ASAP2_VERSION 1 3
/begin PROJECT P411 "BMW DDE6.0 6-Zylinder V96.2 14.10.2004"
/begin HEADER "" VERSION "V96.2_6Z" PROJECT_NO P411 /end HEADER
/begin MODULE DIM ""
/begin MOD_COMMON "" BYTE_ORDER MSB_FIRST ALIGNMENT_BYTE 1 ALIGNMENT_WORD 2 ALIGNMENT_LONG 4 ALIGNMENT_FLOAT32_IEEE 4 /end MOD_COMMON
/begin CHARACTERISTIC DSM_RdyABForceMsk_C "Maske zur Erzwingung von Readiness durch bitweises AND mit Message DSM_stRdyAB" VALUE 0xCF83A Kw_Wu16 65535.00 OneToOne 0.00 65535.00 FORMAT "%8.2" /end CHARACTERISTIC
/begin CHARACTERISTIC DSM_RdyCDForceMsk_C "Maske zur Erzwingung von Readiness durch bitweises AND mit Message DSM_stRdyCD" VALUE 0xCF83C Kw_Wu16 65535.00 OneToOne 0.00 65535.00 FORMAT "%8.2" /end CHARACTERISTIC
/begin CHARACTERISTIC DSM_RdyOnMilEnable_C "Verhalten Readiness bei angesteuerter MIL" VALUE 0xCF83E Kw_Wu8 1.00000000000 RdyOnMilEnable 0.00 1.00000000000 FORMAT "%13.11" /end CHARACTERISTIC
/begin CHARACTERISTIC DSM_TsfDfp_Layer_TANS_C "Schwerezaehlergrenze fuer Fehlerpfad Dfp_Layer_TANS" VALUE 0xCF6D6 Kw_Wu8 51000. TimeDsmTsf 0.00 51000. FORMAT "%5.0" /end CHARACTERISTIC
/begin CHARACTERISTIC DSM_TsfDfp_ACCDCmpr_C "Schwerezaehlergrenze fuer Fehlerpfad Dfp_ACCDCmpr" VALUE 0xCF6D7 Kw_Wu8 51000. TimeDsmTsf 0.00 51000. FORMAT "%5.0" /end CHARACTERISTIC
/begin CHARACTERISTIC DSM_TsfDfp_ACCDPres_C "Schwerezaehlergrenze fuer Fehlerpfad Dfp_ACCDPres" VALUE 0xCF6D8 Kw_Wu8 51000. TimeDsmTsf 0.00 51000. FORMAT "%5.0" /end CHARACTERISTIC
/begin CHARACTERISTIC DSM_TsfDfp_ACCDPres1_C "Schwerezaehlergrenze fuer Fehlerpfad Dfp_ACCDPres1" VALUE 0xCF6D9 Kw_Wu8 51000. TimeDsmTsf 0.00 51000. FORMAT "%5.0" /end CHARACTERISTIC
/begin CHARACTERISTIC DSM_TsfDfp_ACCDPresAna_C "Schwerezaehlergrenze fuer Fehlerpfad Dfp_ACCDPresAna" VALUE 0xCF6DA Kw_Wu8 51000. TimeDsmTsf 0.00 51000. FORMAT "%5.0" /end CHARACTERISTIC
/begin CHARACTERISTIC DSM_TsfDfp_ACCDSwtin_C "Schwerezaehlergrenze fuer Fehlerpfad Dfp_ACCDSwtin" VALUE 0xCF6DB Kw_Wu8 51000. TimeDsmTsf 0.00 51000. FORMAT "%5.0" /end CHARACTERISTIC
/begin CHARACTERISTIC DSM_TsfDfp_ACC_PlausTrqDes_C "Schwerezaehlergrenze fuer Fehlerpfad Dfp_ACC_PlausTrqDes" VALUE 0xCF6DC Kw_Wu8 51000. TimeDsmTsf 0.00 51000. FORMAT "%5.0" /end CHARACTERISTIC
/begin CHARACTERISTIC DSM_TsfDfp_ACC_trqInr_C "Schwerezaehlergrenze fuer Fehlerpfad Dfp_ACC_trqInr" VALUE 0xCF6DD Kw_Wu8 51000. TimeDsmTsf 0.00 51000. FORMAT "%5.0" /end CHARACTERISTIC
/begin CHARACTERISTIC DSM_TsfDfp_ACTrq_C "Schwerezaehlergrenze fuer Fehlerpfad Dfp_ACTrq" VALUE 0xCF6DE Kw_Wu8 51000. TimeDsmTsf 0.00 51000. FORMAT "%5.0" /end CHARACTERISTIC
/begin CHARACTERISTIC DSM_TsfDfp_ADCMon_C "Schwerezaehlergrenze fuer Fehlerpfad Dfp_ADCMon" VALUE 0xCF6DF Kw_Wu8 51000. TimeDsmTsf 0.00 51000. FORMAT "%5.0" /end CHARACTERISTIC
/begin CHARACTERISTIC DSM_TsfDfp_AFSCDIdlAdjVal_C "Schwerezaehlergrenze fuer Fehlerpfad Dfp_AFSCDIdlAdjVal" VALUE 0xCF6E0 Kw_Wu8 51000. TimeDsmTsf 0.00 51000. FORMAT "%5.0" /end CHARACTERISTIC
/begin CHARACTERISTIC DSM_TsfDfp_AFSCDLdAdjVal_C "Schwerezaehlergrenze fuer Fehlerpfad Dfp_AFSCDLdAdjVal" VALUE 0xCF6E1 Kw_Wu8 51000. TimeDsmTsf 0.00 51000. FORMAT "%5.0" /end CHARACTERISTIC
/begin CHARACTERISTIC DSM_TsfDfp_AFSCD_AirTempDcyc_C "Schwerezaehlergrenze fuer Fehlerpfad Dfp_AFSCD_AirTempDcyc" VALUE 0xCF6E2 Kw_Wu8 51000. TimeDsmTsf 0.00 51000. FORMAT "%5.0" /end CHARACTERISTIC
/begin CHARACTERISTIC DSM_TsfDfp_AFSCD_PlOffsDrft_C "Schwerezaehlergrenze fuer Fehlerpfad Dfp_AFSCD_PlOffsDrft" VALUE 0xCF6E3 Kw_Wu8 51000. TimeDsmTsf 0.00 51000. FORMAT "%5.0" /end CHARACTERISTIC
/begin CHARACTERISTIC DSM_TsfDfp_AFSCD_PlSetyDrft_C "Schwerezaehlergrenze fuer Fehlerpfad Dfp_AFSCD_PlSetyDrft" VALUE 0xCF6E4 Kw_Wu8 51000. TimeDsmTsf 0.00 51000. FORMAT "%5.0" /end CHARACTERISTIC
/begin CHARACTERISTIC DSM_TsfDfp_AFSCD_SRCAirTemp_C "Schwerezaehlergrenze fuer Fehlerpfad Dfp_AFSCD_SRCAirTemp" VALUE 0xCF6E5 Kw_Wu8 51000. TimeDsmTsf 0.00 51000. FORMAT "%5.0" /end CHARACTERISTIC
/begin CHARACTERISTIC DSM_TsfDfp_AFSCD_SRCBatt_C "Schwerezaehlergrenze fuer Fehlerpfad Dfp_AFSCD_SRCBatt" VALUE 0xCF6E6 Kw_Wu8 51000. TimeDsmTsf 0.00 51000. FORMAT "%5.0" /end CHARACTERISTIC
/begin CHARACTERISTIC DSM_TsfDfp_AFSCD_SRCCorrAirm_C "Schwerezaehlergrenze fuer Fehlerpfad Dfp_AFSCD_SRCCorrAirm" VALUE 0xCF6E7 Kw_Wu8 51000. TimeDsmTsf 0.00 51000. FORMAT "%5.0" /end CHARACTERISTIC
/begin CHARACTERISTIC DSM_TsfDfp_AFSCD_SRCRawAirm_C "Schwerezaehlergrenze fuer Fehlerpfad Dfp_AFSCD_SRCRawAirm" VALUE 0xCF6E8 Kw_Wu8 51000. TimeDsmTsf 0.00 51000. FORMAT "%5.0" /end CHARACTERISTIC
/begin CHARACTERISTIC DSM_TsfDfp_Layer_TUMG_C "Schwerezaehlergrenze fuer Fehlerpfad Dfp_Layer_TUMG" VALUE 0xCF6E9 Kw_Wu8 51000. TimeDsmTsf 0.00 51000. FORMAT "%5.0" /end CHARACTERISTIC
/begin CHARACTERISTIC DSM_TsfDfp_AFSCD_SRCRefSigPer_C "Schwerezaehlergrenze fuer Fehlerpfad Dfp_AFSCD_SRCRefSigPer" VALUE 0xCF6EA Kw_Wu8 51000. TimeDsmTsf 0.00 51000. FORMAT "%5.0" /end CHARACTERISTIC
/begin CHARACTERISTIC DSM_TsfDfp_AOHtCD_C "Schwerezaehlergrenze fuer Fehlerpfad Dfp_AOHtCD" VALUE 0xCF6EB Kw_Wu8 51000. TimeDsmTsf 0.00 51000. FORMAT "%5.0" /end CHARACTERISTIC
/begin CHARACTERISTIC DSM_TsfDfp_Layer_GEN_C "Schwerezaehlergrenze fuer Fehlerpfad Dfp_Layer_GEN" VALUE 0xCF6EC Kw_Wu8 51000. TimeDsmTsf 0.00 51000. FORMAT "%5.0" /end CHARACTERISTIC
/begin CHARACTERISTIC DSM_TsfDfp_Layer_BSD_C "Schwerezaehlergrenze fuer Fehlerpfad Dfp_Layer_BSD" VALUE 0xCF6ED Kw_Wu8 51000. TimeDsmTsf 0.00 51000. FORMAT "%5.0" /end CHARACTERISTIC
/begin CHARACTERISTIC DSM_TsfDfp_AOHtCD_AOHtDia1_C "Schwerezaehlergrenze fuer Fehlerpfad Dfp_AOHtCD_AOHtDia1" VALUE 0xCF6EE Kw_Wu8 51000. TimeDsmTsf 0.00 51000. FORMAT "%5.0" /end CHARACTERISTIC
/begin CHARACTERISTIC DSM_TsfDfp_AOHtCD_AOHtDia2_C "Schwerezaehlergrenze fuer Fehlerpfad Dfp_AOHtCD_AOHtDia2" VALUE 0xCF6EF Kw_Wu8 51000. TimeDsmTsf 0.00 51000. FORMAT "%5.0" /end CHARACTERISTIC
/begin CHARACTERISTIC DSM_TsfDfp_AOHtCD_AOHtDia3_C "Schwerezaehlergrenze fuer Fehlerpfad Dfp_AOHtCD_AOHtDia3" VALUE 0xCF6F0 Kw_Wu8 51000. TimeDsmTsf 0.00 51000. FORMAT "%5.0" /end CHARACTERISTIC
/begin CHARACTERISTIC DSM_TsfDfp_APP1_C "Schwerezaehlergrenze fuer Fehlerpfad Dfp_APP1" VALUE 0xCF6F1 Kw_Wu8 51000. TimeDsmTsf 0.00 51000. FORMAT "%5.0" /end CHARACTERISTIC
/begin CHARACTERISTIC DSM_TsfDfp_APP2_C "Schwerezaehlergrenze fuer Fehlerpfad Dfp_APP2" VALUE 0xCF6F2 Kw_Wu8 51000. TimeDsmTsf 0.00 51000. FORMAT "%5.0" /end CHARACTERISTIC
/begin CHARACTERISTIC DSM_TsfDfp_APPCDCmpd_C "Schwerezaehlergrenze fuer Fehlerpfad Dfp_APPCDCmpd" VALUE 0xCF6F3 Kw_Wu8 51000. TimeDsmTsf 0.00 51000. FORMAT "%5.0" /end CHARACTERISTIC
/begin CHARACTERISTIC DSM_TsfDfp_APPSync_C "Schwerezaehlergrenze fuer Fehlerpfad Dfp_APPSync" VALUE 0xCF6F4 Kw_Wu8 51000. TimeDsmTsf 0.00 51000. FORMAT "%5.0" /end CHARACTERISTIC
/begin CHARACTERISTIC DSM_TsfDfp_APSCD_C "Schwerezaehlergrenze fuer Fehlerpfad Dfp_APSCD" VALUE 0xCF6F5 Kw_Wu8 51000. TimeDsmTsf 0.00 51000. FORMAT "%5.0" /end CHARACTERISTIC
/begin CHARACTERISTIC DSM_TsfDfp_ARS_C "Schwerezaehlergrenze fuer Fehlerpfad Dfp_ARS" VALUE 0xCF6F6 Kw_Wu8 51000. TimeDsmTsf 0.00 51000. FORMAT "%5.0" /end CHARACTERISTIC
/begin CHARACTERISTIC DSM_TsfDfp_AccPedPlausBrk_C "Schwerezaehlergrenze fuer Fehlerpfad Dfp_AccPedPlausBrk" VALUE 0xCF6F7 Kw_Wu8 51000. TimeDsmTsf 0.00 51000. FORMAT "%5.0" /end CHARACTERISTIC
/begin CHARACTERISTIC DSM_TsfDfp_Layer_QLT_C "Schwerezaehlergrenze fuer Fehlerpfad Dfp_Layer_QLT" VALUE 0xCF6F8 Kw_Wu8 51000. TimeDsmTsf 0.00 51000. FORMAT "%5.0" /end CHARACTERISTIC
/begin CHARACTERISTIC DSM_TsfDfp_AirCtlGvnrDvtRgnMax_C "Schwerezaehlergrenze fuer Fehlerpfad Dfp_AirCtlGvnrDvtRgnMax" VALUE 0xCF6F9 Kw_Wu8 51000. TimeDsmTsf 0.00 51000. FORMAT "%5.0" /end CHARACTERISTIC
/begin CHARACTERISTIC DSM_TsfDfp_Layer_IBS1_C "Schwerezaehlergrenze fuer Fehlerpfad Dfp_Layer_IBS1" VALUE 0xCF6FA Kw_Wu8 51000. TimeDsmTsf 0.00 51000. FORMAT "%5.0" /end CHARACTERISTIC
/begin CHARACTERISTIC DSM_TsfDfp_Layer_IBS2_C "Schwerezaehlergrenze fuer Fehlerpfad Dfp_Layer_IBS2" VALUE 0xCF6FB Kw_Wu8 51000. TimeDsmTsf 0.00 51000. FORMAT "%5.0" /end CHARACTERISTIC
/begin CHARACTERISTIC DSM_TsfDfp_Layer_IBS3_C "Schwerezaehlergrenze fuer Fehlerpfad Dfp_Layer_IBS3" VALUE 0xCF6FC Kw_Wu8 51000. TimeDsmTsf 0.00 51000. FORMAT "%5.0" /end CHARACTERISTIC
/begin CHARACTERISTIC DSM_TsfDfp_Layer_PMBN_C "Schwerezaehlergrenze fuer Fehlerpfad Dfp_Layer_PMBN" VALUE 0xCF6FD Kw_Wu8 51000. TimeDsmTsf 0.00 51000. FORMAT "%5.0" /end CHARACTERISTIC
/begin CHARACTERISTIC DSM_TsfDfp_Layer_PMBATT_C "Schwerezaehlergrenze fuer Fehlerpfad Dfp_Layer_PMBATT" VALUE 0xCF6FE Kw_Wu8 51000. TimeDsmTsf 0.00 51000. FORMAT "%5.0" /end CHARACTERISTIC
/begin CHARACTERISTIC DSM_TsfDfp_AirCtlGvnrDvtRgnMin_C "Schwerezaehlergrenze fuer Fehlerpfad Dfp_AirCtlGvnrDvtRgnMin" VALUE 0xCF6FF Kw_Wu8 51000. TimeDsmTsf 0.00 51000. FORMAT "%5.0" /end CHARACTERISTIC
/begin CHARACTERISTIC DSM_TsfDfp_AirCtlGvnrDvtRgnMn2_C "Schwerezaehlergrenze fuer Fehlerpfad Dfp_AirCtlGvnrDvtRgnMn2" VALUE 0xCF700 Kw_Wu8 51000. TimeDsmTsf 0.00 51000. FORMAT "%5.0" /end CHARACTERISTIC
/begin CHARACTERISTIC DSM_TsfDfp_AirCtlGvnrDvtRgnMx2_C "Schwerezaehlergrenze fuer Fehlerpfad Dfp_AirCtlGvnrDvtRgnMx2" VALUE 0xCF701 Kw_Wu8 51000. TimeDsmTsf 0.00 51000. FORMAT "%5.0" /end CHARACTERISTIC
/begin CHARACTERISTIC DSM_TsfDfp_AirCtlPlateBreak_C "DSM variable for Dfp_AirCtlPlateBreak_mp" VALUE 0xCF702 Kw_Wu8 51000. TimeDsmTsf 0.00 51000. FORMAT "%5.0" /end CHARACTERISTIC
/begin CHARACTERISTIC DSM_TsfDfp_AirCtlRmpTO_C "Schwerezaehlergrenze fuer Fehlerpfad Dfp_AirCtlRmpTO" VALUE 0xCF703 Kw_Wu8 51000. TimeDsmTsf 0.00 51000. FORMAT "%5.0" /end CHARACTERISTIC
/begin CHARACTERISTIC DSM_TsfDfp_AirCtl_GovNegDev_C "Schwerezaehlergrenze fuer Fehlerpfad Dfp_AirCtl_GovNegDev" VALUE 0xCF704 Kw_Wu8 51000. TimeDsmTsf 0.00 51000. FORMAT "%5.0" /end CHARACTERISTIC
/begin CHARACTERISTIC DSM_TsfDfp_AirCtl_GovNegDev2_C "Schwerezaehlergrenze fuer Fehlerpfad Dfp_AirCtl_GovNegDev2" VALUE 0xCF705 Kw_Wu8 51000. TimeDsmTsf 0.00 51000. FORMAT "%5.0" /end CHARACTERISTIC
/begin CHARACTERISTIC DSM_TsfDfp_AirCtl_GovPosDev_C "Schwerezaehlergrenze fuer Fehlerpfad Dfp_AirCtl_GovPosDev" VALUE 0xCF706 Kw_Wu8 51000. TimeDsmTsf 0.00 51000. FORMAT "%5.0" /end CHARACTERISTIC
/begin CHARACTERISTIC DSM_TsfDfp_AirCtl_GovPosDev2_C "Schwerezaehlergrenze fuer Fehlerpfad Dfp_AirCtl_GovPosDev2" VALUE 0xCF707 Kw_Wu8 51000. TimeDsmTsf 0.00 51000. FORMAT "%5.0" /end CHARACTERISTIC
/begin CHARACTERISTIC DSM_TsfDfp_AltCD_C "Schwerezaehlergrenze fuer Fehlerpfad Dfp_AltCD" VALUE 0xCF708 Kw_Wu8 51000. TimeDsmTsf 0.00 51000. FORMAT "%5.0" /end CHARACTERISTIC
/begin CHARACTERISTIC DSM_TsfDfp_AltCD_Load_C "Schwerezaehlergrenze fuer Fehlerpfad Dfp_AltCD_Load" VALUE 0xCF709 Kw_Wu8 51000. TimeDsmTsf 0.00 51000. FORMAT "%5.0" /end CHARACTERISTIC
/begin CHARACTERISTIC DSM_TsfDfp_BPACD_BPADia1_C "Schwerezaehlergrenze fuer Fehlerpfad Dfp_BPACD_BPADia1" VALUE 0xCF70A Kw_Wu8 51000. TimeDsmTsf 0.00 51000. FORMAT "%5.0" /end CHARACTERISTIC
/begin CHARACTERISTIC DSM_TsfDfp_BPACD_BPADia2_C "Schwerezaehlergrenze fuer Fehlerpfad Dfp_BPACD_BPADia2" VALUE 0xCF70B Kw_Wu8 51000. TimeDsmTsf 0.00 51000. FORMAT "%5.0" /end CHARACTERISTIC
/begin CHARACTERISTIC DSM_TsfDfp_BPACD_BPADia3_C "Schwerezaehlergrenze fuer Fehlerpfad Dfp_BPACD_BPADia3" VALUE 0xCF70C Kw_Wu8 51000. TimeDsmTsf 0.00 51000. FORMAT "%5.0" /end CHARACTERISTIC
/begin CHARACTERISTIC DSM_TsfDfp_BPACD_BPADia4_C "Schwerezaehlergrenze fuer Fehlerpfad Dfp_BPACD_BPADia4" VALUE 0xCF70D Kw_Wu8 51000. TimeDsmTsf 0.00 51000. FORMAT "%5.0" /end CHARACTERISTIC
/begin CHARACTERISTIC DSM_TsfDfp_BPACD_Max_C "Schwerezaehlergrenze fuer Fehlerpfad Dfp_BPACD_Max" VALUE 0xCF70E Kw_Wu8 51000. TimeDsmTsf 0.00 51000. FORMAT "%5.0" /end CHARACTERISTIC
/begin CHARACTERISTIC DSM_TsfDfp_BPACD_Min_C "Schwerezaehlergrenze fuer Fehlerpfad Dfp_BPACD_Min" VALUE 0xCF70F Kw_Wu8 51000. TimeDsmTsf 0.00 51000. FORMAT "%5.0" /end CHARACTERISTIC
/begin CHARACTERISTIC DSM_TsfDfp_BPACD_PwmIn_C "Schwerezaehlergrenze fuer Fehlerpfad Dfp_BPACD_PwmIn" VALUE 0xCF710 Kw_Wu8 51000. TimeDsmTsf 0.00 51000. FORMAT "%5.0" /end CHARACTERISTIC
/begin CHARACTERISTIC DSM_TsfDfp_BPACD_PwmInDia1_C "Schwerezaehlergrenze fuer Fehlerpfad Dfp_BPACD_PwmInDia1" VALUE 0xCF711 Kw_Wu8 51000. TimeDsmTsf 0.00 51000. FORMAT "%5.0" /end CHARACTERISTIC
/begin CHARACTERISTIC DSM_TsfDfp_BPACD_PwmInDia2_C "Schwerezaehlergrenze fuer Fehlerpfad Dfp_BPACD_PwmInDia2" VALUE 0xCF712 Kw_Wu8 51000. TimeDsmTsf 0.00 51000. FORMAT "%5.0" /end CHARACTERISTIC
/begin CHARACTERISTIC DSM_TsfDfp_BPACD_PwmInDia3_C "Schwerezaehlergrenze fuer Fehlerpfad Dfp_BPACD_PwmInDia3" VALUE 0xCF713 Kw_Wu8 51000. TimeDsmTsf 0.00 51000. FORMAT "%5.0" /end CHARACTERISTIC
/begin CHARACTERISTIC DSM_TsfDfp_BPACD_PwmInDia4_C "Schwerezaehlergrenze fuer Fehlerpfad Dfp_BPACD_PwmInDia4" VALUE 0xCF714 Kw_Wu8 51000. TimeDsmTsf 0.00 51000. FORMAT "%5.0" /end CHARACTERISTIC
/begin CHARACTERISTIC DSM_TsfDfp_BPACD_SigNpl_C "Schwerezaehlergrenze fuer Fehlerpfad Dfp_BPACD_SigNpl" VALUE 0xCF715 Kw_Wu8 51000. TimeDsmTsf 0.00 51000. FORMAT "%5.0" /end CHARACTERISTIC
/begin CHARACTERISTIC DSM_TsfDfp_BPSCD_C "Schwerezaehlergrenze fuer Fehlerpfad Dfp_BPSCD" VALUE 0xCF716 Kw_Wu8 51000. TimeDsmTsf 0.00 51000. FORMAT "%5.0" /end CHARACTERISTIC
/begin CHARACTERISTIC DSM_TsfDfp_BattCD_C "Schwerezaehlergrenze fuer Fehlerpfad Dfp_BattCD" VALUE 0xCF717 Kw_Wu8 51000. TimeDsmTsf 0.00 51000. FORMAT "%5.0" /end CHARACTERISTIC
/begin CHARACTERISTIC DSM_TsfDfp_BrkCD_C "Schwerezaehlergrenze fuer Fehlerpfad Dfp_BrkCD" VALUE 0xCF718 Kw_Wu8 51000. TimeDsmTsf 0.00 51000. FORMAT "%5.0" /end CHARACTERISTIC
/begin CHARACTERISTIC DSM_TsfDfp_Bss_C "Schwerezaehlergrenze fuer Fehlerpfad Dfp_Bss" VALUE 0xCF719 Kw_Wu8 51000. TimeDsmTsf 0.00 51000. FORMAT "%5.0" /end CHARACTERISTIC
/begin CHARACTERISTIC DSM_TsfDfp_CBACD_C "Schwerezaehlergrenze fuer Fehlerpfad Dfp_CBACD" VALUE 0xCF71A Kw_Wu8 51000. TimeDsmTsf 0.00 51000. FORMAT "%5.0" /end CHARACTERISTIC
/begin CHARACTERISTIC DSM_TsfDfp_CTSCD_C "Schwerezaehlergrenze fuer Fehlerpfad Dfp_CTSCD" VALUE 0xCF71B Kw_Wu8 51000. TimeDsmTsf 0.00 51000. FORMAT "%5.0" /end CHARACTERISTIC
/begin CHARACTERISTIC DSM_TsfDfp_Clg_DynTst_C "Schwerezaehlergrenze fuer Fehlerpfad Dfp_Clg_DynTst" VALUE 0xCF71C Kw_Wu8 51000. TimeDsmTsf 0.00 51000. FORMAT "%5.0" /end CHARACTERISTIC
/begin CHARACTERISTIC DSM_TsfDfp_CmbChbMisfire1_C "Schwerezaehlergrenze fuer Fehlerpfad Dfp_CmbChbMisfire1" VALUE 0xCF71D Kw_Wu8 51000. TimeDsmTsf 0.00 51000. FORMAT "%5.0" /end CHARACTERISTIC
/begin CHARACTERISTIC DSM_TsfDfp_CmbChbMisfire2_C "Schwerezaehlergrenze fuer Fehlerpfad Dfp_CmbChbMisfire2" VALUE 0xCF71E Kw_Wu8 51000. TimeDsmTsf 0.00 51000. FORMAT "%5.0" /end CHARACTERISTIC
/begin CHARACTERISTIC DSM_TsfDfp_Layer_PMRUHVERL_C "Schwerezaehlergrenze fuer Fehlerpfad Dfp_Layer_PMRUHVERL" VALUE 0xCF71F Kw_Wu8 51000. TimeDsmTsf 0.00 51000. FORMAT "%5.0" /end CHARACTERISTIC
/begin CHARACTERISTIC DSM_TsfDfp_CmbChbMisfire3_C "Schwerezaehlergrenze fuer Fehlerpfad Dfp_CmbChbMisfire3" VALUE 0xCF720 Kw_Wu8 51000. TimeDsmTsf 0.00 51000. FORMAT "%5.0" /end CHARACTERISTIC
/begin CHARACTERISTIC DSM_TsfDfp_CmbChbMisfire4_C "Schwerezaehlergrenze fuer Fehlerpfad Dfp_CmbChbMisfire4" VALUE 0xCF721 Kw_Wu8 51000. TimeDsmTsf 0.00 51000. FORMAT "%5.0" /end CHARACTERISTIC
/begin CHARACTERISTIC DSM_TsfDfp_CmbChbMisfire5_C "Schwerezaehlergrenze fuer Fehlerpfad Dfp_CmbChbMisfire5" VALUE 0xCF722 Kw_Wu8 51000. TimeDsmTsf 0.00 51000. FORMAT "%5.0" /end CHARACTERISTIC
/begin CHARACTERISTIC DSM_TsfDfp_CmbChbMisfire6_C "Schwerezaehlergrenze fuer Fehlerpfad Dfp_CmbChbMisfire6" VALUE 0xCF723 Kw_Wu8 51000. TimeDsmTsf 0.00 51000. FORMAT "%5.0" /end CHARACTERISTIC
/begin CHARACTERISTIC DSM_TsfDfp_Layer_TOENS_C "Schwerezaehlergrenze fuer Fehlerpfad Dfp_Layer_TOENS" VALUE 0xCF724 Kw_Wu8 51000. TimeDsmTsf 0.00 51000. FORMAT "%5.0" /end CHARACTERISTIC
/begin CHARACTERISTIC DSM_TsfDfp_Layer_MANHYDR_C "Schwerezaehlergrenze fuer Fehlerpfad Dfp_Layer_MANHYDR" VALUE 0xCF725 Kw_Wu8 51000. TimeDsmTsf 0.00 51000. FORMAT "%5.0" /end CHARACTERISTIC
/begin CHARACTERISTIC DSM_TsfDfp_Layer_MANLUFT_C "Schwerezaehlergrenze fuer Fehlerpfad Dfp_Layer_MANLUFT" VALUE 0xCF726 Kw_Wu8 51000. TimeDsmTsf 0.00 51000. FORMAT "%5.0" /end CHARACTERISTIC
/begin CHARACTERISTIC DSM_TsfDfp_CmbChbMisfireMul_C "Schwerezaehlergrenze fuer Fehlerpfad Dfp_CmbChbMisfireMul" VALUE 0xCF727 Kw_Wu8 51000. TimeDsmTsf 0.00 51000. FORMAT "%5.0" /end CHARACTERISTIC
/begin CHARACTERISTIC DSM_TsfDfp_CoVMDCSh_C "Schwerezaehlergrenze fuer Fehlerpfad Dfp_CoVMDCSh" VALUE 0xCF728 Kw_Wu8 51000. TimeDsmTsf 0.00 51000. FORMAT "%5.0" /end CHARACTERISTIC
/begin CHARACTERISTIC DSM_TsfDfp_ConvCD_C "Schwerezaehlergrenze fuer Fehlerpfad Dfp_ConvCD" VALUE 0xCF729 Kw_Wu8 51000. TimeDsmTsf 0.00 51000. FORMAT "%5.0" /end CHARACTERISTIC
/begin CHARACTERISTIC DSM_TsfDfp_CrCCDMFL_C "Schwerezaehlergrenze fuer Fehlerpfad Dfp_CrCCDMFL" VALUE 0xCF72A Kw_Wu8 51000. TimeDsmTsf 0.00 51000. FORMAT "%5.0" /end CHARACTERISTIC
/begin CHARACTERISTIC DSM_TsfDfp_CrCtl_vCrCtl_C "Schwerezaehlergrenze fuer Fehlerpfad Dfp_CrCtl_vCrCtl" VALUE 0xCF72B Kw_Wu8 51000. TimeDsmTsf 0.00 51000. FORMAT "%5.0" /end CHARACTERISTIC
/begin CHARACTERISTIC DSM_TsfDfp_DCC_PlausTrqDes_C "Schwerezaehlergrenze fuer Fehlerpfad Dfp_DCC_PlausTrqDes" VALUE 0xCF72C Kw_Wu8 51000. TimeDsmTsf 0.00 51000. FORMAT "%5.0" /end CHARACTERISTIC
/begin CHARACTERISTIC DSM_TsfDfp_Dummy1_C "Schwerezaehlergrenze fuer Fehlerpfad Dfp_Dummy1" VALUE 0xCF72D Kw_Wu8 51000. TimeDsmTsf 0.00 51000. FORMAT "%5.0" /end CHARACTERISTIC
/begin CHARACTERISTIC DSM_TsfDfp_EATSCD_C "Schwerezaehlergrenze fuer Fehlerpfad Dfp_EATSCD" VALUE 0xCF72E Kw_Wu8 51000. TimeDsmTsf 0.00 51000. FORMAT "%5.0" /end CHARACTERISTIC
/begin CHARACTERISTIC DSM_TsfDfp_EBAFCD_C "Schwerezaehlergrenze fuer Fehlerpfad Dfp_EBAFCD" VALUE 0xCF72F Kw_Wu8 51000. TimeDsmTsf 0.00 51000. FORMAT "%5.0" /end CHARACTERISTIC
/begin CHARACTERISTIC DSM_TsfDfp_EBFCD_C "Schwerezaehlergrenze fuer Fehlerpfad Dfp_EBFCD" VALUE 0xCF730 Kw_Wu8 51000. TimeDsmTsf 0.00 51000. FORMAT "%5.0" /end CHARACTERISTIC
/begin CHARACTERISTIC DSM_TsfDfp_EBTSCD_C "Schwerezaehlergrenze fuer Fehlerpfad Dfp_EBTSCD" VALUE 0xCF731 Kw_Wu8 51000. TimeDsmTsf 0.00 51000. FORMAT "%5.0" /end CHARACTERISTIC
/begin CHARACTERISTIC DSM_TsfDfp_EBTSCD_OvrTemp_C "Schwerezaehlergrenze fuer Fehlerpfad Dfp_EBTSCD_OvrTemp" VALUE 0xCF732 Kw_Wu8 51000. TimeDsmTsf 0.00 51000. FORMAT "%5.0" /end CHARACTERISTIC
/begin CHARACTERISTIC DSM_TsfDfp_ECBCD_C "Schwerezaehlergrenze fuer Fehlerpfad Dfp_ECBCD" VALUE 0xCF733 Kw_Wu8 51000. TimeDsmTsf 0.00 51000. FORMAT "%5.0" /end CHARACTERISTIC
/begin CHARACTERISTIC DSM_TsfDfp_EEPCDVarMng_C "Schwerezaehlergrenze fuer Fehlerpfad Dfp_EEPCDVarMng" VALUE 0xCF734 Kw_Wu8 51000. TimeDsmTsf 0.00 51000. FORMAT "%5.0" /end CHARACTERISTIC
/begin CHARACTERISTIC DSM_TsfDfp_EGPpCD_C "Schwerezaehlergrenze fuer Fehlerpfad Dfp_EGPpCD" VALUE 0xCF735 Kw_Wu8 51000. TimeDsmTsf 0.00 51000. FORMAT "%5.0" /end CHARACTERISTIC
/begin CHARACTERISTIC DSM_TsfDfp_EGPpCDTPreTrbn_C "Schwerezaehlergrenze fuer Fehlerpfad Dfp_EgPpCDTPreTrbn" VALUE 0xCF736 Kw_Wu8 51000. TimeDsmTsf 0.00 51000. FORMAT "%5.0" /end CHARACTERISTIC
/begin CHARACTERISTIC DSM_TsfDfp_EGRCD_Max_C "Schwerezaehlergrenze fuer Fehlerpfad Dfp_EGRCD_Max" VALUE 0xCF737 Kw_Wu8 51000. TimeDsmTsf 0.00 51000. FORMAT "%5.0" /end CHARACTERISTIC
/begin CHARACTERISTIC DSM_TsfDfp_EGRCD_Min_C "Schwerezaehlergrenze fuer Fehlerpfad Dfp_EGRCD_Min" VALUE 0xCF738 Kw_Wu8 51000. TimeDsmTsf 0.00 51000. FORMAT "%5.0" /end CHARACTERISTIC
/begin CHARACTERISTIC DSM_TsfDfp_EGRCD_SigNpl_C "Schwerezaehlergrenze fuer Fehlerpfad Dfp_EGRCD_SigNpl" VALUE 0xCF739 Kw_Wu8 51000. TimeDsmTsf 0.00 51000. FORMAT "%5.0" /end CHARACTERISTIC
/begin CHARACTERISTIC DSM_TsfDfp_EGTOilLvlCrit_C "Schwerezaehlergrenze fuer Fehlerpfad Dfp_EGTOilLvlCrit" VALUE 0xCF73A Kw_Wu8 51000. TimeDsmTsf 0.00 51000. FORMAT "%5.0" /end CHARACTERISTIC
/begin CHARACTERISTIC DSM_TsfDfp_EGTOilVscCrit_C "Schwerezaehlergrenze fuer Fehlerpfad Dfp_EGTOilVscCrit" VALUE 0xCF73B Kw_Wu8 51000. TimeDsmTsf 0.00 51000. FORMAT "%5.0" /end CHARACTERISTIC
/begin CHARACTERISTIC DSM_TsfDfp_EGTRgnOilDil_C "Schwerezaehlergrenze fuer Fehlerpfad Dfp_EGTRgnOilDil" VALUE 0xCF73C Kw_Wu8 51000. TimeDsmTsf 0.00 51000. FORMAT "%5.0" /end CHARACTERISTIC
/begin CHARACTERISTIC DSM_TsfDfp_EGTTempGvnrInr_C "Schwerezaehlergrenze fuer Fehlerpfad Dfp_EGTTempGvnrInr" VALUE 0xCF73D Kw_Wu8 51000. TimeDsmTsf 0.00 51000. FORMAT "%5.0" /end CHARACTERISTIC
/begin CHARACTERISTIC DSM_TsfDfp_EGTTempGvnrOutr_C "Schwerezaehlergrenze fuer Fehlerpfad Dfp_EGTTempGvnrOutr" VALUE 0xCF73E Kw_Wu8 51000. TimeDsmTsf 0.00 51000. FORMAT "%5.0" /end CHARACTERISTIC
/begin CHARACTERISTIC DSM_TsfDfp_EMCCD1_C "Schwerezaehlergrenze fuer Fehlerpfad Dfp_EMCCD1" VALUE 0xCF73F Kw_Wu8 51000. TimeDsmTsf 0.00 51000. FORMAT "%5.0" /end CHARACTERISTIC
/begin CHARACTERISTIC DSM_TsfDfp_EMCCD2_C "Schwerezaehlergrenze fuer Fehlerpfad Dfp_EMCCD2" VALUE 0xCF740 Kw_Wu8 51000. TimeDsmTsf 0.00 51000. FORMAT "%5.0" /end CHARACTERISTIC
/begin CHARACTERISTIC DSM_TsfDfp_EMCCD_ADC1_C "Schwerezaehlergrenze fuer Fehlerpfad Dfp_EMCCD_ADC1" VALUE 0xCF741 Kw_Wu8 51000. TimeDsmTsf 0.00 51000. FORMAT "%5.0" /end CHARACTERISTIC
/begin CHARACTERISTIC DSM_TsfDfp_EMCCD_ADC2_C "Schwerezaehlergrenze fuer Fehlerpfad Dfp_EMCCD_ADC2" VALUE 0xCF742 Kw_Wu8 51000. TimeDsmTsf 0.00 51000. FORMAT "%5.0" /end CHARACTERISTIC
/begin CHARACTERISTIC DSM_TsfDfp_ETClbETFltInj1_C "Schwerezaehlergrenze fuer Fehlerpfad Dfp_ETClbETFltInj1" VALUE 0xCF743 Kw_Wu8 51000. TimeDsmTsf 0.00 51000. FORMAT "%5.0" /end CHARACTERISTIC
/begin CHARACTERISTIC DSM_TsfDfp_ETClbETFltInj2_C "Schwerezaehlergrenze fuer Fehlerpfad Dfp_ETClbETFltInj2" VALUE 0xCF744 Kw_Wu8 51000. TimeDsmTsf 0.00 51000. FORMAT "%5.0" /end CHARACTERISTIC
/begin CHARACTERISTIC DSM_TsfDfp_ETClbETFltInj3_C "Schwerezaehlergrenze fuer Fehlerpfad Dfp_ETClbETFltInj3" VALUE 0xCF745 Kw_Wu8 51000. TimeDsmTsf 0.00 51000. FORMAT "%5.0" /end CHARACTERISTIC
/begin CHARACTERISTIC DSM_TsfDfp_ETClbETFltInj4_C "Schwerezaehlergrenze fuer Fehlerpfad Dfp_ETClbETFltInj4" VALUE 0xCF746 Kw_Wu8 51000. TimeDsmTsf 0.00 51000. FORMAT "%5.0" /end CHARACTERISTIC
/begin CHARACTERISTIC DSM_TsfDfp_ETClbETFltInj5_C "Schwerezaehlergrenze fuer Fehlerpfad Dfp_ETClbETFltInj5" VALUE 0xCF747 Kw_Wu8 51000. TimeDsmTsf 0.00 51000. FORMAT "%5.0" /end CHARACTERISTIC
/begin CHARACTERISTIC DSM_TsfDfp_ETClbETFltInj6_C "Schwerezaehlergrenze fuer Fehlerpfad Dfp_ETClbETFltInj6" VALUE 0xCF748 Kw_Wu8 51000. TimeDsmTsf 0.00 51000. FORMAT "%5.0" /end CHARACTERISTIC
/begin CHARACTERISTIC DSM_TsfDfp_ETClbInj1_C "Schwerezaehlergrenze fuer Fehlerpfad Dfp_ETClbInj1" VALUE 0xCF749 Kw_Wu8 51000. TimeDsmTsf 0.00 51000. FORMAT "%5.0" /end CHARACTERISTIC
/begin CHARACTERISTIC DSM_TsfDfp_ETClbInj2_C "Schwerezaehlergrenze fuer Fehlerpfad Dfp_ETClbInj2" VALUE 0xCF74A Kw_Wu8 51000. TimeDsmTsf 0.00 51000. FORMAT "%5.0" /end CHARACTERISTIC
/begin CHARACTERISTIC DSM_TsfDfp_ETClbInj3_C "Schwerezaehlergrenze fuer Fehlerpfad Dfp_ETClbInj3" VALUE 0xCF74B Kw_Wu8 51000. TimeDsmTsf 0.00 51000. FORMAT "%5.0" /end CHARACTERISTIC
/begin CHARACTERISTIC DSM_TsfDfp_ETClbInj4_C "Schwerezaehlergrenze fuer Fehlerpfad Dfp_ETClbInj4" VALUE 0xCF74C Kw_Wu8 51000. TimeDsmTsf 0.00 51000. FORMAT "%5.0" /end CHARACTERISTIC
/begin CHARACTERISTIC DSM_TsfDfp_ETClbInj5_C "Schwerezaehlergrenze fuer Fehlerpfad Dfp_ETClbInj5" VALUE 0xCF74D Kw_Wu8 51000. TimeDsmTsf 0.00 51000. FORMAT "%5.0" /end CHARACTERISTIC
/begin CHARACTERISTIC DSM_TsfDfp_ETClbInj6_C "Schwerezaehlergrenze fuer Fehlerpfad Dfp_ETClbInj6" VALUE 0xCF74E Kw_Wu8 51000. TimeDsmTsf 0.00 51000. FORMAT "%5.0" /end CHARACTERISTIC
/begin CHARACTERISTIC DSM_TsfDfp_EngMCaS1_C "Schwerezaehlergrenze fuer Fehlerpfad Dfp_EngMCaS1" VALUE 0xCF74F Kw_Wu8 51000. TimeDsmTsf 0.00 51000. FORMAT "%5.0" /end CHARACTERISTIC
/begin CHARACTERISTIC DSM_TsfDfp_EngMCrS1_C "Schwerezaehlergrenze fuer Fehlerpfad Dfp_EngMCrS1" VALUE 0xCF750 Kw_Wu8 51000. TimeDsmTsf 0.00 51000. FORMAT "%5.0" /end CHARACTERISTIC
/begin CHARACTERISTIC DSM_TsfDfp_EngMOfsCaSCrS_C "Schwerezaehlergrenze fuer Fehlerpfad Dfp_EngMOfsCaSCrS" VALUE 0xCF751 Kw_Wu8 51000. TimeDsmTsf 0.00 51000. FORMAT "%5.0" /end CHARACTERISTIC
/begin CHARACTERISTIC DSM_TsfDfp_EngPrtFWODet_C "Schwerezaehlergrenze fuer Fehlerpfad Dfp_EngPrtFWODet" VALUE 0xCF752 Kw_Wu8 51000. TimeDsmTsf 0.00 51000. FORMAT "%5.0" /end CHARACTERISTIC
/begin CHARACTERISTIC DSM_TsfDfp_FBCqDvt_C "Schwerezaehlergrenze fuer Fehlerpfad Dfp_FBCqDvt" VALUE 0xCF753 Kw_Wu8 51000. TimeDsmTsf 0.00 51000. FORMAT "%5.0" /end CHARACTERISTIC
/begin CHARACTERISTIC DSM_TsfDfp_FMAErrMod_C "Schwerezaehlergrenze fuer Fehlerpfad Dfp_FMAErrMod" VALUE 0xCF754 Kw_Wu8 51000. TimeDsmTsf 0.00 51000. FORMAT "%5.0" /end CHARACTERISTIC
/begin CHARACTERISTIC DSM_TsfDfp_FMTC_NonMonotonMap_C "Schwerezaehlergrenze fuer Fehlerpfad Dfp_FMTC_NonMonotonMap" VALUE 0xCF755 Kw_Wu8 51000. TimeDsmTsf 0.00 51000. FORMAT "%5.0" /end CHARACTERISTIC
/begin CHARACTERISTIC DSM_TsfDfp_FTSCD_C "Schwerezaehlergrenze fuer Fehlerpfad Dfp_FTSCD" VALUE 0xCF756 Kw_Wu8 51000. TimeDsmTsf 0.00 51000. FORMAT "%5.0" /end CHARACTERISTIC
/begin CHARACTERISTIC DSM_TsfDfp_FanCD_C "Schwerezaehlergrenze fuer Fehlerpfad Dfp_FanCD" VALUE 0xCF757 Kw_Wu8 51000. TimeDsmTsf 0.00 51000. FORMAT "%5.0" /end CHARACTERISTIC
/begin CHARACTERISTIC DSM_TsfDfp_FanCD_FanCtlr1_C "Schwerezaehlergrenze fuer Fehlerpfad Dfp_FanCD_FanCtlr1" VALUE 0xCF758 Kw_Wu8 51000. TimeDsmTsf 0.00 51000. FORMAT "%5.0" /end CHARACTERISTIC
/begin CHARACTERISTIC DSM_TsfDfp_FanCD_FanCtlr2_C "Schwerezaehlergrenze fuer Fehlerpfad Dfp_FanCD_FanCtlr2" VALUE 0xCF759 Kw_Wu8 51000. TimeDsmTsf 0.00 51000. FORMAT "%5.0" /end CHARACTERISTIC
/begin CHARACTERISTIC DSM_TsfDfp_FanCD_FanCtlr3_C "Schwerezaehlergrenze fuer Fehlerpfad Dfp_FanCD_FanCtlr3" VALUE 0xCF75A Kw_Wu8 51000. TimeDsmTsf 0.00 51000. FORMAT "%5.0" /end CHARACTERISTIC
/begin CHARACTERISTIC DSM_TsfDfp_FlFCD_C "Schwerezaehlergrenze fuer Fehlerpfad Dfp_FlFCD" VALUE 0xCF75B Kw_Wu8 51000. TimeDsmTsf 0.00 51000. FORMAT "%5.0" /end CHARACTERISTIC
/begin CHARACTERISTIC DSM_TsfDfp_FlMngSmkDefect_C "Schwerezaehlergrenze fuer Fehlerpfad Dfp_FlMngSmkDefect" VALUE 0xCF75C Kw_Wu8 51000. TimeDsmTsf 0.00 51000. FORMAT "%5.0" /end CHARACTERISTIC
/begin CHARACTERISTIC DSM_TsfDfp_FrmMngANFRADMOMPT_C "Schwerezaehlergrenze fuer Fehlerpfad Dfp_FrmMngANFRADMOMPT" VALUE 0xCF75D Kw_Wu8 51000. TimeDsmTsf 0.00 51000. FORMAT "%5.0" /end CHARACTERISTIC
/begin CHARACTERISTIC DSM_TsfDfp_FrmMngASC1_C "Schwerezaehlergrenze fuer Fehlerpfad Dfp_FrmMngASC1" VALUE 0xCF75E Kw_Wu8 51000. TimeDsmTsf 0.00 51000. FORMAT "%5.0" /end CHARACTERISTIC
/begin CHARACTERISTIC DSM_TsfDfp_FrmMngASC2_C "Schwerezaehlergrenze fuer Fehlerpfad Dfp_FrmMngASC2" VALUE 0xCF75F Kw_Wu8 51000. TimeDsmTsf 0.00 51000. FORMAT "%5.0" /end CHARACTERISTIC
/begin CHARACTERISTIC DSM_TsfDfp_FrmMngASC3_C "Schwerezaehlergrenze fuer Fehlerpfad Dfp_FrmMngASC3" VALUE 0xCF760 Kw_Wu8 51000. TimeDsmTsf 0.00 51000. FORMAT "%5.0" /end CHARACTERISTIC
/begin CHARACTERISTIC DSM_TsfDfp_FrmMngASC4_C "Schwerezaehlergrenze fuer Fehlerpfad Dfp_FrmMngASC4" VALUE 0xCF761 Kw_Wu8 51000. TimeDsmTsf 0.00 51000. FORMAT "%5.0" /end CHARACTERISTIC
/begin CHARACTERISTIC DSM_TsfDfp_FrmMngBOS_RESET_C "Schwerezaehlergrenze fuer Fehlerpfad Dfp_FrmMngBOS_RESET" VALUE 0xCF762 Kw_Wu8 51000. TimeDsmTsf 0.00 51000. FORMAT "%5.0" /end CHARACTERISTIC
/begin CHARACTERISTIC DSM_TsfDfp_FrmMngBOS_RESET2_C "Schwerezaehlergrenze fuer Fehlerpfad Dfp_FrmMngBOS_RESET2" VALUE 0xCF763 Kw_Wu8 51000. TimeDsmTsf 0.00 51000. FORMAT "%5.0" /end CHARACTERISTIC
/begin CHARACTERISTIC DSM_TsfDfp_FrmMngDMANFAFS_C "Schwerezaehlergrenze fuer Fehlerpfad Dfp_FrmMngDMANFAFS" VALUE 0xCF764 Kw_Wu8 51000. TimeDsmTsf 0.00 51000. FORMAT "%5.0" /end CHARACTERISTIC
/begin CHARACTERISTIC DSM_TsfDfp_FrmMngDRMANFSSG_C "Schwerezaehlergrenze fuer Fehlerpfad Dfp_FrmMngDRMANFSSG" VALUE 0xCF765 Kw_Wu8 51000. TimeDsmTsf 0.00 51000. FORMAT "%5.0" /end CHARACTERISTIC
/begin CHARACTERISTIC DSM_TsfDfp_FrmMngEGS1_C "Schwerezaehlergrenze fuer Fehlerpfad Dfp_FrmMngEGS1" VALUE 0xCF766 Kw_Wu8 51000. TimeDsmTsf 0.00 51000. FORMAT "%5.0" /end CHARACTERISTIC
/begin CHARACTERISTIC DSM_TsfDfp_FrmMngEGS2_C "Schwerezaehlergrenze fuer Fehlerpfad Dfp_FrmMngEGS2" VALUE 0xCF767 Kw_Wu8 51000. TimeDsmTsf 0.00 51000. FORMAT "%5.0" /end CHARACTERISTIC
/begin CHARACTERISTIC DSM_TsfDfp_FrmMngGEARBX_DATA_C "severity-counter for path" VALUE 0xCF768 Kw_Wu8 51000. TimeDsmTsf 0.00 51000. FORMAT "%5.0" /end CHARACTERISTIC
/begin CHARACTERISTIC DSM_TsfDfp_FrmMngGEARBX_DATA2_C "Schwerezaehlergrenze fuer Fehlerpfad Dfp_FrmMngGEARBX_DATA2" VALUE 0xCF769 Kw_Wu8 51000. TimeDsmTsf 0.00 51000. FORMAT "%5.0" /end CHARACTERISTIC
/begin CHARACTERISTIC DSM_TsfDfp_FrmMngHEAT_AC_C "severity-counter for path" VALUE 0xCF76A Kw_Wu8 51000. TimeDsmTsf 0.00 51000. FORMAT "%5.0" /end CHARACTERISTIC
/begin CHARACTERISTIC DSM_TsfDfp_FrmMngINSTR2_C "Schwerezaehlergrenze fuer Fehlerpfad Dfp_FrmMngINSTR2" VALUE 0xCF76B Kw_Wu8 51000. TimeDsmTsf 0.00 51000. FORMAT "%5.0" /end CHARACTERISTIC
/begin CHARACTERISTIC DSM_TsfDfp_FrmMngINSTR3_C "Schwerezaehlergrenze fuer Fehlerpfad Dfp_FrmMngINSTR3" VALUE 0xCF76C Kw_Wu8 51000. TimeDsmTsf 0.00 51000. FORMAT "%5.0" /end CHARACTERISTIC
/begin CHARACTERISTIC DSM_TsfDfp_FrmMngLENKRADWINKEL_C "Schwerezaehlergrenze fuer Fehlerpfad Dfp_FrmMngLENKRADWINKEL" VALUE 0xCF76D Kw_Wu8 51000. TimeDsmTsf 0.00 51000. FORMAT "%5.0" /end CHARACTERISTIC
/begin CHARACTERISTIC DSM_TsfDfp_FrmMngMILEAGE_RANGE_C "Schwerezaehlergrenze fuer Fehlerpfad Dfp_FrmMngMILEAGE_RANGE" VALUE 0xCF76E Kw_Wu8 51000. TimeDsmTsf 0.00 51000. FORMAT "%5.0" /end CHARACTERISTIC
/begin CHARACTERISTIC DSM_TsfDfp_FrmMngOPCRCTLACC_C "Schwerezaehlergrenze fuer Fehlerpfad Dfp_FrmMngOPCRCTLACC" VALUE 0xCF76F Kw_Wu8 51000. TimeDsmTsf 0.00 51000. FORMAT "%5.0" /end CHARACTERISTIC
/begin CHARACTERISTIC DSM_TsfDfp_FrmMngPRGG_CCTR_C "Schwerezaehlergrenze fuer Fehlerpfad Dfp_FrmMngPRGG_CCTR" VALUE 0xCF770 Kw_Wu8 51000. TimeDsmTsf 0.00 51000. FORMAT "%5.0" /end CHARACTERISTIC
/begin CHARACTERISTIC DSM_TsfDfp_FrmMngPWRMNG_LOADV_C "Schwerezaehlergrenze fuer Fehlerpfad Dfp_FrmMngPWRMNG_LOADV" VALUE 0xCF771 Kw_Wu8 51000. TimeDsmTsf 0.00 51000. FORMAT "%5.0" /end CHARACTERISTIC
/begin CHARACTERISTIC DSM_TsfDfp_FrmMngParkConsumer_C "Schwerezaehlgrenze fuer Fehlerpfad Dfp_FrmMngParkConsumer" VALUE 0xCF772 Kw_Wu8 51000. TimeDsmTsf 0.00 51000. FORMAT "%5.0" /end CHARACTERISTIC
/begin CHARACTERISTIC DSM_TsfDfp_FrmMngRQSTGEFAN_C "Schwerezaehlergrenze fuer Fehlerpfad Dfp_FrmMngRQSTGEFAN_C" VALUE 0xCF773 Kw_Wu8 51000. TimeDsmTsf 0.00 51000. FORMAT "%5.0" /end CHARACTERISTIC
/begin CHARACTERISTIC DSM_TsfDfp_FrmMngSSGErr_C "Schwerezaehlergrenze fuer Fehlerpfad Dfp_FrmMngSSGErr" VALUE 0xCF774 Kw_Wu8 51000. TimeDsmTsf 0.00 51000. FORMAT "%5.0" /end CHARACTERISTIC
/begin CHARACTERISTIC DSM_TsfDfp_FrmMngSSGShOff_C "Schwerezaehlergrenze fuer Fehlerpfad Dfp_FrmMngSSGShOff" VALUE 0xCF775 Kw_Wu8 51000. TimeDsmTsf 0.00 51000. FORMAT "%5.0" /end CHARACTERISTIC
/begin CHARACTERISTIC DSM_TsfDfp_FrmMngSTAT_ANH_C "Schwerezaehlergrenze fuer Fehlerpfad Dfp_FrmMngSTAT_ANH" VALUE 0xCF776 Kw_Wu8 51000. TimeDsmTsf 0.00 51000. FORMAT "%5.0" /end CHARACTERISTIC
/begin CHARACTERISTIC DSM_TsfDfp_FrmMngSTAT_ARS_C "severity-counter for path" VALUE 0xCF777 Kw_Wu8 51000. TimeDsmTsf 0.00 51000. FORMAT "%5.0" /end CHARACTERISTIC
/begin CHARACTERISTIC DSM_TsfDfp_FrmMngSTAT_DSC_C "severity-counter for path" VALUE 0xCF778 Kw_Wu8 51000. TimeDsmTsf 0.00 51000. FORMAT "%5.0" /end CHARACTERISTIC
/begin CHARACTERISTIC DSM_TsfDfp_FrmMngSTAT_EKP_C "Schwerezaehlergrenze fuer Fehlerpfad Dfp_FrmMngSTAT_EKP" VALUE 0xCF779 Kw_Wu8 51000. TimeDsmTsf 0.00 51000. FORMAT "%5.0" /end CHARACTERISTIC
/begin CHARACTERISTIC DSM_TsfDfp_FrmMngSTAT_KOMBI_C "Schwerezaehlergrenze fuer Fehlerpfad Dfp_FrmMngSTAT_KOMBI" VALUE 0xCF77A Kw_Wu8 51000. TimeDsmTsf 0.00 51000. FORMAT "%5.0" /end CHARACTERISTIC
/begin CHARACTERISTIC DSM_TsfDfp_FrmMngSTAT_SITZ_C "Schwerezaehlergrenze fuer Fehlerpfad Dfp_FrmMngSTAT_SITZ" VALUE 0xCF77B Kw_Wu8 51000. TimeDsmTsf 0.00 51000. FORMAT "%5.0" /end CHARACTERISTIC
/begin CHARACTERISTIC DSM_TsfDfp_FrmMngStOBDGbxMilOf_C "Schwerezaehlergrenze fuer Fehlerpfad Dfp_FrmMngStOBDGbxMilOf" VALUE 0xCF77C Kw_Wu8 51000. TimeDsmTsf 0.00 51000. FORMAT "%5.0" /end CHARACTERISTIC
/begin CHARACTERISTIC DSM_TsfDfp_FrmMngStOBDGbxMilOn_C "Schwerezaehlergrenze fuer Fehlerpfad Dfp_FrmMngStOBDGbxMilOn" VALUE 0xCF77D Kw_Wu8 51000. TimeDsmTsf 0.00 51000. FORMAT "%5.0" /end CHARACTERISTIC
/begin CHARACTERISTIC DSM_TsfDfp_FrmMngTEMPRELTIME_C "Schwerezaehlergrenze fuer Fehlerpfad Dfp_FrmMngTEMPRELTIME" VALUE 0xCF77E Kw_Wu8 51000. TimeDsmTsf 0.00 51000. FORMAT "%5.0" /end CHARACTERISTIC
/begin CHARACTERISTIC DSM_TsfDfp_FrmMngTERMINAL_C "severity-counter for path" VALUE 0xCF77F Kw_Wu8 51000. TimeDsmTsf 0.00 51000. FORMAT "%5.0" /end CHARACTERISTIC
/begin CHARACTERISTIC DSM_TsfDfp_FrmMngTIME_DATE_C "Schwerezaehlergrenze fuer Fehlerpfad Dfp_FrmMngTIME_DATE" VALUE 0xCF780 Kw_Wu8 51000. TimeDsmTsf 0.00 51000. FORMAT "%5.0" /end CHARACTERISTIC
/begin CHARACTERISTIC DSM_TsfDfp_FrmMngTORQUE_DSC_C "severity-counter for path" VALUE 0xCF781 Kw_Wu8 51000. TimeDsmTsf 0.00 51000. FORMAT "%5.0" /end CHARACTERISTIC
/begin CHARACTERISTIC DSM_TsfDfp_FrmMngTORQUE_GEARBX_C "severity-counter for path" VALUE 0xCF782 Kw_Wu8 51000. TimeDsmTsf 0.00 51000. FORMAT "%5.0" /end CHARACTERISTIC
/begin CHARACTERISTIC DSM_TsfDfp_FrmMngTrq_ReqACC_C "Schwerezaehlergrenze fuer Fehlerpfad Dfp_FrmMngTrq_ReqACC" VALUE 0xCF783 Kw_Wu8 51000. TimeDsmTsf 0.00 51000. FORMAT "%5.0" /end CHARACTERISTIC
/begin CHARACTERISTIC DSM_TsfDfp_FrmMngVEH_MOD_C "Schwerezaehlergrenze fuer Fehlerpfad Dfp_FrmMngVEH_MOD_C" VALUE 0xCF784 Kw_Wu8 51000. TimeDsmTsf 0.00 51000. FORMAT "%5.0" /end CHARACTERISTIC
/begin CHARACTERISTIC DSM_TsfDfp_FrmMngVELOCITY_C "severity-counter for path" VALUE 0xCF785 Kw_Wu8 51000. TimeDsmTsf 0.00 51000. FORMAT "%5.0" /end CHARACTERISTIC
/begin CHARACTERISTIC DSM_TsfDfp_FrmMngWHEEL_SPEED_C "Schwerezaehlergrenze fuer Fehlerpfad Dfp_FrmMngWHEEL_SPEED" VALUE 0xCF786 Kw_Wu8 51000. TimeDsmTsf 0.00 51000. FORMAT "%5.0" /end CHARACTERISTIC
/begin CHARACTERISTIC DSM_TsfDfp_FrmMngstCurr_C "Schwerezählergrenze für Dfp_FrmMngstCurr" VALUE 0xCF787 Kw_Wu8 51000. TimeDsmTsf 0.00 51000. FORMAT "%5.0" /end CHARACTERISTIC
/begin CHARACTERISTIC DSM_TsfDfp_FrmMngswtPSPOff_C "Schwerezählergrenze für Dfp_FrmMngswtPSPOff" VALUE 0xCF788 Kw_Wu8 51000. TimeDsmTsf 0.00 51000. FORMAT "%5.0" /end CHARACTERISTIC
/begin CHARACTERISTIC DSM_TsfDfp_GearbxIncMax_C "Schwerezaehlergrenze fuer Fehlerpfad Dfp_GearbxIncMax" VALUE 0xCF789 Kw_Wu8 51000. TimeDsmTsf 0.00 51000. FORMAT "%5.0" /end CHARACTERISTIC
/begin CHARACTERISTIC DSM_TsfDfp_GlwCD_C "Schwerezaehlergrenze fuer Fehlerpfad Dfp_GlwCD" VALUE 0xCF78A Kw_Wu8 51000. TimeDsmTsf 0.00 51000. FORMAT "%5.0" /end CHARACTERISTIC
/begin CHARACTERISTIC DSM_TsfDfp_GlwCDGlwCirc1_C "Schwerezaehlergrenze fuer Fehlerpfad Dfp_GlwCDGlwCirc1" VALUE 0xCF78B Kw_Wu8 51000. TimeDsmTsf 0.00 51000. FORMAT "%5.0" /end CHARACTERISTIC
/begin CHARACTERISTIC DSM_TsfDfp_GlwCDGlwCirc2_C "Schwerezaehlergrenze fuer Fehlerpfad Dfp_GlwCDGlwCirc2" VALUE 0xCF78C Kw_Wu8 51000. TimeDsmTsf 0.00 51000. FORMAT "%5.0" /end CHARACTERISTIC
/begin CHARACTERISTIC DSM_TsfDfp_GlwCDGlwCirc3_C "Schwerezaehlergrenze fuer Fehlerpfad Dfp_GlwCDGlwCirc3" VALUE 0xCF78D Kw_Wu8 51000. TimeDsmTsf 0.00 51000. FORMAT "%5.0" /end CHARACTERISTIC
/begin CHARACTERISTIC DSM_TsfDfp_GlwCDGlwCirc4_C "Schwerezaehlergrenze fuer Fehlerpfad Dfp_GlwCDGlwCirc4" VALUE 0xCF78E Kw_Wu8 51000. TimeDsmTsf 0.00 51000. FORMAT "%5.0" /end CHARACTERISTIC
/begin CHARACTERISTIC DSM_TsfDfp_GlwCDGlwCirc5_C "Schwerezaehlergrenze fuer Fehlerpfad Dfp_GlwCDGlwCirc5" VALUE 0xCF78F Kw_Wu8 51000. TimeDsmTsf 0.00 51000. FORMAT "%5.0" /end CHARACTERISTIC
/begin CHARACTERISTIC DSM_TsfDfp_GlwCDGlwCirc6_C "Schwerezaehlergrenze fuer Fehlerpfad Dfp_GlwCDGlwCirc6" VALUE 0xCF790 Kw_Wu8 51000. TimeDsmTsf 0.00 51000. FORMAT "%5.0" /end CHARACTERISTIC
/begin CHARACTERISTIC DSM_TsfDfp_GlwCDGlwCirc7_C "Schwerezaehlergrenze fuer Fehlerpfad Dfp_GlwCDGlwCirc7" VALUE 0xCF791 Kw_Wu8 51000. TimeDsmTsf 0.00 51000. FORMAT "%5.0" /end CHARACTERISTIC
/begin CHARACTERISTIC DSM_TsfDfp_GlwCDGlwCirc8_C "Schwerezaehlergrenze fuer Fehlerpfad Dfp_GlwCDGlwCirc8" VALUE 0xCF792 Kw_Wu8 51000. TimeDsmTsf 0.00 51000. FORMAT "%5.0" /end CHARACTERISTIC
/begin CHARACTERISTIC DSM_TsfDfp_GlwCtl_C "Schwerezaehlergrenze fuer Fehlerpfad Dfp_GlwCtl" VALUE 0xCF793 Kw_Wu8 51000. TimeDsmTsf 0.00 51000. FORMAT "%5.0" /end CHARACTERISTIC
/begin CHARACTERISTIC DSM_TsfDfp_HWEMonCom_C "Schwerezaehlergrenze fuer Fehlerpfad Dfp_HWEMonCom" VALUE 0xCF794 Kw_Wu8 51000. TimeDsmTsf 0.00 51000. FORMAT "%5.0" /end CHARACTERISTIC
/begin CHARACTERISTIC DSM_TsfDfp_HWEMonEEPROM_C "Schwerezaehlergrenze fuer Fehlerpfad Dfp_HWEMonEEPROM" VALUE 0xCF795 Kw_Wu8 51000. TimeDsmTsf 0.00 51000. FORMAT "%5.0" /end CHARACTERISTIC
/begin CHARACTERISTIC DSM_TsfDfp_HWEMonRcyLocked_C "Schwerezaehlergrenze fuer Fehlerpfad Dfp_HWEMonRcyLocked" VALUE 0xCF796 Kw_Wu8 51000. TimeDsmTsf 0.00 51000. FORMAT "%5.0" /end CHARACTERISTIC
/begin CHARACTERISTIC DSM_TsfDfp_HWEMonRcySuppressed_C "Schwerezaehlergrenze fuer Fehlerpfad Dfp_HWEMonRcySuppressed" VALUE 0xCF797 Kw_Wu8 51000. TimeDsmTsf 0.00 51000. FORMAT "%5.0" /end CHARACTERISTIC
/begin CHARACTERISTIC DSM_TsfDfp_HWEMonRcyVisible_C "Schwerezaehlergrenze fuer Fehlerpfad Dfp_HWEMonRcyVisible" VALUE 0xCF798 Kw_Wu8 51000. TimeDsmTsf 0.00 51000. FORMAT "%5.0" /end CHARACTERISTIC
/begin CHARACTERISTIC DSM_TsfDfp_HWEMonUMaxSupply_C "Schwerezaehlergrenze fuer Fehlerpfad Dfp_HWEMonUMaxSupply" VALUE 0xCF799 Kw_Wu8 51000. TimeDsmTsf 0.00 51000. FORMAT "%5.0" /end CHARACTERISTIC
/begin CHARACTERISTIC DSM_TsfDfp_HWEMonUMinSupply_C "Schwerezaehlergrenze fuer Fehlerpfad Dfp_HWEMonUMinSupply" VALUE 0xCF79A Kw_Wu8 51000. TimeDsmTsf 0.00 51000. FORMAT "%5.0" /end CHARACTERISTIC
/begin CHARACTERISTIC DSM_TsfDfp_IATSCD_C "Schwerezaehlergrenze fuer Fehlerpfad Dfp_IATSCD" VALUE 0xCF79B Kw_Wu8 51000. TimeDsmTsf 0.00 51000. FORMAT "%5.0" /end CHARACTERISTIC
/begin CHARACTERISTIC DSM_TsfDfp_IATSCD_CATS_C "Schwerezaehlergrenze fuer Fehlerpfad Dfp_IATSCD_CATS" VALUE 0xCF79C Kw_Wu8 51000. TimeDsmTsf 0.00 51000. FORMAT "%5.0" /end CHARACTERISTIC
/begin CHARACTERISTIC DSM_TsfDfp_ImmCtlImmCD_C "Schwerezaehlergrenze fuer Fehlerpfad Dfp_ImmCtlImmCD" VALUE 0xCF79D Kw_Wu8 51000. TimeDsmTsf 0.00 51000. FORMAT "%5.0" /end CHARACTERISTIC
/begin CHARACTERISTIC DSM_TsfDfp_ImmCtlImmEep_C "Schwerezaehlergrenze fuer Fehlerpfad Dfp_ImmCtlImmEep" VALUE 0xCF79E Kw_Wu8 51000. TimeDsmTsf 0.00 51000. FORMAT "%5.0" /end CHARACTERISTIC
/begin CHARACTERISTIC DSM_TsfDfp_ImmCtlMpl_C "Schwerezaehlergrenze fuer Fehlerpfad Dfp_ImmCtlMpl" VALUE 0xCF79F Kw_Wu8 51000. TimeDsmTsf 0.00 51000. FORMAT "%5.0" /end CHARACTERISTIC
/begin CHARACTERISTIC DSM_TsfDfp_IndSys1_C "Schwerezaehlergrenze fuer Fehlerpfad Dfp_IndSys1" VALUE 0xCF7A0 Kw_Wu8 51000. TimeDsmTsf 0.00 51000. FORMAT "%5.0" /end CHARACTERISTIC
/begin CHARACTERISTIC DSM_TsfDfp_IndSys2_C "Schwerezaehlergrenze fuer Fehlerpfad Dfp_IndSys2" VALUE 0xCF7A1 Kw_Wu8 51000. TimeDsmTsf 0.00 51000. FORMAT "%5.0" /end CHARACTERISTIC
/begin CHARACTERISTIC DSM_TsfDfp_InjCrv_InjLim_C "Schwerezaehlergrenze fuer Fehlerpfad Dfp_InjCrv_InjLim" VALUE 0xCF7A2 Kw_Wu8 51000. TimeDsmTsf 0.00 51000. FORMAT "%5.0" /end CHARACTERISTIC
/begin CHARACTERISTIC DSM_TsfDfp_InjCtlAdjQnt_C "Schwerezaehlergrenze fuer Fehlerpfad Dfp_InjCtlAdjQnt" VALUE 0xCF7A3 Kw_Wu8 51000. TimeDsmTsf 0.00 51000. FORMAT "%5.0" /end CHARACTERISTIC
/begin CHARACTERISTIC DSM_TsfDfp_InjCtlDrift_C "Schwerezaehlergrenze fuer Fehlerpfad Dfp_InjCtlDrift" VALUE 0xCF7A4 Kw_Wu8 51000. TimeDsmTsf 0.00 51000. FORMAT "%5.0" /end CHARACTERISTIC
/begin CHARACTERISTIC DSM_TsfDfp_InjVlvBnk1A_C "Schwerezaehlergrenze fuer Fehlerpfad Dfp_InjVlvBnk1A" VALUE 0xCF7A5 Kw_Wu8 51000. TimeDsmTsf 0.00 51000. FORMAT "%5.0" /end CHARACTERISTIC
/begin CHARACTERISTIC DSM_TsfDfp_InjVlvBnk1B_C "Schwerezaehlergrenze fuer Fehlerpfad Dfp_InjVlvBnk1B" VALUE 0xCF7A6 Kw_Wu8 51000. TimeDsmTsf 0.00 51000. FORMAT "%5.0" /end CHARACTERISTIC
/begin CHARACTERISTIC DSM_TsfDfp_InjVlvBnk2A_C "Schwerezaehlergrenze fuer Fehlerpfad Dfp_InjVlvBnk2A" VALUE 0xCF7A7 Kw_Wu8 51000. TimeDsmTsf 0.00 51000. FORMAT "%5.0" /end CHARACTERISTIC
/begin CHARACTERISTIC DSM_TsfDfp_InjVlvBnk2B_C "Schwerezaehlergrenze fuer Fehlerpfad Dfp_InjVlvBnk2B" VALUE 0xCF7A8 Kw_Wu8 51000. TimeDsmTsf 0.00 51000. FORMAT "%5.0" /end CHARACTERISTIC
/begin CHARACTERISTIC DSM_TsfDfp_InjVlvChipA_C "Schwerezaehlergrenze fuer Fehlerpfad Dfp_InjVlvChipA" VALUE 0xCF7A9 Kw_Wu8 51000. TimeDsmTsf 0.00 51000. FORMAT "%5.0" /end CHARACTERISTIC
/begin CHARACTERISTIC DSM_TsfDfp_InjVlvChipB_C "Schwerezaehlergrenze fuer Fehlerpfad Dfp_InjVlvChipB" VALUE 0xCF7AA Kw_Wu8 51000. TimeDsmTsf 0.00 51000. FORMAT "%5.0" /end CHARACTERISTIC
/begin CHARACTERISTIC DSM_TsfDfp_InjVlvCyl1A_C "Schwerezaehlergrenze fuer Fehlerpfad Dfp_InjVlvCyl1A" VALUE 0xCF7AB Kw_Wu8 51000. TimeDsmTsf 0.00 51000. FORMAT "%5.0" /end CHARACTERISTIC
/begin CHARACTERISTIC DSM_TsfDfp_InjVlvCyl1B_C "Schwerezaehlergrenze fuer Fehlerpfad Dfp_InjVlvCyl1B" VALUE 0xCF7AC Kw_Wu8 51000. TimeDsmTsf 0.00 51000. FORMAT "%5.0" /end CHARACTERISTIC
/begin CHARACTERISTIC DSM_TsfDfp_InjVlvCyl2A_C "Schwerezaehlergrenze fuer Fehlerpfad Dfp_InjVlvCyl2A" VALUE 0xCF7AD Kw_Wu8 51000. TimeDsmTsf 0.00 51000. FORMAT "%5.0" /end CHARACTERISTIC
/begin CHARACTERISTIC DSM_TsfDfp_InjVlvCyl2B_C "Schwerezaehlergrenze fuer Fehlerpfad Dfp_InjVlvCyl2B" VALUE 0xCF7AE Kw_Wu8 51000. TimeDsmTsf 0.00 51000. FORMAT "%5.0" /end CHARACTERISTIC
/begin CHARACTERISTIC DSM_TsfDfp_InjVlvCyl3A_C "Schwerezaehlergrenze fuer Fehlerpfad Dfp_InjVlvCyl3A" VALUE 0xCF7AF Kw_Wu8 51000. TimeDsmTsf 0.00 51000. FORMAT "%5.0" /end CHARACTERISTIC
/begin CHARACTERISTIC DSM_TsfDfp_InjVlvCyl3B_C "Schwerezaehlergrenze fuer Fehlerpfad Dfp_InjVlvCyl3B" VALUE 0xCF7B0 Kw_Wu8 51000. TimeDsmTsf 0.00 51000. FORMAT "%5.0" /end CHARACTERISTIC
/begin CHARACTERISTIC DSM_TsfDfp_InjVlvCyl4A_C "Schwerezaehlergrenze fuer Fehlerpfad Dfp_InjVlvCyl4A" VALUE 0xCF7B1 Kw_Wu8 51000. TimeDsmTsf 0.00 51000. FORMAT "%5.0" /end CHARACTERISTIC
/begin CHARACTERISTIC DSM_TsfDfp_InjVlvCyl4B_C "Schwerezaehlergrenze fuer Fehlerpfad Dfp_InjVlvCyl4B" VALUE 0xCF7B2 Kw_Wu8 51000. TimeDsmTsf 0.00 51000. FORMAT "%5.0" /end CHARACTERISTIC
/begin CHARACTERISTIC DSM_TsfDfp_InjVlvCyl5A_C "Schwerezaehlergrenze fuer Fehlerpfad Dfp_InjVlvCyl5A" VALUE 0xCF7B3 Kw_Wu8 51000. TimeDsmTsf 0.00 51000. FORMAT "%5.0" /end CHARACTERISTIC
/begin CHARACTERISTIC DSM_TsfDfp_InjVlvCyl5B_C "Schwerezaehlergrenze fuer Fehlerpfad Dfp_InjVlvCyl5B" VALUE 0xCF7B4 Kw_Wu8 51000. TimeDsmTsf 0.00 51000. FORMAT "%5.0" /end CHARACTERISTIC
/begin CHARACTERISTIC DSM_TsfDfp_InjVlvCyl6A_C "Schwerezaehlergrenze fuer Fehlerpfad Dfp_InjVlvCyl6A" VALUE 0xCF7B5 Kw_Wu8 51000. TimeDsmTsf 0.00 51000. FORMAT "%5.0" /end CHARACTERISTIC
/begin CHARACTERISTIC DSM_TsfDfp_InjVlvCyl6B_C "Schwerezaehlergrenze fuer Fehlerpfad Dfp_InjVlvCyl6B" VALUE 0xCF7B6 Kw_Wu8 51000. TimeDsmTsf 0.00 51000. FORMAT "%5.0" /end CHARACTERISTIC
/begin CHARACTERISTIC DSM_TsfDfp_KeyCheck_C "Schwerezaehlergrenze fuer Fehlerpfad Dfp_KeyCheck" VALUE 0xCF7B7 Kw_Wu8 51000. TimeDsmTsf 0.00 51000. FORMAT "%5.0" /end CHARACTERISTIC
/begin CHARACTERISTIC DSM_TsfDfp_LIGovECUTransMode_C "Schwerezaehlergrenze fuer Fehlerpfad Dfp_LIGovECUTransMode" VALUE 0xCF7B8 Kw_Wu8 51000. TimeDsmTsf 0.00 51000. FORMAT "%5.0" /end CHARACTERISTIC
/begin CHARACTERISTIC DSM_TsfDfp_LPACD_Max_C "Schwerezaehlergrenze fuer Fehlerpfad Dfp_LPACD_Max" VALUE 0xCF7B9 Kw_Wu8 51000. TimeDsmTsf 0.00 51000. FORMAT "%5.0" /end CHARACTERISTIC
/begin CHARACTERISTIC DSM_TsfDfp_LPACD_Min_C "Schwerezaehlergrenze fuer Fehlerpfad Dfp_LPACD_Min" VALUE 0xCF7BA Kw_Wu8 51000. TimeDsmTsf 0.00 51000. FORMAT "%5.0" /end CHARACTERISTIC
/begin CHARACTERISTIC DSM_TsfDfp_LPACD_SigNpl_C "Schwerezaehlergrenze fuer Fehlerpfad Dfp_LPACD_SigNpl" VALUE 0xCF7BB Kw_Wu8 51000. TimeDsmTsf 0.00 51000. FORMAT "%5.0" /end CHARACTERISTIC
/begin CHARACTERISTIC DSM_TsfDfp_LSUCDCircNernst0_C "Schwerezaehlergrenze fuer Fehlerpfad Dfp_LSUCDCircNernst0" VALUE 0xCF7BC Kw_Wu8 51000. TimeDsmTsf 0.00 51000. FORMAT "%5.0" /end CHARACTERISTIC
/begin CHARACTERISTIC DSM_TsfDfp_LSUCDCircPumpCur0_C "Schwerezaehlergrenze fuer Fehlerpfad Dfp_LSUCDCircPumpCur0" VALUE 0xCF7BD Kw_Wu8 51000. TimeDsmTsf 0.00 51000. FORMAT "%5.0" /end CHARACTERISTIC
/begin CHARACTERISTIC DSM_TsfDfp_LSUCDCircVirtGnd0_C "Schwerezaehlergrenze fuer Fehlerpfad Dfp_LSUCDCircVirtGnd0" VALUE 0xCF7BE Kw_Wu8 51000. TimeDsmTsf 0.00 51000. FORMAT "%5.0" /end CHARACTERISTIC
/begin CHARACTERISTIC DSM_TsfDfp_LSUCDHeater0_C "Schwerezaehlergrenze fuer Fehlerpfad Dfp_LSUCDHeater0" VALUE 0xCF7BF Kw_Wu8 51000. TimeDsmTsf 0.00 51000. FORMAT "%5.0" /end CHARACTERISTIC
/begin CHARACTERISTIC DSM_TsfDfp_LSUCDHtCoup0_C "Schwerezaehlergrenze fuer Fehlerpfad Dfp_LSUCDHtCoup0" VALUE 0xCF7C0 Kw_Wu8 51000. TimeDsmTsf 0.00 51000. FORMAT "%5.0" /end CHARACTERISTIC
/begin CHARACTERISTIC DSM_TsfDfp_LSUCDO20_C "Schwerezaehlergrenze fuer Fehlerpfad Dfp_LSUCDO20" VALUE 0xCF7C1 Kw_Wu8 51000. TimeDsmTsf 0.00 51000. FORMAT "%5.0" /end CHARACTERISTIC
/begin CHARACTERISTIC DSM_TsfDfp_LSUCDO2Clb0_C "Schwerezaehlergrenze fuer Fehlerpfad Dfp_LSUCDO2Clb0" VALUE 0xCF7C2 Kw_Wu8 51000. TimeDsmTsf 0.00 51000. FORMAT "%5.0" /end CHARACTERISTIC
/begin CHARACTERISTIC DSM_TsfDfp_LSUCDRiClb0_C "Schwerezaehlergrenze fuer Fehlerpfad Dfp_LSUCDRiClb0" VALUE 0xCF7C3 Kw_Wu8 51000. TimeDsmTsf 0.00 51000. FORMAT "%5.0" /end CHARACTERISTIC
/begin CHARACTERISTIC DSM_TsfDfp_LSUCDSPI0_C "Schwerezaehlergrenze fuer Fehlerpfad Dfp_LSUCDSPI0" VALUE 0xCF7C4 Kw_Wu8 51000. TimeDsmTsf 0.00 51000. FORMAT "%5.0" /end CHARACTERISTIC
/begin CHARACTERISTIC DSM_TsfDfp_LSUCDSPIBattLow0_C "Schwerezaehlergrenze fuer Fehlerpfad Dfp_LSUCDSPIBattLow0" VALUE 0xCF7C5 Kw_Wu8 51000. TimeDsmTsf 0.00 51000. FORMAT "%5.0" /end CHARACTERISTIC
/begin CHARACTERISTIC DSM_TsfDfp_LSUCDWireIP0_C "Schwerezaehlergrenze fuer Fehlerpfad Dfp_LSUCDWireIP0" VALUE 0xCF7C6 Kw_Wu8 51000. TimeDsmTsf 0.00 51000. FORMAT "%5.0" /end CHARACTERISTIC
/begin CHARACTERISTIC DSM_TsfDfp_LSUCtlRiExc0_C "Schwerezaehlergrenze fuer Fehlerpfad Dfp_LSUCtlRiExc0" VALUE 0xCF7C7 Kw_Wu8 51000. TimeDsmTsf 0.00 51000. FORMAT "%5.0" /end CHARACTERISTIC
/begin CHARACTERISTIC DSM_TsfDfp_LSUMon1Sens_C "Schwerezaehlergrenze fuer Fehlerpfad Dfp_LSUMon1Sens" VALUE 0xCF7C8 Kw_Wu8 51000. TimeDsmTsf 0.00 51000. FORMAT "%5.0" /end CHARACTERISTIC
/begin CHARACTERISTIC DSM_TsfDfp_LSUMon2Sens_C "Schwerezaehlergrenze fuer Fehlerpfad Dfp_LSUMon2Sens" VALUE 0xCF7C9 Kw_Wu8 51000. TimeDsmTsf 0.00 51000. FORMAT "%5.0" /end CHARACTERISTIC
/begin CHARACTERISTIC DSM_TsfDfp_MIL_C "Schwerezaehlergrenze fuer Fehlerpfad Dfp_MIL" VALUE 0xCF7CA Kw_Wu8 51000. TimeDsmTsf 0.00 51000. FORMAT "%5.0" /end CHARACTERISTIC
/begin CHARACTERISTIC DSM_TsfDfp_MRlyCD_C "Schwerezaehlergrenze fuer Fehlerpfad Dfp_MRlyCD" VALUE 0xCF7CB Kw_Wu8 51000. TimeDsmTsf 0.00 51000. FORMAT "%5.0" /end CHARACTERISTIC
/begin CHARACTERISTIC DSM_TsfDfp_MSidCD_Comm_C "Schwerezaehlergrenze fuer Fehlerpfad Dfp_MSidCD_Comm" VALUE 0xCF7CC Kw_Wu8 51000. TimeDsmTsf 0.00 51000. FORMAT "%5.0" /end CHARACTERISTIC
/begin CHARACTERISTIC DSM_TsfDfp_MSidCD_Pin_C "Schwerezaehlergrenze fuer Fehlerpfad Dfp_MSidCD_Pin" VALUE 0xCF7CD Kw_Wu8 51000. TimeDsmTsf 0.00 51000. FORMAT "%5.0" /end CHARACTERISTIC
/begin CHARACTERISTIC DSM_TsfDfp_MSidCD_Sel_INI_C "Schwerezaehlergrenze fuer Fehlerpfad Dfp_MSidCD_Sel_INI" VALUE 0xCF7CE Kw_Wu8 51000. TimeDsmTsf 0.00 51000. FORMAT "%5.0" /end CHARACTERISTIC
/begin CHARACTERISTIC DSM_TsfDfp_MSidCD_Select_C "Schwerezaehlergrenze fuer Fehlerpfad Dfp_MSidCD_Select" VALUE 0xCF7CF Kw_Wu8 51000. TimeDsmTsf 0.00 51000. FORMAT "%5.0" /end CHARACTERISTIC
/begin CHARACTERISTIC DSM_TsfDfp_MeUnCDNoLoad_C "Schwerezaehlergrenze fuer Fehlerpfad Dfp_MeUnCDNoLoad" VALUE 0xCF7D0 Kw_Wu8 51000. TimeDsmTsf 0.00 51000. FORMAT "%5.0" /end CHARACTERISTIC
/begin CHARACTERISTIC DSM_TsfDfp_MeUnCDSCBat_C "Schwerezaehlergrenze fuer Fehlerpfad Dfp_MeUnCDSCBat" VALUE 0xCF7D1 Kw_Wu8 51000. TimeDsmTsf 0.00 51000. FORMAT "%5.0" /end CHARACTERISTIC
/begin CHARACTERISTIC DSM_TsfDfp_MeUnCDSCGnd_C "Schwerezaehlergrenze fuer Fehlerpfad Dfp_MeUnCDSCGnd" VALUE 0xCF7D2 Kw_Wu8 51000. TimeDsmTsf 0.00 51000. FORMAT "%5.0" /end CHARACTERISTIC
/begin CHARACTERISTIC DSM_TsfDfp_MeUnCD_ADC_C "Schwerezaehlergrenze fuer Fehlerpfad Dfp_MeUnCD_ADC" VALUE 0xCF7D3 Kw_Wu8 51000. TimeDsmTsf 0.00 51000. FORMAT "%5.0" /end CHARACTERISTIC
/begin CHARACTERISTIC DSM_TsfDfp_MeUnCD_SigTst_C "Schwerezaehlergrenze fuer Fehlerpfad Dfp_MeUnCD_SigTst" VALUE 0xCF7D4 Kw_Wu8 51000. TimeDsmTsf 0.00 51000. FORMAT "%5.0" /end CHARACTERISTIC
/begin CHARACTERISTIC DSM_TsfDfp_Montr_C "Schwerezaehlergrenze fuer Fehlerpfad Dfp_Montr" VALUE 0xCF7D5 Kw_Wu8 51000. TimeDsmTsf 0.00 51000. FORMAT "%5.0" /end CHARACTERISTIC
/begin CHARACTERISTIC DSM_TsfDfp_NetMngDeviceA_C "Schwerezaehlergrenze fuer Fehlerpfad Dfp_NetMngDeviceA" VALUE 0xCF7D6 Kw_Wu8 51000. TimeDsmTsf 0.00 51000. FORMAT "%5.0" /end CHARACTERISTIC
/begin CHARACTERISTIC DSM_TsfDfp_NetMngDeviceB_C "Schwerezaehlergrenze fuer Fehlerpfad Dfp_NetMngDeviceB" VALUE 0xCF7D7 Kw_Wu8 51000. TimeDsmTsf 0.00 51000. FORMAT "%5.0" /end CHARACTERISTIC
/begin CHARACTERISTIC DSM_TsfDfp_NetMngDeviceC_C "Schwerezaehlergrenze fuer Fehlerpfad Dfp_NetMngDeviceC" VALUE 0xCF7D8 Kw_Wu8 51000. TimeDsmTsf 0.00 51000. FORMAT "%5.0" /end CHARACTERISTIC
/begin CHARACTERISTIC DSM_TsfDfp_NetMngPtCan_C "Schwerezaehlergrenze fuer Fehlerpfad Dfp_NetMngPtCan" VALUE 0xCF7D9 Kw_Wu8 51000. TimeDsmTsf 0.00 51000. FORMAT "%5.0" /end CHARACTERISTIC
/begin CHARACTERISTIC DSM_TsfDfp_OPSCD_Lamp_C "Schwerezaehlergrenze fuer Fehlerpfad Dfp_OPSCD_Lamp" VALUE 0xCF7DA Kw_Wu8 51000. TimeDsmTsf 0.00 51000. FORMAT "%5.0" /end CHARACTERISTIC
/begin CHARACTERISTIC DSM_TsfDfp_OPSCD_anain_C "Schwerezaehlergrenze fuer Fehlerpfad Dfp_OPSCD_anain" VALUE 0xCF7DB Kw_Wu8 51000. TimeDsmTsf 0.00 51000. FORMAT "%5.0" /end CHARACTERISTIC
/begin CHARACTERISTIC DSM_TsfDfp_OTSCD_C "Schwerezaehlergrenze fuer Fehlerpfad Dfp_OTSCD" VALUE 0xCF7DC Kw_Wu8 51000. TimeDsmTsf 0.00 51000. FORMAT "%5.0" /end CHARACTERISTIC
/begin CHARACTERISTIC DSM_TsfDfp_OvRMon_C "Schwerezaehlergrenze fuer Fehlerpfad Dfp_OvRMon" VALUE 0xCF7DD Kw_Wu8 51000. TimeDsmTsf 0.00 51000. FORMAT "%5.0" /end CHARACTERISTIC
/begin CHARACTERISTIC DSM_TsfDfp_OvRMonSigA_C "Schwerezaehlergrenze fuer Fehlerpfad Dfp_OvRMonSigA" VALUE 0xCF7DE Kw_Wu8 51000. TimeDsmTsf 0.00 51000. FORMAT "%5.0" /end CHARACTERISTIC
/begin CHARACTERISTIC DSM_TsfDfp_OxiCCDTPre_C "Schwerezaehlergrenze fuer Fehlerpfad Dfp_OxiCCDTPre" VALUE 0xCF7DF Kw_Wu8 51000. TimeDsmTsf 0.00 51000. FORMAT "%5.0" /end CHARACTERISTIC
/begin CHARACTERISTIC DSM_TsfDfp_PCBS_C "Schwerezaehlergrenze fuer Fehlerpfad Dfp_PCBS" VALUE 0xCF7E0 Kw_Wu8 51000. TimeDsmTsf 0.00 51000. FORMAT "%5.0" /end CHARACTERISTIC
/begin CHARACTERISTIC DSM_TsfDfp_PCR_GovDevNeg_C "Schwerezaehlergrenze fuer Fehlerpfad Dfp_PCR_GovDevNeg" VALUE 0xCF7E1 Kw_Wu8 51000. TimeDsmTsf 0.00 51000. FORMAT "%5.0" /end CHARACTERISTIC
/begin CHARACTERISTIC DSM_TsfDfp_PCR_GovDevPos_C "Schwerezaehlergrenze fuer Fehlerpfad Dfp_PCR_GovDevPos" VALUE 0xCF7E2 Kw_Wu8 51000. TimeDsmTsf 0.00 51000. FORMAT "%5.0" /end CHARACTERISTIC
/begin CHARACTERISTIC DSM_TsfDfp_PCR_LPGvnrDvtNeg_C "Schwerezaehlergrenze fuer Fehlerpfad Dfp_PCR_LPGvnrDvtNeg" VALUE 0xCF7E3 Kw_Wu8 51000. TimeDsmTsf 0.00 51000. FORMAT "%5.0" /end CHARACTERISTIC
/begin CHARACTERISTIC DSM_TsfDfp_PCR_LPGvnrDvtPos_C "Schwerezaehlergrenze fuer Fehlerpfad Dfp_PCR_LPGvnrDvtPos" VALUE 0xCF7E4 Kw_Wu8 51000. TimeDsmTsf 0.00 51000. FORMAT "%5.0" /end CHARACTERISTIC
/begin CHARACTERISTIC DSM_TsfDfp_PCVCDNoLoad_C "Schwerezaehlergrenze fuer Fehlerpfad Dfp_PCVCDNoLoad" VALUE 0xCF7E5 Kw_Wu8 51000. TimeDsmTsf 0.00 51000. FORMAT "%5.0" /end CHARACTERISTIC
/begin CHARACTERISTIC DSM_TsfDfp_PCVCDSCBat_C "Schwerezaehlergrenze fuer Fehlerpfad Dfp_PCVCDSCBat" VALUE 0xCF7E6 Kw_Wu8 51000. TimeDsmTsf 0.00 51000. FORMAT "%5.0" /end CHARACTERISTIC
/begin CHARACTERISTIC DSM_TsfDfp_PCVCDSCGnd_C "Schwerezaehlergrenze fuer Fehlerpfad Dfp_PCVCDSCGnd" VALUE 0xCF7E7 Kw_Wu8 51000. TimeDsmTsf 0.00 51000. FORMAT "%5.0" /end CHARACTERISTIC
/begin CHARACTERISTIC DSM_TsfDfp_PCVCD_ADC_C "Schwerezaehlergrenze fuer Fehlerpfad Dfp_PCVCD_ADC" VALUE 0xCF7E8 Kw_Wu8 51000. TimeDsmTsf 0.00 51000. FORMAT "%5.0" /end CHARACTERISTIC
/begin CHARACTERISTIC DSM_TsfDfp_PCVCD_SigTst_C "Schwerezaehlergrenze fuer Fehlerpfad Dfp_PCVCD_SigTst" VALUE 0xCF7E9 Kw_Wu8 51000. TimeDsmTsf 0.00 51000. FORMAT "%5.0" /end CHARACTERISTIC
/begin CHARACTERISTIC DSM_TsfDfp_PFltAPSPlaus_C "Schwerezaehlergrenze fuer Fehlerpfad Dfp_PFltAPSPlaus" VALUE 0xCF7EA Kw_Wu8 51000. TimeDsmTsf 0.00 51000. FORMAT "%5.0" /end CHARACTERISTIC
/begin CHARACTERISTIC DSM_TsfDfp_PFltAPSens_C "Schwerezaehlergrenze fuer Fehlerpfad Dfp_PFltAPSens" VALUE 0xCF7EB Kw_Wu8 51000. TimeDsmTsf 0.00 51000. FORMAT "%5.0" /end CHARACTERISTIC
/begin CHARACTERISTIC DSM_TsfDfp_PFltBPSPlaus_C "Schwerezaehlergrenze fuer Fehlerpfad Dfp_PFltBPSPlaus" VALUE 0xCF7EC Kw_Wu8 51000. TimeDsmTsf 0.00 51000. FORMAT "%5.0" /end CHARACTERISTIC
/begin CHARACTERISTIC DSM_TsfDfp_PFltCDPPre_C "Schwerezaehlergrenze fuer Fehlerpfad Dfp_PFltCDPPre" VALUE 0xCF7ED Kw_Wu8 51000. TimeDsmTsf 0.00 51000. FORMAT "%5.0" /end CHARACTERISTIC
/begin CHARACTERISTIC DSM_TsfDfp_PFltCDTempPre_C "Schwerezaehlergrenze fuer Fehlerpfad Dfp_PFltCDTempPre" VALUE 0xCF7EE Kw_Wu8 51000. TimeDsmTsf 0.00 51000. FORMAT "%5.0" /end CHARACTERISTIC
/begin CHARACTERISTIC DSM_TsfDfp_PFltChar_C "Schwerezaehlergrenze fuer Fehlerpfad Dfp_PFltChar" VALUE 0xCF7EF Kw_Wu8 51000. TimeDsmTsf 0.00 51000. FORMAT "%5.0" /end CHARACTERISTIC
/begin CHARACTERISTIC DSM_TsfDfp_PFltEngPrt_C "Schwerezaehlergrenze fuer Fehlerpfad Dfp_PFltEngPrt" VALUE 0xCF7F0 Kw_Wu8 51000. TimeDsmTsf 0.00 51000. FORMAT "%5.0" /end CHARACTERISTIC
/begin CHARACTERISTIC DSM_TsfDfp_PFltOvldInhRgn_C "Schwerezaehlergrenze fuer Fehlerpfad Dfp_PFltOvldInhRgn" VALUE 0xCF7F1 Kw_Wu8 51000. TimeDsmTsf 0.00 51000. FORMAT "%5.0" /end CHARACTERISTIC
/begin CHARACTERISTIC DSM_TsfDfp_PFltOvldTrqLim_C "Schwerezaehlergrenze fuer Fehlerpfad Dfp_PFltOvldTrqLim" VALUE 0xCF7F2 Kw_Wu8 51000. TimeDsmTsf 0.00 51000. FORMAT "%5.0" /end CHARACTERISTIC
/begin CHARACTERISTIC DSM_TsfDfp_PFltPresDynPlaus_C "Schwerezaehlergrenze fuer Fehlerpfad Dfp_PFltPresDynPlaus" VALUE 0xCF7F3 Kw_Wu8 51000. TimeDsmTsf 0.00 51000. FORMAT "%5.0" /end CHARACTERISTIC
/begin CHARACTERISTIC DSM_TsfDfp_PFltPresPlaus_C "Schwerezaehlergrenze fuer Fehlerpfad Dfp_PFltPresPlaus" VALUE 0xCF7F4 Kw_Wu8 51000. TimeDsmTsf 0.00 51000. FORMAT "%5.0" /end CHARACTERISTIC
/begin CHARACTERISTIC DSM_TsfDfp_PFltPresSens_C "Schwerezaehlergrenze fuer Fehlerpfad Dfp_PFltPresSens" VALUE 0xCF7F5 Kw_Wu8 51000. TimeDsmTsf 0.00 51000. FORMAT "%5.0" /end CHARACTERISTIC
/begin CHARACTERISTIC DSM_TsfDfp_PFltPresSensFrz_C "Schwerezaehlergrenze fuer Fehlerpfad Dfp_PFltPresSensFrz" VALUE 0xCF7F6 Kw_Wu8 51000. TimeDsmTsf 0.00 51000. FORMAT "%5.0" /end CHARACTERISTIC
/begin CHARACTERISTIC DSM_TsfDfp_PFltPresSensHsLn_C "Schwerezaehlergrenze fuer Fehlerpfad Dfp_PFltPresSensHsLn" VALUE 0xCF7F7 Kw_Wu8 51000. TimeDsmTsf 0.00 51000. FORMAT "%5.0" /end CHARACTERISTIC
/begin CHARACTERISTIC DSM_TsfDfp_PFltPresSensSot_C "Schwerezaehlergrenze fuer Fehlerpfad Dfp_PFltPresSensSot" VALUE 0xCF7F8 Kw_Wu8 51000. TimeDsmTsf 0.00 51000. FORMAT "%5.0" /end CHARACTERISTIC
/begin CHARACTERISTIC DSM_TsfDfp_PFltRgnPerm_C "Schwerezaehlergrenze fuer Fehlerpfad Dfp_PFltRgnPerm" VALUE 0xCF7F9 Kw_Wu8 51000. TimeDsmTsf 0.00 51000. FORMAT "%5.0" /end CHARACTERISTIC
/begin CHARACTERISTIC DSM_TsfDfp_PFltTempDwnStrm_C "Schwerezaehlergrenze fuer Fehlerpfad Dfp_PFltTempDwnStrm" VALUE 0xCF7FA Kw_Wu8 51000. TimeDsmTsf 0.00 51000. FORMAT "%5.0" /end CHARACTERISTIC
/begin CHARACTERISTIC DSM_TsfDfp_PFltTempSens_C "Schwerezaehlergrenze fuer Fehlerpfad Dfp_PFltTempSens" VALUE 0xCF7FB Kw_Wu8 51000. TimeDsmTsf 0.00 51000. FORMAT "%5.0" /end CHARACTERISTIC
/begin CHARACTERISTIC DSM_TsfDfp_PFltTempUpStrm_C "Schwerezaehlergrenze fuer Fehlerpfad Dfp_PFltTempUpStrm" VALUE 0xCF7FC Kw_Wu8 51000. TimeDsmTsf 0.00 51000. FORMAT "%5.0" /end CHARACTERISTIC
/begin CHARACTERISTIC DSM_TsfDfp_PFlt_tOxiPreMax_C "Schwerezaehlergrenze fuer Fehlerpfad Dfp_PFlt_tOxiPreMax" VALUE 0xCF7FD Kw_Wu8 51000. TimeDsmTsf 0.00 51000. FORMAT "%5.0" /end CHARACTERISTIC
/begin CHARACTERISTIC DSM_TsfDfp_PFlt_tOxiPreMxRgn_C "Schwerezaehlergrenze fuer Fehlerpfad Dfp_PFlt_tOxiPreMxRgn" VALUE 0xCF7FE Kw_Wu8 51000. TimeDsmTsf 0.00 51000. FORMAT "%5.0" /end CHARACTERISTIC
/begin CHARACTERISTIC DSM_TsfDfp_PFlt_tPreMax_C "Schwerezaehlergrenze fuer Fehlerpfad Dfp_PFlt_tPreMax" VALUE 0xCF7FF Kw_Wu8 51000. TimeDsmTsf 0.00 51000. FORMAT "%5.0" /end CHARACTERISTIC
/begin CHARACTERISTIC DSM_TsfDfp_PFlt_tPreMaxRgn_C "Schwerezaehlergrenze fuer Fehlerpfad Dfp_PFlt_tPreMaxRgn" VALUE 0xCF800 Kw_Wu8 51000. TimeDsmTsf 0.00 51000. FORMAT "%5.0" /end CHARACTERISTIC
/begin CHARACTERISTIC DSM_TsfDfp_PFltmSotDiffMax_C "Schwerezaehlergrenze fuer Fehlerpfad Dfp_PFltmSotDiffMax" VALUE 0xCF801 Kw_Wu8 51000. TimeDsmTsf 0.00 51000. FORMAT "%5.0" /end CHARACTERISTIC
/begin CHARACTERISTIC DSM_TsfDfp_PSPCD_Actr_C "Schwerezaehlergrenze fuer Fehlerpfad Dfp_PSPCD_Actr" VALUE 0xCF802 Kw_Wu8 51000. TimeDsmTsf 0.00 51000. FORMAT "%5.0" /end CHARACTERISTIC
/begin CHARACTERISTIC DSM_TsfDfp_PresPlausDblDef_C "Schwerezaehlergrenze fuer Fehlerpfad Dfp_PresPlausDblDef" VALUE 0xCF803 Kw_Wu8 51000. TimeDsmTsf 0.00 51000. FORMAT "%5.0" /end CHARACTERISTIC
/begin CHARACTERISTIC DSM_TsfDfp_QLTCD_C "Schwerezaehlergrenze fuer Fehlerpfad Dfp_QLTCD" VALUE 0xCF804 Kw_Wu8 51000. TimeDsmTsf 0.00 51000. FORMAT "%5.0" /end CHARACTERISTIC
/begin CHARACTERISTIC DSM_TsfDfp_RailCD_C "Schwerezaehlergrenze fuer Fehlerpfad Dfp_RailCD" VALUE 0xCF805 Kw_Wu8 51000. TimeDsmTsf 0.00 51000. FORMAT "%5.0" /end CHARACTERISTIC
/begin CHARACTERISTIC DSM_TsfDfp_RailCDOfsTst_C "Schwerezaehlergrenze fuer Fehlerpfad Dfp_RailCDOfsTst" VALUE 0xCF806 Kw_Wu8 51000. TimeDsmTsf 0.00 51000. FORMAT "%5.0" /end CHARACTERISTIC
/begin CHARACTERISTIC DSM_TsfDfp_RailCD_PMonStrt_C "Schwerezaehlergrenze fuer Fehlerpfad Dfp_RailCD_PMonStrt" VALUE 0xCF807 Kw_Wu8 51000. TimeDsmTsf 0.00 51000. FORMAT "%5.0" /end CHARACTERISTIC
/begin CHARACTERISTIC DSM_TsfDfp_RailCtlModeMeUnDiag_C "Schwerezaehlergrenze fuer Fehlerpfad Dfp_RailCtlModeMeUnDiag" VALUE 0xCF808 Kw_Wu8 51000. TimeDsmTsf 0.00 51000. FORMAT "%5.0" /end CHARACTERISTIC
/begin CHARACTERISTIC DSM_TsfDfp_RailCtlModePCVDiag_C "Schwerezaehlergrenze fuer Fehlerpfad Dfp_RailCtlModePCVDiag" VALUE 0xCF809 Kw_Wu8 51000. TimeDsmTsf 0.00 51000. FORMAT "%5.0" /end CHARACTERISTIC
/begin CHARACTERISTIC DSM_TsfDfp_RailMeUn0_C "Schwerezaehlergrenze fuer Fehlerpfad Dfp_RailMeUn0" VALUE 0xCF80A Kw_Wu8 51000. TimeDsmTsf 0.00 51000. FORMAT "%5.0" /end CHARACTERISTIC
/begin CHARACTERISTIC DSM_TsfDfp_RailMeUn1_C "Schwerezaehlergrenze fuer Fehlerpfad Dfp_RailMeUn1" VALUE 0xCF80B Kw_Wu8 51000. TimeDsmTsf 0.00 51000. FORMAT "%5.0" /end CHARACTERISTIC
/begin CHARACTERISTIC DSM_TsfDfp_RailMeUn2_C "Schwerezaehlergrenze fuer Fehlerpfad Dfp_RailMeUn2" VALUE 0xCF80C Kw_Wu8 51000. TimeDsmTsf 0.00 51000. FORMAT "%5.0" /end CHARACTERISTIC
/begin CHARACTERISTIC DSM_TsfDfp_RailMeUn3_C "Schwerezaehlergrenze fuer Fehlerpfad Dfp_RailMeUn3" VALUE 0xCF80D Kw_Wu8 51000. TimeDsmTsf 0.00 51000. FORMAT "%5.0" /end CHARACTERISTIC
/begin CHARACTERISTIC DSM_TsfDfp_RailMeUn4_C "Schwerezaehlergrenze fuer Fehlerpfad Dfp_RailMeUn4" VALUE 0xCF80E Kw_Wu8 51000. TimeDsmTsf 0.00 51000. FORMAT "%5.0" /end CHARACTERISTIC
/begin CHARACTERISTIC DSM_TsfDfp_RailPCV0_C "Schwerezaehlergrenze fuer Fehlerpfad Dfp_RailPCV0" VALUE 0xCF80F Kw_Wu8 51000. TimeDsmTsf 0.00 51000. FORMAT "%5.0" /end CHARACTERISTIC
/begin CHARACTERISTIC DSM_TsfDfp_RailPCV1_C "Schwerezaehlergrenze fuer Fehlerpfad Dfp_RailPCV1" VALUE 0xCF810 Kw_Wu8 51000. TimeDsmTsf 0.00 51000. FORMAT "%5.0" /end CHARACTERISTIC
/begin CHARACTERISTIC DSM_TsfDfp_RailPCV2_C "Schwerezaehlergrenze fuer Fehlerpfad Dfp_RailPCV2" VALUE 0xCF811 Kw_Wu8 51000. TimeDsmTsf 0.00 51000. FORMAT "%5.0" /end CHARACTERISTIC
/begin CHARACTERISTIC DSM_TsfDfp_RailPCV3_C "Schwerezaehlergrenze fuer Fehlerpfad Dfp_RailPCV3" VALUE 0xCF812 Kw_Wu8 51000. TimeDsmTsf 0.00 51000. FORMAT "%5.0" /end CHARACTERISTIC
/begin CHARACTERISTIC DSM_TsfDfp_RailPCV4_C "Schwerezaehlergrenze fuer Fehlerpfad Dfp_RailPCV4" VALUE 0xCF813 Kw_Wu8 51000. TimeDsmTsf 0.00 51000. FORMAT "%5.0" /end CHARACTERISTIC
/begin CHARACTERISTIC DSM_TsfDfp_RailPCV5_C "Schwerezaehlergrenze fuer Fehlerpfad Dfp_RailPCV5" VALUE 0xCF814 Kw_Wu8 51000. TimeDsmTsf 0.00 51000. FORMAT "%5.0" /end CHARACTERISTIC
/begin CHARACTERISTIC DSM_TsfDfp_SOPTst_C "Schwerezaehlergrenze fuer Fehlerpfad Dfp_SOPTst" VALUE 0xCF815 Kw_Wu8 51000. TimeDsmTsf 0.00 51000. FORMAT "%5.0" /end CHARACTERISTIC
/begin CHARACTERISTIC DSM_TsfDfp_SSpMon1_C "Schwerezaehlergrenze fuer Fehlerpfad Dfp_SSpMon1" VALUE 0xCF816 Kw_Wu8 51000. TimeDsmTsf 0.00 51000. FORMAT "%5.0" /end CHARACTERISTIC
/begin CHARACTERISTIC DSM_TsfDfp_SSpMon2_C "Schwerezaehlergrenze fuer Fehlerpfad Dfp_SSpMon2" VALUE 0xCF817 Kw_Wu8 51000. TimeDsmTsf 0.00 51000. FORMAT "%5.0" /end CHARACTERISTIC
/begin CHARACTERISTIC DSM_TsfDfp_SSpMon3_C "Schwerezaehlergrenze fuer Fehlerpfad Dfp_SSpMon3" VALUE 0xCF818 Kw_Wu8 51000. TimeDsmTsf 0.00 51000. FORMAT "%5.0" /end CHARACTERISTIC
/begin CHARACTERISTIC DSM_TsfDfp_SWChk_CycSigChkDat_C "Schwerezaehlergrenze fuer Fehlerpfad Dfp_SWChk_CycSigChkDat" VALUE 0xCF819 Kw_Wu8 51000. TimeDsmTsf 0.00 51000. FORMAT "%5.0" /end CHARACTERISTIC
/begin CHARACTERISTIC DSM_TsfDfp_SWChk_CycSigChkPrg_C "Schwerezaehlergrenze fuer Fehlerpfad Dfp_SWChk_CycSigChkPrg" VALUE 0xCF81A Kw_Wu8 51000. TimeDsmTsf 0.00 51000. FORMAT "%5.0" /end CHARACTERISTIC
/begin CHARACTERISTIC DSM_TsfDfp_ShutCD_C "Schwerezaehlergrenze fuer Fehlerpfad Dfp_ShutCD" VALUE 0xCF81B Kw_Wu8 51000. TimeDsmTsf 0.00 51000. FORMAT "%5.0" /end CHARACTERISTIC
/begin CHARACTERISTIC DSM_TsfDfp_StSysTrqShutOff_C "Schwerezaehlergrenze fuer Fehlerpfad Dfp_StSysTrqShutOff" VALUE 0xCF81C Kw_Wu8 51000. TimeDsmTsf 0.00 51000. FORMAT "%5.0" /end CHARACTERISTIC
/begin CHARACTERISTIC DSM_TsfDfp_StrtCD_Actr_C "Schwerezaehlergrenze fuer Fehlerpfad Dfp_StrtCD_Actr" VALUE 0xCF81D Kw_Wu8 51000. TimeDsmTsf 0.00 51000. FORMAT "%5.0" /end CHARACTERISTIC
/begin CHARACTERISTIC DSM_TsfDfp_SysLamp_C "Schwerezaehlergrenze fuer Fehlerpfad Dfp_SysLamp" VALUE 0xCF81E Kw_Wu8 51000. TimeDsmTsf 0.00 51000. FORMAT "%5.0" /end CHARACTERISTIC
/begin CHARACTERISTIC DSM_TsfDfp_T15CD_C "Schwerezaehlergrenze fuer Fehlerpfad Dfp_T15CD" VALUE 0xCF81F Kw_Wu8 51000. TimeDsmTsf 0.00 51000. FORMAT "%5.0" /end CHARACTERISTIC
/begin CHARACTERISTIC DSM_TsfDfp_TGearbx_C "Schwerezaehlergrenze fuer Fehlerpfad Dfp_TGearbx" VALUE 0xCF820 Kw_Wu8 51000. TimeDsmTsf 0.00 51000. FORMAT "%5.0" /end CHARACTERISTIC
/begin CHARACTERISTIC DSM_TsfDfp_TPUMon_C "Schwerezaehlergrenze fuer Fehlerpfad Dfp_TPUMon" VALUE 0xCF821 Kw_Wu8 51000. TimeDsmTsf 0.00 51000. FORMAT "%5.0" /end CHARACTERISTIC
/begin CHARACTERISTIC DSM_TsfDfp_TVACD_Max_C "Schwerezaehlergrenze fuer Fehlerpfad Dfp_TVACD_Max" VALUE 0xCF822 Kw_Wu8 51000. TimeDsmTsf 0.00 51000. FORMAT "%5.0" /end CHARACTERISTIC
/begin CHARACTERISTIC DSM_TsfDfp_TVACD_Min_C "Schwerezaehlergrenze fuer Fehlerpfad Dfp_TVACD_Min" VALUE 0xCF823 Kw_Wu8 51000. TimeDsmTsf 0.00 51000. FORMAT "%5.0" /end CHARACTERISTIC
/begin CHARACTERISTIC DSM_TsfDfp_TVACD_SigNpl_C "Schwerezaehlergrenze fuer Fehlerpfad Dfp_TVACD_SigNpl" VALUE 0xCF824 Kw_Wu8 51000. TimeDsmTsf 0.00 51000. FORMAT "%5.0" /end CHARACTERISTIC
/begin CHARACTERISTIC DSM_TsfDfp_TVACD_TVADia1_C "Schwerezaehlergrenze fuer Fehlerpfad Dfp_TVACD_TVADia1" VALUE 0xCF825 Kw_Wu8 51000. TimeDsmTsf 0.00 51000. FORMAT "%5.0" /end CHARACTERISTIC
/begin CHARACTERISTIC DSM_TsfDfp_TVACD_TVADia2_C "Schwerezaehlergrenze fuer Fehlerpfad Dfp_TVACD_TVADia2" VALUE 0xCF826 Kw_Wu8 51000. TimeDsmTsf 0.00 51000. FORMAT "%5.0" /end CHARACTERISTIC
/begin CHARACTERISTIC DSM_TsfDfp_TVACD_TVADia3_C "Schwerezaehlergrenze fuer Fehlerpfad Dfp_TVACD_TVADia3" VALUE 0xCF827 Kw_Wu8 51000. TimeDsmTsf 0.00 51000. FORMAT "%5.0" /end CHARACTERISTIC
/begin CHARACTERISTIC DSM_TsfDfp_TVACD_TVADia4_C "Schwerezaehlergrenze fuer Fehlerpfad Dfp_TVACD_TVADia4" VALUE 0xCF828 Kw_Wu8 51000. TimeDsmTsf 0.00 51000. FORMAT "%5.0" /end CHARACTERISTIC
/begin CHARACTERISTIC DSM_TsfDfp_ThrVlvMon_C "Schwerezaehlergrenze fuer Fehlerpfad Dfp_ThrVlvMon" VALUE 0xCF829 Kw_Wu8 51000. TimeDsmTsf 0.00 51000. FORMAT "%5.0" /end CHARACTERISTIC
/begin CHARACTERISTIC DSM_TsfDfp_VSACD_DiaDet_C "Schwerezaehlergrenze fuer Fehlerpfad Dfp_VSACD_DiaDet" VALUE 0xCF82A Kw_Wu8 51000. TimeDsmTsf 0.00 51000. FORMAT "%5.0" /end CHARACTERISTIC
/begin CHARACTERISTIC DSM_TsfDfp_VSACD_DioInDia1_C "Schwerezaehlergrenze fuer Fehlerpfad Dfp_VSACD_DioInDia1" VALUE 0xCF82B Kw_Wu8 51000. TimeDsmTsf 0.00 51000. FORMAT "%5.0" /end CHARACTERISTIC
/begin CHARACTERISTIC DSM_TsfDfp_VSACD_DioInDia2_C "Schwerezaehlergrenze fuer Fehlerpfad Dfp_VSACD_DioInDia2" VALUE 0xCF82C Kw_Wu8 51000. TimeDsmTsf 0.00 51000. FORMAT "%5.0" /end CHARACTERISTIC
/begin CHARACTERISTIC DSM_TsfDfp_VSACD_DioInDia3_C "Schwerezaehlergrenze fuer Fehlerpfad Dfp_VSACD_DioInDia3" VALUE 0xCF82D Kw_Wu8 51000. TimeDsmTsf 0.00 51000. FORMAT "%5.0" /end CHARACTERISTIC
/begin CHARACTERISTIC DSM_TsfDfp_VSACD_DioInDia4_C "Schwerezaehlergrenze fuer Fehlerpfad Dfp_VSACD_DioInDia4" VALUE 0xCF82E Kw_Wu8 51000. TimeDsmTsf 0.00 51000. FORMAT "%5.0" /end CHARACTERISTIC
/begin CHARACTERISTIC DSM_TsfDfp_VSACD_DioInMin_C "Schwerezaehlergrenze fuer Fehlerpfad Dfp_VSACD_DioInMin" VALUE 0xCF82F Kw_Wu8 51000. TimeDsmTsf 0.00 51000. FORMAT "%5.0" /end CHARACTERISTIC
/begin CHARACTERISTIC DSM_TsfDfp_VSACD_Max_C "Schwerezaehlergrenze fuer Fehlerpfad Dfp_VSACD_Max" VALUE 0xCF830 Kw_Wu8 51000. TimeDsmTsf 0.00 51000. FORMAT "%5.0" /end CHARACTERISTIC
/begin CHARACTERISTIC DSM_TsfDfp_VSACD_Min_C "Schwerezaehlergrenze fuer Fehlerpfad Dfp_VSACD_Min" VALUE 0xCF831 Kw_Wu8 51000. TimeDsmTsf 0.00 51000. FORMAT "%5.0" /end CHARACTERISTIC
/begin CHARACTERISTIC DSM_TsfDfp_VSACD_SigNpl_C "Schwerezaehlergrenze fuer Fehlerpfad Dfp_VSACD_SigNpl" VALUE 0xCF832 Kw_Wu8 51000. TimeDsmTsf 0.00 51000. FORMAT "%5.0" /end CHARACTERISTIC
/begin CHARACTERISTIC DSM_TsfDfp_VSACD_VSADia1_C "Schwerezaehlergrenze fuer Fehlerpfad Dfp_VSACD_VSADia1" VALUE 0xCF833 Kw_Wu8 51000. TimeDsmTsf 0.00 51000. FORMAT "%5.0" /end CHARACTERISTIC
/begin CHARACTERISTIC DSM_TsfDfp_VSACD_VSADia2_C "Schwerezaehlergrenze fuer Fehlerpfad Dfp_VSACD_VSADia2" VALUE 0xCF834 Kw_Wu8 51000. TimeDsmTsf 0.00 51000. FORMAT "%5.0" /end CHARACTERISTIC
/begin CHARACTERISTIC DSM_TsfDfp_VSACD_VSADia3_C "Schwerezaehlergrenze fuer Fehlerpfad Dfp_VSACD_VSADia3" VALUE 0xCF835 Kw_Wu8 51000. TimeDsmTsf 0.00 51000. FORMAT "%5.0" /end CHARACTERISTIC
/begin CHARACTERISTIC DSM_TsfDfp_VSACD_VSADia4_C "Schwerezaehlergrenze fuer Fehlerpfad Dfp_VSACD_VSADia4" VALUE 0xCF836 Kw_Wu8 51000. TimeDsmTsf 0.00 51000. FORMAT "%5.0" /end CHARACTERISTIC
/begin CHARACTERISTIC DSM_TsfDfp_VSSCD1_C "Schwerezaehlergrenze fuer Fehlerpfad Dfp_VSSCD1" VALUE 0xCF837 Kw_Wu8 51000. TimeDsmTsf 0.00 51000. FORMAT "%5.0" /end CHARACTERISTIC
/begin CHARACTERISTIC DSM_TsfDfp_VSSCD2_C "Schwerezaehlergrenze fuer Fehlerpfad Dfp_VSSCD2" VALUE 0xCF838 Kw_Wu8 51000. TimeDsmTsf 0.00 51000. FORMAT "%5.0" /end CHARACTERISTIC
/begin CHARACTERISTIC DSM_TsfDfp_WdCom_C "Schwerezaehlergrenze fuer Fehlerpfad Dfp_WdCom" VALUE 0xCF839 Kw_Wu8 51000. TimeDsmTsf 0.00 51000. FORMAT "%5.0" /end CHARACTERISTIC
/begin CHARACTERISTIC EATSCD_uSRCMin_C "SRC Minimum Umgebungstemperatur" VALUE 0xCF848 Kw_Ws16 5200.391 Volt 0.00 5200.391 FORMAT "%8.3" EXTENDED_LIMITS -160156.4 160151.5 /end CHARACTERISTIC
/begin CHARACTERISTIC EATSCD_uSRCMax_C "SRC Maximum Umgebungstemperatur" VALUE 0xCF84A Kw_Ws16 5200.391 Volt 0.00 5200.391 FORMAT "%8.3" EXTENDED_LIMITS -160156.4 160151.5 /end CHARACTERISTIC
/begin CHARACTERISTIC EATSCD_tLin_CUR "Linearisierungskennlinie der Umgebungstemperatur" CURVE 0xCF84C Kl_Xs16_Ws16 950.0000 Temp_Cels -50.1400 899.8600 FORMAT "%8.4" EXTENDED_LIMITS -3549.940 3003.560
 /begin AXIS_DESCR STD_AXIS EATSCD_uRaw Volt 25 0.00 5200.391 FORMAT "%8.3" EXTENDED_LIMITS -160156.4 160151.5 DEPOSIT ABSOLUTE /end AXIS_DESCR
/end CHARACTERISTIC
/begin CHARACTERISTIC EATSCD_DebSigDef_C "Entprellzeit defekt CAN Signal Fehler Umgebungstemperatur" VALUE 0xCF8B2 Kw_Wu16 655350.0 Time_ms 0.00 655350.0 FORMAT "%8.1" /end CHARACTERISTIC
/begin CHARACTERISTIC EATSCD_DebSigOk_C "Heilungsentprellzeit CAN Signalfehler Umgebungstemperatur" VALUE 0xCF8B4 Kw_Wu16 655350.0 Time_ms 0.00 655350.0 FORMAT "%8.1" /end CHARACTERISTIC
/begin CHARACTERISTIC EATSCD_DebSRCHighDef_C "EATS Fehlerentprellungszeit fuer SRC-High" VALUE 0xCF8B6 Kw_Wu16 655350.0 Time_ms 0.00 655350.0 FORMAT "%8.1" /end CHARACTERISTIC
/begin CHARACTERISTIC EATSCD_DebSRCHighOk_C "EATS Heilungsentprellzeit fuer SRC-High" VALUE 0xCF8B8 Kw_Wu16 655350.0 Time_ms 0.00 655350.0 FORMAT "%8.1" /end CHARACTERISTIC
/begin CHARACTERISTIC EATSCD_DebSRCLowDef_C "EATS Fehlerentprellungszeit fuer SRC-Low" VALUE 0xCF8BA Kw_Wu16 655350.0 Time_ms 0.00 655350.0 FORMAT "%8.1" /end CHARACTERISTIC
/begin CHARACTERISTIC EATSCD_DebSRCLowOk_C "EATS Heilungsentprellzeit fuer SRC-Low" VALUE 0xCF8BC Kw_Wu16 655350.0 Time_ms 0.00 655350.0 FORMAT "%8.1" /end CHARACTERISTIC
/begin CHARACTERISTIC EATSCD_dtRmpSubs_C "Rampensteigung für Umgebungstemperatur" VALUE 0xCF8C0 Kw_Wu32 6553.59899750 RmpTempCels 0.00100097656250 6553.59999847 FORMAT "%13.8" EXTENDED_LIMITS 0.00 6553.59999847 /end CHARACTERISTIC
/begin CHARACTERISTIC EATSCD_dtRmpSubsUp_C "Rampensteigung für Umschaltung der Umgebungstemperatur" VALUE 0xCF8C4 Kw_Wu32 6553.59899750 RmpTempCels 0.00100097656250 6553.59999847 FORMAT "%13.8" EXTENDED_LIMITS 0.00 6553.59999847 /end CHARACTERISTIC
/begin CHARACTERISTIC EATSCD_dtRmpSubsDwn_C "Rampensteigung für Umschaltung der Umgebungstemperatur" VALUE 0xCF8C8 Kw_Wu32 6553.59899750 RmpTempCels 0.00100097656250 6553.59999847 FORMAT "%13.8" EXTENDED_LIMITS 0.00 6553.59999847 /end CHARACTERISTIC
/begin CHARACTERISTIC EATSCD_numAdc_C "#SSD Applikationsparameter fuer Umgebungslufttemperatur-Fuhehler" VALUE 0xCF8CC Kw_Wu8 26.0000000000 NumPinAdc 0.00 26.0000000000 FORMAT "%13.10" /end CHARACTERISTIC
/begin CHARACTERISTIC EATSCD_dtRmpSlpUp_C "popsitive Rampensteigung" VALUE 0xCF8D0 Kw_Wu32 6553598.99749 RmpTemp 1.00097656250 6553599.99847 FORMAT "%13.5" EXTENDED_LIMITS 0.00 6553599.99847 /end CHARACTERISTIC
/begin CHARACTERISTIC EATSCD_dtRmpSlpDwn_C "negative Rampensteigung" VALUE 0xCF8D4 Kw_Wu32 6553598.99749 RmpTemp 1.00097656250 6553599.99847 FORMAT "%13.5" EXTENDED_LIMITS 0.00 6553599.99847 /end CHARACTERISTIC
/begin CHARACTERISTIC EATSCD_swtSensImpl_C "Schalter zur Auswahl der Umgebungstemperatur (0: Umgebungsluft- Sensor, 1: Ersatztemperatur, default: Ansauglufttemperatur)" VALUE 0xCF8D8 Kw_Wu8 2.000 OneToOne 0.00 2.000 FORMAT "%5.3" EXTENDED_LIMITS 0.00 255.0 /end CHARACTERISTIC
/begin CHARACTERISTIC EATSCD_swtSigVal_C "Datensatzwert Signalquelle Umgebungsluftemperatur (0 = ADC, 1 = CAN)" VALUE 0xCF8D9 Kw_Wu8 1.000 OneToOne 0.00 1.000 FORMAT "%5.3" EXTENDED_LIMITS 0.00 255.0 /end CHARACTERISTIC
/begin CHARACTERISTIC EATSCD_tAirSubs_C "Ersatzwert für Umgebungstemperatur" VALUE 0xCF8DA Kw_Ws16 250.0000 Temp_Cels -50.14000 199.8600 FORMAT "%8.4" EXTENDED_LIMITS -3549.940 3003.560 /end CHARACTERISTIC
/begin CHARACTERISTIC EATSCD_tiTransStValid_C "Zeit nach der EATSCD_stValid ohne gültigen CAN wert auf TRUE gesetzt wird" VALUE 0xCF8DC Kw_Wu16 655.3500 Time_s 0.00 655.3500 FORMAT "%8.4" /end CHARACTERISTIC
/begin CHARACTERISTIC EATSCD_stSensIDWord_C "Geberkennwort Umgebungstemperatur" VALUE 0xCF8DE Kw_Wu16 65535.00 OneToOne 0.00 65535.00 FORMAT "%8.2" /end CHARACTERISTIC
/begin CHARACTERISTIC EATSCD_tDfl_C "Vorgabewert Umgebungstemperatur" VALUE 0xCF8E0 Kw_Ws16 950.0000 Temp_Cels -50.1400 899.8600 FORMAT "%8.4" EXTENDED_LIMITS -3549.940 3003.560 /end CHARACTERISTIC
/begin CHARACTERISTIC EBAFCD_ctPwrStgOnMax_C "Maximaler Zähler für Powerstage On im Fehlerfall" VALUE 0xCF8E4 Kw_Wu16 65535.00 OneToOne 0.00 65535.00 FORMAT "%8.2" /end CHARACTERISTIC
/begin CHARACTERISTIC EBAFCD_DebExcTempDef_C "Defect time for EXC_TEMP error" VALUE 0xCF8E6 Kw_Wu16 655350.0 Time_ms 0.00 655350.0 FORMAT "%8.1" /end CHARACTERISTIC
/begin CHARACTERISTIC EBAFCD_DebExcTempOk_C "Healing time for EXC_TEMP error" VALUE 0xCF8E8 Kw_Wu16 655350.0 Time_ms 0.00 655350.0 FORMAT "%8.1" /end CHARACTERISTIC
/begin CHARACTERISTIC EBAFCD_DebNoLoadDef_C "Defect time for NO_LOAD error" VALUE 0xCF8EA Kw_Wu16 655350.0 Time_ms 0.00 655350.0 FORMAT "%8.1" /end CHARACTERISTIC
/begin CHARACTERISTIC EBAFCD_DebNoLoadOk_C "Healing time for NO_LOAD error" VALUE 0xCF8EC Kw_Wu16 655350.0 Time_ms 0.00 655350.0 FORMAT "%8.1" /end CHARACTERISTIC
/begin CHARACTERISTIC EBAFCD_DebShortCircBatDef_C "Defect time for SHORT_CIRC_BAT error" VALUE 0xCF8EE Kw_Wu16 655350.0 Time_ms 0.00 655350.0 FORMAT "%8.1" /end CHARACTERISTIC
/begin CHARACTERISTIC EBAFCD_DebShortCircBatOk_C "Healing time for SHORT_CIRC_BAT error" VALUE 0xCF8F0 Kw_Wu16 655350.0 Time_ms 0.00 655350.0 FORMAT "%8.1" /end CHARACTERISTIC
/begin CHARACTERISTIC EBAFCD_DebShortCircGndDef_C "Defect time for SHORT_CIRC_GND error" VALUE 0xCF8F2 Kw_Wu16 655350.0 Time_ms 0.00 655350.0 FORMAT "%8.1" /end CHARACTERISTIC
/begin CHARACTERISTIC EBAFCD_DebShortCircGndOk_C "Healing time for SHORT_CIRC_GND error" VALUE 0xCF8F4 Kw_Wu16 655350.0 Time_ms 0.00 655350.0 FORMAT "%8.1" /end CHARACTERISTIC
/begin CHARACTERISTIC EBAFCD_InvSigOut_C "status word for (non)/inverting output EBAFCD_stSigOut" VALUE 0xCF8F6 Kw_Wu8 255.0 OneToOne 0.00 255.0 FORMAT "%5.1" /end CHARACTERISTIC
/begin CHARACTERISTIC EBAFCD_nFan_C "minimum rpm of fan to disable outout" VALUE 0xCF8F8 Kw_Ws16 6000.092 FanSpd -3000.092 3000.000 FORMAT "%8.3" /end CHARACTERISTIC
/begin CHARACTERISTIC EBAFCD_numDiaOut_C "Request of test of power stage from tester" VALUE 0xCF8FA Kw_Wu8 27.0000000000 NumPinDia 0.00 27.0000000000 FORMAT "%13.10" /end CHARACTERISTIC
/begin CHARACTERISTIC EBAFCD_numDioOut_C "Selection of power stage" VALUE 0xCF8FB Kw_Wu8 11.0000000000 NumPinDioOut 0.00 11.0000000000 FORMAT "%13.10" /end CHARACTERISTIC
/begin CHARACTERISTIC EBAFCD_stSPICtl_C "Schalter ob Endstufe SPI kontrollierbar = 1 oder nicht SPI kontrollierbar = 0" VALUE 0xCF8FC Kw_Wu8 1.000 OneToOne 0.00 1.000 FORMAT "%5.3" EXTENDED_LIMITS 0.00 255.0 /end CHARACTERISTIC
/begin CHARACTERISTIC EBAFCD_tClntTrMin_C "threshold low engine protection pressure hysteresis" VALUE 0xCF8FE Kw_Ws16 950.000 Temp_Cels -50.140 899.860 FORMAT "%8.3" EXTENDED_LIMITS -3549.940 3003.560 /end CHARACTERISTIC
/begin CHARACTERISTIC EBAFCD_tClntTrMax_C "threshold high engine protection pressure hysteresis" VALUE 0xCF900 Kw_Ws16 950.000 Temp_Cels -50.140 899.860 FORMAT "%8.3" EXTENDED_LIMITS -3549.940 3003.560 /end CHARACTERISTIC
/begin CHARACTERISTIC EBAFCD_sttClntTrOff_C "engine protection off" VALUE 0xCF902 Kw_Ws16 65535.00 OneToOne -32768.00 32767.00 FORMAT "%8.2" READ_ONLY /end CHARACTERISTIC
/begin CHARACTERISTIC EBAFCD_sttClntTrOn_C "engine protection on" VALUE 0xCF904 Kw_Ws16 65535.00 OneToOne -32768.00 32767.00 FORMAT "%8.2" READ_ONLY /end CHARACTERISTIC
/begin CHARACTERISTIC EBAFCD_tClntMin_C "threshold low engine protection pressure hysteresis" VALUE 0xCF906 Kw_Ws16 950.000 Temp_Cels -50.140 899.860 FORMAT "%8.3" EXTENDED_LIMITS -3549.940 3003.560 /end CHARACTERISTIC
/begin CHARACTERISTIC EBAFCD_tClntMax_C "threshold high engine protection pressure hysteresis" VALUE 0xCF908 Kw_Ws16 950.000 Temp_Cels -50.140 899.860 FORMAT "%8.3" EXTENDED_LIMITS -3549.940 3003.560 /end CHARACTERISTIC
/begin CHARACTERISTIC EBAFCD_sttClntOff_C "engine protection off" VALUE 0xCF90A Kw_Ws16 65535.00 OneToOne -32768.00 32767.00 FORMAT "%8.2" READ_ONLY /end CHARACTERISTIC
/begin CHARACTERISTIC EBAFCD_sttClntOn_C "engine protection on" VALUE 0xCF90C Kw_Ws16 65535.00 OneToOne -32768.00 32767.00 FORMAT "%8.2" READ_ONLY /end CHARACTERISTIC
/begin CHARACTERISTIC EBAFCD_tiBtwTst_C "Zeitabstand, in dem die Endstufe im Fehlerfall getestet wird" VALUE 0xCF90E Kw_Wu16 29980.00 Time_ms 20.00000 30000.00 FORMAT "%8.2" EXTENDED_LIMITS 0.00 655350.0 /end CHARACTERISTIC
/begin CHARACTERISTIC EBAFCD_tiPwrStgOn_C "Zeit für welche die Endstufe im Fehlerfall eingeschalten wird (nur nicht SPI kontrolliert)" VALUE 0xCF910 Kw_Wu16 655140.0 Time_ms 0.00 655140.0 FORMAT "%8.1" EXTENDED_LIMITS 0.00 655350.0 /end CHARACTERISTIC
/begin CHARACTERISTIC EBFCD_ctPwrStgOnMax_C "Maximaler Zähler für Powerstage On im Fehlerfall" VALUE 0xCF912 Kw_Wu16 65535.00 OneToOne 0.00 65535.00 FORMAT "%8.2" /end CHARACTERISTIC
/begin CHARACTERISTIC EBFCD_DebExcTempDef_C "time for final defect of excess temperature defect" VALUE 0xCF914 Kw_Wu16 655350.0 Time_ms 0.00 655350.0 FORMAT "%8.1" /end CHARACTERISTIC
/begin CHARACTERISTIC EBFCD_DebExcTempOk_C "time for healing of excess temperature defect" VALUE 0xCF916 Kw_Wu16 655350.0 Time_ms 0.00 655350.0 FORMAT "%8.1" /end CHARACTERISTIC
/begin CHARACTERISTIC EBFCD_DebNoLoadDef_C "time for final defect of no load" VALUE 0xCF918 Kw_Wu16 655350.0 Time_ms 0.00 655350.0 FORMAT "%8.1" /end CHARACTERISTIC
/begin CHARACTERISTIC EBFCD_DebNoLoadOk_C "time for healing of no load defect" VALUE 0xCF91A Kw_Wu16 655350.0 Time_ms 0.00 655350.0 FORMAT "%8.1" /end CHARACTERISTIC
/begin CHARACTERISTIC EBFCD_DebShortCircBatDef_C "time for final defect for short circuit to battery" VALUE 0xCF91C Kw_Wu16 655350.0 Time_ms 0.00 655350.0 FORMAT "%8.1" /end CHARACTERISTIC
/begin CHARACTERISTIC EBFCD_DebShortCircBatOk_C "time for healing of short circuit to battery" VALUE 0xCF91E Kw_Wu16 655350.0 Time_ms 0.00 655350.0 FORMAT "%8.1" /end CHARACTERISTIC
/begin CHARACTERISTIC EBFCD_DebShortCircGndDef_C "time for final defect of short circuit to ground" VALUE 0xCF920 Kw_Wu16 655350.0 Time_ms 0.00 655350.0 FORMAT "%8.1" /end CHARACTERISTIC
/begin CHARACTERISTIC EBFCD_DebShortCircGndOk_C "time for final defect of short circuit to ground" VALUE 0xCF922 Kw_Wu16 655350.0 Time_ms 0.00 655350.0 FORMAT "%8.1" /end CHARACTERISTIC
/begin CHARACTERISTIC EBFCD_numDiaOut_C "#SSD application parameter for EBFCD diagnostic signal" VALUE 0xCF924 Kw_Wu8 27.0000000000 NumPinDia 0.00 27.0000000000 FORMAT "%13.10" /end CHARACTERISTIC
/begin CHARACTERISTIC EBFCD_numDioOut_C "#SSD application parameter for fan output signal" VALUE 0xCF925 Kw_Wu8 11.0000000000 NumPinDioOut 0.00 11.0000000000 FORMAT "%13.10" /end CHARACTERISTIC
/begin CHARACTERISTIC EBFCD_stDigInvOut_C "Digital output signal invert information" VALUE 0xCF926 Kw_Wu8 1.000 OneToOne 0.00 1.000 FORMAT "%5.3" EXTENDED_LIMITS 0.00 255.0 /end CHARACTERISTIC
/begin CHARACTERISTIC EBFCD_stSigOutErr_C "Default value if error occurs" VALUE 0xCF927 Kw_Wu8 1.000 OneToOne 0.00 1.000 FORMAT "%5.3" EXTENDED_LIMITS 0.00 255.0 /end CHARACTERISTIC
/begin CHARACTERISTIC EBFCD_stSPICtl_C "Schalter ob Endstufe SPI kontrollierbar = 1 oder nicht SPI kontrollierbar = 0" VALUE 0xCF928 Kw_Wu8 1.000 OneToOne 0.00 1.000 FORMAT "%5.3" EXTENDED_LIMITS 0.00 255.0 /end CHARACTERISTIC
/begin CHARACTERISTIC EBFCD_swtOnOff_C "Switch for switching the functionality ON/OFF (1 = ON, 0 = OFF)" VALUE 0xCF929 Kw_Wu8 1.000 OneToOne 0.00 1.000 FORMAT "%5.3" EXTENDED_LIMITS 0.00 255.0 /end CHARACTERISTIC
/begin CHARACTERISTIC EBFCD_tECUXLow_C "Minimum value for the input of the hysteresis" VALUE 0xCF92A Kw_Ws16 250.0000 Temp_Cels -50.1400 199.8600 FORMAT "%8.4" EXTENDED_LIMITS -3549.940 3003.560 /end CHARACTERISTIC
/begin CHARACTERISTIC EBFCD_tECUXHigh_C "Maximum value for the input of the hysteresis" VALUE 0xCF92C Kw_Ws16 250.0000 Temp_Cels -50.1400 199.8600 FORMAT "%8.4" EXTENDED_LIMITS -3549.940 3003.560 /end CHARACTERISTIC
/begin CHARACTERISTIC EBFCD_stECUYLow_C "Minimum value for the output of the hysteresis" VALUE 0xCF92E Kw_Ws16 1.000000 OneToOne 0.00 1.000000 FORMAT "%8.6" EXTENDED_LIMITS -32768.00 32767.00 /end CHARACTERISTIC
/begin CHARACTERISTIC EBFCD_stECUYHigh_C "Maximum value for the output of the hysteresis" VALUE 0xCF930 Kw_Ws16 1.000000 OneToOne 0.00 1.000000 FORMAT "%8.6" EXTENDED_LIMITS -32768.00 32767.00 /end CHARACTERISTIC
/begin CHARACTERISTIC EBFCD_tiBtwTst_C "Zeitabstand, in dem die Endstufe im Fehlerfall getestet wird" VALUE 0xCF932 Kw_Wu16 29980.00 Time_ms 20.00000 30000.00 FORMAT "%8.2" EXTENDED_LIMITS 0.00 655350.0 /end CHARACTERISTIC
/begin CHARACTERISTIC EBFCD_tiPwrStgOn_C "Zeit für welche die Endstufe im Fehlerfall eingeschalten wird (nur nicht SPI kontrolliert)" VALUE 0xCF934 Kw_Wu16 655140.0 Time_ms 0.00 655140.0 FORMAT "%8.1" EXTENDED_LIMITS 0.00 655350.0 /end CHARACTERISTIC
/begin CHARACTERISTIC EBTSCD_uSRCMin_C "#SSD min. value of SRC" VALUE 0xCF938 Kw_Ws16 5200.391 Volt 0.00 5200.391 FORMAT "%8.3" EXTENDED_LIMITS -160156.4 160151.5 /end CHARACTERISTIC
/begin CHARACTERISTIC EBTSCD_uSRCMax_C "#SSD max. value of SRC" VALUE 0xCF93A Kw_Ws16 5200.391 Volt 0.00 5200.391 FORMAT "%8.3" EXTENDED_LIMITS -160156.4 160151.5 /end CHARACTERISTIC
/begin CHARACTERISTIC EBTSCD_tLin_CUR "#SSD curve for linearisation in EBTSCD" CURVE 0xCF93C Kl_Xs16_Ws16 250.0000 Temp_Cels -50.14000 199.8600 FORMAT "%8.4" EXTENDED_LIMITS -3549.940 3003.560
 /begin AXIS_DESCR STD_AXIS EBTSCD_uRawTECU_mp Volt 5 0.00 5200.391 FORMAT "%8.3" EXTENDED_LIMITS -160156.4 160151.5 DEPOSIT ABSOLUTE /end AXIS_DESCR
/end CHARACTERISTIC
/begin CHARACTERISTIC EBTSCD_OvrDebSRCHighDef_C "#SSD Error debounce time for Over temperature error" VALUE 0xCF952 Kw_Wu16 655350.0 Time_ms 0.00 655350.0 FORMAT "%8.1" /end CHARACTERISTIC
/begin CHARACTERISTIC EBTSCD_OvrDebSRCHighOk_C "#SSD Healing debounce time for over temperature  error" VALUE 0xCF954 Kw_Wu16 655350.0 Time_ms 0.00 655350.0 FORMAT "%8.1" /end CHARACTERISTIC
/begin CHARACTERISTIC EBTSCD_DebSRCHighDef_C "#SSD Error debounce time for SRC-High error" VALUE 0xCF956 Kw_Wu16 655350.0 Time_ms 0.00 655350.0 FORMAT "%8.1" /end CHARACTERISTIC
/begin CHARACTERISTIC EBTSCD_DebSRCHighOk_C "#SSD Healing debounce time for SRC-High error" VALUE 0xCF958 Kw_Wu16 655350.0 Time_ms 0.00 655350.0 FORMAT "%8.1" /end CHARACTERISTIC
/begin CHARACTERISTIC EBTSCD_DebSRCLowDef_C "#SSD Error debounce time for SRC-Low error" VALUE 0xCF95A Kw_Wu16 655350.0 Time_ms 0.00 655350.0 FORMAT "%8.1" /end CHARACTERISTIC
/begin CHARACTERISTIC EBTSCD_DebSRCLowOk_C "#SSD Healing debounce time for SRC-Low error" VALUE 0xCF95C Kw_Wu16 655350.0 Time_ms 0.00 655350.0 FORMAT "%8.1" /end CHARACTERISTIC
/begin CHARACTERISTIC EBTSCD_numAdc_C "#SSD application parameter for ECU temperature" VALUE 0xCF95E Kw_Wu8 26.0000000000 NumPinAdc 0.00 26.0000000000 FORMAT "%13.10" /end CHARACTERISTIC
/begin CHARACTERISTIC EBTSCD_dtRmpSlpUp_C "#SSD ramp slope up" VALUE 0xCF960 Kw_Wu32 6553598.99749 RmpTemp 1.00097656250 6553599.99847 FORMAT "%13.5" EXTENDED_LIMITS 0.00 6553599.99847 /end CHARACTERISTIC
/begin CHARACTERISTIC EBTSCD_dtRmpSlpDwn_C "#SSD ramp slope down" VALUE 0xCF964 Kw_Wu32 6553598.99749 RmpTemp 1.00097656250 6553599.99847 FORMAT "%13.5" EXTENDED_LIMITS 0.00 6553599.99847 /end CHARACTERISTIC
/begin CHARACTERISTIC EBTSCD_tiTECUPT1_C "#SSD Time constant of PT1 delay element" VALUE 0xCF968 Kw_Wu32 4294.9663 TimeDelay_s 0.0010000001 4294.9673 FORMAT "%9.4" EXTENDED_LIMITS 0.0000010000000 4294.9673 /end CHARACTERISTIC
/begin CHARACTERISTIC EBTSCD_tOvrTemp_C "#SSD over temperature threshold" VALUE 0xCF96C Kw_Ws16 250.0000 Temp_Cels -50.1400 199.8600 FORMAT "%8.4" EXTENDED_LIMITS -3549.940 3003.560 /end CHARACTERISTIC
/begin CHARACTERISTIC EBTSCD_stSensIDWord_C "#SSD ID-Word for transition stage" VALUE 0xCF96E Kw_Wu16 65535.00 OneToOne 0.00 65535.00 FORMAT "%8.2" /end CHARACTERISTIC
/begin CHARACTERISTIC EBTSCD_tDfl_C "#SSD default value if error occurs" VALUE 0xCF970 Kw_Ws16 250.0000 Temp_Cels -50.14000 199.8600 FORMAT "%8.4" EXTENDED_LIMITS -3549.940 3003.560 /end CHARACTERISTIC
/begin CHARACTERISTIC ECBCD_ctPwrStgOnMax_C "Maximum number of powerstage switch on per driving cycle in case of SCB or excess temperature" VALUE 0xCF974 Kw_Wu16 65535.00 OneToOne 0.00 65535.00 FORMAT "%8.2" /end CHARACTERISTIC
/begin CHARACTERISTIC ECBCD_numDia_C "Parameter zur Pin-Auswahl der Hardware-Diagnose" VALUE 0xCF976 Kw_Wu8 27.0000000000 NumPinDia 0.00 27.0000000000 FORMAT "%13.10" /end CHARACTERISTIC
/begin CHARACTERISTIC ECBCD_numDioOut_C "application parameter for selecting  EGR Bypass Valve power stages" VALUE 0xCF977 Kw_Wu8 11.0000000000 NumPinDioOut 0.00 11.0000000000 FORMAT "%13.10" /end CHARACTERISTIC
/begin CHARACTERISTIC ECBCD_stInvOut_C "Invertierungsparameter für das Signal des ECB-Ventil-Stellers" VALUE 0xCF978 Kw_Wu8 1.000 OneToOne 0.00 1.000 FORMAT "%5.3" EXTENDED_LIMITS 0.00 255.0 /end CHARACTERISTIC
/begin CHARACTERISTIC ECBCD_stOutActv_C "Parameter, der Digital 1 vertritt" VALUE 0xCF979 Kw_Wu8 255.0 OneToOne 0.00 255.0 FORMAT "%5.1" /end CHARACTERISTIC
/begin CHARACTERISTIC ECBCD_stOutInActv_C "Parameter, der Digital 0 vertritt" VALUE 0xCF97A Kw_Wu8 255.0 OneToOne 0.00 255.0 FORMAT "%5.1" /end CHARACTERISTIC
/begin CHARACTERISTIC ECBCD_stPwrStgActv_C "Aktivierung der Abschaltbedingungen der Endstufe" VALUE 0xCF97B Kw_Wu8 255.0 OneToOne 0.00 255.0 FORMAT "%5.1" /end CHARACTERISTIC
/begin CHARACTERISTIC ECBCD_stPwrStgDia_C "Aktivierung der Abschaltbedingungen der Endstufendiagnose" VALUE 0xCF97C Kw_Wu8 255.0 OneToOne 0.00 255.0 FORMAT "%5.1" /end CHARACTERISTIC
/begin CHARACTERISTIC ECBCD_stSPICtl_C "Parameter to indicate the type of powerstage used ( 1 = SPI controllable powerstage, 0 = Non SPI powerstage)" VALUE 0xCF97D Kw_Wu8 1.000 OneToOne 0.00 1.000 FORMAT "%5.3" EXTENDED_LIMITS 0.00 255.0 /end CHARACTERISTIC
/begin CHARACTERISTIC ECBCD_tiBtwTst_C "Zeitabstand, in dem im Fehlerfall die Endstufe getestet wird" VALUE 0xCF97E Kw_Wu16 29980.00 Time_ms 20.00000 30000.00 FORMAT "%8.2" EXTENDED_LIMITS 0.00 655350.0 /end CHARACTERISTIC
/begin CHARACTERISTIC ECBCD_tiDebExcTempDef_C "Fehlerentprellzeit für Übertemperatur" VALUE 0xCF980 Kw_Wu16 655350.0 Time_ms 0.00 655350.0 FORMAT "%8.1" /end CHARACTERISTIC
/begin CHARACTERISTIC ECBCD_tiDebExcTempOk_C "Heilungsentprellzeit für Übertemperatur" VALUE 0xCF982 Kw_Wu16 655350.0 Time_ms 0.00 655350.0 FORMAT "%8.1" /end CHARACTERISTIC
/begin CHARACTERISTIC ECBCD_tiDebNoLoadDef_C "Fehlerentprellzeit für Lastabfall" VALUE 0xCF984 Kw_Wu16 655350.0 Time_ms 0.00 655350.0 FORMAT "%8.1" /end CHARACTERISTIC
/begin CHARACTERISTIC ECBCD_tiDebNoLoadOk_C "Heilungsentprellzeit für Lastabfall" VALUE 0xCF986 Kw_Wu16 655350.0 Time_ms 0.00 655350.0 FORMAT "%8.1" /end CHARACTERISTIC
/begin CHARACTERISTIC ECBCD_tiDebShortCircBatDef_C "Fehlerentprellzeit für Kurzschluß nach Batterie" VALUE 0xCF988 Kw_Wu16 655350.0 Time_ms 0.00 655350.0 FORMAT "%8.1" /end CHARACTERISTIC
/begin CHARACTERISTIC ECBCD_tiDebShortCircBatOk_C "Heilungsentprellzeit für Kurzschluß nach Batterie" VALUE 0xCF98A Kw_Wu16 655350.0 Time_ms 0.00 655350.0 FORMAT "%8.1" /end CHARACTERISTIC
/begin CHARACTERISTIC ECBCD_tiDebShortCircGndDef_C "Fehlerentprellzeit für Kurzschluss nach Masse" VALUE 0xCF98C Kw_Wu16 655350.0 Time_ms 0.00 655350.0 FORMAT "%8.1" /end CHARACTERISTIC
/begin CHARACTERISTIC ECBCD_tiDebShortCircGndOk_C "Heilungsentprellzeit für Kurzschluss nach Masse" VALUE 0xCF98E Kw_Wu16 655350.0 Time_ms 0.00 655350.0 FORMAT "%8.1" /end CHARACTERISTIC
/begin CHARACTERISTIC ECBCD_tiPwrStgOn_C "Time for which the powerstage is switched on in case of non SPI powerstage" VALUE 0xCF990 Kw_Wu16 655140.0 Time_ms 0.00 655140.0 FORMAT "%8.1" EXTENDED_LIMITS 0.00 655350.0 /end CHARACTERISTIC
/begin CHARACTERISTIC ECU_vPrgThres_C "#SSD obere Geschwindigkeitsgrenze für die FLASH Programmierung" VALUE 0xCF992 Kw_Ws16 327.6700 Vel 0.00 327.6700 FORMAT "%8.4" EXTENDED_LIMITS -327.6800 327.6700 /end CHARACTERISTIC
/begin CHARACTERISTIC EEPCD_stMILDfl_C "Vorgabezewert für MIL von EEPCD defekt" VALUE 0xCF994 Kw_Wu8 1.000 OneToOne 0.00 1.000 FORMAT "%5.3" EXTENDED_LIMITS 0.00 255.0 /end CHARACTERISTIC
/begin CHARACTERISTIC EGPpCD_ctPwrStgOnMax_C "Maximaler Zähler für Powerstage On im Fehlerfall" VALUE 0xCFBF8 Kw_Wu16 65535.00 OneToOne 0.00 65535.00 FORMAT "%8.2" /end CHARACTERISTIC
/begin CHARACTERISTIC EGPpCD_numDia_C "#SSD Application parameter for Exhaust gas pressure pump actuator diagnostic signal" VALUE 0xCFBFA Kw_Wu8 27.0000000000 NumPinDia 0.00 27.0000000000 FORMAT "%13.10" /end CHARACTERISTIC
/begin CHARACTERISTIC EGPpCD_numDioOut_C "#SSD Application parameter for Exhaust gas pressure pump actuator output pin" VALUE 0xCFBFB Kw_Wu8 11.0000000000 NumPinDioOut 0.00 11.0000000000 FORMAT "%13.10" /end CHARACTERISTIC
/begin CHARACTERISTIC EGPpCD_stInvOut_C "Digital output invert information for Exhaust gas pressure pump actuator" VALUE 0xCFBFC Kw_Wu8 1.000 OneToOne 0.00 1.000 FORMAT "%5.3" EXTENDED_LIMITS 0.00 255.0 /end CHARACTERISTIC
/begin CHARACTERISTIC EGPpCD_stPwrStgActv_C "Status word for deactivation of the powerstage diagnostics" VALUE 0xCFBFD Kw_Wu8 255.0 OneToOne 0.00 255.0 FORMAT "%5.1" /end CHARACTERISTIC
/begin CHARACTERISTIC EGPpCD_stSPICtl_C "Schalter ob Endstufe SPI kontrollierbar = 1 oder nicht SPI kontrollierbar = 0" VALUE 0xCFBFE Kw_Wu8 1.000 OneToOne 0.00 1.000 FORMAT "%5.3" EXTENDED_LIMITS 0.00 255.0 /end CHARACTERISTIC
/begin CHARACTERISTIC EGPpCD_tiBtwTst_C "Zeitabstand, in dem die Endstufe im Fehlerfall getestet wird" VALUE 0xCFC00 Kw_Wu16 655140.0 Time_ms 0.00 655140.0 FORMAT "%8.1" EXTENDED_LIMITS 0.00 655350.0 /end CHARACTERISTIC
/begin CHARACTERISTIC EGPpCD_tiDebExcTempDef_C "Debounce duration for excess temperature error detection" VALUE 0xCFC02 Kw_Wu16 655350.0 Time_ms 0.00 655350.0 FORMAT "%8.1" /end CHARACTERISTIC
/begin CHARACTERISTIC EGPpCD_tiDebExcTempOk_C "Debounce duration for excess temperature error healing" VALUE 0xCFC04 Kw_Wu16 655350.0 Time_ms 0.00 655350.0 FORMAT "%8.1" /end CHARACTERISTIC
/begin CHARACTERISTIC EGPpCD_tiDebNoLoadDef_C "Debounce duration for no load error detection" VALUE 0xCFC06 Kw_Wu16 655350.0 Time_ms 0.00 655350.0 FORMAT "%8.1" /end CHARACTERISTIC
/begin CHARACTERISTIC EGPpCD_tiDebNoLoadOk_C "Debounce duration for no load error healing" VALUE 0xCFC08 Kw_Wu16 655350.0 Time_ms 0.00 655350.0 FORMAT "%8.1" /end CHARACTERISTIC
/begin CHARACTERISTIC EGPpCD_tiDebShortCircBatDef_C "Debounce duration for short circuit to battery error detection" VALUE 0xCFC0A Kw_Wu16 655350.0 Time_ms 0.00 655350.0 FORMAT "%8.1" /end CHARACTERISTIC
/begin CHARACTERISTIC EGPpCD_tiDebShortCircBatOk_C "Debounce duration for short circuit to battery error healing" VALUE 0xCFC0C Kw_Wu16 655350.0 Time_ms 0.00 655350.0 FORMAT "%8.1" /end CHARACTERISTIC
/begin CHARACTERISTIC EGPpCD_tiDebShortCircGndDef_C "Debounce duration for short circuit to ground error detection" VALUE 0xCFC0E Kw_Wu16 655350.0 Time_ms 0.00 655350.0 FORMAT "%8.1" /end CHARACTERISTIC
/begin CHARACTERISTIC EGPpCD_tiDebShortCircGndOk_C "Debounce duration for short circuit to ground error healing" VALUE 0xCFC10 Kw_Wu16 655350.0 Time_ms 0.00 655350.0 FORMAT "%8.1" /end CHARACTERISTIC
/begin CHARACTERISTIC EGPpCD_tiPwrStgOn_C "Zeit für welche die Endstufe im Fehlerfall eingeschalten wird (nur nicht SPI kontrolliert)" VALUE 0xCFC12 Kw_Wu16 655140.0 Time_ms 0.00 655140.0 FORMAT "%8.1" EXTENDED_LIMITS 0.00 655350.0 /end CHARACTERISTIC
/begin CHARACTERISTIC EGPp_facGeoSil2_C "Geometric factor silencer" VALUE 0xCFAF4 Kw_Ws16 100.0000 Fact1 0.00 100.0000 FORMAT "%8.4" EXTENDED_LIMITS -256.0000 255.9922 /end CHARACTERISTIC
/begin CHARACTERISTIC EGPp_facGeoSil_C "geometrischer Faktor Schalldämpfer" VALUE 0xCFAF6 Kw_Ws16 100.0000 Fact1 0.00 100.0000 FORMAT "%8.4" EXTENDED_LIMITS -256.0000 255.9922 /end CHARACTERISTIC
/begin CHARACTERISTIC EGPp_facPow_CUR "Potenzfunktion für Abgasvolumenstrom" CURVE 0xCFAF8 Kl_Xs16_Ws16 250.0000 Fact1 0.00 250.0000 FORMAT "%8.4" EXTENDED_LIMITS -256.0000 255.9922 READ_ONLY
 /begin AXIS_DESCR STD_AXIS EGPp_dvolSil_mp CubMtrPerHr 11 0.00 3200.000 FORMAT "%8.3" EXTENDED_LIMITS -3276.800 3276.700 DEPOSIT ABSOLUTE /end AXIS_DESCR
/end CHARACTERISTIC
/begin CHARACTERISTIC EGPp_facRhoEta_CUR "temperaturabhängiger Dichte- und Viskositätsfaktor" CURVE 0xCFB26 Kl_Xs16_Ws16 4.000000 Fact 0.00 4.000000 FORMAT "%8.6" EXTENDED_LIMITS -4.000000 3.999878 READ_ONLY
 /begin AXIS_DESCR STD_AXIS PFlt_tPstSim Temp_Cels 9 -50.140 899.860 FORMAT "%8.3" EXTENDED_LIMITS -3549.940 3003.560 DEPOSIT ABSOLUTE /end AXIS_DESCR
/end CHARACTERISTIC
/begin CHARACTERISTIC EGPp_nAvrgLim_C "Drehzahlschwelle zur Ansteuerung der NSD-Klappe" VALUE 0xCF9A0 Kw_Ws16 6000.000 EngN 0.00 6000.000 FORMAT "%8.3" EXTENDED_LIMITS -32768.00 32767.00 /end CHARACTERISTIC
/begin CHARACTERISTIC EGPp_pPstPFlt_MAP "Druckabfallkennfeld" MAP 0xCFB4C Kf_Xs16_Ys16_Ws16 3500.0000 Pres_hPa 0.00 3500.0000 FORMAT "%8.4" EXTENDED_LIMITS -32768.00 32767.00
 /begin AXIS_DESCR STD_AXIS Eng_nAvrg EngN 8 0.00 8000.000 FORMAT "%8.3" EXTENDED_LIMITS -32768.00 32767.00 DEPOSIT ABSOLUTE /end AXIS_DESCR
 /begin AXIS_DESCR STD_AXIS InjCtl_qSetUnBal InjMassCyc 8 0.00 200.0000 FORMAT "%8.4" EXTENDED_LIMITS -327.6800 327.6700 DEPOSIT ABSOLUTE /end AXIS_DESCR
/end CHARACTERISTIC
/begin CHARACTERISTIC EGPp_tiPresFltPT1_C "PT1 Filterzeit für die Druckmodellierung im Abgasrohr" VALUE 0xCFBF0 Kw_Wu32 4294.9673 TimeDelay_s 0.0000010000000 4294.9673 FORMAT "%9.4" /end CHARACTERISTIC
/begin CHARACTERISTIC EGPp_rLogicOutNHys_C "" VALUE 0xCF9A2 Kw_Wu16 100.0000 Prc 0.00 100.0000 FORMAT "%8.4" EXTENDED_LIMITS 0.00 799.9878 /end CHARACTERISTIC
/begin CHARACTERISTIC EGPp_rLogicOutQHys_C "" VALUE 0xCF9A4 Kw_Wu16 100.0000 Prc 0.00 100.0000 FORMAT "%8.4" EXTENDED_LIMITS 0.00 799.9878 /end CHARACTERISTIC
/begin CHARACTERISTIC EGPp_stFlapRgn_MAP "Kennfeld zur Ansteuerung der NSD-Klappe wärend Regeneration" MAP 0xCF9A6 Kf_Xs16_Ys16_Ws16 1.000000 OneToOne 0.00 1.000000 FORMAT "%8.6" EXTENDED_LIMITS -32768.00 32767.00
 /begin AXIS_DESCR STD_AXIS Eng_nAvrg EngN 8 40.00000 6000.000 FORMAT "%8.3" EXTENDED_LIMITS -32768.00 32767.00 DEPOSIT ABSOLUTE /end AXIS_DESCR
 /begin AXIS_DESCR STD_AXIS InjCtl_qCurr InjMassCyc 8 0.00 200.0000 FORMAT "%8.4" EXTENDED_LIMITS -327.6800 327.6700 DEPOSIT ABSOLUTE /end AXIS_DESCR
/end CHARACTERISTIC
/begin CHARACTERISTIC EGPp_stFlap_MAP "Exhaust Gas Pump status calculation map" MAP 0xCFA4A Kf_Xs16_Ys16_Ws16 1.000000 OneToOne 0.00 1.000000 FORMAT "%8.6" EXTENDED_LIMITS -32768.00 32767.00
 /begin AXIS_DESCR STD_AXIS Eng_nAvrg EngN 8 40.00000 6000.000 FORMAT "%8.3" EXTENDED_LIMITS -32768.00 32767.00 DEPOSIT ABSOLUTE /end AXIS_DESCR
 /begin AXIS_DESCR STD_AXIS InjCtl_qCurr InjMassCyc 8 0.00 200.0000 FORMAT "%8.4" EXTENDED_LIMITS -327.6800 327.6700 DEPOSIT ABSOLUTE /end AXIS_DESCR
/end CHARACTERISTIC
/begin CHARACTERISTIC EGPp_stMskRgn_C "Maske für Regenerationsumschaltung" VALUE 0xCFAF0 Kw_Wu32 4294967295.00 OneToOne 0.00 4294967295.00 FORMAT "%13.2" /end CHARACTERISTIC
/begin CHARACTERISTIC EGPp_swtPresCalc_C "Schalter für Druckberechnung (0-Kennfeld, 1- Simulation)" VALUE 0xCFBF4 Kw_Wu8 1.000 OneToOne 0.00 1.000 FORMAT "%5.3" EXTENDED_LIMITS 0.00 255.0 /end CHARACTERISTIC
/begin CHARACTERISTIC EGRCD_ctPwrStgOnMax_C "Maximale Anzahl der aktivierung der Endstufe bei SCB und Übertemperatur Fehler" VALUE 0xCFC14 Kw_Wu16 65535.00 OneToOne 0.00 65535.00 FORMAT "%8.2" /end CHARACTERISTIC
/begin CHARACTERISTIC EGRCD_DebExcTempDef_C "#SSD Fehlerentprellzeit für Übertemperatur" VALUE 0xCFC16 Kw_Wu16 655350.0 Time_ms 0.00 655350.0 FORMAT "%8.1" /end CHARACTERISTIC
/begin CHARACTERISTIC EGRCD_DebExcTempOk_C "Heilungsentprellzeit für Übertemperatur" VALUE 0xCFC18 Kw_Wu16 655350.0 Time_ms 0.00 655350.0 FORMAT "%8.1" /end CHARACTERISTIC
/begin CHARACTERISTIC EGRCD_DebNoLoadDef_C "#SSD Fehlerentprellzeit für Lastabfall" VALUE 0xCFC1A Kw_Wu16 655350.0 Time_ms 0.00 655350.0 FORMAT "%8.1" /end CHARACTERISTIC
/begin CHARACTERISTIC EGRCD_DebNoLoadOk_C "Heilungsentprellzeit für Lastabfall" VALUE 0xCFC1C Kw_Wu16 655350.0 Time_ms 0.00 655350.0 FORMAT "%8.1" /end CHARACTERISTIC
/begin CHARACTERISTIC EGRCD_DebShortCircBatDef_C "#SSD Fehlerentprellzeit für Kurzschluß nach Batteriespannung" VALUE 0xCFC1E Kw_Wu16 655350.0 Time_ms 0.00 655350.0 FORMAT "%8.1" /end CHARACTERISTIC
/begin CHARACTERISTIC EGRCD_DebShortCircBatOk_C "Heilungsentprellzeit für Kurzschluß nach Batteriespannung" VALUE 0xCFC20 Kw_Wu16 655350.0 Time_ms 0.00 655350.0 FORMAT "%8.1" /end CHARACTERISTIC
/begin CHARACTERISTIC EGRCD_DebShortCircGndDef_C "#SSD Fehlerentprellzeit für Kurzschluß nach Masse" VALUE 0xCFC22 Kw_Wu16 655350.0 Time_ms 0.00 655350.0 FORMAT "%8.1" /end CHARACTERISTIC
/begin CHARACTERISTIC EGRCD_DebShortCircGndOk_C "Heilungsentprellzeit für Kurzschluß nach Masse" VALUE 0xCFC24 Kw_Wu16 655350.0 Time_ms 0.00 655350.0 FORMAT "%8.1" /end CHARACTERISTIC
/begin CHARACTERISTIC EGRCD_numDia_C "#SSD Applikationsparameter fuer Diagnose Signal :EGR-Steller" VALUE 0xCFC26 Kw_Wu8 27.0000000000 NumPinDia 0.00 27.0000000000 FORMAT "%13.10" /end CHARACTERISTIC
/begin CHARACTERISTIC EGRCD_numPwmOut_C "#SSD Applikationsparameter fuer EGR-Steller" VALUE 0xCFC27 Kw_Wu8 13.0000000000 NumPinPwmOut 0.00 13.0000000000 FORMAT "%13.10" /end CHARACTERISTIC
/begin CHARACTERISTIC EGRCD_stInvOut_C "Invertierungsparameter für das Signal der Abgasrückführstellerendstufe" VALUE 0xCFC28 Kw_Wu8 1.000 OneToOne 0.00 1.000 FORMAT "%5.3" EXTENDED_LIMITS 0.00 255.0 /end CHARACTERISTIC
/begin CHARACTERISTIC EGRCD_tiPer_C "Periodendauer Abgasrückführsteller" VALUE 0xCFC2A Kw_Ws16 6553.500 Period -3276.800 3276.700 FORMAT "%8.3" /end CHARACTERISTIC
/begin CHARACTERISTIC EGRCD_rCnv_MAP "Kennfeld zur konvertierung in Tastverhältnis" MAP 0xCFC2C Kf_Xs16_Ys16_Ws16 100.0000 DtyCyc 0.00 100.0000 FORMAT "%8.4" EXTENDED_LIMITS -327.6800 327.6700
 /begin AXIS_DESCR STD_AXIS Eng_nAvrg EngN 8 0.00 8000.000 FORMAT "%8.3" EXTENDED_LIMITS -32768.00 32767.00 DEPOSIT ABSOLUTE /end AXIS_DESCR
 /begin AXIS_DESCR STD_AXIS EGRVlv_rEGR Prc 8 -400.0000 399.9878 FORMAT "%8.4" DEPOSIT ABSOLUTE /end AXIS_DESCR
/end CHARACTERISTIC
/begin CHARACTERISTIC EGRCD_rOutMax_C "Maximal auszugebendes Tastverhältnis" VALUE 0xCFCD0 Kw_Ws16 655.3500 DtyCyc -327.6800 327.6700 FORMAT "%8.4" /end CHARACTERISTIC
/begin CHARACTERISTIC EGRCD_rOutMin_C "Minimal auszugebendes Tastverhältnis" VALUE 0xCFCD2 Kw_Ws16 655.3500 DtyCyc -327.6800 327.6700 FORMAT "%8.4" /end CHARACTERISTIC
/begin CHARACTERISTIC EGRCD_stPwrStgActv_C "Aktivierung der Abschaltbedingungen der Endstufe" VALUE 0xCFCD4 Kw_Wu8 255.0 OneToOne 0.00 255.0 FORMAT "%5.1" /end CHARACTERISTIC
/begin CHARACTERISTIC EGRCD_stPwrStgDia_C "#SSD Aktivierung der Abschaltbedingungen der Endstufendiagnose" VALUE 0xCFCD5 Kw_Wu8 255.0 OneToOne 0.00 255.0 FORMAT "%5.1" /end CHARACTERISTIC
/begin CHARACTERISTIC EGRCD_stSPICtl_C "0 = Non SPI powerstage )" VALUE 0xCFCD6 Kw_Wu8 1.000 OneToOne 0.00 1.000 FORMAT "%5.3" EXTENDED_LIMITS 0.00 255.0 /end CHARACTERISTIC
/begin CHARACTERISTIC EGRCD_swt_C "Schalter Batteriesspannungskorrektur (0 = AUS, 1 = EIN)" VALUE 0xCFCD7 Kw_Wu8 255.0 OneToOne 0.00 255.0 FORMAT "%5.1" /end CHARACTERISTIC
/begin CHARACTERISTIC EGRCD_tiBtwTst_C "Zeitabstand, in dem im Fehlerfall die Endstufe getestet wird" VALUE 0xCFCD8 Kw_Wu16 29980.00 Time_ms 20.00000 30000.00 FORMAT "%8.2" EXTENDED_LIMITS 0.00 655350.0 /end CHARACTERISTIC
/begin CHARACTERISTIC EGRCD_tiPwrStgOn_C "Zeit für welche die Endstufe im Fehlerfall eingeschalten wird (nur nicht SPI kontrolliert)" VALUE 0xCFCDA Kw_Wu16 655140.0 Time_ms 0.00 655140.0 FORMAT "%8.1" EXTENDED_LIMITS 0.00 655350.0 /end CHARACTERISTIC
/begin CHARACTERISTIC EGRClg_numCtlValCalc_C "Index zur Auswahl der Temperatur aus dem Motortemperaturfeld" VALUE 0xCFCDC Kw_Wu8 2.00000000000 EngTempFldSel 0.00 2.00000000000 FORMAT "%13.11" /end CHARACTERISTIC
/begin CHARACTERISTIC EGRClg_qBypOff_CUR "oberer drehzahlabhängiger Schwellwert der Einspritzmenge zum Deaktivieren des ARF-Kühler-Bypass" CURVE 0xCFCDE Kl_Xs16_Ws16 150.0000 InjMass 0.00 150.0000 FORMAT "%8.4" EXTENDED_LIMITS -327.6800 327.6700
 /begin AXIS_DESCR STD_AXIS Eng_nAvrg EngN 8 0.00 6000.000 FORMAT "%8.3" EXTENDED_LIMITS -32768.00 32767.00 DEPOSIT ABSOLUTE /end AXIS_DESCR
/end CHARACTERISTIC
/begin CHARACTERISTIC EGRClg_qBypOn_CUR "unterer drehzahlabhängiger Schwellwert der Einspritzmenge zum Aktivieren des ARF-Kühler-Bypass" CURVE 0xCFD00 Kl_Xs16_Ws16 150.0000 InjMass 0.00 150.0000 FORMAT "%8.4" EXTENDED_LIMITS -327.6800 327.6700
 /begin AXIS_DESCR STD_AXIS Eng_nAvrg EngN 8 0.00 6000.000 FORMAT "%8.3" EXTENDED_LIMITS -32768.00 32767.00 DEPOSIT ABSOLUTE /end AXIS_DESCR
/end CHARACTERISTIC
/begin CHARACTERISTIC EGRClg_stDflVal_C "Ersatzwertauswahl für die Ansteuerung des ARF-Kühler-Bypasses im Fehlerfall" VALUE 0xCFD22 Kw_Wu8 255.0 OneToOne 0.00 255.0 FORMAT "%5.1" /end CHARACTERISTIC
/begin CHARACTERISTIC EGRClg_stRgnMsk_C "Bit mask for regeneration demand of exhaust gas treatment" VALUE 0xCFD24 Kw_Wu32 4294967295.00 OneToOne 0.00 4294967295.00 FORMAT "%13.2" /end CHARACTERISTIC
/begin CHARACTERISTIC EGRClg_tBypOff_C "oberer Schwellwert der Temperatur aus dem Motortemperaturfeld zum Deaktivieren des ARF-Kühler-Bypass" VALUE 0xCFD28 Kw_Ws16 250.0000 Temp_Cels -50.14000 199.8600 FORMAT "%8.4" EXTENDED_LIMITS -3549.940 3003.560 /end CHARACTERISTIC
/begin CHARACTERISTIC EGRClg_tBypOn_C "unterer Schwellwert der Temperatur aus dem Motortemperaturfeld zum Aktivieren des ARF-Kühler-Bypass" VALUE 0xCFD2A Kw_Ws16 250.0000 Temp_Cels -50.14000 199.8600 FORMAT "%8.4" EXTENDED_LIMITS -3549.940 3003.560 /end CHARACTERISTIC
/begin CHARACTERISTIC EGRClg_tCldStrtThres_C "Temperatur-Schwellwert für Kaltstarterkennung" VALUE 0xCFD2C Kw_Ws16 250.0000 Temp_Cels -50.14000 199.8600 FORMAT "%8.4" EXTENDED_LIMITS -3549.940 3003.560 /end CHARACTERISTIC
/begin CHARACTERISTIC EGRClg_tIATBypOff_C "oberer Schwellwert der LuftTemperatur zum Deaktivieren des ARF-Kühler-Bypass" VALUE 0xCFD2E Kw_Ws16 250.0000 Temp_Cels -50.14000 199.8600 FORMAT "%8.4" EXTENDED_LIMITS -3549.940 3003.560 /end CHARACTERISTIC
/begin CHARACTERISTIC EGRClg_tIATBypOn_C "unterer Schwellwert der LuftTemperatur zum Aktivieren des ARF-Kühler-Bypass" VALUE 0xCFD30 Kw_Ws16 250.0000 Temp_Cels -50.14000 199.8600 FORMAT "%8.4" EXTENDED_LIMITS -3549.940 3003.560 /end CHARACTERISTIC
/begin CHARACTERISTIC EGRClg_tiCldStrt_C "Zeit für Aktivierung des ARF-Kühler-Bypasses bei Kaltstart" VALUE 0xCFD32 Kw_Wu16 300.0000 Time_s 0.00 300.0000 FORMAT "%8.4" EXTENDED_LIMITS 0.00 655.3500 /end CHARACTERISTIC
/begin CHARACTERISTIC EGRVlv_rEGR2_Vector "#SSD Bypass-Label for exhaust gas recirculation coordinator2" VALUE 0xC393A Kw_Wu8 255.0 OneToOne 0.00 255.0 FORMAT "%5.1" /end CHARACTERISTIC
/begin CHARACTERISTIC EGRVlv_rEGR2_Channel "#SSD Bypass-Label for exhaust gas recirculation coordinator2" VALUE 0xC393B Kw_Wu8 255.0 OneToOne 0.00 255.0 FORMAT "%5.1" /end CHARACTERISTIC
/begin CHARACTERISTIC EGRVlv_rEGR_Vector "#SSD Bypass-Label für EGRVlv_rEGR" VALUE 0xC393C Kw_Wu8 255.0 OneToOne 0.00 255.0 FORMAT "%5.1" /end CHARACTERISTIC
/begin CHARACTERISTIC EGRVlv_rEGR_Channel "#SSD Bypass-Label für EGRVlv_rEGR" VALUE 0xC393D Kw_Wu8 255.0 OneToOne 0.00 255.0 FORMAT "%5.1" /end CHARACTERISTIC
/begin CHARACTERISTIC EGSys_CalValFl_C "Unterer Heizwert Kraftstoff" VALUE 0xD040C Kw_Wu16 6553500. Calory 0.00 6553500. FORMAT "%8.0" /end CHARACTERISTIC
/begin CHARACTERISTIC EGSys_cndHtEG_CUR "Wärmeleitfähigkeit Abgas (nicht applizierbar)" CURVE 0xCFF40 Kl_Xs16_Ws16 1.000000 Fact 0.00 1.000000 FORMAT "%8.6" EXTENDED_LIMITS -4.000000 3.999878 READ_ONLY
 /begin AXIS_DESCR STD_AXIS EGSys_tEGLSUInpCrv0_mp Temp_Cels 8 -50.140 899.860 FORMAT "%8.3" EXTENDED_LIMITS -3549.940 3003.560 DEPOSIT ABSOLUTE /end AXIS_DESCR
/end CHARACTERISTIC
/begin CHARACTERISTIC EGSys_cpEG_MAP "Wärmekapazität Abgas (nicht applizierbar)" MAP 0xCFF62 Kf_Xs16_Ys16_Ws16 2.000000 SpecificHeat 0.00 2.000000 FORMAT "%8.6" EXTENDED_LIMITS -3.276800 3.276700 READ_ONLY
 /begin AXIS_DESCR STD_AXIS EGSys_tEGLSUInpCrv0_mp Temp_Cels 6 -50.140 899.860 FORMAT "%8.3" EXTENDED_LIMITS -3549.940 3003.560 DEPOSIT ABSOLUTE /end AXIS_DESCR
 /begin AXIS_DESCR STD_AXIS EGSys_rLmbdAprx lambda 6 -30.00000 30.00000 FORMAT "%8.5" EXTENDED_LIMITS -32.76800 32.76700 DEPOSIT ABSOLUTE /end AXIS_DESCR
/end CHARACTERISTIC
/begin CHARACTERISTIC EGSys_cpNSC_C "Wärmekapazität NSC" VALUE 0xD035C Kw_Ws16 2999.900 HeatCapacity 0.1000000 3000.000 FORMAT "%8.3" EXTENDED_LIMITS -3276.800 3276.700 /end CHARACTERISTIC
/begin CHARACTERISTIC EGSys_cpOxiCat_C "Wärmekapazität Oxidationskatalysator" VALUE 0xD040E Kw_Ws16 2999.900 HeatCapacity 0.1000000 3000.000 FORMAT "%8.3" EXTENDED_LIMITS -3276.800 3276.700 /end CHARACTERISTIC
/begin CHARACTERISTIC EGSys_dmAir_MAP "Kennfeld zur Ermittlung Luftmassenstrom im Auslegungspunkt (zur Temperaturkorrektur)" MAP 0xD001C Kf_Xs16_Ys16_Ws16 1000.000 AirMassPerTime 0.00 1000.000 FORMAT "%8.3" EXTENDED_LIMITS -3276.800 3276.700
 /begin AXIS_DESCR STD_AXIS Eng_nAvrg EngN 8 0.00 8000.000 FORMAT "%8.3" EXTENDED_LIMITS -32768.00 32767.00 DEPOSIT ABSOLUTE /end AXIS_DESCR
 /begin AXIS_DESCR STD_AXIS InjCtl_qCurr InjMassCyc 8 0.00 100.0000 FORMAT "%8.4" EXTENDED_LIMITS -327.6800 327.6700 DEPOSIT ABSOLUTE /end AXIS_DESCR
/end CHARACTERISTIC
/begin CHARACTERISTIC EGSys_dmEGMinVal_C "Kleinstwert Abgasmassenstrom für thermische Modellierung" VALUE 0xCFFC6 Kw_Ws16 1000.000 AirMassPerTime 0.00 1000.000 FORMAT "%8.3" EXTENDED_LIMITS -3276.800 3276.700 /end CHARACTERISTIC
/begin CHARACTERISTIC EGSys_dmPlsThresLSU_C "Minimaler Massenstrom für gültigen Gasstoß" VAL_BLK 0xCFD34 Kwb_Ws16 1000.000 AirMassPerTime 0.00 1000.000 FORMAT "%8.3" EXTENDED_LIMITS -3276.800 3276.700 NUMBER 1 /end CHARACTERISTIC
/begin CHARACTERISTIC EGSys_dpExhGas_MAP "Kennfeld für Abgasgegendruck" MAP 0xCFE48 Kf_Xs16_Ys16_Ws16 65535.00 Pres_hPa -32768.00 32767.00 FORMAT "%8.2"
 /begin AXIS_DESCR STD_AXIS Eng_nAvrg EngN 10 -32768.00 32767.00 FORMAT "%8.2" DEPOSIT ABSOLUTE /end AXIS_DESCR
 /begin AXIS_DESCR STD_AXIS InjCtl_qSetUnBal InjMassCyc 10 -327.6800 327.6700 FORMAT "%8.4" DEPOSIT ABSOLUTE /end AXIS_DESCR
/end CHARACTERISTIC
/begin CHARACTERISTIC EGSys_facAirMass_CUR "Kennlinie zur Luftmassenabhängigen Temperaturkorrektur" CURVE 0xD00C0 Kl_Xs16_Ws16 2.000000 Fact 0.00 2.000000 FORMAT "%8.6" EXTENDED_LIMITS -4.000000 3.999878
 /begin AXIS_DESCR STD_AXIS EGSys_rAirPerTime_mp Fact 8 0.00 8.000000 FORMAT "%8.6" EXTENDED_LIMITS -4.000000 3.999878 DEPOSIT ABSOLUTE /end AXIS_DESCR
/end CHARACTERISTIC
/begin CHARACTERISTIC EGSys_facCldStrtLSU_C "Faktor für Schwellwerterhöhung bei wiederholtem Kaltstart" VAL_BLK 0xCFD36 Kwb_Ws16 1.000000 Fact 0.00 1.000000 FORMAT "%8.6" EXTENDED_LIMITS -4.000000 3.999878 NUMBER 1 /end CHARACTERISTIC
/begin CHARACTERISTIC EGSys_facCorrCldEng_CUR "Kennlinie zur Abgastemperatur-Korrektur beim kaltem Motor" CURVE 0xD00E2 Kl_Xs16_Ws16 2.000000 Fact 0.00 2.000000 FORMAT "%8.6" EXTENDED_LIMITS -4.000000 3.999878
 /begin AXIS_DESCR STD_AXIS EGSys_tDiffCldEng_mp TempDiff_Cels 8 -3276.800 3276.700 FORMAT "%8.3" DEPOSIT ABSOLUTE /end AXIS_DESCR
/end CHARACTERISTIC
/begin CHARACTERISTIC EGSys_facIAT_CUR "Kennlinie zur ansauglufttemperaturabhängigen Korrektur der Abgastemperatur" CURVE 0xD0104 Kl_Xs16_Ws16 2.000000 Fact 0.00 2.000000 FORMAT "%8.6" EXTENDED_LIMITS -4.000000 3.999878
 /begin AXIS_DESCR STD_AXIS EGSys_tDiffIAT_mp TempDiff_Cels 8 -3276.800 3276.700 FORMAT "%8.3" DEPOSIT ABSOLUTE /end AXIS_DESCR
/end CHARACTERISTIC
/begin CHARACTERISTIC EGSys_facPlsLSU_C "Faktor für Abnahme der Wärmeschwelle bei gültigem Gasstoß" VAL_BLK 0xCFD38 Kwb_Ws16 1.000000 Fact 0.00 1.000000 FORMAT "%8.6" EXTENDED_LIMITS -4.000000 3.999878 NUMBER 1 /end CHARACTERISTIC
/begin CHARACTERISTIC EGSys_facPlsThresLSU_C "minimaler Wärmemengenschwellwert zur Aktivierung der Gasstoß-Erkennung" VAL_BLK 0xCFD3A Kwb_Ws16 1.000000 Fact 0.00 1.000000 FORMAT "%8.6" EXTENDED_LIMITS -4.000000 3.999878 NUMBER 1 /end CHARACTERISTIC
/begin CHARACTERISTIC EGSys_facStrtDlv_CUR "Kennlinie zur Förderbeginnabhängigen Temperaturkorrektur" CURVE 0xD0126 Kl_Xs16_Ws16 2.000000 Fact 0.00 2.000000 FORMAT "%8.6" EXTENDED_LIMITS -4.000000 3.999878
 /begin AXIS_DESCR STD_AXIS EGSys_phiDiffStrt_mp AngleCrS 8 -49.99219 49.99219 FORMAT "%8.5" EXTENDED_LIMITS -768.0000 767.9766 DEPOSIT ABSOLUTE /end AXIS_DESCR
/end CHARACTERISTIC
/begin CHARACTERISTIC EGSys_facTempCmb_CUR "Temperaturabhängiger Faktor zur Korrektur der im Oxidationskatalysator abreagierenden Kraftstoffmasse" CURVE 0xD0410 Kl_Xs16_Ws16 2.000000 Fact 0.00 2.000000 FORMAT "%8.6" EXTENDED_LIMITS -4.000000 3.999878
 /begin AXIS_DESCR STD_AXIS EGSys_tAvrgOxiCat_mp Temp_Cels 8 -50.140 899.860 FORMAT "%8.3" EXTENDED_LIMITS -3549.940 3003.560 DEPOSIT ABSOLUTE /end AXIS_DESCR
/end CHARACTERISTIC
/begin CHARACTERISTIC EGSys_tiPT1NSC_C "Feste thermische Zeitkonstante zur NSC-Modellierung" VALUE 0xD0360 Kw_Wu32 4294.9663 TimeDelay_s 0.0010000001 4294.9673 FORMAT "%9.4" EXTENDED_LIMITS 0.0000010000000 4294.9673 /end CHARACTERISTIC
/begin CHARACTERISTIC EGSys_numECU_C "Anzahl der Steuergeräte" VALUE 0xCFFC8 Kw_Wu8 254.0 OneToOne 1.000 255.0 FORMAT "%5.1" EXTENDED_LIMITS 0.00 255.0 /end CHARACTERISTIC
/begin CHARACTERISTIC EGSys_numMaxCldStrt_C "Maximale Anzahl der zu zählenden Kaltstarts" VAL_BLK 0xCFD3C Kwb_Wu8 10.00 OneToOne 0.00 10.00 FORMAT "%5.2" EXTENDED_LIMITS 0.00 255.0 NUMBER 1 /end CHARACTERISTIC
/begin CHARACTERISTIC EGSys_numRdPosLSU2_C "Leseindex im Temperaturarray für Abgastemperatur(en) am Sensoreinbauort (im Fehlerfall)" VAL_BLK 0xCFFC9 Kwb_Wu8 12.00 OneToOne 0.00 12.00 FORMAT "%5.2" EXTENDED_LIMITS 0.00 255.0 NUMBER 1 /end CHARACTERISTIC
/begin CHARACTERISTIC EGSys_numRdPosLSUWall_C "Leseindex der Rohrwandtemperatur im Temperaturarray" VAL_BLK 0xCFFCA Kwb_Wu8 14.00 OneToOne 0.00 14.00 FORMAT "%5.2" EXTENDED_LIMITS 0.00 255.0 NUMBER 1 /end CHARACTERISTIC
/begin CHARACTERISTIC EGSys_numRdPosLSU_C "Leseindex im Temperaturarray für Abgastemperatur(en) am Sensoreinbauort" VAL_BLK 0xCFFCB Kwb_Wu8 12.00 OneToOne 0.00 12.00 FORMAT "%5.2" EXTENDED_LIMITS 0.00 255.0 NUMBER 1 /end CHARACTERISTIC
/begin CHARACTERISTIC EGSys_numRdPosNSC2_C "Leseindex im Temperaturarray für NSC Einlaßtemperatur (im Fehlerfall)" VALUE 0xCFFCC Kw_Wu8 12.00 OneToOne 0.00 12.00 FORMAT "%5.2" EXTENDED_LIMITS 0.00 255.0 /end CHARACTERISTIC
/begin CHARACTERISTIC EGSys_numRdPosNSC_C "Leseindex im Temperaturarray für NSC Einlaßtemperatur" VALUE 0xCFFCD Kw_Wu8 12.00 OneToOne 0.00 12.00 FORMAT "%5.2" EXTENDED_LIMITS 0.00 255.0 /end CHARACTERISTIC
/begin CHARACTERISTIC EGSys_numRdPosOxiCat2_C "Leseindex im Temperaturarray für Oxydations-Katalysator-Einlaßtemperatur (im Fehlerfall)" VALUE 0xCFFCE Kw_Wu8 12.00 OneToOne 0.00 12.00 FORMAT "%5.2" EXTENDED_LIMITS 0.00 255.0 /end CHARACTERISTIC
/begin CHARACTERISTIC EGSys_numRdPosOxiCat_C "Leseindex im Temperaturarray für Oxydations-Katalysator-Einlaßtemperatur" VALUE 0xCFFCF Kw_Wu8 12.00 OneToOne 0.00 12.00 FORMAT "%5.2" EXTENDED_LIMITS 0.00 255.0 /end CHARACTERISTIC
/begin CHARACTERISTIC EGSys_numRdPosTrbn2_C "Leseindex im Temperaturarray für Turbineneinlaßtemperatur (im Fehlerfall)" VALUE 0xCFFD0 Kw_Wu8 12.00 OneToOne 0.00 12.00 FORMAT "%5.2" EXTENDED_LIMITS 0.00 255.0 /end CHARACTERISTIC
/begin CHARACTERISTIC EGSys_numRdPosTrbn_C "Leseindex im Temperaturarray für Turbineneinlaßtemperatur" VALUE 0xCFFD1 Kw_Wu8 12.00 OneToOne 0.00 12.00 FORMAT "%5.2" EXTENDED_LIMITS 0.00 255.0 /end CHARACTERISTIC
/begin CHARACTERISTIC EGSys_numRdPosTube2_C "Leseindex im Temperaturarray für Rohr-Einlaßtemperaturen (im Fehlerfall)" VAL_BLK 0xCFFD2 Kwb_Wu8 12.00 OneToOne 0.00 12.00 FORMAT "%5.2" EXTENDED_LIMITS 0.00 255.0 NUMBER 2 /end CHARACTERISTIC
/begin CHARACTERISTIC EGSys_numRdPosTube_C "Leseindex im Temperaturarray für Rohr-Einlaßtemperaturen" VAL_BLK 0xCFFD4 Kwb_Wu8 12.00 OneToOne 0.00 12.00 FORMAT "%5.2" EXTENDED_LIMITS 0.00 255.0 NUMBER 2 /end CHARACTERISTIC
/begin CHARACTERISTIC EGSys_numTempThresLSU_C "Schalter zur Auswahl der Eingangstemperatur iin das Kennfeld für die Taupunktberechnung." VALUE 0xCFD3D Kw_Wu8 3.000 OneToOne 0.00 3.000 FORMAT "%5.3" EXTENDED_LIMITS 0.00 255.0 /end CHARACTERISTIC
/begin CHARACTERISTIC EGSys_tiPT1OxiCat_C "Feste thermische Zeitkonstante zur Oxidationskatalysator-Modellierung" VALUE 0xD0434 Kw_Wu32 4294.9663 TimeDelay_s 0.0010000001 4294.9673 FORMAT "%9.4" EXTENDED_LIMITS 0.0000010000000 4294.9673 /end CHARACTERISTIC
/begin CHARACTERISTIC EGSys_pConstVal_C "Normdruck" VALUE 0xCFF3C Kw_Ws16 65535.00 Pres_hPa -32768.00 32767.00 FORMAT "%8.2" READ_ONLY /end CHARACTERISTIC
/begin CHARACTERISTIC EGSys_phiStrtDlv_MAP "Kennfeld zur Ermittlung Förderbeginn MI1 im Auslegungspunkt (zur Temperaturkorrektur)" MAP 0xD0148 Kf_Xs16_Ys16_Ws16 99.98437 AngleCrS -49.99219 49.99219 FORMAT "%8.5" EXTENDED_LIMITS -768.0000 767.9766
 /begin AXIS_DESCR STD_AXIS Eng_nAvrg EngN 8 0.00 8000.000 FORMAT "%8.3" EXTENDED_LIMITS -32768.00 32767.00 DEPOSIT ABSOLUTE /end AXIS_DESCR
 /begin AXIS_DESCR STD_AXIS InjCtl_qCurr InjMassCyc 8 0.00 100.0000 FORMAT "%8.4" EXTENDED_LIMITS -327.6800 327.6700 DEPOSIT ABSOLUTE /end AXIS_DESCR
/end CHARACTERISTIC
/begin CHARACTERISTIC EGSys_stOxiModActvMsk_C "Anwendung konstant Spitzen für aktiven oxicatmodus verdecken" VALUE 0xD0438 Kw_Wu32 4294967295.00 OneToOne 0.00 4294967295.00 FORMAT "%13.2" /end CHARACTERISTIC
/begin CHARACTERISTIC EGSys_swtDewDetShOff_C "Umschalter für Ersatzfunktion (Zeitapplikation) (1: Ersatzfunktion, 0: Taupunkterkennung)" VAL_BLK 0xCFD3E Kwb_Wu8 10.00 OneToOne 0.00 10.00 FORMAT "%5.2" EXTENDED_LIMITS 0.00 255.0 NUMBER 1 /end CHARACTERISTIC
/begin CHARACTERISTIC EGSys_swtPresSel_C "Auswahl, ob Atmosphaerendruck (=1) oder Druck vor Partikelfilter (=0)" VALUE 0xCFF3E Kw_Wu8 1.000 OneToOne 0.00 1.000 FORMAT "%5.3" EXTENDED_LIMITS 0.00 255.0 /end CHARACTERISTIC
/begin CHARACTERISTIC EGSys_swtTimeNSC_C "Schalter zur Verwendung fester oder variabler thermischer Zeitkonstante für NSC (1 = fest, 0 = variabel)" VALUE 0xD0364 Kw_Wu8 1.000 OneToOne 0.00 1.000 FORMAT "%5.3" EXTENDED_LIMITS 0.00 255.0 /end CHARACTERISTIC
/begin CHARACTERISTIC EGSys_tEngStat_C "Kühlmitteltemperatur (bzw Motortemperatur) betriebswarmer Motor unter normalen Bendingungen" VALUE 0xD01EC Kw_Ws16 950.000 Temp_Cels -50.140 899.860 FORMAT "%8.3" EXTENDED_LIMITS -3549.940 3003.560 /end CHARACTERISTIC
/begin CHARACTERISTIC EGSys_tExcClntDfl_C "Ersatzwert für Motor-Übertemperatur" VALUE 0xD001A Kw_Ws16 1095.000 TempDiff_Cels -45.00000 1050.000 FORMAT "%8.3" EXTENDED_LIMITS -3276.800 3276.700 /end CHARACTERISTIC
/begin CHARACTERISTIC EGSys_tIAT_MAP "Kennfeld Ansauglufttemperatur im Auslegungspunkt zur Korrektur der stationären Krümmeraustrittstemperatur" MAP 0xD01EE Kf_Xs16_Ys16_Ws16 950.000 Temp_Cels -50.140 899.860 FORMAT "%8.3" EXTENDED_LIMITS -3549.940 3003.560
 /begin AXIS_DESCR STD_AXIS Eng_nAvrg EngN 8 0.00 8000.000 FORMAT "%8.3" EXTENDED_LIMITS -32768.00 32767.00 DEPOSIT ABSOLUTE /end AXIS_DESCR
 /begin AXIS_DESCR STD_AXIS InjCtl_qCurr InjMassCyc 8 0.00 100.0000 FORMAT "%8.4" EXTENDED_LIMITS -327.6800 327.6700 DEPOSIT ABSOLUTE /end AXIS_DESCR
/end CHARACTERISTIC
/begin CHARACTERISTIC EGSys_tiDebLSU0_C "Entprellzeit Heizungsfreigabe Lambdasonde 0" VAL_BLK 0xCFD40 Kwb_Wu16 20.00000 Time_s 0.00 20.00000 FORMAT "%8.5" EXTENDED_LIMITS 0.00 655.3500 NUMBER 1 /end CHARACTERISTIC
/begin CHARACTERISTIC EGSys_tiDebNrmTransOk_C "Entprellzeit zur Verzögerung der Berechnungen nach Start bis gültige Temperaturen anliegen" VALUE 0xCFD42 Kw_Ws16 1000.000 TimeDeb 0.00 1000.000 FORMAT "%8.3" EXTENDED_LIMITS -327680.0 327670.0 /end CHARACTERISTIC
/begin CHARACTERISTIC EGSys_tiHtgDelLSU_C "Verzögerung der Heizungsfreigabe im Fehlerfall" VAL_BLK 0xCFD44 Kwb_Wu32 42949672.9500 Time_s 0.00 42949672.9500 FORMAT "%13.4" NUMBER 1 /end CHARACTERISTIC
/begin CHARACTERISTIC EGSys_tIntegIni_C "Temperaturschwellwert für die Aktivierung des Wärmemengenintegrators" VAL_BLK 0xCFD48 Kwb_Ws16 250.0000 Temp_Cels -50.1400 199.8600 FORMAT "%8.4" EXTENDED_LIMITS -3549.940 3003.560 NUMBER 1 /end CHARACTERISTIC
/begin CHARACTERISTIC EGSys_tiPlsLSU_C "Minimale Dauer für gültigen Gaspuls" VAL_BLK 0xCFD4A Kwb_Wu16 20.00000 Time_s 0.00 20.00000 FORMAT "%8.5" EXTENDED_LIMITS 0.00 655.3500 NUMBER 1 /end CHARACTERISTIC
/begin CHARACTERISTIC EGSys_tManfDfl_C "Vorgabewert Abgaskrümmertemperatur im Fehlerfall" VALUE 0xD0292 Kw_Ws16 950.000 Temp_Cels -50.140 899.860 FORMAT "%8.3" EXTENDED_LIMITS -3549.940 3003.560 /end CHARACTERISTIC
/begin CHARACTERISTIC EGSys_tManfStat_MAP "Kennfeld zur Ermittlung der stationären Abgaskrümmertemperatur" MAP 0xD0294 Kf_Xs16_Ys16_Ws16 950.000 Temp_Cels -50.140 899.860 FORMAT "%8.3" EXTENDED_LIMITS -3549.940 3003.560
 /begin AXIS_DESCR STD_AXIS Eng_nAvrg EngN 10 0.00 8000.000 FORMAT "%8.3" EXTENDED_LIMITS -32768.00 32767.00 DEPOSIT ABSOLUTE /end AXIS_DESCR
 /begin AXIS_DESCR STD_AXIS InjCtl_qCurr InjMassCyc 8 0.00 100.0000 FORMAT "%8.4" EXTENDED_LIMITS -327.6800 327.6700 DEPOSIT ABSOLUTE /end AXIS_DESCR
/end CHARACTERISTIC
/begin CHARACTERISTIC EGSys_tNSCDfl_C "Ersatzwert für NSC Temperatur" VALUE 0xD0366 Kw_Ws16 950.000 Temp_Cels -50.140 899.860 FORMAT "%8.3" EXTENDED_LIMITS -3549.940 3003.560 /end CHARACTERISTIC
/begin CHARACTERISTIC EGSys_tNSCExoIncr_MAP "Kennfeld für Temperaturerhöhung im NSC aufgrund chemischer Reaktionen" MAP 0xD0368 Kf_Xs16_Ys16_Ws16 1095.000 TempDiff_Cels -45.00000 1050.000 FORMAT "%8.3" EXTENDED_LIMITS -3276.800 3276.700
 /begin AXIS_DESCR STD_AXIS EGSys_tAvrgNSC_mp Temp_Cels 8 -50.140 899.860 FORMAT "%8.3" EXTENDED_LIMITS -3549.940 3003.560 DEPOSIT ABSOLUTE /end AXIS_DESCR
 /begin AXIS_DESCR STD_AXIS EGSys_rLmbdAprx lambda 8 -30.00000 30.00000 FORMAT "%8.5" EXTENDED_LIMITS -32.76800 32.76700 DEPOSIT ABSOLUTE /end AXIS_DESCR
/end CHARACTERISTIC
/begin CHARACTERISTIC EGSys_tOxiCatDfl_C "Ersatzwert Oxidationskatalysatortemperatur" VALUE 0xD043C Kw_Ws16 950.000 Temp_Cels -50.140 899.860 FORMAT "%8.3" EXTENDED_LIMITS -3549.940 3003.560 /end CHARACTERISTIC
/begin CHARACTERISTIC EGSys_tOxiCatExoIncr_MAP "Kennfeld für Tempertaturerhöhung im Oxidationskatalysator aufgrund chemischer Reaktionen" MAP 0xD043E Kf_Xs16_Ys16_Ws16 1095.000 TempDiff_Cels -45.00000 1050.000 FORMAT "%8.3" EXTENDED_LIMITS -3276.800 3276.700
 /begin AXIS_DESCR STD_AXIS EGSys_tAvrgOxiCat_mp Temp_Cels 8 -50.140 899.860 FORMAT "%8.3" EXTENDED_LIMITS -3549.940 3003.560 DEPOSIT ABSOLUTE /end AXIS_DESCR
 /begin AXIS_DESCR STD_AXIS EGSys_rLmbdAprx lambda 8 -30.00000 30.00000 FORMAT "%8.5" EXTENDED_LIMITS -32.76800 32.76700 DEPOSIT ABSOLUTE /end AXIS_DESCR
/end CHARACTERISTIC
/begin CHARACTERISTIC EGSys_dtOxiTempUp_C "Steigung für Rampe oben der oxicattemperatur" VALUE 0xD04E4 Kw_Wu32 6553.59999847 RmpTempCels 0.00 6553.59999847 FORMAT "%13.8" /end CHARACTERISTIC
/begin CHARACTERISTIC EGSys_dtOxiTempDwn_C "Steigung für Rampe unten der oxicattemperatur" VALUE 0xD04E8 Kw_Wu32 6553.59999847 RmpTempCels 0.00 6553.59999847 FORMAT "%13.8" /end CHARACTERISTIC
/begin CHARACTERISTIC EGSys_tThresLSUAct_C "Temperaturschwellwert für reversible TPE" VAL_BLK 0xCFD4C Kwb_Ws16 250.0000 Temp_Cels -50.1400 199.8600 FORMAT "%8.4" EXTENDED_LIMITS -3549.940 3003.560 NUMBER 1 /end CHARACTERISTIC
/begin CHARACTERISTIC EGSys_tThresLSU_C "Temperaturschwellwert zur optionalen Benutzung als Eingang in das Kennfeld zur Taupunktberechnung." VALUE 0xCFD4E Kw_Ws16 950.000 Temp_Cels -50.140 899.860 FORMAT "%8.3" EXTENDED_LIMITS -3549.940 3003.560 /end CHARACTERISTIC
/begin CHARACTERISTIC EGSys_tWtEquiv_C "äquivalente Wassertemperatur beim Verdampfen" VAL_BLK 0xCFD50 Kwb_Ws16 950.000 Temp_Cels -50.140 899.860 FORMAT "%8.3" EXTENDED_LIMITS -3549.940 3003.560 NUMBER 1 /end CHARACTERISTIC
/begin CHARACTERISTIC EGSys_vscDynEG_CUR "Dynamische Viskosität Abgas (nicht applizierbar)" CURVE 0xCFFD6 Kl_Xs16_Ws16 0.9998779 Fact 0.0001220703 1.000000 FORMAT "%8.6" EXTENDED_LIMITS -4.000000 3.999878 READ_ONLY
 /begin AXIS_DESCR STD_AXIS EGSys_tEGLSUInpCrv0_mp Temp_Cels 8 -50.140 899.860 FORMAT "%8.3" EXTENDED_LIMITS -3549.940 3003.560 DEPOSIT ABSOLUTE /end AXIS_DESCR
/end CHARACTERISTIC
/begin CHARACTERISTIC EGSys_vscKinEG_CUR "Kinematische Viskosität Abgas (nicht applizierbar)" CURVE 0xCFFF8 Kl_Xs16_Ws16 0.9998779 Fact 0.0001220703 1.000000 FORMAT "%8.6" EXTENDED_LIMITS -4.000000 3.999878 READ_ONLY
 /begin AXIS_DESCR STD_AXIS EGSys_tEGLSUInpCrv0_mp Temp_Cels 8 -50.140 899.860 FORMAT "%8.3" EXTENDED_LIMITS -3549.940 3003.560 DEPOSIT ABSOLUTE /end AXIS_DESCR
/end CHARACTERISTIC
/begin CHARACTERISTIC EGSys_wLSUIKi_C "Verstärkung des Integrators" VAL_BLK 0xCFD52 Kwb_Ws16 5.000000 OneToOne 0.00 5.000000 FORMAT "%8.6" EXTENDED_LIMITS -32768.00 32767.00 NUMBER 1 /end CHARACTERISTIC
/begin CHARACTERISTIC EGSys_wThresLSU0_MAP "Wärmeschwellen Grundkennfeld Lambdasonde 0" MAP 0xCFD54 Kf_Xs16_Ys16_Ws16 6000.000 Energy 0.00 6000.000 FORMAT "%8.3" EXTENDED_LIMITS -32768.00 32767.00
 /begin AXIS_DESCR STD_AXIS EGSys_tEGLSUInpCrv0_mp Temp_Cels 10 -50.140 899.860 FORMAT "%8.3" EXTENDED_LIMITS -3549.940 3003.560 DEPOSIT ABSOLUTE /end AXIS_DESCR
 /begin AXIS_DESCR STD_AXIS Eng_tEng Temp_Cels 10 -50.140 899.860 FORMAT "%8.3" EXTENDED_LIMITS -3549.940 3003.560 DEPOSIT ABSOLUTE /end AXIS_DESCR
/end CHARACTERISTIC
/begin MEASUREMENT DfpErrCol_mp "Meßpunkt der für alle Fehlerpfade die Fehlerinformation gesammelt zur Verfügung stellt." UWORD OneToOne 1 100 0.00 65535.00 FORMAT "%8.2" ARRAY_SIZE 23 ECU_ADDRESS 0x6F802C /end MEASUREMENT
/begin MEASUREMENT DFPM_stFCMChkCause "Message für DSM internen gebrauch (unterstützung bei DSM problemen)" UBYTE FCMChkCause 1 100 1.00000000000 15.0000000000 FORMAT "%13.10" ECU_ADDRESS 0x7FA838 /end MEASUREMENT
/begin MEASUREMENT DfpZyfCol_mp "Meßpunkt der gesammelt für alle Fehlerpfade das Zyklus Bit (getested Info) zur Verfügung stellt." UWORD OneToOne 1 100 0.00 65535.00 FORMAT "%8.2" ARRAY_SIZE 23 ECU_ADDRESS 0x6F805A /end MEASUREMENT
/begin MEASUREMENT DSCHED_numDefDfpArray_mp "Array von defekten DFPs welche einen ausgewählten FID verriegeln" UWORD DfpName 1 100 0.00 356.000000000 FORMAT "%13.9" ARRAY_SIZE 10 ECU_ADDRESS 0x8FED80 /end MEASUREMENT
/begin MEASUREMENT DSCHED_numOkDfpArray_mp "Array von nicht defekten DFPs welche einen ausgewählten FID verriegeln" UWORD DfpName 1 100 0.00 356.000000000 FORMAT "%13.9" ARRAY_SIZE 20 ECU_ADDRESS 0x8FED94 /end MEASUREMENT
/begin MEASUREMENT DSM_ctDfctPath "Anzahl der momentan defekten Fehlerpfade" UWORD OneToOne 1 100 0.00 65535.00 FORMAT "%8.2" ECU_ADDRESS 0x7F8C28 /end MEASUREMENT
/begin MEASUREMENT DSM_ctFcmEntry "Anzahl der belegten Fehlerspeichereinträge" UBYTE OneToOne 1 100 0.00 255.0 FORMAT "%5.1" ECU_ADDRESS 0x7F8865 /end MEASUREMENT
/begin MEASUREMENT DSM_ctFCMEntrySize_mp "Größe eines Fehlerspeichereintrages in Bytes (Inklusive Füllbyte falls vorhanden)" UBYTE OneToOne 1 100 0.00 255.0 FORMAT "%5.1" ECU_ADDRESS 0x8FEDBC /end MEASUREMENT
/begin MEASUREMENT DSM_ctOBDPath "Anzahl der momentanen OBD-fehler im Fehlerspeicher" UBYTE OneToOne 1 100 0.00 255.0 FORMAT "%5.1" ECU_ADDRESS 0x7F8866 /end MEASUREMENT
/begin MEASUREMENT DSM_ctOBDValidPath "Anzahl bestätigter OBD relevanter Fehlerspeicher Einträge." UBYTE OneToOne 1 100 0.00 255.0 FORMAT "%5.1" ECU_ADDRESS 0x7F8867 /end MEASUREMENT
/begin MEASUREMENT DSM_ctPath_mp "Anzahl der existierenden Fehlerpfade" UWORD OneToOne 1 100 0.00 65535.00 FORMAT "%8.2" ECU_ADDRESS 0x8FEDBE /end MEASUREMENT
/begin MEASUREMENT DSM_ctRdyActCyc_mp "Status für jedes Readinessbit aus dem aktuellen driving cycle" UBYTE OneToOne 1 100 0.00 255.0 FORMAT "%5.1" ECU_ADDRESS 0x6F801C /end MEASUREMENT
/begin MEASUREMENT DSM_ctRdyCycCat_mp "Anzahl der für Readiness Bit Catalyst erreichten Zyklen." UBYTE OneToOne 1 100 0.00 255.0 FORMAT "%5.1" ECU_ADDRESS 0x8FED6B /end MEASUREMENT
/begin MEASUREMENT DSM_ctRdyCycCompr_mp "Anzahl der für Readiness Bit Comprehensive Components erreichten Zyklen." UBYTE OneToOne 1 100 0.00 255.0 FORMAT "%5.1" ECU_ADDRESS 0x8FED6C /end MEASUREMENT
/begin MEASUREMENT DSM_ctRdyCycEGR_mp "Anzahl der für Readiness Bit EGR erreichten Zyklen." UBYTE OneToOne 1 100 0.00 255.0 FORMAT "%5.1" ECU_ADDRESS 0x8FED6D /end MEASUREMENT
/begin MEASUREMENT DSM_ctRdyCycFuel_mp "Anzahl der für Readiness Bit Fuel System erreichten Zyklen." UBYTE OneToOne 1 100 0.00 255.0 FORMAT "%5.1" ECU_ADDRESS 0x8FED6E /end MEASUREMENT
/begin MEASUREMENT DSM_ctRdyCycMisf_mp "Anzahl der für Readiness Bit Misfire erreichten Zyklen." UBYTE OneToOne 1 100 0.00 255.0 FORMAT "%5.1" ECU_ADDRESS 0x8FED6F /end MEASUREMENT
/begin MEASUREMENT DSM_ctRdyCycOxSenHt_mp "Anzahl erreichter Zyklen für Readiness Bit Oxygen Sensor Heater" UBYTE OneToOne 1 100 0.00 255.0 FORMAT "%5.1" ECU_ADDRESS 0x8FED70 /end MEASUREMENT
/begin MEASUREMENT DSM_ctRdyCycOxSen_mp "Anzahl der erreichten Zyklen für Readiness Bit Oxygen Sensor" UBYTE OneToOne 1 100 0.00 255.0 FORMAT "%5.1" ECU_ADDRESS 0x8FED71 /end MEASUREMENT
/begin MEASUREMENT DSM_ctRdyLimCat_mp "Notwendige Anzahl Zyklen für Readiness Bit Catalyst." UBYTE OneToOne 1 100 0.00 255.0 FORMAT "%5.1" ECU_ADDRESS 0x8FED72 /end MEASUREMENT
/begin MEASUREMENT DSM_ctRdyLimCompr_mp "Notwendige Anzahl Zyklen für Readiness Bit Comprehensive Components." UBYTE OneToOne 1 100 0.00 255.0 FORMAT "%5.1" ECU_ADDRESS 0x8FED73 /end MEASUREMENT
/begin MEASUREMENT DSM_ctRdyLimEGR_mp "Notwendige Anzahl Zyklen für Readiness Bit EGR." UBYTE OneToOne 1 100 0.00 255.0 FORMAT "%5.1" ECU_ADDRESS 0x8FED74 /end MEASUREMENT
/begin MEASUREMENT DSM_ctRdyLimFuel_mp "Notwendige Anzahl Zyklen für Readiness Bit Fuel System." UBYTE OneToOne 1 100 0.00 255.0 FORMAT "%5.1" ECU_ADDRESS 0x8FED75 /end MEASUREMENT
/begin MEASUREMENT DSM_ctRdyLimMisf_mp "Notwendige Anzahl Zyklen für Readiness Bit Misfire." UBYTE OneToOne 1 100 0.00 255.0 FORMAT "%5.1" ECU_ADDRESS 0x8FED76 /end MEASUREMENT
/begin MEASUREMENT DSM_ctRdyLimOxSenHt_mp "Notwendige Anzahl von Zyklen für Readiness Bit Oxygen Sensor Heater" UBYTE OneToOne 1 100 0.00 255.0 FORMAT "%5.1" ECU_ADDRESS 0x8FED77 /end MEASUREMENT
/begin MEASUREMENT DSM_ctRdyLimOxSen_mp "Notwendige Anzahl Zyklen für Readiness Bit Oxygen Sensor" UBYTE OneToOne 1 100 0.00 255.0 FORMAT "%5.1" ECU_ADDRESS 0x8FED78 /end MEASUREMENT
/begin MEASUREMENT DSM_ctRdyPathsCat_mp "Anzahl von Fehlerpfaden die zum Readiness Bit Catalyst gehören." UBYTE OneToOne 1 100 0.00 255.0 FORMAT "%5.1" ECU_ADDRESS 0x8FED79 /end MEASUREMENT
/begin MEASUREMENT DSM_ctRdyPathsCompr_mp "Anzahl von Fehlerpfaden die zum Readiness Bit Comprehensive Components gehören." UBYTE OneToOne 1 100 0.00 255.0 FORMAT "%5.1" ECU_ADDRESS 0x8FED7A /end MEASUREMENT
/begin MEASUREMENT DSM_ctRdyPathsEGR_mp "Anzahl von Fehlerpfaden die zum Readiness Bit EGR gehören." UBYTE OneToOne 1 100 0.00 255.0 FORMAT "%5.1" ECU_ADDRESS 0x8FED7B /end MEASUREMENT
/begin MEASUREMENT DSM_ctRdyPathsFuel_mp "Anzahl von Fehlerpfaden die zum Readiness Bit Fuel System gehören." UBYTE OneToOne 1 100 0.00 255.0 FORMAT "%5.1" ECU_ADDRESS 0x8FED7C /end MEASUREMENT
/begin MEASUREMENT DSM_ctRdyPathsMisf_mp "Anzahl von Fehlerpfaden die zum Readiness Bit Misfire gehören." UBYTE OneToOne 1 100 0.00 255.0 FORMAT "%5.1" ECU_ADDRESS 0x8FED7D /end MEASUREMENT
/begin MEASUREMENT DSM_ctRdyPathsOxSenHt_mp "Anzahl von Fehlerpfaden, die zum Readiness Bit Oxygen Sensor Heater gehören" UBYTE OneToOne 1 100 0.00 255.0 FORMAT "%5.1" ECU_ADDRESS 0x8FED7E /end MEASUREMENT
/begin MEASUREMENT DSM_ctRdyPathsOxSen_mp "Anzahl der Fehlerpfade die zum Readiness Bit Oxygen Sensor gehören" UBYTE OneToOne 1 100 0.00 255.0 FORMAT "%5.1" ECU_ADDRESS 0x8FED7F /end MEASUREMENT
/begin MEASUREMENT DSM_ctRdyTstCat_mp "Anzahl von in diesem Zyklus getesteten Fehlerpfaden die zum Readiness Bit Catalyst gehören." UWORD OneToOne 1 100 0.00 65535.00 FORMAT "%8.2" ECU_ADDRESS 0x6F801E /end MEASUREMENT
/begin MEASUREMENT DSM_ctRdyTstCompr_mp "Anzahl von in diesem Zyklus getesteten Fehlerpfaden die zum Readiness Bit Comprehensive Components  gehören." UWORD OneToOne 1 100 0.00 65535.00 FORMAT "%8.2" ECU_ADDRESS 0x6F8020 /end MEASUREMENT
/begin MEASUREMENT DSM_ctRdyTstEGR_mp "Anzahl von in diesem Zyklus getesteten Fehlerpfaden die zum Readiness Bit EGR gehören." UWORD OneToOne 1 100 0.00 65535.00 FORMAT "%8.2" ECU_ADDRESS 0x6F8022 /end MEASUREMENT
/begin MEASUREMENT DSM_ctRdyTstFuel_mp "Anzahl von in diesem Zyklus getesteten Fehlerpfaden die zum Readiness Bit Fuel System gehören." UWORD OneToOne 1 100 0.00 65535.00 FORMAT "%8.2" ECU_ADDRESS 0x6F8024 /end MEASUREMENT
/begin MEASUREMENT DSM_ctRdyTstMisf_mp "Anzahl von in diesem Zyklus getesteten Fehlerpfaden die zum Readiness Bit Misfire  gehören." UWORD OneToOne 1 100 0.00 65535.00 FORMAT "%8.2" ECU_ADDRESS 0x6F8026 /end MEASUREMENT
/begin MEASUREMENT DSM_ctRdyTstOxSenHt_mp "Anzahl von in diesem Zyklus getesteten Fehlerpfaden die zum Readiness Bit Oxygen Sensor Heater gehören." UWORD OneToOne 1 100 0.00 65535.00 FORMAT "%8.2" ECU_ADDRESS 0x6F8028 /end MEASUREMENT
/begin MEASUREMENT DSM_ctRdyTstOxSen_mp "Anzahl von in diesem Zyklus getesteten Fehlerpfaden die zum Readiness Bit Oxygen Sensor Heater gehören." UWORD OneToOne 1 100 0.00 65535.00 FORMAT "%8.2" ECU_ADDRESS 0x6F802A /end MEASUREMENT
/begin MEASUREMENT DSM_ctTstPath "Anzahl der getesteten Fehlerpfade" UWORD OneToOne 1 100 0.00 65535.00 FORMAT "%8.2" ECU_ADDRESS 0x7F8C2A /end MEASUREMENT
/begin MEASUREMENT DSM_ctWUC "Anzahl der Warm Up Cycle seit dem letzten Fehlerspeicherlöschen  (PID $30)" UBYTE OneToOne 1 100 0.00 255.0 FORMAT "%5.1" ECU_ADDRESS 0x7FEF30 /end MEASUREMENT
/begin MEASUREMENT DSM_lDist "Anzahl der gefahrenen Strecke seitdem letzten Fehlerspeicherlöschen (PID $31)" UWORD OneToOne 1 100 0.00 65535.00 FORMAT "%8.2" ECU_ADDRESS 0x7FEF32 /end MEASUREMENT
/begin MEASUREMENT DSM_stCycles "Status der DSM Trigger Zyklen (WUC, DC, ...)" UBYTE OneToOne 1 100 0.00 255.0 FORMAT "%5.1" ECU_ADDRESS 0x7F8868 /end MEASUREMENT
/begin MEASUREMENT DSM_stECUMasterSlave "Statusinformation ob das Steuergerät ein Master- oder ein Slave-Steuergerät ist" UBYTE OneToOne 1 100 0.00 255.0 FORMAT "%5.1" ECU_ADDRESS 0x7F8869 /end MEASUREMENT
/begin MEASUREMENT DSM_stInhDelay "Status Fehlerverriegelungs Verzögerung (1 wenn mindestens 1 Verzögerung aktiv)" UBYTE OneToOne 1 100 0.00 255.0 FORMAT "%5.1" ECU_ADDRESS 0x7F886A /end MEASUREMENT
/begin MEASUREMENT DSM_stMIL "DSM Mil Anforderungsstatus (1 = kontinuierlich, 2 blinkend)" UBYTE OneToOne 1 100 0.00 255.0 FORMAT "%5.1" ECU_ADDRESS 0x7F886B /end MEASUREMENT
/begin MEASUREMENT DSM_stPID41 "Readiness Status für Diagnoseschnittstelle gemäß ISO/DIS 15031-6.5, PID41" ULONG OneToOne 1 100 0.00 4294967295.00 FORMAT "%13.2" ECU_ADDRESS 0x7F9218 /end MEASUREMENT
/begin MEASUREMENT DSM_stRdyAB "Readiness Status für Diagnoseschnittstelle gemäß SAE J1979 PID1 Byte A + B" UWORD OneToOne 1 100 0.00 65535.00 FORMAT "%8.2" ECU_ADDRESS 0x7F8C2C /end MEASUREMENT
/begin MEASUREMENT DSM_stRdyCD "Readiness Status für Diagnoseschnittstelle gemäß SAE J1979 PID1 Byte C * D" UWORD OneToOne 1 100 0.00 65535.00 FORMAT "%8.2" ECU_ADDRESS 0x7F8C2E /end MEASUREMENT
/begin MEASUREMENT DSM_stRdyCheckEnable "veroderte ready-bits der dfps, die durch die Funktion DSM_SetDfpSleep ermittelt wurden" UBYTE OneToOne 1 100 0.00 255.0 FORMAT "%5.1" ECU_ADDRESS 0x7F886C /end MEASUREMENT
/begin MEASUREMENT DSM_stSysLamp "DSM System Lampen Anforderungsstatus (1 = kontinuierlich)" UBYTE OneToOne 1 100 0.00 255.0 FORMAT "%5.1" ECU_ADDRESS 0x7F886D /end MEASUREMENT
/begin MEASUREMENT DSM_tiDCDelay_mp "aktuelle Zeit für Driving cycle Verzögerungszeit" UWORD OneToOne 1 100 0.00 65535.00 FORMAT "%8.2" ECU_ADDRESS 0x6F8088 /end MEASUREMENT
/begin MEASUREMENT EATSCD_stValid "Gültigkeit für EATSCD_tAir" UBYTE OneToOne 1 100 0.00 255.0 FORMAT "%5.1" ECU_ADDRESS 0x7F886E /end MEASUREMENT
/begin MEASUREMENT EATSCD_swtSig "Signalquelle Umgebungstemperatur (ADC oder CAN)" UBYTE OneToOne 1 100 0.00 255.0 FORMAT "%5.1" ECU_ADDRESS 0x7F886F /end MEASUREMENT
/begin MEASUREMENT EATSCD_tAir "Umgebungstemperatur" SWORD Temp_Cels 1 100 -50.140 899.860 FORMAT "%8.3" ECU_ADDRESS 0x7F8C34 /end MEASUREMENT
/begin MEASUREMENT EATSCD_tAirLin "linearisierter Wert der Umgebungstemperatur" SWORD Temp_Cels 1 100 -50.140 899.860 FORMAT "%8.3" ECU_ADDRESS 0x7F8C36 /end MEASUREMENT
/begin MEASUREMENT EATSCD_uRaw "Spannungsrohwert der Umgebungstemperatur" SWORD Volt 1 100 0.00 5000.000 FORMAT "%8.3" ECU_ADDRESS 0x7F8C38 /end MEASUREMENT
/begin MEASUREMENT EBAFCD_stSigOut "source of activation for electrical power stage of EBAFCD output" UBYTE OneToOne 1 100 0.00 255.0 FORMAT "%5.1" ECU_ADDRESS 0x7F8870 /end MEASUREMENT
/begin MEASUREMENT EBAFCD_st_mp "Status of Engine Bay Air Flap" UBYTE OneToOne 1 100 0.00 255.0 FORMAT "%5.1" ECU_ADDRESS 0x8FEDEC /end MEASUREMENT
/begin MEASUREMENT EBFCD_stOut "status output of EBFCD" UBYTE OneToOne 1 100 0.00 255.0 FORMAT "%5.1" ECU_ADDRESS 0x7F8871 /end MEASUREMENT
/begin MEASUREMENT EBFCD_st_mp "Status of output of EBFCD" UBYTE OneToOne 1 100 0.00 255.0 FORMAT "%5.1" ECU_ADDRESS 0x8FEDED /end MEASUREMENT
/begin MEASUREMENT EBTSCD_tCIntLin "ECU temperature linearized value" SWORD Temp_Cels 1 100 -50.140 899.860 FORMAT "%8.3" ECU_ADDRESS 0x7F8C3A /end MEASUREMENT
/begin MEASUREMENT EBTSCD_tECU "ECU temperature current value" SWORD Temp_Cels 1 100 -50.140 899.860 FORMAT "%8.3" ECU_ADDRESS 0x7F8C3C /end MEASUREMENT
/begin MEASUREMENT EBTSCD_uRawTECU_mp "Raw sensor voltage" SWORD Volt 1 100 -160156.4 160151.5 FORMAT "%8.1" ECU_ADDRESS 0x8FEDEE /end MEASUREMENT
/begin MEASUREMENT ECBCD_stOut "" UBYTE OneToOne 1 100 0.00 255.0 FORMAT "%5.1" ECU_ADDRESS 0x7F8872 /end MEASUREMENT
/begin MEASUREMENT ECBVlv_rECB "Stellgröße für ARF-Kühler-Bypass-Ventil" SWORD DtyCyc 1 100 -327.6800 327.6700 FORMAT "%8.4" ECU_ADDRESS 0x7F8C3E /end MEASUREMENT
/begin MEASUREMENT EEPCD_stErrSet "Allgemeiner Fehlerzustand bei der Aktivierung einer Konfiguration" UBYTE OneToOne 1 100 0.00 255.0 FORMAT "%5.1" ECU_ADDRESS 0x7F8873 /end MEASUREMENT
/begin MEASUREMENT EEPCD_stMIL "Variant manager default status of MIL lamp" UBYTE OneToOne 1 100 0.00 255.0 FORMAT "%5.1" ECU_ADDRESS 0x7F8874 /end MEASUREMENT
/begin MEASUREMENT EGPpCD_stActrOut "status of exhaust gas pressure pipe actuator" UBYTE OneToOne 1 100 0.00 255.0 FORMAT "%5.1" ECU_ADDRESS 0x7F8875 /end MEASUREMENT
/begin MEASUREMENT EGPp_dvolSil_mp "Abgasvolumenstrom nach Partikelfilter" SWORD CubMtrPerHr 1 100 -3276.800 3276.700 FORMAT "%8.3" ECU_ADDRESS 0x8FEDF0 /end MEASUREMENT
/begin MEASUREMENT EGPp_pPstPFlt "Druckabfall des Abgassystems nach Partikelfilter" SWORD Pres_hPa 1 100 -32768.00 32767.00 FORMAT "%8.2" ECU_ADDRESS 0x7F8C42 /end MEASUREMENT
/begin MEASUREMENT EGPp_pPstPFltMap_mp "Druckabfall nach Partikelfilter aus Kennfeldberechnung" SWORD Pres_hPa 1 100 -32768.00 32767.00 FORMAT "%8.2" ECU_ADDRESS 0x8FEDF2 /end MEASUREMENT
/begin MEASUREMENT EGPp_pPstPFltSim_mp "Druckabfall nach Partikelfilter aus Simulation" SWORD Pres_hPa 1 100 -32768.00 32767.00 FORMAT "%8.2" ECU_ADDRESS 0x8FEDF4 /end MEASUREMENT
/begin MEASUREMENT EGPp_stLogicOut "Status of Exhaust gas pressure pump" UBYTE OneToOne 1 100 0.00 255.0 FORMAT "%5.1" ECU_ADDRESS 0x7F8876 /end MEASUREMENT
/begin MEASUREMENT EGRCD_rCnv_mp "Tastverhältnis  basierend auf dem Ausgang des Abgasrückführreglers" SWORD DtyCyc 1 100 -327.6800 327.6700 FORMAT "%8.4" ECU_ADDRESS 0x8FEDF6 /end MEASUREMENT
/begin MEASUREMENT EGRCD_rOut "Tastverhältnis zür Endstufenansteuerung" SWORD DtyCyc 1 100 -327.6800 327.6700 FORMAT "%8.4" ECU_ADDRESS 0x7F8C44 /end MEASUREMENT
/begin MEASUREMENT EGRClg_qBypOff_mp "oberer drehzahlabhängiger Schwellwert der Einspritzmenge zum Deaktivieren des ARF-Kühler-Bypass" SWORD InjMass 1 100 -327.6800 327.6700 FORMAT "%8.4" ECU_ADDRESS 0x8FEDF8 /end MEASUREMENT
/begin MEASUREMENT EGRClg_qBypOn_mp "unterer drehzahlabhängiger Schwellwert der Einspritzmenge zum Aktivieren des ARF-Kühler-Bypass" SWORD InjMass 1 100 -327.6800 327.6700 FORMAT "%8.4" ECU_ADDRESS 0x8FEDFA /end MEASUREMENT
/begin MEASUREMENT EGRClg_rECB "Steuerwert für ARF-Kühler-Bypass-Ventil" SWORD DtyCyc 1 100 -327.6800 327.6700 FORMAT "%8.4" ECU_ADDRESS 0x7F8C46 /end MEASUREMENT
/begin MEASUREMENT EGRClg_stCldStrt_mp "Status der Kaltstart-Bedingung" UBYTE OneToOne 1 100 0.00 255.0 FORMAT "%5.1" ECU_ADDRESS 0x8FEDFC /end MEASUREMENT
/begin MEASUREMENT EGRClg_stInt_mp "Internal states of EGR cooler bypass" UBYTE OneToOne 1 100 0.00 255.0 FORMAT "%5.1" ECU_ADDRESS 0x8FEDFD /end MEASUREMENT
/begin MEASUREMENT EGRClg_stQHys_mp "Status der Hysterese-Bedingung über Einspritzmenge" UBYTE OneToOne 1 100 0.00 255.0 FORMAT "%5.1" ECU_ADDRESS 0x8FEDFE /end MEASUREMENT
/begin MEASUREMENT EGRClg_stRgn_mp "" ULONG OneToOne 1 100 0.00 4294967295.00 FORMAT "%13.2" ECU_ADDRESS 0x8FEE00 /end MEASUREMENT
/begin MEASUREMENT EGRClg_stTHys_mp "Status der Hysterese-Bedingung über Temperatur aus dem Motortemperaturfeld" UBYTE OneToOne 1 100 0.00 255.0 FORMAT "%5.1" ECU_ADDRESS 0x8FEE04 /end MEASUREMENT
/begin MEASUREMENT EGRClg_tCtlValCalc_mp "ausgewählte Temperatur aus dem Motortemperaturfeld" SWORD Temp_Cels 1 100 -50.140 899.860 FORMAT "%8.3" ECU_ADDRESS 0x8FEE06 /end MEASUREMENT
/begin MEASUREMENT EGRVlv_rEGR "Ansteuertastverhältnis für ARF-Ventil" SWORD Prc 1 100 -400.0000 399.9878 FORMAT "%8.4" ECU_ADDRESS 0x7F8C48 /end MEASUREMENT
/begin MEASUREMENT EGRVlv_rEGR2 "Sollwert für Abgasrückführung Coordinator 2" SWORD Prc 1 100 -400.0000 399.9878 FORMAT "%8.4" ECU_ADDRESS 0x7F8C4A /end MEASUREMENT
/begin MEASUREMENT EGRVlv_rEGR2Byp_mp "measuringpoint2 to be able to read value by ASCET before bypass" SWORD Prc 1 100 -400.0000 399.9878 FORMAT "%8.4" ECU_ADDRESS 0x8FEE08 /end MEASUREMENT
/begin MEASUREMENT EGRVlv_rEGRByp_mp "Bypass-Label, Kopie von EGRVlv_rEGR" SWORD Prc 1 100 -400.0000 399.9878 FORMAT "%8.4" ECU_ADDRESS 0x8FEE0A /end MEASUREMENT
/begin MEASUREMENT EGSys_cpEGLSU_mp "Spezifische Wärmekapazität des Abgases" SWORD SpecificHeat 1 100 -3.276800 3.276700 FORMAT "%8.6" ARRAY_SIZE 1 ECU_ADDRESS 0x8FEE0C /end MEASUREMENT
/begin MEASUREMENT EGSys_cpEGNSC_mp "Spezifische Wärmekapazität Abgas im NSC" SWORD SpecificHeat 1 100 -3.276800 3.276700 FORMAT "%8.6" ECU_ADDRESS 0x8FEE54 /end MEASUREMENT
/begin MEASUREMENT EGSys_ctCldStrtLSU_mp "Zähler für wiederholte Kaltstarts" UBYTE OneToOne 1 100 0.00 255.0 FORMAT "%5.1" ARRAY_SIZE 1 ECU_ADDRESS 0x6F808B /end MEASUREMENT
/begin MEASUREMENT EGSys_dmEG "näherungsweiser Abgasmassenstrom" SWORD AirMassPerTime 1 100 -3276.800 3276.700 FORMAT "%8.3" ECU_ADDRESS 0x7F8C4C /end MEASUREMENT
/begin MEASUREMENT EGSys_dwLSU_mp "Abgaswärmestrom an Sondenposition" SWORD Pwr_kW_Sec 1 100 -327.6800 327.6700 FORMAT "%8.4" ARRAY_SIZE 1 ECU_ADDRESS 0x8FEE0E /end MEASUREMENT
/begin MEASUREMENT EGSys_facAirMass_mp "Luftmassen-Korrekturfaktor für stationäre Abgaskrümmertemperatur" SWORD Fact 1 100 -4.000000 3.999878 FORMAT "%8.6" ECU_ADDRESS 0x8FEE42 /end MEASUREMENT
/begin MEASUREMENT EGSys_facStrtDlv_mp "Förderbeginn-Korrekturfaktor für stationäre Abgaskrümmertemperatur" SWORD Fact 1 100 -4.000000 3.999878 FORMAT "%8.6" ECU_ADDRESS 0x8FEE44 /end MEASUREMENT
/begin MEASUREMENT EGSys_pExhGas "Abgasgegendruck" SWORD Pres_hPa 1 100 -32768.00 32767.00 FORMAT "%8.2" ARRAY_SIZE 1 ECU_ADDRESS 0x7F8C4E /end MEASUREMENT
/begin MEASUREMENT EGSys_phiDiffStrt_mp "Differenz zwischen Förderbeginn im Auslegungspunkt und aktuellem Wert" SWORD AngleCrS 1 100 -768.0000 767.9766 FORMAT "%8.4" ECU_ADDRESS 0x8FEE46 /end MEASUREMENT
/begin MEASUREMENT EGSys_qMIStd "Vor- und haupteingespritzte Kraftstoffmenge (im Brennraum verbrannt)" SWORD InjMassCyc 1 100 -327.6800 327.6700 FORMAT "%8.4" ECU_ADDRESS 0x7F8C50 /end MEASUREMENT
/begin MEASUREMENT EGSys_qPoIRgn "Spät nacheingespritzte Kraftstoffmenge (nicht im Brennraum verbrannt)" SWORD InjMassInj 1 100 -327.6800 327.6700 FORMAT "%8.4" ECU_ADDRESS 0x7F8C52 /end MEASUREMENT
/begin MEASUREMENT EGSys_rAirPerTime_mp "Verhältnis Luftmassenstrom im Auslegungspunkt zu aktuellem Wert" SWORD Fact 1 100 -4.000000 3.999878 FORMAT "%8.6" ECU_ADDRESS 0x8FEE48 /end MEASUREMENT
/begin MEASUREMENT EGSys_rLmbdAprx "näherungsweiser Lambda-Wert" SWORD lambda 1 100 -32.76800 32.76700 FORMAT "%8.5" ECU_ADDRESS 0x7F8C54 /end MEASUREMENT
/begin MEASUREMENT EGSys_stHtgLSU "Statusbit Freigabe Sensor-Heizung" UBYTE OneToOne 1 100 0.00 255.0 FORMAT "%5.1" ARRAY_SIZE 1 ECU_ADDRESS 0x7F8877 /end MEASUREMENT
/begin MEASUREMENT EGSys_stHtgLSULstTrp_mp "Status der Taupunktfreigabe des letzten Fahrzyklus" UBYTE OneToOne 1 100 0.00 255.0 FORMAT "%5.1" ARRAY_SIZE 1 ECU_ADDRESS 0x8FEE10 /end MEASUREMENT
/begin MEASUREMENT EGSys_stHtgThresLSUHit_mp "Statusmessage für Überschreiten des Wärmemengenschwellwertes" UBYTE OneToOne 1 100 0.00 255.0 FORMAT "%5.1" ARRAY_SIZE 1 ECU_ADDRESS 0x8FEE11 /end MEASUREMENT
/begin MEASUREMENT EGSys_stIntegIni_mp "Status Integrator Initialisierung" UBYTE OneToOne 1 100 0.00 255.0 FORMAT "%5.1" ARRAY_SIZE 1 ECU_ADDRESS 0x8FEE12 /end MEASUREMENT
/begin MEASUREMENT EGSys_stPlsLSU_mp "Status-Bit gültiger Gaspuls" UBYTE OneToOne 1 100 0.00 255.0 FORMAT "%5.1" ARRAY_SIZE 1 ECU_ADDRESS 0x8FEE13 /end MEASUREMENT
/begin MEASUREMENT EGSys_tAvrgNSC_mp "Mittlere Temperatur NSC" SWORD Temp_Cels 1 100 -50.140 899.860 FORMAT "%8.3" ECU_ADDRESS 0x8FEE56 /end MEASUREMENT
/begin MEASUREMENT EGSys_tCorrIAT_mp "Temperaturoffset aufgrund Schwankungen der Ansauglufttemperatur" SWORD TempDiff_Cels 1 100 -3276.800 3276.700 FORMAT "%8.3" ECU_ADDRESS 0x8FEE4A /end MEASUREMENT
/begin MEASUREMENT EGSys_tCorrManf_mp "Temperaturoffset Krümmer bei kaltem Motor" SWORD TempDiff_Cels 1 100 -3276.800 3276.700 FORMAT "%8.3" ECU_ADDRESS 0x8FEE4C /end MEASUREMENT
/begin MEASUREMENT EGSys_tDiffCldEng_mp "Abweichung aktuelle Motortemperatur von stationärem Wert" SWORD TempDiff_Cels 1 100 -3276.800 3276.700 FORMAT "%8.3" ECU_ADDRESS 0x8FEE4E /end MEASUREMENT
/begin MEASUREMENT EGSys_tDiffIAT_mp "Differenz zwischen Ansaulglufttemperatur im Auslegungspunkt und aktuellem Wert" SWORD TempDiff_Cels 1 100 -3276.800 3276.700 FORMAT "%8.3" ECU_ADDRESS 0x8FEE50 /end MEASUREMENT
/begin MEASUREMENT EGSys_tEGLSU "Abgas-Temperatur an Sensor-Position" SWORD Temp_Cels 1 100 -50.140 899.860 FORMAT "%8.3" ARRAY_SIZE 1 ECU_ADDRESS 0x7F8C56 /end MEASUREMENT
/begin MEASUREMENT EGSys_tEGLSUInpCrv0_mp "Messpunkt Eingang der Kennlinien" SWORD Temp_Cels 1 100 -50.140 899.860 FORMAT "%8.3" ECU_ADDRESS 0x8FEE1C /end MEASUREMENT
/begin MEASUREMENT EGSys_tEGLSUInpCrv1_mp "Messpunkt Eingang des Kennfeldes EGSys_wTresLSU1_MAP" SWORD Temp_Cels 1 100 -50.140 899.860 FORMAT "%8.3" ECU_ADDRESS 0x8FEE1E /end MEASUREMENT
/begin MEASUREMENT EGSys_tEGLSUInpCrv2_mp "Messpunkt Eingang des Kennfeldes EGSys_wTresLSU2_MAP" SWORD Temp_Cels 1 100 -50.140 899.860 FORMAT "%8.3" ECU_ADDRESS 0x8FEE20 /end MEASUREMENT
/begin MEASUREMENT EGSys_tEGLSUInpCrv3_mp "Messpunkt Eingang des Kennfeldes EGSys_wTresLSU3_MAP" SWORD Temp_Cels 1 100 -50.140 899.860 FORMAT "%8.3" ECU_ADDRESS 0x8FEE22 /end MEASUREMENT
/begin MEASUREMENT EGSys_tEGPreNSC "Abgastemperatur am NSC-Eintritt" SWORD Temp_Cels 1 100 -50.140 899.860 FORMAT "%8.3" ECU_ADDRESS 0x7F8C58 /end MEASUREMENT
/begin MEASUREMENT EGSys_tEGPreOxiCat "Abgastemperatur am Oxidationskatalysator-Eintritt" SWORD Temp_Cels 1 100 -50.140 899.860 FORMAT "%8.3" ECU_ADDRESS 0x7F8C5A /end MEASUREMENT
/begin MEASUREMENT EGSys_tEGPreTrbn "Abgas-Temperatur vor Turbine" SWORD Temp_Cels 1 100 -50.140 899.860 FORMAT "%8.3" ECU_ADDRESS 0x7F8C5C /end MEASUREMENT
/begin MEASUREMENT EGSys_tEGPreTube "Abgastemperatur am Abgasrohr-Eintritt" SWORD Temp_Cels 1 100 -50.140 899.860 FORMAT "%8.3" ARRAY_SIZE 2 ECU_ADDRESS 0x7F921C /end MEASUREMENT
/begin MEASUREMENT EGSys_tManfStat "stationäre Abgastemperatur im Abgaskrümmer" SWORD Temp_Cels 1 100 -50.140 899.860 FORMAT "%8.3" ECU_ADDRESS 0x7F8C60 /end MEASUREMENT
/begin MEASUREMENT EGSys_tManfStat_mp "stationäre Abgastemperatur im Abgaskrümmer ohne Korrekturen" SWORD Temp_Cels 1 100 -50.140 899.860 FORMAT "%8.3" ECU_ADDRESS 0x8FEE52 /end MEASUREMENT
/begin MEASUREMENT EGSys_tMem_mp "Zwischenspeicher für Temperaturen" SWORD Temp_Cels 1 100 -50.140 899.860 FORMAT "%8.3" ARRAY_SIZE 14 ECU_ADDRESS 0x8FEE24 /end MEASUREMENT
/begin MEASUREMENT EGSys_tNSC "Temperatur NSC (Austritt)" SWORD Temp_Cels 1 100 -50.140 899.860 FORMAT "%8.3" ECU_ADDRESS 0x7F8C62 /end MEASUREMENT
/begin MEASUREMENT EGSys_tNSCExoIncr_mp "Temperaturerhöhung im NSC durch chemische Reaktionen" SWORD TempDiff_Cels 1 100 -3276.800 3276.700 FORMAT "%8.3" ECU_ADDRESS 0x8FEE58 /end MEASUREMENT
/begin MEASUREMENT EGSys_tNSCStat_mp "Stationäre Temperatur NSC" SWORD Temp_Cels 1 100 -50.140 899.860 FORMAT "%8.3" ECU_ADDRESS 0x8FEE5A /end MEASUREMENT
/begin MEASUREMENT EGSys_tOxiCat "Temperatur Oxidationskatalysator (Austritt)" SWORD Temp_Cels 1 100 -50.140 899.860 FORMAT "%8.3" ECU_ADDRESS 0x7F8C66 /end MEASUREMENT
/begin MEASUREMENT EGSys_tShOffTExcClnt_mp "Motorübertemperature bei Motorstop" SWORD TempDiff_Cels 1 100 -3276.800 3276.700 FORMAT "%8.3" ECU_ADDRESS 0x8FEE40 /end MEASUREMENT
/begin MEASUREMENT EGSys_tWallLSU "Wandtemperatur am Sondeneinbauort" SWORD Temp_Cels 1 100 -50.140 899.860 FORMAT "%8.3" ARRAY_SIZE 1 ECU_ADDRESS 0x7F8C6C /end MEASUREMENT
/begin MEASUREMENT EGSys_wLSU_mp " integrierte Wärmemenge an Sensor-Position." SWORD Energy 1 100 -32768.00 32767.00 FORMAT "%8.2" ARRAY_SIZE 1 ECU_ADDRESS 0x6F808C /end MEASUREMENT
/begin MEASUREMENT EGSys_wThresLSUAct_mp "aktueller Wärmeschwellwert an Sensorposition." SWORD Energy 1 100 -32768.00 32767.00 FORMAT "%8.2" ARRAY_SIZE 1 ECU_ADDRESS 0x8FEE14 /end MEASUREMENT
/begin MEASUREMENT EGSys_wThresLSUNoPls_mp "Hitzeschwelle ohne gültigen Gaspuls." SWORD Energy 1 100 -32768.00 32767.00 FORMAT "%8.2" ARRAY_SIZE 1 ECU_ADDRESS 0x8FEE16 /end MEASUREMENT
/begin MEASUREMENT EGSys_wThresLSUPls_mp "Hitzeschwelle für gültigen Gaspuls" SWORD Energy 1 100 -32768.00 32767.00 FORMAT "%8.2" ARRAY_SIZE 1 ECU_ADDRESS 0x8FEE18 /end MEASUREMENT
/begin MEASUREMENT EGSys_wThresLSU_mp "Grundlegender Wert-Hitzeschwelle-Sensor" SWORD Energy 1 100 -32768.00 32767.00 FORMAT "%8.2" ARRAY_SIZE 1 ECU_ADDRESS 0x8FEE1A /end MEASUREMENT
/begin MEASUREMENT EGT_tOutrDesInTempGvnr "Kundenspezifischer Temperaturvorgabewert des äußeren Reglers." SWORD Temp_Cels 1 100 -50.140 899.860 FORMAT "%8.3" ECU_ADDRESS 0x7F8C8E /end MEASUREMENT
/begin MEASUREMENT FidCol_mp "Meßpunkt der gesammelt den Zustand aller Funktionsidentifier (Fid) zur Verfügung stellt." UWORD OneToOne 1 100 0.00 65535.00 FORMAT "%8.2" ARRAY_SIZE 20 ECU_ADDRESS 0x8FEDC0 /end MEASUREMENT
/begin MEASUREMENT PCR_rGvnrLP2 "Das Verhältnis 2 des Ventilhubes aus dem PCR-Ausgleichsregler" SWORD Prc 1 100 -400.0000 399.9878 FORMAT "%8.4" ECU_ADDRESS 0x7F905C /end MEASUREMENT
/begin MEASUREMENT PFlt_tOxiPst "Temperatur nach dem Oxidations Katalysator" SWORD Temp_Cels 1 100 -50.140 899.860 FORMAT "%8.3" ECU_ADDRESS 0x7F90C4 /end MEASUREMENT
/begin MEASUREMENT PFlt_tTurbPre "Temperatur vor dem Turbolader" SWORD Temp_Cels 1 100 -50.140 899.860 FORMAT "%8.3" ECU_ADDRESS 0x7F90CE /end MEASUREMENT
/begin MEASUREMENT TVACD_stAirMon "Status des TVACD" UBYTE OneToOne 1 100 0.00 255.0 FORMAT "%5.1" ECU_ADDRESS 0x7F89F3 /end MEASUREMENT
/begin MEASUREMENT Uhwe_ctAtomicLvl_mp "Interrupt Lock Level" ULONG OneToOne 1 100 0.00 4294967295.00 FORMAT "%13.2" ECU_ADDRESS 0x8FEDE8 /end MEASUREMENT
/begin FUNCTION dsm_auto_tsf ""
 /begin DEF_CHARACTERISTIC DSM_TsfDfp_Layer_TANS_C DSM_TsfDfp_ACCDCmpr_C DSM_TsfDfp_ACCDPres_C DSM_TsfDfp_ACCDPres1_C DSM_TsfDfp_ACCDPresAna_C DSM_TsfDfp_ACCDSwtin_C DSM_TsfDfp_ACC_PlausTrqDes_C DSM_TsfDfp_ACC_trqInr_C DSM_TsfDfp_ACTrq_C DSM_TsfDfp_ADCMon_C DSM_TsfDfp_AFSCDIdlAdjVal_C DSM_TsfDfp_AFSCDLdAdjVal_C DSM_TsfDfp_AFSCD_AirTempDcyc_C DSM_TsfDfp_AFSCD_PlOffsDrft_C DSM_TsfDfp_AFSCD_PlSetyDrft_C DSM_TsfDfp_AFSCD_SRCAirTemp_C DSM_TsfDfp_AFSCD_SRCBatt_C DSM_TsfDfp_AFSCD_SRCCorrAirm_C DSM_TsfDfp_AFSCD_SRCRawAirm_C DSM_TsfDfp_Layer_TUMG_C DSM_TsfDfp_AFSCD_SRCRefSigPer_C DSM_TsfDfp_AOHtCD_C DSM_TsfDfp_Layer_GEN_C DSM_TsfDfp_Layer_BSD_C DSM_TsfDfp_AOHtCD_AOHtDia1_C DSM_TsfDfp_AOHtCD_AOHtDia2_C DSM_TsfDfp_AOHtCD_AOHtDia3_C DSM_TsfDfp_APP1_C DSM_TsfDfp_APP2_C DSM_TsfDfp_APPCDCmpd_C DSM_TsfDfp_APPSync_C DSM_TsfDfp_APSCD_C DSM_TsfDfp_ARS_C DSM_TsfDfp_AccPedPlausBrk_C DSM_TsfDfp_Layer_QLT_C DSM_TsfDfp_AirCtlGvnrDvtRgnMax_C DSM_TsfDfp_Layer_IBS1_C DSM_TsfDfp_Layer_IBS2_C DSM_TsfDfp_Layer_IBS3_C DSM_TsfDfp_Layer_PMBN_C DSM_TsfDfp_Layer_PMBATT_C DSM_TsfDfp_AirCtlGvnrDvtRgnMin_C DSM_TsfDfp_AirCtlGvnrDvtRgnMn2_C DSM_TsfDfp_AirCtlGvnrDvtRgnMx2_C DSM_TsfDfp_AirCtlPlateBreak_C DSM_TsfDfp_AirCtlRmpTO_C DSM_TsfDfp_AirCtl_GovNegDev_C DSM_TsfDfp_AirCtl_GovNegDev2_C DSM_TsfDfp_AirCtl_GovPosDev_C DSM_TsfDfp_AirCtl_GovPosDev2_C DSM_TsfDfp_AltCD_C DSM_TsfDfp_AltCD_Load_C DSM_TsfDfp_BPACD_BPADia1_C DSM_TsfDfp_BPACD_BPADia2_C DSM_TsfDfp_BPACD_BPADia3_C DSM_TsfDfp_BPACD_BPADia4_C DSM_TsfDfp_BPACD_Max_C DSM_TsfDfp_BPACD_Min_C DSM_TsfDfp_BPACD_PwmIn_C DSM_TsfDfp_BPACD_PwmInDia1_C DSM_TsfDfp_BPACD_PwmInDia2_C DSM_TsfDfp_BPACD_PwmInDia3_C DSM_TsfDfp_BPACD_PwmInDia4_C DSM_TsfDfp_BPACD_SigNpl_C DSM_TsfDfp_BPSCD_C DSM_TsfDfp_BattCD_C DSM_TsfDfp_BrkCD_C DSM_TsfDfp_Bss_C DSM_TsfDfp_CBACD_C DSM_TsfDfp_CTSCD_C DSM_TsfDfp_Clg_DynTst_C DSM_TsfDfp_CmbChbMisfire1_C DSM_TsfDfp_CmbChbMisfire2_C DSM_TsfDfp_Layer_PMRUHVERL_C DSM_TsfDfp_CmbChbMisfire3_C DSM_TsfDfp_CmbChbMisfire4_C DSM_TsfDfp_CmbChbMisfire5_C DSM_TsfDfp_CmbChbMisfire6_C DSM_TsfDfp_Layer_TOENS_C DSM_TsfDfp_Layer_MANHYDR_C DSM_TsfDfp_Layer_MANLUFT_C DSM_TsfDfp_CmbChbMisfireMul_C DSM_TsfDfp_CoVMDCSh_C DSM_TsfDfp_ConvCD_C DSM_TsfDfp_CrCCDMFL_C DSM_TsfDfp_CrCtl_vCrCtl_C DSM_TsfDfp_DCC_PlausTrqDes_C DSM_TsfDfp_Dummy1_C DSM_TsfDfp_EATSCD_C DSM_TsfDfp_EBAFCD_C DSM_TsfDfp_EBFCD_C DSM_TsfDfp_EBTSCD_C DSM_TsfDfp_EBTSCD_OvrTemp_C DSM_TsfDfp_ECBCD_C DSM_TsfDfp_EEPCDVarMng_C DSM_TsfDfp_EGPpCD_C DSM_TsfDfp_EGPpCDTPreTrbn_C DSM_TsfDfp_EGRCD_Max_C DSM_TsfDfp_EGRCD_Min_C DSM_TsfDfp_EGRCD_SigNpl_C DSM_TsfDfp_EGTOilLvlCrit_C DSM_TsfDfp_EGTOilVscCrit_C DSM_TsfDfp_EGTRgnOilDil_C DSM_TsfDfp_EGTTempGvnrInr_C DSM_TsfDfp_EGTTempGvnrOutr_C DSM_TsfDfp_EMCCD1_C DSM_TsfDfp_EMCCD2_C DSM_TsfDfp_EMCCD_ADC1_C DSM_TsfDfp_EMCCD_ADC2_C DSM_TsfDfp_ETClbETFltInj1_C DSM_TsfDfp_ETClbETFltInj2_C DSM_TsfDfp_ETClbETFltInj3_C DSM_TsfDfp_ETClbETFltInj4_C DSM_TsfDfp_ETClbETFltInj5_C DSM_TsfDfp_ETClbETFltInj6_C DSM_TsfDfp_ETClbInj1_C DSM_TsfDfp_ETClbInj2_C DSM_TsfDfp_ETClbInj3_C DSM_TsfDfp_ETClbInj4_C DSM_TsfDfp_ETClbInj5_C DSM_TsfDfp_ETClbInj6_C DSM_TsfDfp_EngMCaS1_C DSM_TsfDfp_EngMCrS1_C DSM_TsfDfp_EngMOfsCaSCrS_C DSM_TsfDfp_EngPrtFWODet_C DSM_TsfDfp_FBCqDvt_C DSM_TsfDfp_FMAErrMod_C DSM_TsfDfp_FMTC_NonMonotonMap_C DSM_TsfDfp_FTSCD_C DSM_TsfDfp_FanCD_C DSM_TsfDfp_FanCD_FanCtlr1_C DSM_TsfDfp_FanCD_FanCtlr2_C DSM_TsfDfp_FanCD_FanCtlr3_C DSM_TsfDfp_FlFCD_C DSM_TsfDfp_FlMngSmkDefect_C DSM_TsfDfp_FrmMngANFRADMOMPT_C DSM_TsfDfp_FrmMngASC1_C DSM_TsfDfp_FrmMngASC2_C DSM_TsfDfp_FrmMngASC3_C DSM_TsfDfp_FrmMngASC4_C DSM_TsfDfp_FrmMngBOS_RESET_C DSM_TsfDfp_FrmMngBOS_RESET2_C DSM_TsfDfp_FrmMngDMANFAFS_C DSM_TsfDfp_FrmMngDRMANFSSG_C DSM_TsfDfp_FrmMngEGS1_C DSM_TsfDfp_FrmMngEGS2_C DSM_TsfDfp_FrmMngGEARBX_DATA_C DSM_TsfDfp_FrmMngGEARBX_DATA2_C DSM_TsfDfp_FrmMngHEAT_AC_C DSM_TsfDfp_FrmMngINSTR2_C DSM_TsfDfp_FrmMngINSTR3_C DSM_TsfDfp_FrmMngLENKRADWINKEL_C DSM_TsfDfp_FrmMngMILEAGE_RANGE_C DSM_TsfDfp_FrmMngOPCRCTLACC_C DSM_TsfDfp_FrmMngPRGG_CCTR_C DSM_TsfDfp_FrmMngPWRMNG_LOADV_C DSM_TsfDfp_FrmMngParkConsumer_C DSM_TsfDfp_FrmMngRQSTGEFAN_C DSM_TsfDfp_FrmMngSSGErr_C DSM_TsfDfp_FrmMngSSGShOff_C DSM_TsfDfp_FrmMngSTAT_ANH_C DSM_TsfDfp_FrmMngSTAT_ARS_C DSM_TsfDfp_FrmMngSTAT_DSC_C DSM_TsfDfp_FrmMngSTAT_EKP_C DSM_TsfDfp_FrmMngSTAT_KOMBI_C DSM_TsfDfp_FrmMngSTAT_SITZ_C DSM_TsfDfp_FrmMngStOBDGbxMilOf_C DSM_TsfDfp_FrmMngStOBDGbxMilOn_C DSM_TsfDfp_FrmMngTEMPRELTIME_C DSM_TsfDfp_FrmMngTERMINAL_C DSM_TsfDfp_FrmMngTIME_DATE_C DSM_TsfDfp_FrmMngTORQUE_DSC_C DSM_TsfDfp_FrmMngTORQUE_GEARBX_C DSM_TsfDfp_FrmMngTrq_ReqACC_C DSM_TsfDfp_FrmMngVEH_MOD_C DSM_TsfDfp_FrmMngVELOCITY_C DSM_TsfDfp_FrmMngWHEEL_SPEED_C DSM_TsfDfp_FrmMngstCurr_C DSM_TsfDfp_FrmMngswtPSPOff_C DSM_TsfDfp_GearbxIncMax_C DSM_TsfDfp_GlwCD_C DSM_TsfDfp_GlwCDGlwCirc1_C DSM_TsfDfp_GlwCDGlwCirc2_C DSM_TsfDfp_GlwCDGlwCirc3_C DSM_TsfDfp_GlwCDGlwCirc4_C DSM_TsfDfp_GlwCDGlwCirc5_C DSM_TsfDfp_GlwCDGlwCirc6_C DSM_TsfDfp_GlwCDGlwCirc7_C DSM_TsfDfp_GlwCDGlwCirc8_C DSM_TsfDfp_GlwCtl_C DSM_TsfDfp_HWEMonCom_C DSM_TsfDfp_HWEMonEEPROM_C DSM_TsfDfp_HWEMonRcyLocked_C DSM_TsfDfp_HWEMonRcySuppressed_C DSM_TsfDfp_HWEMonRcyVisible_C DSM_TsfDfp_HWEMonUMaxSupply_C DSM_TsfDfp_HWEMonUMinSupply_C DSM_TsfDfp_IATSCD_C DSM_TsfDfp_IATSCD_CATS_C DSM_TsfDfp_ImmCtlImmCD_C DSM_TsfDfp_ImmCtlImmEep_C DSM_TsfDfp_ImmCtlMpl_C DSM_TsfDfp_IndSys1_C DSM_TsfDfp_IndSys2_C DSM_TsfDfp_InjCrv_InjLim_C DSM_TsfDfp_InjCtlAdjQnt_C DSM_TsfDfp_InjCtlDrift_C DSM_TsfDfp_InjVlvBnk1A_C DSM_TsfDfp_InjVlvBnk1B_C DSM_TsfDfp_InjVlvBnk2A_C DSM_TsfDfp_InjVlvBnk2B_C DSM_TsfDfp_InjVlvChipA_C DSM_TsfDfp_InjVlvChipB_C DSM_TsfDfp_InjVlvCyl1A_C DSM_TsfDfp_InjVlvCyl1B_C DSM_TsfDfp_InjVlvCyl2A_C DSM_TsfDfp_InjVlvCyl2B_C DSM_TsfDfp_InjVlvCyl3A_C DSM_TsfDfp_InjVlvCyl3B_C DSM_TsfDfp_InjVlvCyl4A_C DSM_TsfDfp_InjVlvCyl4B_C DSM_TsfDfp_InjVlvCyl5A_C DSM_TsfDfp_InjVlvCyl5B_C DSM_TsfDfp_InjVlvCyl6A_C DSM_TsfDfp_InjVlvCyl6B_C DSM_TsfDfp_KeyCheck_C DSM_TsfDfp_LIGovECUTransMode_C DSM_TsfDfp_LPACD_Max_C DSM_TsfDfp_LPACD_Min_C DSM_TsfDfp_LPACD_SigNpl_C DSM_TsfDfp_LSUCDCircNernst0_C DSM_TsfDfp_LSUCDCircPumpCur0_C DSM_TsfDfp_LSUCDCircVirtGnd0_C DSM_TsfDfp_LSUCDHeater0_C DSM_TsfDfp_LSUCDHtCoup0_C DSM_TsfDfp_LSUCDO20_C DSM_TsfDfp_LSUCDO2Clb0_C DSM_TsfDfp_LSUCDRiClb0_C DSM_TsfDfp_LSUCDSPI0_C DSM_TsfDfp_LSUCDSPIBattLow0_C DSM_TsfDfp_LSUCDWireIP0_C DSM_TsfDfp_LSUCtlRiExc0_C DSM_TsfDfp_LSUMon1Sens_C DSM_TsfDfp_LSUMon2Sens_C DSM_TsfDfp_MIL_C DSM_TsfDfp_MRlyCD_C DSM_TsfDfp_MSidCD_Comm_C DSM_TsfDfp_MSidCD_Pin_C DSM_TsfDfp_MSidCD_Sel_INI_C DSM_TsfDfp_MSidCD_Select_C DSM_TsfDfp_MeUnCDNoLoad_C DSM_TsfDfp_MeUnCDSCBat_C DSM_TsfDfp_MeUnCDSCGnd_C DSM_TsfDfp_MeUnCD_ADC_C DSM_TsfDfp_MeUnCD_SigTst_C DSM_TsfDfp_Montr_C DSM_TsfDfp_NetMngDeviceA_C DSM_TsfDfp_NetMngDeviceB_C DSM_TsfDfp_NetMngDeviceC_C DSM_TsfDfp_NetMngPtCan_C DSM_TsfDfp_OPSCD_Lamp_C DSM_TsfDfp_OPSCD_anain_C DSM_TsfDfp_OTSCD_C DSM_TsfDfp_OvRMon_C DSM_TsfDfp_OvRMonSigA_C DSM_TsfDfp_OxiCCDTPre_C DSM_TsfDfp_PCBS_C DSM_TsfDfp_PCR_GovDevNeg_C DSM_TsfDfp_PCR_GovDevPos_C DSM_TsfDfp_PCR_LPGvnrDvtNeg_C DSM_TsfDfp_PCR_LPGvnrDvtPos_C DSM_TsfDfp_PCVCDNoLoad_C DSM_TsfDfp_PCVCDSCBat_C DSM_TsfDfp_PCVCDSCGnd_C DSM_TsfDfp_PCVCD_ADC_C DSM_TsfDfp_PCVCD_SigTst_C DSM_TsfDfp_PFltAPSPlaus_C DSM_TsfDfp_PFltAPSens_C DSM_TsfDfp_PFltBPSPlaus_C DSM_TsfDfp_PFltCDPPre_C DSM_TsfDfp_PFltCDTempPre_C DSM_TsfDfp_PFltChar_C DSM_TsfDfp_PFltEngPrt_C DSM_TsfDfp_PFltOvldInhRgn_C DSM_TsfDfp_PFltOvldTrqLim_C DSM_TsfDfp_PFltPresDynPlaus_C DSM_TsfDfp_PFltPresPlaus_C DSM_TsfDfp_PFltPresSens_C DSM_TsfDfp_PFltPresSensFrz_C DSM_TsfDfp_PFltPresSensHsLn_C DSM_TsfDfp_PFltPresSensSot_C DSM_TsfDfp_PFltRgnPerm_C DSM_TsfDfp_PFltTempDwnStrm_C DSM_TsfDfp_PFltTempSens_C DSM_TsfDfp_PFltTempUpStrm_C DSM_TsfDfp_PFlt_tOxiPreMax_C DSM_TsfDfp_PFlt_tOxiPreMxRgn_C DSM_TsfDfp_PFlt_tPreMax_C DSM_TsfDfp_PFlt_tPreMaxRgn_C DSM_TsfDfp_PFltmSotDiffMax_C DSM_TsfDfp_PSPCD_Actr_C DSM_TsfDfp_PresPlausDblDef_C DSM_TsfDfp_QLTCD_C DSM_TsfDfp_RailCD_C DSM_TsfDfp_RailCDOfsTst_C DSM_TsfDfp_RailCD_PMonStrt_C DSM_TsfDfp_RailCtlModeMeUnDiag_C DSM_TsfDfp_RailCtlModePCVDiag_C DSM_TsfDfp_RailMeUn0_C DSM_TsfDfp_RailMeUn1_C DSM_TsfDfp_RailMeUn2_C DSM_TsfDfp_RailMeUn3_C DSM_TsfDfp_RailMeUn4_C DSM_TsfDfp_RailPCV0_C DSM_TsfDfp_RailPCV1_C DSM_TsfDfp_RailPCV2_C DSM_TsfDfp_RailPCV3_C DSM_TsfDfp_RailPCV4_C DSM_TsfDfp_RailPCV5_C DSM_TsfDfp_SOPTst_C DSM_TsfDfp_SSpMon1_C DSM_TsfDfp_SSpMon2_C DSM_TsfDfp_SSpMon3_C DSM_TsfDfp_SWChk_CycSigChkDat_C DSM_TsfDfp_SWChk_CycSigChkPrg_C DSM_TsfDfp_ShutCD_C DSM_TsfDfp_StSysTrqShutOff_C DSM_TsfDfp_StrtCD_Actr_C DSM_TsfDfp_SysLamp_C DSM_TsfDfp_T15CD_C DSM_TsfDfp_TGearbx_C DSM_TsfDfp_TPUMon_C DSM_TsfDfp_TVACD_Max_C DSM_TsfDfp_TVACD_Min_C DSM_TsfDfp_TVACD_SigNpl_C DSM_TsfDfp_TVACD_TVADia1_C DSM_TsfDfp_TVACD_TVADia2_C DSM_TsfDfp_TVACD_TVADia3_C DSM_TsfDfp_TVACD_TVADia4_C DSM_TsfDfp_ThrVlvMon_C DSM_TsfDfp_VSACD_DiaDet_C DSM_TsfDfp_VSACD_DioInDia1_C DSM_TsfDfp_VSACD_DioInDia2_C DSM_TsfDfp_VSACD_DioInDia3_C DSM_TsfDfp_VSACD_DioInDia4_C DSM_TsfDfp_VSACD_DioInMin_C DSM_TsfDfp_VSACD_Max_C DSM_TsfDfp_VSACD_Min_C DSM_TsfDfp_VSACD_SigNpl_C DSM_TsfDfp_VSACD_VSADia1_C DSM_TsfDfp_VSACD_VSADia2_C DSM_TsfDfp_VSACD_VSADia3_C DSM_TsfDfp_VSACD_VSADia4_C DSM_TsfDfp_VSSCD1_C DSM_TsfDfp_VSSCD2_C DSM_TsfDfp_WdCom_C /end DEF_CHARACTERISTIC
/end FUNCTION
/begin FUNCTION dsm_msg ""
 /begin OUT_MEASUREMENT DFPM_stFCMChkCause DSM_ctDfctPath DSM_ctFcmEntry DSM_ctOBDPath DSM_ctOBDValidPath DSM_ctTstPath DSM_ctWUC DSM_lDist DSM_stCycles DSM_stECUMasterSlave DSM_stInhDelay DSM_stMIL DSM_stPID41 DSM_stRdyAB DSM_stRdyCD DSM_stRdyCheckEnable DSM_stSysLamp /end OUT_MEASUREMENT
/end FUNCTION
/begin FUNCTION dsm_rdy ""
 /begin DEF_CHARACTERISTIC DSM_RdyABForceMsk_C DSM_RdyCDForceMsk_C DSM_RdyOnMilEnable_C /end DEF_CHARACTERISTIC
/end FUNCTION
/begin FUNCTION dsm_rdy_msg "" /end FUNCTION
/begin FUNCTION dsm_rdy_uic ""
 /begin OUT_MEASUREMENT DSM_ctRdyActCyc_mp DSM_ctRdyCycCat_mp DSM_ctRdyCycCompr_mp DSM_ctRdyCycEGR_mp DSM_ctRdyCycFuel_mp DSM_ctRdyCycMisf_mp DSM_ctRdyCycOxSenHt_mp DSM_ctRdyCycOxSen_mp DSM_ctRdyLimCat_mp DSM_ctRdyLimCompr_mp DSM_ctRdyLimEGR_mp DSM_ctRdyLimFuel_mp DSM_ctRdyLimMisf_mp DSM_ctRdyLimOxSenHt_mp DSM_ctRdyLimOxSen_mp DSM_ctRdyPathsCat_mp DSM_ctRdyPathsCompr_mp DSM_ctRdyPathsEGR_mp DSM_ctRdyPathsFuel_mp DSM_ctRdyPathsMisf_mp DSM_ctRdyPathsOxSenHt_mp DSM_ctRdyPathsOxSen_mp DSM_ctRdyTstCat_mp DSM_ctRdyTstCompr_mp DSM_ctRdyTstEGR_mp DSM_ctRdyTstFuel_mp DSM_ctRdyTstMisf_mp DSM_ctRdyTstOxSenHt_mp DSM_ctRdyTstOxSen_mp /end OUT_MEASUREMENT
/end FUNCTION
/begin FUNCTION dsm_sy_conf "" /end FUNCTION
/begin FUNCTION dsm_uic ""
 /begin OUT_MEASUREMENT DfpErrCol_mp DfpZyfCol_mp DSCHED_numDefDfpArray_mp DSCHED_numOkDfpArray_mp DSM_ctFCMEntrySize_mp DSM_ctPath_mp DSM_tiDCDelay_mp FidCol_mp /end OUT_MEASUREMENT
/end FUNCTION
/begin FUNCTION dummy "" /end FUNCTION
/begin FUNCTION dummy_proj_msg ""
 /begin OUT_MEASUREMENT EGT_tOutrDesInTempGvnr PCR_rGvnrLP2 PFlt_tOxiPst PFlt_tTurbPre TVACD_stAirMon /end OUT_MEASUREMENT
/end FUNCTION
/begin FUNCTION dummy_uic "" /begin OUT_MEASUREMENT Uhwe_ctAtomicLvl_mp /end OUT_MEASUREMENT /end FUNCTION
/begin FUNCTION eatscd "Umgebungslufttemperaturerfassung"
 /begin DEF_CHARACTERISTIC EATSCD_uSRCMin_C EATSCD_uSRCMax_C EATSCD_tLin_CUR EATSCD_DebSigDef_C EATSCD_DebSigOk_C EATSCD_DebSRCHighDef_C EATSCD_DebSRCHighOk_C EATSCD_DebSRCLowDef_C EATSCD_DebSRCLowOk_C EATSCD_dtRmpSubs_C EATSCD_dtRmpSubsUp_C EATSCD_dtRmpSubsDwn_C EATSCD_numAdc_C EATSCD_dtRmpSlpUp_C EATSCD_dtRmpSlpDwn_C EATSCD_swtSensImpl_C EATSCD_swtSigVal_C EATSCD_tAirSubs_C EATSCD_tiTransStValid_C EATSCD_stSensIDWord_C EATSCD_tDfl_C /end DEF_CHARACTERISTIC
 /begin IN_MEASUREMENT EATSCD_uRaw /end IN_MEASUREMENT
/end FUNCTION
/begin FUNCTION eatscd_msg ""
 /begin OUT_MEASUREMENT EATSCD_stValid EATSCD_swtSig EATSCD_tAir EATSCD_tAirLin EATSCD_uRaw /end OUT_MEASUREMENT
/end FUNCTION
/begin FUNCTION eatscd_uic "" /end FUNCTION
/begin FUNCTION ebafcd "Abluftklappensteuerung Komponententreiber"
 /begin DEF_CHARACTERISTIC EBAFCD_ctPwrStgOnMax_C EBAFCD_DebExcTempDef_C EBAFCD_DebExcTempOk_C EBAFCD_DebNoLoadDef_C EBAFCD_DebNoLoadOk_C EBAFCD_DebShortCircBatDef_C EBAFCD_DebShortCircBatOk_C EBAFCD_DebShortCircGndDef_C EBAFCD_DebShortCircGndOk_C EBAFCD_InvSigOut_C EBAFCD_nFan_C EBAFCD_numDiaOut_C EBAFCD_numDioOut_C EBAFCD_stSPICtl_C EBAFCD_tClntTrMin_C EBAFCD_tClntTrMax_C EBAFCD_sttClntTrOff_C EBAFCD_sttClntTrOn_C EBAFCD_tClntMin_C EBAFCD_tClntMax_C EBAFCD_sttClntOff_C EBAFCD_sttClntOn_C EBAFCD_tiBtwTst_C EBAFCD_tiPwrStgOn_C /end DEF_CHARACTERISTIC
/end FUNCTION
/begin FUNCTION ebafcd_msg "" /begin OUT_MEASUREMENT EBAFCD_stSigOut /end OUT_MEASUREMENT /end FUNCTION
/begin FUNCTION ebafcd_uic "" /begin OUT_MEASUREMENT EBAFCD_st_mp /end OUT_MEASUREMENT /end FUNCTION
/begin FUNCTION ebfcd_actoutebox "E-Box Cooler Fan component driver"
 /begin DEF_CHARACTERISTIC EBFCD_ctPwrStgOnMax_C EBFCD_DebExcTempDef_C EBFCD_DebExcTempOk_C EBFCD_DebNoLoadDef_C EBFCD_DebNoLoadOk_C EBFCD_DebShortCircBatDef_C EBFCD_DebShortCircBatOk_C EBFCD_DebShortCircGndDef_C EBFCD_DebShortCircGndOk_C EBFCD_numDiaOut_C EBFCD_numDioOut_C EBFCD_stDigInvOut_C EBFCD_stSigOutErr_C EBFCD_stSPICtl_C EBFCD_swtOnOff_C EBFCD_tECUXLow_C EBFCD_tECUXHigh_C EBFCD_stECUYLow_C EBFCD_stECUYHigh_C EBFCD_tiBtwTst_C EBFCD_tiPwrStgOn_C /end DEF_CHARACTERISTIC
/end FUNCTION
/begin FUNCTION ebfcd_actoutebox_msg "" /begin OUT_MEASUREMENT EBFCD_stOut /end OUT_MEASUREMENT /end FUNCTION
/begin FUNCTION ebfcd_actoutebox_uic "" /begin OUT_MEASUREMENT EBFCD_st_mp /end OUT_MEASUREMENT /end FUNCTION
/begin FUNCTION ebtscd_gettempebox "ECU Temperature sensor component driver"
 /begin DEF_CHARACTERISTIC EBTSCD_uSRCMin_C EBTSCD_uSRCMax_C EBTSCD_tLin_CUR EBTSCD_OvrDebSRCHighDef_C EBTSCD_OvrDebSRCHighOk_C EBTSCD_DebSRCHighDef_C EBTSCD_DebSRCHighOk_C EBTSCD_DebSRCLowDef_C EBTSCD_DebSRCLowOk_C EBTSCD_numAdc_C EBTSCD_dtRmpSlpUp_C EBTSCD_dtRmpSlpDwn_C EBTSCD_tiTECUPT1_C EBTSCD_tOvrTemp_C EBTSCD_stSensIDWord_C EBTSCD_tDfl_C /end DEF_CHARACTERISTIC
 /begin IN_MEASUREMENT EBTSCD_uRawTECU_mp /end IN_MEASUREMENT
/end FUNCTION
/begin FUNCTION ebtscd_gettempebox_msg "" /begin OUT_MEASUREMENT EBTSCD_tCIntLin EBTSCD_tECU /end OUT_MEASUREMENT /end FUNCTION
/begin FUNCTION ebtscd_gettempebox_uic "" /begin OUT_MEASUREMENT EBTSCD_uRawTECU_mp /end OUT_MEASUREMENT /end FUNCTION
/begin FUNCTION ecbcd_co "EGR Bypass Valve Component Driver"
 /begin DEF_CHARACTERISTIC ECBCD_ctPwrStgOnMax_C ECBCD_numDia_C ECBCD_numDioOut_C ECBCD_stInvOut_C ECBCD_stOutActv_C ECBCD_stOutInActv_C ECBCD_stPwrStgActv_C ECBCD_stPwrStgDia_C ECBCD_stSPICtl_C ECBCD_tiBtwTst_C ECBCD_tiDebExcTempDef_C ECBCD_tiDebExcTempOk_C ECBCD_tiDebNoLoadDef_C ECBCD_tiDebNoLoadOk_C ECBCD_tiDebShortCircBatDef_C ECBCD_tiDebShortCircBatOk_C ECBCD_tiDebShortCircGndDef_C ECBCD_tiDebShortCircGndOk_C ECBCD_tiPwrStgOn_C /end DEF_CHARACTERISTIC
/end FUNCTION
/begin FUNCTION ecbcd_co_msg "" /begin OUT_MEASUREMENT ECBCD_stOut /end OUT_MEASUREMENT /end FUNCTION
/begin FUNCTION ecbcd_co_uic "" /end FUNCTION
/begin FUNCTION ecbvlv_co "AGR-Kühler-Bypass Koordinator" /end FUNCTION
/begin FUNCTION ecbvlv_co_msg "" /begin OUT_MEASUREMENT ECBVlv_rECB /end OUT_MEASUREMENT /end FUNCTION
/begin FUNCTION ecbvlv_co_uic "" /end FUNCTION
/begin FUNCTION ecu "" /begin DEF_CHARACTERISTIC ECU_vPrgThres_C /end DEF_CHARACTERISTIC /end FUNCTION
/begin FUNCTION eepcd "Komponenten Treiber für EEPROM Zugriffe" /begin DEF_CHARACTERISTIC EEPCD_stMILDfl_C /end DEF_CHARACTERISTIC /end FUNCTION
/begin FUNCTION eepcd_msg "" /begin OUT_MEASUREMENT EEPCD_stErrSet EEPCD_stMIL /end OUT_MEASUREMENT /end FUNCTION
/begin FUNCTION eepinit "EEPROM Erstinitialisierung" /begin DEF_CHARACTERISTIC /end DEF_CHARACTERISTIC /end FUNCTION
/begin FUNCTION eepinit_develop "ließt Bloecke vom EEPROM und schreibt ein Byte an waelbare Positionen" /begin DEF_CHARACTERISTIC /end DEF_CHARACTERISTIC /begin OUT_MEASUREMENT /end OUT_MEASUREMENT /end FUNCTION
/begin FUNCTION egppcd_actrout "Exhaust Gas pressure Pump Component Driver"
 /begin DEF_CHARACTERISTIC EGPpCD_ctPwrStgOnMax_C EGPpCD_numDia_C EGPpCD_numDioOut_C EGPpCD_stInvOut_C EGPpCD_stPwrStgActv_C EGPpCD_stSPICtl_C EGPpCD_tiBtwTst_C EGPpCD_tiDebExcTempDef_C EGPpCD_tiDebExcTempOk_C EGPpCD_tiDebNoLoadDef_C EGPpCD_tiDebNoLoadOk_C EGPpCD_tiDebShortCircBatDef_C EGPpCD_tiDebShortCircBatOk_C EGPpCD_tiDebShortCircGndDef_C EGPpCD_tiDebShortCircGndOk_C EGPpCD_tiPwrStgOn_C /end DEF_CHARACTERISTIC
/end FUNCTION
/begin FUNCTION egppcd_actrout_msg "" /begin OUT_MEASUREMENT EGPpCD_stActrOut /end OUT_MEASUREMENT /end FUNCTION
/begin FUNCTION egppcd_actrout_uic "" /end FUNCTION
/begin FUNCTION egpp_logic "Calculates the status of the Exhaust gas pressure pump"
 /begin DEF_CHARACTERISTIC EGPp_nAvrgLim_C EGPp_rLogicOutNHys_C EGPp_rLogicOutQHys_C EGPp_stFlapRgn_MAP EGPp_stFlap_MAP EGPp_stMskRgn_C /end DEF_CHARACTERISTIC
 /begin IN_MEASUREMENT Eng_nAvrg InjCtl_qCurr /end IN_MEASUREMENT
/end FUNCTION
/begin FUNCTION egpp_logic_msg "" /begin OUT_MEASUREMENT EGPp_stLogicOut /end OUT_MEASUREMENT /end FUNCTION
/begin FUNCTION egpp_logic_uic "" /end FUNCTION
/begin FUNCTION egpp_prescalc "Berechnung des Abgasdruckes"
 /begin DEF_CHARACTERISTIC EGPp_facGeoSil2_C EGPp_facGeoSil_C EGPp_facPow_CUR EGPp_facRhoEta_CUR EGPp_pPstPFlt_MAP EGPp_tiPresFltPT1_C EGPp_swtPresCalc_C /end DEF_CHARACTERISTIC
 /begin IN_MEASUREMENT EGPp_dvolSil_mp Eng_nAvrg InjCtl_qSetUnBal PFlt_tPstSim /end IN_MEASUREMENT
/end FUNCTION
/begin FUNCTION egpp_prescalc_msg "" /begin OUT_MEASUREMENT EGPp_pPstPFlt /end OUT_MEASUREMENT /end FUNCTION
/begin FUNCTION egpp_prescalc_uic "" /begin OUT_MEASUREMENT EGPp_dvolSil_mp EGPp_pPstPFltMap_mp EGPp_pPstPFltSim_mp /end OUT_MEASUREMENT /end FUNCTION
/begin FUNCTION egrcd "Komponententreiber Abgasrückführsteller"
 /begin DEF_CHARACTERISTIC EGRCD_ctPwrStgOnMax_C EGRCD_DebExcTempDef_C EGRCD_DebExcTempOk_C EGRCD_DebNoLoadDef_C EGRCD_DebNoLoadOk_C EGRCD_DebShortCircBatDef_C EGRCD_DebShortCircBatOk_C EGRCD_DebShortCircGndDef_C EGRCD_DebShortCircGndOk_C EGRCD_numDia_C EGRCD_numPwmOut_C EGRCD_stInvOut_C EGRCD_tiPer_C EGRCD_rCnv_MAP EGRCD_rOutMax_C EGRCD_rOutMin_C EGRCD_stPwrStgActv_C EGRCD_stPwrStgDia_C EGRCD_stSPICtl_C EGRCD_swt_C EGRCD_tiBtwTst_C EGRCD_tiPwrStgOn_C /end DEF_CHARACTERISTIC
 /begin IN_MEASUREMENT EGRVlv_rEGR Eng_nAvrg /end IN_MEASUREMENT
/end FUNCTION
/begin FUNCTION egrcd_msg "" /begin OUT_MEASUREMENT EGRCD_rOut /end OUT_MEASUREMENT /end FUNCTION
/begin FUNCTION egrcd_uic "" /begin OUT_MEASUREMENT EGRCD_rCnv_mp /end OUT_MEASUREMENT /end FUNCTION
/begin FUNCTION egrclg_ctlvalcalc "Steuerwertberechnung für AGR-Kühlert-Bypass"
 /begin DEF_CHARACTERISTIC EGRClg_numCtlValCalc_C EGRClg_qBypOff_CUR EGRClg_qBypOn_CUR EGRClg_stDflVal_C EGRClg_stRgnMsk_C EGRClg_tBypOff_C EGRClg_tBypOn_C EGRClg_tCldStrtThres_C EGRClg_tIATBypOff_C EGRClg_tIATBypOn_C EGRClg_tiCldStrt_C /end DEF_CHARACTERISTIC
 /begin IN_MEASUREMENT Eng_nAvrg /end IN_MEASUREMENT
/end FUNCTION
/begin FUNCTION egrclg_ctlvalcalc_msg "" /begin OUT_MEASUREMENT EGRClg_rECB /end OUT_MEASUREMENT /end FUNCTION
/begin FUNCTION egrclg_ctlvalcalc_uic ""
 /begin OUT_MEASUREMENT EGRClg_qBypOff_mp EGRClg_qBypOn_mp EGRClg_stCldStrt_mp EGRClg_stInt_mp EGRClg_stQHys_mp EGRClg_stRgn_mp EGRClg_stTHys_mp EGRClg_tCtlValCalc_mp /end OUT_MEASUREMENT
/end FUNCTION
/begin FUNCTION egrvlv_co "Stellerkoordinator Abgasrückführung" /end FUNCTION
/begin FUNCTION egrvlv_co_msg "" /begin OUT_MEASUREMENT EGRVlv_rEGR EGRVlv_rEGR2 /end OUT_MEASUREMENT /end FUNCTION
/begin FUNCTION egrvlv_co_uic ""
 /begin DEF_CHARACTERISTIC EGRVlv_rEGR2_Vector EGRVlv_rEGR2_Channel EGRVlv_rEGR_Vector EGRVlv_rEGR_Channel /end DEF_CHARACTERISTIC
 /begin OUT_MEASUREMENT EGRVlv_rEGR2Byp_mp EGRVlv_rEGRByp_mp /end OUT_MEASUREMENT
/end FUNCTION
/begin FUNCTION egsys_dewdet "Taupunktbestimmungslogik"
 /begin DEF_CHARACTERISTIC EGSys_dmPlsThresLSU_C EGSys_facCldStrtLSU_C EGSys_facPlsLSU_C EGSys_facPlsThresLSU_C EGSys_numMaxCldStrt_C EGSys_numTempThresLSU_C EGSys_swtDewDetShOff_C EGSys_tiDebLSU0_C EGSys_tiDebNrmTransOk_C EGSys_tiHtgDelLSU_C EGSys_tIntegIni_C EGSys_tiPlsLSU_C EGSys_tThresLSUAct_C EGSys_tThresLSU_C EGSys_tWtEquiv_C EGSys_wLSUIKi_C EGSys_wThresLSU0_MAP /end DEF_CHARACTERISTIC
 /begin IN_MEASUREMENT EGSys_tEGLSUInpCrv0_mp Eng_tEng /end IN_MEASUREMENT
 /begin OUT_MEASUREMENT EGSys_cpEGLSU_mp EGSys_ctCldStrtLSU_mp EGSys_dwLSU_mp EGSys_stHtgLSULstTrp_mp EGSys_stHtgThresLSUHit_mp EGSys_stIntegIni_mp EGSys_stPlsLSU_mp EGSys_wLSU_mp EGSys_wThresLSUAct_mp EGSys_wThresLSUNoPls_mp EGSys_wThresLSUPls_mp EGSys_wThresLSU_mp /end OUT_MEASUREMENT
/end FUNCTION
/begin FUNCTION egsys_dewdet_msg "" /begin OUT_MEASUREMENT EGSys_stHtgLSU /end OUT_MEASUREMENT /end FUNCTION
/begin FUNCTION egsys_dewdet_uic "" /end FUNCTION
/begin FUNCTION egsys_mdlbackpres "Berechnung des Abgasgegendrucks" /begin DEF_CHARACTERISTIC EGSys_dpExhGas_MAP EGSys_pConstVal_C EGSys_swtPresSel_C /end DEF_CHARACTERISTIC /begin IN_MEASUREMENT Eng_nAvrg InjCtl_qSetUnBal /end IN_MEASUREMENT /end FUNCTION
/begin FUNCTION egsys_mdlbackpres_msg "" /begin OUT_MEASUREMENT EGSys_pExhGas /end OUT_MEASUREMENT /end FUNCTION
/begin FUNCTION egsys_mdlbackpres_uic "" /end FUNCTION
/begin FUNCTION egsys_tegco "Schnittstellenkoordinator für Abgastemperaturmodell"
 /begin DEF_CHARACTERISTIC EGSys_cndHtEG_CUR EGSys_cpEG_MAP EGSys_dmEGMinVal_C EGSys_numECU_C EGSys_numRdPosLSU2_C EGSys_numRdPosLSUWall_C EGSys_numRdPosLSU_C EGSys_numRdPosNSC2_C EGSys_numRdPosNSC_C EGSys_numRdPosOxiCat2_C EGSys_numRdPosOxiCat_C EGSys_numRdPosTrbn2_C EGSys_numRdPosTrbn_C EGSys_numRdPosTube2_C EGSys_numRdPosTube_C EGSys_vscDynEG_CUR EGSys_vscKinEG_CUR /end DEF_CHARACTERISTIC
 /begin IN_MEASUREMENT EGSys_rLmbdAprx /end IN_MEASUREMENT
 /begin OUT_MEASUREMENT EGSys_tEGLSUInpCrv0_mp EGSys_tEGLSUInpCrv1_mp EGSys_tEGLSUInpCrv2_mp EGSys_tEGLSUInpCrv3_mp EGSys_tMem_mp /end OUT_MEASUREMENT
/end FUNCTION
/begin FUNCTION egsys_tegco_msg ""
 /begin OUT_MEASUREMENT EGSys_dmEG EGSys_qMIStd EGSys_qPoIRgn EGSys_rLmbdAprx EGSys_tEGLSU EGSys_tEGPreNSC EGSys_tEGPreOxiCat EGSys_tEGPreTrbn EGSys_tEGPreTube EGSys_tWallLSU /end OUT_MEASUREMENT
/end FUNCTION
/begin FUNCTION egsys_tegco_uic "" /begin OUT_MEASUREMENT EGSys_tShOffTExcClnt_mp /end OUT_MEASUREMENT /end FUNCTION
/begin FUNCTION egsys_tegco_var "" /begin DEF_CHARACTERISTIC EGSys_tExcClntDfl_C /end DEF_CHARACTERISTIC /end FUNCTION
/begin FUNCTION egsys_tegmod "Abgastemperaturmodell"
 /begin DEF_CHARACTERISTIC EGSys_dmAir_MAP EGSys_facAirMass_CUR EGSys_facCorrCldEng_CUR EGSys_facIAT_CUR EGSys_facStrtDlv_CUR EGSys_phiStrtDlv_MAP EGSys_tEngStat_C EGSys_tIAT_MAP EGSys_tManfDfl_C EGSys_tManfStat_MAP /end DEF_CHARACTERISTIC
 /begin IN_MEASUREMENT EGSys_phiDiffStrt_mp EGSys_rAirPerTime_mp EGSys_tDiffCldEng_mp EGSys_tDiffIAT_mp Eng_nAvrg InjCtl_qCurr /end IN_MEASUREMENT
/end FUNCTION
/begin FUNCTION egsys_tegmod_msg "" /begin OUT_MEASUREMENT EGSys_tManfStat /end OUT_MEASUREMENT /end FUNCTION
/begin FUNCTION egsys_tegmod_uic ""
 /begin OUT_MEASUREMENT EGSys_facAirMass_mp EGSys_facStrtDlv_mp EGSys_phiDiffStrt_mp EGSys_rAirPerTime_mp EGSys_tCorrIAT_mp EGSys_tCorrManf_mp EGSys_tDiffCldEng_mp EGSys_tDiffIAT_mp EGSys_tManfStat_mp /end OUT_MEASUREMENT
/end FUNCTION
/begin FUNCTION egsys_tnscmod "Temperaturmodell für NOx-Speicherkatalysator"
 /begin DEF_CHARACTERISTIC EGSys_cpNSC_C EGSys_tiPT1NSC_C EGSys_swtTimeNSC_C EGSys_tNSCDfl_C EGSys_tNSCExoIncr_MAP /end DEF_CHARACTERISTIC
 /begin IN_MEASUREMENT EGSys_rLmbdAprx EGSys_tAvrgNSC_mp /end IN_MEASUREMENT
/end FUNCTION
/begin FUNCTION egsys_tnscmod_msg "" /begin OUT_MEASUREMENT EGSys_tNSC /end OUT_MEASUREMENT /end FUNCTION
/begin FUNCTION egsys_tnscmod_uic ""
 /begin OUT_MEASUREMENT EGSys_cpEGNSC_mp EGSys_tAvrgNSC_mp EGSys_tNSCExoIncr_mp EGSys_tNSCStat_mp /end OUT_MEASUREMENT
/end FUNCTION
/begin FUNCTION egsys_toxicatmod "Temperaturmodel für Oxidationskatalysator"
 /begin DEF_CHARACTERISTIC EGSys_CalValFl_C EGSys_cpOxiCat_C EGSys_facTempCmb_CUR EGSys_tiPT1OxiCat_C EGSys_stOxiModActvMsk_C EGSys_tOxiCatDfl_C EGSys_tOxiCatExoIncr_MAP EGSys_dtOxiTempUp_C EGSys_dtOxiTempDwn_C /end DEF_CHARACTERISTIC
 /begin IN_MEASUREMENT EGSys_rLmbdAprx EGSys_tAvrgOxiCat_mp /end IN_MEASUREMENT
/end FUNCTION
/begin FUNCTION egsys_toxicatmod_msg "" /begin OUT_MEASUREMENT EGSys_tOxiCat /end OUT_MEASUREMENT /end FUNCTION
/begin COMPU_METHOD AirMassPerTime "Luftmasse pro Zeit" RAT_FUNC "%6.3" "Kg/h" COEFFS 0 10 0 0 0 1 /end COMPU_METHOD
/begin COMPU_METHOD AngleCrS "Winkel Kurbelwelle" RAT_FUNC "%6.4" "deg CrS" COEFFS 0 42.6666666666667 0 0 0 1 /end COMPU_METHOD
/begin COMPU_METHOD Calory "Heizwert" RAT_FUNC "%6.0" "J/g" COEFFS 0 0.01 0 0 0 1 /end COMPU_METHOD
/begin COMPU_METHOD CubMtrPerHr "Volumsstrom in m^3/h" RAT_FUNC "%6.3" "m^3/h" COEFFS 0 10 0 0 0 1 /end COMPU_METHOD
/begin COMPU_METHOD DfpName "Verbale Umrechnung für Fehlerpfadnamen" TAB_VERB "%6.3" "-" COMPU_TAB_REF DfpName /end COMPU_METHOD
/begin COMPU_VTAB DfpName "Verbale Umrechnung für Fehlerpfadnamen" TAB_VERB 357 0 "Dfp_unused" 1 "Dfp_Layer_TANS" 2 "Dfp_ACCDCmpr" 3 "Dfp_ACCDPres" 4 "Dfp_ACCDPres1" 5 "Dfp_ACCDPresAna" 6 "Dfp_ACCDSwtin" 7 "Dfp_ACC_PlausTrqDes" 8 "Dfp_ACC_trqInr" 9 "Dfp_ACTrq" 10 "Dfp_ADCMon" 11 "Dfp_AFSCDIdlAdjVal" 12 "Dfp_AFSCDLdAdjVal" 13 "Dfp_AFSCD_AirTempDcyc" 14 "Dfp_AFSCD_PlOffsDrft" 15 "Dfp_AFSCD_PlSetyDrft" 16 "Dfp_AFSCD_SRCAirTemp" 17 "Dfp_AFSCD_SRCBatt" 18 "Dfp_AFSCD_SRCCorrAirm" 19 "Dfp_AFSCD_SRCRawAirm" 20 "Dfp_Layer_TUMG" 21 "Dfp_AFSCD_SRCRefSigPer" 22 "Dfp_AOHtCD" 23 "Dfp_Layer_GEN" 24 "Dfp_Layer_BSD" 25 "Dfp_AOHtCD_AOHtDia1" 26 "Dfp_AOHtCD_AOHtDia2" 27 "Dfp_AOHtCD_AOHtDia3" 28 "Dfp_APP1" 29 "Dfp_APP2" 30 "Dfp_APPCDCmpd" 31 "Dfp_APPSync" 32 "Dfp_APSCD" 33 "Dfp_ARS" 34 "Dfp_AccPedPlausBrk" 35 "Dfp_Layer_QLT" 36 "Dfp_AirCtlGvnrDvtRgnMax" 37 "Dfp_Layer_IBS1" 38 "Dfp_Layer_IBS2" 39 "Dfp_Layer_IBS3" 40 "Dfp_Layer_PMBN" 41 "Dfp_Layer_PMBATT" 42 "Dfp_AirCtlGvnrDvtRgnMin" 43 "Dfp_AirCtlGvnrDvtRgnMn2" 44 "Dfp_AirCtlGvnrDvtRgnMx2" 45 "Dfp_AirCtlPlateBreak" 46 "Dfp_AirCtlRmpTO" 47 "Dfp_AirCtl_GovNegDev" 48 "Dfp_AirCtl_GovNegDev2" 49 "Dfp_AirCtl_GovPosDev" 50 "Dfp_AirCtl_GovPosDev2" 51 "Dfp_AltCD" 52 "Dfp_AltCD_Load" 53 "Dfp_BPACD_BPADia1" 54 "Dfp_BPACD_BPADia2" 55 "Dfp_BPACD_BPADia3" 56 "Dfp_BPACD_BPADia4" 57 "Dfp_BPACD_Max" 58 "Dfp_BPACD_Min" 59 "Dfp_BPACD_PwmIn" 60 "Dfp_BPACD_PwmInDia1" 61 "Dfp_BPACD_PwmInDia2" 62 "Dfp_BPACD_PwmInDia3" 63 "Dfp_BPACD_PwmInDia4" 64 "Dfp_BPACD_SigNpl" 65 "Dfp_BPSCD" 66 "Dfp_BattCD" 67 "Dfp_BrkCD" 68 "Dfp_Bss" 69 "Dfp_CBACD" 70 "Dfp_CTSCD" 71 "Dfp_Clg_DynTst" 72 "Dfp_CmbChbMisfire1" 73 "Dfp_CmbChbMisfire2" 74 "Dfp_Layer_PMRUHVERL" 75 "Dfp_CmbChbMisfire3" 76 "Dfp_CmbChbMisfire4" 77 "Dfp_CmbChbMisfire5" 78 "Dfp_CmbChbMisfire6" 79 "Dfp_Layer_TOENS" 80 "Dfp_Layer_MANHYDR" 81 "Dfp_Layer_MANLUFT" 82 "Dfp_CmbChbMisfireMul" 83 "Dfp_CoVMDCSh" 84 "Dfp_ConvCD" 85 "Dfp_CrCCDMFL" 86 "Dfp_CrCtl_vCrCtl" 87 "Dfp_DCC_PlausTrqDes" 88 "Dfp_Dummy1" 89 "Dfp_EATSCD" 90 "Dfp_EBAFCD" 91 "Dfp_EBFCD" 92 "Dfp_EBTSCD" 93 "Dfp_EBTSCD_OvrTemp" 94 "Dfp_ECBCD" 95 "Dfp_EEPCDVarMng" 96 "Dfp_EGPpCD" 97 "Dfp_EGPpCDTPreTrbn" 98 "Dfp_EGRCD_Max" 99 "Dfp_EGRCD_Min" 100 "Dfp_EGRCD_SigNpl" 101 "Dfp_EGTOilLvlCrit" 102 "Dfp_EGTOilVscCrit" 103 "Dfp_EGTRgnOilDil" 104 "Dfp_EGTTempGvnrInr" 105 "Dfp_EGTTempGvnrOutr" 106 "Dfp_EMCCD1" 107 "Dfp_EMCCD2" 108 "Dfp_EMCCD_ADC1" 109 "Dfp_EMCCD_ADC2" 110 "Dfp_ETClbETFltInj1" 111 "Dfp_ETClbETFltInj2" 112 "Dfp_ETClbETFltInj3" 113 "Dfp_ETClbETFltInj4" 114 "Dfp_ETClbETFltInj5" 115 "Dfp_ETClbETFltInj6" 116 "Dfp_ETClbInj1" 117 "Dfp_ETClbInj2" 118 "Dfp_ETClbInj3" 119 "Dfp_ETClbInj4" 120 "Dfp_ETClbInj5" 121 "Dfp_ETClbInj6" 122 "Dfp_EngMCaS1" 123 "Dfp_EngMCrS1" 124 "Dfp_EngMOfsCaSCrS" 125 "Dfp_EngPrtFWODet" 126 "Dfp_FBCqDvt" 127 "Dfp_FMAErrMod" 128 "Dfp_FMTC_NonMonotonMap" 129 "Dfp_FTSCD" 130 "Dfp_FanCD" 131 "Dfp_FanCD_FanCtlr1" 132 "Dfp_FanCD_FanCtlr2" 133 "Dfp_FanCD_FanCtlr3" 134 "Dfp_FlFCD" 135 "Dfp_FlMngSmkDefect" 136 "Dfp_FrmMngANFRADMOMPT" 137 "Dfp_FrmMngASC1" 138 "Dfp_FrmMngASC2" 139 "Dfp_FrmMngASC3" 140 "Dfp_FrmMngASC4" 141 "Dfp_FrmMngBOS_RESET" 142 "Dfp_FrmMngBOS_RESET2" 143 "Dfp_FrmMngDMANFAFS" 144 "Dfp_FrmMngDRMANFSSG" 145 "Dfp_FrmMngEGS1" 146 "Dfp_FrmMngEGS2" 147 "Dfp_FrmMngGEARBX_DATA" 148 "Dfp_FrmMngGEARBX_DATA2" 149 "Dfp_FrmMngHEAT_AC" 150 "Dfp_FrmMngINSTR2" 151 "Dfp_FrmMngINSTR3" 152 "Dfp_FrmMngLENKRADWINKEL" 153 "Dfp_FrmMngMILEAGE_RANGE" 154 "Dfp_FrmMngOPCRCTLACC" 155 "Dfp_FrmMngPRGG_CCTR" 156 "Dfp_FrmMngPWRMNG_LOADV" 157 "Dfp_FrmMngParkConsumer" 158 "Dfp_FrmMngRQSTGEFAN" 159 "Dfp_FrmMngSSGErr" 160 "Dfp_FrmMngSSGShOff" 161 "Dfp_FrmMngSTAT_ANH" 162 "Dfp_FrmMngSTAT_ARS" 163 "Dfp_FrmMngSTAT_DSC" 164 "Dfp_FrmMngSTAT_EKP" 165 "Dfp_FrmMngSTAT_KOMBI" 166 "Dfp_FrmMngSTAT_SITZ" 167 "Dfp_FrmMngStOBDGbxMilOf" 168 "Dfp_FrmMngStOBDGbxMilOn" 169 "Dfp_FrmMngTEMPRELTIME" 170 "Dfp_FrmMngTERMINAL" 171 "Dfp_FrmMngTIME_DATE" 172 "Dfp_FrmMngTORQUE_DSC" 173 "Dfp_FrmMngTORQUE_GEARBX" 174 "Dfp_FrmMngTrq_ReqACC" 175 "Dfp_FrmMngVEH_MOD" 176 "Dfp_FrmMngVELOCITY" 177 "Dfp_FrmMngWHEEL_SPEED" 178 "Dfp_FrmMngstCurr" 179 "Dfp_FrmMngswtPSPOff" 180 "Dfp_GearbxIncMax" 181 "Dfp_GlwCD" 182 "Dfp_GlwCDGlwCirc1" 183 "Dfp_GlwCDGlwCirc2" 184 "Dfp_GlwCDGlwCirc3" 185 "Dfp_GlwCDGlwCirc4" 186 "Dfp_GlwCDGlwCirc5" 187 "Dfp_GlwCDGlwCirc6" 188 "Dfp_GlwCDGlwCirc7" 189 "Dfp_GlwCDGlwCirc8" 190 "Dfp_GlwCtl" 191 "Dfp_HWEMonCom" 192 "Dfp_HWEMonEEPROM" 193 "Dfp_HWEMonRcyLocked" 194 "Dfp_HWEMonRcySuppressed" 195 "Dfp_HWEMonRcyVisible" 196 "Dfp_HWEMonUMaxSupply" 197 "Dfp_HWEMonUMinSupply" 198 "Dfp_IATSCD" 199 "Dfp_IATSCD_CATS" 200 "Dfp_ImmCtlImmCD" 201 "Dfp_ImmCtlImmEep" 202 "Dfp_ImmCtlMpl" 203 "Dfp_IndSys1" 204 "Dfp_IndSys2" 205 "Dfp_InjCrv_InjLim" 206 "Dfp_InjCtlAdjQnt" 207 "Dfp_InjCtlDrift" 208 "Dfp_InjVlvBnk1A" 209 "Dfp_InjVlvBnk1B" 210 "Dfp_InjVlvBnk2A" 211 "Dfp_InjVlvBnk2B" 212 "Dfp_InjVlvChipA" 213 "Dfp_InjVlvChipB" 214 "Dfp_InjVlvCyl1A" 215 "Dfp_InjVlvCyl1B" 216 "Dfp_InjVlvCyl2A" 217 "Dfp_InjVlvCyl2B" 218 "Dfp_InjVlvCyl3A" 219 "Dfp_InjVlvCyl3B" 220 "Dfp_InjVlvCyl4A" 221 "Dfp_InjVlvCyl4B" 222 "Dfp_InjVlvCyl5A" 223 "Dfp_InjVlvCyl5B" 224 "Dfp_InjVlvCyl6A" 225 "Dfp_InjVlvCyl6B" 226 "Dfp_KeyCheck" 227 "Dfp_LIGovECUTransMode" 228 "Dfp_LPACD_Max" 229 "Dfp_LPACD_Min" 230 "Dfp_LPACD_SigNpl" 231 "Dfp_LSUCDCircNernst0" 232 "Dfp_LSUCDCircPumpCur0" 233 "Dfp_LSUCDCircVirtGnd0" 234 "Dfp_LSUCDHeater0" 235 "Dfp_LSUCDHtCoup0" 236 "Dfp_LSUCDO20" 237 "Dfp_LSUCDO2Clb0" 238 "Dfp_LSUCDRiClb0" 239 "Dfp_LSUCDSPI0" 240 "Dfp_LSUCDSPIBattLow0" 241 "Dfp_LSUCDWireIP0" 242 "Dfp_LSUCtlRiExc0" 243 "Dfp_LSUMon1Sens" 244 "Dfp_LSUMon2Sens" 245 "Dfp_MIL" 246 "Dfp_MRlyCD" 247 "Dfp_MSidCD_Comm" 248 "Dfp_MSidCD_Pin" 249 "Dfp_MSidCD_Sel_INI" 250 "Dfp_MSidCD_Select" 251 "Dfp_MeUnCDNoLoad" 252 "Dfp_MeUnCDSCBat" 253 "Dfp_MeUnCDSCGnd" 254 "Dfp_MeUnCD_ADC" 255 "Dfp_MeUnCD_SigTst" 256 "Dfp_Montr" 257 "Dfp_NetMngDeviceA" 258 "Dfp_NetMngDeviceB" 259 "Dfp_NetMngDeviceC" 260 "Dfp_NetMngPtCan" 261 "Dfp_OPSCD_Lamp" 262 "Dfp_OPSCD_anain" 263 "Dfp_OTSCD" 264 "Dfp_OvRMon" 265 "Dfp_OvRMonSigA" 266 "Dfp_OxiCCDTPre" 267 "Dfp_PCBS" 268 "Dfp_PCR_GovDevNeg" 269 "Dfp_PCR_GovDevPos" 270 "Dfp_PCR_LPGvnrDvtNeg" 271 "Dfp_PCR_LPGvnrDvtPos" 272 "Dfp_PCVCDNoLoad" 273 "Dfp_PCVCDSCBat" 274 "Dfp_PCVCDSCGnd" 275 "Dfp_PCVCD_ADC" 276 "Dfp_PCVCD_SigTst" 277 "Dfp_PFltAPSPlaus" 278 "Dfp_PFltAPSens" 279 "Dfp_PFltBPSPlaus" 280 "Dfp_PFltCDPPre" 281 "Dfp_PFltCDTempPre" 282 "Dfp_PFltChar" 283 "Dfp_PFltEngPrt" 284 "Dfp_PFltOvldInhRgn" 285 "Dfp_PFltOvldTrqLim" 286 "Dfp_PFltPresDynPlaus" 287 "Dfp_PFltPresPlaus" 288 "Dfp_PFltPresSens" 289 "Dfp_PFltPresSensFrz" 290 "Dfp_PFltPresSensHsLn" 291 "Dfp_PFltPresSensSot" 292 "Dfp_PFltRgnPerm" 293 "Dfp_PFltTempDwnStrm" 294 "Dfp_PFltTempSens" 295 "Dfp_PFltTempUpStrm" 296 "Dfp_PFlt_tOxiPreMax" 297 "Dfp_PFlt_tOxiPreMxRgn" 298 "Dfp_PFlt_tPreMax" 299 "Dfp_PFlt_tPreMaxRgn" 300 "Dfp_PFltmSotDiffMax" 301 "Dfp_PSPCD_Actr" 302 "Dfp_PresPlausDblDef" 303 "Dfp_QLTCD" 304 "Dfp_RailCD" 305 "Dfp_RailCDOfsTst" 306 "Dfp_RailCD_PMonStrt" 307 "Dfp_RailCtlModeMeUnDiag" 308 "Dfp_RailCtlModePCVDiag" 309 "Dfp_RailMeUn0" 310 "Dfp_RailMeUn1" 311 "Dfp_RailMeUn2" 312 "Dfp_RailMeUn3" 313 "Dfp_RailMeUn4" 314 "Dfp_RailPCV0" 315 "Dfp_RailPCV1" 316 "Dfp_RailPCV2" 317 "Dfp_RailPCV3" 318 "Dfp_RailPCV4" 319 "Dfp_RailPCV5" 320 "Dfp_SOPTst" 321 "Dfp_SSpMon1" 322 "Dfp_SSpMon2" 323 "Dfp_SSpMon3" 324 "Dfp_SWChk_CycSigChkDat" 325 "Dfp_SWChk_CycSigChkPrg" 326 "Dfp_ShutCD" 327 "Dfp_StSysTrqShutOff" 328 "Dfp_StrtCD_Actr" 329 "Dfp_SysLamp" 330 "Dfp_T15CD" 331 "Dfp_TGearbx" 332 "Dfp_TPUMon" 333 "Dfp_TVACD_Max" 334 "Dfp_TVACD_Min" 335 "Dfp_TVACD_SigNpl" 336 "Dfp_TVACD_TVADia1" 337 "Dfp_TVACD_TVADia2" 338 "Dfp_TVACD_TVADia3" 339 "Dfp_TVACD_TVADia4" 340 "Dfp_ThrVlvMon" 341 "Dfp_VSACD_DiaDet" 342 "Dfp_VSACD_DioInDia1" 343 "Dfp_VSACD_DioInDia2" 344 "Dfp_VSACD_DioInDia3" 345 "Dfp_VSACD_DioInDia4" 346 "Dfp_VSACD_DioInMin" 347 "Dfp_VSACD_Max" 348 "Dfp_VSACD_Min" 349 "Dfp_VSACD_SigNpl" 350 "Dfp_VSACD_VSADia1" 351 "Dfp_VSACD_VSADia2" 352 "Dfp_VSACD_VSADia3" 353 "Dfp_VSACD_VSADia4" 354 "Dfp_VSSCD1" 355 "Dfp_VSSCD2" 356 "Dfp_WdCom" /end COMPU_VTAB
/begin COMPU_METHOD DtyCyc "Tastverhaeltnis" RAT_FUNC "%6.4" "%" COEFFS 0 100 0 0 0 1 /end COMPU_METHOD
/begin COMPU_METHOD Energy "Energie in Joule" RAT_FUNC "%6.2" "kJ" COEFFS 0 1 0 0 0 1 /end COMPU_METHOD
/begin COMPU_METHOD EngN "Motordrehzahl" RAT_FUNC "%6.2" "rpm" COEFFS 0 1 0 0 0 1 /end COMPU_METHOD
/begin COMPU_METHOD EngTempFldSel "Verbale Umrechnung für Auswahl aus dem Motortemperatur-Feld Eng_tFld" TAB_VERB "%6.3" "-" COMPU_TAB_REF EngTempFldSel /end COMPU_METHOD
/begin COMPU_VTAB EngTempFldSel "Verbale Umrechnung für Auswahl aus dem Motortemperatur-Feld Eng_tFld" TAB_VERB 3 0 "Coolant_Temperature" 1 "Oil_Temperature" 2 "Eng_tEng" /end COMPU_VTAB
/begin COMPU_METHOD Fact "Faktor mit Auflösung 1 / 8192, hauptsächlich für einen Faktorenbereich 0...1 verwendet" RAT_FUNC "%6.5" "-" COEFFS 0 8192 0 0 0 1 /end COMPU_METHOD
/begin COMPU_METHOD Fact1 "Faktor mit Auflösung 0,01 (100 mal höherer Bereich als Fact)" RAT_FUNC "%6.4" "-" COEFFS 0 128 0 0 0 1 /end COMPU_METHOD
/begin COMPU_METHOD FanSpd "(MAXSINT16 / FANSPD_MAX) * phys" RAT_FUNC "%6.3" "1/min" COEFFS 0 10.9223333333333 0 0 0 1 /end COMPU_METHOD
/begin COMPU_METHOD FCMChkCause "Verbale Umrechnung für Message für DSM internen gebrauch (unterstützung bei DSM problemen)" TAB_VERB "%6.3" "-" COMPU_TAB_REF FCMChkCause /end COMPU_METHOD
/begin COMPU_VTAB FCMChkCause "Verbale Umrechnung für Message für DSM internen gebrauch (unterstützung bei DSM problemen)" TAB_VERB 15 1 "fcmEnd npl: fcmEnd > FCM_TAB_SIZE" 2 "Erf and Typ npl" 3 "fcmEnd npl: line == fcmEnd" 4 "Mem set but no entry" 5 "No Mem set but entry" 6 "Mem npl class blocked" 7 "class npl" 8 "Mil npl 1" 9 "Mil npl 2" 10 "Scatt npl" 11 "Flc npl" 12 "Hlc npl" 13 "Fcm blocked" 14 "complement npl" 15 "dpfToClear are blocked" /end COMPU_VTAB
/begin COMPU_METHOD HeatCapacity "Waermekapazitaet einer Substanz" RAT_FUNC "%6.3" "J/K" COEFFS 0 10 0 0 0 1 /end COMPU_METHOD
/begin COMPU_METHOD InjMass "Einspritzmenge" RAT_FUNC "%6.4" "mg/hub" COEFFS 0 100 0 0 0 1 /end COMPU_METHOD
/begin COMPU_METHOD InjMassCorr "Korrektureinspritzmenge" RAT_FUNC "%6.5" "mg/hub" COEFFS 0 1000 0 0 0 1 /end COMPU_METHOD
/begin COMPU_METHOD InjMassCyc "Einspritzmenge pro Zyklus (mg/Zyklus)" RAT_FUNC "%6.4" "mg/cyc" COEFFS 0 100 0 0 0 1 /end COMPU_METHOD
/begin COMPU_METHOD InjMassInj "Einspritzmenge pro Einspritzung (mg/Einspritzung)" RAT_FUNC "%6.4" "mg/inj" COEFFS 0 100 0 0 0 1 /end COMPU_METHOD
/begin COMPU_METHOD lambda "Lambda" RAT_FUNC "%6.5" "-" COEFFS 0 1000 0 0 0 1 /end COMPU_METHOD
/begin COMPU_METHOD NumPinAdc "verbale Umrechnung für ADC Signale" TAB_VERB "%6.3" "-" COMPU_TAB_REF NumPinAdc /end COMPU_METHOD
/begin COMPU_VTAB NumPinAdc "verbale Umrechnung für ADC Signale" TAB_VERB 27 0 "Water_Temperature_Sensor_182" 1 "Intake_Air_Temperature_Sensor_157" 2 "Charge_Air_Temperature_Sensor_183" 3 "Exhaust_Temperature_Sensor_2_134" 4 "Exhaust_Temperature_Sensor_1_158" 5 "1st_APP_Sensor_252" 6 "2nd_APP_Sensor_239" 7 "ADC_REF" 8 "Boost_Pressure_Sensor_154" 9 "Atmospheric_Pressure_Sensor" 10 "Battery_Voltage_Sensor" 11 "Rail_Pressure_Sensor_156" 12 "Rail_Pressure_Peak_Value_156" 13 "Booster_Voltage_Sensor" 14 "Current_MeUn_Sensor" 15 "Current_PCV_Sensor" 16 "Voltage_Bank_1" 17 "Voltage_Bank_2" 18 "Pressure_Upstream_Particle_Filter_159" 19 "Engine_Oil_Pressure_110" 20 "Temperature_ECU_PCB" 21 "Voltage_Lambda_Ua" 22 "Voltage_Lambda_Ri" 23 "EMCCD_Current_Governor1_124" 24 "EMCCD_Current_Governor2_121" 25 "ADC_DUMMY_NOT_USED" 26 "ADC_DUMMY_A_NOT_USED" /end COMPU_VTAB
/begin COMPU_METHOD NumPinDia "Verbale Umrechnung für Diagnose Signale" TAB_VERB "%6.3" "-" COMPU_TAB_REF NumPinDia /end COMPU_METHOD
/begin COMPU_VTAB NumPinDia "Verbale Umrechnung für Diagnose Signale" TAB_VERB 28 0 "CJ945_Diagnostic_Signal" 1 "AC_Compressor_DiaSig" 2 "Fuel_Pump_Diagnostic_Signal_232" 3 "Starter_234" 4 "Oil_Pressure_Lamp_Switch_245" 5 "EGRClg_Byp_Diagnostic_Signal_123" 6 "Ebox_Fan_Actuator_Diagnostic_Signal_219" 7 "Shuttr_Actuator_Diagnostic_Signal_231" 8 "Twostage_TurboLoading_SW_DiaSig" 9 "DIO_OUT_DIAGNOSTIC_DUMMY_NOT_USED" 10 "Alternator" 11 "Boost_Pressure_Actuator_Diagnostic_Signal_193" 12 "EGR_Actuator_Diagnostic_Signal_194" 13 "1st_Pressure_Control_Valve_Diagnostic_Signal_172" 14 "2nd_Pressure_Control_Valve_Diagnostic_Signal_172" 15 "1st_Metering_Unit_Diagnostic_Signal_171" 16 "2nd_Metering_Unit_Diagnostic_Signal_171" 17 "Variable_Swirl_Actuator_Diagnostic_Signal_195" 18 "FAN_240" 19 "Add_On_Heater_244" 20 "EngM_Bearing_Actuator_Diagnostic_Signal_124" 21 "EngM_Bearing_Actuator_Diagnostic_Signal_121" 22 "Throttle_Valve_Diagnostic_Signal_196" 23 "Low pressure stage BPA_Diagnostic_Signal_117" 24 "PWM_DIAGNOSTIC_DUMMY_NOT_USED" 25 "1st_Sensor_Supply_Voltage_DiaSig" 26 "2nd_Sensor_Supply_Voltage_DiaSig" 27 "3rd_Sensor_Supply_Voltage_DiaSig" /end COMPU_VTAB
/begin COMPU_METHOD NumPinDioOut "Verbale Umrechnung für Digitalausgang Signale" TAB_VERB "%6.3" "-" COMPU_TAB_REF NumPinDioOut /end COMPU_METHOD
/begin COMPU_VTAB NumPinDioOut "Verbale Umrechnung für Digitalausgang Signale" TAB_VERB 12 0 "Main_Relay_220(144)" 1 "AC_Compressor" 2 "Fuel_Pump_232" 3 "Starter_234" 4 "OPS_Lamp_245" 5 "EGRClg_Byp_123" 6 "Ebox_Fan_Actuator_219" 7 "Shuttr_Actuator_Digital_231" 8 "STATREG_PSOFF_Bit" 9 "Twostage_TurboLoading_120" 10 "TD_Signal_253" 11 "DIO_OUT_DUMMY_NOT_USED" /end COMPU_VTAB
/begin COMPU_METHOD NumPinPwmOut "Verbale Umrechnung für PWM-Ausgang Signale" TAB_VERB "%6.3" "-" COMPU_TAB_REF NumPinPwmOut /end COMPU_METHOD
/begin COMPU_VTAB NumPinPwmOut "Verbale Umrechnung für PWM-Ausgang Signale" TAB_VERB 14 0 "Boost_Pressure_Actuator_193" 1 "EGR_Actuator_194" 2 "PCV_Actuator_172" 3 "MeUn_Actuator_171" 4 "Variable_Swirl_Actuator_195" 5 "Fan_Actuator_240" 6 "Add_On_Heater_244" 7 "EngM_Bearing_Actuator_124" 8 "EngM_Bearing_Actuator_121" 9 "Throttle_Valve_196" 10 "LSU_Heater_PWMOutput" 11 "Low pressure stage BPA_117" 12 "Shuttr_Actuator_PWM_231" 13 "PWM_DUMMY_NOT_USED" /end COMPU_VTAB
/begin COMPU_METHOD OneToOne "eins zu eins (physikalischer Wert ist gleich dem internen Wert)" RAT_FUNC "%6.2" "-" COEFFS 0 1 0 0 0 1 /end COMPU_METHOD
/begin COMPU_METHOD Period "Periodendauer" RAT_FUNC "%6.3" "ms" COEFFS 0 10 0 0 0 1 /end COMPU_METHOD
/begin COMPU_METHOD Prc "Prozent, gleiche interne Auflösung wie Fact, aber Darstellung in Prozent (0...100%)" RAT_FUNC "%6.4" "%" COEFFS 0 81.92 0 0 0 1 /end COMPU_METHOD
/begin COMPU_METHOD Pres_hPa "Druck (angezeigt in [hPa])" RAT_FUNC "%6.2" "hPa" COEFFS 0 1 0 0 0 1 /end COMPU_METHOD
/begin COMPU_METHOD Pwr_kW_Sec "Leistungsaenderungsrate in kW/s" RAT_FUNC "%6.4" "kW/s" COEFFS 0 100 0 0 0 1 /end COMPU_METHOD
/begin COMPU_METHOD RdyOnMilEnable "Verbale Umrechnung für DSM_RdyOnMilEnable_C" TAB_VERB "%6.3" "-" COMPU_TAB_REF RdyOnMilEnable /end COMPU_METHOD
/begin COMPU_VTAB RdyOnMilEnable "Verbale Umrechnung für DSM_RdyOnMilEnable_C" TAB_VERB 2 0 "normal" 1 "set all Rdy bits on Mil ON" /end COMPU_VTAB
/begin COMPU_METHOD RmpTemp "Rampengradient für Temperatur" RAT_FUNC "%6.4" "deg C/s" COEFFS 0 655.36 0 0 0 1 /end COMPU_METHOD
/begin COMPU_METHOD RmpTempCels "temperature ramp gradient in Centigrade" RAT_FUNC "%8.7" "C/ms" COEFFS 0 655360 0 0 0 1 /end COMPU_METHOD
/begin COMPU_METHOD SpecificHeat "spezifische Waermekapazitaet einer Substanz" RAT_FUNC "%7.6" "J/g/K" COEFFS 0 10000 0 0 0 1 /end COMPU_METHOD
/begin COMPU_METHOD TempDiff_Cels "difference/offset temperature displayed in degree celcius" RAT_FUNC "%6.3" "deg C" COEFFS 0 10 0 0 0 1 /end COMPU_METHOD
/begin COMPU_METHOD Temp_Cels "Temperatur dargestellt in °C (gleiche interne Darstellung wie Temp_Kelv)" RAT_FUNC "%6.1" "deg C" COEFFS 0 10 2731.4 0 0 1 /end COMPU_METHOD
/begin COMPU_METHOD TimeDeb "Entprellzeit in Millisekunden für Libraryfunktion Debounce" RAT_FUNC "%6.1" "ms" COEFFS 0 0.1 0 0 0 1 /end COMPU_METHOD
/begin COMPU_METHOD TimeDelay_s "Zeitkonstante T1 (in s) für PT1, DT1, etc." RAT_FUNC "%9.3" "s" COEFFS 0 0 1 0 0.00023283064365387 0 /end COMPU_METHOD
/begin COMPU_METHOD TimeDsmTsf "Skalierung der DSM Schwerezähler Werte" RAT_FUNC "%6.0" "ms" COEFFS 0 0.005 0 0 0 1 /end COMPU_METHOD
/begin COMPU_METHOD Time_ms "Zeit in ms für Fehlerentprellung (DSM) und SW-Timer" RAT_FUNC "%6.1" "ms" COEFFS 0 0.1 0 0 0 1 /end COMPU_METHOD
/begin COMPU_METHOD Time_s "Zeit in s für Fehlerentprellung (DSM) und SW-Timer" RAT_FUNC "%6.4" "s" COEFFS 0 100 0 0 0 1 /end COMPU_METHOD
/begin COMPU_METHOD Vel "Fahrzeuggeschwindigkeit, gleiche interne Auflösung wie Vel_SI" RAT_FUNC "%6.4" "km/h" COEFFS 0 100 0 0 0 1 /end COMPU_METHOD
/begin COMPU_METHOD Volt "Spannung in V (von ADC)" RAT_FUNC "%6.2" "mV" COEFFS 0 0.2046 0 0 0 1 /end COMPU_METHOD
/begin RECORD_LAYOUT Kf_Xs16_Ys16_Ws16 NO_AXIS_PTS_X 1 SWORD NO_AXIS_PTS_Y 2 SWORD AXIS_PTS_X 3 SWORD INDEX_INCR DIRECT AXIS_PTS_Y 4 SWORD INDEX_INCR DIRECT FNC_VALUES 5 SWORD COLUMN_DIR DIRECT /end RECORD_LAYOUT
/begin RECORD_LAYOUT Kl_Xs16_Ws16 NO_AXIS_PTS_X 1 SWORD AXIS_PTS_X 2 SWORD INDEX_INCR DIRECT FNC_VALUES 3 SWORD COLUMN_DIR DIRECT /end RECORD_LAYOUT
/begin RECORD_LAYOUT Kwb_Ws16 FNC_VALUES 1 SWORD COLUMN_DIR DIRECT /end RECORD_LAYOUT
/begin RECORD_LAYOUT Kwb_Wu16 FNC_VALUES 1 UWORD COLUMN_DIR DIRECT /end RECORD_LAYOUT
/begin RECORD_LAYOUT Kwb_Wu32 FNC_VALUES 1 ULONG COLUMN_DIR DIRECT /end RECORD_LAYOUT
/begin RECORD_LAYOUT Kwb_Wu8 FNC_VALUES 1 UBYTE COLUMN_DIR DIRECT /end RECORD_LAYOUT
/begin RECORD_LAYOUT Kw_Ws16 FNC_VALUES 1 SWORD COLUMN_DIR DIRECT /end RECORD_LAYOUT
/begin RECORD_LAYOUT Kw_Wu16 FNC_VALUES 1 UWORD COLUMN_DIR DIRECT /end RECORD_LAYOUT
/begin RECORD_LAYOUT Kw_Wu32 FNC_VALUES 1 ULONG COLUMN_DIR DIRECT /end RECORD_LAYOUT
/begin RECORD_LAYOUT Kw_Wu8 FNC_VALUES 1 UBYTE COLUMN_DIR DIRECT /end RECORD_LAYOUT
/end MODULE
/end PROJECT
