ASAP2_VERSION 1 3
/begin PROJECT P411 "BMW DDE6.0 6-Zylinder V66.1 07.01.2004 CAN12H"
/begin HEADER "" VERSION "V571_6Z_CAN12H" PROJECT_NO P411 /end HEADER
/begin MODULE DIM ""
/begin MOD_COMMON "" BYTE_ORDER MSB_FIRST ALIGNMENT_BYTE 1 ALIGNMENT_WORD 2 ALIGNMENT_LONG 4 ALIGNMENT_FLOAT32_IEEE 4 /end MOD_COMMON
/begin CHARACTERISTIC CW_BATTCOD "Enable Handcodierung" VALUE 0xc1661 TKW_VV_VV_UB 100.0 Def_st_ub_q1 0.0 2.0000 /begin FUNCTION_LIST LBATTCAL /end FUNCTION_LIST /end CHARACTERISTIC
/begin CHARACTERISTIC CW_BNS_LR "" VALUE 0xc1774 TKW_VV_VV_UB 100.0 Def_st_ub_q1 0.0 1.0000 /begin FUNCTION_LIST LOADRESP /end FUNCTION_LIST /end CHARACTERISTIC
/begin CHARACTERISTIC KF_GENWETA1 "Wirkungsgrad1 Generator mit 2*PI" MAP 0xc12f2 TKF_SW_UB_UB 100.0 Def_f_ub_b8 0.0 7.9687 /begin FUNCTION_LIST IMDGEN_1PR /end FUNCTION_LIST /begin AXIS_DESCR STD_AXIS I_gm Def_i_ub_q1 8 0.0 255.0000 /end AXIS_DESCR /begin AXIS_DESCR STD_AXIS N_gen Def_n_sw_q1p0 8 -32768.0000 32767.0000 /end AXIS_DESCR /end CHARACTERISTIC
/begin CHARACTERISTIC KF_GENWETA2 "Wirkungsgrad2 Generator mit 2*PI" MAP 0xc134c TKF_SW_UB_UB 100.0 Def_f_ub_b8 0.0 7.9687 /begin FUNCTION_LIST IMDGEN_1PR /end FUNCTION_LIST /begin AXIS_DESCR STD_AXIS I_gm Def_i_ub_q1 8 0.0 255.0000 /end AXIS_DESCR /begin AXIS_DESCR STD_AXIS N_gen Def_n_sw_q1p0 8 -32768.0000 32767.0000 /end AXIS_DESCR /end CHARACTERISTIC
/begin CHARACTERISTIC KF_GENWETA3 "Wirkungsgrad3 Generator mit 2*PI" MAP 0xc1462 TKF_SW_UB_UB 100.0 Def_f_ub_b8 0.0 7.9687 /begin FUNCTION_LIST IMDGEN_1PR /end FUNCTION_LIST /begin AXIS_DESCR STD_AXIS I_gm Def_i_ub_q1 8 0.0 255.0000 /end AXIS_DESCR /begin AXIS_DESCR STD_AXIS N_gen Def_n_sw_q1p0 8 -32768.0000 32767.0000 /end AXIS_DESCR /end CHARACTERISTIC
/begin CHARACTERISTIC KF_GENWETA4 "Wirkungsgrad4 Generator mit 2*PI" MAP 0xc1408 TKF_SW_UB_UB 100.0 Def_f_ub_b8 0.0 7.9687 /begin FUNCTION_LIST IMDGEN_1PR /end FUNCTION_LIST /begin AXIS_DESCR STD_AXIS I_gm Def_i_ub_q1 8 0.0 255.0000 /end AXIS_DESCR /begin AXIS_DESCR STD_AXIS N_gen Def_n_sw_q1p0 8 -32768.0000 32767.0000 /end AXIS_DESCR /end CHARACTERISTIC
/begin CHARACTERISTIC KF_IGENDF1 "Generatorstrom1 DF-Kennfeld" MAP 0xc1505 TKF_UB_UB_UB 100.0 Def_i_ub_q1 0.0 255.0000 /begin FUNCTION_LIST IMDGEN_1PR /end FUNCTION_LIST /begin AXIS_DESCR STD_AXIS Dffgen Def_f_ub_b100 7 0.0 99.6093 /end AXIS_DESCR /begin AXIS_DESCR STD_AXIS I_genmax Def_i_ub_q1 8 0.0 255.0000 /end AXIS_DESCR /end CHARACTERISTIC
/begin CHARACTERISTIC KF_IGENDF2 "Generatorstrom2 DF-Kennfeld" MAP 0xc14bc TKF_UB_UB_UB 100.0 Def_i_ub_q1 0.0 255.0000 /begin FUNCTION_LIST IMDGEN_1PR /end FUNCTION_LIST /begin AXIS_DESCR STD_AXIS Dffgen Def_f_ub_b100 7 0.0 99.6093 /end AXIS_DESCR /begin AXIS_DESCR STD_AXIS I_genmax Def_i_ub_q1 8 0.0 255.0000 /end AXIS_DESCR /end CHARACTERISTIC
/begin CHARACTERISTIC KF_IGENDF3 "Generatorstrom3 DF-Kennfeld" MAP 0xc1597 TKF_UB_UB_UB 100.0 Def_i_ub_q1 0.0 255.0000 /begin FUNCTION_LIST IMDGEN_1PR /end FUNCTION_LIST /begin AXIS_DESCR STD_AXIS Dffgen Def_f_ub_b100 7 0.0 99.6093 /end AXIS_DESCR /begin AXIS_DESCR STD_AXIS I_genmax Def_i_ub_q1 8 0.0 255.0000 /end AXIS_DESCR /end CHARACTERISTIC
/begin CHARACTERISTIC KF_IGENDF4 "Generatorstrom4 DF-Kennfeld" MAP 0xc154e TKF_UB_UB_UB 100.0 Def_i_ub_q1 0.0 255.0000 /begin FUNCTION_LIST IMDGEN_1PR /end FUNCTION_LIST /begin AXIS_DESCR STD_AXIS Dffgen Def_f_ub_b100 7 0.0 99.6093 /end AXIS_DESCR /begin AXIS_DESCR STD_AXIS I_genmax Def_i_ub_q1 8 0.0 255.0000 /end AXIS_DESCR /end CHARACTERISTIC
/begin CHARACTERISTIC KF_IGENKA1 "Kaltkennfeld 1 Generator" MAP 0xc0f36 TKF_SW_UW_UB 100.0 Def_i_ub_q1 0.0 255.0000 /begin FUNCTION_LIST IMDGEN_1PR /end FUNCTION_LIST /begin AXIS_DESCR STD_AXIS U_gen Def_u_uw_q0p1 7 0.0 6553.5000 FORMAT "%6.3" /end AXIS_DESCR /begin AXIS_DESCR STD_AXIS N_gen Def_n_sw_q1p0 9 -32768.0000 32767.0000 /end AXIS_DESCR /end CHARACTERISTIC
/begin CHARACTERISTIC KF_IGENKA2 "Kaltkennfeld 2 Generator" MAP 0xc0d72 TKF_SW_UW_UB 100.0 Def_i_ub_q1 0.0 255.0000 /begin FUNCTION_LIST IMDGEN_1PR /end FUNCTION_LIST /begin AXIS_DESCR STD_AXIS U_gen Def_u_uw_q0p1 7 0.0 6553.5000 FORMAT "%6.3" /end AXIS_DESCR /begin AXIS_DESCR STD_AXIS N_gen Def_n_sw_q1p0 9 -32768.0000 32767.0000 /end AXIS_DESCR /end CHARACTERISTIC
/begin CHARACTERISTIC KF_IGENKA3 "Kaltkennfeld 3 Generator" MAP 0xc0e54 TKF_SW_UW_UB 100.0 Def_i_ub_q1 0.0 255.0000 /begin FUNCTION_LIST IMDGEN_1PR /end FUNCTION_LIST /begin AXIS_DESCR STD_AXIS U_gen Def_u_uw_q0p1 7 0.0 6553.5000 FORMAT "%6.3" /end AXIS_DESCR /begin AXIS_DESCR STD_AXIS N_gen Def_n_sw_q1p0 9 -32768.0000 32767.0000 /end AXIS_DESCR /end CHARACTERISTIC
/begin CHARACTERISTIC KF_IGENKA4 "Kaltkennfeld 4 Generator" MAP 0xc0f98 TKF_SW_UW_UB 100.0 Def_i_ub_q1 0.0 255.0000 /begin FUNCTION_LIST IMDGEN_1PR /end FUNCTION_LIST /begin AXIS_DESCR STD_AXIS U_gen Def_u_uw_q0p1 7 0.0 6553.5000 FORMAT "%6.3" /end AXIS_DESCR /begin AXIS_DESCR STD_AXIS N_gen Def_n_sw_q1p0 9 -32768.0000 32767.0000 /end AXIS_DESCR /end CHARACTERISTIC
/begin CHARACTERISTIC KF_IGENWA1 "Warmkennfeld 1 Generator" MAP 0xc0e14 TKF_SW_UB_UB 100.0 Def_i_ub_q1 0.0 255.0000 /begin FUNCTION_LIST IMDGEN_1PR /end FUNCTION_LIST /begin AXIS_DESCR STD_AXIS Gen_i_kaltun Def_i_ub_q1 6 0.0 255.0000 /end AXIS_DESCR
 /begin AXIS_DESCR STD_AXIS Tgen_end Def_t_sw_q0p1 7 -3276.8000 3276.7000 FORMAT "%4.1" /end AXIS_DESCR
/end CHARACTERISTIC
/begin CHARACTERISTIC KF_IGENWA2 "Warmkennfeld 2 Generator" MAP 0xc0dd4 TKF_SW_UB_UB 100.0 Def_i_ub_q1 0.0 255.0000 /begin FUNCTION_LIST IMDGEN_1PR /end FUNCTION_LIST /begin AXIS_DESCR STD_AXIS Gen_i_kaltun Def_i_ub_q1 6 0.0 255.0000 /end AXIS_DESCR
 /begin AXIS_DESCR STD_AXIS Tgen_end Def_t_sw_q0p1 7 -3276.8000 3276.7000 FORMAT "%4.1" /end AXIS_DESCR
/end CHARACTERISTIC
/begin CHARACTERISTIC KF_IGENWA3 "Warmkennfeld  3 Generator" MAP 0xc0ef6 TKF_SW_UB_UB 100.0 Def_i_ub_q1 0.0 255.0000 /begin FUNCTION_LIST IMDGEN_1PR /end FUNCTION_LIST /begin AXIS_DESCR STD_AXIS Gen_i_kaltun Def_i_ub_q1 6 0.0 255.0000 /end AXIS_DESCR
 /begin AXIS_DESCR STD_AXIS Tgen_end Def_t_sw_q0p1 7 -3276.8000 3276.7000 FORMAT "%4.1" /end AXIS_DESCR
/end CHARACTERISTIC
/begin CHARACTERISTIC KF_IGENWA4 "Warmkennfeld 4 Generator" MAP 0xc0eb6 TKF_SW_UB_UB 100.0 Def_i_ub_q1 0.0 255.0000 /begin FUNCTION_LIST IMDGEN_1PR /end FUNCTION_LIST /begin AXIS_DESCR STD_AXIS Gen_i_kaltun Def_i_ub_q1 6 0.0 255.0000 /end AXIS_DESCR
 /begin AXIS_DESCR STD_AXIS Tgen_end Def_t_sw_q0p1 7 -3276.8000 3276.7000 FORMAT "%4.1" /end AXIS_DESCR
/end CHARACTERISTIC
/begin CHARACTERISTIC KF_LORESP "Kennfeld Loadresponse ueber Motordrehzahl und rel. Luftmasse" MAP 0xc17dc TKF_SW_SW_UB 100.0 Def_td_ub_q0p1 0.0 25.5000 /begin FUNCTION_LIST LOADRESP /end FUNCTION_LIST /begin AXIS_DESCR STD_AXIS Nkw Def_n_sw_q1p0 6 -32768.0000 32767.0000 /end AXIS_DESCR
 /begin AXIS_DESCR STD_AXIS Rf Def_rf_sw_q0p01 6 -327.6800 327.6700 FORMAT "%7.4" /end AXIS_DESCR
/end CHARACTERISTIC
/begin CHARACTERISTIC KF_MDGENFIL "Filterung Generatormoment" MAP 0xc13a6 TKF_SW_SW_UW 100.0 Def_f_uw_b1 0.0 9.99984741210938e-1 /begin FUNCTION_LIST IMDGEN_1PR /end FUNCTION_LIST
 /begin AXIS_DESCR STD_AXIS Md_gennmufi Def_m_sw_q0p1 6 -3276.8000 3276.7000 FORMAT "%5.2" /end AXIS_DESCR
 /begin AXIS_DESCR STD_AXIS Nkw Def_n_sw_q1p0 6 -32768.0000 32767.0000 /end AXIS_DESCR
/end CHARACTERISTIC
/begin CHARACTERISTIC KF_TW "Kennfeld Tuningwahrscheinlichkeit" MAP 0xc1f50 TKF_UW_UW_UW 100.0 Def_f_uw_b100 0.0 99.9984 /begin FUNCTION_LIST MANDETEK /end FUNCTION_LIST /begin AXIS_DESCR STD_AXIS Twhydr Def_f_uw_b100 6 0.0 99.9984 FORMAT "%6.3" /end AXIS_DESCR /begin AXIS_DESCR STD_AXIS Twluft Def_f_uw_b100 6 0.0 99.9984 FORMAT "%6.3" /end AXIS_DESCR FORMAT "%6.3" /end CHARACTERISTIC
/begin CHARACTERISTIC KF_ZLRESOF "Kennfeld Generatorausschaltzeit bei Stillstand" MAP 0xc17ba TKF_UW_SW_UB 100.0 Def_td_ub_q1 0.0 255.0000 /begin FUNCTION_LIST LOADRESP /end FUNCTION_LIST
 /begin AXIS_DESCR STD_AXIS Tmot_start Def_t_sw_q0p01 4 -327.6800 327.6700 FORMAT "%5.2" /end AXIS_DESCR
 /begin AXIS_DESCR STD_AXIS Km_st Def_km_uw_q10 4 0.0 655350.0000 /end AXIS_DESCR
/end CHARACTERISTIC
/begin CHARACTERISTIC KF_ZLRRESOFV "Kennfeld Generatorausschaltzeit bei Fahrt" MAP 0xc1798 TKF_UW_SW_UB 100.0 Def_td_ub_q1 0.0 255.0000 /begin FUNCTION_LIST LOADRESP /end FUNCTION_LIST
 /begin AXIS_DESCR STD_AXIS Tmot_start Def_t_sw_q0p01 4 -327.6800 327.6700 FORMAT "%5.2" /end AXIS_DESCR
 /begin AXIS_DESCR STD_AXIS Km_st Def_km_uw_q10 4 0.0 655350.0000 /end AXIS_DESCR
/end CHARACTERISTIC
/begin CHARACTERISTIC KL_BATTLSTR "Geschwindigkeitsfaktor Batterieumgebungstemperatur" CURVE 0xc16b0 TKL_UW_VV_UW 100.0 Def_f_uw_b256 0.0 255.9960 /begin FUNCTION_LIST LBATTCAL /end FUNCTION_LIST /begin AXIS_DESCR STD_AXIS V Def_v_uw_q1p0 6 0.0 360.0000 /end AXIS_DESCR FORMAT "%6.3" /end CHARACTERISTIC
/begin CHARACTERISTIC KL_EXPALH "Funktion EXP(-ALPHA*tabst_w) hinten" CURVE 0xc16f8 TKL_UW_VV_UW 100.0 Def_f_uw_b1 0.0 9.99984741210938e-1 /begin FUNCTION_LIST LBATTCAL /end FUNCTION_LIST /begin AXIS_DESCR STD_AXIS Tn_abstell Def_st_uw_q1 11 0.0 65535.0000 /end AXIS_DESCR /end CHARACTERISTIC
/begin CHARACTERISTIC KL_EXPALV "Funktion EXP(-ALPHA*tabst_w) hinten" CURVE 0xc16ca TKL_UW_VV_UW 100.0 Def_f_uw_b1 0.0 9.99984741210938e-1 /begin FUNCTION_LIST LBATTCAL /end FUNCTION_LIST /begin AXIS_DESCR STD_AXIS Tn_abstell Def_st_uw_q1 11 0.0 65535.0000 /end AXIS_DESCR /end CHARACTERISTIC
/begin CHARACTERISTIC KL_EXPBETAV "Funktion EXP (-BETA*tabst_w)" CURVE 0xc1682 TKL_UW_VV_UW 100.0 Def_f_uw_b1 0.0 9.99984741210938e-1 /begin FUNCTION_LIST LBATTCAL /end FUNCTION_LIST /begin AXIS_DESCR STD_AXIS Tn_abstell Def_st_uw_q1 11 0.0 65535.0000 /end AXIS_DESCR /end CHARACTERISTIC
/begin CHARACTERISTIC KL_FPDIODE1 "Verlustleistungsfaktor eines Diodenpaars1" CURVE 0xc127c TKL_SW_VV_UB 100.0 Def_f_ub_b2 0.0 1.9921 /begin FUNCTION_LIST IMDGEN_1PR /end FUNCTION_LIST
 /begin AXIS_DESCR STD_AXIS Tgen Def_t_sw_q0p1 5 -3276.8000 3276.7000 FORMAT "%4.1" /end AXIS_DESCR
/end CHARACTERISTIC
/begin CHARACTERISTIC KL_FPDIODE2 "Verlustleistungsfaktor eines Diodenpaars2" CURVE 0xc12e0 TKL_SW_VV_UB 100.0 Def_f_ub_b2 0.0 1.9921 /begin FUNCTION_LIST IMDGEN_1PR /end FUNCTION_LIST
 /begin AXIS_DESCR STD_AXIS Tgen Def_t_sw_q0p1 5 -3276.8000 3276.7000 FORMAT "%4.1" /end AXIS_DESCR
/end CHARACTERISTIC
/begin CHARACTERISTIC KL_FPDIODE3 "Verlustleistungsfaktor eines Diodenpaars" CURVE 0xc1244 TKL_SW_VV_UB 100.0 Def_f_ub_b2 0.0 1.9921 /begin FUNCTION_LIST IMDGEN_1PR /end FUNCTION_LIST
 /begin AXIS_DESCR STD_AXIS Tgen Def_t_sw_q0p1 5 -3276.8000 3276.7000 FORMAT "%4.1" /end AXIS_DESCR
/end CHARACTERISTIC
/begin CHARACTERISTIC KL_FPDIODE4 "Verlustleistungsfaktor eines Diodenpaars4" CURVE 0xc12ce TKL_SW_VV_UB 100.0 Def_f_ub_b2 0.0 1.9921 /begin FUNCTION_LIST IMDGEN_1PR /end FUNCTION_LIST
 /begin AXIS_DESCR STD_AXIS Tgen Def_t_sw_q0p1 5 -3276.8000 3276.7000 FORMAT "%4.1" /end AXIS_DESCR
/end CHARACTERISTIC
/begin CHARACTERISTIC KL_GENEXP1 "Abkühlkurve Generator1" CURVE 0xc10ee TKL_UW_VV_UB 100.0 Def_f_ub_b1 0.0 0.9960 /begin FUNCTION_LIST IMDGEN_1PR /end FUNCTION_LIST /begin AXIS_DESCR STD_AXIS Tn_abstell Def_st_uw_q1 13 0.0 65535.0000 /end AXIS_DESCR /end CHARACTERISTIC
/begin CHARACTERISTIC KL_GENEXP2 "Abkühlkurve Generator2" CURVE 0xc1092 TKL_UW_VV_UB 100.0 Def_f_ub_b1 0.0 0.9960 /begin FUNCTION_LIST IMDGEN_1PR /end FUNCTION_LIST /begin AXIS_DESCR STD_AXIS Tn_abstell Def_st_uw_q1 13 0.0 65535.0000 /end AXIS_DESCR /end CHARACTERISTIC
/begin CHARACTERISTIC KL_GENEXP3 "Abkühlkurve Generator3" CURVE 0xc121a TKL_UW_VV_UB 100.0 Def_f_ub_b1 0.0 0.9960 /begin FUNCTION_LIST IMDGEN_1PR /end FUNCTION_LIST /begin AXIS_DESCR STD_AXIS Tn_abstell Def_st_uw_q1 13 0.0 65535.0000 /end AXIS_DESCR /end CHARACTERISTIC
/begin CHARACTERISTIC KL_GENEXP4 "Abkühlkurve Generator4" CURVE 0xc1142 TKL_UW_VV_UB 100.0 Def_f_ub_b1 0.0 0.9960 /begin FUNCTION_LIST IMDGEN_1PR /end FUNCTION_LIST /begin AXIS_DESCR STD_AXIS Tn_abstell Def_st_uw_q1 13 0.0 65535.0000 /end AXIS_DESCR /end CHARACTERISTIC
/begin CHARACTERISTIC KL_GENLDST "Auslastungsgrad Generator" CURVE 0xc1730 TKL_SW_VV_UB 100.0 Def_f_ub_b100 0.0 99.6093 /begin FUNCTION_LIST LDSTGEN /end FUNCTION_LIST
 /begin AXIS_DESCR STD_AXIS Tgen Def_t_sw_q0p1 6 -3276.8000 3276.7000 FORMAT "%4.1" /end AXIS_DESCR
/end CHARACTERISTIC
/begin CHARACTERISTIC KL_GENTETA1 "Temperatur_eta_faktor Generator1" CURVE 0xc1256 TKL_SW_VV_UW 100.0 Def_f_uw_b2 0.0 1.9999 /begin FUNCTION_LIST IMDGEN_1PR /end FUNCTION_LIST
 /begin AXIS_DESCR STD_AXIS Tgen Def_t_sw_q0p1 3 -3276.8000 3276.7000 FORMAT "%4.1" /end AXIS_DESCR
/end CHARACTERISTIC
/begin CHARACTERISTIC KL_GENTETA2 "Temperatur_eta_faktor Generator2" CURVE 0xc12a8 TKL_SW_VV_UW 100.0 Def_f_uw_b2 0.0 1.9999 /begin FUNCTION_LIST IMDGEN_1PR /end FUNCTION_LIST
 /begin AXIS_DESCR STD_AXIS Tgen Def_t_sw_q0p1 3 -3276.8000 3276.7000 FORMAT "%4.1" /end AXIS_DESCR
/end CHARACTERISTIC
/begin CHARACTERISTIC KL_GENTETA3 "Temperatur_eta_faktor Generator3" CURVE 0xc103a TKL_SW_VV_UW 100.0 Def_f_uw_b2 0.0 1.9999 /begin FUNCTION_LIST IMDGEN_1PR /end FUNCTION_LIST
 /begin AXIS_DESCR STD_AXIS Tgen Def_t_sw_q0p1 3 -3276.8000 3276.7000 FORMAT "%4.1" /end AXIS_DESCR
/end CHARACTERISTIC
/begin CHARACTERISTIC KL_GENTETA4 "Temperatur_eta_faktor Generator4" CURVE 0xc1012 TKL_SW_VV_UW 100.0 Def_f_uw_b2 0.0 1.9999 /begin FUNCTION_LIST IMDGEN_1PR /end FUNCTION_LIST
 /begin AXIS_DESCR STD_AXIS Tgen Def_t_sw_q0p1 3 -3276.8000 3276.7000 FORMAT "%4.1" /end AXIS_DESCR
/end CHARACTERISTIC
/begin CHARACTERISTIC KL_LADEKENNL "Batterieladespannungskennlinie" CURVE 0xc1668 TKL_SW_VV_SW 100.0 Def_u_sw_b128 0.0 127.9960 /begin FUNCTION_LIST LBATTCAL /end FUNCTION_LIST
 /begin AXIS_DESCR STD_AXIS T_battabst Def_t_sw_q0p1 6 -3276.8000 3276.7000 FORMAT "%4.1" /end AXIS_DESCR
 FORMAT "%6.3" /end CHARACTERISTIC
/begin CHARACTERISTIC KL_LORESPM "Motorabhängiger Loadresponse-Faktor" CURVE 0xc1784 TKL_SW_VV_UB 100.0 Def_f_ub_b4 0.0 3.9843 /begin FUNCTION_LIST LOADRESP /end FUNCTION_LIST
 /begin AXIS_DESCR STD_AXIS Tmot Def_t_sw_q0p01 6 -327.6800 327.6700 FORMAT "%5.2" /end AXIS_DESCR
/end CHARACTERISTIC
/begin CHARACTERISTIC KL_RTH0FAK1 "RTHfaktor1 ueber Generatorstrom" CURVE 0xc1048 TKL_UB_VV_UB 100.0 Def_f_ub_b4 0.0 3.9843 /begin FUNCTION_LIST IMDGEN_1PR /end FUNCTION_LIST /begin AXIS_DESCR STD_AXIS I_gen_end Def_i_ub_q1 11 0.0 255.0000 /end AXIS_DESCR /end CHARACTERISTIC
/begin CHARACTERISTIC KL_RTH0FAK2 "RTHfaktor 2 ueber Generatorstrom" CURVE 0xc1264 TKL_UB_VV_UB 100.0 Def_f_ub_b4 0.0 3.9843 /begin FUNCTION_LIST IMDGEN_1PR /end FUNCTION_LIST /begin AXIS_DESCR STD_AXIS I_gen_end Def_i_ub_q1 11 0.0 255.0000 /end AXIS_DESCR /end CHARACTERISTIC
/begin CHARACTERISTIC KL_RTH0FAK3 "RTHfaktor3 ueber Generatorstrom" CURVE 0xc0ffa TKL_UB_VV_UB 100.0 Def_f_ub_b4 0.0 3.9843 /begin FUNCTION_LIST IMDGEN_1PR /end FUNCTION_LIST /begin AXIS_DESCR STD_AXIS I_gen_end Def_i_ub_q1 11 0.0 255.0000 /end AXIS_DESCR /end CHARACTERISTIC
/begin CHARACTERISTIC KL_RTH0FAK4 "RTHfaktor4 ueber Generatorstrom" CURVE 0xc107a TKL_UB_VV_UB 100.0 Def_f_ub_b4 0.0 3.9843 /begin FUNCTION_LIST IMDGEN_1PR /end FUNCTION_LIST /begin AXIS_DESCR STD_AXIS I_gen_end Def_i_ub_q1 11 0.0 255.0000 /end AXIS_DESCR /end CHARACTERISTIC
/begin CHARACTERISTIC KL_RTHFAK1 "RTHfaktor ueber Generatorstrom" CURVE 0xc12b6 TKL_UB_VV_UB 100.0 Def_f_ub_b4 0.0 3.9843 /begin FUNCTION_LIST IMDGEN_1PR /end FUNCTION_LIST /begin AXIS_DESCR STD_AXIS I_gen_end Def_i_ub_q1 11 0.0 255.0000 /end AXIS_DESCR /end CHARACTERISTIC
/begin CHARACTERISTIC KL_RTHFAK2 "RTHfaktor2 ueber Generatorstrom Fahrt" CURVE 0xc10d6 TKL_UB_VV_UB 100.0 Def_f_ub_b4 0.0 3.9843 /begin FUNCTION_LIST IMDGEN_1PR /end FUNCTION_LIST /begin AXIS_DESCR STD_AXIS I_gen_end Def_i_ub_q1 11 0.0 255.0000 /end AXIS_DESCR /end CHARACTERISTIC
/begin CHARACTERISTIC KL_RTHFAK3 "RTHfaktor3 ueber Generatorstrom Fahrt" CURVE 0xc11c0 TKL_UB_VV_UB 100.0 Def_f_ub_b4 0.0 3.9843 /begin FUNCTION_LIST IMDGEN_1PR /end FUNCTION_LIST /begin AXIS_DESCR STD_AXIS I_gen_end Def_i_ub_q1 11 0.0 255.0000 /end AXIS_DESCR /end CHARACTERISTIC
/begin CHARACTERISTIC KL_RTHFAK4 "RTHfaktor4 ueber Generatorstrom Fahrt" CURVE 0xc1202 TKL_UB_VV_UB 100.0 Def_f_ub_b4 0.0 3.9843 /begin FUNCTION_LIST IMDGEN_1PR /end FUNCTION_LIST /begin AXIS_DESCR STD_AXIS I_gen_end Def_i_ub_q1 11 0.0 255.0000 /end AXIS_DESCR /end CHARACTERISTIC
/begin CHARACTERISTIC KL_RTHGEN1 "RTH-Kennfeld Generator1" CURVE 0xc1060 TKL_SW_VV_UW 100.0 Def_f_uw_b64 0.0 1.0000 /begin FUNCTION_LIST IMDGEN_1PR /end FUNCTION_LIST /begin AXIS_DESCR STD_AXIS N_gen Def_n_sw_q1p0 6 -32768.0000 32767.0000 /end AXIS_DESCR FORMAT "%7.4" /end CHARACTERISTIC
/begin CHARACTERISTIC KL_RTHGEN2 "RTH-Kennfeld Generator2" CURVE 0xc1020 TKL_SW_VV_UW 100.0 Def_f_uw_b64 0.0 1.0000 /begin FUNCTION_LIST IMDGEN_1PR /end FUNCTION_LIST /begin AXIS_DESCR STD_AXIS N_gen Def_n_sw_q1p0 6 -32768.0000 32767.0000 /end AXIS_DESCR FORMAT "%7.4" /end CHARACTERISTIC
/begin CHARACTERISTIC KL_RTHGEN3 "RTH-Kennfeld Generator3" CURVE 0xc10bc TKL_SW_VV_UW 100.0 Def_f_uw_b64 0.0 1.0000 /begin FUNCTION_LIST IMDGEN_1PR /end FUNCTION_LIST /begin AXIS_DESCR STD_AXIS N_gen Def_n_sw_q1p0 6 -32768.0000 32767.0000 /end AXIS_DESCR FORMAT "%7.4" /end CHARACTERISTIC
/begin CHARACTERISTIC KL_RTHGEN4 "RTH-Kennfeld Generator4" CURVE 0xc128e TKL_SW_VV_UW 100.0 Def_f_uw_b64 0.0 1.0000 /begin FUNCTION_LIST IMDGEN_1PR /end FUNCTION_LIST /begin AXIS_DESCR STD_AXIS N_gen Def_n_sw_q1p0 6 -32768.0000 32767.0000 /end AXIS_DESCR FORMAT "%7.4" /end CHARACTERISTIC
/begin CHARACTERISTIC KL_TANSGEN1 "Kennlinie Generatoransaugluft1" CURVE 0xc1196 TKL_UW_VV_SW 100.0 Def_t_sw_q0p1 -3276.8000 3276.7000 /begin FUNCTION_LIST IMDGEN_1PR /end FUNCTION_LIST /begin AXIS_DESCR STD_AXIS V Def_v_uw_q1p0 10 0.0 360.0000 /end AXIS_DESCR FORMAT "%4.1" /end CHARACTERISTIC
/begin CHARACTERISTIC KL_TANSGEN2 "Kennlinie Generatoransaugluft2" CURVE 0xc11d8 TKL_UW_VV_SW 100.0 Def_t_sw_q0p1 -3276.8000 3276.7000 /begin FUNCTION_LIST IMDGEN_1PR /end FUNCTION_LIST /begin AXIS_DESCR STD_AXIS V Def_v_uw_q1p0 10 0.0 360.0000 /end AXIS_DESCR FORMAT "%4.1" /end CHARACTERISTIC
/begin CHARACTERISTIC KL_TANSGEN3 "Kennlinie Generatoransaugluft3" CURVE 0xc116c TKL_UW_VV_SW 100.0 Def_t_sw_q0p1 -3276.8000 3276.7000 /begin FUNCTION_LIST IMDGEN_1PR /end FUNCTION_LIST /begin AXIS_DESCR STD_AXIS V Def_v_uw_q1p0 10 0.0 360.0000 /end AXIS_DESCR FORMAT "%4.1" /end CHARACTERISTIC
/begin CHARACTERISTIC KL_TANSGEN4 "Kennlinie Generatoransaugluft4" CURVE 0xc1118 TKL_UW_VV_SW 100.0 Def_t_sw_q0p1 -3276.8000 3276.7000 /begin FUNCTION_LIST IMDGEN_1PR /end FUNCTION_LIST /begin AXIS_DESCR STD_AXIS V Def_v_uw_q1p0 10 0.0 360.0000 /end AXIS_DESCR FORMAT "%4.1" /end CHARACTERISTIC
/begin CHARACTERISTIC KL_TWHYDR "Kennlinie Tuningwahrscheinlichkeit Hydraulik" CURVE 0xc1f2e TKL_UW_VV_UW 100.0 Def_f_uw_b100 0.0 99.9984 /begin FUNCTION_LIST MANDETEK /end FUNCTION_LIST /begin AXIS_DESCR STD_AXIS Twhydrcnt Def_dez_uw_q1 8 0.0 65535.0000 /end AXIS_DESCR FORMAT "%6.3" /end CHARACTERISTIC
/begin CHARACTERISTIC KL_TWLUFT "Kennlinie Tuningwahrscheinlichkeit Luft" CURVE 0xc1f0c TKL_UW_VV_UW 100.0 Def_f_uw_b100 0.0 99.9984 /begin FUNCTION_LIST MANDETEK /end FUNCTION_LIST /begin AXIS_DESCR STD_AXIS Twluftcnt Def_dez_uw_q1 8 0.0 65535.0000 /end AXIS_DESCR FORMAT "%6.3" /end CHARACTERISTIC
/begin CHARACTERISTIC K_APPTBATINI "Enable Applikation Initwert Batterietemperatur" VALUE 0xc1662 TKW_VV_VV_UB 100.0 Def_st_ub_q1 0.0 255.0000 /begin FUNCTION_LIST LBATTCAL /end FUNCTION_LIST /end CHARACTERISTIC
/begin CHARACTERISTIC K_APPUPLLDST "Applikationswert St_ldstgen für Nachlauf" VALUE 0xc1728 TKW_VV_VV_UB 100.0 Def_st_ub_q1 0.0 255.0000 /begin FUNCTION_LIST LDSTGEN /end FUNCTION_LIST /end CHARACTERISTIC
/begin CHARACTERISTIC K_APP_LLAH "Kennwert zum Umschalten auf Applikationskonstante" VALUE 0xc1754 TKW_VV_VV_UB 100.0 Def_st_ub_q1 0.0 255.0000 /begin FUNCTION_LIST LLRANH /end FUNCTION_LIST /end CHARACTERISTIC
/begin CHARACTERISTIC K_BATTHTAUVG "Zeitkonstante Batterie hinten bei VFZG>" VALUE 0xc1640 TKW_VV_VV_UW 100.0 Def_f_uw_b1 0.0 9.99984741210938e-1 /begin FUNCTION_LIST LBATTCAL /end FUNCTION_LIST /end CHARACTERISTIC
/begin CHARACTERISTIC K_BATTHTAUVK "Zeitkonstante Batterie hinten bei VFZG<" VALUE 0xc1642 TKW_VV_VV_UW 100.0 Def_f_uw_b1 0.0 9.99984741210938e-1 /begin FUNCTION_LIST LBATTCAL /end FUNCTION_LIST /end CHARACTERISTIC
/begin CHARACTERISTIC K_BATTORT0 "Batterieeinbauort No1" VALUE 0xc1663 TKW_VV_VV_UB 100.0 Def_st_ub_q1 0.0 2.0000 /begin FUNCTION_LIST LBATTCAL /end FUNCTION_LIST /end CHARACTERISTIC
/begin CHARACTERISTIC K_BATTORT2 "Batterieeinbauort No2" VALUE 0xc1664 TKW_VV_VV_UB 100.0 Def_st_ub_q1 0.0 2.0000 /begin FUNCTION_LIST LBATTCAL /end FUNCTION_LIST /end CHARACTERISTIC
/begin CHARACTERISTIC K_BATTVTAUVG "Zeitkonstante Batterie vorne bei VFZG>" VALUE 0xc1644 TKW_VV_VV_UW 100.0 Def_f_uw_b1 0.0 9.99984741210938e-1 /begin FUNCTION_LIST LBATTCAL /end FUNCTION_LIST /end CHARACTERISTIC
/begin CHARACTERISTIC K_BATTVTAUVK "Zeitkonstante Batterie bei VFZG<Zeitkonstante Batterie bei VFZG>" VALUE 0xc1646 TKW_VV_VV_UW 100.0 Def_f_uw_b1 0.0 9.99984741210938e-1 /begin FUNCTION_LIST LBATTCAL /end FUNCTION_LIST /end CHARACTERISTIC
/begin CHARACTERISTIC K_BATT_ALFAH "Alphatau-Wert Batterie hinten" VALUE 0xc1648 TKW_VV_VV_UW 100.0 Def_f_uw_b1 1.52587890625e-5 9.99984741210938e-1 /begin FUNCTION_LIST LBATTCAL /end FUNCTION_LIST /end CHARACTERISTIC
/begin CHARACTERISTIC K_BATT_ALFAV "Alphatau-Wert Batterie vorne" VALUE 0xc164a TKW_VV_VV_UW 100.0 Def_f_uw_b1 1.52587890625e-5 9.99984741210938e-1 /begin FUNCTION_LIST LBATTCAL /end FUNCTION_LIST /end CHARACTERISTIC
/begin CHARACTERISTIC K_BATT_BETAV "Beta-Wert Batterie vorne" VALUE 0xc164c TKW_VV_VV_UW 100.0 Def_f_uw_b1 1.52587890625e-5 9.99984741210938e-1 /begin FUNCTION_LIST LBATTCAL /end FUNCTION_LIST /end CHARACTERISTIC
/begin CHARACTERISTIC K_BATVFZGTAU "VFZG-Umschaltschwelle TAU Batterie" VALUE 0xc164e TKW_VV_VV_UW 100.0 Def_v_uw_q1p0 0.0 65535.0000 /begin FUNCTION_LIST LBATTCAL /end FUNCTION_LIST /end CHARACTERISTIC
/begin CHARACTERISTIC K_BGAPP "Applikationswert Generatorbegrenzung über Maximalmoment" VALUE 0xc1775 TKW_VV_VV_UB 100.0 Identity 0.0 1.0000 /begin FUNCTION_LIST LOADRESP /end FUNCTION_LIST /end CHARACTERISTIC
/begin CHARACTERISTIC K_DFLLMIN "DF unterhalb derer die LLDZanh. zurueckgenommen wird." VALUE 0xc174a TKW_VV_VV_UB 100.0 Def_f_ub_b100 0.0 99.6093 /begin FUNCTION_LIST LLPMCTRL /end FUNCTION_LIST /end CHARACTERISTIC
/begin CHARACTERISTIC K_DFMAX "Obere Schwelle DF Signal" VALUE 0xc174b TKW_VV_VV_UB 100.0 Def_f_ub_b100 0.0 99.6093 /begin FUNCTION_LIST LLPMCTRL /end FUNCTION_LIST /end CHARACTERISTIC
/begin CHARACTERISTIC K_DFMODE "DF-Mode-Schalter themermisch/elektrisch" VALUE 0xc1729 TKW_VV_VV_UB 100.0 Def_st_ub_q1 0.0 255.0000 /begin FUNCTION_LIST LDSTGEN /end FUNCTION_LIST /end CHARACTERISTIC
/begin CHARACTERISTIC K_DFS_MAX "DF-Auslastung Maximalschwelle" VALUE 0xc172a TKW_VV_VV_UB 100.0 Def_f_ub_b100 0.0 99.6093 /begin FUNCTION_LIST LDSTGEN /end FUNCTION_LIST /end CHARACTERISTIC
/begin CHARACTERISTIC K_DFS_MIN "DF-Auslastung Minimalschwelle" VALUE 0xc172b TKW_VV_VV_UB 100.0 Def_f_ub_b100 0.0 99.6093 /begin FUNCTION_LIST LDSTGEN /end FUNCTION_LIST /end CHARACTERISTIC
/begin CHARACTERISTIC K_DFS_MITT "DF-Auslastung Mittelschwelle" VALUE 0xc172c TKW_VV_VV_UB 100.0 Def_f_ub_b100 0.0 99.6093 /begin FUNCTION_LIST LDSTGEN /end FUNCTION_LIST /end CHARACTERISTIC
/begin CHARACTERISTIC K_DF_DEAKAPP "Df-Schwelle für IG 0A Zwangssetzung" VALUE 0xc0d34 TKW_VV_VV_UB 100.0 Def_f_ub_b100 0.0 99.6093 /begin FUNCTION_LIST IMDGEN_1PR /end FUNCTION_LIST /end CHARACTERISTIC
/begin CHARACTERISTIC K_DI1000DT "" VALUE 0xc15fe TKW_VV_VV_UB 100.0 Def_td_ub_q0p05 0.0 12.7500 /begin FUNCTION_LIST KT_IBS /end FUNCTION_LIST /end CHARACTERISTIC
/begin CHARACTERISTIC K_DI1000STG "" VALUE 0xc15fc TKW_VV_VV_UB 100.0 Def_i_ub_q0p08 0.0 20.4000 /begin FUNCTION_LIST KT_IBS /end FUNCTION_LIST /end CHARACTERISTIC
/begin CHARACTERISTIC K_DI1000TGRZ "" VALUE 0xc15f3 TKW_VV_VV_UB 100.0 Def_td_ub_q1 0.0 255.0000 /begin FUNCTION_LIST KT_IBS /end FUNCTION_LIST /end CHARACTERISTIC
/begin CHARACTERISTIC K_DI200DT "" VALUE 0xc15fd TKW_VV_VV_UB 100.0 Def_td_ub_q0p05 0.0 12.7500 /begin FUNCTION_LIST KT_IBS /end FUNCTION_LIST /end CHARACTERISTIC
/begin CHARACTERISTIC K_DI200STG "" VALUE 0xc15fb TKW_VV_VV_UB 100.0 Def_i_ub_q0p02 0.0 5.1000 /begin FUNCTION_LIST KT_IBS /end FUNCTION_LIST /end CHARACTERISTIC
/begin CHARACTERISTIC K_DIHIGHGRZ "" VALUE 0xc15f7 TKW_VV_VV_UB 100.0 Def_i_ub_q0p08 0.0 20.4000 /begin FUNCTION_LIST KT_IBS /end FUNCTION_LIST /end CHARACTERISTIC
/begin CHARACTERISTIC K_DILOWGRZ "" VALUE 0xc15f6 TKW_VV_VV_UB 100.0 Def_i_ub_q0p02 0.0 5.1000 /begin FUNCTION_LIST KT_IBS /end FUNCTION_LIST /end CHARACTERISTIC
/begin CHARACTERISTIC K_DIPL5 "" VALUE 0xc1601 TKW_VV_VV_UB 100.0 Def_dez_ub_q1 0.0 255.0000 /begin FUNCTION_LIST KT_IBS /end FUNCTION_LIST /end CHARACTERISTIC
/begin CHARACTERISTIC K_DIPL6 "" VALUE 0xc1602 TKW_VV_VV_UB 100.0 Def_dez_ub_q1 0.0 255.0000 /begin FUNCTION_LIST KT_IBS /end FUNCTION_LIST /end CHARACTERISTIC
/begin CHARACTERISTIC K_DIPL7 "" VALUE 0xc1603 TKW_VV_VV_UB 100.0 Def_dez_ub_q1 0.0 255.0000 /begin FUNCTION_LIST KT_IBS /end FUNCTION_LIST /end CHARACTERISTIC
/begin CHARACTERISTIC K_DIPL8 "" VALUE 0xc1604 TKW_VV_VV_UB 100.0 Def_dez_ub_q1 0.0 255.0000 /begin FUNCTION_LIST KT_IBS /end FUNCTION_LIST /end CHARACTERISTIC
/begin CHARACTERISTIC K_DKL15FIL "" VALUE 0xc15f9 TKW_VV_VV_UB 100.0 Def_td_ub_q0p00625 0.0 1.5937 /begin FUNCTION_LIST KT_IBS /end FUNCTION_LIST /end CHARACTERISTIC
/begin CHARACTERISTIC K_DSOCHYST "Hystereschwelle SOC" VALUE 0xc1744 TKW_VV_VV_SW 100.0 Def_f_sw_b100 -100.0000 99.9969 /begin FUNCTION_LIST LLPMCTRL /end FUNCTION_LIST FORMAT "%6.3" /end CHARACTERISTIC
/begin CHARACTERISTIC K_DSOCLLANH "Abstand zur Stfgrz, bei der die LLDZanh aktiviert wird." VALUE 0xc1746 TKW_VV_VV_SW 100.0 Def_f_sw_b100 -100.0000 99.9969 /begin FUNCTION_LIST LLPMCTRL /end FUNCTION_LIST FORMAT "%6.3" /end CHARACTERISTIC
/begin CHARACTERISTIC K_DTANSKOR "Ansaugluftmodelloffset Aussentemperatur" VALUE 0xc1630 TKW_VV_VV_SW 100.0 Def_t_sw_q0p1 -3276.8000 3276.7000 /begin FUNCTION_LIST LBATTCAL /end FUNCTION_LIST FORMAT "%4.1" /end CHARACTERISTIC
/begin CHARACTERISTIC K_DTMAXGRZI "" VALUE 0xc15f5 TKW_VV_VV_UB 100.0 Def_td_ub_q1 0.0 255.0000 /begin FUNCTION_LIST KT_IBS /end FUNCTION_LIST /end CHARACTERISTIC
/begin CHARACTERISTIC K_DUIGRZ "" VALUE 0xc15f4 TKW_VV_VV_UB 100.0 Def_i_ub_q0p02 0.0 5.1000 /begin FUNCTION_LIST KT_IBS /end FUNCTION_LIST /end CHARACTERISTIC
/begin CHARACTERISTIC K_DUMINTGRZ "" VALUE 0xc15f8 TKW_VV_VV_UB 100.0 Def_td_ub_q0p05 0.0 12.7500 /begin FUNCTION_LIST KT_IBS /end FUNCTION_LIST /end CHARACTERISTIC
/begin CHARACTERISTIC K_DUREFMAX "" VALUE 0xc15fa TKW_VV_VV_UB 100.0 Def_u_ub_q0p0196 0.0 4.9980 /begin FUNCTION_LIST KT_IBS /end FUNCTION_LIST /end CHARACTERISTIC
/begin CHARACTERISTIC K_DUREFMINI "" VALUE 0xc1605 TKW_VV_VV_UB 100.0 Def_u_ub_q0p0196 0.0 4.9980 /begin FUNCTION_LIST KT_IBS /end FUNCTION_LIST /end CHARACTERISTIC
/begin CHARACTERISTIC K_ENABSDIBS "kt_ibs enable Kommunikation" VALUE 0xc1618 TKW_VV_VV_UB 100.0 Def_dez_ub_q1 0.0 255.0000 /begin FUNCTION_LIST KT_IBS /end FUNCTION_LIST /end CHARACTERISTIC
/begin CHARACTERISTIC K_ENAPPLGOFF "Enable Generatorauschaltsteuerung" VALUE 0xc1776 TKW_VV_VV_UB 100.0 Def_st_ub_q1 0.0 255.0000 /begin FUNCTION_LIST LOADRESP /end FUNCTION_LIST /end CHARACTERISTIC
/begin CHARACTERISTIC K_ENAPPLRESP "Enable Handsteuerung Loadresponse" VALUE 0xc1777 TKW_VV_VV_UB 100.0 Def_st_ub_q1 0.0 255.0000 /begin FUNCTION_LIST LOADRESP /end FUNCTION_LIST /end CHARACTERISTIC
/begin CHARACTERISTIC K_ENGENTANS "Schwelle Motortemperatur fuer Freigabe Generaturansaugluft " VALUE 0xc0cd8 TKW_VV_VV_SW 100.0 Def_t_sw_q0p1 -3276.8000 3276.7000 /begin FUNCTION_LIST IMDGEN_1PR /end FUNCTION_LIST FORMAT "%4.1" /end CHARACTERISTIC
/begin CHARACTERISTIC K_ENISOC0 "" VALUE 0xc15e4 TKW_VV_VV_UB 100.0 Def_i_ub_q0p02 0.0 5.1000 /begin FUNCTION_LIST KT_IBS /end FUNCTION_LIST /end CHARACTERISTIC
/begin CHARACTERISTIC K_ENUSOC0 "" VALUE 0xc15e5 TKW_VV_VV_UB 100.0 Def_u_ub_q0p064_o6 6.0000 22.3200 /begin FUNCTION_LIST KT_IBS /end FUNCTION_LIST /end CHARACTERISTIC
/begin CHARACTERISTIC K_EN_MDGEN "" VALUE 0xc0d35 TKW_VV_VV_UB 100.0 Def_st_ub_q1 0.0 255.0000 /begin FUNCTION_LIST IMDGEN_1PR /end FUNCTION_LIST /end CHARACTERISTIC
/begin CHARACTERISTIC K_ERREPEAT "EBSD Fehler repeat" VALUE 0xc1619 TKW_VV_VV_UB 100.0 Def_dez_ub_q1 0.0 255.0000 /begin FUNCTION_LIST KT_IBS /end FUNCTION_LIST /end CHARACTERISTIC
/begin CHARACTERISTIC K_FHOGNMN "minimaler Wichtungsfaktor fuer minimale HFM-Luftmassen Schwelle in Abhaengigkeit von d.Hoehe fuer Generatorreduzierung" VALUE 0xc1778 TKW_VV_VV_UB 100.0 Def_f_ub_b4 0.0 3.9843 /begin FUNCTION_LIST LOADRESP /end FUNCTION_LIST /end CHARACTERISTIC
/begin CHARACTERISTIC K_FHYDR "Konstante Fehler Hydraulikpfad" VALUE 0xc1ee4 TKW_VV_VV_UL 100.0 Def_f_ul_b262144 0.0 196596.0001 /begin FUNCTION_LIST MANDETEK /end FUNCTION_LIST /end CHARACTERISTIC
/begin CHARACTERISTIC K_FHYDRMAX "Konstante max. Fehler Hydraulikpfad" VALUE 0xc1ee8 TKW_VV_VV_UL 100.0 Def_f_ul_b262144 0.0 196596.0001 /begin FUNCTION_LIST MANDETEK /end FUNCTION_LIST /end CHARACTERISTIC
/begin CHARACTERISTIC K_FHYDRMIN "Konstante max. Fehler Hydraulikpfad" VALUE 0xc1eec TKW_VV_VV_UL 100.0 Def_f_ul_b262144 0.0 196596.0001 /begin FUNCTION_LIST MANDETEK /end FUNCTION_LIST /end CHARACTERISTIC
/begin CHARACTERISTIC K_FIDMANHYDR "Konstante Funktionsidentifier Mandetek Hydraulikpfad" VALUE 0xc1efc TKW_VV_VV_UB 100.0 Def_dez_ub_q1 0.0 255.0000 /begin FUNCTION_LIST MANDETEK /end FUNCTION_LIST /end CHARACTERISTIC
/begin CHARACTERISTIC K_FIDMANLUFT "Konstante Funktionsidentifier Mandetek Luftpfad" VALUE 0xc1efd TKW_VV_VV_UB 100.0 Def_dez_ub_q1 0.0 255.0000 /begin FUNCTION_LIST MANDETEK /end FUNCTION_LIST /end CHARACTERISTIC
/begin CHARACTERISTIC K_FLAISTMAX "Faktor La_ist max" VALUE 0xc1efe TKW_VV_VV_UB 100.0 Def_f_ub_b2 0.0 1.9921 /begin FUNCTION_LIST MANDETEK /end FUNCTION_LIST /end CHARACTERISTIC
/begin CHARACTERISTIC K_FLAISTMIN "Faktor La_ist min" VALUE 0xc1eff TKW_VV_VV_UB 100.0 Def_f_ub_b2 0.0 1.9921 /begin FUNCTION_LIST MANDETEK /end FUNCTION_LIST /end CHARACTERISTIC
/begin CHARACTERISTIC K_FLUFT "Konstante Fehler Luftpfad" VALUE 0xc1ef0 TKW_VV_VV_UL 100.0 Def_f_ul_b262144 0.0 262128.0002 /begin FUNCTION_LIST MANDETEK /end FUNCTION_LIST /end CHARACTERISTIC
/begin CHARACTERISTIC K_FLUFTMAX "Konstante max. Fehler lUFTpfad" VALUE 0xc1ef4 TKW_VV_VV_UL 100.0 Def_f_ul_b262144 0.0 262128.0002 /begin FUNCTION_LIST MANDETEK /end FUNCTION_LIST /end CHARACTERISTIC
/begin CHARACTERISTIC K_FLUFTMIN "Konstante mIN. Fehler lUFTpfad" VALUE 0xc1ef8 TKW_VV_VV_UL 100.0 Def_f_ul_b262144 0.0 262128.0002 /begin FUNCTION_LIST MANDETEK /end FUNCTION_LIST /end CHARACTERISTIC
/begin CHARACTERISTIC K_FMEISTMAX "Faktor Me_ist max" VALUE 0xc1f00 TKW_VV_VV_UB 100.0 Def_f_ub_b2 0.0 1.9921 /begin FUNCTION_LIST MANDETEK /end FUNCTION_LIST /end CHARACTERISTIC
/begin CHARACTERISTIC K_FMEISTMIN "Faktor Me_ist min" VALUE 0xc1f01 TKW_VV_VV_UB 100.0 Def_f_ub_b2 0.0 1.9921 /begin FUNCTION_LIST MANDETEK /end FUNCTION_LIST /end CHARACTERISTIC
/begin CHARACTERISTIC K_FMLMAX "Faktor Ml max" VALUE 0xc1f02 TKW_VV_VV_UB 100.0 Def_f_ub_b2 0.0 1.9921 /begin FUNCTION_LIST MANDETEK /end FUNCTION_LIST /end CHARACTERISTIC
/begin CHARACTERISTIC K_FMLMIN "Faktor Ml min" VALUE 0xc1f03 TKW_VV_VV_UB 100.0 Def_f_ub_b2 0.0 1.9921 /begin FUNCTION_LIST MANDETEK /end FUNCTION_LIST /end CHARACTERISTIC
/begin CHARACTERISTIC K_FPLDMAX "Faktor Pld max" VALUE 0xc1f04 TKW_VV_VV_UB 100.0 Def_f_ub_b2 0.0 1.9921 /begin FUNCTION_LIST MANDETEK /end FUNCTION_LIST /end CHARACTERISTIC
/begin CHARACTERISTIC K_FPLDMIN "Faktor Pld min" VALUE 0xc1f05 TKW_VV_VV_UB 100.0 Def_f_ub_b2 0.0 1.9921 /begin FUNCTION_LIST MANDETEK /end FUNCTION_LIST /end CHARACTERISTIC
/begin CHARACTERISTIC K_FTVAGRMAX "Faktor Tvagr max" VALUE 0xc1f06 TKW_VV_VV_UB 100.0 Def_f_ub_b2 0.0 1.9921 /begin FUNCTION_LIST MANDETEK /end FUNCTION_LIST /end CHARACTERISTIC
/begin CHARACTERISTIC K_FTVAGRMIN "Faktor Tvagr min" VALUE 0xc1f07 TKW_VV_VV_UB 100.0 Def_f_ub_b2 0.0 1.9921 /begin FUNCTION_LIST MANDETEK /end FUNCTION_LIST /end CHARACTERISTIC
/begin CHARACTERISTIC K_FTVPLDMAX "Faktor Tvpldmax" VALUE 0xc1f08 TKW_VV_VV_UB 100.0 Def_f_ub_b2 0.0 1.9921 /begin FUNCTION_LIST MANDETEK /end FUNCTION_LIST /end CHARACTERISTIC
/begin CHARACTERISTIC K_FTVPLDMIN "Faktor Tvpld min" VALUE 0xc1f09 TKW_VV_VV_UB 100.0 Def_f_ub_b2 0.0 1.9921 /begin FUNCTION_LIST MANDETEK /end FUNCTION_LIST /end CHARACTERISTIC
/begin CHARACTERISTIC K_GENDIFAK1 "Stromfaktor Diode1" VALUE 0xc0d36 TKW_VV_VV_UB 100.0 Def_f_ub_b1 0.0 0.9960 /begin FUNCTION_LIST IMDGEN_1PR /end FUNCTION_LIST /end CHARACTERISTIC
/begin CHARACTERISTIC K_GENDIFAK2 "Stromfaktor Diode2" VALUE 0xc0d37 TKW_VV_VV_UB 100.0 Def_f_ub_b1 0.0 0.9960 /begin FUNCTION_LIST IMDGEN_1PR /end FUNCTION_LIST /end CHARACTERISTIC
/begin CHARACTERISTIC K_GENDIFAK3 "Stromfaktor Diode3" VALUE 0xc0d38 TKW_VV_VV_UB 100.0 Def_f_ub_b1 0.0 0.9960 /begin FUNCTION_LIST IMDGEN_1PR /end FUNCTION_LIST /end CHARACTERISTIC
/begin CHARACTERISTIC K_GENDIFAK4 "Stromfaktor Diode4" VALUE 0xc0d39 TKW_VV_VV_UB 100.0 Def_f_ub_b1 0.0 0.9960 /begin FUNCTION_LIST IMDGEN_1PR /end FUNCTION_LIST /end CHARACTERISTIC
/begin CHARACTERISTIC K_GENITYP "Generatorstrotyp 0=gerechnet / 1=gemessen" VALUE 0xc0d3a TKW_VV_VV_UB 100.0 Def_st_ub_q1 0.0 1.0000 /begin FUNCTION_LIST IMDGEN_1PR /end FUNCTION_LIST /end CHARACTERISTIC
/begin CHARACTERISTIC K_GENLDDFMAX "Schwell Anzeige maximaler Auslastungsgrad Generator" VALUE 0xc172d TKW_VV_VV_UB 100.0 Def_f_ub_b100 0.0 99.6093 /begin FUNCTION_LIST LDSTGEN /end FUNCTION_LIST /end CHARACTERISTIC
/begin CHARACTERISTIC K_GENLLAHAPP "Applikationskonstente zum Setzen B_idlespec" VALUE 0xc1755 TKW_VV_VV_UB 100.0 Def_st_ub_q1 0.0 255.0000 /begin FUNCTION_LIST LLRANH /end FUNCTION_LIST /end CHARACTERISTIC
/begin CHARACTERISTIC K_GENMDNMOF "Offset des Generatormoments" VALUE 0xc0cda TKW_VV_VV_SW 100.0 Def_m_sw_q0p1 -3276.8000 3276.7000 /begin FUNCTION_LIST IMDGEN_1PR /end FUNCTION_LIST FORMAT "%5.2" /end CHARACTERISTIC
/begin CHARACTERISTIC K_GENRS0_1 "Generatorstatorwiderstand1 bei 25°" VALUE 0xc0ce8 TKW_VV_VV_UW 100.0 Def_f_uw_b1 0.0 9.99984741210938e-1 /begin FUNCTION_LIST IMDGEN_1PR /end FUNCTION_LIST /end CHARACTERISTIC
/begin CHARACTERISTIC K_GENRS0_2 "Generatorstatorwiderstand2 bei 25°" VALUE 0xc0cea TKW_VV_VV_UW 100.0 Def_f_uw_b1 0.0 9.99984741210938e-1 /begin FUNCTION_LIST IMDGEN_1PR /end FUNCTION_LIST /end CHARACTERISTIC
/begin CHARACTERISTIC K_GENRS0_3 "Generatorstatorwiderstand3 bei 25°" VALUE 0xc0cec TKW_VV_VV_UW 100.0 Def_f_uw_b1 0.0 9.99984741210938e-1 /begin FUNCTION_LIST IMDGEN_1PR /end FUNCTION_LIST /end CHARACTERISTIC
/begin CHARACTERISTIC K_GENRS0_4 "Generatorstatorwiderstand4 bei 25°" VALUE 0xc0cee TKW_VV_VV_UW 100.0 Def_f_uw_b1 0.0 9.99984741210938e-1 /begin FUNCTION_LIST IMDGEN_1PR /end FUNCTION_LIST /end CHARACTERISTIC
/begin CHARACTERISTIC K_GENSTFAK1 "Stromfaktor Statorspule" VALUE 0xc0d3b TKW_VV_VV_UB 100.0 Def_f_ub_b1 0.0 0.9960 /begin FUNCTION_LIST IMDGEN_1PR /end FUNCTION_LIST /end CHARACTERISTIC
/begin CHARACTERISTIC K_GENSTFAK2 "Stromfaktor Statorspule2" VALUE 0xc0d3c TKW_VV_VV_UB 100.0 Def_f_ub_b1 0.0 0.9960 /begin FUNCTION_LIST IMDGEN_1PR /end FUNCTION_LIST /end CHARACTERISTIC
/begin CHARACTERISTIC K_GENSTFAK3 "Stromfaktor Statorspule3" VALUE 0xc0d3d TKW_VV_VV_UB 100.0 Def_f_ub_b1 0.0 0.9960 /begin FUNCTION_LIST IMDGEN_1PR /end FUNCTION_LIST /end CHARACTERISTIC
/begin CHARACTERISTIC K_GENSTFAK4 "Stromfaktor Statorspule4" VALUE 0xc0d3e TKW_VV_VV_UB 100.0 Def_f_ub_b1 0.0 0.9960 /begin FUNCTION_LIST IMDGEN_1PR /end FUNCTION_LIST /end CHARACTERISTIC
/begin CHARACTERISTIC K_GENTEMPAPP "Geneeratortemperatur mauelle Vorgabe" VALUE 0xc0cdc TKW_VV_VV_SW 100.0 Def_t_sw_q0p1 -3276.8000 3276.7000 /begin FUNCTION_LIST IMDGEN_1PR /end FUNCTION_LIST FORMAT "%4.1" /end CHARACTERISTIC
/begin CHARACTERISTIC K_GENTEMPMAN "Manuelle Generatorvorgabe" VALUE 0xc0d3f TKW_VV_VV_UB 100.0 Def_st_ub_q1 0.0 255.0000 /begin FUNCTION_LIST IMDGEN_1PR /end FUNCTION_LIST /end CHARACTERISTIC
/begin CHARACTERISTIC K_GENTMOTDT "" VALUE 0xc0cde TKW_VV_VV_SW 100.0 Def_t_sw_q0p1 -3276.8000 3276.7000 /begin FUNCTION_LIST IMDGEN_1PR /end FUNCTION_LIST FORMAT "%4.1" /end CHARACTERISTIC
/begin CHARACTERISTIC K_GENTMOTOF1 "Offset Generatoransaugluft" VALUE 0xc0ce0 TKW_VV_VV_SW 100.0 Def_t_sw_q0p1 -3276.8000 3276.7000 /begin FUNCTION_LIST IMDGEN_1PR /end FUNCTION_LIST FORMAT "%4.1" /end CHARACTERISTIC
/begin CHARACTERISTIC K_GENTMOTOF2 "Offset Generatoransaugluft" VALUE 0xc0ce2 TKW_VV_VV_SW 100.0 Def_t_sw_q0p1 -3276.8000 3276.7000 /begin FUNCTION_LIST IMDGEN_1PR /end FUNCTION_LIST FORMAT "%4.1" /end CHARACTERISTIC
/begin CHARACTERISTIC K_GENTMOTOF3 "Offset Generatoransaugluft" VALUE 0xc0ce4 TKW_VV_VV_SW 100.0 Def_t_sw_q0p1 -3276.8000 3276.7000 /begin FUNCTION_LIST IMDGEN_1PR /end FUNCTION_LIST FORMAT "%4.1" /end CHARACTERISTIC
/begin CHARACTERISTIC K_GENTMOTOF4 "Offset Generatoransaugluft" VALUE 0xc0ce6 TKW_VV_VV_SW 100.0 Def_t_sw_q0p1 -3276.8000 3276.7000 /begin FUNCTION_LIST IMDGEN_1PR /end FUNCTION_LIST FORMAT "%4.1" /end CHARACTERISTIC
/begin CHARACTERISTIC K_GENTYP "Generatortyp" VALUE 0xc0d40 TKW_VV_VV_UB 100.0 Def_st_ub_q1 0.0 255.0000 /begin FUNCTION_LIST IMDGEN_1PR /end FUNCTION_LIST /end CHARACTERISTIC
/begin CHARACTERISTIC K_GENTYPFELD "Generatorkennfeldzuordnung" VAL_BLK 0xc0d50 TKW_VV_VV_UB 100.0 Def_st_ub_q1 0.0 255.0000 /begin FUNCTION_LIST IMDGEN_1PR /end FUNCTION_LIST NUMBER 33 /end CHARACTERISTIC
/begin CHARACTERISTIC K_GENUEBSETZ1 "Generatoruebersetzung1" VALUE 0xc0d30 TKW_VV_VV_UB 100.0 Def_f_ub_b4 0.0 3.9843 /begin FUNCTION_LIST IMDGEN_1PR /end FUNCTION_LIST /end CHARACTERISTIC
/begin CHARACTERISTIC K_GENUEBSETZ2 "Generatoruebersetzung2" VALUE 0xc0d31 TKW_VV_VV_UB 100.0 Def_f_ub_b4 0.0 3.9843 /begin FUNCTION_LIST IMDGEN_1PR /end FUNCTION_LIST /end CHARACTERISTIC
/begin CHARACTERISTIC K_GENUEBSETZ3 "Generatoruebersetzung3" VALUE 0xc0d32 TKW_VV_VV_UB 100.0 Def_f_ub_b4 0.0 3.9843 /begin FUNCTION_LIST IMDGEN_1PR /end FUNCTION_LIST /end CHARACTERISTIC
/begin CHARACTERISTIC K_GENUEBSETZ4 "Generatoruebersetzung4" VALUE 0xc0d33 TKW_VV_VV_UB 100.0 Def_f_ub_b4 0.0 3.9843 /begin FUNCTION_LIST IMDGEN_1PR /end FUNCTION_LIST /end CHARACTERISTIC
/begin CHARACTERISTIC K_GENUMGTYP "" VALUE 0xc0d41 TKW_VV_VV_UB 100.0 Def_st_ub_q1 0.0 255.0000 /begin FUNCTION_LIST IMDGEN_1PR /end FUNCTION_LIST /end CHARACTERISTIC
/begin CHARACTERISTIC K_GENVFZGSW "geschwindigkeitsabhängige Generatoransaugluftschwelle" VALUE 0xc0cf0 TKW_VV_VV_UW 100.0 Def_v_uw_q1p0 0.0 65535.0000 /begin FUNCTION_LIST IMDGEN_1PR /end FUNCTION_LIST /end CHARACTERISTIC
/begin CHARACTERISTIC K_GEN_IGOF "Offsetwert Generatorstrom" VALUE 0xc0cf2 TKW_VV_VV_UW 100.0 Def_f_uw_b2048 0.0 254.0000 /begin FUNCTION_LIST IMDGEN_1PR /end FUNCTION_LIST FORMAT "%5.2" /end CHARACTERISTIC
/begin CHARACTERISTIC K_GHYDRLA "Kennwerteblock für Gewicht Hydraulikpfad La_ist1" VAL_BLK 0xc1df2 TKW_VV_VV_UW 100.0 Def_f_uw_b16 0.0 15.9997 /begin FUNCTION_LIST MANDETEK /end FUNCTION_LIST NUMBER 120 FORMAT "%7.4" /end CHARACTERISTIC
/begin CHARACTERISTIC K_GHYDRME "Kennwerteblock für Gewicht Hydraulikpfad Me_ist" VAL_BLK 0xc1852 TKW_VV_VV_SW 100.0 Def_me_sw_q0p01 0.0 327.6700 /begin FUNCTION_LIST MANDETEK /end FUNCTION_LIST NUMBER 120 FORMAT "%6.3" /end CHARACTERISTIC
/begin CHARACTERISTIC K_GHYDRML "Kennwerteblock für Gewicht Hydraulikpfad Ml" VAL_BLK 0xc1942 TKW_VV_VV_SW 100.0 Def_ml_sw_q0p1 0.0 3276.7000 /begin FUNCTION_LIST MANDETEK /end FUNCTION_LIST NUMBER 120 FORMAT "%5.2" /end CHARACTERISTIC
/begin CHARACTERISTIC K_GLUFTML "Kennwerteblock für Gewicht Luftpfad Ml" VAL_BLK 0xc1a32 TKW_VV_VV_SW 100.0 Def_ml_sw_q0p1 0.0 3276.7000 /begin FUNCTION_LIST MANDETEK /end FUNCTION_LIST NUMBER 120 FORMAT "%5.2" /end CHARACTERISTIC
/begin CHARACTERISTIC K_GLUFTPLD "Kennwerteblock für Gewicht Luftpfad Pld" VAL_BLK 0xc1b22 TKW_VV_VV_SW 100.0 Def_p_sw_q1 0.0 32767.0000 /begin FUNCTION_LIST MANDETEK /end FUNCTION_LIST NUMBER 120 FORMAT "%4.1" /end CHARACTERISTIC
/begin CHARACTERISTIC K_GLUFTTVAGR "Kennwerteblock für Gewicht Luftpfad Tastverhältnis Agr" VAL_BLK 0xc1c12 TKW_VV_VV_SW 100.0 Def_tv_sw_q0p01 0.0 327.6700 /begin FUNCTION_LIST MANDETEK /end FUNCTION_LIST NUMBER 120 FORMAT "%6.3" /end CHARACTERISTIC
/begin CHARACTERISTIC K_GLUFTTVPLD "Kennwerteblock für Gewicht Luftpfad Tastverhältnis Pld" VAL_BLK 0xc1d02 TKW_VV_VV_SW 100.0 Def_tv_sw_q0p01 0.0 327.6700 /begin FUNCTION_LIST MANDETEK /end FUNCTION_LIST NUMBER 120 FORMAT "%6.3" /end CHARACTERISTIC
/begin CHARACTERISTIC K_IBSTSTERR "EBSD Fehler repeat" VALUE 0xc161b TKW_VV_VV_UB 100.0 Def_dez_ub_q1 0.0 255.0000 /begin FUNCTION_LIST KT_IBS /end FUNCTION_LIST /end CHARACTERISTIC
/begin CHARACTERISTIC K_IBSVERSION "Liste der kompatiblen IBS SW- Versionen" VAL_BLK 0xc1608 TKW_VV_VV_UB 100.0 Def_dez_ub_q1 0.0 255.0000 /begin FUNCTION_LIST KT_IBS /end FUNCTION_LIST NUMBER 16 /end CHARACTERISTIC
/begin CHARACTERISTIC K_IBTEMPMAXI "" VALUE 0xc1606 TKW_VV_VV_UB 100.0 Def_dez_ub_q1 0.0 255.0000 /begin FUNCTION_LIST KT_IBS /end FUNCTION_LIST /end CHARACTERISTIC
/begin CHARACTERISTIC K_IBTEMPMINI "" VALUE 0xc1607 TKW_VV_VV_UB 100.0 Def_dez_ub_q1 0.0 255.0000 /begin FUNCTION_LIST KT_IBS /end FUNCTION_LIST /end CHARACTERISTIC
/begin CHARACTERISTIC K_IBUNPLADEL "EBSD Fehler repeat" VALUE 0xc161a TKW_VV_VV_UB 100.0 Def_dez_ub_q1 0.0 255.0000 /begin FUNCTION_LIST KT_IBS /end FUNCTION_LIST /end CHARACTERISTIC
/begin CHARACTERISTIC K_IERRFIL "Filterkonstante für Filterung Erregerstrom" VALUE 0xc172e TKW_VV_VV_UB 100.0 Def_f_ub_b1 0.0040 0.9960 /begin FUNCTION_LIST LDSTGEN /end FUNCTION_LIST /end CHARACTERISTIC
/begin CHARACTERISTIC K_IGBASIS "Generatorgrundstrombedarf FZG " VALUE 0xc0d42 TKW_VV_VV_UB 100.0 Def_i_ub_q1 0.0 255.0000 /begin FUNCTION_LIST IMDGEN_1PR /end FUNCTION_LIST /end CHARACTERISTIC
/begin CHARACTERISTIC K_IGBASISOFF "Generatorgrundstrombedarf FZG bei Genred" VALUE 0xc0d43 TKW_VV_VV_UB 100.0 Def_i_ub_q1 0.0 255.0000 /begin FUNCTION_LIST IMDGEN_1PR /end FUNCTION_LIST /end CHARACTERISTIC
/begin CHARACTERISTIC K_IGNOTWERT "" VALUE 0xc0d44 TKW_VV_VV_UB 100.0 Def_i_ub_q1 0.0 255.0000 /begin FUNCTION_LIST IMDGEN_1PR /end FUNCTION_LIST /end CHARACTERISTIC
/begin CHARACTERISTIC K_ILMINUMG "integrierte Lufmassenschwelle Aussentemperaturmodell" VALUE 0xc1650 TKW_VV_VV_UW 100.0 Def_lm_uw_q0p000444 0.0 29.1266 /begin FUNCTION_LIST LBATTCAL /end FUNCTION_LIST FORMAT "%7.4" /end CHARACTERISTIC
/begin CHARACTERISTIC K_ISLEEPGRZ "" VALUE 0xc15f2 TKW_VV_VV_UB 100.0 Def_i_ub_q0p02 0.0 5.1000 /begin FUNCTION_LIST KT_IBS /end FUNCTION_LIST /end CHARACTERISTIC
/begin CHARACTERISTIC K_ISTARTTRIG "" VALUE 0xc15e9 TKW_VV_VV_UB 100.0 Def_i_ub_q5p12 0.0 1305.6000 /begin FUNCTION_LIST KT_IBS /end FUNCTION_LIST /end CHARACTERISTIC
/begin CHARACTERISTIC K_LAISTO "Konstante Obergrenze Lambda" VALUE 0xc1846 TKW_VV_VV_UW 100.0 Def_f_uw_b16 0.0 15.9997 /begin FUNCTION_LIST MANDETEK /end FUNCTION_LIST FORMAT "%7.4" /end CHARACTERISTIC
/begin CHARACTERISTIC K_LAISTTO "Konstante Obergrenze Lambdatotzone" VALUE 0xc1848 TKW_VV_VV_UW 100.0 Def_f_uw_b16 0.0 15.9997 /begin FUNCTION_LIST MANDETEK /end FUNCTION_LIST FORMAT "%7.4" /end CHARACTERISTIC
/begin CHARACTERISTIC K_LAISTTU "Konstante Untergrenze Lambdatotzone" VALUE 0xc184a TKW_VV_VV_UW 100.0 Def_f_uw_b16 0.0 15.9997 /begin FUNCTION_LIST MANDETEK /end FUNCTION_LIST FORMAT "%7.4" /end CHARACTERISTIC
/begin CHARACTERISTIC K_LAISTU "Konstante Untergrenze Lambda" VALUE 0xc184c TKW_VV_VV_UW 100.0 Def_f_uw_b16 0.0 15.9997 /begin FUNCTION_LIST MANDETEK /end FUNCTION_LIST FORMAT "%7.4" /end CHARACTERISTIC
/begin CHARACTERISTIC K_LAMAX "Konstante maximales Lambda" VALUE 0xc184e TKW_VV_VV_UW 100.0 Def_f_uw_b16 0.0625 15.9997 /begin FUNCTION_LIST MANDETEK /end FUNCTION_LIST FORMAT "%7.4" /end CHARACTERISTIC
/begin CHARACTERISTIC K_LAMIN "Konstante minimales Lambda" VALUE 0xc1850 TKW_VV_VV_UW 100.0 Def_f_uw_b16 0.0 15.9997 /begin FUNCTION_LIST MANDETEK /end FUNCTION_LIST FORMAT "%7.4" /end CHARACTERISTIC
/begin CHARACTERISTIC K_LBATTMAXK "maximale Batterieladespannung Kofferraum" VALUE 0xc1622 TKW_VV_VV_SW 100.0 Def_u_sw_b128 0.0 127.9960 /begin FUNCTION_LIST LBATTCAL /end FUNCTION_LIST FORMAT "%6.3" /end CHARACTERISTIC
/begin CHARACTERISTIC K_LBATTMAXM "maximale Batterieladespannung" VALUE 0xc1624 TKW_VV_VV_SW 100.0 Def_u_sw_b128 0.0 127.9960 /begin FUNCTION_LIST LBATTCAL /end FUNCTION_LIST FORMAT "%6.3" /end CHARACTERISTIC
/begin CHARACTERISTIC K_LBATTMIN "minmale Batterieladespannung Licht an" VALUE 0xc1626 TKW_VV_VV_SW 100.0 Def_u_sw_b128 0.0 127.9960 /begin FUNCTION_LIST LBATTCAL /end FUNCTION_LIST FORMAT "%6.3" /end CHARACTERISTIC
/begin CHARACTERISTIC K_LBATTTUMG "" VALUE 0xc1628 TKW_VV_VV_SW 100.0 Def_t_sw_q0p1 -3276.8000 3276.7000 /begin FUNCTION_LIST LBATTCAL /end FUNCTION_LIST FORMAT "%4.1" /end CHARACTERISTIC
/begin CHARACTERISTIC K_LBATTTUMGBA "" VALUE 0xc162a TKW_VV_VV_SW 100.0 Def_t_sw_q0p1 -3276.8000 3276.7000 /begin FUNCTION_LIST LBATTCAL /end FUNCTION_LIST FORMAT "%4.1" /end CHARACTERISTIC
/begin CHARACTERISTIC K_LERNRATE "s" VALUE 0xc1f0a TKW_VV_VV_UB 100.0 Def_f_ub_b1 0.0 0.9960 /begin FUNCTION_LIST MANDETEK /end FUNCTION_LIST /end CHARACTERISTIC
/begin CHARACTERISTIC K_LLANHAPP "LLDZanh.-level, falls Generator fehlerhaft ist." VALUE 0xc174c TKW_VV_VV_UB 100.0 Def_st_ub_q1 0.0 255.0000 /begin FUNCTION_LIST LLPMCTRL /end FUNCTION_LIST /end CHARACTERISTIC
/begin CHARACTERISTIC K_LLPMAPP "Handapplikationswert für Leerlaufdrehzahlvorgabe" VALUE 0xc174d TKW_VV_VV_UB 100.0 Def_st_ub_q1 0.0 255.0000 /begin FUNCTION_LIST LLPMCTRL /end FUNCTION_LIST /end CHARACTERISTIC
/begin CHARACTERISTIC K_LRBNS "" VALUE 0xc1779 TKW_VV_VV_UB 100.0 Def_td_ub_q0p1 0.0 25.5000 /begin FUNCTION_LIST LOADRESP /end FUNCTION_LIST /end CHARACTERISTIC
/begin CHARACTERISTIC K_LRESPAPP "Load-Response Applikation" VALUE 0xc177a TKW_VV_VV_UB 100.0 Def_td_ub_q0p1 0.0 25.5000 /begin FUNCTION_LIST LOADRESP /end FUNCTION_LIST /end CHARACTERISTIC
/begin CHARACTERISTIC K_LRMAXG "" VALUE 0xc177b TKW_VV_VV_UB 100.0 Def_td_ub_q0p1 0.0 25.5000 /begin FUNCTION_LIST LOADRESP /end FUNCTION_LIST /end CHARACTERISTIC
/begin CHARACTERISTIC K_MANAWNUMM "" VALUE 0xc0d45 TKW_VV_VV_UB 100.0 Def_st_ub_q1 0.0 255.0000 /begin FUNCTION_LIST IMDGEN_1PR /end FUNCTION_LIST /end CHARACTERISTIC
/begin CHARACTERISTIC K_MCOBATTORT "Codierung Hand Batterieeinbauort" VALUE 0xc1665 TKW_VV_VV_UB 100.0 Def_st_ub_q1 0.0 2.0000 /begin FUNCTION_LIST LBATTCAL /end FUNCTION_LIST /end CHARACTERISTIC
/begin CHARACTERISTIC K_MDGNHYS "Hysterese für Drehzahlschwelle Generator-Maximalmomentbegrenzung" VALUE 0xc1758 TKW_VV_VV_SW 100.0 Def_n_sw_q1p0 -32768.0000 32767.0000 /begin FUNCTION_LIST LOADRESP /end FUNCTION_LIST /end CHARACTERISTIC
/begin CHARACTERISTIC K_MDGNMAX "Maximaldrehzahl für Generator-Maximalmomentbegrenzung" VALUE 0xc175a TKW_VV_VV_SW 100.0 Def_n_sw_q1p0 -32768.0000 32767.0000 /begin FUNCTION_LIST LOADRESP /end FUNCTION_LIST /end CHARACTERISTIC
/begin CHARACTERISTIC K_MEISTO "Konstante Obergrenze aktuelle Einspritzmasse" VALUE 0xc181a TKW_VV_VV_SW 100.0 Def_me_sw_q0p01 0.0 327.6700 /begin FUNCTION_LIST MANDETEK /end FUNCTION_LIST FORMAT "%6.3" /end CHARACTERISTIC
/begin CHARACTERISTIC K_MEISTU "Konstante Untergrenze aktuelle Einspritzmasse" VALUE 0xc181c TKW_VV_VV_SW 100.0 Def_me_sw_q0p01 0.0 327.6700 /begin FUNCTION_LIST MANDETEK /end FUNCTION_LIST FORMAT "%6.3" /end CHARACTERISTIC
/begin CHARACTERISTIC K_MEMAX "Konstante maximale Einspritzmasse" VALUE 0xc181e TKW_VV_VV_SW 100.0 Def_me_sw_q0p01 1.2800 327.6700 /begin FUNCTION_LIST MANDETEK /end FUNCTION_LIST FORMAT "%6.3" /end CHARACTERISTIC
/begin CHARACTERISTIC K_MEMIN "Konstante minimale Einspritzmasse" VALUE 0xc1820 TKW_VV_VV_SW 100.0 Def_me_sw_q0p01 0.0 327.6700 /begin FUNCTION_LIST MANDETEK /end FUNCTION_LIST FORMAT "%6.3" /end CHARACTERISTIC
/begin CHARACTERISTIC K_MGMAXAPP "Applikationswert Genratormaximalmoment" VALUE 0xc175c TKW_VV_VV_SW 100.0 Def_m_sw_q0p1 -3276.8000 3276.7000 /begin FUNCTION_LIST LOADRESP /end FUNCTION_LIST FORMAT "%5.2" /end CHARACTERISTIC
/begin CHARACTERISTIC K_MLMAX "Konstante maximale Luftmasse pro Zylinder" VALUE 0xc1822 TKW_VV_VV_SW 100.0 Def_ml_sw_q0p1 12.8000 3276.7000 /begin FUNCTION_LIST MANDETEK /end FUNCTION_LIST FORMAT "%5.2" /end CHARACTERISTIC
/begin CHARACTERISTIC K_MLMIN "Konstante minimale Luftmasse pro Zylinder" VALUE 0xc1824 TKW_VV_VV_SW 100.0 Def_ml_sw_q0p1 0.0 3276.7000 /begin FUNCTION_LIST MANDETEK /end FUNCTION_LIST FORMAT "%5.2" /end CHARACTERISTIC
/begin CHARACTERISTIC K_MLO "Konstante Obergrenze Luftmasse pro Zylinder" VALUE 0xc1826 TKW_VV_VV_SW 100.0 Def_ml_sw_q0p1 0.0 3276.7000 /begin FUNCTION_LIST MANDETEK /end FUNCTION_LIST FORMAT "%5.2" /end CHARACTERISTIC
/begin CHARACTERISTIC K_MLU "Konstante Untergrenze Luftmasse pro Zylinder" VALUE 0xc1828 TKW_VV_VV_SW 100.0 Def_ml_sw_q0p1 0.0 3276.7000 /begin FUNCTION_LIST MANDETEK /end FUNCTION_LIST FORMAT "%5.2" /end CHARACTERISTIC
/begin CHARACTERISTIC K_NKWMANDET "Konstante Motordrehzahlschwelle Manipulationserkennung" VALUE 0xc182a TKW_VV_VV_SW 100.0 Def_n_sw_q1p0 -32768.0000 32767.0000 /begin FUNCTION_LIST MANDETEK /end FUNCTION_LIST /end CHARACTERISTIC
/begin CHARACTERISTIC K_NKW_SCH "" VALUE 0xc1756 TKW_VV_VV_SW 100.0 Def_n_sw_q1p0 0.0 32767.0000 /begin FUNCTION_LIST LOADRESP /end FUNCTION_LIST /end CHARACTERISTIC
/begin CHARACTERISTIC K_NLLMIN "Motordrehzahl unterhalb derer die LLDZanh. zurueckgenommen wird." VALUE 0xc1748 TKW_VV_VV_SW 100.0 Def_n_sw_q1p0 -32768.0000 32767.0000 /begin FUNCTION_LIST LLPMCTRL /end FUNCTION_LIST /end CHARACTERISTIC
/begin CHARACTERISTIC K_NMINUMG "Drehzahlschwelle Aussentemperaturmodell" VALUE 0xc1632 TKW_VV_VV_SW 100.0 Def_n_sw_q1p0 0.0 32767.0000 /begin FUNCTION_LIST LBATTCAL /end FUNCTION_LIST /end CHARACTERISTIC
/begin CHARACTERISTIC K_NMXGENOF "Motordrehzahlschwelle für Generatorzuschaltung" VALUE 0xc175e TKW_VV_VV_SW 100.0 Def_n_sw_q1p0 -32768.0000 32767.0000 /begin FUNCTION_LIST LOADRESP /end FUNCTION_LIST /end CHARACTERISTIC
/begin CHARACTERISTIC K_NSUBO "N_soll bei Batterieladebilanz zu niedrig" VALUE 0xc1750 TKW_VV_VV_SW 100.0 Def_n_sw_q1p0 0.0 32767.0000 /begin FUNCTION_LIST LLRANH /end FUNCTION_LIST /end CHARACTERISTIC
/begin CHARACTERISTIC K_NSUBU "N_soll bei Ladebilanz iO" VALUE 0xc1752 TKW_VV_VV_SW 100.0 Def_n_sw_q1p0 0.0 32767.0000 /begin FUNCTION_LIST LLRANH /end FUNCTION_LIST /end CHARACTERISTIC
/begin CHARACTERISTIC K_OFTUMGCAN "Offset Umgebungstemperatur CAN" VALUE 0xc1634 TKW_VV_VV_SW 100.0 Def_t_sw_q0p1 -3276.8000 3276.7000 /begin FUNCTION_LIST LBATTCAL /end FUNCTION_LIST FORMAT "%4.1" /end CHARACTERISTIC
/begin CHARACTERISTIC K_OFULADE "Offset Ladekennlinie Batthinten" VALUE 0xc1636 TKW_VV_VV_SW 100.0 Def_u_sw_b128 -128.0000 127.9960 /begin FUNCTION_LIST LBATTCAL /end FUNCTION_LIST FORMAT "%6.3" /end CHARACTERISTIC
/begin CHARACTERISTIC K_OZLANGLIM1 "Schwelle für langen Mittelwert Ölniveau (Vebrauchswarnung)" VALUE 0xc1fb3 TKW_VV_VV_UB 100.0 Def_niv_ub_b75 0.0 74.7070 /begin FUNCTION_LIST OZBG /end FUNCTION_LIST /end CHARACTERISTIC
/begin CHARACTERISTIC K_OZLANGLIM2 "Schwelle für langen Mittelwert Ölniveau (Verlustwarnung)" VALUE 0xc1fb4 TKW_VV_VV_UB 100.0 Def_niv_ub_b75 0.0 74.7070 /begin FUNCTION_LIST OZBG /end FUNCTION_LIST /end CHARACTERISTIC
/begin CHARACTERISTIC K_OZLIM1HEAL "Schwelle für Rücknahme der Ölniveauwarnung Verbrauch" VALUE 0xc1fb5 TKW_VV_VV_UB 100.0 Def_niv_ub_b75 0.0 74.7070 /begin FUNCTION_LIST OZBG /end FUNCTION_LIST /end CHARACTERISTIC
/begin CHARACTERISTIC K_OZLIM2HEAL "Schwelle für Rücknahme der Ölniveauwarnung Verlust" VALUE 0xc1fb6 TKW_VV_VV_UB 100.0 Def_niv_ub_b75 0.0 74.7070 /begin FUNCTION_LIST OZBG /end FUNCTION_LIST /end CHARACTERISTIC
/begin CHARACTERISTIC K_OZORLIM2 "Schwelle für Orientierungswert Ölniveau (Verlustwarnung)" VALUE 0xc1fb2 TKW_VV_VV_UB 100.0 Def_niv_ub_b75 0.0 74.7070 /begin FUNCTION_LIST OZBG /end FUNCTION_LIST /end CHARACTERISTIC
/begin CHARACTERISTIC K_OZVORLIM1 "Schwelle für vorgezogenen Mittelwert Ölniveau (Vebrauchswarnung)" VALUE 0xc1fb7 TKW_VV_VV_UB 100.0 Def_niv_ub_b75 0.0 74.7070 /begin FUNCTION_LIST OZBG /end FUNCTION_LIST /end CHARACTERISTIC
/begin CHARACTERISTIC K_OZVORLIM2 "Schwelle für vorgezogenen Mittelwert Ölniveau (Verlustwarnung)" VALUE 0xc1fb8 TKW_VV_VV_UB 100.0 Def_niv_ub_b75 0.0 74.7070 /begin FUNCTION_LIST OZBG /end FUNCTION_LIST /end CHARACTERISTIC
/begin CHARACTERISTIC K_PLBATTUMG "Plausibilisierung-Schwelle Batterieumgebungstemperatur" VALUE 0xc1638 TKW_VV_VV_SW 100.0 Def_t_sw_q0p1 0.0 3276.7000 /begin FUNCTION_LIST LBATTCAL /end FUNCTION_LIST FORMAT "%4.1" /end CHARACTERISTIC
/begin CHARACTERISTIC K_PLDMAX "Konstante maximalr Ladedruck" VALUE 0xc182c TKW_VV_VV_SW 100.0 Def_p_sw_q1 128.0000 32767.0000 /begin FUNCTION_LIST MANDETEK /end FUNCTION_LIST FORMAT "%4.1" /end CHARACTERISTIC
/begin CHARACTERISTIC K_PLDMIN "Konstante minimaler Ladedruck" VALUE 0xc182e TKW_VV_VV_SW 100.0 Def_p_sw_q1 0.0 32767.0000 /begin FUNCTION_LIST MANDETEK /end FUNCTION_LIST FORMAT "%4.1" /end CHARACTERISTIC
/begin CHARACTERISTIC K_PLDO "Konstante Obergrenze Ladedruck" VALUE 0xc1830 TKW_VV_VV_SW 100.0 Def_p_sw_q1 0.0 32767.0000 /begin FUNCTION_LIST MANDETEK /end FUNCTION_LIST FORMAT "%4.1" /end CHARACTERISTIC
/begin CHARACTERISTIC K_PLDU "Konstante Untergrenze Ladedruck" VALUE 0xc1832 TKW_VV_VV_SW 100.0 Def_p_sw_q1 0.0 32767.0000 /begin FUNCTION_LIST MANDETEK /end FUNCTION_LIST FORMAT "%4.1" /end CHARACTERISTIC
/begin CHARACTERISTIC K_PRELLGTMOT "Prellzeit für Tmot-Schwelle" VALUE 0xc0d46 TKW_VV_VV_UB 100.0 Def_td_ub_q1 0.0 255.0000 /begin FUNCTION_LIST IMDGEN_1PR /end FUNCTION_LIST /end CHARACTERISTIC
/begin CHARACTERISTIC K_RLEITUNGK "Widerstand Ladeleitung Batterie Kofferraum" VALUE 0xc165c TKW_VV_VV_UB 100.0 Def_f_ub_b32 0.0 31.8750 /begin FUNCTION_LIST LBATTCAL /end FUNCTION_LIST /end CHARACTERISTIC
/begin CHARACTERISTIC K_RLEITUNGM "Widerstand Ladeleitung Batterie Motorraum" VALUE 0xc165d TKW_VV_VV_UB 100.0 Def_f_ub_b32 0.0 31.8750 /begin FUNCTION_LIST LBATTCAL /end FUNCTION_LIST /end CHARACTERISTIC
/begin CHARACTERISTIC K_RLMXGENOF "relative Luftfüllungschwelle für Generatorzuschaltung" VALUE 0xc1760 TKW_VV_VV_SW 100.0 Def_rf_sw_q0p01 -327.6800 327.6700 /begin FUNCTION_LIST LOADRESP /end FUNCTION_LIST FORMAT "%7.4" /end CHARACTERISTIC
/begin CHARACTERISTIC K_SLEEPWAIT "" VALUE 0xc161e TKW_VV_VV_UB 100.0 ident 0.0 255.0000 /begin FUNCTION_LIST KT_IBS /end FUNCTION_LIST /end CHARACTERISTIC
/begin CHARACTERISTIC K_S_CLERRIBS "IBS Fehlerlöschen schaltbar" VALUE 0xc161c TKW_VV_VV_UB 100.0 Def_dez_ub_q1 0.0 255.0000 /begin FUNCTION_LIST KT_IBS /end FUNCTION_LIST /end CHARACTERISTIC
/begin CHARACTERISTIC K_T1SCHWELLE "" VALUE 0xc15ef TKW_VV_VV_UB 100.0 Def_i_ub_q0p04 0.0 10.2000 /begin FUNCTION_LIST KT_IBS /end FUNCTION_LIST /end CHARACTERISTIC
/begin CHARACTERISTIC K_T1SOC0 "" VALUE 0xc15e6 TKW_VV_VV_UB 100.0 Def_td_ub_q256 0.0 65280.0000 /begin FUNCTION_LIST KT_IBS /end FUNCTION_LIST /end CHARACTERISTIC
/begin CHARACTERISTIC K_T2SCHWELLE "" VALUE 0xc15f0 TKW_VV_VV_UB 100.0 Def_i_ub_q0p04 0.0 10.2000 /begin FUNCTION_LIST KT_IBS /end FUNCTION_LIST /end CHARACTERISTIC
/begin CHARACTERISTIC K_T2SOC0 "" VALUE 0xc15e7 TKW_VV_VV_UB 100.0 Def_td_ub_q256 0.0 65280.0000 /begin FUNCTION_LIST KT_IBS /end FUNCTION_LIST /end CHARACTERISTIC
/begin CHARACTERISTIC K_T3SCHWELLE "" VALUE 0xc15f1 TKW_VV_VV_UB 100.0 Def_i_ub_q0p04 0.0 10.2000 /begin FUNCTION_LIST KT_IBS /end FUNCTION_LIST /end CHARACTERISTIC
/begin CHARACTERISTIC K_T3SOC0 "" VALUE 0xc15e8 TKW_VV_VV_UB 100.0 Def_td_ub_q256 0.0 65280.0000 /begin FUNCTION_LIST KT_IBS /end FUNCTION_LIST /end CHARACTERISTIC
/begin CHARACTERISTIC K_TABSTGNMN "minimale Abstellzeit für Generatorreduzierung" VALUE 0xc176a TKW_VV_VV_UW 100.0 Def_st_uw_q1 0.0 65535.0000 /begin FUNCTION_LIST LOADRESP /end FUNCTION_LIST /end CHARACTERISTIC
/begin CHARACTERISTIC K_TABSTGNMX "maximale Abstellzeit für Generatorreduzierung" VALUE 0xc176c TKW_VV_VV_UW 100.0 Def_st_uw_q1 0.0 65535.0000 /begin FUNCTION_LIST LOADRESP /end FUNCTION_LIST /end CHARACTERISTIC
/begin CHARACTERISTIC K_TATMGENOF "Motordrehzahlschwelle  Katalysatortemperatur" VALUE 0xc1762 TKW_VV_VV_SW 100.0 Def_t_sw_q0p1 -3276.8000 3276.7000 /begin FUNCTION_LIST LOADRESP /end FUNCTION_LIST FORMAT "%4.1" /end CHARACTERISTIC
/begin CHARACTERISTIC K_TBATINIMAN "Applikation INITWERT Batterietemperatur" VALUE 0xc163a TKW_VV_VV_SW 100.0 Def_t_sw_q0p1 0.0 3276.7000 /begin FUNCTION_LIST LBATTCAL /end FUNCTION_LIST FORMAT "%4.1" /end CHARACTERISTIC
/begin CHARACTERISTIC K_TBATTFTAUV "Zeitkonstante 5*Tau Batterievorne" VALUE 0xc1652 TKW_VV_VV_UW 100.0 Def_st_uw_q1 0.0 65535.0000 /begin FUNCTION_LIST LBATTCAL /end FUNCTION_LIST /end CHARACTERISTIC
/begin CHARACTERISTIC K_TBATTTAUFH "Zeitkonstante Batterie 5*Tau hinten" VALUE 0xc1654 TKW_VV_VV_UW 100.0 Def_st_uw_q1 0.0 65535.0000 /begin FUNCTION_LIST LBATTCAL /end FUNCTION_LIST /end CHARACTERISTIC
/begin CHARACTERISTIC K_TGENOFVL "Generatorsabschaltzeit bei Vollastbeschleunigung" VALUE 0xc177c TKW_VV_VV_UB 100.0 Def_dez_ub_q1 0.0 255.0000 /begin FUNCTION_LIST LOADRESP /end FUNCTION_LIST /end CHARACTERISTIC
/begin CHARACTERISTIC K_TIGMISCH "" VALUE 0xc0d47 TKW_VV_VV_UB 100.0 Def_td_ub_q0p01 0.0 2.5500 /begin FUNCTION_LIST IMDGEN_1PR /end FUNCTION_LIST /end CHARACTERISTIC
/begin CHARACTERISTIC K_TIMERDLY "Verzoegerungszeit für Startwertberechnung" VALUE 0xc165e TKW_VV_VV_UB 100.0 Def_dez_ub_q1 0.0 255.0000 /begin FUNCTION_LIST LBATTCAL /end FUNCTION_LIST /end CHARACTERISTIC
/begin CHARACTERISTIC K_TLORESPST "Startloadresponse" VALUE 0xc177d TKW_VV_VV_UB 100.0 Def_td_ub_q0p1 0.0 25.5000 /begin FUNCTION_LIST LOADRESP /end FUNCTION_LIST /end CHARACTERISTIC
/begin CHARACTERISTIC K_TMOTABGNMN "minimale Motorabstelltemperatur für Generatorreduzierung" VALUE 0xc1764 TKW_VV_VV_SW 100.0 Def_t_sw_q0p01 -327.6800 327.6700 /begin FUNCTION_LIST LOADRESP /end FUNCTION_LIST FORMAT "%5.2" /end CHARACTERISTIC
/begin CHARACTERISTIC K_TMPCOM_DIV "" VALUE 0xc1600 TKW_VV_VV_UB 100.0 Def_dez_ub_q1 0.0 255.0000 /begin FUNCTION_LIST KT_IBS /end FUNCTION_LIST /end CHARACTERISTIC
/begin CHARACTERISTIC K_TMPCOM_MUL "" VALUE 0xc15ff TKW_VV_VV_UB 100.0 Def_dez_ub_q1 0.0 255.0000 /begin FUNCTION_LIST KT_IBS /end FUNCTION_LIST /end CHARACTERISTIC
/begin CHARACTERISTIC K_TNNSTART "Zeittriggerschwelle nach Motorstart" VALUE 0xc1726 TKW_VV_VV_UW 100.0 Def_td_uw_q0p01 0.0 655.3500 /begin FUNCTION_LIST LDSTGEN /end FUNCTION_LIST FORMAT "%5.2" /end CHARACTERISTIC
/begin CHARACTERISTIC K_TNUSTART "" VALUE 0xc15ea TKW_VV_VV_UB 100.0 Def_td_ub_q0p0125 0.0 3.1875 /begin FUNCTION_LIST KT_IBS /end FUNCTION_LIST /end CHARACTERISTIC
/begin CHARACTERISTIC K_TNUSTARTFL "" VALUE 0xc15eb TKW_VV_VV_UB 100.0 Def_td_ub_q0p002_o01 0.0100 0.5200 /begin FUNCTION_LIST KT_IBS /end FUNCTION_LIST /end CHARACTERISTIC
/begin CHARACTERISTIC K_TPT1TICO "" VALUE 0xc15e0 TKW_VV_VV_UW 100.0 Def_td_uw_q0p05 0.0 3276.7500 /begin FUNCTION_LIST KT_IBS /end FUNCTION_LIST FORMAT "%5.2" /end CHARACTERISTIC
/begin CHARACTERISTIC K_TSLEEPRUH "" VALUE 0xc15ee TKW_VV_VV_UB 100.0 Def_td_ub_q16 0.0 4080.0000 /begin FUNCTION_LIST KT_IBS /end FUNCTION_LIST /end CHARACTERISTIC
/begin CHARACTERISTIC K_TSTCNTEN "" VALUE 0xc0d48 TKW_VV_VV_UB 100.0 Def_st_ub_q1 0.0 255.0000 /begin FUNCTION_LIST IMDGEN_1PR /end FUNCTION_LIST /end CHARACTERISTIC
/begin CHARACTERISTIC K_TSTFIL_IN "" VALUE 0xc0cf4 TKW_VV_VV_UW 100.0 Def_t_uw_q0p075 0.0 49151.2500 /begin FUNCTION_LIST IMDGEN_1PR /end FUNCTION_LIST FORMAT "%5.2" /end CHARACTERISTIC
/begin CHARACTERISTIC K_TSTFIL_INI "" VALUE 0xc0d49 TKW_VV_VV_UB 100.0 Def_st_ub_q1 0.0 255.0000 /begin FUNCTION_LIST IMDGEN_1PR /end FUNCTION_LIST /end CHARACTERISTIC
/begin CHARACTERISTIC K_TUMGGNMN "minimale Umgebungstemperatur für Generatorreduzierung" VALUE 0xc1766 TKW_VV_VV_SW 100.0 Def_t_sw_q0p1 -3276.8000 3276.7000 /begin FUNCTION_LIST LOADRESP /end FUNCTION_LIST FORMAT "%4.1" /end CHARACTERISTIC
/begin CHARACTERISTIC K_TUMGGNMX "maximale Umgebungstemperatur für Generatorreduzierung" VALUE 0xc1768 TKW_VV_VV_SW 100.0 Def_t_sw_q0p1 -3276.8000 3276.7000 /begin FUNCTION_LIST LOADRESP /end FUNCTION_LIST FORMAT "%4.1" /end CHARACTERISTIC
/begin CHARACTERISTIC K_TUMGINI "Initialisierungswert Aussentemperaturmodell" VALUE 0xc163c TKW_VV_VV_SW 100.0 Def_t_sw_q0p1 -3276.8000 3276.7000 /begin FUNCTION_LIST LBATTCAL /end FUNCTION_LIST FORMAT "%4.1" /end CHARACTERISTIC
/begin CHARACTERISTIC K_TUMGTAU "Zeitkonstante 5*Tau Aussentemperatur" VALUE 0xc1656 TKW_VV_VV_UW 100.0 Def_st_uw_q1 0.0 65535.0000 /begin FUNCTION_LIST LBATTCAL /end FUNCTION_LIST /end CHARACTERISTIC
/begin CHARACTERISTIC K_TVAGRMAX "Konstante maximales Tastverhältnis AGR-Steller" VALUE 0xc1834 TKW_VV_VV_SW 100.0 Def_tv_sw_q0p01 1.2800 327.6700 /begin FUNCTION_LIST MANDETEK /end FUNCTION_LIST FORMAT "%6.3" /end CHARACTERISTIC
/begin CHARACTERISTIC K_TVAGRMIN "Konstante minimales Tastverhältnis AGR-Steller" VALUE 0xc1836 TKW_VV_VV_SW 100.0 Def_tv_sw_q0p01 0.0 327.6700 /begin FUNCTION_LIST MANDETEK /end FUNCTION_LIST FORMAT "%6.3" /end CHARACTERISTIC
/begin CHARACTERISTIC K_TVAGRO "Konstante Obergrenze Tastverhältnis AGR-Steller" VALUE 0xc1838 TKW_VV_VV_SW 100.0 Def_tv_sw_q0p01 0.0 327.6700 /begin FUNCTION_LIST MANDETEK /end FUNCTION_LIST FORMAT "%6.3" /end CHARACTERISTIC
/begin CHARACTERISTIC K_TVAGRU "Konstante Untergrenze Tastverhältnis AGR-Steller" VALUE 0xc183a TKW_VV_VV_SW 100.0 Def_tv_sw_q0p01 0.0 327.6700 /begin FUNCTION_LIST MANDETEK /end FUNCTION_LIST FORMAT "%6.3" /end CHARACTERISTIC
/begin CHARACTERISTIC K_TVLOFHYST "Hysterese Generatorvollastabschaltung" VALUE 0xc177e TKW_VV_VV_UB 100.0 Def_dez_ub_q1 0.0 255.0000 /begin FUNCTION_LIST LOADRESP /end FUNCTION_LIST /end CHARACTERISTIC
/begin CHARACTERISTIC K_TVPLDMAX "Konstante maximales Tastverhältnis Ladedrucksteller" VALUE 0xc183c TKW_VV_VV_SW 100.0 Def_tv_sw_q0p01 1.2800 327.6700 /begin FUNCTION_LIST MANDETEK /end FUNCTION_LIST FORMAT "%6.3" /end CHARACTERISTIC
/begin CHARACTERISTIC K_TVPLDMIN "Konstante minimales Tastverhältnis Ladedrucksteller" VALUE 0xc183e TKW_VV_VV_SW 100.0 Def_tv_sw_q0p01 0.0 327.6700 /begin FUNCTION_LIST MANDETEK /end FUNCTION_LIST FORMAT "%6.3" /end CHARACTERISTIC
/begin CHARACTERISTIC K_TVPLDO "Konstante Obergrenze Tastverhältnis Ladedrucksteller" VALUE 0xc1840 TKW_VV_VV_SW 100.0 Def_tv_sw_q0p01 0.0 327.6700 /begin FUNCTION_LIST MANDETEK /end FUNCTION_LIST FORMAT "%6.3" /end CHARACTERISTIC
/begin CHARACTERISTIC K_TVPLDU "Konstante Untergrenze Tastverhältnis Ladedrucksteller" VALUE 0xc1842 TKW_VV_VV_SW 100.0 Def_tv_sw_q0p01 0.0 327.6700 /begin FUNCTION_LIST MANDETEK /end FUNCTION_LIST FORMAT "%6.3" /end CHARACTERISTIC
/begin CHARACTERISTIC K_T_CLERRIBS "" VALUE 0xc161d TKW_VV_VV_UB 100.0 Def_dez_ub_q1 0.0 255.0000 /begin FUNCTION_LIST KT_IBS /end FUNCTION_LIST /end CHARACTERISTIC
/begin CHARACTERISTIC K_T_UTIEFSET "" VALUE 0xc15ed TKW_VV_VV_UB 100.0 Def_td_ub_q1 0.0 255.0000 /begin FUNCTION_LIST KT_IBS /end FUNCTION_LIST /end CHARACTERISTIC
/begin CHARACTERISTIC K_UBATTNORM "Batterienormspannung" VALUE 0xc163e TKW_VV_VV_SW 100.0 Def_u_sw_b128 -128.0000 127.9960 /begin FUNCTION_LIST LBATTCAL /end FUNCTION_LIST FORMAT "%6.3" /end CHARACTERISTIC
/begin CHARACTERISTIC K_UBW_TNSTART "Wartezeit nach Start" VALUE 0xc1620 TKW_VV_VV_UW 100.0 Def_td_uw_q0p01 0.0 655.3500 /begin FUNCTION_LIST LAYER /end FUNCTION_LIST FORMAT "%5.2" /end CHARACTERISTIC
/begin CHARACTERISTIC K_UDIODERMS1 "RMS-Schwellspannung Generatordiode1" VALUE 0xc0d4a TKW_VV_VV_UB 100.0 Def_f_ub_b2 0.0 1.9921 /begin FUNCTION_LIST IMDGEN_1PR /end FUNCTION_LIST /end CHARACTERISTIC
/begin CHARACTERISTIC K_UDIODERMS2 "RMS-Schwellspannung Generatordiode2" VALUE 0xc0d4b TKW_VV_VV_UB 100.0 Def_f_ub_b2 0.0 1.9921 /begin FUNCTION_LIST IMDGEN_1PR /end FUNCTION_LIST /end CHARACTERISTIC
/begin CHARACTERISTIC K_UDIODERMS3 "RMS-Schwellspannung Generatordiode3" VALUE 0xc0d4c TKW_VV_VV_UB 100.0 Def_f_ub_b2 0.0 1.9921 /begin FUNCTION_LIST IMDGEN_1PR /end FUNCTION_LIST /end CHARACTERISTIC
/begin CHARACTERISTIC K_UDIODERMS4 "RMS-Schwellspannung Generatordiode3" VALUE 0xc0d4d TKW_VV_VV_UB 100.0 Def_f_ub_b2 0.0 1.9921 /begin FUNCTION_LIST IMDGEN_1PR /end FUNCTION_LIST /end CHARACTERISTIC
/begin CHARACTERISTIC K_UKOMPK "Applikationswert Kompensationsspannung Kafferraum" VALUE 0xc162c TKW_VV_VV_UW 100.0 Def_u_uw_q0p0942 0.0 1.9782 /begin FUNCTION_LIST LBATTCAL /end FUNCTION_LIST FORMAT "%4.1" /end CHARACTERISTIC
/begin CHARACTERISTIC K_UKOMPM "Applikationswert Kompensationsspannung Motorraum" VALUE 0xc162e TKW_VV_VV_UW 100.0 Def_u_uw_q0p0942 0.0 2.0000 /begin FUNCTION_LIST LBATTCAL /end FUNCTION_LIST FORMAT "%4.1" /end CHARACTERISTIC
/begin CHARACTERISTIC K_ULADE_TAU "Batterieladespannungs Zeitkonstante" VALUE 0xc1658 TKW_VV_VV_UW 100.0 Def_f_uw_b1 0.0 9.99984741210938e-1 /begin FUNCTION_LIST LBATTCAL /end FUNCTION_LIST /end CHARACTERISTIC
/begin CHARACTERISTIC K_UTIEFAPP "" VALUE 0xc15ec TKW_VV_VV_UB 100.0 Def_u_ub_q0p064_o6 6.0000 22.3200 /begin FUNCTION_LIST KT_IBS /end FUNCTION_LIST /end CHARACTERISTIC
/begin CHARACTERISTIC K_VGENOFMN "Geschwindigkeitgeneratorabschaltschwelle bei Vollastbeschleunigung" VALUE 0xc176e TKW_VV_VV_UW 100.0 Def_v_uw_q1p0 0.0 65535.0000 /begin FUNCTION_LIST LOADRESP /end FUNCTION_LIST /end CHARACTERISTIC
/begin CHARACTERISTIC K_VGENOGMX "Geschwindigkeitgeneratorzuschaltschwelle bei Vollastbeschleunigung" VALUE 0xc1770 TKW_VV_VV_UW 100.0 Def_v_uw_q1p0 0.0 65535.0000 /begin FUNCTION_LIST LOADRESP /end FUNCTION_LIST /end CHARACTERISTIC
/begin CHARACTERISTIC K_VMINUMG "Fahrzeuggeschwindigkeitsschwelle Aussentemperaturmodell" VALUE 0xc165a TKW_VV_VV_UW 100.0 Def_v_uw_q1p0 0.0 65535.0000 /begin FUNCTION_LIST LBATTCAL /end FUNCTION_LIST /end CHARACTERISTIC
/begin CHARACTERISTIC K_VZLORESOFV "Geschwindigkeitsschwelle für Generatorzuschaltung" VALUE 0xc1772 TKW_VV_VV_UW 100.0 Def_v_uw_q1p0 0.0 65535.0000 /begin FUNCTION_LIST LOADRESP /end FUNCTION_LIST /end CHARACTERISTIC
/begin CHARACTERISTIC K_WPEDMANDET "Konstante Pedalwertgeber Manipulationserkennung" VALUE 0xc1844 TKW_VV_VV_SW 100.0 Def_tv_sw_q0p0244 -800.0000 799.9755 /begin FUNCTION_LIST MANDETEK /end FUNCTION_LIST FORMAT "%5.2" /end CHARACTERISTIC
/begin CHARACTERISTIC K_ZMGENIG "" VALUE 0xc0cf6 TKW_VV_VV_UW 100.0 Def_f_uw_b1 0.0 9.99984741210938e-1 /begin FUNCTION_LIST IMDGEN_1PR /end FUNCTION_LIST /end CHARACTERISTIC
/begin CHARACTERISTIC K_ZMGENS0HZ1 "Zeitkonstante Generatorstator1 Aufheizung im Stand" VALUE 0xc0cf8 TKW_VV_VV_UW 100.0 Def_f_uw_b1 0.0 9.99984741210938e-1 /begin FUNCTION_LIST IMDGEN_1PR /end FUNCTION_LIST /end CHARACTERISTIC
/begin CHARACTERISTIC K_ZMGENS0HZ2 "Zeitkonstante Generatorstator2 Aufheizung im Stand" VALUE 0xc0cfa TKW_VV_VV_UW 100.0 Def_f_uw_b1 0.0 9.99984741210938e-1 /begin FUNCTION_LIST IMDGEN_1PR /end FUNCTION_LIST /end CHARACTERISTIC
/begin CHARACTERISTIC K_ZMGENS0HZ3 "Zeitkonstante Generatorstator3 Aufheizung im Stand" VALUE 0xc0cfc TKW_VV_VV_UW 100.0 Def_f_uw_b1 0.0 9.99984741210938e-1 /begin FUNCTION_LIST IMDGEN_1PR /end FUNCTION_LIST /end CHARACTERISTIC
/begin CHARACTERISTIC K_ZMGENS0HZ4 "Zeitkonstante Generatorstator4 Aufheizung im Stand" VALUE 0xc0cfe TKW_VV_VV_UW 100.0 Def_f_uw_b1 0.0 9.99984741210938e-1 /begin FUNCTION_LIST IMDGEN_1PR /end FUNCTION_LIST /end CHARACTERISTIC
/begin CHARACTERISTIC K_ZMGENS0KL1 "Zeitkonstante Abkühlung Generator im Stand1" VALUE 0xc0d00 TKW_VV_VV_UW 100.0 Def_f_uw_b1 0.0 9.99984741210938e-1 /begin FUNCTION_LIST IMDGEN_1PR /end FUNCTION_LIST /end CHARACTERISTIC
/begin CHARACTERISTIC K_ZMGENS0KL2 "Zeitkonstante Abkühlung Generator im Stand2" VALUE 0xc0d02 TKW_VV_VV_UW 100.0 Def_f_uw_b1 0.0 9.99984741210938e-1 /begin FUNCTION_LIST IMDGEN_1PR /end FUNCTION_LIST /end CHARACTERISTIC
/begin CHARACTERISTIC K_ZMGENS0KL3 "Zeitkonstante Abkühlung Generator im Stand3" VALUE 0xc0d04 TKW_VV_VV_UW 100.0 Def_f_uw_b1 0.0 9.99984741210938e-1 /begin FUNCTION_LIST IMDGEN_1PR /end FUNCTION_LIST /end CHARACTERISTIC
/begin CHARACTERISTIC K_ZMGENS0KL4 "Zeitkonstante Abkühlung Generator im Stand4" VALUE 0xc0d06 TKW_VV_VV_UW 100.0 Def_f_uw_b1 0.0 9.99984741210938e-1 /begin FUNCTION_LIST IMDGEN_1PR /end FUNCTION_LIST /end CHARACTERISTIC
/begin CHARACTERISTIC K_ZMGENSTHZ1 "Zeitkonstante Generatorstator1 Aufheizung" VALUE 0xc0d08 TKW_VV_VV_UW 100.0 Def_f_uw_b1 0.0 9.99984741210938e-1 /begin FUNCTION_LIST IMDGEN_1PR /end FUNCTION_LIST /end CHARACTERISTIC
/begin CHARACTERISTIC K_ZMGENSTHZ2 "Zeitkonstante Generatorstator2 Aufheizung" VALUE 0xc0d0a TKW_VV_VV_UW 100.0 Def_f_uw_b1 0.0 9.99984741210938e-1 /begin FUNCTION_LIST IMDGEN_1PR /end FUNCTION_LIST /end CHARACTERISTIC
/begin CHARACTERISTIC K_ZMGENSTHZ3 "Zeitkonstante Generatorstator3 Aufheizung" VALUE 0xc0d0c TKW_VV_VV_UW 100.0 Def_f_uw_b1 0.0 9.99984741210938e-1 /begin FUNCTION_LIST IMDGEN_1PR /end FUNCTION_LIST /end CHARACTERISTIC
/begin CHARACTERISTIC K_ZMGENSTHZ4 "Zeitkonstante Generatorstator4 Aufheizung" VALUE 0xc0d0e TKW_VV_VV_UW 100.0 Def_f_uw_b1 0.0 9.99984741210938e-1 /begin FUNCTION_LIST IMDGEN_1PR /end FUNCTION_LIST /end CHARACTERISTIC
/begin CHARACTERISTIC K_ZMGENSTKL1 "Zeitkonstante Abkühlung Generator1" VALUE 0xc0d10 TKW_VV_VV_UW 100.0 Def_f_uw_b1 0.0 9.99984741210938e-1 /begin FUNCTION_LIST IMDGEN_1PR /end FUNCTION_LIST /end CHARACTERISTIC
/begin CHARACTERISTIC K_ZMGENSTKL2 "Zeitkonstante Abkühlung Generator2" VALUE 0xc0d12 TKW_VV_VV_UW 100.0 Def_f_uw_b1 0.0 9.99984741210938e-1 /begin FUNCTION_LIST IMDGEN_1PR /end FUNCTION_LIST /end CHARACTERISTIC
/begin CHARACTERISTIC K_ZMGENSTKL3 "Zeitkonstante Abkühlung Generator3" VALUE 0xc0d14 TKW_VV_VV_UW 100.0 Def_f_uw_b1 0.0 9.99984741210938e-1 /begin FUNCTION_LIST IMDGEN_1PR /end FUNCTION_LIST /end CHARACTERISTIC
/begin CHARACTERISTIC K_ZMGENSTKL4 "Zeitkonstante Abkühlung Generator4" VALUE 0xc0d16 TKW_VV_VV_UW 100.0 Def_f_uw_b1 0.0 9.99984741210938e-1 /begin FUNCTION_LIST IMDGEN_1PR /end FUNCTION_LIST /end CHARACTERISTIC
/begin CHARACTERISTIC K_ZMGENTWA "" VALUE 0xc0d18 TKW_VV_VV_UW 100.0 Def_f_uw_b1 0.0 9.99984741210938e-1 /begin FUNCTION_LIST IMDGEN_1PR /end FUNCTION_LIST /end CHARACTERISTIC
/begin CHARACTERISTIC K_ZMGN0TANS1 "Zeitkonstante Generatoransaugluft1 bei vfzg = 0" VALUE 0xc0d1a TKW_VV_VV_UW 100.0 Def_f_uw_b1 0.0 9.99984741210938e-1 /begin FUNCTION_LIST IMDGEN_1PR /end FUNCTION_LIST /end CHARACTERISTIC
/begin CHARACTERISTIC K_ZMGN0TANS2 "Zeitkonstante Generatoransaugluft2 bei vfzg = 0" VALUE 0xc0d1c TKW_VV_VV_UW 100.0 Def_f_uw_b1 0.0 9.99984741210938e-1 /begin FUNCTION_LIST IMDGEN_1PR /end FUNCTION_LIST /end CHARACTERISTIC
/begin CHARACTERISTIC K_ZMGN0TANS3 "Zeitkonstante Generatoransaugluft3 bei vfzg = 0" VALUE 0xc0d1e TKW_VV_VV_UW 100.0 Def_f_uw_b1 0.0 9.99984741210938e-1 /begin FUNCTION_LIST IMDGEN_1PR /end FUNCTION_LIST /end CHARACTERISTIC
/begin CHARACTERISTIC K_ZMGN0TANS4 "Zeitkonstante Generatoransaugluft4 bei vfzg = 0" VALUE 0xc0d20 TKW_VV_VV_UW 100.0 Def_f_uw_b1 0.0 9.99984741210938e-1 /begin FUNCTION_LIST IMDGEN_1PR /end FUNCTION_LIST /end CHARACTERISTIC
/begin CHARACTERISTIC K_ZMGNTANS1 "Zeitkonstante Generatoransaugluft1" VALUE 0xc0d22 TKW_VV_VV_UW 100.0 Def_f_uw_b1 0.0 9.99984741210938e-1 /begin FUNCTION_LIST IMDGEN_1PR /end FUNCTION_LIST /end CHARACTERISTIC
/begin CHARACTERISTIC K_ZMGNTANS2 "Zeitkonstante Generatoransaugluft2" VALUE 0xc0d24 TKW_VV_VV_UW 100.0 Def_f_uw_b1 0.0 9.99984741210938e-1 /begin FUNCTION_LIST IMDGEN_1PR /end FUNCTION_LIST /end CHARACTERISTIC
/begin CHARACTERISTIC K_ZMGNTANS3 "Zeitkonstante Generatoransaugluft3" VALUE 0xc0d26 TKW_VV_VV_UW 100.0 Def_f_uw_b1 0.0 9.99984741210938e-1 /begin FUNCTION_LIST IMDGEN_1PR /end FUNCTION_LIST /end CHARACTERISTIC
/begin CHARACTERISTIC K_ZMGNTANS4 "Zeitkonstante Generatoransaugluft3" VALUE 0xc0d28 TKW_VV_VV_UW 100.0 Def_f_uw_b1 0.0 9.99984741210938e-1 /begin FUNCTION_LIST IMDGEN_1PR /end FUNCTION_LIST /end CHARACTERISTIC
/begin CHARACTERISTIC K_ZMIGMISCH "Zeitkonstante IG Mischung" VALUE 0xc0d2a TKW_VV_VV_UW 100.0 Def_f_uw_b1 0.0 9.99984741210938e-1 /begin FUNCTION_LIST IMDGEN_1PR /end FUNCTION_LIST /end CHARACTERISTIC
/begin CHARACTERISTIC K_ZMTESTFIL "" VALUE 0xc0d2c TKW_VV_VV_UW 100.0 Def_f_uw_b1 0.0 9.99984741210938e-1 /begin FUNCTION_LIST IMDGEN_1PR /end FUNCTION_LIST /end CHARACTERISTIC
/begin CHARACTERISTIC S_IGMISCH "" VALUE 0xc0d4e TKW_VV_VV_UB 100.0 Identity 0.0 1.0000 /begin FUNCTION_LIST IMDGEN_1PR /end FUNCTION_LIST /end CHARACTERISTIC
/begin CHARACTERISTIC S_LBATT1 "Applikationsschalter1 Auswahl Ersatztemperatur" VALUE 0xc165f TKW_VV_VV_UB 100.0 Identity 0.0 1.0000 /begin FUNCTION_LIST LBATTCAL /end FUNCTION_LIST /end CHARACTERISTIC
/begin CHARACTERISTIC S_LBATT2 "Applikationsschalter2 Auswahl Ersatztemperatur" VALUE 0xc1660 TKW_VV_VV_UB 100.0 Identity 0.0 1.0000 /begin FUNCTION_LIST LBATTCAL /end FUNCTION_LIST /end CHARACTERISTIC
/begin CHARACTERISTIC S_LBATTAPPL "" VALUE 0xc1666 TKW_VV_VV_UB 100.0 Identity 0.0 1.0000 /begin FUNCTION_LIST LBATTCAL /end FUNCTION_LIST /end CHARACTERISTIC
/begin CHARACTERISTIC S_LORESLL "Schalter Kennlinienausschaltzeit " VALUE 0xc177f TKW_VV_VV_UB 100.0 Identity 0.0 1.0000 /begin FUNCTION_LIST LOADRESP /end FUNCTION_LIST /end CHARACTERISTIC
/begin CHARACTERISTIC S_MGAPP "Schalter für Applikationswert Genratormaximalmoment" VALUE 0xc1780 TKW_VV_VV_UB 100.0 Identity 0.0 1.0000 /begin FUNCTION_LIST LOADRESP /end FUNCTION_LIST /end CHARACTERISTIC
/begin CHARACTERISTIC S_N_IDLIBS "Schalter zum manuellen Setzen von LL aktiv" VALUE 0xc174e TKW_VV_VV_UB 100.0 Identity 0.0 1.0000 /begin FUNCTION_LIST LLPMCTRL /end FUNCTION_LIST /end CHARACTERISTIC
/begin CHARACTERISTIC S_RDGENTYP "" VALUE 0xc0d4f TKW_VV_VV_UB 100.0 Def_st_ub_q1 0.0 255.0000 /begin FUNCTION_LIST IMDGEN_1PR /end FUNCTION_LIST /end CHARACTERISTIC
/begin CHARACTERISTIC S_SAPP "Schalter für Applikationswert Begrenzungsstrategie" VALUE 0xc1781 TKW_VV_VV_UB 100.0 Identity 0.0 1.0000 /begin FUNCTION_LIST LOADRESP /end FUNCTION_LIST /end CHARACTERISTIC
/begin CHARACTERISTIC S_TLACTIV "" VALUE 0xc1782 TKW_VV_VV_UB 100.0 Identity 0.0 1.0000 /begin FUNCTION_LIST LOADRESP /end FUNCTION_LIST /end CHARACTERISTIC
/begin MEASUREMENT Abst_hydr "Abstand Hydraulikpfadpfad" ULONG Def_f_ul_b262144 0 0 0.0 11.9998 ECU_ADDRESS 0x7FDAFC /begin FUNCTION_LIST MANDETEK /end FUNCTION_LIST /end MEASUREMENT
/begin MEASUREMENT Abst_luft "Abstand Luftpfad" ULONG Def_f_ul_b262144 0 0 0.0 15.9997 ECU_ADDRESS 0x7FDB00 /begin FUNCTION_LIST MANDETEK /end FUNCTION_LIST /end MEASUREMENT
/begin MEASUREMENT Abst_temp1 "Abstand Hydraulikpfad temporär 1" UWORD Def_f_uw_b4 0 0 0.0 3.9999 ECU_ADDRESS 0x7FDAC2 /begin FUNCTION_LIST MANDETEK /end FUNCTION_LIST /end MEASUREMENT
/begin MEASUREMENT Abst_temp2 "Abstand Hydraulikpfad temporär 2" UWORD Def_f_uw_b4 0 0 0.0 3.9999 ECU_ADDRESS 0x7FDAC4 /begin FUNCTION_LIST MANDETEK /end FUNCTION_LIST /end MEASUREMENT
/begin MEASUREMENT Abst_temp3 "Abstand Hydraulikpfad temporär 3" UWORD Def_f_uw_b4 0 0 0.0 3.9999 ECU_ADDRESS 0x7FDAC6 /begin FUNCTION_LIST MANDETEK /end FUNCTION_LIST /end MEASUREMENT
/begin MEASUREMENT Abst_temp4 "Abstand Luftpfad temporär 5" UWORD Def_f_uw_b4 0 0 0.0 3.9999 ECU_ADDRESS 0x7FDAC8 /begin FUNCTION_LIST MANDETEK /end FUNCTION_LIST /end MEASUREMENT
/begin MEASUREMENT Abst_temp5 "Abstand Luftpfad temporär 6" UWORD Def_f_uw_b4 0 0 0.0 3.9999 ECU_ADDRESS 0x7FDACA /begin FUNCTION_LIST MANDETEK /end FUNCTION_LIST /end MEASUREMENT
/begin MEASUREMENT Abst_temp6 "Abstand Luftpfad temporär 7" UWORD Def_f_uw_b4 0 0 0.0 3.9999 ECU_ADDRESS 0x7FDACC /begin FUNCTION_LIST MANDETEK /end FUNCTION_LIST /end MEASUREMENT
/begin MEASUREMENT Abst_temp7 "Abstand Luftpfad temporär 8" UWORD Def_f_uw_b4 0 0 0.0 3.9999 ECU_ADDRESS 0x7FDACE /begin FUNCTION_LIST MANDETEK /end FUNCTION_LIST /end MEASUREMENT
/begin MEASUREMENT Acfzgl "Fahrzeuglängsbeschleunigung" SBYTE Def_ac_sb_q0p25 0 0 -32.0000 31.7500 ECU_ADDRESS 0x7FC100 /begin FUNCTION_LIST LAYER /end FUNCTION_LIST /end MEASUREMENT
/begin MEASUREMENT Acfzgq "Fahrzeugquerbeschleunigung" SBYTE Def_ac_sb_q0p25 0 0 -32.0000 31.7500 ECU_ADDRESS 0x7FC101 /begin FUNCTION_LIST LAYER /end FUNCTION_LIST /end MEASUREMENT
/begin MEASUREMENT Batt_class "Klassifizierung der in diesem Fzg. eingebauten Batterie" UBYTE Def_dez_ub_q1 0 0 0.0 255.0000 ECU_ADDRESS 0x7FD94C /begin FUNCTION_LIST LAYER /end FUNCTION_LIST /end MEASUREMENT
/begin MEASUREMENT Batt_coort "Codierter Batterieeinbauort" UBYTE Def_dez_ub_q1 0 0 0.0 255.0000 ECU_ADDRESS 0x7FC134 /begin FUNCTION_LIST LAYER /end FUNCTION_LIST /end MEASUREMENT
/begin MEASUREMENT Batt_ort "Batterieeinbauort" UBYTE Def_st_ub_q1 0 0 0.0 255.0000 ECU_ADDRESS 0x7FD99E /begin FUNCTION_LIST LBATTCAL /end FUNCTION_LIST /end MEASUREMENT
/begin MEASUREMENT Batt_tfil "Zeitkonstante Batterie" UWORD Def_f_uw_b1 0 0 0.0 9.99984741210938e-1 ECU_ADDRESS 0x7FD99A /begin FUNCTION_LIST LBATTCAL /end FUNCTION_LIST /end MEASUREMENT
/begin MEASUREMENT Bordnetz "Ausgewähltes Bordnetz(0x01 => CAN11H, 0x02 => CAN12H(BN2000))" UBYTE Def_st_ub_q1 0 0 0.0 255.0000 ECU_ADDRESS 0x7FC135 /begin FUNCTION_LIST LAYER /end FUNCTION_LIST /end MEASUREMENT
/begin MEASUREMENT Bosbtvfbk "Rest-Verfügbarkeit Motoröl in Prozent" UBYTE Def_dez_ub_q1 0 0 0.0 255.0000 ECU_ADDRESS 0x7FDE8E /begin FUNCTION_LIST OZBG /end FUNCTION_LIST /end MEASUREMENT
/begin MEASUREMENT Bosbtvfbkt "Verfügbarkeit vom Tester" UBYTE Def_dez_ub_q1 0 0 0.0 255.0000 ECU_ADDRESS 0x7FC0FD /begin FUNCTION_LIST LAYER /end FUNCTION_LIST /end MEASUREMENT
/begin MEASUREMENT Bosfxid2 "Zieltermin_Monat_BOS_Rückstellung_2" SWORD Def_dez_sw_q1 0 0 -32768.0000 32767.0000 ECU_ADDRESS 0x7FDE8A /begin FUNCTION_LIST OZBG /end FUNCTION_LIST /end MEASUREMENT
/begin MEASUREMENT Bosfxid2r "ID_Funktion_BOS_Rückstellung_2" UWORD Def_dez_uw_q1 0 0 0.0 65535.0000 ECU_ADDRESS 0x7FD966 /begin FUNCTION_LIST LAYER /end FUNCTION_LIST /end MEASUREMENT
/begin MEASUREMENT Bosid2 "Zieltermin_Monat_BOS_Rückstellung_2" UBYTE Def_dez_ub_q1 0 0 0.0 255.0000 ECU_ADDRESS 0x7FDE8F /begin FUNCTION_LIST OZBG /end FUNCTION_LIST /end MEASUREMENT
/begin MEASUREMENT Bosid2r "ID_2_BOS_Rückstellung_2" UBYTE Def_dez_ub_q1 0 0 0.0 255.0000 ECU_ADDRESS 0x7FD964 /begin FUNCTION_LIST LAYER /end FUNCTION_LIST /end MEASUREMENT
/begin MEASUREMENT Bosjziel "Zieltermin_Monat_BOS_Rückstellung_2" UBYTE Def_dez_ub_q1 0 0 0.0 255.0000 ECU_ADDRESS 0x7FDE90 /begin FUNCTION_LIST OZBG /end FUNCTION_LIST /end MEASUREMENT
/begin MEASUREMENT Bosjzielr "Zieltermin_Monat_BOS_Rückstellung_2" UBYTE Def_dez_ub_q1 0 0 0.0 255.0000 ECU_ADDRESS 0x7FD968 /begin FUNCTION_LIST LAYER /end FUNCTION_LIST /end MEASUREMENT
/begin MEASUREMENT Bosjzielt "Zieltermin_Jahr vom Tester" UBYTE Def_dez_ub_q1 0 0 0.0 255.0000 ECU_ADDRESS 0x7FC1C2 /begin FUNCTION_LIST LAYER /end FUNCTION_LIST /end MEASUREMENT
/begin MEASUREMENT Bosmziel "Zieltermin_Monat_BOS_Meldung_2" UBYTE Def_dez_ub_q1 0 0 0.0 255.0000 ECU_ADDRESS 0x7FDE91 /begin FUNCTION_LIST OZBG /end FUNCTION_LIST /end MEASUREMENT
/begin MEASUREMENT Bosmzielr "Zieltermin_Jahr_BOS_Rückstellung_2" UBYTE Def_dez_ub_q1 0 0 0.0 255.0000 ECU_ADDRESS 0x7FD969 /begin FUNCTION_LIST LAYER /end FUNCTION_LIST /end MEASUREMENT
/begin MEASUREMENT Bosmzielt "Zieltermin_Monat vom Tester" UBYTE Def_dez_ub_q1 0 0 0.0 255.0000 ECU_ADDRESS 0x7FC1C1 /begin FUNCTION_LIST LAYER /end FUNCTION_LIST /end MEASUREMENT
/begin MEASUREMENT Bosprog2 "Prognose_Intervall_Zeit_BOS_Meldung_2" UBYTE Def_dez_ub_q1 0 0 0.0 255.0000 ECU_ADDRESS 0x7FDE92 /begin FUNCTION_LIST OZBG /end FUNCTION_LIST /end MEASUREMENT
/begin MEASUREMENT Bosprog2r "Prognose_Intervall_Zeit_BOS_Rückstellung_2" UBYTE Def_dez_ub_q1 0 0 0.0 255.0000 ECU_ADDRESS 0x7FD96A /begin FUNCTION_LIST LAYER /end FUNCTION_LIST /end MEASUREMENT
/begin MEASUREMENT Bosprog2t "Prognose_Intervall_Zeit vom Tester" UBYTE Def_dez_ub_q1 0 0 0.0 255.0000 ECU_ADDRESS 0x7FC1C3 /begin FUNCTION_LIST LAYER /end FUNCTION_LIST /end MEASUREMENT
/begin MEASUREMENT Bosres "Zieltermin_Monat_BOS_Rückstellung_2" UBYTE Def_dez_ub_q1 0 0 0.0 255.0000 ECU_ADDRESS 0x7FDE93 /begin FUNCTION_LIST OZBG /end FUNCTION_LIST /end MEASUREMENT
/begin MEASUREMENT Bosrlsm "Ausgabewert Restlaufstrecke Motoröl" SWORD Def_km_sw_q10 0 0 -327680.0000 327670.0000 ECU_ADDRESS 0x7FDE8C /begin FUNCTION_LIST OZBG /end FUNCTION_LIST /end MEASUREMENT
/begin MEASUREMENT Bosrlsmr "Restlaufstrecke Motoröl vom Kombi" SWORD Def_km_sw_q10 0 0 -327680.0000 327670.0000 ECU_ADDRESS 0x7FC1BC /begin FUNCTION_LIST LAYER /end FUNCTION_LIST /end MEASUREMENT
/begin MEASUREMENT Bosrlsmt "Restlaufstrecke Motoröl vom Kombi" SWORD Def_km_sw_q10 0 0 -327680.0000 327670.0000 ECU_ADDRESS 0x7FC1BE /begin FUNCTION_LIST LAYER /end FUNCTION_LIST /end MEASUREMENT
/begin MEASUREMENT Bosrw2 "Prognose_Intervall_Weg_BOS_Meldung_2" UBYTE Def_km_ub_q1000 0 0 0.0 255000.0000 ECU_ADDRESS 0x7FDE94 /begin FUNCTION_LIST OZBG /end FUNCTION_LIST /end MEASUREMENT
/begin MEASUREMENT Bosrw2r "Prognose_Intervall_Weg_BOS_Rückstellung_2" UBYTE Def_km_ub_q1000 0 0 0.0 255000.0000 ECU_ADDRESS 0x7FD96B /begin FUNCTION_LIST LAYER /end FUNCTION_LIST /end MEASUREMENT
/begin MEASUREMENT Bosrw2t "Prognose_Intervall_Weg vom Tester" UBYTE Def_km_ub_q1000 0 0 0.0 255000.0000 ECU_ADDRESS 0x7FC1C0 /begin FUNCTION_LIST LAYER /end FUNCTION_LIST /end MEASUREMENT
/begin MEASUREMENT Bosstate "Einheit der BOS-Info (km)" UBYTE Def_dez_ub_q1 0 0 0.0 255.0000 ECU_ADDRESS 0x7FDE9E /begin FUNCTION_LIST OZBG /end FUNCTION_LIST /end MEASUREMENT
/begin MEASUREMENT Bosv "Verfügbarkeit vom Kombi" UBYTE Def_dez_ub_q1 0 0 0.0 255.0000 ECU_ADDRESS 0x7FC102 /begin FUNCTION_LIST LAYER /end FUNCTION_LIST /end MEASUREMENT
/begin MEASUREMENT Bsdcontrol "3 Byte Schnittstelle für kt_ibs" UBYTE Def_dez_ub_q1 0 0 0.0 255.0000 ECU_ADDRESS 0x7FC136 /begin FUNCTION_LIST LAYER /end FUNCTION_LIST /end MEASUREMENT
/begin MEASUREMENT Bsddata "3 Byte Schnittstelle kt_ibs" UBYTE Def_dez_ub_q1 0 0 0.0 255.0000 ECU_ADDRESS 0x7FC137 /begin FUNCTION_LIST LAYER /end FUNCTION_LIST /end MEASUREMENT
/begin MEASUREMENT Bsdgencv "Chipversion Generator 1" UBYTE Def_st_ub_q1 0 0 0.0 255.0000 ECU_ADDRESS 0x7FC138 /begin FUNCTION_LIST LAYER /end FUNCTION_LIST /end MEASUREMENT
/begin MEASUREMENT Bsdgencv2 "Chipversion Generatorregler 2" UBYTE Def_st_ub_q1 0 0 0.0 255.0000 ECU_ADDRESS 0x7FC139 /begin FUNCTION_LIST LAYER /end FUNCTION_LIST /end MEASUREMENT
/begin MEASUREMENT Bsdgenregv "Reglerversion Generator 1" UBYTE Def_st_ub_q1 0 0 0.0 255.0000 ECU_ADDRESS 0x7FC13A /begin FUNCTION_LIST LAYER /end FUNCTION_LIST /end MEASUREMENT
/begin MEASUREMENT Bsdgenregv2 "Reglerversion Generator 2" UBYTE Def_st_ub_q1 0 0 0.0 255.0000 ECU_ADDRESS 0x7FC13B /begin FUNCTION_LIST LAYER /end FUNCTION_LIST /end MEASUREMENT
/begin MEASUREMENT Bsdregadr "3 Byte Schnittstelle für kt_ibs" UBYTE Def_dez_ub_q1 0 0 0.0 255.0000 ECU_ADDRESS 0x7FC13C /begin FUNCTION_LIST LAYER /end FUNCTION_LIST /end MEASUREMENT
/begin MEASUREMENT Chk16_ibs "Checksumme Parameter aus IBS" UWORD Def_dez_uw_q1 0 0 0.0 65535.0000 ECU_ADDRESS 0x7FD8F0 /begin FUNCTION_LIST KT_IBS /end FUNCTION_LIST /end MEASUREMENT
/begin MEASUREMENT Chkpara "Checksumme Parameter intern" UWORD Def_dez_uw_q1 0 0 0.0 65535.0000 ECU_ADDRESS 0x7FD8F2 /begin FUNCTION_LIST KT_IBS /end FUNCTION_LIST /end MEASUREMENT
/begin MEASUREMENT Comcontrol "Kontrolle Diagnose Modul DIBS" UBYTE Def_dez_ub_q1 0 0 0.0 255.0000 ECU_ADDRESS 0x7FD911 /begin FUNCTION_LIST KT_IBS /end FUNCTION_LIST /end MEASUREMENT
/begin MEASUREMENT Dffgen "ss_msv.dat" UBYTE Def_f_ub_b100 0 0 0.0 99.6093 ECU_ADDRESS 0x7FD9AF /begin FUNCTION_LIST LDSTGEN /end FUNCTION_LIST /end MEASUREMENT
/begin MEASUREMENT Dfgrob "Grobwert Auslastungsgrad Generator 1" UBYTE Def_st_ub_q1 0 0 0.0 255.0000 ECU_ADDRESS 0x7FC13D /begin FUNCTION_LIST LAYER /end FUNCTION_LIST /end MEASUREMENT
/begin MEASUREMENT Dfgrob2 "Grobwert Auslastungsgrad Generator 2" UBYTE Def_st_ub_q1 0 0 0.0 255.0000 ECU_ADDRESS 0x7FC13E /begin FUNCTION_LIST LAYER /end FUNCTION_LIST /end MEASUREMENT
/begin MEASUREMENT Dfmonitor "DF-Monitor für FASTA" UBYTE Def_f_ub_b100 0 0 0.0 99.6093 ECU_ADDRESS 0x7FD9A8 /begin FUNCTION_LIST LDSTGEN /end FUNCTION_LIST /end MEASUREMENT
/begin MEASUREMENT Dfpropval "" UWORD Def_f_uw_b32 0 0 0.0 31.9995 ECU_ADDRESS 0x7FD9AC /begin FUNCTION_LIST LDSTGEN /end FUNCTION_LIST /end MEASUREMENT
/begin MEASUREMENT Dfsiggen "Auslastungsgrad Generator 1" UBYTE Def_f_ub_b100 0 0 0.0 99.6093 ECU_ADDRESS 0x7FC13F /begin FUNCTION_LIST LAYER /end FUNCTION_LIST /end MEASUREMENT
/begin MEASUREMENT Dfsiggen2 "Auslastungsgrad Generator 2" UBYTE Def_f_ub_b100 0 0 0.0 99.6093 ECU_ADDRESS 0x7FC140 /begin FUNCTION_LIST LAYER /end FUNCTION_LIST /end MEASUREMENT
/begin MEASUREMENT Dfsumme "DFMonitor Summe FASTA" FLOAT32_IEEE Def_f_r32 0 0 1.0000 340282346638528860000000000000000000000.0 ECU_ADDRESS 0x7FD9A0 /begin FUNCTION_LIST LDSTGEN /end FUNCTION_LIST /end MEASUREMENT
/begin MEASUREMENT Dfwanzahl "DF-Wertezähler" FLOAT32_IEEE Def_f_r32 0 0 1.0000 340282346638528860000000000000000000000.0 ECU_ADDRESS 0x7FD9A4 /begin FUNCTION_LIST LDSTGEN /end FUNCTION_LIST /end MEASUREMENT
/begin MEASUREMENT Dmd_gen "Maximaler Momentenanstieg Motor für Generator" SWORD Def_dm_sw_q0p1 0 0 -3276.8000 3276.7000 ECU_ADDRESS 0x7FC142 /begin FUNCTION_LIST LAYER /end FUNCTION_LIST /end MEASUREMENT
/begin MEASUREMENT Ebsd_adr "EBSD Adresse im IBS" UBYTE Def_dez_ub_q1 0 0 0.0 255.0000 ECU_ADDRESS 0x7FD925 /begin FUNCTION_LIST KT_IBS /end FUNCTION_LIST /end MEASUREMENT
/begin MEASUREMENT Ebsd_errdir "EBSD Übertragungsrichtung bei Fehler" UBYTE Def_dez_ub_q1 0 0 0.0 255.0000 ECU_ADDRESS 0x7FD926 /begin FUNCTION_LIST KT_IBS /end FUNCTION_LIST /end MEASUREMENT
/begin MEASUREMENT Ebsd_errep "EBSD Fehler repeat timer" UBYTE Def_dez_ub_q1 0 0 0.0 255.0000 ECU_ADDRESS 0x7FD928 /begin FUNCTION_LIST KT_IBS /end FUNCTION_LIST /end MEASUREMENT
/begin MEASUREMENT Ebsd_errin "EBSD Index bei Fehler" UBYTE Def_dez_ub_q1 0 0 0.0 255.0000 ECU_ADDRESS 0x7FD927 /begin FUNCTION_LIST KT_IBS /end FUNCTION_LIST /end MEASUREMENT
/begin MEASUREMENT Ebsd_nbyt "Länge EBSD Variable" UBYTE Def_dez_ub_q1 0 0 0.0 255.0000 ECU_ADDRESS 0x7FD923 /begin FUNCTION_LIST KT_IBS /end FUNCTION_LIST /end MEASUREMENT
/begin MEASUREMENT Ebsd_timo "EBSD Fehler timeout counter" UBYTE Def_dez_ub_q1 0 0 0.0 255.0000 ECU_ADDRESS 0x7FD929 /begin FUNCTION_LIST KT_IBS /end FUNCTION_LIST /end MEASUREMENT
/begin MEASUREMENT Ebsd_varin "Index EBSD Variable" UBYTE Def_dez_ub_q1 0 0 0.0 255.0000 ECU_ADDRESS 0x7FD922 /begin FUNCTION_LIST KT_IBS /end FUNCTION_LIST /end MEASUREMENT
/begin MEASUREMENT F_hydr "Fehler Hydraulikpfadpfad relativ" ULONG Def_f_ul_b262144 0 0 0.0 196596.0001 ECU_ADDRESS 0x7FDB04 /begin FUNCTION_LIST MANDETEK /end FUNCTION_LIST /end MEASUREMENT
/begin MEASUREMENT F_hydra "Fehler Hydraulikpfadpfad absolut" ULONG Def_f_ul_b262144 0 0 0.0 11.9998 ECU_ADDRESS 0x7FDB08 /begin FUNCTION_LIST MANDETEK /end FUNCTION_LIST /end MEASUREMENT
/begin MEASUREMENT F_luft "Fehler Luftpfadpfad relativ" ULONG Def_f_ul_b262144 0 0 0.0 262128.0002 ECU_ADDRESS 0x7FDB0C /begin FUNCTION_LIST MANDETEK /end FUNCTION_LIST /end MEASUREMENT
/begin MEASUREMENT F_lufta "Fehler Luftpfad absolut" ULONG Def_f_ul_b262144 0 0 0.0 15.9997 ECU_ADDRESS 0x7FDB10 /begin FUNCTION_LIST MANDETEK /end FUNCTION_LIST /end MEASUREMENT
/begin MEASUREMENT Fahrzeug "Fahrzeugtypbezeichnung (E60 = 60, E65 = 65, E46 = 46)" UBYTE Def_dez_ub_q1 0 0 0.0 255.0000 ECU_ADDRESS 0x7FC144 /begin FUNCTION_LIST LAYER /end FUNCTION_LIST /end MEASUREMENT
/begin MEASUREMENT Fdib_ig "" SWORD Def_i_sw_q1 0 0 -32768.0000 32767.0000 ECU_ADDRESS 0x7FD876 /begin FUNCTION_LIST IMDGEN_1PR /end FUNCTION_LIST /end MEASUREMENT
/begin MEASUREMENT Fho "Korrekturfaktor Höhe" UWORD Def_f_uw_b2 0 0 0.0 1.9999 ECU_ADDRESS 0x7FC146 /begin FUNCTION_LIST LAYER /end FUNCTION_LIST /end MEASUREMENT
/begin MEASUREMENT Fhydr_temp1 "rel. Fehler Hydraulikpfad temporär 1" ULONG Def_f_ul_b262144 0 0 0.0 65532.0000 ECU_ADDRESS 0x7FDB14 /begin FUNCTION_LIST MANDETEK /end FUNCTION_LIST /end MEASUREMENT
/begin MEASUREMENT Fhydr_temp2 "rel. Fehler Hydraulikpfad temporär 2" ULONG Def_f_ul_b262144 0 0 0.0 65532.0000 ECU_ADDRESS 0x7FDB18 /begin FUNCTION_LIST MANDETEK /end FUNCTION_LIST /end MEASUREMENT
/begin MEASUREMENT Fhydr_temp3 "rel. Fehler Hydraulikpfad temporär 3" ULONG Def_f_ul_b262144 0 0 0.0 65532.0000 ECU_ADDRESS 0x7FDB1C /begin FUNCTION_LIST MANDETEK /end FUNCTION_LIST /end MEASUREMENT
/begin MEASUREMENT Fid_manhydr "Funktionsidentifier Mandetek Hydraulikpfad" UBYTE Def_dez_ub_q1 0 0 0.0 255.0000 ECU_ADDRESS 0x7FC1D5 /begin FUNCTION_LIST LAYER /end FUNCTION_LIST /end MEASUREMENT
/begin MEASUREMENT Fid_manluft "Funktionsidentifier Mandetek Luftpfad" UBYTE Def_dez_ub_q1 0 0 0.0 255.0000 ECU_ADDRESS 0x7FC1D4 /begin FUNCTION_LIST LAYER /end FUNCTION_LIST /end MEASUREMENT
/begin MEASUREMENT Fluft_temp1 "rel. Fehler Luftpfad temporär 1" ULONG Def_f_ul_b262144 0 0 0.0 65532.0000 ECU_ADDRESS 0x7FDB20 /begin FUNCTION_LIST MANDETEK /end FUNCTION_LIST /end MEASUREMENT
/begin MEASUREMENT Fluft_temp2 "rel. Fehler Luftpfad temporär 2" ULONG Def_f_ul_b262144 0 0 0.0 65532.0000 ECU_ADDRESS 0x7FDB24 /begin FUNCTION_LIST MANDETEK /end FUNCTION_LIST /end MEASUREMENT
/begin MEASUREMENT Fluft_temp3 "rel. Fehler Luftpfad temporär 3" ULONG Def_f_ul_b262144 0 0 0.0 65532.0000 ECU_ADDRESS 0x7FDB28 /begin FUNCTION_LIST MANDETEK /end FUNCTION_LIST /end MEASUREMENT
/begin MEASUREMENT Fluft_temp4 "rel. Fehler Luftpfad temporär 4" ULONG Def_f_ul_b262144 0 0 0.0 65532.0000 ECU_ADDRESS 0x7FDB2C /begin FUNCTION_LIST MANDETEK /end FUNCTION_LIST /end MEASUREMENT
/begin MEASUREMENT Fsclctr "Hilfszaehler IBS Fehler loeschen" UBYTE Def_dez_ub_q1 0 0 0.0 255.0000 ECU_ADDRESS 0x7FD92B /begin FUNCTION_LIST KT_IBS /end FUNCTION_LIST /end MEASUREMENT
/begin MEASUREMENT Gangi "Aktueller Gang intern" UBYTE Def_dez_ub_q1 0 0 0.0 255.0000 ECU_ADDRESS 0x7FC103 /begin FUNCTION_LIST LAYER /end FUNCTION_LIST /end MEASUREMENT
/begin MEASUREMENT Gen_awnumm "Generatorkennfeldnummer" UBYTE Def_st_ub_q1 0 0 0.0 255.0000 ECU_ADDRESS 0x7FD86C /begin FUNCTION_LIST IMDGEN_1PR /end FUNCTION_LIST /end MEASUREMENT
/begin MEASUREMENT Gen_dts "Temperaturerhoehung im Generatorstator" SWORD Def_t_sw_q0p1 0 0 -3276.8000 3276.7000 ECU_ADDRESS 0x7FD878 /begin FUNCTION_LIST IMDGEN_1PR /end FUNCTION_LIST /end MEASUREMENT
/begin MEASUREMENT Gen_feta "Generatorwirkungsgrad Berechnnugsterm" ULONG Def_eta_ul_b8192 0 0 1.9073486328125e-6 5000.0000 ECU_ADDRESS 0x7FD8A0 /begin FUNCTION_LIST IMDGEN_1PR /end FUNCTION_LIST /end MEASUREMENT
/begin MEASUREMENT Gen_i_kaltun "DF korrektiert ueber Generatordrehzahl" UBYTE Def_i_ub_q1 0 0 0.0 255.0000 ECU_ADDRESS 0x7FD8AD /begin FUNCTION_LIST IMDGEN_1PR /end FUNCTION_LIST /end MEASUREMENT
/begin MEASUREMENT Gen_manufak "Herstellercode Generator 1" UBYTE Def_st_ub_q1 0 0 0.0 255.0000 ECU_ADDRESS 0x7FC148 /begin FUNCTION_LIST LAYER /end FUNCTION_LIST /end MEASUREMENT
/begin MEASUREMENT Gen_manufak2 "Herstellercode Generator 2" UBYTE Def_st_ub_q1 0 0 0.0 255.0000 ECU_ADDRESS 0x7FC149 /begin FUNCTION_LIST LAYER /end FUNCTION_LIST /end MEASUREMENT
/begin MEASUREMENT Gen_nummer "Erkannte Generatornummer" UBYTE Def_st_ub_q1 0 0 0.0 255.0000 ECU_ADDRESS 0x7FD8AE /begin FUNCTION_LIST IMDGEN_1PR /end FUNCTION_LIST /end MEASUREMENT
/begin MEASUREMENT Gen_rs "Statorwiderstand" UWORD Def_f_uw_b1 0 0 0.0 9.99984741210938e-1 ECU_ADDRESS 0x7FD88E /begin FUNCTION_LIST IMDGEN_1PR /end FUNCTION_LIST /end MEASUREMENT
/begin MEASUREMENT Gen_spv "Generatorstatorverlustleistung" UWORD Def_f_uw_b2048 0 0 0.0 2047.9687 ECU_ADDRESS 0x7FD890 /begin FUNCTION_LIST IMDGEN_1PR /end FUNCTION_LIST /end MEASUREMENT
/begin MEASUREMENT Gen_sttemp "Generatorstarttemperatur" SWORD Def_t_sw_q0p1 0 0 -3276.8000 3276.7000 ECU_ADDRESS 0x7FD87A /begin FUNCTION_LIST IMDGEN_1PR /end FUNCTION_LIST /end MEASUREMENT
/begin MEASUREMENT Gen_tans "Generatoransauglufttemperatur" SWORD Def_t_sw_q0p1 0 0 -3276.8000 3276.7000 ECU_ADDRESS 0x7FD87C /begin FUNCTION_LIST IMDGEN_1PR /end FUNCTION_LIST /end MEASUREMENT
/begin MEASUREMENT Gen_tansend "Generatoransaugluftendwert" SWORD Def_t_sw_q0p1 0 0 -3276.8000 3276.7000 ECU_ADDRESS 0x7FD87E /begin FUNCTION_LIST IMDGEN_1PR /end FUNCTION_LIST /end MEASUREMENT
/begin MEASUREMENT Gen_teta "Wirkungsgrad Generator W*PI temperaturkompensiert" UWORD Def_f_uw_b32 0 0 0.0 31.9995 ECU_ADDRESS 0x7FD892 /begin FUNCTION_LIST IMDGEN_1PR /end FUNCTION_LIST /end MEASUREMENT
/begin MEASUREMENT Gen_typkenn "Kennung Generatortyp Gen 1" UBYTE Def_st_ub_q1 0 0 0.0 255.0000 ECU_ADDRESS 0x7FC14A /begin FUNCTION_LIST LAYER /end FUNCTION_LIST /end MEASUREMENT
/begin MEASUREMENT Gen_typkenn2 "Kennung Generatortyp Gen 2" UBYTE Def_st_ub_q1 0 0 0.0 255.0000 ECU_ADDRESS 0x7FC14B /begin FUNCTION_LIST LAYER /end FUNCTION_LIST /end MEASUREMENT
/begin MEASUREMENT Gen_weta "Wirkungsgrad Generator mit Omega*PI" UWORD Def_f_uw_b32 0 0 0.0 31.9995 ECU_ADDRESS 0x7FD894 /begin FUNCTION_LIST IMDGEN_1PR /end FUNCTION_LIST /end MEASUREMENT
/begin MEASUREMENT Gewh "Gewicht Hydraulikpfad" UBYTE Def_dez_ub_q1 0 0 0.0 255.0000 ECU_ADDRESS 0x7FDB30 /begin FUNCTION_LIST MANDETEK /end FUNCTION_LIST /end MEASUREMENT
/begin MEASUREMENT Gewl "Gewicht Luftpfad" UBYTE Def_dez_ub_q1 0 0 0.0 255.0000 ECU_ADDRESS 0x7FDB31 /begin FUNCTION_LIST MANDETEK /end FUNCTION_LIST /end MEASUREMENT
/begin MEASUREMENT Ghydrla "Gewicht Hydraulikpfad La_ist1" UBYTE Def_f_ub_b2 0 0 0.0079 1.9921 ECU_ADDRESS 0x7FDB34 ARRAY_SIZE 120 /begin FUNCTION_LIST MANDETEK /end FUNCTION_LIST /end MEASUREMENT
/begin MEASUREMENT Ghydrme "Gewicht Hydraulikpfad Me_ist" UBYTE Def_f_ub_b2 0 0 0.0079 1.9921 ECU_ADDRESS 0x7FDBAC ARRAY_SIZE 120 /begin FUNCTION_LIST MANDETEK /end FUNCTION_LIST /end MEASUREMENT
/begin MEASUREMENT Ghydrml "Gewicht Hydraulikpfad Ml" UBYTE Def_f_ub_b2 0 0 0.0079 1.9921 ECU_ADDRESS 0x7FDC24 ARRAY_SIZE 120 /begin FUNCTION_LIST MANDETEK /end FUNCTION_LIST /end MEASUREMENT
/begin MEASUREMENT Gluftml "Gewicht Luftpfad Ml" UBYTE Def_f_ub_b2 0 0 0.0079 1.9921 ECU_ADDRESS 0x7FDC9C ARRAY_SIZE 120 /begin FUNCTION_LIST MANDETEK /end FUNCTION_LIST /end MEASUREMENT
/begin MEASUREMENT Gluftpld "Gewicht Luftpfad Pld" UBYTE Def_f_ub_b2 0 0 0.0079 1.9921 ECU_ADDRESS 0x7FDD14 ARRAY_SIZE 120 /begin FUNCTION_LIST MANDETEK /end FUNCTION_LIST /end MEASUREMENT
/begin MEASUREMENT Glufttvagr "Gewicht Luftpfad Tastverhältnis Agr" UBYTE Def_f_ub_b2 0 0 0.0079 1.9921 ECU_ADDRESS 0x7FDD8C ARRAY_SIZE 120 /begin FUNCTION_LIST MANDETEK /end FUNCTION_LIST /end MEASUREMENT
/begin MEASUREMENT Glufttvpld "Gewicht Luftpfad Tastverhältnis Pld" UBYTE Def_f_ub_b2 0 0 0.0079 1.9921 ECU_ADDRESS 0x7FDE04 ARRAY_SIZE 120 /begin FUNCTION_LIST MANDETEK /end FUNCTION_LIST /end MEASUREMENT
/begin MEASUREMENT Hydrstat "Zähler für quasistationären Zustand Hydraulikpfad" UBYTE Def_dez_ub_q1 0 0 0.0 255.0000 ECU_ADDRESS 0x7FDE7C /begin FUNCTION_LIST MANDETEK /end FUNCTION_LIST /end MEASUREMENT
/begin MEASUREMENT I_basis "Basis Strombedarf FZG mit SLP" UBYTE Def_i_ub_q1 0 0 0.0 255.0000 ECU_ADDRESS 0x7FD8AF /begin FUNCTION_LIST IMDGEN_1PR /end FUNCTION_LIST /end MEASUREMENT
/begin MEASUREMENT I_batt "Batteriestrom von IBS gemessen" UWORD Def_i_uw_q0p08_o200 0 0 -200.0000 5042.8000 ECU_ADDRESS 0x7FD8B6 /begin FUNCTION_LIST KT_IBS /end FUNCTION_LIST /end MEASUREMENT
/begin MEASUREMENT I_gen "Generatorstrom" UBYTE Def_i_ub_q1 0 0 0.0 255.0000 ECU_ADDRESS 0x7FD8AA /begin FUNCTION_LIST IMDGEN_1PR /end FUNCTION_LIST /end MEASUREMENT
/begin MEASUREMENT I_gen_end "Generatorstrom gemessen / gerechnet" UBYTE Def_i_ub_q1 0 0 0.0 254.0000 ECU_ADDRESS 0x7FD8B0 /begin FUNCTION_LIST IMDGEN_1PR /end FUNCTION_LIST /end MEASUREMENT
/begin MEASUREMENT I_gen_g "Generatorstrom gesamt" UBYTE Def_i_ub_q1 0 0 0.0 255.0000 ECU_ADDRESS 0x7FD8B1 /begin FUNCTION_LIST IMDGEN_1PR /end FUNCTION_LIST /end MEASUREMENT
/begin MEASUREMENT I_gen_nafil "Generatorstrom nach Filter" UWORD Def_i_uw_q0p03125 0 0 0.0 256.0000 ECU_ADDRESS 0x7FD896 /begin FUNCTION_LIST IMDGEN_1PR /end FUNCTION_LIST /end MEASUREMENT
/begin MEASUREMENT I_gen_vorfil "Generatorstrom vor Filter" UWORD Def_i_uw_q0p03125 0 0 0.0 256.0000 ECU_ADDRESS 0x7FD898 /begin FUNCTION_LIST IMDGEN_1PR /end FUNCTION_LIST /end MEASUREMENT
/begin MEASUREMENT I_genmax "korrigiertes DF Signal ueber Temperatur, Generatordrehzahl, Generatorspannung" UBYTE Def_i_ub_q1 0 0 0.0 255.0000 ECU_ADDRESS 0x7FD8AB /begin FUNCTION_LIST IMDGEN_1PR /end FUNCTION_LIST /end MEASUREMENT
/begin MEASUREMENT I_gm "Generatormischstrom" UBYTE Def_i_ub_q1 0 0 0.0 255.0000 ECU_ADDRESS 0x7FD8B2 /begin FUNCTION_LIST IMDGEN_1PR /end FUNCTION_LIST /end MEASUREMENT
/begin MEASUREMENT I_gvor "Stromwert nach Überblendung" UBYTE Def_i_ub_q1 0 0 0.0 255.0000 ECU_ADDRESS 0x7FD8B3 /begin FUNCTION_LIST IMDGEN_1PR /end FUNCTION_LIST /end MEASUREMENT
/begin MEASUREMENT I_pregelv "Strom Raildruckregelventil" SWORD Def_i_sw_q0039 0 0 -128.0000 127.9960 ECU_ADDRESS 0x7FC132 /begin FUNCTION_LIST LAYER /end FUNCTION_LIST /end MEASUREMENT
/begin MEASUREMENT I_soc0 "Strom bei Ruhespannungsmessung" SWORD Def_i_sw_q0p02 0 0 -655.3600 655.3400 ECU_ADDRESS 0x7FD8C6 /begin FUNCTION_LIST KT_IBS /end FUNCTION_LIST /end MEASUREMENT
/begin MEASUREMENT I_tnstart "Batteriestrom im Start" UWORD Def_i_uw_q0p02 0 0 0.0 1310.7000 ECU_ADDRESS 0x7FD8DA /begin FUNCTION_LIST KT_IBS /end FUNCTION_LIST /end MEASUREMENT
/begin MEASUREMENT I_vorstart "Batteriestrom vor Start" UWORD Def_i_uw_q0p02_o200 0 0 -200.0000 1110.7000 ECU_ADDRESS 0x7FD8D8 /begin FUNCTION_LIST KT_IBS /end FUNCTION_LIST /end MEASUREMENT
/begin MEASUREMENT I_zme "Strom Zumeßeinheit" SWORD Def_i_sw_q0039 0 0 -128.0000 127.9960 ECU_ADDRESS 0x7FC130 /begin FUNCTION_LIST LAYER /end FUNCTION_LIST /end MEASUREMENT
/begin MEASUREMENT Ib_chk16 "Checksumme EBSD Übertragung aus IBS" UWORD Def_dez_uw_q1 0 0 0.0 65535.0000 ECU_ADDRESS 0x7FD8EE /begin FUNCTION_LIST KT_IBS /end FUNCTION_LIST /end MEASUREMENT
/begin MEASUREMENT Ib_parlen "Länge IBS Parameterliste" UBYTE Def_dez_ub_q1 0 0 0.0 255.0000 ECU_ADDRESS 0x7FD918 /begin FUNCTION_LIST KT_IBS /end FUNCTION_LIST /end MEASUREMENT
/begin MEASUREMENT Ibhwversi "IBS Hardware Version" UBYTE Def_dez_ub_q1 0 0 0.0 255.0000 ECU_ADDRESS 0x7FD917 /begin FUNCTION_LIST KT_IBS /end FUNCTION_LIST /end MEASUREMENT
/begin MEASUREMENT Ibs_errors "Fehler Reg. aus IBS gelesen" UBYTE Def_dez_ub_q1 0 0 0.0 255.0000 ECU_ADDRESS 0x7FD90C /begin FUNCTION_LIST KT_IBS /end FUNCTION_LIST /end MEASUREMENT
/begin MEASUREMENT Ibs_msgind "Index auf EBSD Botschaft" UBYTE Def_dez_ub_q1 0 0 0.0 255.0000 ECU_ADDRESS 0x7FD90D /begin FUNCTION_LIST KT_IBS /end FUNCTION_LIST /end MEASUREMENT
/begin MEASUREMENT Ibs_msgsta "EBSD Fehler Status" UBYTE Def_dez_ub_q1 0 0 0.0 255.0000 ECU_ADDRESS 0x7FD90E /begin FUNCTION_LIST KT_IBS /end FUNCTION_LIST /end MEASUREMENT
/begin MEASUREMENT Ibs_reg5 "IBS Register 5 Var.not used: now St_ibsreg5" UBYTE Def_dez_ub_q1 0 0 0.0 255.0000 ECU_ADDRESS 0x7FD90B /begin FUNCTION_LIST KT_IBS /end FUNCTION_LIST /end MEASUREMENT
/begin MEASUREMENT Ibs_start "Status Statemachine Startup Kommunikation" UBYTE Def_dez_ub_q1 0 0 0.0 255.0000 ECU_ADDRESS 0x7FD910 /begin FUNCTION_LIST KT_IBS /end FUNCTION_LIST /end MEASUREMENT
/begin MEASUREMENT Ibsbclctri "IBS Fehlerzähler" UBYTE Def_dez_ub_q1 0 0 0.0 255.0000 ECU_ADDRESS 0x7FD91A /begin FUNCTION_LIST KT_IBS /end FUNCTION_LIST /end MEASUREMENT
/begin MEASUREMENT Ibsborctr "IBS Fehlerzähler" UWORD Def_dez_uw_q1 0 0 0.0 65535.0000 ECU_ADDRESS 0x7FD8BA /begin FUNCTION_LIST KT_IBS /end FUNCTION_LIST /end MEASUREMENT
/begin MEASUREMENT Ibsdncsctr "IBS Fehlerzähler download checksum" UBYTE Def_dez_ub_q1 0 0 0.0 255.0000 ECU_ADDRESS 0x7FD91E /begin FUNCTION_LIST KT_IBS /end FUNCTION_LIST /end MEASUREMENT
/begin MEASUREMENT Ibseromctr "IBS Fehlerzähler" UBYTE Def_dez_ub_q1 0 0 0.0 255.0000 ECU_ADDRESS 0x7FD91B /begin FUNCTION_LIST KT_IBS /end FUNCTION_LIST /end MEASUREMENT
/begin MEASUREMENT Ibsiicctri "IBS Fehlerzähler" UBYTE Def_dez_ub_q1 0 0 0.0 255.0000 ECU_ADDRESS 0x7FD919 /begin FUNCTION_LIST KT_IBS /end FUNCTION_LIST /end MEASUREMENT
/begin MEASUREMENT Ibslvdctr "IBS Fehlerzähler" UWORD Def_dez_uw_q1 0 0 0.0 65535.0000 ECU_ADDRESS 0x7FD8B4 /begin FUNCTION_LIST KT_IBS /end FUNCTION_LIST /end MEASUREMENT
/begin MEASUREMENT Ibsporctr "IBS Fehlerzähler power on" UWORD Def_dez_uw_q1 0 0 0.0 65535.0000 ECU_ADDRESS 0x7FD8BE /begin FUNCTION_LIST KT_IBS /end FUNCTION_LIST /end MEASUREMENT
/begin MEASUREMENT Ibspromctr "IBS Fehlerzähler" UBYTE Def_dez_ub_q1 0 0 0.0 255.0000 ECU_ADDRESS 0x7FD91D /begin FUNCTION_LIST KT_IBS /end FUNCTION_LIST /end MEASUREMENT
/begin MEASUREMENT Ibsptyctr "IBS Fehlerzähler BSD parity" UWORD Def_dez_uw_q1 0 0 0.0 65535.0000 ECU_ADDRESS 0x7FD8C0 /begin FUNCTION_LIST KT_IBS /end FUNCTION_LIST /end MEASUREMENT
/begin MEASUREMENT Ibsramctr "IBS Fehlerzähler" UBYTE Def_dez_ub_q1 0 0 0.0 255.0000 ECU_ADDRESS 0x7FD91C /begin FUNCTION_LIST KT_IBS /end FUNCTION_LIST /end MEASUREMENT
/begin MEASUREMENT Ibswbase "IBS Software Baseline" UBYTE Def_dez_ub_q1 0 0 0.0 255.0000 ECU_ADDRESS 0x7FD915 /begin FUNCTION_LIST KT_IBS /end FUNCTION_LIST /end MEASUREMENT
/begin MEASUREMENT Ibswchang "IBS Software Änderungs Status" UBYTE Def_dez_ub_q1 0 0 0.0 255.0000 ECU_ADDRESS 0x7FD916 /begin FUNCTION_LIST KT_IBS /end FUNCTION_LIST /end MEASUREMENT
/begin MEASUREMENT Ibswdtctr "IBS Fehlerzähler watchdog" UWORD Def_dez_uw_q1 0 0 0.0 65535.0000 ECU_ADDRESS 0x7FD8BC /begin FUNCTION_LIST KT_IBS /end FUNCTION_LIST /end MEASUREMENT
/begin MEASUREMENT Id_bosmg "Kennung für BOS-Meldung = Ölservice-Info" UWORD Def_dez_uw_q1 0 0 0.0 65535.0000 ECU_ADDRESS 0x7FDE9C /begin FUNCTION_LIST OZBG /end FUNCTION_LIST /end MEASUREMENT
/begin MEASUREMENT Id_bosmgt "Kennung für BOS-Meldung vom Tester" UBYTE Def_dez_ub_q1 0 0 0.0 255.0000 ECU_ADDRESS 0x7FDE9F /begin FUNCTION_LIST OZBG /end FUNCTION_LIST /end MEASUREMENT
/begin MEASUREMENT Id_bosmsg "Kennung für BOS-Meldung vom Kombi" UBYTE Def_dez_ub_q1 0 0 0.0 255.0000 ECU_ADDRESS 0x7FDEA0 /begin FUNCTION_LIST OZBG /end FUNCTION_LIST /end MEASUREMENT
/begin MEASUREMENT Id_bosrst "ID für BOS-Reset vom Kombi" UBYTE Def_dez_ub_q1 0 0 0.0 255.0000 ECU_ADDRESS 0x7FC104 /begin FUNCTION_LIST LAYER /end FUNCTION_LIST /end MEASUREMENT
/begin MEASUREMENT Id_bosrtt "Kennung vom Tester für Ölservice" UBYTE Def_dez_ub_q1 0 0 0.0 255.0000 ECU_ADDRESS 0x7FC0FE /begin FUNCTION_LIST LAYER /end FUNCTION_LIST /end MEASUREMENT
/begin MEASUREMENT Id_bosrtw "ID für Motoröl vom Kombi" UWORD Def_dez_uw_q1 0 0 0.0 65535.0000 ECU_ADDRESS 0x7FC106 /begin FUNCTION_LIST LAYER /end FUNCTION_LIST /end MEASUREMENT
/begin MEASUREMENT Ierr "Erregerstrom Generator1" UBYTE Def_i_ub_q0p125 0 0 0.0 31.8750 ECU_ADDRESS 0x7FC14C /begin FUNCTION_LIST LAYER /end FUNCTION_LIST /end MEASUREMENT
/begin MEASUREMENT Ierr2 "Erregerstrom Generator 2" UBYTE Def_i_ub_q0p125 0 0 0.0 31.8750 ECU_ADDRESS 0x7FC14D /begin FUNCTION_LIST LAYER /end FUNCTION_LIST /end MEASUREMENT
/begin MEASUREMENT Ierr_fil "Gefilterter Erregerstrom" UBYTE Def_i_ub_q0p125 0 0 0.0 31.8750 ECU_ADDRESS 0x7FD9AE /begin FUNCTION_LIST LDSTGEN /end FUNCTION_LIST /end MEASUREMENT
/begin MEASUREMENT Ierrfgrenz "Kopie begrenzter Erregerstrom Generator 1" UBYTE Def_i_ub_q0p125 0 0 0.0 31.8750 ECU_ADDRESS 0x7FC14E /begin FUNCTION_LIST LAYER /end FUNCTION_LIST /end MEASUREMENT
/begin MEASUREMENT Ierrfgrenz2 "Kopie begrenzter Erregerstrom Generator 2" UBYTE Def_i_ub_q0p125 0 0 0.0 31.8750 ECU_ADDRESS 0x7FC14F /begin FUNCTION_LIST LAYER /end FUNCTION_LIST /end MEASUREMENT
/begin MEASUREMENT Ierrgrenz "Grenzertrregerstrom" UBYTE Def_i_ub_q0p125 0 0 0.0 31.8750 ECU_ADDRESS 0x7FD8AC /begin FUNCTION_LIST IMDGEN_1PR /end FUNCTION_LIST /end MEASUREMENT
/begin MEASUREMENT Ierrgrenz2 "Grenzertrregerstrom" UBYTE Def_i_ub_q0p125 0 0 0.0 31.8750 ECU_ADDRESS 0x7FC150 /begin FUNCTION_LIST LAYER /end FUNCTION_LIST /end MEASUREMENT
/begin MEASUREMENT Ikurz_ogr "Obere Grenze Kurzschlussstrom vom CAS" UBYTE Def_i_ub_q10 0 0 0.0 2550.0000 ECU_ADDRESS 0x7FD94D /begin FUNCTION_LIST LAYER /end FUNCTION_LIST /end MEASUREMENT
/begin MEASUREMENT Ikurz_ugr "Untere Grenze Kurzschlussstrom vom CAS" UBYTE Def_i_ub_q10 0 0 0.0 2550.0000 ECU_ADDRESS 0x7FD94E /begin FUNCTION_LIST LAYER /end FUNCTION_LIST /end MEASUREMENT
/begin MEASUREMENT Ivvtmot_mw " " SWORD Def_i_sw_q0p0625 0 0 -2048.0000 2047.9375 ECU_ADDRESS 0x7FC152 ARRAY_SIZE 6 /begin FUNCTION_LIST LAYER /end FUNCTION_LIST /end MEASUREMENT
/begin MEASUREMENT Ivvtmot_mw2 " " SWORD Def_i_sw_q0p0625 0 0 -2048.0000 2047.9375 ECU_ADDRESS 0x7FC15E ARRAY_SIZE 6 /begin FUNCTION_LIST LAYER /end FUNCTION_LIST /end MEASUREMENT
/begin MEASUREMENT Iwakeupgr "Fahrzeugspezifischer Ruhestrom" UBYTE Def_i_ub_q0p001 0 0 0.0 0.2550 ECU_ADDRESS 0x7FD94F /begin FUNCTION_LIST LAYER /end FUNCTION_LIST /end MEASUREMENT
/begin MEASUREMENT Km_st "Kilometerstand" UWORD Def_km_uw_q10 0 0 0.0 655350.0000 ECU_ADDRESS 0x7FC16A /begin FUNCTION_LIST LAYER /end FUNCTION_LIST /end MEASUREMENT
/begin MEASUREMENT Km_st_1 "Wegstrecke_km auf 1km genau" ULONG Def_dez_ul_q1 0 0 0.0 2147483647.0000 ECU_ADDRESS 0x7FD96C /begin FUNCTION_LIST LAYER /end FUNCTION_LIST /end MEASUREMENT
/begin MEASUREMENT Kt_ibsstatus "Status BSD Statemachine" UBYTE Def_dez_ub_q1 0 0 0.0 255.0000 ECU_ADDRESS 0x7FD90F /begin FUNCTION_LIST KT_IBS /end FUNCTION_LIST /end MEASUREMENT
/begin MEASUREMENT Ktib_chk16 "Checksumme EBSD Übertragung intern" UWORD Def_dez_uw_q1 0 0 0.0 65535.0000 ECU_ADDRESS 0x7FD8EC /begin FUNCTION_LIST KT_IBS /end FUNCTION_LIST /end MEASUREMENT
/begin MEASUREMENT Ktupcsctr "kt_ibs Fehlerzähler EBSD Checksumme" UWORD Def_dez_uw_q1 0 0 0.0 65535.0000 ECU_ADDRESS 0x7FD8EA /begin FUNCTION_LIST KT_IBS /end FUNCTION_LIST /end MEASUREMENT
/begin MEASUREMENT Kvaverbr "Kraftstoffverbrauch (Einspritzmenge in Microliter)" UWORD Def_dez_uw_q1 0 0 0.0 65535.0000 ECU_ADDRESS 0x7FC108 /begin FUNCTION_LIST LAYER /end FUNCTION_LIST /end MEASUREMENT
/begin MEASUREMENT L_pwmout "Tastverhältnis E-Lüfter" UBYTE Def_tv_ub_q0p390625 0 0 0.0 99.6093 ECU_ADDRESS 0x7FC16C /begin FUNCTION_LIST LAYER /end FUNCTION_LIST /end MEASUREMENT
/begin MEASUREMENT La_ist1 "Lambdaistwert" UWORD Def_f_uw_b16 0 0 0.0 15.9997 ECU_ADDRESS 0x7FC1CC /begin FUNCTION_LIST LAYER /end FUNCTION_LIST /end MEASUREMENT
/begin MEASUREMENT La_n "Lambdawert normiert" UBYTE Def_f_ub_b2 0 0 0.0 1.9921 ECU_ADDRESS 0x7FDE7D /begin FUNCTION_LIST MANDETEK /end FUNCTION_LIST /end MEASUREMENT
/begin MEASUREMENT Loadresp "" UBYTE Def_td_ub_q0p1 0 0 0.0 25.5000 ECU_ADDRESS 0x7FD9BC /begin FUNCTION_LIST LOADRESP /end FUNCTION_LIST /end MEASUREMENT
/begin MEASUREMENT Luftstat "Zähler für quasistationären Zustand Luftpfad" UBYTE Def_dez_ub_q1 0 0 0.0 255.0000 ECU_ADDRESS 0x7FDE7E /begin FUNCTION_LIST MANDETEK /end FUNCTION_LIST /end MEASUREMENT
/begin MEASUREMENT Md_genfil "gefiltertes Generatormoment absolut" SWORD Def_m_sw_q0p1 0 0 -3276.8000 3276.7000 ECU_ADDRESS 0x7FD880 /begin FUNCTION_LIST IMDGEN_1PR /end FUNCTION_LIST /end MEASUREMENT
/begin MEASUREMENT Md_gennm "gefiltertes Generatormoment absolut Ausgang" SWORD Def_m_sw_q0p1 0 0 -3276.8000 3276.7000 ECU_ADDRESS 0x7FD86E /begin FUNCTION_LIST IMDGEN_1PR /end FUNCTION_LIST /end MEASUREMENT
/begin MEASUREMENT Md_gennmufi "Generatormoment absolut" SWORD Def_m_sw_q0p1 0 0 -3276.8000 3276.7000 ECU_ADDRESS 0x7FD882 /begin FUNCTION_LIST IMDGEN_1PR /end FUNCTION_LIST /end MEASUREMENT
/begin MEASUREMENT Md_genrel "relatives Generatormoment Ausgang" UWORD Def_f_uw_b100 0 0 0.0 99.9984 ECU_ADDRESS 0x7FD89A /begin FUNCTION_LIST IMDGEN_1PR /end FUNCTION_LIST /end MEASUREMENT
/begin MEASUREMENT Md_genvf "relatives Generatordrehmoment" UWORD Def_f_uw_b100 0 0 0.0 99.9984 ECU_ADDRESS 0x7FD874 /begin FUNCTION_LIST IMDGEN_1PR /end FUNCTION_LIST /end MEASUREMENT
/begin MEASUREMENT Md_grenz "Maximalmoment Generator an BSDII" SWORD Def_m_sw_q0p1 0 0 -3276.8000 3276.7000 ECU_ADDRESS 0x7FD9B6 /begin FUNCTION_LIST LOADRESP /end FUNCTION_LIST /end MEASUREMENT
/begin MEASUREMENT Md_mgmax "Maximalmoment Generator" SWORD Def_m_sw_q0p1 0 0 -3276.8000 3276.7000 ECU_ADDRESS 0x7FC12A /begin FUNCTION_LIST LAYER /end FUNCTION_LIST /end MEASUREMENT
/begin MEASUREMENT Me_ist "Einspritzmasse aktuell" SWORD Def_me_sw_q0p01 0 0 -327.6800 327.6700 ECU_ADDRESS 0x7FC1CA /begin FUNCTION_LIST LAYER /end FUNCTION_LIST /end MEASUREMENT
/begin MEASUREMENT Me_n "Einspritzmasse normiert" UBYTE Def_f_ub_b2 0 0 0.0 1.9921 ECU_ADDRESS 0x7FDE7F /begin FUNCTION_LIST MANDETEK /end FUNCTION_LIST /end MEASUREMENT
/begin MEASUREMENT Ml "Luftmasse pro Zylinder" SWORD Def_ml_sw_q0p1 0 0 -3276.8000 3276.7000 ECU_ADDRESS 0x7FC1C8 /begin FUNCTION_LIST LAYER /end FUNCTION_LIST /end MEASUREMENT
/begin MEASUREMENT Mlh_n "Luftmasse pro Zylinder normiert Hydraulikpfad" UBYTE Def_f_ub_b2 0 0 0.0 1.9921 ECU_ADDRESS 0x7FDE80 /begin FUNCTION_LIST MANDETEK /end FUNCTION_LIST /end MEASUREMENT
/begin MEASUREMENT Mll_n "Luftmasse pro Zylinder normiert Luftpfad" UBYTE Def_f_ub_b2 0 0 0.0 1.9921 ECU_ADDRESS 0x7FDE81 /begin FUNCTION_LIST MANDETEK /end FUNCTION_LIST /end MEASUREMENT
/begin MEASUREMENT Mslui "Integr. Luftmasse" UWORD Def_lm_uw_q0p000444 0 0 0.0 29.1266 ECU_ADDRESS 0x7FC16E /begin FUNCTION_LIST LAYER /end FUNCTION_LIST /end MEASUREMENT
/begin MEASUREMENT N_gen "Generatordrehzahl" SWORD Def_n_sw_q1p0 0 0 0.0 32767.0000 ECU_ADDRESS 0x7FD884 /begin FUNCTION_LIST IMDGEN_1PR /end FUNCTION_LIST /end MEASUREMENT
/begin MEASUREMENT N_idlibs "Leerlaufdrehzahlvorgabe von LC-Powermanagement" UBYTE Def_st_ub_q1 0 0 0.0 255.0000 ECU_ADDRESS 0x7FC34E /begin FUNCTION_LIST LLPMCTRL /end FUNCTION_LIST /end MEASUREMENT
/begin MEASUREMENT N_idlms "Leerlaufdrehzahlanhebung von Powermodul" UBYTE Def_st_ub_q1 0 0 0.0 255.0000 ECU_ADDRESS 0x7FC174 /begin FUNCTION_LIST LAYER /end FUNCTION_LIST /end MEASUREMENT
/begin MEASUREMENT N_nstart "Motordrehzahl nach Motorstart" SWORD Def_n_sw_q1p0 0 0 -32768.0000 32767.0000 ECU_ADDRESS 0x7FD9AA /begin FUNCTION_LIST LDSTGEN /end FUNCTION_LIST /end MEASUREMENT
/begin MEASUREMENT Nkw "Drehzahl" SWORD Def_n_sw_q1p0 0 0 -32768.0000 32767.0000 ECU_ADDRESS 0x7FC170 /begin FUNCTION_LIST LAYER /end FUNCTION_LIST /end MEASUREMENT
/begin MEASUREMENT Nkw_s "Motordrehzahl U/s" SWORD Def_n_sw_q1p0 0 0 -32768.0000 32767.0000 ECU_ADDRESS 0x7FD886 /begin FUNCTION_LIST IMDGEN_1PR /end FUNCTION_LIST /end MEASUREMENT
/begin MEASUREMENT Nslb "N_soll Korrektur von Ladebilanz Batterie" SWORD Def_n_sw_q1p0 0 0 0.0 32767.0000 ECU_ADDRESS 0x7FD9B2 /begin FUNCTION_LIST LLRANH /end FUNCTION_LIST /end MEASUREMENT
/begin MEASUREMENT Nsllm "Solldrehzahl im Leerlauf ohne Fahrstufe" SWORD Def_n_sw_q1p0 0 0 -32768.0000 32767.0000 ECU_ADDRESS 0x7FC172 /begin FUNCTION_LIST LAYER /end FUNCTION_LIST /end MEASUREMENT
/begin MEASUREMENT Oz_datstat "Status Anzeige Uhrzeit Datum" UBYTE Def_dez_ub_q1 0 0 0.0 255.0000 ECU_ADDRESS 0x7FC1BA /begin FUNCTION_LIST LAYER /end FUNCTION_LIST /end MEASUREMENT
/begin MEASUREMENT Oz_lf1c "Länderfaktor 1 codiert" UBYTE Def_lf_ub_q0p01 0 0 0.0 2.5500 ECU_ADDRESS 0x7FC0FB /begin FUNCTION_LIST LAYER /end FUNCTION_LIST /end MEASUREMENT
/begin MEASUREMENT Oz_lf2c "Länderfaktor 2 codiert" UBYTE Def_lf_ub_q0p01 0 0 0.0 2.5500 ECU_ADDRESS 0x7FC0FC /begin FUNCTION_LIST LAYER /end FUNCTION_LIST /end MEASUREMENT
/begin MEASUREMENT Oz_nivr "Rohwert Ölniveau vom Sensor" UBYTE Def_dez_ub_q1 0 0 0.0 255.0000 ECU_ADDRESS 0x7FC10A /begin FUNCTION_LIST LAYER /end FUNCTION_LIST /end MEASUREMENT
/begin MEASUREMENT Oz_permr "Rohwert Permittivität vom Sensor" UWORD Def_dez_uw_q1 0 0 0.0 65535.0000 ECU_ADDRESS 0x7FC10C /begin FUNCTION_LIST LAYER /end FUNCTION_LIST /end MEASUREMENT
/begin MEASUREMENT Oz_reset "Zieltermin_Monat_BOS_Rückstellung_2" UBYTE Def_dez_ub_q1 0 0 0.0 255.0000 ECU_ADDRESS 0x7FDEA1 /begin FUNCTION_LIST OZBG /end FUNCTION_LIST /end MEASUREMENT
/begin MEASUREMENT Oz_resetr "Status der Resetart vom Kombi" UBYTE Def_dez_ub_q1 0 0 0.0 255.0000 ECU_ADDRESS 0x7FC1C4 /begin FUNCTION_LIST LAYER /end FUNCTION_LIST /end MEASUREMENT
/begin MEASUREMENT Oz_status "Statusinfo vom Sensor" UBYTE Def_dez_ub_q1 0 0 0.0 255.0000 ECU_ADDRESS 0x7FC10E /begin FUNCTION_LIST LAYER /end FUNCTION_LIST /end MEASUREMENT
/begin MEASUREMENT Oz_tempakt "Ausgabe Öltemperatur für den Tester" SWORD Def_t_sw_q0p1 0 0 -3276.8000 3276.7000 ECU_ADDRESS 0x7FDE96 /begin FUNCTION_LIST OZBG /end FUNCTION_LIST /end MEASUREMENT
/begin MEASUREMENT Oz_tempr "Rohwert Öltemperatur vom Sensor" UBYTE Def_dez_ub_q1 0 0 0.0 255.0000 ECU_ADDRESS 0x7FC10F /begin FUNCTION_LIST LAYER /end FUNCTION_LIST /end MEASUREMENT
/begin MEASUREMENT P_gen_ab "elektrische Generatorleistung" ULONG Def_pwr_ul_q0p03125 0 0 0.0 4096.0000 ECU_ADDRESS 0x7FD8A4 /begin FUNCTION_LIST IMDGEN_1PR /end FUNCTION_LIST /end MEASUREMENT
/begin MEASUREMENT P_gle "Glühleistung" UWORD Def_p_uw_q0p039 0 0 0.0 2559.9609 ECU_ADDRESS 0x7FC12E /begin FUNCTION_LIST LAYER /end FUNCTION_LIST /end MEASUREMENT
/begin MEASUREMENT Pld "Ladedruck" SWORD Def_p_sw_q1 0 0 -32768.0000 32767.0000 ECU_ADDRESS 0x7FC1CE /begin FUNCTION_LIST LAYER /end FUNCTION_LIST /end MEASUREMENT
/begin MEASUREMENT Pld_n "Ladedruck normiert" UBYTE Def_f_ub_b2 0 0 0.0 1.9921 ECU_ADDRESS 0x7FDE82 /begin FUNCTION_LIST MANDETEK /end FUNCTION_LIST /end MEASUREMENT
/begin MEASUREMENT Pmsv "Angemeldete Powermanagment Standverbraucher" UBYTE Def_dez_ub_q1 0 0 0.0 255.0000 ECU_ADDRESS 0x7FD950 ARRAY_SIZE 15 /begin FUNCTION_LIST LAYER /end FUNCTION_LIST /end MEASUREMENT
/begin MEASUREMENT Pu "Umgebungsdruck" UWORD Def_p_uw_q0p039 0 0 0.0 2559.9609 ECU_ADDRESS 0x7FC110 /begin FUNCTION_LIST LAYER /end FUNCTION_LIST /end MEASUREMENT
/begin MEASUREMENT Pwg_ist "Pedalwert Fahrerwunsch in %" SWORD Def_wdk_sw_q0p0244 0 0 -800.0000 799.9755 ECU_ADDRESS 0x7FC112 /begin FUNCTION_LIST LAYER /end FUNCTION_LIST /end MEASUREMENT
/begin MEASUREMENT Qelad "Delta Batterieentladung" UWORD Def_ql_uw_q0p0182 0 0 0.0 1192.7502 ECU_ADDRESS 0x7FD8C4 /begin FUNCTION_LIST KT_IBS /end FUNCTION_LIST /end MEASUREMENT
/begin MEASUREMENT Qeladsoc0 "Entladung bei Ruhespannungsmessung" UWORD Def_ql_uw_q0p0182 0 0 0.0 1192.7502 ECU_ADDRESS 0x7FD8D2 /begin FUNCTION_LIST KT_IBS /end FUNCTION_LIST /end MEASUREMENT
/begin MEASUREMENT Qlad "Delta Batterieladung" UWORD Def_ql_uw_q0p0182 0 0 0.0 1192.7502 ECU_ADDRESS 0x7FD8C2 /begin FUNCTION_LIST KT_IBS /end FUNCTION_LIST /end MEASUREMENT
/begin MEASUREMENT Qladsoc0 "Ladung bei Ruhespannungsmessung" UWORD Def_ql_uw_q0p0182 0 0 0.0 1192.7502 ECU_ADDRESS 0x7FD8D0 /begin FUNCTION_LIST KT_IBS /end FUNCTION_LIST /end MEASUREMENT
/begin MEASUREMENT R5cyctim "Timer f. zyklisches Senden IBS Reg. 5" UBYTE Def_dez_ub_q1 0 0 0.0 255.0000 ECU_ADDRESS 0x7FD92A /begin FUNCTION_LIST KT_IBS /end FUNCTION_LIST /end MEASUREMENT
/begin MEASUREMENT Rf "Relative Luftfuellung" SWORD Def_rf_sw_q0p01 0 0 -327.6800 327.6700 ECU_ADDRESS 0x7FC176 /begin FUNCTION_LIST LAYER /end FUNCTION_LIST /end MEASUREMENT
/begin MEASUREMENT Sigmanla "Ringpuffer La_ist1" UWORD Def_f_uw_b16 0 0 0.0 15.9997 ECU_ADDRESS 0x7FDAD0 ARRAY_SIZE 20 /begin FUNCTION_LIST MANDETEK /end FUNCTION_LIST /end MEASUREMENT
/begin MEASUREMENT Sigmanme "Ringpuffer Einspritzmasse aktuell" SWORD Def_me_sw_q0p01 0 0 -327.6800 327.6700 ECU_ADDRESS 0x7FD9D2 ARRAY_SIZE 20 /begin FUNCTION_LIST MANDETEK /end FUNCTION_LIST /end MEASUREMENT
/begin MEASUREMENT Sigmanmlh "Ringpuffer Luftmasse pro Zylinder (Hydraulikpfad)" SWORD Def_ml_sw_q0p1 0 0 -3276.8000 3276.7000 ECU_ADDRESS 0x7FD9FA ARRAY_SIZE 20 /begin FUNCTION_LIST MANDETEK /end FUNCTION_LIST /end MEASUREMENT
/begin MEASUREMENT Sigmanmll "Ringpuffer Luftmasse pro Zylinder (Luftpfad)" SWORD Def_ml_sw_q0p1 0 0 -3276.8000 3276.7000 ECU_ADDRESS 0x7FDA22 ARRAY_SIZE 20 /begin FUNCTION_LIST MANDETEK /end FUNCTION_LIST /end MEASUREMENT
/begin MEASUREMENT Sigmanpld "Ringpuffer Ladedruck" SWORD Def_p_sw_q1 0 0 -32768.0000 32767.0000 ECU_ADDRESS 0x7FDA4A ARRAY_SIZE 20 /begin FUNCTION_LIST MANDETEK /end FUNCTION_LIST /end MEASUREMENT
/begin MEASUREMENT Sigmantvagr "Ringpuffer Tastverhältnis AGR-Steller" SWORD Def_tv_sw_q0p01 0 0 -327.6800 327.6700 ECU_ADDRESS 0x7FDA72 ARRAY_SIZE 20 /begin FUNCTION_LIST MANDETEK /end FUNCTION_LIST /end MEASUREMENT
/begin MEASUREMENT Sigmantvpld "Ringpuffer Tastverhältnis Ladedrucksteller" SWORD Def_tv_sw_q0p01 0 0 -327.6800 327.6700 ECU_ADDRESS 0x7FDA9A ARRAY_SIZE 20 /begin FUNCTION_LIST MANDETEK /end FUNCTION_LIST /end MEASUREMENT
/begin MEASUREMENT Snibs "Seriennummer" ULONG Def_dez_ul_q1 0 0 0.0 2147483647.0000 ECU_ADDRESS 0x7FD900 /begin FUNCTION_LIST KT_IBS /end FUNCTION_LIST /end MEASUREMENT
/begin MEASUREMENT St_ckl15 "Klemmensignale vom CAN" UBYTE Def_dez_ub_q1 0 0 0.0 255.0000 ECU_ADDRESS 0x7FC178 /begin FUNCTION_LIST LAYER /end FUNCTION_LIST /end MEASUREMENT
/begin MEASUREMENT St_ckl15.B_ckl30 "Bedingung Klemme R (über CAN)" UBYTE Def_bit_ub_1 0 0 0.0 255.0 ECU_ADDRESS 0x7FC178 /begin FUNCTION_LIST LAYER /end FUNCTION_LIST BIT_MASK 0x2 /end MEASUREMENT
/begin MEASUREMENT St_ckl15.B_ckl50 "Bedingung Klemme 50 (vom CAN)" UBYTE Def_bit_ub_0 0 0 0.0 255.0 ECU_ADDRESS 0x7FC178 /begin FUNCTION_LIST LAYER /end FUNCTION_LIST BIT_MASK 0x1 /end MEASUREMENT
/begin MEASUREMENT St_egs "Statusbyte Automatikgetriebe" UBYTE Def_st_ub_q1 0 0 0.0 255.0000 ECU_ADDRESS 0x7FC179 /begin FUNCTION_LIST LAYER /end FUNCTION_LIST /end MEASUREMENT
/begin MEASUREMENT St_egs.B_fs "Bedingung Fahrstufe" UBYTE Def_bit_ub_0 0 0 0.0 255.0 ECU_ADDRESS 0x7FC179 /begin FUNCTION_LIST LAYER /end FUNCTION_LIST BIT_MASK 0x1 /end MEASUREMENT
/begin MEASUREMENT St_elu "Status elu" UBYTE Def_st_ub_q1 0 0 0.0 255.0000 ECU_ADDRESS 0x7FD971 /begin FUNCTION_LIST LAYER /end FUNCTION_LIST /end MEASUREMENT
/begin MEASUREMENT St_elu.B_elu600 "Bedingung Elüftertyp" UBYTE Def_bit_ub_0 0 0 0.0 255.0 ECU_ADDRESS 0x7FD971 /begin FUNCTION_LIST LAYER /end FUNCTION_LIST BIT_MASK 0x1 /end MEASUREMENT
/begin MEASUREMENT St_genallg "Allgemeine Eingangsbits" UBYTE Def_st_ub_q1 0 0 0.0 255.0000 ECU_ADDRESS 0x7FC17A /begin FUNCTION_LIST LAYER /end FUNCTION_LIST /end MEASUREMENT
/begin MEASUREMENT St_genallg.B_abliactiv "Bedingung Abblendlicht aktiv" UBYTE Def_bit_ub_1 0 0 0.0 255.0 ECU_ADDRESS 0x7FC17A /begin FUNCTION_LIST LAYER /end FUNCTION_LIST BIT_MASK 0x2 /end MEASUREMENT
/begin MEASUREMENT St_genallg.B_bsdprot1 "Bedingung BSD Protokollinhalt für BSD1 Regler" UBYTE Def_bit_ub_3 0 0 0.0 255.0 ECU_ADDRESS 0x7FC17A /begin FUNCTION_LIST LAYER /end FUNCTION_LIST BIT_MASK 0x8 /end MEASUREMENT
/begin MEASUREMENT St_genallg.B_bsdprot2 "Bedingung BSD Protokollinhalt für BSD 2 Regler" UBYTE Def_bit_ub_4 0 0 0.0 255.0 ECU_ADDRESS 0x7FC17A /begin FUNCTION_LIST LAYER /end FUNCTION_LIST BIT_MASK 0x10 /end MEASUREMENT
/begin MEASUREMENT St_genallg.B_gen2inst "2. Generator installiert" UBYTE Def_bit_ub_2 0 0 0.0 255.0 ECU_ADDRESS 0x7FC17A /begin FUNCTION_LIST LAYER /end FUNCTION_LIST BIT_MASK 0x4 /end MEASUREMENT
/begin MEASUREMENT St_genallg.B_iliactiv "Bedingung Innenlicht aktiv" UBYTE Def_bit_ub_0 0 0 0.0 255.0 ECU_ADDRESS 0x7FC17A /begin FUNCTION_LIST LAYER /end FUNCTION_LIST BIT_MASK 0x1 /end MEASUREMENT
/begin MEASUREMENT St_genallg.B_rd_gentyp "Bedingung Schalter APK zum Auslesen Hersteller und Generatortyp" UBYTE Def_bit_ub_5 0 0 0.0 255.0 ECU_ADDRESS 0x7FC17A /begin FUNCTION_LIST LAYER /end FUNCTION_LIST BIT_MASK 0x20 /end MEASUREMENT
/begin MEASUREMENT St_generator "Statusbyte Generator" UBYTE Def_st_ub_q1 0 0 0.0 255.0000 ECU_ADDRESS 0x7FC17B /begin FUNCTION_LIST LAYER /end FUNCTION_LIST /end MEASUREMENT
/begin MEASUREMENT St_generator.B_crashgen "Bedingung Generator abschalten bei Crash" UBYTE Def_bit_ub_6 0 0 0.0 255.0 ECU_ADDRESS 0x7FC17B /begin FUNCTION_LIST LAYER /end FUNCTION_LIST BIT_MASK 0x40 /end MEASUREMENT
/begin MEASUREMENT St_generator.B_genactiv "Bedingung Generatorinterface aktiv" UBYTE Def_bit_ub_0 0 0 0.0 255.0 ECU_ADDRESS 0x7FC17B /begin FUNCTION_LIST LAYER /end FUNCTION_LIST BIT_MASK 0x1 /end MEASUREMENT
/begin MEASUREMENT St_generator.B_genfbsd "Bedingung Kommunikationsverlust BSD Generator" UBYTE Def_bit_ub_2 0 0 0.0 255.0 ECU_ADDRESS 0x7FC17B /begin FUNCTION_LIST LAYER /end FUNCTION_LIST BIT_MASK 0x4 /end MEASUREMENT
/begin MEASUREMENT St_generator.B_genfel "Bedingung Generatorfehler elektrisch" UBYTE Def_bit_ub_3 0 0 0.0 255.0 ECU_ADDRESS 0x7FC17B /begin FUNCTION_LIST LAYER /end FUNCTION_LIST BIT_MASK 0x8 /end MEASUREMENT
/begin MEASUREMENT St_generator.B_genfht "Bedingung Generatorzustand hohe Temparatur" UBYTE Def_bit_ub_4 0 0 0.0 255.0 ECU_ADDRESS 0x7FC17B /begin FUNCTION_LIST LAYER /end FUNCTION_LIST BIT_MASK 0x10 /end MEASUREMENT
/begin MEASUREMENT St_generator.B_genfme "Bedingung Generatorfehler mechanisch" UBYTE Def_bit_ub_5 0 0 0.0 255.0 ECU_ADDRESS 0x7FC17B /begin FUNCTION_LIST LAYER /end FUNCTION_LIST BIT_MASK 0x20 /end MEASUREMENT
/begin MEASUREMENT St_generator2 "Statuswort für 2. Generator" UBYTE Def_st_ub_q1 0 0 0.0 255.0000 ECU_ADDRESS 0x7FC17C /begin FUNCTION_LIST LAYER /end FUNCTION_LIST /end MEASUREMENT
/begin MEASUREMENT St_generator2.B_genactiv2 "Bedingung Generatorinterface Gen 2 activ" UBYTE Def_bit_ub_0 0 0 0.0 255.0 ECU_ADDRESS 0x7FC17C /begin FUNCTION_LIST LAYER /end FUNCTION_LIST BIT_MASK 0x1 /end MEASUREMENT
/begin MEASUREMENT St_generator2.B_genfbsd2 "Kommunikationsverlust BSD Generator 2" UBYTE Def_bit_ub_2 0 0 0.0 255.0 ECU_ADDRESS 0x7FC17C /begin FUNCTION_LIST LAYER /end FUNCTION_LIST BIT_MASK 0x4 /end MEASUREMENT
/begin MEASUREMENT St_generator2.B_genfel2 "Generatorfehler elektrisch Generator 2" UBYTE Def_bit_ub_3 0 0 0.0 255.0 ECU_ADDRESS 0x7FC17C /begin FUNCTION_LIST LAYER /end FUNCTION_LIST BIT_MASK 0x8 /end MEASUREMENT
/begin MEASUREMENT St_generator2.B_genfht2 "Generatorfehler Übertemperatur Gen 2" UBYTE Def_bit_ub_4 0 0 0.0 255.0 ECU_ADDRESS 0x7FC17C /begin FUNCTION_LIST LAYER /end FUNCTION_LIST BIT_MASK 0x10 /end MEASUREMENT
/begin MEASUREMENT St_generator2.B_genfme2 "Generatorfehler Mechanisch Generator 2" UBYTE Def_bit_ub_5 0 0 0.0 255.0 ECU_ADDRESS 0x7FC17C /begin FUNCTION_LIST LAYER /end FUNCTION_LIST BIT_MASK 0x20 /end MEASUREMENT
/begin MEASUREMENT St_genll "LR Eingänge" UBYTE Def_st_ub_q1 0 0 0.0 255.0000 ECU_ADDRESS 0x7FC17D /begin FUNCTION_LIST LAYER /end FUNCTION_LIST /end MEASUREMENT
/begin MEASUREMENT St_genll.B_lrfoff "Kopie Drehzahlschwelle für LR-Funktion Generator 1 aktiv" UBYTE Def_bit_ub_0 0 0 0.0 255.0 ECU_ADDRESS 0x7FC17D /begin FUNCTION_LIST LAYER /end FUNCTION_LIST BIT_MASK 0x1 /end MEASUREMENT
/begin MEASUREMENT St_genll.B_lrfoff2 "Kopie Drehzahlschwelle für LR-Funktion Generator 2 aktiv" UBYTE Def_bit_ub_1 0 0 0.0 255.0 ECU_ADDRESS 0x7FC17D /begin FUNCTION_LIST LAYER /end FUNCTION_LIST BIT_MASK 0x2 /end MEASUREMENT
/begin MEASUREMENT St_genll.B_lrreg1ak "LR-Register 1 aktiv Generator 1" UBYTE Def_bit_ub_2 0 0 0.0 255.0 ECU_ADDRESS 0x7FC17D /begin FUNCTION_LIST LAYER /end FUNCTION_LIST BIT_MASK 0x4 /end MEASUREMENT
/begin MEASUREMENT St_genll.B_lrreg1ak2 "LR-Register 1 aktiv Generator 2" UBYTE Def_bit_ub_3 0 0 0.0 255.0 ECU_ADDRESS 0x7FC17D /begin FUNCTION_LIST LAYER /end FUNCTION_LIST BIT_MASK 0x8 /end MEASUREMENT
/begin MEASUREMENT St_ibebsd1 "Statuswort ibebsd1" UBYTE Def_st_ub_q1 0 0 0.0 255.0000 ECU_ADDRESS 0x7FD912 /begin FUNCTION_LIST KT_IBS /end FUNCTION_LIST /end MEASUREMENT
/begin MEASUREMENT St_ibebsd1.B_eb_busy "Bedingung EBSD Übertragungsrichtung schreiben" UBYTE Def_bit_ub_3 0 0 0.0 255.0 ECU_ADDRESS 0x7FD912 /begin FUNCTION_LIST KT_IBS /end FUNCTION_LIST BIT_MASK 0x8 /end MEASUREMENT
/begin MEASUREMENT St_ibebsd1.B_eb_txok "Bedingung EBSD Übertragungsrichtung schreiben" UBYTE Def_bit_ub_2 0 0 0.0 255.0 ECU_ADDRESS 0x7FD912 /begin FUNCTION_LIST KT_IBS /end FUNCTION_LIST BIT_MASK 0x4 /end MEASUREMENT
/begin MEASUREMENT St_ibebsd1.B_ibs_msgrdy "Bedingung EBSD Botschaft von IBS empfangen" UBYTE Def_bit_ub_0 0 0 0.0 255.0 ECU_ADDRESS 0x7FD912 /begin FUNCTION_LIST KT_IBS /end FUNCTION_LIST BIT_MASK 0x1 /end MEASUREMENT
/begin MEASUREMENT St_ibebsd1.B_ibs_msgwri "Bedingung EBSD Übertragungsrichtung schreiben" UBYTE Def_bit_ub_1 0 0 0.0 255.0 ECU_ADDRESS 0x7FD912 /begin FUNCTION_LIST KT_IBS /end FUNCTION_LIST BIT_MASK 0x2 /end MEASUREMENT
/begin MEASUREMENT St_ibmix "Statuswort ibmix" UBYTE Def_st_ub_q1 0 0 0.0 255.0000 ECU_ADDRESS 0x7FD914 /begin FUNCTION_LIST KT_IBS /end FUNCTION_LIST /end MEASUREMENT
/begin MEASUREMENT St_ibmix.B_ibrhilo "toggle Bit Register0/ 1 hi- od. lo byte" UBYTE Def_bit_ub_0 0 0 0.0 255.0 ECU_ADDRESS 0x7FD914 /begin FUNCTION_LIST KT_IBS /end FUNCTION_LIST BIT_MASK 0x1 /end MEASUREMENT
/begin MEASUREMENT St_ibmix.B_ibttog "global toggle bit" UBYTE Def_bit_ub_1 0 0 0.0 255.0 ECU_ADDRESS 0x7FD914 /begin FUNCTION_LIST KT_IBS /end FUNCTION_LIST BIT_MASK 0x2 /end MEASUREMENT
/begin MEASUREMENT St_ibs "Status ibs" UBYTE Def_st_ub_q1 0 0 0.0 255.0000 ECU_ADDRESS 0x7FD972 /begin FUNCTION_LIST LAYER /end FUNCTION_LIST /end MEASUREMENT
/begin MEASUREMENT St_ibs.B_ibsdetec "Bedingung IBS erkannt" UBYTE Def_bit_ub_0 0 0 0.0 255.0 ECU_ADDRESS 0x7FD972 /begin FUNCTION_LIST LAYER /end FUNCTION_LIST BIT_MASK 0x1 /end MEASUREMENT
/begin MEASUREMENT St_ibserr "Statuswort ibserr" UBYTE Def_st_ub_q1 0 0 0.0 255.0000 ECU_ADDRESS 0x7FD913 /begin FUNCTION_LIST KT_IBS /end FUNCTION_LIST /end MEASUREMENT
/begin MEASUREMENT St_ibserr.B_ibfbsd "Bedingung BSD Fehler" UBYTE Def_bit_ub_0 0 0 0.0 255.0 ECU_ADDRESS 0x7FD913 /begin FUNCTION_LIST KT_IBS /end FUNCTION_LIST BIT_MASK 0x1 /end MEASUREMENT
/begin MEASUREMENT St_ibserr.B_ibfebsd "Bedingung EBSD Fehler" UBYTE Def_bit_ub_1 0 0 0.0 255.0 ECU_ADDRESS 0x7FD913 /begin FUNCTION_LIST KT_IBS /end FUNCTION_LIST BIT_MASK 0x2 /end MEASUREMENT
/begin MEASUREMENT St_ibserr.B_ibunplau "Bedingung IBS Version unplausibel" UBYTE Def_bit_ub_2 0 0 0.0 255.0 ECU_ADDRESS 0x7FD913 /begin FUNCTION_LIST KT_IBS /end FUNCTION_LIST BIT_MASK 0x4 /end MEASUREMENT
/begin MEASUREMENT St_ibsreg4 "Statuswort ibsreg4" UBYTE Def_st_ub_q1 0 0 0.0 255.0000 ECU_ADDRESS 0x7FD909 /begin FUNCTION_LIST KT_IBS /end FUNCTION_LIST /end MEASUREMENT
/begin MEASUREMENT St_ibsreg4.B_ibspwf "Bedingung IBS powerfail erkannt" UBYTE Def_bit_ub_4 0 0 0.0 255.0 ECU_ADDRESS 0x7FD909 /begin FUNCTION_LIST KT_IBS /end FUNCTION_LIST BIT_MASK 0x10 /end MEASUREMENT
/begin MEASUREMENT St_ibsreg4.B_startfgk "Bedingung Startfähigkeit gefährdet" UBYTE Def_bit_ub_0 0 0 0.0 255.0 ECU_ADDRESS 0x7FD909 /begin FUNCTION_LIST KT_IBS /end FUNCTION_LIST BIT_MASK 0x1 /end MEASUREMENT
/begin MEASUREMENT St_ibsreg4.B_strtaw "Bedingung Startauswertung gerechnet" UBYTE Def_bit_ub_1 0 0 0.0 255.0 ECU_ADDRESS 0x7FD909 /begin FUNCTION_LIST KT_IBS /end FUNCTION_LIST BIT_MASK 0x2 /end MEASUREMENT
/begin MEASUREMENT St_ibsreg4.B_tiefset "Bedingung Tiefentladung" UBYTE Def_bit_ub_5 0 0 0.0 255.0 ECU_ADDRESS 0x7FD909 /begin FUNCTION_LIST KT_IBS /end FUNCTION_LIST BIT_MASK 0x20 /end MEASUREMENT
/begin MEASUREMENT St_ibsreg5 "Statuswort ibsreg5" UBYTE Def_st_ub_q1 0 0 0.0 255.0000 ECU_ADDRESS 0x7FD90A /begin FUNCTION_LIST KT_IBS /end FUNCTION_LIST /end MEASUREMENT
/begin MEASUREMENT St_ibsreg5.B_fsclr "Bedingung IBS interne Fehler loeschen" UBYTE Def_bit_ub_3 0 0 0.0 255.0 ECU_ADDRESS 0x7FD90A /begin FUNCTION_LIST KT_IBS /end FUNCTION_LIST BIT_MASK 0x8 /end MEASUREMENT
/begin MEASUREMENT St_imdgen0 "Statuswort" UBYTE Def_st_ub_q1 0 0 0.0 255.0000 ECU_ADDRESS 0x7FD8A8 /begin FUNCTION_LIST IMDGEN_1PR /end FUNCTION_LIST /end MEASUREMENT
/begin MEASUREMENT St_imdgen0.B_firstemp "Bedingung Generatorstarttemperatur-Berechnung" UBYTE Def_bit_ub_0 0 0 0.0 255.0 ECU_ADDRESS 0x7FD8A8 /begin FUNCTION_LIST IMDGEN_1PR /end FUNCTION_LIST BIT_MASK 0x1 /end MEASUREMENT
/begin MEASUREMENT St_imdgen0.B_gene "Generatormoment enable/disable" UBYTE Def_bit_ub_1 0 0 0.0 255.0 ECU_ADDRESS 0x7FD8A8 /begin FUNCTION_LIST IMDGEN_1PR /end FUNCTION_LIST BIT_MASK 0x2 /end MEASUREMENT
/begin MEASUREMENT St_imdgen0.B_generken "" UBYTE Def_bit_ub_2 0 0 0.0 255.0 ECU_ADDRESS 0x7FD8A8 /begin FUNCTION_LIST IMDGEN_1PR /end FUNCTION_LIST BIT_MASK 0x4 /end MEASUREMENT
/begin MEASUREMENT St_imdgen_1s "Statuswort" UBYTE Def_st_ub_q1 0 0 0.0 255.0000 ECU_ADDRESS 0x7FC0FA /begin FUNCTION_LIST LAYER /end FUNCTION_LIST /end MEASUREMENT
/begin MEASUREMENT St_imdgen_1s.B_genhtkrit "Diodentemparatur im kritischen Bereich" UBYTE Def_bit_ub_1 0 0 0.0 255.0 ECU_ADDRESS 0x7FC0FA /begin FUNCTION_LIST LAYER /end FUNCTION_LIST BIT_MASK 0x2 /end MEASUREMENT
/begin MEASUREMENT St_imdgen_1s.B_tdiodekrit "Generatormoment enable/disable" UBYTE Def_bit_ub_3 0 0 0.0 255.0 ECU_ADDRESS 0x7FC0FA /begin FUNCTION_LIST LAYER /end FUNCTION_LIST BIT_MASK 0x8 /end MEASUREMENT
/begin MEASUREMENT St_imdgen_nv0 "Statuswort" UBYTE Def_st_ub_q1 0 0 0.0 255.0000 ECU_ADDRESS 0x7FD8A9 /begin FUNCTION_LIST IMDGEN_1PR /end FUNCTION_LIST /end MEASUREMENT
/begin MEASUREMENT St_imdgen_nv0.B_genfkupl "Generatortyp unplausibel" UBYTE Def_bit_ub_0 0 0 0.0 255.0 ECU_ADDRESS 0x7FD8A9 /begin FUNCTION_LIST IMDGEN_1PR /end FUNCTION_LIST BIT_MASK 0x1 /end MEASUREMENT
/begin MEASUREMENT St_imdgen_nv0.B_heizen "Bedingung Generator in Heizphase" UBYTE Def_bit_ub_1 0 0 0.0 255.0 ECU_ADDRESS 0x7FD8A9 /begin FUNCTION_LIST IMDGEN_1PR /end FUNCTION_LIST BIT_MASK 0x2 /end MEASUREMENT
/begin MEASUREMENT St_instr3_1 "Status Can Botschaft Instr3 (CAN11)" UBYTE Def_st_ub_q1 0 0 0.0 255.0000 ECU_ADDRESS 0x7FC17E /begin FUNCTION_LIST LAYER /end FUNCTION_LIST /end MEASUREMENT
/begin MEASUREMENT St_instr3_1.S_tns "Bedingung aus Schalter Tag-/Nachtbeleuchtung" UBYTE Def_bit_ub_6 0 0 0.0 255.0 ECU_ADDRESS 0x7FC17E /begin FUNCTION_LIST LAYER /end FUNCTION_LIST BIT_MASK 0x40 /end MEASUREMENT
/begin MEASUREMENT St_kl15 "Statusbyte Klemme 15" UBYTE Def_st_ub_q1 0 0 0.0 255.0000 ECU_ADDRESS 0x7FC17F /begin FUNCTION_LIST LAYER /end FUNCTION_LIST /end MEASUREMENT
/begin MEASUREMENT St_kl15.B_kl15_ep "Bitgröße, Bedingung KL15 gesetzt" UBYTE Def_bit_ub_0 0 0 0.0 255.0 ECU_ADDRESS 0x7FC17F /begin FUNCTION_LIST LAYER /end FUNCTION_LIST BIT_MASK 0x1 /end MEASUREMENT
/begin MEASUREMENT St_lbattcal0 "Statuswort" UBYTE Def_st_ub_q1 0 0 0.0 255.0000 ECU_ADDRESS 0x7FD99C /begin FUNCTION_LIST LBATTCAL /end FUNCTION_LIST /end MEASUREMENT
/begin MEASUREMENT St_lbattcal0.B_dly_tbi "" UBYTE Def_bit_ub_5 0 0 0.0 255.0 ECU_ADDRESS 0x7FD99C /begin FUNCTION_LIST LBATTCAL /end FUNCTION_LIST BIT_MASK 0x20 /end MEASUREMENT
/begin MEASUREMENT St_lbattcal0.B_lbatteinih "Ende Initialisierungsphase Lbattcal Batterie hinten" UBYTE Def_bit_ub_0 0 0 0.0 255.0 ECU_ADDRESS 0x7FD99C /begin FUNCTION_LIST LBATTCAL /end FUNCTION_LIST BIT_MASK 0x1 /end MEASUREMENT
/begin MEASUREMENT St_lbattcal0.B_lbatteiniv "Ende Initialisierungsphase Lbattcal Batterie vorne" UBYTE Def_bit_ub_1 0 0 0.0 255.0 ECU_ADDRESS 0x7FD99C /begin FUNCTION_LIST LBATTCAL /end FUNCTION_LIST BIT_MASK 0x2 /end MEASUREMENT
/begin MEASUREMENT St_lbattcal0.B_lbattenh "Enable Batterie hinten" UBYTE Def_bit_ub_2 0 0 0.0 255.0 ECU_ADDRESS 0x7FD99C /begin FUNCTION_LIST LBATTCAL /end FUNCTION_LIST BIT_MASK 0x4 /end MEASUREMENT
/begin MEASUREMENT St_lbattcal0.B_lbattenv "Enable Batterie vorne" UBYTE Def_bit_ub_3 0 0 0.0 255.0 ECU_ADDRESS 0x7FD99C /begin FUNCTION_LIST LBATTCAL /end FUNCTION_LIST BIT_MASK 0x8 /end MEASUREMENT
/begin MEASUREMENT St_lbattcal0.B_lbattinit "Initialisierung LBATTCAL beendet" UBYTE Def_bit_ub_4 0 0 0.0 255.0 ECU_ADDRESS 0x7FD99C /begin FUNCTION_LIST LBATTCAL /end FUNCTION_LIST BIT_MASK 0x10 /end MEASUREMENT
/begin MEASUREMENT St_ldstgen "Lastzustand Generator elektrisch/thermisch" UBYTE Def_st_ub_q1 0 0 0.0 255.0000 ECU_ADDRESS 0x7FD9B0 /begin FUNCTION_LIST LDSTGEN /end FUNCTION_LIST /end MEASUREMENT
/begin MEASUREMENT St_llr "Statusword Leerlaufregler" UWORD Def_st_uw_q1 0 0 0.0 65535.0000 ECU_ADDRESS 0x7FC180 /begin FUNCTION_LIST LAYER /end FUNCTION_LIST /end MEASUREMENT
/begin MEASUREMENT St_llr.B_llrein "wird beim ersten LL-Regler ein gesetzt und nicht mehr geändert" UWORD Def_bit_uw_0 0 0 0.0 65535.0 ECU_ADDRESS 0x7FC180 /begin FUNCTION_LIST LAYER /end FUNCTION_LIST BIT_MASK 0x1 /end MEASUREMENT
/begin MEASUREMENT St_llranh0 "Statuswort" UBYTE Def_st_ub_q1 0 0 0.0 255.0000 ECU_ADDRESS 0x7FD9B4 /begin FUNCTION_LIST LLRANH /end FUNCTION_LIST /end MEASUREMENT
/begin MEASUREMENT St_llranh0.B_idl_tp "Temporäres Berechnungsbit" UBYTE Def_bit_ub_2 0 0 0.0 255.0 ECU_ADDRESS 0x7FD9B4 /begin FUNCTION_LIST LLRANH /end FUNCTION_LIST BIT_MASK 0x4 /end MEASUREMENT
/begin MEASUREMENT St_llranh0.B_idlgspec "" UBYTE Def_bit_ub_0 0 0 0.0 255.0 ECU_ADDRESS 0x7FD9B4 /begin FUNCTION_LIST LLRANH /end FUNCTION_LIST BIT_MASK 0x1 /end MEASUREMENT
/begin MEASUREMENT St_llranh0.B_nsub "Bedingung für Solldrehzahlanhebung bei niedriger Batteriespannung" UBYTE Def_bit_ub_1 0 0 0.0 255.0 ECU_ADDRESS 0x7FD9B4 /begin FUNCTION_LIST LLRANH /end FUNCTION_LIST BIT_MASK 0x2 /end MEASUREMENT
/begin MEASUREMENT St_loadresp0 "Statuswort" UBYTE Def_st_ub_q1 0 0 0.0 255.0000 ECU_ADDRESS 0x7FD9B8 /begin FUNCTION_LIST LOADRESP /end FUNCTION_LIST /end MEASUREMENT
/begin MEASUREMENT St_loadresp0.B_fub "" UBYTE Def_bit_ub_2 0 0 0.0 255.0 ECU_ADDRESS 0x7FD9B8 /begin FUNCTION_LIST LOADRESP /end FUNCTION_LIST BIT_MASK 0x4 /end MEASUREMENT
/begin MEASUREMENT St_loadresp0.B_genoffmd "Bedingung Generatorabschaltung im Start" UBYTE Def_bit_ub_1 0 0 0.0 255.0 ECU_ADDRESS 0x7FD9B8 /begin FUNCTION_LIST LOADRESP /end FUNCTION_LIST BIT_MASK 0x2 /end MEASUREMENT
/begin MEASUREMENT St_loadresp0.B_genoffst "" UBYTE Def_bit_ub_0 0 0 0.0 255.0 ECU_ADDRESS 0x7FD9B8 /begin FUNCTION_LIST LOADRESP /end FUNCTION_LIST BIT_MASK 0x1 /end MEASUREMENT
/begin MEASUREMENT St_loadresp10ms "Statuswort" UBYTE Def_st_ub_q1 0 0 0.0 255.0000 ECU_ADDRESS 0x7FD9B9 /begin FUNCTION_LIST LOADRESP /end FUNCTION_LIST /end MEASUREMENT
/begin MEASUREMENT St_loadresp10ms.B_mdgrenz "Bedingung Generator im Modus Momentenbegrenzung" UBYTE Def_bit_ub_0 0 0 0.0 255.0 ECU_ADDRESS 0x7FD9B9 /begin FUNCTION_LIST LOADRESP /end FUNCTION_LIST BIT_MASK 0x1 /end MEASUREMENT
/begin MEASUREMENT St_loadresp_nv0 "Statuswort" UBYTE Def_st_ub_q1 0 0 0.0 255.0000 ECU_ADDRESS 0x7FD9B5 /begin FUNCTION_LIST LOADRESP /end FUNCTION_LIST /end MEASUREMENT
/begin MEASUREMENT St_loadresp_nv0.B_genoffvl "Bedingung Generatorabschaltung bei Vollast" UBYTE Def_bit_ub_0 0 0 0.0 255.0 ECU_ADDRESS 0x7FD9B5 /begin FUNCTION_LIST LOADRESP /end FUNCTION_LIST BIT_MASK 0x1 /end MEASUREMENT
/begin MEASUREMENT St_mandetek "Statuswort" UWORD Def_st_uw_q1 0 0 0.0 65535.0000 ECU_ADDRESS 0x7FDAF8 /begin FUNCTION_LIST MANDETEK /end FUNCTION_LIST /end MEASUREMENT
/begin MEASUREMENT St_mandetek.B_lsuakt "Bedingung für Hydraulikpfadaktivierung temp 4" UWORD Def_bit_uw_8 0 0 0.0 65535.0 ECU_ADDRESS 0x7FDAF8 /begin FUNCTION_LIST MANDETEK /end FUNCTION_LIST BIT_MASK 0x100 /end MEASUREMENT
/begin MEASUREMENT St_mandetek.B_mandetek1 "Bedingung für Hydraulikpfadaktivierung temp 1" UWORD Def_bit_uw_3 0 0 0.0 65535.0 ECU_ADDRESS 0x7FDAF8 /begin FUNCTION_LIST MANDETEK /end FUNCTION_LIST BIT_MASK 0x8 /end MEASUREMENT
/begin MEASUREMENT St_mandetek.B_mandetek2 "Bedingung Freigabe Manipulationserkennung " UWORD Def_bit_uw_4 0 0 0.0 65535.0 ECU_ADDRESS 0x7FDAF8 /begin FUNCTION_LIST MANDETEK /end FUNCTION_LIST BIT_MASK 0x10 /end MEASUREMENT
/begin MEASUREMENT St_mandetek.B_mandetek3 "Bedingung Lambdasonde aktiv" UWORD Def_bit_uw_5 0 0 0.0 65535.0 ECU_ADDRESS 0x7FDAF8 /begin FUNCTION_LIST MANDETEK /end FUNCTION_LIST BIT_MASK 0x20 /end MEASUREMENT
/begin MEASUREMENT St_mandetek.B_mandetek4 "Bedingung Manipulationserkenung Luftpfad aktiv" UWORD Def_bit_uw_6 0 0 0.0 65535.0 ECU_ADDRESS 0x7FDAF8 /begin FUNCTION_LIST MANDETEK /end FUNCTION_LIST BIT_MASK 0x40 /end MEASUREMENT
/begin MEASUREMENT St_mandetek.B_mandetek5 "Bedingung für Hydraulikpfadaktivierung temp. 2" UWORD Def_bit_uw_7 0 0 0.0 65535.0 ECU_ADDRESS 0x7FDAF8 /begin FUNCTION_LIST MANDETEK /end FUNCTION_LIST BIT_MASK 0x80 /end MEASUREMENT
/begin MEASUREMENT St_mandetek.B_mandetekh "Bedingung für Hydraulikpfadaktivierung temp 5" UWORD Def_bit_uw_1 0 0 0.0 65535.0 ECU_ADDRESS 0x7FDAF8 /begin FUNCTION_LIST MANDETEK /end FUNCTION_LIST BIT_MASK 0x2 /end MEASUREMENT
/begin MEASUREMENT St_mandetek.B_mandetekl "Bedingung Manipulationserkenung Hydraulikpfad aktiv" UWORD Def_bit_uw_2 0 0 0.0 65535.0 ECU_ADDRESS 0x7FDAF8 /begin FUNCTION_LIST MANDETEK /end FUNCTION_LIST BIT_MASK 0x4 /end MEASUREMENT
/begin MEASUREMENT St_mandetek.B_mandetekml "Bedingung für Hydraulikpfadaktivierung temp. 3" UWORD Def_bit_uw_0 0 0 0.0 65535.0 ECU_ADDRESS 0x7FDAF8 /begin FUNCTION_LIST MANDETEK /end FUNCTION_LIST BIT_MASK 0x1 /end MEASUREMENT
/begin MEASUREMENT St_master "Statusbyte master" UBYTE Def_st_ub_q1 0 0 0.0 255.0000 ECU_ADDRESS 0x7FC182 /begin FUNCTION_LIST LAYER /end FUNCTION_LIST /end MEASUREMENT
/begin MEASUREMENT St_master.B_masterhw "Bedingung Master SG" UBYTE Def_bit_ub_0 0 0 0.0 255.0 ECU_ADDRESS 0x7FC182 /begin FUNCTION_LIST LAYER /end FUNCTION_LIST BIT_MASK 0x1 /end MEASUREMENT
/begin MEASUREMENT St_mdna "" UBYTE Def_st_ub_q1 0 0 0.0 255.0000 ECU_ADDRESS 0x7FC183 /begin FUNCTION_LIST LAYER /end FUNCTION_LIST /end MEASUREMENT
/begin MEASUREMENT St_mdna.B_lastab "" UBYTE Def_bit_ub_0 0 0 0.0 255.0 ECU_ADDRESS 0x7FC183 /begin FUNCTION_LIST LAYER /end FUNCTION_LIST BIT_MASK 0x1 /end MEASUREMENT
/begin MEASUREMENT St_mkwchn "Statuswort Masterkurbelwelle" UBYTE Def_dez_ub_q1 0 0 0.0 255.0000 ECU_ADDRESS 0x7FC184 /begin FUNCTION_LIST LAYER /end FUNCTION_LIST /end MEASUREMENT
/begin MEASUREMENT St_mkwchn.B_kwdreht "Bedingung drehende Kurbelwelle erkannt" UBYTE Def_bit_ub_5 0 0 0.0 255.0 ECU_ADDRESS 0x7FC184 /begin FUNCTION_LIST LAYER /end FUNCTION_LIST BIT_MASK 0x20 /end MEASUREMENT
/begin MEASUREMENT St_motzustd "Statusword fuer Motorzustand" UWORD Def_st_uw_q1 0 0 0.0 65535.0000 ECU_ADDRESS 0x7FC186 /begin FUNCTION_LIST LAYER /end FUNCTION_LIST /end MEASUREMENT
/begin MEASUREMENT St_motzustd.B_ll "Bedingung Leerlauf" UWORD Def_bit_uw_3 0 0 0.0 65535.0 ECU_ADDRESS 0x7FC186 /begin FUNCTION_LIST LAYER /end FUNCTION_LIST BIT_MASK 0x8 /end MEASUREMENT
/begin MEASUREMENT St_motzustd.B_vl "Bedingung Vollast" UWORD Def_bit_uw_5 0 0 0.0 65535.0 ECU_ADDRESS 0x7FC186 /begin FUNCTION_LIST LAYER /end FUNCTION_LIST BIT_MASK 0x20 /end MEASUREMENT
/begin MEASUREMENT St_oz "Statuswort Eingangsgrößen Ölzustandssensor" UBYTE Def_dez_ub_q1 0 0 0.0 255.0000 ECU_ADDRESS 0x7FC125 /begin FUNCTION_LIST LAYER /end FUNCTION_LIST /end MEASUREMENT
/begin MEASUREMENT St_oz.B_anhang "Bedingung Anhänger erkannt" UBYTE Def_bit_ub_0 0 0 0.0 255.0 ECU_ADDRESS 0x7FC125 /begin FUNCTION_LIST LAYER /end FUNCTION_LIST BIT_MASK 0x1 /end MEASUREMENT
/begin MEASUREMENT St_oz.B_ozfbsd "Bedingung Fehler BSD-Kommunikation" UBYTE Def_bit_ub_1 0 0 0.0 255.0 ECU_ADDRESS 0x7FC125 /begin FUNCTION_LIST LAYER /end FUNCTION_LIST BIT_MASK 0x2 /end MEASUREMENT
/begin MEASUREMENT St_oz_i "Statusbyte für Eingang OZ" UBYTE Def_dez_ub_q1 0 0 0.0 255.0000 ECU_ADDRESS 0x7FC124 /begin FUNCTION_LIST LAYER /end FUNCTION_LIST /end MEASUREMENT
/begin MEASUREMENT St_oz_i.B_td_og "Bedingung Abkühlzeit gültig" UBYTE Def_bit_ub_0 0 0 0.0 255.0 ECU_ADDRESS 0x7FC124 /begin FUNCTION_LIST LAYER /end FUNCTION_LIST BIT_MASK 0x1 /end MEASUREMENT
/begin MEASUREMENT St_oz_i.B_td_ogok "Bedingung State-Machine 1x gültig gerechnet" UBYTE Def_bit_ub_4 0 0 0.0 255.0 ECU_ADDRESS 0x7FC124 /begin FUNCTION_LIST LAYER /end FUNCTION_LIST BIT_MASK 0x10 /end MEASUREMENT
/begin MEASUREMENT St_oz_i.B_toel "Bedingung tr und tv gültig" UBYTE Def_bit_ub_1 0 0 0.0 255.0 ECU_ADDRESS 0x7FC124 /begin FUNCTION_LIST LAYER /end FUNCTION_LIST BIT_MASK 0x2 /end MEASUREMENT
/begin MEASUREMENT St_ozbg0 "Statuswort" UBYTE Def_st_ub_q1 0 0 0.0 255.0000 ECU_ADDRESS 0x7FDEA2 /begin FUNCTION_LIST OZBG /end FUNCTION_LIST /end MEASUREMENT
/begin MEASUREMENT St_ozbg0.B_bosmsgc "Bedingung für Absetzen einer BOS-Meldung" UBYTE Def_bit_ub_0 0 0 0.0 255.0 ECU_ADDRESS 0x7FDEA2 /begin FUNCTION_LIST OZBG /end FUNCTION_LIST BIT_MASK 0x1 /end MEASUREMENT
/begin MEASUREMENT St_ozbg0.B_mol_vb "Bedingung Ölverbrauchswarnung" UBYTE Def_bit_ub_1 0 0 0.0 255.0 ECU_ADDRESS 0x7FDEA2 /begin FUNCTION_LIST OZBG /end FUNCTION_LIST BIT_MASK 0x2 /end MEASUREMENT
/begin MEASUREMENT St_ozbg0.B_mol_vl "Bedingung Ölverlustwarnung" UBYTE Def_bit_ub_2 0 0 0.0 255.0 ECU_ADDRESS 0x7FDEA2 /begin FUNCTION_LIST OZBG /end FUNCTION_LIST BIT_MASK 0x4 /end MEASUREMENT
/begin MEASUREMENT St_ozbg0.B_oeltemp "Bedingung für CAN-Ausgabe der Öltemperatur" UBYTE Def_bit_ub_3 0 0 0.0 255.0 ECU_ADDRESS 0x7FDEA2 /begin FUNCTION_LIST OZBG /end FUNCTION_LIST BIT_MASK 0x8 /end MEASUREMENT
/begin MEASUREMENT St_ozbg0.B_oelverb "" UBYTE Def_bit_ub_4 0 0 0.0 255.0 ECU_ADDRESS 0x7FDEA2 /begin FUNCTION_LIST OZBG /end FUNCTION_LIST BIT_MASK 0x10 /end MEASUREMENT
/begin MEASUREMENT St_ozbg0.B_oelverl "" UBYTE Def_bit_ub_5 0 0 0.0 255.0 ECU_ADDRESS 0x7FDEA2 /begin FUNCTION_LIST OZBG /end FUNCTION_LIST BIT_MASK 0x20 /end MEASUREMENT
/begin MEASUREMENT St_ozbg_nv0 "Statuswort" UBYTE Def_st_ub_q1 0 0 0.0 255.0000 ECU_ADDRESS 0x7FDE88 /begin FUNCTION_LIST OZBG /end FUNCTION_LIST /end MEASUREMENT
/begin MEASUREMENT St_ozbg_nv0.B_ozkl15 "Merker für Einschalten Kl. 15" UBYTE Def_bit_ub_0 0 0 0.0 255.0 ECU_ADDRESS 0x7FDE88 /begin FUNCTION_LIST OZBG /end FUNCTION_LIST BIT_MASK 0x1 /end MEASUREMENT
/begin MEASUREMENT St_pmbnstab "Status pmbnstab" UBYTE Def_st_ub_q1 0 0 0.0 255.0000 ECU_ADDRESS 0x7FD973 /begin FUNCTION_LIST LAYER /end FUNCTION_LIST /end MEASUREMENT
/begin MEASUREMENT St_pmbnstab.B_nachlend "Bedingung Nachlauf beendet" UBYTE Def_bit_ub_0 0 0 0.0 255.0 ECU_ADDRESS 0x7FD973 /begin FUNCTION_LIST LAYER /end FUNCTION_LIST BIT_MASK 0x1 /end MEASUREMENT
/begin MEASUREMENT St_pmi "Statuswort Eingänge LCP" UBYTE Def_dez_ub_q1 0 0 0.0 255.0000 ECU_ADDRESS 0x7FC188 /begin FUNCTION_LIST LAYER /end FUNCTION_LIST /end MEASUREMENT
/begin MEASUREMENT St_pmi.B_fabttreg "Bedingung Batterietausch registrieren" UBYTE Def_bit_ub_1 0 0 0.0 255.0 ECU_ADDRESS 0x7FC188 /begin FUNCTION_LIST LAYER /end FUNCTION_LIST BIT_MASK 0x2 /end MEASUREMENT
/begin MEASUREMENT St_pmi.B_fahisrst "Bedingung Histogramm Reset" UBYTE Def_bit_ub_2 0 0 0.0 255.0 ECU_ADDRESS 0x7FC188 /begin FUNCTION_LIST LAYER /end FUNCTION_LIST BIT_MASK 0x4 /end MEASUREMENT
/begin MEASUREMENT St_pmi_nv "Status pmi_nv" UBYTE Def_st_ub_q1 0 0 0.0 255.0000 ECU_ADDRESS 0x7FD974 /begin FUNCTION_LIST LAYER /end FUNCTION_LIST /end MEASUREMENT
/begin MEASUREMENT St_pmi_nv.B_fapmmess "Bedingung Messmethode PM" UBYTE Def_bit_ub_0 0 0 0.0 255.0 ECU_ADDRESS 0x7FD974 /begin FUNCTION_LIST LAYER /end FUNCTION_LIST BIT_MASK 0x1 /end MEASUREMENT
/begin MEASUREMENT St_pmi_nv.B_ulcp "Bedingung ULCP aktiv" UBYTE Def_bit_ub_1 0 0 0.0 255.0 ECU_ADDRESS 0x7FD974 /begin FUNCTION_LIST LAYER /end FUNCTION_LIST BIT_MASK 0x2 /end MEASUREMENT
/begin MEASUREMENT St_pwf "Statuswert fuer Power-fail" UBYTE Def_st_ub_q1 0 0 0.0 255.0000 ECU_ADDRESS 0x7FC189 /begin FUNCTION_LIST LAYER /end FUNCTION_LIST /end MEASUREMENT
/begin MEASUREMENT St_pwf.B_pwf "Bedingung Powerfail" UBYTE Def_bit_ub_0 0 0 0.0 255.0 ECU_ADDRESS 0x7FC189 /begin FUNCTION_LIST LAYER /end FUNCTION_LIST BIT_MASK 0x1 /end MEASUREMENT
/begin MEASUREMENT St_sawe "Statusbyte Schubabschaltung/Wiedereinsetzen" UBYTE Def_st_ub_q1 0 0 0.0 255.0000 ECU_ADDRESS 0x7FC18A /begin FUNCTION_LIST LAYER /end FUNCTION_LIST /end MEASUREMENT
/begin MEASUREMENT St_sawe.B_sa "Bedingung Schubabschaltung" UBYTE Def_bit_ub_3 0 0 0.0 255.0 ECU_ADDRESS 0x7FC18A /begin FUNCTION_LIST LAYER /end FUNCTION_LIST BIT_MASK 0x8 /end MEASUREMENT
/begin MEASUREMENT St_sleep "Statuswort Einschlafverhalten" UBYTE Def_st_ub_q1 0 0 0.0 255.0000 ECU_ADDRESS 0x7FD908 /begin FUNCTION_LIST KT_IBS /end FUNCTION_LIST /end MEASUREMENT
/begin MEASUREMENT St_sleep.B_sleepwait "Signal Verzoegerung Sleep Indication" UBYTE Def_bit_ub_0 0 0 0.0 255.0 ECU_ADDRESS 0x7FD908 /begin FUNCTION_LIST KT_IBS /end FUNCTION_LIST BIT_MASK 0x1 /end MEASUREMENT
/begin MEASUREMENT St_slp "Statusbyte Sekundärluftpumpe" UBYTE Def_st_ub_q1 0 0 0.0 255.0000 ECU_ADDRESS 0x7FC18B /begin FUNCTION_LIST LAYER /end FUNCTION_LIST /end MEASUREMENT
/begin MEASUREMENT St_slp.B_fasls "Bed. Funktionsanf Sekundärluftsystem" UBYTE Def_bit_ub_0 0 0 0.0 255.0 ECU_ADDRESS 0x7FC18B /begin FUNCTION_LIST LAYER /end FUNCTION_LIST BIT_MASK 0x1 /end MEASUREMENT
/begin MEASUREMENT St_slp.B_genslp "Bedingung Spannungsanforderung Sekundärluftpumpe" UBYTE Def_bit_ub_2 0 0 0.0 255.0 ECU_ADDRESS 0x7FC18B /begin FUNCTION_LIST LAYER /end FUNCTION_LIST BIT_MASK 0x4 /end MEASUREMENT
/begin MEASUREMENT St_sls "Statuswort Sekundärluftsystem" UBYTE Def_dez_ub_q1 0 0 0.0 255.0000 ECU_ADDRESS 0x7FC18C /begin FUNCTION_LIST LAYER /end FUNCTION_LIST /end MEASUREMENT
/begin MEASUREMENT St_sls.B_sls "Bedingung Sekundärluftsystem aktiv" UBYTE Def_bit_ub_0 0 0 0.0 255.0 ECU_ADDRESS 0x7FC18C /begin FUNCTION_LIST LAYER /end FUNCTION_LIST BIT_MASK 0x1 /end MEASUREMENT
/begin MEASUREMENT St_start "Status Start" UBYTE Def_st_ub_q1 0 0 0.0 255.0000 ECU_ADDRESS 0x7FD970 /begin FUNCTION_LIST LAYER /end FUNCTION_LIST /end MEASUREMENT
/begin MEASUREMENT St_start.B_sta "Bedingung Automatikstart" UBYTE Def_bit_ub_7 0 0 0.0 255.0 ECU_ADDRESS 0x7FD970 /begin FUNCTION_LIST LAYER /end FUNCTION_LIST BIT_MASK 0x80 /end MEASUREMENT
/begin MEASUREMENT St_start.B_startende "Bedingung Startende" UBYTE Def_bit_ub_3 0 0 0.0 255.0 ECU_ADDRESS 0x7FD970 /begin FUNCTION_LIST LAYER /end FUNCTION_LIST BIT_MASK 0x8 /end MEASUREMENT
/begin MEASUREMENT St_tan "Statuswort" UBYTE Def_st_ub_q1 0 0 0.0 255.0000 ECU_ADDRESS 0x7FD99D /begin FUNCTION_LIST LBATTCAL /end FUNCTION_LIST /end MEASUREMENT
/begin MEASUREMENT St_tan.B_taners "Bedingung für Startwertberechnung" UBYTE Def_bit_ub_0 0 0 0.0 255.0 ECU_ADDRESS 0x7FD99D /begin FUNCTION_LIST LBATTCAL /end FUNCTION_LIST BIT_MASK 0x1 /end MEASUREMENT
/begin MEASUREMENT St_tum "Statuswort tum" UBYTE Def_dez_ub_q1 0 0 0.0 255.0000 ECU_ADDRESS 0x7FC123 /begin FUNCTION_LIST LAYER /end FUNCTION_LIST /end MEASUREMENT
/begin MEASUREMENT St_tum.B_tumers "Bedingung Umgebungstemperaturersatzwert" UBYTE Def_bit_ub_0 0 0 0.0 255.0 ECU_ADDRESS 0x7FC123 /begin FUNCTION_LIST LAYER /end FUNCTION_LIST BIT_MASK 0x1 /end MEASUREMENT
/begin MEASUREMENT St_zwktibs "Statuswort zwktibs" UBYTE Def_dez_ub_q1 0 0 0.0 255.0000 ECU_ADDRESS 0x7FC18D /begin FUNCTION_LIST LAYER /end FUNCTION_LIST /end MEASUREMENT
/begin MEASUREMENT St_zwktibs.B_ibsactiv "Bedingung Kommunikation mit IBS vorhanden" UBYTE Def_bit_ub_0 0 0 0.0 255.0 ECU_ADDRESS 0x7FC18D /begin FUNCTION_LIST LAYER /end FUNCTION_LIST BIT_MASK 0x1 /end MEASUREMENT
/begin MEASUREMENT T1histiruh "Ruhestromhistogramm Klasse 1" UWORD Def_dez_uw_q1 0 0 0.0 65535.0000 ECU_ADDRESS 0x7FD8DC /begin FUNCTION_LIST KT_IBS /end FUNCTION_LIST /end MEASUREMENT
/begin MEASUREMENT T2histiruh "Ruhestromhistogramm Klasse 2" UWORD Def_dez_uw_q1 0 0 0.0 65535.0000 ECU_ADDRESS 0x7FD8DE /begin FUNCTION_LIST KT_IBS /end FUNCTION_LIST /end MEASUREMENT
/begin MEASUREMENT T3histiruh "Ruhestromhistogramm Klasse 3" UWORD Def_dez_uw_q1 0 0 0.0 65535.0000 ECU_ADDRESS 0x7FD8E0 /begin FUNCTION_LIST KT_IBS /end FUNCTION_LIST /end MEASUREMENT
/begin MEASUREMENT T4histiruh "Ruhestromhistogramm Klasse 4" UWORD Def_dez_uw_q1 0 0 0.0 65535.0000 ECU_ADDRESS 0x7FD8E2 /begin FUNCTION_LIST KT_IBS /end FUNCTION_LIST /end MEASUREMENT
/begin MEASUREMENT T_batstiniv "Starttemperatur Batterie vorne" SWORD Def_t_sw_q0p1 0 0 -3276.8000 3276.7000 ECU_ADDRESS 0x7FD98C /begin FUNCTION_LIST LBATTCAL /end FUNCTION_LIST /end MEASUREMENT
/begin MEASUREMENT T_batt_ibs "Batterietemperatur" SWORD Def_t_sw_q0p1 0 0 -3276.8000 3276.7000 ECU_ADDRESS 0x7FD8E4 /begin FUNCTION_LIST KT_IBS /end FUNCTION_LIST /end MEASUREMENT
/begin MEASUREMENT T_batt_ini "Startwert Batterietemperatur" SWORD Def_t_sw_q0p1 0 0 -3276.8000 3276.7000 ECU_ADDRESS 0x7FD98E /begin FUNCTION_LIST LBATTCAL /end FUNCTION_LIST /end MEASUREMENT
/begin MEASUREMENT T_batt_lb "Batterietemperatur" SWORD Def_t_sw_q0p1 0 0 -3276.8000 3276.7000 ECU_ADDRESS 0x7FD986 /begin FUNCTION_LIST LBATTCAL /end FUNCTION_LIST /end MEASUREMENT
/begin MEASUREMENT T_batt_max "Maximale Batt. Temperatur bei Stillstand" SWORD Def_t_sw_q0p1 0 0 -3276.8000 3276.7000 ECU_ADDRESS 0x7FD8E6 /begin FUNCTION_LIST KT_IBS /end FUNCTION_LIST /end MEASUREMENT
/begin MEASUREMENT T_batt_min "Minimale Batt. Temperatur bei Stillstand" SWORD Def_t_sw_q0p1 0 0 -3276.8000 3276.7000 ECU_ADDRESS 0x7FD8E8 /begin FUNCTION_LIST KT_IBS /end FUNCTION_LIST /end MEASUREMENT
/begin MEASUREMENT T_batt_zw "Temporäre Batterietemperatur" SWORD Def_t_sw_q0p1 0 0 -3276.8000 3276.7000 ECU_ADDRESS 0x7FD990 /begin FUNCTION_LIST LBATTCAL /end FUNCTION_LIST /end MEASUREMENT
/begin MEASUREMENT T_batt_zw2 "Temporäre Zwischengroesse" SWORD Def_t_sw_q0p1 0 0 -3276.8000 3276.7000 ECU_ADDRESS 0x7FD992 /begin FUNCTION_LIST LBATTCAL /end FUNCTION_LIST /end MEASUREMENT
/begin MEASUREMENT T_batt_zw3 "" SWORD Def_t_sw_q0p1 0 0 -3276.8000 3276.7000 ECU_ADDRESS 0x7FD994 /begin FUNCTION_LIST LBATTCAL /end FUNCTION_LIST /end MEASUREMENT
/begin MEASUREMENT T_battabst "Batterieabstelltemperatur" SWORD Def_t_sw_q0p1 0 0 -3276.8000 3276.7000 ECU_ADDRESS 0x7FD976 /begin FUNCTION_LIST LBATTCAL /end FUNCTION_LIST /end MEASUREMENT
/begin MEASUREMENT T_battsoc0 "Batterietemperatur bei Ruhespannungsmessung" SWORD Def_t_sw_q0p1 0 0 -3276.8000 3276.7000 ECU_ADDRESS 0x7FD8C8 /begin FUNCTION_LIST KT_IBS /end FUNCTION_LIST /end MEASUREMENT
/begin MEASUREMENT T_battsoci "T_battsoc0, Rohwert aus IBS" UBYTE Def_dez_ub_q1 0 0 0.0 255.0000 ECU_ADDRESS 0x7FD91F /begin FUNCTION_LIST KT_IBS /end FUNCTION_LIST /end MEASUREMENT
/begin MEASUREMENT T_jahr "Borddatum" UWORD Def_dez_uw_q1 0 0 0.0 65535.0000 ECU_ADDRESS 0x7FC128 /begin FUNCTION_LIST LAYER /end FUNCTION_LIST /end MEASUREMENT
/begin MEASUREMENT T_monate "Borddatum" UBYTE Def_dez_ub_q1 0 0 0.0 255.0000 ECU_ADDRESS 0x7FC12C /begin FUNCTION_LIST LAYER /end FUNCTION_LIST /end MEASUREMENT
/begin MEASUREMENT T_tag "Borddatum" UBYTE Def_dez_ub_q1 0 0 0.0 255.0000 ECU_ADDRESS 0x7FC12D /begin FUNCTION_LIST LAYER /end FUNCTION_LIST /end MEASUREMENT
/begin MEASUREMENT Tans "Ansauglufttemperatur" SWORD Def_t_sw_q0p1 0 0 -3276.8000 3276.7000 ECU_ADDRESS 0x7FC18E /begin FUNCTION_LIST LAYER /end FUNCTION_LIST /end MEASUREMENT
/begin MEASUREMENT Tbatt_maxi "T_batt_max, Rohwert aus IBS" UBYTE Def_dez_ub_q1 0 0 0.0 255.0000 ECU_ADDRESS 0x7FD920 /begin FUNCTION_LIST KT_IBS /end FUNCTION_LIST /end MEASUREMENT
/begin MEASUREMENT Tbatt_mini "T_batt_min, Rohwert aus IBS" UBYTE Def_dez_ub_q1 0 0 0.0 255.0000 ECU_ADDRESS 0x7FD921 /begin FUNCTION_LIST KT_IBS /end FUNCTION_LIST /end MEASUREMENT
/begin MEASUREMENT Tchip "Chiptemperatur Generator1" SWORD Def_t_sw_q0p1 0 0 -3276.8000 3276.7000 ECU_ADDRESS 0x7FC190 /begin FUNCTION_LIST LAYER /end FUNCTION_LIST /end MEASUREMENT
/begin MEASUREMENT Tchip2 "Chiptemperatur Generator2" SWORD Def_t_sw_q0p1 0 0 -3276.8000 3276.7000 ECU_ADDRESS 0x7FC192 /begin FUNCTION_LIST LAYER /end FUNCTION_LIST /end MEASUREMENT
/begin MEASUREMENT Td_f_ierr "Filterzeit Erregerstrom aus BSD-Timingkoordinator" UBYTE Def_td_ub_q0p01 0 0 0.0 2.5500 ECU_ADDRESS 0x7FC194 /begin FUNCTION_LIST LAYER /end FUNCTION_LIST /end MEASUREMENT
/begin MEASUREMENT Td_og_cnt "Zähler für fallende Flanken im Töns Signal" UBYTE Def_dez_ub_q1 0 0 0.0 255.0000 ECU_ADDRESS 0x7FC114 /begin FUNCTION_LIST LAYER /end FUNCTION_LIST /end MEASUREMENT
/begin MEASUREMENT Td_og_icnt "Zeit zwischen 2 fallenden Flanken" UWORD Def_dez_uw_q1 0 0 0.0 65535.0000 ECU_ADDRESS 0x7FC116 /begin FUNCTION_LIST LAYER /end FUNCTION_LIST /end MEASUREMENT
/begin MEASUREMENT Td_og_tk "Abkühlzeit vom TÖNS" UWORD Def_td_uw_q0p1 0 0 0.0 6553.5000 ECU_ADDRESS 0x7FC118 /begin FUNCTION_LIST LAYER /end FUNCTION_LIST /end MEASUREMENT
/begin MEASUREMENT Td_og_tr "Referntzeit" UWORD Def_td_uw_q0p1 0 0 0.0 6553.5000 ECU_ADDRESS 0x7FC11A /begin FUNCTION_LIST LAYER /end FUNCTION_LIST /end MEASUREMENT
/begin MEASUREMENT Td_og_tv "Abkühlzeit Vom TÖNS" UWORD Def_td_uw_q0p1 0 0 0.0 6553.5000 ECU_ADDRESS 0x7FC11C /begin FUNCTION_LIST LAYER /end FUNCTION_LIST /end MEASUREMENT
/begin MEASUREMENT Td_og_uplcnt "Zähler für unplausible Signale" UBYTE Def_dez_ub_q1 0 0 0.0 255.0000 ECU_ADDRESS 0x7FC11E /begin FUNCTION_LIST LAYER /end FUNCTION_LIST /end MEASUREMENT
/begin MEASUREMENT Td_rdgenreg2 "Auslesezeit für DF-Signal und Diagnose" UBYTE Def_td_ub_q0p1 0 0 0.0 25.5000 ECU_ADDRESS 0x7FC195 /begin FUNCTION_LIST LAYER /end FUNCTION_LIST /end MEASUREMENT
/begin MEASUREMENT Tgen "Generatortemperatur" SWORD Def_t_sw_q0p1 0 0 -3276.8000 3276.7000 ECU_ADDRESS 0x7FD870 /begin FUNCTION_LIST IMDGEN_1PR /end FUNCTION_LIST /end MEASUREMENT
/begin MEASUREMENT Tgen_ab "Abstelltemperatur Generator" SWORD Def_t_sw_q0p1 0 0 -3276.8000 3276.7000 ECU_ADDRESS 0x7FD86A /begin FUNCTION_LIST IMDGEN_1PR /end FUNCTION_LIST /end MEASUREMENT
/begin MEASUREMENT Tgen_dt "Temperaturdifferenz zwischen Abstelltemperatur und Umgebungstemperatur" SWORD Def_t_sw_q0p1 0 0 -48.0000 384.0000 ECU_ADDRESS 0x7FD888 /begin FUNCTION_LIST IMDGEN_1PR /end FUNCTION_LIST /end MEASUREMENT
/begin MEASUREMENT Tgen_end "Generatortemperatur endgültig" SWORD Def_t_sw_q0p1 0 0 -3276.8000 3276.7000 ECU_ADDRESS 0x7FD872 /begin FUNCTION_LIST IMDGEN_1PR /end FUNCTION_LIST /end MEASUREMENT
/begin MEASUREMENT Tgen_exp "Delta Abkühltemperatur" SWORD Def_t_sw_q0p1 0 0 -48.0000 384.0000 ECU_ADDRESS 0x7FD88A /begin FUNCTION_LIST IMDGEN_1PR /end FUNCTION_LIST /end MEASUREMENT
/begin MEASUREMENT Tgen_fil "gefilterte Generatortemperatur" SWORD Def_t_sw_q0p1 0 0 -3276.8000 3276.7000 ECU_ADDRESS 0x7FD88C /begin FUNCTION_LIST IMDGEN_1PR /end FUNCTION_LIST /end MEASUREMENT
/begin MEASUREMENT Tkat_mod "Modellierte Katalysatortemperatur" SWORD Def_t_sw_q0p1 0 0 -3276.8000 3276.7000 ECU_ADDRESS 0x7FC196 /begin FUNCTION_LIST LAYER /end FUNCTION_LIST /end MEASUREMENT
/begin MEASUREMENT Tlrfgen "Kopier Generator1 LR Vorgabe auf Bus gelegt" UBYTE Def_td_ub_q0p1 0 0 0.0 25.5000 ECU_ADDRESS 0x7FC198 /begin FUNCTION_LIST LAYER /end FUNCTION_LIST /end MEASUREMENT
/begin MEASUREMENT Tlrfgen2 "Kopier Generator2 LR Vorgabe auf Bus gelegt" UBYTE Def_td_ub_q0p1 0 0 0.0 25.5000 ECU_ADDRESS 0x7FC199 /begin FUNCTION_LIST LAYER /end FUNCTION_LIST /end MEASUREMENT
/begin MEASUREMENT Tlrgen "Sollwert Load- Response- Zeit Generator" UBYTE Def_td_ub_q0p1 0 0 0.0 25.5000 ECU_ADDRESS 0x7FD9BA /begin FUNCTION_LIST LOADRESP /end FUNCTION_LIST /end MEASUREMENT
/begin MEASUREMENT Tlrgen2 "Sollwert Load- Response- Zeit Generator2" UBYTE Def_td_ub_q0p1 0 0 0.0 25.5000 ECU_ADDRESS 0x7FD9BB /begin FUNCTION_LIST LOADRESP /end FUNCTION_LIST /end MEASUREMENT
/begin MEASUREMENT Tmot "Kühlwassertemperatur" SWORD Def_t_sw_q0p01 0 0 -327.6800 327.6700 ECU_ADDRESS 0x7FC19A /begin FUNCTION_LIST LAYER /end FUNCTION_LIST /end MEASUREMENT
/begin MEASUREMENT Tmot_abstell "Motorstarttemperatur" SWORD Def_t_sw_q0p01 0 0 -327.6800 327.6700 ECU_ADDRESS 0x7FD960 /begin FUNCTION_LIST LAYER /end FUNCTION_LIST /end MEASUREMENT
/begin MEASUREMENT Tmot_start "Motorstarttemperatur" SWORD Def_t_sw_q0p01 0 0 -327.6800 327.6700 ECU_ADDRESS 0x7FC19C /begin FUNCTION_LIST LAYER /end FUNCTION_LIST /end MEASUREMENT
/begin MEASUREMENT Tn_abstell "Abstellzeit" UWORD Def_dez_uw_q1 0 0 0.0 65535.0000 ECU_ADDRESS 0x7FC1A0 /begin FUNCTION_LIST LAYER /end FUNCTION_LIST /end MEASUREMENT
/begin MEASUREMENT Tn_abstellm "Abstellzeit in Minuten" UWORD Def_dez_uw_q1 0 0 0.0 65535.0000 ECU_ADDRESS 0x7FD962 /begin FUNCTION_LIST LAYER /end FUNCTION_LIST /end MEASUREMENT
/begin MEASUREMENT Tn_start_10 "Zeit nach Startende in 10ms aufgelöst" UWORD Def_td_uw_q0p01 0 0 0.0 655.3500 ECU_ADDRESS 0x7FC19E /begin FUNCTION_LIST LAYER /end FUNCTION_LIST /end MEASUREMENT
/begin MEASUREMENT Toel "Ausgabewert Motoröltemperatur für LoCAN" SWORD Def_t_sw_q0p1 0 0 -3276.8000 3276.7000 ECU_ADDRESS 0x7FDE98 /begin FUNCTION_LIST OZBG /end FUNCTION_LIST /end MEASUREMENT
/begin MEASUREMENT Toel_mdl "Modelltemperatur Motoröl" SWORD Def_t_sw_q0p1 0 0 -3276.8000 3276.7000 ECU_ADDRESS 0x7FC120 /begin FUNCTION_LIST LAYER /end FUNCTION_LIST /end MEASUREMENT
/begin MEASUREMENT Toel_oz "Ausgabe Öltemperatur" SWORD Def_t_sw_q0p1 0 0 -3276.8000 3276.7000 ECU_ADDRESS 0x7FDE9A /begin FUNCTION_LIST OZBG /end FUNCTION_LIST /end MEASUREMENT
/begin MEASUREMENT Tst_countv "Testcounter-Wert" UWORD Def_st_uw_q1 0 0 0.0 65535.0000 ECU_ADDRESS 0x7FD89C /begin FUNCTION_LIST IMDGEN_1PR /end FUNCTION_LIST /end MEASUREMENT
/begin MEASUREMENT Tst_fil_out "Testfilter Ausgang" UWORD Def_t_uw_q0p075 0 0 0.0 768.0000 ECU_ADDRESS 0x7FD89E /begin FUNCTION_LIST IMDGEN_1PR /end FUNCTION_LIST /end MEASUREMENT
/begin MEASUREMENT Tumg "Umgebungstemperatur" SWORD Def_t_sw_q0p1 0 0 -3276.8000 3276.7000 ECU_ADDRESS 0x7FC1A2 /begin FUNCTION_LIST LAYER /end FUNCTION_LIST /end MEASUREMENT
/begin MEASUREMENT Tumg_abst "Abstell-Aussentemperatur" SWORD Def_t_sw_q0p1 0 0 -3276.8000 3276.7000 ECU_ADDRESS 0x7FD978 /begin FUNCTION_LIST LBATTCAL /end FUNCTION_LIST /end MEASUREMENT
/begin MEASUREMENT Tumg_battab "Abstell-Umgebungstemperatur Batterie" SWORD Def_t_sw_q0p1 0 0 -3276.8000 3276.7000 ECU_ADDRESS 0x7FD97A /begin FUNCTION_LIST LBATTCAL /end FUNCTION_LIST /end MEASUREMENT
/begin MEASUREMENT Tumg_can "Umgebungstemperatur" SWORD Def_t_sw_q0p1 0 0 -3276.8000 3276.7000 ECU_ADDRESS 0x7FC1A4 /begin FUNCTION_LIST LAYER /end FUNCTION_LIST /end MEASUREMENT
/begin MEASUREMENT Tumg_dt "Temporäre zwischengroesse" SWORD Def_t_sw_q0p1 0 0 -3276.8000 3276.7000 ECU_ADDRESS 0x7FD996 /begin FUNCTION_LIST LBATTCAL /end FUNCTION_LIST /end MEASUREMENT
/begin MEASUREMENT Tumg_ers "Aussentemperatur oder Ersatzwert" SWORD Def_t_sw_q0p1 0 0 -3276.8000 3276.7000 ECU_ADDRESS 0x7FD988 /begin FUNCTION_LIST LBATTCAL /end FUNCTION_LIST /end MEASUREMENT
/begin MEASUREMENT Tumg_tp "" SWORD Def_t_sw_q0p1 0 0 -3276.8000 3276.7000 ECU_ADDRESS 0x7FD998 /begin FUNCTION_LIST LBATTCAL /end FUNCTION_LIST /end MEASUREMENT
/begin MEASUREMENT Tv_agr "Tastverhältnis AGR-Steller" SWORD Def_tv_sw_q0p01 0 0 -327.6800 327.6700 ECU_ADDRESS 0x7FC1D2 /begin FUNCTION_LIST LAYER /end FUNCTION_LIST /end MEASUREMENT
/begin MEASUREMENT Tv_agr_n "Tastverhältnis AGR-Steller normiert" UBYTE Def_f_ub_b2 0 0 0.0 1.9921 ECU_ADDRESS 0x7FDE83 /begin FUNCTION_LIST MANDETEK /end FUNCTION_LIST /end MEASUREMENT
/begin MEASUREMENT Tv_pld "Tastverhältnis Ladedrucksteller" SWORD Def_tv_sw_q0p01 0 0 -327.6800 327.6700 ECU_ADDRESS 0x7FC1D0 /begin FUNCTION_LIST LAYER /end FUNCTION_LIST /end MEASUREMENT
/begin MEASUREMENT Tv_pld_n "Tastverhältnis Ladedrucksteller normiert" UBYTE Def_f_ub_b2 0 0 0.0 1.9921 ECU_ADDRESS 0x7FDE84 /begin FUNCTION_LIST MANDETEK /end FUNCTION_LIST /end MEASUREMENT
/begin MEASUREMENT Tw "Tuningwahrscheinlichkeit" UWORD Def_f_uw_b100 0 0 0.0 99.9984 ECU_ADDRESS 0x7FD9C8 /begin FUNCTION_LIST MANDETEK /end FUNCTION_LIST /end MEASUREMENT
/begin MEASUREMENT Twhydr "Tuningwahrscheinlichkeit Hydraulikpfad" UWORD Def_f_uw_b100 0 0 0.0 99.9984 ECU_ADDRESS 0x7FD9CA /begin FUNCTION_LIST MANDETEK /end FUNCTION_LIST /end MEASUREMENT
/begin MEASUREMENT Twhydrcnt "Tuningwahrscheinlichkeitszähler Hydraulokpfad" UWORD Def_dez_uw_q1 0 0 0.0 65535.0000 ECU_ADDRESS 0x7FD9CC /begin FUNCTION_LIST MANDETEK /end FUNCTION_LIST /end MEASUREMENT
/begin MEASUREMENT Twhydrcntg "Zähler Tuningwahrscheinlichk Hydraulikpfad gesamt" ULONG Def_dez_ul_q1 0 0 1.0000 4294967295.0000 ECU_ADDRESS 0x7FD9C0 /begin FUNCTION_LIST MANDETEK /end FUNCTION_LIST /end MEASUREMENT
/begin MEASUREMENT Twluft "Tuningwahrscheinlichkeit Luftpfad" UWORD Def_f_uw_b100 0 0 0.0 99.9984 ECU_ADDRESS 0x7FD9CE /begin FUNCTION_LIST MANDETEK /end FUNCTION_LIST /end MEASUREMENT
/begin MEASUREMENT Twluftcnt "Tuningwahrscheinlichkeitszähler Luftpfad" UWORD Def_dez_uw_q1 0 0 0.0 65535.0000 ECU_ADDRESS 0x7FD9D0 /begin FUNCTION_LIST MANDETEK /end FUNCTION_LIST /end MEASUREMENT
/begin MEASUREMENT Twluftcntg "Zähler Tuningwahrscheinlichkeit Luftpfad gesamt" ULONG Def_dez_ul_q1 0 0 1.0000 4294967264.0000 ECU_ADDRESS 0x7FD9C4 /begin FUNCTION_LIST MANDETEK /end FUNCTION_LIST /end MEASUREMENT
/begin MEASUREMENT U1soc0 "Ruhespannung 1" UWORD Def_u_uw_q0p25em3_o6 0 0 6.0000 22.3837 ECU_ADDRESS 0x7FD8CA /begin FUNCTION_LIST KT_IBS /end FUNCTION_LIST /end MEASUREMENT
/begin MEASUREMENT U2soc0 "Ruhespannung 1" UWORD Def_u_uw_q0p25em3_o6 0 0 6.0000 22.3837 ECU_ADDRESS 0x7FD8CC /begin FUNCTION_LIST KT_IBS /end FUNCTION_LIST /end MEASUREMENT
/begin MEASUREMENT U3soc0 "Ruhespannung 1" UWORD Def_u_uw_q0p25em3_o6 0 0 6.0000 22.3837 ECU_ADDRESS 0x7FD8CE /begin FUNCTION_LIST KT_IBS /end FUNCTION_LIST /end MEASUREMENT
/begin MEASUREMENT U_batt "Batteriespannung von IBS gemessen" UWORD Def_u_uw_q0p25em3_o6 0 0 6.0000 22.3837 ECU_ADDRESS 0x7FD8B8 /begin FUNCTION_LIST KT_IBS /end FUNCTION_LIST /end MEASUREMENT
/begin MEASUREMENT U_fgen "Kopierter Wert von zum Generator gesendete Sollspannung Generator 1" UWORD Def_u_uw_q0p1 0 0 0.0 6553.5000 ECU_ADDRESS 0x7FC1A6 /begin FUNCTION_LIST LAYER /end FUNCTION_LIST /end MEASUREMENT
/begin MEASUREMENT U_fgen2 "Kopierter Wert von zum Generator gesendete Sollspannung Generator 2" UWORD Def_u_uw_q0p1 0 0 0.0 6553.5000 ECU_ADDRESS 0x7FC1A8 /begin FUNCTION_LIST LAYER /end FUNCTION_LIST /end MEASUREMENT
/begin MEASUREMENT U_gen_slp "Spannungsanforderung Sekundärluftpumpe" UWORD Def_u_uw_q0p1 0 0 0.0 6553.5000 ECU_ADDRESS 0x7FC1AA /begin FUNCTION_LIST LAYER /end FUNCTION_LIST /end MEASUREMENT
/begin MEASUREMENT U_gensollm "Generatorsollspannung" SWORD Def_u_sw_b128 0 0 -128.0000 127.9960 ECU_ADDRESS 0x7FD98A /begin FUNCTION_LIST LBATTCAL /end FUNCTION_LIST /end MEASUREMENT
/begin MEASUREMENT U_gensollpm "Sollwert Spannung vom Powermodul" SWORD Def_u_sw_b128 0 0 -128.0000 127.9960 ECU_ADDRESS 0x7FC1AE /begin FUNCTION_LIST LAYER /end FUNCTION_LIST /end MEASUREMENT
/begin MEASUREMENT U_kompk "Zwischengröße" UWORD Def_u_uw_q0p0942 0 0 0.0 6173.3970 ECU_ADDRESS 0x7FD97E /begin FUNCTION_LIST LBATTCAL /end FUNCTION_LIST /end MEASUREMENT
/begin MEASUREMENT U_kompm "Zwischengröße" UWORD Def_u_uw_q0p0942 0 0 0.0 94.2000 ECU_ADDRESS 0x7FD980 /begin FUNCTION_LIST LBATTCAL /end FUNCTION_LIST /end MEASUREMENT
/begin MEASUREMENT U_lade "Zwischengröße" SWORD Def_u_sw_b128 0 0 0.0 127.9960 ECU_ADDRESS 0x7FD97C /begin FUNCTION_LIST LBATTCAL /end FUNCTION_LIST /end MEASUREMENT
/begin MEASUREMENT U_tnstart "Spannung im Start" UWORD Def_u_uw_q0p25em3_o6 0 0 6.0000 22.3837 ECU_ADDRESS 0x7FD8D6 /begin FUNCTION_LIST KT_IBS /end FUNCTION_LIST /end MEASUREMENT
/begin MEASUREMENT U_vorstart "Spannung vor Start" UWORD Def_u_uw_q0p25em3_o6 0 0 6.0000 22.3837 ECU_ADDRESS 0x7FD8D4 /begin FUNCTION_LIST KT_IBS /end FUNCTION_LIST /end MEASUREMENT
/begin MEASUREMENT Ub "Bordnetzspannung" UWORD Def_u_uw_q0p0942 0 0 0.0 6173.3970 ECU_ADDRESS 0x7FC1AC /begin FUNCTION_LIST LAYER /end FUNCTION_LIST /end MEASUREMENT
/begin MEASUREMENT Unind "EBSD Puffer Index" UBYTE Def_dez_ub_q1 0 0 0.0 255.0000 ECU_ADDRESS 0x7FD924 /begin FUNCTION_LIST KT_IBS /end FUNCTION_LIST /end MEASUREMENT
/begin MEASUREMENT Uregnom "Nominalspannung Regler Generator 1" UWORD Def_u_uw_q0p1 0 0 0.0 6553.5000 ECU_ADDRESS 0x7FC1B0 /begin FUNCTION_LIST LAYER /end FUNCTION_LIST /end MEASUREMENT
/begin MEASUREMENT Uregnom2 "Nominalspannung Regler Generator 2" UWORD Def_u_uw_q0p1 0 0 0.0 6553.5000 ECU_ADDRESS 0x7FC1B2 /begin FUNCTION_LIST LAYER /end FUNCTION_LIST /end MEASUREMENT
/begin MEASUREMENT V "Fahrzeuggeschwindigkeit" UWORD Def_v_uw_q1p0 0 0 0.0 360.0000 ECU_ADDRESS 0x7FC1B4 /begin FUNCTION_LIST LAYER /end FUNCTION_LIST /end MEASUREMENT
/begin MEASUREMENT W_ub "Ub von AD-Wandler" UBYTE Def_u_ub_q0p0942 0 0 0.0 24.0210 ECU_ADDRESS 0x7FC1B6 /begin FUNCTION_LIST LAYER /end FUNCTION_LIST /end MEASUREMENT
/begin MEASUREMENT Wped "Pedalwertgeberposition" SWORD Def_tv_sw_q0p0244 0 0 -800.0000 799.9755 ECU_ADDRESS 0x7FC1C6 /begin FUNCTION_LIST LAYER /end FUNCTION_LIST /end MEASUREMENT
/begin MEASUREMENT Z_mandetek1 "Zähler Mandetek1" UBYTE Def_dez_ub_q1 0 0 0.0 255.0000 ECU_ADDRESS 0x7FDE85 /begin FUNCTION_LIST MANDETEK /end FUNCTION_LIST /end MEASUREMENT
/begin MEASUREMENT Z_mandetek2 "Zähler Mandetek2" UBYTE Def_dez_ub_q1 0 0 0.0 255.0000 ECU_ADDRESS 0x7FDE86 /begin FUNCTION_LIST MANDETEK /end FUNCTION_LIST /end MEASUREMENT
/begin MEASUREMENT Zbibs "Zusbaunummer" ULONG Def_dez_ul_q1 0 0 0.0 2147483647.0000 ECU_ADDRESS 0x7FD8FC /begin FUNCTION_LIST KT_IBS /end FUNCTION_LIST /end MEASUREMENT
/begin MEASUREMENT Zrbosmld "anzuzeigender Zähler für durchgeführten Ölservice" UBYTE Def_dez_ub_q1 0 0 0.0 255.0000 ECU_ADDRESS 0x7FDE95 /begin FUNCTION_LIST OZBG /end FUNCTION_LIST /end MEASUREMENT
/begin MEASUREMENT Zrbosr "Servicezähler vom Kombi" UBYTE Def_dez_ub_q1 0 0 0.0 255.0000 ECU_ADDRESS 0x7FC122 /begin FUNCTION_LIST LAYER /end FUNCTION_LIST /end MEASUREMENT
/begin MEASUREMENT Zrbosrt "Servicezählerwert vom Tester" UBYTE Def_dez_ub_q1 0 0 0.0 255.0000 ECU_ADDRESS 0x7FC0FF /begin FUNCTION_LIST LAYER /end FUNCTION_LIST /end MEASUREMENT
/begin MEASUREMENT Ztageabs "Tagezähler vom Kombi" UWORD Def_dez_uw_q1 0 0 0.0 65535.0000 ECU_ADDRESS 0x7FC1B8 /begin FUNCTION_LIST LAYER /end FUNCTION_LIST /end MEASUREMENT
/begin FUNCTION IMDGEN_1PR "IMDGEN_1PR" /end FUNCTION
/begin FUNCTION KT_IBS "KT_IBS" /end FUNCTION
/begin FUNCTION LAYER "LAYER" /end FUNCTION
/begin FUNCTION LBATTCAL "LBATTCAL" /end FUNCTION
/begin FUNCTION LDSTGEN "LDSTGEN" /end FUNCTION
/begin FUNCTION LLPMCTRL "LLPMCTRL" /end FUNCTION
/begin FUNCTION LLRANH "LLRANH" /end FUNCTION
/begin FUNCTION LOADRESP "LOADRESP" /end FUNCTION
/begin FUNCTION MANDETEK "MANDETEK" /end FUNCTION
/begin FUNCTION OZBG "OZBG" /end FUNCTION
/begin COMPU_METHOD Def_ac_sb_q0p25 "Def_ac_sb_q0p25" RAT_FUNC "%4.1" "-" COEFFS 0 4 0 0 0 1 /end COMPU_METHOD
/begin COMPU_METHOD Def_bit_ub_0 "Def_bit_ub_0" TAB_VERB "%5.2" "-" COMPU_TAB_REF Def_bit_ub_0_VTAB /end COMPU_METHOD
/begin COMPU_METHOD Def_bit_ub_1 "Def_bit_ub_1" TAB_VERB "%5.2" "-" COMPU_TAB_REF Def_bit_ub_1_VTAB /end COMPU_METHOD
/begin COMPU_METHOD Def_bit_ub_2 "Def_bit_ub_2" TAB_VERB "%5.2" "-" COMPU_TAB_REF Def_bit_ub_2_VTAB /end COMPU_METHOD
/begin COMPU_METHOD Def_bit_ub_3 "Def_bit_ub_3" TAB_VERB "%5.2" "-" COMPU_TAB_REF Def_bit_ub_3_VTAB /end COMPU_METHOD
/begin COMPU_METHOD Def_bit_ub_4 "Def_bit_ub_4" TAB_VERB "%5.2" "-" COMPU_TAB_REF Def_bit_ub_4_VTAB /end COMPU_METHOD
/begin COMPU_METHOD Def_bit_ub_5 "Def_bit_ub_5" TAB_VERB "%5.2" "-" COMPU_TAB_REF Def_bit_ub_5_VTAB /end COMPU_METHOD
/begin COMPU_METHOD Def_bit_ub_6 "Def_bit_ub_6" TAB_VERB "%5.2" "-" COMPU_TAB_REF Def_bit_ub_6_VTAB /end COMPU_METHOD
/begin COMPU_METHOD Def_bit_ub_7 "Def_bit_ub_7" TAB_VERB "%5.2" "-" COMPU_TAB_REF Def_bit_ub_7_VTAB /end COMPU_METHOD
/begin COMPU_METHOD Def_bit_uw_0 "Def_bit_uw_0" TAB_VERB "%7.2" "-" COMPU_TAB_REF Def_bit_uw_0_VTAB /end COMPU_METHOD
/begin COMPU_METHOD Def_bit_uw_1 "Def_bit_uw_1" TAB_VERB "%7.2" "-" COMPU_TAB_REF Def_bit_uw_1_VTAB /end COMPU_METHOD
/begin COMPU_METHOD Def_bit_uw_2 "Def_bit_uw_2" TAB_VERB "%7.2" "-" COMPU_TAB_REF Def_bit_uw_2_VTAB /end COMPU_METHOD
/begin COMPU_METHOD Def_bit_uw_3 "Def_bit_uw_3" TAB_VERB "%7.2" "-" COMPU_TAB_REF Def_bit_uw_3_VTAB /end COMPU_METHOD
/begin COMPU_METHOD Def_bit_uw_4 "Def_bit_uw_4" TAB_VERB "%7.2" "-" COMPU_TAB_REF Def_bit_uw_4_VTAB /end COMPU_METHOD
/begin COMPU_METHOD Def_bit_uw_5 "Def_bit_uw_5" TAB_VERB "%7.2" "-" COMPU_TAB_REF Def_bit_uw_5_VTAB /end COMPU_METHOD
/begin COMPU_METHOD Def_bit_uw_6 "Def_bit_uw_6" TAB_VERB "%7.2" "-" COMPU_TAB_REF Def_bit_uw_6_VTAB /end COMPU_METHOD
/begin COMPU_METHOD Def_bit_uw_7 "Def_bit_uw_7" TAB_VERB "%7.2" "-" COMPU_TAB_REF Def_bit_uw_7_VTAB /end COMPU_METHOD
/begin COMPU_METHOD Def_bit_uw_8 "Def_bit_uw_8" TAB_VERB "%7.2" "-" COMPU_TAB_REF Def_bit_uw_8_VTAB /end COMPU_METHOD
/begin COMPU_METHOD Def_dez_sw_q1 "Def_dez_sw_q1" RAT_FUNC "%5.0" "-" COEFFS 0 1 0 0 0 1 /end COMPU_METHOD
/begin COMPU_METHOD Def_dez_ub_q1 "Def_dez_ub_q1" RAT_FUNC "%3.0" "-" COEFFS 0 1 0 0 0 1 /end COMPU_METHOD
/begin COMPU_METHOD Def_dez_ul_q1 "Def_dez_ul_q1" RAT_FUNC "%7.0" "-" COEFFS 0 1 0 0 0 1 /end COMPU_METHOD
/begin COMPU_METHOD Def_dez_uw_q1 "Def_dez_uw_q1" RAT_FUNC "%5.0" "-" COEFFS 0 1 0 0 0 1 /end COMPU_METHOD
/begin COMPU_METHOD Def_dm_sw_q0p1 "Def_dm_sw_q0p1" RAT_FUNC "%7.2" "Nm/s" COEFFS 0 10 0 0 0 1 /end COMPU_METHOD
/begin COMPU_METHOD Def_eta_ul_b8192 "Def_eta_ul_b8192" RAT_FUNC "%14.6" "-" COEFFS 0 524288 0 0 0 1 /end COMPU_METHOD
/begin COMPU_METHOD Def_f_r32 "Def_f_r32" RAT_FUNC "%14.7" "-" COEFFS 0 1 0 0 0 1 /end COMPU_METHOD
/begin COMPU_METHOD Def_f_sw_b100 "Def_f_sw_b100" RAT_FUNC "%8.3" "-" COEFFS 0 32768 0 0 0 100 /end COMPU_METHOD
/begin COMPU_METHOD Def_f_ub_b1 "Def_f_ub_b1" RAT_FUNC "%6.3" "-" COEFFS 0 256 0 0 0 1 /end COMPU_METHOD
/begin COMPU_METHOD Def_f_ub_b100 "Def_f_ub_b100" RAT_FUNC "%5.2" "%" COEFFS 0 256 0 0 0 100 /end COMPU_METHOD
/begin COMPU_METHOD Def_f_ub_b2 "Def_f_ub_b2" RAT_FUNC "%6.3" "-" COEFFS 0 256 0 0 0 2 /end COMPU_METHOD
/begin COMPU_METHOD Def_f_ub_b32 "Def_f_ub_b32" RAT_FUNC "%5.2" "-" COEFFS 0 256 0 0 0 32 /end COMPU_METHOD
/begin COMPU_METHOD Def_f_ub_b4 "Def_f_ub_b4" RAT_FUNC "%5.2" "-" COEFFS 0 256 0 0 0 4 /end COMPU_METHOD
/begin COMPU_METHOD Def_f_ub_b8 "Def_f_ub_b8" RAT_FUNC "%5.2" "-" COEFFS 0 256 0 0 0 8 /end COMPU_METHOD
/begin COMPU_METHOD Def_f_ul_b262144 "Def_f_ul_b262144" RAT_FUNC "%14.5" "" COEFFS 0 16384 0 0 0 1 /end COMPU_METHOD
/begin COMPU_METHOD Def_f_uw_b1 "Def_f_uw_b1" RAT_FUNC "%14.5" "-" COEFFS 0 65536 0 0 0 1 /end COMPU_METHOD
/begin COMPU_METHOD Def_f_uw_b100 "Def_f_uw_b100" RAT_FUNC "%8.3" "%" COEFFS 0 65536 0 0 0 100 /end COMPU_METHOD
/begin COMPU_METHOD Def_f_uw_b16 "Def_f_uw_b16" RAT_FUNC "%9.4" "-" COEFFS 0 65536 0 0 0 16 /end COMPU_METHOD
/begin COMPU_METHOD Def_f_uw_b2 "Def_f_uw_b2" RAT_FUNC "%14.5" "-" COEFFS 0 65536 0 0 0 2 /end COMPU_METHOD
/begin COMPU_METHOD Def_f_uw_b2048 "Def_f_uw_b2048" RAT_FUNC "%7.2" "-" COEFFS 0 65536 0 0 0 2048 /end COMPU_METHOD
/begin COMPU_METHOD Def_f_uw_b256 "Def_f_uw_b256" RAT_FUNC "%8.3" "-" COEFFS 0 65536 0 0 0 256 /end COMPU_METHOD
/begin COMPU_METHOD Def_f_uw_b32 "Def_f_uw_b32" RAT_FUNC "%9.4" "-" COEFFS 0 65536 0 0 0 32 /end COMPU_METHOD
/begin COMPU_METHOD Def_f_uw_b4 "Def_f_uw_b4" RAT_FUNC "%14.5" "-" COEFFS 0 65536 0 0 0 4 /end COMPU_METHOD
/begin COMPU_METHOD Def_f_uw_b64 "Def_f_uw_b64" RAT_FUNC "%9.4" "-" COEFFS 0 65536 0 0 0 64 /end COMPU_METHOD
/begin COMPU_METHOD Def_i_sw_q0039 "Def_i_sw_q0039" RAT_FUNC "%8.3" "mA" COEFFS 0 256 0 0 0 1 /end COMPU_METHOD
/begin COMPU_METHOD Def_i_sw_q0p02 "Def_i_sw_q0p02" RAT_FUNC "%8.3" "A" COEFFS 0 50 0 0 0 1 /end COMPU_METHOD
/begin COMPU_METHOD Def_i_sw_q0p0625 "Def_i_sw_q0p0625" RAT_FUNC "%8.3" "A" COEFFS 0 1000 0 0 0 62.5 /end COMPU_METHOD
/begin COMPU_METHOD Def_i_sw_q1 "Def_i_sw_q1" RAT_FUNC "%8.3" "A" COEFFS 0 1 0 0 0 1 /end COMPU_METHOD
/begin COMPU_METHOD Def_i_ub_q0p001 "Def_i_ub_q0p001" RAT_FUNC "%6.3" "A" COEFFS 0 1000 0 0 0 1 /end COMPU_METHOD
/begin COMPU_METHOD Def_i_ub_q0p02 "Def_i_ub_q0p02" RAT_FUNC "%5.2" "A" COEFFS 0 50 0 0 0 1 /end COMPU_METHOD
/begin COMPU_METHOD Def_i_ub_q0p04 "Def_i_ub_q0p04" RAT_FUNC "%5.2" "A" COEFFS 0 25 0 0 0 1 /end COMPU_METHOD
/begin COMPU_METHOD Def_i_ub_q0p08 "Def_i_ub_q0p08" RAT_FUNC "%5.2" "A" COEFFS 0 25 0 0 0 2 /end COMPU_METHOD
/begin COMPU_METHOD Def_i_ub_q0p125 "Def_i_ub_q0p125" RAT_FUNC "%6.3" "A" COEFFS 0 8 0 0 0 1 /end COMPU_METHOD
/begin COMPU_METHOD Def_i_ub_q1 "Def_i_ub_q1" RAT_FUNC "%6.3" "" COEFFS 0 1 0 0 0 1 /end COMPU_METHOD
/begin COMPU_METHOD Def_i_ub_q10 "Def_i_ub_q10" RAT_FUNC "%5.2" "A" COEFFS 0 1 0 0 0 10 /end COMPU_METHOD
/begin COMPU_METHOD Def_i_ub_q5p12 "Def_i_ub_q5p12" RAT_FUNC "%5.2" "" COEFFS 0 25 0 0 0 128 /end COMPU_METHOD
/begin COMPU_METHOD Def_i_uw_q0p02 "Def_i_uw_q0p02" RAT_FUNC "%8.3" "A" COEFFS 0 1 0 0 0 0.02 /end COMPU_METHOD
/begin COMPU_METHOD Def_i_uw_q0p02_o200 "Def_i_uw_q0p02_o200" RAT_FUNC "%7.2" "A" COEFFS 0 50 10000 0 0 1 /end COMPU_METHOD
/begin COMPU_METHOD Def_i_uw_q0p03125 "Def_i_uw_q0p03125" RAT_FUNC "%8.3" "A" COEFFS 0 65536 0 0 0 2048 /end COMPU_METHOD
/begin COMPU_METHOD Def_i_uw_q0p08_o200 "Def_i_uw_q0p08_o200" RAT_FUNC "%8.3" "" COEFFS 0 25 5000 0 0 2 /end COMPU_METHOD
/begin COMPU_METHOD Def_km_sw_q10 "Def_km_sw_q10" RAT_FUNC "%6.1" "km" COEFFS 0 1 0 0 0 10 /end COMPU_METHOD
/begin COMPU_METHOD Def_km_ub_q1000 "Def_km_ub_q1000" RAT_FUNC "%3.0" "km" COEFFS 0 1 0 0 0 1000 /end COMPU_METHOD
/begin COMPU_METHOD Def_km_uw_q10 "Def_km_uw_q10" RAT_FUNC "%5.0" "km" COEFFS 0 1 0 0 0 10 /end COMPU_METHOD
/begin COMPU_METHOD Def_lf_ub_q0p01 "Def_lf_ub_q0p01" RAT_FUNC "%5.2" "-" COEFFS 0 100 0 0 0 1 /end COMPU_METHOD
/begin COMPU_METHOD Def_lm_uw_q0p000444 "Def_lm_uw_q0p000444" RAT_FUNC "%9.4" "kg" COEFFS 0 2250 0 0 0 1 /end COMPU_METHOD
/begin COMPU_METHOD Def_m_sw_q0p1 "Def_m_sw_q0p1" RAT_FUNC "%7.2" "Nm" COEFFS 0 10 0 0 0 1 /end COMPU_METHOD
/begin COMPU_METHOD Def_me_sw_q0p01 "Def_me_sw_q0p01" RAT_FUNC "%8.3" "mg/cyc" COEFFS 0 100 0 0 0 1 /end COMPU_METHOD
/begin COMPU_METHOD Def_ml_sw_q0p1 "Def_ml_sw_q0p1" RAT_FUNC "%7.2" "mg/Hub" COEFFS 0 10 0 0 0 1 /end COMPU_METHOD
/begin COMPU_METHOD Def_n_sw_q1p0 "Def_n_sw_q1p0" RAT_FUNC "%5.0" "Upm" COEFFS 0 1 0 0 0 1 /end COMPU_METHOD
/begin COMPU_METHOD Def_niv_ub_b75 "Def_niv_ub_b75" RAT_FUNC "%5.2" "" COEFFS 0 256 0 0 0 75 /end COMPU_METHOD
/begin COMPU_METHOD Def_p_sw_q1 "Def_p_sw_q1" RAT_FUNC "%6.1" "hPa" COEFFS 0 1 0 0 0 1 /end COMPU_METHOD
/begin COMPU_METHOD Def_p_uw_q0p039 "Def_p_uw_q0p039" RAT_FUNC "%7.2" "hPa" COEFFS 0 256 0 0 0 10 /end COMPU_METHOD
/begin COMPU_METHOD Def_pwr_ul_q0p03125 "Def_pwr_ul_q0p03125" RAT_FUNC "%10.3" "-" COEFFS 0 65536 0 0 0 2048 /end COMPU_METHOD
/begin COMPU_METHOD Def_ql_uw_q0p0182 "Def_ql_uw_q0p0182" RAT_FUNC "%8.3" "Ah" COEFFS 0 989 0 0 0 18 /end COMPU_METHOD
/begin COMPU_METHOD Def_rf_sw_q0p01 "Def_rf_sw_q0p01" RAT_FUNC "%9.4" "%" COEFFS 0 100 0 0 0 1 /end COMPU_METHOD
/begin COMPU_METHOD Def_st_ub_q1 "Def_st_ub_q1" RAT_FUNC "%3.0" "-" COEFFS 0 1 0 0 0 1 /end COMPU_METHOD
/begin COMPU_METHOD Def_st_uw_q1 "Def_st_uw_q1" RAT_FUNC "%5.0" "-" COEFFS 0 1 0 0 0 1 /end COMPU_METHOD
/begin COMPU_METHOD Def_t_sw_q0p01 "Def_t_sw_q0p01" RAT_FUNC "%7.2" "°C" COEFFS 0 100 0 0 0 1 /end COMPU_METHOD
/begin COMPU_METHOD Def_t_sw_q0p1 "Def_t_sw_q0p1" RAT_FUNC "%6.1" "°C" COEFFS 0 10 0 0 0 1 /end COMPU_METHOD
/begin COMPU_METHOD Def_t_uw_q0p075 "Def_t_uw_q0p075" RAT_FUNC "%7.2" "°C" COEFFS 0 1 0 0 0 0.75 /end COMPU_METHOD
/begin COMPU_METHOD Def_td_ub_q0p002_o01 "Def_td_ub_q0p002_o01" RAT_FUNC "%6.3" "s" COEFFS 0 -1 0.01 0 0 -0.002 /end COMPU_METHOD
/begin COMPU_METHOD Def_td_ub_q0p00625 "Def_td_ub_q0p00625" RAT_FUNC "%7.4" "s" COEFFS 0 160 0 0 0 1 /end COMPU_METHOD
/begin COMPU_METHOD Def_td_ub_q0p01 "Def_td_ub_q0p01" RAT_FUNC "%5.2" "s" COEFFS 0 100 0 0 0 1 /end COMPU_METHOD
/begin COMPU_METHOD Def_td_ub_q0p0125 "Def_td_ub_q0p0125" RAT_FUNC "%5.2" "s" COEFFS 0 80 0 0 0 1 /end COMPU_METHOD
/begin COMPU_METHOD Def_td_ub_q0p05 "Def_td_ub_q0p05" RAT_FUNC "%5.2" "s" COEFFS 0 20 0 0 0 1 /end COMPU_METHOD
/begin COMPU_METHOD Def_td_ub_q0p1 "Def_td_ub_q0p1" RAT_FUNC "%4.1" "s" COEFFS 0 10 0 0 0 1 /end COMPU_METHOD
/begin COMPU_METHOD Def_td_ub_q1 "Def_td_ub_q1" RAT_FUNC "%5.2" "s" COEFFS 0 1 0 0 0 1 /end COMPU_METHOD
/begin COMPU_METHOD Def_td_ub_q16 "Def_td_ub_q16" RAT_FUNC "%5.2" "s" COEFFS 0 1 0 0 0 16 /end COMPU_METHOD
/begin COMPU_METHOD Def_td_ub_q256 "Def_td_ub_q256" RAT_FUNC "%5.2" "s" COEFFS 0 1 0 0 0 256 /end COMPU_METHOD
/begin COMPU_METHOD Def_td_uw_q0p01 "Def_td_uw_q0p01" RAT_FUNC "%7.2" "s" COEFFS 0 100 0 0 0 1 /end COMPU_METHOD
/begin COMPU_METHOD Def_td_uw_q0p05 "Def_td_uw_q0p05" RAT_FUNC "%7.2" "s" COEFFS 0 20 0 0 0 1 /end COMPU_METHOD
/begin COMPU_METHOD Def_td_uw_q0p1 "Def_td_uw_q0p1" RAT_FUNC "%6.1" "s" COEFFS 0 10 0 0 0 1 /end COMPU_METHOD
/begin COMPU_METHOD Def_tv_sw_q0p01 "Def_tv_sw_q0p01" RAT_FUNC "%8.3" "%" COEFFS 0 100 0 0 0 1 /end COMPU_METHOD
/begin COMPU_METHOD Def_tv_sw_q0p0244 "Def_tv_sw_q0p0244" RAT_FUNC "%7.2" "%" COEFFS 0 4096 0 0 0 100 /end COMPU_METHOD
/begin COMPU_METHOD Def_tv_ub_q0p390625 "Def_tv_ub_q0p390625" RAT_FUNC "%5.2" "%" COEFFS 0 256 0 0 0 100 /end COMPU_METHOD
/begin COMPU_METHOD Def_u_sw_b128 "Def_u_sw_b128" RAT_FUNC "%8.3" "V" COEFFS 0 256 0 0 0 1 /end COMPU_METHOD
/begin COMPU_METHOD Def_u_ub_q0p0196 "Def_u_ub_q0p0196" RAT_FUNC "%7.4" "V" COEFFS 0 1 0 0 0 0.0196 /end COMPU_METHOD
/begin COMPU_METHOD Def_u_ub_q0p064_o6 "Def_u_ub_q0p064_o6" RAT_FUNC "%5.2" "V" COEFFS 0 -125 750 0 0 -8 /end COMPU_METHOD
/begin COMPU_METHOD Def_u_ub_q0p0942 "Def_u_ub_q0p0942" RAT_FUNC "%7.4" "V" COEFFS 0 1 0 0 0 0.0942 /end COMPU_METHOD
/begin COMPU_METHOD Def_u_uw_q0p0942 "Def_u_uw_q0p0942" RAT_FUNC "%6.1" "V" COEFFS 0 1 0 0 0 0.0942 /end COMPU_METHOD
/begin COMPU_METHOD Def_u_uw_q0p1 "Def_u_uw_q0p1" RAT_FUNC "%8.3" "V" COEFFS 0 10 0 0 0 1 /end COMPU_METHOD
/begin COMPU_METHOD Def_u_uw_q0p25em3_o6 "Def_u_uw_q0p25em3_o6" RAT_FUNC "%9.4" "" COEFFS 0 -4000 24000 0 0 -1 /end COMPU_METHOD
/begin COMPU_METHOD Def_v_uw_q1p0 "Def_v_uw_q1p0" RAT_FUNC "%5.0" "km/h" COEFFS 0 1 0 0 0 1 /end COMPU_METHOD
/begin COMPU_METHOD Def_wdk_sw_q0p0244 "Def_wdk_sw_q0p0244" RAT_FUNC "%7.2" "%" COEFFS 0 4096 0 0 0 100 /end COMPU_METHOD
/begin COMPU_METHOD Identity "Identity" RAT_FUNC "%4.1" "-" COEFFS 0 1 0 0 0 1 /end COMPU_METHOD
/begin COMPU_METHOD ident "ident" RAT_FUNC "%4.1" "-" COEFFS 0 1 0 0 0 1 /end COMPU_METHOD
/begin COMPU_VTAB Def_bit_ub_0_VTAB "Def_bit_ub_0_VTAB" TAB_VERB 2 0 "FALSE" 1 "TRUE" /end COMPU_VTAB
/begin COMPU_VTAB Def_bit_ub_1_VTAB "Def_bit_ub_1_VTAB" TAB_VERB 2 0 "FALSE" 1 "TRUE" /end COMPU_VTAB
/begin COMPU_VTAB Def_bit_ub_2_VTAB "Def_bit_ub_2_VTAB" TAB_VERB 2 0 "FALSE" 1 "TRUE" /end COMPU_VTAB
/begin COMPU_VTAB Def_bit_ub_3_VTAB "Def_bit_ub_3_VTAB" TAB_VERB 2 0 "FALSE" 1 "TRUE" /end COMPU_VTAB
/begin COMPU_VTAB Def_bit_ub_4_VTAB "Def_bit_ub_4_VTAB" TAB_VERB 2 0 "FALSE" 1 "TRUE" /end COMPU_VTAB
/begin COMPU_VTAB Def_bit_ub_5_VTAB "Def_bit_ub_5_VTAB" TAB_VERB 2 0 "FALSE" 1 "TRUE" /end COMPU_VTAB
/begin COMPU_VTAB Def_bit_ub_6_VTAB "Def_bit_ub_6_VTAB" TAB_VERB 2 0 "FALSE" 1 "TRUE" /end COMPU_VTAB
/begin COMPU_VTAB Def_bit_ub_7_VTAB "Def_bit_ub_7_VTAB" TAB_VERB 2 0 "FALSE" 1 "TRUE" /end COMPU_VTAB
/begin COMPU_VTAB Def_bit_uw_0_VTAB "Def_bit_uw_0_VTAB" TAB_VERB 2 0 "FALSE" 1 "TRUE" /end COMPU_VTAB
/begin COMPU_VTAB Def_bit_uw_1_VTAB "Def_bit_uw_1_VTAB" TAB_VERB 2 0 "FALSE" 1 "TRUE" /end COMPU_VTAB
/begin COMPU_VTAB Def_bit_uw_2_VTAB "Def_bit_uw_2_VTAB" TAB_VERB 2 0 "FALSE" 1 "TRUE" /end COMPU_VTAB
/begin COMPU_VTAB Def_bit_uw_3_VTAB "Def_bit_uw_3_VTAB" TAB_VERB 2 0 "FALSE" 1 "TRUE" /end COMPU_VTAB
/begin COMPU_VTAB Def_bit_uw_4_VTAB "Def_bit_uw_4_VTAB" TAB_VERB 2 0 "FALSE" 1 "TRUE" /end COMPU_VTAB
/begin COMPU_VTAB Def_bit_uw_5_VTAB "Def_bit_uw_5_VTAB" TAB_VERB 2 0 "FALSE" 1 "TRUE" /end COMPU_VTAB
/begin COMPU_VTAB Def_bit_uw_6_VTAB "Def_bit_uw_6_VTAB" TAB_VERB 2 0 "FALSE" 1 "TRUE" /end COMPU_VTAB
/begin COMPU_VTAB Def_bit_uw_7_VTAB "Def_bit_uw_7_VTAB" TAB_VERB 2 0 "FALSE" 1 "TRUE" /end COMPU_VTAB
/begin COMPU_VTAB Def_bit_uw_8_VTAB "Def_bit_uw_8_VTAB" TAB_VERB 2 0 "FALSE" 1 "TRUE" /end COMPU_VTAB
/begin RECORD_LAYOUT TKF_SW_SW_UB NO_AXIS_PTS_X 1 UBYTE NO_AXIS_PTS_Y 2 UBYTE AXIS_PTS_X 3 SWORD INDEX_INCR DIRECT AXIS_PTS_Y 4 SWORD INDEX_INCR DIRECT FNC_VALUES 5 UBYTE COLUMN_DIR DIRECT /end RECORD_LAYOUT
/begin RECORD_LAYOUT TKF_SW_SW_UW NO_AXIS_PTS_X 1 UBYTE NO_AXIS_PTS_Y 2 UBYTE AXIS_PTS_X 3 SWORD INDEX_INCR DIRECT AXIS_PTS_Y 4 SWORD INDEX_INCR DIRECT FNC_VALUES 5 UWORD COLUMN_DIR DIRECT /end RECORD_LAYOUT
/begin RECORD_LAYOUT TKF_SW_UB_UB NO_AXIS_PTS_X 1 UBYTE NO_AXIS_PTS_Y 2 UBYTE AXIS_PTS_X 3 UBYTE INDEX_INCR DIRECT AXIS_PTS_Y 4 SWORD INDEX_INCR DIRECT FNC_VALUES 5 UBYTE COLUMN_DIR DIRECT /end RECORD_LAYOUT
/begin RECORD_LAYOUT TKF_SW_UW_UB NO_AXIS_PTS_X 1 UBYTE NO_AXIS_PTS_Y 2 UBYTE AXIS_PTS_X 3 UWORD INDEX_INCR DIRECT AXIS_PTS_Y 4 SWORD INDEX_INCR DIRECT FNC_VALUES 5 UBYTE COLUMN_DIR DIRECT /end RECORD_LAYOUT
/begin RECORD_LAYOUT TKF_UB_UB_UB NO_AXIS_PTS_X 1 UBYTE NO_AXIS_PTS_Y 2 UBYTE AXIS_PTS_X 3 UBYTE INDEX_INCR DIRECT AXIS_PTS_Y 4 UBYTE INDEX_INCR DIRECT FNC_VALUES 5 UBYTE COLUMN_DIR DIRECT /end RECORD_LAYOUT
/begin RECORD_LAYOUT TKF_UW_SW_UB NO_AXIS_PTS_X 1 UBYTE NO_AXIS_PTS_Y 2 UBYTE AXIS_PTS_X 3 SWORD INDEX_INCR DIRECT AXIS_PTS_Y 4 UWORD INDEX_INCR DIRECT FNC_VALUES 5 UBYTE COLUMN_DIR DIRECT /end RECORD_LAYOUT
/begin RECORD_LAYOUT TKF_UW_UW_UW NO_AXIS_PTS_X 1 UBYTE NO_AXIS_PTS_Y 2 UBYTE AXIS_PTS_X 3 UWORD INDEX_INCR DIRECT AXIS_PTS_Y 4 UWORD INDEX_INCR DIRECT FNC_VALUES 5 UWORD COLUMN_DIR DIRECT /end RECORD_LAYOUT
/begin RECORD_LAYOUT TKL_SW_VV_SW NO_AXIS_PTS_X 1 UBYTE RESERVED 2 BYTE AXIS_PTS_X 3 SWORD INDEX_INCR DIRECT FNC_VALUES 4 SWORD COLUMN_DIR DIRECT /end RECORD_LAYOUT
/begin RECORD_LAYOUT TKL_SW_VV_UB NO_AXIS_PTS_X 1 UBYTE RESERVED 2 BYTE AXIS_PTS_X 3 SWORD INDEX_INCR DIRECT FNC_VALUES 4 UBYTE COLUMN_DIR DIRECT /end RECORD_LAYOUT
/begin RECORD_LAYOUT TKL_SW_VV_UW NO_AXIS_PTS_X 1 UBYTE RESERVED 2 BYTE AXIS_PTS_X 3 SWORD INDEX_INCR DIRECT FNC_VALUES 4 UWORD COLUMN_DIR DIRECT /end RECORD_LAYOUT
/begin RECORD_LAYOUT TKL_UB_VV_UB NO_AXIS_PTS_X 1 UBYTE RESERVED 2 BYTE AXIS_PTS_X 3 UBYTE INDEX_INCR DIRECT FNC_VALUES 4 UBYTE COLUMN_DIR DIRECT /end RECORD_LAYOUT
/begin RECORD_LAYOUT TKL_UW_VV_SW NO_AXIS_PTS_X 1 UBYTE RESERVED 2 BYTE AXIS_PTS_X 3 UWORD INDEX_INCR DIRECT FNC_VALUES 4 SWORD COLUMN_DIR DIRECT /end RECORD_LAYOUT
/begin RECORD_LAYOUT TKL_UW_VV_UB NO_AXIS_PTS_X 1 UBYTE RESERVED 2 BYTE AXIS_PTS_X 3 UWORD INDEX_INCR DIRECT FNC_VALUES 4 UBYTE COLUMN_DIR DIRECT /end RECORD_LAYOUT
/begin RECORD_LAYOUT TKL_UW_VV_UW NO_AXIS_PTS_X 1 UBYTE RESERVED 2 BYTE AXIS_PTS_X 3 UWORD INDEX_INCR DIRECT FNC_VALUES 4 UWORD COLUMN_DIR DIRECT /end RECORD_LAYOUT
/begin RECORD_LAYOUT TKW_VV_VV_SW FNC_VALUES 1 SWORD COLUMN_DIR DIRECT /end RECORD_LAYOUT
/begin RECORD_LAYOUT TKW_VV_VV_UB FNC_VALUES 1 UBYTE COLUMN_DIR DIRECT /end RECORD_LAYOUT
/begin RECORD_LAYOUT TKW_VV_VV_UL FNC_VALUES 1 ULONG COLUMN_DIR DIRECT /end RECORD_LAYOUT
/begin RECORD_LAYOUT TKW_VV_VV_UW FNC_VALUES 1 UWORD COLUMN_DIR DIRECT /end RECORD_LAYOUT
/end MODULE
/end PROJECT
