ASAP2_VERSION 1 3
/begin PROJECT P383 "BMW DDE6.3 8-Zylinder V9E.3 11.10.2004 CAN12H"
/begin HEADER "" VERSION "V9E.3_8Z_CAN12H" PROJECT_NO P383 /end HEADER
/begin MODULE DIM ""
/begin MOD_COMMON "" BYTE_ORDER MSB_FIRST ALIGNMENT_BYTE 1 ALIGNMENT_WORD 2 ALIGNMENT_LONG 4 ALIGNMENT_FLOAT32_IEEE 4 /end MOD_COMMON
/begin CHARACTERISTIC DSM_DInDfp_Layer_TANS_C "Verzögerung Ersatzreaktion für Fehlerpfad Dfp_Layer_TANS" VALUE 0xD15BE Kw_Wu16 655350.0 Time_ms 0.00 655350.0 FORMAT "%8.1" /end CHARACTERISTIC
/begin CHARACTERISTIC DSM_DInDfp_ACCDSwtin_C "Verzögerung Ersatzreaktion für Fehlerpfad Dfp_ACCDSwtin" VALUE 0xD15C0 Kw_Wu16 655350.0 Time_ms 0.00 655350.0 FORMAT "%8.1" /end CHARACTERISTIC
/begin CHARACTERISTIC DSM_DInDfp_ACC_PlausTrqDes_C "Verzögerung Ersatzreaktion für Fehlerpfad Dfp_ACC_PlausTrqDes" VALUE 0xD15C2 Kw_Wu16 655350.0 Time_ms 0.00 655350.0 FORMAT "%8.1" /end CHARACTERISTIC
/begin CHARACTERISTIC DSM_DInDfp_ACC_trqInr_C "Verzögerung Ersatzreaktion für Fehlerpfad Dfp_ACC_trqInr" VALUE 0xD15C4 Kw_Wu16 655350.0 Time_ms 0.00 655350.0 FORMAT "%8.1" /end CHARACTERISTIC
/begin CHARACTERISTIC DSM_DInDfp_ACTrq_C "Verzögerung Ersatzreaktion für Fehlerpfad Dfp_ACTrq" VALUE 0xD15C6 Kw_Wu16 655350.0 Time_ms 0.00 655350.0 FORMAT "%8.1" /end CHARACTERISTIC
/begin CHARACTERISTIC DSM_DInDfp_ADCMon_C "Verzögerung Ersatzreaktion für Fehlerpfad Dfp_ADCMon" VALUE 0xD15C8 Kw_Wu16 655350.0 Time_ms 0.00 655350.0 FORMAT "%8.1" /end CHARACTERISTIC
/begin CHARACTERISTIC DSM_DInDfp_AFSCDIdlAdjVal_C "Verzögerung Ersatzreaktion für Fehlerpfad Dfp_AFSCDIdlAdjVal" VALUE 0xD15CA Kw_Wu16 655350.0 Time_ms 0.00 655350.0 FORMAT "%8.1" /end CHARACTERISTIC
/begin CHARACTERISTIC DSM_DInDfp_AFSCDLdAdjVal_C "Verzögerung Ersatzreaktion für Fehlerpfad Dfp_AFSCDLdAdjVal" VALUE 0xD15CC Kw_Wu16 655350.0 Time_ms 0.00 655350.0 FORMAT "%8.1" /end CHARACTERISTIC
/begin CHARACTERISTIC DSM_DInDfp_AFSCDPlAirPerCylDif_C "Verzögerung Ersatzreaktion für Fehlerpfad Dfp_AFSCDPlAirPerCylDif" VALUE 0xD15CE Kw_Wu16 655350.0 Time_ms 0.00 655350.0 FORMAT "%8.1" /end CHARACTERISTIC
/begin CHARACTERISTIC DSM_DInDfp_AFSCD_AirTempDcyc_C "Verzögerung Ersatzreaktion für Fehlerpfad Dfp_AFSCD_AirTempDcyc" VALUE 0xD15D0 Kw_Wu16 655350.0 Time_ms 0.00 655350.0 FORMAT "%8.1" /end CHARACTERISTIC
/begin CHARACTERISTIC DSM_DInDfp_AFSCD_AirTempDcyc2_C "Verzögerung Ersatzreaktion für Fehlerpfad Dfp_AFSCD_AirTempDcyc2" VALUE 0xD15D2 Kw_Wu16 655350.0 Time_ms 0.00 655350.0 FORMAT "%8.1" /end CHARACTERISTIC
/begin CHARACTERISTIC DSM_DInDfp_AFSCD_PlOffsDrft_C "Verzögerung Ersatzreaktion für Fehlerpfad Dfp_AFSCD_PlOffsDrft" VALUE 0xD15D4 Kw_Wu16 655350.0 Time_ms 0.00 655350.0 FORMAT "%8.1" /end CHARACTERISTIC
/begin CHARACTERISTIC DSM_DInDfp_AFSCD_PlOffsDrft2_C "Verzögerung Ersatzreaktion für Fehlerpfad Dfp_AFSCD_PlOffsDrft2" VALUE 0xD15D6 Kw_Wu16 655350.0 Time_ms 0.00 655350.0 FORMAT "%8.1" /end CHARACTERISTIC
/begin CHARACTERISTIC DSM_DInDfp_AFSCD_PlSetyDrft_C "Verzögerung Ersatzreaktion für Fehlerpfad Dfp_AFSCD_PlSetyDrft" VALUE 0xD15D8 Kw_Wu16 655350.0 Time_ms 0.00 655350.0 FORMAT "%8.1" /end CHARACTERISTIC
/begin CHARACTERISTIC DSM_DInDfp_AFSCD_SRCAirTemp_C "Verzögerung Ersatzreaktion für Fehlerpfad Dfp_AFSCD_SRCAirTemp" VALUE 0xD15DA Kw_Wu16 655350.0 Time_ms 0.00 655350.0 FORMAT "%8.1" /end CHARACTERISTIC
/begin CHARACTERISTIC DSM_DInDfp_AFSCD_SRCAirTemp2_C "Verzögerung Ersatzreaktion für Fehlerpfad Dfp_AFSCD_SRCAirTemp2" VALUE 0xD15DC Kw_Wu16 655350.0 Time_ms 0.00 655350.0 FORMAT "%8.1" /end CHARACTERISTIC
/begin CHARACTERISTIC DSM_DInDfp_AFSCD_SRCBatt_C "Verzögerung Ersatzreaktion für Fehlerpfad Dfp_AFSCD_SRCBatt" VALUE 0xD15DE Kw_Wu16 655350.0 Time_ms 0.00 655350.0 FORMAT "%8.1" /end CHARACTERISTIC
/begin CHARACTERISTIC DSM_DInDfp_AFSCD_SRCBatt2_C "Verzögerung Ersatzreaktion für Fehlerpfad Dfp_AFSCD_SRCBatt2" VALUE 0xD15E0 Kw_Wu16 655350.0 Time_ms 0.00 655350.0 FORMAT "%8.1" /end CHARACTERISTIC
/begin CHARACTERISTIC DSM_DInDfp_AFSCD_SRCCorrAirm_C "Verzögerung Ersatzreaktion für Fehlerpfad Dfp_AFSCD_SRCCorrAirm" VALUE 0xD15E2 Kw_Wu16 655350.0 Time_ms 0.00 655350.0 FORMAT "%8.1" /end CHARACTERISTIC
/begin CHARACTERISTIC DSM_DInDfp_Layer_TUMG_C "Verzögerung Ersatzreaktion für Fehlerpfad Dfp_Layer_TUMG" VALUE 0xD15E4 Kw_Wu16 655350.0 Time_ms 0.00 655350.0 FORMAT "%8.1" /end CHARACTERISTIC
/begin CHARACTERISTIC DSM_DInDfp_AFSCD_SRCCorrAirm2_C "Verzögerung Ersatzreaktion für Fehlerpfad Dfp_AFSCD_SRCCorrAirm2" VALUE 0xD15E6 Kw_Wu16 655350.0 Time_ms 0.00 655350.0 FORMAT "%8.1" /end CHARACTERISTIC
/begin CHARACTERISTIC DSM_DInDfp_AFSCD_SRCRawAirm_C "Verzögerung Ersatzreaktion für Fehlerpfad Dfp_AFSCD_SRCRawAirm" VALUE 0xD15E8 Kw_Wu16 655350.0 Time_ms 0.00 655350.0 FORMAT "%8.1" /end CHARACTERISTIC
/begin CHARACTERISTIC DSM_DInDfp_Layer_GEN_C "Verzögerung Ersatzreaktion für Fehlerpfad Dfp_Layer_GEN" VALUE 0xD15EA Kw_Wu16 655350.0 Time_ms 0.00 655350.0 FORMAT "%8.1" /end CHARACTERISTIC
/begin CHARACTERISTIC DSM_DInDfp_Layer_BSD_C "Verzögerung Ersatzreaktion für Fehlerpfad Dfp_Layer_BSD" VALUE 0xD15EC Kw_Wu16 655350.0 Time_ms 0.00 655350.0 FORMAT "%8.1" /end CHARACTERISTIC
/begin CHARACTERISTIC DSM_DInDfp_AFSCD_SRCRawAirm2_C "Verzögerung Ersatzreaktion für Fehlerpfad Dfp_AFSCD_SRCRawAirm2" VALUE 0xD15EE Kw_Wu16 655350.0 Time_ms 0.00 655350.0 FORMAT "%8.1" /end CHARACTERISTIC
/begin CHARACTERISTIC DSM_DInDfp_AFSCD_SRCRefSigPer_C "Verzögerung Ersatzreaktion für Fehlerpfad Dfp_AFSCD_SRCRefSigPer" VALUE 0xD15F0 Kw_Wu16 655350.0 Time_ms 0.00 655350.0 FORMAT "%8.1" /end CHARACTERISTIC
/begin CHARACTERISTIC DSM_DInDfp_AFSCD_SRCRefSigPer2_C "Verzögerung Ersatzreaktion für Fehlerpfad Dfp_AFSCD_SRCRefSigPer2" VALUE 0xD15F2 Kw_Wu16 655350.0 Time_ms 0.00 655350.0 FORMAT "%8.1" /end CHARACTERISTIC
/begin CHARACTERISTIC DSM_DInDfp_AOHtCD_C "Verzögerung Ersatzreaktion für Fehlerpfad Dfp_AOHtCD" VALUE 0xD15F4 Kw_Wu16 655350.0 Time_ms 0.00 655350.0 FORMAT "%8.1" /end CHARACTERISTIC
/begin CHARACTERISTIC DSM_DInDfp_AOHtCD_AOHtDia1_C "Verzögerung Ersatzreaktion für Fehlerpfad Dfp_AOHtCD_AOHtDia1" VALUE 0xD15F6 Kw_Wu16 655350.0 Time_ms 0.00 655350.0 FORMAT "%8.1" /end CHARACTERISTIC
/begin CHARACTERISTIC DSM_DInDfp_AOHtCD_AOHtDia2_C "Verzögerung Ersatzreaktion für Fehlerpfad Dfp_AOHtCD_AOHtDia2" VALUE 0xD15F8 Kw_Wu16 655350.0 Time_ms 0.00 655350.0 FORMAT "%8.1" /end CHARACTERISTIC
/begin CHARACTERISTIC DSM_DInDfp_AOHtCD_AOHtDia3_C "Verzögerung Ersatzreaktion für Fehlerpfad Dfp_AOHtCD_AOHtDia3" VALUE 0xD15FA Kw_Wu16 655350.0 Time_ms 0.00 655350.0 FORMAT "%8.1" /end CHARACTERISTIC
/begin CHARACTERISTIC DSM_DInDfp_APP1_C "Verzögerung Ersatzreaktion für Fehlerpfad Dfp_APP1" VALUE 0xD15FC Kw_Wu16 655350.0 Time_ms 0.00 655350.0 FORMAT "%8.1" /end CHARACTERISTIC
/begin CHARACTERISTIC DSM_DInDfp_APP2_C "Verzögerung Ersatzreaktion für Fehlerpfad Dfp_APP2" VALUE 0xD15FE Kw_Wu16 655350.0 Time_ms 0.00 655350.0 FORMAT "%8.1" /end CHARACTERISTIC
/begin CHARACTERISTIC DSM_DInDfp_APPCDCmpd_C "Verzögerung Ersatzreaktion für Fehlerpfad Dfp_APPCDCmpd" VALUE 0xD1600 Kw_Wu16 655350.0 Time_ms 0.00 655350.0 FORMAT "%8.1" /end CHARACTERISTIC
/begin CHARACTERISTIC DSM_DInDfp_Layer_QLT_C "Verzögerung Ersatzreaktion für Fehlerpfad Dfp_Layer_QLT" VALUE 0xD1602 Kw_Wu16 655350.0 Time_ms 0.00 655350.0 FORMAT "%8.1" /end CHARACTERISTIC
/begin CHARACTERISTIC DSM_DInDfp_APPSync_C "Verzögerung Ersatzreaktion für Fehlerpfad Dfp_APPSync" VALUE 0xD1604 Kw_Wu16 655350.0 Time_ms 0.00 655350.0 FORMAT "%8.1" /end CHARACTERISTIC
/begin CHARACTERISTIC DSM_DInDfp_Layer_IBS1_C "Verzögerung Ersatzreaktion für Fehlerpfad Dfp_Layer_IBS1" VALUE 0xD1606 Kw_Wu16 655350.0 Time_ms 0.00 655350.0 FORMAT "%8.1" /end CHARACTERISTIC
/begin CHARACTERISTIC DSM_DInDfp_Layer_IBS2_C "Verzögerung Ersatzreaktion für Fehlerpfad Dfp_Layer_IBS2" VALUE 0xD1608 Kw_Wu16 655350.0 Time_ms 0.00 655350.0 FORMAT "%8.1" /end CHARACTERISTIC
/begin CHARACTERISTIC DSM_DInDfp_Layer_IBS3_C "Verzögerung Ersatzreaktion für Fehlerpfad Dfp_Layer_IBS3" VALUE 0xD160A Kw_Wu16 655350.0 Time_ms 0.00 655350.0 FORMAT "%8.1" /end CHARACTERISTIC
/begin CHARACTERISTIC DSM_DInDfp_Layer_PMBN_C "Verzögerung Ersatzreaktion für Fehlerpfad Dfp_Layer_PMBN" VALUE 0xD160C Kw_Wu16 655350.0 Time_ms 0.00 655350.0 FORMAT "%8.1" /end CHARACTERISTIC
/begin CHARACTERISTIC DSM_DInDfp_Layer_PMBATT_C "Verzögerung Ersatzreaktion für Fehlerpfad Dfp_Layer_PMBATT" VALUE 0xD160E Kw_Wu16 655350.0 Time_ms 0.00 655350.0 FORMAT "%8.1" /end CHARACTERISTIC
/begin CHARACTERISTIC DSM_DInDfp_APSCD_C "Verzögerung Ersatzreaktion für Fehlerpfad Dfp_APSCD" VALUE 0xD1610 Kw_Wu16 655350.0 Time_ms 0.00 655350.0 FORMAT "%8.1" /end CHARACTERISTIC
/begin CHARACTERISTIC DSM_DInDfp_ARS_C "Verzögerung Ersatzreaktion für Fehlerpfad Dfp_ARS" VALUE 0xD1612 Kw_Wu16 655350.0 Time_ms 0.00 655350.0 FORMAT "%8.1" /end CHARACTERISTIC
/begin CHARACTERISTIC DSM_DInDfp_AccPedPlausBrk_C "Verzögerung Ersatzreaktion für Fehlerpfad Dfp_AccPedPlausBrk" VALUE 0xD1614 Kw_Wu16 655350.0 Time_ms 0.00 655350.0 FORMAT "%8.1" /end CHARACTERISTIC
/begin CHARACTERISTIC DSM_DInDfp_AddPCDTnkLvl_C "Verzögerung Ersatzreaktion für Fehlerpfad Dfp_AddPCDTnkLvl" VALUE 0xD1616 Kw_Wu16 655350.0 Time_ms 0.00 655350.0 FORMAT "%8.1" /end CHARACTERISTIC
/begin CHARACTERISTIC DSM_DInDfp_AirCtlGvnrDvtRgnMax_C "Verzögerung Ersatzreaktion für Fehlerpfad Dfp_AirCtlGvnrDvtRgnMax" VALUE 0xD1618 Kw_Wu16 655350.0 Time_ms 0.00 655350.0 FORMAT "%8.1" /end CHARACTERISTIC
/begin CHARACTERISTIC DSM_DInDfp_AirCtlGvnrDvtRgnMin_C "Verzögerung Ersatzreaktion für Fehlerpfad Dfp_AirCtlGvnrDvtRgnMin" VALUE 0xD161A Kw_Wu16 655350.0 Time_ms 0.00 655350.0 FORMAT "%8.1" /end CHARACTERISTIC
/begin CHARACTERISTIC DSM_DInDfp_AirCtlGvnrDvtRgnMn2_C "Verzögerung Ersatzreaktion für Fehlerpfad Dfp_AirCtlGvnrDvtRgnMn2" VALUE 0xD161C Kw_Wu16 655350.0 Time_ms 0.00 655350.0 FORMAT "%8.1" /end CHARACTERISTIC
/begin CHARACTERISTIC DSM_DInDfp_AirCtlGvnrDvtRgnMx2_C "Verzögerung Ersatzreaktion für Fehlerpfad Dfp_AirCtlGvnrDvtRgnMx2" VALUE 0xD161E Kw_Wu16 655350.0 Time_ms 0.00 655350.0 FORMAT "%8.1" /end CHARACTERISTIC
/begin CHARACTERISTIC DSM_DInDfp_AirCtlPlateBreak_C "DSM variable for Dfp_AirCtlPlateBreak_mp" VALUE 0xD1620 Kw_Wu16 655350.0 Time_ms 0.00 655350.0 FORMAT "%8.1" /end CHARACTERISTIC
/begin CHARACTERISTIC DSM_DInDfp_AirCtlRmpTO_C "Verzögerung Ersatzreaktion für Fehlerpfad Dfp_AirCtlRmpTO" VALUE 0xD1622 Kw_Wu16 655350.0 Time_ms 0.00 655350.0 FORMAT "%8.1" /end CHARACTERISTIC
/begin CHARACTERISTIC DSM_DInDfp_AirCtl_GovNegDev_C "Verzögerung Ersatzreaktion für Fehlerpfad Dfp_AirCtl_GovNegDev" VALUE 0xD1624 Kw_Wu16 655350.0 Time_ms 0.00 655350.0 FORMAT "%8.1" /end CHARACTERISTIC
/begin CHARACTERISTIC DSM_DInDfp_AirCtl_GovNegDev2_C "Verzögerung Ersatzreaktion für Fehlerpfad Dfp_AirCtl_GovNegDev2" VALUE 0xD1626 Kw_Wu16 655350.0 Time_ms 0.00 655350.0 FORMAT "%8.1" /end CHARACTERISTIC
/begin CHARACTERISTIC DSM_DInDfp_AirCtl_GovPosDev_C "Verzögerung Ersatzreaktion für Fehlerpfad Dfp_AirCtl_GovPosDev" VALUE 0xD1628 Kw_Wu16 655350.0 Time_ms 0.00 655350.0 FORMAT "%8.1" /end CHARACTERISTIC
/begin CHARACTERISTIC DSM_DInDfp_AirCtl_GovPosDev2_C "Verzögerung Ersatzreaktion für Fehlerpfad Dfp_AirCtl_GovPosDev2" VALUE 0xD162A Kw_Wu16 655350.0 Time_ms 0.00 655350.0 FORMAT "%8.1" /end CHARACTERISTIC
/begin CHARACTERISTIC DSM_DInDfp_AltCD_C "Verzögerung Ersatzreaktion für Fehlerpfad Dfp_AltCD" VALUE 0xD162C Kw_Wu16 655350.0 Time_ms 0.00 655350.0 FORMAT "%8.1" /end CHARACTERISTIC
/begin CHARACTERISTIC DSM_DInDfp_BPACD_BPADia1_C "Verzögerung Ersatzreaktion für Fehlerpfad Dfp_BPACD_BPADia1" VALUE 0xD162E Kw_Wu16 655350.0 Time_ms 0.00 655350.0 FORMAT "%8.1" /end CHARACTERISTIC
/begin CHARACTERISTIC DSM_DInDfp_BPACD_BPADia1v2_C "Verzögerung Ersatzreaktion für Fehlerpfad Dfp_BPACD_BPADia1v2" VALUE 0xD1630 Kw_Wu16 655350.0 Time_ms 0.00 655350.0 FORMAT "%8.1" /end CHARACTERISTIC
/begin CHARACTERISTIC DSM_DInDfp_BPACD_BPADia2_C "Verzögerung Ersatzreaktion für Fehlerpfad Dfp_BPACD_BPADia2" VALUE 0xD1632 Kw_Wu16 655350.0 Time_ms 0.00 655350.0 FORMAT "%8.1" /end CHARACTERISTIC
/begin CHARACTERISTIC DSM_DInDfp_BPACD_BPADia2v2_C "Verzögerung Ersatzreaktion für Fehlerpfad Dfp_BPACD_BPADia2v2" VALUE 0xD1634 Kw_Wu16 655350.0 Time_ms 0.00 655350.0 FORMAT "%8.1" /end CHARACTERISTIC
/begin CHARACTERISTIC DSM_DInDfp_BPACD_BPADia3_C "Verzögerung Ersatzreaktion für Fehlerpfad Dfp_BPACD_BPADia3" VALUE 0xD1636 Kw_Wu16 655350.0 Time_ms 0.00 655350.0 FORMAT "%8.1" /end CHARACTERISTIC
/begin CHARACTERISTIC DSM_DInDfp_BPACD_BPADia3v2_C "Verzögerung Ersatzreaktion für Fehlerpfad Dfp_BPACD_BPADia3v2" VALUE 0xD1638 Kw_Wu16 655350.0 Time_ms 0.00 655350.0 FORMAT "%8.1" /end CHARACTERISTIC
/begin CHARACTERISTIC DSM_DInDfp_BPACD_BPADia4_C "Verzögerung Ersatzreaktion für Fehlerpfad Dfp_BPACD_BPADia4" VALUE 0xD163A Kw_Wu16 655350.0 Time_ms 0.00 655350.0 FORMAT "%8.1" /end CHARACTERISTIC
/begin CHARACTERISTIC DSM_DInDfp_BPACD_BPADia4v2_C "Verzögerung Ersatzreaktion für Fehlerpfad Dfp_BPACD_BPADia4v2" VALUE 0xD163C Kw_Wu16 655350.0 Time_ms 0.00 655350.0 FORMAT "%8.1" /end CHARACTERISTIC
/begin CHARACTERISTIC DSM_DInDfp_BPACD_Max_C "Verzögerung Ersatzreaktion für Fehlerpfad Dfp_BPACD_Max" VALUE 0xD163E Kw_Wu16 655350.0 Time_ms 0.00 655350.0 FORMAT "%8.1" /end CHARACTERISTIC
/begin CHARACTERISTIC DSM_DInDfp_BPACD_Max2_C "Verzögerung Ersatzreaktion für Fehlerpfad Dfp_BPACD_Max2" VALUE 0xD1640 Kw_Wu16 655350.0 Time_ms 0.00 655350.0 FORMAT "%8.1" /end CHARACTERISTIC
/begin CHARACTERISTIC DSM_DInDfp_BPACD_Min_C "Verzögerung Ersatzreaktion für Fehlerpfad Dfp_BPACD_Min" VALUE 0xD1642 Kw_Wu16 655350.0 Time_ms 0.00 655350.0 FORMAT "%8.1" /end CHARACTERISTIC
/begin CHARACTERISTIC DSM_DInDfp_BPACD_Min2_C "Verzögerung Ersatzreaktion für Fehlerpfad Dfp_BPACD_Min2" VALUE 0xD1644 Kw_Wu16 655350.0 Time_ms 0.00 655350.0 FORMAT "%8.1" /end CHARACTERISTIC
/begin CHARACTERISTIC DSM_DInDfp_BPACD_SigNpl_C "Verzögerung Ersatzreaktion für Fehlerpfad Dfp_BPACD_SigNpl" VALUE 0xD1646 Kw_Wu16 655350.0 Time_ms 0.00 655350.0 FORMAT "%8.1" /end CHARACTERISTIC
/begin CHARACTERISTIC DSM_DInDfp_BPACD_SigNpl2_C "Verzögerung Ersatzreaktion für Fehlerpfad Dfp_BPACD_SigNpl2" VALUE 0xD1648 Kw_Wu16 655350.0 Time_ms 0.00 655350.0 FORMAT "%8.1" /end CHARACTERISTIC
/begin CHARACTERISTIC DSM_DInDfp_BPSCD_C "Verzögerung Ersatzreaktion für Fehlerpfad Dfp_BPSCD" VALUE 0xD164A Kw_Wu16 655350.0 Time_ms 0.00 655350.0 FORMAT "%8.1" /end CHARACTERISTIC
/begin CHARACTERISTIC DSM_DInDfp_BattCD_C "Verzögerung Ersatzreaktion für Fehlerpfad Dfp_BattCD" VALUE 0xD164C Kw_Wu16 655350.0 Time_ms 0.00 655350.0 FORMAT "%8.1" /end CHARACTERISTIC
/begin CHARACTERISTIC DSM_DInDfp_BrkCD_C "Verzögerung Ersatzreaktion für Fehlerpfad Dfp_BrkCD" VALUE 0xD164E Kw_Wu16 655350.0 Time_ms 0.00 655350.0 FORMAT "%8.1" /end CHARACTERISTIC
/begin CHARACTERISTIC DSM_DInDfp_Layer_PMRUHVERL_C "Verzögerung Ersatzreaktion für Fehlerpfad Dfp_Layer_PMRUHVERL" VALUE 0xD1650 Kw_Wu16 655350.0 Time_ms 0.00 655350.0 FORMAT "%8.1" /end CHARACTERISTIC
/begin CHARACTERISTIC DSM_DInDfp_Bss_C "Verzögerung Ersatzreaktion für Fehlerpfad Dfp_Bss" VALUE 0xD1652 Kw_Wu16 655350.0 Time_ms 0.00 655350.0 FORMAT "%8.1" /end CHARACTERISTIC
/begin CHARACTERISTIC DSM_DInDfp_CBACD_C "Verzögerung Ersatzreaktion für Fehlerpfad Dfp_CBACD" VALUE 0xD1654 Kw_Wu16 655350.0 Time_ms 0.00 655350.0 FORMAT "%8.1" /end CHARACTERISTIC
/begin CHARACTERISTIC DSM_DInDfp_CTSCD_C "Verzögerung Ersatzreaktion für Fehlerpfad Dfp_CTSCD" VALUE 0xD1656 Kw_Wu16 655350.0 Time_ms 0.00 655350.0 FORMAT "%8.1" /end CHARACTERISTIC
/begin CHARACTERISTIC DSM_DInDfp_Clg_DynTst_C "Verzögerung Ersatzreaktion für Fehlerpfad Dfp_Clg_DynTst" VALUE 0xD1658 Kw_Wu16 655350.0 Time_ms 0.00 655350.0 FORMAT "%8.1" /end CHARACTERISTIC
/begin CHARACTERISTIC DSM_DInDfp_Layer_TOENS_C "Verzögerung Ersatzreaktion für Fehlerpfad Dfp_Layer_TOENS" VALUE 0xD165A Kw_Wu16 655350.0 Time_ms 0.00 655350.0 FORMAT "%8.1" /end CHARACTERISTIC
/begin CHARACTERISTIC DSM_DInDfp_Layer_MANHYDR_C "Verzögerung Ersatzreaktion für Fehlerpfad Dfp_Layer_MANHYDR" VALUE 0xD165C Kw_Wu16 655350.0 Time_ms 0.00 655350.0 FORMAT "%8.1" /end CHARACTERISTIC
/begin CHARACTERISTIC DSM_DInDfp_Layer_MANLUFT_C "Verzögerung Ersatzreaktion für Fehlerpfad Dfp_Layer_MANLUFT" VALUE 0xD165E Kw_Wu16 655350.0 Time_ms 0.00 655350.0 FORMAT "%8.1" /end CHARACTERISTIC
/begin CHARACTERISTIC DSM_DInDfp_CmbChbMisfire1_C "Verzögerung Ersatzreaktion für Fehlerpfad Dfp_CmbChbMisfire1" VALUE 0xD1660 Kw_Wu16 655350.0 Time_ms 0.00 655350.0 FORMAT "%8.1" /end CHARACTERISTIC
/begin CHARACTERISTIC DSM_DInDfp_CmbChbMisfire2_C "Verzögerung Ersatzreaktion für Fehlerpfad Dfp_CmbChbMisfire2" VALUE 0xD1662 Kw_Wu16 655350.0 Time_ms 0.00 655350.0 FORMAT "%8.1" /end CHARACTERISTIC
/begin CHARACTERISTIC DSM_DInDfp_CmbChbMisfire3_C "Verzögerung Ersatzreaktion für Fehlerpfad Dfp_CmbChbMisfire3" VALUE 0xD1664 Kw_Wu16 655350.0 Time_ms 0.00 655350.0 FORMAT "%8.1" /end CHARACTERISTIC
/begin CHARACTERISTIC DSM_DInDfp_CmbChbMisfire4_C "Verzögerung Ersatzreaktion für Fehlerpfad Dfp_CmbChbMisfire4" VALUE 0xD1666 Kw_Wu16 655350.0 Time_ms 0.00 655350.0 FORMAT "%8.1" /end CHARACTERISTIC
/begin CHARACTERISTIC DSM_DInDfp_CmbChbMisfire5_C "Verzögerung Ersatzreaktion für Fehlerpfad Dfp_CmbChbMisfire5" VALUE 0xD1668 Kw_Wu16 655350.0 Time_ms 0.00 655350.0 FORMAT "%8.1" /end CHARACTERISTIC
/begin CHARACTERISTIC DSM_DInDfp_CmbChbMisfire6_C "Verzögerung Ersatzreaktion für Fehlerpfad Dfp_CmbChbMisfire6" VALUE 0xD166A Kw_Wu16 655350.0 Time_ms 0.00 655350.0 FORMAT "%8.1" /end CHARACTERISTIC
/begin CHARACTERISTIC DSM_DInDfp_CmbChbMisfire7_C "Verzögerung Ersatzreaktion für Fehlerpfad Dfp_CmbChbMisfire7" VALUE 0xD166C Kw_Wu16 655350.0 Time_ms 0.00 655350.0 FORMAT "%8.1" /end CHARACTERISTIC
/begin CHARACTERISTIC DSM_DInDfp_CmbChbMisfire8_C "Verzögerung Ersatzreaktion für Fehlerpfad Dfp_CmbChbMisfire8" VALUE 0xD166E Kw_Wu16 655350.0 Time_ms 0.00 655350.0 FORMAT "%8.1" /end CHARACTERISTIC
/begin CHARACTERISTIC DSM_DInDfp_CmbChbMisfireMul_C "Verzögerung Ersatzreaktion für Fehlerpfad Dfp_CmbChbMisfireMul" VALUE 0xD1670 Kw_Wu16 655350.0 Time_ms 0.00 655350.0 FORMAT "%8.1" /end CHARACTERISTIC
/begin CHARACTERISTIC DSM_DInDfp_CoDT_TRQ_Des_C "Verzögerung Ersatzreaktion für Fehlerpfad Dfp_CoDT_TRQ_Des" VALUE 0xD1672 Kw_Wu16 655350.0 Time_ms 0.00 655350.0 FORMAT "%8.1" /end CHARACTERISTIC
/begin CHARACTERISTIC DSM_DInDfp_CoDT_TRQ_Lead_C "Verzögerung Ersatzreaktion für Fehlerpfad Dfp_CoDT_TRQ_Lead" VALUE 0xD1674 Kw_Wu16 655350.0 Time_ms 0.00 655350.0 FORMAT "%8.1" /end CHARACTERISTIC
/begin CHARACTERISTIC DSM_DInDfp_CoEng_GbxRpmRduc_C "Verzögerung Ersatzreaktion für Fehlerpfad Dfp_CoEng_GbxRpmRduc" VALUE 0xD1676 Kw_Wu16 655350.0 Time_ms 0.00 655350.0 FORMAT "%8.1" /end CHARACTERISTIC
/begin CHARACTERISTIC DSM_DInDfp_CoVMDCSh_C "Verzögerung Ersatzreaktion für Fehlerpfad Dfp_CoVMDCSh" VALUE 0xD1678 Kw_Wu16 655350.0 Time_ms 0.00 655350.0 FORMAT "%8.1" /end CHARACTERISTIC
/begin CHARACTERISTIC DSM_DInDfp_ConvCD_C "Verzögerung Ersatzreaktion für Fehlerpfad Dfp_ConvCD" VALUE 0xD167A Kw_Wu16 655350.0 Time_ms 0.00 655350.0 FORMAT "%8.1" /end CHARACTERISTIC
/begin CHARACTERISTIC DSM_DInDfp_CrCCDMFL_C "Verzögerung Ersatzreaktion für Fehlerpfad Dfp_CrCCDMFL" VALUE 0xD167C Kw_Wu16 655350.0 Time_ms 0.00 655350.0 FORMAT "%8.1" /end CHARACTERISTIC
/begin CHARACTERISTIC DSM_DInDfp_CrCtl_vCrCtl_C "Verzögerung Ersatzreaktion für Fehlerpfad Dfp_CrCtl_vCrCtl" VALUE 0xD167E Kw_Wu16 655350.0 Time_ms 0.00 655350.0 FORMAT "%8.1" /end CHARACTERISTIC
/begin CHARACTERISTIC DSM_DInDfp_EATSCD_C "Verzögerung Ersatzreaktion für Fehlerpfad Dfp_EATSCD" VALUE 0xD1680 Kw_Wu16 655350.0 Time_ms 0.00 655350.0 FORMAT "%8.1" /end CHARACTERISTIC
/begin CHARACTERISTIC DSM_DInDfp_EBAFCD_C "Verzögerung Ersatzreaktion für Fehlerpfad Dfp_EBAFCD" VALUE 0xD1682 Kw_Wu16 655350.0 Time_ms 0.00 655350.0 FORMAT "%8.1" /end CHARACTERISTIC
/begin CHARACTERISTIC DSM_DInDfp_EBFCD_C "Verzögerung Ersatzreaktion für Fehlerpfad Dfp_EBFCD" VALUE 0xD1684 Kw_Wu16 655350.0 Time_ms 0.00 655350.0 FORMAT "%8.1" /end CHARACTERISTIC
/begin CHARACTERISTIC DSM_DInDfp_EBTSCD_C "Verzögerung Ersatzreaktion für Fehlerpfad Dfp_EBTSCD" VALUE 0xD1686 Kw_Wu16 655350.0 Time_ms 0.00 655350.0 FORMAT "%8.1" /end CHARACTERISTIC
/begin CHARACTERISTIC DSM_DInDfp_EBTSCD_OvrTemp_C "Verzögerung Ersatzreaktion für Fehlerpfad Dfp_EBTSCD_OvrTemp" VALUE 0xD1688 Kw_Wu16 655350.0 Time_ms 0.00 655350.0 FORMAT "%8.1" /end CHARACTERISTIC
/begin CHARACTERISTIC DSM_DInDfp_EEPCDVarMng_C "Verzögerung Ersatzreaktion für Fehlerpfad Dfp_EEPCDVarMng" VALUE 0xD168A Kw_Wu16 655350.0 Time_ms 0.00 655350.0 FORMAT "%8.1" /end CHARACTERISTIC
/begin CHARACTERISTIC DSM_DInDfp_EGPpCD_C "Verzögerung Ersatzreaktion für Fehlerpfad Dfp_EGPpCD" VALUE 0xD168C Kw_Wu16 655350.0 Time_ms 0.00 655350.0 FORMAT "%8.1" /end CHARACTERISTIC
/begin CHARACTERISTIC DSM_DInDfp_EGRCD_Max_C "Verzögerung Ersatzreaktion für Fehlerpfad Dfp_EGRCD_Max" VALUE 0xD168E Kw_Wu16 655350.0 Time_ms 0.00 655350.0 FORMAT "%8.1" /end CHARACTERISTIC
/begin CHARACTERISTIC DSM_DInDfp_EGRCD_Max2_C "Verzögerung Ersatzreaktion für Fehlerpfad Dfp_EGRCD_Max2" VALUE 0xD1690 Kw_Wu16 655350.0 Time_ms 0.00 655350.0 FORMAT "%8.1" /end CHARACTERISTIC
/begin CHARACTERISTIC DSM_DInDfp_EGRCD_Min_C "Verzögerung Ersatzreaktion für Fehlerpfad Dfp_EGRCD_Min" VALUE 0xD1692 Kw_Wu16 655350.0 Time_ms 0.00 655350.0 FORMAT "%8.1" /end CHARACTERISTIC
/begin CHARACTERISTIC DSM_DInDfp_EGRCD_Min2_C "Verzögerung Ersatzreaktion für Fehlerpfad Dfp_EGRCD_Min2" VALUE 0xD1694 Kw_Wu16 655350.0 Time_ms 0.00 655350.0 FORMAT "%8.1" /end CHARACTERISTIC
/begin CHARACTERISTIC DSM_DInDfp_EGRCD_PWMInDia1_C "Verzögerung Ersatzreaktion für Fehlerpfad Dfp_EGRCD_PWMInDia1" VALUE 0xD1696 Kw_Wu16 655350.0 Time_ms 0.00 655350.0 FORMAT "%8.1" /end CHARACTERISTIC
/begin CHARACTERISTIC DSM_DInDfp_EGRCD_PWMInDia2_C "Verzögerung Ersatzreaktion für Fehlerpfad Dfp_EGRCD_PWMInDia2" VALUE 0xD1698 Kw_Wu16 655350.0 Time_ms 0.00 655350.0 FORMAT "%8.1" /end CHARACTERISTIC
/begin CHARACTERISTIC DSM_DInDfp_EGRCD_PWMInDia21_C "Verzögerung Ersatzreaktion für Fehlerpfad Dfp_EGRCD_PWMInDia21" VALUE 0xD169A Kw_Wu16 655350.0 Time_ms 0.00 655350.0 FORMAT "%8.1" /end CHARACTERISTIC
/begin CHARACTERISTIC DSM_DInDfp_EGRCD_PWMInDia22_C "Verzögerung Ersatzreaktion für Fehlerpfad Dfp_EGRCD_PWMInDia22" VALUE 0xD169C Kw_Wu16 655350.0 Time_ms 0.00 655350.0 FORMAT "%8.1" /end CHARACTERISTIC
/begin CHARACTERISTIC DSM_DInDfp_EGRCD_PWMInDia23_C "Verzögerung Ersatzreaktion für Fehlerpfad Dfp_EGRCD_PWMInDia23" VALUE 0xD169E Kw_Wu16 655350.0 Time_ms 0.00 655350.0 FORMAT "%8.1" /end CHARACTERISTIC
/begin CHARACTERISTIC DSM_DInDfp_EGRCD_PWMInDia24_C "Verzögerung Ersatzreaktion für Fehlerpfad Dfp_EGRCD_PWMInDia24" VALUE 0xD16A0 Kw_Wu16 655350.0 Time_ms 0.00 655350.0 FORMAT "%8.1" /end CHARACTERISTIC
/begin CHARACTERISTIC DSM_DInDfp_EGRCD_PWMInDia3_C "Verzögerung Ersatzreaktion für Fehlerpfad Dfp_EGRCD_PWMInDia3" VALUE 0xD16A2 Kw_Wu16 655350.0 Time_ms 0.00 655350.0 FORMAT "%8.1" /end CHARACTERISTIC
/begin CHARACTERISTIC DSM_DInDfp_EGRCD_PWMInDia4_C "Verzögerung Ersatzreaktion für Fehlerpfad Dfp_EGRCD_PWMInDia4" VALUE 0xD16A4 Kw_Wu16 655350.0 Time_ms 0.00 655350.0 FORMAT "%8.1" /end CHARACTERISTIC
/begin CHARACTERISTIC DSM_DInDfp_EGRCD_SigDia_C "Verzögerung Ersatzreaktion für Fehlerpfad Dfp_EGRCD_SigDia" VALUE 0xD16A6 Kw_Wu16 655350.0 Time_ms 0.00 655350.0 FORMAT "%8.1" /end CHARACTERISTIC
/begin CHARACTERISTIC DSM_DInDfp_EGRCD_SigDia2_C "Verzögerung Ersatzreaktion für Fehlerpfad Dfp_EGRCD_SigDia2" VALUE 0xD16A8 Kw_Wu16 655350.0 Time_ms 0.00 655350.0 FORMAT "%8.1" /end CHARACTERISTIC
/begin CHARACTERISTIC DSM_DInDfp_EGRCD_SigNpl_C "Verzögerung Ersatzreaktion für Fehlerpfad Dfp_EGRCD_SigNpl" VALUE 0xD16AA Kw_Wu16 655350.0 Time_ms 0.00 655350.0 FORMAT "%8.1" /end CHARACTERISTIC
/begin CHARACTERISTIC DSM_DInDfp_EGRCD_SigNpl2_C "Verzögerung Ersatzreaktion für Fehlerpfad Dfp_EGRCD_SigNpl2" VALUE 0xD16AC Kw_Wu16 655350.0 Time_ms 0.00 655350.0 FORMAT "%8.1" /end CHARACTERISTIC
/begin CHARACTERISTIC DSM_DInDfp_EGTOilLvlCrit_C "Verzögerung Ersatzreaktion für Fehlerpfad Dfp_EGTOilLvlCrit" VALUE 0xD16AE Kw_Wu16 655350.0 Time_ms 0.00 655350.0 FORMAT "%8.1" /end CHARACTERISTIC
/begin CHARACTERISTIC DSM_DInDfp_EGTOilVscCrit_C "Verzögerung Ersatzreaktion für Fehlerpfad Dfp_EGTOilVscCrit" VALUE 0xD16B0 Kw_Wu16 655350.0 Time_ms 0.00 655350.0 FORMAT "%8.1" /end CHARACTERISTIC
/begin CHARACTERISTIC DSM_DInDfp_EGTRgnOilDil_C "Verzögerung Ersatzreaktion für Fehlerpfad Dfp_EGTRgnOilDil" VALUE 0xD16B2 Kw_Wu16 655350.0 Time_ms 0.00 655350.0 FORMAT "%8.1" /end CHARACTERISTIC
/begin CHARACTERISTIC DSM_DInDfp_EGTTempGvnrInrB1_C "Verzögerung Ersatzreaktion für Fehlerpfad Dfp_EGTTempGvnrInrB1" VALUE 0xD16B4 Kw_Wu16 655350.0 Time_ms 0.00 655350.0 FORMAT "%8.1" /end CHARACTERISTIC
/begin CHARACTERISTIC DSM_DInDfp_EGTTempGvnrInrB2_C "Verzögerung Ersatzreaktion für Fehlerpfad Dfp_EGTTempGvnrInrB2" VALUE 0xD16B6 Kw_Wu16 655350.0 Time_ms 0.00 655350.0 FORMAT "%8.1" /end CHARACTERISTIC
/begin CHARACTERISTIC DSM_DInDfp_EGTTempGvnrOutrB1_C "Verzögerung Ersatzreaktion für Fehlerpfad Dfp_EGTTempGvnrOutrB1" VALUE 0xD16B8 Kw_Wu16 655350.0 Time_ms 0.00 655350.0 FORMAT "%8.1" /end CHARACTERISTIC
/begin CHARACTERISTIC DSM_DInDfp_EGTTempGvnrOutrB2_C "Verzögerung Ersatzreaktion für Fehlerpfad Dfp_EGTTempGvnrOutrB2" VALUE 0xD16BA Kw_Wu16 655350.0 Time_ms 0.00 655350.0 FORMAT "%8.1" /end CHARACTERISTIC
/begin CHARACTERISTIC DSM_DInDfp_ETClbETFltInj1_C "Verzögerung Ersatzreaktion für Fehlerpfad Dfp_ETClbETFltInj1" VALUE 0xD16BC Kw_Wu16 655350.0 Time_ms 0.00 655350.0 FORMAT "%8.1" /end CHARACTERISTIC
/begin CHARACTERISTIC DSM_DInDfp_ETClbETFltInj2_C "Verzögerung Ersatzreaktion für Fehlerpfad Dfp_ETClbETFltInj2" VALUE 0xD16BE Kw_Wu16 655350.0 Time_ms 0.00 655350.0 FORMAT "%8.1" /end CHARACTERISTIC
/begin CHARACTERISTIC DSM_DInDfp_ETClbETFltInj3_C "Verzögerung Ersatzreaktion für Fehlerpfad Dfp_ETClbETFltInj3" VALUE 0xD16C0 Kw_Wu16 655350.0 Time_ms 0.00 655350.0 FORMAT "%8.1" /end CHARACTERISTIC
/begin CHARACTERISTIC DSM_DInDfp_ETClbETFltInj4_C "Verzögerung Ersatzreaktion für Fehlerpfad Dfp_ETClbETFltInj4" VALUE 0xD16C2 Kw_Wu16 655350.0 Time_ms 0.00 655350.0 FORMAT "%8.1" /end CHARACTERISTIC
/begin CHARACTERISTIC DSM_DInDfp_ETClbETFltInj5_C "Verzögerung Ersatzreaktion für Fehlerpfad Dfp_ETClbETFltInj5" VALUE 0xD16C4 Kw_Wu16 655350.0 Time_ms 0.00 655350.0 FORMAT "%8.1" /end CHARACTERISTIC
/begin CHARACTERISTIC DSM_DInDfp_ETClbETFltInj6_C "Verzögerung Ersatzreaktion für Fehlerpfad Dfp_ETClbETFltInj6" VALUE 0xD16C6 Kw_Wu16 655350.0 Time_ms 0.00 655350.0 FORMAT "%8.1" /end CHARACTERISTIC
/begin CHARACTERISTIC DSM_DInDfp_ETClbETFltInj7_C "Verzögerung Ersatzreaktion für Fehlerpfad Dfp_ETClbETFltInj7" VALUE 0xD16C8 Kw_Wu16 655350.0 Time_ms 0.00 655350.0 FORMAT "%8.1" /end CHARACTERISTIC
/begin CHARACTERISTIC DSM_DInDfp_ETClbETFltInj8_C "Verzögerung Ersatzreaktion für Fehlerpfad Dfp_ETClbETFltInj8" VALUE 0xD16CA Kw_Wu16 655350.0 Time_ms 0.00 655350.0 FORMAT "%8.1" /end CHARACTERISTIC
/begin CHARACTERISTIC DSM_DInDfp_ETClbInj1_C "Verzögerung Ersatzreaktion für Fehlerpfad Dfp_ETClbInj1" VALUE 0xD16CC Kw_Wu16 655350.0 Time_ms 0.00 655350.0 FORMAT "%8.1" /end CHARACTERISTIC
/begin CHARACTERISTIC DSM_DInDfp_ETClbInj2_C "Verzögerung Ersatzreaktion für Fehlerpfad Dfp_ETClbInj2" VALUE 0xD16CE Kw_Wu16 655350.0 Time_ms 0.00 655350.0 FORMAT "%8.1" /end CHARACTERISTIC
/begin CHARACTERISTIC DSM_DInDfp_ETClbInj3_C "Verzögerung Ersatzreaktion für Fehlerpfad Dfp_ETClbInj3" VALUE 0xD16D0 Kw_Wu16 655350.0 Time_ms 0.00 655350.0 FORMAT "%8.1" /end CHARACTERISTIC
/begin CHARACTERISTIC DSM_DInDfp_ETClbInj4_C "Verzögerung Ersatzreaktion für Fehlerpfad Dfp_ETClbInj4" VALUE 0xD16D2 Kw_Wu16 655350.0 Time_ms 0.00 655350.0 FORMAT "%8.1" /end CHARACTERISTIC
/begin CHARACTERISTIC DSM_DInDfp_ETClbInj5_C "Verzögerung Ersatzreaktion für Fehlerpfad Dfp_ETClbInj5" VALUE 0xD16D4 Kw_Wu16 655350.0 Time_ms 0.00 655350.0 FORMAT "%8.1" /end CHARACTERISTIC
/begin CHARACTERISTIC DSM_DInDfp_ETClbInj6_C "Verzögerung Ersatzreaktion für Fehlerpfad Dfp_ETClbInj6" VALUE 0xD16D6 Kw_Wu16 655350.0 Time_ms 0.00 655350.0 FORMAT "%8.1" /end CHARACTERISTIC
/begin CHARACTERISTIC DSM_DInDfp_ETClbInj7_C "Verzögerung Ersatzreaktion für Fehlerpfad Dfp_ETClbInj7" VALUE 0xD16D8 Kw_Wu16 655350.0 Time_ms 0.00 655350.0 FORMAT "%8.1" /end CHARACTERISTIC
/begin CHARACTERISTIC DSM_DInDfp_ETClbInj8_C "Verzögerung Ersatzreaktion für Fehlerpfad Dfp_ETClbInj8" VALUE 0xD16DA Kw_Wu16 655350.0 Time_ms 0.00 655350.0 FORMAT "%8.1" /end CHARACTERISTIC
/begin CHARACTERISTIC DSM_DInDfp_EngMCaS1_C "Verzögerung Ersatzreaktion für Fehlerpfad Dfp_EngMCaS1" VALUE 0xD16DC Kw_Wu16 655350.0 Time_ms 0.00 655350.0 FORMAT "%8.1" /end CHARACTERISTIC
/begin CHARACTERISTIC DSM_DInDfp_EngMCrS1_C "Verzögerung Ersatzreaktion für Fehlerpfad Dfp_EngMCrS1" VALUE 0xD16DE Kw_Wu16 655350.0 Time_ms 0.00 655350.0 FORMAT "%8.1" /end CHARACTERISTIC
/begin CHARACTERISTIC DSM_DInDfp_EngMOfsCaSCrS_C "Verzögerung Ersatzreaktion für Fehlerpfad Dfp_EngMOfsCaSCrS" VALUE 0xD16E0 Kw_Wu16 655350.0 Time_ms 0.00 655350.0 FORMAT "%8.1" /end CHARACTERISTIC
/begin CHARACTERISTIC DSM_DInDfp_EngMntCtlCD_C "Verzögerung Ersatzreaktion für Fehlerpfad Dfp_EngMntCtlCD" VALUE 0xD16E2 Kw_Wu16 655350.0 Time_ms 0.00 655350.0 FORMAT "%8.1" /end CHARACTERISTIC
/begin CHARACTERISTIC DSM_DInDfp_FBCqDvt_C "Verzögerung Ersatzreaktion für Fehlerpfad Dfp_FBCqDvt" VALUE 0xD16E4 Kw_Wu16 655350.0 Time_ms 0.00 655350.0 FORMAT "%8.1" /end CHARACTERISTIC
/begin CHARACTERISTIC DSM_DInDfp_FMAErrMod_C "Verzögerung Ersatzreaktion für Fehlerpfad Dfp_FMAErrMod" VALUE 0xD16E6 Kw_Wu16 655350.0 Time_ms 0.00 655350.0 FORMAT "%8.1" /end CHARACTERISTIC
/begin CHARACTERISTIC DSM_DInDfp_FMTC_NonMonotonMap_C "Verzögerung Ersatzreaktion für Fehlerpfad Dfp_FMTC_NonMonotonMap" VALUE 0xD16E8 Kw_Wu16 655350.0 Time_ms 0.00 655350.0 FORMAT "%8.1" /end CHARACTERISTIC
/begin CHARACTERISTIC DSM_DInDfp_FTSCD_C "Verzögerung Ersatzreaktion für Fehlerpfad Dfp_FTSCD" VALUE 0xD16EA Kw_Wu16 655350.0 Time_ms 0.00 655350.0 FORMAT "%8.1" /end CHARACTERISTIC
/begin CHARACTERISTIC DSM_DInDfp_FanCD_C "Verzögerung Ersatzreaktion für Fehlerpfad Dfp_FanCD" VALUE 0xD16EC Kw_Wu16 655350.0 Time_ms 0.00 655350.0 FORMAT "%8.1" /end CHARACTERISTIC
/begin CHARACTERISTIC DSM_DInDfp_FanCD_FanCtlr1_C "Verzögerung Ersatzreaktion für Fehlerpfad Dfp_FanCD_FanCtlr1" VALUE 0xD16EE Kw_Wu16 655350.0 Time_ms 0.00 655350.0 FORMAT "%8.1" /end CHARACTERISTIC
/begin CHARACTERISTIC DSM_DInDfp_FanCD_FanCtlr2_C "Verzögerung Ersatzreaktion für Fehlerpfad Dfp_FanCD_FanCtlr2" VALUE 0xD16F0 Kw_Wu16 655350.0 Time_ms 0.00 655350.0 FORMAT "%8.1" /end CHARACTERISTIC
/begin CHARACTERISTIC DSM_DInDfp_FanCD_FanCtlr3_C "Verzögerung Ersatzreaktion für Fehlerpfad Dfp_FanCD_FanCtlr3" VALUE 0xD16F2 Kw_Wu16 655350.0 Time_ms 0.00 655350.0 FORMAT "%8.1" /end CHARACTERISTIC
/begin CHARACTERISTIC DSM_DInDfp_FlFCD_C "Verzögerung Ersatzreaktion für Fehlerpfad Dfp_FlFCD" VALUE 0xD16F4 Kw_Wu16 655350.0 Time_ms 0.00 655350.0 FORMAT "%8.1" /end CHARACTERISTIC
/begin CHARACTERISTIC DSM_DInDfp_FlMngSmkDefect_C "Verzögerung Ersatzreaktion für Fehlerpfad Dfp_FlMngSmkDefect" VALUE 0xD16F6 Kw_Wu16 655350.0 Time_ms 0.00 655350.0 FORMAT "%8.1" /end CHARACTERISTIC
/begin CHARACTERISTIC DSM_DInDfp_FlSCDT1_C "Verzögerung Ersatzreaktion für Fehlerpfad Dfp_FlSCDT1" VALUE 0xD16F8 Kw_Wu16 655350.0 Time_ms 0.00 655350.0 FORMAT "%8.1" /end CHARACTERISTIC
/begin CHARACTERISTIC DSM_DInDfp_FrmMngANFRADMOMPT_C "Verzögerung Ersatzreaktion für Fehlerpfad Dfp_FrmMngANFRADMOMPT" VALUE 0xD16FA Kw_Wu16 655350.0 Time_ms 0.00 655350.0 FORMAT "%8.1" /end CHARACTERISTIC
/begin CHARACTERISTIC DSM_DInDfp_FrmMngASC1_C "Verzögerung Ersatzreaktion für Fehlerpfad Dfp_FrmMngASC1" VALUE 0xD16FC Kw_Wu16 655350.0 Time_ms 0.00 655350.0 FORMAT "%8.1" /end CHARACTERISTIC
/begin CHARACTERISTIC DSM_DInDfp_FrmMngASC2_C "Verzögerung Ersatzreaktion für Fehlerpfad Dfp_FrmMngASC2" VALUE 0xD16FE Kw_Wu16 655350.0 Time_ms 0.00 655350.0 FORMAT "%8.1" /end CHARACTERISTIC
/begin CHARACTERISTIC DSM_DInDfp_FrmMngASC3_C "Verzögerung Ersatzreaktion für Fehlerpfad Dfp_FrmMngASC3" VALUE 0xD1700 Kw_Wu16 655350.0 Time_ms 0.00 655350.0 FORMAT "%8.1" /end CHARACTERISTIC
/begin CHARACTERISTIC DSM_DInDfp_FrmMngASC4_C "Verzögerung Ersatzreaktion für Fehlerpfad Dfp_FrmMngASC4" VALUE 0xD1702 Kw_Wu16 655350.0 Time_ms 0.00 655350.0 FORMAT "%8.1" /end CHARACTERISTIC
/begin CHARACTERISTIC DSM_DInDfp_FrmMngBOS_RESET_C "Verzögerung Ersatzreaktion für Fehlerpfad Dfp_FrmMngBOS_RESET" VALUE 0xD1704 Kw_Wu16 655350.0 Time_ms 0.00 655350.0 FORMAT "%8.1" /end CHARACTERISTIC
/begin CHARACTERISTIC DSM_DInDfp_FrmMngBOS_RESET2_C "Verzögerung Ersatzreaktion für Fehlerpfad Dfp_FrmMngBOS_RESET2" VALUE 0xD1706 Kw_Wu16 655350.0 Time_ms 0.00 655350.0 FORMAT "%8.1" /end CHARACTERISTIC
/begin CHARACTERISTIC DSM_DInDfp_FrmMngDMANFAFS_C "Verzögerung Ersatzreaktion für Fehlerpfad Dfp_FrmMngDMANFAFS" VALUE 0xD1708 Kw_Wu16 655350.0 Time_ms 0.00 655350.0 FORMAT "%8.1" /end CHARACTERISTIC
/begin CHARACTERISTIC DSM_DInDfp_FrmMngDRMANFSSG_C "Verzögerung Ersatzreaktion für Fehlerpfad Dfp_FrmMngDRMANFSSG" VALUE 0xD170A Kw_Wu16 655350.0 Time_ms 0.00 655350.0 FORMAT "%8.1" /end CHARACTERISTIC
/begin CHARACTERISTIC DSM_DInDfp_FrmMngEGS1_C "Verzögerung Ersatzreaktion für Fehlerpfad Dfp_FrmMngEGS1" VALUE 0xD170C Kw_Wu16 655350.0 Time_ms 0.00 655350.0 FORMAT "%8.1" /end CHARACTERISTIC
/begin CHARACTERISTIC DSM_DInDfp_FrmMngEGS2_C "Verzögerung Ersatzreaktion für Fehlerpfad Dfp_FrmMngEGS2" VALUE 0xD170E Kw_Wu16 655350.0 Time_ms 0.00 655350.0 FORMAT "%8.1" /end CHARACTERISTIC
/begin CHARACTERISTIC DSM_DInDfp_FrmMngGEARBX_DATA_C "Verzögerung Ersatzreaktion für Fehlerpfad Dfp_FrmMngGEARBX_DATA" VALUE 0xD1710 Kw_Wu16 655350.0 Time_ms 0.00 655350.0 FORMAT "%8.1" /end CHARACTERISTIC
/begin CHARACTERISTIC DSM_DInDfp_FrmMngGEARBX_DATA2_C "Verzögerung Ersatzreaktion für Fehlerpfad Dfp_FrmMngGEARBX_DATA2" VALUE 0xD1712 Kw_Wu16 655350.0 Time_ms 0.00 655350.0 FORMAT "%8.1" /end CHARACTERISTIC
/begin CHARACTERISTIC DSM_DInDfp_FrmMngHEAT_AC_C "Verzögerung Ersatzreaktion für Fehlerpfad Dfp_FrmMngHEAT_AC" VALUE 0xD1714 Kw_Wu16 655350.0 Time_ms 0.00 655350.0 FORMAT "%8.1" /end CHARACTERISTIC
/begin CHARACTERISTIC DSM_DInDfp_FrmMngINSTR2_C "Verzögerung Ersatzreaktion für Fehlerpfad Dfp_FrmMngINSTR2" VALUE 0xD1716 Kw_Wu16 655350.0 Time_ms 0.00 655350.0 FORMAT "%8.1" /end CHARACTERISTIC
/begin CHARACTERISTIC DSM_DInDfp_FrmMngINSTR3_C "Verzögerung Ersatzreaktion für Fehlerpfad Dfp_FrmMngINSTR3" VALUE 0xD1718 Kw_Wu16 655350.0 Time_ms 0.00 655350.0 FORMAT "%8.1" /end CHARACTERISTIC
/begin CHARACTERISTIC DSM_DInDfp_FrmMngLENKRADWINKEL_C "Verzögerung Ersatzreaktion für Fehlerpfad Dfp_FrmMngLENKRADWINKEL" VALUE 0xD171A Kw_Wu16 655350.0 Time_ms 0.00 655350.0 FORMAT "%8.1" /end CHARACTERISTIC
/begin CHARACTERISTIC DSM_DInDfp_FrmMngMILEAGE_RANGE_C "Verzögerung Ersatzreaktion für Fehlerpfad Dfp_FrmMngMILEAGE_RANGE" VALUE 0xD171C Kw_Wu16 655350.0 Time_ms 0.00 655350.0 FORMAT "%8.1" /end CHARACTERISTIC
/begin CHARACTERISTIC DSM_DInDfp_FrmMngMSPHISYNC_C "Verzögerung Ersatzreaktion für Fehlerpfad Dfp_FrmMngMSPHISYNC" VALUE 0xD171E Kw_Wu16 655350.0 Time_ms 0.00 655350.0 FORMAT "%8.1" /end CHARACTERISTIC
/begin CHARACTERISTIC DSM_DInDfp_FrmMngMST4_C "Verzögerung Ersatzreaktion für Fehlerpfad Dfp_FrmMngMST4" VALUE 0xD1720 Kw_Wu16 655350.0 Time_ms 0.00 655350.0 FORMAT "%8.1" /end CHARACTERISTIC
/begin CHARACTERISTIC DSM_DInDfp_FrmMngMST5_C "Verzögerung Ersatzreaktion für Fehlerpfad Dfp_FrmMngMST5" VALUE 0xD1722 Kw_Wu16 655350.0 Time_ms 0.00 655350.0 FORMAT "%8.1" /end CHARACTERISTIC
/begin CHARACTERISTIC DSM_DInDfp_FrmMngOPCRCTLACC_C "Verzögerung Ersatzreaktion für Fehlerpfad Dfp_FrmMngOPCRCTLACC" VALUE 0xD1724 Kw_Wu16 655350.0 Time_ms 0.00 655350.0 FORMAT "%8.1" /end CHARACTERISTIC
/begin CHARACTERISTIC DSM_DInDfp_FrmMngPRGG_CCTR_C "Verzögerung Ersatzreaktion für Fehlerpfad Dfp_FrmMngPRGG_CCTR" VALUE 0xD1726 Kw_Wu16 655350.0 Time_ms 0.00 655350.0 FORMAT "%8.1" /end CHARACTERISTIC
/begin CHARACTERISTIC DSM_DInDfp_FrmMngPWRMNG_LOADV_C "Verzögerung Ersatzreaktion für Fehlerpfad Dfp_FrmMngPWRMNG_LOADV" VALUE 0xD1728 Kw_Wu16 655350.0 Time_ms 0.00 655350.0 FORMAT "%8.1" /end CHARACTERISTIC
/begin CHARACTERISTIC DSM_DInDfp_FrmMngParkConsumer_C "Verzögerung Ersatzreaktion für Fehlerpfad Dfp_FrmMngParkConsumer_C" VALUE 0xD172A Kw_Wu16 655350.0 Time_ms 0.00 655350.0 FORMAT "%8.1" /end CHARACTERISTIC
/begin CHARACTERISTIC DSM_DInDfp_FrmMngRQSTGEFAN_C "Verzögerung Ersatzreaktion für Fehlerpfad Dfp_FrmMngRQSTGEFAN_C" VALUE 0xD172C Kw_Wu16 655350.0 Time_ms 0.00 655350.0 FORMAT "%8.1" /end CHARACTERISTIC
/begin CHARACTERISTIC DSM_DInDfp_FrmMngSLV4_C "Verzögerung Ersatzreaktion für Fehlerpfad Dfp_FrmMngSLV4" VALUE 0xD172E Kw_Wu16 655350.0 Time_ms 0.00 655350.0 FORMAT "%8.1" /end CHARACTERISTIC
/begin CHARACTERISTIC DSM_DInDfp_FrmMngSLV5_C "Verzögerung Ersatzreaktion für Fehlerpfad Dfp_FrmMngSLV5" VALUE 0xD1730 Kw_Wu16 655350.0 Time_ms 0.00 655350.0 FORMAT "%8.1" /end CHARACTERISTIC
/begin CHARACTERISTIC DSM_DInDfp_FrmMngSSGErr_C "Verzögerung Ersatzreaktion für Fehlerpfad Dfp_FrmMngSSGErr" VALUE 0xD1732 Kw_Wu16 655350.0 Time_ms 0.00 655350.0 FORMAT "%8.1" /end CHARACTERISTIC
/begin CHARACTERISTIC DSM_DInDfp_FrmMngSSGShOff_C "Verzögerung Ersatzreaktion für Fehlerpfad Dfp_FrmMngSSGShOff" VALUE 0xD1734 Kw_Wu16 655350.0 Time_ms 0.00 655350.0 FORMAT "%8.1" /end CHARACTERISTIC
/begin CHARACTERISTIC DSM_DInDfp_FrmMngSTAT_ANH_C "Verzögerung Ersatzreaktion für Fehlerpfad Dfp_FrmMngSTAT_ANH" VALUE 0xD1736 Kw_Wu16 655350.0 Time_ms 0.00 655350.0 FORMAT "%8.1" /end CHARACTERISTIC
/begin CHARACTERISTIC DSM_DInDfp_FrmMngSTAT_ARS_C "Verzögerung Ersatzreaktion für Fehlerpfad Dfp_FrmMngSTAT_ARS" VALUE 0xD1738 Kw_Wu16 655350.0 Time_ms 0.00 655350.0 FORMAT "%8.1" /end CHARACTERISTIC
/begin CHARACTERISTIC DSM_DInDfp_FrmMngSTAT_DSC_C "Verzögerung Ersatzreaktion für Fehlerpfad Dfp_FrmMngSTAT_DSC" VALUE 0xD173A Kw_Wu16 655350.0 Time_ms 0.00 655350.0 FORMAT "%8.1" /end CHARACTERISTIC
/begin CHARACTERISTIC DSM_DInDfp_FrmMngSTAT_EKP_C "Verzögerung Ersatzreaktion für Fehlerpfad Dfp_FrmMngSTAT_EKP" VALUE 0xD173C Kw_Wu16 655350.0 Time_ms 0.00 655350.0 FORMAT "%8.1" /end CHARACTERISTIC
/begin CHARACTERISTIC DSM_DInDfp_FrmMngSTAT_KOMBI_C "Verzögerung Ersatzreaktion für Fehlerpfad Dfp_FrmMngSTAT_KOMBI" VALUE 0xD173E Kw_Wu16 655350.0 Time_ms 0.00 655350.0 FORMAT "%8.1" /end CHARACTERISTIC
/begin CHARACTERISTIC DSM_DInDfp_FrmMngSTAT_SITZ_C "Verzögerung Ersatzreaktion für Fehlerpfad Dfp_FrmMngSTAT_SITZ" VALUE 0xD1740 Kw_Wu16 655350.0 Time_ms 0.00 655350.0 FORMAT "%8.1" /end CHARACTERISTIC
/begin CHARACTERISTIC DSM_DInDfp_FrmMngStOBDGbxMilOf_C "Verzögerung Ersatzreaktion für Fehlerpfad Dfp_FrmMngStOBDGbxMilOf" VALUE 0xD1742 Kw_Wu16 655350.0 Time_ms 0.00 655350.0 FORMAT "%8.1" /end CHARACTERISTIC
/begin CHARACTERISTIC DSM_DInDfp_FrmMngStOBDGbxMilOn_C "Verzögerung Ersatzreaktion für Fehlerpfad Dfp_FrmMngStOBDGbxMilOn" VALUE 0xD1744 Kw_Wu16 655350.0 Time_ms 0.00 655350.0 FORMAT "%8.1" /end CHARACTERISTIC
/begin CHARACTERISTIC DSM_DInDfp_FrmMngTEMPRELTIME_C "Verzögerung Ersatzreaktion für Fehlerpfad Dfp_FrmMngTEMPRELTIME" VALUE 0xD1746 Kw_Wu16 655350.0 Time_ms 0.00 655350.0 FORMAT "%8.1" /end CHARACTERISTIC
/begin CHARACTERISTIC DSM_DInDfp_FrmMngTERMINAL_C "Verzögerung Ersatzreaktion für Fehlerpfad Dfp_FrmMngTERMINAL" VALUE 0xD1748 Kw_Wu16 655350.0 Time_ms 0.00 655350.0 FORMAT "%8.1" /end CHARACTERISTIC
/begin CHARACTERISTIC DSM_DInDfp_FrmMngTIME_DATE_C "Verzögerung Ersatzreaktion für Fehlerpfad Dfp_FrmMngTIME_DATE" VALUE 0xD174A Kw_Wu16 655350.0 Time_ms 0.00 655350.0 FORMAT "%8.1" /end CHARACTERISTIC
/begin CHARACTERISTIC DSM_DInDfp_FrmMngTORQUE_DSC_C "Verzögerung Ersatzreaktion für Fehlerpfad Dfp_FrmMngTORQUE_DSC" VALUE 0xD174C Kw_Wu16 655350.0 Time_ms 0.00 655350.0 FORMAT "%8.1" /end CHARACTERISTIC
/begin CHARACTERISTIC DSM_DInDfp_FrmMngTORQUE_GEARBX_C "Verzögerung Ersatzreaktion für Fehlerpfad Dfp_FrmMngTORQUE_GEARBX" VALUE 0xD174E Kw_Wu16 655350.0 Time_ms 0.00 655350.0 FORMAT "%8.1" /end CHARACTERISTIC
/begin CHARACTERISTIC DSM_DInDfp_FrmMngTrq_ReqACC_C "Verzögerung Ersatzreaktion für Fehlerpfad Dfp_FrmMngTrq_ReqACC" VALUE 0xD1750 Kw_Wu16 655350.0 Time_ms 0.00 655350.0 FORMAT "%8.1" /end CHARACTERISTIC
/begin CHARACTERISTIC DSM_DInDfp_FrmMngVEH_MOD_C "Verzögerung Ersatzreaktion für Fehlerpfad Dfp_FrmMngVEH_MOD_C" VALUE 0xD1752 Kw_Wu16 655350.0 Time_ms 0.00 655350.0 FORMAT "%8.1" /end CHARACTERISTIC
/begin CHARACTERISTIC DSM_DInDfp_FrmMngVELOCITY_C "Verzögerung Ersatzreaktion für Fehlerpfad Dfp_FrmMngVELOCITY" VALUE 0xD1754 Kw_Wu16 655350.0 Time_ms 0.00 655350.0 FORMAT "%8.1" /end CHARACTERISTIC
/begin CHARACTERISTIC DSM_DInDfp_FrmMngWHEEL_SPEED_C "Verzögerung Ersatzreaktion für Fehlerpfad Dfp_FrmMngWHEEL_SPEED" VALUE 0xD1756 Kw_Wu16 655350.0 Time_ms 0.00 655350.0 FORMAT "%8.1" /end CHARACTERISTIC
/begin CHARACTERISTIC DSM_DInDfp_FrmMngstCurr_C "Inhibitlabel für Dfp_FrmMngstCurr" VALUE 0xD1758 Kw_Wu16 655350.0 Time_ms 0.00 655350.0 FORMAT "%8.1" /end CHARACTERISTIC
/begin CHARACTERISTIC DSM_DInDfp_FrmMngswtPSPOff_C "Inhibitlabel für Dfp_FrmMngswtPSPOff" VALUE 0xD175A Kw_Wu16 655350.0 Time_ms 0.00 655350.0 FORMAT "%8.1" /end CHARACTERISTIC
/begin CHARACTERISTIC DSM_DInDfp_GearbxIncMax_C "Verzögerung Ersatzreaktion für Fehlerpfad Dfp_GearbxIncMax" VALUE 0xD175C Kw_Wu16 655350.0 Time_ms 0.00 655350.0 FORMAT "%8.1" /end CHARACTERISTIC
/begin CHARACTERISTIC DSM_DInDfp_GlwCD_C "Verzögerung Ersatzreaktion für Fehlerpfad Dfp_GlwCD" VALUE 0xD175E Kw_Wu16 655350.0 Time_ms 0.00 655350.0 FORMAT "%8.1" /end CHARACTERISTIC
/begin CHARACTERISTIC DSM_DInDfp_GlwCDGlwCirc1_C "Verzögerung Ersatzreaktion für Fehlerpfad Dfp_GlwCDGlwCirc1" VALUE 0xD1760 Kw_Wu16 655350.0 Time_ms 0.00 655350.0 FORMAT "%8.1" /end CHARACTERISTIC
/begin CHARACTERISTIC DSM_DInDfp_GlwCDGlwCirc2_C "Verzögerung Ersatzreaktion für Fehlerpfad Dfp_GlwCDGlwCirc2" VALUE 0xD1762 Kw_Wu16 655350.0 Time_ms 0.00 655350.0 FORMAT "%8.1" /end CHARACTERISTIC
/begin CHARACTERISTIC DSM_DInDfp_GlwCDGlwCirc3_C "Verzögerung Ersatzreaktion für Fehlerpfad Dfp_GlwCDGlwCirc3" VALUE 0xD1764 Kw_Wu16 655350.0 Time_ms 0.00 655350.0 FORMAT "%8.1" /end CHARACTERISTIC
/begin CHARACTERISTIC DSM_DInDfp_GlwCDGlwCirc4_C "Verzögerung Ersatzreaktion für Fehlerpfad Dfp_GlwCDGlwCirc4" VALUE 0xD1766 Kw_Wu16 655350.0 Time_ms 0.00 655350.0 FORMAT "%8.1" /end CHARACTERISTIC
/begin CHARACTERISTIC DSM_DInDfp_GlwCDGlwCirc5_C "Verzögerung Ersatzreaktion für Fehlerpfad Dfp_GlwCDGlwCirc5" VALUE 0xD1768 Kw_Wu16 655350.0 Time_ms 0.00 655350.0 FORMAT "%8.1" /end CHARACTERISTIC
/begin CHARACTERISTIC DSM_DInDfp_GlwCDGlwCirc6_C "Verzögerung Ersatzreaktion für Fehlerpfad Dfp_GlwCDGlwCirc6" VALUE 0xD176A Kw_Wu16 655350.0 Time_ms 0.00 655350.0 FORMAT "%8.1" /end CHARACTERISTIC
/begin CHARACTERISTIC DSM_DInDfp_GlwCDGlwCirc7_C "Verzögerung Ersatzreaktion für Fehlerpfad Dfp_GlwCDGlwCirc7" VALUE 0xD176C Kw_Wu16 655350.0 Time_ms 0.00 655350.0 FORMAT "%8.1" /end CHARACTERISTIC
/begin CHARACTERISTIC DSM_DInDfp_GlwCDGlwCirc8_C "Verzögerung Ersatzreaktion für Fehlerpfad Dfp_GlwCDGlwCirc8" VALUE 0xD176E Kw_Wu16 655350.0 Time_ms 0.00 655350.0 FORMAT "%8.1" /end CHARACTERISTIC
/begin CHARACTERISTIC DSM_DInDfp_GlwCtl_C "Verzögerung Ersatzreaktion für Fehlerpfad Dfp_GlwCtl" VALUE 0xD1770 Kw_Wu16 655350.0 Time_ms 0.00 655350.0 FORMAT "%8.1" /end CHARACTERISTIC
/begin CHARACTERISTIC DSM_DInDfp_HWEMonCom_C "Verzögerung Ersatzreaktion für Fehlerpfad Dfp_HWEMonCom" VALUE 0xD1772 Kw_Wu16 655350.0 Time_ms 0.00 655350.0 FORMAT "%8.1" /end CHARACTERISTIC
/begin CHARACTERISTIC DSM_DInDfp_HWEMonEEPROM_C "Verzögerung Ersatzreaktion für Fehlerpfad Dfp_HWEMonEEPROM" VALUE 0xD1774 Kw_Wu16 655350.0 Time_ms 0.00 655350.0 FORMAT "%8.1" /end CHARACTERISTIC
/begin CHARACTERISTIC DSM_DInDfp_HWEMonRcyLocked_C "Verzögerung Ersatzreaktion für Fehlerpfad Dfp_HWEMonRcyLocked" VALUE 0xD1776 Kw_Wu16 655350.0 Time_ms 0.00 655350.0 FORMAT "%8.1" /end CHARACTERISTIC
/begin CHARACTERISTIC DSM_DInDfp_HWEMonRcySuppressed_C "Verzögerung Ersatzreaktion für Fehlerpfad Dfp_HWEMonRcySuppressed" VALUE 0xD1778 Kw_Wu16 655350.0 Time_ms 0.00 655350.0 FORMAT "%8.1" /end CHARACTERISTIC
/begin CHARACTERISTIC DSM_DInDfp_HWEMonRcyVisible_C "Verzögerung Ersatzreaktion für Fehlerpfad Dfp_HWEMonRcyVisible" VALUE 0xD177A Kw_Wu16 655350.0 Time_ms 0.00 655350.0 FORMAT "%8.1" /end CHARACTERISTIC
/begin CHARACTERISTIC DSM_DInDfp_HWEMonUMaxSupply_C "Verzögerung Ersatzreaktion für Fehlerpfad Dfp_HWEMonUMaxSupply" VALUE 0xD177C Kw_Wu16 655350.0 Time_ms 0.00 655350.0 FORMAT "%8.1" /end CHARACTERISTIC
/begin CHARACTERISTIC DSM_DInDfp_HWEMonUMinSupply_C "Verzögerung Ersatzreaktion für Fehlerpfad Dfp_HWEMonUMinSupply" VALUE 0xD177E Kw_Wu16 655350.0 Time_ms 0.00 655350.0 FORMAT "%8.1" /end CHARACTERISTIC
/begin CHARACTERISTIC DSM_DInDfp_IATSCD_C "Verzögerung Ersatzreaktion für Fehlerpfad Dfp_IATSCD" VALUE 0xD1780 Kw_Wu16 655350.0 Time_ms 0.00 655350.0 FORMAT "%8.1" /end CHARACTERISTIC
/begin CHARACTERISTIC DSM_DInDfp_IATSCD_CATS_C "Verzögerung Ersatzreaktion für Fehlerpfad Dfp_IATSCD_CATS" VALUE 0xD1782 Kw_Wu16 655350.0 Time_ms 0.00 655350.0 FORMAT "%8.1" /end CHARACTERISTIC
/begin CHARACTERISTIC DSM_DInDfp_IATSCD_CATSSec_C "Verzögerung Ersatzreaktion für Fehlerpfad Dfp_IATSCD_CATSSec" VALUE 0xD1784 Kw_Wu16 655350.0 Time_ms 0.00 655350.0 FORMAT "%8.1" /end CHARACTERISTIC
/begin CHARACTERISTIC DSM_DInDfp_ImmCtlImmCD_C "Verzögerung Ersatzreaktion für Fehlerpfad Dfp_ImmCtlImmCD" VALUE 0xD1786 Kw_Wu16 655350.0 Time_ms 0.00 655350.0 FORMAT "%8.1" /end CHARACTERISTIC
/begin CHARACTERISTIC DSM_DInDfp_ImmCtlImmEep_C "Verzögerung Ersatzreaktion für Fehlerpfad Dfp_ImmCtlImmEep" VALUE 0xD1788 Kw_Wu16 655350.0 Time_ms 0.00 655350.0 FORMAT "%8.1" /end CHARACTERISTIC
/begin CHARACTERISTIC DSM_DInDfp_ImmCtlMpl_C "Verzögerung Ersatzreaktion für Fehlerpfad Dfp_ImmCtlMpl" VALUE 0xD178A Kw_Wu16 655350.0 Time_ms 0.00 655350.0 FORMAT "%8.1" /end CHARACTERISTIC
/begin CHARACTERISTIC DSM_DInDfp_IndSys1_C "Verzögerung Ersatzreaktion für Fehlerpfad Dfp_IndSys1" VALUE 0xD178C Kw_Wu16 655350.0 Time_ms 0.00 655350.0 FORMAT "%8.1" /end CHARACTERISTIC
/begin CHARACTERISTIC DSM_DInDfp_IndSys2_C "Verzögerung Ersatzreaktion für Fehlerpfad Dfp_IndSys2" VALUE 0xD178E Kw_Wu16 655350.0 Time_ms 0.00 655350.0 FORMAT "%8.1" /end CHARACTERISTIC
/begin CHARACTERISTIC DSM_DInDfp_InjCrv_InjLim_C "Verzögerung Ersatzreaktion für Fehlerpfad Dfp_InjCrv_InjLim" VALUE 0xD1790 Kw_Wu16 655350.0 Time_ms 0.00 655350.0 FORMAT "%8.1" /end CHARACTERISTIC
/begin CHARACTERISTIC DSM_DInDfp_InjCtlAdjQnt_C "Verzögerung Ersatzreaktion für Fehlerpfad Dfp_InjCtlAdjQnt" VALUE 0xD1792 Kw_Wu16 655350.0 Time_ms 0.00 655350.0 FORMAT "%8.1" /end CHARACTERISTIC
/begin CHARACTERISTIC DSM_DInDfp_InjCtlDrift_C "Verzögerung Ersatzreaktion für Fehlerpfad Dfp_InjCtlDrift" VALUE 0xD1794 Kw_Wu16 655350.0 Time_ms 0.00 655350.0 FORMAT "%8.1" /end CHARACTERISTIC
/begin CHARACTERISTIC DSM_DInDfp_InjVCDActrChrg_C "Verzögerung Ersatzreaktion für Fehlerpfad Dfp_InjVCDActrChrg" VALUE 0xD1796 Kw_Wu16 655350.0 Time_ms 0.00 655350.0 FORMAT "%8.1" /end CHARACTERISTIC
/begin CHARACTERISTIC DSM_DInDfp_InjVCDActrEnrg1_C "Verzögerung Ersatzreaktion für Fehlerpfad Dfp_InjVCDActrEnrg1" VALUE 0xD1798 Kw_Wu16 655350.0 Time_ms 0.00 655350.0 FORMAT "%8.1" /end CHARACTERISTIC
/begin CHARACTERISTIC DSM_DInDfp_InjVCDActrEnrg2_C "Verzögerung Ersatzreaktion für Fehlerpfad Dfp_InjVCDActrEnrg2" VALUE 0xD179A Kw_Wu16 655350.0 Time_ms 0.00 655350.0 FORMAT "%8.1" /end CHARACTERISTIC
/begin CHARACTERISTIC DSM_DInDfp_InjVCDActrEnrg3_C "Verzögerung Ersatzreaktion für Fehlerpfad Dfp_InjVCDActrEnrg3" VALUE 0xD179C Kw_Wu16 655350.0 Time_ms 0.00 655350.0 FORMAT "%8.1" /end CHARACTERISTIC
/begin CHARACTERISTIC DSM_DInDfp_InjVCDActrEnrg4_C "Verzögerung Ersatzreaktion für Fehlerpfad Dfp_InjVCDActrEnrg4" VALUE 0xD179E Kw_Wu16 655350.0 Time_ms 0.00 655350.0 FORMAT "%8.1" /end CHARACTERISTIC
/begin CHARACTERISTIC DSM_DInDfp_InjVCDActrEnrg5_C "Verzögerung Ersatzreaktion für Fehlerpfad Dfp_InjVCDActrEnrg5" VALUE 0xD17A0 Kw_Wu16 655350.0 Time_ms 0.00 655350.0 FORMAT "%8.1" /end CHARACTERISTIC
/begin CHARACTERISTIC DSM_DInDfp_InjVCDActrEnrg6_C "Verzögerung Ersatzreaktion für Fehlerpfad Dfp_InjVCDActrEnrg6" VALUE 0xD17A2 Kw_Wu16 655350.0 Time_ms 0.00 655350.0 FORMAT "%8.1" /end CHARACTERISTIC
/begin CHARACTERISTIC DSM_DInDfp_InjVCDActrEnrg7_C "Verzögerung Ersatzreaktion für Fehlerpfad Dfp_InjVCDActrEnrg7" VALUE 0xD17A4 Kw_Wu16 655350.0 Time_ms 0.00 655350.0 FORMAT "%8.1" /end CHARACTERISTIC
/begin CHARACTERISTIC DSM_DInDfp_InjVCDActrEnrg8_C "Verzögerung Ersatzreaktion für Fehlerpfad Dfp_InjVCDActrEnrg8" VALUE 0xD17A6 Kw_Wu16 655350.0 Time_ms 0.00 655350.0 FORMAT "%8.1" /end CHARACTERISTIC
/begin CHARACTERISTIC DSM_DInDfp_InjVCDActrVolt_C "Verzögerung Ersatzreaktion für Fehlerpfad Dfp_InjVCDActrVolt" VALUE 0xD17A8 Kw_Wu16 655350.0 Time_ms 0.00 655350.0 FORMAT "%8.1" /end CHARACTERISTIC
/begin CHARACTERISTIC DSM_DInDfp_InjVCDClsBank1_C "Verzögerung Ersatzreaktion für Fehlerpfad Dfp_InjVCDClsBank1" VALUE 0xD17AA Kw_Wu16 655350.0 Time_ms 0.00 655350.0 FORMAT "%8.1" /end CHARACTERISTIC
/begin CHARACTERISTIC DSM_DInDfp_InjVCDClsBank2_C "Verzögerung Ersatzreaktion für Fehlerpfad Dfp_InjVCDClsBank2" VALUE 0xD17AC Kw_Wu16 655350.0 Time_ms 0.00 655350.0 FORMAT "%8.1" /end CHARACTERISTIC
/begin CHARACTERISTIC DSM_DInDfp_InjVCDMonCab_C "Verzögerung Ersatzreaktion für Fehlerpfad Dfp_InjVCDMonCab" VALUE 0xD17AE Kw_Wu16 655350.0 Time_ms 0.00 655350.0 FORMAT "%8.1" /end CHARACTERISTIC
/begin CHARACTERISTIC DSM_DInDfp_InjVCDMonSwt_C "Verzögerung Ersatzreaktion für Fehlerpfad Dfp_InjVCDMonSwt" VALUE 0xD17B0 Kw_Wu16 655350.0 Time_ms 0.00 655350.0 FORMAT "%8.1" /end CHARACTERISTIC
/begin CHARACTERISTIC DSM_DInDfp_InjVCDShOffDCDC_C "Verzögerung Ersatzreaktion für Fehlerpfad Dfp_InjVCDShOffDCDC" VALUE 0xD17B2 Kw_Wu16 655350.0 Time_ms 0.00 655350.0 FORMAT "%8.1" /end CHARACTERISTIC
/begin CHARACTERISTIC DSM_DInDfp_InjVCDUBuf1_C "Verzögerung Ersatzreaktion für Fehlerpfad Dfp_InjVCDUBuf1" VALUE 0xD17B4 Kw_Wu16 655350.0 Time_ms 0.00 655350.0 FORMAT "%8.1" /end CHARACTERISTIC
/begin CHARACTERISTIC DSM_DInDfp_InjVCDUBuf2_C "Verzögerung Ersatzreaktion für Fehlerpfad Dfp_InjVCDUBuf2" VALUE 0xD17B6 Kw_Wu16 655350.0 Time_ms 0.00 655350.0 FORMAT "%8.1" /end CHARACTERISTIC
/begin CHARACTERISTIC DSM_DInDfp_InjVCD_CY370Ampl_C "Verzögerung Ersatzreaktion für Fehlerpfad Dfp_InjVCD_CY370Ampl" VALUE 0xD17B8 Kw_Wu16 655350.0 Time_ms 0.00 655350.0 FORMAT "%8.1" /end CHARACTERISTIC
/begin CHARACTERISTIC DSM_DInDfp_InjVCD_DrvTime_C "Verzögerung Ersatzreaktion für Fehlerpfad Dfp_InjVCD_DrvTime" VALUE 0xD17BA Kw_Wu16 655350.0 Time_ms 0.00 655350.0 FORMAT "%8.1" /end CHARACTERISTIC
/begin CHARACTERISTIC DSM_DInDfp_InjVCD_DrvTimeRcy_C "Verzögerung Ersatzreaktion für Fehlerpfad Dfp_InjVCD_DrvTimeRcy" VALUE 0xD17BC Kw_Wu16 655350.0 Time_ms 0.00 655350.0 FORMAT "%8.1" /end CHARACTERISTIC
/begin CHARACTERISTIC DSM_DInDfp_InjVCD_TPUErr_C "Verzögerung Ersatzreaktion für Fehlerpfad Dfp_InjVCD_TPUErr" VALUE 0xD17BE Kw_Wu16 655350.0 Time_ms 0.00 655350.0 FORMAT "%8.1" /end CHARACTERISTIC
/begin CHARACTERISTIC DSM_DInDfp_InjVlvBnk1A_C "Verzögerung Ersatzreaktion für Fehlerpfad Dfp_InjVlvBnk1A" VALUE 0xD17C0 Kw_Wu16 655350.0 Time_ms 0.00 655350.0 FORMAT "%8.1" /end CHARACTERISTIC
/begin CHARACTERISTIC DSM_DInDfp_InjVlvBnk1B_C "Verzögerung Ersatzreaktion für Fehlerpfad Dfp_InjVlvBnk1B" VALUE 0xD17C2 Kw_Wu16 655350.0 Time_ms 0.00 655350.0 FORMAT "%8.1" /end CHARACTERISTIC
/begin CHARACTERISTIC DSM_DInDfp_InjVlvBnk2A_C "Verzögerung Ersatzreaktion für Fehlerpfad Dfp_InjVlvBnk2A" VALUE 0xD17C4 Kw_Wu16 655350.0 Time_ms 0.00 655350.0 FORMAT "%8.1" /end CHARACTERISTIC
/begin CHARACTERISTIC DSM_DInDfp_InjVlvBnk2B_C "Verzögerung Ersatzreaktion für Fehlerpfad Dfp_InjVlvBnk2B" VALUE 0xD17C6 Kw_Wu16 655350.0 Time_ms 0.00 655350.0 FORMAT "%8.1" /end CHARACTERISTIC
/begin CHARACTERISTIC DSM_DInDfp_InjVlvChipA_C "Verzögerung Ersatzreaktion für Fehlerpfad Dfp_InjVlvChipA" VALUE 0xD17C8 Kw_Wu16 655350.0 Time_ms 0.00 655350.0 FORMAT "%8.1" /end CHARACTERISTIC
/begin CHARACTERISTIC DSM_DInDfp_InjVlvChipB_C "Verzögerung Ersatzreaktion für Fehlerpfad Dfp_InjVlvChipB" VALUE 0xD17CA Kw_Wu16 655350.0 Time_ms 0.00 655350.0 FORMAT "%8.1" /end CHARACTERISTIC
/begin CHARACTERISTIC DSM_DInDfp_InjVlvCyl1A_C "Verzögerung Ersatzreaktion für Fehlerpfad Dfp_InjVlvCyl1A" VALUE 0xD17CC Kw_Wu16 655350.0 Time_ms 0.00 655350.0 FORMAT "%8.1" /end CHARACTERISTIC
/begin CHARACTERISTIC DSM_DInDfp_InjVlvCyl1B_C "Verzögerung Ersatzreaktion für Fehlerpfad Dfp_InjVlvCyl1B" VALUE 0xD17CE Kw_Wu16 655350.0 Time_ms 0.00 655350.0 FORMAT "%8.1" /end CHARACTERISTIC
/begin CHARACTERISTIC DSM_DInDfp_InjVlvCyl1C_C "Verzögerung Ersatzreaktion für Fehlerpfad Dfp_InjVlvCyl1C" VALUE 0xD17D0 Kw_Wu16 655350.0 Time_ms 0.00 655350.0 FORMAT "%8.1" /end CHARACTERISTIC
/begin CHARACTERISTIC DSM_DInDfp_InjVlvCyl2A_C "Verzögerung Ersatzreaktion für Fehlerpfad Dfp_InjVlvCyl2A" VALUE 0xD17D2 Kw_Wu16 655350.0 Time_ms 0.00 655350.0 FORMAT "%8.1" /end CHARACTERISTIC
/begin CHARACTERISTIC DSM_DInDfp_InjVlvCyl2B_C "Verzögerung Ersatzreaktion für Fehlerpfad Dfp_InjVlvCyl2B" VALUE 0xD17D4 Kw_Wu16 655350.0 Time_ms 0.00 655350.0 FORMAT "%8.1" /end CHARACTERISTIC
/begin CHARACTERISTIC DSM_DInDfp_InjVlvCyl2C_C "Verzögerung Ersatzreaktion für Fehlerpfad Dfp_InjVlvCyl2C" VALUE 0xD17D6 Kw_Wu16 655350.0 Time_ms 0.00 655350.0 FORMAT "%8.1" /end CHARACTERISTIC
/begin CHARACTERISTIC DSM_DInDfp_InjVlvCyl3A_C "Verzögerung Ersatzreaktion für Fehlerpfad Dfp_InjVlvCyl3A" VALUE 0xD17D8 Kw_Wu16 655350.0 Time_ms 0.00 655350.0 FORMAT "%8.1" /end CHARACTERISTIC
/begin CHARACTERISTIC DSM_DInDfp_InjVlvCyl3B_C "Verzögerung Ersatzreaktion für Fehlerpfad Dfp_InjVlvCyl3B" VALUE 0xD17DA Kw_Wu16 655350.0 Time_ms 0.00 655350.0 FORMAT "%8.1" /end CHARACTERISTIC
/begin CHARACTERISTIC DSM_DInDfp_InjVlvCyl3C_C "Verzögerung Ersatzreaktion für Fehlerpfad Dfp_InjVlvCyl3C" VALUE 0xD17DC Kw_Wu16 655350.0 Time_ms 0.00 655350.0 FORMAT "%8.1" /end CHARACTERISTIC
/begin CHARACTERISTIC DSM_DInDfp_InjVlvCyl4A_C "Verzögerung Ersatzreaktion für Fehlerpfad Dfp_InjVlvCyl4A" VALUE 0xD17DE Kw_Wu16 655350.0 Time_ms 0.00 655350.0 FORMAT "%8.1" /end CHARACTERISTIC
/begin CHARACTERISTIC DSM_DInDfp_InjVlvCyl4B_C "Verzögerung Ersatzreaktion für Fehlerpfad Dfp_InjVlvCyl4B" VALUE 0xD17E0 Kw_Wu16 655350.0 Time_ms 0.00 655350.0 FORMAT "%8.1" /end CHARACTERISTIC
/begin CHARACTERISTIC DSM_DInDfp_InjVlvCyl4C_C "Verzögerung Ersatzreaktion für Fehlerpfad Dfp_InjVlvCyl4C" VALUE 0xD17E2 Kw_Wu16 655350.0 Time_ms 0.00 655350.0 FORMAT "%8.1" /end CHARACTERISTIC
/begin CHARACTERISTIC DSM_DInDfp_InjVlvCyl5A_C "Verzögerung Ersatzreaktion für Fehlerpfad Dfp_InjVlvCyl5A" VALUE 0xD17E4 Kw_Wu16 655350.0 Time_ms 0.00 655350.0 FORMAT "%8.1" /end CHARACTERISTIC
/begin CHARACTERISTIC DSM_DInDfp_InjVlvCyl5B_C "Verzögerung Ersatzreaktion für Fehlerpfad Dfp_InjVlvCyl5B" VALUE 0xD17E6 Kw_Wu16 655350.0 Time_ms 0.00 655350.0 FORMAT "%8.1" /end CHARACTERISTIC
/begin CHARACTERISTIC DSM_DInDfp_InjVlvCyl5C_C "Verzögerung Ersatzreaktion für Fehlerpfad Dfp_InjVlvCyl5C" VALUE 0xD17E8 Kw_Wu16 655350.0 Time_ms 0.00 655350.0 FORMAT "%8.1" /end CHARACTERISTIC
/begin CHARACTERISTIC DSM_DInDfp_InjVlvCyl6A_C "Verzögerung Ersatzreaktion für Fehlerpfad Dfp_InjVlvCyl6A" VALUE 0xD17EA Kw_Wu16 655350.0 Time_ms 0.00 655350.0 FORMAT "%8.1" /end CHARACTERISTIC
/begin CHARACTERISTIC DSM_DInDfp_InjVlvCyl6B_C "Verzögerung Ersatzreaktion für Fehlerpfad Dfp_InjVlvCyl6B" VALUE 0xD17EC Kw_Wu16 655350.0 Time_ms 0.00 655350.0 FORMAT "%8.1" /end CHARACTERISTIC
/begin CHARACTERISTIC DSM_DInDfp_InjVlvCyl6C_C "Verzögerung Ersatzreaktion für Fehlerpfad Dfp_InjVlvCyl6C" VALUE 0xD17EE Kw_Wu16 655350.0 Time_ms 0.00 655350.0 FORMAT "%8.1" /end CHARACTERISTIC
/begin CHARACTERISTIC DSM_DInDfp_InjVlvCyl7A_C "Verzögerung Ersatzreaktion für Fehlerpfad Dfp_InjVlvCyl7A" VALUE 0xD17F0 Kw_Wu16 655350.0 Time_ms 0.00 655350.0 FORMAT "%8.1" /end CHARACTERISTIC
/begin CHARACTERISTIC DSM_DInDfp_InjVlvCyl7B_C "Verzögerung Ersatzreaktion für Fehlerpfad Dfp_InjVlvCyl7B" VALUE 0xD17F2 Kw_Wu16 655350.0 Time_ms 0.00 655350.0 FORMAT "%8.1" /end CHARACTERISTIC
/begin CHARACTERISTIC DSM_DInDfp_InjVlvCyl7C_C "Verzögerung Ersatzreaktion für Fehlerpfad Dfp_InjVlvCyl7C" VALUE 0xD17F4 Kw_Wu16 655350.0 Time_ms 0.00 655350.0 FORMAT "%8.1" /end CHARACTERISTIC
/begin CHARACTERISTIC DSM_DInDfp_InjVlvCyl8A_C "Verzögerung Ersatzreaktion für Fehlerpfad Dfp_InjVlvCyl8A" VALUE 0xD17F6 Kw_Wu16 655350.0 Time_ms 0.00 655350.0 FORMAT "%8.1" /end CHARACTERISTIC
/begin CHARACTERISTIC DSM_DInDfp_InjVlvCyl8B_C "Verzögerung Ersatzreaktion für Fehlerpfad Dfp_InjVlvCyl8B" VALUE 0xD17F8 Kw_Wu16 655350.0 Time_ms 0.00 655350.0 FORMAT "%8.1" /end CHARACTERISTIC
/begin CHARACTERISTIC DSM_DInDfp_InjVlvCyl8C_C "Verzögerung Ersatzreaktion für Fehlerpfad Dfp_InjVlvCyl8C" VALUE 0xD17FA Kw_Wu16 655350.0 Time_ms 0.00 655350.0 FORMAT "%8.1" /end CHARACTERISTIC
/begin CHARACTERISTIC DSM_DInDfp_InjVlvNVC1_C "Verzögerung Ersatzreaktion für Fehlerpfad Dfp_InjVlvNVC1" VALUE 0xD17FC Kw_Wu16 655350.0 Time_ms 0.00 655350.0 FORMAT "%8.1" /end CHARACTERISTIC
/begin CHARACTERISTIC DSM_DInDfp_InjVlvNVC2_C "Verzögerung Ersatzreaktion für Fehlerpfad Dfp_InjVlvNVC2" VALUE 0xD17FE Kw_Wu16 655350.0 Time_ms 0.00 655350.0 FORMAT "%8.1" /end CHARACTERISTIC
/begin CHARACTERISTIC DSM_DInDfp_InjVlvNVC3_C "Verzögerung Ersatzreaktion für Fehlerpfad Dfp_InjVlvNVC3" VALUE 0xD1800 Kw_Wu16 655350.0 Time_ms 0.00 655350.0 FORMAT "%8.1" /end CHARACTERISTIC
/begin CHARACTERISTIC DSM_DInDfp_InjVlvNVC4_C "Verzögerung Ersatzreaktion für Fehlerpfad Dfp_InjVlvNVC4" VALUE 0xD1802 Kw_Wu16 655350.0 Time_ms 0.00 655350.0 FORMAT "%8.1" /end CHARACTERISTIC
/begin CHARACTERISTIC DSM_DInDfp_InjVlvNVC5_C "Verzögerung Ersatzreaktion für Fehlerpfad Dfp_InjVlvNVC5" VALUE 0xD1804 Kw_Wu16 655350.0 Time_ms 0.00 655350.0 FORMAT "%8.1" /end CHARACTERISTIC
/begin CHARACTERISTIC DSM_DInDfp_InjVlvNVC6_C "Verzögerung Ersatzreaktion für Fehlerpfad Dfp_InjVlvNVC6" VALUE 0xD1806 Kw_Wu16 655350.0 Time_ms 0.00 655350.0 FORMAT "%8.1" /end CHARACTERISTIC
/begin CHARACTERISTIC DSM_DInDfp_InjVlvNVC7_C "Verzögerung Ersatzreaktion für Fehlerpfad Dfp_InjVlvNVC7" VALUE 0xD1808 Kw_Wu16 655350.0 Time_ms 0.00 655350.0 FORMAT "%8.1" /end CHARACTERISTIC
/begin CHARACTERISTIC DSM_DInDfp_InjVlvNVC8_C "Verzögerung Ersatzreaktion für Fehlerpfad Dfp_InjVlvNVC8" VALUE 0xD180A Kw_Wu16 655350.0 Time_ms 0.00 655350.0 FORMAT "%8.1" /end CHARACTERISTIC
/begin CHARACTERISTIC DSM_DInDfp_KeyCheck_C "Verzögerung Ersatzreaktion für Fehlerpfad Dfp_KeyCheck" VALUE 0xD180C Kw_Wu16 655350.0 Time_ms 0.00 655350.0 FORMAT "%8.1" /end CHARACTERISTIC
/begin CHARACTERISTIC DSM_DInDfp_LIGovECUTransMode_C "Verzögerung Ersatzreaktion für Fehlerpfad Dfp_LIGovECUTransMode" VALUE 0xD180E Kw_Wu16 655350.0 Time_ms 0.00 655350.0 FORMAT "%8.1" /end CHARACTERISTIC
/begin CHARACTERISTIC DSM_DInDfp_LPACD_Max_C "Verzögerung Ersatzreaktion für Fehlerpfad Dfp_LPACD_Max" VALUE 0xD1810 Kw_Wu16 655350.0 Time_ms 0.00 655350.0 FORMAT "%8.1" /end CHARACTERISTIC
/begin CHARACTERISTIC DSM_DInDfp_LPACD_Min_C "Verzögerung Ersatzreaktion für Fehlerpfad Dfp_LPACD_Min" VALUE 0xD1812 Kw_Wu16 655350.0 Time_ms 0.00 655350.0 FORMAT "%8.1" /end CHARACTERISTIC
/begin CHARACTERISTIC DSM_DInDfp_LPACD_SigNpl_C "Verzögerung Ersatzreaktion für Fehlerpfad Dfp_LPACD_SigNpl" VALUE 0xD1814 Kw_Wu16 655350.0 Time_ms 0.00 655350.0 FORMAT "%8.1" /end CHARACTERISTIC
/begin CHARACTERISTIC DSM_DInDfp_LSUCDCircNernst0B1_C "Verzögerung Ersatzreaktion für Fehlerpfad Dfp_LSUCDCircNernst0B1" VALUE 0xD1816 Kw_Wu16 655350.0 Time_ms 0.00 655350.0 FORMAT "%8.1" /end CHARACTERISTIC
/begin CHARACTERISTIC DSM_DInDfp_LSUCDCircNernst0B2_C "Verzögerung Ersatzreaktion für Fehlerpfad Dfp_LSUCDCircNernst0B2" VALUE 0xD1818 Kw_Wu16 655350.0 Time_ms 0.00 655350.0 FORMAT "%8.1" /end CHARACTERISTIC
/begin CHARACTERISTIC DSM_DInDfp_LSUCDCircPumpCur0B1_C "Verzögerung Ersatzreaktion für Fehlerpfad Dfp_LSUCDCircPumpCur0B1" VALUE 0xD181A Kw_Wu16 655350.0 Time_ms 0.00 655350.0 FORMAT "%8.1" /end CHARACTERISTIC
/begin CHARACTERISTIC DSM_DInDfp_LSUCDCircPumpCur0B2_C "Verzögerung Ersatzreaktion für Fehlerpfad Dfp_LSUCDCircPumpCur0B2" VALUE 0xD181C Kw_Wu16 655350.0 Time_ms 0.00 655350.0 FORMAT "%8.1" /end CHARACTERISTIC
/begin CHARACTERISTIC DSM_DInDfp_LSUCDCircVirtGnd0B1_C "Verzögerung Ersatzreaktion für Fehlerpfad Dfp_LSUCDCircVirtGnd0B1" VALUE 0xD181E Kw_Wu16 655350.0 Time_ms 0.00 655350.0 FORMAT "%8.1" /end CHARACTERISTIC
/begin CHARACTERISTIC DSM_DInDfp_LSUCDCircVirtGnd0B2_C "Verzögerung Ersatzreaktion für Fehlerpfad Dfp_LSUCDCircVirtGnd0B2" VALUE 0xD1820 Kw_Wu16 655350.0 Time_ms 0.00 655350.0 FORMAT "%8.1" /end CHARACTERISTIC
/begin CHARACTERISTIC DSM_DInDfp_LSUCDHeater0B1_C "Verzögerung Ersatzreaktion für Fehlerpfad Dfp_LSUCDHeater0B1" VALUE 0xD1822 Kw_Wu16 655350.0 Time_ms 0.00 655350.0 FORMAT "%8.1" /end CHARACTERISTIC
/begin CHARACTERISTIC DSM_DInDfp_LSUCDHeater0B2_C "Verzögerung Ersatzreaktion für Fehlerpfad Dfp_LSUCDHeater0B2" VALUE 0xD1824 Kw_Wu16 655350.0 Time_ms 0.00 655350.0 FORMAT "%8.1" /end CHARACTERISTIC
/begin CHARACTERISTIC DSM_DInDfp_LSUCDHtCoup0B1_C "Verzögerung Ersatzreaktion für Fehlerpfad Dfp_LSUCDHtCoup0B1" VALUE 0xD1826 Kw_Wu16 655350.0 Time_ms 0.00 655350.0 FORMAT "%8.1" /end CHARACTERISTIC
/begin CHARACTERISTIC DSM_DInDfp_LSUCDHtCoup0B2_C "Verzögerung Ersatzreaktion für Fehlerpfad Dfp_LSUCDHtCoup0B2" VALUE 0xD1828 Kw_Wu16 655350.0 Time_ms 0.00 655350.0 FORMAT "%8.1" /end CHARACTERISTIC
/begin CHARACTERISTIC DSM_DInDfp_LSUCDO20B1_C "Verzögerung Ersatzreaktion für Fehlerpfad Dfp_LSUCDO20B1" VALUE 0xD182A Kw_Wu16 655350.0 Time_ms 0.00 655350.0 FORMAT "%8.1" /end CHARACTERISTIC
/begin CHARACTERISTIC DSM_DInDfp_LSUCDO20B2_C "Verzögerung Ersatzreaktion für Fehlerpfad Dfp_LSUCDO20B2" VALUE 0xD182C Kw_Wu16 655350.0 Time_ms 0.00 655350.0 FORMAT "%8.1" /end CHARACTERISTIC
/begin CHARACTERISTIC DSM_DInDfp_LSUCDO2Clb0B1_C "Verzögerung Ersatzreaktion für Fehlerpfad Dfp_LSUCDO2Clb0B1" VALUE 0xD182E Kw_Wu16 655350.0 Time_ms 0.00 655350.0 FORMAT "%8.1" /end CHARACTERISTIC
/begin CHARACTERISTIC DSM_DInDfp_LSUCDO2Clb0B2_C "Verzögerung Ersatzreaktion für Fehlerpfad Dfp_LSUCDO2Clb0B2" VALUE 0xD1830 Kw_Wu16 655350.0 Time_ms 0.00 655350.0 FORMAT "%8.1" /end CHARACTERISTIC
/begin CHARACTERISTIC DSM_DInDfp_LSUCDRiClb0B1_C "Verzögerung Ersatzreaktion für Fehlerpfad Dfp_LSUCDRiClb0B1" VALUE 0xD1832 Kw_Wu16 655350.0 Time_ms 0.00 655350.0 FORMAT "%8.1" /end CHARACTERISTIC
/begin CHARACTERISTIC DSM_DInDfp_LSUCDRiClb0B2_C "Verzögerung Ersatzreaktion für Fehlerpfad Dfp_LSUCDRiClb0B2" VALUE 0xD1834 Kw_Wu16 655350.0 Time_ms 0.00 655350.0 FORMAT "%8.1" /end CHARACTERISTIC
/begin CHARACTERISTIC DSM_DInDfp_LSUCDSPI0B1_C "Verzögerung Ersatzreaktion für Fehlerpfad Dfp_LSUCDSPI0B1" VALUE 0xD1836 Kw_Wu16 655350.0 Time_ms 0.00 655350.0 FORMAT "%8.1" /end CHARACTERISTIC
/begin CHARACTERISTIC DSM_DInDfp_LSUCDSPI0B2_C "Verzögerung Ersatzreaktion für Fehlerpfad Dfp_LSUCDSPI0B2" VALUE 0xD1838 Kw_Wu16 655350.0 Time_ms 0.00 655350.0 FORMAT "%8.1" /end CHARACTERISTIC
/begin CHARACTERISTIC DSM_DInDfp_LSUCDSPIBattLow0B1_C "Verzögerung Ersatzreaktion für Fehlerpfad Dfp_LSUCDSPIBattLow0B1" VALUE 0xD183A Kw_Wu16 655350.0 Time_ms 0.00 655350.0 FORMAT "%8.1" /end CHARACTERISTIC
/begin CHARACTERISTIC DSM_DInDfp_LSUCDSPIBattLow0B2_C "Verzögerung Ersatzreaktion für Fehlerpfad Dfp_LSUCDSPIBattLow0B2" VALUE 0xD183C Kw_Wu16 655350.0 Time_ms 0.00 655350.0 FORMAT "%8.1" /end CHARACTERISTIC
/begin CHARACTERISTIC DSM_DInDfp_LSUCDWireIP0B1_C "Verzögerung Ersatzreaktion für Fehlerpfad Dfp_LSUCDWireIP0B1" VALUE 0xD183E Kw_Wu16 655350.0 Time_ms 0.00 655350.0 FORMAT "%8.1" /end CHARACTERISTIC
/begin CHARACTERISTIC DSM_DInDfp_LSUCDWireIP0B2_C "Verzögerung Ersatzreaktion für Fehlerpfad Dfp_LSUCDWireIP0B2" VALUE 0xD1840 Kw_Wu16 655350.0 Time_ms 0.00 655350.0 FORMAT "%8.1" /end CHARACTERISTIC
/begin CHARACTERISTIC DSM_DInDfp_LSUCtlRiExc0B1_C "Verzögerung Ersatzreaktion für Fehlerpfad Dfp_LSUCtlRiExc0B1" VALUE 0xD1842 Kw_Wu16 655350.0 Time_ms 0.00 655350.0 FORMAT "%8.1" /end CHARACTERISTIC
/begin CHARACTERISTIC DSM_DInDfp_LSUCtlRiExc0B2_C "Verzögerung Ersatzreaktion für Fehlerpfad Dfp_LSUCtlRiExc0B2" VALUE 0xD1844 Kw_Wu16 655350.0 Time_ms 0.00 655350.0 FORMAT "%8.1" /end CHARACTERISTIC
/begin CHARACTERISTIC DSM_DInDfp_LSUMon1SensB1_C "Verzögerung Ersatzreaktion für Fehlerpfad Dfp_LSUMon1SensB1" VALUE 0xD1846 Kw_Wu16 655350.0 Time_ms 0.00 655350.0 FORMAT "%8.1" /end CHARACTERISTIC
/begin CHARACTERISTIC DSM_DInDfp_LSUMon1SensB2_C "Verzögerung Ersatzreaktion für Fehlerpfad Dfp_LSUMon1SensB2" VALUE 0xD1848 Kw_Wu16 655350.0 Time_ms 0.00 655350.0 FORMAT "%8.1" /end CHARACTERISTIC
/begin CHARACTERISTIC DSM_DInDfp_LSUMon2SensB1_C "Verzögerung Ersatzreaktion für Fehlerpfad Dfp_LSUMon2SensB1" VALUE 0xD184A Kw_Wu16 655350.0 Time_ms 0.00 655350.0 FORMAT "%8.1" /end CHARACTERISTIC
/begin CHARACTERISTIC DSM_DInDfp_LSUMon2SensB2_C "Verzögerung Ersatzreaktion für Fehlerpfad Dfp_LSUMon2SensB2" VALUE 0xD184C Kw_Wu16 655350.0 Time_ms 0.00 655350.0 FORMAT "%8.1" /end CHARACTERISTIC
/begin CHARACTERISTIC DSM_DInDfp_MIL_C "Verzögerung Ersatzreaktion für Fehlerpfad Dfp_MIL" VALUE 0xD184E Kw_Wu16 655350.0 Time_ms 0.00 655350.0 FORMAT "%8.1" /end CHARACTERISTIC
/begin CHARACTERISTIC DSM_DInDfp_MRlyCD_C "Verzögerung Ersatzreaktion für Fehlerpfad Dfp_MRlyCD" VALUE 0xD1850 Kw_Wu16 655350.0 Time_ms 0.00 655350.0 FORMAT "%8.1" /end CHARACTERISTIC
/begin CHARACTERISTIC DSM_DInDfp_MSMon_C "Verzögerung Ersatzreaktion für Fehlerpfad Dfp_MSMon" VALUE 0xD1852 Kw_Wu16 655350.0 Time_ms 0.00 655350.0 FORMAT "%8.1" /end CHARACTERISTIC
/begin CHARACTERISTIC DSM_DInDfp_MSMonConsist_C "Verzögerung Ersatzreaktion für Fehlerpfad Dfp_MSMonConsist" VALUE 0xD1854 Kw_Wu16 655350.0 Time_ms 0.00 655350.0 FORMAT "%8.1" /end CHARACTERISTIC
/begin CHARACTERISTIC DSM_DInDfp_MSMonPFlt1_C "Verzögerung Ersatzreaktion für Fehlerpfad Dfp_MSMonPFlt1" VALUE 0xD1856 Kw_Wu16 655350.0 Time_ms 0.00 655350.0 FORMAT "%8.1" /end CHARACTERISTIC
/begin CHARACTERISTIC DSM_DInDfp_MSMonPFlt2_C "Verzögerung Ersatzreaktion für Fehlerpfad Dfp_MSMonPFlt2" VALUE 0xD1858 Kw_Wu16 655350.0 Time_ms 0.00 655350.0 FORMAT "%8.1" /end CHARACTERISTIC
/begin CHARACTERISTIC DSM_DInDfp_MSMonPFlt3_C "Verzögerung Ersatzreaktion für Fehlerpfad Dfp_MSMonPFlt3" VALUE 0xD185A Kw_Wu16 655350.0 Time_ms 0.00 655350.0 FORMAT "%8.1" /end CHARACTERISTIC
/begin CHARACTERISTIC DSM_DInDfp_MSMonPFlt4_C "Verzögerung Ersatzreaktion für Fehlerpfad Dfp_MSMonPFlt4" VALUE 0xD185C Kw_Wu16 655350.0 Time_ms 0.00 655350.0 FORMAT "%8.1" /end CHARACTERISTIC
/begin CHARACTERISTIC DSM_DInDfp_MSMon_ARS_TO_C "Verzögerung Ersatzreaktion für Fehlerpfad Dfp_MSMon_ARS_TO" VALUE 0xD185E Kw_Wu16 655350.0 Time_ms 0.00 655350.0 FORMAT "%8.1" /end CHARACTERISTIC
/begin CHARACTERISTIC DSM_DInDfp_MSMon_AirCtl_C "Verzögerung Ersatzreaktion für Fehlerpfad Dfp_MSMon_AirCtl" VALUE 0xD1860 Kw_Wu16 655350.0 Time_ms 0.00 655350.0 FORMAT "%8.1" /end CHARACTERISTIC
/begin CHARACTERISTIC DSM_DInDfp_MSMon_AirSys0_C "Verzögerung Ersatzreaktion für Fehlerpfad Dfp_MSMon_AirSys0" VALUE 0xD1862 Kw_Wu16 655350.0 Time_ms 0.00 655350.0 FORMAT "%8.1" /end CHARACTERISTIC
/begin CHARACTERISTIC DSM_DInDfp_MSMon_AirSys1_C "Verzögerung Ersatzreaktion für Fehlerpfad Dfp_MSMon_AirSys1" VALUE 0xD1864 Kw_Wu16 655350.0 Time_ms 0.00 655350.0 FORMAT "%8.1" /end CHARACTERISTIC
/begin CHARACTERISTIC DSM_DInDfp_MSMon_AirSys2_C "Verzögerung Ersatzreaktion für Fehlerpfad Dfp_MSMon_AirSys2" VALUE 0xD1866 Kw_Wu16 655350.0 Time_ms 0.00 655350.0 FORMAT "%8.1" /end CHARACTERISTIC
/begin CHARACTERISTIC DSM_DInDfp_MSMon_AirSys3_C "Verzögerung Ersatzreaktion für Fehlerpfad Dfp_MSMon_AirSys3" VALUE 0xD1868 Kw_Wu16 655350.0 Time_ms 0.00 655350.0 FORMAT "%8.1" /end CHARACTERISTIC
/begin CHARACTERISTIC DSM_DInDfp_MSMon_AirSys4_C "Verzögerung Ersatzreaktion für Fehlerpfad Dfp_MSMon_AirSys4" VALUE 0xD186A Kw_Wu16 655350.0 Time_ms 0.00 655350.0 FORMAT "%8.1" /end CHARACTERISTIC
/begin CHARACTERISTIC DSM_DInDfp_MSMon_AirSys7_C "Verzögerung Ersatzreaktion für Fehlerpfad Dfp_MSMon_AirSys7" VALUE 0xD186C Kw_Wu16 655350.0 Time_ms 0.00 655350.0 FORMAT "%8.1" /end CHARACTERISTIC
/begin CHARACTERISTIC DSM_DInDfp_MSMon_CanDef_C "Verzögerung Ersatzreaktion für Fehlerpfad Dfp_MSMon_CanDef" VALUE 0xD186E Kw_Wu16 655350.0 Time_ms 0.00 655350.0 FORMAT "%8.1" /end CHARACTERISTIC
/begin CHARACTERISTIC DSM_DInDfp_MSMon_CoEng_OffVeh_C "Verzögerung Ersatzreaktion für Fehlerpfad Dfp_MSMon_CoEng_OffVeh_C" VALUE 0xD1870 Kw_Wu16 655350.0 Time_ms 0.00 655350.0 FORMAT "%8.1" /end CHARACTERISTIC
/begin CHARACTERISTIC DSM_DInDfp_MSMon_CoEng_Rev1_C "Verzögerung Ersatzreaktion für Fehlerpfad Dfp_MSMon_CoEng_Rev1_C" VALUE 0xD1872 Kw_Wu16 655350.0 Time_ms 0.00 655350.0 FORMAT "%8.1" /end CHARACTERISTIC
/begin CHARACTERISTIC DSM_DInDfp_MSMon_CoEng_Rev2_C "Verzögerung Ersatzreaktion für Fehlerpfad Dfp_MSMon_CoEng_Rev2_C" VALUE 0xD1874 Kw_Wu16 655350.0 Time_ms 0.00 655350.0 FORMAT "%8.1" /end CHARACTERISTIC
/begin CHARACTERISTIC DSM_DInDfp_MSMon_CoEng_RevMS_C "Verzögerung Ersatzreaktion für Fehlerpfad Dfp_MSMon_CoEng_RevMS_C" VALUE 0xD1876 Kw_Wu16 655350.0 Time_ms 0.00 655350.0 FORMAT "%8.1" /end CHARACTERISTIC
/begin CHARACTERISTIC DSM_DInDfp_MSMon_DSC_TO_C "Verzögerung Ersatzreaktion für Fehlerpfad Dfp_MSMon_DSC_TO" VALUE 0xD1878 Kw_Wu16 655350.0 Time_ms 0.00 655350.0 FORMAT "%8.1" /end CHARACTERISTIC
/begin CHARACTERISTIC DSM_DInDfp_MSMon_EGS_TO_C "Verzögerung Ersatzreaktion für Fehlerpfad Dfp_MSMon_EGS_TO" VALUE 0xD187A Kw_Wu16 655350.0 Time_ms 0.00 655350.0 FORMAT "%8.1" /end CHARACTERISTIC
/begin CHARACTERISTIC DSM_DInDfp_MSMon_FrmMngCoEng_C "Verzögerung Ersatzreaktion für Fehlerpfad Dfp_MSMon_FrmMngCoEng" VALUE 0xD187C Kw_Wu16 655350.0 Time_ms 0.00 655350.0 FORMAT "%8.1" /end CHARACTERISTIC
/begin CHARACTERISTIC DSM_DInDfp_MSMon_FrmMngPT_C "Verzögerung Ersatzreaktion für Fehlerpfad Dfp_MSMon_FrmMngPT_C" VALUE 0xD187E Kw_Wu16 655350.0 Time_ms 0.00 655350.0 FORMAT "%8.1" /end CHARACTERISTIC
/begin CHARACTERISTIC DSM_DInDfp_MSMon_FrmMngPT2_C "Verzögerung Ersatzreaktion für Fehlerpfad Dfp_MSMon_FrmMngPT2" VALUE 0xD1880 Kw_Wu16 655350.0 Time_ms 0.00 655350.0 FORMAT "%8.1" /end CHARACTERISTIC
/begin CHARACTERISTIC DSM_DInDfp_MSMon_Mil_C "Verzögerung Ersatzreaktion für Fehlerpfad Dfp_MSMon_Mil_C" VALUE 0xD1882 Kw_Wu16 655350.0 Time_ms 0.00 655350.0 FORMAT "%8.1" /end CHARACTERISTIC
/begin CHARACTERISTIC DSM_DInDfp_MSMon_NetMngPtCan_C "Verzögerung Ersatzreaktion für Fehlerpfad Dfp_MSMon_NetMngPtCan" VALUE 0xD1884 Kw_Wu16 655350.0 Time_ms 0.00 655350.0 FORMAT "%8.1" /end CHARACTERISTIC
/begin CHARACTERISTIC DSM_DInDfp_MSMon_RailCDPMon_C "Verzögerung Ersatzreaktion für Fehlerpfad Dfp_MSMon_RailCDPMon" VALUE 0xD1886 Kw_Wu16 655350.0 Time_ms 0.00 655350.0 FORMAT "%8.1" /end CHARACTERISTIC
/begin CHARACTERISTIC DSM_DInDfp_MSMon_StEGS_C "Verzögerung Ersatzreaktion für Fehlerpfad Dfp_MSMon_StEGS" VALUE 0xD1888 Kw_Wu16 655350.0 Time_ms 0.00 655350.0 FORMAT "%8.1" /end CHARACTERISTIC
/begin CHARACTERISTIC DSM_DInDfp_MSMon_SysLamp_C "Verzögerung Ersatzreaktion für Fehlerpfad Dfp_MSMon_SysLamp_C" VALUE 0xD188A Kw_Wu16 655350.0 Time_ms 0.00 655350.0 FORMAT "%8.1" /end CHARACTERISTIC
/begin CHARACTERISTIC DSM_DInDfp_MSMon_ZFCClbActv_C "Verzögerung Ersatzreaktion für Fehlerpfad Dfp_MSMon_ZFCClbActv" VALUE 0xD188C Kw_Wu16 655350.0 Time_ms 0.00 655350.0 FORMAT "%8.1" /end CHARACTERISTIC
/begin CHARACTERISTIC DSM_DInDfp_MSMon_qLimErr_C "Verzögerung Ersatzreaktion für Fehlerpfad Dfp_MSMon_qLimErr_C" VALUE 0xD188E Kw_Wu16 655350.0 Time_ms 0.00 655350.0 FORMAT "%8.1" /end CHARACTERISTIC
/begin CHARACTERISTIC DSM_DInDfp_MSMon_trqCoDT_C "Verzögerung Ersatzreaktion für Fehlerpfad Dfp_MSMon_trqCoDT_C" VALUE 0xD1890 Kw_Wu16 655350.0 Time_ms 0.00 655350.0 FORMAT "%8.1" /end CHARACTERISTIC
/begin CHARACTERISTIC DSM_DInDfp_MSMon_trqCoVeh_C "Verzögerung Ersatzreaktion für Fehlerpfad Dfp_MSMon_trqCoVeh_C" VALUE 0xD1892 Kw_Wu16 655350.0 Time_ms 0.00 655350.0 FORMAT "%8.1" /end CHARACTERISTIC
/begin CHARACTERISTIC DSM_DInDfp_MSMon_trqCoVehLim_C "Verzögerung Ersatzreaktion für Fehlerpfad Dfp_MSMon_trqCoVehLim_C" VALUE 0xD1894 Kw_Wu16 655350.0 Time_ms 0.00 655350.0 FORMAT "%8.1" /end CHARACTERISTIC
/begin CHARACTERISTIC DSM_DInDfp_MSMon_trqDesExt_C "Verzögerung Ersatzreaktion für Fehlerpfad Dfp_MSMon_trqDesExt_C" VALUE 0xD1896 Kw_Wu16 655350.0 Time_ms 0.00 655350.0 FORMAT "%8.1" /end CHARACTERISTIC
/begin CHARACTERISTIC DSM_DInDfp_MSMon_trqDesExtRev_C "Verzögerung Ersatzreaktion für Fehlerpfad Dfp_MSMon_trqDesExtRev_C" VALUE 0xD1898 Kw_Wu16 655350.0 Time_ms 0.00 655350.0 FORMAT "%8.1" /end CHARACTERISTIC
/begin CHARACTERISTIC DSM_DInDfp_MSMon_trqLimErr_C "Verzögerung Ersatzreaktion für Fehlerpfad Dfp_MSMon_trqLimErr_C" VALUE 0xD189A Kw_Wu16 655350.0 Time_ms 0.00 655350.0 FORMAT "%8.1" /end CHARACTERISTIC
/begin CHARACTERISTIC DSM_DInDfp_MSMon_trqLimErr1_C "Verzögerung Ersatzreaktion für Fehlerpfad Dfp_MSMon_trqLimErr1_C" VALUE 0xD189C Kw_Wu16 655350.0 Time_ms 0.00 655350.0 FORMAT "%8.1" /end CHARACTERISTIC
/begin CHARACTERISTIC DSM_DInDfp_MSMon_trqLimErr2_C "Verzögerung Ersatzreaktion für Fehlerpfad Dfp_MSMon_trqLimErr2_C" VALUE 0xD189E Kw_Wu16 655350.0 Time_ms 0.00 655350.0 FORMAT "%8.1" /end CHARACTERISTIC
/begin CHARACTERISTIC DSM_DInDfp_MSMon_trqLimErr3_C "Verzögerung Ersatzreaktion für Fehlerpfad Dfp_MSMon_trqLimErr3" VALUE 0xD18A0 Kw_Wu16 655350.0 Time_ms 0.00 655350.0 FORMAT "%8.1" /end CHARACTERISTIC
/begin CHARACTERISTIC DSM_DInDfp_MSMon_trqLimErr4_C "Verzögerung Ersatzreaktion für Fehlerpfad Dfp_MSMon_trqLimErr4" VALUE 0xD18A2 Kw_Wu16 655350.0 Time_ms 0.00 655350.0 FORMAT "%8.1" /end CHARACTERISTIC
/begin CHARACTERISTIC DSM_DInDfp_MSidCD_Comm_C "Verzögerung Ersatzreaktion für Fehlerpfad Dfp_MSidCD_Comm" VALUE 0xD18A4 Kw_Wu16 655350.0 Time_ms 0.00 655350.0 FORMAT "%8.1" /end CHARACTERISTIC
/begin CHARACTERISTIC DSM_DInDfp_MSidCD_EcuMixed_C "Verzögerung Ersatzreaktion für Fehlerpfad Dfp_MSidCD_EcuMixed" VALUE 0xD18A6 Kw_Wu16 655350.0 Time_ms 0.00 655350.0 FORMAT "%8.1" /end CHARACTERISTIC
/begin CHARACTERISTIC DSM_DInDfp_MSidCD_Pin_C "Verzögerung Ersatzreaktion für Fehlerpfad Dfp_MSidCD_Pin" VALUE 0xD18A8 Kw_Wu16 655350.0 Time_ms 0.00 655350.0 FORMAT "%8.1" /end CHARACTERISTIC
/begin CHARACTERISTIC DSM_DInDfp_MSidCD_Sel_INI_C "Verzögerung Ersatzreaktion für Fehlerpfad Dfp_MSidCD_Sel_INI" VALUE 0xD18AA Kw_Wu16 655350.0 Time_ms 0.00 655350.0 FORMAT "%8.1" /end CHARACTERISTIC
/begin CHARACTERISTIC DSM_DInDfp_MSidCD_Select_C "Verzögerung Ersatzreaktion für Fehlerpfad Dfp_MSidCD_Select" VALUE 0xD18AC Kw_Wu16 655350.0 Time_ms 0.00 655350.0 FORMAT "%8.1" /end CHARACTERISTIC
/begin CHARACTERISTIC DSM_DInDfp_MSid_SwCmp_C "Verzögerung Ersatzreaktion für Fehlerpfad Dfp_MSid_SwCmp" VALUE 0xD18AE Kw_Wu16 655350.0 Time_ms 0.00 655350.0 FORMAT "%8.1" /end CHARACTERISTIC
/begin CHARACTERISTIC DSM_DInDfp_MSid_regEEPDiff_C "Verzögerung Ersatzreaktion für Fehlerpfad Dfp_MSid_regEEPDiff" VALUE 0xD18B0 Kw_Wu16 655350.0 Time_ms 0.00 655350.0 FORMAT "%8.1" /end CHARACTERISTIC
/begin CHARACTERISTIC DSM_DInDfp_MeUnCDNoLoad_C "Verzögerung Ersatzreaktion für Fehlerpfad Dfp_MeUnCDNoLoad" VALUE 0xD18B2 Kw_Wu16 655350.0 Time_ms 0.00 655350.0 FORMAT "%8.1" /end CHARACTERISTIC
/begin CHARACTERISTIC DSM_DInDfp_MeUnCDSCBat_C "Verzögerung Ersatzreaktion für Fehlerpfad Dfp_MeUnCDSCBat" VALUE 0xD18B4 Kw_Wu16 655350.0 Time_ms 0.00 655350.0 FORMAT "%8.1" /end CHARACTERISTIC
/begin CHARACTERISTIC DSM_DInDfp_MeUnCDSCGnd_C "Verzögerung Ersatzreaktion für Fehlerpfad Dfp_MeUnCDSCGnd" VALUE 0xD18B6 Kw_Wu16 655350.0 Time_ms 0.00 655350.0 FORMAT "%8.1" /end CHARACTERISTIC
/begin CHARACTERISTIC DSM_DInDfp_MeUnCD_ADC_C "Verzögerung Ersatzreaktion für Fehlerpfad Dfp_MeUnCD_ADC" VALUE 0xD18B8 Kw_Wu16 655350.0 Time_ms 0.00 655350.0 FORMAT "%8.1" /end CHARACTERISTIC
/begin CHARACTERISTIC DSM_DInDfp_MeUnCD_SigTst_C "Verzögerung Ersatzreaktion für Fehlerpfad Dfp_MeUnCD_SigTst" VALUE 0xD18BA Kw_Wu16 655350.0 Time_ms 0.00 655350.0 FORMAT "%8.1" /end CHARACTERISTIC
/begin CHARACTERISTIC DSM_DInDfp_Montr_C "Verzögerung Ersatzreaktion für Fehlerpfad Dfp_Montr" VALUE 0xD18BC Kw_Wu16 655350.0 Time_ms 0.00 655350.0 FORMAT "%8.1" /end CHARACTERISTIC
/begin CHARACTERISTIC DSM_DInDfp_NetMngDeviceA_C "Verzögerung Ersatzreaktion für Fehlerpfad Dfp_NetMngDeviceA" VALUE 0xD18BE Kw_Wu16 655350.0 Time_ms 0.00 655350.0 FORMAT "%8.1" /end CHARACTERISTIC
/begin CHARACTERISTIC DSM_DInDfp_NetMngDeviceB_C "Verzögerung Ersatzreaktion für Fehlerpfad Dfp_NetMngDeviceB" VALUE 0xD18C0 Kw_Wu16 655350.0 Time_ms 0.00 655350.0 FORMAT "%8.1" /end CHARACTERISTIC
/begin CHARACTERISTIC DSM_DInDfp_NetMngDeviceC_C "Verzögerung Ersatzreaktion für Fehlerpfad Dfp_NetMngDeviceC" VALUE 0xD18C2 Kw_Wu16 655350.0 Time_ms 0.00 655350.0 FORMAT "%8.1" /end CHARACTERISTIC
/begin CHARACTERISTIC DSM_DInDfp_NetMngPrvCan_C "Verzögerung Ersatzreaktion für Fehlerpfad Dfp_NetMngPrvCan" VALUE 0xD18C4 Kw_Wu16 655350.0 Time_ms 0.00 655350.0 FORMAT "%8.1" /end CHARACTERISTIC
/begin CHARACTERISTIC DSM_DInDfp_NetMngPrvCanSlave_C "Verzögerung Ersatzreaktion für Fehlerpfad Dfp_NetMngPrvCanSlave" VALUE 0xD18C6 Kw_Wu16 655350.0 Time_ms 0.00 655350.0 FORMAT "%8.1" /end CHARACTERISTIC
/begin CHARACTERISTIC DSM_DInDfp_NetMngPtCan_C "Verzögerung Ersatzreaktion für Fehlerpfad Dfp_NetMngPtCan" VALUE 0xD18C8 Kw_Wu16 655350.0 Time_ms 0.00 655350.0 FORMAT "%8.1" /end CHARACTERISTIC
/begin CHARACTERISTIC DSM_DInDfp_NetMngPtCanSlave_C "Verzögerung Ersatzreaktion für Fehlerpfad Dfp_NetMngPtCanSlave" VALUE 0xD18CA Kw_Wu16 655350.0 Time_ms 0.00 655350.0 FORMAT "%8.1" /end CHARACTERISTIC
/begin CHARACTERISTIC DSM_DInDfp_OPSCD_Lamp_C "Verzögerung Ersatzreaktion für Fehlerpfad Dfp_OPSCD_Lamp" VALUE 0xD18CC Kw_Wu16 655350.0 Time_ms 0.00 655350.0 FORMAT "%8.1" /end CHARACTERISTIC
/begin CHARACTERISTIC DSM_DInDfp_OPSCD_anain_C "Verzögerung Ersatzreaktion für Fehlerpfad Dfp_OPSCD_anain" VALUE 0xD18CE Kw_Wu16 655350.0 Time_ms 0.00 655350.0 FORMAT "%8.1" /end CHARACTERISTIC
/begin CHARACTERISTIC DSM_DInDfp_OTSCD_C "Verzögerung Ersatzreaktion für Fehlerpfad Dfp_OTSCD" VALUE 0xD18D0 Kw_Wu16 655350.0 Time_ms 0.00 655350.0 FORMAT "%8.1" /end CHARACTERISTIC
/begin CHARACTERISTIC DSM_DInDfp_OvRMon_C "Verzögerung Ersatzreaktion für Fehlerpfad Dfp_OvRMon" VALUE 0xD18D2 Kw_Wu16 655350.0 Time_ms 0.00 655350.0 FORMAT "%8.1" /end CHARACTERISTIC
/begin CHARACTERISTIC DSM_DInDfp_OvRMonSigA_C "Verzögerung Ersatzreaktion für Fehlerpfad Dfp_OvRMonSigA" VALUE 0xD18D4 Kw_Wu16 655350.0 Time_ms 0.00 655350.0 FORMAT "%8.1" /end CHARACTERISTIC
/begin CHARACTERISTIC DSM_DInDfp_OxiCCDTPreB1_C "Verzögerung Ersatzreaktion für Fehlerpfad Dfp_OxiCCDTPreB1" VALUE 0xD18D6 Kw_Wu16 655350.0 Time_ms 0.00 655350.0 FORMAT "%8.1" /end CHARACTERISTIC
/begin CHARACTERISTIC DSM_DInDfp_OxiCCDTPreB2_C "Verzögerung Ersatzreaktion für Fehlerpfad Dfp_OxiCCDTPreB2" VALUE 0xD18D8 Kw_Wu16 655350.0 Time_ms 0.00 655350.0 FORMAT "%8.1" /end CHARACTERISTIC
/begin CHARACTERISTIC DSM_DInDfp_PCBS_C "Verzögerung Ersatzreaktion für Fehlerpfad Dfp_PCBS" VALUE 0xD18DA Kw_Wu16 655350.0 Time_ms 0.00 655350.0 FORMAT "%8.1" /end CHARACTERISTIC
/begin CHARACTERISTIC DSM_DInDfp_PCR_BalGvnr_C "Verzögerung Ersatzreaktion für Fehlerpfad Dfp_PCR_BalGvnr" VALUE 0xD18DC Kw_Wu16 655350.0 Time_ms 0.00 655350.0 FORMAT "%8.1" /end CHARACTERISTIC
/begin CHARACTERISTIC DSM_DInDfp_PCR_GovDevNeg_C "Verzögerung Ersatzreaktion für Fehlerpfad Dfp_PCR_GovDevNeg" VALUE 0xD18DE Kw_Wu16 655350.0 Time_ms 0.00 655350.0 FORMAT "%8.1" /end CHARACTERISTIC
/begin CHARACTERISTIC DSM_DInDfp_PCR_GovDevPos_C "Verzögerung Ersatzreaktion für Fehlerpfad Dfp_PCR_GovDevPos" VALUE 0xD18E0 Kw_Wu16 655350.0 Time_ms 0.00 655350.0 FORMAT "%8.1" /end CHARACTERISTIC
/begin CHARACTERISTIC DSM_DInDfp_PCR_LPGvnrDvtNeg_C "Verzögerung Ersatzreaktion für Fehlerpfad Dfp_PCR_LPGvnrDvtNeg" VALUE 0xD18E2 Kw_Wu16 655350.0 Time_ms 0.00 655350.0 FORMAT "%8.1" /end CHARACTERISTIC
/begin CHARACTERISTIC DSM_DInDfp_PCR_LPGvnrDvtPos_C "Verzögerung Ersatzreaktion für Fehlerpfad Dfp_PCR_LPGvnrDvtPos" VALUE 0xD18E4 Kw_Wu16 655350.0 Time_ms 0.00 655350.0 FORMAT "%8.1" /end CHARACTERISTIC
/begin CHARACTERISTIC DSM_DInDfp_PCVCDNoLoad_C "Verzögerung Ersatzreaktion für Fehlerpfad Dfp_PCVCDNoLoad" VALUE 0xD18E6 Kw_Wu16 655350.0 Time_ms 0.00 655350.0 FORMAT "%8.1" /end CHARACTERISTIC
/begin CHARACTERISTIC DSM_DInDfp_PCVCDSCBat_C "Verzögerung Ersatzreaktion für Fehlerpfad Dfp_PCVCDSCBat" VALUE 0xD18E8 Kw_Wu16 655350.0 Time_ms 0.00 655350.0 FORMAT "%8.1" /end CHARACTERISTIC
/begin CHARACTERISTIC DSM_DInDfp_PCVCDSCGnd_C "Verzögerung Ersatzreaktion für Fehlerpfad Dfp_PCVCDSCGnd" VALUE 0xD18EA Kw_Wu16 655350.0 Time_ms 0.00 655350.0 FORMAT "%8.1" /end CHARACTERISTIC
/begin CHARACTERISTIC DSM_DInDfp_PCVCD_ADC_C "Verzögerung Ersatzreaktion für Fehlerpfad Dfp_PCVCD_ADC" VALUE 0xD18EC Kw_Wu16 655350.0 Time_ms 0.00 655350.0 FORMAT "%8.1" /end CHARACTERISTIC
/begin CHARACTERISTIC DSM_DInDfp_PCVCD_SigTst_C "Verzögerung Ersatzreaktion für Fehlerpfad Dfp_PCVCD_SigTst" VALUE 0xD18EE Kw_Wu16 655350.0 Time_ms 0.00 655350.0 FORMAT "%8.1" /end CHARACTERISTIC
/begin CHARACTERISTIC DSM_DInDfp_PFltAPSPlaus_C "Verzögerung Ersatzreaktion für Fehlerpfad Dfp_PFltAPSPlaus" VALUE 0xD18F0 Kw_Wu16 655350.0 Time_ms 0.00 655350.0 FORMAT "%8.1" /end CHARACTERISTIC
/begin CHARACTERISTIC DSM_DInDfp_PFltAPSensB1_C "Verzögerung Ersatzreaktion für Fehlerpfad Dfp_PFltAPSensB1" VALUE 0xD18F2 Kw_Wu16 655350.0 Time_ms 0.00 655350.0 FORMAT "%8.1" /end CHARACTERISTIC
/begin CHARACTERISTIC DSM_DInDfp_PFltAPSensB2_C "Verzögerung Ersatzreaktion für Fehlerpfad Dfp_PFltAPSensB2" VALUE 0xD18F4 Kw_Wu16 655350.0 Time_ms 0.00 655350.0 FORMAT "%8.1" /end CHARACTERISTIC
/begin CHARACTERISTIC DSM_DInDfp_PFltBPSPlaus_C "Verzögerung Ersatzreaktion für Fehlerpfad Dfp_PFltBPSPlaus" VALUE 0xD18F6 Kw_Wu16 655350.0 Time_ms 0.00 655350.0 FORMAT "%8.1" /end CHARACTERISTIC
/begin CHARACTERISTIC DSM_DInDfp_PFltCDPPreB1_C "Verzögerung Ersatzreaktion für Fehlerpfad Dfp_PFltCDPPreB1" VALUE 0xD18F8 Kw_Wu16 655350.0 Time_ms 0.00 655350.0 FORMAT "%8.1" /end CHARACTERISTIC
/begin CHARACTERISTIC DSM_DInDfp_PFltCDPPreB2_C "Verzögerung Ersatzreaktion für Fehlerpfad Dfp_PFltCDPPreB2" VALUE 0xD18FA Kw_Wu16 655350.0 Time_ms 0.00 655350.0 FORMAT "%8.1" /end CHARACTERISTIC
/begin CHARACTERISTIC DSM_DInDfp_PFltCDTPreB1_C "Verzögerung Ersatzreaktion für Fehlerpfad Dfp_PFltCDTPreB1" VALUE 0xD18FC Kw_Wu16 655350.0 Time_ms 0.00 655350.0 FORMAT "%8.1" /end CHARACTERISTIC
/begin CHARACTERISTIC DSM_DInDfp_PFltCDTPreB2_C "Verzögerung Ersatzreaktion für Fehlerpfad Dfp_PFltCDTPreB2" VALUE 0xD18FE Kw_Wu16 655350.0 Time_ms 0.00 655350.0 FORMAT "%8.1" /end CHARACTERISTIC
/begin CHARACTERISTIC DSM_DInDfp_PFltCharB1_C "Verzögerung Ersatzreaktion für Fehlerpfad Dfp_PFltCharB1" VALUE 0xD1900 Kw_Wu16 655350.0 Time_ms 0.00 655350.0 FORMAT "%8.1" /end CHARACTERISTIC
/begin CHARACTERISTIC DSM_DInDfp_PFltCharB2_C "Verzögerung Ersatzreaktion für Fehlerpfad Dfp_PFltCharB2" VALUE 0xD1902 Kw_Wu16 655350.0 Time_ms 0.00 655350.0 FORMAT "%8.1" /end CHARACTERISTIC
/begin CHARACTERISTIC DSM_DInDfp_PFltDltOxiPreTwFlw_C "Verzögerung Ersatzreaktion für Fehlerpfad Dfp_PFltDltOxiPreTwFlw" VALUE 0xD1904 Kw_Wu16 655350.0 Time_ms 0.00 655350.0 FORMAT "%8.1" /end CHARACTERISTIC
/begin CHARACTERISTIC DSM_DInDfp_PFltDltPreTwFlw_C "Verzögerung Ersatzreaktion für Fehlerpfad Dfp_PFltDltPreTwFlw" VALUE 0xD1906 Kw_Wu16 655350.0 Time_ms 0.00 655350.0 FORMAT "%8.1" /end CHARACTERISTIC
/begin CHARACTERISTIC DSM_DInDfp_PFltEngPrtB1_C "Verzögerung Ersatzreaktion für Fehlerpfad Dfp_PFltEngPrtB1" VALUE 0xD1908 Kw_Wu16 655350.0 Time_ms 0.00 655350.0 FORMAT "%8.1" /end CHARACTERISTIC
/begin CHARACTERISTIC DSM_DInDfp_PFltEngPrtB2_C "Verzögerung Ersatzreaktion für Fehlerpfad Dfp_PFltEngPrtB2" VALUE 0xD190A Kw_Wu16 655350.0 Time_ms 0.00 655350.0 FORMAT "%8.1" /end CHARACTERISTIC
/begin CHARACTERISTIC DSM_DInDfp_PFltOvldInhRgnB1_C "Verzögerung Ersatzreaktion für Fehlerpfad Dfp_PFltOvldInhRgnB1" VALUE 0xD190C Kw_Wu16 655350.0 Time_ms 0.00 655350.0 FORMAT "%8.1" /end CHARACTERISTIC
/begin CHARACTERISTIC DSM_DInDfp_PFltOvldInhRgnB2_C "Verzögerung Ersatzreaktion für Fehlerpfad Dfp_PFltOvldInhRgnB2" VALUE 0xD190E Kw_Wu16 655350.0 Time_ms 0.00 655350.0 FORMAT "%8.1" /end CHARACTERISTIC
/begin CHARACTERISTIC DSM_DInDfp_PFltOvldTrqLimB1_C "Verzögerung Ersatzreaktion für Fehlerpfad Dfp_PFltOvldTrqLimB1" VALUE 0xD1910 Kw_Wu16 655350.0 Time_ms 0.00 655350.0 FORMAT "%8.1" /end CHARACTERISTIC
/begin CHARACTERISTIC DSM_DInDfp_PFltOvldTrqLimB2_C "Verzögerung Ersatzreaktion für Fehlerpfad Dfp_PFltOvldTrqLimB2" VALUE 0xD1912 Kw_Wu16 655350.0 Time_ms 0.00 655350.0 FORMAT "%8.1" /end CHARACTERISTIC
/begin CHARACTERISTIC DSM_DInDfp_PFltPresDynPlausB1_C "Verzögerung Ersatzreaktion für Fehlerpfad Dfp_PFltPresDynPlausB1" VALUE 0xD1914 Kw_Wu16 655350.0 Time_ms 0.00 655350.0 FORMAT "%8.1" /end CHARACTERISTIC
/begin CHARACTERISTIC DSM_DInDfp_PFltPresDynPlausB2_C "Verzögerung Ersatzreaktion für Fehlerpfad Dfp_PFltPresDynPlausB2" VALUE 0xD1916 Kw_Wu16 655350.0 Time_ms 0.00 655350.0 FORMAT "%8.1" /end CHARACTERISTIC
/begin CHARACTERISTIC DSM_DInDfp_PFltPresPlausB1_C "Verzögerung Ersatzreaktion für Fehlerpfad Dfp_PFltPresPlausB1" VALUE 0xD1918 Kw_Wu16 655350.0 Time_ms 0.00 655350.0 FORMAT "%8.1" /end CHARACTERISTIC
/begin CHARACTERISTIC DSM_DInDfp_PFltPresPlausB2_C "Verzögerung Ersatzreaktion für Fehlerpfad Dfp_PFltPresPlausB2" VALUE 0xD191A Kw_Wu16 655350.0 Time_ms 0.00 655350.0 FORMAT "%8.1" /end CHARACTERISTIC
/begin CHARACTERISTIC DSM_DInDfp_PFltPresSensB1_C "Verzögerung Ersatzreaktion für Fehlerpfad Dfp_PFltPresSensB1" VALUE 0xD191C Kw_Wu16 655350.0 Time_ms 0.00 655350.0 FORMAT "%8.1" /end CHARACTERISTIC
/begin CHARACTERISTIC DSM_DInDfp_PFltPresSensB2_C "Verzögerung Ersatzreaktion für Fehlerpfad Dfp_PFltPresSensB2" VALUE 0xD191E Kw_Wu16 655350.0 Time_ms 0.00 655350.0 FORMAT "%8.1" /end CHARACTERISTIC
/begin CHARACTERISTIC DSM_DInDfp_PFltPresSensFrz_C "Verzögerung Ersatzreaktion für Fehlerpfad Dfp_PFltPresSensFrz" VALUE 0xD1920 Kw_Wu16 655350.0 Time_ms 0.00 655350.0 FORMAT "%8.1" /end CHARACTERISTIC
/begin CHARACTERISTIC DSM_DInDfp_PFltPresSensHsLnB1_C "Verzögerung Ersatzreaktion für Fehlerpfad Dfp_PFltPresSensHsLnB1" VALUE 0xD1922 Kw_Wu16 655350.0 Time_ms 0.00 655350.0 FORMAT "%8.1" /end CHARACTERISTIC
/begin CHARACTERISTIC DSM_DInDfp_PFltPresSensHsLnB2_C "Verzögerung Ersatzreaktion für Fehlerpfad Dfp_PFltPresSensHsLnB2" VALUE 0xD1924 Kw_Wu16 655350.0 Time_ms 0.00 655350.0 FORMAT "%8.1" /end CHARACTERISTIC
/begin CHARACTERISTIC DSM_DInDfp_PFltPresSensSotB1_C "Verzögerung Ersatzreaktion für Fehlerpfad Dfp_PFltPresSensSotB1" VALUE 0xD1926 Kw_Wu16 655350.0 Time_ms 0.00 655350.0 FORMAT "%8.1" /end CHARACTERISTIC
/begin CHARACTERISTIC DSM_DInDfp_PFltPresSensSotB2_C "Verzögerung Ersatzreaktion für Fehlerpfad Dfp_PFltPresSensSotB2" VALUE 0xD1928 Kw_Wu16 655350.0 Time_ms 0.00 655350.0 FORMAT "%8.1" /end CHARACTERISTIC
/begin CHARACTERISTIC DSM_DInDfp_PFltRgnPerm_C "Verzögerung Ersatzreaktion für Fehlerpfad Dfp_PFltRgnPerm" VALUE 0xD192A Kw_Wu16 655350.0 Time_ms 0.00 655350.0 FORMAT "%8.1" /end CHARACTERISTIC
/begin CHARACTERISTIC DSM_DInDfp_PFltTempDwnStrmB1_C "Verzögerung Ersatzreaktion für Fehlerpfad Dfp_PFltTempDwnStrmB1" VALUE 0xD192C Kw_Wu16 655350.0 Time_ms 0.00 655350.0 FORMAT "%8.1" /end CHARACTERISTIC
/begin CHARACTERISTIC DSM_DInDfp_PFltTempDwnStrmB2_C "Verzögerung Ersatzreaktion für Fehlerpfad Dfp_PFltTempDwnStrmB2" VALUE 0xD192E Kw_Wu16 655350.0 Time_ms 0.00 655350.0 FORMAT "%8.1" /end CHARACTERISTIC
/begin CHARACTERISTIC DSM_DInDfp_PFltTempSensB1_C "Verzögerung Ersatzreaktion für Fehlerpfad Dfp_PFltTempSensB1" VALUE 0xD1930 Kw_Wu16 655350.0 Time_ms 0.00 655350.0 FORMAT "%8.1" /end CHARACTERISTIC
/begin CHARACTERISTIC DSM_DInDfp_PFltTempSensB2_C "Verzögerung Ersatzreaktion für Fehlerpfad Dfp_PFltTempSensB2" VALUE 0xD1932 Kw_Wu16 655350.0 Time_ms 0.00 655350.0 FORMAT "%8.1" /end CHARACTERISTIC
/begin CHARACTERISTIC DSM_DInDfp_PFltTempUpStrmB1_C "Verzögerung Ersatzreaktion für Fehlerpfad Dfp_PFltTempUpStrmB1" VALUE 0xD1934 Kw_Wu16 655350.0 Time_ms 0.00 655350.0 FORMAT "%8.1" /end CHARACTERISTIC
/begin CHARACTERISTIC DSM_DInDfp_PFltTempUpStrmB2_C "Verzögerung Ersatzreaktion für Fehlerpfad Dfp_PFltTempUpStrmB2" VALUE 0xD1936 Kw_Wu16 655350.0 Time_ms 0.00 655350.0 FORMAT "%8.1" /end CHARACTERISTIC
/begin CHARACTERISTIC DSM_DInDfp_PFlt_tOxiPreMaxB1_C "Verzögerung Ersatzreaktion für Fehlerpfad Dfp_PFlt_tOxiPreMaxB1" VALUE 0xD1938 Kw_Wu16 655350.0 Time_ms 0.00 655350.0 FORMAT "%8.1" /end CHARACTERISTIC
/begin CHARACTERISTIC DSM_DInDfp_PFlt_tOxiPreMaxB2_C "Verzögerung Ersatzreaktion für Fehlerpfad Dfp_PFlt_tOxiPreMaxB2" VALUE 0xD193A Kw_Wu16 655350.0 Time_ms 0.00 655350.0 FORMAT "%8.1" /end CHARACTERISTIC
/begin CHARACTERISTIC DSM_DInDfp_PFlt_tOxiPreMxRgnB1_C "Verzögerung Ersatzreaktion für Fehlerpfad Dfp_PFlt_tOxiPreMxRgnB1" VALUE 0xD193C Kw_Wu16 655350.0 Time_ms 0.00 655350.0 FORMAT "%8.1" /end CHARACTERISTIC
/begin CHARACTERISTIC DSM_DInDfp_PFlt_tOxiPreMxRgnB2_C "Verzögerung Ersatzreaktion für Fehlerpfad Dfp_PFlt_tOxiPreMxRgnB2" VALUE 0xD193E Kw_Wu16 655350.0 Time_ms 0.00 655350.0 FORMAT "%8.1" /end CHARACTERISTIC
/begin CHARACTERISTIC DSM_DInDfp_PFlt_tPreMaxB1_C "Verzögerung Ersatzreaktion für Fehlerpfad Dfp_PFlt_tPreMaxB1" VALUE 0xD1940 Kw_Wu16 655350.0 Time_ms 0.00 655350.0 FORMAT "%8.1" /end CHARACTERISTIC
/begin CHARACTERISTIC DSM_DInDfp_PFlt_tPreMaxB2_C "Verzögerung Ersatzreaktion für Fehlerpfad Dfp_PFlt_tPreMaxB2" VALUE 0xD1942 Kw_Wu16 655350.0 Time_ms 0.00 655350.0 FORMAT "%8.1" /end CHARACTERISTIC
/begin CHARACTERISTIC DSM_DInDfp_PFlt_tPreMaxRgnB1_C "Verzögerung Ersatzreaktion für Fehlerpfad Dfp_PFlt_tPreMaxRgnB1" VALUE 0xD1944 Kw_Wu16 655350.0 Time_ms 0.00 655350.0 FORMAT "%8.1" /end CHARACTERISTIC
/begin CHARACTERISTIC DSM_DInDfp_PFlt_tPreMaxRgnB2_C "Verzögerung Ersatzreaktion für Fehlerpfad Dfp_PFlt_tPreMaxRgnB2" VALUE 0xD1946 Kw_Wu16 655350.0 Time_ms 0.00 655350.0 FORMAT "%8.1" /end CHARACTERISTIC
/begin CHARACTERISTIC DSM_DInDfp_PFltmSotDiffMaxB1_C "Verzögerung Ersatzreaktion für Fehlerpfad Dfp_PFltmSotDiffMaxB1" VALUE 0xD1948 Kw_Wu16 655350.0 Time_ms 0.00 655350.0 FORMAT "%8.1" /end CHARACTERISTIC
/begin CHARACTERISTIC DSM_DInDfp_PFltmSotDiffMaxB2_C "Verzögerung Ersatzreaktion für Fehlerpfad Dfp_PFltmSotDiffMaxB2" VALUE 0xD194A Kw_Wu16 655350.0 Time_ms 0.00 655350.0 FORMAT "%8.1" /end CHARACTERISTIC
/begin CHARACTERISTIC DSM_DInDfp_PresPlausDblDef_C "Verzögerung Ersatzreaktion für Fehlerpfad Dfp_PresPlausDblDef" VALUE 0xD194C Kw_Wu16 655350.0 Time_ms 0.00 655350.0 FORMAT "%8.1" /end CHARACTERISTIC
/begin CHARACTERISTIC DSM_DInDfp_QLTCD_C "Verzögerung Ersatzreaktion für Fehlerpfad Dfp_QLTCD" VALUE 0xD194E Kw_Wu16 655350.0 Time_ms 0.00 655350.0 FORMAT "%8.1" /end CHARACTERISTIC
/begin CHARACTERISTIC DSM_DInDfp_RailCD_C "Verzögerung Ersatzreaktion für Fehlerpfad Dfp_RailCD" VALUE 0xD1950 Kw_Wu16 655350.0 Time_ms 0.00 655350.0 FORMAT "%8.1" /end CHARACTERISTIC
/begin CHARACTERISTIC DSM_DInDfp_RailCDOfsTst_C "Verzögerung Ersatzreaktion für Fehlerpfad Dfp_RailCDOfsTst" VALUE 0xD1952 Kw_Wu16 655350.0 Time_ms 0.00 655350.0 FORMAT "%8.1" /end CHARACTERISTIC
/begin CHARACTERISTIC DSM_DInDfp_RailCD_PMonStrt_C "Verzögerung Ersatzreaktion für Fehlerpfad Dfp_RailCD_PMonStrt" VALUE 0xD1954 Kw_Wu16 655350.0 Time_ms 0.00 655350.0 FORMAT "%8.1" /end CHARACTERISTIC
/begin CHARACTERISTIC DSM_DInDfp_RailCPC1_C "Verzögerung Ersatzreaktion für Fehlerpfad Dfp_RailCPC1" VALUE 0xD1956 Kw_Wu16 655350.0 Time_ms 0.00 655350.0 FORMAT "%8.1" /end CHARACTERISTIC
/begin CHARACTERISTIC DSM_DInDfp_RailCPC3_C "Verzögerung Ersatzreaktion für Fehlerpfad Dfp_RailCPC3" VALUE 0xD1958 Kw_Wu16 655350.0 Time_ms 0.00 655350.0 FORMAT "%8.1" /end CHARACTERISTIC
/begin CHARACTERISTIC DSM_DInDfp_RailCPC4_C "Verzögerung Ersatzreaktion für Fehlerpfad Dfp_RailCPC4" VALUE 0xD195A Kw_Wu16 655350.0 Time_ms 0.00 655350.0 FORMAT "%8.1" /end CHARACTERISTIC
/begin CHARACTERISTIC DSM_DInDfp_RailCtlModeMeUnDiag_C "Verzögerung Ersatzreaktion für Fehlerpfad Dfp_RailCtlModeMeUnDiag" VALUE 0xD195C Kw_Wu16 655350.0 Time_ms 0.00 655350.0 FORMAT "%8.1" /end CHARACTERISTIC
/begin CHARACTERISTIC DSM_DInDfp_RailCtlModePCVDiag_C "Verzögerung Ersatzreaktion für Fehlerpfad Dfp_RailCtlModePCVDiag" VALUE 0xD195E Kw_Wu16 655350.0 Time_ms 0.00 655350.0 FORMAT "%8.1" /end CHARACTERISTIC
/begin CHARACTERISTIC DSM_DInDfp_RailMeUn0_C "Verzögerung Ersatzreaktion für Fehlerpfad Dfp_RailMeUn0" VALUE 0xD1960 Kw_Wu16 655350.0 Time_ms 0.00 655350.0 FORMAT "%8.1" /end CHARACTERISTIC
/begin CHARACTERISTIC DSM_DInDfp_RailMeUn1_C "Verzögerung Ersatzreaktion für Fehlerpfad Dfp_RailMeUn1" VALUE 0xD1962 Kw_Wu16 655350.0 Time_ms 0.00 655350.0 FORMAT "%8.1" /end CHARACTERISTIC
/begin CHARACTERISTIC DSM_DInDfp_RailMeUn2_C "Verzögerung Ersatzreaktion für Fehlerpfad Dfp_RailMeUn2" VALUE 0xD1964 Kw_Wu16 655350.0 Time_ms 0.00 655350.0 FORMAT "%8.1" /end CHARACTERISTIC
/begin CHARACTERISTIC DSM_DInDfp_RailMeUn3_C "Verzögerung Ersatzreaktion für Fehlerpfad Dfp_RailMeUn3" VALUE 0xD1966 Kw_Wu16 655350.0 Time_ms 0.00 655350.0 FORMAT "%8.1" /end CHARACTERISTIC
/begin CHARACTERISTIC DSM_DInDfp_RailMeUn4_C "Verzögerung Ersatzreaktion für Fehlerpfad Dfp_RailMeUn4" VALUE 0xD1968 Kw_Wu16 655350.0 Time_ms 0.00 655350.0 FORMAT "%8.1" /end CHARACTERISTIC
/begin CHARACTERISTIC DSM_DInDfp_RailPCV0_C "Verzögerung Ersatzreaktion für Fehlerpfad Dfp_RailPCV0" VALUE 0xD196A Kw_Wu16 655350.0 Time_ms 0.00 655350.0 FORMAT "%8.1" /end CHARACTERISTIC
/begin CHARACTERISTIC DSM_DInDfp_RailPCV1_C "Verzögerung Ersatzreaktion für Fehlerpfad Dfp_RailPCV1" VALUE 0xD196C Kw_Wu16 655350.0 Time_ms 0.00 655350.0 FORMAT "%8.1" /end CHARACTERISTIC
/begin CHARACTERISTIC DSM_DInDfp_RailPCV2_C "Verzögerung Ersatzreaktion für Fehlerpfad Dfp_RailPCV2" VALUE 0xD196E Kw_Wu16 655350.0 Time_ms 0.00 655350.0 FORMAT "%8.1" /end CHARACTERISTIC
/begin CHARACTERISTIC DSM_DInDfp_RailPCV3_C "Verzögerung Ersatzreaktion für Fehlerpfad Dfp_RailPCV3" VALUE 0xD1970 Kw_Wu16 655350.0 Time_ms 0.00 655350.0 FORMAT "%8.1" /end CHARACTERISTIC
/begin CHARACTERISTIC DSM_DInDfp_RailPCV4_C "Verzögerung Ersatzreaktion für Fehlerpfad Dfp_RailPCV4" VALUE 0xD1972 Kw_Wu16 655350.0 Time_ms 0.00 655350.0 FORMAT "%8.1" /end CHARACTERISTIC
/begin CHARACTERISTIC DSM_DInDfp_RailPCV5_C "Verzögerung Ersatzreaktion für Fehlerpfad Dfp_RailPCV5" VALUE 0xD1974 Kw_Wu16 655350.0 Time_ms 0.00 655350.0 FORMAT "%8.1" /end CHARACTERISTIC
/begin CHARACTERISTIC DSM_DInDfp_SOPTst_C "Verzögerung Ersatzreaktion für Fehlerpfad Dfp_SOPTst" VALUE 0xD1976 Kw_Wu16 655350.0 Time_ms 0.00 655350.0 FORMAT "%8.1" /end CHARACTERISTIC
/begin CHARACTERISTIC DSM_DInDfp_SSpMon1_C "Verzögerung Ersatzreaktion für Fehlerpfad Dfp_SSpMon1" VALUE 0xD1978 Kw_Wu16 655350.0 Time_ms 0.00 655350.0 FORMAT "%8.1" /end CHARACTERISTIC
/begin CHARACTERISTIC DSM_DInDfp_SSpMon2_C "Verzögerung Ersatzreaktion für Fehlerpfad Dfp_SSpMon2" VALUE 0xD197A Kw_Wu16 655350.0 Time_ms 0.00 655350.0 FORMAT "%8.1" /end CHARACTERISTIC
/begin CHARACTERISTIC DSM_DInDfp_SSpMon3_C "Verzögerung Ersatzreaktion für Fehlerpfad Dfp_SSpMon3" VALUE 0xD197C Kw_Wu16 655350.0 Time_ms 0.00 655350.0 FORMAT "%8.1" /end CHARACTERISTIC
/begin CHARACTERISTIC DSM_DInDfp_SSpMon4_C "Verzögerung Ersatzreaktion für Fehlerpfad Dfp_SSpMon4" VALUE 0xD197E Kw_Wu16 655350.0 Time_ms 0.00 655350.0 FORMAT "%8.1" /end CHARACTERISTIC
/begin CHARACTERISTIC DSM_DInDfp_SSpMon5_C "Verzögerung Ersatzreaktion für Fehlerpfad Dfp_SSpMon5" VALUE 0xD1980 Kw_Wu16 655350.0 Time_ms 0.00 655350.0 FORMAT "%8.1" /end CHARACTERISTIC
/begin CHARACTERISTIC DSM_DInDfp_SSpMon6_C "Verzögerung Ersatzreaktion für Fehlerpfad Dfp_SSpMon6" VALUE 0xD1982 Kw_Wu16 655350.0 Time_ms 0.00 655350.0 FORMAT "%8.1" /end CHARACTERISTIC
/begin CHARACTERISTIC DSM_DInDfp_SWChk_CycSigChkDat_C "Verzögerung Ersatzreaktion für Fehlerpfad Dfp_SWChk_CycSigChkDat" VALUE 0xD1984 Kw_Wu16 655350.0 Time_ms 0.00 655350.0 FORMAT "%8.1" /end CHARACTERISTIC
/begin CHARACTERISTIC DSM_DInDfp_SWChk_CycSigChkPrg_C "Verzögerung Ersatzreaktion für Fehlerpfad Dfp_SWChk_CycSigChkPrg" VALUE 0xD1986 Kw_Wu16 655350.0 Time_ms 0.00 655350.0 FORMAT "%8.1" /end CHARACTERISTIC
/begin CHARACTERISTIC DSM_DInDfp_StSysTrqShutOff_C "Verzögerung Ersatzreaktion für Fehlerpfad Dfp_StSysTrqShutOff" VALUE 0xD1988 Kw_Wu16 655350.0 Time_ms 0.00 655350.0 FORMAT "%8.1" /end CHARACTERISTIC
/begin CHARACTERISTIC DSM_DInDfp_StrtCD_Actr_C "Verzögerung Ersatzreaktion für Fehlerpfad Dfp_StrtCD_Actr" VALUE 0xD198A Kw_Wu16 655350.0 Time_ms 0.00 655350.0 FORMAT "%8.1" /end CHARACTERISTIC
/begin CHARACTERISTIC DSM_DInDfp_SysLamp_C "Verzögerung Ersatzreaktion für Fehlerpfad Dfp_SysLamp" VALUE 0xD198C Kw_Wu16 655350.0 Time_ms 0.00 655350.0 FORMAT "%8.1" /end CHARACTERISTIC
/begin CHARACTERISTIC DSM_DInDfp_T15CD_C "Verzögerung Ersatzreaktion für Fehlerpfad Dfp_T15CD" VALUE 0xD198E Kw_Wu16 655350.0 Time_ms 0.00 655350.0 FORMAT "%8.1" /end CHARACTERISTIC
/begin CHARACTERISTIC DSM_DInDfp_TGearbx_C "Verzögerung Ersatzreaktion für Fehlerpfad Dfp_TGearbx" VALUE 0xD1990 Kw_Wu16 655350.0 Time_ms 0.00 655350.0 FORMAT "%8.1" /end CHARACTERISTIC
/begin CHARACTERISTIC DSM_DInDfp_TPUMon_C "Verzögerung Ersatzreaktion für Fehlerpfad Dfp_TPUMon" VALUE 0xD1992 Kw_Wu16 655350.0 Time_ms 0.00 655350.0 FORMAT "%8.1" /end CHARACTERISTIC
/begin CHARACTERISTIC DSM_DInDfp_TVACD_AirMon1_C "Verzögerung Ersatzreaktion für Fehlerpfad Dfp_TVACD_AirMon1" VALUE 0xD1994 Kw_Wu16 655350.0 Time_ms 0.00 655350.0 FORMAT "%8.1" /end CHARACTERISTIC
/begin CHARACTERISTIC DSM_DInDfp_TVACD_AirMon2_C "Verzögerung Ersatzreaktion für Fehlerpfad Dfp_TVACD_AirMon2" VALUE 0xD1996 Kw_Wu16 655350.0 Time_ms 0.00 655350.0 FORMAT "%8.1" /end CHARACTERISTIC
/begin CHARACTERISTIC DSM_DInDfp_TVACD_Max_C "Verzögerung Ersatzreaktion für Fehlerpfad Dfp_TVACD_Max" VALUE 0xD1998 Kw_Wu16 655350.0 Time_ms 0.00 655350.0 FORMAT "%8.1" /end CHARACTERISTIC
/begin CHARACTERISTIC DSM_DInDfp_TVACD_Max2_C "Verzögerung Ersatzreaktion für Fehlerpfad Dfp_TVACD_Max2" VALUE 0xD199A Kw_Wu16 655350.0 Time_ms 0.00 655350.0 FORMAT "%8.1" /end CHARACTERISTIC
/begin CHARACTERISTIC DSM_DInDfp_TVACD_Min_C "Verzögerung Ersatzreaktion für Fehlerpfad Dfp_TVACD_Min" VALUE 0xD199C Kw_Wu16 655350.0 Time_ms 0.00 655350.0 FORMAT "%8.1" /end CHARACTERISTIC
/begin CHARACTERISTIC DSM_DInDfp_TVACD_Min2_C "Verzögerung Ersatzreaktion für Fehlerpfad Dfp_TVACD_Min2" VALUE 0xD199E Kw_Wu16 655350.0 Time_ms 0.00 655350.0 FORMAT "%8.1" /end CHARACTERISTIC
/begin CHARACTERISTIC DSM_DInDfp_TVACD_SigNpl_C "Verzögerung Ersatzreaktion für Fehlerpfad Dfp_TVACD_SigNpl" VALUE 0xD19A0 Kw_Wu16 655350.0 Time_ms 0.00 655350.0 FORMAT "%8.1" /end CHARACTERISTIC
/begin CHARACTERISTIC DSM_DInDfp_TVACD_SigNpl2_C "Verzögerung Ersatzreaktion für Fehlerpfad Dfp_TVACD_SigNpl2" VALUE 0xD19A2 Kw_Wu16 655350.0 Time_ms 0.00 655350.0 FORMAT "%8.1" /end CHARACTERISTIC
/begin CHARACTERISTIC DSM_DInDfp_TVACD_TVADia1_C "Verzögerung Ersatzreaktion für Fehlerpfad Dfp_TVACD_TVADia1" VALUE 0xD19A4 Kw_Wu16 655350.0 Time_ms 0.00 655350.0 FORMAT "%8.1" /end CHARACTERISTIC
/begin CHARACTERISTIC DSM_DInDfp_TVACD_TVADia2_C "Verzögerung Ersatzreaktion für Fehlerpfad Dfp_TVACD_TVADia2" VALUE 0xD19A6 Kw_Wu16 655350.0 Time_ms 0.00 655350.0 FORMAT "%8.1" /end CHARACTERISTIC
/begin CHARACTERISTIC DSM_DInDfp_TVACD_TVADia21_C "Verzögerung Ersatzreaktion für Fehlerpfad Dfp_TVACD_TVADia21" VALUE 0xD19A8 Kw_Wu16 655350.0 Time_ms 0.00 655350.0 FORMAT "%8.1" /end CHARACTERISTIC
/begin CHARACTERISTIC DSM_DInDfp_TVACD_TVADia22_C "Verzögerung Ersatzreaktion für Fehlerpfad Dfp_TVACD_TVADia22" VALUE 0xD19AA Kw_Wu16 655350.0 Time_ms 0.00 655350.0 FORMAT "%8.1" /end CHARACTERISTIC
/begin CHARACTERISTIC DSM_DInDfp_TVACD_TVADia23_C "Verzögerung Ersatzreaktion für Fehlerpfad Dfp_TVACD_TVADia23" VALUE 0xD19AC Kw_Wu16 655350.0 Time_ms 0.00 655350.0 FORMAT "%8.1" /end CHARACTERISTIC
/begin CHARACTERISTIC DSM_DInDfp_TVACD_TVADia24_C "Verzögerung Ersatzreaktion für Fehlerpfad Dfp_TVACD_TVADia24" VALUE 0xD19AE Kw_Wu16 655350.0 Time_ms 0.00 655350.0 FORMAT "%8.1" /end CHARACTERISTIC
/begin CHARACTERISTIC DSM_DInDfp_TVACD_TVADia3_C "Verzögerung Ersatzreaktion für Fehlerpfad Dfp_TVACD_TVADia3" VALUE 0xD19B0 Kw_Wu16 655350.0 Time_ms 0.00 655350.0 FORMAT "%8.1" /end CHARACTERISTIC
/begin CHARACTERISTIC DSM_DInDfp_TVACD_TVADia4_C "Verzögerung Ersatzreaktion für Fehlerpfad Dfp_TVACD_TVADia4" VALUE 0xD19B2 Kw_Wu16 655350.0 Time_ms 0.00 655350.0 FORMAT "%8.1" /end CHARACTERISTIC
/begin CHARACTERISTIC DSM_DInDfp_ThrVlvMon_C "Inhibit Handler Delay Time for path Dfp_ThrVlvMon" VALUE 0xD19B4 Kw_Wu16 655350.0 Time_ms 0.00 655350.0 FORMAT "%8.1" /end CHARACTERISTIC
/begin CHARACTERISTIC DSM_DInDfp_VSACD_DiaDet_C "Verzögerung Ersatzreaktion für Fehlerpfad Dfp_VSACD_DiaDet" VALUE 0xD19B6 Kw_Wu16 655350.0 Time_ms 0.00 655350.0 FORMAT "%8.1" /end CHARACTERISTIC
/begin CHARACTERISTIC DSM_DInDfp_VSACD_DioInDia1_C "Verzögerung Ersatzreaktion für Fehlerpfad Dfp_VSACD_DioInDia1" VALUE 0xD19B8 Kw_Wu16 655350.0 Time_ms 0.00 655350.0 FORMAT "%8.1" /end CHARACTERISTIC
/begin CHARACTERISTIC DSM_DInDfp_VSACD_DioInDia2_C "Verzögerung Ersatzreaktion für Fehlerpfad Dfp_VSACD_DioInDia2" VALUE 0xD19BA Kw_Wu16 655350.0 Time_ms 0.00 655350.0 FORMAT "%8.1" /end CHARACTERISTIC
/begin CHARACTERISTIC DSM_DInDfp_VSACD_DioInDia3_C "Verzögerung Ersatzreaktion für Fehlerpfad Dfp_VSACD_DioInDia3" VALUE 0xD19BC Kw_Wu16 655350.0 Time_ms 0.00 655350.0 FORMAT "%8.1" /end CHARACTERISTIC
/begin CHARACTERISTIC DSM_DInDfp_VSACD_DioInDia4_C "Verzögerung Ersatzreaktion für Fehlerpfad Dfp_VSACD_DioInDia4" VALUE 0xD19BE Kw_Wu16 655350.0 Time_ms 0.00 655350.0 FORMAT "%8.1" /end CHARACTERISTIC
/begin CHARACTERISTIC DSM_DInDfp_VSACD_DioInMin_C "Verzögerung Ersatzreaktion für Fehlerpfad Dfp_VSACD_DioInMin" VALUE 0xD19C0 Kw_Wu16 655350.0 Time_ms 0.00 655350.0 FORMAT "%8.1" /end CHARACTERISTIC
/begin CHARACTERISTIC DSM_DInDfp_VSACD_Max_C "Verzögerung Ersatzreaktion für Fehlerpfad Dfp_VSACD_Max" VALUE 0xD19C2 Kw_Wu16 655350.0 Time_ms 0.00 655350.0 FORMAT "%8.1" /end CHARACTERISTIC
/begin CHARACTERISTIC DSM_DInDfp_VSACD_Min_C "Verzögerung Ersatzreaktion für Fehlerpfad Dfp_VSACD_Min" VALUE 0xD19C4 Kw_Wu16 655350.0 Time_ms 0.00 655350.0 FORMAT "%8.1" /end CHARACTERISTIC
/begin CHARACTERISTIC DSM_DInDfp_VSACD_SigNpl_C "Verzögerung Ersatzreaktion für Fehlerpfad Dfp_VSACD_SigNpl" VALUE 0xD19C6 Kw_Wu16 655350.0 Time_ms 0.00 655350.0 FORMAT "%8.1" /end CHARACTERISTIC
/begin CHARACTERISTIC DSM_DInDfp_VSACD_VSADia1_C "Verzögerung Ersatzreaktion für Fehlerpfad Dfp_VSACD_VSADia1" VALUE 0xD19C8 Kw_Wu16 655350.0 Time_ms 0.00 655350.0 FORMAT "%8.1" /end CHARACTERISTIC
/begin CHARACTERISTIC DSM_DInDfp_VSACD_VSADia2_C "Verzögerung Ersatzreaktion für Fehlerpfad Dfp_VSACD_VSADia2" VALUE 0xD19CA Kw_Wu16 655350.0 Time_ms 0.00 655350.0 FORMAT "%8.1" /end CHARACTERISTIC
/begin CHARACTERISTIC DSM_DInDfp_VSACD_VSADia3_C "Verzögerung Ersatzreaktion für Fehlerpfad Dfp_VSACD_VSADia3" VALUE 0xD19CC Kw_Wu16 655350.0 Time_ms 0.00 655350.0 FORMAT "%8.1" /end CHARACTERISTIC
/begin CHARACTERISTIC DSM_DInDfp_VSACD_VSADia4_C "Verzögerung Ersatzreaktion für Fehlerpfad Dfp_VSACD_VSADia4" VALUE 0xD19CE Kw_Wu16 655350.0 Time_ms 0.00 655350.0 FORMAT "%8.1" /end CHARACTERISTIC
/begin CHARACTERISTIC DSM_DInDfp_VSSCD1_C "Verzögerung Ersatzreaktion für Fehlerpfad Dfp_VSSCD1" VALUE 0xD19D0 Kw_Wu16 655350.0 Time_ms 0.00 655350.0 FORMAT "%8.1" /end CHARACTERISTIC
/begin CHARACTERISTIC DSM_DInDfp_VSSCD2_C "Verzögerung Ersatzreaktion für Fehlerpfad Dfp_VSSCD2" VALUE 0xD19D2 Kw_Wu16 655350.0 Time_ms 0.00 655350.0 FORMAT "%8.1" /end CHARACTERISTIC
/begin CHARACTERISTIC DSM_DInDfp_WdCom_C "Verzögerung Ersatzreaktion für Fehlerpfad Dfp_WdCom" VALUE 0xD19D4 Kw_Wu16 655350.0 Time_ms 0.00 655350.0 FORMAT "%8.1" /end CHARACTERISTIC
/begin MEASUREMENT DSM_FCM_mp "Fehlerspeicher" UBYTE OneToOne 1 100 0.00 255.0 FORMAT "%5.1" ARRAY_SIZE 644 ECU_ADDRESS 0x8FDA98 /end MEASUREMENT
/begin MEASUREMENT Fid_ACCIRevErr_mp "Ist diese Fid verriegelt, so geht die ACC-Momentenschnittstelle in den Zustand ""irreversibler Fehler""" UBYTE OneToOne 1 100 0.00 255.0 FORMAT "%5.1" ECU_ADDRESS 0x8FDD1C /end MEASUREMENT
/begin MEASUREMENT Fid_AccPedBrkPres_mp "FID für defekten Bremsdruck" UBYTE OneToOne 1 100 0.00 255.0 FORMAT "%5.1" ECU_ADDRESS 0x8FDD1D /end MEASUREMENT
/begin MEASUREMENT Fid_AccPedVel_mp "Messpunkt fuer Fid_AccPedVel" UBYTE OneToOne 1 100 0.00 255.0 FORMAT "%5.1" ECU_ADDRESS 0x8FDD1E /end MEASUREMENT
/begin MEASUREMENT Fid_AccPed_Brk_mp "Verriegelung der Freigabe der Überprüfung auf Unplausibilität  bei defekter Bremse" UBYTE OneToOne 1 100 0.00 255.0 FORMAT "%5.1" ECU_ADDRESS 0x8FDD1F /end MEASUREMENT
/begin MEASUREMENT Fid_AccPed_mp "Fehler-Identifier des APP1-Sensors, APP2-Sensors und ADC in diesem Modul" UBYTE OneToOne 1 100 0.00 255.0 FORMAT "%5.1" ECU_ADDRESS 0x8FDD20 /end MEASUREMENT
/begin MEASUREMENT Fid_ACCRevErr_mp "Ist diese Fid verriegelt, so geht die ACC-Momentenschnittstelle in den Zustand ""reversibler Fehler""" UBYTE OneToOne 1 100 0.00 255.0 FORMAT "%5.1" ECU_ADDRESS 0x8FDD21 /end MEASUREMENT
/begin MEASUREMENT Fid_ACCtl_ACTrqErr_mp "Messpunkt fuer Funktions Identifier Fid_ACCtl_ACTrqErr" UBYTE OneToOne 1 100 0.00 255.0 FORMAT "%5.1" ECU_ADDRESS 0x8FDD22 /end MEASUREMENT
/begin MEASUREMENT Fid_ACCtl_CTSErr_mp "Messpunkt fuer Funktions Identifier Fid_ACCtl_CTSErr" UBYTE OneToOne 1 100 0.00 255.0 FORMAT "%5.1" ECU_ADDRESS 0x8FDD23 /end MEASUREMENT
/begin MEASUREMENT Fid_ACCtl_FanErr_mp "Messpunkt fuer Funktions Identifier Fid_ACCtl_FanErr" UBYTE OneToOne 1 100 0.00 255.0 FORMAT "%5.1" ECU_ADDRESS 0x8FDD24 /end MEASUREMENT
/begin MEASUREMENT Fid_ACCtl_TGearbxErr_mp "Messpunkt fuer Funktions Identifier Fid_ACCtl_TGearbxErr" UBYTE OneToOne 1 100 0.00 255.0 FORMAT "%5.1" ECU_ADDRESS 0x8FDD25 /end MEASUREMENT
/begin MEASUREMENT Fid_ACCtl_VSSErr_mp "Messpunkt fuer Funktions Identifier Fid_ACCtl_VSSErr" UBYTE OneToOne 1 100 0.00 255.0 FORMAT "%5.1" ECU_ADDRESS 0x8FDD26 /end MEASUREMENT
/begin MEASUREMENT Fid_ACC_AliveErr_mp "Ist diese Fid verriegelt, so geht die ACC-Momentenschnittstelle in Zustand ""irreversiler Fehler""" UBYTE OneToOne 1 100 0.00 255.0 FORMAT "%5.1" ECU_ADDRESS 0x8FDD27 /end MEASUREMENT
/begin MEASUREMENT Fid_ACC_CanDef_mp "Abschaltung ACC bei Fehler auf privaten CAN (Master Slave)" UBYTE OneToOne 1 100 0.00 255.0 FORMAT "%5.1" ECU_ADDRESS 0x8FDD28 /end MEASUREMENT
/begin MEASUREMENT Fid_ACC_CsErr_mp "Ist diese Fid verriegelt, so geht die ACC-Momentenschnittstelle in den Zustand ""irreversibler Fehler""" UBYTE OneToOne 1 100 0.00 255.0 FORMAT "%5.1" ECU_ADDRESS 0x8FDD29 /end MEASUREMENT
/begin MEASUREMENT Fid_ACC_TiOutErr_mp "Ist diese Fid verriegelt, so geht die ACC-Momentenschnittstelle in den Zustand ""reversibler Fehler""" UBYTE OneToOne 1 100 0.00 255.0 FORMAT "%5.1" ECU_ADDRESS 0x8FDD2A /end MEASUREMENT
/begin MEASUREMENT Fid_AFSCD2_mp "Messpunkt fuer Funktions Identifier Fid_AFSCD2" UBYTE OneToOne 1 100 0.00 255.0 FORMAT "%5.1" ECU_ADDRESS 0x8FDD2B /end MEASUREMENT
/begin MEASUREMENT Fid_AFSCD_AirPerCyl2_mp "Messpunkt fuer Funktions Identifier Fid_AFSCD_AirPerCyl2" UBYTE OneToOne 1 100 0.00 255.0 FORMAT "%5.1" ECU_ADDRESS 0x8FDD2C /end MEASUREMENT
/begin MEASUREMENT Fid_AFSCD_AirPerCyl_mp "Fid zur Umschaltung von der berechneten Luftmasse pro Zylinder auf den Ersatzwert" UBYTE OneToOne 1 100 0.00 255.0 FORMAT "%5.1" ECU_ADDRESS 0x8FDD2D /end MEASUREMENT
/begin MEASUREMENT Fid_AFSCD_AirPerTime2_mp "Messpunkt fuer Funktions Identifier Fid_AFSCD_AirPerTime2" UBYTE OneToOne 1 100 0.00 255.0 FORMAT "%5.1" ECU_ADDRESS 0x8FDD2E /end MEASUREMENT
/begin MEASUREMENT Fid_AFSCD_AirPerTime_mp "FID für Berechnung der Luftmasse pro Zeit" UBYTE OneToOne 1 100 0.00 255.0 FORMAT "%5.1" ECU_ADDRESS 0x8FDD2F /end MEASUREMENT
/begin MEASUREMENT Fid_AFSCD_BPSCDErr_mp "Fid zur Umschatung zwischen Athmosphären druck und boost preasue für defekte Luftmasse pro Zylinder" UBYTE OneToOne 1 100 0.00 255.0 FORMAT "%5.1" ECU_ADDRESS 0x8FDD30 /end MEASUREMENT
/begin MEASUREMENT Fid_AFSCD_mp "FID für Luftmassberechnung" UBYTE OneToOne 1 100 0.00 255.0 FORMAT "%5.1" ECU_ADDRESS 0x8FDD31 /end MEASUREMENT
/begin MEASUREMENT Fid_AFSCD_PlAirPerCylDifOff_mp "" UBYTE OneToOne 1 100 0.00 255.0 FORMAT "%5.1" ECU_ADDRESS 0x8FDD32 /end MEASUREMENT
/begin MEASUREMENT Fid_AFSCD_PlOffsDrft2_mp "Messpunkt fuer Funktions Identifier Fid_AFSCD_PlOffsDrft2" UBYTE OneToOne 1 100 0.00 255.0 FORMAT "%5.1" ECU_ADDRESS 0x8FDD33 /end MEASUREMENT
/begin MEASUREMENT Fid_AFSCD_PlOffsDrft_mp "FID für Funktion AFSCD_PlOffsDrft" UBYTE OneToOne 1 100 0.00 255.0 FORMAT "%5.1" ECU_ADDRESS 0x8FDD34 /end MEASUREMENT
/begin MEASUREMENT Fid_AFSCD_PlSetyDrft2_mp "Messpunkt fuer Funktions Identifier Fid_AFSCD_PlSetyDrft2" UBYTE OneToOne 1 100 0.00 255.0 FORMAT "%5.1" ECU_ADDRESS 0x8FDD35 /end MEASUREMENT
/begin MEASUREMENT Fid_AFSCD_PlSetyDrft_mp "FID für Plausibilitätsprüfung für Empfindlichkeitsdrift des Sensorsignals" UBYTE OneToOne 1 100 0.00 255.0 FORMAT "%5.1" ECU_ADDRESS 0x8FDD36 /end MEASUREMENT
/begin MEASUREMENT Fid_AFSCD_SRCCorrAirm2_mp "Messpunkt fuer Funktions Identifier Fid_AFSCD_SRCCorrAirm2" UBYTE OneToOne 1 100 0.00 255.0 FORMAT "%5.1" ECU_ADDRESS 0x8FDD37 /end MEASUREMENT
/begin MEASUREMENT Fid_AFSCD_SRCCorrAirm_mp "Fid zur Verriegelung des SRC des korrigierten Sensorsignals (HFM6)" UBYTE OneToOne 1 100 0.00 255.0 FORMAT "%5.1" ECU_ADDRESS 0x8FDD38 /end MEASUREMENT
/begin MEASUREMENT Fid_AFSCD_SRCDcyc2_mp "Messpunkt fuer Funktions Identifier Fid_AFSCD_SRCDcyc2" UBYTE OneToOne 1 100 0.00 255.0 FORMAT "%5.1" ECU_ADDRESS 0x8FDD39 /end MEASUREMENT
/begin MEASUREMENT Fid_AFSCD_SRCDcyc_mp "Fid zur Verriegelung des SRC des Tastverhältnisses des Temperatursignals" UBYTE OneToOne 1 100 0.00 255.0 FORMAT "%5.1" ECU_ADDRESS 0x8FDD3A /end MEASUREMENT
/begin MEASUREMENT Fid_AFSCD_SRCRawAirm2_mp "Messpunkt fuer Funktions Identifier Fid_AFSCD_SRCRawAirm2" UBYTE OneToOne 1 100 0.00 255.0 FORMAT "%5.1" ECU_ADDRESS 0x8FDD3B /end MEASUREMENT
/begin MEASUREMENT Fid_AFSCD_SRCRawAirm_mp "Fid zur Verriegelung des SRC des unkorrigierten Sensorsignals (HFM6)" UBYTE OneToOne 1 100 0.00 255.0 FORMAT "%5.1" ECU_ADDRESS 0x8FDD3C /end MEASUREMENT
/begin MEASUREMENT Fid_AFSCD_SRCRefSig2_mp "Messpunkt fuer Funktions Identifier Fid_AFSCD_SRCRefSig2" UBYTE OneToOne 1 100 0.00 255.0 FORMAT "%5.1" ECU_ADDRESS 0x8FDD3D /end MEASUREMENT
/begin MEASUREMENT Fid_AFSCD_SRCRefSig_mp "Fid zur Verriegelung des SRC der Periodendauer des Referenz- bzw Temperatursignals" UBYTE OneToOne 1 100 0.00 255.0 FORMAT "%5.1" ECU_ADDRESS 0x8FDD3E /end MEASUREMENT
/begin MEASUREMENT Fid_AFSCD_tAir1_mp "Messpunkt fuer Funktions Identifier Fid_AFSCD_tAir1" UBYTE OneToOne 1 100 0.00 255.0 FORMAT "%5.1" ECU_ADDRESS 0x8FDD3F /end MEASUREMENT
/begin MEASUREMENT Fid_AFSCD_tAir2_mp "Messpunkt fuer Funktions Identifier Fid_AFSCD_tAir2" UBYTE OneToOne 1 100 0.00 255.0 FORMAT "%5.1" ECU_ADDRESS 0x8FDD40 /end MEASUREMENT
/begin MEASUREMENT Fid_AirCtlCorrAlt_mp "" UBYTE OneToOne 1 100 0.00 255.0 FORMAT "%5.1" ECU_ADDRESS 0x8FDD41 /end MEASUREMENT
/begin MEASUREMENT Fid_AirCtlDyn_mp "Fid für dynamische Begrenzung 2 - AirCtl" UBYTE OneToOne 1 100 0.00 255.0 FORMAT "%5.1" ECU_ADDRESS 0x8FDD42 /end MEASUREMENT
/begin MEASUREMENT Fid_AirCtlNeg2_mp "Messpunkt fuer Funktions Identifier Fid_AirCtlNeg2" UBYTE OneToOne 1 100 0.00 255.0 FORMAT "%5.1" ECU_ADDRESS 0x8FDD43 /end MEASUREMENT
/begin MEASUREMENT Fid_AirCtlNeg_mp "Messpunkt fuer Funktions Identifier Fid_AirCtlNeg" UBYTE OneToOne 1 100 0.00 255.0 FORMAT "%5.1" ECU_ADDRESS 0x8FDD44 /end MEASUREMENT
/begin MEASUREMENT Fid_AirCtlPFltEGRRed_mp "AirCtlPFltEGRRed fault identifier" UBYTE OneToOne 1 100 0.00 255.0 FORMAT "%5.1" ECU_ADDRESS 0x8FDD45 /end MEASUREMENT
/begin MEASUREMENT Fid_AirCtlPlateBreakAct_mp "" UBYTE OneToOne 1 100 0.00 255.0 FORMAT "%5.1" ECU_ADDRESS 0x8FDD46 /end MEASUREMENT
/begin MEASUREMENT Fid_AirCtlPlateBreak_mp "Fid for plate break monitoring" UBYTE OneToOne 1 100 0.00 255.0 FORMAT "%5.1" ECU_ADDRESS 0x8FDD47 /end MEASUREMENT
/begin MEASUREMENT Fid_AirCtlPos2_mp "Messpunkt fuer Funktions Identifier Fid_AirCtlPos2" UBYTE OneToOne 1 100 0.00 255.0 FORMAT "%5.1" ECU_ADDRESS 0x8FDD48 /end MEASUREMENT
/begin MEASUREMENT Fid_AirCtlPos_mp "Messpunkt fuer Funktions Identifier Fid_AirCtlPos" UBYTE OneToOne 1 100 0.00 255.0 FORMAT "%5.1" ECU_ADDRESS 0x8FDD49 /end MEASUREMENT
/begin MEASUREMENT Fid_AirCtl_Brk_mp "Fid zum Deaktvieren der Fehlerausblendung bei betätigter Bremse" UBYTE OneToOne 1 100 0.00 255.0 FORMAT "%5.1" ECU_ADDRESS 0x8FDD4A /end MEASUREMENT
/begin MEASUREMENT Fid_AirCtl_Gear_mp "Störung Identifikation für Airctl vom gearbxstatus" UBYTE OneToOne 1 100 0.00 255.0 FORMAT "%5.1" ECU_ADDRESS 0x8FDD4B /end MEASUREMENT
/begin MEASUREMENT Fid_AirCtl_mp "AirCtl Fehler-Identifier" UBYTE OneToOne 1 100 0.00 255.0 FORMAT "%5.1" ECU_ADDRESS 0x8FDD4C /end MEASUREMENT
/begin MEASUREMENT Fid_AOHt_AltErr_mp "Messpunkt fuer Funktions Identifier Fid_AOHt_AltErr" UBYTE OneToOne 1 100 0.00 255.0 FORMAT "%5.1" ECU_ADDRESS 0x8FDD4D /end MEASUREMENT
/begin MEASUREMENT Fid_AOHt_ShutOffErr_mp "Messpunkt fuer Funktions Identifier Fid_AOHt_ShutOffErr" UBYTE OneToOne 1 100 0.00 255.0 FORMAT "%5.1" ECU_ADDRESS 0x8FDD4E /end MEASUREMENT
/begin MEASUREMENT Fid_APP1_mp "Fid für Fehlerpfad APP1" UBYTE OneToOne 1 100 0.00 255.0 FORMAT "%5.1" ECU_ADDRESS 0x8FDD4F /end MEASUREMENT
/begin MEASUREMENT Fid_APP2_mp "Fid für Fehlerpfad APP2" UBYTE OneToOne 1 100 0.00 255.0 FORMAT "%5.1" ECU_ADDRESS 0x8FDD50 /end MEASUREMENT
/begin MEASUREMENT Fid_APPKickdown_mp "Messpunkt für Fid_APPKickdown" UBYTE OneToOne 1 100 0.00 255.0 FORMAT "%5.1" ECU_ADDRESS 0x8FDD51 /end MEASUREMENT
/begin MEASUREMENT Fid_APSCD_mp "Fid für APSCD Fehlerpfad" UBYTE OneToOne 1 100 0.00 255.0 FORMAT "%5.1" ECU_ADDRESS 0x8FDD52 /end MEASUREMENT
/begin MEASUREMENT Fid_ARSOff_mp "Fid for error reaction" UBYTE OneToOne 1 100 0.00 255.0 FORMAT "%5.1" ECU_ADDRESS 0x8FDD53 /end MEASUREMENT
/begin MEASUREMENT Fid_ASDdc_mp "FID zur Deaktivierung des ASDdc" UBYTE OneToOne 1 100 0.00 255.0 FORMAT "%5.1" ECU_ADDRESS 0x8FDD54 /end MEASUREMENT
/begin MEASUREMENT Fid_ASModSwtOffEng_mp "Messpunkt für function identifier Fid_ASModSwtOffEng" UBYTE OneToOne 1 100 0.00 255.0 FORMAT "%5.1" ECU_ADDRESS 0x8FDD55 /end MEASUREMENT
/begin MEASUREMENT Fid_ASModSwtOffIndVol_mp "Meßpunkt für function identifier Fid_ASModSwtOffIndVol" UBYTE OneToOne 1 100 0.00 255.0 FORMAT "%5.1" ECU_ADDRESS 0x8FDD56 /end MEASUREMENT
/begin MEASUREMENT Fid_BPSCDMon_mp "FID zur Sperrung des SRC-Checks bei einem Fehler in der verwendeten Sensorversorgung" UBYTE OneToOne 1 100 0.00 255.0 FORMAT "%5.1" ECU_ADDRESS 0x8FDD57 /end MEASUREMENT
/begin MEASUREMENT Fid_ClgDynTst_mp "Messpunkt fuer Funktions Identifier Fid_ClgDynTst" UBYTE OneToOne 1 100 0.00 255.0 FORMAT "%5.1" ECU_ADDRESS 0x8FDD58 /end MEASUREMENT
/begin MEASUREMENT Fid_CmbChb_mp "FID zur Aktivierung der Aussetzererkennung" UBYTE OneToOne 1 100 0.00 255.0 FORMAT "%5.1" ECU_ADDRESS 0x8FDD59 /end MEASUREMENT
/begin MEASUREMENT Fid_CoDT_GripDeb_mp "Fid für Kraftschlußentprellung" UBYTE OneToOne 1 100 0.00 255.0 FORMAT "%5.1" ECU_ADDRESS 0x8FDD5A /end MEASUREMENT
/begin MEASUREMENT Fid_CoDT_Mon_mp "Messpunkt fuer Funktions Identifier Fid_CoDT_Mon" UBYTE OneToOne 1 100 0.00 255.0 FORMAT "%5.1" ECU_ADDRESS 0x8FDD5B /end MEASUREMENT
/begin MEASUREMENT Fid_CoDT_TRQ_mp "Fid für den Fehlerpfad Dfp_CoDT_TRQ" UBYTE OneToOne 1 100 0.00 255.0 FORMAT "%5.1" ECU_ADDRESS 0x8FDD5C /end MEASUREMENT
/begin MEASUREMENT Fid_CoEngIRevSys1_mp "Fid für irreversible Systemfehler 1" UBYTE OneToOne 1 100 0.00 255.0 FORMAT "%5.1" ECU_ADDRESS 0x8FDD5D /end MEASUREMENT
/begin MEASUREMENT Fid_CoEngIRevSys2_mp "Fid für irreversible Systemfehler 2" UBYTE OneToOne 1 100 0.00 255.0 FORMAT "%5.1" ECU_ADDRESS 0x8FDD5E /end MEASUREMENT
/begin MEASUREMENT Fid_CoEngIRevVeh_mp "Freigabe, sofern keine irreversiblen Fahrzeugfehler vorhanden" UBYTE OneToOne 1 100 0.00 255.0 FORMAT "%5.1" ECU_ADDRESS 0x8FDD5F /end MEASUREMENT
/begin MEASUREMENT Fid_CoEngPFltErr_mp "Messpunkt fuer Funktions Identifier Fid_CoEngPFltErr" UBYTE OneToOne 1 100 0.00 255.0 FORMAT "%5.1" ECU_ADDRESS 0x8FDD60 /end MEASUREMENT
/begin MEASUREMENT Fid_CoEngPFltOvldErr_mp "Messpunkt fuer Funktions Identifier Fid_CoEngPFltOvldErr" UBYTE OneToOne 1 100 0.00 255.0 FORMAT "%5.1" ECU_ADDRESS 0x8FDD61 /end MEASUREMENT
/begin MEASUREMENT Fid_CoEngRevSys1_mp "Fid für reversible Systemfehler 1" UBYTE OneToOne 1 100 0.00 255.0 FORMAT "%5.1" ECU_ADDRESS 0x8FDD62 /end MEASUREMENT
/begin MEASUREMENT Fid_CoEngRevSys2_mp "Fid für reversible Systemfehler 2" UBYTE OneToOne 1 100 0.00 255.0 FORMAT "%5.1" ECU_ADDRESS 0x8FDD63 /end MEASUREMENT
/begin MEASUREMENT Fid_CoEngRevVeh_mp "Freigabe, sofern keine reversiblen Fahrzeugfehler vorliegen" UBYTE OneToOne 1 100 0.00 255.0 FORMAT "%5.1" ECU_ADDRESS 0x8FDD64 /end MEASUREMENT
/begin MEASUREMENT Fid_CoEngShOffTst_mp "Fid für Deaktivierung belibiger Nachlauf-Prüfungen" UBYTE OneToOne 1 100 0.00 255.0 FORMAT "%5.1" ECU_ADDRESS 0x8FDD65 /end MEASUREMENT
/begin MEASUREMENT Fid_CoEngSoftShOffTV_mp "Messpunkt fuer Funktions Identifier Fid_CoEngSoftShOffTV" UBYTE OneToOne 1 100 0.00 255.0 FORMAT "%5.1" ECU_ADDRESS 0x8FDD66 /end MEASUREMENT
/begin MEASUREMENT Fid_CoEng_ActrPrt_mp "Fehler zur Vermeidung des Stellerschutzzustands COENG_ACTR_PRT" UBYTE OneToOne 1 100 0.00 255.0 FORMAT "%5.1" ECU_ADDRESS 0x8FDD67 /end MEASUREMENT
/begin MEASUREMENT Fid_CoEng_Nrml2Strt_mp "Fid für Übergang vom NORMAL zum START" UBYTE OneToOne 1 100 0.00 255.0 FORMAT "%5.1" ECU_ADDRESS 0x8FDD68 /end MEASUREMENT
/begin MEASUREMENT Fid_CoEng_PwrStgEnable_mp "Messpunkt fuer Funktions Identifier Fid_CoEng_PwrStgEnable" UBYTE OneToOne 1 100 0.00 255.0 FORMAT "%5.1" ECU_ADDRESS 0x8FDD69 /end MEASUREMENT
/begin MEASUREMENT Fid_CoEng_trqLimErr1_mp "Fid für die Aktivierung eines limitierten Moments bei fehlerhaften Raildruck" UBYTE OneToOne 1 100 0.00 255.0 FORMAT "%5.1" ECU_ADDRESS 0x8FDD6A /end MEASUREMENT
/begin MEASUREMENT Fid_CoEng_trqLimErr2_mp "Messpunkt fuer Funktions Identifier Fid_CoEng_trqLimErr2" UBYTE OneToOne 1 100 0.00 255.0 FORMAT "%5.1" ECU_ADDRESS 0x8FDD6B /end MEASUREMENT
/begin MEASUREMENT Fid_CoEng_trqLimErr3_mp "Messpunkt fuer Funktions Identifier Fid_CoEng_trqLimErr3" UBYTE OneToOne 1 100 0.00 255.0 FORMAT "%5.1" ECU_ADDRESS 0x8FDD6C /end MEASUREMENT
/begin MEASUREMENT Fid_CoEng_trqLimErr4_mp "Measurement point for Function Identifier Fid_CoEng_trqLimErr4" UBYTE OneToOne 1 100 0.00 255.0 FORMAT "%5.1" ECU_ADDRESS 0x8FDD6D /end MEASUREMENT
/begin MEASUREMENT Fid_CoEng_trqLimErr_mp "Fehler-begrenzender Moment" UBYTE OneToOne 1 100 0.00 255.0 FORMAT "%5.1" ECU_ADDRESS 0x8FDD6E /end MEASUREMENT
/begin MEASUREMENT Fid_CoVehtrqLimErr_mp "Fid zur Erkennung der Systemfehler, die auf dem Vortriebsmoment reagieren" UBYTE OneToOne 1 100 0.00 255.0 FORMAT "%5.1" ECU_ADDRESS 0x8FDD6F /end MEASUREMENT
/begin MEASUREMENT Fid_CoVM_StabDem_Err_mp "Messpunkt fuer Funktions Identifier Fid_CoVM_StabDem_Err" UBYTE OneToOne 1 100 0.00 255.0 FORMAT "%5.1" ECU_ADDRESS 0x8FDD70 /end MEASUREMENT
/begin MEASUREMENT Fid_CpBVlvOff_mp "Messpunkt fuer Funktions Identifier Fid_CpBVlvOff" UBYTE OneToOne 1 100 0.00 255.0 FORMAT "%5.1" ECU_ADDRESS 0x8FDD71 /end MEASUREMENT
/begin MEASUREMENT Fid_CrCtlShutOffIr_mp "die zu einer irreversiblen Fahrgeschwindigkeitsausschaltung führenden Fehlerpfade" UBYTE OneToOne 1 100 0.00 255.0 FORMAT "%5.1" ECU_ADDRESS 0x8FDD72 /end MEASUREMENT
/begin MEASUREMENT Fid_CrCtl_ASCTimeout_mp "Messpunkt fuer Funktions Identifier Fid_CrCtl_ASCTimeout" UBYTE OneToOne 1 100 0.00 255.0 FORMAT "%5.1" ECU_ADDRESS 0x8FDD73 /end MEASUREMENT
/begin MEASUREMENT Fid_CrCtl_CanDef_mp "Abschaltung CrCtl am Slave bei Fehler Privater CAN" UBYTE OneToOne 1 100 0.00 255.0 FORMAT "%5.1" ECU_ADDRESS 0x8FDD74 /end MEASUREMENT
/begin MEASUREMENT Fid_CrCtl_KombiTimeout_mp "lokale Größe" UBYTE OneToOne 1 100 0.00 255.0 FORMAT "%5.1" ECU_ADDRESS 0x8FDD75 /end MEASUREMENT
/begin MEASUREMENT Fid_CrCtl_vCrCtl_mp "Messpunkt fuer Funktions Identifier Fid_CrCtl_vCrCtl" UBYTE OneToOne 1 100 0.00 255.0 FORMAT "%5.1" ECU_ADDRESS 0x8FDD76 /end MEASUREMENT
/begin MEASUREMENT Fid_CTSCDFlTemp_mp "Messpunkt fuer Funktions Identifier Fid_CTSCDFlTemp" UBYTE OneToOne 1 100 0.00 255.0 FORMAT "%5.1" ECU_ADDRESS 0x8FDD77 /end MEASUREMENT
/begin MEASUREMENT Fid_CTSCD_Plaus_mp "Fid für OTS-CTS Plausibilitätsfehler im OTSCD Fehlerpfad" UBYTE OneToOne 1 100 0.00 255.0 FORMAT "%5.1" ECU_ADDRESS 0x8FDD78 /end MEASUREMENT
/begin MEASUREMENT Fid_DSM_Wuc_mp "Warm Up Cycle bei fehlerhafter Kühlmitteltemperatur deaktivieren" UBYTE OneToOne 1 100 0.00 255.0 FORMAT "%5.1" ECU_ADDRESS 0x8FDD79 /end MEASUREMENT
/begin MEASUREMENT Fid_EATSCDTSubs_mp "Messpunkt fuer Funktions Identifier Fid_EATSCDTSubs" UBYTE OneToOne 1 100 0.00 255.0 FORMAT "%5.1" ECU_ADDRESS 0x8FDD7A /end MEASUREMENT
/begin MEASUREMENT Fid_EBAFCD_mp "Messpunkt fuer Funktions Identifier Fid_EBAFCD" UBYTE OneToOne 1 100 0.00 255.0 FORMAT "%5.1" ECU_ADDRESS 0x8FDD7B /end MEASUREMENT
/begin MEASUREMENT Fid_EBFCD_mp "Messpunkt fuer Funktions Identifier Fid_EBFCD" UBYTE OneToOne 1 100 0.00 255.0 FORMAT "%5.1" ECU_ADDRESS 0x8FDD7C /end MEASUREMENT
/begin MEASUREMENT Fid_ECU_mp "Messpunkt fuer Funktions Identifier Fid_ECU" UBYTE OneToOne 1 100 0.00 255.0 FORMAT "%5.1" ECU_ADDRESS 0x8FDD7D /end MEASUREMENT
/begin MEASUREMENT Fid_EGSysCoLSU0_mp "Messpunkt für Function Identifier Fid_EGSysCoLSU0" UBYTE OneToOne 1 100 0.00 255.0 FORMAT "%5.1" ECU_ADDRESS 0x8FDD7E /end MEASUREMENT
/begin MEASUREMENT Fid_EGSysCoNSC_mp "Messpunkt für Function Identifier Fid_EGSysCoNSC" UBYTE OneToOne 1 100 0.00 255.0 FORMAT "%5.1" ECU_ADDRESS 0x8FDD7F /end MEASUREMENT
/begin MEASUREMENT Fid_EGSysCoOxi_mp "Messpunkt für Function Identifier Fid_EGSysCoOxi" UBYTE OneToOne 1 100 0.00 255.0 FORMAT "%5.1" ECU_ADDRESS 0x8FDD80 /end MEASUREMENT
/begin MEASUREMENT Fid_EGSysCoTrbn_mp "Messpunkt für Function Identifier Fid_EGSysCoTrbn" UBYTE OneToOne 1 100 0.00 255.0 FORMAT "%5.1" ECU_ADDRESS 0x8FDD81 /end MEASUREMENT
/begin MEASUREMENT Fid_EGSysCoTube0_mp "Messpunkt für Function Identifier Fid_EGSysCoTube0" UBYTE OneToOne 1 100 0.00 255.0 FORMAT "%5.1" ECU_ADDRESS 0x8FDD82 /end MEASUREMENT
/begin MEASUREMENT Fid_EGSysCoTube1_mp "Messpunkt für Function Identifier Fid_EGSysCoTube1" UBYTE OneToOne 1 100 0.00 255.0 FORMAT "%5.1" ECU_ADDRESS 0x8FDD83 /end MEASUREMENT
/begin MEASUREMENT Fid_EGSysHtgDel_mp "Messpunkt für Function Identifier Fid_EGSysHtgDel" UBYTE OneToOne 1 100 0.00 255.0 FORMAT "%5.1" ECU_ADDRESS 0x8FDD84 /end MEASUREMENT
/begin MEASUREMENT Fid_EGSysMaxTOxiPreB1_mp "" UBYTE OneToOne 1 100 0.00 255.0 FORMAT "%5.1" ECU_ADDRESS 0x8FDD85 /end MEASUREMENT
/begin MEASUREMENT Fid_EGSysMaxTOxiPreB2_mp "" UBYTE OneToOne 1 100 0.00 255.0 FORMAT "%5.1" ECU_ADDRESS 0x8FDD86 /end MEASUREMENT
/begin MEASUREMENT Fid_EGSysMaxTPreB1_mp "" UBYTE OneToOne 1 100 0.00 255.0 FORMAT "%5.1" ECU_ADDRESS 0x8FDD87 /end MEASUREMENT
/begin MEASUREMENT Fid_EGSysMaxTPreB2_mp "" UBYTE OneToOne 1 100 0.00 255.0 FORMAT "%5.1" ECU_ADDRESS 0x8FDD88 /end MEASUREMENT
/begin MEASUREMENT Fid_EGSysMaxTPreRgnB1_mp "" UBYTE OneToOne 1 100 0.00 255.0 FORMAT "%5.1" ECU_ADDRESS 0x8FDD89 /end MEASUREMENT
/begin MEASUREMENT Fid_EGSysMaxTPreRgnB2_mp "" UBYTE OneToOne 1 100 0.00 255.0 FORMAT "%5.1" ECU_ADDRESS 0x8FDD8A /end MEASUREMENT
/begin MEASUREMENT Fid_EGSysMxTOxiPreRgnB1_mp "" UBYTE OneToOne 1 100 0.00 255.0 FORMAT "%5.1" ECU_ADDRESS 0x8FDD8B /end MEASUREMENT
/begin MEASUREMENT Fid_EGSysMxTOxiPreRgnB2_mp "" UBYTE OneToOne 1 100 0.00 255.0 FORMAT "%5.1" ECU_ADDRESS 0x8FDD8C /end MEASUREMENT
/begin MEASUREMENT Fid_EGSysNSC_mp "Messpunkt für Function Identifier NSC" UBYTE OneToOne 1 100 0.00 255.0 FORMAT "%5.1" ECU_ADDRESS 0x8FDD8D /end MEASUREMENT
/begin MEASUREMENT Fid_EGSysOxiCat_mp "Messpunkt für Function Identifier OxiCat" UBYTE OneToOne 1 100 0.00 255.0 FORMAT "%5.1" ECU_ADDRESS 0x8FDD8E /end MEASUREMENT
/begin MEASUREMENT Fid_EGSysPresEnv_mp "Messpunkt für Function Identifier Fid_EGSysPresEnv" UBYTE OneToOne 1 100 0.00 255.0 FORMAT "%5.1" ECU_ADDRESS 0x8FDD8F /end MEASUREMENT
/begin MEASUREMENT Fid_EGSysStrt_mp "Messpunkt für Function Identifier Fid_EGSysStrt" UBYTE OneToOne 1 100 0.00 255.0 FORMAT "%5.1" ECU_ADDRESS 0x8FDD90 /end MEASUREMENT
/begin MEASUREMENT Fid_EGSysTemp_mp "Messpunkt für Function Identifier Fid_EGSysTemp" UBYTE OneToOne 1 100 0.00 255.0 FORMAT "%5.1" ECU_ADDRESS 0x8FDD91 /end MEASUREMENT
/begin MEASUREMENT Fid_EGSysTrbn_mp "Messpunkt für Function Identifier Fid_EGSysTrbn" UBYTE OneToOne 1 100 0.00 255.0 FORMAT "%5.1" ECU_ADDRESS 0x8FDD92 /end MEASUREMENT
/begin MEASUREMENT Fid_EGSysTube_mp "Messpunkt für Function Identifier Tube" UBYTE OneToOne 1 100 0.00 255.0 FORMAT "%5.1" ECU_ADDRESS 0x8FDD93 /end MEASUREMENT
/begin MEASUREMENT Fid_EGSys_AP_mp "Fehler des Atmosphärendruckfühlers" UBYTE OneToOne 1 100 0.00 255.0 FORMAT "%5.1" ECU_ADDRESS 0x8FDD94 /end MEASUREMENT
/begin MEASUREMENT Fid_EGTRgnLck_mp "Function indentifier zur Verriegelung einer Regeneration bei Überschreiten der kritischen Ölverdünnungszeit" UBYTE OneToOne 1 100 0.00 255.0 FORMAT "%5.1" ECU_ADDRESS 0x8FDD95 /end MEASUREMENT
/begin MEASUREMENT Fid_EGTTempGvnrAirCtl_mp "Fehler Erkennung für dauernde Regelabweichung des Luftmassenreglers" UBYTE OneToOne 1 100 0.00 255.0 FORMAT "%5.1" ECU_ADDRESS 0x8FDD96 /end MEASUREMENT
/begin MEASUREMENT Fid_EGTTempGvnrInrB1_mp "Function Identifier für Temperatur des inneren Regelkreises Bank 1" UBYTE OneToOne 1 100 0.00 255.0 FORMAT "%5.1" ECU_ADDRESS 0x8FDD97 /end MEASUREMENT
/begin MEASUREMENT Fid_EGTTempGvnrInrB2_mp "Function Identifier für Temperatur des inneren Regelkreises Bank 2" UBYTE OneToOne 1 100 0.00 255.0 FORMAT "%5.1" ECU_ADDRESS 0x8FDD98 /end MEASUREMENT
/begin MEASUREMENT Fid_EGTTempGvnrOutrB1_mp "Function Identifier für Temperatur des äußeren Regelkreises Bank 1" UBYTE OneToOne 1 100 0.00 255.0 FORMAT "%5.1" ECU_ADDRESS 0x8FDD99 /end MEASUREMENT
/begin MEASUREMENT Fid_EGTTempGvnrOutrB2_mp "Function Identifier für Temperatur des äußeren Regelkreises Bank 2" UBYTE OneToOne 1 100 0.00 255.0 FORMAT "%5.1" ECU_ADDRESS 0x8FDD9A /end MEASUREMENT
/begin MEASUREMENT Fid_EngCTSCD_mp "Messpunkt fuer Funktions Identifier Fid_EngCTSCD" UBYTE OneToOne 1 100 0.00 255.0 FORMAT "%5.1" ECU_ADDRESS 0x8FDD9B /end MEASUREMENT
/begin MEASUREMENT Fid_EngMCaS1_mp "Fid Definition zur Vermeidung der Nockenwellendiagnose beim Versorgungsfehler" UBYTE OneToOne 1 100 0.00 255.0 FORMAT "%5.1" ECU_ADDRESS 0x8FDD9C /end MEASUREMENT
/begin MEASUREMENT Fid_EngMCaSBackUp_mp "Wechsel ins Notfahren erfolgt bei gültigem Nockenwellensignal" UBYTE OneToOne 1 100 0.00 255.0 FORMAT "%5.1" ECU_ADDRESS 0x8FDD9D /end MEASUREMENT
/begin MEASUREMENT Fid_EngMCrS1_mp "Fid Definition zur Vermeidung der Kurbelwellendiagnose beim Versorgungsfehler" UBYTE OneToOne 1 100 0.00 255.0 FORMAT "%5.1" ECU_ADDRESS 0x8FDD9E /end MEASUREMENT
/begin MEASUREMENT Fid_EngMCrSBackUp_mp "Wenn EngM_stBackUpVar_C=1,dann nur wenn der Dfp_EngMCrS1 einen Fehler meldet,wird (über diese Fid) in den BackUp mode gewechselt" UBYTE OneToOne 1 100 0.00 255.0 FORMAT "%5.1" ECU_ADDRESS 0x8FDD9F /end MEASUREMENT
/begin MEASUREMENT Fid_EngMTEng_mp "Fid for EngM_EngMntCtl subsystem" UBYTE OneToOne 1 100 0.00 255.0 FORMAT "%5.1" ECU_ADDRESS 0x8FDDA0 /end MEASUREMENT
/begin MEASUREMENT Fid_EngMTrqFrcPDiff_mp "Messpunkt für Function Identifier" UBYTE OneToOne 1 100 0.00 255.0 FORMAT "%5.1" ECU_ADDRESS 0x8FDDA1 /end MEASUREMENT
/begin MEASUREMENT Fid_EngMVVeh_mp "Fid for EngM_EngMntCtl subsystem" UBYTE OneToOne 1 100 0.00 255.0 FORMAT "%5.1" ECU_ADDRESS 0x8FDDA2 /end MEASUREMENT
/begin MEASUREMENT Fid_EngM_ChkStrtSpd_mp "Fid für Anfang nur mit Kurbelwellen-System" UBYTE OneToOne 1 100 0.00 255.0 FORMAT "%5.1" ECU_ADDRESS 0x8FDDA3 /end MEASUREMENT
/begin MEASUREMENT Fid_EngPrt_nLimErr_mp "Messpunkt für Funktions Identifier bei zusätzlicher Drezahlbegrenzung im Systemfehlerfall" UBYTE OneToOne 1 100 0.00 255.0 FORMAT "%5.1" ECU_ADDRESS 0x8FDDA4 /end MEASUREMENT
/begin MEASUREMENT Fid_ETClbCorActv_mp "FID zur Deaktivierung der ETClb ET Korrektur" UBYTE OneToOne 1 100 0.00 255.0 FORMAT "%5.1" ECU_ADDRESS 0x8FDDA5 /end MEASUREMENT
/begin MEASUREMENT Fid_FanCtl_mp "Fehler-Identifier für Wassertemperatur-Sensorfehler" UBYTE OneToOne 1 100 0.00 255.0 FORMAT "%5.1" ECU_ADDRESS 0x8FDDA6 /end MEASUREMENT
/begin MEASUREMENT Fid_FanGbxOil_mp "fault identifier for Gear box oil temperature" UBYTE OneToOne 1 100 0.00 255.0 FORMAT "%5.1" ECU_ADDRESS 0x8FDDA7 /end MEASUREMENT
/begin MEASUREMENT Fid_FBCMonI_mp "Messpunkt fuer Funktions Identifier Fid_FBCMonI" UBYTE OneToOne 1 100 0.00 255.0 FORMAT "%5.1" ECU_ADDRESS 0x8FDDA8 /end MEASUREMENT
/begin MEASUREMENT Fid_FBC_mp "FID zur Aktivierung der Mengenausgleichsregelung" UBYTE OneToOne 1 100 0.00 255.0 FORMAT "%5.1" ECU_ADDRESS 0x8FDDA9 /end MEASUREMENT
/begin MEASUREMENT Fid_FlMngFullLdRglOff_mp "Messpunkt fuer Funktions Identifier Fid_FlMngFullLdRglOff" UBYTE OneToOne 1 100 0.00 255.0 FORMAT "%5.1" ECU_ADDRESS 0x8FDDAA /end MEASUREMENT
/begin MEASUREMENT Fid_FlMngSmkDefect_mp "Messpunkt fuer Funktions Identifier Fid_FlMngSmkDefect" UBYTE OneToOne 1 100 0.00 255.0 FORMAT "%5.1" ECU_ADDRESS 0x8FDDAB /end MEASUREMENT
/begin MEASUREMENT Fid_FlMngTPFltErr_mp "Umschaltung auf Defektkennfeld" UBYTE OneToOne 1 100 0.00 255.0 FORMAT "%5.1" ECU_ADDRESS 0x8FDDAC /end MEASUREMENT
/begin MEASUREMENT Fid_FlSysCTSSens_mp "Fid zur Deaktivierung der Verwendung der Wassertemperatur als Kraftstoffsystemtemperatur" UBYTE OneToOne 1 100 0.00 255.0 FORMAT "%5.1" ECU_ADDRESS 0x8FDDAD /end MEASUREMENT
/begin MEASUREMENT Fid_FlSysDens_mp "Verriegelung der Sensorerfassung für die Kraftstofftemperatur" UBYTE OneToOne 1 100 0.00 255.0 FORMAT "%5.1" ECU_ADDRESS 0x8FDDAE /end MEASUREMENT
/begin MEASUREMENT Fid_FlSysFTSSens_mp "Fid zur Deaktivierung der Verwendung der Kraftstofftemperatur als Kraftstoffsystemtemperatur" UBYTE OneToOne 1 100 0.00 255.0 FORMAT "%5.1" ECU_ADDRESS 0x8FDDAF /end MEASUREMENT
/begin MEASUREMENT Fid_FMASwtOff1_mp "Meßpunkt für FMA-Abschaltung bei leichten Systemfehlern (Abschaltmöglichkeit 1)" UBYTE OneToOne 1 100 0.00 255.0 FORMAT "%5.1" ECU_ADDRESS 0x8FDDB0 /end MEASUREMENT
/begin MEASUREMENT Fid_FMASwtOff2_mp "Fid um Abschaltbedingung 2 wegen Systemfehler zu realisieren" UBYTE OneToOne 1 100 0.00 255.0 FORMAT "%5.1" ECU_ADDRESS 0x8FDDB1 /end MEASUREMENT
/begin MEASUREMENT Fid_FMASwtOff3_mp "Meßpunkt für FMA-Abschaltung bei schweren Systemfehlern (Abschaltmöglichkeit 3)" UBYTE OneToOne 1 100 0.00 255.0 FORMAT "%5.1" ECU_ADDRESS 0x8FDDB2 /end MEASUREMENT
/begin MEASUREMENT Fid_FMTC_AirCorr_mp "Veriegelung der Eta-Korrektur für Luftmasse pro Zylinder" UBYTE OneToOne 1 100 0.00 255.0 FORMAT "%5.1" ECU_ADDRESS 0x8FDDB3 /end MEASUREMENT
/begin MEASUREMENT Fid_FMTC_PCRCorr_mp "Messpunkt fuer Funktions Identifier Fid_FMTC_PCRCorr" UBYTE OneToOne 1 100 0.00 255.0 FORMAT "%5.1" ECU_ADDRESS 0x8FDDB4 /end MEASUREMENT
/begin MEASUREMENT Fid_FMTC_SOECorr_mp "Veriegelung der Eta-Korrektur für den Spritzbeginn" UBYTE OneToOne 1 100 0.00 255.0 FORMAT "%5.1" ECU_ADDRESS 0x8FDDB5 /end MEASUREMENT
/begin MEASUREMENT Fid_FrmMngAddLevl_mp "Messpunkt fuer Funktions Identifier Fid_FrmMngAddLevl" UBYTE OneToOne 1 100 0.00 255.0 FORMAT "%5.1" ECU_ADDRESS 0x8FDDB6 /end MEASUREMENT
/begin MEASUREMENT Fid_FrmMngAOHt_mp "" UBYTE OneToOne 1 100 0.00 255.0 FORMAT "%5.1" ECU_ADDRESS 0x8FDDB7 /end MEASUREMENT
/begin MEASUREMENT Fid_FrmMngAPP_mp "Messpunkt fuer Funktions Identifier Fid_FrmMngAPP" UBYTE OneToOne 1 100 0.00 255.0 FORMAT "%5.1" ECU_ADDRESS 0x8FDDB8 /end MEASUREMENT
/begin MEASUREMENT Fid_FrmMngARS_mp "Messpunkt fuer Funktions Identifier Fid_FrmMngARS" UBYTE OneToOne 1 100 0.00 255.0 FORMAT "%5.1" ECU_ADDRESS 0x8FDDB9 /end MEASUREMENT
/begin MEASUREMENT Fid_FrmMngBrkDef_mp "Messpunkt fuer Funktions Identifier Fid_FrmMngBrkDef" UBYTE OneToOne 1 100 0.00 255.0 FORMAT "%5.1" ECU_ADDRESS 0x8FDDBA /end MEASUREMENT
/begin MEASUREMENT Fid_FrmMngBrk_mp "Messpunkt fuer Funktions Identifier Fid_FrmMngBrk" UBYTE OneToOne 1 100 0.00 255.0 FORMAT "%5.1" ECU_ADDRESS 0x8FDDBB /end MEASUREMENT
/begin MEASUREMENT Fid_FrmMngCoEng_mp "Messpunkt fuer Funktions Identifier Fid_FrmMngCoEng" UBYTE OneToOne 1 100 0.00 255.0 FORMAT "%5.1" ECU_ADDRESS 0x8FDDBC /end MEASUREMENT
/begin MEASUREMENT Fid_FrmMngCoEng_St2_mp "Messpunkt fuer Funktions Identifier Fid_FrmMngCoEng_St2" UBYTE OneToOne 1 100 0.00 255.0 FORMAT "%5.1" ECU_ADDRESS 0x8FDDBD /end MEASUREMENT
/begin MEASUREMENT Fid_FrmMngConvDef_mp "Messpunkt fuer Funktions Identifier Fid_FrmMngConvDef" UBYTE OneToOne 1 100 0.00 255.0 FORMAT "%5.1" ECU_ADDRESS 0x8FDDBE /end MEASUREMENT
/begin MEASUREMENT Fid_FrmMngEngOvrSpd_mp "Messpunkt fuer Funktions Identifier Fid_FrmMngEngOvrSpd" UBYTE OneToOne 1 100 0.00 255.0 FORMAT "%5.1" ECU_ADDRESS 0x8FDDBF /end MEASUREMENT
/begin MEASUREMENT Fid_FrmMngEngRpmTemp_mp "Messpunkt für Funktions Identifier Fid_FrmMngEngRpmTemp" UBYTE OneToOne 1 100 0.00 255.0 FORMAT "%5.1" ECU_ADDRESS 0x8FDDC0 /end MEASUREMENT
/begin MEASUREMENT Fid_FrmMngEngSpd_mp "Messpunkt fuer Funktions Identifier Fid_FrmMngEngSpd" UBYTE OneToOne 1 100 0.00 255.0 FORMAT "%5.1" ECU_ADDRESS 0x8FDDC1 /end MEASUREMENT
/begin MEASUREMENT Fid_FrmMngInjDU1_mp "Messpunkt fuer Funktions Identifier Fid_FrmMngInjDU1" UBYTE OneToOne 1 100 0.00 255.0 FORMAT "%5.1" ECU_ADDRESS 0x8FDDC2 /end MEASUREMENT
/begin MEASUREMENT Fid_FrmMngInjDU2_mp "Messpunkt fuer Funktions Identifier Fid_FrmMngInjDU2" UBYTE OneToOne 1 100 0.00 255.0 FORMAT "%5.1" ECU_ADDRESS 0x8FDDC3 /end MEASUREMENT
/begin MEASUREMENT Fid_FrmMngInjVlv_mp "Messpunkt fuer Funktions Identifier Fid_FrmMngInjVlv" UBYTE OneToOne 1 100 0.00 255.0 FORMAT "%5.1" ECU_ADDRESS 0x8FDDC4 /end MEASUREMENT
/begin MEASUREMENT Fid_FrmMngnSetpoint_mp "Messpunkt fuer Funktions Identifier Fid_FrmMngnSetpoint" UBYTE OneToOne 1 100 0.00 255.0 FORMAT "%5.1" ECU_ADDRESS 0x8FDDC5 /end MEASUREMENT
/begin MEASUREMENT Fid_FrmMngOBDCtl_mp "Messpunkt fuer Funktions Identifier Fid_FrmMngOBDCtl" UBYTE OneToOne 1 100 0.00 255.0 FORMAT "%5.1" ECU_ADDRESS 0x8FDDC6 /end MEASUREMENT
/begin MEASUREMENT Fid_FrmMngParkConsumer_mp "Messpunkt fuer Funktions Identifier Fid_FrmMngParkConsumer" UBYTE OneToOne 1 100 0.00 255.0 FORMAT "%5.1" ECU_ADDRESS 0x8FDDC7 /end MEASUREMENT
/begin MEASUREMENT Fid_FrmMngPFltDef_mp "Messpunkt fuer Funktions Identifier Fid_FrmMngPFltDef" UBYTE OneToOne 1 100 0.00 255.0 FORMAT "%5.1" ECU_ADDRESS 0x8FDDC8 /end MEASUREMENT
/begin MEASUREMENT Fid_FrmMngPla_DSC_mp "Fid für FrmMng-Plaus DSC" UBYTE OneToOne 1 100 0.00 255.0 FORMAT "%5.1" ECU_ADDRESS 0x8FDDC9 /end MEASUREMENT
/begin MEASUREMENT Fid_FrmMngPla_EGS_mp "Fid für FrmMng-Plaus EGS" UBYTE OneToOne 1 100 0.00 255.0 FORMAT "%5.1" ECU_ADDRESS 0x8FDDCA /end MEASUREMENT
/begin MEASUREMENT Fid_FrmMngPowerTrainCAN_mp "Messpunkt fuer Funktions Identifier Fid_FrmMngPowerTrainCAN" UBYTE OneToOne 1 100 0.00 255.0 FORMAT "%5.1" ECU_ADDRESS 0x8FDDCB /end MEASUREMENT
/begin MEASUREMENT Fid_FrmMngPrvCan_mp "" UBYTE OneToOne 1 100 0.00 255.0 FORMAT "%5.1" ECU_ADDRESS 0x8FDDCC /end MEASUREMENT
/begin MEASUREMENT Fid_FrmMngpVal_mp "Messpunkt fuer Funktions Identifier Fid_FrmMngpVal" UBYTE OneToOne 1 100 0.00 255.0 FORMAT "%5.1" ECU_ADDRESS 0x8FDDCD /end MEASUREMENT
/begin MEASUREMENT Fid_FrmMngPwrMngLIGovSt_mp "Messpunkt fuer Funktions Identifier Fid_FrmMngPwrMngLIGovSt" UBYTE OneToOne 1 100 0.00 255.0 FORMAT "%5.1" ECU_ADDRESS 0x8FDDCE /end MEASUREMENT
/begin MEASUREMENT Fid_FrmMngRpmRduc_mp "Fid für Momentenbegrenzung durch PFlt" UBYTE OneToOne 1 100 0.00 255.0 FORMAT "%5.1" ECU_ADDRESS 0x8FDDCF /end MEASUREMENT
/begin MEASUREMENT Fid_FrmMngSIG_ARS_mp "Messpunkt fuer Funktions Identifier Fid_FrmMngSIG_ARS" UBYTE OneToOne 1 100 0.00 255.0 FORMAT "%5.1" ECU_ADDRESS 0x8FDDD0 /end MEASUREMENT
/begin MEASUREMENT Fid_FrmMngSIG_DSC_mp "Messpunkt fuer Funktions Identifier Fid_FrmMngSIG_DSC" UBYTE OneToOne 1 100 0.00 255.0 FORMAT "%5.1" ECU_ADDRESS 0x8FDDD1 /end MEASUREMENT
/begin MEASUREMENT Fid_FrmMngSig_EGS_mp "Messpunkt fuer Funktions Identifier Fid_FrmMngSIG_EGS" UBYTE OneToOne 1 100 0.00 255.0 FORMAT "%5.1" ECU_ADDRESS 0x8FDDD2 /end MEASUREMENT
/begin MEASUREMENT Fid_FrmMngtEng_mp "Messpunkt fuer Funktions Identifier Fid_FrmMngtEng" UBYTE OneToOne 1 100 0.00 255.0 FORMAT "%5.1" ECU_ADDRESS 0x8FDDD3 /end MEASUREMENT
/begin MEASUREMENT Fid_FrmMngTO_ARS_mp "Messpunkt fuer Funktions Identifier Fid_FrmMngTO_ARS" UBYTE OneToOne 1 100 0.00 255.0 FORMAT "%5.1" ECU_ADDRESS 0x8FDDD4 /end MEASUREMENT
/begin MEASUREMENT Fid_FrmMngTO_DSC_mp "Messpunkt fuer Funktions Identifier Fid_FrmMngTO_DSC" UBYTE OneToOne 1 100 0.00 255.0 FORMAT "%5.1" ECU_ADDRESS 0x8FDDD5 /end MEASUREMENT
/begin MEASUREMENT Fid_FrmMngTo_EGS_mp "Messpunkt fuer Funktions Identifier Fid_FrmMngTO_EGS" UBYTE OneToOne 1 100 0.00 255.0 FORMAT "%5.1" ECU_ADDRESS 0x8FDDD6 /end MEASUREMENT
/begin MEASUREMENT Fid_FrmMngTrqGearbx_mp "Messpunkt fuer Funktions Identifier Fid_FrmMngTrqGearbx" UBYTE OneToOne 1 100 0.00 255.0 FORMAT "%5.1" ECU_ADDRESS 0x8FDDD7 /end MEASUREMENT
/begin MEASUREMENT Fid_FrmMngWaterVlv_mp "Fid for heating current defect" UBYTE OneToOne 1 100 0.00 255.0 FORMAT "%5.1" ECU_ADDRESS 0x8FDDD8 /end MEASUREMENT
/begin MEASUREMENT Fid_FrmMng_stTrq_mp "Messpunkt fuer Funktions Identifier Fid_FrmMng_stTrq_mp" UBYTE OneToOne 1 100 0.00 255.0 FORMAT "%5.1" ECU_ADDRESS 0x8FDDD9 /end MEASUREMENT
/begin MEASUREMENT Fid_FrmMng_ST_TORQ_mp "Messpunkt fuer Funktions Identifier Fid_FrmMng_ST_TORQ" UBYTE OneToOne 1 100 0.00 255.0 FORMAT "%5.1" ECU_ADDRESS 0x8FDDDA /end MEASUREMENT
/begin MEASUREMENT Fid_FTSCDErr_mp "Messpunkt fuer Funktions Identifier Fid_FTSCDErr" UBYTE OneToOne 1 100 0.00 255.0 FORMAT "%5.1" ECU_ADDRESS 0x8FDDDB /end MEASUREMENT
/begin MEASUREMENT Fid_GearbxDrvAwayInactv_mp "" UBYTE OneToOne 1 100 0.00 255.0 FORMAT "%5.1" ECU_ADDRESS 0x8FDDDC /end MEASUREMENT
/begin MEASUREMENT Fid_GearbxDrvAway_mp "Fid zur Aktivierung der Anfahrmomentbegrenzung" UBYTE OneToOne 1 100 0.00 255.0 FORMAT "%5.1" ECU_ADDRESS 0x8FDDDD /end MEASUREMENT
/begin MEASUREMENT Fid_GearbxNmin_mp "Fid zu Abschaltung erhöhter Leerlaufdrehzahl während Wandlerkupplung im modus geregelt" UBYTE OneToOne 1 100 0.00 255.0 FORMAT "%5.1" ECU_ADDRESS 0x8FDDDE /end MEASUREMENT
/begin MEASUREMENT Fid_GearbxPtCANErr_mp "Messpunkt fuer Funktions Identifier Fid_GearbxPtCANErr" UBYTE OneToOne 1 100 0.00 255.0 FORMAT "%5.1" ECU_ADDRESS 0x8FDDDF /end MEASUREMENT
/begin MEASUREMENT Fid_GearbxSlip_mp "Messpunkt fuer Funktions Identifier Fid_GearbxSlip" UBYTE OneToOne 1 100 0.00 255.0 FORMAT "%5.1" ECU_ADDRESS 0x8FDDE0 /end MEASUREMENT
/begin MEASUREMENT Fid_GearbxTrqLimErr_mp "Messpunkt fuer Funktions Identifier Fid_GearbxTrqLimErr" UBYTE OneToOne 1 100 0.00 255.0 FORMAT "%5.1" ECU_ADDRESS 0x8FDDE1 /end MEASUREMENT
/begin MEASUREMENT Fid_Gearbx_GearDet_mp "Fid für Gangerkennung" UBYTE OneToOne 1 100 0.00 255.0 FORMAT "%5.1" ECU_ADDRESS 0x8FDDE2 /end MEASUREMENT
/begin MEASUREMENT Fid_Gearbx_TrqIntv_Err_mp "Messpunkt fuer Funktions Identifier Fid_Gearbx_TrqIntv_Err" UBYTE OneToOne 1 100 0.00 255.0 FORMAT "%5.1" ECU_ADDRESS 0x8FDDE3 /end MEASUREMENT
/begin MEASUREMENT Fid_GlwCtl1_mp "Verwendung der Ersatztemperatur anstelle der Motortemperatur zur Berechnung der Motortemperatur für das Glühen." UBYTE OneToOne 1 100 0.00 255.0 FORMAT "%5.1" ECU_ADDRESS 0x8FDDE4 /end MEASUREMENT
/begin MEASUREMENT Fid_GlwCtl2_mp "Freigabe für den Übergang in den Glühsystemzustand ""Nachlauf aktiv""" UBYTE OneToOne 1 100 0.00 255.0 FORMAT "%5.1" ECU_ADDRESS 0x8FDDE5 /end MEASUREMENT
/begin MEASUREMENT Fid_GlwCtl3_mp "Fid zur Verriegelung des Glühens" UBYTE OneToOne 1 100 0.00 255.0 FORMAT "%5.1" ECU_ADDRESS 0x8FDDE6 /end MEASUREMENT
/begin MEASUREMENT Fid_HDC_mp "Messpunkt fuer Funktions Identifier Fid_HDC" UBYTE OneToOne 1 100 0.00 255.0 FORMAT "%5.1" ECU_ADDRESS 0x8FDDE7 /end MEASUREMENT
/begin MEASUREMENT Fid_IATSCD_mp "FID zur Sperrung der Ersatzwertberechnung beim EATS-Fehler" UBYTE OneToOne 1 100 0.00 255.0 FORMAT "%5.1" ECU_ADDRESS 0x8FDDE8 /end MEASUREMENT
/begin MEASUREMENT Fid_IATSCD_tAir1_mp "Messpunkt fuer Funktions Identifier Fid_IATSCD_tAir1" UBYTE OneToOne 1 100 0.00 255.0 FORMAT "%5.1" ECU_ADDRESS 0x8FDDE9 /end MEASUREMENT
/begin MEASUREMENT Fid_IATSCD_tAir2_mp "Messpunkt fuer Funktions Identifier Fid_IATSCD_tAir2" UBYTE OneToOne 1 100 0.00 255.0 FORMAT "%5.1" ECU_ADDRESS 0x8FDDEA /end MEASUREMENT
/begin MEASUREMENT Fid_IndSys1_mp "Messpunkt fuer Funktions Identifier Fid_IndSys1" UBYTE OneToOne 1 100 0.00 255.0 FORMAT "%5.1" ECU_ADDRESS 0x8FDDEB /end MEASUREMENT
/begin MEASUREMENT Fid_IndSys2_mp "Messpunkt fuer Funktions Identifier Fid_IndSys2" UBYTE OneToOne 1 100 0.00 255.0 FORMAT "%5.1" ECU_ADDRESS 0x8FDDEC /end MEASUREMENT
/begin MEASUREMENT Fid_InjCrvCoErr_mp "FID für ausgeschaltete Voreinspritzung" UBYTE OneToOne 1 100 0.00 255.0 FORMAT "%5.1" ECU_ADDRESS 0x8FDDED /end MEASUREMENT
/begin MEASUREMENT Fid_InjCrvCylOffs_mp "Fid zur Anzeige von defektem Wassertemperatursensor" UBYTE OneToOne 1 100 0.00 255.0 FORMAT "%5.1" ECU_ADDRESS 0x8FDDEE /end MEASUREMENT
/begin MEASUREMENT Fid_InjCtl_qLimErr_mp "Aktivierung der Mengenbegrenzung wegen Systemfehler" UBYTE OneToOne 1 100 0.00 255.0 FORMAT "%5.1" ECU_ADDRESS 0x8FDDEF /end MEASUREMENT
/begin MEASUREMENT Fid_InjVCDActrEnrgTemp_mp "Verwendung des Aktortemperatur-Ersatzwertes" UBYTE OneToOne 1 100 0.00 255.0 FORMAT "%5.1" ECU_ADDRESS 0x8FDDF0 /end MEASUREMENT
/begin MEASUREMENT Fid_InjVCDCls_mp "Fid zur Deaktivierung der Ableitwiderstand-Diagnose" UBYTE OneToOne 1 100 0.00 255.0 FORMAT "%5.1" ECU_ADDRESS 0x8FDDF1 /end MEASUREMENT
/begin MEASUREMENT Fid_InjVCDTPUErr_mp "Fid für Verriegelung des TPU-Fehlers bei KS am Injektor" UBYTE OneToOne 1 100 0.00 255.0 FORMAT "%5.1" ECU_ADDRESS 0x8FDDF2 /end MEASUREMENT
/begin MEASUREMENT Fid_InjVlvActrTemp_mp "Verwendung des Aktortemperatur-Ersatzwertes für die Spannungssollwert-Berechnung" UBYTE OneToOne 1 100 0.00 255.0 FORMAT "%5.1" ECU_ADDRESS 0x8FDDF3 /end MEASUREMENT
/begin MEASUREMENT Fid_InjVlvInjLim_mp "Limitierung auf eine Einspritzung" UBYTE OneToOne 1 100 0.00 255.0 FORMAT "%5.1" ECU_ADDRESS 0x8FDDF4 /end MEASUREMENT
/begin MEASUREMENT Fid_InjVlvMon_mp "Fid zur Deaktivierung der Injektordiagnose" UBYTE OneToOne 1 100 0.00 255.0 FORMAT "%5.1" ECU_ADDRESS 0x8FDDF5 /end MEASUREMENT
/begin MEASUREMENT Fid_InjVlvNVC_mp "Fid zu Deaktivierung der NVC" UBYTE OneToOne 1 100 0.00 255.0 FORMAT "%5.1" ECU_ADDRESS 0x8FDDF6 /end MEASUREMENT
/begin MEASUREMENT Fid_InjVlvSetUpVolt_mp "Verwendung des Raildruck-Ersatzwertes für die Spannungssollwert-Berechnung" UBYTE OneToOne 1 100 0.00 255.0 FORMAT "%5.1" ECU_ADDRESS 0x8FDDF7 /end MEASUREMENT
/begin MEASUREMENT Fid_InjVlvWvCorOff_mp "Fid der Druckwellenkorrektur" UBYTE OneToOne 1 100 0.00 255.0 FORMAT "%5.1" ECU_ADDRESS 0x8FDDF8 /end MEASUREMENT
/begin MEASUREMENT Fid_Layer_FI_TANS_mp "Messpunkt fuer Funktions Identifier Fid_Layer_FI_TANS" UBYTE OneToOne 1 100 0.00 255.0 FORMAT "%5.1" ECU_ADDRESS 0x8FDDF9 /end MEASUREMENT
/begin MEASUREMENT Fid_Layer_FI_TUMG_mp "Messpunkt fuer Funktions Identifier Fid_Layer_FI_TUMG" UBYTE OneToOne 1 100 0.00 255.0 FORMAT "%5.1" ECU_ADDRESS 0x8FDDFA /end MEASUREMENT
/begin MEASUREMENT Fid_Layer_MANHYDR_mp "Messpunkt fuer Funktions Identifier Fid_Layer_MANHYDR" UBYTE OneToOne 1 100 0.00 255.0 FORMAT "%5.1" ECU_ADDRESS 0x8FDDFB /end MEASUREMENT
/begin MEASUREMENT Fid_Layer_MANLUFT_mp "Messpunkt fuer Funktions Identifier Fid_Layer_MANLUFT" UBYTE OneToOne 1 100 0.00 255.0 FORMAT "%5.1" ECU_ADDRESS 0x8FDDFC /end MEASUREMENT
/begin MEASUREMENT Fid_LIGovSetpointDrvAwy_mp "Messpunkt fuer Funktions Identifier Fid_LIGovSetpointDrvAwy" UBYTE OneToOne 1 100 0.00 255.0 FORMAT "%5.1" ECU_ADDRESS 0x8FDDFD /end MEASUREMENT
/begin MEASUREMENT Fid_LIGovUbr_mp "FID zur Deaktivierung der Funkionalität Unterbremsen" UBYTE OneToOne 1 100 0.00 255.0 FORMAT "%5.1" ECU_ADDRESS 0x8FDDFE /end MEASUREMENT
/begin MEASUREMENT Fid_LSUCDactiv0_mp "Messpunkt fuer Funktions Identifier Fid_LSUCDactiv0" UBYTE OneToOne 1 100 0.00 255.0 FORMAT "%5.1" ECU_ADDRESS 0x8FDDFF /end MEASUREMENT
/begin MEASUREMENT Fid_LSUCDlsu0_mp "Messpunkt fuer Funktions Identifier Fid_LSUCDlsu0" UBYTE OneToOne 1 100 0.00 255.0 FORMAT "%5.1" ECU_ADDRESS 0x8FDE00 /end MEASUREMENT
/begin MEASUREMENT Fid_LSUCDMon0_mp "Messpunkt fuer Funktions Identifier Fid_LSUCDMon0" UBYTE OneToOne 1 100 0.00 255.0 FORMAT "%5.1" ECU_ADDRESS 0x8FDE01 /end MEASUREMENT
/begin MEASUREMENT Fid_LSUCDO20_mp "Messpunkt fuer Funktions Identifier Fid_LSUCDO20" UBYTE OneToOne 1 100 0.00 255.0 FORMAT "%5.1" ECU_ADDRESS 0x8FDE02 /end MEASUREMENT
/begin MEASUREMENT Fid_LSUCDRi0_mp "Messpunkt fuer Funktions Identifier Fid_LSUCDRi0" UBYTE OneToOne 1 100 0.00 255.0 FORMAT "%5.1" ECU_ADDRESS 0x8FDE03 /end MEASUREMENT
/begin MEASUREMENT Fid_LSUClbSched_mp "Fid zur Unterdrückung der CJ125-Kalibrierung im Falle einer defekten Batterie" UBYTE OneToOne 1 100 0.00 255.0 FORMAT "%5.1" ECU_ADDRESS 0x8FDE04 /end MEASUREMENT
/begin MEASUREMENT Fid_LSUCtl0_mp "Messpunkt fuer Funktions Identifier Fid_LSUCtl0" UBYTE OneToOne 1 100 0.00 255.0 FORMAT "%5.1" ECU_ADDRESS 0x8FDE05 /end MEASUREMENT
/begin MEASUREMENT Fid_LSUMonAllChecks_mp "Messpunkt fuer Funktions Identifier Fid_LSUMonAllChecks" UBYTE OneToOne 1 100 0.00 255.0 FORMAT "%5.1" ECU_ADDRESS 0x8FDE06 /end MEASUREMENT
/begin MEASUREMENT Fid_LSUMonPlausChk_mp "Messpunkt fuer Funktions Identifier Fid_LSUMonPlausChk" UBYTE OneToOne 1 100 0.00 255.0 FORMAT "%5.1" ECU_ADDRESS 0x8FDE07 /end MEASUREMENT
/begin MEASUREMENT Fid_MeUnCDCalcI_mp "Fehleridentifier um den I-Anteil des Stromreglers für die Zumesseinheit einzufrieren" UBYTE OneToOne 1 100 0.00 255.0 FORMAT "%5.1" ECU_ADDRESS 0x8FDE08 /end MEASUREMENT
/begin MEASUREMENT Fid_Mil_mp "Fid für den Fehlerpfad Dfp_Mil" UBYTE OneToOne 1 100 0.00 255.0 FORMAT "%5.1" ECU_ADDRESS 0x8FDE09 /end MEASUREMENT
/begin MEASUREMENT Fid_MSCDPrivCan_mp "Messpunkt fuer Funktions Identifier Fid_MSCDPrivCan" UBYTE OneToOne 1 100 0.00 255.0 FORMAT "%5.1" ECU_ADDRESS 0x8FDE0A /end MEASUREMENT
/begin MEASUREMENT Fid_MSidCD_ECU_mp "Messpunkt fuer Funktions Identifier Fid_MSidCD_ECU" UBYTE OneToOne 1 100 0.00 255.0 FORMAT "%5.1" ECU_ADDRESS 0x8FDE0B /end MEASUREMENT
/begin MEASUREMENT Fid_MSidCD_Pin_mp "Messpunkt fuer Funktions Identifier Fid_MSidCD_Pin" UBYTE OneToOne 1 100 0.00 255.0 FORMAT "%5.1" ECU_ADDRESS 0x8FDE0C /end MEASUREMENT
/begin MEASUREMENT Fid_MSMonNetMngPtCan_mp "" UBYTE OneToOne 1 100 0.00 255.0 FORMAT "%5.1" ECU_ADDRESS 0x8FDE0D /end MEASUREMENT
/begin MEASUREMENT Fid_MSMonPFlt1_mp "Messpunkt fuer Funktions Identifier Fid_MSMonPFlt1" UBYTE OneToOne 1 100 0.00 255.0 FORMAT "%5.1" ECU_ADDRESS 0x8FDE0E /end MEASUREMENT
/begin MEASUREMENT Fid_MSMonPFlt2_mp "Messpunkt fuer Funktions Identifier Fid_MSMonPFlt2" UBYTE OneToOne 1 100 0.00 255.0 FORMAT "%5.1" ECU_ADDRESS 0x8FDE0F /end MEASUREMENT
/begin MEASUREMENT Fid_MSMonPFlt3_mp "Messpunkt fuer Funktions Identifier Fid_MSMonPFlt3" UBYTE OneToOne 1 100 0.00 255.0 FORMAT "%5.1" ECU_ADDRESS 0x8FDE10 /end MEASUREMENT
/begin MEASUREMENT Fid_MSMonPFlt4_mp "Messpunkt fuer Funktions Identifier Fid_MSMonPFlt4" UBYTE OneToOne 1 100 0.00 255.0 FORMAT "%5.1" ECU_ADDRESS 0x8FDE11 /end MEASUREMENT
/begin MEASUREMENT Fid_MSMonStEGS_mp "" UBYTE OneToOne 1 100 0.00 255.0 FORMAT "%5.1" ECU_ADDRESS 0x8FDE12 /end MEASUREMENT
/begin MEASUREMENT Fid_MSMon_ARS_TO_mp "Messpunkt fuer Funktions Identifier Fid_MSMon_ARS_TO" UBYTE OneToOne 1 100 0.00 255.0 FORMAT "%5.1" ECU_ADDRESS 0x8FDE13 /end MEASUREMENT
/begin MEASUREMENT Fid_MSMon_CanDef_mp "Messpunkt fuer Funktions Identifier Fid_MSMon_CanDef" UBYTE OneToOne 1 100 0.00 255.0 FORMAT "%5.1" ECU_ADDRESS 0x8FDE14 /end MEASUREMENT
/begin MEASUREMENT Fid_MSMon_DSC_TO_mp "Messpunkt fuer Funktions Identifier Fid_MSMon_DSC_TO" UBYTE OneToOne 1 100 0.00 255.0 FORMAT "%5.1" ECU_ADDRESS 0x8FDE15 /end MEASUREMENT
/begin MEASUREMENT Fid_MSMon_EGS_TO_mp "Messpunkt fuer Funktions Identifier Fid_MSMon_EGS_TO" UBYTE OneToOne 1 100 0.00 255.0 FORMAT "%5.1" ECU_ADDRESS 0x8FDE16 /end MEASUREMENT
/begin MEASUREMENT Fid_MSMon_FrmMngPT2_mp "Messpunkt fuer Funktions Identifier Fid_MSMon_FrmMngPT2" UBYTE OneToOne 1 100 0.00 255.0 FORMAT "%5.1" ECU_ADDRESS 0x8FDE17 /end MEASUREMENT
/begin MEASUREMENT Fid_MSMon_FrmMngPT_mp "dazugehörige Fid zum Fehlerpfad Dfp_MSMon_FrmMngPT" UBYTE OneToOne 1 100 0.00 255.0 FORMAT "%5.1" ECU_ADDRESS 0x8FDE18 /end MEASUREMENT
/begin MEASUREMENT Fid_MSMon_trqOff_mp "dazugehörige Fid zum Fehlerpfad Dfp_MSMon_trqOff" UBYTE OneToOne 1 100 0.00 255.0 FORMAT "%5.1" ECU_ADDRESS 0x8FDE19 /end MEASUREMENT
/begin MEASUREMENT Fid_OTSCD_mp "Fid für SRC Max- und Min-Fehler des OTSCD Fehlerpfads" UBYTE OneToOne 1 100 0.00 255.0 FORMAT "%5.1" ECU_ADDRESS 0x8FDE1A /end MEASUREMENT
/begin MEASUREMENT Fid_OxiCat_pPreCat_mp "Druckverlust über OxiKat" UBYTE OneToOne 1 100 0.00 255.0 FORMAT "%5.1" ECU_ADDRESS 0x8FDE1B /end MEASUREMENT
/begin MEASUREMENT Fid_PCBSPFltDef_mp "Messpunkt fuer Funktions Identifier Fid_PCBSPFltDef" UBYTE OneToOne 1 100 0.00 255.0 FORMAT "%5.1" ECU_ADDRESS 0x8FDE1C /end MEASUREMENT
/begin MEASUREMENT Fid_PCRBalGvnrP40Corr_mp "Fid um die Korrektur von Partikelfilterdifferenzdruck für den Gleichstellregler GSR im Fehlerfall auf 1 neutral zu stellen." UBYTE OneToOne 1 100 0.00 255.0 FORMAT "%5.1" ECU_ADDRESS 0x8FDE1D /end MEASUREMENT
/begin MEASUREMENT Fid_PCRBalGvnr_mp "Messpunkt fuer Funktions Identifier Fid_PCRBalGvnr" UBYTE OneToOne 1 100 0.00 255.0 FORMAT "%5.1" ECU_ADDRESS 0x8FDE1E /end MEASUREMENT
/begin MEASUREMENT Fid_PCRExtnLimActr_mp "Function identifier shut-off correction of the actuator limitation because of increasing backpressure upstream from  part. filte" UBYTE OneToOne 1 100 0.00 255.0 FORMAT "%5.1" ECU_ADDRESS 0x8FDE1F /end MEASUREMENT
/begin MEASUREMENT Fid_PCRGvnrDvtNeg_mp "Messpunkt fuer Funktions Identifier Fid_PCRGvnrDvtNeg" UBYTE OneToOne 1 100 0.00 255.0 FORMAT "%5.1" ECU_ADDRESS 0x8FDE20 /end MEASUREMENT
/begin MEASUREMENT Fid_PCRGvnrDvtPos_mp "Messpunkt fuer Funktions Identifier Fid_PCRGvnrDvtPos" UBYTE OneToOne 1 100 0.00 255.0 FORMAT "%5.1" ECU_ADDRESS 0x8FDE21 /end MEASUREMENT
/begin MEASUREMENT Fid_PCRLPGvnrDvtNeg_mp "Fid fuer neg. Regelabweichung PCR-LP" UBYTE OneToOne 1 100 0.00 255.0 FORMAT "%5.1" ECU_ADDRESS 0x8FDE22 /end MEASUREMENT
/begin MEASUREMENT Fid_PCRLPGvnrDvtPos_mp "FID fürpos. Regelabweichung PCR-LP" UBYTE OneToOne 1 100 0.00 255.0 FORMAT "%5.1" ECU_ADDRESS 0x8FDE23 /end MEASUREMENT
/begin MEASUREMENT Fid_PCRSurgeGvnr_mp "" UBYTE OneToOne 1 100 0.00 255.0 FORMAT "%5.1" ECU_ADDRESS 0x8FDE24 /end MEASUREMENT
/begin MEASUREMENT Fid_PCRSurgeLIGov_mp "Fault path identifier for Anti-Surge LIGov" UBYTE OneToOne 1 100 0.00 255.0 FORMAT "%5.1" ECU_ADDRESS 0x8FDE25 /end MEASUREMENT
/begin MEASUREMENT Fid_PCR_LPMS_mp "FID für Ladedruckregelung-Niederdruckstufe LP 8 Zyl." UBYTE OneToOne 1 100 0.00 255.0 FORMAT "%5.1" ECU_ADDRESS 0x8FDE26 /end MEASUREMENT
/begin MEASUREMENT Fid_PCR_LP_mp "FID für Ladedruckregelung-Niederdruckstufe (LP)" UBYTE OneToOne 1 100 0.00 255.0 FORMAT "%5.1" ECU_ADDRESS 0x8FDE27 /end MEASUREMENT
/begin MEASUREMENT Fid_PCR_mp "Systemfehler in PCR" UBYTE OneToOne 1 100 0.00 255.0 FORMAT "%5.1" ECU_ADDRESS 0x8FDE28 /end MEASUREMENT
/begin MEASUREMENT Fid_PCR_MS_mp "Messpunkt fuer Funktions Identifier Fid_PCR_MS" UBYTE OneToOne 1 100 0.00 255.0 FORMAT "%5.1" ECU_ADDRESS 0x8FDE29 /end MEASUREMENT
/begin MEASUREMENT Fid_PCR_SurgeDet_mp "Meßpunkt für Fid" UBYTE OneToOne 1 100 0.00 255.0 FORMAT "%5.1" ECU_ADDRESS 0x8FDE2A /end MEASUREMENT
/begin MEASUREMENT Fid_PCVCDCalcI_mp "Fehleridentifier um den I-Anteil des Stromreglers für das Druckregelventil einzufrieren" UBYTE OneToOne 1 100 0.00 255.0 FORMAT "%5.1" ECU_ADDRESS 0x8FDE2B /end MEASUREMENT
/begin MEASUREMENT Fid_PFltAshCorRgn_mp "function identifier zur Freigabe der Regenerationsanforderung" UBYTE OneToOne 1 100 0.00 255.0 FORMAT "%5.1" ECU_ADDRESS 0x8FDE2C /end MEASUREMENT
/begin MEASUREMENT Fid_PFltAshCor_mp "Messpunkt fuer Funktions Identifier Fid_PFltAshCor" UBYTE OneToOne 1 100 0.00 255.0 FORMAT "%5.1" ECU_ADDRESS 0x8FDE2D /end MEASUREMENT
/begin MEASUREMENT Fid_PFltBrk_mp "Function Identifier für Bremssignal" UBYTE OneToOne 1 100 0.00 255.0 FORMAT "%5.1" ECU_ADDRESS 0x8FDE2E /end MEASUREMENT
/begin MEASUREMENT Fid_PFltCharB1_mp "Fid für Verhinderung Resflow-SRC Bank 1" UBYTE OneToOne 1 100 0.00 255.0 FORMAT "%5.1" ECU_ADDRESS 0x8FDE2F /end MEASUREMENT
/begin MEASUREMENT Fid_PFltCharB2_mp "Fid für Verhinderung Resflow-SRC Bank 2" UBYTE OneToOne 1 100 0.00 255.0 FORMAT "%5.1" ECU_ADDRESS 0x8FDE30 /end MEASUREMENT
/begin MEASUREMENT Fid_PFltChngParB1_mp "Messpunkt fuer Funktions Identifier Fid_PFltChngPar Bank 1" UBYTE OneToOne 1 100 0.00 255.0 FORMAT "%5.1" ECU_ADDRESS 0x8FDE31 /end MEASUREMENT
/begin MEASUREMENT Fid_PFltChngParB2_mp "Messpunkt fuer Funktions Identifier Fid_PFltChngPar Bank 2" UBYTE OneToOne 1 100 0.00 255.0 FORMAT "%5.1" ECU_ADDRESS 0x8FDE32 /end MEASUREMENT
/begin MEASUREMENT Fid_PFltClth_mp "Function Identifier für Kupplungssignal" UBYTE OneToOne 1 100 0.00 255.0 FORMAT "%5.1" ECU_ADDRESS 0x8FDE33 /end MEASUREMENT
/begin MEASUREMENT Fid_PFltDynChkB1_mp "Messpunkt fuer Funktions Identifier Fid_PFltDynChkB1" UBYTE OneToOne 1 100 0.00 255.0 FORMAT "%5.1" ECU_ADDRESS 0x8FDE34 /end MEASUREMENT
/begin MEASUREMENT Fid_PFltDynChkB2_mp "Messpunkt fuer Funktions Identifier Fid_PFltDynChkB2" UBYTE OneToOne 1 100 0.00 255.0 FORMAT "%5.1" ECU_ADDRESS 0x8FDE35 /end MEASUREMENT
/begin MEASUREMENT Fid_PFltEngPrtRgnMon_mp "Messpunkt fuer Funktions Identifier Fid_PFltEngPrtRgnMon" UBYTE OneToOne 1 100 0.00 255.0 FORMAT "%5.1" ECU_ADDRESS 0x8FDE36 /end MEASUREMENT
/begin MEASUREMENT Fid_PFltGearDet_mp "Function Identifier für Gangsignal" UBYTE OneToOne 1 100 0.00 255.0 FORMAT "%5.1" ECU_ADDRESS 0x8FDE37 /end MEASUREMENT
/begin MEASUREMENT Fid_PFltHsLnChkB1_mp "Messpunkt fuer Funktions Identifier Fid_PFltHsLnChkB1" UBYTE OneToOne 1 100 0.00 255.0 FORMAT "%5.1" ECU_ADDRESS 0x8FDE38 /end MEASUREMENT
/begin MEASUREMENT Fid_PFltHsLnChkB2_mp "Messpunkt fuer Funktions Identifier Fid_PFltHsLnChkB2" UBYTE OneToOne 1 100 0.00 255.0 FORMAT "%5.1" ECU_ADDRESS 0x8FDE39 /end MEASUREMENT
/begin MEASUREMENT Fid_PFltLckRgnErr_mp "Messpunkt fuer Funktions Identifier Fid_PFltLckRgnErr" UBYTE OneToOne 1 100 0.00 255.0 FORMAT "%5.1" ECU_ADDRESS 0x8FDE3A /end MEASUREMENT
/begin MEASUREMENT Fid_PFltLckRgnFuel_mp "Fid für PFlt-Kraftstoff-Verriegelungsregeneration" UBYTE OneToOne 1 100 0.00 255.0 FORMAT "%5.1" ECU_ADDRESS 0x8FDE3B /end MEASUREMENT
/begin MEASUREMENT Fid_PFltNumPFltErrLck_mp "Messpunkt fuer Funktions Identifier Fid_PFltNumPFltErrLck" UBYTE OneToOne 1 100 0.00 255.0 FORMAT "%5.1" ECU_ADDRESS 0x8FDE3C /end MEASUREMENT
/begin MEASUREMENT Fid_PFltNumPFltErr_mp "Messpunkt fuer Funktions Identifier Fid_PFltNumPFltErr" UBYTE OneToOne 1 100 0.00 255.0 FORMAT "%5.1" ECU_ADDRESS 0x8FDE3D /end MEASUREMENT
/begin MEASUREMENT Fid_PFltPlausPresB1_mp "Messpunkt fuer Funktions Identifier Fid_PFltPlausPresB1" UBYTE OneToOne 1 100 0.00 255.0 FORMAT "%5.1" ECU_ADDRESS 0x8FDE3E /end MEASUREMENT
/begin MEASUREMENT Fid_PFltPlausPresB2_mp "Messpunkt fuer Funktions Identifier Fid_PFltPlausPresB2" UBYTE OneToOne 1 100 0.00 255.0 FORMAT "%5.1" ECU_ADDRESS 0x8FDE3F /end MEASUREMENT
/begin MEASUREMENT Fid_PFltPlausTempB1_mp "Messpunkt fuer Funktions Identifier Fid_PFltPlausTempB1" UBYTE OneToOne 1 100 0.00 255.0 FORMAT "%5.1" ECU_ADDRESS 0x8FDE40 /end MEASUREMENT
/begin MEASUREMENT Fid_PFltPlausTempB2_mp "Messpunkt fuer Funktions Identifier Fid_PFltPlausTempB2" UBYTE OneToOne 1 100 0.00 255.0 FORMAT "%5.1" ECU_ADDRESS 0x8FDE41 /end MEASUREMENT
/begin MEASUREMENT Fid_PFltPresPlausProj_mp "Messpunkt fuer Funktions Identifier Fid_PFltPresPlausProj" UBYTE OneToOne 1 100 0.00 255.0 FORMAT "%5.1" ECU_ADDRESS 0x8FDE42 /end MEASUREMENT
/begin MEASUREMENT Fid_PFltPresSensFrz_mp "Messpunkt fuer Funktions Identifier Fid_PFltPresSensFrz" UBYTE OneToOne 1 100 0.00 255.0 FORMAT "%5.1" ECU_ADDRESS 0x8FDE43 /end MEASUREMENT
/begin MEASUREMENT Fid_PFltPresSensHsLnB1_mp "Messpunkt fuer Funktions Identifier Fid_PFltPresSensHsLnB1" UBYTE OneToOne 1 100 0.00 255.0 FORMAT "%5.1" ECU_ADDRESS 0x8FDE44 /end MEASUREMENT
/begin MEASUREMENT Fid_PFltPresSensHsLnB2_mp "Messpunkt fuer Funktions Identifier Fid_PFltPresSensHsLnB2" UBYTE OneToOne 1 100 0.00 255.0 FORMAT "%5.1" ECU_ADDRESS 0x8FDE45 /end MEASUREMENT
/begin MEASUREMENT Fid_PFltPresSensPreB1_mp "Messpunkt fuer Funktions Identifier Fid_PfltPresSensPreB1" UBYTE OneToOne 1 100 0.00 255.0 FORMAT "%5.1" ECU_ADDRESS 0x8FDE46 /end MEASUREMENT
/begin MEASUREMENT Fid_PFltPresSensPreB2_mp "Messpunkt fuer Funktions Identifier Fid_PfltPresSensPreB2" UBYTE OneToOne 1 100 0.00 255.0 FORMAT "%5.1" ECU_ADDRESS 0x8FDE47 /end MEASUREMENT
/begin MEASUREMENT Fid_PFltSimOnB1_mp "wenn aktiv wird von Beladungsmessung auf Simulation umgesch(Bank1)." UBYTE OneToOne 1 100 0.00 255.0 FORMAT "%5.1" ECU_ADDRESS 0x8FDE48 /end MEASUREMENT
/begin MEASUREMENT Fid_PFltSimOnB2_mp "wenn aktiv wird von Beladungsmessung auf Simulation umgesch(Bank2)." UBYTE OneToOne 1 100 0.00 255.0 FORMAT "%5.1" ECU_ADDRESS 0x8FDE49 /end MEASUREMENT
/begin MEASUREMENT Fid_PFltSpdVeh_mp "Function Identifier für Fahrzeugsgeschwindigkeit" UBYTE OneToOne 1 100 0.00 255.0 FORMAT "%5.1" ECU_ADDRESS 0x8FDE4A /end MEASUREMENT
/begin MEASUREMENT Fid_PFltSRCPresB1_mp "Messpunkt fuer Funktions Identifier Fid_PFltSRCPresB1" UBYTE OneToOne 1 100 0.00 255.0 FORMAT "%5.1" ECU_ADDRESS 0x8FDE4B /end MEASUREMENT
/begin MEASUREMENT Fid_PFltSRCPresB2_mp "Messpunkt fuer Funktions Identifier Fid_PFltSRCPresB2" UBYTE OneToOne 1 100 0.00 255.0 FORMAT "%5.1" ECU_ADDRESS 0x8FDE4C /end MEASUREMENT
/begin MEASUREMENT Fid_PFltSRCTempB1_mp "Messpunkt fuer Funktions Identifier Fid_PFltSRCTempB1" UBYTE OneToOne 1 100 0.00 255.0 FORMAT "%5.1" ECU_ADDRESS 0x8FDE4D /end MEASUREMENT
/begin MEASUREMENT Fid_PFltSRCTempB2_mp "Messpunkt fuer Funktions Identifier Fid_PFltSRCTempB2" UBYTE OneToOne 1 100 0.00 255.0 FORMAT "%5.1" ECU_ADDRESS 0x8FDE4E /end MEASUREMENT
/begin MEASUREMENT Fid_PFltSucB1_mp "Für erfolgreiche Regenerationsabfragung in Bank 1 verriegeln" UBYTE OneToOne 1 100 0.00 255.0 FORMAT "%5.1" ECU_ADDRESS 0x8FDE4F /end MEASUREMENT
/begin MEASUREMENT Fid_PFltSucB2_mp "Für erfolgreiche Regenerationsabfragung in Bank 2 verriegeln" UBYTE OneToOne 1 100 0.00 255.0 FORMAT "%5.1" ECU_ADDRESS 0x8FDE50 /end MEASUREMENT
/begin MEASUREMENT Fid_PFltTempAir_mp "Function Identifier für Ansaugsluft-temperatur" UBYTE OneToOne 1 100 0.00 255.0 FORMAT "%5.1" ECU_ADDRESS 0x8FDE51 /end MEASUREMENT
/begin MEASUREMENT Fid_PFltTempClnt_mp "Function identifier für Kühlflüssigkeitstemperatur" UBYTE OneToOne 1 100 0.00 255.0 FORMAT "%5.1" ECU_ADDRESS 0x8FDE52 /end MEASUREMENT
/begin MEASUREMENT Fid_PFltTempOxiPreB1_mp "Messpunkt fuer Funktions Identifier Fid_PFltTempOxiPreB1" UBYTE OneToOne 1 100 0.00 255.0 FORMAT "%5.1" ECU_ADDRESS 0x8FDE53 /end MEASUREMENT
/begin MEASUREMENT Fid_PFltTempOxiPreB2_mp "Messpunkt fuer Funktions Identifier Fid_PFltTempOxiPreB2" UBYTE OneToOne 1 100 0.00 255.0 FORMAT "%5.1" ECU_ADDRESS 0x8FDE54 /end MEASUREMENT
/begin MEASUREMENT Fid_PFltTempOxiPstB1_mp "Messpunkt fuer Funktions Identifier Fid_PFltTempOxiPstB1" UBYTE OneToOne 1 100 0.00 255.0 FORMAT "%5.1" ECU_ADDRESS 0x8FDE55 /end MEASUREMENT
/begin MEASUREMENT Fid_PFltTempOxiPstB2_mp "Messpunkt fuer Funktions Identifier Fid_PFltTempOxiPstB2" UBYTE OneToOne 1 100 0.00 255.0 FORMAT "%5.1" ECU_ADDRESS 0x8FDE56 /end MEASUREMENT
/begin MEASUREMENT Fid_PFltTempPreB1_mp "Messpunkt fuer Funktions Identifier Fid_PFltTempPreB1" UBYTE OneToOne 1 100 0.00 255.0 FORMAT "%5.1" ECU_ADDRESS 0x8FDE57 /end MEASUREMENT
/begin MEASUREMENT Fid_PFltTempPreB2_mp "Messpunkt fuer Funktions Identifier Fid_PFltTempPreB2" UBYTE OneToOne 1 100 0.00 255.0 FORMAT "%5.1" ECU_ADDRESS 0x8FDE58 /end MEASUREMENT
/begin MEASUREMENT Fid_PFltTempSensB1_mp "Messpunkt fuer Funktions Identifier Fid_PFltTempSensB1" UBYTE OneToOne 1 100 0.00 255.0 FORMAT "%5.1" ECU_ADDRESS 0x8FDE59 /end MEASUREMENT
/begin MEASUREMENT Fid_PFltTempSensB2_mp "Messpunkt fuer Funktions Identifier Fid_PFltTempSensB2" UBYTE OneToOne 1 100 0.00 255.0 FORMAT "%5.1" ECU_ADDRESS 0x8FDE5A /end MEASUREMENT
/begin MEASUREMENT Fid_PFltTempSensFrz_mp "Messpunkt fuer Funktions Identifier Fid_PFltTempSensFrz" UBYTE OneToOne 1 100 0.00 255.0 FORMAT "%5.1" ECU_ADDRESS 0x8FDE5B /end MEASUREMENT
/begin MEASUREMENT Fid_PFltTOxiPreDiffB1_mp "" UBYTE OneToOne 1 100 0.00 255.0 FORMAT "%5.1" ECU_ADDRESS 0x8FDE5C /end MEASUREMENT
/begin MEASUREMENT Fid_PFltTOxiPreDiffB2_mp "" UBYTE OneToOne 1 100 0.00 255.0 FORMAT "%5.1" ECU_ADDRESS 0x8FDE5D /end MEASUREMENT
/begin MEASUREMENT Fid_PFltTPreDiffB1_mp "" UBYTE OneToOne 1 100 0.00 255.0 FORMAT "%5.1" ECU_ADDRESS 0x8FDE5E /end MEASUREMENT
/begin MEASUREMENT Fid_PFltTPreDiffB2_mp "" UBYTE OneToOne 1 100 0.00 255.0 FORMAT "%5.1" ECU_ADDRESS 0x8FDE5F /end MEASUREMENT
/begin MEASUREMENT Fid_PFltTwFlwTempDev_mp "Funktionsidentifier für Temperaturdifferenz bei  Motoren mit zweiflutige  Abgassysteme" UBYTE OneToOne 1 100 0.00 255.0 FORMAT "%5.1" ECU_ADDRESS 0x8FDE60 /end MEASUREMENT
/begin MEASUREMENT Fid_PFltVltgBatt_mp "Function Identifier für Akkumulatorspannung" UBYTE OneToOne 1 100 0.00 255.0 FORMAT "%5.1" ECU_ADDRESS 0x8FDE61 /end MEASUREMENT
/begin MEASUREMENT Fid_RailCDRPSErrChk_mp "Fid zur Reaktion auf Fehler des Kraftstoffdrucksensors: Dfp_RailCD_mp wird nicht weiter gestestet." UBYTE OneToOne 1 100 0.00 255.0 FORMAT "%5.1" ECU_ADDRESS 0x8FDE62 /end MEASUREMENT
/begin MEASUREMENT Fid_RailCDSubstVal_mp "Fid zur Reaktion auf Fehler des Kraftstoffdrucksensors" UBYTE OneToOne 1 100 0.00 255.0 FORMAT "%5.1" ECU_ADDRESS 0x8FDE63 /end MEASUREMENT
/begin MEASUREMENT Fid_RailCD_PMonStrt_mp "Messpunkt fuer Funktions Identifier Fid_RailCD_PMonStrt" UBYTE OneToOne 1 100 0.00 255.0 FORMAT "%5.1" ECU_ADDRESS 0x8FDE64 /end MEASUREMENT
/begin MEASUREMENT Fid_RailCPCtlMeUnMode_mp "Fid zur Aktivierung der Überwachung von der CPC-Umschaltung zur Regelung über MeUn" UBYTE OneToOne 1 100 0.00 255.0 FORMAT "%5.1" ECU_ADDRESS 0x8FDE65 /end MEASUREMENT
/begin MEASUREMENT Fid_RailCPCtlPCVMode_mp "Fid zur Aktivierung der Überwachung von der CPC-Umschaltung zur Regelung über PCV" UBYTE OneToOne 1 100 0.00 255.0 FORMAT "%5.1" ECU_ADDRESS 0x8FDE66 /end MEASUREMENT
/begin MEASUREMENT Fid_RailCtlMode_mp "Fehlerverriegelung allgemein für die Druckregelung" UBYTE OneToOne 1 100 0.00 255.0 FORMAT "%5.1" ECU_ADDRESS 0x8FDE67 /end MEASUREMENT
/begin MEASUREMENT Fid_RailMeUn0Blk_mp "Fehleridentifier zur Verriegelung der Überwachung auf positive Regelabweichung" UBYTE OneToOne 1 100 0.00 255.0 FORMAT "%5.1" ECU_ADDRESS 0x8FDE68 /end MEASUREMENT
/begin MEASUREMENT Fid_RailMeUn0Rls_mp "Fehleridentifier zur Freigabe der Überwachung auf positive Regelabweichung" UBYTE OneToOne 1 100 0.00 255.0 FORMAT "%5.1" ECU_ADDRESS 0x8FDE69 /end MEASUREMENT
/begin MEASUREMENT Fid_RailMeUn1Blk_mp "Fehleridentifier zur Verriegelung der Überwachung auf positive Regelabweichung und Sollwert des Volumenstroms d. Zumesseinheit" UBYTE OneToOne 1 100 0.00 255.0 FORMAT "%5.1" ECU_ADDRESS 0x8FDE6A /end MEASUREMENT
/begin MEASUREMENT Fid_RailMeUn1Rls_mp "Fehleridentifier zur Freigabe der Überwachung auf positive Regelabweichung und Sollwert des Volumenstroms d. Zumesseinheit" UBYTE OneToOne 1 100 0.00 255.0 FORMAT "%5.1" ECU_ADDRESS 0x8FDE6B /end MEASUREMENT
/begin MEASUREMENT Fid_RailMeUn2Blk_mp "Fehleridentifier zur Verriegelung der Überwachung auf negative Regelabweichung bei Nullförderung" UBYTE OneToOne 1 100 0.00 255.0 FORMAT "%5.1" ECU_ADDRESS 0x8FDE6C /end MEASUREMENT
/begin MEASUREMENT Fid_RailMeUn2Rls_mp "Fehleridentifier zur Freigabe der Überwachung auf negative Regelabweichung bei Nullförderung" UBYTE OneToOne 1 100 0.00 255.0 FORMAT "%5.1" ECU_ADDRESS 0x8FDE6D /end MEASUREMENT
/begin MEASUREMENT Fid_RailMeUn3Blk_mp "Fehleridentifier zur Verriegelung der Überwachung auf minimalen Raildruck" UBYTE OneToOne 1 100 0.00 255.0 FORMAT "%5.1" ECU_ADDRESS 0x8FDE6E /end MEASUREMENT
/begin MEASUREMENT Fid_RailMeUn3Rls_mp "Fehleridentifier zur Freigabe der Überwachung auf minimalen Raildruck" UBYTE OneToOne 1 100 0.00 255.0 FORMAT "%5.1" ECU_ADDRESS 0x8FDE6F /end MEASUREMENT
/begin MEASUREMENT Fid_RailMeUn4Blk_mp "Fehleridentifier zur Verriegelung der Überwachung auf maximalen Raildruck" UBYTE OneToOne 1 100 0.00 255.0 FORMAT "%5.1" ECU_ADDRESS 0x8FDE70 /end MEASUREMENT
/begin MEASUREMENT Fid_RailMeUn4Rls_mp "Fehleridentifier zur Freigabe der Überwachung auf maximalen Raildruck" UBYTE OneToOne 1 100 0.00 255.0 FORMAT "%5.1" ECU_ADDRESS 0x8FDE71 /end MEASUREMENT
/begin MEASUREMENT Fid_RailMeUnCtlMode_mp "Fehlerverriegelung für die Druckregelung über Zumesseinheit" UBYTE OneToOne 1 100 0.00 255.0 FORMAT "%5.1" ECU_ADDRESS 0x8FDE72 /end MEASUREMENT
/begin MEASUREMENT Fid_RailPCV0Blk_mp "Fehleridentifier zur Verriegelung der Überwachung auf positive Regelabweichung" UBYTE OneToOne 1 100 0.00 255.0 FORMAT "%5.1" ECU_ADDRESS 0x8FDE73 /end MEASUREMENT
/begin MEASUREMENT Fid_RailPCV0Rls_mp "Fehleridentifier zur Freigabe der Überwachung auf positive Regelabweichung" UBYTE OneToOne 1 100 0.00 255.0 FORMAT "%5.1" ECU_ADDRESS 0x8FDE74 /end MEASUREMENT
/begin MEASUREMENT Fid_RailPCV1Blk_mp "Fehleridentifier zur Verriegelung der Überwachung auf positive Regelabweichung kombiniert mit Stellgröße des Druckregelventils" UBYTE OneToOne 1 100 0.00 255.0 FORMAT "%5.1" ECU_ADDRESS 0x8FDE75 /end MEASUREMENT
/begin MEASUREMENT Fid_RailPCV1Rls_mp "Fehleridentifier zur Freigabe der Überwachung auf positive Regelabweichung kombiniert mit Stellgröße des Druckregelventils" UBYTE OneToOne 1 100 0.00 255.0 FORMAT "%5.1" ECU_ADDRESS 0x8FDE76 /end MEASUREMENT
/begin MEASUREMENT Fid_RailPCV2Blk_mp "Fehleridentifier zur Verriegelung der Überwachung auf negative Regelabweichung kombiniert mit Stellgröße des Druckregelventils" UBYTE OneToOne 1 100 0.00 255.0 FORMAT "%5.1" ECU_ADDRESS 0x8FDE77 /end MEASUREMENT
/begin MEASUREMENT Fid_RailPCV2Rls_mp "Fehleridentifier zur Freigabe der Überwachung auf negative Regelabweichung kombiniert mit Stellgröße des Druckregelventils" UBYTE OneToOne 1 100 0.00 255.0 FORMAT "%5.1" ECU_ADDRESS 0x8FDE78 /end MEASUREMENT
/begin MEASUREMENT Fid_RailPCV3Blk_mp "Fehleridentifier zur Verriegelung der Überwachung auf minimalen Raildruck" UBYTE OneToOne 1 100 0.00 255.0 FORMAT "%5.1" ECU_ADDRESS 0x8FDE79 /end MEASUREMENT
/begin MEASUREMENT Fid_RailPCV3Rls_mp "Fehleridentifier zur Freigabe der Überwachung auf minimalen Raildruck" UBYTE OneToOne 1 100 0.00 255.0 FORMAT "%5.1" ECU_ADDRESS 0x8FDE7A /end MEASUREMENT
/begin MEASUREMENT Fid_RailPCV4Blk_mp "Fehleridentifier zur Verriegelung der Überwachung auf maximalen Raildruck" UBYTE OneToOne 1 100 0.00 255.0 FORMAT "%5.1" ECU_ADDRESS 0x8FDE7B /end MEASUREMENT
/begin MEASUREMENT Fid_RailPCV4Rls_mp "Fehleridentifier zur Freigabe der Überwachung auf maximalen Raildruck" UBYTE OneToOne 1 100 0.00 255.0 FORMAT "%5.1" ECU_ADDRESS 0x8FDE7C /end MEASUREMENT
/begin MEASUREMENT Fid_RailPCV5Blk_mp "Fehleridentifier zur Verriegelung der Plausibilisierung des Raildruck mit dem Strom durch das Druckregelventil" UBYTE OneToOne 1 100 0.00 255.0 FORMAT "%5.1" ECU_ADDRESS 0x8FDE7D /end MEASUREMENT
/begin MEASUREMENT Fid_RailPCV5Rls_mp "Fehleridentifier zur Freigabe der Plausibilisierung des Raildruck mit dem Strom durch das Druckregelventil" UBYTE OneToOne 1 100 0.00 255.0 FORMAT "%5.1" ECU_ADDRESS 0x8FDE7E /end MEASUREMENT
/begin MEASUREMENT Fid_RailPCVCtlMode_mp "Fehlerverriegelung für die Druckregelung über Druckregelventil" UBYTE OneToOne 1 100 0.00 255.0 FORMAT "%5.1" ECU_ADDRESS 0x8FDE7F /end MEASUREMENT
/begin MEASUREMENT Fid_RailSetPointLim_mp "Fid zur Verriegelung der ""normalen"" Begrenzung des Raildruck-Sollwertes" UBYTE OneToOne 1 100 0.00 255.0 FORMAT "%5.1" ECU_ADDRESS 0x8FDE80 /end MEASUREMENT
/begin MEASUREMENT Fid_RailSetPointRed_mp "Fehlerverriegelung zur Freigabe der Solldruckabsenkung im Systemfehlerfall" UBYTE OneToOne 1 100 0.00 255.0 FORMAT "%5.1" ECU_ADDRESS 0x8FDE81 /end MEASUREMENT
/begin MEASUREMENT Fid_SignalsTstNLim_mp "Drehzahlbegrenzung beim Testerzugrift im Fall einen Defekt in Nockenwelle oder Kurbelwelle" UBYTE OneToOne 1 100 0.00 255.0 FORMAT "%5.1" ECU_ADDRESS 0x8FDE82 /end MEASUREMENT
/begin MEASUREMENT Fid_StSysImmo_mp "FID WFS sperrt Starter" UBYTE OneToOne 1 100 0.00 255.0 FORMAT "%5.1" ECU_ADDRESS 0x8FDE83 /end MEASUREMENT
/begin MEASUREMENT Fid_StSysStrtTipGbxDat_mp "fid Getriebedaten für Automatik Start" UBYTE OneToOne 1 100 0.00 255.0 FORMAT "%5.1" ECU_ADDRESS 0x8FDE84 /end MEASUREMENT
/begin MEASUREMENT Fid_SysLamp_mp "dazugehörige Fid zum Fehlerpfad Dfp_SysLamp" UBYTE OneToOne 1 100 0.00 255.0 FORMAT "%5.1" ECU_ADDRESS 0x8FDE85 /end MEASUREMENT
/begin MEASUREMENT Fid_T15CDCanError_mp "Function Identifier für Ersatzwert bei CAN- Fehler" UBYTE OneToOne 1 100 0.00 255.0 FORMAT "%5.1" ECU_ADDRESS 0x8FDE86 /end MEASUREMENT
/begin MEASUREMENT Fid_T50CDSig_mp "Messpunkt fuer Funktions Identifier Fid_T50CDSig" UBYTE OneToOne 1 100 0.00 255.0 FORMAT "%5.1" ECU_ADDRESS 0x8FDE87 /end MEASUREMENT
/begin MEASUREMENT Fid_ThrVlvMon_mp "Messpunkt fuer Funktions Identifier Fid_ThrVlvMon" UBYTE OneToOne 1 100 0.00 255.0 FORMAT "%5.1" ECU_ADDRESS 0x8FDE88 /end MEASUREMENT
/begin MEASUREMENT Fid_TVACD_AirMonOff_mp "" UBYTE OneToOne 1 100 0.00 255.0 FORMAT "%5.1" ECU_ADDRESS 0x8FDE89 /end MEASUREMENT
/begin MEASUREMENT Fid_VehDaDist_mp "Status Funktionsidentifier Fid_VehDaDist zur Verriegelung Kilometerzähler VehDa_lSum" UBYTE OneToOne 1 100 0.00 255.0 FORMAT "%5.1" ECU_ADDRESS 0x8FDE8A /end MEASUREMENT
/begin MEASUREMENT Fid_VSACDDioInDia_mp "" UBYTE OneToOne 1 100 0.00 255.0 FORMAT "%5.1" ECU_ADDRESS 0x8FDE8B /end MEASUREMENT
/begin MEASUREMENT Fid_VSSCD_Tx_mp "Messpunkt fuer Funktions Identifier Fid_VSSCD_Tx" UBYTE OneToOne 1 100 0.00 255.0 FORMAT "%5.1" ECU_ADDRESS 0x8FDE8C /end MEASUREMENT
/begin MEASUREMENT Fid_ZFCClbActv_mp "FID für Ersatzreaktion für die Nullmengenkalibrierung" UBYTE OneToOne 1 100 0.00 255.0 FORMAT "%5.1" ECU_ADDRESS 0x8FDE8D /end MEASUREMENT
/begin MEASUREMENT Fid_ZFCCldCmbCham_mp "Function Identifier für die Erkennung ausgekühlter Brennraum der Nullmengenkalibrierung" UBYTE OneToOne 1 100 0.00 255.0 FORMAT "%5.1" ECU_ADDRESS 0x8FDE8E /end MEASUREMENT
/begin FUNCTION dsm_auto_inhdel ""
 /begin DEF_CHARACTERISTIC DSM_DInDfp_Layer_TANS_C DSM_DInDfp_ACCDSwtin_C DSM_DInDfp_ACC_PlausTrqDes_C DSM_DInDfp_ACC_trqInr_C DSM_DInDfp_ACTrq_C DSM_DInDfp_ADCMon_C DSM_DInDfp_AFSCDIdlAdjVal_C DSM_DInDfp_AFSCDLdAdjVal_C DSM_DInDfp_AFSCDPlAirPerCylDif_C DSM_DInDfp_AFSCD_AirTempDcyc_C DSM_DInDfp_AFSCD_AirTempDcyc2_C DSM_DInDfp_AFSCD_PlOffsDrft_C DSM_DInDfp_AFSCD_PlOffsDrft2_C DSM_DInDfp_AFSCD_PlSetyDrft_C DSM_DInDfp_AFSCD_SRCAirTemp_C DSM_DInDfp_AFSCD_SRCAirTemp2_C DSM_DInDfp_AFSCD_SRCBatt_C DSM_DInDfp_AFSCD_SRCBatt2_C DSM_DInDfp_AFSCD_SRCCorrAirm_C DSM_DInDfp_Layer_TUMG_C DSM_DInDfp_AFSCD_SRCCorrAirm2_C DSM_DInDfp_AFSCD_SRCRawAirm_C DSM_DInDfp_Layer_GEN_C DSM_DInDfp_Layer_BSD_C DSM_DInDfp_AFSCD_SRCRawAirm2_C DSM_DInDfp_AFSCD_SRCRefSigPer_C DSM_DInDfp_AFSCD_SRCRefSigPer2_C DSM_DInDfp_AOHtCD_C DSM_DInDfp_AOHtCD_AOHtDia1_C DSM_DInDfp_AOHtCD_AOHtDia2_C DSM_DInDfp_AOHtCD_AOHtDia3_C DSM_DInDfp_APP1_C DSM_DInDfp_APP2_C DSM_DInDfp_APPCDCmpd_C DSM_DInDfp_Layer_QLT_C DSM_DInDfp_APPSync_C DSM_DInDfp_Layer_IBS1_C DSM_DInDfp_Layer_IBS2_C DSM_DInDfp_Layer_IBS3_C DSM_DInDfp_Layer_PMBN_C DSM_DInDfp_Layer_PMBATT_C DSM_DInDfp_APSCD_C DSM_DInDfp_ARS_C DSM_DInDfp_AccPedPlausBrk_C DSM_DInDfp_AddPCDTnkLvl_C DSM_DInDfp_AirCtlGvnrDvtRgnMax_C DSM_DInDfp_AirCtlGvnrDvtRgnMin_C DSM_DInDfp_AirCtlGvnrDvtRgnMn2_C DSM_DInDfp_AirCtlGvnrDvtRgnMx2_C DSM_DInDfp_AirCtlPlateBreak_C DSM_DInDfp_AirCtlRmpTO_C DSM_DInDfp_AirCtl_GovNegDev_C DSM_DInDfp_AirCtl_GovNegDev2_C DSM_DInDfp_AirCtl_GovPosDev_C DSM_DInDfp_AirCtl_GovPosDev2_C DSM_DInDfp_AltCD_C DSM_DInDfp_BPACD_BPADia1_C DSM_DInDfp_BPACD_BPADia1v2_C DSM_DInDfp_BPACD_BPADia2_C DSM_DInDfp_BPACD_BPADia2v2_C DSM_DInDfp_BPACD_BPADia3_C DSM_DInDfp_BPACD_BPADia3v2_C DSM_DInDfp_BPACD_BPADia4_C DSM_DInDfp_BPACD_BPADia4v2_C DSM_DInDfp_BPACD_Max_C DSM_DInDfp_BPACD_Max2_C DSM_DInDfp_BPACD_Min_C DSM_DInDfp_BPACD_Min2_C DSM_DInDfp_BPACD_SigNpl_C DSM_DInDfp_BPACD_SigNpl2_C DSM_DInDfp_BPSCD_C DSM_DInDfp_BattCD_C DSM_DInDfp_BrkCD_C DSM_DInDfp_Layer_PMRUHVERL_C DSM_DInDfp_Bss_C DSM_DInDfp_CBACD_C DSM_DInDfp_CTSCD_C DSM_DInDfp_Clg_DynTst_C DSM_DInDfp_Layer_TOENS_C DSM_DInDfp_Layer_MANHYDR_C DSM_DInDfp_Layer_MANLUFT_C DSM_DInDfp_CmbChbMisfire1_C DSM_DInDfp_CmbChbMisfire2_C DSM_DInDfp_CmbChbMisfire3_C DSM_DInDfp_CmbChbMisfire4_C DSM_DInDfp_CmbChbMisfire5_C DSM_DInDfp_CmbChbMisfire6_C DSM_DInDfp_CmbChbMisfire7_C DSM_DInDfp_CmbChbMisfire8_C DSM_DInDfp_CmbChbMisfireMul_C DSM_DInDfp_CoDT_TRQ_Des_C DSM_DInDfp_CoDT_TRQ_Lead_C DSM_DInDfp_CoEng_GbxRpmRduc_C DSM_DInDfp_CoVMDCSh_C DSM_DInDfp_ConvCD_C DSM_DInDfp_CrCCDMFL_C DSM_DInDfp_CrCtl_vCrCtl_C DSM_DInDfp_EATSCD_C DSM_DInDfp_EBAFCD_C DSM_DInDfp_EBFCD_C DSM_DInDfp_EBTSCD_C DSM_DInDfp_EBTSCD_OvrTemp_C DSM_DInDfp_EEPCDVarMng_C DSM_DInDfp_EGPpCD_C DSM_DInDfp_EGRCD_Max_C DSM_DInDfp_EGRCD_Max2_C DSM_DInDfp_EGRCD_Min_C DSM_DInDfp_EGRCD_Min2_C DSM_DInDfp_EGRCD_PWMInDia1_C DSM_DInDfp_EGRCD_PWMInDia2_C DSM_DInDfp_EGRCD_PWMInDia21_C DSM_DInDfp_EGRCD_PWMInDia22_C DSM_DInDfp_EGRCD_PWMInDia23_C DSM_DInDfp_EGRCD_PWMInDia24_C DSM_DInDfp_EGRCD_PWMInDia3_C DSM_DInDfp_EGRCD_PWMInDia4_C DSM_DInDfp_EGRCD_SigDia_C DSM_DInDfp_EGRCD_SigDia2_C DSM_DInDfp_EGRCD_SigNpl_C DSM_DInDfp_EGRCD_SigNpl2_C DSM_DInDfp_EGTOilLvlCrit_C DSM_DInDfp_EGTOilVscCrit_C DSM_DInDfp_EGTRgnOilDil_C DSM_DInDfp_EGTTempGvnrInrB1_C DSM_DInDfp_EGTTempGvnrInrB2_C DSM_DInDfp_EGTTempGvnrOutrB1_C DSM_DInDfp_EGTTempGvnrOutrB2_C DSM_DInDfp_ETClbETFltInj1_C DSM_DInDfp_ETClbETFltInj2_C DSM_DInDfp_ETClbETFltInj3_C DSM_DInDfp_ETClbETFltInj4_C DSM_DInDfp_ETClbETFltInj5_C DSM_DInDfp_ETClbETFltInj6_C DSM_DInDfp_ETClbETFltInj7_C DSM_DInDfp_ETClbETFltInj8_C DSM_DInDfp_ETClbInj1_C DSM_DInDfp_ETClbInj2_C DSM_DInDfp_ETClbInj3_C DSM_DInDfp_ETClbInj4_C DSM_DInDfp_ETClbInj5_C DSM_DInDfp_ETClbInj6_C DSM_DInDfp_ETClbInj7_C DSM_DInDfp_ETClbInj8_C DSM_DInDfp_EngMCaS1_C DSM_DInDfp_EngMCrS1_C DSM_DInDfp_EngMOfsCaSCrS_C DSM_DInDfp_EngMntCtlCD_C DSM_DInDfp_FBCqDvt_C DSM_DInDfp_FMAErrMod_C DSM_DInDfp_FMTC_NonMonotonMap_C DSM_DInDfp_FTSCD_C DSM_DInDfp_FanCD_C DSM_DInDfp_FanCD_FanCtlr1_C DSM_DInDfp_FanCD_FanCtlr2_C DSM_DInDfp_FanCD_FanCtlr3_C DSM_DInDfp_FlFCD_C DSM_DInDfp_FlMngSmkDefect_C DSM_DInDfp_FlSCDT1_C DSM_DInDfp_FrmMngANFRADMOMPT_C DSM_DInDfp_FrmMngASC1_C DSM_DInDfp_FrmMngASC2_C DSM_DInDfp_FrmMngASC3_C DSM_DInDfp_FrmMngASC4_C DSM_DInDfp_FrmMngBOS_RESET_C DSM_DInDfp_FrmMngBOS_RESET2_C DSM_DInDfp_FrmMngDMANFAFS_C DSM_DInDfp_FrmMngDRMANFSSG_C DSM_DInDfp_FrmMngEGS1_C DSM_DInDfp_FrmMngEGS2_C DSM_DInDfp_FrmMngGEARBX_DATA_C DSM_DInDfp_FrmMngGEARBX_DATA2_C DSM_DInDfp_FrmMngHEAT_AC_C DSM_DInDfp_FrmMngINSTR2_C DSM_DInDfp_FrmMngINSTR3_C DSM_DInDfp_FrmMngLENKRADWINKEL_C DSM_DInDfp_FrmMngMILEAGE_RANGE_C DSM_DInDfp_FrmMngMSPHISYNC_C DSM_DInDfp_FrmMngMST4_C DSM_DInDfp_FrmMngMST5_C DSM_DInDfp_FrmMngOPCRCTLACC_C DSM_DInDfp_FrmMngPRGG_CCTR_C DSM_DInDfp_FrmMngPWRMNG_LOADV_C DSM_DInDfp_FrmMngParkConsumer_C DSM_DInDfp_FrmMngRQSTGEFAN_C DSM_DInDfp_FrmMngSLV4_C DSM_DInDfp_FrmMngSLV5_C DSM_DInDfp_FrmMngSSGErr_C DSM_DInDfp_FrmMngSSGShOff_C DSM_DInDfp_FrmMngSTAT_ANH_C DSM_DInDfp_FrmMngSTAT_ARS_C DSM_DInDfp_FrmMngSTAT_DSC_C DSM_DInDfp_FrmMngSTAT_EKP_C DSM_DInDfp_FrmMngSTAT_KOMBI_C DSM_DInDfp_FrmMngSTAT_SITZ_C DSM_DInDfp_FrmMngStOBDGbxMilOf_C DSM_DInDfp_FrmMngStOBDGbxMilOn_C DSM_DInDfp_FrmMngTEMPRELTIME_C DSM_DInDfp_FrmMngTERMINAL_C DSM_DInDfp_FrmMngTIME_DATE_C DSM_DInDfp_FrmMngTORQUE_DSC_C DSM_DInDfp_FrmMngTORQUE_GEARBX_C DSM_DInDfp_FrmMngTrq_ReqACC_C DSM_DInDfp_FrmMngVEH_MOD_C DSM_DInDfp_FrmMngVELOCITY_C DSM_DInDfp_FrmMngWHEEL_SPEED_C DSM_DInDfp_FrmMngstCurr_C DSM_DInDfp_FrmMngswtPSPOff_C DSM_DInDfp_GearbxIncMax_C DSM_DInDfp_GlwCD_C DSM_DInDfp_GlwCDGlwCirc1_C DSM_DInDfp_GlwCDGlwCirc2_C DSM_DInDfp_GlwCDGlwCirc3_C DSM_DInDfp_GlwCDGlwCirc4_C DSM_DInDfp_GlwCDGlwCirc5_C DSM_DInDfp_GlwCDGlwCirc6_C DSM_DInDfp_GlwCDGlwCirc7_C DSM_DInDfp_GlwCDGlwCirc8_C DSM_DInDfp_GlwCtl_C DSM_DInDfp_HWEMonCom_C DSM_DInDfp_HWEMonEEPROM_C DSM_DInDfp_HWEMonRcyLocked_C DSM_DInDfp_HWEMonRcySuppressed_C DSM_DInDfp_HWEMonRcyVisible_C DSM_DInDfp_HWEMonUMaxSupply_C DSM_DInDfp_HWEMonUMinSupply_C DSM_DInDfp_IATSCD_C DSM_DInDfp_IATSCD_CATS_C DSM_DInDfp_IATSCD_CATSSec_C DSM_DInDfp_ImmCtlImmCD_C DSM_DInDfp_ImmCtlImmEep_C DSM_DInDfp_ImmCtlMpl_C DSM_DInDfp_IndSys1_C DSM_DInDfp_IndSys2_C DSM_DInDfp_InjCrv_InjLim_C DSM_DInDfp_InjCtlAdjQnt_C DSM_DInDfp_InjCtlDrift_C DSM_DInDfp_InjVCDActrChrg_C DSM_DInDfp_InjVCDActrEnrg1_C DSM_DInDfp_InjVCDActrEnrg2_C DSM_DInDfp_InjVCDActrEnrg3_C DSM_DInDfp_InjVCDActrEnrg4_C DSM_DInDfp_InjVCDActrEnrg5_C DSM_DInDfp_InjVCDActrEnrg6_C DSM_DInDfp_InjVCDActrEnrg7_C DSM_DInDfp_InjVCDActrEnrg8_C DSM_DInDfp_InjVCDActrVolt_C DSM_DInDfp_InjVCDClsBank1_C DSM_DInDfp_InjVCDClsBank2_C DSM_DInDfp_InjVCDMonCab_C DSM_DInDfp_InjVCDMonSwt_C DSM_DInDfp_InjVCDShOffDCDC_C DSM_DInDfp_InjVCDUBuf1_C DSM_DInDfp_InjVCDUBuf2_C DSM_DInDfp_InjVCD_CY370Ampl_C DSM_DInDfp_InjVCD_DrvTime_C DSM_DInDfp_InjVCD_DrvTimeRcy_C DSM_DInDfp_InjVCD_TPUErr_C DSM_DInDfp_InjVlvBnk1A_C DSM_DInDfp_InjVlvBnk1B_C DSM_DInDfp_InjVlvBnk2A_C DSM_DInDfp_InjVlvBnk2B_C DSM_DInDfp_InjVlvChipA_C DSM_DInDfp_InjVlvChipB_C DSM_DInDfp_InjVlvCyl1A_C DSM_DInDfp_InjVlvCyl1B_C DSM_DInDfp_InjVlvCyl1C_C DSM_DInDfp_InjVlvCyl2A_C DSM_DInDfp_InjVlvCyl2B_C DSM_DInDfp_InjVlvCyl2C_C DSM_DInDfp_InjVlvCyl3A_C DSM_DInDfp_InjVlvCyl3B_C DSM_DInDfp_InjVlvCyl3C_C DSM_DInDfp_InjVlvCyl4A_C DSM_DInDfp_InjVlvCyl4B_C DSM_DInDfp_InjVlvCyl4C_C DSM_DInDfp_InjVlvCyl5A_C DSM_DInDfp_InjVlvCyl5B_C DSM_DInDfp_InjVlvCyl5C_C DSM_DInDfp_InjVlvCyl6A_C DSM_DInDfp_InjVlvCyl6B_C DSM_DInDfp_InjVlvCyl6C_C DSM_DInDfp_InjVlvCyl7A_C DSM_DInDfp_InjVlvCyl7B_C DSM_DInDfp_InjVlvCyl7C_C DSM_DInDfp_InjVlvCyl8A_C DSM_DInDfp_InjVlvCyl8B_C DSM_DInDfp_InjVlvCyl8C_C DSM_DInDfp_InjVlvNVC1_C DSM_DInDfp_InjVlvNVC2_C DSM_DInDfp_InjVlvNVC3_C DSM_DInDfp_InjVlvNVC4_C DSM_DInDfp_InjVlvNVC5_C DSM_DInDfp_InjVlvNVC6_C DSM_DInDfp_InjVlvNVC7_C DSM_DInDfp_InjVlvNVC8_C DSM_DInDfp_KeyCheck_C DSM_DInDfp_LIGovECUTransMode_C DSM_DInDfp_LPACD_Max_C DSM_DInDfp_LPACD_Min_C DSM_DInDfp_LPACD_SigNpl_C DSM_DInDfp_LSUCDCircNernst0B1_C DSM_DInDfp_LSUCDCircNernst0B2_C DSM_DInDfp_LSUCDCircPumpCur0B1_C DSM_DInDfp_LSUCDCircPumpCur0B2_C DSM_DInDfp_LSUCDCircVirtGnd0B1_C DSM_DInDfp_LSUCDCircVirtGnd0B2_C DSM_DInDfp_LSUCDHeater0B1_C DSM_DInDfp_LSUCDHeater0B2_C DSM_DInDfp_LSUCDHtCoup0B1_C DSM_DInDfp_LSUCDHtCoup0B2_C DSM_DInDfp_LSUCDO20B1_C DSM_DInDfp_LSUCDO20B2_C DSM_DInDfp_LSUCDO2Clb0B1_C DSM_DInDfp_LSUCDO2Clb0B2_C DSM_DInDfp_LSUCDRiClb0B1_C DSM_DInDfp_LSUCDRiClb0B2_C DSM_DInDfp_LSUCDSPI0B1_C DSM_DInDfp_LSUCDSPI0B2_C DSM_DInDfp_LSUCDSPIBattLow0B1_C DSM_DInDfp_LSUCDSPIBattLow0B2_C DSM_DInDfp_LSUCDWireIP0B1_C DSM_DInDfp_LSUCDWireIP0B2_C DSM_DInDfp_LSUCtlRiExc0B1_C DSM_DInDfp_LSUCtlRiExc0B2_C DSM_DInDfp_LSUMon1SensB1_C DSM_DInDfp_LSUMon1SensB2_C DSM_DInDfp_LSUMon2SensB1_C DSM_DInDfp_LSUMon2SensB2_C DSM_DInDfp_MIL_C DSM_DInDfp_MRlyCD_C DSM_DInDfp_MSMon_C DSM_DInDfp_MSMonConsist_C DSM_DInDfp_MSMonPFlt1_C DSM_DInDfp_MSMonPFlt2_C DSM_DInDfp_MSMonPFlt3_C DSM_DInDfp_MSMonPFlt4_C DSM_DInDfp_MSMon_ARS_TO_C DSM_DInDfp_MSMon_AirCtl_C DSM_DInDfp_MSMon_AirSys0_C DSM_DInDfp_MSMon_AirSys1_C DSM_DInDfp_MSMon_AirSys2_C DSM_DInDfp_MSMon_AirSys3_C DSM_DInDfp_MSMon_AirSys4_C DSM_DInDfp_MSMon_AirSys7_C DSM_DInDfp_MSMon_CanDef_C DSM_DInDfp_MSMon_CoEng_OffVeh_C DSM_DInDfp_MSMon_CoEng_Rev1_C DSM_DInDfp_MSMon_CoEng_Rev2_C DSM_DInDfp_MSMon_CoEng_RevMS_C DSM_DInDfp_MSMon_DSC_TO_C DSM_DInDfp_MSMon_EGS_TO_C DSM_DInDfp_MSMon_FrmMngCoEng_C DSM_DInDfp_MSMon_FrmMngPT_C DSM_DInDfp_MSMon_FrmMngPT2_C DSM_DInDfp_MSMon_Mil_C DSM_DInDfp_MSMon_NetMngPtCan_C DSM_DInDfp_MSMon_RailCDPMon_C DSM_DInDfp_MSMon_StEGS_C DSM_DInDfp_MSMon_SysLamp_C DSM_DInDfp_MSMon_ZFCClbActv_C DSM_DInDfp_MSMon_qLimErr_C DSM_DInDfp_MSMon_trqCoDT_C DSM_DInDfp_MSMon_trqCoVeh_C DSM_DInDfp_MSMon_trqCoVehLim_C DSM_DInDfp_MSMon_trqDesExt_C DSM_DInDfp_MSMon_trqDesExtRev_C DSM_DInDfp_MSMon_trqLimErr_C DSM_DInDfp_MSMon_trqLimErr1_C DSM_DInDfp_MSMon_trqLimErr2_C DSM_DInDfp_MSMon_trqLimErr3_C DSM_DInDfp_MSMon_trqLimErr4_C DSM_DInDfp_MSidCD_Comm_C DSM_DInDfp_MSidCD_EcuMixed_C DSM_DInDfp_MSidCD_Pin_C DSM_DInDfp_MSidCD_Sel_INI_C DSM_DInDfp_MSidCD_Select_C DSM_DInDfp_MSid_SwCmp_C DSM_DInDfp_MSid_regEEPDiff_C DSM_DInDfp_MeUnCDNoLoad_C DSM_DInDfp_MeUnCDSCBat_C DSM_DInDfp_MeUnCDSCGnd_C DSM_DInDfp_MeUnCD_ADC_C DSM_DInDfp_MeUnCD_SigTst_C DSM_DInDfp_Montr_C DSM_DInDfp_NetMngDeviceA_C DSM_DInDfp_NetMngDeviceB_C DSM_DInDfp_NetMngDeviceC_C DSM_DInDfp_NetMngPrvCan_C DSM_DInDfp_NetMngPrvCanSlave_C DSM_DInDfp_NetMngPtCan_C DSM_DInDfp_NetMngPtCanSlave_C DSM_DInDfp_OPSCD_Lamp_C DSM_DInDfp_OPSCD_anain_C DSM_DInDfp_OTSCD_C DSM_DInDfp_OvRMon_C DSM_DInDfp_OvRMonSigA_C DSM_DInDfp_OxiCCDTPreB1_C DSM_DInDfp_OxiCCDTPreB2_C DSM_DInDfp_PCBS_C DSM_DInDfp_PCR_BalGvnr_C DSM_DInDfp_PCR_GovDevNeg_C DSM_DInDfp_PCR_GovDevPos_C DSM_DInDfp_PCR_LPGvnrDvtNeg_C DSM_DInDfp_PCR_LPGvnrDvtPos_C DSM_DInDfp_PCVCDNoLoad_C DSM_DInDfp_PCVCDSCBat_C DSM_DInDfp_PCVCDSCGnd_C DSM_DInDfp_PCVCD_ADC_C DSM_DInDfp_PCVCD_SigTst_C DSM_DInDfp_PFltAPSPlaus_C DSM_DInDfp_PFltAPSensB1_C DSM_DInDfp_PFltAPSensB2_C DSM_DInDfp_PFltBPSPlaus_C DSM_DInDfp_PFltCDPPreB1_C DSM_DInDfp_PFltCDPPreB2_C DSM_DInDfp_PFltCDTPreB1_C DSM_DInDfp_PFltCDTPreB2_C DSM_DInDfp_PFltCharB1_C DSM_DInDfp_PFltCharB2_C DSM_DInDfp_PFltDltOxiPreTwFlw_C DSM_DInDfp_PFltDltPreTwFlw_C DSM_DInDfp_PFltEngPrtB1_C DSM_DInDfp_PFltEngPrtB2_C DSM_DInDfp_PFltOvldInhRgnB1_C DSM_DInDfp_PFltOvldInhRgnB2_C DSM_DInDfp_PFltOvldTrqLimB1_C DSM_DInDfp_PFltOvldTrqLimB2_C DSM_DInDfp_PFltPresDynPlausB1_C DSM_DInDfp_PFltPresDynPlausB2_C DSM_DInDfp_PFltPresPlausB1_C DSM_DInDfp_PFltPresPlausB2_C DSM_DInDfp_PFltPresSensB1_C DSM_DInDfp_PFltPresSensB2_C DSM_DInDfp_PFltPresSensFrz_C DSM_DInDfp_PFltPresSensHsLnB1_C DSM_DInDfp_PFltPresSensHsLnB2_C DSM_DInDfp_PFltPresSensSotB1_C DSM_DInDfp_PFltPresSensSotB2_C DSM_DInDfp_PFltRgnPerm_C DSM_DInDfp_PFltTempDwnStrmB1_C DSM_DInDfp_PFltTempDwnStrmB2_C DSM_DInDfp_PFltTempSensB1_C DSM_DInDfp_PFltTempSensB2_C DSM_DInDfp_PFltTempUpStrmB1_C DSM_DInDfp_PFltTempUpStrmB2_C DSM_DInDfp_PFlt_tOxiPreMaxB1_C DSM_DInDfp_PFlt_tOxiPreMaxB2_C DSM_DInDfp_PFlt_tOxiPreMxRgnB1_C DSM_DInDfp_PFlt_tOxiPreMxRgnB2_C DSM_DInDfp_PFlt_tPreMaxB1_C DSM_DInDfp_PFlt_tPreMaxB2_C DSM_DInDfp_PFlt_tPreMaxRgnB1_C DSM_DInDfp_PFlt_tPreMaxRgnB2_C DSM_DInDfp_PFltmSotDiffMaxB1_C DSM_DInDfp_PFltmSotDiffMaxB2_C DSM_DInDfp_PresPlausDblDef_C DSM_DInDfp_QLTCD_C DSM_DInDfp_RailCD_C DSM_DInDfp_RailCDOfsTst_C DSM_DInDfp_RailCD_PMonStrt_C DSM_DInDfp_RailCPC1_C DSM_DInDfp_RailCPC3_C DSM_DInDfp_RailCPC4_C DSM_DInDfp_RailCtlModeMeUnDiag_C DSM_DInDfp_RailCtlModePCVDiag_C DSM_DInDfp_RailMeUn0_C DSM_DInDfp_RailMeUn1_C DSM_DInDfp_RailMeUn2_C DSM_DInDfp_RailMeUn3_C DSM_DInDfp_RailMeUn4_C DSM_DInDfp_RailPCV0_C DSM_DInDfp_RailPCV1_C DSM_DInDfp_RailPCV2_C DSM_DInDfp_RailPCV3_C DSM_DInDfp_RailPCV4_C DSM_DInDfp_RailPCV5_C DSM_DInDfp_SOPTst_C DSM_DInDfp_SSpMon1_C DSM_DInDfp_SSpMon2_C DSM_DInDfp_SSpMon3_C DSM_DInDfp_SSpMon4_C DSM_DInDfp_SSpMon5_C DSM_DInDfp_SSpMon6_C DSM_DInDfp_SWChk_CycSigChkDat_C DSM_DInDfp_SWChk_CycSigChkPrg_C DSM_DInDfp_StSysTrqShutOff_C DSM_DInDfp_StrtCD_Actr_C DSM_DInDfp_SysLamp_C DSM_DInDfp_T15CD_C DSM_DInDfp_TGearbx_C DSM_DInDfp_TPUMon_C DSM_DInDfp_TVACD_AirMon1_C DSM_DInDfp_TVACD_AirMon2_C DSM_DInDfp_TVACD_Max_C DSM_DInDfp_TVACD_Max2_C DSM_DInDfp_TVACD_Min_C DSM_DInDfp_TVACD_Min2_C DSM_DInDfp_TVACD_SigNpl_C DSM_DInDfp_TVACD_SigNpl2_C DSM_DInDfp_TVACD_TVADia1_C DSM_DInDfp_TVACD_TVADia2_C DSM_DInDfp_TVACD_TVADia21_C DSM_DInDfp_TVACD_TVADia22_C DSM_DInDfp_TVACD_TVADia23_C DSM_DInDfp_TVACD_TVADia24_C DSM_DInDfp_TVACD_TVADia3_C DSM_DInDfp_TVACD_TVADia4_C DSM_DInDfp_ThrVlvMon_C DSM_DInDfp_VSACD_DiaDet_C DSM_DInDfp_VSACD_DioInDia1_C DSM_DInDfp_VSACD_DioInDia2_C DSM_DInDfp_VSACD_DioInDia3_C DSM_DInDfp_VSACD_DioInDia4_C DSM_DInDfp_VSACD_DioInMin_C DSM_DInDfp_VSACD_Max_C DSM_DInDfp_VSACD_Min_C DSM_DInDfp_VSACD_SigNpl_C DSM_DInDfp_VSACD_VSADia1_C DSM_DInDfp_VSACD_VSADia2_C DSM_DInDfp_VSACD_VSADia3_C DSM_DInDfp_VSACD_VSADia4_C DSM_DInDfp_VSSCD1_C DSM_DInDfp_VSSCD2_C DSM_DInDfp_WdCom_C /end DEF_CHARACTERISTIC
/end FUNCTION
/begin FUNCTION dsm_auto_oldas ""
 /begin OUT_MEASUREMENT DSM_FCM_mp Fid_ACCIRevErr_mp Fid_AccPedBrkPres_mp Fid_AccPedVel_mp Fid_AccPed_Brk_mp Fid_AccPed_mp Fid_ACCRevErr_mp Fid_ACCtl_ACTrqErr_mp Fid_ACCtl_CTSErr_mp Fid_ACCtl_FanErr_mp Fid_ACCtl_TGearbxErr_mp Fid_ACCtl_VSSErr_mp Fid_ACC_AliveErr_mp Fid_ACC_CanDef_mp Fid_ACC_CsErr_mp Fid_ACC_TiOutErr_mp Fid_AFSCD2_mp Fid_AFSCD_AirPerCyl2_mp Fid_AFSCD_AirPerCyl_mp Fid_AFSCD_AirPerTime2_mp Fid_AFSCD_AirPerTime_mp Fid_AFSCD_BPSCDErr_mp Fid_AFSCD_mp Fid_AFSCD_PlAirPerCylDifOff_mp Fid_AFSCD_PlOffsDrft2_mp Fid_AFSCD_PlOffsDrft_mp Fid_AFSCD_PlSetyDrft2_mp Fid_AFSCD_PlSetyDrft_mp Fid_AFSCD_SRCCorrAirm2_mp Fid_AFSCD_SRCCorrAirm_mp Fid_AFSCD_SRCDcyc2_mp Fid_AFSCD_SRCDcyc_mp Fid_AFSCD_SRCRawAirm2_mp Fid_AFSCD_SRCRawAirm_mp Fid_AFSCD_SRCRefSig2_mp Fid_AFSCD_SRCRefSig_mp Fid_AFSCD_tAir1_mp Fid_AFSCD_tAir2_mp Fid_AirCtlCorrAlt_mp Fid_AirCtlDyn_mp Fid_AirCtlNeg2_mp Fid_AirCtlNeg_mp Fid_AirCtlPFltEGRRed_mp Fid_AirCtlPlateBreakAct_mp Fid_AirCtlPlateBreak_mp Fid_AirCtlPos2_mp Fid_AirCtlPos_mp Fid_AirCtl_Brk_mp Fid_AirCtl_Gear_mp Fid_AirCtl_mp Fid_AOHt_AltErr_mp Fid_AOHt_ShutOffErr_mp Fid_APP1_mp Fid_APP2_mp Fid_APPKickdown_mp Fid_APSCD_mp Fid_ARSOff_mp Fid_ASDdc_mp Fid_ASModSwtOffEng_mp Fid_ASModSwtOffIndVol_mp Fid_BPSCDMon_mp Fid_ClgDynTst_mp Fid_CmbChb_mp Fid_CoDT_GripDeb_mp Fid_CoDT_Mon_mp Fid_CoDT_TRQ_mp Fid_CoEngIRevSys1_mp Fid_CoEngIRevSys2_mp Fid_CoEngIRevVeh_mp Fid_CoEngPFltErr_mp Fid_CoEngPFltOvldErr_mp Fid_CoEngRevSys1_mp Fid_CoEngRevSys2_mp Fid_CoEngRevVeh_mp Fid_CoEngShOffTst_mp Fid_CoEngSoftShOffTV_mp Fid_CoEng_ActrPrt_mp Fid_CoEng_Nrml2Strt_mp Fid_CoEng_PwrStgEnable_mp Fid_CoEng_trqLimErr1_mp Fid_CoEng_trqLimErr2_mp Fid_CoEng_trqLimErr3_mp Fid_CoEng_trqLimErr4_mp Fid_CoEng_trqLimErr_mp Fid_CoVehtrqLimErr_mp Fid_CoVM_StabDem_Err_mp Fid_CpBVlvOff_mp Fid_CrCtlShutOffIr_mp Fid_CrCtl_ASCTimeout_mp Fid_CrCtl_CanDef_mp Fid_CrCtl_KombiTimeout_mp Fid_CrCtl_vCrCtl_mp Fid_CTSCDFlTemp_mp Fid_CTSCD_Plaus_mp Fid_DSM_Wuc_mp Fid_EATSCDTSubs_mp Fid_EBAFCD_mp Fid_EBFCD_mp Fid_ECU_mp Fid_EGSysCoLSU0_mp Fid_EGSysCoNSC_mp Fid_EGSysCoOxi_mp Fid_EGSysCoTrbn_mp Fid_EGSysCoTube0_mp Fid_EGSysCoTube1_mp Fid_EGSysHtgDel_mp Fid_EGSysMaxTOxiPreB1_mp Fid_EGSysMaxTOxiPreB2_mp Fid_EGSysMaxTPreB1_mp Fid_EGSysMaxTPreB2_mp Fid_EGSysMaxTPreRgnB1_mp Fid_EGSysMaxTPreRgnB2_mp Fid_EGSysMxTOxiPreRgnB1_mp Fid_EGSysMxTOxiPreRgnB2_mp Fid_EGSysNSC_mp Fid_EGSysOxiCat_mp Fid_EGSysPresEnv_mp Fid_EGSysStrt_mp Fid_EGSysTemp_mp Fid_EGSysTrbn_mp Fid_EGSysTube_mp Fid_EGSys_AP_mp Fid_EGTRgnLck_mp Fid_EGTTempGvnrAirCtl_mp Fid_EGTTempGvnrInrB1_mp Fid_EGTTempGvnrInrB2_mp Fid_EGTTempGvnrOutrB1_mp Fid_EGTTempGvnrOutrB2_mp Fid_EngCTSCD_mp Fid_EngMCaS1_mp Fid_EngMCaSBackUp_mp Fid_EngMCrS1_mp Fid_EngMCrSBackUp_mp Fid_EngMTEng_mp Fid_EngMTrqFrcPDiff_mp Fid_EngMVVeh_mp Fid_EngM_ChkStrtSpd_mp Fid_EngPrt_nLimErr_mp Fid_ETClbCorActv_mp Fid_FanCtl_mp Fid_FanGbxOil_mp Fid_FBCMonI_mp Fid_FBC_mp Fid_FlMngFullLdRglOff_mp Fid_FlMngSmkDefect_mp Fid_FlMngTPFltErr_mp Fid_FlSysCTSSens_mp Fid_FlSysDens_mp Fid_FlSysFTSSens_mp Fid_FMASwtOff1_mp Fid_FMASwtOff2_mp Fid_FMASwtOff3_mp Fid_FMTC_AirCorr_mp Fid_FMTC_PCRCorr_mp Fid_FMTC_SOECorr_mp Fid_FrmMngAddLevl_mp Fid_FrmMngAOHt_mp Fid_FrmMngAPP_mp Fid_FrmMngARS_mp Fid_FrmMngBrkDef_mp Fid_FrmMngBrk_mp Fid_FrmMngCoEng_mp Fid_FrmMngCoEng_St2_mp Fid_FrmMngConvDef_mp Fid_FrmMngEngOvrSpd_mp Fid_FrmMngEngRpmTemp_mp Fid_FrmMngEngSpd_mp Fid_FrmMngInjDU1_mp Fid_FrmMngInjDU2_mp Fid_FrmMngInjVlv_mp Fid_FrmMngnSetpoint_mp Fid_FrmMngOBDCtl_mp Fid_FrmMngParkConsumer_mp Fid_FrmMngPFltDef_mp Fid_FrmMngPla_DSC_mp Fid_FrmMngPla_EGS_mp Fid_FrmMngPowerTrainCAN_mp Fid_FrmMngPrvCan_mp Fid_FrmMngpVal_mp Fid_FrmMngPwrMngLIGovSt_mp Fid_FrmMngRpmRduc_mp Fid_FrmMngSIG_ARS_mp Fid_FrmMngSIG_DSC_mp Fid_FrmMngSig_EGS_mp Fid_FrmMngtEng_mp Fid_FrmMngTO_ARS_mp Fid_FrmMngTO_DSC_mp Fid_FrmMngTo_EGS_mp Fid_FrmMngTrqGearbx_mp Fid_FrmMngWaterVlv_mp Fid_FrmMng_stTrq_mp Fid_FrmMng_ST_TORQ_mp Fid_FTSCDErr_mp Fid_GearbxDrvAwayInactv_mp Fid_GearbxDrvAway_mp Fid_GearbxNmin_mp Fid_GearbxPtCANErr_mp Fid_GearbxSlip_mp Fid_GearbxTrqLimErr_mp Fid_Gearbx_GearDet_mp Fid_Gearbx_TrqIntv_Err_mp Fid_GlwCtl1_mp Fid_GlwCtl2_mp Fid_GlwCtl3_mp Fid_HDC_mp Fid_IATSCD_mp Fid_IATSCD_tAir1_mp Fid_IATSCD_tAir2_mp Fid_IndSys1_mp Fid_IndSys2_mp Fid_InjCrvCoErr_mp Fid_InjCrvCylOffs_mp Fid_InjCtl_qLimErr_mp Fid_InjVCDActrEnrgTemp_mp Fid_InjVCDCls_mp Fid_InjVCDTPUErr_mp Fid_InjVlvActrTemp_mp Fid_InjVlvInjLim_mp Fid_InjVlvMon_mp Fid_InjVlvNVC_mp Fid_InjVlvSetUpVolt_mp Fid_InjVlvWvCorOff_mp Fid_Layer_FI_TANS_mp Fid_Layer_FI_TUMG_mp Fid_Layer_MANHYDR_mp Fid_Layer_MANLUFT_mp Fid_LIGovSetpointDrvAwy_mp Fid_LIGovUbr_mp Fid_LSUCDactiv0_mp Fid_LSUCDlsu0_mp Fid_LSUCDMon0_mp Fid_LSUCDO20_mp Fid_LSUCDRi0_mp Fid_LSUClbSched_mp Fid_LSUCtl0_mp Fid_LSUMonAllChecks_mp Fid_LSUMonPlausChk_mp Fid_MeUnCDCalcI_mp Fid_Mil_mp Fid_MSCDPrivCan_mp Fid_MSidCD_ECU_mp Fid_MSidCD_Pin_mp Fid_MSMonNetMngPtCan_mp Fid_MSMonPFlt1_mp Fid_MSMonPFlt2_mp Fid_MSMonPFlt3_mp Fid_MSMonPFlt4_mp Fid_MSMonStEGS_mp Fid_MSMon_ARS_TO_mp Fid_MSMon_CanDef_mp Fid_MSMon_DSC_TO_mp Fid_MSMon_EGS_TO_mp Fid_MSMon_FrmMngPT2_mp Fid_MSMon_FrmMngPT_mp Fid_MSMon_trqOff_mp Fid_OTSCD_mp Fid_OxiCat_pPreCat_mp Fid_PCBSPFltDef_mp Fid_PCRBalGvnrP40Corr_mp Fid_PCRBalGvnr_mp Fid_PCRExtnLimActr_mp Fid_PCRGvnrDvtNeg_mp Fid_PCRGvnrDvtPos_mp Fid_PCRLPGvnrDvtNeg_mp Fid_PCRLPGvnrDvtPos_mp Fid_PCRSurgeGvnr_mp Fid_PCRSurgeLIGov_mp Fid_PCR_LPMS_mp Fid_PCR_LP_mp Fid_PCR_mp Fid_PCR_MS_mp Fid_PCR_SurgeDet_mp Fid_PCVCDCalcI_mp Fid_PFltAshCorRgn_mp Fid_PFltAshCor_mp Fid_PFltBrk_mp Fid_PFltCharB1_mp Fid_PFltCharB2_mp Fid_PFltChngParB1_mp Fid_PFltChngParB2_mp Fid_PFltClth_mp Fid_PFltDynChkB1_mp Fid_PFltDynChkB2_mp Fid_PFltEngPrtRgnMon_mp Fid_PFltGearDet_mp Fid_PFltHsLnChkB1_mp Fid_PFltHsLnChkB2_mp Fid_PFltLckRgnErr_mp Fid_PFltLckRgnFuel_mp Fid_PFltNumPFltErrLck_mp Fid_PFltNumPFltErr_mp Fid_PFltPlausPresB1_mp Fid_PFltPlausPresB2_mp Fid_PFltPlausTempB1_mp Fid_PFltPlausTempB2_mp Fid_PFltPresPlausProj_mp Fid_PFltPresSensFrz_mp Fid_PFltPresSensHsLnB1_mp Fid_PFltPresSensHsLnB2_mp Fid_PFltPresSensPreB1_mp Fid_PFltPresSensPreB2_mp Fid_PFltSimOnB1_mp Fid_PFltSimOnB2_mp Fid_PFltSpdVeh_mp Fid_PFltSRCPresB1_mp Fid_PFltSRCPresB2_mp Fid_PFltSRCTempB1_mp Fid_PFltSRCTempB2_mp Fid_PFltSucB1_mp Fid_PFltSucB2_mp Fid_PFltTempAir_mp Fid_PFltTempClnt_mp Fid_PFltTempOxiPreB1_mp Fid_PFltTempOxiPreB2_mp Fid_PFltTempOxiPstB1_mp Fid_PFltTempOxiPstB2_mp Fid_PFltTempPreB1_mp Fid_PFltTempPreB2_mp Fid_PFltTempSensB1_mp Fid_PFltTempSensB2_mp Fid_PFltTempSensFrz_mp Fid_PFltTOxiPreDiffB1_mp Fid_PFltTOxiPreDiffB2_mp Fid_PFltTPreDiffB1_mp Fid_PFltTPreDiffB2_mp Fid_PFltTwFlwTempDev_mp Fid_PFltVltgBatt_mp Fid_RailCDRPSErrChk_mp Fid_RailCDSubstVal_mp Fid_RailCD_PMonStrt_mp Fid_RailCPCtlMeUnMode_mp Fid_RailCPCtlPCVMode_mp Fid_RailCtlMode_mp Fid_RailMeUn0Blk_mp Fid_RailMeUn0Rls_mp Fid_RailMeUn1Blk_mp Fid_RailMeUn1Rls_mp Fid_RailMeUn2Blk_mp Fid_RailMeUn2Rls_mp Fid_RailMeUn3Blk_mp Fid_RailMeUn3Rls_mp Fid_RailMeUn4Blk_mp Fid_RailMeUn4Rls_mp Fid_RailMeUnCtlMode_mp Fid_RailPCV0Blk_mp Fid_RailPCV0Rls_mp Fid_RailPCV1Blk_mp Fid_RailPCV1Rls_mp Fid_RailPCV2Blk_mp Fid_RailPCV2Rls_mp Fid_RailPCV3Blk_mp Fid_RailPCV3Rls_mp Fid_RailPCV4Blk_mp Fid_RailPCV4Rls_mp Fid_RailPCV5Blk_mp Fid_RailPCV5Rls_mp Fid_RailPCVCtlMode_mp Fid_RailSetPointLim_mp Fid_RailSetPointRed_mp Fid_SignalsTstNLim_mp Fid_StSysImmo_mp Fid_StSysStrtTipGbxDat_mp Fid_SysLamp_mp Fid_T15CDCanError_mp Fid_T50CDSig_mp Fid_ThrVlvMon_mp Fid_TVACD_AirMonOff_mp Fid_VehDaDist_mp Fid_VSACDDioInDia_mp Fid_VSSCD_Tx_mp Fid_ZFCClbActv_mp Fid_ZFCCldCmbCham_mp /end OUT_MEASUREMENT
/end FUNCTION
/begin COMPU_METHOD OneToOne "eins zu eins (physikalischer Wert ist gleich dem internen Wert)" RAT_FUNC "%6.2" "-" COEFFS 0 1 0 0 0 1 /end COMPU_METHOD
/begin COMPU_METHOD Time_ms "Zeit in ms für Fehlerentprellung (DSM) und SW-Timer" RAT_FUNC "%6.1" "ms" COEFFS 0 0.1 0 0 0 1 /end COMPU_METHOD
/begin RECORD_LAYOUT Kw_Wu16 FNC_VALUES 1 UWORD COLUMN_DIR DIRECT /end RECORD_LAYOUT
/end MODULE
/end PROJECT
