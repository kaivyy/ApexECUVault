ASAP2_VERSION 1 3
/begin PROJECT P390 "BMW DDE6.2 6-Zylinder VR0.1 15.03.2004 CAN11/12H"
/begin HEADER "" VERSION "VR0.1_6Z_CAN11/12H" PROJECT_NO P390 /end HEADER
/begin MODULE DIM ""
/begin MOD_COMMON "" BYTE_ORDER MSB_FIRST ALIGNMENT_BYTE 1 ALIGNMENT_WORD 2 ALIGNMENT_LONG 4 ALIGNMENT_FLOAT32_IEEE 4 /end MOD_COMMON
/begin CHARACTERISTIC ANZMRKAUS "wie oft die anzeige ausgeschalten wird" VALUE 0xC05BC KwWU8 255.0 dez 0.00 255.0 FORMAT "%5.1" /end CHARACTERISTIC
/begin CHARACTERISTIC ANZMRKMX "max. zulässige anzahl von geschwindigkeits- marken beim stufentempomat" VALUE 0xC05BD KwWU8 255.0 dez 0.00 255.0 FORMAT "%5.1" /end CHARACTERISTIC
/begin CHARACTERISTIC CpBVlv_numGear_C "Gang schwellwert" VALUE 0xC8C28 Kw_Ws8 7.000 OneToOne -1.000 6.000 FORMAT "%5.3" EXTENDED_LIMITS -128.0 127.0 /end CHARACTERISTIC
/begin CHARACTERISTIC CpBVlv_qCloseRgn_MAP "Kennfeld für unteren Schwellwert der Kraftstoffmenge bei Regeneration" MAP 0xC8C2A Kf_Xs16_Ys16_Ws16 327.6700 InjMass 0.00 327.6700 FORMAT "%8.4" EXTENDED_LIMITS -327.6800 327.6700
 /begin AXIS_DESCR STD_AXIS Eng_nAvrg EngN 12 0.00 6000.000 FORMAT "%8.3" EXTENDED_LIMITS -32768.00 32767.00 DEPOSIT ABSOLUTE /end AXIS_DESCR
 /begin AXIS_DESCR STD_AXIS APSCD_pVal Pres_hPa 6 0.00 3500.000 FORMAT "%8.3" EXTENDED_LIMITS -32768.00 32767.00 DEPOSIT ABSOLUTE /end AXIS_DESCR
/end CHARACTERISTIC
/begin CHARACTERISTIC CpBVlv_qClose_MAP "MAP unterer schwellwert Kraftstoffmenge" MAP 0xC8CE2 Kf_Xs16_Ys16_Ws16 327.6700 InjMass 0.00 327.6700 FORMAT "%8.4" EXTENDED_LIMITS -327.6800 327.6700
 /begin AXIS_DESCR STD_AXIS Eng_nAvrg EngN 12 0.00 6000.000 FORMAT "%8.3" EXTENDED_LIMITS -32768.00 32767.00 DEPOSIT ABSOLUTE /end AXIS_DESCR
 /begin AXIS_DESCR STD_AXIS APSCD_pVal Pres_hPa 6 0.00 3500.000 FORMAT "%8.3" EXTENDED_LIMITS -32768.00 32767.00 DEPOSIT ABSOLUTE /end AXIS_DESCR
/end CHARACTERISTIC
/begin CHARACTERISTIC CpBVlv_qOpnRgn_MAP "Kennfeld für einen höheren Schwellenwert der Kraftstoffmenge" MAP 0xC8D9A Kf_Xs16_Ys16_Ws16 327.6700 InjMass 0.00 327.6700 FORMAT "%8.4" EXTENDED_LIMITS -327.6800 327.6700
 /begin AXIS_DESCR STD_AXIS Eng_nAvrg EngN 12 0.00 6000.000 FORMAT "%8.3" EXTENDED_LIMITS -32768.00 32767.00 DEPOSIT ABSOLUTE /end AXIS_DESCR
 /begin AXIS_DESCR STD_AXIS APSCD_pVal Pres_hPa 6 0.00 3500.000 FORMAT "%8.3" EXTENDED_LIMITS -32768.00 32767.00 DEPOSIT ABSOLUTE /end AXIS_DESCR
/end CHARACTERISTIC
/begin CHARACTERISTIC CpBVlv_qOpn_MAP "MAP oberer schwellwert Kraftstoffmenge" MAP 0xC8E52 Kf_Xs16_Ys16_Ws16 327.6700 InjMass 0.00 327.6700 FORMAT "%8.4" EXTENDED_LIMITS -327.6800 327.6700
 /begin AXIS_DESCR STD_AXIS Eng_nAvrg EngN 12 0.00 6000.000 FORMAT "%8.3" EXTENDED_LIMITS -32768.00 32767.00 DEPOSIT ABSOLUTE /end AXIS_DESCR
 /begin AXIS_DESCR STD_AXIS APSCD_pVal Pres_hPa 6 0.00 3500.000 FORMAT "%8.3" EXTENDED_LIMITS -32768.00 32767.00 DEPOSIT ABSOLUTE /end AXIS_DESCR
/end CHARACTERISTIC
/begin CHARACTERISTIC CpBVlv_stClose_C "Kompressor-Bypassventil geschlossen" VALUE 0xC8F0A Kw_Wu8 1.000 OneToOne 0.00 1.000 FORMAT "%5.3" EXTENDED_LIMITS 0.00 255.0 /end CHARACTERISTIC
/begin CHARACTERISTIC CpBVlv_stOpn_C "Kompressor-Bypassventil offen" VALUE 0xC8F0B Kw_Wu8 1.000 OneToOne 0.00 1.000 FORMAT "%5.3" EXTENDED_LIMITS 0.00 255.0 /end CHARACTERISTIC
/begin CHARACTERISTIC CpBVlv_stRgnMsk_C "Bit mask for switching off at regeneration" VALUE 0xC8F0C Kw_Wu32 4294967295.00 OneToOne 0.00 4294967295.00 FORMAT "%13.2" /end CHARACTERISTIC
/begin CHARACTERISTIC CpBVlv_swtErrOff_C "mask für shutoff" VALUE 0xC8F10 Kw_Wu8 255.0 OneToOne 0.00 255.0 FORMAT "%5.1" /end CHARACTERISTIC
/begin CHARACTERISTIC CpBVlv_swtQDesVal_C "Auswahlschalter Mengenreferenz (0: derzeitige Menge, 1: Rohmenge)" VALUE 0xC8F11 Kw_Wu8 1.000 OneToOne 0.00 1.000 FORMAT "%5.3" EXTENDED_LIMITS 0.00 255.0 /end CHARACTERISTIC
/begin CHARACTERISTIC CpBVlv_tiRmpSlp_C "Neigungswert für Rampe" VALUE 0xC8F14 Kw_Wu32 31.775030303030302 TimeEGTRmp 0.99296969696969695 32.768000000000001 FORMAT "%19.16" EXTENDED_LIMITS 0.000000015258789066052715 65.536000000000001 /end CHARACTERISTIC
/begin CHARACTERISTIC CrCCD_tiDebMaxMFLDef_C "Defektentprellung Togglebittimeout" VALUE 0xC8F18 Kw_Wu16 655350.0 Time_ms 0.00 655350.0 FORMAT "%8.1" /end CHARACTERISTIC
/begin CHARACTERISTIC CrCCD_tiDebMaxMFLOk_C "Heilentprellung Togglebittimeout" VALUE 0xC8F1A Kw_Wu16 655350.0 Time_ms 0.00 655350.0 FORMAT "%8.1" /end CHARACTERISTIC
/begin CHARACTERISTIC CrCCD_tiDebMinMFLDef_C "Defektentprellung Framelänge außerhalb der Toleranz" VALUE 0xC8F1C Kw_Wu16 655350.0 Time_ms 0.00 655350.0 FORMAT "%8.1" /end CHARACTERISTIC
/begin CHARACTERISTIC CrCCD_tiDebMinMFLOk_C "Heilentprellung Framelänge außerhalb der Toleranz" VALUE 0xC8F1E Kw_Wu16 655350.0 Time_ms 0.00 655350.0 FORMAT "%8.1" /end CHARACTERISTIC
/begin CHARACTERISTIC CrCCD_tiDebNplMFLDef_C "Defektentprellung MFL-Signal nicht plausibel (Biterror)" VALUE 0xC8F20 Kw_Wu16 655350.0 Time_ms 0.00 655350.0 FORMAT "%8.1" /end CHARACTERISTIC
/begin CHARACTERISTIC CrCCD_tiDebNplMFLOk_C "Heilentprellung MFL-Signal nicht plausibel (Biterror)" VALUE 0xC8F22 Kw_Wu16 655350.0 Time_ms 0.00 655350.0 FORMAT "%8.1" /end CHARACTERISTIC
/begin CHARACTERISTIC CrCCD_tiDebSigMFLDef_C "Defektentprellung MFL-Signal Timeout" VALUE 0xC8F24 Kw_Wu16 655350.0 Time_ms 0.00 655350.0 FORMAT "%8.1" /end CHARACTERISTIC
/begin CHARACTERISTIC CrCCD_tiDebSigMFLOk_C "Heilentprellung MFL-Signal Timeout" VALUE 0xC8F26 Kw_Wu16 655350.0 Time_ms 0.00 655350.0 FORMAT "%8.1" /end CHARACTERISTIC
/begin CHARACTERISTIC CrCCD_stMSWModeAdjMax_C "Maximalwert vom Abgleichwert Mainswitch Mode" VALUE 0xC8F28 Kw_Wu8 1.000 OneToOne 0.00 1.000 FORMAT "%5.3" EXTENDED_LIMITS 0.00 255.0 /end CHARACTERISTIC
/begin CHARACTERISTIC CrCCD_stMSWModeAdjMin_C "Minimalwert vom Abgleichwert Mainswitch Mode" VALUE 0xC8F29 Kw_Wu8 1.000 OneToOne 0.00 1.000 FORMAT "%5.3" EXTENDED_LIMITS 0.00 255.0 /end CHARACTERISTIC
/begin CHARACTERISTIC CrCCD_stMSWModeDflt_C "Vorgabewert für Abgleichwert Mainswitch Mode bei fehlgeschlagener EEPROM Kommunikation" VALUE 0xC8F2A Kw_Wu8 1.000 OneToOne 0.00 1.000 FORMAT "%5.3" EXTENDED_LIMITS 0.00 255.0 /end CHARACTERISTIC
/begin CHARACTERISTIC CrCCD_swtDevType_C "SW-Schalter Typ für CrCCD_swtDev" VALUE 0xC8F2B Kw_Wu8 1.000 OneToOne 0.00 1.000 FORMAT "%5.3" EXTENDED_LIMITS 0.00 255.0 /end CHARACTERISTIC
/begin CHARACTERISTIC CrCCD_swtDevVal_C "Datensatzwert für SW-Schalter CrCCD_swtDev, eingebauter FGR-Bedienteiltyp (0: kein bedienteil, 1: TPU, 2: CAN)" VALUE 0xC8F2C Kw_Wu8 2.000 OneToOne 0.00 2.000 FORMAT "%5.3" EXTENDED_LIMITS 0.00 255.0 /end CHARACTERISTIC
/begin CHARACTERISTIC CrCCD_swtMSWType_C "MSW Mode vom EEPROM (1) oder Applikation (0)" VALUE 0xC8F2D Kw_Wu8 1.000 OneToOne 0.00 1.000 FORMAT "%5.3" EXTENDED_LIMITS 0.00 255.0 /end CHARACTERISTIC
/begin CHARACTERISTIC CrCCD_swtMSWVal_C "MSW Mode von der Applikation (1: MSW aktiviert, 0: MSW deaktiviert)" VALUE 0xC8F2E Kw_Wu8 1.000 OneToOne 0.00 1.000 FORMAT "%5.3" EXTENDED_LIMITS 0.00 255.0 /end CHARACTERISTIC
/begin CHARACTERISTIC CrCCD_tiDebSetMn_C "time for SET- detection" VALUE 0xC8F30 Kw_Wu16 1500.000 Time_ms 0.00 1500.000 FORMAT "%8.3" EXTENDED_LIMITS 0.00 655350.0 /end CHARACTERISTIC
/begin CHARACTERISTIC CrCCD_tiDebSetPl_C "time for SET+ detection" VALUE 0xC8F32 Kw_Wu16 1500.000 Time_ms 0.00 1500.000 FORMAT "%8.3" EXTENDED_LIMITS 0.00 655350.0 /end CHARACTERISTIC
/begin CHARACTERISTIC CrCCD_tiToggleMax_C "Maximalzeit bis Togglebitwechsel erfolgt sein muß" VALUE 0xC8F34 Kw_Wu16 1500.000 Time_ms 0.00 1500.000 FORMAT "%8.3" EXTENDED_LIMITS 0.00 655350.0 /end CHARACTERISTIC
/begin CHARACTERISTIC CrCtl_aAccLim_C "Minimal erlaubte Fahrzeugbeschleunigung für Übergang von SET+ zu HOLD" VALUE 0xC8F70 Kw_Ws16 10.00000 Acc 0.00 10.00000 FORMAT "%8.5" EXTENDED_LIMITS -32.76800 32.76700 /end CHARACTERISTIC
/begin CHARACTERISTIC CrCtl_aAccMax_C "Fahrzeugbeschleunigungsschwelle für CrCtl-Abschaltbedingung ""zu große Fahrzeugbeschleunigung""" VALUE 0xC8F38 Kw_Ws16 42.76800 Acc -32.76800 10.00000 FORMAT "%8.5" EXTENDED_LIMITS -32.76800 32.76700 /end CHARACTERISTIC
/begin CHARACTERISTIC CrCtl_AccGear2PKp_C "P-Reglerparametersatz für Beschleunigung 2.Gang" VALUE 0xC8F74 Kw_Wu32 1310719.99969 Kp_Vel2TrqPrp 0.00 1310719.99969 FORMAT "%13.5" /end CHARACTERISTIC
/begin CHARACTERISTIC CrCtl_AccGear2PKpPos_C "P-Reglerparametersatz für Beschleunigung 2.Gang" VALUE 0xC8F78 Kw_Wu32 1310719.99969 Kp_Vel2TrqPrp 0.00 1310719.99969 FORMAT "%13.5" /end CHARACTERISTIC
/begin CHARACTERISTIC CrCtl_AccGear2PKpNeg_C "P-Reglerparametersatz für Beschleunigung 2.Gang" VALUE 0xC8F7C Kw_Wu32 1310719.99969 Kp_Vel2TrqPrp 0.00 1310719.99969 FORMAT "%13.5" /end CHARACTERISTIC
/begin CHARACTERISTIC CrCtl_vAccGear2PWinPos_C "P-Reglerparametersatz für Beschleunigung 2.Gang" VALUE 0xC8F80 Kw_Ws16 300.0000 Vel 0.00 300.0000 FORMAT "%8.4" EXTENDED_LIMITS -327.6800 327.6700 /end CHARACTERISTIC
/begin CHARACTERISTIC CrCtl_vAccGear2PWinNeg_C "P-Reglerparametersatz für Beschleunigung 2.Gang" VALUE 0xC8F82 Kw_Ws16 300.0000 Vel -300.0000 0.00 FORMAT "%8.4" EXTENDED_LIMITS -327.6800 327.6700 /end CHARACTERISTIC
/begin CHARACTERISTIC CrCtl_AccGear3PKp_C "P-Reglerparametersatz für Beschleunigung 3.Gang" VALUE 0xC8F84 Kw_Wu32 1310719.99969 Kp_Vel2TrqPrp 0.00 1310719.99969 FORMAT "%13.5" /end CHARACTERISTIC
/begin CHARACTERISTIC CrCtl_AccGear3PKpPos_C "P-Reglerparametersatz für Beschleunigung 3.Gang" VALUE 0xC8F88 Kw_Wu32 1310719.99969 Kp_Vel2TrqPrp 0.00 1310719.99969 FORMAT "%13.5" /end CHARACTERISTIC
/begin CHARACTERISTIC CrCtl_AccGear3PKpNeg_C "P-Reglerparametersatz für Beschleunigung 3.Gang" VALUE 0xC8F8C Kw_Wu32 1310719.99969 Kp_Vel2TrqPrp 0.00 1310719.99969 FORMAT "%13.5" /end CHARACTERISTIC
/begin CHARACTERISTIC CrCtl_vAccGear3PWinPos_C "P-Reglerparametersatz für Beschleunigung 3.Gang" VALUE 0xC8F90 Kw_Ws16 300.0000 Vel 0.00 300.0000 FORMAT "%8.4" EXTENDED_LIMITS -327.6800 327.6700 /end CHARACTERISTIC
/begin CHARACTERISTIC CrCtl_vAccGear3PWinNeg_C "P-Reglerparametersatz für Beschleunigung 3.Gang" VALUE 0xC8F92 Kw_Ws16 300.0000 Vel -300.0000 0.00 FORMAT "%8.4" EXTENDED_LIMITS -327.6800 327.6700 /end CHARACTERISTIC
/begin CHARACTERISTIC CrCtl_AccGear4PKp_C "P-Reglerparametersatz für Beschleunigung 4.Gang" VALUE 0xC8F94 Kw_Wu32 1310719.99969 Kp_Vel2TrqPrp 0.00 1310719.99969 FORMAT "%13.5" /end CHARACTERISTIC
/begin CHARACTERISTIC CrCtl_AccGear4PKpPos_C "P-Reglerparametersatz für Beschleunigung 4.Gang" VALUE 0xC8F98 Kw_Wu32 1310719.99969 Kp_Vel2TrqPrp 0.00 1310719.99969 FORMAT "%13.5" /end CHARACTERISTIC
/begin CHARACTERISTIC CrCtl_AccGear4PKpNeg_C "P-Reglerparametersatz für Beschleunigung 4.Gang" VALUE 0xC8F9C Kw_Wu32 1310719.99969 Kp_Vel2TrqPrp 0.00 1310719.99969 FORMAT "%13.5" /end CHARACTERISTIC
/begin CHARACTERISTIC CrCtl_vAccGear4PWinPos_C "P-Reglerparametersatz für Beschleunigung 4.Gang" VALUE 0xC8FA0 Kw_Ws16 300.0000 Vel 0.00 300.0000 FORMAT "%8.4" EXTENDED_LIMITS -327.6800 327.6700 /end CHARACTERISTIC
/begin CHARACTERISTIC CrCtl_vAccGear4PWinNeg_C "P-Reglerparametersatz für Beschleunigung 4.Gang" VALUE 0xC8FA2 Kw_Ws16 300.0000 Vel -300.0000 0.00 FORMAT "%8.4" EXTENDED_LIMITS -327.6800 327.6700 /end CHARACTERISTIC
/begin CHARACTERISTIC CrCtl_AccGear5PKp_C "P-Reglerparametersatz für Beschleunigung 5.Gang" VALUE 0xC8FA4 Kw_Wu32 1310719.99969 Kp_Vel2TrqPrp 0.00 1310719.99969 FORMAT "%13.5" /end CHARACTERISTIC
/begin CHARACTERISTIC CrCtl_AccGear5PKpPos_C "P-Reglerparametersatz für Beschleunigung 5.Gang" VALUE 0xC8FA8 Kw_Wu32 1310719.99969 Kp_Vel2TrqPrp 0.00 1310719.99969 FORMAT "%13.5" /end CHARACTERISTIC
/begin CHARACTERISTIC CrCtl_AccGear5PKpNeg_C "P-Reglerparametersatz für Beschleunigung 5.Gang" VALUE 0xC8FAC Kw_Wu32 1310719.99969 Kp_Vel2TrqPrp 0.00 1310719.99969 FORMAT "%13.5" /end CHARACTERISTIC
/begin CHARACTERISTIC CrCtl_vAccGear5PWinPos_C "P-Reglerparametersatz für Beschleunigung 5.Gang" VALUE 0xC8FB0 Kw_Ws16 300.0000 Vel 0.00 300.0000 FORMAT "%8.4" EXTENDED_LIMITS -327.6800 327.6700 /end CHARACTERISTIC
/begin CHARACTERISTIC CrCtl_vAccGear5PWinNeg_C "P-Reglerparametersatz für Beschleunigung 5.Gang" VALUE 0xC8FB2 Kw_Ws16 300.0000 Vel -300.0000 0.00 FORMAT "%8.4" EXTENDED_LIMITS -327.6800 327.6700 /end CHARACTERISTIC
/begin CHARACTERISTIC CrCtl_AccGear6PKp_C "P-Reglerparametersatz für Beschleunigung 6.Gang" VALUE 0xC8FB4 Kw_Wu32 1310719.99969 Kp_Vel2TrqPrp 0.00 1310719.99969 FORMAT "%13.5" /end CHARACTERISTIC
/begin CHARACTERISTIC CrCtl_AccGear6PKpPos_C "P-Reglerparametersatz für Beschleunigung 6.Gang" VALUE 0xC8FB8 Kw_Wu32 1310719.99969 Kp_Vel2TrqPrp 0.00 1310719.99969 FORMAT "%13.5" /end CHARACTERISTIC
/begin CHARACTERISTIC CrCtl_AccGear6PKpNeg_C "P-Reglerparametersatz für Beschleunigung 6.Gang" VALUE 0xC8FBC Kw_Wu32 1310719.99969 Kp_Vel2TrqPrp 0.00 1310719.99969 FORMAT "%13.5" /end CHARACTERISTIC
/begin CHARACTERISTIC CrCtl_vAccGear6PWinPos_C "P-Reglerparametersatz für Beschleunigung 6.Gang" VALUE 0xC8FC0 Kw_Ws16 300.0000 Vel 0.00 300.0000 FORMAT "%8.4" EXTENDED_LIMITS -327.6800 327.6700 /end CHARACTERISTIC
/begin CHARACTERISTIC CrCtl_vAccGear6PWinNeg_C "P-Reglerparametersatz für Beschleunigung 6.Gang" VALUE 0xC8FC2 Kw_Ws16 300.0000 Vel -300.0000 0.00 FORMAT "%8.4" EXTENDED_LIMITS -327.6800 327.6700 /end CHARACTERISTIC
/begin CHARACTERISTIC CrCtl_aDeclLim_C "neg. Beschleunigungsschwelle Übergang EIN- zu HALTEN" VALUE 0xC8FC4 Kw_Ws16 10.00000 Acc -10.00000 0.00 FORMAT "%8.5" EXTENDED_LIMITS -32.76800 32.76700 /end CHARACTERISTIC
/begin CHARACTERISTIC CrCtl_aDecMax_C "max. zulässige neg. Beschleunigung für Abschaltung FGR" VALUE 0xC8F3A Kw_Ws16 32.76800 Acc -32.76800 0.00 FORMAT "%8.5" EXTENDED_LIMITS -32.76800 32.76700 /end CHARACTERISTIC
/begin CHARACTERISTIC CrCtl_ctMaxTip_C "Maximal erlaubte Tipanzahl ohne Erreichen der Sollgeschwindigkeit" VALUE 0xC8FC6 Kw_Wu8 100.0 OneToOne 0.00 100.0 FORMAT "%5.1" EXTENDED_LIMITS 0.00 255.0 /end CHARACTERISTIC
/begin CHARACTERISTIC CrCtl_DebToVCrCtlDef_C "dfhjdghkj" VALUE 0xC94C8 Kw_Wu16 65535.00 OneToOne 0.00 65535.00 FORMAT "%8.2" /end CHARACTERISTIC
/begin CHARACTERISTIC CrCtl_DebToVCrCtlOk_C " Healing time for CrCtl_-messages Timeout" VALUE 0xC94CA Kw_Wu16 65535.00 OneToOne 0.00 65535.00 FORMAT "%8.2" /end CHARACTERISTIC
/begin CHARACTERISTIC CrCtl_DeclGear2PKp_C "P-Reglerparametersatz für Verzögerung 2.Gang" VALUE 0xC8FC8 Kw_Wu32 1310719.99969 Kp_Vel2TrqPrp 0.00 1310719.99969 FORMAT "%13.5" /end CHARACTERISTIC
/begin CHARACTERISTIC CrCtl_DeclGear2PKpPos_C "P-Reglerparametersatz für Verzögerung 2.Gang" VALUE 0xC8FCC Kw_Wu32 1310719.99969 Kp_Vel2TrqPrp 0.00 1310719.99969 FORMAT "%13.5" /end CHARACTERISTIC
/begin CHARACTERISTIC CrCtl_DeclGear2PKpNeg_C "P-Reglerparametersatz für Verzögerung 2.Gang" VALUE 0xC8FD0 Kw_Wu32 1310719.99969 Kp_Vel2TrqPrp 0.00 1310719.99969 FORMAT "%13.5" /end CHARACTERISTIC
/begin CHARACTERISTIC CrCtl_vDeclGear2PWinPos_C "P-Reglerparametersatz für Verzögerung 2.Gang" VALUE 0xC8FD4 Kw_Ws16 300.0000 Vel 0.00 300.0000 FORMAT "%8.4" EXTENDED_LIMITS -327.6800 327.6700 /end CHARACTERISTIC
/begin CHARACTERISTIC CrCtl_vDeclGear2PWinNeg_C "P-Reglerparametersatz für Verzögerung 2.Gang" VALUE 0xC8FD6 Kw_Ws16 300.0000 Vel -300.0000 0.00 FORMAT "%8.4" EXTENDED_LIMITS -327.6800 327.6700 /end CHARACTERISTIC
/begin CHARACTERISTIC CrCtl_DeclGear3PKp_C "P-Reglerparametersatz für Verzögerung 3.Gang" VALUE 0xC8FD8 Kw_Wu32 1310719.99969 Kp_Vel2TrqPrp 0.00 1310719.99969 FORMAT "%13.5" /end CHARACTERISTIC
/begin CHARACTERISTIC CrCtl_DeclGear3PKpPos_C "P-Reglerparametersatz für Verzögerung 3.Gang" VALUE 0xC8FDC Kw_Wu32 1310719.99969 Kp_Vel2TrqPrp 0.00 1310719.99969 FORMAT "%13.5" /end CHARACTERISTIC
/begin CHARACTERISTIC CrCtl_DeclGear3PKpNeg_C "P-Reglerparametersatz für Verzögerung 3.Gang" VALUE 0xC8FE0 Kw_Wu32 1310719.99969 Kp_Vel2TrqPrp 0.00 1310719.99969 FORMAT "%13.5" /end CHARACTERISTIC
/begin CHARACTERISTIC CrCtl_vDeclGear3PWinPos_C "P-Reglerparametersatz für Verzögerung 3.Gang" VALUE 0xC8FE4 Kw_Ws16 300.0000 Vel 0.00 300.0000 FORMAT "%8.4" EXTENDED_LIMITS -327.6800 327.6700 /end CHARACTERISTIC
/begin CHARACTERISTIC CrCtl_vDeclGear3PWinNeg_C "P-Reglerparametersatz für Verzögerung 3.Gang" VALUE 0xC8FE6 Kw_Ws16 300.0000 Vel -300.0000 0.00 FORMAT "%8.4" EXTENDED_LIMITS -327.6800 327.6700 /end CHARACTERISTIC
/begin CHARACTERISTIC CrCtl_DeclGear4PKp_C "P-Reglerparametersatz für Verzögerung 4.Gang" VALUE 0xC8FE8 Kw_Wu32 1310719.99969 Kp_Vel2TrqPrp 0.00 1310719.99969 FORMAT "%13.5" /end CHARACTERISTIC
/begin CHARACTERISTIC CrCtl_DeclGear4PKpPos_C "P-Reglerparametersatz für Verzögerung 4.Gang" VALUE 0xC8FEC Kw_Wu32 1310719.99969 Kp_Vel2TrqPrp 0.00 1310719.99969 FORMAT "%13.5" /end CHARACTERISTIC
/begin CHARACTERISTIC CrCtl_DeclGear4PKpNeg_C "P-Reglerparametersatz für Verzögerung 4.Gang" VALUE 0xC8FF0 Kw_Wu32 1310719.99969 Kp_Vel2TrqPrp 0.00 1310719.99969 FORMAT "%13.5" /end CHARACTERISTIC
/begin CHARACTERISTIC CrCtl_vDeclGear4PWinPos_C "P-Reglerparametersatz für Verzögerung 4.Gang" VALUE 0xC8FF4 Kw_Ws16 300.0000 Vel 0.00 300.0000 FORMAT "%8.4" EXTENDED_LIMITS -327.6800 327.6700 /end CHARACTERISTIC
/begin CHARACTERISTIC CrCtl_vDeclGear4PWinNeg_C "P-Reglerparametersatz für Verzögerung 4.Gang" VALUE 0xC8FF6 Kw_Ws16 300.0000 Vel -300.0000 0.00 FORMAT "%8.4" EXTENDED_LIMITS -327.6800 327.6700 /end CHARACTERISTIC
/begin CHARACTERISTIC CrCtl_DeclGear5PKp_C "P-Reglerparametersatz für Verzögerung 5.Gang" VALUE 0xC8FF8 Kw_Wu32 1310719.99969 Kp_Vel2TrqPrp 0.00 1310719.99969 FORMAT "%13.5" /end CHARACTERISTIC
/begin CHARACTERISTIC CrCtl_DeclGear5PKpPos_C "P-Reglerparametersatz für Verzögerung 5.Gang" VALUE 0xC8FFC Kw_Wu32 1310719.99969 Kp_Vel2TrqPrp 0.00 1310719.99969 FORMAT "%13.5" /end CHARACTERISTIC
/begin CHARACTERISTIC CrCtl_DeclGear5PKpNeg_C "P-Reglerparametersatz für Verzögerung 5.Gang" VALUE 0xC9000 Kw_Wu32 1310719.99969 Kp_Vel2TrqPrp 0.00 1310719.99969 FORMAT "%13.5" /end CHARACTERISTIC
/begin CHARACTERISTIC CrCtl_vDeclGear5PWinPos_C "P-Reglerparametersatz für Verzögerung 5.Gang" VALUE 0xC9004 Kw_Ws16 300.0000 Vel 0.00 300.0000 FORMAT "%8.4" EXTENDED_LIMITS -327.6800 327.6700 /end CHARACTERISTIC
/begin CHARACTERISTIC CrCtl_vDeclGear5PWinNeg_C "P-Reglerparametersatz für Verzögerung 5.Gang" VALUE 0xC9006 Kw_Ws16 300.0000 Vel -300.0000 0.00 FORMAT "%8.4" EXTENDED_LIMITS -327.6800 327.6700 /end CHARACTERISTIC
/begin CHARACTERISTIC CrCtl_DeclGear6PKp_C "P-Reglerparametersatz für Verzögerung 6.Gang" VALUE 0xC9008 Kw_Wu32 1310719.99969 Kp_Vel2TrqPrp 0.00 1310719.99969 FORMAT "%13.5" /end CHARACTERISTIC
/begin CHARACTERISTIC CrCtl_DeclGear6PKpPos_C "P-Reglerparametersatz für Verzögerung 6.Gang" VALUE 0xC900C Kw_Wu32 1310719.99969 Kp_Vel2TrqPrp 0.00 1310719.99969 FORMAT "%13.5" /end CHARACTERISTIC
/begin CHARACTERISTIC CrCtl_DeclGear6PKpNeg_C "P-Reglerparametersatz für Verzögerung 6.Gang" VALUE 0xC9010 Kw_Wu32 1310719.99969 Kp_Vel2TrqPrp 0.00 1310719.99969 FORMAT "%13.5" /end CHARACTERISTIC
/begin CHARACTERISTIC CrCtl_vDeclGear6PWinPos_C "P-Reglerparametersatz für Verzögerung 6.Gang" VALUE 0xC9014 Kw_Ws16 300.0000 Vel 0.00 300.0000 FORMAT "%8.4" EXTENDED_LIMITS -327.6800 327.6700 /end CHARACTERISTIC
/begin CHARACTERISTIC CrCtl_vDeclGear6PWinNeg_C "P-Reglerparametersatz für Verzögerung 6.Gang" VALUE 0xC9016 Kw_Ws16 300.0000 Vel -300.0000 0.00 FORMAT "%8.4" EXTENDED_LIMITS -327.6800 327.6700 /end CHARACTERISTIC
/begin CHARACTERISTIC CrCtl_dtrqAccDwn_C "FGR: EIN+: Anstieg Momentenverringerung nach Loslassen EIN+ Taste" VALUE 0xC9018 Kw_Ws16 327670.0 dTrqPrp_20ms 0.00 327670.0 FORMAT "%8.1" EXTENDED_LIMITS -327680.0 327670.0 /end CHARACTERISTIC
/begin CHARACTERISTIC CrCtl_dtrqDeclUp_C "FGR, EIN-: Momentenanstieg nach Loslassen EIN- Taste" VALUE 0xC901A Kw_Ws16 327670.0 dTrqPrp_20ms 0.00 327670.0 FORMAT "%8.1" EXTENDED_LIMITS -327680.0 327670.0 /end CHARACTERISTIC
/begin CHARACTERISTIC CrCtl_dtrqOffComf1_C "Rampensteigung 1 Komfortabschaltung" VALUE 0xC901C Kw_Ws16 327670.0 dTrqPrp_20ms 0.00 327670.0 FORMAT "%8.1" EXTENDED_LIMITS -327680.0 327670.0 /end CHARACTERISTIC
/begin CHARACTERISTIC CrCtl_dtrqOffComf2_C "Rampensteigung 2 Komfortabschaltung" VALUE 0xC901E Kw_Ws16 327670.0 dTrqPrp_20ms 0.00 327670.0 FORMAT "%8.1" EXTENDED_LIMITS -327680.0 327670.0 /end CHARACTERISTIC
/begin CHARACTERISTIC CrCtl_dtrqOffFast1_CUR "Kurve für erste Rampe bei Schnellabschaltung" CURVE 0xC9020 Kl_Xs16_Ws16 327670.0 dTrqPrp_20ms 0.00 327670.0 FORMAT "%8.1" EXTENDED_LIMITS -327680.0 327670.0
 /begin AXIS_DESCR STD_AXIS Gearbx_stGear OneToOne 8 -1.000 6.000 FORMAT "%5.3" EXTENDED_LIMITS -128.0 127.0 DEPOSIT ABSOLUTE /end AXIS_DESCR
/end CHARACTERISTIC
/begin CHARACTERISTIC CrCtl_dtrqOffFast2_CUR "Kurve für zweite Rampe bei Schnellabschaltung" CURVE 0xC9042 Kl_Xs16_Ws16 327670.0 dTrqPrp_20ms 0.00 327670.0 FORMAT "%8.1" EXTENDED_LIMITS -327680.0 327670.0
 /begin AXIS_DESCR STD_AXIS Gearbx_stGear OneToOne 8 -1.000 6.000 FORMAT "%5.3" EXTENDED_LIMITS -128.0 127.0 DEPOSIT ABSOLUTE /end AXIS_DESCR
/end CHARACTERISTIC
/begin CHARACTERISTIC CrCtl_dtrqOffFast3_CUR "Kennfled für dritte Rampe bei Schnellabschaltung" CURVE 0xC9064 Kl_Xs16_Ws16 327670.0 dTrqPrp_20ms 0.00 327670.0 FORMAT "%8.1" EXTENDED_LIMITS -327680.0 327670.0
 /begin AXIS_DESCR STD_AXIS Gearbx_stGear OneToOne 8 -1.000 6.000 FORMAT "%5.3" EXTENDED_LIMITS -128.0 127.0 DEPOSIT ABSOLUTE /end AXIS_DESCR
/end CHARACTERISTIC
/begin CHARACTERISTIC CrCtl_dvAccFDCG3_CUR "Curve for slope of ramp speed in acceleration <= 3th gear" CURVE 0xC9086 Kl_Xs16_Ws16 16383.50 dVel_20ms 0.00 16383.50 FORMAT "%8.2" EXTENDED_LIMITS -16384.00 16383.50
 /begin AXIS_DESCR STD_AXIS CrCtl_vBeg Vel 3 0.00 300.0000 FORMAT "%8.4" EXTENDED_LIMITS -327.6800 327.6700 DEPOSIT ABSOLUTE /end AXIS_DESCR
/end CHARACTERISTIC
/begin CHARACTERISTIC CrCtl_dvAccFDCG4_CUR "Curve for slope of ramp speed in acceleration (EIN+), 4th gear" CURVE 0xC9094 Kl_Xs16_Ws16 16383.50 dVel_20ms 0.00 16383.50 FORMAT "%8.2" EXTENDED_LIMITS -16384.00 16383.50
 /begin AXIS_DESCR STD_AXIS CrCtl_vBeg Vel 3 0.00 300.0000 FORMAT "%8.4" EXTENDED_LIMITS -327.6800 327.6700 DEPOSIT ABSOLUTE /end AXIS_DESCR
/end CHARACTERISTIC
/begin CHARACTERISTIC CrCtl_dvAccFDCG5_CUR "Curve for slope of ramp speed in acceleration (EIN+), 5th gear" CURVE 0xC90A2 Kl_Xs16_Ws16 16383.50 dVel_20ms 0.00 16383.50 FORMAT "%8.2" EXTENDED_LIMITS -16384.00 16383.50
 /begin AXIS_DESCR STD_AXIS CrCtl_vBeg Vel 3 0.00 300.0000 FORMAT "%8.4" EXTENDED_LIMITS -327.6800 327.6700 DEPOSIT ABSOLUTE /end AXIS_DESCR
/end CHARACTERISTIC
/begin CHARACTERISTIC CrCtl_dvAccFDCG6_CUR "Curve for slope of ramp speed in acceleration (EIN+), >= 6th gear" CURVE 0xC90B0 Kl_Xs16_Ws16 16383.50 dVel_20ms 0.00 16383.50 FORMAT "%8.2" EXTENDED_LIMITS -16384.00 16383.50
 /begin AXIS_DESCR STD_AXIS CrCtl_vBeg Vel 3 0.00 300.0000 FORMAT "%8.4" EXTENDED_LIMITS -327.6800 327.6700 DEPOSIT ABSOLUTE /end AXIS_DESCR
/end CHARACTERISTIC
/begin CHARACTERISTIC CrCtl_dvAccG3_CUR "KL Anstieg FGR Rampengeschwindigkeit bei EIN+ für Gang <= 3" CURVE 0xC90BE Kl_Xs16_Ws16 16383.50 dVel_20ms 0.00 16383.50 FORMAT "%8.2" EXTENDED_LIMITS -16384.00 16383.50
 /begin AXIS_DESCR STD_AXIS CrCtl_vBeg Vel 3 0.00 300.0000 FORMAT "%8.4" EXTENDED_LIMITS -327.6800 327.6700 DEPOSIT ABSOLUTE /end AXIS_DESCR
/end CHARACTERISTIC
/begin CHARACTERISTIC CrCtl_dvAccG4_CUR "KL Anstieg FGR Rampengeschwindigkeit bei EIN+ für 4. Gang" CURVE 0xC90CC Kl_Xs16_Ws16 16383.50 dVel_20ms 0.00 16383.50 FORMAT "%8.2" EXTENDED_LIMITS -16384.00 16383.50
 /begin AXIS_DESCR STD_AXIS CrCtl_vBeg Vel 3 0.00 300.0000 FORMAT "%8.4" EXTENDED_LIMITS -327.6800 327.6700 DEPOSIT ABSOLUTE /end AXIS_DESCR
/end CHARACTERISTIC
/begin CHARACTERISTIC CrCtl_dvAccG5_CUR "KL Anstieg FGR Rampengeschwindigkeit bei EIN+ für 5. Gang" CURVE 0xC90DA Kl_Xs16_Ws16 16383.50 dVel_20ms 0.00 16383.50 FORMAT "%8.2" EXTENDED_LIMITS -16384.00 16383.50
 /begin AXIS_DESCR STD_AXIS CrCtl_vBeg Vel 3 0.00 300.0000 FORMAT "%8.4" EXTENDED_LIMITS -327.6800 327.6700 DEPOSIT ABSOLUTE /end AXIS_DESCR
/end CHARACTERISTIC
/begin CHARACTERISTIC CrCtl_dvAccG6_CUR "KL Anstieg FGR Rampengeschwindigkeit bei EIN+ für 6. Gang" CURVE 0xC90E8 Kl_Xs16_Ws16 16383.50 dVel_20ms 0.00 16383.50 FORMAT "%8.2" EXTENDED_LIMITS -16384.00 16383.50
 /begin AXIS_DESCR STD_AXIS CrCtl_vBeg Vel 3 0.00 300.0000 FORMAT "%8.4" EXTENDED_LIMITS -327.6800 327.6700 DEPOSIT ABSOLUTE /end AXIS_DESCR
/end CHARACTERISTIC
/begin CHARACTERISTIC CrCtl_dvDeclFDCG3_CUR "Curve for slope of ramp speed in acceleration (EIN+), >= 3rd gear" CURVE 0xC90F6 Kl_Xs16_Ws16 16383.50 dVel_20ms 0.00 16383.50 FORMAT "%8.2" EXTENDED_LIMITS -16384.00 16383.50
 /begin AXIS_DESCR STD_AXIS CrCtl_vBeg Vel 3 0.00 300.0000 FORMAT "%8.4" EXTENDED_LIMITS -327.6800 327.6700 DEPOSIT ABSOLUTE /end AXIS_DESCR
/end CHARACTERISTIC
/begin CHARACTERISTIC CrCtl_dvDeclFDCG4_CUR "Curve for slope of ramp speed in deceleration (EIN-), 4th gear" CURVE 0xC9104 Kl_Xs16_Ws16 16383.50 dVel_20ms 0.00 16383.50 FORMAT "%8.2" EXTENDED_LIMITS -16384.00 16383.50
 /begin AXIS_DESCR STD_AXIS CrCtl_vBeg Vel 3 0.00 300.0000 FORMAT "%8.4" EXTENDED_LIMITS -327.6800 327.6700 DEPOSIT ABSOLUTE /end AXIS_DESCR
/end CHARACTERISTIC
/begin CHARACTERISTIC CrCtl_dvDeclFDCG5_CUR "curve for ramp slope SET+ 5th gear for sport mode" CURVE 0xC9112 Kl_Xs16_Ws16 16383.50 dVel_20ms 0.00 16383.50 FORMAT "%8.2" EXTENDED_LIMITS -16384.00 16383.50
 /begin AXIS_DESCR STD_AXIS CrCtl_vBeg Vel 3 0.00 300.0000 FORMAT "%8.4" EXTENDED_LIMITS -327.6800 327.6700 DEPOSIT ABSOLUTE /end AXIS_DESCR
/end CHARACTERISTIC
/begin CHARACTERISTIC CrCtl_dvDeclFDCG6_CUR "Curve for slope of ramp speed in deceleration (EIN-), >= 6th gear" CURVE 0xC9120 Kl_Xs16_Ws16 16383.50 dVel_20ms 0.00 16383.50 FORMAT "%8.2" EXTENDED_LIMITS -16384.00 16383.50
 /begin AXIS_DESCR STD_AXIS CrCtl_vBeg Vel 3 0.00 300.0000 FORMAT "%8.4" EXTENDED_LIMITS -327.6800 327.6700 DEPOSIT ABSOLUTE /end AXIS_DESCR
/end CHARACTERISTIC
/begin CHARACTERISTIC CrCtl_dvDeclG3_CUR "KL Abstieg FGR Rampengeschwindigkeit bei EIN- für Gang <= 3" CURVE 0xC912E Kl_Xs16_Ws16 16383.50 dVel_20ms 0.00 16383.50 FORMAT "%8.2" EXTENDED_LIMITS -16384.00 16383.50
 /begin AXIS_DESCR STD_AXIS CrCtl_vBeg Vel 3 0.00 300.0000 FORMAT "%8.4" EXTENDED_LIMITS -327.6800 327.6700 DEPOSIT ABSOLUTE /end AXIS_DESCR
/end CHARACTERISTIC
/begin CHARACTERISTIC CrCtl_dvDeclG4_CUR "KL Abstieg FGR Rampengeschwindigkeit bei EIN- für 4. Gang" CURVE 0xC913C Kl_Xs16_Ws16 16383.50 dVel_20ms 0.00 16383.50 FORMAT "%8.2" EXTENDED_LIMITS -16384.00 16383.50
 /begin AXIS_DESCR STD_AXIS CrCtl_vBeg Vel 3 0.00 300.0000 FORMAT "%8.4" EXTENDED_LIMITS -327.6800 327.6700 DEPOSIT ABSOLUTE /end AXIS_DESCR
/end CHARACTERISTIC
/begin CHARACTERISTIC CrCtl_dvDeclG5_CUR "KL Abstieg FGR Rampengeschwindigkeit bei EIN- für 5. Gang" CURVE 0xC914A Kl_Xs16_Ws16 16383.50 dVel_20ms 0.00 16383.50 FORMAT "%8.2" EXTENDED_LIMITS -16384.00 16383.50
 /begin AXIS_DESCR STD_AXIS CrCtl_vBeg Vel 3 0.00 300.0000 FORMAT "%8.4" EXTENDED_LIMITS -327.6800 327.6700 DEPOSIT ABSOLUTE /end AXIS_DESCR
/end CHARACTERISTIC
/begin CHARACTERISTIC CrCtl_dvDeclG6_CUR "KL Abstieg FGR Rampengeschwindigkeit bei EIN- für 6. Gang" CURVE 0xC9158 Kl_Xs16_Ws16 16383.50 dVel_20ms 0.00 16383.50 FORMAT "%8.2" EXTENDED_LIMITS -16384.00 16383.50
 /begin AXIS_DESCR STD_AXIS CrCtl_vBeg Vel 3 0.00 300.0000 FORMAT "%8.4" EXTENDED_LIMITS -327.6800 327.6700 DEPOSIT ABSOLUTE /end AXIS_DESCR
/end CHARACTERISTIC
/begin CHARACTERISTIC CrCtl_dvResAbvFDCG3_CUR "Curve for slope of set speed ramp RESUME ABOVE, >=3th gear" CURVE 0xC9166 Kl_Xs16_Ws16 16383.50 dVel_20ms 0.00 16383.50 FORMAT "%8.2" EXTENDED_LIMITS -16384.00 16383.50
 /begin AXIS_DESCR STD_AXIS CrCtl_vBeg Vel 3 0.00 300.0000 FORMAT "%8.4" EXTENDED_LIMITS -327.6800 327.6700 DEPOSIT ABSOLUTE /end AXIS_DESCR
/end CHARACTERISTIC
/begin CHARACTERISTIC CrCtl_dvResAbvFDCG4_CUR "Curve for slope of set speed ramp RESUME ABOVE, >=4th gear" CURVE 0xC9174 Kl_Xs16_Ws16 16383.50 dVel_20ms 0.00 16383.50 FORMAT "%8.2" EXTENDED_LIMITS -16384.00 16383.50
 /begin AXIS_DESCR STD_AXIS CrCtl_vBeg Vel 3 0.00 300.0000 FORMAT "%8.4" EXTENDED_LIMITS -327.6800 327.6700 DEPOSIT ABSOLUTE /end AXIS_DESCR
/end CHARACTERISTIC
/begin CHARACTERISTIC CrCtl_dvResAbvFDCG5_CUR "Curve for slope of set speed ramp RESUME ABOVE, >=5th gear" CURVE 0xC9182 Kl_Xs16_Ws16 16383.50 dVel_20ms 0.00 16383.50 FORMAT "%8.2" EXTENDED_LIMITS -16384.00 16383.50
 /begin AXIS_DESCR STD_AXIS CrCtl_vBeg Vel 3 0.00 300.0000 FORMAT "%8.4" EXTENDED_LIMITS -327.6800 327.6700 DEPOSIT ABSOLUTE /end AXIS_DESCR
/end CHARACTERISTIC
/begin CHARACTERISTIC CrCtl_dvResAbvFDCG6_CUR "Curve for slope of set speed ramp RESUME ABOVE, >=6th gear" CURVE 0xC9190 Kl_Xs16_Ws16 16383.50 dVel_20ms 0.00 16383.50 FORMAT "%8.2" EXTENDED_LIMITS -16384.00 16383.50
 /begin AXIS_DESCR STD_AXIS CrCtl_vBeg Vel 3 0.00 300.0000 FORMAT "%8.4" EXTENDED_LIMITS -327.6800 327.6700 DEPOSIT ABSOLUTE /end AXIS_DESCR
/end CHARACTERISTIC
/begin CHARACTERISTIC CrCtl_dvResAbvG3_MAP "KF Abstieg FGR Rampengeschwindigkeit bei WA von oben für Gang <= 3" MAP 0xC919E Kf_Xs16_Ys16_Ws16 16383.50 dVel_20ms 0.00 16383.50 FORMAT "%8.2" EXTENDED_LIMITS -16384.00 16383.50
 /begin AXIS_DESCR STD_AXIS CrCtl_vBeg Vel 3 0.00 300.0000 FORMAT "%8.4" EXTENDED_LIMITS -327.6800 327.6700 DEPOSIT ABSOLUTE /end AXIS_DESCR
 /begin AXIS_DESCR STD_AXIS CrCtl_vDiff_mp Vel 1 0.00 300.0000 FORMAT "%8.4" EXTENDED_LIMITS -327.6800 327.6700 DEPOSIT ABSOLUTE /end AXIS_DESCR
/end CHARACTERISTIC
/begin CHARACTERISTIC CrCtl_dvResAbvG4_MAP "KF Abstieg FGR Rampengeschwindigkeit bei WA von oben für 4. Gang" MAP 0xC91B0 Kf_Xs16_Ys16_Ws16 16383.50 dVel_20ms 0.00 16383.50 FORMAT "%8.2" EXTENDED_LIMITS -16384.00 16383.50
 /begin AXIS_DESCR STD_AXIS CrCtl_vBeg Vel 3 0.00 300.0000 FORMAT "%8.4" EXTENDED_LIMITS -327.6800 327.6700 DEPOSIT ABSOLUTE /end AXIS_DESCR
 /begin AXIS_DESCR STD_AXIS CrCtl_vDiff_mp Vel 1 0.00 300.0000 FORMAT "%8.4" EXTENDED_LIMITS -327.6800 327.6700 DEPOSIT ABSOLUTE /end AXIS_DESCR
/end CHARACTERISTIC
/begin CHARACTERISTIC CrCtl_dvResAbvG5_MAP "KF Abstieg FGR Rampengeschwindigkeit bei WA von oben für 5. Gang" MAP 0xC91C2 Kf_Xs16_Ys16_Ws16 16383.50 dVel_20ms 0.00 16383.50 FORMAT "%8.2" EXTENDED_LIMITS -16384.00 16383.50
 /begin AXIS_DESCR STD_AXIS CrCtl_vBeg Vel 3 0.00 300.0000 FORMAT "%8.4" EXTENDED_LIMITS -327.6800 327.6700 DEPOSIT ABSOLUTE /end AXIS_DESCR
 /begin AXIS_DESCR STD_AXIS CrCtl_vDiff_mp Vel 1 0.00 300.0000 FORMAT "%8.4" EXTENDED_LIMITS -327.6800 327.6700 DEPOSIT ABSOLUTE /end AXIS_DESCR
/end CHARACTERISTIC
/begin CHARACTERISTIC CrCtl_dvResAbvG6_MAP "KF Abstieg FGR Rampengeschwindigkeit bei WA von oben für 6. Gang" MAP 0xC91D4 Kf_Xs16_Ys16_Ws16 16383.50 dVel_20ms 0.00 16383.50 FORMAT "%8.2" EXTENDED_LIMITS -16384.00 16383.50
 /begin AXIS_DESCR STD_AXIS CrCtl_vBeg Vel 3 0.00 300.0000 FORMAT "%8.4" EXTENDED_LIMITS -327.6800 327.6700 DEPOSIT ABSOLUTE /end AXIS_DESCR
 /begin AXIS_DESCR STD_AXIS CrCtl_vDiff_mp Vel 1 0.00 300.0000 FORMAT "%8.4" EXTENDED_LIMITS -327.6800 327.6700 DEPOSIT ABSOLUTE /end AXIS_DESCR
/end CHARACTERISTIC
/begin CHARACTERISTIC CrCtl_dvResBlwFDCG3_CUR "Curve for slope of set speed ramp RESUME BELOW, <= 3th gear" CURVE 0xC91E6 Kl_Xs16_Ws16 16383.50 dVel_20ms 0.00 16383.50 FORMAT "%8.2" EXTENDED_LIMITS -16384.00 16383.50
 /begin AXIS_DESCR STD_AXIS CrCtl_vBeg Vel 3 0.00 300.0000 FORMAT "%8.4" EXTENDED_LIMITS -327.6800 327.6700 DEPOSIT ABSOLUTE /end AXIS_DESCR
/end CHARACTERISTIC
/begin CHARACTERISTIC CrCtl_dvResBlwFDCG4_CUR "Curve for slope of set speed ramp RESUME BELOW, <= 4th gear" CURVE 0xC91F4 Kl_Xs16_Ws16 16383.50 dVel_20ms 0.00 16383.50 FORMAT "%8.2" EXTENDED_LIMITS -16384.00 16383.50
 /begin AXIS_DESCR STD_AXIS CrCtl_vBeg Vel 3 0.00 300.0000 FORMAT "%8.4" EXTENDED_LIMITS -327.6800 327.6700 DEPOSIT ABSOLUTE /end AXIS_DESCR
/end CHARACTERISTIC
/begin CHARACTERISTIC CrCtl_dvResBlwFDCG5_CUR "Curve for slope of set speed ramp RESUME BELOW, <= 5th gear" CURVE 0xC9202 Kl_Xs16_Ws16 16383.50 dVel_20ms 0.00 16383.50 FORMAT "%8.2" EXTENDED_LIMITS -16384.00 16383.50
 /begin AXIS_DESCR STD_AXIS CrCtl_vBeg Vel 3 0.00 300.0000 FORMAT "%8.4" EXTENDED_LIMITS -327.6800 327.6700 DEPOSIT ABSOLUTE /end AXIS_DESCR
/end CHARACTERISTIC
/begin CHARACTERISTIC CrCtl_dvResBlwFDCG6_CUR "Curve for slope of set speed ramp RESUME BELOW, >=6th gear" CURVE 0xC9210 Kl_Xs16_Ws16 16383.50 dVel_20ms 0.00 16383.50 FORMAT "%8.2" EXTENDED_LIMITS -16384.00 16383.50
 /begin AXIS_DESCR STD_AXIS CrCtl_vBeg Vel 3 0.00 300.0000 FORMAT "%8.4" EXTENDED_LIMITS -327.6800 327.6700 DEPOSIT ABSOLUTE /end AXIS_DESCR
/end CHARACTERISTIC
/begin CHARACTERISTIC CrCtl_dvResBlwG3_MAP "KF Anstieg FGR Rampengeschwindigkeit bei WA von unten für Gang <= 3" MAP 0xC921E Kf_Xs16_Ys16_Ws16 16383.50 dVel_20ms 0.00 16383.50 FORMAT "%8.2" EXTENDED_LIMITS -16384.00 16383.50
 /begin AXIS_DESCR STD_AXIS CrCtl_vBeg Vel 3 0.00 300.0000 FORMAT "%8.4" EXTENDED_LIMITS -327.6800 327.6700 DEPOSIT ABSOLUTE /end AXIS_DESCR
 /begin AXIS_DESCR STD_AXIS CrCtl_vDiff_mp Vel 1 0.00 300.0000 FORMAT "%8.4" EXTENDED_LIMITS -327.6800 327.6700 DEPOSIT ABSOLUTE /end AXIS_DESCR
/end CHARACTERISTIC
/begin CHARACTERISTIC CrCtl_dvResBlwG4_MAP "KF Anstieg FGR Rampengeschwindigkeit bei WA von unten für 4. Gang" MAP 0xC9230 Kf_Xs16_Ys16_Ws16 16383.50 dVel_20ms 0.00 16383.50 FORMAT "%8.2" EXTENDED_LIMITS -16384.00 16383.50
 /begin AXIS_DESCR STD_AXIS CrCtl_vBeg Vel 3 0.00 300.0000 FORMAT "%8.4" EXTENDED_LIMITS -327.6800 327.6700 DEPOSIT ABSOLUTE /end AXIS_DESCR
 /begin AXIS_DESCR STD_AXIS CrCtl_vDiff_mp Vel 1 0.00 300.0000 FORMAT "%8.4" EXTENDED_LIMITS -327.6800 327.6700 DEPOSIT ABSOLUTE /end AXIS_DESCR
/end CHARACTERISTIC
/begin CHARACTERISTIC CrCtl_dvResBlwG5_MAP "KF Anstieg FGR Rampengeschwindigkeit bei WA von unten für 5. Gang" MAP 0xC9242 Kf_Xs16_Ys16_Ws16 16383.50 dVel_20ms 0.00 16383.50 FORMAT "%8.2" EXTENDED_LIMITS -16384.00 16383.50
 /begin AXIS_DESCR STD_AXIS CrCtl_vBeg Vel 3 0.00 300.0000 FORMAT "%8.4" EXTENDED_LIMITS -327.6800 327.6700 DEPOSIT ABSOLUTE /end AXIS_DESCR
 /begin AXIS_DESCR STD_AXIS CrCtl_vDiff_mp Vel 1 0.00 300.0000 FORMAT "%8.4" EXTENDED_LIMITS -327.6800 327.6700 DEPOSIT ABSOLUTE /end AXIS_DESCR
/end CHARACTERISTIC
/begin CHARACTERISTIC CrCtl_dvResBlwG6_MAP "KF Anstieg FGR Rampengeschwindigkeit bei WA von unten für 6. Gang" MAP 0xC9254 Kf_Xs16_Ys16_Ws16 16383.50 dVel_20ms 0.00 16383.50 FORMAT "%8.2" EXTENDED_LIMITS -16384.00 16383.50
 /begin AXIS_DESCR STD_AXIS CrCtl_vBeg Vel 3 0.00 300.0000 FORMAT "%8.4" EXTENDED_LIMITS -327.6800 327.6700 DEPOSIT ABSOLUTE /end AXIS_DESCR
 /begin AXIS_DESCR STD_AXIS CrCtl_vDiff_mp Vel 1 0.00 300.0000 FORMAT "%8.4" EXTENDED_LIMITS -327.6800 327.6700 DEPOSIT ABSOLUTE /end AXIS_DESCR
/end CHARACTERISTIC
/begin CHARACTERISTIC CrCtl_facIncSlope_CUR "Überhöhungskennlinie für SET+, SET-, WA+, WA-" CURVE 0xC9266 Kl_Xs16_Ws16 7800.049 Prc_1000 -3900.024 3900.024 FORMAT "%8.3" EXTENDED_LIMITS -4000.000 3999.878
 /begin AXIS_DESCR STD_AXIS Rail_tiThresMonEna Time_ms 6 0.00 655350.0 FORMAT "%8.1" DEPOSIT ABSOLUTE /end AXIS_DESCR
/end CHARACTERISTIC
/begin CHARACTERISTIC CrCtl_facPropAcc_C "Proportionalfaktor für Initialmoment von Fahrgeschwindigkeit in EIN+/WAU des FGR" VALUE 0xC9280 Kw_Ws16 79.99756 Vel2TrqPrp 0.00 79.99756 FORMAT "%8.5" EXTENDED_LIMITS -80.00000 79.99756 /end CHARACTERISTIC
/begin CHARACTERISTIC CrCtl_facPropDecl_C "Proportionalfaktor für Offset von Fahrgeschwindigkeit zur Momentenerhöhung nach EIN-" VALUE 0xC9282 Kw_Ws16 79.99756 Vel2TrqPrp 0.00 79.99756 FORMAT "%8.5" EXTENDED_LIMITS -80.00000 79.99756 /end CHARACTERISTIC
/begin CHARACTERISTIC CrCtl_facRedDecl_C "Faktor zur Momentenreduzierung bei Übergang HALTEN zu EIN- nach Ablauf TIP-Erkennung" VALUE 0xC9284 Kw_Ws16 100.0000 Prc 0.00 100.0000 FORMAT "%8.4" EXTENDED_LIMITS -400.0000 399.9878 /end CHARACTERISTIC
/begin CHARACTERISTIC CrCtl_facRedHi_C "höherer Faktor Reduzierung FGR Moment bei Loslassen EIN+ (FGR-Moment > Schwelle)" VALUE 0xC9286 Kw_Ws16 100.0000 Prc 0.00 100.0000 FORMAT "%8.4" EXTENDED_LIMITS -400.0000 399.9878 /end CHARACTERISTIC
/begin CHARACTERISTIC CrCtl_facRedLo_C "niederer Faktor Reduzierung FGR-Moment bei Loslassen EIN+ (FGR-Moment <= Schwelle)" VALUE 0xC9288 Kw_Ws16 100.0000 Prc 0.00 100.0000 FORMAT "%8.4" EXTENDED_LIMITS -400.0000 399.9878 /end CHARACTERISTIC
/begin CHARACTERISTIC CrCtl_facResAbvFDC_CUR "Curve for reducing the slope of ramp speed in WA- and Tip- at the end of the ramp" CURVE 0xC928A Kl_Xs16_Ws16 99.97559 Prc_1000 0.00 99.97559 FORMAT "%8.4" EXTENDED_LIMITS -4000.000 3999.878
 /begin AXIS_DESCR STD_AXIS CrCtl_vDiffRed_mp Vel 6 -327.6800 327.6700 FORMAT "%8.4" DEPOSIT ABSOLUTE /end AXIS_DESCR
/end CHARACTERISTIC
/begin CHARACTERISTIC CrCtl_facResAbv_CUR "Abflachungskennlinie für WA-" CURVE 0xC92A4 Kl_Xs16_Ws16 99.97559 Prc_1000 0.00 99.97559 FORMAT "%8.4" EXTENDED_LIMITS -4000.000 3999.878
 /begin AXIS_DESCR STD_AXIS CrCtl_vDiffRed_mp Vel 3 -327.6800 327.6700 FORMAT "%8.4" DEPOSIT ABSOLUTE /end AXIS_DESCR
/end CHARACTERISTIC
/begin CHARACTERISTIC CrCtl_facResBlwFDC_CUR " Curve for reducing the slope of ramp speed in WA+ and Tip+ at the end of the ramp" CURVE 0xC92B2 Kl_Xs16_Ws16 99.97559 Prc_1000 0.00 99.97559 FORMAT "%8.4" EXTENDED_LIMITS -4000.000 3999.878
 /begin AXIS_DESCR STD_AXIS CrCtl_vDiffRed_mp Vel 6 -327.6800 327.6700 FORMAT "%8.4" DEPOSIT ABSOLUTE /end AXIS_DESCR
/end CHARACTERISTIC
/begin CHARACTERISTIC CrCtl_facResBlw_CUR "Abflachungskennlinie für WA+" CURVE 0xC92CC Kl_Xs16_Ws16 99.97559 Prc_1000 0.00 99.97559 FORMAT "%8.4" EXTENDED_LIMITS -4000.000 3999.878
 /begin AXIS_DESCR STD_AXIS CrCtl_vDiffRed_mp Vel 3 -327.6800 327.6700 FORMAT "%8.4" DEPOSIT ABSOLUTE /end AXIS_DESCR
/end CHARACTERISTIC
/begin CHARACTERISTIC CrCtl_facRmpRes_C "Faktor für Rampensteigung FGR-Geschwindigkeit WA (Endphase WA-Rampe)" VALUE 0xC92DA Kw_Ws16 1.000000 Fact 0.00 1.000000 FORMAT "%8.6" EXTENDED_LIMITS -4.000000 3.999878 /end CHARACTERISTIC
/begin CHARACTERISTIC CrCtl_HoldGear2IKi_C "Integralverstärkung Ki Kleinsignalbereich in HALTEN für 2. Gang" VALUE 0xC92DC Kw_Wu32 19999999.9953 Ki_Vel2TrqPrp 0.00 19999999.9953 FORMAT "%13.4" /end CHARACTERISTIC
/begin CHARACTERISTIC CrCtl_HoldGear2IKiPos_C "Integralverstärkung Ki pos. Großsignalbereich in HALTEN für 2. Gang" VALUE 0xC92E0 Kw_Wu32 19999999.9953 Ki_Vel2TrqPrp 0.00 19999999.9953 FORMAT "%13.4" /end CHARACTERISTIC
/begin CHARACTERISTIC CrCtl_HoldGear2IKiNeg_C "Integralverstärkung Ki neg. Großsignalbereich in HALTEN für 2. Gang" VALUE 0xC92E4 Kw_Wu32 19999999.9953 Ki_Vel2TrqPrp 0.00 19999999.9953 FORMAT "%13.4" /end CHARACTERISTIC
/begin CHARACTERISTIC CrCtl_vHoldGear2IWinPos_C "obere Grenze Kleinsignalbereich I-Anteil in HALTEN, 2. Gang" VALUE 0xC92E8 Kw_Ws16 300.0000 Vel 0.00 300.0000 FORMAT "%8.4" EXTENDED_LIMITS -327.6800 327.6700 /end CHARACTERISTIC
/begin CHARACTERISTIC CrCtl_vHoldGear2IWinNeg_C "untere Grenze Kleinsignalbereich I-Anteil in HALTEN, 2. Gang" VALUE 0xC92EA Kw_Ws16 300.0000 Vel -300.0000 0.00 FORMAT "%8.4" EXTENDED_LIMITS -327.6800 327.6700 /end CHARACTERISTIC
/begin CHARACTERISTIC CrCtl_HoldGear2PKp_C "Proportionalverstärkung Kp Kleinsignalbereich in HALTEN, 2. Gang" VALUE 0xC92EC Kw_Wu32 1310719.99969 Kp_Vel2TrqPrp 0.00 1310719.99969 FORMAT "%13.5" /end CHARACTERISTIC
/begin CHARACTERISTIC CrCtl_HoldGear2PKpPos_C "Proportionalverstärkung Kp pos. Großsignalbereich in HALTEN, 2. Gang" VALUE 0xC92F0 Kw_Wu32 1310719.99969 Kp_Vel2TrqPrp 0.00 1310719.99969 FORMAT "%13.5" /end CHARACTERISTIC
/begin CHARACTERISTIC CrCtl_HoldGear2PKpNeg_C "Proportionalverstärkung Kp neg. Großsignalbereich in HALTEN, 2. Gang" VALUE 0xC92F4 Kw_Wu32 1310719.99969 Kp_Vel2TrqPrp 0.00 1310719.99969 FORMAT "%13.5" /end CHARACTERISTIC
/begin CHARACTERISTIC CrCtl_vHoldGear2PWinPos_C "obere Grenze Kleinsignalbereich P-Anteil in HALTEN, 2. Gang" VALUE 0xC92F8 Kw_Ws16 300.0000 Vel 0.00 300.0000 FORMAT "%8.4" EXTENDED_LIMITS -327.6800 327.6700 /end CHARACTERISTIC
/begin CHARACTERISTIC CrCtl_vHoldGear2PWinNeg_C "untere Grenze Kleinsignalbereich P-Anteil in HALTEN, 2. Gang" VALUE 0xC92FA Kw_Ws16 300.0000 Vel -300.0000 0.00 FORMAT "%8.4" EXTENDED_LIMITS -327.6800 327.6700 /end CHARACTERISTIC
/begin CHARACTERISTIC CrCtl_HoldGear3IKi_C "Integralverstärkung Kleinsignalbereich in HALTEN, 3. Gang" VALUE 0xC92FC Kw_Wu32 19999999.9953 Ki_Vel2TrqPrp 0.00 19999999.9953 FORMAT "%13.4" /end CHARACTERISTIC
/begin CHARACTERISTIC CrCtl_HoldGear3IKiPos_C "Integralverstärkung Ki pos. Großsignalbereich in HALTEN, 3. Gang" VALUE 0xC9300 Kw_Wu32 19999999.9953 Ki_Vel2TrqPrp 0.00 19999999.9953 FORMAT "%13.4" /end CHARACTERISTIC
/begin CHARACTERISTIC CrCtl_HoldGear3IKiNeg_C "Integralverstärkung Ki neg. Großsignalbereich in HALTEN, 3. Gang" VALUE 0xC9304 Kw_Wu32 19999999.9953 Ki_Vel2TrqPrp 0.00 19999999.9953 FORMAT "%13.4" /end CHARACTERISTIC
/begin CHARACTERISTIC CrCtl_vHoldGear3IWinPos_C "obere Grenze Kleinsignalbereich I-Anteil in HALTEN, 3. Gang" VALUE 0xC9308 Kw_Ws16 300.0000 Vel 0.00 300.0000 FORMAT "%8.4" EXTENDED_LIMITS -327.6800 327.6700 /end CHARACTERISTIC
/begin CHARACTERISTIC CrCtl_vHoldGear3IWinNeg_C "untere Grenze Kleinsignalbereich I-Anteil in HALTEN, 3. Gang" VALUE 0xC930A Kw_Ws16 300.0000 Vel -300.0000 0.00 FORMAT "%8.4" EXTENDED_LIMITS -327.6800 327.6700 /end CHARACTERISTIC
/begin CHARACTERISTIC CrCtl_HoldGear3PKp_C "Proportionalverstärkung Kp Kleinsignalbereich in HALTEN, 3. Gang" VALUE 0xC930C Kw_Wu32 1310719.99969 Kp_Vel2TrqPrp 0.00 1310719.99969 FORMAT "%13.5" /end CHARACTERISTIC
/begin CHARACTERISTIC CrCtl_HoldGear3PKpPos_C "Proportionalverstärkung Kp pos. Großsignalbereich in HALTEN, 3. Gang" VALUE 0xC9310 Kw_Wu32 1310719.99969 Kp_Vel2TrqPrp 0.00 1310719.99969 FORMAT "%13.5" /end CHARACTERISTIC
/begin CHARACTERISTIC CrCtl_HoldGear3PKpNeg_C "Proportionalverstärkung Kp neg. Großsignalbereich in HALTEN, 3. Gang" VALUE 0xC9314 Kw_Wu32 1310719.99969 Kp_Vel2TrqPrp 0.00 1310719.99969 FORMAT "%13.5" /end CHARACTERISTIC
/begin CHARACTERISTIC CrCtl_vHoldGear3PWinPos_C "obere Grenze Kleinsignalbereich P-Anteil in HALTEN, 3. Gang" VALUE 0xC9318 Kw_Ws16 300.0000 Vel 0.00 300.0000 FORMAT "%8.4" EXTENDED_LIMITS -327.6800 327.6700 /end CHARACTERISTIC
/begin CHARACTERISTIC CrCtl_vHoldGear3PWinNeg_C "untere Grenze Kleinsignalbereich P-Anteil in HALTEN, 3. Gang" VALUE 0xC931A Kw_Ws16 300.0000 Vel -300.0000 0.00 FORMAT "%8.4" EXTENDED_LIMITS -327.6800 327.6700 /end CHARACTERISTIC
/begin CHARACTERISTIC CrCtl_HoldGear4IKi_C "Integralverstärkung Kleinsignalbereich in HALTEN, 4. Gang" VALUE 0xC931C Kw_Wu32 19999999.9953 Ki_Vel2TrqPrp 0.00 19999999.9953 FORMAT "%13.4" /end CHARACTERISTIC
/begin CHARACTERISTIC CrCtl_HoldGear4IKiPos_C "Integralverstärkung Ki pos. Großsignalbereich in HALTEN, 4. Gang" VALUE 0xC9320 Kw_Wu32 19999999.9953 Ki_Vel2TrqPrp 0.00 19999999.9953 FORMAT "%13.4" /end CHARACTERISTIC
/begin CHARACTERISTIC CrCtl_HoldGear4IKiNeg_C "Integralverstärkung Ki neg. Großsignalbereich in HALTEN, 4. Gang" VALUE 0xC9324 Kw_Wu32 19999999.9953 Ki_Vel2TrqPrp 0.00 19999999.9953 FORMAT "%13.4" /end CHARACTERISTIC
/begin CHARACTERISTIC CrCtl_vHoldGear4IWinPos_C "obere Grenze Kleinsignalbereich I-Anteil in HALTEN, 4. Gang" VALUE 0xC9328 Kw_Ws16 300.0000 Vel 0.00 300.0000 FORMAT "%8.4" EXTENDED_LIMITS -327.6800 327.6700 /end CHARACTERISTIC
/begin CHARACTERISTIC CrCtl_vHoldGear4IWinNeg_C "untere Grenze Kleinsignalbereich I-Anteil in HALTEN, 4. Gang" VALUE 0xC932A Kw_Ws16 300.0000 Vel -300.0000 0.00 FORMAT "%8.4" EXTENDED_LIMITS -327.6800 327.6700 /end CHARACTERISTIC
/begin CHARACTERISTIC CrCtl_HoldGear4PKp_C "Proportionalverstärkung Kp Kleinsignalbereich in HALTEN, 4 Gang" VALUE 0xC932C Kw_Wu32 1310719.99969 Kp_Vel2TrqPrp 0.00 1310719.99969 FORMAT "%13.5" /end CHARACTERISTIC
/begin CHARACTERISTIC CrCtl_HoldGear4PKpPos_C "Proportionalverstärkung Kp pos. Großsignalbereich in HALTEN, 4. Gang" VALUE 0xC9330 Kw_Wu32 1310719.99969 Kp_Vel2TrqPrp 0.00 1310719.99969 FORMAT "%13.5" /end CHARACTERISTIC
/begin CHARACTERISTIC CrCtl_HoldGear4PKpNeg_C "Proportionalverstärkung Kp neg. Großsignalbereich in HALTEN, 4. Gang" VALUE 0xC9334 Kw_Wu32 1310719.99969 Kp_Vel2TrqPrp 0.00 1310719.99969 FORMAT "%13.5" /end CHARACTERISTIC
/begin CHARACTERISTIC CrCtl_vHoldGear4PWinPos_C "obere Grenze Kleinsignalbereich P-Anteil in HALTEN, 4. Gang" VALUE 0xC9338 Kw_Ws16 300.0000 Vel 0.00 300.0000 FORMAT "%8.4" EXTENDED_LIMITS -327.6800 327.6700 /end CHARACTERISTIC
/begin CHARACTERISTIC CrCtl_vHoldGear4PWinNeg_C "untere Grenze Kleinsignalbereich P-Anteil in HALTEN, 4. Gang" VALUE 0xC933A Kw_Ws16 300.0000 Vel -300.0000 0.00 FORMAT "%8.4" EXTENDED_LIMITS -327.6800 327.6700 /end CHARACTERISTIC
/begin CHARACTERISTIC CrCtl_HoldGear5IKi_C "Integralverstärkung Kleinsignalbereich in HALTEN, 5. Gang" VALUE 0xC933C Kw_Wu32 19999999.9953 Ki_Vel2TrqPrp 0.00 19999999.9953 FORMAT "%13.4" /end CHARACTERISTIC
/begin CHARACTERISTIC CrCtl_HoldGear5IKiPos_C "Integralverstärkung Ki pos. Großsignalbereich in HALTEN, 5. Gang" VALUE 0xC9340 Kw_Wu32 19999999.9953 Ki_Vel2TrqPrp 0.00 19999999.9953 FORMAT "%13.4" /end CHARACTERISTIC
/begin CHARACTERISTIC CrCtl_HoldGear5IKiNeg_C "Integralverstärkung Ki neg. Großsignalbereich in HALTEN, 5. Gang" VALUE 0xC9344 Kw_Wu32 19999999.9953 Ki_Vel2TrqPrp 0.00 19999999.9953 FORMAT "%13.4" /end CHARACTERISTIC
/begin CHARACTERISTIC CrCtl_vHoldGear5IWinPos_C "obere Grenze Kleinsignalbereich I-Anteil in HALTEN, 5. Gang" VALUE 0xC9348 Kw_Ws16 300.0000 Vel 0.00 300.0000 FORMAT "%8.4" EXTENDED_LIMITS -327.6800 327.6700 /end CHARACTERISTIC
/begin CHARACTERISTIC CrCtl_vHoldGear5IWinNeg_C "untere Grenze Kleinsignalbereich I-Anteil in HALTEN, 5. Gang" VALUE 0xC934A Kw_Ws16 300.0000 Vel -300.0000 0.00 FORMAT "%8.4" EXTENDED_LIMITS -327.6800 327.6700 /end CHARACTERISTIC
/begin CHARACTERISTIC CrCtl_HoldGear5PKp_C "Proportionalverstärkung Kp Kleinsignalbereich in HALTEN, 5 Gang" VALUE 0xC934C Kw_Wu32 1310719.99969 Kp_Vel2TrqPrp 0.00 1310719.99969 FORMAT "%13.5" /end CHARACTERISTIC
/begin CHARACTERISTIC CrCtl_HoldGear5PKpPos_C "Proportionalverstärkung Kp pos. Großsignalbereich in HALTEN, 5. Gang" VALUE 0xC9350 Kw_Wu32 1310719.99969 Kp_Vel2TrqPrp 0.00 1310719.99969 FORMAT "%13.5" /end CHARACTERISTIC
/begin CHARACTERISTIC CrCtl_HoldGear5PKpNeg_C "Proportionalverstärkung Kp neg. Großsignalbereich in HALTEN, 5. Gang" VALUE 0xC9354 Kw_Wu32 1310719.99969 Kp_Vel2TrqPrp 0.00 1310719.99969 FORMAT "%13.5" /end CHARACTERISTIC
/begin CHARACTERISTIC CrCtl_vHoldGear5PWinPos_C "obere Grenze Kleinsignalbereich P-Anteil in HALTEN, 5. Gang" VALUE 0xC9358 Kw_Ws16 300.0000 Vel 0.00 300.0000 FORMAT "%8.4" EXTENDED_LIMITS -327.6800 327.6700 /end CHARACTERISTIC
/begin CHARACTERISTIC CrCtl_vHoldGear5PWinNeg_C "untere Grenze Kleinsignalbereich P-Anteil in HALTEN, 5. Gang" VALUE 0xC935A Kw_Ws16 300.0000 Vel -300.0000 0.00 FORMAT "%8.4" EXTENDED_LIMITS -327.6800 327.6700 /end CHARACTERISTIC
/begin CHARACTERISTIC CrCtl_HoldGear6IKi_C "Integralverstärkung Kleinsignalbereich in HALTEN, 6. Gang" VALUE 0xC935C Kw_Wu32 19999999.9953 Ki_Vel2TrqPrp 0.00 19999999.9953 FORMAT "%13.4" /end CHARACTERISTIC
/begin CHARACTERISTIC CrCtl_HoldGear6IKiPos_C "Integralverstärkung Ki neg. Großsignalbereich in HALTEN, 6. Gang" VALUE 0xC9360 Kw_Wu32 19999999.9953 Ki_Vel2TrqPrp 0.00 19999999.9953 FORMAT "%13.4" /end CHARACTERISTIC
/begin CHARACTERISTIC CrCtl_HoldGear6IKiNeg_C "Integralverstärkung Ki neg. Großsignalbereich in HALTEN, 6. Gang" VALUE 0xC9364 Kw_Wu32 19999999.9953 Ki_Vel2TrqPrp 0.00 19999999.9953 FORMAT "%13.4" /end CHARACTERISTIC
/begin CHARACTERISTIC CrCtl_vHoldGear6IWinPos_C "obere Grenze Kleinsignalbereich I-Anteil in HALTEN, 6. Gang" VALUE 0xC9368 Kw_Ws16 300.0000 Vel 0.00 300.0000 FORMAT "%8.4" EXTENDED_LIMITS -327.6800 327.6700 /end CHARACTERISTIC
/begin CHARACTERISTIC CrCtl_vHoldGear6IWinNeg_C "untere Grenze Kleinsignalbereich I-Anteil in HALTEN, 6. Gang" VALUE 0xC936A Kw_Ws16 300.0000 Vel -300.0000 0.00 FORMAT "%8.4" EXTENDED_LIMITS -327.6800 327.6700 /end CHARACTERISTIC
/begin CHARACTERISTIC CrCtl_HoldGear6PKp_C "Proportionalverstärkung Kp Kleinsignalbereich in HALTEN, 6 Gang" VALUE 0xC936C Kw_Wu32 1310719.99969 Kp_Vel2TrqPrp 0.00 1310719.99969 FORMAT "%13.5" /end CHARACTERISTIC
/begin CHARACTERISTIC CrCtl_HoldGear6PKpPos_C "Proportionalverstärkung Kp pos. Großsignalbereich in HALTEN, 6. Gang" VALUE 0xC9370 Kw_Wu32 1310719.99969 Kp_Vel2TrqPrp 0.00 1310719.99969 FORMAT "%13.5" /end CHARACTERISTIC
/begin CHARACTERISTIC CrCtl_HoldGear6PKpNeg_C "Proportionalverstärkung Kp neg. Großsignalbereich in HALTEN, 6. Gang" VALUE 0xC9374 Kw_Wu32 1310719.99969 Kp_Vel2TrqPrp 0.00 1310719.99969 FORMAT "%13.5" /end CHARACTERISTIC
/begin CHARACTERISTIC CrCtl_vHoldGear6PWinPos_C "obere Grenze Kleinsignalbereich P-Anteil in HALTEN, 6. Gang" VALUE 0xC9378 Kw_Ws16 300.0000 Vel 0.00 300.0000 FORMAT "%8.4" EXTENDED_LIMITS -327.6800 327.6700 /end CHARACTERISTIC
/begin CHARACTERISTIC CrCtl_vHoldGear6PWinNeg_C "untere Grenze Kleinsignalbereich P-Anteil in HALTEN, 6. Gang" VALUE 0xC937A Kw_Ws16 300.0000 Vel -300.0000 0.00 FORMAT "%8.4" EXTENDED_LIMITS -327.6800 327.6700 /end CHARACTERISTIC
/begin CHARACTERISTIC CrCtl_nMaxAlw_C "Obere Drehzahlschwelle Abschaltung FGR" VALUE 0xC8F3C Kw_Ws16 6000.000 EngN 0.00 6000.000 FORMAT "%8.3" EXTENDED_LIMITS -32768.00 32767.00 /end CHARACTERISTIC
/begin CHARACTERISTIC CrCtl_nMinAlw_C "untere Drehzahlschwelle Abschaltung FGR" VALUE 0xC8F3E Kw_Ws16 6000.000 EngN 0.00 6000.000 FORMAT "%8.3" EXTENDED_LIMITS -32768.00 32767.00 /end CHARACTERISTIC
/begin CHARACTERISTIC CrCtl_rAccPedVelMin_C "Minimum acc per ratio for cruise control" VALUE 0xC94CC Kw_Ws16 799.9878 Prc -400.0000 399.9878 FORMAT "%8.4" /end CHARACTERISTIC
/begin CHARACTERISTIC CrCtl_tiResAbvGear2DT1_C "DT1 Zeitkonstante T1 Endphase WA oben für 2. Gang" VALUE 0xC937C Kw_Wu32 4294.9673 TimeDelay_s 0.0000010000000 4294.9673 FORMAT "%9.4" /end CHARACTERISTIC
/begin CHARACTERISTIC CrCtl_ResAbvGear2DT1Kd_C "Differentialverstärkung Endphase WA oben 2. Gang" VALUE 0xC9380 Kw_Ws32 1310719.99969 Kd_Vel2TrqPrp -655360.000000 655359.999695 FORMAT "%13.6" /end CHARACTERISTIC
/begin CHARACTERISTIC CrCtl_tiResAbvGear3DT1_C "DT1 Zeitkonstante T1 Endphase WA oben für 3. Gang" VALUE 0xC9384 Kw_Wu32 4294.9673 TimeDelay_s 0.0000010000000 4294.9673 FORMAT "%9.4" /end CHARACTERISTIC
/begin CHARACTERISTIC CrCtl_ResAbvGear3DT1Kd_C "Differentialverstärkung Endphase WA oben 3. Gang" VALUE 0xC9388 Kw_Ws32 1310719.99969 Kd_Vel2TrqPrp -655360.000000 655359.999695 FORMAT "%13.6" /end CHARACTERISTIC
/begin CHARACTERISTIC CrCtl_tiResAbvGear4DT1_C "DT1 Zeitkonstante T1 Endphase WA oben für 4. Gang" VALUE 0xC938C Kw_Wu32 4294.9673 TimeDelay_s 0.0000010000000 4294.9673 FORMAT "%9.4" /end CHARACTERISTIC
/begin CHARACTERISTIC CrCtl_ResAbvGear4DT1Kd_C "Differentialverstärkung Endphase WA oben 4. Gang" VALUE 0xC9390 Kw_Ws32 1310719.99969 Kd_Vel2TrqPrp -655360.000000 655359.999695 FORMAT "%13.6" /end CHARACTERISTIC
/begin CHARACTERISTIC CrCtl_tiResAbvGear5DT1_C "DT1 Zeitkonstante T1 Endphase WA oben für 5. Gang" VALUE 0xC9394 Kw_Wu32 4294.9673 TimeDelay_s 0.0000010000000 4294.9673 FORMAT "%9.4" /end CHARACTERISTIC
/begin CHARACTERISTIC CrCtl_ResAbvGear5DT1Kd_C "Differentialverstärkung Endphase WA oben 5. Gang" VALUE 0xC9398 Kw_Ws32 1310719.99969 Kd_Vel2TrqPrp -655360.000000 655359.999695 FORMAT "%13.6" /end CHARACTERISTIC
/begin CHARACTERISTIC CrCtl_tiResAbvGear6DT1_C "DT1 Zeitkonstante T1 Endphase WA oben für 6. Gang" VALUE 0xC939C Kw_Wu32 4294.9673 TimeDelay_s 0.0000010000000 4294.9673 FORMAT "%9.4" /end CHARACTERISTIC
/begin CHARACTERISTIC CrCtl_ResAbvGear6DT1Kd_C "Differentialverstärkung Endphase WA oben 6. Gang" VALUE 0xC93A0 Kw_Ws32 1310719.99969 Kd_Vel2TrqPrp -655360.000000 655359.999695 FORMAT "%13.6" /end CHARACTERISTIC
/begin CHARACTERISTIC CrCtl_ResBlwGear2IKi_C "PI-Reglerparametersatz für WA+ 2.Gang" VALUE 0xC93A4 Kw_Wu32 19999999.9953 Ki_Vel2TrqPrp 0.00 19999999.9953 FORMAT "%13.4" /end CHARACTERISTIC
/begin CHARACTERISTIC CrCtl_ResBlwGear2IKiPos_C "PI-Reglerparametersatz für WA+ 2.Gang" VALUE 0xC93A8 Kw_Wu32 19999999.9953 Ki_Vel2TrqPrp 0.00 19999999.9953 FORMAT "%13.4" /end CHARACTERISTIC
/begin CHARACTERISTIC CrCtl_ResBlwGear2IKiNeg_C "PI-Reglerparametersatz für WA+ 2.Gang" VALUE 0xC93AC Kw_Wu32 19999999.9953 Ki_Vel2TrqPrp 0.00 19999999.9953 FORMAT "%13.4" /end CHARACTERISTIC
/begin CHARACTERISTIC CrCtl_vResBlwGear2IWinPos_C "PI-Reglerparametersatz für WA+ 2.Gang" VALUE 0xC93B0 Kw_Ws16 300.0000 Vel 0.00 300.0000 FORMAT "%8.4" EXTENDED_LIMITS -327.6800 327.6700 /end CHARACTERISTIC
/begin CHARACTERISTIC CrCtl_vResBlwGear2IWinNeg_C "PI-Reglerparametersatz für WA+ 2.Gang" VALUE 0xC93B2 Kw_Ws16 300.0000 Vel -300.0000 0.00 FORMAT "%8.4" EXTENDED_LIMITS -327.6800 327.6700 /end CHARACTERISTIC
/begin CHARACTERISTIC CrCtl_ResBlwGear2PKp_C "PI-Reglerparametersatz für WA+ 2.Gang" VALUE 0xC93B4 Kw_Wu32 1310719.99969 Kp_Vel2TrqPrp 0.00 1310719.99969 FORMAT "%13.5" /end CHARACTERISTIC
/begin CHARACTERISTIC CrCtl_ResBlwGear2PKpPos_C "PI-Reglerparametersatz für WA+ 2.Gang" VALUE 0xC93B8 Kw_Wu32 1310719.99969 Kp_Vel2TrqPrp 0.00 1310719.99969 FORMAT "%13.5" /end CHARACTERISTIC
/begin CHARACTERISTIC CrCtl_ResBlwGear2PKpNeg_C "PI-Reglerparametersatz für WA+ 2.Gang" VALUE 0xC93BC Kw_Wu32 1310719.99969 Kp_Vel2TrqPrp 0.00 1310719.99969 FORMAT "%13.5" /end CHARACTERISTIC
/begin CHARACTERISTIC CrCtl_vResBlwGear2PWinPos_C "PI-Reglerparametersatz für WA+ 2.Gang" VALUE 0xC93C0 Kw_Ws16 300.0000 Vel 0.00 300.0000 FORMAT "%8.4" EXTENDED_LIMITS -327.6800 327.6700 /end CHARACTERISTIC
/begin CHARACTERISTIC CrCtl_vResBlwGear2PWinNeg_C "PI-Reglerparametersatz für WA+ 2.Gang" VALUE 0xC93C2 Kw_Ws16 300.0000 Vel -300.0000 0.00 FORMAT "%8.4" EXTENDED_LIMITS -327.6800 327.6700 /end CHARACTERISTIC
/begin CHARACTERISTIC CrCtl_ResBlwGear3IKi_C "PI-Reglerparametersatz für WA+ 3.Gang" VALUE 0xC93C4 Kw_Wu32 19999999.9953 Ki_Vel2TrqPrp 0.00 19999999.9953 FORMAT "%13.4" /end CHARACTERISTIC
/begin CHARACTERISTIC CrCtl_ResBlwGear3IKiPos_C "PI-Reglerparametersatz für WA+ 3.Gang" VALUE 0xC93C8 Kw_Wu32 19999999.9953 Ki_Vel2TrqPrp 0.00 19999999.9953 FORMAT "%13.4" /end CHARACTERISTIC
/begin CHARACTERISTIC CrCtl_ResBlwGear3IKiNeg_C "PI-Reglerparametersatz für WA+ 3.Gang" VALUE 0xC93CC Kw_Wu32 19999999.9953 Ki_Vel2TrqPrp 0.00 19999999.9953 FORMAT "%13.4" /end CHARACTERISTIC
/begin CHARACTERISTIC CrCtl_vResBlwGear3IWinPos_C "PI-Reglerparametersatz für WA+ 3.Gang" VALUE 0xC93D0 Kw_Ws16 300.0000 Vel 0.00 300.0000 FORMAT "%8.4" EXTENDED_LIMITS -327.6800 327.6700 /end CHARACTERISTIC
/begin CHARACTERISTIC CrCtl_vResBlwGear3IWinNeg_C "PI-Reglerparametersatz für WA+ 3.Gang" VALUE 0xC93D2 Kw_Ws16 300.0000 Vel -300.0000 0.00 FORMAT "%8.4" EXTENDED_LIMITS -327.6800 327.6700 /end CHARACTERISTIC
/begin CHARACTERISTIC CrCtl_ResBlwGear3PKp_C "PI-Reglerparametersatz für WA+ 3.Gang" VALUE 0xC93D4 Kw_Wu32 1310719.99969 Kp_Vel2TrqPrp 0.00 1310719.99969 FORMAT "%13.5" /end CHARACTERISTIC
/begin CHARACTERISTIC CrCtl_ResBlwGear3PKpPos_C "PI-Reglerparametersatz für WA+ 3.Gang" VALUE 0xC93D8 Kw_Wu32 1310719.99969 Kp_Vel2TrqPrp 0.00 1310719.99969 FORMAT "%13.5" /end CHARACTERISTIC
/begin CHARACTERISTIC CrCtl_ResBlwGear3PKpNeg_C "PI-Reglerparametersatz für WA+ 3.Gang" VALUE 0xC93DC Kw_Wu32 1310719.99969 Kp_Vel2TrqPrp 0.00 1310719.99969 FORMAT "%13.5" /end CHARACTERISTIC
/begin CHARACTERISTIC CrCtl_vResBlwGear3PWinPos_C "PI-Reglerparametersatz für WA+ 3.Gang" VALUE 0xC93E0 Kw_Ws16 300.0000 Vel 0.00 300.0000 FORMAT "%8.4" EXTENDED_LIMITS -327.6800 327.6700 /end CHARACTERISTIC
/begin CHARACTERISTIC CrCtl_vResBlwGear3PWinNeg_C "PI-Reglerparametersatz für WA+ 3.Gang" VALUE 0xC93E2 Kw_Ws16 300.0000 Vel -300.0000 0.00 FORMAT "%8.4" EXTENDED_LIMITS -327.6800 327.6700 /end CHARACTERISTIC
/begin CHARACTERISTIC CrCtl_ResBlwGear4IKi_C "PI-Reglerparametersatz für WA+ 4.Gang" VALUE 0xC93E4 Kw_Wu32 19999999.9953 Ki_Vel2TrqPrp 0.00 19999999.9953 FORMAT "%13.4" /end CHARACTERISTIC
/begin CHARACTERISTIC CrCtl_ResBlwGear4IKiPos_C "PI-Reglerparametersatz für WA+ 4.Gang" VALUE 0xC93E8 Kw_Wu32 19999999.9953 Ki_Vel2TrqPrp 0.00 19999999.9953 FORMAT "%13.4" /end CHARACTERISTIC
/begin CHARACTERISTIC CrCtl_ResBlwGear4IKiNeg_C "PI-Reglerparametersatz für WA+ 4.Gang" VALUE 0xC93EC Kw_Wu32 19999999.9953 Ki_Vel2TrqPrp 0.00 19999999.9953 FORMAT "%13.4" /end CHARACTERISTIC
/begin CHARACTERISTIC CrCtl_vResBlwGear4IWinPos_C "PI-Reglerparametersatz für WA+ 4.Gang" VALUE 0xC93F0 Kw_Ws16 300.0000 Vel 0.00 300.0000 FORMAT "%8.4" EXTENDED_LIMITS -327.6800 327.6700 /end CHARACTERISTIC
/begin CHARACTERISTIC CrCtl_vResBlwGear4IWinNeg_C "PI-Reglerparametersatz für WA+ 4.Gang" VALUE 0xC93F2 Kw_Ws16 300.0000 Vel -300.0000 0.00 FORMAT "%8.4" EXTENDED_LIMITS -327.6800 327.6700 /end CHARACTERISTIC
/begin CHARACTERISTIC CrCtl_ResBlwGear4PKp_C "PI-Reglerparametersatz für WA+ 4.Gang" VALUE 0xC93F4 Kw_Wu32 1310719.99969 Kp_Vel2TrqPrp 0.00 1310719.99969 FORMAT "%13.5" /end CHARACTERISTIC
/begin CHARACTERISTIC CrCtl_ResBlwGear4PKpPos_C "PI-Reglerparametersatz für WA+ 4.Gang" VALUE 0xC93F8 Kw_Wu32 1310719.99969 Kp_Vel2TrqPrp 0.00 1310719.99969 FORMAT "%13.5" /end CHARACTERISTIC
/begin CHARACTERISTIC CrCtl_ResBlwGear4PKpNeg_C "PI-Reglerparametersatz für WA+ 4.Gang" VALUE 0xC93FC Kw_Wu32 1310719.99969 Kp_Vel2TrqPrp 0.00 1310719.99969 FORMAT "%13.5" /end CHARACTERISTIC
/begin CHARACTERISTIC CrCtl_vResBlwGear4PWinPos_C "PI-Reglerparametersatz für WA+ 4.Gang" VALUE 0xC9400 Kw_Ws16 300.0000 Vel 0.00 300.0000 FORMAT "%8.4" EXTENDED_LIMITS -327.6800 327.6700 /end CHARACTERISTIC
/begin CHARACTERISTIC CrCtl_vResBlwGear4PWinNeg_C "PI-Reglerparametersatz für WA+ 4.Gang" VALUE 0xC9402 Kw_Ws16 300.0000 Vel -300.0000 0.00 FORMAT "%8.4" EXTENDED_LIMITS -327.6800 327.6700 /end CHARACTERISTIC
/begin CHARACTERISTIC CrCtl_ResBlwGear5IKi_C "PI-Reglerparametersatz für WA+ 5.Gang" VALUE 0xC9404 Kw_Wu32 19999999.9953 Ki_Vel2TrqPrp 0.00 19999999.9953 FORMAT "%13.4" /end CHARACTERISTIC
/begin CHARACTERISTIC CrCtl_ResBlwGear5IKiPos_C "PI-Reglerparametersatz für WA+ 5.Gang" VALUE 0xC9408 Kw_Wu32 19999999.9953 Ki_Vel2TrqPrp 0.00 19999999.9953 FORMAT "%13.4" /end CHARACTERISTIC
/begin CHARACTERISTIC CrCtl_ResBlwGear5IKiNeg_C "PI-Reglerparametersatz für WA+ 5.Gang" VALUE 0xC940C Kw_Wu32 19999999.9953 Ki_Vel2TrqPrp 0.00 19999999.9953 FORMAT "%13.4" /end CHARACTERISTIC
/begin CHARACTERISTIC CrCtl_vResBlwGear5IWinPos_C "PI-Reglerparametersatz für WA+ 5.Gang" VALUE 0xC9410 Kw_Ws16 300.0000 Vel 0.00 300.0000 FORMAT "%8.4" EXTENDED_LIMITS -327.6800 327.6700 /end CHARACTERISTIC
/begin CHARACTERISTIC CrCtl_vResBlwGear5IWinNeg_C "PI-Reglerparametersatz für WA+ 5.Gang" VALUE 0xC9412 Kw_Ws16 300.0000 Vel -300.0000 0.00 FORMAT "%8.4" EXTENDED_LIMITS -327.6800 327.6700 /end CHARACTERISTIC
/begin CHARACTERISTIC CrCtl_ResBlwGear5PKp_C "PI-Reglerparametersatz für WA+ 5.Gang" VALUE 0xC9414 Kw_Wu32 1310719.99969 Kp_Vel2TrqPrp 0.00 1310719.99969 FORMAT "%13.5" /end CHARACTERISTIC
/begin CHARACTERISTIC CrCtl_ResBlwGear5PKpPos_C "PI-Reglerparametersatz für WA+ 5.Gang" VALUE 0xC9418 Kw_Wu32 1310719.99969 Kp_Vel2TrqPrp 0.00 1310719.99969 FORMAT "%13.5" /end CHARACTERISTIC
/begin CHARACTERISTIC CrCtl_ResBlwGear5PKpNeg_C "PI-Reglerparametersatz für WA+ 5.Gang" VALUE 0xC941C Kw_Wu32 1310719.99969 Kp_Vel2TrqPrp 0.00 1310719.99969 FORMAT "%13.5" /end CHARACTERISTIC
/begin CHARACTERISTIC CrCtl_vResBlwGear5PWinPos_C "PI-Reglerparametersatz für WA+ 5.Gang" VALUE 0xC9420 Kw_Ws16 300.0000 Vel 0.00 300.0000 FORMAT "%8.4" EXTENDED_LIMITS -327.6800 327.6700 /end CHARACTERISTIC
/begin CHARACTERISTIC CrCtl_vResBlwGear5PWinNeg_C "PI-Reglerparametersatz für WA+ 5.Gang" VALUE 0xC9422 Kw_Ws16 300.0000 Vel -300.0000 0.00 FORMAT "%8.4" EXTENDED_LIMITS -327.6800 327.6700 /end CHARACTERISTIC
/begin CHARACTERISTIC CrCtl_ResBlwGear6IKi_C "PI-Reglerparametersatz für WA+ 6.Gang" VALUE 0xC9424 Kw_Wu32 19999999.9953 Ki_Vel2TrqPrp 0.00 19999999.9953 FORMAT "%13.4" /end CHARACTERISTIC
/begin CHARACTERISTIC CrCtl_ResBlwGear6IKiPos_C "PI-Reglerparametersatz für WA+ 6.Gang" VALUE 0xC9428 Kw_Wu32 19999999.9953 Ki_Vel2TrqPrp 0.00 19999999.9953 FORMAT "%13.4" /end CHARACTERISTIC
/begin CHARACTERISTIC CrCtl_ResBlwGear6IKiNeg_C "PI-Reglerparametersatz für WA+ 6.Gang" VALUE 0xC942C Kw_Wu32 19999999.9953 Ki_Vel2TrqPrp 0.00 19999999.9953 FORMAT "%13.4" /end CHARACTERISTIC
/begin CHARACTERISTIC CrCtl_vResBlwGear6IWinPos_C "PI-Reglerparametersatz für WA+ 6.Gang" VALUE 0xC9430 Kw_Ws16 300.0000 Vel 0.00 300.0000 FORMAT "%8.4" EXTENDED_LIMITS -327.6800 327.6700 /end CHARACTERISTIC
/begin CHARACTERISTIC CrCtl_vResBlwGear6IWinNeg_C "PI-Reglerparametersatz für WA+ 6.Gang" VALUE 0xC9432 Kw_Ws16 300.0000 Vel -300.0000 0.00 FORMAT "%8.4" EXTENDED_LIMITS -327.6800 327.6700 /end CHARACTERISTIC
/begin CHARACTERISTIC CrCtl_ResBlwGear6PKp_C "PI-Reglerparametersatz für WA+ 6.Gang" VALUE 0xC9434 Kw_Wu32 1310719.99969 Kp_Vel2TrqPrp 0.00 1310719.99969 FORMAT "%13.5" /end CHARACTERISTIC
/begin CHARACTERISTIC CrCtl_ResBlwGear6PKpPos_C "PI-Reglerparametersatz für WA+ 6.Gang" VALUE 0xC9438 Kw_Wu32 1310719.99969 Kp_Vel2TrqPrp 0.00 1310719.99969 FORMAT "%13.5" /end CHARACTERISTIC
/begin CHARACTERISTIC CrCtl_ResBlwGear6PKpNeg_C "PI-Reglerparametersatz für WA+ 6.Gang" VALUE 0xC943C Kw_Wu32 1310719.99969 Kp_Vel2TrqPrp 0.00 1310719.99969 FORMAT "%13.5" /end CHARACTERISTIC
/begin CHARACTERISTIC CrCtl_vResBlwGear6PWinPos_C "PI-Reglerparametersatz für WA+ 6.Gang" VALUE 0xC9440 Kw_Ws16 300.0000 Vel 0.00 300.0000 FORMAT "%8.4" EXTENDED_LIMITS -327.6800 327.6700 /end CHARACTERISTIC
/begin CHARACTERISTIC CrCtl_vResBlwGear6PWinNeg_C "PI-Reglerparametersatz für WA+ 6.Gang" VALUE 0xC9442 Kw_Ws16 300.0000 Vel -300.0000 0.00 FORMAT "%8.4" EXTENDED_LIMITS -327.6800 327.6700 /end CHARACTERISTIC
/begin CHARACTERISTIC CrCtl_ResRmpGear2PKp_C "P-Reglerparametersatz für WA 2.Gang" VALUE 0xC9444 Kw_Wu32 1310719.99969 Kp_Vel2TrqPrp 0.00 1310719.99969 FORMAT "%13.5" /end CHARACTERISTIC
/begin CHARACTERISTIC CrCtl_ResRmpGear2PKpPos_C "P-Reglerparametersatz für WA 2.Gang" VALUE 0xC9448 Kw_Wu32 1310719.99969 Kp_Vel2TrqPrp 0.00 1310719.99969 FORMAT "%13.5" /end CHARACTERISTIC
/begin CHARACTERISTIC CrCtl_ResRmpGear2PKpNeg_C "P-Reglerparametersatz für WA 2.Gang" VALUE 0xC944C Kw_Wu32 1310719.99969 Kp_Vel2TrqPrp 0.00 1310719.99969 FORMAT "%13.5" /end CHARACTERISTIC
/begin CHARACTERISTIC CrCtl_vResRmpGear2PWinPos_C "P-Reglerparametersatz für WA 2.Gang" VALUE 0xC9450 Kw_Ws16 300.0000 Vel 0.00 300.0000 FORMAT "%8.4" EXTENDED_LIMITS -327.6800 327.6700 /end CHARACTERISTIC
/begin CHARACTERISTIC CrCtl_vResRmpGear2PWinNeg_C "P-Reglerparametersatz für WA 2.Gang" VALUE 0xC9452 Kw_Ws16 300.0000 Vel -300.0000 0.00 FORMAT "%8.4" EXTENDED_LIMITS -327.6800 327.6700 /end CHARACTERISTIC
/begin CHARACTERISTIC CrCtl_ResRmpGear3PKp_C "P-Reglerparametersatz für WA 3.Gang" VALUE 0xC9454 Kw_Wu32 1310719.99969 Kp_Vel2TrqPrp 0.00 1310719.99969 FORMAT "%13.5" /end CHARACTERISTIC
/begin CHARACTERISTIC CrCtl_ResRmpGear3PKpPos_C "P-Reglerparametersatz für WA 3.Gang" VALUE 0xC9458 Kw_Wu32 1310719.99969 Kp_Vel2TrqPrp 0.00 1310719.99969 FORMAT "%13.5" /end CHARACTERISTIC
/begin CHARACTERISTIC CrCtl_ResRmpGear3PKpNeg_C "P-Reglerparametersatz für WA 3.Gang" VALUE 0xC945C Kw_Wu32 1310719.99969 Kp_Vel2TrqPrp 0.00 1310719.99969 FORMAT "%13.5" /end CHARACTERISTIC
/begin CHARACTERISTIC CrCtl_vResRmpGear3PWinPos_C "P-Reglerparametersatz für WA 3.Gang" VALUE 0xC9460 Kw_Ws16 300.0000 Vel 0.00 300.0000 FORMAT "%8.4" EXTENDED_LIMITS -327.6800 327.6700 /end CHARACTERISTIC
/begin CHARACTERISTIC CrCtl_vResRmpGear3PWinNeg_C "P-Reglerparametersatz für WA 3.Gang" VALUE 0xC9462 Kw_Ws16 300.0000 Vel -300.0000 0.00 FORMAT "%8.4" EXTENDED_LIMITS -327.6800 327.6700 /end CHARACTERISTIC
/begin CHARACTERISTIC CrCtl_ResRmpGear4PKp_C "P-Reglerparametersatz für WA 4.Gang" VALUE 0xC9464 Kw_Wu32 1310719.99969 Kp_Vel2TrqPrp 0.00 1310719.99969 FORMAT "%13.5" /end CHARACTERISTIC
/begin CHARACTERISTIC CrCtl_ResRmpGear4PKpPos_C "P-Reglerparametersatz für WA 4.Gang" VALUE 0xC9468 Kw_Wu32 1310719.99969 Kp_Vel2TrqPrp 0.00 1310719.99969 FORMAT "%13.5" /end CHARACTERISTIC
/begin CHARACTERISTIC CrCtl_ResRmpGear4PKpNeg_C "P-Reglerparametersatz für WA 4.Gang" VALUE 0xC946C Kw_Wu32 1310719.99969 Kp_Vel2TrqPrp 0.00 1310719.99969 FORMAT "%13.5" /end CHARACTERISTIC
/begin CHARACTERISTIC CrCtl_vResRmpGear4PWinPos_C "P-Reglerparametersatz für WA 4.Gang" VALUE 0xC9470 Kw_Ws16 300.0000 Vel 0.00 300.0000 FORMAT "%8.4" EXTENDED_LIMITS -327.6800 327.6700 /end CHARACTERISTIC
/begin CHARACTERISTIC CrCtl_vResRmpGear4PWinNeg_C "P-Reglerparametersatz für WA 4.Gang" VALUE 0xC9472 Kw_Ws16 300.0000 Vel -300.0000 0.00 FORMAT "%8.4" EXTENDED_LIMITS -327.6800 327.6700 /end CHARACTERISTIC
/begin CHARACTERISTIC CrCtl_ResRmpGear5PKp_C "P-Reglerparametersatz für WA 5.Gang" VALUE 0xC9474 Kw_Wu32 1310719.99969 Kp_Vel2TrqPrp 0.00 1310719.99969 FORMAT "%13.5" /end CHARACTERISTIC
/begin CHARACTERISTIC CrCtl_ResRmpGear5PKpPos_C "P-Reglerparametersatz für WA 5.Gang" VALUE 0xC9478 Kw_Wu32 1310719.99969 Kp_Vel2TrqPrp 0.00 1310719.99969 FORMAT "%13.5" /end CHARACTERISTIC
/begin CHARACTERISTIC CrCtl_ResRmpGear5PKpNeg_C "P-Reglerparametersatz für WA 5.Gang" VALUE 0xC947C Kw_Wu32 1310719.99969 Kp_Vel2TrqPrp 0.00 1310719.99969 FORMAT "%13.5" /end CHARACTERISTIC
/begin CHARACTERISTIC CrCtl_vResRmpGear5PWinPos_C "P-Reglerparametersatz für WA 5.Gang" VALUE 0xC9480 Kw_Ws16 300.0000 Vel 0.00 300.0000 FORMAT "%8.4" EXTENDED_LIMITS -327.6800 327.6700 /end CHARACTERISTIC
/begin CHARACTERISTIC CrCtl_vResRmpGear5PWinNeg_C "P-Reglerparametersatz für WA 5.Gang" VALUE 0xC9482 Kw_Ws16 300.0000 Vel -300.0000 0.00 FORMAT "%8.4" EXTENDED_LIMITS -327.6800 327.6700 /end CHARACTERISTIC
/begin CHARACTERISTIC CrCtl_ResRmpGear6PKp_C "P-Reglerparametersatz für WA 6.Gang" VALUE 0xC9484 Kw_Wu32 1310719.99969 Kp_Vel2TrqPrp 0.00 1310719.99969 FORMAT "%13.5" /end CHARACTERISTIC
/begin CHARACTERISTIC CrCtl_ResRmpGear6PKpPos_C "P-Reglerparametersatz für WA 6.Gang" VALUE 0xC9488 Kw_Wu32 1310719.99969 Kp_Vel2TrqPrp 0.00 1310719.99969 FORMAT "%13.5" /end CHARACTERISTIC
/begin CHARACTERISTIC CrCtl_ResRmpGear6PKpNeg_C "P-Reglerparametersatz für WA 6.Gang" VALUE 0xC948C Kw_Wu32 1310719.99969 Kp_Vel2TrqPrp 0.00 1310719.99969 FORMAT "%13.5" /end CHARACTERISTIC
/begin CHARACTERISTIC CrCtl_vResRmpGear6PWinPos_C "P-Reglerparametersatz für WA 6.Gang" VALUE 0xC9490 Kw_Ws16 300.0000 Vel 0.00 300.0000 FORMAT "%8.4" EXTENDED_LIMITS -327.6800 327.6700 /end CHARACTERISTIC
/begin CHARACTERISTIC CrCtl_vResRmpGear6PWinNeg_C "P-Reglerparametersatz für WA 6.Gang" VALUE 0xC9492 Kw_Ws16 300.0000 Vel -300.0000 0.00 FORMAT "%8.4" EXTENDED_LIMITS -327.6800 327.6700 /end CHARACTERISTIC
/begin CHARACTERISTIC CrCtl_rVnDvtShutOff_C "Abweichung v/n-Verhältnis Abschalten FGR" VALUE 0xC8F40 Kw_Ws16 0.3276700 VelToN 0.00 0.3276700 FORMAT "%9.7" EXTENDED_LIMITS -0.3276800 0.3276700 /end CHARACTERISTIC
/begin CHARACTERISTIC CrCtl_stShutOffCodeMsk_C "#SSD Bitmaske zum Ausmaskieren von FGR-Abschaltbedingungen" VALUE 0xC8F44 Kw_Wu32 4294967295.00 OneToOne 0.00 4294967295.00 FORMAT "%13.2" /end CHARACTERISTIC
/begin CHARACTERISTIC CrCtl_stShutOffHDC_C "Shutoff of Hill descent Control" VALUE 0xC8F48 Kw_Wu8 255.0 OneToOne 0.00 255.0 FORMAT "%5.1" /end CHARACTERISTIC
/begin CHARACTERISTIC CrCtl_stShutOffInfoLR_C "informationswert zum ausschalten bei zu geringem abstand" VALUE 0xC8F49 Kw_Wu8 255.0 OneToOne 0.00 255.0 FORMAT "%5.1" /end CHARACTERISTIC
/begin CHARACTERISTIC CrCtl_stShutOffLR_C "Application data for shutoff of LR" VALUE 0xC8F4A Kw_Wu8 255.0 OneToOne 0.00 255.0 FORMAT "%5.1" /end CHARACTERISTIC
/begin CHARACTERISTIC CrCtl_swtCrCtlType_C "Schalter um Typ des Tempomats auszuwählen (1: herkömmlicher Tempomat, 2: Stufentempomat)" VALUE 0xC94CE Kw_Wu8 255.0 OneToOne 0.00 255.0 FORMAT "%5.1" /end CHARACTERISTIC
/begin CHARACTERISTIC CrCtl_swtOffset_C "Umschaltung zwischen gesendeter und berechneter Anzeigegeschwindigkeit (1: berechnete, 0: gesendete)" VALUE 0xC94CF Kw_Wu8 255.0 OneToOne 0.00 255.0 FORMAT "%5.1" /end CHARACTERISTIC
/begin CHARACTERISTIC CrCtl_swtResOff_C "0...keine Wiederaufnahme im Stufentemp. Zustand OFF; 1...Wiederaufnahme im Stufentempomat-Zustand OFF erlaubt" VALUE 0xC9494 Kw_Wu8 255.0 OneToOne 0.00 255.0 FORMAT "%5.1" /end CHARACTERISTIC
/begin CHARACTERISTIC CrCtl_swtSelKombi_C "Schalter zur Auswahl des Kombi-Typs (1: standard, 0: alte version)" VALUE 0xC8F4B Kw_Wu8 255.0 OneToOne 0.00 255.0 FORMAT "%5.1" /end CHARACTERISTIC
/begin CHARACTERISTIC CrCtl_swtShutOffOpt_C "Optionen Abschaltung FGR (bit 0: 1: Ansteuerung der Bremse vor Fahrgeschwindigkeitstest, 0: kein Ansteuern; bit1-7: ungebraucht)" VALUE 0xC8F4C Kw_Wu8 255.0 OneToOne 0.00 255.0 FORMAT "%5.1" /end CHARACTERISTIC
/begin CHARACTERISTIC CrCtl_swtVSSFil_C "Schalter zur Auswahl zwischen gefilterter und ungefilterter Fahrzeug-Ist-Geschwindigkeit (1: gefiltert 0: ungefiltert)" VALUE 0xC94D0 Kw_Wu8 255.0 OneToOne 0.00 255.0 FORMAT "%5.1" /end CHARACTERISTIC
/begin CHARACTERISTIC CrCtl_tiAcc_C "Maximalzeit für Abschaltbedingung ""zu große Beschleunigung""" VALUE 0xC8F4E Kw_Wu16 655350.0 TimeDeb 0.00 655350.0 FORMAT "%8.1" /end CHARACTERISTIC
/begin CHARACTERISTIC CrCtl_tiAqpl_C "Maximalzeit für Aquaplaningerkennung" VALUE 0xC8F50 Kw_Wu16 655350.0 TimeDeb 0.00 655350.0 FORMAT "%8.1" /end CHARACTERISTIC
/begin CHARACTERISTIC CrCtl_tiClCtrDelayABS_C "Entprellung der FGR-Abschaltung bei ABS-Eingriff" VALUE 0xC8F52 Kw_Wu16 655350.0 TimeDeb 0.00 655350.0 FORMAT "%8.1" /end CHARACTERISTIC
/begin CHARACTERISTIC CrCtl_tiClCtrDelayASC_C "debounce time for ASC intervention" VALUE 0xC8F54 Kw_Wu16 655350.0 TimeDeb 0.00 655350.0 FORMAT "%8.1" /end CHARACTERISTIC
/begin CHARACTERISTIC CrCtl_tiClCtrDelayDSC_C "debounce time for DSC intervention" VALUE 0xC8F56 Kw_Wu16 655350.0 TimeDeb 0.00 655350.0 FORMAT "%8.1" /end CHARACTERISTIC
/begin CHARACTERISTIC CrCtl_tiClCtrDelayEBV_C "Entprellung der FGR-Abschaltung bei EBV-Eingriff" VALUE 0xC8F58 Kw_Wu16 655350.0 TimeDeb 0.00 655350.0 FORMAT "%8.1" /end CHARACTERISTIC
/begin CHARACTERISTIC CrCtl_tiClCtrDelayHBA_C "Entprellung der FGR-Abschaltung bei HBA-Eingriff" VALUE 0xC8F5A Kw_Wu16 655350.0 TimeDeb 0.00 655350.0 FORMAT "%8.1" /end CHARACTERISTIC
/begin CHARACTERISTIC CrCtl_tiClCtrDelayMSR_C "debounce time for MSR intervention" VALUE 0xC8F5C Kw_Wu16 655350.0 TimeDeb 0.00 655350.0 FORMAT "%8.1" /end CHARACTERISTIC
/begin CHARACTERISTIC CrCtl_tiDec_C "Entprellzeit zu große Fahrzeugverzögerung für Abschaltung FGR" VALUE 0xC8F5E Kw_Wu16 655350.0 TimeDeb 0.00 655350.0 FORMAT "%8.1" /end CHARACTERISTIC
/begin CHARACTERISTIC CrCtl_tiDisableDiagVCrCtl_C "Time to disable cruise control diagnostics" VALUE 0xC94D4 Kw_Wu32 42949672950.0 Time_ms 0.00 42949672950.0 FORMAT "%13.1" /end CHARACTERISTIC
/begin CHARACTERISTIC CrCtl_tiDispOffFil_C "time delay for tracking speed set point" VALUE 0xC94D8 Kw_Wu32 4294.9673 TimeDelay_s 0.0000010000000 4294.9673 FORMAT "%9.4" /end CHARACTERISTIC
/begin CHARACTERISTIC CrCtl_tiGearDeb_C "Entprellzeit neuer Gang für FGR" VALUE 0xC8F60 Kw_Wu16 655350.0 TimeDeb 0.00 655350.0 FORMAT "%8.1" /end CHARACTERISTIC
/begin CHARACTERISTIC CrCtl_tiNegDvtTi_C "Entprellzeit zu große neg. Geschwindigkeitsabweichung für Abschaltung FGR" VALUE 0xC8F62 Kw_Wu16 655350.0 TimeDeb 0.00 655350.0 FORMAT "%8.1" /end CHARACTERISTIC
/begin CHARACTERISTIC CrCtl_tiOff_C "Dauer zum niederrampen zum gewünschten Drehmoment" VALUE 0xC9496 Kw_Wu16 655350.0 TimeDeb 0.00 655350.0 FORMAT "%8.1" /end CHARACTERISTIC
/begin CHARACTERISTIC CrCtl_tiTipUpDn_C "Erkennungszeit TIP-UP/DOWN" VALUE 0xC9498 Kw_Wu16 655350.0 Time_ms 0.00 655350.0 FORMAT "%8.1" /end CHARACTERISTIC
/begin CHARACTERISTIC CrCtl_tiVSSFil_C "time delay for tracking speed set point" VALUE 0xC94DC Kw_Wu32 4294.9673 TimeDelay_s 0.0000010000000 4294.9673 FORMAT "%9.4" /end CHARACTERISTIC
/begin CHARACTERISTIC CrCtl_trqDesThres_C "Momentenschwelle zur Entscheidung der Momentenrampensteigung zur Momentenreduzierung nach SET+" VALUE 0xC949A Kw_Ws16 500.0000 TrqPrp 0.00 500.0000 FORMAT "%8.4" EXTENDED_LIMITS -6553.600 6553.400 /end CHARACTERISTIC
/begin CHARACTERISTIC CrCtl_trqDes_Vector "#SSD Bypass label, nicht editieren!" VALUE 0xC308E Kw_Wu8 255.0 OneToOne 0.00 255.0 FORMAT "%5.1" /end CHARACTERISTIC
/begin CHARACTERISTIC CrCtl_trqDes_Channel "#SSD Bypass label, nicht editieren!" VALUE 0xC308F Kw_Wu8 255.0 OneToOne 0.00 255.0 FORMAT "%5.1" /end CHARACTERISTIC
/begin CHARACTERISTIC CrCtl_trqLead_Vector "#SSD Bypass label, nicht editieren!" VALUE 0xC3090 Kw_Wu8 255.0 OneToOne 0.00 255.0 FORMAT "%5.1" /end CHARACTERISTIC
/begin CHARACTERISTIC CrCtl_trqLead_Channel "#SSD Bypass label, nicht editieren!" VALUE 0xC3091 Kw_Wu8 255.0 OneToOne 0.00 255.0 FORMAT "%5.1" /end CHARACTERISTIC
/begin CHARACTERISTIC CrCtl_trqMaxOfs_C "Offset auf maximales Moment CoDT_trqMax" VALUE 0xC949C Kw_Ws16 500.0000 TrqPrp 0.00 500.0000 FORMAT "%8.4" EXTENDED_LIMITS -6553.600 6553.400 /end CHARACTERISTIC
/begin CHARACTERISTIC CrCtl_trqOffComf_C "Momentenschwelle für Umschaltung der Rampensteigung bei Komfortabschaltung" VALUE 0xC949E Kw_Ws16 11000.00 TrqPrp -5000.000 6000.000 FORMAT "%8.3" EXTENDED_LIMITS -6553.600 6553.400 /end CHARACTERISTIC
/begin CHARACTERISTIC CrCtl_trqOffFast12_C "Umschaltschwelle von Rampe 1 auf Rampe 2" VALUE 0xC94A0 Kw_Ws16 11000.00 TrqPrp -5000.000 6000.000 FORMAT "%8.3" EXTENDED_LIMITS -6553.600 6553.400 /end CHARACTERISTIC
/begin CHARACTERISTIC CrCtl_trqOffFast23_C "Umschaltschwelle von Rampe 2 auf Rampe 3" VALUE 0xC94A2 Kw_Ws16 11000.00 TrqPrp -5000.000 6000.000 FORMAT "%8.3" EXTENDED_LIMITS -6553.600 6553.400 /end CHARACTERISTIC
/begin CHARACTERISTIC CrCtl_uBattMin_C "min batteriespannung" VALUE 0xC94E0 Kw_Ws16 1281232. Volt_Batt -640625.6 640606.1 FORMAT "%8.1" /end CHARACTERISTIC
/begin CHARACTERISTIC CrCtl_vAccSet_C "Setzwertkorrektur nach SET+" VALUE 0xC94A4 Kw_Ws16 300.0000 Vel 0.00 300.0000 FORMAT "%8.4" EXTENDED_LIMITS -327.6800 327.6700 /end CHARACTERISTIC
/begin CHARACTERISTIC CrCtl_vAlwDvtThres_C "zulässige Regelabweichung für TIP-UP/DOWN FGR" VALUE 0xC94A6 Kw_Ws16 300.0000 Vel 0.00 300.0000 FORMAT "%8.4" EXTENDED_LIMITS -327.6800 327.6700 /end CHARACTERISTIC
/begin CHARACTERISTIC CrCtl_vAlwMaxKm_C "maximal erlaubte FGR-geschw." VALUE 0xC94E2 Kw_Ws16 300.0000 Vel 0.00 300.0000 FORMAT "%8.4" EXTENDED_LIMITS -327.6800 327.6700 /end CHARACTERISTIC
/begin CHARACTERISTIC CrCtl_vAlwMaxM_C "max erlaubte FGR-geschwindigkeit" VALUE 0xC94E4 Kw_Ws16 300.0000 Vel_mph 0.00 300.0000 FORMAT "%8.4" EXTENDED_LIMITS -327.6800 327.6700 /end CHARACTERISTIC
/begin CHARACTERISTIC CrCtl_vAlwMinKm_C "min. erlaubte FGR-geschwindigkeit" VALUE 0xC94E6 Kw_Ws16 300.0000 Vel 0.00 300.0000 FORMAT "%8.4" EXTENDED_LIMITS -327.6800 327.6700 /end CHARACTERISTIC
/begin CHARACTERISTIC CrCtl_vAlwMinM_C "min. erlaubte FGR-geschwindigkeit" VALUE 0xC94E8 Kw_Ws16 300.0000 Vel_mph 0.00 300.0000 FORMAT "%8.4" EXTENDED_LIMITS -327.6800 327.6700 /end CHARACTERISTIC
/begin CHARACTERISTIC CrCtl_vDeclSet_C "Setzwertkorrektur nach SET-" VALUE 0xC94A8 Kw_Ws16 300.0000 Vel 0.00 300.0000 FORMAT "%8.4" EXTENDED_LIMITS -327.6800 327.6700 /end CHARACTERISTIC
/begin CHARACTERISTIC CrCtl_vDiffAccMax_C "Geschwindigkeitsschwelle für Setzwertkorrektur nach SET+" VALUE 0xC94AA Kw_Ws16 300.0000 Vel 0.00 300.0000 FORMAT "%8.4" EXTENDED_LIMITS -327.6800 327.6700 /end CHARACTERISTIC
/begin CHARACTERISTIC CrCtl_vDiffAcc_C "Geschwindigkeitsoffset für doppelte Momentenrampensteigung bei Übergang EIN+ zu HALTEN des FGR" VALUE 0xC94AC Kw_Ws16 300.0000 Vel 0.00 300.0000 FORMAT "%8.4" EXTENDED_LIMITS -327.6800 327.6700 /end CHARACTERISTIC
/begin CHARACTERISTIC CrCtl_vDiffAqpl_C "Geschwindigkeitsdifferenz für Aquaplaningerkennung" VALUE 0xC8F64 Kw_Ws16 300.0000 Vel 0.00 300.0000 FORMAT "%8.4" EXTENDED_LIMITS -327.6800 327.6700 /end CHARACTERISTIC
/begin CHARACTERISTIC CrCtl_vDiffDeclMax_C "Geschwindigkeitsschwelle für Setzwertkorrektur nach SET-" VALUE 0xC94AE Kw_Ws16 300.0000 Vel 0.00 300.0000 FORMAT "%8.4" EXTENDED_LIMITS -327.6800 327.6700 /end CHARACTERISTIC
/begin CHARACTERISTIC CrCtl_vDiffDecl_C "Geschwindigkeitsoffset für doppelte Momentenrampensteigung bei Übergang EIN- zu HALTEN des FGR" VALUE 0xC94B0 Kw_Ws16 300.0000 Vel 0.00 300.0000 FORMAT "%8.4" EXTENDED_LIMITS -327.6800 327.6700 /end CHARACTERISTIC
/begin CHARACTERISTIC CrCtl_vDiffResAbv_C "Schwelle Differenz Ist- und Sollgeschwindigkeit für Reduzierung Zielgeschwindigkeitsrampe bei WA von oben" VALUE 0xC94B2 Kw_Ws16 300.0000 Vel 0.00 300.0000 FORMAT "%8.4" EXTENDED_LIMITS -327.6800 327.6700 /end CHARACTERISTIC
/begin CHARACTERISTIC CrCtl_vDiffResBlw_C "Schwelle Differenz Ist- und Sollgeschwindigkeit für Reduzierung Zielgeschwindigkeitsrampe bei WA von unten" VALUE 0xC94B4 Kw_Ws16 300.0000 Vel 0.00 300.0000 FORMAT "%8.4" EXTENDED_LIMITS -327.6800 327.6700 /end CHARACTERISTIC
/begin CHARACTERISTIC CrCtl_vDvtNegTipDwn_C "FGR: zulässige negative Regelabweichung TIP-DWN" VALUE 0xC94B6 Kw_Ws16 300.0000 Vel 0.00 300.0000 FORMAT "%8.4" EXTENDED_LIMITS -327.6800 327.6700 /end CHARACTERISTIC
/begin CHARACTERISTIC CrCtl_vDvtNegTipUp_C "FGR: zulässige negative Regelabweichung TIP-UP" VALUE 0xC94B8 Kw_Ws16 300.0000 Vel 0.00 300.0000 FORMAT "%8.4" EXTENDED_LIMITS -327.6800 327.6700 /end CHARACTERISTIC
/begin CHARACTERISTIC CrCtl_vDvtPosTipDwn_C "FGR: zulässige positive Regelabweichung TIP-DWN" VALUE 0xC94BA Kw_Ws16 300.0000 Vel 0.00 300.0000 FORMAT "%8.4" EXTENDED_LIMITS -327.6800 327.6700 /end CHARACTERISTIC
/begin CHARACTERISTIC CrCtl_vMaxShutOff_C "obere Grenze Fahrgeschwindigkeit Abschaltung FGR" VALUE 0xC8F66 Kw_Ws16 300.0000 Vel 0.00 300.0000 FORMAT "%8.4" EXTENDED_LIMITS -327.6800 327.6700 /end CHARACTERISTIC
/begin CHARACTERISTIC CrCtl_vMinShutOff_C "untere Grenze Fahrgeschwindigkeit Abschaltung FGR" VALUE 0xC8F68 Kw_Ws16 300.0000 Vel 0.00 300.0000 FORMAT "%8.4" EXTENDED_LIMITS -327.6800 327.6700 /end CHARACTERISTIC
/begin CHARACTERISTIC CrCtl_vNegDvtTi_C "negative Geschwindigkeitsabweichung Abschaltung FGR nach Entprellzeit" VALUE 0xC8F6A Kw_Ws16 300.0000 Vel 0.00 300.0000 FORMAT "%8.4" EXTENDED_LIMITS -327.6800 327.6700 /end CHARACTERISTIC
/begin CHARACTERISTIC CrCtl_vNegDvt_C "negative Geschwindigkeitsabweichung Abschaltung FGR" VALUE 0xC8F6C Kw_Ws16 300.0000 Vel 0.00 300.0000 FORMAT "%8.4" EXTENDED_LIMITS -327.6800 327.6700 /end CHARACTERISTIC
/begin CHARACTERISTIC CrCtl_vOffMax_C "Maximum velocity of cruise control" VALUE 0xC94EA Kw_Ws16 300.0000 Vel 0.00 300.0000 FORMAT "%8.4" EXTENDED_LIMITS -327.6800 327.6700 /end CHARACTERISTIC
/begin CHARACTERISTIC CrCtl_vOfsDecl_C "neg. Offset für Sollgeschwindigkeit für Übergang EIN- zu HALTEN des FGR" VALUE 0xC94BC Kw_Ws16 300.0000 Vel 0.00 300.0000 FORMAT "%8.4" EXTENDED_LIMITS -327.6800 327.6700 /end CHARACTERISTIC
/begin CHARACTERISTIC CrCtl_vOfsResBlw_C "Geschwindigkeitsoffset für Übergang WA+ --> Konstantfahrt" VALUE 0xC94BE Kw_Ws16 300.0000 Vel 0.00 300.0000 FORMAT "%8.4" EXTENDED_LIMITS -327.6800 327.6700 /end CHARACTERISTIC
/begin CHARACTERISTIC CrCtl_vOfsRes_C "Offset FGR-Sollgeschwindigkeit für Übergang WA zu HALTEN" VALUE 0xC94C0 Kw_Ws16 300.0000 Vel 0.00 300.0000 FORMAT "%8.4" EXTENDED_LIMITS -327.6800 327.6700 /end CHARACTERISTIC
/begin CHARACTERISTIC CrCtl_vPosDvt_C "positive Geschwindigkeitsabweichung Abschaltung FGR" VALUE 0xC8F6E Kw_Ws16 300.0000 Vel 0.00 300.0000 FORMAT "%8.4" EXTENDED_LIMITS -327.6800 327.6700 /end CHARACTERISTIC
/begin CHARACTERISTIC CrCtl_vRlsOfsI_C "FGR, Offset-Schwellwert für Freigabe Integrator" VALUE 0xC94C2 Kw_Ws16 300.0000 Vel 0.00 300.0000 FORMAT "%8.4" EXTENDED_LIMITS -327.6800 327.6700 /end CHARACTERISTIC
/begin CHARACTERISTIC CrCtl_vTipStep_C "#SSD FGR TIP-UP/DOWN Geschwindigkeitsschritt" VALUE 0xC94C4 Kw_Ws16 300.0000 Vel 0.00 300.0000 FORMAT "%8.4" EXTENDED_LIMITS -327.6800 327.6700 /end CHARACTERISTIC
/begin CHARACTERISTIC CrSCD_ctGapIncs_C "#SSD Kurbelwellenkonfiguration: Anzahl der fehlenden Inkremente in der Lücke (virtuelle Inkremente)" VALUE 0xC05F2 Kw_Wu8 0.00 OneToOne 2.000 2.000 FORMAT "%5.3" EXTENDED_LIMITS 0.00 255.0 /end CHARACTERISTIC
/begin CHARACTERISTIC CrSCD_ctGaps_C "#SSD Kurbelwellenkonfiguration: Anzahl der Lücken auf dem Inkrementgeberrad" VALUE 0xC05F3 Kw_Wu8 3.000 OneToOne 1.000 4.000 FORMAT "%5.3" EXTENDED_LIMITS 0.00 255.0 /end CHARACTERISTIC
/begin CHARACTERISTIC CrSCD_ctIncs_C "#SSD Kurbelwellenkonfiguration: Anzahl der Inkremente einschließlich virtueller Lückenzähne" VALUE 0xC05F4 Kw_Wu8 110.0 OneToOne 10.00 120.0 FORMAT "%5.1" EXTENDED_LIMITS 0.00 255.0 /end CHARACTERISTIC
/begin CHARACTERISTIC CrSCD_ctThresCtlMin_C "#SSD Kleinste Schwelle der dyn. Schwellennachführung des Kurbelwellensignals" VALUE 0xC05EC Kw_Wu8 7.000 OneToOne 0.00 7.000 FORMAT "%5.3" EXTENDED_LIMITS 0.00 255.0 /end CHARACTERISTIC
/begin CHARACTERISTIC CrSCD_ctTurns_C "#SSD Anzahl der Kurbelwellenumdrehungen pro Nockenwellenumdrehung (1 = 2 Takter, 2 = 4 Takter)" VALUE 0xC05DA Kw_Wu8 1.000 OneToOne 1.000 2.000 FORMAT "%5.3" EXTENDED_LIMITS 0.00 255.0 /end CHARACTERISTIC
/begin CHARACTERISTIC CrSCD_facGapPlausHigh_CUR "#SSD Verhältnis zur Bestimmung der oberen Grenze des Fensters zur Lückenplausibilisierung des Inkrementsignals" CURVE 0xC951E Kl_Xs16_Ws16 3.000000 Fact_Inc 3.000000 6.000000 FORMAT "%8.6" EXTENDED_LIMITS -128.0000 127.9961
 /begin AXIS_DESCR STD_AXIS CrSCD_tiIncr TimeDT 10 100.0000 32767.00 FORMAT "%8.2" EXTENDED_LIMITS 0.00 65535.00 DEPOSIT ABSOLUTE /end AXIS_DESCR
/end CHARACTERISTIC
/begin CHARACTERISTIC CrSCD_facGapPlausLow_CUR "#SSD Verhältnis zur Bestimmung der unteren Grenze des Fensters zur Lückenplausibilisierung des Inkrementsignals" CURVE 0xC9548 Kl_Xs16_Ws16 3.000000 Fact_Inc 0.00 3.000000 FORMAT "%8.6" EXTENDED_LIMITS -128.0000 127.9961
 /begin AXIS_DESCR STD_AXIS CrSCD_tiIncr TimeDT 10 100.0000 32767.00 FORMAT "%8.2" EXTENDED_LIMITS 0.00 65535.00 DEPOSIT ABSOLUTE /end AXIS_DESCR
/end CHARACTERISTIC
/begin CHARACTERISTIC CrSCD_facIncPlausHigh_CUR "#SSD Verhältnis zur Bestimmung der obere Grenze des Fensters zur Plausibilisierung des Inkrementsignals" CURVE 0xC9572 Kl_Xs16_Ws16 1.000000 Fact_Inc 1.000000 2.000000 FORMAT "%8.6" EXTENDED_LIMITS -128.0000 127.9961
 /begin AXIS_DESCR STD_AXIS CrSCD_tiIncr TimeDT 10 100.0000 32767.00 FORMAT "%8.2" EXTENDED_LIMITS 0.00 65535.00 DEPOSIT ABSOLUTE /end AXIS_DESCR
/end CHARACTERISTIC
/begin CHARACTERISTIC CrSCD_facIncPlausLow_CUR "#SSD Verhältnis zur Bestimmung der unteren Grenze des Fensters zur Plausibilisierung des Inkrementsignals" CURVE 0xC959C Kl_Xs16_Ws16 1.000000 Fact_Inc 0.00 1.000000 FORMAT "%8.6" EXTENDED_LIMITS -128.0000 127.9961
 /begin AXIS_DESCR STD_AXIS CrSCD_tiIncr TimeDT 10 100.0000 32767.00 FORMAT "%8.2" EXTENDED_LIMITS 0.00 65535.00 DEPOSIT ABSOLUTE /end AXIS_DESCR
/end CHARACTERISTIC
/begin CHARACTERISTIC CrSCD_nFast_C "#SSD Frequenz für das winkelsynchrone Interruptsystem, wenn kein Inkrementsignal vorhanden" VALUE 0xC05DC Kw_Ws16 8000.000 EngN 0.00 8000.000 FORMAT "%8.3" EXTENDED_LIMITS -32768.00 32767.00 /end CHARACTERISTIC
/begin CHARACTERISTIC CrSCD_nMax_C "#SSD Größte zulässige Frequenz des Inkrementsignals" VALUE 0xC05DE Kw_Ws16 2000.000 EngN 5000.000 7000.000 FORMAT "%8.3" EXTENDED_LIMITS -32768.00 32767.00 /end CHARACTERISTIC
/begin CHARACTERISTIC CrSCD_nMin_C "#SSD Kleinste zulässige Frequenz des Inkrementsignals" VALUE 0xC05E0 Kw_Ws16 480.0000 EngN 20.00000 500.0000 FORMAT "%8.4" EXTENDED_LIMITS -32768.00 32767.00 /end CHARACTERISTIC
/begin CHARACTERISTIC CrSCD_nSlowHigh_C "#SSD Obere Drehzahlschwelle ab der das Slow-Bit für die Diahnose zurückgesetzt wird" VALUE 0xC05E2 Kw_Ws16 3000.000 EngN 0.00 3000.000 FORMAT "%8.3" EXTENDED_LIMITS -32768.00 32767.00 /end CHARACTERISTIC
/begin CHARACTERISTIC CrSCD_nSlow_C "#SSD Schwelle ab der Unterdrehzahl gemeldet wird" VALUE 0xC05E4 Kw_Ws16 1000.000 EngN 0.00 1000.000 FORMAT "%8.3" EXTENDED_LIMITS -32768.00 32767.00 /end CHARACTERISTIC
/begin CHARACTERISTIC CrSCD_nThresCtlHigh_C "#SSD Obere Schwelle zur Aktiviereung der dyn. Schwellennachführung" VALUE 0xC05EE Kw_Ws16 65535.00 EngN -32768.00 32767.00 FORMAT "%8.2" /end CHARACTERISTIC
/begin CHARACTERISTIC CrSCD_nThresCtlLow_C "#SSD Untere Schwelle zur Aktivierung der dyn. Schwellennachführung" VALUE 0xC05F0 Kw_Ws16 65535.00 EngN -32768.00 32767.00 FORMAT "%8.2" /end CHARACTERISTIC
/begin CHARACTERISTIC CrSCD_numFBCSeg_C "#SSD Anzahl der FBC segmente" VALUE 0xC05F5 Kw_Wu8 7.000 OneToOne 1.000 8.000 FORMAT "%5.3" EXTENDED_LIMITS 0.00 255.0 READ_ONLY /end CHARACTERISTIC
/begin CHARACTERISTIC CrSCD_numShftMisf_C "#SSD Phasenverschiebung Segmentsystem für Aussetzererkennung (in MAR-Segmenten)" VALUE 0xC05E6 Kw_Wu8 1.000 OneToOne 0.00 1.000 FORMAT "%5.3" EXTENDED_LIMITS 0.00 255.0 /end CHARACTERISTIC
/begin CHARACTERISTIC CrSCD_numTDCSeg_C "#SSD Anzahl der Segment pro OT" VALUE 0xC05F6 Kw_Wu8 0.00 OneToOne 2.000 2.000 FORMAT "%5.3" EXTENDED_LIMITS 0.00 255.0 READ_ONLY /end CHARACTERISTIC
/begin CHARACTERISTIC CrSCD_phiGap2Zero_C "#SSD Winkel zwischen Lücke und physikalischer Nullposition" VALUE 0xC05F8 Kw_Ws16 720.0000 AngleCrS 0.00 720.0000 FORMAT "%8.4" EXTENDED_LIMITS -768.0000 767.9766 /end CHARACTERISTIC
/begin CHARACTERISTIC CrSCD_phiIncCor_CUR "#SSD Phasenkorrekturkennlinie des Inkrementsystems der Kurbelwelle" CURVE 0xC94EC Kl_Xs16_Ws16 50.01562 AngleCrS -25.00781 25.00781 FORMAT "%8.5" EXTENDED_LIMITS -768.0000 767.9766
 /begin AXIS_DESCR STD_AXIS CrSCD_nAvrg EngN 12 0.00 6000.000 FORMAT "%8.3" EXTENDED_LIMITS -32768.00 32767.00 DEPOSIT ABSOLUTE /end AXIS_DESCR
/end CHARACTERISTIC
/begin CHARACTERISTIC CrSCD_phiSegLength_C "#SSD Kurbelwellenkonfiguration: Segementlänge" VALUE 0xC05E8 Kw_Ws16 90.00000 AngleCrS 30.00000 120.0000 FORMAT "%8.4" EXTENDED_LIMITS -768.0000 767.9766 /end CHARACTERISTIC
/begin CHARACTERISTIC CrSCD_phiSegPhase_C "#SSD Phasenlage der Drehzahlsegmente zum OT" VALUE 0xC05EA Kw_Ws16 720.0000 AngleCrS 0.00 720.0000 FORMAT "%8.4" EXTENDED_LIMITS -768.0000 767.9766 /end CHARACTERISTIC
/begin CHARACTERISTIC CrSCD_tiPlausCalcOff_C "#SSD Schwelle zum Abschalten der Berechnung der Plausibilitätsfenster" VALUE 0xC05FA Kw_Ws16 32767.00 TimeDT 0.00 32767.00 FORMAT "%8.2" EXTENDED_LIMITS -32768.00 32767.00 /end CHARACTERISTIC
/begin CHARACTERISTIC CrS_ctMaxInjStrt_C "#SSD Maximale Anzahl von Testeinspritzungen" VALUE 0xC05C6 Kw_Wu16 100.0000 OneToOne 0.00 100.0000 FORMAT "%8.4" EXTENDED_LIMITS 0.00 65535.00 /end CHARACTERISTIC
/begin CHARACTERISTIC CrS_facSegTimeMax_C "#SSD Maximales Verhältnis der Segmentzeiten, das eine konstante Motordrehzahl signalisiert" VALUE 0xC05C8 Kw_Ws32 100.000000000 Fact1 0.00 100.000000000 FORMAT "%13.9" EXTENDED_LIMITS -16777216.0000 16777215.9922 /end CHARACTERISTIC
/begin CHARACTERISTIC CrS_facSegTimeMin_C "#SSD Minimales Verhältnis der Segmentzeiten, das eine konstante Motordrehzahl signalisiert" VALUE 0xC05CC Kw_Ws32 100.000000000 Fact1 0.00 100.000000000 FORMAT "%13.9" EXTENDED_LIMITS -16777216.0000 16777215.9922 /end CHARACTERISTIC
/begin CHARACTERISTIC CrS_facSegTime_C "#SSD Verhältnis der Segmentzeiten" VALUE 0xC05D0 Kw_Ws32 99.0000000000 Fact1 1.00000000000 100.000000000 FORMAT "%13.9" EXTENDED_LIMITS -16777216.0000 16777215.9922 /end CHARACTERISTIC
/begin CHARACTERISTIC CrS_phiSegLengthStrtSpd_C "#SSD Segmentlänge, die berechnet werden soll" VALUE 0xC05D4 Kw_Ws16 180.0000 AngleCrS 0.00 180.0000 FORMAT "%8.4" EXTENDED_LIMITS -768.0000 767.9766 /end CHARACTERISTIC
/begin CHARACTERISTIC CrS_phiSegOfsStrtSpdOld_C "#SSD Segment Offset des alten Segmentes bezüglich TDC" VALUE 0xC05D6 Kw_Ws16 1440.000 AngleCrS -720.0000 720.0000 FORMAT "%8.4" EXTENDED_LIMITS -768.0000 767.9766 /end CHARACTERISTIC
/begin CHARACTERISTIC CrS_phiSegOfsStrtSpd_C "#SSD Segment Offset des aktuellen Segmentes bezüglich TDC" VALUE 0xC05D8 Kw_Ws16 1440.000 AngleCrS -720.0000 720.0000 FORMAT "%8.4" EXTENDED_LIMITS -768.0000 767.9766 /end CHARACTERISTIC
/begin CHARACTERISTIC CTSCD_uSRCMin_C "Minimalwert für SRC WTF-Sensor" VALUE 0xC95C8 Kw_Ws16 5200.391 Volt 0.00 5200.391 FORMAT "%8.3" EXTENDED_LIMITS -160156.4 160151.5 /end CHARACTERISTIC
/begin CHARACTERISTIC CTSCD_uSRCMax_C "Maximalwert für SRC WTF-Sensor" VALUE 0xC95CA Kw_Ws16 5200.391 Volt 0.00 5200.391 FORMAT "%8.3" EXTENDED_LIMITS -160156.4 160151.5 /end CHARACTERISTIC
/begin CHARACTERISTIC CTSCD_tLin_CUR "Linearisierungskennlinie für WTF-Sensor" CURVE 0xC95CC Kl_Xs16_Ws16 950.0000 Temp_Cels -50.1400 899.8600 FORMAT "%8.4" EXTENDED_LIMITS -3549.940 3003.560
 /begin AXIS_DESCR STD_AXIS CTSCD_uRaw Volt 20 0.00 5200.391 FORMAT "%8.3" EXTENDED_LIMITS -160156.4 160151.5 DEPOSIT ABSOLUTE /end AXIS_DESCR
/end CHARACTERISTIC
/begin CHARACTERISTIC CTSCD_DebSigDef_C "#SSD Fehlerentprellung Wassertemperatur über CAN" VALUE 0xC961E Kw_Wu16 655350.0 Time_ms 0.00 655350.0 FORMAT "%8.1" /end CHARACTERISTIC
/begin CHARACTERISTIC CTSCD_DebSigOk_C "Heilungsentprellung Wassertemperatur über CAN" VALUE 0xC9620 Kw_Wu16 655350.0 Time_ms 0.00 655350.0 FORMAT "%8.1" /end CHARACTERISTIC
/begin CHARACTERISTIC CTSCD_DebSRCHighDef_C "#SSD WTF Fehlerentprellzeit fuer SRC-High" VALUE 0xC9622 Kw_Wu16 655350.0 Time_ms 0.00 655350.0 FORMAT "%8.1" /end CHARACTERISTIC
/begin CHARACTERISTIC CTSCD_DebSRCHighOk_C "WTF Heilungsentprellzeit fuer SRC-High" VALUE 0xC9624 Kw_Wu16 655350.0 Time_ms 0.00 655350.0 FORMAT "%8.1" /end CHARACTERISTIC
/begin CHARACTERISTIC CTSCD_DebSRCLowDef_C "#SSD WTF Fehlerentprellzeit fuer SRC-Low" VALUE 0xC9626 Kw_Wu16 655350.0 Time_ms 0.00 655350.0 FORMAT "%8.1" /end CHARACTERISTIC
/begin CHARACTERISTIC CTSCD_DebSRCLowOk_C "WTF Heilungsentprellzeit fuer SRC-Low" VALUE 0xC9628 Kw_Wu16 655350.0 Time_ms 0.00 655350.0 FORMAT "%8.1" /end CHARACTERISTIC
/begin CHARACTERISTIC CTSCD_dtRmpSlp2UpDwn_C "Auf- und Abwärts Rampensteigung im Zustand 2 beim Übergang  zweier Ersatzwerte für den Wassertemperaturfühler" VALUE 0xC962C Kw_Wu32 6553598.99749 RmpTemp 1.00097656250 6553599.99847 FORMAT "%13.5" EXTENDED_LIMITS 0.00 6553599.99847 /end CHARACTERISTIC
/begin CHARACTERISTIC CTSCD_dtFlTempUp_C "ramp slope up in C/ms" VALUE 0xC9630 Kw_Wu32 6553.59899750 RmpTempCels 0.00100097656250 6553.59999847 FORMAT "%13.8" EXTENDED_LIMITS 0.00 6553.59999847 /end CHARACTERISTIC
/begin CHARACTERISTIC CTSCD_dtFlTempDwn_C " ramp slope down in C/ms" VALUE 0xC9634 Kw_Wu32 6553.59899750 RmpTempCels 0.00100097656250 6553.59999847 FORMAT "%13.8" EXTENDED_LIMITS 0.00 6553.59999847 /end CHARACTERISTIC
/begin CHARACTERISTIC CTSCD_numAdc_C "#SSD Applikationsparameter fuer Kuehlwassertemperatur-Fuehler" VALUE 0xC9638 Kw_Wu8 46.0000000000 NumPinAdc 0.00 46.0000000000 FORMAT "%13.10" /end CHARACTERISTIC
/begin CHARACTERISTIC CTSCD_dtRmpSlp1Up_C "Aufwärts Rampensteigung  im Zustand 1 bei  Übergang Messwert  Vorgabewert für WTF" VALUE 0xC963C Kw_Wu32 6553598.99749 RmpTemp 1.00097656250 6553599.99847 FORMAT "%13.5" EXTENDED_LIMITS 0.00 6553599.99847 /end CHARACTERISTIC
/begin CHARACTERISTIC CTSCD_dtRmpSlp1Dwn_C "Abwärtsrampensteigung im Zustand 1 beim Übergang  Messwert Vorgabewert   für WTF" VALUE 0xC9640 Kw_Wu32 6553598.99749 RmpTemp 1.00097656250 6553599.99847 FORMAT "%13.5" EXTENDED_LIMITS 0.00 6553599.99847 /end CHARACTERISTIC
/begin CHARACTERISTIC CTSCD_stSensIDWord_C "#SSD Geberkennwort WTF-Sensor" VALUE 0xC9644 Kw_Wu8 255.0 OneToOne 0.00 255.0 FORMAT "%5.1" /end CHARACTERISTIC
/begin CHARACTERISTIC CTSCD_swtPHtrIgnoreCAN_C "Schalter um Wert von CAN oder HW zu wählen (1: CAN, 0: HW)" VALUE 0xC9645 Kw_Wu8 1.000 OneToOne 0.00 1.000 FORMAT "%5.3" EXTENDED_LIMITS 0.00 255.0 /end CHARACTERISTIC
/begin CHARACTERISTIC CTSCD_swtSigVal_C "Signalquelle ADC/CAN (0: ADC, 1: CAN)" VALUE 0xC9646 Kw_Wu8 1.000 OneToOne 0.00 1.000 FORMAT "%5.3" EXTENDED_LIMITS 0.00 255.0 /end CHARACTERISTIC
/begin CHARACTERISTIC CTSCD_tClntPMin_C "Threshold Value of Coolant Temperature before Correction" VALUE 0xC9648 Kw_Ws16 250.0000 Temp_Cels -50.14000 199.8600 FORMAT "%8.4" EXTENDED_LIMITS -3549.940 3003.560 /end CHARACTERISTIC
/begin CHARACTERISTIC CTSCD_tDflCold_C "Wassertemperatur-Vorgabewert  im  Glüh und Startvorgang bei defektem WTS-Sensor" VALUE 0xC964A Kw_Ws16 950.0000 Temp_Cels -50.1400 899.8600 FORMAT "%8.4" EXTENDED_LIMITS -3549.940 3003.560 /end CHARACTERISTIC
/begin CHARACTERISTIC CTSCD_tDflWarm_C "Wassertemperatur-Vorgabewert  nach Glüh und Startvorgang  bei defektem WTS-Sensor" VALUE 0xC964C Kw_Ws16 950.0000 Temp_Cels -50.1400 899.8600 FORMAT "%8.4" EXTENDED_LIMITS -3549.940 3003.560 /end CHARACTERISTIC
/begin CHARACTERISTIC CTSCD_tDiffThres_C "Difference Threshold value of Fuel and Coolant Temperature" VALUE 0xC964E Kw_Ws16 250.0000 Temp_Cels -50.14000 199.8600 FORMAT "%8.4" EXTENDED_LIMITS -3549.940 3003.560 /end CHARACTERISTIC
/begin CHARACTERISTIC CTSCD_tFuelMin_C "Threshold Value of Fuel Temperature" VALUE 0xC9650 Kw_Ws16 250.0000 Temp_Cels -50.14000 199.8600 FORMAT "%8.4" EXTENDED_LIMITS -3549.940 3003.560 /end CHARACTERISTIC
/begin CHARACTERISTIC CTSCD_tiWait_C "Time delay to set CTSCD_stPHtr 5th Bit" VALUE 0xC9652 Kw_Wu16 655350.0 Time_ms 0.00 655350.0 FORMAT "%8.1" /end CHARACTERISTIC
/begin CHARACTERISTIC CWBGSTUT "0: Programmiermodus gesperrt, 1: Programmiermodus verfügbar" VALUE 0xC05BE KwWU8 255.0 dez 0.00 255.0 FORMAT "%5.1" /end CHARACTERISTIC
/begin CHARACTERISTIC CycSigCheck_nLimit_C "" VALUE 0xC9654 Kw_Wu16 6000.000 EngN 0.00 6000.000 FORMAT "%8.3" EXTENDED_LIMITS 0.00 65535.00 /end CHARACTERISTIC
/begin CHARACTERISTIC CycSigCheck_swtMode_C "" VALUE 0xC9656 Kw_Wu8 1.000 OneToOne 0.00 1.000 FORMAT "%5.3" EXTENDED_LIMITS 0.00 255.0 /end CHARACTERISTIC
/begin CHARACTERISTIC CycSigCheck_swtOff_C "" VALUE 0xC9657 Kw_Wu8 1.000 OneToOne 0.00 1.000 FORMAT "%5.3" EXTENDED_LIMITS 0.00 255.0 /end CHARACTERISTIC
/begin CHARACTERISTIC DCC_DebPlausTrqDesDef_C "Defektzeit des Fehlerpfad Plausibilitaet Radmoment-Anforderung" VALUE 0xC9658 Kw_Wu16 65535.00 OneToOne 0.00 65535.00 FORMAT "%8.2" /end CHARACTERISTIC
/begin CHARACTERISTIC DCC_DebPlausTrqDesOk_C "Heilungszeit des Fehlerpfad Plausibilitaet Radmoment-Anforderung" VALUE 0xC965A Kw_Wu16 65535.00 OneToOne 0.00 65535.00 FORMAT "%8.2" /end CHARACTERISTIC
/begin CHARACTERISTIC DCC_EngSpdKi_C "deviation is within small signal bounds" VALUE 0xC965C Kw_Wu32 799999.999814 Ki_rpm2Nm 0.00 799999.999814 FORMAT "%13.6" /end CHARACTERISTIC
/begin CHARACTERISTIC DCC_EngSpdKiPos_C "deviation is greater than small signal bound" VALUE 0xC9660 Kw_Wu32 799999.999814 Ki_rpm2Nm 0.00 799999.999814 FORMAT "%13.6" /end CHARACTERISTIC
/begin CHARACTERISTIC DCC_EngSpdKiNeg_C "deviation is smaller than small signal bound" VALUE 0xC9664 Kw_Wu32 799999.999814 Ki_rpm2Nm 0.00 799999.999814 FORMAT "%13.6" /end CHARACTERISTIC
/begin CHARACTERISTIC DCC_nEngSpdIWinPos_C "Obere Kleinsignalgrenze für das I-Glied des PI-Reglers" VALUE 0xC9668 Kw_Ws16 8191.875 EngN_HiRes -4096.000 4095.875 FORMAT "%8.3" /end CHARACTERISTIC
/begin CHARACTERISTIC DCC_nEngSpdIWinNeg_C "Untere Kleinsignalgrenze für das I-Glied des PIDT1-Reglers" VALUE 0xC966A Kw_Ws16 8191.875 EngN_HiRes -4096.000 4095.875 FORMAT "%8.3" /end CHARACTERISTIC
/begin CHARACTERISTIC DCC_EngSpdKp_C "deviation is within small signal bounds" VALUE 0xC966C Kw_Wu32 52428.7999878 Kp_rpm2Nm 0.00 52428.7999878 FORMAT "%13.7" /end CHARACTERISTIC
/begin CHARACTERISTIC DCC_EngSpdKpPos_C "deviation is greater than small signal bound" VALUE 0xC9670 Kw_Wu32 52428.7999878 Kp_rpm2Nm 0.00 52428.7999878 FORMAT "%13.7" /end CHARACTERISTIC
/begin CHARACTERISTIC DCC_EngSpdKpNeg_C "deviation is smaller than small signal bound" VALUE 0xC9674 Kw_Wu32 52428.7999878 Kp_rpm2Nm 0.00 52428.7999878 FORMAT "%13.7" /end CHARACTERISTIC
/begin CHARACTERISTIC DCC_nEngSpdPWinPos_C "Obere Kleinsignalgrenze für das P-Glied des PI-Reglers" VALUE 0xC9678 Kw_Ws16 8191.875 EngN_HiRes -4096.000 4095.875 FORMAT "%8.3" /end CHARACTERISTIC
/begin CHARACTERISTIC DCC_nEngSpdPWinNeg_C "Untere Kleinsignalgrenze für das P-Glied des PIDT1-Reglers" VALUE 0xC967A Kw_Ws16 8191.875 EngN_HiRes -4096.000 4095.875 FORMAT "%8.3" /end CHARACTERISTIC
/begin CHARACTERISTIC DCC_lWheelDyn_C "Radumfang des Fahrzeug-Rad" VALUE 0xC967C Kw_Ws16 99.99219 Length1 0.007812500 100.0000 FORMAT "%8.4" EXTENDED_LIMITS -256.0000 255.9922 /end CHARACTERISTIC
/begin CHARACTERISTIC DCC_nSetPoint_CUR "Kennlinie fuer DCC setpoint" CURVE 0xC967E Kl_Xs16_Ws16 5000.000 EngN 0.00 5000.000 FORMAT "%8.3" EXTENDED_LIMITS -32768.00 32767.00
 /begin AXIS_DESCR STD_AXIS DCC_nSetPointRaw_mp EngN 6 0.00 5000.000 FORMAT "%8.3" EXTENDED_LIMITS -32768.00 32767.00 DEPOSIT ABSOLUTE /end AXIS_DESCR
/end CHARACTERISTIC
/begin CHARACTERISTIC DCC_nShft_C "Drehzahlschwelle Gangerkennung" VALUE 0xC9698 Kw_Ws16 8000.000 EngN 0.00 8000.000 FORMAT "%8.3" EXTENDED_LIMITS -32768.00 32767.00 /end CHARACTERISTIC
/begin CHARACTERISTIC DCC_numGearMax_C "Anzahl Getreibegaenge" VALUE 0xC969A Kw_Ws8 7.000 OneToOne -1.000 6.000 FORMAT "%5.3" EXTENDED_LIMITS -128.0 127.0 /end CHARACTERISTIC
/begin CHARACTERISTIC DCC_swtARWMode_C "Schalten  für das Entscheiden des    Anti-Reset-Windup   Verhaltens" VALUE 0xC969B Kw_Wu8 255.0 OneToOne 0.00 255.0 FORMAT "%5.1" /end CHARACTERISTIC
/begin CHARACTERISTIC DCC_swtTrqDesShutOff_C "Shalter fuer Abshaltbedinung Radmoment" VALUE 0xC969C Kw_Wu8 255.0 OneToOne 0.00 255.0 FORMAT "%5.1" /end CHARACTERISTIC
/begin CHARACTERISTIC DCC_tiBrkPressedDel_C "Verzoegerung Bremssignal" VALUE 0xC969E Kw_Wu16 1000.000 Time_ms 0.00 1000.000 FORMAT "%8.3" EXTENDED_LIMITS 0.00 655350.0 /end CHARACTERISTIC
/begin CHARACTERISTIC DCC_tiEngSpdActv_C "Verzoegerung des DCC Freigabe Drehzahlregelung" VALUE 0xC96A0 Kw_Wu16 1000.000 Time_ms 0.00 1000.000 FORMAT "%8.3" EXTENDED_LIMITS 0.00 655350.0 /end CHARACTERISTIC
/begin CHARACTERISTIC DCC_tiPlausBrk_C "Verzoegerung Bremssignal Plausibilitaetsfehler" VALUE 0xC96A2 Kw_Wu16 1000.000 Time_ms 0.00 1000.000 FORMAT "%8.3" EXTENDED_LIMITS 0.00 655350.0 /end CHARACTERISTIC
/begin CHARACTERISTIC DCC_tiPT1_C "Filterkonstante Radmoment" VALUE 0xC96A4 Kw_Wu32 4294.9673 TimeDelay_s 0.0000010000000 4294.9673 FORMAT "%9.4" /end CHARACTERISTIC
/begin CHARACTERISTIC DCC_trqARWIMin_C "Mindestwert von    Anti-Reset-Windup" VALUE 0xC96A8 Kw_Ws16 6553.500 Trq -3276.800 3276.700 FORMAT "%8.3" /end CHARACTERISTIC
/begin CHARACTERISTIC DCC_trqEngSpdMax_C "Maximales Moment des Drehzahlreglers" VALUE 0xC96AA Kw_Ws16 6553.500 Trq -3276.800 3276.700 FORMAT "%8.3" /end CHARACTERISTIC
/begin CHARACTERISTIC DCC_dtrqLimBrkUp_C "Positive Steigung der Rampe DCC Wunschmoment bei Betaetigung des Bremspedals" VALUE 0xC96AC Kw_Wu32 13107199.9969 RmpTrqPrp 0.00 13107199.9969 FORMAT "%13.4" /end CHARACTERISTIC
/begin CHARACTERISTIC DCC_dtrqLimBrkDwn_C "Negative Steigung der Rampe DCC Wunschmoment bei Betaetigung des Bremspedals" VALUE 0xC96B0 Kw_Wu32 13107199.9969 RmpTrqPrp 0.00 13107199.9969 FORMAT "%13.4" /end CHARACTERISTIC
/begin CHARACTERISTIC DCC_dtrqSwtUp_C "Positive Steigung beim Umschalten auf Drehzahlregelung" VALUE 0xC96B4 Kw_Wu32 13107199.9969 RmpTrqPrp 0.00 13107199.9969 FORMAT "%13.4" /end CHARACTERISTIC
/begin CHARACTERISTIC DCC_dtrqSwtDwn_C "Negative Steigung beim Umschalten auf Drehzahlregelung" VALUE 0xC96B8 Kw_Wu32 13107199.9969 RmpTrqPrp 0.00 13107199.9969 FORMAT "%13.4" /end CHARACTERISTIC
/begin CHARACTERISTIC DCC_dtrqLimUp_C "Positive Steigung der Rampe DCC Wunschmoment" VALUE 0xC96BC Kw_Wu32 13107199.9969 RmpTrqPrp 0.00 13107199.9969 FORMAT "%13.4" /end CHARACTERISTIC
/begin CHARACTERISTIC DCC_dtrqLimDwn_C "Negative Steigung der Rampe DCC Wunschmoment" VALUE 0xC96C0 Kw_Wu32 13107199.9969 RmpTrqPrp 0.00 13107199.9969 FORMAT "%13.4" /end CHARACTERISTIC
/begin CHARACTERISTIC DCC_trqReplVal_C "Ersatzwert DCC-Moment" VALUE 0xC96C4 Kw_Ws16 13107.00 TrqPrp -6553.600 6553.400 FORMAT "%8.3" /end CHARACTERISTIC
/begin CHARACTERISTIC DCC_trqShft_CUR "Drehmomentkennlinie zur Initialisierung der Drehzahlregelung" CURVE 0xC96C6 Kl_Xs16_Ws16 1500.000 Trq -500.0000 1000.000 FORMAT "%8.3" EXTENDED_LIMITS -3276.800 3276.700
 /begin AXIS_DESCR STD_AXIS Eng_nAvrg EngN 7 0.00 6000.000 FORMAT "%8.3" EXTENDED_LIMITS -32768.00 32767.00 DEPOSIT ABSOLUTE /end AXIS_DESCR
/end CHARACTERISTIC
/begin CHARACTERISTIC DCC_vLim_C "Geschwindigkeitsschwelle fuer DCC Eingriff" VALUE 0xC96E4 Kw_Ws16 20.00000 Vel 0.00 20.00000 FORMAT "%8.5" EXTENDED_LIMITS -327.6800 327.6700 /end CHARACTERISTIC
/begin CHARACTERISTIC DrvTrn_drTransDTUp_C "Positive slope for torque changes" VALUE 0xC96E8 Kw_Wu32 655359.999847 RmpTransR 0.00 655359.999847 FORMAT "%13.6" /end CHARACTERISTIC
/begin CHARACTERISTIC DrvTrn_drTransDTDwn_C "negative slope for torque changes" VALUE 0xC96EC Kw_Wu32 655359.999847 RmpTransR 0.00 655359.999847 FORMAT "%13.6" /end CHARACTERISTIC
/begin CHARACTERISTIC DrvTrn_rFlatTransDT_C "Ausgangswert des flachen Getriebeverhältnisses des drivetrain" VALUE 0xC96F0 Kw_Ws16 100.0000 TransR 0.00 100.0000 FORMAT "%8.4" EXTENDED_LIMITS -327.6800 327.6700 /end CHARACTERISTIC
/begin CHARACTERISTIC DrvTrn_rTransDTInit_C "Triebstrangübersetzungs-Vorgabewert (Radmoment pro Motormoment)" VALUE 0xC96F2 Kw_Ws16 100.0000 TransR 0.00 100.0000 FORMAT "%8.4" EXTENDED_LIMITS -327.6800 327.6700 /end CHARACTERISTIC
/begin CHARACTERISTIC DrvTrn_swtCAN_C "für Aktivierung von rTrans von CAN schalten" VALUE 0xC96F4 Kw_Wu8 1.000 OneToOne 0.00 1.000 FORMAT "%5.3" EXTENDED_LIMITS 0.00 255.0 /end CHARACTERISTIC
/begin CHARACTERISTIC DrvTrn_swtrTransSel_C "Schalter zur aktivierung des Übersetzungsverhältniss-Momentanwertes (1: verzögert, 0: direkter Wert)" VALUE 0xC96F5 Kw_Wu8 1.000 OneToOne 0.00 1.000 FORMAT "%5.3" EXTENDED_LIMITS 0.00 255.0 /end CHARACTERISTIC
/begin CHARACTERISTIC DrvTrn_tiRTransDT_C "Zeitintervall für das Einfrieren des aktuellen Triebstrangübersetzungswert" VALUE 0xC96F6 Kw_Ws16 655140.0 Time_ms 0.00 655140.0 FORMAT "%8.1" EXTENDED_LIMITS -327680.0 327670.0 /end CHARACTERISTIC
/begin CHARACTERISTIC DrvTrn_vLimTransDT_C "Geschwindigkeits begrenzung" VALUE 0xC96F8 Kw_Ws16 200.0000 Vel 0.00 200.0000 FORMAT "%8.4" EXTENDED_LIMITS -327.6800 327.6700 /end CHARACTERISTIC
/begin CHARACTERISTIC DVMARK "Mindestabstand von Geschwindigkeits-Marken beim Stufentempomat" VALUE 0xC05AC KwWU16 655.3500 Vel 0.00 655.3500 FORMAT "%8.4" /end CHARACTERISTIC
/begin CHARACTERISTIC DVMARKMI "dvmark_w für mph-Tachometer" VALUE 0xC05AE KwWU16 655.3500 Vel 0.00 655.3500 FORMAT "%8.4" /end CHARACTERISTIC
/begin CHARACTERISTIC DVPRG "Schrittweite bei Anzeige der Regelgeschwindigkeit im Programmiermodus" VALUE 0xC05B0 KwWU16 655.3500 Vel 0.00 655.3500 FORMAT "%8.4" /end CHARACTERISTIC
/begin CHARACTERISTIC DVPRGMI "dvprg_w für mph-Tachometer" VALUE 0xC05B2 KwWU16 655.3500 Vel 0.00 655.3500 FORMAT "%8.4" /end CHARACTERISTIC
/begin CHARACTERISTIC DVSTUTOM "Schrittweite f ür Verstellung der Zielgeschwindigkeit ohne programmierte Marken" VALUE 0xC05B4 KwWU16 655.3500 Vel 0.00 655.3500 FORMAT "%8.4" /end CHARACTERISTIC
/begin CHARACTERISTIC DVSTUTOMMI "dvstutom_w für mph - tacho" VALUE 0xC05B6 KwWU16 655.3500 Vel 0.00 655.3500 FORMAT "%8.4" /end CHARACTERISTIC
/begin CHARACTERISTIC TFGRTP "Zeit für Tip-Erkennung bei FGR-Bedientasten" VALUE 0xC05BF KwWU8 5.100 t20msxs_ub_b5p1 0.00 5.100 FORMAT "%5.3" /end CHARACTERISTIC
/begin CHARACTERISTIC TMARK "Verzögerungszeit f ür Ein- und Ausblenden der Marken mit Tipschalter Aus" VALUE 0xC05C0 KwWU8 5.100 t20msxs_ub_b5p1 0.00 5.100 FORMAT "%5.3" /end CHARACTERISTIC
/begin CHARACTERISTIC TMRKBLI "Zeit für Ein- und Ausschaltung beim Blinken der Markenanzeige" VALUE 0xC05C1 KwWU8 5.100 t20msxs_ub_b5p1 0.00 5.100 FORMAT "%5.3" /end CHARACTERISTIC
/begin CHARACTERISTIC TMSGSGTMN "min zeit zwischen zwei botschaften" VALUE 0xC05AA KwWU8 5.100 t20msxs_ub_b5p1 0.00 5.100 FORMAT "%5.3" /end CHARACTERISTIC
/begin CHARACTERISTIC TSELO "Verzögerungszeit für das Setzen und Löschen von Marken" VALUE 0xC05C2 KwWU8 5.100 t20msxs_ub_b5p1 0.00 5.100 FORMAT "%5.3" /end CHARACTERISTIC
/begin CHARACTERISTIC TVSTUTK "Verzögerungszeit kurz für Verstellung bei gehaltener Taste" VALUE 0xC05C3 KwWU8 5.100 t20msxs_ub_b5p1 0.00 5.100 FORMAT "%5.3" /end CHARACTERISTIC
/begin CHARACTERISTIC TVSTUTL "Verzögerungszeit lang für Verstellung bei gehaltener Taste" VALUE 0xC05C4 KwWU8 5.100 t20msxs_ub_b5p1 0.00 5.100 FORMAT "%5.3" /end CHARACTERISTIC
/begin CHARACTERISTIC VFGRPRG "Geschindigkeitsschwelle zum Abschalten des FGR Programmiermodus" VALUE 0xC05B8 KwWU16 655.3500 Vel 0.00 655.3500 FORMAT "%8.4" /end CHARACTERISTIC
/begin CHARACTERISTIC VVEMOFS "Offset zur eingefrorenen vIst bei verzögern, ab der die v-Marke wieder zum Schleppzeiger wird" VALUE 0xC05BA KwWU16 655.3500 Vel 0.00 655.3500 FORMAT "%8.4" /end CHARACTERISTIC
/begin MEASUREMENT anzmark "Anzahl Geschwindigkeits-Marken Stufentempomat" UBYTE dez 1 100 0.00 255.0 FORMAT "%5.1" ECU_ADDRESS 0x7F89E3 /end MEASUREMENT
/begin MEASUREMENT BGSTUTlokbits0 "keine Funktion" UWORD dez 1 100 0.00 65535.00 FORMAT "%8.2" ECU_ADDRESS 0x7F8AD4 /end MEASUREMENT
/begin MEASUREMENT B_acc "Bedingung ACC-Steuergerät vorhanden" UBYTE B_TRUE 1 100 0.00 1.00000000000 BIT_MASK 0x1 FORMAT "%13.11" ECU_ADDRESS 0x7F87D3 /end MEASUREMENT
/begin MEASUREMENT B_acmsggts "Bed. Min. Zeit in der keine Bit gesendet wurde ist verstrichen + Ereignis aufgetreten" UBYTE B_TRUE 1 100 0.00 1.00000000000 BIT_MASK 0x1 FORMAT "%13.11" ECU_ADDRESS 0x7F87D4 /end MEASUREMENT
/begin MEASUREMENT B_besch "Bedingung FGR im Zustand Beschleunigen" UBYTE B_TRUE 1 100 0.00 1.00000000000 BIT_MASK 0x1 FORMAT "%13.11" ECU_ADDRESS 0x7F87D5 /end MEASUREMENT
/begin MEASUREMENT B_beveh "Bedingung Halten der Beschleunigen- oder Verzögerungs-Taste" UBYTE B_TRUE 1 100 0.00 1.00000000000 FORMAT "%13.11" ECU_ADDRESS 0x7F87D6 /end MEASUREMENT
/begin MEASUREMENT B_bv1 "Bedingung Bediensignal Stufentempomat Beschleunigen oder Verzögern 1. Stufe" UBYTE B_TRUE 1 100 0.00 1.00000000000 FORMAT "%13.11" ECU_ADDRESS 0x7F87D7 /end MEASUREMENT
/begin MEASUREMENT B_bv2 "Bedingung Bediensignal Stufentempomat Beschleunigen oder Verzögern 2. Stufe" UBYTE B_TRUE 1 100 0.00 1.00000000000 FORMAT "%13.11" ECU_ADDRESS 0x7F87D8 /end MEASUREMENT
/begin MEASUREMENT B_cmsggts "Trigger Bit zum Senden der Botschaft" UBYTE B_TRUE 1 100 0.00 1.00000000000 BIT_MASK 0x1 FORMAT "%13.11" ECU_ADDRESS 0x7F87D9 /end MEASUREMENT
/begin MEASUREMENT B_envtwa "Bedingung FGR aktiv vor Betätigung der Wiederaufnahme-Taste" UBYTE B_TRUE 1 100 0.00 1.00000000000 FORMAT "%13.11" ECU_ADDRESS 0x7F87DA /end MEASUREMENT
/begin MEASUREMENT B_ergacgt "Bedingung Ereignis (Änderung) bei Stufentempomat aufgetreten" UBYTE B_TRUE 1 100 0.00 1.00000000000 BIT_MASK 0x1 FORMAT "%13.11" ECU_ADDRESS 0x7F87DB /end MEASUREMENT
/begin MEASUREMENT B_fgrat "Bedingung: Tip-Schalter Aus am FGR-Bedienteil betätigt" UBYTE B_TRUE 1 100 0.00 1.00000000000 BIT_MASK 0x1 FORMAT "%13.11" ECU_ADDRESS 0x7F87DC /end MEASUREMENT
/begin MEASUREMENT B_fgren "Bedingung Fahrgeschwindigkeitsregelung aktiv (Enable)" UBYTE B_TRUE 1 100 0.00 1.00000000000 BIT_MASK 0x1 FORMAT "%13.11" ECU_ADDRESS 0x7F87DD /end MEASUREMENT
/begin MEASUREMENT B_fgrepa "Status in Cruise control" UBYTE B_TRUE 1 100 0.00 1.00000000000 FORMAT "%13.11" ECU_ADDRESS 0x7F87DE /end MEASUREMENT
/begin MEASUREMENT B_fgresv "" UBYTE B_TRUE 1 100 0.00 1.00000000000 BIT_MASK 0x1 FORMAT "%13.11" ECU_ADDRESS 0x7F87DF /end MEASUREMENT
/begin MEASUREMENT B_fgrtb2 "Bedingung FGR-Taste Auswahl der nächsthöheren Zielgeschwindigkeit" UBYTE B_TRUE 1 100 0.00 1.00000000000 BIT_MASK 0x1 FORMAT "%13.11" ECU_ADDRESS 0x7F87E0 /end MEASUREMENT
/begin MEASUREMENT B_fgrtbe "Bedingung FGR-Taste Beschleunigen" UBYTE B_TRUE 1 100 0.00 1.00000000000 BIT_MASK 0x1 FORMAT "%13.11" ECU_ADDRESS 0x7F87E1 /end MEASUREMENT
/begin MEASUREMENT B_fgrtv2 "Bedingung FGR-Taste Auswahl der nächstniederen Zielgeschwindigkeit" UBYTE B_TRUE 1 100 0.00 1.00000000000 BIT_MASK 0x1 FORMAT "%13.11" ECU_ADDRESS 0x7F87E2 /end MEASUREMENT
/begin MEASUREMENT B_fgrtve "Bedingung FGR-Taste Verzöägern" UBYTE B_TRUE 1 100 0.00 1.00000000000 BIT_MASK 0x1 FORMAT "%13.11" ECU_ADDRESS 0x7F87E3 /end MEASUREMENT
/begin MEASUREMENT B_fgrtwa "Bedingung FGR-Taste Wiederaufnahme" UBYTE B_TRUE 1 100 0.00 1.00000000000 BIT_MASK 0x1 FORMAT "%13.11" ECU_ADDRESS 0x7F87E4 /end MEASUREMENT
/begin MEASUREMENT B_fgrvem "Bedingung: FGR im Zustand Verzögern (aus ME)" UBYTE B_TRUE 1 100 0.00 1.00000000000 BIT_MASK 0x1 FORMAT "%13.11" ECU_ADDRESS 0x7F87E5 /end MEASUREMENT
/begin MEASUREMENT B_insfgre "Bedingung Fehler im INST-Kombi, FGR muss abgeschaltet werden" UBYTE B_TRUE 1 100 0.00 1.00000000000 BIT_MASK 0x1 FORMAT "%13.11" ECU_ADDRESS 0x7F87E6 /end MEASUREMENT
/begin MEASUREMENT B_kl15 "Bedingung Klemme 15" UBYTE B_TRUE 1 100 0.00 1.00000000000 BIT_MASK 0x1 FORMAT "%13.11" ECU_ADDRESS 0x7F87E7 /end MEASUREMENT
/begin MEASUREMENT B_km "Bedingung CAN-Kombi-Kodierung in km/h" UBYTE B_TRUE 1 100 0.00 1.00000000000 BIT_MASK 0x1 FORMAT "%13.11" ECU_ADDRESS 0x7F87E8 /end MEASUREMENT
/begin MEASUREMENT B_mmiena "Status bit" UBYTE B_TRUE 1 100 0.00 1.00000000000 BIT_MASK 0x1 FORMAT "%13.11" ECU_ADDRESS 0x7F87E9 /end MEASUREMENT
/begin MEASUREMENT B_mrkbli "Bedingung Blinken der Markenanzeige" UBYTE B_TRUE 1 100 0.00 1.00000000000 FORMAT "%13.11" ECU_ADDRESS 0x7F87EA /end MEASUREMENT
/begin MEASUREMENT B_mrkein "Bedingung Anzeige Geschwindigkeits-Marken im Kombi ein" UBYTE B_TRUE 1 100 0.00 1.00000000000 BIT_MASK 0x1 FORMAT "%13.11" ECU_ADDRESS 0x7F87EB /end MEASUREMENT
/begin MEASUREMENT B_mrkv "Bedingung Veränderung der Geschwindigkeits-Marken Stufentempomat" UBYTE B_TRUE 1 100 0.00 1.00000000000 BIT_MASK 0x1 FORMAT "%13.11" ECU_ADDRESS 0x7F87EC /end MEASUREMENT
/begin MEASUREMENT B_mrkvff "Bedingung Merker das B:_mrkv (Marker Veränderung) gesetzt war" UBYTE B_TRUE 1 100 0.00 1.00000000000 BIT_MASK 0x1 FORMAT "%13.11" ECU_ADDRESS 0x7F87ED /end MEASUREMENT
/begin MEASUREMENT B_prgmod "Bedingung Programmiermodus Stufentempomat" UBYTE B_TRUE 1 100 0.00 1.00000000000 FORMAT "%13.11" ECU_ADDRESS 0x7F87EE /end MEASUREMENT
/begin MEASUREMENT B_tmark "Bedingung Taste Aus für die Zeit TMARK betätigt" UBYTE B_TRUE 1 100 0.00 1.00000000000 FORMAT "%13.11" ECU_ADDRESS 0x7F87EF /end MEASUREMENT
/begin MEASUREMENT B_tmrkbli "Bedingung"" Blinken der Markenanzeige""" UBYTE B_TRUE 1 100 0.00 1.00000000000 FORMAT "%13.11" ECU_ADDRESS 0x7F87F0 /end MEASUREMENT
/begin MEASUREMENT B_vziels "Bedingung Übernahme berechnete Zielgeschwindigkeit" UBYTE B_TRUE 1 100 0.00 1.00000000000 BIT_MASK 0x1 FORMAT "%13.11" ECU_ADDRESS 0x7F87F1 /end MEASUREMENT
/begin MEASUREMENT canzbl "Zähler für Aus-/Ein-Schaltungen beim Blinken der Markenanzeige" UBYTE dez 1 100 0.00 255.0 FORMAT "%5.1" ECU_ADDRESS 0x7F89E4 /end MEASUREMENT
/begin MEASUREMENT CpBVlv_qClose_mp "mp für niedrigeren Schwellenwert der Einspriztmenge (Schließung)" SWORD InjMassCyc 1 100 -327.6800 327.6700 FORMAT "%8.4" ECU_ADDRESS 0x8FE588 /end MEASUREMENT
/begin MEASUREMENT CpBVlv_qOpn_mp "mp für höheren Schwellenwert der der Einspriztmenge  (Eröffnung)" SWORD InjMassCyc 1 100 -327.6800 327.6700 FORMAT "%8.4" ECU_ADDRESS 0x8FE58A /end MEASUREMENT
/begin MEASUREMENT CpBVlv_stLogic "Logikstatus fuer Verdichterbypass" UBYTE OneToOne 1 100 0.00 255.0 FORMAT "%5.1" ECU_ADDRESS 0x7F8830 /end MEASUREMENT
/begin MEASUREMENT CpBVlv_stOff_mp "mp für shutoff" UBYTE OneToOne 1 100 0.00 255.0 FORMAT "%5.1" ECU_ADDRESS 0x8FE58C /end MEASUREMENT
/begin MEASUREMENT CpBVlv_stOpn "Zustand Kompressorbypass-Ventil" UBYTE OneToOne 1 100 0.00 255.0 FORMAT "%5.1" ECU_ADDRESS 0x7F8831 /end MEASUREMENT
/begin MEASUREMENT CrCCD_dMFLData_mp "Rohdaten vom MFL" UBYTE OneToOne 1 100 0.00 255.0 FORMAT "%5.1" ECU_ADDRESS 0x8FE58D /end MEASUREMENT
/begin MEASUREMENT CrCCD_stDev "Status FGR-Bedienteil (zusätzliche Abschaltbedingungen)" UBYTE OneToOne 1 100 0.00 255.0 FORMAT "%5.1" ECU_ADDRESS 0x7F8832 /end MEASUREMENT
/begin MEASUREMENT CrCCD_stKey "Rückgabewert ""Taste gedrückt""" UBYTE OneToOne 1 100 0.00 255.0 FORMAT "%5.1" ECU_ADDRESS 0x7F8833 /end MEASUREMENT
/begin MEASUREMENT CrCCD_stKeyOff "tip up und tip down Taste bei deaktivierten CrCtl Hauptschalter" UBYTE OneToOne 1 100 0.00 255.0 FORMAT "%5.1" ECU_ADDRESS 0x7F8834 /end MEASUREMENT
/begin MEASUREMENT CrCCD_swtDev "SW-Schalter eingebauter Typ FGR Bedienteil" UBYTE OneToOne 1 100 0.00 255.0 FORMAT "%5.1" ECU_ADDRESS 0x7F8835 /end MEASUREMENT
/begin MEASUREMENT CrCCD_swtMSW "Schalterstellung vom MSW (1...MSW ein/0...MSW aus)" UBYTE OneToOne 1 100 0.00 255.0 FORMAT "%5.1" ECU_ADDRESS 0x7F8836 /end MEASUREMENT
/begin MEASUREMENT CrCtl_BGSTUTbits2_mp "" UWORD OneToOne 1 100 0.00 65535.00 FORMAT "%8.2" ECU_ADDRESS 0x8FE5A6 /end MEASUREMENT
/begin MEASUREMENT CrCtl_dvAcc_mp "Rampensteigung bei Beschleunigung SET+" SWORD dVel_20ms 1 100 -16384.00 16383.50 FORMAT "%8.2" ECU_ADDRESS 0x8FE592 /end MEASUREMENT
/begin MEASUREMENT CrCtl_dvDecl_mp "Rampensteigung bei Verzögerung SET-" SWORD dVel_20ms 1 100 -16384.00 16383.50 FORMAT "%8.2" ECU_ADDRESS 0x8FE594 /end MEASUREMENT
/begin MEASUREMENT CrCtl_dvResAbv_mp "Rampensteigung bei WA-" SWORD dVel_20ms 1 100 -16384.00 16383.50 FORMAT "%8.2" ECU_ADDRESS 0x8FE596 /end MEASUREMENT
/begin MEASUREMENT CrCtl_dvResBlw_mp "Rampensteigung WA+" SWORD dVel_20ms 1 100 -16384.00 16383.50 FORMAT "%8.2" ECU_ADDRESS 0x8FE598 /end MEASUREMENT
/begin MEASUREMENT CrCtl_mrkeinvp_mp "" UBYTE OneToOne 1 100 0.00 255.0 FORMAT "%5.1" ECU_ADDRESS 0x8FE5A8 /end MEASUREMENT
/begin MEASUREMENT CrCtl_numGear "Gang FGR" SBYTE OneToOne 1 100 -128.0 127.0 FORMAT "%5.1" ECU_ADDRESS 0x7F8837 /end MEASUREMENT
/begin MEASUREMENT CrCtl_numVMrk "1 Index für vmrki..." UBYTE OneToOne 1 100 0.00 255.0 FORMAT "%5.1" ECU_ADDRESS 0x7F8838 /end MEASUREMENT
/begin MEASUREMENT CrCtl_rVnBeg "Verhältnis Geschwindigkeit zu Drehzahl bei Aktivierung FGR" SWORD VelToN 1 100 0.00 0.3276700 FORMAT "%9.7" ECU_ADDRESS 0x7F8BC0 /end MEASUREMENT
/begin MEASUREMENT CrCtl_st "Status FGR" UBYTE OneToOne 1 100 0.00 255.0 FORMAT "%5.1" ECU_ADDRESS 0x7F8839 /end MEASUREMENT
/begin MEASUREMENT CrCtl_stActive "Flag aktiver FGR" UBYTE OneToOne 1 100 0.00 255.0 FORMAT "%5.1" ECU_ADDRESS 0x7F883A /end MEASUREMENT
/begin MEASUREMENT CrCtl_stBrkBeforeCruise_mp "Meßpunkt für Bremsenanforderung" UBYTE OneToOne 1 100 0.00 255.0 FORMAT "%5.1" ECU_ADDRESS 0x8FE58E /end MEASUREMENT
/begin MEASUREMENT CrCtl_stCAN "Status der CrCtl für CAN" UBYTE OneToOne 1 100 0.00 255.0 FORMAT "%5.1" ECU_ADDRESS 0x7F883B /end MEASUREMENT
/begin MEASUREMENT CrCtl_stCC "Status FGR" UBYTE OneToOne 1 100 0.00 255.0 FORMAT "%5.1" ECU_ADDRESS 0x7F883C /end MEASUREMENT
/begin MEASUREMENT CrCtl_stClCtr_mp "Status nach DSC, ASC & MSR Eingriffen" UWORD OneToOne 1 100 0.00 65535.00 FORMAT "%8.2" ECU_ADDRESS 0x8FE590 /end MEASUREMENT
/begin MEASUREMENT CrCtl_stLampOut "Status der CrCtl-Lampe (wird über CAN versendet)" UBYTE OneToOne 1 100 0.00 255.0 FORMAT "%5.1" ECU_ADDRESS 0x7F883D /end MEASUREMENT
/begin MEASUREMENT CrCtl_stRecFGR "Status ob FGR im Fahrzeug verbaut ist" UBYTE OneToOne 1 100 0.00 255.0 FORMAT "%5.1" ECU_ADDRESS 0x7F883E /end MEASUREMENT
/begin MEASUREMENT CrCtl_stShutOffCode "Abschaltgrund FGR" ULONG OneToOne 1 100 0.00 4294967295.00 FORMAT "%13.2" ECU_ADDRESS 0x7F919C /end MEASUREMENT
/begin MEASUREMENT CrCtl_stShutOffCode1_mp "Low Byte von CrCtl_shutOffCode (Verwendung als Signal)" UWORD OneToOne 1 100 0.00 65535.00 FORMAT "%8.2" ECU_ADDRESS 0x6F8012 /end MEASUREMENT
/begin MEASUREMENT CrCtl_stShutOffCode2_mp "Low Byte von CrCtl_shutOffCode (Verwendung als Signal)" UWORD OneToOne 1 100 0.00 65535.00 FORMAT "%8.2" ECU_ADDRESS 0x6F8014 /end MEASUREMENT
/begin MEASUREMENT CrCtl_stShutOffFrz1_mp "latched shutoff reason" UWORD OneToOne 1 100 0.00 65535.00 FORMAT "%8.2" ECU_ADDRESS 0x6F8016 /end MEASUREMENT
/begin MEASUREMENT CrCtl_stShutOffFrz2_mp "latched shutoff reason" UWORD OneToOne 1 100 0.00 65535.00 FORMAT "%8.2" ECU_ADDRESS 0x6F8018 /end MEASUREMENT
/begin MEASUREMENT CrCtl_stShutOffFrz_mp "eingefrorener Abschaltgrund FGR" ULONG OneToOne 1 100 0.00 4294967295.00 FORMAT "%13.2" ECU_ADDRESS 0x6F801C /end MEASUREMENT
/begin MEASUREMENT CrCtl_stUpdateVMrk "Trigger zum senden der Botschaft" UBYTE OneToOne 1 100 0.00 255.0 FORMAT "%5.1" ECU_ADDRESS 0x7F883F /end MEASUREMENT
/begin MEASUREMENT CrCtl_stVCrCtl "Diagnosefreigabestatus für Anzeigegeschwindigkeit" UBYTE OneToOne 1 100 0.00 255.0 FORMAT "%5.1" ECU_ADDRESS 0x7F8840 /end MEASUREMENT
/begin MEASUREMENT CrCtl_stVDisp "Marke aus/ein" UBYTE OneToOne 1 100 0.00 255.0 FORMAT "%5.1" ECU_ADDRESS 0x7F8841 /end MEASUREMENT
/begin MEASUREMENT CrCtl_stVSetNew "neue Sollgeschwindigkeit aus Stufentempomat übernehmen" UBYTE OneToOne 1 100 0.00 255.0 FORMAT "%5.1" ECU_ADDRESS 0x7F8842 /end MEASUREMENT
/begin MEASUREMENT CrCtl_trqDes "Momentenanforderung FGR" SWORD TrqPrp 1 100 -6553.600 6553.400 FORMAT "%8.3" ECU_ADDRESS 0x7F8BC2 /end MEASUREMENT
/begin MEASUREMENT CrCtl_trqDT1_mp "DT1 Ausgang FGR" SWORD TrqPrp 1 100 -6553.600 6553.400 FORMAT "%8.3" ECU_ADDRESS 0x8FE59A /end MEASUREMENT
/begin MEASUREMENT CrCtl_trqI_mp "I-Anteil FGR" SWORD TrqPrp 1 100 -6553.600 6553.400 FORMAT "%8.3" ECU_ADDRESS 0x8FE59C /end MEASUREMENT
/begin MEASUREMENT CrCtl_trqLead "Vorhaltmoment des FGR" SWORD TrqPrp 1 100 -6553.600 6553.400 FORMAT "%8.3" ECU_ADDRESS 0x7F8BC4 /end MEASUREMENT
/begin MEASUREMENT CrCtl_trqMax_mp "Maximales Moment FGR" SWORD TrqPrp 1 100 -6553.600 6553.400 FORMAT "%8.3" ECU_ADDRESS 0x8FE59E /end MEASUREMENT
/begin MEASUREMENT CrCtl_trqP_mp "P-Anteil der Fahrgeschwindigkeits PI-Regelung" SWORD TrqPrp 1 100 -6553.600 6553.400 FORMAT "%8.3" ECU_ADDRESS 0x8FE5A0 /end MEASUREMENT
/begin MEASUREMENT CrCtl_vAlwMax "Obere Grenze für FGR-Sollgeschwindigkeit" SWORD Vel 1 100 0.00 300.0000 FORMAT "%8.4" ECU_ADDRESS 0x7F8BC6 /end MEASUREMENT
/begin MEASUREMENT CrCtl_vAlwMin "min. mögliche Setzgeschwindigkeit" SWORD Vel 1 100 0.00 300.0000 FORMAT "%8.4" ECU_ADDRESS 0x7F8BC8 /end MEASUREMENT
/begin MEASUREMENT CrCtl_vBeg "FGR: Fahrgeschwindigkeit am Anfang von EIN+, EIN- und WA" SWORD Vel 1 100 0.00 300.0000 FORMAT "%8.4" ECU_ADDRESS 0x7F8BCA /end MEASUREMENT
/begin MEASUREMENT CrCtl_vCurr "Fahrzeuggeschwindigkeit für FGR" SWORD Vel 1 100 0.00 300.0000 FORMAT "%8.4" ECU_ADDRESS 0x7F8BCC /end MEASUREMENT
/begin MEASUREMENT CrCtl_vDes "Sollgeschwindigkeit FGR" SWORD Vel 1 100 0.00 300.0000 FORMAT "%8.4" ECU_ADDRESS 0x7F8BCE /end MEASUREMENT
/begin MEASUREMENT CrCtl_vDesDisp "aktuelle Zielgeschwindigkeit STUT" SWORD Vel 1 100 0.00 300.0000 FORMAT "%8.4" ECU_ADDRESS 0x7F8BD0 /end MEASUREMENT
/begin MEASUREMENT CrCtl_vDiffRed_mp "Geschwindigkeitsdifferenz für Abflachungskennlinie" SWORD Vel 1 100 -327.6800 327.6700 FORMAT "%8.4" ECU_ADDRESS 0x8FE5A2 /end MEASUREMENT
/begin MEASUREMENT CrCtl_vDiff_mp "FGR: | CrCtl_vDes - CrCtl_vBeg |, Differenz V_SOLL und v bei Anfang EIN+, EIN- und WA" SWORD Vel 1 100 -327.6800 327.6700 FORMAT "%8.4" ECU_ADDRESS 0x8FE5A4 /end MEASUREMENT
/begin MEASUREMENT CrCtl_vDispOffset "Abweichung Anzeigegeschwindigkeit - gef. Messgeschwindigkeit" SWORD Vel 1 100 0.00 300.0000 FORMAT "%8.4" ECU_ADDRESS 0x7F8BD2 /end MEASUREMENT
/begin MEASUREMENT CrCtl_vMrk1 "v-Marke 1 für Botschaft" SWORD Vel 1 100 0.00 300.0000 FORMAT "%8.4" ECU_ADDRESS 0x7F8BD4 /end MEASUREMENT
/begin MEASUREMENT CrCtl_vMrk2 "v-Marke für 2 Botschaft" SWORD Vel 1 100 0.00 300.0000 FORMAT "%8.4" ECU_ADDRESS 0x7F8BD6 /end MEASUREMENT
/begin MEASUREMENT CrCtl_vMrk3 "v-Marke 3 für Botschaft" SWORD Vel 1 100 0.00 300.0000 FORMAT "%8.4" ECU_ADDRESS 0x7F8BD8 /end MEASUREMENT
/begin MEASUREMENT CrCtl_vRmp "Rampenzielgeschwindigkeit FGR" SWORD Vel 1 100 0.00 300.0000 FORMAT "%8.4" ECU_ADDRESS 0x7F8BDA /end MEASUREMENT
/begin MEASUREMENT CrCtl_vSetNew "neue Sollgeschwindigkeit aus Stufentempomat" SWORD Vel 1 100 0.00 300.0000 FORMAT "%8.4" ECU_ADDRESS 0x7F8BDC /end MEASUREMENT
/begin MEASUREMENT CrSCD_dSegMisf "Verschiebung Segmentsystem für Aussetzererkennung" SBYTE OneToOne 1 100 -128.0 127.0 FORMAT "%5.1" ECU_ADDRESS 0x7F8843 /end MEASUREMENT
/begin MEASUREMENT CrSCD_incNextIntDelta_mp "Anzahl der Inkrements bis zum nächsten statischen  Interrupt" SWORD OneToOne 1 100 -32768.00 32767.00 FORMAT "%8.2" ECU_ADDRESS 0x8FE5C0 /end MEASUREMENT
/begin MEASUREMENT CrSCD_incNextInt_mp "Anzahl der Inkrements bis zum nächsten statischen  Interrupt" SBYTE OneToOne 1 100 -128.0 127.0 FORMAT "%5.1" ECU_ADDRESS 0x8FE5C2 /end MEASUREMENT
/begin MEASUREMENT CrSCD_nAvrg "gemittelte Kurbelwellendrehzahl des letzten und vorletzten segmentes" SWORD EngN 1 100 -32768.00 32767.00 FORMAT "%8.2" ECU_ADDRESS 0x7F8BDE /end MEASUREMENT
/begin MEASUREMENT CrSCD_nAvrgHiRes "Gemittelte hochauflösende Drehzahl" SLONG EngN_HiRes 1 100 -268435456.000 268435455.875 FORMAT "%13.3" ECU_ADDRESS 0x7F91A4 /end MEASUREMENT
/begin MEASUREMENT CrSCD_nCurr "aktuelle Motordrehzahl aus der letzten Segmentperiode" SWORD EngN 1 100 -32768.00 32767.00 FORMAT "%8.2" ECU_ADDRESS 0x7F8BE0 /end MEASUREMENT
/begin MEASUREMENT CrSCD_nCurrHiRes "Aktuelle hochauflösende Drehzahl" SLONG EngN_HiRes 1 100 -268435456.000 268435455.875 FORMAT "%13.3" ECU_ADDRESS 0x7F91A8 /end MEASUREMENT
/begin MEASUREMENT CrSCD_nDyn "aktuelle Motordrehzahl mit Filter für Segment der Dekompressionsphase" SWORD EngN 1 100 -32768.00 32767.00 FORMAT "%8.2" ECU_ADDRESS 0x7F8BE2 /end MEASUREMENT
/begin MEASUREMENT CrSCD_nHold "aktuelle Motordrehzahl des vorletzten Segmentes" SWORD EngN 1 100 -32768.00 32767.00 FORMAT "%8.2" ECU_ADDRESS 0x7F8BE4 /end MEASUREMENT
/begin MEASUREMENT CrSCD_nIncr "Motordrehzahl aus Inkrementperiode" SWORD EngN 1 100 -32768.00 32767.00 FORMAT "%8.2" ECU_ADDRESS 0x7F8BE6 /end MEASUREMENT
/begin MEASUREMENT CrSCD_nMisf "Drehzahlsignal für ODB-Zündaussetzererkennung" SWORD EngN 1 100 -32768.00 32767.00 FORMAT "%8.2" ECU_ADDRESS 0x7F8BE8 /end MEASUREMENT
/begin MEASUREMENT CrSCD_numSeg "aktuelle Segmentnummer  (Segment 0 ist bei OT 1)" UBYTE OneToOne 1 100 0.00 255.0 FORMAT "%5.1" ECU_ADDRESS 0x7F8844 /end MEASUREMENT
/begin MEASUREMENT CrSCD_phiCurr_mp "Aktueller Winkel basierent auf dem Inkrementsystem" SWORD AngleCrS 1 100 -768.0000 767.9766 FORMAT "%8.4" ECU_ADDRESS 0x8FE5C4 /end MEASUREMENT
/begin MEASUREMENT CrSCD_phiIncCor "aktuelle Phasenkorrektur des Inkrementsystems der Kurbelwelle" SWORD AngleCrS 1 100 -768.0000 767.9766 FORMAT "%8.4" ECU_ADDRESS 0x7F8BEA /end MEASUREMENT
/begin MEASUREMENT CrSCD_phiIncr "Winkel eines Inkrements in Grad Kurbelwelle" SWORD AngleCrS 1 100 -768.0000 767.9766 FORMAT "%8.4" ECU_ADDRESS 0x7F8BEC /end MEASUREMENT
/begin MEASUREMENT CrSCD_phiSegGrid_mp "Berechnete Drehzahlsegmentlänge" SWORD AngleCrS 1 100 -768.0000 767.9766 FORMAT "%8.4" ECU_ADDRESS 0x8FE5C6 /end MEASUREMENT
/begin MEASUREMENT CrSCD_stIncErr_mp "Fehlerstatus des Inkrementgebersignals (Signalstöhrungen, Frequenzstatus, Inkrementpufferstatus)" UBYTE OneToOne 1 100 0.00 255.0 FORMAT "%5.1" ECU_ADDRESS 0x8FE5C8 /end MEASUREMENT
/begin MEASUREMENT CrSCD_stIncSig_mp "Status des Inkrementgeber Signalauswertung (Plausibilisierung der Zahnflankenzeiten und -anzahl)" UBYTE OneToOne 1 100 0.00 255.0 FORMAT "%5.1" ECU_ADDRESS 0x8FE5C9 /end MEASUREMENT
/begin MEASUREMENT CrSCD_stIncSyncInc_mp "Synchronisationsstatus des Inkrementgebersignals nach Aufruf von CrSCD_UpdPos (Intern, Debugging)" UBYTE OneToOne 1 100 0.00 255.0 FORMAT "%5.1" ECU_ADDRESS 0x8FE5CA /end MEASUREMENT
/begin MEASUREMENT CrSCD_stIncSyncPhase_mp "Synchronisationsstatus des Inkrementgebersignals nach Aufruf von CaSCD_GetPos (Intern, Debugging)" UBYTE OneToOne 1 100 0.00 255.0 FORMAT "%5.1" ECU_ADDRESS 0x8FE5CB /end MEASUREMENT
/begin MEASUREMENT CrSCD_tiIncr "aktuelle Inkrementperiode (1 Inkrement = Winkelbereich aus 360°KW/CrSCD_ctIncs_C, Abtastung = 2ms)" UWORD TimeDT 1 100 0.00 65535.00 FORMAT "%8.2" ECU_ADDRESS 0x7F8BEE /end MEASUREMENT
/begin MEASUREMENT CrSCD_tiSeg "aktuelle Segmentperiode (1 Segment = Winkelbereich der über CrSCD_phiSeg_C appliziert ist, Abtastung = n-sync.)" ULONG Per_Dur 1 100 0.00 4294967295.00 FORMAT "%13.2" ECU_ADDRESS 0x7F91AC /end MEASUREMENT
/begin MEASUREMENT CrS_ctInjStrt_mp "Anzahl der durchgeführten Testeinspritzungen" UWORD OneToOne 1 100 0.00 65535.00 FORMAT "%8.2" ECU_ADDRESS 0x8FE5AA /end MEASUREMENT
/begin MEASUREMENT CrS_facSegTime_mp "Verhältnis der Segmentzeiten" SLONG Fact1 1 100 -16777216.0000 16777215.9922 FORMAT "%13.4" ECU_ADDRESS 0x8FE5AC /end MEASUREMENT
/begin MEASUREMENT CrS_numTDCStrtLst_mp "Zeigt den Zylinder an, in den als letztes eingespritzt wurde" UWORD OneToOne 1 100 0.00 65535.00 FORMAT "%8.2" ECU_ADDRESS 0x8FE5B0 /end MEASUREMENT
/begin MEASUREMENT CrS_numTDCStrt_mp "Zeigt die Zylinder an, in die bereits eingespritzt wurde" UWORD OneToOne 1 100 0.00 65535.00 FORMAT "%8.2" ECU_ADDRESS 0x8FE5B2 /end MEASUREMENT
/begin MEASUREMENT CrS_stStrt_mp "Messpunkt für Zustandsautomat" UBYTE OneToOne 1 100 0.00 255.0 FORMAT "%5.1" ECU_ADDRESS 0x8FE5B4 /end MEASUREMENT
/begin MEASUREMENT CrS_tiSegOld_mp "Segmentzeit vor einer Testeinspritzung" SLONG Per_Dur 1 100 -2147483648.00 2147483647.00 FORMAT "%13.2" ECU_ADDRESS 0x8FE5B8 /end MEASUREMENT
/begin MEASUREMENT CrS_tiSeg_mp "Segmentzeit nach einer Testeinspritzung" SLONG Per_Dur 1 100 -2147483648.00 2147483647.00 FORMAT "%13.2" ECU_ADDRESS 0x8FE5BC /end MEASUREMENT
/begin MEASUREMENT ctblink "Zeitzähler für Blinken der Markenanzeige" UBYTE t20msxs_ub_b5p1 1 100 0.00 5.100 FORMAT "%5.3" ECU_ADDRESS 0x7F89E5 /end MEASUREMENT
/begin MEASUREMENT CTSCD_dtClnt "Wechselrate der Kuehlwassertemperatur" SWORD TempCels_100ms 1 100 -32768.00 32767.00 FORMAT "%8.2" ECU_ADDRESS 0x7F8AFE /end MEASUREMENT
/begin MEASUREMENT CTSCD_stErrIni "Fehlerstatus ADC Kanal Kühlwassertemperatur während SG-Hochlauf" UBYTE OneToOne 1 100 0.00 255.0 FORMAT "%5.1" ECU_ADDRESS 0x7F87FB /end MEASUREMENT
/begin MEASUREMENT CTSCD_stPHtr "Heater Temperature status" UBYTE OneToOne 1 100 0.00 255.0 FORMAT "%5.1" ECU_ADDRESS 0x7F87FC /end MEASUREMENT
/begin MEASUREMENT CTSCD_stRmp_mp "Zustandsinformation aktiver Rampensteigungsparametersatz" UBYTE OneToOne 1 100 0.00 255.0 FORMAT "%5.1" ECU_ADDRESS 0x8FE5CC /end MEASUREMENT
/begin MEASUREMENT CTSCD_swtSig "Wassertemperatur über CAN oder ADC" UBYTE OneToOne 1 100 0.00 255.0 FORMAT "%5.1" ECU_ADDRESS 0x7F87FD /end MEASUREMENT
/begin MEASUREMENT CTSCD_tClnt "Kühlmitteltemperatur" SWORD Temp_Cels 1 100 -50.140 899.860 FORMAT "%8.3" ECU_ADDRESS 0x7F8B00 /end MEASUREMENT
/begin MEASUREMENT CTSCD_tClntLin "linearisierter Wert aus HWK vorm Aufruf der Übergangsfunktion" SWORD Temp_Cels 1 100 -50.140 899.860 FORMAT "%8.3" ECU_ADDRESS 0x7F8B02 /end MEASUREMENT
/begin MEASUREMENT CTSCD_tClntP "Coolant Temperature Before correction" SWORD Temp_Cels 1 100 -50.140 899.860 FORMAT "%8.3" ECU_ADDRESS 0x7F8B04 /end MEASUREMENT
/begin MEASUREMENT CTSCD_uRaw "Wassertemperatur Spannungsrohwert" SWORD Volt 1 100 -160156.4 160151.5 FORMAT "%8.1" ECU_ADDRESS 0x7F8B06 /end MEASUREMENT
/begin MEASUREMENT CycSigCheck_stTest "" UBYTE OneToOne 1 100 0.00 255.0 FORMAT "%5.1" ECU_ADDRESS 0x7F8845 /end MEASUREMENT
/begin MEASUREMENT DCC_nDvthires_mp "Regelabweichung Drehzahlregelung DCC mit höhere Auflösung" SWORD EngN_HiRes 1 100 -4096.000 4095.875 FORMAT "%8.3" ECU_ADDRESS 0x8FE5CE /end MEASUREMENT
/begin MEASUREMENT DCC_nDvt_mp "Regelabweichung Drehzahlregelung DCC" SWORD EngN 1 100 -32768.00 32767.00 FORMAT "%8.2" ECU_ADDRESS 0x8FE5D0 /end MEASUREMENT
/begin MEASUREMENT DCC_nSetPointRaw_mp "Roherwert Sollwert Drehzahlregelung DCC" SWORD EngN 1 100 -32768.00 32767.00 FORMAT "%8.2" ECU_ADDRESS 0x8FE5D2 /end MEASUREMENT
/begin MEASUREMENT DCC_nSetPoint_mp "Sollwert Drehzahlregelung DCC" SWORD EngN 1 100 -32768.00 32767.00 FORMAT "%8.2" ECU_ADDRESS 0x8FE5D4 /end MEASUREMENT
/begin MEASUREMENT DCC_nShft_mp "Motordrehzahl freezed während der Gangschaltungen" SWORD EngN 1 100 -32768.00 32767.00 FORMAT "%8.2" ECU_ADDRESS 0x8FE5D6 /end MEASUREMENT
/begin MEASUREMENT DCC_nWheel_mp "Fahrzeugraddrehzahl" SWORD WheelN 1 100 -32768.00 32767.00 FORMAT "%8.2" ECU_ADDRESS 0x8FE5D8 /end MEASUREMENT
/begin MEASUREMENT DCC_rTransDTNext_mp "Uebersetzungverhaeltnis des wahrscheinlichen Zielganges" SWORD TransR 1 100 -327.6800 327.6700 FORMAT "%8.4" ECU_ADDRESS 0x8FE5DA /end MEASUREMENT
/begin MEASUREMENT DCC_stAckEngDCC "Status Quittierung Antreibstrang" UBYTE OneToOne 1 100 0.00 255.0 FORMAT "%5.1" ECU_ADDRESS 0x7F8846 /end MEASUREMENT
/begin MEASUREMENT DCC_stActive "Radmoment-Anforderung aktiv" UBYTE OneToOne 1 100 0.00 255.0 FORMAT "%5.1" ECU_ADDRESS 0x7F8847 /end MEASUREMENT
/begin MEASUREMENT DCC_stBrkPressed_mp "Status der Bremse" UBYTE OneToOne 1 100 0.00 255.0 FORMAT "%5.1" ECU_ADDRESS 0x8FE5DC /end MEASUREMENT
/begin MEASUREMENT DCC_stCtlVel "Status regelung Geschwindigkeit" UBYTE OneToOne 1 100 0.00 255.0 FORMAT "%5.1" ECU_ADDRESS 0x7F8848 /end MEASUREMENT
/begin MEASUREMENT DCC_stDCC "Zustandautomat DCC" UBYTE OneToOne 1 100 0.00 255.0 FORMAT "%5.1" ECU_ADDRESS 0x7F8849 /end MEASUREMENT
/begin MEASUREMENT DCC_stError "Fehlerzustand in DCC" UBYTE OneToOne 1 100 0.00 255.0 FORMAT "%5.1" ECU_ADDRESS 0x7F884A /end MEASUREMENT
/begin MEASUREMENT DCC_stGearNext_mp "Wahrscheinlicher Zielgang" SBYTE OneToOne 1 100 -128.0 127.0 FORMAT "%5.1" ECU_ADDRESS 0x8FE5DD /end MEASUREMENT
/begin MEASUREMENT DCC_stGearOld_mp "Eingelegter Gang vor grip Verlust" SBYTE OneToOne 1 100 -128.0 127.0 FORMAT "%5.1" ECU_ADDRESS 0x8FE5DE /end MEASUREMENT
/begin MEASUREMENT DCC_stRecDCC "Status ob DCC im fahrzeug verbaut ist" UBYTE OneToOne 1 100 0.00 255.0 FORMAT "%5.1" ECU_ADDRESS 0x7F884B /end MEASUREMENT
/begin MEASUREMENT DCC_stRls "Status freigabe DCC Eingriff" UBYTE OneToOne 1 100 0.00 255.0 FORMAT "%5.1" ECU_ADDRESS 0x7F884C /end MEASUREMENT
/begin MEASUREMENT DCC_stRlsMT_mp "Status freigabe DCC Eingriff fuer Handschalter" UBYTE OneToOne 1 100 0.00 255.0 FORMAT "%5.1" ECU_ADDRESS 0x8FE5DF /end MEASUREMENT
/begin MEASUREMENT DCC_swtPosAT_mp "Rampenschalterstellung Automatik" UBYTE OneToOne 1 100 0.00 255.0 FORMAT "%5.1" ECU_ADDRESS 0x8FE5E0 /end MEASUREMENT
/begin MEASUREMENT DCC_swtPosBrk_mp "Rampenschalterstellung im Ueberwachung des DCC-Moment" UBYTE OneToOne 1 100 0.00 255.0 FORMAT "%5.1" ECU_ADDRESS 0x8FE5E1 /end MEASUREMENT
/begin MEASUREMENT DCC_swtPosES_mp "Rampenschalterstellung drehzahlregelung" UBYTE OneToOne 1 100 0.00 255.0 FORMAT "%5.1" ECU_ADDRESS 0x8FE5E2 /end MEASUREMENT
/begin MEASUREMENT DCC_swtPosMT_mp "Rampenschalterstellung Handschalter" UBYTE OneToOne 1 100 0.00 255.0 FORMAT "%5.1" ECU_ADDRESS 0x8FE5E3 /end MEASUREMENT
/begin MEASUREMENT DCC_trqDes "Wunschmoment DCC" SWORD TrqPrp 1 100 -6553.600 6553.400 FORMAT "%8.3" ECU_ADDRESS 0x7F8BF0 /end MEASUREMENT
/begin MEASUREMENT DCC_trqDesDCCFlt_mp "PT1 gefilterter Werte Moment-Anforderung ueber Can" SWORD TrqPrp 1 100 -6553.600 6553.400 FORMAT "%8.3" ECU_ADDRESS 0x8FE5E4 /end MEASUREMENT
/begin MEASUREMENT DCC_trqDesDCCMT_mp "DCC Wunschmoment fuer Handschalter" SWORD TrqPrp 1 100 -6553.600 6553.400 FORMAT "%8.3" ECU_ADDRESS 0x8FE5E6 /end MEASUREMENT
/begin MEASUREMENT DCC_trqEngSpdRaw_mp "Drehmoment Drehzahlregler - Rohwert" SWORD Trq 1 100 -3276.800 3276.700 FORMAT "%8.3" ECU_ADDRESS 0x8FE5E8 /end MEASUREMENT
/begin MEASUREMENT DCC_trqEngSpd_mp "Drehmoment Drehzahlregler" SWORD TrqPrp 1 100 -6553.600 6553.400 FORMAT "%8.3" ECU_ADDRESS 0x8FE5EA /end MEASUREMENT
/begin MEASUREMENT DCC_trqIEngSpd_mp "I-Anteil Drehzahlregler" SWORD Trq 1 100 -3276.800 3276.700 FORMAT "%8.3" ECU_ADDRESS 0x8FE5EC /end MEASUREMENT
/begin MEASUREMENT DCC_trqIInit_mp "Initialisierungswert fuer Motordrehzahlregler" SWORD Trq 1 100 -3276.800 3276.700 FORMAT "%8.3" ECU_ADDRESS 0x8FE5EE /end MEASUREMENT
/begin MEASUREMENT DCC_trqPEngSpd_mp "P-Anteil Drehzahlregler" SWORD Trq 1 100 -3276.800 3276.700 FORMAT "%8.3" ECU_ADDRESS 0x8FE5F0 /end MEASUREMENT
/begin MEASUREMENT DCC_trqRaw "Rohwert Radmoment" SWORD TrqPrp 1 100 -6553.600 6553.400 FORMAT "%8.3" ECU_ADDRESS 0x7F8BF2 /end MEASUREMENT
/begin MEASUREMENT DCC_trqRaw_mp "Rohwert Radmoment" SWORD TrqPrp 1 100 -6553.600 6553.400 FORMAT "%8.3" ECU_ADDRESS 0x8FE5F2 /end MEASUREMENT
/begin MEASUREMENT DCC_trqsaveStI_mp "Vorhergehender Wert des I-Zustandes des Motordrehzahlreglers" SWORD Trq 1 100 -3276.800 3276.700 FORMAT "%8.3" ECU_ADDRESS 0x8FE5F4 /end MEASUREMENT
/begin MEASUREMENT DCC_trqShft_mp "Drehmoment zur Initialisierung des Drehzahl Reglers" SWORD Trq 1 100 -3276.800 3276.700 FORMAT "%8.3" ECU_ADDRESS 0x8FE5F6 /end MEASUREMENT
/begin MEASUREMENT DCC_trqStI_mp "Anwesender Wert des I-Zustandes des Motordrehzahlreglers" SWORD Trq 1 100 -3276.800 3276.700 FORMAT "%8.3" ECU_ADDRESS 0x8FE5F8 /end MEASUREMENT
/begin MEASUREMENT DCC_vConv_mp "Fahrgeschwindigkeit (metres/min)" SLONG Vel_mpm 1 100 -21474836.4800 21474836.4700 FORMAT "%13.4" ECU_ADDRESS 0x8FE5FC /end MEASUREMENT
/begin MEASUREMENT DrvTrn_rFlatTransDT "Zugverhältnis für flache Drehkraftstruktur fahren" SWORD TransR 1 100 -327.6800 327.6700 FORMAT "%8.4" ECU_ADDRESS 0x7F8C00 /end MEASUREMENT
/begin MEASUREMENT DrvTrn_rTransDT "Triebstrang-Übersetzung (Radmoment pro Motormoment)" SWORD TransR 1 100 -327.6800 327.6700 FORMAT "%8.4" ECU_ADDRESS 0x7F8C02 /end MEASUREMENT
/begin MEASUREMENT DrvTrn_rTransDTact_mp "aktueller Wert der Triebstrangübersetzung" SWORD TransR 1 100 -327.6800 327.6700 FORMAT "%8.4" ECU_ADDRESS 0x8FE600 /end MEASUREMENT
/begin MEASUREMENT DrvTrn_rTransDTRmpIn_mp "Input to the ramp for delaying torque requests" SWORD TransR 1 100 -327.6800 327.6700 FORMAT "%8.4" ECU_ADDRESS 0x8FE602 /end MEASUREMENT
/begin MEASUREMENT dvmark_w "Mindestabstand von Geschwindigkeitsmarken beim Stufentempomat" UWORD Vel 1 100 0.00 655.3500 FORMAT "%8.4" ECU_ADDRESS 0x7F912C /end MEASUREMENT
/begin MEASUREMENT dvprg_w "Schrittweite bei Anzeige der Regelgeschwindigkeit im Programmiermodus" UWORD Vel 1 100 0.00 655.3500 FORMAT "%8.4" ECU_ADDRESS 0x7F912E /end MEASUREMENT
/begin MEASUREMENT dvstutom_w "Schrittweite für Verstellung der Zielgeschwindigkeit ohne programmierte Marken" UWORD Vel 1 100 0.00 655.3500 FORMAT "%8.4" ECU_ADDRESS 0x7F9130 /end MEASUREMENT
/begin MEASUREMENT indexmrst "Index für vmrki..." UBYTE dez 1 100 0.00 255.0 FORMAT "%5.1" ECU_ADDRESS 0x7F89E6 /end MEASUREMENT
/begin MEASUREMENT mmimrk_w "ported from ME9" UWORD Vel 1 100 0.00 655.3500 FORMAT "%8.4" ARRAY_SIZE 15 ECU_ADDRESS 0x7F94D0 /end MEASUREMENT
/begin MEASUREMENT mrknrc "Nummer veränderte Geschwindigkeits-Marke für schnelle CAN- Übertragung" UBYTE dez 1 100 0.00 255.0 FORMAT "%5.1" ECU_ADDRESS 0x7F89E7 /end MEASUREMENT
/begin MEASUREMENT mrknrcan "Nummer Geschwindigkeits-Marken Stufentempomat f ür CAN- Übertragung" UBYTE dez 1 100 0.00 255.0 FORMAT "%5.1" ARRAY_SIZE 15 ECU_ADDRESS 0x7F9482 /end MEASUREMENT
/begin MEASUREMENT mrknrint "Nummer Geschwindigkeits-Marken Stufentempomat intern" UBYTE dez 1 100 0.00 255.0 FORMAT "%5.1" ARRAY_SIZE 15 ECU_ADDRESS 0x7F9491 /end MEASUREMENT
/begin MEASUREMENT mrkstut_w "Geschwindigkeits-Marken Stufentempomat" UWORD Vel 1 100 0.00 655.3500 FORMAT "%8.4" ARRAY_SIZE 15 ECU_ADDRESS 0x7F94EE /end MEASUREMENT
/begin MEASUREMENT statvza "Status Zielgeschwindigkeit für Kombi-Anzeige Stufentempomat" UBYTE dez 1 100 0.00 255.0 FORMAT "%5.1" ECU_ADDRESS 0x7F89EC /end MEASUREMENT
/begin MEASUREMENT tnomgs60ms "Zeit in der keine CAN-Botschaft G_T versendet wurde" UBYTE t20msxs_ub_b5p1 1 100 0.00 5.100 FORMAT "%5.3" ECU_ADDRESS 0x7F89ED /end MEASUREMENT
/begin MEASUREMENT vfgr_w "Fahrzeug-Ist-Geschwindigkeit für FGR" UWORD Vel 1 100 0.00 655.3500 FORMAT "%8.4" ECU_ADDRESS 0x7F9134 /end MEASUREMENT
/begin MEASUREMENT vmrki1_w "v-Marke 1 für Botschaft" UWORD Vel 1 100 0.00 655.3500 FORMAT "%8.4" ECU_ADDRESS 0x7F9136 /end MEASUREMENT
/begin MEASUREMENT vmrki2_w "v-Marke 2 für Botschaft" UWORD Vel 1 100 0.00 655.3500 FORMAT "%8.4" ECU_ADDRESS 0x7F9138 /end MEASUREMENT
/begin MEASUREMENT vmrki3_w "v-Marke 3 für Botschaft" UWORD Vel 1 100 0.00 655.3500 FORMAT "%8.4" ECU_ADDRESS 0x7F913A /end MEASUREMENT
/begin MEASUREMENT vreglmax_w "Maximal zulässige Sollgeschwindigkeit für FGR" UWORD Vel 1 100 0.00 655.3500 FORMAT "%8.4" ECU_ADDRESS 0x7F913C /end MEASUREMENT
/begin MEASUREMENT vreglmin_w "minimal zulässige Sollgeschwindigkeit für FGR" UWORD Vel 1 100 0.00 655.3500 FORMAT "%8.4" ECU_ADDRESS 0x7F913E /end MEASUREMENT
/begin MEASUREMENT vzielakvp_w "Variable für Zielgeschwindigkeit im Kombi" UWORD Vel 1 100 0.00 655.3500 FORMAT "%8.4" ECU_ADDRESS 0x7F9144 /end MEASUREMENT
/begin MEASUREMENT vzielak_w "Zielgeschwindigkeit für Kombi-Anzeige Stufentempomat" UWORD Vel 1 100 0.00 655.3500 FORMAT "%8.4" ECU_ADDRESS 0x7F9142 /end MEASUREMENT
/begin MEASUREMENT vziels_w "Berechnete Soll-Zielgeschwindigkeit für FGR" UWORD Vel 1 100 0.00 655.3500 FORMAT "%8.4" ECU_ADDRESS 0x7F9146 /end MEASUREMENT
/begin MEASUREMENT vziel_w "Zielgeschwindigkeit für FGR" UWORD Vel 1 100 0.00 655.3500 FORMAT "%8.4" ECU_ADDRESS 0x7F9140 /end MEASUREMENT
/begin FUNCTION cpbvlv_logic ""
 /begin DEF_CHARACTERISTIC CpBVlv_numGear_C CpBVlv_qCloseRgn_MAP CpBVlv_qClose_MAP CpBVlv_qOpnRgn_MAP CpBVlv_qOpn_MAP CpBVlv_stClose_C CpBVlv_stOpn_C CpBVlv_stRgnMsk_C CpBVlv_swtErrOff_C CpBVlv_swtQDesVal_C CpBVlv_tiRmpSlp_C /end DEF_CHARACTERISTIC
 /begin IN_MEASUREMENT APSCD_pVal Eng_nAvrg /end IN_MEASUREMENT
/end FUNCTION
/begin FUNCTION cpbvlv_logic_msg "" /begin OUT_MEASUREMENT CpBVlv_stLogic CpBVlv_stOpn /end OUT_MEASUREMENT /end FUNCTION
/begin FUNCTION cpbvlv_logic_uic "" /begin OUT_MEASUREMENT CpBVlv_qClose_mp CpBVlv_qOpn_mp CpBVlv_stOff_mp /end OUT_MEASUREMENT /end FUNCTION
/begin FUNCTION crccd_keydet "Bedienteilerfassung Fahrgeschwindigkeitsregler"
 /begin DEF_CHARACTERISTIC CrCCD_tiDebMaxMFLDef_C CrCCD_tiDebMaxMFLOk_C CrCCD_tiDebMinMFLDef_C CrCCD_tiDebMinMFLOk_C CrCCD_tiDebNplMFLDef_C CrCCD_tiDebNplMFLOk_C CrCCD_tiDebSigMFLDef_C CrCCD_tiDebSigMFLOk_C CrCCD_stMSWModeAdjMax_C CrCCD_stMSWModeAdjMin_C CrCCD_stMSWModeDflt_C CrCCD_swtDevType_C CrCCD_swtDevVal_C CrCCD_swtMSWType_C CrCCD_swtMSWVal_C CrCCD_tiDebSetMn_C CrCCD_tiDebSetPl_C CrCCD_tiToggleMax_C /end DEF_CHARACTERISTIC
/end FUNCTION
/begin FUNCTION crccd_keydet_msg ""
 /begin OUT_MEASUREMENT CrCCD_stDev CrCCD_stKey CrCCD_stKeyOff CrCCD_swtDev CrCCD_swtMSW /end OUT_MEASUREMENT
/end FUNCTION
/begin FUNCTION crccd_keydet_uic "" /begin OUT_MEASUREMENT CrCCD_dMFLData_mp /end OUT_MEASUREMENT /end FUNCTION
/begin FUNCTION crctl_detcrctl "" /end FUNCTION
/begin FUNCTION crctl_detcrctl_msg "" /begin OUT_MEASUREMENT CrCtl_stRecFGR /end OUT_MEASUREMENT /end FUNCTION
/begin FUNCTION crctl_detcrctl_uic "" /end FUNCTION
/begin FUNCTION crctl_msg "" /begin OUT_MEASUREMENT CrCtl_stActive CrCtl_trqDes CrCtl_trqLead /end OUT_MEASUREMENT /end FUNCTION
/begin FUNCTION crctl_sendvmrk "Aufbereitung Stufentempomatinformation für Kombi" /begin DEF_CHARACTERISTIC TMSGSGTMN /end DEF_CHARACTERISTIC /end FUNCTION
/begin FUNCTION crctl_sendvmrk_msg ""
 /begin OUT_MEASUREMENT B_acmsggts B_cmsggts B_ergacgt B_mrkvff indexmrst tnomgs60ms vmrki1_w vmrki2_w vmrki3_w /end OUT_MEASUREMENT
/end FUNCTION
/begin FUNCTION crctl_sendvmrk_uic "" /end FUNCTION
/begin FUNCTION crctl_shutoff "FGR-Abschaltung"
 /begin DEF_CHARACTERISTIC CrCtl_aAccMax_C CrCtl_aDecMax_C CrCtl_nMaxAlw_C CrCtl_nMinAlw_C CrCtl_rVnDvtShutOff_C CrCtl_stShutOffCodeMsk_C CrCtl_stShutOffHDC_C CrCtl_stShutOffInfoLR_C CrCtl_stShutOffLR_C CrCtl_swtSelKombi_C CrCtl_swtShutOffOpt_C CrCtl_tiAcc_C CrCtl_tiAqpl_C CrCtl_tiClCtrDelayABS_C CrCtl_tiClCtrDelayASC_C CrCtl_tiClCtrDelayDSC_C CrCtl_tiClCtrDelayEBV_C CrCtl_tiClCtrDelayHBA_C CrCtl_tiClCtrDelayMSR_C CrCtl_tiDec_C CrCtl_tiGearDeb_C CrCtl_tiNegDvtTi_C CrCtl_vDiffAqpl_C CrCtl_vMaxShutOff_C CrCtl_vMinShutOff_C CrCtl_vNegDvtTi_C CrCtl_vNegDvt_C CrCtl_vPosDvt_C /end DEF_CHARACTERISTIC
/end FUNCTION
/begin FUNCTION crctl_shutoff_msg "" /begin OUT_MEASUREMENT CrCtl_numGear CrCtl_stShutOffCode /end OUT_MEASUREMENT /end FUNCTION
/begin FUNCTION crctl_shutoff_uic ""
 /begin OUT_MEASUREMENT CrCtl_stBrkBeforeCruise_mp CrCtl_stClCtr_mp CrCtl_stShutOffCode1_mp CrCtl_stShutOffCode2_mp CrCtl_stShutOffFrz1_mp CrCtl_stShutOffFrz2_mp CrCtl_stShutOffFrz_mp /end OUT_MEASUREMENT
/end FUNCTION
/begin FUNCTION crctl_updatedem "FGR-Anforderungen Update (Abschalten + Regler)"
 /begin DEF_CHARACTERISTIC CrCtl_aAccLim_C CrCtl_AccGear2PKp_C CrCtl_AccGear2PKpPos_C CrCtl_AccGear2PKpNeg_C CrCtl_vAccGear2PWinPos_C CrCtl_vAccGear2PWinNeg_C CrCtl_AccGear3PKp_C CrCtl_AccGear3PKpPos_C CrCtl_AccGear3PKpNeg_C CrCtl_vAccGear3PWinPos_C CrCtl_vAccGear3PWinNeg_C CrCtl_AccGear4PKp_C CrCtl_AccGear4PKpPos_C CrCtl_AccGear4PKpNeg_C CrCtl_vAccGear4PWinPos_C CrCtl_vAccGear4PWinNeg_C CrCtl_AccGear5PKp_C CrCtl_AccGear5PKpPos_C CrCtl_AccGear5PKpNeg_C CrCtl_vAccGear5PWinPos_C CrCtl_vAccGear5PWinNeg_C CrCtl_AccGear6PKp_C CrCtl_AccGear6PKpPos_C CrCtl_AccGear6PKpNeg_C CrCtl_vAccGear6PWinPos_C CrCtl_vAccGear6PWinNeg_C CrCtl_aDeclLim_C CrCtl_ctMaxTip_C CrCtl_DeclGear2PKp_C CrCtl_DeclGear2PKpPos_C CrCtl_DeclGear2PKpNeg_C CrCtl_vDeclGear2PWinPos_C CrCtl_vDeclGear2PWinNeg_C CrCtl_DeclGear3PKp_C CrCtl_DeclGear3PKpPos_C CrCtl_DeclGear3PKpNeg_C CrCtl_vDeclGear3PWinPos_C CrCtl_vDeclGear3PWinNeg_C CrCtl_DeclGear4PKp_C CrCtl_DeclGear4PKpPos_C CrCtl_DeclGear4PKpNeg_C CrCtl_vDeclGear4PWinPos_C CrCtl_vDeclGear4PWinNeg_C CrCtl_DeclGear5PKp_C CrCtl_DeclGear5PKpPos_C CrCtl_DeclGear5PKpNeg_C CrCtl_vDeclGear5PWinPos_C CrCtl_vDeclGear5PWinNeg_C CrCtl_DeclGear6PKp_C CrCtl_DeclGear6PKpPos_C CrCtl_DeclGear6PKpNeg_C CrCtl_vDeclGear6PWinPos_C CrCtl_vDeclGear6PWinNeg_C CrCtl_dtrqAccDwn_C CrCtl_dtrqDeclUp_C CrCtl_dtrqOffComf1_C CrCtl_dtrqOffComf2_C CrCtl_dtrqOffFast1_CUR CrCtl_dtrqOffFast2_CUR CrCtl_dtrqOffFast3_CUR CrCtl_dvAccFDCG3_CUR CrCtl_dvAccFDCG4_CUR CrCtl_dvAccFDCG5_CUR CrCtl_dvAccFDCG6_CUR CrCtl_dvAccG3_CUR CrCtl_dvAccG4_CUR CrCtl_dvAccG5_CUR CrCtl_dvAccG6_CUR CrCtl_dvDeclFDCG3_CUR CrCtl_dvDeclFDCG4_CUR CrCtl_dvDeclFDCG5_CUR CrCtl_dvDeclFDCG6_CUR CrCtl_dvDeclG3_CUR CrCtl_dvDeclG4_CUR CrCtl_dvDeclG5_CUR CrCtl_dvDeclG6_CUR CrCtl_dvResAbvFDCG3_CUR CrCtl_dvResAbvFDCG4_CUR CrCtl_dvResAbvFDCG5_CUR CrCtl_dvResAbvFDCG6_CUR CrCtl_dvResAbvG3_MAP CrCtl_dvResAbvG4_MAP CrCtl_dvResAbvG5_MAP CrCtl_dvResAbvG6_MAP CrCtl_dvResBlwFDCG3_CUR CrCtl_dvResBlwFDCG4_CUR CrCtl_dvResBlwFDCG5_CUR CrCtl_dvResBlwFDCG6_CUR CrCtl_dvResBlwG3_MAP CrCtl_dvResBlwG4_MAP CrCtl_dvResBlwG5_MAP CrCtl_dvResBlwG6_MAP CrCtl_facIncSlope_CUR CrCtl_facPropAcc_C CrCtl_facPropDecl_C CrCtl_facRedDecl_C CrCtl_facRedHi_C CrCtl_facRedLo_C CrCtl_facResAbvFDC_CUR CrCtl_facResAbv_CUR CrCtl_facResBlwFDC_CUR CrCtl_facResBlw_CUR CrCtl_facRmpRes_C CrCtl_HoldGear2IKi_C CrCtl_HoldGear2IKiPos_C CrCtl_HoldGear2IKiNeg_C CrCtl_vHoldGear2IWinPos_C CrCtl_vHoldGear2IWinNeg_C CrCtl_HoldGear2PKp_C CrCtl_HoldGear2PKpPos_C CrCtl_HoldGear2PKpNeg_C CrCtl_vHoldGear2PWinPos_C CrCtl_vHoldGear2PWinNeg_C CrCtl_HoldGear3IKi_C CrCtl_HoldGear3IKiPos_C CrCtl_HoldGear3IKiNeg_C CrCtl_vHoldGear3IWinPos_C CrCtl_vHoldGear3IWinNeg_C CrCtl_HoldGear3PKp_C CrCtl_HoldGear3PKpPos_C CrCtl_HoldGear3PKpNeg_C CrCtl_vHoldGear3PWinPos_C CrCtl_vHoldGear3PWinNeg_C CrCtl_HoldGear4IKi_C CrCtl_HoldGear4IKiPos_C CrCtl_HoldGear4IKiNeg_C CrCtl_vHoldGear4IWinPos_C CrCtl_vHoldGear4IWinNeg_C CrCtl_HoldGear4PKp_C CrCtl_HoldGear4PKpPos_C CrCtl_HoldGear4PKpNeg_C CrCtl_vHoldGear4PWinPos_C CrCtl_vHoldGear4PWinNeg_C CrCtl_HoldGear5IKi_C CrCtl_HoldGear5IKiPos_C CrCtl_HoldGear5IKiNeg_C CrCtl_vHoldGear5IWinPos_C CrCtl_vHoldGear5IWinNeg_C CrCtl_HoldGear5PKp_C CrCtl_HoldGear5PKpPos_C CrCtl_HoldGear5PKpNeg_C CrCtl_vHoldGear5PWinPos_C CrCtl_vHoldGear5PWinNeg_C CrCtl_HoldGear6IKi_C CrCtl_HoldGear6IKiPos_C CrCtl_HoldGear6IKiNeg_C CrCtl_vHoldGear6IWinPos_C CrCtl_vHoldGear6IWinNeg_C CrCtl_HoldGear6PKp_C CrCtl_HoldGear6PKpPos_C CrCtl_HoldGear6PKpNeg_C CrCtl_vHoldGear6PWinPos_C CrCtl_vHoldGear6PWinNeg_C CrCtl_tiResAbvGear2DT1_C CrCtl_ResAbvGear2DT1Kd_C CrCtl_tiResAbvGear3DT1_C CrCtl_ResAbvGear3DT1Kd_C CrCtl_tiResAbvGear4DT1_C CrCtl_ResAbvGear4DT1Kd_C CrCtl_tiResAbvGear5DT1_C CrCtl_ResAbvGear5DT1Kd_C CrCtl_tiResAbvGear6DT1_C CrCtl_ResAbvGear6DT1Kd_C CrCtl_ResBlwGear2IKi_C CrCtl_ResBlwGear2IKiPos_C CrCtl_ResBlwGear2IKiNeg_C CrCtl_vResBlwGear2IWinPos_C CrCtl_vResBlwGear2IWinNeg_C CrCtl_ResBlwGear2PKp_C CrCtl_ResBlwGear2PKpPos_C CrCtl_ResBlwGear2PKpNeg_C CrCtl_vResBlwGear2PWinPos_C CrCtl_vResBlwGear2PWinNeg_C CrCtl_ResBlwGear3IKi_C CrCtl_ResBlwGear3IKiPos_C CrCtl_ResBlwGear3IKiNeg_C CrCtl_vResBlwGear3IWinPos_C CrCtl_vResBlwGear3IWinNeg_C CrCtl_ResBlwGear3PKp_C CrCtl_ResBlwGear3PKpPos_C CrCtl_ResBlwGear3PKpNeg_C CrCtl_vResBlwGear3PWinPos_C CrCtl_vResBlwGear3PWinNeg_C CrCtl_ResBlwGear4IKi_C CrCtl_ResBlwGear4IKiPos_C CrCtl_ResBlwGear4IKiNeg_C CrCtl_vResBlwGear4IWinPos_C CrCtl_vResBlwGear4IWinNeg_C CrCtl_ResBlwGear4PKp_C CrCtl_ResBlwGear4PKpPos_C CrCtl_ResBlwGear4PKpNeg_C CrCtl_vResBlwGear4PWinPos_C CrCtl_vResBlwGear4PWinNeg_C CrCtl_ResBlwGear5IKi_C CrCtl_ResBlwGear5IKiPos_C CrCtl_ResBlwGear5IKiNeg_C CrCtl_vResBlwGear5IWinPos_C CrCtl_vResBlwGear5IWinNeg_C CrCtl_ResBlwGear5PKp_C CrCtl_ResBlwGear5PKpPos_C CrCtl_ResBlwGear5PKpNeg_C CrCtl_vResBlwGear5PWinPos_C CrCtl_vResBlwGear5PWinNeg_C CrCtl_ResBlwGear6IKi_C CrCtl_ResBlwGear6IKiPos_C CrCtl_ResBlwGear6IKiNeg_C CrCtl_vResBlwGear6IWinPos_C CrCtl_vResBlwGear6IWinNeg_C CrCtl_ResBlwGear6PKp_C CrCtl_ResBlwGear6PKpPos_C CrCtl_ResBlwGear6PKpNeg_C CrCtl_vResBlwGear6PWinPos_C CrCtl_vResBlwGear6PWinNeg_C CrCtl_ResRmpGear2PKp_C CrCtl_ResRmpGear2PKpPos_C CrCtl_ResRmpGear2PKpNeg_C CrCtl_vResRmpGear2PWinPos_C CrCtl_vResRmpGear2PWinNeg_C CrCtl_ResRmpGear3PKp_C CrCtl_ResRmpGear3PKpPos_C CrCtl_ResRmpGear3PKpNeg_C CrCtl_vResRmpGear3PWinPos_C CrCtl_vResRmpGear3PWinNeg_C CrCtl_ResRmpGear4PKp_C CrCtl_ResRmpGear4PKpPos_C CrCtl_ResRmpGear4PKpNeg_C CrCtl_vResRmpGear4PWinPos_C CrCtl_vResRmpGear4PWinNeg_C CrCtl_ResRmpGear5PKp_C CrCtl_ResRmpGear5PKpPos_C CrCtl_ResRmpGear5PKpNeg_C CrCtl_vResRmpGear5PWinPos_C CrCtl_vResRmpGear5PWinNeg_C CrCtl_ResRmpGear6PKp_C CrCtl_ResRmpGear6PKpPos_C CrCtl_ResRmpGear6PKpNeg_C CrCtl_vResRmpGear6PWinPos_C CrCtl_vResRmpGear6PWinNeg_C CrCtl_swtResOff_C CrCtl_tiOff_C CrCtl_tiTipUpDn_C CrCtl_trqDesThres_C CrCtl_trqMaxOfs_C CrCtl_trqOffComf_C CrCtl_trqOffFast12_C CrCtl_trqOffFast23_C CrCtl_vAccSet_C CrCtl_vAlwDvtThres_C CrCtl_vDeclSet_C CrCtl_vDiffAccMax_C CrCtl_vDiffAcc_C CrCtl_vDiffDeclMax_C CrCtl_vDiffDecl_C CrCtl_vDiffResAbv_C CrCtl_vDiffResBlw_C CrCtl_vDvtNegTipDwn_C CrCtl_vDvtNegTipUp_C CrCtl_vDvtPosTipDwn_C CrCtl_vOfsDecl_C CrCtl_vOfsResBlw_C CrCtl_vOfsRes_C CrCtl_vRlsOfsI_C CrCtl_vTipStep_C /end DEF_CHARACTERISTIC
 /begin IN_MEASUREMENT CrCtl_vBeg CrCtl_vDiffRed_mp CrCtl_vDiff_mp Gearbx_stGear Rail_tiThresMonEna /end IN_MEASUREMENT
/end FUNCTION
/begin FUNCTION crctl_updatedem_msg ""
 /begin OUT_MEASUREMENT CrCtl_rVnBeg CrCtl_st CrCtl_stCAN CrCtl_stLampOut CrCtl_vBeg CrCtl_vDes CrCtl_vRmp /end OUT_MEASUREMENT
/end FUNCTION
/begin FUNCTION crctl_updatedem_uic ""
 /begin DEF_CHARACTERISTIC CrCtl_trqDes_Vector CrCtl_trqDes_Channel CrCtl_trqLead_Vector CrCtl_trqLead_Channel /end DEF_CHARACTERISTIC
 /begin OUT_MEASUREMENT CrCtl_dvAcc_mp CrCtl_dvDecl_mp CrCtl_dvResAbv_mp CrCtl_dvResBlw_mp CrCtl_trqDT1_mp CrCtl_trqI_mp CrCtl_trqMax_mp CrCtl_trqP_mp CrCtl_vDiffRed_mp CrCtl_vDiff_mp /end OUT_MEASUREMENT
/end FUNCTION
/begin FUNCTION crctl_vcrctl ""
 /begin DEF_CHARACTERISTIC CrCtl_DebToVCrCtlDef_C CrCtl_DebToVCrCtlOk_C CrCtl_rAccPedVelMin_C CrCtl_swtCrCtlType_C CrCtl_swtOffset_C CrCtl_swtVSSFil_C CrCtl_tiDisableDiagVCrCtl_C CrCtl_tiDispOffFil_C CrCtl_tiVSSFil_C CrCtl_uBattMin_C CrCtl_vAlwMaxKm_C CrCtl_vAlwMaxM_C CrCtl_vAlwMinKm_C CrCtl_vAlwMinM_C CrCtl_vOffMax_C /end DEF_CHARACTERISTIC
/end FUNCTION
/begin FUNCTION crctl_vcrctl_msg ""
 /begin OUT_MEASUREMENT CrCtl_stVCrCtl CrCtl_vAlwMax CrCtl_vAlwMin CrCtl_vCurr CrCtl_vDispOffset /end OUT_MEASUREMENT
/end FUNCTION
/begin FUNCTION crctl_vcrctl_uic "" /end FUNCTION
/begin FUNCTION crctl_vsetstep "Stufentempomat"
 /begin DEF_CHARACTERISTIC ANZMRKAUS ANZMRKMX CWBGSTUT DVMARK DVMARKMI DVPRG DVPRGMI DVSTUTOM DVSTUTOMMI TFGRTP TMARK TMRKBLI TSELO TVSTUTK TVSTUTL VFGRPRG VVEMOFS /end DEF_CHARACTERISTIC
/end FUNCTION
/begin FUNCTION crctl_vsetstep_msg ""
 /begin OUT_MEASUREMENT anzmark BGSTUTlokbits0 B_beveh B_bv1 B_bv2 B_envtwa B_fgrepa B_mrkbli B_mrkein B_mrkv B_prgmod B_tmark B_tmrkbli B_vziels canzbl ctblink dvmark_w dvprg_w dvstutom_w mrknrc mrknrcan mrknrint mrkstut_w statvza vzielakvp_w vzielak_w vziels_w /end OUT_MEASUREMENT
/end FUNCTION
/begin FUNCTION crctl_vsetstep_uic "" /begin OUT_MEASUREMENT CrCtl_BGSTUTbits2_mp CrCtl_mrkeinvp_mp /end OUT_MEASUREMENT /end FUNCTION
/begin FUNCTION crctl_vstepadapt "Aufbereitung der Größen für den Stufentempomaten" /end FUNCTION
/begin FUNCTION crctl_vstepadapt_msg ""
 /begin OUT_MEASUREMENT B_acc B_besch B_fgrat B_fgren B_fgresv B_fgrtb2 B_fgrtbe B_fgrtv2 B_fgrtve B_fgrtwa B_fgrvem B_insfgre B_kl15 B_km B_mmiena CrCtl_numVMrk CrCtl_stCC CrCtl_stUpdateVMrk CrCtl_stVDisp CrCtl_stVSetNew CrCtl_vDesDisp CrCtl_vMrk1 CrCtl_vMrk2 CrCtl_vMrk3 CrCtl_vSetNew mmimrk_w vfgr_w vreglmax_w vreglmin_w vziel_w /end OUT_MEASUREMENT
/end FUNCTION
/begin FUNCTION crctl_vstepadapt_uic "" /end FUNCTION
/begin FUNCTION crscd "Komponententreiber Kurbelwelle"
 /begin DEF_CHARACTERISTIC CrSCD_ctTurns_C CrSCD_nFast_C CrSCD_nMax_C CrSCD_nMin_C CrSCD_nSlowHigh_C CrSCD_nSlow_C CrSCD_numShftMisf_C CrSCD_phiIncCor_CUR CrSCD_phiSegLength_C CrSCD_phiSegPhase_C /end DEF_CHARACTERISTIC
 /begin IN_MEASUREMENT CrSCD_nAvrg /end IN_MEASUREMENT
/end FUNCTION
/begin FUNCTION crscd_msg ""
 /begin OUT_MEASUREMENT CrSCD_dSegMisf CrSCD_nAvrg CrSCD_nAvrgHiRes CrSCD_nCurr CrSCD_nCurrHiRes CrSCD_nDyn CrSCD_nHold CrSCD_nMisf CrSCD_numSeg CrSCD_phiIncCor CrSCD_phiIncr CrSCD_tiSeg /end OUT_MEASUREMENT
/end FUNCTION
/begin FUNCTION crscd_thresctl ""
 /begin DEF_CHARACTERISTIC CrSCD_ctThresCtlMin_C CrSCD_nThresCtlHigh_C CrSCD_nThresCtlLow_C /end DEF_CHARACTERISTIC
/end FUNCTION
/begin FUNCTION crscd_uic ""
 /begin OUT_MEASUREMENT CrSCD_incNextIntDelta_mp CrSCD_incNextInt_mp CrSCD_phiCurr_mp CrSCD_phiSegGrid_mp CrSCD_stIncErr_mp CrSCD_stIncSig_mp CrSCD_stIncSyncInc_mp CrSCD_stIncSyncPhase_mp /end OUT_MEASUREMENT
/end FUNCTION
/begin FUNCTION crscd_var ""
 /begin DEF_CHARACTERISTIC CrSCD_ctGapIncs_C CrSCD_ctGaps_C CrSCD_ctIncs_C CrSCD_facGapPlausHigh_CUR CrSCD_facGapPlausLow_CUR CrSCD_facIncPlausHigh_CUR CrSCD_facIncPlausLow_CUR CrSCD_numFBCSeg_C CrSCD_numTDCSeg_C CrSCD_phiGap2Zero_C CrSCD_tiPlausCalcOff_C /end DEF_CHARACTERISTIC
 /begin IN_MEASUREMENT CrSCD_tiIncr /end IN_MEASUREMENT
/end FUNCTION
/begin FUNCTION crscd_var_msg "" /begin OUT_MEASUREMENT CrSCD_nIncr CrSCD_tiIncr /end OUT_MEASUREMENT /end FUNCTION
/begin FUNCTION crs_chkstrtspd "Redundanter Start nur mit Kurbelwelle"
 /begin DEF_CHARACTERISTIC CrS_ctMaxInjStrt_C CrS_facSegTimeMax_C CrS_facSegTimeMin_C CrS_facSegTime_C CrS_phiSegLengthStrtSpd_C CrS_phiSegOfsStrtSpdOld_C CrS_phiSegOfsStrtSpd_C /end DEF_CHARACTERISTIC
/end FUNCTION
/begin FUNCTION crs_chkstrtspd_uic ""
 /begin OUT_MEASUREMENT CrS_ctInjStrt_mp CrS_facSegTime_mp CrS_numTDCStrtLst_mp CrS_numTDCStrt_mp CrS_stStrt_mp CrS_tiSegOld_mp CrS_tiSeg_mp /end OUT_MEASUREMENT
/end FUNCTION
/begin FUNCTION ctscd "Wassertemperaturfühler Komponententreiber"
 /begin DEF_CHARACTERISTIC CTSCD_uSRCMin_C CTSCD_uSRCMax_C CTSCD_tLin_CUR CTSCD_DebSigDef_C CTSCD_DebSigOk_C CTSCD_DebSRCHighDef_C CTSCD_DebSRCHighOk_C CTSCD_DebSRCLowDef_C CTSCD_DebSRCLowOk_C CTSCD_dtRmpSlp2UpDwn_C CTSCD_dtFlTempUp_C CTSCD_dtFlTempDwn_C CTSCD_numAdc_C CTSCD_dtRmpSlp1Up_C CTSCD_dtRmpSlp1Dwn_C CTSCD_stSensIDWord_C CTSCD_swtPHtrIgnoreCAN_C CTSCD_swtSigVal_C CTSCD_tClntPMin_C CTSCD_tDflCold_C CTSCD_tDflWarm_C CTSCD_tDiffThres_C CTSCD_tFuelMin_C CTSCD_tiWait_C /end DEF_CHARACTERISTIC
 /begin IN_MEASUREMENT CTSCD_uRaw /end IN_MEASUREMENT
/end FUNCTION
/begin FUNCTION ctscd_msg ""
 /begin OUT_MEASUREMENT CTSCD_dtClnt CTSCD_stErrIni CTSCD_stPHtr CTSCD_swtSig CTSCD_tClnt CTSCD_tClntLin CTSCD_tClntP CTSCD_uRaw /end OUT_MEASUREMENT
/end FUNCTION
/begin FUNCTION ctscd_uic "" /begin OUT_MEASUREMENT CTSCD_stRmp_mp /end OUT_MEASUREMENT /end FUNCTION
/begin FUNCTION ctscd_var "" /end FUNCTION
/begin FUNCTION ctscd_var_msg "" /end FUNCTION
/begin FUNCTION curmap_size_base "" /end FUNCTION
/begin FUNCTION curmap_size_proj "" /end FUNCTION
/begin FUNCTION curmap_size_sys "" /end FUNCTION
/begin FUNCTION cycsigcheck ""
 /begin DEF_CHARACTERISTIC CycSigCheck_nLimit_C CycSigCheck_swtMode_C CycSigCheck_swtOff_C /end DEF_CHARACTERISTIC
/end FUNCTION
/begin FUNCTION cycsigcheck_msg "" /begin OUT_MEASUREMENT CycSigCheck_stTest /end OUT_MEASUREMENT /end FUNCTION
/begin FUNCTION dcc_updatedem "Fahrgeschwindigkeitregelung"
 /begin DEF_CHARACTERISTIC DCC_DebPlausTrqDesDef_C DCC_DebPlausTrqDesOk_C DCC_EngSpdKi_C DCC_EngSpdKiPos_C DCC_EngSpdKiNeg_C DCC_nEngSpdIWinPos_C DCC_nEngSpdIWinNeg_C DCC_EngSpdKp_C DCC_EngSpdKpPos_C DCC_EngSpdKpNeg_C DCC_nEngSpdPWinPos_C DCC_nEngSpdPWinNeg_C DCC_lWheelDyn_C DCC_nSetPoint_CUR DCC_nShft_C DCC_numGearMax_C DCC_swtARWMode_C DCC_swtTrqDesShutOff_C DCC_tiBrkPressedDel_C DCC_tiEngSpdActv_C DCC_tiPlausBrk_C DCC_tiPT1_C DCC_trqARWIMin_C DCC_trqEngSpdMax_C DCC_dtrqLimBrkUp_C DCC_dtrqLimBrkDwn_C DCC_dtrqSwtUp_C DCC_dtrqSwtDwn_C DCC_dtrqLimUp_C DCC_dtrqLimDwn_C DCC_trqReplVal_C DCC_trqShft_CUR DCC_vLim_C /end DEF_CHARACTERISTIC
 /begin IN_MEASUREMENT DCC_nSetPointRaw_mp Eng_nAvrg /end IN_MEASUREMENT
/end FUNCTION
/begin FUNCTION dcc_updatedem_msg ""
 /begin OUT_MEASUREMENT DCC_stAckEngDCC DCC_stActive DCC_stCtlVel DCC_stDCC DCC_stError DCC_stRecDCC DCC_stRls DCC_trqDes DCC_trqRaw /end OUT_MEASUREMENT
/end FUNCTION
/begin FUNCTION dcc_updatedem_uic ""
 /begin OUT_MEASUREMENT DCC_nDvthires_mp DCC_nDvt_mp DCC_nSetPointRaw_mp DCC_nSetPoint_mp DCC_nShft_mp DCC_nWheel_mp DCC_rTransDTNext_mp DCC_stBrkPressed_mp DCC_stGearNext_mp DCC_stGearOld_mp DCC_stRlsMT_mp DCC_swtPosAT_mp DCC_swtPosBrk_mp DCC_swtPosES_mp DCC_swtPosMT_mp DCC_trqDesDCCFlt_mp DCC_trqDesDCCMT_mp DCC_trqEngSpdRaw_mp DCC_trqEngSpd_mp DCC_trqIEngSpd_mp DCC_trqIInit_mp DCC_trqPEngSpd_mp DCC_trqRaw_mp DCC_trqsaveStI_mp DCC_trqShft_mp DCC_trqStI_mp DCC_vConv_mp /end OUT_MEASUREMENT
/end FUNCTION
/begin FUNCTION drvtrn "Antriebsstrang"
 /begin DEF_CHARACTERISTIC DrvTrn_drTransDTUp_C DrvTrn_drTransDTDwn_C DrvTrn_rFlatTransDT_C DrvTrn_rTransDTInit_C DrvTrn_swtCAN_C DrvTrn_swtrTransSel_C DrvTrn_tiRTransDT_C DrvTrn_vLimTransDT_C /end DEF_CHARACTERISTIC
/end FUNCTION
/begin FUNCTION drvtrn_msg "" /begin OUT_MEASUREMENT DrvTrn_rFlatTransDT DrvTrn_rTransDT /end OUT_MEASUREMENT /end FUNCTION
/begin FUNCTION drvtrn_uic "" /begin OUT_MEASUREMENT DrvTrn_rTransDTact_mp DrvTrn_rTransDTRmpIn_mp /end OUT_MEASUREMENT /end FUNCTION
/begin COMPU_METHOD Acc "Fahrzeugbeschleunigung" RAT_FUNC "%6.5" "m/s^2" COEFFS 0 1000 0 0 0 1 /end COMPU_METHOD
/begin COMPU_METHOD AngleCrS "Winkel Kurbelwelle" RAT_FUNC "%6.4" "deg CrS" COEFFS 0 42.6666666666667 0 0 0 1 /end COMPU_METHOD
/begin COMPU_METHOD B_TRUE "Umrechnung   ----> FALSE;    TRUE = TRUE" TAB_VERB "%6.3" "-" COMPU_TAB_REF B_TRUE /end COMPU_METHOD
/begin COMPU_VTAB B_TRUE "Umrechnung   ----> FALSE;    TRUE = TRUE" TAB_VERB 2 0 "FALSE" 1 "TRUE" /end COMPU_VTAB
/begin COMPU_METHOD dez "K3 Umwandlungen" RAT_FUNC "%6.2" "-" COEFFS 0 1 0 0 0 1 /end COMPU_METHOD
/begin COMPU_METHOD dTrqPrp_20ms "Anstieg Vortriebsmoment im 20 ms Raster" RAT_FUNC "%6.1" "Nm/s" COEFFS 0 0.1 0 0 0 1 /end COMPU_METHOD
/begin COMPU_METHOD dVel_20ms "Anstieg Fahrgeschwindigkeit im 20 ms Raster" RAT_FUNC "%6.3" "(km/h)/s" COEFFS 0 2 0 0 0 1 /end COMPU_METHOD
/begin COMPU_METHOD EngN "Motordrehzahl" RAT_FUNC "%6.2" "rpm" COEFFS 0 1 0 0 0 1 /end COMPU_METHOD
/begin COMPU_METHOD EngN_HiRes "Motordrehzahl, höhere Auflösung als EngM" RAT_FUNC "%6.3" "rpm" COEFFS 0 8 0 0 0 1 /end COMPU_METHOD
/begin COMPU_METHOD Fact "Faktor mit Auflösung 1 / 8192, hauptsächlich für einen Faktorenbereich 0...1 verwendet" RAT_FUNC "%6.5" "-" COEFFS 0 8192 0 0 0 1 /end COMPU_METHOD
/begin COMPU_METHOD Fact1 "Faktor mit Auflösung 0,01 (100 mal höherer Bereich als Fact)" RAT_FUNC "%6.4" "-" COEFFS 0 128 0 0 0 1 /end COMPU_METHOD
/begin COMPU_METHOD Fact2 "Faktor mit Auflösung 0.001, für einen Faktorenbereich 0...5,46117 verwendet" RAT_FUNC "%7.6" "-" COEFFS 0 16384 0 0 0 1 /end COMPU_METHOD
/begin COMPU_METHOD Fact_Inc "Faktor für Inkrement/Gap Plausibilitäts-Fenster" RAT_FUNC "%6.4" "-" COEFFS 0 256 0 0 0 1 /end COMPU_METHOD
/begin COMPU_METHOD InjMass "Einspritzmenge" RAT_FUNC "%6.4" "mg/hub" COEFFS 0 100 0 0 0 1 /end COMPU_METHOD
/begin COMPU_METHOD InjMassCyc "Einspritzmenge pro Zyklus (mg/Zyklus)" RAT_FUNC "%6.4" "mg/cyc" COEFFS 0 100 0 0 0 1 /end COMPU_METHOD
/begin COMPU_METHOD Kd_Vel2TrqPrp "Differentialverstärkung (Fahrgeschwindigkeit zu Vortriebsmoment)" RAT_FUNC "%6.5" "Nm/(km/h)" COEFFS 0 3276.8 0 0 0 1 /end COMPU_METHOD
/begin COMPU_METHOD Ki_rpm2Nm "Integralverstärkung Ki (Motordrehzahl EngN zu Motormoment Trq)" RAT_FUNC "%6.5" "Nm/(rpm*s)" COEFFS 0 5368.70912 0 0 0 1 /end COMPU_METHOD
/begin COMPU_METHOD Ki_Vel2TrqPrp "Integralverstärkung (Fahrgeschwindigkeit zu Vortriebsmoment)" RAT_FUNC "%6.4" "Nm/(km/h)/s" COEFFS 0 214.7483648 0 0 0 1 /end COMPU_METHOD
/begin COMPU_METHOD Kp_rpm2Nm "Proportionale Verstärkung Kp (Motordrehzahl EngN zu Moment Trq)" RAT_FUNC "%7.6" "Nm/rpm" COEFFS 0 81920 0 0 0 1 /end COMPU_METHOD
/begin COMPU_METHOD Kp_Vel2TrqPrp "Proportionalverstärkung (Fahrgeschwindigkeit zu Vortriebsmoment)" RAT_FUNC "%6.5" "Nm/(km/h)" COEFFS 0 3276.8 0 0 0 1 /end COMPU_METHOD
/begin COMPU_METHOD Length1 "Abstand in Meter" RAT_FUNC "%6.4" "m" COEFFS 0 128 0 0 0 1 /end COMPU_METHOD
/begin COMPU_METHOD NumPinAdc "verbale Umrechnung für ADC Signale" TAB_VERB "%6.3" "-" COMPU_TAB_REF NumPinAdc /end COMPU_METHOD
/begin COMPU_VTAB NumPinAdc "verbale Umrechnung für ADC Signale" TAB_VERB 47 0 "Water_Temperature_Sensor_182" 1 "Intake_Air_Temperature_Sensor_157" 2 "Charge_Air_Temperature_Sensor_183" 3 "Exhaust_Temperature_Sensor_2_134" 4 "Exhaust_Temperature_Sensor_1_158" 5 "1st_APP_Sensor_252" 6 "2nd_APP_Sensor_239" 7 "ADC_REF" 8 "Boost_Pressure_Sensor_154" 9 "Atmospheric_Pressure_Sensor" 10 "Battery_Voltage_Sensor" 11 "Rail_Pressure_Sensor_156" 12 "Rail_Pressure_Peak_Value_156" 13 "Booster_Voltage_Sensor" 14 "Current_MeUn_Sensor" 15 "Current_PCV_Sensor" 16 "Voltage_Bank_1" 17 "Voltage_Bank_2" 18 "Pressure_Upstream_Particle_Filter_159" 19 "Engine_Oil_Pressure_110" 20 "Temperature_ECU_PCB" 21 "Voltage_Lambda_Ua" 22 "Voltage_Lambda_Ri" 23 "EMCCD_Current_Governor1_124" 24 "EMCCD_Current_Governor2_121" 25 "ADC_DUMMY_A_NOT_USED" 26 "ADC_DUMMY_NOT_USED" 27 "Charge_Actuator_Event_0" 28 "Voltage_Piezo_Actuator_Bank_2_Event_0" 29 "Voltage_Piezo_Actuator_Bank_1_Event_0" 30 "Charge_Actuator_Event_1" 31 "Voltage_Piezo_Actuator_Bank_2_Event_1" 32 "Voltage_Piezo_Actuator_Bank_1_Event_1" 33 "Charge_Actuator_Event_2" 34 "Voltage_Piezo_Actuator_Bank_2_Event_2" 35 "Voltage_Piezo_Actuator_Bank_1_Event_2" 36 "Charge_Actuator_Event_3" 37 "Voltage_Piezo_Actuator_Bank_2_Event_3" 38 "Voltage_Piezo_Actuator_Bank_1_Event_3" 39 "Charge_Actuator_Event_4" 40 "Voltage_Piezo_Actuator_Bank_2_Event_4" 41 "Voltage_Piezo_Actuator_Bank_1_Event_4" 42 "Charge_Actuator_Event_5" 43 "Voltage_Piezo_Actuator_Bank_2_Event_5" 44 "Voltage_Piezo_Actuator_Bank_1_Event_5" 45 "Booster_Voltage_Piezo" 46 "Piezo_Voltage" /end COMPU_VTAB
/begin COMPU_METHOD OneToOne "eins zu eins (physikalischer Wert ist gleich dem internen Wert)" RAT_FUNC "%6.2" "-" COEFFS 0 1 0 0 0 1 /end COMPU_METHOD
/begin COMPU_METHOD Per_Dur "Periodendauer Segmentzeit" RAT_FUNC "%6.2" "usec" COEFFS 0 1 0 0 0 1 /end COMPU_METHOD
/begin COMPU_METHOD Prc "Prozent, gleiche interne Auflösung wie Fact, aber Darstellung in Prozent (0...100%)" RAT_FUNC "%6.4" "%" COEFFS 0 81.92 0 0 0 1 /end COMPU_METHOD
/begin COMPU_METHOD Prc_1000 "Prozentumrechnung mit größerer Quantisierung, dafür größerer Wertebereich" RAT_FUNC "%6.3" "%" COEFFS 0 8.192 0 0 0 1 /end COMPU_METHOD
/begin COMPU_METHOD Pres_hPa "Druck (angezeigt in [hPa])" RAT_FUNC "%6.2" "hPa" COEFFS 0 1 0 0 0 1 /end COMPU_METHOD
/begin COMPU_METHOD RmpTemp "Rampengradient für Temperatur" RAT_FUNC "%6.4" "deg C/s" COEFFS 0 655.36 0 0 0 1 /end COMPU_METHOD
/begin COMPU_METHOD RmpTempCels "temperature ramp gradient in Centigrade" RAT_FUNC "%8.7" "C/ms" COEFFS 0 655360 0 0 0 1 /end COMPU_METHOD
/begin COMPU_METHOD RmpTransR "Umrechnung für die Rampensteigung des Triebstrangübersetzungverhältnisses" RAT_FUNC "%6.5" "1/s" COEFFS 0 6553.6 0 0 0 1 /end COMPU_METHOD
/begin COMPU_METHOD RmpTrqPrp "Rampenanstieg für Vortriebsmoment [Nm/s]" RAT_FUNC "%6.4" "Nm/s" COEFFS 0 327.68 0 0 0 1 /end COMPU_METHOD
/begin COMPU_METHOD t20msxs_ub_b5p1 "K3 Umwandlungen" RAT_FUNC "%6.4" "s" COEFFS 0 1 0 0 0 0.02 /end COMPU_METHOD
/begin COMPU_METHOD TempCels_100ms "Temperatur Differenz in Grad C/sec (bezgl. 100ms task)" RAT_FUNC "%6.2" "deg C/s" COEFFS 0 1 0 0 0 1 /end COMPU_METHOD
/begin COMPU_METHOD Temp_Cels "Temperatur dargestellt in °C (gleiche interne Darstellung wie Temp_Kelv)" RAT_FUNC "%6.1" "deg C" COEFFS 0 10 2731.4 0 0 1 /end COMPU_METHOD
/begin COMPU_METHOD TimeDeb "Entprellzeit in Millisekunden für Libraryfunktion Debounce" RAT_FUNC "%6.1" "ms" COEFFS 0 0.1 0 0 0 1 /end COMPU_METHOD
/begin COMPU_METHOD TimeDelay_s "Zeitkonstante T1 (in s) für PT1, DT1, etc." RAT_FUNC "%9.3" "s" COEFFS 0 0 1 0 0.00023283064365387 0 /end COMPU_METHOD
/begin COMPU_METHOD TimeDT "Abtastzeit (in us) für Library Regler, Filter, etc." RAT_FUNC "%6.2" "us" COEFFS 0 1 0 0 0 1 /end COMPU_METHOD
/begin COMPU_METHOD TimeEGTRmp "Umrechnung  Zeit in Rampensteigung,  Verwendet in EGT-Bibliothek" RAT_FUNC "%6.3" "s" COEFFS 0 0 1 0 0.0152587890625 0 /end COMPU_METHOD
/begin COMPU_METHOD Time_ms "Zeit in ms für Fehlerentprellung (DSM) und SW-Timer" RAT_FUNC "%6.1" "ms" COEFFS 0 0.1 0 0 0 1 /end COMPU_METHOD
/begin COMPU_METHOD TransR "Übersetzungsverhältnis (Getriebe etc.)" RAT_FUNC "%6.4" "-" COEFFS 0 100 0 0 0 1 /end COMPU_METHOD
/begin COMPU_METHOD Trq "Motormoment" RAT_FUNC "%6.3" "Nm" COEFFS 0 10 0 0 0 1 /end COMPU_METHOD
/begin COMPU_METHOD TrqPrp "Vortriebsmoment" RAT_FUNC "%6.3" "Nm" COEFFS 0 5 0 0 0 1 /end COMPU_METHOD
/begin COMPU_METHOD Vel "Fahrzeuggeschwindigkeit, gleiche interne Auflösung wie Vel_SI" RAT_FUNC "%6.4" "km/h" COEFFS 0 100 0 0 0 1 /end COMPU_METHOD
/begin COMPU_METHOD Vel2TrqPrp "Umwandlung von Fahrgeschwindigkeit zu Vortriebsmoment" RAT_FUNC "%6.4" "Nm/(km/h)" COEFFS 0 409.6 0 0 0 1 /end COMPU_METHOD
/begin COMPU_METHOD VelToN "Verhältnis Fahrzeuggeschwindigkeit zu Motordrehzahl v/n" RAT_FUNC "%8.7" "(km/h)/rpm" COEFFS 0 100000 0 0 0 1 /end COMPU_METHOD
/begin COMPU_METHOD Vel_mph "vehicle speed in mph" RAT_FUNC "%6.4" "mph" COEFFS 0 100 0 0 0 1 /end COMPU_METHOD
/begin COMPU_METHOD Vel_mpm "Umrechnung von Kmph nach mpm" RAT_FUNC "%6.4" "m/min" COEFFS 0 100 0 0 0 1 /end COMPU_METHOD
/begin COMPU_METHOD Volt "Spannung in V (von ADC)" RAT_FUNC "%6.2" "mV" COEFFS 0 0.2046 0 0 0 1 /end COMPU_METHOD
/begin COMPU_METHOD Volt_Batt "Batteriespannung" RAT_FUNC "%6.1" "mV" COEFFS 0 0.05115 0 0 0 1 /end COMPU_METHOD
/begin COMPU_METHOD WheelN "Umrechnung fuer RPM" RAT_FUNC "%6.2" "rpm" COEFFS 0 1 0 0 0 1 /end COMPU_METHOD
/begin RECORD_LAYOUT Kf_Xs16_Ys16_Ws16 NO_AXIS_PTS_X 1 SWORD NO_AXIS_PTS_Y 2 SWORD AXIS_PTS_X 3 SWORD INDEX_INCR DIRECT AXIS_PTS_Y 4 SWORD INDEX_INCR DIRECT FNC_VALUES 5 SWORD COLUMN_DIR DIRECT /end RECORD_LAYOUT
/begin RECORD_LAYOUT Kl_Xs16_Ws16 NO_AXIS_PTS_X 1 SWORD AXIS_PTS_X 2 SWORD INDEX_INCR DIRECT FNC_VALUES 3 SWORD COLUMN_DIR DIRECT /end RECORD_LAYOUT
/begin RECORD_LAYOUT KwWU16 FNC_VALUES 1 UWORD COLUMN_DIR DIRECT /end RECORD_LAYOUT
/begin RECORD_LAYOUT KwWU8 FNC_VALUES 1 UBYTE COLUMN_DIR DIRECT /end RECORD_LAYOUT
/begin RECORD_LAYOUT Kw_Ws16 FNC_VALUES 1 SWORD COLUMN_DIR DIRECT /end RECORD_LAYOUT
/begin RECORD_LAYOUT Kw_Ws32 FNC_VALUES 1 SLONG COLUMN_DIR DIRECT /end RECORD_LAYOUT
/begin RECORD_LAYOUT Kw_Ws8 FNC_VALUES 1 SBYTE COLUMN_DIR DIRECT /end RECORD_LAYOUT
/begin RECORD_LAYOUT Kw_Wu16 FNC_VALUES 1 UWORD COLUMN_DIR DIRECT /end RECORD_LAYOUT
/begin RECORD_LAYOUT Kw_Wu32 FNC_VALUES 1 ULONG COLUMN_DIR DIRECT /end RECORD_LAYOUT
/begin RECORD_LAYOUT Kw_Wu8 FNC_VALUES 1 UBYTE COLUMN_DIR DIRECT /end RECORD_LAYOUT
/end MODULE
/end PROJECT
