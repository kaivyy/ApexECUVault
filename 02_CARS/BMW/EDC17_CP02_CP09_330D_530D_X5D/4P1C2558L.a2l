ASAP2_VERSION 1 4
/begin PROJECT P_558 "EDC17_CP02"
/begin HEADER "" VERSION "V1C1" PROJECT_NO P_558 /end HEADER
/begin MODULE DIM ""
/begin MOD_COMMON "" BYTE_ORDER MSB_LAST ALIGNMENT_BYTE 1 ALIGNMENT_WORD 2 ALIGNMENT_LONG 4 ALIGNMENT_FLOAT32_IEEE 4 /end MOD_COMMON
/begin CHARACTERISTIC DFES_Cls.DFC_AirCtlGovDvtEOMMax_C "/" VALUE 0x80073A92 Val_Wu8 255.0 DFES_OneToOne 0.00 255.0 FORMAT "%5.1" /end CHARACTERISTIC
/begin CHARACTERISTIC DFES_Cls.DFC_AirCtlGovDvtEOMMin_C "/" VALUE 0x80073A93 Val_Wu8 255.0 DFES_OneToOne 0.00 255.0 FORMAT "%5.1" /end CHARACTERISTIC
/begin CHARACTERISTIC DFES_Cls.DFC_AirCtlGovDvtMax_C "/" VALUE 0x80073A94 Val_Wu8 255.0 DFES_OneToOne 0.00 255.0 FORMAT "%5.1" /end CHARACTERISTIC
/begin CHARACTERISTIC DFES_Cls.DFC_AirCtlGovDvtMin_C "/" VALUE 0x80073A95 Val_Wu8 255.0 DFES_OneToOne 0.00 255.0 FORMAT "%5.1" /end CHARACTERISTIC
/begin CHARACTERISTIC DFES_Cls.DFC_Cj945SpiCom1_C "/" VALUE 0x80073A96 Val_Wu8 255.0 DFES_OneToOne 0.00 255.0 FORMAT "%5.1" /end CHARACTERISTIC
/begin CHARACTERISTIC DFES_Cls.DFC_ComButtonMSASig_C "/" VALUE 0x80073A97 Val_Wu8 255.0 DFES_OneToOne 0.00 255.0 FORMAT "%5.1" /end CHARACTERISTIC
/begin CHARACTERISTIC DFES_Cls.DFC_ComButtonMSATo_C "/" VALUE 0x80073A98 Val_Wu8 255.0 DFES_OneToOne 0.00 255.0 FORMAT "%5.1" /end CHARACTERISTIC
/begin CHARACTERISTIC DFES_Cls.DFC_ComGearboxData2Sig_C "/" VALUE 0x80073A99 Val_Wu8 255.0 DFES_OneToOne 0.00 255.0 FORMAT "%5.1" /end CHARACTERISTIC
/begin CHARACTERISTIC DFES_Cls.DFC_ComGearboxData2To_C "/" VALUE 0x80073A9A Val_Wu8 255.0 DFES_OneToOne 0.00 255.0 FORMAT "%5.1" /end CHARACTERISTIC
/begin CHARACTERISTIC DFES_Cls.DFC_ComGearboxDataSig_C "/" VALUE 0x80073A9B Val_Wu8 255.0 DFES_OneToOne 0.00 255.0 FORMAT "%5.1" /end CHARACTERISTIC
/begin CHARACTERISTIC DFES_Cls.DFC_ComGearboxDataTo_C "/" VALUE 0x80073A9C Val_Wu8 255.0 DFES_OneToOne 0.00 255.0 FORMAT "%5.1" /end CHARACTERISTIC
/begin CHARACTERISTIC DFES_Cls.DFC_ComHeatACSig_C "/" VALUE 0x80073A9D Val_Wu8 255.0 DFES_OneToOne 0.00 255.0 FORMAT "%5.1" /end CHARACTERISTIC
/begin CHARACTERISTIC DFES_Cls.DFC_ComHeatACTo_C "/" VALUE 0x80073A9E Val_Wu8 255.0 DFES_OneToOne 0.00 255.0 FORMAT "%5.1" /end CHARACTERISTIC
/begin CHARACTERISTIC DFES_Cls.DFC_ComLenkradwinkelSig_C "/" VALUE 0x80073A9F Val_Wu8 255.0 DFES_OneToOne 0.00 255.0 FORMAT "%5.1" /end CHARACTERISTIC
/begin CHARACTERISTIC DFES_Cls.DFC_ComLenkradwinkelTo_C "/" VALUE 0x80073AA0 Val_Wu8 255.0 DFES_OneToOne 0.00 255.0 FORMAT "%5.1" /end CHARACTERISTIC
/begin CHARACTERISTIC DFES_Cls.DFC_ComMileageRangeSig_C "/" VALUE 0x80073AA1 Val_Wu8 255.0 DFES_OneToOne 0.00 255.0 FORMAT "%5.1" /end CHARACTERISTIC
/begin CHARACTERISTIC DFES_Cls.DFC_ComMileageRangeTo_C "/" VALUE 0x80073AA2 Val_Wu8 255.0 DFES_OneToOne 0.00 255.0 FORMAT "%5.1" /end CHARACTERISTIC
/begin CHARACTERISTIC DFES_Cls.DFC_ComPspSig_C "/" VALUE 0x80073AA3 Val_Wu8 255.0 DFES_OneToOne 0.00 255.0 FORMAT "%5.1" /end CHARACTERISTIC
/begin CHARACTERISTIC DFES_Cls.DFC_ComPspTo_C "/" VALUE 0x80073AA4 Val_Wu8 255.0 DFES_OneToOne 0.00 255.0 FORMAT "%5.1" /end CHARACTERISTIC
/begin CHARACTERISTIC DFES_Cls.DFC_ComShutOffPSPSig_C "/" VALUE 0x80073AA5 Val_Wu8 255.0 DFES_OneToOne 0.00 255.0 FORMAT "%5.1" /end CHARACTERISTIC
/begin CHARACTERISTIC DFES_Cls.DFC_ComShutOffPSPTo_C "/" VALUE 0x80073AA6 Val_Wu8 255.0 DFES_OneToOne 0.00 255.0 FORMAT "%5.1" /end CHARACTERISTIC
/begin CHARACTERISTIC DFES_Cls.DFC_ComStKombiCtr_C "/" VALUE 0x80073AA7 Val_Wu8 255.0 DFES_OneToOne 0.00 255.0 FORMAT "%5.1" /end CHARACTERISTIC
/begin CHARACTERISTIC DFES_Cls.DFC_ComStKombiSig_C "/" VALUE 0x80073AA8 Val_Wu8 255.0 DFES_OneToOne 0.00 255.0 FORMAT "%5.1" /end CHARACTERISTIC
/begin CHARACTERISTIC DFES_Cls.DFC_ComStKombiTo_C "/" VALUE 0x80073AA9 Val_Wu8 255.0 DFES_OneToOne 0.00 255.0 FORMAT "%5.1" /end CHARACTERISTIC
/begin CHARACTERISTIC DFES_Cls.DFC_ComStateARSCtr_C "/" VALUE 0x80073AAA Val_Wu8 255.0 DFES_OneToOne 0.00 255.0 FORMAT "%5.1" /end CHARACTERISTIC
/begin CHARACTERISTIC DFES_Cls.DFC_ComStateARSSig_C "/" VALUE 0x80073AAB Val_Wu8 255.0 DFES_OneToOne 0.00 255.0 FORMAT "%5.1" /end CHARACTERISTIC
/begin CHARACTERISTIC DFES_Cls.DFC_ComStateARSTo_C "/" VALUE 0x80073AAC Val_Wu8 255.0 DFES_OneToOne 0.00 255.0 FORMAT "%5.1" /end CHARACTERISTIC
/begin CHARACTERISTIC DFES_Cls.DFC_ComStateDscSig_C "/" VALUE 0x80073AAD Val_Wu8 255.0 DFES_OneToOne 0.00 255.0 FORMAT "%5.1" /end CHARACTERISTIC
/begin CHARACTERISTIC DFES_Cls.DFC_ComStateDscTo_C "/" VALUE 0x80073AAE Val_Wu8 255.0 DFES_OneToOne 0.00 255.0 FORMAT "%5.1" /end CHARACTERISTIC
/begin CHARACTERISTIC DFES_Cls.DFC_ComStateSeatSig_C "/" VALUE 0x80073AAF Val_Wu8 255.0 DFES_OneToOne 0.00 255.0 FORMAT "%5.1" /end CHARACTERISTIC
/begin CHARACTERISTIC DFES_Cls.DFC_ComStateSeatTo_C "/" VALUE 0x80073AB0 Val_Wu8 255.0 DFES_OneToOne 0.00 255.0 FORMAT "%5.1" /end CHARACTERISTIC
/begin CHARACTERISTIC DFES_Cls.DFC_ComTempRelTimeSig_C "/" VALUE 0x80073AB1 Val_Wu8 255.0 DFES_OneToOne 0.00 255.0 FORMAT "%5.1" /end CHARACTERISTIC
/begin CHARACTERISTIC DFES_Cls.DFC_ComTempRelTimeTo_C "/" VALUE 0x80073AB2 Val_Wu8 255.0 DFES_OneToOne 0.00 255.0 FORMAT "%5.1" /end CHARACTERISTIC
/begin CHARACTERISTIC DFES_Cls.DFC_ComTerminalChk_C "/" VALUE 0x80073AB3 Val_Wu8 255.0 DFES_OneToOne 0.00 255.0 FORMAT "%5.1" /end CHARACTERISTIC
/begin CHARACTERISTIC DFES_Cls.DFC_ComTerminalCtr_C "/" VALUE 0x80073AB4 Val_Wu8 255.0 DFES_OneToOne 0.00 255.0 FORMAT "%5.1" /end CHARACTERISTIC
/begin CHARACTERISTIC DFES_Cls.DFC_ComTerminalSig_C "/" VALUE 0x80073AB5 Val_Wu8 255.0 DFES_OneToOne 0.00 255.0 FORMAT "%5.1" /end CHARACTERISTIC
/begin CHARACTERISTIC DFES_Cls.DFC_ComTerminalTo_C "/" VALUE 0x80073AB6 Val_Wu8 255.0 DFES_OneToOne 0.00 255.0 FORMAT "%5.1" /end CHARACTERISTIC
/begin CHARACTERISTIC DFES_Cls.DFC_ComTimeDateSig_C "/" VALUE 0x80073AB7 Val_Wu8 255.0 DFES_OneToOne 0.00 255.0 FORMAT "%5.1" /end CHARACTERISTIC
/begin CHARACTERISTIC DFES_Cls.DFC_ComTimeDateTo_C "/" VALUE 0x80073AB8 Val_Wu8 255.0 DFES_OneToOne 0.00 255.0 FORMAT "%5.1" /end CHARACTERISTIC
/begin CHARACTERISTIC DFES_Cls.DFC_ComTrailerSig_C "/" VALUE 0x80073AB9 Val_Wu8 255.0 DFES_OneToOne 0.00 255.0 FORMAT "%5.1" /end CHARACTERISTIC
/begin CHARACTERISTIC DFES_Cls.DFC_ComTrailerTo_C "/" VALUE 0x80073ABA Val_Wu8 255.0 DFES_OneToOne 0.00 255.0 FORMAT "%5.1" /end CHARACTERISTIC
/begin CHARACTERISTIC DFES_Cls.DFC_ComTrqDemandAfsChk_C "/" VALUE 0x80073ABB Val_Wu8 255.0 DFES_OneToOne 0.00 255.0 FORMAT "%5.1" /end CHARACTERISTIC
/begin CHARACTERISTIC DFES_Cls.DFC_ComTrqDemandAfsCtr_C "/" VALUE 0x80073ABC Val_Wu8 255.0 DFES_OneToOne 0.00 255.0 FORMAT "%5.1" /end CHARACTERISTIC
/begin CHARACTERISTIC DFES_Cls.DFC_ComTrqDemandAfsSig_C "/" VALUE 0x80073ABD Val_Wu8 255.0 DFES_OneToOne 0.00 255.0 FORMAT "%5.1" /end CHARACTERISTIC
/begin CHARACTERISTIC DFES_Cls.DFC_ComTrqDemandAfsTo_C "/" VALUE 0x80073ABE Val_Wu8 255.0 DFES_OneToOne 0.00 255.0 FORMAT "%5.1" /end CHARACTERISTIC
/begin CHARACTERISTIC DFES_Cls.DFC_ComTrqDemandDscChk_C "/" VALUE 0x80073ABF Val_Wu8 255.0 DFES_OneToOne 0.00 255.0 FORMAT "%5.1" /end CHARACTERISTIC
/begin CHARACTERISTIC DFES_Cls.DFC_ComTrqDemandDscCtr_C "/" VALUE 0x80073AC0 Val_Wu8 255.0 DFES_OneToOne 0.00 255.0 FORMAT "%5.1" /end CHARACTERISTIC
/begin CHARACTERISTIC DFES_Cls.DFC_ComTrqDemandDscSig_C "/" VALUE 0x80073AC1 Val_Wu8 255.0 DFES_OneToOne 0.00 255.0 FORMAT "%5.1" /end CHARACTERISTIC
/begin CHARACTERISTIC DFES_Cls.DFC_ComTrqDemandDscTo_C "/" VALUE 0x80073AC2 Val_Wu8 255.0 DFES_OneToOne 0.00 255.0 FORMAT "%5.1" /end CHARACTERISTIC
/begin CHARACTERISTIC DFES_Cls.DFC_ComTrqDemandGbxChk_C "/" VALUE 0x80073AC3 Val_Wu8 255.0 DFES_OneToOne 0.00 255.0 FORMAT "%5.1" /end CHARACTERISTIC
/begin CHARACTERISTIC DFES_Cls.DFC_ComTrqDemandGbxCtr_C "/" VALUE 0x80073AC4 Val_Wu8 255.0 DFES_OneToOne 0.00 255.0 FORMAT "%5.1" /end CHARACTERISTIC
/begin CHARACTERISTIC DFES_Cls.DFC_ComTrqDemandGbxSig_C "/" VALUE 0x80073AC5 Val_Wu8 255.0 DFES_OneToOne 0.00 255.0 FORMAT "%5.1" /end CHARACTERISTIC
/begin CHARACTERISTIC DFES_Cls.DFC_ComTrqDemandGbxTo_C "/" VALUE 0x80073AC6 Val_Wu8 255.0 DFES_OneToOne 0.00 255.0 FORMAT "%5.1" /end CHARACTERISTIC
/begin CHARACTERISTIC DFES_Cls.DFC_ComVelocitySig_C "/" VALUE 0x80073AC7 Val_Wu8 255.0 DFES_OneToOne 0.00 255.0 FORMAT "%5.1" /end CHARACTERISTIC
/begin CHARACTERISTIC DFES_Cls.DFC_ComVelocityTo_C "/" VALUE 0x80073AC8 Val_Wu8 255.0 DFES_OneToOne 0.00 255.0 FORMAT "%5.1" /end CHARACTERISTIC
/begin CHARACTERISTIC DFES_Cls.DFC_ComWheelSpeedSig_C "/" VALUE 0x80073AC9 Val_Wu8 255.0 DFES_OneToOne 0.00 255.0 FORMAT "%5.1" /end CHARACTERISTIC
/begin CHARACTERISTIC DFES_Cls.DFC_ComWheelSpeedTo_C "/" VALUE 0x80073ACA Val_Wu8 255.0 DFES_OneToOne 0.00 255.0 FORMAT "%5.1" /end CHARACTERISTIC
/begin CHARACTERISTIC DFES_Cls.DFC_ComZvKlappenSig_C "/" VALUE 0x80073ACB Val_Wu8 255.0 DFES_OneToOne 0.00 255.0 FORMAT "%5.1" /end CHARACTERISTIC
/begin CHARACTERISTIC DFES_Cls.DFC_ComZvKlappenTo_C "/" VALUE 0x80073ACC Val_Wu8 255.0 DFES_OneToOne 0.00 255.0 FORMAT "%5.1" /end CHARACTERISTIC
/begin CHARACTERISTIC DFES_Cls.DFC_Cy150SpiCom_C "/" VALUE 0x80073ACD Val_Wu8 255.0 DFES_OneToOne 0.00 255.0 FORMAT "%5.1" /end CHARACTERISTIC
/begin CHARACTERISTIC DFES_Cls.DFC_Cy320SpiCom_C "/" VALUE 0x80073ACE Val_Wu8 255.0 DFES_OneToOne 0.00 255.0 FORMAT "%5.1" /end CHARACTERISTIC
/begin CHARACTERISTIC DFES_Cls.DFC_ETCtlDvtInrMax_C "/" VALUE 0x80073ACF Val_Wu8 255.0 DFES_OneToOne 0.00 255.0 FORMAT "%5.1" /end CHARACTERISTIC
/begin CHARACTERISTIC DFES_Cls.DFC_ETCtlDvtInrMin_C "/" VALUE 0x80073AD0 Val_Wu8 255.0 DFES_OneToOne 0.00 255.0 FORMAT "%5.1" /end CHARACTERISTIC
/begin CHARACTERISTIC DFES_Cls.DFC_ETCtlDvtOutrMax_C "/" VALUE 0x80073AD1 Val_Wu8 255.0 DFES_OneToOne 0.00 255.0 FORMAT "%5.1" /end CHARACTERISTIC
/begin CHARACTERISTIC DFES_Cls.DFC_ETCtlDvtOutrMin_C "/" VALUE 0x80073AD2 Val_Wu8 255.0 DFES_OneToOne 0.00 255.0 FORMAT "%5.1" /end CHARACTERISTIC
/begin CHARACTERISTIC DFES_Cls.DFC_Fan4WinErr1_C "/" VALUE 0x80073AD3 Val_Wu8 255.0 DFES_OneToOne 0.00 255.0 FORMAT "%5.1" /end CHARACTERISTIC
/begin CHARACTERISTIC DFES_Cls.DFC_Fan4WinErr2_C "/" VALUE 0x80073AD4 Val_Wu8 255.0 DFES_OneToOne 0.00 255.0 FORMAT "%5.1" /end CHARACTERISTIC
/begin CHARACTERISTIC DFES_Cls.DFC_Fan4WinErr3_C "/" VALUE 0x80073AD5 Val_Wu8 255.0 DFES_OneToOne 0.00 255.0 FORMAT "%5.1" /end CHARACTERISTIC
/begin CHARACTERISTIC DFES_Cls.DFC_Fan4WinErr4_C "/" VALUE 0x80073AD6 Val_Wu8 255.0 DFES_OneToOne 0.00 255.0 FORMAT "%5.1" /end CHARACTERISTIC
/begin CHARACTERISTIC DFES_Cls.DFC_FanSCG_C "/" VALUE 0x80073AD7 Val_Wu8 255.0 DFES_OneToOne 0.00 255.0 FORMAT "%5.1" /end CHARACTERISTIC
/begin CHARACTERISTIC DFES_Cls.DFC_PCRGovDvtLPMax_C "/" VALUE 0x80073AD8 Val_Wu8 255.0 DFES_OneToOne 0.00 255.0 FORMAT "%5.1" /end CHARACTERISTIC
/begin CHARACTERISTIC DFES_Cls.DFC_PCRGovDvtLPMin_C "/" VALUE 0x80073AD9 Val_Wu8 255.0 DFES_OneToOne 0.00 255.0 FORMAT "%5.1" /end CHARACTERISTIC
/begin CHARACTERISTIC DFES_Cls.DFC_PCRGovDvtMax_C "/" VALUE 0x80073ADA Val_Wu8 255.0 DFES_OneToOne 0.00 255.0 FORMAT "%5.1" /end CHARACTERISTIC
/begin CHARACTERISTIC DFES_Cls.DFC_PCRGovDvtMin_C "/" VALUE 0x80073ADB Val_Wu8 255.0 DFES_OneToOne 0.00 255.0 FORMAT "%5.1" /end CHARACTERISTIC
/begin CHARACTERISTIC DFES_Cls.DFC_RailCPC1_C "/" VALUE 0x80073ADC Val_Wu8 255.0 DFES_OneToOne 0.00 255.0 FORMAT "%5.1" /end CHARACTERISTIC
/begin CHARACTERISTIC DFES_Cls.DFC_RailCPC3_C "/" VALUE 0x80073ADD Val_Wu8 255.0 DFES_OneToOne 0.00 255.0 FORMAT "%5.1" /end CHARACTERISTIC
/begin CHARACTERISTIC DFES_Cls.DFC_RailCPC4_C "/" VALUE 0x80073ADE Val_Wu8 255.0 DFES_OneToOne 0.00 255.0 FORMAT "%5.1" /end CHARACTERISTIC
/begin CHARACTERISTIC DFES_Cls.DFC_RailMeUn0_C "/" VALUE 0x80073ADF Val_Wu8 255.0 DFES_OneToOne 0.00 255.0 FORMAT "%5.1" /end CHARACTERISTIC
/begin CHARACTERISTIC DFES_Cls.DFC_RailMeUn1_C "/" VALUE 0x80073AE0 Val_Wu8 255.0 DFES_OneToOne 0.00 255.0 FORMAT "%5.1" /end CHARACTERISTIC
/begin CHARACTERISTIC DFES_Cls.DFC_RailMeUn2_C "/" VALUE 0x80073AE1 Val_Wu8 255.0 DFES_OneToOne 0.00 255.0 FORMAT "%5.1" /end CHARACTERISTIC
/begin CHARACTERISTIC DFES_Cls.DFC_RailMeUn3_C "/" VALUE 0x80073AE2 Val_Wu8 255.0 DFES_OneToOne 0.00 255.0 FORMAT "%5.1" /end CHARACTERISTIC
/begin CHARACTERISTIC DFES_Cls.DFC_RailMeUn4_C "/" VALUE 0x80073AE3 Val_Wu8 255.0 DFES_OneToOne 0.00 255.0 FORMAT "%5.1" /end CHARACTERISTIC
/begin CHARACTERISTIC DFES_Cls.DFC_RailPCV0_C "/" VALUE 0x80073AE4 Val_Wu8 255.0 DFES_OneToOne 0.00 255.0 FORMAT "%5.1" /end CHARACTERISTIC
/begin CHARACTERISTIC DFES_Cls.DFC_RailPCV1_C "/" VALUE 0x80073AE5 Val_Wu8 255.0 DFES_OneToOne 0.00 255.0 FORMAT "%5.1" /end CHARACTERISTIC
/begin CHARACTERISTIC DFES_Cls.DFC_RailPCV2_C "/" VALUE 0x80073AE6 Val_Wu8 255.0 DFES_OneToOne 0.00 255.0 FORMAT "%5.1" /end CHARACTERISTIC
/begin CHARACTERISTIC DFES_Cls.DFC_RailPCV3_C "/" VALUE 0x80073AE7 Val_Wu8 255.0 DFES_OneToOne 0.00 255.0 FORMAT "%5.1" /end CHARACTERISTIC
/begin CHARACTERISTIC DFES_Cls.DFC_RailPCV4_C "/" VALUE 0x80073AE8 Val_Wu8 255.0 DFES_OneToOne 0.00 255.0 FORMAT "%5.1" /end CHARACTERISTIC
/begin CHARACTERISTIC DFES_Cls.DFC_RailPMonStrt_C "/" VALUE 0x80073AE9 Val_Wu8 255.0 DFES_OneToOne 0.00 255.0 FORMAT "%5.1" /end CHARACTERISTIC
/begin CHARACTERISTIC DFES_Cls.DFC_SSpMon1_C "/" VALUE 0x80073AEA Val_Wu8 255.0 DFES_OneToOne 0.00 255.0 FORMAT "%5.1" /end CHARACTERISTIC
/begin CHARACTERISTIC DFES_Cls.DFC_SSpMon2_C "/" VALUE 0x80073AEB Val_Wu8 255.0 DFES_OneToOne 0.00 255.0 FORMAT "%5.1" /end CHARACTERISTIC
/begin CHARACTERISTIC DFES_Cls.DFC_SSpMon3_C "/" VALUE 0x80073AEC Val_Wu8 255.0 DFES_OneToOne 0.00 255.0 FORMAT "%5.1" /end CHARACTERISTIC
/begin CHARACTERISTIC DFES_Cls.DFC_Sia_E1_C "/" VALUE 0x80073AED Val_Wu8 255.0 DFES_OneToOne 0.00 255.0 FORMAT "%5.1" /end CHARACTERISTIC
/begin CHARACTERISTIC DFES_Cls.DFC_Sia_E10_C "/" VALUE 0x80073AEE Val_Wu8 255.0 DFES_OneToOne 0.00 255.0 FORMAT "%5.1" /end CHARACTERISTIC
/begin CHARACTERISTIC DFES_Cls.DFC_Sia_E11_C "/" VALUE 0x80073AEF Val_Wu8 255.0 DFES_OneToOne 0.00 255.0 FORMAT "%5.1" /end CHARACTERISTIC
/begin CHARACTERISTIC DFES_Cls.DFC_Sia_E12_C "/" VALUE 0x80073AF0 Val_Wu8 255.0 DFES_OneToOne 0.00 255.0 FORMAT "%5.1" /end CHARACTERISTIC
/begin CHARACTERISTIC DFES_Cls.DFC_Sia_E13_C "/" VALUE 0x80073AF1 Val_Wu8 255.0 DFES_OneToOne 0.00 255.0 FORMAT "%5.1" /end CHARACTERISTIC
/begin CHARACTERISTIC DFES_Cls.DFC_Sia_E14_C "/" VALUE 0x80073AF2 Val_Wu8 255.0 DFES_OneToOne 0.00 255.0 FORMAT "%5.1" /end CHARACTERISTIC
/begin CHARACTERISTIC DFES_Cls.DFC_Sia_E15_C "/" VALUE 0x80073AF3 Val_Wu8 255.0 DFES_OneToOne 0.00 255.0 FORMAT "%5.1" /end CHARACTERISTIC
/begin CHARACTERISTIC DFES_Cls.DFC_Sia_E2_C "/" VALUE 0x80073AF4 Val_Wu8 255.0 DFES_OneToOne 0.00 255.0 FORMAT "%5.1" /end CHARACTERISTIC
/begin CHARACTERISTIC DFES_Cls.DFC_Sia_E3_C "/" VALUE 0x80073AF5 Val_Wu8 255.0 DFES_OneToOne 0.00 255.0 FORMAT "%5.1" /end CHARACTERISTIC
/begin CHARACTERISTIC DFES_Cls.DFC_Sia_E4_C "/" VALUE 0x80073AF6 Val_Wu8 255.0 DFES_OneToOne 0.00 255.0 FORMAT "%5.1" /end CHARACTERISTIC
/begin CHARACTERISTIC DFES_Cls.DFC_Sia_E5_C "/" VALUE 0x80073AF7 Val_Wu8 255.0 DFES_OneToOne 0.00 255.0 FORMAT "%5.1" /end CHARACTERISTIC
/begin CHARACTERISTIC DFES_Cls.DFC_Sia_E6_C "/" VALUE 0x80073AF8 Val_Wu8 255.0 DFES_OneToOne 0.00 255.0 FORMAT "%5.1" /end CHARACTERISTIC
/begin CHARACTERISTIC DFES_Cls.DFC_Sia_E7_C "/" VALUE 0x80073AF9 Val_Wu8 255.0 DFES_OneToOne 0.00 255.0 FORMAT "%5.1" /end CHARACTERISTIC
/begin CHARACTERISTIC DFES_Cls.DFC_Sia_E8_C "/" VALUE 0x80073AFA Val_Wu8 255.0 DFES_OneToOne 0.00 255.0 FORMAT "%5.1" /end CHARACTERISTIC
/begin CHARACTERISTIC DFES_Cls.DFC_Sia_E9_C "/" VALUE 0x80073AFB Val_Wu8 255.0 DFES_OneToOne 0.00 255.0 FORMAT "%5.1" /end CHARACTERISTIC
/begin CHARACTERISTIC DFES_Cls.DFC_ThrVlv4WinErr1_C "/" VALUE 0x80073AFC Val_Wu8 255.0 DFES_OneToOne 0.00 255.0 FORMAT "%5.1" /end CHARACTERISTIC
/begin CHARACTERISTIC DFES_Cls.DFC_ThrVlv4WinErr2_C "/" VALUE 0x80073AFD Val_Wu8 255.0 DFES_OneToOne 0.00 255.0 FORMAT "%5.1" /end CHARACTERISTIC
/begin CHARACTERISTIC DFES_Cls.DFC_ThrVlv4WinErr3_C "/" VALUE 0x80073AFE Val_Wu8 255.0 DFES_OneToOne 0.00 255.0 FORMAT "%5.1" /end CHARACTERISTIC
/begin CHARACTERISTIC DFES_Cls.DFC_ThrVlv4WinErr4_C "/" VALUE 0x80073AFF Val_Wu8 255.0 DFES_OneToOne 0.00 255.0 FORMAT "%5.1" /end CHARACTERISTIC
/begin CHARACTERISTIC DFES_Cls.DFC_ThrVlvSCG_C "/" VALUE 0x80073B00 Val_Wu8 255.0 DFES_OneToOne 0.00 255.0 FORMAT "%5.1" /end CHARACTERISTIC
/begin CHARACTERISTIC DFES_Cls.DFC_TrbCh4WinErr1_C "/" VALUE 0x80073B01 Val_Wu8 255.0 DFES_OneToOne 0.00 255.0 FORMAT "%5.1" /end CHARACTERISTIC
/begin CHARACTERISTIC DFES_Cls.DFC_TrbCh4WinErr2_C "/" VALUE 0x80073B02 Val_Wu8 255.0 DFES_OneToOne 0.00 255.0 FORMAT "%5.1" /end CHARACTERISTIC
/begin CHARACTERISTIC DFES_Cls.DFC_TrbCh4WinErr3_C "/" VALUE 0x80073B03 Val_Wu8 255.0 DFES_OneToOne 0.00 255.0 FORMAT "%5.1" /end CHARACTERISTIC
/begin CHARACTERISTIC DFES_Cls.DFC_TrbCh4WinErr4_C "/" VALUE 0x80073B04 Val_Wu8 255.0 DFES_OneToOne 0.00 255.0 FORMAT "%5.1" /end CHARACTERISTIC
/begin CHARACTERISTIC DFES_Cls.DFC_TrbChSCG_C "/" VALUE 0x80073B05 Val_Wu8 255.0 DFES_OneToOne 0.00 255.0 FORMAT "%5.1" /end CHARACTERISTIC
/begin CHARACTERISTIC DFES_Cls.DFC_TrbChSRCMax_C "/" VALUE 0x80073B06 Val_Wu8 255.0 DFES_OneToOne 0.00 255.0 FORMAT "%5.1" /end CHARACTERISTIC
/begin CHARACTERISTIC DFES_Cls.DFC_TrbChSRCMin_C "/" VALUE 0x80073B07 Val_Wu8 255.0 DFES_OneToOne 0.00 255.0 FORMAT "%5.1" /end CHARACTERISTIC
/begin CHARACTERISTIC DFES_Cls.DFC_WaHtEl4WinErr1_C "/" VALUE 0x80073B08 Val_Wu8 255.0 DFES_OneToOne 0.00 255.0 FORMAT "%5.1" /end CHARACTERISTIC
/begin CHARACTERISTIC DFES_Cls.DFC_WaHtEl4WinErr2_C "/" VALUE 0x80073B09 Val_Wu8 255.0 DFES_OneToOne 0.00 255.0 FORMAT "%5.1" /end CHARACTERISTIC
/begin CHARACTERISTIC DFES_Cls.DFC_WaHtEl4WinErr3_C "/" VALUE 0x80073B0A Val_Wu8 255.0 DFES_OneToOne 0.00 255.0 FORMAT "%5.1" /end CHARACTERISTIC
/begin CHARACTERISTIC DFES_Cls.DFC_WaHtEl4WinErr4_C "/" VALUE 0x80073B0B Val_Wu8 255.0 DFES_OneToOne 0.00 255.0 FORMAT "%5.1" /end CHARACTERISTIC
/begin CHARACTERISTIC DFES_Cls.DFC_WaHtElSCG_C "/" VALUE 0x80073B0C Val_Wu8 255.0 DFES_OneToOne 0.00 255.0 FORMAT "%5.1" /end CHARACTERISTIC
/begin CHARACTERISTIC DFES_Cls.DFC_ETClbETFltMax_C "/" VALUE 0x80073B0D Val_Wu8 255.0 DFES_OneToOne 0.00 255.0 FORMAT "%5.1" /end CHARACTERISTIC
/begin CHARACTERISTIC DFES_Cls.DFC_ETClbETFltMin_C "/" VALUE 0x80073B0E Val_Wu8 255.0 DFES_OneToOne 0.00 255.0 FORMAT "%5.1" /end CHARACTERISTIC
/begin CHARACTERISTIC DFES_Cls.DFC_InjCrvInjLimChrgBal_C "/" VALUE 0x80073B0F Val_Wu8 255.0 DFES_OneToOne 0.00 255.0 FORMAT "%5.1" /end CHARACTERISTIC
/begin CHARACTERISTIC DFES_Cls.DFC_InjCrvInjLimQntBal_C "/" VALUE 0x80073B10 Val_Wu8 255.0 DFES_OneToOne 0.00 255.0 FORMAT "%5.1" /end CHARACTERISTIC
/begin CHARACTERISTIC DFES_Cls.DFC_InjCrvInjLimSys_C "/" VALUE 0x80073B11 Val_Wu8 255.0 DFES_OneToOne 0.00 255.0 FORMAT "%5.1" /end CHARACTERISTIC
/begin CHARACTERISTIC DFES_Cls.DFC_InjCrvNumInjRtmLim_C "/" VALUE 0x80073B12 Val_Wu8 255.0 DFES_OneToOne 0.00 255.0 FORMAT "%5.1" /end CHARACTERISTIC
/begin CHARACTERISTIC DFES_Cls.DFC_LSUHtCoupSig_0_C "/" VALUE 0x80073B13 Val_Wu8 255.0 DFES_OneToOne 0.00 255.0 FORMAT "%5.1" /end CHARACTERISTIC
/begin CHARACTERISTIC DFES_Cls.DFC_LSUHtCoupSig_1_C "/" VALUE 0x80073B14 Val_Wu8 255.0 DFES_OneToOne 0.00 255.0 FORMAT "%5.1" /end CHARACTERISTIC
/begin CHARACTERISTIC DFES_Cls.DFC_LSUHtCoupSig_2_C "/" VALUE 0x80073B15 Val_Wu8 255.0 DFES_OneToOne 0.00 255.0 FORMAT "%5.1" /end CHARACTERISTIC
/begin CHARACTERISTIC DFES_Cls.DFC_LSUHtCoupSig_3_C "/" VALUE 0x80073B16 Val_Wu8 255.0 DFES_OneToOne 0.00 255.0 FORMAT "%5.1" /end CHARACTERISTIC
/begin CHARACTERISTIC DFES_Cls.DFC_CtT_C "/" VALUE 0x80073B17 Val_Wu8 255.0 DFES_OneToOne 0.00 255.0 FORMAT "%5.1" /end CHARACTERISTIC
/begin CHARACTERISTIC DFES_Cls.DFC_DSMDummy_C "/" VALUE 0x80073B18 Val_Wu8 255.0 DFES_OneToOne 0.00 255.0 FORMAT "%5.1" /end CHARACTERISTIC
/begin CHARACTERISTIC DFES_Cls.DFC_MeUnOL_C "/" VALUE 0x80073B19 Val_Wu8 255.0 DFES_OneToOne 0.00 255.0 FORMAT "%5.1" /end CHARACTERISTIC
/begin CHARACTERISTIC DFES_Cls.DFC_MeUnSCB_C "/" VALUE 0x80073B1A Val_Wu8 255.0 DFES_OneToOne 0.00 255.0 FORMAT "%5.1" /end CHARACTERISTIC
/begin CHARACTERISTIC DFES_Cls.DFC_MeUnSRCMax_C "/" VALUE 0x80073B1B Val_Wu8 255.0 DFES_OneToOne 0.00 255.0 FORMAT "%5.1" /end CHARACTERISTIC
/begin CHARACTERISTIC DFES_Cls.DFC_MeUnSRCMin_C "/" VALUE 0x80073B1C Val_Wu8 255.0 DFES_OneToOne 0.00 255.0 FORMAT "%5.1" /end CHARACTERISTIC
/begin CHARACTERISTIC DFES_Cls.DFC_PCVOL_C "/" VALUE 0x80073B1D Val_Wu8 255.0 DFES_OneToOne 0.00 255.0 FORMAT "%5.1" /end CHARACTERISTIC
/begin CHARACTERISTIC DFES_Cls.DFC_PCVSCB_C "/" VALUE 0x80073B1E Val_Wu8 255.0 DFES_OneToOne 0.00 255.0 FORMAT "%5.1" /end CHARACTERISTIC
/begin CHARACTERISTIC DFES_Cls.DFC_PCVSRCMax_C "/" VALUE 0x80073B1F Val_Wu8 255.0 DFES_OneToOne 0.00 255.0 FORMAT "%5.1" /end CHARACTERISTIC
/begin CHARACTERISTIC DFES_Cls.DFC_PCVSRCMin_C "/" VALUE 0x80073B20 Val_Wu8 255.0 DFES_OneToOne 0.00 255.0 FORMAT "%5.1" /end CHARACTERISTIC
/begin CHARACTERISTIC DFES_Cls.DFC_RailPSRCMax_C "/" VALUE 0x80073B21 Val_Wu8 255.0 DFES_OneToOne 0.00 255.0 FORMAT "%5.1" /end CHARACTERISTIC
/begin CHARACTERISTIC DFES_Cls.DFC_RailPSRCMin_C "/" VALUE 0x80073B22 Val_Wu8 255.0 DFES_OneToOne 0.00 255.0 FORMAT "%5.1" /end CHARACTERISTIC
/begin CHARACTERISTIC DFES_Cls.DFC_IVActrVltgSRCMax_C "/" VALUE 0x80073B23 Val_Wu8 255.0 DFES_OneToOne 0.00 255.0 FORMAT "%5.1" /end CHARACTERISTIC
/begin CHARACTERISTIC DFES_Cls.DFC_IVActrVltgSRCMin_C "/" VALUE 0x80073B24 Val_Wu8 255.0 DFES_OneToOne 0.00 255.0 FORMAT "%5.1" /end CHARACTERISTIC
/begin CHARACTERISTIC DFES_Cls.DFC_IVPSplyDCDC_C "/" VALUE 0x80073B25 Val_Wu8 255.0 DFES_OneToOne 0.00 255.0 FORMAT "%5.1" /end CHARACTERISTIC
/begin CHARACTERISTIC DFES_Cls.DFC_IVPSplyVltgSRCMax_C "/" VALUE 0x80073B26 Val_Wu8 255.0 DFES_OneToOne 0.00 255.0 FORMAT "%5.1" /end CHARACTERISTIC
/begin CHARACTERISTIC DFES_Cls.DFC_IVPSplyVltgSRCMin_C "/" VALUE 0x80073B27 Val_Wu8 255.0 DFES_OneToOne 0.00 255.0 FORMAT "%5.1" /end CHARACTERISTIC
/begin CHARACTERISTIC DFES_Cls.DFC_AFSOffsDrftMax_C "/" VALUE 0x80073B28 Val_Wu8 255.0 DFES_OneToOne 0.00 255.0 FORMAT "%5.1" /end CHARACTERISTIC
/begin CHARACTERISTIC DFES_Cls.DFC_AFSOffsDrftMin_C "/" VALUE 0x80073B29 Val_Wu8 255.0 DFES_OneToOne 0.00 255.0 FORMAT "%5.1" /end CHARACTERISTIC
/begin CHARACTERISTIC DFES_Cls.DFC_AFSSRCCorMax_C "/" VALUE 0x80073B2A Val_Wu8 255.0 DFES_OneToOne 0.00 255.0 FORMAT "%5.1" /end CHARACTERISTIC
/begin CHARACTERISTIC DFES_Cls.DFC_AFSSRCCorMin_C "/" VALUE 0x80073B2B Val_Wu8 255.0 DFES_OneToOne 0.00 255.0 FORMAT "%5.1" /end CHARACTERISTIC
/begin CHARACTERISTIC DFES_Cls.DFC_AFSSRCRawMax_C "/" VALUE 0x80073B2C Val_Wu8 255.0 DFES_OneToOne 0.00 255.0 FORMAT "%5.1" /end CHARACTERISTIC
/begin CHARACTERISTIC DFES_Cls.DFC_AFSSRCRawMin_C "/" VALUE 0x80073B2D Val_Wu8 255.0 DFES_OneToOne 0.00 255.0 FORMAT "%5.1" /end CHARACTERISTIC
/begin CHARACTERISTIC DFES_Cls.DFC_AFSSetyDrftMax_C "/" VALUE 0x80073B2E Val_Wu8 255.0 DFES_OneToOne 0.00 255.0 FORMAT "%5.1" /end CHARACTERISTIC
/begin CHARACTERISTIC DFES_Cls.DFC_AFSSetyDrftMin_C "/" VALUE 0x80073B2F Val_Wu8 255.0 DFES_OneToOne 0.00 255.0 FORMAT "%5.1" /end CHARACTERISTIC
/begin CHARACTERISTIC DFES_Cls.DFC_AirCClntPAnaSRCMax_C "/" VALUE 0x80073B30 Val_Wu8 255.0 DFES_OneToOne 0.00 255.0 FORMAT "%5.1" /end CHARACTERISTIC
/begin CHARACTERISTIC DFES_Cls.DFC_AirCClntPAnaSRCMin_C "/" VALUE 0x80073B31 Val_Wu8 255.0 DFES_OneToOne 0.00 255.0 FORMAT "%5.1" /end CHARACTERISTIC
/begin CHARACTERISTIC DFES_Cls.DFC_AirCClntPPerSRCMax_C "/" VALUE 0x80073B32 Val_Wu8 255.0 DFES_OneToOne 0.00 255.0 FORMAT "%5.1" /end CHARACTERISTIC
/begin CHARACTERISTIC DFES_Cls.DFC_AirCClntPPerSRCMin_C "/" VALUE 0x80073B33 Val_Wu8 255.0 DFES_OneToOne 0.00 255.0 FORMAT "%5.1" /end CHARACTERISTIC
/begin CHARACTERISTIC DFES_Cls.DFC_AirCClntPdcycSRCMax_C "/" VALUE 0x80073B34 Val_Wu8 255.0 DFES_OneToOne 0.00 255.0 FORMAT "%5.1" /end CHARACTERISTIC
/begin CHARACTERISTIC DFES_Cls.DFC_AirCClntPdcycSRCMin_C "/" VALUE 0x80073B35 Val_Wu8 255.0 DFES_OneToOne 0.00 255.0 FORMAT "%5.1" /end CHARACTERISTIC
/begin CHARACTERISTIC DFES_Cls.DFC_AirCCmprOL_C "/" VALUE 0x80073B36 Val_Wu8 255.0 DFES_OneToOne 0.00 255.0 FORMAT "%5.1" /end CHARACTERISTIC
/begin CHARACTERISTIC DFES_Cls.DFC_AirCCmprRedTrqOL_C "/" VALUE 0x80073B37 Val_Wu8 255.0 DFES_OneToOne 0.00 255.0 FORMAT "%5.1" /end CHARACTERISTIC
/begin CHARACTERISTIC DFES_Cls.DFC_AirCCmprRedTrqSCB_C "/" VALUE 0x80073B38 Val_Wu8 255.0 DFES_OneToOne 0.00 255.0 FORMAT "%5.1" /end CHARACTERISTIC
/begin CHARACTERISTIC DFES_Cls.DFC_AirCCmprRedTrqSCG_C "/" VALUE 0x80073B39 Val_Wu8 255.0 DFES_OneToOne 0.00 255.0 FORMAT "%5.1" /end CHARACTERISTIC
/begin CHARACTERISTIC DFES_Cls.DFC_AirCCmprSCB_C "/" VALUE 0x80073B3A Val_Wu8 255.0 DFES_OneToOne 0.00 255.0 FORMAT "%5.1" /end CHARACTERISTIC
/begin CHARACTERISTIC DFES_Cls.DFC_AirCCmprSCG_C "/" VALUE 0x80073B3B Val_Wu8 255.0 DFES_OneToOne 0.00 255.0 FORMAT "%5.1" /end CHARACTERISTIC
/begin CHARACTERISTIC DFES_Cls.DFC_AirCSwtNpl_C "/" VALUE 0x80073B3C Val_Wu8 255.0 DFES_OneToOne 0.00 255.0 FORMAT "%5.1" /end CHARACTERISTIC
/begin CHARACTERISTIC DFES_Cls.DFC_AirCSwtSig_C "/" VALUE 0x80073B3D Val_Wu8 255.0 DFES_OneToOne 0.00 255.0 FORMAT "%5.1" /end CHARACTERISTIC
/begin CHARACTERISTIC DFES_Cls.DFC_BattUSRCMax_C "/" VALUE 0x80073B3E Val_Wu8 255.0 DFES_OneToOne 0.00 255.0 FORMAT "%5.1" /end CHARACTERISTIC
/begin CHARACTERISTIC DFES_Cls.DFC_BattUSRCMin_C "/" VALUE 0x80073B3F Val_Wu8 255.0 DFES_OneToOne 0.00 255.0 FORMAT "%5.1" /end CHARACTERISTIC
/begin CHARACTERISTIC DFES_Cls.DFC_BrkNpl_C "/" VALUE 0x80073B40 Val_Wu8 255.0 DFES_OneToOne 0.00 255.0 FORMAT "%5.1" /end CHARACTERISTIC
/begin CHARACTERISTIC DFES_Cls.DFC_BrkPSRCMax_C "/" VALUE 0x80073B41 Val_Wu8 255.0 DFES_OneToOne 0.00 255.0 FORMAT "%5.1" /end CHARACTERISTIC
/begin CHARACTERISTIC DFES_Cls.DFC_BrkPSRCMin_C "/" VALUE 0x80073B42 Val_Wu8 255.0 DFES_OneToOne 0.00 255.0 FORMAT "%5.1" /end CHARACTERISTIC
/begin CHARACTERISTIC DFES_Cls.DFC_BrkSig_C "/" VALUE 0x80073B43 Val_Wu8 255.0 DFES_OneToOne 0.00 255.0 FORMAT "%5.1" /end CHARACTERISTIC
/begin CHARACTERISTIC DFES_Cls.DFC_CByVlvOL_C "/" VALUE 0x80073B44 Val_Wu8 255.0 DFES_OneToOne 0.00 255.0 FORMAT "%5.1" /end CHARACTERISTIC
/begin CHARACTERISTIC DFES_Cls.DFC_CByVlvSCB_C "/" VALUE 0x80073B45 Val_Wu8 255.0 DFES_OneToOne 0.00 255.0 FORMAT "%5.1" /end CHARACTERISTIC
/begin CHARACTERISTIC DFES_Cls.DFC_CByVlvSCG_C "/" VALUE 0x80073B46 Val_Wu8 255.0 DFES_OneToOne 0.00 255.0 FORMAT "%5.1" /end CHARACTERISTIC
/begin CHARACTERISTIC DFES_Cls.DFC_CEngDsTSRCMax_C "/" VALUE 0x80073B47 Val_Wu8 255.0 DFES_OneToOne 0.00 255.0 FORMAT "%5.1" /end CHARACTERISTIC
/begin CHARACTERISTIC DFES_Cls.DFC_CEngDsTSRCMin_C "/" VALUE 0x80073B48 Val_Wu8 255.0 DFES_OneToOne 0.00 255.0 FORMAT "%5.1" /end CHARACTERISTIC
/begin CHARACTERISTIC DFES_Cls.DFC_CEngDsTSig_C "/" VALUE 0x80073B49 Val_Wu8 255.0 DFES_OneToOne 0.00 255.0 FORMAT "%5.1" /end CHARACTERISTIC
/begin CHARACTERISTIC DFES_Cls.DFC_CEngUsTSRCMax_C "/" VALUE 0x80073B4A Val_Wu8 255.0 DFES_OneToOne 0.00 255.0 FORMAT "%5.1" /end CHARACTERISTIC
/begin CHARACTERISTIC DFES_Cls.DFC_CEngUsTSRCMin_C "/" VALUE 0x80073B4B Val_Wu8 255.0 DFES_OneToOne 0.00 255.0 FORMAT "%5.1" /end CHARACTERISTIC
/begin CHARACTERISTIC DFES_Cls.DFC_CThmstOL_C "/" VALUE 0x80073B4C Val_Wu8 255.0 DFES_OneToOne 0.00 255.0 FORMAT "%5.1" /end CHARACTERISTIC
/begin CHARACTERISTIC DFES_Cls.DFC_CThmstSCB_C "/" VALUE 0x80073B4D Val_Wu8 255.0 DFES_OneToOne 0.00 255.0 FORMAT "%5.1" /end CHARACTERISTIC
/begin CHARACTERISTIC DFES_Cls.DFC_CThmstSCG_C "/" VALUE 0x80073B4E Val_Wu8 255.0 DFES_OneToOne 0.00 255.0 FORMAT "%5.1" /end CHARACTERISTIC
/begin CHARACTERISTIC DFES_Cls.DFC_ClthSig_C "/" VALUE 0x80073B4F Val_Wu8 255.0 DFES_OneToOne 0.00 255.0 FORMAT "%5.1" /end CHARACTERISTIC
/begin CHARACTERISTIC DFES_Cls.DFC_ECBVlvOL_C "/" VALUE 0x80073B50 Val_Wu8 255.0 DFES_OneToOne 0.00 255.0 FORMAT "%5.1" /end CHARACTERISTIC
/begin CHARACTERISTIC DFES_Cls.DFC_ECBVlvSCB_C "/" VALUE 0x80073B51 Val_Wu8 255.0 DFES_OneToOne 0.00 255.0 FORMAT "%5.1" /end CHARACTERISTIC
/begin CHARACTERISTIC DFES_Cls.DFC_ECBVlvSCG_C "/" VALUE 0x80073B52 Val_Wu8 255.0 DFES_OneToOne 0.00 255.0 FORMAT "%5.1" /end CHARACTERISTIC
/begin CHARACTERISTIC DFES_Cls.DFC_ECBVlvSRCMax_C "/" VALUE 0x80073B53 Val_Wu8 255.0 DFES_OneToOne 0.00 255.0 FORMAT "%5.1" /end CHARACTERISTIC
/begin CHARACTERISTIC DFES_Cls.DFC_ECBVlvSRCMin_C "/" VALUE 0x80073B54 Val_Wu8 255.0 DFES_OneToOne 0.00 255.0 FORMAT "%5.1" /end CHARACTERISTIC
/begin CHARACTERISTIC DFES_Cls.DFC_EGRVlvGovDvtMax_C "/" VALUE 0x80073B55 Val_Wu8 255.0 DFES_OneToOne 0.00 255.0 FORMAT "%5.1" /end CHARACTERISTIC
/begin CHARACTERISTIC DFES_Cls.DFC_EGRVlvGovDvtMin_C "/" VALUE 0x80073B56 Val_Wu8 255.0 DFES_OneToOne 0.00 255.0 FORMAT "%5.1" /end CHARACTERISTIC
/begin CHARACTERISTIC DFES_Cls.DFC_EGRVlvOL_C "/" VALUE 0x80073B57 Val_Wu8 255.0 DFES_OneToOne 0.00 255.0 FORMAT "%5.1" /end CHARACTERISTIC
/begin CHARACTERISTIC DFES_Cls.DFC_EGRVlvSCB_C "/" VALUE 0x80073B58 Val_Wu8 255.0 DFES_OneToOne 0.00 255.0 FORMAT "%5.1" /end CHARACTERISTIC
/begin CHARACTERISTIC DFES_Cls.DFC_EGRVlvSCG_C "/" VALUE 0x80073B59 Val_Wu8 255.0 DFES_OneToOne 0.00 255.0 FORMAT "%5.1" /end CHARACTERISTIC
/begin CHARACTERISTIC DFES_Cls.DFC_EGRVlvSRCMax_C "/" VALUE 0x80073B5A Val_Wu8 255.0 DFES_OneToOne 0.00 255.0 FORMAT "%5.1" /end CHARACTERISTIC
/begin CHARACTERISTIC DFES_Cls.DFC_EGRVlvSRCMin_C "/" VALUE 0x80073B5B Val_Wu8 255.0 DFES_OneToOne 0.00 255.0 FORMAT "%5.1" /end CHARACTERISTIC
/begin CHARACTERISTIC DFES_Cls.DFC_EMDmpOL_0_C "/" VALUE 0x80073B5C Val_Wu8 255.0 DFES_OneToOne 0.00 255.0 FORMAT "%5.1" /end CHARACTERISTIC
/begin CHARACTERISTIC DFES_Cls.DFC_EMDmpOL_1_C "/" VALUE 0x80073B5D Val_Wu8 255.0 DFES_OneToOne 0.00 255.0 FORMAT "%5.1" /end CHARACTERISTIC
/begin CHARACTERISTIC DFES_Cls.DFC_EMDmpSCB_0_C "/" VALUE 0x80073B5E Val_Wu8 255.0 DFES_OneToOne 0.00 255.0 FORMAT "%5.1" /end CHARACTERISTIC
/begin CHARACTERISTIC DFES_Cls.DFC_EMDmpSCB_1_C "/" VALUE 0x80073B5F Val_Wu8 255.0 DFES_OneToOne 0.00 255.0 FORMAT "%5.1" /end CHARACTERISTIC
/begin CHARACTERISTIC DFES_Cls.DFC_EMDmpSCG_0_C "/" VALUE 0x80073B60 Val_Wu8 255.0 DFES_OneToOne 0.00 255.0 FORMAT "%5.1" /end CHARACTERISTIC
/begin CHARACTERISTIC DFES_Cls.DFC_EMDmpSCG_1_C "/" VALUE 0x80073B61 Val_Wu8 255.0 DFES_OneToOne 0.00 255.0 FORMAT "%5.1" /end CHARACTERISTIC
/begin CHARACTERISTIC DFES_Cls.DFC_EngStAOL_C "/" VALUE 0x80073B62 Val_Wu8 255.0 DFES_OneToOne 0.00 255.0 FORMAT "%5.1" /end CHARACTERISTIC
/begin CHARACTERISTIC DFES_Cls.DFC_EngStASCB_C "/" VALUE 0x80073B63 Val_Wu8 255.0 DFES_OneToOne 0.00 255.0 FORMAT "%5.1" /end CHARACTERISTIC
/begin CHARACTERISTIC DFES_Cls.DFC_EngStASCG_C "/" VALUE 0x80073B64 Val_Wu8 255.0 DFES_OneToOne 0.00 255.0 FORMAT "%5.1" /end CHARACTERISTIC
/begin CHARACTERISTIC DFES_Cls.DFC_EnvPSRCMax_C "/" VALUE 0x80073B65 Val_Wu8 255.0 DFES_OneToOne 0.00 255.0 FORMAT "%5.1" /end CHARACTERISTIC
/begin CHARACTERISTIC DFES_Cls.DFC_EnvPSRCMin_C "/" VALUE 0x80073B66 Val_Wu8 255.0 DFES_OneToOne 0.00 255.0 FORMAT "%5.1" /end CHARACTERISTIC
/begin CHARACTERISTIC DFES_Cls.DFC_EnvPSig_C "/" VALUE 0x80073B67 Val_Wu8 255.0 DFES_OneToOne 0.00 255.0 FORMAT "%5.1" /end CHARACTERISTIC
/begin CHARACTERISTIC DFES_Cls.DFC_EnvTSRCMax_C "/" VALUE 0x80073B68 Val_Wu8 255.0 DFES_OneToOne 0.00 255.0 FORMAT "%5.1" /end CHARACTERISTIC
/begin CHARACTERISTIC DFES_Cls.DFC_EnvTSRCMin_C "/" VALUE 0x80073B69 Val_Wu8 255.0 DFES_OneToOne 0.00 255.0 FORMAT "%5.1" /end CHARACTERISTIC
/begin CHARACTERISTIC DFES_Cls.DFC_FanOL_C "/" VALUE 0x80073B6A Val_Wu8 255.0 DFES_OneToOne 0.00 255.0 FORMAT "%5.1" /end CHARACTERISTIC
/begin CHARACTERISTIC DFES_Cls.DFC_FanSCB_C "/" VALUE 0x80073B6B Val_Wu8 255.0 DFES_OneToOne 0.00 255.0 FORMAT "%5.1" /end CHARACTERISTIC
/begin CHARACTERISTIC DFES_Cls.DFC_FlFltSig_C "/" VALUE 0x80073B6C Val_Wu8 255.0 DFES_OneToOne 0.00 255.0 FORMAT "%5.1" /end CHARACTERISTIC
/begin CHARACTERISTIC DFES_Cls.DFC_FuelTSRCMax_C "/" VALUE 0x80073B6D Val_Wu8 255.0 DFES_OneToOne 0.00 255.0 FORMAT "%5.1" /end CHARACTERISTIC
/begin CHARACTERISTIC DFES_Cls.DFC_FuelTSRCMin_C "/" VALUE 0x80073B6E Val_Wu8 255.0 DFES_OneToOne 0.00 255.0 FORMAT "%5.1" /end CHARACTERISTIC
/begin CHARACTERISTIC DFES_Cls.DFC_GbxNPosPPerSRCMax_C "/" VALUE 0x80073B6F Val_Wu8 255.0 DFES_OneToOne 0.00 255.0 FORMAT "%5.1" /end CHARACTERISTIC
/begin CHARACTERISTIC DFES_Cls.DFC_GbxNPosPPerSRCMin_C "/" VALUE 0x80073B70 Val_Wu8 255.0 DFES_OneToOne 0.00 255.0 FORMAT "%5.1" /end CHARACTERISTIC
/begin CHARACTERISTIC DFES_Cls.DFC_GbxNPosPdcycSRCMax_C "/" VALUE 0x80073B71 Val_Wu8 255.0 DFES_OneToOne 0.00 255.0 FORMAT "%5.1" /end CHARACTERISTIC
/begin CHARACTERISTIC DFES_Cls.DFC_GbxNPosPdcycSRCMin_C "/" VALUE 0x80073B72 Val_Wu8 255.0 DFES_OneToOne 0.00 255.0 FORMAT "%5.1" /end CHARACTERISTIC
/begin CHARACTERISTIC DFES_Cls.DFC_GbxNPosSig_C "/" VALUE 0x80073B73 Val_Wu8 255.0 DFES_OneToOne 0.00 255.0 FORMAT "%5.1" /end CHARACTERISTIC
/begin CHARACTERISTIC DFES_Cls.DFC_GlwPlgBSDOL_0_C "/" VALUE 0x80073B74 Val_Wu8 255.0 DFES_OneToOne 0.00 255.0 FORMAT "%5.1" /end CHARACTERISTIC
/begin CHARACTERISTIC DFES_Cls.DFC_GlwPlgBSDOL_1_C "/" VALUE 0x80073B75 Val_Wu8 255.0 DFES_OneToOne 0.00 255.0 FORMAT "%5.1" /end CHARACTERISTIC
/begin CHARACTERISTIC DFES_Cls.DFC_GlwPlgBSDOL_2_C "/" VALUE 0x80073B76 Val_Wu8 255.0 DFES_OneToOne 0.00 255.0 FORMAT "%5.1" /end CHARACTERISTIC
/begin CHARACTERISTIC DFES_Cls.DFC_GlwPlgBSDOL_3_C "/" VALUE 0x80073B77 Val_Wu8 255.0 DFES_OneToOne 0.00 255.0 FORMAT "%5.1" /end CHARACTERISTIC
/begin CHARACTERISTIC DFES_Cls.DFC_GlwPlgBSDOL_4_C "/" VALUE 0x80073B78 Val_Wu8 255.0 DFES_OneToOne 0.00 255.0 FORMAT "%5.1" /end CHARACTERISTIC
/begin CHARACTERISTIC DFES_Cls.DFC_GlwPlgBSDOL_5_C "/" VALUE 0x80073B79 Val_Wu8 255.0 DFES_OneToOne 0.00 255.0 FORMAT "%5.1" /end CHARACTERISTIC
/begin CHARACTERISTIC DFES_Cls.DFC_GlwPlgBSDOL_6_C "/" VALUE 0x80073B7A Val_Wu8 255.0 DFES_OneToOne 0.00 255.0 FORMAT "%5.1" /end CHARACTERISTIC
/begin CHARACTERISTIC DFES_Cls.DFC_GlwPlgBSDOL_7_C "/" VALUE 0x80073B7B Val_Wu8 255.0 DFES_OneToOne 0.00 255.0 FORMAT "%5.1" /end CHARACTERISTIC
/begin CHARACTERISTIC DFES_Cls.DFC_GlwPlgBSDOT_0_C "/" VALUE 0x80073B7C Val_Wu8 255.0 DFES_OneToOne 0.00 255.0 FORMAT "%5.1" /end CHARACTERISTIC
/begin CHARACTERISTIC DFES_Cls.DFC_GlwPlgBSDOT_1_C "/" VALUE 0x80073B7D Val_Wu8 255.0 DFES_OneToOne 0.00 255.0 FORMAT "%5.1" /end CHARACTERISTIC
/begin CHARACTERISTIC DFES_Cls.DFC_GlwPlgBSDOT_2_C "/" VALUE 0x80073B7E Val_Wu8 255.0 DFES_OneToOne 0.00 255.0 FORMAT "%5.1" /end CHARACTERISTIC
/begin CHARACTERISTIC DFES_Cls.DFC_GlwPlgBSDOT_3_C "/" VALUE 0x80073B7F Val_Wu8 255.0 DFES_OneToOne 0.00 255.0 FORMAT "%5.1" /end CHARACTERISTIC
/begin CHARACTERISTIC DFES_Cls.DFC_GlwPlgBSDOT_4_C "/" VALUE 0x80073B80 Val_Wu8 255.0 DFES_OneToOne 0.00 255.0 FORMAT "%5.1" /end CHARACTERISTIC
/begin CHARACTERISTIC DFES_Cls.DFC_GlwPlgBSDOT_5_C "/" VALUE 0x80073B81 Val_Wu8 255.0 DFES_OneToOne 0.00 255.0 FORMAT "%5.1" /end CHARACTERISTIC
/begin CHARACTERISTIC DFES_Cls.DFC_GlwPlgBSDOT_6_C "/" VALUE 0x80073B82 Val_Wu8 255.0 DFES_OneToOne 0.00 255.0 FORMAT "%5.1" /end CHARACTERISTIC
/begin CHARACTERISTIC DFES_Cls.DFC_GlwPlgBSDOT_7_C "/" VALUE 0x80073B83 Val_Wu8 255.0 DFES_OneToOne 0.00 255.0 FORMAT "%5.1" /end CHARACTERISTIC
/begin CHARACTERISTIC DFES_Cls.DFC_GlwPlgBSDSC_0_C "/" VALUE 0x80073B84 Val_Wu8 255.0 DFES_OneToOne 0.00 255.0 FORMAT "%5.1" /end CHARACTERISTIC
/begin CHARACTERISTIC DFES_Cls.DFC_GlwPlgBSDSC_1_C "/" VALUE 0x80073B85 Val_Wu8 255.0 DFES_OneToOne 0.00 255.0 FORMAT "%5.1" /end CHARACTERISTIC
/begin CHARACTERISTIC DFES_Cls.DFC_GlwPlgBSDSC_2_C "/" VALUE 0x80073B86 Val_Wu8 255.0 DFES_OneToOne 0.00 255.0 FORMAT "%5.1" /end CHARACTERISTIC
/begin CHARACTERISTIC DFES_Cls.DFC_GlwPlgBSDSC_3_C "/" VALUE 0x80073B87 Val_Wu8 255.0 DFES_OneToOne 0.00 255.0 FORMAT "%5.1" /end CHARACTERISTIC
/begin CHARACTERISTIC DFES_Cls.DFC_GlwPlgBSDSC_4_C "/" VALUE 0x80073B88 Val_Wu8 255.0 DFES_OneToOne 0.00 255.0 FORMAT "%5.1" /end CHARACTERISTIC
/begin CHARACTERISTIC DFES_Cls.DFC_GlwPlgBSDSC_5_C "/" VALUE 0x80073B89 Val_Wu8 255.0 DFES_OneToOne 0.00 255.0 FORMAT "%5.1" /end CHARACTERISTIC
/begin CHARACTERISTIC DFES_Cls.DFC_GlwPlgBSDSC_6_C "/" VALUE 0x80073B8A Val_Wu8 255.0 DFES_OneToOne 0.00 255.0 FORMAT "%5.1" /end CHARACTERISTIC
/begin CHARACTERISTIC DFES_Cls.DFC_GlwPlgBSDSC_7_C "/" VALUE 0x80073B8B Val_Wu8 255.0 DFES_OneToOne 0.00 255.0 FORMAT "%5.1" /end CHARACTERISTIC
/begin CHARACTERISTIC DFES_Cls.DFC_GlwPlgComErr_C "/" VALUE 0x80073B8C Val_Wu8 255.0 DFES_OneToOne 0.00 255.0 FORMAT "%5.1" /end CHARACTERISTIC
/begin CHARACTERISTIC DFES_Cls.DFC_InjVlvPresMin_C "/" VALUE 0x80073B8D Val_Wu8 255.0 DFES_OneToOne 0.00 255.0 FORMAT "%5.1" /end CHARACTERISTIC
/begin CHARACTERISTIC DFES_Cls.DFC_LSUCircNernstMax_0_C "/" VALUE 0x80073B8E Val_Wu8 255.0 DFES_OneToOne 0.00 255.0 FORMAT "%5.1" /end CHARACTERISTIC
/begin CHARACTERISTIC DFES_Cls.DFC_LSUCircNernstMax_1_C "/" VALUE 0x80073B8F Val_Wu8 255.0 DFES_OneToOne 0.00 255.0 FORMAT "%5.1" /end CHARACTERISTIC
/begin CHARACTERISTIC DFES_Cls.DFC_LSUCircNernstMax_2_C "/" VALUE 0x80073B90 Val_Wu8 255.0 DFES_OneToOne 0.00 255.0 FORMAT "%5.1" /end CHARACTERISTIC
/begin CHARACTERISTIC DFES_Cls.DFC_LSUCircNernstMax_3_C "/" VALUE 0x80073B91 Val_Wu8 255.0 DFES_OneToOne 0.00 255.0 FORMAT "%5.1" /end CHARACTERISTIC
/begin CHARACTERISTIC DFES_Cls.DFC_LSUCircNernstMin_0_C "/" VALUE 0x80073B92 Val_Wu8 255.0 DFES_OneToOne 0.00 255.0 FORMAT "%5.1" /end CHARACTERISTIC
/begin CHARACTERISTIC DFES_Cls.DFC_LSUCircNernstMin_1_C "/" VALUE 0x80073B93 Val_Wu8 255.0 DFES_OneToOne 0.00 255.0 FORMAT "%5.1" /end CHARACTERISTIC
/begin CHARACTERISTIC DFES_Cls.DFC_LSUCircNernstMin_2_C "/" VALUE 0x80073B94 Val_Wu8 255.0 DFES_OneToOne 0.00 255.0 FORMAT "%5.1" /end CHARACTERISTIC
/begin CHARACTERISTIC DFES_Cls.DFC_LSUCircNernstMin_3_C "/" VALUE 0x80073B95 Val_Wu8 255.0 DFES_OneToOne 0.00 255.0 FORMAT "%5.1" /end CHARACTERISTIC
/begin CHARACTERISTIC DFES_Cls.DFC_LSUCircNernstSig_0_C "/" VALUE 0x80073B96 Val_Wu8 255.0 DFES_OneToOne 0.00 255.0 FORMAT "%5.1" /end CHARACTERISTIC
/begin CHARACTERISTIC DFES_Cls.DFC_LSUCircNernstSig_1_C "/" VALUE 0x80073B97 Val_Wu8 255.0 DFES_OneToOne 0.00 255.0 FORMAT "%5.1" /end CHARACTERISTIC
/begin CHARACTERISTIC DFES_Cls.DFC_LSUCircNernstSig_2_C "/" VALUE 0x80073B98 Val_Wu8 255.0 DFES_OneToOne 0.00 255.0 FORMAT "%5.1" /end CHARACTERISTIC
/begin CHARACTERISTIC DFES_Cls.DFC_LSUCircNernstSig_3_C "/" VALUE 0x80073B99 Val_Wu8 255.0 DFES_OneToOne 0.00 255.0 FORMAT "%5.1" /end CHARACTERISTIC
/begin CHARACTERISTIC DFES_Cls.DFC_LSUCircPmpCurMax_0_C "/" VALUE 0x80073B9A Val_Wu8 255.0 DFES_OneToOne 0.00 255.0 FORMAT "%5.1" /end CHARACTERISTIC
/begin CHARACTERISTIC DFES_Cls.DFC_LSUCircPmpCurMax_1_C "/" VALUE 0x80073B9B Val_Wu8 255.0 DFES_OneToOne 0.00 255.0 FORMAT "%5.1" /end CHARACTERISTIC
/begin CHARACTERISTIC DFES_Cls.DFC_LSUCircPmpCurMax_2_C "/" VALUE 0x80073B9C Val_Wu8 255.0 DFES_OneToOne 0.00 255.0 FORMAT "%5.1" /end CHARACTERISTIC
/begin CHARACTERISTIC DFES_Cls.DFC_LSUCircPmpCurMax_3_C "/" VALUE 0x80073B9D Val_Wu8 255.0 DFES_OneToOne 0.00 255.0 FORMAT "%5.1" /end CHARACTERISTIC
/begin CHARACTERISTIC DFES_Cls.DFC_LSUCircPmpCurMin_0_C "/" VALUE 0x80073B9E Val_Wu8 255.0 DFES_OneToOne 0.00 255.0 FORMAT "%5.1" /end CHARACTERISTIC
/begin CHARACTERISTIC DFES_Cls.DFC_LSUCircPmpCurMin_1_C "/" VALUE 0x80073B9F Val_Wu8 255.0 DFES_OneToOne 0.00 255.0 FORMAT "%5.1" /end CHARACTERISTIC
/begin CHARACTERISTIC DFES_Cls.DFC_LSUCircPmpCurMin_2_C "/" VALUE 0x80073BA0 Val_Wu8 255.0 DFES_OneToOne 0.00 255.0 FORMAT "%5.1" /end CHARACTERISTIC
/begin CHARACTERISTIC DFES_Cls.DFC_LSUCircPmpCurMin_3_C "/" VALUE 0x80073BA1 Val_Wu8 255.0 DFES_OneToOne 0.00 255.0 FORMAT "%5.1" /end CHARACTERISTIC
/begin CHARACTERISTIC DFES_Cls.DFC_LSUCircPmpCurSig_0_C "/" VALUE 0x80073BA2 Val_Wu8 255.0 DFES_OneToOne 0.00 255.0 FORMAT "%5.1" /end CHARACTERISTIC
/begin CHARACTERISTIC DFES_Cls.DFC_LSUCircPmpCurSig_1_C "/" VALUE 0x80073BA3 Val_Wu8 255.0 DFES_OneToOne 0.00 255.0 FORMAT "%5.1" /end CHARACTERISTIC
/begin CHARACTERISTIC DFES_Cls.DFC_LSUCircPmpCurSig_2_C "/" VALUE 0x80073BA4 Val_Wu8 255.0 DFES_OneToOne 0.00 255.0 FORMAT "%5.1" /end CHARACTERISTIC
/begin CHARACTERISTIC DFES_Cls.DFC_LSUCircPmpCurSig_3_C "/" VALUE 0x80073BA5 Val_Wu8 255.0 DFES_OneToOne 0.00 255.0 FORMAT "%5.1" /end CHARACTERISTIC
/begin CHARACTERISTIC DFES_Cls.DFC_LSUCircVirtGndMax_0_C "/" VALUE 0x80073BA6 Val_Wu8 255.0 DFES_OneToOne 0.00 255.0 FORMAT "%5.1" /end CHARACTERISTIC
/begin CHARACTERISTIC DFES_Cls.DFC_LSUCircVirtGndMax_1_C "/" VALUE 0x80073BA7 Val_Wu8 255.0 DFES_OneToOne 0.00 255.0 FORMAT "%5.1" /end CHARACTERISTIC
/begin CHARACTERISTIC DFES_Cls.DFC_LSUCircVirtGndMax_2_C "/" VALUE 0x80073BA8 Val_Wu8 255.0 DFES_OneToOne 0.00 255.0 FORMAT "%5.1" /end CHARACTERISTIC
/begin CHARACTERISTIC DFES_Cls.DFC_LSUCircVirtGndMax_3_C "/" VALUE 0x80073BA9 Val_Wu8 255.0 DFES_OneToOne 0.00 255.0 FORMAT "%5.1" /end CHARACTERISTIC
/begin CHARACTERISTIC DFES_Cls.DFC_LSUCircVirtGndMin_0_C "/" VALUE 0x80073BAA Val_Wu8 255.0 DFES_OneToOne 0.00 255.0 FORMAT "%5.1" /end CHARACTERISTIC
/begin CHARACTERISTIC DFES_Cls.DFC_LSUCircVirtGndMin_1_C "/" VALUE 0x80073BAB Val_Wu8 255.0 DFES_OneToOne 0.00 255.0 FORMAT "%5.1" /end CHARACTERISTIC
/begin CHARACTERISTIC DFES_Cls.DFC_LSUCircVirtGndMin_2_C "/" VALUE 0x80073BAC Val_Wu8 255.0 DFES_OneToOne 0.00 255.0 FORMAT "%5.1" /end CHARACTERISTIC
/begin CHARACTERISTIC DFES_Cls.DFC_LSUCircVirtGndMin_3_C "/" VALUE 0x80073BAD Val_Wu8 255.0 DFES_OneToOne 0.00 255.0 FORMAT "%5.1" /end CHARACTERISTIC
/begin CHARACTERISTIC DFES_Cls.DFC_LSUCircVirtGndSig_0_C "/" VALUE 0x80073BAE Val_Wu8 255.0 DFES_OneToOne 0.00 255.0 FORMAT "%5.1" /end CHARACTERISTIC
/begin CHARACTERISTIC DFES_Cls.DFC_LSUCircVirtGndSig_1_C "/" VALUE 0x80073BAF Val_Wu8 255.0 DFES_OneToOne 0.00 255.0 FORMAT "%5.1" /end CHARACTERISTIC
/begin CHARACTERISTIC DFES_Cls.DFC_LSUCircVirtGndSig_2_C "/" VALUE 0x80073BB0 Val_Wu8 255.0 DFES_OneToOne 0.00 255.0 FORMAT "%5.1" /end CHARACTERISTIC
/begin CHARACTERISTIC DFES_Cls.DFC_LSUCircVirtGndSig_3_C "/" VALUE 0x80073BB1 Val_Wu8 255.0 DFES_OneToOne 0.00 255.0 FORMAT "%5.1" /end CHARACTERISTIC
/begin CHARACTERISTIC DFES_Cls.DFC_LSUHtrMax_0_C "/" VALUE 0x80073BB2 Val_Wu8 255.0 DFES_OneToOne 0.00 255.0 FORMAT "%5.1" /end CHARACTERISTIC
/begin CHARACTERISTIC DFES_Cls.DFC_LSUHtrMax_1_C "/" VALUE 0x80073BB3 Val_Wu8 255.0 DFES_OneToOne 0.00 255.0 FORMAT "%5.1" /end CHARACTERISTIC
/begin CHARACTERISTIC DFES_Cls.DFC_LSUHtrMax_2_C "/" VALUE 0x80073BB4 Val_Wu8 255.0 DFES_OneToOne 0.00 255.0 FORMAT "%5.1" /end CHARACTERISTIC
/begin CHARACTERISTIC DFES_Cls.DFC_LSUHtrMax_3_C "/" VALUE 0x80073BB5 Val_Wu8 255.0 DFES_OneToOne 0.00 255.0 FORMAT "%5.1" /end CHARACTERISTIC
/begin CHARACTERISTIC DFES_Cls.DFC_LSUHtrMin_0_C "/" VALUE 0x80073BB6 Val_Wu8 255.0 DFES_OneToOne 0.00 255.0 FORMAT "%5.1" /end CHARACTERISTIC
/begin CHARACTERISTIC DFES_Cls.DFC_LSUHtrMin_1_C "/" VALUE 0x80073BB7 Val_Wu8 255.0 DFES_OneToOne 0.00 255.0 FORMAT "%5.1" /end CHARACTERISTIC
/begin CHARACTERISTIC DFES_Cls.DFC_LSUHtrMin_2_C "/" VALUE 0x80073BB8 Val_Wu8 255.0 DFES_OneToOne 0.00 255.0 FORMAT "%5.1" /end CHARACTERISTIC
/begin CHARACTERISTIC DFES_Cls.DFC_LSUHtrMin_3_C "/" VALUE 0x80073BB9 Val_Wu8 255.0 DFES_OneToOne 0.00 255.0 FORMAT "%5.1" /end CHARACTERISTIC
/begin CHARACTERISTIC DFES_Cls.DFC_LSUHtrSig_0_C "/" VALUE 0x80073BBA Val_Wu8 255.0 DFES_OneToOne 0.00 255.0 FORMAT "%5.1" /end CHARACTERISTIC
/begin CHARACTERISTIC DFES_Cls.DFC_LSUHtrSig_1_C "/" VALUE 0x80073BBB Val_Wu8 255.0 DFES_OneToOne 0.00 255.0 FORMAT "%5.1" /end CHARACTERISTIC
/begin CHARACTERISTIC DFES_Cls.DFC_LSUHtrSig_2_C "/" VALUE 0x80073BBC Val_Wu8 255.0 DFES_OneToOne 0.00 255.0 FORMAT "%5.1" /end CHARACTERISTIC
/begin CHARACTERISTIC DFES_Cls.DFC_LSUHtrSig_3_C "/" VALUE 0x80073BBD Val_Wu8 255.0 DFES_OneToOne 0.00 255.0 FORMAT "%5.1" /end CHARACTERISTIC
/begin CHARACTERISTIC DFES_Cls.DFC_LSUO2Max_0_C "/" VALUE 0x80073BBE Val_Wu8 255.0 DFES_OneToOne 0.00 255.0 FORMAT "%5.1" /end CHARACTERISTIC
/begin CHARACTERISTIC DFES_Cls.DFC_LSUO2Max_1_C "/" VALUE 0x80073BBF Val_Wu8 255.0 DFES_OneToOne 0.00 255.0 FORMAT "%5.1" /end CHARACTERISTIC
/begin CHARACTERISTIC DFES_Cls.DFC_LSUO2Max_2_C "/" VALUE 0x80073BC0 Val_Wu8 255.0 DFES_OneToOne 0.00 255.0 FORMAT "%5.1" /end CHARACTERISTIC
/begin CHARACTERISTIC DFES_Cls.DFC_LSUO2Max_3_C "/" VALUE 0x80073BC1 Val_Wu8 255.0 DFES_OneToOne 0.00 255.0 FORMAT "%5.1" /end CHARACTERISTIC
/begin CHARACTERISTIC DFES_Cls.DFC_LSUO2Min_0_C "/" VALUE 0x80073BC2 Val_Wu8 255.0 DFES_OneToOne 0.00 255.0 FORMAT "%5.1" /end CHARACTERISTIC
/begin CHARACTERISTIC DFES_Cls.DFC_LSUO2Min_1_C "/" VALUE 0x80073BC3 Val_Wu8 255.0 DFES_OneToOne 0.00 255.0 FORMAT "%5.1" /end CHARACTERISTIC
/begin CHARACTERISTIC DFES_Cls.DFC_LSUO2Min_2_C "/" VALUE 0x80073BC4 Val_Wu8 255.0 DFES_OneToOne 0.00 255.0 FORMAT "%5.1" /end CHARACTERISTIC
/begin CHARACTERISTIC DFES_Cls.DFC_LSUO2Min_3_C "/" VALUE 0x80073BC5 Val_Wu8 255.0 DFES_OneToOne 0.00 255.0 FORMAT "%5.1" /end CHARACTERISTIC
/begin CHARACTERISTIC DFES_Cls.DFC_LSUSPIBattLowMin_0_C "/" VALUE 0x80073BC6 Val_Wu8 255.0 DFES_OneToOne 0.00 255.0 FORMAT "%5.1" /end CHARACTERISTIC
/begin CHARACTERISTIC DFES_Cls.DFC_LSUSPIBattLowMin_1_C "/" VALUE 0x80073BC7 Val_Wu8 255.0 DFES_OneToOne 0.00 255.0 FORMAT "%5.1" /end CHARACTERISTIC
/begin CHARACTERISTIC DFES_Cls.DFC_LSUSPIBattLowMin_2_C "/" VALUE 0x80073BC8 Val_Wu8 255.0 DFES_OneToOne 0.00 255.0 FORMAT "%5.1" /end CHARACTERISTIC
/begin CHARACTERISTIC DFES_Cls.DFC_LSUSPIBattLowMin_3_C "/" VALUE 0x80073BC9 Val_Wu8 255.0 DFES_OneToOne 0.00 255.0 FORMAT "%5.1" /end CHARACTERISTIC
/begin CHARACTERISTIC DFES_Cls.DFC_LSUSPISig_0_C "/" VALUE 0x80073BCA Val_Wu8 255.0 DFES_OneToOne 0.00 255.0 FORMAT "%5.1" /end CHARACTERISTIC
/begin CHARACTERISTIC DFES_Cls.DFC_LSUSPISig_1_C "/" VALUE 0x80073BCB Val_Wu8 255.0 DFES_OneToOne 0.00 255.0 FORMAT "%5.1" /end CHARACTERISTIC
/begin CHARACTERISTIC DFES_Cls.DFC_LSUSPISig_2_C "/" VALUE 0x80073BCC Val_Wu8 255.0 DFES_OneToOne 0.00 255.0 FORMAT "%5.1" /end CHARACTERISTIC
/begin CHARACTERISTIC DFES_Cls.DFC_LSUSPISig_3_C "/" VALUE 0x80073BCD Val_Wu8 255.0 DFES_OneToOne 0.00 255.0 FORMAT "%5.1" /end CHARACTERISTIC
/begin CHARACTERISTIC DFES_Cls.DFC_LSUtExcMax_0_C "/" VALUE 0x80073BCE Val_Wu8 255.0 DFES_OneToOne 0.00 255.0 FORMAT "%5.1" /end CHARACTERISTIC
/begin CHARACTERISTIC DFES_Cls.DFC_LSUtExcMax_1_C "/" VALUE 0x80073BCF Val_Wu8 255.0 DFES_OneToOne 0.00 255.0 FORMAT "%5.1" /end CHARACTERISTIC
/begin CHARACTERISTIC DFES_Cls.DFC_LSUtExcMax_2_C "/" VALUE 0x80073BD0 Val_Wu8 255.0 DFES_OneToOne 0.00 255.0 FORMAT "%5.1" /end CHARACTERISTIC
/begin CHARACTERISTIC DFES_Cls.DFC_LSUtExcMax_3_C "/" VALUE 0x80073BD1 Val_Wu8 255.0 DFES_OneToOne 0.00 255.0 FORMAT "%5.1" /end CHARACTERISTIC
/begin CHARACTERISTIC DFES_Cls.DFC_LSUtExcMin_0_C "/" VALUE 0x80073BD2 Val_Wu8 255.0 DFES_OneToOne 0.00 255.0 FORMAT "%5.1" /end CHARACTERISTIC
/begin CHARACTERISTIC DFES_Cls.DFC_LSUtExcMin_1_C "/" VALUE 0x80073BD3 Val_Wu8 255.0 DFES_OneToOne 0.00 255.0 FORMAT "%5.1" /end CHARACTERISTIC
/begin CHARACTERISTIC DFES_Cls.DFC_LSUtExcMin_2_C "/" VALUE 0x80073BD4 Val_Wu8 255.0 DFES_OneToOne 0.00 255.0 FORMAT "%5.1" /end CHARACTERISTIC
/begin CHARACTERISTIC DFES_Cls.DFC_LSUtExcMin_3_C "/" VALUE 0x80073BD5 Val_Wu8 255.0 DFES_OneToOne 0.00 255.0 FORMAT "%5.1" /end CHARACTERISTIC
/begin CHARACTERISTIC DFES_Cls.DFC_MILOL_C "/" VALUE 0x80073BD6 Val_Wu8 255.0 DFES_OneToOne 0.00 255.0 FORMAT "%5.1" /end CHARACTERISTIC
/begin CHARACTERISTIC DFES_Cls.DFC_MILSCB_C "/" VALUE 0x80073BD7 Val_Wu8 255.0 DFES_OneToOne 0.00 255.0 FORMAT "%5.1" /end CHARACTERISTIC
/begin CHARACTERISTIC DFES_Cls.DFC_MILSCG_C "/" VALUE 0x80073BD8 Val_Wu8 255.0 DFES_OneToOne 0.00 255.0 FORMAT "%5.1" /end CHARACTERISTIC
/begin CHARACTERISTIC DFES_Cls.DFC_MeUnSCG_C "/" VALUE 0x80073BD9 Val_Wu8 255.0 DFES_OneToOne 0.00 255.0 FORMAT "%5.1" /end CHARACTERISTIC
/begin CHARACTERISTIC DFES_Cls.DFC_NplHsChngPPFltDiff_C "/" VALUE 0x80073BDA Val_Wu8 255.0 DFES_OneToOne 0.00 255.0 FORMAT "%5.1" /end CHARACTERISTIC
/begin CHARACTERISTIC DFES_Cls.DFC_NplPAirFltDs_C "/" VALUE 0x80073BDB Val_Wu8 255.0 DFES_OneToOne 0.00 255.0 FORMAT "%5.1" /end CHARACTERISTIC
/begin CHARACTERISTIC DFES_Cls.DFC_NplTPFltUs_C "/" VALUE 0x80073BDC Val_Wu8 255.0 DFES_OneToOne 0.00 255.0 FORMAT "%5.1" /end CHARACTERISTIC
/begin CHARACTERISTIC DFES_Cls.DFC_OilComErr_C "/" VALUE 0x80073BDD Val_Wu8 255.0 DFES_OneToOne 0.00 255.0 FORMAT "%5.1" /end CHARACTERISTIC
/begin CHARACTERISTIC DFES_Cls.DFC_OilPLmpOL_C "/" VALUE 0x80073BDE Val_Wu8 255.0 DFES_OneToOne 0.00 255.0 FORMAT "%5.1" /end CHARACTERISTIC
/begin CHARACTERISTIC DFES_Cls.DFC_OilPLmpSCB_C "/" VALUE 0x80073BDF Val_Wu8 255.0 DFES_OneToOne 0.00 255.0 FORMAT "%5.1" /end CHARACTERISTIC
/begin CHARACTERISTIC DFES_Cls.DFC_OilPLmpSCG_C "/" VALUE 0x80073BE0 Val_Wu8 255.0 DFES_OneToOne 0.00 255.0 FORMAT "%5.1" /end CHARACTERISTIC
/begin CHARACTERISTIC DFES_Cls.DFC_OilPNpl_C "/" VALUE 0x80073BE1 Val_Wu8 255.0 DFES_OneToOne 0.00 255.0 FORMAT "%5.1" /end CHARACTERISTIC
/begin CHARACTERISTIC DFES_Cls.DFC_OilTNpl_C "/" VALUE 0x80073BE2 Val_Wu8 255.0 DFES_OneToOne 0.00 255.0 FORMAT "%5.1" /end CHARACTERISTIC
/begin CHARACTERISTIC DFES_Cls.DFC_OilTSRCMax_C "/" VALUE 0x80073BE3 Val_Wu8 255.0 DFES_OneToOne 0.00 255.0 FORMAT "%5.1" /end CHARACTERISTIC
/begin CHARACTERISTIC DFES_Cls.DFC_OilTSRCMin_C "/" VALUE 0x80073BE4 Val_Wu8 255.0 DFES_OneToOne 0.00 255.0 FORMAT "%5.1" /end CHARACTERISTIC
/begin CHARACTERISTIC DFES_Cls.DFC_PCACDsEnvPPls_C "/" VALUE 0x80073BE5 Val_Wu8 255.0 DFES_OneToOne 0.00 255.0 FORMAT "%5.1" /end CHARACTERISTIC
/begin CHARACTERISTIC DFES_Cls.DFC_PCACDsSRCMax_C "/" VALUE 0x80073BE6 Val_Wu8 255.0 DFES_OneToOne 0.00 255.0 FORMAT "%5.1" /end CHARACTERISTIC
/begin CHARACTERISTIC DFES_Cls.DFC_PCACDsSRCMin_C "/" VALUE 0x80073BE7 Val_Wu8 255.0 DFES_OneToOne 0.00 255.0 FORMAT "%5.1" /end CHARACTERISTIC
/begin CHARACTERISTIC DFES_Cls.DFC_PCVSCG_C "/" VALUE 0x80073BE8 Val_Wu8 255.0 DFES_OneToOne 0.00 255.0 FORMAT "%5.1" /end CHARACTERISTIC
/begin CHARACTERISTIC DFES_Cls.DFC_PFltCharPDiffMin_C "/" VALUE 0x80073BE9 Val_Wu8 255.0 DFES_OneToOne 0.00 255.0 FORMAT "%5.1" /end CHARACTERISTIC
/begin CHARACTERISTIC DFES_Cls.DFC_PFltDstrMin_C "/" VALUE 0x80073BEA Val_Wu8 255.0 DFES_OneToOne 0.00 255.0 FORMAT "%5.1" /end CHARACTERISTIC
/begin CHARACTERISTIC DFES_Cls.DFC_PFltEngPrt_C "/" VALUE 0x80073BEB Val_Wu8 255.0 DFES_OneToOne 0.00 255.0 FORMAT "%5.1" /end CHARACTERISTIC
/begin CHARACTERISTIC DFES_Cls.DFC_PFltLmpOL_C "/" VALUE 0x80073BEC Val_Wu8 255.0 DFES_OneToOne 0.00 255.0 FORMAT "%5.1" /end CHARACTERISTIC
/begin CHARACTERISTIC DFES_Cls.DFC_PFltLmpSCB_C "/" VALUE 0x80073BED Val_Wu8 255.0 DFES_OneToOne 0.00 255.0 FORMAT "%5.1" /end CHARACTERISTIC
/begin CHARACTERISTIC DFES_Cls.DFC_PFltLmpSCG_C "/" VALUE 0x80073BEE Val_Wu8 255.0 DFES_OneToOne 0.00 255.0 FORMAT "%5.1" /end CHARACTERISTIC
/begin CHARACTERISTIC DFES_Cls.DFC_PFltRgnPerm_C "/" VALUE 0x80073BEF Val_Wu8 255.0 DFES_OneToOne 0.00 255.0 FORMAT "%5.1" /end CHARACTERISTIC
/begin CHARACTERISTIC DFES_Cls.DFC_PFltSRCMaxFlwRstn_C "/" VALUE 0x80073BF0 Val_Wu8 255.0 DFES_OneToOne 0.00 255.0 FORMAT "%5.1" /end CHARACTERISTIC
/begin CHARACTERISTIC DFES_Cls.DFC_PFltSRCMinFlwRstn_C "/" VALUE 0x80073BF1 Val_Wu8 255.0 DFES_OneToOne 0.00 255.0 FORMAT "%5.1" /end CHARACTERISTIC
/begin CHARACTERISTIC DFES_Cls.DFC_PFltSotMsDvtMax_C "/" VALUE 0x80073BF2 Val_Wu8 255.0 DFES_OneToOne 0.00 255.0 FORMAT "%5.1" /end CHARACTERISTIC
/begin CHARACTERISTIC DFES_Cls.DFC_PFltSotMsDvtMin_C "/" VALUE 0x80073BF3 Val_Wu8 255.0 DFES_OneToOne 0.00 255.0 FORMAT "%5.1" /end CHARACTERISTIC
/begin CHARACTERISTIC DFES_Cls.DFC_PFltSotMsMax_C "/" VALUE 0x80073BF4 Val_Wu8 255.0 DFES_OneToOne 0.00 255.0 FORMAT "%5.1" /end CHARACTERISTIC
/begin CHARACTERISTIC DFES_Cls.DFC_PSPOL_C "/" VALUE 0x80073BF5 Val_Wu8 255.0 DFES_OneToOne 0.00 255.0 FORMAT "%5.1" /end CHARACTERISTIC
/begin CHARACTERISTIC DFES_Cls.DFC_PSPSCB_C "/" VALUE 0x80073BF6 Val_Wu8 255.0 DFES_OneToOne 0.00 255.0 FORMAT "%5.1" /end CHARACTERISTIC
/begin CHARACTERISTIC DFES_Cls.DFC_PSPSCG_C "/" VALUE 0x80073BF7 Val_Wu8 255.0 DFES_OneToOne 0.00 255.0 FORMAT "%5.1" /end CHARACTERISTIC
/begin CHARACTERISTIC DFES_Cls.DFC_SRCHighAPP1_C "/" VALUE 0x80073BF8 Val_Wu8 255.0 DFES_OneToOne 0.00 255.0 FORMAT "%5.1" /end CHARACTERISTIC
/begin CHARACTERISTIC DFES_Cls.DFC_SRCHighAPP2_C "/" VALUE 0x80073BF9 Val_Wu8 255.0 DFES_OneToOne 0.00 255.0 FORMAT "%5.1" /end CHARACTERISTIC
/begin CHARACTERISTIC DFES_Cls.DFC_SRCLowAPP1_C "/" VALUE 0x80073BFA Val_Wu8 255.0 DFES_OneToOne 0.00 255.0 FORMAT "%5.1" /end CHARACTERISTIC
/begin CHARACTERISTIC DFES_Cls.DFC_SRCLowAPP2_C "/" VALUE 0x80073BFB Val_Wu8 255.0 DFES_OneToOne 0.00 255.0 FORMAT "%5.1" /end CHARACTERISTIC
/begin CHARACTERISTIC DFES_Cls.DFC_SRCMaxPAirFltDs_C "/" VALUE 0x80073BFC Val_Wu8 255.0 DFES_OneToOne 0.00 255.0 FORMAT "%5.1" /end CHARACTERISTIC
/begin CHARACTERISTIC DFES_Cls.DFC_SRCMaxPPFltUs_C "/" VALUE 0x80073BFD Val_Wu8 255.0 DFES_OneToOne 0.00 255.0 FORMAT "%5.1" /end CHARACTERISTIC
/begin CHARACTERISTIC DFES_Cls.DFC_SRCMaxTECU_C "/" VALUE 0x80073BFE Val_Wu8 255.0 DFES_OneToOne 0.00 255.0 FORMAT "%5.1" /end CHARACTERISTIC
/begin CHARACTERISTIC DFES_Cls.DFC_SRCMaxTOxiCatUs_C "/" VALUE 0x80073BFF Val_Wu8 255.0 DFES_OneToOne 0.00 255.0 FORMAT "%5.1" /end CHARACTERISTIC
/begin CHARACTERISTIC DFES_Cls.DFC_SRCMaxTPFltUs_C "/" VALUE 0x80073C00 Val_Wu8 255.0 DFES_OneToOne 0.00 255.0 FORMAT "%5.1" /end CHARACTERISTIC
/begin CHARACTERISTIC DFES_Cls.DFC_SRCMinPAirFltDs_C "/" VALUE 0x80073C01 Val_Wu8 255.0 DFES_OneToOne 0.00 255.0 FORMAT "%5.1" /end CHARACTERISTIC
/begin CHARACTERISTIC DFES_Cls.DFC_SRCMinPPFltUs_C "/" VALUE 0x80073C02 Val_Wu8 255.0 DFES_OneToOne 0.00 255.0 FORMAT "%5.1" /end CHARACTERISTIC
/begin CHARACTERISTIC DFES_Cls.DFC_SRCMinTECU_C "/" VALUE 0x80073C03 Val_Wu8 255.0 DFES_OneToOne 0.00 255.0 FORMAT "%5.1" /end CHARACTERISTIC
/begin CHARACTERISTIC DFES_Cls.DFC_SRCMinTOxiCatUs_C "/" VALUE 0x80073C04 Val_Wu8 255.0 DFES_OneToOne 0.00 255.0 FORMAT "%5.1" /end CHARACTERISTIC
/begin CHARACTERISTIC DFES_Cls.DFC_SRCMinTPFltUs_C "/" VALUE 0x80073C05 Val_Wu8 255.0 DFES_OneToOne 0.00 255.0 FORMAT "%5.1" /end CHARACTERISTIC
/begin CHARACTERISTIC DFES_Cls.DFC_SVSOL_C "/" VALUE 0x80073C06 Val_Wu8 255.0 DFES_OneToOne 0.00 255.0 FORMAT "%5.1" /end CHARACTERISTIC
/begin CHARACTERISTIC DFES_Cls.DFC_SVSSCB_C "/" VALUE 0x80073C07 Val_Wu8 255.0 DFES_OneToOne 0.00 255.0 FORMAT "%5.1" /end CHARACTERISTIC
/begin CHARACTERISTIC DFES_Cls.DFC_SVSSCG_C "/" VALUE 0x80073C08 Val_Wu8 255.0 DFES_OneToOne 0.00 255.0 FORMAT "%5.1" /end CHARACTERISTIC
/begin CHARACTERISTIC DFES_Cls.DFC_StrtOL_C "/" VALUE 0x80073C09 Val_Wu8 255.0 DFES_OneToOne 0.00 255.0 FORMAT "%5.1" /end CHARACTERISTIC
/begin CHARACTERISTIC DFES_Cls.DFC_StrtSCB_C "/" VALUE 0x80073C0A Val_Wu8 255.0 DFES_OneToOne 0.00 255.0 FORMAT "%5.1" /end CHARACTERISTIC
/begin CHARACTERISTIC DFES_Cls.DFC_StrtSCG_C "/" VALUE 0x80073C0B Val_Wu8 255.0 DFES_OneToOne 0.00 255.0 FORMAT "%5.1" /end CHARACTERISTIC
/begin CHARACTERISTIC DFES_Cls.DFC_SyncAPP_C "/" VALUE 0x80073C0C Val_Wu8 255.0 DFES_OneToOne 0.00 255.0 FORMAT "%5.1" /end CHARACTERISTIC
/begin CHARACTERISTIC DFES_Cls.DFC_T15Npl_C "/" VALUE 0x80073C0D Val_Wu8 255.0 DFES_OneToOne 0.00 255.0 FORMAT "%5.1" /end CHARACTERISTIC
/begin CHARACTERISTIC DFES_Cls.DFC_TAFSDtyCycHi_C "/" VALUE 0x80073C0E Val_Wu8 255.0 DFES_OneToOne 0.00 255.0 FORMAT "%5.1" /end CHARACTERISTIC
/begin CHARACTERISTIC DFES_Cls.DFC_TAFSDtyCycLo_C "/" VALUE 0x80073C0F Val_Wu8 255.0 DFES_OneToOne 0.00 255.0 FORMAT "%5.1" /end CHARACTERISTIC
/begin CHARACTERISTIC DFES_Cls.DFC_TAFSPerHi_C "/" VALUE 0x80073C10 Val_Wu8 255.0 DFES_OneToOne 0.00 255.0 FORMAT "%5.1" /end CHARACTERISTIC
/begin CHARACTERISTIC DFES_Cls.DFC_TAFSPerLo_C "/" VALUE 0x80073C11 Val_Wu8 255.0 DFES_OneToOne 0.00 255.0 FORMAT "%5.1" /end CHARACTERISTIC
/begin CHARACTERISTIC DFES_Cls.DFC_TCACDsSRCMax_C "/" VALUE 0x80073C12 Val_Wu8 255.0 DFES_OneToOne 0.00 255.0 FORMAT "%5.1" /end CHARACTERISTIC
/begin CHARACTERISTIC DFES_Cls.DFC_TCACDsSRCMin_C "/" VALUE 0x80073C13 Val_Wu8 255.0 DFES_OneToOne 0.00 255.0 FORMAT "%5.1" /end CHARACTERISTIC
/begin CHARACTERISTIC DFES_Cls.DFC_ThrVlvOL_C "/" VALUE 0x80073C14 Val_Wu8 255.0 DFES_OneToOne 0.00 255.0 FORMAT "%5.1" /end CHARACTERISTIC
/begin CHARACTERISTIC DFES_Cls.DFC_ThrVlvSCB_C "/" VALUE 0x80073C15 Val_Wu8 255.0 DFES_OneToOne 0.00 255.0 FORMAT "%5.1" /end CHARACTERISTIC
/begin CHARACTERISTIC DFES_Cls.DFC_ThrVlvSRCMax_C "/" VALUE 0x80073C16 Val_Wu8 255.0 DFES_OneToOne 0.00 255.0 FORMAT "%5.1" /end CHARACTERISTIC
/begin CHARACTERISTIC DFES_Cls.DFC_ThrVlvSRCMin_C "/" VALUE 0x80073C17 Val_Wu8 255.0 DFES_OneToOne 0.00 255.0 FORMAT "%5.1" /end CHARACTERISTIC
/begin CHARACTERISTIC DFES_Cls.DFC_TrbChLPOL_C "/" VALUE 0x80073C18 Val_Wu8 255.0 DFES_OneToOne 0.00 255.0 FORMAT "%5.1" /end CHARACTERISTIC
/begin CHARACTERISTIC DFES_Cls.DFC_TrbChLPSCB_C "/" VALUE 0x80073C19 Val_Wu8 255.0 DFES_OneToOne 0.00 255.0 FORMAT "%5.1" /end CHARACTERISTIC
/begin CHARACTERISTIC DFES_Cls.DFC_TrbChLPSCG_C "/" VALUE 0x80073C1A Val_Wu8 255.0 DFES_OneToOne 0.00 255.0 FORMAT "%5.1" /end CHARACTERISTIC
/begin CHARACTERISTIC DFES_Cls.DFC_TrbChOL_C "/" VALUE 0x80073C1B Val_Wu8 255.0 DFES_OneToOne 0.00 255.0 FORMAT "%5.1" /end CHARACTERISTIC
/begin CHARACTERISTIC DFES_Cls.DFC_TrbChSCB_C "/" VALUE 0x80073C1C Val_Wu8 255.0 DFES_OneToOne 0.00 255.0 FORMAT "%5.1" /end CHARACTERISTIC
/begin CHARACTERISTIC DFES_Cls.DFC_VSwVlvGovDvtMax_C "/" VALUE 0x80073C1D Val_Wu8 255.0 DFES_OneToOne 0.00 255.0 FORMAT "%5.1" /end CHARACTERISTIC
/begin CHARACTERISTIC DFES_Cls.DFC_VSwVlvGovDvtMin_C "/" VALUE 0x80073C1E Val_Wu8 255.0 DFES_OneToOne 0.00 255.0 FORMAT "%5.1" /end CHARACTERISTIC
/begin CHARACTERISTIC DFES_Cls.DFC_VSwVlvOL_C "/" VALUE 0x80073C1F Val_Wu8 255.0 DFES_OneToOne 0.00 255.0 FORMAT "%5.1" /end CHARACTERISTIC
/begin CHARACTERISTIC DFES_Cls.DFC_VSwVlvSCB_C "/" VALUE 0x80073C20 Val_Wu8 255.0 DFES_OneToOne 0.00 255.0 FORMAT "%5.1" /end CHARACTERISTIC
/begin CHARACTERISTIC DFES_Cls.DFC_VSwVlvSCG_C "/" VALUE 0x80073C21 Val_Wu8 255.0 DFES_OneToOne 0.00 255.0 FORMAT "%5.1" /end CHARACTERISTIC
/begin CHARACTERISTIC DFES_Cls.DFC_VSwVlvSRCMax_C "/" VALUE 0x80073C22 Val_Wu8 255.0 DFES_OneToOne 0.00 255.0 FORMAT "%5.1" /end CHARACTERISTIC
/begin CHARACTERISTIC DFES_Cls.DFC_VSwVlvSRCMin_C "/" VALUE 0x80073C23 Val_Wu8 255.0 DFES_OneToOne 0.00 255.0 FORMAT "%5.1" /end CHARACTERISTIC
/begin CHARACTERISTIC DFES_Cls.DFC_VehVHW_C "/" VALUE 0x80073C24 Val_Wu8 255.0 DFES_OneToOne 0.00 255.0 FORMAT "%5.1" /end CHARACTERISTIC
/begin CHARACTERISTIC DFES_Cls.DFC_VehVMax_C "/" VALUE 0x80073C25 Val_Wu8 255.0 DFES_OneToOne 0.00 255.0 FORMAT "%5.1" /end CHARACTERISTIC
/begin CHARACTERISTIC DFES_Cls.DFC_VehVPlaus_C "/" VALUE 0x80073C26 Val_Wu8 255.0 DFES_OneToOne 0.00 255.0 FORMAT "%5.1" /end CHARACTERISTIC
/begin CHARACTERISTIC DFES_Cls.DFC_VehVSig_C "/" VALUE 0x80073C27 Val_Wu8 255.0 DFES_OneToOne 0.00 255.0 FORMAT "%5.1" /end CHARACTERISTIC
/begin CHARACTERISTIC DFES_Cls.DFC_WaHtElOL_C "/" VALUE 0x80073C28 Val_Wu8 255.0 DFES_OneToOne 0.00 255.0 FORMAT "%5.1" /end CHARACTERISTIC
/begin CHARACTERISTIC DFES_Cls.DFC_WaHtElSCB_C "/" VALUE 0x80073C29 Val_Wu8 255.0 DFES_OneToOne 0.00 255.0 FORMAT "%5.1" /end CHARACTERISTIC
/begin CHARACTERISTIC DFES_Cls.DFC_ClthNpl_C "/" VALUE 0x80073C2A Val_Wu8 255.0 DFES_OneToOne 0.00 255.0 FORMAT "%5.1" /end CHARACTERISTIC
/begin CHARACTERISTIC DFES_Cls.DFC_ETClbETMax_0_C "/" VALUE 0x80073C2B Val_Wu8 255.0 DFES_OneToOne 0.00 255.0 FORMAT "%5.1" /end CHARACTERISTIC
/begin CHARACTERISTIC DFES_Cls.DFC_ETClbETMax_1_C "/" VALUE 0x80073C2C Val_Wu8 255.0 DFES_OneToOne 0.00 255.0 FORMAT "%5.1" /end CHARACTERISTIC
/begin CHARACTERISTIC DFES_Cls.DFC_ETClbETMax_2_C "/" VALUE 0x80073C2D Val_Wu8 255.0 DFES_OneToOne 0.00 255.0 FORMAT "%5.1" /end CHARACTERISTIC
/begin CHARACTERISTIC DFES_Cls.DFC_ETClbETMax_3_C "/" VALUE 0x80073C2E Val_Wu8 255.0 DFES_OneToOne 0.00 255.0 FORMAT "%5.1" /end CHARACTERISTIC
/begin CHARACTERISTIC DFES_Cls.DFC_ETClbETMax_4_C "/" VALUE 0x80073C2F Val_Wu8 255.0 DFES_OneToOne 0.00 255.0 FORMAT "%5.1" /end CHARACTERISTIC
/begin CHARACTERISTIC DFES_Cls.DFC_ETClbETMax_5_C "/" VALUE 0x80073C30 Val_Wu8 255.0 DFES_OneToOne 0.00 255.0 FORMAT "%5.1" /end CHARACTERISTIC
/begin CHARACTERISTIC DFES_Cls.DFC_ETClbETMin_0_C "/" VALUE 0x80073C31 Val_Wu8 255.0 DFES_OneToOne 0.00 255.0 FORMAT "%5.1" /end CHARACTERISTIC
/begin CHARACTERISTIC DFES_Cls.DFC_ETClbETMin_1_C "/" VALUE 0x80073C32 Val_Wu8 255.0 DFES_OneToOne 0.00 255.0 FORMAT "%5.1" /end CHARACTERISTIC
/begin CHARACTERISTIC DFES_Cls.DFC_ETClbETMin_2_C "/" VALUE 0x80073C33 Val_Wu8 255.0 DFES_OneToOne 0.00 255.0 FORMAT "%5.1" /end CHARACTERISTIC
/begin CHARACTERISTIC DFES_Cls.DFC_ETClbETMin_3_C "/" VALUE 0x80073C34 Val_Wu8 255.0 DFES_OneToOne 0.00 255.0 FORMAT "%5.1" /end CHARACTERISTIC
/begin CHARACTERISTIC DFES_Cls.DFC_ETClbETMin_4_C "/" VALUE 0x80073C35 Val_Wu8 255.0 DFES_OneToOne 0.00 255.0 FORMAT "%5.1" /end CHARACTERISTIC
/begin CHARACTERISTIC DFES_Cls.DFC_ETClbETMin_5_C "/" VALUE 0x80073C36 Val_Wu8 255.0 DFES_OneToOne 0.00 255.0 FORMAT "%5.1" /end CHARACTERISTIC
/begin CHARACTERISTIC DFES_Cls.DFC_IVDiaBnkShCirBSH_0_C "/" VALUE 0x80073C37 Val_Wu8 255.0 DFES_OneToOne 0.00 255.0 FORMAT "%5.1" /end CHARACTERISTIC
/begin CHARACTERISTIC DFES_Cls.DFC_IVDiaBnkShCirBSH_1_C "/" VALUE 0x80073C38 Val_Wu8 255.0 DFES_OneToOne 0.00 255.0 FORMAT "%5.1" /end CHARACTERISTIC
/begin CHARACTERISTIC DFES_Cls.DFC_IVDiaBnkShCirChSwt_0_C "/" VALUE 0x80073C39 Val_Wu8 255.0 DFES_OneToOne 0.00 255.0 FORMAT "%5.1" /end CHARACTERISTIC
/begin CHARACTERISTIC DFES_Cls.DFC_IVDiaBnkShCirChSwt_1_C "/" VALUE 0x80073C3A Val_Wu8 255.0 DFES_OneToOne 0.00 255.0 FORMAT "%5.1" /end CHARACTERISTIC
/begin CHARACTERISTIC DFES_Cls.DFC_IVDiaBnkShCirHSBatt_0_C "/" VALUE 0x80073C3B Val_Wu8 255.0 DFES_OneToOne 0.00 255.0 FORMAT "%5.1" /end CHARACTERISTIC
/begin CHARACTERISTIC DFES_Cls.DFC_IVDiaBnkShCirHSBatt_1_C "/" VALUE 0x80073C3C Val_Wu8 255.0 DFES_OneToOne 0.00 255.0 FORMAT "%5.1" /end CHARACTERISTIC
/begin CHARACTERISTIC DFES_Cls.DFC_IVDiaBnkShCirHiRstnc_0_C "/" VALUE 0x80073C3D Val_Wu8 255.0 DFES_OneToOne 0.00 255.0 FORMAT "%5.1" /end CHARACTERISTIC
/begin CHARACTERISTIC DFES_Cls.DFC_IVDiaBnkShCirHiRstnc_1_C "/" VALUE 0x80073C3E Val_Wu8 255.0 DFES_OneToOne 0.00 255.0 FORMAT "%5.1" /end CHARACTERISTIC
/begin CHARACTERISTIC DFES_Cls.DFC_IVDiaBnkShCirLSHSGnd_0_C "/" VALUE 0x80073C3F Val_Wu8 255.0 DFES_OneToOne 0.00 255.0 FORMAT "%5.1" /end CHARACTERISTIC
/begin CHARACTERISTIC DFES_Cls.DFC_IVDiaBnkShCirLSHSGnd_1_C "/" VALUE 0x80073C40 Val_Wu8 255.0 DFES_OneToOne 0.00 255.0 FORMAT "%5.1" /end CHARACTERISTIC
/begin CHARACTERISTIC DFES_Cls.DFC_IVDiaBnkShCirTransfer_0_C "/" VALUE 0x80073C41 Val_Wu8 255.0 DFES_OneToOne 0.00 255.0 FORMAT "%5.1" /end CHARACTERISTIC
/begin CHARACTERISTIC DFES_Cls.DFC_IVDiaBnkShCirTransfer_1_C "/" VALUE 0x80073C42 Val_Wu8 255.0 DFES_OneToOne 0.00 255.0 FORMAT "%5.1" /end CHARACTERISTIC
/begin CHARACTERISTIC DFES_Cls.DFC_IVDiaCylNoCls_0_C "/" VALUE 0x80073C43 Val_Wu8 255.0 DFES_OneToOne 0.00 255.0 FORMAT "%5.1" /end CHARACTERISTIC
/begin CHARACTERISTIC DFES_Cls.DFC_IVDiaCylNoCls_1_C "/" VALUE 0x80073C44 Val_Wu8 255.0 DFES_OneToOne 0.00 255.0 FORMAT "%5.1" /end CHARACTERISTIC
/begin CHARACTERISTIC DFES_Cls.DFC_IVDiaCylNoCls_2_C "/" VALUE 0x80073C45 Val_Wu8 255.0 DFES_OneToOne 0.00 255.0 FORMAT "%5.1" /end CHARACTERISTIC
/begin CHARACTERISTIC DFES_Cls.DFC_IVDiaCylNoCls_3_C "/" VALUE 0x80073C46 Val_Wu8 255.0 DFES_OneToOne 0.00 255.0 FORMAT "%5.1" /end CHARACTERISTIC
/begin CHARACTERISTIC DFES_Cls.DFC_IVDiaCylNoCls_4_C "/" VALUE 0x80073C47 Val_Wu8 255.0 DFES_OneToOne 0.00 255.0 FORMAT "%5.1" /end CHARACTERISTIC
/begin CHARACTERISTIC DFES_Cls.DFC_IVDiaCylNoCls_5_C "/" VALUE 0x80073C48 Val_Wu8 255.0 DFES_OneToOne 0.00 255.0 FORMAT "%5.1" /end CHARACTERISTIC
/begin CHARACTERISTIC DFES_Cls.DFC_IVDiaCylNoLd_0_C "/" VALUE 0x80073C49 Val_Wu8 255.0 DFES_OneToOne 0.00 255.0 FORMAT "%5.1" /end CHARACTERISTIC
/begin CHARACTERISTIC DFES_Cls.DFC_IVDiaCylNoLd_1_C "/" VALUE 0x80073C4A Val_Wu8 255.0 DFES_OneToOne 0.00 255.0 FORMAT "%5.1" /end CHARACTERISTIC
/begin CHARACTERISTIC DFES_Cls.DFC_IVDiaCylNoLd_2_C "/" VALUE 0x80073C4B Val_Wu8 255.0 DFES_OneToOne 0.00 255.0 FORMAT "%5.1" /end CHARACTERISTIC
/begin CHARACTERISTIC DFES_Cls.DFC_IVDiaCylNoLd_3_C "/" VALUE 0x80073C4C Val_Wu8 255.0 DFES_OneToOne 0.00 255.0 FORMAT "%5.1" /end CHARACTERISTIC
/begin CHARACTERISTIC DFES_Cls.DFC_IVDiaCylNoLd_4_C "/" VALUE 0x80073C4D Val_Wu8 255.0 DFES_OneToOne 0.00 255.0 FORMAT "%5.1" /end CHARACTERISTIC
/begin CHARACTERISTIC DFES_Cls.DFC_IVDiaCylNoLd_5_C "/" VALUE 0x80073C4E Val_Wu8 255.0 DFES_OneToOne 0.00 255.0 FORMAT "%5.1" /end CHARACTERISTIC
/begin CHARACTERISTIC DFES_Cls.DFC_IVDiaCylShCirHiRstnc_0_C "/" VALUE 0x80073C4F Val_Wu8 255.0 DFES_OneToOne 0.00 255.0 FORMAT "%5.1" /end CHARACTERISTIC
/begin CHARACTERISTIC DFES_Cls.DFC_IVDiaCylShCirHiRstnc_1_C "/" VALUE 0x80073C50 Val_Wu8 255.0 DFES_OneToOne 0.00 255.0 FORMAT "%5.1" /end CHARACTERISTIC
/begin CHARACTERISTIC DFES_Cls.DFC_IVDiaCylShCirHiRstnc_2_C "/" VALUE 0x80073C51 Val_Wu8 255.0 DFES_OneToOne 0.00 255.0 FORMAT "%5.1" /end CHARACTERISTIC
/begin CHARACTERISTIC DFES_Cls.DFC_IVDiaCylShCirHiRstnc_3_C "/" VALUE 0x80073C52 Val_Wu8 255.0 DFES_OneToOne 0.00 255.0 FORMAT "%5.1" /end CHARACTERISTIC
/begin CHARACTERISTIC DFES_Cls.DFC_IVDiaCylShCirHiRstnc_4_C "/" VALUE 0x80073C53 Val_Wu8 255.0 DFES_OneToOne 0.00 255.0 FORMAT "%5.1" /end CHARACTERISTIC
/begin CHARACTERISTIC DFES_Cls.DFC_IVDiaCylShCirHiRstnc_5_C "/" VALUE 0x80073C54 Val_Wu8 255.0 DFES_OneToOne 0.00 255.0 FORMAT "%5.1" /end CHARACTERISTIC
/begin CHARACTERISTIC DFES_Cls.DFC_IVDiaCylShCirLSBatt_0_C "/" VALUE 0x80073C55 Val_Wu8 255.0 DFES_OneToOne 0.00 255.0 FORMAT "%5.1" /end CHARACTERISTIC
/begin CHARACTERISTIC DFES_Cls.DFC_IVDiaCylShCirLSBatt_1_C "/" VALUE 0x80073C56 Val_Wu8 255.0 DFES_OneToOne 0.00 255.0 FORMAT "%5.1" /end CHARACTERISTIC
/begin CHARACTERISTIC DFES_Cls.DFC_IVDiaCylShCirLSBatt_2_C "/" VALUE 0x80073C57 Val_Wu8 255.0 DFES_OneToOne 0.00 255.0 FORMAT "%5.1" /end CHARACTERISTIC
/begin CHARACTERISTIC DFES_Cls.DFC_IVDiaCylShCirLSBatt_3_C "/" VALUE 0x80073C58 Val_Wu8 255.0 DFES_OneToOne 0.00 255.0 FORMAT "%5.1" /end CHARACTERISTIC
/begin CHARACTERISTIC DFES_Cls.DFC_IVDiaCylShCirLSBatt_4_C "/" VALUE 0x80073C59 Val_Wu8 255.0 DFES_OneToOne 0.00 255.0 FORMAT "%5.1" /end CHARACTERISTIC
/begin CHARACTERISTIC DFES_Cls.DFC_IVDiaCylShCirLSBatt_5_C "/" VALUE 0x80073C5A Val_Wu8 255.0 DFES_OneToOne 0.00 255.0 FORMAT "%5.1" /end CHARACTERISTIC
/begin CHARACTERISTIC DFES_Cls.DFC_IVDiaCylShCirLSHS_0_C "/" VALUE 0x80073C5B Val_Wu8 255.0 DFES_OneToOne 0.00 255.0 FORMAT "%5.1" /end CHARACTERISTIC
/begin CHARACTERISTIC DFES_Cls.DFC_IVDiaCylShCirLSHS_1_C "/" VALUE 0x80073C5C Val_Wu8 255.0 DFES_OneToOne 0.00 255.0 FORMAT "%5.1" /end CHARACTERISTIC
/begin CHARACTERISTIC DFES_Cls.DFC_IVDiaCylShCirLSHS_2_C "/" VALUE 0x80073C5D Val_Wu8 255.0 DFES_OneToOne 0.00 255.0 FORMAT "%5.1" /end CHARACTERISTIC
/begin CHARACTERISTIC DFES_Cls.DFC_IVDiaCylShCirLSHS_3_C "/" VALUE 0x80073C5E Val_Wu8 255.0 DFES_OneToOne 0.00 255.0 FORMAT "%5.1" /end CHARACTERISTIC
/begin CHARACTERISTIC DFES_Cls.DFC_IVDiaCylShCirLSHS_4_C "/" VALUE 0x80073C5F Val_Wu8 255.0 DFES_OneToOne 0.00 255.0 FORMAT "%5.1" /end CHARACTERISTIC
/begin CHARACTERISTIC DFES_Cls.DFC_IVDiaCylShCirLSHS_5_C "/" VALUE 0x80073C60 Val_Wu8 255.0 DFES_OneToOne 0.00 255.0 FORMAT "%5.1" /end CHARACTERISTIC
/begin CHARACTERISTIC DFES_Cls.DFC_IVDiaCylShCirLsLs_0_C "/" VALUE 0x80073C61 Val_Wu8 255.0 DFES_OneToOne 0.00 255.0 FORMAT "%5.1" /end CHARACTERISTIC
/begin CHARACTERISTIC DFES_Cls.DFC_IVDiaCylShCirLsLs_1_C "/" VALUE 0x80073C62 Val_Wu8 255.0 DFES_OneToOne 0.00 255.0 FORMAT "%5.1" /end CHARACTERISTIC
/begin CHARACTERISTIC DFES_Cls.DFC_IVDiaCylShCirLsLs_2_C "/" VALUE 0x80073C63 Val_Wu8 255.0 DFES_OneToOne 0.00 255.0 FORMAT "%5.1" /end CHARACTERISTIC
/begin CHARACTERISTIC DFES_Cls.DFC_IVDiaCylShCirLsLs_3_C "/" VALUE 0x80073C64 Val_Wu8 255.0 DFES_OneToOne 0.00 255.0 FORMAT "%5.1" /end CHARACTERISTIC
/begin CHARACTERISTIC DFES_Cls.DFC_IVDiaCylShCirLsLs_4_C "/" VALUE 0x80073C65 Val_Wu8 255.0 DFES_OneToOne 0.00 255.0 FORMAT "%5.1" /end CHARACTERISTIC
/begin CHARACTERISTIC DFES_Cls.DFC_IVDiaCylShCirLsLs_5_C "/" VALUE 0x80073C66 Val_Wu8 255.0 DFES_OneToOne 0.00 255.0 FORMAT "%5.1" /end CHARACTERISTIC
/begin CHARACTERISTIC DFES_Cls.DFC_IVDiaSPICfg_C "/" VALUE 0x80073C67 Val_Wu8 255.0 DFES_OneToOne 0.00 255.0 FORMAT "%5.1" /end CHARACTERISTIC
/begin CHARACTERISTIC DFES_Cls.DFC_IVDiaSPIColl_C "/" VALUE 0x80073C68 Val_Wu8 255.0 DFES_OneToOne 0.00 255.0 FORMAT "%5.1" /end CHARACTERISTIC
/begin CHARACTERISTIC DFES_Cls.DFC_IVDiaSPICtrl_C "/" VALUE 0x80073C69 Val_Wu8 255.0 DFES_OneToOne 0.00 255.0 FORMAT "%5.1" /end CHARACTERISTIC
/begin CHARACTERISTIC DFES_Cls.DFC_IVDiaSPIRam_C "/" VALUE 0x80073C6A Val_Wu8 255.0 DFES_OneToOne 0.00 255.0 FORMAT "%5.1" /end CHARACTERISTIC
/begin CHARACTERISTIC DFES_Cls.DFC_IVDiaSPITrans_C "/" VALUE 0x80073C6B Val_Wu8 255.0 DFES_OneToOne 0.00 255.0 FORMAT "%5.1" /end CHARACTERISTIC
/begin CHARACTERISTIC DFES_Cls.DFC_LSUCmpChk_0_C "/" VALUE 0x80073C6C Val_Wu8 255.0 DFES_OneToOne 0.00 255.0 FORMAT "%5.1" /end CHARACTERISTIC
/begin CHARACTERISTIC DFES_Cls.DFC_LSUCmpChk_1_C "/" VALUE 0x80073C6D Val_Wu8 255.0 DFES_OneToOne 0.00 255.0 FORMAT "%5.1" /end CHARACTERISTIC
/begin CHARACTERISTIC DFES_Cls.DFC_LSUCmpChk_2_C "/" VALUE 0x80073C6E Val_Wu8 255.0 DFES_OneToOne 0.00 255.0 FORMAT "%5.1" /end CHARACTERISTIC
/begin CHARACTERISTIC DFES_Cls.DFC_LSUCmpChk_3_C "/" VALUE 0x80073C6F Val_Wu8 255.0 DFES_OneToOne 0.00 255.0 FORMAT "%5.1" /end CHARACTERISTIC
/begin CHARACTERISTIC DFES_Cls.DFC_LSUCmpChk_4_C "/" VALUE 0x80073C70 Val_Wu8 255.0 DFES_OneToOne 0.00 255.0 FORMAT "%5.1" /end CHARACTERISTIC
/begin CHARACTERISTIC DFES_Cls.DFC_LSUCmpChk_5_C "/" VALUE 0x80073C71 Val_Wu8 255.0 DFES_OneToOne 0.00 255.0 FORMAT "%5.1" /end CHARACTERISTIC
/begin CHARACTERISTIC DFES_Cls.DFC_LSUDynChk_0_C "/" VALUE 0x80073C72 Val_Wu8 255.0 DFES_OneToOne 0.00 255.0 FORMAT "%5.1" /end CHARACTERISTIC
/begin CHARACTERISTIC DFES_Cls.DFC_LSUDynChk_1_C "/" VALUE 0x80073C73 Val_Wu8 255.0 DFES_OneToOne 0.00 255.0 FORMAT "%5.1" /end CHARACTERISTIC
/begin CHARACTERISTIC DFES_Cls.DFC_LSUDynChk_2_C "/" VALUE 0x80073C74 Val_Wu8 255.0 DFES_OneToOne 0.00 255.0 FORMAT "%5.1" /end CHARACTERISTIC
/begin CHARACTERISTIC DFES_Cls.DFC_LSUDynChk_3_C "/" VALUE 0x80073C75 Val_Wu8 255.0 DFES_OneToOne 0.00 255.0 FORMAT "%5.1" /end CHARACTERISTIC
/begin CHARACTERISTIC DFES_Cls.DFC_LSUO2ClbMax_0_C "/" VALUE 0x80073C76 Val_Wu8 255.0 DFES_OneToOne 0.00 255.0 FORMAT "%5.1" /end CHARACTERISTIC
/begin CHARACTERISTIC DFES_Cls.DFC_LSUO2ClbMax_1_C "/" VALUE 0x80073C77 Val_Wu8 255.0 DFES_OneToOne 0.00 255.0 FORMAT "%5.1" /end CHARACTERISTIC
/begin CHARACTERISTIC DFES_Cls.DFC_LSUO2ClbMax_2_C "/" VALUE 0x80073C78 Val_Wu8 255.0 DFES_OneToOne 0.00 255.0 FORMAT "%5.1" /end CHARACTERISTIC
/begin CHARACTERISTIC DFES_Cls.DFC_LSUO2ClbMax_3_C "/" VALUE 0x80073C79 Val_Wu8 255.0 DFES_OneToOne 0.00 255.0 FORMAT "%5.1" /end CHARACTERISTIC
/begin CHARACTERISTIC DFES_Cls.DFC_LSUO2ClbMin_0_C "/" VALUE 0x80073C7A Val_Wu8 255.0 DFES_OneToOne 0.00 255.0 FORMAT "%5.1" /end CHARACTERISTIC
/begin CHARACTERISTIC DFES_Cls.DFC_LSUO2ClbMin_1_C "/" VALUE 0x80073C7B Val_Wu8 255.0 DFES_OneToOne 0.00 255.0 FORMAT "%5.1" /end CHARACTERISTIC
/begin CHARACTERISTIC DFES_Cls.DFC_LSUO2ClbMin_2_C "/" VALUE 0x80073C7C Val_Wu8 255.0 DFES_OneToOne 0.00 255.0 FORMAT "%5.1" /end CHARACTERISTIC
/begin CHARACTERISTIC DFES_Cls.DFC_LSUO2ClbMin_3_C "/" VALUE 0x80073C7D Val_Wu8 255.0 DFES_OneToOne 0.00 255.0 FORMAT "%5.1" /end CHARACTERISTIC
/begin CHARACTERISTIC DFES_Cls.DFC_LSUO2PlausMax_0_C "/" VALUE 0x80073C7E Val_Wu8 255.0 DFES_OneToOne 0.00 255.0 FORMAT "%5.1" /end CHARACTERISTIC
/begin CHARACTERISTIC DFES_Cls.DFC_LSUO2PlausMax_1_C "/" VALUE 0x80073C7F Val_Wu8 255.0 DFES_OneToOne 0.00 255.0 FORMAT "%5.1" /end CHARACTERISTIC
/begin CHARACTERISTIC DFES_Cls.DFC_LSUO2PlausMax_2_C "/" VALUE 0x80073C80 Val_Wu8 255.0 DFES_OneToOne 0.00 255.0 FORMAT "%5.1" /end CHARACTERISTIC
/begin CHARACTERISTIC DFES_Cls.DFC_LSUO2PlausMax_3_C "/" VALUE 0x80073C81 Val_Wu8 255.0 DFES_OneToOne 0.00 255.0 FORMAT "%5.1" /end CHARACTERISTIC
/begin CHARACTERISTIC DFES_Cls.DFC_LSUO2PlausMin_0_C "/" VALUE 0x80073C82 Val_Wu8 255.0 DFES_OneToOne 0.00 255.0 FORMAT "%5.1" /end CHARACTERISTIC
/begin CHARACTERISTIC DFES_Cls.DFC_LSUO2PlausMin_1_C "/" VALUE 0x80073C83 Val_Wu8 255.0 DFES_OneToOne 0.00 255.0 FORMAT "%5.1" /end CHARACTERISTIC
/begin CHARACTERISTIC DFES_Cls.DFC_LSUO2PlausMin_2_C "/" VALUE 0x80073C84 Val_Wu8 255.0 DFES_OneToOne 0.00 255.0 FORMAT "%5.1" /end CHARACTERISTIC
/begin CHARACTERISTIC DFES_Cls.DFC_LSUO2PlausMin_3_C "/" VALUE 0x80073C85 Val_Wu8 255.0 DFES_OneToOne 0.00 255.0 FORMAT "%5.1" /end CHARACTERISTIC
/begin CHARACTERISTIC DFES_Cls.DFC_LSURiClbMax_0_C "/" VALUE 0x80073C86 Val_Wu8 255.0 DFES_OneToOne 0.00 255.0 FORMAT "%5.1" /end CHARACTERISTIC
/begin CHARACTERISTIC DFES_Cls.DFC_LSURiClbMax_1_C "/" VALUE 0x80073C87 Val_Wu8 255.0 DFES_OneToOne 0.00 255.0 FORMAT "%5.1" /end CHARACTERISTIC
/begin CHARACTERISTIC DFES_Cls.DFC_LSURiClbMax_2_C "/" VALUE 0x80073C88 Val_Wu8 255.0 DFES_OneToOne 0.00 255.0 FORMAT "%5.1" /end CHARACTERISTIC
/begin CHARACTERISTIC DFES_Cls.DFC_LSURiClbMax_3_C "/" VALUE 0x80073C89 Val_Wu8 255.0 DFES_OneToOne 0.00 255.0 FORMAT "%5.1" /end CHARACTERISTIC
/begin CHARACTERISTIC DFES_Cls.DFC_LSURiClbMin_0_C "/" VALUE 0x80073C8A Val_Wu8 255.0 DFES_OneToOne 0.00 255.0 FORMAT "%5.1" /end CHARACTERISTIC
/begin CHARACTERISTIC DFES_Cls.DFC_LSURiClbMin_1_C "/" VALUE 0x80073C8B Val_Wu8 255.0 DFES_OneToOne 0.00 255.0 FORMAT "%5.1" /end CHARACTERISTIC
/begin CHARACTERISTIC DFES_Cls.DFC_LSURiClbMin_2_C "/" VALUE 0x80073C8C Val_Wu8 255.0 DFES_OneToOne 0.00 255.0 FORMAT "%5.1" /end CHARACTERISTIC
/begin CHARACTERISTIC DFES_Cls.DFC_LSURiClbMin_3_C "/" VALUE 0x80073C8D Val_Wu8 255.0 DFES_OneToOne 0.00 255.0 FORMAT "%5.1" /end CHARACTERISTIC
/begin CHARACTERISTIC DFES_Cls.DFC_LSUWireIPSig_0_C "/" VALUE 0x80073C8E Val_Wu8 255.0 DFES_OneToOne 0.00 255.0 FORMAT "%5.1" /end CHARACTERISTIC
/begin CHARACTERISTIC DFES_Cls.DFC_LSUWireIPSig_1_C "/" VALUE 0x80073C8F Val_Wu8 255.0 DFES_OneToOne 0.00 255.0 FORMAT "%5.1" /end CHARACTERISTIC
/begin CHARACTERISTIC DFES_Cls.DFC_LSUWireIPSig_2_C "/" VALUE 0x80073C90 Val_Wu8 255.0 DFES_OneToOne 0.00 255.0 FORMAT "%5.1" /end CHARACTERISTIC
/begin CHARACTERISTIC DFES_Cls.DFC_LSUWireIPSig_3_C "/" VALUE 0x80073C91 Val_Wu8 255.0 DFES_OneToOne 0.00 255.0 FORMAT "%5.1" /end CHARACTERISTIC
/begin CHARACTERISTIC DFES_Cls.DFC_AFSDrftIdlAdjVal_C "/" VALUE 0x80073C92 Val_Wu8 255.0 DFES_OneToOne 0.00 255.0 FORMAT "%5.1" /end CHARACTERISTIC
/begin CHARACTERISTIC DFES_Cls.DFC_AFSDrftLdAdjVal_C "/" VALUE 0x80073C93 Val_Wu8 255.0 DFES_OneToOne 0.00 255.0 FORMAT "%5.1" /end CHARACTERISTIC
/begin CHARACTERISTIC DFES_Cls.DFC_AdcI_ADC0_Cal_C "/" VALUE 0x80073C94 Val_Wu8 255.0 DFES_OneToOne 0.00 255.0 FORMAT "%5.1" /end CHARACTERISTIC
/begin CHARACTERISTIC DFES_Cls.DFC_AdcI_ADC0_Conv_C "/" VALUE 0x80073C95 Val_Wu8 255.0 DFES_OneToOne 0.00 255.0 FORMAT "%5.1" /end CHARACTERISTIC
/begin CHARACTERISTIC DFES_Cls.DFC_CmbChbMisfireMax_0_C "/" VALUE 0x80073C96 Val_Wu8 255.0 DFES_OneToOne 0.00 255.0 FORMAT "%5.1" /end CHARACTERISTIC
/begin CHARACTERISTIC DFES_Cls.DFC_CmbChbMisfireMax_1_C "/" VALUE 0x80073C97 Val_Wu8 255.0 DFES_OneToOne 0.00 255.0 FORMAT "%5.1" /end CHARACTERISTIC
/begin CHARACTERISTIC DFES_Cls.DFC_CmbChbMisfireMax_2_C "/" VALUE 0x80073C98 Val_Wu8 255.0 DFES_OneToOne 0.00 255.0 FORMAT "%5.1" /end CHARACTERISTIC
/begin CHARACTERISTIC DFES_Cls.DFC_CmbChbMisfireMax_3_C "/" VALUE 0x80073C99 Val_Wu8 255.0 DFES_OneToOne 0.00 255.0 FORMAT "%5.1" /end CHARACTERISTIC
/begin CHARACTERISTIC DFES_Cls.DFC_CmbChbMisfireMax_4_C "/" VALUE 0x80073C9A Val_Wu8 255.0 DFES_OneToOne 0.00 255.0 FORMAT "%5.1" /end CHARACTERISTIC
/begin CHARACTERISTIC DFES_Cls.DFC_CmbChbMisfireMax_5_C "/" VALUE 0x80073C9B Val_Wu8 255.0 DFES_OneToOne 0.00 255.0 FORMAT "%5.1" /end CHARACTERISTIC
/begin CHARACTERISTIC DFES_Cls.DFC_CmbChbMisfireMul_C "/" VALUE 0x80073C9C Val_Wu8 255.0 DFES_OneToOne 0.00 255.0 FORMAT "%5.1" /end CHARACTERISTIC
/begin CHARACTERISTIC DFES_Cls.DFC_INJVLVBUSY_C "/" VALUE 0x80073C9D Val_Wu8 255.0 DFES_OneToOne 0.00 255.0 FORMAT "%5.1" /end CHARACTERISTIC
/begin CHARACTERISTIC DFES_Cls.DFC_IVAdjIVA_0_C "/" VALUE 0x80073C9E Val_Wu8 255.0 DFES_OneToOne 0.00 255.0 FORMAT "%5.1" /end CHARACTERISTIC
/begin CHARACTERISTIC DFES_Cls.DFC_IVAdjIVA_1_C "/" VALUE 0x80073C9F Val_Wu8 255.0 DFES_OneToOne 0.00 255.0 FORMAT "%5.1" /end CHARACTERISTIC
/begin CHARACTERISTIC DFES_Cls.DFC_IVAdjIVA_2_C "/" VALUE 0x80073CA0 Val_Wu8 255.0 DFES_OneToOne 0.00 255.0 FORMAT "%5.1" /end CHARACTERISTIC
/begin CHARACTERISTIC DFES_Cls.DFC_IVAdjIVA_3_C "/" VALUE 0x80073CA1 Val_Wu8 255.0 DFES_OneToOne 0.00 255.0 FORMAT "%5.1" /end CHARACTERISTIC
/begin CHARACTERISTIC DFES_Cls.DFC_IVAdjIVA_4_C "/" VALUE 0x80073CA2 Val_Wu8 255.0 DFES_OneToOne 0.00 255.0 FORMAT "%5.1" /end CHARACTERISTIC
/begin CHARACTERISTIC DFES_Cls.DFC_IVAdjIVA_5_C "/" VALUE 0x80073CA3 Val_Wu8 255.0 DFES_OneToOne 0.00 255.0 FORMAT "%5.1" /end CHARACTERISTIC
/begin CHARACTERISTIC DFES_Cls.DFC_InjCtlAdjQntEEPCS_C "/" VALUE 0x80073CA4 Val_Wu8 255.0 DFES_OneToOne 0.00 255.0 FORMAT "%5.1" /end CHARACTERISTIC
/begin CHARACTERISTIC DFES_Cls.DFC_InjCtlDriftEEPCS_C "/" VALUE 0x80073CA5 Val_Wu8 255.0 DFES_OneToOne 0.00 255.0 FORMAT "%5.1" /end CHARACTERISTIC
/begin CHARACTERISTIC DFES_Cls.DFC_MRlyErlyOpng_C "/" VALUE 0x80073CA6 Val_Wu8 255.0 DFES_OneToOne 0.00 255.0 FORMAT "%5.1" /end CHARACTERISTIC
/begin CHARACTERISTIC DFES_Cls.DFC_MRlyStk_C "/" VALUE 0x80073CA7 Val_Wu8 255.0 DFES_OneToOne 0.00 255.0 FORMAT "%5.1" /end CHARACTERISTIC
/begin CHARACTERISTIC DFES_Cls.DFC_SensFrzPPFltUs_C "/" VALUE 0x80073CA8 Val_Wu8 255.0 DFES_OneToOne 0.00 255.0 FORMAT "%5.1" /end CHARACTERISTIC
/begin CHARACTERISTIC DFES_Cls.DFC_T15Sig_C "/" VALUE 0x80073CA9 Val_Wu8 255.0 DFES_OneToOne 0.00 255.0 FORMAT "%5.1" /end CHARACTERISTIC
/begin CHARACTERISTIC DFES_Cls.DFC_AirCtlRmpTOut_C "/" VALUE 0x80073CAA Val_Wu8 255.0 DFES_OneToOne 0.00 255.0 FORMAT "%5.1" /end CHARACTERISTIC
/begin CHARACTERISTIC DFES_Cls.DFC_CEngDsTDynTst_C "/" VALUE 0x80073CAB Val_Wu8 255.0 DFES_OneToOne 0.00 255.0 FORMAT "%5.1" /end CHARACTERISTIC
/begin CHARACTERISTIC DFES_Cls.DFC_EGRVlvJamVlvClsd_C "/" VALUE 0x80073CAC Val_Wu8 255.0 DFES_OneToOne 0.00 255.0 FORMAT "%5.1" /end CHARACTERISTIC
/begin CHARACTERISTIC DFES_Cls.DFC_EGRVlvJamVlvOpn_C "/" VALUE 0x80073CAD Val_Wu8 255.0 DFES_OneToOne 0.00 255.0 FORMAT "%5.1" /end CHARACTERISTIC
/begin CHARACTERISTIC DFES_Cls.DFC_EGRVlvLgTDrft_C "/" VALUE 0x80073CAE Val_Wu8 255.0 DFES_OneToOne 0.00 255.0 FORMAT "%5.1" /end CHARACTERISTIC
/begin CHARACTERISTIC DFES_Cls.DFC_EGRVlvOfsLrnJamVlv_C "/" VALUE 0x80073CAF Val_Wu8 255.0 DFES_OneToOne 0.00 255.0 FORMAT "%5.1" /end CHARACTERISTIC
/begin CHARACTERISTIC DFES_Cls.DFC_EGRVlvShTDrft_C "/" VALUE 0x80073CB0 Val_Wu8 255.0 DFES_OneToOne 0.00 255.0 FORMAT "%5.1" /end CHARACTERISTIC
/begin CHARACTERISTIC DFES_Cls.DFC_EGTRgnOilDilMax_C "/" VALUE 0x80073CB1 Val_Wu8 255.0 DFES_OneToOne 0.00 255.0 FORMAT "%5.1" /end CHARACTERISTIC
/begin CHARACTERISTIC DFES_Cls.DFC_EngICO_C "/" VALUE 0x80073CB2 Val_Wu8 255.0 DFES_OneToOne 0.00 255.0 FORMAT "%5.1" /end CHARACTERISTIC
/begin CHARACTERISTIC DFES_Cls.DFC_EpmCaSI1ErrSig_C "/" VALUE 0x80073CB3 Val_Wu8 255.0 DFES_OneToOne 0.00 255.0 FORMAT "%5.1" /end CHARACTERISTIC
/begin CHARACTERISTIC DFES_Cls.DFC_EpmCaSI1NoSig_C "/" VALUE 0x80073CB4 Val_Wu8 255.0 DFES_OneToOne 0.00 255.0 FORMAT "%5.1" /end CHARACTERISTIC
/begin CHARACTERISTIC DFES_Cls.DFC_EpmCaSI1OfsErr_C "/" VALUE 0x80073CB5 Val_Wu8 255.0 DFES_OneToOne 0.00 255.0 FORMAT "%5.1" /end CHARACTERISTIC
/begin CHARACTERISTIC DFES_Cls.DFC_EpmCrSErrSig_C "/" VALUE 0x80073CB6 Val_Wu8 255.0 DFES_OneToOne 0.00 255.0 FORMAT "%5.1" /end CHARACTERISTIC
/begin CHARACTERISTIC DFES_Cls.DFC_EpmCrSNoSig_C "/" VALUE 0x80073CB7 Val_Wu8 255.0 DFES_OneToOne 0.00 255.0 FORMAT "%5.1" /end CHARACTERISTIC
/begin CHARACTERISTIC DFES_Cls.DFC_MoCADCCmp_C "/" VALUE 0x80073CB8 Val_Wu8 255.0 DFES_OneToOne 0.00 255.0 FORMAT "%5.1" /end CHARACTERISTIC
/begin CHARACTERISTIC DFES_Cls.DFC_MoCADCTst_C "/" VALUE 0x80073CB9 Val_Wu8 255.0 DFES_OneToOne 0.00 255.0 FORMAT "%5.1" /end CHARACTERISTIC
/begin CHARACTERISTIC DFES_Cls.DFC_MoCADCVltgRatio_C "/" VALUE 0x80073CBA Val_Wu8 255.0 DFES_OneToOne 0.00 255.0 FORMAT "%5.1" /end CHARACTERISTIC
/begin CHARACTERISTIC DFES_Cls.DFC_MoCSOPLoLi_C "/" VALUE 0x80073CBB Val_Wu8 255.0 DFES_OneToOne 0.00 255.0 FORMAT "%5.1" /end CHARACTERISTIC
/begin CHARACTERISTIC DFES_Cls.DFC_MoCSOPMM_C "/" VALUE 0x80073CBC Val_Wu8 255.0 DFES_OneToOne 0.00 255.0 FORMAT "%5.1" /end CHARACTERISTIC
/begin CHARACTERISTIC DFES_Cls.DFC_MoCSOPTimeOut_C "/" VALUE 0x80073CBD Val_Wu8 255.0 DFES_OneToOne 0.00 255.0 FORMAT "%5.1" /end CHARACTERISTIC
/begin CHARACTERISTIC DFES_Cls.DFC_MoCSOPUpLi_C "/" VALUE 0x80073CBE Val_Wu8 255.0 DFES_OneToOne 0.00 255.0 FORMAT "%5.1" /end CHARACTERISTIC
/begin CHARACTERISTIC DFES_Cls.DFC_MoFAPP_C "/" VALUE 0x80073CBF Val_Wu8 255.0 DFES_OneToOne 0.00 255.0 FORMAT "%5.1" /end CHARACTERISTIC
/begin CHARACTERISTIC DFES_Cls.DFC_MoFESpd_C "/" VALUE 0x80073CC0 Val_Wu8 255.0 DFES_OneToOne 0.00 255.0 FORMAT "%5.1" /end CHARACTERISTIC
/begin CHARACTERISTIC DFES_Cls.DFC_MoFInjDatPhi_C "/" VALUE 0x80073CC1 Val_Wu8 255.0 DFES_OneToOne 0.00 255.0 FORMAT "%5.1" /end CHARACTERISTIC
/begin CHARACTERISTIC DFES_Cls.DFC_MoFInjDatQnt_C "/" VALUE 0x80073CC2 Val_Wu8 255.0 DFES_OneToOne 0.00 255.0 FORMAT "%5.1" /end CHARACTERISTIC
/begin CHARACTERISTIC DFES_Cls.DFC_MoFInjQnt_C "/" VALUE 0x80073CC3 Val_Wu8 255.0 DFES_OneToOne 0.00 255.0 FORMAT "%5.1" /end CHARACTERISTIC
/begin CHARACTERISTIC DFES_Cls.DFC_MoFOvR_C "/" VALUE 0x80073CC4 Val_Wu8 255.0 DFES_OneToOne 0.00 255.0 FORMAT "%5.1" /end CHARACTERISTIC
/begin CHARACTERISTIC DFES_Cls.DFC_MoFQntCor_C "/" VALUE 0x80073CC5 Val_Wu8 255.0 DFES_OneToOne 0.00 255.0 FORMAT "%5.1" /end CHARACTERISTIC
/begin CHARACTERISTIC DFES_Cls.DFC_MoFTrqCmp_C "/" VALUE 0x80073CC6 Val_Wu8 255.0 DFES_OneToOne 0.00 255.0 FORMAT "%5.1" /end CHARACTERISTIC
/begin CHARACTERISTIC DFES_Cls.DFC_NplTOxiCatUs_C "/" VALUE 0x80073CC7 Val_Wu8 255.0 DFES_OneToOne 0.00 255.0 FORMAT "%5.1" /end CHARACTERISTIC
/begin CHARACTERISTIC DFES_Cls.DFC_PhyModNonMonMapNpl_C "/" VALUE 0x80073CC8 Val_Wu8 255.0 DFES_OneToOne 0.00 255.0 FORMAT "%5.1" /end CHARACTERISTIC
/begin CHARACTERISTIC DFES_Cls.DFC_RailPOfsTstMax_C "/" VALUE 0x80073CC9 Val_Wu8 255.0 DFES_OneToOne 0.00 255.0 FORMAT "%5.1" /end CHARACTERISTIC
/begin CHARACTERISTIC DFES_Cls.DFC_RailPOfsTstMin_C "/" VALUE 0x80073CCA Val_Wu8 255.0 DFES_OneToOne 0.00 255.0 FORMAT "%5.1" /end CHARACTERISTIC
/begin CHARACTERISTIC DFES_Cls.DFC_SWReset_0_C "/" VALUE 0x80073CCB Val_Wu8 255.0 DFES_OneToOne 0.00 255.0 FORMAT "%5.1" /end CHARACTERISTIC
/begin CHARACTERISTIC DFES_Cls.DFC_SWReset_1_C "/" VALUE 0x80073CCC Val_Wu8 255.0 DFES_OneToOne 0.00 255.0 FORMAT "%5.1" /end CHARACTERISTIC
/begin CHARACTERISTIC DFES_Cls.DFC_SWReset_2_C "/" VALUE 0x80073CCD Val_Wu8 255.0 DFES_OneToOne 0.00 255.0 FORMAT "%5.1" /end CHARACTERISTIC
/begin CHARACTERISTIC DFES_Cls.DFC_VSwVlvJamVlv_C "/" VALUE 0x80073CCE Val_Wu8 255.0 DFES_OneToOne 0.00 255.0 FORMAT "%5.1" /end CHARACTERISTIC
/begin CHARACTERISTIC DFES_Cls.DFC_VSwVlvLgTDrft_C "/" VALUE 0x80073CCF Val_Wu8 255.0 DFES_OneToOne 0.00 255.0 FORMAT "%5.1" /end CHARACTERISTIC
/begin CHARACTERISTIC DFES_Cls.DFC_VSwVlvOfsLrnJamVlv_C "/" VALUE 0x80073CD0 Val_Wu8 255.0 DFES_OneToOne 0.00 255.0 FORMAT "%5.1" /end CHARACTERISTIC
/begin CHARACTERISTIC DFES_Cls.DFC_VSwVlvShTDrft_C "/" VALUE 0x80073CD1 Val_Wu8 255.0 DFES_OneToOne 0.00 255.0 FORMAT "%5.1" /end CHARACTERISTIC
/begin FUNCTION dfes_class_auto ""
 /begin DEF_CHARACTERISTIC DFES_Cls.DFC_AirCtlGovDvtEOMMax_C DFES_Cls.DFC_AirCtlGovDvtEOMMin_C DFES_Cls.DFC_AirCtlGovDvtMax_C DFES_Cls.DFC_AirCtlGovDvtMin_C DFES_Cls.DFC_Cj945SpiCom1_C DFES_Cls.DFC_ComButtonMSASig_C DFES_Cls.DFC_ComButtonMSATo_C DFES_Cls.DFC_ComGearboxData2Sig_C DFES_Cls.DFC_ComGearboxData2To_C DFES_Cls.DFC_ComGearboxDataSig_C DFES_Cls.DFC_ComGearboxDataTo_C DFES_Cls.DFC_ComHeatACSig_C DFES_Cls.DFC_ComHeatACTo_C DFES_Cls.DFC_ComLenkradwinkelSig_C DFES_Cls.DFC_ComLenkradwinkelTo_C DFES_Cls.DFC_ComMileageRangeSig_C DFES_Cls.DFC_ComMileageRangeTo_C DFES_Cls.DFC_ComPspSig_C DFES_Cls.DFC_ComPspTo_C DFES_Cls.DFC_ComShutOffPSPSig_C DFES_Cls.DFC_ComShutOffPSPTo_C DFES_Cls.DFC_ComStKombiCtr_C DFES_Cls.DFC_ComStKombiSig_C DFES_Cls.DFC_ComStKombiTo_C DFES_Cls.DFC_ComStateARSCtr_C DFES_Cls.DFC_ComStateARSSig_C DFES_Cls.DFC_ComStateARSTo_C DFES_Cls.DFC_ComStateDscSig_C DFES_Cls.DFC_ComStateDscTo_C DFES_Cls.DFC_ComStateSeatSig_C DFES_Cls.DFC_ComStateSeatTo_C DFES_Cls.DFC_ComTempRelTimeSig_C DFES_Cls.DFC_ComTempRelTimeTo_C DFES_Cls.DFC_ComTerminalChk_C DFES_Cls.DFC_ComTerminalCtr_C DFES_Cls.DFC_ComTerminalSig_C DFES_Cls.DFC_ComTerminalTo_C DFES_Cls.DFC_ComTimeDateSig_C DFES_Cls.DFC_ComTimeDateTo_C DFES_Cls.DFC_ComTrailerSig_C DFES_Cls.DFC_ComTrailerTo_C DFES_Cls.DFC_ComTrqDemandAfsChk_C DFES_Cls.DFC_ComTrqDemandAfsCtr_C DFES_Cls.DFC_ComTrqDemandAfsSig_C DFES_Cls.DFC_ComTrqDemandAfsTo_C DFES_Cls.DFC_ComTrqDemandDscChk_C DFES_Cls.DFC_ComTrqDemandDscCtr_C DFES_Cls.DFC_ComTrqDemandDscSig_C DFES_Cls.DFC_ComTrqDemandDscTo_C DFES_Cls.DFC_ComTrqDemandGbxChk_C DFES_Cls.DFC_ComTrqDemandGbxCtr_C DFES_Cls.DFC_ComTrqDemandGbxSig_C DFES_Cls.DFC_ComTrqDemandGbxTo_C DFES_Cls.DFC_ComVelocitySig_C DFES_Cls.DFC_ComVelocityTo_C DFES_Cls.DFC_ComWheelSpeedSig_C DFES_Cls.DFC_ComWheelSpeedTo_C DFES_Cls.DFC_ComZvKlappenSig_C DFES_Cls.DFC_ComZvKlappenTo_C DFES_Cls.DFC_Cy150SpiCom_C DFES_Cls.DFC_Cy320SpiCom_C DFES_Cls.DFC_ETCtlDvtInrMax_C DFES_Cls.DFC_ETCtlDvtInrMin_C DFES_Cls.DFC_ETCtlDvtOutrMax_C DFES_Cls.DFC_ETCtlDvtOutrMin_C DFES_Cls.DFC_Fan4WinErr1_C DFES_Cls.DFC_Fan4WinErr2_C DFES_Cls.DFC_Fan4WinErr3_C DFES_Cls.DFC_Fan4WinErr4_C DFES_Cls.DFC_FanSCG_C DFES_Cls.DFC_PCRGovDvtLPMax_C DFES_Cls.DFC_PCRGovDvtLPMin_C DFES_Cls.DFC_PCRGovDvtMax_C DFES_Cls.DFC_PCRGovDvtMin_C DFES_Cls.DFC_RailCPC1_C DFES_Cls.DFC_RailCPC3_C DFES_Cls.DFC_RailCPC4_C DFES_Cls.DFC_RailMeUn0_C DFES_Cls.DFC_RailMeUn1_C DFES_Cls.DFC_RailMeUn2_C DFES_Cls.DFC_RailMeUn3_C DFES_Cls.DFC_RailMeUn4_C DFES_Cls.DFC_RailPCV0_C DFES_Cls.DFC_RailPCV1_C DFES_Cls.DFC_RailPCV2_C DFES_Cls.DFC_RailPCV3_C DFES_Cls.DFC_RailPCV4_C DFES_Cls.DFC_RailPMonStrt_C DFES_Cls.DFC_SSpMon1_C DFES_Cls.DFC_SSpMon2_C DFES_Cls.DFC_SSpMon3_C DFES_Cls.DFC_Sia_E1_C DFES_Cls.DFC_Sia_E10_C DFES_Cls.DFC_Sia_E11_C DFES_Cls.DFC_Sia_E12_C DFES_Cls.DFC_Sia_E13_C DFES_Cls.DFC_Sia_E14_C DFES_Cls.DFC_Sia_E15_C DFES_Cls.DFC_Sia_E2_C DFES_Cls.DFC_Sia_E3_C DFES_Cls.DFC_Sia_E4_C DFES_Cls.DFC_Sia_E5_C DFES_Cls.DFC_Sia_E6_C DFES_Cls.DFC_Sia_E7_C DFES_Cls.DFC_Sia_E8_C DFES_Cls.DFC_Sia_E9_C DFES_Cls.DFC_ThrVlv4WinErr1_C DFES_Cls.DFC_ThrVlv4WinErr2_C DFES_Cls.DFC_ThrVlv4WinErr3_C DFES_Cls.DFC_ThrVlv4WinErr4_C DFES_Cls.DFC_ThrVlvSCG_C DFES_Cls.DFC_TrbCh4WinErr1_C DFES_Cls.DFC_TrbCh4WinErr2_C DFES_Cls.DFC_TrbCh4WinErr3_C DFES_Cls.DFC_TrbCh4WinErr4_C DFES_Cls.DFC_TrbChSCG_C DFES_Cls.DFC_TrbChSRCMax_C DFES_Cls.DFC_TrbChSRCMin_C DFES_Cls.DFC_WaHtEl4WinErr1_C DFES_Cls.DFC_WaHtEl4WinErr2_C DFES_Cls.DFC_WaHtEl4WinErr3_C DFES_Cls.DFC_WaHtEl4WinErr4_C DFES_Cls.DFC_WaHtElSCG_C DFES_Cls.DFC_ETClbETFltMax_C DFES_Cls.DFC_ETClbETFltMin_C DFES_Cls.DFC_InjCrvInjLimChrgBal_C DFES_Cls.DFC_InjCrvInjLimQntBal_C DFES_Cls.DFC_InjCrvInjLimSys_C DFES_Cls.DFC_InjCrvNumInjRtmLim_C DFES_Cls.DFC_LSUHtCoupSig_0_C DFES_Cls.DFC_LSUHtCoupSig_1_C DFES_Cls.DFC_LSUHtCoupSig_2_C DFES_Cls.DFC_LSUHtCoupSig_3_C DFES_Cls.DFC_CtT_C DFES_Cls.DFC_DSMDummy_C DFES_Cls.DFC_MeUnOL_C DFES_Cls.DFC_MeUnSCB_C DFES_Cls.DFC_MeUnSRCMax_C DFES_Cls.DFC_MeUnSRCMin_C DFES_Cls.DFC_PCVOL_C DFES_Cls.DFC_PCVSCB_C DFES_Cls.DFC_PCVSRCMax_C DFES_Cls.DFC_PCVSRCMin_C DFES_Cls.DFC_RailPSRCMax_C DFES_Cls.DFC_RailPSRCMin_C DFES_Cls.DFC_IVActrVltgSRCMax_C DFES_Cls.DFC_IVActrVltgSRCMin_C DFES_Cls.DFC_IVPSplyDCDC_C DFES_Cls.DFC_IVPSplyVltgSRCMax_C DFES_Cls.DFC_IVPSplyVltgSRCMin_C DFES_Cls.DFC_AFSOffsDrftMax_C DFES_Cls.DFC_AFSOffsDrftMin_C DFES_Cls.DFC_AFSSRCCorMax_C DFES_Cls.DFC_AFSSRCCorMin_C DFES_Cls.DFC_AFSSRCRawMax_C DFES_Cls.DFC_AFSSRCRawMin_C DFES_Cls.DFC_AFSSetyDrftMax_C DFES_Cls.DFC_AFSSetyDrftMin_C DFES_Cls.DFC_AirCClntPAnaSRCMax_C DFES_Cls.DFC_AirCClntPAnaSRCMin_C DFES_Cls.DFC_AirCClntPPerSRCMax_C DFES_Cls.DFC_AirCClntPPerSRCMin_C DFES_Cls.DFC_AirCClntPdcycSRCMax_C DFES_Cls.DFC_AirCClntPdcycSRCMin_C DFES_Cls.DFC_AirCCmprOL_C DFES_Cls.DFC_AirCCmprRedTrqOL_C DFES_Cls.DFC_AirCCmprRedTrqSCB_C DFES_Cls.DFC_AirCCmprRedTrqSCG_C DFES_Cls.DFC_AirCCmprSCB_C DFES_Cls.DFC_AirCCmprSCG_C DFES_Cls.DFC_AirCSwtNpl_C DFES_Cls.DFC_AirCSwtSig_C DFES_Cls.DFC_BattUSRCMax_C DFES_Cls.DFC_BattUSRCMin_C DFES_Cls.DFC_BrkNpl_C DFES_Cls.DFC_BrkPSRCMax_C DFES_Cls.DFC_BrkPSRCMin_C DFES_Cls.DFC_BrkSig_C DFES_Cls.DFC_CByVlvOL_C DFES_Cls.DFC_CByVlvSCB_C DFES_Cls.DFC_CByVlvSCG_C DFES_Cls.DFC_CEngDsTSRCMax_C DFES_Cls.DFC_CEngDsTSRCMin_C DFES_Cls.DFC_CEngDsTSig_C DFES_Cls.DFC_CEngUsTSRCMax_C DFES_Cls.DFC_CEngUsTSRCMin_C DFES_Cls.DFC_CThmstOL_C DFES_Cls.DFC_CThmstSCB_C DFES_Cls.DFC_CThmstSCG_C DFES_Cls.DFC_ClthSig_C DFES_Cls.DFC_ECBVlvOL_C DFES_Cls.DFC_ECBVlvSCB_C DFES_Cls.DFC_ECBVlvSCG_C DFES_Cls.DFC_ECBVlvSRCMax_C DFES_Cls.DFC_ECBVlvSRCMin_C DFES_Cls.DFC_EGRVlvGovDvtMax_C DFES_Cls.DFC_EGRVlvGovDvtMin_C DFES_Cls.DFC_EGRVlvOL_C DFES_Cls.DFC_EGRVlvSCB_C DFES_Cls.DFC_EGRVlvSCG_C DFES_Cls.DFC_EGRVlvSRCMax_C DFES_Cls.DFC_EGRVlvSRCMin_C DFES_Cls.DFC_EMDmpOL_0_C DFES_Cls.DFC_EMDmpOL_1_C DFES_Cls.DFC_EMDmpSCB_0_C DFES_Cls.DFC_EMDmpSCB_1_C DFES_Cls.DFC_EMDmpSCG_0_C DFES_Cls.DFC_EMDmpSCG_1_C DFES_Cls.DFC_EngStAOL_C DFES_Cls.DFC_EngStASCB_C DFES_Cls.DFC_EngStASCG_C DFES_Cls.DFC_EnvPSRCMax_C DFES_Cls.DFC_EnvPSRCMin_C DFES_Cls.DFC_EnvPSig_C DFES_Cls.DFC_EnvTSRCMax_C DFES_Cls.DFC_EnvTSRCMin_C DFES_Cls.DFC_FanOL_C DFES_Cls.DFC_FanSCB_C DFES_Cls.DFC_FlFltSig_C DFES_Cls.DFC_FuelTSRCMax_C DFES_Cls.DFC_FuelTSRCMin_C DFES_Cls.DFC_GbxNPosPPerSRCMax_C DFES_Cls.DFC_GbxNPosPPerSRCMin_C DFES_Cls.DFC_GbxNPosPdcycSRCMax_C DFES_Cls.DFC_GbxNPosPdcycSRCMin_C DFES_Cls.DFC_GbxNPosSig_C DFES_Cls.DFC_GlwPlgBSDOL_0_C DFES_Cls.DFC_GlwPlgBSDOL_1_C DFES_Cls.DFC_GlwPlgBSDOL_2_C DFES_Cls.DFC_GlwPlgBSDOL_3_C DFES_Cls.DFC_GlwPlgBSDOL_4_C DFES_Cls.DFC_GlwPlgBSDOL_5_C DFES_Cls.DFC_GlwPlgBSDOL_6_C DFES_Cls.DFC_GlwPlgBSDOL_7_C DFES_Cls.DFC_GlwPlgBSDOT_0_C DFES_Cls.DFC_GlwPlgBSDOT_1_C DFES_Cls.DFC_GlwPlgBSDOT_2_C DFES_Cls.DFC_GlwPlgBSDOT_3_C DFES_Cls.DFC_GlwPlgBSDOT_4_C DFES_Cls.DFC_GlwPlgBSDOT_5_C DFES_Cls.DFC_GlwPlgBSDOT_6_C DFES_Cls.DFC_GlwPlgBSDOT_7_C DFES_Cls.DFC_GlwPlgBSDSC_0_C DFES_Cls.DFC_GlwPlgBSDSC_1_C DFES_Cls.DFC_GlwPlgBSDSC_2_C DFES_Cls.DFC_GlwPlgBSDSC_3_C DFES_Cls.DFC_GlwPlgBSDSC_4_C DFES_Cls.DFC_GlwPlgBSDSC_5_C DFES_Cls.DFC_GlwPlgBSDSC_6_C DFES_Cls.DFC_GlwPlgBSDSC_7_C DFES_Cls.DFC_GlwPlgComErr_C DFES_Cls.DFC_InjVlvPresMin_C DFES_Cls.DFC_LSUCircNernstMax_0_C DFES_Cls.DFC_LSUCircNernstMax_1_C DFES_Cls.DFC_LSUCircNernstMax_2_C DFES_Cls.DFC_LSUCircNernstMax_3_C DFES_Cls.DFC_LSUCircNernstMin_0_C DFES_Cls.DFC_LSUCircNernstMin_1_C DFES_Cls.DFC_LSUCircNernstMin_2_C DFES_Cls.DFC_LSUCircNernstMin_3_C DFES_Cls.DFC_LSUCircNernstSig_0_C DFES_Cls.DFC_LSUCircNernstSig_1_C DFES_Cls.DFC_LSUCircNernstSig_2_C DFES_Cls.DFC_LSUCircNernstSig_3_C DFES_Cls.DFC_LSUCircPmpCurMax_0_C DFES_Cls.DFC_LSUCircPmpCurMax_1_C DFES_Cls.DFC_LSUCircPmpCurMax_2_C DFES_Cls.DFC_LSUCircPmpCurMax_3_C DFES_Cls.DFC_LSUCircPmpCurMin_0_C DFES_Cls.DFC_LSUCircPmpCurMin_1_C DFES_Cls.DFC_LSUCircPmpCurMin_2_C DFES_Cls.DFC_LSUCircPmpCurMin_3_C DFES_Cls.DFC_LSUCircPmpCurSig_0_C DFES_Cls.DFC_LSUCircPmpCurSig_1_C DFES_Cls.DFC_LSUCircPmpCurSig_2_C DFES_Cls.DFC_LSUCircPmpCurSig_3_C DFES_Cls.DFC_LSUCircVirtGndMax_0_C DFES_Cls.DFC_LSUCircVirtGndMax_1_C DFES_Cls.DFC_LSUCircVirtGndMax_2_C DFES_Cls.DFC_LSUCircVirtGndMax_3_C DFES_Cls.DFC_LSUCircVirtGndMin_0_C DFES_Cls.DFC_LSUCircVirtGndMin_1_C DFES_Cls.DFC_LSUCircVirtGndMin_2_C DFES_Cls.DFC_LSUCircVirtGndMin_3_C DFES_Cls.DFC_LSUCircVirtGndSig_0_C DFES_Cls.DFC_LSUCircVirtGndSig_1_C DFES_Cls.DFC_LSUCircVirtGndSig_2_C DFES_Cls.DFC_LSUCircVirtGndSig_3_C DFES_Cls.DFC_LSUHtrMax_0_C DFES_Cls.DFC_LSUHtrMax_1_C DFES_Cls.DFC_LSUHtrMax_2_C DFES_Cls.DFC_LSUHtrMax_3_C DFES_Cls.DFC_LSUHtrMin_0_C DFES_Cls.DFC_LSUHtrMin_1_C DFES_Cls.DFC_LSUHtrMin_2_C DFES_Cls.DFC_LSUHtrMin_3_C DFES_Cls.DFC_LSUHtrSig_0_C DFES_Cls.DFC_LSUHtrSig_1_C DFES_Cls.DFC_LSUHtrSig_2_C DFES_Cls.DFC_LSUHtrSig_3_C DFES_Cls.DFC_LSUO2Max_0_C DFES_Cls.DFC_LSUO2Max_1_C DFES_Cls.DFC_LSUO2Max_2_C DFES_Cls.DFC_LSUO2Max_3_C DFES_Cls.DFC_LSUO2Min_0_C DFES_Cls.DFC_LSUO2Min_1_C DFES_Cls.DFC_LSUO2Min_2_C DFES_Cls.DFC_LSUO2Min_3_C DFES_Cls.DFC_LSUSPIBattLowMin_0_C DFES_Cls.DFC_LSUSPIBattLowMin_1_C DFES_Cls.DFC_LSUSPIBattLowMin_2_C DFES_Cls.DFC_LSUSPIBattLowMin_3_C DFES_Cls.DFC_LSUSPISig_0_C DFES_Cls.DFC_LSUSPISig_1_C DFES_Cls.DFC_LSUSPISig_2_C DFES_Cls.DFC_LSUSPISig_3_C DFES_Cls.DFC_LSUtExcMax_0_C DFES_Cls.DFC_LSUtExcMax_1_C DFES_Cls.DFC_LSUtExcMax_2_C DFES_Cls.DFC_LSUtExcMax_3_C DFES_Cls.DFC_LSUtExcMin_0_C DFES_Cls.DFC_LSUtExcMin_1_C DFES_Cls.DFC_LSUtExcMin_2_C DFES_Cls.DFC_LSUtExcMin_3_C DFES_Cls.DFC_MILOL_C DFES_Cls.DFC_MILSCB_C DFES_Cls.DFC_MILSCG_C DFES_Cls.DFC_MeUnSCG_C DFES_Cls.DFC_NplHsChngPPFltDiff_C DFES_Cls.DFC_NplPAirFltDs_C DFES_Cls.DFC_NplTPFltUs_C DFES_Cls.DFC_OilComErr_C DFES_Cls.DFC_OilPLmpOL_C DFES_Cls.DFC_OilPLmpSCB_C DFES_Cls.DFC_OilPLmpSCG_C DFES_Cls.DFC_OilPNpl_C DFES_Cls.DFC_OilTNpl_C DFES_Cls.DFC_OilTSRCMax_C DFES_Cls.DFC_OilTSRCMin_C DFES_Cls.DFC_PCACDsEnvPPls_C DFES_Cls.DFC_PCACDsSRCMax_C DFES_Cls.DFC_PCACDsSRCMin_C DFES_Cls.DFC_PCVSCG_C DFES_Cls.DFC_PFltCharPDiffMin_C DFES_Cls.DFC_PFltDstrMin_C DFES_Cls.DFC_PFltEngPrt_C DFES_Cls.DFC_PFltLmpOL_C DFES_Cls.DFC_PFltLmpSCB_C DFES_Cls.DFC_PFltLmpSCG_C DFES_Cls.DFC_PFltRgnPerm_C DFES_Cls.DFC_PFltSRCMaxFlwRstn_C DFES_Cls.DFC_PFltSRCMinFlwRstn_C DFES_Cls.DFC_PFltSotMsDvtMax_C DFES_Cls.DFC_PFltSotMsDvtMin_C DFES_Cls.DFC_PFltSotMsMax_C DFES_Cls.DFC_PSPOL_C DFES_Cls.DFC_PSPSCB_C DFES_Cls.DFC_PSPSCG_C DFES_Cls.DFC_SRCHighAPP1_C DFES_Cls.DFC_SRCHighAPP2_C DFES_Cls.DFC_SRCLowAPP1_C DFES_Cls.DFC_SRCLowAPP2_C DFES_Cls.DFC_SRCMaxPAirFltDs_C DFES_Cls.DFC_SRCMaxPPFltUs_C DFES_Cls.DFC_SRCMaxTECU_C DFES_Cls.DFC_SRCMaxTOxiCatUs_C DFES_Cls.DFC_SRCMaxTPFltUs_C DFES_Cls.DFC_SRCMinPAirFltDs_C DFES_Cls.DFC_SRCMinPPFltUs_C DFES_Cls.DFC_SRCMinTECU_C DFES_Cls.DFC_SRCMinTOxiCatUs_C DFES_Cls.DFC_SRCMinTPFltUs_C DFES_Cls.DFC_SVSOL_C DFES_Cls.DFC_SVSSCB_C DFES_Cls.DFC_SVSSCG_C DFES_Cls.DFC_StrtOL_C DFES_Cls.DFC_StrtSCB_C DFES_Cls.DFC_StrtSCG_C DFES_Cls.DFC_SyncAPP_C DFES_Cls.DFC_T15Npl_C DFES_Cls.DFC_TAFSDtyCycHi_C DFES_Cls.DFC_TAFSDtyCycLo_C DFES_Cls.DFC_TAFSPerHi_C DFES_Cls.DFC_TAFSPerLo_C DFES_Cls.DFC_TCACDsSRCMax_C DFES_Cls.DFC_TCACDsSRCMin_C DFES_Cls.DFC_ThrVlvOL_C DFES_Cls.DFC_ThrVlvSCB_C DFES_Cls.DFC_ThrVlvSRCMax_C DFES_Cls.DFC_ThrVlvSRCMin_C DFES_Cls.DFC_TrbChLPOL_C DFES_Cls.DFC_TrbChLPSCB_C DFES_Cls.DFC_TrbChLPSCG_C DFES_Cls.DFC_TrbChOL_C DFES_Cls.DFC_TrbChSCB_C DFES_Cls.DFC_VSwVlvGovDvtMax_C DFES_Cls.DFC_VSwVlvGovDvtMin_C DFES_Cls.DFC_VSwVlvOL_C DFES_Cls.DFC_VSwVlvSCB_C DFES_Cls.DFC_VSwVlvSCG_C DFES_Cls.DFC_VSwVlvSRCMax_C DFES_Cls.DFC_VSwVlvSRCMin_C DFES_Cls.DFC_VehVHW_C DFES_Cls.DFC_VehVMax_C DFES_Cls.DFC_VehVPlaus_C DFES_Cls.DFC_VehVSig_C DFES_Cls.DFC_WaHtElOL_C DFES_Cls.DFC_WaHtElSCB_C DFES_Cls.DFC_ClthNpl_C DFES_Cls.DFC_ETClbETMax_0_C DFES_Cls.DFC_ETClbETMax_1_C DFES_Cls.DFC_ETClbETMax_2_C DFES_Cls.DFC_ETClbETMax_3_C DFES_Cls.DFC_ETClbETMax_4_C DFES_Cls.DFC_ETClbETMax_5_C DFES_Cls.DFC_ETClbETMin_0_C DFES_Cls.DFC_ETClbETMin_1_C DFES_Cls.DFC_ETClbETMin_2_C DFES_Cls.DFC_ETClbETMin_3_C DFES_Cls.DFC_ETClbETMin_4_C DFES_Cls.DFC_ETClbETMin_5_C DFES_Cls.DFC_IVDiaBnkShCirBSH_0_C DFES_Cls.DFC_IVDiaBnkShCirBSH_1_C DFES_Cls.DFC_IVDiaBnkShCirChSwt_0_C DFES_Cls.DFC_IVDiaBnkShCirChSwt_1_C DFES_Cls.DFC_IVDiaBnkShCirHSBatt_0_C DFES_Cls.DFC_IVDiaBnkShCirHSBatt_1_C DFES_Cls.DFC_IVDiaBnkShCirHiRstnc_0_C DFES_Cls.DFC_IVDiaBnkShCirHiRstnc_1_C DFES_Cls.DFC_IVDiaBnkShCirLSHSGnd_0_C DFES_Cls.DFC_IVDiaBnkShCirLSHSGnd_1_C DFES_Cls.DFC_IVDiaBnkShCirTransfer_0_C DFES_Cls.DFC_IVDiaBnkShCirTransfer_1_C DFES_Cls.DFC_IVDiaCylNoCls_0_C DFES_Cls.DFC_IVDiaCylNoCls_1_C DFES_Cls.DFC_IVDiaCylNoCls_2_C DFES_Cls.DFC_IVDiaCylNoCls_3_C DFES_Cls.DFC_IVDiaCylNoCls_4_C DFES_Cls.DFC_IVDiaCylNoCls_5_C DFES_Cls.DFC_IVDiaCylNoLd_0_C DFES_Cls.DFC_IVDiaCylNoLd_1_C DFES_Cls.DFC_IVDiaCylNoLd_2_C DFES_Cls.DFC_IVDiaCylNoLd_3_C DFES_Cls.DFC_IVDiaCylNoLd_4_C DFES_Cls.DFC_IVDiaCylNoLd_5_C DFES_Cls.DFC_IVDiaCylShCirHiRstnc_0_C DFES_Cls.DFC_IVDiaCylShCirHiRstnc_1_C DFES_Cls.DFC_IVDiaCylShCirHiRstnc_2_C DFES_Cls.DFC_IVDiaCylShCirHiRstnc_3_C DFES_Cls.DFC_IVDiaCylShCirHiRstnc_4_C DFES_Cls.DFC_IVDiaCylShCirHiRstnc_5_C DFES_Cls.DFC_IVDiaCylShCirLSBatt_0_C DFES_Cls.DFC_IVDiaCylShCirLSBatt_1_C DFES_Cls.DFC_IVDiaCylShCirLSBatt_2_C DFES_Cls.DFC_IVDiaCylShCirLSBatt_3_C DFES_Cls.DFC_IVDiaCylShCirLSBatt_4_C DFES_Cls.DFC_IVDiaCylShCirLSBatt_5_C DFES_Cls.DFC_IVDiaCylShCirLSHS_0_C DFES_Cls.DFC_IVDiaCylShCirLSHS_1_C DFES_Cls.DFC_IVDiaCylShCirLSHS_2_C DFES_Cls.DFC_IVDiaCylShCirLSHS_3_C DFES_Cls.DFC_IVDiaCylShCirLSHS_4_C DFES_Cls.DFC_IVDiaCylShCirLSHS_5_C DFES_Cls.DFC_IVDiaCylShCirLsLs_0_C DFES_Cls.DFC_IVDiaCylShCirLsLs_1_C DFES_Cls.DFC_IVDiaCylShCirLsLs_2_C DFES_Cls.DFC_IVDiaCylShCirLsLs_3_C DFES_Cls.DFC_IVDiaCylShCirLsLs_4_C DFES_Cls.DFC_IVDiaCylShCirLsLs_5_C DFES_Cls.DFC_IVDiaSPICfg_C DFES_Cls.DFC_IVDiaSPIColl_C DFES_Cls.DFC_IVDiaSPICtrl_C DFES_Cls.DFC_IVDiaSPIRam_C DFES_Cls.DFC_IVDiaSPITrans_C DFES_Cls.DFC_LSUCmpChk_0_C DFES_Cls.DFC_LSUCmpChk_1_C DFES_Cls.DFC_LSUCmpChk_2_C DFES_Cls.DFC_LSUCmpChk_3_C DFES_Cls.DFC_LSUCmpChk_4_C DFES_Cls.DFC_LSUCmpChk_5_C DFES_Cls.DFC_LSUDynChk_0_C DFES_Cls.DFC_LSUDynChk_1_C DFES_Cls.DFC_LSUDynChk_2_C DFES_Cls.DFC_LSUDynChk_3_C DFES_Cls.DFC_LSUO2ClbMax_0_C DFES_Cls.DFC_LSUO2ClbMax_1_C DFES_Cls.DFC_LSUO2ClbMax_2_C DFES_Cls.DFC_LSUO2ClbMax_3_C DFES_Cls.DFC_LSUO2ClbMin_0_C DFES_Cls.DFC_LSUO2ClbMin_1_C DFES_Cls.DFC_LSUO2ClbMin_2_C DFES_Cls.DFC_LSUO2ClbMin_3_C DFES_Cls.DFC_LSUO2PlausMax_0_C DFES_Cls.DFC_LSUO2PlausMax_1_C DFES_Cls.DFC_LSUO2PlausMax_2_C DFES_Cls.DFC_LSUO2PlausMax_3_C DFES_Cls.DFC_LSUO2PlausMin_0_C DFES_Cls.DFC_LSUO2PlausMin_1_C DFES_Cls.DFC_LSUO2PlausMin_2_C DFES_Cls.DFC_LSUO2PlausMin_3_C DFES_Cls.DFC_LSURiClbMax_0_C DFES_Cls.DFC_LSURiClbMax_1_C DFES_Cls.DFC_LSURiClbMax_2_C DFES_Cls.DFC_LSURiClbMax_3_C DFES_Cls.DFC_LSURiClbMin_0_C DFES_Cls.DFC_LSURiClbMin_1_C DFES_Cls.DFC_LSURiClbMin_2_C DFES_Cls.DFC_LSURiClbMin_3_C DFES_Cls.DFC_LSUWireIPSig_0_C DFES_Cls.DFC_LSUWireIPSig_1_C DFES_Cls.DFC_LSUWireIPSig_2_C DFES_Cls.DFC_LSUWireIPSig_3_C DFES_Cls.DFC_AFSDrftIdlAdjVal_C DFES_Cls.DFC_AFSDrftLdAdjVal_C DFES_Cls.DFC_AdcI_ADC0_Cal_C DFES_Cls.DFC_AdcI_ADC0_Conv_C DFES_Cls.DFC_CmbChbMisfireMax_0_C DFES_Cls.DFC_CmbChbMisfireMax_1_C DFES_Cls.DFC_CmbChbMisfireMax_2_C DFES_Cls.DFC_CmbChbMisfireMax_3_C DFES_Cls.DFC_CmbChbMisfireMax_4_C DFES_Cls.DFC_CmbChbMisfireMax_5_C DFES_Cls.DFC_CmbChbMisfireMul_C DFES_Cls.DFC_INJVLVBUSY_C DFES_Cls.DFC_IVAdjIVA_0_C DFES_Cls.DFC_IVAdjIVA_1_C DFES_Cls.DFC_IVAdjIVA_2_C DFES_Cls.DFC_IVAdjIVA_3_C DFES_Cls.DFC_IVAdjIVA_4_C DFES_Cls.DFC_IVAdjIVA_5_C DFES_Cls.DFC_InjCtlAdjQntEEPCS_C DFES_Cls.DFC_InjCtlDriftEEPCS_C DFES_Cls.DFC_MRlyErlyOpng_C DFES_Cls.DFC_MRlyStk_C DFES_Cls.DFC_SensFrzPPFltUs_C DFES_Cls.DFC_T15Sig_C DFES_Cls.DFC_AirCtlRmpTOut_C DFES_Cls.DFC_CEngDsTDynTst_C DFES_Cls.DFC_EGRVlvJamVlvClsd_C DFES_Cls.DFC_EGRVlvJamVlvOpn_C DFES_Cls.DFC_EGRVlvLgTDrft_C DFES_Cls.DFC_EGRVlvOfsLrnJamVlv_C DFES_Cls.DFC_EGRVlvShTDrft_C DFES_Cls.DFC_EGTRgnOilDilMax_C DFES_Cls.DFC_EngICO_C DFES_Cls.DFC_EpmCaSI1ErrSig_C DFES_Cls.DFC_EpmCaSI1NoSig_C DFES_Cls.DFC_EpmCaSI1OfsErr_C DFES_Cls.DFC_EpmCrSErrSig_C DFES_Cls.DFC_EpmCrSNoSig_C DFES_Cls.DFC_MoCADCCmp_C DFES_Cls.DFC_MoCADCTst_C DFES_Cls.DFC_MoCADCVltgRatio_C DFES_Cls.DFC_MoCSOPLoLi_C DFES_Cls.DFC_MoCSOPMM_C DFES_Cls.DFC_MoCSOPTimeOut_C DFES_Cls.DFC_MoCSOPUpLi_C DFES_Cls.DFC_MoFAPP_C DFES_Cls.DFC_MoFESpd_C DFES_Cls.DFC_MoFInjDatPhi_C DFES_Cls.DFC_MoFInjDatQnt_C DFES_Cls.DFC_MoFInjQnt_C DFES_Cls.DFC_MoFOvR_C DFES_Cls.DFC_MoFQntCor_C DFES_Cls.DFC_MoFTrqCmp_C DFES_Cls.DFC_NplTOxiCatUs_C DFES_Cls.DFC_PhyModNonMonMapNpl_C DFES_Cls.DFC_RailPOfsTstMax_C DFES_Cls.DFC_RailPOfsTstMin_C DFES_Cls.DFC_SWReset_0_C DFES_Cls.DFC_SWReset_1_C DFES_Cls.DFC_SWReset_2_C DFES_Cls.DFC_VSwVlvJamVlv_C DFES_Cls.DFC_VSwVlvLgTDrft_C DFES_Cls.DFC_VSwVlvOfsLrnJamVlv_C DFES_Cls.DFC_VSwVlvShTDrft_C /end DEF_CHARACTERISTIC
/end FUNCTION
/begin COMPU_METHOD DEFAULT_FORMULA "DEFAULT_FORMULA" RAT_FUNC "%7.0" "" COEFFS 0 1 0 0 0 1 /end COMPU_METHOD
/begin COMPU_METHOD DFES_OneToOne "" RAT_FUNC "%6.2" "-" COEFFS 0 1 0 0 0 1 /end COMPU_METHOD
/begin RECORD_LAYOUT Val_Wu8 FNC_VALUES 1 UBYTE COLUMN_DIR DIRECT /end RECORD_LAYOUT
/end MODULE
/end PROJECT
