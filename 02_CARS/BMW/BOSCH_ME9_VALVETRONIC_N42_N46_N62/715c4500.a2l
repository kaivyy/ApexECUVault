ASAP2_VERSION 1 3
/begin PROJECT _715C4500 "basisme9"
/begin HEADER "" VERSION "_715C4500" PROJECT_NO _715C4500 /end HEADER
/begin MODULE DIM ""
/begin MOD_COMMON "" BYTE_ORDER MSB_FIRST ALIGNMENT_BYTE 1 ALIGNMENT_WORD 2 ALIGNMENT_LONG 2 ALIGNMENT_FLOAT32_IEEE 4 /end MOD_COMMON
/begin CHARACTERISTIC ABKTWSLP "Abk¸hlkurve f¸r Temperatur der SLP-wicklung in Abh. von der Abstellzeit" CURVE 0xFCC288 KlAxU8SstxU16WU16 0.9960938 fak_ub_b1 0.00 0.9960938 FORMAT "%9.7"
 /begin AXIS_DESCR STD_AXIS tabst_w t1sxs_uw_q1 6 0.00 65535.00 FORMAT "%8.2" DEPOSIT ABSOLUTE /end AXIS_DESCR
/end CHARACTERISTIC
/begin CHARACTERISTIC BGMSDKDPS "Umschaltung UGD->UG ueber dpsfak" VALUE 0xFC2828 KwUb 1.000 fak_ub_q0p00392 0.00 1.000 FORMAT "%5.3" /end CHARACTERISTIC
/begin CHARACTERISTIC BGMSVVTDPS "Umschaltung GD->UGD ueber dpsfak" VALUE 0xFC2829 KwUb 1.000 fak_ub_q0p00392 0.00 1.000 FORMAT "%5.3" /end CHARACTERISTIC
/begin CHARACTERISTIC BGWDKDPSGR "Grenzwert dp f¸r Berechnung DK-Winkel aus HFM-Signal ungedrosselt" VALUE 0xFC1E4C KwWS16 2559.961 p_q0p039 -1280.000 1279.961 FORMAT "%8.3" /end CHARACTERISTIC
/begin CHARACTERISTIC CBGRLP "Codewort Konfiguration Funktion BGRLP" VALUE 0xFC4A5C KwUb 255.0 dez 0.00 255.0 FORMAT "%5.1" /end CHARACTERISTIC
/begin CHARACTERISTIC CL30LINE "30. Linie der Klassentabelle" VAL_BLK 0xFD13A2 KwbUb 255.0 dez 0.00 255.0 FORMAT "%5.1" NUMBER 13 /end CHARACTERISTIC
/begin CHARACTERISTIC CL31LINE "31. Linie der Klassentabelle" VAL_BLK 0xFD13AF KwbUb 255.0 dez 0.00 255.0 FORMAT "%5.1" NUMBER 13 /end CHARACTERISTIC
/begin CHARACTERISTIC CL32LINE "32. Linie der Klassentabelle" VAL_BLK 0xFD13BC KwbUb 255.0 dez 0.00 255.0 FORMAT "%5.1" NUMBER 13 /end CHARACTERISTIC
/begin CHARACTERISTIC CL33LINE "33. Linie der Klassentabelle" VAL_BLK 0xFD13C9 KwbUb 255.0 dez 0.00 255.0 FORMAT "%5.1" NUMBER 13 /end CHARACTERISTIC
/begin CHARACTERISTIC CL34LINE "34. Linie der Klassentabelle" VAL_BLK 0xFD13D6 KwbUb 255.0 dez 0.00 255.0 FORMAT "%5.1" NUMBER 13 /end CHARACTERISTIC
/begin CHARACTERISTIC CL35LINE "35. Linie der Klassentabelle" VAL_BLK 0xFD13E3 KwbUb 255.0 dez 0.00 255.0 FORMAT "%5.1" NUMBER 13 /end CHARACTERISTIC
/begin CHARACTERISTIC CL36LINE "36. Linie der Klassentabelle" VAL_BLK 0xFD13F0 KwbUb 255.0 dez 0.00 255.0 FORMAT "%5.1" NUMBER 13 /end CHARACTERISTIC
/begin CHARACTERISTIC CL37LINE "37. Linie der Klassentabelle" VAL_BLK 0xFD13FD KwbUb 255.0 dez 0.00 255.0 FORMAT "%5.1" NUMBER 13 /end CHARACTERISTIC
/begin CHARACTERISTIC CL38LINE "38. Linie der Klassentabelle" VAL_BLK 0xFD140A KwbUb 255.0 dez 0.00 255.0 FORMAT "%5.1" NUMBER 13 /end CHARACTERISTIC
/begin CHARACTERISTIC CL39LINE "39. Linie der Klassentabelle" VAL_BLK 0xFD1417 KwbUb 255.0 dez 0.00 255.0 FORMAT "%5.1" NUMBER 13 /end CHARACTERISTIC
/begin CHARACTERISTIC CWBKV "Codewort f¸r Bremskraftverst‰rker" VALUE 0xFD040A KwUw 65535.00 dez 0.00 65535.00 FORMAT "%8.2" /end CHARACTERISTIC
/begin CHARACTERISTIC CWDASC "Code f¸r ASC-‹berwachungsumschaltung" VALUE 0xFC0EA2 KwUb 255.0 dez 0.00 255.0 FORMAT "%5.1" /end CHARACTERISTIC
/begin CHARACTERISTIC CWDEGFE "Codewort f¸r Abschaltung der Funktion %DEGFE" VALUE 0xFCD4C8 KwUb 255.0 dez 0.00 255.0 FORMAT "%5.1" /end CHARACTERISTIC
/begin CHARACTERISTIC CWPSBKVPE "Kodewort zum Abschalten der Endstufediagnose" VALUE 0xFCCD64 KwWU8 255.0 dez 0.00 255.0 FORMAT "%5.1" /end CHARACTERISTIC
/begin CHARACTERISTIC CWPSELS "Kodewort zum Abschalten der Endstufediagnose E-Box L¸fter" VALUE 0xFCCD65 KwWU8 255.0 dez 0.00 255.0 FORMAT "%5.1" /end CHARACTERISTIC
/begin CHARACTERISTIC CWPSEVE "Codewort f¸r Endstufendiagnose EV" VALUE 0xFCCD6A KwWU8 255.0 dez 0.00 255.0 FORMAT "%5.1" /end CHARACTERISTIC
/begin CHARACTERISTIC CWPSKPE "Codewort f¸r Endstufendiagnose EKP" VALUE 0xFCCD67 KwWU8 255.0 dez 0.00 255.0 FORMAT "%5.1" /end CHARACTERISTIC
/begin CHARACTERISTIC CWTEMPK "Codeword f¸r Adressierung FWFTBRTA (tans/evtmod)" VALUE 0xFCD3E8 KwUb 255.0 dez 0.00 255.0 FORMAT "%5.1" /end CHARACTERISTIC
/begin CHARACTERISTIC CW_BGKUPPL "" VALUE 0xFC1F76 KwWU8 1.000 dez 0.00 1.000 FORMAT "%5.3" /end CHARACTERISTIC
/begin CHARACTERISTIC CW_CCPAKTIV "" VALUE 0xFC0ED3 KwWU8 255.0 default 0.00 255.0 FORMAT "%5.1" /end CHARACTERISTIC
/begin CHARACTERISTIC CW_DPSMSZS "Code-Wort Umschaltung dps_w / dpssol_w" VALUE 0xFC282A KwUb 255.0 dez 0.00 255.0 FORMAT "%5.1" /end CHARACTERISTIC
/begin CHARACTERISTIC CW_NNMSZS "Codewort Temperatureingang f¸r Multilineare Regession 0=tmot,1=tmoel,2=toel" VALUE 0xFC282B KwUb 255.0 dez 0.00 255.0 FORMAT "%5.1" /end CHARACTERISTIC
/begin CHARACTERISTIC CW_RLCAL "" VALUE 0xFC2B6E KwWU8 255.0 dez 0.00 255.0 FORMAT "%5.1" /end CHARACTERISTIC
/begin CHARACTERISTIC DEAVANOS "Funkionsschalter Diagnose" VALUE 0xFC9BF0 KwWU8 255.0 dez 0.00 255.0 FORMAT "%5.1" /end CHARACTERISTIC
/begin CHARACTERISTIC DEVTMAGR "Offset f¸r evtmod abh‰ngig von tsges_w bei hoher tans verursacht d. AGR" CURVE 0xFCD4A2 KlASwSstSwWSw 49151.25 temp_sw_q0p75 -24576.00 24575.25 FORMAT "%8.2"
 /begin AXIS_DESCR STD_AXIS tsges_w temp_sw_q0p75 8 -24576.00 24575.25 FORMAT "%8.2" DEPOSIT ABSOLUTE /end AXIS_DESCR
/end CHARACTERISTIC
/begin CHARACTERISTIC DFKMSMN "Delta FKMSDKMN zum R¸cksetzen von B_fkmsmn" VALUE 0xFC282C KwUb 3.984 fak_ub_b4 0.00 3.984 FORMAT "%5.3" /end CHARACTERISTIC
/begin CHARACTERISTIC DFKMSMX "Delta FKMSDKMX zum R¸cksetzen von B_fkmsmx" VALUE 0xFC282D KwUb 3.984 fak_ub_b4 0.00 3.984 FORMAT "%5.3" /end CHARACTERISTIC
/begin CHARACTERISTIC DFKPVMN "Delta FKPVDKMN zum R¸cksetzen von B_fkpvmn" VALUE 0xFC282E KwUb 3.984 fak_ub_b4 0.00 3.984 FORMAT "%5.3" /end CHARACTERISTIC
/begin CHARACTERISTIC DFKPVMX "Delta FKPVDKMX zum R¸cksetzen von B_fkpvmx" VALUE 0xFC282F KwUb 3.984 fak_ub_b4 0.00 3.984 FORMAT "%5.3" /end CHARACTERISTIC
/begin CHARACTERISTIC DFRUTYP "DF-R¸ckschaltungstyp f¸r LLR-Anhebung" VALUE 0xFC99C6 KwWU8 255.0 dez 0.00 255.0 FORMAT "%5.1" /end CHARACTERISTIC
/begin CHARACTERISTIC DISA_GW "Schwellwert f¸r DISA Anschlagerkennung" VALUE 0xFCCF0C KwUw 319.9951 spg_uw_b5 0.00 319.9951 FORMAT "%8.4" /end CHARACTERISTIC
/begin CHARACTERISTIC DISA_TIME1 "Timeout-Zeit f¸r Schalt-Peak-Erkennung" VALUE 0xFCCF0E KwUw 655.3500 t10msxs_uw_b655p35 0.00 655.3500 FORMAT "%8.4" /end CHARACTERISTIC
/begin CHARACTERISTIC DISA_TIME2 "Timeout-Zeit f¸r Anschlagerkennung" VALUE 0xFCCF10 KwUw 655.3500 t10msxs_uw_b655p35 0.00 655.3500 FORMAT "%8.4" /end CHARACTERISTIC
/begin CHARACTERISTIC DMAUFASC "Deltamoment Aufregelung nach ASC-Fehler" VALUE 0xFC0ED1 KwUb 24.90 rel_ub_b24p9 0.00 24.90 FORMAT "%5.2" /end CHARACTERISTIC
/begin CHARACTERISTIC DPBKVSPS "Delta Druck zw. Sollbremskraftverst‰rkerdruck und Saugrohrdruck" VALUE 0xFD040C KwUw 2559.961 p_uw_q0p039 0.00 2559.961 FORMAT "%8.3" /end CHARACTERISTIC
/begin CHARACTERISTIC DPBKVUKKPU "min. zul‰s. Druckdiff. zw. pbkv und pu f¸r Kompressorabschaltung" CURVE 0xFD040E KlAUwSstUwWUw 2559.961 p_uw_q0p039 0.00 2559.961 FORMAT "%8.3"
 /begin AXIS_DESCR STD_AXIS pubkv_w p_uw_q0p039 4 0.00 2559.961 FORMAT "%8.3" DEPOSIT ABSOLUTE /end AXIS_DESCR
/end CHARACTERISTIC
/begin CHARACTERISTIC DPBKVUKNKH "min. zul‰s. Druckdif. zw. BKV-Druck und pu f¸r LL-Drehzahl f¸r KH abschalten" CURVE 0xFD0420 KlAUwSstUwWUw 2559.961 p_uw_q0p039 0.00 2559.961 FORMAT "%8.3"
 /begin AXIS_DESCR STD_AXIS pubkv_w p_uw_q0p039 4 0.00 2559.961 FORMAT "%8.3" DEPOSIT ABSOLUTE /end AXIS_DESCR
/end CHARACTERISTIC
/begin CHARACTERISTIC DPBKVUKNW "min. zul‰s. Druckdiff. zw. pbkv und pu f¸r NW-Umschaltung auf min. ‹berschneidun" CURVE 0xFD0432 KlAUwSstUwWUw 2559.961 p_uw_q0p039 0.00 2559.961 FORMAT "%8.3"
 /begin AXIS_DESCR STD_AXIS pubkv_w p_uw_q0p039 4 0.00 2559.961 FORMAT "%8.3" DEPOSIT ABSOLUTE /end AXIS_DESCR
/end CHARACTERISTIC
/begin CHARACTERISTIC DPBKVUKP "min. zul‰s. Druckdif. zwischen BKV-Druck und pu f¸r Pumpenansteuerung" CURVE 0xFD0444 KlAUwSstUwWUw 2559.961 p_uw_q0p039 0.00 2559.961 FORMAT "%8.3"
 /begin AXIS_DESCR STD_AXIS pubkv_w p_uw_q0p039 4 0.00 2559.961 FORMAT "%8.3" DEPOSIT ABSOLUTE /end AXIS_DESCR
/end CHARACTERISTIC
/begin CHARACTERISTIC DPBKVUKPU "min. zul‰s. Druckdif. zw. BKV-Druck und pu ohne Bet‰t. der Bremse abh. von pu" CURVE 0xFD0456 KlAUwSstUwWUw 2559.961 p_uw_q0p039 0.00 2559.961 FORMAT "%8.3"
 /begin AXIS_DESCR STD_AXIS pubkv_w p_uw_q0p039 4 0.00 2559.961 FORMAT "%8.3" DEPOSIT ABSOLUTE /end AXIS_DESCR
/end CHARACTERISTIC
/begin CHARACTERISTIC DPBKVUS "gew¸nschte Druckdifferenz zwischen Bremskraftverst‰rker und Umgebungsdruck" VALUE 0xFD03FE KwUb 1275. p_ub_q5 0.00 1275. FORMAT "%5.0" /end CHARACTERISTIC
/begin CHARACTERISTIC DPSTDMN "" VALUE 0xFC285A KwUw 2559.961 p_q0p039 0.00 2559.961 FORMAT "%8.3" /end CHARACTERISTIC
/begin CHARACTERISTIC DRLDYNU "drl-Schwellwert f¸r te-Nachspritzer/Reduktion" VALUE 0xFC4A5E KwSw 1535.977 rel_sw_q0p0234 -768.0000 767.9766 FORMAT "%8.4" /end CHARACTERISTIC
/begin CHARACTERISTIC DTABUNPL "Schwelle Abstellzeit unplausibel" VALUE 0xFCD764 KwUw 65535.00 t1sxs_uw_q1 0.00 65535.00 FORMAT "%8.2" /end CHARACTERISTIC
/begin CHARACTERISTIC DTEPRU "delta-te-Schwelle fuer Nachspritzer-/ti-Reduktion erkannt" VALUE 0xFC4A60 KwUw 209.7478 t3p2usxms_uw_b209p7 0.00 209.7478 FORMAT "%8.4" /end CHARACTERISTIC
/begin CHARACTERISTIC DTUMTA "Offset Ansauglufttemperatur -> Umgebungstemperatur" VALUE 0xFCD750 KwSb 191.3 temp_sb_q0p75 -96.00 95.25 FORMAT "%5.2" /end CHARACTERISTIC
/begin CHARACTERISTIC EKPFA "Anzahl Verifikationen zur Fehlerentprellung in der Endstufendiagnose EKP-Relais" VALUE 0xFCCD68 KwWU8 255.0 dez 0.00 255.0 FORMAT "%5.1" /end CHARACTERISTIC
/begin CHARACTERISTIC EKPPA "Anzahl Pr¸fpulsausgaben in der Endstufendiagnose EKP-Relais" VALUE 0xFCCD69 KwWU8 255.0 dez 0.00 255.0 FORMAT "%5.1" /end CHARACTERISTIC
/begin CHARACTERISTIC EVTMODO "Offset f¸r evtmod abh‰ngig von gefilterter Motortemperatur" CURVE 0xFCD3EC KlAUbSstUbWUb 191.3 temp_ub_q0p75_o48 -48.00 143.3 FORMAT "%5.1"
 /begin AXIS_DESCR STD_AXIS tmotfil temp_ub_q0p75_o48 12 -48.00 143.3 FORMAT "%5.1" DEPOSIT ABSOLUTE /end AXIS_DESCR
/end CHARACTERISTIC
/begin CHARACTERISTIC FDVANS "Temperaturfaktor f¸r Drosselventildurchfluﬂ" CURVE 0xFCD408 KlAUbSstUbWUb 1.992 fak_ub_b2 0.00 1.992 FORMAT "%5.3"
 /begin AXIS_DESCR STD_AXIS tans temp_ub_q0p75_o48 8 -48.00 143.3 FORMAT "%5.1" DEPOSIT ABSOLUTE /end AXIS_DESCR
/end CHARACTERISTIC
/begin CHARACTERISTIC FKMSDKMN "min.Korrekturfaktor schneller Massenstromabgleich" VALUE 0xFC2830 KwUb 3.984 fak_ub_b4 0.00 3.984 FORMAT "%5.3" /end CHARACTERISTIC
/begin CHARACTERISTIC FKMSDKMX "max.Korrekturfaktor schneller Massenstromabgleich" VALUE 0xFC2831 KwUb 3.984 fak_ub_b4 0.00 3.984 FORMAT "%5.3" /end CHARACTERISTIC
/begin CHARACTERISTIC FKMSVVTMN "min. Korrekturfaktor schneller Massenstromabgleich ungedrosselt" VALUE 0xFC2832 KwUb 3.984 fak_ub_b4 0.00 3.984 FORMAT "%5.3" /end CHARACTERISTIC
/begin CHARACTERISTIC FKMSVVTMX "max. Korrekturfaktor schneller Massenstromabgleich ungedrosselt" VALUE 0xFC2833 KwUb 3.984 fak_ub_b4 0.00 3.984 FORMAT "%5.3" /end CHARACTERISTIC
/begin CHARACTERISTIC FKPVDKE "Initialisierungswert f¸r Integrator Korrekturfaktor Massenstromabgleich" VALUE 0xFC2834 KwUb 3.984 fak_ub_b4 0.00 3.984 FORMAT "%5.3" /end CHARACTERISTIC
/begin CHARACTERISTIC FKPVDKMN "Minimaler Korrekturfaktor langsamer Massenstomabgleich" VALUE 0xFC2835 KwUb 3.984 fak_ub_b4 0.00 3.984 FORMAT "%5.3" /end CHARACTERISTIC
/begin CHARACTERISTIC FKPVDKMX "Maximaler Korrekturfaktor langsamer Massenstomabgleich" VALUE 0xFC2836 KwUb 3.984 fak_ub_b4 0.00 3.984 FORMAT "%5.3" /end CHARACTERISTIC
/begin CHARACTERISTIC FKPVVVTMN "Minimaler Korrekturfaktor langsamer Massenstomabgleich ungedrosselt" VALUE 0xFC2837 KwUb 3.984 fak_ub_b4 0.00 3.984 FORMAT "%5.3" /end CHARACTERISTIC
/begin CHARACTERISTIC FKPVVVTMX "Maximaler Korrekturfaktor langsamer Massenstomabgleich ungedrosselt" VALUE 0xFC2838 KwUb 3.984 fak_ub_b4 0.00 3.984 FORMAT "%5.3" /end CHARACTERISTIC
/begin CHARACTERISTIC FMLZKRST "Faktor 1/(Rho Kraftstoff[kg/l] * 14,7)  [l/kg]" VALUE 0xFD03E4 KwUb 0.9961 fak_ub_b1 0.00 0.9961 /end CHARACTERISTIC
/begin CHARACTERISTIC FMTEVEIN "Faktor Massenstrom durch TEV abh‰ngig von der Ansteuerzeit" CURVE 0xFC9B0A KlAUwSstUwWUw 0.9999847 fak_uw_b1 0.00 0.9999847 FORMAT "%9.7"
 /begin AXIS_DESCR STD_AXIS ttevein t128ms_uw 10 0.00 128.00 FORMAT "%6.2" DEPOSIT ABSOLUTE /end AXIS_DESCR
/end CHARACTERISTIC
/begin CHARACTERISTIC FPVMXN "Faktor maximales Druckverh‰ltnis mit Hauptlastsignal" CURVE 0xFCD3B4 KlAUwSstUwWUw 1.999969 fak_uw_b2 0.00 1.999969 FORMAT "%8.6"
 /begin AXIS_DESCR STD_AXIS nmot_w nmot_uw_q0p25 6 0.00 16383.75 FORMAT "%8.2" DEPOSIT ABSOLUTE /end AXIS_DESCR
/end CHARACTERISTIC
/begin CHARACTERISTIC FPVMXN2 "Faktor maximales Druckverh‰ltnis mit Nebenlastsignal" CURVE 0xFCD3CE KlAUwSstUwWUw 1.999969 fak_uw_b2 0.00 1.999969 FORMAT "%8.6"
 /begin AXIS_DESCR STD_AXIS nmot_w nmot_uw_q0p25 6 0.00 16383.75 FORMAT "%8.2" DEPOSIT ABSOLUTE /end AXIS_DESCR
/end CHARACTERISTIC
/begin CHARACTERISTIC FRSTSUAREA "" VALUE 0xFC2B72 KwUw 65535.00 dez 0.00 65535.00 FORMAT "%8.2" /end CHARACTERISTIC
/begin CHARACTERISTIC FUMRMV "Faktor Dichte der Luft" VALUE 0xFC9B08 KwUb 1.992 dichte_ub_b2 0.00 1.992 FORMAT "%5.3" /end CHARACTERISTIC
/begin CHARACTERISTIC FWFTBRTA "Wichtung ftbr in Abh‰ngigkeit von tans" CURVE 0xFCD41C KlAUbSstUbWUb 1.992 fak_ub_b2 0.00 1.992 FORMAT "%5.3"
 /begin AXIS_DESCR STD_AXIS tempin temp_ub_q0p75_o48 14 -48.00 143.3 FORMAT "%5.1" DEPOSIT ABSOLUTE /end AXIS_DESCR
/end CHARACTERISTIC
/begin CHARACTERISTIC FWTMTU "Faktor zur Wichtung zwischen Motortemperatur und Umgebungstemperatur" VALUE 0xFD03DE KwUb 0.9961 fak_ub_b1 0.00 0.9961 /end CHARACTERISTIC
/begin CHARACTERISTIC HUBFMAON "max.Hub Schwelle Freigabe der mult. Adaption" CURVE 0xFCD0D6 KlAUbSstUbWUw 65.53500 hub_uw_q0p001 0.00 65.53500 FORMAT "%8.5"
 /begin AXIS_DESCR STD_AXIS nmot nmot_ub_q40 4 0.00 10200. FORMAT "%5.0" DEPOSIT ABSOLUTE /end AXIS_DESCR
/end CHARACTERISTIC
/begin CHARACTERISTIC HUBFMAUN "min.Hub Schwelle Freigabe der mult. Adaption" CURVE 0xFCD0E4 KlAUbSstUbWUw 65.53500 hub_uw_q0p001 0.00 65.53500 FORMAT "%8.5"
 /begin AXIS_DESCR STD_AXIS nmot nmot_ub_q40 4 0.00 10200. FORMAT "%5.0" DEPOSIT ABSOLUTE /end AXIS_DESCR
/end CHARACTERISTIC
/begin CHARACTERISTIC HUBMSON "min.Hub Schwelle Freigabe der addi. Adaption" CURVE 0xFCD0F2 KlAUbSstUbWUw 65.53500 hub_uw_q0p001 0.00 65.53500 FORMAT "%8.5"
 /begin AXIS_DESCR STD_AXIS nmot nmot_ub_q40 4 0.00 10200. FORMAT "%5.0" DEPOSIT ABSOLUTE /end AXIS_DESCR
/end CHARACTERISTIC
/begin CHARACTERISTIC IGENLLRANH "Generatorstromabstand f¸r LL-Anhebung" VALUE 0xFC99C7 KwWU8 254.0 igen_ub_q1 0.00 254.0 FORMAT "%5.1" /end CHARACTERISTIC
/begin CHARACTERISTIC IMTUMTA "Schwelle integrierte Luftmasse f¸r Bestimmung Umgebungstemperatur" VALUE 0xFCD751 KwUb 23.21 m_ub_b23p3 0.00 23.21 FORMAT "%5.2" /end CHARACTERISTIC
/begin CHARACTERISTIC KFDFIGEN0 "" MAP 0xFC9728 KfAxU8AyU8SstxU8SstyU8WU8 99.61 PCENT 0.00 99.61 FORMAT "%5.2"
 /begin AXIS_DESCR STD_AXIS genitemp2 igen_ub_q1 8 0.00 255.0 FORMAT "%5.1" DEPOSIT ABSOLUTE /end AXIS_DESCR
 /begin AXIS_DESCR STD_AXIS igenrllrah igen_ub_q1 8 0.00 255.0 FORMAT "%5.1" DEPOSIT ABSOLUTE /end AXIS_DESCR
/end CHARACTERISTIC
/begin CHARACTERISTIC KFDFIGEN1 "" MAP 0xFC977C KfAxU8AyU8SstxU8SstyU8WU8 99.61 PCENT 0.00 99.61 FORMAT "%5.2"
 /begin AXIS_DESCR STD_AXIS genitemp2 igen_ub_q1 8 0.00 255.0 FORMAT "%5.1" DEPOSIT ABSOLUTE /end AXIS_DESCR
 /begin AXIS_DESCR STD_AXIS igenrllrah igen_ub_q1 8 0.00 255.0 FORMAT "%5.1" DEPOSIT ABSOLUTE /end AXIS_DESCR
/end CHARACTERISTIC
/begin CHARACTERISTIC KFDFIGEN2 "" MAP 0xFC97D0 KfAxU8AyU8SstxU8SstyU8WU8 99.61 PCENT 0.00 99.61 FORMAT "%5.2"
 /begin AXIS_DESCR STD_AXIS genitemp2 igen_ub_q1 8 0.00 255.0 FORMAT "%5.1" DEPOSIT ABSOLUTE /end AXIS_DESCR
 /begin AXIS_DESCR STD_AXIS igenrllrah igen_ub_q1 8 0.00 255.0 FORMAT "%5.1" DEPOSIT ABSOLUTE /end AXIS_DESCR
/end CHARACTERISTIC
/begin CHARACTERISTIC KFDFIGEN3 "" MAP 0xFC9824 KfAxU8AyU8SstxU8SstyU8WU8 99.61 PCENT 0.00 99.61 FORMAT "%5.2"
 /begin AXIS_DESCR STD_AXIS genitemp2 igen_ub_q1 8 0.00 255.0 FORMAT "%5.1" DEPOSIT ABSOLUTE /end AXIS_DESCR
 /begin AXIS_DESCR STD_AXIS igenrllrah igen_ub_q1 8 0.00 255.0 FORMAT "%5.1" DEPOSIT ABSOLUTE /end AXIS_DESCR
/end CHARACTERISTIC
/begin CHARACTERISTIC KFDFIGEN4 "" MAP 0xFC9878 KfAxU8AyU8SstxU8SstyU8WU8 99.61 PCENT 0.00 99.61 FORMAT "%5.2"
 /begin AXIS_DESCR STD_AXIS genitemp2 igen_ub_q1 8 0.00 255.0 FORMAT "%5.1" DEPOSIT ABSOLUTE /end AXIS_DESCR
 /begin AXIS_DESCR STD_AXIS igenrllrah igen_ub_q1 8 0.00 255.0 FORMAT "%5.1" DEPOSIT ABSOLUTE /end AXIS_DESCR
/end CHARACTERISTIC
/begin CHARACTERISTIC KFDFIGEN5 "" MAP 0xFC98CC KfAxU8AyU8SstxU8SstyU8WU8 99.61 PCENT 0.00 99.61 FORMAT "%5.2"
 /begin AXIS_DESCR STD_AXIS genitemp2 igen_ub_q1 8 0.00 255.0 FORMAT "%5.1" DEPOSIT ABSOLUTE /end AXIS_DESCR
 /begin AXIS_DESCR STD_AXIS igenrllrah igen_ub_q1 8 0.00 255.0 FORMAT "%5.1" DEPOSIT ABSOLUTE /end AXIS_DESCR
/end CHARACTERISTIC
/begin CHARACTERISTIC KFDFIGEN6 "" MAP 0xFC9920 KfAxU8AyU8SstxU8SstyU8WU8 99.61 PCENT 0.00 99.61 FORMAT "%5.2"
 /begin AXIS_DESCR STD_AXIS genitemp2 igen_ub_q1 8 0.00 255.0 FORMAT "%5.1" DEPOSIT ABSOLUTE /end AXIS_DESCR
 /begin AXIS_DESCR STD_AXIS igenrllrah igen_ub_q1 8 0.00 255.0 FORMAT "%5.1" DEPOSIT ABSOLUTE /end AXIS_DESCR
/end CHARACTERISTIC
/begin CHARACTERISTIC KFDFIGEN7 "" MAP 0xFC9974 KfAxU8AyU8SstxU8SstyU8WU8 99.61 PCENT 0.00 99.61 FORMAT "%5.2"
 /begin AXIS_DESCR STD_AXIS genitemp2 igen_ub_q1 8 0.00 255.0 FORMAT "%5.1" DEPOSIT ABSOLUTE /end AXIS_DESCR
 /begin AXIS_DESCR STD_AXIS igenrllrah igen_ub_q1 8 0.00 255.0 FORMAT "%5.1" DEPOSIT ABSOLUTE /end AXIS_DESCR
/end CHARACTERISTIC
/begin CHARACTERISTIC KFDKMS "Massenstrom ¸ber DK abh‰ngig von Druckverh‰ltnis und DK Winkel" MAP 0xFCD100 KfAxUwAyUwSstxSwSstyUwWUw 6553.500 m_uw_b6553p5 0.00 6553.500 FORMAT "%8.3"
 /begin AXIS_DESCR STD_AXIS wdkbab_w relDK_q0p02441 21 -800.0000 799.9756 FORMAT "%8.4" DEPOSIT ABSOLUTE /end AXIS_DESCR
 /begin AXIS_DESCR STD_AXIS dpipol_aus fak_uw_b2 8 0.00 1.999969 FORMAT "%8.6" DEPOSIT ABSOLUTE /end AXIS_DESCR
/end CHARACTERISTIC
/begin CHARACTERISTIC KFEHUBIV "Inverses Hubkennfeld gerechnet aus KFEHUB" MAP 0xFC2268 KfAxU8AyU8SstxU16SstyU16WU16 1535.977 rel_uw_q0p0234 0.00 1535.977 FORMAT "%8.3"
 /begin AXIS_DESCR STD_AXIS nmot_w nmot_uw_q0p25 16 0.00 16383.75 FORMAT "%8.2" DEPOSIT ABSOLUTE /end AXIS_DESCR
 /begin AXIS_DESCR STD_AXIS evhubin_w hub_uw_q0p001 24 0.00 65.53500 FORMAT "%8.5" DEPOSIT ABSOLUTE /end AXIS_DESCR
/end CHARACTERISTIC
/begin CHARACTERISTIC KFEHUBLLIV "Inverses Hubkennfeld gerechnet aus KFEHUBLL" MAP 0xFC25BC KfAxU8AyU8SstxU16SstyU16WU16 1638.375 m_uw_b1638p4 0.00 1638.375 FORMAT "%8.3"
 /begin AXIS_DESCR STD_AXIS evhubin_w hub_uw_q0p001 21 0.00 65.53500 FORMAT "%8.5" DEPOSIT ABSOLUTE /end AXIS_DESCR
 /begin AXIS_DESCR STD_AXIS nmot_w nmot_uw_q0p25 6 0.00 16383.75 FORMAT "%8.2" DEPOSIT ABSOLUTE /end AXIS_DESCR
/end CHARACTERISTIC
/begin CHARACTERISTIC KFEHUBLLKI "" MAP 0xFC26F2 KfAxU8AyU8SstxU16SstyU16WU16 1638.375 m_uw_b1638p4 0.00 1638.375 FORMAT "%8.3"
 /begin AXIS_DESCR STD_AXIS evhubin_w hub_uw_q0p001 21 0.00 65.53500 FORMAT "%8.5" DEPOSIT ABSOLUTE /end AXIS_DESCR
 /begin AXIS_DESCR STD_AXIS nmot_w nmot_uw_q0p25 6 0.00 16383.75 FORMAT "%8.2" DEPOSIT ABSOLUTE /end AXIS_DESCR
/end CHARACTERISTIC
/begin CHARACTERISTIC KFFWTBR "Wichtungsfaktor Tans/Tmot f¸r Brennraumtemperaturmodell" MAP 0xFCD43C KfAxUbAyUbSstxUbSstyUbWUb 0.9961 fak_ub_b1 0.00 0.9961
 /begin AXIS_DESCR STD_AXIS rl rel_ub_q0p75 10 0.00 191.3 FORMAT "%5.1" DEPOSIT ABSOLUTE /end AXIS_DESCR
 /begin AXIS_DESCR STD_AXIS nmot nmot_ub_q40 8 0.00 10200. FORMAT "%5.0" DEPOSIT ABSOLUTE /end AXIS_DESCR
/end CHARACTERISTIC
/begin CHARACTERISTIC KFKOMABNPU "mrfa-Schwelle ab der Klimakompressor nicht mehr abgeschalten wird" MAP 0xFD0468 KfAxUwAyUwSstxUwSstyUwWUw 199.9969 rel_uw_b200 0.00 199.9969 FORMAT "%8.4"
 /begin AXIS_DESCR STD_AXIS nmot_w nmot_uw_q0p25 4 0.00 16383.75 FORMAT "%8.2" DEPOSIT ABSOLUTE /end AXIS_DESCR
 /begin AXIS_DESCR STD_AXIS fho_w fak_uw_b4 3 0.00 3.999939 FORMAT "%8.6" DEPOSIT ABSOLUTE /end AXIS_DESCR
/end CHARACTERISTIC
/begin CHARACTERISTIC KFMSNVVT "Massenstrom ¸ber VVT im Start" MAP 0xFC285C KfAxUwAyUwSstxUwSstyUwWUw 6553.500 m_uw_b6553p5 0.00 6553.500 FORMAT "%8.3"
 /begin AXIS_DESCR STD_AXIS evhubs_w hub_uw_q0p001 16 0.00 65.53500 FORMAT "%8.5" DEPOSIT ABSOLUTE /end AXIS_DESCR
 /begin AXIS_DESCR STD_AXIS nmot_w nmot_uw_q0p25 6 0.00 16383.75 FORMAT "%8.2" DEPOSIT ABSOLUTE /end AXIS_DESCR
/end CHARACTERISTIC
/begin CHARACTERISTIC KFMSNWDK "Kennfeld normierter Massenstrom ¸ber DK" MAP 0xFCD28E KfAxUwAyUwSstxSwSstyUwWUw 6553.500 m_uw_b6553p5 0.00 6553.500 FORMAT "%8.3"
 /begin AXIS_DESCR STD_AXIS wdkbab_w relDK_q0p02441 16 -800.0000 799.9756 FORMAT "%8.4" DEPOSIT ABSOLUTE /end AXIS_DESCR
 /begin AXIS_DESCR STD_AXIS nmot_w nmot_uw_q0p25 6 0.00 16383.75 FORMAT "%8.2" DEPOSIT ABSOLUTE /end AXIS_DESCR
/end CHARACTERISTIC
/begin CHARACTERISTIC KFMSSPPSML "Massenstrom durch das Saugstrahlpumpenventil unter Normbedingungen" MAP 0xFCC0AA KfAxUwAyUwSstxUwSstyUwWUw 25.59961 m_uw_b25p6 0.00 25.59961 FORMAT "%8.5"
 /begin AXIS_DESCR STD_AXIS ml_w m_uw_b6553p5 12 0.00 6553.500 FORMAT "%8.3" DEPOSIT ABSOLUTE /end AXIS_DESCR
 /begin AXIS_DESCR STD_AXIS pspssp_w fak_uw_b2 8 0.00 1.999969 FORMAT "%8.6" DEPOSIT ABSOLUTE /end AXIS_DESCR
/end CHARACTERISTIC
/begin CHARACTERISTIC KFMTEDPML "" MAP 0xFCFBAA KfAxUwAyUwSstxUwSstyUwWUw 25.59961 m_uw_b25p6 0.00 25.59961 FORMAT "%8.5"
 /begin AXIS_DESCR STD_AXIS dps_uw p_q0p039s32768 12 -1280.00 1279.96 FORMAT "%7.2" DEPOSIT ABSOLUTE /end AXIS_DESCR
 /begin AXIS_DESCR STD_AXIS ml_w m_uw_b6553p5 8 0.00 6553.500 FORMAT "%8.3" DEPOSIT ABSOLUTE /end AXIS_DESCR
/end CHARACTERISTIC
/begin CHARACTERISTIC KFPRG00 "" MAP 0xFC2B74 GkfWUw 2559.961 p_uw_q0p039 0.00 2559.961 FORMAT "%8.3"
 /begin AXIS_DESCR COM_AXIS Vse_spri sprzi_q0p1 7 0.00 6554. FORMAT "%4.0" AXIS_PTS_REF SVE07FEUW /end AXIS_DESCR
 /begin AXIS_DESCR COM_AXIS Vsa_spri sprzi_q0p1 7 0.00 6554. FORMAT "%4.0" AXIS_PTS_REF SVA07FEUW /end AXIS_DESCR
/end CHARACTERISTIC
/begin CHARACTERISTIC KFPRG01 "" MAP 0xFC2BD6 GkfWUw 2559.961 p_uw_q0p039 0.00 2559.961 FORMAT "%8.3"
 /begin AXIS_DESCR COM_AXIS Vse_spri sprzi_q0p1 7 0.00 6554. FORMAT "%4.0" AXIS_PTS_REF SVE07FEUW /end AXIS_DESCR
 /begin AXIS_DESCR COM_AXIS Vsa_spri sprzi_q0p1 7 0.00 6554. FORMAT "%4.0" AXIS_PTS_REF SVA07FEUW /end AXIS_DESCR
/end CHARACTERISTIC
/begin CHARACTERISTIC KFPRG02 "" MAP 0xFC2C38 GkfWUw 2559.961 p_uw_q0p039 0.00 2559.961 FORMAT "%8.3"
 /begin AXIS_DESCR COM_AXIS Vse_spri sprzi_q0p1 7 0.00 6554. FORMAT "%4.0" AXIS_PTS_REF SVE07FEUW /end AXIS_DESCR
 /begin AXIS_DESCR COM_AXIS Vsa_spri sprzi_q0p1 7 0.00 6554. FORMAT "%4.0" AXIS_PTS_REF SVA07FEUW /end AXIS_DESCR
/end CHARACTERISTIC
/begin CHARACTERISTIC KFPRG03 "" MAP 0xFC2C9A GkfWUw 2559.961 p_uw_q0p039 0.00 2559.961 FORMAT "%8.3"
 /begin AXIS_DESCR COM_AXIS Vse_spri sprzi_q0p1 7 0.00 6554. FORMAT "%4.0" AXIS_PTS_REF SVE07FEUW /end AXIS_DESCR
 /begin AXIS_DESCR COM_AXIS Vsa_spri sprzi_q0p1 7 0.00 6554. FORMAT "%4.0" AXIS_PTS_REF SVA07FEUW /end AXIS_DESCR
/end CHARACTERISTIC
/begin CHARACTERISTIC KFPRG04 "" MAP 0xFC2CFC GkfWUw 2559.961 p_uw_q0p039 0.00 2559.961 FORMAT "%8.3"
 /begin AXIS_DESCR COM_AXIS Vse_spri sprzi_q0p1 7 0.00 6554. FORMAT "%4.0" AXIS_PTS_REF SVE07FEUW /end AXIS_DESCR
 /begin AXIS_DESCR COM_AXIS Vsa_spri sprzi_q0p1 7 0.00 6554. FORMAT "%4.0" AXIS_PTS_REF SVA07FEUW /end AXIS_DESCR
/end CHARACTERISTIC
/begin CHARACTERISTIC KFPRG05 "" MAP 0xFC2D5E GkfWUw 2559.961 p_uw_q0p039 0.00 2559.961 FORMAT "%8.3"
 /begin AXIS_DESCR COM_AXIS Vse_spri sprzi_q0p1 7 0.00 6554. FORMAT "%4.0" AXIS_PTS_REF SVE07FEUW /end AXIS_DESCR
 /begin AXIS_DESCR COM_AXIS Vsa_spri sprzi_q0p1 7 0.00 6554. FORMAT "%4.0" AXIS_PTS_REF SVA07FEUW /end AXIS_DESCR
/end CHARACTERISTIC
/begin CHARACTERISTIC KFPRG06 "" MAP 0xFC2DC0 GkfWUw 2559.961 p_uw_q0p039 0.00 2559.961 FORMAT "%8.3"
 /begin AXIS_DESCR COM_AXIS Vse_spri sprzi_q0p1 7 0.00 6554. FORMAT "%4.0" AXIS_PTS_REF SVE07FEUW /end AXIS_DESCR
 /begin AXIS_DESCR COM_AXIS Vsa_spri sprzi_q0p1 7 0.00 6554. FORMAT "%4.0" AXIS_PTS_REF SVA07FEUW /end AXIS_DESCR
/end CHARACTERISTIC
/begin CHARACTERISTIC KFPRG07 "" MAP 0xFC2E22 GkfWUw 2559.961 p_uw_q0p039 0.00 2559.961 FORMAT "%8.3"
 /begin AXIS_DESCR COM_AXIS Vse_spri sprzi_q0p1 7 0.00 6554. FORMAT "%4.0" AXIS_PTS_REF SVE07FEUW /end AXIS_DESCR
 /begin AXIS_DESCR COM_AXIS Vsa_spri sprzi_q0p1 7 0.00 6554. FORMAT "%4.0" AXIS_PTS_REF SVA07FEUW /end AXIS_DESCR
/end CHARACTERISTIC
/begin CHARACTERISTIC KFPRG08 "" MAP 0xFC2E84 GkfWUw 2559.961 p_uw_q0p039 0.00 2559.961 FORMAT "%8.3"
 /begin AXIS_DESCR COM_AXIS Vse_spri sprzi_q0p1 7 0.00 6554. FORMAT "%4.0" AXIS_PTS_REF SVE07FEUW /end AXIS_DESCR
 /begin AXIS_DESCR COM_AXIS Vsa_spri sprzi_q0p1 7 0.00 6554. FORMAT "%4.0" AXIS_PTS_REF SVA07FEUW /end AXIS_DESCR
/end CHARACTERISTIC
/begin CHARACTERISTIC KFPRG09 "" MAP 0xFC2EE6 GkfWUw 2559.961 p_uw_q0p039 0.00 2559.961 FORMAT "%8.3"
 /begin AXIS_DESCR COM_AXIS Vse_spri sprzi_q0p1 7 0.00 6554. FORMAT "%4.0" AXIS_PTS_REF SVE07FEUW /end AXIS_DESCR
 /begin AXIS_DESCR COM_AXIS Vsa_spri sprzi_q0p1 7 0.00 6554. FORMAT "%4.0" AXIS_PTS_REF SVA07FEUW /end AXIS_DESCR
/end CHARACTERISTIC
/begin CHARACTERISTIC KFPRG10 "" MAP 0xFC2F48 GkfWUw 2559.961 p_uw_q0p039 0.00 2559.961 FORMAT "%8.3"
 /begin AXIS_DESCR COM_AXIS Vse_spri sprzi_q0p1 7 0.00 6554. FORMAT "%4.0" AXIS_PTS_REF SVE07FEUW /end AXIS_DESCR
 /begin AXIS_DESCR COM_AXIS Vsa_spri sprzi_q0p1 7 0.00 6554. FORMAT "%4.0" AXIS_PTS_REF SVA07FEUW /end AXIS_DESCR
/end CHARACTERISTIC
/begin CHARACTERISTIC KFPRG11 "" MAP 0xFC2FAA GkfWUw 2559.961 p_uw_q0p039 0.00 2559.961 FORMAT "%8.3"
 /begin AXIS_DESCR COM_AXIS Vse_spri sprzi_q0p1 7 0.00 6554. FORMAT "%4.0" AXIS_PTS_REF SVE07FEUW /end AXIS_DESCR
 /begin AXIS_DESCR COM_AXIS Vsa_spri sprzi_q0p1 7 0.00 6554. FORMAT "%4.0" AXIS_PTS_REF SVA07FEUW /end AXIS_DESCR
/end CHARACTERISTIC
/begin CHARACTERISTIC KFPRG12 "" MAP 0xFC300C GkfWUw 2559.961 p_uw_q0p039 0.00 2559.961 FORMAT "%8.3"
 /begin AXIS_DESCR COM_AXIS Vse_spri sprzi_q0p1 7 0.00 6554. FORMAT "%4.0" AXIS_PTS_REF SVE07FEUW /end AXIS_DESCR
 /begin AXIS_DESCR COM_AXIS Vsa_spri sprzi_q0p1 7 0.00 6554. FORMAT "%4.0" AXIS_PTS_REF SVA07FEUW /end AXIS_DESCR
/end CHARACTERISTIC
/begin CHARACTERISTIC KFPRG13 "" MAP 0xFC306E GkfWUw 2559.961 p_uw_q0p039 0.00 2559.961 FORMAT "%8.3"
 /begin AXIS_DESCR COM_AXIS Vse_spri sprzi_q0p1 7 0.00 6554. FORMAT "%4.0" AXIS_PTS_REF SVE07FEUW /end AXIS_DESCR
 /begin AXIS_DESCR COM_AXIS Vsa_spri sprzi_q0p1 7 0.00 6554. FORMAT "%4.0" AXIS_PTS_REF SVA07FEUW /end AXIS_DESCR
/end CHARACTERISTIC
/begin CHARACTERISTIC KFPRG14 "" MAP 0xFC30D0 GkfWUw 2559.961 p_uw_q0p039 0.00 2559.961 FORMAT "%8.3"
 /begin AXIS_DESCR COM_AXIS Vse_spri sprzi_q0p1 7 0.00 6554. FORMAT "%4.0" AXIS_PTS_REF SVE07FEUW /end AXIS_DESCR
 /begin AXIS_DESCR COM_AXIS Vsa_spri sprzi_q0p1 7 0.00 6554. FORMAT "%4.0" AXIS_PTS_REF SVA07FEUW /end AXIS_DESCR
/end CHARACTERISTIC
/begin CHARACTERISTIC KFPRG15 "" MAP 0xFC3132 GkfWUw 2559.961 p_uw_q0p039 0.00 2559.961 FORMAT "%8.3"
 /begin AXIS_DESCR COM_AXIS Vse_spri sprzi_q0p1 7 0.00 6554. FORMAT "%4.0" AXIS_PTS_REF SVE07FEUW /end AXIS_DESCR
 /begin AXIS_DESCR COM_AXIS Vsa_spri sprzi_q0p1 7 0.00 6554. FORMAT "%4.0" AXIS_PTS_REF SVA07FEUW /end AXIS_DESCR
/end CHARACTERISTIC
/begin CHARACTERISTIC KFPRGSUL "" MAP 0xFC3194 GkfWUw 2559.961 p_uw_q0p039 0.00 2559.961 FORMAT "%8.3"
 /begin AXIS_DESCR COM_AXIS Vse_spri sprzi_q0p1 7 0.00 6554. FORMAT "%4.0" AXIS_PTS_REF SVE07FEUW /end AXIS_DESCR
 /begin AXIS_DESCR COM_AXIS Vsa_spri sprzi_q0p1 7 0.00 6554. FORMAT "%4.0" AXIS_PTS_REF SVA07FEUW /end AXIS_DESCR
/end CHARACTERISTIC
/begin CHARACTERISTIC KFSRMAREA "" MAP 0xFC2B2E KfAxU8AyU8SstxU8SstyU16WU8 14.00 dez 0.00 14.00 FORMAT "%5.2"
 /begin AXIS_DESCR STD_AXIS disa_pos dez 2 0.00 1.000 FORMAT "%5.3" DEPOSIT ABSOLUTE /end AXIS_DESCR
 /begin AXIS_DESCR STD_AXIS nmot_w nmot_uw_q0p25 15 0.00 10000.00 FORMAT "%8.2" DEPOSIT ABSOLUTE /end AXIS_DESCR
/end CHARACTERISTIC
/begin CHARACTERISTIC KFSTTANKR "Verst‰rkungsfaktor f¸r K-TP Filterung Tankf¸llstand rechts" VALUE 0xFD03E5 KwUb 0.9961 fak_ub_b1 0.00 0.9961 /end CHARACTERISTIC
/begin CHARACTERISTIC KFTWSLP "Wicklungstemperatur der SLP in Abh‰ngigkeit von der Batteriespannung" MAP 0xFCC25E KfAxU8AyU8SstxU16SstyU16WU16 1535.977 temp_q0p0234_o273 -273.1500 1262.827 FORMAT "%8.3"
 /begin AXIS_DESCR STD_AXIS twslpst_w temp_q0p0234_o273 4 -273.1500 1262.827 FORMAT "%8.3" DEPOSIT ABSOLUTE /end AXIS_DESCR
 /begin AXIS_DESCR STD_AXIS ubsqf_w spg_q0p00039 3 0.00 25.59961 FORMAT "%8.5" DEPOSIT ABSOLUTE /end AXIS_DESCR
/end CHARACTERISTIC
/begin CHARACTERISTIC KFURL00 "" MAP 0xFC31F6 GkfWUw 0.2999954 rel_uw_b0p3 0.00 0.2999954 FORMAT "%9.7"
 /begin AXIS_DESCR COM_AXIS Vse_spri sprzi_q0p1 7 0.00 6554. FORMAT "%4.0" AXIS_PTS_REF SVE07FEUW /end AXIS_DESCR
 /begin AXIS_DESCR COM_AXIS Vsa_spri sprzi_q0p1 7 0.00 6554. FORMAT "%4.0" AXIS_PTS_REF SVA07FEUW /end AXIS_DESCR
/end CHARACTERISTIC
/begin CHARACTERISTIC KFURL01 "" MAP 0xFC3258 GkfWUw 0.2999954 rel_uw_b0p3 0.00 0.2999954 FORMAT "%9.7"
 /begin AXIS_DESCR COM_AXIS Vse_spri sprzi_q0p1 7 0.00 6554. FORMAT "%4.0" AXIS_PTS_REF SVE07FEUW /end AXIS_DESCR
 /begin AXIS_DESCR COM_AXIS Vsa_spri sprzi_q0p1 7 0.00 6554. FORMAT "%4.0" AXIS_PTS_REF SVA07FEUW /end AXIS_DESCR
/end CHARACTERISTIC
/begin CHARACTERISTIC KFURL02 "" MAP 0xFC32BA GkfWUw 0.2999954 rel_uw_b0p3 0.00 0.2999954 FORMAT "%9.7"
 /begin AXIS_DESCR COM_AXIS Vse_spri sprzi_q0p1 7 0.00 6554. FORMAT "%4.0" AXIS_PTS_REF SVE07FEUW /end AXIS_DESCR
 /begin AXIS_DESCR COM_AXIS Vsa_spri sprzi_q0p1 7 0.00 6554. FORMAT "%4.0" AXIS_PTS_REF SVA07FEUW /end AXIS_DESCR
/end CHARACTERISTIC
/begin CHARACTERISTIC KFURL03 "" MAP 0xFC331C GkfWUw 0.2999954 rel_uw_b0p3 0.00 0.2999954 FORMAT "%9.7"
 /begin AXIS_DESCR COM_AXIS Vse_spri sprzi_q0p1 7 0.00 6554. FORMAT "%4.0" AXIS_PTS_REF SVE07FEUW /end AXIS_DESCR
 /begin AXIS_DESCR COM_AXIS Vsa_spri sprzi_q0p1 7 0.00 6554. FORMAT "%4.0" AXIS_PTS_REF SVA07FEUW /end AXIS_DESCR
/end CHARACTERISTIC
/begin CHARACTERISTIC KFURL04 "" MAP 0xFC337E GkfWUw 0.2999954 rel_uw_b0p3 0.00 0.2999954 FORMAT "%9.7"
 /begin AXIS_DESCR COM_AXIS Vse_spri sprzi_q0p1 7 0.00 6554. FORMAT "%4.0" AXIS_PTS_REF SVE07FEUW /end AXIS_DESCR
 /begin AXIS_DESCR COM_AXIS Vsa_spri sprzi_q0p1 7 0.00 6554. FORMAT "%4.0" AXIS_PTS_REF SVA07FEUW /end AXIS_DESCR
/end CHARACTERISTIC
/begin CHARACTERISTIC KFURL05 "" MAP 0xFC33E0 GkfWUw 0.2999954 rel_uw_b0p3 0.00 0.2999954 FORMAT "%9.7"
 /begin AXIS_DESCR COM_AXIS Vse_spri sprzi_q0p1 7 0.00 6554. FORMAT "%4.0" AXIS_PTS_REF SVE07FEUW /end AXIS_DESCR
 /begin AXIS_DESCR COM_AXIS Vsa_spri sprzi_q0p1 7 0.00 6554. FORMAT "%4.0" AXIS_PTS_REF SVA07FEUW /end AXIS_DESCR
/end CHARACTERISTIC
/begin CHARACTERISTIC KFURL06 "" MAP 0xFC3442 GkfWUw 0.2999954 rel_uw_b0p3 0.00 0.2999954 FORMAT "%9.7"
 /begin AXIS_DESCR COM_AXIS Vse_spri sprzi_q0p1 7 0.00 6554. FORMAT "%4.0" AXIS_PTS_REF SVE07FEUW /end AXIS_DESCR
 /begin AXIS_DESCR COM_AXIS Vsa_spri sprzi_q0p1 7 0.00 6554. FORMAT "%4.0" AXIS_PTS_REF SVA07FEUW /end AXIS_DESCR
/end CHARACTERISTIC
/begin CHARACTERISTIC KFURL07 "" MAP 0xFC34A4 GkfWUw 0.2999954 rel_uw_b0p3 0.00 0.2999954 FORMAT "%9.7"
 /begin AXIS_DESCR COM_AXIS Vse_spri sprzi_q0p1 7 0.00 6554. FORMAT "%4.0" AXIS_PTS_REF SVE07FEUW /end AXIS_DESCR
 /begin AXIS_DESCR COM_AXIS Vsa_spri sprzi_q0p1 7 0.00 6554. FORMAT "%4.0" AXIS_PTS_REF SVA07FEUW /end AXIS_DESCR
/end CHARACTERISTIC
/begin CHARACTERISTIC KFURL08 "" MAP 0xFC3506 GkfWUw 0.2999954 rel_uw_b0p3 0.00 0.2999954 FORMAT "%9.7"
 /begin AXIS_DESCR COM_AXIS Vse_spri sprzi_q0p1 7 0.00 6554. FORMAT "%4.0" AXIS_PTS_REF SVE07FEUW /end AXIS_DESCR
 /begin AXIS_DESCR COM_AXIS Vsa_spri sprzi_q0p1 7 0.00 6554. FORMAT "%4.0" AXIS_PTS_REF SVA07FEUW /end AXIS_DESCR
/end CHARACTERISTIC
/begin CHARACTERISTIC KFURL09 "" MAP 0xFC3568 GkfWUw 0.2999954 rel_uw_b0p3 0.00 0.2999954 FORMAT "%9.7"
 /begin AXIS_DESCR COM_AXIS Vse_spri sprzi_q0p1 7 0.00 6554. FORMAT "%4.0" AXIS_PTS_REF SVE07FEUW /end AXIS_DESCR
 /begin AXIS_DESCR COM_AXIS Vsa_spri sprzi_q0p1 7 0.00 6554. FORMAT "%4.0" AXIS_PTS_REF SVA07FEUW /end AXIS_DESCR
/end CHARACTERISTIC
/begin CHARACTERISTIC KFURL10 "" MAP 0xFC35CA GkfWUw 0.2999954 rel_uw_b0p3 0.00 0.2999954 FORMAT "%9.7"
 /begin AXIS_DESCR COM_AXIS Vse_spri sprzi_q0p1 7 0.00 6554. FORMAT "%4.0" AXIS_PTS_REF SVE07FEUW /end AXIS_DESCR
 /begin AXIS_DESCR COM_AXIS Vsa_spri sprzi_q0p1 7 0.00 6554. FORMAT "%4.0" AXIS_PTS_REF SVA07FEUW /end AXIS_DESCR
/end CHARACTERISTIC
/begin CHARACTERISTIC KFURL11 "" MAP 0xFC362C GkfWUw 0.2999954 rel_uw_b0p3 0.00 0.2999954 FORMAT "%9.7"
 /begin AXIS_DESCR COM_AXIS Vse_spri sprzi_q0p1 7 0.00 6554. FORMAT "%4.0" AXIS_PTS_REF SVE07FEUW /end AXIS_DESCR
 /begin AXIS_DESCR COM_AXIS Vsa_spri sprzi_q0p1 7 0.00 6554. FORMAT "%4.0" AXIS_PTS_REF SVA07FEUW /end AXIS_DESCR
/end CHARACTERISTIC
/begin CHARACTERISTIC KFURL12 "" MAP 0xFC368E GkfWUw 0.2999954 rel_uw_b0p3 0.00 0.2999954 FORMAT "%9.7"
 /begin AXIS_DESCR COM_AXIS Vse_spri sprzi_q0p1 7 0.00 6554. FORMAT "%4.0" AXIS_PTS_REF SVE07FEUW /end AXIS_DESCR
 /begin AXIS_DESCR COM_AXIS Vsa_spri sprzi_q0p1 7 0.00 6554. FORMAT "%4.0" AXIS_PTS_REF SVA07FEUW /end AXIS_DESCR
/end CHARACTERISTIC
/begin CHARACTERISTIC KFURL13 "" MAP 0xFC36F0 GkfWUw 0.2999954 rel_uw_b0p3 0.00 0.2999954 FORMAT "%9.7"
 /begin AXIS_DESCR COM_AXIS Vse_spri sprzi_q0p1 7 0.00 6554. FORMAT "%4.0" AXIS_PTS_REF SVE07FEUW /end AXIS_DESCR
 /begin AXIS_DESCR COM_AXIS Vsa_spri sprzi_q0p1 7 0.00 6554. FORMAT "%4.0" AXIS_PTS_REF SVA07FEUW /end AXIS_DESCR
/end CHARACTERISTIC
/begin CHARACTERISTIC KFURL14 "" MAP 0xFC3752 GkfWUw 0.2999954 rel_uw_b0p3 0.00 0.2999954 FORMAT "%9.7"
 /begin AXIS_DESCR COM_AXIS Vse_spri sprzi_q0p1 7 0.00 6554. FORMAT "%4.0" AXIS_PTS_REF SVE07FEUW /end AXIS_DESCR
 /begin AXIS_DESCR COM_AXIS Vsa_spri sprzi_q0p1 7 0.00 6554. FORMAT "%4.0" AXIS_PTS_REF SVA07FEUW /end AXIS_DESCR
/end CHARACTERISTIC
/begin CHARACTERISTIC KFURL15 "" MAP 0xFC37B4 GkfWUw 0.2999954 rel_uw_b0p3 0.00 0.2999954 FORMAT "%9.7"
 /begin AXIS_DESCR COM_AXIS Vse_spri sprzi_q0p1 7 0.00 6554. FORMAT "%4.0" AXIS_PTS_REF SVE07FEUW /end AXIS_DESCR
 /begin AXIS_DESCR COM_AXIS Vsa_spri sprzi_q0p1 7 0.00 6554. FORMAT "%4.0" AXIS_PTS_REF SVA07FEUW /end AXIS_DESCR
/end CHARACTERISTIC
/begin CHARACTERISTIC KFURLSUL "" MAP 0xFC3816 GkfWUw 0.2999954 rel_uw_b0p3 0.00 0.2999954 FORMAT "%9.7"
 /begin AXIS_DESCR COM_AXIS Vse_spri sprzi_q0p1 7 0.00 6554. FORMAT "%4.0" AXIS_PTS_REF SVE07FEUW /end AXIS_DESCR
 /begin AXIS_DESCR COM_AXIS Vsa_spri sprzi_q0p1 7 0.00 6554. FORMAT "%4.0" AXIS_PTS_REF SVA07FEUW /end AXIS_DESCR
/end CHARACTERISTIC
/begin CHARACTERISTIC KFZKMSVT "Zeitkonstante f¸r schnellen Massenstromabgleich" MAP 0xFC294C KfAxUwAyUwSstxUwSstyUwWUw 15.62478 mk10ms_uw_q2p384e5n 0.00 15.62478 FORMAT "%8.5"
 /begin AXIS_DESCR STD_AXIS rlvw_w rel_uw_q0p0234 10 0.00 1535.977 FORMAT "%8.3" DEPOSIT ABSOLUTE /end AXIS_DESCR
 /begin AXIS_DESCR STD_AXIS nmot_w nmot_uw_q0p25 10 0.00 16383.75 FORMAT "%8.2" DEPOSIT ABSOLUTE /end AXIS_DESCR
/end CHARACTERISTIC
/begin CHARACTERISTIC KIMSA "Beiwert f¸r Leerlaufluftmassenintegrator f¸r E-Gas" VALUE 0xFCD090 KwUb 0.1660 m_ub_b0p166 0.00 0.1660 FORMAT "%6.4" /end CHARACTERISTIC
/begin CHARACTERISTIC KIMSALL "Beiwert f¸r Leerlaufluftmassenintegrator f¸r E-Gas" VALUE 0xFCD091 KwUb 10.58 m_ub_q0p0415 0.00 10.58 FORMAT "%5.2" /end CHARACTERISTIC
/begin CHARACTERISTIC KIMSALLVT "Beiwert f¸r Leerlaufluftmassenintegrator f¸r VVT" VALUE 0xFCD092 KwUb 10.58 m_ub_q0p0415 0.00 10.58 FORMAT "%5.2" /end CHARACTERISTIC
/begin CHARACTERISTIC KIMSAVT "Beiwert f¸r Leerlaufluftmassenintegrator f¸r VVT" VALUE 0xFCD093 KwUb 0.1660 m_ub_b0p166 0.00 0.1660 FORMAT "%6.4" /end CHARACTERISTIC
/begin CHARACTERISTIC KIMSNLL "Beiwert f¸r Leerlaufwinkelintegrator" VALUE 0xFCD094 KwUb 10.58 m_ub_q0p0415 0.00 10.58 FORMAT "%5.2" /end CHARACTERISTIC
/begin CHARACTERISTIC KISRM "Integratorbeiwert f¸r Saugrohrmodell (Dynamik)" VALUE 0xFC3878 KwUw 0.9999847 fak_uw_b1 0.00 0.9999847 FORMAT "%9.7" /end CHARACTERISTIC
/begin CHARACTERISTIC KISRMSU "Integrationsbeiwert f¸r Saugrohrmodell bei sumode=1" VALUE 0xFC387A KwUw 0.9999847 fak_uw_b1 0.00 0.9999847 FORMAT "%9.7" /end CHARACTERISTIC
/begin CHARACTERISTIC KLMSNVTOM "Korrektur Luftmasse bei VVT im LL abh‰ngig von trefvvt" CURVE 0xFCD37E KlAUwSstUwWSw 6553.500 m_uw_b6553p5 -3276.800 3276.700 FORMAT "%8.3"
 /begin AXIS_DESCR STD_AXIS trefvvto temp_ub_q0p75_o48 12 -48.00000 49103.25 FORMAT "%8.2" DEPOSIT ABSOLUTE /end AXIS_DESCR
/end CHARACTERISTIC
/begin CHARACTERISTIC KLTDSTEND "Kennlinie: Verzugszeit f¸r Bit B_stend abh‰ngig von tmst" CURVE 0xFCD098 KlAUbSstUbWUb 2.550 t10msxs_ub_b2p55 0.00 2.550 FORMAT "%5.3"
 /begin AXIS_DESCR STD_AXIS tmst temp_ub_q0p75_o48 4 -48.00 143.3 FORMAT "%5.1" DEPOSIT ABSOLUTE /end AXIS_DESCR
/end CHARACTERISTIC
/begin CHARACTERISTIC KLZKBGMSDK "Zeitkonstante Korrekturwerte GD Betrieb" CURVE 0xFC2A40 KlAUwSstUwWUw 0.9999847 fak_uw_b1 0.00 0.9999847 FORMAT "%9.7"
 /begin AXIS_DESCR STD_AXIS dpsfak fak_ub_q0p00392 8 0.00 1.000 FORMAT "%5.3" DEPOSIT ABSOLUTE /end AXIS_DESCR
/end CHARACTERISTIC
/begin CHARACTERISTIC KUMSRL "Umrechnungskonstante von Massenstrom in relative Luftf¸llung" VALUE 0xFC2839 KwUb 0.001992 kumsrl_ub_b0p002 0.00 0.001992 FORMAT "%8.6" /end CHARACTERISTIC
/begin CHARACTERISTIC KVLAD "Konstante f¸r Umrechnung von Ladedruck in Luftmasse" VALUE 0xFC283A KwUb 1.992 rel_ub_b2p0 0.00 1.992 FORMAT "%5.3" /end CHARACTERISTIC
/begin CHARACTERISTIC LADFIL "Ladedruckfilterung" VALUE 0xFC283B KwUb 0.9961 fak_ub_b1 0.00 0.9961 /end CHARACTERISTIC
/begin CHARACTERISTIC LBMINIT "Initialisierungswert des Z‰hlers Bezugsmarkenverlust, wenn SG zuvor im NLDG war" VALUE 0xFC1DCA KwWU16 65535.00 dez 0.00 65535.00 FORMAT "%8.2" /end CHARACTERISTIC
/begin CHARACTERISTIC LBMMX "Maximalwert f¸r Z‰hler Bezugsmarkenverlust" VALUE 0xFC1DCC KwWU16 65535.00 dez 0.00 65535.00 FORMAT "%8.2" /end CHARACTERISTIC
/begin CHARACTERISTIC LLRABS_DF "DF-Schwelle f¸r LL-Absenkung" VALUE 0xFC99C8 KwWU8 99.61 PCENT 0.00 99.61 FORMAT "%5.2" /end CHARACTERISTIC
/begin CHARACTERISTIC LLRANH_DF "DF-Schwelle f¸r LL-Anhebung" VALUE 0xFC99C9 KwWU8 99.61 PCENT 0.00 99.61 FORMAT "%5.2" /end CHARACTERISTIC
/begin CHARACTERISTIC LNXQTM "Nat¸rlicher Logarithmus aus Temperaturquotient" CURVE 0xFCD766 KlAUwSstUwWUw 3.999939 fak_uw_b4 0.00 3.999939 FORMAT "%8.6"
 /begin AXIS_DESCR STD_AXIS xqtm_w fak_uw_b16 12 0.00 15.99976 FORMAT "%8.5" DEPOSIT ABSOLUTE /end AXIS_DESCR
/end CHARACTERISTIC
/begin CHARACTERISTIC MDNORM "Maximales indiziertes Motormoment f¸r Moment-Normierung" VALUE 0xFC0ECD KwUb 1008. md_ub_q16 0.00 1008. FORMAT "%5.0" /end CHARACTERISTIC
/begin CHARACTERISTIC MIMSRMXN "Maximal zul‰ssiges MSR-Moment" CURVE 0xFC0EA6 KlAUwSstUwWUw 99.99847 rel_uw_b100 0.00 99.99847 FORMAT "%8.5"
 /begin AXIS_DESCR STD_AXIS nmot_w nmot_uw_q0p25 6 0.00 16383.75 FORMAT "%8.2" DEPOSIT ABSOLUTE /end AXIS_DESCR
/end CHARACTERISTIC
/begin CHARACTERISTIC MLFKMSDK "Luftmassenstromschwelle f¸r multipl. Abgleich von HFM- und DK-Massenstrom" VALUE 0xFC2A62 KwUw 6553.500 m_uw_b6553p5 0.00 6553.500 FORMAT "%8.3" /end CHARACTERISTIC
/begin CHARACTERISTIC MLMAX "Maximaler Luftfluﬂ f¸r die Lastberechnung nach SAE J1979" VALUE 0xFCD3B2 KwUw 6553.500 m_uw_b6553p5 0.00 6553.500 FORMAT "%8.3" /end CHARACTERISTIC
/begin CHARACTERISTIC MRFAMXKAHY "Hysterese f¸r Sperren Klimakompressor ¸ber mrfa-Schwelle" VALUE 0xFD0492 KwUw 199.9969 rel_uw_b200 0.00 199.9969 FORMAT "%8.4" /end CHARACTERISTIC
/begin CHARACTERISTIC MSALLMN "Minimale Leerlaufluftmassenadaption f¸r E-Gas" VALUE 0xFC283C KwSb 25.50 m_ub_q0p1 -12.80 12.70 FORMAT "%5.2" /end CHARACTERISTIC
/begin CHARACTERISTIC MSALLMX "Maximale Leerlaufluftmassenadaption f¸r E-Gas" VALUE 0xFC283D KwSb 25.50 m_ub_q0p1 -12.80 12.70 FORMAT "%5.2" /end CHARACTERISTIC
/begin CHARACTERISTIC MSLG "Massenstrom Leckluft gesamt" VALUE 0xFC283E KwSb 25.50 m_ub_q0p1 -12.80 12.70 FORMAT "%5.2" /end CHARACTERISTIC
/begin CHARACTERISTIC NASPR "Rover" VALUE 0xFC9BC2 KwUw 100.0000 kw_q1 50.00000 150.0000 FORMAT "%8.4" /end CHARACTERISTIC
/begin CHARACTERISTIC NDECJ "Drehzahl-Schwelle f¸r CJ400-Endstufendiagnose" VALUE 0xFC2030 KwUb 10200. nmot_ub_q40 0.00 10200. FORMAT "%5.0" /end CHARACTERISTIC
/begin CHARACTERISTIC NMSNDKO "Drehzahlschwelle f¸r Integratorfreigabe zur Adaption der Leckluft" VALUE 0xFC283F KwUb 10200. nmot_ub_q40 0.00 10200. FORMAT "%5.0" /end CHARACTERISTIC
/begin CHARACTERISTIC NMSNVTO "Drehzahlschwelle f¸r Integratorfreigabe zur Adaption der Leckluft VVT" VALUE 0xFC2840 KwUb 10200. nmot_ub_q40 0.00 10200. FORMAT "%5.0" /end CHARACTERISTIC
/begin CHARACTERISTIC NRLMNIST "Drehzahlwert f¸r konstantes rl im Start" VALUE 0xFC2A64 KwUw 16383.75 nmot_uw_q0p25 0.00 16383.75 FORMAT "%8.2" /end CHARACTERISTIC
/begin CHARACTERISTIC NTUMTA "Schwelle Drehzahl f¸r Bestimmung Umgebungstemperatur" VALUE 0xFCD752 KwUb 10200. nmot_ub_q40 0.00 10200. FORMAT "%5.0" /end CHARACTERISTIC
/begin CHARACTERISTIC NTWBGLLGEN "Notlaufwert Leerlaufanhebung bei Generatorfehler" VALUE 0xFC99CA KwWU8 1.000 dez 0.00 1.000 FORMAT "%5.3" /end CHARACTERISTIC
/begin CHARACTERISTIC NV "" CURVE 0xFC1F22 FklWU16 511.9922 qnv_uw_b512 0.00 511.9922 FORMAT "%8.4"
 /begin AXIS_DESCR FIX_AXIS gangctr dez 6 0.00 5.000 FORMAT "%5.3" FIX_AXIS_PAR 0 0 6 /end AXIS_DESCR
/end CHARACTERISTIC
/begin CHARACTERISTIC NVGMN "Minimales NV-Verh‰ltnis" CURVE 0xFC1F2E FklWS16 25599.94 nmotg_sw_q0p39 -12800.16 12799.77 FORMAT "%8.2"
 /begin AXIS_DESCR FIX_AXIS gangctr dez 6 0.00 5.000 FORMAT "%5.3" FIX_AXIS_PAR 0 0 6 /end AXIS_DESCR
/end CHARACTERISTIC
/begin CHARACTERISTIC NVGMX "Maximales NV-Verh‰ltnis" CURVE 0xFC1F3A FklWS16 25599.94 nmotg_sw_q0p39 -12800.16 12799.77 FORMAT "%8.2"
 /begin AXIS_DESCR FIX_AXIS gangctr dez 6 0.00 5.000 FORMAT "%5.3" FIX_AXIS_PAR 0 0 6 /end AXIS_DESCR
/end CHARACTERISTIC
/begin CHARACTERISTIC NVO "n/v Schwelle f¸r Z¸ndwinkelsp‰tziehen  oberer Gang" CURVE 0xFC1F46 FklWU16 511.9922 qnv_uw_b512 0.00 511.9922 FORMAT "%8.4"
 /begin AXIS_DESCR FIX_AXIS gangctr dez 6 0.00 5.000 FORMAT "%5.3" FIX_AXIS_PAR 0 0 6 /end AXIS_DESCR
/end CHARACTERISTIC
/begin CHARACTERISTIC NVV "" CURVE 0xFC1F52 FklWU16 81918.75 vfzg_ub_q1p25 0.00 81918.75 FORMAT "%8.2"
 /begin AXIS_DESCR FIX_AXIS gangctr dez 6 0.00 5.000 FORMAT "%5.3" FIX_AXIS_PAR 0 0 6 /end AXIS_DESCR
/end CHARACTERISTIC
/begin CHARACTERISTIC NW_ADP_MN "Minimalwert Adaption NW" VAL_BLK 0xFC9BC4 KwbUw 6554. sprzi_q0p1 0.00 6554. FORMAT "%4.0" NUMBER 4 /end CHARACTERISTIC
/begin CHARACTERISTIC NW_ADP_MX "Maximalwert Adaption NW" VAL_BLK 0xFC9BCC KwbUw 6554. sprzi_q0p1 0.00 6554. FORMAT "%4.0" NUMBER 4 /end CHARACTERISTIC
/begin CHARACTERISTIC NW_POSMN "Minimalwert Nw_pos" VAL_BLK 0xFC9BD4 KwbUw 6554. sprzi_q0p1 0.00 6554. FORMAT "%4.0" NUMBER 4 /end CHARACTERISTIC
/begin CHARACTERISTIC NW_POSMX "Maximalwert Nw_pos" VAL_BLK 0xFC9BDC KwbUw 6554. sprzi_q0p1 0.00 6554. FORMAT "%4.0" NUMBER 4 /end CHARACTERISTIC
/begin CHARACTERISTIC OPBKVUKKB "Offset zu DPBKVUKKPU bei bet‰tigter Bremse" VALUE 0xFD0494 KwSw 2559.961 p_sw_q0p039 -1280.000 1279.961 FORMAT "%8.3" /end CHARACTERISTIC
/begin CHARACTERISTIC OPBKVUKNKH "Offset zu DPBKVUKNKH bei bet‰tigter Bremse" VALUE 0xFD0496 KwSw 2559.961 p_sw_q0p039 -1280.000 1279.961 FORMAT "%8.3" /end CHARACTERISTIC
/begin CHARACTERISTIC OPBKVUKNWB "Offset zu DPBKVUKNW bei bet‰tigter Bremse" VALUE 0xFD0498 KwSw 2559.961 p_sw_q0p039 -1280.000 1279.961 FORMAT "%8.3" /end CHARACTERISTIC
/begin CHARACTERISTIC OPBKVUKPB "Offset zu DPBKVUKP bei bet‰tigter Bremse" VALUE 0xFD049A KwSw 2559.961 p_sw_q0p039 -1280.000 1279.961 FORMAT "%8.3" /end CHARACTERISTIC
/begin CHARACTERISTIC OPBKVUKPUB "Offset zu DPBKVUKPU bei bet‰tigter Bremse" VALUE 0xFD049C KwSw 2559.961 p_sw_q0p039 -1280.000 1279.961 FORMAT "%8.3" /end CHARACTERISTIC
/begin CHARACTERISTIC PBKVKREHY "Hysterese zur kritischen Obergrenze f¸r Druck im BKV  f¸r Ersatzmaﬂnahmen" VALUE 0xFD049E KwUw 2559.961 p_uw_q0p039 0.00 2559.961 FORMAT "%8.3" /end CHARACTERISTIC
/begin CHARACTERISTIC PBKVKRHY "Hysterese zur kritischen Obergrenze f¸r Druck im Bremskraftverst‰rker" VALUE 0xFD04A0 KwUw 2559.961 p_uw_q0p039 0.00 2559.961 FORMAT "%8.3" /end CHARACTERISTIC
/begin CHARACTERISTIC PGFLNL "Anzahl an Phasenflanken bis NLDG aufgerufen wird bei eingetragenem E_n" VALUE 0xFC1DCE KwWU16 65535.00 DEZ 0.00 65535.00 FORMAT "%8.2" /end CHARACTERISTIC
/begin CHARACTERISTIC PGFLWA "Anzahl PG-Flankenwechsel f¸r DG-Fehler B_signal" VALUE 0xFC1DD0 KwWU16 65535.00 DEZ 0.00 65535.00 FORMAT "%8.2" /end CHARACTERISTIC
/begin CHARACTERISTIC PRELLDFAH "Prellzeit f¸r LLR-Anhebung" VALUE 0xFC99CB KwWU8 25.50 t100msxs_ub_b25p5 0.00 25.50 FORMAT "%5.2" /end CHARACTERISTIC
/begin CHARACTERISTIC PRELLDFRF "Prellzeit f¸r LLR-Absenkung" VALUE 0xFC99CC KwWU8 25.50 t100msxs_ub_b25p5 0.00 25.50 FORMAT "%5.2" /end CHARACTERISTIC
/begin CHARACTERISTIC PSPVDKUGN "Verh‰ltnis pspvdk ungedrosselt" CURVE 0xFC2A66 KlAUwSstUwWUw 1.999969 fak_uw_b2 0.00 1.999969 FORMAT "%8.6"
 /begin AXIS_DESCR STD_AXIS nmot_w nmot_uw_q0p25 12 0.00 16383.75 FORMAT "%8.2" DEPOSIT ABSOLUTE /end AXIS_DESCR
/end CHARACTERISTIC
/begin CHARACTERISTIC RKACOMN "untere Schwelle additive Korrektur pro Zeit LL-CO Abgleich" VALUE 0xFC4A68 KwSw 20.01563 rel_sw_b1536 -20.01563 0.00 FORMAT "%8.5" /end CHARACTERISTIC
/begin CHARACTERISTIC RKACOMX "obere Schwelle additive Korrektur pro Zeit LL-CO Abgleich" VALUE 0xFC4A6A KwSw 20.01563 rel_sw_b1536 0.00 20.01563 FORMAT "%8.5" /end CHARACTERISTIC
/begin CHARACTERISTIC RLNOT "Notlauf rl bei E_DK und E_LM" CURVE 0xFC2844 KlAUbSstUbWUb 191.3 rel_ub_q0p75 0.00 191.3 FORMAT "%5.1"
 /begin AXIS_DESCR STD_AXIS nmot nmot_ub_q40 6 0.00 10200. FORMAT "%5.0" DEPOSIT ABSOLUTE /end AXIS_DESCR
/end CHARACTERISTIC
/begin CHARACTERISTIC SRMAREANM "" MAP 0xFC2ADC KfAxU8AyU8SstxU8SstyU16WU16 10000.00 nmot_uw_q0p25 0.00 10000.00 FORMAT "%8.2"
 /begin AXIS_DESCR STD_AXIS srmarea dez 15 0.00 14.00 FORMAT "%5.2" DEPOSIT ABSOLUTE /end AXIS_DESCR
 /begin AXIS_DESCR STD_AXIS hilo dez 2 0.00 1.000000 FORMAT "%8.6" DEPOSIT ABSOLUTE /end AXIS_DESCR
/end CHARACTERISTIC
/begin CHARACTERISTIC STM_ERR "L¸fteranforderung bei CAN-INST3-Ausfall" VALUE 0xFCC818 KwUb 15.00 dez 0.00 15.00 FORMAT "%5.2" /end CHARACTERISTIC
/begin AXIS_PTS SVA07FEUW "" 0xFC115E Vsa_spri SstAUwSstUw 6554. sprzi_q0p1 7 0.00 6554. FORMAT "%4.0" DEPOSIT ABSOLUTE /end AXIS_PTS
/begin AXIS_PTS SVE07FEUW "" 0xFC116E Vse_spri SstAUwSstUw 6554. sprzi_q0p1 7 0.00 6554. FORMAT "%4.0" DEPOSIT ABSOLUTE /end AXIS_PTS
/begin CHARACTERISTIC S_DISAVORH "" VALUE 0xFC2B6F KwWU8 1.000 dez 0.00 1.000 FORMAT "%5.3" /end CHARACTERISTIC
/begin CHARACTERISTIC S_HUBINST "Umschaltung evhubs_w / evhubin_w f¸r KFMSNVVT" VALUE 0xFC2851 KwUb 255.0 dez 0.00 255.0 FORMAT "%5.1" /end CHARACTERISTIC
/begin CHARACTERISTIC S_MSDKIST "Umschaltung Nebenlastsignal unabh‰ngig von B_stend" VALUE 0xFC2852 KwUb 255.0 dez 0.00 255.0 FORMAT "%5.1" /end CHARACTERISTIC
/begin CHARACTERISTIC S_NNADAP "Einschalten multilineare Regression im LL (1)" VALUE 0xFC2853 KwUb 255.0 dez 0.00 255.0 FORMAT "%5.1" /end CHARACTERISTIC
/begin CHARACTERISTIC TASCNP "Entprellzeit ASC-Signal nicht plaus." VALUE 0xFC0EA3 KwUb 25.50 t100msxs_ub_b25p5 0.00 25.50 FORMAT "%5.2" /end CHARACTERISTIC
/begin CHARACTERISTIC TASCNP2 "Entprellzeit ASC-Signal nicht plaus." VALUE 0xFC0EA4 KwUb 2.550 t10msxs_ub_b2p55 0.00 2.550 FORMAT "%5.3" /end CHARACTERISTIC
/begin CHARACTERISTIC TDBKVKOMAB "Verzˆgerungszeit der Forderung Klimakompressor abschalten" VALUE 0xFD03FF KwUb 5.100 t20msxs_ub_q0p02 0.00 5.100 FORMAT "%5.3" /end CHARACTERISTIC
/begin CHARACTERISTIC TDBKVNKHAB "Verzˆgerungszeit der Forderung LL-Drehzahl f¸r KH abschalten" VALUE 0xFD0400 KwUb 5.100 t20msxs_ub_q0p02 0.00 5.100 FORMAT "%5.3" /end CHARACTERISTIC
/begin CHARACTERISTIC TDBKVNWAB "Verzˆgerungszeit f¸r NW-Umschaltung min. ‹berschneidung" VALUE 0xFD0401 KwUb 5.100 t20msxs_ub_q0p02 0.00 5.100 FORMAT "%5.3" /end CHARACTERISTIC
/begin CHARACTERISTIC TDBKVP "Verzˆgerung des Bits B_pbkvmn bei ausreichendem Saugrohrdruck" VALUE 0xFD0402 KwUb 5.100 t20msxs_ub_q0p02 0.00 5.100 FORMAT "%5.3" /end CHARACTERISTIC
/begin CHARACTERISTIC TDBKVSTED "Einschaltverzˆgerung  der Steuerbits der BKV-Funktion nach Startende" VALUE 0xFD04A2 KwUw 655.3500 t10msxs_uw_b655p35 0.00 655.3500 FORMAT "%8.4" /end CHARACTERISTIC
/begin CHARACTERISTIC TDCANA1 "Zeit f¸r Fehlererkennung ""CAN_A Error passiv""" VALUE 0xFC0ECA KwWU8 2.550 t10msxs_ub_b2p55 0.00 2.550 FORMAT "%5.3" /end CHARACTERISTIC
/begin CHARACTERISTIC TDCANA3 "Zeit f¸r Fehlererkennung ""CAN_A BUS off""" VALUE 0xFC0ECB KwWU8 2.550 t10msxs_ub_b2p55 0.00 2.550 FORMAT "%5.3" /end CHARACTERISTIC
/begin CHARACTERISTIC TDCANAH "Heilungsentprellzeit f¸r CAN_A-Fehler" VALUE 0xFC0ECC KwWU8 2.550 t10msxs_ub_b2p55 0.00 2.550 FORMAT "%5.3" /end CHARACTERISTIC
/begin CHARACTERISTIC TDCAS "Zeit f¸r Timeouterkennung CAN-Schnittstelle ASC" VALUE 0xFC0EC0 KwWU16 655.3500 t10msxs_uw_b655p35 0.00 655.3500 FORMAT "%8.4" /end CHARACTERISTIC
/begin CHARACTERISTIC TDCEZ "Zeit f¸r Timeouterkennung CAN-Schnittstelle EZH" VALUE 0xFC0EC2 KwWU16 655.3500 t10msxs_uw_b655p35 0.00 655.3500 FORMAT "%8.4" /end CHARACTERISTIC
/begin CHARACTERISTIC TDCGE "Zeit f¸r Timeouterkennung CAN-Schnittstelle EGS" VALUE 0xFC0EC4 KwWU16 655.3500 t10msxs_uw_b655p35 0.00 655.3500 FORMAT "%8.4" /end CHARACTERISTIC
/begin CHARACTERISTIC TDCINS "Zeit f¸r Timeouterkennung CAN-Schnittstelle Kombi-Instr." VALUE 0xFC0EC6 KwWU16 655.3500 t10msxs_uw_b655p35 0.00 655.3500 FORMAT "%8.4" /end CHARACTERISTIC
/begin CHARACTERISTIC TDDIAGEL "Zeitdauer Berechnung Endstufen-Diagnose E-Box Luefter gesperrt" VALUE 0xFCCD66 KwWU8 25.50 t_q0p1 0.00 25.50 FORMAT "%5.2" /end CHARACTERISTIC
/begin CHARACTERISTIC TDEGFEMN "Zeitverzˆgerung f¸r Setzen des MIN-Fehlers" VALUE 0xFCD4C9 KwUb 25.50 t100msxs_ub_b25p5 0.00 25.50 FORMAT "%5.2" /end CHARACTERISTIC
/begin CHARACTERISTIC TDEGFEMX "Zeitverzˆgerung f¸r Setzen des MAX-Fehlers" VALUE 0xFCD4CA KwUb 25.50 t100msxs_ub_b25p5 0.00 25.50 FORMAT "%5.2" /end CHARACTERISTIC
/begin CHARACTERISTIC TDEGFENO "Zeitverzˆgerung f¸r Setzen des NO-Fehlers" VALUE 0xFCD4CB KwUb 25.50 t100msxs_ub_b25p5 0.00 25.50 FORMAT "%5.2" /end CHARACTERISTIC
/begin CHARACTERISTIC TDEGFEST "Zeitverzˆgerung nach Start" VALUE 0xFCD4CC KwUb 25.50 t100msxs_ub_b25p5 0.00 25.50 FORMAT "%5.2" /end CHARACTERISTIC
/begin CHARACTERISTIC TDENDAUFH "Zeit bis Aufheizphase f¸r max.Temp. d. SLP nach abschalten dieser erreicht ist" VALUE 0xFD03DF KwUb 255.0 t_q1 0.00 255.0 FORMAT "%5.1" /end CHARACTERISTIC
/begin CHARACTERISTIC TDHCINS "Zeit f¸r Fehlerheilung CAN-Timeout Kombi-Instr." VALUE 0xFC0EC8 KwWU16 6553.500 t100msxs_uw_b6553p5 0.00 6553.500 FORMAT "%8.3" /end CHARACTERISTIC
/begin CHARACTERISTIC TDNVAUS "Verzˆgerungszeit NV-Verh‰ltnis auﬂerhalb Band" CURVE 0xFC1F5E FklWU16 655.3500 t10msxs_uw_b655p35 0.00 655.3500 FORMAT "%8.4"
 /begin AXIS_DESCR FIX_AXIS gangctr dez 6 0.00 5.000 FORMAT "%5.3" FIX_AXIS_PAR 0 0 6 /end AXIS_DESCR
/end CHARACTERISTIC
/begin CHARACTERISTIC TDNVEIN "Verzˆgerungszeit NV-Verh‰ltnis innerhalb Band" CURVE 0xFC1F6A FklWU16 655.3500 t10msxs_uw_b655p35 0.00 655.3500 FORMAT "%8.4"
 /begin AXIS_DESCR FIX_AXIS gangctr dez 6 0.00 5.000 FORMAT "%5.3" FIX_AXIS_PAR 0 0 6 /end AXIS_DESCR
/end CHARACTERISTIC
/begin CHARACTERISTIC TDPBKVMN "Verzˆgerungszeit der Bedingung BKV ohne ausreichenden Unterdruck" VALUE 0xFD0403 KwUb 5.100 t20msxs_ub_q0p02 0.00 5.100 FORMAT "%5.3" /end CHARACTERISTIC
/begin CHARACTERISTIC TDPBKVMNP "Verzˆgerungszeit der Bedingung BKV ohne ausreichenden Unterdruck f¸r BKV-Pumpe" VALUE 0xFD0404 KwUb 5.100 t20msxs_ub_q0p02 0.00 5.100 FORMAT "%5.3" /end CHARACTERISTIC
/begin CHARACTERISTIC TDSSPAV "Massenstromverzˆgerung beim Ausschalten" CURVE 0xFCC196 KlAUwSstUwWUw 655.3500 t10msxs_uw_b655p35 0.00 655.3500 FORMAT "%8.4"
 /begin AXIS_DESCR STD_AXIS pspssp_w fak_uw_b2 12 0.00 1.999969 FORMAT "%8.6" DEPOSIT ABSOLUTE /end AXIS_DESCR
/end CHARACTERISTIC
/begin CHARACTERISTIC TDSSPEV "Massenstromverzˆgerung beim Einschalten" CURVE 0xFCC1C8 KlAUwSstUwWUw 655.3500 t10msxs_uw_b655p35 0.00 655.3500 FORMAT "%8.4"
 /begin AXIS_DESCR STD_AXIS pspssp_w fak_uw_b2 12 0.00 1.999969 FORMAT "%8.6" DEPOSIT ABSOLUTE /end AXIS_DESCR
/end CHARACTERISTIC
/begin CHARACTERISTIC TEBKVNKHA "Entprellzeit f¸r Schalter Druck Bremskraftverst‰rker" VALUE 0xFD0405 KwUb 5.100 t20msxs_ub_q0p02 0.00 5.100 FORMAT "%5.3" /end CHARACTERISTIC
/begin CHARACTERISTIC TEBKVNWAB "Entprellzeit f¸r NW-Umschaltung min. ‹berschneidung" VALUE 0xFD0406 KwUb 5.100 t20msxs_ub_q0p02 0.00 5.100 FORMAT "%5.3" /end CHARACTERISTIC
/begin CHARACTERISTIC TEPBKVMN "Entprellzeit von B_pbkvmn" VALUE 0xFD0407 KwUb 5.100 t20msxs_ub_q0p02 0.00 5.100 FORMAT "%5.3" /end CHARACTERISTIC
/begin CHARACTERISTIC TEPCL "Zeit ab Motorlauf bis EPCL-Testansteuerung Ende" VALUE 0xFC1183 KwUb 51.00 t200msxs_ub_b51 0.00 51.00 FORMAT "%5.2" /end CHARACTERISTIC
/begin CHARACTERISTIC TEPCLI "Zeit ab INI bis EPCL-Testansteuerung Ende" VALUE 0xFC1184 KwUb 51.00 t200msxs_ub_b51 0.00 51.00 FORMAT "%5.2" /end CHARACTERISTIC
/begin CHARACTERISTIC TEPPBKV "Entprellzeit f¸r Schalter Druck Bremskraftverst‰rker" VALUE 0xFD0408 KwUb 5.080 t20msxs_ub_q0p02 0.00 5.080 FORMAT "%5.3" /end CHARACTERISTIC
/begin CHARACTERISTIC TIMSA "Integratorsteigung f¸r multi. Adaption" VALUE 0xFCD0A1 KwUb 51.00 t200msxs_ub_b51 0.00 51.00 FORMAT "%5.2" /end CHARACTERISTIC
/begin CHARACTERISTIC TIMSALL "Integratorsteigung f¸r multi. Adaption  (langsam)" VALUE 0xFCD0A2 KwUb 51.00 t200msxs_ub_b51 0.00 51.00 FORMAT "%5.2" /end CHARACTERISTIC
/begin CHARACTERISTIC TIMSALLVT "Integratorsteigung f¸r multi. Adaption  (langsam) VVT" VALUE 0xFCD0A3 KwUb 51.00 t200msxs_ub_b51 0.00 51.00 FORMAT "%5.2" /end CHARACTERISTIC
/begin CHARACTERISTIC TIMSAON "Zeitverzoegerung BGMSZS Abgleich" VALUE 0xFCD3B0 KwUw 655.3500 t10msxs_uw_b655p35 0.00 655.3500 FORMAT "%8.4" /end CHARACTERISTIC
/begin CHARACTERISTIC TIMSAVT "Integratorsteigung f¸r multi. Adaption VVT" VALUE 0xFCD0A4 KwUb 51.00 t200msxs_ub_b51 0.00 51.00 FORMAT "%5.2" /end CHARACTERISTIC
/begin CHARACTERISTIC TLLCO "Motortemp. - Schwelle CO - Korrektur" VALUE 0xFC4A66 KwUb 191.3 temp_ub_q0p75_o48 -48.00 143.3 FORMAT "%5.1" /end CHARACTERISTIC
/begin CHARACTERISTIC TMFKMSDKA "Mot.-Temperaturschwelle f¸r multi. Adaption" VALUE 0xFC2854 KwUb 191.3 temp_ub_q0p75_o48 -48.00 143.3 FORMAT "%5.1" /end CHARACTERISTIC
/begin CHARACTERISTIC TMFKMSVTA "Mot.-Temperaturschwelle f¸r multi. Adaption VVT" VALUE 0xFC2855 KwUb 191.3 temp_ub_q0p75_o48 -48.00 143.3 FORMAT "%5.1" /end CHARACTERISTIC
/begin CHARACTERISTIC TMNEZH_MX "Maximale Anzahl Fahrzyklen f¸r Fehlereintrag EZH ‹bertemperatur" VALUE 0xFC0ED2 KwWU8 10.00 dez 0.00 10.00 FORMAT "%5.2" /end CHARACTERISTIC
/begin CHARACTERISTIC TMOTNLDG "Temperaturschwelle f¸r Drehzahlgeber-Notlauf" VALUE 0xFC1DD6 KwWU8 191.3 temp_ub_q0p75_o48 -48.00 143.3 FORMAT "%5.1" /end CHARACTERISTIC
/begin CHARACTERISTIC TMVDBS "Entprellzeit Beschleunigungssignaldiagnose" VALUE 0xFC1F78 KwUb 25.50 t100msxs_ub_b25p5 0.00 25.50 FORMAT "%5.2" /end CHARACTERISTIC
/begin CHARACTERISTIC TNLSGM "Nachlaufzeit f¸r SG abschalten" CURVE 0xFCD754 KlAUbSstUbWUb 255.0 t1sxs_ub_b255 0.00 255.0 FORMAT "%5.1"
 /begin AXIS_DESCR STD_AXIS tmotab temp_ub_q0p75_o48 6 -48.00 143.3 FORMAT "%5.1" DEPOSIT ABSOLUTE /end AXIS_DESCR
/end CHARACTERISTIC
/begin CHARACTERISTIC TNSURLP "Zeit rl-Praediktions-Unterdrueckung im Nachstart" VALUE 0xFC4A5D KwUb 25.50 t100msxs_ub_b25p5 0.00 25.50 FORMAT "%5.2" /end CHARACTERISTIC
/begin CHARACTERISTIC TPLUHRC "Zeit f¸r Erkennung relative Zeit von Kombi-Uhr plausibel" VALUE 0xFCD798 KwUw 65535.00 tmin_uw_q1 0.00 65535.00 FORMAT "%8.2" /end CHARACTERISTIC
/begin CHARACTERISTIC TPLUHRR "Zeit f¸r Erkennung relative Zeit von Kombi-Uhr unplausibel" VALUE 0xFCD79A KwUw 655.3500 t10msxs_uw_b655p35 0.00 655.3500 FORMAT "%8.4" /end CHARACTERISTIC
/begin CHARACTERISTIC TPNSE "Pr¸fzeit nach Startende f¸r DVE-Diagnose" VALUE 0xFCC9AA KwUb 25.40 t100msxs_ub_b25p5 0.1000 25.50 FORMAT "%5.2" /end CHARACTERISTIC
/begin CHARACTERISTIC TUMTAI "Initialisierungswert Umgebungstemperatur" VALUE 0xFCD761 KwUb 191.3 temp_ub_q0p75_o48 -48.00 143.3 FORMAT "%5.1" /end CHARACTERISTIC
/begin CHARACTERISTIC TVCO "CO-Korrektur" CURVE 0xFC4A6C KlASwSstSwWSw 3071.953 rel_sw_b1536 -1536.000 1535.953 FORMAT "%8.3"
 /begin AXIS_DESCR STD_AXIS co_pot_w dez 8 -32768.00 32767.00 FORMAT "%8.2" DEPOSIT ABSOLUTE /end AXIS_DESCR
/end CHARACTERISTIC
/begin CHARACTERISTIC TVFGRAT "Verzˆgerungszeit f¸r Ausgabe FGR-Bedientaste bei ausschalten" VALUE 0xFC0ECE KwUb 2.550 t_q0p01 0.00 2.550 FORMAT "%5.3" /end CHARACTERISTIC
/begin CHARACTERISTIC TVFGRSE "Verzˆgerungszeit f¸r Ausgabe FGR-Bedientaste neu setzen" VALUE 0xFC0ECF KwUb 2.550 t_q0p01 0.00 2.550 FORMAT "%5.3" /end CHARACTERISTIC
/begin CHARACTERISTIC TVMFLA "Verzˆgerungszeit f¸r Ausgabe Status FGR-Lampe" VALUE 0xFC0ED0 KwUb 2.550 t_q0p01 0.00 2.550 FORMAT "%5.3" /end CHARACTERISTIC
/begin CHARACTERISTIC TWBDCY "Wartezeit f¸r Erkennung Bedingung 'driving cycle'" VALUE 0xFCC988 KwUw 13107.00 t200msxs_uw_q0p2 0.00 13107.00 FORMAT "%8.2" /end CHARACTERISTIC
/begin CHARACTERISTIC TWSLPPWF "Initialisierungswert der Wicklungstemperatur der SLP bei Powerfail" VALUE 0xFD03E0 KwUw 1535.977 temp_q0p0234_o273 -273.1500 1262.827 FORMAT "%8.3" /end CHARACTERISTIC
/begin CHARACTERISTIC UBCJMN "Minimale UBat-Schwelle f¸r Freigabe der CJ400-Endstufendiagnose" VALUE 0xFC2031 KwUb 24.02 spg_ubatt 0.00 24.02 FORMAT "%5.2" /end CHARACTERISTIC
/begin CHARACTERISTIC UBCJMX "Maximale UBat-Schwelle f¸r Freigabe der CJ400-Endstufendiagnose" VALUE 0xFC2032 KwUb 24.02 spg_ubatt 0.00 24.02 FORMAT "%5.2" /end CHARACTERISTIC
/begin CHARACTERISTIC VASRM "Geschwindigkeitsschwelle f¸r Schlechtwegerkennung" VALUE 0xFC1F79 KwUb 318.8 vfzg_ub_q1p25 0.00 318.8 FORMAT "%5.1" /end CHARACTERISTIC
/begin CHARACTERISTIC VBSMX "obere Plausibilit‰tsschwelle f¸r Radgeschwindigkeit" VALUE 0xFC1F7A KwUw 4095.938 vfzg_uw_q0p0625 0.00 4095.938 FORMAT "%8.3" /end CHARACTERISTIC
/begin CHARACTERISTIC VNSK_DELTA "Filterzeitkonstante Regler¸berwachung" VALUE 0xFC9BE4 KwWU16 0.9999847 fak_uw_b1 0.00 0.9999847 FORMAT "%9.7" /end CHARACTERISTIC
/begin CHARACTERISTIC VNSK_TV_I "Filterzeitkonstante Haltetastverh‰ltnis¸berwachung" VALUE 0xFC9BE6 KwWU16 0.9999847 fak_uw_b1 0.00 0.9999847 FORMAT "%9.7" /end CHARACTERISTIC
/begin CHARACTERISTIC VNS_DELTMX "Maximale Regelabweichung PT1 Regler¸berwachung" VALUE 0xFC9BE8 KwWU16 6554. sprzi_q0p1 0.00 6554. FORMAT "%4.0" /end CHARACTERISTIC
/begin CHARACTERISTIC VNS_DELTMX2 "" VALUE 0xFC9BEA KwWU16 6554. sprzi_q0p1 0.00 6554. FORMAT "%4.0" /end CHARACTERISTIC
/begin CHARACTERISTIC VNS_ERRCNT "Eintragschwelle Sensorsignal abgefallen" VALUE 0xFC9BF1 KwWU8 255.0 dez 0.00 255.0 FORMAT "%5.1" /end CHARACTERISTIC
/begin CHARACTERISTIC VNS_ERRCNT2 "" VALUE 0xFC9BF2 KwWU8 255.0 dez 0.00 255.0 FORMAT "%5.1" /end CHARACTERISTIC
/begin CHARACTERISTIC VNS_NMOTS "Drehzahlschelle Sensorsignal abgefallen" VALUE 0xFC9BF3 KwWU8 10200. nmot_ub_q40 0.00 10200. FORMAT "%5.0" /end CHARACTERISTIC
/begin CHARACTERISTIC VNS_TMN "Minimale Temperaturschelle f¸r Diagnose variable NWS" VALUE 0xFC9BF4 KwWU8 191.3 temp_ub_q0p75_o48 -48.00 143.3 FORMAT "%5.1" /end CHARACTERISTIC
/begin CHARACTERISTIC VNS_TMX "Maximale Temperaturschelle f¸r Diagnose variable NWS" VALUE 0xFC9BF5 KwWU8 191.3 temp_ub_q0p75_o48 -48.00 143.3 FORMAT "%5.1" /end CHARACTERISTIC
/begin CHARACTERISTIC VNS_TVIMN "Minimalbegrenzung Tastverh‰ltnis I-Anteil" VALUE 0xFC9BEC KwWU16 199.997 vnstv_q0p00305s32768 -100.000 99.9969 /end CHARACTERISTIC
/begin CHARACTERISTIC VNS_TVIMX "Maximalbegrenzung Tastverh‰ltnis I-Anteil" VALUE 0xFC9BEE KwWU16 199.997 vnstv_q0p00305s32768 -100.000 99.9969 /end CHARACTERISTIC
/begin CHARACTERISTIC VSEKPMXN "Kennlinie Kraftstoff-Sollvolumenstrom bei Vollast abh‰ngig von der Drehzahl" CURVE 0xFD03E8 KlAUbSstUbWUb 255.0 fuel_ub_q1 0.00 255.0 FORMAT "%5.1"
 /begin AXIS_DESCR STD_AXIS nmot nmot_ub_q40 5 0.00 10200. FORMAT "%5.0" DEPOSIT ABSOLUTE /end AXIS_DESCR
/end CHARACTERISTIC
/begin CHARACTERISTIC VSSSPE "Ersatzwert f¸r Sollvolumenstrom f¸r SSP" VALUE 0xFD03F3 KwUb 255.0 fuel_ub_q1 0.00 255.0 FORMAT "%5.1" /end CHARACTERISTIC
/begin CHARACTERISTIC VSSSPTAIRL "KL Kraftstoff-Sollvolumenstrom f¸r die SSP abh. von dem F¸llstand" CURVE 0xFD03F4 KlAUbSstUbWUb 255.0 fuel_ub_q1 0.00 255.0 FORMAT "%5.1"
 /begin AXIS_DESCR STD_AXIS fsttankrf fuel_ub_q0p5 4 0.00 127.5 FORMAT "%5.1" DEPOSIT ABSOLUTE /end AXIS_DESCR
/end CHARACTERISTIC
/begin CHARACTERISTIC VTUMTA "Schwelle Fahrzeuggeschwindigkeit f¸r Bestimmung Umgebungstemperatur" VALUE 0xFCD762 KwUb 318.8 vfzg_ub_q1p25 0.00 318.8 FORMAT "%5.1" /end CHARACTERISTIC
/begin CHARACTERISTIC VVTALLMN "Minimale additive Luftmassenadaption VVT Betrieb" VALUE 0xFC2856 KwSb 25.50 m_ub_q0p1 -12.80 12.70 FORMAT "%5.2" /end CHARACTERISTIC
/begin CHARACTERISTIC VVTALLMX "Maximale additive Luftmassenadaption VVT Betrieb" VALUE 0xFC2857 KwSb 25.50 m_ub_q0p1 -12.80 12.70 FORMAT "%5.2" /end CHARACTERISTIC
/begin CHARACTERISTIC VVTNLLMN "Minimale Offsetadaption" VALUE 0xFC2858 KwSb 25.50 m_ub_q0p1 -12.80 12.70 FORMAT "%5.2" /end CHARACTERISTIC
/begin CHARACTERISTIC VVTNLLMX "Maximale Leerlaufwinkeladaption" VALUE 0xFC2859 KwSb 25.50 m_ub_q0p1 -12.80 12.70 FORMAT "%5.2" /end CHARACTERISTIC
/begin CHARACTERISTIC WDKFMAON "min. Schwelle Freigabe der mult. Adaption" CURVE 0xFCD0A8 KlAUbSstUbWUb 100.0 relDK_ub_b100 0.00 100.0 FORMAT "%5.1"
 /begin AXIS_DESCR STD_AXIS nmot nmot_ub_q40 4 0.00 10200. FORMAT "%5.0" DEPOSIT ABSOLUTE /end AXIS_DESCR
/end CHARACTERISTIC
/begin CHARACTERISTIC WDKFMAUN "max. Schwelle Freigabe der multi. Adaption" CURVE 0xFCD0B4 KlAUbSstUbWUb 100.0 relDK_ub_b100 0.00 100.0 FORMAT "%5.1"
 /begin AXIS_DESCR STD_AXIS nmot nmot_ub_q40 4 0.00 10200. FORMAT "%5.0" DEPOSIT ABSOLUTE /end AXIS_DESCR
/end CHARACTERISTIC
/begin CHARACTERISTIC WDKMSON "min. Schwelle Freigabe der addi. Adaption" CURVE 0xFCD0C0 KlAUbSstUbWUb 100.0 relDK_ub_b100 0.00 100.0 FORMAT "%5.1"
 /begin AXIS_DESCR STD_AXIS nmot nmot_ub_q40 4 0.00 10200. FORMAT "%5.0" DEPOSIT ABSOLUTE /end AXIS_DESCR
/end CHARACTERISTIC
/begin CHARACTERISTIC WDKMSONTD "min. Schwelle Freigabe der addi. Adaption bei Teildrosselung" CURVE 0xFCD0CC KlAUbSstUbWUb 100.0 relDK_ub_b100 0.00 100.0 FORMAT "%5.1"
 /begin AXIS_DESCR STD_AXIS nmot nmot_ub_q40 4 0.00 10200. FORMAT "%5.0" DEPOSIT ABSOLUTE /end AXIS_DESCR
/end CHARACTERISTIC
/begin CHARACTERISTIC ZBRT "Zeitkonstante f¸r Brennraumtempmodell" VALUE 0xFCD4A0 KwUb 25.4996 zk100msxs_ub_b25p5 0.100392 25.6000 FORMAT "%7.4" /end CHARACTERISTIC
/begin CHARACTERISTIC ZFMVRV "Zeitkonstante f¸r Filterung des Geschwindigkeitssignals" VALUE 0xFC21D0 KwUb 5.08000 zk20msxs_ub_b5p1 0.0200000 5.10000 FORMAT "%7.5" /end CHARACTERISTIC
/begin CHARACTERISTIC ZIDFBM "Z‰hler-Inkrementierung je L¸ckenkorrektur bei BM-‹berpr¸fung" VALUE 0xFC1DD2 KwWU16 65535.00 dez 0.00 65535.00 FORMAT "%8.2" /end CHARACTERISTIC
/begin CHARACTERISTIC ZIDNOBM "Z‰hler-Inkrementierung nach Verlust der Bezugsmarke" VALUE 0xFC1DD4 KwWU16 65535.00 dez 0.00 65535.00 FORMAT "%8.2" /end CHARACTERISTIC
/begin CHARACTERISTIC ZKABKTWSLP "Zeitkonstante f¸r die Abk¸hlung der Wicklungstemperatur der SLP" VALUE 0xFD03E2 KwUw 65534.000000 zk1sxs_uw_b65535 1.0000000000 65535.000000 FORMAT "%12.6" /end CHARACTERISTIC
/begin CHARACTERISTIC ZKMSDK "Zeitkonstante schnelle Massenstromadaption" CURVE 0xFC2A98 KlAUwSstUwWUw 7.812269 mk10ms_uw_q2p384e5n 0.00 7.812269 FORMAT "%8.6"
 /begin AXIS_DESCR STD_AXIS dpsvbgms_w fak_uw_b2 8 0.00 1.999969 FORMAT "%8.6" DEPOSIT ABSOLUTE /end AXIS_DESCR
/end CHARACTERISTIC
/begin CHARACTERISTIC ZKMSDKTD "Zeitkonstante schnelle Massenstromadaption teilgedrosselt" CURVE 0xFC2ABA KlAUwSstUwWUw 7.812269 mk10ms_uw_q2p384e5n 0.00 7.812269 FORMAT "%8.6"
 /begin AXIS_DESCR STD_AXIS dpsvbgms_w fak_uw_b2 8 0.00 1.999969 FORMAT "%8.6" DEPOSIT ABSOLUTE /end AXIS_DESCR
/end CHARACTERISTIC
/begin CHARACTERISTIC ZKTABTU "Zeitkonstante f¸r Motorabk¸hlung" CURVE 0xFCD79C KlAUwSstUwWUw 65535.00 t1sxs_uw_q1 0.00 65535.00 FORMAT "%8.2"
 /begin AXIS_DESCR STD_AXIS tum_ein temp_ub_q0p75_o48 4 -48.00 143.3 FORMAT "%5.1" DEPOSIT ABSOLUTE /end AXIS_DESCR
/end CHARACTERISTIC
/begin CHARACTERISTIC ZKTWSLPUB "Zeitkonstante f¸r Wicklungstemperatur der SLP" CURVE 0xFCC2A2 KlAxU8SstxU16WU16 65534.000000 zk1sxs_uw_b65535 1.0000000000 65535.000000 FORMAT "%12.6"
 /begin AXIS_DESCR STD_AXIS ub_w spg_ubatt 4 0.00 6173.397 FORMAT "%8.3" DEPOSIT ABSOLUTE /end AXIS_DESCR
/end CHARACTERISTIC
/begin CHARACTERISTIC ZNGFIL "Zeitkonstante f¸r Drehzahlgradient-Filter" VALUE 0xFC1DC8 KwUw 655.34999985 zk10msxs_uw_b655 0.010000152590 655.36000000 FORMAT "%12.8" /end CHARACTERISTIC
/begin CHARACTERISTIC ZTDAGR "Zeitkonstante Temperaturdynamik bei AGR Auf- Abschaltung" VALUE 0xFCD4C4 KwUw 6553.50000 zk100msxs_uw_b6553 0.100001526 6553.60000 FORMAT "%10.5" /end CHARACTERISTIC
/begin CHARACTERISTIC ZTMMBR "Zeitkonstante Motortemperatur f¸r Brennraumtempmodell" VALUE 0xFCD4C6 KwUw 6553.50000 zk100msxs_uw_b6553 0.100001526 6553.60000 FORMAT "%10.5" /end CHARACTERISTIC
/begin CHARACTERISTIC ZVTPRGSU "Zeitkonstante Tiefpaﬂfilterung bei Saugrohrklappendynamik" VALUE 0xFC2B70 KwUb 5.08000 zk20msxs_ub_b5p1 0.0200000 5.10000 FORMAT "%7.5" /end CHARACTERISTIC
/begin CHARACTERISTIC ZVTSSPAV "Massenstromzeitkonstante beim Ausschalten" CURVE 0xFCC1FA KlAUwSstUwWUw 655.34999985 zk10msxs_uw_b655 0.010000152590 655.36000000 FORMAT "%12.8"
 /begin AXIS_DESCR STD_AXIS pspssp_w fak_uw_b2 12 0.00 1.999969 FORMAT "%8.6" DEPOSIT ABSOLUTE /end AXIS_DESCR
/end CHARACTERISTIC
/begin CHARACTERISTIC ZVTSSPEV "Massenstromzeitkonstante beim Einschalten" CURVE 0xFCC22C KlAUwSstUwWUw 655.34999985 zk10msxs_uw_b655 0.010000152590 655.36000000 FORMAT "%12.8"
 /begin AXIS_DESCR STD_AXIS pspssp_w fak_uw_b2 12 0.00 1.999969 FORMAT "%8.6" DEPOSIT ABSOLUTE /end AXIS_DESCR
/end CHARACTERISTIC
/begin CHARACTERISTIC ZWDKM1 "1. Zeitkonstante Dk-Modell" VALUE 0xFC4A62 KwUw 2.550000 zk10msxs_uw_b2p55T 0.00 2.550000 FORMAT "%8.6" /end CHARACTERISTIC
/begin CHARACTERISTIC ZWDKM2 "2. Zeitkonstante Dk-Modell" VALUE 0xFC4A64 KwUw 2.550000 zk10msxs_uw_b2p55T 0.00 2.550000 FORMAT "%8.6" /end CHARACTERISTIC
/begin MEASUREMENT addsu_u "AD-Messwert Umgebungsdrucksensor; DFPM Umweltbedingung" UBYTE dez 1 100 0 255 FORMAT "%5.1" ECU_ADDRESS 0x5B8DFC /end MEASUREMENT
/begin MEASUREMENT adhfm_u "AD-Messwert Luftmassenmesser; DFPM Umweltbedingung" UBYTE dez 1 100 0 255 FORMAT "%5.1" ECU_ADDRESS 0x5B8DFD /end MEASUREMENT
/begin MEASUREMENT adta_u "AD-Messwert Ansauglufttemperatur; DFPM Umweltbedingung" UBYTE dez 1 100 0 255 FORMAT "%5.1" ECU_ADDRESS 0x5B8DFE /end MEASUREMENT
/begin MEASUREMENT adtka_u "AD-Messwert Temperatur K¸hlwasseraustritt; DFPM-Umweltbedingung" UBYTE dez 1 100 0 255 FORMAT "%5.1" ECU_ADDRESS 0x5B8DFF /end MEASUREMENT
/begin MEASUREMENT adtm_u "AD-Messwert Motortemperatur; DFPM Umweltbedingung" UBYTE dez 1 100 0 255 FORMAT "%5.1" ECU_ADDRESS 0x5B8E00 /end MEASUREMENT
/begin MEASUREMENT agrr "Abgasr¸ckf¸hrrate" UBYTE rel_ub_b99p6 1 100 0 99.6094 FORMAT "%5.2" ECU_ADDRESS 0x5B8E7F /end MEASUREMENT
/begin MEASUREMENT agrr_w "Abgasr¸ckf¸hrrate word" UWORD rel_uw_b100 1 100 0 99.9985 FORMAT "%8.5" ECU_ADDRESS 0x5B914A /end MEASUREMENT
/begin MEASUREMENT asccod "Automatische ASC-SG Erkennung" UBYTE dez 1 100 0 255 FORMAT "%5.1" ECU_ADDRESS 0x3FD7E6 /end MEASUREMENT
/begin MEASUREMENT asc_alive "ASC-Alive Z‰hler" UBYTE dez 1 100 0 15 FORMAT "%5.2" ECU_ADDRESS 0x5B8DE9 /end MEASUREMENT
/begin MEASUREMENT bbdcy "Byte f¸r Bedingung B_dcy als Triggerevent in DCLA" UBYTE dez 1 100 0 255 FORMAT "%5.1" ECU_ADDRESS 0x5B8DF8 /end MEASUREMENT
/begin MEASUREMENT bfzglfgr "Fahrzeugl‰ngsbeschleunigung" SBYTE bfzg_sb_q0p217 1 100 -27.776 27.559 FORMAT "%5.2" ECU_ADDRESS 0x5B8E7C /end MEASUREMENT
/begin MEASUREMENT BgtabstNvBits "" UBYTE dez 1 100 0 255 FORMAT "%5.1" ECU_ADDRESS 0x3FDC10 /end MEASUREMENT
/begin MEASUREMENT BKVlokbits0 "" UBYTE dez 1 100 0 255 FORMAT "%5.1" ECU_ADDRESS 0x5B9030 /end MEASUREMENT
/begin MEASUREMENT bmloss_w "Z‰hler BM-Fehler f¸r DG Diagnose" UWORD dez 1 100 0 65535 FORMAT "%8.2" ECU_ADDRESS 0x5B957E /end MEASUREMENT
/begin MEASUREMENT bsc "Radbeschleunigungssignal aus ABS-Sensorsignal berechnet" UBYTE acc_ub_b55p55 1 100 0 55.335 FORMAT "%5.2" ECU_ADDRESS 0x5B8E75 /end MEASUREMENT
/begin MEASUREMENT B_ac "Bedingung Lastaufschaltung Klimaanlage" UBYTE B_TRUE 1 100 0 1 BIT_MASK 0x1 FORMAT "%13.11" ECU_ADDRESS 0x3FBC34 /end MEASUREMENT
/begin MEASUREMENT B_anwmn "Nockenwellensteuerung: Min Position nicht ok (Auslaﬂ Nockenwelle 1)" UBYTE B_TRUE 1 100 0 1 BIT_MASK 0x20 FORMAT "%13.11" ECU_ADDRESS 0x5B8A41 /end MEASUREMENT
/begin MEASUREMENT B_anwmn2 "Nockenwellensteuerung: Min Position nicht ok (Auslaﬂ Nockenwelle 2)" UBYTE B_TRUE 1 100 0 1 BIT_MASK 0x80 FORMAT "%13.11" ECU_ADDRESS 0x5B8A41 /end MEASUREMENT
/begin MEASUREMENT B_anwpnp "Nockenwellensteuerung: Position nicht plausibel (Auslaﬂ Nockenwelle 1)" UBYTE B_TRUE 1 100 0 1 BIT_MASK 0x2 FORMAT "%13.11" ECU_ADDRESS 0x5B8A41 /end MEASUREMENT
/begin MEASUREMENT B_anwpnp2 "Nockenwellensteuerung: Position nicht plausibel (Auslaﬂ Nockenwelle 2)" UBYTE B_TRUE 1 100 0 1 BIT_MASK 0x8 FORMAT "%13.11" ECU_ADDRESS 0x5B8A41 /end MEASUREMENT
/begin MEASUREMENT B_asc1cok "Bedingung CAN-ASC1-Botschaft empfangen" UBYTE B_TRUE 1 100 0 1 BIT_MASK 0x1 FORMAT "%13.11" ECU_ADDRESS 0x3FBC18 /end MEASUREMENT
/begin MEASUREMENT B_asc1new "Bedingung CAN-ASC1-Botschaft empfangen" UBYTE B_TRUE 1 100 0 1 BIT_MASK 0x1 FORMAT "%13.11" ECU_ADDRESS 0x3FBC19 /end MEASUREMENT
/begin MEASUREMENT B_asc2cok "Bedingung ASC verbaut und ASC2-Botschaft vorhanden" UBYTE B_TRUE 1 100 0 1 BIT_MASK 0x1 FORMAT "%13.11" ECU_ADDRESS 0x3FBC1A /end MEASUREMENT
/begin MEASUREMENT B_asc2new "Bedingung CAN-ASC2-Botschaft empfangen" UBYTE B_TRUE 1 100 0 1 BIT_MASK 0x1 FORMAT "%13.11" ECU_ADDRESS 0x3FBC1B /end MEASUREMENT
/begin MEASUREMENT B_asc3cok "Bedingung: CAN-Botschaft ASC3 vorhanden" UBYTE B_TRUE 1 100 0 1 BIT_MASK 0x1 FORMAT "%13.11" ECU_ADDRESS 0x3FBC1C /end MEASUREMENT
/begin MEASUREMENT B_asc3new "Bedingung CAN-ASC3-Botschaft empfangen" UBYTE B_TRUE 1 100 0 1 BIT_MASK 0x1 FORMAT "%13.11" ECU_ADDRESS 0x3FBC1D /end MEASUREMENT
/begin MEASUREMENT B_ascdme "Bedingung : Quittierung ASC-Botschaft ok." UBYTE B_TRUE 1 100 0 1 BIT_MASK 0x1 FORMAT "%13.11" ECU_ADDRESS 0x3FBC13 /end MEASUREMENT
/begin MEASUREMENT B_ascpkw "Bedingung Fahrzeug mit ASC erkannt und CAN-Botschaft nicht unterbrochen" UBYTE B_TRUE 1 100 0 1 BIT_MASK 0x1 FORMAT "%13.11" ECU_ADDRESS 0x3FD7E5 /end MEASUREMENT
/begin MEASUREMENT B_ascsipl "Bedingung ASC-Signal plausibel" UBYTE B_TRUE 1 100 0 1 BIT_MASK 0x1 FORMAT "%13.11" ECU_ADDRESS 0x3FBC14 /end MEASUREMENT
/begin MEASUREMENT B_asc_reg "CAN-Botschaft: ASC regelt (mit Bremsen-Eingriff)" UBYTE B_TRUE 1 100 0 1 BIT_MASK 0x1 FORMAT "%13.11" ECU_ADDRESS 0x3FBC1E /end MEASUREMENT
/begin MEASUREMENT B_asrext "Bedingung f¸r externe ASR-Anforderung" UBYTE B_TRUE 1 100 0 1 BIT_MASK 0x1 FORMAT "%13.11" ECU_ADDRESS 0x3FBC1F /end MEASUREMENT
/begin MEASUREMENT B_asrextmem "" UBYTE B_TRUE 1 100 0 1 BIT_MASK 0x1 FORMAT "%13.11" ECU_ADDRESS 0x3FBC20 /end MEASUREMENT
/begin MEASUREMENT B_autget "Bedingung Automatikgetriebe" UBYTE B_TRUE 1 100 0 1 BIT_MASK 0x1 FORMAT "%13.11" ECU_ADDRESS 0x3FBC25 /end MEASUREMENT
/begin MEASUREMENT B_azh "Bedingung Anforderung Zuheizmaﬂnahme vom EZH" UBYTE B_TRUE 1 100 0 1 BIT_MASK 0x1 FORMAT "%13.11" ECU_ADDRESS 0x3FBC2E /end MEASUREMENT
/begin MEASUREMENT B_bgmsdk "Bedingung Freigabe GD Betrieb Adaption" UBYTE dez 1 100 0 255 FORMAT "%5.1" ECU_ADDRESS 0x5B86C6 /end MEASUREMENT
/begin MEASUREMENT B_bgmszs "Bedindung Freigabe Adaption" UBYTE dez 1 100 0 255 FORMAT "%5.1" ECU_ADDRESS 0x5B86C7 /end MEASUREMENT
/begin MEASUREMENT B_bgmszsi "Initialisierung schneller Luftmassenabgleich" UBYTE dez 1 100 0 255 FORMAT "%5.1" ECU_ADDRESS 0x5B86C8 /end MEASUREMENT
/begin MEASUREMENT B_bkvagrab "Bedingung AGR aus wegen Bremskraftverst‰rker" UBYTE B_TRUE 1 100 0 1 BIT_MASK 0x1 FORMAT "%13.11" ECU_ADDRESS 0x3FBFF7 /end MEASUREMENT
/begin MEASUREMENT B_bkvdkhab "Bedingung: Momentreserve f¸r KH abschalten, da nicht gen¸gend Unterdruck in BKV" UBYTE B_TRUE 1 100 0 1 BIT_MASK 0x1 FORMAT "%13.11" ECU_ADDRESS 0x3FBFF8 /end MEASUREMENT
/begin MEASUREMENT B_bkvkoma "Bedingung: (Klima-) Kompressor abschalten, da nicht gen¸gend Unterdruck in BKV" UBYTE B_TRUE 1 100 0 1 BIT_MASK 0x2 FORMAT "%13.11" ECU_ADDRESS 0x5B9030 /end MEASUREMENT
/begin MEASUREMENT B_bkvkomab "Bedingung: (Klima-) Kompressor abschalten, da nicht gen¸gend Unterdruck in BKV" UBYTE B_TRUE 1 100 0 1 BIT_MASK 0x1 FORMAT "%13.11" ECU_ADDRESS 0x3FBFF9 /end MEASUREMENT
/begin MEASUREMENT B_bkvleer "Bedingung Bremskraftverst‰rker ohne ausreichenden Unterdruck" UBYTE B_TRUE 1 100 0 1 BIT_MASK 0x1 FORMAT "%13.11" ECU_ADDRESS 0x3FBFFA /end MEASUREMENT
/begin MEASUREMENT B_bkvnkha "Bedingung: LL-Drehzahl f¸r KH abschalten, da nicht gen¸gend Unterdruck in BKV" UBYTE B_TRUE 1 100 0 1 BIT_MASK 0x10 FORMAT "%13.11" ECU_ADDRESS 0x5B9030 /end MEASUREMENT
/begin MEASUREMENT B_bkvnkhab "Bedingung: LL-Drehzahl f¸r KH abschalten, da nicht gen¸gend Unterdruck in BKV" UBYTE B_TRUE 1 100 0 1 BIT_MASK 0x1 FORMAT "%13.11" ECU_ADDRESS 0x3FBFFB /end MEASUREMENT
/begin MEASUREMENT B_bkvnwab "Bedingung Nockenwelle in Position mit min- ‹berschneidung wenn BKV leeer" UBYTE B_TRUE 1 100 0 1 BIT_MASK 0x1 FORMAT "%13.11" ECU_ADDRESS 0x3FBFFC /end MEASUREMENT
/begin MEASUREMENT B_bkvnwum "Bedingung Nockenwelle in Position mit min- ‹berschneidung wenn BKV leer" UBYTE B_TRUE 1 100 0 1 BIT_MASK 0x4 FORMAT "%13.11" ECU_ADDRESS 0x5B9030 /end MEASUREMENT
/begin MEASUREMENT B_bkvpa "Bedingung: Bremskraftverst‰rker-Pumpe ansteuern, da BKV zu wenig unterdruck" UBYTE B_TRUE 1 100 0 1 BIT_MASK 0x1 FORMAT "%13.11" ECU_ADDRESS 0x3FBFFD /end MEASUREMENT
/begin MEASUREMENT B_calcelse "Bedingung: Berechnung Endstufen-Diagnose E-Box Luefter" UBYTE B_TRUE 1 100 0 1 BIT_MASK 0x1 FORMAT "%13.11" ECU_ADDRESS 0x3FBD0E /end MEASUREMENT
/begin MEASUREMENT B_cotrim "Bedingung f¸r LL-CO Abgleich erf¸llt" UBYTE B_TRUE 1 100 0 1 BIT_MASK 0x1 FORMAT "%13.11" ECU_ADDRESS 0x3FBD4C /end MEASUREMENT
/begin MEASUREMENT B_dcy "Bedingung 'driving cycle' erkannt" UBYTE B_TRUE 1 100 0 1 BIT_MASK 0x1 FORMAT "%13.11" ECU_ADDRESS 0x5B8DF8 /end MEASUREMENT
/begin MEASUREMENT B_desee "Diagnose Endstufe: Eingangsbedingungen erf¸llt" UBYTE B_TRUE 1 100 0 1 BIT_MASK 0x1 FORMAT "%13.11" ECU_ADDRESS 0x3FBD0D /end MEASUREMENT
/begin MEASUREMENT B_diag_ezh "Bedingung: Aktuelle Fehlermeldung vom EZH-Steuerger‰t" UBYTE B_TRUE 1 100 0 1 BIT_MASK 0x1 FORMAT "%13.11" ECU_ADDRESS 0x3FBC2F /end MEASUREMENT
/begin MEASUREMENT B_disamx "Fehlerflag: DISA blockiert st‰ndig" UBYTE dez 1 100 0 255 FORMAT "%5.1" ECU_ADDRESS 0x5B86A5 /end MEASUREMENT
/begin MEASUREMENT B_disanp "Fehlerflag: DISA verstellt nicht oder Leitungsbruch (unplausibel)" UBYTE dez 1 100 0 255 FORMAT "%5.1" ECU_ADDRESS 0x5B86A6 /end MEASUREMENT
/begin MEASUREMENT B_dpsmod "Berechnungsmode f¸r dpsbgms_w" UBYTE B_TRUE 1 100 0 1 BIT_MASK 0x1 FORMAT "%13.11" ECU_ADDRESS 0x5B86D5 /end MEASUREMENT
/begin MEASUREMENT B_dsc_reg "CAN-Botschaft: DSC regelt (Motor und Bremseingriffe)" UBYTE B_TRUE 1 100 0 1 BIT_MASK 0x1 FORMAT "%13.11" ECU_ADDRESS 0x3FBC21 /end MEASUREMENT
/begin MEASUREMENT B_dslvh "Bedingung Ladedrucksensor vorhanden" UBYTE dez 1 100 0 255 FORMAT "%5.1" ECU_ADDRESS 0x5B86C9 /end MEASUREMENT
/begin MEASUREMENT B_dssv "Bedingung Saugrohr-Drucksensor vorhanden als Hauptlastsensor" UBYTE dez 1 100 0 255 FORMAT "%5.1" ECU_ADDRESS 0x5B86CA /end MEASUREMENT
/begin MEASUREMENT B_edprcana "Bedingung Fehler im dualported Ram CAN A" UBYTE B_TRUE 1 100 0 1 BIT_MASK 0x1 FORMAT "%13.11" ECU_ADDRESS 0x5B8AD6 /end MEASUREMENT
/begin MEASUREMENT B_eepcod1 "Data ID im Flash und EEPROM Spiegel unterschiedlich" UBYTE B_TRUE 1 100 0 1 BIT_MASK 0x1 FORMAT "%13.11" ECU_ADDRESS 0x3FBEA4 /end MEASUREMENT
/begin MEASUREMENT B_eev "Bedingung Endstufenfehler EV" UBYTE B_TRUE 1 100 0 1 BIT_MASK 0x1 FORMAT "%13.11" ECU_ADDRESS 0x3FBD0F /end MEASUREMENT
/begin MEASUREMENT B_egscok "Bedingung Getriebebotschaft CAN empfangen" UBYTE B_TRUE 1 100 0 1 BIT_MASK 0x1 FORMAT "%13.11" ECU_ADDRESS 0x3FBC26 /end MEASUREMENT
/begin MEASUREMENT B_egsnew "Bedingung, daﬂ eine neue Getriebebotschaft erkannt wurde" UBYTE B_TRUE 1 100 0 1 BIT_MASK 0x1 FORMAT "%13.11" ECU_ADDRESS 0x3FBC27 /end MEASUREMENT
/begin MEASUREMENT B_endaufh "Bedingung Aufheizphase der Wicklungstemperatur der SLP erreicht" UBYTE B_TRUE 1 100 0 1 BIT_MASK 0x1 FORMAT "%13.11" ECU_ADDRESS 0x5B8B88 /end MEASUREMENT
/begin MEASUREMENT B_enwmn "Nockenwellensteuerung: Min Position nicht ok (Einlaﬂ Nockenwelle 1)" UBYTE B_TRUE 1 100 0 1 BIT_MASK 0x10 FORMAT "%13.11" ECU_ADDRESS 0x5B8A41 /end MEASUREMENT
/begin MEASUREMENT B_enwmn2 "Nockenwellensteuerung: Min. Position nicht ok (Einlaﬂ Nockenwelle 2)" UBYTE B_TRUE 1 100 0 1 BIT_MASK 0x40 FORMAT "%13.11" ECU_ADDRESS 0x5B8A41 /end MEASUREMENT
/begin MEASUREMENT B_enwpnp "Nockenwellensteuerung: Position nicht plausibel (Einlaﬂ Nockenwelle 1)" UBYTE B_TRUE 1 100 0 1 BIT_MASK 0x1 FORMAT "%13.11" ECU_ADDRESS 0x5B8A41 /end MEASUREMENT
/begin MEASUREMENT B_enwpnp2 "Nockenwellensteuerung: Position nicht plausibel (Einlaﬂ Nockenwelle 2)" UBYTE B_TRUE 1 100 0 1 BIT_MASK 0x4 FORMAT "%13.11" ECU_ADDRESS 0x5B8A41 /end MEASUREMENT
/begin MEASUREMENT B_epcl "Bedingung f¸r Ansteuerung EGAS-Fehlerlampe" UBYTE B_TRUE 1 100 0 1 BIT_MASK 0x1 FORMAT "%13.11" ECU_ADDRESS 0x3FBC3F /end MEASUREMENT
/begin MEASUREMENT B_epclloc "Bedingung f¸r Ansteuerung EGAS-Fehlerlampe loc." UBYTE B_TRUE 1 100 0 1 BIT_MASK 0x1 FORMAT "%13.11" ECU_ADDRESS 0x3FBC40 /end MEASUREMENT
/begin MEASUREMENT B_evanos "Fehler im Vanos nach letztem Reset" UBYTE B_TRUE 1 100 0 1 FORMAT "%13.11" ECU_ADDRESS 0x5B8CD4 /end MEASUREMENT
/begin MEASUREMENT B_evfzgv1 "Bedingung Fehler Geschwindigkeitssignal V1 (¸ber CAN)" UBYTE B_TRUE 1 100 0 1 BIT_MASK 0x1 FORMAT "%13.11" ECU_ADDRESS 0x3FBC22 /end MEASUREMENT
/begin MEASUREMENT B_ezh "Bedingung: EZH verbaut" UBYTE B_TRUE 1 100 0 1 BIT_MASK 0x1 FORMAT "%13.11" ECU_ADDRESS 0x3FBC30 /end MEASUREMENT
/begin MEASUREMENT B_ezhcok "Bedingung EZH Botschaft CAN empfangen" UBYTE B_TRUE 1 100 0 1 BIT_MASK 0x1 FORMAT "%13.11" ECU_ADDRESS 0x3FBC31 /end MEASUREMENT
/begin MEASUREMENT B_ezherrst "Bedingung: Fehler ‹bertemperatur w‰hrend aktuellem Fahrzyklus erkannt" UBYTE B_TRUE 1 100 0 1 BIT_MASK 0x1 FORMAT "%13.11" ECU_ADDRESS 0x3FBC32 /end MEASUREMENT
/begin MEASUREMENT B_ezhnew "Bedingung: Neue EZH-CAN-Botschaft empfangen" UBYTE B_TRUE 1 100 0 1 BIT_MASK 0x1 FORMAT "%13.11" ECU_ADDRESS 0x3FBC33 /end MEASUREMENT
/begin MEASUREMENT B_fgrabz "Bedingung zus‰tzliche FGR-Abschaltung" UBYTE B_TRUE 1 100 0 1 BIT_MASK 0x1 FORMAT "%13.11" ECU_ADDRESS 0x3FBD1F /end MEASUREMENT
/begin MEASUREMENT B_fkmsmn "schnelle Massenstromadaption fkmsdks im unteren Anschlag" UBYTE dez 1 100 0 255 FORMAT "%5.1" ECU_ADDRESS 0x5B86CB /end MEASUREMENT
/begin MEASUREMENT B_fkmsmx "schnelle Massenstromadaption fkmsdks im oberen Anschlag" UBYTE dez 1 100 0 255 FORMAT "%5.1" ECU_ADDRESS 0x5B86CC /end MEASUREMENT
/begin MEASUREMENT B_fkpvmn "langsame Massenstromadaption fkpvdk im unteren Anschlag" UBYTE dez 1 100 0 255 FORMAT "%5.1" ECU_ADDRESS 0x5B86CD /end MEASUREMENT
/begin MEASUREMENT B_fkpvmx "langsame Massenstromadaption fkpvdk im oberen Anschlag" UBYTE dez 1 100 0 255 FORMAT "%5.1" ECU_ADDRESS 0x5B86CE /end MEASUREMENT
/begin MEASUREMENT B_fs "Bedingung Fahrstufe" UBYTE B_TRUE 1 100 0 1 BIT_MASK 0x1 FORMAT "%13.11" ECU_ADDRESS 0x3FBC28 /end MEASUREMENT
/begin MEASUREMENT B_fstcanok "CAN: Bedingung Tankfuellstands-Message okay" UBYTE B_TRUE 1 100 0 1 BIT_MASK 0x1 FORMAT "%13.11" ECU_ADDRESS 0x5B8AD7 /end MEASUREMENT
/begin MEASUREMENT B_fstpl "Bedingung Tankf¸llstand plausibel" UBYTE B_TRUE 1 100 0 1 BIT_MASK 0x1 FORMAT "%13.11" ECU_ADDRESS 0x3FBFF6 /end MEASUREMENT
/begin MEASUREMENT B_got "Bedingung Getriebeˆl_‹bertemperatur Stufe I" UBYTE B_TRUE 1 100 0 1 BIT_MASK 0x1 FORMAT "%13.11" ECU_ADDRESS 0x3FBC29 /end MEASUREMENT
/begin MEASUREMENT B_gts "Bedingung Getriebeschutz" UBYTE B_TRUE 1 100 0 1 BIT_MASK 0x1 FORMAT "%13.11" ECU_ADDRESS 0x3FBC2A /end MEASUREMENT
/begin MEASUREMENT B_hfmv "Bedingung HFM vorhanden" UBYTE dez 1 100 0 255 FORMAT "%5.1" ECU_ADDRESS 0x5B86CF /end MEASUREMENT
/begin MEASUREMENT B_hysllrah "Bedingung LL-Anhebunghysterese" UBYTE B_TRUE 1 100 0 1 FORMAT "%13.11" ECU_ADDRESS 0x5B89A2 /end MEASUREMENT
/begin MEASUREMENT B_hzl "Bedingung Anforderung Zuheizmaﬂnahme vom Klima-SG" UBYTE B_TRUE 1 100 0 1 BIT_MASK 0x1 FORMAT "%13.11" ECU_ADDRESS 0x3FBC35 /end MEASUREMENT
/begin MEASUREMENT B_ins2cok "Bedingung: CAN-Botschaft INSTR2 vorhanden" UBYTE B_TRUE 1 100 0 1 BIT_MASK 0x1 FORMAT "%13.11" ECU_ADDRESS 0x3FBC36 /end MEASUREMENT
/begin MEASUREMENT B_ins2new "Bedingung CAN-Kombi-Botschaft 2 empfangen" UBYTE B_TRUE 1 100 0 1 BIT_MASK 0x1 FORMAT "%13.11" ECU_ADDRESS 0x3FBC37 /end MEASUREMENT
/begin MEASUREMENT B_ins3cok "Bedingung CAN-Botschaft-INST3 vorhanden" UBYTE B_TRUE 1 100 0 1 BIT_MASK 0x1 FORMAT "%13.11" ECU_ADDRESS 0x3FBC38 /end MEASUREMENT
/begin MEASUREMENT B_ins3new "Bedingung CAN-Kombi-Botschaft 3 empfangen" UBYTE B_TRUE 1 100 0 1 BIT_MASK 0x1 FORMAT "%13.11" ECU_ADDRESS 0x3FBC39 /end MEASUREMENT
/begin MEASUREMENT B_intzwv "Bedingung ZW-Verstellung durch MD-Struktur aktiv" UBYTE B_TRUE 1 100 0 1 BIT_MASK 0x1 FORMAT "%13.11" ECU_ADDRESS 0x3FBF36 /end MEASUREMENT
/begin MEASUREMENT B_ko "Bedingung Kompressor freigegeben" UBYTE B_TRUE 1 100 0 1 BIT_MASK 0x1 FORMAT "%13.11" ECU_ADDRESS 0x3FBC3A /end MEASUREMENT
/begin MEASUREMENT B_kovar "Variantenbit f¸r Klimakompressor vorhanden" UBYTE B_TRUE 1 100 0 1 BIT_MASK 0x1 FORMAT "%13.11" ECU_ADDRESS 0x3FBC3B /end MEASUREMENT
/begin MEASUREMENT B_kupplmod "Bedingung Kupplung bet‰tigt aus Modell" UBYTE B_TRUE 1 100 0 1 FORMAT "%13.11" ECU_ADDRESS 0x5B8B46 /end MEASUREMENT
/begin MEASUREMENT B_lwscok "" UBYTE B_TRUE 1 100 0 1 BIT_MASK 0x1 FORMAT "%13.11" ECU_ADDRESS 0x3FBC16 /end MEASUREMENT
/begin MEASUREMENT B_lwsnew "" UBYTE B_TRUE 1 100 0 1 BIT_MASK 0x1 FORMAT "%13.11" ECU_ADDRESS 0x3FBC17 /end MEASUREMENT
/begin MEASUREMENT B_miext "Bedingung externer Momenteneingriff" UBYTE B_TRUE 1 100 0 1 BIT_MASK 0x1 FORMAT "%13.11" ECU_ADDRESS 0x3FBF37 /end MEASUREMENT
/begin MEASUREMENT B_msrext "Bedingung f¸r externe Anforderung MSR" UBYTE B_TRUE 1 100 0 1 BIT_MASK 0x1 FORMAT "%13.11" ECU_ADDRESS 0x3FBC23 /end MEASUREMENT
/begin MEASUREMENT B_ngasok "Bedingung Ringspeicher f¸r ngas-Berechnung ok" UBYTE B_TRUE 1 100 0 1 BIT_MASK 0x1 FORMAT "%13.11" ECU_ADDRESS 0x3FBC46 /end MEASUREMENT
/begin MEASUREMENT B_nldg "Bedingung Drehzahlgeber-Notlauf ist aktiv." UBYTE B_TRUE 1 100 0 1 BIT_MASK 0x1 FORMAT "%13.11" ECU_ADDRESS 0x3FBC4B /end MEASUREMENT
/begin MEASUREMENT B_nmin "Bedingung Unterdrehzahl: n < NMIN" UBYTE B_TRUE 1 100 0 1 BIT_MASK 0x1 FORMAT "%13.11" ECU_ADDRESS 0x3FBC48 /end MEASUREMENT
/begin MEASUREMENT B_nmot "Bedingung Motordrehzahl: n > NMIN" UBYTE B_TRUE 1 100 0 1 BIT_MASK 0x1 FORMAT "%13.11" ECU_ADDRESS 0x3FBC49 /end MEASUREMENT
/begin MEASUREMENT B_nsp "Bedingung Nachspritzer" UBYTE B_TRUE 1 100 0 1 BIT_MASK 0x1 FORMAT "%13.11" ECU_ADDRESS 0x3FBD46 /end MEASUREMENT
/begin MEASUREMENT B_ntkw "Bedingung Anforderung niedrige K¸hlmitteltemp. (W‰rmetauscherschutz)" UBYTE B_TRUE 1 100 0 1 BIT_MASK 0x1 FORMAT "%13.11" ECU_ADDRESS 0x3FBC3C /end MEASUREMENT
/begin MEASUREMENT B_oldmiistc "" UBYTE B_TRUE 1 100 0 1 BIT_MASK 0x1 FORMAT "%13.11" ECU_ADDRESS 0x3FBC15 /end MEASUREMENT
/begin MEASUREMENT B_pbkvmn "Bedingung Bremskraftverst‰rker-Druck minimieren" UBYTE B_TRUE 1 100 0 1 BIT_MASK 0x1 FORMAT "%13.11" ECU_ADDRESS 0x5B9030 /end MEASUREMENT
/begin MEASUREMENT B_pbkvmnp "Bedingung: Bremskraftverst‰rkerdruck durch BKV-Pumpe minimieren" UBYTE B_TRUE 1 100 0 1 BIT_MASK 0x8 FORMAT "%13.11" ECU_ADDRESS 0x5B9030 /end MEASUREMENT
/begin MEASUREMENT B_phad "Adaption Kurbel/Nockenwelle erfolgt" UBYTE B_TRUE 1 100 0 1 BIT_MASK 0x1 FORMAT "%13.11" ECU_ADDRESS 0x5B8A40 /end MEASUREMENT
/begin MEASUREMENT B_phad2 "Adaption Kurbel-/Nockenwelle 2 erfolgt" UBYTE B_TRUE 1 100 0 1 BIT_MASK 0x4 FORMAT "%13.11" ECU_ADDRESS 0x5B8A40 /end MEASUREMENT
/begin MEASUREMENT B_phad3 "Adaption Kurbel-/Nockenwelle 3 erfolgt" UBYTE B_TRUE 1 100 0 1 BIT_MASK 0x2 FORMAT "%13.11" ECU_ADDRESS 0x5B8A40 /end MEASUREMENT
/begin MEASUREMENT B_phad4 "Adaption Kurbel-/Nockenwelle 4 erfolgt" UBYTE B_TRUE 1 100 0 1 BIT_MASK 0x8 FORMAT "%13.11" ECU_ADDRESS 0x5B8A40 /end MEASUREMENT
/begin MEASUREMENT B_pltab "Bedingung Plausibilit‰tspr¸fung Abstellzeit mˆglich" UBYTE B_TRUE 1 100 0 1 BIT_MASK 0x1 FORMAT "%13.11" ECU_ADDRESS 0x3FBD4A /end MEASUREMENT
/begin MEASUREMENT B_pn "Bedingung f¸r Fahrstufe P oder N" UBYTE B_TRUE 1 100 0 1 BIT_MASK 0x1 FORMAT "%13.11" ECU_ADDRESS 0x3FBC2B /end MEASUREMENT
/begin MEASUREMENT B_rlp "Bedingung Lastpraediktion aktiv" UBYTE B_TRUE 1 100 0 1 BIT_MASK 0x1 FORMAT "%13.11" ECU_ADDRESS 0x3FBD47 /end MEASUREMENT
/begin MEASUREMENT B_rlpns "Einschaltbedingung Lastpraediktion nach Start" UBYTE B_TRUE 1 100 0 1 BIT_MASK 0x1 FORMAT "%13.11" ECU_ADDRESS 0x3FBD48 /end MEASUREMENT
/begin MEASUREMENT B_sspfini "Bedingung: Abschaltung Tiefpaﬂfilter f¸r Massenstrom" UBYTE B_TRUE 1 100 0 1 BIT_MASK 0x1 FORMAT "%13.11" ECU_ADDRESS 0x3FBFF4 /end MEASUREMENT
/begin MEASUREMENT B_sspm "Bedingung: Massenstrom ¸ber SSP-Ventil freigegeben" UBYTE B_TRUE 1 100 0 1 BIT_MASK 0x1 FORMAT "%13.11" ECU_ADDRESS 0x3FBFF5 /end MEASUREMENT
/begin MEASUREMENT B_startini "Startbit f¸r Erkennung der ersten Synchronisation nach KL15 ein" UBYTE B_TRUE 1 100 0 1 BIT_MASK 0x1 FORMAT "%13.11" ECU_ADDRESS 0x3FBC4A /end MEASUREMENT
/begin MEASUREMENT B_suini "Bedingung Abschaltung Tiefpaﬂfilter f¸r pirg_w und fupsrl_w" UBYTE B_TRUE 1 100 0 1 BIT_MASK 0x1 FORMAT "%13.11" ECU_ADDRESS 0x3FBD22 /end MEASUREMENT
/begin MEASUREMENT B_tabunpl "Bedingung Abstellzeit unplausibel" UBYTE B_TRUE 1 100 0 1 BIT_MASK 0x1 FORMAT "%13.11" ECU_ADDRESS 0x3FBD4B /end MEASUREMENT
/begin MEASUREMENT B_talcan "Bedingung Tank leer aus Kombi-Botschaft" UBYTE B_TRUE 1 100 0 1 BIT_MASK 0x1 FORMAT "%13.11" ECU_ADDRESS 0x3FD7EA /end MEASUREMENT
/begin MEASUREMENT B_timsa "Bedingung Integrator f¸r multip. Adaption freigegeben" UBYTE dez 1 100 0 255 FORMAT "%5.1" ECU_ADDRESS 0x5B86D0 /end MEASUREMENT
/begin MEASUREMENT B_timsall "Bedingung Integrator f¸r additive Adaption freigegeben" UBYTE dez 1 100 0 255 FORMAT "%5.1" ECU_ADDRESS 0x5B86D1 /end MEASUREMENT
/begin MEASUREMENT B_timsallv "Freigabe langsame Faktoradaption VVT" UBYTE dez 1 100 0 255 FORMAT "%5.1" ECU_ADDRESS 0x5B86D2 /end MEASUREMENT
/begin MEASUREMENT B_timsavvt "Freigabe Aditiveadaption VVT" UBYTE dez 1 100 0 255 FORMAT "%5.1" ECU_ADDRESS 0x5B86D3 /end MEASUREMENT
/begin MEASUREMENT B_timsvvt "Bedingung schneller Massenstromabgleich aktiv VVT Betrieb" UBYTE dez 1 100 0 255 FORMAT "%5.1" ECU_ADDRESS 0x5B86D4 /end MEASUREMENT
/begin MEASUREMENT B_tired "Bedingung ti-Reduktion" UBYTE B_TRUE 1 100 0 1 BIT_MASK 0x1 FORMAT "%13.11" ECU_ADDRESS 0x3FBD49 /end MEASUREMENT
/begin MEASUREMENT B_tns "Bedingung aus Schalter Tag-/Nachtbeleuchtung" UBYTE B_TRUE 1 100 0 1 BIT_MASK 0x1 FORMAT "%13.11" ECU_ADDRESS 0x3FBC3D /end MEASUREMENT
/begin MEASUREMENT B_uhrrnpl "Bedingung Uhr mit relativem Minutenz‰hler unplausibel" UBYTE B_TRUE 1 100 0 1 BIT_MASK 0x1 FORMAT "%13.11" ECU_ADDRESS 0x3FDC10 /end MEASUREMENT
/begin MEASUREMENT B_wdkhfu "Bdg: Berechnung  Winkels DK aus Signal des HF-Sensors ungedrosselt" UBYTE B_TRUE 1 100 0 1 FORMAT "%13.11" ECU_ADDRESS 0x5B8B40 /end MEASUREMENT
/begin MEASUREMENT B_wk "Bedingung: Wandlerkupplung ¸berbr¸ckt" UBYTE B_TRUE 1 100 0 1 BIT_MASK 0x1 FORMAT "%13.11" ECU_ADDRESS 0x3FBC2C /end MEASUREMENT
/begin MEASUREMENT B_wkr "Bedingung f¸r Wandlerkupplung geregelt" UBYTE B_TRUE 1 100 0 1 BIT_MASK 0x1 FORMAT "%13.11" ECU_ADDRESS 0x3FBC2D /end MEASUREMENT
/begin MEASUREMENT canastat "Fehlerstatus des CAN A" UBYTE dez 1 100 0 255 FORMAT "%5.1" ECU_ADDRESS 0x5B8500 /end MEASUREMENT
/begin MEASUREMENT canastati "" UBYTE dez 1 100 0 255 FORMAT "%5.1" ECU_ADDRESS 0x5B8501 /end MEASUREMENT
/begin MEASUREMENT CANINSbits "" UBYTE dez 1 100 0 255 FORMAT "%5.1" ECU_ADDRESS 0x3FD7EA /end MEASUREMENT
/begin MEASUREMENT co_pot "Leerlauf-CO-Gemisch-Versteller" SBYTE dez 1 100 -128 127 FORMAT "%5.1" ECU_ADDRESS 0x5B8E93 /end MEASUREMENT
/begin MEASUREMENT co_pot_w "Leerlauf-CO-Gemisch-Versteller" SWORD dez 1 100 -32768 32767 FORMAT "%8.2" ECU_ADDRESS 0x5B9194 /end MEASUREMENT
/begin MEASUREMENT dcycnt "Driving cycle - counter" UWORD dez 1 100 0 65535 FORMAT "%8.2" ECU_ADDRESS 0x3FD7F4 /end MEASUREMENT
/begin MEASUREMENT dekpe "Statusbyte Diagnose EKP Endstufe" UBYTE dez 1 100 0 255 FORMAT "%5.1" ECU_ADDRESS 0x5B869C /end MEASUREMENT
/begin MEASUREMENT disa_pos "" UBYTE dez 1 100 0 255 FORMAT "%5.1" ECU_ADDRESS 0x5B86D8 /end MEASUREMENT
/begin MEASUREMENT dkmsmszs "Ausgang aus KFDKMS" UWORD m_uw_b6553p5 1 100 0 6553.5 FORMAT "%8.3" ECU_ADDRESS 0x5B95EC /end MEASUREMENT
/begin MEASUREMENT dnmotas_w "Differenzdrehzahl ¸ber ein Arbeitsspiel" SWORD nmot_sw_q0p25 1 100 -8192 8191.75 FORMAT "%8.3" ECU_ADDRESS 0x5B9070 /end MEASUREMENT
/begin MEASUREMENT dnmot_w "Differenzdrehzahl zwischen zwei folgenden Segmenten" SWORD nmot_sw_q0p25 1 100 -8192 8191.75 FORMAT "%8.3" ECU_ADDRESS 0x5B9072 /end MEASUREMENT
/begin MEASUREMENT dpbkvukb_w "min. zul‰ssige Druckdif. zwischen BKV-Druck und pu mit Bet‰tigung der Bremse" UWORD p_uw_q0p039 1 100 0 2559.96 FORMAT "%8.3" ECU_ADDRESS 0x5B949C /end MEASUREMENT
/begin MEASUREMENT dpbkvukh_w "min. zul‰ssige Druckdif. zw. pbkv  und pu f¸r Abschalten der LL-Drehzahl f¸r KH" UWORD p_uw_q0p039 1 100 0 2559.96 FORMAT "%8.3" ECU_ADDRESS 0x5B949E /end MEASUREMENT
/begin MEASUREMENT dpbkvukk_w "min. zul‰ssige Druckdif. zwischen BKV-Druck und pu f¸r Abschaltung Klimakom." UWORD p_uw_q0p039 1 100 0 2559.96 FORMAT "%8.3" ECU_ADDRESS 0x5B94A0 /end MEASUREMENT
/begin MEASUREMENT dpbkvukp_w "min. zul‰ssige Druckdif. zw. pbkv  und pu f¸r Ansteuerung BKV-Pumpe" UWORD p_uw_q0p039 1 100 0 2559.96 FORMAT "%8.3" ECU_ADDRESS 0x5B94A2 /end MEASUREMENT
/begin MEASUREMENT dpbkvukr_w "min. zul‰ssige Druckdif. zwischen BKV-Druck und Umgebungsdruck" UWORD p_uw_q0p039 1 100 0 2559.96 FORMAT "%8.3" ECU_ADDRESS 0x5B94A4 /end MEASUREMENT
/begin MEASUREMENT dpbkvuk_w "min. zul‰ssige Druckdif. zwischen BKV-Druck und pu ohne Bet‰tigung der Bremse" UWORD p_uw_q0p039 1 100 0 2559.96 FORMAT "%8.3" ECU_ADDRESS 0x5B94A6 /end MEASUREMENT
/begin MEASUREMENT dpbkvunw_w "min. zul. Druckdif. zw. pbkv und pu f¸r NW-Umschaltung" UWORD p_uw_q0p039 1 100 0 2559.96 FORMAT "%8.3" ECU_ADDRESS 0x5B94A8 /end MEASUREMENT
/begin MEASUREMENT dpbukkb_w "min. zul. Druckdif. zw. pbkv und pu f¸r Absch. Klimakom. beim Bremsen" UWORD p_uw_q0p039 1 100 0 2559.96 FORMAT "%8.3" ECU_ADDRESS 0x5B94AA /end MEASUREMENT
/begin MEASUREMENT dpbukk_w "min. zul. Druckdif. zw. pbkv und pu f¸r Absch. Klimakom. ohne zu Bremsen" UWORD p_uw_q0p039 1 100 0 2559.96 FORMAT "%8.3" ECU_ADDRESS 0x5B94AC /end MEASUREMENT
/begin MEASUREMENT dpbuknkh_w "min. zul‰ssige Druckdif. zw. pbkv  und pu f¸r Abschalten der LL-Drehzahl f¸r KH" UWORD p_uw_q0p039 1 100 0 2559.96 FORMAT "%8.3" ECU_ADDRESS 0x5B94AE /end MEASUREMENT
/begin MEASUREMENT dpbuknwb_w "min. zul. Druckdif. zw. pbkv und pu f¸r NW-Umschaltung beim Bremsen" UWORD p_uw_q0p039 1 100 0 2559.96 FORMAT "%8.3" ECU_ADDRESS 0x5B94B0 /end MEASUREMENT
/begin MEASUREMENT dpbuknw_w "min. zul. Druckdif. zw. pbkv und pu f¸r NW-Umschaltung ohne zu Bremsen" UWORD p_uw_q0p039 1 100 0 2559.96 FORMAT "%8.3" ECU_ADDRESS 0x5B94B2 /end MEASUREMENT
/begin MEASUREMENT dpbukpb_w "min. zul‰ssige Druckdif. zw. pbkv  und pu f¸r Ansteuerung BKV-Pumpe mit Bremsen" UWORD p_uw_q0p039 1 100 0 2559.96 FORMAT "%8.3" ECU_ADDRESS 0x5B94B4 /end MEASUREMENT
/begin MEASUREMENT dpbukp_w "min. zul‰ssige Druckdif. zw. pbkv  und pu f¸r Ansteuerung BKV-Pumpe ohne Bremsen" UWORD p_uw_q0p039 1 100 0 2559.96 FORMAT "%8.3" ECU_ADDRESS 0x5B94B6 /end MEASUREMENT
/begin MEASUREMENT dpbunkhb_w "min. zul‰ssige Druckdif. zw. pbkv  und pu f¸r Abschalten LL_Drehzahl f¸r KH" UWORD p_uw_q0p039 1 100 0 2559.96 FORMAT "%8.3" ECU_ADDRESS 0x5B94B8 /end MEASUREMENT
/begin MEASUREMENT dpipolmszs "Kennlinieninterpolation dp BGMSZS" UWORD fak_uw_b2 1 100 0 1.99997 FORMAT "%8.6" ECU_ADDRESS 0x5B95EE /end MEASUREMENT
/begin MEASUREMENT dpipol_aus "Kennlinieninterpolation dp BGMSZS aus" UWORD fak_uw_b2 1 100 0 1.99997 FORMAT "%8.6" ECU_ADDRESS 0x5B95F0 /end MEASUREMENT
/begin MEASUREMENT dpipol_in "dpipolmszs umgerechnet f¸r Kennlinieninterpolation KLAF" UWORD fak_uw_q0p001 1 100 0 0.5 FORMAT "%9.7" ECU_ADDRESS 0x5B95F2 /end MEASUREMENT
/begin MEASUREMENT dpipowdkhf "Kennlinieninterpolation aus dp f¸r BGWDKHF" UWORD fak_uw_b2 1 100 0 1.99997 FORMAT "%8.6" ECU_ADDRESS 0x5B95D6 /end MEASUREMENT
/begin MEASUREMENT dpsbgms_w "Differenzdruck mit Massenstromabgleich" SWORD p_q0p039 1 100 -1280 1279.96 FORMAT "%8.3" ECU_ADDRESS 0x5B95F4 /end MEASUREMENT
/begin MEASUREMENT dpsdvs_w "delta Saugrohrdruck aus Drosselventilen (Word)" SWORD p_sw_q0p039 1 100 -1280 1279.96 FORMAT "%8.3" ECU_ADDRESS 0x5B917C /end MEASUREMENT
/begin MEASUREMENT dpsfg_w "delta-Frischgaspartialdruck im Saugrohr" SWORD p_sw_q0p039 1 100 -1280 1279.96 FORMAT "%8.3" ECU_ADDRESS 0x5B914C /end MEASUREMENT
/begin MEASUREMENT dpsmp_w "delta extrapolierter Saugrohrdruck (Word)" SWORD p_sw_q0p039 1 100 -1280 1279.96 FORMAT "%8.3" ECU_ADDRESS 0x5B917E /end MEASUREMENT
/begin MEASUREMENT dpsvbgms_w "Solldruckverhaeltnis vor Begrenzung" UWORD fak_uw_b2 1 100 0 1.99997 FORMAT "%8.6" ECU_ADDRESS 0x5B95F6 /end MEASUREMENT
/begin MEASUREMENT dps_uw "Delta-Saugrohrdruck (unsigned word)" UWORD p_q0p039s32768 1 100 -1280 1279.96 FORMAT "%7.2" ECU_ADDRESS 0x5B9448 /end MEASUREMENT
/begin MEASUREMENT dpwdkhf_in "Eingang KL Interpolation f¸r BGWDKHF in Integer" UWORD fak_uw_q0p001 1 100 0 65.535 FORMAT "%8.5" ECU_ADDRESS 0x5B95D8 /end MEASUREMENT
/begin MEASUREMENT dpwdkhf_w "Eingang KL Interpolation f¸r BGWDKHF" UWORD fak_uw_b2 1 100 0 0.999969 FORMAT "%9.7" ECU_ADDRESS 0x5B95DA /end MEASUREMENT
/begin MEASUREMENT drlas_w "F¸llungs‰nderung pro Arbeitsspiel" SWORD relNWU_q0p0234 1 100 -768 767.977 FORMAT "%8.4" ECU_ADDRESS 0x5B9138 /end MEASUREMENT
/begin MEASUREMENT drllad_w "Dynamikanteil der relativen F¸llung rl bei Laderdynamik" SWORD rel_sw_q0p0234 1 100 -768 767.977 FORMAT "%8.4" ECU_ADDRESS 0x5B9110 /end MEASUREMENT
/begin MEASUREMENT drlp_w "delta-Einspritzberechnungs-Last aus Praediktion (Word)" SWORD rel_sw_q0p0234 1 100 -768 767.977 FORMAT "%8.4" ECU_ADDRESS 0x3FC068 /end MEASUREMENT
/begin MEASUREMENT drl_w "F¸llungs‰nderung (Word)" SWORD rel_sw_q0p0234 1 100 -768 767.977 FORMAT "%8.4" ECU_ADDRESS 0x5B914E /end MEASUREMENT
/begin MEASUREMENT dtwslpum_w "Differenz zwischen Wicklungstemperatur der SLP und der SLP Umgebungstemperatur" SWORD temp_q0p0234 1 100 -768 767.977 FORMAT "%8.4" ECU_ADDRESS 0x5B8A92 /end MEASUREMENT
/begin MEASUREMENT dv_lh "Radgeschwindigkeitsdifferenz links hinten" SWORD vfzg_uw_q0p0625 1 100 -2048 2047.94 FORMAT "%8.3" ECU_ADDRESS 0x5B90D4 /end MEASUREMENT
/begin MEASUREMENT dv_lv "Radgeschwindigkeitsdifferenz links vorne" SWORD vfzg_uw_q0p0625 1 100 -2048 2047.94 FORMAT "%8.3" ECU_ADDRESS 0x5B90D6 /end MEASUREMENT
/begin MEASUREMENT dv_rh "Radgeschwindigkeitsdifferenz rechts hinten" SWORD vfzg_uw_q0p0625 1 100 -2048 2047.94 FORMAT "%8.3" ECU_ADDRESS 0x5B90D8 /end MEASUREMENT
/begin MEASUREMENT dv_rv "Radgeschwindigkeitsdifferenz rechts vorne" SWORD vfzg_uw_q0p0625 1 100 -2048 2047.94 FORMAT "%8.3" ECU_ADDRESS 0x5B90DA /end MEASUREMENT
/begin MEASUREMENT egscod "Automatische EGS-SG Erkennung" UBYTE dez 1 100 0 255 FORMAT "%5.1" ECU_ADDRESS 0x3FD7E7 /end MEASUREMENT
/begin MEASUREMENT ekpausc "CAN-Botschaft EKP-Abschaltung ¸ber Crash-Sensor Airbag-SG" UBYTE dez 1 100 0 3 FORMAT "%5.3" ECU_ADDRESS 0x5B8DF1 /end MEASUREMENT
/begin MEASUREMENT ekpfz "Endstufendiagnose EKP-Relais: Z‰hler zur Entprellung der Endstufenfehler" UBYTE dez 1 100 0 255 FORMAT "%5.1" ECU_ADDRESS 0x5B869D /end MEASUREMENT
/begin MEASUREMENT ekppz "Endstufendiagnose EKP-Relais: Z‰hler f¸r Pr¸fpulsausgabe" UBYTE dez 1 100 0 255 FORMAT "%5.1" ECU_ADDRESS 0x5B869E /end MEASUREMENT
/begin MEASUREMENT etazabas "Ist-Zylinderausblendungswirkungsgrad (ohne ext. Ausblendungsanforderung)" UBYTE rel_ub_b127p5 1 100 0 127.5 FORMAT "%5.1" ECU_ADDRESS 0x5B8FBB /end MEASUREMENT
/begin MEASUREMENT evhubin2_w "Isthub aus Hubmodell Bank 2" UWORD hub_uw_q0p001 1 100 0 65.535 FORMAT "%8.5" ECU_ADDRESS 0x5B95F8 /end MEASUREMENT
/begin MEASUREMENT evhubin_w "Isthub aus Hubmodell" UWORD hub_uw_q0p001 1 100 0 65.535 FORMAT "%8.5" ECU_ADDRESS 0x5B95FA /end MEASUREMENT
/begin MEASUREMENT evtmod "Einlaﬂventiltemperatur modelliert (Temperaturmodell)" UBYTE temp_ub_q0p75_o48 1 100 -48 143.25 FORMAT "%5.1" ECU_ADDRESS 0x5B86EC /end MEASUREMENT
/begin MEASUREMENT ezhcod "Nachricht EZH erfolgreich empfangen" UBYTE dez 1 100 0 255 FORMAT "%5.1" ECU_ADDRESS 0x3FD7E9 /end MEASUREMENT
/begin MEASUREMENT E_disasch "Fehlerflag" UBYTE dez 1 100 0 255 FORMAT "%5.1" ECU_ADDRESS 0x5B86A7 /end MEASUREMENT
/begin MEASUREMENT fho_u "Korrekturfaktor Hˆhe (byte)" UBYTE fak_q0p015625 1 100 0 3.98438 FORMAT "%5.3" ECU_ADDRESS 0x5B8B90 /end MEASUREMENT
/begin MEASUREMENT fkmsdka_w "Korrekturfaktor schneller Massenstromausgleich" UWORD fak_uw_b4 1 100 0 3.99994 FORMAT "%8.6" ECU_ADDRESS 0x3FDBD8 /end MEASUREMENT
/begin MEASUREMENT fkmsdks_w "Korrekturfaktor schneller Massenstromabgleich" UWORD fak_uw_b4 1 100 0 3.99994 FORMAT "%8.6" ECU_ADDRESS 0x3FDBDA /end MEASUREMENT
/begin MEASUREMENT fkmsdk_w "Korrekturfaktor Massenstrom Nebenf¸llungssignal" UWORD fak_uw_b4 1 100 0 3.99994 FORMAT "%8.6" ECU_ADDRESS 0x3FDBDC /end MEASUREMENT
/begin MEASUREMENT fkmsvvta_w "Faktor Massenstromabgleich langsam VVT" UWORD fak_uw_b4 1 100 0 3.99994 FORMAT "%8.6" ECU_ADDRESS 0x3FDBDE /end MEASUREMENT
/begin MEASUREMENT fkmsvvts_w "Faktor Massenstromabgleich schnell VVT" UWORD fak_uw_b4 1 100 0 3.99994 FORMAT "%8.6" ECU_ADDRESS 0x3FDBE0 /end MEASUREMENT
/begin MEASUREMENT fkmsvvt_w "Faktor Massenstromabgleich gesamt VVT" UWORD fak_uw_b4 1 100 0 3.99994 FORMAT "%8.6" ECU_ADDRESS 0x3FDBE2 /end MEASUREMENT
/begin MEASUREMENT fmtate_w "Berechnung der Blendenˆffnung ¸ber Tastverh‰ltnis" UWORD fak_uw_b1 1 100 0 0.999985 FORMAT "%9.7" ECU_ADDRESS 0x5B944A /end MEASUREMENT
/begin MEASUREMENT fmtev_w "Faktor Massenstrom durch TEV" UWORD fak_uw_b1 1 100 0 0.999985 FORMAT "%9.7" ECU_ADDRESS 0x5B944C /end MEASUREMENT
/begin MEASUREMENT fnnm_w "" UWORD fak_uw_b1 1 100 0 0.999985 FORMAT "%9.7" ECU_ADDRESS 0x5B86DA /end MEASUREMENT
/begin MEASUREMENT fpvdk "Korrekturfaktor Druck vor Drosselklappe" UBYTE fak_ub_b4 1 100 0 3.98438 FORMAT "%5.3" ECU_ADDRESS 0x5B8E7D /end MEASUREMENT
/begin MEASUREMENT fpvdk_w "Korrekturfaktor Druck vor Drosselklappe 16-Bit" UWORD fak_uw_b4 1 100 0 3.99994 FORMAT "%8.6" ECU_ADDRESS 0x5B9112 /end MEASUREMENT
/begin MEASUREMENT frau_u "multiplikativer Gemischadaptionsfaktor unterer mult. Bereich (Byte)" UBYTE fak_ub_b2 1 100 0 1.99219 FORMAT "%5.3" ECU_ADDRESS 0x5B8E01 /end MEASUREMENT
/begin MEASUREMENT fra_u "multiplikative Gemischkorrektur der Gemischadaption (Byte)" UBYTE fak_ub_b2 1 100 0 1.99219 FORMAT "%5.3" ECU_ADDRESS 0x5B8E02 /end MEASUREMENT
/begin MEASUREMENT frhodk_w "Faktor Luftdichtekorrektur f¸r DK-Durchfluﬂ f(Ansauglufttemp.,Hˆhe) 16 Bit" UWORD fak_uw_b2 1 100 0 1.99997 FORMAT "%8.6" ECU_ADDRESS 0x5B9114 /end MEASUREMENT
/begin MEASUREMENT frhol_u "Umweltwert: Faktor Luftdichte f(Ansauglufttemp., Hˆhe) 8-Bit" UBYTE fak_ub_b2 1 100 0 1.99219 FORMAT "%5.3" ECU_ADDRESS 0x5B8E03 /end MEASUREMENT
/begin MEASUREMENT frm_u "schneller Mittelwert des Lambdaregelfaktors ( 1 Byte f¸r Tester )" UBYTE fak_ub_b2 1 100 0 1.99219 FORMAT "%5.3" ECU_ADDRESS 0x5B8E04 /end MEASUREMENT
/begin MEASUREMENT fr_u "Lambda-Regler-Ausgang (Byte)" UBYTE fak_ub_b2 1 100 0 1.99219 FORMAT "%5.3" ECU_ADDRESS 0x5B8E05 /end MEASUREMENT
/begin MEASUREMENT fsttankl "F¸llstand der linken Tankh‰lfte" UBYTE fuel_ub_q0p5 1 100 0 127.5 FORMAT "%5.1" ECU_ADDRESS 0x5B8DF2 /end MEASUREMENT
/begin MEASUREMENT fsttankrf "F¸llstand der rechten Tankh‰lfte gefiltert" UBYTE fuel_ub_q0p5 1 100 0 127.5 FORMAT "%5.1" ECU_ADDRESS 0x5B8A98 /end MEASUREMENT
/begin MEASUREMENT ftbr "Faktor Temperaturkorrektur im Brennraum" UBYTE fak_ub_b2 1 100 0 1.99219 FORMAT "%5.3" ECU_ADDRESS 0x5B86ED /end MEASUREMENT
/begin MEASUREMENT ftbr_w "Faktor Temperaturkorrektur im Brennraum" UWORD fak_uw_b2 1 100 0 1.99997 FORMAT "%8.6" ECU_ADDRESS 0x5B86F2 /end MEASUREMENT
/begin MEASUREMENT ftead_u "Beladung des Aktivkohlefilters" SBYTE fak_q0p5 1 100 -64 63.5 FORMAT "%5.2" ECU_ADDRESS 0x5B8E06 /end MEASUREMENT
/begin MEASUREMENT ftsr "Korrekturfaktor Lufttemperatur im Saugrohr" UBYTE fak_ub_b2 1 100 0 1.99219 FORMAT "%5.3" ECU_ADDRESS 0x5B8E80 /end MEASUREMENT
/begin MEASUREMENT ftu "Faktor Temperatur Umgebung" UBYTE fak_ub_b2 1 100 0 1.99219 FORMAT "%5.3" ECU_ADDRESS 0x5B86EE /end MEASUREMENT
/begin MEASUREMENT ftvdk "Korrekturfaktor Temperatur vor Drosselklappe" UBYTE fak_ub_b2 1 100 0 1.99219 FORMAT "%5.3" ECU_ADDRESS 0x5B8E81 /end MEASUREMENT
/begin MEASUREMENT ftw "Faktor Temperaturgewichtung tmot, tans" UBYTE fak_ub_b1 1 100 0 0.996094 ECU_ADDRESS 0x5B86EF /end MEASUREMENT
/begin MEASUREMENT fupsrl_w "Faktor systembezogene Umrechnung Druck auf F¸llung (16-Bit)" UWORD rel_uw_b0p3 1 100 0 0.299995 FORMAT "%9.7" ECU_ADDRESS 0x5B9150 /end MEASUREMENT
/begin MEASUREMENT fvisrm_w "Faktor Verst‰rkung Integrator Saugrohrmodell" UWORD p_uw_b32 1 100 0 31.9995 FORMAT "%8.5" ECU_ADDRESS 0x5B9152 /end MEASUREMENT
/begin MEASUREMENT fwprs_w "Faktor Preadiktionswinkel bezogen auf Segment" UWORD fak_uw_b32 1 100 0 31.9995 FORMAT "%8.5" ECU_ADDRESS 0x5B9180 /end MEASUREMENT
/begin MEASUREMENT gangauti "bei Automatikgetriebe ¸ber CAN empfangener aktueller Gang" UBYTE dez 1 100 0 255 FORMAT "%5.1" ECU_ADDRESS 0x5B8DED /end MEASUREMENT
/begin MEASUREMENT gangctr "tempor‰rer Gangz‰hler" UBYTE dez 1 100 0 255 FORMAT "%5.1" ECU_ADDRESS 0x5B8E72 /end MEASUREMENT
/begin MEASUREMENT gendfvorhs "DF-Signal Vorhersage" UBYTE PCENT 1 100 0 99.6094 FORMAT "%5.2" ECU_ADDRESS 0x5B89A3 /end MEASUREMENT
/begin MEASUREMENT genikaltmp "tempor‰rer Kaltstrom" UBYTE igen_ub_q1 1 100 0 255 FORMAT "%5.1" ECU_ADDRESS 0x5B89A4 /end MEASUREMENT
/begin MEASUREMENT genitemp2 "tempor‰rer Warmstrom" UBYTE igen_ub_q1 1 100 0 255 FORMAT "%5.1" ECU_ADDRESS 0x5B89A5 /end MEASUREMENT
/begin MEASUREMENT hilo "" UWORD dez 1 100 0 65535 FORMAT "%8.2" ECU_ADDRESS 0x5B86DC /end MEASUREMENT
/begin MEASUREMENT iegr_w "Rover" UWORD rel_uw_b100 1 100 0 99.9985 FORMAT "%8.5" ECU_ADDRESS 0x5B9154 /end MEASUREMENT
/begin MEASUREMENT igenrllrah "Generatorstrom mit Vorlaufreserve" UBYTE igen_ub_q1 1 100 0 254 FORMAT "%5.1" ECU_ADDRESS 0x5B89A6 /end MEASUREMENT
/begin MEASUREMENT igod_u "Integratorgradient f¸r Nulltest-Diagnose Klopfregelung (1 Byte f¸r Tester)" SBYTE spgg_sb_b3052 1 100 -3052.01 3028.16 FORMAT "%5.0" ECU_ADDRESS 0x5B8E07 /end MEASUREMENT
/begin MEASUREMENT igokr_u "Integratorgradient f¸r Offsetkorrektur Klopfregelung (Byte)" SBYTE spgg_sb_b3052 1 100 -3052.01 3028.16 FORMAT "%5.0" ECU_ADDRESS 0x5B8E08 /end MEASUREMENT
/begin MEASUREMENT irspsyn "Index f¸r Ringspeicheradressierung tsegrsp_w, nmotrsp_w, rlrsp_w" UBYTE dez 1 100 0 255 FORMAT "%5.1" ECU_ADDRESS 0x5B8E2D /end MEASUREMENT
/begin MEASUREMENT irspsynold "Ein  Arbeitsspiel alter Index f¸r die Ringspeicheradressierung" UBYTE dez 1 100 0 255 FORMAT "%5.1" ECU_ADDRESS 0x5B8E2E /end MEASUREMENT
/begin MEASUREMENT kmstand "Fahrstrecke des Fahrzeugs als Information ¸ber CAN" UWORD km_uw_q10 1 100 0 655350 FORMAT "%8.1" ECU_ADDRESS 0x5B906C /end MEASUREMENT
/begin MEASUREMENT kocod "Automatische Variantenerkennung des Klimakompressors" UBYTE dez 1 100 0 255 FORMAT "%5.1" ECU_ADDRESS 0x3FD7EB /end MEASUREMENT
/begin MEASUREMENT kpe_error "Fehlerstatus aus Error Trace Buffer" UBYTE dez 1 100 0 255 FORMAT "%5.1" ECU_ADDRESS 0x5B869F /end MEASUREMENT
/begin MEASUREMENT lambrinv "invertiertes Lambda-Brennraum (rk/rl)" UBYTE fak_ub_b16 1 100 0 15.9375 FORMAT "%5.2" ECU_ADDRESS 0x5B8A99 /end MEASUREMENT
/begin MEASUREMENT lamsons_u "Lambda-Sollwert bezogen auf Einbauort Lambda-Sensor (1 Byte f¸r Tester)" UBYTE fak_ub_b16 1 100 0 15.9375 FORMAT "%5.2" ECU_ADDRESS 0x5B8E09 /end MEASUREMENT
/begin MEASUREMENT lb_nll "Anforderung Leerlaufdrehzahlerhˆhung" UBYTE B_TRUE 1 100 0 1 BIT_MASK 0x1 FORMAT "%13.11" ECU_ADDRESS 0x3FBC3E /end MEASUREMENT
/begin MEASUREMENT lb_usoll "Regelspannungsvorgabe f¸r Generator" UBYTE spg_q0p1_o10p6 1 100 10.6 36.1 FORMAT "%5.2" ECU_ADDRESS 0x5B8DF3 /end MEASUREMENT
/begin MEASUREMENT lws_w "Lenkwinkel" SWORD lws_q0p04375 1 100 -1433.6 1433.56 FORMAT "%8.3" ECU_ADDRESS 0x5B905A /end MEASUREMENT
/begin MEASUREMENT mdindegs_w "indiziertes Motormoment; R¸ckmeldung an Getriebesteuerung" UWORD rel_uw_b100 1 100 0 99.9985 FORMAT "%8.5" ECU_ADDRESS 0x5B940E /end MEASUREMENT
/begin MEASUREMENT mdindlm_w "indiziertes Motormoment; R¸ckmeldung an ASR" UWORD rel_uw_b100 1 100 0 99.9985 FORMAT "%8.5" ECU_ADDRESS 0x5B9410 /end MEASUREMENT
/begin MEASUREMENT mdkog "Momentenaufnahme geregelter Klimakompressor" UBYTE md_ub_q1 1 100 0 31 FORMAT "%5.2" ECU_ADDRESS 0x5B8DF4 /end MEASUREMENT
/begin MEASUREMENT mdwancan "Drehmomentaufnahme des Wandlers ¸ber CAN" UBYTE rel_ub_b99p6 1 100 0 99.6094 FORMAT "%5.2" ECU_ADDRESS 0x5B8DEE /end MEASUREMENT
/begin MEASUREMENT miasrl "ind. ASC-Moment f¸r Luftpfad" UBYTE rel_ub_b100 1 100 0 100 FORMAT "%5.1" ECU_ADDRESS 0x5B8DEA /end MEASUREMENT
/begin MEASUREMENT miasrl_w "Indiziertes Soll-Motormoment ASR f¸r langsamen Eingriff" UWORD rel_uw_b100 1 100 0 99.9985 FORMAT "%8.5" ECU_ADDRESS 0x5B905C /end MEASUREMENT
/begin MEASUREMENT miasrs "Indiziertes Soll-Motormoment ASR f¸r schnellen Eingriff" UBYTE rel_ub_b100 1 100 0 100 FORMAT "%5.1" ECU_ADDRESS 0x5B8DEB /end MEASUREMENT
/begin MEASUREMENT miasrs_w "Indiziertes Soll-Motormoment ASR f¸r schnellen Eingriff" UWORD rel_uw_b100 1 100 0 99.9985 FORMAT "%8.5" ECU_ADDRESS 0x5B905E /end MEASUREMENT
/begin MEASUREMENT migs_w "Indiziertes Soll-Motormoment GS f¸r schnellen Eingriff" UWORD rel_uw_b100 1 100 0 99.9985 FORMAT "%8.5" ECU_ADDRESS 0x5B906A /end MEASUREMENT
/begin MEASUREMENT miint1_w "Berechnetes Ist-Moment;interne Eingriffe mit AR, LLR, MDBEG" UWORD rel_uw_b100 1 100 0 99.9985 FORMAT "%8.5" ECU_ADDRESS 0x5B9412 /end MEASUREMENT
/begin MEASUREMENT miint2_w "Berechnetes Ist-Moment; Begrenzung auf mizwmn" UWORD rel_uw_b100 1 100 0 99.9985 FORMAT "%8.5" ECU_ADDRESS 0x5B9414 /end MEASUREMENT
/begin MEASUREMENT miint3_w "Berechnetes Ist-Moment; Begrenzung auf mibas, miszul" UWORD rel_uw_b100 1 100 0 99.9985 FORMAT "%8.5" ECU_ADDRESS 0x5B9416 /end MEASUREMENT
/begin MEASUREMENT miintegs_w "Berechnetes Ist-Moment Getriebe" UWORD rel_uw_b100 1 100 0 99.9985 FORMAT "%8.5" ECU_ADDRESS 0x5B9418 /end MEASUREMENT
/begin MEASUREMENT miintv_w "Berechnetes Ist-Moment;interne Eingriffe ohne AR, LLR, MDBEG" UWORD rel_uw_b100 1 100 0 99.9985 FORMAT "%8.5" ECU_ADDRESS 0x5B941A /end MEASUREMENT
/begin MEASUREMENT miint_w "Berechnetes Ist-Moment mit allen internen Eingriffen" UWORD rel_uw_b100 1 100 0 99.9985 FORMAT "%8.5" ECU_ADDRESS 0x5B941C /end MEASUREMENT
/begin MEASUREMENT miistc "indiziertes Motormoment Hochdruckphase Istwert f¸r Ausgabe auf CAN-Bus" UBYTE rel_ub_b100 1 100 0 100 FORMAT "%5.1" ECU_ADDRESS 0x5B8DE7 /end MEASUREMENT
/begin MEASUREMENT mimsr "Indiziertes Soll-Motormoment MSR" UBYTE rel_ub_b100 1 100 0 100 FORMAT "%5.1" ECU_ADDRESS 0x5B8DEC /end MEASUREMENT
/begin MEASUREMENT mimsr_w "Indiziertes Soll-Motormoment MSR" UWORD rel_uw_b100 1 100 0 99.9985 FORMAT "%8.5" ECU_ADDRESS 0x5B9054 /end MEASUREMENT
/begin MEASUREMENT ml "Luftmassenfluﬂ" UBYTE m_ub_b1020 1 100 0 1020 FORMAT "%5.0" ECU_ADDRESS 0x3FC026 /end MEASUREMENT
/begin MEASUREMENT mlbb "Luftmassenfluﬂ gefiltert (Byte), Bank1 bezogen" UBYTE m_ub_b1020 1 100 0 1020 FORMAT "%5.0" ECU_ADDRESS 0x5B8E4B /end MEASUREMENT
/begin MEASUREMENT mlbb_w "Luftmassenfluﬂ gefiltert (Word), Bank1 bezogen" UWORD m_uw_b6553p5 1 100 0 6553.5 FORMAT "%8.3" ECU_ADDRESS 0x5B90AE /end MEASUREMENT
/begin MEASUREMENT mlsolkori "rlvwvvti rueckwaerts aus Modell umgerechnet" UWORD m_uw_b1638p4 1 100 0 1638.38 FORMAT "%8.3" ECU_ADDRESS 0x5B95FC /end MEASUREMENT
/begin MEASUREMENT mlwdknshf "normierter Luftmassenstrom f¸r DK-Winkel aus HFM-Signal" UWORD m_uw_b6553p5 1 100 0 6553.5 FORMAT "%8.3" ECU_ADDRESS 0x5B95DC /end MEASUREMENT
/begin MEASUREMENT ml_w "Luftmassenfluﬂ gefiltert (Word)" UWORD m_uw_b6553p5 1 100 0 6553.5 FORMAT "%8.3" ECU_ADDRESS 0x3FC062 /end MEASUREMENT
/begin MEASUREMENT msabg "Abgasmassenfluﬂ gefiltert, Bank 1" UBYTE m_ub_b1020 1 100 0 1020 FORMAT "%5.0" ECU_ADDRESS 0x5B8E4C /end MEASUREMENT
/begin MEASUREMENT msabg_w "Abgasmassenstrom gefiltert (Word), Bank 1" UWORD m_uw_b6553p5 1 100 0 6553.5 FORMAT "%8.3" ECU_ADDRESS 0x5B90B0 /end MEASUREMENT
/begin MEASUREMENT msdif_w "Massenstromdifferenz mshfm_w - msdk_w" SWORD m_sw_q0p1 1 100 -3276.8 3276.7 FORMAT "%8.3" ECU_ADDRESS 0x5B9116 /end MEASUREMENT
/begin MEASUREMENT msdkalm_w "Massenstrom ¸ber Drosselklappe (abgeglichen mit HFM Signal)" UWORD m_uw_b6553p5 1 100 0 6553.5 FORMAT "%8.3" ECU_ADDRESS 0x5B9118 /end MEASUREMENT
/begin MEASUREMENT msdkroh_w "" UWORD m_uw_b6553p5 1 100 0 6553.5 FORMAT "%8.3" ECU_ADDRESS 0x5B911A /end MEASUREMENT
/begin MEASUREMENT msdk_w "Massenstrom ¸ber Drosselklappe (word)" UWORD m_uw_b6553p5 1 100 0 6553.5 FORMAT "%8.3" ECU_ADDRESS 0x5B911C /end MEASUREMENT
/begin MEASUREMENT mshfmad "Luftmassenstrom korrigert f¸r Berechnung DK-Winkel aus HFM-Signal" UWORD m_uw_b6553p5 1 100 0 6553.5 FORMAT "%8.3" ECU_ADDRESS 0x5B95DE /end MEASUREMENT
/begin MEASUREMENT mskorb_w "normierte Luftmasse aus Isthub incl. Massenstromabgleich" SWORD m_uw_b1638p4 1 100 -819.2 819.175 FORMAT "%8.4" ECU_ADDRESS 0x5B95FE /end MEASUREMENT
/begin MEASUREMENT msndko_w "normierter Leckluftmassenstrom ¸ber Drosselklappe (word)" SWORD m_uw_b6553p5 1 100 -3276.8 3276.7 FORMAT "%8.3" ECU_ADDRESS 0x3FDBE4 /end MEASUREMENT
/begin MEASUREMENT msndkpk_w "normierter praedizierter korrig. Massenstrom ueber Drosselklappe (word)" UWORD m_uw_b6553p5 1 100 0 6553.5 FORMAT "%8.3" ECU_ADDRESS 0x5B9182 /end MEASUREMENT
/begin MEASUREMENT msndk_w "normierter Massenstrom ¸ber Drosselklappe (word)" UWORD m_uw_b6553p5 1 100 0 6553.5 FORMAT "%8.3" ECU_ADDRESS 0x5B911E /end MEASUREMENT
/begin MEASUREMENT msntevo_w "normierter, ¸berkritischer Massenstrom durch das 100% offene TEV" UWORD m_uw_b25p6 1 100 0 25.5996 FORMAT "%8.5" ECU_ADDRESS 0x5B8A1E /end MEASUREMENT
/begin MEASUREMENT msnvvtoll "Massestrom von KIMSALL-Integrator + MSLG" SWORD m_uw_b6553p5 1 100 -3276.8 3276.7 FORMAT "%8.3" ECU_ADDRESS 0x3FDBE6 /end MEASUREMENT
/begin MEASUREMENT msnvvto_w "gelerner Massenstromoffset ungedrosselt" SWORD m_uw_b6553p5 1 100 -3276.8 3276.7 FORMAT "%8.3" ECU_ADDRESS 0x3FDBE8 /end MEASUREMENT
/begin MEASUREMENT msspkorr_w "" UWORD m_uw_b6553p5 1 100 0 6553.5 FORMAT "%8.3" ECU_ADDRESS 0x5B9600 /end MEASUREMENT
/begin MEASUREMENT mssppsp_w "Normierter Massenstrom ¸ber das Ventil der Saugstrahlpumpe" UWORD m_uw_b25p6 1 100 0 25.5996 FORMAT "%8.5" ECU_ADDRESS 0x5B9802 /end MEASUREMENT
/begin MEASUREMENT msspu_w "Ungefilterter Massenstrom ¸ber das Ventil der Saugstrahlpumpe" UWORD m_uw_b25p6 1 100 0 25.5996 FORMAT "%8.5" ECU_ADDRESS 0x5B9804 /end MEASUREMENT
/begin MEASUREMENT mssp_w "Massenstrom ¸ber das Ventil der Saugstrahlpumpe" UWORD m_uw_b25p6 1 100 0 25.5996 FORMAT "%8.5" ECU_ADDRESS 0x5B9806 /end MEASUREMENT
/begin MEASUREMENT mss_w "Massenstrom vom Sensor (Auswahl zwischen mshfm_w und ml_w)" UWORD m_uw_b6553p5 1 100 0 6553.5 FORMAT "%8.3" ECU_ADDRESS 0x5B9120 /end MEASUREMENT
/begin MEASUREMENT mste "Massenstrom Tankentl¸ftung ins Saugrohr" UBYTE m_ub_b25p6 1 100 0 25.5 FORMAT "%5.2" ECU_ADDRESS 0x3FC058 /end MEASUREMENT
/begin MEASUREMENT mstedp_w "Normierter Massenstrom durch das TEV mit Zeitverhalten" UWORD m_uw_b25p6 1 100 0 25.5996 FORMAT "%8.5" ECU_ADDRESS 0x5B944E /end MEASUREMENT
/begin MEASUREMENT mstedte "Massenstrom TEV f¸r DTEV" UBYTE m_ub_b25p6 1 100 0 25.5 FORMAT "%5.2" ECU_ADDRESS 0x5B8FE0 /end MEASUREMENT
/begin MEASUREMENT mstedte_w "Massenstrom TEV f¸r DTEV (Word)" UWORD m_uw_b25p6 1 100 0 25.5996 FORMAT "%8.5" ECU_ADDRESS 0x5B9450 /end MEASUREMENT
/begin MEASUREMENT msteo_w "Massenstom durch das 100% offene TEV" UWORD m_uw_b25p6 1 100 0 25.5996 FORMAT "%8.5" ECU_ADDRESS 0x5B9452 /end MEASUREMENT
/begin MEASUREMENT mste_w "Massenstrom Tankentl¸ftung in das Saugrohr" UWORD m_uw_b25p6 1 100 0 25.5996 FORMAT "%8.5" ECU_ADDRESS 0x5B9454 /end MEASUREMENT
/begin MEASUREMENT mszsst "" UBYTE dez 1 100 0 255 FORMAT "%5.1" ECU_ADDRESS 0x5B86D5 /end MEASUREMENT
/begin MEASUREMENT ngas_w "Drehzahlgradient ¸ber ein Arbeitsspiel" SWORD nmotg_sw_q0p39 1 100 -12800.2 12799.8 FORMAT "%8.2" ECU_ADDRESS 0x5B9074 /end MEASUREMENT
/begin MEASUREMENT ngfil "gefilterter Drehzahlgradient" SBYTE nmotg_sb_q100 1 100 -12800 12700 FORMAT "%5.0" ECU_ADDRESS 0x5B8E2F /end MEASUREMENT
/begin MEASUREMENT ngfil_w "gefilterter Drehzahlgradient" SWORD nmotg_sw_q0p39 1 100 -12800.2 12799.8 FORMAT "%8.2" ECU_ADDRESS 0x5B9076 /end MEASUREMENT
/begin MEASUREMENT ngsllm "Generatorleerlaufdrehzahl" UWORD ngen_uw_q0p5 1 100 0 32767.5 FORMAT "%8.2" ECU_ADDRESS 0x5B89A0 /end MEASUREMENT
/begin MEASUREMENT nmn10msctr "Z‰hler 10 ms Raster ohne Zahninterrupt" UBYTE dez 1 100 0 255 FORMAT "%5.1" ECU_ADDRESS 0x5B8C08 /end MEASUREMENT
/begin MEASUREMENT nmot "Motordrehzahl" UBYTE nmot_ub_q40 1 100 0 10000 FORMAT "%5.0" ECU_ADDRESS 0x5B8C05 /end MEASUREMENT
/begin MEASUREMENT nmotarr_w "Ringspeicher f¸r Drehzahlen" UWORD nmot_uw_q0p25 1 100 0 16383.8 FORMAT "%8.2" ARRAY_SIZE 6 ECU_ADDRESS 0x5B956E /end MEASUREMENT
/begin MEASUREMENT nmotas_w "Motordrehzahl von 2 Umdrehungen (1 Arbeitsspiel) zuvor" UWORD nmot_uw_q0p25 1 100 0 16383.8 FORMAT "%8.2" ECU_ADDRESS 0x5B9078 /end MEASUREMENT
/begin MEASUREMENT nmothi_w "" UWORD nmot_uw_q0p25 1 100 0 10000 FORMAT "%8.2" ECU_ADDRESS 0x5B9604 /end MEASUREMENT
/begin MEASUREMENT nmotll "Motordrehzahl im Leerlaufbereich" UBYTE nmot_ub_q10 1 100 0 2550 FORMAT "%5.0" ECU_ADDRESS 0x5B8C06 /end MEASUREMENT
/begin MEASUREMENT nmotllfil "Gefilterte Drehzahl nmotll" UBYTE nmot_ub_q10 1 100 0 2550 FORMAT "%5.0" ECU_ADDRESS 0x5B8C07 /end MEASUREMENT
/begin MEASUREMENT nmotlo_w "" UWORD nmot_uw_q0p25 1 100 0 10000 FORMAT "%8.2" ECU_ADDRESS 0x5B9606 /end MEASUREMENT
/begin MEASUREMENT nmot_f "Motordrehzahl" FLOAT32_IEEE fak_r32_1 1 100 0 10000 FORMAT "%43.37" ECU_ADDRESS 0x3FAA10 /end MEASUREMENT
/begin MEASUREMENT nmot_w "Motordrehzahl" UWORD nmot_uw_q0p25 1 100 0 10000 FORMAT "%8.2" ECU_ADDRESS 0x5B957C /end MEASUREMENT
/begin MEASUREMENT n_idlgspec "Drehzahl Leerlaufvorgabe (Anforderung Leerlauf-Solldrehzahl-Anhebung)" UBYTE dez 1 100 0 255 FORMAT "%5.1" ECU_ADDRESS 0x5B89A7 /end MEASUREMENT
/begin MEASUREMENT obdstegs "aus CAN-Signal OBD_STAT_GS aufbereitete Grˆﬂe f¸r ME" UBYTE dez 1 100 0 4 FORMAT "%5.3" ECU_ADDRESS 0x5B8DEF /end MEASUREMENT
/begin MEASUREMENT offakdps "" UWORD fak_uw_b025o32768 1 100 -0.125 0.124996 FORMAT "%9.7" ECU_ADDRESS 0x5B9456 /end MEASUREMENT
/begin MEASUREMENT pirgrohi "" UWORD p_uw_q0p039 1 100 0 2559.96 FORMAT "%8.3" ECU_ADDRESS 0x5B86DE /end MEASUREMENT
/begin MEASUREMENT pirgrolo "" UWORD p_uw_q0p039 1 100 0 2559.96 FORMAT "%8.3" ECU_ADDRESS 0x5B86E0 /end MEASUREMENT
/begin MEASUREMENT pirgro_w "Rohwert Partialdruck Restgas internes AGR" UWORD p_uw_q0p039 1 100 0 2559.96 FORMAT "%8.3" ECU_ADDRESS 0x5B86E2 /end MEASUREMENT
/begin MEASUREMENT pirg_w "Partialdruck Restgas interne AGR (16-Bit)" UWORD p_uw_q0p039 1 100 0 2559.96 FORMAT "%8.3" ECU_ADDRESS 0x5B9156 /end MEASUREMENT
/begin MEASUREMENT psbkv_w "benˆtigter Saugrohrdruck, falls nicht gen¸gend Unterdruck im Bremskraftverst." UWORD p_uw_q0p039 1 100 0 2559.96 FORMAT "%8.3" ECU_ADDRESS 0x5B94BA /end MEASUREMENT
/begin MEASUREMENT psfg_w "Frischgaspartialdruck im Saugrohr (word)" UWORD p_uw_q0p039 1 100 0 2559.96 FORMAT "%8.3" ECU_ADDRESS 0x5B9158 /end MEASUREMENT
/begin MEASUREMENT psmppvdk_w "praed. ps/Druck vor Drosselklappe (word)" UWORD fak_uw_q0p001 1 100 0 65.535 FORMAT "%8.5" ECU_ADDRESS 0x5B9184 /end MEASUREMENT
/begin MEASUREMENT psmp_w "extrapolierter Saugrohrdruck (Word)" UWORD p_uw_q0p039 1 100 0 2559.96 FORMAT "%8.3" ECU_ADDRESS 0x5B9186 /end MEASUREMENT
/begin MEASUREMENT psmxbkvg "geforderter max. Saugrohrdruck f¸r Bremsunterdruckspeicher" UBYTE p_ub_q10 1 100 0 2550 FORMAT "%5.0" ECU_ADDRESS 0x5B9031 /end MEASUREMENT
/begin MEASUREMENT psmxbkvg_w "geforderter max. Saugrohrdruck f¸r Bremsunterdruckspeicher" UWORD p_uw_q0p039 1 100 0 2559.96 FORMAT "%8.3" ECU_ADDRESS 0x5B94BC /end MEASUREMENT
/begin MEASUREMENT psmx_w "Saugrohrmaximaldruckbegrenzung f¸r modellierten Saugrohrdruck" UWORD p_uw_q0p039 1 100 0 2559.96 FORMAT "%8.3" ECU_ADDRESS 0x5B915A /end MEASUREMENT
/begin MEASUREMENT pspssp_w "Druckverh‰ltnis ¸ber Ventil Saugstrahlpumpe" UWORD fak_uw_b2 1 100 0 1.99997 FORMAT "%8.6" ECU_ADDRESS 0x5B9808 /end MEASUREMENT
/begin MEASUREMENT pspvdb_w "Quotient Saugrohrduck/Druck vor DK begrenzt (word)" UWORD fak_uw_b2 1 100 0 1.99997 FORMAT "%8.6" ECU_ADDRESS 0x5B9122 /end MEASUREMENT
/begin MEASUREMENT pspvdkugn_w "" UWORD fak_uw_b2 1 100 0 1.99997 FORMAT "%8.6" ECU_ADDRESS 0x5B9124 /end MEASUREMENT
/begin MEASUREMENT pspvdk_w "Quotient Saugrohrdruck/Druck vor Drosselklappe (word)" UWORD fak_uw_b2 1 100 0 1.99997 FORMAT "%8.6" ECU_ADDRESS 0x5B9126 /end MEASUREMENT
/begin MEASUREMENT psp_w "praedizierter Saugrohrdruck (Word)" UWORD p_uw_q0p039 1 100 0 2559.96 FORMAT "%8.3" ECU_ADDRESS 0x5B9188 /end MEASUREMENT
/begin MEASUREMENT psrlrohi "" UWORD rel_uw_b0p3 1 100 0 0.299995 FORMAT "%9.7" ECU_ADDRESS 0x5B86E4 /end MEASUREMENT
/begin MEASUREMENT psrlrolo "" UWORD rel_uw_b0p3 1 100 0 0.299995 FORMAT "%9.7" ECU_ADDRESS 0x5B86E6 /end MEASUREMENT
/begin MEASUREMENT psrlro_w "Rohwert f¸r Faktor systembezogene Umrechnung Druck auf F¸llung" UWORD rel_uw_b0p3 1 100 0 0.299995 FORMAT "%9.7" ECU_ADDRESS 0x5B86E8 /end MEASUREMENT
/begin MEASUREMENT ps_w "Saugrohr-Absolutdruck (Word)" UWORD p_uw_q0p039 1 100 0 2559.96 FORMAT "%8.3" ECU_ADDRESS 0x3FC064 /end MEASUREMENT
/begin MEASUREMENT pvdk "Druck vor Drosselklappe" UBYTE p_ub_q10 1 100 0 2550 FORMAT "%5.0" ECU_ADDRESS 0x5B8E7E /end MEASUREMENT
/begin MEASUREMENT pvdk_w "Druck vor Drosselklappe 16-Bit" UWORD p_uw_q0p039 1 100 0 2559.96 FORMAT "%8.3" ECU_ADDRESS 0x5B9128 /end MEASUREMENT
/begin MEASUREMENT Q_asc "Quittung ASR-Botschaft" UBYTE B_TRUE 1 100 0 1 BIT_MASK 0x1 FORMAT "%13.11" ECU_ADDRESS 0x3FBC24 /end MEASUREMENT
/begin MEASUREMENT rfagr_w "relative F¸llung AGR (word)" UWORD rel_uw_q0p0234 1 100 0 1535.98 FORMAT "%8.3" ECU_ADDRESS 0x5B915C /end MEASUREMENT
/begin MEASUREMENT rfges_w "gesamte relative F¸llung (inclusive AGR) 16-Bit" UWORD rel_uw_q0p0234 1 100 0 1535.98 FORMAT "%8.3" ECU_ADDRESS 0x5B915E /end MEASUREMENT
/begin MEASUREMENT rinh_u "Istwert (Byte) Innenwiderstand Ri-Nernstzelle der Lambdasonde hinter KAT" UBYTE r_ub_q64 1 100 0 16320 FORMAT "%5.0" ECU_ADDRESS 0x5B8E0A /end MEASUREMENT
/begin MEASUREMENT rinv_u "Istwert (Byte) Innenwiderstand Ri-Nernstzelle der Lambdasonde vor KAT" UBYTE r_ub_q64 1 100 0 16320 FORMAT "%5.0" ECU_ADDRESS 0x5B8E0B /end MEASUREMENT
/begin MEASUREMENT rkaco_w "Additive Korrektur der rel. Kraftstoffmasse f¸r LL-CO einstellen" SWORD rel_sw_b1536 1 100 -1536 1535.95 FORMAT "%8.3" ECU_ADDRESS 0x5B9196 /end MEASUREMENT
/begin MEASUREMENT rkrn_u "" UBYTE spg_q0p625 1 100 0 159.375 FORMAT "%5.1" ARRAY_SIZE 8 ECU_ADDRESS 0x5B8E0C /end MEASUREMENT
/begin MEASUREMENT rl "relative Luftf¸llung" UBYTE rel_ub_q0p75 1 100 0 191.25 FORMAT "%5.1" ECU_ADDRESS 0x3FC027 /end MEASUREMENT
/begin MEASUREMENT rldvs_w "relative Luftf¸llung durch Drosselventile am Saugrohr 16-Bit" UWORD rel_uw_q0p0234 1 100 0 1535.98 FORMAT "%8.3" ECU_ADDRESS 0x5B912A /end MEASUREMENT
/begin MEASUREMENT rlgas_w "F¸llungsgradient ¸ber ein Arbeitsspiel bestimmt" SWORD relNWU_q0p0234 1 100 -768 767.977 FORMAT "%8.4" ECU_ADDRESS 0x5B913A /end MEASUREMENT
/begin MEASUREMENT rlmp_w "rel. extrapolierte Luftfuellung (Word)" UWORD rel_uw_q0p0234 1 100 0 1535.98 FORMAT "%8.3" ECU_ADDRESS 0x5B918A /end MEASUREMENT
/begin MEASUREMENT rlp "rel. Luftf¸llung praediziert f¸r Einspritzberechnung" UBYTE rel_ub_q0p75 1 100 0 191.25 FORMAT "%5.1" ECU_ADDRESS 0x5B8E8F /end MEASUREMENT
/begin MEASUREMENT rlp_w "rel. Luftf¸llung praediziert f¸r Einspritzberechnung (Word)" UWORD rel_uw_q0p0234 1 100 0 1535.98 FORMAT "%8.3" ECU_ADDRESS 0x5B918C /end MEASUREMENT
/begin MEASUREMENT rlrohmp_w "rel. Luftf¸llung Saugrohrzufluss bei Saugrohrdruck psmp_w (Word)" UWORD rel_uw_q0p0234 1 100 0 1535.98 FORMAT "%8.3" ECU_ADDRESS 0x5B918E /end MEASUREMENT
/begin MEASUREMENT rlroh_w "relative Luftf¸llung: Rohwert vom Lastsensor (word)" UWORD rel_uw_q0p0234 1 100 0 1535.98 FORMAT "%8.3" ECU_ADDRESS 0x5B912C /end MEASUREMENT
/begin MEASUREMENT rlrsp_w "Beginn Ringspeicher relative F¸llung" UWORD rel_uw_q0p0234 1 100 0 1535.98 FORMAT "%8.3" ARRAY_SIZE 6 ECU_ADDRESS 0x5B913C /end MEASUREMENT
/begin MEASUREMENT rlvwvvti "rlvwvvt aus inversem F¸llungsmodell Ausgang von KFEHUBIV" UWORD rel_uw_q0p0234 1 100 0 1535.98 FORMAT "%8.3" ECU_ADDRESS 0x5B9602 /end MEASUREMENT
/begin MEASUREMENT rl_u "relative Luftf¸llung (Byte) f¸r Fehlerspeicher-Umwelten" UBYTE rel_ub_b100 1 100 0 100 FORMAT "%5.1" ECU_ADDRESS 0x5B8E14 /end MEASUREMENT
/begin MEASUREMENT rl_w "relative Luftf¸llung (Word)" UWORD rel_uw_q0p0234 1 100 0 1535.98 FORMAT "%8.3" ECU_ADDRESS 0x3FC066 /end MEASUREMENT
/begin MEASUREMENT rml "relative Luftmasse (calc. load value) nach SAE J1979" UBYTE rel_ub_b99p6 1 100 0 99.6094 FORMAT "%5.2" ECU_ADDRESS 0x5B86D6 /end MEASUREMENT
/begin MEASUREMENT slsstat "SLS-Status ¸ber CAN" UBYTE dez 1 100 0 255 FORMAT "%5.1" ECU_ADDRESS 0x5B8A90 /end MEASUREMENT
/begin MEASUREMENT srmarea "" UBYTE dez 1 100 0 255 FORMAT "%5.1" ECU_ADDRESS 0x5B86D9 /end MEASUREMENT
/begin MEASUREMENT startddisa "Flag: Diagnose starten" UBYTE dez 1 100 0 255 FORMAT "%5.1" ECU_ADDRESS 0x5B86A8 /end MEASUREMENT
/begin MEASUREMENT statetwslp "Status des Zustandsautomaten f¸r die Berechnung der SLP-Wicklungstemperatur" UBYTE dez 1 100 0 255 FORMAT "%5.1" ECU_ADDRESS 0x5B8A96 /end MEASUREMENT
/begin MEASUREMENT Stat_md_e "CAN-Signal: Status Momenteneingriff" UBYTE dez 1 100 0 255 FORMAT "%5.1" ECU_ADDRESS 0x5B8DE8 /end MEASUREMENT
/begin MEASUREMENT sta_ezherr "Status Fehlerart EZH-Diagnose" UBYTE dez 1 100 0 255 FORMAT "%5.1" ECU_ADDRESS 0x5B8DF0 /end MEASUREMENT
/begin MEASUREMENT stmlac "Anforderungsstufe E-L¸fter von Klimaanlage" UBYTE dez 1 100 0 15 FORMAT "%5.2" ECU_ADDRESS 0x5B8DF5 /end MEASUREMENT
/begin MEASUREMENT sttdnvvaus "" UBYTE dez 1 100 0 255 FORMAT "%5.1" ECU_ADDRESS 0x5B8E73 /end MEASUREMENT
/begin MEASUREMENT sttdnvvein "" UBYTE dez 1 100 0 255 FORMAT "%5.1" ECU_ADDRESS 0x5B8E74 /end MEASUREMENT
/begin MEASUREMENT synstate "Aktueller Synchronisierzustand" UBYTE dez 1 100 0 255 FORMAT "%5.1" ECU_ADDRESS 0x5B8C09 /end MEASUREMENT
/begin MEASUREMENT synstate_o "Sychronisationszustand des vorherigen Synchros" UBYTE dez 1 100 0 255 FORMAT "%5.1" ECU_ADDRESS 0x5B8C0A /end MEASUREMENT
/begin MEASUREMENT tabsmn_w "Abstellzeit aus relativem Minutenz‰hler" UWORD t1sxs_uw_q1 1 100 0 65535 FORMAT "%8.2" ECU_ADDRESS 0x5B8722 /end MEASUREMENT
/begin MEASUREMENT tabsnl_w "Abstellzeit aus SG-Nachlauf" UWORD t1sxs_uw_q1 1 100 0 65535 FORMAT "%8.2" ECU_ADDRESS 0x3FDC12 /end MEASUREMENT
/begin MEASUREMENT tabssc_w "Abstellzeit aus relativem Sekundenz‰hler" UWORD t1sxs_uw_q1 1 100 0 65535 FORMAT "%8.2" ECU_ADDRESS 0x5B8724 /end MEASUREMENT
/begin MEASUREMENT tabstm_w "Abstellzeit aus Abk¸hlung des Motors" UWORD t1sxs_uw_q1 1 100 0 65535 FORMAT "%8.2" ECU_ADDRESS 0x5B8726 /end MEASUREMENT
/begin MEASUREMENT tabst_u "Abstellzeit (Byte)" UBYTE t_q256 1 100 0 65280 FORMAT "%5.0" ECU_ADDRESS 0x5B8E15 /end MEASUREMENT
/begin MEASUREMENT tabst_w "Abstellzeit" UWORD t1sxs_uw_q1 1 100 0 65535 FORMAT "%8.2" ECU_ADDRESS 0x5B8728 /end MEASUREMENT
/begin MEASUREMENT tas_w "Zeit ¸ber ein Arbeitsspiel f¸r rlgas_w" UWORD t_q16us 1 100 0 1.04856e+006 FORMAT "%8.0" ECU_ADDRESS 0x5B9148 /end MEASUREMENT
/begin MEASUREMENT tdcas_ctr1 "Timer keine neue ASC1-Botschaft angekommen" UWORD t10msxs_uw_b655p35 1 100 0 655.35 FORMAT "%8.4" ECU_ADDRESS 0x5B9056 /end MEASUREMENT
/begin MEASUREMENT tdcas_ctr2 "" UWORD t10msxs_uw_b655p35 1 100 0 655.35 FORMAT "%8.4" ECU_ADDRESS 0x5B9058 /end MEASUREMENT
/begin MEASUREMENT tefreq "" UBYTE freq2000_ub 1 100 0 199.219 FORMAT "%5.1" ECU_ADDRESS 0x5B8FE1 /end MEASUREMENT
/begin MEASUREMENT tempin "Temperatur Eingang (Adressierung von FWFTBRTA)" UBYTE temp_ub_q0p75_o48 1 100 -48 143.25 FORMAT "%5.1" ECU_ADDRESS 0x5B86F0 /end MEASUREMENT
/begin MEASUREMENT tfst "Tankf¸llstand" UBYTE fuel_ub_q1 1 100 0 255 FORMAT "%5.1" ECU_ADDRESS 0x5B8DF6 /end MEASUREMENT
/begin MEASUREMENT tmnezh "Entprellz‰hler f¸r Fehler EZH ‹bertemperatur (STA_EZHERR = 1)" SBYTE dez 1 100 -128 127 FORMAT "%5.1" ECU_ADDRESS 0x3FD7E8 /end MEASUREMENT
/begin MEASUREMENT tmotfil "gefilterte Motortemperatur" UBYTE temp_ub_q0p75_o48 1 100 -48 143.25 FORMAT "%5.1" ECU_ADDRESS 0x3FDC0C /end MEASUREMENT
/begin MEASUREMENT tmot_u "Motor-Temperatur mit def. Quantisierung f¸r FSP-Umwelten" UBYTE temp_ub_q1_o40 1 100 -40 215 FORMAT "%5.1" ECU_ADDRESS 0x5B8E16 /end MEASUREMENT
/begin MEASUREMENT tnse_u "Zeit nach Startende Byte" UBYTE t25p6sxs_ub_b6528 1 100 0 6528 FORMAT "%5.0" ECU_ADDRESS 0x5B8E17 /end MEASUREMENT
/begin MEASUREMENT top_u "Operating time" UBYTE t1536minxmin_q1536 1 100 0 391680 FORMAT "%5.0" ECU_ADDRESS 0x5B8B91 /end MEASUREMENT
/begin MEASUREMENT tpsvkmf_u "gefilterter Periodendauerwert des Sondensignals vor Kat. (Byte)" UBYTE t10msxs_ub_b10p2 1 100 0 10.2 FORMAT "%5.2" ECU_ADDRESS 0x5B8E18 /end MEASUREMENT
/begin MEASUREMENT trefvvto "Referenztemperatur f¸r multilineare Regression" UWORD temp_ub_q0p75_o48 1 100 -48 49103.3 FORMAT "%8.2" ECU_ADDRESS 0x5B912E /end MEASUREMENT
/begin MEASUREMENT trminaus_w "Relative Zeit des Motorabstellens in Minuten" UWORD tmin_uw_q1 1 100 0 65535 FORMAT "%8.2" ECU_ADDRESS 0x3FDC14 /end MEASUREMENT
/begin MEASUREMENT trminein_w "Relative Zeit des Motorstarts in Minuten" UWORD tmin_uw_q1 1 100 0 65535 FORMAT "%8.2" ECU_ADDRESS 0x5B872A /end MEASUREMENT
/begin MEASUREMENT trmin_w "Relative Zeit in Minuten" UWORD tmin_uw_q1 1 100 0 65535 FORMAT "%8.2" ECU_ADDRESS 0x5B8502 /end MEASUREMENT
/begin MEASUREMENT tsast_l "Zeit ¸ber ein Arbeitsspiel genau" ULONG t_q0p0001_ms 1 100 0 429497 FORMAT "%13.6" ECU_ADDRESS 0x5B99D0 /end MEASUREMENT
/begin MEASUREMENT tsas_w "Zeit ¸ber ein Arbeitsspiel f¸r ngas_w" UWORD t_q0p04_ms 1 100 0 2621.4 FORMAT "%8.3" ECU_ADDRESS 0x5B957A /end MEASUREMENT
/begin MEASUREMENT tsegrsp_l "Array mit Segmentzeiten ¸ber das letzte Arbeitsspiel" ULONG t_q0p0001_ms 1 100 0 429497 FORMAT "%13.6" ARRAY_SIZE 6 ECU_ADDRESS 0x5B99D4 /end MEASUREMENT
/begin MEASUREMENT tsges_w "Saugrohrgesamttemperatur (nach AGR-Einleitung) (word)" SWORD temp_sw_q0p75 1 100 -24576 24575.3 FORMAT "%8.2" ECU_ADDRESS 0x5B86F4 /end MEASUREMENT
/begin MEASUREMENT tumgcan "Umgebungstemperatur empfangen von CAN-Kombiinstrument" SBYTE temp_q1 1 100 -128 127 FORMAT "%5.1" ECU_ADDRESS 0x5B8DF7 /end MEASUREMENT
/begin MEASUREMENT tumgslp "Umgebungstemperatur der SLP (Auswahl zwischen tmot und tumg)" UBYTE temp_ub_q0p75_o48 1 100 -48 143.25 FORMAT "%5.1" ECU_ADDRESS 0x5B8A97 /end MEASUREMENT
/begin MEASUREMENT tumta "Umgebungstemperatur aus Ansauglufttemperatur" UBYTE temp_ub_q0p75_o48 1 100 -48 143.25 FORMAT "%5.1" ECU_ADDRESS 0x3FDC11 /end MEASUREMENT
/begin MEASUREMENT tum_ein "Umgebungstemperatur f¸r Abstellzeitberechnung" UBYTE temp_ub_q0p75_o48 1 100 -48 143.25 FORMAT "%5.1" ECU_ADDRESS 0x5B8720 /end MEASUREMENT
/begin MEASUREMENT twslpst_w "berechnete Wicklungstemperatur der Sekund‰rluftpumpe bei Setzen von B_slp" UWORD temp_q0p0234_o273 1 100 -0.009375 65535 FORMAT "%8.2" ECU_ADDRESS 0x5B8A94 /end MEASUREMENT
/begin MEASUREMENT twslp_w "berechnete Wicklungstemperatur der Sekund‰rluftpumpe" UWORD temp_q0p0234_o273 1 100 -273.15 1262.83 FORMAT "%8.3" ECU_ADDRESS 0x3FDD06 /end MEASUREMENT
/begin MEASUREMENT udkp1a_u "Spannung Drosselklappen-Poti 1 am (unteren) Anschlag (Byte)" UBYTE spg_ub_b5 1 100 0 4.98047 FORMAT "%5.3" ECU_ADDRESS 0x5B8E19 /end MEASUREMENT
/begin MEASUREMENT udkp1_u "Spannung Drosselklappen-Poti 1 (Byte)" UBYTE spg_ub_b5 1 100 0 4.98047 FORMAT "%5.3" ECU_ADDRESS 0x5B8E1A /end MEASUREMENT
/begin MEASUREMENT udkp2_u "Spannung Drosselklappen-Poti 2 (Byte)" UBYTE spg_ub_b5 1 100 0 4.98047 FORMAT "%5.3" ECU_ADDRESS 0x5B8E1B /end MEASUREMENT
/begin MEASUREMENT ufgentmp2 "tempor‰rer Generatorspannungsollwert" UBYTE spg_ugen 1 100 10.6 36.1 FORMAT "%5.2" ECU_ADDRESS 0x5B89A8 /end MEASUREMENT
/begin MEASUREMENT umsrln_w "Umrechnungsfaktor F¸llung in Massenstrom" UWORD m_uw_q0p0005 1 100 0 32.7675 FORMAT "%8.5" ECU_ADDRESS 0x5B9130 /end MEASUREMENT
/begin MEASUREMENT upwg1_u "Spannung PWG-Poti 1 (Byte)" UBYTE spg_ub_b5 1 100 0 4.98047 FORMAT "%5.3" ECU_ADDRESS 0x5B8E1C /end MEASUREMENT
/begin MEASUREMENT upwg2d_u "Verdoppelte PWG-Poti-2-Spannung (Byte)" UBYTE spg_ub_b5 1 100 0 4.98047 FORMAT "%5.3" ECU_ADDRESS 0x5B8E1D /end MEASUREMENT
/begin MEASUREMENT upwg2_u "Spannung PWG-Poti 2 (Byte)" UBYTE spg_ub_b5 1 100 0 4.98047 FORMAT "%5.3" ECU_ADDRESS 0x5B8E1E /end MEASUREMENT
/begin MEASUREMENT uushk_u "ADC-Spannung Lambdasonde hinter Katalysator (Byte)" UBYTE spg_ub_b5 1 100 0 4.98047 FORMAT "%5.3" ECU_ADDRESS 0x5B8E1F /end MEASUREMENT
/begin MEASUREMENT uusvk_u "ADC-Spannung Lambdasonde vor Katalysator (Byte)" UBYTE spg_ub_b5 1 100 0 4.98047 FORMAT "%5.3" ECU_ADDRESS 0x5B8E20 /end MEASUREMENT
/begin MEASUREMENT vfgrrf_w "Referenz-Fahrzeuggeschwindigkeit f¸r FGR" UWORD vfzg_uw_b512 1 100 0 511.992 FORMAT "%8.4" ECU_ADDRESS 0x5B910A /end MEASUREMENT
/begin MEASUREMENT vfgr_w "Fahrzeug-Ist-Geschwindigkeit f¸r FGR" UWORD vfzg_uw_b512 1 100 0 511.992 FORMAT "%8.4" ECU_ADDRESS 0x5B910C /end MEASUREMENT
/begin MEASUREMENT vfzgv1_u "Umweltbedingung Fahrzeuggeschwindigkeit, CAN-Signal V 1" UBYTE vfzg_q1p0 1 100 0 255 FORMAT "%5.1" ECU_ADDRESS 0x5B8B92 /end MEASUREMENT
/begin MEASUREMENT vfzgv1_w "Fahrzeuggeschwindigkeit, CAN-Signal V1" UWORD vfzg_uw_b512 1 100 0 511.992 FORMAT "%8.4" ECU_ADDRESS 0x5B9060 /end MEASUREMENT
/begin MEASUREMENT vfzg_u "Fahrzeuggeschwindigkeit, mit def. Quantisierung f¸r Tester" UBYTE vfzg_q1p0 1 100 0 255 FORMAT "%5.1" ECU_ADDRESS 0x5B8E21 /end MEASUREMENT
/begin MEASUREMENT vfzv1f_w "Fahrzeuggeschwindigkeit, CAN-Signal V1 gefiltert" UWORD vfzg_uw_b512 1 100 0 511.992 FORMAT "%8.4" ECU_ADDRESS 0x5B910E /end MEASUREMENT
/begin MEASUREMENT Vnscnt "Fehlerz‰hler Vanos abgefallener Sensor NW/KW" UBYTE dez 1 100 0 255 FORMAT "%5.1" ARRAY_SIZE 4 ECU_ADDRESS 0x5B8CD8 /end MEASUREMENT
/begin MEASUREMENT Vnscnt2 "Fehlerz‰hler Vanos Istposition auﬂerhalb Fenster NW/KW" UBYTE dez 1 100 0 255 FORMAT "%5.1" ARRAY_SIZE 4 ECU_ADDRESS 0x5B8CDC /end MEASUREMENT
/begin MEASUREMENT Vnsdeltaub "Regelabweichung nach Filter" UWORD sprzi_q0p1 1 100 0 6553.5 FORMAT "%4.0" ARRAY_SIZE 4 ECU_ADDRESS 0x5B97B8 /end MEASUREMENT
/begin MEASUREMENT Vnserr "Fehlerstatus Vanos" UBYTE dez 1 100 0 255 FORMAT "%5.1" ARRAY_SIZE 4 ECU_ADDRESS 0x5B8CE0 /end MEASUREMENT
/begin MEASUREMENT Vnshaltetv "Haltetv Vanos" UWORD vnstv_q0p00305s32768 1 100 -100 99.9969 ARRAY_SIZE 4 ECU_ADDRESS 0x5B97C0 /end MEASUREMENT
/begin MEASUREMENT Vns_dad "" UBYTE dez 1 100 0 255 FORMAT "%5.1" ECU_ADDRESS 0x5B8A40 /end MEASUREMENT
/begin MEASUREMENT Vns_dst "" UBYTE dez 1 100 0 255 FORMAT "%5.1" ECU_ADDRESS 0x5B8A41 /end MEASUREMENT
/begin MEASUREMENT vrad_lh "Radgeschwindigkeit links hinten" UWORD vfzg_uw_q0p0625 1 100 0 4095.94 FORMAT "%8.3" ECU_ADDRESS 0x5B9062 /end MEASUREMENT
/begin MEASUREMENT vrad_lv "Radgeschwindigkeit links vorne" UWORD vfzg_uw_q0p0625 1 100 0 4095.94 FORMAT "%8.3" ECU_ADDRESS 0x5B9064 /end MEASUREMENT
/begin MEASUREMENT vrad_rh "Radgeschwindigkeit rechts hinten" UWORD vfzg_uw_q0p0625 1 100 0 4095.94 FORMAT "%8.3" ECU_ADDRESS 0x5B9066 /end MEASUREMENT
/begin MEASUREMENT vrad_rv "Radgeschwindigkeit rechts vorne" UWORD vfzg_uw_q0p0625 1 100 0 4095.94 FORMAT "%8.3" ECU_ADDRESS 0x5B9068 /end MEASUREMENT
/begin MEASUREMENT vregdia_w "Volumenstrom Tankentl¸ftungsventil: Wert f¸r Diagnose Tankdichtheit" UWORD vs_uw_b25p6 1 100 0 25.5996 FORMAT "%8.5" ECU_ADDRESS 0x5B9458 /end MEASUREMENT
/begin MEASUREMENT vssekp "EKP-Sollvolumenstrom" UBYTE fuel_ub_q1 1 100 0 255 FORMAT "%5.1" ECU_ADDRESS 0x5B8A9A /end MEASUREMENT
/begin MEASUREMENT vssgkrst "Kraftstoff-Sollvolumenstrom (Gesamtbedarf Motor + Saugstrahlpumpe)" UBYTE fuel_ub_q1 1 100 0 255 FORMAT "%5.1" ECU_ADDRESS 0x5B8A9B /end MEASUREMENT
/begin MEASUREMENT vsskrst "Kraftstoff-Sollvolumenstrom (Betriebspunktabh‰ngiger Bedarf)" UBYTE fuel_ub_q1 1 100 0 255 FORMAT "%5.1" ECU_ADDRESS 0x5B8A9C /end MEASUREMENT
/begin MEASUREMENT vsskrstl1 "Kraftstoff-Sollvolumenstrom f¸r Lambda=1" UBYTE fuel_ub_q1 1 100 0 255 FORMAT "%5.1" ECU_ADDRESS 0x5B8A9D /end MEASUREMENT
/begin MEASUREMENT vssssp "Kraftstoff-Sollvolumenstrom f¸r die Saugstrahlpumpe" UBYTE fuel_ub_q1 1 100 0 255 FORMAT "%5.1" ECU_ADDRESS 0x5B8A9E /end MEASUREMENT
/begin MEASUREMENT vssvlmx "Kraftstoff-Sollvolumenstrom bei Vollast" UBYTE fuel_ub_q1 1 100 0 255 FORMAT "%5.1" ECU_ADDRESS 0x5B8A9F /end MEASUREMENT
/begin MEASUREMENT vwkw "KW-Winkelgeschwindigkeit" UBYTE rel_ub_q0p1875 1 100 0 47.8125 FORMAT "%5.2" ECU_ADDRESS 0x5B8E90 /end MEASUREMENT
/begin MEASUREMENT wdkbab_w "wdkba_w begrenzt (Minimalauswahl zwischen wdkba_w und wdkugd_w)" SWORD relDK_q0p02441 1 100 -800 799.976 FORMAT "%8.4" ECU_ADDRESS 0x5B9132 /end MEASUREMENT
/begin MEASUREMENT wdkbapb_w "fuer Einspritzung praediz. begr. Drosselklappenwinkel (Word)" SWORD relDK_q0p02441 1 100 -800 799.976 FORMAT "%8.4" ECU_ADDRESS 0x5B9190 /end MEASUREMENT
/begin MEASUREMENT wdkbap_w "fuer Einspritzung praedizierter Drosselklappenwinkel (Word)" UWORD rel_uw_b100 1 100 0 99.9985 FORMAT "%8.5" ECU_ADDRESS 0x5B9192 /end MEASUREMENT
/begin MEASUREMENT wdkhfu_w " WK-Winkel  ber. aus Massenstrom d. Haupf¸llungssensors ungedrosselt" UWORD rel_uw_b100 1 100 0 99.9985 FORMAT "%8.5" ECU_ADDRESS 0x5B95E0 /end MEASUREMENT
/begin MEASUREMENT wdkhf_w "Berechneter Winkel der Drosselklappe aus dem Hauptf¸llungssignal" UWORD rel_uw_b100 1 100 0 99.9985 FORMAT "%8.5" ECU_ADDRESS 0x5B95E2 /end MEASUREMENT
/begin MEASUREMENT wdknlpr_u "" UBYTE relDK_ub_b100 1 100 0 100 FORMAT "%5.1" ECU_ADDRESS 0x5B8E22 /end MEASUREMENT
/begin MEASUREMENT wdknlp_u "DK-Winkel der Notluftposition (byte)" UBYTE relDK_ub_b100 1 100 0 100 FORMAT "%5.1" ECU_ADDRESS 0x5B8E23 /end MEASUREMENT
/begin MEASUREMENT wee "Winkel Einspritzende im Normalbetrieb" UBYTE zw_ub_q6 1 100 0 1530 FORMAT "%5.0" ECU_ADDRESS 0x5B8FF3 /end MEASUREMENT
/begin MEASUREMENT wnwi1_u "" SBYTE wkw_sb_b128 1 100 -128 127 FORMAT "%2.0" ECU_ADDRESS 0x5B8E24 /end MEASUREMENT
/begin MEASUREMENT wnwue "Winkel Nockenwellenueberschneidung" SBYTE kw_q1 1 100 -128 127 FORMAT "%5.1" ECU_ADDRESS 0x5B8A3F /end MEASUREMENT
/begin MEASUREMENT wnwue_w "Winkel Nockenwellenueberschneidung" UWORD kw_q1_o128 1 100 -128 65407 FORMAT "%8.2" ECU_ADDRESS 0x5B86EA /end MEASUREMENT
/begin MEASUREMENT wpr "Einspritzberechnungs-Praediktions-Winkel" UBYTE zw_ub_q6 1 100 0 1530 FORMAT "%5.0" ECU_ADDRESS 0x5B8E91 /end MEASUREMENT
/begin MEASUREMENT wprnsp "Einspritzberechnungs-Praediktions-Winkel bei Nachspritzer" UBYTE zw_ub_q6 1 100 0 1530 FORMAT "%5.0" ECU_ADDRESS 0x5B8E92 /end MEASUREMENT
/begin MEASUREMENT xqtm_w "Temperaturquotient" UWORD fak_uw_b16 1 100 0 15.9998 FORMAT "%8.5" ECU_ADDRESS 0x5B872C /end MEASUREMENT
/begin MEASUREMENT zkbgmsdk "Zeitkonstante Korrekturwerte GD Betrieb" UWORD fak_uw_b1 1 100 0 0.999985 FORMAT "%9.7" ECU_ADDRESS 0x5B9134 /end MEASUREMENT
/begin MEASUREMENT zkmsdk_w "" UWORD mk10ms_uw_q2p384e5n 1 100 0 15.6248 FORMAT "%8.5" ECU_ADDRESS 0x5B9136 /end MEASUREMENT
/begin MEASUREMENT zrph2_save "" ULONG dez 1 100 0 4.29497e+009 FORMAT "%13.2" ECU_ADDRESS 0x5B99EC /end MEASUREMENT
/begin MEASUREMENT zrph_save "" ULONG dez 1 100 0 4.29497e+009 FORMAT "%13.2" ECU_ADDRESS 0x5B99F0 /end MEASUREMENT
/begin MEASUREMENT zvtssp_w "" UWORD zk10msxs_uw_b655 1 100 0.0100002 655.36 FORMAT "%12.8" ECU_ADDRESS 0x5B980A /end MEASUREMENT
/begin MEASUREMENT zylvirt "Stand Zylinderz‰hler vor Umsynchronisation aus Schnellstart" UBYTE dez 1 100 0 255 FORMAT "%5.1" ECU_ADDRESS 0x5B8C0B /end MEASUREMENT
/begin FUNCTION BGKUPPL "BGKUPPL.  Berechnete Grˆﬂe Kupplungssignal" /begin DEF_CHARACTERISTIC CW_BGKUPPL NV NVGMN NVGMX NVO NVV TDNVAUS TDNVEIN /end DEF_CHARACTERISTIC /begin IN_MEASUREMENT B_stend ngfil_w nvquot_w vfzg /end IN_MEASUREMENT /begin OUT_MEASUREMENT B_kupplmod gangctr sttdnvvaus sttdnvvein /end OUT_MEASUREMENT /end FUNCTION
/begin FUNCTION BGLLGEN "BGLLGEN.  Berechnete Grˆﬂe Leerlaufdrehzahlanhebung Generator"
 /begin DEF_CHARACTERISTIC DFRUTYP IGENLLRANH KFDFIGEN0 KFDFIGEN1 KFDFIGEN2 KFDFIGEN3 KFDFIGEN4 KFDFIGEN5 KFDFIGEN6 KFDFIGEN7 LLRABS_DF LLRANH_DF NTWBGLLGEN PRELLDFAH PRELLDFRF /end DEF_CHARACTERISTIC
 /begin REF_CHARACTERISTIC GENUEBSETZ0 GENUEBSETZ1 GENUEBSETZ2 GENUEBSETZ3 GENUEBSETZ4 GENUEBSETZ5 GENUEBSETZ6 GENUEBSETZ7 KFIGENKA0 KFIGENKA1 KFIGENKA2 KFIGENKA3 KFIGENKA4 KFIGENKA5 KFIGENKA6 KFIGENKA7 KFIGENWA0 KFIGENWA1 KFIGENWA2 KFIGENWA3 KFIGENWA4 KFIGENWA5 KFIGENWA6 KFIGENWA7 /end REF_CHARACTERISTIC
 /begin IN_MEASUREMENT B_genfprl B_ll dffgen genawnumm gentempend nsllm st_i_gen ufgen /end IN_MEASUREMENT
 /begin OUT_MEASUREMENT B_hysllrah n_idlgspec /end OUT_MEASUREMENT
 /begin LOC_MEASUREMENT gendfvorhs genikaltmp genitemp2 igenrllrah ngsllm ufgentmp2 /end LOC_MEASUREMENT
/end FUNCTION
/begin FUNCTION BGMDLM "Berechnete Grˆﬂe Motormoment mit Momenteneingriffen" /begin REF_CHARACTERISTIC CWZWVMX /end REF_CHARACTERISTIC
 /begin IN_MEASUREMENT B_allzwe B_dash B_fil B_msr dmar_w dmllr_w dmrkt_w miasrs_w mibas_w mibgr_w miext_w mifa_w miist_w mims_w minmx_w miszul_w mivmx_w mizsol_w mizwmn_w redbas synchroCtr /end IN_MEASUREMENT
 /begin OUT_MEASUREMENT B_intzwv B_miext mdindegs_w mdindlm_w miint1_w miint2_w miint3_w miintegs_w miintv_w miint_w /end OUT_MEASUREMENT
 /begin LOC_MEASUREMENT etazabas /end LOC_MEASUREMENT
/end FUNCTION
/begin FUNCTION BGMSABG "Berechnung Abgasmassenstrom - bankabh‰ngig" /begin IN_MEASUREMENT ml ml_w msl /end IN_MEASUREMENT /begin OUT_MEASUREMENT mlbb mlbb_w msabg msabg_w /end OUT_MEASUREMENT /end FUNCTION
/begin FUNCTION BGMSSP "Berechnete Grˆﬂe Massenstrom f¸r Saugstrahlpumpe" /begin DEF_CHARACTERISTIC KFMSSPPSML TDSSPAV TDSSPEV ZVTSSPAV ZVTSSPEV /end DEF_CHARACTERISTIC /begin IN_MEASUREMENT B_bkvp ftvdkho_w ml_w ps_w pvdkds_w /end IN_MEASUREMENT /begin OUT_MEASUREMENT mssp_w /end OUT_MEASUREMENT /begin LOC_MEASUREMENT B_sspfini B_sspm mssppsp_w msspu_w pspssp_w zvtssp_w /end LOC_MEASUREMENT /end FUNCTION
/begin FUNCTION BGMSZS "Berechnungsgrˆﬂe Massenstrˆme zum Saugrohr"
 /begin DEF_CHARACTERISTIC BGMSDKDPS BGMSVVTDPS CW_DPSMSZS CW_NNMSZS DFKMSMN DFKMSMX DFKPVMN DFKPVMX DPSTDMN FKMSDKMN FKMSDKMX FKMSVVTMN FKMSVVTMX FKPVDKE FKPVDKMN FKPVDKMX FKPVVVTMN FKPVVVTMX HUBFMAON HUBFMAUN HUBMSON KFDKMS KFEHUBIV KFEHUBLLIV KFEHUBLLKI KFMSNVVT KFMSNWDK KFZKMSVT KIMSA KIMSALL KIMSALLVT KIMSAVT KIMSNLL KLMSNVTOM KLTDSTEND KLZKBGMSDK KUMSRL KVLAD LADFIL MLFKMSDK MSALLMN MSALLMX MSLG NMSNDKO NMSNVTO NRLMNIST PSPVDKUGN RLNOT S_HUBINST S_MSDKIST S_NNADAP TIMSA TIMSALL TIMSALLVT TIMSAON TIMSAVT TMFKMSDKA TMFKMSVTA VVTALLMN VVTALLMX VVTNLLMN VVTNLLMX WDKFMAON WDKFMAUN WDKMSON WDKMSONTD ZKMSDK ZKMSDKTD /end DEF_CHARACTERISTIC
 /begin REF_CHARACTERISTIC KLAF KLDPIPOL KLDPSDKM MSNLG /end REF_CHARACTERISTIC
 /begin IN_MEASUREMENT B_clradmsz B_ehfm B_gd B_gdst B_hfm B_ll B_llk B_llrein B_lltd B_nmot B_pwf B_rlh B_stend B_vl B_vvtnotl dpsfak dpssol_uw dpssol_w dps_w evhubi2_w evhubi_w evhubs_w fho fhubvnsi_w fhubwll_au fpups_w fpvdkds_w ftvdk ml_w mshfm_w msnvvtdnn msnvvtonn mssp_w mste m_tol nmot nmot_w ps_w pu_w pvdkds_w rlvugd rlvw_w tmot tmst toel_w Vse_spri Vse_sprn Vse_sprs wdkba wdkba_w wdkugd_w /end IN_MEASUREMENT
 /begin OUT_MEASUREMENT B_bgmsdk B_bgmszs B_bgmszsi B_dpsmod B_dslvh B_dssv B_fkmsmn B_fkmsmx B_fkpvmn B_fkpvmx B_hfmv B_timsa B_timsall B_timsallv B_timsavvt B_timsvvt dpsbgms_w dpsvbgms_w evhubin2_w evhubin_w fkmsdka_w fkmsdks_w fkmsdk_w fkmsvvta_w fkmsvvts_w fkmsvvt_w fpvdk fpvdk_w frhodk_w mlsolkori msdif_w msdkalm_w msdkroh_w msdk_w mskorb_w msndko_w msndk_w msnvvtoll msnvvto_w mss_w mszsst pspvdb_w pspvdkugn_w pspvdk_w pvdk pvdk_w rldvs_w rlroh_w rlvwvvti trefvvto umsrln_w wdkbab_w zkbgmsdk zkmsdk_w /end OUT_MEASUREMENT
 /begin LOC_MEASUREMENT dkmsmszs dpipolmszs dpipol_aus dpipol_in drllad_w msspkorr_w /end LOC_MEASUREMENT
/end FUNCTION
/begin FUNCTION BGNG "Berechnete Grˆﬂe Drehzahlgradient" /begin DEF_CHARACTERISTIC ZNGFIL /end DEF_CHARACTERISTIC /begin IN_MEASUREMENT inisynmon nmot_w tseg_l /end IN_MEASUREMENT
 /begin OUT_MEASUREMENT B_ngasok dnmotas_w dnmot_w irspsyn ngas_w ngfil ngfil_w tsegrsp_l /end OUT_MEASUREMENT
 /begin LOC_MEASUREMENT irspsynold nmotarr_w nmotas_w tsast_l tsas_w /end LOC_MEASUREMENT
/end FUNCTION
/begin FUNCTION bgnmot "bgnmot.   Berechnete Grˆﬂe Drehzahl" /begin IN_MEASUREMENT B_nmin synstate tseg_l /end IN_MEASUREMENT /begin OUT_MEASUREMENT nmot nmotll nmotllfil nmot_f nmot_w /end OUT_MEASUREMENT /end FUNCTION
/begin FUNCTION BGRBS "Berechnete Grˆﬂe Radbeschleunigung aus Raddrehzahl" /begin DEF_CHARACTERISTIC TMVDBS VASRM VBSMX /end DEF_CHARACTERISTIC /begin IN_MEASUREMENT B_asc2cok B_cdswe vfzg vrad_lh vrad_lv vrad_rh vrad_rv /end IN_MEASUREMENT /begin OUT_MEASUREMENT bsc dv_lh dv_lv dv_rh dv_rv /end OUT_MEASUREMENT /end FUNCTION
/begin FUNCTION BGRLG "Berechnete Grˆﬂe RL-GRADIENT" /begin IN_MEASUREMENT B_ngasok irspsyn rl_w tsegrsp_l /end IN_MEASUREMENT /begin OUT_MEASUREMENT drlas_w rlgas_w /end OUT_MEASUREMENT /begin LOC_MEASUREMENT rlrsp_w tas_w /end LOC_MEASUREMENT /end FUNCTION
/begin FUNCTION BGRLP "Berechnungsgrˆﬂe rlp pr‰dizierte Luftf¸llung" /begin DEF_CHARACTERISTIC CBGRLP DRLDYNU DTEPRU TNSURLP /end DEF_CHARACTERISTIC /begin REF_CHARACTERISTIC KFMSNWDK KLAF PSPVDKUGN /end REF_CHARACTERISTIC
 /begin IN_MEASUREMENT B_ll B_nswo2 B_st B_stend dpsfg_w drl_w frhodk_w fupsrl_w fvisrm_w msndko_w mste nmot nmot_w pirg_w psmx_w pspvdkugn_w ps_w pvdk_w rfagr_w rfges_w rldvs_w rl_w te_w tvu_w umsrln_w wdkbap_w wdkugd_w wea wee wes /end IN_MEASUREMENT
 /begin OUT_MEASUREMENT B_nsp B_tired drlp_w rlp rlp_w /end OUT_MEASUREMENT
 /begin LOC_MEASUREMENT B_rlp B_rlpns dpsdvs_w dpsmp_w fwprs_w msndkpk_w psmppvdk_w psmp_w psp_w rlmp_w rlrohmp_w vwkw wdkbapb_w wpr wprnsp /end LOC_MEASUREMENT
/end FUNCTION
/begin FUNCTION BGRML "Berechnungsgrˆﬂe relative Luftmasse nach SAE J1979 Mode $01 + $02 PID $04" /begin DEF_CHARACTERISTIC MLMAX /end DEF_CHARACTERISTIC /begin IN_MEASUREMENT fpvdk_w ml_w /end IN_MEASUREMENT /begin OUT_MEASUREMENT rml /end OUT_MEASUREMENT /end FUNCTION
/begin FUNCTION BGSRM "F¸llungserfassung Saugrohrmodell"
 /begin DEF_CHARACTERISTIC CW_RLCAL FPVMXN FPVMXN2 FRSTSUAREA KFPRG00 KFPRG01 KFPRG02 KFPRG03 KFPRG04 KFPRG05 KFPRG06 KFPRG07 KFPRG08 KFPRG09 KFPRG10 KFPRG11 KFPRG12 KFPRG13 KFPRG14 KFPRG15 KFPRGSUL KFSRMAREA KFURL00 KFURL01 KFURL02 KFURL03 KFURL04 KFURL05 KFURL06 KFURL07 KFURL08 KFURL09 KFURL10 KFURL11 KFURL12 KFURL13 KFURL14 KFURL15 KFURLSUL KISRM KISRMSU SRMAREANM S_DISAVORH ZVTPRGSU /end DEF_CHARACTERISTIC
 /begin REF_CHARACTERISTIC SVA07FEUW SVE07FEUW /end REF_CHARACTERISTIC
 /begin IN_MEASUREMENT B_hfm B_psger B_su dps_w esst_sva07feuw esst_sve07feuw fho_w ftbr_w ftsr nmot_w psagr_w pu_w pvdkds_w rlroh_w sumode umsrln_w Vsa_spri Vse_spri wnwue /end IN_MEASUREMENT
 /begin OUT_MEASUREMENT agrr agrr_w dpsfg_w drl_w fupsrl_w fvisrm_w iegr_w ml ml_w pirg_w psfg_w psmx_w ps_w rfagr_w rfges_w rl rl_w /end OUT_MEASUREMENT
 /begin LOC_MEASUREMENT B_suini disa_pos fnnm_w hilo nmothi_w nmotlo_w pirgrohi pirgrolo pirgro_w psrlrohi psrlrolo psrlro_w srmarea wnwue_w /end LOC_MEASUREMENT
/end FUNCTION
/begin FUNCTION BGSTDSLS "Berechnete Grˆﬂe; Status Diagnose Sekund‰rluftsystem bei Systemtest" /begin IN_MEASUREMENT B_dslfa B_dslm B_dslo B_dsls B_fasla B_fasls B_szsls /end IN_MEASUREMENT /begin OUT_MEASUREMENT slsstat /end OUT_MEASUREMENT /end FUNCTION
/begin FUNCTION BGTABST "Berechnete Grˆﬂe Abstellzeit"
 /begin DEF_CHARACTERISTIC DTABUNPL DTUMTA IMTUMTA LNXQTM NTUMTA TNLSGM TPLUHRC TPLUHRR TUMTAI VTUMTA ZKTABTU /end DEF_CHARACTERISTIC
 /begin IN_MEASUREMENT B_abstnl B_etum B_ins2cok B_ins3cok B_nlwst B_nmin B_pwf B_stend B_tfu B_uhrrmin B_uhrrsec B_vbemg imlatm nmot swOffDlBits tans tmotab tmst tnst_w trmin_w tumg vfzg /end IN_MEASUREMENT
 /begin OUT_MEASUREMENT tabst_w /end OUT_MEASUREMENT
 /begin LOC_MEASUREMENT BgtabstNvBits B_pltab B_tabunpl B_uhrrnpl tabsmn_w tabsnl_w tabssc_w tabstm_w trminaus_w trminein_w tumta tum_ein xqtm_w /end LOC_MEASUREMENT
/end FUNCTION
/begin FUNCTION BGTEMPK "F¸llungserfassung Berechnung Temperaturkompensation"
 /begin DEF_CHARACTERISTIC CWTEMPK DEVTMAGR EVTMODO FDVANS FWFTBRTA KFFWTBR ZBRT ZTDAGR ZTMMBR /end DEF_CHARACTERISTIC
 /begin IN_MEASUREMENT B_nmot nmot rl tans tmot /end IN_MEASUREMENT
 /begin OUT_MEASUREMENT evtmod ftbr ftbr_w ftsr ftu ftvdk ftw /end OUT_MEASUREMENT
 /begin LOC_MEASUREMENT tempin tmotfil tsges_w /end LOC_MEASUREMENT
/end FUNCTION
/begin FUNCTION BGTEV "Berechnungsgrˆﬂe Massenstrom TEV" /begin DEF_CHARACTERISTIC FMTEVEIN FUMRMV KFMTEDPML /end DEF_CHARACTERISTIC /begin REF_CHARACTERISTIC CWTEACFG /end REF_CHARACTERISTIC
 /begin IN_MEASUREMENT B_dteaa dpssol_w dps_w fho_w ftvdk ftvdkho_w ml_w ps_w pu_w tevper ttevein /end IN_MEASUREMENT
 /begin OUT_MEASUREMENT dps_uw msntevo_w mste mstedte mstedte_w msteo_w mste_w tefreq vregdia_w /end OUT_MEASUREMENT
 /begin LOC_MEASUREMENT fmtate_w fmtev_w mstedp_w offakdps /end LOC_MEASUREMENT
/end FUNCTION
/begin FUNCTION BGTWSLP "Berechnete Grˆﬂen f¸r Temperatur der SLP-Wicklung"
 /begin DEF_CHARACTERISTIC ABKTWSLP FWTMTU KFTWSLP TDENDAUFH TWSLPPWF ZKABKTWSLP ZKTWSLPUB /end DEF_CHARACTERISTIC
 /begin IN_MEASUREMENT B_eemrdy B_eepwf B_slp B_stend tabst_w tmot tumg ubsqf_w ub_w /end IN_MEASUREMENT
 /begin OUT_MEASUREMENT statetwslp twslp_w /end OUT_MEASUREMENT
 /begin LOC_MEASUREMENT B_endaufh dtwslpum_w tumgslp twslpst_w /end LOC_MEASUREMENT
/end FUNCTION
/begin FUNCTION BGVFGR "Berechnete Geschwindigkeit f¸r Fahrgeschwindigkeitsregler" /begin DEF_CHARACTERISTIC ZFMVRV /end DEF_CHARACTERISTIC /begin IN_MEASUREMENT B_asc1cok B_evfzgv1 vfzgv1_w vfzg_w /end IN_MEASUREMENT /begin OUT_MEASUREMENT bfzglfgr B_fgrabz vfgrrf_w vfgr_w /end OUT_MEASUREMENT /begin LOC_MEASUREMENT vfzv1f_w /end LOC_MEASUREMENT /end FUNCTION
/begin FUNCTION BGVSEKP "Berechnete Grˆﬂe Kraftstoff-Sollvolumenstrom f¸r bedarfsgesteuerte EKP" /begin DEF_CHARACTERISTIC FMLZKRST KFSTTANKR VSEKPMXN VSSSPE VSSSPTAIRL /end DEF_CHARACTERISTIC
 /begin IN_MEASUREMENT B_bt B_btekp B_ekp B_ekpet B_ins2cok fsttankl ml_w nmot rk_w rlp_w tfst /end IN_MEASUREMENT
 /begin OUT_MEASUREMENT lambrinv vssekp vssgkrst vsskrst vsskrstl1 vssssp vssvlmx /end OUT_MEASUREMENT
 /begin LOC_MEASUREMENT B_fstpl fsttankrf /end LOC_MEASUREMENT
/end FUNCTION
/begin FUNCTION BGWDKHF "BGWDKHF.  Berechnung Winkel Drosselklappe aus Signal d. Hauptf¸llungssensors" /begin DEF_CHARACTERISTIC BGWDKDPSGR /end DEF_CHARACTERISTIC /begin REF_CHARACTERISTIC KFWDKDPS KFWDKMSN KLAF KLDPIPOL KLDPSDKM MSNLG /end REF_CHARACTERISTIC
 /begin IN_MEASUREMENT B_vl dpssol_w ftvdkho_w mshfm_w nmot_w pvdkds_w wdks_w wdkugd_w /end IN_MEASUREMENT
 /begin OUT_MEASUREMENT B_wdkhfu wdkhf_w /end OUT_MEASUREMENT
 /begin LOC_MEASUREMENT dpipowdkhf dpwdkhf_in dpwdkhf_w mlwdknshf mshfmad wdkhfu_w /end LOC_MEASUREMENT
/end FUNCTION
/begin FUNCTION BGWDKM "Berechnung Dk-Winkel Modell" /begin DEF_CHARACTERISTIC ZWDKM1 ZWDKM2 /end DEF_CHARACTERISTIC /begin IN_MEASUREMENT wdksp_w /end IN_MEASUREMENT /begin OUT_MEASUREMENT wdkbap_w /end OUT_MEASUREMENT /end FUNCTION
/begin FUNCTION BGWNE "Berechnete Basis-Grˆﬂen f¸r Winkel- und Drehzahlerfassung" /begin REF_CHARACTERISTIC NMIN TPREL /end REF_CHARACTERISTIC
 /begin IN_MEASUREMENT B_bm B_stprel B_tprel B_zprel sync_level tseg_l zzkwas_w zzvirt zzyl /end IN_MEASUREMENT
 /begin OUT_MEASUREMENT B_nmin B_nmot B_startini nmn10msctr synstate synstate_o zylvirt /end OUT_MEASUREMENT
/end FUNCTION
/begin FUNCTION BKV "Drucksteuerung f¸r Bremskraftverst‰rker"
 /begin DEF_CHARACTERISTIC CWBKV DPBKVSPS DPBKVUKKPU DPBKVUKNKH DPBKVUKNW DPBKVUKP DPBKVUKPU DPBKVUS KFKOMABNPU MRFAMXKAHY OPBKVUKKB OPBKVUKNKH OPBKVUKNWB OPBKVUKPB OPBKVUKPUB PBKVKREHY PBKVKRHY TDBKVKOMAB TDBKVNKHAB TDBKVNWAB TDBKVP TDBKVSTED TDPBKVMN TDPBKVMNP TEBKVNKHA TEBKVNWAB TEPBKVMN TEPPBKV /end DEF_CHARACTERISTIC
 /begin IN_MEASUREMENT B_bkvp B_brems B_cdbkvp B_kh B_ll dpbkvu_w fho_w mrfa_w nmot_w psspbkv_w ps_w pubkv_w tnst_w /end IN_MEASUREMENT
 /begin OUT_MEASUREMENT B_bkvagrab B_bkvdkhab B_bkvkomab B_bkvleer B_bkvnkhab B_bkvnwab B_bkvpa dpbkvukp_w psmxbkvg psmxbkvg_w /end OUT_MEASUREMENT
 /begin LOC_MEASUREMENT BKVlokbits0 B_bkvkoma B_bkvnkha B_bkvnwum B_pbkvmn B_pbkvmnp dpbkvukb_w dpbkvukh_w dpbkvukk_w dpbkvukr_w dpbkvuk_w dpbkvunw_w dpbukkb_w dpbukk_w dpbuknkh_w dpbuknwb_w dpbuknw_w dpbukpb_w dpbukp_w dpbunkhb_w psbkv_w /end LOC_MEASUREMENT
/end FUNCTION
/begin FUNCTION CANASR "CAN-Botschafts- und Signaldefinition Antriebsschlupfregelung" /begin DEF_CHARACTERISTIC DMAUFASC /end DEF_CHARACTERISTIC /begin REF_CHARACTERISTIC TDCAS /end REF_CHARACTERISTIC /begin IN_MEASUREMENT B_clvar B_msr B_pwf tdcas_ctr1 /end IN_MEASUREMENT
 /begin OUT_MEASUREMENT asc_alive B_asc1cok B_asc1new B_asc2cok B_asc2new B_asc3cok B_asc3new B_ascpkw B_asc_reg B_asrext B_asrextmem B_dsc_reg B_evfzgv1 B_msrext miasrl miasrl_w miasrs miasrs_w mimsr Q_asc vfzgv1_w vrad_lh vrad_lv vrad_rh vrad_rv /end OUT_MEASUREMENT
 /begin LOC_MEASUREMENT asccod /end LOC_MEASUREMENT
/end FUNCTION
/begin FUNCTION CANDME "DME CAN-Botschafts- und Signaldefinitionen" /begin DEF_CHARACTERISTIC MDNORM TVFGRAT TVFGRSE TVMFLA /end DEF_CHARACTERISTIC
 /begin IN_MEASUREMENT batt_anz B_accdme B_ascdme B_brems B_epcl B_falls B_fgrat B_fgrhe B_fgrtbe B_fgrtve B_fgrtwa B_i_ska_fr B_i_ska_um B_kd B_kl15 B_kl61 B_koe B_kuppl B_mil B_nivns B_nmot B_oelverb B_oelverl B_sa B_tankd B_togerr B_togupl B_uetmc ehz_pw etazaist fgr_stat gen_htar gen_last i_dmesys kvaverbr L_fgr L_p_oil L_tp_sw mdindlm_w mdverl_w miist_w mivbeg_w nmot_w obdsteuer pu synchroCtr S_eza S_kl30h S_shl S_wl tmot tmot_kalt tp_sw vssekp wped wpfgr_w w_fpdk_mod zwout zwspae /end IN_MEASUREMENT
 /begin OUT_MEASUREMENT B_oldmiistc miistc Stat_md_e /end OUT_MEASUREMENT
/end FUNCTION
/begin FUNCTION CANEGS "CAN-Botschafts- und Signaldefinition Getriebesteuerung" /begin IN_MEASUREMENT B_clvar B_pwf /end IN_MEASUREMENT
 /begin OUT_MEASUREMENT B_autget B_egscok B_egsnew B_fs B_got B_gts B_pn B_wk B_wkr gangauti mdwancan migs_w obdstegs /end OUT_MEASUREMENT
 /begin LOC_MEASUREMENT egscod /end LOC_MEASUREMENT
/end FUNCTION
/begin FUNCTION CANEZH "EZH CAN-Botschafts- und Signaldefinitionen" /begin DEF_CHARACTERISTIC TMNEZH_MX /end DEF_CHARACTERISTIC /begin IN_MEASUREMENT B_pwf /end IN_MEASUREMENT /begin OUT_MEASUREMENT B_azh B_ezh B_ezhcok B_ezhnew /end OUT_MEASUREMENT /begin LOC_MEASUREMENT B_diag_ezh B_ezherrst ezhcod sta_ezherr tmnezh /end LOC_MEASUREMENT /end FUNCTION
/begin FUNCTION CANINS "CAN-Botschafts- und Signaldefinition Kombiinstrument" /begin DEF_CHARACTERISTIC STM_ERR /end DEF_CHARACTERISTIC /begin IN_MEASUREMENT B_clvar B_pwf /end IN_MEASUREMENT
 /begin OUT_MEASUREMENT B_ac B_fstcanok B_hzl B_ins2cok B_ins2new B_ins3cok B_ins3new B_ko B_kovar B_ntkw B_talcan B_tns CANINSbits ekpausc fsttankl kmstand kocod lb_nll lb_usoll mdkog stmlac tfst trmin_w tumgcan /end OUT_MEASUREMENT
/end FUNCTION
/begin FUNCTION CANLWS "CAN-Botschaft- und Signaldefinition Lenkradwinkelsensor" /begin OUT_MEASUREMENT B_lwscok B_lwsnew lws_w /end OUT_MEASUREMENT /end FUNCTION
/begin FUNCTION CAN_CONF "" /end FUNCTION
/begin FUNCTION CCP "‹bertragungsprotokoll f¸r Applikationstools" /begin DEF_CHARACTERISTIC CW_CCPAKTIV /end DEF_CHARACTERISTIC /end FUNCTION
/begin FUNCTION CCP_CONF "" /end FUNCTION
/begin FUNCTION COSA "Software-Abgleich" /begin DEF_CHARACTERISTIC RKACOMN RKACOMX TLLCO TVCO /end DEF_CHARACTERISTIC /begin REF_CHARACTERISTIC N0 NRKAB /end REF_CHARACTERISTIC /begin IN_MEASUREMENT B_eepdif B_ll B_nokatfz nmot tmot /end IN_MEASUREMENT /begin OUT_MEASUREMENT B_cotrim co_pot rkaco_w /end OUT_MEASUREMENT /begin LOC_MEASUREMENT co_pot_w /end LOC_MEASUREMENT /end FUNCTION
/begin FUNCTION CVO "CVO.      Berechnung Ventil¸berschneidungswinkel" /begin DEF_CHARACTERISTIC NASPR /end DEF_CHARACTERISTIC /begin REF_CHARACTERISTIC WESNESPR /end REF_CHARACTERISTIC /begin IN_MEASUREMENT evhubs_w Vsa_spri Vse_spri wvesp /end IN_MEASUREMENT /begin OUT_MEASUREMENT wee wnwue /end OUT_MEASUREMENT /end FUNCTION
/begin FUNCTION DASC "Diagnose ASC-Signale" /begin DEF_CHARACTERISTIC CWDASC MIMSRMXN TASCNP TASCNP2 /end DEF_CHARACTERISTIC /begin REF_CHARACTERISTIC BZ_MSR_M /end REF_CHARACTERISTIC
 /begin IN_MEASUREMENT asc_alive B_asrext B_fgdcan B_msrext B_nomsr_um miasrl miasrs mimsr nmot_w /end IN_MEASUREMENT
 /begin OUT_MEASUREMENT B_ascdme B_ascsipl mimsr_w /end OUT_MEASUREMENT
/end FUNCTION
/begin FUNCTION DBKVPE "Endstufendiagnose Bremskraftverst‰rker-Pumpe" /begin DEF_CHARACTERISTIC CWPSBKVPE /end DEF_CHARACTERISTIC /begin REF_CHARACTERISTIC TVP /end REF_CHARACTERISTIC /begin IN_MEASUREMENT B_bkvp B_desee /end IN_MEASUREMENT /begin SUB_FUNCTION DFPM_DBKVPE /end SUB_FUNCTION /end FUNCTION
/begin FUNCTION DCANA "Diagnose CAN A" /begin DEF_CHARACTERISTIC TDCANA1 TDCANA3 TDCANAH /end DEF_CHARACTERISTIC /begin IN_MEASUREMENT B_fgdcan /end IN_MEASUREMENT /begin OUT_MEASUREMENT B_edprcana canastat canastati /end OUT_MEASUREMENT /end FUNCTION
/begin FUNCTION DCAS "Diagnose; CAN-Timeout ASC-Schnittstelle" /begin DEF_CHARACTERISTIC TDCAS /end DEF_CHARACTERISTIC /begin REF_CHARACTERISTIC UBDCAN /end REF_CHARACTERISTIC /begin IN_MEASUREMENT B_asc1new B_asc2new B_ascpkw B_nmot ub /end IN_MEASUREMENT /begin OUT_MEASUREMENT tdcas_ctr1 tdcas_ctr2 /end OUT_MEASUREMENT /end FUNCTION
/begin FUNCTION DCDACC "Diagnose; Zugriff auf Testerdaten" /end FUNCTION
/begin FUNCTION DCEZ "Diagnose; CAN-Timeout¸berwachung EZH" /begin DEF_CHARACTERISTIC TDCEZ /end DEF_CHARACTERISTIC /begin REF_CHARACTERISTIC UBDCAN /end REF_CHARACTERISTIC /begin IN_MEASUREMENT B_ezh B_ezhnew B_nmot ub /end IN_MEASUREMENT /end FUNCTION
/begin FUNCTION DCGE "Diagnose; CAN-Timeout GE-Schnittstelle" /begin DEF_CHARACTERISTIC TDCGE /end DEF_CHARACTERISTIC /begin REF_CHARACTERISTIC UBDCAN /end REF_CHARACTERISTIC /begin IN_MEASUREMENT B_autget B_egsnew B_nmot ub /end IN_MEASUREMENT /end FUNCTION
/begin FUNCTION DCINS "Diagnose; CAN Timeout Instrument (Kombi)" /begin DEF_CHARACTERISTIC TDCINS TDHCINS /end DEF_CHARACTERISTIC /begin REF_CHARACTERISTIC UBDCAN /end REF_CHARACTERISTIC /begin IN_MEASUREMENT B_ins2new B_ins3new B_nmot ub /end IN_MEASUREMENT /end FUNCTION
/begin FUNCTION DCLA "OBDII; Klassentabelle"
 /begin DEF_CHARACTERISTIC CL30LINE CL31LINE CL32LINE CL33LINE CL34LINE CL35LINE CL36LINE CL37LINE CL38LINE CL39LINE /end DEF_CHARACTERISTIC
/end FUNCTION
/begin FUNCTION DCOD "Diagnosefunktion Codierung" /begin REF_CHARACTERISTIC CODINDEX /end REF_CHARACTERISTIC /begin IN_MEASUREMENT B_pwf /end IN_MEASUREMENT /begin OUT_MEASUREMENT B_eepcod1 /end OUT_MEASUREMENT /end FUNCTION
/begin FUNCTION DDCY "OBDII; Erf¸llung Bedingung 'driving cycle'" /begin DEF_CHARACTERISTIC TWBDCY /end DEF_CHARACTERISTIC /begin IN_MEASUREMENT B_pwf B_stend /end IN_MEASUREMENT /begin OUT_MEASUREMENT bbdcy B_dcy dcycnt /end OUT_MEASUREMENT /end FUNCTION
/begin FUNCTION DDG "Diagnose Drehzahlgeber" /begin DEF_CHARACTERISTIC LBMINIT LBMMX PGFLNL PGFLWA TMOTNLDG ZIDFBM ZIDNOBM /end DEF_CHARACTERISTIC /begin IN_MEASUREMENT bmlosctr_w B_bm B_fbm B_nmin tmot zrph2_l zrph_l /end IN_MEASUREMENT /begin OUT_MEASUREMENT B_nldg /end OUT_MEASUREMENT /begin LOC_MEASUREMENT bmloss_w zrph2_save zrph_save /end LOC_MEASUREMENT /end FUNCTION
/begin FUNCTION DDISASCH "Diagnose Schalt-Disa" /begin DEF_CHARACTERISTIC DISA_GW DISA_TIME1 DISA_TIME2 /end DEF_CHARACTERISTIC /begin REF_CHARACTERISTIC CWDDISA /end REF_CHARACTERISTIC /begin IN_MEASUREMENT B_di_ausschalt B_di_einschalt Disa_spg Ditv_aus Di_cnt /end IN_MEASUREMENT /begin OUT_MEASUREMENT B_disamx B_disanp E_disasch startddisa /end OUT_MEASUREMENT /end FUNCTION
/begin FUNCTION DDVE "Diagnose: EGAS-Steller DV-E" /begin DEF_CHARACTERISTIC TPNSE /end DEF_CHARACTERISTIC
 /begin IN_MEASUREMENT B_abgle B_dkaden B_dkp1e B_dkp1mn B_dkp1mx B_dkp1np B_dkp2e B_dkp2mn B_dkp2mx B_dkp2np B_dlrbe B_dlrpide B_dveese B_fproab B_fproe B_fprook B_fprordy B_fprovb B_fprrdy B_fprzab B_fprze B_fprzvb B_lrnakt B_lrnerf B_lrnrdy B_lrnvb B_lrnws B_nlpe B_nlperf B_nlpnew B_pwf B_stend B_umae B_umauab B_wdksive dveadchst fprstep_c lrnstep_c /end IN_MEASUREMENT
/end FUNCTION
/begin FUNCTION DEAVANOS "Diagnose Ein- / Auslaﬂ- VANOS"
 /begin DEF_CHARACTERISTIC DEAVANOS NW_ADP_MN NW_ADP_MX NW_POSMN NW_POSMX VNSK_DELTA VNSK_TV_I VNS_DELTMX VNS_DELTMX2 VNS_ERRCNT VNS_ERRCNT2 VNS_NMOTS VNS_TMN VNS_TMX VNS_TVIMN VNS_TVIMX /end DEF_CHARACTERISTIC
 /begin REF_CHARACTERISTIC SPRZG_AN /end REF_CHARACTERISTIC
 /begin IN_MEASUREMENT B_vsaadnok B_vsaadok B_vsaflan B_vseadnok B_vseadok B_vseflan nmot Nw_pos tmot Vsa_adp Vsa_sprs Vsa_tv_i Vse_adp Vse_sprs Vse_tv_i /end IN_MEASUREMENT
 /begin OUT_MEASUREMENT B_anwmn B_anwmn2 B_anwpnp B_anwpnp2 B_enwmn B_enwmn2 B_enwpnp B_enwpnp2 B_evanos B_phad B_phad2 B_phad3 B_phad4 Vnscnt Vnscnt2 Vnsdeltaub Vnserr Vnshaltetv Vns_dad Vns_dst /end OUT_MEASUREMENT
/end FUNCTION
/begin FUNCTION DECJ "Diagnose; Endstufe CJ4x/9x" /begin DEF_CHARACTERISTIC NDECJ UBCJMN UBCJMX /end DEF_CHARACTERISTIC /begin IN_MEASUREMENT nmot ub /end IN_MEASUREMENT /begin OUT_MEASUREMENT B_desee /end OUT_MEASUREMENT /end FUNCTION
/begin FUNCTION DEGFE "Diagnose der Eingangsgrˆﬂen F¸llungserfassung" /begin DEF_CHARACTERISTIC CWDEGFE TDEGFEMN TDEGFEMX TDEGFENO TDEGFEST /end DEF_CHARACTERISTIC /begin IN_MEASUREMENT B_fkmsmn B_fkmsmx B_fkpvmn B_fkpvmx B_stend /end IN_MEASUREMENT /end FUNCTION
/begin FUNCTION DEKPE "Diagnose; Elektrokraftstoffpumpe Endstufe" /begin DEF_CHARACTERISTIC CWPSKPE EKPFA EKPPA /end DEF_CHARACTERISTIC /begin IN_MEASUREMENT B_desee /end IN_MEASUREMENT /begin LOC_MEASUREMENT dekpe ekpfz ekppz kpe_error /end LOC_MEASUREMENT /begin SUB_FUNCTION DFPM_DEKPE /end SUB_FUNCTION /end FUNCTION
/begin FUNCTION DELSE "Diagnose; Endstufe  E-BOX L¸fteransteuerung" /begin DEF_CHARACTERISTIC CWPSELS TDDIAGEL /end DEF_CHARACTERISTIC /begin REF_CHARACTERISTIC TVP /end REF_CHARACTERISTIC /begin IN_MEASUREMENT B_desee B_ebl /end IN_MEASUREMENT /begin LOC_MEASUREMENT B_calcelse /end LOC_MEASUREMENT /begin SUB_FUNCTION DFPM_DELSE /end SUB_FUNCTION /end FUNCTION
/begin FUNCTION DEPCL "Diagnose; Elektronik Powertrain Control Lampe" /begin DEF_CHARACTERISTIC TEPCL TEPCLI /end DEF_CHARACTERISTIC /begin IN_MEASUREMENT B_bt B_bteepcl B_btepcl B_nmot dfpmEpclState /end IN_MEASUREMENT /begin OUT_MEASUREMENT B_epcl /end OUT_MEASUREMENT /begin LOC_MEASUREMENT B_epclloc /end LOC_MEASUREMENT /end FUNCTION
/begin FUNCTION DEVE "Diagnose; Einspritzventil - Endstufe" /begin DEF_CHARACTERISTIC CWPSEVE /end DEF_CHARACTERISTIC /begin REF_CHARACTERISTIC TVP /end REF_CHARACTERISTIC /begin IN_MEASUREMENT B_desee B_sa B_stend evz_austot /end IN_MEASUREMENT /begin OUT_MEASUREMENT B_eev /end OUT_MEASUREMENT /begin SUB_FUNCTION DFPM_DEVE /end SUB_FUNCTION /end FUNCTION
/begin FUNCTION DFFT "Diagnose; Freeze Frame Auswahltabelle"
 /begin IN_MEASUREMENT egaspfad flglrs fra_u fr_u gangi mizsolv_u mizuvfil mi_duf mi_um ml mpfad nmot pu rinh_u rinv_u rl rml rstpfad skapfad tabgm tans tfst tkatm tmew tmot tmotlin tmot_u tmrw tpsvkmf_u tumg ub udkp1_u udkp2_u upwg1_u upwg2d_u upwg2_u ushk usvk vfzg_u wdkba wdks wped /end IN_MEASUREMENT
/end FUNCTION
/begin FUNCTION DFFTCNV "Diagnose; Freeze Frame Tabelle, Konvertierung zu Bytes" /begin REF_CHARACTERISTIC NMAX /end REF_CHARACTERISTIC
 /begin IN_MEASUREMENT fho_w frau_w fra_w frhol_w frm_w fr_w ftead_w igod_w igokr_w lamsons_w nmot_w rinh_w rinv_w rkrn_w rlugd_w rl_w tabst_w tmotlin tnse_w top_w tpsvkmf_w udkp1a_w udkp1_w udkp2_w udsu_w uhfm_w upwg1_w upwg2d_w upwg2_w uushk_w uusvk_w vfzg vfzgv1_w wdknlpr_w wdknlp_w wnwi_w wtans wtka wtmot /end IN_MEASUREMENT
 /begin OUT_MEASUREMENT addsu_u adhfm_u adta_u adtka_u adtm_u fho_u frau_u fra_u frhol_u frm_u fr_u ftead_u igod_u igokr_u lamsons_u rinh_u rinv_u rkrn_u rl_u tabst_u tmot_u tnse_u top_u tpsvkmf_u udkp1a_u udkp1_u udkp2_u upwg1_u upwg2d_u upwg2_u uushk_u uusvk_u vfzgv1_u vfzg_u wdknlpr_u wdknlp_u wnwi1_u /end OUT_MEASUREMENT
/end FUNCTION
/begin FUNCTION DFFTK "Diagnose; Kundenspezifische Auswahlliste f¸r Freeze Frame-Werte"
 /begin IN_MEASUREMENT addsu_u adhfm_u adta_u adtka_u adtm_u ahkat B_fe dffgen fho_u flgtiab frau_u frhol_u frm_u fstt ftead_u gentemp igod_u igokr_u ikrma ikrmet lamsons_u msabg nmot phlsnh phlsnv rkrn_u stssgerr tabgmf tabst_u taml tikatm tkatmf tmst tnse_u top_u tvlrhi udkp1a_u ugen uushk_u uusvk_u vfzg2 vfzgv1_u wdknlpr_u wdknlp_u wnwi1_u /end IN_MEASUREMENT
/end FUNCTION
/begin COMPU_METHOD acc_ub_b55p55 "" RAT_FUNC "%6.3" "m/(s^2)" COEFFS 0 1 0 0 0 0.217 /end COMPU_METHOD
/begin COMPU_METHOD bfzg_sb_q0p217 "" RAT_FUNC "%6.3" "m/s^2" COEFFS 0 1 0 0 0 0.217 /end COMPU_METHOD
/begin COMPU_METHOD B_TRUE "boolsche Zust‰nde, positive Logik" TAB_VERB "%6.3" "" COMPU_TAB_REF B_TRUE /end COMPU_METHOD
/begin COMPU_VTAB B_TRUE "boolsche Zust‰nde, positive Logik" TAB_VERB 2 0 "----" 1 "TRUE" /end COMPU_VTAB
/begin COMPU_METHOD DEZ "1 : 1 Umrechnug (dez/hex)" RAT_FUNC "%6.2" "" COEFFS 0 1 0 0 0 1 /end COMPU_METHOD
/begin COMPU_METHOD dez "1 : 1 Umrechnug (dez/hex)" RAT_FUNC "%6.2" "" COEFFS 0 1 0 0 0 1 /end COMPU_METHOD
/begin COMPU_METHOD dichte_ub_b2 "" RAT_FUNC "%6.4" "kg/m^3" COEFFS 0 256 0 0 0 2 /end COMPU_METHOD
/begin COMPU_METHOD fak_q0p015625 "" RAT_FUNC "%6.4" "-" COEFFS 0 64 0 0 0 1 /end COMPU_METHOD
/begin COMPU_METHOD fak_q0p5 "" RAT_FUNC "%6.3" "-" COEFFS 0 1 0 0 0 0.5 /end COMPU_METHOD
/begin COMPU_METHOD fak_r32_1 "" RAT_FUNC "%43.21" "-" COEFFS 0 1 0 0 0 1 /end COMPU_METHOD
/begin COMPU_METHOD fak_ub_b1 "" RAT_FUNC "%6.4" "-" COEFFS 0 256 0 0 0 1 /end COMPU_METHOD
/begin COMPU_METHOD fak_ub_b16 "" RAT_FUNC "%6.4" "-" COEFFS 0 256 0 0 0 16 /end COMPU_METHOD
/begin COMPU_METHOD fak_ub_b2 "" RAT_FUNC "%6.4" "-" COEFFS 0 256 0 0 0 2 /end COMPU_METHOD
/begin COMPU_METHOD fak_ub_b4 "" RAT_FUNC "%6.4" "-" COEFFS 0 256 0 0 0 4 /end COMPU_METHOD
/begin COMPU_METHOD fak_ub_q0p00392 "" RAT_FUNC "%6.4" "-" COEFFS 0 255 0 0 0 1 /end COMPU_METHOD
/begin COMPU_METHOD fak_uw_b025o32768 "" RAT_FUNC "%8.4" "-" COEFFS 0 262144 32768 0 0 1 /end COMPU_METHOD
/begin COMPU_METHOD fak_uw_b1 "" RAT_FUNC "%7.6" "-" COEFFS 0 65536 0 0 0 1 /end COMPU_METHOD
/begin COMPU_METHOD fak_uw_b16 "" RAT_FUNC "%6.5" "-" COEFFS 0 65536 0 0 0 16 /end COMPU_METHOD
/begin COMPU_METHOD fak_uw_b2 "" RAT_FUNC "%7.6" "-" COEFFS 0 65536 0 0 0 2 /end COMPU_METHOD
/begin COMPU_METHOD fak_uw_b32 "" RAT_FUNC "%6.5" "-" COEFFS 0 65536 0 0 0 32 /end COMPU_METHOD
/begin COMPU_METHOD fak_uw_b4 "" RAT_FUNC "%7.6" "-" COEFFS 0 65536 0 0 0 4 /end COMPU_METHOD
/begin COMPU_METHOD fak_uw_q0p001 "" RAT_FUNC "%6.5" "-" COEFFS 0 65536 0 0 0 65.536 /end COMPU_METHOD
/begin COMPU_METHOD freq2000_ub "" RAT_FUNC "%5.2" "1/s" COEFFS 0 256 0 0 0 200 /end COMPU_METHOD
/begin COMPU_METHOD fuel_ub_q0p5 "" RAT_FUNC "%6.3" "l" COEFFS 0 2 0 0 0 1 /end COMPU_METHOD
/begin COMPU_METHOD fuel_ub_q1 "" RAT_FUNC "%6.2" "l" COEFFS 0 1 0 0 0 1 /end COMPU_METHOD
/begin COMPU_METHOD hub_uw_q0p001 "" RAT_FUNC "%6.5" "mm" COEFFS 0 1000 0 0 0 1 /end COMPU_METHOD
/begin COMPU_METHOD igen_ub_q1 "" RAT_FUNC "%6.2" "" COEFFS 0 1 0 0 0 1 /end COMPU_METHOD
/begin COMPU_METHOD km_uw_q10 "" RAT_FUNC "%6.1" "km" COEFFS 0 1 0 0 0 10 /end COMPU_METHOD
/begin COMPU_METHOD kumsrl_ub_b0p002 "" RAT_FUNC "%8.7" "(kg/h)/((1/min)*%)" COEFFS 0 128000 0 0 0 1 /end COMPU_METHOD
/begin COMPU_METHOD kw_q1 "" RAT_FUNC "%6.2" "Grad KW" COEFFS 0 1 0 0 0 1 /end COMPU_METHOD
/begin COMPU_METHOD kw_q1_o128 "" RAT_FUNC "%6.4" "Grad KW" COEFFS 0 1 128 0 0 1 /end COMPU_METHOD
/begin COMPU_METHOD lws_q0p04375 "" RAT_FUNC "%6.4" "Grad" COEFFS 0 1 0 0 0 0.04375 /end COMPU_METHOD
/begin COMPU_METHOD md_ub_q1 "" RAT_FUNC "%6.2" "Nm" COEFFS 0 1 0 0 0 1 /end COMPU_METHOD
/begin COMPU_METHOD md_ub_q16 "" RAT_FUNC "%6.1" "Nm" COEFFS 0 1 0 0 0 16 /end COMPU_METHOD
/begin COMPU_METHOD mk10ms_uw_q2p384e5n "" RAT_FUNC "%6.5" "h(kg*s)" COEFFS 0 41943 0 0 0 10 /end COMPU_METHOD
/begin COMPU_METHOD m_sw_q0p1 "" RAT_FUNC "%6.3" "kg/h" COEFFS 0 1 0 0 0 0.1 /end COMPU_METHOD
/begin COMPU_METHOD m_ub_b0p166 "" RAT_FUNC "%6.5" "1/s" COEFFS 0 255 0 0 0 0.166 /end COMPU_METHOD
/begin COMPU_METHOD m_ub_b1020 "" RAT_FUNC "%6.2" "kg/h" COEFFS 0 1 0 0 0 4 /end COMPU_METHOD
/begin COMPU_METHOD m_ub_b23p3 "" RAT_FUNC "%6.3" "kg" COEFFS 0 2812.5 0 0 0 256 /end COMPU_METHOD
/begin COMPU_METHOD m_ub_b25p6 "" RAT_FUNC "%6.3" "kg/h" COEFFS 0 256 0 0 0 25.6 /end COMPU_METHOD
/begin COMPU_METHOD m_ub_q0p0415 "" RAT_FUNC "%6.4" "kg/(h*s)" COEFFS 0 1 0 0 0 0.0415 /end COMPU_METHOD
/begin COMPU_METHOD m_ub_q0p1 "" RAT_FUNC "%6.3" "kg/h" COEFFS 0 256 0 0 0 25.6 /end COMPU_METHOD
/begin COMPU_METHOD m_uw_b1638p4 "" RAT_FUNC "%6.4" "kg/h" COEFFS 0 1 0 0 0 0.025 /end COMPU_METHOD
/begin COMPU_METHOD m_uw_b25p6 "" RAT_FUNC "%6.5" "kg/h" COEFFS 0 65536 0 0 0 25.6 /end COMPU_METHOD
/begin COMPU_METHOD m_uw_b6553p5 "" RAT_FUNC "%6.3" "kg/h" COEFFS 0 1 0 0 0 0.1 /end COMPU_METHOD
/begin COMPU_METHOD m_uw_q0p0005 "" RAT_FUNC "%6.5" "kg/h" COEFFS 0 1 0 0 0 0.0005 /end COMPU_METHOD
/begin COMPU_METHOD ngen_uw_q0p5 "" RAT_FUNC "%6.3" "" COEFFS 0 1 0 0 0 0.5 /end COMPU_METHOD
/begin COMPU_METHOD nmotg_sb_q100 "" RAT_FUNC "%6.0" "1/min/s" COEFFS 0 1 0 0 0 100 /end COMPU_METHOD
/begin COMPU_METHOD nmotg_sw_q0p39 "" RAT_FUNC "%6.3" "1/min/s" COEFFS 0 1 0 0 0 0.39063 /end COMPU_METHOD
/begin COMPU_METHOD nmot_sw_q0p25 "" RAT_FUNC "%6.3" "1/min" COEFFS 0 1 0 0 0 0.25 /end COMPU_METHOD
/begin COMPU_METHOD nmot_ub_q10 "" RAT_FUNC "%6.1" "1/min" COEFFS 0 1 0 0 0 10 /end COMPU_METHOD
/begin COMPU_METHOD nmot_ub_q40 "" RAT_FUNC "%6.1" "1/min" COEFFS 0 1 0 0 0 40 /end COMPU_METHOD
/begin COMPU_METHOD nmot_uw_q0p25 "" RAT_FUNC "%6.3" "1/min" COEFFS 0 1 0 0 0 0.25 /end COMPU_METHOD
/begin COMPU_METHOD PCENT "Prozent" RAT_FUNC "%6.3" "%" COEFFS 0 256 0 0 0 100 /end COMPU_METHOD
/begin COMPU_METHOD p_q0p039 "" RAT_FUNC "%6.4" "hPa" COEFFS 0 256 0 0 0 10 /end COMPU_METHOD
/begin COMPU_METHOD p_q0p039s32768 "" RAT_FUNC "%7.1" "hPa" COEFFS 0 256 327680 0 0 10 /end COMPU_METHOD
/begin COMPU_METHOD p_sw_q0p039 "" RAT_FUNC "%6.4" "hPa" COEFFS 0 256 0 0 0 10 /end COMPU_METHOD
/begin COMPU_METHOD p_ub_q10 "" RAT_FUNC "%6.1" "hPa" COEFFS 0 1 0 0 0 10 /end COMPU_METHOD
/begin COMPU_METHOD p_ub_q5 "" RAT_FUNC "%6.2" "hPa" COEFFS 0 1 0 0 0 5 /end COMPU_METHOD
/begin COMPU_METHOD p_uw_b32 "" RAT_FUNC "%6.5" "hPa/%" COEFFS 0 65536 0 0 0 32 /end COMPU_METHOD
/begin COMPU_METHOD p_uw_q0p039 "" RAT_FUNC "%6.4" "hPa" COEFFS 0 256 0 0 0 10 /end COMPU_METHOD
/begin COMPU_METHOD qnv_uw_b512 "" RAT_FUNC "%6.4" "(1/min) / (km/h)" COEFFS 0 65536 0 0 0 512 /end COMPU_METHOD
/begin COMPU_METHOD relDK_q0p02441 "" RAT_FUNC "%6.4" "%DK" COEFFS 0 65536 0 0 0 1600 /end COMPU_METHOD
/begin COMPU_METHOD relDK_ub_b100 "" RAT_FUNC "%6.3" "%DK" COEFFS 0 255 0 0 0 100 /end COMPU_METHOD
/begin COMPU_METHOD relNWU_q0p0234 "" RAT_FUNC "%6.4" "%/NWU" COEFFS 0 32 0 0 0 0.75 /end COMPU_METHOD
/begin COMPU_METHOD rel_sw_b1536 "" RAT_FUNC "%6.4" "%" COEFFS 0 65536 0 0 0 3072 /end COMPU_METHOD
/begin COMPU_METHOD rel_sw_q0p0234 "" RAT_FUNC "%6.4" "%/seg" COEFFS 0 32 0 0 0 0.75 /end COMPU_METHOD
/begin COMPU_METHOD rel_ub_b100 "" RAT_FUNC "%6.3" "%" COEFFS 0 255 0 0 0 100 /end COMPU_METHOD
/begin COMPU_METHOD rel_ub_b127p5 "" RAT_FUNC "%6.3" "%" COEFFS 0 2 0 0 0 1 /end COMPU_METHOD
/begin COMPU_METHOD rel_ub_b24p9 "" RAT_FUNC "%6.3" "%" COEFFS 0 255 0 0 0 24.9 /end COMPU_METHOD
/begin COMPU_METHOD rel_ub_b2p0 "" RAT_FUNC "%6.4" "%" COEFFS 0 256 0 0 0 2 /end COMPU_METHOD
/begin COMPU_METHOD rel_ub_b99p6 "" RAT_FUNC "%6.3" "%" COEFFS 0 256 0 0 0 100 /end COMPU_METHOD
/begin COMPU_METHOD rel_ub_q0p1875 "" RAT_FUNC "%6.3" "KW/ms" COEFFS 0 256 0 0 0 48 /end COMPU_METHOD
/begin COMPU_METHOD rel_ub_q0p75 "" RAT_FUNC "%6.3" "%" COEFFS 0 1 0 0 0 0.75 /end COMPU_METHOD
/begin COMPU_METHOD rel_uw_b0p3 "" RAT_FUNC "%8.7" "%/hPa" COEFFS 0 65536 0 0 0 0.3 /end COMPU_METHOD
/begin COMPU_METHOD rel_uw_b100 "" RAT_FUNC "%6.4" "%" COEFFS 0 65536 0 0 0 100 /end COMPU_METHOD
/begin COMPU_METHOD rel_uw_b200 "" RAT_FUNC "%6.4" "%" COEFFS 0 65536 0 0 0 200 /end COMPU_METHOD
/begin COMPU_METHOD rel_uw_q0p0234 "" RAT_FUNC "%6.4" "%" COEFFS 0 32 0 0 0 0.75 /end COMPU_METHOD
/begin COMPU_METHOD r_ub_q64 "" RAT_FUNC "%6.1" "Ohm" COEFFS 0 1 0 0 0 64 /end COMPU_METHOD
/begin COMPU_METHOD spgg_sb_b3052 "" RAT_FUNC "%6.1" "V/s" COEFFS 0 1 0 0 0 23.8438 /end COMPU_METHOD
/begin COMPU_METHOD spg_q0p00039 "" RAT_FUNC "%6.5" "V" COEFFS 0 1 0 0 0 0.000390625 /end COMPU_METHOD
/begin COMPU_METHOD spg_q0p1_o10p6 "" RAT_FUNC "%6.2" "V" COEFFS 0 1 -10.6 0 0 0.1 /end COMPU_METHOD
/begin COMPU_METHOD spg_q0p625 "" RAT_FUNC "%6.3" "V" COEFFS 0 8 0 0 0 5 /end COMPU_METHOD
/begin COMPU_METHOD spg_ubatt "" RAT_FUNC "%6.3" "V" COEFFS 0 1 0 0 0 0.0942 /end COMPU_METHOD
/begin COMPU_METHOD spg_ub_b5 "" RAT_FUNC "%6.4" "V" COEFFS 0 256 0 0 0 5 /end COMPU_METHOD
/begin COMPU_METHOD spg_ugen "" RAT_FUNC "%6.2" "V" COEFFS 0 10 -106 0 0 1 /end COMPU_METHOD
/begin COMPU_METHOD spg_uw_b5 "" RAT_FUNC "%6.4" "V" COEFFS 0 1024 0 0 0 5 /end COMPU_METHOD
/begin COMPU_METHOD sprzi_q0p1 "" RAT_FUNC "%4.2" "Grad KW" COEFFS 0 10 0 0 0 1 /end COMPU_METHOD
/begin COMPU_METHOD t100msxs_ub_b25p5 "" RAT_FUNC "%6.3" "s" COEFFS 0 1 0 0 0 0.1 /end COMPU_METHOD
/begin COMPU_METHOD t100msxs_uw_b6553p5 "" RAT_FUNC "%6.3" "s" COEFFS 0 1 0 0 0 0.1 /end COMPU_METHOD
/begin COMPU_METHOD t10msxs_ub_b10p2 "" RAT_FUNC "%6.4" "s" COEFFS 0 1 0 0 0 0.04 /end COMPU_METHOD
/begin COMPU_METHOD t10msxs_ub_b2p55 "" RAT_FUNC "%6.4" "s" COEFFS 0 1 0 0 0 0.01 /end COMPU_METHOD
/begin COMPU_METHOD t10msxs_uw_b655p35 "" RAT_FUNC "%6.4" "s" COEFFS 0 1 0 0 0 0.01 /end COMPU_METHOD
/begin COMPU_METHOD t128ms_uw "" RAT_FUNC "%6.4" "ms" COEFFS 0 512 0 0 0 1 /end COMPU_METHOD
/begin COMPU_METHOD t1536minxmin_q1536 "" RAT_FUNC "%7.0" "min" COEFFS 0 1 0 0 0 1536 /end COMPU_METHOD
/begin COMPU_METHOD t1sxs_ub_b255 "" RAT_FUNC "%6.2" "s" COEFFS 0 1 0 0 0 1 /end COMPU_METHOD
/begin COMPU_METHOD t1sxs_uw_q1 "" RAT_FUNC "%6.2" "s" COEFFS 0 1 0 0 0 1 /end COMPU_METHOD
/begin COMPU_METHOD t200msxs_ub_b51 "" RAT_FUNC "%6.3" "s" COEFFS 0 1 0 0 0 0.2 /end COMPU_METHOD
/begin COMPU_METHOD t200msxs_uw_q0p2 "" RAT_FUNC "%6.3" "s" COEFFS 0 1 0 0 0 0.2 /end COMPU_METHOD
/begin COMPU_METHOD t20msxs_ub_q0p02 "" RAT_FUNC "%6.4" "s" COEFFS 0 50 0 0 0 1 /end COMPU_METHOD
/begin COMPU_METHOD t25p6sxs_ub_b6528 "" RAT_FUNC "%6.1" "s" COEFFS 0 1 0 0 0 25.6 /end COMPU_METHOD
/begin COMPU_METHOD t3p2usxms_uw_b209p7 "" RAT_FUNC "%6.4" "ms" COEFFS 0 65536 0 0 0 209.751 /end COMPU_METHOD
/begin COMPU_METHOD temp_q0p0234 "" RAT_FUNC "%6.4" "K" COEFFS 0 256 0 0 0 6 /end COMPU_METHOD
/begin COMPU_METHOD temp_q0p0234_o273 "" RAT_FUNC "%6.1" "Grad C" COEFFS 0 1 273.15 0 0 0.0234375 /end COMPU_METHOD
/begin COMPU_METHOD temp_q1 "" RAT_FUNC "%6.2" "Grad C" COEFFS 0 1 0 0 0 1 /end COMPU_METHOD
/begin COMPU_METHOD temp_sb_q0p75 "" RAT_FUNC "%6.3" "Grad C" COEFFS 0 1 0 0 0 0.75 /end COMPU_METHOD
/begin COMPU_METHOD temp_sw_q0p75 "" RAT_FUNC "%6.3" "Grad C" COEFFS 0 4 0 0 0 3 /end COMPU_METHOD
/begin COMPU_METHOD temp_ub_q0p75_o48 "" RAT_FUNC "%6.2" "Grad C" COEFFS 0 1 48 0 0 0.75 /end COMPU_METHOD
/begin COMPU_METHOD temp_ub_q1_o40 "" RAT_FUNC "%6.2" "Grad C" COEFFS 0 1 40 0 0 1 /end COMPU_METHOD
/begin COMPU_METHOD tmin_uw_q1 "" RAT_FUNC "%6.2" "min" COEFFS 0 1 0 0 0 1 /end COMPU_METHOD
/begin COMPU_METHOD t_q0p0001_ms "" RAT_FUNC "%7.6" "ms" COEFFS 0 1 0 0 0 0.0001 /end COMPU_METHOD
/begin COMPU_METHOD t_q0p01 "" RAT_FUNC "%6.4" "s" COEFFS 0 100 0 0 0 1 /end COMPU_METHOD
/begin COMPU_METHOD t_q0p04_ms "" RAT_FUNC "%6.4" "ms" COEFFS 0 1 0 0 0 0.04 /end COMPU_METHOD
/begin COMPU_METHOD t_q0p1 "" RAT_FUNC "%6.3" "s" COEFFS 0 10 0 0 0 1 /end COMPU_METHOD
/begin COMPU_METHOD t_q1 "" RAT_FUNC "%6.2" "s" COEFFS 0 1 0 0 0 1 /end COMPU_METHOD
/begin COMPU_METHOD t_q16us "" RAT_FUNC "%6.1" "us" COEFFS 0 1 0 0 0 16 /end COMPU_METHOD
/begin COMPU_METHOD t_q256 "" RAT_FUNC "%6.0" "s" COEFFS 0 1 0 0 0 256 /end COMPU_METHOD
/begin COMPU_METHOD vfzg_q1p0 "" RAT_FUNC "%6.2" "km/h" COEFFS 0 1 0 0 0 1 /end COMPU_METHOD
/begin COMPU_METHOD vfzg_ub_q1p25 "" RAT_FUNC "%6.2" "km/h" COEFFS 0 1 0 0 0 1.25 /end COMPU_METHOD
/begin COMPU_METHOD vfzg_uw_b512 "" RAT_FUNC "%6.4" "km/h" COEFFS 0 65536 0 0 0 512 /end COMPU_METHOD
/begin COMPU_METHOD vfzg_uw_q0p0625 "" RAT_FUNC "%6.4" "km/h" COEFFS 0 1 0 0 0 0.0625 /end COMPU_METHOD
/begin COMPU_METHOD vnstv_q0p00305s32768 "" RAT_FUNC "%7.3" "%" COEFFS 0 327.68 32768 0 0 1 /end COMPU_METHOD
/begin COMPU_METHOD vs_uw_b25p6 "" RAT_FUNC "%6.5" "m^3/h" COEFFS 0 65536 0 0 0 25.6 /end COMPU_METHOD
/begin COMPU_METHOD wkw_sb_b128 "" RAT_FUNC "%3.1" "Grad KW" COEFFS 0 1 0 0 0 1 /end COMPU_METHOD
/begin COMPU_METHOD zk100msxs_ub_b25p5 "" RAT_FUNC "%6.3" "s" COEFFS 0 0 256 0 10 0 /end COMPU_METHOD
/begin COMPU_METHOD zk100msxs_uw_b6553 "" RAT_FUNC "%10.3" "s" COEFFS 0 0 65536 0 10 0 /end COMPU_METHOD
/begin COMPU_METHOD zk10msxs_uw_b2p55T "" TAB_INTP "%6.3" "s" COMPU_TAB_REF zk10msxs_uw_b2p55T /end COMPU_METHOD
/begin COMPU_TAB zk10msxs_uw_b2p55T "" TAB_INTP 35 128 2.55 145 2.25 163 2 186 1.75 217 1.5 251 1.3 283 1.15 326 1 362 0.9 407 0.8 465 0.7 541 0.6 649 0.5 720 0.45 809 0.4 923 0.35 1074 0.3 1285 0.25 1524 0.21 1872 0.17 2259 0.14 2426 0.13 2620 0.12 2847 0.11 3118 0.1 3446 0.09 3850 0.08 4362 0.07 5030 0.06 5939 0.05 7248 0.04 9288 0.03 12893 0.02 20713 0.01 32767 0 /end COMPU_TAB
/begin COMPU_METHOD zk10msxs_uw_b655 "" RAT_FUNC "%6.2" "s" COEFFS 0 0 65536 0 100 0 /end COMPU_METHOD
/begin COMPU_METHOD zk1sxs_uw_b65535 "" RAT_FUNC "%6.0" "s" COEFFS 0 0 65535 0 1 0 /end COMPU_METHOD
/begin COMPU_METHOD zk20msxs_ub_b5p1 "" RAT_FUNC "%6.4" "s" COEFFS 0 0 5.1 0 1 0 /end COMPU_METHOD
/begin COMPU_METHOD zw_ub_q6 "" RAT_FUNC "%6.2" "Grad KW" COEFFS 0 255 0 0 0 1530 /end COMPU_METHOD
/begin COMPU_METHOD default "" RAT_FUNC "%6.2" "" COEFFS 0 1 0 0 0 1 /end COMPU_METHOD
/begin RECORD_LAYOUT FklWS16 FNC_VALUES 1 SWORD COLUMN_DIR DIRECT /end RECORD_LAYOUT
/begin RECORD_LAYOUT FklWU16 FNC_VALUES 1 UWORD COLUMN_DIR DIRECT /end RECORD_LAYOUT
/begin RECORD_LAYOUT GkfWUw FNC_VALUES 1 UWORD COLUMN_DIR DIRECT /end RECORD_LAYOUT
/begin RECORD_LAYOUT KfAxU8AyU8SstxU16SstyU16WU16 NO_AXIS_PTS_X 1 UWORD NO_AXIS_PTS_Y 2 UWORD AXIS_PTS_X 3 UWORD INDEX_INCR DIRECT AXIS_PTS_Y 4 UWORD INDEX_INCR DIRECT FNC_VALUES 5 UWORD COLUMN_DIR DIRECT /end RECORD_LAYOUT
/begin RECORD_LAYOUT KfAxU8AyU8SstxU8SstyU16WU16 NO_AXIS_PTS_X 1 UBYTE NO_AXIS_PTS_Y 2 UBYTE AXIS_PTS_X 3 UBYTE INDEX_INCR DIRECT AXIS_PTS_Y 4 UWORD INDEX_INCR DIRECT FNC_VALUES 5 UWORD COLUMN_DIR DIRECT /end RECORD_LAYOUT
/begin RECORD_LAYOUT KfAxU8AyU8SstxU8SstyU16WU8 NO_AXIS_PTS_X 1 UBYTE NO_AXIS_PTS_Y 2 UBYTE AXIS_PTS_X 3 UBYTE INDEX_INCR DIRECT AXIS_PTS_Y 4 UWORD INDEX_INCR DIRECT FNC_VALUES 5 UBYTE COLUMN_DIR DIRECT /end RECORD_LAYOUT
/begin RECORD_LAYOUT KfAxU8AyU8SstxU8SstyU8WU8 NO_AXIS_PTS_X 1 UBYTE NO_AXIS_PTS_Y 2 UBYTE AXIS_PTS_X 3 UBYTE INDEX_INCR DIRECT AXIS_PTS_Y 4 UBYTE INDEX_INCR DIRECT FNC_VALUES 5 UBYTE COLUMN_DIR DIRECT /end RECORD_LAYOUT
/begin RECORD_LAYOUT KfAxUbAyUbSstxUbSstyUbWUb NO_AXIS_PTS_X 1 UBYTE NO_AXIS_PTS_Y 2 UBYTE AXIS_PTS_X 3 UBYTE INDEX_INCR DIRECT AXIS_PTS_Y 4 UBYTE INDEX_INCR DIRECT FNC_VALUES 5 UBYTE COLUMN_DIR DIRECT /end RECORD_LAYOUT
/begin RECORD_LAYOUT KfAxUwAyUwSstxSwSstyUwWUw NO_AXIS_PTS_X 1 UWORD NO_AXIS_PTS_Y 2 UWORD AXIS_PTS_X 3 SWORD INDEX_INCR DIRECT AXIS_PTS_Y 4 UWORD INDEX_INCR DIRECT FNC_VALUES 5 UWORD COLUMN_DIR DIRECT /end RECORD_LAYOUT
/begin RECORD_LAYOUT KfAxUwAyUwSstxUwSstyUwWUw NO_AXIS_PTS_X 1 UWORD NO_AXIS_PTS_Y 2 UWORD AXIS_PTS_X 3 UWORD INDEX_INCR DIRECT AXIS_PTS_Y 4 UWORD INDEX_INCR DIRECT FNC_VALUES 5 UWORD COLUMN_DIR DIRECT /end RECORD_LAYOUT
/begin RECORD_LAYOUT KlASwSstSwWSw NO_AXIS_PTS_X 1 SWORD AXIS_PTS_X 2 SWORD INDEX_INCR DIRECT FNC_VALUES 3 SWORD COLUMN_DIR DIRECT /end RECORD_LAYOUT
/begin RECORD_LAYOUT KlAUbSstUbWUb NO_AXIS_PTS_X 1 UBYTE AXIS_PTS_X 2 UBYTE INDEX_INCR DIRECT FNC_VALUES 3 UBYTE COLUMN_DIR DIRECT /end RECORD_LAYOUT
/begin RECORD_LAYOUT KlAUbSstUbWUw NO_AXIS_PTS_X 1 UBYTE AXIS_PTS_X 2 UBYTE INDEX_INCR DIRECT FNC_VALUES 3 UWORD COLUMN_DIR DIRECT /end RECORD_LAYOUT
/begin RECORD_LAYOUT KlAUwSstUwWSw NO_AXIS_PTS_X 1 UWORD AXIS_PTS_X 2 UWORD INDEX_INCR DIRECT FNC_VALUES 3 SWORD COLUMN_DIR DIRECT /end RECORD_LAYOUT
/begin RECORD_LAYOUT KlAUwSstUwWUw NO_AXIS_PTS_X 1 UWORD AXIS_PTS_X 2 UWORD INDEX_INCR DIRECT FNC_VALUES 3 UWORD COLUMN_DIR DIRECT /end RECORD_LAYOUT
/begin RECORD_LAYOUT KlAxU8SstxU16WU16 NO_AXIS_PTS_X 1 UWORD AXIS_PTS_X 2 UWORD INDEX_INCR DIRECT FNC_VALUES 3 UWORD COLUMN_DIR DIRECT /end RECORD_LAYOUT
/begin RECORD_LAYOUT KwbUb FNC_VALUES 1 UBYTE COLUMN_DIR DIRECT /end RECORD_LAYOUT
/begin RECORD_LAYOUT KwbUw FNC_VALUES 1 UWORD COLUMN_DIR DIRECT /end RECORD_LAYOUT
/begin RECORD_LAYOUT KwSb FNC_VALUES 1 SBYTE COLUMN_DIR DIRECT /end RECORD_LAYOUT
/begin RECORD_LAYOUT KwSw FNC_VALUES 1 SWORD COLUMN_DIR DIRECT /end RECORD_LAYOUT
/begin RECORD_LAYOUT KwUb FNC_VALUES 1 UBYTE COLUMN_DIR DIRECT /end RECORD_LAYOUT
/begin RECORD_LAYOUT KwUw FNC_VALUES 1 UWORD COLUMN_DIR DIRECT /end RECORD_LAYOUT
/begin RECORD_LAYOUT KwWS16 FNC_VALUES 1 SWORD COLUMN_DIR DIRECT /end RECORD_LAYOUT
/begin RECORD_LAYOUT KwWU16 FNC_VALUES 1 UWORD COLUMN_DIR DIRECT /end RECORD_LAYOUT
/begin RECORD_LAYOUT KwWU8 FNC_VALUES 1 UBYTE COLUMN_DIR DIRECT /end RECORD_LAYOUT
/begin RECORD_LAYOUT SstAUwSstUw NO_AXIS_PTS_X 1 UWORD AXIS_PTS_X 2 UWORD INDEX_INCR DIRECT /end RECORD_LAYOUT
/end MODULE
/end PROJECT
