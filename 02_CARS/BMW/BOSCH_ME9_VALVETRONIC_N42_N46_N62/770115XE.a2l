ASAP2_VERSION 1 3
/begin PROJECT basisme9 ""
/begin HEADER "" VERSION "basisme9" PROJECT_NO basisme9 /end HEADER
/begin MODULE DIM ""
/begin MOD_COMMON "" BYTE_ORDER MSB_FIRST ALIGNMENT_BYTE 1 ALIGNMENT_WORD 2 ALIGNMENT_LONG 2 ALIGNMENT_FLOAT32_IEEE 4 /end MOD_COMMON
/begin CHARACTERISTIC AIMV "Anzahl Geschwindigkeitsimpulse pro km f¸r Normierung v-Signal" VALUE 0x4E5200 KwWU32 460799999892.71161 aimv_ul_b4p608e11 107.28836062068315 460800000000.00000 FORMAT "%19.6" /end CHARACTERISTIC
/begin CHARACTERISTIC AZKRLDYN "Anzahl Z¸ndungen pro Zyl. bei KR-Lastdynamik" CURVE 0x4ED004 KlAUbSstUbWUb 254.0 dez 1.000 255.0 FORMAT "%5.1"
 /begin AXIS_DESCR STD_AXIS nmot nmot_ub_q40 16 0.00 10200. FORMAT "%5.0" DEPOSIT ABSOLUTE /end AXIS_DESCR
/end CHARACTERISTIC
/begin CHARACTERISTIC AZKRNDYN "Anzahl Z¸ndungen f¸r KR-Drehzahldynamik" CURVE 0x4ED028 KlAUbSstUbWUb 254.0 dez 1.000 255.0 FORMAT "%5.1"
 /begin AXIS_DESCR STD_AXIS nmot nmot_ub_q40 16 0.00 10200. FORMAT "%5.0" DEPOSIT ABSOLUTE /end AXIS_DESCR
/end CHARACTERISTIC
/begin CHARACTERISTIC CNFKUPPL "Konfigurationsflag f¸r die Auswertung des Kuplg.schalters in der LLR" VALUE 0x4E59F8 KwUb 255.0 dez 0.00 255.0 FORMAT "%5.1" /end CHARACTERISTIC
/begin CHARACTERISTIC CWKHMD "Codewort f¸r Drehmomentenreserve bei Katheizen" VALUE 0x4ECBD8 KwUb 255.0 dez 0.00 255.0 FORMAT "%5.1" /end CHARACTERISTIC
/begin CHARACTERISTIC CWKTM "Codewort zur Steuerung KTM" VALUE 0x4E4BC4 KwWU16 65535.00 default 0.00 65535.00 FORMAT "%8.2" /end CHARACTERISTIC
/begin CHARACTERISTIC CWLAMBTS "Codewort: Lambda Bauteileschutz" VALUE 0x4EC078 KwUb 255.0 dez 0.00 255.0 FORMAT "%5.1" /end CHARACTERISTIC
/begin CHARACTERISTIC CWLAMKH "Codewort Lambdakoordination bei Kat-heizen" VALUE 0x4E4D70 KwUb 255.0 dez 0.00 255.0 FORMAT "%5.1" /end CHARACTERISTIC
/begin CHARACTERISTIC CWLLRMR "Codewort f¸r LLR-Momentenreserve" VALUE 0x4E5B64 KwUb 255.0 dez 0.00 255.0 FORMAT "%5.1" /end CHARACTERISTIC
/begin CHARACTERISTIC CWTEV "" VALUE 0x4E51FE KwUb 255.0 dez 0.00 255.0 FORMAT "%5.1" /end CHARACTERISTIC
/begin CHARACTERISTIC CWTEVPOS "" VALUE 0x4E51FF KwUb 255.0 dez 0.00 255.0 FORMAT "%5.1" /end CHARACTERISTIC
/begin CHARACTERISTIC CWTMOT "=1 Diagnose K2x, =0 Diagnose K4x" VALUE 0x4EC5C4 KwUb 255.0 dez 0.00 255.0 FORMAT "%5.1" /end CHARACTERISTIC
/begin CHARACTERISTIC CWTMPLAUS "Tmot Plausibilisierung (=0 ein, =1 aus)" VALUE 0x4EC5C5 KwUb 255.0 dez 0.00 255.0 FORMAT "%5.1" /end CHARACTERISTIC
/begin CHARACTERISTIC CWVLTEST "" VALUE 0x4EC89D KwUb 255.0 dez 0.00 255.0 FORMAT "%5.1" /end CHARACTERISTIC
/begin CHARACTERISTIC CW_BTS "Codewort BTS" VALUE 0x4ECA9E KwUb 255.0 dez 0.00 255.0 FORMAT "%5.1" /end CHARACTERISTIC
/begin CHARACTERISTIC CW_BTSKILL "Codewort ‹berbr¸ckung Killkreis" VALUE 0x4ECA9F KwUb 255.0 dez 0.00 255.0 FORMAT "%5.1" /end CHARACTERISTIC
/begin CHARACTERISTIC CW_KRRA "Codewort Z¸ndwinkel der KR wird immer ausgegeben" VALUE 0x4E5737 KwUb 255.0 dez 0.00 255.0 FORMAT "%5.1" /end CHARACTERISTIC
/begin CHARACTERISTIC CW_LBZAP "" VALUE 0x4E5A1C KwUb 1.000 dez 0.00 1.000 FORMAT "%5.3" /end CHARACTERISTIC
/begin CHARACTERISTIC CW_TZYL "Umschalter zwischen Zylindertemperaturen und tmot" VALUE 0x4EC6D2 KwUb 255.0 dez 0.00 255.0 FORMAT "%5.1" /end CHARACTERISTIC
/begin CHARACTERISTIC DELTAIIMX "Stromhysterrese BTS" VALUE 0x4ECAA4 KwUw 2499.962 ii_uw_b2621 0.00 2499.962 FORMAT "%8.3" /end CHARACTERISTIC
/begin CHARACTERISTIC DLBTS "Delta Lambdasoll f¸r Bauteileschutz" CURVE 0x4EC20C KlAUbSstUbWSb 1.000 fak_sb_b1 -1.000 0.00 FORMAT "%5.3"
 /begin AXIS_DESCR STD_AXIS detazwbs rel_ub_b127p5 8 0.00 127.5 FORMAT "%5.1" DEPOSIT ABSOLUTE /end AXIS_DESCR
/end CHARACTERISTIC
/begin CHARACTERISTIC DMRESFS "LLR: Abbaugeschwindigkeit der erhˆhten Drehmomentreserve" VALUE 0x4E5B65 KwUb 4.845 relgrad_20ms_qn0p019 -4.845 0.00 FORMAT "%5.3" /end CHARACTERISTIC
/begin CHARACTERISTIC DMRESLL "LLR: Abbaugeschwindigkeit der erhˆhten Drehmomentreserve" VALUE 0x4E5B66 KwUb 4.845 relgrad_20ms_qn0p019 -4.845 0.00 FORMAT "%5.3" /end CHARACTERISTIC
/begin CHARACTERISTIC DMRESLW "Momentenreserve bei Servolenkung" CURVE 0x4E5BD2 KlAUwSstSwWUw 24.99765 rel_q0p09726 0.00 24.99765 FORMAT "%8.5"
 /begin AXIS_DESCR STD_AXIS lws_w lws_q0p04375 7 -1433.600 1433.556 FORMAT "%8.3" DEPOSIT ABSOLUTE /end AXIS_DESCR
/end CHARACTERISTIC
/begin CHARACTERISTIC DNLLR "Drehzahlband oberhalb nstat f¸r LLR-Freigabe" VALUE 0x4E5A1A KwUw 16383.75 Def_n4 0.00 16383.75 FORMAT "%8.2" /end CHARACTERISTIC
/begin CHARACTERISTIC DNLLRES "LLR: Unterdrehzahlschwelle zur Erhˆhung der Momentenreserve im LL" VALUE 0x4E5B67 KwSb 2550. nmotd_sb_q10 -1280. 1270. FORMAT "%5.0" /end CHARACTERISTIC
/begin CHARACTERISTIC DNSNFX "Offset zur Bestimmung der oberen Grenze f¸r die Solldrehzahlnachf¸hrung" VALUE 0x4E5A1D KwUb 2550. nmot_ub_q10 0.00 2550. FORMAT "%5.0" /end CHARACTERISTIC
/begin CHARACTERISTIC DSTMOT "Tzyl-Schwelle zur Durchf¸hrung der Max-Diagnose f¸r tmot" VALUE 0x4EC5C6 KwUb 191.3 temp_ub_q0p75_o48 -48.00 143.3 FORMAT "%5.1" /end CHARACTERISTIC
/begin CHARACTERISTIC DSTZYL "tmotzyl-Schwelle f¸r Zylinderkopftemperaturdiagnose" VALUE 0x4EC728 KwUw 49151.25 temp_ub_q0p75_o48 -48.00000 49103.25 FORMAT "%8.2" /end CHARACTERISTIC
/begin CHARACTERISTIC DSTZYLMOT "tmot-Schwelle f¸r Zylinderkopftemperaturdiagnose" VALUE 0x4EC72A KwUw 49151.25 temp_ub_q0p75_o48 -48.00000 49103.25 FORMAT "%8.2" /end CHARACTERISTIC
/begin CHARACTERISTIC DTBTS "Temperaturhysterese f¸r Bauteileschutz" VALUE 0x4EC21E KwUw 1279.980 temp_uw_q0p0195 0.00 1279.980 FORMAT "%8.3" /end CHARACTERISTIC
/begin CHARACTERISTIC DTLRTML "Bewertungsfaktor Zeitdekrementierung f¸r Erreichen tmot-Einschaltschwelle LR" CURVE 0x4EC5C8 KlAUbSstUbWUb 99.61 rel_ub_b99p6 0.00 99.61 FORMAT "%5.2"
 /begin AXIS_DESCR STD_AXIS mll1 m_ub_b1020 7 0.00 1020. FORMAT "%5.0" DEPOSIT ABSOLUTE /end AXIS_DESCR
/end CHARACTERISTIC
/begin CHARACTERISTIC DTMDMA "Abstand Motortemperaturmodell zur Starttemperatur" VALUE 0x4EC5D7 KwUb 191.3 temp_ub_b191p25 0.00 191.3 FORMAT "%5.1" /end CHARACTERISTIC
/begin CHARACTERISTIC DTMDNPO "Abstand Motortemperaturmodell zur oberen Unplausibilit‰tsschwelle" VALUE 0x4EC5D8 KwUb 191.3 temp_ub_b191p25 0.00 191.3 FORMAT "%5.1" /end CHARACTERISTIC
/begin CHARACTERISTIC DTMSRT "Delta Motortemp.zu Starttemp. f.Retrigg. Modelle (Blockheater-Erkennung)" VALUE 0x4EC5D9 KwUb 191.3 temp_ub_b191p25 0.00 191.3 FORMAT "%5.1" /end CHARACTERISTIC
/begin CHARACTERISTIC DWEKSN "delta Winkel Ersatz-Klopfsensor" CURVE 0x4E5718 KlAxU8SstxU8WU8 191.3 zw_ub_qn0p75 -191.3 0.00 FORMAT "%5.1"
 /begin AXIS_DESCR STD_AXIS nmot nmot_ub_q40 8 0.00 10200. FORMAT "%5.0" DEPOSIT ABSOLUTE /end AXIS_DESCR
/end CHARACTERISTIC
/begin CHARACTERISTIC DWKRMSN "delta Winkel KR Abstand zur gemittelten Sp‰tverstellung" CURVE 0x4ED104 KlAUbSstUbWUb 191.3 zw_ub_qn0p75 -191.3 0.00 FORMAT "%5.1"
 /begin AXIS_DESCR STD_AXIS nmot nmot_ub_q40 16 0.00 10200. FORMAT "%5.0" DEPOSIT ABSOLUTE /end AXIS_DESCR
/end CHARACTERISTIC
/begin CHARACTERISTIC DYADMX "Max. Wert des add. Dynamikvorhalts" VALUE 0x4E5710 KwUb 24.00 zw_ub_qn0p75 -24.00 0.00 FORMAT "%5.2" /end CHARACTERISTIC
/begin CHARACTERISTIC DYAFVS "Stufenhˆhe f¸r Abregelung des Dynamikvorhalts" VALUE 0x4E5711 KwUb 19.50 zw_ub_q0p75 0.7500 20.25 FORMAT "%5.2" /end CHARACTERISTIC
/begin CHARACTERISTIC DYAMNV "Min. Wert des add. Dynamikvorhalts" VALUE 0x4E5712 KwUb 24.00 zw_ub_qn0p75 -24.00 0.00 FORMAT "%5.2" /end CHARACTERISTIC
/begin CHARACTERISTIC DYAVF "Abregelkonstante f¸r Dynamikvorhalt" VALUE 0x4E5713 KwUb 254.0 dez 1.000 255.0 FORMAT "%5.1" /end CHARACTERISTIC
/begin CHARACTERISTIC DZWMRMX "" VALUE 0x4E59DE KwSb 191.3 zw_sb_q0p75 -96.00 95.25 FORMAT "%5.2" /end CHARACTERISTIC
/begin CHARACTERISTIC ETADZW "ZW-Wirkungsgrad in Abh‰ngigkeit von delta ZW" CURVE 0x4E4BCC FklWUb 127.5 rel_ub_b127p5 0.00 127.5 FORMAT "%5.1"
 /begin AXIS_DESCR FIX_AXIS dzwg zw_sb_q0p75 128 0.00 95.25 FORMAT "%5.2" FIX_AXIS_PAR 0 0 128 /end AXIS_DESCR
/end CHARACTERISTIC
/begin CHARACTERISTIC FABSTT "Faktor Abstellzeit f¸r Modelltemparatur" CURVE 0x4EC61C KlAUwSstUwWUw 1.999969 fak_uw_b2 0.00 1.999969 FORMAT "%8.6"
 /begin AXIS_DESCR STD_AXIS tabst_w t1sxs_uw_q1 5 0.00 65535.00 FORMAT "%8.2" DEPOSIT ABSOLUTE /end AXIS_DESCR
/end CHARACTERISTIC
/begin CHARACTERISTIC FAKIBTS "Umrechnungsfaktor UIsens -> Ibts" VALUE 0x4ECAA6 KwUw 20.00000 fak_i_bts 0.00 20.00000 FORMAT "%8.5" /end CHARACTERISTIC
/begin CHARACTERISTIC FBSTABGM "Faktor Bauteileschutz abh‰ngig von model. Abgastemperatur" CURVE 0x4E4D5C KlAUwSstUwWUw 1.999969 fak_uw_b2 0.00 1.999969 FORMAT "%8.6"
 /begin AXIS_DESCR STD_AXIS tabgm_w temp_uw_q0p0195_o50 4 -50.00000 1229.980 FORMAT "%8.3" DEPOSIT ABSOLUTE /end AXIS_DESCR
/end CHARACTERISTIC
/begin CHARACTERISTIC FKELDY "Korrekturfaktor f¸r Klopferkennungsschwelle bei Lastdynamik" VALUE 0x4E5992 KwUb 2.000 fak_ub_b4 0.00 2.000 FORMAT "%5.3" /end CHARACTERISTIC
/begin CHARACTERISTIC FKELDYA "Korrekturfaktor f¸r Klopferkennungsschwelle bei Lastdynamikadaption" VALUE 0x4E5714 KwUb 0.6250 fak_ub_b4 0.6250 1.250 FORMAT "%5.3" /end CHARACTERISTIC
/begin CHARACTERISTIC FKENDY "Korrekturfaktor f¸r Klopferkennungsschwelle bei Drehzahldynamik" VALUE 0x4E5993 KwUb 2.000 fak_ub_b4 0.00 2.000 FORMAT "%5.3" /end CHARACTERISTIC
/begin CHARACTERISTIC FKETM "Klopferkennungsfaktor unterhalb tmot-Schwelle" CURVE 0x4E5984 KlAxU8SstxU16WU16 3.984375 fak_ub_b4 0.00 3.984375 FORMAT "%8.6"
 /begin AXIS_DESCR STD_AXIS tmotzyl_w temp_ub_q0p75_o48 3 -48.00000 49103.25 FORMAT "%8.2" DEPOSIT ABSOLUTE /end AXIS_DESCR
/end CHARACTERISTIC
/begin CHARACTERISTIC FKVAUM "Umrechnungsfaktor Einspritzzeit in Kraftstoffverbrauch" VALUE 0x4E96FE KwWU16 312.5000 tefuel_uw_b312p5 0.00 312.5000 FORMAT "%8.4" /end CHARACTERISTIC
/begin CHARACTERISTIC FMDKHFH "Hˆhenkorrektur Drehmomentenreserve f¸r Katheizen" CURVE 0x4ECBF0 KlAUwSstUwWUw 1.999969 fak_uw_b2 0.00 1.999969 FORMAT "%8.6"
 /begin AXIS_DESCR STD_AXIS fho_w fak_uw_b4 4 0.00 3.999939 FORMAT "%8.6" DEPOSIT ABSOLUTE /end AXIS_DESCR
/end CHARACTERISTIC
/begin CHARACTERISTIC FMDKHTMST "tmst-Korrektur Drehmomentenresrve f¸r Katheizen" CURVE 0x4ECBDC KlAUbSstUbWUb 1.992 fak_ub_b2 0.00 1.992 FORMAT "%5.3"
 /begin AXIS_DESCR STD_AXIS tmst temp_ub_q0p75_o48 8 -48.00 143.3 FORMAT "%5.1" DEPOSIT ABSOLUTE /end AXIS_DESCR
/end CHARACTERISTIC
/begin CHARACTERISTIC FNSNF "Faktor f¸r Solldrehzahlnachf¸hrung" VALUE 0x4E5A1E KwUb 0.9961 rel_ub_b1p0 0.00 0.9961 /end CHARACTERISTIC
/begin CHARACTERISTIC FNSNFT "Faktor f¸r Solldrehzahlnachf¸hrung gedrosselt" VALUE 0x4E5A1F KwUb 0.9961 rel_ub_b1p0 0.00 0.9961 /end CHARACTERISTIC
/begin CHARACTERISTIC FNSSTM "Faktor zur Wichtung der Solldrehzahl im Start" CURVE 0x4ED6EC KlAUbSstUbWUb 1.992 fak_ub_b2 0.00 1.992 FORMAT "%5.3"
 /begin AXIS_DESCR STD_AXIS tmot temp_ub_q0p75_o48 6 -48.00 143.3 FORMAT "%5.1" DEPOSIT ABSOLUTE /end AXIS_DESCR
/end CHARACTERISTIC
/begin CHARACTERISTIC FNSSTMT "Faktor zur Wichtung der Solldrehzahl im Start gedrosselt" CURVE 0x4ED6FC KlAUbSstUbWUb 1.992 fak_ub_b2 0.00 1.992 FORMAT "%5.3"
 /begin AXIS_DESCR STD_AXIS tmot temp_ub_q0p75_o48 6 -48.00 143.3 FORMAT "%5.1" DEPOSIT ABSOLUTE /end AXIS_DESCR
/end CHARACTERISTIC
/begin CHARACTERISTIC FQML "PWM-Taktfrequenz fuer Motorluefteransteuerung" VALUE 0x4E51DA KwUw 2000.000 freq_q1 0.00 2000.000 FORMAT "%8.3" /end CHARACTERISTIC
/begin CHARACTERISTIC FSTMOTMN "Minimale Fehlerschwelle tmot" VALUE 0x4EC5DA KwUb 191.3 temp_ub_q0p75_o48 -48.00 143.3 FORMAT "%5.1" /end CHARACTERISTIC
/begin CHARACTERISTIC FSTMOTMX "Maximale Fehlerschwelle tmot" VALUE 0x4EC5DB KwUb 191.3 temp_ub_q0p75_o48 -48.00 143.3 FORMAT "%5.1" /end CHARACTERISTIC
/begin CHARACTERISTIC FSTZYLMN "Fehlerschwelle f¸r Min-Fehler, Zylinderkopftemperatur" VALUE 0x4EC72C KwUw 49151.25 temp_ub_q0p75_o48 -48.00000 49103.25 FORMAT "%8.2" /end CHARACTERISTIC
/begin CHARACTERISTIC FSTZYLMX "Fehlerschwelle f¸r Max-Fehler, Zylinderkopftomperatur" VALUE 0x4EC72E KwUw 49151.25 temp_ub_q0p75_o48 -48.00000 49103.25 FORMAT "%8.2" /end CHARACTERISTIC
/begin CHARACTERISTIC IIEKPMAX "Auslˆsestromquadrat BTS Ekp" VALUE 0x4ECAA8 KwUw 99.98322 ii_uw_b2621 0.00 99.98322 FORMAT "%8.4" /end CHARACTERISTIC
/begin CHARACTERISTIC IISYSMAX "Auslˆsestromquadrat BTS System" VALUE 0x4ECAAA KwUw 149.9939 ii_uw_b2621 0.00 149.9939 FORMAT "%8.4" /end CHARACTERISTIC
/begin CHARACTERISTIC IIZDGMAX "Auslˆsestromquadrat BTS Z¸ndung" VALUE 0x4ECAAC KwUw 169.9829 ii_uw_b2621 0.00 169.9829 FORMAT "%8.4" /end CHARACTERISTIC
/begin CHARACTERISTIC IMLLASKH "imlpr-Schwelle f¸r ‹bergang auf Lambda-Abgas-Vorgabe" VALUE 0x4ECDB2 KwUb 0.9961 fak_ub_b1 0.00 0.9961 /end CHARACTERISTIC
/begin CHARACTERISTIC KE1NL "Klopferkennungsschwelle bei Zylinderz‰hler 1 f(n,rl)" MAP 0x4E5744 GkfWU8 3.984 fak_ub_b4 0.00 3.984 FORMAT "%5.3"
 /begin AXIS_DESCR COM_AXIS nmot nmot_ub_q40 16 0.00 10200. AXIS_PTS_REF SNM16KRUB /end AXIS_DESCR
 /begin AXIS_DESCR COM_AXIS rl rel_ub_q0p75 4 0.00 191.3 AXIS_PTS_REF SRL04KRUB /end AXIS_DESCR
/end CHARACTERISTIC
/begin CHARACTERISTIC KE2NL "Klopferkennungsschwelle bei Zylinderz‰hler 2 f(n,rl)" MAP 0x4E5784 GkfWU8 3.984 fak_ub_b4 0.00 3.984 FORMAT "%5.3"
 /begin AXIS_DESCR COM_AXIS nmot nmot_ub_q40 16 0.00 10200. AXIS_PTS_REF SNM16KRUB /end AXIS_DESCR
 /begin AXIS_DESCR COM_AXIS rl rel_ub_q0p75 4 0.00 191.3 AXIS_PTS_REF SRL04KRUB /end AXIS_DESCR
/end CHARACTERISTIC
/begin CHARACTERISTIC KE3NL "Klopferkennungsschwelle bei Zylinderz‰hler 3 f(n,rl)" MAP 0x4E57C4 GkfWU8 3.984 fak_ub_b4 0.00 3.984 FORMAT "%5.3"
 /begin AXIS_DESCR COM_AXIS nmot nmot_ub_q40 16 0.00 10200. AXIS_PTS_REF SNM16KRUB /end AXIS_DESCR
 /begin AXIS_DESCR COM_AXIS rl rel_ub_q0p75 4 0.00 191.3 AXIS_PTS_REF SRL04KRUB /end AXIS_DESCR
/end CHARACTERISTIC
/begin CHARACTERISTIC KE4NL "Klopferkennungsschwelle bei Zylinderz‰hler 4 f(n,rl)" MAP 0x4E5804 GkfWU8 3.984 fak_ub_b4 0.00 3.984 FORMAT "%5.3"
 /begin AXIS_DESCR COM_AXIS nmot nmot_ub_q40 16 0.00 10200. AXIS_PTS_REF SNM16KRUB /end AXIS_DESCR
 /begin AXIS_DESCR COM_AXIS rl rel_ub_q0p75 4 0.00 191.3 AXIS_PTS_REF SRL04KRUB /end AXIS_DESCR
/end CHARACTERISTIC
/begin CHARACTERISTIC KE5NL "Klopferkennungsschwelle bei Zylinderz‰hler 5 f(n,rl)" MAP 0x4E5844 GkfWU8 3.984 fak_ub_b4 0.00 3.984 FORMAT "%5.3"
 /begin AXIS_DESCR COM_AXIS nmot nmot_ub_q40 16 0.00 10200. AXIS_PTS_REF SNM16KRUB /end AXIS_DESCR
 /begin AXIS_DESCR COM_AXIS rl rel_ub_q0p75 4 0.00 191.3 AXIS_PTS_REF SRL04KRUB /end AXIS_DESCR
/end CHARACTERISTIC
/begin CHARACTERISTIC KE6NL "Klopferkennungsschwelle bei Zylinderz‰hler 6 f(n,rl)" MAP 0x4E5884 GkfWU8 3.984 fak_ub_b4 0.00 3.984 FORMAT "%5.3"
 /begin AXIS_DESCR COM_AXIS nmot nmot_ub_q40 16 0.00 10200. AXIS_PTS_REF SNM16KRUB /end AXIS_DESCR
 /begin AXIS_DESCR COM_AXIS rl rel_ub_q0p75 4 0.00 191.3 AXIS_PTS_REF SRL04KRUB /end AXIS_DESCR
/end CHARACTERISTIC
/begin CHARACTERISTIC KE7NL "Klopferkennungsschwelle bei Zylinderz‰hler 7 f(n,rl)" MAP 0x4E58C4 GkfWU8 3.984 fak_ub_b4 0.00 3.984 FORMAT "%5.3"
 /begin AXIS_DESCR COM_AXIS nmot nmot_ub_q40 16 0.00 10200. AXIS_PTS_REF SNM16KRUB /end AXIS_DESCR
 /begin AXIS_DESCR COM_AXIS rl rel_ub_q0p75 4 0.00 191.3 AXIS_PTS_REF SRL04KRUB /end AXIS_DESCR
/end CHARACTERISTIC
/begin CHARACTERISTIC KE8NL "Klopferkennungsschwelle bei Zylinderz‰hler 8 f(n,rl)" MAP 0x4E5904 GkfWU8 3.984 fak_ub_b4 0.00 3.984 FORMAT "%5.3"
 /begin AXIS_DESCR COM_AXIS nmot nmot_ub_q40 16 0.00 10200. AXIS_PTS_REF SNM16KRUB /end AXIS_DESCR
 /begin AXIS_DESCR COM_AXIS rl rel_ub_q0p75 4 0.00 191.3 AXIS_PTS_REF SRL04KRUB /end AXIS_DESCR
/end CHARACTERISTIC
/begin CHARACTERISTIC KEREFF "Tiefpassverhalten normal" CURVE 0x4ED4A8 KlAUbSstUbWUb 99.61 rel_ub_b100 0.3922 100.0 FORMAT "%5.1"
 /begin AXIS_DESCR STD_AXIS nmot nmot_ub_q40 6 0.00 10200. FORMAT "%5.0" DEPOSIT ABSOLUTE /end AXIS_DESCR
/end CHARACTERISTIC
/begin CHARACTERISTIC KEREFLDY "Tiefpassverhalten bei Lastdynamik" CURVE 0x4ED4B8 KlAUbSstUbWUb 99.61 rel_ub_b100 0.3922 100.0 FORMAT "%5.1"
 /begin AXIS_DESCR STD_AXIS nmot nmot_ub_q40 6 0.00 10200. FORMAT "%5.0" DEPOSIT ABSOLUTE /end AXIS_DESCR
/end CHARACTERISTIC
/begin CHARACTERISTIC KEREFNDY "Tiefpassverhalten bei Drehzahldynamik" CURVE 0x4ED4C8 KlAUbSstUbWUb 99.61 rel_ub_b100 0.3922 100.0 FORMAT "%5.1"
 /begin AXIS_DESCR STD_AXIS nmot nmot_ub_q40 6 0.00 10200. FORMAT "%5.0" DEPOSIT ABSOLUTE /end AXIS_DESCR
/end CHARACTERISTIC
/begin CHARACTERISTIC KFBS "Kennfeld f¸r banksel. Gemischfaktor" MAP 0x4E48E8 KfAxUbAyUbSstxUbSstyUbWSb 0.4980 fak_sb_b0p25 -0.2500 0.2480
 /begin AXIS_DESCR STD_AXIS nmot nmot_ub_q40 16 0.00 10200. FORMAT "%5.0" DEPOSIT ABSOLUTE /end AXIS_DESCR
 /begin AXIS_DESCR STD_AXIS rl rel_ub_q0p75 16 0.00 191.3 FORMAT "%5.1" DEPOSIT ABSOLUTE /end AXIS_DESCR
/end CHARACTERISTIC
/begin CHARACTERISTIC KFDTMTE "Kennfeld Motortemperaturgradient f¸r Ersatztemperatur" MAP 0x4EC632 KfAxUbAyUbSstxUbSstyUbWSb 0.1868 temp_sb_b0p093 -0.09375 0.09302 FORMAT "%7.5"
 /begin AXIS_DESCR STD_AXIS mll1 m_ub_b1020 5 0.00 1020. FORMAT "%5.0" DEPOSIT ABSOLUTE /end AXIS_DESCR
 /begin AXIS_DESCR STD_AXIS tmew temp_ub_q0p75_o48 4 -48.00 143.3 FORMAT "%5.1" DEPOSIT ABSOLUTE /end AXIS_DESCR
/end CHARACTERISTIC
/begin CHARACTERISTIC KFDTMTR "Kennfeld Motortemperaturgradient f¸r Referenztemperatur" MAP 0x4EC651 KfAxUbAyUbSstxUbSstyUbWSb 0.1868 temp_sb_b0p093 -0.09375 0.09302 FORMAT "%7.5"
 /begin AXIS_DESCR STD_AXIS mll1 m_ub_b1020 5 0.00 1020. FORMAT "%5.0" DEPOSIT ABSOLUTE /end AXIS_DESCR
 /begin AXIS_DESCR STD_AXIS tmrw temp_ub_q0p75_o48 4 -48.00 143.3 FORMAT "%5.1" DEPOSIT ABSOLUTE /end AXIS_DESCR
/end CHARACTERISTIC
/begin CHARACTERISTIC KFDYES "Lastdynamikerkennungsschwelle" MAP 0x4E5590 GkfWS16 799.9756 relDK_q0p02441 0.00 799.9756 FORMAT "%8.4"
 /begin AXIS_DESCR COM_AXIS nmot_w nmot_uw_q0p25 8 0.00 16383.75 AXIS_PTS_REF SNM08KRUW /end AXIS_DESCR
 /begin AXIS_DESCR COM_AXIS wdkba_w relDK_q0p02441 6 -800.0000 799.9756 AXIS_PTS_REF SWD06KRSW /end AXIS_DESCR
/end CHARACTERISTIC
/begin CHARACTERISTIC KFDYESEH "Lastdynamikerkennungsschwelle" MAP 0x4E55F0 GkfWS16 32.76700 hub_uw_q0p001 0.00 32.76700 FORMAT "%8.5"
 /begin AXIS_DESCR COM_AXIS nmot_w nmot_uw_q0p25 8 0.00 16383.75 AXIS_PTS_REF SNM08KRUW /end AXIS_DESCR
 /begin AXIS_DESCR COM_AXIS evhubi_w hub_uw_q0p001 6 -32.76800 32.76700 AXIS_PTS_REF SEH06KRUW /end AXIS_DESCR
/end CHARACTERISTIC
/begin CHARACTERISTIC KFDYESEHOF "Dynamikvorhalt Offsetschwelle" MAP 0x4E5650 GkfWS16 32.76700 hub_uw_q0p001 0.00 32.76700 FORMAT "%8.5"
 /begin AXIS_DESCR COM_AXIS nmot_w nmot_uw_q0p25 8 0.00 16383.75 AXIS_PTS_REF SNM08KRUW /end AXIS_DESCR
 /begin AXIS_DESCR COM_AXIS evhubi_w hub_uw_q0p001 6 -32.76800 32.76700 AXIS_PTS_REF SEH06KRUW /end AXIS_DESCR
/end CHARACTERISTIC
/begin CHARACTERISTIC KFDYESOF "Dynamikvorhalt Offsetschwelle" MAP 0x4E56B0 GkfWS16 799.9756 relDK_q0p02441 0.00 799.9756 FORMAT "%8.4"
 /begin AXIS_DESCR COM_AXIS nmot_w nmot_uw_q0p25 8 0.00 16383.75 AXIS_PTS_REF SNM08KRUW /end AXIS_DESCR
 /begin AXIS_DESCR COM_AXIS wdkba_w relDK_q0p02441 6 -800.0000 799.9756 AXIS_PTS_REF SWD06KRSW /end AXIS_DESCR
/end CHARACTERISTIC
/begin CHARACTERISTIC KFDYWVS "vorgesteuerter Dynamikvorhalt" MAP 0x4ED04C KfAxUbAyUbSstxUbSstyUbWUb 191.3 zw_ub_qn0p75 -191.3 0.00 FORMAT "%5.1"
 /begin AXIS_DESCR STD_AXIS tans temp_ub_q0p75_o48 6 -48.00 143.3 FORMAT "%5.1" DEPOSIT ABSOLUTE /end AXIS_DESCR
 /begin AXIS_DESCR STD_AXIS nmot nmot_ub_q40 6 0.00 10200. FORMAT "%5.0" DEPOSIT ABSOLUTE /end AXIS_DESCR
/end CHARACTERISTIC
/begin CHARACTERISTIC KFFDLBTS "Faktor Delta Lambdasoll f¸r Bauteileschutz" MAP 0x4EC07C GkfWUb 1.992 fak_ub_b2 0.00 1.992 FORMAT "%5.3"
 /begin AXIS_DESCR COM_AXIS rl rel_ub_q0p75 12 0.00 191.3 AXIS_PTS_REF SRL12GKUB /end AXIS_DESCR
 /begin AXIS_DESCR COM_AXIS nmot nmot_ub_q40 16 0.00 10200. AXIS_PTS_REF SNM16GKUB /end AXIS_DESCR
/end CHARACTERISTIC
/begin CHARACTERISTIC KFKTM "" MAP 0x4E4A0C KfAxU8AyU8SstxU16SstyU16WU16 1.992188 fak_ub_b2 0.00 1.992188 FORMAT "%8.6"
 /begin AXIS_DESCR STD_AXIS tabgmab temp_ub_q5_o50 6 -50.00000 1225.000 FORMAT "%8.3" DEPOSIT ABSOLUTE /end AXIS_DESCR
 /begin AXIS_DESCR STD_AXIS tabst_w t1sxs_uw_q1 6 0.00 65535.00 FORMAT "%8.2" DEPOSIT ABSOLUTE /end AXIS_DESCR
/end CHARACTERISTIC
/begin CHARACTERISTIC KFKTM2 "" MAP 0x4E4AD4 KfAxU8AyU8SstxU8SstyU8WU8 1.992 fak_ub_b2 0.00 1.992 FORMAT "%5.3"
 /begin AXIS_DESCR STD_AXIS vfzg vfzg_ub_q1p25 6 0.00 318.8 FORMAT "%5.1" DEPOSIT ABSOLUTE /end AXIS_DESCR
 /begin AXIS_DESCR STD_AXIS taml rel_ub_b100 6 0.00 100.0 FORMAT "%5.1" DEPOSIT ABSOLUTE /end AXIS_DESCR
/end CHARACTERISTIC
/begin CHARACTERISTIC KFKWTMP "Kennfeld Drehmomentenreserve f¸r Kat warmhalten, zeitweise" MAP 0x4ECC02 KfAxUwAyUwSstxUwSstyUwWUw 99.99847 rel_uw_b100 0.00 99.99847 FORMAT "%8.5"
 /begin AXIS_DESCR STD_AXIS nmot_w nmot_uw_q0p25 4 0.00 16383.75 FORMAT "%8.2" DEPOSIT ABSOLUTE /end AXIS_DESCR
 /begin AXIS_DESCR STD_AXIS mifakh_w rel_uw_b100 4 0.00 99.99847 FORMAT "%8.5" DEPOSIT ABSOLUTE /end AXIS_DESCR
/end CHARACTERISTIC
/begin CHARACTERISTIC KFLAMFA "Kennfeld Lambda Fahrerwunsch" MAP 0x4EC228 KfAxUbAyUbSstxUbSstyUbWUb 1.992 fak_ub_b2 0.00 1.992 FORMAT "%5.3"
 /begin AXIS_DESCR STD_AXIS nmot nmot_ub_q40 12 0.00 10200. FORMAT "%5.0" DEPOSIT ABSOLUTE /end AXIS_DESCR
 /begin AXIS_DESCR STD_AXIS rl rel_ub_q0p75 16 0.00 191.3 FORMAT "%5.1" DEPOSIT ABSOLUTE /end AXIS_DESCR
/end CHARACTERISTIC
/begin CHARACTERISTIC KFLANSKH "Kennfeld Lambda-Motor-Vorgabe bei Katheizen im Nachstart" MAP 0x4ECDC8 KfAxUwAyUwSstxUwSstyUwWUw 15.89990 fak_q0p000244 0.09985352 15.99976 FORMAT "%8.5"
 /begin AXIS_DESCR STD_AXIS tmstzyl_w temp_ub_q0p75_o48 6 -48.00000 49103.25 FORMAT "%8.2" DEPOSIT ABSOLUTE /end AXIS_DESCR
 /begin AXIS_DESCR STD_AXIS anztib_w dez 12 0.00 65535.00 FORMAT "%8.2" DEPOSIT ABSOLUTE /end AXIS_DESCR
/end CHARACTERISTIC
/begin CHARACTERISTIC KFLASKH "Kennfeld Lambda-Abgas-Soll bei Katheizen" MAP 0x4ECE80 KfAxUwAyUwSstxUwSstyUwWUw 15.99976 fak_q0p000244 0.00 15.99976 FORMAT "%8.5"
 /begin AXIS_DESCR STD_AXIS nmot_w nmot_uw_q0p25 8 0.00 16383.75 FORMAT "%8.2" DEPOSIT ABSOLUTE /end AXIS_DESCR
 /begin AXIS_DESCR STD_AXIS rl_w rel_uw_q0p0234 8 0.00 1535.977 FORMAT "%8.3" DEPOSIT ABSOLUTE /end AXIS_DESCR
/end CHARACTERISTIC
/begin CHARACTERISTIC KFLBTS "Lambdasoll f¸r Bauteileschutz" MAP 0x4EC13C GkfWUb 1.992 fak_ub_b2 0.00 1.992 FORMAT "%5.3"
 /begin AXIS_DESCR COM_AXIS rl rel_ub_q0p75 12 0.00 191.3 AXIS_PTS_REF SRL12GKUB /end AXIS_DESCR
 /begin AXIS_DESCR COM_AXIS nmot nmot_ub_q40 16 0.00 10200. AXIS_PTS_REF SNM16GKUB /end AXIS_DESCR
/end CHARACTERISTIC
/begin CHARACTERISTIC KFLMSKH "Kennfeld Lambda-Motor-Soll bei Katheizen" MAP 0x4ECF24 KfAxUwAyUwSstxUwSstyUwWUw 15.99976 fak_q0p000244 0.00 15.99976 FORMAT "%8.5"
 /begin AXIS_DESCR STD_AXIS nmot_w nmot_uw_q0p25 8 0.00 16383.75 FORMAT "%8.2" DEPOSIT ABSOLUTE /end AXIS_DESCR
 /begin AXIS_DESCR STD_AXIS rl_w rel_uw_q0p0234 8 0.00 1535.977 FORMAT "%8.3" DEPOSIT ABSOLUTE /end AXIS_DESCR
/end CHARACTERISTIC
/begin CHARACTERISTIC KFMDDSLA "Kennfeld Drehmomentenreserve bei Testereingriff Sekund‰rluftdiagnose" MAP 0x4ECC36 KfAxUwAyUwSstxUwSstyUwWUw 99.99847 rel_uw_b100 0.00 99.99847 FORMAT "%8.5"
 /begin AXIS_DESCR STD_AXIS nmot_w nmot_uw_q0p25 4 0.00 16383.75 FORMAT "%8.2" DEPOSIT ABSOLUTE /end AXIS_DESCR
 /begin AXIS_DESCR STD_AXIS mifakh_w rel_uw_b100 4 0.00 99.99847 FORMAT "%8.5" DEPOSIT ABSOLUTE /end AXIS_DESCR
/end CHARACTERISTIC
/begin CHARACTERISTIC KFMDKH "Kennfeld Drehmomentenreserve f¸r Katheizen" MAP 0x4ECC6A KfAxUwAyUwSstxUwSstyUwWUw 99.99847 rel_uw_b100 0.00 99.99847 FORMAT "%8.5"
 /begin AXIS_DESCR STD_AXIS nmot_w nmot_uw_q0p25 8 0.00 16383.75 FORMAT "%8.2" DEPOSIT ABSOLUTE /end AXIS_DESCR
 /begin AXIS_DESCR STD_AXIS mifakh_w rel_uw_b100 8 0.00 99.99847 FORMAT "%8.5" DEPOSIT ABSOLUTE /end AXIS_DESCR
/end CHARACTERISTIC
/begin CHARACTERISTIC KFMDKHLL "Kennfeld Drehmomentenreserve f¸r Katheizen bei LL" MAP 0x4ECD0E KfAxUwAyUwSstxUwSstyUwWUw 99.99847 rel_uw_b100 0.00 99.99847 FORMAT "%8.5"
 /begin AXIS_DESCR STD_AXIS nmot_w nmot_uw_q0p25 8 0.00 16383.75 FORMAT "%8.2" DEPOSIT ABSOLUTE /end AXIS_DESCR
 /begin AXIS_DESCR STD_AXIS mifakh_w rel_uw_b100 8 0.00 99.99847 FORMAT "%8.5" DEPOSIT ABSOLUTE /end AXIS_DESCR
/end CHARACTERISTIC
/begin CHARACTERISTIC KFMRES "LLR: Basis Momentenreserve im LL und ll-nahem Bereich" MAP 0x4E5B68 GkfWUb 24.90 rel_ub_b24p9 0.00 24.90 FORMAT "%5.2"
 /begin AXIS_DESCR COM_AXIS dns nmotd_sb_q10 6 -1280. 1270. AXIS_PTS_REF SNS06LLSB /end AXIS_DESCR
 /begin AXIS_DESCR COM_AXIS tans temp_ub_q0p75_o48 4 -48.00 143.3 AXIS_PTS_REF STA04SAUB /end AXIS_DESCR
/end CHARACTERISTIC
/begin CHARACTERISTIC KFMRESFS "LLR: Basis Momentenreserve im LL und LL-nahem Bereich bei B_fs=1" MAP 0x4E5B80 GkfWUb 24.90 rel_ub_b24p9 0.00 24.90 FORMAT "%5.2"
 /begin AXIS_DESCR COM_AXIS dns nmotd_sb_q10 6 -1280. 1270. AXIS_PTS_REF SNS06LLSB /end AXIS_DESCR
 /begin AXIS_DESCR COM_AXIS tans temp_ub_q0p75_o48 4 -48.00 143.3 AXIS_PTS_REF STA04SAUB /end AXIS_DESCR
/end CHARACTERISTIC
/begin CHARACTERISTIC KFMRESFST "" MAP 0x4E5B98 GkfWUb 24.90 rel_ub_b24p9 0.00 24.90 FORMAT "%5.2"
 /begin AXIS_DESCR COM_AXIS dns nmotd_sb_q10 6 -1280. 1270. AXIS_PTS_REF SNS06LLSB /end AXIS_DESCR
 /begin AXIS_DESCR COM_AXIS tmot temp_ub_q0p75_o48 4 -48.00 143.3 AXIS_PTS_REF STM04SAUB /end AXIS_DESCR
/end CHARACTERISTIC
/begin CHARACTERISTIC KFMREST "" MAP 0x4E5BB0 GkfWUb 24.90 rel_ub_b24p9 0.00 24.90 FORMAT "%5.2"
 /begin AXIS_DESCR COM_AXIS dns nmotd_sb_q10 6 -1280. 1270. AXIS_PTS_REF SNS06LLSB /end AXIS_DESCR
 /begin AXIS_DESCR COM_AXIS tmot temp_ub_q0p75_o48 4 -48.00 143.3 AXIS_PTS_REF STM04SAUB /end AXIS_DESCR
/end CHARACTERISTIC
/begin CHARACTERISTIC KFTMOKOR "" MAP 0x4E4B08 KfAxU8AyU8SstxU8SstyU8WU8 191.3 temp_ub_q0p75_o48 -48.00 143.3 FORMAT "%5.1"
 /begin AXIS_DESCR STD_AXIS tmot temp_ub_q0p75_o48 9 -48.00 143.3 FORMAT "%5.1" DEPOSIT ABSOLUTE /end AXIS_DESCR
 /begin AXIS_DESCR STD_AXIS nmot nmot_ub_q40 9 0.00 10200. FORMAT "%5.0" DEPOSIT ABSOLUTE /end AXIS_DESCR
/end CHARACTERISTIC
/begin CHARACTERISTIC KFZKTMTKR "Kennfeld f¸r Zeitkonstante PT1-Filterung tkrst" MAP 0x4E4A70 KfAxU8AyU8SstxU16SstyU16WU16 6553.500 t100msxs_uw_b6553p5 0.00 6553.500 FORMAT "%8.3"
 /begin AXIS_DESCR STD_AXIS tnst_w t10msxs_uw_b655p35 6 0.00 655.3500 FORMAT "%8.4" DEPOSIT ABSOLUTE /end AXIS_DESCR
 /begin AXIS_DESCR STD_AXIS vsskrst fuel_ub_q1 6 0.00 65535.00 FORMAT "%8.2" DEPOSIT ABSOLUTE /end AXIS_DESCR
/end CHARACTERISTIC
/begin CHARACTERISTIC KFZWOBTS "optimaler Z¸ndwinkel Bauteileschutz" MAP 0x4E4C4C GkfWSb 191.3 zw_sb_q0p75 -96.00 95.25 FORMAT "%5.2"
 /begin AXIS_DESCR COM_AXIS nmot_w nmot_uw_q0p25 16 0.00 16383.75 AXIS_PTS_REF SNM16OPUW /end AXIS_DESCR
 /begin AXIS_DESCR COM_AXIS rl_w_kge rel_uw_q0p0234 16 0.00 1535.977 AXIS_PTS_REF SRL16OPUW /end AXIS_DESCR
/end CHARACTERISTIC
/begin CHARACTERISTIC KLBTSVL "Rover" CURVE 0x4EC1FC GklWUb 1.992 fak_ub_b2 0.00 1.992 FORMAT "%5.3"
 /begin AXIS_DESCR COM_AXIS nmot nmot_ub_q40 16 0.00 10200. AXIS_PTS_REF SNM16GKUB /end AXIS_DESCR
/end CHARACTERISTIC
/begin CHARACTERISTIC KLDTMRS "Kennlinie Motortemperatur-Gradient im Schub f¸r Referenzmodell" CURVE 0x4EC670 KlAUbSstUbWSb 0.1868 temp_sb_b0p093 -0.09375 0.09302 FORMAT "%7.5"
 /begin AXIS_DESCR STD_AXIS tmrw temp_ub_q0p75_o48 5 -48.00 143.3 FORMAT "%5.1" DEPOSIT ABSOLUTE /end AXIS_DESCR
/end CHARACTERISTIC
/begin CHARACTERISTIC KLKRMRLESS "" CURVE 0x4E599A KlAxU8SstxU16WS16 15.99976 fak_uw_b16 -8.000000 7.999756 FORMAT "%8.6"
 /begin AXIS_DESCR STD_AXIS nmot nmot_ub_q40 8 0.00 2621400. FORMAT "%8.0" DEPOSIT ABSOLUTE /end AXIS_DESCR
/end CHARACTERISTIC
/begin CHARACTERISTIC KLKRMRPLUS "" CURVE 0x4E59BC KlAxU8SstxU16WS16 15.99976 fak_uw_b16 -8.000000 7.999756 FORMAT "%8.6"
 /begin AXIS_DESCR STD_AXIS wkrm zw_ub_qn0p75 8 -49151.25 0.00 FORMAT "%8.2" DEPOSIT ABSOLUTE /end AXIS_DESCR
/end CHARACTERISTIC
/begin CHARACTERISTIC KLKRZWMR "" CURVE 0x4ED4D8 KlAUbSstUbWUw 6399.300 rel_q0p09726 0.00 6399.300 FORMAT "%8.3"
 /begin AXIS_DESCR STD_AXIS dwkrkorlls zw_ub_q0p75 8 0.00 191.3 FORMAT "%5.1" DEPOSIT ABSOLUTE /end AXIS_DESCR
/end CHARACTERISTIC
/begin CHARACTERISTIC KLLAKHFH "Umgebungsdruckkorrektur Lambda Katheizen" CURVE 0x4ECFC8 KlAUwSstUwWUw 1.999969 fak_uw_b2 0.00 1.999969 FORMAT "%8.6"
 /begin AXIS_DESCR STD_AXIS fho_w fak_uw_b4 4 0.00 3.999939 FORMAT "%8.6" DEPOSIT ABSOLUTE /end AXIS_DESCR
/end CHARACTERISTIC
/begin CHARACTERISTIC KLZWBSVL "Rover" CURVE 0x4E4D4C GklWSb 191.3 zw_sb_q0p75 -96.00 95.25 FORMAT "%5.2"
 /begin AXIS_DESCR COM_AXIS nmot_w nmot_uw_q0p25 16 0.00 16383.75 AXIS_PTS_REF SNM16OPUW /end AXIS_DESCR
/end CHARACTERISTIC
/begin CHARACTERISTIC KNSNF "Sperrband f¸r Solldrehzahlnachf¸hrung" VALUE 0x4E5A20 KwUb 2550. nmot_ub_q10 0.00 2550. FORMAT "%5.0" /end CHARACTERISTIC
/begin CHARACTERISTIC KNSNFT "Sperrband f¸r Solldrehzahlnachf¸hrung gedrosselt" VALUE 0x4E5A21 KwUb 2550. nmot_ub_q10 0.00 2550. FORMAT "%5.0" /end CHARACTERISTIC
/begin CHARACTERISTIC KRAL1N "Klopfregeladaption Lastbereich 1" CURVE 0x4ED128 KlAUbSstUbWUb 191.3 rel_ub_q0p75 0.00 191.3 FORMAT "%5.1"
 /begin AXIS_DESCR STD_AXIS nmot nmot_ub_q40 16 0.00 10200. FORMAT "%5.0" DEPOSIT ABSOLUTE /end AXIS_DESCR
/end CHARACTERISTIC
/begin CHARACTERISTIC KRAL2N "Klopfregeladaption Lastbereich 2" CURVE 0x4ED14C KlAUbSstUbWUb 191.3 rel_ub_q0p75 0.00 191.3 FORMAT "%5.1"
 /begin AXIS_DESCR STD_AXIS nmot nmot_ub_q40 16 0.00 10200. FORMAT "%5.0" DEPOSIT ABSOLUTE /end AXIS_DESCR
/end CHARACTERISTIC
/begin CHARACTERISTIC KRALH "Klopfregeladaption Lasthysterese" VALUE 0x4ED16D KwUb 191.3 rel_ub_q0p75 0.00 191.3 FORMAT "%5.1" /end CHARACTERISTIC
/begin CHARACTERISTIC KRAN1 "Klopfregeladaption Drehzahlbereich, St¸tzstelle 1" VALUE 0x4ED16E KwUb 10200. nmot_ub_q40 0.00 10200. FORMAT "%5.0" /end CHARACTERISTIC
/begin CHARACTERISTIC KRAN2 "Klopfregeladaption Drehzahlbereich, St¸tzstelle 2" VALUE 0x4ED16F KwUb 10200. nmot_ub_q40 0.00 10200. FORMAT "%5.0" /end CHARACTERISTIC
/begin CHARACTERISTIC KRAN3 "Klopfregeladaption Drehzahlbereich, St¸tzstelle 3" VALUE 0x4ED170 KwUb 10200. nmot_ub_q40 0.00 10200. FORMAT "%5.0" /end CHARACTERISTIC
/begin CHARACTERISTIC KRAN4 "Klopfregeladaption Drehzahlbereich, St¸tzstelle 4" VALUE 0x4ED171 KwUb 10200. nmot_ub_q40 0.00 10200. FORMAT "%5.0" /end CHARACTERISTIC
/begin CHARACTERISTIC KRANH "Klopfregeladaption Drehzahlhysterese" VALUE 0x4ED172 KwUb 10200. nmot_ub_q40 0.00 10200. FORMAT "%5.0" /end CHARACTERISTIC
/begin CHARACTERISTIC KRDWA "Klopfregelung Differenz aktueller ZW zu Adaptionskennfeld" VALUE 0x4E5738 KwUb 191.3 zw_ub_q0p75 0.00 191.3 FORMAT "%5.1" /end CHARACTERISTIC
/begin CHARACTERISTIC KRDWKLA "Der SV-Lernbetrag f¸r die KR-Adaption nach einem erkannten Klopfereignis" VALUE 0x4E5739 KwSb 12.00 zw_ub_qn0p75 -6.000 6.000 FORMAT "%5.3" /end CHARACTERISTIC
/begin CHARACTERISTIC KRDWSA "Der FV-Lernbetrag f¸r die KR-Adaption wenn wkra-wkr > KRDWA" VALUE 0x4E573A KwUb 6.000 zw_ub_q0p75 0.00 6.000 FORMAT "%5.3" /end CHARACTERISTIC
/begin CHARACTERISTIC KRDWSN "Klopfregelung delta - Winkel Sicherheit" CURVE 0x4ED174 KlAUbSstUbWUb 191.3 zw_ub_qn0p75 -191.3 0.00 FORMAT "%5.1"
 /begin AXIS_DESCR STD_AXIS nmot nmot_ub_q40 16 0.00 10200. FORMAT "%5.0" DEPOSIT ABSOLUTE /end AXIS_DESCR
/end CHARACTERISTIC
/begin CHARACTERISTIC KRFKN "Sp‰tverstellung pro Klopfereignis" CURVE 0x4ED198 KlAUbSstUbWUb 191.3 zw_ub_qn0p75 -191.3 0.00 FORMAT "%5.1"
 /begin AXIS_DESCR STD_AXIS nmot nmot_ub_q40 16 0.00 10200. FORMAT "%5.0" DEPOSIT ABSOLUTE /end AXIS_DESCR
/end CHARACTERISTIC
/begin CHARACTERISTIC KRKFKS "Zuordnung der Kloperkennungskennlinie bei fehlender Zyl.-1-Erkennung" VALUE 0x4E5994 KwUb 255.0 dez 0.00 255.0 FORMAT "%5.1" /end CHARACTERISTIC
/begin CHARACTERISTIC KRLMDY "Lesen bei Lastbereichswechsel: immer oder nur bei Dynamik" VALUE 0x4E573B KwUb 1.000 dez 0.00 1.000 FORMAT "%5.3" /end CHARACTERISTIC
/begin CHARACTERISTIC KRMRMN "" VALUE 0x4E59DF KwUb 191.3 zw_ub_qn0p75 -191.3 0.00 FORMAT "%5.1" /end CHARACTERISTIC
/begin CHARACTERISTIC KRMXN "maximale Sp‰tverstellung" CURVE 0x4ED1BC KlAUbSstUbWUb 190.5 zw_ub_qn0p75 -191.3 -0.7500 FORMAT "%5.1"
 /begin AXIS_DESCR STD_AXIS nmot nmot_ub_q40 16 0.00 10200. FORMAT "%5.0" DEPOSIT ABSOLUTE /end AXIS_DESCR
/end CHARACTERISTIC
/begin CHARACTERISTIC KRNMDY "Lesen bei Drehzahlbereichswechsel: immer oder nur bei Dynamik" VALUE 0x4E573C KwUb 1.000 dez 0.00 1.000 FORMAT "%5.3" /end CHARACTERISTIC
/begin CHARACTERISTIC KRVFLN "Anz. Z¸nd./Zyl., bzw. Zeitangabe von Fr¸hverst. zu Fr¸hverst. (Stufenbreite-KR)" MAP 0x4ED1E0 KfAxUbAyUbSstxUbSstyUbWUb 254.0 dez 1.000 255.0 FORMAT "%5.1"
 /begin AXIS_DESCR STD_AXIS nmot nmot_ub_q40 16 0.00 10200. FORMAT "%5.0" DEPOSIT ABSOLUTE /end AXIS_DESCR
 /begin AXIS_DESCR STD_AXIS rl rel_ub_q0p75 12 0.00 191.3 FORMAT "%5.1" DEPOSIT ABSOLUTE /end AXIS_DESCR
/end CHARACTERISTIC
/begin CHARACTERISTIC KRVFSLN "Anzahl Z¸ndungen/Zyl., oder Zeitangabe f¸r schnelle Fr¸hverstellung der KR" MAP 0x4ED2C0 KfAxUbAyUbSstxUbSstyUbWUb 254.0 dez 1.000 255.0 FORMAT "%5.1"
 /begin AXIS_DESCR STD_AXIS nmot nmot_ub_q40 16 0.00 10200. FORMAT "%5.0" DEPOSIT ABSOLUTE /end AXIS_DESCR
 /begin AXIS_DESCR STD_AXIS rl rel_ub_q0p75 12 0.00 191.3 FORMAT "%5.1" DEPOSIT ABSOLUTE /end AXIS_DESCR
/end CHARACTERISTIC
/begin CHARACTERISTIC KRVST "Verst‰rkung nach Start" VALUE 0x4E5995 KwUb 6.000 dez 0.00 6.000 FORMAT "%5.3" /end CHARACTERISTIC
/begin CHARACTERISTIC KRZWOFF_NL "" MAP 0x4ED3A0 KfAxUbAyUbSstxUbSstyUbWUb 191.3 zw_ub_qn0p75 -191.3 0.00 FORMAT "%5.1"
 /begin AXIS_DESCR STD_AXIS nmot nmot_ub_q40 16 0.00 10200. FORMAT "%5.0" DEPOSIT ABSOLUTE /end AXIS_DESCR
 /begin AXIS_DESCR STD_AXIS rl rel_ub_q0p75 12 0.00 191.3 FORMAT "%5.1" DEPOSIT ABSOLUTE /end AXIS_DESCR
/end CHARACTERISTIC
/begin CHARACTERISTIC KSZA "Anzahl Klopfsensoren" VALUE 0x4E5996 KwUb 3.000 dez 1.000 4.000 FORMAT "%5.3" /end CHARACTERISTIC
/begin CHARACTERISTIC L9935_COIL_MODE "" VALUE 0x4E29B6 KwUb 255.0 dez 0.00 255.0 FORMAT "%5.1" /end CHARACTERISTIC
/begin CHARACTERISTIC L9935_ERR_STEPS "" VALUE 0x4E29B7 KwUb 255.0 dez 0.00 255.0 FORMAT "%5.1" /end CHARACTERISTIC
/begin CHARACTERISTIC LAMFAMAS "" CURVE 0x4EC308 KlAUbSstUbWUb 1.992 fak_ub_b2 0.00 1.992 FORMAT "%5.3"
 /begin AXIS_DESCR STD_AXIS nmot nmot_ub_q40 16 0.00 10200. FORMAT "%5.0" DEPOSIT ABSOLUTE /end AXIS_DESCR
/end CHARACTERISTIC
/begin CHARACTERISTIC LAMFAMAX "" VALUE 0x4EC329 KwUb 1.992 fak_ub_b2 0.00 1.992 FORMAT "%5.3" /end CHARACTERISTIC
/begin CHARACTERISTIC LAMFAVL "Lambdawunsch Vollast" CURVE 0x4EC32C KlAUbSstUbWUb 1.992 fak_ub_b2 0.00 1.992 FORMAT "%5.3"
 /begin AXIS_DESCR STD_AXIS nmot nmot_ub_q40 16 0.00 10200. FORMAT "%5.0" DEPOSIT ABSOLUTE /end AXIS_DESCR
/end CHARACTERISTIC
/begin CHARACTERISTIC LAMFB "" MAP 0x4EC34D KfAxUbAyUbSstxUbSstyUbWSb 3.984 fak_sb_b2 -2.000 1.984 FORMAT "%5.3"
 /begin AXIS_DESCR STD_AXIS nmot nmot_ub_q40 12 0.00 10200. FORMAT "%5.0" DEPOSIT ABSOLUTE /end AXIS_DESCR
 /begin AXIS_DESCR STD_AXIS rl rel_ub_q0p75 16 0.00 191.3 FORMAT "%5.1" DEPOSIT ABSOLUTE /end AXIS_DESCR
/end CHARACTERISTIC
/begin CHARACTERISTIC LAMFBMAX "" VALUE 0x4EC42B KwUb 1.992 fak_ub_b2 0.00 1.992 FORMAT "%5.3" /end CHARACTERISTIC
/begin CHARACTERISTIC LAMFBMIN "" VALUE 0x4EC42C KwUb 1.992 fak_ub_b2 0.00 1.992 FORMAT "%5.3" /end CHARACTERISTIC
/begin CHARACTERISTIC LAMFBOFBT "" MAP 0x4EC42D KfAxUbAyUbSstxUbSstyUbWSb 1.992 fak_sb_b1 -1.000 0.9922 FORMAT "%5.3"
 /begin AXIS_DESCR STD_AXIS tans temp_ub_q0p75_o48 12 -48.00 143.3 FORMAT "%5.1" DEPOSIT ABSOLUTE /end AXIS_DESCR
 /begin AXIS_DESCR STD_AXIS tmotzyl_u temp_ub_q0p75_o48 16 -48.00 143.3 FORMAT "%5.1" DEPOSIT ABSOLUTE /end AXIS_DESCR
/end CHARACTERISTIC
/begin CHARACTERISTIC LAMFBOFGANG "" CURVE 0x4EC50B KlAUbSstUbWSb 1.992 fak_sb_b1 -1.000 0.9922 FORMAT "%5.3"
 /begin AXIS_DESCR STD_AXIS gangi dez 8 0.00 255.0 FORMAT "%5.1" DEPOSIT ABSOLUTE /end AXIS_DESCR
/end CHARACTERISTIC
/begin CHARACTERISTIC LAMFLGSL "Lambda Motorlaufgrenze  fett bei Sekund‰rlufteinblasung" CURVE 0x4EC520 KlAUbSstUbWUb 1.992 fak_ub_b2 0.00 1.992 FORMAT "%5.3"
 /begin AXIS_DESCR STD_AXIS imlatm m_ub_b23p3 6 0.00 23.21 FORMAT "%5.2" DEPOSIT ABSOLUTE /end AXIS_DESCR
/end CHARACTERISTIC
/begin CHARACTERISTIC LAMLGFTM "Lambda Motorlaufgrenze fett" CURVE 0x4EC530 GklWUb 1.992 fak_ub_b2 0.00 1.992 FORMAT "%5.3"
 /begin AXIS_DESCR COM_AXIS tmot temp_ub_q0p75_o48 12 -48.00 143.3 AXIS_PTS_REF STM12ESUB /end AXIS_DESCR
/end CHARACTERISTIC
/begin CHARACTERISTIC LAMLGMTM "Laufgrenze ""mager""" CURVE 0x4EC53C GklWUb 1.992 fak_ub_b2 0.00 1.992 FORMAT "%5.3"
 /begin AXIS_DESCR COM_AXIS tmot temp_ub_q0p75_o48 12 -48.00 143.3 AXIS_PTS_REF STM12ESUB /end AXIS_DESCR
/end CHARACTERISTIC
/begin CHARACTERISTIC LAMSOSOF "Lambdasonde Soll Obergrenze f¸r 1.0-Fenster" VALUE 0x4E4D72 KwUw 15.99976 fak_uw_b16 0.00 15.99976 FORMAT "%8.5" /end CHARACTERISTIC
/begin CHARACTERISTIC LAMSOSUF "Lambdasonde Soll Untergrenze f¸r 1.0-Fenster" VALUE 0x4E4D74 KwUw 15.99976 fak_uw_b16 0.00 15.99976 FORMAT "%8.5" /end CHARACTERISTIC
/begin CHARACTERISTIC LAMVFGMIN "" VALUE 0x4E4D6E KwUb 100.0 vfzg_ub_q1p25 0.00 100.0 FORMAT "%5.1" /end CHARACTERISTIC
/begin CHARACTERISTIC LAM_DIAG "Kennline f¸r Messeing‰nge" CURVE 0x4E5144 KlAxU8SstxU8WU8 2.000 fak_ub_b2 0.00 2.000 FORMAT "%5.3"
 /begin AXIS_DESCR STD_AXIS ulam1 spg_ub_b5 11 0.00 5.000 FORMAT "%5.3" DEPOSIT ABSOLUTE /end AXIS_DESCR
/end CHARACTERISTIC
/begin CHARACTERISTIC LASDSLA "Lambda-Abgas-Soll bei Sekund‰rluftadaption/Kurztest" CURVE 0x4ECFDA KlAUwSstUwWUw 15.99976 fak_q0p000244 0.00 15.99976 FORMAT "%8.5"
 /begin AXIS_DESCR STD_AXIS ml_w m_uw_b6553p5 4 0.00 6553.500 FORMAT "%8.3" DEPOSIT ABSOLUTE /end AXIS_DESCR
/end CHARACTERISTIC
/begin CHARACTERISTIC LASOAB "Lambdasollwert bei Bankabschaltung" VALUE 0x4E4D71 KwUb 1.992 fak_ub_b2 0.00 1.992 FORMAT "%5.3" /end CHARACTERISTIC
/begin CHARACTERISTIC LASTMOT "Motortemp.-Korrektur von Lambda-Abgas-Soll" CURVE 0x4ECFEC KlAUwSstUwWUw 1.992188 fak_ub_b2 0.00 1.992188 FORMAT "%8.6"
 /begin AXIS_DESCR STD_AXIS tmotzyl_w temp_ub_q0p75_o48 4 -48.00000 49103.25 FORMAT "%8.2" DEPOSIT ABSOLUTE /end AXIS_DESCR
/end CHARACTERISTIC
/begin CHARACTERISTIC LBZAPPL "" VALUE 0x4E5A22 KwUb 1.000 dez 0.00 1.000 FORMAT "%5.3" /end CHARACTERISTIC
/begin CHARACTERISTIC LIMTKOA "Zeitschwelle um den Kompressor unbegrenzt auszuschalten" VALUE 0x4E96C0 KwUb 51.00 t200msxs_ub_b51 0.00 51.00 FORMAT "%5.2" /end CHARACTERISTIC
/begin CHARACTERISTIC LKRALL "Bedingung  Leerlaufadaption aktiv" VALUE 0x4E5734 KwWU8 191.3 rel_ub_q0p75 0.00 191.3 FORMAT "%5.1" /end CHARACTERISTIC
/begin CHARACTERISTIC LKRN "Lastschwelle Klopfregelung" CURVE 0x4ED480 KlAUbSstUbWUb 191.3 rel_ub_q0p75 0.00 191.3 FORMAT "%5.1"
 /begin AXIS_DESCR STD_AXIS nmot nmot_ub_q40 16 0.00 10200. FORMAT "%5.0" DEPOSIT ABSOLUTE /end AXIS_DESCR
/end CHARACTERISTIC
/begin CHARACTERISTIC LMSTMOT "Motortemp.-Korrektur von Lambda-Motor-Soll" CURVE 0x4ECDB4 KlAUwSstUwWUw 1.992188 fak_ub_b2 0.00 1.992188 FORMAT "%8.6"
 /begin AXIS_DESCR STD_AXIS tmotzyl_w temp_ub_q0p75_o48 4 -48.00000 49103.25 FORMAT "%8.2" DEPOSIT ABSOLUTE /end AXIS_DESCR
/end CHARACTERISTIC
/begin CHARACTERISTIC LP_FAKTOR "" VALUE 0x4EF58E KwUw 0.9999847 fak_uw_b1 0.00 0.9999847 FORMAT "%9.7" /end CHARACTERISTIC
/begin CHARACTERISTIC MDKOAN "Drehmomentschwelle um den Klimakompressor abzuschalten" CURVE 0x4E96C4 GklWUb 99.61 rel_ub_b99p6 0.00 99.61 FORMAT "%5.2"
 /begin AXIS_DESCR COM_AXIS nmot nmot_ub_q40 8 0.00 10200. AXIS_PTS_REF SNM08KOUB /end AXIS_DESCR
/end CHARACTERISTIC
/begin CHARACTERISTIC MDKOEN "Drehmomentschwelle um den Klimakompressor einzuschalten" CURVE 0x4E96CC GklWUb 99.61 rel_ub_b99p6 0.00 99.61 FORMAT "%5.2"
 /begin AXIS_DESCR COM_AXIS nmot nmot_ub_q40 8 0.00 10200. AXIS_PTS_REF SNM08KOUB /end AXIS_DESCR
/end CHARACTERISTIC
/begin CHARACTERISTIC MKRSTFAK "Kennlinie Umrechnung Kraftstoff Sollvolumen Faktot Abk¸hlung" CURVE 0x4E4BB0 KlAxU8SstxU8WU8 1.992 fak_ub_b2 0.00 1.992 FORMAT "%5.3"
 /begin AXIS_DESCR STD_AXIS vsskrst fuel_ub_q1 9 0.00 255.0 FORMAT "%5.1" DEPOSIT ABSOLUTE /end AXIS_DESCR
/end CHARACTERISTIC
/begin CHARACTERISTIC MLSSTART "KL zum erreichen des Tastverh‰ltnisses ¸ber der Zeit f¸r Motorl¸fter" CURVE 0x4E51DC KlAUwSstUwWUw 100.0000 rel_ub_b100 0.00 100.0000 FORMAT "%8.4"
 /begin AXIS_DESCR STD_AXIS ztmls t10msxs_uw_b655p35 8 0.00 2.500000 FORMAT "%8.6" DEPOSIT ABSOLUTE /end AXIS_DESCR
/end CHARACTERISTIC
/begin CHARACTERISTIC MO_DRE_DEL "" VALUE 0x4EF590 KwUw 10.00000 dez 0.00 10.00000 FORMAT "%8.5" /end CHARACTERISTIC
/begin CHARACTERISTIC MRESFSM "LLR: Erhˆhte Momentenreserve im LL nach einlegen der Fahrstufe" CURVE 0x4E5BC8 GklWUb 24.90 rel_ub_b24p9 0.00 24.90 FORMAT "%5.2"
 /begin AXIS_DESCR COM_AXIS tmot temp_ub_q0p75_o48 4 -48.00 143.3 AXIS_PTS_REF STM04SAUB /end AXIS_DESCR
/end CHARACTERISTIC
/begin CHARACTERISTIC MRESLLM "LLR: Erhˆhte Momentenreserve im LL nach Drehzahleinbruch" CURVE 0x4E5BCC GklWUb 24.90 rel_ub_b24p9 0.00 24.90 FORMAT "%5.2"
 /begin AXIS_DESCR COM_AXIS tmot temp_ub_q0p75_o48 4 -48.00 143.3 AXIS_PTS_REF STM04SAUB /end AXIS_DESCR
/end CHARACTERISTIC
/begin CHARACTERISTIC MRESTEV "Momentenreserve bei TEV-Drehzahlcheck" VALUE 0x4E5BD0 KwSb 24.90 rel_sb_q0p0976 -12.50 12.40 FORMAT "%5.2" /end CHARACTERISTIC
/begin CHARACTERISTIC NFHZ "Solldrehzahl bei eingeschalteter Frontscheibenheizung" VALUE 0x4E5A23 KwUb 2550. nmot_ub_q10 0.00 2550. FORMAT "%5.0" /end CHARACTERISTIC
/begin CHARACTERISTIC NFHZFS "Solldrehzahl bei eingeschalteter Frontscheibenheizung und B_fs=1" VALUE 0x4E5A24 KwUb 2550. nmot_ub_q10 0.00 2550. FORMAT "%5.0" /end CHARACTERISTIC
/begin CHARACTERISTIC NFKRAS "Drehzahlschwelle f¸r Schreibfreigabe Klopfregeladaption" VALUE 0x4E573D KwUb 10200. nmot_ub_q40 0.00 10200. FORMAT "%5.0" /end CHARACTERISTIC
/begin CHARACTERISTIC NFSACVMN "Einstellbare Solldrehzahl bei AC und FS Minimum" VALUE 0x4ED6DE KwSb 2550. nmotd_sb_q10 -1280. 1270. FORMAT "%5.0" /end CHARACTERISTIC
/begin CHARACTERISTIC NFSACVMX "Einstellbare Solldrehzahl bei AC und FS Maximum" VALUE 0x4ED6DF KwSb 2550. nmotd_sb_q10 -1280. 1270. FORMAT "%5.0" /end CHARACTERISTIC
/begin CHARACTERISTIC NFSM "Solldrehzahl Fahrstufenschalter ein" CURVE 0x4ED70C GklWUb 2550. nmot_ub_q10 0.00 2550. FORMAT "%5.0"
 /begin AXIS_DESCR COM_AXIS tmot temp_ub_q0p75_o48 6 -48.00 143.3 AXIS_PTS_REF STM06LLUB /end AXIS_DESCR
/end CHARACTERISTIC
/begin CHARACTERISTIC NFSMVMN "Einstellbare Solldrehzahl Minimum bei FS" VALUE 0x4ED6E0 KwSb 2550. nmotd_sb_q10 -1280. 1270. FORMAT "%5.0" /end CHARACTERISTIC
/begin CHARACTERISTIC NFSMVMX "Einstellbare Solldrehzahl Maximum bei FS" VALUE 0x4ED6E1 KwSb 2550. nmotd_sb_q10 -1280. 1270. FORMAT "%5.0" /end CHARACTERISTIC
/begin CHARACTERISTIC NGKRWN "Schwellwert Drehzahlgradient f¸r Dynamikerkennung" CURVE 0x4ED080 KlAUwSstUwWUw 12799.77 nmotg_nuw_q0p39 0.00 12799.77 FORMAT "%8.2"
 /begin AXIS_DESCR STD_AXIS nmot nmot_ub_q40 16 0.00 2621400. FORMAT "%8.0" DEPOSIT ABSOLUTE /end AXIS_DESCR
/end CHARACTERISTIC
/begin CHARACTERISTIC NGNSNF "Drehzahlgradientenschwelle zur Auslˆsung der Drehzahlnachf¸hrung" VALUE 0x4E5A25 KwUb 25500. nmotg_ub_q100 0.00 25500. FORMAT "%5.0" /end CHARACTERISTIC
/begin CHARACTERISTIC NKRF "Drehzahlschwelle f¸r Klopfregelfreigabe" VALUE 0x4E573E KwUb 10200. nmot_ub_q40 0.00 10200. FORMAT "%5.0" /end CHARACTERISTIC
/begin CHARACTERISTIC NLBZSOLL "" VALUE 0x4E5A26 KwUb 2550. nmot_ub_q10 0.00 2550. FORMAT "%5.0" /end CHARACTERISTIC
/begin CHARACTERISTIC NLBZSO_OFF "" VALUE 0x4E5A27 KwUb 2550. nmot_ub_q10 0.00 2550. FORMAT "%5.0" /end CHARACTERISTIC
/begin CHARACTERISTIC NLLM "Solldrehzahl" CURVE 0x4ED714 GklWUb 2550. nmot_ub_q10 0.00 2550. FORMAT "%5.0"
 /begin AXIS_DESCR COM_AXIS tmot temp_ub_q0p75_o48 6 -48.00 143.3 AXIS_PTS_REF STM06LLUB /end AXIS_DESCR
/end CHARACTERISTIC
/begin CHARACTERISTIC NLLMVMN "Einstellbare LL-Solldrehzal Minimum" VALUE 0x4ED6E2 KwSb 2550. nmotd_sb_q10 -1280. 1270. FORMAT "%5.0" /end CHARACTERISTIC
/begin CHARACTERISTIC NLLMVMX "Einstellbare LL-Solldrehzal Maximum" VALUE 0x4ED6E3 KwSb 2550. nmotd_sb_q10 -1280. 1270. FORMAT "%5.0" /end CHARACTERISTIC
/begin CHARACTERISTIC NNGKRWN "Schwellwert Drehzahlgradient f¸r Dynamikerkennung" CURVE 0x4ED0C2 KlAUwSstUwWUw 25599.55 nmotg_nuw_q0p39 -12799.77 12799.77 FORMAT "%8.2"
 /begin AXIS_DESCR STD_AXIS nmot nmot_ub_q40 16 0.00 2621400. FORMAT "%8.0" DEPOSIT ABSOLUTE /end AXIS_DESCR
/end CHARACTERISTIC
/begin CHARACTERISTIC NSAC "Solldrehzahl bei Klimaanlage ein (S_AC = 1)" VALUE 0x4E5A28 KwUb 2550. nmot_ub_q10 0.00 2550. FORMAT "%5.0" /end CHARACTERISTIC
/begin CHARACTERISTIC NSACFS "Solldrehzahl bei Klimaanlage ein (S_AC = 1) und eingelegter Fahrstufe (S_fs=1)" VALUE 0x4E5A29 KwUb 2550. nmot_ub_q10 0.00 2550. FORMAT "%5.0" /end CHARACTERISTIC
/begin CHARACTERISTIC NSACMVMN "Einstellbare LL-Solldrehzal Minimum bei AC" VALUE 0x4ED6E4 KwSb 2550. nmotd_sb_q10 -1280. 1270. FORMAT "%5.0" /end CHARACTERISTIC
/begin CHARACTERISTIC NSACMVMX "Einstellbare LL-Solldrehzal Maximum bei AC" VALUE 0x4ED6E5 KwSb 2550. nmotd_sb_q10 -1280. 1270. FORMAT "%5.0" /end CHARACTERISTIC
/begin CHARACTERISTIC NSFSHLS "Solldrehzahl nsfsmn bei Heizleistungssteigerung" VALUE 0x4E5A2A KwUb 2550. nmot_ub_q10 0.00 2550. FORMAT "%5.0" /end CHARACTERISTIC
/begin CHARACTERISTIC NSHLS "Solldrehzahl nsllmn bei Heizleistungssteigerung" VALUE 0x4E5A2B KwUb 2550. nmot_ub_q10 0.00 2550. FORMAT "%5.0" /end CHARACTERISTIC
/begin CHARACTERISTIC NSLBVMN "Einstellbare LL-Solldrehzal Minimum bei Unterspannung" VALUE 0x4ED6E6 KwSb 2550. nmotd_sb_q10 -1280. 1270. FORMAT "%5.0" /end CHARACTERISTIC
/begin CHARACTERISTIC NSLBVMX "Einstellbare LL-Solldrehzal Maximum bei Unterspannung" VALUE 0x4ED6E7 KwSb 2550. nmotd_sb_q10 -1280. 1270. FORMAT "%5.0" /end CHARACTERISTIC
/begin CHARACTERISTIC NSLPP "Solldrehzahl abh‰ngig vom Pumpendruck der Servolenkung" CURVE 0x4ED71C KlAUbSstUbWUb 2550. nmot_ub_q10 0.00 2550. FORMAT "%5.0"
 /begin AXIS_DESCR STD_AXIS psl dez 4 0.00 255.0 FORMAT "%5.1" DEPOSIT ABSOLUTE /end AXIS_DESCR
/end CHARACTERISTIC
/begin CHARACTERISTIC NSLPPFS "Solldrehzahl abh‰ngig vom Pumpendruck der Servolenkung bei B_fs=1" CURVE 0x4ED728 KlAUbSstUbWUb 2550. nmot_ub_q10 0.00 2550. FORMAT "%5.0"
 /begin AXIS_DESCR STD_AXIS psl dez 4 0.00 255.0 FORMAT "%5.1" DEPOSIT ABSOLUTE /end AXIS_DESCR
/end CHARACTERISTIC
/begin CHARACTERISTIC NSMNEGS "Soll-Drehzahlschwelle f¸r Getriebesteuerung B_nsmin" VALUE 0x4E5A2C KwUb 2550. nmot_ub_q10 0.00 2550. FORMAT "%5.0" /end CHARACTERISTIC
/begin CHARACTERISTIC NSNOT "Solldrehzahlanhebung bei B_nnot=1" VALUE 0x4E5A2D KwUb 2550. nmot_ub_q10 0.00 2550. FORMAT "%5.0" /end CHARACTERISTIC
/begin CHARACTERISTIC NSNOT1 "Solldrehzahlanhebung bei Notlauf" VALUE 0x4E5A2E KwUb 2550. nmot_ub_q10 0.00 2550. FORMAT "%5.0" /end CHARACTERISTIC
/begin CHARACTERISTIC NSNOT1FS "Solldrehzahlanhebung bei Notlauf und Fahrstufe EIN" VALUE 0x4E5A2F KwUb 2550. nmot_ub_q10 0.00 2550. FORMAT "%5.0" /end CHARACTERISTIC
/begin CHARACTERISTIC NSNOTFS "Solldrehzahlanhebung bei B_nnot=1 und Fahrstufe" VALUE 0x4E5A30 KwUb 2550. nmot_ub_q10 0.00 2550. FORMAT "%5.0" /end CHARACTERISTIC
/begin CHARACTERISTIC NSOELH "Solldrehzahl bei hoher ÷ltemperatur" VALUE 0x4E5A31 KwUb 2550. nmot_ub_q10 0.00 2550. FORMAT "%5.0" /end CHARACTERISTIC
/begin CHARACTERISTIC NSOELHFS "Solldrehzahl bei hoher ÷ltemperatur und Fahrstufe eingelegt" VALUE 0x4E5A32 KwUb 2550. nmot_ub_q10 0.00 2550. FORMAT "%5.0" /end CHARACTERISTIC
/begin CHARACTERISTIC NTEB "Angehobene Solldrehzahl bei stark beladenem AKF" VALUE 0x4E5A33 KwUb 2550. nmot_ub_q10 0.00 2550. FORMAT "%5.0" /end CHARACTERISTIC
/begin CHARACTERISTIC NTEBFS "Angehobene Solldrehzahl bei stark beladenem AKF und B_fs=1" VALUE 0x4E5A34 KwUb 2550. nmot_ub_q10 0.00 2550. FORMAT "%5.0" /end CHARACTERISTIC
/begin CHARACTERISTIC OFFTZYL "Offset auf tmot zur Berechnung von tmotzyl-Ersatzwert" VALUE 0x4EC730 KwUw 49151.25 temp_ub_q0p75_o48 -48.00000 49103.25 FORMAT "%8.2" /end CHARACTERISTIC
/begin CHARACTERISTIC PER2TEETH "" CURVE 0x4EC89E KlAUwSstUwWUw 720.0000 kw_q0p02566 0.00 720.0000 FORMAT "%8.4"
 /begin AXIS_DESCR STD_AXIS tevdutycor rel_uw_q0p010 11 0.00 655.3500 FORMAT "%8.4" DEPOSIT ABSOLUTE /end AXIS_DESCR
/end CHARACTERISTIC
/begin CHARACTERISTIC PZWKRA "Prozentuale H‰ufigkeit der ZW-Ausgabe durch die KR w‰hrend Dynamikadaption" VALUE 0x4E5715 KwUb 99.61 rel_ub_b99p6 0.00 99.61 FORMAT "%5.2" /end CHARACTERISTIC
/begin CHARACTERISTIC RAIDEGREE "" CURVE 0x4E9878 KlAUwSstUwWUw 6553.500 wink_uw_q0p1 0.00 6553.500 FORMAT "%8.3"
 /begin AXIS_DESCR STD_AXIS urai_w spg_uw_q0p00488 5 0.00 319.9951 FORMAT "%8.4" DEPOSIT ABSOLUTE /end AXIS_DESCR
/end CHARACTERISTIC
/begin CHARACTERISTIC REFINI "Startwert Referenzpegel bei Klopfregelung aktiv" VALUE 0x4E5997 KwUb 0.7227 spg_ub_b5 0.2930 1.016 FORMAT "%5.3" /end CHARACTERISTIC
/begin CHARACTERISTIC RKREM1N "" CURVE 0x4E5944 GklWU8 0.9961 fak_ub_b1 0.00 0.9961
 /begin AXIS_DESCR COM_AXIS nmot nmot_ub_q40 16 0.00 10200. AXIS_PTS_REF SN16KR1UB /end AXIS_DESCR
/end CHARACTERISTIC
/begin CHARACTERISTIC RKREM2N "" CURVE 0x4E5954 GklWU8 0.9961 fak_ub_b1 0.00 0.9961
 /begin AXIS_DESCR COM_AXIS nmot nmot_ub_q40 16 0.00 10200. AXIS_PTS_REF SN16KR2UB /end AXIS_DESCR
/end CHARACTERISTIC
/begin CHARACTERISTIC RKRMX1N "Maximaler Referenzpegel f¸r Klopferkennungsschwelle Zyl.-gruppe 1" CURVE 0x4E5964 GklWU8 317.500 spg_ub_b320 1.25000 318.750
 /begin AXIS_DESCR COM_AXIS nmot nmot_ub_q40 16 0.00 10200. AXIS_PTS_REF SN16KR1UB /end AXIS_DESCR
/end CHARACTERISTIC
/begin CHARACTERISTIC RKRMX2N "Maximaler Referenzpegel f¸r Klopferkennungsschwelle Zyl.-gruppe 2" CURVE 0x4E5974 GklWU8 317.500 spg_ub_b320 1.25000 318.750
 /begin AXIS_DESCR COM_AXIS nmot nmot_ub_q40 16 0.00 10200. AXIS_PTS_REF SN16KR2UB /end AXIS_DESCR
/end CHARACTERISTIC
/begin AXIS_PTS SEH06KRUW "St¸tzstellenverteilung evhubi_w, 6 Sst." 0x4EA1CE evhubi_w SstASwSstSw 65.53500 hub_uw_q0p001 6 -32.76800 32.76700 FORMAT "%8.5" DEPOSIT ABSOLUTE /end AXIS_PTS
/begin CHARACTERISTIC SENE1 "Sensorersatz f¸r Klopfsensor 1" VALUE 0x4E5735 KwWU8 255.0 dezsub1 1.000 256.0 FORMAT "%5.1" /end CHARACTERISTIC
/begin CHARACTERISTIC SENE2 "Sensorersatz f¸r Klopfsensor 2" VALUE 0x4E5736 KwWU8 255.0 dezsub1 1.000 256.0 FORMAT "%5.1" /end CHARACTERISTIC
/begin AXIS_PTS SN16KR1UB "" 0x4E2A14 nmot SstAU8SstU8 10200. nmot_ub_q40 16 0.00 10200. FORMAT "%5.0" DEPOSIT ABSOLUTE /end AXIS_PTS
/begin AXIS_PTS SN16KR2UB "" 0x4E2A28 nmot SstAU8SstU8 10200. nmot_ub_q40 16 0.00 10200. FORMAT "%5.0" DEPOSIT ABSOLUTE /end AXIS_PTS
/begin AXIS_PTS SNM08KOUB "St¸tzstellenverteilung f¸r Klimakompressorsteuerung  8  nmot" 0x4E96D4 nmot SstAUbSstUb 10200. nmot_ub_q40 8 0.00 10200. FORMAT "%5.0" DEPOSIT ABSOLUTE /end AXIS_PTS
/begin AXIS_PTS SNM08KRUW "St¸tzstellenverteilung Drehzahl, 8 Sst." 0x4EA224 nmot_w SstAUwSstUw 16383.75 nmot_uw_q0p25 8 0.00 16383.75 FORMAT "%8.2" DEPOSIT ABSOLUTE /end AXIS_PTS
/begin AXIS_PTS SNM16GKUB "" 0x4EA134 nmot SstAUbSstUb 10200. nmot_ub_q40 16 0.00 10200. FORMAT "%5.0" DEPOSIT ABSOLUTE /end AXIS_PTS
/begin AXIS_PTS SNM16KRUB "St¸tzstellenverteilung Drehzahl, 16 Sst." 0x4EA148 nmot SstAUbSstUb 10200. nmot_ub_q40 16 0.00 10200. FORMAT "%5.0" DEPOSIT ABSOLUTE /end AXIS_PTS
/begin AXIS_PTS SNM16OPUW "St¸tzstellenverteilung Drehzahl" 0x4E2BBC nmot_w SstAUwSstUw 16383.75 nmot_uw_q0p25 16 0.00 16383.75 FORMAT "%8.2" DEPOSIT ABSOLUTE /end AXIS_PTS
/begin AXIS_PTS SNS06LLSB "St¸tzstellenvert., Solldrehzahlabw., 06 Sst., LL-Regel." 0x4E5A38 dns SstAUbSstSb 2550. nmotd_sb_q10 6 -1280. 1270. FORMAT "%5.0" DEPOSIT ABSOLUTE /end AXIS_PTS
/begin AXIS_PTS SNS06LLTSB "" 0x4E5A40 dns SstAUbSstSb 2550. nmotd_sb_q10 6 -1280. 1270. FORMAT "%5.0" DEPOSIT ABSOLUTE /end AXIS_PTS
/begin AXIS_PTS SRL04KRUB "St¸tzstellenverteilung relative F¸llung, 4 Sst." 0x4EA15C rl SstAUbSstUb 191.3 rel_ub_q0p75 4 0.00 191.3 FORMAT "%5.1" DEPOSIT ABSOLUTE /end AXIS_PTS
/begin AXIS_PTS SRL12GKUB "" 0x4EA164 rl SstAUbSstUb 191.3 rel_ub_q0p75 12 0.00 191.3 FORMAT "%5.1" DEPOSIT ABSOLUTE /end AXIS_PTS
/begin AXIS_PTS SRL16OPUW "St¸tzstellenverteilung relative Luftf¸llung" 0x4E68A6 rl_w_kge SstAUwSstUw 1535.977 rel_uw_q0p0234 16 0.00 1535.977 FORMAT "%8.3" DEPOSIT ABSOLUTE /end AXIS_PTS
/begin AXIS_PTS STA04SAUB "" 0x4E2B80 tans SstAUbSstUb 191.3 temp_ub_q0p75_o48 4 -48.00 143.3 FORMAT "%5.1" DEPOSIT ABSOLUTE /end AXIS_PTS
/begin CHARACTERISTIC STKRLDY "St¸tzstellengrenzwert f¸r KR-Adaption bei Lastdynamik" VALUE 0x4E573F KwUb 255.0 dez 0.00 255.0 FORMAT "%5.1" /end CHARACTERISTIC
/begin CHARACTERISTIC STKRNDY "St¸tzstellengrenzwert f¸r KR-Adaption bei Drehzahldynamik" VALUE 0x4E5740 KwUb 255.0 dez 0.00 255.0 FORMAT "%5.1" /end CHARACTERISTIC
/begin AXIS_PTS STM04SAUB "St¸tzstellenverteilung Motortemperatur, 4 Sst." 0x4E2B90 tmot SstAUbSstUb 191.3 temp_ub_q0p75_o48 4 -48.00 143.3 FORMAT "%5.1" DEPOSIT ABSOLUTE /end AXIS_PTS
/begin AXIS_PTS STM06LLTUB "" 0x4EA1A4 tmot SstAUbSstUb 191.3 temp_ub_q0p75_o48 6 -48.00 143.3 FORMAT "%5.1" DEPOSIT ABSOLUTE /end AXIS_PTS
/begin AXIS_PTS STM06LLUB "St¸tzstellenverteilung Motortemperatur, 6 Sst." 0x4EA1AC tmot SstAUbSstUb 191.3 temp_ub_q0p75_o48 6 -48.00 143.3 FORMAT "%5.1" DEPOSIT ABSOLUTE /end AXIS_PTS
/begin AXIS_PTS STM12ESUB "SST-Verteilung f¸r die Motortemperatur tmot" 0x4EA1C0 tmot SstAUbSstUb 191.3 temp_ub_q0p75_o48 12 -48.00 143.3 FORMAT "%5.1" DEPOSIT ABSOLUTE /end AXIS_PTS
/begin CHARACTERISTIC STNSG1 "St¸tzstellenverteilung nmot-1 SG-Temperaturhistogramm" VALUE 0x4EC6A0 KwUb 10200. nmot_ub_q40 0.00 10200. FORMAT "%5.0" /end CHARACTERISTIC
/begin CHARACTERISTIC STNSG2 "St¸tzstellenverteilung nmot-2 SG-Temperaturhistogramm" VALUE 0x4EC6A1 KwUb 10200. nmot_ub_q40 0.00 10200. FORMAT "%5.0" /end CHARACTERISTIC
/begin CHARACTERISTIC STNSG3 "St¸tzstellenverteilung nmot-3 SG-Temperaturhistogramm" VALUE 0x4EC6A2 KwUb 10200. nmot_ub_q40 0.00 10200. FORMAT "%5.0" /end CHARACTERISTIC
/begin CHARACTERISTIC STNSG4 "St¸tzstellenverteilung nmot-4 SG-Temperaturhistogramm" VALUE 0x4EC6A3 KwUb 10200. nmot_ub_q40 0.00 10200. FORMAT "%5.0" /end CHARACTERISTIC
/begin CHARACTERISTIC STNSG5 "St¸tzstellenverteilung nmot-5 SG-Temperaturhistogramm" VALUE 0x4EC6A4 KwUb 10200. nmot_ub_q40 0.00 10200. FORMAT "%5.0" /end CHARACTERISTIC
/begin CHARACTERISTIC STTSG1 "St¸tzstellenverteilung 1 tsg  SG-Temperaturhistogramm" VALUE 0x4EC6A5 KwUb 191.3 temp_ub_q0p75_o48 -48.00 143.3 FORMAT "%5.1" /end CHARACTERISTIC
/begin CHARACTERISTIC STTSG2 "St¸tzstellenverteilung 2 tsg  SG-Temperaturhistogramm" VALUE 0x4EC6A6 KwUb 191.3 temp_ub_q0p75_o48 -48.00 143.3 FORMAT "%5.1" /end CHARACTERISTIC
/begin CHARACTERISTIC STTSG3 "St¸tzstellenverteilung 3 tsg  SG-Temperaturhistogramm" VALUE 0x4EC6A7 KwUb 191.3 temp_ub_q0p75_o48 -48.00 143.3 FORMAT "%5.1" /end CHARACTERISTIC
/begin CHARACTERISTIC STTSG4 "St¸tzstellenverteilung 4 tsg  SG-Temperaturhistogramm" VALUE 0x4EC6A8 KwUb 191.3 temp_ub_q0p75_o48 -48.00 143.3 FORMAT "%5.1" /end CHARACTERISTIC
/begin CHARACTERISTIC STTSG5 "St¸tzstellenverteilung 5 tsg  SG-Temperaturhistogramm" VALUE 0x4EC6A9 KwUb 191.3 temp_ub_q0p75_o48 -48.00 143.3 FORMAT "%5.1" /end CHARACTERISTIC
/begin AXIS_PTS SWD06KRSW "St¸tzstellenverteilung DK-Winkel, 6 Sst." 0x4EA2C2 wdkba_w SstASwSstSw 1599.976 relDK_q0p02441 6 -800.0000 799.9756 FORMAT "%8.4" DEPOSIT ABSOLUTE /end AXIS_PTS
/begin CHARACTERISTIC S_KRMRLL "" VALUE 0x4ED4D6 KwUb 255.0 dez 0.00 255.0 FORMAT "%5.1" /end CHARACTERISTIC
/begin CHARACTERISTIC TABGBTS "Abgastemperaturschwelle f¸r Bauteileschutz" VALUE 0x4EC220 KwUw 1279.980 temp_uw_q0p0195_o50 -50.00000 1229.980 FORMAT "%8.3" /end CHARACTERISTIC
/begin CHARACTERISTIC TABKOR "Kennlinie Korrektur tkrststart ¸ber Abstellzeit" CURVE 0x4E4B6E KlAxU8SstxU16WU16 1.992188 fak_ub_b2 0.00 1.992188 FORMAT "%8.6"
 /begin AXIS_DESCR STD_AXIS tabst_w t1sxs_uw_q1 9 0.00 65535.00 FORMAT "%8.2" DEPOSIT ABSOLUTE /end AXIS_DESCR
/end CHARACTERISTIC
/begin CHARACTERISTIC TADMM "1. Stufenbreite (Zeit) f¸r Motortemperaturmodell" VALUE 0x4EC67C KwUw 6553.500 t100msxs_uw_b6553p5 0.00 6553.500 FORMAT "%8.3" /end CHARACTERISTIC
/begin CHARACTERISTIC TBTSOFFSC "Erkennung Kurzschluss" VALUE 0x4ECAA0 KwUb 25.50 t100msxs_ub_b25p5 0.00 25.50 FORMAT "%5.2" /end CHARACTERISTIC
/begin CHARACTERISTIC TDMRESLL "Sperrzeit f¸r die erhˆhte Momentenreserve nach dem Start" VALUE 0x4ED746 KwUb 51.00 t200msxs_ub_b51 0.00 51.00 FORMAT "%5.2" /end CHARACTERISTIC
/begin CHARACTERISTIC TDNLBZ "" VALUE 0x4ED734 KwUw 12999.80 t200msxs_ub_b51 0.2000000 13000.00 FORMAT "%8.2" /end CHARACTERISTIC
/begin CHARACTERISTIC TDNSUB "Batterie - Erholzeit ab Start, f¸r UBATT - Diagnose" VALUE 0x4E500A KwUb 255.0 t100msxs_ub_b255 0.00 255.0 FORMAT "%5.1" /end CHARACTERISTIC
/begin CHARACTERISTIC TDTM "Entprellzeit Fehlererkennung TMOT" VALUE 0x4EC67E KwUw 6553.500 t100msxs_uw_b6553p5 0.00 6553.500 FORMAT "%8.3" /end CHARACTERISTIC
/begin CHARACTERISTIC TDTMMA "Verzˆgerungszeit Anfangswert Motortemperaturmodell" VALUE 0x4EC680 KwUw 6553.500 t100msxs_uw_b6553p5 0.00 6553.500 FORMAT "%8.3" /end CHARACTERISTIC
/begin CHARACTERISTIC TDTMOTZYL "Entprellzeit Fehlererkennung Kopftemperatur" VALUE 0x4EC6D3 KwUb 25.50 t100msxs_ub_b25p5 0.00 25.50 FORMAT "%5.2" /end CHARACTERISTIC
/begin CHARACTERISTIC TDUB "Wartezeit f¸r UBATT-Diagnose" VALUE 0x4E500B KwUb 25.50 t100msxs_ub_b25p5 0.00 25.50 FORMAT "%5.2" /end CHARACTERISTIC
/begin CHARACTERISTIC TEVCOR "" MAP 0x4EC8CC KfAxUbAyUbSstxUbSstyUwWUw 16.00000 fak_uw_b16 0.00 16.00000 FORMAT "%8.5"
 /begin AXIS_DESCR STD_AXIS nmot nmot_ub_q40 10 0.00 10200. FORMAT "%5.0" DEPOSIT ABSOLUTE /end AXIS_DESCR
 /begin AXIS_DESCR STD_AXIS rl_w rel_uw_q0p0234 10 0.00 1535.977 FORMAT "%8.3" DEPOSIT ABSOLUTE /end AXIS_DESCR
/end CHARACTERISTIC
/begin CHARACTERISTIC TEVEND "" MAP 0x4EC9B4 KfAxUbAyUbSstxUbSstyUwWUw 720.0000 kw_q0p02566 0.00 720.0000 FORMAT "%8.4"
 /begin AXIS_DESCR STD_AXIS nmot nmot_ub_q40 10 0.00 10200. FORMAT "%5.0" DEPOSIT ABSOLUTE /end AXIS_DESCR
 /begin AXIS_DESCR STD_AXIS rl_w rel_uw_q0p0234 10 0.00 1535.977 FORMAT "%8.3" DEPOSIT ABSOLUTE /end AXIS_DESCR
/end CHARACTERISTIC
/begin CHARACTERISTIC THEV "" VALUE 0x4EA9B8 KwUw 6553.500 t100msxs_uw_b6553p6 0.00 6553.500 FORMAT "%8.3" /end CHARACTERISTIC
/begin CHARACTERISTIC THSVKTA "" CURVE 0x4EA98C KlAUbSstUbWUb 2.550 t10msxs_q0p01_o0p05 -0.05000 2.500 FORMAT "%5.3"
 /begin AXIS_DESCR STD_AXIS tabgmls temp_ub_q5_o50 8 -50.00 1225. FORMAT "%5.0" DEPOSIT ABSOLUTE /end AXIS_DESCR
/end CHARACTERISTIC
/begin CHARACTERISTIC THSVKTA2 "" CURVE 0x4EA9A0 KlAUbSstUbWUb 2.550 t10msxs_q0p01_o0p05 -0.05000 2.500 FORMAT "%5.3"
 /begin AXIS_DESCR STD_AXIS tabgmls2 temp_ub_q5_o50 8 -50.00 1225. FORMAT "%5.0" DEPOSIT ABSOLUTE /end AXIS_DESCR
/end CHARACTERISTIC
/begin CHARACTERISTIC THVA "" VALUE 0x4EA9B1 KwUb 2.550 t10msxs_q0p01_o0p05 -0.05000 2.500 FORMAT "%5.3" /end CHARACTERISTIC
/begin CHARACTERISTIC THVA2 "" VALUE 0x4EA9B2 KwUb 2.550 t10msxs_q0p01_o0p05 -0.05000 2.500 FORMAT "%5.3" /end CHARACTERISTIC
/begin CHARACTERISTIC THVAWU "" VALUE 0x4EA9B3 KwUb 2.550 t10msxs_ub_b2p55 0.00 2.550 FORMAT "%5.3" /end CHARACTERISTIC
/begin CHARACTERISTIC TIMXBTSON "Wiedereinschaltzeit BTS nach ‹berstromauslˆsung" VALUE 0x4ECAA1 KwUb 25.50 t100msxs_ub_b25p5 0.00 25.50 FORMAT "%5.2" /end CHARACTERISTIC
/begin CHARACTERISTIC TKAKOR "Kennlinie Korrektur" CURVE 0x4E4B94 KlAxU8SstxS16WS16 383.2500 temp_sb_q0p75 -192.0000 191.2500 FORMAT "%8.4"
 /begin AXIS_DESCR STD_AXIS tkakor_in temp_sb_q0p75 6 -192.0000 191.2500 FORMAT "%8.4" DEPOSIT ABSOLUTE /end AXIS_DESCR
/end CHARACTERISTIC
/begin CHARACTERISTIC TKATBTS "Kat-Temperaturschwelle f¸r Bauteileschutz" VALUE 0x4EC222 KwUw 1279.980 temp_uw_q0p0195_o50 -50.00000 1229.980 FORMAT "%8.3" /end CHARACTERISTIC
/begin CHARACTERISTIC TKOAMNN "Minimale Abschaltzeit des Klimakompressors" CURVE 0x4E96E0 GklWUb 51.00 t200msxs_ub_b51 0.00 51.00 FORMAT "%5.2"
 /begin AXIS_DESCR COM_AXIS nmot nmot_ub_q40 8 0.00 10200. AXIS_PTS_REF SNM08KOUB /end AXIS_DESCR
/end CHARACTERISTIC
/begin CHARACTERISTIC TKOAMXN "Maximale Abschaltzeit des Klimakompressors" CURVE 0x4E96E8 GklWUb 51.00 t200msxs_ub_b51 0.00 51.00 FORMAT "%5.2"
 /begin AXIS_DESCR COM_AXIS nmot nmot_ub_q40 8 0.00 10200. AXIS_PTS_REF SNM08KOUB /end AXIS_DESCR
/end CHARACTERISTIC
/begin CHARACTERISTIC TKOEMNN "Minimale Einschaltzeit des Klimakompressors" CURVE 0x4E96F0 GklWUb 51.00 t200msxs_ub_b51 0.00 51.00 FORMAT "%5.2"
 /begin AXIS_DESCR COM_AXIS nmot nmot_ub_q40 8 0.00 10200. AXIS_PTS_REF SNM08KOUB /end AXIS_DESCR
/end CHARACTERISTIC
/begin CHARACTERISTIC TKRSTINT "Initialisierung tkrstab" VALUE 0x4E4BC6 KwWU8 191.3 temp_ub_q0p75_o48 -48.00 143.3 FORMAT "%5.1" /end CHARACTERISTIC
/begin CHARACTERISTIC TLAFA "Vezˆgerungszeit bis Lambda Fahrerwunsch aktiv" VALUE 0x4EC51C KwUb 25.50 t100msxs_ub_b25p5 0.00 25.50 FORMAT "%5.2" /end CHARACTERISTIC
/begin CHARACTERISTIC TMDMMA "Anfangstemperatur f¸r Motortemperaturmodell" VALUE 0x4EC5DC KwUb 191.3 temp_ub_q0p75_o48 -48.00 143.3 FORMAT "%5.1" /end CHARACTERISTIC
/begin CHARACTERISTIC TMDMMAT "Ersatztemperatur abh. Abstellzeit w‰hrend TDTMMA" CURVE 0x4EC682 KlAUwSstUwWUw 191.2500 temp_uw_q0p75_o48 -48.00000 143.2500 FORMAT "%8.4"
 /begin AXIS_DESCR STD_AXIS tabst_w t1sxs_uw_q1 3 0.00 65535.00 FORMAT "%8.2" DEPOSIT ABSOLUTE /end AXIS_DESCR
/end CHARACTERISTIC
/begin CHARACTERISTIC TMDMMAU "Unterster Anfangswert aus tans f¸r Motortemperaturmodell" VALUE 0x4EC5DD KwUb 191.3 temp_ub_q0p75_o48 -48.00 143.3 FORMAT "%5.1" /end CHARACTERISTIC
/begin CHARACTERISTIC TMDMMEE "Endtemperatur f¸r Ersatzwert Motortemperatur" VALUE 0x4EC5DE KwUb 191.3 temp_ub_q0p75_o48 -48.00 143.3 FORMAT "%5.1" /end CHARACTERISTIC
/begin CHARACTERISTIC TMDMMER "Endtemperatur f¸r Referenzwert Motortemperatur" VALUE 0x4EC5DF KwUb 191.3 temp_ub_q0p75_o48 -48.00 143.3 FORMAT "%5.1" /end CHARACTERISTIC
/begin CHARACTERISTIC TMDMN "Motortemperatur min." VALUE 0x4EC5E0 KwUb 191.3 temp_ub_q0p75_o48 -48.00 143.3 FORMAT "%5.1" /end CHARACTERISTIC
/begin CHARACTERISTIC TMDMX "Motortemperatur max." VALUE 0x4EC5E1 KwUb 191.3 temp_ub_q0p75_o48 -48.00 143.3 FORMAT "%5.1" /end CHARACTERISTIC
/begin CHARACTERISTIC TMDYNA "TMOT - Schwelle f¸r Lastdynamikadaption aktiv" VALUE 0x4E5716 KwUw 49151.25 temp_ub_q0p75_o48 -48.00000 49103.25 FORMAT "%8.2" /end CHARACTERISTIC
/begin CHARACTERISTIC TMKOAO "Obere Motortemperaturschwelle f¸r Kompressorabschaltung" VALUE 0x4E96F8 KwUb 191.3 temp_ub_q0p75_o48 -48.00 143.3 FORMAT "%5.1" /end CHARACTERISTIC
/begin CHARACTERISTIC TMKOAU "Untere Motortemperaturschwelle f¸r Kompressorabschaltung" VALUE 0x4E96F9 KwUb 191.3 temp_ub_q0p75_o48 -48.00 143.3 FORMAT "%5.1" /end CHARACTERISTIC
/begin CHARACTERISTIC TMKR "Motortemperaturschwelle f¸r Klopfregelung aktiv" VALUE 0x4ED4A2 KwUw 49151.25 temp_ub_q0p75_o48 -48.00000 49103.25 FORMAT "%8.2" /end CHARACTERISTIC
/begin CHARACTERISTIC TMKRA "Motortemperaturschwelle f¸r adaptive Klopfregelung" VALUE 0x4ED4A4 KwUw 49151.25 temp_ub_q0p75_o48 -48.00000 49103.25 FORMAT "%8.2" /end CHARACTERISTIC
/begin CHARACTERISTIC TMLLRNS "Motortemperaturschwelle f¸r Solldrehzahlverstellung ¸ber Tester" VALUE 0x4ED6E8 KwUb 191.3 temp_ub_q0p75_o48 -48.00 143.3 FORMAT "%5.1" /end CHARACTERISTIC
/begin CHARACTERISTIC TMLRTMS "Motortemperaturschwelle f¸r LR ein abh. von Starttemperatur" CURVE 0x4EC5E4 KlAUbSstUbWUb 191.3 temp_ub_q0p75_o48 -48.00 143.3 FORMAT "%5.1"
 /begin AXIS_DESCR STD_AXIS tmst temp_ub_q0p75_o48 4 -48.00 143.3 FORMAT "%5.1" DEPOSIT ABSOLUTE /end AXIS_DESCR
/end CHARACTERISTIC
/begin CHARACTERISTIC TMMXRT "max. Motortemperatur f. Retrigg. Modelle (Blockheater-Erkennung)" VALUE 0x4EC5ED KwUb 191.3 temp_ub_q0p75_o48 -48.00 143.3 FORMAT "%5.1" /end CHARACTERISTIC
/begin CHARACTERISTIC TMNV "Temperaturschwelle f¸r DS2-Nsoll-Verstellung bei FS=0" VALUE 0x4ED6E9 KwUb 191.3 temp_ub_q0p75_o48 -48.00 143.3 FORMAT "%5.1" /end CHARACTERISTIC
/begin CHARACTERISTIC TMNVFS "Temperaturschwelle f¸r DS2-Nsoll-Verstellung bei FS=1" VALUE 0x4ED6EA KwUb 191.3 temp_ub_q0p75_o48 -48.00 143.3 FORMAT "%5.1" /end CHARACTERISTIC
/begin CHARACTERISTIC TMOHSMN "Minimal Motortemperatur f¸r Sondenheizung" VALUE 0x4EA9B4 KwUb 191.3 temp_ub_q0p75_o48 -48.00 143.3 FORMAT "%5.1" /end CHARACTERISTIC
/begin CHARACTERISTIC TMOTDE "tmot-Ersatzwert bei tmot- und tzyl-Fehler" VALUE 0x4EC5EE KwUb 191.3 temp_ub_q0p75_o48 -48.00 143.3 FORMAT "%5.1" /end CHARACTERISTIC
/begin CHARACTERISTIC TMOTELI "Temperatur Motor Erfassung u. Linearisierung, Inverskennlinie" CURVE 0x4EC5F0 KlAUbSstUbWUb 191.3 temp_ub_q0p75_o48 -48.00 143.3 FORMAT "%5.1"
 /begin AXIS_DESCR STD_AXIS wtmot spg_ub_b5 20 0.00 4.980 FORMAT "%5.3" DEPOSIT ABSOLUTE /end AXIS_DESCR
/end CHARACTERISTIC
/begin CHARACTERISTIC TMOTZYLDE "Ersatzwert Kopftemperatur" VALUE 0x4EC732 KwUw 49151.25 temp_ub_q0p75_o48 -48.00000 49103.25 FORMAT "%8.2" /end CHARACTERISTIC
/begin CHARACTERISTIC TMOTZYLELI " Temperatur Kopftemperatur-Erfassung u. Linearisierung Inverskennlinie" CURVE 0x4EC6D4 KlAUbSstUwWUw 49151.25 temp_ub_q0p75_o48 -48.00000 49103.25 FORMAT "%8.2"
 /begin AXIS_DESCR STD_AXIS utzyl1_w spg_uw_q0p00488 20 0.00 319.9951 FORMAT "%8.4" DEPOSIT ABSOLUTE /end AXIS_DESCR
/end CHARACTERISTIC
/begin CHARACTERISTIC TMVL "Motortemperaturschwelle f¸r Vollasterkennung" VALUE 0x4EC51D KwUb 191.3 temp_ub_q0p75_o48 -48.00 143.3 FORMAT "%5.1" /end CHARACTERISTIC
/begin CHARACTERISTIC TNSRT "Max.-Zeit ab Start f¸r Retriggerung Berechnung Motortemperaturmodell" VALUE 0x4EC619 KwUb 255.0 t1sxs_ub_b255 0.00 255.0 FORMAT "%5.1" /end CHARACTERISTIC
/begin CHARACTERISTIC TNSTKO "Unterdr¸ckungszeit des Kompressors nach dem Start" VALUE 0x4E96FA KwUb 51.00 t200msxs_ub_b51 0.00 51.00 FORMAT "%5.2" /end CHARACTERISTIC
/begin CHARACTERISTIC TSGELI "Temperatur Steuerger‰t- Erfassung und Linearisierung" CURVE 0x4EC6AC KlAUbSstUbWUb 191.3 temp_ub_q0p75_o48 -48.00 143.3 FORMAT "%5.1"
 /begin AXIS_DESCR STD_AXIS wtsg spg_ub_b5 18 0.00 4.980 FORMAT "%5.3" DEPOSIT ABSOLUTE /end AXIS_DESCR
/end CHARACTERISTIC
/begin CHARACTERISTIC TSTSG "Zeitintervall f¸r Erfassung SG-Temperatur-Histogramm" VALUE 0x4EC6D1 KwUb 254.0 t1sxs_ub_b255 1.000 255.0 FORMAT "%5.1" /end CHARACTERISTIC
/begin CHARACTERISTIC TVDK "Verzˆgerungszeit nach Schlieﬂen der Drosselklappe" VALUE 0x4E59F9 KwUb 5.100 t20msxs_ub_b5p1 0.00 5.100 FORMAT "%5.3" /end CHARACTERISTIC
/begin CHARACTERISTIC TVHSV "" VALUE 0x4EA9B5 KwUb 25.50 t100msxs_ub_b25p5 0.00 25.50 FORMAT "%5.2" /end CHARACTERISTIC
/begin CHARACTERISTIC TVKOE "Verzˆgerungszeit f¸r Kompressor EIN" VALUE 0x4E96FB KwUb 51.00 t200msxs_ub_b51 0.00 51.00 FORMAT "%5.2" /end CHARACTERISTIC
/begin CHARACTERISTIC TVKUPPL "Verzˆgerungszeit f¸r die Information des Kupplungsschalter" VALUE 0x4E59FA KwUb 5.100 t20msxs_ub_b5p1 0.00 5.100 FORMAT "%5.3" /end CHARACTERISTIC
/begin CHARACTERISTIC TVLLRI "Verzˆgerungszeit f¸r Freigabe I-Anteil nach Start" CURVE 0x4E59FC KlAUbSstUbWUb 5.100 t20msxs_ub_b5p1 0.00 5.100 FORMAT "%5.3"
 /begin AXIS_DESCR STD_AXIS tmot temp_ub_q0p75_o48 6 -48.00 143.3 FORMAT "%5.1" DEPOSIT ABSOLUTE /end AXIS_DESCR
/end CHARACTERISTIC
/begin CHARACTERISTIC TVLLRMRTEV "Verzˆgerungszeit MD-Reserve Wegnahme nach TEV-Drehzahlpr¸." VALUE 0x4E5BD1 KwUb 51.00 t200msxs_ub_b51 0.00 51.00 FORMAT "%5.2" /end CHARACTERISTIC
/begin CHARACTERISTIC TVLLRPD "Maximale Verzˆgerungszeit f¸r Freigabe PD-Anteil nach Start" CURVE 0x4E5A0C KlAUbSstUbWUb 5.100 t20msxs_ub_b5p1 0.00 5.100 FORMAT "%5.3"
 /begin AXIS_DESCR STD_AXIS tmot temp_ub_q0p75_o48 6 -48.00 143.3 FORMAT "%5.1" DEPOSIT ABSOLUTE /end AXIS_DESCR
/end CHARACTERISTIC
/begin CHARACTERISTIC TVRESFS "Haltezeit f¸r die erhˆhte Momentenrerserve nach Einlegen der Fahrstufe" VALUE 0x4ED747 KwUb 51.00 t200msxs_ub_b51 0.00 51.00 FORMAT "%5.2" /end CHARACTERISTIC
/begin CHARACTERISTIC TVRESLL "Haltezeit f¸r die erhˆhte Momentenrerserve nach Drehzahleinbruch" VALUE 0x4ED748 KwUb 51.00 t200msxs_ub_b51 0.00 51.00 FORMAT "%5.2" /end CHARACTERISTIC
/begin CHARACTERISTIC TWLRTMS "Wartezeit f¸r Diagnose TMOT-Einschaltbedingung lambda-Regelung" CURVE 0x4EC690 KlAUbSstUbWUw 6553.500 t100msxs_uw_b6553p5 0.00 6553.500 FORMAT "%8.3"
 /begin AXIS_DESCR STD_AXIS tmst temp_ub_q0p75_o48 4 -48.00 143.3 FORMAT "%5.1" DEPOSIT ABSOLUTE /end AXIS_DESCR
/end CHARACTERISTIC
/begin CHARACTERISTIC TWTMNHST "Wartezeit f¸r tmot-Max-Diagnose nach Heiﬂstart" VALUE 0x4EC61A KwUb 255.0 t1sxs_ub_b255 0.00 255.0 FORMAT "%5.1" /end CHARACTERISTIC
/begin CHARACTERISTIC TZVER "Z‰hlerzeit f¸r Adaptionsverzˆgerung in KRDY" VALUE 0x4ED07E KwUb 25.50 t100msxs_ub_b25p5 0.00 25.50 FORMAT "%5.2" /end CHARACTERISTIC
/begin CHARACTERISTIC UBDE "Ubatt - Ersatzwert bei defektem AD - Kanal" VALUE 0x4E500C KwUb 24.02 spg_ubatt 0.00 24.02 FORMAT "%5.2" /end CHARACTERISTIC
/begin CHARACTERISTIC UBDMN1 "Batteriespannung min. (Netz)" VALUE 0x4E500D KwUb 24.02 spg_ubatt 0.00 24.02 FORMAT "%5.2" /end CHARACTERISTIC
/begin CHARACTERISTIC UBDMN2 "Batteriespannung min. (ADC)" VALUE 0x4E500E KwUb 24.02 spg_ubatt 0.00 24.02 FORMAT "%5.2" /end CHARACTERISTIC
/begin CHARACTERISTIC UBDMX "Batteriespannung max." VALUE 0x4E500F KwUb 24.02 spg_ubatt 0.00 24.02 FORMAT "%5.2" /end CHARACTERISTIC
/begin CHARACTERISTIC UBHS "Batteriespannungsschwelle f¸r Abschalten der Sondenheizung" VALUE 0x4EA9B6 KwUb 24.02 spg_ubatt 0.00 24.02 FORMAT "%5.2" /end CHARACTERISTIC
/begin CHARACTERISTIC UEBERSETZ_G "" CURVE 0x4E988E KlAUwSstUwWUw 15.00000 fak_uw_b16 0.00 15.00000 FORMAT "%8.5"
 /begin AXIS_DESCR STD_AXIS gangi dez 7 0.00 15.00000 FORMAT "%8.5" DEPOSIT ABSOLUTE /end AXIS_DESCR
/end CHARACTERISTIC
/begin CHARACTERISTIC UEBERSETZ_H "" VALUE 0x4EF592 KwUw 15.99976 fak_uw_b16 0.00 15.99976 FORMAT "%8.5" /end CHARACTERISTIC
/begin CHARACTERISTIC UHSN "Nennspannung f¸r die Sondenheizung" VALUE 0x4EA9B7 KwUb 24.02 spg_ubatt 0.00 24.02 FORMAT "%5.2" /end CHARACTERISTIC
/begin CHARACTERISTIC UMIN "Spannungsschwelle f¸er Kurzschlusserkennung BTS" VALUE 0x4ECAA2 KwUb 24.02 spg_ubatt 0.00 24.02 FORMAT "%5.2" /end CHARACTERISTIC
/begin CHARACTERISTIC VFZMN "Erkennen Fahren-Stehen" VALUE 0x4E5204 KwWU16 511.9922 vfzg_uw_b512 0.00 511.9922 FORMAT "%8.4" /end CHARACTERISTIC
/begin CHARACTERISTIC VKOAO "Obere Geschwindigkeitsschwelle f¸r Kompressorabschaltung" VALUE 0x4E96FC KwUb 318.8 vfzg_ub_q1p25 0.00 318.8 FORMAT "%5.1" /end CHARACTERISTIC
/begin CHARACTERISTIC VLLR "Fahrzeuggeschwindigkeitsschwelle f¸r Leerlaufregelung" VALUE 0x4E5A19 KwUb 318.8 vfzg_ub_q1p25 0.00 318.8 FORMAT "%5.1" /end CHARACTERISTIC
/begin CHARACTERISTIC VMDUB "Geschwindigkeitsschwelle min. f¸r Batteriespannungs-Diagnose" VALUE 0x4E5010 KwUb 318.8 vfzg_ub_q1p25 0.00 318.8 FORMAT "%5.1" /end CHARACTERISTIC
/begin CHARACTERISTIC VNLBZHI "" VALUE 0x4E5A47 KwUb 260.0 vfzg_ub_q1p25 0.00 260.0 FORMAT "%5.1" /end CHARACTERISTIC
/begin CHARACTERISTIC VS100ZWKR "Zylinderindividuelle ZW-Verstellung durch VS100" VAL_BLK 0x4E572C KwbWS8 190.5 zw_sb_qn0p75 -95.25 95.25 FORMAT "%5.2" NUMBER 8 /end CHARACTERISTIC
/begin CHARACTERISTIC ZDLBTS "Zeitkonstante Delta Lambda Bauteileschutz" VALUE 0x4EC224 KwUw 6553.50000 zk100msxs_uw_b6553 0.100001526 6553.60000 FORMAT "%10.5" /end CHARACTERISTIC
/begin CHARACTERISTIC ZFLASKH "Zeitkonstante f¸r ‹bergang auf Lambda-Abgas-Vorgabe" VALUE 0x4ECDC6 KwUb 25.4996 zk100msxs_ub_b25p5 0.100392 25.6000 FORMAT "%7.4" /end CHARACTERISTIC
/begin CHARACTERISTIC ZFTMOT "Zeitkonstante Tiefpaﬂfilter tmot" VALUE 0x4EC69E KwUw 6553.500 t100msxs_uw_b6553p5 0.00 6553.500 FORMAT "%8.3" /end CHARACTERISTIC
/begin CHARACTERISTIC ZFTZYL "Zeitkonstante Filter Kopftemperatur" VALUE 0x4EC726 KwUb 5.08000 zk20msxs_ub_b5p1 0.0200000 5.10000 FORMAT "%7.5" /end CHARACTERISTIC
/begin CHARACTERISTIC ZKBKVAB "Zeitkonstante Absteuerung Momentenreserve Katheizen f¸r BKV" VALUE 0x4ECBED KwUb 25.4996 zk100msxs_ub_b25p5 0.100392 25.6000 FORMAT "%7.4" /end CHARACTERISTIC
/begin CHARACTERISTIC ZKIIBTS "Zeitkonstante f¸er Sicherungsnachbildung BTS" VALUE 0x4ECAA3 KwUb 1.08308 zk10msxs_ub_b2p56 0.196923 1.28000 FORMAT "%7.5" /end CHARACTERISTIC
/begin CHARACTERISTIC ZKMDKH "Filterzeitkonstante bei Wechsel von Teillast nach LL und umgekehrt" VALUE 0x4ECBEE KwUb 25.4996 zk100msxs_ub_b25p5 0.100392 25.6000 FORMAT "%7.4" /end CHARACTERISTIC
/begin CHARACTERISTIC ZKNS "Zeitkonstante f¸r Solldrehzahl bei Umschaltung" VALUE 0x4E5A48 KwUb 5.08000 zk20msxs_ub_b5p1 0.0200000 5.10000 FORMAT "%7.5" /end CHARACTERISTIC
/begin CHARACTERISTIC ZKTMTKA "Zeitkonstante PT1-Filterung Lufttemperaturanteil" VALUE 0x4E4BC7 KwWU8 25.40 t100msxs_ub_b25p5 0.1000 25.50 FORMAT "%5.2" /end CHARACTERISTIC
/begin CHARACTERISTIC ZKTMTMOT "Zeitkonstante PT1-Filterung K¸hlwassertemperaturanteil" VALUE 0x4E4BC8 KwWU8 25.40 t100msxs_ub_b25p5 0.1000 25.50 FORMAT "%5.2" /end CHARACTERISTIC
/begin CHARACTERISTIC ZKTMVFZLU "Zeitkonstante PT1-Filterung Lufttemperaturanteil K¸hlung" VALUE 0x4E4BC9 KwWU8 25.40 t100msxs_ub_b25p5 0.1000 25.50 FORMAT "%5.2" /end CHARACTERISTIC
/begin CHARACTERISTIC ZNLBZ "" VALUE 0x4ED731 KwUb 50.80 t200msxs_ub_b51 0.2000 51.00 FORMAT "%5.2" /end CHARACTERISTIC
/begin CHARACTERISTIC ZNLBZ_OFF "" VALUE 0x4ED732 KwUb 50.80 t200msxs_ub_b51 0.2000 51.00 FORMAT "%5.2" /end CHARACTERISTIC
/begin CHARACTERISTIC ZNSM "Zeitkonstante f¸r Solldrehzahlabregelung" CURVE 0x4E5A4C GklWUb 5.08000 zk20msxs_ub_b5p1 0.0200000 5.10000 FORMAT "%7.5"
 /begin AXIS_DESCR COM_AXIS tmot temp_ub_q0p75_o48 6 -48.00 143.3 AXIS_PTS_REF STM06LLUB /end AXIS_DESCR
/end CHARACTERISTIC
/begin CHARACTERISTIC ZNSMT "Zeitkonstante f¸r Solldrehzahlabregelung gedrosselt" CURVE 0x4E5A54 GklWUb 5.08000 zk20msxs_ub_b5p1 0.0200000 5.10000 FORMAT "%7.5"
 /begin AXIS_DESCR COM_AXIS tmot temp_ub_q0p75_o48 6 -48.00 143.3 AXIS_PTS_REF STM06LLTUB /end AXIS_DESCR
/end CHARACTERISTIC
/begin CHARACTERISTIC ZYRKR "Zylinderzuordnung f¸r maximale Referenzpegelbegrenzung Klopfregelung" VALUE 0x4E5998 KwUb 255.0 dez 0.00 255.0 FORMAT "%5.1" /end CHARACTERISTIC
/begin MEASUREMENT abbwevz "" SWORD kw_q3 1 100 -98304 98301 FORMAT "%8.2" ECU_ADDRESS 0x7FE14E /end MEASUREMENT
/begin MEASUREMENT anzti "ti-Einspritzz‰hler" UBYTE dez 1 100 0 255 FORMAT "%5.1" ECU_ADDRESS 0x7FD82D /end MEASUREMENT
/begin MEASUREMENT anzti_w "ti-Einspritzz‰hler" UWORD dez 1 100 0 65535 FORMAT "%8.2" ECU_ADDRESS 0x7FE150 /end MEASUREMENT
/begin MEASUREMENT asc_brk_ft "" UBYTE B_TRUE 1 100 0 1 BIT_MASK 0x1 FORMAT "%13.11" ECU_ADDRESS 0x7FBCA7 /end MEASUREMENT
/begin MEASUREMENT asc_brk_hd "" UBYTE B_TRUE 1 100 0 1 BIT_MASK 0x1 FORMAT "%13.11" ECU_ADDRESS 0x7FBCA8 /end MEASUREMENT
/begin MEASUREMENT azkrldy "aktueller Wert der KL AZKRLDYN" UBYTE dez 1 100 0 255 FORMAT "%5.1" ECU_ADDRESS 0x7FBCC9 /end MEASUREMENT
/begin MEASUREMENT azkrndy "aktueller Wert der KL AZKRNDYN" UBYTE dez 1 100 0 255 FORMAT "%5.1" ECU_ADDRESS 0x7FBCCA /end MEASUREMENT
/begin MEASUREMENT bbsp1 "Byte f¸r Bedingung B_sp1 als Triggerevent in DCLA" UBYTE dez 1 100 0 255 FORMAT "%5.1" ECU_ADDRESS 0x7FC0C8 /end MEASUREMENT
/begin MEASUREMENT bbsp2 "Byte f¸r Bedingung B_sp2 als Triggerevent in DCLA" UBYTE dez 1 100 0 255 FORMAT "%5.1" ECU_ADDRESS 0x7FC0C9 /end MEASUREMENT
/begin MEASUREMENT bfzgl_b "Fahrzeugl‰ngsbeschleunigung" SBYTE bfzg_sb_q0p217 1 100 -27.776 27.559 FORMAT "%5.2" ECU_ADDRESS 0x7FD82E /end MEASUREMENT
/begin MEASUREMENT Bts_stat "" UBYTE dez 1 100 0 255 FORMAT "%5.1" ECU_ADDRESS 0x7FD63A /end MEASUREMENT
/begin MEASUREMENT Bts_stat2 "" UBYTE dez 1 100 0 255 FORMAT "%5.1" ECU_ADDRESS 0x7FD63B /end MEASUREMENT
/begin MEASUREMENT Bts_stat3 "" UBYTE dez 1 100 0 255 FORMAT "%5.1" ECU_ADDRESS 0x7FD63C /end MEASUREMENT
/begin MEASUREMENT B_acres "Bedingung f¸r Aufbau einer Drehmomentenreserve bei Klimabereitschaft" UBYTE B_TRUE 1 100 0 1 BIT_MASK 0x1 FORMAT "%13.11" ECU_ADDRESS 0x7FBC66 /end MEASUREMENT
/begin MEASUREMENT B_anfw "Bedingung Anfangswert¸bernahme (TMOT-Modell)" UBYTE B_TRUE 1 100 0 1 BIT_MASK 0x1 FORMAT "%13.11" ECU_ADDRESS 0x7FBA72 /end MEASUREMENT
/begin MEASUREMENT B_dslafa "Anfoderung Kurztest oder Adaption in DSLSXXX" UBYTE B_TRUE 1 100 0 1 BIT_MASK 0x1 FORMAT "%13.11" ECU_ADDRESS 0x7FD9EC /end MEASUREMENT
/begin MEASUREMENT B_ekpein "" UBYTE B_TRUE 1 100 0 1 BIT_MASK 0x1 FORMAT "%13.11" ECU_ADDRESS 0x7FD63A /end MEASUREMENT
/begin MEASUREMENT B_fallsa "Bedingung: Funktionsanforderung Drehzahl‰nderung durch Tester aktiv" UBYTE B_TRUE 1 100 0 1 BIT_MASK 0x1 FORMAT "%13.11" ECU_ADDRESS 0x7FBB2C /end MEASUREMENT
/begin MEASUREMENT B_fbstabgm "Bedingung: Faktor Bauteileschutz ¸ber Abgastemperaturmodell" UBYTE B_TRUE 1 100 0 1 BIT_MASK 0x1 FORMAT "%13.11" ECU_ADDRESS 0x7FBA44 /end MEASUREMENT
/begin MEASUREMENT B_fgdtm "Bedingung Freigabe Diagnose Tmot" UBYTE B_TRUE 1 100 0 1 BIT_MASK 0x1 FORMAT "%13.11" ECU_ADDRESS 0x7FBA73 /end MEASUREMENT
/begin MEASUREMENT B_hsve "Bedingung Endstufe Sondenheizung vor Kat angesteuert" UBYTE B_TRUE 1 100 0 1 BIT_MASK 0x1 FORMAT "%13.11" ECU_ADDRESS 0x7FB999 /end MEASUREMENT
/begin MEASUREMENT B_hsve2 "Bedingung Endstufe Sondenheizung2 vor Kat angesteuert" UBYTE B_TRUE 1 100 0 1 BIT_MASK 0x1 FORMAT "%13.11" ECU_ADDRESS 0x7FB99A /end MEASUREMENT
/begin MEASUREMENT B_hsvmx "" UBYTE B_TRUE 1 100 0 1 BIT_MASK 0x1 FORMAT "%13.11" ECU_ADDRESS 0x7FB99B /end MEASUREMENT
/begin MEASUREMENT B_hsvmx2 "" UBYTE B_TRUE 1 100 0 1 BIT_MASK 0x1 FORMAT "%13.11" ECU_ADDRESS 0x7FB99C /end MEASUREMENT
/begin MEASUREMENT B_iekpmx "Bedingung EKP BTS ‹berstrom" UBYTE B_TRUE 1 100 0 1 BIT_MASK 0x4 FORMAT "%13.11" ECU_ADDRESS 0x7FD63B /end MEASUREMENT
/begin MEASUREMENT B_isysmx "Bedingung System BTS ‹berstrom" UBYTE B_TRUE 1 100 0 1 BIT_MASK 0x4 FORMAT "%13.11" ECU_ADDRESS 0x7FD63A /end MEASUREMENT
/begin MEASUREMENT B_izdgmx "Bedingung Z¸ndungs BTS ‹berstrom" UBYTE B_TRUE 1 100 0 1 BIT_MASK 0x40 FORMAT "%13.11" ECU_ADDRESS 0x7FD63A /end MEASUREMENT
/begin MEASUREMENT B_killfall "" UBYTE B_TRUE 1 100 0 1 BIT_MASK 0x4 FORMAT "%13.11" ECU_ADDRESS 0x7FD63C /end MEASUREMENT
/begin MEASUREMENT B_killrise "" UBYTE B_TRUE 1 100 0 1 BIT_MASK 0x2 FORMAT "%13.11" ECU_ADDRESS 0x7FD63C /end MEASUREMENT
/begin MEASUREMENT B_kl "Bedingung f¸r erkannte Klopfer" UBYTE B_TRUE 1 100 0 1 BIT_MASK 0x1 FORMAT "%13.11" ECU_ADDRESS 0x7FBAF0 /end MEASUREMENT
/begin MEASUREMENT B_kldynrm "Bedingung normales Klopfen bei adapt. Lastdynamik" UBYTE B_TRUE 1 100 0 1 BIT_MASK 0x1 FORMAT "%13.11" ECU_ADDRESS 0x7FBADD /end MEASUREMENT
/begin MEASUREMENT B_kldystk "Bedingung starkes Klopfen bei adapt. Lastdynamik" UBYTE B_TRUE 1 100 0 1 BIT_MASK 0x1 FORMAT "%13.11" ECU_ADDRESS 0x7FBADE /end MEASUREMENT
/begin MEASUREMENT B_koe "Bedingung f¸r Kompressoreinschalten" UBYTE B_TRUE 1 100 0 1 BIT_MASK 0x1 FORMAT "%13.11" ECU_ADDRESS 0x7FBC67 /end MEASUREMENT
/begin MEASUREMENT B_koena "Bedingung Kompressor freigegeben" UBYTE B_TRUE 1 100 0 1 BIT_MASK 0x1 FORMAT "%13.11" ECU_ADDRESS 0x7FBC68 /end MEASUREMENT
/begin MEASUREMENT B_komnoff "Bedingung Kompresszor-Mindestabschaltzeit abgelaufen" UBYTE B_TRUE 1 100 0 1 BIT_MASK 0x1 FORMAT "%13.11" ECU_ADDRESS 0x7FBC69 /end MEASUREMENT
/begin MEASUREMENT B_komnon "Bedingung Kompresszor-Mindesteinschaltzeit abgelaufen" UBYTE B_TRUE 1 100 0 1 BIT_MASK 0x1 FORMAT "%13.11" ECU_ADDRESS 0x7FBC6A /end MEASUREMENT
/begin MEASUREMENT B_komxoff "Bedingung Kompresszor-Hˆchstabschaltzeit abgelaufen" UBYTE B_TRUE 1 100 0 1 BIT_MASK 0x1 FORMAT "%13.11" ECU_ADDRESS 0x7FBC6B /end MEASUREMENT
/begin MEASUREMENT B_kooff "Bedingung f¸r hartes Kompressorabschalten" UBYTE B_TRUE 1 100 0 1 BIT_MASK 0x1 FORMAT "%13.11" ECU_ADDRESS 0x7FBC6C /end MEASUREMENT
/begin MEASUREMENT B_kosta "Bedingung f¸r Einfrieren des aktuellen Kompressorzustandes" UBYTE B_TRUE 1 100 0 1 BIT_MASK 0x1 FORMAT "%13.11" ECU_ADDRESS 0x7FBC6D /end MEASUREMENT
/begin MEASUREMENT B_kr "Bedingung Klopregelung aktiv" UBYTE B_TRUE 1 100 0 1 BIT_MASK 0x1 FORMAT "%13.11" ECU_ADDRESS 0x7FBAE6 /end MEASUREMENT
/begin MEASUREMENT B_kra "KR-Adaption aktiv" UBYTE B_TRUE 1 100 0 1 BIT_MASK 0x1 FORMAT "%13.11" ECU_ADDRESS 0x7FBAE7 /end MEASUREMENT
/begin MEASUREMENT B_kras "KR-Adaption schreiben zul‰ssig" UBYTE B_TRUE 1 100 0 1 BIT_MASK 0x1 FORMAT "%13.11" ECU_ADDRESS 0x7FBAE8 /end MEASUREMENT
/begin MEASUREMENT B_krldy "Bedingung Lastdynamik f¸r Klopferkennung aktiv" UBYTE B_TRUE 1 100 0 1 BIT_MASK 0x1 FORMAT "%13.11" ECU_ADDRESS 0x7FBADF /end MEASUREMENT
/begin MEASUREMENT B_krldya "Bedingung Lastdynamikvorhalt und -adaption aktiv" UBYTE B_TRUE 1 100 0 1 BIT_MASK 0x1 FORMAT "%13.11" ECU_ADDRESS 0x7FBAE0 /end MEASUREMENT
/begin MEASUREMENT B_krldyf "Bedingung Adaption Lastdynamikvorhalt nach fr¸h freigegeben" UBYTE B_TRUE 1 100 0 1 BIT_MASK 0x1 FORMAT "%13.11" ECU_ADDRESS 0x7FBAE1 /end MEASUREMENT
/begin MEASUREMENT B_krldyofok "" UBYTE B_TRUE 1 100 0 1 BIT_MASK 0x1 FORMAT "%13.11" ECU_ADDRESS 0x7FBAE2 /end MEASUREMENT
/begin MEASUREMENT B_krldyok "" UBYTE B_TRUE 1 100 0 1 BIT_MASK 0x1 FORMAT "%13.11" ECU_ADDRESS 0x7FBAE3 /end MEASUREMENT
/begin MEASUREMENT B_krmrll "" UBYTE B_TRUE 1 100 0 1 BIT_MASK 0x1 FORMAT "%13.11" ECU_ADDRESS 0x7FBAF1 /end MEASUREMENT
/begin MEASUREMENT B_krndy "Bedingung Drehzahldynamik f¸r Klopferkennung aktiv" UBYTE B_TRUE 1 100 0 1 BIT_MASK 0x1 FORMAT "%13.11" ECU_ADDRESS 0x7FBAE4 /end MEASUREMENT
/begin MEASUREMENT B_krsadyn "Bedingung Adaptions-Delay nach SA" UBYTE B_TRUE 1 100 0 1 BIT_MASK 0x1 FORMAT "%13.11" ECU_ADDRESS 0x7FBAE5 /end MEASUREMENT
/begin MEASUREMENT B_ksa "Bedingung Ersatzsensor A wird benutzt" UBYTE B_TRUE 1 100 0 1 BIT_MASK 0x1 FORMAT "%13.11" ECU_ADDRESS 0x7FBAE9 /end MEASUREMENT
/begin MEASUREMENT B_ksb "Bedingung Ersatzsensor B wird benutzt" UBYTE B_TRUE 1 100 0 1 BIT_MASK 0x1 FORMAT "%13.11" ECU_ADDRESS 0x7FBAEA /end MEASUREMENT
/begin MEASUREMENT B_ktm_ini "Bedingung KTM-Initialisierung" UBYTE B_TRUE 1 100 0 1 FORMAT "%13.11" ECU_ADDRESS 0x7FD7FB /end MEASUREMENT
/begin MEASUREMENT B_lalgf "Bedingung Laufgrenze ""Lambda fett"" aktiv" UBYTE B_TRUE 1 100 0 1 BIT_MASK 0x1 FORMAT "%13.11" ECU_ADDRESS 0x7FBA48 /end MEASUREMENT
/begin MEASUREMENT B_lalgf2 "Bedingung Laufgrenze ""Lambda fett"" aktiv" UBYTE B_TRUE 1 100 0 1 BIT_MASK 0x1 FORMAT "%13.11" ECU_ADDRESS 0x7FBA49 /end MEASUREMENT
/begin MEASUREMENT B_lambts "Lambda f¸r Bauteileschutz ist aktiv" UBYTE B_TRUE 1 100 0 1 BIT_MASK 0x1 FORMAT "%13.11" ECU_ADDRESS 0x7FBA4A /end MEASUREMENT
/begin MEASUREMENT B_lambts2 "Lambda f¸r Bauteileschutz ist aktiv (Bank2)" UBYTE B_TRUE 1 100 0 1 BIT_MASK 0x1 FORMAT "%13.11" ECU_ADDRESS 0x7FBA4B /end MEASUREMENT
/begin MEASUREMENT B_lamka "Lambda f¸r Kat-Ausr‰umen aktiv" UBYTE B_TRUE 1 100 0 1 BIT_MASK 0x1 FORMAT "%13.11" ECU_ADDRESS 0x7FBA4C /end MEASUREMENT
/begin MEASUREMENT B_lamka2 "Lambda f¸r Kat-Ausr‰umen aktiv" UBYTE B_TRUE 1 100 0 1 BIT_MASK 0x1 FORMAT "%13.11" ECU_ADDRESS 0x7FBA4D /end MEASUREMENT
/begin MEASUREMENT B_lamkh "Bedingung Lambdasoll f¸r Katheizen aktiv" UBYTE B_TRUE 1 100 0 1 BIT_MASK 0x1 FORMAT "%13.11" ECU_ADDRESS 0x7FBA4E /end MEASUREMENT
/begin MEASUREMENT B_lamkhe "keine Lambdaanforderung seitens LAKH" UBYTE B_TRUE 1 100 0 1 BIT_MASK 0x1 FORMAT "%13.11" ECU_ADDRESS 0x7FBAD3 /end MEASUREMENT
/begin MEASUREMENT B_lamnswl "Lambda-Motor-Soll f¸r Nachstart und Warmlauf aktiv" UBYTE B_TRUE 1 100 0 1 BIT_MASK 0x1 FORMAT "%13.11" ECU_ADDRESS 0x7FBA4F /end MEASUREMENT
/begin MEASUREMENT B_lamsdef "Bedingung : definierte Soll-Lambda" UBYTE B_TRUE 1 100 0 1 BIT_MASK 0x1 FORMAT "%13.11" ECU_ADDRESS 0x7FBA50 /end MEASUREMENT
/begin MEASUREMENT B_ldef "Bedingung : definierte Soll-Lambda Bank1" UBYTE B_TRUE 1 100 0 1 BIT_MASK 0x1 FORMAT "%13.11" ECU_ADDRESS 0x7FBA51 /end MEASUREMENT
/begin MEASUREMENT B_ldef2 "Bedingung : definierte Soll-Lambda Bank2" UBYTE B_TRUE 1 100 0 1 BIT_MASK 0x1 FORMAT "%13.11" ECU_ADDRESS 0x7FBA52 /end MEASUREMENT
/begin MEASUREMENT B_lkrall "Bedingung  Leerlaufadaption aktiv" UBYTE B_TRUE 1 100 0 1 BIT_MASK 0x1 FORMAT "%13.11" ECU_ADDRESS 0x7FBAEB /end MEASUREMENT
/begin MEASUREMENT B_llr "Bedingung Leerlaufregelung" UBYTE B_TRUE 1 100 0 1 BIT_MASK 0x1 FORMAT "%13.11" ECU_ADDRESS 0x7FBB27 /end MEASUREMENT
/begin MEASUREMENT B_llrein "Bedingung LLR ist aktiv" UBYTE B_TRUE 1 100 0 1 BIT_MASK 0x1 FORMAT "%13.11" ECU_ADDRESS 0x7FBB28 /end MEASUREMENT
/begin MEASUREMENT B_llri "Bedingung I-Anteil der LLR aktiv" UBYTE B_TRUE 1 100 0 1 BIT_MASK 0x1 FORMAT "%13.11" ECU_ADDRESS 0x7FBB29 /end MEASUREMENT
/begin MEASUREMENT B_llrpd "Bedingung PD-Anteil der LLR aktiv" UBYTE B_TRUE 1 100 0 1 BIT_MASK 0x1 FORMAT "%13.11" ECU_ADDRESS 0x7FBB2A /end MEASUREMENT
/begin MEASUREMENT B_mxmntm "Bedingung min-oder max-Fehler Motortemp¸eraturf¸hler vorhanden" UBYTE B_TRUE 1 100 0 1 BIT_MASK 0x1 FORMAT "%13.11" ECU_ADDRESS 0x7FBA74 /end MEASUREMENT
/begin MEASUREMENT B_nac "Bedingung f¸r erhˆhte LL-Drehzahl bei Klimaanlage" UBYTE B_TRUE 1 100 0 1 BIT_MASK 0x1 FORMAT "%13.11" ECU_ADDRESS 0x7FBC6E /end MEASUREMENT
/begin MEASUREMENT B_nivns "Bedingung niedrige Solldrehzahl" UBYTE B_TRUE 1 100 0 1 BIT_MASK 0x1 FORMAT "%13.11" ECU_ADDRESS 0x7FBB2D /end MEASUREMENT
/begin MEASUREMENT B_nlbfast "" UBYTE B_TRUE 1 100 0 1 BIT_MASK 0x1 FORMAT "%13.11" ECU_ADDRESS 0x7FBB2E /end MEASUREMENT
/begin MEASUREMENT B_nlboff "" UBYTE B_TRUE 1 100 0 1 BIT_MASK 0x1 FORMAT "%13.11" ECU_ADDRESS 0x7FBB2F /end MEASUREMENT
/begin MEASUREMENT B_nlbon "" UBYTE B_TRUE 1 100 0 1 BIT_MASK 0x1 FORMAT "%13.11" ECU_ADDRESS 0x7FBB30 /end MEASUREMENT
/begin MEASUREMENT B_nokatfz "Bedingung Nicht-KAT Fahrzeug" UBYTE B_TRUE 1 100 0 1 BIT_MASK 0x1 FORMAT "%13.11" ECU_ADDRESS 0x7FBAD2 /end MEASUREMENT
/begin MEASUREMENT B_nsabg "Bedingung Abgleich Solldrehzahl" UBYTE B_TRUE 1 100 0 1 BIT_MASK 0x1 FORMAT "%13.11" ECU_ADDRESS 0x7FBB26 /end MEASUREMENT
/begin MEASUREMENT B_rehs "Restart Sondenheizung" UBYTE B_TRUE 1 100 0 1 BIT_MASK 0x1 FORMAT "%13.11" ECU_ADDRESS 0x7FB99D /end MEASUREMENT
/begin MEASUREMENT B_tabgbts "Bedingung Abgastemperatur f¸r Bauteileschutz ¸berschritten" UBYTE B_TRUE 1 100 0 1 BIT_MASK 0x1 FORMAT "%13.11" ECU_ADDRESS 0x7FBA45 /end MEASUREMENT
/begin MEASUREMENT B_tevtini "TEV timer wurde neu initialisiert" UBYTE B_TRUE 1 100 0 1 BIT_MASK 0x1 FORMAT "%13.11" ECU_ADDRESS 0x7FBAA9 /end MEASUREMENT
/begin MEASUREMENT B_tkatbts "Bedingung Katalysatortemperatur f¸r Bauteileschutz ¸berschritten" UBYTE B_TRUE 1 100 0 1 BIT_MASK 0x1 FORMAT "%13.11" ECU_ADDRESS 0x7FBA46 /end MEASUREMENT
/begin MEASUREMENT B_tmdmme "Bedingung Endtemperatur von Motortemperaturmodell erreicht" UBYTE B_TRUE 1 100 0 1 BIT_MASK 0x1 FORMAT "%13.11" ECU_ADDRESS 0x7FBA75 /end MEASUREMENT
/begin MEASUREMENT B_tmkr "Bedingung Temperatur (tmot) fuer KR aktiv erreicht" UBYTE B_TRUE 1 100 0 1 BIT_MASK 0x1 FORMAT "%13.11" ECU_ADDRESS 0x7FBAEC /end MEASUREMENT
/begin MEASUREMENT B_tmmn "Bedingung: Blockheater erkannt" UBYTE B_TRUE 1 100 0 1 BIT_MASK 0x1 FORMAT "%13.11" ECU_ADDRESS 0x7FBA76 /end MEASUREMENT
/begin MEASUREMENT B_tmsrt "Bedingung Retriggerung Motortemperaturmodell nach Start" UBYTE B_TRUE 1 100 0 1 BIT_MASK 0x1 FORMAT "%13.11" ECU_ADDRESS 0x7FBA77 /end MEASUREMENT
/begin MEASUREMENT B_uekpmn "Schwelle f¸r Versorgungsspannung" UBYTE B_TRUE 1 100 0 1 BIT_MASK 0x8 FORMAT "%13.11" ECU_ADDRESS 0x7FD63B /end MEASUREMENT
/begin MEASUREMENT B_usysmn "Schwelle f¸r Versorgungsspannung" UBYTE B_TRUE 1 100 0 1 BIT_MASK 0x8 FORMAT "%13.11" ECU_ADDRESS 0x7FD63A /end MEASUREMENT
/begin MEASUREMENT B_uzdgmn "Schwelle f¸r Versorgungsspannung" UBYTE B_TRUE 1 100 0 1 BIT_MASK 0x80 FORMAT "%13.11" ECU_ADDRESS 0x7FD63A /end MEASUREMENT
/begin MEASUREMENT B_vla "Bedingung Vollastanreicherung > 1.0" UBYTE B_TRUE 1 100 0 1 BIT_MASK 0x1 FORMAT "%13.11" ECU_ADDRESS 0x7FBA47 /end MEASUREMENT
/begin MEASUREMENT B_vllr "Bedingung Fahrzeug rollt mit eingelegtem Gang" UBYTE B_TRUE 1 100 0 1 BIT_MASK 0x1 FORMAT "%13.11" ECU_ADDRESS 0x7FBB2B /end MEASUREMENT
/begin MEASUREMENT B_wkral "Bedingung wkr aus KR-Adaptionskennfeld einlesen" UBYTE B_TRUE 1 100 0 1 BIT_MASK 0x1 FORMAT "%13.11" ECU_ADDRESS 0x7FBAED /end MEASUREMENT
/begin MEASUREMENT B_zwkraa "Bedingung Z¸ndwinkel der KR wird ausgegeben" UBYTE B_TRUE 1 100 0 1 BIT_MASK 0x1 FORMAT "%13.11" ECU_ADDRESS 0x7FBAEE /end MEASUREMENT
/begin MEASUREMENT B_zwkrum "Flag: schnelle Fr¸hverstellung" UBYTE B_TRUE 1 100 0 1 BIT_MASK 0x1 FORMAT "%13.11" ECU_ADDRESS 0x7FBAEF /end MEASUREMENT
/begin MEASUREMENT detazwbs "Delta ZW-Wirkungsgrad f¸r Bauteileschutz" UBYTE rel_ub_b127p5 1 100 0 127.5 FORMAT "%5.1" ECU_ADDRESS 0x7FD5D6 /end MEASUREMENT
/begin MEASUREMENT dk_pos_asc "" SWORD relDK_q0p02441 1 100 -800 799.976 FORMAT "%8.4" ECU_ADDRESS 0x7FBD08 /end MEASUREMENT
/begin MEASUREMENT dlambts_w "" SWORD fak_sw_b8 1 100 -8 7.99976 FORMAT "%8.6" ECU_ADDRESS 0x7FD5DC /end MEASUREMENT
/begin MEASUREMENT dmdresdtev "Delta-Momentenreserve f¸r TEV Drehzahlcheck" SBYTE rel_sb_q0p0976 1 100 -12.4988 12.4012 FORMAT "%5.2" ECU_ADDRESS 0x7FDA4D /end MEASUREMENT
/begin MEASUREMENT dmdresfs "dyn. Delta-Moment nach eingelegter Fahrstufe" UBYTE rel_ub_b24p9 1 100 0 24.9 FORMAT "%5.2" ECU_ADDRESS 0x7FDA4E /end MEASUREMENT
/begin MEASUREMENT dmlllmn_w "Reservemomentschwelle f¸r Lufteingriffe" SWORD rel_sw_b100 1 100 -100 99.9969 FORMAT "%8.4" ECU_ADDRESS 0x7FDE62 /end MEASUREMENT
/begin MEASUREMENT dmrdsls_w "Momentenreserve f¸r Diagnose Sekund‰rluft" UWORD rel_uw_b100 1 100 0 99.9985 FORMAT "%8.5" ECU_ADDRESS 0x7FD660 /end MEASUREMENT
/begin MEASUREMENT dmrkh "Momenten-Reserve f¸r Katheizen" UBYTE rel_ub_b99p6 1 100 0 99.6094 FORMAT "%5.2" ECU_ADDRESS 0x7FD65C /end MEASUREMENT
/begin MEASUREMENT dmrkhz_w "Momentenreserve f¸r Katheizen" UWORD rel_uw_b100 1 100 0 99.9985 FORMAT "%8.5" ECU_ADDRESS 0x7FD662 /end MEASUREMENT
/begin MEASUREMENT dmrkh_w "Momentenreserve f¸r Katheizen" UWORD rel_uw_b100 1 100 0 99.9985 FORMAT "%8.5" ECU_ADDRESS 0x7FD664 /end MEASUREMENT
/begin MEASUREMENT dmrkrll "" UWORD rel_q0p09726 1 100 0 6399.3 FORMAT "%8.3" ECU_ADDRESS 0x7FDE4A /end MEASUREMENT
/begin MEASUREMENT dmrllr_w "Momenten-Reserve f¸r Leerlaufregelung" UWORD rel_q0p09726 1 100 0 6399.3 FORMAT "%8.3" ECU_ADDRESS 0x7FDE64 /end MEASUREMENT
/begin MEASUREMENT dnfsacmv "LLRNS: Delta-Solldrehzahl von DS2-Kommunikator, AC mit FS" SBYTE nmotd_sb_q10 1 100 -1280 1270 FORMAT "%5.0" ECU_ADDRESS 0x7FD6CF /end MEASUREMENT
/begin MEASUREMENT dnfsmv "LLRNS: Delta-Solldrehzahl von DS2-Kommunikator, mit FS" SBYTE nmotd_sb_q10 1 100 -1280 1270 FORMAT "%5.0" ECU_ADDRESS 0x7FD6D0 /end MEASUREMENT
/begin MEASUREMENT dnllmv "LLRNS: Delta-Solldrehzahl von DS2-Kommunikator" SBYTE nmotd_sb_q10 1 100 -1280 1270 FORMAT "%5.0" ECU_ADDRESS 0x7FD6D1 /end MEASUREMENT
/begin MEASUREMENT dns "LLR: Drehzahlabweichung zur station‰ren Solldrehzahl" SBYTE nmotd_sb_q10 1 100 -1280 1270 FORMAT "%5.0" ECU_ADDRESS 0x7FDA44 /end MEASUREMENT
/begin MEASUREMENT dnsacmv "LLRNS: Delta-Solldrehzahl von DS2-Kommunikator, AC ohne FS" SBYTE nmotd_sb_q10 1 100 -1280 1270 FORMAT "%5.0" ECU_ADDRESS 0x7FD6D2 /end MEASUREMENT
/begin MEASUREMENT dnslbv "LLRNS: Delta-Solldrehzahl von DS2-Kommunikator, aus LLRUB" SBYTE nmotd_sb_q10 1 100 -1280 1270 FORMAT "%5.0" ECU_ADDRESS 0x7FD6D3 /end MEASUREMENT
/begin MEASUREMENT drkwtmp_w "Momentenreserve f¸r Kat warmhalten, zeitweise" UWORD rel_uw_b100 1 100 0 99.9985 FORMAT "%8.5" ECU_ADDRESS 0x7FD666 /end MEASUREMENT
/begin MEASUREMENT dweksw "aktueller KL-Wert delta Winkel Ersatz-Klopfsensor" UBYTE zw_ub_qn0p75 1 100 -191.25 0 FORMAT "%5.1" ECU_ADDRESS 0x7FD831 /end MEASUREMENT
/begin MEASUREMENT dwkr "zylinderindividuelle Z¸ndwinkelsp‰tverstellung KR" SBYTE zw_sb_q0p75 1 100 -96 95.25 FORMAT "%5.2" ECU_ADDRESS 0x7FD9F4 /end MEASUREMENT
/begin MEASUREMENT dwkrkorll "" SBYTE zw_sb_q0p75 1 100 -96 95.25 FORMAT "%5.2" ECU_ADDRESS 0x7FDA3D /end MEASUREMENT
/begin MEASUREMENT dwkrkorlls "" UBYTE zw_ub_q0p75 1 100 0 191.25 FORMAT "%5.1" ECU_ADDRESS 0x7FDA3E /end MEASUREMENT
/begin MEASUREMENT dwkrmsw "aktueller Wert f¸r Mittelwertbegrenzung der Sp‰tverstellung" UBYTE zw_ub_qn0p75 1 100 -191.25 0 FORMAT "%5.1" ECU_ADDRESS 0x7FD9F5 /end MEASUREMENT
/begin MEASUREMENT dwkrz "zyl.ind. ZW-Sp‰tverstellung inkl. Dyn.vorhalt" SBYTE zw_sb_q0p75 1 100 -96 95.25 FORMAT "%5.2" ARRAY_SIZE 8 ECU_ADDRESS 0x7FD9F8 /end MEASUREMENT
/begin MEASUREMENT dyesehof_w "aktueller Wert Offset f¸r Lastdynamikerkennungsschwelle" SWORD hub_uw_q0p001 1 100 -32.768 32.767 FORMAT "%8.5" ECU_ADDRESS 0x7FDE3C /end MEASUREMENT
/begin MEASUREMENT dyesehv_w "aktueller Wert Lastdynamikerkennungsschwelle" SWORD hub_uw_q0p001 1 100 -32.768 32.767 FORMAT "%8.5" ECU_ADDRESS 0x7FDE3E /end MEASUREMENT
/begin MEASUREMENT dyesofv_w "aktueller Wert Offset f¸r Lastdynamikerkennungsschwelle" SWORD relDK_q0p02441 1 100 -800 799.976 FORMAT "%8.4" ECU_ADDRESS 0x7FDE40 /end MEASUREMENT
/begin MEASUREMENT dyesv_w "aktueller Wert Lastdynamikerkennungsschwelle" SWORD relDK_q0p02441 1 100 -800 799.976 FORMAT "%8.4" ECU_ADDRESS 0x7FDE42 /end MEASUREMENT
/begin MEASUREMENT dzwg "Delta Z¸ndwinkel Grund-ZW zu Optimal-ZW" SBYTE zw_sb_q0p75 1 100 -96 95.25 FORMAT "%5.2" ECU_ADDRESS 0x7FD5D7 /end MEASUREMENT
/begin MEASUREMENT dzwibts "" SBYTE zw_sb_q0p75 1 100 -96 95.25 FORMAT "%5.2" ECU_ADDRESS 0x7FD5D8 /end MEASUREMENT
/begin MEASUREMENT eskillold "" UBYTE B_TRUE 1 100 0 1 BIT_MASK 0x1 FORMAT "%13.11" ECU_ADDRESS 0x7FD63C /end MEASUREMENT
/begin MEASUREMENT esst_snm08koub "" ULONG dez 1 100 0 4.29497e+009 FORMAT "%13.2" ECU_ADDRESS 0x7FE580 /end MEASUREMENT
/begin MEASUREMENT esst_sns06llsb "" ULONG dez 1 100 0 4.29497e+009 FORMAT "%13.2" ECU_ADDRESS 0x7FE490 /end MEASUREMENT
/begin MEASUREMENT esst_sns06lltsb "" ULONG dez 1 100 0 4.29497e+009 FORMAT "%13.2" ECU_ADDRESS 0x7FE494 /end MEASUREMENT
/begin MEASUREMENT etazwg "Wirkungsgrad beim Grundz¸ndwinkel" UBYTE rel_ub_b127p5 1 100 0 127.5 FORMAT "%5.1" ECU_ADDRESS 0x7FD5D9 /end MEASUREMENT
/begin MEASUREMENT etazwibts "" UBYTE rel_ub_b127p5 1 100 0 127.5 FORMAT "%5.1" ECU_ADDRESS 0x7FD5DA /end MEASUREMENT
/begin MEASUREMENT etazwim "" UBYTE rel_ub_b127p5 1 100 0 127.5 FORMAT "%5.1" ECU_ADDRESS 0x7FD5DB /end MEASUREMENT
/begin MEASUREMENT fkbkvab "Faktor Reduzierung Reservemoment f¸r Bremskraftverst‰rker" UBYTE fak_ub_b1 1 100 0 0.996094 ECU_ADDRESS 0x7FD65D /end MEASUREMENT
/begin MEASUREMENT fketm "" UBYTE fak_ub_b4 1 100 0 3.98438 FORMAT "%5.3" ECU_ADDRESS 0x7FD838 /end MEASUREMENT
/begin MEASUREMENT fktmsch "Korrekturfaktor f¸r Steigung Modelltemperatur bei Schichtbetrieb" UBYTE fak_ub_b2 1 100 0 1.99219 FORMAT "%5.3" ECU_ADDRESS 0x7FD606 /end MEASUREMENT
/begin MEASUREMENT fkvaum_ee "EEPROM Ablage von FKVAUM" UWORD tefuel_uw_b312p5 1 100 0 312.5 FORMAT "%8.4" ECU_ADDRESS 0x7F9CA2 /end MEASUREMENT
/begin MEASUREMENT flaskh "Faktor ‹bergang zu Lambda-Abgas bei Sekund‰rluft" UBYTE fak_ub_b1 1 100 0 0.996094 ECU_ADDRESS 0x7FD66C /end MEASUREMENT
/begin MEASUREMENT flmsslkh "Faktor Lambda-Motor-Soll-Sekund‰rluftanteil, resultierend" UBYTE fak_ub_b1 1 100 0 0.996094 ECU_ADDRESS 0x7FD66D /end MEASUREMENT
/begin MEASUREMENT fmkhfho_w "Hˆhenkorrektur der Drehmomentenreserve bei Katheizen" UWORD fak_uw_b2 1 100 0 1.99997 FORMAT "%8.6" ECU_ADDRESS 0x7FD668 /end MEASUREMENT
/begin MEASUREMENT fmkhtmst "tmst-Korrektur der Drehmomentreserve bei Katheizen" UBYTE fak_ub_b2 1 100 0 1.99219 FORMAT "%5.3" ECU_ADDRESS 0x7FD65E /end MEASUREMENT
/begin MEASUREMENT fra10_w "" UWORD fak_uw_b2 1 100 0 1.99997 FORMAT "%8.6" ECU_ADDRESS 0x7FDCEC /end MEASUREMENT
/begin MEASUREMENT fra2_10_w "" UWORD fak_uw_b2 1 100 0 1.99997 FORMAT "%8.6" ECU_ADDRESS 0x7FDCEE /end MEASUREMENT
/begin MEASUREMENT fslsdyn "Faktor Dynamikbeschreibung Sekund‰rluftsystem" UBYTE fak_ub_b1 1 100 0 0.996094 ECU_ADDRESS 0x7FD66E /end MEASUREMENT
/begin MEASUREMENT fvst2_w "" UWORD fak_uw_b64 1 100 0 63.999 FORMAT "%8.5" ECU_ADDRESS 0x7FDCF0 /end MEASUREMENT
/begin MEASUREMENT fvst_w "Faktor Vorsteuerung" UWORD fak_uw_b64 1 100 0 63.999 FORMAT "%8.5" ECU_ADDRESS 0x7FDCF2 /end MEASUREMENT
/begin MEASUREMENT gearatio_w "" UWORD fak_uw_b16 1 100 0 15.9998 FORMAT "%8.5" ECU_ADDRESS 0x7FE0BE /end MEASUREMENT
/begin MEASUREMENT iekp "" UBYTE i_ub_q0p391 1 100 0 50 FORMAT "%5.2" ECU_ADDRESS 0x7FD987 /end MEASUREMENT
/begin MEASUREMENT iiekpf_w "Stromquadrat EKP gefiltert" UWORD ii_uw_b2621 1 100 0 2499.96 FORMAT "%8.3" ECU_ADDRESS 0x7FDDC0 /end MEASUREMENT
/begin MEASUREMENT iiekp_w "Stromquadrat EKP" UWORD ii_uw_b2621 1 100 0 2499.96 FORMAT "%8.3" ECU_ADDRESS 0x7FDDC2 /end MEASUREMENT
/begin MEASUREMENT iisysf_w "Stromquadrat System gefiltert" UWORD ii_uw_b2621 1 100 0 2499.96 FORMAT "%8.3" ECU_ADDRESS 0x7FDDC4 /end MEASUREMENT
/begin MEASUREMENT iisys_w "Stromquadrat System" UWORD ii_uw_b2621 1 100 0 2499.96 FORMAT "%8.3" ECU_ADDRESS 0x7FDDC6 /end MEASUREMENT
/begin MEASUREMENT iizdgf_w "Stromquadrat Z¸ndung gefiltert" UWORD ii_uw_b2621 1 100 0 2499.96 FORMAT "%8.3" ECU_ADDRESS 0x7FDDC8 /end MEASUREMENT
/begin MEASUREMENT iizdg_w "Stromquadrat Z¸ndung" UWORD ii_uw_b2621 1 100 0 2499.96 FORMAT "%8.3" ECU_ADDRESS 0x7FDDCA /end MEASUREMENT
/begin MEASUREMENT ikrn_w "Normiertes Klopfintegral rollierend mit Zylinderz‰hler" UWORD spg_uw_b1280 1 100 0 1279.96 FORMAT "%7.2" ECU_ADDRESS 0x7FDE48 /end MEASUREMENT
/begin MEASUREMENT isys "" UBYTE i_ub_q0p391 1 100 0 50 FORMAT "%5.2" ECU_ADDRESS 0x7FD988 /end MEASUREMENT
/begin MEASUREMENT izdg "" UBYTE i_ub_q0p391 1 100 0 50 FORMAT "%5.2" ECU_ADDRESS 0x7FD989 /end MEASUREMENT
/begin MEASUREMENT ke "Klopferkennungsschwelle aus Kennlinie" UBYTE fak_ub_b4 1 100 0 3.98438 FORMAT "%5.3" ARRAY_SIZE 8 ECU_ADDRESS 0x7FDA14 /end MEASUREMENT
/begin MEASUREMENT kek "Klopferkennungsschwelle korrigiert" UBYTE fak_ub_b4 1 100 0 3.98438 FORMAT "%5.3" ARRAY_SIZE 8 ECU_ADDRESS 0x7FDA1C /end MEASUREMENT
/begin MEASUREMENT kek_tst "Klopferkennungsschwelle korrigiert rollierend mit Zyl.z‰hler" UBYTE fak_ub_b4 1 100 0 3.98438 FORMAT "%5.3" ECU_ADDRESS 0x7FDA24 /end MEASUREMENT
/begin MEASUREMENT kereffw "Ausgang KEREFF" UBYTE rel_ub_b100 1 100 0.392157 100 FORMAT "%5.1" ECU_ADDRESS 0x7FD839 /end MEASUREMENT
/begin MEASUREMENT kerefldyw "" UBYTE rel_ub_b100 1 100 0.392157 100 FORMAT "%5.1" ECU_ADDRESS 0x7FD83A /end MEASUREMENT
/begin MEASUREMENT kerefndyw "" UBYTE rel_ub_b100 1 100 0.392157 100 FORMAT "%5.1" ECU_ADDRESS 0x7FD83B /end MEASUREMENT
/begin MEASUREMENT kezkkl "zyl.-ind. Z‰hler f¸r nicht klopfende Arbeitsspiele (Z‰hler kein Klopfen)" UWORD dez 1 100 0 65535 FORMAT "%8.2" ARRAY_SIZE 2 ECU_ADDRESS 0x7FE15C /end MEASUREMENT
/begin MEASUREMENT kezkklmx "zyl.-ind. max. Z‰hlerstand f¸r nicht klopfende Arbeitsspiele" UWORD dez 1 100 0 65535 FORMAT "%8.2" ARRAY_SIZE 2 ECU_ADDRESS 0x7FE160 /end MEASUREMENT
/begin MEASUREMENT kezmxmit "Mittelwert der max. Z‰hlerst‰nde aller Zylinder (Z‰hler max. Summe)" UWORD dez 1 100 0 65535 FORMAT "%8.2" ECU_ADDRESS 0x7FE164 /end MEASUREMENT
/begin MEASUREMENT kral1w "aktueller Wert Last-Adaptionsbereich 1" UBYTE rel_ub_q0p75 1 100 0 191.25 FORMAT "%5.1" ECU_ADDRESS 0x7FD6A6 /end MEASUREMENT
/begin MEASUREMENT kral2w "aktueller Wert Last-Adaptionsbereich 2" UBYTE rel_ub_q0p75 1 100 0 191.25 FORMAT "%5.1" ECU_ADDRESS 0x7FD6A7 /end MEASUREMENT
/begin MEASUREMENT krdwsw "aktueller KL-Wert der Sicherheitssp‰tverstellung" UBYTE zw_ub_qn0p75 1 100 -191.25 0 FORMAT "%5.1" ECU_ADDRESS 0x7FDA00 /end MEASUREMENT
/begin MEASUREMENT krfkw "Aktueller Wert aus KRFKN" UBYTE zw_ub_qn0p75 1 100 -191.25 0 FORMAT "%5.1" ECU_ADDRESS 0x7FDA01 /end MEASUREMENT
/begin MEASUREMENT krmxw "aktueller Wert f¸r Sp‰tbegrenzung der Sp‰tverstellung" UBYTE zw_ub_qn0p75 1 100 -191.25 0 FORMAT "%5.1" ECU_ADDRESS 0x7FDA02 /end MEASUREMENT
/begin MEASUREMENT krvfakt "" UBYTE dez 1 100 0 255 FORMAT "%5.1" ECU_ADDRESS 0x7FDA03 /end MEASUREMENT
/begin MEASUREMENT krvfsw "Initwert f¸r schnelle Fr¸hverstellung" UBYTE dez 1 100 0 255 FORMAT "%5.1" ECU_ADDRESS 0x7FDA04 /end MEASUREMENT
/begin MEASUREMENT krvfw "Initwert f¸r normale Fr¸hverstellung" UBYTE dez 1 100 0 255 FORMAT "%5.1" ECU_ADDRESS 0x7FDA05 /end MEASUREMENT
/begin MEASUREMENT ksa "Nummer des Klopfsensors" UBYTE dezsub1 1 100 1 256 FORMAT "%5.1" ECU_ADDRESS 0x7FD832 /end MEASUREMENT
/begin MEASUREMENT ksb "Ersatzklopfsensor B" UBYTE dezsub1 1 100 1 256 FORMAT "%5.1" ECU_ADDRESS 0x7FD833 /end MEASUREMENT
/begin MEASUREMENT ksdefa "Nummer des defekten Klopfsensors von Ersatzsensor A" UBYTE dezsub1 1 100 1 256 FORMAT "%5.1" ECU_ADDRESS 0x7FD834 /end MEASUREMENT
/begin MEASUREMENT ksdefb "Nummer des defekten Klopfsensors von Ersatzsensor B" UBYTE dezsub1 1 100 1 256 FORMAT "%5.1" ECU_ADDRESS 0x7FD835 /end MEASUREMENT
/begin MEASUREMENT kvarest "KVA-Rest" UWORD fuel_uw_b1 1 100 0 0.999985 FORMAT "%9.7" ECU_ADDRESS 0x7FE1EA /end MEASUREMENT
/begin MEASUREMENT kvaverbr "Verbrauchte Kraftstoffmenge ¸ber CAN; normiert in u-Liter" UWORD fuel_uw_b65535 1 100 0 65535 FORMAT "%8.2" ECU_ADDRESS 0x7FE1EC /end MEASUREMENT
/begin MEASUREMENT kvaverbrko "zu korrigierende Kraftstoffmenge" UWORD fuel_uw_b65535 1 100 0 65535 FORMAT "%8.2" ECU_ADDRESS 0x7FE1EE /end MEASUREMENT
/begin MEASUREMENT kva_korr "Korrekturfaktor f¸r die Kraftstoffmenge" SBYTE rel_uw_q0p001 1 100 -0.128 0.127 FORMAT "%6.4" ECU_ADDRESS 0x7F9CA0 /end MEASUREMENT
/begin MEASUREMENT L9935_current_position "" UWORD dez 1 100 0 65535 FORMAT "%8.2" ARRAY_SIZE 2 ECU_ADDRESS 0x7FDB26 /end MEASUREMENT
/begin MEASUREMENT L9935_errors "" UWORD dez 1 100 0 65535 FORMAT "%8.2" ARRAY_SIZE 16 ECU_ADDRESS 0x7FDB2A /end MEASUREMENT
/begin MEASUREMENT L9935_sdo "" UBYTE dez 1 100 0 255 FORMAT "%5.1" ARRAY_SIZE 8 ECU_ADDRESS 0x7FD87F /end MEASUREMENT
/begin MEASUREMENT LAKHlokBits "" UBYTE dez 1 100 0 255 FORMAT "%5.1" ECU_ADDRESS 0x7FD9EC /end MEASUREMENT
/begin MEASUREMENT lambas "Basis-Lambda" UBYTE fak_ub_b2 1 100 0 1.99219 FORMAT "%5.3" ECU_ADDRESS 0x7FD951 /end MEASUREMENT
/begin MEASUREMENT lambts_w "Lambda f¸r Bauteileschutz" UWORD fak_uw_b16 1 100 0 15.9998 FORMAT "%8.5" ECU_ADDRESS 0x7FD5DE /end MEASUREMENT
/begin MEASUREMENT lamfa_w "Lambdasoll Fahrerwunsch (word)" UWORD fak_uw_b16 1 100 0 15.9998 FORMAT "%8.5" ECU_ADDRESS 0x7FD5E4 /end MEASUREMENT
/begin MEASUREMENT lamfb "" UBYTE fak_ub_b2 1 100 0 1.99219 FORMAT "%5.3" ECU_ADDRESS 0x7FD5E2 /end MEASUREMENT
/begin MEASUREMENT lamkh2_w "Lambda-Motor-Soll bei Katheizen, Bank 2 (word)" UWORD fak_q0p000244 1 100 0 15.9998 FORMAT "%8.5" ECU_ADDRESS 0x7FDE34 /end MEASUREMENT
/begin MEASUREMENT lamkhe2_w "Lambda-Motor-Soll bei Katheizen, effektiv, Bank 2" UWORD fak_uw_b16 1 100 0 15.9998 FORMAT "%8.5" ECU_ADDRESS 0x7FDD0A /end MEASUREMENT
/begin MEASUREMENT lamkhe_w "Lambda-Motor-Soll bei Katheizen, effektiv" UWORD fak_uw_b16 1 100 0 15.9998 FORMAT "%8.5" ECU_ADDRESS 0x7FDD0C /end MEASUREMENT
/begin MEASUREMENT lamkhg2_w "Lambda-Motor-Soll bei Katheizen (word) gewichtet mit flakh, Bank 2" UWORD fak_q0p000244 1 100 0 15.9998 FORMAT "%8.5" ECU_ADDRESS 0x7FDE36 /end MEASUREMENT
/begin MEASUREMENT lamkhg_w "Lambda-Motor-Soll bei Katheizen (word) gewichtet mit flakh" UWORD fak_q0p000244 1 100 0 15.9998 FORMAT "%8.5" ECU_ADDRESS 0x7FDE38 /end MEASUREMENT
/begin MEASUREMENT lamkhr2_w "Lambda-Motor-Soll resultierend bei Katheizen, Bank 2 (word)" UWORD fak_q0p000244 1 100 0 15.9998 FORMAT "%8.5" ECU_ADDRESS 0x7FD670 /end MEASUREMENT
/begin MEASUREMENT lamkhr_w "Lambda-Motor-Soll resultierend bei Katheizen (word)" UWORD fak_q0p000244 1 100 0 15.9998 FORMAT "%8.5" ECU_ADDRESS 0x7FD672 /end MEASUREMENT
/begin MEASUREMENT lamkh_w "Lambda-Motor-Soll bei Katheizen (word)" UWORD fak_q0p000244 1 100 0 15.9998 FORMAT "%8.5" ECU_ADDRESS 0x7FDE3A /end MEASUREMENT
/begin MEASUREMENT lamlgfmn "Lambda Motorlaufgrenze fett" UBYTE fak_ub_b2 1 100 0 1.99219 FORMAT "%5.3" ECU_ADDRESS 0x7FD5E6 /end MEASUREMENT
/begin MEASUREMENT lamlgm "Laufgrenze ""Lambda mager""" UBYTE fak_ub_b2 1 100 0 1.99219 FORMAT "%5.3" ECU_ADDRESS 0x7FD5E7 /end MEASUREMENT
/begin MEASUREMENT lams2_w "Lambdasoll (word)" UWORD fak_uw_b16 1 100 0 15.9998 FORMAT "%8.5" ECU_ADDRESS 0x7FDD0E /end MEASUREMENT
/begin MEASUREMENT lamsbg2_w "Lambdasoll Begrenzung (word) Bank2" UWORD fak_uw_b16 1 100 0 15.9998 FORMAT "%8.5" ECU_ADDRESS 0x7FDD10 /end MEASUREMENT
/begin MEASUREMENT lamsbg_w "Lambdasoll Begrenzung (word)" UWORD fak_uw_b16 1 100 0 15.9998 FORMAT "%8.5" ECU_ADDRESS 0x7FDD12 /end MEASUREMENT
/begin MEASUREMENT lamsl "" UWORD fak_uw_b16 1 100 0 15.9998 FORMAT "%8.5" ECU_ADDRESS 0x7FD5E8 /end MEASUREMENT
/begin MEASUREMENT lamsl2 "" UWORD fak_uw_b16 1 100 0 15.9998 FORMAT "%8.5" ECU_ADDRESS 0x7FD5EA /end MEASUREMENT
/begin MEASUREMENT lamsons2_w "Lambda-Sollwert bezogen auf Einbauort Lambda-Sensor Bank2" UWORD fak_uw_b16 1 100 0 15.9998 FORMAT "%8.5" ECU_ADDRESS 0x7FDD14 /end MEASUREMENT
/begin MEASUREMENT lamsons_w "Lambda-Sollwert bezogen auf Einbauort Lambda-Sensor" UWORD fak_uw_b16 1 100 0 15.9998 FORMAT "%8.5" ECU_ADDRESS 0x7FDD16 /end MEASUREMENT
/begin MEASUREMENT lamsos2_w "Lambda-Sollwert bezogen auf Einbauort Lambda-Sensor Bank2" UWORD fak_uw_b16 1 100 0 15.9998 FORMAT "%8.5" ECU_ADDRESS 0x7FDD18 /end MEASUREMENT
/begin MEASUREMENT lamsos_w "Lambda-Sollwert bezogen auf Einbauort Lambda-Sensor" UWORD fak_uw_b16 1 100 0 15.9998 FORMAT "%8.5" ECU_ADDRESS 0x7FDD1A /end MEASUREMENT
/begin MEASUREMENT lamsubg2_w "Lambdasoll unbegrenzt (word)" UWORD fak_uw_b16 1 100 0 15.9998 FORMAT "%8.5" ECU_ADDRESS 0x7FDD1C /end MEASUREMENT
/begin MEASUREMENT lamsubg_w "Lambdasoll unbegrenzt (word)" UWORD fak_uw_b16 1 100 0 15.9998 FORMAT "%8.5" ECU_ADDRESS 0x7FDD1E /end MEASUREMENT
/begin MEASUREMENT lams_w "Lambdasoll (word)" UWORD fak_uw_b16 1 100 0 15.9998 FORMAT "%8.5" ECU_ADDRESS 0x7FDD20 /end MEASUREMENT
/begin MEASUREMENT lamvoa2_w "Lambdavorsteuerung ohne additive Anteile" UWORD fak_uw_b16 1 100 0 15.9998 FORMAT "%8.5" ECU_ADDRESS 0x7FDD22 /end MEASUREMENT
/begin MEASUREMENT lamvoa_w "Lambdavorsteuerung ohne additive Anteile" UWORD fak_uw_b16 1 100 0 15.9998 FORMAT "%8.5" ECU_ADDRESS 0x7FDD24 /end MEASUREMENT
/begin MEASUREMENT lam_1 "interner Ausgang" UBYTE fak_ub_b2 1 100 0 1.99219 FORMAT "%5.3" ECU_ADDRESS 0x7FD959 /end MEASUREMENT
/begin MEASUREMENT lam_2 "interner Ausgang" UBYTE fak_ub_b2 1 100 0 1.99219 FORMAT "%5.3" ECU_ADDRESS 0x7FD95A /end MEASUREMENT
/begin MEASUREMENT lanskh_w "Lambda-Motor-Soll im Nachstart bei Katheizen" UWORD fak_q0p000244 1 100 0 15.9998 FORMAT "%8.5" ECU_ADDRESS 0x7FD674 /end MEASUREMENT
/begin MEASUREMENT lasdslg2_w "Lambda-Abgas-Soll f¸r Sekund‰rluftdiagnose Bank 2 gewichtet mit flamsl2" UWORD fak_q0p000244 1 100 0 15.9998 FORMAT "%8.5" ECU_ADDRESS 0x7FD676 /end MEASUREMENT
/begin MEASUREMENT lasdslg_w "Lambda-Abgas-Soll f¸r Sekund‰rluftdiagnose gewichtet mit flamsl" UWORD fak_q0p000244 1 100 0 15.9998 FORMAT "%8.5" ECU_ADDRESS 0x7FD678 /end MEASUREMENT
/begin MEASUREMENT lasdsl_w "Lambda-Abgas-Soll f¸r Sekund‰rluftdiagnose" UWORD fak_q0p000244 1 100 0 15.9998 FORMAT "%8.5" ECU_ADDRESS 0x7FD67A /end MEASUREMENT
/begin MEASUREMENT laskh_w "Lambda-Abgas-Soll bei Katheizen (word)" UWORD fak_q0p000244 1 100 0 15.9998 FORMAT "%8.5" ECU_ADDRESS 0x7FD67C /end MEASUREMENT
/begin MEASUREMENT lbts_w "Lambda f¸r Bauteileschutz aus Station‰rkennfeld" UWORD fak_uw_b16 1 100 0 15.9998 FORMAT "%8.5" ECU_ADDRESS 0x7FD5E0 /end MEASUREMENT
/begin MEASUREMENT lkrw "aktueller Wert der Lastschwelle Klopfregelung" UBYTE rel_ub_q0p75 1 100 0 191.25 FORMAT "%5.1" ECU_ADDRESS 0x7FD6A8 /end MEASUREMENT
/begin MEASUREMENT llsstat "Funktionsstatus LLRNS bei Anforderung Systemcheck" UBYTE dez 1 100 0 255 FORMAT "%5.1" ECU_ADDRESS 0x7FD6D4 /end MEASUREMENT
/begin MEASUREMENT lmskh_w "Lambda-Motor-Soll bei katheizen (word)" UWORD fak_q0p000244 1 100 0 15.9998 FORMAT "%8.5" ECU_ADDRESS 0x7FD67E /end MEASUREMENT
/begin MEASUREMENT lmssl2_w "Lambda-Motor-Soll wegen Sekund‰rluft bei Kathezen, Bank 2" UWORD fak_q0p000244 1 100 0 15.9998 FORMAT "%8.5" ECU_ADDRESS 0x7FD680 /end MEASUREMENT
/begin MEASUREMENT lmssl_w "Lambda-Motor-Soll wegen Sekund‰rluft bei Katheizen (word)" UWORD fak_q0p000244 1 100 0 15.9998 FORMAT "%8.5" ECU_ADDRESS 0x7FD682 /end MEASUREMENT
/begin MEASUREMENT manftmew "Monitor Anfangswert TMEW-Bildung" UBYTE temp_ub_q0p75_o48 1 100 -48 143.25 FORMAT "%5.1" ECU_ADDRESS 0x7FD607 /end MEASUREMENT
/begin MEASUREMENT mifakh_w "indiziertes Motormoment f¸r Katheizen" UWORD rel_uw_b100 1 100 0 99.9985 FORMAT "%8.5" ECU_ADDRESS 0x7FD66A /end MEASUREMENT
/begin MEASUREMENT mll1 "Luftmassenfluﬂ bezogen auf lambda=1" UBYTE m_ub_b1020 1 100 0 1020 FORMAT "%5.0" ECU_ADDRESS 0x7FBCB2 /end MEASUREMENT
/begin MEASUREMENT mo_dre_ar "" UWORD md_uw_q0p0625 1 100 0 4095.94 FORMAT "%8.3" ARRAY_SIZE 10 ECU_ADDRESS 0x7FE0C0 /end MEASUREMENT
/begin MEASUREMENT mo_dre_asc "" UWORD md_uw_q0p0625 1 100 0 4095.94 FORMAT "%8.3" ECU_ADDRESS 0x7FE0D4 /end MEASUREMENT
/begin MEASUREMENT mo_dre_i "" UWORD dez 1 100 0 65535 FORMAT "%8.2" ECU_ADDRESS 0x7FE264 /end MEASUREMENT
/begin MEASUREMENT mo_rpm_asc "" UWORD nmot_uw_q0p25 1 100 0 16383.8 FORMAT "%8.2" ECU_ADDRESS 0x7FE266 /end MEASUREMENT
/begin MEASUREMENT msttmew "Monitor Steigung TMEW-Bildung" SBYTE temp_sb_b0p093 1 100 -0.09375 0.0930176 FORMAT "%7.5" ECU_ADDRESS 0x7FD608 /end MEASUREMENT
/begin MEASUREMENT msttmrw "Monitor Steigung TMRW-Bildung" SBYTE temp_sb_b0p093 1 100 -0.09375 0.0930176 FORMAT "%7.5" ECU_ADDRESS 0x7FD609 /end MEASUREMENT
/begin MEASUREMENT ngkrv_w "aktueller Wert Drehzahldynamikschwelle" SWORD nmotg_sw_q0p39 1 100 -12800.2 12799.8 FORMAT "%8.2" ECU_ADDRESS 0x7FDE44 /end MEASUREMENT
/begin MEASUREMENT nngkrv_w "aktueller Wert Drehzahldynamikschwelle" SWORD nmotg_sw_q0p39 1 100 -12800.2 12799.8 FORMAT "%8.2" ECU_ADDRESS 0x7FDE46 /end MEASUREMENT
/begin MEASUREMENT nokatfz_flg "" UBYTE dez 1 100 0 255 FORMAT "%5.1" ECU_ADDRESS 0x7F9C2C /end MEASUREMENT
/begin MEASUREMENT nsfsm "LLR: Motortemperaturabh‰ngige Solldrehzahl im LL bei S_fs=1" UBYTE nmot_ub_q10 1 100 0 2550 FORMAT "%5.0" ECU_ADDRESS 0x7FD6D5 /end MEASUREMENT
/begin MEASUREMENT nsfsmn "LLR: Minimale Solldrehzahl bei eingelegter Fahrstufe" UBYTE nmot_ub_q10 1 100 0 2550 FORMAT "%5.0" ECU_ADDRESS 0x7FDA45 /end MEASUREMENT
/begin MEASUREMENT nslbfast "" UBYTE nmot_ub_q10 1 100 0 2550 FORMAT "%5.0" ECU_ADDRESS 0x7FD6D6 /end MEASUREMENT
/begin MEASUREMENT nslbslow "" UBYTE nmot_ub_q10 1 100 0 2550 FORMAT "%5.0" ECU_ADDRESS 0x7FD6D7 /end MEASUREMENT
/begin MEASUREMENT nslbz "Solldrehtahl abh‰ngig von lbz" UBYTE nmot_ub_q10 1 100 0 2550 FORMAT "%5.0" ECU_ADDRESS 0x7FD6D8 /end MEASUREMENT
/begin MEASUREMENT nsllm "LLR: Motortemperaturabh‰ngige Solldrehzahl im LL" UBYTE nmot_ub_q10 1 100 0 2550 FORMAT "%5.0" ECU_ADDRESS 0x7FD6D9 /end MEASUREMENT
/begin MEASUREMENT nsllmkl "" UBYTE nmot_ub_q10 1 100 0 2550 FORMAT "%5.0" ECU_ADDRESS 0x7FD6DA /end MEASUREMENT
/begin MEASUREMENT nsllmn "LLR: Minimale Solldrehzahl im LL" UBYTE nmot_ub_q10 1 100 0 2550 FORMAT "%5.0" ECU_ADDRESS 0x7FDA46 /end MEASUREMENT
/begin MEASUREMENT nsnf "LLR: Nachgef¸hrte Solldrehzahl" UBYTE nmot_ub_q10 1 100 0 2550 FORMAT "%5.0" ECU_ADDRESS 0x7FDA47 /end MEASUREMENT
/begin MEASUREMENT nsol "Leerlaufsolldrehzahl" UBYTE nmot_ub_q10 1 100 0 2550 FORMAT "%5.0" ECU_ADDRESS 0x7FDA48 /end MEASUREMENT
/begin MEASUREMENT nsol_w "Leerlaufsolldrehzahl" UWORD nmot_uw_q0p25 1 100 0 16383.8 FORMAT "%8.2" ECU_ADDRESS 0x7FDE4C /end MEASUREMENT
/begin MEASUREMENT nsst "Initialisierungswert der Solldrehzahl im Start" UBYTE nmot_ub_q10 1 100 0 2550 FORMAT "%5.0" ECU_ADDRESS 0x7FDA49 /end MEASUREMENT
/begin MEASUREMENT nstat "Solldrehzahl station‰r" UBYTE nmot_ub_q10 1 100 0 2550 FORMAT "%5.0" ECU_ADDRESS 0x7FDA4A /end MEASUREMENT
/begin MEASUREMENT phlsnv "" UBYTE fak_ub_q0p01 1 100 0 2.55 FORMAT "%5.3" ECU_ADDRESS 0x7FD569 /end MEASUREMENT
/begin MEASUREMENT phlsnv2 "" UBYTE fak_ub_q0p01 1 100 0 2.55 FORMAT "%5.3" ECU_ADDRESS 0x7FD56A /end MEASUREMENT
/begin MEASUREMENT rai_dbg_w "" UWORD wink_uw_q0p1 1 100 0 6553.5 FORMAT "%8.3" ECU_ADDRESS 0x7FE0D6 /end MEASUREMENT
/begin MEASUREMENT rai_w "" UWORD wink_uw_q0p1 1 100 0 6553.5 FORMAT "%8.3" ECU_ADDRESS 0x7FE0D8 /end MEASUREMENT
/begin MEASUREMENT rk10_w "" UWORD rel_uw_b3072 1 100 0 3071.95 FORMAT "%8.3" ECU_ADDRESS 0x7FDCF4 /end MEASUREMENT
/begin MEASUREMENT rk2_10_w "" UWORD rel_uw_b3072 1 100 0 3071.95 FORMAT "%8.3" ECU_ADDRESS 0x7FDCF6 /end MEASUREMENT
/begin MEASUREMENT rk2_w "relative Kraftstoffmasse Bank2" UWORD rel_uw_b3072 1 100 0 3071.95 FORMAT "%8.3" ECU_ADDRESS 0x7FDCF8 /end MEASUREMENT
/begin MEASUREMENT rkkva10_w "" UWORD rel_uw_b3072 1 100 0 3071.95 FORMAT "%8.3" ECU_ADDRESS 0x7FDCFA /end MEASUREMENT
/begin MEASUREMENT rkkva2_10_w "" UWORD rel_uw_b3072 1 100 0 3071.95 FORMAT "%8.3" ECU_ADDRESS 0x7FDCFC /end MEASUREMENT
/begin MEASUREMENT rkkva2_w "relative Kraftstoffmasse (f¸r Kraftstoff-Verbrauchs-Anzeige Bank 2)" UWORD rel_uw_b3072 1 100 0 3071.95 FORMAT "%8.3" ECU_ADDRESS 0x7FDCFE /end MEASUREMENT
/begin MEASUREMENT rkkva_w "relative Kraftstoffmasse (f¸r Kraftstoff-Verbrauchs-Anzeige Bank 1)" UWORD rel_uw_b3072 1 100 0 3071.95 FORMAT "%8.3" ECU_ADDRESS 0x7FDD00 /end MEASUREMENT
/begin MEASUREMENT rkr "Referenzpegel Klopfregelung" UBYTE spg_ub_b5 1 100 0 4.98047 FORMAT "%5.3" ARRAY_SIZE 8 ECU_ADDRESS 0x7FDA28 /end MEASUREMENT
/begin MEASUREMENT rkrem1w "" UBYTE fak_ub_b1 1 100 0 0.996094 ECU_ADDRESS 0x7FD83C /end MEASUREMENT
/begin MEASUREMENT rkrem2w "" UBYTE fak_ub_b1 1 100 0 0.996094 ECU_ADDRESS 0x7FD83D /end MEASUREMENT
/begin MEASUREMENT rkrkor "" UBYTE spg_ub_b5 1 100 0 4.98047 FORMAT "%5.3" ARRAY_SIZE 8 ECU_ADDRESS 0x7FD840 /end MEASUREMENT
/begin MEASUREMENT rkrmx1w "aktueller Wert der KL RKRMX1N" UBYTE spg_ub_b320 1 100 0 318.75 ECU_ADDRESS 0x7FDA30 /end MEASUREMENT
/begin MEASUREMENT rkrmx2w "aktueller Wert der KL RKRMX2N" UBYTE spg_ub_b320 1 100 0 318.75 ECU_ADDRESS 0x7FDA31 /end MEASUREMENT
/begin MEASUREMENT rkr_tst "Referenzpegel Klopfregelung rollierend mit Zyl.z‰hler" UBYTE spg_ub_b5 1 100 0 4.98047 FORMAT "%5.3" ECU_ADDRESS 0x7FDA32 /end MEASUREMENT
/begin MEASUREMENT rkte10_w "" SWORD rel_sw_q0p0468 1 100 -1536 1535.95 FORMAT "%8.3" ECU_ADDRESS 0x7FDD02 /end MEASUREMENT
/begin MEASUREMENT rk_w "relative Kraftstoffmasse" UWORD rel_uw_b3072 1 100 0 3071.95 FORMAT "%8.3" ECU_ADDRESS 0x7FDD04 /end MEASUREMENT
/begin MEASUREMENT stkrlx "Lastst¸tzstelle f¸r die KR-Adaption" UBYTE dez 1 100 0 255 FORMAT "%5.1" ECU_ADDRESS 0x7FDA06 /end MEASUREMENT
/begin MEASUREMENT stkrnx "Drehzahlst¸tzstelle f¸r die KR-Adaption" UBYTE dez 1 100 0 255 FORMAT "%5.1" ECU_ADDRESS 0x7FDA07 /end MEASUREMENT
/begin MEASUREMENT tabzyl1_w "Abstelltemperatur Zylinder 1" UWORD temp_ub_q0p75_o48 1 100 -48 49103.3 FORMAT "%8.2" ECU_ADDRESS 0x7F9C08 /end MEASUREMENT
/begin MEASUREMENT tabzyl2_w "Abstelltemperatur Zylinder 2" UWORD temp_ub_q0p75_o48 1 100 -48 49103.3 FORMAT "%8.2" ECU_ADDRESS 0x7F9C0C /end MEASUREMENT
/begin MEASUREMENT tabzyl_w "Mittlere Zylinderabstelltemperatur" UWORD temp_ub_q0p75_o48 1 100 -48 49103.3 FORMAT "%8.2" ECU_ADDRESS 0x7F9C0A /end MEASUREMENT
/begin MEASUREMENT taml "Tastverh‰ltnis E-L¸fter" UBYTE rel_ub_b100 1 100 0 100 FORMAT "%5.1" ECU_ADDRESS 0x7FD985 /end MEASUREMENT
/begin MEASUREMENT tdlrtm_w "Diagnosezeit f¸r ‹berschreitung Motortemperaturschwelle f¸r Lambda-Regelung" UWORD t100msxs_uw_b6553p5 1 100 0 6553.5 FORMAT "%8.3" ECU_ADDRESS 0x7FD612 /end MEASUREMENT
/begin MEASUREMENT tesum_l "Summe effektive Einspritzzeit long word" ULONG dez 1 100 0 4.29497e+009 FORMAT "%13.2" ECU_ADDRESS 0x7FE464 /end MEASUREMENT
/begin MEASUREMENT tevangle "" UWORD kw_q0p02566 1 100 0 1535.98 FORMAT "%8.3" ECU_ADDRESS 0x7FDDB6 /end MEASUREMENT
/begin MEASUREMENT tevdangle "" UWORD kw_q0p02566 1 100 0 1535.98 FORMAT "%8.3" ECU_ADDRESS 0x7FDDB8 /end MEASUREMENT
/begin MEASUREMENT tevduty "" UWORD rel_uw_q0p010 1 100 0 655.35 FORMAT "%8.4" ECU_ADDRESS 0x7FDDBA /end MEASUREMENT
/begin MEASUREMENT tevdutycor "" UWORD rel_uw_q0p010 1 100 0 655.35 FORMAT "%8.4" ECU_ADDRESS 0x7FDDBC /end MEASUREMENT
/begin MEASUREMENT tev_btduty "" SWORD dez 1 100 -32768 32767 FORMAT "%8.2" ECU_ADDRESS 0x7FDDBE /end MEASUREMENT
/begin MEASUREMENT te_ges "" UWORD t3p2usxms_uw_b209p7 1 100 0 209.748 FORMAT "%8.4" ECU_ADDRESS 0x7FE1F0 /end MEASUREMENT
/begin MEASUREMENT thvaist "" UBYTE t10msxs_ub_b2p55 1 100 0 2.55 FORMAT "%5.3" ECU_ADDRESS 0x7FD56B /end MEASUREMENT
/begin MEASUREMENT thvaist2 "" UBYTE t10msxs_ub_b2p55 1 100 0 2.55 FORMAT "%5.3" ECU_ADDRESS 0x7FD56C /end MEASUREMENT
/begin MEASUREMENT thvat "" UBYTE t10msxs_q0p01_o0p05 1 100 -0.05 2.5 FORMAT "%5.3" ECU_ADDRESS 0x7FD56D /end MEASUREMENT
/begin MEASUREMENT thvat2 "" UBYTE t10msxs_q0p01_o0p05 1 100 -0.05 2.5 FORMAT "%5.3" ECU_ADDRESS 0x7FD56E /end MEASUREMENT
/begin MEASUREMENT tireforx_w "" UWORD fak_uw_b4 1 100 0 3.99994 FORMAT "%8.6" ECU_ADDRESS 0x7FE0DA /end MEASUREMENT
/begin MEASUREMENT tirefory_w "" UWORD fak_uw_b4 1 100 0 3.99994 FORMAT "%8.6" ECU_ADDRESS 0x7FE0DC /end MEASUREMENT
/begin MEASUREMENT ti_summe_alt "" ULONG dez 1 100 0 4.29497e+009 FORMAT "%13.2" ECU_ADDRESS 0x7FE468 /end MEASUREMENT
/begin MEASUREMENT tkakor_in "Temperaturdifferenz tmot-tans" SWORD temp_sb_q0p75 1 100 -192 191.25 FORMAT "%8.4" ECU_ADDRESS 0x7FE128 /end MEASUREMENT
/begin MEASUREMENT tkrst "Kraftstofftemperatur" UBYTE temp_ub_q0p75_o48 1 100 -48 143.25 FORMAT "%5.1" ECU_ADDRESS 0x7FD827 /end MEASUREMENT
/begin MEASUREMENT tkrstab "Kraftstofftemperatur beim Abstellen aus Modell" UBYTE temp_ub_q0p75_o48 1 100 -48 143.25 FORMAT "%5.1" ECU_ADDRESS 0x7F9BCC /end MEASUREMENT
/begin MEASUREMENT tkrstluft "Offset durch Lufteinfluss auf tkrst" SBYTE temp_sb_q1p5 1 100 -192 190.5 FORMAT "%5.1" ECU_ADDRESS 0x7FD828 /end MEASUREMENT
/begin MEASUREMENT tkrststart "Startwert f¸r tkrst nach Reset" SWORD temp_sw_q0p75 1 100 -192 191.25 FORMAT "%8.4" ECU_ADDRESS 0x7FE12A /end MEASUREMENT
/begin MEASUREMENT tkrstvt "Rohwert tkrst" SWORD temp_sw_q0p75 1 100 -192 191.25 FORMAT "%8.4" ECU_ADDRESS 0x7FE12C /end MEASUREMENT
/begin MEASUREMENT tkrstwand "Einfluss Wandtemperatur Rail tkrst" SBYTE temp_sb_q1p5 1 100 -192 190.5 FORMAT "%5.1" ECU_ADDRESS 0x7FD829 /end MEASUREMENT
/begin MEASUREMENT tkrstzu "Einfluﬂ Zulaufmassenstrom Kraftstoff mit tumg auf tkrst" SBYTE temp_sb_q1p5 1 100 -192 190.5 FORMAT "%5.1" ECU_ADDRESS 0x7FD82A /end MEASUREMENT
/begin MEASUREMENT tmew "Motortemperatur-Ersatzwert aus Modell" UBYTE temp_ub_q0p75_o48 1 100 -48 143.25 FORMAT "%5.1" ECU_ADDRESS 0x7FD60A /end MEASUREMENT
/begin MEASUREMENT tmewab "Motortemperatur-Ersatzwert aus Modell beim Abstellen" UBYTE temp_ub_q0p75_o48 1 100 -48 143.25 FORMAT "%5.1" ECU_ADDRESS 0x7F9C06 /end MEASUREMENT
/begin MEASUREMENT tmot "Motor-Temperatur" UBYTE temp_ub_q0p75_o48 1 100 -48 143.25 FORMAT "%5.1" ECU_ADDRESS 0x7FD953 /end MEASUREMENT
/begin MEASUREMENT tmotab "Motortemperatur beim Abstellen" UBYTE temp_ub_q0p75_o48 1 100 -48 143.25 FORMAT "%5.1" ECU_ADDRESS 0x7F9C07 /end MEASUREMENT
/begin MEASUREMENT tmotew "tmot-Ersatzwert" UBYTE temp_ub_q0p75_o48 1 100 -48 143.25 FORMAT "%5.1" ECU_ADDRESS 0x7FD60B /end MEASUREMENT
/begin MEASUREMENT tmotlin "Motortemperatur, linearisiert und umgerechnet" UBYTE temp_ub_q0p75_o48 1 100 -48 143.25 FORMAT "%5.1" ECU_ADDRESS 0x7FD60C /end MEASUREMENT
/begin MEASUREMENT tmotlin_w "Motortemperatur, linearisiert und umgerechnet, 16Bit-Wort" UWORD temp_uw_q0p0029_o48 1 100 -48 143.997 FORMAT "%8.4" ECU_ADDRESS 0x7FD614 /end MEASUREMENT
/begin MEASUREMENT tmotvt "Motortemperatur vor Tiefpaﬂfilter" UBYTE temp_ub_q0p75_o48 1 100 -48 143.25 FORMAT "%5.1" ECU_ADDRESS 0x7FD60D /end MEASUREMENT
/begin MEASUREMENT tmotzyl1li "Oeltemperatur linearisiert" UWORD temp_ub_q0p75_o48 1 100 -48 49103.3 FORMAT "%8.2" ECU_ADDRESS 0x7FDD32 /end MEASUREMENT
/begin MEASUREMENT tmotzyl1_w "Kopftemperatur Zyl2" UWORD temp_ub_q0p75_o48 1 100 -48 49103.3 FORMAT "%8.2" ECU_ADDRESS 0x7FDD34 /end MEASUREMENT
/begin MEASUREMENT tmotzyl2li "Oeltemperatur linearisiert" UWORD temp_ub_q0p75_o48 1 100 -48 49103.3 FORMAT "%8.2" ECU_ADDRESS 0x7FDD3C /end MEASUREMENT
/begin MEASUREMENT tmotzyl2_w "Kopftemperatur Zyl2" UWORD temp_ub_q0p75_o48 1 100 -48 49103.3 FORMAT "%8.2" ECU_ADDRESS 0x7FDD3E /end MEASUREMENT
/begin MEASUREMENT tmotzyl_w "Mittlere Kopftemperatur" UWORD temp_ub_q0p75_o48 1 100 -48 49103.3 FORMAT "%8.2" ECU_ADDRESS 0x7FDD36 /end MEASUREMENT
/begin MEASUREMENT tmrw "Motortemperatur-Referenzwert aus Modell" UBYTE temp_ub_q0p75_o48 1 100 -48 143.25 FORMAT "%5.1" ECU_ADDRESS 0x7FD60E /end MEASUREMENT
/begin MEASUREMENT tmrwend "Endwert f¸r Referenzwert Motortemperatur-Modell" UBYTE temp_ub_q0p75_o48 1 100 -48 143.25 FORMAT "%5.1" ECU_ADDRESS 0x7FD60F /end MEASUREMENT
/begin MEASUREMENT tmst "Motorstarttemperatur" UBYTE temp_ub_q0p75_o48 1 100 -48 143.25 FORMAT "%5.1" ECU_ADDRESS 0x7FD610 /end MEASUREMENT
/begin MEASUREMENT tmstzyl1_w "Starttemperatur Zylinder 1" UWORD temp_ub_q0p75_o48 1 100 -48 49103.3 FORMAT "%8.2" ECU_ADDRESS 0x7FDD38 /end MEASUREMENT
/begin MEASUREMENT tmstzyl2_w "Starttemperatur Zylinder 1" UWORD temp_ub_q0p75_o48 1 100 -48 49103.3 FORMAT "%8.2" ECU_ADDRESS 0x7FDD40 /end MEASUREMENT
/begin MEASUREMENT tmstzyl_w "Zylinderstarttemperatur" UWORD temp_ub_q0p75_o48 1 100 -48 49103.3 FORMAT "%8.2" ECU_ADDRESS 0x7FDD3A /end MEASUREMENT
/begin MEASUREMENT tptmot_out "Einfluss ¸ber K¸hlwassertemperatur auf tkrst" UBYTE temp_ub_q0p75_o48 1 100 -48 143.25 FORMAT "%5.1" ECU_ADDRESS 0x7FD82B /end MEASUREMENT
/begin MEASUREMENT tsg "Steuerger‰tetemperatur" UBYTE temp_ub_q0p75_o48 1 100 -48 143.25 FORMAT "%5.1" ECU_ADDRESS 0x7FC0BC /end MEASUREMENT
/begin MEASUREMENT tsg_history_a "" UWORD default 1 100 0 65535 FORMAT "%8.2" ARRAY_SIZE 36 ECU_ADDRESS 0x7F99A8 /end MEASUREMENT
/begin MEASUREMENT t_iekp "" UBYTE t100msxs_ub_b25p5 1 100 0 25.5 FORMAT "%5.2" ECU_ADDRESS 0x7FD63D /end MEASUREMENT
/begin MEASUREMENT t_iekpsc "" UBYTE t100msxs_ub_b25p5 1 100 0 25.5 FORMAT "%5.2" ECU_ADDRESS 0x7FD63E /end MEASUREMENT
/begin MEASUREMENT t_isys "" UBYTE t100msxs_ub_b25p5 1 100 0 25.5 FORMAT "%5.2" ECU_ADDRESS 0x7FD63F /end MEASUREMENT
/begin MEASUREMENT t_isyssc "" UBYTE t100msxs_ub_b25p5 1 100 0 25.5 FORMAT "%5.2" ECU_ADDRESS 0x7FD640 /end MEASUREMENT
/begin MEASUREMENT t_izdg "" UBYTE t100msxs_ub_b25p5 1 100 0 25.5 FORMAT "%5.2" ECU_ADDRESS 0x7FD641 /end MEASUREMENT
/begin MEASUREMENT t_izdgsc "" UBYTE t100msxs_ub_b25p5 1 100 0 25.5 FORMAT "%5.2" ECU_ADDRESS 0x7FD642 /end MEASUREMENT
/begin MEASUREMENT ub "Batteriespannung" UBYTE spg_ubatt 1 100 0 24.021 FORMAT "%5.2" ECU_ADDRESS 0x7FC0CA /end MEASUREMENT
/begin MEASUREMENT ubsq "Bordnetzspannung, umgerechnet in Standard-Quantisierung" UBYTE spg_q0p1 1 100 0 25.5 FORMAT "%5.2" ECU_ADDRESS 0x7FC0CB /end MEASUREMENT
/begin MEASUREMENT ubsqf "Bordnetzspannung, umgerechnet in Standard-Quantisierung und gefiltert" UBYTE spg_q0p1 1 100 0 25.5 FORMAT "%5.2" ECU_ADDRESS 0x7FC0CC /end MEASUREMENT
/begin MEASUREMENT ubsqf_w "Bordnetzspannung, umgerechnet in Standard-Quantisierung und gefiltert" UWORD spg_q0p00039 1 100 0 25.5996 FORMAT "%8.5" ECU_ADDRESS 0x7FDD42 /end MEASUREMENT
/begin MEASUREMENT ubsq_w "Bordnetzspannung, umgerechnet in Standard-Quantisierung" UWORD spg_q0p00039 1 100 0 25.5996 FORMAT "%8.5" ECU_ADDRESS 0x7FDD44 /end MEASUREMENT
/begin MEASUREMENT ub_w "Batteriespannung" UWORD spg_ubatt 1 100 0 6173.4 FORMAT "%8.3" ECU_ADDRESS 0x7FDD46 /end MEASUREMENT
/begin MEASUREMENT udsk "Spannungswert aus Kraftstoffdruck" UBYTE spg_ub_b5 1 100 0 4.98047 FORMAT "%5.3" ECU_ADDRESS 0x7FD976 /end MEASUREMENT
/begin MEASUREMENT udsk_w "" UWORD spg_uw_q0p00488 1 100 0 319.995 FORMAT "%8.4" ECU_ADDRESS 0x7FDDA0 /end MEASUREMENT
/begin MEASUREMENT udsu_w "Spannung Umgebungsdrucksensor (word 10-Bit von ADC)" UWORD spg_uw_b5 1 100 0 319.995 FORMAT "%8.4" ECU_ADDRESS 0x7FD636 /end MEASUREMENT
/begin MEASUREMENT ugetrg "" UBYTE spg_ub_b5 1 100 0 4.98047 FORMAT "%5.3" ECU_ADDRESS 0x7FD977 /end MEASUREMENT
/begin MEASUREMENT uiekp_w "" UWORD spg_uw_q0p00488 1 100 0 319.995 FORMAT "%8.4" ECU_ADDRESS 0x7FDDA2 /end MEASUREMENT
/begin MEASUREMENT uielue_w "" UWORD spg_uw_q0p00488 1 100 0 319.995 FORMAT "%8.4" ECU_ADDRESS 0x7FDDA4 /end MEASUREMENT
/begin MEASUREMENT uisys_w "" UWORD spg_uw_q0p00488 1 100 0 319.995 FORMAT "%8.4" ECU_ADDRESS 0x7FDDA6 /end MEASUREMENT
/begin MEASUREMENT uizdg_w "" UWORD spg_uw_q0p00488 1 100 0 319.995 FORMAT "%8.4" ECU_ADDRESS 0x7FDDA8 /end MEASUREMENT
/begin MEASUREMENT uki1_w "Spannungswert aus Klopfsensorbaustein" UWORD spg_uw_b5 1 100 0 319.995 FORMAT "%8.4" ECU_ADDRESS 0x7FD638 /end MEASUREMENT
/begin MEASUREMENT ukl15 "" UBYTE spg_ubatt 1 100 0 24.021 FORMAT "%5.2" ECU_ADDRESS 0x7FD634 /end MEASUREMENT
/begin MEASUREMENT ulam1 "Mess-Eingang f¸r 0-5 Volt" UBYTE spg_ub_b5 1 100 0 4.98047 FORMAT "%5.3" ECU_ADDRESS 0x7FD978 /end MEASUREMENT
/begin MEASUREMENT ulam2 "Mess-Eingang f¸r 0-5 Volt" UBYTE spg_ub_b5 1 100 0 4.98047 FORMAT "%5.3" ECU_ADDRESS 0x7FD979 /end MEASUREMENT
/begin MEASUREMENT ulsvk1 "" UBYTE spg_ub_b5 1 100 0 4.98047 FORMAT "%5.3" ECU_ADDRESS 0x7FD97A /end MEASUREMENT
/begin MEASUREMENT ulsvk2 "" UBYTE spg_ub_b5 1 100 0 4.98047 FORMAT "%5.3" ECU_ADDRESS 0x7FD97B /end MEASUREMENT
/begin MEASUREMENT urai_w "" UWORD spg_uw_q0p00488 1 100 0 319.995 FORMAT "%8.4" ECU_ADDRESS 0x7FDDAA /end MEASUREMENT
/begin MEASUREMENT utzyl1 "Spannungswert Temperatursensor Zylinder 1" UBYTE spg_ub_b5 1 100 0 4.98047 FORMAT "%5.3" ECU_ADDRESS 0x7FD97C /end MEASUREMENT
/begin MEASUREMENT utzyl1_w "" UWORD spg_uw_q0p00488 1 100 0 319.995 FORMAT "%8.4" ECU_ADDRESS 0x7FDDAC /end MEASUREMENT
/begin MEASUREMENT utzyl2 "Spannungswert Temperatursensor Zylinder 2" UBYTE spg_ub_b5 1 100 0 4.98047 FORMAT "%5.3" ECU_ADDRESS 0x7FD97D /end MEASUREMENT
/begin MEASUREMENT utzyl2_w "" UWORD spg_uw_q0p00488 1 100 0 319.995 FORMAT "%8.4" ECU_ADDRESS 0x7FDDAE /end MEASUREMENT
/begin MEASUREMENT uuekp "" UBYTE spg_ubatt 1 100 0 24.021 FORMAT "%5.2" ECU_ADDRESS 0x7FD97E /end MEASUREMENT
/begin MEASUREMENT uuelue "" UBYTE spg_ubatt 1 100 0 24.021 FORMAT "%5.2" ECU_ADDRESS 0x7FD97F /end MEASUREMENT
/begin MEASUREMENT uulsuv2_w "Sondenspannung vor Kat einer Breitbandlambdasonde Bank2 (ADC-Wert)" UWORD spg_uw_q0p00488 1 100 0 319.995 FORMAT "%8.4" ECU_ADDRESS 0x7FDDB0 /end MEASUREMENT
/begin MEASUREMENT uulsuv_w "Sondenspannung vor Kat einer Breitbandlambdasonde (ADC-Wert)" UWORD spg_uw_q0p00488 1 100 0 319.995 FORMAT "%8.4" ECU_ADDRESS 0x7FDDB2 /end MEASUREMENT
/begin MEASUREMENT uusvk2_w "ADC-Spannung Lambdasonde vor Katalysator 2 (Word)" UWORD spg_uw_q0p00488 1 100 0 319.995 FORMAT "%8.4" ECU_ADDRESS 0x7FE146 /end MEASUREMENT
/begin MEASUREMENT uusvk2_w_1ms "" UWORD spg_uw_q0p00488 1 100 0 319.995 FORMAT "%8.4" ECU_ADDRESS 0x7FE148 /end MEASUREMENT
/begin MEASUREMENT uusvk_w "ADC-Spannung Lambdasonde vor Katalysator (Word)" UWORD spg_uw_q0p00488 1 100 0 319.995 FORMAT "%8.4" ECU_ADDRESS 0x7FE14A /end MEASUREMENT
/begin MEASUREMENT uusvk_w_1ms "" UWORD spg_uw_q0p00488 1 100 0 319.995 FORMAT "%8.4" ECU_ADDRESS 0x7FE14C /end MEASUREMENT
/begin MEASUREMENT uusys "" UBYTE spg_ubatt 1 100 0 24.021 FORMAT "%5.2" ECU_ADDRESS 0x7FD980 /end MEASUREMENT
/begin MEASUREMENT uuzdg "" UBYTE spg_ubatt 1 100 0 24.021 FORMAT "%5.2" ECU_ADDRESS 0x7FD981 /end MEASUREMENT
/begin MEASUREMENT vfzg "Fahrzeuggeschwindigkeit" UBYTE vfzg_ub_q1p25 1 100 0 318.75 FORMAT "%5.1" ECU_ADDRESS 0x7FD82F /end MEASUREMENT
/begin MEASUREMENT vfzg_w "Fahrzeuggeschwindigkeit" UWORD vfzg_uw_b512 1 100 0 511.992 FORMAT "%8.4" ECU_ADDRESS 0x7FE154 /end MEASUREMENT
/begin MEASUREMENT vfzroh_w "Fahrzeuggeschwindigkeit Ausgabewert an SCAN-Tool" UWORD vfzg_uw_b512 1 100 0 511.992 FORMAT "%8.4" ECU_ADDRESS 0x7FE156 /end MEASUREMENT
/begin MEASUREMENT virkr "Verh‰ltnis Integrator / Referenzpegel Klopfregelung" UBYTE fak_ub_b4 1 100 0 3.98438 FORMAT "%5.3" ECU_ADDRESS 0x7FBCDA /end MEASUREMENT
/begin MEASUREMENT vkr "Verst‰rkungsstufe f¸r Eingangsverst‰rkung Klopf-IC" UBYTE dez 1 100 0 255 FORMAT "%5.1" ARRAY_SIZE 8 ECU_ADDRESS 0x7FDA34 /end MEASUREMENT
/begin MEASUREMENT vkr_tst "Verst‰rkungsstufe f¸r Eingangsverst‰rkung Klopf-IC rollierend mit Zyl.z‰hler" UBYTE dez 1 100 0 255 FORMAT "%5.1" ECU_ADDRESS 0x7FDA3C /end MEASUREMENT
/begin MEASUREMENT vroh_w "Fahrzeuggeschwindigkeit ungefiltert" UWORD vfzg_uw_b512 1 100 0 511.992 FORMAT "%8.4" ECU_ADDRESS 0x7FE152 /end MEASUREMENT
/begin MEASUREMENT vszwm "Mittelwert der ZW-Verstellung ¸ber VS2x" SBYTE zw_sb_q0p75 1 100 -96 95.25 FORMAT "%5.2" ECU_ADDRESS 0x7FDA08 /end MEASUREMENT
/begin MEASUREMENT wkr "zylinderindividuelle Z¸ndwinkelsp‰tverstellung KR" UBYTE zw_ub_qn0p75 1 100 -191.25 0 FORMAT "%5.1" ARRAY_SIZE 8 ECU_ADDRESS 0x7FBCD0 /end MEASUREMENT
/begin MEASUREMENT wkra "last und drehzahlabh. Adaptionskennfeld f. wkr" UBYTE zw_ub_qn0p75 1 100 -191.25 0 FORMAT "%5.1" ARRAY_SIZE 168 ECU_ADDRESS 0x7F99F0 /end MEASUREMENT
/begin MEASUREMENT wkratst "wkra mit Synchro-Raster rollierend" UBYTE zw_ub_qn0p75 1 100 -191.25 0 FORMAT "%5.1" ECU_ADDRESS 0x7FDA09 /end MEASUREMENT
/begin MEASUREMENT wkrdy "Z¸ndwinkelsp‰tverstellung bei KR-Dynamik" UBYTE zw_ub_qn0p75 1 100 -191.25 0 FORMAT "%5.1" ECU_ADDRESS 0x7FBCCB /end MEASUREMENT
/begin MEASUREMENT wkrdya "adaptierter Z¸ndwinkel bei KR-Dynamik" UBYTE zw_ub_qn0p75 1 100 -191.25 0 FORMAT "%5.1" ARRAY_SIZE 5 ECU_ADDRESS 0x7F9C30 /end MEASUREMENT
/begin MEASUREMENT wkrdyvs "vorgesteuerter Z¸ndwinkelsp‰tverstellung bei KR-Dynamik" UBYTE zw_ub_qn0p75 1 100 -191.25 0 FORMAT "%5.1" ECU_ADDRESS 0x7FBCCC /end MEASUREMENT
/begin MEASUREMENT wkrksa "mittlere KR-Sp‰tverstellung aller Zylinder an Ersatzsensor A" UBYTE zw_ub_qn0p75 1 100 -191.25 0 FORMAT "%5.1" ECU_ADDRESS 0x7FD836 /end MEASUREMENT
/begin MEASUREMENT wkrksb "mittlere KR-Sp‰tverstellung aller Zylinder an Ersatzsensor B" UBYTE zw_ub_qn0p75 1 100 -191.25 0 FORMAT "%5.1" ECU_ADDRESS 0x7FD837 /end MEASUREMENT
/begin MEASUREMENT wkrm "Mittelwert der zylinderindividuellen ZW-Sp‰tverstellungen durch KR" UBYTE zw_ub_qn0p75 1 100 -191.25 0 FORMAT "%5.1" ECU_ADDRESS 0x7FBCD8 /end MEASUREMENT
/begin MEASUREMENT wkrma "Mittelwert der ZW-Sp‰tverstellungen KR, allgemein (im Notlauf mit Sicherheit)" UBYTE zw_ub_qn0p75 1 100 -191.25 0 FORMAT "%5.1" ECU_ADDRESS 0x7FBCD9 /end MEASUREMENT
/begin MEASUREMENT wkr_tst "zyl.ind. ZW-Sp‰tverstellung, rollierend" UBYTE zw_ub_qn0p75 1 100 -191.25 0 FORMAT "%5.1" ECU_ADDRESS 0x7FDA0A /end MEASUREMENT
/begin MEASUREMENT Wpuffer10_tmp "" UWORD default 1 100 0 65535 FORMAT "%8.2" ECU_ADDRESS 0x7FDD06 /end MEASUREMENT
/begin MEASUREMENT Wpuffer2_10_tmp "" UWORD default 1 100 0 65535 FORMAT "%8.2" ECU_ADDRESS 0x7FDD08 /end MEASUREMENT
/begin MEASUREMENT wtans "A/D-Wert f¸r tans" UBYTE spg_ub_b5 1 100 0 4.98047 FORMAT "%5.3" ECU_ADDRESS 0x7FD982 /end MEASUREMENT
/begin MEASUREMENT wtmot "A/D-Wert f¸r tmot" UBYTE spg_ub_b5 1 100 0 4.98047 FORMAT "%5.3" ECU_ADDRESS 0x7FD983 /end MEASUREMENT
/begin MEASUREMENT wtsg "Wert Temperatur Steuerger‰t" UBYTE spg_ub_b5 1 100 0 4.98047 FORMAT "%5.3" ECU_ADDRESS 0x7FD984 /end MEASUREMENT
/begin MEASUREMENT wub "Batteriespannung; vom AD-Wandler erfaﬂter Wert" UBYTE spg_ubatt 1 100 0 24.021 FORMAT "%5.2" ECU_ADDRESS 0x7FD635 /end MEASUREMENT
/begin MEASUREMENT zaldy "Z¸ndungsz‰hler f¸r Abregelung Lastdynamik" UBYTE dez 1 100 0 255 FORMAT "%5.1" ECU_ADDRESS 0x7FD9F3 /end MEASUREMENT
/begin MEASUREMENT zkrvf "Z‰hler bestimmt die Frequenz der zylinderindividuellen Z¸ndwinkelfr¸hverstellung" UBYTE dez 1 100 0 255 FORMAT "%5.1" ARRAY_SIZE 8 ECU_ADDRESS 0x7FDA0C /end MEASUREMENT
/begin MEASUREMENT zldy "Z¸ndungsz‰hler f¸r Lastdynamik" UBYTE dez 1 100 0 255 FORMAT "%5.1" ECU_ADDRESS 0x7FBCCD /end MEASUREMENT
/begin MEASUREMENT zndy "Z¸ndungsz‰hler f¸r Drehzahldynamik" UBYTE dez 1 100 0 255 FORMAT "%5.1" ECU_ADDRESS 0x7FBCCE /end MEASUREMENT
/begin MEASUREMENT ztmls "Zeitz‰hler f¸r Motorl¸fterfunktion (10ms)" UWORD t10msxs_uw_b655p35 1 100 0 655.35 FORMAT "%8.4" ECU_ADDRESS 0x7FDDB4 /end MEASUREMENT
/begin MEASUREMENT zzwdykr "Z¸ndungsz‰hler bei gesetztem Bit B_zwkra=1 w‰hrend der KR-Dynamik" UWORD dez 1 100 0 65535 FORMAT "%8.2" ECU_ADDRESS 0x7FBCEE /end MEASUREMENT
/begin MEASUREMENT zzwdymd "Z¸ndungsz‰hler bei nicht gesetztem Bit B_zwkra=0 w‰hrend der KR-Dynamik" UWORD dez 1 100 0 65535 FORMAT "%8.2" ECU_ADDRESS 0x7FBCF0 /end MEASUREMENT
/begin MEASUREMENT zzylzue "SW-Zylinderz‰hler f¸r Z¸ndungsberechnung" UBYTE dez 1 100 0 255 FORMAT "%5.1" ECU_ADDRESS 0x7FD986 /end MEASUREMENT
/begin FUNCTION GGTFM "Gebergrˆﬂe TFM Temperaturf¸hler Motor (/-K¸hlmittel)"
 /begin DEF_CHARACTERISTIC CWTMOT CWTMPLAUS DSTMOT DTLRTML DTMDMA DTMDNPO DTMSRT FABSTT FSTMOTMN FSTMOTMX KFDTMTE KFDTMTR KLDTMRS TADMM TDTM TDTMMA TMDMMA TMDMMAT TMDMMAU TMDMMEE TMDMMER TMDMN TMDMX TMLRTMS TMMXRT TMOTDE TMOTELI TNSRT TWLRTMS TWTMNHST ZFTMOT /end DEF_CHARACTERISTIC
 /begin REF_CHARACTERISTIC OFFTZYL /end REF_CHARACTERISTIC
 /begin IN_MEASUREMENT B_adpini B_nmin B_nmot B_nokatfz B_pwf B_sa B_st B_stend E_TZYL1 E_TZYL2 ml tabst_w tans tmotzyl_w tnst_w wtmot /end IN_MEASUREMENT
 /begin OUT_MEASUREMENT B_anfw B_fgdtm B_mxmntm B_tmdmme B_tmmn B_tmsrt fktmsch manftmew mll1 msttmew msttmrw tdlrtm_w tmew tmewab tmot tmotab tmotew tmotlin tmotlin_w tmotvt tmrw tmrwend tmst /end OUT_MEASUREMENT
 /begin LOC_MEASUREMENT /end LOC_MEASUREMENT
 /begin SUB_FUNCTION /end SUB_FUNCTION
/end FUNCTION
/begin FUNCTION GGTSG "Gebergrˆﬂe und Dokumentation Temperatur Steuerger‰t"
 /begin DEF_CHARACTERISTIC STNSG1 STNSG2 STNSG3 STNSG4 STNSG5 STTSG1 STTSG2 STTSG3 STTSG4 STTSG5 TSGELI TSTSG /end DEF_CHARACTERISTIC
 /begin REF_CHARACTERISTIC /end REF_CHARACTERISTIC
 /begin IN_MEASUREMENT nmot wtsg /end IN_MEASUREMENT
 /begin OUT_MEASUREMENT tsg tsg_history_a /end OUT_MEASUREMENT
 /begin LOC_MEASUREMENT /end LOC_MEASUREMENT
 /begin SUB_FUNCTION /end SUB_FUNCTION
/end FUNCTION
/begin FUNCTION GGTZYL1 ""
 /begin DEF_CHARACTERISTIC CW_TZYL DSTZYL DSTZYLMOT FSTZYLMN FSTZYLMX OFFTZYL TDTMOTZYL TMOTZYLDE TMOTZYLELI ZFTZYL /end DEF_CHARACTERISTIC
 /begin REF_CHARACTERISTIC TMDMMEE /end REF_CHARACTERISTIC
 /begin IN_MEASUREMENT B_adpini B_bktzyl1 B_bktzyl2 B_nmin B_nmot B_st B_stend E_tm tmot tmotzyl2_w utzyl1_w utzyl2_w /end IN_MEASUREMENT
 /begin OUT_MEASUREMENT tabzyl1_w tabzyl_w tmotzyl1li tmotzyl1_w tmotzyl_w tmstzyl1_w tmstzyl_w /end OUT_MEASUREMENT
 /begin LOC_MEASUREMENT /end LOC_MEASUREMENT
 /begin SUB_FUNCTION /end SUB_FUNCTION
/end FUNCTION
/begin FUNCTION GGTZYL2 "" /begin DEF_CHARACTERISTIC /end DEF_CHARACTERISTIC
 /begin REF_CHARACTERISTIC CW_TZYL FSTZYLMN FSTZYLMX TDTMOTZYL TMDMMEE TMOTZYLDE TMOTZYLELI ZFTZYL /end REF_CHARACTERISTIC
 /begin IN_MEASUREMENT B_adpini B_bktzyl1 B_bktzyl2 B_nmin B_nmot B_st B_stend tmot tmotzyl1_w utzyl2_w /end IN_MEASUREMENT
 /begin OUT_MEASUREMENT tabzyl2_w tmotzyl2li tmotzyl2_w tmstzyl2_w /end OUT_MEASUREMENT
 /begin LOC_MEASUREMENT /end LOC_MEASUREMENT
 /begin SUB_FUNCTION /end SUB_FUNCTION
/end FUNCTION
/begin FUNCTION GGUB "8.10      Gebergrˆﬂe Batteriespannung, inkl.Diagnose" /begin DEF_CHARACTERISTIC TDNSUB TDUB UBDE UBDMN1 UBDMN2 UBDMX VMDUB /end DEF_CHARACTERISTIC /begin REF_CHARACTERISTIC /end REF_CHARACTERISTIC /begin IN_MEASUREMENT B_stend vfzg wub /end IN_MEASUREMENT /begin OUT_MEASUREMENT ub ubsq ubsqf ubsqf_w ubsq_w ub_w /end OUT_MEASUREMENT /begin LOC_MEASUREMENT /end LOC_MEASUREMENT /begin SUB_FUNCTION /end SUB_FUNCTION /end FUNCTION
/begin FUNCTION GGVFZG "Gebergrˆﬂe Fahrzeuggeschwindigkeit" /begin DEF_CHARACTERISTIC VFZMN /end DEF_CHARACTERISTIC /begin REF_CHARACTERISTIC /end REF_CHARACTERISTIC /begin IN_MEASUREMENT B_abs B_vnull vfzggang_w v_hrad v_vrad /end IN_MEASUREMENT /begin OUT_MEASUREMENT bfzgl_b vfzg vfzg_w vfzroh_w /end OUT_MEASUREMENT /begin LOC_MEASUREMENT /end LOC_MEASUREMENT /begin SUB_FUNCTION /end SUB_FUNCTION /end FUNCTION
/begin FUNCTION GK "Gemischkontrolle" /begin DEF_CHARACTERISTIC KFBS /end DEF_CHARACTERISTIC /begin REF_CHARACTERISTIC CWTEVPOS /end REF_CHARACTERISTIC
 /begin IN_MEASUREMENT B_esukdk10 fgru fns fr2_w fra2_w fra_w fr_w fst_w fwe fwl fwl2 lamnswl_w lamsbg2_w lamsbg_w nmot rka2_w rkaco_w rka_w rkte_w rkukg10_w rkukg_w rl rlp_w /end IN_MEASUREMENT
 /begin OUT_MEASUREMENT fra10_w fra2_10_w rk10_w rk2_10_w rk2_w rkkva10_w rkkva2_10_w rkkva2_w rkkva_w rkte10_w rk_w /end OUT_MEASUREMENT
 /begin LOC_MEASUREMENT fvst2_w fvst_w Wpuffer10_tmp Wpuffer2_10_tmp /end LOC_MEASUREMENT
 /begin SUB_FUNCTION /end SUB_FUNCTION
/end FUNCTION
/begin FUNCTION HLS ""
 /begin DEF_CHARACTERISTIC THEV THSVKTA THSVKTA2 THVA THVA2 THVAWU TMOHSMN TVHSV UBHS UHSN /end DEF_CHARACTERISTIC
 /begin REF_CHARACTERISTIC /end REF_CHARACTERISTIC
 /begin IN_MEASUREMENT B_atmtpa B_atmtpa2 B_sbbvk B_sbbvk2 B_stend tabgmls tabgmls2 tkatm tkatm2 tmotzyl1_w tmotzyl2_w ub /end IN_MEASUREMENT
 /begin OUT_MEASUREMENT B_hsve B_hsve2 phlsnv phlsnv2 /end OUT_MEASUREMENT
 /begin LOC_MEASUREMENT B_hsvmx B_hsvmx2 B_rehs thvaist thvaist2 thvat thvat2 /end LOC_MEASUREMENT
 /begin SUB_FUNCTION /end SUB_FUNCTION
/end FUNCTION
/begin FUNCTION INDEX_DAKLE "" /begin DEF_CHARACTERISTIC /end DEF_CHARACTERISTIC /begin REF_CHARACTERISTIC /end REF_CHARACTERISTIC /begin IN_MEASUREMENT /end IN_MEASUREMENT /begin OUT_MEASUREMENT /end OUT_MEASUREMENT /begin LOC_MEASUREMENT /end LOC_MEASUREMENT /begin SUB_FUNCTION /end SUB_FUNCTION /end FUNCTION
/begin FUNCTION INDEX_DASC "" /begin DEF_CHARACTERISTIC /end DEF_CHARACTERISTIC /begin REF_CHARACTERISTIC /end REF_CHARACTERISTIC /begin IN_MEASUREMENT /end IN_MEASUREMENT /begin OUT_MEASUREMENT /end OUT_MEASUREMENT /begin LOC_MEASUREMENT /end LOC_MEASUREMENT /begin SUB_FUNCTION /end SUB_FUNCTION /end FUNCTION
/begin FUNCTION INDEX_DCABS "" /begin DEF_CHARACTERISTIC /end DEF_CHARACTERISTIC /begin REF_CHARACTERISTIC /end REF_CHARACTERISTIC /begin IN_MEASUREMENT /end IN_MEASUREMENT /begin OUT_MEASUREMENT /end OUT_MEASUREMENT /begin LOC_MEASUREMENT /end LOC_MEASUREMENT /begin SUB_FUNCTION /end SUB_FUNCTION /end FUNCTION
/begin FUNCTION INDEX_DCANA "" /begin DEF_CHARACTERISTIC /end DEF_CHARACTERISTIC /begin REF_CHARACTERISTIC /end REF_CHARACTERISTIC /begin IN_MEASUREMENT /end IN_MEASUREMENT /begin OUT_MEASUREMENT /end OUT_MEASUREMENT /begin LOC_MEASUREMENT /end LOC_MEASUREMENT /begin SUB_FUNCTION /end SUB_FUNCTION /end FUNCTION
/begin FUNCTION INDEX_DCAS "" /begin DEF_CHARACTERISTIC /end DEF_CHARACTERISTIC /begin REF_CHARACTERISTIC /end REF_CHARACTERISTIC /begin IN_MEASUREMENT /end IN_MEASUREMENT /begin OUT_MEASUREMENT /end OUT_MEASUREMENT /begin LOC_MEASUREMENT /end LOC_MEASUREMENT /begin SUB_FUNCTION /end SUB_FUNCTION /end FUNCTION
/begin FUNCTION INDEX_DCKOMBI "" /begin DEF_CHARACTERISTIC /end DEF_CHARACTERISTIC /begin REF_CHARACTERISTIC /end REF_CHARACTERISTIC /begin IN_MEASUREMENT /end IN_MEASUREMENT /begin OUT_MEASUREMENT /end OUT_MEASUREMENT /begin LOC_MEASUREMENT /end LOC_MEASUREMENT /begin SUB_FUNCTION /end SUB_FUNCTION /end FUNCTION
/begin FUNCTION INDEX_DCZFE "" /begin DEF_CHARACTERISTIC /end DEF_CHARACTERISTIC /begin REF_CHARACTERISTIC /end REF_CHARACTERISTIC /begin IN_MEASUREMENT /end IN_MEASUREMENT /begin OUT_MEASUREMENT /end OUT_MEASUREMENT /begin LOC_MEASUREMENT /end LOC_MEASUREMENT /begin SUB_FUNCTION /end SUB_FUNCTION /end FUNCTION
/begin FUNCTION INDEX_DDG "" /begin DEF_CHARACTERISTIC /end DEF_CHARACTERISTIC /begin REF_CHARACTERISTIC /end REF_CHARACTERISTIC /begin IN_MEASUREMENT /end IN_MEASUREMENT /begin OUT_MEASUREMENT /end OUT_MEASUREMENT /begin LOC_MEASUREMENT /end LOC_MEASUREMENT /begin SUB_FUNCTION /end SUB_FUNCTION /end FUNCTION
/begin FUNCTION INDEX_DDKP "" /begin DEF_CHARACTERISTIC /end DEF_CHARACTERISTIC /begin REF_CHARACTERISTIC /end REF_CHARACTERISTIC /begin IN_MEASUREMENT /end IN_MEASUREMENT /begin OUT_MEASUREMENT /end OUT_MEASUREMENT /begin LOC_MEASUREMENT /end LOC_MEASUREMENT /begin SUB_FUNCTION /end SUB_FUNCTION /end FUNCTION
/begin FUNCTION INDEX_DDKPA "" /begin DEF_CHARACTERISTIC /end DEF_CHARACTERISTIC /begin REF_CHARACTERISTIC /end REF_CHARACTERISTIC /begin IN_MEASUREMENT /end IN_MEASUREMENT /begin OUT_MEASUREMENT /end OUT_MEASUREMENT /begin LOC_MEASUREMENT /end LOC_MEASUREMENT /begin SUB_FUNCTION /end SUB_FUNCTION /end FUNCTION
/begin FUNCTION INDEX_DEKPE "" /begin DEF_CHARACTERISTIC /end DEF_CHARACTERISTIC /begin REF_CHARACTERISTIC /end REF_CHARACTERISTIC /begin IN_MEASUREMENT /end IN_MEASUREMENT /begin OUT_MEASUREMENT /end OUT_MEASUREMENT /begin LOC_MEASUREMENT /end LOC_MEASUREMENT /begin SUB_FUNCTION /end SUB_FUNCTION /end FUNCTION
/begin FUNCTION INDEX_DEVE "" /begin DEF_CHARACTERISTIC /end DEF_CHARACTERISTIC /begin REF_CHARACTERISTIC /end REF_CHARACTERISTIC /begin IN_MEASUREMENT /end IN_MEASUREMENT /begin OUT_MEASUREMENT /end OUT_MEASUREMENT /begin LOC_MEASUREMENT /end LOC_MEASUREMENT /begin SUB_FUNCTION /end SUB_FUNCTION /end FUNCTION
/begin FUNCTION INDEX_DEWS "" /begin DEF_CHARACTERISTIC /end DEF_CHARACTERISTIC /begin REF_CHARACTERISTIC /end REF_CHARACTERISTIC /begin IN_MEASUREMENT /end IN_MEASUREMENT /begin OUT_MEASUREMENT /end OUT_MEASUREMENT /begin LOC_MEASUREMENT /end LOC_MEASUREMENT /begin SUB_FUNCTION /end SUB_FUNCTION /end FUNCTION
/begin FUNCTION INDEX_DEWSE "" /begin DEF_CHARACTERISTIC /end DEF_CHARACTERISTIC /begin REF_CHARACTERISTIC /end REF_CHARACTERISTIC /begin IN_MEASUREMENT /end IN_MEASUREMENT /begin OUT_MEASUREMENT /end OUT_MEASUREMENT /begin LOC_MEASUREMENT /end LOC_MEASUREMENT /begin SUB_FUNCTION /end SUB_FUNCTION /end FUNCTION
/begin FUNCTION INDEX_DFPM "" /begin DEF_CHARACTERISTIC /end DEF_CHARACTERISTIC /begin REF_CHARACTERISTIC /end REF_CHARACTERISTIC /begin IN_MEASUREMENT /end IN_MEASUREMENT /begin OUT_MEASUREMENT /end OUT_MEASUREMENT /begin LOC_MEASUREMENT /end LOC_MEASUREMENT /begin SUB_FUNCTION /end SUB_FUNCTION /end FUNCTION
/begin FUNCTION INDEX_DHSSEKP "" /begin DEF_CHARACTERISTIC /end DEF_CHARACTERISTIC /begin REF_CHARACTERISTIC /end REF_CHARACTERISTIC /begin IN_MEASUREMENT /end IN_MEASUREMENT /begin OUT_MEASUREMENT /end OUT_MEASUREMENT /begin LOC_MEASUREMENT /end LOC_MEASUREMENT /begin SUB_FUNCTION /end SUB_FUNCTION /end FUNCTION
/begin FUNCTION INDEX_DHSSSYS "" /begin DEF_CHARACTERISTIC /end DEF_CHARACTERISTIC /begin REF_CHARACTERISTIC /end REF_CHARACTERISTIC /begin IN_MEASUREMENT /end IN_MEASUREMENT /begin OUT_MEASUREMENT /end OUT_MEASUREMENT /begin LOC_MEASUREMENT /end LOC_MEASUREMENT /begin SUB_FUNCTION /end SUB_FUNCTION /end FUNCTION
/begin FUNCTION INDEX_DHSSZDG "" /begin DEF_CHARACTERISTIC /end DEF_CHARACTERISTIC /begin REF_CHARACTERISTIC /end REF_CHARACTERISTIC /begin IN_MEASUREMENT /end IN_MEASUREMENT /begin OUT_MEASUREMENT /end OUT_MEASUREMENT /begin LOC_MEASUREMENT /end LOC_MEASUREMENT /begin SUB_FUNCTION /end SUB_FUNCTION /end FUNCTION
/begin FUNCTION INDEX_DKAT "" /begin DEF_CHARACTERISTIC /end DEF_CHARACTERISTIC /begin REF_CHARACTERISTIC /end REF_CHARACTERISTIC /begin IN_MEASUREMENT /end IN_MEASUREMENT /begin OUT_MEASUREMENT /end OUT_MEASUREMENT /begin LOC_MEASUREMENT /end LOC_MEASUREMENT /begin SUB_FUNCTION /end SUB_FUNCTION /end FUNCTION
/begin FUNCTION INDEX_DKILL "" /begin DEF_CHARACTERISTIC /end DEF_CHARACTERISTIC /begin REF_CHARACTERISTIC /end REF_CHARACTERISTIC /begin IN_MEASUREMENT /end IN_MEASUREMENT /begin OUT_MEASUREMENT /end OUT_MEASUREMENT /begin LOC_MEASUREMENT /end LOC_MEASUREMENT /begin SUB_FUNCTION /end SUB_FUNCTION /end FUNCTION
/begin FUNCTION INDEX_DKL15 "" /begin DEF_CHARACTERISTIC /end DEF_CHARACTERISTIC /begin REF_CHARACTERISTIC /end REF_CHARACTERISTIC /begin IN_MEASUREMENT /end IN_MEASUREMENT /begin OUT_MEASUREMENT /end OUT_MEASUREMENT /begin LOC_MEASUREMENT /end LOC_MEASUREMENT /begin SUB_FUNCTION /end SUB_FUNCTION /end FUNCTION
/begin FUNCTION INDEX_DKRNT "" /begin DEF_CHARACTERISTIC /end DEF_CHARACTERISTIC /begin REF_CHARACTERISTIC /end REF_CHARACTERISTIC /begin IN_MEASUREMENT /end IN_MEASUREMENT /begin OUT_MEASUREMENT /end OUT_MEASUREMENT /begin LOC_MEASUREMENT /end LOC_MEASUREMENT /begin SUB_FUNCTION /end SUB_FUNCTION /end FUNCTION
/begin FUNCTION INDEX_DKRS "" /begin DEF_CHARACTERISTIC /end DEF_CHARACTERISTIC /begin REF_CHARACTERISTIC /end REF_CHARACTERISTIC /begin IN_MEASUREMENT /end IN_MEASUREMENT /begin OUT_MEASUREMENT /end OUT_MEASUREMENT /begin LOC_MEASUREMENT /end LOC_MEASUREMENT /begin SUB_FUNCTION /end SUB_FUNCTION /end FUNCTION
/begin FUNCTION INDEX_DKRTP "" /begin DEF_CHARACTERISTIC /end DEF_CHARACTERISTIC /begin REF_CHARACTERISTIC /end REF_CHARACTERISTIC /begin IN_MEASUREMENT /end IN_MEASUREMENT /begin OUT_MEASUREMENT /end OUT_MEASUREMENT /begin LOC_MEASUREMENT /end LOC_MEASUREMENT /begin SUB_FUNCTION /end SUB_FUNCTION /end FUNCTION
/begin FUNCTION INDEX_DKUPPL "" /begin DEF_CHARACTERISTIC /end DEF_CHARACTERISTIC /begin REF_CHARACTERISTIC /end REF_CHARACTERISTIC /begin IN_MEASUREMENT /end IN_MEASUREMENT /begin OUT_MEASUREMENT /end OUT_MEASUREMENT /begin LOC_MEASUREMENT /end LOC_MEASUREMENT /begin SUB_FUNCTION /end SUB_FUNCTION /end FUNCTION
/begin FUNCTION INDEX_DKVS "" /begin DEF_CHARACTERISTIC /end DEF_CHARACTERISTIC /begin REF_CHARACTERISTIC /end REF_CHARACTERISTIC /begin IN_MEASUREMENT /end IN_MEASUREMENT /begin OUT_MEASUREMENT /end OUT_MEASUREMENT /begin LOC_MEASUREMENT /end LOC_MEASUREMENT /begin SUB_FUNCTION /end SUB_FUNCTION /end FUNCTION
/begin FUNCTION INDEX_DLLR "" /begin DEF_CHARACTERISTIC /end DEF_CHARACTERISTIC /begin REF_CHARACTERISTIC /end REF_CHARACTERISTIC /begin IN_MEASUREMENT /end IN_MEASUREMENT /begin OUT_MEASUREMENT /end OUT_MEASUREMENT /begin LOC_MEASUREMENT /end LOC_MEASUREMENT /begin SUB_FUNCTION /end SUB_FUNCTION /end FUNCTION
/begin FUNCTION INDEX_DLSA "" /begin DEF_CHARACTERISTIC /end DEF_CHARACTERISTIC /begin REF_CHARACTERISTIC /end REF_CHARACTERISTIC /begin IN_MEASUREMENT /end IN_MEASUREMENT /begin OUT_MEASUREMENT /end OUT_MEASUREMENT /begin LOC_MEASUREMENT /end LOC_MEASUREMENT /begin SUB_FUNCTION /end SUB_FUNCTION /end FUNCTION
/begin FUNCTION INDEX_DLSHVKE "" /begin DEF_CHARACTERISTIC /end DEF_CHARACTERISTIC /begin REF_CHARACTERISTIC /end REF_CHARACTERISTIC /begin IN_MEASUREMENT /end IN_MEASUREMENT /begin OUT_MEASUREMENT /end OUT_MEASUREMENT /begin LOC_MEASUREMENT /end LOC_MEASUREMENT /begin SUB_FUNCTION /end SUB_FUNCTION /end FUNCTION
/begin FUNCTION INDEX_DLSV "" /begin DEF_CHARACTERISTIC /end DEF_CHARACTERISTIC /begin REF_CHARACTERISTIC /end REF_CHARACTERISTIC /begin IN_MEASUREMENT /end IN_MEASUREMENT /begin OUT_MEASUREMENT /end OUT_MEASUREMENT /begin LOC_MEASUREMENT /end LOC_MEASUREMENT /begin SUB_FUNCTION /end SUB_FUNCTION /end FUNCTION
/begin FUNCTION INDEX_DMLS "" /begin DEF_CHARACTERISTIC /end DEF_CHARACTERISTIC /begin REF_CHARACTERISTIC /end REF_CHARACTERISTIC /begin IN_MEASUREMENT /end IN_MEASUREMENT /begin OUT_MEASUREMENT /end OUT_MEASUREMENT /begin LOC_MEASUREMENT /end LOC_MEASUREMENT /begin SUB_FUNCTION /end SUB_FUNCTION /end FUNCTION
/begin FUNCTION INDEX_DOS "" /begin DEF_CHARACTERISTIC /end DEF_CHARACTERISTIC /begin REF_CHARACTERISTIC /end REF_CHARACTERISTIC /begin IN_MEASUREMENT /end IN_MEASUREMENT /begin OUT_MEASUREMENT /end OUT_MEASUREMENT /begin LOC_MEASUREMENT /end LOC_MEASUREMENT /begin SUB_FUNCTION /end SUB_FUNCTION /end FUNCTION
/begin FUNCTION INDEX_DPH "" /begin DEF_CHARACTERISTIC /end DEF_CHARACTERISTIC /begin REF_CHARACTERISTIC /end REF_CHARACTERISTIC /begin IN_MEASUREMENT /end IN_MEASUREMENT /begin OUT_MEASUREMENT /end OUT_MEASUREMENT /begin LOC_MEASUREMENT /end LOC_MEASUREMENT /begin SUB_FUNCTION /end SUB_FUNCTION /end FUNCTION
/begin FUNCTION INDEX_DRADV "" /begin DEF_CHARACTERISTIC /end DEF_CHARACTERISTIC /begin REF_CHARACTERISTIC /end REF_CHARACTERISTIC /begin IN_MEASUREMENT /end IN_MEASUREMENT /begin OUT_MEASUREMENT /end OUT_MEASUREMENT /begin LOC_MEASUREMENT /end LOC_MEASUREMENT /begin SUB_FUNCTION /end SUB_FUNCTION /end FUNCTION
/begin FUNCTION INDEX_DSIKODA "" /begin DEF_CHARACTERISTIC /end DEF_CHARACTERISTIC /begin REF_CHARACTERISTIC /end REF_CHARACTERISTIC /begin IN_MEASUREMENT /end IN_MEASUREMENT /begin OUT_MEASUREMENT /end OUT_MEASUREMENT /begin LOC_MEASUREMENT /end LOC_MEASUREMENT /begin SUB_FUNCTION /end SUB_FUNCTION /end FUNCTION
/begin FUNCTION INDEX_DSLD "" /begin DEF_CHARACTERISTIC /end DEF_CHARACTERISTIC /begin REF_CHARACTERISTIC /end REF_CHARACTERISTIC /begin IN_MEASUREMENT /end IN_MEASUREMENT /begin OUT_MEASUREMENT /end OUT_MEASUREMENT /begin LOC_MEASUREMENT /end LOC_MEASUREMENT /begin SUB_FUNCTION /end SUB_FUNCTION /end FUNCTION
/begin FUNCTION INDEX_DSLSLR "" /begin DEF_CHARACTERISTIC /end DEF_CHARACTERISTIC /begin REF_CHARACTERISTIC /end REF_CHARACTERISTIC /begin IN_MEASUREMENT /end IN_MEASUREMENT /begin OUT_MEASUREMENT /end OUT_MEASUREMENT /begin LOC_MEASUREMENT /end LOC_MEASUREMENT /begin SUB_FUNCTION /end SUB_FUNCTION /end FUNCTION
/begin FUNCTION INDEX_DSLVE "" /begin DEF_CHARACTERISTIC /end DEF_CHARACTERISTIC /begin REF_CHARACTERISTIC /end REF_CHARACTERISTIC /begin IN_MEASUREMENT /end IN_MEASUREMENT /begin OUT_MEASUREMENT /end OUT_MEASUREMENT /begin LOC_MEASUREMENT /end LOC_MEASUREMENT /begin SUB_FUNCTION /end SUB_FUNCTION /end FUNCTION
/begin FUNCTION INDEX_DSST "" /begin DEF_CHARACTERISTIC /end DEF_CHARACTERISTIC /begin REF_CHARACTERISTIC /end REF_CHARACTERISTIC /begin IN_MEASUREMENT /end IN_MEASUREMENT /begin OUT_MEASUREMENT /end OUT_MEASUREMENT /begin LOC_MEASUREMENT /end LOC_MEASUREMENT /begin SUB_FUNCTION /end SUB_FUNCTION /end FUNCTION
/begin FUNCTION INDEX_DSSTE "" /begin DEF_CHARACTERISTIC /end DEF_CHARACTERISTIC /begin REF_CHARACTERISTIC /end REF_CHARACTERISTIC /begin IN_MEASUREMENT /end IN_MEASUREMENT /begin OUT_MEASUREMENT /end OUT_MEASUREMENT /begin LOC_MEASUREMENT /end LOC_MEASUREMENT /begin SUB_FUNCTION /end SUB_FUNCTION /end FUNCTION
/begin FUNCTION INDEX_DSTARTE "" /begin DEF_CHARACTERISTIC /end DEF_CHARACTERISTIC /begin REF_CHARACTERISTIC /end REF_CHARACTERISTIC /begin IN_MEASUREMENT /end IN_MEASUREMENT /begin OUT_MEASUREMENT /end OUT_MEASUREMENT /begin LOC_MEASUREMENT /end LOC_MEASUREMENT /begin SUB_FUNCTION /end SUB_FUNCTION /end FUNCTION
/begin FUNCTION INDEX_DSTP1 "" /begin DEF_CHARACTERISTIC /end DEF_CHARACTERISTIC /begin REF_CHARACTERISTIC /end REF_CHARACTERISTIC /begin IN_MEASUREMENT /end IN_MEASUREMENT /begin OUT_MEASUREMENT /end OUT_MEASUREMENT /begin LOC_MEASUREMENT /end LOC_MEASUREMENT /begin SUB_FUNCTION /end SUB_FUNCTION /end FUNCTION
/begin FUNCTION INDEX_DSTP2 "" /begin DEF_CHARACTERISTIC /end DEF_CHARACTERISTIC /begin REF_CHARACTERISTIC /end REF_CHARACTERISTIC /begin IN_MEASUREMENT /end IN_MEASUREMENT /begin OUT_MEASUREMENT /end OUT_MEASUREMENT /begin LOC_MEASUREMENT /end LOC_MEASUREMENT /begin SUB_FUNCTION /end SUB_FUNCTION /end FUNCTION
/begin FUNCTION INDEX_DTCJ945 "" /begin DEF_CHARACTERISTIC /end DEF_CHARACTERISTIC /begin REF_CHARACTERISTIC /end REF_CHARACTERISTIC /begin IN_MEASUREMENT /end IN_MEASUREMENT /begin OUT_MEASUREMENT /end OUT_MEASUREMENT /begin LOC_MEASUREMENT /end LOC_MEASUREMENT /begin SUB_FUNCTION /end SUB_FUNCTION /end FUNCTION
/begin FUNCTION INDEX_DTCY315 "" /begin DEF_CHARACTERISTIC /end DEF_CHARACTERISTIC /begin REF_CHARACTERISTIC /end REF_CHARACTERISTIC /begin IN_MEASUREMENT /end IN_MEASUREMENT /begin OUT_MEASUREMENT /end OUT_MEASUREMENT /begin LOC_MEASUREMENT /end LOC_MEASUREMENT /begin SUB_FUNCTION /end SUB_FUNCTION /end FUNCTION
/begin FUNCTION INDEX_DTDE "" /begin DEF_CHARACTERISTIC /end DEF_CHARACTERISTIC /begin REF_CHARACTERISTIC /end REF_CHARACTERISTIC /begin IN_MEASUREMENT /end IN_MEASUREMENT /begin OUT_MEASUREMENT /end OUT_MEASUREMENT /begin LOC_MEASUREMENT /end LOC_MEASUREMENT /begin SUB_FUNCTION /end SUB_FUNCTION /end FUNCTION
/begin FUNCTION INDEX_DTEVE "" /begin DEF_CHARACTERISTIC /end DEF_CHARACTERISTIC /begin REF_CHARACTERISTIC /end REF_CHARACTERISTIC /begin IN_MEASUREMENT /end IN_MEASUREMENT /begin OUT_MEASUREMENT /end OUT_MEASUREMENT /begin LOC_MEASUREMENT /end LOC_MEASUREMENT /begin SUB_FUNCTION /end SUB_FUNCTION /end FUNCTION
/begin FUNCTION INDEX_DTEVN "" /begin DEF_CHARACTERISTIC /end DEF_CHARACTERISTIC /begin REF_CHARACTERISTIC /end REF_CHARACTERISTIC /begin IN_MEASUREMENT /end IN_MEASUREMENT /begin OUT_MEASUREMENT /end OUT_MEASUREMENT /begin LOC_MEASUREMENT /end LOC_MEASUREMENT /begin SUB_FUNCTION /end SUB_FUNCTION /end FUNCTION
/begin FUNCTION INDEX_DTHS "DTHS." /begin DEF_CHARACTERISTIC /end DEF_CHARACTERISTIC /begin REF_CHARACTERISTIC /end REF_CHARACTERISTIC /begin IN_MEASUREMENT /end IN_MEASUREMENT /begin OUT_MEASUREMENT /end OUT_MEASUREMENT /begin LOC_MEASUREMENT /end LOC_MEASUREMENT /begin SUB_FUNCTION /end SUB_FUNCTION /end FUNCTION
/begin FUNCTION INDEX_DU5VG "" /begin DEF_CHARACTERISTIC /end DEF_CHARACTERISTIC /begin REF_CHARACTERISTIC /end REF_CHARACTERISTIC /begin IN_MEASUREMENT /end IN_MEASUREMENT /begin OUT_MEASUREMENT /end OUT_MEASUREMENT /begin LOC_MEASUREMENT /end LOC_MEASUREMENT /begin SUB_FUNCTION /end SUB_FUNCTION /end FUNCTION
/begin FUNCTION INDEX_DUR "" /begin DEF_CHARACTERISTIC /end DEF_CHARACTERISTIC /begin REF_CHARACTERISTIC /end REF_CHARACTERISTIC /begin IN_MEASUREMENT /end IN_MEASUREMENT /begin OUT_MEASUREMENT /end OUT_MEASUREMENT /begin LOC_MEASUREMENT /end LOC_MEASUREMENT /begin SUB_FUNCTION /end SUB_FUNCTION /end FUNCTION
/begin FUNCTION INDEX_DVFZ "" /begin DEF_CHARACTERISTIC /end DEF_CHARACTERISTIC /begin REF_CHARACTERISTIC /end REF_CHARACTERISTIC /begin IN_MEASUREMENT /end IN_MEASUREMENT /begin OUT_MEASUREMENT /end OUT_MEASUREMENT /begin LOC_MEASUREMENT /end LOC_MEASUREMENT /begin SUB_FUNCTION /end SUB_FUNCTION /end FUNCTION
/begin FUNCTION INDEX_DVMAXMAN "" /begin DEF_CHARACTERISTIC /end DEF_CHARACTERISTIC /begin REF_CHARACTERISTIC /end REF_CHARACTERISTIC /begin IN_MEASUREMENT /end IN_MEASUREMENT /begin OUT_MEASUREMENT /end OUT_MEASUREMENT /begin LOC_MEASUREMENT /end LOC_MEASUREMENT /begin SUB_FUNCTION /end SUB_FUNCTION /end FUNCTION
/begin FUNCTION INDEX_EGFE "" /begin DEF_CHARACTERISTIC /end DEF_CHARACTERISTIC /begin REF_CHARACTERISTIC /end REF_CHARACTERISTIC /begin IN_MEASUREMENT /end IN_MEASUREMENT /begin OUT_MEASUREMENT /end OUT_MEASUREMENT /begin LOC_MEASUREMENT /end LOC_MEASUREMENT /begin SUB_FUNCTION /end SUB_FUNCTION /end FUNCTION
/begin FUNCTION INDEX_FRPS "" /begin DEF_CHARACTERISTIC /end DEF_CHARACTERISTIC /begin REF_CHARACTERISTIC /end REF_CHARACTERISTIC /begin IN_MEASUREMENT /end IN_MEASUREMENT /begin OUT_MEASUREMENT /end OUT_MEASUREMENT /begin LOC_MEASUREMENT /end LOC_MEASUREMENT /begin SUB_FUNCTION /end SUB_FUNCTION /end FUNCTION
/begin FUNCTION INDEX_GGDSAS "" /begin DEF_CHARACTERISTIC /end DEF_CHARACTERISTIC /begin REF_CHARACTERISTIC /end REF_CHARACTERISTIC /begin IN_MEASUREMENT /end IN_MEASUREMENT /begin OUT_MEASUREMENT /end OUT_MEASUREMENT /begin LOC_MEASUREMENT /end LOC_MEASUREMENT /begin SUB_FUNCTION /end SUB_FUNCTION /end FUNCTION
/begin FUNCTION INDEX_GGEGAS "" /begin DEF_CHARACTERISTIC /end DEF_CHARACTERISTIC /begin REF_CHARACTERISTIC /end REF_CHARACTERISTIC /begin IN_MEASUREMENT /end IN_MEASUREMENT /begin OUT_MEASUREMENT /end OUT_MEASUREMENT /begin LOC_MEASUREMENT /end LOC_MEASUREMENT /begin SUB_FUNCTION /end SUB_FUNCTION /end FUNCTION
/begin FUNCTION INDEX_GGGANG "" /begin DEF_CHARACTERISTIC /end DEF_CHARACTERISTIC /begin REF_CHARACTERISTIC /end REF_CHARACTERISTIC /begin IN_MEASUREMENT /end IN_MEASUREMENT /begin OUT_MEASUREMENT /end OUT_MEASUREMENT /begin LOC_MEASUREMENT /end LOC_MEASUREMENT /begin SUB_FUNCTION /end SUB_FUNCTION /end FUNCTION
/begin FUNCTION INDEX_GGTFA "" /begin DEF_CHARACTERISTIC /end DEF_CHARACTERISTIC /begin REF_CHARACTERISTIC /end REF_CHARACTERISTIC /begin IN_MEASUREMENT /end IN_MEASUREMENT /begin OUT_MEASUREMENT /end OUT_MEASUREMENT /begin LOC_MEASUREMENT /end LOC_MEASUREMENT /begin SUB_FUNCTION /end SUB_FUNCTION /end FUNCTION
/begin FUNCTION INDEX_GGTFM "" /begin DEF_CHARACTERISTIC /end DEF_CHARACTERISTIC /begin REF_CHARACTERISTIC /end REF_CHARACTERISTIC /begin IN_MEASUREMENT /end IN_MEASUREMENT /begin OUT_MEASUREMENT /end OUT_MEASUREMENT /begin LOC_MEASUREMENT /end LOC_MEASUREMENT /begin SUB_FUNCTION /end SUB_FUNCTION /end FUNCTION
/begin FUNCTION INDEX_GGTZYL1 "" /begin DEF_CHARACTERISTIC /end DEF_CHARACTERISTIC /begin REF_CHARACTERISTIC /end REF_CHARACTERISTIC /begin IN_MEASUREMENT /end IN_MEASUREMENT /begin OUT_MEASUREMENT /end OUT_MEASUREMENT /begin LOC_MEASUREMENT /end LOC_MEASUREMENT /begin SUB_FUNCTION /end SUB_FUNCTION /end FUNCTION
/begin FUNCTION INDEX_GGTZYL2 "" /begin DEF_CHARACTERISTIC /end DEF_CHARACTERISTIC /begin REF_CHARACTERISTIC /end REF_CHARACTERISTIC /begin IN_MEASUREMENT /end IN_MEASUREMENT /begin OUT_MEASUREMENT /end OUT_MEASUREMENT /begin LOC_MEASUREMENT /end LOC_MEASUREMENT /begin SUB_FUNCTION /end SUB_FUNCTION /end FUNCTION
/begin FUNCTION INDEX_GGUB "" /begin DEF_CHARACTERISTIC /end DEF_CHARACTERISTIC /begin REF_CHARACTERISTIC /end REF_CHARACTERISTIC /begin IN_MEASUREMENT /end IN_MEASUREMENT /begin OUT_MEASUREMENT /end OUT_MEASUREMENT /begin LOC_MEASUREMENT /end LOC_MEASUREMENT /begin SUB_FUNCTION /end SUB_FUNCTION /end FUNCTION
/begin FUNCTION INDEX_MDKOG "" /begin DEF_CHARACTERISTIC /end DEF_CHARACTERISTIC /begin REF_CHARACTERISTIC /end REF_CHARACTERISTIC /begin IN_MEASUREMENT /end IN_MEASUREMENT /begin OUT_MEASUREMENT /end OUT_MEASUREMENT /begin LOC_MEASUREMENT /end LOC_MEASUREMENT /begin SUB_FUNCTION /end SUB_FUNCTION /end FUNCTION
/begin FUNCTION INDEX_SWADP "" /begin DEF_CHARACTERISTIC /end DEF_CHARACTERISTIC /begin REF_CHARACTERISTIC /end REF_CHARACTERISTIC /begin IN_MEASUREMENT /end IN_MEASUREMENT /begin OUT_MEASUREMENT /end OUT_MEASUREMENT /begin LOC_MEASUREMENT /end LOC_MEASUREMENT /begin SUB_FUNCTION /end SUB_FUNCTION /end FUNCTION
/begin FUNCTION INPUT_BOX "" /begin DEF_CHARACTERISTIC LP_FAKTOR MO_DRE_DEL RAIDEGREE UEBERSETZ_G UEBERSETZ_H /end DEF_CHARACTERISTIC /begin REF_CHARACTERISTIC MDNORM /end REF_CHARACTERISTIC /begin IN_MEASUREMENT B_brkfoot B_brkhand gangi miist_w nmot_w urai_w wdkba_w /end IN_MEASUREMENT
 /begin OUT_MEASUREMENT asc_brk_ft asc_brk_hd dk_pos_asc gearatio_w mo_dre_ar mo_dre_asc mo_dre_i mo_rpm_asc rai_dbg_w rai_w tireforx_w tirefory_w /end OUT_MEASUREMENT
 /begin LOC_MEASUREMENT /end LOC_MEASUREMENT
 /begin SUB_FUNCTION /end SUB_FUNCTION
/end FUNCTION
/begin FUNCTION KATV "Variantenerkennung (Fahrzeug mit/ohne Kat und Lambdasonden)" /begin DEF_CHARACTERISTIC /end DEF_CHARACTERISTIC /begin REF_CHARACTERISTIC CDHSV UHDMX /end REF_CHARACTERISTIC /begin IN_MEASUREMENT B_adpini B_clvar uhsv uhsv2 /end IN_MEASUREMENT /begin OUT_MEASUREMENT B_nokatfz nokatfz_flg /end OUT_MEASUREMENT /begin LOC_MEASUREMENT /end LOC_MEASUREMENT /begin SUB_FUNCTION /end SUB_FUNCTION /end FUNCTION
/begin FUNCTION KBK2SERVI "" /begin DEF_CHARACTERISTIC /end DEF_CHARACTERISTIC /begin REF_CHARACTERISTIC /end REF_CHARACTERISTIC /begin IN_MEASUREMENT nmot /end IN_MEASUREMENT /begin OUT_MEASUREMENT bbsp1 bbsp2 /end OUT_MEASUREMENT /begin LOC_MEASUREMENT /end LOC_MEASUREMENT /begin SUB_FUNCTION /end SUB_FUNCTION /end FUNCTION
/begin FUNCTION KHMD "Berechnung Reservemoment f¸r Katheizen"
 /begin DEF_CHARACTERISTIC CWKHMD FMDKHFH FMDKHTMST KFKWTMP KFMDDSLA KFMDKH KFMDKHLL ZKBKVAB ZKMDKH /end DEF_CHARACTERISTIC
 /begin REF_CHARACTERISTIC /end REF_CHARACTERISTIC
 /begin IN_MEASUREMENT B_bkvleer B_fasla B_kh B_kw B_ll dmllri_w fho_w fmdkh mifa_w nmot_w tmot tmst /end IN_MEASUREMENT
 /begin OUT_MEASUREMENT dmrdsls_w dmrkh dmrkh_w /end OUT_MEASUREMENT
 /begin LOC_MEASUREMENT dmrkhz_w drkwtmp_w fkbkvab fmkhfho_w fmkhtmst mifakh_w /end LOC_MEASUREMENT
 /begin SUB_FUNCTION /end SUB_FUNCTION
/end FUNCTION
/begin FUNCTION KOS "Klimakompressor - Steuerung"
 /begin DEF_CHARACTERISTIC LIMTKOA MDKOAN MDKOEN SNM08KOUB TKOAMNN TKOAMXN TKOEMNN TMKOAO TMKOAU TNSTKO TVKOE VKOAO /end DEF_CHARACTERISTIC
 /begin REF_CHARACTERISTIC /end REF_CHARACTERISTIC
 /begin IN_MEASUREMENT B_ac B_ko B_stend B_vl mdko mifal_w nmot tmot vfzg /end IN_MEASUREMENT
 /begin OUT_MEASUREMENT B_acres B_koe B_kosta B_nac /end OUT_MEASUREMENT
 /begin LOC_MEASUREMENT B_koena B_komnoff B_komnon B_komxoff B_kooff esst_snm08koub /end LOC_MEASUREMENT
 /begin SUB_FUNCTION /end SUB_FUNCTION
/end FUNCTION
/begin FUNCTION KRDY "Klopfregelung Dynamik"
 /begin DEF_CHARACTERISTIC AZKRLDYN AZKRNDYN DYADMX DYAFVS DYAMNV DYAVF FKELDYA KFDYES KFDYESEH KFDYESEHOF KFDYESOF KFDYWVS NGKRWN NNGKRWN PZWKRA TMDYNA TZVER /end DEF_CHARACTERISTIC
 /begin REF_CHARACTERISTIC SEH06KRUW SNM08KRUW SWD06KRSW /end REF_CHARACTERISTIC
 /begin IN_MEASUREMENT B_adpini B_clradkrd B_gdvhub B_gdvvtueb B_kl B_kr B_ll B_sa B_tmkr B_zwkraa devhubi_w dwdkba_w esst_seh06kruw esst_snm08kruw esst_swd06krsw evhubi_w kek krfkw ngas_w nmot nmot_w stkrnx tans tmotzyl_w virkr wdkba_w zzylkr /end IN_MEASUREMENT
 /begin OUT_MEASUREMENT azkrldy azkrndy B_krldy B_krldya B_krldyf B_krndy B_krsadyn dyesehof_w dyesehv_w dyesofv_w dyesv_w wkrdy wkrdyvs zaldy zldy zndy zzwdykr zzwdymd /end OUT_MEASUREMENT
 /begin LOC_MEASUREMENT B_kldynrm B_kldystk B_krldyofok B_krldyok ngkrv_w nngkrv_w wkrdya /end LOC_MEASUREMENT
 /begin SUB_FUNCTION /end SUB_FUNCTION
/end FUNCTION
/begin FUNCTION KRKE "Klopferkennung"
 /begin DEF_CHARACTERISTIC FKELDY FKENDY FKETM KE1NL KE2NL KE3NL KE4NL KE5NL KE6NL KE7NL KE8NL KEREFF KEREFLDY KEREFNDY KRKFKS KRVST KSZA REFINI RKREM1N RKREM2N RKRMX1N RKRMX2N ZYRKR /end DEF_CHARACTERISTIC
 /begin REF_CHARACTERISTIC SN16KR1UB SN16KR2UB SNM16KRUB SRL04KRUB /end REF_CHARACTERISTIC
 /begin IN_MEASUREMENT B_c95ks3 B_dnt B_dntb B_dtp B_dtpb B_kr B_krldy B_krndy B_st B_synph esst_sn16kr1ub esst_sn16kr2ub esst_snm16krub esst_srl04krub ikr ikrma ikrme nmot rl tmotzyl_w vske zzylkr /end IN_MEASUREMENT
 /begin OUT_MEASUREMENT B_kl fketm ikrn_w ke kek kek_tst kereffw kerefldyw kerefndyw kezkkl kezkklmx kezmxmit rkr rkrem1w rkrem2w rkrkor rkrmx1w rkrmx2w rkr_tst virkr vkr vkr_tst /end OUT_MEASUREMENT
 /begin LOC_MEASUREMENT /end LOC_MEASUREMENT
 /begin SUB_FUNCTION /end SUB_FUNCTION
/end FUNCTION
/begin FUNCTION KRMRLL "KRMRLL." /begin DEF_CHARACTERISTIC DZWMRMX KLKRMRLESS KLKRMRPLUS KLKRZWMR KRMRMN S_KRMRLL /end DEF_CHARACTERISTIC /begin REF_CHARACTERISTIC /end REF_CHARACTERISTIC /begin IN_MEASUREMENT B_llzwe nmot wkrm zwbas zwspae /end IN_MEASUREMENT /begin OUT_MEASUREMENT B_krmrll dmrkrll dwkrkorll dwkrkorlls /end OUT_MEASUREMENT /begin LOC_MEASUREMENT /end LOC_MEASUREMENT /begin SUB_FUNCTION /end SUB_FUNCTION /end FUNCTION
/begin FUNCTION KRRA "Klopfregelung mit Adaption der zylinderindividuellen Sp‰tverstellung"
 /begin DEF_CHARACTERISTIC CW_KRRA DWEKSN DWKRMSN KRAL1N KRAL2N KRALH KRAN1 KRAN2 KRAN3 KRAN4 KRANH KRDWA KRDWKLA KRDWSA KRDWSN KRFKN KRLMDY KRMXN KRNMDY KRVFLN KRVFSLN KRZWOFF_NL LKRALL LKRN NFKRAS NKRF SENE1 SENE2 STKRLDY STKRNDY TMKR TMKRA VS100ZWKR /end DEF_CHARACTERISTIC
 /begin REF_CHARACTERISTIC KSZA SENZZYL S_ZNDRLP /end REF_CHARACTERISTIC
 /begin IN_MEASUREMENT B_adpini B_clradkr B_ffuerfse B_fkvs B_fosb B_ftev B_kl B_krdws B_krldy B_krldya B_krndy B_ll B_stend B_vl nmot rl rlp tmotzyl_w vszwkr zwkrafld zzylkr /end IN_MEASUREMENT
 /begin OUT_MEASUREMENT B_kr B_tmkr B_zwkraa dwkr dwkrz krfkw krvfakt lkrw stkrnx vszwm wkr wkra wkratst wkrm wkrma wkr_tst /end OUT_MEASUREMENT
 /begin LOC_MEASUREMENT B_kra B_kras B_ksa B_ksb B_lkrall B_wkral B_zwkrum dweksw dwkrmsw kral1w kral2w krdwsw krmxw krvfsw krvfw ksa ksb ksdefa ksdefb stkrlx wkrksa wkrksb zkrvf /end LOC_MEASUREMENT
 /begin SUB_FUNCTION /end SUB_FUNCTION
/end FUNCTION
/begin FUNCTION KTM "KTM.      Kraftstofftemperaturmodell"
 /begin DEF_CHARACTERISTIC CWKTM KFKTM KFKTM2 KFTMOKOR KFZKTMTKR MKRSTFAK TABKOR TKAKOR TKRSTINT ZKTMTKA ZKTMTMOT ZKTMVFZLU /end DEF_CHARACTERISTIC
 /begin REF_CHARACTERISTIC /end REF_CHARACTERISTIC
 /begin IN_MEASUREMENT B_adpini B_nmot B_st B_stend nmot tabgmab tabst_w taml tans tka tmot tnst_w tumg vfzg vsskrst /end IN_MEASUREMENT
 /begin OUT_MEASUREMENT B_ktm_ini tkrst tkrstab /end OUT_MEASUREMENT
 /begin LOC_MEASUREMENT tkakor_in tkrstluft tkrststart tkrstvt tkrstwand tkrstzu tptmot_out /end LOC_MEASUREMENT
 /begin SUB_FUNCTION /end SUB_FUNCTION
/end FUNCTION
/begin FUNCTION KT_ADC "" /begin DEF_CHARACTERISTIC /end DEF_CHARACTERISTIC /begin REF_CHARACTERISTIC KW_UbEwsMin /end REF_CHARACTERISTIC /begin IN_MEASUREMENT B_lowvoltage Ews_active EWS_inhibit udkp1_w /end IN_MEASUREMENT
 /begin OUT_MEASUREMENT udsk udsk_w udsu_w ugetrg uiekp_w uielue_w uisys_w uizdg_w uki1_w ukl15 ulam1 ulam2 ulsvk1 ulsvk2 urai_w utzyl1 utzyl1_w utzyl2 utzyl2_w uuekp uuelue uusys uuzdg wtans wtmot wtsg wub /end OUT_MEASUREMENT
 /begin LOC_MEASUREMENT /end LOC_MEASUREMENT
 /begin SUB_FUNCTION /end SUB_FUNCTION
/end FUNCTION
/begin FUNCTION KT_BTS ""
 /begin DEF_CHARACTERISTIC CW_BTS CW_BTSKILL DELTAIIMX FAKIBTS IIEKPMAX IISYSMAX IIZDGMAX TBTSOFFSC TIMXBTSON UMIN ZKIIBTS /end DEF_CHARACTERISTIC
 /begin REF_CHARACTERISTIC /end REF_CHARACTERISTIC
 /begin IN_MEASUREMENT B_btekp B_ekp B_ekpbts B_ekpbtssc B_ekpet B_kl15 B_sperrEKP B_sysbts B_sysbtssc B_zdgbts B_zdgbtssc ES_kill Ews_auth uiekp_w uisys_w uizdg_w uuekp uusys uuzdg /end IN_MEASUREMENT
 /begin OUT_MEASUREMENT Bts_stat Bts_stat2 Bts_stat3 B_ekpein B_iekpmx B_isysmx B_izdgmx B_killfall B_killrise B_uekpmn B_usysmn B_uzdgmn eskillold iekp iiekpf_w iiekp_w iisysf_w iisys_w iizdgf_w iizdg_w isys izdg t_iekp t_iekpsc t_isys t_isyssc t_izdg t_izdgsc /end OUT_MEASUREMENT
 /begin LOC_MEASUREMENT /end LOC_MEASUREMENT
 /begin SUB_FUNCTION /end SUB_FUNCTION
/end FUNCTION
/begin FUNCTION KT_GGLS "" /begin DEF_CHARACTERISTIC /end DEF_CHARACTERISTIC /begin REF_CHARACTERISTIC TGGLS /end REF_CHARACTERISTIC /begin IN_MEASUREMENT B_pripv B_pripv2 /end IN_MEASUREMENT
 /begin OUT_MEASUREMENT uulsuv2_w uulsuv_w uusvk2_w uusvk2_w_1ms uusvk_w uusvk_w_1ms /end OUT_MEASUREMENT
 /begin LOC_MEASUREMENT /end LOC_MEASUREMENT
 /begin SUB_FUNCTION /end SUB_FUNCTION
/end FUNCTION
/begin FUNCTION KT_INJEC "Komponententreiber Einspritzung ME 9" /begin DEF_CHARACTERISTIC CWVLTEST /end DEF_CHARACTERISTIC /begin REF_CHARACTERISTIC /end REF_CHARACTERISTIC
 /begin IN_MEASUREMENT B_esbnb B_esbst B_stend B_timesync_out nmot tez_l Ti_summe tvu_w wea wes wvesp zzyl /end IN_MEASUREMENT
 /begin OUT_MEASUREMENT anzti anzti_w tesum_l ti_summe_alt /end OUT_MEASUREMENT
 /begin LOC_MEASUREMENT abbwevz /end LOC_MEASUREMENT
 /begin SUB_FUNCTION /end SUB_FUNCTION
/end FUNCTION
/begin FUNCTION KT_MLS "" /begin DEF_CHARACTERISTIC FQML MLSSTART /end DEF_CHARACTERISTIC /begin REF_CHARACTERISTIC /end REF_CHARACTERISTIC /begin IN_MEASUREMENT B_btelue B_elue B_sysbts /end IN_MEASUREMENT /begin OUT_MEASUREMENT taml ztmls /end OUT_MEASUREMENT /begin LOC_MEASUREMENT /end LOC_MEASUREMENT /begin SUB_FUNCTION /end SUB_FUNCTION /end FUNCTION
/begin FUNCTION KT_PORTSOFF "" /begin DEF_CHARACTERISTIC /end DEF_CHARACTERISTIC /begin REF_CHARACTERISTIC /end REF_CHARACTERISTIC /begin IN_MEASUREMENT /end IN_MEASUREMENT /begin OUT_MEASUREMENT /end OUT_MEASUREMENT /begin LOC_MEASUREMENT /end LOC_MEASUREMENT /begin SUB_FUNCTION /end SUB_FUNCTION /end FUNCTION
/begin FUNCTION KT_SLS "" /begin DEF_CHARACTERISTIC /end DEF_CHARACTERISTIC /begin REF_CHARACTERISTIC /end REF_CHARACTERISTIC /begin IN_MEASUREMENT B_btslp B_slp B_slpet /end IN_MEASUREMENT /begin OUT_MEASUREMENT /end OUT_MEASUREMENT /begin LOC_MEASUREMENT /end LOC_MEASUREMENT /begin SUB_FUNCTION /end SUB_FUNCTION /end FUNCTION
/begin FUNCTION KT_TEV "" /begin DEF_CHARACTERISTIC CWTEV CWTEVPOS PER2TEETH TEVCOR TEVEND /end DEF_CHARACTERISTIC /begin REF_CHARACTERISTIC /end REF_CHARACTERISTIC /begin IN_MEASUREMENT B_bttev B_tevet B_tevtstp nmot rl_w tateout tevper t_bttev /end IN_MEASUREMENT /begin OUT_MEASUREMENT B_tevtini tevangle tevdangle tevduty tevdutycor tev_btduty /end OUT_MEASUREMENT /begin LOC_MEASUREMENT /end LOC_MEASUREMENT /begin SUB_FUNCTION /end SUB_FUNCTION /end FUNCTION
/begin FUNCTION KT_VFZG "" /begin DEF_CHARACTERISTIC AIMV /end DEF_CHARACTERISTIC /begin REF_CHARACTERISTIC /end REF_CHARACTERISTIC /begin IN_MEASUREMENT /end IN_MEASUREMENT /begin OUT_MEASUREMENT vroh_w /end OUT_MEASUREMENT /begin LOC_MEASUREMENT /end LOC_MEASUREMENT /begin SUB_FUNCTION /end SUB_FUNCTION /end FUNCTION
/begin FUNCTION KT_ZUEN "Komponententreiber Z¸ndung Masterfunktion f¸r ME9" /begin DEF_CHARACTERISTIC /end DEF_CHARACTERISTIC /begin REF_CHARACTERISTIC /end REF_CHARACTERISTIC
 /begin IN_MEASUREMENT B_ff B_llrein B_nmin ffzanz ffztld ffztof szout_w zwoutar zzyl /end IN_MEASUREMENT
 /begin OUT_MEASUREMENT zzylzue /end OUT_MEASUREMENT
 /begin LOC_MEASUREMENT /end LOC_MEASUREMENT
 /begin SUB_FUNCTION /end SUB_FUNCTION
/end FUNCTION
/begin FUNCTION KVA "Ausgangssignal: Kraftstoff-Verbrauchs-Anzeige" /begin DEF_CHARACTERISTIC FKVAUM /end DEF_CHARACTERISTIC /begin REF_CHARACTERISTIC CWFRPC KLKRKTE /end REF_CHARACTERISTIC /begin IN_MEASUREMENT B_adpini frlfsdp_w frpc_corr rkte_w rk_w tesum_l /end IN_MEASUREMENT /begin OUT_MEASUREMENT fkvaum_ee kvarest kvaverbr kvaverbrko kva_korr te_ges /end OUT_MEASUREMENT /begin LOC_MEASUREMENT /end LOC_MEASUREMENT /begin SUB_FUNCTION /end SUB_FUNCTION /end FUNCTION
/begin FUNCTION L9935 "" /begin DEF_CHARACTERISTIC L9935_COIL_MODE L9935_ERR_STEPS /end DEF_CHARACTERISTIC /begin REF_CHARACTERISTIC /end REF_CHARACTERISTIC /begin IN_MEASUREMENT /end IN_MEASUREMENT /begin OUT_MEASUREMENT L9935_current_position L9935_errors L9935_sdo /end OUT_MEASUREMENT /begin LOC_MEASUREMENT /end LOC_MEASUREMENT /begin SUB_FUNCTION /end SUB_FUNCTION /end FUNCTION
/begin FUNCTION LAKH "Lambda-Koordination bei Katheizen"
 /begin DEF_CHARACTERISTIC IMLLASKH KFLANSKH KFLASKH KFLMSKH KLLAKHFH LASDSLA LASTMOT LMSTMOT ZFLASKH /end DEF_CHARACTERISTIC
 /begin REF_CHARACTERISTIC /end REF_CHARACTERISTIC
 /begin IN_MEASUREMENT anztib_w B_dsla B_fasla B_kh B_slsfz fho_w flakh flamsl2_w flamsl_w flmssl fmsldyn fslpdyn imlpr ml_w nmot_w rl_w tmotzyl_w tmstzyl_w /end IN_MEASUREMENT
 /begin OUT_MEASUREMENT B_lamkhe lamkh2_w lamkh_w /end OUT_MEASUREMENT
 /begin LOC_MEASUREMENT B_dslafa flaskh flmsslkh fslsdyn LAKHlokBits lamkhg2_w lamkhg_w lamkhr2_w lamkhr_w lanskh_w lasdslg2_w lasdslg_w lasdsl_w laskh_w lmskh_w lmssl2_w lmssl_w /end LOC_MEASUREMENT
 /begin SUB_FUNCTION /end SUB_FUNCTION
/end FUNCTION
/begin FUNCTION LAMBTS ""
 /begin DEF_CHARACTERISTIC CWLAMBTS DLBTS DTBTS ETADZW FBSTABGM KFFDLBTS KFLBTS KFZWOBTS KLBTSVL KLZWBSVL TABGBTS TKATBTS ZDLBTS /end DEF_CHARACTERISTIC
 /begin REF_CHARACTERISTIC SNM16GKUB SNM16OPUW SRL12GKUB SRL16OPUW /end REF_CHARACTERISTIC
 /begin IN_MEASUREMENT B_dash B_gsaf B_vl esst_snm16gkub esst_snm16opuw esst_srl12gkub esst_srl16opuw etazwist nmot nmot_w rl rl_w_kge tabgm_w tkatm_w zwgru zwist zwopt /end IN_MEASUREMENT
 /begin OUT_MEASUREMENT lambts_w /end OUT_MEASUREMENT
 /begin LOC_MEASUREMENT B_fbstabgm B_tabgbts B_tkatbts detazwbs dlambts_w dzwg dzwibts etazwg etazwibts etazwim lbts_w /end LOC_MEASUREMENT
 /begin SUB_FUNCTION /end SUB_FUNCTION
/end FUNCTION
/begin FUNCTION LAMFAW "Lambda Fahrerwunsch"
 /begin DEF_CHARACTERISTIC KFLAMFA LAMFAMAS LAMFAMAX LAMFAVL LAMFB LAMFBMAX LAMFBMIN LAMFBOFBT LAMFBOFGANG LAMVFGMIN TLAFA TMVL /end DEF_CHARACTERISTIC
 /begin REF_CHARACTERISTIC /end REF_CHARACTERISTIC
 /begin IN_MEASUREMENT B_ll B_noise_er B_stend B_vl gangi nmot rl tans tmot tmotzyl_u vfzg /end IN_MEASUREMENT
 /begin OUT_MEASUREMENT B_vla lamfa_w lamfb /end OUT_MEASUREMENT
 /begin LOC_MEASUREMENT /end LOC_MEASUREMENT
 /begin SUB_FUNCTION /end SUB_FUNCTION
/end FUNCTION
/begin FUNCTION LAMKO "Lambdakoordination"
 /begin DEF_CHARACTERISTIC CWLAMKH LAMFLGSL LAMLGFTM LAMLGMTM LAMSOSOF LAMSOSUF LASOAB /end DEF_CHARACTERISTIC
 /begin REF_CHARACTERISTIC CWEBSLV STM12ESUB /end REF_CHARACTERISTIC
 /begin IN_MEASUREMENT B_bevab B_bevab2 B_dsla B_fasla B_kh B_lamdkt B_lamdkt2 B_lamkhe B_lamnse B_sls B_slv B_slvein esst_stm12esub flamkh flamsl2_w flamsl_w imlatm lambts_w lamdkt2_w lamdkt_w lamfa_w lamka2_w lamka_w lamkh2_w lamkh_w lamnswl_w tmot /end IN_MEASUREMENT
 /begin OUT_MEASUREMENT B_lalgf B_lalgf2 B_lamka B_lamka2 B_lamsdef lambas lamsbg2_w lamsbg_w lamsl lamsl2 lamsons2_w lamsons_w lamvoa2_w lamvoa_w /end OUT_MEASUREMENT
 /begin LOC_MEASUREMENT B_lambts B_lambts2 B_lamkh B_lamnswl B_ldef B_ldef2 lamkhe2_w lamkhe_w lamlgfmn lamlgm lams2_w lamsos2_w lamsos_w lamsubg2_w lamsubg_w lams_w /end LOC_MEASUREMENT
 /begin SUB_FUNCTION /end SUB_FUNCTION
/end FUNCTION
/begin FUNCTION lam_io "" /begin DEF_CHARACTERISTIC LAM_DIAG /end DEF_CHARACTERISTIC /begin REF_CHARACTERISTIC /end REF_CHARACTERISTIC /begin IN_MEASUREMENT ulam1 ulam2 /end IN_MEASUREMENT /begin OUT_MEASUREMENT lam_1 lam_2 /end OUT_MEASUREMENT /begin LOC_MEASUREMENT /end LOC_MEASUREMENT /begin SUB_FUNCTION /end SUB_FUNCTION /end FUNCTION
/begin FUNCTION LLRABG "Leerlaufregelung-Solldrehzahl Korrektur mit Tester"
 /begin DEF_CHARACTERISTIC NFSACVMN NFSACVMX NFSMVMN NFSMVMX NLLMVMN NLLMVMX NSACMVMN NSACMVMX NSLBVMN NSLBVMX TMLLRNS TMNV TMNVFS /end DEF_CHARACTERISTIC
 /begin REF_CHARACTERISTIC /end REF_CHARACTERISTIC
 /begin IN_MEASUREMENT B_eepdif B_ll tmot /end IN_MEASUREMENT
 /begin OUT_MEASUREMENT B_nsabg dnfsacmv dnfsmv dnllmv dnsacmv dnslbv /end OUT_MEASUREMENT
 /begin LOC_MEASUREMENT /end LOC_MEASUREMENT
 /begin SUB_FUNCTION /end SUB_FUNCTION
/end FUNCTION
/begin FUNCTION LLRBB "Leerlaufregelung Betriebsbedingungen" /begin DEF_CHARACTERISTIC CNFKUPPL DNLLR TVDK TVKUPPL TVLLRI TVLLRPD VLLR /end DEF_CHARACTERISTIC /begin REF_CHARACTERISTIC /end REF_CHARACTERISTIC
 /begin IN_MEASUREMENT B_dash B_fil B_fs B_kuppl B_ll B_mdein B_nmot B_sa B_sab B_stend dmllri_w dn gangi mill_w mistt nmot nmotll nmot_w nstat tmot vfzg /end IN_MEASUREMENT
 /begin OUT_MEASUREMENT B_llr B_llrein B_llri B_llrpd B_vllr /end OUT_MEASUREMENT
 /begin LOC_MEASUREMENT /end LOC_MEASUREMENT
 /begin SUB_FUNCTION /end SUB_FUNCTION
/end FUNCTION
/begin FUNCTION LLRMR "Momentenreserve Leerlaufregelung"
 /begin DEF_CHARACTERISTIC CWLLRMR DMRESFS DMRESLL DMRESLW DNLLRES KFMRES KFMRESFS KFMRESFST KFMREST MRESFSM MRESLLM MRESTEV TDMRESLL TVLLRMRTEV TVRESFS TVRESLL /end DEF_CHARACTERISTIC
 /begin REF_CHARACTERISTIC SNS06LLSB STA04SAUB STM04SAUB /end REF_CHARACTERISTIC
 /begin IN_MEASUREMENT B_dtebn B_fs B_ll B_nswo1 B_stend dmrac dmrkrll dns dpsfak esst_sns06llsb esst_sta04saub esst_stm04saub lws_w tans tmot /end IN_MEASUREMENT
 /begin OUT_MEASUREMENT dmdresdtev dmdresfs dmlllmn_w dmrllr_w /end OUT_MEASUREMENT
 /begin LOC_MEASUREMENT /end LOC_MEASUREMENT
 /begin SUB_FUNCTION /end SUB_FUNCTION
/end FUNCTION
/begin FUNCTION LLRNS "Leerlaufregelung-Solldrehzahl"
 /begin DEF_CHARACTERISTIC CW_LBZAP DNSNFX FNSNF FNSNFT FNSSTM FNSSTMT KNSNF KNSNFT LBZAPPL NFHZ NFHZFS NFSM NGNSNF NLBZSOLL NLBZSO_OFF NLLM NSAC NSACFS NSFSHLS NSHLS NSLPP NSLPPFS NSMNEGS NSNOT NSNOT1 NSNOT1FS NSNOTFS NSOELH NSOELHFS NTEB NTEBFS SNS06LLSB SNS06LLTSB TDNLBZ VNLBZHI ZKNS ZNLBZ ZNLBZ_OFF ZNSM ZNSMT /end DEF_CHARACTERISTIC
 /begin REF_CHARACTERISTIC STM06LLTUB STM06LLUB /end REF_CHARACTERISTIC
 /begin IN_MEASUREMENT B_autget B_dknolu B_dkpu B_egscok B_falls B_fhz B_fs B_gd B_HLSKW B_kuppl B_ll B_llrein B_nac B_nftev B_nnot B_nsub B_nsubcan B_nswo1 B_oelh B_pn B_stend dnfsacmv dnfsmv dnllmv dnsacmv dpsfak esst_stm06lltub esst_stm06llub nfskh ngfil nllkh nmotll nsolfa psl tmot vfzg vsns /end IN_MEASUREMENT
 /begin OUT_MEASUREMENT B_fallsa B_nivns B_nlbfast B_nlboff B_nlbon dns esst_sns06llsb esst_sns06lltsb llsstat nsfsm nslbfast nslbslow nsllm nsllmkl nsol nsol_w nsst nstat /end OUT_MEASUREMENT
 /begin LOC_MEASUREMENT nsfsmn nslbz nsllmn nsnf /end LOC_MEASUREMENT
 /begin SUB_FUNCTION /end SUB_FUNCTION
/end FUNCTION
/begin COMPU_METHOD aimv_ul_b4p608e11 "" RAT_FUNC "%13.0" "-" COEFFS 0 0 4.608e+011 0 1 0 /end COMPU_METHOD
/begin COMPU_METHOD bfzg_sb_q0p217 "" RAT_FUNC "%6.3" "m/s^2" COEFFS 0 1 0 0 0 0.217 /end COMPU_METHOD
/begin COMPU_METHOD B_TRUE "" TAB_VERB "%6.3" "" COMPU_TAB_REF B_TRUE /end COMPU_METHOD
/begin COMPU_VTAB B_TRUE "" TAB_VERB 2 0 "false" 1 "TRUE" /end COMPU_VTAB
/begin COMPU_METHOD Def_n4 "" RAT_FUNC "%6.3" "Upm" COEFFS 0 4 0 0 0 1 /end COMPU_METHOD
/begin COMPU_METHOD dez "" RAT_FUNC "%6.2" "" COEFFS 0 1 0 0 0 1 /end COMPU_METHOD
/begin COMPU_METHOD dezsub1 "" RAT_FUNC "%6.2" "-" COEFFS 0 1 -1 0 0 1 /end COMPU_METHOD
/begin COMPU_METHOD fak_i_bts "" RAT_FUNC "%6.5" "-" COEFFS 0 65535 0 0 0 20 /end COMPU_METHOD
/begin COMPU_METHOD fak_q0p000244 "" RAT_FUNC "%6.5" "-" COEFFS 0 65536 0 0 0 16 /end COMPU_METHOD
/begin COMPU_METHOD fak_sb_b0p25 "" RAT_FUNC "%6.4" "-" COEFFS 0 256 0 0 0 0.5 /end COMPU_METHOD
/begin COMPU_METHOD fak_sb_b1 "" RAT_FUNC "%6.4" "-" COEFFS 0 256 0 0 0 2 /end COMPU_METHOD
/begin COMPU_METHOD fak_sb_b2 "" RAT_FUNC "%6.4" "-" COEFFS 0 256 0 0 0 4 /end COMPU_METHOD
/begin COMPU_METHOD fak_sw_b8 "" RAT_FUNC "%6.5" "-" COEFFS 0 65536 0 0 0 16 /end COMPU_METHOD
/begin COMPU_METHOD fak_ub_b1 "" RAT_FUNC "%6.4" "-" COEFFS 0 256 0 0 0 1 /end COMPU_METHOD
/begin COMPU_METHOD fak_ub_b2 "" RAT_FUNC "%6.4" "-" COEFFS 0 256 0 0 0 2 /end COMPU_METHOD
/begin COMPU_METHOD fak_ub_b4 "" RAT_FUNC "%6.4" "-" COEFFS 0 256 0 0 0 4 /end COMPU_METHOD
/begin COMPU_METHOD fak_ub_q0p01 "" RAT_FUNC "%6.4" "-" COEFFS 0 1 0 0 0 0.01 /end COMPU_METHOD
/begin COMPU_METHOD fak_uw_b1 "" RAT_FUNC "%7.6" "-" COEFFS 0 65536 0 0 0 1 /end COMPU_METHOD
/begin COMPU_METHOD fak_uw_b16 "" RAT_FUNC "%6.5" "-" COEFFS 0 65536 0 0 0 16 /end COMPU_METHOD
/begin COMPU_METHOD fak_uw_b2 "" RAT_FUNC "%7.6" "-" COEFFS 0 65536 0 0 0 2 /end COMPU_METHOD
/begin COMPU_METHOD fak_uw_b4 "" RAT_FUNC "%7.6" "-" COEFFS 0 65536 0 0 0 4 /end COMPU_METHOD
/begin COMPU_METHOD fak_uw_b64 "" RAT_FUNC "%6.5" "-" COEFFS 0 65536 0 0 0 64 /end COMPU_METHOD
/begin COMPU_METHOD freq_q1 "" RAT_FUNC "%6.2" "1/s" COEFFS 0 1 0 0 0 1 /end COMPU_METHOD
/begin COMPU_METHOD fuel_ub_q1 "" RAT_FUNC "%6.2" "l" COEFFS 0 1 0 0 0 1 /end COMPU_METHOD
/begin COMPU_METHOD fuel_uw_b1 "" RAT_FUNC "%7.6" "ul" COEFFS 0 65536 0 0 0 1 /end COMPU_METHOD
/begin COMPU_METHOD fuel_uw_b65535 "" RAT_FUNC "%6.2" "ul" COEFFS 0 1 0 0 0 1 /end COMPU_METHOD
/begin COMPU_METHOD hub_uw_q0p001 "" RAT_FUNC "%6.5" "mm" COEFFS 0 1000 0 0 0 1 /end COMPU_METHOD
/begin COMPU_METHOD ii_uw_b2621 "" RAT_FUNC "%6.4" "A^2" COEFFS 0 655.36 0 0 0 25 /end COMPU_METHOD
/begin COMPU_METHOD i_ub_q0p391 "" RAT_FUNC "%6.3" "A" COEFFS 0 25.5 0 0 0 5 /end COMPU_METHOD
/begin COMPU_METHOD kw_q0p02566 "" RAT_FUNC "%6.4" "∞KW" COEFFS 0 256 0 0 0 6 /end COMPU_METHOD
/begin COMPU_METHOD kw_q3 "" RAT_FUNC "%6.2" "Grad KW" COEFFS 0 1 0 0 0 3 /end COMPU_METHOD
/begin COMPU_METHOD lws_q0p04375 "" RAT_FUNC "%6.4" "Grad" COEFFS 0 1 0 0 0 0.04375 /end COMPU_METHOD
/begin COMPU_METHOD md_uw_q0p0625 "" RAT_FUNC "%6.4" "Nm" COEFFS 0 1 0 0 0 0.0625 /end COMPU_METHOD
/begin COMPU_METHOD m_ub_b1020 "" RAT_FUNC "%6.2" "kg/h" COEFFS 0 1 0 0 0 4 /end COMPU_METHOD
/begin COMPU_METHOD m_ub_b23p3 "" RAT_FUNC "%6.3" "kg" COEFFS 0 2812.5 0 0 0 256 /end COMPU_METHOD
/begin COMPU_METHOD m_uw_b6553p5 "" RAT_FUNC "%6.3" "kg/h" COEFFS 0 1 0 0 0 0.1 /end COMPU_METHOD
/begin COMPU_METHOD nmotd_sb_q10 "" RAT_FUNC "%6.1" "1/min" COEFFS 0 1 0 0 0 10 /end COMPU_METHOD
/begin COMPU_METHOD nmotg_nuw_q0p39 "" RAT_FUNC "%7.0" "(1/min)/s" COEFFS 0 1 12800.2 0 0 0.39063 /end COMPU_METHOD
/begin COMPU_METHOD nmotg_sw_q0p39 "" RAT_FUNC "%6.3" "1/min/s" COEFFS 0 1 0 0 0 0.39063 /end COMPU_METHOD
/begin COMPU_METHOD nmotg_ub_q100 "" RAT_FUNC "%6.0" "1/min/s" COEFFS 0 1 0 0 0 100 /end COMPU_METHOD
/begin COMPU_METHOD nmot_ub_q10 "" RAT_FUNC "%6.1" "1/min" COEFFS 0 1 0 0 0 10 /end COMPU_METHOD
/begin COMPU_METHOD nmot_ub_q40 "" RAT_FUNC "%6.1" "1/min" COEFFS 0 1 0 0 0 40 /end COMPU_METHOD
/begin COMPU_METHOD nmot_uw_q0p25 "" RAT_FUNC "%6.3" "1/min" COEFFS 0 1 0 0 0 0.25 /end COMPU_METHOD
/begin COMPU_METHOD relDK_q0p02441 "" RAT_FUNC "%6.4" "%DK" COEFFS 0 65536 0 0 0 1600 /end COMPU_METHOD
/begin COMPU_METHOD relgrad_20ms_qn0p019 "" RAT_FUNC "%6.5" "%/s" COEFFS 0 -1 0 0 0 0.019 /end COMPU_METHOD
/begin COMPU_METHOD rel_q0p09726 "" RAT_FUNC "%6.3" "%" COEFFS 0 255 0 0 0 24.9 /end COMPU_METHOD
/begin COMPU_METHOD rel_sb_q0p0976 "" RAT_FUNC "%6.3" "%" COEFFS 0 1 0 0 0 0.097647 /end COMPU_METHOD
/begin COMPU_METHOD rel_sw_b100 "" RAT_FUNC "%6.4" "%" COEFFS 0 32768 0 0 0 100 /end COMPU_METHOD
/begin COMPU_METHOD rel_sw_q0p0468 "" RAT_FUNC "%6.4" "%" COEFFS 0 65536 0 0 0 3072 /end COMPU_METHOD
/begin COMPU_METHOD rel_ub_b100 "" RAT_FUNC "%6.3" "%" COEFFS 0 255 0 0 0 100 /end COMPU_METHOD
/begin COMPU_METHOD rel_ub_b127p5 "" RAT_FUNC "%6.3" "%" COEFFS 0 2 0 0 0 1 /end COMPU_METHOD
/begin COMPU_METHOD rel_ub_b1p0 "" RAT_FUNC "%6.4" "%" COEFFS 0 256 0 0 0 1 /end COMPU_METHOD
/begin COMPU_METHOD rel_ub_b24p9 "" RAT_FUNC "%6.3" "%" COEFFS 0 255 0 0 0 24.9 /end COMPU_METHOD
/begin COMPU_METHOD rel_ub_b99p6 "" RAT_FUNC "%6.3" "%" COEFFS 0 256 0 0 0 100 /end COMPU_METHOD
/begin COMPU_METHOD rel_ub_q0p75 "" RAT_FUNC "%6.3" "%" COEFFS 0 1 0 0 0 0.75 /end COMPU_METHOD
/begin COMPU_METHOD rel_uw_b100 "" RAT_FUNC "%6.4" "%" COEFFS 0 65536 0 0 0 100 /end COMPU_METHOD
/begin COMPU_METHOD rel_uw_b3072 "" RAT_FUNC "%6.4" "%" COEFFS 0 65536 0 0 0 3072 /end COMPU_METHOD
/begin COMPU_METHOD rel_uw_q0p001 "" RAT_FUNC "%6.5" "%" COEFFS 0 1000 0 0 0 1 /end COMPU_METHOD
/begin COMPU_METHOD rel_uw_q0p010 "" RAT_FUNC "%6.4" "%" COEFFS 0 100 0 0 0 1 /end COMPU_METHOD
/begin COMPU_METHOD rel_uw_q0p0234 "" RAT_FUNC "%6.4" "%" COEFFS 0 32 0 0 0 0.75 /end COMPU_METHOD
/begin COMPU_METHOD spg_q0p00039 "" RAT_FUNC "%6.5" "V" COEFFS 0 1 0 0 0 0.000390625 /end COMPU_METHOD
/begin COMPU_METHOD spg_q0p1 "" RAT_FUNC "%6.3" "V" COEFFS 0 1 0 0 0 0.1 /end COMPU_METHOD
/begin COMPU_METHOD spg_ubatt "" RAT_FUNC "%6.3" "V" COEFFS 0 1 0 0 0 0.0942 /end COMPU_METHOD
/begin COMPU_METHOD spg_ub_b320 "" RAT_FUNC "%7.3" "V" COEFFS 0 1 0 0 0 1.25 /end COMPU_METHOD
/begin COMPU_METHOD spg_ub_b5 "" RAT_FUNC "%6.4" "V" COEFFS 0 256 0 0 0 5 /end COMPU_METHOD
/begin COMPU_METHOD spg_uw_b1280 "" RAT_FUNC "%7.4" "V" COEFFS 0 1000 0 0 0 19.531 /end COMPU_METHOD
/begin COMPU_METHOD spg_uw_b5 "" RAT_FUNC "%6.4" "V" COEFFS 0 1024 0 0 0 5 /end COMPU_METHOD
/begin COMPU_METHOD spg_uw_q0p00488 "" RAT_FUNC "%6.4" "V" COEFFS 0 1024 0 0 0 5 /end COMPU_METHOD
/begin COMPU_METHOD t100msxs_ub_b255 "" RAT_FUNC "%6.2" "s" COEFFS 0 1 0 0 0 1 /end COMPU_METHOD
/begin COMPU_METHOD t100msxs_ub_b25p5 "" RAT_FUNC "%6.3" "s" COEFFS 0 1 0 0 0 0.1 /end COMPU_METHOD
/begin COMPU_METHOD t100msxs_uw_b6553p5 "" RAT_FUNC "%6.3" "s" COEFFS 0 1 0 0 0 0.1 /end COMPU_METHOD
/begin COMPU_METHOD t100msxs_uw_b6553p6 "" RAT_FUNC "%6.3" "s" COEFFS 0 10 0 0 0 1 /end COMPU_METHOD
/begin COMPU_METHOD t10msxs_q0p01_o0p05 "" RAT_FUNC "%6.4" "s" COEFFS 0 1 0.05 0 0 0.01 /end COMPU_METHOD
/begin COMPU_METHOD t10msxs_ub_b2p55 "" RAT_FUNC "%6.4" "s" COEFFS 0 1 0 0 0 0.01 /end COMPU_METHOD
/begin COMPU_METHOD t10msxs_uw_b655p35 "" RAT_FUNC "%6.4" "s" COEFFS 0 1 0 0 0 0.01 /end COMPU_METHOD
/begin COMPU_METHOD t1sxs_ub_b255 "" RAT_FUNC "%6.2" "s" COEFFS 0 1 0 0 0 1 /end COMPU_METHOD
/begin COMPU_METHOD t1sxs_uw_q1 "" RAT_FUNC "%6.2" "s" COEFFS 0 1 0 0 0 1 /end COMPU_METHOD
/begin COMPU_METHOD t200msxs_ub_b51 "" RAT_FUNC "%6.3" "s" COEFFS 0 1 0 0 0 0.2 /end COMPU_METHOD
/begin COMPU_METHOD t20msxs_ub_b5p1 "" RAT_FUNC "%6.4" "s" COEFFS 0 1 0 0 0 0.02 /end COMPU_METHOD
/begin COMPU_METHOD t3p2usxms_uw_b209p7 "" RAT_FUNC "%6.4" "ms" COEFFS 0 65536 0 0 0 209.751 /end COMPU_METHOD
/begin COMPU_METHOD tefuel_uw_b312p5 "" RAT_FUNC "%6.4" "ul/ms" COEFFS 0 65535 0 0 0 312.5 /end COMPU_METHOD
/begin COMPU_METHOD temp_sb_b0p093 "" RAT_FUNC "%6.5" "Grad C" COEFFS 0 512 0 0 0 0.375 /end COMPU_METHOD
/begin COMPU_METHOD temp_sb_q0p75 "" RAT_FUNC "%6.3" "Grad C" COEFFS 0 1 0 0 0 0.75 /end COMPU_METHOD
/begin COMPU_METHOD temp_sb_q1p5 "" RAT_FUNC "%6.2" "Grad C" COEFFS 0 1 0 0 0 1.5 /end COMPU_METHOD
/begin COMPU_METHOD temp_sw_q0p75 "" RAT_FUNC "%6.3" "Grad C" COEFFS 0 4 0 0 0 3 /end COMPU_METHOD
/begin COMPU_METHOD temp_ub_b191p25 "" RAT_FUNC "%6.3" "Grad C" COEFFS 0 1 0 0 0 0.75 /end COMPU_METHOD
/begin COMPU_METHOD temp_ub_q0p75_o48 "" RAT_FUNC "%6.2" "Grad C" COEFFS 0 1 48 0 0 0.75 /end COMPU_METHOD
/begin COMPU_METHOD temp_ub_q5_o50 "" RAT_FUNC "%6.2" "Grad C" COEFFS 0 1 50 0 0 5 /end COMPU_METHOD
/begin COMPU_METHOD temp_uw_q0p0029_o48 "" RAT_FUNC "%6.2" "Grad C" COEFFS 0 256 12288 0 0 0.75 /end COMPU_METHOD
/begin COMPU_METHOD temp_uw_q0p0195 "" RAT_FUNC "%6.4" "Grad C" COEFFS 0 256 0 0 0 5 /end COMPU_METHOD
/begin COMPU_METHOD temp_uw_q0p0195_o50 "" RAT_FUNC "%6.2" "Grad C" COEFFS 0 256 12800 0 0 5 /end COMPU_METHOD
/begin COMPU_METHOD temp_uw_q0p75_o48 "" RAT_FUNC "%6.2" "Grad C" COEFFS 0 1 48 0 0 0.75 /end COMPU_METHOD
/begin COMPU_METHOD vfzg_ub_q1p25 "" RAT_FUNC "%6.2" "km/h" COEFFS 0 1 0 0 0 1.25 /end COMPU_METHOD
/begin COMPU_METHOD vfzg_uw_b512 "" RAT_FUNC "%6.4" "km/h" COEFFS 0 65536 0 0 0 512 /end COMPU_METHOD
/begin COMPU_METHOD wink_uw_q0p1 "" RAT_FUNC "%6.3" "Grad" COEFFS 0 10 0 0 0 1 /end COMPU_METHOD
/begin COMPU_METHOD zk100msxs_ub_b25p5 "" RAT_FUNC "%6.3" "s" COEFFS 0 0 256 0 10 0 /end COMPU_METHOD
/begin COMPU_METHOD zk100msxs_uw_b6553 "" RAT_FUNC "%10.3" "s" COEFFS 0 0 65536 0 10 0 /end COMPU_METHOD
/begin COMPU_METHOD zk10msxs_ub_b2p56 "" RAT_FUNC "%6.4" "s" COEFFS 0 0 256 0 100 0 /end COMPU_METHOD
/begin COMPU_METHOD zk20msxs_ub_b5p1 "" RAT_FUNC "%6.4" "s" COEFFS 0 0 5.1 0 1 0 /end COMPU_METHOD
/begin COMPU_METHOD zw_sb_q0p75 "" RAT_FUNC "%6.3" "Grad KW" COEFFS 0 255 0 0 0 191.25 /end COMPU_METHOD
/begin COMPU_METHOD zw_sb_qn0p75 "" RAT_FUNC "%6.4" "Grad KW" COEFFS 0 1 0 0 0 -0.75 /end COMPU_METHOD
/begin COMPU_METHOD zw_ub_q0p75 "" RAT_FUNC "%6.3" "Grad KW" COEFFS 0 255 0 0 0 191.25 /end COMPU_METHOD
/begin COMPU_METHOD zw_ub_qn0p75 "" RAT_FUNC "%6.4" "Grad KW" COEFFS 0 1 0 0 0 -0.75 /end COMPU_METHOD
/begin COMPU_METHOD default "" RAT_FUNC "%6.2" "" COEFFS 0 1 0 0 0 1 /end COMPU_METHOD
/begin RECORD_LAYOUT FklWUb FNC_VALUES 1 UBYTE COLUMN_DIR DIRECT /end RECORD_LAYOUT
/begin RECORD_LAYOUT GkfWS16 FNC_VALUES 1 SWORD COLUMN_DIR DIRECT /end RECORD_LAYOUT
/begin RECORD_LAYOUT GkfWSb FNC_VALUES 1 SBYTE COLUMN_DIR DIRECT /end RECORD_LAYOUT
/begin RECORD_LAYOUT GkfWU8 FNC_VALUES 1 UBYTE COLUMN_DIR DIRECT /end RECORD_LAYOUT
/begin RECORD_LAYOUT GkfWUb FNC_VALUES 1 UBYTE COLUMN_DIR DIRECT /end RECORD_LAYOUT
/begin RECORD_LAYOUT GklWSb FNC_VALUES 1 SBYTE COLUMN_DIR DIRECT /end RECORD_LAYOUT
/begin RECORD_LAYOUT GklWU8 FNC_VALUES 1 UBYTE COLUMN_DIR DIRECT /end RECORD_LAYOUT
/begin RECORD_LAYOUT GklWUb FNC_VALUES 1 UBYTE COLUMN_DIR DIRECT /end RECORD_LAYOUT
/begin RECORD_LAYOUT KfAxU8AyU8SstxU16SstyU16WU16 NO_AXIS_PTS_X 1 UWORD NO_AXIS_PTS_Y 2 UWORD AXIS_PTS_X 3 UWORD INDEX_INCR DIRECT AXIS_PTS_Y 4 UWORD INDEX_INCR DIRECT FNC_VALUES 5 UWORD COLUMN_DIR DIRECT /end RECORD_LAYOUT
/begin RECORD_LAYOUT KfAxU8AyU8SstxU8SstyU8WU8 NO_AXIS_PTS_X 1 UBYTE NO_AXIS_PTS_Y 2 UBYTE AXIS_PTS_X 3 UBYTE INDEX_INCR DIRECT AXIS_PTS_Y 4 UBYTE INDEX_INCR DIRECT FNC_VALUES 5 UBYTE COLUMN_DIR DIRECT /end RECORD_LAYOUT
/begin RECORD_LAYOUT KfAxUbAyUbSstxUbSstyUbWSb NO_AXIS_PTS_X 1 UBYTE NO_AXIS_PTS_Y 2 UBYTE AXIS_PTS_X 3 UBYTE INDEX_INCR DIRECT AXIS_PTS_Y 4 UBYTE INDEX_INCR DIRECT FNC_VALUES 5 SBYTE COLUMN_DIR DIRECT /end RECORD_LAYOUT
/begin RECORD_LAYOUT KfAxUbAyUbSstxUbSstyUbWUb NO_AXIS_PTS_X 1 UBYTE NO_AXIS_PTS_Y 2 UBYTE AXIS_PTS_X 3 UBYTE INDEX_INCR DIRECT AXIS_PTS_Y 4 UBYTE INDEX_INCR DIRECT FNC_VALUES 5 UBYTE COLUMN_DIR DIRECT /end RECORD_LAYOUT
/begin RECORD_LAYOUT KfAxUbAyUbSstxUbSstyUwWUw NO_AXIS_PTS_X 1 UBYTE NO_AXIS_PTS_Y 2 UBYTE AXIS_PTS_X 3 UBYTE INDEX_INCR DIRECT AXIS_PTS_Y 4 UWORD INDEX_INCR DIRECT FNC_VALUES 5 UWORD COLUMN_DIR DIRECT /end RECORD_LAYOUT
/begin RECORD_LAYOUT KfAxUwAyUwSstxUwSstyUwWUw NO_AXIS_PTS_X 1 UWORD NO_AXIS_PTS_Y 2 UWORD AXIS_PTS_X 3 UWORD INDEX_INCR DIRECT AXIS_PTS_Y 4 UWORD INDEX_INCR DIRECT FNC_VALUES 5 UWORD COLUMN_DIR DIRECT /end RECORD_LAYOUT
/begin RECORD_LAYOUT KlAUbSstUbWSb NO_AXIS_PTS_X 1 UBYTE AXIS_PTS_X 2 UBYTE INDEX_INCR DIRECT FNC_VALUES 3 SBYTE COLUMN_DIR DIRECT /end RECORD_LAYOUT
/begin RECORD_LAYOUT KlAUbSstUbWUb NO_AXIS_PTS_X 1 UBYTE AXIS_PTS_X 2 UBYTE INDEX_INCR DIRECT FNC_VALUES 3 UBYTE COLUMN_DIR DIRECT /end RECORD_LAYOUT
/begin RECORD_LAYOUT KlAUbSstUbWUw NO_AXIS_PTS_X 1 UBYTE AXIS_PTS_X 2 UBYTE INDEX_INCR DIRECT FNC_VALUES 3 UWORD COLUMN_DIR DIRECT /end RECORD_LAYOUT
/begin RECORD_LAYOUT KlAUbSstUwWUw NO_AXIS_PTS_X 1 UWORD AXIS_PTS_X 2 UWORD INDEX_INCR DIRECT FNC_VALUES 3 UWORD COLUMN_DIR DIRECT /end RECORD_LAYOUT
/begin RECORD_LAYOUT KlAUwSstSwWUw NO_AXIS_PTS_X 1 UWORD AXIS_PTS_X 2 SWORD INDEX_INCR DIRECT FNC_VALUES 3 UWORD COLUMN_DIR DIRECT /end RECORD_LAYOUT
/begin RECORD_LAYOUT KlAUwSstUwWUw NO_AXIS_PTS_X 1 UWORD AXIS_PTS_X 2 UWORD INDEX_INCR DIRECT FNC_VALUES 3 UWORD COLUMN_DIR DIRECT /end RECORD_LAYOUT
/begin RECORD_LAYOUT KlAxU8SstxS16WS16 NO_AXIS_PTS_X 1 SWORD AXIS_PTS_X 2 SWORD INDEX_INCR DIRECT FNC_VALUES 3 SWORD COLUMN_DIR DIRECT /end RECORD_LAYOUT
/begin RECORD_LAYOUT KlAxU8SstxU16WS16 NO_AXIS_PTS_X 1 UWORD AXIS_PTS_X 2 UWORD INDEX_INCR DIRECT FNC_VALUES 3 SWORD COLUMN_DIR DIRECT /end RECORD_LAYOUT
/begin RECORD_LAYOUT KlAxU8SstxU16WU16 NO_AXIS_PTS_X 1 UWORD AXIS_PTS_X 2 UWORD INDEX_INCR DIRECT FNC_VALUES 3 UWORD COLUMN_DIR DIRECT /end RECORD_LAYOUT
/begin RECORD_LAYOUT KlAxU8SstxU8WU8 NO_AXIS_PTS_X 1 UBYTE AXIS_PTS_X 2 UBYTE INDEX_INCR DIRECT FNC_VALUES 3 UBYTE COLUMN_DIR DIRECT /end RECORD_LAYOUT
/begin RECORD_LAYOUT KwbWS8 FNC_VALUES 1 SBYTE COLUMN_DIR DIRECT /end RECORD_LAYOUT
/begin RECORD_LAYOUT KwSb FNC_VALUES 1 SBYTE COLUMN_DIR DIRECT /end RECORD_LAYOUT
/begin RECORD_LAYOUT KwUb FNC_VALUES 1 UBYTE COLUMN_DIR DIRECT /end RECORD_LAYOUT
/begin RECORD_LAYOUT KwUw FNC_VALUES 1 UWORD COLUMN_DIR DIRECT /end RECORD_LAYOUT
/begin RECORD_LAYOUT KwWU16 FNC_VALUES 1 UWORD COLUMN_DIR DIRECT /end RECORD_LAYOUT
/begin RECORD_LAYOUT KwWU32 FNC_VALUES 1 ULONG COLUMN_DIR DIRECT /end RECORD_LAYOUT
/begin RECORD_LAYOUT KwWU8 FNC_VALUES 1 UBYTE COLUMN_DIR DIRECT /end RECORD_LAYOUT
/begin RECORD_LAYOUT SstASwSstSw NO_AXIS_PTS_X 1 SWORD AXIS_PTS_X 2 SWORD INDEX_INCR DIRECT /end RECORD_LAYOUT
/begin RECORD_LAYOUT SstAU8SstU8 NO_AXIS_PTS_X 1 UBYTE AXIS_PTS_X 2 UBYTE INDEX_INCR DIRECT /end RECORD_LAYOUT
/begin RECORD_LAYOUT SstAUbSstSb NO_AXIS_PTS_X 1 UBYTE AXIS_PTS_X 2 SBYTE INDEX_INCR DIRECT /end RECORD_LAYOUT
/begin RECORD_LAYOUT SstAUbSstUb NO_AXIS_PTS_X 1 UBYTE AXIS_PTS_X 2 UBYTE INDEX_INCR DIRECT /end RECORD_LAYOUT
/begin RECORD_LAYOUT SstAUwSstUw NO_AXIS_PTS_X 1 UWORD AXIS_PTS_X 2 UWORD INDEX_INCR DIRECT /end RECORD_LAYOUT
/end MODULE
/end PROJECT
