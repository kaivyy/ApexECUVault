ASAP2_VERSION 1 41
/begin PROJECT MSD85 "Spray Guided DI-System with Piezo Injectors for 8-Cylinder"
/begin HEADER "_default_HeaderComment" PROJECT_NO _91 /end HEADER
/begin MODULE _default_ModuleName "_default_ModuleLongIdentifier"
/begin MOD_COMMON "_default_ModCommonComment" DEPOSIT ABSOLUTE BYTE_ORDER MSB_LAST ALIGNMENT_BYTE 1 ALIGNMENT_WORD 2 ALIGNMENT_LONG 2 ALIGNMENT_FLOAT32_IEEE 2 ALIGNMENT_FLOAT64_IEEE 4 /end MOD_COMMON
/begin MEASUREMENT v_amp "Ambient pressure sensor raw acquisition" UWORD _CNV_A_R_LINEAR_____2_CM 1 100. 0. 4.9951171875 DISPLAY_IDENTIFIER V_AMP ECU_ADDRESS 0xd000a780 FORMAT "%5.3" /end MEASUREMENT
/begin MEASUREMENT lv_poil_swi "logical variable oil pressure switch (1 = oil pressure o.k.)" UBYTE _CNV_S_2_RANGE__0___1_CM 1 100. 0. 1. DISPLAY_IDENTIFIER LV_POIL_SWI ECU_ADDRESS 0xd0008bf4 BIT_MASK 0x1 /end MEASUREMENT
/begin AXIS_PTS ldp_v_poil_ip_poil_v_poil "" 0xa08090b0 v_poil _REC_AXS_20_u2 4.9951171875 _CNV_A_R_LINEAR_____2_CM 8 0. 4.9951171875 FORMAT "%5.3" /end AXIS_PTS
/begin CHARACTERISTIC ip_poil_v_poil "Oil pressure senosr linearisation table" CURVE 0xa080b354 _REC_CUR_20_u2_u2 20. _CNV_A_R_LINEAR_____247_CM 0. 20. DISPLAY_IDENTIFIER IP_POIL_V_POIL
 /begin AXIS_DESCR COM_AXIS v_poil _CNV_A_R_LINEAR_____2_CM 8 0. 4.9951171875 FORMAT "%5.3" AXIS_PTS_REF ldp_v_poil_ip_poil_v_poil /end AXIS_DESCR
/end CHARACTERISTIC
/begin CHARACTERISTIC c_poil_err_sub "Substitude value of oil pressure in case of an sensor error" VALUE 0xa080c07c _REC_VAL_20_u2 20. _CNV_A_R_LINEAR_____247_CM 0. 20. DISPLAY_IDENTIFIER C_POIL_ERR_SUB /end CHARACTERISTIC
/begin MEASUREMENT poil "Oil pressure" UWORD _CNV_A_R_LINEAR_____247_CM 1 100. 0. 20. DISPLAY_IDENTIFIER POIL ECU_ADDRESS 0xd000a7b0 /end MEASUREMENT
/begin CHARACTERISTIC lc_poil_ctl_ena "Boolean to enable oil pressure control" VALUE 0xa080c5d0 _REC_VAL_20_u1 1. _CNV_A_R_LINEAR_____0_CM 0. 1. DISPLAY_IDENTIFIER LC_POIL_CTL_ENA FORMAT "%1.0" /end CHARACTERISTIC
/begin MEASUREMENT t_poil_swi "timer for delayed oil switch signal" UBYTE _CNV_A_R_LINEAR_____4_CM 1 100. 0. 25.5 DISPLAY_IDENTIFIER T_POIL_SWI ECU_ADDRESS 0xd00015c4 FORMAT "%4.1" /end MEASUREMENT
/begin CHARACTERISTIC c_t_poil_swi_bas "Basis time delay for oil pressure switch" VALUE 0xa080c254 _REC_VAL_20_u1 25.5 _CNV_A_R_LINEAR_____4_CM 0. 25.5 DISPLAY_IDENTIFIER C_T_POIL_SWI_BAS FORMAT "%4.1" /end CHARACTERISTIC
/begin CHARACTERISTIC c_t_poil_swi_lgt "time delay for oil pressure switch due to LGT" VALUE 0xa080c255 _REC_VAL_20_u1 25.5 _CNV_A_R_LINEAR_____4_CM 0. 25.5 DISPLAY_IDENTIFIER C_T_POIL_SWI_LGT FORMAT "%4.1" /end CHARACTERISTIC
/begin CHARACTERISTIC c_t_poil_swi_trv "time delay for oil pressure switch due to TRV" VALUE 0xa080c257 _REC_VAL_20_u1 25.5 _CNV_A_R_LINEAR_____4_CM 0. 25.5 DISPLAY_IDENTIFIER C_T_POIL_SWI_TRV FORMAT "%4.1" /end CHARACTERISTIC
/begin CHARACTERISTIC c_poil_ac_veh_lgt_tcs "threshold for longitudinal acceleration for oil pressure switch" VALUE 0xa080c078 _REC_VAL_20_s2 102.35 _CNV_A_R_LINEAR_____41_CM -51.175 51.175 DISPLAY_IDENTIFIER C_POIL_AC_VEH_LGT_TCS FORMAT "%8.3" /end CHARACTERISTIC
/begin CHARACTERISTIC c_poil_ac_veh_trv_tcs "threshold for transversal acceleration for oil pressure switch" VALUE 0xa080c07a _REC_VAL_20_s2 102.35 _CNV_A_R_LINEAR_____41_CM -51.175 51.175 DISPLAY_IDENTIFIER C_POIL_AC_VEH_TRV_TCS FORMAT "%8.3" /end CHARACTERISTIC
/begin MEASUREMENT lv_bios_poil_swi "logical variable for non debounced oil pressure switch signal" UBYTE _CNV_S_2_RANGE__0___1_CM 1 100. 0. 1. DISPLAY_IDENTIFIER LV_BIOS_POIL_SWI ECU_ADDRESS 0xd0008bf5 BIT_MASK 0x1 /end MEASUREMENT
/begin MEASUREMENT v_poil "Oil pressure sensor raw acquisition" UWORD _CNV_A_R_LINEAR_____2_CM 1 100. 0. 4.9951171875 DISPLAY_IDENTIFIER V_POIL ECU_ADDRESS 0xd000a7b2 FORMAT "%5.3" /end MEASUREMENT
/begin MEASUREMENT v_dmtl "Diagnosis module tank leakage currency raw acquisition" UWORD _CNV_A_R_LINEAR_____2_CM 1 100. 0. 4.9951171875 DISPLAY_IDENTIFIER V_DMTL ECU_ADDRESS 0xd000a6a4 FORMAT "%5.3" /end MEASUREMENT
/begin MEASUREMENT v_sof_swi "Voltage of sport switch" UWORD _CNV_A_R_LINEAR_____2_CM 1 100. 0. 4.9951171875 DISPLAY_IDENTIFIER V_SOF_SWI ECU_ADDRESS 0xd000a6a6 FORMAT "%5.3" /end MEASUREMENT
/begin MEASUREMENT v_sof_swi_mon "Voltage of sport switch for monitoring" UWORD _CNV_A_R_LINEAR_____2_CM 1 100. 0. 4.9951171875 DISPLAY_IDENTIFIER V_SOF_SWI_MON ECU_ADDRESS 0xd000a6a8 FORMAT "%5.3" /end MEASUREMENT
/begin MEASUREMENT lv_inh_nt_agi_err "inhibition of the NOx catalyst aging adaptation due to error on sensor or subsystem" UBYTE _CNV_S_2_RANGE__0___1_CM 1 100. 0. 1. DISPLAY_IDENTIFIER LV_INH_NT_AGI_ERR ECU_ADDRESS 0xd000773d BIT_MASK 0x1 /end MEASUREMENT
/begin MEASUREMENT tnt_mdl_nt_agi_dyw[0] "NOx trap temperature of limited dynamic window out of TNT_MDL_MV" UWORD _CNV_A_R_LINEAR_____209_CM 1 100. 0. 1023.984375 DISPLAY_IDENTIFIER TNT_MDL_NT_AGI_DYW[1] ECU_ADDRESS 0xd00036c0 FORMAT "%7.2" /end MEASUREMENT
/begin MEASUREMENT tnt_mdl_nt_agi_dyw[1] "NOx trap temperature of limited dynamic window out of TNT_MDL_MV" UWORD _CNV_A_R_LINEAR_____209_CM 1 100. 0. 1023.984375 DISPLAY_IDENTIFIER TNT_MDL_NT_AGI_DYW[2] ECU_ADDRESS 0xd00036c2 FORMAT "%7.2" /end MEASUREMENT
/begin MEASUREMENT lv_inh_nt_agi "flag inhibiting the NOx catalyst aging adaptation" UBYTE _CNV_S_2_RANGE__0___1_CM 1 100. 0. 1. DISPLAY_IDENTIFIER LV_INH_NT_AGI ECU_ADDRESS 0xd000773b BIT_MASK 0x1 /end MEASUREMENT
/begin CHARACTERISTIC c_tnt_mdl_nt_agi_delta "max. deviation between higher and lower NT temp. for enabling an aging adaptation" VALUE 0xa0807f4e _REC_VAL_20_u1 1020. _CNV_A_R_LINEAR_____481_CM 0. 1020. DISPLAY_IDENTIFIER C_TNT_MDL_NT_AGI_DELTA FORMAT "%4.0" /end CHARACTERISTIC
/begin CHARACTERISTIC c_tnt_mdl_nt_agi_dyw "temperature threshold for dynamic window limitation" VALUE 0xa0807f4f _REC_VAL_20_u1 1020. _CNV_A_R_LINEAR_____481_CM 0. 1020. DISPLAY_IDENTIFIER C_TNT_MDL_NT_AGI_DYW FORMAT "%4.0" /end CHARACTERISTIC
/begin CHARACTERISTIC c_crlc_tnt_mdl_nt_agi_dyw "correlation factor for calculation of TNT of dynamic window limitation" VALUE 0xa0807eec _REC_VAL_20_u2 0.9999847412109381 _CNV_A_R_LINEAR_____89_CM 0. 0.9999847412109381 DISPLAY_IDENTIFIER C_CRLC_TNT_MDL_NT_AGI_DYW FORMAT "%7.5" /end CHARACTERISTIC
/begin CHARACTERISTIC lc_inh_nt_agi_man "Deactivation flag ( for the manual setting of the inhibiting bit NOx trap aging adaptation )" VALUE 0xa0807f6a _REC_VAL_20_u1 1. _CNV_A_R_LINEAR_____0_CM 0. 1. DISPLAY_IDENTIFIER LC_INH_NT_AGI_MAN FORMAT "%1.0" /end CHARACTERISTIC
/begin CHARACTERISTIC lc_inh_nt_agi_off "Deactivation flag for the deactivation of inhibiting the NOx trap aging adaptation " VALUE 0xa0807f6b _REC_VAL_20_u1 1. _CNV_A_R_LINEAR_____0_CM 0. 1. DISPLAY_IDENTIFIER LC_INH_NT_AGI_OFF FORMAT "%1.0" /end CHARACTERISTIC
/begin CHARACTERISTIC c_tnt_mdl_nt_agi_min "temperature threshold for enabling / disabling an aging adaptation" VALUE 0xa0807f51 _REC_VAL_20_u1 1020. _CNV_A_R_LINEAR_____481_CM 0. 1020. DISPLAY_IDENTIFIER C_TNT_MDL_NT_AGI_MIN FORMAT "%4.0" /end CHARACTERISTIC
/begin MEASUREMENT lv_inh_nt_agi_tnt "inhibition of the NOx catalyst aging adaptation due to temperature window control" UBYTE _CNV_S_2_RANGE__0___1_CM 1 100. 0. 1. DISPLAY_IDENTIFIER LV_INH_NT_AGI_TNT ECU_ADDRESS 0xd00036ea BIT_MASK 0x1 /end MEASUREMENT
/begin MEASUREMENT lv_inh_nt_agi_thd "inhibition of the NOx catalyst aging adaptation due to MFF or N" UBYTE _CNV_S_2_RANGE__0___1_CM 1 100. 0. 1. DISPLAY_IDENTIFIER LV_INH_NT_AGI_THD ECU_ADDRESS 0xd00036e9 BIT_MASK 0x1 /end MEASUREMENT
/begin MEASUREMENT lv_inh_nt_agi_bas "flag inhibiting the NOx catalyst aging adaptation" UBYTE _CNV_S_2_RANGE__0___1_CM 1 100. 0. 1. DISPLAY_IDENTIFIER LV_INH_NT_AGI_BAS ECU_ADDRESS 0xd000773c BIT_MASK 0x1 /end MEASUREMENT
/begin CHARACTERISTIC c_tnt_mdl_nt_agi_max "temperature threshold for enabling / disabling an aging adaptation" VALUE 0xa0807f50 _REC_VAL_20_u1 1020. _CNV_A_R_LINEAR_____481_CM 0. 1020. DISPLAY_IDENTIFIER C_TNT_MDL_NT_AGI_MAX FORMAT "%4.0" /end CHARACTERISTIC
/begin CHARACTERISTIC c_n_32_nt_agi_max "engine speed threshold for enabling / disabling an aging adaptation" VALUE 0xa0807f0a _REC_VAL_20_u1 8160. _CNV_A_R_LINEAR_____10_CM 0. 8160. DISPLAY_IDENTIFIER C_N_32_NT_AGI_MAX FORMAT "%4.0" /end CHARACTERISTIC
/begin CHARACTERISTIC c_n_32_nt_agi_min "engine speed threshold for enabling / disabling an aging adaptation" VALUE 0xa0807f0b _REC_VAL_20_u1 8160. _CNV_A_R_LINEAR_____10_CM 0. 8160. DISPLAY_IDENTIFIER C_N_32_NT_AGI_MIN FORMAT "%4.0" /end CHARACTERISTIC
/begin CHARACTERISTIC c_mff_sp_s_nt_agi_max "fuel mass flow threshold for enabling / disabling an aging adaptation" VALUE 0xa0807f06 _REC_VAL_20_u2 1389. _CNV_A_R_LINEAR_____111_CM 0. 1389. DISPLAY_IDENTIFIER C_MFF_SP_S_NT_AGI_MAX FORMAT "%7.2" /end CHARACTERISTIC
/begin CHARACTERISTIC c_mff_sp_s_nt_agi_min "fuel mass flow threshold for enabling / disabling an aging adaptation" VALUE 0xa0807f08 _REC_VAL_20_u2 1389. _CNV_A_R_LINEAR_____111_CM 0. 1389. DISPLAY_IDENTIFIER C_MFF_SP_S_NT_AGI_MIN FORMAT "%7.2" /end CHARACTERISTIC
/begin CHARACTERISTIC c_lamb_nt_agi_min "lambda threshold for enabling / disabling an aging adaptation" VALUE 0xa0807efe _REC_VAL_20_u2 31.9990234375 _CNV_A_R_LINEAR_____129_CM 0. 31.9990234375 DISPLAY_IDENTIFIER C_LAMB_NT_AGI_MIN FORMAT "%7.4" /end CHARACTERISTIC
/begin CHARACTERISTIC c_tia_nt_agi_min "min. intake air temperature threshold for enabling / disabling an aging adaptation" VALUE 0xa0807f4a _REC_VAL_20_u1 190.5 _CNV_A_R_LINEAR_____17_CM -48. 142.5 DISPLAY_IDENTIFIER C_TIA_NT_AGI_MIN FORMAT "%5.1" /end CHARACTERISTIC
/begin CHARACTERISTIC c_toil_nt_agi_max "max. oil temperature threshold for enabling / disabling an aging adaptation" VALUE 0xa0807f57 _REC_VAL_20_u1 200. _CNV_A_R_LINEAR_____26_CM -40. 160. DISPLAY_IDENTIFIER C_TOIL_NT_AGI_MAX FORMAT "%3.0" /end CHARACTERISTIC
/begin CHARACTERISTIC c_toil_nt_agi_min "min. oil temperature threshold for enabling / disabling an aging adaptation" VALUE 0xa0807f58 _REC_VAL_20_u1 200. _CNV_A_R_LINEAR_____26_CM -40. 160. DISPLAY_IDENTIFIER C_TOIL_NT_AGI_MIN FORMAT "%3.0" /end CHARACTERISTIC
/begin CHARACTERISTIC c_amp_nt_agi_min "min. ambient pressure threshold for enabling / disabling an aging adaptation" VALUE 0xa0807ee0 _REC_VAL_20_u2 5434. _CNV_A_R_LINEAR_____27_CM 0. 5434. DISPLAY_IDENTIFIER C_AMP_NT_AGI_MIN FORMAT "%7.2" /end CHARACTERISTIC
/begin MEASUREMENT lv_nt_agi_obs_ena "Activation Conditions for continuous Aging Observation" UBYTE _CNV_S_2_RANGE__0___1_CM 1 100. 0. 1. DISPLAY_IDENTIFIER LV_NT_AGI_OBS_ENA ECU_ADDRESS 0xd0007747 BIT_MASK 0x1 /end MEASUREMENT
/begin MEASUREMENT lv_nt_agi_obs_egr_ena "Activation Conditions for continuous Aging Observation" UBYTE _CNV_S_2_RANGE__0___1_CM 1 100. 0. 1. DISPLAY_IDENTIFIER LV_NT_AGI_OBS_EGR_ENA ECU_ADDRESS 0xd0007746 BIT_MASK 0x1 /end MEASUREMENT
/begin MEASUREMENT lv_nox_sens_max_adj "Flag to enable adjustment of NOx Sensor threshold for regeneration by aging adaptation" UBYTE _CNV_S_2_RANGE__0___1_CM 1 100. 0. 1. DISPLAY_IDENTIFIER LV_NOX_SENS_MAX_ADJ ECU_ADDRESS 0xd0007740 BIT_MASK 0x1 /end MEASUREMENT
/begin MEASUREMENT lv_inh_nt_agi_tnt_bas "inhibition of the NOx catalyst aging adaptation due to temperature window control" UBYTE _CNV_S_2_RANGE__0___1_CM 1 100. 0. 1. DISPLAY_IDENTIFIER LV_INH_NT_AGI_TNT_BAS ECU_ADDRESS 0xd000773e BIT_MASK 0x1 /end MEASUREMENT
/begin CHARACTERISTIC c_tnt_mdl_mv_agi_min "Temperature threshold for enabling / disabling an aging adaptation" VALUE 0xa0807f4d _REC_VAL_20_u1 1020. _CNV_A_R_LINEAR_____481_CM 0. 1020. DISPLAY_IDENTIFIER C_TNT_MDL_MV_AGI_MIN FORMAT "%4.0" /end CHARACTERISTIC
/begin CHARACTERISTIC c_tnt_mdl_mv_agi_max "Temperature threshold for enabling / disabling an aging adaptation" VALUE 0xa0807f4c _REC_VAL_20_u1 1020. _CNV_A_R_LINEAR_____481_CM 0. 1020. DISPLAY_IDENTIFIER C_TNT_MDL_MV_AGI_MAX FORMAT "%4.0" /end CHARACTERISTIC
/begin CHARACTERISTIC lc_nox_sens_max_agi_adj_ena "Switch to enable adjustment of NOx Sensor threshold for regeneration by aging adaptation" VALUE 0xa0807f6d _REC_VAL_20_u1 1. _CNV_A_R_LINEAR_____0_CM 0. 1. DISPLAY_IDENTIFIER LC_NOX_SENS_MAX_AGI_ADJ_ENA FORMAT "%1.0" /end CHARACTERISTIC
/begin MEASUREMENT nt_agi_thermo_st "NOx trap aging factor due to thermal aging" UWORD _CNV_A_R_LINEAR_____89_CM 1 100. 0. 0.9999847412109381 DISPLAY_IDENTIFIER NT_AGI_THERMO_ST ECU_ADDRESS 0xd000369e FORMAT "%7.5" /end MEASUREMENT
/begin MEASUREMENT nt_agi_thermo_grd "NOx trap aging factor due to thermal aging" UWORD _CNV_A_R_NOXM_LINEA_482_CM 1 100. 0. -0.1 DISPLAY_IDENTIFIER NT_AGI_THERMO_GRD ECU_ADDRESS 0xd00071f4 FORMAT "%7.6" /end MEASUREMENT
/begin MEASUREMENT ctr_km_can_st "vehicle kilometer reading from CAN message INSTR2" UWORD _CNV_A_R_LINEAR_____58_CM 1 100. 0. 655350. DISPLAY_IDENTIFIER CTR_KM_CAN_ST ECU_ADDRESS 0xd0003680 FORMAT "%7.0" /end MEASUREMENT
/begin CHARACTERISTIC c_ctr_km_can_dif_min "vehicle kilometer diffence threshold for gradient calculation" VALUE 0xa0807eee _REC_VAL_20_u2 655350. _CNV_A_R_LINEAR_____58_CM 0. 655350. DISPLAY_IDENTIFIER C_CTR_KM_CAN_DIF_MIN FORMAT "%7.0" /end CHARACTERISTIC
/begin MEASUREMENT lv_inh_lamb_puls_so2p "flag inhibiting the NOx catalyst desulfation lambda stimulation" UBYTE _CNV_S_2_RANGE__0___1_CM 1 100. 0. 1. DISPLAY_IDENTIFIER LV_INH_LAMB_PULS_SO2P ECU_ADDRESS 0xd000890c BIT_MASK 0x1 /end MEASUREMENT
/begin CHARACTERISTIC lc_inh_lamb_puls_so2p_man "code word for the manual setting of the inhibiting bit NOx trap desulfation by lambda stimulation" VALUE 0xa080c58a _REC_VAL_20_u1 1. _CNV_A_R_LINEAR_____0_CM 0. 1. DISPLAY_IDENTIFIER LC_INH_LAMB_PULS_SO2P_MAN FORMAT "%1.0" /end CHARACTERISTIC
/begin CHARACTERISTIC lc_inh_lamb_puls_so2p_off "code word for the deactivation of inhibiting the NOx trap desulfation by lambda stimulation" VALUE 0xa080c58b _REC_VAL_20_u1 1. _CNV_A_R_LINEAR_____0_CM 0. 1. DISPLAY_IDENTIFIER LC_INH_LAMB_PULS_SO2P_OFF FORMAT "%1.0" /end CHARACTERISTIC
/begin MEASUREMENT lv_nt_o2_stc_req "bit for requesting an OSC adaptation cycle" UBYTE _CNV_S_2_RANGE__0___1_CM 1 100. 0. 1. DISPLAY_IDENTIFIER LV_NT_O2_STC_REQ ECU_ADDRESS 0xd0008911 BIT_MASK 0x1 /end MEASUREMENT
/begin MEASUREMENT lv_nt_o2_stc_lim "bit for limitation an OSC adaptation cycle" UBYTE _CNV_S_2_RANGE__0___1_CM 1 100. 0. 1. DISPLAY_IDENTIFIER LV_NT_O2_STC_LIM ECU_ADDRESS 0xd0008912 BIT_MASK 0x1 /end MEASUREMENT
/begin MEASUREMENT lv_nt_o2_stc_vld "Flag for valid status of OSC adaptation measurement" UBYTE _CNV_S_2_RANGE__0___1_CM 1 100. 0. 1. DISPLAY_IDENTIFIER LV_NT_O2_STC_VLD ECU_ADDRESS 0xd0008913 BIT_MASK 0x1 /end MEASUREMENT
/begin MEASUREMENT nt_o2_stc_ad "adaptation factor for NOx catalyst oxygen storage capacity" UBYTE _CNV_A_R_LINEAR_____103_CM 1 100. 0. 1.9921875 DISPLAY_IDENTIFIER NT_O2_STC_AD ECU_ADDRESS 0xd0008910 FORMAT "%5.3" /end MEASUREMENT
/begin MEASUREMENT nt_o2_stc_ofs "adaptation offset for NOx catalyst oxygen storage capacity" SWORD _CNV_A_R_LINEAR_____484_CM 1 100. -10485.6 10485.6 DISPLAY_IDENTIFIER NT_O2_STC_OFS ECU_ADDRESS 0xd000a4de FORMAT "%7.1" /end MEASUREMENT
/begin MEASUREMENT dist_o2_stc_old "mileage of last O2_STC adaptation" UWORD _CNV_A_R_LINEAR_____255_CM 1 100. 0. 524280. DISPLAY_IDENTIFIER DIST_O2_STC_OLD ECU_ADDRESS 0xd000a4dc FORMAT "%6.0" /end MEASUREMENT
/begin CHARACTERISTIC c_dist_o2_stc "mileage distance to be passed before next O2_STC measurement" VALUE 0xa080bc46 _REC_VAL_20_u2 524280. _CNV_A_R_LINEAR_____255_CM 0. 524280. DISPLAY_IDENTIFIER C_DIST_O2_STC FORMAT "%6.0" /end CHARACTERISTIC
/begin CHARACTERISTIC c_dist_o2_stc_vld "mileage distance to be passed before next O2_STC measurement is not valid anymore" VALUE 0xa080bc48 _REC_VAL_20_u2 524280. _CNV_A_R_LINEAR_____255_CM 0. 524280. DISPLAY_IDENTIFIER C_DIST_O2_STC_VLD FORMAT "%6.0" /end CHARACTERISTIC
/begin CHARACTERISTIC c_nt_o2_stc_delta "permissible deviation between old and new osc value" VALUE 0xa080c038 _REC_VAL_20_u2 10485.6 _CNV_A_R_LINEAR_____485_CM 0. 10485.6 DISPLAY_IDENTIFIER C_NT_O2_STC_DELTA FORMAT "%7.1" /end CHARACTERISTIC
/begin CHARACTERISTIC lc_nt_o2_stc_req "Logical constant for manually requesting an O2_STC adaptation cycle" VALUE 0xa080c5cc _REC_VAL_20_u1 1. _CNV_A_R_LINEAR_____0_CM 0. 1. DISPLAY_IDENTIFIER LC_NT_O2_STC_REQ FORMAT "%1.0" /end CHARACTERISTIC
/begin CHARACTERISTIC lc_nt_o2_stc_vld "Logical constant for manually setting of valid bit O2_STC value" VALUE 0xa080c5cd _REC_VAL_20_u1 1. _CNV_A_R_LINEAR_____0_CM 0. 1. DISPLAY_IDENTIFIER LC_NT_O2_STC_VLD FORMAT "%1.0" /end CHARACTERISTIC
/begin CHARACTERISTIC c_nt_o2_stc_ad_man "manual initialisation value for oxygen storage capacity adaptation value" VALUE 0xa080c036 _REC_VAL_20_u1 1.9921875 _CNV_A_R_LINEAR_____103_CM 0. 1.9921875 DISPLAY_IDENTIFIER C_NT_O2_STC_AD_MAN FORMAT "%5.3" /end CHARACTERISTIC
/begin CHARACTERISTIC lc_nt_o2_stc_ad_man "Logical constant for manual initialisation of NT_O2_STC_AD" VALUE 0xa080c5ca _REC_VAL_20_u1 1. _CNV_A_R_LINEAR_____0_CM 0. 1. DISPLAY_IDENTIFIER LC_NT_O2_STC_AD_MAN FORMAT "%1.0" /end CHARACTERISTIC
/begin CHARACTERISTIC lc_nt_o2_stc_rep_off "Logical constant for disabling a repetition of osc-measurement in case of gradient limitation" VALUE 0xa080c5cb _REC_VAL_20_u1 1. _CNV_A_R_LINEAR_____0_CM 0. 1. DISPLAY_IDENTIFIER LC_NT_O2_STC_REP_OFF FORMAT "%1.0" /end CHARACTERISTIC
/begin MEASUREMENT dist_nt "mileage counter for NOx trap purposes" UWORD _CNV_A_R_LINEAR_____255_CM 1 100. 0. 524280. DISPLAY_IDENTIFIER DIST_NT ECU_ADDRESS 0xd000a52c FORMAT "%8.3" /end MEASUREMENT
/begin MEASUREMENT ntl_dec_int_ad "mileage counter for NOx trap purposes" UWORD _CNV_A_R_LINEAR_____244_CM 1 100. 0. 10485.6 DISPLAY_IDENTIFIER NTL_DEC_INT_AD ECU_ADDRESS 0xd000a52e FORMAT "%7.1" /end MEASUREMENT
/begin CHARACTERISTIC c_maf_int_puc_min_nox "Minimum air mass flow threshold for starting the NOx signal offset adaptation at PUC." VALUE 0xa0807a2e _REC_VAL_20_u2 2912.666666666671 _CNV_A_R_LINEAR_____314_CM 0. 2912.66666666667 DISPLAY_IDENTIFIER C_MAF_INT_PUC_MIN_NOX FORMAT "%7.2" /end CHARACTERISTIC
/begin CHARACTERISTIC c_nt_agi_nox_ofs_min "NOx catalyst aging threshold for calculation of a new NOx signal offset value" VALUE 0xa0807a4a _REC_VAL_20_u2 0.9999847412109381 _CNV_A_R_LINEAR_____89_CM 0. 0.9999847412109381 DISPLAY_IDENTIFIER C_NT_AGI_NOX_OFS_MIN FORMAT "%7.5" /end CHARACTERISTIC
/begin CHARACTERISTIC c_nox_ofs_puc_max "Maximum NOx signal offset value at PUC." VALUE 0xa0807a46 _REC_VAL_20_s2 1600. _CNV_A_R_NOXD_LINEA_486_CM -100. 1500. DISPLAY_IDENTIFIER C_NOX_OFS_PUC_MAX FORMAT "%4.0" /end CHARACTERISTIC
/begin CHARACTERISTIC c_nt_hom_ini_use "Offset adaptation runs only after a complete NOx catalyst regeneration." VALUE 0xa0807a4e _REC_VAL_20_u1 3. _CNV_A_R_LINEAR_____0_CM 0. 3. DISPLAY_IDENTIFIER C_NT_HOM_INI_USE FORMAT "%1.0" /end CHARACTERISTIC
/begin CHARACTERISTIC c_nox_ofs_sel "Selection of a NOx signal adaptation method." VALUE 0xa0807a48 _REC_VAL_20_u1 3. _CNV_S_4_NOXD_NOX_O_487_CM 0. 3. DISPLAY_IDENTIFIER C_NOX_OFS_SEL /end CHARACTERISTIC
/begin CHARACTERISTIC c_tnt_mdl_nox_ofs_min "Min. temperature of NOx catalyst at which the NOx signal offset adaptation at LOAD is active." VALUE 0xa0807a70 _REC_VAL_20_u2 1023.984375 _CNV_A_R_LINEAR_____209_CM 0. 1023.984375 DISPLAY_IDENTIFIER C_TNT_MDL_NOX_OFS_MIN FORMAT "%7.2" /end CHARACTERISTIC
/begin CHARACTERISTIC c_tnt_mdl_nox_ofs_max "Max. temperature of NOx catalyst at which the NOx signal offset adaptation at LOAD is active." VALUE 0xa0807a6e _REC_VAL_20_u2 1023.984375 _CNV_A_R_LINEAR_____209_CM 0. 1023.984375 DISPLAY_IDENTIFIER C_TNT_MDL_NOX_OFS_MAX FORMAT "%7.2" /end CHARACTERISTIC
/begin CHARACTERISTIC c_t_afl_nox_ofs_min "Min. lean time for calculation of NOx signal offset adaptation value." VALUE 0xa0807a52 _REC_VAL_20_u2 1310.7 _CNV_A_R_LINEAR_____110_CM 0. 1310.7 DISPLAY_IDENTIFIER C_T_AFL_NOX_OFS_MIN FORMAT "%7.2" /end CHARACTERISTIC
/begin CHARACTERISTIC c_crlc_nox_ofs_puc "Correlation constant for calculation of PUC offset value." VALUE 0xa0807a24 _REC_VAL_20_u2 0.9999847412109381 _CNV_A_R_LINEAR_____89_CM 0. 0.9999847412109381 DISPLAY_IDENTIFIER C_CRLC_NOX_OFS_PUC FORMAT "%7.5" /end CHARACTERISTIC
/begin CHARACTERISTIC ip_crlc_nox_ofs_load "Correlation constant for calculation of LOAD offset value." CURVE 0xa0807a14 _REC_CUR_20_u2_u2 0.9999847412109381 _CNV_A_R_LINEAR_____89_CM 0. 0.9999847412109381 DISPLAY_IDENTIFIER IP_CRLC_NOX_OFS_LOAD FORMAT "%7.5"
 /begin AXIS_DESCR COM_AXIS nox_ns_ofs_ad_min[0] _CNV_A_R_NOXD_LINEA_488_CM 4 -100. 1500. FORMAT "%4.0" AXIS_PTS_REF ldp_nox_ns_ofs_ad_min_ip_load /end AXIS_DESCR
/end CHARACTERISTIC
/begin MEASUREMENT nox_ns_ad[0] "NOx concentration in the exhaust gas downstream of NOx catalyst." UWORD _CNV_A_R_NOXD_LINEA_486_CM 1 100. 0. 1500. DISPLAY_IDENTIFIER NOX_NS_AD[1] ECU_ADDRESS 0xd00071ac FORMAT "%4.0" /end MEASUREMENT
/begin MEASUREMENT nox_ns_ad[1] "NOx concentration in the exhaust gas downstream of NOx catalyst." UWORD _CNV_A_R_NOXD_LINEA_486_CM 1 100. 0. 1500. DISPLAY_IDENTIFIER NOX_NS_AD[2] ECU_ADDRESS 0xd00071ae FORMAT "%4.0" /end MEASUREMENT
/begin MEASUREMENT nox_ofs_puc[0] "NOx signal offset value, measured at PUC" SWORD _CNV_A_R_NOXD_LINEA_486_CM 1 100. -100. 1500. DISPLAY_IDENTIFIER NOX_OFS_PUC[1] ECU_ADDRESS 0xd00071bc FORMAT "%4.0" /end MEASUREMENT
/begin MEASUREMENT nox_ofs_puc[1] "NOx signal offset value, measured at PUC" SWORD _CNV_A_R_NOXD_LINEA_486_CM 1 100. -100. 1500. DISPLAY_IDENTIFIER NOX_OFS_PUC[2] ECU_ADDRESS 0xd00071be FORMAT "%4.0" /end MEASUREMENT
/begin MEASUREMENT nox_ofs_load[0] "NOx signal offset value, measured after start of a \"LOAD\" phase" SWORD _CNV_A_R_NOXD_LINEA_486_CM 1 100. -100. 1500. DISPLAY_IDENTIFIER NOX_OFS_LOAD[1] ECU_ADDRESS 0xd00071b8 FORMAT "%4.0" /end MEASUREMENT
/begin MEASUREMENT nox_ofs_load[1] "NOx signal offset value, measured after start of a \"LOAD\" phase" SWORD _CNV_A_R_NOXD_LINEA_486_CM 1 100. -100. 1500. DISPLAY_IDENTIFIER NOX_OFS_LOAD[2] ECU_ADDRESS 0xd00071ba FORMAT "%4.0" /end MEASUREMENT
/begin MEASUREMENT lv_t_ns_vld "NOx sensor signal valid after regeneration." UBYTE _CNV_S_2_RANGE__0___1_CM 1 100. 0. 1. DISPLAY_IDENTIFIER LV_T_NS_VLD ECU_ADDRESS 0xd000772a BIT_MASK 0x1 /end MEASUREMENT
/begin MEASUREMENT lv_t_ns_vld_tmp[0] "NOx sensor signal valid after regeneration (bank selective)." UBYTE _CNV_S_2_RANGE__0___1_CM 1 100. 0. 1. DISPLAY_IDENTIFIER LV_T_NS_VLD_TMP[1] ECU_ADDRESS 0xd000772c BIT_MASK 0x1 /end MEASUREMENT
/begin MEASUREMENT lv_t_ns_vld_tmp[1] "NOx sensor signal valid after regeneration (bank selective)." UBYTE _CNV_S_2_RANGE__0___1_CM 1 100. 0. 1. DISPLAY_IDENTIFIER LV_T_NS_VLD_TMP[2] ECU_ADDRESS 0xd000772d BIT_MASK 0x1 /end MEASUREMENT
/begin MEASUREMENT lv_nox_ofs_load[0] "NOx minimum observation activation." UBYTE _CNV_S_2_RANGE__0___1_CM 1 100. 0. 1. DISPLAY_IDENTIFIER LV_NOX_OFS_LOAD[1] ECU_ADDRESS 0xd0007714 BIT_MASK 0x1 /end MEASUREMENT
/begin MEASUREMENT lv_nox_ofs_load[1] "NOx minimum observation activation." UBYTE _CNV_S_2_RANGE__0___1_CM 1 100. 0. 1. DISPLAY_IDENTIFIER LV_NOX_OFS_LOAD[2] ECU_ADDRESS 0xd0007715 BIT_MASK 0x1 /end MEASUREMENT
/begin MEASUREMENT nox_ns_ofs_ad_min[0] "Minumum NOx signal after LOAD phase." SWORD _CNV_A_R_NOXD_LINEA_486_CM 1 100. -100. 1500. DISPLAY_IDENTIFIER NOX_NS_OFS_AD_MIN[1] ECU_ADDRESS 0xd00071b4 FORMAT "%4.0" /end MEASUREMENT
/begin MEASUREMENT nox_ns_ofs_ad_min[1] "Minumum NOx signal after LOAD phase." SWORD _CNV_A_R_NOXD_LINEA_486_CM 1 100. -100. 1500. DISPLAY_IDENTIFIER NOX_NS_OFS_AD_MIN[2] ECU_ADDRESS 0xd00071b6 FORMAT "%4.0" /end MEASUREMENT
/begin MEASUREMENT nox_ns_ad_add[0] "Offset adaptation value for the NOx signal." SWORD _CNV_A_R_NOXD_LINEA_486_CM 1 100. -100. 1500. DISPLAY_IDENTIFIER NOX_NS_AD_ADD[1] ECU_ADDRESS 0xd00071b0 FORMAT "%4.0" /end MEASUREMENT
/begin MEASUREMENT nox_ns_ad_add[1] "Offset adaptation value for the NOx signal." SWORD _CNV_A_R_NOXD_LINEA_486_CM 1 100. -100. 1500. DISPLAY_IDENTIFIER NOX_NS_AD_ADD[2] ECU_ADDRESS 0xd00071b2 FORMAT "%4.0" /end MEASUREMENT
/begin MEASUREMENT t_nox_ns_ad_delta_vld[0] "Timer for NOx sensor signal valid regarding gradient observation." UBYTE _CNV_A_R_LINEAR_____4_CM 1 100. 0. 25.5 DISPLAY_IDENTIFIER T_NOX_NS_AD_DELTA_VLD[1] ECU_ADDRESS 0xd000365c FORMAT "%4.1" /end MEASUREMENT
/begin MEASUREMENT t_nox_ns_ad_delta_vld[1] "Timer for NOx sensor signal valid regarding gradient observation." UBYTE _CNV_A_R_LINEAR_____4_CM 1 100. 0. 25.5 DISPLAY_IDENTIFIER T_NOX_NS_AD_DELTA_VLD[2] ECU_ADDRESS 0xd000365d FORMAT "%4.1" /end MEASUREMENT
/begin MEASUREMENT nox_ns_ad_delta_mmv[0] "NOx sensor signal gradient moving mean value (bank selective)." SWORD _CNV_A_R_NOXD_LINEA_486_CM 1 100. -1500. 1500. DISPLAY_IDENTIFIER NOX_NS_AD_DELTA_MMV[1] ECU_ADDRESS 0xd0003654 FORMAT "%5.0" /end MEASUREMENT
/begin MEASUREMENT nox_ns_ad_delta_mmv[1] "NOx sensor signal gradient moving mean value (bank selective)." SWORD _CNV_A_R_NOXD_LINEA_486_CM 1 100. -1500. 1500. DISPLAY_IDENTIFIER NOX_NS_AD_DELTA_MMV[2] ECU_ADDRESS 0xd0003656 FORMAT "%5.0" /end MEASUREMENT
/begin MEASUREMENT nox_ns_ad_delta[0] "NOx sensor signal gradient (bank selective)" SWORD _CNV_A_R_NOXD_LINEA_486_CM 1 100. -1500. 1500. DISPLAY_IDENTIFIER NOX_NS_AD_DELTA[1] ECU_ADDRESS 0xd0003650 FORMAT "%5.0" /end MEASUREMENT
/begin MEASUREMENT nox_ns_ad_delta[1] "NOx sensor signal gradient (bank selective)" SWORD _CNV_A_R_NOXD_LINEA_486_CM 1 100. -1500. 1500. DISPLAY_IDENTIFIER NOX_NS_AD_DELTA[2] ECU_ADDRESS 0xd0003652 FORMAT "%5.0" /end MEASUREMENT
/begin CHARACTERISTIC c_crlc_nox_ns_ad_delta "Correlation factor to calculate moving mean value of the NOx sensor signal gradient." VALUE 0xa0807a22 _REC_VAL_20_u2 0.9999847412109381 _CNV_A_R_LINEAR_____89_CM 0. 0.9999847412109381 DISPLAY_IDENTIFIER C_CRLC_NOX_NS_AD_DELTA FORMAT "%7.5" /end CHARACTERISTIC
/begin CHARACTERISTIC c_ctr_nt_agi_ad_cmpl_sum_ad_min "Minimum completed sulphur adaptations for set free of NOx signal offset adaptation." VALUE 0xa0807a26 _REC_VAL_20_u2 65535. _CNV_A_R_LINEAR_____0_CM 0. 65535. DISPLAY_IDENTIFIER C_CTR_NT_AGI_AD_CMPL_SUM_AD_MIN FORMAT "%5.0" /end CHARACTERISTIC
/begin CHARACTERISTIC c_nox_add_zero_max "Upper NOx signal offset adaptation value threshold to set the adaptation value to 0." VALUE 0xa0807a34 _REC_VAL_20_s2 1600. _CNV_A_R_NOXD_LINEA_486_CM -100. 1500. DISPLAY_IDENTIFIER C_NOX_ADD_ZERO_MAX FORMAT "%4.0" /end CHARACTERISTIC
/begin CHARACTERISTIC c_nox_add_zero_min "Lower NOx signal offset adaptation value threshold to set the adaptation value to 0." VALUE 0xa0807a36 _REC_VAL_20_s2 1600. _CNV_A_R_NOXD_LINEA_486_CM -100. 1500. DISPLAY_IDENTIFIER C_NOX_ADD_ZERO_MIN FORMAT "%4.0" /end CHARACTERISTIC
/begin CHARACTERISTIC c_nox_ad_add_max "Maximum limit of NOx signal offset adaptation value." VALUE 0xa0807a30 _REC_VAL_20_s2 1600. _CNV_A_R_NOXD_LINEA_486_CM -100. 1500. DISPLAY_IDENTIFIER C_NOX_AD_ADD_MAX FORMAT "%4.0" /end CHARACTERISTIC
/begin CHARACTERISTIC c_nox_ad_add_min "Minimum limit of NOx signal offset adaptation value." VALUE 0xa0807a32 _REC_VAL_20_s2 1600. _CNV_A_R_NOXD_LINEA_486_CM -100. 1500. DISPLAY_IDENTIFIER C_NOX_AD_ADD_MIN FORMAT "%4.0" /end CHARACTERISTIC
/begin CHARACTERISTIC c_nox_ns_ad_add[0] "Manual NOx signal offset." VALUE 0xa0807a3c _REC_VAL_20_s2 1600. _CNV_A_R_NOXD_LINEA_486_CM -100. 1500. DISPLAY_IDENTIFIER C_NOX_NS_AD_ADD[1] FORMAT "%4.0" /end CHARACTERISTIC
/begin CHARACTERISTIC c_nox_ns_ad_add[1] "Manual NOx signal offset." VALUE 0xa0807a3e _REC_VAL_20_s2 1600. _CNV_A_R_NOXD_LINEA_486_CM -100. 1500. DISPLAY_IDENTIFIER C_NOX_NS_AD_ADD[2] FORMAT "%4.0" /end CHARACTERISTIC
/begin CHARACTERISTIC c_nox_ns_ad_delta_mmv_max "Maximum allowed NOx sensor signal gradient." VALUE 0xa0807a40 _REC_VAL_20_s2 3000. _CNV_A_R_NOXD_LINEA_486_CM -1500. 1500. DISPLAY_IDENTIFIER C_NOX_NS_AD_DELTA_MMV_MAX FORMAT "%5.0" /end CHARACTERISTIC
/begin CHARACTERISTIC c_nox_ns_ad_delta_mmv_min "Minimum allowed NOx sensor signal gradient." VALUE 0xa0807a42 _REC_VAL_20_s2 3000. _CNV_A_R_NOXD_LINEA_486_CM -1500. 1500. DISPLAY_IDENTIFIER C_NOX_NS_AD_DELTA_MMV_MIN FORMAT "%5.0" /end CHARACTERISTIC
/begin CHARACTERISTIC c_nox_ns_ad_max_sens_vld "Maximum NOx sensor signal to enable gradient observation." VALUE 0xa0807a44 _REC_VAL_20_u2 1500. _CNV_A_R_NOXD_LINEA_486_CM 0. 1500. DISPLAY_IDENTIFIER C_NOX_NS_AD_MAX_SENS_VLD FORMAT "%4.0" /end CHARACTERISTIC
/begin CHARACTERISTIC c_nt_agi_sul_nox_ofs_ad_min "Minimum NOx catalyst aging factor due to sulphur for set free of NOx signal offset adaptation." VALUE 0xa0807a4c _REC_VAL_20_u2 0.9999847412109381 _CNV_A_R_LINEAR_____89_CM 0. 0.9999847412109381 DISPLAY_IDENTIFIER C_NT_AGI_SUL_NOX_OFS_AD_MIN FORMAT "%7.5" /end CHARACTERISTIC
/begin CHARACTERISTIC c_nt_sul_nox_ofs_ad_max "Maximum NOx catalyst sulphur load for set free of NOx signal offset adaptation." VALUE 0xa0807a50 _REC_VAL_20_u2 10485.6 _CNV_A_R_LINEAR_____244_CM 0. 10485.6 DISPLAY_IDENTIFIER C_NT_SUL_NOX_OFS_AD_MAX FORMAT "%7.1" /end CHARACTERISTIC
/begin CHARACTERISTIC c_t_nox_ns_ad_delta_min "Minimum time to set NOx Sensor signal to valid regarding NOx Signal gradient observation." VALUE 0xa0807a54 _REC_VAL_20_u1 25.5 _CNV_A_R_LINEAR_____4_CM 0. 25.5 DISPLAY_IDENTIFIER C_T_NOX_NS_AD_DELTA_MIN FORMAT "%4.1" /end CHARACTERISTIC
/begin CHARACTERISTIC c_t_nox_ns_ofs_puc "Minimum time NOx Signal is valid to enable NOx signal offset adaptation in PUC phase." VALUE 0xa0807a58 _REC_VAL_20_u2 655.35 _CNV_A_R_LINEAR_____3_CM 0. 655.35 DISPLAY_IDENTIFIER C_T_NOX_NS_OFS_PUC FORMAT "%6.2" /end CHARACTERISTIC
/begin CHARACTERISTIC c_t_nox_ns_ofs "Min. NOx signal time for enable of NOx signal offset adaptation." VALUE 0xa0807a56 _REC_VAL_20_u2 655.35 _CNV_A_R_LINEAR_____3_CM 0. 655.35 DISPLAY_IDENTIFIER C_T_NOX_NS_OFS FORMAT "%6.2" /end CHARACTERISTIC
/begin CHARACTERISTIC c_t_ns_vld "Minimum lean time to set NOx sensor signal to valid." VALUE 0xa0807a6a _REC_VAL_20_u2 1310.7 _CNV_A_R_LINEAR_____110_CM 0. 1310.7 DISPLAY_IDENTIFIER C_T_NS_VLD FORMAT "%7.2" /end CHARACTERISTIC
/begin CHARACTERISTIC c_t_ns_vld_puc "Minimum PUC time to set NOx sensor signal to valid." VALUE 0xa0807a6c _REC_VAL_20_u2 1310.7 _CNV_A_R_LINEAR_____110_CM 0. 1310.7 DISPLAY_IDENTIFIER C_T_NS_VLD_PUC FORMAT "%7.2" /end CHARACTERISTIC
/begin CHARACTERISTIC lc_nox_ns_ofs_vld_on "Valid NOx Sensor signal is necessary for this offset adaptation (on/off)." VALUE 0xa0807a76 _REC_VAL_20_u1 1. _CNV_A_R_LINEAR_____0_CM 0. 1. DISPLAY_IDENTIFIER LC_NOX_NS_OFS_VLD_ON FORMAT "%1.0" /end CHARACTERISTIC
/begin AXIS_PTS ldp_nox_ns_ofs_ad_min_ip_load "" 0xa0807a08 nox_ns_ofs_ad_min[0] _REC_AXS_20_u2 1600. _CNV_A_R_NOXD_LINEA_488_CM 4 -100. 1500. FORMAT "%4.0" /end AXIS_PTS
/begin CHARACTERISTIC lc_inh_ch_so2p_man "switch for manual inhibition of catalyst heating for desulfation" VALUE 0xa080c57d _REC_VAL_20_u1 1. _CNV_A_R_LINEAR_____0_CM 0. 1. DISPLAY_IDENTIFIER LC_INH_CH_SO2P_MAN FORMAT "%2.0" /end CHARACTERISTIC
/begin CHARACTERISTIC lc_inh_ch_so2p_off "switch for forcing the inhibition of desulfation catalyst heating to be deactivated" VALUE 0xa080c57e _REC_VAL_20_u1 1. _CNV_A_R_LINEAR_____0_CM 0. 1. DISPLAY_IDENTIFIER LC_INH_CH_SO2P_OFF FORMAT "%2.0" /end CHARACTERISTIC
/begin MEASUREMENT lv_inh_ch_so2p "flag inhibiting the catalyst heating for desulfation" UBYTE _CNV_S_2_RANGE__0___1_CM 1 100. 0. 1. DISPLAY_IDENTIFIER LV_INH_CH_SO2P ECU_ADDRESS 0xd0008958 BIT_MASK 0x1 /end MEASUREMENT
/begin MEASUREMENT lv_trig_afr_afl "Logical value for triggering a transition of rich to lean operation" UBYTE _CNV_S_2_RANGE__0___1_CM 1 100. 0. 1. DISPLAY_IDENTIFIER LV_TRIG_AFR_AFL ECU_ADDRESS 0xd000891c BIT_MASK 0x1 /end MEASUREMENT
/begin MEASUREMENT lv_rgn_nt_req "logical value for regeneration phase request" UBYTE _CNV_S_2_RANGE__0___1_CM 1 100. 0. 1. DISPLAY_IDENTIFIER LV_RGN_NT_REQ ECU_ADDRESS 0xd0008918 BIT_MASK 0x1 /end MEASUREMENT
/begin MEASUREMENT lv_nox_sens_rgn "regeneration request only due to NOx sensor (loading model blocked)" UBYTE _CNV_S_2_RANGE__0___1_CM 1 100. 0. 1. DISPLAY_IDENTIFIER LV_NOX_SENS_RGN ECU_ADDRESS 0xd000891b BIT_MASK 0x1 /end MEASUREMENT
/begin MEASUREMENT lv_nox_sens "logical value for the existence of a NOx sensor" UBYTE _CNV_S_2_RANGE__0___1_CM 1 100. 0. 1. DISPLAY_IDENTIFIER LV_NOX_SENS ECU_ADDRESS 0xd000891a BIT_MASK 0x1 /end MEASUREMENT
/begin MEASUREMENT lv_afl_not "logical value: lambda=1 or richer operation is requested or active" UBYTE _CNV_S_2_RANGE__0___1_CM 1 100. 0. 1. DISPLAY_IDENTIFIER LV_AFL_NOT ECU_ADDRESS 0xd000891d BIT_MASK 0x1 /end MEASUREMENT
/begin MEASUREMENT lv_rgn_stop_sens "flag indicating: Stop of Rgn by sensor enabled" UBYTE _CNV_S_2_RANGE__0___1_CM 1 100. 0. 1. DISPLAY_IDENTIFIER LV_RGN_STOP_SENS ECU_ADDRESS 0xd000891e BIT_MASK 0x1 /end MEASUREMENT
/begin MEASUREMENT lv_rgn_stop_tout "flag indicating: Stop of Rgn by time counter enabled" UBYTE _CNV_S_2_RANGE__0___1_CM 1 100. 0. 1. DISPLAY_IDENTIFIER LV_RGN_STOP_TOUT ECU_ADDRESS 0xd0008920 BIT_MASK 0x1 /end MEASUREMENT
/begin MEASUREMENT lv_rgn_stop_mdl "flag indicating: Stop of Rgn out of model enabled" UBYTE _CNV_S_2_RANGE__0___1_CM 1 100. 0. 1. DISPLAY_IDENTIFIER LV_RGN_STOP_MDL ECU_ADDRESS 0xd000891f BIT_MASK 0x1 /end MEASUREMENT
/begin MEASUREMENT lv_rgn_req_ntld "logical value for regeneration phase request because of the NOx trap loading degree" UBYTE _CNV_S_2_RANGE__0___1_CM 1 100. 0. 1. DISPLAY_IDENTIFIER LV_RGN_REQ_NTLD ECU_ADDRESS 0xd0008921 BIT_MASK 0x1 /end MEASUREMENT
/begin MEASUREMENT lv_rgn_req_nox_sens "regeneration request caused by the NOx sensor signal" UBYTE _CNV_S_2_RANGE__0___1_CM 1 100. 0. 1. DISPLAY_IDENTIFIER LV_RGN_REQ_NOX_SENS ECU_ADDRESS 0xd0008923 BIT_MASK 0x1 /end MEASUREMENT
/begin MEASUREMENT lv_rgn_req_ntld_afs "logical value for regeneration phase request before switching to stoichiometric operation or rich operation" UBYTE _CNV_S_2_RANGE__0___1_CM 1 100. 0. 1. DISPLAY_IDENTIFIER LV_RGN_REQ_NTLD_AFS ECU_ADDRESS 0xd0008922 BIT_MASK 0x1 /end MEASUREMENT
/begin MEASUREMENT lv_sens_afr_trim "downstream sensor sees rich exhaust gas (homogeneous detection threshold)" UBYTE _CNV_S_2_RANGE__0___1_CM 1 100. 0. 1. DISPLAY_IDENTIFIER LV_SENS_AFR_TRIM ECU_ADDRESS 0xd0008924 BIT_MASK 0x1 /end MEASUREMENT
/begin MEASUREMENT lv_nt_hom_ini "flag: NOx trap initialised due to sufficient hom. stoic. operation (accumulation effects eliminated)" UBYTE _CNV_S_2_RANGE__0___1_CM 1 100. 0. 1. DISPLAY_IDENTIFIER LV_NT_HOM_INI ECU_ADDRESS 0xd0008925 BIT_MASK 0x1 /end MEASUREMENT
/begin MEASUREMENT lv_t_afl_min "flag: minimum lean time for setting a request elapsed" UBYTE _CNV_S_2_RANGE__0___1_CM 1 100. 0. 1. DISPLAY_IDENTIFIER LV_T_AFL_MIN ECU_ADDRESS 0xd000892b BIT_MASK 0x1 /end MEASUREMENT
/begin MEASUREMENT lv_mdl_afr "model rich exhaust gas (stop of regeneration)" UBYTE _CNV_S_2_RANGE__0___1_CM 1 100. 0. 1. DISPLAY_IDENTIFIER LV_MDL_AFR ECU_ADDRESS 0xd0008926 BIT_MASK 0x1 /end MEASUREMENT
/begin MEASUREMENT lv_tout_afr "rich exhaust gas after time out (stop of regeneration)" UBYTE _CNV_S_2_RANGE__0___1_CM 1 100. 0. 1. DISPLAY_IDENTIFIER LV_TOUT_AFR ECU_ADDRESS 0xd0008927 BIT_MASK 0x1 /end MEASUREMENT
/begin MEASUREMENT nox_conc_raw "NOx concentration engine out" UWORD _CNV_A_R_NOXD_LINEA_486_CM 1 100. 0. 65535. DISPLAY_IDENTIFIER NOX_CONC_RAW ECU_ADDRESS 0xd000a4e2 FORMAT "%5.0" /end MEASUREMENT
/begin MEASUREMENT nox_conc_red "corrected NOx concentration in catalyst (incl. SSR)" UWORD _CNV_A_R_NOXD_LINEA_486_CM 1 100. 0. 65535. DISPLAY_IDENTIFIER NOX_CONC_RED ECU_ADDRESS 0xd000a4e6 FORMAT "%5.0" /end MEASUREMENT
/begin MEASUREMENT nox_conc "NOx concentration engine out (after raw emission adaptation correction)" UWORD _CNV_A_R_NOXD_LINEA_486_CM 1 100. 0. 65535. DISPLAY_IDENTIFIER NOX_CONC ECU_ADDRESS 0xd000a4e4 FORMAT "%5.0" /end MEASUREMENT
/begin MEASUREMENT nox_conc_red_mmv_rgn_st "filtered corrected NOx concentration in catalyst (incl. SSR) at Rgn start" UWORD _CNV_A_R_NOXD_LINEA_486_CM 1 100. 0. 65535. DISPLAY_IDENTIFIER NOX_CONC_RED_MMV_RGN_ST ECU_ADDRESS 0xd000a4ea FORMAT "%5.0" /end MEASUREMENT
/begin MEASUREMENT nox_conc_red_mmv "filtered corrected NOx concentration in catalyst (incl. SSR)" UWORD _CNV_A_R_NOXD_LINEA_486_CM 1 100. 0. 65535. DISPLAY_IDENTIFIER NOX_CONC_RED_MMV ECU_ADDRESS 0xd000a4e8 FORMAT "%5.0" /end MEASUREMENT
/begin MEASUREMENT nox_sens_max "NOx sensor signal threshold for requesting a regeneration" UWORD _CNV_A_R_NOXD_LINEA_486_CM 1 100. 0. 1500. DISPLAY_IDENTIFIER NOX_SENS_MAX ECU_ADDRESS 0xd000a512 FORMAT "%4.0" /end MEASUREMENT
/begin MEASUREMENT nox_conc_mmv "filtered NOx concentration engine out concentration" UWORD _CNV_A_R_NOXD_LINEA_486_CM 1 100. 0. 65535. DISPLAY_IDENTIFIER NOX_CONC_MMV ECU_ADDRESS 0xd0001534 FORMAT "%5.0" /end MEASUREMENT
/begin MEASUREMENT nox_conc_out_mdl "corrected NOx concentration after catalyst" UWORD _CNV_A_R_NOXD_LINEA_486_CM 1 100. 0. 65535. DISPLAY_IDENTIFIER NOX_CONC_OUT_MDL ECU_ADDRESS 0xd000a510 FORMAT "%5.0" /end MEASUREMENT
/begin MEASUREMENT nox_conc_out_mdl_mmv "filtered corrected NOx concentration after catalyst" UWORD _CNV_A_R_NOXD_LINEA_486_CM 1 100. 0. 65535. DISPLAY_IDENTIFIER NOX_CONC_OUT_MDL_MMV ECU_ADDRESS 0xd0001542 FORMAT "%5.0" /end MEASUREMENT
/begin MEASUREMENT nox_cor "raw engine out NOx emission" UWORD _CNV_A_R_LINEAR_____489_CM 1 100. 0. 1023.984375 DISPLAY_IDENTIFIER NOX_COR ECU_ADDRESS 0xd0001536 FORMAT "%7.2" /end MEASUREMENT
/begin MEASUREMENT nox_cor_red "corrected engine out NOx emission (incl. SSR)" UWORD _CNV_A_R_LINEAR_____489_CM 1 100. 0. 1023.984375 DISPLAY_IDENTIFIER NOX_COR_RED ECU_ADDRESS 0xd000a4ec FORMAT "%7.2" /end MEASUREMENT
/begin MEASUREMENT nox_flow "NOx emission flow which is stored in the catalyst" UWORD _CNV_A_R_LINEAR_____489_CM 1 100. 0. 1023.984375 DISPLAY_IDENTIFIER NOX_FLOW ECU_ADDRESS 0xd0001538 FORMAT "%7.2" /end MEASUREMENT
/begin MEASUREMENT nox_out_mdl "modelled downstream NOx emission" UWORD _CNV_A_R_LINEAR_____489_CM 1 100. 0. 1023.984375 DISPLAY_IDENTIFIER NOX_OUT_MDL ECU_ADDRESS 0xd000a4ee FORMAT "%7.2" /end MEASUREMENT
/begin MEASUREMENT nox_out_mdl_int "integral of modelled downstream NOx emission for one lean / rich cycle" UWORD _CNV_A_R_LINEAR_____244_CM 1 100. 0. 10485.6 DISPLAY_IDENTIFIER NOX_OUT_MDL_INT ECU_ADDRESS 0xd000a4f0 FORMAT "%7.1" /end MEASUREMENT
/begin MEASUREMENT nox_out_int_tmp_2 "temporary internal NOx out integral value for NOx sensor regeneration request calculation" UWORD _CNV_A_R_LINEAR_____244_CM 1 100. 0. 10485.6 DISPLAY_IDENTIFIER NOX_OUT_INT_TMP_2 ECU_ADDRESS 0xd0001572 FORMAT "%7.1" /end MEASUREMENT
/begin MEASUREMENT nt_eff "NOx trap efficiency" UWORD _CNV_A_R_LINEAR_____259_CM 1 100. 0. 1. DISPLAY_IDENTIFIER NT_EFF ECU_ADDRESS 0xd000a4f2 FORMAT "%7.5" /end MEASUREMENT
/begin MEASUREMENT nt_eff_cor "NOx trap efficiency correction factor" UBYTE _CNV_A_R_LINEAR_____243_CM 1 100. 0. 3.984375 DISPLAY_IDENTIFIER NT_EFF_COR ECU_ADDRESS 0xd0001594 FORMAT "%4.2" /end MEASUREMENT
/begin MEASUREMENT nt_eff_cor_rgn_st "NOx trap efficiency correction factor at regeneration start" UBYTE _CNV_A_R_LINEAR_____243_CM 1 100. 0. 3.984375 DISPLAY_IDENTIFIER NT_EFF_COR_RGN_ST ECU_ADDRESS 0xd0008915 FORMAT "%4.2" /end MEASUREMENT
/begin MEASUREMENT ntl "NOx trap absolute loading" UWORD _CNV_A_R_LINEAR_____244_CM 1 100. 0. 10485.6 DISPLAY_IDENTIFIER NTL ECU_ADDRESS 0xd000a4f6 FORMAT "%7.1" /end MEASUREMENT
/begin MEASUREMENT ntl_rgn_st_nox "NOx trap absolute loading (only NOx) when regeneration starts" UWORD _CNV_A_R_LINEAR_____244_CM 1 100. 0. 10485.6 DISPLAY_IDENTIFIER NTL_RGN_ST_NOX ECU_ADDRESS 0xd000a4fa FORMAT "%7.1" /end MEASUREMENT
/begin MEASUREMENT ntl_rgn_st "NOx trap absolute loading (O2+NOx) when regeneration starts" UWORD _CNV_A_R_LINEAR_____244_CM 1 100. 0. 10485.6 DISPLAY_IDENTIFIER NTL_RGN_ST ECU_ADDRESS 0xd000a4f8 FORMAT "%7.1" /end MEASUREMENT
/begin MEASUREMENT o2l "O2 absolut loading of the NOx trap" UWORD _CNV_A_R_LINEAR_____244_CM 1 100. 0. 10485.6 DISPLAY_IDENTIFIER O2L ECU_ADDRESS 0xd000a502 FORMAT "%7.1" /end MEASUREMENT
/begin MEASUREMENT nt_o2_stc "NOx trap oxygen storage capacity" UWORD _CNV_A_R_LINEAR_____244_CM 1 100. 0. 10485.6 DISPLAY_IDENTIFIER NT_O2_STC ECU_ADDRESS 0xd000a4fe FORMAT "%7.1" /end MEASUREMENT
/begin MEASUREMENT nt_o2_stc_bas "NOx trap base oxygen storage capacity" UWORD _CNV_A_R_LINEAR_____244_CM 1 100. 0. 10485.6 DISPLAY_IDENTIFIER NT_O2_STC_BAS ECU_ADDRESS 0xd000a500 FORMAT "%7.1" /end MEASUREMENT
/begin MEASUREMENT o2_flow "corrected engine out O2 flow" UWORD _CNV_A_R_LINEAR_____490_CM 1 100. 0. 16383.75 DISPLAY_IDENTIFIER O2_FLOW ECU_ADDRESS 0xd000153e FORMAT "%7.1" /end MEASUREMENT
/begin MEASUREMENT fac_rgn_dec_shar "share factor for the reducing agent for the decrementation of NTL and O2L" UBYTE _CNV_A_R_LINEAR_____103_CM 1 100. 0. 1. DISPLAY_IDENTIFIER FAC_RGN_DEC_SHAR ECU_ADDRESS 0xd0001595 FORMAT "%5.3" /end MEASUREMENT
/begin MEASUREMENT ntld "NOx trap loading degree" UWORD _CNV_A_R_LINEAR_____89_CM 1 100. 0. 0.9999847412109381 DISPLAY_IDENTIFIER NTLD ECU_ADDRESS 0xd000a504 FORMAT "%7.5" /end MEASUREMENT
/begin MEASUREMENT ntld_mdl "NOx trap loading degree out of model" UWORD _CNV_A_R_LINEAR_____89_CM 1 100. 0. 0.9999847412109381 DISPLAY_IDENTIFIER NTLD_MDL ECU_ADDRESS 0xd000a516 FORMAT "%7.5" /end MEASUREMENT
/begin MEASUREMENT ntld_rgn_st "NOx trap loading degree at start of regeneration" UWORD _CNV_A_R_LINEAR_____89_CM 1 100. 0. 0.9999847412109381 DISPLAY_IDENTIFIER NTLD_RGN_ST ECU_ADDRESS 0xd000a506 FORMAT "%7.5" /end MEASUREMENT
/begin MEASUREMENT ntld_max "loading degree threshold for starting a regeneration" UWORD _CNV_A_R_LINEAR_____89_CM 1 100. 0. 0.9999847412109381 DISPLAY_IDENTIFIER NTLD_MAX ECU_ADDRESS 0xd000a508 FORMAT "%7.5" /end MEASUREMENT
/begin MEASUREMENT t_afl "elapsed time since lean phase was started" UWORD _CNV_A_R_LINEAR_____110_CM 1 100. 0. 1310.7 DISPLAY_IDENTIFIER T_AFL ECU_ADDRESS 0xd000a50a FORMAT "%7.2" /end MEASUREMENT
/begin MEASUREMENT t_afl_puc "elapsed time since last PUC phase" UWORD _CNV_A_R_LINEAR_____110_CM 1 100. 0. 1310.7 DISPLAY_IDENTIFIER T_AFL_PUC ECU_ADDRESS 0xd000a50c FORMAT "%7.2" /end MEASUREMENT
/begin MEASUREMENT t_nt_hom_delta "decrement for T_NT_HOM counter" SBYTE _CNV_A_R_LINEAR_____3_CM 1 100. -1.28 1.27 DISPLAY_IDENTIFIER T_NT_HOM_DELTA ECU_ADDRESS 0xd000159a FORMAT "%5.2" /end MEASUREMENT
/begin MEASUREMENT sum_ntl_cyc "amount of regeneration cycles carried out" UWORD _CNV_A_R_LINEAR_____0_CM 1 100. 0. 65535. DISPLAY_IDENTIFIER SUM_NTL_CYC ECU_ADDRESS 0xd000a4e0 FORMAT "%5.0" /end MEASUREMENT
/begin MEASUREMENT flow_nt_mmv "filtered exhaust gas flow through NOx trap" UWORD _CNV_A_R_LINEAR_____215_CM 1 100. 0. 2047.96875 DISPLAY_IDENTIFIER FLOW_NT_MMV ECU_ADDRESS 0xd000a50e FORMAT "%7.2" /end MEASUREMENT
/begin MEASUREMENT nt_agi_av "actual aging factor (ratio of actual storage capacity vs. base storage capacity)" UBYTE _CNV_A_R_LINEAR_____28_CM 1 100. 0. 0.99609375 DISPLAY_IDENTIFIER NT_AGI_AV ECU_ADDRESS 0xd0008916 FORMAT "%5.3" /end MEASUREMENT
/begin MEASUREMENT nox_cor_red_mmv "moving mean value of corrected engine out NOx emission (incl. SSR)" UWORD _CNV_A_R_LINEAR_____489_CM 1 100. 0. 1023.984375 DISPLAY_IDENTIFIER NOX_COR_RED_MMV ECU_ADDRESS 0xd000a514 FORMAT "%7.2" /end MEASUREMENT
/begin CHARACTERISTIC c_lamb_o2_stc "lambda threshold for O2 storage in lean operation" VALUE 0xa080bde0 _REC_VAL_20_u2 31.9990234375 _CNV_A_R_LINEAR_____129_CM 0. 31.9990234375 DISPLAY_IDENTIFIER C_LAMB_O2_STC FORMAT "%7.4" /end CHARACTERISTIC
/begin CHARACTERISTIC c_o2_flow_cor_fac "correction factor for the O2 engine out flow" VALUE 0xa080c05e _REC_VAL_20_u2 128. _CNV_A_R_LINEAR_____491_CM 0. 128. DISPLAY_IDENTIFIER C_O2_FLOW_COR_FAC FORMAT "%7.3" /end CHARACTERISTIC
/begin CHARACTERISTIC c_fac_o2_equ "factor for the balance of stored NO O2" VALUE 0xa080bce9 _REC_VAL_20_u1 1.9921875 _CNV_A_R_LINEAR_____103_CM 0. 1.9921875 DISPLAY_IDENTIFIER C_FAC_O2_EQU FORMAT "%5.3" /end CHARACTERISTIC
/begin CHARACTERISTIC c_fac_cor_o2l "correction factor for the O2L decrementation" VALUE 0xa080bcb6 _REC_VAL_20_u1 1.9921875 _CNV_A_R_LINEAR_____103_CM 0. 1.9921875 DISPLAY_IDENTIFIER C_FAC_COR_O2L FORMAT "%5.3" /end CHARACTERISTIC
/begin CHARACTERISTIC c_lamb_stc "lambda threshold for lean operation" VALUE 0xa080bdfa _REC_VAL_20_u2 31.9990234375 _CNV_A_R_LINEAR_____129_CM 0. 31.9990234375 DISPLAY_IDENTIFIER C_LAMB_STC FORMAT "%7.4" /end CHARACTERISTIC
/begin CHARACTERISTIC c_lamb_rgn "lambda threshold for rich operation" VALUE 0xa080bdea _REC_VAL_20_u2 31.9990234375 _CNV_A_R_LINEAR_____129_CM 0. 31.9990234375 DISPLAY_IDENTIFIER C_LAMB_RGN FORMAT "%7.4" /end CHARACTERISTIC
/begin CHARACTERISTIC c_ntl_ini_st "initialisation value of the NOx trap absolute loading after engine start" VALUE 0xa080c042 _REC_VAL_20_u2 10485.6 _CNV_A_R_LINEAR_____244_CM 0. 10485.6 DISPLAY_IDENTIFIER C_NTL_INI_ST FORMAT "%7.1" /end CHARACTERISTIC
/begin CHARACTERISTIC c_ntld_rgn_st_ini "initialisation value for NOx trap loading degree at start of regeneration" VALUE 0xa080c05a _REC_VAL_20_u2 0.9999847412109381 _CNV_A_R_LINEAR_____89_CM 0. 0.9999847412109381 DISPLAY_IDENTIFIER C_NTLD_RGN_ST_INI FORMAT "%7.5" /end CHARACTERISTIC
/begin CHARACTERISTIC c_ntld_lgrd "limitating gradient of loading degree" VALUE 0xa080c04e _REC_VAL_20_u2 0.9999847412109381 _CNV_A_R_LINEAR_____89_CM 0. 0.9999847412109381 DISPLAY_IDENTIFIER C_NTLD_LGRD FORMAT "%7.5" /end CHARACTERISTIC
/begin CHARACTERISTIC c_nox_conc_cor "correction factor of the NOx concentration regarding the mol mass" VALUE 0xa080bfee _REC_VAL_20_u2 8192. _CNV_A_R_LINEAR_____492_CM 0. 8192. DISPLAY_IDENTIFIER C_NOX_CONC_COR FORMAT "%6.1" /end CHARACTERISTIC
/begin CHARACTERISTIC c_crlc_nox_conc_red "correction factor for filtering of NOX_CONC_RED" VALUE 0xa080bb08 _REC_VAL_20_u2 0.9999847412109381 _CNV_A_R_LINEAR_____89_CM 0. 0.9999847412109381 DISPLAY_IDENTIFIER C_CRLC_NOX_CONC_RED FORMAT "%7.5" /end CHARACTERISTIC
/begin CHARACTERISTIC c_crlc_nox_cor_red "correction factor for filtering of NOX_COR_RED" VALUE 0xa080bb0a _REC_VAL_20_u2 0.9999847412109381 _CNV_A_R_LINEAR_____89_CM 0. 0.9999847412109381 DISPLAY_IDENTIFIER C_CRLC_NOX_COR_RED FORMAT "%7.5" /end CHARACTERISTIC
/begin CHARACTERISTIC c_crlc_nox_conc_out_mdl "correction factor for filtering of NOX_CONC_OUT_MDL" VALUE 0xa080bb06 _REC_VAL_20_u2 0.9999847412109381 _CNV_A_R_LINEAR_____89_CM 0. 0.9999847412109381 DISPLAY_IDENTIFIER C_CRLC_NOX_CONC_OUT_MDL FORMAT "%7.5" /end CHARACTERISTIC
/begin CHARACTERISTIC c_ntld_nt_hom_rst "loading degree threshold for resetting the homogeneous time counter T_NT_HOM" VALUE 0xa080c058 _REC_VAL_20_u2 0.9999847412109381 _CNV_A_R_LINEAR_____89_CM 0. 0.9999847412109381 DISPLAY_IDENTIFIER C_NTLD_NT_HOM_RST FORMAT "%7.5" /end CHARACTERISTIC
/begin CHARACTERISTIC c_t_afl_nt_hom_rst "lean time after which the homogeneous time counter is reinitialised" VALUE 0xa080c116 _REC_VAL_20_u2 1310.7 _CNV_A_R_LINEAR_____110_CM 0. 1310.7 DISPLAY_IDENTIFIER C_T_AFL_NT_HOM_RST FORMAT "%7.2" /end CHARACTERISTIC
/begin CHARACTERISTIC lc_nt_afs_req "switch to force hom. mode in passive or enable lean operation" VALUE 0xa080c5c9 _REC_VAL_20_u1 1. _CNV_A_R_LINEAR_____0_CM 0. 1. DISPLAY_IDENTIFIER LC_NT_AFS_REQ FORMAT "%1.0" /end CHARACTERISTIC
/begin CHARACTERISTIC c_state_rgn_ctl "regeneration stop mode" VALUE 0xa080c0ec _REC_VAL_20_u1 3. _CNV_S_4_STATE_RGN__493_CM 0. 3. DISPLAY_IDENTIFIER C_STATE_RGN_CTL /end CHARACTERISTIC
/begin CHARACTERISTIC c_t_afl_rgn_req_ntld "minimum duration of lean operation before permitting a regeneration request from the model" VALUE 0xa080c118 _REC_VAL_20_u2 1310.7 _CNV_A_R_LINEAR_____110_CM 0. 1310.7 DISPLAY_IDENTIFIER C_T_AFL_RGN_REQ_NTLD FORMAT "%7.2" /end CHARACTERISTIC
/begin CHARACTERISTIC c_t_afl_min "minimum duration of lean operation before permitting a regeneration" VALUE 0xa080c114 _REC_VAL_20_u2 1310.7 _CNV_A_R_LINEAR_____110_CM 0. 1310.7 DISPLAY_IDENTIFIER C_T_AFL_MIN FORMAT "%7.2" /end CHARACTERISTIC
/begin CHARACTERISTIC c_vls_nox_sens_rgn_stop "binary NOx sensor signal threshold for determining rich exhaust gas" VALUE 0xa080c470 _REC_VAL_20_u2 1400. _CNV_A_R_LINEAR_____219_CM -200. 1200. DISPLAY_IDENTIFIER C_VLS_NOX_SENS_RGN_STOP FORMAT "%4.0" /end CHARACTERISTIC
/begin CHARACTERISTIC c_lamb_nox_sens_rgn_stop "linear NOx sensor signal threshold for determining rich exhaust gas" VALUE 0xa080bdde _REC_VAL_20_u2 31.9990234375 _CNV_A_R_LINEAR_____129_CM 0. 31.9990234375 DISPLAY_IDENTIFIER C_LAMB_NOX_SENS_RGN_STOP FORMAT "%7.4" /end CHARACTERISTIC
/begin CHARACTERISTIC c_lamb_nox_sens_afr_trim "linear NOx sensor signal threshold for determining rich trim conditions" VALUE 0xa080bddc _REC_VAL_20_u2 31.9990234375 _CNV_A_R_LINEAR_____129_CM 0. 31.9990234375 DISPLAY_IDENTIFIER C_LAMB_NOX_SENS_AFR_TRIM FORMAT "%7.4" /end CHARACTERISTIC
/begin CHARACTERISTIC c_o2l_min "minimum NOx trap oxygen loading for stopping a regeneration" VALUE 0xa080c060 _REC_VAL_20_u2 10485.6 _CNV_A_R_LINEAR_____244_CM 0. 10485.6 DISPLAY_IDENTIFIER C_O2L_MIN FORMAT "%7.1" /end CHARACTERISTIC
/begin CHARACTERISTIC c_sum_o2l_ntl_max "threshold of oxygen and NOx loading for requesting a NOx catalyst purge" VALUE 0xa080c108 _REC_VAL_20_u2 10485.6 _CNV_A_R_LINEAR_____244_CM 0. 10485.6 DISPLAY_IDENTIFIER C_SUM_O2L_NTL_MAX FORMAT "%7.1" /end CHARACTERISTIC
/begin CHARACTERISTIC c_ntl_trig_afr_afl "minimum NOx trap NOx loading for triggering the transition from rich to lean operation" VALUE 0xa080c046 _REC_VAL_20_u2 10485.6 _CNV_A_R_LINEAR_____244_CM 0. 10485.6 DISPLAY_IDENTIFIER C_NTL_TRIG_AFR_AFL FORMAT "%7.1" /end CHARACTERISTIC
/begin CHARACTERISTIC c_tnt_mdl_inh_purge "NOx trap temperature threshold for inhibiting a catalyst purge" VALUE 0xa080c33a _REC_VAL_20_u1 1020. _CNV_A_R_LINEAR_____481_CM 0. 1020. DISPLAY_IDENTIFIER C_TNT_MDL_INH_PURGE FORMAT "%4.0" /end CHARACTERISTIC
/begin CHARACTERISTIC lc_nox_sens "logical constant for the existence of a NOx sensor" VALUE 0xa080c5c5 _REC_VAL_20_u1 1. _CNV_A_R_LINEAR_____0_CM 0. 1. DISPLAY_IDENTIFIER LC_NOX_SENS FORMAT "%1.0" /end CHARACTERISTIC
/begin CHARACTERISTIC lc_nox_sens_rgn "switch to exclusivly use the NOx sensor for requesting a regeneration" VALUE 0xa080c5c7 _REC_VAL_20_u1 1. _CNV_A_R_LINEAR_____0_CM 0. 1. DISPLAY_IDENTIFIER LC_NOX_SENS_RGN FORMAT "%1.0" /end CHARACTERISTIC
/begin CHARACTERISTIC lc_sum_ntl_cyc_new "initialisation of regeneration cycle counter" VALUE 0xa080c5f7 _REC_VAL_20_u1 1. _CNV_A_R_LINEAR_____0_CM 0. 1. DISPLAY_IDENTIFIER LC_SUM_NTL_CYC_NEW FORMAT "%1.0" /end CHARACTERISTIC
/begin CHARACTERISTIC lc_ntld_max_afs "switch between NTLD and NTLD_MDL for LV_RGN_REQ_NTLD_AFS" VALUE 0xa080c5cf _REC_VAL_20_u1 1. _CNV_A_R_LINEAR_____0_CM 0. 1. DISPLAY_IDENTIFIER LC_NTLD_MAX_AFS FORMAT "%1.0" /end CHARACTERISTIC
/begin CHARACTERISTIC lc_inh_rgn_pu "switch to forbid regeneration during PU" VALUE 0xa080c599 _REC_VAL_20_u1 1. _CNV_A_R_LINEAR_____0_CM 0. 1. DISPLAY_IDENTIFIER LC_INH_RGN_PU FORMAT "%1.0" /end CHARACTERISTIC
/begin CHARACTERISTIC c_tnt_mdl_min_hys "temperature hysteresis for lambda=1 mode deactivation due to low temperature" VALUE 0xa080c33d _REC_VAL_20_u1 1020. _CNV_A_R_LINEAR_____481_CM 0. 1020. DISPLAY_IDENTIFIER C_TNT_MDL_MIN_HYS FORMAT "%4.0" /end CHARACTERISTIC
/begin CHARACTERISTIC c_tnt_mdl_max_hys "temperature hysteresis for lambda=1 mode deactivation due to high temperature" VALUE 0xa080c33b _REC_VAL_20_u1 1020. _CNV_A_R_LINEAR_____481_CM 0. 1020. DISPLAY_IDENTIFIER C_TNT_MDL_MAX_HYS FORMAT "%4.0" /end CHARACTERISTIC
/begin AXIS_PTS ldp_nox_conc_mmv_ip_nt_stc_bas "" 0xa0808bd4 nox_conc_mmv _REC_AXS_20_u2 65535. _CNV_A_R_NOXD_LINEA_486_CM 8 0. 65535. FORMAT "%5.0" /end AXIS_PTS
/begin AXIS_PTS ldpm_tnt_mdl_nox "" 0xa0809868 tnt_mdl_mv _REC_AXS_20_u1 1020. _CNV_A_R_LINEAR_____481_CM 8 0. 1020. FORMAT "%4.0" /end AXIS_PTS
/begin AXIS_PTS ldp_nt_agi_ntld_ip_nt_agi_rgn "" 0xa0808c28 nt_agi_ntld _REC_AXS_20_u1 0.99609375 _CNV_A_R_LINEAR_____28_CM 8 0. 0.99609375 FORMAT "%5.3" /end AXIS_PTS
/begin AXIS_PTS ldp_tnt_mdl_mv_ip_nt_agi_rgn "" 0xa0808ee4 tnt_mdl_mv _REC_AXS_20_u1 1020. _CNV_A_R_LINEAR_____481_CM 8 0. 1020. FORMAT "%4.0" /end AXIS_PTS
/begin AXIS_PTS ldpm_n_32_1 "" 0xa08095ce n_32 _REC_AXS_20_u1 8160. _CNV_A_R_LINEAR_____10_CM 4 0. 8160. FORMAT "%4.0" /end AXIS_PTS
/begin AXIS_PTS ldp_flow_nt_mmv_ip_t_rgn_max "" 0xa080867c flow_nt_mmv _REC_AXS_20_u2 2047.96875 _CNV_A_R_LINEAR_____215_CM 4 0. 2047.96875 FORMAT "%7.2" /end AXIS_PTS
/begin AXIS_PTS ldpm_maf_kgh_ip_t_nt_hom "" 0xa0809512 maf_kgh _REC_AXS_20_u1 2040. _CNV_A_R_LINEAR_____494_CM 4 0. 2040. FORMAT "%4.0" /end AXIS_PTS
/begin AXIS_PTS ldpm_lamb_av_cor_ip_t_nt_hom "" 0xa0809468 online_dummy _REC_AXS_20_u2 31.9990234375 _CNV_A_R_LINEAR_____129_CM 4 0. 31.9990234375 FORMAT "%7.4" /end AXIS_PTS
/begin AXIS_PTS ldp_tqi_req_fast_ip_ntld_max "" 0xa080905c tqi_req_fast _REC_AXS_20_u2 2047.96875 _CNV_A_R_LINEAR_____87_CM 12 -1024. 1023.96875 FORMAT "%8.2" /end AXIS_PTS
/begin CHARACTERISTIC ip_nox_red_fac "reduction factor taking into account the chemical  NOx conversion" CURVE 0xa080b1e4 _REC_CUR_20_u1_u1 0.99609375 _CNV_A_R_LINEAR_____28_CM 0. 0.99609375 DISPLAY_IDENTIFIER IP_NOX_RED_FAC FORMAT "%5.3"
 /begin AXIS_DESCR COM_AXIS tnt_mdl_mv _CNV_A_R_LINEAR_____481_CM 4 0. 1020. FORMAT "%4.0" AXIS_PTS_REF ldp_tnt_mdl_mv_ip_nox_red_fac /end AXIS_DESCR
/end CHARACTERISTIC
/begin CHARACTERISTIC ip_nt_eff_bas "basic NOx trap efficiency" MAP 0xa08159cc _REC_MAP_20_u2_u2_u1 0.9999847412109381 _CNV_A_R_LINEAR_____89_CM 0. 0.9999847412109381 DISPLAY_IDENTIFIER IP_NT_EFF_BAS FORMAT "%7.5"
 /begin AXIS_DESCR COM_AXIS ntld _CNV_A_R_LINEAR_____89_CM 8 0. 0.9999847412109381 FORMAT "%7.5" AXIS_PTS_REF ldpm_ntld /end AXIS_DESCR
 /begin AXIS_DESCR COM_AXIS tnt_mdl_mv _CNV_A_R_LINEAR_____481_CM 8 0. 1020. FORMAT "%4.0" AXIS_PTS_REF ldpm_tnt_mdl_nox /end AXIS_DESCR
/end CHARACTERISTIC
/begin CHARACTERISTIC ip_nt_eff_cor "NOx trap efficiency correction" MAP 0xa080b228 _REC_MAP_20_u1_u2_u1 3.984375 _CNV_A_R_LINEAR_____243_CM 0. 3.984375 DISPLAY_IDENTIFIER IP_NT_EFF_COR FORMAT "%4.2"
 /begin AXIS_DESCR COM_AXIS nox_cor _CNV_A_R_LINEAR_____489_CM 8 0. 1023.984375 FORMAT "%7.2" AXIS_PTS_REF ldp_nox_cor_ip_nt_eff_cor /end AXIS_DESCR
 /begin AXIS_DESCR COM_AXIS tnt_mdl_mv _CNV_A_R_LINEAR_____481_CM 8 0. 1020. FORMAT "%4.0" AXIS_PTS_REF ldpm_tnt_mdl_nox /end AXIS_DESCR
/end CHARACTERISTIC
/begin CHARACTERISTIC ip_o2_stc_max "max. storage capacity of O2 in the NOx trap" MAP 0xa0815c3c _REC_MAP_20_u2_u2_u1 10485.6 _CNV_A_R_LINEAR_____244_CM 0. 10485.6 DISPLAY_IDENTIFIER IP_O2_STC_MAX FORMAT "%7.1"
 /begin AXIS_DESCR COM_AXIS lamb_mv _CNV_A_R_LINEAR_____129_CM 8 0. 31.9990234375 FORMAT "%7.4" AXIS_PTS_REF ldp_lamb_ls_up_mv_ip_o2_stc_max /end AXIS_DESCR
 /begin AXIS_DESCR COM_AXIS tnt_mdl_mv _CNV_A_R_LINEAR_____481_CM 8 0. 1020. FORMAT "%4.0" AXIS_PTS_REF ldpm_tnt_mdl_nox /end AXIS_DESCR
/end CHARACTERISTIC
/begin CHARACTERISTIC ip_nt_agi_rgn_frq "modification of the actual storage capacity due to aging factor NT_AGI_NTLD" MAP 0xa080b1e8 _REC_MAP_20_u1_u1_u1 0.99609375 _CNV_A_R_LINEAR_____28_CM 0. 0.99609375 DISPLAY_IDENTIFIER IP_NT_AGI_RGN_FRQ FORMAT "%5.3"
 /begin AXIS_DESCR COM_AXIS nt_agi_ntld _CNV_A_R_LINEAR_____28_CM 8 0. 0.99609375 FORMAT "%5.3" AXIS_PTS_REF ldp_nt_agi_ntld_ip_nt_agi_rgn /end AXIS_DESCR
 /begin AXIS_DESCR COM_AXIS tnt_mdl_mv _CNV_A_R_LINEAR_____481_CM 8 0. 1020. FORMAT "%4.0" AXIS_PTS_REF ldp_tnt_mdl_mv_ip_nt_agi_rgn /end AXIS_DESCR
/end CHARACTERISTIC
/begin CHARACTERISTIC ip_ntl_min "minimum NOx trap NOx loading for stopping a regeneration" CURVE 0xa080b284 _REC_CUR_20_u2_u1 10485.6 _CNV_A_R_LINEAR_____244_CM 0. 10485.6 DISPLAY_IDENTIFIER IP_NTL_MIN FORMAT "%7.1"
 /begin AXIS_DESCR COM_AXIS tnt_mdl_mv _CNV_A_R_LINEAR_____481_CM 8 0. 1020. FORMAT "%4.0" AXIS_PTS_REF ldpm_tnt_mdl_nox /end AXIS_DESCR
/end CHARACTERISTIC
/begin CHARACTERISTIC ip_ntld_max "maximum NOx trap loading degree for requesting a regeneration" MAP 0xa0815b4c _REC_MAP_20_u2_u2_u1 0.9999847412109381 _CNV_A_R_LINEAR_____89_CM 0. 0.9999847412109381 DISPLAY_IDENTIFIER IP_NTLD_MAX FORMAT "%7.5"
 /begin AXIS_DESCR COM_AXIS tqi_req_fast _CNV_A_R_LINEAR_____87_CM 12 -1024. 1023.96875 FORMAT "%8.2" AXIS_PTS_REF ldp_tqi_req_fast_ip_ntld_max /end AXIS_DESCR
 /begin AXIS_DESCR COM_AXIS n_32 _CNV_A_R_LINEAR_____10_CM 4 0. 8160. FORMAT "%4.0" AXIS_PTS_REF ldpm_n_32_1 /end AXIS_DESCR
/end CHARACTERISTIC
/begin CHARACTERISTIC ip_ntld_max_adj "maximum NOx trap loading degree for requesting a regeneration (adjusted for special purposes)" MAP 0xa080b294 _REC_MAP_20_u2_u2_u1 0.9999847412109381 _CNV_A_R_LINEAR_____89_CM 0. 0.9999847412109381 DISPLAY_IDENTIFIER IP_NTLD_MAX_ADJ FORMAT "%7.5"
 /begin AXIS_DESCR COM_AXIS tqi_req_fast _CNV_A_R_LINEAR_____87_CM 8 -1024. 1023.96875 FORMAT "%8.2" AXIS_PTS_REF ldpm_tqi_req_fast_1_egtr /end AXIS_DESCR
 /begin AXIS_DESCR COM_AXIS n_32 _CNV_A_R_LINEAR_____10_CM 4 0. 8160. FORMAT "%4.0" AXIS_PTS_REF ldpm_n_32_1 /end AXIS_DESCR
/end CHARACTERISTIC
/begin CHARACTERISTIC id_vls_down_rgn_stop "downstream binary lambda sensor signal threshold for determining rich exhaust gas" CURVE 0xa0809f3c _REC_CUR_20_u2_u2 4.9951171875 _CNV_A_R_LINEAR_____2_CM 0. 4.9951171875 DISPLAY_IDENTIFIER ID_VLS_DOWN_RGN_STOP FORMAT "%5.3"
 /begin AXIS_DESCR COM_AXIS ntld_rgn_st _CNV_A_R_LINEAR_____89_CM 4 0. 0.9999847412109381 FORMAT "%7.5" AXIS_PTS_REF ldp_ntld_rgn_st_id_vls_down /end AXIS_DESCR
/end CHARACTERISTIC
/begin CHARACTERISTIC ip_t_nt_hom_dec "weighted decrement for the homogeneous time counter" MAP 0xa080b470 _REC_MAP_20_u1_u1_u2 1.27 _CNV_A_R_LINEAR_____3_CM 0. 1.27 DISPLAY_IDENTIFIER IP_T_NT_HOM_DEC FORMAT "%5.3"
 /begin AXIS_DESCR COM_AXIS maf_kgh _CNV_A_R_LINEAR_____494_CM 4 0. 2040. FORMAT "%4.0" AXIS_PTS_REF ldpm_maf_kgh_ip_t_nt_hom /end AXIS_DESCR
 /begin AXIS_DESCR COM_AXIS online_dummy _CNV_A_R_LINEAR_____129_CM 4 0. 31.9990234375 FORMAT "%7.4" AXIS_PTS_REF ldpm_lamb_av_cor_ip_t_nt_hom /end AXIS_DESCR
/end CHARACTERISTIC
/begin CHARACTERISTIC ip_t_nt_hom_inc "weighted increment for the homogeneous time counter" MAP 0xa080b480 _REC_MAP_20_u1_u1_u2 1.27 _CNV_A_R_LINEAR_____3_CM 0. 1.27 DISPLAY_IDENTIFIER IP_T_NT_HOM_INC FORMAT "%5.3"
 /begin AXIS_DESCR COM_AXIS maf_kgh _CNV_A_R_LINEAR_____494_CM 4 0. 2040. FORMAT "%4.0" AXIS_PTS_REF ldpm_maf_kgh_ip_t_nt_hom /end AXIS_DESCR
 /begin AXIS_DESCR COM_AXIS online_dummy _CNV_A_R_LINEAR_____129_CM 4 0. 31.9990234375 FORMAT "%7.4" AXIS_PTS_REF ldpm_lamb_av_cor_ip_t_nt_hom /end AXIS_DESCR
/end CHARACTERISTIC
/begin CHARACTERISTIC ip_t_rgn_max "regeneration time for manual regeneration duration selection" MAP 0xa080b4a0 _REC_MAP_20_u2_u2_u2 655.35 _CNV_A_R_LINEAR_____3_CM 0. 655.35 DISPLAY_IDENTIFIER IP_T_RGN_MAX FORMAT "%6.2"
 /begin AXIS_DESCR COM_AXIS flow_nt_mmv _CNV_A_R_LINEAR_____215_CM 4 0. 2047.96875 FORMAT "%7.2" AXIS_PTS_REF ldp_flow_nt_mmv_ip_t_rgn_max /end AXIS_DESCR
 /begin AXIS_DESCR COM_AXIS nt_agi _CNV_A_R_LINEAR_____89_CM 4 0. 0.9999847412109381 FORMAT "%7.5" AXIS_PTS_REF ldpm_nt_agi /end AXIS_DESCR
/end CHARACTERISTIC
/begin MEASUREMENT tnt_mdl_max "maximum NOx trap temperature for lean operation" UBYTE _CNV_A_R_LINEAR_____481_CM 1 100. 0. 1020. DISPLAY_IDENTIFIER TNT_MDL_MAX ECU_ADDRESS 0xd0001598 FORMAT "%4.0" /end MEASUREMENT
/begin MEASUREMENT tnt_mdl_min "minimum NOx trap temperature for lean operation" UBYTE _CNV_A_R_LINEAR_____481_CM 1 100. 0. 1020. DISPLAY_IDENTIFIER TNT_MDL_MIN ECU_ADDRESS 0xd0001599 FORMAT "%4.0" /end MEASUREMENT
/begin CHARACTERISTIC lc_rpu_state_nox "Switch to use RPU value of STATE_NOX" VALUE 0xa080c5ea _REC_VAL_20_u1 1. _CNV_A_R_LINEAR_____0_CM 0. 1. DISPLAY_IDENTIFIER LC_RPU_STATE_NOX FORMAT "%1.0" /end CHARACTERISTIC
/begin CHARACTERISTIC lc_rpu_nt_eff_cor "Switch to use RPU value of NT_EFF_COR" VALUE 0xa080c5e4 _REC_VAL_20_u1 1. _CNV_A_R_LINEAR_____0_CM 0. 1. DISPLAY_IDENTIFIER LC_RPU_NT_EFF_COR FORMAT "%1.0" /end CHARACTERISTIC
/begin CHARACTERISTIC lc_rpu_nt_stc_bas "Switch to use RPU value of NT_STC_BAS" VALUE 0xa080c5e5 _REC_VAL_20_u1 1. _CNV_A_R_LINEAR_____0_CM 0. 1. DISPLAY_IDENTIFIER LC_RPU_NT_STC_BAS FORMAT "%1.0" /end CHARACTERISTIC
/begin CHARACTERISTIC lc_rpu_ntl "Switch to use RPU value of NTL" VALUE 0xa080c5e6 _REC_VAL_20_u1 1. _CNV_A_R_LINEAR_____0_CM 0. 1. DISPLAY_IDENTIFIER LC_RPU_NTL FORMAT "%1.0" /end CHARACTERISTIC
/begin CHARACTERISTIC lc_rpu_rgn_nt_req "switch to use RPU value of LV_RGN_NT_REQ" VALUE 0xa080c5e8 _REC_VAL_20_u1 1. _CNV_A_R_LINEAR_____0_CM 0. 1. DISPLAY_IDENTIFIER LC_RPU_RGN_NT_REQ FORMAT "%1.0" /end CHARACTERISTIC
/begin CHARACTERISTIC lc_rpu_nt_afs_req "Switch to use RPU value of LV_NT_AFS_REQ" VALUE 0xa080c5e3 _REC_VAL_20_u1 1. _CNV_A_R_LINEAR_____0_CM 0. 1. DISPLAY_IDENTIFIER LC_RPU_NT_AFS_REQ FORMAT "%1.0" /end CHARACTERISTIC
/begin CHARACTERISTIC lc_rpu_rgn_agi "Switch to use RPU value of LV_RGN_AGI_i" VALUE 0xa080c5e7 _REC_VAL_20_u1 1. _CNV_A_R_LINEAR_____0_CM 0. 1. DISPLAY_IDENTIFIER LC_RPU_RGN_AGI FORMAT "%1.0" /end CHARACTERISTIC
/begin CHARACTERISTIC lc_rpu_act_int_puc_afl "Switch to use RPU value of LV_ACT_INT_PUC_AFL_i" VALUE 0xa080c5e0 _REC_VAL_20_u1 1. _CNV_A_R_LINEAR_____0_CM 0. 1. DISPLAY_IDENTIFIER LC_RPU_ACT_INT_PUC_AFL FORMAT "%1.0" /end CHARACTERISTIC
/begin CHARACTERISTIC lc_rpu_sens_afr "Switch to use RPU value of LV_SENS_AFR_i" VALUE 0xa080c5e9 _REC_VAL_20_u1 1. _CNV_A_R_LINEAR_____0_CM 0. 1. DISPLAY_IDENTIFIER LC_RPU_SENS_AFR FORMAT "%1.0" /end CHARACTERISTIC
/begin CHARACTERISTIC lc_rpu_state_tran_calc "Switch to enable transition calc. by ECU / DME if STATE_NOX is calc. by RPU" VALUE 0xa080c5eb _REC_VAL_20_u1 1. _CNV_A_R_LINEAR_____0_CM 0. 1. DISPLAY_IDENTIFIER LC_RPU_STATE_TRAN_CALC FORMAT "%1.0" /end CHARACTERISTIC
/begin CHARACTERISTIC c_nox_out_mes_int_max "threshold for integrated downstream emission (meas. by NOx sensor) for requesting a regeneration" VALUE 0xa080bffc _REC_VAL_20_u2 10485.6 _CNV_A_R_LINEAR_____244_CM 0. 10485.6 DISPLAY_IDENTIFIER C_NOX_OUT_MES_INT_MAX FORMAT "%7.1" /end CHARACTERISTIC
/begin MEASUREMENT nt_eff_bas "Basis NOx trap efficiency" UWORD _CNV_A_R_LINEAR_____89_CM 1 100. 0. 0.9999847412109381 DISPLAY_IDENTIFIER NT_EFF_BAS ECU_ADDRESS 0xd0001544 FORMAT "%7.5" /end MEASUREMENT
/begin MEASUREMENT ntld_max_afs "maximum NOx trap loading degree for requesting a regeneration before lambda1 operation" UWORD _CNV_A_R_LINEAR_____89_CM 1 100. 0. 0.9999847412109381 DISPLAY_IDENTIFIER NTLD_MAX_AFS ECU_ADDRESS 0xd000a518 FORMAT "%7.5" /end MEASUREMENT
/begin MEASUREMENT ntld_max_afs_bas "Basis maximum NOx trap loading degree for requesting a regeneration before lambda1 operation" UWORD _CNV_A_R_LINEAR_____89_CM 1 100. 0. 0.9999847412109381 DISPLAY_IDENTIFIER NTLD_MAX_AFS_BAS ECU_ADDRESS 0xd0001546 FORMAT "%7.5" /end MEASUREMENT
/begin MEASUREMENT nox_sens_max_bas "Not corrected NOx sensor signal threshold for requesting a regeneration" UWORD _CNV_A_R_NOXD_LINEA_486_CM 1 100. 0. 1500. DISPLAY_IDENTIFIER NOX_SENS_MAX_BAS ECU_ADDRESS 0xd0001548 FORMAT "%4.0" /end MEASUREMENT
/begin AXIS_PTS ldpm_ntld "" 0xa080973c ntld _REC_AXS_20_u2 0.9999847412109381 _CNV_A_R_LINEAR_____89_CM 8 0. 0.9999847412109381 FORMAT "%7.5" /end AXIS_PTS
/begin AXIS_PTS ldpm_nt_agi "" 0xa0809730 nt_agi _REC_AXS_20_u2 0.9999847412109381 _CNV_A_R_LINEAR_____89_CM 4 0. 0.9999847412109381 FORMAT "%7.5" /end AXIS_PTS
/begin AXIS_PTS ldp_tqi_req_fast_ip_ntld_afs_at "" 0xa0809034 tqi_req_fast _REC_AXS_20_u2 2047.96875 _CNV_A_R_LINEAR_____87_CM 8 -1024. 1023.96875 FORMAT "%8.2" /end AXIS_PTS
/begin AXIS_PTS ldp_tqi_req_fast_ip_ntld_afs_mt "" 0xa0809048 tqi_req_fast _REC_AXS_20_u2 2047.96875 _CNV_A_R_LINEAR_____87_CM 8 -1024. 1023.96875 FORMAT "%8.2" /end AXIS_PTS
/begin AXIS_PTS ldp_n_32_ntld_max_afs_mt "" 0xa0808a84 n_32 _REC_AXS_20_u1 8160. _CNV_A_R_LINEAR_____10_CM 4 0. 8160. FORMAT "%4.0" /end AXIS_PTS
/begin AXIS_PTS ldp_n_32_ntld_max_afs_at "" 0xa0808a7e n_32 _REC_AXS_20_u1 8160. _CNV_A_R_LINEAR_____10_CM 4 0. 8160. FORMAT "%4.0" /end AXIS_PTS
/begin CHARACTERISTIC ip_fac_nox_sens_max "factor to correct threshold of the NOx sensor signal for requesting a regeneration" MAP 0xa080a3c4 _REC_MAP_20_u1_u2_u2 1.9921875 _CNV_A_R_LINEAR_____103_CM 0. 1.9921875 DISPLAY_IDENTIFIER IP_FAC_NOX_SENS_MAX FORMAT "%5.3"
 /begin AXIS_DESCR COM_AXIS nt_agi _CNV_A_R_LINEAR_____89_CM 4 0. 0.9999847412109381 FORMAT "%7.5" AXIS_PTS_REF ldpm_nt_agi /end AXIS_DESCR
 /begin AXIS_DESCR COM_AXIS tnt_mdl_mv _CNV_A_R_LINEAR_____209_CM 6 0. 1023.984375 FORMAT "%11.6" AXIS_PTS_REF ldp_tnt_mdl_mv_ip_fac_nox_sens /end AXIS_DESCR
/end CHARACTERISTIC
/begin CHARACTERISTIC c_fac_ntld_max_afs_err_egr "factor to correct homogen request in case of EGR_ERR" VALUE 0xa080bce8 _REC_VAL_20_u1 1.9921875 _CNV_A_R_LINEAR_____103_CM 0. 1.9921875 DISPLAY_IDENTIFIER C_FAC_NTLD_MAX_AFS_ERR_EGR FORMAT "%5.3" /end CHARACTERISTIC
/begin AXIS_PTS ldp_flow_nt_mmv_ip_nox_sens_mt "" 0xa080866c flow_nt_mmv _REC_AXS_20_u2 2047.96875 _CNV_A_R_LINEAR_____215_CM 6 0. 2047.96875 FORMAT "%7.2" /end AXIS_PTS
/begin AXIS_PTS ldp_flow_nt_mmv_ip_nox_sens_at "" 0xa080865c flow_nt_mmv _REC_AXS_20_u2 2047.96875 _CNV_A_R_LINEAR_____215_CM 6 0. 2047.96875 FORMAT "%7.2" /end AXIS_PTS
/begin AXIS_PTS ldp_n_32_ip_nox_sens_max_mt "" 0xa0808a2c n_32 _REC_AXS_20_u1 8160. _CNV_A_R_LINEAR_____10_CM 8 0. 8160. FORMAT "%4.0" /end AXIS_PTS
/begin AXIS_PTS ldp_n_32_ip_nox_sens_max_at "" 0xa0808a20 n_32 _REC_AXS_20_u1 8160. _CNV_A_R_LINEAR_____10_CM 8 0. 8160. FORMAT "%4.0" /end AXIS_PTS
/begin CHARACTERISTIC c_nox_sens_max_ofs "Threshold offset of the NOx sensor signal for requesting a regeneration" VALUE 0xa080c004 _REC_VAL_20_u2 1500. _CNV_A_R_NOXD_LINEA_486_CM 0. 1500. DISPLAY_IDENTIFIER C_NOX_SENS_MAX_OFS FORMAT "%4.0" /end CHARACTERISTIC
/begin AXIS_PTS ldp_nt_agi_thermo__tnt_mdl_max "" 0xa0808c32 nt_agi _REC_AXS_20_u1 0.99609375 _CNV_A_R_LINEAR_____28_CM 4 0. 0.99609375 FORMAT "%5.3" /end AXIS_PTS
/begin CHARACTERISTIC ip_ntld_max_afs_at "maximum NOx trap loading degree for requesting a regeneration before lambda1 operation ( for automatic transmission )" MAP 0xa080b2d4 _REC_MAP_20_u2_u2_u1 0.9999847412109381 _CNV_A_R_LINEAR_____89_CM 0. 0.9999847412109381 DISPLAY_IDENTIFIER IP_NTLD_MAX_AFS_AT FORMAT "%7.5"
 /begin AXIS_DESCR COM_AXIS tqi_req_fast _CNV_A_R_LINEAR_____87_CM 8 -1024. 1023.96875 FORMAT "%8.2" AXIS_PTS_REF ldp_tqi_req_fast_ip_ntld_afs_at /end AXIS_DESCR
 /begin AXIS_DESCR COM_AXIS n_32 _CNV_A_R_LINEAR_____10_CM 4 0. 8160. FORMAT "%4.0" AXIS_PTS_REF ldp_n_32_ntld_max_afs_at /end AXIS_DESCR
/end CHARACTERISTIC
/begin CHARACTERISTIC ip_ntld_max_afs_mt "maximum NOx trap loading degree for requesting a regeneration before lambda1 operation ( for manual transmission )" MAP 0xa080b314 _REC_MAP_20_u2_u2_u1 0.9999847412109381 _CNV_A_R_LINEAR_____89_CM 0. 0.9999847412109381 DISPLAY_IDENTIFIER IP_NTLD_MAX_AFS_MT FORMAT "%7.5"
 /begin AXIS_DESCR COM_AXIS tqi_req_fast _CNV_A_R_LINEAR_____87_CM 8 -1024. 1023.96875 FORMAT "%8.2" AXIS_PTS_REF ldp_tqi_req_fast_ip_ntld_afs_mt /end AXIS_DESCR
 /begin AXIS_DESCR COM_AXIS n_32 _CNV_A_R_LINEAR_____10_CM 4 0. 8160. FORMAT "%4.0" AXIS_PTS_REF ldp_n_32_ntld_max_afs_mt /end AXIS_DESCR
/end CHARACTERISTIC
/begin CHARACTERISTIC ip_nox_sens_max_mt "threshold of the NOx sensor signal for requesting a regeneration for MT" MAP 0xa081596c _REC_MAP_20_u2_u2_u1 1500. _CNV_A_R_NOXD_LINEA_486_CM 0. 1500. DISPLAY_IDENTIFIER IP_NOX_SENS_MAX_MT FORMAT "%4.0"
 /begin AXIS_DESCR COM_AXIS flow_nt_mmv _CNV_A_R_LINEAR_____215_CM 6 0. 2047.96875 FORMAT "%7.2" AXIS_PTS_REF ldp_flow_nt_mmv_ip_nox_sens_mt /end AXIS_DESCR
 /begin AXIS_DESCR COM_AXIS n_32 _CNV_A_R_LINEAR_____10_CM 8 0. 8160. FORMAT "%4.0" AXIS_PTS_REF ldp_n_32_ip_nox_sens_max_mt /end AXIS_DESCR
/end CHARACTERISTIC
/begin CHARACTERISTIC ip_nox_sens_max_at "threshold of the NOx sensor signal for requesting a regeneration for AT" MAP 0xa081590c _REC_MAP_20_u2_u2_u1 1500. _CNV_A_R_NOXD_LINEA_486_CM 0. 1500. DISPLAY_IDENTIFIER IP_NOX_SENS_MAX_AT FORMAT "%4.0"
 /begin AXIS_DESCR COM_AXIS flow_nt_mmv _CNV_A_R_LINEAR_____215_CM 6 0. 2047.96875 FORMAT "%7.2" AXIS_PTS_REF ldp_flow_nt_mmv_ip_nox_sens_at /end AXIS_DESCR
 /begin AXIS_DESCR COM_AXIS n_32 _CNV_A_R_LINEAR_____10_CM 8 0. 8160. FORMAT "%4.0" AXIS_PTS_REF ldp_n_32_ip_nox_sens_max_at /end AXIS_DESCR
/end CHARACTERISTIC
/begin CHARACTERISTIC c_nt_stc_bas_max_rng_h "maximum value of base NOx trap storage capacity map" VALUE 0xa080c03c _REC_VAL_20_u2 20971.2 _CNV_A_R_LINEAR_____495_CM 0. 20971.2 DISPLAY_IDENTIFIER C_NT_STC_BAS_MAX_RNG_H FORMAT "%7.1" /end CHARACTERISTIC
/begin MEASUREMENT nt_stc_rng_h "NOx trap storage capacity" UWORD _CNV_A_R_LINEAR_____495_CM 1 100. 0. 20971.2 DISPLAY_IDENTIFIER NT_STC_RNG_H ECU_ADDRESS 0xd000153c FORMAT "%7.1" /end MEASUREMENT
/begin MEASUREMENT nt_stc_bas_rng_h "NOx trap base storage capacity" UWORD _CNV_A_R_LINEAR_____495_CM 1 100. 0. 20971.2 DISPLAY_IDENTIFIER NT_STC_BAS_RNG_H ECU_ADDRESS 0xd000a4f4 FORMAT "%7.1" /end MEASUREMENT
/begin MEASUREMENT t_afl_sum "sum_of_lean_time" ULONG _CNV_A_R_LINEAR_____496_CM 1 100. 0. 85900000. DISPLAY_IDENTIFIER T_AFL_SUM ECU_ADDRESS 0xd000b834 FORMAT "%11.0" /end MEASUREMENT
/begin CHARACTERISTIC ip_nt_stc_bas_rng_h "NOx trap storage capacity" MAP 0xa0815acc _REC_MAP_20_u2_u2_u1 20971.2 _CNV_A_R_LINEAR_____495_CM 0. 20971.2 DISPLAY_IDENTIFIER IP_NT_STC_BAS_RNG_H FORMAT "%7.1"
 /begin AXIS_DESCR COM_AXIS nox_conc_mmv _CNV_A_R_NOXD_LINEA_486_CM 8 0. 65535. FORMAT "%5.0" AXIS_PTS_REF ldp_nox_conc_mmv_ip_nt_stc_bas /end AXIS_DESCR
 /begin AXIS_DESCR COM_AXIS tnt_mdl_mv _CNV_A_R_LINEAR_____481_CM 8 0. 1020. FORMAT "%4.0" AXIS_PTS_REF ldpm_tnt_mdl_nox /end AXIS_DESCR
/end CHARACTERISTIC
/begin CHARACTERISTIC c_nt_stc_ini_rng_h "initialisation value of actual and base NOx trap storage capacity" VALUE 0xa080c03e _REC_VAL_20_u2 20971.2 _CNV_A_R_LINEAR_____495_CM 0. 20971.2 DISPLAY_IDENTIFIER C_NT_STC_INI_RNG_H FORMAT "%7.1" /end CHARACTERISTIC
/begin MEASUREMENT lv_nt_act "flag for NOx catalyst function activation" UBYTE _CNV_S_2_RANGE__0___1_CM 1 100. 0. 1. DISPLAY_IDENTIFIER LV_NT_ACT ECU_ADDRESS 0xd0008917 BIT_MASK 0x1 /end MEASUREMENT
/begin MEASUREMENT lv_sens_rgn_1_ready "end of first regeneration" UBYTE _CNV_S_2_RANGE__0___1_CM 1 100. 0. 1. DISPLAY_IDENTIFIER LV_SENS_RGN_1_READY ECU_ADDRESS 0xd0008928 BIT_MASK 0x1 /end MEASUREMENT
/begin MEASUREMENT lv_rgn_cdn "flag for testing whether or not regeneration conditions are given" UBYTE _CNV_S_2_RANGE__0___1_CM 1 100. 0. 1. DISPLAY_IDENTIFIER LV_RGN_CDN ECU_ADDRESS 0xd000892a BIT_MASK 0x1 /end MEASUREMENT
/begin MEASUREMENT lv_vls_grd_neg "negative gradient of vls_nox_sens_1 between first and second regeneration" UBYTE _CNV_S_2_RANGE__0___1_CM 1 100. 0. 1. DISPLAY_IDENTIFIER LV_VLS_GRD_NEG ECU_ADDRESS 0xd000892c BIT_MASK 0x1 /end MEASUREMENT
/begin MEASUREMENT ntl_min "minimum NOx trap loading" UWORD _CNV_A_R_LINEAR_____244_CM 1 100. 0. 10485.6 DISPLAY_IDENTIFIER NTL_MIN ECU_ADDRESS 0xd000a4fc FORMAT "%7.1" /end MEASUREMENT
/begin MEASUREMENT vls_min_tmp "temporary local minimum of vls_nox_sens_1" UWORD _CNV_A_R_LINEAR_____219_CM 1 100. -200. 1200. DISPLAY_IDENTIFIER VLS_MIN_TMP ECU_ADDRESS 0xd000154a FORMAT "%5.0" /end MEASUREMENT
/begin MEASUREMENT vls_max_tmp "temporary local maximum of vls_nox_sens_1" UWORD _CNV_A_R_LINEAR_____219_CM 1 100. -200. 1200. DISPLAY_IDENTIFIER VLS_MAX_TMP ECU_ADDRESS 0xd000154c FORMAT "%5.0" /end MEASUREMENT
/begin CHARACTERISTIC lc_nt_act "logical constant for NOx catalyst function activation" VALUE 0xa080c5c8 _REC_VAL_20_u1 1. _CNV_A_R_LINEAR_____0_CM 0. 1. DISPLAY_IDENTIFIER LC_NT_ACT FORMAT "%1.0" /end CHARACTERISTIC
/begin CHARACTERISTIC lc_sens_afr_mod "selection of calculation method for LV_SENS_AFR_i" VALUE 0xa080c5ed _REC_VAL_20_u1 1. _CNV_A_R_LINEAR_____0_CM 0. 1. DISPLAY_IDENTIFIER LC_SENS_AFR_MOD FORMAT "%1.0" /end CHARACTERISTIC
/begin CHARACTERISTIC c_t_nt_hom_max_vld "lean time threshold for resetting the homogeneous time T_NT_HOM" VALUE 0xa080c244 _REC_VAL_20_u2 655.35 _CNV_A_R_LINEAR_____3_CM 0. 655.35 DISPLAY_IDENTIFIER C_T_NT_HOM_MAX_VLD FORMAT "%6.2" /end CHARACTERISTIC
/begin CHARACTERISTIC c_vls_nox_sens_afr_trim "binary NOx sensor signal threshold for determining rich trim conditions" VALUE 0xa080c46e _REC_VAL_20_u2 1400. _CNV_A_R_LINEAR_____219_CM -200. 1200. DISPLAY_IDENTIFIER C_VLS_NOX_SENS_AFR_TRIM FORMAT "%4.0" /end CHARACTERISTIC
/begin CHARACTERISTIC c_vls_dist_grd_neg "Difference between local maximum and current value for calculation of negative gradient" VALUE 0xa080c450 _REC_VAL_20_u2 1400. _CNV_A_R_LINEAR_____219_CM -200. 1200. DISPLAY_IDENTIFIER C_VLS_DIST_GRD_NEG FORMAT "%5.0" /end CHARACTERISTIC
/begin CHARACTERISTIC c_vls_dist_grd_pos "Difference between local minimum and current value for calculation of positive gradient" VALUE 0xa080c452 _REC_VAL_20_u2 1400. _CNV_A_R_LINEAR_____219_CM -200. 1200. DISPLAY_IDENTIFIER C_VLS_DIST_GRD_POS FORMAT "%5.0" /end CHARACTERISTIC
/begin CHARACTERISTIC c_vls_max_rgn_2_stop "Threshold value for end of second regeneration" VALUE 0xa080c464 _REC_VAL_20_u2 1400. _CNV_A_R_LINEAR_____219_CM -200. 1200. DISPLAY_IDENTIFIER C_VLS_MAX_RGN_2_STOP FORMAT "%5.0" /end CHARACTERISTIC
/begin CHARACTERISTIC ip_tnt_mdl_min "minimum NOx trap temperature for lean operation" CURVE 0xa080b6e8 _REC_CUR_20_u1_u1 1020. _CNV_A_R_LINEAR_____481_CM 0. 1020. DISPLAY_IDENTIFIER IP_TNT_MDL_MIN FORMAT "%4.0"
 /begin AXIS_DESCR COM_AXIS nt_agi _CNV_A_R_LINEAR_____28_CM 4 0. 0.99609375 FORMAT "%5.3" AXIS_PTS_REF ldp_nt_agi_thermo__tnt_mdl_min /end AXIS_DESCR
/end CHARACTERISTIC
/begin CHARACTERISTIC ip_tnt_mdl_min_is "minimum NOx trap temperature for lean operation at idle speed" CURVE 0xa080b6ec _REC_CUR_20_u1_u1 1020. _CNV_A_R_LINEAR_____481_CM 0. 1020. DISPLAY_IDENTIFIER IP_TNT_MDL_MIN_IS FORMAT "%4.0"
 /begin AXIS_DESCR COM_AXIS nt_agi _CNV_A_R_LINEAR_____28_CM 4 0. 0.99609375 FORMAT "%5.3" AXIS_PTS_REF ldp_nt_agi_thermo_ip_tnt_min_is /end AXIS_DESCR
/end CHARACTERISTIC
/begin AXIS_PTS ldp_nt_agi_thermo__tnt_mdl_min "" 0xa0808c38 nt_agi _REC_AXS_20_u1 0.99609375 _CNV_A_R_LINEAR_____28_CM 4 0. 0.99609375 FORMAT "%5.3" /end AXIS_PTS
/begin AXIS_PTS ldp_nt_agi_thermo_ip_tnt_min_is "" 0xa0808c3e nt_agi _REC_AXS_20_u1 0.99609375 _CNV_A_R_LINEAR_____28_CM 4 0. 0.99609375 FORMAT "%5.3" /end AXIS_PTS
/begin CHARACTERISTIC c_vls_max_rgn_1_stop "Threshold value for end of first regeneration" VALUE 0xa080c462 _REC_VAL_20_u2 1400. _CNV_A_R_LINEAR_____219_CM -200. 1200. DISPLAY_IDENTIFIER C_VLS_MAX_RGN_1_STOP FORMAT "%5.0" /end CHARACTERISTIC
/begin CHARACTERISTIC c_vls_grd_neg_vls_set "Negative gradient for set of LV_SENS_AFR_2 with VLS signal" VALUE 0xa080c460 _REC_VAL_20_u2 1400. _CNV_A_R_LINEAR_____219_CM -200. 1200. DISPLAY_IDENTIFIER C_VLS_GRD_NEG_VLS_SET FORMAT "%5.0" /end CHARACTERISTIC
/begin MEASUREMENT vls_nox_sens_old "old binary O2 signal voltage, raw value, measured by NOx sensor" UWORD _CNV_A_R_LINEAR_____219_CM 1 100. -200. 1200. DISPLAY_IDENTIFIER VLS_NOX_SENS_OLD ECU_ADDRESS 0xd000131e FORMAT "%5.0" /end MEASUREMENT
/begin MEASUREMENT nox_out_int_tmp_1 "temporary internal NOx out integral value for NOx sensor regeneration request calculation" UWORD _CNV_A_R_LINEAR_____244_CM 1 100. 0. 10485.6 DISPLAY_IDENTIFIER NOX_OUT_INT_TMP_1 ECU_ADDRESS 0xd0001570 FORMAT "%7.1" /end MEASUREMENT
/begin MEASUREMENT nox_cor_int "Integral of modelled NOx raw emissions (pre NOx catalyst) at current lean operation phase" UWORD _CNV_A_R_LINEAR_____244_CM 1 100. 0. 10485.6 DISPLAY_IDENTIFIER NOX_COR_INT ECU_ADDRESS 0xd000153a FORMAT "%7.1" /end MEASUREMENT
/begin MEASUREMENT dist_afl_st "Mileage counter value at start of lean operation phase (STATE_NOX = LOAD)" ULONG _CNV_A_R_LINEAR_____434_CM 1 100. 0. 429496729500. DISPLAY_IDENTIFIER DIST_AFL_ST ECU_ADDRESS 0xd0001588 FORMAT "%12.0" /end MEASUREMENT
/begin MEASUREMENT dist_afl "Mileage during current lean operation phase (STATE_NOX = LOAD)" UWORD _CNV_A_R_LINEAR_____497_CM 1 100. 0. 6553.5 DISPLAY_IDENTIFIER DIST_AFL ECU_ADDRESS 0xd0001554 FORMAT "%6.1" /end MEASUREMENT
/begin MEASUREMENT t_stop "Time counter since start of STATE_NOX = STOP is active" UWORD _CNV_A_R_LINEAR_____110_CM 1 100. 0. 1310.7 DISPLAY_IDENTIFIER T_STOP ECU_ADDRESS 0xd0001556 FORMAT "%7.2" /end MEASUREMENT
/begin MEASUREMENT state_nox "NOx catalyst state" UBYTE _CNV_S_6_STATE_NOX__245_CM 1 100. 0. 5. DISPLAY_IDENTIFIER STATE_NOX ECU_ADDRESS 0xd0008914 /end MEASUREMENT
/begin CHARACTERISTIC c_vls_down_afr_trim "binary lambda sensor signal threshold for determining rich trim conditions" VALUE 0xa080c45c _REC_VAL_20_u2 4.9951171875 _CNV_A_R_LINEAR_____2_CM 0. 4.9951171875 DISPLAY_IDENTIFIER C_VLS_DOWN_AFR_TRIM FORMAT "%5.3" /end CHARACTERISTIC
/begin CHARACTERISTIC c_t_stop_afl_purge_max "Time limit for activation of catalyst purge after lean operation at STATE_NOX = STOP" VALUE 0xa080c272 _REC_VAL_20_u2 1310.7 _CNV_A_R_LINEAR_____110_CM 0. 1310.7 DISPLAY_IDENTIFIER C_T_STOP_AFL_PURGE_MAX FORMAT "%7.2" /end CHARACTERISTIC
/begin CHARACTERISTIC c_maf_int_stop_afl_purge_max "Air mass integral limit for activation of catalyst purge after lean operation at STATE_NOX = STOP" VALUE 0xa080be34 _REC_VAL_20_u2 1456.333333 _CNV_A_R_ANOX_LINEA_498_CM 0. 1456.333333 DISPLAY_IDENTIFIER C_MAF_INT_STOP_AFL_PURGE_MAX FORMAT "%7.2" /end CHARACTERISTIC
/begin CHARACTERISTIC c_ctr_afl_purge_max "Maximum number of activation cycles for catalyst purge after lean operation at STATE_NOX = STOP" VALUE 0xa080bb20 _REC_VAL_20_u1 255. _CNV_A_R_LINEAR_____0_CM 0. 255. DISPLAY_IDENTIFIER C_CTR_AFL_PURGE_MAX FORMAT "%3.0" /end CHARACTERISTIC
/begin CHARACTERISTIC c_vls_down_afl_purge_on "VLS_DOWN activation threshold for catalyst purge after lean operation at STATE_NOX = STOP" VALUE 0xa080c456 _REC_VAL_20_u2 4.9951171875 _CNV_A_R_LINEAR_____2_CM 0. 4.9951171875 DISPLAY_IDENTIFIER C_VLS_DOWN_AFL_PURGE_ON FORMAT "%5.3" /end CHARACTERISTIC
/begin CHARACTERISTIC c_vls_down_afl_purge_off "VLS_DOWN deactivation threshold for catalyst purge after lean operation at STATE_NOX = STOP" VALUE 0xa080c454 _REC_VAL_20_u2 4.9951171875 _CNV_A_R_LINEAR_____2_CM 0. 4.9951171875 DISPLAY_IDENTIFIER C_VLS_DOWN_AFL_PURGE_OFF FORMAT "%5.3" /end CHARACTERISTIC
/begin CHARACTERISTIC c_vls_nox_sens_afl_purge_on "VLS_NOX_SENS activation threshold for catalyst purge after lean operation at STATE_NOX = STOP" VALUE 0xa080c468 _REC_VAL_20_u2 1400. _CNV_A_R_LINEAR_____219_CM -200. 1200. DISPLAY_IDENTIFIER C_VLS_NOX_SENS_AFL_PURGE_ON FORMAT "%4.0" /end CHARACTERISTIC
/begin CHARACTERISTIC c_vls_nox_sens_afl_purge_off "VLS_NOX_SENS deactivation threshold for catalyst purge after lean operation at STATE_NOX = STOP" VALUE 0xa080c466 _REC_VAL_20_u2 1400. _CNV_A_R_LINEAR_____219_CM -200. 1200. DISPLAY_IDENTIFIER C_VLS_NOX_SENS_AFL_PURGE_OFF FORMAT "%4.0" /end CHARACTERISTIC
/begin CHARACTERISTIC c_lamb_nox_sens_afl_purge_on "LAMB_NOX_SENS activation threshold for catalyst purge after lean operation at STATE_NOX = STOP" VALUE 0xa080bdd6 _REC_VAL_20_u2 31.9990234375 _CNV_A_R_LINEAR_____129_CM 0. 31.9990234375 DISPLAY_IDENTIFIER C_LAMB_NOX_SENS_AFL_PURGE_ON FORMAT "%7.4" /end CHARACTERISTIC
/begin CHARACTERISTIC c_lamb_nox_sens_afl_purge_off "LAMB_NOX_SENS deactivation threshold for catalyst purge after lean operation at STATE_NOX = STOP" VALUE 0xa080bdd4 _REC_VAL_20_u2 31.9990234375 _CNV_A_R_LINEAR_____129_CM 0. 31.9990234375 DISPLAY_IDENTIFIER C_LAMB_NOX_SENS_AFL_PURGE_OFF FORMAT "%7.4" /end CHARACTERISTIC
/begin CHARACTERISTIC c_vs_inh_purge "vehicle speed threshold for inhibiting a catalyst purge" VALUE 0xa080c4c3 _REC_VAL_20_u1 255. _CNV_A_R_LINEAR_____6_CM 0. 255. DISPLAY_IDENTIFIER C_VS_INH_PURGE FORMAT "%3.0" /end CHARACTERISTIC
/begin CHARACTERISTIC lc_nox_rpu "General switch to enable switch to RPU values" VALUE 0xa080c5c4 _REC_VAL_20_u1 1. _CNV_A_R_LINEAR_____0_CM 0. 1. DISPLAY_IDENTIFIER LC_NOX_RPU FORMAT "%1.0" /end CHARACTERISTIC
/begin CHARACTERISTIC lc_inh_afl_purge_tout "Inhibition of catalyst purge break if a time out condition fulfilled" VALUE 0xa080c57c _REC_VAL_20_u1 1. _CNV_A_R_LINEAR_____0_CM 0. 1. DISPLAY_IDENTIFIER LC_INH_AFL_PURGE_TOUT FORMAT "%1.0" /end CHARACTERISTIC
/begin AXIS_PTS ldpm_tqi_req_fast_1_egtr "" 0xa080989c tqi_req_fast _REC_AXS_20_u2 2047.96875 _CNV_A_R_LINEAR_____87_CM 8 -1024. 1023.96875 FORMAT "%8.2" /end AXIS_PTS
/begin AXIS_PTS ldp_tnt_mdl_mv_ip_fac_nox_sens "" 0xa0808ed0 tnt_mdl_mv _REC_AXS_20_u2 1023.984375 _CNV_A_R_LINEAR_____209_CM 6 0. 1023.984375 FORMAT "%11.6" /end AXIS_PTS
/begin AXIS_PTS ldp_nox_cor_ip_nt_eff_cor "" 0xa0808be8 nox_cor _REC_AXS_20_u2 1023.984375 _CNV_A_R_LINEAR_____489_CM 8 0. 1023.984375 FORMAT "%7.2" /end AXIS_PTS
/begin CHARACTERISTIC ip_tnt_mdl_max "maximum NOx trap temperature for lean operation" CURVE 0xa080b6e4 _REC_CUR_20_u1_u1 1020. _CNV_A_R_LINEAR_____481_CM 0. 1020. DISPLAY_IDENTIFIER IP_TNT_MDL_MAX FORMAT "%4.0"
 /begin AXIS_DESCR COM_AXIS nt_agi _CNV_A_R_LINEAR_____28_CM 4 0. 0.99609375 FORMAT "%5.3" AXIS_PTS_REF ldp_nt_agi_thermo__tnt_mdl_max /end AXIS_DESCR
/end CHARACTERISTIC
/begin AXIS_PTS ldp_ntl_dec_int_ip_t_max_rgn "" 0xa0808c44 ntl_dec_int[0] _REC_AXS_20_u2 10485.6 _CNV_A_R_LINEAR_____244_CM 6 0. 10485.6 FORMAT "%8.2" /end AXIS_PTS
/begin AXIS_PTS ldp_ntl_rgn_st_ip_t_max_rgn "" 0xa0808c64 ntl_rgn_st _REC_AXS_20_u2 10485.6 _CNV_A_R_LINEAR_____244_CM 6 0. 10485.6 FORMAT "%8.2" /end AXIS_PTS
/begin AXIS_PTS ldp_ntl_rgn_st_ip_ntl_dec_int "" 0xa0808c54 ntl_rgn_st _REC_AXS_20_u2 10485.6 _CNV_A_R_LINEAR_____244_CM 6 0. 10485.6 FORMAT "%8.2" /end AXIS_PTS
/begin CHARACTERISTIC ip_t_max_rgn_2_stop "Maximum time duration of second regeneration" MAP 0xa0815e3c _REC_MAP_20_u2_u2_u2 655.35 _CNV_A_R_LINEAR_____3_CM 0. 655.35 DISPLAY_IDENTIFIER IP_T_MAX_RGN_2_STOP FORMAT "%6.2"
 /begin AXIS_DESCR COM_AXIS ntl_rgn_st _CNV_A_R_LINEAR_____244_CM 6 0. 10485.6 FORMAT "%8.2" AXIS_PTS_REF ldp_ntl_rgn_st_ip_t_max_rgn /end AXIS_DESCR
 /begin AXIS_DESCR COM_AXIS ntl_dec_int[0] _CNV_A_R_LINEAR_____244_CM 6 0. 10485.6 FORMAT "%8.2" AXIS_PTS_REF ldp_ntl_dec_int_ip_t_max_rgn /end AXIS_DESCR
/end CHARACTERISTIC
/begin CHARACTERISTIC ip_ntl_dec_int_max "Maximum amount of regeneration agent" CURVE 0xa080b268 _REC_CUR_20_u2_u2 10485.6 _CNV_A_R_LINEAR_____244_CM 0. 10485.6 DISPLAY_IDENTIFIER IP_NTL_DEC_INT_MAX FORMAT "%8.2"
 /begin AXIS_DESCR COM_AXIS ntl_rgn_st _CNV_A_R_LINEAR_____244_CM 6 0. 10485.6 FORMAT "%8.2" AXIS_PTS_REF ldp_ntl_rgn_st_ip_ntl_dec_int /end AXIS_DESCR
/end CHARACTERISTIC
/begin CHARACTERISTIC c_dist_afl_min "Minimum mileage for calculation of RATIO_NOX_OUT_INT_DIST" VALUE 0xa080bc44 _REC_VAL_20_u2 6553.5 _CNV_A_R_LINEAR_____497_CM 0. 6553.5 DISPLAY_IDENTIFIER C_DIST_AFL_MIN FORMAT "%6.1" /end CHARACTERISTIC
/begin CHARACTERISTIC c_ratio_nox_out_int_dist_max "Maximum ratio of NOx out integral to mileage at current lean phase; threshold for start of a NOx regeneration" VALUE 0xa080c0a2 _REC_VAL_20_u2 6.5535 _CNV_A_R_ANOX_LINEA_499_CM 0. 6.5535 DISPLAY_IDENTIFIER C_RATIO_NOX_OUT_INT_DIST_MAX FORMAT "%6.4" /end CHARACTERISTIC
/begin CHARACTERISTIC c_nox_cor_int_min "Minimum NOx raw emission integral value for calculation of RATIO_NOX" VALUE 0xa080bff0 _REC_VAL_20_u2 10485.6 _CNV_A_R_LINEAR_____244_CM 0. 10485.6 DISPLAY_IDENTIFIER C_NOX_COR_INT_MIN FORMAT "%8.2" /end CHARACTERISTIC
/begin CHARACTERISTIC c_crlc_flow_nt "correlation constant for calculation of filtered exhaust gas flow" VALUE 0xa080baea _REC_VAL_20_u2 0.9999847412109381 _CNV_A_R_LINEAR_____89_CM 0. 0.9999847412109381 DISPLAY_IDENTIFIER C_CRLC_FLOW_NT FORMAT "%7.5" /end CHARACTERISTIC
/begin CHARACTERISTIC c_ratio_nox_max "Maximum ratio of NOx out integral to NOx raw emission integral; threshold for start of a NOx regenration" VALUE 0xa080c0a0 _REC_VAL_20_u2 99.99847412109381 _CNV_A_R_LINEAR_____8_CM 0. 99.99847412109381 DISPLAY_IDENTIFIER C_RATIO_NOX_MAX /end CHARACTERISTIC
/begin MEASUREMENT lv_cat_purge_req_post_afl[0] "Request for catalyst purge activation when leaving lean burn operation" UBYTE _CNV_S_2_RANGE__0___1_CM 1 100. 0. 1. DISPLAY_IDENTIFIER LV_CAT_PURGE_REQ_POST_AFL[1] ECU_ADDRESS 0xd000893c BIT_MASK 0x1 /end MEASUREMENT
/begin MEASUREMENT lv_cat_purge_req_post_afl[1] "Request for catalyst purge activation when leaving lean burn operation" UBYTE _CNV_S_2_RANGE__0___1_CM 1 100. 0. 1. DISPLAY_IDENTIFIER LV_CAT_PURGE_REQ_POST_AFL[2] ECU_ADDRESS 0xd000893d BIT_MASK 0x1 /end MEASUREMENT
/begin MEASUREMENT state_afl_purge[0] "State of catalyst purge after lean operation" UBYTE _CNV_S_3_STATE_AFL__500_CM 1 100. 0. 2. DISPLAY_IDENTIFIER STATE_AFL_PURGE[1] ECU_ADDRESS 0xd00015a6 /end MEASUREMENT
/begin MEASUREMENT state_afl_purge[1] "State of catalyst purge after lean operation" UBYTE _CNV_S_3_STATE_AFL__500_CM 1 100. 0. 2. DISPLAY_IDENTIFIER STATE_AFL_PURGE[2] ECU_ADDRESS 0xd00015a7 /end MEASUREMENT
/begin MEASUREMENT ctr_afl_purge[0] "Activation counter for catalyst purge after lean operation" UBYTE _CNV_A_R_LINEAR_____0_CM 1 100. 0. 255. DISPLAY_IDENTIFIER CTR_AFL_PURGE[1] ECU_ADDRESS 0xd00015a8 FORMAT "%3.0" /end MEASUREMENT
/begin MEASUREMENT ctr_afl_purge[1] "Activation counter for catalyst purge after lean operation" UBYTE _CNV_A_R_LINEAR_____0_CM 1 100. 0. 255. DISPLAY_IDENTIFIER CTR_AFL_PURGE[2] ECU_ADDRESS 0xd00015a9 FORMAT "%3.0" /end MEASUREMENT
/begin CHARACTERISTIC c_state_sens_afl_purge[0] "Determination of signal for catalyst purge function after lean operation" VALUE 0xa080c0f0 _REC_VAL_20_u1 4. _CNV_S_5_C_STATE_SE_501_CM 0. 4. DISPLAY_IDENTIFIER C_STATE_SENS_AFL_PURGE[1] /end CHARACTERISTIC
/begin CHARACTERISTIC c_state_sens_afl_purge[1] "Determination of signal for catalyst purge function after lean operation" VALUE 0xa080c0f1 _REC_VAL_20_u1 4. _CNV_S_5_C_STATE_SE_501_CM 0. 4. DISPLAY_IDENTIFIER C_STATE_SENS_AFL_PURGE[2] /end CHARACTERISTIC
/begin MEASUREMENT ratio_nox[0] "Ratio of NOx out integral to NOx raw emission integral" UWORD _CNV_A_R_LINEAR_____8_CM 1 100. 0. 99.99847412109381 DISPLAY_IDENTIFIER ratio_nox_1 ECU_ADDRESS 0xd000156c /end MEASUREMENT
/begin MEASUREMENT ratio_nox[1] "Ratio of NOx out integral to NOx raw emission integral" UWORD _CNV_A_R_LINEAR_____8_CM 1 100. 0. 99.99847412109381 DISPLAY_IDENTIFIER ratio_nox_2 ECU_ADDRESS 0xd000156e /end MEASUREMENT
/begin MEASUREMENT ratio_nox_out_int_dist[0] "Ratio of NOx out emissions related to mileage of current lean operation phase" UWORD _CNV_A_R_ANOX_LINEA_499_CM 1 100. 0. 6.5535 DISPLAY_IDENTIFIER ratio_nox_out_int_dist_1 ECU_ADDRESS 0xd0001568 FORMAT "%6.4" /end MEASUREMENT
/begin MEASUREMENT ratio_nox_out_int_dist[1] "Ratio of NOx out emissions related to mileage of current lean operation phase" UWORD _CNV_A_R_ANOX_LINEA_499_CM 1 100. 0. 6.5535 DISPLAY_IDENTIFIER ratio_nox_out_int_dist_2 ECU_ADDRESS 0xd000156a FORMAT "%6.4" /end MEASUREMENT
/begin MEASUREMENT lv_rgn_agi[0] "flag used for communication with aging function" UBYTE _CNV_S_2_RANGE__0___1_CM 1 100. 0. 1. DISPLAY_IDENTIFIER LV_RGN_AGI[1] ECU_ADDRESS 0xd000892e BIT_MASK 0x1 /end MEASUREMENT
/begin MEASUREMENT lv_rgn_agi[1] "flag used for communication with aging function" UBYTE _CNV_S_2_RANGE__0___1_CM 1 100. 0. 1. DISPLAY_IDENTIFIER LV_RGN_AGI[2] ECU_ADDRESS 0xd000892f BIT_MASK 0x1 /end MEASUREMENT
/begin MEASUREMENT lv_rgn_agi_vld[0] "flag used for communication with aging function" UBYTE _CNV_S_2_RANGE__0___1_CM 1 100. 0. 1. DISPLAY_IDENTIFIER LV_RGN_AGI_VLD[1] ECU_ADDRESS 0xd0008930 BIT_MASK 0x1 /end MEASUREMENT
/begin MEASUREMENT lv_rgn_agi_vld[1] "flag used for communication with aging function" UBYTE _CNV_S_2_RANGE__0___1_CM 1 100. 0. 1. DISPLAY_IDENTIFIER LV_RGN_AGI_VLD[2] ECU_ADDRESS 0xd0008931 BIT_MASK 0x1 /end MEASUREMENT
/begin MEASUREMENT lv_rgn_req_nox_sens_tmp[0] "bench selective regeneration request caused by the NOx sensor signal" UBYTE _CNV_S_2_RANGE__0___1_CM 1 100. 0. 1. DISPLAY_IDENTIFIER LV_RGN_REQ_NOX_SENS_TMP[1] ECU_ADDRESS 0xd0008932 BIT_MASK 0x1 /end MEASUREMENT
/begin MEASUREMENT lv_rgn_req_nox_sens_tmp[1] "bench selective regeneration request caused by the NOx sensor signal" UBYTE _CNV_S_2_RANGE__0___1_CM 1 100. 0. 1. DISPLAY_IDENTIFIER LV_RGN_REQ_NOX_SENS_TMP[2] ECU_ADDRESS 0xd0008933 BIT_MASK 0x1 /end MEASUREMENT
/begin MEASUREMENT lv_act_int_puc_afl[0] "request for catalyst purge activation when leaving lean burn condition" UBYTE _CNV_S_2_RANGE__0___1_CM 1 100. 0. 1. DISPLAY_IDENTIFIER LV_ACT_INT_PUC_AFL[1] ECU_ADDRESS 0xd0008934 BIT_MASK 0x1 /end MEASUREMENT
/begin MEASUREMENT lv_act_int_puc_afl[1] "request for catalyst purge activation when leaving lean burn condition" UBYTE _CNV_S_2_RANGE__0___1_CM 1 100. 0. 1. DISPLAY_IDENTIFIER LV_ACT_INT_PUC_AFL[2] ECU_ADDRESS 0xd0008935 BIT_MASK 0x1 /end MEASUREMENT
/begin MEASUREMENT lv_sens_afr[0] "downstream sensor sees rich exhaust gas (stop of regeneration)" UBYTE _CNV_S_2_RANGE__0___1_CM 1 100. 0. 1. DISPLAY_IDENTIFIER LV_SENS_AFR[1] ECU_ADDRESS 0xd0008936 BIT_MASK 0x1 /end MEASUREMENT
/begin MEASUREMENT lv_sens_afr[1] "downstream sensor sees rich exhaust gas (stop of regeneration)" UBYTE _CNV_S_2_RANGE__0___1_CM 1 100. 0. 1. DISPLAY_IDENTIFIER LV_SENS_AFR[2] ECU_ADDRESS 0xd0008937 BIT_MASK 0x1 /end MEASUREMENT
/begin MEASUREMENT lv_sens_afr_trim_tmp[0] "downstream sensor sees rich exhaust gas (homogeneous detection threshold) (bench selective)" UBYTE _CNV_S_2_RANGE__0___1_CM 1 100. 0. 1. DISPLAY_IDENTIFIER LV_SENS_AFR_TRIM_TMP[1] ECU_ADDRESS 0xd0008938 BIT_MASK 0x1 /end MEASUREMENT
/begin MEASUREMENT lv_sens_afr_trim_tmp[1] "downstream sensor sees rich exhaust gas (homogeneous detection threshold) (bench selective)" UBYTE _CNV_S_2_RANGE__0___1_CM 1 100. 0. 1. DISPLAY_IDENTIFIER LV_SENS_AFR_TRIM_TMP[2] ECU_ADDRESS 0xd0008939 BIT_MASK 0x1 /end MEASUREMENT
/begin MEASUREMENT lv_nox_sens_nox_vld_rgn_st[0] "flag: NOx sensor NOx signal validity at the moment the NOx sensor rgn request is set" UBYTE _CNV_S_2_RANGE__0___1_CM 1 100. 0. 1. DISPLAY_IDENTIFIER LV_NOX_SENS_NOX_VLD_RGN_ST[1] ECU_ADDRESS 0xd000893a BIT_MASK 0x1 /end MEASUREMENT
/begin MEASUREMENT lv_nox_sens_nox_vld_rgn_st[1] "flag: NOx sensor NOx signal validity at the moment the NOx sensor rgn request is set" UBYTE _CNV_S_2_RANGE__0___1_CM 1 100. 0. 1. DISPLAY_IDENTIFIER LV_NOX_SENS_NOX_VLD_RGN_ST[2] ECU_ADDRESS 0xd000893b BIT_MASK 0x1 /end MEASUREMENT
/begin MEASUREMENT ntl_dec[0] "decrement of NOx trap absolute NOx loading during regeneration (lack of oxygen)" ULONG _CNV_A_R_LINEAR_____502_CM 1 100. 0. 10485.7599975586 DISPLAY_IDENTIFIER NTL_DEC[1] ECU_ADDRESS 0xd0001574 FORMAT "%12.6" /end MEASUREMENT
/begin MEASUREMENT ntl_dec[1] "decrement of NOx trap absolute NOx loading during regeneration (lack of oxygen)" ULONG _CNV_A_R_LINEAR_____502_CM 1 100. 0. 10485.7599975586 DISPLAY_IDENTIFIER NTL_DEC[2] ECU_ADDRESS 0xd0001578 FORMAT "%12.6" /end MEASUREMENT
/begin MEASUREMENT ntl_dec_int[0] "integral of the lack of oxygen during regeneration phase" UWORD _CNV_A_R_LINEAR_____244_CM 1 100. 0. 10485.6 DISPLAY_IDENTIFIER NTL_DEC_INT[1] ECU_ADDRESS 0xd000a51a FORMAT "%7.1" /end MEASUREMENT
/begin MEASUREMENT ntl_dec_int[1] "integral of the lack of oxygen during regeneration phase" UWORD _CNV_A_R_LINEAR_____244_CM 1 100. 0. 10485.6 DISPLAY_IDENTIFIER NTL_DEC_INT[2] ECU_ADDRESS 0xd000a51c FORMAT "%7.1" /end MEASUREMENT
/begin MEASUREMENT ntl_dec_int_swi[0] "NTL_DEC INT until the downstream sensor switches to rich exhaust gas" UWORD _CNV_A_R_LINEAR_____244_CM 1 100. 0. 10485.6 DISPLAY_IDENTIFIER NTL_DEC_INT_SWI[1] ECU_ADDRESS 0xd000a51e FORMAT "%7.1" /end MEASUREMENT
/begin MEASUREMENT ntl_dec_int_swi[1] "NTL_DEC INT until the downstream sensor switches to rich exhaust gas" UWORD _CNV_A_R_LINEAR_____244_CM 1 100. 0. 10485.6 DISPLAY_IDENTIFIER NTL_DEC_INT_SWI[2] ECU_ADDRESS 0xd000a520 FORMAT "%7.1" /end MEASUREMENT
/begin AXIS_PTS ldp_lamb_ls_up_mv_ip_o2_stc_max "" 0xa0808804 lamb_mv _REC_AXS_20_u2 31.9990234375 _CNV_A_R_LINEAR_____129_CM 8 0. 31.9990234375 FORMAT "%7.4" /end AXIS_PTS
/begin CHARACTERISTIC c_state_sens_afr[0] "bench selective mode to determine rich exhaust gas downstream NOx trap" VALUE 0xa080c0f2 _REC_VAL_20_u1 4. _CNV_S_5_STATE_SENS_503_CM 0. 4. DISPLAY_IDENTIFIER C_STATE_SENS_AFR[1] /end CHARACTERISTIC
/begin CHARACTERISTIC c_state_sens_afr[1] "bench selective mode to determine rich exhaust gas downstream NOx trap" VALUE 0xa080c0f3 _REC_VAL_20_u1 4. _CNV_S_5_STATE_SENS_503_CM 0. 4. DISPLAY_IDENTIFIER C_STATE_SENS_AFR[2] /end CHARACTERISTIC
/begin CHARACTERISTIC c_state_sens_afr_trim[0] "bench selective mode to determine trim threshold reached by downstream sensor" VALUE 0xa080c0f6 _REC_VAL_20_u1 4. _CNV_S_5_STATE_SENS_503_CM 0. 4. DISPLAY_IDENTIFIER C_STATE_SENS_AFR_TRIM[1] /end CHARACTERISTIC
/begin CHARACTERISTIC c_state_sens_afr_trim[1] "bench selective mode to determine trim threshold reached by downstream sensor" VALUE 0xa080c0f7 _REC_VAL_20_u1 4. _CNV_S_5_STATE_SENS_503_CM 0. 4. DISPLAY_IDENTIFIER C_STATE_SENS_AFR_TRIM[2] /end CHARACTERISTIC
/begin MEASUREMENT nox_ns_ad_tmp[0] "temporary internal NOx sensor NOx value for regeneration request calculation" UWORD _CNV_A_R_NOXD_LINEA_486_CM 1 100. 0. 1500. DISPLAY_IDENTIFIER NOX_NS_AD_TMP[1] ECU_ADDRESS 0xd0001564 FORMAT "%4.0" /end MEASUREMENT
/begin MEASUREMENT nox_ns_ad_tmp[1] "temporary internal NOx sensor NOx value for regeneration request calculation" UWORD _CNV_A_R_NOXD_LINEA_486_CM 1 100. 0. 1500. DISPLAY_IDENTIFIER NOX_NS_AD_TMP[2] ECU_ADDRESS 0xd0001566 FORMAT "%4.0" /end MEASUREMENT
/begin MEASUREMENT nox_ns_ad_rgn_st[0] "downstream NOx concentration by NOx sensor at start of regeneration" UWORD _CNV_A_R_NOXD_LINEA_486_CM 1 100. 0. 1500. DISPLAY_IDENTIFIER NOX_NS_AD_RGN_ST[1] ECU_ADDRESS 0xd000a522 FORMAT "%4.0" /end MEASUREMENT
/begin MEASUREMENT nox_ns_ad_rgn_st[1] "downstream NOx concentration by NOx sensor at start of regeneration" UWORD _CNV_A_R_NOXD_LINEA_486_CM 1 100. 0. 1500. DISPLAY_IDENTIFIER NOX_NS_AD_RGN_ST[2] ECU_ADDRESS 0xd000a524 FORMAT "%4.0" /end MEASUREMENT
/begin CHARACTERISTIC c_nox_ns_ad_rgn_stop "linear NOx sensor signal threshold for determining rich trim conditions" VALUE 0xa080bff8 _REC_VAL_20_u2 1500. _CNV_A_R_NOXD_LINEA_486_CM 0. 1500. DISPLAY_IDENTIFIER C_NOX_NS_AD_RGN_STOP FORMAT "%4.0" /end CHARACTERISTIC
/begin CHARACTERISTIC c_nox_ns_ad_dif_mon "Max. deviation between model and NOx sensor" VALUE 0xa080bff6 _REC_VAL_20_u2 1500. _CNV_A_R_NOXD_LINEA_486_CM 0. 1500. DISPLAY_IDENTIFIER C_NOX_NS_AD_DIF_MON FORMAT "%4.0" /end CHARACTERISTIC
/begin CHARACTERISTIC c_t_nt_hom "lean time threshold for resetting the homogeneous time T_NT_HOM" VALUE 0xa080c242 _REC_VAL_20_u2 655.35 _CNV_A_R_LINEAR_____3_CM 0. 655.35 DISPLAY_IDENTIFIER C_T_NT_HOM FORMAT "%6.2" /end CHARACTERISTIC
/begin CHARACTERISTIC c_t_rgn_max_diag "Maximum regeneration duration if sensor test is activated" VALUE 0xa080c26e _REC_VAL_20_u2 655.35 _CNV_A_R_LINEAR_____3_CM 0. 655.35 DISPLAY_IDENTIFIER C_T_RGN_MAX_DIAG FORMAT "%6.2" /end CHARACTERISTIC
/begin MEASUREMENT lv_nt_afs_req "request of lambda = 1 operation mode" UBYTE _CNV_S_2_RANGE__0___1_CM 1 100. 0. 1. DISPLAY_IDENTIFIER LV_NT_AFS_REQ ECU_ADDRESS 0xd0008919 BIT_MASK 0x1 /end MEASUREMENT
/begin MEASUREMENT lv_nt_afs_req_pred "Prediction result for request of homogeneous stoichiometric operation" UBYTE _CNV_S_2_RANGE__0___1_CM 1 100. 0. 1. DISPLAY_IDENTIFIER LV_NT_AFS_REQ_PRED ECU_ADDRESS 0xd00015a4 BIT_MASK 0x1 /end MEASUREMENT
/begin MEASUREMENT t_nt_hom "counting back the minimum homogeneous time for detecting initialised catalyst state" UWORD _CNV_A_R_LINEAR_____3_CM 1 100. 0. 655.35 DISPLAY_IDENTIFIER T_NT_HOM ECU_ADDRESS 0xd0001540 FORMAT "%6.2" /end MEASUREMENT
/begin MEASUREMENT t_nt_afs_req_pred "Duration of active homogeneous stoichiometric operation request due to high predicted NOx raw emissions" UWORD _CNV_A_R_LINEAR_____4_CM 1 100. 0. 6553.5 DISPLAY_IDENTIFIER T_NT_AFS_REQ_PRED ECU_ADDRESS 0xd000155a FORMAT "%6.1" /end MEASUREMENT
/begin MEASUREMENT maf_int_stop "Air mass integral since start of STATE_NOX = STOP is active" UWORD _CNV_A_R_ANOX_LINEA_498_CM 1 100. 0. 1456.333333 DISPLAY_IDENTIFIER MAF_INT_STOP ECU_ADDRESS 0xd0001558 FORMAT "%7.2" /end MEASUREMENT
/begin MEASUREMENT maf_mmv_nox_pred "Filtered mass air flow for reset of AFS request due to high predicted NOx raw emissions" UWORD _CNV_A_R_LINEAR_____111_CM 1 100. 0. 1389. DISPLAY_IDENTIFIER MAF_MMV_NOX_PRED ECU_ADDRESS 0xd000155c FORMAT "%7.2" /end MEASUREMENT
/begin AXIS_PTS ldp_tnt_mdl_mv_ip_nox_red_fac "" 0xa0808ede tnt_mdl_mv _REC_AXS_20_u1 1020. _CNV_A_R_LINEAR_____481_CM 4 0. 1020. FORMAT "%4.0" /end AXIS_PTS
/begin AXIS_PTS ldp_ntld_rgn_st_id_vls_down "" 0xa0808c74 ntld_rgn_st _REC_AXS_20_u2 0.9999847412109381 _CNV_A_R_LINEAR_____89_CM 4 0. 0.9999847412109381 FORMAT "%7.5" /end AXIS_PTS
/begin CHARACTERISTIC ip_nt_eff_bas_ef_close "basic NOx trap efficiency for closed exhaust flap" MAP 0xa0815a4c _REC_MAP_20_u2_u2_u1 0.9999847412109381 _CNV_A_R_LINEAR_____89_CM 0. 0.9999847412109381 DISPLAY_IDENTIFIER IP_NT_EFF_BAS_EF_CLOSE FORMAT "%7.5"
 /begin AXIS_DESCR COM_AXIS ntld _CNV_A_R_LINEAR_____89_CM 8 0. 0.9999847412109381 FORMAT "%7.5" AXIS_PTS_REF ldpm_ntld /end AXIS_DESCR
 /begin AXIS_DESCR COM_AXIS tnt_mdl_mv _CNV_A_R_LINEAR_____481_CM 8 0. 1020. FORMAT "%4.0" AXIS_PTS_REF ldpm_tnt_mdl_nox /end AXIS_DESCR
/end CHARACTERISTIC
/begin CHARACTERISTIC ip_nox_cor_s_afs_req "engine out NOx emission threshold for requesting Lambda = 1.0 operation at stratified operation" MAP 0xa0815864 _REC_MAP_20_u2_u1_u2 1023.984375 _CNV_A_R_LINEAR_____489_CM 0. 1023.984375 DISPLAY_IDENTIFIER IP_NOX_COR_S_AFS_REQ FORMAT "%7.2"
 /begin AXIS_DESCR COM_AXIS tnt_mdl_l _CNV_A_R_LINEAR_____481_CM 8 0. 1020. FORMAT "%4.0" AXIS_PTS_REF ldp_tnt_mdl_l_ip_nox_cor_s /end AXIS_DESCR
 /begin AXIS_DESCR COM_AXIS nt_agi _CNV_A_R_LINEAR_____89_CM 6 0. 0.9999847412109381 FORMAT "%7.5" AXIS_PTS_REF ldp_nt_agi_ip_nox_cor_s /end AXIS_DESCR
/end CHARACTERISTIC
/begin CHARACTERISTIC ip_nox_cor_homs_afs_req "engine out NOx emission threshold for requesting Lambda = 1.0 operation - homogeneous lean prediction" MAP 0xa08157bc _REC_MAP_20_u2_u1_u2 1023.984375 _CNV_A_R_LINEAR_____489_CM 0. 1023.984375 DISPLAY_IDENTIFIER IP_NOX_COR_HOMS_AFS_REQ FORMAT "%7.2"
 /begin AXIS_DESCR COM_AXIS tnt_mdl_l _CNV_A_R_LINEAR_____481_CM 8 0. 1020. FORMAT "%4.0" AXIS_PTS_REF ldp_tnt_mdl_l_ip_nox_cor_homs /end AXIS_DESCR
 /begin AXIS_DESCR COM_AXIS nt_agi _CNV_A_R_LINEAR_____89_CM 6 0. 0.9999847412109381 FORMAT "%7.5" AXIS_PTS_REF ldp_nt_agi_ip_nox_cor_homs /end AXIS_DESCR
/end CHARACTERISTIC
/begin AXIS_PTS ldp_tnt_mdl_l_ip_nox_cor_s "" 0xa0808ec4 tnt_mdl_l _REC_AXS_20_u1 1020. _CNV_A_R_LINEAR_____481_CM 8 0. 1020. FORMAT "%4.0" /end AXIS_PTS
/begin AXIS_PTS ldp_tnt_mdl_l_ip_nox_cor_homs "" 0xa0808eb8 tnt_mdl_l _REC_AXS_20_u1 1020. _CNV_A_R_LINEAR_____481_CM 8 0. 1020. FORMAT "%4.0" /end AXIS_PTS
/begin AXIS_PTS ldp_nt_agi_ip_nox_cor_s "" 0xa0808c18 nt_agi _REC_AXS_20_u2 0.9999847412109381 _CNV_A_R_LINEAR_____89_CM 6 0. 0.9999847412109381 FORMAT "%7.5" /end AXIS_PTS
/begin AXIS_PTS ldp_nt_agi_ip_nox_cor_homs "" 0xa0808c08 nt_agi _REC_AXS_20_u2 0.9999847412109381 _CNV_A_R_LINEAR_____89_CM 6 0. 0.9999847412109381 FORMAT "%7.5" /end AXIS_PTS
/begin CHARACTERISTIC ip_nox_cor_s_afs_req_hys "NOx emission hysteresis for reset of Lambda = 1.0 operation request - stratified prediction" MAP 0xa08158c4 _REC_MAP_20_u2_u1_u2 2047.96875 _CNV_A_R_LINEAR_____504_CM -1024. 1023.96875 DISPLAY_IDENTIFIER IP_NOX_COR_S_AFS_REQ_HYS FORMAT "%11.5"
 /begin AXIS_DESCR COM_AXIS n_32 _CNV_A_R_LINEAR_____10_CM 6 0. 8160. FORMAT "%4.0" AXIS_PTS_REF ldp_n_32_ip_nox_cor_s_hys /end AXIS_DESCR
 /begin AXIS_DESCR COM_AXIS maf_mmv_nox_pred _CNV_A_R_LINEAR_____111_CM 6 0. 1389. FORMAT "%7.2" AXIS_PTS_REF ldp_maf_mmv_nox_pred_ip_nox_s /end AXIS_DESCR
/end CHARACTERISTIC
/begin CHARACTERISTIC ip_nox_cor_homs_afs_req_hys "NOx emission hysteresis for reset of Lambda = 1.0 operation request - homogeneous lean prediction" MAP 0xa081581c _REC_MAP_20_u2_u1_u2 2047.96875 _CNV_A_R_LINEAR_____504_CM -1024. 1023.96875 DISPLAY_IDENTIFIER IP_NOX_COR_HOMS_AFS_REQ_HYS FORMAT "%11.5"
 /begin AXIS_DESCR COM_AXIS n_32 _CNV_A_R_LINEAR_____10_CM 6 0. 8160. FORMAT "%4.0" AXIS_PTS_REF ldp_n_32_ip_nox_cor_homs_hys /end AXIS_DESCR
 /begin AXIS_DESCR COM_AXIS maf_mmv_nox_pred _CNV_A_R_LINEAR_____111_CM 6 0. 1389. FORMAT "%7.2" AXIS_PTS_REF ldp_maf_mmv_nox_pred_ip_nox_hom /end AXIS_DESCR
/end CHARACTERISTIC
/begin AXIS_PTS ldp_maf_mmv_nox_pred_ip_nox_s "" 0xa08088e4 maf_mmv_nox_pred _REC_AXS_20_u2 1389. _CNV_A_R_LINEAR_____111_CM 6 0. 1389. FORMAT "%7.2" /end AXIS_PTS
/begin AXIS_PTS ldp_maf_mmv_nox_pred_ip_nox_hom "" 0xa08088d4 maf_mmv_nox_pred _REC_AXS_20_u2 1389. _CNV_A_R_LINEAR_____111_CM 6 0. 1389. FORMAT "%7.2" /end AXIS_PTS
/begin CHARACTERISTIC c_sum_ntl_cyc_sp "NOx trap regeneration cycle counter initialisation value" VALUE 0xa080c106 _REC_VAL_20_u2 65535. _CNV_A_R_LINEAR_____0_CM 0. 65535. DISPLAY_IDENTIFIER C_SUM_NTL_CYC_SP FORMAT "%5.0" /end CHARACTERISTIC
/begin CHARACTERISTIC c_t_nt_afs_req_pred_max "Maximum duration of of active AFS request due to high predicted NOx row emissions" VALUE 0xa080c240 _REC_VAL_20_u2 6553.5 _CNV_A_R_LINEAR_____4_CM 0. 6553.5 DISPLAY_IDENTIFIER C_T_NT_AFS_REQ_PRED_MAX FORMAT "%6.1" /end CHARACTERISTIC
/begin CHARACTERISTIC c_crlc_maf_mmv_nox_pred "Correlation constant for calculation of filtered mass air flow" VALUE 0xa080baf6 _REC_VAL_20_u2 0.9999847412109381 _CNV_A_R_LINEAR_____89_CM 0. 0.9999847412109381 DISPLAY_IDENTIFIER C_CRLC_MAF_MMV_NOX_PRED FORMAT "%7.5" /end CHARACTERISTIC
/begin MEASUREMENT nt_agi "NOx trap aging factor" UWORD _CNV_A_R_LINEAR_____89_CM 1 100. 0. 0.9999847412109381 DISPLAY_IDENTIFIER NT_AGI ECU_ADDRESS 0xd00071e4 FORMAT "%7.5" /end MEASUREMENT
/begin MEASUREMENT nt_agi_sul "NOx trap aging factor due to sulphor load" UWORD _CNV_A_R_LINEAR_____89_CM 1 100. 0. 0.9999847412109381 DISPLAY_IDENTIFIER NT_AGI_SUL ECU_ADDRESS 0xd00071f0 FORMAT "%7.5" /end MEASUREMENT
/begin MEASUREMENT nt_agi_thermo "NOx trap aging factor due to thermal aging" UWORD _CNV_A_R_LINEAR_____89_CM 1 100. 0. 0.9999847412109381 DISPLAY_IDENTIFIER NT_AGI_THERMO ECU_ADDRESS 0xd00071f2 FORMAT "%7.5" /end MEASUREMENT
/begin MEASUREMENT nt_agi_ntld "NOx trap aging factor" UWORD _CNV_A_R_LINEAR_____89_CM 1 100. 0. 0.9999847412109381 DISPLAY_IDENTIFIER NT_AGI_NTLD ECU_ADDRESS 0xd00071e6 FORMAT "%7.5" /end MEASUREMENT
/begin MEASUREMENT nt_agi_s_red "NOx trap aging factor" UWORD _CNV_A_R_LINEAR_____89_CM 1 100. 0. 0.9999847412109381 DISPLAY_IDENTIFIER NT_AGI_S_RED ECU_ADDRESS 0xd00071ee FORMAT "%7.5" /end MEASUREMENT
/begin MEASUREMENT nt_agi_obs "quick aging monitoring value" UWORD _CNV_A_R_LINEAR_____89_CM 1 100. 0. 0.9999847412109381 DISPLAY_IDENTIFIER NT_AGI_OBS ECU_ADDRESS 0xd00071e8 FORMAT "%7.5" /end MEASUREMENT
/begin MEASUREMENT nt_sul_agi "interface variable for update of sulphur release model by aging function" UWORD _CNV_A_R_LINEAR_____244_CM 1 100. 0. 10485.6 DISPLAY_IDENTIFIER NT_SUL_AGI ECU_ADDRESS 0xd00071fc FORMAT "%7.1" /end MEASUREMENT
/begin MEASUREMENT nt_sul_upd "interface variable for update of sulphur model by aging function" UWORD _CNV_A_R_LINEAR_____244_CM 1 100. 0. 10485.6 DISPLAY_IDENTIFIER NT_SUL_UPD ECU_ADDRESS 0xd0007208 FORMAT "%7.1" /end MEASUREMENT
/begin MEASUREMENT lv_nt_afs_req_agi "logical value for the request of lambda = 1 operation " UBYTE _CNV_S_2_RANGE__0___1_CM 1 100. 0. 1. DISPLAY_IDENTIFIER LV_NT_AFS_REQ_AGI ECU_ADDRESS 0xd0007741 BIT_MASK 0x1 /end MEASUREMENT
/begin MEASUREMENT lv_agi_ad_trig "Logical value for the request of adaptation of aging factor" UBYTE _CNV_S_2_RANGE__0___1_CM 1 100. 0. 1. DISPLAY_IDENTIFIER LV_AGI_AD_TRIG ECU_ADDRESS 0xd00036e8 BIT_MASK 0x1 /end MEASUREMENT
/begin MEASUREMENT lv_so2p_req_1 "request of a desulfation " UBYTE _CNV_S_2_RANGE__0___1_CM 1 100. 0. 1. DISPLAY_IDENTIFIER LV_SO2P_REQ_1 ECU_ADDRESS 0xd0007754 BIT_MASK 0x1 /end MEASUREMENT
/begin MEASUREMENT lv_so2p_req_2 "request of a desulfation (forces catalyst heating)" UBYTE _CNV_S_2_RANGE__0___1_CM 1 100. 0. 1. DISPLAY_IDENTIFIER LV_SO2P_REQ_2 ECU_ADDRESS 0xd0007755 BIT_MASK 0x1 /end MEASUREMENT
/begin MEASUREMENT lv_cdn_nt_agi_thermo_ad "flag: thermal aging adaption enabled (due to low sulphur load)" UBYTE _CNV_S_2_RANGE__0___1_CM 1 100. 0. 1. DISPLAY_IDENTIFIER LV_CDN_NT_AGI_THERMO_AD ECU_ADDRESS 0xd0007739 BIT_MASK 0x1 /end MEASUREMENT
/begin MEASUREMENT lv_agi_vld "Logical value for completed aging adaptation" UBYTE _CNV_S_2_RANGE__0___1_CM 1 100. 0. 1. DISPLAY_IDENTIFIER LV_AGI_VLD ECU_ADDRESS 0xd0007738 BIT_MASK 0x1 /end MEASUREMENT
/begin MEASUREMENT lv_nt_agi_bas_ena "basic aging factor calculation enabled" UBYTE _CNV_S_2_RANGE__0___1_CM 1 100. 0. 1. DISPLAY_IDENTIFIER LV_NT_AGI_BAS_ENA ECU_ADDRESS 0xd00036ed BIT_MASK 0x1 /end MEASUREMENT
/begin MEASUREMENT lv_nt_agi_ena_tmp "temporary value for LV_NT_AGI_ENA calculation" UBYTE _CNV_S_2_RANGE__0___1_CM 1 100. 0. 1. DISPLAY_IDENTIFIER LV_NT_AGI_ENA_TMP ECU_ADDRESS 0xd00036ee BIT_MASK 0x1 /end MEASUREMENT
/begin MEASUREMENT lv_nt_agi_ena "aging factor (sulphor or thermal) calculation enabled" UBYTE _CNV_S_2_RANGE__0___1_CM 1 100. 0. 1. DISPLAY_IDENTIFIER LV_NT_AGI_ENA ECU_ADDRESS 0xd0007743 BIT_MASK 0x1 /end MEASUREMENT
/begin MEASUREMENT lv_nt_agi_ena_tnt "temperature initialisation condition for aging adaptation given" UBYTE _CNV_S_2_RANGE__0___1_CM 1 100. 0. 1. DISPLAY_IDENTIFIER LV_NT_AGI_ENA_TNT ECU_ADDRESS 0xd00036ef BIT_MASK 0x1 /end MEASUREMENT
/begin MEASUREMENT lv_nt_agi_ena_afs "value for HOM_REQ before aging adaptation" UBYTE _CNV_S_2_RANGE__0___1_CM 1 100. 0. 1. DISPLAY_IDENTIFIER LV_NT_AGI_ENA_AFS ECU_ADDRESS 0xd0007744 BIT_MASK 0x1 /end MEASUREMENT
/begin MEASUREMENT lv_nt_agi_ena_afs_tmp "temporary value for HOM_REQ before aging adaptation" UBYTE _CNV_S_2_RANGE__0___1_CM 1 100. 0. 1. DISPLAY_IDENTIFIER LV_NT_AGI_ENA_AFS_TMP ECU_ADDRESS 0xd0007745 BIT_MASK 0x1 /end MEASUREMENT
/begin MEASUREMENT lv_egr_ratio_sp_agi_act "request to close EGR valve for better NT aging adaptation performance" UBYTE _CNV_S_2_RANGE__0___1_CM 1 100. 0. 1. DISPLAY_IDENTIFIER LV_EGR_RATIO_SP_AGI_ACT ECU_ADDRESS 0xd000773a BIT_MASK 0x1 /end MEASUREMENT
/begin MEASUREMENT ctr_nt_agi_ad "counter of aging adaptations attempts (with closed EGR valve)" UBYTE _CNV_A_R_LINEAR_____0_CM 1 100. 0. 255. DISPLAY_IDENTIFIER CTR_NT_AGI_AD ECU_ADDRESS 0xd00036e4 FORMAT "%3.0" /end MEASUREMENT
/begin MEASUREMENT ctr_nt_agi_ad_cmpl "counter of completed aging adaptation cycles during driving cycle" UBYTE _CNV_A_R_LINEAR_____0_CM 1 100. 0. 255. DISPLAY_IDENTIFIER CTR_NT_AGI_AD_CMPL ECU_ADDRESS 0xd0007730 FORMAT "%3.0" /end MEASUREMENT
/begin MEASUREMENT ctr_nt_agi_ad_cmpl_sum "counter of completed aging adaptations" UWORD _CNV_A_R_LINEAR_____0_CM 1 100. 0. 65535. DISPLAY_IDENTIFIER CTR_NT_AGI_AD_CMPL_SUM ECU_ADDRESS 0xd00071d8 FORMAT "%5.0" /end MEASUREMENT
/begin CHARACTERISTIC c_nt_agi_1 "NOx trap aging factor threshold for the desulfation request 1" VALUE 0xa0807f0e _REC_VAL_20_u2 0.9999847412109381 _CNV_A_R_LINEAR_____89_CM 0. 0.9999847412109381 DISPLAY_IDENTIFIER C_NT_AGI_1 FORMAT "%7.5" /end CHARACTERISTIC
/begin CHARACTERISTIC c_nt_agi_2 "NOx trap aging factor threshold for the desulfation request 2" VALUE 0xa0807f10 _REC_VAL_20_u2 0.9999847412109381 _CNV_A_R_LINEAR_____89_CM 0. 0.9999847412109381 DISPLAY_IDENTIFIER C_NT_AGI_2 FORMAT "%7.5" /end CHARACTERISTIC
/begin CHARACTERISTIC c_nt_agi_3 "NOx trap aging factor threshold for the request of lambda = 1 operation" VALUE 0xa0807f12 _REC_VAL_20_u2 0.9999847412109381 _CNV_A_R_LINEAR_____89_CM 0. 0.9999847412109381 DISPLAY_IDENTIFIER C_NT_AGI_3 FORMAT "%7.5" /end CHARACTERISTIC
/begin CHARACTERISTIC c_nt_agi_ntld_man "Manual set of NT_AGI_NTLD" VALUE 0xa0807f18 _REC_VAL_20_u2 0.9999847412109381 _CNV_A_R_LINEAR_____89_CM 0. 0.9999847412109381 DISPLAY_IDENTIFIER C_NT_AGI_NTLD_MAN FORMAT "%7.5" /end CHARACTERISTIC
/begin CHARACTERISTIC c_nt_agi_s_red_man "Manual set of NT_AGI_S_RED" VALUE 0xa0807f22 _REC_VAL_20_u2 0.9999847412109381 _CNV_A_R_LINEAR_____89_CM 0. 0.9999847412109381 DISPLAY_IDENTIFIER C_NT_AGI_S_RED_MAN FORMAT "%7.5" /end CHARACTERISTIC
/begin CHARACTERISTIC c_nt_agi_obs_min "aging monitoring minimum threshold to request of lambda=1 operation" VALUE 0xa0807f1a _REC_VAL_20_u2 0.9999847412109381 _CNV_A_R_LINEAR_____89_CM 0. 0.9999847412109381 DISPLAY_IDENTIFIER C_NT_AGI_OBS_MIN FORMAT "%7.5" /end CHARACTERISTIC
/begin CHARACTERISTIC c_nt_agi_obs_min_is "aging monitoring minimum threshold to request of lambda=1 operation during idle speed" VALUE 0xa0807f20 _REC_VAL_20_u2 0.9999847412109381 _CNV_A_R_LINEAR_____89_CM 0. 0.9999847412109381 DISPLAY_IDENTIFIER C_NT_AGI_OBS_MIN_IS FORMAT "%7.5" /end CHARACTERISTIC
/begin CHARACTERISTIC c_crlc_nt_agi_thermo_inc "correlation constant for the calculation of the aging factor (increasing factor)" VALUE 0xa0807ee8 _REC_VAL_20_u2 0.9999847412109381 _CNV_A_R_LINEAR_____89_CM 0. 0.9999847412109381 DISPLAY_IDENTIFIER C_CRLC_NT_AGI_THERMO_INC FORMAT "%7.5" /end CHARACTERISTIC
/begin CHARACTERISTIC c_crlc_nt_agi_thermo_dec "correlation constant for the calculation of the aging factor (decreasing factor)" VALUE 0xa0807ee6 _REC_VAL_20_u2 0.9999847412109381 _CNV_A_R_LINEAR_____89_CM 0. 0.9999847412109381 DISPLAY_IDENTIFIER C_CRLC_NT_AGI_THERMO_DEC FORMAT "%7.5" /end CHARACTERISTIC
/begin CHARACTERISTIC c_crlc_nt_agi_sul "correlation constant for the calculation of the aging factor due to sulphur load" VALUE 0xa0807ee4 _REC_VAL_20_u2 0.9999847412109381 _CNV_A_R_LINEAR_____89_CM 0. 0.9999847412109381 DISPLAY_IDENTIFIER C_CRLC_NT_AGI_SUL FORMAT "%7.5" /end CHARACTERISTIC
/begin CHARACTERISTIC c_crlc_nt_agi_obs "filter constant for NT_AGI_OBS calculation" VALUE 0xa0807ee2 _REC_VAL_20_u2 0.9999847412109381 _CNV_A_R_LINEAR_____89_CM 0. 0.9999847412109381 DISPLAY_IDENTIFIER C_CRLC_NT_AGI_OBS FORMAT "%7.5" /end CHARACTERISTIC
/begin CHARACTERISTIC c_nt_sul_max_1 "sulphor model threshold to request set desulfation request 1" VALUE 0xa0807f2c _REC_VAL_20_u2 10485.6 _CNV_A_R_LINEAR_____244_CM 0. 10485.6 DISPLAY_IDENTIFIER C_NT_SUL_MAX_1 FORMAT "%7.1" /end CHARACTERISTIC
/begin CHARACTERISTIC c_sul_thd_agi_thermo "threshold for reset of thermal aging adaptation / SUL no more neglectable" VALUE 0xa0807f3e _REC_VAL_20_u2 10485.6 _CNV_A_R_LINEAR_____244_CM 0. 10485.6 DISPLAY_IDENTIFIER C_SUL_THD_AGI_THERMO FORMAT "%7.1" /end CHARACTERISTIC
/begin CHARACTERISTIC c_nt_sul_ext_adj "sulphor load initialisation value by scan tool" VALUE 0xa0807f28 _REC_VAL_20_u2 10485.6 _CNV_A_R_LINEAR_____244_CM 0. 10485.6 DISPLAY_IDENTIFIER C_NT_SUL_EXT_ADJ FORMAT "%7.1" /end CHARACTERISTIC
/begin CHARACTERISTIC c_ctr_nt_agi_ad_max "max. number of attemps for adaptation (incl. successful attempts)" VALUE 0xa0807ef1 _REC_VAL_20_u1 255. _CNV_A_R_LINEAR_____0_CM 0. 255. DISPLAY_IDENTIFIER C_CTR_NT_AGI_AD_MAX FORMAT "%3.0" /end CHARACTERISTIC
/begin CHARACTERISTIC c_ctr_nt_agi_ad_cmpl_max "max. number of successful adaptations per cycle" VALUE 0xa0807ef0 _REC_VAL_20_u1 255. _CNV_A_R_LINEAR_____0_CM 0. 255. DISPLAY_IDENTIFIER C_CTR_NT_AGI_AD_CMPL_MAX FORMAT "%3.0" /end CHARACTERISTIC
/begin CHARACTERISTIC c_nox_ppm_min_agi "min. NOx sensor signal threshold for enabling an aging adaptation" VALUE 0xa0807f0c _REC_VAL_20_u2 1500. _CNV_A_R_NOXD_LINEA_486_CM 0. 1500. DISPLAY_IDENTIFIER C_NOX_PPM_MIN_AGI FORMAT "%4.0" /end CHARACTERISTIC
/begin CHARACTERISTIC c_tnt_mdl_nt_agi_obs_ini "threshold for setting the quick aging monitoring values" VALUE 0xa0807f52 _REC_VAL_20_u1 1020. _CNV_A_R_LINEAR_____481_CM 0. 1020. DISPLAY_IDENTIFIER C_TNT_MDL_NT_AGI_OBS_INI FORMAT "%4.0" /end CHARACTERISTIC
/begin CHARACTERISTIC c_tnt_mdl_agi_ena_tnt "threshold for temperature initialisation condition" VALUE 0xa0807f4b _REC_VAL_20_u1 1020. _CNV_A_R_LINEAR_____481_CM 0. 1020. DISPLAY_IDENTIFIER C_TNT_MDL_AGI_ENA_TNT FORMAT "%4.0" /end CHARACTERISTIC
/begin CHARACTERISTIC c_t_afl_max_agi_ena "maximum lean phase time without aging enabling bit yet set" VALUE 0xa0807f40 _REC_VAL_20_u2 1310.7 _CNV_A_R_LINEAR_____110_CM 0. 1310.7 DISPLAY_IDENTIFIER C_T_AFL_MAX_AGI_ENA FORMAT "%7.2" /end CHARACTERISTIC
/begin CHARACTERISTIC c_vs_obs_min "vehicle speed threshold to switch aging monitoring" VALUE 0xa0807f66 _REC_VAL_20_u1 255. _CNV_A_R_LINEAR_____6_CM 0. 255. DISPLAY_IDENTIFIER C_VS_OBS_MIN FORMAT "%3.0" /end CHARACTERISTIC
/begin CHARACTERISTIC lc_nt_agi_ini_man "Manual reset of the logical variables for desulfation" VALUE 0xa0807f70 _REC_VAL_20_u1 1. _CNV_A_R_LINEAR_____0_CM 0. 1. DISPLAY_IDENTIFIER LC_NT_AGI_INI_MAN FORMAT "%1.0" /end CHARACTERISTIC
/begin CHARACTERISTIC lc_nt_agi_man "Logical constant for manual switch of aging factor determination" VALUE 0xa0807f71 _REC_VAL_20_u1 1. _CNV_A_R_LINEAR_____0_CM 0. 1. DISPLAY_IDENTIFIER LC_NT_AGI_MAN FORMAT "%1.0" /end CHARACTERISTIC
/begin CHARACTERISTIC lc_nt_agi_sul_ini "NOx trap aging factor due sulphur load initializing value (branch selective)" VALUE 0xa0807f75 _REC_VAL_20_u1 1. _CNV_A_R_LINEAR_____0_CM 0. 1. DISPLAY_IDENTIFIER LC_NT_AGI_SUL_INI FORMAT "%1.0" /end CHARACTERISTIC
/begin CHARACTERISTIC lc_nt_agi_thermo_ini "NOx trap aging factor due thermo aging initializing value (branch selective)" VALUE 0xa0807f76 _REC_VAL_20_u1 1. _CNV_A_R_LINEAR_____0_CM 0. 1. DISPLAY_IDENTIFIER LC_NT_AGI_THERMO_INI FORMAT "%1.0" /end CHARACTERISTIC
/begin CHARACTERISTIC lc_agi_ad_trig_man "Manual trigger for starting aging adaptation" VALUE 0xa0807f68 _REC_VAL_20_u1 1. _CNV_A_R_LINEAR_____0_CM 0. 1. DISPLAY_IDENTIFIER LC_AGI_AD_TRIG_MAN FORMAT "%1.0" /end CHARACTERISTIC
/begin CHARACTERISTIC lc_sul_thermo_cor "Logical constant for switching between absolut and relativ NT_SUL" VALUE 0xa0807f7a _REC_VAL_20_u1 1. _CNV_A_R_LINEAR_____0_CM 0. 1. DISPLAY_IDENTIFIER LC_SUL_THERMO_COR FORMAT "%1.0" /end CHARACTERISTIC
/begin CHARACTERISTIC lc_ena_sul_upd "Logical constant to enable adaptation between sulphur modell and aging factor determination" VALUE 0xa0807f69 _REC_VAL_20_u1 1. _CNV_A_R_LINEAR_____0_CM 0. 1. DISPLAY_IDENTIFIER LC_ENA_SUL_UPD FORMAT "%1.0" /end CHARACTERISTIC
/begin CHARACTERISTIC lc_sul_upd "Logical constant to enable calibration of NT_AGI_SUL with sulphur modell" VALUE 0xa0807f7b _REC_VAL_20_u1 1. _CNV_A_R_LINEAR_____0_CM 0. 1. DISPLAY_IDENTIFIER LC_SUL_UPD FORMAT "%1.0" /end CHARACTERISTIC
/begin CHARACTERISTIC lc_nt_agi_nt_sul_mpg "Logical constant to enable calibration of NT_SUL with aging determination" VALUE 0xa0807f73 _REC_VAL_20_u1 1. _CNV_A_R_LINEAR_____0_CM 0. 1. DISPLAY_IDENTIFIER LC_NT_AGI_NT_SUL_MPG FORMAT "%1.0" /end CHARACTERISTIC
/begin CHARACTERISTIC lc_nt_agi_min "Logical constant for selecting NT_AGI" VALUE 0xa0807f72 _REC_VAL_20_u1 1. _CNV_A_R_LINEAR_____0_CM 0. 1. DISPLAY_IDENTIFIER LC_NT_AGI_MIN FORMAT "%1.0" /end CHARACTERISTIC
/begin CHARACTERISTIC lc_nt_agi_egr_close "switch: close EGR during aging adaptation" VALUE 0xa0807f6f _REC_VAL_20_u1 1. _CNV_A_R_LINEAR_____0_CM 0. 1. DISPLAY_IDENTIFIER LC_NT_AGI_EGR_CLOSE FORMAT "%1.0" /end CHARACTERISTIC
/begin CHARACTERISTIC lc_nt_agi_obs_ini "switch for manual initialisation of quick aging monitoring values" VALUE 0xa0807f74 _REC_VAL_20_u1 1. _CNV_A_R_LINEAR_____0_CM 0. 1. DISPLAY_IDENTIFIER LC_NT_AGI_OBS_INI FORMAT "%1.0" /end CHARACTERISTIC
/begin CHARACTERISTIC lc_nt_agi_ad_ctr_rst_tnt "switch for resetting the adaptation cycle counters depending on NT temperature" VALUE 0xa0807f6e _REC_VAL_20_u1 1. _CNV_A_R_LINEAR_____0_CM 0. 1. DISPLAY_IDENTIFIER LC_NT_AGI_AD_CTR_RST_TNT FORMAT "%1.0" /end CHARACTERISTIC
/begin CHARACTERISTIC lc_nox_ad_cmpl_off "switch to ignore NOx raw emission adaptation" VALUE 0xa0807f6c _REC_VAL_20_u1 1. _CNV_A_R_LINEAR_____0_CM 0. 1. DISPLAY_IDENTIFIER LC_NOX_AD_CMPL_OFF FORMAT "%1.0" /end CHARACTERISTIC
/begin CHARACTERISTIC c_state_nt_agi_ntld "Mode to switch NT_AGI_NTLD." VALUE 0xa0807f35 _REC_VAL_20_u1 3. _CNV_S_4_NOXM_STATE_505_CM 0. 3. DISPLAY_IDENTIFIER C_STATE_NT_AGI_NTLD /end CHARACTERISTIC
/begin CHARACTERISTIC c_state_nt_agi_s_red "Mode to switch NT_AGI_S_RED" VALUE 0xa0807f36 _REC_VAL_20_u1 3. _CNV_S_4_NOXM_STATE_505_CM 0. 3. DISPLAY_IDENTIFIER C_STATE_NT_AGI_S_RED /end CHARACTERISTIC
/begin AXIS_PTS ldp_nt_sul_ip_nt_agi_nt_sul "" 0xa0807ae0 nt_sul _REC_AXS_20_u2 10485.6 _CNV_A_R_LINEAR_____244_CM 6 0. 10485.6 FORMAT "%7.1" /end AXIS_PTS
/begin AXIS_PTS ldp_nt_agi_sul_ip_nt_sul_nt_agi "" 0xa0807ac0 nt_agi_sul _REC_AXS_20_u2 0.9999847412109381 _CNV_A_R_LINEAR_____89_CM 6 0. 0.9999847412109381 FORMAT "%7.5" /end AXIS_PTS
/begin CHARACTERISTIC ip_ntld_agi "NOx trap loading degree, has to be invers to IP_NT_EFF_BAS" MAP 0xa081337c _REC_MAP_20_u2_u2_u2 0.9999847412109381 _CNV_A_R_LINEAR_____89_CM 0. 0.9999847412109381 DISPLAY_IDENTIFIER IP_NTLD_AGI FORMAT "%7.5"
 /begin AXIS_DESCR COM_AXIS nox_eff[0] _CNV_A_R_LINEAR_____89_CM 8 0. 0.9999847412109381 FORMAT "%7.5" AXIS_PTS_REF ldpm_nox_eff /end AXIS_DESCR
 /begin AXIS_DESCR COM_AXIS tnt_mdl_mv _CNV_A_R_LINEAR_____209_CM 8 0. 1023.984375 FORMAT "%7.2" AXIS_PTS_REF ldpm_tnt_mdl_nox_nt /end AXIS_DESCR
/end CHARACTERISTIC
/begin CHARACTERISTIC ip_nt_agi_nt_sul "Correlation sulphur loading - aging factor due to sulphur load" CURVE 0xa0807e20 _REC_CUR_20_u2_u2 0.9999847412109381 _CNV_A_R_LINEAR_____89_CM 0. 0.9999847412109381 DISPLAY_IDENTIFIER IP_NT_AGI_NT_SUL FORMAT "%7.5"
 /begin AXIS_DESCR COM_AXIS nt_sul _CNV_A_R_LINEAR_____244_CM 6 0. 10485.6 FORMAT "%7.1" AXIS_PTS_REF ldp_nt_sul_ip_nt_agi_nt_sul /end AXIS_DESCR
/end CHARACTERISTIC
/begin CHARACTERISTIC ip_nt_sul_nt_agi "Correlation aging factor due to sulphur load - sulphur loading" CURVE 0xa0807e94 _REC_CUR_20_u2_u2 10485.6 _CNV_A_R_LINEAR_____244_CM 0. 10485.6 DISPLAY_IDENTIFIER IP_NT_SUL_NT_AGI FORMAT "%7.1"
 /begin AXIS_DESCR COM_AXIS nt_agi_sul _CNV_A_R_LINEAR_____89_CM 6 0. 0.9999847412109381 FORMAT "%7.5" AXIS_PTS_REF ldp_nt_agi_sul_ip_nt_sul_nt_agi /end AXIS_DESCR
/end CHARACTERISTIC
/begin CHARACTERISTIC ip_nt_sul_h_min "NOx trap sulphur loading threshold (for high sulphured fuel) for desulfation request 2" CURVE 0xa0807e58 _REC_CUR_20_u2_u2 10485.6 _CNV_A_R_LINEAR_____244_CM 0. 10485.6 DISPLAY_IDENTIFIER IP_NT_SUL_H_MIN FORMAT "%7.1"
 /begin AXIS_DESCR COM_AXIS nt_agi_thermo _CNV_A_R_LINEAR_____89_CM 6 0. 0.9999847412109381 FORMAT "%7.5" AXIS_PTS_REF ldpm_nt_agi_thermo /end AXIS_DESCR
/end CHARACTERISTIC
/begin MEASUREMENT lv_so2p_req_fq "logical value for active FQ adaption" UBYTE _CNV_S_2_RANGE__0___1_CM 1 100. 0. 1. DISPLAY_IDENTIFIER LV_SO2P_REQ_FQ ECU_ADDRESS 0xd0007756 BIT_MASK 0x1 /end MEASUREMENT
/begin MEASUREMENT fac_su_conc_fuel "Interface factor to sulphur model for calibration fuel sulphur concentration" UBYTE _CNV_A_R_LINEAR_____0_CM 1 100. 0. 255. DISPLAY_IDENTIFIER FAC_SU_CONC_FUEL ECU_ADDRESS 0xd0007731 FORMAT "%3.0" /end MEASUREMENT
/begin MEASUREMENT lv_nt_afs_req_agi_tmp_3 "logical value for the request of lambda =1 operation" UBYTE _CNV_S_2_RANGE__0___1_CM 1 100. 0. 1. DISPLAY_IDENTIFIER LV_NT_AFS_REQ_AGI_TMP_3 ECU_ADDRESS 0xd0007742 BIT_MASK 0x1 /end MEASUREMENT
/begin MEASUREMENT lv_nt_afs_req_agi_tmp_2 "logical value for the request of lambda =1 operation" UBYTE _CNV_S_2_RANGE__0___1_CM 1 100. 0. 1. DISPLAY_IDENTIFIER LV_NT_AFS_REQ_AGI_TMP_2 ECU_ADDRESS 0xd00036ec BIT_MASK 0x1 /end MEASUREMENT
/begin MEASUREMENT lv_nt_afs_req_agi_tmp_1 "logical value for the request of lambda =1 operation" UBYTE _CNV_S_2_RANGE__0___1_CM 1 100. 0. 1. DISPLAY_IDENTIFIER LV_NT_AFS_REQ_AGI_TMP_1 ECU_ADDRESS 0xd00036eb BIT_MASK 0x1 /end MEASUREMENT
/begin MEASUREMENT ctr_nt_agi_so2p_fq "counter of completed aging adaptation during FQ adaption" UWORD _CNV_A_R_LINEAR_____0_CM 1 100. 0. 65535. DISPLAY_IDENTIFIER CTR_NT_AGI_SO2P_FQ ECU_ADDRESS 0xd00071da FORMAT "%5.0" /end MEASUREMENT
/begin MEASUREMENT dif_ctr_nt_agi_cmpl_sum "completed aging adaptation due to FQ adaption" UWORD _CNV_A_R_LINEAR_____0_CM 1 100. 0. 65535. DISPLAY_IDENTIFIER DIF_CTR_NT_AGI_CMPL_SUM ECU_ADDRESS 0xd0003686 FORMAT "%5.0" /end MEASUREMENT
/begin MEASUREMENT nt_agi_so2p_fq "NOx trap aging factor" UWORD _CNV_A_R_LINEAR_____89_CM 1 100. 0. 0.9999847412109381 DISPLAY_IDENTIFIER NT_AGI_SO2P_FQ ECU_ADDRESS 0xd000369c FORMAT "%7.5" /end MEASUREMENT
/begin MEASUREMENT nt_agi_so2p_fq_sum "sum of NOx trap aging factor during FQ adaption" ULONG _CNV_A_R_NOXM_LINEA_506_CM 1 100. 0. 255.999985 DISPLAY_IDENTIFIER NT_AGI_SO2P_FQ_SUM ECU_ADDRESS 0xd0006390 FORMAT "%9.5" /end MEASUREMENT
/begin AXIS_PTS ldpm_nox_eff "" 0xa0807bdc nox_eff[0] _REC_AXS_20_u2 0.9999847412109381 _CNV_A_R_LINEAR_____89_CM 8 0. 0.9999847412109381 FORMAT "%7.5" /end AXIS_PTS
/begin AXIS_PTS ldpm_tnt_mdl_nox_nt "" 0xa0807c54 tnt_mdl_mv _REC_AXS_20_u2 1023.984375 _CNV_A_R_LINEAR_____209_CM 8 0. 1023.984375 FORMAT "%7.2" /end AXIS_PTS
/begin AXIS_PTS ldpm_nt_agi_thermo "" 0xa0807bf0 nt_agi_thermo _REC_AXS_20_u2 0.9999847412109381 _CNV_A_R_LINEAR_____89_CM 6 0. 0.9999847412109381 FORMAT "%7.5" /end AXIS_PTS
/begin CHARACTERISTIC c_nt_agi_obs_min_egr_err "aging_monitoring minimum threshold to request I 1 operation if EGR valve stucked close" VALUE 0xa0807f1e _REC_VAL_20_u2 0.9999847412109381 _CNV_A_R_LINEAR_____89_CM 0. 0.9999847412109381 DISPLAY_IDENTIFIER C_NT_AGI_OBS_MIN_EGR_ERR FORMAT "%7.5" /end CHARACTERISTIC
/begin CHARACTERISTIC ip_ntld_agi_ef_close "NOx trap loading degree, has to be inverse to IP_NT_EFF_BAS_EF_CLOSE" MAP 0xa08133fc _REC_MAP_20_u2_u2_u2 0.9999847412109381 _CNV_A_R_LINEAR_____89_CM 0. 0.9999847412109381 DISPLAY_IDENTIFIER IP_NTLD_AGI_EF_CLOSE FORMAT "%7.5"
 /begin AXIS_DESCR COM_AXIS nox_eff[0] _CNV_A_R_LINEAR_____89_CM 8 0. 0.9999847412109381 FORMAT "%7.5" AXIS_PTS_REF ldpm_nox_eff /end AXIS_DESCR
 /begin AXIS_DESCR COM_AXIS tnt_mdl_mv _CNV_A_R_LINEAR_____209_CM 8 0. 1023.984375 FORMAT "%7.2" AXIS_PTS_REF ldpm_tnt_mdl_nox_nt /end AXIS_DESCR
/end CHARACTERISTIC
/begin CHARACTERISTIC ip_nt_sul_max_2_deac "sulphur model threshold to request reset desulfation request 2" CURVE 0xa0807e7c _REC_CUR_20_u2_u2 10485.6 _CNV_A_R_LINEAR_____244_CM 0. 10485.6 DISPLAY_IDENTIFIER IP_NT_SUL_MAX_2_DEAC FORMAT "%7.1"
 /begin AXIS_DESCR COM_AXIS nt_agi_thermo _CNV_A_R_LINEAR_____89_CM 6 0. 0.9999847412109381 FORMAT "%7.5" AXIS_PTS_REF ldpm_nt_agi_thermo /end AXIS_DESCR
/end CHARACTERISTIC
/begin CHARACTERISTIC ip_nt_sul_max_2 "sulphur model threshold to request set desulfation request 2" CURVE 0xa0807e70 _REC_CUR_20_u2_u2 10485.6 _CNV_A_R_LINEAR_____244_CM 0. 10485.6 DISPLAY_IDENTIFIER IP_NT_SUL_MAX_2 FORMAT "%7.1"
 /begin AXIS_DESCR COM_AXIS nt_agi_thermo _CNV_A_R_LINEAR_____89_CM 6 0. 0.9999847412109381 FORMAT "%7.5" AXIS_PTS_REF ldpm_nt_agi_thermo /end AXIS_DESCR
/end CHARACTERISTIC
/begin CHARACTERISTIC ip_nt_sul_max_3 "sulphur model threshold to request I 1 operation" CURVE 0xa0807e88 _REC_CUR_20_u2_u2 10485.6 _CNV_A_R_LINEAR_____244_CM 0. 10485.6 DISPLAY_IDENTIFIER IP_NT_SUL_MAX_3 FORMAT "%7.1"
 /begin AXIS_DESCR COM_AXIS nt_agi_thermo _CNV_A_R_LINEAR_____89_CM 6 0. 0.9999847412109381 FORMAT "%7.5" AXIS_PTS_REF ldpm_nt_agi_thermo /end AXIS_DESCR
/end CHARACTERISTIC
/begin CHARACTERISTIC c_nt_agi_obs_min_2 "aging monitoring minimum threshold 2 to request I 1 operation" VALUE 0xa0807f1c _REC_VAL_20_u2 0.9999847412109381 _CNV_A_R_LINEAR_____89_CM 0. 0.9999847412109381 DISPLAY_IDENTIFIER C_NT_AGI_OBS_MIN_2 FORMAT "%7.5" /end CHARACTERISTIC
/begin CHARACTERISTIC c_nt_sul_so2p_fq "sulphur model value to start FQ-desulfation" VALUE 0xa0807f2e _REC_VAL_20_u2 10485.6 _CNV_A_R_LINEAR_____244_CM 0. 10485.6 DISPLAY_IDENTIFIER C_NT_SUL_SO2P_FQ FORMAT "%7.1" /end CHARACTERISTIC
/begin CHARACTERISTIC c_fac_su_conc_fuel "Interface factor to sulphur model for calibrating fuel sulphur concentration" VALUE 0xa0807efa _REC_VAL_20_u1 255. _CNV_A_R_LINEAR_____0_CM 0. 255. DISPLAY_IDENTIFIER C_FAC_SU_CONC_FUEL FORMAT "%3.0" /end CHARACTERISTIC
/begin CHARACTERISTIC c_ctr_nt_agi_so2p_fq_min "counter threshold or aging adaption after FQ-desulfation" VALUE 0xa0807ef2 _REC_VAL_20_u2 65535. _CNV_A_R_LINEAR_____0_CM 0. 65535. DISPLAY_IDENTIFIER C_CTR_NT_AGI_SO2P_FQ_MIN FORMAT "%5.0" /end CHARACTERISTIC
/begin CHARACTERISTIC c_ntld_so2p_fq "NOx loading degree to stop aging adaption after FQ-desulfation" VALUE 0xa0807f32 _REC_VAL_20_u2 0.9999847412109381 _CNV_A_R_LINEAR_____89_CM 0. 0.9999847412109381 DISPLAY_IDENTIFIER C_NTLD_SO2P_FQ FORMAT "%7.5" /end CHARACTERISTIC
/begin CHARACTERISTIC c_nt_agi_thermo_so2p_fq_ini "Initial aging value after FQ-desulfation" VALUE 0xa0807f26 _REC_VAL_20_u2 0.9999847412109381 _CNV_A_R_LINEAR_____89_CM 0. 0.9999847412109381 DISPLAY_IDENTIFIER C_NT_AGI_THERMO_SO2P_FQ_INI FORMAT "%7.5" /end CHARACTERISTIC
/begin MEASUREMENT nt_agi_sul_sng[0] "NOx trap aging factor due to sulphur load (bench selective)" ULONG _CNV_A_R_NOXM_LINEA_507_CM 1 100. 0. 1. DISPLAY_IDENTIFIER NT_AGI_SUL_SNG[1] ECU_ADDRESS 0xd0006394 FORMAT "%12.10" /end MEASUREMENT
/begin MEASUREMENT nt_agi_sul_sng[1] "NOx trap aging factor due to sulphur load (bench selective)" ULONG _CNV_A_R_NOXM_LINEA_507_CM 1 100. 0. 1. DISPLAY_IDENTIFIER NT_AGI_SUL_SNG[2] ECU_ADDRESS 0xd0006398 FORMAT "%12.10" /end MEASUREMENT
/begin MEASUREMENT nt_agi_thermo_sng[0] "NOx trap aging factor due to thermal aging (bench selective)" UWORD _CNV_A_R_LINEAR_____89_CM 1 100. 0. 0.9999847412109381 DISPLAY_IDENTIFIER NT_AGI_THERMO_SNG[1] ECU_ADDRESS 0xd00071f6 FORMAT "%7.5" /end MEASUREMENT
/begin MEASUREMENT nt_agi_thermo_sng[1] "NOx trap aging factor due to thermal aging (bench selective)" UWORD _CNV_A_R_LINEAR_____89_CM 1 100. 0. 0.9999847412109381 DISPLAY_IDENTIFIER NT_AGI_THERMO_SNG[2] ECU_ADDRESS 0xd00071f8 FORMAT "%7.5" /end MEASUREMENT
/begin MEASUREMENT nt_agi_bas[0] "NOx trap aging factor base value (not defined in binary Lambda-Sensor mode)" UWORD _CNV_A_R_LINEAR_____89_CM 1 100. 0. 0.9999847412109381 DISPLAY_IDENTIFIER NT_AGI_BAS[1] ECU_ADDRESS 0xd0003698 FORMAT "%7.5" /end MEASUREMENT
/begin MEASUREMENT nt_agi_bas[1] "NOx trap aging factor base value (not defined in binary Lambda-Sensor mode)" UWORD _CNV_A_R_LINEAR_____89_CM 1 100. 0. 0.9999847412109381 DISPLAY_IDENTIFIER NT_AGI_BAS[2] ECU_ADDRESS 0xd000369a FORMAT "%7.5" /end MEASUREMENT
/begin MEASUREMENT nt_agi_obs_sng[0] "Quick aging monitoring value (bench selective)" UWORD _CNV_A_R_LINEAR_____89_CM 1 100. 0. 0.9999847412109381 DISPLAY_IDENTIFIER NT_AGI_OBS_SNG[1] ECU_ADDRESS 0xd00071ea FORMAT "%7.5" /end MEASUREMENT
/begin MEASUREMENT nt_agi_obs_sng[1] "Quick aging monitoring value (bench selective)" UWORD _CNV_A_R_LINEAR_____89_CM 1 100. 0. 0.9999847412109381 DISPLAY_IDENTIFIER NT_AGI_OBS_SNG[2] ECU_ADDRESS 0xd00071ec FORMAT "%7.5" /end MEASUREMENT
/begin MEASUREMENT nox_eff[0] "Actual NOx trap efficiency (not defined in binary Lambda-Sensor mode) (bench selective)" UWORD _CNV_A_R_LINEAR_____89_CM 1 100. 0. 0.9999847412109381 DISPLAY_IDENTIFIER NOX_EFF[1] ECU_ADDRESS 0xd0003694 FORMAT "%7.5" /end MEASUREMENT
/begin MEASUREMENT nox_eff[1] "Actual NOx trap efficiency (not defined in binary Lambda-Sensor mode) (bench selective)" UWORD _CNV_A_R_LINEAR_____89_CM 1 100. 0. 0.9999847412109381 DISPLAY_IDENTIFIER NOX_EFF[2] ECU_ADDRESS 0xd0003696 FORMAT "%7.5" /end MEASUREMENT
/begin CHARACTERISTIC c_nt_agi_ini[0] "NOx trap aging factor initializing value (branch selective)" VALUE 0xa0807f14 _REC_VAL_20_u2 0.9999847412109381 _CNV_A_R_LINEAR_____89_CM 0. 0.9999847412109381 DISPLAY_IDENTIFIER C_NT_AGI_INI[1] FORMAT "%7.5" /end CHARACTERISTIC
/begin CHARACTERISTIC c_nt_agi_ini[1] "NOx trap aging factor initializing value (branch selective)" VALUE 0xa0807f16 _REC_VAL_20_u2 0.9999847412109381 _CNV_A_R_LINEAR_____89_CM 0. 0.9999847412109381 DISPLAY_IDENTIFIER C_NT_AGI_INI[2] FORMAT "%7.5" /end CHARACTERISTIC
/begin MEASUREMENT nt_sul_agi_sng[0] "Interface variable for update of sulphur release model by aging function (bench selective)" UWORD _CNV_A_R_LINEAR_____244_CM 1 100. 0. 10485.6 DISPLAY_IDENTIFIER NT_SUL_AGI_SNG[1] ECU_ADDRESS 0xd00071fe FORMAT "%7.1" /end MEASUREMENT
/begin MEASUREMENT nt_sul_agi_sng[1] "Interface variable for update of sulphur release model by aging function (bench selective)" UWORD _CNV_A_R_LINEAR_____244_CM 1 100. 0. 10485.6 DISPLAY_IDENTIFIER NT_SUL_AGI_SNG[2] ECU_ADDRESS 0xd0007200 FORMAT "%7.1" /end MEASUREMENT
/begin MEASUREMENT ntld_agi[0] "\"reverse\" NOx trap loading degree (bench selective)" UWORD _CNV_A_R_LINEAR_____89_CM 1 100. 0. 0.9999847412109381 DISPLAY_IDENTIFIER NTLD_AGI[1] ECU_ADDRESS 0xd00036a8 FORMAT "%7.5" /end MEASUREMENT
/begin MEASUREMENT ntld_agi[1] "\"reverse\" NOx trap loading degree (bench selective)" UWORD _CNV_A_R_LINEAR_____89_CM 1 100. 0. 0.9999847412109381 DISPLAY_IDENTIFIER NTLD_AGI[2] ECU_ADDRESS 0xd00036aa FORMAT "%7.5" /end MEASUREMENT
/begin MEASUREMENT lv_key_off "Boolean for ignition key status (ON / OFF)" UBYTE _CNV_S_2_RANGE__0___1_CM 1 100. 0. 1. DISPLAY_IDENTIFIER LV_KEY_OFF ECU_ADDRESS 0xd0008af0 BIT_MASK 0x1 /end MEASUREMENT
/begin MEASUREMENT ivvtpwm_in[0] "PWM for inlet VANOS" UWORD _CNV_A_R_LINEAR_____8_CM 1 100. 0. 99.99847412109381 DISPLAY_IDENTIFIER IVVTPWM_IN[0] ECU_ADDRESS 0xd000acbc FORMAT "%5.2" /end MEASUREMENT
/begin MEASUREMENT ivvtpwm_in[1] "PWM for inlet VANOS" UWORD _CNV_A_R_LINEAR_____8_CM 1 100. 0. 99.99847412109381 DISPLAY_IDENTIFIER IVVTPWM_IN[1] ECU_ADDRESS 0xd000acbe FORMAT "%5.2" /end MEASUREMENT
/begin MEASUREMENT ivvtpwm_ex[0] "PWM for outlet VANOS" UWORD _CNV_A_R_LINEAR_____8_CM 1 100. 0. 99.99847412109381 DISPLAY_IDENTIFIER IVVTPWM_EX[0] ECU_ADDRESS 0xd000acc0 FORMAT "%5.2" /end MEASUREMENT
/begin MEASUREMENT ivvtpwm_ex[1] "PWM for outlet VANOS" UWORD _CNV_A_R_LINEAR_____8_CM 1 100. 0. 99.99847412109381 DISPLAY_IDENTIFIER IVVTPWM_EX[1] ECU_ADDRESS 0xd000acc2 FORMAT "%5.2" /end MEASUREMENT
/begin AXIS_PTS ldp_n_32_ip_nox_cor_s_hys "" 0xa0807ab6 n_32 _REC_AXS_20_u1 8160. _CNV_A_R_LINEAR_____10_CM 6 0. 8160. FORMAT "%4.0" /end AXIS_PTS
/begin AXIS_PTS ldp_n_32_ip_nox_cor_homs_hys "" 0xa0807aae n_32 _REC_AXS_20_u1 8160. _CNV_A_R_LINEAR_____10_CM 6 0. 8160. FORMAT "%4.0" /end AXIS_PTS
/begin AXIS_PTS ldpm_mff_sp_1_noxm "" 0xa0807ba4 mff_sp_s _REC_AXS_20_u2 1389. _CNV_A_R_LINEAR_____111_CM 8 0. 1389. FORMAT "%7.2" /end AXIS_PTS
/begin AXIS_PTS ldpm_n_32_1_noxm "" 0xa0807bd0 n_32 _REC_AXS_20_u1 8160. _CNV_A_R_LINEAR_____10_CM 8 0. 8160. FORMAT "%4.0" /end AXIS_PTS
/begin AXIS_PTS ldpm_pq_egr_1_noxm "" 0xa0807c20 pq_egr _REC_AXS_20_u2 1. _CNV_A_R_LINEAR_____165_CM 8 0. 1. FORMAT "%7.5" /end AXIS_PTS
/begin AXIS_PTS ldpm_ratio_egr_dif_1_noxm "" 0xa0807c34 ratio_egr_dif_nox_s _REC_AXS_20_u2 99.99847412 _CNV_A_R_LINEAR_____178_CM 8 -50. 49.99847412 FORMAT "%7.3" /end AXIS_PTS
/begin AXIS_PTS ldpm_tia_1_noxm "" 0xa0807c4c tia_im _REC_AXS_20_u1 190.5 _CNV_A_R_LINEAR_____17_CM 4 -48. 142.5 FORMAT "%6.2" /end AXIS_PTS
/begin AXIS_PTS ldpm_map_dif_nox_1_noxm "" 0xa0807b90 map_dif_nox_s _REC_AXS_20_u2 5434. _CNV_A_R_NOXM_LINEA_880_CM 8 -2717.04145876249 2716.95854123751 FORMAT "%8.2" /end AXIS_PTS
/begin AXIS_PTS ldpm_tco_dif_nox_1_noxm "" 0xa0807c46 tco_dif_nox_s _REC_AXS_20_u1 191.25 _CNV_A_R_ENTE_LINEA_443_CM 4 -96. 95.25 FORMAT "%5.1" /end AXIS_PTS
/begin AXIS_PTS ldpm_fac_maf_max_1_noxm "" 0xa0807b44 fac_maf_max _REC_AXS_20_u2 1.99996948242188 _CNV_A_R_LINEAR_____9_CM 4 0. 1.99996948242188 FORMAT "%7.5" /end AXIS_PTS
/begin MEASUREMENT v_igk_bas "Battery voltage after key raw acquisition" UWORD _CNV_A_R_LINEAR_____473_CM 1 100. 0. 28.7055 DISPLAY_IDENTIFIER V_IGK_BAS ECU_ADDRESS 0xd000a6c2 FORMAT "%5.2" /end MEASUREMENT
/begin MEASUREMENT v_igk_mes "Computed ignition key voltage" UWORD _CNV_A_R_LINEAR_____473_CM 1 100. 0. 28.7055 DISPLAY_IDENTIFIER V_IGK_MES ECU_ADDRESS 0xd000a6c0 FORMAT "%5.2" /end MEASUREMENT
/begin MEASUREMENT vb_mes "Computed battery voltage" UWORD _CNV_A_R_LINEAR_____473_CM 1 100. 0. 28.7055 DISPLAY_IDENTIFIER VB_MES ECU_ADDRESS 0xd000a6d4 FORMAT "%5.2" /end MEASUREMENT
/begin MEASUREMENT vb_bas "Battery voltage after relay raw acquisition" UWORD _CNV_A_R_LINEAR_____473_CM 1 100. 0. 28.7055 DISPLAY_IDENTIFIER VB_BAS ECU_ADDRESS 0xd000a6d6 FORMAT "%5.2" /end MEASUREMENT
/begin MEASUREMENT nox_cor_homs "Corrected engine out NOx emission in homogeneous-stratified operation mode" UWORD _CNV_A_R_LINEAR_____489_CM 1 100. 0. 1023.984375 DISPLAY_IDENTIFIER NOX_COR_HOMS ECU_ADDRESS 0xd00071dc FORMAT "%7.2" /end MEASUREMENT
/begin MEASUREMENT nox_cor_homs_pred "Predicted engine out NOx emission in homogeneous-stratified operation mode" UWORD _CNV_A_R_LINEAR_____489_CM 1 100. 0. 1023.984375 DISPLAY_IDENTIFIER NOX_COR_HOMS_PRED ECU_ADDRESS 0xd00071de FORMAT "%7.2" /end MEASUREMENT
/begin MEASUREMENT map_dif_nox_homs "pressure difference to basis ambient pressure of the model (homogeneous-stratified combustion mode)" SWORD _CNV_A_R_LINEAR_____279_CM 1 100. -2717.04145876249 2716.95854123751 DISPLAY_IDENTIFIER MAP_DIF_NOX_HOMS ECU_ADDRESS 0xd000368c FORMAT "%8.2" /end MEASUREMENT
/begin MEASUREMENT tco_dif_nox_homs "Cooling water temperature difference to basis cooling temperature of the model (homogeneous-stratified combustion mode)" SBYTE _CNV_A_R_LINEAR_____25_CM 1 100. -96. 95.25 DISPLAY_IDENTIFIER TCO_DIF_NOX_HOMS ECU_ADDRESS 0xd00036e5 FORMAT "%5.1" /end MEASUREMENT
/begin MEASUREMENT nox_cor_homs_tmp "Corrected engine out NOx emission in homogeneous-stratified operation mode (intermediate)" UWORD _CNV_A_R_LINEAR_____927_CM 1 100. 0. 2047.96875 DISPLAY_IDENTIFIER NOX_COR_HOMS_TMP ECU_ADDRESS 0xd0003690 FORMAT "%7.2" /end MEASUREMENT
/begin MEASUREMENT ratio_egr_dif_nox_homs "Exhaust gas recirculation ratio difference to basis calibration (homogeneous-stratified combustion mode)" SWORD _CNV_A_R_LINEAR_____113_CM 1 100. -50. 49.9984741210938 DISPLAY_IDENTIFIER RATIO_EGR_DIF_NOX_HOMS ECU_ADDRESS 0xd00036ac FORMAT "%7.3" /end MEASUREMENT
/begin CHARACTERISTIC c_amp_bas_nox_homs "basis ambient pressure for NOx engine out emission model (homogeneous-stratified combustion mode)" VALUE 0xa0807edc _REC_VAL_20_u2 5434. _CNV_A_R_LINEAR_____27_CM 0. 5434. DISPLAY_IDENTIFIER C_AMP_BAS_NOX_HOMS FORMAT "%7.2" /end CHARACTERISTIC
/begin CHARACTERISTIC c_tco_bas_nox_homs "Basis cooling water temperature for NOx engine out emission model (homogeneous-stratified combustion mode)" VALUE 0xa0807f48 _REC_VAL_20_u1 190.5 _CNV_A_R_LINEAR_____17_CM -48. 142.5 DISPLAY_IDENTIFIER C_TCO_BAS_NOX_HOMS FORMAT "%6.2" /end CHARACTERISTIC
/begin CHARACTERISTIC ip_nox_map_dif_homs "engine out NOx emission correction due to ambient pressure deviation (homogeneous-stratified combustion mode)" MAP 0xa081316c _REC_MAP_20_u2_u2_u2 1.99996948242188 _CNV_A_R_LINEAR_____9_CM 0. 1.99996948242188 DISPLAY_IDENTIFIER IP_NOX_MAP_DIF_HOMS FORMAT "%7.5"
 /begin AXIS_DESCR COM_AXIS pq_egr _CNV_A_R_LINEAR_____165_CM 8 0. 1. FORMAT "%7.5" AXIS_PTS_REF ldpm_pq_egr_1_noxm /end AXIS_DESCR
 /begin AXIS_DESCR COM_AXIS map_dif_nox_s _CNV_A_R_NOXM_LINEA_880_CM 8 -2717.04145876249 2716.95854123751 FORMAT "%8.2" AXIS_PTS_REF ldpm_map_dif_nox_1_noxm /end AXIS_DESCR
/end CHARACTERISTIC
/begin CHARACTERISTIC ip_nox_homs "NOx engine out base emission in homogeneous-stratified combustion mode" MAP 0xa08130ec _REC_MAP_20_u2_u2_u1 1023.984375 _CNV_A_R_LINEAR_____489_CM 0. 1023.984375 DISPLAY_IDENTIFIER IP_NOX_HOMS FORMAT "%7.2"
 /begin AXIS_DESCR COM_AXIS mff_sp_s _CNV_A_R_LINEAR_____111_CM 8 0. 1389. FORMAT "%7.2" AXIS_PTS_REF ldpm_mff_sp_1_noxm /end AXIS_DESCR
 /begin AXIS_DESCR COM_AXIS n_32 _CNV_A_R_LINEAR_____10_CM 8 0. 8160. FORMAT "%4.0" AXIS_PTS_REF ldpm_n_32_1_noxm /end AXIS_DESCR
/end CHARACTERISTIC
/begin CHARACTERISTIC ip_nox_tco_homs "engine out NOx emission correction due to cooling water temperature (homogeneous-stratified combustion mode)" MAP 0xa0807d10 _REC_MAP_20_u2_u2_u1 1.99996948242188 _CNV_A_R_LINEAR_____9_CM 0. 1.99996948242188 DISPLAY_IDENTIFIER IP_NOX_TCO_HOMS FORMAT "%7.5"
 /begin AXIS_DESCR COM_AXIS map_dif_nox_s _CNV_A_R_NOXM_LINEA_880_CM 8 -2717.04145876249 2716.95854123751 FORMAT "%8.2" AXIS_PTS_REF ldpm_map_dif_nox_1_noxm /end AXIS_DESCR
 /begin AXIS_DESCR COM_AXIS tco_dif_nox_s _CNV_A_R_ENTE_LINEA_443_CM 4 -96. 95.25 FORMAT "%5.1" AXIS_PTS_REF ldpm_tco_dif_nox_1_noxm /end AXIS_DESCR
/end CHARACTERISTIC
/begin CHARACTERISTIC ip_nox_tia_homs "Engine out NOx emission correction due to intake air temperature (homogeneous-stratified combustion mode)" MAP 0xa0807da0 _REC_MAP_20_u2_u1_u1 1.99996948242188 _CNV_A_R_LINEAR_____9_CM 0. 1.99996948242188 DISPLAY_IDENTIFIER IP_NOX_TIA_HOMS FORMAT "%7.5"
 /begin AXIS_DESCR COM_AXIS n_32 _CNV_A_R_LINEAR_____10_CM 8 0. 8160. FORMAT "%4.0" AXIS_PTS_REF ldpm_n_32_1_noxm /end AXIS_DESCR
 /begin AXIS_DESCR COM_AXIS tia_im _CNV_A_R_LINEAR_____17_CM 4 -48. 142.5 FORMAT "%6.2" AXIS_PTS_REF ldpm_tia_1_noxm /end AXIS_DESCR
/end CHARACTERISTIC
/begin CHARACTERISTIC ip_fac_maf_max_nox_homs "Engine out NOx emission correction due to the throttle factor (homogeneous-stratified combustion mode)" CURVE 0xa0807c70 _REC_CUR_20_u2_u2 1.99996948242188 _CNV_A_R_LINEAR_____9_CM 0. 1.99996948242188 DISPLAY_IDENTIFIER IP_FAC_MAF_MAX_NOX_HOMS FORMAT "%7.5"
 /begin AXIS_DESCR COM_AXIS fac_maf_max _CNV_A_R_LINEAR_____9_CM 4 0. 1.99996948242188 FORMAT "%7.5" AXIS_PTS_REF ldpm_fac_maf_max_1_noxm /end AXIS_DESCR
/end CHARACTERISTIC
/begin CHARACTERISTIC ip_nox_tco_homs_pred "Prediction of engine out NOx emission correction due to cooling water temperature (homogeneous-stratified combustion mode)" CURVE 0xa0807d50 _REC_CUR_20_u2_u1 1.99996948242188 _CNV_A_R_LINEAR_____9_CM 0. 1.99996948242188 DISPLAY_IDENTIFIER IP_NOX_TCO_HOMS_PRED FORMAT "%7.5"
 /begin AXIS_DESCR COM_AXIS tco_dif_nox_s _CNV_A_R_ENTE_LINEA_443_CM 4 -96. 95.25 FORMAT "%5.1" AXIS_PTS_REF ldpm_tco_dif_nox_1_noxm /end AXIS_DESCR
/end CHARACTERISTIC
/begin CHARACTERISTIC ip_nox_egr_ratio_dif_homs "engine out NOx emission correction due to EGR ratio deviation (homogeneous-stratified combustion mode)" MAP 0xa0812fec _REC_MAP_20_u2_u2_u2 1.99996948242188 _CNV_A_R_LINEAR_____9_CM 0. 1.99996948242188 DISPLAY_IDENTIFIER IP_NOX_EGR_RATIO_DIF_HOMS FORMAT "%7.5"
 /begin AXIS_DESCR COM_AXIS pq_egr _CNV_A_R_LINEAR_____165_CM 8 0. 1. FORMAT "%7.5" AXIS_PTS_REF ldpm_pq_egr_1_noxm /end AXIS_DESCR
 /begin AXIS_DESCR COM_AXIS ratio_egr_dif_nox_s _CNV_A_R_LINEAR_____178_CM 8 -50. 49.99847412 FORMAT "%7.3" AXIS_PTS_REF ldpm_ratio_egr_dif_1_noxm /end AXIS_DESCR
/end CHARACTERISTIC
/begin CHARACTERISTIC ip_nox_egr_ratio_bas_homs "EGR reference value at NOx emission basis calibration (homogeneous-stratified combustion mode)" MAP 0xa0812eec _REC_MAP_20_u2_u2_u1 99.99847412 _CNV_A_R_LINEAR_____178_CM -50. 49.99847412 DISPLAY_IDENTIFIER IP_NOX_EGR_RATIO_BAS_HOMS FORMAT "%7.3"
 /begin AXIS_DESCR COM_AXIS mff_sp_s _CNV_A_R_LINEAR_____111_CM 8 0. 1389. FORMAT "%7.2" AXIS_PTS_REF ldpm_mff_sp_1_noxm /end AXIS_DESCR
 /begin AXIS_DESCR COM_AXIS n_32 _CNV_A_R_LINEAR_____10_CM 8 0. 8160. FORMAT "%4.0" AXIS_PTS_REF ldpm_n_32_1_noxm /end AXIS_DESCR
/end CHARACTERISTIC
/begin MEASUREMENT nox_cor_s "Corrected engine out NOx emission in stratified operation mode" UWORD _CNV_A_R_LINEAR_____489_CM 1 100. 0. 1023.984375 DISPLAY_IDENTIFIER NOX_COR_S ECU_ADDRESS 0xd00071e0 FORMAT "%7.2" /end MEASUREMENT
/begin MEASUREMENT nox_cor_s_pred "Predicted engine out NOx emission in stratified operation mode" UWORD _CNV_A_R_LINEAR_____489_CM 1 100. 0. 1023.984375 DISPLAY_IDENTIFIER NOX_COR_S_PRED ECU_ADDRESS 0xd00071e2 FORMAT "%7.2" /end MEASUREMENT
/begin MEASUREMENT map_dif_nox_s "pressure difference to basis ambient pressure of the model" SWORD _CNV_A_R_LINEAR_____279_CM 1 100. -2717.04145876249 2716.95854123751 DISPLAY_IDENTIFIER MAP_DIF_NOX_S ECU_ADDRESS 0xd000368e FORMAT "%8.2" /end MEASUREMENT
/begin MEASUREMENT tco_dif_nox_s "Cooling water temperature difference to basis cooling temperature of the model" SBYTE _CNV_A_R_LINEAR_____25_CM 1 100. -96. 95.25 DISPLAY_IDENTIFIER TCO_DIF_NOX_S ECU_ADDRESS 0xd00036e6 FORMAT "%5.1" /end MEASUREMENT
/begin MEASUREMENT nox_cor_s_tmp "Corrected engine out NOx emission in stratified operation mode (intermediate)" UWORD _CNV_A_R_LINEAR_____927_CM 1 100. 0. 2047.96875 DISPLAY_IDENTIFIER NOX_COR_S_TMP ECU_ADDRESS 0xd0003692 FORMAT "%7.2" /end MEASUREMENT
/begin MEASUREMENT ratio_egr_dif_nox_s "Exhaust gas recirculation ratio difference to basis calibration" SWORD _CNV_A_R_LINEAR_____113_CM 1 100. -50. 49.9984741210938 DISPLAY_IDENTIFIER RATIO_EGR_DIF_NOX_S ECU_ADDRESS 0xd00036ae FORMAT "%7.3" /end MEASUREMENT
/begin CHARACTERISTIC c_amp_bas_nox_s "basis ambient pressure for NOx engine out emission model" VALUE 0xa0807ede _REC_VAL_20_u2 5434. _CNV_A_R_LINEAR_____27_CM 0. 5434. DISPLAY_IDENTIFIER C_AMP_BAS_NOX_S FORMAT "%7.2" /end CHARACTERISTIC
/begin CHARACTERISTIC c_tco_bas_nox_s "Basis cooling water temperature for NOx engine out emission model" VALUE 0xa0807f49 _REC_VAL_20_u1 190.5 _CNV_A_R_LINEAR_____17_CM -48. 142.5 DISPLAY_IDENTIFIER C_TCO_BAS_NOX_S FORMAT "%6.2" /end CHARACTERISTIC
/begin CHARACTERISTIC ip_nox_map_dif_s "engine out NOx emission correction due to ambient pressure deviation" MAP 0xa08131ec _REC_MAP_20_u2_u2_u2 1.99996948242188 _CNV_A_R_LINEAR_____9_CM 0. 1.99996948242188 DISPLAY_IDENTIFIER IP_NOX_MAP_DIF_S FORMAT "%7.5"
 /begin AXIS_DESCR COM_AXIS pq_egr _CNV_A_R_LINEAR_____165_CM 8 0. 1. FORMAT "%7.5" AXIS_PTS_REF ldpm_pq_egr_1_noxm /end AXIS_DESCR
 /begin AXIS_DESCR COM_AXIS map_dif_nox_s _CNV_A_R_NOXM_LINEA_880_CM 8 -2717.04145876249 2716.95854123751 FORMAT "%8.2" AXIS_PTS_REF ldpm_map_dif_nox_1_noxm /end AXIS_DESCR
/end CHARACTERISTIC
/begin CHARACTERISTIC ip_nox_s "NOx engine out base emission in stratified operation" MAP 0xa081326c _REC_MAP_20_u2_u2_u1 1023.984375 _CNV_A_R_LINEAR_____489_CM 0. 1023.984375 DISPLAY_IDENTIFIER IP_NOX_S FORMAT "%7.2"
 /begin AXIS_DESCR COM_AXIS mff_sp_s _CNV_A_R_LINEAR_____111_CM 8 0. 1389. FORMAT "%7.2" AXIS_PTS_REF ldpm_mff_sp_1_noxm /end AXIS_DESCR
 /begin AXIS_DESCR COM_AXIS n_32 _CNV_A_R_LINEAR_____10_CM 8 0. 8160. FORMAT "%4.0" AXIS_PTS_REF ldpm_n_32_1_noxm /end AXIS_DESCR
/end CHARACTERISTIC
/begin CHARACTERISTIC ip_nox_tco_s "engine out NOx emission correction due to cooling water temperature" MAP 0xa0807d58 _REC_MAP_20_u2_u2_u1 1.99996948242188 _CNV_A_R_LINEAR_____9_CM 0. 1.99996948242188 DISPLAY_IDENTIFIER IP_NOX_TCO_S FORMAT "%7.5"
 /begin AXIS_DESCR COM_AXIS map_dif_nox_s _CNV_A_R_NOXM_LINEA_880_CM 8 -2717.04145876249 2716.95854123751 FORMAT "%8.2" AXIS_PTS_REF ldpm_map_dif_nox_1_noxm /end AXIS_DESCR
 /begin AXIS_DESCR COM_AXIS tco_dif_nox_s _CNV_A_R_ENTE_LINEA_443_CM 4 -96. 95.25 FORMAT "%5.1" AXIS_PTS_REF ldpm_tco_dif_nox_1_noxm /end AXIS_DESCR
/end CHARACTERISTIC
/begin CHARACTERISTIC ip_nox_tia_s "Engine out NOx emission correction due to intake air temperature" MAP 0xa0807de0 _REC_MAP_20_u2_u1_u1 1.99996948242188 _CNV_A_R_LINEAR_____9_CM 0. 1.99996948242188 DISPLAY_IDENTIFIER IP_NOX_TIA_S FORMAT "%7.5"
 /begin AXIS_DESCR COM_AXIS n_32 _CNV_A_R_LINEAR_____10_CM 8 0. 8160. FORMAT "%4.0" AXIS_PTS_REF ldpm_n_32_1_noxm /end AXIS_DESCR
 /begin AXIS_DESCR COM_AXIS tia_im _CNV_A_R_LINEAR_____17_CM 4 -48. 142.5 FORMAT "%6.2" AXIS_PTS_REF ldpm_tia_1_noxm /end AXIS_DESCR
/end CHARACTERISTIC
/begin CHARACTERISTIC ip_fac_maf_max_nox_s "Engine out NOx emission correction due to the throttle factor" CURVE 0xa0807c78 _REC_CUR_20_u2_u2 1.99996948242188 _CNV_A_R_LINEAR_____9_CM 0. 1.99996948242188 DISPLAY_IDENTIFIER IP_FAC_MAF_MAX_NOX_S FORMAT "%7.5"
 /begin AXIS_DESCR COM_AXIS fac_maf_max _CNV_A_R_LINEAR_____9_CM 4 0. 1.99996948242188 FORMAT "%7.5" AXIS_PTS_REF ldpm_fac_maf_max_1_noxm /end AXIS_DESCR
/end CHARACTERISTIC
/begin CHARACTERISTIC ip_nox_tco_s_pred "Prediction of engine out NOx emission correction due to cooling water temperature" CURVE 0xa0807d98 _REC_CUR_20_u2_u1 1.99996948242188 _CNV_A_R_LINEAR_____9_CM 0. 1.99996948242188 DISPLAY_IDENTIFIER IP_NOX_TCO_S_PRED FORMAT "%7.5"
 /begin AXIS_DESCR COM_AXIS tco_dif_nox_s _CNV_A_R_ENTE_LINEA_443_CM 4 -96. 95.25 FORMAT "%5.1" AXIS_PTS_REF ldpm_tco_dif_nox_1_noxm /end AXIS_DESCR
/end CHARACTERISTIC
/begin CHARACTERISTIC ip_nox_egr_ratio_dif_s "engine out NOx emission correction due to EGR ratio deviation" MAP 0xa081306c _REC_MAP_20_u2_u2_u2 1.99996948242188 _CNV_A_R_LINEAR_____9_CM 0. 1.99996948242188 DISPLAY_IDENTIFIER IP_NOX_EGR_RATIO_DIF_S FORMAT "%7.5"
 /begin AXIS_DESCR COM_AXIS pq_egr _CNV_A_R_LINEAR_____165_CM 8 0. 1. FORMAT "%7.5" AXIS_PTS_REF ldpm_pq_egr_1_noxm /end AXIS_DESCR
 /begin AXIS_DESCR COM_AXIS ratio_egr_dif_nox_s _CNV_A_R_LINEAR_____178_CM 8 -50. 49.99847412 FORMAT "%7.3" AXIS_PTS_REF ldpm_ratio_egr_dif_1_noxm /end AXIS_DESCR
/end CHARACTERISTIC
/begin CHARACTERISTIC ip_nox_egr_ratio_bas_s "EGR reference value at NOx emission basis calibration" MAP 0xa0812f6c _REC_MAP_20_u2_u2_u1 99.99847412 _CNV_A_R_LINEAR_____178_CM -50. 49.99847412 DISPLAY_IDENTIFIER IP_NOX_EGR_RATIO_BAS_S FORMAT "%7.3"
 /begin AXIS_DESCR COM_AXIS mff_sp_s _CNV_A_R_LINEAR_____111_CM 8 0. 1389. FORMAT "%7.2" AXIS_PTS_REF ldpm_mff_sp_1_noxm /end AXIS_DESCR
 /begin AXIS_DESCR COM_AXIS n_32 _CNV_A_R_LINEAR_____10_CM 8 0. 8160. FORMAT "%4.0" AXIS_PTS_REF ldpm_n_32_1_noxm /end AXIS_DESCR
/end CHARACTERISTIC
/begin MEASUREMENT t_afl_down_lock[0] "timer indicating duration of LV_AFL lock at LS downstream position" UWORD _CNV_A_R_LINEAR_____110_CM 1 100. 0. 1310.7 DISPLAY_IDENTIFIER T_AFL_DOWN_LOCK[1] ECU_ADDRESS 0xd00036b0 FORMAT "%7.2" /end MEASUREMENT
/begin MEASUREMENT t_afl_down_lock[1] "timer indicating duration of LV_AFL lock at LS downstream position" UWORD _CNV_A_R_LINEAR_____110_CM 1 100. 0. 1310.7 DISPLAY_IDENTIFIER T_AFL_DOWN_LOCK[2] ECU_ADDRESS 0xd00036b2 FORMAT "%7.2" /end MEASUREMENT
/begin MEASUREMENT t_vls_down_cyc_afr[0] "rich mixture cycle time at LS downstream position" UWORD _CNV_A_R_LINEAR_____110_CM 1 100. 0. 1310.7 DISPLAY_IDENTIFIER T_VLS_DOWN_CYC_AFR[1] ECU_ADDRESS 0xd00036bc FORMAT "%7.2" /end MEASUREMENT
/begin MEASUREMENT t_vls_down_cyc_afr[1] "rich mixture cycle time at LS downstream position" UWORD _CNV_A_R_LINEAR_____110_CM 1 100. 0. 1310.7 DISPLAY_IDENTIFIER T_VLS_DOWN_CYC_AFR[2] ECU_ADDRESS 0xd00036be FORMAT "%7.2" /end MEASUREMENT
/begin MEASUREMENT lv_so2p_req "General desulfation request" UBYTE _CNV_S_2_RANGE__0___1_CM 1 100. 0. 1. DISPLAY_IDENTIFIER LV_SO2P_REQ ECU_ADDRESS 0xd0007753 BIT_MASK 0x1 /end MEASUREMENT
/begin MEASUREMENT lv_so2p_fast_req "Fast desulfation request" UBYTE _CNV_S_2_RANGE__0___1_CM 1 100. 0. 1. DISPLAY_IDENTIFIER LV_SO2P_FAST_REQ ECU_ADDRESS 0xd0007751 BIT_MASK 0x1 /end MEASUREMENT
/begin MEASUREMENT lv_so2p_lamb_puls "Lambda alternation request" UBYTE _CNV_S_2_RANGE__0___1_CM 1 100. 0. 1. DISPLAY_IDENTIFIER LV_SO2P_LAMB_PULS ECU_ADDRESS 0xd0007752 BIT_MASK 0x1 /end MEASUREMENT
/begin MEASUREMENT lv_so2p_act "NOx trap desulfation active" UBYTE _CNV_S_2_RANGE__0___1_CM 1 100. 0. 1. DISPLAY_IDENTIFIER LV_SO2P_ACT ECU_ADDRESS 0xd0007748 BIT_MASK 0x1 /end MEASUREMENT
/begin MEASUREMENT lv_so2p_afr_cord "Rich operation for fast desulfation request" UBYTE _CNV_S_2_RANGE__0___1_CM 1 100. 0. 1. DISPLAY_IDENTIFIER LV_SO2P_AFR_CORD ECU_ADDRESS 0xd0007750 BIT_MASK 0x1 /end MEASUREMENT
/begin MEASUREMENT t_so2p_not "time counter for non-desulfation athmosphere" UWORD _CNV_A_R_LINEAR_____4_CM 1 100. 0. 6553.5 DISPLAY_IDENTIFIER T_SO2P_NOT ECU_ADDRESS 0xd000720c FORMAT "%6.1" /end MEASUREMENT
/begin MEASUREMENT t_so2p_dly "delay time counter before sulfur release" UWORD _CNV_A_R_LINEAR_____4_CM 1 100. 0. 6553.5 DISPLAY_IDENTIFIER T_SO2P_DLY ECU_ADDRESS 0xd000720a FORMAT "%6.1" /end MEASUREMENT
/begin MEASUREMENT lamb_so2p[0] "lambda setpoint for desulfation" UWORD _CNV_A_R_LINEAR_____129_CM 1 100. 0. 31.9990234375 DISPLAY_IDENTIFIER LAMB_SO2P[1] ECU_ADDRESS 0xd0007734 FORMAT "%7.4" /end MEASUREMENT
/begin MEASUREMENT lamb_so2p[1] "lambda setpoint for desulfation" UWORD _CNV_A_R_LINEAR_____129_CM 1 100. 0. 31.9990234375 DISPLAY_IDENTIFIER LAMB_SO2P[2] ECU_ADDRESS 0xd0007736 FORMAT "%7.4" /end MEASUREMENT
/begin CHARACTERISTIC c_tnt_mdl_so2p_min "NOx trap monolith temperature threshold for SO2 purge possible" VALUE 0xa0807f56 _REC_VAL_20_u1 1020. _CNV_A_R_LINEAR_____481_CM 0. 1020. DISPLAY_IDENTIFIER C_TNT_MDL_SO2P_MIN FORMAT "%4.0" /end CHARACTERISTIC
/begin CHARACTERISTIC c_tnt_mdl_so2p_hys "NOx trap monolith temperature hysteresis for SO2 purge deactivation" VALUE 0xa0807f55 _REC_VAL_20_u1 1020. _CNV_A_R_LINEAR_____481_CM 0. 1020. DISPLAY_IDENTIFIER C_TNT_MDL_SO2P_HYS FORMAT "%4.0" /end CHARACTERISTIC
/begin CHARACTERISTIC c_tnt_mdl_so2p_fast "NOx trap temperature threshold for switching to fast desulfation" VALUE 0xa0807f53 _REC_VAL_20_u1 1020. _CNV_A_R_LINEAR_____481_CM 0. 1020. DISPLAY_IDENTIFIER C_TNT_MDL_SO2P_FAST FORMAT "%4.0" /end CHARACTERISTIC
/begin CHARACTERISTIC c_tnt_mdl_so2p_fast_hys "NOx trap temperature hysteresis for switching back to alternating desulfation" VALUE 0xa0807f54 _REC_VAL_20_u1 1020. _CNV_A_R_LINEAR_____481_CM 0. 1020. DISPLAY_IDENTIFIER C_TNT_MDL_SO2P_FAST_HYS FORMAT "%4.0" /end CHARACTERISTIC
/begin CHARACTERISTIC c_t_so2p_not_max "maximum time for desulfation interruption before desulfation timer reset" VALUE 0xa0807f42 _REC_VAL_20_u2 6553.5 _CNV_A_R_LINEAR_____4_CM 0. 6553.5 DISPLAY_IDENTIFIER C_T_SO2P_NOT_MAX FORMAT "%6.1" /end CHARACTERISTIC
/begin CHARACTERISTIC c_nt_agi_so2p_max "max. NOx trap aging factor" VALUE 0xa0807f24 _REC_VAL_20_u2 0.9999847412109381 _CNV_A_R_LINEAR_____89_CM 0. 0.9999847412109381 DISPLAY_IDENTIFIER C_NT_AGI_SO2P_MAX FORMAT "%7.5" /end CHARACTERISTIC
/begin CHARACTERISTIC c_vs_so2p_fast_hys "vehicle speed hysteresis for switching back to alternating desulfation" VALUE 0xa0807f67 _REC_VAL_20_u1 255. _CNV_A_R_LINEAR_____6_CM 0. 255. DISPLAY_IDENTIFIER C_VS_SO2P_FAST_HYS FORMAT "%3.0" /end CHARACTERISTIC
/begin CHARACTERISTIC lc_so2p_fast_man "manual switch to fast desulfation mode " VALUE 0xa0807f79 _REC_VAL_20_u1 1. _CNV_A_R_LINEAR_____0_CM 0. 1. DISPLAY_IDENTIFIER LC_SO2P_FAST_MAN FORMAT "%1.0" BIT_MASK 0x1 /end CHARACTERISTIC
/begin CHARACTERISTIC c_lamb_so2p_pas "passive lambda value if the desulfation is not active" VALUE 0xa0807f00 _REC_VAL_20_u2 31.9990234375 _CNV_A_R_LINEAR_____129_CM 0. 31.9990234375 DISPLAY_IDENTIFIER C_LAMB_SO2P_PAS FORMAT "%7.4" /end CHARACTERISTIC
/begin CHARACTERISTIC ip_lamb_so2p "required lambda setpoint during desulfation" CURVE 0xa0807d00 _REC_CUR_20_u2_u2 31.9990234375 _CNV_A_R_LINEAR_____129_CM 0. 31.9990234375 DISPLAY_IDENTIFIER IP_LAMB_SO2P FORMAT "%7.4"
 /begin AXIS_DESCR COM_AXIS tnt_mdl_mv _CNV_A_R_LINEAR_____209_CM 8 0. 1023.984375 FORMAT "%7.2" AXIS_PTS_REF ldp_tnt_mdl_mv_ip_lamb_so2p /end AXIS_DESCR
/end CHARACTERISTIC
/begin CHARACTERISTIC c_nt_sul_so2p_max "max. NOx trap sulphur load out of sulphur model" VALUE 0xa0807f30 _REC_VAL_20_u2 10485.6 _CNV_A_R_LINEAR_____244_CM 0. 10485.6 DISPLAY_IDENTIFIER C_NT_SUL_SO2P_MAX FORMAT "%7.1" /end CHARACTERISTIC
/begin AXIS_PTS ldp_tnt_mdl_mv_ip_vs_so2p_fast "" 0xa0807b2a tnt_mdl_mv _REC_AXS_20_u1 1020. _CNV_A_R_LINEAR_____481_CM 4 0. 1020. FORMAT "%4.0" /end AXIS_PTS
/begin CHARACTERISTIC ip_vs_so2p_fast_thd "vehicle speed threshold for switching to fast desulation according to TNT_MDL_MV" CURVE 0xa0807ed8 _REC_CUR_20_u1_u1 255. _CNV_A_R_LINEAR_____6_CM 0. 255. DISPLAY_IDENTIFIER IP_VS_SO2P_FAST_THD FORMAT "%3.0"
 /begin AXIS_DESCR COM_AXIS tnt_mdl_mv _CNV_A_R_LINEAR_____481_CM 4 0. 1020. FORMAT "%4.0" AXIS_PTS_REF ldp_tnt_mdl_mv_ip_vs_so2p_fast /end AXIS_DESCR
/end CHARACTERISTIC
/begin MEASUREMENT lv_so2p_act_lamb[0] "NOx trap desulfation lambda condition fulfilled" UBYTE _CNV_S_2_RANGE__0___1_CM 1 100. 0. 1. DISPLAY_IDENTIFIER LV_SO2P_ACT_LAMB[1] ECU_ADDRESS 0xd000774a BIT_MASK 0x1 /end MEASUREMENT
/begin MEASUREMENT lv_so2p_act_lamb[1] "NOx trap desulfation lambda condition fulfilled" UBYTE _CNV_S_2_RANGE__0___1_CM 1 100. 0. 1. DISPLAY_IDENTIFIER LV_SO2P_ACT_LAMB[2] ECU_ADDRESS 0xd000774b BIT_MASK 0x1 /end MEASUREMENT
/begin MEASUREMENT lv_so2p_act_tnt "NOx trap desulfation temperature condition fulfilled" UBYTE _CNV_S_2_RANGE__0___1_CM 1 100. 0. 1. DISPLAY_IDENTIFIER LV_SO2P_ACT_TNT ECU_ADDRESS 0xd000774c BIT_MASK 0x1 /end MEASUREMENT
/begin MEASUREMENT vls_ref_so2p[0] "Reference signal value for desulfation atmosphere detection" UWORD _CNV_A_R_LINEAR_____2_CM 1 100. 0. 4.9951171875 DISPLAY_IDENTIFIER VLS_REF_SO2P[1] ECU_ADDRESS 0xd00036c8 FORMAT "%5.3" /end MEASUREMENT
/begin MEASUREMENT vls_ref_so2p[1] "Reference signal value for desulfation atmosphere detection" UWORD _CNV_A_R_LINEAR_____2_CM 1 100. 0. 4.9951171875 DISPLAY_IDENTIFIER VLS_REF_SO2P[2] ECU_ADDRESS 0xd00036ca FORMAT "%5.3" /end MEASUREMENT
/begin CHARACTERISTIC c_vls_ref_so2p "reference signal manual value" VALUE 0xa0807f5e _REC_VAL_20_u2 4.9951171875 _CNV_A_R_LINEAR_____2_CM 0. 4.9951171875 DISPLAY_IDENTIFIER C_VLS_REF_SO2P FORMAT "%5.3" /end CHARACTERISTIC
/begin CHARACTERISTIC c_vls_so2p_hys "VLS hysteresis for SO2 purge active detection" VALUE 0xa0807f62 _REC_VAL_20_u2 4.9951171875 _CNV_A_R_LINEAR_____2_CM 0. 4.9951171875 DISPLAY_IDENTIFIER C_VLS_SO2P_HYS FORMAT "%5.3" /end CHARACTERISTIC
/begin CHARACTERISTIC c_vls_so2p_min "VLS threshold for SO2 purge activation" VALUE 0xa0807f64 _REC_VAL_20_u2 4.9951171875 _CNV_A_R_LINEAR_____2_CM 0. 4.9951171875 DISPLAY_IDENTIFIER C_VLS_SO2P_MIN FORMAT "%5.3" /end CHARACTERISTIC
/begin AXIS_PTS ldp_tnt_mdl_mv_ip_lamb_so2p "" 0xa0807b0c tnt_mdl_mv _REC_AXS_20_u2 1023.984375 _CNV_A_R_LINEAR_____209_CM 8 0. 1023.984375 FORMAT "%7.2" /end AXIS_PTS
/begin CHARACTERISTIC c_state_sens_vls_down_so2p_act[0] "Mode to determine the sensor used for detection of a desulfating atmosphere" VALUE 0xa0807f38 _REC_VAL_20_u1 5. _CNV_S_6_NOXM_STATE_929_CM 0. 5. DISPLAY_IDENTIFIER C_STATE_SENS_VLS_DOWN_SO2P_ACT[1] /end CHARACTERISTIC
/begin CHARACTERISTIC c_state_sens_vls_down_so2p_act[1] "Mode to determine the sensor used for detection of a desulfating atmosphere" VALUE 0xa0807f39 _REC_VAL_20_u1 5. _CNV_S_6_NOXM_STATE_929_CM 0. 5. DISPLAY_IDENTIFIER C_STATE_SENS_VLS_DOWN_SO2P_ACT[2] /end CHARACTERISTIC
/begin COMPU_METHOD _CNV_A_R_LINEAR_____0_CM "" RAT_FUNC "%6.3" "-" COEFFS 0 1. 0. 0 0 1 /end COMPU_METHOD
/begin COMPU_METHOD _CNV_S_2_RANGE__0___1_CM "" TAB_VERB "%6.3" "-" COMPU_TAB_REF _CNV_S_2_RANGE__0___1 /end COMPU_METHOD
/begin COMPU_VTAB _CNV_S_2_RANGE__0___1 "" TAB_VERB 2 0 "0" 1 "1" /end COMPU_VTAB
/begin COMPU_METHOD _CNV_A_R_LINEAR_____2_CM "" RAT_FUNC "%6.3" "V" COEFFS 0 204.8 0. 0 0 1 /end COMPU_METHOD
/begin COMPU_METHOD _CNV_A_R_LINEAR_____3_CM "" RAT_FUNC "%6.3" "s" COEFFS 0 100. 0. 0 0 1 /end COMPU_METHOD
/begin COMPU_METHOD _CNV_A_R_LINEAR_____4_CM "" RAT_FUNC "%6.3" "s" COEFFS 0 10. 0. 0 0 1 /end COMPU_METHOD
/begin COMPU_METHOD _CNV_A_R_LINEAR_____6_CM "" RAT_FUNC "%6.3" "km/h" COEFFS 0 1. 0. 0 0 1 /end COMPU_METHOD
/begin COMPU_METHOD _CNV_A_R_LINEAR_____8_CM "" RAT_FUNC "%6.3" "%" COEFFS 0 655.3599999999997 0. 0 0 1 /end COMPU_METHOD
/begin COMPU_METHOD _CNV_A_R_LINEAR_____9_CM "" RAT_FUNC "%6.3" "-" COEFFS 0 32767.99999999992 0. 0 0 1 /end COMPU_METHOD
/begin COMPU_METHOD _CNV_A_R_LINEAR_____10_CM "" RAT_FUNC "%6.3" "rpm" COEFFS 0 3.125e-002 0. 0 0 1 /end COMPU_METHOD
/begin COMPU_METHOD _CNV_A_R_LINEAR_____17_CM "" RAT_FUNC "%6.3" "°C" COEFFS 0 1.333333333333333 64. 0 0 1 /end COMPU_METHOD
/begin COMPU_METHOD _CNV_A_R_LINEAR_____25_CM "" RAT_FUNC "%6.3" "°C" COEFFS 0 1.333333333333333 0. 0 0 1 /end COMPU_METHOD
/begin COMPU_METHOD _CNV_A_R_LINEAR_____26_CM "" RAT_FUNC "%6.3" "°C" COEFFS 0 1. 40. 0 0 1 /end COMPU_METHOD
/begin COMPU_METHOD _CNV_A_R_LINEAR_____27_CM "" RAT_FUNC "%6.3" "hPa" COEFFS 0 12.06017666543982 0. 0 0 1 /end COMPU_METHOD
/begin COMPU_METHOD _CNV_A_R_LINEAR_____28_CM "" RAT_FUNC "%6.3" "-" COEFFS 0 256. 0. 0 0 1 /end COMPU_METHOD
/begin COMPU_METHOD _CNV_A_R_LINEAR_____41_CM "" RAT_FUNC "%6.3" "m/s²" COEFFS 0 640. 0. 0 0 1 /end COMPU_METHOD
/begin COMPU_METHOD _CNV_A_R_LINEAR_____58_CM "" RAT_FUNC "%6.3" "km" COEFFS 0 0.1 0. 0 0 1 /end COMPU_METHOD
/begin COMPU_METHOD _CNV_A_R_LINEAR_____87_CM "" RAT_FUNC "%6.3" "Nm" COEFFS 0 32. 32768. 0 0 1 /end COMPU_METHOD
/begin COMPU_METHOD _CNV_A_R_LINEAR_____89_CM "" RAT_FUNC "%6.3" "-" COEFFS 0 65535.99999999996 0. 0 0 1 /end COMPU_METHOD
/begin COMPU_METHOD _CNV_A_R_LINEAR_____103_CM "" RAT_FUNC "%6.3" "-" COEFFS 0 128. 0. 0 0 1 /end COMPU_METHOD
/begin COMPU_METHOD _CNV_A_R_LINEAR_____110_CM "" RAT_FUNC "%6.3" "s" COEFFS 0 50. 0. 0 0 1 /end COMPU_METHOD
/begin COMPU_METHOD _CNV_A_R_LINEAR_____111_CM "" RAT_FUNC "%6.3" "mg/stk" COEFFS 0 47.18142548596112 0. 0 0 1 /end COMPU_METHOD
/begin COMPU_METHOD _CNV_A_R_LINEAR_____113_CM "" RAT_FUNC "%6.3" "%" COEFFS 0 655.3599999999997 -1.455191522836685e-011 0 0 1 /end COMPU_METHOD
/begin COMPU_METHOD _CNV_A_R_LINEAR_____129_CM "" RAT_FUNC "%6.3" "-" COEFFS 0 1024. 0. 0 0 1 /end COMPU_METHOD
/begin COMPU_METHOD _CNV_A_R_LINEAR_____165_CM "" RAT_FUNC "%6.3" "-" COEFFS 0 65535. 0. 0 0 1 /end COMPU_METHOD
/begin COMPU_METHOD _CNV_A_R_LINEAR_____178_CM "" RAT_FUNC "%6.3" "%" COEFFS 0 655.3600000071681 32768.00000035841 0 0 1 /end COMPU_METHOD
/begin COMPU_METHOD _CNV_A_R_LINEAR_____209_CM "" RAT_FUNC "%6.3" "°C" COEFFS 0 64. 0. 0 0 1 /end COMPU_METHOD
/begin COMPU_METHOD _CNV_A_R_LINEAR_____215_CM "" RAT_FUNC "%6.3" "kg/h" COEFFS 0 32. 0. 0 0 1 /end COMPU_METHOD
/begin COMPU_METHOD _CNV_A_R_LINEAR_____219_CM "" RAT_FUNC "%6.3" "mV" COEFFS 0 1. 200. 0 0 1 /end COMPU_METHOD
/begin COMPU_METHOD _CNV_A_R_LINEAR_____243_CM "" RAT_FUNC "%6.3" "" COEFFS 0 64. 0. 0 0 1 /end COMPU_METHOD
/begin COMPU_METHOD _CNV_A_R_LINEAR_____244_CM "" RAT_FUNC "%6.3" "mg" COEFFS 0 6.25 0. 0 0 1 /end COMPU_METHOD
/begin COMPU_METHOD _CNV_S_6_STATE_NOX__245_CM "" TAB_VERB "%6.3" "-" COMPU_TAB_REF _CNV_S_6_STATE_NOX__245 /end COMPU_METHOD
/begin COMPU_VTAB _CNV_S_6_STATE_NOX__245 "" TAB_VERB 6 0 "PASSIV" 1 "LOAD" 2 "REGENERATION" 3 "WAIT" 4 "STOP" 5 "WARMUP" /end COMPU_VTAB
/begin COMPU_METHOD _CNV_A_R_LINEAR_____247_CM "" RAT_FUNC "%6.3" "Bar" COEFFS 0 1000. 0. 0 0 1 /end COMPU_METHOD
/begin COMPU_METHOD _CNV_A_R_LINEAR_____255_CM "" RAT_FUNC "%6.3" "km" COEFFS 0 0.125 0. 0 0 1 /end COMPU_METHOD
/begin COMPU_METHOD _CNV_A_R_LINEAR_____259_CM "" RAT_FUNC "%6.3" "-" COEFFS 0 32768. 0. 0 0 1 /end COMPU_METHOD
/begin COMPU_METHOD _CNV_A_R_LINEAR_____279_CM "" RAT_FUNC "%6.3" "hPa" COEFFS 0 12.06017666543982 -4.001776687800884e-011 0 0 1 /end COMPU_METHOD
/begin COMPU_METHOD _CNV_A_R_LINEAR_____314_CM "" RAT_FUNC "%6.3" "g" COEFFS 0 22.49999999999997 0. 0 0 1 /end COMPU_METHOD
/begin COMPU_METHOD _CNV_A_R_LINEAR_____434_CM "" RAT_FUNC "%6.3" "m" COEFFS 0 1.e-002 0. 0 0 1 /end COMPU_METHOD
/begin COMPU_METHOD _CNV_A_R_ENTE_LINEA_443_CM "" RAT_FUNC "%6.3" "°C" COEFFS 0 1.333333333333333 128. 0 0 1 /end COMPU_METHOD
/begin COMPU_METHOD _CNV_A_R_LINEAR_____473_CM "" RAT_FUNC "%6.3" "V" COEFFS 0 35.63776976537597 0. 0 0 1 /end COMPU_METHOD
/begin COMPU_METHOD _CNV_A_R_LINEAR_____481_CM "" RAT_FUNC "%6.3" "°C" COEFFS 0 0.25 0. 0 0 1 /end COMPU_METHOD
/begin COMPU_METHOD _CNV_A_R_NOXM_LINEA_482_CM "" RAT_FUNC "%6.3" "1/km" COEFFS 0 -327680. 0. 0 0 1 /end COMPU_METHOD
/begin COMPU_METHOD _CNV_A_R_LINEAR_____484_CM "" RAT_FUNC "%6.3" "mg" COEFFS 0 3.125 -0.5 0 0 1 /end COMPU_METHOD
/begin COMPU_METHOD _CNV_A_R_LINEAR_____485_CM "" RAT_FUNC "%6.3" "mg" COEFFS 0 3.124952315556573 0. 0 0 1 /end COMPU_METHOD
/begin COMPU_METHOD _CNV_A_R_NOXD_LINEA_486_CM "" RAT_FUNC "%6.3" "ppm" COEFFS 0 1. 0. 0 0 1 /end COMPU_METHOD
/begin COMPU_METHOD _CNV_S_4_NOXD_NOX_O_487_CM "" TAB_VERB "%6.3" "-" COMPU_TAB_REF _CNV_S_4_NOXD_NOX_O_487 /end COMPU_METHOD
/begin COMPU_VTAB _CNV_S_4_NOXD_NOX_O_487 "" TAB_VERB 4 0 "PUC_OFFSET" 1 "LOAD_OFFSET" 2 "MIN_OFFSET" 3 "MAN_OFFSET" /end COMPU_VTAB
/begin COMPU_METHOD _CNV_A_R_NOXD_LINEA_488_CM "" RAT_FUNC "%6.3" "ppm" COEFFS 0 1. 100. 0 0 1 /end COMPU_METHOD
/begin COMPU_METHOD _CNV_A_R_LINEAR_____489_CM "" RAT_FUNC "%6.3" "mg/s" COEFFS 0 64. 0. 0 0 1 /end COMPU_METHOD
/begin COMPU_METHOD _CNV_A_R_LINEAR_____490_CM "" RAT_FUNC "%6.3" "mg/s" COEFFS 0 4. 0. 0 0 1 /end COMPU_METHOD
/begin COMPU_METHOD _CNV_A_R_LINEAR_____491_CM "" RAT_FUNC "%6.3" "-" COEFFS 0 511.9921875 0. 0 0 1 /end COMPU_METHOD
/begin COMPU_METHOD _CNV_A_R_LINEAR_____492_CM "" RAT_FUNC "%6.3" "-" COEFFS 0 7.9998779296875 0. 0 0 1 /end COMPU_METHOD
/begin COMPU_METHOD _CNV_S_4_STATE_RGN__493_CM "" TAB_VERB "%6.3" "-" COMPU_TAB_REF _CNV_S_4_STATE_RGN__493 /end COMPU_METHOD
/begin COMPU_VTAB _CNV_S_4_STATE_RGN__493 "" TAB_VERB 4 0 "SENSOR" 1 "MODEL" 2 "SENSOR_MODEL" 3 "TIME" /end COMPU_VTAB
/begin COMPU_METHOD _CNV_A_R_LINEAR_____494_CM "" RAT_FUNC "%6.3" "kg/h" COEFFS 0 0.125 0. 0 0 1 /end COMPU_METHOD
/begin COMPU_METHOD _CNV_A_R_LINEAR_____495_CM "" RAT_FUNC "%6.3" "mg" COEFFS 0 3.125 0. 0 0 1 /end COMPU_METHOD
/begin COMPU_METHOD _CNV_A_R_LINEAR_____496_CM "" RAT_FUNC "%6.3" "s" COEFFS 0 49.99961926658906 0. 0 0 1 /end COMPU_METHOD
/begin COMPU_METHOD _CNV_A_R_LINEAR_____497_CM "" RAT_FUNC "%6.3" "km" COEFFS 0 10. 0. 0 0 1 /end COMPU_METHOD
/begin COMPU_METHOD _CNV_A_R_ANOX_LINEA_498_CM "" RAT_FUNC "%6.3" "g" COEFFS 0 45.00000001029984 0. 0 0 1 /end COMPU_METHOD
/begin COMPU_METHOD _CNV_A_R_ANOX_LINEA_499_CM "" RAT_FUNC "%6.3" "g/km" COEFFS 0 10000. 0. 0 0 1 /end COMPU_METHOD
/begin COMPU_METHOD _CNV_S_3_STATE_AFL__500_CM "" TAB_VERB "%6.3" "-" COMPU_TAB_REF _CNV_S_3_STATE_AFL__500 /end COMPU_METHOD
/begin COMPU_VTAB _CNV_S_3_STATE_AFL__500 "" TAB_VERB 3 0 "DISABLED" 1 "OFF" 2 "ON" /end COMPU_VTAB
/begin COMPU_METHOD _CNV_S_5_C_STATE_SE_501_CM "" TAB_VERB "%6.3" "" COMPU_TAB_REF _CNV_S_5_C_STATE_SE_501 /end COMPU_METHOD
/begin COMPU_VTAB _CNV_S_5_C_STATE_SE_501 "" TAB_VERB 5 0 "VLS_DOWN" 1 "VLS_NOX_SENS" 2 "LAMB_NOX_SENS" 3 "VLS_NT_DOWN" 4 "NONE" /end COMPU_VTAB
/begin COMPU_METHOD _CNV_A_R_LINEAR_____502_CM "" RAT_FUNC "%6.3" "mg" COEFFS 0 409599.9999999998 0. 0 0 1 /end COMPU_METHOD
/begin COMPU_METHOD _CNV_S_5_STATE_SENS_503_CM "" TAB_VERB "%6.3" "-" COMPU_TAB_REF _CNV_S_5_STATE_SENS_503 /end COMPU_METHOD
/begin COMPU_VTAB _CNV_S_5_STATE_SENS_503 "" TAB_VERB 5 0 "VLS_DOWN" 1 "VLS_NOX_SENS" 2 "LAMB_NOX_SENS" 3 "VLS_NT_DOWN" 4 "NONE" /end COMPU_VTAB
/begin COMPU_METHOD _CNV_A_R_LINEAR_____504_CM "" RAT_FUNC "%6.3" "mg/s" COEFFS 0 32. 32768. 0 0 1 /end COMPU_METHOD
/begin COMPU_METHOD _CNV_S_4_NOXM_STATE_505_CM "" TAB_VERB "%6.3" "-" COMPU_TAB_REF _CNV_S_4_NOXM_STATE_505 /end COMPU_METHOD
/begin COMPU_VTAB _CNV_S_4_NOXM_STATE_505 "" TAB_VERB 4 0 "ALL" 1 "THERMO" 2 "SUL" 3 "MAN" /end COMPU_VTAB
/begin COMPU_METHOD _CNV_A_R_NOXM_LINEA_506_CM "" RAT_FUNC "%6.3" "-" COEFFS 0 65535.99993374999 0. 0 0 1 /end COMPU_METHOD
/begin COMPU_METHOD _CNV_A_R_NOXM_LINEA_507_CM "" RAT_FUNC "%6.3" "-" COEFFS 0 4294967295. 0. 0 0 1 /end COMPU_METHOD
/begin COMPU_METHOD _CNV_A_R_NOXM_LINEA_880_CM "" RAT_FUNC "%6.3" "hPa" COEFFS 0 12.06017666543982 32767.99999999996 0 0 1 /end COMPU_METHOD
/begin COMPU_METHOD _CNV_A_R_LINEAR_____927_CM "" RAT_FUNC "%6.3" "mg/s" COEFFS 0 32. 0. 0 0 1 /end COMPU_METHOD
/begin COMPU_METHOD _CNV_S_6_NOXM_STATE_929_CM "" TAB_VERB "%6.3" "-" COMPU_TAB_REF _CNV_S_6_NOXM_STATE_929 /end COMPU_METHOD
/begin COMPU_VTAB _CNV_S_6_NOXM_STATE_929 "" TAB_VERB 6 0 "LAMB_LS_UP" 1 "VLS_DOWN" 2 "VLS_NS" 3 "LAMB_NS" 4 "VLS_NT_DOWN" 5 "MANUAL" /end COMPU_VTAB
/begin RECORD_LAYOUT _REC_VAL_20_u1 FNC_VALUES 1 UBYTE COLUMN_DIR DIRECT /end RECORD_LAYOUT
/begin RECORD_LAYOUT _REC_VAL_20_u2 FNC_VALUES 1 UWORD COLUMN_DIR DIRECT /end RECORD_LAYOUT
/begin RECORD_LAYOUT _REC_AXS_20_u1 NO_AXIS_PTS_X 1 UBYTE AXIS_PTS_X 2 UBYTE INDEX_INCR DIRECT /end RECORD_LAYOUT
/begin RECORD_LAYOUT _REC_MAP_20_u2_u1_u1 FNC_VALUES 1 UWORD COLUMN_DIR DIRECT /end RECORD_LAYOUT
/begin RECORD_LAYOUT _REC_CUR_20_u1_u1 FNC_VALUES 1 UBYTE COLUMN_DIR DIRECT /end RECORD_LAYOUT
/begin RECORD_LAYOUT _REC_VAL_20_s2 FNC_VALUES 1 SWORD COLUMN_DIR DIRECT /end RECORD_LAYOUT
/begin RECORD_LAYOUT _REC_MAP_20_u2_u2_u1 FNC_VALUES 1 UWORD COLUMN_DIR DIRECT /end RECORD_LAYOUT
/begin RECORD_LAYOUT _REC_AXS_20_u2 NO_AXIS_PTS_X 1 UWORD AXIS_PTS_X 2 UWORD INDEX_INCR DIRECT /end RECORD_LAYOUT
/begin RECORD_LAYOUT _REC_CUR_20_u2_u1 FNC_VALUES 1 UWORD COLUMN_DIR DIRECT /end RECORD_LAYOUT
/begin RECORD_LAYOUT _REC_CUR_20_u2_u2 FNC_VALUES 1 UWORD COLUMN_DIR DIRECT /end RECORD_LAYOUT
/begin RECORD_LAYOUT _REC_MAP_20_u2_u2_u2 FNC_VALUES 1 UWORD COLUMN_DIR DIRECT /end RECORD_LAYOUT
/begin RECORD_LAYOUT _REC_MAP_20_u2_u1_u2 FNC_VALUES 1 UWORD COLUMN_DIR DIRECT /end RECORD_LAYOUT
/begin RECORD_LAYOUT _REC_MAP_20_u1_u2_u2 FNC_VALUES 1 UBYTE COLUMN_DIR DIRECT /end RECORD_LAYOUT
/begin RECORD_LAYOUT _REC_MAP_20_u1_u1_u1 FNC_VALUES 1 UBYTE COLUMN_DIR DIRECT /end RECORD_LAYOUT
/begin RECORD_LAYOUT _REC_MAP_20_u1_u2_u1 FNC_VALUES 1 UBYTE COLUMN_DIR DIRECT /end RECORD_LAYOUT
/begin RECORD_LAYOUT _REC_MAP_20_u1_u1_u2 FNC_VALUES 1 UBYTE COLUMN_DIR DIRECT /end RECORD_LAYOUT
/begin FUNCTION INJ_NOx_catalyst_management_catalyst_states "_NOx catalyst management-catalyst states"
 /begin DEF_CHARACTERISTIC c_lamb_o2_stc c_o2_flow_cor_fac c_fac_o2_equ c_fac_cor_o2l c_lamb_stc c_lamb_rgn c_ntl_ini_st c_ntld_rgn_st_ini c_ntld_lgrd c_nox_conc_cor c_crlc_nox_conc_red c_crlc_nox_cor_red c_crlc_nox_conc_out_mdl c_ntld_nt_hom_rst c_t_afl_nt_hom_rst lc_nt_afs_req c_state_rgn_ctl c_t_afl_rgn_req_ntld c_t_afl_min c_vls_nox_sens_rgn_stop c_lamb_nox_sens_rgn_stop c_lamb_nox_sens_afr_trim c_o2l_min c_sum_o2l_ntl_max c_ntl_trig_afr_afl c_tnt_mdl_inh_purge lc_nox_sens lc_nox_sens_rgn lc_sum_ntl_cyc_new lc_ntld_max_afs lc_inh_rgn_pu c_tnt_mdl_min_hys c_tnt_mdl_max_hys ldp_nox_conc_mmv_ip_nt_stc_bas ldpm_tnt_mdl_nox ldp_nt_agi_ntld_ip_nt_agi_rgn ldp_tnt_mdl_mv_ip_nt_agi_rgn ldpm_n_32_1 ldp_flow_nt_mmv_ip_t_rgn_max ldpm_maf_kgh_ip_t_nt_hom ldpm_lamb_av_cor_ip_t_nt_hom ldp_tqi_req_fast_ip_ntld_max ip_nox_red_fac ip_nt_eff_bas ip_nt_eff_cor ip_o2_stc_max ip_nt_agi_rgn_frq ip_ntl_min ip_ntld_max ip_ntld_max_adj id_vls_down_rgn_stop ip_t_nt_hom_dec ip_t_nt_hom_inc ip_t_rgn_max lc_rpu_state_nox lc_rpu_nt_eff_cor lc_rpu_nt_stc_bas lc_rpu_ntl lc_rpu_rgn_nt_req lc_rpu_nt_afs_req lc_rpu_rgn_agi lc_rpu_act_int_puc_afl lc_rpu_sens_afr lc_rpu_state_tran_calc c_nox_out_mes_int_max ldpm_ntld ldpm_nt_agi ldp_tqi_req_fast_ip_ntld_afs_at ldp_tqi_req_fast_ip_ntld_afs_mt ldp_n_32_ntld_max_afs_mt ldp_n_32_ntld_max_afs_at ip_fac_nox_sens_max c_fac_ntld_max_afs_err_egr ldp_flow_nt_mmv_ip_nox_sens_mt ldp_flow_nt_mmv_ip_nox_sens_at ldp_n_32_ip_nox_sens_max_mt ldp_n_32_ip_nox_sens_max_at c_nox_sens_max_ofs ldp_nt_agi_thermo__tnt_mdl_max ip_ntld_max_afs_at ip_ntld_max_afs_mt ip_nox_sens_max_mt ip_nox_sens_max_at c_nt_stc_bas_max_rng_h ip_nt_stc_bas_rng_h c_nt_stc_ini_rng_h lc_nt_act lc_sens_afr_mod c_t_nt_hom_max_vld c_vls_nox_sens_afr_trim c_vls_dist_grd_neg c_vls_dist_grd_pos c_vls_max_rgn_2_stop ip_tnt_mdl_min ip_tnt_mdl_min_is ldp_nt_agi_thermo__tnt_mdl_min ldp_nt_agi_thermo_ip_tnt_min_is c_vls_max_rgn_1_stop c_vls_grd_neg_vls_set c_vls_down_afr_trim c_t_stop_afl_purge_max c_maf_int_stop_afl_purge_max c_ctr_afl_purge_max c_vls_down_afl_purge_on c_vls_down_afl_purge_off c_vls_nox_sens_afl_purge_on c_vls_nox_sens_afl_purge_off c_lamb_nox_sens_afl_purge_on c_lamb_nox_sens_afl_purge_off c_vs_inh_purge lc_nox_rpu lc_inh_afl_purge_tout ldpm_tqi_req_fast_1_egtr ldp_tnt_mdl_mv_ip_fac_nox_sens ldp_nox_cor_ip_nt_eff_cor ip_tnt_mdl_max ldp_ntl_dec_int_ip_t_max_rgn ldp_ntl_rgn_st_ip_t_max_rgn ldp_ntl_rgn_st_ip_ntl_dec_int ip_t_max_rgn_2_stop ip_ntl_dec_int_max c_dist_afl_min c_ratio_nox_out_int_dist_max c_nox_cor_int_min c_crlc_flow_nt c_ratio_nox_max c_state_sens_afl_purge[0] c_state_sens_afl_purge[1] ldp_lamb_ls_up_mv_ip_o2_stc_max c_state_sens_afr[0] c_state_sens_afr[1] c_state_sens_afr_trim[0] c_state_sens_afr_trim[1] c_nox_ns_ad_rgn_stop c_nox_ns_ad_dif_mon c_t_nt_hom c_t_rgn_max_diag ldp_tnt_mdl_mv_ip_nox_red_fac ldp_ntld_rgn_st_id_vls_down ip_nt_eff_bas_ef_close ip_nox_cor_s_afs_req ip_nox_cor_homs_afs_req ldp_tnt_mdl_l_ip_nox_cor_s ldp_tnt_mdl_l_ip_nox_cor_homs ldp_nt_agi_ip_nox_cor_s ldp_nt_agi_ip_nox_cor_homs ip_nox_cor_s_afs_req_hys ip_nox_cor_homs_afs_req_hys ldp_maf_mmv_nox_pred_ip_nox_s ldp_maf_mmv_nox_pred_ip_nox_hom c_sum_ntl_cyc_sp c_t_nt_afs_req_pred_max c_crlc_maf_mmv_nox_pred /end DEF_CHARACTERISTIC
 /begin OUT_MEASUREMENT lv_trig_afr_afl lv_rgn_nt_req lv_nox_sens_rgn lv_nox_sens lv_afl_not lv_rgn_stop_sens lv_rgn_stop_tout lv_rgn_stop_mdl lv_rgn_req_ntld lv_rgn_req_nox_sens lv_rgn_req_ntld_afs lv_sens_afr_trim lv_nt_hom_ini lv_t_afl_min lv_mdl_afr lv_tout_afr nox_conc_raw nox_conc_red nox_conc nox_conc_red_mmv_rgn_st nox_conc_red_mmv nox_sens_max nox_conc_mmv nox_conc_out_mdl nox_conc_out_mdl_mmv nox_cor nox_cor_red nox_flow nox_out_mdl nox_out_mdl_int nox_out_int_tmp_2 nt_eff nt_eff_cor nt_eff_cor_rgn_st ntl ntl_rgn_st_nox ntl_rgn_st o2l nt_o2_stc nt_o2_stc_bas o2_flow fac_rgn_dec_shar ntld ntld_mdl ntld_rgn_st ntld_max t_afl t_afl_puc t_nt_hom_delta sum_ntl_cyc flow_nt_mmv nt_agi_av nox_cor_red_mmv tnt_mdl_max tnt_mdl_min nt_eff_bas ntld_max_afs ntld_max_afs_bas nox_sens_max_bas nt_stc_rng_h nt_stc_bas_rng_h t_afl_sum lv_nt_act lv_sens_rgn_1_ready lv_rgn_cdn lv_vls_grd_neg ntl_min vls_min_tmp vls_max_tmp vls_nox_sens_old nox_out_int_tmp_1 nox_cor_int dist_afl_st dist_afl t_stop state_nox lv_cat_purge_req_post_afl[0] lv_cat_purge_req_post_afl[1] state_afl_purge[0] state_afl_purge[1] ctr_afl_purge[0] ctr_afl_purge[1] ratio_nox[0] ratio_nox[1] ratio_nox_out_int_dist[0] ratio_nox_out_int_dist[1] lv_rgn_agi[0] lv_rgn_agi[1] lv_rgn_agi_vld[0] lv_rgn_agi_vld[1] lv_rgn_req_nox_sens_tmp[0] lv_rgn_req_nox_sens_tmp[1] lv_act_int_puc_afl[0] lv_act_int_puc_afl[1] lv_sens_afr[0] lv_sens_afr[1] lv_sens_afr_trim_tmp[0] lv_sens_afr_trim_tmp[1] lv_nox_sens_nox_vld_rgn_st[0] lv_nox_sens_nox_vld_rgn_st[1] ntl_dec[0] ntl_dec[1] ntl_dec_int[0] ntl_dec_int[1] ntl_dec_int_swi[0] ntl_dec_int_swi[1] nox_ns_ad_tmp[0] nox_ns_ad_tmp[1] nox_ns_ad_rgn_st[0] nox_ns_ad_rgn_st[1] lv_nt_afs_req lv_nt_afs_req_pred t_nt_hom t_nt_afs_req_pred maf_int_stop maf_mmv_nox_pred /end OUT_MEASUREMENT
/end FUNCTION
/begin FUNCTION INJ_NOx_catalyst_desulfation "_NOx catalyst desulfation"
 /begin DEF_CHARACTERISTIC lc_inh_ch_so2p_man lc_inh_ch_so2p_off c_tnt_mdl_so2p_min c_tnt_mdl_so2p_hys c_tnt_mdl_so2p_fast c_tnt_mdl_so2p_fast_hys c_t_so2p_not_max c_nt_agi_so2p_max c_vs_so2p_fast_hys lc_so2p_fast_man c_lamb_so2p_pas ip_lamb_so2p c_nt_sul_so2p_max ldp_tnt_mdl_mv_ip_vs_so2p_fast ip_vs_so2p_fast_thd c_vls_ref_so2p c_vls_so2p_hys c_vls_so2p_min ldp_tnt_mdl_mv_ip_lamb_so2p c_state_sens_vls_down_so2p_act[0] c_state_sens_vls_down_so2p_act[1] /end DEF_CHARACTERISTIC
 /begin OUT_MEASUREMENT lv_inh_ch_so2p lv_so2p_req lv_so2p_fast_req lv_so2p_lamb_puls lv_so2p_act lv_so2p_afr_cord t_so2p_not t_so2p_dly lamb_so2p[0] lamb_so2p[1] lv_so2p_act_lamb[0] lv_so2p_act_lamb[1] lv_so2p_act_tnt vls_ref_so2p[0] vls_ref_so2p[1] /end OUT_MEASUREMENT
/end FUNCTION
/begin FUNCTION INJ_NOx_engine_out_emission_stratified_mode "_NOx engine out emission stratified mode"
 /begin DEF_CHARACTERISTIC ldpm_mff_sp_1_noxm ldpm_n_32_1_noxm ldpm_pq_egr_1_noxm ldpm_ratio_egr_dif_1_noxm ldpm_tia_1_noxm ldpm_map_dif_nox_1_noxm ldpm_tco_dif_nox_1_noxm ldpm_fac_maf_max_1_noxm c_amp_bas_nox_s c_tco_bas_nox_s ip_nox_map_dif_s ip_nox_s ip_nox_tco_s ip_nox_tia_s ip_fac_maf_max_nox_s ip_nox_tco_s_pred ip_nox_egr_ratio_dif_s ip_nox_egr_ratio_bas_s /end DEF_CHARACTERISTIC
 /begin OUT_MEASUREMENT nox_cor_s nox_cor_s_pred map_dif_nox_s tco_dif_nox_s nox_cor_s_tmp ratio_egr_dif_nox_s /end OUT_MEASUREMENT
/end FUNCTION
/begin FUNCTION INJ_NOx___Sensor_function "_NOx - Sensor function"
 /begin DEF_CHARACTERISTIC c_maf_int_puc_min_nox c_nt_agi_nox_ofs_min c_nox_ofs_puc_max c_nt_hom_ini_use c_nox_ofs_sel c_tnt_mdl_nox_ofs_min c_tnt_mdl_nox_ofs_max c_t_afl_nox_ofs_min c_crlc_nox_ofs_puc ip_crlc_nox_ofs_load c_crlc_nox_ns_ad_delta c_ctr_nt_agi_ad_cmpl_sum_ad_min c_nox_add_zero_max c_nox_add_zero_min c_nox_ad_add_max c_nox_ad_add_min c_nox_ns_ad_add[0] c_nox_ns_ad_add[1] c_nox_ns_ad_delta_mmv_max c_nox_ns_ad_delta_mmv_min c_nox_ns_ad_max_sens_vld c_nt_agi_sul_nox_ofs_ad_min c_nt_sul_nox_ofs_ad_max c_t_nox_ns_ad_delta_min c_t_nox_ns_ofs_puc c_t_nox_ns_ofs c_t_ns_vld c_t_ns_vld_puc lc_nox_ns_ofs_vld_on ldp_nox_ns_ofs_ad_min_ip_load /end DEF_CHARACTERISTIC
 /begin OUT_MEASUREMENT nox_ns_ad[0] nox_ns_ad[1] nox_ofs_puc[0] nox_ofs_puc[1] nox_ofs_load[0] nox_ofs_load[1] lv_t_ns_vld lv_t_ns_vld_tmp[0] lv_t_ns_vld_tmp[1] lv_nox_ofs_load[0] lv_nox_ofs_load[1] nox_ns_ofs_ad_min[0] nox_ns_ofs_ad_min[1] nox_ns_ad_add[0] nox_ns_ad_add[1] t_nox_ns_ad_delta_vld[0] t_nox_ns_ad_delta_vld[1] nox_ns_ad_delta_mmv[0] nox_ns_ad_delta_mmv[1] nox_ns_ad_delta[0] nox_ns_ad_delta[1] /end OUT_MEASUREMENT
/end FUNCTION
/begin FUNCTION INJ_NOx_catalyst_Oxygen_storage_capacity_adaptation "_NOx catalyst Oxygen storage capacity adaptation"
 /begin DEF_CHARACTERISTIC c_dist_o2_stc c_dist_o2_stc_vld c_nt_o2_stc_delta lc_nt_o2_stc_req lc_nt_o2_stc_vld c_nt_o2_stc_ad_man lc_nt_o2_stc_ad_man lc_nt_o2_stc_rep_off /end DEF_CHARACTERISTIC
 /begin OUT_MEASUREMENT lv_nt_o2_stc_req lv_nt_o2_stc_lim lv_nt_o2_stc_vld nt_o2_stc_ad nt_o2_stc_ofs dist_o2_stc_old dist_nt ntl_dec_int_ad /end OUT_MEASUREMENT
/end FUNCTION
/begin FUNCTION INJ_Application_Incidence_for_NOx_Cat_Desulfation_Lambda_Stimulation "_Application Incidence for NOx Cat Desulfation Lambda Stimulation" /begin DEF_CHARACTERISTIC lc_inh_lamb_puls_so2p_man lc_inh_lamb_puls_so2p_off /end DEF_CHARACTERISTIC
 /begin OUT_MEASUREMENT lv_inh_lamb_puls_so2p t_afl_down_lock[0] t_afl_down_lock[1] t_vls_down_cyc_afr[0] t_vls_down_cyc_afr[1] /end OUT_MEASUREMENT
/end FUNCTION
/begin FUNCTION INJ_NOx_engine_out_emission_homogeneous_mode "_NOx engine out emission homogeneous mode"
 /begin DEF_CHARACTERISTIC c_amp_bas_nox_homs c_tco_bas_nox_homs ip_nox_map_dif_homs ip_nox_homs ip_nox_tco_homs ip_nox_tia_homs ip_fac_maf_max_nox_homs ip_nox_tco_homs_pred ip_nox_egr_ratio_dif_homs ip_nox_egr_ratio_bas_homs /end DEF_CHARACTERISTIC
 /begin OUT_MEASUREMENT nox_cor_homs nox_cor_homs_pred map_dif_nox_homs tco_dif_nox_homs nox_cor_homs_tmp ratio_egr_dif_nox_homs /end OUT_MEASUREMENT
/end FUNCTION
/begin FUNCTION INJ_NOx_catalyst_desulfation___heating_activation "_NOx catalyst desulfation - heating activation" /end FUNCTION
/begin FUNCTION INJ_Application_incidence_for_NOx_cat_aging "_Application incidence for NOx cat aging"
 /begin DEF_CHARACTERISTIC c_tnt_mdl_nt_agi_delta c_tnt_mdl_nt_agi_dyw c_crlc_tnt_mdl_nt_agi_dyw lc_inh_nt_agi_man lc_inh_nt_agi_off c_tnt_mdl_nt_agi_min c_tnt_mdl_nt_agi_max c_n_32_nt_agi_max c_n_32_nt_agi_min c_mff_sp_s_nt_agi_max c_mff_sp_s_nt_agi_min c_lamb_nt_agi_min c_tia_nt_agi_min c_toil_nt_agi_max c_toil_nt_agi_min c_amp_nt_agi_min c_tnt_mdl_mv_agi_min c_tnt_mdl_mv_agi_max lc_nox_sens_max_agi_adj_ena /end DEF_CHARACTERISTIC
/end FUNCTION
/begin FUNCTION INJ_NOx_Catalyst_aging "_NOx Catalyst aging"
 /begin DEF_CHARACTERISTIC c_ctr_km_can_dif_min c_nt_agi_1 c_nt_agi_2 c_nt_agi_3 c_nt_agi_ntld_man c_nt_agi_s_red_man c_nt_agi_obs_min c_nt_agi_obs_min_is c_crlc_nt_agi_thermo_inc c_crlc_nt_agi_thermo_dec c_crlc_nt_agi_sul c_crlc_nt_agi_obs c_nt_sul_max_1 c_sul_thd_agi_thermo c_nt_sul_ext_adj c_ctr_nt_agi_ad_max c_ctr_nt_agi_ad_cmpl_max c_nox_ppm_min_agi c_tnt_mdl_nt_agi_obs_ini c_tnt_mdl_agi_ena_tnt c_t_afl_max_agi_ena c_vs_obs_min lc_nt_agi_ini_man lc_nt_agi_man lc_nt_agi_sul_ini lc_nt_agi_thermo_ini lc_agi_ad_trig_man lc_sul_thermo_cor lc_ena_sul_upd lc_sul_upd lc_nt_agi_nt_sul_mpg lc_nt_agi_min lc_nt_agi_egr_close lc_nt_agi_obs_ini lc_nt_agi_ad_ctr_rst_tnt lc_nox_ad_cmpl_off c_state_nt_agi_ntld c_state_nt_agi_s_red ldp_nt_sul_ip_nt_agi_nt_sul ldp_nt_agi_sul_ip_nt_sul_nt_agi ip_ntld_agi ip_nt_agi_nt_sul ip_nt_sul_nt_agi ip_nt_sul_h_min ldpm_nox_eff ldpm_tnt_mdl_nox_nt ldpm_nt_agi_thermo c_nt_agi_obs_min_egr_err ip_ntld_agi_ef_close ip_nt_sul_max_2_deac ip_nt_sul_max_2 ip_nt_sul_max_3 c_nt_agi_obs_min_2 c_nt_sul_so2p_fq c_fac_su_conc_fuel c_ctr_nt_agi_so2p_fq_min c_ntld_so2p_fq c_nt_agi_thermo_so2p_fq_ini c_nt_agi_ini[0] c_nt_agi_ini[1] /end DEF_CHARACTERISTIC
 /begin OUT_MEASUREMENT lv_inh_nt_agi_err tnt_mdl_nt_agi_dyw[0] tnt_mdl_nt_agi_dyw[1] lv_inh_nt_agi lv_inh_nt_agi_tnt lv_inh_nt_agi_thd lv_inh_nt_agi_bas lv_nt_agi_obs_ena lv_nt_agi_obs_egr_ena lv_nox_sens_max_adj lv_inh_nt_agi_tnt_bas nt_agi_thermo_st nt_agi_thermo_grd ctr_km_can_st nt_agi nt_agi_sul nt_agi_thermo nt_agi_ntld nt_agi_s_red nt_agi_obs nt_sul_agi nt_sul_upd lv_nt_afs_req_agi lv_agi_ad_trig lv_so2p_req_1 lv_so2p_req_2 lv_cdn_nt_agi_thermo_ad lv_agi_vld lv_nt_agi_bas_ena lv_nt_agi_ena_tmp lv_nt_agi_ena lv_nt_agi_ena_tnt lv_nt_agi_ena_afs lv_nt_agi_ena_afs_tmp lv_egr_ratio_sp_agi_act ctr_nt_agi_ad ctr_nt_agi_ad_cmpl ctr_nt_agi_ad_cmpl_sum lv_so2p_req_fq fac_su_conc_fuel lv_nt_afs_req_agi_tmp_3 lv_nt_afs_req_agi_tmp_2 lv_nt_afs_req_agi_tmp_1 ctr_nt_agi_so2p_fq dif_ctr_nt_agi_cmpl_sum nt_agi_so2p_fq nt_agi_so2p_fq_sum nt_agi_sul_sng[0] nt_agi_sul_sng[1] nt_agi_thermo_sng[0] nt_agi_thermo_sng[1] nt_agi_bas[0] nt_agi_bas[1] nt_agi_obs_sng[0] nt_agi_obs_sng[1] nox_eff[0] nox_eff[1] nt_sul_agi_sng[0] nt_sul_agi_sng[1] ntld_agi[0] ntld_agi[1] /end OUT_MEASUREMENT
/end FUNCTION
/begin FUNCTION C_2_BIO "C_2_BIO"
 /begin SUB_FUNCTION BIO_Standard_analog_inputs BIO_Keyword_Protocol_2000 BIO_Logic_inputs BIO_Acquisition_of_after_ignition_key_battery_voltage BIO_MSW_interface BIO_PWM_outputs BIO_Acquisition_of_oil_pressure BIO_Acquisition_of_mass_air_flow BIO_Acquisition_of_fuel_pressure /end SUB_FUNCTION
/end FUNCTION
/begin FUNCTION BIO_Standard_analog_inputs "_Standard analog inputs" /begin OUT_MEASUREMENT v_amp v_dmtl v_sof_swi v_sof_swi_mon /end OUT_MEASUREMENT /end FUNCTION
/begin FUNCTION BIO_Keyword_Protocol_2000 "_Keyword Protocol 2000" /end FUNCTION
/begin FUNCTION BIO_Logic_inputs "_Logic inputs" /end FUNCTION
/begin FUNCTION BIO_Acquisition_of_after_ignition_key_battery_voltage "_Acquisition of after ignition key battery voltage" /begin OUT_MEASUREMENT lv_key_off v_igk_bas v_igk_mes vb_mes vb_bas /end OUT_MEASUREMENT /end FUNCTION
/begin FUNCTION BIO_MSW_interface "_MSW interface" /end FUNCTION
/begin FUNCTION BIO_PWM_outputs "_PWM outputs" /begin OUT_MEASUREMENT ivvtpwm_in[0] ivvtpwm_in[1] ivvtpwm_ex[0] ivvtpwm_ex[1] /end OUT_MEASUREMENT /end FUNCTION
/begin FUNCTION BIO_Acquisition_of_oil_pressure "Acquisition of oil pressure"
 /begin DEF_CHARACTERISTIC ldp_v_poil_ip_poil_v_poil ip_poil_v_poil c_poil_err_sub lc_poil_ctl_ena c_t_poil_swi_bas c_t_poil_swi_lgt c_t_poil_swi_trv c_poil_ac_veh_lgt_tcs c_poil_ac_veh_trv_tcs /end DEF_CHARACTERISTIC
 /begin OUT_MEASUREMENT lv_poil_swi poil t_poil_swi lv_bios_poil_swi v_poil /end OUT_MEASUREMENT
/end FUNCTION
/end MODULE
/end PROJECT
