ASAP2_VERSION 1 41
/begin PROJECT MSD85 "Spray Guided DI-System with Piezo Injectors for 8-Cylinder"
/begin HEADER "_default_HeaderComment" PROJECT_NO _91 /end HEADER
/begin MODULE _default_ModuleName "_default_ModuleLongIdentifier"
/begin MOD_COMMON "_default_ModCommonComment" DEPOSIT ABSOLUTE BYTE_ORDER MSB_LAST ALIGNMENT_BYTE 1 ALIGNMENT_WORD 2 ALIGNMENT_LONG 2 ALIGNMENT_FLOAT32_IEEE 2 ALIGNMENT_FLOAT64_IEEE 4 /end MOD_COMMON
/begin MEASUREMENT injr.STR_INJR_ISPCLEGYIV0.str_injr_ispclegyiv0_pls_l[0].lv_iv_egy_rng "Flag for the injector energy range of the first pulse (0 = low range, 1 = high range)" UBYTE _CNV_S_2_RANGE__0___1_CM 1 100. 0. 1. DISPLAY_IDENTIFIER LV_IV_EGY_RNG_1 ECU_ADDRESS 0xd0006e4c BIT_MASK 0x1 /end MEASUREMENT
/begin MEASUREMENT injr.STR_INJR_ISPCLEGYIV0.str_injr_ispclegyiv0_pls_l[0].str_injr_ispclegyiv0_mod_ti_l.ti_min_stnd_egy_h "Minimum stratified injection time for high energy range, 1. pulse" UWORD _CNV_A_R_LINEAR_____228_CM 1 100. 0. 65.535 DISPLAY_IDENTIFIER TI_1_MIN_STND_EGY_H_S ECU_ADDRESS 0xd0006e50 /end MEASUREMENT
/begin MEASUREMENT injr.STR_INJR_ISPCLEGYIV0.str_injr_ispclegyiv0_pls_l[0].str_injr_ispclegyiv0_mod_ti_l.mff_sp_tot[0] "Total MFF-setpoint corrected by MFF-difference factor - stratified operation (1. pulse)" UWORD _CNV_A_R_LINEAR_____111_CM 1 100. 0. 1389. DISPLAY_IDENTIFIER MFF_SP_1_TOT_S[0] ECU_ADDRESS 0xd0006e54 FORMAT "%7.2" /end MEASUREMENT
/begin MEASUREMENT injr.STR_INJR_ISPCLEGYIV0.str_injr_ispclegyiv0_pls_l[0].str_injr_ispclegyiv0_mod_ti_l.mff_sp_tot[1] "Total MFF-setpoint corrected by MFF-difference factor - stratified operation (1. pulse)" UWORD _CNV_A_R_LINEAR_____111_CM 1 100. 0. 1389. DISPLAY_IDENTIFIER MFF_SP_1_TOT_S[1] ECU_ADDRESS 0xd0006e56 FORMAT "%7.2" /end MEASUREMENT
/begin MEASUREMENT injr.STR_INJR_ISPCLEGYIV0.str_injr_ispclegyiv0_pls_l[0].str_injr_ispclegyiv0_mod_ti_l.mff_sp_tot[2] "Total MFF-setpoint corrected by MFF-difference factor - stratified operation (1. pulse)" UWORD _CNV_A_R_LINEAR_____111_CM 1 100. 0. 1389. DISPLAY_IDENTIFIER MFF_SP_1_TOT_S[2] ECU_ADDRESS 0xd0006e58 FORMAT "%7.2" /end MEASUREMENT
/begin MEASUREMENT injr.STR_INJR_ISPCLEGYIV0.str_injr_ispclegyiv0_pls_l[0].str_injr_ispclegyiv0_mod_ti_l.mff_sp_tot[3] "Total MFF-setpoint corrected by MFF-difference factor - stratified operation (1. pulse)" UWORD _CNV_A_R_LINEAR_____111_CM 1 100. 0. 1389. DISPLAY_IDENTIFIER MFF_SP_1_TOT_S[3] ECU_ADDRESS 0xd0006e5a FORMAT "%7.2" /end MEASUREMENT
/begin MEASUREMENT injr.STR_INJR_ISPCLEGYIV0.str_injr_ispclegyiv0_pls_l[0].str_injr_ispclegyiv0_mod_ti_l.mff_sp_tot[4] "Total MFF-setpoint corrected by MFF-difference factor - stratified operation (1. pulse)" UWORD _CNV_A_R_LINEAR_____111_CM 1 100. 0. 1389. DISPLAY_IDENTIFIER MFF_SP_1_TOT_S[4] ECU_ADDRESS 0xd0006e5c FORMAT "%7.2" /end MEASUREMENT
/begin MEASUREMENT injr.STR_INJR_ISPCLEGYIV0.str_injr_ispclegyiv0_pls_l[0].str_injr_ispclegyiv0_mod_ti_l.mff_sp_tot[5] "Total MFF-setpoint corrected by MFF-difference factor - stratified operation (1. pulse)" UWORD _CNV_A_R_LINEAR_____111_CM 1 100. 0. 1389. DISPLAY_IDENTIFIER MFF_SP_1_TOT_S[5] ECU_ADDRESS 0xd0006e5e FORMAT "%7.2" /end MEASUREMENT
/begin MEASUREMENT injr.STR_INJR_ISPCLEGYIV0.str_injr_ispclegyiv0_pls_l[0].str_injr_ispclegyiv0_mod_ti_l.mff_sp_tot[6] "Total MFF-setpoint corrected by MFF-difference factor - stratified operation (1. pulse)" UWORD _CNV_A_R_LINEAR_____111_CM 1 100. 0. 1389. DISPLAY_IDENTIFIER MFF_SP_1_TOT_S[6] ECU_ADDRESS 0xd0006e60 FORMAT "%7.2" /end MEASUREMENT
/begin MEASUREMENT injr.STR_INJR_ISPCLEGYIV0.str_injr_ispclegyiv0_pls_l[0].str_injr_ispclegyiv0_mod_ti_l.mff_sp_tot[7] "Total MFF-setpoint corrected by MFF-difference factor - stratified operation (1. pulse)" UWORD _CNV_A_R_LINEAR_____111_CM 1 100. 0. 1389. DISPLAY_IDENTIFIER MFF_SP_1_TOT_S[7] ECU_ADDRESS 0xd0006e62 FORMAT "%7.2" /end MEASUREMENT
/begin MEASUREMENT injr.STR_INJR_ISPCLEGYIV0.str_injr_ispclegyiv0_pls_l[0].str_injr_ispclegyiv0_mod_ti_l.ti_stnd[0] "Mapped Injection time, stratified mode, 1. pulse" UWORD _CNV_A_R_LINEAR_____228_CM 1 100. 0. 65.535 DISPLAY_IDENTIFIER TI_1_STND_S[0] ECU_ADDRESS 0xd0006e64 /end MEASUREMENT
/begin MEASUREMENT injr.STR_INJR_ISPCLEGYIV0.str_injr_ispclegyiv0_pls_l[0].str_injr_ispclegyiv0_mod_ti_l.ti_stnd[1] "Mapped Injection time, stratified mode, 1. pulse" UWORD _CNV_A_R_LINEAR_____228_CM 1 100. 0. 65.535 DISPLAY_IDENTIFIER TI_1_STND_S[1] ECU_ADDRESS 0xd0006e66 /end MEASUREMENT
/begin MEASUREMENT injr.STR_INJR_ISPCLEGYIV0.str_injr_ispclegyiv0_pls_l[0].str_injr_ispclegyiv0_mod_ti_l.ti_stnd[2] "Mapped Injection time, stratified mode, 1. pulse" UWORD _CNV_A_R_LINEAR_____228_CM 1 100. 0. 65.535 DISPLAY_IDENTIFIER TI_1_STND_S[2] ECU_ADDRESS 0xd0006e68 /end MEASUREMENT
/begin MEASUREMENT injr.STR_INJR_ISPCLEGYIV0.str_injr_ispclegyiv0_pls_l[0].str_injr_ispclegyiv0_mod_ti_l.ti_stnd[3] "Mapped Injection time, stratified mode, 1. pulse" UWORD _CNV_A_R_LINEAR_____228_CM 1 100. 0. 65.535 DISPLAY_IDENTIFIER TI_1_STND_S[3] ECU_ADDRESS 0xd0006e6a /end MEASUREMENT
/begin MEASUREMENT injr.STR_INJR_ISPCLEGYIV0.str_injr_ispclegyiv0_pls_l[0].str_injr_ispclegyiv0_mod_ti_l.ti_stnd[4] "Mapped Injection time, stratified mode, 1. pulse" UWORD _CNV_A_R_LINEAR_____228_CM 1 100. 0. 65.535 DISPLAY_IDENTIFIER TI_1_STND_S[4] ECU_ADDRESS 0xd0006e6c /end MEASUREMENT
/begin MEASUREMENT injr.STR_INJR_ISPCLEGYIV0.str_injr_ispclegyiv0_pls_l[0].str_injr_ispclegyiv0_mod_ti_l.ti_stnd[5] "Mapped Injection time, stratified mode, 1. pulse" UWORD _CNV_A_R_LINEAR_____228_CM 1 100. 0. 65.535 DISPLAY_IDENTIFIER TI_1_STND_S[5] ECU_ADDRESS 0xd0006e6e /end MEASUREMENT
/begin MEASUREMENT injr.STR_INJR_ISPCLEGYIV0.str_injr_ispclegyiv0_pls_l[0].str_injr_ispclegyiv0_mod_ti_l.ti_stnd[6] "Mapped Injection time, stratified mode, 1. pulse" UWORD _CNV_A_R_LINEAR_____228_CM 1 100. 0. 65.535 DISPLAY_IDENTIFIER TI_1_STND_S[6] ECU_ADDRESS 0xd0006e70 /end MEASUREMENT
/begin MEASUREMENT injr.STR_INJR_ISPCLEGYIV0.str_injr_ispclegyiv0_pls_l[0].str_injr_ispclegyiv0_mod_ti_l.ti_stnd[7] "Mapped Injection time, stratified mode, 1. pulse" UWORD _CNV_A_R_LINEAR_____228_CM 1 100. 0. 65.535 DISPLAY_IDENTIFIER TI_1_STND_S[7] ECU_ADDRESS 0xd0006e72 /end MEASUREMENT
/begin MEASUREMENT injr.STR_INJR_ISPCLEGYIV0.str_injr_ispclegyiv0_pls_l[0].str_injr_ispclegyiv0_mod_ti_l.t_cha_per "Piezo IV charge period for stratified mode first pulse" UBYTE _CNV_A_R_INJR_LINEA_466_CM 1 100. 0. 0.3 DISPLAY_IDENTIFIER T_CHA_PER_S_1 ECU_ADDRESS 0xd0006e74 FORMAT "%4.2" /end MEASUREMENT
/begin MEASUREMENT injr.STR_INJR_ISPCLEGYIV0.str_injr_ispclegyiv0_pls_l[0].str_injr_ispclegyiv0_mod_ti_l.t_dcha_per "Piezo IV discharge period for stratified mode first pulse" UBYTE _CNV_A_R_INJR_LINEA_466_CM 1 100. 0. 0.3 DISPLAY_IDENTIFIER T_DCHA_PER_S_1 ECU_ADDRESS 0xd0006e75 FORMAT "%4.2" /end MEASUREMENT
/begin MEASUREMENT injr.STR_INJR_ISPCLEGYIV0.str_injr_ispclegyiv0_pls_l[0].str_injr_ispclegyiv0_mod_mff_l.t_cha_per "Piezo IV charge period for homogeneous mode first pulse" UBYTE _CNV_A_R_INJR_LINEA_466_CM 1 100. 0. 0.3 DISPLAY_IDENTIFIER T_CHA_PER_HOM ECU_ADDRESS 0xd0006e7c FORMAT "%4.2" /end MEASUREMENT
/begin MEASUREMENT injr.STR_INJR_ISPCLEGYIV0.str_injr_ispclegyiv0_pls_l[0].str_injr_ispclegyiv0_mod_mff_l.t_dcha_per "Piezo IV discharge period for homogeneous mode first pulse" UBYTE _CNV_A_R_INJR_LINEA_466_CM 1 100. 0. 0.3 DISPLAY_IDENTIFIER T_DCHA_PER_HOM ECU_ADDRESS 0xd0006e7d FORMAT "%4.2" /end MEASUREMENT
/begin MEASUREMENT injr.STR_INJR_ISPCLEGYIV0.str_injr_ispclegyiv0_pls_l[1].lv_iv_egy_rng "Flag for the injector energy range of the second pulse (0 = low range, 1 = high range)" UBYTE _CNV_S_2_RANGE__0___1_CM 1 100. 0. 1. DISPLAY_IDENTIFIER LV_IV_EGY_RNG_2 ECU_ADDRESS 0xd0006e80 BIT_MASK 0x1 /end MEASUREMENT
/begin MEASUREMENT injr.STR_INJR_ISPCLEGYIV0.str_injr_ispclegyiv0_pls_l[1].str_injr_ispclegyiv0_mod_ti_l.ti_min_stnd_egy_h "Minimum stratified injection time for high energy range, 2. pulse" UWORD _CNV_A_R_LINEAR_____228_CM 1 100. 0. 65.535 DISPLAY_IDENTIFIER TI_2_MIN_STND_EGY_H_S ECU_ADDRESS 0xd0006e84 /end MEASUREMENT
/begin MEASUREMENT injr.STR_INJR_ISPCLEGYIV0.str_injr_ispclegyiv0_pls_l[1].str_injr_ispclegyiv0_mod_ti_l.mff_sp_tot[0] "Total MFF-setpoint corrected by MFF-difference factor - stratified operation (2. pulse)" UWORD _CNV_A_R_LINEAR_____111_CM 1 100. 0. 1389. DISPLAY_IDENTIFIER MFF_SP_2_TOT_S[0] ECU_ADDRESS 0xd0006e88 FORMAT "%7.2" /end MEASUREMENT
/begin MEASUREMENT injr.STR_INJR_ISPCLEGYIV0.str_injr_ispclegyiv0_pls_l[1].str_injr_ispclegyiv0_mod_ti_l.mff_sp_tot[1] "Total MFF-setpoint corrected by MFF-difference factor - stratified operation (2. pulse)" UWORD _CNV_A_R_LINEAR_____111_CM 1 100. 0. 1389. DISPLAY_IDENTIFIER MFF_SP_2_TOT_S[1] ECU_ADDRESS 0xd0006e8a FORMAT "%7.2" /end MEASUREMENT
/begin MEASUREMENT injr.STR_INJR_ISPCLEGYIV0.str_injr_ispclegyiv0_pls_l[1].str_injr_ispclegyiv0_mod_ti_l.mff_sp_tot[2] "Total MFF-setpoint corrected by MFF-difference factor - stratified operation (2. pulse)" UWORD _CNV_A_R_LINEAR_____111_CM 1 100. 0. 1389. DISPLAY_IDENTIFIER MFF_SP_2_TOT_S[2] ECU_ADDRESS 0xd0006e8c FORMAT "%7.2" /end MEASUREMENT
/begin MEASUREMENT injr.STR_INJR_ISPCLEGYIV0.str_injr_ispclegyiv0_pls_l[1].str_injr_ispclegyiv0_mod_ti_l.mff_sp_tot[3] "Total MFF-setpoint corrected by MFF-difference factor - stratified operation (2. pulse)" UWORD _CNV_A_R_LINEAR_____111_CM 1 100. 0. 1389. DISPLAY_IDENTIFIER MFF_SP_2_TOT_S[3] ECU_ADDRESS 0xd0006e8e FORMAT "%7.2" /end MEASUREMENT
/begin MEASUREMENT injr.STR_INJR_ISPCLEGYIV0.str_injr_ispclegyiv0_pls_l[1].str_injr_ispclegyiv0_mod_ti_l.mff_sp_tot[4] "Total MFF-setpoint corrected by MFF-difference factor - stratified operation (2. pulse)" UWORD _CNV_A_R_LINEAR_____111_CM 1 100. 0. 1389. DISPLAY_IDENTIFIER MFF_SP_2_TOT_S[4] ECU_ADDRESS 0xd0006e90 FORMAT "%7.2" /end MEASUREMENT
/begin MEASUREMENT injr.STR_INJR_ISPCLEGYIV0.str_injr_ispclegyiv0_pls_l[1].str_injr_ispclegyiv0_mod_ti_l.mff_sp_tot[5] "Total MFF-setpoint corrected by MFF-difference factor - stratified operation (2. pulse)" UWORD _CNV_A_R_LINEAR_____111_CM 1 100. 0. 1389. DISPLAY_IDENTIFIER MFF_SP_2_TOT_S[5] ECU_ADDRESS 0xd0006e92 FORMAT "%7.2" /end MEASUREMENT
/begin MEASUREMENT injr.STR_INJR_ISPCLEGYIV0.str_injr_ispclegyiv0_pls_l[1].str_injr_ispclegyiv0_mod_ti_l.mff_sp_tot[6] "Total MFF-setpoint corrected by MFF-difference factor - stratified operation (2. pulse)" UWORD _CNV_A_R_LINEAR_____111_CM 1 100. 0. 1389. DISPLAY_IDENTIFIER MFF_SP_2_TOT_S[6] ECU_ADDRESS 0xd0006e94 FORMAT "%7.2" /end MEASUREMENT
/begin MEASUREMENT injr.STR_INJR_ISPCLEGYIV0.str_injr_ispclegyiv0_pls_l[1].str_injr_ispclegyiv0_mod_ti_l.mff_sp_tot[7] "Total MFF-setpoint corrected by MFF-difference factor - stratified operation (2. pulse)" UWORD _CNV_A_R_LINEAR_____111_CM 1 100. 0. 1389. DISPLAY_IDENTIFIER MFF_SP_2_TOT_S[7] ECU_ADDRESS 0xd0006e96 FORMAT "%7.2" /end MEASUREMENT
/begin MEASUREMENT injr.STR_INJR_ISPCLEGYIV0.str_injr_ispclegyiv0_pls_l[1].str_injr_ispclegyiv0_mod_ti_l.ti_stnd[0] "Mapped Injection time, stratified mode, 2. pulse" UWORD _CNV_A_R_LINEAR_____228_CM 1 100. 0. 65.535 DISPLAY_IDENTIFIER TI_2_STND_S[0] ECU_ADDRESS 0xd0006e98 /end MEASUREMENT
/begin MEASUREMENT injr.STR_INJR_ISPCLEGYIV0.str_injr_ispclegyiv0_pls_l[1].str_injr_ispclegyiv0_mod_ti_l.ti_stnd[1] "Mapped Injection time, stratified mode, 2. pulse" UWORD _CNV_A_R_LINEAR_____228_CM 1 100. 0. 65.535 DISPLAY_IDENTIFIER TI_2_STND_S[1] ECU_ADDRESS 0xd0006e9a /end MEASUREMENT
/begin MEASUREMENT injr.STR_INJR_ISPCLEGYIV0.str_injr_ispclegyiv0_pls_l[1].str_injr_ispclegyiv0_mod_ti_l.ti_stnd[2] "Mapped Injection time, stratified mode, 2. pulse" UWORD _CNV_A_R_LINEAR_____228_CM 1 100. 0. 65.535 DISPLAY_IDENTIFIER TI_2_STND_S[2] ECU_ADDRESS 0xd0006e9c /end MEASUREMENT
/begin MEASUREMENT injr.STR_INJR_ISPCLEGYIV0.str_injr_ispclegyiv0_pls_l[1].str_injr_ispclegyiv0_mod_ti_l.ti_stnd[3] "Mapped Injection time, stratified mode, 2. pulse" UWORD _CNV_A_R_LINEAR_____228_CM 1 100. 0. 65.535 DISPLAY_IDENTIFIER TI_2_STND_S[3] ECU_ADDRESS 0xd0006e9e /end MEASUREMENT
/begin MEASUREMENT injr.STR_INJR_ISPCLEGYIV0.str_injr_ispclegyiv0_pls_l[1].str_injr_ispclegyiv0_mod_ti_l.ti_stnd[4] "Mapped Injection time, stratified mode, 2. pulse" UWORD _CNV_A_R_LINEAR_____228_CM 1 100. 0. 65.535 DISPLAY_IDENTIFIER TI_2_STND_S[4] ECU_ADDRESS 0xd0006ea0 /end MEASUREMENT
/begin MEASUREMENT injr.STR_INJR_ISPCLEGYIV0.str_injr_ispclegyiv0_pls_l[1].str_injr_ispclegyiv0_mod_ti_l.ti_stnd[5] "Mapped Injection time, stratified mode, 2. pulse" UWORD _CNV_A_R_LINEAR_____228_CM 1 100. 0. 65.535 DISPLAY_IDENTIFIER TI_2_STND_S[5] ECU_ADDRESS 0xd0006ea2 /end MEASUREMENT
/begin MEASUREMENT injr.STR_INJR_ISPCLEGYIV0.str_injr_ispclegyiv0_pls_l[1].str_injr_ispclegyiv0_mod_ti_l.ti_stnd[6] "Mapped Injection time, stratified mode, 2. pulse" UWORD _CNV_A_R_LINEAR_____228_CM 1 100. 0. 65.535 DISPLAY_IDENTIFIER TI_2_STND_S[6] ECU_ADDRESS 0xd0006ea4 /end MEASUREMENT
/begin MEASUREMENT injr.STR_INJR_ISPCLEGYIV0.str_injr_ispclegyiv0_pls_l[1].str_injr_ispclegyiv0_mod_ti_l.ti_stnd[7] "Mapped Injection time, stratified mode, 2. pulse" UWORD _CNV_A_R_LINEAR_____228_CM 1 100. 0. 65.535 DISPLAY_IDENTIFIER TI_2_STND_S[7] ECU_ADDRESS 0xd0006ea6 /end MEASUREMENT
/begin MEASUREMENT injr.STR_INJR_ISPCLEGYIV0.str_injr_ispclegyiv0_pls_l[1].str_injr_ispclegyiv0_mod_ti_l.t_cha_per "Piezo IV charge period for stratified mode second pulse" UBYTE _CNV_A_R_INJR_LINEA_466_CM 1 100. 0. 0.3 DISPLAY_IDENTIFIER T_CHA_PER_S_2 ECU_ADDRESS 0xd0006ea8 FORMAT "%4.2" /end MEASUREMENT
/begin MEASUREMENT injr.STR_INJR_ISPCLEGYIV0.str_injr_ispclegyiv0_pls_l[1].str_injr_ispclegyiv0_mod_ti_l.t_dcha_per "Piezo IV discharge period for stratified mode second pulse" UBYTE _CNV_A_R_INJR_LINEA_466_CM 1 100. 0. 0.3 DISPLAY_IDENTIFIER T_DCHA_PER_S_2 ECU_ADDRESS 0xd0006ea9 FORMAT "%4.2" /end MEASUREMENT
/begin MEASUREMENT injr.STR_INJR_ISPCLEGYIV0.str_injr_ispclegyiv0_pls_l[1].str_injr_ispclegyiv0_mod_mff_l.ti_prs_sp "Injection time setpoint for calculation of injection pressure correction at homogeneous mode, second pulse" UWORD _CNV_A_R_LINEAR_____228_CM 1 100. 0. 65.535 DISPLAY_IDENTIFIER TI_2_PRS_HOM_SP ECU_ADDRESS 0xd0006eac /end MEASUREMENT
/begin MEASUREMENT injr.STR_INJR_ISPCLEGYIV0.str_injr_ispclegyiv0_pls_l[1].str_injr_ispclegyiv0_mod_mff_l.mff_sp_min "Minimum fuel mass setpoint for the second pulse at homogeneous mode" UWORD _CNV_A_R_LINEAR_____111_CM 1 100. 0. 1389. DISPLAY_IDENTIFIER MFF_SP_2_HOM_MIN ECU_ADDRESS 0xd0006eae FORMAT "%7.2" /end MEASUREMENT
/begin MEASUREMENT injr.STR_INJR_ISPCLEGYIV0.str_injr_ispclegyiv0_pls_l[1].str_injr_ispclegyiv0_mod_mff_l.t_cha_per "Piezo IV charge period for homogeneous mode second pulse" UBYTE _CNV_A_R_INJR_LINEA_466_CM 1 100. 0. 0.3 DISPLAY_IDENTIFIER T_CHA_PER_HOM_2 ECU_ADDRESS 0xd0006eb0 FORMAT "%4.2" /end MEASUREMENT
/begin MEASUREMENT injr.STR_INJR_ISPCLEGYIV0.str_injr_ispclegyiv0_pls_l[1].str_injr_ispclegyiv0_mod_mff_l.t_dcha_per "Piezo IV discharge period for homogeneous mode second pulse" UBYTE _CNV_A_R_INJR_LINEA_466_CM 1 100. 0. 0.3 DISPLAY_IDENTIFIER T_DCHA_PER_HOM_2 ECU_ADDRESS 0xd0006eb1 FORMAT "%4.2" /end MEASUREMENT
/begin MEASUREMENT injr.STR_INJR_ISPCLEGYIV0.str_injr_ispclegyiv0_pls_l[2].lv_iv_egy_rng "Flag for the injector energy range of the third pulse (0 = low range, 1 = high range)" UBYTE _CNV_S_2_RANGE__0___1_CM 1 100. 0. 1. DISPLAY_IDENTIFIER LV_IV_EGY_RNG_3 ECU_ADDRESS 0xd0006eb4 BIT_MASK 0x1 /end MEASUREMENT
/begin MEASUREMENT injr.STR_INJR_ISPCLEGYIV0.str_injr_ispclegyiv0_pls_l[2].str_injr_ispclegyiv0_mod_mff_l.ti_prs_sp "Injection time setpoint for calculation of injection pressure correction at homogeneous mode, third pulse" UWORD _CNV_A_R_LINEAR_____228_CM 1 100. 0. 65.535 DISPLAY_IDENTIFIER TI_3_PRS_HOM_SP ECU_ADDRESS 0xd0006ee0 /end MEASUREMENT
/begin MEASUREMENT injr.STR_INJR_ISPCLEGYIV0.str_injr_ispclegyiv0_pls_l[2].str_injr_ispclegyiv0_mod_mff_l.mff_sp_min "Minimum fuel mass setpoint for the third pulse at homogeneous mode" UWORD _CNV_A_R_LINEAR_____111_CM 1 100. 0. 1389. DISPLAY_IDENTIFIER MFF_SP_3_HOM_MIN ECU_ADDRESS 0xd0006ee2 FORMAT "%7.2" /end MEASUREMENT
/begin MEASUREMENT injr.STR_INJR_ISPCLEGYIV0.str_injr_ispclegyiv0_pls_l[2].str_injr_ispclegyiv0_mod_mff_l.t_cha_per "Piezo IV charge period for homogeneous mode third pulse" UBYTE _CNV_A_R_INJR_LINEA_466_CM 1 100. 0. 0.3 DISPLAY_IDENTIFIER T_CHA_PER_HOM_3 ECU_ADDRESS 0xd0006ee4 FORMAT "%4.2" /end MEASUREMENT
/begin MEASUREMENT injr.STR_INJR_ISPCLEGYIV0.str_injr_ispclegyiv0_pls_l[2].str_injr_ispclegyiv0_mod_mff_l.t_dcha_per "Piezo IV discharge period for homogeneous mode third pulse" UBYTE _CNV_A_R_INJR_LINEA_466_CM 1 100. 0. 0.3 DISPLAY_IDENTIFIER T_DCHA_PER_HOM_3 ECU_ADDRESS 0xd0006ee5 FORMAT "%4.2" /end MEASUREMENT
/begin MEASUREMENT injr.STR_INJR_REQGNHOMS0.soi_1_homs[0] "Start of the first injection for homogeneous stratified mode" UWORD _CNV_A_R_LINEAR_____200_CM 1 100. 0. 720. DISPLAY_IDENTIFIER SOI_1_HOMS[0] ECU_ADDRESS 0xd0006ee8 FORMAT "%7.3" /end MEASUREMENT
/begin MEASUREMENT injr.STR_INJR_REQGNHOMS0.soi_1_homs[1] "Start of the first injection for homogeneous stratified mode" UWORD _CNV_A_R_LINEAR_____200_CM 1 100. 0. 720. DISPLAY_IDENTIFIER SOI_1_HOMS[1] ECU_ADDRESS 0xd0006eea FORMAT "%7.3" /end MEASUREMENT
/begin MEASUREMENT injr.STR_INJR_REQGNHOMS0.soi_1_homs[2] "Start of the first injection for homogeneous stratified mode" UWORD _CNV_A_R_LINEAR_____200_CM 1 100. 0. 720. DISPLAY_IDENTIFIER SOI_1_HOMS[2] ECU_ADDRESS 0xd0006eec FORMAT "%7.3" /end MEASUREMENT
/begin MEASUREMENT injr.STR_INJR_REQGNHOMS0.soi_1_homs[3] "Start of the first injection for homogeneous stratified mode" UWORD _CNV_A_R_LINEAR_____200_CM 1 100. 0. 720. DISPLAY_IDENTIFIER SOI_1_HOMS[3] ECU_ADDRESS 0xd0006eee FORMAT "%7.3" /end MEASUREMENT
/begin MEASUREMENT injr.STR_INJR_REQGNHOMS0.soi_1_homs[4] "Start of the first injection for homogeneous stratified mode" UWORD _CNV_A_R_LINEAR_____200_CM 1 100. 0. 720. DISPLAY_IDENTIFIER SOI_1_HOMS[4] ECU_ADDRESS 0xd0006ef0 FORMAT "%7.3" /end MEASUREMENT
/begin MEASUREMENT injr.STR_INJR_REQGNHOMS0.soi_1_homs[5] "Start of the first injection for homogeneous stratified mode" UWORD _CNV_A_R_LINEAR_____200_CM 1 100. 0. 720. DISPLAY_IDENTIFIER SOI_1_HOMS[5] ECU_ADDRESS 0xd0006ef2 FORMAT "%7.3" /end MEASUREMENT
/begin MEASUREMENT injr.STR_INJR_REQGNHOMS0.soi_1_homs[6] "Start of the first injection for homogeneous stratified mode" UWORD _CNV_A_R_LINEAR_____200_CM 1 100. 0. 720. DISPLAY_IDENTIFIER SOI_1_HOMS[6] ECU_ADDRESS 0xd0006ef4 FORMAT "%7.3" /end MEASUREMENT
/begin MEASUREMENT injr.STR_INJR_REQGNHOMS0.soi_1_homs[7] "Start of the first injection for homogeneous stratified mode" UWORD _CNV_A_R_LINEAR_____200_CM 1 100. 0. 720. DISPLAY_IDENTIFIER SOI_1_HOMS[7] ECU_ADDRESS 0xd0006ef6 FORMAT "%7.3" /end MEASUREMENT
/begin MEASUREMENT injr.STR_INJR_REQGNHOMS0.eoi_2_homs[0] "End of the second injection for homogeneous stratified mode" UWORD _CNV_A_R_LINEAR_____200_CM 1 100. 0. 720. DISPLAY_IDENTIFIER EOI_2_HOMS[0] ECU_ADDRESS 0xd0006ef8 FORMAT "%7.3" /end MEASUREMENT
/begin MEASUREMENT injr.STR_INJR_REQGNHOMS0.eoi_2_homs[1] "End of the second injection for homogeneous stratified mode" UWORD _CNV_A_R_LINEAR_____200_CM 1 100. 0. 720. DISPLAY_IDENTIFIER EOI_2_HOMS[1] ECU_ADDRESS 0xd0006efa FORMAT "%7.3" /end MEASUREMENT
/begin MEASUREMENT injr.STR_INJR_REQGNHOMS0.eoi_2_homs[2] "End of the second injection for homogeneous stratified mode" UWORD _CNV_A_R_LINEAR_____200_CM 1 100. 0. 720. DISPLAY_IDENTIFIER EOI_2_HOMS[2] ECU_ADDRESS 0xd0006efc FORMAT "%7.3" /end MEASUREMENT
/begin MEASUREMENT injr.STR_INJR_REQGNHOMS0.eoi_2_homs[3] "End of the second injection for homogeneous stratified mode" UWORD _CNV_A_R_LINEAR_____200_CM 1 100. 0. 720. DISPLAY_IDENTIFIER EOI_2_HOMS[3] ECU_ADDRESS 0xd0006efe FORMAT "%7.3" /end MEASUREMENT
/begin MEASUREMENT injr.STR_INJR_REQGNHOMS0.eoi_2_homs[4] "End of the second injection for homogeneous stratified mode" UWORD _CNV_A_R_LINEAR_____200_CM 1 100. 0. 720. DISPLAY_IDENTIFIER EOI_2_HOMS[4] ECU_ADDRESS 0xd0006f00 FORMAT "%7.3" /end MEASUREMENT
/begin MEASUREMENT injr.STR_INJR_REQGNHOMS0.eoi_2_homs[5] "End of the second injection for homogeneous stratified mode" UWORD _CNV_A_R_LINEAR_____200_CM 1 100. 0. 720. DISPLAY_IDENTIFIER EOI_2_HOMS[5] ECU_ADDRESS 0xd0006f02 FORMAT "%7.3" /end MEASUREMENT
/begin MEASUREMENT injr.STR_INJR_REQGNHOMS0.eoi_2_homs[6] "End of the second injection for homogeneous stratified mode" UWORD _CNV_A_R_LINEAR_____200_CM 1 100. 0. 720. DISPLAY_IDENTIFIER EOI_2_HOMS[6] ECU_ADDRESS 0xd0006f04 FORMAT "%7.3" /end MEASUREMENT
/begin MEASUREMENT injr.STR_INJR_REQGNHOMS0.eoi_2_homs[7] "End of the second injection for homogeneous stratified mode" UWORD _CNV_A_R_LINEAR_____200_CM 1 100. 0. 720. DISPLAY_IDENTIFIER EOI_2_HOMS[7] ECU_ADDRESS 0xd0006f06 FORMAT "%7.3" /end MEASUREMENT
/begin MEASUREMENT injr.STR_INJR_ISPCLCAPA0.capa_iv_dif_nom[0] "Capacity offset of the piezo injector to the nominal value." SWORD _CNV_A_R_INJR_LINEA_467_CM 1 100. -13.9802133 13.9797867 DISPLAY_IDENTIFIER CAPA_IV_DIF_NOM[0] ECU_ADDRESS 0xd0006f08 FORMAT "%6.4" /end MEASUREMENT
/begin MEASUREMENT injr.STR_INJR_ISPCLCAPA0.capa_iv_dif_nom[1] "Capacity offset of the piezo injector to the nominal value." SWORD _CNV_A_R_INJR_LINEA_467_CM 1 100. -13.9802133 13.9797867 DISPLAY_IDENTIFIER CAPA_IV_DIF_NOM[1] ECU_ADDRESS 0xd0006f0a FORMAT "%6.4" /end MEASUREMENT
/begin MEASUREMENT injr.STR_INJR_ISPCLCAPA0.capa_iv_dif_nom[2] "Capacity offset of the piezo injector to the nominal value." SWORD _CNV_A_R_INJR_LINEA_467_CM 1 100. -13.9802133 13.9797867 DISPLAY_IDENTIFIER CAPA_IV_DIF_NOM[2] ECU_ADDRESS 0xd0006f0c FORMAT "%6.4" /end MEASUREMENT
/begin MEASUREMENT injr.STR_INJR_ISPCLCAPA0.capa_iv_dif_nom[3] "Capacity offset of the piezo injector to the nominal value." SWORD _CNV_A_R_INJR_LINEA_467_CM 1 100. -13.9802133 13.9797867 DISPLAY_IDENTIFIER CAPA_IV_DIF_NOM[3] ECU_ADDRESS 0xd0006f0e FORMAT "%6.4" /end MEASUREMENT
/begin MEASUREMENT injr.STR_INJR_ISPCLCAPA0.capa_iv_dif_nom[4] "Capacity offset of the piezo injector to the nominal value." SWORD _CNV_A_R_INJR_LINEA_467_CM 1 100. -13.9802133 13.9797867 DISPLAY_IDENTIFIER CAPA_IV_DIF_NOM[4] ECU_ADDRESS 0xd0006f10 FORMAT "%6.4" /end MEASUREMENT
/begin MEASUREMENT injr.STR_INJR_ISPCLCAPA0.capa_iv_dif_nom[5] "Capacity offset of the piezo injector to the nominal value." SWORD _CNV_A_R_INJR_LINEA_467_CM 1 100. -13.9802133 13.9797867 DISPLAY_IDENTIFIER CAPA_IV_DIF_NOM[5] ECU_ADDRESS 0xd0006f12 FORMAT "%6.4" /end MEASUREMENT
/begin MEASUREMENT injr.STR_INJR_ISPCLCAPA0.capa_iv_dif_nom[6] "Capacity offset of the piezo injector to the nominal value." SWORD _CNV_A_R_INJR_LINEA_467_CM 1 100. -13.9802133 13.9797867 DISPLAY_IDENTIFIER CAPA_IV_DIF_NOM[6] ECU_ADDRESS 0xd0006f14 FORMAT "%6.4" /end MEASUREMENT
/begin MEASUREMENT injr.STR_INJR_ISPCLCAPA0.capa_iv_dif_nom[7] "Capacity offset of the piezo injector to the nominal value." SWORD _CNV_A_R_INJR_LINEA_467_CM 1 100. -13.9802133 13.9797867 DISPLAY_IDENTIFIER CAPA_IV_DIF_NOM[7] ECU_ADDRESS 0xd0006f16 FORMAT "%6.4" /end MEASUREMENT
/begin MEASUREMENT injr.STR_INJR_ISPCLCAPA0.capa_iv_1_fil[0] "Capacity of the piezo injector for the first pulse, filtered value." UWORD _CNV_A_R_INJR_LINEA_464_CM 1 100. 0. 27.96 DISPLAY_IDENTIFIER CAPA_IV_1_FIL[0] ECU_ADDRESS 0xd0006f18 FORMAT "%5.4" /end MEASUREMENT
/begin MEASUREMENT injr.STR_INJR_ISPCLCAPA0.capa_iv_1_fil[1] "Capacity of the piezo injector for the first pulse, filtered value." UWORD _CNV_A_R_INJR_LINEA_464_CM 1 100. 0. 27.96 DISPLAY_IDENTIFIER CAPA_IV_1_FIL[1] ECU_ADDRESS 0xd0006f1a FORMAT "%5.4" /end MEASUREMENT
/begin MEASUREMENT injr.STR_INJR_ISPCLCAPA0.capa_iv_1_fil[2] "Capacity of the piezo injector for the first pulse, filtered value." UWORD _CNV_A_R_INJR_LINEA_464_CM 1 100. 0. 27.96 DISPLAY_IDENTIFIER CAPA_IV_1_FIL[2] ECU_ADDRESS 0xd0006f1c FORMAT "%5.4" /end MEASUREMENT
/begin MEASUREMENT injr.STR_INJR_ISPCLCAPA0.capa_iv_1_fil[3] "Capacity of the piezo injector for the first pulse, filtered value." UWORD _CNV_A_R_INJR_LINEA_464_CM 1 100. 0. 27.96 DISPLAY_IDENTIFIER CAPA_IV_1_FIL[3] ECU_ADDRESS 0xd0006f1e FORMAT "%5.4" /end MEASUREMENT
/begin MEASUREMENT injr.STR_INJR_ISPCLCAPA0.capa_iv_1_fil[4] "Capacity of the piezo injector for the first pulse, filtered value." UWORD _CNV_A_R_INJR_LINEA_464_CM 1 100. 0. 27.96 DISPLAY_IDENTIFIER CAPA_IV_1_FIL[4] ECU_ADDRESS 0xd0006f20 FORMAT "%5.4" /end MEASUREMENT
/begin MEASUREMENT injr.STR_INJR_ISPCLCAPA0.capa_iv_1_fil[5] "Capacity of the piezo injector for the first pulse, filtered value." UWORD _CNV_A_R_INJR_LINEA_464_CM 1 100. 0. 27.96 DISPLAY_IDENTIFIER CAPA_IV_1_FIL[5] ECU_ADDRESS 0xd0006f22 FORMAT "%5.4" /end MEASUREMENT
/begin MEASUREMENT injr.STR_INJR_ISPCLCAPA0.capa_iv_1_fil[6] "Capacity of the piezo injector for the first pulse, filtered value." UWORD _CNV_A_R_INJR_LINEA_464_CM 1 100. 0. 27.96 DISPLAY_IDENTIFIER CAPA_IV_1_FIL[6] ECU_ADDRESS 0xd0006f24 FORMAT "%5.4" /end MEASUREMENT
/begin MEASUREMENT injr.STR_INJR_ISPCLCAPA0.capa_iv_1_fil[7] "Capacity of the piezo injector for the first pulse, filtered value." UWORD _CNV_A_R_INJR_LINEA_464_CM 1 100. 0. 27.96 DISPLAY_IDENTIFIER CAPA_IV_1_FIL[7] ECU_ADDRESS 0xd0006f26 FORMAT "%5.4" /end MEASUREMENT
/begin MEASUREMENT injr.STR_INJR_ISPCLCAPA0.temp_capa_iv[0] "Temperature of the piezo stack derived from its capacity." UBYTE _CNV_A_R_LINEAR_____17_CM 1 100. -48. 142.5 DISPLAY_IDENTIFIER TEMP_CAPA_IV[0] ECU_ADDRESS 0xd0006f28 FORMAT "%6.2" /end MEASUREMENT
/begin MEASUREMENT injr.STR_INJR_ISPCLCAPA0.temp_capa_iv[1] "Temperature of the piezo stack derived from its capacity." UBYTE _CNV_A_R_LINEAR_____17_CM 1 100. -48. 142.5 DISPLAY_IDENTIFIER TEMP_CAPA_IV[1] ECU_ADDRESS 0xd0006f29 FORMAT "%6.2" /end MEASUREMENT
/begin MEASUREMENT injr.STR_INJR_ISPCLCAPA0.temp_capa_iv[2] "Temperature of the piezo stack derived from its capacity." UBYTE _CNV_A_R_LINEAR_____17_CM 1 100. -48. 142.5 DISPLAY_IDENTIFIER TEMP_CAPA_IV[2] ECU_ADDRESS 0xd0006f2a FORMAT "%6.2" /end MEASUREMENT
/begin MEASUREMENT injr.STR_INJR_ISPCLCAPA0.temp_capa_iv[3] "Temperature of the piezo stack derived from its capacity." UBYTE _CNV_A_R_LINEAR_____17_CM 1 100. -48. 142.5 DISPLAY_IDENTIFIER TEMP_CAPA_IV[3] ECU_ADDRESS 0xd0006f2b FORMAT "%6.2" /end MEASUREMENT
/begin MEASUREMENT injr.STR_INJR_ISPCLCAPA0.temp_capa_iv[4] "Temperature of the piezo stack derived from its capacity." UBYTE _CNV_A_R_LINEAR_____17_CM 1 100. -48. 142.5 DISPLAY_IDENTIFIER TEMP_CAPA_IV[4] ECU_ADDRESS 0xd0006f2c FORMAT "%6.2" /end MEASUREMENT
/begin MEASUREMENT injr.STR_INJR_ISPCLCAPA0.temp_capa_iv[5] "Temperature of the piezo stack derived from its capacity." UBYTE _CNV_A_R_LINEAR_____17_CM 1 100. -48. 142.5 DISPLAY_IDENTIFIER TEMP_CAPA_IV[5] ECU_ADDRESS 0xd0006f2d FORMAT "%6.2" /end MEASUREMENT
/begin MEASUREMENT injr.STR_INJR_ISPCLCAPA0.temp_capa_iv[6] "Temperature of the piezo stack derived from its capacity." UBYTE _CNV_A_R_LINEAR_____17_CM 1 100. -48. 142.5 DISPLAY_IDENTIFIER TEMP_CAPA_IV[6] ECU_ADDRESS 0xd0006f2e FORMAT "%6.2" /end MEASUREMENT
/begin MEASUREMENT injr.STR_INJR_ISPCLCAPA0.temp_capa_iv[7] "Temperature of the piezo stack derived from its capacity." UBYTE _CNV_A_R_LINEAR_____17_CM 1 100. -48. 142.5 DISPLAY_IDENTIFIER TEMP_CAPA_IV[7] ECU_ADDRESS 0xd0006f2f FORMAT "%6.2" /end MEASUREMENT
/begin CHARACTERISTIC c_seg_ctr_capa_temp "Number of segments for capacity offset calculation." VALUE 0xa080657a _REC_VAL_20_u2 65535. _CNV_A_R_LINEAR_____0_CM 0. 65535. DISPLAY_IDENTIFIER C_SEG_CTR_CAPA_TEMP FORMAT "%5.0" /end CHARACTERISTIC
/begin CHARACTERISTIC c_t_es_capa_temp "Minimum engine of duration for capacity offset calculation." VALUE 0xa080658e _REC_VAL_20_u2 65535. _CNV_A_R_LINEAR_____84_CM 0. 65535. DISPLAY_IDENTIFIER C_T_ES_CAPA_TEMP FORMAT "%5.0" /end CHARACTERISTIC
/begin CHARACTERISTIC ip_capa_iv_nom "Nominal capacity of the piezo injector depending on temperature and fuel pressure." MAP 0xa0811330 _REC_MAP_20_u2_u1_u2 27.96 _CNV_A_R_INJR_LINEA_464_CM 0. 27.96 DISPLAY_IDENTIFIER IP_CAPA_IV_NOM FORMAT "%5.4"
 /begin AXIS_DESCR COM_AXIS tco _CNV_A_R_LINEAR_____17_CM 8 -48. 142.5 FORMAT "%6.2" AXIS_PTS_REF ldp_tco_ip_capa_iv_nom /end AXIS_DESCR
 /begin AXIS_DESCR COM_AXIS fup_h_mv _CNV_A_R_LINEAR_____171_CM 6 0. 347776. FORMAT "%8.1" AXIS_PTS_REF ldpm_fup_2_injr /end AXIS_DESCR
/end CHARACTERISTIC
/begin AXIS_PTS ldp_tco_ip_capa_iv_nom "" 0xa08061cc tco _REC_AXS_20_u1 190.5 _CNV_A_R_LINEAR_____17_CM 8 -48. 142.5 FORMAT "%6.2" /end AXIS_PTS
/begin AXIS_PTS ldpm_fup_2_injr "" 0xa0806258 fup_h_mv _REC_AXS_20_u2 347776. _CNV_A_R_LINEAR_____171_CM 6 0. 347776. FORMAT "%8.1" /end AXIS_PTS
/begin CHARACTERISTIC ip_temp_capa_iv_nom "Nominal temperature-capacity relationship of the piezo injector depending on fuel pressure." MAP 0xa08064a0 _REC_MAP_20_u1_u2_u2 190.5 _CNV_A_R_LINEAR_____17_CM -48. 142.5 DISPLAY_IDENTIFIER IP_TEMP_CAPA_IV_NOM FORMAT "%6.2"
 /begin AXIS_DESCR COM_AXIS injr.STR_INJR_ISPCLCAPA0.capa_iv_1_fil[0] _CNV_A_R_INJR_LINEA_464_CM 8 0. 27.96 FORMAT "%5.4" AXIS_PTS_REF ldp_capa_ip_temp_capa_iv_nom /end AXIS_DESCR
 /begin AXIS_DESCR COM_AXIS fup_h_mv _CNV_A_R_LINEAR_____171_CM 6 0. 347776. FORMAT "%8.1" AXIS_PTS_REF ldpm_fup_2_injr /end AXIS_DESCR
/end CHARACTERISTIC
/begin AXIS_PTS ldp_capa_ip_temp_capa_iv_nom "" 0xa0805ffc injr.STR_INJR_ISPCLCAPA0.capa_iv_1_fil[0] _REC_AXS_20_u2 27.96 _CNV_A_R_INJR_LINEA_464_CM 8 0. 27.96 FORMAT "%5.4" /end AXIS_PTS
/begin CHARACTERISTIC c_ti_min_capa_fil "Minimum injection time limit for calculation of filtered capacity" VALUE 0xa08065d2 _REC_VAL_20_u2 65.535 _CNV_A_R_LINEAR_____228_CM 0. 65.535 DISPLAY_IDENTIFIER C_TI_MIN_CAPA_FIL /end CHARACTERISTIC
/begin CHARACTERISTIC c_temp_capa_inc "Temperature increment" VALUE 0xa0806592 _REC_VAL_20_u2 1.5 _CNV_A_R_INJR_LINEA_469_CM 0. 1.5 DISPLAY_IDENTIFIER C_TEMP_CAPA_INC FORMAT "%6.5" /end CHARACTERISTIC
/begin AXIS_PTS ldp_egy_ip_capa_cor_egy_iv "" 0xa0806068 injr.STR_INJR_IFINFTRANS0.str_injr_transfer_to_iosw.str_injr_transfer_to_iosw_cyl[0].str_injr_transfer_to_iosw_pls[0].egy_iv_clc _REC_AXS_20_u2 255. _CNV_A_R_INJR_LINEA_432_CM 6 0. 255. FORMAT "%7.3" /end AXIS_PTS
/begin CHARACTERISTIC ip_capa_cor_egy_iv "Capacity correction depending on the piezo injector´s energy" CURVE 0xa0806314 _REC_CUR_20_u2_u2 27.96 _CNV_A_R_INJR_LINEA_470_CM -13.9802133 13.9797867 DISPLAY_IDENTIFIER IP_CAPA_COR_EGY_IV FORMAT "%6.4"
 /begin AXIS_DESCR COM_AXIS injr.STR_INJR_IFINFTRANS0.str_injr_transfer_to_iosw.str_injr_transfer_to_iosw_cyl[0].str_injr_transfer_to_iosw_pls[0].egy_iv_clc _CNV_A_R_INJR_LINEA_432_CM 6 0. 255. FORMAT "%7.3" AXIS_PTS_REF ldp_egy_ip_capa_cor_egy_iv /end AXIS_DESCR
/end CHARACTERISTIC
/begin CHARACTERISTIC c_fac_fil_capa_iv "PT1-Filter constant for piezo capacity." VALUE 0xa0806568 _REC_VAL_20_u1 0.99609375 _CNV_A_R_LINEAR_____28_CM 0. 0.99609375 DISPLAY_IDENTIFIER C_FAC_FIL_CAPA_IV FORMAT "%5.3" /end CHARACTERISTIC
/begin MEASUREMENT lv_t_es_capa_temp_vld "Engine stop time is valid for calculation of capacity offset" UBYTE _CNV_S_2_RANGE__0___1_CM 1 100. 0. 1. DISPLAY_IDENTIFIER LV_T_ES_CAPA_TEMP_VLD ECU_ADDRESS 0xd0007681 BIT_MASK 0x1 /end MEASUREMENT
/begin MEASUREMENT lv_temp_capa_iv_eol "Flag indicating valid capacity-temperature adaptation at end-of-line" UBYTE _CNV_S_2_RANGE__0___1_CM 1 100. 0. 1. DISPLAY_IDENTIFIER LV_TEMP_CAPA_IV_EOL ECU_ADDRESS 0xd0007682 BIT_MASK 0x1 /end MEASUREMENT
/begin CHARACTERISTIC c_capa_iv_dif_nom_lim "Limit of the capacity offset of the piezo injector to the nominal value." VALUE 0xa080651c _REC_VAL_20_u2 27.96 _CNV_A_R_INJR_LINEA_464_CM 0. 27.96 DISPLAY_IDENTIFIER C_CAPA_IV_DIF_NOM_LIM FORMAT "%5.4" /end CHARACTERISTIC
/begin CHARACTERISTIC c_temp_capa_iv_eol "Flag for capacity-temperature adaptation at end-of-line, manual setting" VALUE 0xa0806594 _REC_VAL_20_u1 1. _CNV_A_R_LINEAR_____0_CM 0. 1. DISPLAY_IDENTIFIER C_TEMP_CAPA_IV_EOL FORMAT "%1.0" /end CHARACTERISTIC
/begin CHARACTERISTIC lc_capa_iv_dif_nom_inh_ch_ena "Logical constant to enable inhibition of capacity offset determination for catalyst heating" VALUE 0xa08065d8 _REC_VAL_20_u1 1. _CNV_A_R_LINEAR_____0_CM 0. 1. DISPLAY_IDENTIFIER LC_CAPA_IV_DIF_NOM_INH_CH_ENA FORMAT "%1.0" /end CHARACTERISTIC
/begin CHARACTERISTIC lc_temp_capa_iv_eol_man "Logical constant to enable manual setting of end-of-line bit for capacity temperature adaptation" VALUE 0xa08065ed _REC_VAL_20_u1 1. _CNV_A_R_LINEAR_____0_CM 0. 1. DISPLAY_IDENTIFIER LC_TEMP_CAPA_IV_EOL_MAN FORMAT "%1.0" /end CHARACTERISTIC
/begin MEASUREMENT ducy_ti_n "Injection duty cycle" UWORD _CNV_A_R_INJR_LINEA_460_CM 1 100. 0. 100. DISPLAY_IDENTIFIER DUCY_TI_N ECU_ADDRESS 0xd000329a FORMAT "%7.3" /end MEASUREMENT
/begin AXIS_PTS ldp_ducy_ip_egy_add_ducy "Additive piezo energy correction depending on the injection duty cycle" 0xa0806058 ducy_ti_n _REC_AXS_20_u2 100. _CNV_A_R_INJR_LINEA_460_CM 7 0. 100. FORMAT "%7.3" /end AXIS_PTS
/begin AXIS_PTS ldp_n_ip_egy_add_ducy "Additive piezo energy correction depending on the injection duty cycle" 0xa0806150 n_32 _REC_AXS_20_u1 8160. _CNV_A_R_LINEAR_____10_CM 7 0. 8160. FORMAT "%4.0" /end AXIS_PTS
/begin CHARACTERISTIC ip_egy_add_ducy "Additive piezo energy correction depending on the injection duty cycle" MAP 0xa0811510 _REC_MAP_20_u2_u2_u1 255.00000002244 _CNV_A_R_INJR_LINEA_471_CM -127.501945536512 127.498054485928 DISPLAY_IDENTIFIER IP_EGY_ADD_DUCY FORMAT "%8.3"
 /begin AXIS_DESCR COM_AXIS ducy_ti_n _CNV_A_R_INJR_LINEA_460_CM 7 0. 100. FORMAT "%7.3" AXIS_PTS_REF ldp_ducy_ip_egy_add_ducy /end AXIS_DESCR
 /begin AXIS_DESCR COM_AXIS n_32 _CNV_A_R_LINEAR_____10_CM 7 0. 8160. FORMAT "%4.0" AXIS_PTS_REF ldp_n_ip_egy_add_ducy /end AXIS_DESCR
/end CHARACTERISTIC
/begin MEASUREMENT egy_add_ducy "Additive piezo energy correction depending on the injection duty cycle" SWORD _CNV_A_R_INJR_LINEA_472_CM 1 100. -127.501945536512 127.498054485928 DISPLAY_IDENTIFIER EGY_ADD_DUCY ECU_ADDRESS 0xd0006f5c FORMAT "%8.3" /end MEASUREMENT
/begin AXIS_PTS ldpm_n_ip_egy_add_cor_ext "" 0xa08062b4 n _REC_AXS_20_u2 8160. _CNV_A_R_LINEAR_____14_CM 8 0. 8160. FORMAT "%4.0" /end AXIS_PTS
/begin AXIS_PTS ldpm_mff_sp_ip_egy_add_cor_ext "" 0xa08062a0 mff_sp_mv _REC_AXS_20_u2 1389. _CNV_A_R_LINEAR_____111_CM 8 0. 1389. FORMAT "%7.2" /end AXIS_PTS
/begin CHARACTERISTIC ip_egy_add_cor_ext_hom "Additive piezo injector energy correction depending on engine speed and load, HOM mode" MAP 0xa0811390 _REC_MAP_20_u2_u2_u2 255.00000002244 _CNV_A_R_INJR_LINEA_471_CM -127.501945536512 127.498054485928 DISPLAY_IDENTIFIER IP_EGY_ADD_COR_EXT_HOM FORMAT "%8.3"
 /begin AXIS_DESCR COM_AXIS n _CNV_A_R_LINEAR_____14_CM 8 0. 8160. FORMAT "%4.0" AXIS_PTS_REF ldpm_n_ip_egy_add_cor_ext /end AXIS_DESCR
 /begin AXIS_DESCR COM_AXIS mff_sp_mv _CNV_A_R_LINEAR_____111_CM 8 0. 1389. FORMAT "%7.2" AXIS_PTS_REF ldpm_mff_sp_ip_egy_add_cor_ext /end AXIS_DESCR
/end CHARACTERISTIC
/begin CHARACTERISTIC ip_egy_add_cor_ext_homs "Additive piezo injector energy correction depending on engine speed and load, HOMS mode" MAP 0xa0811410 _REC_MAP_20_u2_u2_u2 255.00000002244 _CNV_A_R_INJR_LINEA_471_CM -127.501945536512 127.498054485928 DISPLAY_IDENTIFIER IP_EGY_ADD_COR_EXT_HOMS FORMAT "%8.3"
 /begin AXIS_DESCR COM_AXIS n _CNV_A_R_LINEAR_____14_CM 8 0. 8160. FORMAT "%4.0" AXIS_PTS_REF ldpm_n_ip_egy_add_cor_ext /end AXIS_DESCR
 /begin AXIS_DESCR COM_AXIS mff_sp_mv _CNV_A_R_LINEAR_____111_CM 8 0. 1389. FORMAT "%7.2" AXIS_PTS_REF ldpm_mff_sp_ip_egy_add_cor_ext /end AXIS_DESCR
/end CHARACTERISTIC
/begin CHARACTERISTIC ip_egy_add_cor_ext_s "Additive piezo injector energy correction depending on engine speed and load, S mode" MAP 0xa0811490 _REC_MAP_20_u2_u2_u2 255.00000002244 _CNV_A_R_INJR_LINEA_471_CM -127.501945536512 127.498054485928 DISPLAY_IDENTIFIER IP_EGY_ADD_COR_EXT_S FORMAT "%8.3"
 /begin AXIS_DESCR COM_AXIS n _CNV_A_R_LINEAR_____14_CM 8 0. 8160. FORMAT "%4.0" AXIS_PTS_REF ldpm_n_ip_egy_add_cor_ext /end AXIS_DESCR
 /begin AXIS_DESCR COM_AXIS mff_sp_mv _CNV_A_R_LINEAR_____111_CM 8 0. 1389. FORMAT "%7.2" AXIS_PTS_REF ldpm_mff_sp_ip_egy_add_cor_ext /end AXIS_DESCR
/end CHARACTERISTIC
/begin CHARACTERISTIC ip_egy_add_iv_agi_dist "Additive piezo energy depending on accumulated driving distance for compensation of aging effects" CURVE 0xa0806338 _REC_CUR_20_u2_u2 255.00000002244 _CNV_A_R_INJR_LINEA_471_CM -127.501945536512 127.498054485928 DISPLAY_IDENTIFIER IP_EGY_ADD_IV_AGI_DIST FORMAT "%8.3"
 /begin AXIS_DESCR COM_AXIS online_dummy _CNV_A_R_LINEAR_____255_CM 16 0. 524280. FORMAT "%6.0" AXIS_PTS_REF ldpm_dist_ip_egy_add_iv_agi /end AXIS_DESCR
/end CHARACTERISTIC
/begin AXIS_PTS ldpm_dist_ip_egy_add_iv_agi "" 0xa0806234 online_dummy _REC_AXS_20_u2 524280. _CNV_A_R_LINEAR_____255_CM 16 0. 524280. FORMAT "%6.0" /end AXIS_PTS
/begin MEASUREMENT egy_add_cor_ext[0] "External additive piezo energy correction" SWORD _CNV_A_R_INJR_LINEA_472_CM 1 100. -127.501945536512 127.498054485928 DISPLAY_IDENTIFIER EGY_ADD_COR_EXT[0] ECU_ADDRESS 0xd0006f4c FORMAT "%8.3" /end MEASUREMENT
/begin MEASUREMENT egy_add_cor_ext[1] "External additive piezo energy correction" SWORD _CNV_A_R_INJR_LINEA_472_CM 1 100. -127.501945536512 127.498054485928 DISPLAY_IDENTIFIER EGY_ADD_COR_EXT[1] ECU_ADDRESS 0xd0006f4e FORMAT "%8.3" /end MEASUREMENT
/begin MEASUREMENT egy_add_cor_ext[2] "External additive piezo energy correction" SWORD _CNV_A_R_INJR_LINEA_472_CM 1 100. -127.501945536512 127.498054485928 DISPLAY_IDENTIFIER EGY_ADD_COR_EXT[2] ECU_ADDRESS 0xd0006f50 FORMAT "%8.3" /end MEASUREMENT
/begin MEASUREMENT egy_add_cor_ext[3] "External additive piezo energy correction" SWORD _CNV_A_R_INJR_LINEA_472_CM 1 100. -127.501945536512 127.498054485928 DISPLAY_IDENTIFIER EGY_ADD_COR_EXT[3] ECU_ADDRESS 0xd0006f52 FORMAT "%8.3" /end MEASUREMENT
/begin MEASUREMENT egy_add_cor_ext[4] "External additive piezo energy correction" SWORD _CNV_A_R_INJR_LINEA_472_CM 1 100. -127.501945536512 127.498054485928 DISPLAY_IDENTIFIER EGY_ADD_COR_EXT[4] ECU_ADDRESS 0xd0006f54 FORMAT "%8.3" /end MEASUREMENT
/begin MEASUREMENT egy_add_cor_ext[5] "External additive piezo energy correction" SWORD _CNV_A_R_INJR_LINEA_472_CM 1 100. -127.501945536512 127.498054485928 DISPLAY_IDENTIFIER EGY_ADD_COR_EXT[5] ECU_ADDRESS 0xd0006f56 FORMAT "%8.3" /end MEASUREMENT
/begin MEASUREMENT egy_add_cor_ext[6] "External additive piezo energy correction" SWORD _CNV_A_R_INJR_LINEA_472_CM 1 100. -127.501945536512 127.498054485928 DISPLAY_IDENTIFIER EGY_ADD_COR_EXT[6] ECU_ADDRESS 0xd0006f58 FORMAT "%8.3" /end MEASUREMENT
/begin MEASUREMENT egy_add_cor_ext[7] "External additive piezo energy correction" SWORD _CNV_A_R_INJR_LINEA_472_CM 1 100. -127.501945536512 127.498054485928 DISPLAY_IDENTIFIER EGY_ADD_COR_EXT[7] ECU_ADDRESS 0xd0006f5a FORMAT "%8.3" /end MEASUREMENT
/begin CHARACTERISTIC c_egy_sp_iv_ext_adj[0] "Default value for external energy setpoint for piezo injector energy controller calculation" VALUE 0xa080652c _REC_VAL_20_u2 255. _CNV_A_R_INJR_LINEA_432_CM 0. 255. DISPLAY_IDENTIFIER C_EGY_SP_IV_EXT_ADJ[0] FORMAT "%7.3" /end CHARACTERISTIC
/begin CHARACTERISTIC c_egy_sp_iv_ext_adj[1] "Default value for external energy setpoint for piezo injector energy controller calculation" VALUE 0xa080652e _REC_VAL_20_u2 255. _CNV_A_R_INJR_LINEA_432_CM 0. 255. DISPLAY_IDENTIFIER C_EGY_SP_IV_EXT_ADJ[1] FORMAT "%7.3" /end CHARACTERISTIC
/begin CHARACTERISTIC c_egy_sp_iv_ext_adj[2] "Default value for external energy setpoint for piezo injector energy controller calculation" VALUE 0xa0806530 _REC_VAL_20_u2 255. _CNV_A_R_INJR_LINEA_432_CM 0. 255. DISPLAY_IDENTIFIER C_EGY_SP_IV_EXT_ADJ[2] FORMAT "%7.3" /end CHARACTERISTIC
/begin CHARACTERISTIC c_egy_sp_iv_ext_adj[3] "Default value for external energy setpoint for piezo injector energy controller calculation" VALUE 0xa0806532 _REC_VAL_20_u2 255. _CNV_A_R_INJR_LINEA_432_CM 0. 255. DISPLAY_IDENTIFIER C_EGY_SP_IV_EXT_ADJ[3] FORMAT "%7.3" /end CHARACTERISTIC
/begin CHARACTERISTIC c_egy_sp_iv_ext_adj[4] "Default value for external energy setpoint for piezo injector energy controller calculation" VALUE 0xa0806534 _REC_VAL_20_u2 255. _CNV_A_R_INJR_LINEA_432_CM 0. 255. DISPLAY_IDENTIFIER C_EGY_SP_IV_EXT_ADJ[4] FORMAT "%7.3" /end CHARACTERISTIC
/begin CHARACTERISTIC c_egy_sp_iv_ext_adj[5] "Default value for external energy setpoint for piezo injector energy controller calculation" VALUE 0xa0806536 _REC_VAL_20_u2 255. _CNV_A_R_INJR_LINEA_432_CM 0. 255. DISPLAY_IDENTIFIER C_EGY_SP_IV_EXT_ADJ[5] FORMAT "%7.3" /end CHARACTERISTIC
/begin CHARACTERISTIC c_egy_sp_iv_ext_adj[6] "Default value for external energy setpoint for piezo injector energy controller calculation" VALUE 0xa0806538 _REC_VAL_20_u2 255. _CNV_A_R_INJR_LINEA_432_CM 0. 255. DISPLAY_IDENTIFIER C_EGY_SP_IV_EXT_ADJ[6] FORMAT "%7.3" /end CHARACTERISTIC
/begin CHARACTERISTIC c_egy_sp_iv_ext_adj[7] "Default value for external energy setpoint for piezo injector energy controller calculation" VALUE 0xa080653a _REC_VAL_20_u2 255. _CNV_A_R_INJR_LINEA_432_CM 0. 255. DISPLAY_IDENTIFIER C_EGY_SP_IV_EXT_ADJ[7] FORMAT "%7.3" /end CHARACTERISTIC
/begin CHARACTERISTIC lc_egy_sp_iv_ext_adj_ena "Logical constant to enable external energy setpoint calculation for piezo injector energy controller" VALUE 0xa08065da _REC_VAL_20_u1 1. _CNV_A_R_LINEAR_____0_CM 0. 1. DISPLAY_IDENTIFIER LC_EGY_SP_IV_EXT_ADJ_ENA FORMAT "%1.0" /end CHARACTERISTIC
/begin MEASUREMENT egy_sp_iv_ext[0] "External injection valve EGY setpoint value for energy controller" UWORD _CNV_A_R_INJR_LINEA_432_CM 1 100. 0. 255. DISPLAY_IDENTIFIER EGY_SP_IV_EXT[0] ECU_ADDRESS 0xd0006f64 FORMAT "%7.3" /end MEASUREMENT
/begin MEASUREMENT egy_sp_iv_ext[1] "External injection valve EGY setpoint value for energy controller" UWORD _CNV_A_R_INJR_LINEA_432_CM 1 100. 0. 255. DISPLAY_IDENTIFIER EGY_SP_IV_EXT[1] ECU_ADDRESS 0xd0006f66 FORMAT "%7.3" /end MEASUREMENT
/begin MEASUREMENT egy_sp_iv_ext[2] "External injection valve EGY setpoint value for energy controller" UWORD _CNV_A_R_INJR_LINEA_432_CM 1 100. 0. 255. DISPLAY_IDENTIFIER EGY_SP_IV_EXT[2] ECU_ADDRESS 0xd0006f68 FORMAT "%7.3" /end MEASUREMENT
/begin MEASUREMENT egy_sp_iv_ext[3] "External injection valve EGY setpoint value for energy controller" UWORD _CNV_A_R_INJR_LINEA_432_CM 1 100. 0. 255. DISPLAY_IDENTIFIER EGY_SP_IV_EXT[3] ECU_ADDRESS 0xd0006f6a FORMAT "%7.3" /end MEASUREMENT
/begin MEASUREMENT egy_sp_iv_ext[4] "External injection valve EGY setpoint value for energy controller" UWORD _CNV_A_R_INJR_LINEA_432_CM 1 100. 0. 255. DISPLAY_IDENTIFIER EGY_SP_IV_EXT[4] ECU_ADDRESS 0xd0006f6c FORMAT "%7.3" /end MEASUREMENT
/begin MEASUREMENT egy_sp_iv_ext[5] "External injection valve EGY setpoint value for energy controller" UWORD _CNV_A_R_INJR_LINEA_432_CM 1 100. 0. 255. DISPLAY_IDENTIFIER EGY_SP_IV_EXT[5] ECU_ADDRESS 0xd0006f6e FORMAT "%7.3" /end MEASUREMENT
/begin MEASUREMENT egy_sp_iv_ext[6] "External injection valve EGY setpoint value for energy controller" UWORD _CNV_A_R_INJR_LINEA_432_CM 1 100. 0. 255. DISPLAY_IDENTIFIER EGY_SP_IV_EXT[6] ECU_ADDRESS 0xd0006f70 FORMAT "%7.3" /end MEASUREMENT
/begin MEASUREMENT egy_sp_iv_ext[7] "External injection valve EGY setpoint value for energy controller" UWORD _CNV_A_R_INJR_LINEA_432_CM 1 100. 0. 255. DISPLAY_IDENTIFIER EGY_SP_IV_EXT[7] ECU_ADDRESS 0xd0006f72 FORMAT "%7.3" /end MEASUREMENT
/begin MEASUREMENT dist_iv_chg[0] "Cylinder individual distance accumulation [8 km] at injector change" UWORD _CNV_A_R_LINEAR_____255_CM 1 100. 0. 524280. DISPLAY_IDENTIFIER DIST_IV_CHG[0] ECU_ADDRESS 0xd0006f3c FORMAT "%6.0" /end MEASUREMENT
/begin MEASUREMENT dist_iv_chg[1] "Cylinder individual distance accumulation [8 km] at injector change" UWORD _CNV_A_R_LINEAR_____255_CM 1 100. 0. 524280. DISPLAY_IDENTIFIER DIST_IV_CHG[1] ECU_ADDRESS 0xd0006f3e FORMAT "%6.0" /end MEASUREMENT
/begin MEASUREMENT dist_iv_chg[2] "Cylinder individual distance accumulation [8 km] at injector change" UWORD _CNV_A_R_LINEAR_____255_CM 1 100. 0. 524280. DISPLAY_IDENTIFIER DIST_IV_CHG[2] ECU_ADDRESS 0xd0006f40 FORMAT "%6.0" /end MEASUREMENT
/begin MEASUREMENT dist_iv_chg[3] "Cylinder individual distance accumulation [8 km] at injector change" UWORD _CNV_A_R_LINEAR_____255_CM 1 100. 0. 524280. DISPLAY_IDENTIFIER DIST_IV_CHG[3] ECU_ADDRESS 0xd0006f42 FORMAT "%6.0" /end MEASUREMENT
/begin MEASUREMENT dist_iv_chg[4] "Cylinder individual distance accumulation [8 km] at injector change" UWORD _CNV_A_R_LINEAR_____255_CM 1 100. 0. 524280. DISPLAY_IDENTIFIER DIST_IV_CHG[4] ECU_ADDRESS 0xd0006f44 FORMAT "%6.0" /end MEASUREMENT
/begin MEASUREMENT dist_iv_chg[5] "Cylinder individual distance accumulation [8 km] at injector change" UWORD _CNV_A_R_LINEAR_____255_CM 1 100. 0. 524280. DISPLAY_IDENTIFIER DIST_IV_CHG[5] ECU_ADDRESS 0xd0006f46 FORMAT "%6.0" /end MEASUREMENT
/begin MEASUREMENT dist_iv_chg[6] "Cylinder individual distance accumulation [8 km] at injector change" UWORD _CNV_A_R_LINEAR_____255_CM 1 100. 0. 524280. DISPLAY_IDENTIFIER DIST_IV_CHG[6] ECU_ADDRESS 0xd0006f48 FORMAT "%6.0" /end MEASUREMENT
/begin MEASUREMENT dist_iv_chg[7] "Cylinder individual distance accumulation [8 km] at injector change" UWORD _CNV_A_R_LINEAR_____255_CM 1 100. 0. 524280. DISPLAY_IDENTIFIER DIST_IV_CHG[7] ECU_ADDRESS 0xd0006f4a FORMAT "%6.0" /end MEASUREMENT
/begin MEASUREMENT fmy_stat_imob_0.ctr_abc "anti bounce counter for diagnosis instance IMOB_0" UBYTE _CNV_A_R_LINEAR_____0_CM 1 100. 0. 255. DISPLAY_IDENTIFIER CTR_ABC_IMOB_0 ECU_ADDRESS 0xd0009754 FORMAT "%3.0" /end MEASUREMENT
/begin MEASUREMENT fmy_stat_imob_0.ctr_end_diag "counter for end of diagnosis for diagnosis instance IMOB_0" UBYTE _CNV_A_R_LINEAR_____0_CM 1 100. 0. 255. DISPLAY_IDENTIFIER CTR_ABC_END_DIAG_IMOB_0 ECU_ADDRESS 0xd0009755 FORMAT "%3.0" /end MEASUREMENT
/begin MEASUREMENT fmy_stat_imob_0.err_info_stat.lv_err_mem "storage in dynamic failure memory of the diagnosis instance IMOB_0" UWORD _CNV_S_2_RANGE__0___1_CM 1 100. 0. 1. DISPLAY_IDENTIFIER LV_ERR_MEM_IMOB_0 ECU_ADDRESS 0xd0009756 BIT_MASK 0x8 /end MEASUREMENT
/begin MEASUREMENT fmy_stat_imob_0.err_info_stat.lv_ready "readiness status of the diagnosis instance IMOB_0" UWORD _CNV_S_2_RANGE__0___1_CM 1 100. 0. 1. DISPLAY_IDENTIFIER LV_READY_IMOB_0 ECU_ADDRESS 0xd0009756 BIT_MASK 0x10 /end MEASUREMENT
/begin MEASUREMENT fmy_stat_imob_0.err_info_stat.lv_end_diag "end of diagnosis of the diagnosis instance IMOB_0" UWORD _CNV_S_2_RANGE__0___1_CM 1 100. 0. 1. DISPLAY_IDENTIFIER LV_END_DIAG_IMOB_0 ECU_ADDRESS 0xd0009756 BIT_MASK 0x20 /end MEASUREMENT
/begin MEASUREMENT fmy_stat_imob_0.err_info_stat.lv_cdn_diag "diagnosis condition of the diagnosis instance IMOB_0" UWORD _CNV_S_2_RANGE__0___1_CM 1 100. 0. 1. DISPLAY_IDENTIFIER LV_CDN_DIAG_IMOB_0 ECU_ADDRESS 0xd0009756 BIT_MASK 0x40 /end MEASUREMENT
/begin MEASUREMENT fmy_stat_imob_0.err_info_stat.err_sym "symptoms of the diagnosis instance IMOB_0" UWORD _CNV_S_16_RANGE_ERR__349_CM 1 100. 0. 15. DISPLAY_IDENTIFIER ERR_SYM_IMOB_0 ECU_ADDRESS 0xd0009756 BIT_MASK 0x780 /end MEASUREMENT
/begin MEASUREMENT fmy_stat_imob_1.ctr_abc "anti bounce counter for diagnosis instance IMOB_1" UBYTE _CNV_A_R_LINEAR_____0_CM 1 100. 0. 255. DISPLAY_IDENTIFIER CTR_ABC_IMOB_1 ECU_ADDRESS 0xd0009758 FORMAT "%3.0" /end MEASUREMENT
/begin MEASUREMENT fmy_stat_imob_1.ctr_end_diag "counter for end of diagnosis for diagnosis instance IMOB_1" UBYTE _CNV_A_R_LINEAR_____0_CM 1 100. 0. 255. DISPLAY_IDENTIFIER CTR_ABC_END_DIAG_IMOB_1 ECU_ADDRESS 0xd0009759 FORMAT "%3.0" /end MEASUREMENT
/begin MEASUREMENT fmy_stat_imob_1.err_info_stat.lv_err_mem "storage in dynamic failure memory of the diagnosis instance IMOB_1" UWORD _CNV_S_2_RANGE__0___1_CM 1 100. 0. 1. DISPLAY_IDENTIFIER LV_ERR_MEM_IMOB_1 ECU_ADDRESS 0xd000975a BIT_MASK 0x8 /end MEASUREMENT
/begin MEASUREMENT fmy_stat_imob_1.err_info_stat.lv_ready "readiness status of the diagnosis instance IMOB_1" UWORD _CNV_S_2_RANGE__0___1_CM 1 100. 0. 1. DISPLAY_IDENTIFIER LV_READY_IMOB_1 ECU_ADDRESS 0xd000975a BIT_MASK 0x10 /end MEASUREMENT
/begin MEASUREMENT fmy_stat_imob_1.err_info_stat.lv_end_diag "end of diagnosis of the diagnosis instance IMOB_1" UWORD _CNV_S_2_RANGE__0___1_CM 1 100. 0. 1. DISPLAY_IDENTIFIER LV_END_DIAG_IMOB_1 ECU_ADDRESS 0xd000975a BIT_MASK 0x20 /end MEASUREMENT
/begin MEASUREMENT fmy_stat_imob_1.err_info_stat.lv_cdn_diag "diagnosis condition of the diagnosis instance IMOB_1" UWORD _CNV_S_2_RANGE__0___1_CM 1 100. 0. 1. DISPLAY_IDENTIFIER LV_CDN_DIAG_IMOB_1 ECU_ADDRESS 0xd000975a BIT_MASK 0x40 /end MEASUREMENT
/begin MEASUREMENT fmy_stat_imob_1.err_info_stat.err_sym "symptoms of the diagnosis instance IMOB_1" UWORD _CNV_S_16_RANGE_ERR__349_CM 1 100. 0. 15. DISPLAY_IDENTIFIER ERR_SYM_IMOB_1 ECU_ADDRESS 0xd000975a BIT_MASK 0x780 /end MEASUREMENT
/begin MEASUREMENT fmy_stat_imob_2.ctr_abc "anti bounce counter for diagnosis instance IMOB_2" UBYTE _CNV_A_R_LINEAR_____0_CM 1 100. 0. 255. DISPLAY_IDENTIFIER CTR_ABC_IMOB_2 ECU_ADDRESS 0xd000975c FORMAT "%3.0" /end MEASUREMENT
/begin MEASUREMENT fmy_stat_imob_2.ctr_end_diag "counter for end of diagnosis for diagnosis instance IMOB_2" UBYTE _CNV_A_R_LINEAR_____0_CM 1 100. 0. 255. DISPLAY_IDENTIFIER CTR_ABC_END_DIAG_IMOB_2 ECU_ADDRESS 0xd000975d FORMAT "%3.0" /end MEASUREMENT
/begin MEASUREMENT fmy_stat_imob_2.err_info_stat.lv_err_mem "storage in dynamic failure memory of the diagnosis instance IMOB_2" UWORD _CNV_S_2_RANGE__0___1_CM 1 100. 0. 1. DISPLAY_IDENTIFIER LV_ERR_MEM_IMOB_2 ECU_ADDRESS 0xd000975e BIT_MASK 0x8 /end MEASUREMENT
/begin MEASUREMENT fmy_stat_imob_2.err_info_stat.lv_ready "readiness status of the diagnosis instance IMOB_2" UWORD _CNV_S_2_RANGE__0___1_CM 1 100. 0. 1. DISPLAY_IDENTIFIER LV_READY_IMOB_2 ECU_ADDRESS 0xd000975e BIT_MASK 0x10 /end MEASUREMENT
/begin MEASUREMENT fmy_stat_imob_2.err_info_stat.lv_end_diag "end of diagnosis of the diagnosis instance IMOB_2" UWORD _CNV_S_2_RANGE__0___1_CM 1 100. 0. 1. DISPLAY_IDENTIFIER LV_END_DIAG_IMOB_2 ECU_ADDRESS 0xd000975e BIT_MASK 0x20 /end MEASUREMENT
/begin MEASUREMENT fmy_stat_imob_2.err_info_stat.lv_cdn_diag "diagnosis condition of the diagnosis instance IMOB_2" UWORD _CNV_S_2_RANGE__0___1_CM 1 100. 0. 1. DISPLAY_IDENTIFIER LV_CDN_DIAG_IMOB_2 ECU_ADDRESS 0xd000975e BIT_MASK 0x40 /end MEASUREMENT
/begin MEASUREMENT fmy_stat_imob_2.err_info_stat.err_sym "symptoms of the diagnosis instance IMOB_2" UWORD _CNV_S_16_RANGE_ERR__349_CM 1 100. 0. 15. DISPLAY_IDENTIFIER ERR_SYM_IMOB_2 ECU_ADDRESS 0xd000975e BIT_MASK 0x780 /end MEASUREMENT
/begin MEASUREMENT fmy_stat_imob_3.ctr_abc "anti bounce counter for diagnosis instance IMOB_3" UBYTE _CNV_A_R_LINEAR_____0_CM 1 100. 0. 255. DISPLAY_IDENTIFIER CTR_ABC_IMOB_3 ECU_ADDRESS 0xd0009760 FORMAT "%3.0" /end MEASUREMENT
/begin MEASUREMENT fmy_stat_imob_3.ctr_end_diag "counter for end of diagnosis for diagnosis instance IMOB_3" UBYTE _CNV_A_R_LINEAR_____0_CM 1 100. 0. 255. DISPLAY_IDENTIFIER CTR_ABC_END_DIAG_IMOB_3 ECU_ADDRESS 0xd0009761 FORMAT "%3.0" /end MEASUREMENT
/begin MEASUREMENT fmy_stat_imob_3.err_info_stat.lv_err_mem "storage in dynamic failure memory of the diagnosis instance IMOB_3" UWORD _CNV_S_2_RANGE__0___1_CM 1 100. 0. 1. DISPLAY_IDENTIFIER LV_ERR_MEM_IMOB_3 ECU_ADDRESS 0xd0009762 BIT_MASK 0x8 /end MEASUREMENT
/begin MEASUREMENT fmy_stat_imob_3.err_info_stat.lv_ready "readiness status of the diagnosis instance IMOB_3" UWORD _CNV_S_2_RANGE__0___1_CM 1 100. 0. 1. DISPLAY_IDENTIFIER LV_READY_IMOB_3 ECU_ADDRESS 0xd0009762 BIT_MASK 0x10 /end MEASUREMENT
/begin MEASUREMENT fmy_stat_imob_3.err_info_stat.lv_end_diag "end of diagnosis of the diagnosis instance IMOB_3" UWORD _CNV_S_2_RANGE__0___1_CM 1 100. 0. 1. DISPLAY_IDENTIFIER LV_END_DIAG_IMOB_3 ECU_ADDRESS 0xd0009762 BIT_MASK 0x20 /end MEASUREMENT
/begin MEASUREMENT fmy_stat_imob_3.err_info_stat.lv_cdn_diag "diagnosis condition of the diagnosis instance IMOB_3" UWORD _CNV_S_2_RANGE__0___1_CM 1 100. 0. 1. DISPLAY_IDENTIFIER LV_CDN_DIAG_IMOB_3 ECU_ADDRESS 0xd0009762 BIT_MASK 0x40 /end MEASUREMENT
/begin MEASUREMENT fmy_stat_imob_3.err_info_stat.err_sym "symptoms of the diagnosis instance IMOB_3" UWORD _CNV_S_16_RANGE_ERR__349_CM 1 100. 0. 15. DISPLAY_IDENTIFIER ERR_SYM_IMOB_3 ECU_ADDRESS 0xd0009762 BIT_MASK 0x780 /end MEASUREMENT
/begin MEASUREMENT fmy_stat_tco_el.ctr_abc "anti bounce counter for diagnosis instance TCO_EL" UBYTE _CNV_A_R_LINEAR_____0_CM 1 100. 0. 255. DISPLAY_IDENTIFIER CTR_ABC_TCO_EL ECU_ADDRESS 0xd0009a18 FORMAT "%3.0" /end MEASUREMENT
/begin MEASUREMENT fmy_stat_tco_el.ctr_end_diag "counter for end of diagnosis for diagnosis instance TCO_EL" UBYTE _CNV_A_R_LINEAR_____0_CM 1 100. 0. 255. DISPLAY_IDENTIFIER CTR_ABC_END_DIAG_TCO_EL ECU_ADDRESS 0xd0009a19 FORMAT "%3.0" /end MEASUREMENT
/begin MEASUREMENT fmy_stat_tco_el.err_info_stat.lv_err_mem "storage in dynamic failure memory of the diagnosis instance TCO_EL" UWORD _CNV_S_2_RANGE__0___1_CM 1 100. 0. 1. DISPLAY_IDENTIFIER LV_ERR_MEM_TCO_EL ECU_ADDRESS 0xd0009a1a BIT_MASK 0x8 /end MEASUREMENT
/begin MEASUREMENT fmy_stat_tco_el.err_info_stat.lv_ready "readiness status of the diagnosis instance TCO_EL" UWORD _CNV_S_2_RANGE__0___1_CM 1 100. 0. 1. DISPLAY_IDENTIFIER LV_READY_TCO_EL ECU_ADDRESS 0xd0009a1a BIT_MASK 0x10 /end MEASUREMENT
/begin MEASUREMENT fmy_stat_tco_el.err_info_stat.lv_end_diag "end of diagnosis of the diagnosis instance TCO_EL" UWORD _CNV_S_2_RANGE__0___1_CM 1 100. 0. 1. DISPLAY_IDENTIFIER LV_END_DIAG_TCO_EL ECU_ADDRESS 0xd0009a1a BIT_MASK 0x20 /end MEASUREMENT
/begin MEASUREMENT fmy_stat_tco_el.err_info_stat.lv_cdn_diag "diagnosis condition of the diagnosis instance TCO_EL" UWORD _CNV_S_2_RANGE__0___1_CM 1 100. 0. 1. DISPLAY_IDENTIFIER LV_CDN_DIAG_TCO_EL ECU_ADDRESS 0xd0009a1a BIT_MASK 0x40 /end MEASUREMENT
/begin MEASUREMENT fmy_stat_tco_el.err_info_stat.err_sym "symptoms of the diagnosis instance TCO_EL" UWORD _CNV_S_16_RANGE_ERR__349_CM 1 100. 0. 15. DISPLAY_IDENTIFIER ERR_SYM_TCO_EL ECU_ADDRESS 0xd0009a1a BIT_MASK 0x780 /end MEASUREMENT
/begin MEASUREMENT fmy_stat_tco_grd.ctr_abc "anti bounce counter for diagnosis instance TCO_GRD" UBYTE _CNV_A_R_LINEAR_____0_CM 1 100. 0. 255. DISPLAY_IDENTIFIER CTR_ABC_TCO_GRD ECU_ADDRESS 0xd0009a1c FORMAT "%3.0" /end MEASUREMENT
/begin MEASUREMENT fmy_stat_tco_grd.ctr_end_diag "counter for end of diagnosis for diagnosis instance TCO_GRD" UBYTE _CNV_A_R_LINEAR_____0_CM 1 100. 0. 255. DISPLAY_IDENTIFIER CTR_ABC_END_DIAG_TCO_GRD ECU_ADDRESS 0xd0009a1d FORMAT "%3.0" /end MEASUREMENT
/begin MEASUREMENT fmy_stat_tco_grd.err_info_stat.lv_err_mem "storage in dynamic failure memory of the diagnosis instance TCO_GRD" UWORD _CNV_S_2_RANGE__0___1_CM 1 100. 0. 1. DISPLAY_IDENTIFIER LV_ERR_MEM_TCO_GRD ECU_ADDRESS 0xd0009a1e BIT_MASK 0x8 /end MEASUREMENT
/begin MEASUREMENT fmy_stat_tco_grd.err_info_stat.lv_ready "readiness status of the diagnosis instance TCO_GRD" UWORD _CNV_S_2_RANGE__0___1_CM 1 100. 0. 1. DISPLAY_IDENTIFIER LV_READY_TCO_GRD ECU_ADDRESS 0xd0009a1e BIT_MASK 0x10 /end MEASUREMENT
/begin MEASUREMENT fmy_stat_tco_grd.err_info_stat.lv_end_diag "end of diagnosis of the diagnosis instance TCO_GRD" UWORD _CNV_S_2_RANGE__0___1_CM 1 100. 0. 1. DISPLAY_IDENTIFIER LV_END_DIAG_TCO_GRD ECU_ADDRESS 0xd0009a1e BIT_MASK 0x20 /end MEASUREMENT
/begin MEASUREMENT fmy_stat_tco_grd.err_info_stat.lv_cdn_diag "diagnosis condition of the diagnosis instance TCO_GRD" UWORD _CNV_S_2_RANGE__0___1_CM 1 100. 0. 1. DISPLAY_IDENTIFIER LV_CDN_DIAG_TCO_GRD ECU_ADDRESS 0xd0009a1e BIT_MASK 0x40 /end MEASUREMENT
/begin MEASUREMENT fmy_stat_tco_grd.err_info_stat.err_sym "symptoms of the diagnosis instance TCO_GRD" UWORD _CNV_S_16_RANGE_ERR__349_CM 1 100. 0. 15. DISPLAY_IDENTIFIER ERR_SYM_TCO_GRD ECU_ADDRESS 0xd0009a1e BIT_MASK 0x780 /end MEASUREMENT
/begin MEASUREMENT fmy_stat_tco_stuck.ctr_abc "anti bounce counter for diagnosis instance TCO_STUCK" UBYTE _CNV_A_R_LINEAR_____0_CM 1 100. 0. 255. DISPLAY_IDENTIFIER CTR_ABC_TCO_STUCK ECU_ADDRESS 0xd0009a24 FORMAT "%3.0" /end MEASUREMENT
/begin MEASUREMENT fmy_stat_tco_stuck.ctr_end_diag "counter for end of diagnosis for diagnosis instance TCO_STUCK" UBYTE _CNV_A_R_LINEAR_____0_CM 1 100. 0. 255. DISPLAY_IDENTIFIER CTR_ABC_END_DIAG_TCO_STUCK ECU_ADDRESS 0xd0009a25 FORMAT "%3.0" /end MEASUREMENT
/begin MEASUREMENT fmy_stat_tco_stuck.err_info_stat.lv_err_mem "storage in dynamic failure memory of the diagnosis instance TCO_STUCK" UWORD _CNV_S_2_RANGE__0___1_CM 1 100. 0. 1. DISPLAY_IDENTIFIER LV_ERR_MEM_TCO_STUCK ECU_ADDRESS 0xd0009a26 BIT_MASK 0x8 /end MEASUREMENT
/begin MEASUREMENT fmy_stat_tco_stuck.err_info_stat.lv_ready "readiness status of the diagnosis instance TCO_STUCK" UWORD _CNV_S_2_RANGE__0___1_CM 1 100. 0. 1. DISPLAY_IDENTIFIER LV_READY_TCO_STUCK ECU_ADDRESS 0xd0009a26 BIT_MASK 0x10 /end MEASUREMENT
/begin MEASUREMENT fmy_stat_tco_stuck.err_info_stat.lv_end_diag "end of diagnosis of the diagnosis instance TCO_STUCK" UWORD _CNV_S_2_RANGE__0___1_CM 1 100. 0. 1. DISPLAY_IDENTIFIER LV_END_DIAG_TCO_STUCK ECU_ADDRESS 0xd0009a26 BIT_MASK 0x20 /end MEASUREMENT
/begin MEASUREMENT fmy_stat_tco_stuck.err_info_stat.lv_cdn_diag "diagnosis condition of the diagnosis instance TCO_STUCK" UWORD _CNV_S_2_RANGE__0___1_CM 1 100. 0. 1. DISPLAY_IDENTIFIER LV_CDN_DIAG_TCO_STUCK ECU_ADDRESS 0xd0009a26 BIT_MASK 0x40 /end MEASUREMENT
/begin MEASUREMENT fmy_stat_tco_stuck.err_info_stat.err_sym "symptoms of the diagnosis instance TCO_STUCK" UWORD _CNV_S_16_RANGE_ERR__349_CM 1 100. 0. 15. DISPLAY_IDENTIFIER ERR_SYM_TCO_STUCK ECU_ADDRESS 0xd0009a26 BIT_MASK 0x780 /end MEASUREMENT
/begin MEASUREMENT fmy_stat_tco_stuck_rng.ctr_abc "anti bounce counter for diagnosis instance TCO_STUCK_RNG" UBYTE _CNV_A_R_LINEAR_____0_CM 1 100. 0. 255. DISPLAY_IDENTIFIER CTR_ABC_TCO_STUCK_RNG ECU_ADDRESS 0xd0009a28 FORMAT "%3.0" /end MEASUREMENT
/begin MEASUREMENT fmy_stat_tco_stuck_rng.ctr_end_diag "counter for end of diagnosis for diagnosis instance TCO_STUCK_RNG" UBYTE _CNV_A_R_LINEAR_____0_CM 1 100. 0. 255. DISPLAY_IDENTIFIER CTR_ABC_END_DIAG_TCO_STUCK_RNG ECU_ADDRESS 0xd0009a29 FORMAT "%3.0" /end MEASUREMENT
/begin MEASUREMENT fmy_stat_tco_stuck_rng.err_info_stat.lv_err_mem "storage in dynamic failure memory of the diagnosis instance TCO_STUCK_RNG" UWORD _CNV_S_2_RANGE__0___1_CM 1 100. 0. 1. DISPLAY_IDENTIFIER LV_ERR_MEM_TCO_STUCK_RNG ECU_ADDRESS 0xd0009a2a BIT_MASK 0x8 /end MEASUREMENT
/begin MEASUREMENT fmy_stat_tco_stuck_rng.err_info_stat.lv_ready "readiness status of the diagnosis instance TCO_STUCK_RNG" UWORD _CNV_S_2_RANGE__0___1_CM 1 100. 0. 1. DISPLAY_IDENTIFIER LV_READY_TCO_STUCK_RNG ECU_ADDRESS 0xd0009a2a BIT_MASK 0x10 /end MEASUREMENT
/begin MEASUREMENT fmy_stat_tco_stuck_rng.err_info_stat.lv_end_diag "end of diagnosis of the diagnosis instance TCO_STUCK_RNG" UWORD _CNV_S_2_RANGE__0___1_CM 1 100. 0. 1. DISPLAY_IDENTIFIER LV_END_DIAG_TCO_STUCK_RNG ECU_ADDRESS 0xd0009a2a BIT_MASK 0x20 /end MEASUREMENT
/begin MEASUREMENT fmy_stat_tco_stuck_rng.err_info_stat.lv_cdn_diag "diagnosis condition of the diagnosis instance TCO_STUCK_RNG" UWORD _CNV_S_2_RANGE__0___1_CM 1 100. 0. 1. DISPLAY_IDENTIFIER LV_CDN_DIAG_TCO_STUCK_RNG ECU_ADDRESS 0xd0009a2a BIT_MASK 0x40 /end MEASUREMENT
/begin MEASUREMENT fmy_stat_tco_stuck_rng.err_info_stat.err_sym "symptoms of the diagnosis instance TCO_STUCK_RNG" UWORD _CNV_S_16_RANGE_ERR__349_CM 1 100. 0. 15. DISPLAY_IDENTIFIER ERR_SYM_TCO_STUCK_RNG ECU_ADDRESS 0xd0009a2a BIT_MASK 0x780 /end MEASUREMENT
/begin MEASUREMENT fmy_stat_tco_plaus.ctr_abc "anti bounce counter for diagnosis instance TCO_PLAUS" UBYTE _CNV_A_R_LINEAR_____0_CM 1 100. 0. 255. DISPLAY_IDENTIFIER CTR_ABC_TCO_PLAUS ECU_ADDRESS 0xd0009a20 FORMAT "%3.0" /end MEASUREMENT
/begin MEASUREMENT fmy_stat_tco_plaus.ctr_end_diag "counter for end of diagnosis for diagnosis instance TCO_PLAUS" UBYTE _CNV_A_R_LINEAR_____0_CM 1 100. 0. 255. DISPLAY_IDENTIFIER CTR_ABC_END_DIAG_TCO_PLAUS ECU_ADDRESS 0xd0009a21 FORMAT "%3.0" /end MEASUREMENT
/begin MEASUREMENT fmy_stat_tco_plaus.err_info_stat.lv_err_mem "storage in dynamic failure memory of the diagnosis instance TCO_PLAUS" UWORD _CNV_S_2_RANGE__0___1_CM 1 100. 0. 1. DISPLAY_IDENTIFIER LV_ERR_MEM_TCO_PLAUS ECU_ADDRESS 0xd0009a22 BIT_MASK 0x8 /end MEASUREMENT
/begin MEASUREMENT fmy_stat_tco_plaus.err_info_stat.lv_ready "readiness status of the diagnosis instance TCO_PLAUS" UWORD _CNV_S_2_RANGE__0___1_CM 1 100. 0. 1. DISPLAY_IDENTIFIER LV_READY_TCO_PLAUS ECU_ADDRESS 0xd0009a22 BIT_MASK 0x10 /end MEASUREMENT
/begin MEASUREMENT fmy_stat_tco_plaus.err_info_stat.lv_end_diag "end of diagnosis of the diagnosis instance TCO_PLAUS" UWORD _CNV_S_2_RANGE__0___1_CM 1 100. 0. 1. DISPLAY_IDENTIFIER LV_END_DIAG_TCO_PLAUS ECU_ADDRESS 0xd0009a22 BIT_MASK 0x20 /end MEASUREMENT
/begin MEASUREMENT fmy_stat_tco_plaus.err_info_stat.lv_cdn_diag "diagnosis condition of the diagnosis instance TCO_PLAUS" UWORD _CNV_S_2_RANGE__0___1_CM 1 100. 0. 1. DISPLAY_IDENTIFIER LV_CDN_DIAG_TCO_PLAUS ECU_ADDRESS 0xd0009a22 BIT_MASK 0x40 /end MEASUREMENT
/begin MEASUREMENT fmy_stat_tco_plaus.err_info_stat.err_sym "symptoms of the diagnosis instance TCO_PLAUS" UWORD _CNV_S_16_RANGE_ERR__349_CM 1 100. 0. 15. DISPLAY_IDENTIFIER ERR_SYM_TCO_PLAUS ECU_ADDRESS 0xd0009a22 BIT_MASK 0x780 /end MEASUREMENT
/begin MEASUREMENT fmy_stat_tco_2_el.ctr_abc "anti bounce counter for diagnosis instance TCO_2_EL" UBYTE _CNV_A_R_LINEAR_____0_CM 1 100. 0. 255. DISPLAY_IDENTIFIER CTR_ABC_TCO_2_EL ECU_ADDRESS 0xd0009a0c FORMAT "%3.0" /end MEASUREMENT
/begin MEASUREMENT fmy_stat_tco_2_el.ctr_end_diag "counter for end of diagnosis for diagnosis instance TCO_2_EL" UBYTE _CNV_A_R_LINEAR_____0_CM 1 100. 0. 255. DISPLAY_IDENTIFIER CTR_ABC_END_DIAG_TCO_2_EL ECU_ADDRESS 0xd0009a0d FORMAT "%3.0" /end MEASUREMENT
/begin MEASUREMENT fmy_stat_tco_2_el.err_info_stat.lv_err_mem "storage in dynamic failure memory of the diagnosis instance TCO_2_EL" UWORD _CNV_S_2_RANGE__0___1_CM 1 100. 0. 1. DISPLAY_IDENTIFIER LV_ERR_MEM_TCO_2_EL ECU_ADDRESS 0xd0009a0e BIT_MASK 0x8 /end MEASUREMENT
/begin MEASUREMENT fmy_stat_tco_2_el.err_info_stat.lv_ready "readiness status of the diagnosis instance TCO_2_EL" UWORD _CNV_S_2_RANGE__0___1_CM 1 100. 0. 1. DISPLAY_IDENTIFIER LV_READY_TCO_2_EL ECU_ADDRESS 0xd0009a0e BIT_MASK 0x10 /end MEASUREMENT
/begin MEASUREMENT fmy_stat_tco_2_el.err_info_stat.lv_end_diag "end of diagnosis of the diagnosis instance TCO_2_EL" UWORD _CNV_S_2_RANGE__0___1_CM 1 100. 0. 1. DISPLAY_IDENTIFIER LV_END_DIAG_TCO_2_EL ECU_ADDRESS 0xd0009a0e BIT_MASK 0x20 /end MEASUREMENT
/begin MEASUREMENT fmy_stat_tco_2_el.err_info_stat.lv_cdn_diag "diagnosis condition of the diagnosis instance TCO_2_EL" UWORD _CNV_S_2_RANGE__0___1_CM 1 100. 0. 1. DISPLAY_IDENTIFIER LV_CDN_DIAG_TCO_2_EL ECU_ADDRESS 0xd0009a0e BIT_MASK 0x40 /end MEASUREMENT
/begin MEASUREMENT fmy_stat_tco_2_el.err_info_stat.err_sym "symptoms of the diagnosis instance TCO_2_EL" UWORD _CNV_S_16_RANGE_ERR__349_CM 1 100. 0. 15. DISPLAY_IDENTIFIER ERR_SYM_TCO_2_EL ECU_ADDRESS 0xd0009a0e BIT_MASK 0x780 /end MEASUREMENT
/begin MEASUREMENT fmy_stat_tco_2_grd.ctr_abc "anti bounce counter for diagnosis instance TCO_2_GRD" UBYTE _CNV_A_R_LINEAR_____0_CM 1 100. 0. 255. DISPLAY_IDENTIFIER CTR_ABC_TCO_2_GRD ECU_ADDRESS 0xd0009a10 FORMAT "%3.0" /end MEASUREMENT
/begin MEASUREMENT fmy_stat_tco_2_grd.ctr_end_diag "counter for end of diagnosis for diagnosis instance TCO_2_GRD" UBYTE _CNV_A_R_LINEAR_____0_CM 1 100. 0. 255. DISPLAY_IDENTIFIER CTR_ABC_END_DIAG_TCO_2_GRD ECU_ADDRESS 0xd0009a11 FORMAT "%3.0" /end MEASUREMENT
/begin MEASUREMENT fmy_stat_tco_2_grd.err_info_stat.lv_err_mem "storage in dynamic failure memory of the diagnosis instance TCO_2_GRD" UWORD _CNV_S_2_RANGE__0___1_CM 1 100. 0. 1. DISPLAY_IDENTIFIER LV_ERR_MEM_TCO_2_GRD ECU_ADDRESS 0xd0009a12 BIT_MASK 0x8 /end MEASUREMENT
/begin MEASUREMENT fmy_stat_tco_2_grd.err_info_stat.lv_ready "readiness status of the diagnosis instance TCO_2_GRD" UWORD _CNV_S_2_RANGE__0___1_CM 1 100. 0. 1. DISPLAY_IDENTIFIER LV_READY_TCO_2_GRD ECU_ADDRESS 0xd0009a12 BIT_MASK 0x10 /end MEASUREMENT
/begin MEASUREMENT fmy_stat_tco_2_grd.err_info_stat.lv_end_diag "end of diagnosis of the diagnosis instance TCO_2_GRD" UWORD _CNV_S_2_RANGE__0___1_CM 1 100. 0. 1. DISPLAY_IDENTIFIER LV_END_DIAG_TCO_2_GRD ECU_ADDRESS 0xd0009a12 BIT_MASK 0x20 /end MEASUREMENT
/begin MEASUREMENT fmy_stat_tco_2_grd.err_info_stat.lv_cdn_diag "diagnosis condition of the diagnosis instance TCO_2_GRD" UWORD _CNV_S_2_RANGE__0___1_CM 1 100. 0. 1. DISPLAY_IDENTIFIER LV_CDN_DIAG_TCO_2_GRD ECU_ADDRESS 0xd0009a12 BIT_MASK 0x40 /end MEASUREMENT
/begin MEASUREMENT fmy_stat_tco_2_grd.err_info_stat.err_sym "symptoms of the diagnosis instance TCO_2_GRD" UWORD _CNV_S_16_RANGE_ERR__349_CM 1 100. 0. 15. DISPLAY_IDENTIFIER ERR_SYM_TCO_2_GRD ECU_ADDRESS 0xd0009a12 BIT_MASK 0x780 /end MEASUREMENT
/begin MEASUREMENT fmy_stat_tco_2_plaus.ctr_abc "anti bounce counter for diagnosis instance TCO_2_PLAUS" UBYTE _CNV_A_R_LINEAR_____0_CM 1 100. 0. 255. DISPLAY_IDENTIFIER CTR_ABC_TCO_2_PLAUS ECU_ADDRESS 0xd0009a14 FORMAT "%3.0" /end MEASUREMENT
/begin MEASUREMENT fmy_stat_tco_2_plaus.ctr_end_diag "counter for end of diagnosis for diagnosis instance TCO_2_PLAUS" UBYTE _CNV_A_R_LINEAR_____0_CM 1 100. 0. 255. DISPLAY_IDENTIFIER CTR_ABC_END_DIAG_TCO_2_PLAUS ECU_ADDRESS 0xd0009a15 FORMAT "%3.0" /end MEASUREMENT
/begin MEASUREMENT fmy_stat_tco_2_plaus.err_info_stat.lv_err_mem "storage in dynamic failure memory of the diagnosis instance TCO_2_PLAUS" UWORD _CNV_S_2_RANGE__0___1_CM 1 100. 0. 1. DISPLAY_IDENTIFIER LV_ERR_MEM_TCO_2_PLAUS ECU_ADDRESS 0xd0009a16 BIT_MASK 0x8 /end MEASUREMENT
/begin MEASUREMENT fmy_stat_tco_2_plaus.err_info_stat.lv_ready "readiness status of the diagnosis instance TCO_2_PLAUS" UWORD _CNV_S_2_RANGE__0___1_CM 1 100. 0. 1. DISPLAY_IDENTIFIER LV_READY_TCO_2_PLAUS ECU_ADDRESS 0xd0009a16 BIT_MASK 0x10 /end MEASUREMENT
/begin MEASUREMENT fmy_stat_tco_2_plaus.err_info_stat.lv_end_diag "end of diagnosis of the diagnosis instance TCO_2_PLAUS" UWORD _CNV_S_2_RANGE__0___1_CM 1 100. 0. 1. DISPLAY_IDENTIFIER LV_END_DIAG_TCO_2_PLAUS ECU_ADDRESS 0xd0009a16 BIT_MASK 0x20 /end MEASUREMENT
/begin MEASUREMENT fmy_stat_tco_2_plaus.err_info_stat.lv_cdn_diag "diagnosis condition of the diagnosis instance TCO_2_PLAUS" UWORD _CNV_S_2_RANGE__0___1_CM 1 100. 0. 1. DISPLAY_IDENTIFIER LV_CDN_DIAG_TCO_2_PLAUS ECU_ADDRESS 0xd0009a16 BIT_MASK 0x40 /end MEASUREMENT
/begin MEASUREMENT fmy_stat_tco_2_plaus.err_info_stat.err_sym "symptoms of the diagnosis instance TCO_2_PLAUS" UWORD _CNV_S_16_RANGE_ERR__349_CM 1 100. 0. 15. DISPLAY_IDENTIFIER ERR_SYM_TCO_2_PLAUS ECU_ADDRESS 0xd0009a16 BIT_MASK 0x780 /end MEASUREMENT
/begin MEASUREMENT fmy_stat_ect_el.ctr_abc "anti bounce counter for diagnosis instance ECT_EL" UBYTE _CNV_A_R_LINEAR_____0_CM 1 100. 0. 255. DISPLAY_IDENTIFIER CTR_ABC_ECT_EL ECU_ADDRESS 0xd000963c FORMAT "%3.0" /end MEASUREMENT
/begin MEASUREMENT fmy_stat_ect_el.ctr_end_diag "counter for end of diagnosis for diagnosis instance ECT_EL" UBYTE _CNV_A_R_LINEAR_____0_CM 1 100. 0. 255. DISPLAY_IDENTIFIER CTR_ABC_END_DIAG_ECT_EL ECU_ADDRESS 0xd000963d FORMAT "%3.0" /end MEASUREMENT
/begin MEASUREMENT fmy_stat_ect_el.err_info_stat.lv_err_mem "storage in dynamic failure memory of the diagnosis instance ECT_EL" UWORD _CNV_S_2_RANGE__0___1_CM 1 100. 0. 1. DISPLAY_IDENTIFIER LV_ERR_MEM_ECT_EL ECU_ADDRESS 0xd000963e BIT_MASK 0x8 /end MEASUREMENT
/begin MEASUREMENT fmy_stat_ect_el.err_info_stat.lv_ready "readiness status of the diagnosis instance ECT_EL" UWORD _CNV_S_2_RANGE__0___1_CM 1 100. 0. 1. DISPLAY_IDENTIFIER LV_READY_ECT_EL ECU_ADDRESS 0xd000963e BIT_MASK 0x10 /end MEASUREMENT
/begin MEASUREMENT fmy_stat_ect_el.err_info_stat.lv_end_diag "end of diagnosis of the diagnosis instance ECT_EL" UWORD _CNV_S_2_RANGE__0___1_CM 1 100. 0. 1. DISPLAY_IDENTIFIER LV_END_DIAG_ECT_EL ECU_ADDRESS 0xd000963e BIT_MASK 0x20 /end MEASUREMENT
/begin MEASUREMENT fmy_stat_ect_el.err_info_stat.lv_cdn_diag "diagnosis condition of the diagnosis instance ECT_EL" UWORD _CNV_S_2_RANGE__0___1_CM 1 100. 0. 1. DISPLAY_IDENTIFIER LV_CDN_DIAG_ECT_EL ECU_ADDRESS 0xd000963e BIT_MASK 0x40 /end MEASUREMENT
/begin MEASUREMENT fmy_stat_ect_el.err_info_stat.err_sym "symptoms of the diagnosis instance ECT_EL" UWORD _CNV_S_16_RANGE_ERR__349_CM 1 100. 0. 15. DISPLAY_IDENTIFIER ERR_SYM_ECT_EL ECU_ADDRESS 0xd000963e BIT_MASK 0x780 /end MEASUREMENT
/begin MEASUREMENT fmy_stat_ecf_el_1.ctr_abc "anti bounce counter for diagnosis instance ECF_EL_1" UBYTE _CNV_A_R_LINEAR_____0_CM 1 100. 0. 255. DISPLAY_IDENTIFIER CTR_ABC_ECF_EL_1 ECU_ADDRESS 0xd000961c FORMAT "%3.0" /end MEASUREMENT
/begin MEASUREMENT fmy_stat_ecf_el_1.ctr_end_diag "counter for end of diagnosis for diagnosis instance ECF_EL_1" UBYTE _CNV_A_R_LINEAR_____0_CM 1 100. 0. 255. DISPLAY_IDENTIFIER CTR_ABC_END_DIAG_ECF_EL_1 ECU_ADDRESS 0xd000961d FORMAT "%3.0" /end MEASUREMENT
/begin MEASUREMENT fmy_stat_ecf_el_1.err_info_stat.lv_err_mem "storage in dynamic failure memory of the diagnosis instance ECF_EL_1" UWORD _CNV_S_2_RANGE__0___1_CM 1 100. 0. 1. DISPLAY_IDENTIFIER LV_ERR_MEM_ECF_EL_1 ECU_ADDRESS 0xd000961e BIT_MASK 0x8 /end MEASUREMENT
/begin MEASUREMENT fmy_stat_ecf_el_1.err_info_stat.lv_ready "readiness status of the diagnosis instance ECF_EL_1" UWORD _CNV_S_2_RANGE__0___1_CM 1 100. 0. 1. DISPLAY_IDENTIFIER LV_READY_ECF_EL_1 ECU_ADDRESS 0xd000961e BIT_MASK 0x10 /end MEASUREMENT
/begin MEASUREMENT fmy_stat_ecf_el_1.err_info_stat.lv_end_diag "end of diagnosis of the diagnosis instance ECF_EL_1" UWORD _CNV_S_2_RANGE__0___1_CM 1 100. 0. 1. DISPLAY_IDENTIFIER LV_END_DIAG_ECF_EL_1 ECU_ADDRESS 0xd000961e BIT_MASK 0x20 /end MEASUREMENT
/begin MEASUREMENT fmy_stat_ecf_el_1.err_info_stat.lv_cdn_diag "diagnosis condition of the diagnosis instance ECF_EL_1" UWORD _CNV_S_2_RANGE__0___1_CM 1 100. 0. 1. DISPLAY_IDENTIFIER LV_CDN_DIAG_ECF_EL_1 ECU_ADDRESS 0xd000961e BIT_MASK 0x40 /end MEASUREMENT
/begin MEASUREMENT fmy_stat_ecf_el_1.err_info_stat.err_sym "symptoms of the diagnosis instance ECF_EL_1" UWORD _CNV_S_16_RANGE_ERR__349_CM 1 100. 0. 15. DISPLAY_IDENTIFIER ERR_SYM_ECF_EL_1 ECU_ADDRESS 0xd000961e BIT_MASK 0x780 /end MEASUREMENT
/begin MEASUREMENT fmy_stat_ecf_el_2.ctr_abc "anti bounce counter for diagnosis instance ECF_EL_2" UBYTE _CNV_A_R_LINEAR_____0_CM 1 100. 0. 255. DISPLAY_IDENTIFIER CTR_ABC_ECF_EL_2 ECU_ADDRESS 0xd0009620 FORMAT "%3.0" /end MEASUREMENT
/begin MEASUREMENT fmy_stat_ecf_el_2.ctr_end_diag "counter for end of diagnosis for diagnosis instance ECF_EL_2" UBYTE _CNV_A_R_LINEAR_____0_CM 1 100. 0. 255. DISPLAY_IDENTIFIER CTR_ABC_END_DIAG_ECF_EL_2 ECU_ADDRESS 0xd0009621 FORMAT "%3.0" /end MEASUREMENT
/begin MEASUREMENT fmy_stat_ecf_el_2.err_info_stat.lv_err_mem "storage in dynamic failure memory of the diagnosis instance ECF_EL_2" UWORD _CNV_S_2_RANGE__0___1_CM 1 100. 0. 1. DISPLAY_IDENTIFIER LV_ERR_MEM_ECF_EL_2 ECU_ADDRESS 0xd0009622 BIT_MASK 0x8 /end MEASUREMENT
/begin MEASUREMENT fmy_stat_ecf_el_2.err_info_stat.lv_ready "readiness status of the diagnosis instance ECF_EL_2" UWORD _CNV_S_2_RANGE__0___1_CM 1 100. 0. 1. DISPLAY_IDENTIFIER LV_READY_ECF_EL_2 ECU_ADDRESS 0xd0009622 BIT_MASK 0x10 /end MEASUREMENT
/begin MEASUREMENT fmy_stat_ecf_el_2.err_info_stat.lv_end_diag "end of diagnosis of the diagnosis instance ECF_EL_2" UWORD _CNV_S_2_RANGE__0___1_CM 1 100. 0. 1. DISPLAY_IDENTIFIER LV_END_DIAG_ECF_EL_2 ECU_ADDRESS 0xd0009622 BIT_MASK 0x20 /end MEASUREMENT
/begin MEASUREMENT fmy_stat_ecf_el_2.err_info_stat.lv_cdn_diag "diagnosis condition of the diagnosis instance ECF_EL_2" UWORD _CNV_S_2_RANGE__0___1_CM 1 100. 0. 1. DISPLAY_IDENTIFIER LV_CDN_DIAG_ECF_EL_2 ECU_ADDRESS 0xd0009622 BIT_MASK 0x40 /end MEASUREMENT
/begin MEASUREMENT fmy_stat_ecf_el_2.err_info_stat.err_sym "symptoms of the diagnosis instance ECF_EL_2" UWORD _CNV_S_16_RANGE_ERR__349_CM 1 100. 0. 15. DISPLAY_IDENTIFIER ERR_SYM_ECF_EL_2 ECU_ADDRESS 0xd0009622 BIT_MASK 0x780 /end MEASUREMENT
/begin MEASUREMENT fmy_stat_ecfpwm_fb_1.ctr_abc "anti bounce counter for diagnosis instance ECFPWM_FB_1" UBYTE _CNV_A_R_LINEAR_____0_CM 1 100. 0. 255. DISPLAY_IDENTIFIER CTR_ABC_ECFPWM_FB_1 ECU_ADDRESS 0xd0009624 FORMAT "%3.0" /end MEASUREMENT
/begin MEASUREMENT fmy_stat_ecfpwm_fb_1.ctr_end_diag "counter for end of diagnosis for diagnosis instance ECFPWM_FB_1" UBYTE _CNV_A_R_LINEAR_____0_CM 1 100. 0. 255. DISPLAY_IDENTIFIER CTR_ABC_END_DIAG_ECFPWM_FB_1 ECU_ADDRESS 0xd0009625 FORMAT "%3.0" /end MEASUREMENT
/begin MEASUREMENT fmy_stat_ecfpwm_fb_1.err_info_stat.lv_err_mem "storage in dynamic failure memory of the diagnosis instance ECFPWM_FB_1" UWORD _CNV_S_2_RANGE__0___1_CM 1 100. 0. 1. DISPLAY_IDENTIFIER LV_ERR_MEM_ECFPWM_FB_1 ECU_ADDRESS 0xd0009626 BIT_MASK 0x8 /end MEASUREMENT
/begin MEASUREMENT fmy_stat_ecfpwm_fb_1.err_info_stat.lv_ready "readiness status of the diagnosis instance ECFPWM_FB_1" UWORD _CNV_S_2_RANGE__0___1_CM 1 100. 0. 1. DISPLAY_IDENTIFIER LV_READY_ECFPWM_FB_1 ECU_ADDRESS 0xd0009626 BIT_MASK 0x10 /end MEASUREMENT
/begin MEASUREMENT fmy_stat_ecfpwm_fb_1.err_info_stat.lv_end_diag "end of diagnosis of the diagnosis instance ECFPWM_FB_1" UWORD _CNV_S_2_RANGE__0___1_CM 1 100. 0. 1. DISPLAY_IDENTIFIER LV_END_DIAG_ECFPWM_FB_1 ECU_ADDRESS 0xd0009626 BIT_MASK 0x20 /end MEASUREMENT
/begin MEASUREMENT fmy_stat_ecfpwm_fb_1.err_info_stat.lv_cdn_diag "diagnosis condition of the diagnosis instance ECFPWM_FB_1" UWORD _CNV_S_2_RANGE__0___1_CM 1 100. 0. 1. DISPLAY_IDENTIFIER LV_CDN_DIAG_ECFPWM_FB_1 ECU_ADDRESS 0xd0009626 BIT_MASK 0x40 /end MEASUREMENT
/begin MEASUREMENT fmy_stat_ecfpwm_fb_1.err_info_stat.err_sym "symptoms of the diagnosis instance ECFPWM_FB_1" UWORD _CNV_S_16_RANGE_ERR__349_CM 1 100. 0. 15. DISPLAY_IDENTIFIER ERR_SYM_ECFPWM_FB_1 ECU_ADDRESS 0xd0009626 BIT_MASK 0x780 /end MEASUREMENT
/begin MEASUREMENT fmy_stat_ecfpwm_fb_2.ctr_abc "anti bounce counter for diagnosis instance ECFPWM_FB_2" UBYTE _CNV_A_R_LINEAR_____0_CM 1 100. 0. 255. DISPLAY_IDENTIFIER CTR_ABC_ECFPWM_FB_2 ECU_ADDRESS 0xd0009628 FORMAT "%3.0" /end MEASUREMENT
/begin MEASUREMENT fmy_stat_ecfpwm_fb_2.ctr_end_diag "counter for end of diagnosis for diagnosis instance ECFPWM_FB_2" UBYTE _CNV_A_R_LINEAR_____0_CM 1 100. 0. 255. DISPLAY_IDENTIFIER CTR_ABC_END_DIAG_ECFPWM_FB_2 ECU_ADDRESS 0xd0009629 FORMAT "%3.0" /end MEASUREMENT
/begin MEASUREMENT fmy_stat_ecfpwm_fb_2.err_info_stat.lv_err_mem "storage in dynamic failure memory of the diagnosis instance ECFPWM_FB_2" UWORD _CNV_S_2_RANGE__0___1_CM 1 100. 0. 1. DISPLAY_IDENTIFIER LV_ERR_MEM_ECFPWM_FB_2 ECU_ADDRESS 0xd000962a BIT_MASK 0x8 /end MEASUREMENT
/begin MEASUREMENT fmy_stat_ecfpwm_fb_2.err_info_stat.lv_ready "readiness status of the diagnosis instance ECFPWM_FB_2" UWORD _CNV_S_2_RANGE__0___1_CM 1 100. 0. 1. DISPLAY_IDENTIFIER LV_READY_ECFPWM_FB_2 ECU_ADDRESS 0xd000962a BIT_MASK 0x10 /end MEASUREMENT
/begin MEASUREMENT fmy_stat_ecfpwm_fb_2.err_info_stat.lv_end_diag "end of diagnosis of the diagnosis instance ECFPWM_FB_2" UWORD _CNV_S_2_RANGE__0___1_CM 1 100. 0. 1. DISPLAY_IDENTIFIER LV_END_DIAG_ECFPWM_FB_2 ECU_ADDRESS 0xd000962a BIT_MASK 0x20 /end MEASUREMENT
/begin MEASUREMENT fmy_stat_ecfpwm_fb_2.err_info_stat.lv_cdn_diag "diagnosis condition of the diagnosis instance ECFPWM_FB_2" UWORD _CNV_S_2_RANGE__0___1_CM 1 100. 0. 1. DISPLAY_IDENTIFIER LV_CDN_DIAG_ECFPWM_FB_2 ECU_ADDRESS 0xd000962a BIT_MASK 0x40 /end MEASUREMENT
/begin MEASUREMENT fmy_stat_ecfpwm_fb_2.err_info_stat.err_sym "symptoms of the diagnosis instance ECFPWM_FB_2" UWORD _CNV_S_16_RANGE_ERR__349_CM 1 100. 0. 15. DISPLAY_IDENTIFIER ERR_SYM_ECFPWM_FB_2 ECU_ADDRESS 0xd000962a BIT_MASK 0x780 /end MEASUREMENT
/begin MEASUREMENT fmy_stat_th.ctr_abc "anti bounce counter for diagnosis instance TH" UBYTE _CNV_A_R_LINEAR_____0_CM 1 100. 0. 255. DISPLAY_IDENTIFIER CTR_ABC_TH ECU_ADDRESS 0xd0009a3c FORMAT "%3.0" /end MEASUREMENT
/begin MEASUREMENT fmy_stat_th.ctr_end_diag "counter for end of diagnosis for diagnosis instance TH" UBYTE _CNV_A_R_LINEAR_____0_CM 1 100. 0. 255. DISPLAY_IDENTIFIER CTR_ABC_END_DIAG_TH ECU_ADDRESS 0xd0009a3d FORMAT "%3.0" /end MEASUREMENT
/begin MEASUREMENT fmy_stat_th.err_info_stat.lv_err_mem "storage in dynamic failure memory of the diagnosis instance TH" UWORD _CNV_S_2_RANGE__0___1_CM 1 100. 0. 1. DISPLAY_IDENTIFIER LV_ERR_MEM_TH ECU_ADDRESS 0xd0009a3e BIT_MASK 0x8 /end MEASUREMENT
/begin MEASUREMENT fmy_stat_th.err_info_stat.lv_ready "readiness status of the diagnosis instance TH" UWORD _CNV_S_2_RANGE__0___1_CM 1 100. 0. 1. DISPLAY_IDENTIFIER LV_READY_TH ECU_ADDRESS 0xd0009a3e BIT_MASK 0x10 /end MEASUREMENT
/begin MEASUREMENT fmy_stat_th.err_info_stat.lv_end_diag "end of diagnosis of the diagnosis instance TH" UWORD _CNV_S_2_RANGE__0___1_CM 1 100. 0. 1. DISPLAY_IDENTIFIER LV_END_DIAG_TH ECU_ADDRESS 0xd0009a3e BIT_MASK 0x20 /end MEASUREMENT
/begin MEASUREMENT fmy_stat_th.err_info_stat.lv_cdn_diag "diagnosis condition of the diagnosis instance TH" UWORD _CNV_S_2_RANGE__0___1_CM 1 100. 0. 1. DISPLAY_IDENTIFIER LV_CDN_DIAG_TH ECU_ADDRESS 0xd0009a3e BIT_MASK 0x40 /end MEASUREMENT
/begin MEASUREMENT fmy_stat_th.err_info_stat.err_sym "symptoms of the diagnosis instance TH" UWORD _CNV_S_16_RANGE_ERR__349_CM 1 100. 0. 15. DISPLAY_IDENTIFIER ERR_SYM_TH ECU_ADDRESS 0xd0009a3e BIT_MASK 0x780 /end MEASUREMENT
/begin MEASUREMENT fmy_stat_ftl_min.ctr_abc "anti bounce counter for diagnosis instance FTL_MIN" UBYTE _CNV_A_R_LINEAR_____0_CM 1 100. 0. 255. DISPLAY_IDENTIFIER CTR_ABC_FTL_MIN ECU_ADDRESS 0xd00096a0 FORMAT "%3.0" /end MEASUREMENT
/begin MEASUREMENT fmy_stat_ftl_min.ctr_end_diag "counter for end of diagnosis for diagnosis instance FTL_MIN" UBYTE _CNV_A_R_LINEAR_____0_CM 1 100. 0. 255. DISPLAY_IDENTIFIER CTR_ABC_END_DIAG_FTL_MIN ECU_ADDRESS 0xd00096a1 FORMAT "%3.0" /end MEASUREMENT
/begin MEASUREMENT fmy_stat_ftl_min.err_info_stat.lv_err_mem "storage in dynamic failure memory of the diagnosis instance FTL_MIN" UWORD _CNV_S_2_RANGE__0___1_CM 1 100. 0. 1. DISPLAY_IDENTIFIER LV_ERR_MEM_FTL_MIN ECU_ADDRESS 0xd00096a2 BIT_MASK 0x8 /end MEASUREMENT
/begin MEASUREMENT fmy_stat_ftl_min.err_info_stat.lv_ready "readiness status of the diagnosis instance FTL_MIN" UWORD _CNV_S_2_RANGE__0___1_CM 1 100. 0. 1. DISPLAY_IDENTIFIER LV_READY_FTL_MIN ECU_ADDRESS 0xd00096a2 BIT_MASK 0x10 /end MEASUREMENT
/begin MEASUREMENT fmy_stat_ftl_min.err_info_stat.lv_end_diag "end of diagnosis of the diagnosis instance FTL_MIN" UWORD _CNV_S_2_RANGE__0___1_CM 1 100. 0. 1. DISPLAY_IDENTIFIER LV_END_DIAG_FTL_MIN ECU_ADDRESS 0xd00096a2 BIT_MASK 0x20 /end MEASUREMENT
/begin MEASUREMENT fmy_stat_ftl_min.err_info_stat.lv_cdn_diag "diagnosis condition of the diagnosis instance FTL_MIN" UWORD _CNV_S_2_RANGE__0___1_CM 1 100. 0. 1. DISPLAY_IDENTIFIER LV_CDN_DIAG_FTL_MIN ECU_ADDRESS 0xd00096a2 BIT_MASK 0x40 /end MEASUREMENT
/begin MEASUREMENT fmy_stat_ftl_min.err_info_stat.err_sym "symptoms of the diagnosis instance FTL_MIN" UWORD _CNV_S_16_RANGE_ERR__349_CM 1 100. 0. 15. DISPLAY_IDENTIFIER ERR_SYM_FTL_MIN ECU_ADDRESS 0xd00096a2 BIT_MASK 0x780 /end MEASUREMENT
/begin MEASUREMENT fmy_stat_tia_el_1.ctr_abc "anti bounce counter for diagnosis instance TIA_EL_1" UBYTE _CNV_A_R_LINEAR_____0_CM 1 100. 0. 255. DISPLAY_IDENTIFIER CTR_ABC_TIA_EL_1 ECU_ADDRESS 0xd0009a40 FORMAT "%3.0" /end MEASUREMENT
/begin MEASUREMENT fmy_stat_tia_el_1.ctr_end_diag "counter for end of diagnosis for diagnosis instance TIA_EL_1" UBYTE _CNV_A_R_LINEAR_____0_CM 1 100. 0. 255. DISPLAY_IDENTIFIER CTR_ABC_END_DIAG_TIA_EL_1 ECU_ADDRESS 0xd0009a41 FORMAT "%3.0" /end MEASUREMENT
/begin MEASUREMENT fmy_stat_tia_el_1.err_info_stat.lv_err_mem "storage in dynamic failure memory of the diagnosis instance TIA_EL_1" UWORD _CNV_S_2_RANGE__0___1_CM 1 100. 0. 1. DISPLAY_IDENTIFIER LV_ERR_MEM_TIA_EL_1 ECU_ADDRESS 0xd0009a42 BIT_MASK 0x8 /end MEASUREMENT
/begin MEASUREMENT fmy_stat_tia_el_1.err_info_stat.lv_ready "readiness status of the diagnosis instance TIA_EL_1" UWORD _CNV_S_2_RANGE__0___1_CM 1 100. 0. 1. DISPLAY_IDENTIFIER LV_READY_TIA_EL_1 ECU_ADDRESS 0xd0009a42 BIT_MASK 0x10 /end MEASUREMENT
/begin MEASUREMENT fmy_stat_tia_el_1.err_info_stat.lv_end_diag "end of diagnosis of the diagnosis instance TIA_EL_1" UWORD _CNV_S_2_RANGE__0___1_CM 1 100. 0. 1. DISPLAY_IDENTIFIER LV_END_DIAG_TIA_EL_1 ECU_ADDRESS 0xd0009a42 BIT_MASK 0x20 /end MEASUREMENT
/begin MEASUREMENT fmy_stat_tia_el_1.err_info_stat.lv_cdn_diag "diagnosis condition of the diagnosis instance TIA_EL_1" UWORD _CNV_S_2_RANGE__0___1_CM 1 100. 0. 1. DISPLAY_IDENTIFIER LV_CDN_DIAG_TIA_EL_1 ECU_ADDRESS 0xd0009a42 BIT_MASK 0x40 /end MEASUREMENT
/begin MEASUREMENT fmy_stat_tia_el_1.err_info_stat.err_sym "symptoms of the diagnosis instance TIA_EL_1" UWORD _CNV_S_16_RANGE_ERR__349_CM 1 100. 0. 15. DISPLAY_IDENTIFIER ERR_SYM_TIA_EL_1 ECU_ADDRESS 0xd0009a42 BIT_MASK 0x780 /end MEASUREMENT
/begin MEASUREMENT fmy_stat_tia_el_2.ctr_abc "anti bounce counter for diagnosis instance TIA_EL_2" UBYTE _CNV_A_R_LINEAR_____0_CM 1 100. 0. 255. DISPLAY_IDENTIFIER CTR_ABC_TIA_EL_2 ECU_ADDRESS 0xd0009a44 FORMAT "%3.0" /end MEASUREMENT
/begin MEASUREMENT fmy_stat_tia_el_2.ctr_end_diag "counter for end of diagnosis for diagnosis instance TIA_EL_2" UBYTE _CNV_A_R_LINEAR_____0_CM 1 100. 0. 255. DISPLAY_IDENTIFIER CTR_ABC_END_DIAG_TIA_EL_2 ECU_ADDRESS 0xd0009a45 FORMAT "%3.0" /end MEASUREMENT
/begin MEASUREMENT fmy_stat_tia_el_2.err_info_stat.lv_err_mem "storage in dynamic failure memory of the diagnosis instance TIA_EL_2" UWORD _CNV_S_2_RANGE__0___1_CM 1 100. 0. 1. DISPLAY_IDENTIFIER LV_ERR_MEM_TIA_EL_2 ECU_ADDRESS 0xd0009a46 BIT_MASK 0x8 /end MEASUREMENT
/begin MEASUREMENT fmy_stat_tia_el_2.err_info_stat.lv_ready "readiness status of the diagnosis instance TIA_EL_2" UWORD _CNV_S_2_RANGE__0___1_CM 1 100. 0. 1. DISPLAY_IDENTIFIER LV_READY_TIA_EL_2 ECU_ADDRESS 0xd0009a46 BIT_MASK 0x10 /end MEASUREMENT
/begin MEASUREMENT fmy_stat_tia_el_2.err_info_stat.lv_end_diag "end of diagnosis of the diagnosis instance TIA_EL_2" UWORD _CNV_S_2_RANGE__0___1_CM 1 100. 0. 1. DISPLAY_IDENTIFIER LV_END_DIAG_TIA_EL_2 ECU_ADDRESS 0xd0009a46 BIT_MASK 0x20 /end MEASUREMENT
/begin MEASUREMENT fmy_stat_tia_el_2.err_info_stat.lv_cdn_diag "diagnosis condition of the diagnosis instance TIA_EL_2" UWORD _CNV_S_2_RANGE__0___1_CM 1 100. 0. 1. DISPLAY_IDENTIFIER LV_CDN_DIAG_TIA_EL_2 ECU_ADDRESS 0xd0009a46 BIT_MASK 0x40 /end MEASUREMENT
/begin MEASUREMENT fmy_stat_tia_el_2.err_info_stat.err_sym "symptoms of the diagnosis instance TIA_EL_2" UWORD _CNV_S_16_RANGE_ERR__349_CM 1 100. 0. 15. DISPLAY_IDENTIFIER ERR_SYM_TIA_EL_2 ECU_ADDRESS 0xd0009a46 BIT_MASK 0x780 /end MEASUREMENT
/begin MEASUREMENT fmy_stat_tia_thr_el_1.ctr_abc "anti bounce counter for diagnosis instance TIA_THR_EL_1" UBYTE _CNV_A_R_LINEAR_____0_CM 1 100. 0. 255. DISPLAY_IDENTIFIER CTR_ABC_TIA_THR_EL_1 ECU_ADDRESS 0xd0009a4c FORMAT "%3.0" /end MEASUREMENT
/begin MEASUREMENT fmy_stat_tia_thr_el_1.ctr_end_diag "counter for end of diagnosis for diagnosis instance TIA_THR_EL_1" UBYTE _CNV_A_R_LINEAR_____0_CM 1 100. 0. 255. DISPLAY_IDENTIFIER CTR_ABC_END_DIAG_TIA_THR_EL_1 ECU_ADDRESS 0xd0009a4d FORMAT "%3.0" /end MEASUREMENT
/begin MEASUREMENT fmy_stat_tia_thr_el_1.err_info_stat.lv_err_mem "storage in dynamic failure memory of the diagnosis instance TIA_THR_EL_1" UWORD _CNV_S_2_RANGE__0___1_CM 1 100. 0. 1. DISPLAY_IDENTIFIER LV_ERR_MEM_TIA_THR_EL_1 ECU_ADDRESS 0xd0009a4e BIT_MASK 0x8 /end MEASUREMENT
/begin MEASUREMENT fmy_stat_tia_thr_el_1.err_info_stat.lv_ready "readiness status of the diagnosis instance TIA_THR_EL_1" UWORD _CNV_S_2_RANGE__0___1_CM 1 100. 0. 1. DISPLAY_IDENTIFIER LV_READY_TIA_THR_EL_1 ECU_ADDRESS 0xd0009a4e BIT_MASK 0x10 /end MEASUREMENT
/begin MEASUREMENT fmy_stat_tia_thr_el_1.err_info_stat.lv_end_diag "end of diagnosis of the diagnosis instance TIA_THR_EL_1" UWORD _CNV_S_2_RANGE__0___1_CM 1 100. 0. 1. DISPLAY_IDENTIFIER LV_END_DIAG_TIA_THR_EL_1 ECU_ADDRESS 0xd0009a4e BIT_MASK 0x20 /end MEASUREMENT
/begin MEASUREMENT fmy_stat_tia_thr_el_1.err_info_stat.lv_cdn_diag "diagnosis condition of the diagnosis instance TIA_THR_EL_1" UWORD _CNV_S_2_RANGE__0___1_CM 1 100. 0. 1. DISPLAY_IDENTIFIER LV_CDN_DIAG_TIA_THR_EL_1 ECU_ADDRESS 0xd0009a4e BIT_MASK 0x40 /end MEASUREMENT
/begin MEASUREMENT fmy_stat_tia_thr_el_1.err_info_stat.err_sym "symptoms of the diagnosis instance TIA_THR_EL_1" UWORD _CNV_S_16_RANGE_ERR__349_CM 1 100. 0. 15. DISPLAY_IDENTIFIER ERR_SYM_TIA_THR_EL_1 ECU_ADDRESS 0xd0009a4e BIT_MASK 0x780 /end MEASUREMENT
/begin MEASUREMENT fmy_stat_tia_thr_el_2.ctr_abc "anti bounce counter for diagnosis instance TIA_THR_EL_2" UBYTE _CNV_A_R_LINEAR_____0_CM 1 100. 0. 255. DISPLAY_IDENTIFIER CTR_ABC_TIA_THR_EL_2 ECU_ADDRESS 0xd0009a50 FORMAT "%3.0" /end MEASUREMENT
/begin MEASUREMENT fmy_stat_tia_thr_el_2.ctr_end_diag "counter for end of diagnosis for diagnosis instance TIA_THR_EL_2" UBYTE _CNV_A_R_LINEAR_____0_CM 1 100. 0. 255. DISPLAY_IDENTIFIER CTR_ABC_END_DIAG_TIA_THR_EL_2 ECU_ADDRESS 0xd0009a51 FORMAT "%3.0" /end MEASUREMENT
/begin MEASUREMENT fmy_stat_tia_thr_el_2.err_info_stat.lv_err_mem "storage in dynamic failure memory of the diagnosis instance TIA_THR_EL_2" UWORD _CNV_S_2_RANGE__0___1_CM 1 100. 0. 1. DISPLAY_IDENTIFIER LV_ERR_MEM_TIA_THR_EL_2 ECU_ADDRESS 0xd0009a52 BIT_MASK 0x8 /end MEASUREMENT
/begin MEASUREMENT fmy_stat_tia_thr_el_2.err_info_stat.lv_ready "readiness status of the diagnosis instance TIA_THR_EL_2" UWORD _CNV_S_2_RANGE__0___1_CM 1 100. 0. 1. DISPLAY_IDENTIFIER LV_READY_TIA_THR_EL_2 ECU_ADDRESS 0xd0009a52 BIT_MASK 0x10 /end MEASUREMENT
/begin MEASUREMENT fmy_stat_tia_thr_el_2.err_info_stat.lv_end_diag "end of diagnosis of the diagnosis instance TIA_THR_EL_2" UWORD _CNV_S_2_RANGE__0___1_CM 1 100. 0. 1. DISPLAY_IDENTIFIER LV_END_DIAG_TIA_THR_EL_2 ECU_ADDRESS 0xd0009a52 BIT_MASK 0x20 /end MEASUREMENT
/begin MEASUREMENT fmy_stat_tia_thr_el_2.err_info_stat.lv_cdn_diag "diagnosis condition of the diagnosis instance TIA_THR_EL_2" UWORD _CNV_S_2_RANGE__0___1_CM 1 100. 0. 1. DISPLAY_IDENTIFIER LV_CDN_DIAG_TIA_THR_EL_2 ECU_ADDRESS 0xd0009a52 BIT_MASK 0x40 /end MEASUREMENT
/begin MEASUREMENT fmy_stat_tia_thr_el_2.err_info_stat.err_sym "symptoms of the diagnosis instance TIA_THR_EL_2" UWORD _CNV_S_16_RANGE_ERR__349_CM 1 100. 0. 15. DISPLAY_IDENTIFIER ERR_SYM_TIA_THR_EL_2 ECU_ADDRESS 0xd0009a52 BIT_MASK 0x780 /end MEASUREMENT
/begin MEASUREMENT fmy_stat_amp.ctr_abc "anti bounce counter for diagnosis instance AMP" UBYTE _CNV_A_R_LINEAR_____0_CM 1 100. 0. 255. DISPLAY_IDENTIFIER CTR_ABC_AMP ECU_ADDRESS 0xd00093dc FORMAT "%3.0" /end MEASUREMENT
/begin MEASUREMENT fmy_stat_amp.ctr_end_diag "counter for end of diagnosis for diagnosis instance AMP" UBYTE _CNV_A_R_LINEAR_____0_CM 1 100. 0. 255. DISPLAY_IDENTIFIER CTR_ABC_END_DIAG_AMP ECU_ADDRESS 0xd00093dd FORMAT "%3.0" /end MEASUREMENT
/begin MEASUREMENT fmy_stat_amp.err_info_stat.lv_err_mem "storage in dynamic failure memory of the diagnosis instance AMP" UWORD _CNV_S_2_RANGE__0___1_CM 1 100. 0. 1. DISPLAY_IDENTIFIER LV_ERR_MEM_AMP ECU_ADDRESS 0xd00093de BIT_MASK 0x8 /end MEASUREMENT
/begin MEASUREMENT fmy_stat_amp.err_info_stat.lv_ready "readiness status of the diagnosis instance AMP" UWORD _CNV_S_2_RANGE__0___1_CM 1 100. 0. 1. DISPLAY_IDENTIFIER LV_READY_AMP ECU_ADDRESS 0xd00093de BIT_MASK 0x10 /end MEASUREMENT
/begin MEASUREMENT fmy_stat_amp.err_info_stat.lv_end_diag "end of diagnosis of the diagnosis instance AMP" UWORD _CNV_S_2_RANGE__0___1_CM 1 100. 0. 1. DISPLAY_IDENTIFIER LV_END_DIAG_AMP ECU_ADDRESS 0xd00093de BIT_MASK 0x20 /end MEASUREMENT
/begin MEASUREMENT fmy_stat_amp.err_info_stat.lv_cdn_diag "diagnosis condition of the diagnosis instance AMP" UWORD _CNV_S_2_RANGE__0___1_CM 1 100. 0. 1. DISPLAY_IDENTIFIER LV_CDN_DIAG_AMP ECU_ADDRESS 0xd00093de BIT_MASK 0x40 /end MEASUREMENT
/begin MEASUREMENT fmy_stat_amp.err_info_stat.err_sym "symptoms of the diagnosis instance AMP" UWORD _CNV_S_16_RANGE_ERR__349_CM 1 100. 0. 15. DISPLAY_IDENTIFIER ERR_SYM_AMP ECU_ADDRESS 0xd00093de BIT_MASK 0x780 /end MEASUREMENT
/begin MEASUREMENT fmy_stat_amp_plaus.ctr_abc "anti bounce counter for diagnosis instance AMP_PLAUS" UBYTE _CNV_A_R_LINEAR_____0_CM 1 100. 0. 255. DISPLAY_IDENTIFIER CTR_ABC_AMP_PLAUS ECU_ADDRESS 0xd00093e0 FORMAT "%3.0" /end MEASUREMENT
/begin MEASUREMENT fmy_stat_amp_plaus.ctr_end_diag "counter for end of diagnosis for diagnosis instance AMP_PLAUS" UBYTE _CNV_A_R_LINEAR_____0_CM 1 100. 0. 255. DISPLAY_IDENTIFIER CTR_ABC_END_DIAG_AMP_PLAUS ECU_ADDRESS 0xd00093e1 FORMAT "%3.0" /end MEASUREMENT
/begin MEASUREMENT fmy_stat_amp_plaus.err_info_stat.lv_err_mem "storage in dynamic failure memory of the diagnosis instance AMP_PLAUS" UWORD _CNV_S_2_RANGE__0___1_CM 1 100. 0. 1. DISPLAY_IDENTIFIER LV_ERR_MEM_AMP_PLAUS ECU_ADDRESS 0xd00093e2 BIT_MASK 0x8 /end MEASUREMENT
/begin MEASUREMENT fmy_stat_amp_plaus.err_info_stat.lv_ready "readiness status of the diagnosis instance AMP_PLAUS" UWORD _CNV_S_2_RANGE__0___1_CM 1 100. 0. 1. DISPLAY_IDENTIFIER LV_READY_AMP_PLAUS ECU_ADDRESS 0xd00093e2 BIT_MASK 0x10 /end MEASUREMENT
/begin MEASUREMENT fmy_stat_amp_plaus.err_info_stat.lv_end_diag "end of diagnosis of the diagnosis instance AMP_PLAUS" UWORD _CNV_S_2_RANGE__0___1_CM 1 100. 0. 1. DISPLAY_IDENTIFIER LV_END_DIAG_AMP_PLAUS ECU_ADDRESS 0xd00093e2 BIT_MASK 0x20 /end MEASUREMENT
/begin MEASUREMENT fmy_stat_amp_plaus.err_info_stat.lv_cdn_diag "diagnosis condition of the diagnosis instance AMP_PLAUS" UWORD _CNV_S_2_RANGE__0___1_CM 1 100. 0. 1. DISPLAY_IDENTIFIER LV_CDN_DIAG_AMP_PLAUS ECU_ADDRESS 0xd00093e2 BIT_MASK 0x40 /end MEASUREMENT
/begin MEASUREMENT fmy_stat_amp_plaus.err_info_stat.err_sym "symptoms of the diagnosis instance AMP_PLAUS" UWORD _CNV_S_16_RANGE_ERR__349_CM 1 100. 0. 15. DISPLAY_IDENTIFIER ERR_SYM_AMP_PLAUS ECU_ADDRESS 0xd00093e2 BIT_MASK 0x780 /end MEASUREMENT
/begin MEASUREMENT fmy_stat_maf.ctr_abc "anti bounce counter for diagnosis instance MAF" UBYTE _CNV_A_R_LINEAR_____0_CM 1 100. 0. 255. DISPLAY_IDENTIFIER CTR_ABC_MAF ECU_ADDRESS 0xd00097ec FORMAT "%3.0" /end MEASUREMENT
/begin MEASUREMENT fmy_stat_maf.ctr_end_diag "counter for end of diagnosis for diagnosis instance MAF" UBYTE _CNV_A_R_LINEAR_____0_CM 1 100. 0. 255. DISPLAY_IDENTIFIER CTR_ABC_END_DIAG_MAF ECU_ADDRESS 0xd00097ed FORMAT "%3.0" /end MEASUREMENT
/begin MEASUREMENT fmy_stat_maf.err_info_stat.lv_err_mem "storage in dynamic failure memory of the diagnosis instance MAF" UWORD _CNV_S_2_RANGE__0___1_CM 1 100. 0. 1. DISPLAY_IDENTIFIER LV_ERR_MEM_MAF ECU_ADDRESS 0xd00097ee BIT_MASK 0x8 /end MEASUREMENT
/begin MEASUREMENT fmy_stat_maf.err_info_stat.lv_ready "readiness status of the diagnosis instance MAF" UWORD _CNV_S_2_RANGE__0___1_CM 1 100. 0. 1. DISPLAY_IDENTIFIER LV_READY_MAF ECU_ADDRESS 0xd00097ee BIT_MASK 0x10 /end MEASUREMENT
/begin MEASUREMENT fmy_stat_maf.err_info_stat.lv_end_diag "end of diagnosis of the diagnosis instance MAF" UWORD _CNV_S_2_RANGE__0___1_CM 1 100. 0. 1. DISPLAY_IDENTIFIER LV_END_DIAG_MAF ECU_ADDRESS 0xd00097ee BIT_MASK 0x20 /end MEASUREMENT
/begin MEASUREMENT fmy_stat_maf.err_info_stat.lv_cdn_diag "diagnosis condition of the diagnosis instance MAF" UWORD _CNV_S_2_RANGE__0___1_CM 1 100. 0. 1. DISPLAY_IDENTIFIER LV_CDN_DIAG_MAF ECU_ADDRESS 0xd00097ee BIT_MASK 0x40 /end MEASUREMENT
/begin MEASUREMENT fmy_stat_maf.err_info_stat.err_sym "symptoms of the diagnosis instance MAF" UWORD _CNV_S_16_RANGE_ERR__349_CM 1 100. 0. 15. DISPLAY_IDENTIFIER ERR_SYM_MAF ECU_ADDRESS 0xd00097ee BIT_MASK 0x780 /end MEASUREMENT
/begin MEASUREMENT fmy_stat_el_cps.ctr_abc "anti bounce counter for diagnosis instance EL_CPS" UBYTE _CNV_A_R_LINEAR_____0_CM 1 100. 0. 255. DISPLAY_IDENTIFIER CTR_ABC_EL_CPS ECU_ADDRESS 0xd0009658 FORMAT "%3.0" /end MEASUREMENT
/begin MEASUREMENT fmy_stat_el_cps.ctr_end_diag "counter for end of diagnosis for diagnosis instance EL_CPS" UBYTE _CNV_A_R_LINEAR_____0_CM 1 100. 0. 255. DISPLAY_IDENTIFIER CTR_ABC_END_DIAG_EL_CPS ECU_ADDRESS 0xd0009659 FORMAT "%3.0" /end MEASUREMENT
/begin MEASUREMENT fmy_stat_el_cps.err_info_stat.lv_err_mem "storage in dynamic failure memory of the diagnosis instance EL_CPS" UWORD _CNV_S_2_RANGE__0___1_CM 1 100. 0. 1. DISPLAY_IDENTIFIER LV_ERR_MEM_EL_CPS ECU_ADDRESS 0xd000965a BIT_MASK 0x8 /end MEASUREMENT
/begin MEASUREMENT fmy_stat_el_cps.err_info_stat.lv_ready "readiness status of the diagnosis instance EL_CPS" UWORD _CNV_S_2_RANGE__0___1_CM 1 100. 0. 1. DISPLAY_IDENTIFIER LV_READY_EL_CPS ECU_ADDRESS 0xd000965a BIT_MASK 0x10 /end MEASUREMENT
/begin MEASUREMENT fmy_stat_el_cps.err_info_stat.lv_end_diag "end of diagnosis of the diagnosis instance EL_CPS" UWORD _CNV_S_2_RANGE__0___1_CM 1 100. 0. 1. DISPLAY_IDENTIFIER LV_END_DIAG_EL_CPS ECU_ADDRESS 0xd000965a BIT_MASK 0x20 /end MEASUREMENT
/begin MEASUREMENT fmy_stat_el_cps.err_info_stat.lv_cdn_diag "diagnosis condition of the diagnosis instance EL_CPS" UWORD _CNV_S_2_RANGE__0___1_CM 1 100. 0. 1. DISPLAY_IDENTIFIER LV_CDN_DIAG_EL_CPS ECU_ADDRESS 0xd000965a BIT_MASK 0x40 /end MEASUREMENT
/begin MEASUREMENT fmy_stat_el_cps.err_info_stat.err_sym "symptoms of the diagnosis instance EL_CPS" UWORD _CNV_S_16_RANGE_ERR__349_CM 1 100. 0. 15. DISPLAY_IDENTIFIER ERR_SYM_EL_CPS ECU_ADDRESS 0xd000965a BIT_MASK 0x780 /end MEASUREMENT
/begin MEASUREMENT lv_inh_diag_iv "Inhibition condition for  the IV diagnostic" UBYTE _CNV_S_2_RANGE__0___1_CM 1 100. 0. 1. DISPLAY_IDENTIFIER LV_INH_DIAG_IV ECU_ADDRESS 0xd0007678 BIT_MASK 0x1 /end MEASUREMENT
/begin MEASUREMENT lv_err_iv_lst_cyc "Flag that indicates if a debounced injector error is present at the end of the driving cycle " UBYTE _CNV_S_2_RANGE__0___1_CM 1 100. 0. 1. DISPLAY_IDENTIFIER LV_ERR_IV_LST_CYC ECU_ADDRESS 0xd0007674 BIT_MASK 0x1 /end MEASUREMENT
/begin CHARACTERISTIC c_tco_thd_inh_diag_iv "TCO threshold below which the injector diagnosis is inhibited" VALUE 0xa0806590 _REC_VAL_20_u1 190.5 _CNV_A_R_LINEAR_____17_CM -48. 142.5 DISPLAY_IDENTIFIER C_TCO_THD_INH_DIAG_IV FORMAT "%6.2" /end CHARACTERISTIC
/begin MEASUREMENT inh_iv_diag_err "Cylinder shut off request from injection valve diagnosis (cylinder allocated)" UBYTE _CNV_A_R_LINEAR_____0_CM 1 100. 0. 255. DISPLAY_IDENTIFIER INH_IV_DIAG_ERR ECU_ADDRESS 0xd000762f FORMAT "%3.0" /end MEASUREMENT
/begin CHARACTERISTIC lc_inh_iv_diag_err_ena "Manual switch for activation of INH_IV_DIAG_ERR" VALUE 0xa08065e3 _REC_VAL_20_u1 1. _CNV_A_R_LINEAR_____0_CM 0. 1. DISPLAY_IDENTIFIER LC_INH_IV_DIAG_ERR_ENA FORMAT "%1.0" /end CHARACTERISTIC
/begin MEASUREMENT lv_inh_diag_pbk_iv "Inhibition condition for  the injection valve power stage diagnosis" UBYTE _CNV_S_2_RANGE__0___1_CM 1 100. 0. 1. DISPLAY_IDENTIFIER LV_INH_DIAG_PBK_IV ECU_ADDRESS 0xd0007679 BIT_MASK 0x1 /end MEASUREMENT
/begin MEASUREMENT lv_err_pbk_iv_lst_cyc "Flag that indicates if a debounced injection valve power stage error is present at the end of the driving cycle" UBYTE _CNV_S_2_RANGE__0___1_CM 1 100. 0. 1. DISPLAY_IDENTIFIER LV_ERR_PBK_IV_LST_CYC ECU_ADDRESS 0xd0007675 BIT_MASK 0x1 /end MEASUREMENT
/begin MEASUREMENT state_diag_iv "Error pattern without debouncing for all injectors" UBYTE _CNV_A_R_LINEAR_____0_CM 1 100. 0. 255. DISPLAY_IDENTIFIER STATE_DIAG_IV ECU_ADDRESS 0xd000763b FORMAT "%3.0" /end MEASUREMENT
/begin CHARACTERISTIC c_n_cdn_diag_iv_fl_thd "Threshold disable diagnosis at full load" VALUE 0xa0806574 _REC_VAL_20_u1 8160. _CNV_A_R_LINEAR_____10_CM 0. 8160. DISPLAY_IDENTIFIER C_N_CDN_DIAG_IV_FL_THD FORMAT "%4.0" /end CHARACTERISTIC
/begin CHARACTERISTIC c_abc_inc_iv "Anti-bounce increment value" VALUE 0xa0806518 _REC_VAL_20_u1 255. _CNV_A_R_LINEAR_____0_CM 0. 255. DISPLAY_IDENTIFIER C_ABC_INC_IV FORMAT "%3.0" /end CHARACTERISTIC
/begin CHARACTERISTIC c_abc_max_iv "Anti-bounce maximum value" VALUE 0xa080651a _REC_VAL_20_u1 254. _CNV_A_R_LINEAR_____0_CM 1. 255. DISPLAY_IDENTIFIER C_ABC_MAX_IV FORMAT "%3.0" /end CHARACTERISTIC
/begin MEASUREMENT state_err_iv "Error pattern after debouncing for all injectors" UBYTE _CNV_A_R_LINEAR_____0_CM 1 100. 0. 255. DISPLAY_IDENTIFIER STATE_ERR_IV ECU_ADDRESS 0xd000763d FORMAT "%3.0" /end MEASUREMENT
/begin MEASUREMENT state_err_iv_cyl[0] "Detailed error information of injection valve, cylinder individual" UBYTE _CNV_A_R_LINEAR_____0_CM 1 100. 0. 255. DISPLAY_IDENTIFIER STATE_ERR_IV_CYL[0] ECU_ADDRESS 0xd0003370 FORMAT "%3.0" /end MEASUREMENT
/begin MEASUREMENT state_err_iv_cyl[1] "Detailed error information of injection valve, cylinder individual" UBYTE _CNV_A_R_LINEAR_____0_CM 1 100. 0. 255. DISPLAY_IDENTIFIER STATE_ERR_IV_CYL[1] ECU_ADDRESS 0xd0003371 FORMAT "%3.0" /end MEASUREMENT
/begin MEASUREMENT state_err_iv_cyl[2] "Detailed error information of injection valve, cylinder individual" UBYTE _CNV_A_R_LINEAR_____0_CM 1 100. 0. 255. DISPLAY_IDENTIFIER STATE_ERR_IV_CYL[2] ECU_ADDRESS 0xd0003372 FORMAT "%3.0" /end MEASUREMENT
/begin MEASUREMENT state_err_iv_cyl[3] "Detailed error information of injection valve, cylinder individual" UBYTE _CNV_A_R_LINEAR_____0_CM 1 100. 0. 255. DISPLAY_IDENTIFIER STATE_ERR_IV_CYL[3] ECU_ADDRESS 0xd0003373 FORMAT "%3.0" /end MEASUREMENT
/begin MEASUREMENT state_err_iv_cyl[4] "Detailed error information of injection valve, cylinder individual" UBYTE _CNV_A_R_LINEAR_____0_CM 1 100. 0. 255. DISPLAY_IDENTIFIER STATE_ERR_IV_CYL[4] ECU_ADDRESS 0xd0003374 FORMAT "%3.0" /end MEASUREMENT
/begin MEASUREMENT state_err_iv_cyl[5] "Detailed error information of injection valve, cylinder individual" UBYTE _CNV_A_R_LINEAR_____0_CM 1 100. 0. 255. DISPLAY_IDENTIFIER STATE_ERR_IV_CYL[5] ECU_ADDRESS 0xd0003375 FORMAT "%3.0" /end MEASUREMENT
/begin MEASUREMENT state_err_iv_cyl[6] "Detailed error information of injection valve, cylinder individual" UBYTE _CNV_A_R_LINEAR_____0_CM 1 100. 0. 255. DISPLAY_IDENTIFIER STATE_ERR_IV_CYL[6] ECU_ADDRESS 0xd0003376 FORMAT "%3.0" /end MEASUREMENT
/begin MEASUREMENT state_err_iv_cyl[7] "Detailed error information of injection valve, cylinder individual" UBYTE _CNV_A_R_LINEAR_____0_CM 1 100. 0. 255. DISPLAY_IDENTIFIER STATE_ERR_IV_CYL[7] ECU_ADDRESS 0xd0003377 FORMAT "%3.0" /end MEASUREMENT
/begin MEASUREMENT lv_err_iv_sc[0] "Error flag for indication of a detailed short circuit error information (only for display)" UBYTE _CNV_S_2_RANGE__0___1_CM 1 100. 0. 1. DISPLAY_IDENTIFIER LV_ERR_IV_SC[0] ECU_ADDRESS 0xd000339c /end MEASUREMENT
/begin MEASUREMENT lv_err_iv_sc[1] "Error flag for indication of a detailed short circuit error information (only for display)" UBYTE _CNV_S_2_RANGE__0___1_CM 1 100. 0. 1. DISPLAY_IDENTIFIER LV_ERR_IV_SC[1] ECU_ADDRESS 0xd000339d /end MEASUREMENT
/begin MEASUREMENT lv_err_iv_sc[2] "Error flag for indication of a detailed short circuit error information (only for display)" UBYTE _CNV_S_2_RANGE__0___1_CM 1 100. 0. 1. DISPLAY_IDENTIFIER LV_ERR_IV_SC[2] ECU_ADDRESS 0xd000339e /end MEASUREMENT
/begin MEASUREMENT lv_err_iv_sc[3] "Error flag for indication of a detailed short circuit error information (only for display)" UBYTE _CNV_S_2_RANGE__0___1_CM 1 100. 0. 1. DISPLAY_IDENTIFIER LV_ERR_IV_SC[3] ECU_ADDRESS 0xd000339f /end MEASUREMENT
/begin MEASUREMENT lv_err_iv_sc[4] "Error flag for indication of a detailed short circuit error information (only for display)" UBYTE _CNV_S_2_RANGE__0___1_CM 1 100. 0. 1. DISPLAY_IDENTIFIER LV_ERR_IV_SC[4] ECU_ADDRESS 0xd00033a0 /end MEASUREMENT
/begin MEASUREMENT lv_err_iv_sc[5] "Error flag for indication of a detailed short circuit error information (only for display)" UBYTE _CNV_S_2_RANGE__0___1_CM 1 100. 0. 1. DISPLAY_IDENTIFIER LV_ERR_IV_SC[5] ECU_ADDRESS 0xd00033a1 /end MEASUREMENT
/begin MEASUREMENT lv_err_iv_sc[6] "Error flag for indication of a detailed short circuit error information (only for display)" UBYTE _CNV_S_2_RANGE__0___1_CM 1 100. 0. 1. DISPLAY_IDENTIFIER LV_ERR_IV_SC[6] ECU_ADDRESS 0xd00033a2 /end MEASUREMENT
/begin MEASUREMENT lv_err_iv_sc[7] "Error flag for indication of a detailed short circuit error information (only for display)" UBYTE _CNV_S_2_RANGE__0___1_CM 1 100. 0. 1. DISPLAY_IDENTIFIER LV_ERR_IV_SC[7] ECU_ADDRESS 0xd00033a3 /end MEASUREMENT
/begin MEASUREMENT lv_err_iv[0] "Error flag for IVx derived from STATE_ERR_IV (only for display)" UBYTE _CNV_S_2_RANGE__0___1_CM 1 100. 0. 1. DISPLAY_IDENTIFIER LV_ERR_IV[0] ECU_ADDRESS 0xd000338c /end MEASUREMENT
/begin MEASUREMENT lv_err_iv[1] "Error flag for IVx derived from STATE_ERR_IV (only for display)" UBYTE _CNV_S_2_RANGE__0___1_CM 1 100. 0. 1. DISPLAY_IDENTIFIER LV_ERR_IV[1] ECU_ADDRESS 0xd000338d /end MEASUREMENT
/begin MEASUREMENT lv_err_iv[2] "Error flag for IVx derived from STATE_ERR_IV (only for display)" UBYTE _CNV_S_2_RANGE__0___1_CM 1 100. 0. 1. DISPLAY_IDENTIFIER LV_ERR_IV[2] ECU_ADDRESS 0xd000338e /end MEASUREMENT
/begin MEASUREMENT lv_err_iv[3] "Error flag for IVx derived from STATE_ERR_IV (only for display)" UBYTE _CNV_S_2_RANGE__0___1_CM 1 100. 0. 1. DISPLAY_IDENTIFIER LV_ERR_IV[3] ECU_ADDRESS 0xd000338f /end MEASUREMENT
/begin MEASUREMENT lv_err_iv[4] "Error flag for IVx derived from STATE_ERR_IV (only for display)" UBYTE _CNV_S_2_RANGE__0___1_CM 1 100. 0. 1. DISPLAY_IDENTIFIER LV_ERR_IV[4] ECU_ADDRESS 0xd0003390 /end MEASUREMENT
/begin MEASUREMENT lv_err_iv[5] "Error flag for IVx derived from STATE_ERR_IV (only for display)" UBYTE _CNV_S_2_RANGE__0___1_CM 1 100. 0. 1. DISPLAY_IDENTIFIER LV_ERR_IV[5] ECU_ADDRESS 0xd0003391 /end MEASUREMENT
/begin MEASUREMENT lv_err_iv[6] "Error flag for IVx derived from STATE_ERR_IV (only for display)" UBYTE _CNV_S_2_RANGE__0___1_CM 1 100. 0. 1. DISPLAY_IDENTIFIER LV_ERR_IV[6] ECU_ADDRESS 0xd0003392 /end MEASUREMENT
/begin MEASUREMENT lv_err_iv[7] "Error flag for IVx derived from STATE_ERR_IV (only for display)" UBYTE _CNV_S_2_RANGE__0___1_CM 1 100. 0. 1. DISPLAY_IDENTIFIER LV_ERR_IV[7] ECU_ADDRESS 0xd0003393 /end MEASUREMENT
/begin CHARACTERISTIC c_ti_thd_inh_diag_iv "Injection time threshold below the IV diagnosis will be inhibited" VALUE 0xa08065d6 _REC_VAL_20_u2 65.535 _CNV_A_R_LINEAR_____228_CM 0. 65.535 DISPLAY_IDENTIFIER C_TI_THD_INH_DIAG_IV /end CHARACTERISTIC
/begin CHARACTERISTIC c_inh_diag_iv_swi_man "Manual switch pattern for cylinder individual inhibition of injection valve diagnosis (bit x = 1, diagnosis of cylinder x will be inhibited)" VALUE 0xa080656a _REC_VAL_20_u1 255. _CNV_A_R_LINEAR_____0_CM 0. 255. DISPLAY_IDENTIFIER C_INH_DIAG_IV_SWI_MAN FORMAT "%3.0" /end CHARACTERISTIC
/begin MEASUREMENT nr_cyl_diag_iv "Number of the logical cylinder, which has done its injection valve diagnosis cycle" UBYTE _CNV_A_R_LINEAR_____0_CM 1 100. 0. 7. DISPLAY_IDENTIFIER NR_CYL_DIAG_IV ECU_ADDRESS 0xd000336a FORMAT "%1.0" /end MEASUREMENT
/begin MEASUREMENT cdn_diag_iv[0] "Diagnosis condition for each symptom of injector 0" UBYTE _CNV_A_R_LINEAR_____0_CM 1 100. 0. 255. DISPLAY_IDENTIFIER CDN_DIAG_IV[0] ECU_ADDRESS 0xd0003358 FORMAT "%3.0" /end MEASUREMENT
/begin MEASUREMENT cdn_diag_iv[1] "Diagnosis condition for each symptom of injector 1" UBYTE _CNV_A_R_LINEAR_____0_CM 1 100. 0. 255. DISPLAY_IDENTIFIER CDN_DIAG_IV[1] ECU_ADDRESS 0xd0003359 FORMAT "%3.0" /end MEASUREMENT
/begin MEASUREMENT cdn_diag_iv[2] "Diagnosis condition for each symptom of injector 2" UBYTE _CNV_A_R_LINEAR_____0_CM 1 100. 0. 255. DISPLAY_IDENTIFIER CDN_DIAG_IV[2] ECU_ADDRESS 0xd000335a FORMAT "%3.0" /end MEASUREMENT
/begin MEASUREMENT cdn_diag_iv[3] "Diagnosis condition for each symptom of injector 3" UBYTE _CNV_A_R_LINEAR_____0_CM 1 100. 0. 255. DISPLAY_IDENTIFIER CDN_DIAG_IV[3] ECU_ADDRESS 0xd000335b FORMAT "%3.0" /end MEASUREMENT
/begin MEASUREMENT cdn_diag_iv[4] "Diagnosis condition for each symptom of injector 4" UBYTE _CNV_A_R_LINEAR_____0_CM 1 100. 0. 255. DISPLAY_IDENTIFIER CDN_DIAG_IV[4] ECU_ADDRESS 0xd000335c FORMAT "%3.0" /end MEASUREMENT
/begin MEASUREMENT cdn_diag_iv[5] "Diagnosis condition for each symptom of injector 5" UBYTE _CNV_A_R_LINEAR_____0_CM 1 100. 0. 255. DISPLAY_IDENTIFIER CDN_DIAG_IV[5] ECU_ADDRESS 0xd000335d FORMAT "%3.0" /end MEASUREMENT
/begin MEASUREMENT cdn_diag_iv[6] "Diagnosis condition for each symptom of injector 6" UBYTE _CNV_A_R_LINEAR_____0_CM 1 100. 0. 255. DISPLAY_IDENTIFIER CDN_DIAG_IV[6] ECU_ADDRESS 0xd000335e FORMAT "%3.0" /end MEASUREMENT
/begin MEASUREMENT cdn_diag_iv[7] "Diagnosis condition for each symptom of injector 7" UBYTE _CNV_A_R_LINEAR_____0_CM 1 100. 0. 255. DISPLAY_IDENTIFIER CDN_DIAG_IV[7] ECU_ADDRESS 0xd000335f FORMAT "%3.0" /end MEASUREMENT
/begin MEASUREMENT cdn_diag_iv_req[0] "Diagnosis condition for each symptom of injector 0" UBYTE _CNV_A_R_LINEAR_____0_CM 1 100. 0. 255. DISPLAY_IDENTIFIER CDN_DIAG_IV_REQ[0] ECU_ADDRESS 0xd0007614 FORMAT "%3.0" /end MEASUREMENT
/begin MEASUREMENT cdn_diag_iv_req[1] "Diagnosis condition for each symptom of injector 1" UBYTE _CNV_A_R_LINEAR_____0_CM 1 100. 0. 255. DISPLAY_IDENTIFIER CDN_DIAG_IV_REQ[1] ECU_ADDRESS 0xd0007615 FORMAT "%3.0" /end MEASUREMENT
/begin MEASUREMENT cdn_diag_iv_req[2] "Diagnosis condition for each symptom of injector 2" UBYTE _CNV_A_R_LINEAR_____0_CM 1 100. 0. 255. DISPLAY_IDENTIFIER CDN_DIAG_IV_REQ[2] ECU_ADDRESS 0xd0007616 FORMAT "%3.0" /end MEASUREMENT
/begin MEASUREMENT cdn_diag_iv_req[3] "Diagnosis condition for each symptom of injector 3" UBYTE _CNV_A_R_LINEAR_____0_CM 1 100. 0. 255. DISPLAY_IDENTIFIER CDN_DIAG_IV_REQ[3] ECU_ADDRESS 0xd0007617 FORMAT "%3.0" /end MEASUREMENT
/begin MEASUREMENT cdn_diag_iv_req[4] "Diagnosis condition for each symptom of injector 4" UBYTE _CNV_A_R_LINEAR_____0_CM 1 100. 0. 255. DISPLAY_IDENTIFIER CDN_DIAG_IV_REQ[4] ECU_ADDRESS 0xd0007618 FORMAT "%3.0" /end MEASUREMENT
/begin MEASUREMENT cdn_diag_iv_req[5] "Diagnosis condition for each symptom of injector 5" UBYTE _CNV_A_R_LINEAR_____0_CM 1 100. 0. 255. DISPLAY_IDENTIFIER CDN_DIAG_IV_REQ[5] ECU_ADDRESS 0xd0007619 FORMAT "%3.0" /end MEASUREMENT
/begin MEASUREMENT cdn_diag_iv_req[6] "Diagnosis condition for each symptom of injector 6" UBYTE _CNV_A_R_LINEAR_____0_CM 1 100. 0. 255. DISPLAY_IDENTIFIER CDN_DIAG_IV_REQ[6] ECU_ADDRESS 0xd000761a FORMAT "%3.0" /end MEASUREMENT
/begin MEASUREMENT cdn_diag_iv_req[7] "Diagnosis condition for each symptom of injector 7" UBYTE _CNV_A_R_LINEAR_____0_CM 1 100. 0. 255. DISPLAY_IDENTIFIER CDN_DIAG_IV_REQ[7] ECU_ADDRESS 0xd000761b FORMAT "%3.0" /end MEASUREMENT
/begin MEASUREMENT state_diag_pbk_iv "Error pattern without debouncing for all injection valve power stages" UBYTE _CNV_A_R_LINEAR_____0_CM 1 100. 0. 255. DISPLAY_IDENTIFIER STATE_DIAG_PBK_IV ECU_ADDRESS 0xd000763c FORMAT "%3.0" /end MEASUREMENT
/begin MEASUREMENT lv_err_pbk_iv[0] "Error flag for injection valve power stage bank errors derived from STATE_ERR_PBK_IV (only for display)" UBYTE _CNV_S_2_RANGE__0___1_CM 1 100. 0. 1. DISPLAY_IDENTIFIER LV_ERR_PBK_IV[1] ECU_ADDRESS 0xd00033a4 /end MEASUREMENT
/begin MEASUREMENT lv_err_pbk_iv[1] "Error flag for injection valve power stage bank errors derived from STATE_ERR_PBK_IV (only for display)" UBYTE _CNV_S_2_RANGE__0___1_CM 1 100. 0. 1. DISPLAY_IDENTIFIER LV_ERR_PBK_IV[2] ECU_ADDRESS 0xd00033a5 /end MEASUREMENT
/begin MEASUREMENT lv_err_pbk_iv[2] "Error flag for injection valve power stage bank errors derived from STATE_ERR_PBK_IV (only for display)" UBYTE _CNV_S_2_RANGE__0___1_CM 1 100. 0. 1. DISPLAY_IDENTIFIER LV_ERR_PBK_IV[3] ECU_ADDRESS 0xd00033a6 /end MEASUREMENT
/begin MEASUREMENT lv_err_pbk_iv[3] "Error flag for injection valve power stage bank errors derived from STATE_ERR_PBK_IV (only for display)" UBYTE _CNV_S_2_RANGE__0___1_CM 1 100. 0. 1. DISPLAY_IDENTIFIER LV_ERR_PBK_IV[4] ECU_ADDRESS 0xd00033a7 /end MEASUREMENT
/begin MEASUREMENT state_err_pbk_iv "" UBYTE _CNV_A_R_LINEAR_____0_CM 1 100. 0. 255. DISPLAY_IDENTIFIER STATE_ERR_PBK_IV ECU_ADDRESS 0xd000763e FORMAT "%3.0" /end MEASUREMENT
/begin MEASUREMENT cdn_diag_pbk_iv[0] "Diagnosis condition for each error symptom of injection valve power stage bank" UBYTE _CNV_A_R_LINEAR_____0_CM 1 100. 0. 255. DISPLAY_IDENTIFIER CDN_DIAG_PBK_IV[1] ECU_ADDRESS 0xd0003360 FORMAT "%3.0" /end MEASUREMENT
/begin MEASUREMENT cdn_diag_pbk_iv[1] "Diagnosis condition for each error symptom of injection valve power stage bank" UBYTE _CNV_A_R_LINEAR_____0_CM 1 100. 0. 255. DISPLAY_IDENTIFIER CDN_DIAG_PBK_IV[2] ECU_ADDRESS 0xd0003361 FORMAT "%3.0" /end MEASUREMENT
/begin MEASUREMENT cdn_diag_pbk_iv[2] "Diagnosis condition for each error symptom of injection valve power stage bank" UBYTE _CNV_A_R_LINEAR_____0_CM 1 100. 0. 255. DISPLAY_IDENTIFIER CDN_DIAG_PBK_IV[3] ECU_ADDRESS 0xd0003362 FORMAT "%3.0" /end MEASUREMENT
/begin MEASUREMENT cdn_diag_pbk_iv[3] "Diagnosis condition for each error symptom of injection valve power stage bank" UBYTE _CNV_A_R_LINEAR_____0_CM 1 100. 0. 255. DISPLAY_IDENTIFIER CDN_DIAG_PBK_IV[4] ECU_ADDRESS 0xd0003363 FORMAT "%3.0" /end MEASUREMENT
/begin MEASUREMENT state_err_sym_pbk_iv[0] "Detailed error symptom information of injection valve power stages, ATIC bank individual" UBYTE _CNV_A_R_LINEAR_____0_CM 1 100. 0. 255. DISPLAY_IDENTIFIER STATE_ERR_SYM_PBK_IV[1] ECU_ADDRESS 0xd0007640 FORMAT "%3.0" /end MEASUREMENT
/begin MEASUREMENT state_err_sym_pbk_iv[1] "Detailed error symptom information of injection valve power stages, ATIC bank individual" UBYTE _CNV_A_R_LINEAR_____0_CM 1 100. 0. 255. DISPLAY_IDENTIFIER STATE_ERR_SYM_PBK_IV[2] ECU_ADDRESS 0xd0007641 FORMAT "%3.0" /end MEASUREMENT
/begin MEASUREMENT state_err_sym_pbk_iv[2] "Detailed error symptom information of injection valve power stages, ATIC bank individual" UBYTE _CNV_A_R_LINEAR_____0_CM 1 100. 0. 255. DISPLAY_IDENTIFIER STATE_ERR_SYM_PBK_IV[3] ECU_ADDRESS 0xd0007642 FORMAT "%3.0" /end MEASUREMENT
/begin MEASUREMENT state_err_sym_pbk_iv[3] "Detailed error symptom information of injection valve power stages, ATIC bank individual" UBYTE _CNV_A_R_LINEAR_____0_CM 1 100. 0. 255. DISPLAY_IDENTIFIER STATE_ERR_SYM_PBK_IV[4] ECU_ADDRESS 0xd0007643 FORMAT "%3.0" /end MEASUREMENT
/begin MEASUREMENT state_err_sym_pbk_iv_st[0] "Detailed error symptom information of injection valve power stages during startup phase, ATIC bank individual" UBYTE _CNV_A_R_LINEAR_____0_CM 1 100. 0. 255. DISPLAY_IDENTIFIER STATE_ERR_SYM_PBK_IV_ST[1] ECU_ADDRESS 0xd0007644 FORMAT "%3.0" /end MEASUREMENT
/begin MEASUREMENT state_err_sym_pbk_iv_st[1] "Detailed error symptom information of injection valve power stages during startup phase, ATIC bank individual" UBYTE _CNV_A_R_LINEAR_____0_CM 1 100. 0. 255. DISPLAY_IDENTIFIER STATE_ERR_SYM_PBK_IV_ST[2] ECU_ADDRESS 0xd0007645 FORMAT "%3.0" /end MEASUREMENT
/begin MEASUREMENT state_err_sym_pbk_iv_st[2] "Detailed error symptom information of injection valve power stages during startup phase, ATIC bank individual" UBYTE _CNV_A_R_LINEAR_____0_CM 1 100. 0. 255. DISPLAY_IDENTIFIER STATE_ERR_SYM_PBK_IV_ST[3] ECU_ADDRESS 0xd0007646 FORMAT "%3.0" /end MEASUREMENT
/begin MEASUREMENT state_err_sym_pbk_iv_st[3] "Detailed error symptom information of injection valve power stages during startup phase, ATIC bank individual" UBYTE _CNV_A_R_LINEAR_____0_CM 1 100. 0. 255. DISPLAY_IDENTIFIER STATE_ERR_SYM_PBK_IV_ST[4] ECU_ADDRESS 0xd0007647 FORMAT "%3.0" /end MEASUREMENT
/begin CHARACTERISTIC c_abc_inc_pbk_iv "Anti-bounce increment value for injection valve power stage diagnosis" VALUE 0xa0806519 _REC_VAL_20_u1 255. _CNV_A_R_LINEAR_____0_CM 0. 255. DISPLAY_IDENTIFIER C_ABC_INC_PBK_IV FORMAT "%3.0" /end CHARACTERISTIC
/begin CHARACTERISTIC c_abc_max_pbk_iv "Anti-bounce maximum value for injection valve power stage diagnosis" VALUE 0xa080651b _REC_VAL_20_u1 254. _CNV_A_R_LINEAR_____0_CM 1. 255. DISPLAY_IDENTIFIER C_ABC_MAX_PBK_IV FORMAT "%3.0" /end CHARACTERISTIC
/begin CHARACTERISTIC c_state_err_sym_pbk_iv_inh "Manual inhibition pattern for injection valve power stage online diagnosis symptom (bit x = 1, diagnosis symptom will be inhibited)" VALUE 0xa0806588 _REC_VAL_20_u1 255. _CNV_A_R_LINEAR_____0_CM 0. 255. DISPLAY_IDENTIFIER C_STATE_ERR_SYM_PBK_IV_INH FORMAT "%3.0" /end CHARACTERISTIC
/begin CHARACTERISTIC c_state_err_sym_pbk_iv_st_inh "Manual inhibition pattern for injection valve power stage startup diagnosis symptom (bit x = 1, diagnosis symptom will be inhibited)" VALUE 0xa0806589 _REC_VAL_20_u1 255. _CNV_A_R_LINEAR_____0_CM 0. 255. DISPLAY_IDENTIFIER C_STATE_ERR_SYM_PBK_IV_ST_INH FORMAT "%3.0" /end CHARACTERISTIC
/begin MEASUREMENT t_dcha_per_post "Piezo IV discharge period for post injection pulse" UBYTE _CNV_A_R_INJR_LINEA_466_CM 1 100. 0. 0.3 DISPLAY_IDENTIFIER T_DCHA_PER_POST ECU_ADDRESS 0xd0007655 FORMAT "%4.2" /end MEASUREMENT
/begin MEASUREMENT egy_step_inj_cha_grd_lim_not[0] "Unlimited piezo injector energy charge gradient for a single step" UWORD _CNV_A_R_INJR_LINEA_460_CM 1 100. 0. 100. DISPLAY_IDENTIFIER EGY_STEP_INJ_CHA_GRD_LIM_NOT[0] ECU_ADDRESS 0xd00032ec FORMAT "%7.3" /end MEASUREMENT
/begin MEASUREMENT egy_step_inj_cha_grd_lim_not[1] "Unlimited piezo injector energy charge gradient for a single step" UWORD _CNV_A_R_INJR_LINEA_460_CM 1 100. 0. 100. DISPLAY_IDENTIFIER EGY_STEP_INJ_CHA_GRD_LIM_NOT[1] ECU_ADDRESS 0xd00032ee FORMAT "%7.3" /end MEASUREMENT
/begin MEASUREMENT egy_step_inj_cha_grd_lim_not[2] "Unlimited piezo injector energy charge gradient for a single step" UWORD _CNV_A_R_INJR_LINEA_460_CM 1 100. 0. 100. DISPLAY_IDENTIFIER EGY_STEP_INJ_CHA_GRD_LIM_NOT[2] ECU_ADDRESS 0xd00032f0 FORMAT "%7.3" /end MEASUREMENT
/begin MEASUREMENT egy_step_inj_cha_grd_lim_not[3] "Unlimited piezo injector energy charge gradient for a single step" UWORD _CNV_A_R_INJR_LINEA_460_CM 1 100. 0. 100. DISPLAY_IDENTIFIER EGY_STEP_INJ_CHA_GRD_LIM_NOT[3] ECU_ADDRESS 0xd00032f2 FORMAT "%7.3" /end MEASUREMENT
/begin MEASUREMENT egy_step_inj_cha_grd_lim_not[4] "Unlimited piezo injector energy charge gradient for a single step" UWORD _CNV_A_R_INJR_LINEA_460_CM 1 100. 0. 100. DISPLAY_IDENTIFIER EGY_STEP_INJ_CHA_GRD_LIM_NOT[4] ECU_ADDRESS 0xd00032f4 FORMAT "%7.3" /end MEASUREMENT
/begin MEASUREMENT egy_step_inj_cha_grd_lim_not[5] "Unlimited piezo injector energy charge gradient for a single step" UWORD _CNV_A_R_INJR_LINEA_460_CM 1 100. 0. 100. DISPLAY_IDENTIFIER EGY_STEP_INJ_CHA_GRD_LIM_NOT[5] ECU_ADDRESS 0xd00032f6 FORMAT "%7.3" /end MEASUREMENT
/begin MEASUREMENT egy_step_inj_cha_grd_lim_not[6] "Unlimited piezo injector energy charge gradient for a single step" UWORD _CNV_A_R_INJR_LINEA_460_CM 1 100. 0. 100. DISPLAY_IDENTIFIER EGY_STEP_INJ_CHA_GRD_LIM_NOT[6] ECU_ADDRESS 0xd00032f8 FORMAT "%7.3" /end MEASUREMENT
/begin MEASUREMENT egy_step_inj_cha_grd_lim_not[7] "Unlimited piezo injector energy charge gradient for a single step" UWORD _CNV_A_R_INJR_LINEA_460_CM 1 100. 0. 100. DISPLAY_IDENTIFIER EGY_STEP_INJ_CHA_GRD_LIM_NOT[7] ECU_ADDRESS 0xd00032fa FORMAT "%7.3" /end MEASUREMENT
/begin MEASUREMENT egy_step_inj_cha_grd_dif_hom[0] "Piezo injector energy charge gradient abundance for a single step - homogenous operation" SWORD _CNV_A_R_INJR_LINEA_460_CM 1 100. -50. 50. DISPLAY_IDENTIFIER EGY_STEP_INJ_CHA_GRD_DIF_HOM[0] ECU_ADDRESS 0xd00032cc FORMAT "%7.3" /end MEASUREMENT
/begin MEASUREMENT egy_step_inj_cha_grd_dif_hom[1] "Piezo injector energy charge gradient abundance for a single step - homogenous operation" SWORD _CNV_A_R_INJR_LINEA_460_CM 1 100. -50. 50. DISPLAY_IDENTIFIER EGY_STEP_INJ_CHA_GRD_DIF_HOM[1] ECU_ADDRESS 0xd00032ce FORMAT "%7.3" /end MEASUREMENT
/begin MEASUREMENT egy_step_inj_cha_grd_dif_hom[2] "Piezo injector energy charge gradient abundance for a single step - homogenous operation" SWORD _CNV_A_R_INJR_LINEA_460_CM 1 100. -50. 50. DISPLAY_IDENTIFIER EGY_STEP_INJ_CHA_GRD_DIF_HOM[2] ECU_ADDRESS 0xd00032d0 FORMAT "%7.3" /end MEASUREMENT
/begin MEASUREMENT egy_step_inj_cha_grd_dif_hom[3] "Piezo injector energy charge gradient abundance for a single step - homogenous operation" SWORD _CNV_A_R_INJR_LINEA_460_CM 1 100. -50. 50. DISPLAY_IDENTIFIER EGY_STEP_INJ_CHA_GRD_DIF_HOM[3] ECU_ADDRESS 0xd00032d2 FORMAT "%7.3" /end MEASUREMENT
/begin MEASUREMENT egy_step_inj_cha_grd_dif_hom[4] "Piezo injector energy charge gradient abundance for a single step - homogenous operation" SWORD _CNV_A_R_INJR_LINEA_460_CM 1 100. -50. 50. DISPLAY_IDENTIFIER EGY_STEP_INJ_CHA_GRD_DIF_HOM[4] ECU_ADDRESS 0xd00032d4 FORMAT "%7.3" /end MEASUREMENT
/begin MEASUREMENT egy_step_inj_cha_grd_dif_hom[5] "Piezo injector energy charge gradient abundance for a single step - homogenous operation" SWORD _CNV_A_R_INJR_LINEA_460_CM 1 100. -50. 50. DISPLAY_IDENTIFIER EGY_STEP_INJ_CHA_GRD_DIF_HOM[5] ECU_ADDRESS 0xd00032d6 FORMAT "%7.3" /end MEASUREMENT
/begin MEASUREMENT egy_step_inj_cha_grd_dif_hom[6] "Piezo injector energy charge gradient abundance for a single step - homogenous operation" SWORD _CNV_A_R_INJR_LINEA_460_CM 1 100. -50. 50. DISPLAY_IDENTIFIER EGY_STEP_INJ_CHA_GRD_DIF_HOM[6] ECU_ADDRESS 0xd00032d8 FORMAT "%7.3" /end MEASUREMENT
/begin MEASUREMENT egy_step_inj_cha_grd_dif_hom[7] "Piezo injector energy charge gradient abundance for a single step - homogenous operation" SWORD _CNV_A_R_INJR_LINEA_460_CM 1 100. -50. 50. DISPLAY_IDENTIFIER EGY_STEP_INJ_CHA_GRD_DIF_HOM[7] ECU_ADDRESS 0xd00032da FORMAT "%7.3" /end MEASUREMENT
/begin MEASUREMENT fac_egy_dif_hom[0] "Energy-level-difference factor - homogenous operation" UWORD _CNV_A_R_INJR_LINEA_526_CM 1 100. -50. 50. DISPLAY_IDENTIFIER FAC_EGY_DIF_HOM[0] ECU_ADDRESS 0xd0003304 FORMAT "%7.3" /end MEASUREMENT
/begin MEASUREMENT fac_egy_dif_hom[1] "Energy-level-difference factor - homogenous operation" UWORD _CNV_A_R_INJR_LINEA_526_CM 1 100. -50. 50. DISPLAY_IDENTIFIER FAC_EGY_DIF_HOM[1] ECU_ADDRESS 0xd0003306 FORMAT "%7.3" /end MEASUREMENT
/begin MEASUREMENT fac_egy_dif_hom[2] "Energy-level-difference factor - homogenous operation" UWORD _CNV_A_R_INJR_LINEA_526_CM 1 100. -50. 50. DISPLAY_IDENTIFIER FAC_EGY_DIF_HOM[2] ECU_ADDRESS 0xd0003308 FORMAT "%7.3" /end MEASUREMENT
/begin MEASUREMENT fac_egy_dif_hom[3] "Energy-level-difference factor - homogenous operation" UWORD _CNV_A_R_INJR_LINEA_526_CM 1 100. -50. 50. DISPLAY_IDENTIFIER FAC_EGY_DIF_HOM[3] ECU_ADDRESS 0xd000330a FORMAT "%7.3" /end MEASUREMENT
/begin MEASUREMENT fac_egy_dif_hom[4] "Energy-level-difference factor - homogenous operation" UWORD _CNV_A_R_INJR_LINEA_526_CM 1 100. -50. 50. DISPLAY_IDENTIFIER FAC_EGY_DIF_HOM[4] ECU_ADDRESS 0xd000330c FORMAT "%7.3" /end MEASUREMENT
/begin MEASUREMENT fac_egy_dif_hom[5] "Energy-level-difference factor - homogenous operation" UWORD _CNV_A_R_INJR_LINEA_526_CM 1 100. -50. 50. DISPLAY_IDENTIFIER FAC_EGY_DIF_HOM[5] ECU_ADDRESS 0xd000330e FORMAT "%7.3" /end MEASUREMENT
/begin MEASUREMENT fac_egy_dif_hom[6] "Energy-level-difference factor - homogenous operation" UWORD _CNV_A_R_INJR_LINEA_526_CM 1 100. -50. 50. DISPLAY_IDENTIFIER FAC_EGY_DIF_HOM[6] ECU_ADDRESS 0xd0003310 FORMAT "%7.3" /end MEASUREMENT
/begin MEASUREMENT fac_egy_dif_hom[7] "Energy-level-difference factor - homogenous operation" UWORD _CNV_A_R_INJR_LINEA_526_CM 1 100. -50. 50. DISPLAY_IDENTIFIER FAC_EGY_DIF_HOM[7] ECU_ADDRESS 0xd0003312 FORMAT "%7.3" /end MEASUREMENT
/begin MEASUREMENT egy_step_inj_cha_grd_dif_s[0] "Piezo injector energy charge gradient abundance for a single step - stratified operation" SWORD _CNV_A_R_INJR_LINEA_460_CM 1 100. -50. 50. DISPLAY_IDENTIFIER EGY_STEP_INJ_CHA_GRD_DIF_S[0] ECU_ADDRESS 0xd00032dc FORMAT "%7.3" /end MEASUREMENT
/begin MEASUREMENT egy_step_inj_cha_grd_dif_s[1] "Piezo injector energy charge gradient abundance for a single step - stratified operation" SWORD _CNV_A_R_INJR_LINEA_460_CM 1 100. -50. 50. DISPLAY_IDENTIFIER EGY_STEP_INJ_CHA_GRD_DIF_S[1] ECU_ADDRESS 0xd00032de FORMAT "%7.3" /end MEASUREMENT
/begin MEASUREMENT egy_step_inj_cha_grd_dif_s[2] "Piezo injector energy charge gradient abundance for a single step - stratified operation" SWORD _CNV_A_R_INJR_LINEA_460_CM 1 100. -50. 50. DISPLAY_IDENTIFIER EGY_STEP_INJ_CHA_GRD_DIF_S[2] ECU_ADDRESS 0xd00032e0 FORMAT "%7.3" /end MEASUREMENT
/begin MEASUREMENT egy_step_inj_cha_grd_dif_s[3] "Piezo injector energy charge gradient abundance for a single step - stratified operation" SWORD _CNV_A_R_INJR_LINEA_460_CM 1 100. -50. 50. DISPLAY_IDENTIFIER EGY_STEP_INJ_CHA_GRD_DIF_S[3] ECU_ADDRESS 0xd00032e2 FORMAT "%7.3" /end MEASUREMENT
/begin MEASUREMENT egy_step_inj_cha_grd_dif_s[4] "Piezo injector energy charge gradient abundance for a single step - stratified operation" SWORD _CNV_A_R_INJR_LINEA_460_CM 1 100. -50. 50. DISPLAY_IDENTIFIER EGY_STEP_INJ_CHA_GRD_DIF_S[4] ECU_ADDRESS 0xd00032e4 FORMAT "%7.3" /end MEASUREMENT
/begin MEASUREMENT egy_step_inj_cha_grd_dif_s[5] "Piezo injector energy charge gradient abundance for a single step - stratified operation" SWORD _CNV_A_R_INJR_LINEA_460_CM 1 100. -50. 50. DISPLAY_IDENTIFIER EGY_STEP_INJ_CHA_GRD_DIF_S[5] ECU_ADDRESS 0xd00032e6 FORMAT "%7.3" /end MEASUREMENT
/begin MEASUREMENT egy_step_inj_cha_grd_dif_s[6] "Piezo injector energy charge gradient abundance for a single step - stratified operation" SWORD _CNV_A_R_INJR_LINEA_460_CM 1 100. -50. 50. DISPLAY_IDENTIFIER EGY_STEP_INJ_CHA_GRD_DIF_S[6] ECU_ADDRESS 0xd00032e8 FORMAT "%7.3" /end MEASUREMENT
/begin MEASUREMENT egy_step_inj_cha_grd_dif_s[7] "Piezo injector energy charge gradient abundance for a single step - stratified operation" SWORD _CNV_A_R_INJR_LINEA_460_CM 1 100. -50. 50. DISPLAY_IDENTIFIER EGY_STEP_INJ_CHA_GRD_DIF_S[7] ECU_ADDRESS 0xd00032ea FORMAT "%7.3" /end MEASUREMENT
/begin MEASUREMENT fac_egy_dif_s[0] "Energy-level-difference factor - stratified operation" UWORD _CNV_A_R_INJR_LINEA_526_CM 1 100. -50. 50. DISPLAY_IDENTIFIER FAC_EGY_DIF_S[0] ECU_ADDRESS 0xd0003314 FORMAT "%7.3" /end MEASUREMENT
/begin MEASUREMENT fac_egy_dif_s[1] "Energy-level-difference factor - stratified operation" UWORD _CNV_A_R_INJR_LINEA_526_CM 1 100. -50. 50. DISPLAY_IDENTIFIER FAC_EGY_DIF_S[1] ECU_ADDRESS 0xd0003316 FORMAT "%7.3" /end MEASUREMENT
/begin MEASUREMENT fac_egy_dif_s[2] "Energy-level-difference factor - stratified operation" UWORD _CNV_A_R_INJR_LINEA_526_CM 1 100. -50. 50. DISPLAY_IDENTIFIER FAC_EGY_DIF_S[2] ECU_ADDRESS 0xd0003318 FORMAT "%7.3" /end MEASUREMENT
/begin MEASUREMENT fac_egy_dif_s[3] "Energy-level-difference factor - stratified operation" UWORD _CNV_A_R_INJR_LINEA_526_CM 1 100. -50. 50. DISPLAY_IDENTIFIER FAC_EGY_DIF_S[3] ECU_ADDRESS 0xd000331a FORMAT "%7.3" /end MEASUREMENT
/begin MEASUREMENT fac_egy_dif_s[4] "Energy-level-difference factor - stratified operation" UWORD _CNV_A_R_INJR_LINEA_526_CM 1 100. -50. 50. DISPLAY_IDENTIFIER FAC_EGY_DIF_S[4] ECU_ADDRESS 0xd000331c FORMAT "%7.3" /end MEASUREMENT
/begin MEASUREMENT fac_egy_dif_s[5] "Energy-level-difference factor - stratified operation" UWORD _CNV_A_R_INJR_LINEA_526_CM 1 100. -50. 50. DISPLAY_IDENTIFIER FAC_EGY_DIF_S[5] ECU_ADDRESS 0xd000331e FORMAT "%7.3" /end MEASUREMENT
/begin MEASUREMENT fac_egy_dif_s[6] "Energy-level-difference factor - stratified operation" UWORD _CNV_A_R_INJR_LINEA_526_CM 1 100. -50. 50. DISPLAY_IDENTIFIER FAC_EGY_DIF_S[6] ECU_ADDRESS 0xd0003320 FORMAT "%7.3" /end MEASUREMENT
/begin MEASUREMENT fac_egy_dif_s[7] "Energy-level-difference factor - stratified operation" UWORD _CNV_A_R_INJR_LINEA_526_CM 1 100. -50. 50. DISPLAY_IDENTIFIER FAC_EGY_DIF_S[7] ECU_ADDRESS 0xd0003322 FORMAT "%7.3" /end MEASUREMENT
/begin MEASUREMENT fac_mff_dif_s[0] "MFF-difference factor - stratified operation" UWORD _CNV_A_R_INJR_LINEA_465_CM 1 100. -1. 0.99996948 DISPLAY_IDENTIFIER FAC_MFF_DIF_S[0] ECU_ADDRESS 0xd0003324 FORMAT "%8.5" /end MEASUREMENT
/begin MEASUREMENT fac_mff_dif_s[1] "MFF-difference factor - stratified operation" UWORD _CNV_A_R_INJR_LINEA_465_CM 1 100. -1. 0.99996948 DISPLAY_IDENTIFIER FAC_MFF_DIF_S[1] ECU_ADDRESS 0xd0003326 FORMAT "%8.5" /end MEASUREMENT
/begin MEASUREMENT fac_mff_dif_s[2] "MFF-difference factor - stratified operation" UWORD _CNV_A_R_INJR_LINEA_465_CM 1 100. -1. 0.99996948 DISPLAY_IDENTIFIER FAC_MFF_DIF_S[2] ECU_ADDRESS 0xd0003328 FORMAT "%8.5" /end MEASUREMENT
/begin MEASUREMENT fac_mff_dif_s[3] "MFF-difference factor - stratified operation" UWORD _CNV_A_R_INJR_LINEA_465_CM 1 100. -1. 0.99996948 DISPLAY_IDENTIFIER FAC_MFF_DIF_S[3] ECU_ADDRESS 0xd000332a FORMAT "%8.5" /end MEASUREMENT
/begin MEASUREMENT fac_mff_dif_s[4] "MFF-difference factor - stratified operation" UWORD _CNV_A_R_INJR_LINEA_465_CM 1 100. -1. 0.99996948 DISPLAY_IDENTIFIER FAC_MFF_DIF_S[4] ECU_ADDRESS 0xd000332c FORMAT "%8.5" /end MEASUREMENT
/begin MEASUREMENT fac_mff_dif_s[5] "MFF-difference factor - stratified operation" UWORD _CNV_A_R_INJR_LINEA_465_CM 1 100. -1. 0.99996948 DISPLAY_IDENTIFIER FAC_MFF_DIF_S[5] ECU_ADDRESS 0xd000332e FORMAT "%8.5" /end MEASUREMENT
/begin MEASUREMENT fac_mff_dif_s[6] "MFF-difference factor - stratified operation" UWORD _CNV_A_R_INJR_LINEA_465_CM 1 100. -1. 0.99996948 DISPLAY_IDENTIFIER FAC_MFF_DIF_S[6] ECU_ADDRESS 0xd0003330 FORMAT "%8.5" /end MEASUREMENT
/begin MEASUREMENT fac_mff_dif_s[7] "MFF-difference factor - stratified operation" UWORD _CNV_A_R_INJR_LINEA_465_CM 1 100. -1. 0.99996948 DISPLAY_IDENTIFIER FAC_MFF_DIF_S[7] ECU_ADDRESS 0xd0003332 FORMAT "%8.5" /end MEASUREMENT
/begin CHARACTERISTIC c_ti_hys_iv_egy_rng "Injection time hysteresis for the selection of the injector energy range" VALUE 0xa08065d0 _REC_VAL_20_u2 65.535 _CNV_A_R_LINEAR_____228_CM 0. 65.535 DISPLAY_IDENTIFIER C_TI_HYS_IV_EGY_RNG /end CHARACTERISTIC
/begin CHARACTERISTIC c_egy_step_inj_cha_grd_min_hom "Lower threshold of energy charge gradient for a single step - homogenous operation" VALUE 0xa0806540 _REC_VAL_20_u2 100. _CNV_A_R_INJR_LINEA_460_CM 0. 100. DISPLAY_IDENTIFIER C_EGY_STEP_INJ_CHA_GRD_MIN_HOM FORMAT "%7.3" /end CHARACTERISTIC
/begin CHARACTERISTIC c_egy_step_inj_cha_grd_max_s "Upper threshold of energy charge gradient for a single step - stratified operation" VALUE 0xa080653e _REC_VAL_20_u2 100. _CNV_A_R_INJR_LINEA_460_CM 0. 100. DISPLAY_IDENTIFIER C_EGY_STEP_INJ_CHA_GRD_MAX_S FORMAT "%7.3" /end CHARACTERISTIC
/begin CHARACTERISTIC c_egy_step_inj_cha_grd_min_s "Lower threshold of energy charge gradient for a single step - stratified operation" VALUE 0xa0806542 _REC_VAL_20_u2 100. _CNV_A_R_INJR_LINEA_460_CM 0. 100. DISPLAY_IDENTIFIER C_EGY_STEP_INJ_CHA_GRD_MIN_S FORMAT "%7.3" /end CHARACTERISTIC
/begin MEASUREMENT fac_ti_cor_iv_egy_rng_l "Multiplicative injection time correction factor for corrections in case of injector low lift" UWORD _CNV_A_R_LINEAR_____9_CM 1 100. 0. 1.99996948242188 DISPLAY_IDENTIFIER FAC_TI_COR_IV_EGY_RNG_L ECU_ADDRESS 0xd0007028 FORMAT "%7.5" /end MEASUREMENT
/begin MEASUREMENT t_dcha_per_hom "Piezo IV discharge period for homogeneous mode" UBYTE _CNV_A_R_INJR_LINEA_466_CM 1 100. 0. 0.3 DISPLAY_IDENTIFIER T_DCHA_PER_HOM ECU_ADDRESS 0xd0007654 FORMAT "%4.2" /end MEASUREMENT
/begin MEASUREMENT t_cha_per_hom "Piezo IV charge period for homogeneous mode" UBYTE _CNV_A_R_INJR_LINEA_466_CM 1 100. 0. 0.3 DISPLAY_IDENTIFIER T_CHA_PER_HOM ECU_ADDRESS 0xd0007652 FORMAT "%4.2" /end MEASUREMENT
/begin AXIS_PTS ldp_fup_mff_thd_iv_egy_rng "" 0xa08060f8 mff_sp_1_hom[0] _REC_AXS_20_u2 347776. _CNV_A_R_LINEAR_____171_CM 7 0. 347776. FORMAT "%8.1" /end AXIS_PTS
/begin CHARACTERISTIC ip_mff_thd_iv_egy_rng "Fuel mass threshold for the selection of the injector energy range depending on FUP" CURVE 0xa0806450 _REC_CUR_20_u2_u2 1389. _CNV_A_R_LINEAR_____111_CM 0. 1389. DISPLAY_IDENTIFIER IP_MFF_THD_IV_EGY_RNG FORMAT "%7.2"
 /begin AXIS_DESCR COM_AXIS mff_sp_1_hom[0] _CNV_A_R_LINEAR_____171_CM 7 0. 347776. FORMAT "%8.1" AXIS_PTS_REF ldp_fup_mff_thd_iv_egy_rng /end AXIS_DESCR
/end CHARACTERISTIC
/begin CHARACTERISTIC c_mff_hys_iv_egy_rng "Fuel mass hysteresis for the selection of the injector energy range" VALUE 0xa0806570 _REC_VAL_20_u2 1389. _CNV_A_R_LINEAR_____111_CM 0. 1389. DISPLAY_IDENTIFIER C_MFF_HYS_IV_EGY_RNG FORMAT "%7.2" /end CHARACTERISTIC
/begin MEASUREMENT lv_egy_add_ad_lim[0] "Adaptive piezo energy correction is at limit, cylinder individual" UBYTE _CNV_S_2_RANGE__0___1_CM 1 100. 0. 1. DISPLAY_IDENTIFIER LV_EGY_ADD_AD_LIM[0] ECU_ADDRESS 0xd000765c /end MEASUREMENT
/begin MEASUREMENT lv_egy_add_ad_lim[1] "Adaptive piezo energy correction is at limit, cylinder individual" UBYTE _CNV_S_2_RANGE__0___1_CM 1 100. 0. 1. DISPLAY_IDENTIFIER LV_EGY_ADD_AD_LIM[1] ECU_ADDRESS 0xd000765d /end MEASUREMENT
/begin MEASUREMENT lv_egy_add_ad_lim[2] "Adaptive piezo energy correction is at limit, cylinder individual" UBYTE _CNV_S_2_RANGE__0___1_CM 1 100. 0. 1. DISPLAY_IDENTIFIER LV_EGY_ADD_AD_LIM[2] ECU_ADDRESS 0xd000765e /end MEASUREMENT
/begin MEASUREMENT lv_egy_add_ad_lim[3] "Adaptive piezo energy correction is at limit, cylinder individual" UBYTE _CNV_S_2_RANGE__0___1_CM 1 100. 0. 1. DISPLAY_IDENTIFIER LV_EGY_ADD_AD_LIM[3] ECU_ADDRESS 0xd000765f /end MEASUREMENT
/begin MEASUREMENT lv_egy_add_ad_lim[4] "Adaptive piezo energy correction is at limit, cylinder individual" UBYTE _CNV_S_2_RANGE__0___1_CM 1 100. 0. 1. DISPLAY_IDENTIFIER LV_EGY_ADD_AD_LIM[4] ECU_ADDRESS 0xd0007660 /end MEASUREMENT
/begin MEASUREMENT lv_egy_add_ad_lim[5] "Adaptive piezo energy correction is at limit, cylinder individual" UBYTE _CNV_S_2_RANGE__0___1_CM 1 100. 0. 1. DISPLAY_IDENTIFIER LV_EGY_ADD_AD_LIM[5] ECU_ADDRESS 0xd0007661 /end MEASUREMENT
/begin MEASUREMENT lv_egy_add_ad_lim[6] "Adaptive piezo energy correction is at limit, cylinder individual" UBYTE _CNV_S_2_RANGE__0___1_CM 1 100. 0. 1. DISPLAY_IDENTIFIER LV_EGY_ADD_AD_LIM[6] ECU_ADDRESS 0xd0007662 /end MEASUREMENT
/begin MEASUREMENT lv_egy_add_ad_lim[7] "Adaptive piezo energy correction is at limit, cylinder individual" UBYTE _CNV_S_2_RANGE__0___1_CM 1 100. 0. 1. DISPLAY_IDENTIFIER LV_EGY_ADD_AD_LIM[7] ECU_ADDRESS 0xd0007663 /end MEASUREMENT
/begin MEASUREMENT lv_egy_add_ad_lim_tol[0] "Adaptive piezo energy correction is at top limit, cylinder individual" UBYTE _CNV_S_2_RANGE__0___1_CM 1 100. 0. 1. DISPLAY_IDENTIFIER LV_EGY_ADD_AD_LIM_TOL[0] ECU_ADDRESS 0xd0007664 /end MEASUREMENT
/begin MEASUREMENT lv_egy_add_ad_lim_tol[1] "Adaptive piezo energy correction is at top limit, cylinder individual" UBYTE _CNV_S_2_RANGE__0___1_CM 1 100. 0. 1. DISPLAY_IDENTIFIER LV_EGY_ADD_AD_LIM_TOL[1] ECU_ADDRESS 0xd0007665 /end MEASUREMENT
/begin MEASUREMENT lv_egy_add_ad_lim_tol[2] "Adaptive piezo energy correction is at top limit, cylinder individual" UBYTE _CNV_S_2_RANGE__0___1_CM 1 100. 0. 1. DISPLAY_IDENTIFIER LV_EGY_ADD_AD_LIM_TOL[2] ECU_ADDRESS 0xd0007666 /end MEASUREMENT
/begin MEASUREMENT lv_egy_add_ad_lim_tol[3] "Adaptive piezo energy correction is at top limit, cylinder individual" UBYTE _CNV_S_2_RANGE__0___1_CM 1 100. 0. 1. DISPLAY_IDENTIFIER LV_EGY_ADD_AD_LIM_TOL[3] ECU_ADDRESS 0xd0007667 /end MEASUREMENT
/begin MEASUREMENT lv_egy_add_ad_lim_tol[4] "Adaptive piezo energy correction is at top limit, cylinder individual" UBYTE _CNV_S_2_RANGE__0___1_CM 1 100. 0. 1. DISPLAY_IDENTIFIER LV_EGY_ADD_AD_LIM_TOL[4] ECU_ADDRESS 0xd0007668 /end MEASUREMENT
/begin MEASUREMENT lv_egy_add_ad_lim_tol[5] "Adaptive piezo energy correction is at top limit, cylinder individual" UBYTE _CNV_S_2_RANGE__0___1_CM 1 100. 0. 1. DISPLAY_IDENTIFIER LV_EGY_ADD_AD_LIM_TOL[5] ECU_ADDRESS 0xd0007669 /end MEASUREMENT
/begin MEASUREMENT lv_egy_add_ad_lim_tol[6] "Adaptive piezo energy correction is at top limit, cylinder individual" UBYTE _CNV_S_2_RANGE__0___1_CM 1 100. 0. 1. DISPLAY_IDENTIFIER LV_EGY_ADD_AD_LIM_TOL[6] ECU_ADDRESS 0xd000766a /end MEASUREMENT
/begin MEASUREMENT lv_egy_add_ad_lim_tol[7] "Adaptive piezo energy correction is at top limit, cylinder individual" UBYTE _CNV_S_2_RANGE__0___1_CM 1 100. 0. 1. DISPLAY_IDENTIFIER LV_EGY_ADD_AD_LIM_TOL[7] ECU_ADDRESS 0xd000766b /end MEASUREMENT
/begin CHARACTERISTIC c_egy_step_inj_cha_grd_max_hom "Upper threshold of energy charge gradient for a single step - homogenous operation" VALUE 0xa080653c _REC_VAL_20_u2 100. _CNV_A_R_INJR_LINEA_460_CM 0. 100. DISPLAY_IDENTIFIER C_EGY_STEP_INJ_CHA_GRD_MAX_HOM FORMAT "%7.3" /end CHARACTERISTIC
/begin MEASUREMENT t_cha_per_post "Piezo IV charge period for post injection pulse" UBYTE _CNV_A_R_INJR_LINEA_466_CM 1 100. 0. 0.3 DISPLAY_IDENTIFIER T_CHA_PER_POST ECU_ADDRESS 0xd0007653 FORMAT "%4.2" /end MEASUREMENT
/begin MEASUREMENT ti_thd_iv_egy_rng "Injection time threshold for the selection of the injector energy range" UWORD _CNV_A_R_LINEAR_____228_CM 1 100. 0. 65.535 DISPLAY_IDENTIFIER TI_THD_IV_EGY_RNG ECU_ADDRESS 0xd0003354 /end MEASUREMENT
/begin AXIS_PTS ldp_fup_fac_ti_cor_iv_rgy_rng_l "Multiplicative injection time correction factor for corrections in case of injector low lift depending on FUP" 0xa08060b0 fup_h_mv _REC_AXS_20_u2 347776. _CNV_A_R_LINEAR_____171_CM 12 0. 347776. FORMAT "%8.1" /end AXIS_PTS
/begin AXIS_PTS ldp_n_32_ti_thd_iv_egy_rng "" 0xa0806148 n_32 _REC_AXS_20_u1 8160. _CNV_A_R_LINEAR_____10_CM 7 0. 8160. FORMAT "%4.0" /end AXIS_PTS
/begin CHARACTERISTIC ip_fac_ti_cor_iv_egy_rng_l "Multiplicative injection time correction factor for corrections in case of injector low lift depending on FUP" CURVE 0xa0806408 _REC_CUR_20_u2_u2 1.99996948242188 _CNV_A_R_LINEAR_____9_CM 0. 1.99996948242188 DISPLAY_IDENTIFIER IP_FAC_TI_COR_IV_EGY_RNG_L FORMAT "%7.5"
 /begin AXIS_DESCR COM_AXIS fup_h_mv _CNV_A_R_LINEAR_____171_CM 12 0. 347776. FORMAT "%8.1" AXIS_PTS_REF ldp_fup_fac_ti_cor_iv_rgy_rng_l /end AXIS_DESCR
/end CHARACTERISTIC
/begin CHARACTERISTIC id_ti_thd_iv_egy_rng "Injection time threshold for the selection of the injector energy range depending on engine speed" CURVE 0xa0806304 _REC_CUR_20_u2_u1 65.535 _CNV_A_R_LINEAR_____228_CM 0. 65.535 DISPLAY_IDENTIFIER ID_TI_THD_IV_EGY_RNG
 /begin AXIS_DESCR COM_AXIS n_32 _CNV_A_R_LINEAR_____10_CM 7 0. 8160. FORMAT "%4.0" AXIS_PTS_REF ldp_n_32_ti_thd_iv_egy_rng /end AXIS_DESCR
/end CHARACTERISTIC
/begin CHARACTERISTIC ip_egy_step_inj_cha_grd[0] "Piezo injector energy charge and discharge gradient for a single step" CURVE 0xa0811574 _REC_CUR_20_u2_u1 100. _CNV_A_R_INJR_LINEA_460_CM 0. 100. DISPLAY_IDENTIFIER IP_EGY_STEP_INJ_CHA_GRD[0] FORMAT "%7.3"
 /begin AXIS_DESCR COM_AXIS tfu_inj _CNV_A_R_LINEAR_____17_CM 6 -48. 142.5 FORMAT "%6.2" AXIS_PTS_REF ldp_tfu_ip_egy_step_inj_cha_grd /end AXIS_DESCR
/end CHARACTERISTIC
/begin CHARACTERISTIC ip_egy_step_inj_cha_grd[1] "Piezo injector energy charge and discharge gradient for a single step" CURVE 0xa0811580 _REC_CUR_20_u2_u1 100. _CNV_A_R_INJR_LINEA_460_CM 0. 100. DISPLAY_IDENTIFIER IP_EGY_STEP_INJ_CHA_GRD[1] FORMAT "%7.3"
 /begin AXIS_DESCR COM_AXIS tfu_inj _CNV_A_R_LINEAR_____17_CM 6 -48. 142.5 FORMAT "%6.2" AXIS_PTS_REF ldp_tfu_ip_egy_step_inj_cha_grd /end AXIS_DESCR
/end CHARACTERISTIC
/begin CHARACTERISTIC ip_egy_step_inj_cha_grd[2] "Piezo injector energy charge and discharge gradient for a single step" CURVE 0xa081158c _REC_CUR_20_u2_u1 100. _CNV_A_R_INJR_LINEA_460_CM 0. 100. DISPLAY_IDENTIFIER IP_EGY_STEP_INJ_CHA_GRD[2] FORMAT "%7.3"
 /begin AXIS_DESCR COM_AXIS tfu_inj _CNV_A_R_LINEAR_____17_CM 6 -48. 142.5 FORMAT "%6.2" AXIS_PTS_REF ldp_tfu_ip_egy_step_inj_cha_grd /end AXIS_DESCR
/end CHARACTERISTIC
/begin CHARACTERISTIC ip_egy_step_inj_cha_grd[3] "Piezo injector energy charge and discharge gradient for a single step" CURVE 0xa0811598 _REC_CUR_20_u2_u1 100. _CNV_A_R_INJR_LINEA_460_CM 0. 100. DISPLAY_IDENTIFIER IP_EGY_STEP_INJ_CHA_GRD[3] FORMAT "%7.3"
 /begin AXIS_DESCR COM_AXIS tfu_inj _CNV_A_R_LINEAR_____17_CM 6 -48. 142.5 FORMAT "%6.2" AXIS_PTS_REF ldp_tfu_ip_egy_step_inj_cha_grd /end AXIS_DESCR
/end CHARACTERISTIC
/begin CHARACTERISTIC ip_egy_step_inj_cha_grd[4] "Piezo injector energy charge and discharge gradient for a single step" CURVE 0xa08115a4 _REC_CUR_20_u2_u1 100. _CNV_A_R_INJR_LINEA_460_CM 0. 100. DISPLAY_IDENTIFIER IP_EGY_STEP_INJ_CHA_GRD[4] FORMAT "%7.3"
 /begin AXIS_DESCR COM_AXIS tfu_inj _CNV_A_R_LINEAR_____17_CM 6 -48. 142.5 FORMAT "%6.2" AXIS_PTS_REF ldp_tfu_ip_egy_step_inj_cha_grd /end AXIS_DESCR
/end CHARACTERISTIC
/begin CHARACTERISTIC ip_egy_step_inj_cha_grd[5] "Piezo injector energy charge and discharge gradient for a single step" CURVE 0xa08115b0 _REC_CUR_20_u2_u1 100. _CNV_A_R_INJR_LINEA_460_CM 0. 100. DISPLAY_IDENTIFIER IP_EGY_STEP_INJ_CHA_GRD[5] FORMAT "%7.3"
 /begin AXIS_DESCR COM_AXIS tfu_inj _CNV_A_R_LINEAR_____17_CM 6 -48. 142.5 FORMAT "%6.2" AXIS_PTS_REF ldp_tfu_ip_egy_step_inj_cha_grd /end AXIS_DESCR
/end CHARACTERISTIC
/begin CHARACTERISTIC ip_egy_step_inj_cha_grd[6] "Piezo injector energy charge and discharge gradient for a single step" CURVE 0xa08115bc _REC_CUR_20_u2_u1 100. _CNV_A_R_INJR_LINEA_460_CM 0. 100. DISPLAY_IDENTIFIER IP_EGY_STEP_INJ_CHA_GRD[6] FORMAT "%7.3"
 /begin AXIS_DESCR COM_AXIS tfu_inj _CNV_A_R_LINEAR_____17_CM 6 -48. 142.5 FORMAT "%6.2" AXIS_PTS_REF ldp_tfu_ip_egy_step_inj_cha_grd /end AXIS_DESCR
/end CHARACTERISTIC
/begin CHARACTERISTIC ip_egy_step_inj_cha_grd[7] "Piezo injector energy charge and discharge gradient for a single step" CURVE 0xa08115c8 _REC_CUR_20_u2_u1 100. _CNV_A_R_INJR_LINEA_460_CM 0. 100. DISPLAY_IDENTIFIER IP_EGY_STEP_INJ_CHA_GRD[7] FORMAT "%7.3"
 /begin AXIS_DESCR COM_AXIS tfu_inj _CNV_A_R_LINEAR_____17_CM 6 -48. 142.5 FORMAT "%6.2" AXIS_PTS_REF ldp_tfu_ip_egy_step_inj_cha_grd /end AXIS_DESCR
/end CHARACTERISTIC
/begin MEASUREMENT min_inj_egy_level "Minimum correction value of injector energy level (calibrateable)" SWORD _CNV_A_R_INJR_LINEA_460_CM 1 100. -50. 50. DISPLAY_IDENTIFIER MIN_INJ_EGY_LEVEL ECU_ADDRESS 0xd0007044 /end MEASUREMENT
/begin CHARACTERISTIC c_max_inj_egy_level_cor "Maximum correction value of injector energy level" VALUE 0xa080656e _REC_VAL_20_s2 100. _CNV_A_R_INJR_LINEA_460_CM -50. 50. DISPLAY_IDENTIFIER C_MAX_INJ_EGY_LEVEL_COR /end CHARACTERISTIC
/begin CHARACTERISTIC c_min_inj_egy_level_cor "Minimum correction value of injector energy level" VALUE 0xa0806572 _REC_VAL_20_s2 100. _CNV_A_R_INJR_LINEA_460_CM -50. 50. DISPLAY_IDENTIFIER C_MIN_INJ_EGY_LEVEL_COR /end CHARACTERISTIC
/begin MEASUREMENT egy_step_inj_dcha_grd[0] "Piezo injector energy discharge gradient for a single step" UWORD _CNV_A_R_INJR_LINEA_460_CM 1 100. 0. 100. DISPLAY_IDENTIFIER EGY_STEP_INJ_DCHA_GRD[0] ECU_ADDRESS 0xd0006fa4 FORMAT "%7.3" /end MEASUREMENT
/begin MEASUREMENT egy_step_inj_dcha_grd[1] "Piezo injector energy discharge gradient for a single step" UWORD _CNV_A_R_INJR_LINEA_460_CM 1 100. 0. 100. DISPLAY_IDENTIFIER EGY_STEP_INJ_DCHA_GRD[1] ECU_ADDRESS 0xd0006fa6 FORMAT "%7.3" /end MEASUREMENT
/begin MEASUREMENT egy_step_inj_dcha_grd[2] "Piezo injector energy discharge gradient for a single step" UWORD _CNV_A_R_INJR_LINEA_460_CM 1 100. 0. 100. DISPLAY_IDENTIFIER EGY_STEP_INJ_DCHA_GRD[2] ECU_ADDRESS 0xd0006fa8 FORMAT "%7.3" /end MEASUREMENT
/begin MEASUREMENT egy_step_inj_dcha_grd[3] "Piezo injector energy discharge gradient for a single step" UWORD _CNV_A_R_INJR_LINEA_460_CM 1 100. 0. 100. DISPLAY_IDENTIFIER EGY_STEP_INJ_DCHA_GRD[3] ECU_ADDRESS 0xd0006faa FORMAT "%7.3" /end MEASUREMENT
/begin MEASUREMENT egy_step_inj_dcha_grd[4] "Piezo injector energy discharge gradient for a single step" UWORD _CNV_A_R_INJR_LINEA_460_CM 1 100. 0. 100. DISPLAY_IDENTIFIER EGY_STEP_INJ_DCHA_GRD[4] ECU_ADDRESS 0xd0006fac FORMAT "%7.3" /end MEASUREMENT
/begin MEASUREMENT egy_step_inj_dcha_grd[5] "Piezo injector energy discharge gradient for a single step" UWORD _CNV_A_R_INJR_LINEA_460_CM 1 100. 0. 100. DISPLAY_IDENTIFIER EGY_STEP_INJ_DCHA_GRD[5] ECU_ADDRESS 0xd0006fae FORMAT "%7.3" /end MEASUREMENT
/begin MEASUREMENT egy_step_inj_dcha_grd[6] "Piezo injector energy discharge gradient for a single step" UWORD _CNV_A_R_INJR_LINEA_460_CM 1 100. 0. 100. DISPLAY_IDENTIFIER EGY_STEP_INJ_DCHA_GRD[6] ECU_ADDRESS 0xd0006fb0 FORMAT "%7.3" /end MEASUREMENT
/begin MEASUREMENT egy_step_inj_dcha_grd[7] "Piezo injector energy discharge gradient for a single step" UWORD _CNV_A_R_INJR_LINEA_460_CM 1 100. 0. 100. DISPLAY_IDENTIFIER EGY_STEP_INJ_DCHA_GRD[7] ECU_ADDRESS 0xd0006fb2 FORMAT "%7.3" /end MEASUREMENT
/begin MEASUREMENT egy_step_inj_cha_lim_dif[0] "Difference of piezo stack energy, which is over the voltage limit" UWORD _CNV_A_R_INJR_LINEA_460_CM 1 100. 0. 100. DISPLAY_IDENTIFIER EGY_STEP_INJ_CHA_LIM_DIF[0] ECU_ADDRESS 0xd0006f94 FORMAT "%7.3" /end MEASUREMENT
/begin MEASUREMENT egy_step_inj_cha_lim_dif[1] "Difference of piezo stack energy, which is over the voltage limit" UWORD _CNV_A_R_INJR_LINEA_460_CM 1 100. 0. 100. DISPLAY_IDENTIFIER EGY_STEP_INJ_CHA_LIM_DIF[1] ECU_ADDRESS 0xd0006f96 FORMAT "%7.3" /end MEASUREMENT
/begin MEASUREMENT egy_step_inj_cha_lim_dif[2] "Difference of piezo stack energy, which is over the voltage limit" UWORD _CNV_A_R_INJR_LINEA_460_CM 1 100. 0. 100. DISPLAY_IDENTIFIER EGY_STEP_INJ_CHA_LIM_DIF[2] ECU_ADDRESS 0xd0006f98 FORMAT "%7.3" /end MEASUREMENT
/begin MEASUREMENT egy_step_inj_cha_lim_dif[3] "Difference of piezo stack energy, which is over the voltage limit" UWORD _CNV_A_R_INJR_LINEA_460_CM 1 100. 0. 100. DISPLAY_IDENTIFIER EGY_STEP_INJ_CHA_LIM_DIF[3] ECU_ADDRESS 0xd0006f9a FORMAT "%7.3" /end MEASUREMENT
/begin MEASUREMENT egy_step_inj_cha_lim_dif[4] "Difference of piezo stack energy, which is over the voltage limit" UWORD _CNV_A_R_INJR_LINEA_460_CM 1 100. 0. 100. DISPLAY_IDENTIFIER EGY_STEP_INJ_CHA_LIM_DIF[4] ECU_ADDRESS 0xd0006f9c FORMAT "%7.3" /end MEASUREMENT
/begin MEASUREMENT egy_step_inj_cha_lim_dif[5] "Difference of piezo stack energy, which is over the voltage limit" UWORD _CNV_A_R_INJR_LINEA_460_CM 1 100. 0. 100. DISPLAY_IDENTIFIER EGY_STEP_INJ_CHA_LIM_DIF[5] ECU_ADDRESS 0xd0006f9e FORMAT "%7.3" /end MEASUREMENT
/begin MEASUREMENT egy_step_inj_cha_lim_dif[6] "Difference of piezo stack energy, which is over the voltage limit" UWORD _CNV_A_R_INJR_LINEA_460_CM 1 100. 0. 100. DISPLAY_IDENTIFIER EGY_STEP_INJ_CHA_LIM_DIF[6] ECU_ADDRESS 0xd0006fa0 FORMAT "%7.3" /end MEASUREMENT
/begin MEASUREMENT egy_step_inj_cha_lim_dif[7] "Difference of piezo stack energy, which is over the voltage limit" UWORD _CNV_A_R_INJR_LINEA_460_CM 1 100. 0. 100. DISPLAY_IDENTIFIER EGY_STEP_INJ_CHA_LIM_DIF[7] ECU_ADDRESS 0xd0006fa2 FORMAT "%7.3" /end MEASUREMENT
/begin MEASUREMENT nr_egy_step_inj_l "Number of charge steps for low piezo energy range" UBYTE _CNV_A_R_LINEAR_____0_CM 1 100. 0. 31. DISPLAY_IDENTIFIER NR_EGY_STEP_INJ_L ECU_ADDRESS 0xd0007638 FORMAT "%2.0" /end MEASUREMENT
/begin MEASUREMENT nr_egy_step_inj_h "Number of charge steps for high piezo energy range" UBYTE _CNV_A_R_LINEAR_____0_CM 1 100. 0. 31. DISPLAY_IDENTIFIER NR_EGY_STEP_INJ_H ECU_ADDRESS 0xd0007637 FORMAT "%2.0" /end MEASUREMENT
/begin MEASUREMENT lv_egy_step_inj_cha_lim[0] "Piezo stack energy is out of limit (over-voltage protection)" UBYTE _CNV_S_2_RANGE__0___1_CM 1 100. 0. 1. DISPLAY_IDENTIFIER LV_EGY_STEP_INJ_CHA_LIM[0] ECU_ADDRESS 0xd000766c BIT_MASK 0x1 /end MEASUREMENT
/begin MEASUREMENT lv_egy_step_inj_cha_lim[1] "Piezo stack energy is out of limit (over-voltage protection)" UBYTE _CNV_S_2_RANGE__0___1_CM 1 100. 0. 1. DISPLAY_IDENTIFIER LV_EGY_STEP_INJ_CHA_LIM[1] ECU_ADDRESS 0xd000766d BIT_MASK 0x1 /end MEASUREMENT
/begin MEASUREMENT lv_egy_step_inj_cha_lim[2] "Piezo stack energy is out of limit (over-voltage protection)" UBYTE _CNV_S_2_RANGE__0___1_CM 1 100. 0. 1. DISPLAY_IDENTIFIER LV_EGY_STEP_INJ_CHA_LIM[2] ECU_ADDRESS 0xd000766e BIT_MASK 0x1 /end MEASUREMENT
/begin MEASUREMENT lv_egy_step_inj_cha_lim[3] "Piezo stack energy is out of limit (over-voltage protection)" UBYTE _CNV_S_2_RANGE__0___1_CM 1 100. 0. 1. DISPLAY_IDENTIFIER LV_EGY_STEP_INJ_CHA_LIM[3] ECU_ADDRESS 0xd000766f BIT_MASK 0x1 /end MEASUREMENT
/begin MEASUREMENT lv_egy_step_inj_cha_lim[4] "Piezo stack energy is out of limit (over-voltage protection)" UBYTE _CNV_S_2_RANGE__0___1_CM 1 100. 0. 1. DISPLAY_IDENTIFIER LV_EGY_STEP_INJ_CHA_LIM[4] ECU_ADDRESS 0xd0007670 BIT_MASK 0x1 /end MEASUREMENT
/begin MEASUREMENT lv_egy_step_inj_cha_lim[5] "Piezo stack energy is out of limit (over-voltage protection)" UBYTE _CNV_S_2_RANGE__0___1_CM 1 100. 0. 1. DISPLAY_IDENTIFIER LV_EGY_STEP_INJ_CHA_LIM[5] ECU_ADDRESS 0xd0007671 BIT_MASK 0x1 /end MEASUREMENT
/begin MEASUREMENT lv_egy_step_inj_cha_lim[6] "Piezo stack energy is out of limit (over-voltage protection)" UBYTE _CNV_S_2_RANGE__0___1_CM 1 100. 0. 1. DISPLAY_IDENTIFIER LV_EGY_STEP_INJ_CHA_LIM[6] ECU_ADDRESS 0xd0007672 BIT_MASK 0x1 /end MEASUREMENT
/begin MEASUREMENT lv_egy_step_inj_cha_lim[7] "Piezo stack energy is out of limit (over-voltage protection)" UBYTE _CNV_S_2_RANGE__0___1_CM 1 100. 0. 1. DISPLAY_IDENTIFIER LV_EGY_STEP_INJ_CHA_LIM[7] ECU_ADDRESS 0xd0007673 BIT_MASK 0x1 /end MEASUREMENT
/begin MEASUREMENT max_inj_egy_level "Maximum correction value of injector energy level (calibrateable)" SWORD _CNV_A_R_INJR_LINEA_460_CM 1 100. -50. 50. DISPLAY_IDENTIFIER MAX_INJ_EGY_LEVEL ECU_ADDRESS 0xd0007030 /end MEASUREMENT
/begin MEASUREMENT fac_egy_pwm_ad[0] "Conversion factor: EGY to % PWM for piezo injector" UWORD _CNV_A_R_INJR_LINEA_527_CM 1 100. 0. 1.99996948242188 DISPLAY_IDENTIFIER FAC_EGY_PWM_AD[0] ECU_ADDRESS 0xd000700c FORMAT "%7.5" /end MEASUREMENT
/begin MEASUREMENT fac_egy_pwm_ad[1] "Conversion factor: EGY to % PWM for piezo injector" UWORD _CNV_A_R_INJR_LINEA_527_CM 1 100. 0. 1.99996948242188 DISPLAY_IDENTIFIER FAC_EGY_PWM_AD[1] ECU_ADDRESS 0xd000700e FORMAT "%7.5" /end MEASUREMENT
/begin MEASUREMENT fac_egy_pwm_ad[2] "Conversion factor: EGY to % PWM for piezo injector" UWORD _CNV_A_R_INJR_LINEA_527_CM 1 100. 0. 1.99996948242188 DISPLAY_IDENTIFIER FAC_EGY_PWM_AD[2] ECU_ADDRESS 0xd0007010 FORMAT "%7.5" /end MEASUREMENT
/begin MEASUREMENT fac_egy_pwm_ad[3] "Conversion factor: EGY to % PWM for piezo injector" UWORD _CNV_A_R_INJR_LINEA_527_CM 1 100. 0. 1.99996948242188 DISPLAY_IDENTIFIER FAC_EGY_PWM_AD[3] ECU_ADDRESS 0xd0007012 FORMAT "%7.5" /end MEASUREMENT
/begin MEASUREMENT fac_egy_pwm_ad[4] "Conversion factor: EGY to % PWM for piezo injector" UWORD _CNV_A_R_INJR_LINEA_527_CM 1 100. 0. 1.99996948242188 DISPLAY_IDENTIFIER FAC_EGY_PWM_AD[4] ECU_ADDRESS 0xd0007014 FORMAT "%7.5" /end MEASUREMENT
/begin MEASUREMENT fac_egy_pwm_ad[5] "Conversion factor: EGY to % PWM for piezo injector" UWORD _CNV_A_R_INJR_LINEA_527_CM 1 100. 0. 1.99996948242188 DISPLAY_IDENTIFIER FAC_EGY_PWM_AD[5] ECU_ADDRESS 0xd0007016 FORMAT "%7.5" /end MEASUREMENT
/begin MEASUREMENT fac_egy_pwm_ad[6] "Conversion factor: EGY to % PWM for piezo injector" UWORD _CNV_A_R_INJR_LINEA_527_CM 1 100. 0. 1.99996948242188 DISPLAY_IDENTIFIER FAC_EGY_PWM_AD[6] ECU_ADDRESS 0xd0007018 FORMAT "%7.5" /end MEASUREMENT
/begin MEASUREMENT fac_egy_pwm_ad[7] "Conversion factor: EGY to % PWM for piezo injector" UWORD _CNV_A_R_INJR_LINEA_527_CM 1 100. 0. 1.99996948242188 DISPLAY_IDENTIFIER FAC_EGY_PWM_AD[7] ECU_ADDRESS 0xd000701a FORMAT "%7.5" /end MEASUREMENT
/begin MEASUREMENT egy_step_inj_cha_grd[0] "Piezo injector energy charge gradient for a single step" UWORD _CNV_A_R_INJR_LINEA_460_CM 1 100. 0. 100. DISPLAY_IDENTIFIER EGY_STEP_INJ_CHA_GRD[0] ECU_ADDRESS 0xd0006f74 FORMAT "%7.3" /end MEASUREMENT
/begin MEASUREMENT egy_step_inj_cha_grd[1] "Piezo injector energy charge gradient for a single step" UWORD _CNV_A_R_INJR_LINEA_460_CM 1 100. 0. 100. DISPLAY_IDENTIFIER EGY_STEP_INJ_CHA_GRD[1] ECU_ADDRESS 0xd0006f76 FORMAT "%7.3" /end MEASUREMENT
/begin MEASUREMENT egy_step_inj_cha_grd[2] "Piezo injector energy charge gradient for a single step" UWORD _CNV_A_R_INJR_LINEA_460_CM 1 100. 0. 100. DISPLAY_IDENTIFIER EGY_STEP_INJ_CHA_GRD[2] ECU_ADDRESS 0xd0006f78 FORMAT "%7.3" /end MEASUREMENT
/begin MEASUREMENT egy_step_inj_cha_grd[3] "Piezo injector energy charge gradient for a single step" UWORD _CNV_A_R_INJR_LINEA_460_CM 1 100. 0. 100. DISPLAY_IDENTIFIER EGY_STEP_INJ_CHA_GRD[3] ECU_ADDRESS 0xd0006f7a FORMAT "%7.3" /end MEASUREMENT
/begin MEASUREMENT egy_step_inj_cha_grd[4] "Piezo injector energy charge gradient for a single step" UWORD _CNV_A_R_INJR_LINEA_460_CM 1 100. 0. 100. DISPLAY_IDENTIFIER EGY_STEP_INJ_CHA_GRD[4] ECU_ADDRESS 0xd0006f7c FORMAT "%7.3" /end MEASUREMENT
/begin MEASUREMENT egy_step_inj_cha_grd[5] "Piezo injector energy charge gradient for a single step" UWORD _CNV_A_R_INJR_LINEA_460_CM 1 100. 0. 100. DISPLAY_IDENTIFIER EGY_STEP_INJ_CHA_GRD[5] ECU_ADDRESS 0xd0006f7e FORMAT "%7.3" /end MEASUREMENT
/begin MEASUREMENT egy_step_inj_cha_grd[6] "Piezo injector energy charge gradient for a single step" UWORD _CNV_A_R_INJR_LINEA_460_CM 1 100. 0. 100. DISPLAY_IDENTIFIER EGY_STEP_INJ_CHA_GRD[6] ECU_ADDRESS 0xd0006f80 FORMAT "%7.3" /end MEASUREMENT
/begin MEASUREMENT egy_step_inj_cha_grd[7] "Piezo injector energy charge gradient for a single step" UWORD _CNV_A_R_INJR_LINEA_460_CM 1 100. 0. 100. DISPLAY_IDENTIFIER EGY_STEP_INJ_CHA_GRD[7] ECU_ADDRESS 0xd0006f82 FORMAT "%7.3" /end MEASUREMENT
/begin CHARACTERISTIC c_nr_egy_step_inj_l "Number of charge steps for a low piezo energy range" VALUE 0xa0806577 _REC_VAL_20_u1 29. _CNV_A_R_LINEAR_____0_CM 2. 31. DISPLAY_IDENTIFIER C_NR_EGY_STEP_INJ_L FORMAT "%2.0" /end CHARACTERISTIC
/begin AXIS_PTS ldp_tfu_ip_egy_step_inj_cha_grd "Piezo injector energy charge and discharge gradient for a single step" 0xa08061f8 tfu_inj _REC_AXS_20_u1 190.5 _CNV_A_R_LINEAR_____17_CM 6 -48. 142.5 FORMAT "%6.2" /end AXIS_PTS
/begin CHARACTERISTIC c_fac_cor_egy_step_inj_dcha_grd "Multiplicative correction factor for cylinder balancing influence on discharge gradient calculation" VALUE 0xa0806554 _REC_VAL_20_u2 1.99996948242188 _CNV_A_R_LINEAR_____9_CM 0. 1.99996948242188 DISPLAY_IDENTIFIER C_FAC_COR_EGY_STEP_INJ_DCHA_GRD FORMAT "%7.5" /end CHARACTERISTIC
/begin CHARACTERISTIC c_egy_ctl_i_gain "Integral gain for piezo energy controller." VALUE 0xa0806524 _REC_VAL_20_u2 1.99996948242188 _CNV_A_R_INJR_LINEA_527_CM 0. 1.99996948242188 DISPLAY_IDENTIFIER C_EGY_CTL_I_GAIN FORMAT "%7.5" /end CHARACTERISTIC
/begin CHARACTERISTIC c_egy_ctl_p_gain "Proportional gain for energy controller." VALUE 0xa0806526 _REC_VAL_20_u2 1.99996948242188 _CNV_A_R_INJR_LINEA_527_CM 0. 1.99996948242188 DISPLAY_IDENTIFIER C_EGY_CTL_P_GAIN FORMAT "%7.5" /end CHARACTERISTIC
/begin CHARACTERISTIC lc_egy_step_ctl_dyn_ena "Enable complete piezo energy controller" VALUE 0xa08065dc _REC_VAL_20_u1 1. _CNV_A_R_LINEAR_____0_CM 0. 1. DISPLAY_IDENTIFIER LC_EGY_STEP_CTL_DYN_ENA FORMAT "%1.0" /end CHARACTERISTIC
/begin CHARACTERISTIC lc_ena_adap_egy_ctl "Enable new adaptation of piezo energy controller values after engine start" VALUE 0xa08065dd _REC_VAL_20_u1 1. _CNV_A_R_LINEAR_____0_CM 0. 1. DISPLAY_IDENTIFIER LC_ENA_ADAP_EGY_CTL FORMAT "%1.0" /end CHARACTERISTIC
/begin CHARACTERISTIC c_ti_egy_ctl_clc_min "Minimum injection time limit for calculation of energy control" VALUE 0xa08065ce _REC_VAL_20_u2 65.535 _CNV_A_R_LINEAR_____228_CM 0. 65.535 DISPLAY_IDENTIFIER C_TI_EGY_CTL_CLC_MIN /end CHARACTERISTIC
/begin CHARACTERISTIC c_pwm_lim_v_max_i_gain "Integral gain for pwm limiting related to stack voltage" VALUE 0xa0806578 _REC_VAL_20_u2 1.99996948242188 _CNV_A_R_LINEAR_____9_CM 0. 1.99996948242188 DISPLAY_IDENTIFIER C_PWM_LIM_V_MAX_I_GAIN FORMAT "%7.5" /end CHARACTERISTIC
/begin AXIS_PTS ldp_tfu_inj_ip_v_iv_max "Maximum allowed voltage on piezo stack before limiting" 0xa08061f0 tfu_inj _REC_AXS_20_u1 190.5 _CNV_A_R_LINEAR_____17_CM 6 -48. 142.5 FORMAT "%6.2" /end AXIS_PTS
/begin CHARACTERISTIC ip_v_iv_max "Maximum allowed voltage on piezo stack before limiting" CURVE 0xa080650c _REC_CUR_20_u2_u1 639.98046875 _CNV_A_R_LINEAR_____207_CM 0. 639.98046875 DISPLAY_IDENTIFIER IP_V_IV_MAX FORMAT "%6.2"
 /begin AXIS_DESCR COM_AXIS tfu_inj _CNV_A_R_LINEAR_____17_CM 6 -48. 142.5 FORMAT "%6.2" AXIS_PTS_REF ldp_tfu_inj_ip_v_iv_max /end AXIS_DESCR
/end CHARACTERISTIC
/begin MEASUREMENT egy_sp[0] "Energy setpoint for piezo injector energy controller after voltage limiter." UWORD _CNV_A_R_INJR_LINEA_432_CM 1 100. 0. 255. DISPLAY_IDENTIFIER EGY_SP[0] ECU_ADDRESS 0xd00032ac FORMAT "%7.3" /end MEASUREMENT
/begin MEASUREMENT egy_sp[1] "Energy setpoint for piezo injector energy controller after voltage limiter." UWORD _CNV_A_R_INJR_LINEA_432_CM 1 100. 0. 255. DISPLAY_IDENTIFIER EGY_SP[1] ECU_ADDRESS 0xd00032ae FORMAT "%7.3" /end MEASUREMENT
/begin MEASUREMENT egy_sp[2] "Energy setpoint for piezo injector energy controller after voltage limiter." UWORD _CNV_A_R_INJR_LINEA_432_CM 1 100. 0. 255. DISPLAY_IDENTIFIER EGY_SP[2] ECU_ADDRESS 0xd00032b0 FORMAT "%7.3" /end MEASUREMENT
/begin MEASUREMENT egy_sp[3] "Energy setpoint for piezo injector energy controller after voltage limiter." UWORD _CNV_A_R_INJR_LINEA_432_CM 1 100. 0. 255. DISPLAY_IDENTIFIER EGY_SP[3] ECU_ADDRESS 0xd00032b2 FORMAT "%7.3" /end MEASUREMENT
/begin MEASUREMENT egy_sp[4] "Energy setpoint for piezo injector energy controller after voltage limiter." UWORD _CNV_A_R_INJR_LINEA_432_CM 1 100. 0. 255. DISPLAY_IDENTIFIER EGY_SP[4] ECU_ADDRESS 0xd00032b4 FORMAT "%7.3" /end MEASUREMENT
/begin MEASUREMENT egy_sp[5] "Energy setpoint for piezo injector energy controller after voltage limiter." UWORD _CNV_A_R_INJR_LINEA_432_CM 1 100. 0. 255. DISPLAY_IDENTIFIER EGY_SP[5] ECU_ADDRESS 0xd00032b6 FORMAT "%7.3" /end MEASUREMENT
/begin MEASUREMENT egy_sp[6] "Energy setpoint for piezo injector energy controller after voltage limiter." UWORD _CNV_A_R_INJR_LINEA_432_CM 1 100. 0. 255. DISPLAY_IDENTIFIER EGY_SP[6] ECU_ADDRESS 0xd00032b8 FORMAT "%7.3" /end MEASUREMENT
/begin MEASUREMENT egy_sp[7] "Energy setpoint for piezo injector energy controller after voltage limiter." UWORD _CNV_A_R_INJR_LINEA_432_CM 1 100. 0. 255. DISPLAY_IDENTIFIER EGY_SP[7] ECU_ADDRESS 0xd00032ba FORMAT "%7.3" /end MEASUREMENT
/begin MEASUREMENT egy_sp_not_lim[0] "Unlimited energy setpoint for piezo injector energy controller." UWORD _CNV_A_R_INJR_LINEA_432_CM 1 100. 0. 255. DISPLAY_IDENTIFIER EGY_SP_NOT_LIM[0] ECU_ADDRESS 0xd00032bc FORMAT "%7.3" /end MEASUREMENT
/begin MEASUREMENT egy_sp_not_lim[1] "Unlimited energy setpoint for piezo injector energy controller." UWORD _CNV_A_R_INJR_LINEA_432_CM 1 100. 0. 255. DISPLAY_IDENTIFIER EGY_SP_NOT_LIM[1] ECU_ADDRESS 0xd00032be FORMAT "%7.3" /end MEASUREMENT
/begin MEASUREMENT egy_sp_not_lim[2] "Unlimited energy setpoint for piezo injector energy controller." UWORD _CNV_A_R_INJR_LINEA_432_CM 1 100. 0. 255. DISPLAY_IDENTIFIER EGY_SP_NOT_LIM[2] ECU_ADDRESS 0xd00032c0 FORMAT "%7.3" /end MEASUREMENT
/begin MEASUREMENT egy_sp_not_lim[3] "Unlimited energy setpoint for piezo injector energy controller." UWORD _CNV_A_R_INJR_LINEA_432_CM 1 100. 0. 255. DISPLAY_IDENTIFIER EGY_SP_NOT_LIM[3] ECU_ADDRESS 0xd00032c2 FORMAT "%7.3" /end MEASUREMENT
/begin MEASUREMENT egy_sp_not_lim[4] "Unlimited energy setpoint for piezo injector energy controller." UWORD _CNV_A_R_INJR_LINEA_432_CM 1 100. 0. 255. DISPLAY_IDENTIFIER EGY_SP_NOT_LIM[4] ECU_ADDRESS 0xd00032c4 FORMAT "%7.3" /end MEASUREMENT
/begin MEASUREMENT egy_sp_not_lim[5] "Unlimited energy setpoint for piezo injector energy controller." UWORD _CNV_A_R_INJR_LINEA_432_CM 1 100. 0. 255. DISPLAY_IDENTIFIER EGY_SP_NOT_LIM[5] ECU_ADDRESS 0xd00032c6 FORMAT "%7.3" /end MEASUREMENT
/begin MEASUREMENT egy_sp_not_lim[6] "Unlimited energy setpoint for piezo injector energy controller." UWORD _CNV_A_R_INJR_LINEA_432_CM 1 100. 0. 255. DISPLAY_IDENTIFIER EGY_SP_NOT_LIM[6] ECU_ADDRESS 0xd00032c8 FORMAT "%7.3" /end MEASUREMENT
/begin MEASUREMENT egy_sp_not_lim[7] "Unlimited energy setpoint for piezo injector energy controller." UWORD _CNV_A_R_INJR_LINEA_432_CM 1 100. 0. 255. DISPLAY_IDENTIFIER EGY_SP_NOT_LIM[7] ECU_ADDRESS 0xd00032ca FORMAT "%7.3" /end MEASUREMENT
/begin MEASUREMENT egy_max_v_lim[0] "Maximum limit of energy after voltage limiter." UWORD _CNV_A_R_INJR_LINEA_432_CM 1 100. 0. 255. DISPLAY_IDENTIFIER EGY_MAX_V_LIM[0] ECU_ADDRESS 0xd000329c FORMAT "%7.3" /end MEASUREMENT
/begin MEASUREMENT egy_max_v_lim[1] "Maximum limit of energy after voltage limiter." UWORD _CNV_A_R_INJR_LINEA_432_CM 1 100. 0. 255. DISPLAY_IDENTIFIER EGY_MAX_V_LIM[1] ECU_ADDRESS 0xd000329e FORMAT "%7.3" /end MEASUREMENT
/begin MEASUREMENT egy_max_v_lim[2] "Maximum limit of energy after voltage limiter." UWORD _CNV_A_R_INJR_LINEA_432_CM 1 100. 0. 255. DISPLAY_IDENTIFIER EGY_MAX_V_LIM[2] ECU_ADDRESS 0xd00032a0 FORMAT "%7.3" /end MEASUREMENT
/begin MEASUREMENT egy_max_v_lim[3] "Maximum limit of energy after voltage limiter." UWORD _CNV_A_R_INJR_LINEA_432_CM 1 100. 0. 255. DISPLAY_IDENTIFIER EGY_MAX_V_LIM[3] ECU_ADDRESS 0xd00032a2 FORMAT "%7.3" /end MEASUREMENT
/begin MEASUREMENT egy_max_v_lim[4] "Maximum limit of energy after voltage limiter." UWORD _CNV_A_R_INJR_LINEA_432_CM 1 100. 0. 255. DISPLAY_IDENTIFIER EGY_MAX_V_LIM[4] ECU_ADDRESS 0xd00032a4 FORMAT "%7.3" /end MEASUREMENT
/begin MEASUREMENT egy_max_v_lim[5] "Maximum limit of energy after voltage limiter." UWORD _CNV_A_R_INJR_LINEA_432_CM 1 100. 0. 255. DISPLAY_IDENTIFIER EGY_MAX_V_LIM[5] ECU_ADDRESS 0xd00032a6 FORMAT "%7.3" /end MEASUREMENT
/begin MEASUREMENT egy_max_v_lim[6] "Maximum limit of energy after voltage limiter." UWORD _CNV_A_R_INJR_LINEA_432_CM 1 100. 0. 255. DISPLAY_IDENTIFIER EGY_MAX_V_LIM[6] ECU_ADDRESS 0xd00032a8 FORMAT "%7.3" /end MEASUREMENT
/begin MEASUREMENT egy_max_v_lim[7] "Maximum limit of energy after voltage limiter." UWORD _CNV_A_R_INJR_LINEA_432_CM 1 100. 0. 255. DISPLAY_IDENTIFIER EGY_MAX_V_LIM[7] ECU_ADDRESS 0xd00032aa FORMAT "%7.3" /end MEASUREMENT
/begin MEASUREMENT lv_egy_pwm_lim[0] "Piezo stack energy demand over 100% PWM." UBYTE _CNV_S_2_RANGE__0___1_CM 1 100. 0. 1. DISPLAY_IDENTIFIER LV_EGY_PWM_LIM[0] ECU_ADDRESS 0xd0003380 BIT_MASK 0x1 /end MEASUREMENT
/begin MEASUREMENT lv_egy_pwm_lim[1] "Piezo stack energy demand over 100% PWM." UBYTE _CNV_S_2_RANGE__0___1_CM 1 100. 0. 1. DISPLAY_IDENTIFIER LV_EGY_PWM_LIM[1] ECU_ADDRESS 0xd0003381 BIT_MASK 0x1 /end MEASUREMENT
/begin MEASUREMENT lv_egy_pwm_lim[2] "Piezo stack energy demand over 100% PWM." UBYTE _CNV_S_2_RANGE__0___1_CM 1 100. 0. 1. DISPLAY_IDENTIFIER LV_EGY_PWM_LIM[2] ECU_ADDRESS 0xd0003382 BIT_MASK 0x1 /end MEASUREMENT
/begin MEASUREMENT lv_egy_pwm_lim[3] "Piezo stack energy demand over 100% PWM." UBYTE _CNV_S_2_RANGE__0___1_CM 1 100. 0. 1. DISPLAY_IDENTIFIER LV_EGY_PWM_LIM[3] ECU_ADDRESS 0xd0003383 BIT_MASK 0x1 /end MEASUREMENT
/begin MEASUREMENT lv_egy_pwm_lim[4] "Piezo stack energy demand over 100% PWM." UBYTE _CNV_S_2_RANGE__0___1_CM 1 100. 0. 1. DISPLAY_IDENTIFIER LV_EGY_PWM_LIM[4] ECU_ADDRESS 0xd0003384 BIT_MASK 0x1 /end MEASUREMENT
/begin MEASUREMENT lv_egy_pwm_lim[5] "Piezo stack energy demand over 100% PWM." UBYTE _CNV_S_2_RANGE__0___1_CM 1 100. 0. 1. DISPLAY_IDENTIFIER LV_EGY_PWM_LIM[5] ECU_ADDRESS 0xd0003385 BIT_MASK 0x1 /end MEASUREMENT
/begin MEASUREMENT lv_egy_pwm_lim[6] "Piezo stack energy demand over 100% PWM." UBYTE _CNV_S_2_RANGE__0___1_CM 1 100. 0. 1. DISPLAY_IDENTIFIER LV_EGY_PWM_LIM[6] ECU_ADDRESS 0xd0003386 BIT_MASK 0x1 /end MEASUREMENT
/begin MEASUREMENT lv_egy_pwm_lim[7] "Piezo stack energy demand over 100% PWM." UBYTE _CNV_S_2_RANGE__0___1_CM 1 100. 0. 1. DISPLAY_IDENTIFIER LV_EGY_PWM_LIM[7] ECU_ADDRESS 0xd0003387 BIT_MASK 0x1 /end MEASUREMENT
/begin CHARACTERISTIC c_egy_bas_inj_sp_h "Energy base value for piezo injector at high needle lift." VALUE 0xa0806522 _REC_VAL_20_u2 255. _CNV_A_R_INJR_LINEA_432_CM 0. 255. DISPLAY_IDENTIFIER C_EGY_BAS_INJ_SP_H FORMAT "%7.3" /end CHARACTERISTIC
/begin CHARACTERISTIC c_egy_inj_max_lim "Maximum value for voltage dependent injector energy limiter." VALUE 0xa0806528 _REC_VAL_20_u2 255. _CNV_A_R_INJR_LINEA_432_CM 0. 255. DISPLAY_IDENTIFIER C_EGY_INJ_MAX_LIM FORMAT "%7.3" /end CHARACTERISTIC
/begin CHARACTERISTIC lc_egy_add_ad_lim_ena "Enable blocking of adaption if additive corrections (EGY_ADD_AD) are limited." VALUE 0xa08065d9 _REC_VAL_20_u1 1. _CNV_A_R_LINEAR_____0_CM 0. 1. DISPLAY_IDENTIFIER LC_EGY_ADD_AD_LIM_ENA FORMAT "%1.0" /end CHARACTERISTIC
/begin CHARACTERISTIC c_fac_lpf_egy_pwm_ad "Factor for PT1-filter for calculation of FAC_EGY_PWM_AD" VALUE 0xa0806569 _REC_VAL_20_u1 0.99609375 _CNV_A_R_LINEAR_____28_CM 0. 0.99609375 DISPLAY_IDENTIFIER C_FAC_LPF_EGY_PWM_AD FORMAT "%5.3" /end CHARACTERISTIC
/begin MEASUREMENT egy_step_inj_cha_grd_bas[0] "Piezo injector base energy charge gradient for a single step, without adaptation corrections." UWORD _CNV_A_R_INJR_LINEA_460_CM 1 100. 0. 100. DISPLAY_IDENTIFIER EGY_STEP_INJ_CHA_GRD_BAS[0] ECU_ADDRESS 0xd0006f84 FORMAT "%7.3" /end MEASUREMENT
/begin MEASUREMENT egy_step_inj_cha_grd_bas[1] "Piezo injector base energy charge gradient for a single step, without adaptation corrections." UWORD _CNV_A_R_INJR_LINEA_460_CM 1 100. 0. 100. DISPLAY_IDENTIFIER EGY_STEP_INJ_CHA_GRD_BAS[1] ECU_ADDRESS 0xd0006f86 FORMAT "%7.3" /end MEASUREMENT
/begin MEASUREMENT egy_step_inj_cha_grd_bas[2] "Piezo injector base energy charge gradient for a single step, without adaptation corrections." UWORD _CNV_A_R_INJR_LINEA_460_CM 1 100. 0. 100. DISPLAY_IDENTIFIER EGY_STEP_INJ_CHA_GRD_BAS[2] ECU_ADDRESS 0xd0006f88 FORMAT "%7.3" /end MEASUREMENT
/begin MEASUREMENT egy_step_inj_cha_grd_bas[3] "Piezo injector base energy charge gradient for a single step, without adaptation corrections." UWORD _CNV_A_R_INJR_LINEA_460_CM 1 100. 0. 100. DISPLAY_IDENTIFIER EGY_STEP_INJ_CHA_GRD_BAS[3] ECU_ADDRESS 0xd0006f8a FORMAT "%7.3" /end MEASUREMENT
/begin MEASUREMENT egy_step_inj_cha_grd_bas[4] "Piezo injector base energy charge gradient for a single step, without adaptation corrections." UWORD _CNV_A_R_INJR_LINEA_460_CM 1 100. 0. 100. DISPLAY_IDENTIFIER EGY_STEP_INJ_CHA_GRD_BAS[4] ECU_ADDRESS 0xd0006f8c FORMAT "%7.3" /end MEASUREMENT
/begin MEASUREMENT egy_step_inj_cha_grd_bas[5] "Piezo injector base energy charge gradient for a single step, without adaptation corrections." UWORD _CNV_A_R_INJR_LINEA_460_CM 1 100. 0. 100. DISPLAY_IDENTIFIER EGY_STEP_INJ_CHA_GRD_BAS[5] ECU_ADDRESS 0xd0006f8e FORMAT "%7.3" /end MEASUREMENT
/begin MEASUREMENT egy_step_inj_cha_grd_bas[6] "Piezo injector base energy charge gradient for a single step, without adaptation corrections." UWORD _CNV_A_R_INJR_LINEA_460_CM 1 100. 0. 100. DISPLAY_IDENTIFIER EGY_STEP_INJ_CHA_GRD_BAS[6] ECU_ADDRESS 0xd0006f90 FORMAT "%7.3" /end MEASUREMENT
/begin MEASUREMENT egy_step_inj_cha_grd_bas[7] "Piezo injector base energy charge gradient for a single step, without adaptation corrections." UWORD _CNV_A_R_INJR_LINEA_460_CM 1 100. 0. 100. DISPLAY_IDENTIFIER EGY_STEP_INJ_CHA_GRD_BAS[7] ECU_ADDRESS 0xd0006f92 FORMAT "%7.3" /end MEASUREMENT
/begin MEASUREMENT nr_egy_ctl_cyl_clc "Cylinder for that the injector needle lift control is calculated." UBYTE _CNV_A_R_LINEAR_____0_CM 1 100. 0. 7. DISPLAY_IDENTIFIER NR_EGY_CTL_CYL_CLC ECU_ADDRESS 0xd000336d FORMAT "%1.0" /end MEASUREMENT
/begin CHARACTERISTIC c_fac_egy_pwm_man[0] "Manually set conversion factor: EGY to % PWM for piezo injector." VALUE 0xa0806558 _REC_VAL_20_u2 1.99996948242188 _CNV_A_R_INJR_LINEA_527_CM 0. 1.99996948242188 DISPLAY_IDENTIFIER C_FAC_EGY_PWM_MAN[0] FORMAT "%7.5" /end CHARACTERISTIC
/begin CHARACTERISTIC c_fac_egy_pwm_man[1] "Manually set conversion factor: EGY to % PWM for piezo injector." VALUE 0xa080655a _REC_VAL_20_u2 1.99996948242188 _CNV_A_R_INJR_LINEA_527_CM 0. 1.99996948242188 DISPLAY_IDENTIFIER C_FAC_EGY_PWM_MAN[1] FORMAT "%7.5" /end CHARACTERISTIC
/begin CHARACTERISTIC c_fac_egy_pwm_man[2] "Manually set conversion factor: EGY to % PWM for piezo injector." VALUE 0xa080655c _REC_VAL_20_u2 1.99996948242188 _CNV_A_R_INJR_LINEA_527_CM 0. 1.99996948242188 DISPLAY_IDENTIFIER C_FAC_EGY_PWM_MAN[2] FORMAT "%7.5" /end CHARACTERISTIC
/begin CHARACTERISTIC c_fac_egy_pwm_man[3] "Manually set conversion factor: EGY to % PWM for piezo injector." VALUE 0xa080655e _REC_VAL_20_u2 1.99996948242188 _CNV_A_R_INJR_LINEA_527_CM 0. 1.99996948242188 DISPLAY_IDENTIFIER C_FAC_EGY_PWM_MAN[3] FORMAT "%7.5" /end CHARACTERISTIC
/begin CHARACTERISTIC c_fac_egy_pwm_man[4] "Manually set conversion factor: EGY to % PWM for piezo injector." VALUE 0xa0806560 _REC_VAL_20_u2 1.99996948242188 _CNV_A_R_INJR_LINEA_527_CM 0. 1.99996948242188 DISPLAY_IDENTIFIER C_FAC_EGY_PWM_MAN[4] FORMAT "%7.5" /end CHARACTERISTIC
/begin CHARACTERISTIC c_fac_egy_pwm_man[5] "Manually set conversion factor: EGY to % PWM for piezo injector." VALUE 0xa0806562 _REC_VAL_20_u2 1.99996948242188 _CNV_A_R_INJR_LINEA_527_CM 0. 1.99996948242188 DISPLAY_IDENTIFIER C_FAC_EGY_PWM_MAN[5] FORMAT "%7.5" /end CHARACTERISTIC
/begin CHARACTERISTIC c_fac_egy_pwm_man[6] "Manually set conversion factor: EGY to % PWM for piezo injector." VALUE 0xa0806564 _REC_VAL_20_u2 1.99996948242188 _CNV_A_R_INJR_LINEA_527_CM 0. 1.99996948242188 DISPLAY_IDENTIFIER C_FAC_EGY_PWM_MAN[6] FORMAT "%7.5" /end CHARACTERISTIC
/begin CHARACTERISTIC c_fac_egy_pwm_man[7] "Manually set conversion factor: EGY to % PWM for piezo injector." VALUE 0xa0806566 _REC_VAL_20_u2 1.99996948242188 _CNV_A_R_INJR_LINEA_527_CM 0. 1.99996948242188 DISPLAY_IDENTIFIER C_FAC_EGY_PWM_MAN[7] FORMAT "%7.5" /end CHARACTERISTIC
/begin MEASUREMENT lv_egy_ad_ena "Piezo energy adaption is enabled and active, if set" UBYTE _CNV_S_2_RANGE__0___1_CM 1 100. 0. 1. DISPLAY_IDENTIFIER LV_EGY_AD_ENA ECU_ADDRESS 0xd000337c BIT_MASK 0x1 /end MEASUREMENT
/begin MEASUREMENT lv_v_lim_ena "Piezo voltage limitation is enabled and active, if set" UBYTE _CNV_S_2_RANGE__0___1_CM 1 100. 0. 1. DISPLAY_IDENTIFIER LV_V_LIM_ENA ECU_ADDRESS 0xd00033ac BIT_MASK 0x1 /end MEASUREMENT
/begin MEASUREMENT egy_step_inj_cha_grd_ofs "Piezo injector energy charge and discharge gradient offset" SWORD _CNV_A_R_INJR_LINEA_460_CM 1 100. -50. 50. DISPLAY_IDENTIFIER EGY_STEP_INJ_CHA_GRD_OFS ECU_ADDRESS 0xd00032fc /end MEASUREMENT
/begin CHARACTERISTIC lc_egy_sp_iv_ext_ena "Logical constant to enable external energy setpoint for injector energy controller" VALUE 0xa08065db _REC_VAL_20_u1 1. _CNV_A_R_LINEAR_____0_CM 0. 1. DISPLAY_IDENTIFIER LC_EGY_SP_IV_EXT_ENA FORMAT "%1.0" /end CHARACTERISTIC
/begin AXIS_PTS ldp_fup_ip_egy_step_inj_cha_grd "Piezo injector energy charge and discharge gradient offset for a single step" 0xa08060e8 fup_h_mv _REC_AXS_20_u2 347776. _CNV_A_R_LINEAR_____171_CM 6 0. 347776. FORMAT "%8.1" /end AXIS_PTS
/begin AXIS_PTS ldp_tfu_inj_ip_egy_step_inj_cha "Piezo injector energy charge and discharge gradient offset for a single step" 0xa08061ea tfu_inj _REC_AXS_20_u1 190.5 _CNV_A_R_LINEAR_____17_CM 4 -48. 142.5 FORMAT "%6.2" /end AXIS_PTS
/begin CHARACTERISTIC ip_egy_step_inj_cha_grd_ofs "Piezo injector energy charge and discharge gradient offset for a single step" MAP 0xa0806368 _REC_MAP_20_u2_u2_u1 100. _CNV_A_R_INJR_LINEA_526_CM -50. 50. DISPLAY_IDENTIFIER IP_EGY_STEP_INJ_CHA_GRD_OFS FORMAT "%7.3"
 /begin AXIS_DESCR COM_AXIS fup_h_mv _CNV_A_R_LINEAR_____171_CM 6 0. 347776. FORMAT "%8.1" AXIS_PTS_REF ldp_fup_ip_egy_step_inj_cha_grd /end AXIS_DESCR
 /begin AXIS_DESCR COM_AXIS tfu_inj _CNV_A_R_LINEAR_____17_CM 4 -48. 142.5 FORMAT "%6.2" AXIS_PTS_REF ldp_tfu_inj_ip_egy_step_inj_cha /end AXIS_DESCR
/end CHARACTERISTIC
/begin CHARACTERISTIC c_nr_egy_step_inj_h "Number of charge steps for a high piezo energy range" VALUE 0xa0806576 _REC_VAL_20_u1 29. _CNV_A_R_LINEAR_____0_CM 2. 31. DISPLAY_IDENTIFIER C_NR_EGY_STEP_INJ_H FORMAT "%2.0" /end CHARACTERISTIC
/begin CHARACTERISTIC c_seg_ctr_egy_ad_ena "Number of segments for activation of piezo energy adaptation" VALUE 0xa080657c _REC_VAL_20_u2 65535. _CNV_A_R_LINEAR_____0_CM 0. 65535. DISPLAY_IDENTIFIER C_SEG_CTR_EGY_AD_ENA FORMAT "%5.0" /end CHARACTERISTIC
/begin MEASUREMENT egy_add_fup "Additive piezo energy correction depending on the fuel pressure" SWORD _CNV_A_R_INJR_LINEA_472_CM 1 100. -127.501945536512 127.498054485928 DISPLAY_IDENTIFIER EGY_ADD_FUP ECU_ADDRESS 0xd0006f5e FORMAT "%8.3" /end MEASUREMENT
/begin AXIS_PTS ldp_fup_ip_egy_add_fup "" 0xa08060cc fup_h_mv _REC_AXS_20_u2 347776. _CNV_A_R_LINEAR_____171_CM 12 0. 347776. FORMAT "%8.1" /end AXIS_PTS
/begin CHARACTERISTIC ip_egy_add_fup "Additive piezo energy correction depending on the fuel pressure" CURVE 0xa0806320 _REC_CUR_20_u2_u2 255.00000002244 _CNV_A_R_INJR_LINEA_471_CM -127.501945536512 127.498054485928 DISPLAY_IDENTIFIER IP_EGY_ADD_FUP FORMAT "%8.3"
 /begin AXIS_DESCR COM_AXIS fup_h_mv _CNV_A_R_LINEAR_____171_CM 12 0. 347776. FORMAT "%8.1" AXIS_PTS_REF ldp_fup_ip_egy_add_fup /end AXIS_DESCR
/end CHARACTERISTIC
/begin CHARACTERISTIC lc_eoi_2_homs_man "Switch to activate the manual setpoint for EOI_2, homogeneous stratified mode" VALUE 0xa08065e0 _REC_VAL_20_u1 1. _CNV_A_R_LINEAR_____0_CM 0. 1. DISPLAY_IDENTIFIER LC_EOI_2_HOMS_MAN FORMAT "%1.0" /end CHARACTERISTIC
/begin CHARACTERISTIC lc_soi_1_homs_man "Switch to activate the manual setpoint for SOI_1, homogeneous stratified mode" VALUE 0xa08065e9 _REC_VAL_20_u1 1. _CNV_A_R_LINEAR_____0_CM 0. 1. DISPLAY_IDENTIFIER LC_SOI_1_HOMS_MAN FORMAT "%1.0" /end CHARACTERISTIC
/begin CHARACTERISTIC c_soi_1_homs_man "Manual setpoint for SOI of the first pulse during homogeneous stratified mode" VALUE 0xa0806582 _REC_VAL_20_u2 720. _CNV_A_R_LINEAR_____200_CM 0. 720. DISPLAY_IDENTIFIER C_SOI_1_HOMS_MAN FORMAT "%7.3" /end CHARACTERISTIC
/begin CHARACTERISTIC c_eoi_2_homs_man "Manual setpoint for EOI of the second pulse during homogeneous stratified mode" VALUE 0xa0806548 _REC_VAL_20_u2 720. _CNV_A_R_LINEAR_____200_CM 0. 720. DISPLAY_IDENTIFIER C_EOI_2_HOMS_MAN FORMAT "%7.3" /end CHARACTERISTIC
/begin COMPU_METHOD _CNV_A_R_LINEAR_____0_CM "" RAT_FUNC "%6.3" "-" COEFFS 0 1. 0. 0 0 1 /end COMPU_METHOD
/begin COMPU_METHOD _CNV_S_2_RANGE__0___1_CM "" TAB_VERB "%6.3" "-" COMPU_TAB_REF _CNV_S_2_RANGE__0___1 /end COMPU_METHOD
/begin COMPU_VTAB _CNV_S_2_RANGE__0___1 "" TAB_VERB 2 0 "0" 1 "1" /end COMPU_VTAB
/begin COMPU_METHOD _CNV_A_R_LINEAR_____9_CM "" RAT_FUNC "%6.3" "-" COEFFS 0 32767.99999999992 0. 0 0 1 /end COMPU_METHOD
/begin COMPU_METHOD _CNV_A_R_LINEAR_____10_CM "" RAT_FUNC "%6.3" "rpm" COEFFS 0 3.125e-002 0. 0 0 1 /end COMPU_METHOD
/begin COMPU_METHOD _CNV_A_R_LINEAR_____14_CM "" RAT_FUNC "%6.3" "rpm" COEFFS 0 1. 0. 0 0 1 /end COMPU_METHOD
/begin COMPU_METHOD _CNV_A_R_LINEAR_____17_CM "" RAT_FUNC "%6.3" "°C" COEFFS 0 1.333333333333333 64. 0 0 1 /end COMPU_METHOD
/begin COMPU_METHOD _CNV_A_R_LINEAR_____28_CM "" RAT_FUNC "%6.3" "-" COEFFS 0 256. 0. 0 0 1 /end COMPU_METHOD
/begin COMPU_METHOD _CNV_A_R_LINEAR_____84_CM "" RAT_FUNC "%6.3" "min" COEFFS 0 1. 0. 0 0 1 /end COMPU_METHOD
/begin COMPU_METHOD _CNV_A_R_LINEAR_____111_CM "" RAT_FUNC "%6.3" "mg/stk" COEFFS 0 47.18142548596112 0. 0 0 1 /end COMPU_METHOD
/begin COMPU_METHOD _CNV_A_R_LINEAR_____171_CM "" RAT_FUNC "%6.3" "hPa" COEFFS 0 0.1884402603974972 0. 0 0 1 /end COMPU_METHOD
/begin COMPU_METHOD _CNV_A_R_LINEAR_____200_CM "" RAT_FUNC "%6.3" "°CRK" COEFFS 0 2.666666666666667 0. 0 0 1 /end COMPU_METHOD
/begin COMPU_METHOD _CNV_A_R_LINEAR_____207_CM "" RAT_FUNC "%6.3" "V" COEFFS 0 51.2 0. 0 0 1 /end COMPU_METHOD
/begin COMPU_METHOD _CNV_A_R_LINEAR_____228_CM "" RAT_FUNC "%6.3" "ms" COEFFS 0 1000. 0. 0 0 1 /end COMPU_METHOD
/begin COMPU_METHOD _CNV_A_R_LINEAR_____255_CM "" RAT_FUNC "%6.3" "km" COEFFS 0 0.125 0. 0 0 1 /end COMPU_METHOD
/begin COMPU_METHOD _CNV_S_16_RANGE_ERR__349_CM "" TAB_VERB "%6.3" "-" COMPU_TAB_REF _CNV_S_16_RANGE_ERR__349 /end COMPU_METHOD
/begin COMPU_VTAB _CNV_S_16_RANGE_ERR__349 "" TAB_VERB 16 0 "NO_SYM" 1 "SYM_0" 2 "SYM_1" 3 "SYM_0, SYM_1" 4 "SYM_2" 5 "SYM_0, SYM_2" 6 "SYM_1, SYM_2" 7 "SYM_0, SYM_1, SYM_2" 8 "SYM_3" 9 "SYM_0, SYM_3" 10 "SYM_1, SYM_3" 11 "SYM_0, SYM_1,SYM_3" 12 "SYM_2, SYM_3" 13 "SYM_0, SYM_2, SYM_3" 14 "SYM_1, SYM_2, SYM_3" 15 "SYM_0, SYM_1, SYM_2, SYM_3" /end COMPU_VTAB
/begin COMPU_METHOD _CNV_A_R_INJR_LINEA_432_CM "" RAT_FUNC "%6.3" "mJ" COEFFS 0 257. 0. 0 0 1 /end COMPU_METHOD
/begin COMPU_METHOD _CNV_A_R_INJR_LINEA_460_CM "" RAT_FUNC "%6.3" "%" COEFFS 0 163.84 0. 0 0 1 /end COMPU_METHOD
/begin COMPU_METHOD _CNV_A_R_INJR_LINEA_464_CM "" RAT_FUNC "%6.3" "uF" COEFFS 0 2343.884120171674 0. 0 0 1 /end COMPU_METHOD
/begin COMPU_METHOD _CNV_A_R_INJR_LINEA_465_CM "" RAT_FUNC "%6.3" "-" COEFFS 0 32768.00003968061 32768.00003968061 0 0 1 /end COMPU_METHOD
/begin COMPU_METHOD _CNV_A_R_INJR_LINEA_466_CM "" RAT_FUNC "%6.3" "ms" COEFFS 0 100. 0. 0 0 1 /end COMPU_METHOD
/begin COMPU_METHOD _CNV_A_R_INJR_LINEA_467_CM "" RAT_FUNC "%6.3" "uF" COEFFS 0 2343.884120171674 -4.951716618961655e-005 0 0 1 /end COMPU_METHOD
/begin COMPU_METHOD _CNV_A_R_INJR_LINEA_469_CM "" RAT_FUNC "%6.3" "°C" COEFFS 0 5461.333333333333 0. 0 0 1 /end COMPU_METHOD
/begin COMPU_METHOD _CNV_A_R_INJR_LINEA_470_CM "" RAT_FUNC "%6.3" "uF" COEFFS 0 2343.884120171674 32767.99995048283 0 0 1 /end COMPU_METHOD
/begin COMPU_METHOD _CNV_A_R_INJR_LINEA_471_CM "" RAT_FUNC "%6.3" "mJ" COEFFS 0 256.999999977384 32768. 0 0 1 /end COMPU_METHOD
/begin COMPU_METHOD _CNV_A_R_INJR_LINEA_472_CM "" RAT_FUNC "%6.3" "mJ" COEFFS 0 256.999999977384 0. 0 0 1 /end COMPU_METHOD
/begin COMPU_METHOD _CNV_A_R_INJR_LINEA_526_CM "" RAT_FUNC "%6.3" "%" COEFFS 0 163.84 8192. 0 0 1 /end COMPU_METHOD
/begin COMPU_METHOD _CNV_A_R_INJR_LINEA_527_CM "" RAT_FUNC "%6.3" "%/mJ" COEFFS 0 32767.99999999992 0. 0 0 1 /end COMPU_METHOD
/begin RECORD_LAYOUT _REC_VAL_20_u1 FNC_VALUES 1 UBYTE COLUMN_DIR DIRECT /end RECORD_LAYOUT
/begin RECORD_LAYOUT _REC_VAL_20_u2 FNC_VALUES 1 UWORD COLUMN_DIR DIRECT /end RECORD_LAYOUT
/begin RECORD_LAYOUT _REC_AXS_20_u1 NO_AXIS_PTS_X 1 UBYTE AXIS_PTS_X 2 UBYTE INDEX_INCR DIRECT /end RECORD_LAYOUT
/begin RECORD_LAYOUT _REC_VAL_20_s2 FNC_VALUES 1 SWORD COLUMN_DIR DIRECT /end RECORD_LAYOUT
/begin RECORD_LAYOUT _REC_MAP_20_u2_u2_u1 FNC_VALUES 1 UWORD COLUMN_DIR DIRECT /end RECORD_LAYOUT
/begin RECORD_LAYOUT _REC_AXS_20_u2 NO_AXIS_PTS_X 1 UWORD AXIS_PTS_X 2 UWORD INDEX_INCR DIRECT /end RECORD_LAYOUT
/begin RECORD_LAYOUT _REC_CUR_20_u2_u1 FNC_VALUES 1 UWORD COLUMN_DIR DIRECT /end RECORD_LAYOUT
/begin RECORD_LAYOUT _REC_CUR_20_u2_u2 FNC_VALUES 1 UWORD COLUMN_DIR DIRECT /end RECORD_LAYOUT
/begin RECORD_LAYOUT _REC_MAP_20_u2_u2_u2 FNC_VALUES 1 UWORD COLUMN_DIR DIRECT /end RECORD_LAYOUT
/begin RECORD_LAYOUT _REC_MAP_20_u2_u1_u2 FNC_VALUES 1 UWORD COLUMN_DIR DIRECT /end RECORD_LAYOUT
/begin RECORD_LAYOUT _REC_MAP_20_u1_u2_u2 FNC_VALUES 1 UBYTE COLUMN_DIR DIRECT /end RECORD_LAYOUT
/begin FUNCTION INJR_Injector_needle_lift_adj ""
 /begin DEF_CHARACTERISTIC c_ti_hys_iv_egy_rng c_egy_step_inj_cha_grd_min_hom c_egy_step_inj_cha_grd_max_s c_egy_step_inj_cha_grd_min_s ldp_fup_mff_thd_iv_egy_rng ip_mff_thd_iv_egy_rng c_mff_hys_iv_egy_rng c_egy_step_inj_cha_grd_max_hom ldp_fup_fac_ti_cor_iv_rgy_rng_l ldp_n_32_ti_thd_iv_egy_rng ip_fac_ti_cor_iv_egy_rng_l id_ti_thd_iv_egy_rng /end DEF_CHARACTERISTIC
 /begin OUT_MEASUREMENT injr.STR_INJR_ISPCLEGYIV0.str_injr_ispclegyiv0_pls_l[0].lv_iv_egy_rng injr.STR_INJR_ISPCLEGYIV0.str_injr_ispclegyiv0_pls_l[0].str_injr_ispclegyiv0_mod_ti_l.ti_min_stnd_egy_h injr.STR_INJR_ISPCLEGYIV0.str_injr_ispclegyiv0_pls_l[0].str_injr_ispclegyiv0_mod_ti_l.mff_sp_tot[0] injr.STR_INJR_ISPCLEGYIV0.str_injr_ispclegyiv0_pls_l[0].str_injr_ispclegyiv0_mod_ti_l.mff_sp_tot[1] injr.STR_INJR_ISPCLEGYIV0.str_injr_ispclegyiv0_pls_l[0].str_injr_ispclegyiv0_mod_ti_l.mff_sp_tot[2] injr.STR_INJR_ISPCLEGYIV0.str_injr_ispclegyiv0_pls_l[0].str_injr_ispclegyiv0_mod_ti_l.mff_sp_tot[3] injr.STR_INJR_ISPCLEGYIV0.str_injr_ispclegyiv0_pls_l[0].str_injr_ispclegyiv0_mod_ti_l.mff_sp_tot[4] injr.STR_INJR_ISPCLEGYIV0.str_injr_ispclegyiv0_pls_l[0].str_injr_ispclegyiv0_mod_ti_l.mff_sp_tot[5] injr.STR_INJR_ISPCLEGYIV0.str_injr_ispclegyiv0_pls_l[0].str_injr_ispclegyiv0_mod_ti_l.mff_sp_tot[6] injr.STR_INJR_ISPCLEGYIV0.str_injr_ispclegyiv0_pls_l[0].str_injr_ispclegyiv0_mod_ti_l.mff_sp_tot[7] injr.STR_INJR_ISPCLEGYIV0.str_injr_ispclegyiv0_pls_l[0].str_injr_ispclegyiv0_mod_ti_l.ti_stnd[0] injr.STR_INJR_ISPCLEGYIV0.str_injr_ispclegyiv0_pls_l[0].str_injr_ispclegyiv0_mod_ti_l.ti_stnd[1] injr.STR_INJR_ISPCLEGYIV0.str_injr_ispclegyiv0_pls_l[0].str_injr_ispclegyiv0_mod_ti_l.ti_stnd[2] injr.STR_INJR_ISPCLEGYIV0.str_injr_ispclegyiv0_pls_l[0].str_injr_ispclegyiv0_mod_ti_l.ti_stnd[3] injr.STR_INJR_ISPCLEGYIV0.str_injr_ispclegyiv0_pls_l[0].str_injr_ispclegyiv0_mod_ti_l.ti_stnd[4] injr.STR_INJR_ISPCLEGYIV0.str_injr_ispclegyiv0_pls_l[0].str_injr_ispclegyiv0_mod_ti_l.ti_stnd[5] injr.STR_INJR_ISPCLEGYIV0.str_injr_ispclegyiv0_pls_l[0].str_injr_ispclegyiv0_mod_ti_l.ti_stnd[6] injr.STR_INJR_ISPCLEGYIV0.str_injr_ispclegyiv0_pls_l[0].str_injr_ispclegyiv0_mod_ti_l.ti_stnd[7] injr.STR_INJR_ISPCLEGYIV0.str_injr_ispclegyiv0_pls_l[0].str_injr_ispclegyiv0_mod_ti_l.t_cha_per injr.STR_INJR_ISPCLEGYIV0.str_injr_ispclegyiv0_pls_l[0].str_injr_ispclegyiv0_mod_ti_l.t_dcha_per injr.STR_INJR_ISPCLEGYIV0.str_injr_ispclegyiv0_pls_l[0].str_injr_ispclegyiv0_mod_mff_l.t_cha_per injr.STR_INJR_ISPCLEGYIV0.str_injr_ispclegyiv0_pls_l[0].str_injr_ispclegyiv0_mod_mff_l.t_dcha_per injr.STR_INJR_ISPCLEGYIV0.str_injr_ispclegyiv0_pls_l[1].lv_iv_egy_rng injr.STR_INJR_ISPCLEGYIV0.str_injr_ispclegyiv0_pls_l[1].str_injr_ispclegyiv0_mod_ti_l.ti_min_stnd_egy_h injr.STR_INJR_ISPCLEGYIV0.str_injr_ispclegyiv0_pls_l[1].str_injr_ispclegyiv0_mod_ti_l.mff_sp_tot[0] injr.STR_INJR_ISPCLEGYIV0.str_injr_ispclegyiv0_pls_l[1].str_injr_ispclegyiv0_mod_ti_l.mff_sp_tot[1] injr.STR_INJR_ISPCLEGYIV0.str_injr_ispclegyiv0_pls_l[1].str_injr_ispclegyiv0_mod_ti_l.mff_sp_tot[2] injr.STR_INJR_ISPCLEGYIV0.str_injr_ispclegyiv0_pls_l[1].str_injr_ispclegyiv0_mod_ti_l.mff_sp_tot[3] injr.STR_INJR_ISPCLEGYIV0.str_injr_ispclegyiv0_pls_l[1].str_injr_ispclegyiv0_mod_ti_l.mff_sp_tot[4] injr.STR_INJR_ISPCLEGYIV0.str_injr_ispclegyiv0_pls_l[1].str_injr_ispclegyiv0_mod_ti_l.mff_sp_tot[5] injr.STR_INJR_ISPCLEGYIV0.str_injr_ispclegyiv0_pls_l[1].str_injr_ispclegyiv0_mod_ti_l.mff_sp_tot[6] injr.STR_INJR_ISPCLEGYIV0.str_injr_ispclegyiv0_pls_l[1].str_injr_ispclegyiv0_mod_ti_l.mff_sp_tot[7] injr.STR_INJR_ISPCLEGYIV0.str_injr_ispclegyiv0_pls_l[1].str_injr_ispclegyiv0_mod_ti_l.ti_stnd[0] injr.STR_INJR_ISPCLEGYIV0.str_injr_ispclegyiv0_pls_l[1].str_injr_ispclegyiv0_mod_ti_l.ti_stnd[1] injr.STR_INJR_ISPCLEGYIV0.str_injr_ispclegyiv0_pls_l[1].str_injr_ispclegyiv0_mod_ti_l.ti_stnd[2] injr.STR_INJR_ISPCLEGYIV0.str_injr_ispclegyiv0_pls_l[1].str_injr_ispclegyiv0_mod_ti_l.ti_stnd[3] injr.STR_INJR_ISPCLEGYIV0.str_injr_ispclegyiv0_pls_l[1].str_injr_ispclegyiv0_mod_ti_l.ti_stnd[4] injr.STR_INJR_ISPCLEGYIV0.str_injr_ispclegyiv0_pls_l[1].str_injr_ispclegyiv0_mod_ti_l.ti_stnd[5] injr.STR_INJR_ISPCLEGYIV0.str_injr_ispclegyiv0_pls_l[1].str_injr_ispclegyiv0_mod_ti_l.ti_stnd[6] injr.STR_INJR_ISPCLEGYIV0.str_injr_ispclegyiv0_pls_l[1].str_injr_ispclegyiv0_mod_ti_l.ti_stnd[7] injr.STR_INJR_ISPCLEGYIV0.str_injr_ispclegyiv0_pls_l[1].str_injr_ispclegyiv0_mod_ti_l.t_cha_per injr.STR_INJR_ISPCLEGYIV0.str_injr_ispclegyiv0_pls_l[1].str_injr_ispclegyiv0_mod_ti_l.t_dcha_per injr.STR_INJR_ISPCLEGYIV0.str_injr_ispclegyiv0_pls_l[1].str_injr_ispclegyiv0_mod_mff_l.ti_prs_sp injr.STR_INJR_ISPCLEGYIV0.str_injr_ispclegyiv0_pls_l[1].str_injr_ispclegyiv0_mod_mff_l.mff_sp_min injr.STR_INJR_ISPCLEGYIV0.str_injr_ispclegyiv0_pls_l[1].str_injr_ispclegyiv0_mod_mff_l.t_cha_per injr.STR_INJR_ISPCLEGYIV0.str_injr_ispclegyiv0_pls_l[1].str_injr_ispclegyiv0_mod_mff_l.t_dcha_per injr.STR_INJR_ISPCLEGYIV0.str_injr_ispclegyiv0_pls_l[2].lv_iv_egy_rng injr.STR_INJR_ISPCLEGYIV0.str_injr_ispclegyiv0_pls_l[2].str_injr_ispclegyiv0_mod_mff_l.ti_prs_sp injr.STR_INJR_ISPCLEGYIV0.str_injr_ispclegyiv0_pls_l[2].str_injr_ispclegyiv0_mod_mff_l.mff_sp_min injr.STR_INJR_ISPCLEGYIV0.str_injr_ispclegyiv0_pls_l[2].str_injr_ispclegyiv0_mod_mff_l.t_cha_per injr.STR_INJR_ISPCLEGYIV0.str_injr_ispclegyiv0_pls_l[2].str_injr_ispclegyiv0_mod_mff_l.t_dcha_per t_dcha_per_post egy_step_inj_cha_grd_lim_not[0] egy_step_inj_cha_grd_lim_not[1] egy_step_inj_cha_grd_lim_not[2] egy_step_inj_cha_grd_lim_not[3] egy_step_inj_cha_grd_lim_not[4] egy_step_inj_cha_grd_lim_not[5] egy_step_inj_cha_grd_lim_not[6] egy_step_inj_cha_grd_lim_not[7] egy_step_inj_cha_grd_dif_hom[0] egy_step_inj_cha_grd_dif_hom[1] egy_step_inj_cha_grd_dif_hom[2] egy_step_inj_cha_grd_dif_hom[3] egy_step_inj_cha_grd_dif_hom[4] egy_step_inj_cha_grd_dif_hom[5] egy_step_inj_cha_grd_dif_hom[6] egy_step_inj_cha_grd_dif_hom[7] fac_egy_dif_hom[0] fac_egy_dif_hom[1] fac_egy_dif_hom[2] fac_egy_dif_hom[3] fac_egy_dif_hom[4] fac_egy_dif_hom[5] fac_egy_dif_hom[6] fac_egy_dif_hom[7] egy_step_inj_cha_grd_dif_s[0] egy_step_inj_cha_grd_dif_s[1] egy_step_inj_cha_grd_dif_s[2] egy_step_inj_cha_grd_dif_s[3] egy_step_inj_cha_grd_dif_s[4] egy_step_inj_cha_grd_dif_s[5] egy_step_inj_cha_grd_dif_s[6] egy_step_inj_cha_grd_dif_s[7] fac_egy_dif_s[0] fac_egy_dif_s[1] fac_egy_dif_s[2] fac_egy_dif_s[3] fac_egy_dif_s[4] fac_egy_dif_s[5] fac_egy_dif_s[6] fac_egy_dif_s[7] fac_mff_dif_s[0] fac_mff_dif_s[1] fac_mff_dif_s[2] fac_mff_dif_s[3] fac_mff_dif_s[4] fac_mff_dif_s[5] fac_mff_dif_s[6] fac_mff_dif_s[7] fac_ti_cor_iv_egy_rng_l t_dcha_per_hom t_cha_per_hom lv_egy_add_ad_lim[0] lv_egy_add_ad_lim[1] lv_egy_add_ad_lim[2] lv_egy_add_ad_lim[3] lv_egy_add_ad_lim[4] lv_egy_add_ad_lim[5] lv_egy_add_ad_lim[6] lv_egy_add_ad_lim[7] lv_egy_add_ad_lim_tol[0] lv_egy_add_ad_lim_tol[1] lv_egy_add_ad_lim_tol[2] lv_egy_add_ad_lim_tol[3] lv_egy_add_ad_lim_tol[4] lv_egy_add_ad_lim_tol[5] lv_egy_add_ad_lim_tol[6] lv_egy_add_ad_lim_tol[7] t_cha_per_post ti_thd_iv_egy_rng /end OUT_MEASUREMENT
/end FUNCTION
/begin FUNCTION INJR_Injector_needle_lift_control ""
 /begin DEF_CHARACTERISTIC ip_egy_step_inj_cha_grd[0] ip_egy_step_inj_cha_grd[1] ip_egy_step_inj_cha_grd[2] ip_egy_step_inj_cha_grd[3] ip_egy_step_inj_cha_grd[4] ip_egy_step_inj_cha_grd[5] ip_egy_step_inj_cha_grd[6] ip_egy_step_inj_cha_grd[7] c_max_inj_egy_level_cor c_min_inj_egy_level_cor c_nr_egy_step_inj_l ldp_tfu_ip_egy_step_inj_cha_grd c_fac_cor_egy_step_inj_dcha_grd c_egy_ctl_i_gain c_egy_ctl_p_gain lc_egy_step_ctl_dyn_ena lc_ena_adap_egy_ctl c_ti_egy_ctl_clc_min c_pwm_lim_v_max_i_gain ldp_tfu_inj_ip_v_iv_max ip_v_iv_max c_egy_bas_inj_sp_h c_egy_inj_max_lim lc_egy_add_ad_lim_ena c_fac_lpf_egy_pwm_ad c_fac_egy_pwm_man[0] c_fac_egy_pwm_man[1] c_fac_egy_pwm_man[2] c_fac_egy_pwm_man[3] c_fac_egy_pwm_man[4] c_fac_egy_pwm_man[5] c_fac_egy_pwm_man[6] c_fac_egy_pwm_man[7] lc_egy_sp_iv_ext_ena ldp_fup_ip_egy_step_inj_cha_grd ldp_tfu_inj_ip_egy_step_inj_cha ip_egy_step_inj_cha_grd_ofs c_nr_egy_step_inj_h c_seg_ctr_egy_ad_ena /end DEF_CHARACTERISTIC
 /begin OUT_MEASUREMENT min_inj_egy_level egy_step_inj_dcha_grd[0] egy_step_inj_dcha_grd[1] egy_step_inj_dcha_grd[2] egy_step_inj_dcha_grd[3] egy_step_inj_dcha_grd[4] egy_step_inj_dcha_grd[5] egy_step_inj_dcha_grd[6] egy_step_inj_dcha_grd[7] egy_step_inj_cha_lim_dif[0] egy_step_inj_cha_lim_dif[1] egy_step_inj_cha_lim_dif[2] egy_step_inj_cha_lim_dif[3] egy_step_inj_cha_lim_dif[4] egy_step_inj_cha_lim_dif[5] egy_step_inj_cha_lim_dif[6] egy_step_inj_cha_lim_dif[7] nr_egy_step_inj_l nr_egy_step_inj_h lv_egy_step_inj_cha_lim[0] lv_egy_step_inj_cha_lim[1] lv_egy_step_inj_cha_lim[2] lv_egy_step_inj_cha_lim[3] lv_egy_step_inj_cha_lim[4] lv_egy_step_inj_cha_lim[5] lv_egy_step_inj_cha_lim[6] lv_egy_step_inj_cha_lim[7] max_inj_egy_level fac_egy_pwm_ad[0] fac_egy_pwm_ad[1] fac_egy_pwm_ad[2] fac_egy_pwm_ad[3] fac_egy_pwm_ad[4] fac_egy_pwm_ad[5] fac_egy_pwm_ad[6] fac_egy_pwm_ad[7] egy_step_inj_cha_grd[0] egy_step_inj_cha_grd[1] egy_step_inj_cha_grd[2] egy_step_inj_cha_grd[3] egy_step_inj_cha_grd[4] egy_step_inj_cha_grd[5] egy_step_inj_cha_grd[6] egy_step_inj_cha_grd[7] egy_sp[0] egy_sp[1] egy_sp[2] egy_sp[3] egy_sp[4] egy_sp[5] egy_sp[6] egy_sp[7] egy_sp_not_lim[0] egy_sp_not_lim[1] egy_sp_not_lim[2] egy_sp_not_lim[3] egy_sp_not_lim[4] egy_sp_not_lim[5] egy_sp_not_lim[6] egy_sp_not_lim[7] egy_max_v_lim[0] egy_max_v_lim[1] egy_max_v_lim[2] egy_max_v_lim[3] egy_max_v_lim[4] egy_max_v_lim[5] egy_max_v_lim[6] egy_max_v_lim[7] lv_egy_pwm_lim[0] lv_egy_pwm_lim[1] lv_egy_pwm_lim[2] lv_egy_pwm_lim[3] lv_egy_pwm_lim[4] lv_egy_pwm_lim[5] lv_egy_pwm_lim[6] lv_egy_pwm_lim[7] egy_step_inj_cha_grd_bas[0] egy_step_inj_cha_grd_bas[1] egy_step_inj_cha_grd_bas[2] egy_step_inj_cha_grd_bas[3] egy_step_inj_cha_grd_bas[4] egy_step_inj_cha_grd_bas[5] egy_step_inj_cha_grd_bas[6] egy_step_inj_cha_grd_bas[7] nr_egy_ctl_cyl_clc lv_egy_ad_ena lv_v_lim_ena egy_step_inj_cha_grd_ofs /end OUT_MEASUREMENT
/end FUNCTION
/begin FUNCTION INJR_Comp_of_fuel_pres_influence "" /begin DEF_CHARACTERISTIC ldp_fup_ip_egy_add_fup ip_egy_add_fup /end DEF_CHARACTERISTIC /begin OUT_MEASUREMENT egy_add_fup /end OUT_MEASUREMENT /end FUNCTION
/begin FUNCTION INJR_Inj_phase_hom_strat_mode ""
 /begin DEF_CHARACTERISTIC lc_eoi_2_homs_man lc_soi_1_homs_man c_soi_1_homs_man c_eoi_2_homs_man /end DEF_CHARACTERISTIC
 /begin OUT_MEASUREMENT injr.STR_INJR_REQGNHOMS0.soi_1_homs[0] injr.STR_INJR_REQGNHOMS0.soi_1_homs[1] injr.STR_INJR_REQGNHOMS0.soi_1_homs[2] injr.STR_INJR_REQGNHOMS0.soi_1_homs[3] injr.STR_INJR_REQGNHOMS0.soi_1_homs[4] injr.STR_INJR_REQGNHOMS0.soi_1_homs[5] injr.STR_INJR_REQGNHOMS0.soi_1_homs[6] injr.STR_INJR_REQGNHOMS0.soi_1_homs[7] injr.STR_INJR_REQGNHOMS0.eoi_2_homs[0] injr.STR_INJR_REQGNHOMS0.eoi_2_homs[1] injr.STR_INJR_REQGNHOMS0.eoi_2_homs[2] injr.STR_INJR_REQGNHOMS0.eoi_2_homs[3] injr.STR_INJR_REQGNHOMS0.eoi_2_homs[4] injr.STR_INJR_REQGNHOMS0.eoi_2_homs[5] injr.STR_INJR_REQGNHOMS0.eoi_2_homs[6] injr.STR_INJR_REQGNHOMS0.eoi_2_homs[7] /end OUT_MEASUREMENT
/end FUNCTION
/begin FUNCTION INJR_Piezo_capa_temp_det ""
 /begin DEF_CHARACTERISTIC c_seg_ctr_capa_temp c_t_es_capa_temp ip_capa_iv_nom ldp_tco_ip_capa_iv_nom ldpm_fup_2_injr ip_temp_capa_iv_nom ldp_capa_ip_temp_capa_iv_nom c_ti_min_capa_fil c_temp_capa_inc ldp_egy_ip_capa_cor_egy_iv ip_capa_cor_egy_iv c_fac_fil_capa_iv c_capa_iv_dif_nom_lim c_temp_capa_iv_eol lc_capa_iv_dif_nom_inh_ch_ena lc_temp_capa_iv_eol_man /end DEF_CHARACTERISTIC
 /begin OUT_MEASUREMENT injr.STR_INJR_ISPCLCAPA0.capa_iv_dif_nom[0] injr.STR_INJR_ISPCLCAPA0.capa_iv_dif_nom[1] injr.STR_INJR_ISPCLCAPA0.capa_iv_dif_nom[2] injr.STR_INJR_ISPCLCAPA0.capa_iv_dif_nom[3] injr.STR_INJR_ISPCLCAPA0.capa_iv_dif_nom[4] injr.STR_INJR_ISPCLCAPA0.capa_iv_dif_nom[5] injr.STR_INJR_ISPCLCAPA0.capa_iv_dif_nom[6] injr.STR_INJR_ISPCLCAPA0.capa_iv_dif_nom[7] injr.STR_INJR_ISPCLCAPA0.capa_iv_1_fil[0] injr.STR_INJR_ISPCLCAPA0.capa_iv_1_fil[1] injr.STR_INJR_ISPCLCAPA0.capa_iv_1_fil[2] injr.STR_INJR_ISPCLCAPA0.capa_iv_1_fil[3] injr.STR_INJR_ISPCLCAPA0.capa_iv_1_fil[4] injr.STR_INJR_ISPCLCAPA0.capa_iv_1_fil[5] injr.STR_INJR_ISPCLCAPA0.capa_iv_1_fil[6] injr.STR_INJR_ISPCLCAPA0.capa_iv_1_fil[7] injr.STR_INJR_ISPCLCAPA0.temp_capa_iv[0] injr.STR_INJR_ISPCLCAPA0.temp_capa_iv[1] injr.STR_INJR_ISPCLCAPA0.temp_capa_iv[2] injr.STR_INJR_ISPCLCAPA0.temp_capa_iv[3] injr.STR_INJR_ISPCLCAPA0.temp_capa_iv[4] injr.STR_INJR_ISPCLCAPA0.temp_capa_iv[5] injr.STR_INJR_ISPCLCAPA0.temp_capa_iv[6] injr.STR_INJR_ISPCLCAPA0.temp_capa_iv[7] lv_t_es_capa_temp_vld lv_temp_capa_iv_eol /end OUT_MEASUREMENT
/end FUNCTION
/begin FUNCTION INJR_Comp_of_inj_duty_cycle ""
 /begin DEF_CHARACTERISTIC ldp_ducy_ip_egy_add_ducy ldp_n_ip_egy_add_ducy ip_egy_add_ducy /end DEF_CHARACTERISTIC
 /begin OUT_MEASUREMENT ducy_ti_n egy_add_ducy /end OUT_MEASUREMENT
/end FUNCTION
/begin FUNCTION INJR_Inj_needle_lift_co_Appl_Inc ""
 /begin DEF_CHARACTERISTIC ldpm_n_ip_egy_add_cor_ext ldpm_mff_sp_ip_egy_add_cor_ext ip_egy_add_cor_ext_hom ip_egy_add_cor_ext_homs ip_egy_add_cor_ext_s ip_egy_add_iv_agi_dist ldpm_dist_ip_egy_add_iv_agi c_egy_sp_iv_ext_adj[0] c_egy_sp_iv_ext_adj[1] c_egy_sp_iv_ext_adj[2] c_egy_sp_iv_ext_adj[3] c_egy_sp_iv_ext_adj[4] c_egy_sp_iv_ext_adj[5] c_egy_sp_iv_ext_adj[6] c_egy_sp_iv_ext_adj[7] lc_egy_sp_iv_ext_adj_ena /end DEF_CHARACTERISTIC
 /begin OUT_MEASUREMENT egy_add_cor_ext[0] egy_add_cor_ext[1] egy_add_cor_ext[2] egy_add_cor_ext[3] egy_add_cor_ext[4] egy_add_cor_ext[5] egy_add_cor_ext[6] egy_add_cor_ext[7] egy_sp_iv_ext[0] egy_sp_iv_ext[1] egy_sp_iv_ext[2] egy_sp_iv_ext[3] egy_sp_iv_ext[4] egy_sp_iv_ext[5] egy_sp_iv_ext[6] egy_sp_iv_ext[7] dist_iv_chg[0] dist_iv_chg[1] dist_iv_chg[2] dist_iv_chg[3] dist_iv_chg[4] dist_iv_chg[5] dist_iv_chg[6] dist_iv_chg[7] /end OUT_MEASUREMENT
/end FUNCTION
/begin FUNCTION C_A_INJR ""
 /begin SUB_FUNCTION INJR_Injection_valve_diagnosis_Appl_Inc INJR_Injection_valve_diagnosis INJR_IV_powerstage_diagnosis INJR_IV_powerstage_diag_Appl_Inc /end SUB_FUNCTION
/end FUNCTION
/begin FUNCTION INJR_Injection_valve_diagnosis_Appl_Inc "" /begin DEF_CHARACTERISTIC c_tco_thd_inh_diag_iv lc_inh_iv_diag_err_ena /end DEF_CHARACTERISTIC /begin OUT_MEASUREMENT lv_inh_diag_iv lv_err_iv_lst_cyc inh_iv_diag_err /end OUT_MEASUREMENT /end FUNCTION
/begin FUNCTION INJR_Injection_valve_diagnosis ""
 /begin DEF_CHARACTERISTIC c_n_cdn_diag_iv_fl_thd c_abc_inc_iv c_abc_max_iv c_ti_thd_inh_diag_iv c_inh_diag_iv_swi_man /end DEF_CHARACTERISTIC
 /begin OUT_MEASUREMENT state_diag_iv state_err_iv state_err_iv_cyl[0] state_err_iv_cyl[1] state_err_iv_cyl[2] state_err_iv_cyl[3] state_err_iv_cyl[4] state_err_iv_cyl[5] state_err_iv_cyl[6] state_err_iv_cyl[7] lv_err_iv_sc[0] lv_err_iv_sc[1] lv_err_iv_sc[2] lv_err_iv_sc[3] lv_err_iv_sc[4] lv_err_iv_sc[5] lv_err_iv_sc[6] lv_err_iv_sc[7] lv_err_iv[0] lv_err_iv[1] lv_err_iv[2] lv_err_iv[3] lv_err_iv[4] lv_err_iv[5] lv_err_iv[6] lv_err_iv[7] nr_cyl_diag_iv cdn_diag_iv[0] cdn_diag_iv[1] cdn_diag_iv[2] cdn_diag_iv[3] cdn_diag_iv[4] cdn_diag_iv[5] cdn_diag_iv[6] cdn_diag_iv[7] cdn_diag_iv_req[0] cdn_diag_iv_req[1] cdn_diag_iv_req[2] cdn_diag_iv_req[3] cdn_diag_iv_req[4] cdn_diag_iv_req[5] cdn_diag_iv_req[6] cdn_diag_iv_req[7] /end OUT_MEASUREMENT
/end FUNCTION
/begin FUNCTION INJR_IV_powerstage_diagnosis ""
 /begin DEF_CHARACTERISTIC c_abc_inc_pbk_iv c_abc_max_pbk_iv c_state_err_sym_pbk_iv_inh c_state_err_sym_pbk_iv_st_inh /end DEF_CHARACTERISTIC
 /begin OUT_MEASUREMENT state_diag_pbk_iv lv_err_pbk_iv[0] lv_err_pbk_iv[1] lv_err_pbk_iv[2] lv_err_pbk_iv[3] state_err_pbk_iv cdn_diag_pbk_iv[0] cdn_diag_pbk_iv[1] cdn_diag_pbk_iv[2] cdn_diag_pbk_iv[3] state_err_sym_pbk_iv[0] state_err_sym_pbk_iv[1] state_err_sym_pbk_iv[2] state_err_sym_pbk_iv[3] state_err_sym_pbk_iv_st[0] state_err_sym_pbk_iv_st[1] state_err_sym_pbk_iv_st[2] state_err_sym_pbk_iv_st[3] /end OUT_MEASUREMENT
/end FUNCTION
/begin FUNCTION INJR_IV_powerstage_diag_Appl_Inc "" /begin OUT_MEASUREMENT lv_inh_diag_pbk_iv lv_err_pbk_iv_lst_cyc /end OUT_MEASUREMENT /end FUNCTION
/begin FUNCTION C_A_ERRM "C_A_ERRM"
 /begin SUB_FUNCTION ERRM_Table_of_Failures ERRM_Anti_bounce_Algorithm ERRM_Debounce_algorithm_Appl_Inc /end SUB_FUNCTION
/end FUNCTION
/begin FUNCTION ERRM_Table_of_Failures "Table_of_Failures"
 /begin OUT_MEASUREMENT fmy_stat_imob_0.ctr_abc fmy_stat_imob_0.ctr_end_diag fmy_stat_imob_0.err_info_stat.lv_err_mem fmy_stat_imob_0.err_info_stat.lv_ready fmy_stat_imob_0.err_info_stat.lv_end_diag fmy_stat_imob_0.err_info_stat.lv_cdn_diag fmy_stat_imob_0.err_info_stat.err_sym fmy_stat_imob_1.ctr_abc fmy_stat_imob_1.ctr_end_diag fmy_stat_imob_1.err_info_stat.lv_err_mem fmy_stat_imob_1.err_info_stat.lv_ready fmy_stat_imob_1.err_info_stat.lv_end_diag fmy_stat_imob_1.err_info_stat.lv_cdn_diag fmy_stat_imob_1.err_info_stat.err_sym fmy_stat_imob_2.ctr_abc fmy_stat_imob_2.ctr_end_diag fmy_stat_imob_2.err_info_stat.lv_err_mem fmy_stat_imob_2.err_info_stat.lv_ready fmy_stat_imob_2.err_info_stat.lv_end_diag fmy_stat_imob_2.err_info_stat.lv_cdn_diag fmy_stat_imob_2.err_info_stat.err_sym fmy_stat_imob_3.ctr_abc fmy_stat_imob_3.ctr_end_diag fmy_stat_imob_3.err_info_stat.lv_err_mem fmy_stat_imob_3.err_info_stat.lv_ready fmy_stat_imob_3.err_info_stat.lv_end_diag fmy_stat_imob_3.err_info_stat.lv_cdn_diag fmy_stat_imob_3.err_info_stat.err_sym fmy_stat_tco_el.ctr_abc fmy_stat_tco_el.ctr_end_diag fmy_stat_tco_el.err_info_stat.lv_err_mem fmy_stat_tco_el.err_info_stat.lv_ready fmy_stat_tco_el.err_info_stat.lv_end_diag fmy_stat_tco_el.err_info_stat.lv_cdn_diag fmy_stat_tco_el.err_info_stat.err_sym fmy_stat_tco_grd.ctr_abc fmy_stat_tco_grd.ctr_end_diag fmy_stat_tco_grd.err_info_stat.lv_err_mem fmy_stat_tco_grd.err_info_stat.lv_ready fmy_stat_tco_grd.err_info_stat.lv_end_diag fmy_stat_tco_grd.err_info_stat.lv_cdn_diag fmy_stat_tco_grd.err_info_stat.err_sym fmy_stat_tco_stuck.ctr_abc fmy_stat_tco_stuck.ctr_end_diag fmy_stat_tco_stuck.err_info_stat.lv_err_mem fmy_stat_tco_stuck.err_info_stat.lv_ready fmy_stat_tco_stuck.err_info_stat.lv_end_diag fmy_stat_tco_stuck.err_info_stat.lv_cdn_diag fmy_stat_tco_stuck.err_info_stat.err_sym fmy_stat_tco_stuck_rng.ctr_abc fmy_stat_tco_stuck_rng.ctr_end_diag fmy_stat_tco_stuck_rng.err_info_stat.lv_err_mem fmy_stat_tco_stuck_rng.err_info_stat.lv_ready fmy_stat_tco_stuck_rng.err_info_stat.lv_end_diag fmy_stat_tco_stuck_rng.err_info_stat.lv_cdn_diag fmy_stat_tco_stuck_rng.err_info_stat.err_sym fmy_stat_tco_plaus.ctr_abc fmy_stat_tco_plaus.ctr_end_diag fmy_stat_tco_plaus.err_info_stat.lv_err_mem fmy_stat_tco_plaus.err_info_stat.lv_ready fmy_stat_tco_plaus.err_info_stat.lv_end_diag fmy_stat_tco_plaus.err_info_stat.lv_cdn_diag fmy_stat_tco_plaus.err_info_stat.err_sym fmy_stat_tco_2_el.ctr_abc fmy_stat_tco_2_el.ctr_end_diag fmy_stat_tco_2_el.err_info_stat.lv_err_mem fmy_stat_tco_2_el.err_info_stat.lv_ready fmy_stat_tco_2_el.err_info_stat.lv_end_diag fmy_stat_tco_2_el.err_info_stat.lv_cdn_diag fmy_stat_tco_2_el.err_info_stat.err_sym fmy_stat_tco_2_grd.ctr_abc fmy_stat_tco_2_grd.ctr_end_diag fmy_stat_tco_2_grd.err_info_stat.lv_err_mem fmy_stat_tco_2_grd.err_info_stat.lv_ready fmy_stat_tco_2_grd.err_info_stat.lv_end_diag fmy_stat_tco_2_grd.err_info_stat.lv_cdn_diag fmy_stat_tco_2_grd.err_info_stat.err_sym fmy_stat_tco_2_plaus.ctr_abc fmy_stat_tco_2_plaus.ctr_end_diag fmy_stat_tco_2_plaus.err_info_stat.lv_err_mem fmy_stat_tco_2_plaus.err_info_stat.lv_ready fmy_stat_tco_2_plaus.err_info_stat.lv_end_diag fmy_stat_tco_2_plaus.err_info_stat.lv_cdn_diag fmy_stat_tco_2_plaus.err_info_stat.err_sym fmy_stat_ect_el.ctr_abc fmy_stat_ect_el.ctr_end_diag fmy_stat_ect_el.err_info_stat.lv_err_mem fmy_stat_ect_el.err_info_stat.lv_ready fmy_stat_ect_el.err_info_stat.lv_end_diag fmy_stat_ect_el.err_info_stat.lv_cdn_diag fmy_stat_ect_el.err_info_stat.err_sym fmy_stat_ecf_el_1.ctr_abc fmy_stat_ecf_el_1.ctr_end_diag fmy_stat_ecf_el_1.err_info_stat.lv_err_mem fmy_stat_ecf_el_1.err_info_stat.lv_ready fmy_stat_ecf_el_1.err_info_stat.lv_end_diag fmy_stat_ecf_el_1.err_info_stat.lv_cdn_diag fmy_stat_ecf_el_1.err_info_stat.err_sym fmy_stat_ecf_el_2.ctr_abc fmy_stat_ecf_el_2.ctr_end_diag fmy_stat_ecf_el_2.err_info_stat.lv_err_mem fmy_stat_ecf_el_2.err_info_stat.lv_ready fmy_stat_ecf_el_2.err_info_stat.lv_end_diag fmy_stat_ecf_el_2.err_info_stat.lv_cdn_diag fmy_stat_ecf_el_2.err_info_stat.err_sym fmy_stat_ecfpwm_fb_1.ctr_abc fmy_stat_ecfpwm_fb_1.ctr_end_diag fmy_stat_ecfpwm_fb_1.err_info_stat.lv_err_mem fmy_stat_ecfpwm_fb_1.err_info_stat.lv_ready fmy_stat_ecfpwm_fb_1.err_info_stat.lv_end_diag fmy_stat_ecfpwm_fb_1.err_info_stat.lv_cdn_diag fmy_stat_ecfpwm_fb_1.err_info_stat.err_sym fmy_stat_ecfpwm_fb_2.ctr_abc fmy_stat_ecfpwm_fb_2.ctr_end_diag fmy_stat_ecfpwm_fb_2.err_info_stat.lv_err_mem fmy_stat_ecfpwm_fb_2.err_info_stat.lv_ready fmy_stat_ecfpwm_fb_2.err_info_stat.lv_end_diag fmy_stat_ecfpwm_fb_2.err_info_stat.lv_cdn_diag fmy_stat_ecfpwm_fb_2.err_info_stat.err_sym fmy_stat_th.ctr_abc fmy_stat_th.ctr_end_diag fmy_stat_th.err_info_stat.lv_err_mem fmy_stat_th.err_info_stat.lv_ready fmy_stat_th.err_info_stat.lv_end_diag fmy_stat_th.err_info_stat.lv_cdn_diag fmy_stat_th.err_info_stat.err_sym fmy_stat_ftl_min.ctr_abc fmy_stat_ftl_min.ctr_end_diag fmy_stat_ftl_min.err_info_stat.lv_err_mem fmy_stat_ftl_min.err_info_stat.lv_ready fmy_stat_ftl_min.err_info_stat.lv_end_diag fmy_stat_ftl_min.err_info_stat.lv_cdn_diag fmy_stat_ftl_min.err_info_stat.err_sym fmy_stat_tia_el_1.ctr_abc fmy_stat_tia_el_1.ctr_end_diag fmy_stat_tia_el_1.err_info_stat.lv_err_mem fmy_stat_tia_el_1.err_info_stat.lv_ready fmy_stat_tia_el_1.err_info_stat.lv_end_diag fmy_stat_tia_el_1.err_info_stat.lv_cdn_diag fmy_stat_tia_el_1.err_info_stat.err_sym fmy_stat_tia_el_2.ctr_abc fmy_stat_tia_el_2.ctr_end_diag fmy_stat_tia_el_2.err_info_stat.lv_err_mem fmy_stat_tia_el_2.err_info_stat.lv_ready fmy_stat_tia_el_2.err_info_stat.lv_end_diag fmy_stat_tia_el_2.err_info_stat.lv_cdn_diag fmy_stat_tia_el_2.err_info_stat.err_sym fmy_stat_tia_thr_el_1.ctr_abc fmy_stat_tia_thr_el_1.ctr_end_diag fmy_stat_tia_thr_el_1.err_info_stat.lv_err_mem fmy_stat_tia_thr_el_1.err_info_stat.lv_ready fmy_stat_tia_thr_el_1.err_info_stat.lv_end_diag fmy_stat_tia_thr_el_1.err_info_stat.lv_cdn_diag fmy_stat_tia_thr_el_1.err_info_stat.err_sym fmy_stat_tia_thr_el_2.ctr_abc fmy_stat_tia_thr_el_2.ctr_end_diag fmy_stat_tia_thr_el_2.err_info_stat.lv_err_mem fmy_stat_tia_thr_el_2.err_info_stat.lv_ready fmy_stat_tia_thr_el_2.err_info_stat.lv_end_diag fmy_stat_tia_thr_el_2.err_info_stat.lv_cdn_diag fmy_stat_tia_thr_el_2.err_info_stat.err_sym fmy_stat_amp.ctr_abc fmy_stat_amp.ctr_end_diag fmy_stat_amp.err_info_stat.lv_err_mem fmy_stat_amp.err_info_stat.lv_ready fmy_stat_amp.err_info_stat.lv_end_diag fmy_stat_amp.err_info_stat.lv_cdn_diag fmy_stat_amp.err_info_stat.err_sym fmy_stat_amp_plaus.ctr_abc fmy_stat_amp_plaus.ctr_end_diag fmy_stat_amp_plaus.err_info_stat.lv_err_mem fmy_stat_amp_plaus.err_info_stat.lv_ready fmy_stat_amp_plaus.err_info_stat.lv_end_diag fmy_stat_amp_plaus.err_info_stat.lv_cdn_diag fmy_stat_amp_plaus.err_info_stat.err_sym fmy_stat_maf.ctr_abc fmy_stat_maf.ctr_end_diag fmy_stat_maf.err_info_stat.lv_err_mem fmy_stat_maf.err_info_stat.lv_ready fmy_stat_maf.err_info_stat.lv_end_diag fmy_stat_maf.err_info_stat.lv_cdn_diag fmy_stat_maf.err_info_stat.err_sym fmy_stat_el_cps.ctr_abc fmy_stat_el_cps.ctr_end_diag fmy_stat_el_cps.err_info_stat.lv_err_mem fmy_stat_el_cps.err_info_stat.lv_ready fmy_stat_el_cps.err_info_stat.lv_end_diag fmy_stat_el_cps.err_info_stat.lv_cdn_diag fmy_stat_el_cps.err_info_stat.err_sym /end OUT_MEASUREMENT
/end FUNCTION
/end MODULE
/end PROJECT
