ASAP2_VERSION 1 4
/begin PROJECT P_558 "EDC17_CP02"
/begin HEADER "" VERSION "V1C1" PROJECT_NO P_558 /end HEADER
/begin MODULE DIM ""
/begin MOD_COMMON "" BYTE_ORDER MSB_LAST ALIGNMENT_BYTE 1 ALIGNMENT_WORD 2 ALIGNMENT_LONG 4 ALIGNMENT_FLOAT32_IEEE 4 /end MOD_COMMON
/begin CHARACTERISTIC ASMod_dmNOxEG_C "" VALUE 0x80067D48 Val_Ws16 6553.500 NOxMassPerTime -3276.800 3276.700 FORMAT "%8.3" /end CHARACTERISTIC
/begin CHARACTERISTIC ASMod_dmSotEG_C "" VALUE 0x80067D4A Val_Ws16 655.3500 SotMassPerTime -327.6800 327.6700 FORMAT "%8.4" /end CHARACTERISTIC
/begin CHARACTERISTIC Exh_pOfsValActMidPPFltDiff_C "" VALUE 0x80067D4C Val_Ws16 7000.000 Pres_hPa -3500.000 3500.000 FORMAT "%8.3" EXTENDED_LIMITS -32768.00 32767.00 /end CHARACTERISTIC
/begin CHARACTERISTIC Exh_stStyPPFltDiff_C "" VALUE 0x80067D4E Val_Ws16 1.000000 OneToOne 0.00 1.000000 FORMAT "%8.6" EXTENDED_LIMITS -32768.00 32767.00 /end CHARACTERISTIC
/begin CHARACTERISTIC Exh_stTrgAftRunPPFltDiff_C "" VALUE 0x80067D50 Val_Ws16 1.000000 OneToOne 0.00 1.000000 FORMAT "%8.6" EXTENDED_LIMITS -32768.00 32767.00 /end CHARACTERISTIC
/begin CHARACTERISTIC FuelLvl_vol_C "" VALUE 0x80067D52 Val_Ws16 655.3500 Vol -327.6800 327.6700 FORMAT "%8.4" /end CHARACTERISTIC
/begin CHARACTERISTIC PCV_CrntCtlDT1.T1_C "/" VALUE 0x80065D90 Val_Ws32 4294.9672940 TimeDelay_s 0.000002000000001 4294.9672960 FORMAT "%12.7" /end CHARACTERISTIC
/begin CHARACTERISTIC PCV_CrntCtlDT1.Kd_C "/" VALUE 0x80065D94 Val_Ws32 65535.9999847 Kd -32768.0000000 32767.9999847 FORMAT "%13.7" /end CHARACTERISTIC
/begin CHARACTERISTIC PCV_CrntCtlI.Ki_C "Klasse für Parameter I-Glied/" VALUE 0x80065DD8 Val_Ws32 244.140624943 Ki_curr2fact -122.070312500 122.070312443 FORMAT "%13.9" /end CHARACTERISTIC
/begin CHARACTERISTIC PCV_CrntCtlI.KiPos_C "Klasse für Parameter I-Glied/" VALUE 0x80065DDC Val_Ws32 244.140624943 Ki_curr2fact -122.070312500 122.070312443 FORMAT "%13.9" /end CHARACTERISTIC
/begin CHARACTERISTIC PCV_CrntCtlI.KiNeg_C "Klasse für Parameter I-Glied/" VALUE 0x80065DE0 Val_Ws32 244.140624943 Ki_curr2fact -122.070312500 122.070312443 FORMAT "%13.9" /end CHARACTERISTIC
/begin CHARACTERISTIC PCV_CrntCtlI.WinPos_C "Klasse für Parameter I-Glied/" VALUE 0x80065DE4 Val_Ws32 4294967295.00 Curr -2147483648.00 2147483647.00 FORMAT "%13.2" /end CHARACTERISTIC
/begin CHARACTERISTIC PCV_CrntCtlI.WinNeg_C "Klasse für Parameter I-Glied/" VALUE 0x80065DE8 Val_Ws32 4294967295.00 Curr -2147483648.00 2147483647.00 FORMAT "%13.2" /end CHARACTERISTIC
/begin CHARACTERISTIC PCV_CtlState.xVal_C "I-Glied, Kleinsignalfenster negativ/" VALUE 0x80065DEC Kw_Wu8 0.00 OneToOne 0.00 0.00 FORMAT "%5.2" EXTENDED_LIMITS 0.00 255.0 /end CHARACTERISTIC
/begin CHARACTERISTIC PCV_CtlState.xTyp_C "I-Glied, Kleinsignalfenster negativ/" VALUE 0x80065DED Kw_Wu8 1.000 OneToOne 1.000 2.000 FORMAT "%5.3" EXTENDED_LIMITS 0.00 255.0 /end CHARACTERISTIC
/begin CHARACTERISTIC PCV_dvolLeak_CUR "Leckage des Druckregelventils" CURVE 0x80065E7C Cur_Xs16Ws16 150000.0 Qp_mm3_sec 0.00 150000.0 FORMAT "%8.1" EXTENDED_LIMITS -327680.0 327670.0
 /begin AXIS_DESCR STD_AXIS Rail_pSetPoint Pres_Rail 6 0.00 2000.000 FORMAT "%5.3" EXTENDED_LIMITS -3276.800 3276.700 DEPOSIT ABSOLUTE /end AXIS_DESCR
/end CHARACTERISTIC
/begin CHARACTERISTIC PCV_dvolUpLim_CUR "Maximaler Durchfluss der Pumpe als Funktion der Drehzahl" CURVE 0x80065CF4 Cur_Xs16Ws16 655350.0 Qp_mm3_sec -327680.0 327670.0 FORMAT "%8.1"
 /begin AXIS_DESCR STD_AXIS Epm_nEng EngN 10 0.00 6000.000 FORMAT "%8.3" EXTENDED_LIMITS -16384.00 16383.50 DEPOSIT ABSOLUTE /end AXIS_DESCR
/end CHARACTERISTIC
/begin CHARACTERISTIC PCV_facAdaptDiffI_C "Faktor der maximalen Abweichung zwischen Soll- und Iststrom durch das PCV, ab dem die Adaption durchgeführt wird" VALUE 0x80065D1E Val_Ws16 1.000000 Fact 0.00 1.000000 FORMAT "%8.6" EXTENDED_LIMITS -4.000000 3.999878 /end CHARACTERISTIC
/begin CHARACTERISTIC PCV_facAdaptDiff_C "Faktor der maximalen Abweichung zwischen Railsoll- und Railistdruck, ab der die Adaption durchgeführt wird" VALUE 0x80065D20 Val_Ws16 1.000000 Fact 0.00 1.000000 FORMAT "%8.6" EXTENDED_LIMITS -4.000000 3.999878 /end CHARACTERISTIC
/begin CHARACTERISTIC PCV_facAdaptFlowMin_C "Mindestwert für den Durchflusskorrektur-Faktor des PCV" VALUE 0x80065D22 Val_Ws16 20.00000 Fact 0.00 20.00000 FORMAT "%8.5" EXTENDED_LIMITS -4.000000 3.999878 /end CHARACTERISTIC
/begin CHARACTERISTIC PCV_facAdaptFlow_MAP "Durchflusskorrektur-Faktor für die PCV-Kennlinie als Funktion vom Durchfluss durch das PCV und dem Raildruck" MAP 0x80065D24 Map_Xs16Ys16Ws16 7.999878 Fact -4.000000 3.999878 FORMAT "%8.6"
 /begin AXIS_DESCR STD_AXIS RailP_pFlt Pres_Rail 6 0.00 2000.000 FORMAT "%5.3" EXTENDED_LIMITS -3276.800 3276.700 DEPOSIT ABSOLUTE /end AXIS_DESCR
 /begin AXIS_DESCR STD_AXIS PCV_dvolFlow_mp Qp_mm3_sec 4 -10000.00 50000.00 FORMAT "%8.2" EXTENDED_LIMITS -327680.0 327670.0 DEPOSIT ABSOLUTE /end AXIS_DESCR
/end CHARACTERISTIC
/begin CHARACTERISTIC PCV_facAdaptMax_C "Maximalwert des Adaptionsfaktors des PCV" VALUE 0x80065D6C Val_Ws16 2.000000 Fact 0.00 2.000000 FORMAT "%8.6" EXTENDED_LIMITS -4.000000 3.999878 /end CHARACTERISTIC
/begin CHARACTERISTIC PCV_facAdaptMin_C "Minimalwert des Adaptionsfaktors des PCV" VALUE 0x80065D6E Val_Ws16 2.000000 Fact 0.00 2.000000 FORMAT "%8.6" EXTENDED_LIMITS -4.000000 3.999878 /end CHARACTERISTIC
/begin CHARACTERISTIC PCV_facAdaptWgh_C "Gewichtungsfaktor für die Berechnung des Adaptionsfaktors des PCV" VALUE 0x80065D70 Val_Ws16 20.00000 Fact4 0.00 20.00000 FORMAT "%8.5" EXTENDED_LIMITS -1638.400 1638.350 /end CHARACTERISTIC
/begin CHARACTERISTIC PCV_facCrntCtlInit_CUR "Sollstrom bei elektrischer Abschaltung des Druckregelventils" CURVE 0x80065DEE Cur_Xs16Ws16 2.000000 Fact 0.00 2.000000 FORMAT "%8.6" EXTENDED_LIMITS -4.000000 3.999878
 /begin AXIS_DESCR STD_AXIS FuelT_tFlSys Temp_Cels 6 -50.14000 149.8600 FORMAT "%8.4" EXTENDED_LIMITS -3549.940 3003.560 DEPOSIT ABSOLUTE /end AXIS_DESCR
/end CHARACTERISTIC
/begin CHARACTERISTIC PCV_facCrntCtlMax_C "Strom zum Schließen des Druckregelventils" VALUE 0x80065E08 Val_Ws16 1.000000 Fact 1.000000 2.000000 FORMAT "%8.6" EXTENDED_LIMITS -4.000000 3.999878 /end CHARACTERISTIC
/begin CHARACTERISTIC PCV_facCrntCtlMin_C "minimaler I-Anteil" VALUE 0x80065E0A Val_Ws16 0.5000000 Fact 0.5000000 1.000000 FORMAT "%8.6" EXTENDED_LIMITS -4.000000 3.999878 /end CHARACTERISTIC
/begin CHARACTERISTIC PCV_iCnvPres_CUR "Kennlinie zur Umrechnung von Druck nach Strom" CURVE 0x80065E0C Cur_Xs16Ws16 5000.000 Curr 0.00 5000.000 FORMAT "%8.3" EXTENDED_LIMITS -32768.00 32767.00
 /begin AXIS_DESCR STD_AXIS PCV_pSet Pres_Rail 10 0.00 2000.000 FORMAT "%5.3" EXTENDED_LIMITS -3276.800 3276.700 DEPOSIT ABSOLUTE /end AXIS_DESCR
/end CHARACTERISTIC
/begin CHARACTERISTIC PCV_iLin_CUR "Analogeingang, Linearisierungskennlinie" CURVE 0x80065D98 Cur_Xs16Ws16 5000.000 Curr 0.00 5000.000 FORMAT "%8.3" EXTENDED_LIMITS -32768.00 32767.00
 /begin AXIS_DESCR STD_AXIS PCV_uRaw_mp Volt 2 0.00 5200.000 FORMAT "%8.3" EXTENDED_LIMITS -6553.600 6553.400 DEPOSIT ABSOLUTE /end AXIS_DESCR
/end CHARACTERISTIC
/begin CHARACTERISTIC PCV_iSetClose_CUR "Sollstrom bei elektrischer Abschaltung des Druckregelventils" CURVE 0x80065E36 Cur_Xs16Ws16 5000.000 Curr 0.00 5000.000 FORMAT "%8.3" EXTENDED_LIMITS -32768.00 32767.00
 /begin AXIS_DESCR STD_AXIS CEngDsT_t Temp_Cels 8 -50.14000 149.8600 FORMAT "%8.4" EXTENDED_LIMITS -3549.940 3003.560 DEPOSIT ABSOLUTE /end AXIS_DESCR
/end CHARACTERISTIC
/begin CHARACTERISTIC PCV_iSetMaxBattHi_C "reduzierter Maximalstrom für das Druckregelventil bei erhöhter Batteriespannung" VALUE 0x80065E58 Val_Ws16 5000.000 Curr 0.00 5000.000 FORMAT "%8.3" EXTENDED_LIMITS -32768.00 32767.00 /end CHARACTERISTIC
/begin CHARACTERISTIC PCV_iSetMax_C "maximaler Strom zum Schließen des Druckregelventils" VALUE 0x80065E5A Val_Ws16 5000.000 Curr 0.00 5000.000 FORMAT "%8.3" EXTENDED_LIMITS -32768.00 32767.00 /end CHARACTERISTIC
/begin CHARACTERISTIC PCV_iSetMin_C "Sollstrom bei elektrischer Abschaltung des Druckregelventils" VALUE 0x80065E5C Val_Ws16 65535.00 Curr -32768.00 32767.00 FORMAT "%8.2" /end CHARACTERISTIC
/begin CHARACTERISTIC PCV_nSetClose_C "Drehzahlschwelle zum Verlassen des Modes PCV_stActrCtl == PCV_CLOSE_MODE (0x20)" VALUE 0x80065E5E Val_Ws16 6000.000 EngN 0.00 6000.000 FORMAT "%8.3" EXTENDED_LIMITS -16384.00 16383.50 /end CHARACTERISTIC
/begin CHARACTERISTIC PCV_numAdaptSum_C "Anzahl der Funktionsaufrufe der PCV-Adaption im Zustand PCV_ADAPT_SUM_UP" VALUE 0x80065D72 Val_Wu16 20.00000 OneToOne 0.00 20.00000 FORMAT "%8.5" EXTENDED_LIMITS 0.00 65535.00 /end CHARACTERISTIC
/begin CHARACTERISTIC PCV_numAdaptThres_C "Anzahl der Adaptionen, die bei beliebigem Raildruck durchgeführt werden" VALUE 0x80065D74 Val_Wu16 100.0000 OneToOne 0.00 100.0000 FORMAT "%8.4" EXTENDED_LIMITS 0.00 65535.00 /end CHARACTERISTIC
/begin CHARACTERISTIC PCV_numAdapt_C "Anzahl der Funktionsaufrufe der PCV-Adaption im Zustand PCV_ADAPT_STABLE" VALUE 0x80065D76 Val_Wu16 100.0000 OneToOne 0.00 100.0000 FORMAT "%8.4" EXTENDED_LIMITS 0.00 65535.00 /end CHARACTERISTIC
/begin CHARACTERISTIC PCV_pAdaptThresDec_C "Differenzdruck, um den die Druckschwelle reduziert wird, wenn die letzte Adaption zu lange zurück liegt" VALUE 0x80065D78 Val_Ws16 5276.800 Pres_Rail -3276.800 2000.000 FORMAT "%5.3" EXTENDED_LIMITS -3276.800 3276.700 /end CHARACTERISTIC
/begin CHARACTERISTIC PCV_pAdaptThresMax_C "Maximaler Raildruck für die Adaptions-Freigabe" VALUE 0x80065D7A Val_Ws16 5276.800 Pres_Rail -3276.800 2000.000 FORMAT "%5.3" EXTENDED_LIMITS -3276.800 3276.700 /end CHARACTERISTIC
/begin CHARACTERISTIC PCV_pAdaptThresMin_C "Minimaler Raildruck für die Adaptions-Freigabe" VALUE 0x80065D7C Val_Ws16 5276.800 Pres_Rail -3276.800 2000.000 FORMAT "%5.3" EXTENDED_LIMITS -3276.800 3276.700 /end CHARACTERISTIC
/begin CHARACTERISTIC PCV_pAdaptThres_C "Maximaler Wert für die Druckschwelle, ab der die Adaption durchgeführt wird" VALUE 0x80065D7E Val_Ws16 5276.800 Pres_Rail -3276.800 2000.000 FORMAT "%5.3" EXTENDED_LIMITS -3276.800 3276.700 /end CHARACTERISTIC
/begin CHARACTERISTIC PCV_Pwm.tiPer_C "Klasse für Parameter Ausgangstastverhältnis/" VALUE 0x80065DA2 Kw_Ws16 9.900000 Period 0.1000000 10.00000 FORMAT "%8.5" EXTENDED_LIMITS -3276.800 3276.700 /end CHARACTERISTIC
/begin CHARACTERISTIC PCV_Pwm.stLvl_C "Klasse für Parameter Ausgangstastverhältnis/" VALUE 0x80065DA4 Kw_Wu8 1.000 OneToOne 0.00 1.000 FORMAT "%5.3" EXTENDED_LIMITS 0.00 255.0 /end CHARACTERISTIC
/begin CHARACTERISTIC PCV_Pwm.rMaxDty_C "Klasse für Parameter Ausgangstastverhältnis/" VALUE 0x80065DA6 Kw_Ws16 100.0000 DtyCyc 0.00 100.0000 FORMAT "%8.4" EXTENDED_LIMITS -327.6800 327.6700 /end CHARACTERISTIC
/begin CHARACTERISTIC PCV_Pwm.rPerUn_C "Klasse für Parameter Ausgangstastverhältnis/" VALUE 0x80065DA8 Kw_Ws16 32767.00 OneToOne 0.00 32767.00 FORMAT "%8.2" EXTENDED_LIMITS -32768.00 32767.00 /end CHARACTERISTIC
/begin CHARACTERISTIC PCV_Pwm.tiPh_C "Klasse für Parameter Ausgangstastverhältnis/" VALUE 0x80065DAA Kw_Ws16 3276.700 Period 0.00 3276.700 FORMAT "%8.3" EXTENDED_LIMITS -3276.800 3276.700 /end CHARACTERISTIC
/begin CHARACTERISTIC PCV_PwmOut.rMin_C "Klasse für Parameter Ausgangstastverhältnis/" VALUE 0x80065DAC Kw_Ws16 100.0000 DtyCyc 0.00 100.0000 FORMAT "%8.4" EXTENDED_LIMITS -327.6800 327.6700 /end CHARACTERISTIC
/begin CHARACTERISTIC PCV_PwmOut.rMax_C "Klasse für Parameter Ausgangstastverhältnis/" VALUE 0x80065DAE Kw_Ws16 100.0000 DtyCyc 0.00 100.0000 FORMAT "%8.4" EXTENDED_LIMITS -327.6800 327.6700 /end CHARACTERISTIC
/begin CHARACTERISTIC PCV_PwmOut.tiBtwTstSCB_C "Klasse für Parameter Ausgangstastverhältnis/" VALUE 0x80065DB0 Kw_Ws16 1000.000 Time_ms 0.00 1000.000 FORMAT "%8.3" EXTENDED_LIMITS -327680.0 327670.0 /end CHARACTERISTIC
/begin CHARACTERISTIC PCV_PwmOut.tiBtwTstOT_C "Klasse für Parameter Ausgangstastverhältnis/" VALUE 0x80065DB2 Kw_Ws16 327.6700 Time_s 0.00 327.6700 FORMAT "%8.4" EXTENDED_LIMITS -327.6800 327.6700 /end CHARACTERISTIC
/begin CHARACTERISTIC PCV_PwmOut.numTstMax_C "Klasse für Parameter Ausgangstastverhältnis/" VALUE 0x80065DB4 Kw_Wu16 65535.00 OneToOne 0.00 65535.00 FORMAT "%8.2" /end CHARACTERISTIC
/begin CHARACTERISTIC PCV_PwmOut.swtBattCor_C "Klasse für Parameter Ausgangstastverhältnis/" VALUE 0x80065DB6 Kw_Wu8 1.000 OneToOne 0.00 1.000 FORMAT "%5.3" EXTENDED_LIMITS 0.00 255.0 /end CHARACTERISTIC
/begin CHARACTERISTIC PCV_PwmOut.swtPsInv_C "Klasse für Parameter Ausgangstastverhältnis/" VALUE 0x80065DB7 Kw_Wu8 255.0 OneToOne 0.00 255.0 FORMAT "%5.1" /end CHARACTERISTIC
/begin CHARACTERISTIC PCV_resCoil_C "Widerstandswert der DRV-Spule" VALUE 0x80065DB8 Val_Ws16 5000.000 Resist_1 0.00 5000.000 FORMAT "%8.3" EXTENDED_LIMITS -32768.00 32767.00 /end CHARACTERISTIC
/begin CHARACTERISTIC PCV_rSetLin_CUR "Linearisierungskennlinie des Tastverhältnisses des Druckregelventils" CURVE 0x80065DBA Cur_Xs16Ws16 655.3500 DtyCyc -327.6800 327.6700 FORMAT "%8.4"
 /begin AXIS_DESCR STD_AXIS PCV_rSet_mp DtyCyc 4 -327.6800 327.6700 FORMAT "%8.4" DEPOSIT ABSOLUTE /end AXIS_DESCR
/end CHARACTERISTIC
/begin CHARACTERISTIC PCV_rTst_C "Tastverhältnis, das im Fehlerfall zyklisch ausgegeben wird" VALUE 0x80065DCC Val_Ws16 100.0000 DtyCyc 0.00 100.0000 FORMAT "%8.4" EXTENDED_LIMITS -327.6800 327.6700 /end CHARACTERISTIC
/begin CHARACTERISTIC PCV_SRC.uMin_C "Klasse für Parameter Analogeingang Signal Range Check/" VALUE 0x80065DCE Kw_Ws16 5200.000 Volt 0.00 5200.000 FORMAT "%8.3" EXTENDED_LIMITS -6553.600 6553.400 /end CHARACTERISTIC
/begin CHARACTERISTIC PCV_SRC.uMax_C "Klasse für Parameter Analogeingang Signal Range Check/" VALUE 0x80065DD0 Kw_Ws16 5200.000 Volt 0.00 5200.000 FORMAT "%8.3" EXTENDED_LIMITS -6553.600 6553.400 /end CHARACTERISTIC
/begin CHARACTERISTIC PCV_stPwrStgActv_C "Signal Range Check Max-Wert" VALUE 0x80065DD2 Val_Wu8 255.0 OneToOne 0.00 255.0 FORMAT "%5.1" /end CHARACTERISTIC
/begin CHARACTERISTIC PCV_stPwrStgDia_C "Statuswort zur Spezifikation des Abschaltverhaltens der Endstufenfehlerdiagnose Druckregelventil" VALUE 0x80065DD3 Val_Wu8 255.0 OneToOne 0.00 255.0 FORMAT "%5.1" /end CHARACTERISTIC
/begin CHARACTERISTIC PCV_swtAdaptCPC_C "Schalter für die Freigabe der Adaption im CPC-Betrieb" VALUE 0x80065D80 Val_Wu8 255.0 OneToOne 0.00 255.0 FORMAT "%5.1" /end CHARACTERISTIC
/begin CHARACTERISTIC PCV_swtAdaptFlow_C "Schalter für die Freigabe der Durchflusswertberechnung" VALUE 0x80065D81 Val_Wu8 255.0 OneToOne 0.00 255.0 FORMAT "%5.1" /end CHARACTERISTIC
/begin CHARACTERISTIC PCV_swtAdaptRst_C "Schalter für das Zurücksetzen der Adaptionswerte" VALUE 0x80065D82 Val_Wu8 255.0 OneToOne 0.00 255.0 FORMAT "%5.1" /end CHARACTERISTIC
/begin CHARACTERISTIC PCV_swtAdapt_C "Schalter für die Freigabe der Adaptionswertberechnung" VALUE 0x80065D83 Val_Wu8 255.0 OneToOne 0.00 255.0 FORMAT "%5.1" /end CHARACTERISTIC
/begin CHARACTERISTIC PCV_swtClose_C "Schalter zur Wahl der Motorstarterkennung" VALUE 0x80065E60 Val_Wu8 1.000 OneToOne 0.00 1.000 FORMAT "%5.3" EXTENDED_LIMITS 0.00 255.0 /end CHARACTERISTIC
/begin CHARACTERISTIC PCV_tFuelAdaptMax_C "Maximale Kraftstofftemperatur, bis zu der die Adaption durchgeführt wird" VALUE 0x80065D84 Val_Ws16 140.0000 Temp_Cels -40.04000 99.96000 FORMAT "%8.4" EXTENDED_LIMITS -3549.940 3003.560 /end CHARACTERISTIC
/begin CHARACTERISTIC PCV_tFuelAdaptMin_C "Minimale Kraftstofftemperatur, ab der die Adaption durchgeführt wird" VALUE 0x80065D86 Val_Ws16 140.0000 Temp_Cels -40.04000 99.96000 FORMAT "%8.4" EXTENDED_LIMITS -3549.940 3003.560 /end CHARACTERISTIC
/begin CHARACTERISTIC PCV_tiAdaptMax_C "Maximale Zeitspanne, die zwischen zwei Adaptionsvorgängen ohne Absenkung der Raildruckschwelle vergehen darf" VALUE 0x80065D88 Val_Wu32 65000.0000000 TimeEngOn 0.00 65000.0000000 FORMAT "%13.7" EXTENDED_LIMITS 0.00 4294967295.00 /end CHARACTERISTIC
/begin CHARACTERISTIC PCV_tiCrntCtlInit_C "maximale Zeitdauer der Initialisierungsphase für den Stromregler" VALUE 0x80065E62 Val_Ws16 327670.0 Time_ms 0.00 327670.0 FORMAT "%8.1" EXTENDED_LIMITS -327680.0 327670.0 /end CHARACTERISTIC
/begin CHARACTERISTIC PCV_tiDurClose_C "Zeitdauer zum sicheren Schließen des Druckregelventils" VALUE 0x80065E64 Val_Wu16 100.0000 Time_ms 0.00 100.0000 FORMAT "%8.4" EXTENDED_LIMITS 0.00 655350.0 /end CHARACTERISTIC
/begin CHARACTERISTIC PCV_tiFlt1PT1_C "PT1 Filterzeitkonstante für Strom-Istwert" VALUE 0x80065E68 Val_Ws32 4294.9672940 TimeDelay_s 0.000002000000001 4294.9672960 FORMAT "%12.7" /end CHARACTERISTIC
/begin CHARACTERISTIC PCV_tiFlt2PT1_C "PT1 Filterzeitkonstante für Strom-Sollwert" VALUE 0x80065E6C Val_Ws32 4294.9672940 TimeDelay_s 0.000002000000001 4294.9672960 FORMAT "%12.7" /end CHARACTERISTIC
/begin CHARACTERISTIC PCV_tiFltPT1Init_C "maximaler Strom zum Schließen des Druckregelventils" VALUE 0x80065E70 Val_Ws32 4294.9672940 TimeDelay_s 0.000002000000001 4294.9672960 FORMAT "%12.7" /end CHARACTERISTIC
/begin CHARACTERISTIC PCV_tiSetCloseMax_C "maximale Verweilzeit im Zustand PCV_stActrCtl == PCV_CLOSE_MODE (0x20)" VALUE 0x80065E74 Val_Wu16 100.0000 Time_ms 0.00 100.0000 FORMAT "%8.4" EXTENDED_LIMITS 0.00 655350.0 /end CHARACTERISTIC
/begin CHARACTERISTIC PCV_tiTst_C "Zeitdauer des aktiven Endstufentests" VALUE 0x80065DD4 Val_Wu16 30000.00 Time_ms 0.00 30000.00 FORMAT "%8.2" EXTENDED_LIMITS 0.00 655350.0 /end CHARACTERISTIC
/begin CHARACTERISTIC PCV_tiWaitClose_C "Verzögerungszeit bis das Druckregelventil nach Erkennen von Motorstart geschlossen ist" VALUE 0x80065E76 Val_Wu16 100.0000 Time_ms 0.00 100.0000 FORMAT "%8.4" EXTENDED_LIMITS 0.00 655350.0 /end CHARACTERISTIC
/begin CHARACTERISTIC PCV_tSwtMeUn_C "Temperaturschwelle für die Freigabe der Botschaft PCV_stAdaptMeUn" VALUE 0x80065D8C Val_Ws16 140.0000 Temp_Cels -40.04000 99.96000 FORMAT "%8.4" EXTENDED_LIMITS -3549.940 3003.560 /end CHARACTERISTIC
/begin CHARACTERISTIC PCV_uBattHi_C "obere Abschaltschwelle für den reduzierten Maximalstrom" VALUE 0x80065E78 Val_Ws16 1310700. Volt_Batt -655360.0 655340.0 FORMAT "%8.1" /end CHARACTERISTIC
/begin CHARACTERISTIC PCV_uBattLo_C "untere Abschaltschwelle für den reduzierten Maximalstrom" VALUE 0x80065E7A Val_Ws16 1310700. Volt_Batt -655360.0 655340.0 FORMAT "%8.1" /end CHARACTERISTIC
/begin CHARACTERISTIC PFltLd_ctRgnSucMin_C "Minimale Anzahl erfolgreicher Regenerationen" VALUE 0x80065E98 Kw_Wu8 255.0 OneToOne 0.00 255.0 FORMAT "%5.1" /end CHARACTERISTIC
/begin CHARACTERISTIC PFltLd_DebSim.tiHiLo_C "Entprellzeit Umschaltung Messung-Simulation/" VALUE 0x80065E9A Kw_Ws16 655350.0 TimeDeb -327680.0 327670.0 FORMAT "%8.1" /end CHARACTERISTIC
/begin CHARACTERISTIC PFltLd_DebSim.tiLoHi_C "Entprellzeit Umschaltung Messung-Simulation/" VALUE 0x80065E9C Kw_Ws16 655350.0 TimeDeb -327680.0 327670.0 FORMAT "%8.1" /end CHARACTERISTIC
/begin CHARACTERISTIC PFltLd_dmSotSimRgnBas_CUR "Basiswert für produzierter Rußmassenstrom abhängig von aktueller Rußmasse" CURVE 0x80066C60 Cur_Xs16Ws16 327.0000 dmSoot_mg_p_s 0.00 327.0000 FORMAT "%8.4" EXTENDED_LIMITS -327.6800 327.6700
 /begin AXIS_DESCR STD_AXIS PFltLd_mSot mSoot_g 8 0.00 300.0000 FORMAT "%8.4" EXTENDED_LIMITS -327.6800 327.6700 DEPOSIT ABSOLUTE /end AXIS_DESCR
/end CHARACTERISTIC
/begin CHARACTERISTIC PFltLd_dpDiffMax_C "Schwelle für Druckdifferenzänderung über der auf Simulation geschaltet wird" VALUE 0x80065E9E Kw_Ws16 65535.00 dPres_hPa_p_s -32768.00 32767.00 FORMAT "%8.2" /end CHARACTERISTIC
/begin CHARACTERISTIC PFltLd_DT1Pres.T1_C "Parameter für Druckdifferenz DT1 Filter/" VALUE 0x80065EA0 Kw_Ws32 4294.9672940 TimeDelay_s 0.000002000000001 4294.9672960 FORMAT "%12.7" /end CHARACTERISTIC
/begin CHARACTERISTIC PFltLd_DT1Pres.Kd_C "Parameter für Druckdifferenz DT1 Filter/" VALUE 0x80065EA4 Kw_Ws32 32767.9999847 Kd 0.00 32767.9999847 FORMAT "%13.7" EXTENDED_LIMITS -32768.0000000 32767.9999847 /end CHARACTERISTIC
/begin CHARACTERISTIC PFltLd_dvolPFltMeasMin_C "Schwelle für Abgasstrom unter der auf Simulation geschaltet wird" VALUE 0x80065EA8 Kw_Ws16 3000.000 CubMtrPerHr 0.00 3000.000 FORMAT "%8.3" EXTENDED_LIMITS -3276.800 3276.700 /end CHARACTERISTIC
/begin CHARACTERISTIC PFltLd_facAshVolCor_MAP "Aschevolumen-abhängiger Korrekturfaktor des Differenzdrukkes" MAP 0x80066174 Kf_Xs16_Ys16_Ws16 1500.000 Fact4 0.00 1500.000 FORMAT "%8.3" EXTENDED_LIMITS -1638.400 1638.350
 /begin AXIS_DESCR STD_AXIS ASMod_dvolPFltEG AirVolPerTime 16 0.00 3000.000 FORMAT "%8.3" EXTENDED_LIMITS -3276.800 3276.700 DEPOSIT ABSOLUTE /end AXIS_DESCR
 /begin AXIS_DESCR STD_AXIS PFltLd_volAsh Vol 16 0.01000000 100.0000 FORMAT "%8.4" EXTENDED_LIMITS -327.6800 327.6700 DEPOSIT ABSOLUTE /end AXIS_DESCR
/end CHARACTERISTIC
/begin CHARACTERISTIC PFltLd_facCnvCatNO2_CUR "Faktor Temperaturabhängigkeit der Konvertierung von O zu NO2 des Oxi-Katalysators" CURVE 0x80066C82 Cur_Xs16Ws16 1.000000 Fact 0.00 1.000000 FORMAT "%8.6" EXTENDED_LIMITS -4.000000 3.999878
 /begin AXIS_DESCR STD_AXIS Exh_tAdapTOxiCatUs Temp_Cels 8 99.96000 799.9600 FORMAT "%8.4" EXTENDED_LIMITS -3549.940 3003.560 DEPOSIT ABSOLUTE /end AXIS_DESCR
/end CHARACTERISTIC
/begin CHARACTERISTIC PFltLd_facDynVsc_CUR "Kennlinie zur Berücksichtigung der dynamischen Viskosität" CURVE 0x800663B8 Kl_Xs16_Ws16 1.000000 Fact 0.00 1.000000 FORMAT "%8.6" EXTENDED_LIMITS -4.000000 3.999878
 /begin AXIS_DESCR STD_AXIS ASMod_tPFltSurfSim Temp_Cels 8 99.96000 799.9600 FORMAT "%8.4" EXTENDED_LIMITS -3549.940 3003.560 DEPOSIT ABSOLUTE /end AXIS_DESCR
/end CHARACTERISTIC
/begin CHARACTERISTIC PFltLd_facMaxOfsNO2_C "Faktor fuer maximal zulaessigen Russmassenoffsetwert aus NO2-Regeneration" VALUE 0x800663DA Kw_Ws16 1.000000 Fact 0.00 1.000000 FORMAT "%8.6" EXTENDED_LIMITS -4.000000 3.999878 /end CHARACTERISTIC
/begin CHARACTERISTIC PFltLd_facMaxOfsStrt_C "Faktor fuer maximal zulaessigen Russmassenoffsetwert aus Startoffsetkorrektur" VALUE 0x800663DC Kw_Ws16 1.000000 Fact 0.00 1.000000 FORMAT "%8.6" EXTENDED_LIMITS -4.000000 3.999878 /end CHARACTERISTIC
/begin CHARACTERISTIC PFltLd_facMltCor_CUR "Kennlinie zur Berücksichtigung der Aschenkorrektur" CURVE 0x80065EB8 Kl_Xs16_Ws16 1.000000 Fact 0.00 1.000000 FORMAT "%8.6" EXTENDED_LIMITS -4.000000 3.999878
 /begin AXIS_DESCR STD_AXIS PFltLd_volAsh_mp Vol 8 0.00 100.0000 FORMAT "%8.4" EXTENDED_LIMITS -327.6800 327.6700 DEPOSIT ABSOLUTE /end AXIS_DESCR
/end CHARACTERISTIC
/begin CHARACTERISTIC PFltLd_facNO2Sot_C "stöchiometrisches NO2/Ruß-Verhältnis" VALUE 0x80066CA4 Val_Ws16 11.00000 Fact1 4.000000 15.00000 FORMAT "%8.5" EXTENDED_LIMITS -256.0000 255.9922 /end CHARACTERISTIC
/begin CHARACTERISTIC PFltLd_facO2SimRgn_MAP "Kennfeld zur Berechnung des Korrekturfaktors für die thermische Rußabbrandsberechnung abhängig von Lambda- und sauerstoffmassenstromabhängigen" MAP 0x80066CA6 Map_Xs16Ys16Ws16 1.000000 Fact 0.00 1.000000 FORMAT "%8.6" EXTENDED_LIMITS -4.000000 3.999878
 /begin AXIS_DESCR STD_AXIS PFltLd_rLam_mp lambda 8 0.00 32.00000 FORMAT "%8.5" EXTENDED_LIMITS -32.76800 32.76700 DEPOSIT ABSOLUTE /end AXIS_DESCR
 /begin AXIS_DESCR STD_AXIS PFltLd_dmO2Aprx AirMassPerTime 8 0.00 50.00000 FORMAT "%8.5" EXTENDED_LIMITS -3276.800 3276.700 DEPOSIT ABSOLUTE /end AXIS_DESCR
/end CHARACTERISTIC
/begin CHARACTERISTIC PFltLd_facPOpOilAsh_MAP "Korrekturfaktor für Ölascheeintrag in den Partikelfilter aus der mittlere Motordrehzahl und der Einspritzmenge Sollwert ohne Mengenausgleichsregelung" MAP 0x80065EDA Kf_Xs16_Ys16_Ws16 3276.750 Fact4 -1638.400 1638.350 FORMAT "%8.3"
 /begin AXIS_DESCR STD_AXIS Epm_nEng EngN 16 0.00 6000.000 FORMAT "%8.3" EXTENDED_LIMITS -16384.00 16383.50 DEPOSIT ABSOLUTE /end AXIS_DESCR
 /begin AXIS_DESCR STD_AXIS InjCtl_qSetUnBal InjMass 16 0.00 327.6700 FORMAT "%8.4" EXTENDED_LIMITS -327.6800 327.6700 DEPOSIT ABSOLUTE /end AXIS_DESCR
/end CHARACTERISTIC
/begin CHARACTERISTIC PFltLd_facSotSimRgnNO2_CUR "Faktor für Beladungsabhängigkeit des NO2-Effektes" CURVE 0x80066D4A Cur_Xs16Ws16 1.000000 Fact 0.00 1.000000 FORMAT "%8.6" EXTENDED_LIMITS -4.000000 3.999878
 /begin AXIS_DESCR STD_AXIS PFltLd_mSot mSoot_g 8 0.00 300.0000 FORMAT "%8.4" EXTENDED_LIMITS -327.6800 327.6700 DEPOSIT ABSOLUTE /end AXIS_DESCR
/end CHARACTERISTIC
/begin CHARACTERISTIC PFltLd_facSumAdjMax_C "Minimun value for facPOpOilAshSumDIAG" VALUE 0x80066120 Kw_Ws32 214748364.750 Fact4 -107374182.400 107374182.350 FORMAT "%13.3" /end CHARACTERISTIC
/begin CHARACTERISTIC PFltLd_facTCorOfsNO2_CUR "Korrekturfaktor des Rußmassen-Offsets nach NO2-Regeneration Abhaengigkeit der Zeit seit Ende der NO2-Regeneration" CURVE 0x800663DE Kl_Xs16_Ws16 1.000000 Fact 0.00 1.000000 FORMAT "%8.6" EXTENDED_LIMITS -4.000000 3.999878
 /begin AXIS_DESCR STD_AXIS PFltLd_tiCorOfsNO2_mp TimeRed 8 -5242.880 5242.720 FORMAT "%8.3" DEPOSIT ABSOLUTE /end AXIS_DESCR
/end CHARACTERISTIC
/begin CHARACTERISTIC PFltLd_facTCorOfsStrt_CUR "Korrekturfaktor des Rußmassen-Startoffsets in Abhaengigkeit der Zeit seit Motorstart" CURVE 0x80066400 Kl_Xs16_Ws16 1.000000 Fact 0.00 1.000000 FORMAT "%8.6" EXTENDED_LIMITS -4.000000 3.999878
 /begin AXIS_DESCR STD_AXIS CoEng_tiNormalRed TimeRed 8 -5242.880 5242.720 FORMAT "%8.3" DEPOSIT ABSOLUTE /end AXIS_DESCR
/end CHARACTERISTIC
/begin CHARACTERISTIC PFltLd_facTempNO2_CUR "Faktor für Temperaturabhängigkeit NO2-Effekt" CURVE 0x80066D6C Cur_Xs16Ws16 1.000000 Fact 0.00 1.000000 FORMAT "%8.6" EXTENDED_LIMITS -4.000000 3.999878
 /begin AXIS_DESCR STD_AXIS ASMod_tPFltSurfSim Temp_Cels 8 99.96000 799.9600 FORMAT "%8.4" EXTENDED_LIMITS -3549.940 3003.560 DEPOSIT ABSOLUTE /end AXIS_DESCR
/end CHARACTERISTIC
/begin CHARACTERISTIC PFltLd_facTempSimRgn_CUR "Einfluß der Temperatur auf regenerierte Partikelmasse" CURVE 0x80066D8E Cur_Xs16Ws16 1.000000 Fact 0.00 1.000000 FORMAT "%8.6" EXTENDED_LIMITS -4.000000 3.999878
 /begin AXIS_DESCR STD_AXIS ASMod_tPFltSurfSim Temp_Cels 4 222.9600 1272.960 FORMAT "%8.3" EXTENDED_LIMITS -3549.940 3003.560 DEPOSIT ABSOLUTE /end AXIS_DESCR
/end CHARACTERISTIC
/begin CHARACTERISTIC PFltLd_facVolFlwNO2_CUR "Korrekturfaktor der NOx/ NO2-Umwandlung in Abhängigkeit der Verweildauer des Abgases im Oxidationskatalysator" CURVE 0x80066DA0 Cur_Xs16Ws16 1.000000 Fact 0.00 1.000000 FORMAT "%8.6" EXTENDED_LIMITS -4.000000 3.999878
 /begin AXIS_DESCR STD_AXIS ASMod_dvolPFltEG AirVolPerTime 8 0.00 3000.000 FORMAT "%8.3" EXTENDED_LIMITS -3276.800 3276.700 DEPOSIT ABSOLUTE /end AXIS_DESCR
/end CHARACTERISTIC
/begin CHARACTERISTIC PFltLd_kiMSotRes_C "Integrationsfaktor für Abschätzung der Restrußmasse im Partikelfilter nach erfolgreicher Regeneration" VALUE 0x80066DC2 Val_Ws16 49.00000 KiRmnSotMs 0.00 49.00000 FORMAT "%8.5" EXTENDED_LIMITS -16384.00 16383.50 /end CHARACTERISTIC
/begin CHARACTERISTIC PFltLd_mOilAshEGSubs_C "Ersatzwert für PFltLd_mOilAshEG_mp falls EEPROM-Fehler" VALUE 0x80066124 Kw_Ws16 300.0000 mOilAsh_g 0.00 300.0000 FORMAT "%8.4" EXTENDED_LIMITS -327.6800 327.6700 /end CHARACTERISTIC
/begin CHARACTERISTIC PFltLd_mSotMeas_MAP "Umrechnung Strömungswiderstand Partikelmasse" MAP 0x80066422 Kf_Xs16_Ys16_Ws16 300.0000 mSoot_g 0.00 300.0000 FORMAT "%8.4" EXTENDED_LIMITS -327.6800 327.6700
 /begin AXIS_DESCR STD_AXIS PFltLd_resFlwFlt Res_hPaHrPerCM 16 0.00 2.500000 FORMAT "%8.6" EXTENDED_LIMITS -3.276800 3.276700 DEPOSIT ABSOLUTE /end AXIS_DESCR
 /begin AXIS_DESCR STD_AXIS PFltLd_dvolPFltEGFlt_mp CubMtrPerHr 16 0.00 3000.000 FORMAT "%8.3" EXTENDED_LIMITS -3276.800 3276.700 DEPOSIT ABSOLUTE /end AXIS_DESCR
/end CHARACTERISTIC
/begin CHARACTERISTIC PFltLd_mSotResAftRgn_CA "Restrussmasse im Partikelfilter nach Regeneration" VAL_BLK 0x80066DC4 ValA_Ws16 300.0000 mSoot_g 0.00 300.0000 FORMAT "%8.4" EXTENDED_LIMITS -327.6800 327.6700 NUMBER 12 /end CHARACTERISTIC
/begin CHARACTERISTIC PFltLd_mSotResAftRgn_MAP "Restrussmasse im Partikelfilter abhängig von Motordrezahl und Einspritzmenge-Sollwert" MAP 0x80066DDC Map_Xs16Ys16Ws16 300.0000 mSoot_g 0.00 300.0000 FORMAT "%8.4" EXTENDED_LIMITS -327.6800 327.6700
 /begin AXIS_DESCR STD_AXIS Epm_nEng EngN 8 40.00000 6000.000 FORMAT "%8.3" EXTENDED_LIMITS -16384.00 16383.50 DEPOSIT ABSOLUTE /end AXIS_DESCR
 /begin AXIS_DESCR STD_AXIS InjCtl_qSetUnBal InjMass 8 0.00 327.6700 FORMAT "%8.4" EXTENDED_LIMITS -327.6800 327.6700 DEPOSIT ABSOLUTE /end AXIS_DESCR
/end CHARACTERISTIC
/begin CHARACTERISTIC PFltLd_mSotSimMax_C "Maximum value for a simulated particle mass" VALUE 0x80066E80 Val_Ws16 300.0000 mSoot_g 0.00 300.0000 FORMAT "%8.4" EXTENDED_LIMITS -327.6800 327.6700 /end CHARACTERISTIC
/begin CHARACTERISTIC PFltLd_mSotSimNoContSubs_C "Ersatzwert der nicht kontinuierlich simulierten Partikelmasse im Fall eines EEPROM Fehlers" VALUE 0x80066E82 Val_Ws16 300.0000 mSoot_g 0.00 300.0000 FORMAT "%8.4" EXTENDED_LIMITS -327.6800 327.6700 /end CHARACTERISTIC
/begin CHARACTERISTIC PFltLd_nFlwRstnSimMin_C "Minimale Drehzahl zur Freigabe der Berechnung des Strömungswiderstandes anhand von Differenzdruck und Abgasvolumenstrom" VALUE 0x80066666 Kw_Ws16 1500.000 EngN 0.00 1500.000 FORMAT "%8.3" EXTENDED_LIMITS -16384.00 16383.50 /end CHARACTERISTIC
/begin CHARACTERISTIC PFltLd_numLSU_C "Array - Index für die Lambdasensor Konfiguration" VALUE 0x80066E84 Val_Wu8 2.000 OneToOne 0.00 2.000 FORMAT "%5.3" EXTENDED_LIMITS 0.00 255.0 /end CHARACTERISTIC
/begin CHARACTERISTIC PFltLd_numRatO2_C "Index zur Auswahl des Sauerstoff-Anteils nach Abgaskrümmer im Array ASMod_rO2EGFld" VALUE 0x80066E85 Val_Wu8 16.00 OneToOne 0.00 16.00 FORMAT "%5.2" EXTENDED_LIMITS 0.00 255.0 /end CHARACTERISTIC
/begin CHARACTERISTIC PFltLd_numValAvrgOfsNO2_C "Anzahl der Mittelungszyklen für Rußmassenoffset-Berechnung bei NO2-Regeneration" VALUE 0x80066668 Kw_Ws16 10000.00 OneToOne 0.00 10000.00 FORMAT "%8.2" EXTENDED_LIMITS -32768.00 32767.00 /end CHARACTERISTIC
/begin CHARACTERISTIC PFltLd_numValAvrgOfsStrt_C "Anzahl der Mittelungszyklen für Rußmassenoffset-Berechnung bei Motorstart" VALUE 0x8006666A Kw_Ws16 10000.00 OneToOne 0.00 10000.00 FORMAT "%8.2" EXTENDED_LIMITS -32768.00 32767.00 /end CHARACTERISTIC
/begin CHARACTERISTIC PFltLd_pDiffPFlt_MAP "Differenzdruck des leeren Partikelfilters" MAP 0x8006666C Kf_Xs16_Ys16_Ws16 3500.000 Pres_hPa 0.00 3500.000 FORMAT "%8.3" EXTENDED_LIMITS -32768.00 32767.00
 /begin AXIS_DESCR STD_AXIS ASMod_tPFltSurfSim Temp_Cels 16 49.96000 1399.960 FORMAT "%8.3" EXTENDED_LIMITS -3549.940 3003.560 DEPOSIT ABSOLUTE /end AXIS_DESCR
 /begin AXIS_DESCR STD_AXIS ASMod_dvolPFltEG AirVolPerTime 16 0.00 3000.000 FORMAT "%8.3" EXTENDED_LIMITS -3276.800 3276.700 DEPOSIT ABSOLUTE /end AXIS_DESCR
/end CHARACTERISTIC
/begin CHARACTERISTIC PFltLd_resFlwMeasInv_MAP "Inverse Strömungswiderstandskennfeld" MAP 0x800668B0 Kf_Xs16_Ys16_Ws16 2.500000 Res_hPaHrPerCM 0.00 2.500000 FORMAT "%8.6" EXTENDED_LIMITS -3.276800 3.276700
 /begin AXIS_DESCR STD_AXIS PFltLd_mSotCrv_mp mSoot_g 16 0.00 300.0000 FORMAT "%8.4" EXTENDED_LIMITS -327.6800 327.6700 DEPOSIT ABSOLUTE /end AXIS_DESCR
 /begin AXIS_DESCR STD_AXIS PFltLd_dvolPFltEGFlt_mp CubMtrPerHr 16 0.00 3000.000 FORMAT "%8.3" EXTENDED_LIMITS -3276.800 3276.700 DEPOSIT ABSOLUTE /end AXIS_DESCR
/end CHARACTERISTIC
/begin CHARACTERISTIC PFltLd_resFlwOfs_MAP "Kennfeld Strömungswiderstandoffset durch Asche im Partikelfilter" MAP 0x80066AF4 Kf_Xs16_Ys16_Ws16 2.500000 Res_hPaHrPerCM 0.00 2.500000 FORMAT "%8.6" EXTENDED_LIMITS -3.276800 3.276700
 /begin AXIS_DESCR STD_AXIS ASMod_dvolPFltEG AirVolPerTime 8 0.00 3000.000 FORMAT "%8.3" EXTENDED_LIMITS -3276.800 3276.700 DEPOSIT ABSOLUTE /end AXIS_DESCR
 /begin AXIS_DESCR STD_AXIS PFltLd_volAsh Vol 8 0.00 100.0000 FORMAT "%8.4" EXTENDED_LIMITS -327.6800 327.6700 DEPOSIT ABSOLUTE /end AXIS_DESCR
/end CHARACTERISTIC
/begin CHARACTERISTIC PFltLd_resFlwPhysMax_C "Maximale Begrenzung des Strömungswiderstandes" VALUE 0x80066B98 Kw_Ws16 2.500000 Res_hPaHrPerCM 0.00 2.500000 FORMAT "%8.6" EXTENDED_LIMITS -3.276800 3.276700 /end CHARACTERISTIC
/begin CHARACTERISTIC PFltLd_resFlwPhysMin_C "Minimale Begrenzung des Strömungswiderstandes" VALUE 0x80066B9A Kw_Ws16 2.500000 Res_hPaHrPerCM 0.00 2.500000 FORMAT "%8.6" EXTENDED_LIMITS -3.276800 3.276700 /end CHARACTERISTIC
/begin CHARACTERISTIC PFltLd_resFlw_MAP "Strömungswiderstand als Funktion von Abgasvolumsstrom und Differenzdruck" MAP 0x80066B9C Kf_Xs16_Ys16_Ws16 2.500000 Res_hPaHrPerCM 0.00 2.500000 FORMAT "%8.6" EXTENDED_LIMITS -3.276800 3.276700
 /begin AXIS_DESCR STD_AXIS ASMod_dvolPFltEG AirVolPerTime 8 0.00 3000.000 FORMAT "%8.3" EXTENDED_LIMITS -3276.800 3276.700 DEPOSIT ABSOLUTE /end AXIS_DESCR
 /begin AXIS_DESCR STD_AXIS PFltLd_pDiffSot_mp Pres_hPa 8 0.00 3500.000 FORMAT "%8.3" EXTENDED_LIMITS -32768.00 32767.00 DEPOSIT ABSOLUTE /end AXIS_DESCR
/end CHARACTERISTIC
/begin CHARACTERISTIC PFltLd_rhoOilAsh_C "Dichte der Öl-Asche" VALUE 0x80066126 Kw_Ws16 2000.000 rhoOilAsh_g_p_l 0.00 2000.000 FORMAT "%8.3" EXTENDED_LIMITS -3276.800 3276.700 /end CHARACTERISTIC
/begin CHARACTERISTIC PFltLd_rStoich_C "Stöchiometrisches Luft-Kraftstoff-Verhältnis" VALUE 0x80066E86 Val_Ws16 327.6750 AirFlRat -163.8400 163.8350 FORMAT "%8.4" /end CHARACTERISTIC
/begin CHARACTERISTIC PFltLd_stEngPOpSpoRgn_C "Status für Erkennung einer spontanen Regeneration" VALUE 0x80066E88 Val_Wu8 11.00 OneToOne 0.00 11.00 FORMAT "%5.2" EXTENDED_LIMITS 0.00 255.0 /end CHARACTERISTIC
/begin CHARACTERISTIC PFltLd_stFlwRstnPT1RgnMsk_C "Mask für Bestimmung Regenerationsrelevante Zustand" VALUE 0x80066C40 Kw_Wu32 4294967295.00 OneToOne 0.00 4294967295.00 FORMAT "%13.2" /end CHARACTERISTIC
/begin CHARACTERISTIC PFltLd_stMskRgnActv_CA "Masken-Array zur Auswahl der Betriebsarten, in denen auf Simulation der Partikelmasse umgeschaltet wird" VAL_BLK 0x80065EAC Kwb_Wu32 4294967295.00 OneToOne 0.00 4294967295.00 FORMAT "%13.2" NUMBER 2 /end CHARACTERISTIC
/begin CHARACTERISTIC PFltLd_stMsSotResRgnMsk_C "Maske zur Auswahl der Betriebsarten, in denen die Restrußmasse im Partikelfilter gemittelt wird" VALUE 0x80066E8C Val_Wu32 4294967295.00 OneToOne 0.00 4294967295.00 FORMAT "%13.2" /end CHARACTERISTIC
/begin CHARACTERISTIC PFltLd_swtMsSotResIniOn_C "Schalter zum Aktivieren der Restrußmasseinitialisierung von der Rußmassesimulation nach erfolgreichen Regeneration" VALUE 0x80066E90 Val_Wu8 1.000 OneToOne 0.00 1.000 FORMAT "%5.3" EXTENDED_LIMITS 0.00 255.0 /end CHARACTERISTIC
/begin CHARACTERISTIC PFltLd_swtMsSotRes_C "Schalter zur Auswahl der Abschätzung der Restrussmasse im Partikelfilter nach erfolgreicher Regeneration" VALUE 0x80066E91 Val_Wu8 1.000 OneToOne 0.00 1.000 FORMAT "%5.3" EXTENDED_LIMITS 0.00 255.0 /end CHARACTERISTIC
/begin CHARACTERISTIC PFltLd_swtOilAsh_C "Auswahlschalter für Korrelationsmethode des Ölasche-Eintrages in den Partikelfilter" VALUE 0x80066128 Kw_Wu8 1.000 OneToOne 0.00 1.000 FORMAT "%5.3" EXTENDED_LIMITS 0.00 255.0 /end CHARACTERISTIC
/begin CHARACTERISTIC PFltLd_swtSensEvalSel_C "Auswahlschalter für Methode der Sensorauswertung" VALUE 0x80066C44 Kw_Wu8 1.000 OneToOne 0.00 1.000 FORMAT "%5.3" EXTENDED_LIMITS 0.00 255.0 /end CHARACTERISTIC
/begin CHARACTERISTIC PFltLd_swtSimRgnNO2Off_C "Schalter zum Deaktivieren des NO2- Effektbetrachtung" VALUE 0x80066E92 Val_Wu8 1.000 OneToOne 0.00 1.000 FORMAT "%5.3" EXTENDED_LIMITS 0.00 255.0 /end CHARACTERISTIC
/begin CHARACTERISTIC PFltLd_swtSotCalcInitOff_C "Schalter zur Deaktivierung der Initialisierung des PT1-Filters für den Strömungswiderstand" VALUE 0x80066C45 Kw_Wu8 1.000 OneToOne 0.00 1.000 FORMAT "%5.3" EXTENDED_LIMITS 0.00 255.0 /end CHARACTERISTIC
/begin CHARACTERISTIC PFltLd_swtSotSim_C "Schalter zur Auswahl der simulierten Rußmasse für Rußmassenberechnung im Partikelfilter" VALUE 0x80066E93 Val_Wu8 2.000 OneToOne 0.00 2.000 FORMAT "%5.3" EXTENDED_LIMITS 0.00 255.0 /end CHARACTERISTIC
/begin CHARACTERISTIC PFltLd_tiFlwRstnPT1_C "Zeitkonstante für Strömungswiderstand" VALUE 0x80066C48 Kw_Ws32 4294.9672940 TimeDelay_s 0.000002000000001 4294.9672960 FORMAT "%12.7" /end CHARACTERISTIC
/begin CHARACTERISTIC PFltLd_tiFlwRstnRgnPT1_C "Zeitkonstant des PT1-Filters für den Stömungswiederstand in Regenerationsbetrieb" VALUE 0x80066C4C Kw_Ws32 4294.9672940 TimeDelay_s 0.000002000000001 4294.9672960 FORMAT "%12.7" /end CHARACTERISTIC
/begin CHARACTERISTIC PFltLd_tiMaxOfsNO2_C "Maximaler Mittelungszeit für die Berechnung des Rußmassenoffsetwerts bei NO2-Regeneration" VALUE 0x80066C50 Kw_Ws16 3600.000 TimeRed 0.00 3600.000 FORMAT "%8.3" EXTENDED_LIMITS -5242.880 5242.720 /end CHARACTERISTIC
/begin CHARACTERISTIC PFltLd_tiMaxOfsStrt_C "Maximaler Mittelungszeit für die Berechnung des Rußmassenoffsetwerts bei Motorstart" VALUE 0x80066C52 Kw_Ws16 3600.000 TimeRed 0.00 3600.000 FORMAT "%8.3" EXTENDED_LIMITS -5242.880 5242.720 /end CHARACTERISTIC
/begin CHARACTERISTIC PFltLd_tiNO2RgnDel_MAP "Verzugszeit der NO2-Regeneration" MAP 0x80066E94 Map_Xs16Ys16Ws16 32767.00 Time_s 0.00 32767.00 FORMAT "%8.2" EXTENDED_LIMITS -327.6800 327.6700
 /begin AXIS_DESCR STD_AXIS Epm_nEng EngN 8 40.00000 6000.000 FORMAT "%8.3" EXTENDED_LIMITS -16384.00 16383.50 DEPOSIT ABSOLUTE /end AXIS_DESCR
 /begin AXIS_DESCR STD_AXIS InjCtl_qSetUnBal InjMass 8 0.00 327.6700 FORMAT "%8.4" EXTENDED_LIMITS -327.6800 327.6700 DEPOSIT ABSOLUTE /end AXIS_DESCR
/end CHARACTERISTIC
/begin CHARACTERISTIC PFltLd_tiOfsNO2Del_C "Minimale Gültigkeitszeit der Rußmassenberechnung zur Freigabe der Mittelwertbildung des Rußmassenoffsets bei NO2-Regeneration" VALUE 0x80066C54 Kw_Ws16 3600.000 Time_ms 0.00 3600.000 FORMAT "%8.3" EXTENDED_LIMITS -327680.0 327670.0 /end CHARACTERISTIC
/begin CHARACTERISTIC PFltLd_tiOfsStrtDel_C "Minimale Gültigkeitszeit der Rußmassenberechnung zur Freigabe der Mittelwertbildung des Rußmassenoffsets bei Motorstart" VALUE 0x80066C56 Kw_Ws16 3600.000 Time_ms 0.00 3600.000 FORMAT "%8.3" EXTENDED_LIMITS -327680.0 327670.0 /end CHARACTERISTIC
/begin CHARACTERISTIC PFltLd_tiOpAdjMax_C "Minimun value for tiOpPFltDIAG" VALUE 0x8006612C Kw_Ws32 4294967295.00 TimeEngOn -2147483648.00 2147483647.00 FORMAT "%13.2" /end CHARACTERISTIC
/begin CHARACTERISTIC PFltLd_tiVolFlwPT1_C "Zeitkonstant des PT1-Filers für Abgasvolumenstom" VALUE 0x80066C58 Kw_Ws32 4294.9672940 TimeDelay_s 0.000002000000001 4294.9672960 FORMAT "%12.7" /end CHARACTERISTIC
/begin CHARACTERISTIC PFltLd_tiVolFlwRgnPT1_C "Zeitkonstant des PT1-Filers für Abgasvolumenstom in Regeneration" VALUE 0x80066C5C Kw_Ws32 4294.9672940 TimeDelay_s 0.000002000000001 4294.9672960 FORMAT "%12.7" /end CHARACTERISTIC
/begin CHARACTERISTIC PFltLd_volOilAshTiEngOn_CUR "Kennlinie zur Umrechnung der Betriebsdauer in Ölaschenvolumen im Partikelfilter" CURVE 0x80066130 Kl_Xs16_Ws16 100.0000 Vol 0.00 100.0000 FORMAT "%8.4" EXTENDED_LIMITS -327.6800 327.6700
 /begin AXIS_DESCR STD_AXIS PFltLd_tiOpPFlt_mp Time_Hr 16 0.00 16383.00 FORMAT "%8.2" EXTENDED_LIMITS -16384.00 16383.50 DEPOSIT ABSOLUTE /end AXIS_DESCR
/end CHARACTERISTIC
/begin CHARACTERISTIC PFltLd_volPFlt_C "Volumen des Partikel Filters" VALUE 0x80065EB4 Kw_Ws16 99.99000 Vol 0.01000000 100.0000 FORMAT "%8.4" EXTENDED_LIMITS -327.6800 327.6700 /end CHARACTERISTIC
/begin CHARACTERISTIC PFltLmp_DigOut.tiBtwTstSCB_C "/" VALUE 0x80066F38 Kw_Ws16 1000.000 Time_ms 0.00 1000.000 FORMAT "%8.3" EXTENDED_LIMITS -327680.0 327670.0 /end CHARACTERISTIC
/begin CHARACTERISTIC PFltLmp_DigOut.tiBtwTstOT_C "/" VALUE 0x80066F3A Kw_Ws16 1000.000 Time_s 0.00 1000.000 FORMAT "%8.3" EXTENDED_LIMITS -327.6800 327.6700 /end CHARACTERISTIC
/begin CHARACTERISTIC PFltLmp_DigOut.numTstMax_C "/" VALUE 0x80066F3C Kw_Wu16 65535.00 OneToOne 0.00 65535.00 FORMAT "%8.2" /end CHARACTERISTIC
/begin CHARACTERISTIC PFltLmp_stPsDiaDisbl_C "" VALUE 0x80066F3E Val_Wu8 255.0 OneToOne 0.00 255.0 FORMAT "%5.1" /end CHARACTERISTIC
/begin CHARACTERISTIC PFltLmp_stPsDisbl_C "" VALUE 0x80066F3F Val_Wu8 255.0 OneToOne 0.00 255.0 FORMAT "%5.1" /end CHARACTERISTIC
/begin CHARACTERISTIC PFltPOp_DebBrk.tiHiLo_C "Entprellzeit für Bremssignal/" VALUE 0x800673F8 Kw_Ws16 3000.000 TimeDeb 0.00 3000.000 FORMAT "%8.3" EXTENDED_LIMITS -327680.0 327670.0 /end CHARACTERISTIC
/begin CHARACTERISTIC PFltPOp_DebBrk.tiLoHi_C "Entprellzeit für Bremssignal/" VALUE 0x800673FA Kw_Ws16 3000.000 TimeDeb 0.00 3000.000 FORMAT "%8.3" EXTENDED_LIMITS -327680.0 327670.0 /end CHARACTERISTIC
/begin CHARACTERISTIC PFltPOp_DebClth.tiHiLo_C "Entprellzeit für Kupplungssignal/" VALUE 0x800673FC Kw_Ws16 3000.000 TimeDeb 0.00 3000.000 FORMAT "%8.3" EXTENDED_LIMITS -327680.0 327670.0 /end CHARACTERISTIC
/begin CHARACTERISTIC PFltPOp_DebClth.tiLoHi_C "Entprellzeit für Kupplungssignal/" VALUE 0x800673FE Kw_Ws16 3000.000 TimeDeb 0.00 3000.000 FORMAT "%8.3" EXTENDED_LIMITS -327680.0 327670.0 /end CHARACTERISTIC
/begin CHARACTERISTIC PFltPOp_DebGear.tiHiLo_C "Entprellzeit für Gangsignal/" VALUE 0x80067400 Kw_Ws16 3000.000 TimeDeb 0.00 3000.000 FORMAT "%8.3" EXTENDED_LIMITS -327680.0 327670.0 /end CHARACTERISTIC
/begin CHARACTERISTIC PFltPOp_DebGear.tiLoHi_C "Entprellzeit für Gangsignal/" VALUE 0x80067402 Kw_Ws16 3000.000 TimeDeb 0.00 3000.000 FORMAT "%8.3" EXTENDED_LIMITS -327680.0 327670.0 /end CHARACTERISTIC
/begin CHARACTERISTIC PFltPOp_nEng_CA "Matrix zur Bestimmung der Bereichsgrenzen für die gefilterte mittlere Drehzahl" MAP 0x80066F40 Kf_Xs16_Ys16_Ws16 32767.50 EngN -16384.00 16383.50 FORMAT "%8.2"
 /begin AXIS_DESCR STD_AXIS PFltPOp_RngIdx_X_mp OneToOne 11 0.00 255.0 FORMAT "%5.1" DEPOSIT ABSOLUTE /end AXIS_DESCR
 /begin AXIS_DESCR STD_AXIS PFltPOp_RngIdx_Y_mp OneToOne 2 0.00 255.0 FORMAT "%5.1" DEPOSIT ABSOLUTE /end AXIS_DESCR
/end CHARACTERISTIC
/begin CHARACTERISTIC PFltPOp_numAir_C "Pointer zu Motortemperaturfeld" VALUE 0x80066F8A Kw_Wu8 2.00000000000 IndSysTempFldSel 0.00 2.00000000000 FORMAT "%13.11" /end CHARACTERISTIC
/begin CHARACTERISTIC PFltPOp_numEngTemp_C "Pointer zum Ansauglufttemperaturfeld" VALUE 0x80067404 Val_Wu8 2.00000000000 EngTempFldSel 0.00 2.00000000000 FORMAT "%13.11" /end CHARACTERISTIC
/begin CHARACTERISTIC PFltPOp_qSetUnBalRng10Max_GCUR "Obere Schwellen-Kraftstoffmengenkennlinie für Bereich 10" CURVE 0x80066F8C Gkl_Ws16 655.3500 InjMass -327.6800 327.6700 FORMAT "%8.4"
 /begin AXIS_DESCR COM_AXIS PFltPOp_nEngFlt EngN 8 -16384.00 16383.50 FORMAT "%8.2" AXIS_PTS_REF PFltPOp_qSetUnBal_AXIS /end AXIS_DESCR
/end CHARACTERISTIC
/begin CHARACTERISTIC PFltPOp_qSetUnBalRng10Min_GCUR "Untere Schwellen-Kraftstoffmengenkennlinie für Bereich 10" CURVE 0x80066F9C Gkl_Ws16 655.3500 InjMass -327.6800 327.6700 FORMAT "%8.4"
 /begin AXIS_DESCR COM_AXIS PFltPOp_nEngFlt EngN 8 -16384.00 16383.50 FORMAT "%8.2" AXIS_PTS_REF PFltPOp_qSetUnBal_AXIS /end AXIS_DESCR
/end CHARACTERISTIC
/begin CHARACTERISTIC PFltPOp_qSetUnBalRng1Max_GCUR "Obere Schwellen-Kraftstoffmengenkennlinie für Bereich 1" CURVE 0x80066FAC Gkl_Ws16 655.3500 InjMass -327.6800 327.6700 FORMAT "%8.4"
 /begin AXIS_DESCR COM_AXIS PFltPOp_nEngFlt EngN 8 -16384.00 16383.50 FORMAT "%8.2" AXIS_PTS_REF PFltPOp_qSetUnBal_AXIS /end AXIS_DESCR
/end CHARACTERISTIC
/begin CHARACTERISTIC PFltPOp_qSetUnBalRng1Min_GCUR "Untere Schwellen-Kraftstoffmengenkennlinie für Bereich 1" CURVE 0x80066FBC Gkl_Ws16 655.3500 InjMass -327.6800 327.6700 FORMAT "%8.4"
 /begin AXIS_DESCR COM_AXIS PFltPOp_nEngFlt EngN 8 -16384.00 16383.50 FORMAT "%8.2" AXIS_PTS_REF PFltPOp_qSetUnBal_AXIS /end AXIS_DESCR
/end CHARACTERISTIC
/begin CHARACTERISTIC PFltPOp_qSetUnBalRng2Max_GCUR "Obere Schwellen-Kraftstoffmengenkennlinie für Bereich 2" CURVE 0x80066FCC Gkl_Ws16 655.3500 InjMass -327.6800 327.6700 FORMAT "%8.4"
 /begin AXIS_DESCR COM_AXIS PFltPOp_nEngFlt EngN 8 -16384.00 16383.50 FORMAT "%8.2" AXIS_PTS_REF PFltPOp_qSetUnBal_AXIS /end AXIS_DESCR
/end CHARACTERISTIC
/begin CHARACTERISTIC PFltPOp_qSetUnBalRng2Min_GCUR "Untere Schwellen-Kraftstoffmengenkennlinie für Bereich 2" CURVE 0x80066FDC Gkl_Ws16 655.3500 InjMass -327.6800 327.6700 FORMAT "%8.4"
 /begin AXIS_DESCR COM_AXIS PFltPOp_nEngFlt EngN 8 -16384.00 16383.50 FORMAT "%8.2" AXIS_PTS_REF PFltPOp_qSetUnBal_AXIS /end AXIS_DESCR
/end CHARACTERISTIC
/begin CHARACTERISTIC PFltPOp_qSetUnBalRng3Max_GCUR "Obere Schwellen-Kraftstoffmengenkennlinie für Bereich 3" CURVE 0x80066FEC Gkl_Ws16 655.3500 InjMass -327.6800 327.6700 FORMAT "%8.4"
 /begin AXIS_DESCR COM_AXIS PFltPOp_nEngFlt EngN 8 -16384.00 16383.50 FORMAT "%8.2" AXIS_PTS_REF PFltPOp_qSetUnBal_AXIS /end AXIS_DESCR
/end CHARACTERISTIC
/begin CHARACTERISTIC PFltPOp_qSetUnBalRng3Min_GCUR "Untere Schwellen-Kraftstoffmengenkennlinie für Bereich 3" CURVE 0x80066FFC Gkl_Ws16 655.3500 InjMass -327.6800 327.6700 FORMAT "%8.4"
 /begin AXIS_DESCR COM_AXIS PFltPOp_nEngFlt EngN 8 -16384.00 16383.50 FORMAT "%8.2" AXIS_PTS_REF PFltPOp_qSetUnBal_AXIS /end AXIS_DESCR
/end CHARACTERISTIC
/begin CHARACTERISTIC PFltPOp_qSetUnBalRng4Max_GCUR "Obere Schwellen-Kraftstoffmengenkennlinie für Bereich 4" CURVE 0x8006700C Gkl_Ws16 655.3500 InjMass -327.6800 327.6700 FORMAT "%8.4"
 /begin AXIS_DESCR COM_AXIS PFltPOp_nEngFlt EngN 8 -16384.00 16383.50 FORMAT "%8.2" AXIS_PTS_REF PFltPOp_qSetUnBal_AXIS /end AXIS_DESCR
/end CHARACTERISTIC
/begin CHARACTERISTIC PFltPOp_qSetUnBalRng4Min_GCUR "Untere Schwellen-Kraftstoffmengenkennlinie für Bereich 4" CURVE 0x8006701C Gkl_Ws16 655.3500 InjMass -327.6800 327.6700 FORMAT "%8.4"
 /begin AXIS_DESCR COM_AXIS PFltPOp_nEngFlt EngN 8 -16384.00 16383.50 FORMAT "%8.2" AXIS_PTS_REF PFltPOp_qSetUnBal_AXIS /end AXIS_DESCR
/end CHARACTERISTIC
/begin CHARACTERISTIC PFltPOp_qSetUnBalRng5Max_GCUR "Obere Schwellen-Kraftstoffmengenkennlinie für Bereich 5" CURVE 0x8006702C Gkl_Ws16 655.3500 InjMass -327.6800 327.6700 FORMAT "%8.4"
 /begin AXIS_DESCR COM_AXIS PFltPOp_nEngFlt EngN 8 -16384.00 16383.50 FORMAT "%8.2" AXIS_PTS_REF PFltPOp_qSetUnBal_AXIS /end AXIS_DESCR
/end CHARACTERISTIC
/begin CHARACTERISTIC PFltPOp_qSetUnBalRng5Min_GCUR "Untere Schwellen-Kraftstoffmengenkennlinie für Bereich 5" CURVE 0x8006703C Gkl_Ws16 655.3500 InjMass -327.6800 327.6700 FORMAT "%8.4"
 /begin AXIS_DESCR COM_AXIS PFltPOp_nEngFlt EngN 8 -16384.00 16383.50 FORMAT "%8.2" AXIS_PTS_REF PFltPOp_qSetUnBal_AXIS /end AXIS_DESCR
/end CHARACTERISTIC
/begin CHARACTERISTIC PFltPOp_qSetUnBalRng6Max_GCUR "Obere Schwellen-Kraftstoffmengenkennlinie für Bereich 6" CURVE 0x8006704C Gkl_Ws16 655.3500 InjMass -327.6800 327.6700 FORMAT "%8.4"
 /begin AXIS_DESCR COM_AXIS PFltPOp_nEngFlt EngN 8 -16384.00 16383.50 FORMAT "%8.2" AXIS_PTS_REF PFltPOp_qSetUnBal_AXIS /end AXIS_DESCR
/end CHARACTERISTIC
/begin CHARACTERISTIC PFltPOp_qSetUnBalRng6Min_GCUR "Untere Schwellen-Kraftstoffmengenkennlinie für Bereich 6" CURVE 0x8006705C Gkl_Ws16 655.3500 InjMass -327.6800 327.6700 FORMAT "%8.4"
 /begin AXIS_DESCR COM_AXIS PFltPOp_nEngFlt EngN 8 -16384.00 16383.50 FORMAT "%8.2" AXIS_PTS_REF PFltPOp_qSetUnBal_AXIS /end AXIS_DESCR
/end CHARACTERISTIC
/begin CHARACTERISTIC PFltPOp_qSetUnBalRng7Max_GCUR "Obere Schwellen-Kraftstoffmengenkennlinie für Bereich 7" CURVE 0x8006706C Gkl_Ws16 655.3500 InjMass -327.6800 327.6700 FORMAT "%8.4"
 /begin AXIS_DESCR COM_AXIS PFltPOp_nEngFlt EngN 8 -16384.00 16383.50 FORMAT "%8.2" AXIS_PTS_REF PFltPOp_qSetUnBal_AXIS /end AXIS_DESCR
/end CHARACTERISTIC
/begin CHARACTERISTIC PFltPOp_qSetUnBalRng7Min_GCUR "Untere Schwellen-Kraftstoffmengenkennlinie für Bereich 7" CURVE 0x8006707C Gkl_Ws16 655.3500 InjMass -327.6800 327.6700 FORMAT "%8.4"
 /begin AXIS_DESCR COM_AXIS PFltPOp_nEngFlt EngN 8 -16384.00 16383.50 FORMAT "%8.2" AXIS_PTS_REF PFltPOp_qSetUnBal_AXIS /end AXIS_DESCR
/end CHARACTERISTIC
/begin CHARACTERISTIC PFltPOp_qSetUnBalRng8Max_GCUR "Obere Schwellen-Kraftstoffmengenkennlinie für Bereich 8" CURVE 0x8006708C Gkl_Ws16 655.3500 InjMass -327.6800 327.6700 FORMAT "%8.4"
 /begin AXIS_DESCR COM_AXIS PFltPOp_nEngFlt EngN 8 -16384.00 16383.50 FORMAT "%8.2" AXIS_PTS_REF PFltPOp_qSetUnBal_AXIS /end AXIS_DESCR
/end CHARACTERISTIC
/begin CHARACTERISTIC PFltPOp_qSetUnBalRng8Min_GCUR "Untere Schwellen-Kraftstoffmengenkennlinie für Bereich 8" CURVE 0x8006709C Gkl_Ws16 655.3500 InjMass -327.6800 327.6700 FORMAT "%8.4"
 /begin AXIS_DESCR COM_AXIS PFltPOp_nEngFlt EngN 8 -16384.00 16383.50 FORMAT "%8.2" AXIS_PTS_REF PFltPOp_qSetUnBal_AXIS /end AXIS_DESCR
/end CHARACTERISTIC
/begin CHARACTERISTIC PFltPOp_qSetUnBalRng9Max_GCUR "Obere Schwellen-Kraftstoffmengenkennlinie für Bereich 9" CURVE 0x800670AC Gkl_Ws16 655.3500 InjMass -327.6800 327.6700 FORMAT "%8.4"
 /begin AXIS_DESCR COM_AXIS PFltPOp_nEngFlt EngN 8 -16384.00 16383.50 FORMAT "%8.2" AXIS_PTS_REF PFltPOp_qSetUnBal_AXIS /end AXIS_DESCR
/end CHARACTERISTIC
/begin CHARACTERISTIC PFltPOp_qSetUnBalRng9Min_GCUR "Untere Schwellen-Kraftstoffmengenkennlinie für Bereich 9" CURVE 0x800670BC Gkl_Ws16 655.3500 InjMass -327.6800 327.6700 FORMAT "%8.4"
 /begin AXIS_DESCR COM_AXIS PFltPOp_nEngFlt EngN 8 -16384.00 16383.50 FORMAT "%8.2" AXIS_PTS_REF PFltPOp_qSetUnBal_AXIS /end AXIS_DESCR
/end CHARACTERISTIC
/begin CHARACTERISTIC PFltPOp_qSetUnBalRngSpoMax_GCUR "Obere Schwellen-Kraftstoffmengenkennlinie für spontane Bereiche" CURVE 0x800670CC Gkl_Ws16 655.3500 InjMass -327.6800 327.6700 FORMAT "%8.4"
 /begin AXIS_DESCR COM_AXIS PFltPOp_nEngFlt EngN 8 -16384.00 16383.50 FORMAT "%8.2" AXIS_PTS_REF PFltPOp_qSetUnBal_AXIS /end AXIS_DESCR
/end CHARACTERISTIC
/begin CHARACTERISTIC PFltPOp_qSetUnBalRngSpoMin_GCUR "Untere Schwellen-Kraftstoffmengenkennlinie für spontane Bereiche" CURVE 0x800670DC Gkl_Ws16 655.3500 InjMass -327.6800 327.6700 FORMAT "%8.4"
 /begin AXIS_DESCR COM_AXIS PFltPOp_nEngFlt EngN 8 -16384.00 16383.50 FORMAT "%8.2" AXIS_PTS_REF PFltPOp_qSetUnBal_AXIS /end AXIS_DESCR
/end CHARACTERISTIC
/begin AXIS_PTS PFltPOp_qSetUnBal_AXIS "Achse für Gruppenkennlinien zur Ermittlung der Bereichsgrenzen der Einspritzmenge" 0x800670EC PFltPOp_nEngFlt GSst_Xs16 32767.50 EngN 8 -16384.00 16383.50 FORMAT "%8.2" DEPOSIT ABSOLUTE /end AXIS_PTS
/begin CHARACTERISTIC PFltPOp_qTrq2Qnt_CUR "Kennlinie zur Umrechnung des Drehmoments in eine ""virtuelle"" Einspritzmenge" CURVE 0x80067406 Cur_Xs16Ws16 655.3500 InjMass -327.6800 327.6700 FORMAT "%8.4"
 /begin AXIS_DESCR STD_AXIS PthSet_trqInrSet Trq 2 -500.0000 1000.000 FORMAT "%8.3" EXTENDED_LIMITS -3276.800 3276.700 DEPOSIT ABSOLUTE /end AXIS_DESCR
/end CHARACTERISTIC
/begin CHARACTERISTIC PFltPOp_rAPP_CA "Matrix zur Bestimmung der Bereichsgrenzen für das gefilterte Pedalwertgebersignal" MAP 0x800670FE Kf_Xs16_Ys16_Ws16 799.9878 Prc -400.0000 399.9878 FORMAT "%8.4"
 /begin AXIS_DESCR STD_AXIS PFltPOp_RngIdx_X_mp OneToOne 11 0.00 255.0 FORMAT "%5.1" DEPOSIT ABSOLUTE /end AXIS_DESCR
 /begin AXIS_DESCR STD_AXIS PFltPOp_RngIdx_Y_mp OneToOne 2 0.00 255.0 FORMAT "%5.1" DEPOSIT ABSOLUTE /end AXIS_DESCR
/end CHARACTERISTIC
/begin CHARACTERISTIC PFltPOp_stGearDebValMax_C "Minimaler Schaltsignalwert für die Entprellungsfunktion" VALUE 0x80067410 Val_Ws8 7.000 OneToOne -1.000 6.000 FORMAT "%5.3" EXTENDED_LIMITS -128.0 127.0 /end CHARACTERISTIC
/begin CHARACTERISTIC PFltPOp_stGearDebValMin_C "Maximaler Schaltsignalwert für die Entprellungsfunktion" VALUE 0x80067411 Val_Ws8 7.000 OneToOne -1.000 6.000 FORMAT "%5.3" EXTENDED_LIMITS -128.0 127.0 /end CHARACTERISTIC
/begin CHARACTERISTIC PFltPOp_stGear_CA "Matrix zur Bestimmung der Bereichsgrenzen für den eingelegten Gang" MAP 0x80067148 Kf_Xs16_Ys16_Ws16 65535.00 OneToOne -32768.00 32767.00 FORMAT "%8.2"
 /begin AXIS_DESCR STD_AXIS PFltPOp_RngIdx_X_mp OneToOne 11 0.00 255.0 FORMAT "%5.1" DEPOSIT ABSOLUTE /end AXIS_DESCR
 /begin AXIS_DESCR STD_AXIS PFltPOp_RngIdx_Y_mp OneToOne 2 0.00 255.0 FORMAT "%5.1" DEPOSIT ABSOLUTE /end AXIS_DESCR
/end CHARACTERISTIC
/begin CHARACTERISTIC PFltPOp_swtBrkRng_CA "Array zur Bestimmung der Bereichswerte für das entprellte Bremssignal" VAL_BLK 0x80067192 ValA_Wu8 255.0 OneToOne 0.00 255.0 FORMAT "%5.1" NUMBER 11 /end CHARACTERISTIC
/begin CHARACTERISTIC PFltPOp_swtClthRng_CA "Array zur Bestimmung der Bereichswerte für das entprellte Bremssignal" VAL_BLK 0x8006719D ValA_Wu8 255.0 OneToOne 0.00 255.0 FORMAT "%5.1" NUMBER 11 /end CHARACTERISTIC
/begin CHARACTERISTIC PFltPOp_swtTrqQnt_C "Schalter zur Auswahl von Einspritzmenge oder Drehmoment zur Betriebspunktberechnung" VALUE 0x80067412 Val_Wu8 1.000 OneToOne 0.00 1.000 FORMAT "%5.3" EXTENDED_LIMITS 0.00 255.0 /end CHARACTERISTIC
/begin CHARACTERISTIC PFltPOp_tAdapTOxiCatUsOff_CA "Matrix zur Bestimmung der Bereichsgrenzen für die gefilterte Abgastemperatur vom Oxidationskatalysator bei inaktivem Bereich" MAP 0x800671A8 Kf_Xs16_Ys16_Ws16 6553.500 Temp_Cels -3549.940 3003.560 FORMAT "%8.3"
 /begin AXIS_DESCR STD_AXIS PFltPOp_RngIdx_X_mp OneToOne 11 0.00 255.0 FORMAT "%5.1" DEPOSIT ABSOLUTE /end AXIS_DESCR
 /begin AXIS_DESCR STD_AXIS PFltPOp_RngIdx_Y_mp OneToOne 2 0.00 255.0 FORMAT "%5.1" DEPOSIT ABSOLUTE /end AXIS_DESCR
/end CHARACTERISTIC
/begin CHARACTERISTIC PFltPOp_tAdapTOxiCatUsOn_CA "Matrix zur Bestimmung der Bereichsgrenzen für die gefilterte Abgastemperatur vom Oxidationskatalysator bei aktivem Bereich" MAP 0x800671F2 Kf_Xs16_Ys16_Ws16 6553.500 Temp_Cels -3549.940 3003.560 FORMAT "%8.3"
 /begin AXIS_DESCR STD_AXIS PFltPOp_RngIdx_X_mp OneToOne 11 0.00 255.0 FORMAT "%5.1" DEPOSIT ABSOLUTE /end AXIS_DESCR
 /begin AXIS_DESCR STD_AXIS PFltPOp_RngIdx_Y_mp OneToOne 2 0.00 255.0 FORMAT "%5.1" DEPOSIT ABSOLUTE /end AXIS_DESCR
/end CHARACTERISTIC
/begin CHARACTERISTIC PFltPOp_tAdapTPFltUsOff_CA "Matrix zur Bestimmung der Bereichsgrenzen für die gefilterte Abgastemperatur vom Partikelfilter bei inaktivem Bereich" MAP 0x8006723C Kf_Xs16_Ys16_Ws16 6553.500 Temp_Cels -3549.940 3003.560 FORMAT "%8.3"
 /begin AXIS_DESCR STD_AXIS PFltPOp_RngIdx_X_mp OneToOne 11 0.00 255.0 FORMAT "%5.1" DEPOSIT ABSOLUTE /end AXIS_DESCR
 /begin AXIS_DESCR STD_AXIS PFltPOp_RngIdx_Y_mp OneToOne 2 0.00 255.0 FORMAT "%5.1" DEPOSIT ABSOLUTE /end AXIS_DESCR
/end CHARACTERISTIC
/begin CHARACTERISTIC PFltPOp_tAdapTPFltUsOn_CA "Matrix zur Bestimmung der Bereichsgrenzen für die gefilterte Abgastemperatur vom Partikelfilter bei aktivem Bereich" MAP 0x80067286 Kf_Xs16_Ys16_Ws16 6553.500 Temp_Cels -3549.940 3003.560 FORMAT "%8.3"
 /begin AXIS_DESCR STD_AXIS PFltPOp_RngIdx_X_mp OneToOne 11 0.00 255.0 FORMAT "%5.1" DEPOSIT ABSOLUTE /end AXIS_DESCR
 /begin AXIS_DESCR STD_AXIS PFltPOp_RngIdx_Y_mp OneToOne 2 0.00 255.0 FORMAT "%5.1" DEPOSIT ABSOLUTE /end AXIS_DESCR
/end CHARACTERISTIC
/begin CHARACTERISTIC PFltPOp_tAir_CA "Matrix zur Bestimmung der Bereichswerte für die gefilterte Lufttemperatur" MAP 0x800672D0 Kf_Xs16_Ys16_Ws16 6553.500 Temp_Cels -3549.940 3003.560 FORMAT "%8.3"
 /begin AXIS_DESCR STD_AXIS PFltPOp_RngIdx_X_mp OneToOne 11 0.00 255.0 FORMAT "%5.1" DEPOSIT ABSOLUTE /end AXIS_DESCR
 /begin AXIS_DESCR STD_AXIS PFltPOp_RngIdx_Y_mp OneToOne 2 0.00 255.0 FORMAT "%5.1" DEPOSIT ABSOLUTE /end AXIS_DESCR
/end CHARACTERISTIC
/begin CHARACTERISTIC PFltPOp_tEngTemp_CA "Matrix zur Bestimmung der Bereichswerte für die gefilterte Motortemperatur" MAP 0x8006731A Kf_Xs16_Ys16_Ws16 6553.500 Temp_Cels -3549.940 3003.560 FORMAT "%8.3"
 /begin AXIS_DESCR STD_AXIS PFltPOp_RngIdx_X_mp OneToOne 11 0.00 255.0 FORMAT "%5.1" DEPOSIT ABSOLUTE /end AXIS_DESCR
 /begin AXIS_DESCR STD_AXIS PFltPOp_RngIdx_Y_mp OneToOne 2 0.00 255.0 FORMAT "%5.1" DEPOSIT ABSOLUTE /end AXIS_DESCR
/end CHARACTERISTIC
/begin CHARACTERISTIC PFltPOp_tiAPPRatPT1_C "Filter-Zeitkonstante für APP_r PT1-Filter" VALUE 0x80067414 Val_Ws32 4294.9672940 TimeDelay_s 0.000002000000001 4294.9672960 FORMAT "%12.7" /end CHARACTERISTIC
/begin CHARACTERISTIC PFltPOp_tiBattPT1_C "Filter-Zeitkonstante für BattU_u PT1-Filter" VALUE 0x80067418 Val_Ws32 4294.9672940 TimeDelay_s 0.000002000000001 4294.9672960 FORMAT "%12.7" /end CHARACTERISTIC
/begin CHARACTERISTIC PFltPOp_tiEngSpdPT1_C "Filter-Zeitkonstante für Epm_nEng PT1-Filter" VALUE 0x8006741C Val_Ws32 4294.9672940 TimeDelay_s 0.000002000000001 4294.9672960 FORMAT "%12.7" /end CHARACTERISTIC
/begin CHARACTERISTIC PFltPOp_tiEngTempPT1_C "Filter-Zeitkonstante für PFltPOp_tEngTemp_mp PT1-Filter" VALUE 0x80067420 Val_Ws32 4294.9672940 TimeDelay_s 0.000002000000001 4294.9672960 FORMAT "%12.7" /end CHARACTERISTIC
/begin CHARACTERISTIC PFltPOp_tiInjMsPT1_C "Filter-Zeitkonstante für InjCtl_qSetUnBal PT1-Filter" VALUE 0x80067424 Val_Ws32 4294.9672940 TimeDelay_s 0.000002000000001 4294.9672960 FORMAT "%12.7" /end CHARACTERISTIC
/begin CHARACTERISTIC PFltPOp_tiSpdVehPT1_C "Filter-Zeitkonstante für VehV_v PT1-Filter" VALUE 0x80067428 Val_Ws32 4294.9672940 TimeDelay_s 0.000002000000001 4294.9672960 FORMAT "%12.7" /end CHARACTERISTIC
/begin CHARACTERISTIC PFltPOp_tiTempOxiCatUsPT1_C "Filter-Zeitkonstante für Exh_tAdapTOxiCatUs PT1-Filter" VALUE 0x8006742C Val_Ws32 4294.9672940 TimeDelay_s 0.000002000000001 4294.9672960 FORMAT "%12.7" /end CHARACTERISTIC
/begin CHARACTERISTIC PFltPOp_tiTempPFltUsPT1_C "Filter-Zeitkonstante für Exh_tAdapTPFltUs PT1-Filter" VALUE 0x80067430 Val_Ws32 4294.9672940 TimeDelay_s 0.000002000000001 4294.9672960 FORMAT "%12.7" /end CHARACTERISTIC
/begin CHARACTERISTIC PFltPOp_uBatt_CA "Matrix zur Bestimmung der Bereichsgrenzen für das gefilterte Batteriespannungssignal" MAP 0x80067364 Kf_Xs16_Ys16_Ws16 1310700. Volt_Batt -655360.0 655340.0 FORMAT "%8.1"
 /begin AXIS_DESCR STD_AXIS PFltPOp_RngIdx_X_mp OneToOne 11 0.00 255.0 FORMAT "%5.1" DEPOSIT ABSOLUTE /end AXIS_DESCR
 /begin AXIS_DESCR STD_AXIS PFltPOp_RngIdx_Y_mp OneToOne 2 0.00 255.0 FORMAT "%5.1" DEPOSIT ABSOLUTE /end AXIS_DESCR
/end CHARACTERISTIC
/begin CHARACTERISTIC PFltPOp_v_CA "Matrix zur Bestimmung der Bereichswerte für die gefilterte Fahrzeuggeschwindigkeit" MAP 0x800673AE Kf_Xs16_Ys16_Ws16 655.3500 Vel -327.6800 327.6700 FORMAT "%8.4"
 /begin AXIS_DESCR STD_AXIS PFltPOp_RngIdx_X_mp OneToOne 11 0.00 255.0 FORMAT "%5.1" DEPOSIT ABSOLUTE /end AXIS_DESCR
 /begin AXIS_DESCR STD_AXIS PFltPOp_RngIdx_Y_mp OneToOne 2 0.00 255.0 FORMAT "%5.1" DEPOSIT ABSOLUTE /end AXIS_DESCR
/end CHARACTERISTIC
/begin CHARACTERISTIC PFltRgn_aDynMinLim_MAP "Kennfeld minimale Beschleunigung" MAP 0x80067A30 Map_Xs16Ys16Ws16 30.00000 Acc 0.00 30.00000 FORMAT "%8.5" EXTENDED_LIMITS -32.76800 32.76700
 /begin AXIS_DESCR STD_AXIS Epm_nEng EngN 8 40.00000 6000.000 FORMAT "%8.3" EXTENDED_LIMITS -16384.00 16383.50 DEPOSIT ABSOLUTE /end AXIS_DESCR
 /begin AXIS_DESCR STD_AXIS PT_numTraGear OneToOne 8 0.00 7.000 FORMAT "%5.3" EXTENDED_LIMITS 0.00 255.0 DEPOSIT ABSOLUTE /end AXIS_DESCR
/end CHARACTERISTIC
/begin CHARACTERISTIC PFltRgn_ctRgnSubs_C "Ersatzwert für EEPROM-Initialisierung der Anzahl erfolgreicher Partikelfilterregenerationen" VALUE 0x80067458 Val_Wu16 255.0000 OneToOne 0.00 255.0000 FORMAT "%8.4" EXTENDED_LIMITS 0.00 65535.00 /end CHARACTERISTIC
/begin CHARACTERISTIC PFltRgn_DebLck.tiHiLo_C "/" VALUE 0x8006745A Kw_Ws16 655350.0 TimeDeb -327680.0 327670.0 FORMAT "%8.1" /end CHARACTERISTIC
/begin CHARACTERISTIC PFltRgn_DebLck.tiLoHi_C "/" VALUE 0x8006745C Kw_Ws16 655350.0 TimeDeb -327680.0 327670.0 FORMAT "%8.1" /end CHARACTERISTIC
/begin CHARACTERISTIC PFltRgn_drAccPedDyn_C "Minimale Beschleunigungsschwelle Dynamikerkennung" VALUE 0x80067AD4 Kw_Ws16 5000.000 PrcPerSec 0.00 5000.000 FORMAT "%8.3" EXTENDED_LIMITS -20000.00 19999.39 /end CHARACTERISTIC
/begin CHARACTERISTIC PFltRgn_drAccPedRawMax_C "Obere Schwelle Beschleunigung über Pedalwert" VALUE 0x80067AD6 Kw_Ws16 5000.000 PrcPerSec 0.00 5000.000 FORMAT "%8.3" EXTENDED_LIMITS -20000.00 19999.39 /end CHARACTERISTIC
/begin CHARACTERISTIC PFltRgn_drAccPedRawMin_C "Untere Schwelle Beschleunigung über Pedalwert" VALUE 0x80067AD8 Kw_Ws16 5000.000 PrcPerSec 0.00 5000.000 FORMAT "%8.3" EXTENDED_LIMITS -20000.00 19999.39 /end CHARACTERISTIC
/begin CHARACTERISTIC PFltRgn_DT1AccPed.T1_C "D-Anteil Dynamik über Pedalwert/" VALUE 0x80067ADC Val_Ws32 1073.7408240 TimeDelay_s 0.0010000000689 1073.7418240 FORMAT "%12.7" EXTENDED_LIMITS 0.000002000000001 4294.9672960 /end CHARACTERISTIC
/begin CHARACTERISTIC PFltRgn_DT1AccPed.Kd_C "D-Anteil Dynamik über Pedalwert/" VALUE 0x80067AE0 Val_Ws32 1.00000000000 Kd 0.00 1.00000000000 FORMAT "%13.11" EXTENDED_LIMITS -32768.0000000 32767.9999847 /end CHARACTERISTIC
/begin CHARACTERISTIC PFltRgn_facChngRgnDel_CA "Korrekturfaktor für den Grenzwert der Zeitdauer nach einer Änderung des Betriebsarten- bzw. Regenerationsstufenwunsches" VAL_BLK 0x8006745E ValA_Ws16 7.999878 Fact -4.000000 3.999878 FORMAT "%8.6" NUMBER 7 /end CHARACTERISTIC
/begin CHARACTERISTIC PFltRgn_facDynInjQnt_C "Korrekturfaktor Einspritzmenge" VALUE 0x80067AE4 Kw_Ws16 2.000000 Fact 0.00 2.000000 FORMAT "%8.6" EXTENDED_LIMITS -4.000000 3.999878 /end CHARACTERISTIC
/begin CHARACTERISTIC PFltRgn_facFullLdCor_MAP "Korrekturkennfed Volllastbestimmung" MAP 0x80067AE6 Map_Xs16Ys16Ws16 2.000000 Fact 0.00 2.000000 FORMAT "%8.6" EXTENDED_LIMITS -4.000000 3.999878
 /begin AXIS_DESCR STD_AXIS VehV_v Vel 8 0.00 327.6700 FORMAT "%8.4" EXTENDED_LIMITS -327.6800 327.6700 DEPOSIT ABSOLUTE /end AXIS_DESCR
 /begin AXIS_DESCR STD_AXIS PT_numTraGear OneToOne 8 0.00 7.000 FORMAT "%5.3" EXTENDED_LIMITS 0.00 255.0 DEPOSIT ABSOLUTE /end AXIS_DESCR
/end CHARACTERISTIC
/begin CHARACTERISTIC PFltRgn_lSumMaxDef_C "Gefahrene Entfernungsschwelle der Regeneration beim Fehlerfall" VALUE 0x80067858 Val_Ws32 4294967295.00 Length -2147483648.00 2147483647.00 FORMAT "%13.2" /end CHARACTERISTIC
/begin CHARACTERISTIC PFltRgn_lSumMax_C "Maximale Schwelle für die zurückgelegte Strecke seit der letzten erfolgreichen Regeneration" VALUE 0x8006785C Val_Ws32 4294967295.00 Length -2147483648.00 2147483647.00 FORMAT "%13.2" /end CHARACTERISTIC
/begin CHARACTERISTIC PFltRgn_lSumSubs_C "Ersatzwert für gefahrene Strecke im Fall eines Eeprom lese Fehlers" VALUE 0x80067860 Val_Ws32 4294967295.00 Length -2147483648.00 2147483647.00 FORMAT "%13.2" /end CHARACTERISTIC
/begin CHARACTERISTIC PFltRgn_mSotMeas_CUR "Umrechnung Strömungswiederstand der Partikelmasse" CURVE 0x80067864 Cur_Xs16Ws16 300.0000 mSoot_g 0.00 300.0000 FORMAT "%8.4" EXTENDED_LIMITS -327.6800 327.6700
 /begin AXIS_DESCR STD_AXIS PFltRgn_resFlwOfs_mp Res_hPaHrPerCM 8 0.00 2.500000 FORMAT "%8.6" EXTENDED_LIMITS -3.276800 3.276700 DEPOSIT ABSOLUTE /end AXIS_DESCR
/end CHARACTERISTIC
/begin CHARACTERISTIC PFltRgn_mSotRngDwn_CA "Übergangsgrenzen für Wechsel in niedrigere Beladungszustände" VAL_BLK 0x80067886 ValA_Ws16 300.0000 mSoot_g 0.00 300.0000 FORMAT "%8.4" EXTENDED_LIMITS -327.6800 327.6700 NUMBER 10 /end CHARACTERISTIC
/begin CHARACTERISTIC PFltRgn_mSotRngUp_CA "Übergangsgrenzen für Wechsel in höhere Beladungszustände" VAL_BLK 0x8006789A ValA_Ws16 300.0000 mSoot_g 0.00 300.0000 FORMAT "%8.4" EXTENDED_LIMITS -327.6800 327.6700 NUMBER 10 /end CHARACTERISTIC
/begin CHARACTERISTIC PFltRgn_numEngPOpDel_CA "Verzögert wirksame Matrix zur Berücksichtigung des Motorbetriebszustandes bei der Regeneration" MAP 0x8006746C Map_Xs16Ys16Ws16 65535.00 OneToOne -32768.00 32767.00 FORMAT "%8.2"
 /begin AXIS_DESCR STD_AXIS PFltPOp_stEngPOp OneToOne 12 0.00 255.0 FORMAT "%5.1" DEPOSIT ABSOLUTE /end AXIS_DESCR
 /begin AXIS_DESCR STD_AXIS PFltRgn_numRgn_mp OneToOne 7 0.00 255.0 FORMAT "%5.1" DEPOSIT ABSOLUTE /end AXIS_DESCR
/end CHARACTERISTIC
/begin CHARACTERISTIC PFltRgn_numEngPOpIntr_CA "Motorbetriebsfeld für unterbrochene Regeneration" MAP 0x8006753E Map_Xs16Ys16Ws16 65535.00 OneToOne -32768.00 32767.00 FORMAT "%8.2"
 /begin AXIS_DESCR STD_AXIS PFltPOp_stEngPOp OneToOne 12 0.00 255.0 FORMAT "%5.1" DEPOSIT ABSOLUTE /end AXIS_DESCR
 /begin AXIS_DESCR STD_AXIS PFltRgn_numRgn_mp OneToOne 7 0.00 255.0 FORMAT "%5.1" DEPOSIT ABSOLUTE /end AXIS_DESCR
/end CHARACTERISTIC
/begin CHARACTERISTIC PFltRgn_numEngPOp_CA "Partikelfilterzustand vs. Motorzustandmatrix" MAP 0x80067610 Map_Xs16Ys16Ws16 65535.00 OneToOne -32768.00 32767.00 FORMAT "%8.2"
 /begin AXIS_DESCR STD_AXIS PFltPOp_stEngPOp OneToOne 12 0.00 255.0 FORMAT "%5.1" DEPOSIT ABSOLUTE /end AXIS_DESCR
 /begin AXIS_DESCR STD_AXIS PFltRgn_numRgn_mp OneToOne 7 0.00 255.0 FORMAT "%5.1" DEPOSIT ABSOLUTE /end AXIS_DESCR
/end CHARACTERISTIC
/begin CHARACTERISTIC PFltRgn_numLst_C "Regenerationsanfoderung wegen Kraftstoffverbrauch, Betriebsdauer oder Strecke" VALUE 0x800678AE Val_Wu8 255.0 OneToOne 0.00 255.0 FORMAT "%5.1" /end CHARACTERISTIC
/begin CHARACTERISTIC PFltRgn_numPrt_C "Regenerationsanforderung wegen Motorschut" VALUE 0x800678AF Val_Wu8 255.0 OneToOne 0.00 255.0 FORMAT "%5.1" /end CHARACTERISTIC
/begin CHARACTERISTIC PFltRgn_numRgnSuc_C "Größte Regenerationsanforderungszahl, ab der eine erfolgreiche Regeneration erkannt wird" VALUE 0x800676E2 Val_Wu8 100.0 OneToOne 0.00 100.0 FORMAT "%5.1" EXTENDED_LIMITS 0.00 255.0 /end CHARACTERISTIC
/begin CHARACTERISTIC PFltRgn_numRgnTxtMsg_C "Minimal Regenerationsanforderung für Text-Botschaft" VALUE 0x800676E3 Val_Wu8 255.0 OneToOne 0.00 255.0 FORMAT "%5.1" /end CHARACTERISTIC
/begin CHARACTERISTIC PFltRgn_pEngPrtMaxInit_C "Initialisierungswert des PT1-Filters für den Maximalwert im Motorschutz" VALUE 0x800678B0 Val_Ws16 3500.000 Pres_hPa 0.00 3500.000 FORMAT "%8.3" EXTENDED_LIMITS -32768.00 32767.00 /end CHARACTERISTIC
/begin CHARACTERISTIC PFltRgn_pEngPrtMax_MAP "Obere Druckschwelle Motorschutz" MAP 0x800678B2 Map_Xs16Ys16Ws16 3500.000 Pres_hPa 0.00 3500.000 FORMAT "%8.3" EXTENDED_LIMITS -32768.00 32767.00
 /begin AXIS_DESCR STD_AXIS Epm_nEng EngN 8 40.00000 6000.000 FORMAT "%8.3" EXTENDED_LIMITS -16384.00 16383.50 DEPOSIT ABSOLUTE /end AXIS_DESCR
 /begin AXIS_DESCR STD_AXIS InjCtl_qSetUnBal InjMass 8 0.00 327.6700 FORMAT "%8.4" EXTENDED_LIMITS -327.6800 327.6700 DEPOSIT ABSOLUTE /end AXIS_DESCR
/end CHARACTERISTIC
/begin CHARACTERISTIC PFltRgn_pEngPrtMin_MAP "Untere Druckschwelle Motorschutz" MAP 0x80067956 Map_Xs16Ys16Ws16 3500.000 Pres_hPa 0.00 3500.000 FORMAT "%8.3" EXTENDED_LIMITS -32768.00 32767.00
 /begin AXIS_DESCR STD_AXIS Epm_nEng EngN 8 40.00000 6000.000 FORMAT "%8.3" EXTENDED_LIMITS -16384.00 16383.50 DEPOSIT ABSOLUTE /end AXIS_DESCR
 /begin AXIS_DESCR STD_AXIS InjCtl_qSetUnBal InjMass 8 0.00 327.6700 FORMAT "%8.4" EXTENDED_LIMITS -327.6800 327.6700 DEPOSIT ABSOLUTE /end AXIS_DESCR
/end CHARACTERISTIC
/begin CHARACTERISTIC PFltRgn_qFlMaxDef_C "Kraftstoffverbrauchsschwelle für Regeneration im Falles eines Fehlers" VALUE 0x800679FA Val_Ws16 320.0000 Fl_L 0.00 320.0000 FORMAT "%8.4" EXTENDED_LIMITS -327.6800 327.6700 /end CHARACTERISTIC
/begin CHARACTERISTIC PFltRgn_qFlMax_C "Schwelle für den Kraftstoffverbrauch seit der letzten erfolgreichen Regeneration" VALUE 0x800679FC Val_Ws16 320.0000 Fl_L 0.00 320.0000 FORMAT "%8.4" EXTENDED_LIMITS -327.6800 327.6700 /end CHARACTERISTIC
/begin CHARACTERISTIC PFltRgn_qFlSubs_C "Ersatzwert für EEPROM-Initialisierung der seit der letzten erfolgreichen Regeneration verbrauchten Kraftstoffmenge" VALUE 0x800679FE Val_Ws16 320.0000 Fl_L 0.00 320.0000 FORMAT "%8.4" EXTENDED_LIMITS -327.6800 327.6700 /end CHARACTERISTIC
/begin CHARACTERISTIC PFltRgn_rAccPedDynMin_C "Minimaler Pedalwert zur Dynamikerkennung" VALUE 0x80067B8A Kw_Ws16 100.0000 Prc 0.00 100.0000 FORMAT "%8.4" EXTENDED_LIMITS -400.0000 399.9878 /end CHARACTERISTIC
/begin CHARACTERISTIC PFltRgn_rFullLdBas_MAP "Kennfeld zur Volllasterkennung" MAP 0x80067B8C Map_Xs16Ys16Ws16 100.0000 Prc 0.00 100.0000 FORMAT "%8.4" EXTENDED_LIMITS -400.0000 399.9878
 /begin AXIS_DESCR STD_AXIS Epm_nEng EngN 8 40.00000 6000.000 FORMAT "%8.3" EXTENDED_LIMITS -16384.00 16383.50 DEPOSIT ABSOLUTE /end AXIS_DESCR
 /begin AXIS_DESCR STD_AXIS InjCtl_qSetUnBal InjMass 8 0.00 327.6700 FORMAT "%8.4" EXTENDED_LIMITS -327.6800 327.6700 DEPOSIT ABSOLUTE /end AXIS_DESCR
/end CHARACTERISTIC
/begin CHARACTERISTIC PFltRgn_rFullLdMax_C "obere Schwelle Volllasterkennung" VALUE 0x80067C30 Kw_Ws16 100.0000 Prc 0.00 100.0000 FORMAT "%8.4" EXTENDED_LIMITS -400.0000 399.9878 /end CHARACTERISTIC
/begin CHARACTERISTIC PFltRgn_rFullLdMin_C "Untere Schwelle Volllasterkennung" VALUE 0x80067C32 Kw_Ws16 100.0000 Prc 0.00 100.0000 FORMAT "%8.4" EXTENDED_LIMITS -400.0000 399.9878 /end CHARACTERISTIC
/begin CHARACTERISTIC PFltRgn_stLckFlMsk_C "Maske für PFltRgn_numTot" VALUE 0x80067434 Kw_Wu16 65535.00 OneToOne 0.00 65535.00 FORMAT "%8.2" /end CHARACTERISTIC
/begin CHARACTERISTIC PFltRgn_stLckOpMode_C "Betriebsartenanforderung bei einer gesperrten Regeneration" VALUE 0x800676E4 Val_Wu32 2147483647.00 OneToOne 0.00 2147483647.00 FORMAT "%13.2" EXTENDED_LIMITS 0.00 4294967295.00 /end CHARACTERISTIC
/begin CHARACTERISTIC PFltRgn_stLckRgnMsk_C "Maske für die Regenerationssperre und die Freigabe" VALUE 0x800676E8 Val_Wu32 4294967295.00 OneToOne 0.00 4294967295.00 FORMAT "%13.2" /end CHARACTERISTIC
/begin CHARACTERISTIC PFltRgn_stOpModeAct_CA "Array mit aktueller Betriebsarten für die Direktsprungsbedingung" VAL_BLK 0x800676EC ValA_Wu32 4294967295.00 OneToOne 0.00 4294967295.00 FORMAT "%13.2" NUMBER 7 /end CHARACTERISTIC
/begin CHARACTERISTIC PFltRgn_stOpModeDes_CA "Array mit gewünschter Betriebsarten für die Direktsprungsbedingung" VAL_BLK 0x80067708 ValA_Wu32 4294967295.00 OneToOne 0.00 4294967295.00 FORMAT "%13.2" NUMBER 7 /end CHARACTERISTIC
/begin CHARACTERISTIC PFltRgn_stRgnActvMsk_C "Maske für DPF Regenerationszeit relevante Abgasnachbehandlungszustand" VALUE 0x80067A00 Val_Wu32 4294967295.00 OneToOne 0.00 4294967295.00 FORMAT "%13.2" /end CHARACTERISTIC
/begin CHARACTERISTIC PFltRgn_stRgnJmpMsk_C "Maske Sprungbedinungserkennung" VALUE 0x80067C34 Kw_Wu8 255.0 OneToOne 0.00 255.0 FORMAT "%5.1" /end CHARACTERISTIC
/begin CHARACTERISTIC PFltRgn_stRgnNoCmplnSubs_C "Ersatzwert für EEPROM-Initialisierung der Status Regeneration nicht erfolgreich beendet" VALUE 0x80067724 Val_Wu8 1.000 OneToOne 0.00 1.000 FORMAT "%5.3" EXTENDED_LIMITS 0.00 255.0 /end CHARACTERISTIC
/begin CHARACTERISTIC PFltRgn_stRgnOpMode_CA "Array mit erforderlicher Betriebsart gemäß Regenerationsanforderung und Motorzustand" VAL_BLK 0x80067728 ValA_Wu32 4294967295.00 OneToOne 0.00 4294967295.00 FORMAT "%13.2" NUMBER 11 /end CHARACTERISTIC
/begin CHARACTERISTIC PFltRgn_stSysFailMsk_C "Bitmaske zur Auswahl der Regenerationsunterbrechung auslösenden Systemfehler" VALUE 0x80067436 Kw_Wu8 255.0 OneToOne 0.00 255.0 FORMAT "%5.1" /end CHARACTERISTIC
/begin CHARACTERISTIC PFltRgn_swtAshCor_C "Schalter um die Partikelmassen-Modellschwellewerte zu korregieren" VALUE 0x80067A04 Val_Wu8 1.000 OneToOne 0.00 1.000 FORMAT "%5.3" EXTENDED_LIMITS 0.00 255.0 /end CHARACTERISTIC
/begin CHARACTERISTIC PFltRgn_swtCntAshCor_C "Schalter zur Berüchsichtigung des Aschekorrekturfaktors beim Überprüfen der Bedingungen für Regenerationsanforderung nach Kraftstoffverbrauch, Betriebsstunden und gefahrener Strecke" VALUE 0x80067A05 Val_Wu8 1.000 OneToOne 0.00 1.000 FORMAT "%5.3" EXTENDED_LIMITS 0.00 255.0 /end CHARACTERISTIC
/begin CHARACTERISTIC PFltRgn_swtDynDetSmkLimOn_C "Schalter Berücksichtigung Rauchbegrenzung bei Dynamikerkennung" VALUE 0x80067C35 Kw_Wu8 1.000 OneToOne 0.00 1.000 FORMAT "%5.3" EXTENDED_LIMITS 0.00 255.0 /end CHARACTERISTIC
/begin CHARACTERISTIC PFltRgn_swtMsSotRngDwnCor_C "Bitwort-Schalter zur Berücksichtigung des Aschekorrekturfaktors beim Überprüfen der Übergangsgrenzen für Wechsel in niedrigere Beladungszustände" VALUE 0x80067A06 Val_Wu16 63.00000 OneToOne 0.00 63.00000 FORMAT "%8.5" EXTENDED_LIMITS 0.00 65535.00 /end CHARACTERISTIC
/begin CHARACTERISTIC PFltRgn_swtMsSotRngUpCor_C "Bitwort-Schalter zur Berücksichtigung des Aschekorrekturfaktors beim Überprüfen der Übergangsgrenzen für Wechsel in höhere Beladungszustände" VALUE 0x80067A08 Val_Wu16 63.00000 OneToOne 0.00 63.00000 FORMAT "%8.5" EXTENDED_LIMITS 0.00 65535.00 /end CHARACTERISTIC
/begin CHARACTERISTIC PFltRgn_swtOfsCor_C "Schalter um die Offset Korrektur in der Zustandsmachine auszuschalten" VALUE 0x80067A0A Val_Wu8 1.000 OneToOne 0.00 1.000 FORMAT "%5.3" EXTENDED_LIMITS 0.00 255.0 /end CHARACTERISTIC
/begin CHARACTERISTIC PFltRgn_swtTmrLckRst_C "" VALUE 0x80067754 Kw_Wu8 1.000 OneToOne 0.00 1.000 FORMAT "%5.3" EXTENDED_LIMITS 0.00 255.0 /end CHARACTERISTIC
/begin CHARACTERISTIC PFltRgn_tiAccPedPT1_C "P-Anteil Pedalwertänderung" VALUE 0x80067C36 Kw_Ws16 1073.7408240 TimeDelay_s 0.0010000000689 1073.7418240 FORMAT "%12.7" EXTENDED_LIMITS 0.13107600012 4294.9672960 /end CHARACTERISTIC
/begin CHARACTERISTIC PFltRgn_tiChngRgnDelBas_MAP "Maximale Verzögerungszeit nach Änderung des Betriebsartenwunsches abhängig von Motorsbetriebszustand" MAP 0x80067756 Map_Xs16Ys16Ws16 655.3500 Time_s -327.6800 327.6700 FORMAT "%8.4"
 /begin AXIS_DESCR STD_AXIS Epm_nEng EngN 8 40.00000 6000.000 FORMAT "%8.3" EXTENDED_LIMITS -16384.00 16383.50 DEPOSIT ABSOLUTE /end AXIS_DESCR
 /begin AXIS_DESCR STD_AXIS InjCtl_qSetUnBal InjMass 8 -327.6800 327.6700 FORMAT "%8.4" DEPOSIT ABSOLUTE /end AXIS_DESCR
/end CHARACTERISTIC
/begin CHARACTERISTIC PFltRgn_tiDebQLimErrIntr_C "Entprellzeit für Regenerationsunterbrechung aufgrund der Mengenbegrenzung" VALUE 0x80067438 Kw_Ws32 1043741820.00 TimeDeb 0.00 1043741820.00 FORMAT "%13.2" EXTENDED_LIMITS -21474836480.0 21474836470.0 /end CHARACTERISTIC
/begin CHARACTERISTIC PFltRgn_tiDebTrqOvhtIntr_C "Entprellzeit für Regenerationsunterbrechung aufgrund des Überhitzungsschutzes" VALUE 0x8006743C Kw_Ws32 1043741820.00 TimeDeb 0.00 1043741820.00 FORMAT "%13.2" EXTENDED_LIMITS -21474836480.0 21474836470.0 /end CHARACTERISTIC
/begin CHARACTERISTIC PFltRgn_tiEngOnMaxDef_C "Motorbetriebszeitschwelle für Regeneration im Falle eines Fehlers" VALUE 0x80067A0C Val_Ws32 4294967295.00 TimeEngOn -2147483648.00 2147483647.00 FORMAT "%13.2" /end CHARACTERISTIC
/begin CHARACTERISTIC PFltRgn_tiEngOnMax_C "Motorbetriebszeitschwelle für Regeneration" VALUE 0x80067A10 Val_Ws32 4294967295.00 TimeEngOn -2147483648.00 2147483647.00 FORMAT "%13.2" /end CHARACTERISTIC
/begin CHARACTERISTIC PFltRgn_tiEngPrtPT1_C "Zeitkonstant für das PT1 Element des Motorschutz" VALUE 0x80067A14 Val_Ws32 4294.9672940 TimeDelay_s 0.000002000000001 4294.9672960 FORMAT "%12.7" /end CHARACTERISTIC
/begin CHARACTERISTIC PFltRgn_tiEngPrt_C "Regenerationsanforderung wegen Motorschutz" VALUE 0x80067A18 Val_Ws32 21474836.4700 Time_s 0.00 21474836.4700 FORMAT "%13.4" EXTENDED_LIMITS -21474836.4800 21474836.4700 /end CHARACTERISTIC
/begin CHARACTERISTIC PFltRgn_tiKpRgnOvrRun_C "Dauer zum Bewahren von Regeneration im Schub" VALUE 0x80067440 Kw_Ws32 42949672.9500 Time_s 0.00 42949672.9500 FORMAT "%13.2" EXTENDED_LIMITS -21474836.4800 21474836.4700 /end CHARACTERISTIC
/begin CHARACTERISTIC PFltRgn_tiLckRgnErr_CA "Sperrzeit nach maximaler Regenerationsdauer überschritten im Falle eines Fehler, abhängig von dem Regenerationszustand" VAL_BLK 0x800677FC ValA_Ws32 42949672.9500 Time_s -21474836.4800 21474836.4700 FORMAT "%13.4" NUMBER 7 /end CHARACTERISTIC
/begin CHARACTERISTIC PFltRgn_tiLckRgn_CA "" VAL_BLK 0x80067818 ValA_Ws32 42949672.9500 Time_s -21474836.4800 21474836.4700 FORMAT "%13.4" NUMBER 7 /end CHARACTERISTIC
/begin CHARACTERISTIC PFltRgn_tiLckSubs_C "" VALUE 0x80067834 Kw_Ws32 21474836.4700 Time_s 0.00 21474836.4700 FORMAT "%13.4" EXTENDED_LIMITS -21474836.4800 21474836.4700 /end CHARACTERISTIC
/begin CHARACTERISTIC PFltRgn_tiLstRgn_C "Dauer der Regenerations wegen Kraftstoffverbrauch, Betriebsdauer oder Strecke" VALUE 0x80067A1C Val_Ws32 21474836.4700 Time_s 0.00 21474836.4700 FORMAT "%13.4" EXTENDED_LIMITS -21474836.4800 21474836.4700 /end CHARACTERISTIC
/begin CHARACTERISTIC PFltRgn_tiOpSubs_C "Ersatzwert für EEPROM-Initialisierung der Betriebsdauer seit der letzten erfolgreichen Regeneration" VALUE 0x80067A20 Val_Ws32 4294967295.00 TimeEngOn -2147483648.00 2147483647.00 FORMAT "%13.2" /end CHARACTERISTIC
/begin CHARACTERISTIC PFltRgn_tiRgnMax_CA "Array mit maximalen Regenerationszeiten" VAL_BLK 0x80067838 ValA_Ws32 42949672.9500 Time_s -21474836.4800 21474836.4700 FORMAT "%13.4" NUMBER 7 /end CHARACTERISTIC
/begin CHARACTERISTIC PFltRgn_tiRgnSpo_C "Regenerationszeit für die Erkennung einer spontanen Regeneration" VALUE 0x80067854 Val_Ws32 42949672.9500 Time_s -21474836.4800 21474836.4700 FORMAT "%13.4" /end CHARACTERISTIC
/begin CHARACTERISTIC PFltRgn_tiSysFailDel_C "Entprellzeit für Regenerationsunterbrechung aufgrund von Systemfehlern" VALUE 0x80067444 Kw_Ws16 327670.0 TimeDeb 0.00 327670.0 FORMAT "%8.1" EXTENDED_LIMITS -327680.0 327670.0 /end CHARACTERISTIC
/begin CHARACTERISTIC PFltRgn_tiTmrEngPrtSubs_C "Ersatzwert für EEPROM-Initialisierung des Timers für Motorschutz" VALUE 0x80067A24 Val_Ws32 42949672.9500 Time_s -21474836.4800 21474836.4700 FORMAT "%13.4" /end CHARACTERISTIC
/begin CHARACTERISTIC PFltRgn_tiTmrLstRgnSubs_C "Ersatzwert für EEPROM-Initialisierung des Timers für letzte Regeneration" VALUE 0x80067A28 Val_Ws32 42949672.9500 Time_s -21474836.4800 21474836.4700 FORMAT "%13.4" /end CHARACTERISTIC
/begin CHARACTERISTIC PFltRgn_tOxiCatUsMaxHi_C "Maximal zulässiger Wert für Temperatur stromaufwärts vom Oxidationkatalysator (obere Grenze)" VALUE 0x80067446 Kw_Ws16 700.0000 Temp_Cels 99.96000 799.9600 FORMAT "%8.4" EXTENDED_LIMITS -3549.940 3003.560 /end CHARACTERISTIC
/begin CHARACTERISTIC PFltRgn_tOxiCatUsMaxLo_C "Maximal zulässiger Wert für Temperatur stromaufwärts vom Oxidationkatalysator (untere Grenze)" VALUE 0x80067448 Kw_Ws16 700.0000 Temp_Cels 99.96000 799.9600 FORMAT "%8.4" EXTENDED_LIMITS -3549.940 3003.560 /end CHARACTERISTIC
/begin CHARACTERISTIC PFltRgn_tPFltUsMaxHi_C "Maximal zulässiger Wert für Temperatur stromaufwärts vom Partikelfilter (obere Grenze)" VALUE 0x8006744A Kw_Ws16 700.0000 Temp_Cels 99.96000 799.9600 FORMAT "%8.4" EXTENDED_LIMITS -3549.940 3003.560 /end CHARACTERISTIC
/begin CHARACTERISTIC PFltRgn_tPFltUsMaxLo_C "Maximal zulässiger Wert für Temperatur stromaufwärts vom Partikelfilter (untere Grenze)" VALUE 0x8006744C Kw_Ws16 6553.500 Temp_Cels -3549.940 3003.560 FORMAT "%8.3" /end CHARACTERISTIC
/begin CHARACTERISTIC PFltRgn_tPFltUsMinOvrRun_C "Minimal zulässiger Temperaturwert zum Aufrechterhalten von der Regeneration im Schub" VALUE 0x8006744E Kw_Ws16 600.0000 Temp_Cels 99.96000 699.9600 FORMAT "%8.4" EXTENDED_LIMITS -3549.940 3003.560 /end CHARACTERISTIC
/begin CHARACTERISTIC PFltRgn_tTrbnUsMaxHi_C "Maximal zulässiger Wert für Temperatur stromaufwärts vom Turbolader (obere Grenze)" VALUE 0x80067450 Kw_Ws16 700.0000 Temp_Cels 99.96000 799.9600 FORMAT "%8.4" EXTENDED_LIMITS -3549.940 3003.560 /end CHARACTERISTIC
/begin CHARACTERISTIC PFltRgn_tTrbnUsMinLo_C "Maximal zulässiger Wert für Temperatur stromaufwärts vom Turbolader (untere Grenze)" VALUE 0x80067452 Kw_Ws16 700.0000 Temp_Cels 99.96000 799.9600 FORMAT "%8.4" EXTENDED_LIMITS -3549.940 3003.560 /end CHARACTERISTIC
/begin CHARACTERISTIC PFltRgn_vDynDetMax_C "Maximale Geschwindigkeit zur Dynamikerkennung" VALUE 0x80067C38 Kw_Ws16 327.6700 Vel 0.00 327.6700 FORMAT "%8.4" EXTENDED_LIMITS -327.6800 327.6700 /end CHARACTERISTIC
/begin CHARACTERISTIC PFltRgn_vDynDetMin_C "Minimale Geschwindigkeit zur Dynamikerkennung" VALUE 0x80067C3A Kw_Ws16 70.00000 Vel 0.00 70.00000 FORMAT "%8.5" EXTENDED_LIMITS -327.6800 327.6700 /end CHARACTERISTIC
/begin CHARACTERISTIC PFltRgn_volFlConsumSubs_C "Ersatzwert für EEPROM-Initialisierung der verbrauchten Gesamtkraftstoffmenge" VALUE 0x80067A2C Val_Wu16 65.50000 Fl_Vol 0.00 65.50000 FORMAT "%8.5" EXTENDED_LIMITS 0.00 65.53500 /end CHARACTERISTIC
/begin CHARACTERISTIC PFltRgn_volFlMinHi_C "Obere Hystereseschwelle zum Entfernen von der Verriegelung" VALUE 0x80067454 Kw_Ws16 100.0000 Vol 0.00 100.0000 FORMAT "%8.4" EXTENDED_LIMITS -327.6800 327.6700 /end CHARACTERISTIC
/begin CHARACTERISTIC PFltRgn_volFlMinLo_C "Untere Hystereseschwelle zum Entfernen von der Verriegelung" VALUE 0x80067456 Kw_Ws16 100.0000 Vol 0.00 100.0000 FORMAT "%8.4" EXTENDED_LIMITS -327.6800 327.6700 /end CHARACTERISTIC
/begin CHARACTERISTIC PFltRgn_vOvrRunMax_C "Maximale Geschwindigkeit zur Schuberkennung" VALUE 0x80067C3C Kw_Ws16 327.6700 Vel 0.00 327.6700 FORMAT "%8.4" EXTENDED_LIMITS -327.6800 327.6700 /end CHARACTERISTIC
/begin CHARACTERISTIC PFltRgn_vOvrRunMin_C "Minimale Geschwindigkeit zur Schuberkennung" VALUE 0x80067C3E Kw_Ws16 70.00000 Vel 0.00 70.00000 FORMAT "%8.5" EXTENDED_LIMITS -327.6800 327.6700 /end CHARACTERISTIC
/begin CHARACTERISTIC PFltSrv_ctRgnDemAdjMax_C "Maximal erlaubter Abgleichwert für die Anzahl der angeforderten Regenerationen" VALUE 0x80067C40 Val_Wu16 32767.00 OneToOne 0.00 32767.00 FORMAT "%8.2" EXTENDED_LIMITS 0.00 65535.00 /end CHARACTERISTIC
/begin CHARACTERISTIC PFltSrv_ctRgnSucAdjMax_C "Maximal erlaubter Abgleichwert für die Anzahl der erfolgreichen Regenerationen" VALUE 0x80067C42 Val_Wu16 32767.00 OneToOne 0.00 32767.00 FORMAT "%8.2" EXTENDED_LIMITS 0.00 65535.00 /end CHARACTERISTIC
/begin CHARACTERISTIC PFltSrv_dmOilAshDia_C "Ölaschenstrom für Service" VALUE 0x80067C44 Val_Ws16 1000.000 dmOilAsh_mg_p_s 0.00 1000.000 FORMAT "%8.3" EXTENDED_LIMITS -327.6800 327.6700 /end CHARACTERISTIC
/begin CHARACTERISTIC PFltSrv_facPOpOilAshAdjMax_C "Maximal erlaubter Abgleichwert für den Ölaschenfaktor" VALUE 0x80067C48 Val_Ws32 212144.000000 Fact 0.00 212144.000000 FORMAT "%13.6" EXTENDED_LIMITS -262144.000000 262143.999878 /end CHARACTERISTIC
/begin CHARACTERISTIC PFltSrv_lSumAdjMax_C "Maximal erlaubter Abgleichwert für den Streckenpunkt der letzten erfolgreichen Regeneration" VALUE 0x80067C4C Val_Ws32 21474836.0000 Length 0.00 21474836.0000 FORMAT "%13.4" EXTENDED_LIMITS -2147483648.00 2147483647.00 /end CHARACTERISTIC
/begin CHARACTERISTIC PFltSrv_lSumDiaAdjMax_C "Maximal erlaubter Abgleichwert für die Strecke seit letztem Partikelfilterwechsel" VALUE 0x80067C50 Val_Ws16 32767.00 OneToOne 0.00 32767.00 FORMAT "%8.2" EXTENDED_LIMITS -32768.00 32767.00 /end CHARACTERISTIC
/begin CHARACTERISTIC PFltSrv_mOilAshAdjMax_C "Maximal erlaubter Abgleichwert für die Ölaschenmasse" VALUE 0x80067C52 Val_Ws16 21474836. mOilAsh_g 0.00 21474836. FORMAT "%8.0" EXTENDED_LIMITS -327.6800 327.6700 /end CHARACTERISTIC
/begin CHARACTERISTIC PFltSrv_mSotContAdjMax_C "Maximal erlaubter Abgleichwert für kontinuierliche Rußmasse" VALUE 0x80067C54 Val_Ws16 655.3500 mSoot_g -327.6800 327.6700 FORMAT "%8.4" /end CHARACTERISTIC
/begin CHARACTERISTIC PFltSrv_mSotDia_C "Rußmasse bei Steuergerätewechsel ohne Wertübernahme" VALUE 0x80067C56 Val_Ws16 320.0000 mSoot_g 0.00 320.0000 FORMAT "%8.4" EXTENDED_LIMITS -327.6800 327.6700 /end CHARACTERISTIC
/begin CHARACTERISTIC PFltSrv_mSotNoContAdjMax_C "Maximal erlaubter Abgleichwert für nichtkontinuierliche Rußmasse" VALUE 0x80067C58 Val_Ws16 655.3500 mSoot_g -327.6800 327.6700 FORMAT "%8.4" /end CHARACTERISTIC
/begin CHARACTERISTIC PFltSrv_mSotRgnSucMax_C "Maximale Rußmasse für erfolgreiche Serviceregeneration" VALUE 0x80067C7C Val_Ws16 655.3500 mSoot_g -327.6800 327.6700 FORMAT "%8.4" /end CHARACTERISTIC
/begin CHARACTERISTIC PFltSrv_mSotStrtMax_C "Maximale Rußmasse zum Starten der Serviceregeneration" VALUE 0x80067CC4 Val_Ws16 300.0000 mSoot_g 0.00 300.0000 FORMAT "%8.4" EXTENDED_LIMITS -327.6800 327.6700 /end CHARACTERISTIC
/begin CHARACTERISTIC PFltSrv_mSotStrtMin_C "Minimale Rußmasse zum Starten der Serviceregeneration" VALUE 0x80067CC6 Val_Ws16 300.0000 mSoot_g 0.00 300.0000 FORMAT "%8.4" EXTENDED_LIMITS -327.6800 327.6700 /end CHARACTERISTIC
/begin CHARACTERISTIC PFltSrv_nEngIncrIdlMax_C "Maximale Drehzahl für zweite Aufheizstufe" VALUE 0x80067C7E Val_Ws16 5960.000 EngN 40.00000 6000.000 FORMAT "%8.3" EXTENDED_LIMITS -16384.00 16383.50 /end CHARACTERISTIC
/begin CHARACTERISTIC PFltSrv_nEngIncrIdlMin_C "Minimale Drehzahl für zweite Aufheizstufe" VALUE 0x80067C80 Val_Ws16 5960.000 EngN 40.00000 6000.000 FORMAT "%8.3" EXTENDED_LIMITS -16384.00 16383.50 /end CHARACTERISTIC
/begin CHARACTERISTIC PFltSrv_nMax_C "Maximale Drehzahl zum Starten der Serviceregeneration" VALUE 0x80067CC8 Val_Ws16 5960.000 EngN 40.00000 6000.000 FORMAT "%8.3" EXTENDED_LIMITS -16384.00 16383.50 /end CHARACTERISTIC
/begin CHARACTERISTIC PFltSrv_nMinClgDwn_C "Anforderung auf minimale Drehzahl während der Abkühlphase" VALUE 0x80067C82 Val_Ws16 5960.000 EngN 40.00000 6000.000 FORMAT "%8.3" EXTENDED_LIMITS -16384.00 16383.50 /end CHARACTERISTIC
/begin CHARACTERISTIC PFltSrv_nMinRgn_C "Anforderung auf minimale Drehzahl während der Serviceregeneration" VALUE 0x80067C84 Val_Ws16 5960.000 EngN 40.00000 6000.000 FORMAT "%8.3" EXTENDED_LIMITS -16384.00 16383.50 /end CHARACTERISTIC
/begin CHARACTERISTIC PFltSrv_nMin_C "Minimale Drehzahl zum Starten der Serviceregeneration" VALUE 0x80067CCA Val_Ws16 5960.000 EngN 40.00000 6000.000 FORMAT "%8.3" EXTENDED_LIMITS -16384.00 16383.50 /end CHARACTERISTIC
/begin CHARACTERISTIC PFltSrv_numAdjIdAdjMax_C "Maximal erlaubter Wert für die Anzahl der Abgleichwerte" VALUE 0x80067C5A Val_Wu8 255.0 OneToOne 0.00 255.0 FORMAT "%5.1" /end CHARACTERISTIC
/begin CHARACTERISTIC PFltSrv_numSrvIdAdjMax_C "Maximal erlaubter Wert für die Anzahl der Servicefälle" VALUE 0x80067C5B Val_Wu8 255.0 OneToOne 0.00 255.0 FORMAT "%5.1" /end CHARACTERISTIC
/begin CHARACTERISTIC PFltSrv_pEnvMin_C "Minimaler Luftdruck zum Starten der Serviceregeneration" VALUE 0x80067CCC Val_Ws16 3500.000 Pres_hPa 0.00 3500.000 FORMAT "%8.3" EXTENDED_LIMITS -32768.00 32767.00 /end CHARACTERISTIC
/begin CHARACTERISTIC PFltSrv_qFlAdjMax_C "Maximal erlaubter Wert für die verbrauchte Kraftstoffmenge seit letzter erfolgreicher Regeneration" VALUE 0x80067C5C Val_Ws16 327.6700 Fl_L 0.00 327.6700 FORMAT "%8.4" EXTENDED_LIMITS -327.6800 327.6700 /end CHARACTERISTIC
/begin CHARACTERISTIC PFltSrv_rAccPedMax_C "Maximale Fahrpedalstellung zum Starten der Serviceregeneration" VALUE 0x80067CCE Val_Ws16 100.0000 Prc 0.00 100.0000 FORMAT "%8.4" EXTENDED_LIMITS -400.0000 399.9878 /end CHARACTERISTIC
/begin CHARACTERISTIC PFltSrv_stHldOnClgDwnMsk_C "Maske für Bedingungen zur Weiterführung der Abkühlphase" VALUE 0x80067C88 Val_Wu32 4294967295.00 OneToOne 0.00 4294967295.00 FORMAT "%13.2" /end CHARACTERISTIC
/begin CHARACTERISTIC PFltSrv_stHldOnRgnMsk_C "Maske für Bedingungen zur Weiterführung der Serviceregeneration" VALUE 0x80067C8C Val_Wu32 4294967295.00 OneToOne 0.00 4294967295.00 FORMAT "%13.2" /end CHARACTERISTIC
/begin CHARACTERISTIC PFltSrv_stOpModeClgDwn_C "Anforderung der Betriebsart für die Serviceregeneration während Abkühlphase" VALUE 0x80067C90 Val_Wu32 4294967295.00 OneToOne 0.00 4294967295.00 FORMAT "%13.2" /end CHARACTERISTIC
/begin CHARACTERISTIC PFltSrv_stOpModeHtUp1_C "Anforderung der Betriebsart für die Serviceregeneration während erstes Auhzeizvorgangs" VALUE 0x80067C94 Val_Wu32 4294967295.00 OneToOne 0.00 4294967295.00 FORMAT "%13.2" /end CHARACTERISTIC
/begin CHARACTERISTIC PFltSrv_stOpModeHtUp2_C "Anforderung der Betriebsart für die Serviceregeneration während zweites Auhzeizvorgangs" VALUE 0x80067C98 Val_Wu32 4294967295.00 OneToOne 0.00 4294967295.00 FORMAT "%13.2" /end CHARACTERISTIC
/begin CHARACTERISTIC PFltSrv_stOpModeRgn_C "Anforderung der Betriebsart für die Serviceregeneration während der Regeneration" VALUE 0x80067C9C Val_Wu32 4294967295.00 OneToOne 0.00 4294967295.00 FORMAT "%13.2" /end CHARACTERISTIC
/begin CHARACTERISTIC PFltSrv_stRgnNoComplAdjMax_C "Maximal erlaubter Wert für den Status unvollendete Regeneration" VALUE 0x80067C5E Val_Wu8 1.000 OneToOne 0.00 1.000 FORMAT "%5.3" EXTENDED_LIMITS 0.00 255.0 /end CHARACTERISTIC
/begin CHARACTERISTIC PFltSrv_stRgnOpMMsk_C "Maske zur Auswahl der Betriebsart während der Aufheiz- und der Regenerationstufe" VALUE 0x80067CD0 Val_Wu32 4294967295.00 OneToOne 0.00 4294967295.00 FORMAT "%13.2" /end CHARACTERISTIC
/begin CHARACTERISTIC PFltSrv_stRlsMsk_C "Maske für Bedingungen zur Freigabe der Serviceregeneration" VALUE 0x80067CA0 Val_Wu32 4294967295.00 OneToOne 0.00 4294967295.00 FORMAT "%13.2" /end CHARACTERISTIC
/begin CHARACTERISTIC PFltSrv_swtCalcCondClb_C "Schalter zur Aktivierung der Berechnung aller Bedingungen zur Erleichterung der Applikation der Partikelfilter-Serviceregeneration" VALUE 0x80067CD4 Val_Wu8 255.0 OneToOne 0.00 255.0 FORMAT "%5.1" /end CHARACTERISTIC
/begin CHARACTERISTIC PFltSrv_swtCondAshCor_C "Schalter zur Aktivierung der Aschenkorrektur für die Serviceregeneration" VALUE 0x80067CD5 Val_Wu8 1.000 OneToOne 0.00 1.000 FORMAT "%5.3" EXTENDED_LIMITS 0.00 255.0 /end CHARACTERISTIC
/begin CHARACTERISTIC PFltSrv_tClntMinHi_C "Obere Hysteresegrenze der Kühlmitteltemperatur für die Bedingungen der Serviceregeneration" VALUE 0x80067CD6 Val_Ws16 200.0000 Temp_Cels -50.14000 149.8600 FORMAT "%8.4" EXTENDED_LIMITS -3549.940 3003.560 /end CHARACTERISTIC
/begin CHARACTERISTIC PFltSrv_tClntMinLo_C "Untere Hysteresegrenze der Kühlmitteltemperatur für die Bedingungen der Serviceregeneration" VALUE 0x80067CD8 Val_Ws16 200.0000 Temp_Cels -50.14000 149.8600 FORMAT "%8.4" EXTENDED_LIMITS -3549.940 3003.560 /end CHARACTERISTIC
/begin CHARACTERISTIC PFltSrv_tFlMax_C "Maximale Kraftstofftemperatur für die Bedingungen der Serviceregeneration" VALUE 0x80067CDA Val_Ws16 250.0000 Temp_Cels -50.14000 199.8600 FORMAT "%8.4" EXTENDED_LIMITS -3549.940 3003.560 /end CHARACTERISTIC
/begin CHARACTERISTIC PFltSrv_tiClgDwnMax_C "Maximale Abkühlzeit der Serviceregeneration" VALUE 0x80067CA4 Val_Ws32 42949672.9500 Time_s -21474836.4800 21474836.4700 FORMAT "%13.4" /end CHARACTERISTIC
/begin CHARACTERISTIC PFltSrv_tiDebTOxiCUsMax_C "Entprellungszeit für Überschreitung der maximalen Temperature vor Oxidationskatalysator zur Weiterführung der Serviceregeneration" VALUE 0x80067CDC Val_Ws16 655350.0 TimeDeb -327680.0 327670.0 FORMAT "%8.1" /end CHARACTERISTIC
/begin CHARACTERISTIC PFltSrv_tiDebTPFltUsMax_C "Entprellungszeit für Überschreitung der maximalen Temperature vor Partikelfilter zur Weiterführung der Serviceregeneration" VALUE 0x80067CDE Val_Ws16 655350.0 TimeDeb -327680.0 327670.0 FORMAT "%8.1" /end CHARACTERISTIC
/begin CHARACTERISTIC PFltSrv_tiEngNrm_C "Minimale Zeit des Motors im laufenden Zustand" VALUE 0x80067CE0 Val_Ws16 3600.000 TimeRed 0.00 3600.000 FORMAT "%8.3" EXTENDED_LIMITS -5242.880 5242.720 /end CHARACTERISTIC
/begin CHARACTERISTIC PFltSrv_tiEngPrtAdjMax_C "Maximal erlaubter Wert für Restzeit der Regenerationsanforderung nach Motorschutz" VALUE 0x80067C60 Val_Ws32 21474836.0000 Time_s 0.00 21474836.0000 FORMAT "%13.4" EXTENDED_LIMITS -21474836.4800 21474836.4700 /end CHARACTERISTIC
/begin CHARACTERISTIC PFltSrv_tiHtgUpMax_C "Maximale Aufheizzeit zum Erreichen der minimalen Temperaturen von Oxidationskatalysator und Partikelfilter zur Weiterführung der Serviceregeneration" VALUE 0x80067CE4 Val_Ws32 42949672.9500 Time_s -21474836.4800 21474836.4700 FORMAT "%13.4" /end CHARACTERISTIC
/begin CHARACTERISTIC PFltSrv_tiLckRlsAdjMax_C "Maximal erlaubter Wert für Restzeit der Regenerationsverriegelung" VALUE 0x80067C64 Val_Ws32 21474836.0000 Time_s 0.00 21474836.0000 FORMAT "%13.4" EXTENDED_LIMITS -21474836.4800 21474836.4700 /end CHARACTERISTIC
/begin CHARACTERISTIC PFltSrv_tiLstRgnAdjMax_C "Maximal erlaubter Wert für Restzeit der Regenerationsanforderung nach Zähler" VALUE 0x80067C68 Val_Ws32 21474836.0000 Time_s 0.00 21474836.0000 FORMAT "%13.4" EXTENDED_LIMITS -21474836.4800 21474836.4700 /end CHARACTERISTIC
/begin CHARACTERISTIC PFltSrv_tiLstRgnDia_C "Restzeit einer Regenerationanforderung nach Zähler im Service" VALUE 0x80067C6C Val_Ws32 21474836.0000 Time_s 0.00 21474836.0000 FORMAT "%13.4" EXTENDED_LIMITS -21474836.4800 21474836.4700 /end CHARACTERISTIC
/begin CHARACTERISTIC PFltSrv_tiOpAdjMax_C "Maximal erlaubter Abgleichwert für den Zeitpunkt der letzten erfolgreichen Regeneration" VALUE 0x80067C70 Val_Ws32 21474836.0000 TimeEngOn 0.00 21474836.0000 FORMAT "%13.4" EXTENDED_LIMITS -2147483648.00 2147483647.00 /end CHARACTERISTIC
/begin CHARACTERISTIC PFltSrv_tiOpPFltAdjMax_C "Maximal erlaubter Abgleichwert für Betriebsdauer der Partikelfilters" VALUE 0x80067C74 Val_Ws32 21474836.0000 TimeEngOn 0.00 21474836.0000 FORMAT "%13.4" EXTENDED_LIMITS -2147483648.00 2147483647.00 /end CHARACTERISTIC
/begin CHARACTERISTIC PFltSrv_tiRgnMax_C "Maximale Serviceregenerationszeit" VALUE 0x80067CE8 Val_Ws32 42949672.9500 Time_s -21474836.4800 21474836.4700 FORMAT "%13.4" /end CHARACTERISTIC
/begin CHARACTERISTIC PFltSrv_tiRgnSucMin_C "Minimale Regenerationszeit für eine erfolgreiche Serviceregeneration" VALUE 0x80067CA8 Val_Ws32 42949672.9500 Time_s -21474836.4800 21474836.4700 FORMAT "%13.4" /end CHARACTERISTIC
/begin CHARACTERISTIC PFltSrv_tiSrvIdlHtUp2Min_C "Minimale Zeit Drezahl im gültigen Bereich zum Übergang in die zweite Aufheizstufe" VALUE 0x80067CAC Val_Ws32 42949672.9500 Time_s -21474836.4800 21474836.4700 FORMAT "%13.4" /end CHARACTERISTIC
/begin CHARACTERISTIC PFltSrv_tiSrvIdlRgnMin_C "Minimale Zeit Drezahl im gültigen Bereich zum Übergang in die Regeneration" VALUE 0x80067CB0 Val_Ws32 42949672.9500 Time_s -21474836.4800 21474836.4700 FORMAT "%13.4" /end CHARACTERISTIC
/begin CHARACTERISTIC PFltSrv_tOilMinHi_C "Obere Hysteresegrenze der Öltemperatur für die Bedingungen der Serviceregeneration" VALUE 0x80067CEC Val_Ws16 250.0000 Temp_Cels -50.14000 199.8600 FORMAT "%8.4" EXTENDED_LIMITS -3549.940 3003.560 /end CHARACTERISTIC
/begin CHARACTERISTIC PFltSrv_tOilMinLo_C "Untere Hysteresegrenze der Öltemperatur für die Bedingungen der Serviceregeneration" VALUE 0x80067CEE Val_Ws16 250.0000 Temp_Cels -50.14000 199.8600 FORMAT "%8.4" EXTENDED_LIMITS -3549.940 3003.560 /end CHARACTERISTIC
/begin CHARACTERISTIC PFltSrv_tOxiCUsClgDwnMax_C "Maximale Temperatur vor Oxidationskatalysator zur Beendigung der Abkühlphase" VALUE 0x80067CB4 Val_Ws16 1095.000 Temp_Cels -45.04000 1049.960 FORMAT "%8.3" EXTENDED_LIMITS -3549.940 3003.560 /end CHARACTERISTIC
/begin CHARACTERISTIC PFltSrv_tOxiCUsHtgUp_C "Minimale Temperatur vor Oxidationskatalysator nach Aufheizzeit zur Weiterführung der Serviceregeneration" VALUE 0x80067CF0 Val_Ws16 1095.000 Temp_Cels -45.04000 1049.960 FORMAT "%8.3" EXTENDED_LIMITS -3549.940 3003.560 /end CHARACTERISTIC
/begin CHARACTERISTIC PFltSrv_tOxiCUsHtUp2Min_C "Minimale Temperatur vor Oxidationskatalysator zum Übergang in die zweite Aufheizstufe" VALUE 0x80067CB6 Val_Ws16 1095.000 Temp_Cels -45.04000 1049.960 FORMAT "%8.3" EXTENDED_LIMITS -3549.940 3003.560 /end CHARACTERISTIC
/begin CHARACTERISTIC PFltSrv_tOxiCUsMax_C "Maximale Temperatur vor Oxidationskatalysator zur Weiterführung der Serviceregeneration" VALUE 0x80067CF2 Val_Ws16 1095.000 Temp_Cels -45.04000 1049.960 FORMAT "%8.3" EXTENDED_LIMITS -3549.940 3003.560 /end CHARACTERISTIC
/begin CHARACTERISTIC PFltSrv_tOxiCUsRgnMin_C "Minimale Temperatur vor Oxidationskatalysator zum Übergang in die Regeneration" VALUE 0x80067CB8 Val_Ws16 1095.000 Temp_Cels -45.04000 1049.960 FORMAT "%8.3" EXTENDED_LIMITS -3549.940 3003.560 /end CHARACTERISTIC
/begin CHARACTERISTIC PFltSrv_tOxiCUsStrtMax_C "Maximale Temperatur vor Oxidationskatalysator zur Fraigabe der Serviceregeneration" VALUE 0x80067CF4 Val_Ws16 1095.000 Temp_Cels -45.04000 1049.960 FORMAT "%8.3" EXTENDED_LIMITS -3549.940 3003.560 /end CHARACTERISTIC
/begin CHARACTERISTIC PFltSrv_tOxiCUsStrtMin_C "Minimale Temperatur vor Oxidationskatalysator zur Fraigabe der Serviceregeneration" VALUE 0x80067CF6 Val_Ws16 1095.000 Temp_Cels -45.04000 1049.960 FORMAT "%8.3" EXTENDED_LIMITS -3549.940 3003.560 /end CHARACTERISTIC
/begin CHARACTERISTIC PFltSrv_tPFltUsClgDwnMax_C "Maximale Temperatur vor Partikelfilter zur Beendigung der Abkühlphase" VALUE 0x80067CBA Val_Ws16 1095.000 Temp_Cels -45.04000 1049.960 FORMAT "%8.3" EXTENDED_LIMITS -3549.940 3003.560 /end CHARACTERISTIC
/begin CHARACTERISTIC PFltSrv_tPFltUsHtgUp_C "Minimale Temperatur vor Partikelfilter nach Aufheizzeit zur Weiterführung der Serviceregeneration" VALUE 0x80067CF8 Val_Ws16 1095.000 Temp_Cels -45.04000 1049.960 FORMAT "%8.3" EXTENDED_LIMITS -3549.940 3003.560 /end CHARACTERISTIC
/begin CHARACTERISTIC PFltSrv_tPFltUsHtUp2Min_C "Minimale Temperatur vor Partikelfilter zum Übergang in die zweite Aufheizstufe" VALUE 0x80067CBC Val_Ws16 1095.000 Temp_Cels -45.04000 1049.960 FORMAT "%8.3" EXTENDED_LIMITS -3549.940 3003.560 /end CHARACTERISTIC
/begin CHARACTERISTIC PFltSrv_tPFltUsMax_C "Maximale Temperatur vor Partikelfilter zur Weiterführung der Serviceregeneration" VALUE 0x80067CFA Val_Ws16 1095.000 Temp_Cels -45.04000 1049.960 FORMAT "%8.3" EXTENDED_LIMITS -3549.940 3003.560 /end CHARACTERISTIC
/begin CHARACTERISTIC PFltSrv_tPFltUsRgnMin_C "Minimale Temperatur vor Partikelfilter zum Übergang in die Regeneration" VALUE 0x80067CBE Val_Ws16 6553.500 Temp_Cels -3549.940 3003.560 FORMAT "%8.3" /end CHARACTERISTIC
/begin CHARACTERISTIC PFltSrv_tPFltUsStrtMax_C "Maximale Temperatur vor Partikelfilter zur Fraigabe der Serviceregeneration" VALUE 0x80067CFC Val_Ws16 1095.000 Temp_Cels -45.04000 1049.960 FORMAT "%8.3" EXTENDED_LIMITS -3549.940 3003.560 /end CHARACTERISTIC
/begin CHARACTERISTIC PFltSrv_tPFltUsStrtMin_C "Minimale Temperatur vor Partikelfilter zur Fraigabe der Serviceregeneration" VALUE 0x80067CFE Val_Ws16 1095.000 Temp_Cels -45.04000 1049.960 FORMAT "%8.3" EXTENDED_LIMITS -3549.940 3003.560 /end CHARACTERISTIC
/begin CHARACTERISTIC PFltSrv_tRgnSucMin_C "Minimale Temperature vor Partikelfilter zum Abzählen der minimalen Regenerationszeit für eine erfolgreiche Serviceregeneration" VALUE 0x80067CC0 Val_Ws16 1095.000 Temp_Cels -45.04000 1049.960 FORMAT "%8.3" EXTENDED_LIMITS -3549.940 3003.560 /end CHARACTERISTIC
/begin CHARACTERISTIC PFltSrv_trqMax_CUR "Maximales Moment für Bedingungen der Serviceregeneration abhängig von Drezahl" CURVE 0x80067D00 Cur_Xs16Ws16 1500.000 Trq -500.0000 1000.000 FORMAT "%8.3" EXTENDED_LIMITS -3276.800 3276.700
 /begin AXIS_DESCR STD_AXIS Epm_nEng EngN 8 40.00000 6000.000 FORMAT "%8.3" EXTENDED_LIMITS -16384.00 16383.50 DEPOSIT ABSOLUTE /end AXIS_DESCR
/end CHARACTERISTIC
/begin CHARACTERISTIC PFltSrv_trqMin_CUR "Minimales Moment für Bedingungen der Serviceregeneration abhängig von Drezahl" CURVE 0x80067D22 Cur_Xs16Ws16 1500.000 Trq -500.0000 1000.000 FORMAT "%8.3" EXTENDED_LIMITS -3276.800 3276.700
 /begin AXIS_DESCR STD_AXIS Epm_nEng EngN 8 40.00000 6000.000 FORMAT "%8.3" EXTENDED_LIMITS -16384.00 16383.50 DEPOSIT ABSOLUTE /end AXIS_DESCR
/end CHARACTERISTIC
/begin CHARACTERISTIC PFltSrv_uBattMin_C "Minimale Batteriesspannung für Bedingungen der Serviceregeneration" VALUE 0x80067D44 Val_Ws16 20780.00 Volt_Batt 0.00 20780.00 FORMAT "%8.2" EXTENDED_LIMITS -655360.0 655340.0 /end CHARACTERISTIC
/begin CHARACTERISTIC PFltSrv_vAvrgDia_C "Durchschnittsgeschwindigkeit für Servicefall" VALUE 0x80067C78 Val_Ws16 320.0000 Vel 0.00 320.0000 FORMAT "%8.4" EXTENDED_LIMITS -327.6800 327.6700 /end CHARACTERISTIC
/begin CHARACTERISTIC PFlt_dvolCharMonMin_C "Minimaler Abgasvolumenstrom zur Überwachung der Partikelfilter-Charakteristik mit Hilfe des Differenzdruck" VALUE 0x80067D58 Val_Ws16 100.0000 AirVolPerTime 0.00 100.0000 FORMAT "%8.4" EXTENDED_LIMITS -3276.800 3276.700 /end CHARACTERISTIC
/begin CHARACTERISTIC PFlt_dvolChkDstrMin_C "Minimaler Abgasvolumenstrom zur Überprüfung des maximalen Differenzdrucks im Nachlauf" VALUE 0x80067D5A Val_Ws16 100.0000 AirVolPerTime 0.00 100.0000 FORMAT "%8.4" EXTENDED_LIMITS -3276.800 3276.700 /end CHARACTERISTIC
/begin CHARACTERISTIC PFlt_dvolMaxVar_C "Maximale Variation des Abgasvolumenstromes für die Erkennung des stationären Zustandes" VALUE 0x80067D5C Val_Ws16 100.0000 AirVolPerTime 0.00 100.0000 FORMAT "%8.4" EXTENDED_LIMITS -3276.800 3276.700 /end CHARACTERISTIC
/begin CHARACTERISTIC PFlt_mSotChkDstrMax_C "Maximale Russmasse zur Druchführung der Überwachung auf zerstörten Partikelfilter" VALUE 0x80067D5E Val_Ws16 300.0000 mSoot_g 0.00 300.0000 FORMAT "%8.4" EXTENDED_LIMITS -327.6800 327.6700 /end CHARACTERISTIC
/begin CHARACTERISTIC PFlt_mSotChkDstrMin_C "Minimale Russmasse zur Druchführung der Überwachung auf zerstörten Partikelfilter" VALUE 0x80067D60 Val_Ws16 300.0000 mSoot_g 0.00 300.0000 FORMAT "%8.4" EXTENDED_LIMITS -327.6800 327.6700 /end CHARACTERISTIC
/begin CHARACTERISTIC PFlt_mSotChkDvtMin_C "Minimale Russmasse zur Druchführung der Überwachung auf Abweichung von simulierter und gemessener Partikelmasse" VALUE 0x80067D62 Val_Ws16 300.0000 mSoot_g 0.00 300.0000 FORMAT "%8.4" EXTENDED_LIMITS -327.6800 327.6700 /end CHARACTERISTIC
/begin CHARACTERISTIC PFlt_mSotChkFlwRstnMin_C "Minimale Russmasse zur Druchführung der Überwachung der Strömungswiderstand" VALUE 0x80067D64 Val_Ws16 300.0000 mSoot_g 0.00 300.0000 FORMAT "%8.4" EXTENDED_LIMITS -327.6800 327.6700 /end CHARACTERISTIC
/begin CHARACTERISTIC PFlt_mSotHysMaxDwn_C "Untere Hysteresegrenze der Russmasse zur Überprüfung auf maximale Beladung des Partikelfilters" VALUE 0x80067D66 Val_Ws16 300.0000 mSoot_g 0.00 300.0000 FORMAT "%8.4" EXTENDED_LIMITS -327.6800 327.6700 /end CHARACTERISTIC
/begin CHARACTERISTIC PFlt_mSotHysMaxUp_C "Obere Hysteresegrenze der Russmasse zur Überprüfung auf maximale Beladung des Partikelfilters" VALUE 0x80067D68 Val_Ws16 300.0000 mSoot_g 0.00 300.0000 FORMAT "%8.4" EXTENDED_LIMITS -327.6800 327.6700 /end CHARACTERISTIC
/begin CHARACTERISTIC PFlt_pDiffCharMonMin_MAP "Von Russmasse und Abgasvolumenstrom abhängiger minimaler Differenzdruck für die Überwachung auf Filterdurchbruch" MAP 0x80067D6A Kf_Xs16_Ys16_Ws16 3500.000 Pres_hPa 0.00 3500.000 FORMAT "%8.3" EXTENDED_LIMITS -32768.00 32767.00
 /begin AXIS_DESCR STD_AXIS ASMod_dvolPFltEG AirVolPerTime 8 0.00 1000.000 FORMAT "%8.3" EXTENDED_LIMITS -3276.800 3276.700 DEPOSIT ABSOLUTE /end AXIS_DESCR
 /begin AXIS_DESCR STD_AXIS PFltLd_mSotSimCont mSoot_g 8 -327.6700 327.6700 FORMAT "%8.4" EXTENDED_LIMITS -327.6800 327.6700 DEPOSIT ABSOLUTE /end AXIS_DESCR
/end CHARACTERISTIC
/begin CHARACTERISTIC PFlt_pDiffNoDstrMin_CUR "Von stationärem Abgasvolumenstrom abhängiger minimaler Differenzdruck in Nachlauf zur Unterstellung eines zerstörten Partikelfilters" CURVE 0x80067E0E Cur_Xs16Ws16 3500.000 Pres_hPa 0.00 3500.000 FORMAT "%8.3" EXTENDED_LIMITS -32768.00 32767.00
 /begin AXIS_DESCR STD_AXIS PFlt_dvolMaxSty_mp AirVolPerTime 8 0.00 3500.000 FORMAT "%8.3" EXTENDED_LIMITS -3276.800 3276.700 DEPOSIT ABSOLUTE /end AXIS_DESCR
/end CHARACTERISTIC
/begin CHARACTERISTIC PFlt_resFlwMax_CUR "Maximale Strömungswiderstand abhängig von kontinuirlich simulierter Russmasse" CURVE 0x80067E30 Cur_Xs16Ws16 2.500000 Res_hPaHrPerCM 0.00 2.500000 FORMAT "%8.6" EXTENDED_LIMITS -3.276800 3.276700
 /begin AXIS_DESCR STD_AXIS PFltLd_mSotSimCont mSoot_g 8 -327.6700 327.6700 FORMAT "%8.4" EXTENDED_LIMITS -327.6800 327.6700 DEPOSIT ABSOLUTE /end AXIS_DESCR
/end CHARACTERISTIC
/begin CHARACTERISTIC PFlt_resFlwMin_CUR "Mnimaler Strömungswiderstand abhängig von kontinuirlich simulierter Russmasse" CURVE 0x80067E52 Cur_Xs16Ws16 2.500000 Res_hPaHrPerCM 0.00 2.500000 FORMAT "%8.6" EXTENDED_LIMITS -3.276800 3.276700
 /begin AXIS_DESCR STD_AXIS PFltLd_mSotSimCont mSoot_g 8 -327.6700 327.6700 FORMAT "%8.4" EXTENDED_LIMITS -327.6800 327.6700 DEPOSIT ABSOLUTE /end AXIS_DESCR
/end CHARACTERISTIC
/begin CHARACTERISTIC PFlt_rSotMsDvtMax_C "Maximale normierte Abweichung zwischen gemessener und kontinuierlich simulierter Russmasse" VALUE 0x80067E74 Val_Ws16 4.000000 RatSotSot 0.00 4.000000 FORMAT "%8.6" EXTENDED_LIMITS -8.192000 8.191750 /end CHARACTERISTIC
/begin CHARACTERISTIC PFlt_rSotMsDvtMin_C "Minimale normierte Abweichung zwischen gemessener und kontinuierlich simulierter Russmasse" VALUE 0x80067E76 Val_Ws16 4.000000 RatSotSot -4.000000 0.00 FORMAT "%8.6" EXTENDED_LIMITS -8.192000 8.191750 /end CHARACTERISTIC
/begin CHARACTERISTIC PFlt_stCharMonRgnOffMsk_CA "Maske zur Auswahl der Betriebsarten für Überwachung des Strömungswiderstandes" VAL_BLK 0x80067E78 Kwb_Wu32 4294967295.00 OneToOne 0.00 4294967295.00 FORMAT "%13.2" NUMBER 2 /end CHARACTERISTIC
/begin CHARACTERISTIC PFlt_stChkDstrMsk_CA "Maske zur Auswahl der Betriebsarten für Überwachung auf zerstörten Partikelfilter" VAL_BLK 0x80067E80 Kwb_Wu32 4294967295.00 OneToOne 0.00 4294967295.00 FORMAT "%13.2" NUMBER 2 /end CHARACTERISTIC
/begin CHARACTERISTIC PFlt_swtActv_C "Schalter zur Deaktivierung der Partikelfilter-Funktionalität" VALUE 0x80067D54 Val_Wu8 1.000 OneToOne 0.00 1.000 FORMAT "%5.3" EXTENDED_LIMITS 0.00 255.0 /end CHARACTERISTIC
/begin CHARACTERISTIC PFlt_swtMonAshCor_C "Schalter zur Aktivierung der Aschenkorrektur für die Partikelfilter-Überwachung" VALUE 0x80067E88 Val_Wu8 1.000 OneToOne 0.00 1.000 FORMAT "%5.3" EXTENDED_LIMITS 0.00 255.0 /end CHARACTERISTIC
/begin CHARACTERISTIC PFlt_swtSrvVal_C "Schalter zum Rücksetzen der EEPROM-Werte" VALUE 0x80067D55 Val_Wu8 255.0 OneToOne 0.00 255.0 FORMAT "%5.1" /end CHARACTERISTIC
/begin CHARACTERISTIC PFlt_swtTrgCharMon_C "Schalter zur Auswahl der Bedingung für die Überwachung des DPF durch Überprüfung des berechneten Strömungswiderstands" VALUE 0x80067E89 Val_Wu8 255.0 OneToOne 0.00 255.0 FORMAT "%5.1" /end CHARACTERISTIC
/begin CHARACTERISTIC PFlt_tiDvolStyChk_C "Minimale Zeit für die Erkennung eines stationäres Abgasvolumenstromes" VALUE 0x80067E8A Val_Ws16 100.0000 Time_s 0.00 100.0000 FORMAT "%8.4" EXTENDED_LIMITS -327.6800 327.6700 /end CHARACTERISTIC
/begin MEASUREMENT ASMod_dmNOxEG "NOx-Massenstrom im Abgas nach Verbrennung" SWORD NOxMassPerTime 1 100 -3276.800 3276.700 FORMAT "%8.3" ECU_ADDRESS 0xD00069DC /end MEASUREMENT
/begin MEASUREMENT ASMod_dmSotEG "Ruß-Massenstrom im Abgas nach Verbrennung" SWORD SotMassPerTime 1 100 -327.6800 327.6700 FORMAT "%8.4" ECU_ADDRESS 0xD00069F6 /end MEASUREMENT
/begin MEASUREMENT Exh_pOfsValActMidPPFltDiff "" SWORD Pres_hPa 1 100 -32768.00 3500.00 FORMAT "%8.2" ECU_ADDRESS 0xD0006EB2 /end MEASUREMENT
/begin MEASUREMENT Exh_pRawAdapPPFltDiff "" SWORD Pres_hPa 1 100 -32768.00 3500.00 FORMAT "%8.2" ECU_ADDRESS 0xD0006EBC /end MEASUREMENT
/begin MEASUREMENT Exh_stStyPPFltDiff "" UBYTE OneToOne 1 100 0.00 255.0 FORMAT "%5.1" ECU_ADDRESS 0xD000900E /end MEASUREMENT
/begin MEASUREMENT Exh_stTrgAftRunPPFltDiff "" UBYTE OneToOne 1 100 0.00 255.0 FORMAT "%5.1" ECU_ADDRESS 0xD000900F /end MEASUREMENT
/begin MEASUREMENT FuelLvl_vol "" SWORD Vol 1 100 -327.6800 327.6700 FORMAT "%8.4" ECU_ADDRESS 0xD0006F46 /end MEASUREMENT
/begin MEASUREMENT PCV_ctAdapt1_mp "Zähler für die Anzahl der Funktionsaufrufe der PCV-Adaption im Zustand PCV_ADAPT_STABLE" UWORD OneToOne 1 100 0.00 65535.00 FORMAT "%8.2" ECU_ADDRESS 0xC000159A /end MEASUREMENT
/begin MEASUREMENT PCV_ctAdapt2_mp "Zähler für die Anzahl der Funktionsaufrufe der PCV-Adaption im Zustand PCV_ADAPT_SUM_UP" UWORD OneToOne 1 100 0.00 65535.00 FORMAT "%8.2" ECU_ADDRESS 0xC000159C /end MEASUREMENT
/begin MEASUREMENT PCV_ctAdapt3_mp "Zähler für die erfolgreiche Berechnung der Adaption" ULONG OneToOne 1 100 0.00 4294967295.00 FORMAT "%13.2" ECU_ADDRESS 0xC00015A0 /end MEASUREMENT
/begin MEASUREMENT PCV_dvolFlow_mp "Eingangswert für das Kennfeld PCV_facAdaptFlow_MAP" SWORD Qp_mm3_sec 1 100 -327680.0 327670.0 FORMAT "%8.1" ECU_ADDRESS 0xC00015A4 /end MEASUREMENT
/begin MEASUREMENT PCV_dvolLeak_mp "Leckage des Druckregelventils" SWORD Qp_mm3_sec 1 100 -327680.0 327670.0 FORMAT "%8.1" ECU_ADDRESS 0xC00015CC /end MEASUREMENT
/begin MEASUREMENT PCV_facAdapt "Adaptionsfaktor für die PCV-Kennlinie" SWORD Fact 1 100 -4.000000 3.999878 FORMAT "%8.6" ECU_ADDRESS 0xD000741C /end MEASUREMENT
/begin MEASUREMENT PCV_facAdaptFlow "Faktor zur Abschätzung des Durchflusses durch das PCV" SWORD Fact 1 100 -4.000000 3.999878 FORMAT "%8.6" ECU_ADDRESS 0xD000741E /end MEASUREMENT
/begin MEASUREMENT PCV_facCrntCtlLim_mp "Drucksollwert von der Raildruckregelung für das Druckregelventil" SWORD Fact 1 100 -4.000000 3.999878 FORMAT "%8.6" ECU_ADDRESS 0xC00015BE /end MEASUREMENT
/begin MEASUREMENT PCV_iActFlt_mp "Drucksollwert von der Raildruckregelung für das Druckregelventil" SWORD Curr 1 100 -32768.00 32767.00 FORMAT "%8.2" ECU_ADDRESS 0xC00015C0 /end MEASUREMENT
/begin MEASUREMENT PCV_iActVal "Analogeingang Strom-Istwert" SWORD Curr 1 100 -32768.00 32767.00 FORMAT "%8.2" ECU_ADDRESS 0xD0007420 /end MEASUREMENT
/begin MEASUREMENT PCV_iAct_mp "Sollstrom für das Druckregelventil" SWORD Curr 1 100 -32768.00 32767.00 FORMAT "%8.2" ECU_ADDRESS 0xC00015C2 /end MEASUREMENT
/begin MEASUREMENT PCV_iDvt "Sollstrom für das Druckregelventil" SWORD Curr 1 100 -32768.00 32767.00 FORMAT "%8.2" ECU_ADDRESS 0xD0007422 /end MEASUREMENT
/begin MEASUREMENT PCV_iSet "Sollstrom für das Druckregelventil" SWORD Curr 1 100 -32768.00 32767.00 FORMAT "%8.2" ECU_ADDRESS 0xD0007424 /end MEASUREMENT
/begin MEASUREMENT PCV_iSetClose_mp "Strom zum Schließen des Druckregelventils" SWORD Curr 1 100 -32768.00 32767.00 FORMAT "%8.2" ECU_ADDRESS 0xC00015C4 /end MEASUREMENT
/begin MEASUREMENT PCV_iSetFlt_mp "Sollstrom für das Druckregelventil" SWORD Curr 1 100 -32768.00 32767.00 FORMAT "%8.2" ECU_ADDRESS 0xC00015C6 /end MEASUREMENT
/begin MEASUREMENT PCV_pAdaptThres_mp "Raildruckschwelle für die Berechnung des Adaptionsfaktors" SWORD Pres_Rail 1 100 -3276.800 2000.000 FORMAT "%5.3" ECU_ADDRESS 0xC00015A6 /end MEASUREMENT
/begin MEASUREMENT PCV_pFltSum_mp "Aufsummierter Raildruck für Mittelwertbildung" SLONG Pres_Rail 1 100 -214748364.800 2000.000 FORMAT "%10.3" ECU_ADDRESS 0xC00015A8 /end MEASUREMENT
/begin MEASUREMENT PCV_pSet "Drucksollwert von der Raildruckregelung für das Druckregelventil" SWORD Pres_Rail 1 100 -3276.800 2000.000 FORMAT "%5.3" ECU_ADDRESS 0xD0007426 /end MEASUREMENT
/begin MEASUREMENT PCV_pSetSum_mp "Aufsummierter Steuerdruck für das PCV für Mittelwertbildung" SLONG Pres_Rail 1 100 -214748364.800 2000.000 FORMAT "%10.3" ECU_ADDRESS 0xC00015AC /end MEASUREMENT
/begin MEASUREMENT PCV_rPs_mp "Ausgangstastverhältnis" SWORD DtyCyc 1 100 -327.6800 327.6700 FORMAT "%8.4" ECU_ADDRESS 0xC00015B4 /end MEASUREMENT
/begin MEASUREMENT PCV_rSetDT1_mp "Sollwert Tastverhältnis mit DT1-Anteil" SWORD DtyCyc 1 100 -327.6800 327.6700 FORMAT "%8.4" ECU_ADDRESS 0xC00015B6 /end MEASUREMENT
/begin MEASUREMENT PCV_rSetLin_mp "Linearisierter Sollwert für das Druckregelventil" SWORD DtyCyc 1 100 -327.6800 327.6700 FORMAT "%8.4" ECU_ADDRESS 0xC00015B8 /end MEASUREMENT
/begin MEASUREMENT PCV_rSet_mp "Sollwert Tastverhältnis für Druckregelventil" SWORD DtyCyc 1 100 -327.6800 327.6700 FORMAT "%8.4" ECU_ADDRESS 0xC00015BA /end MEASUREMENT
/begin MEASUREMENT PCV_stActrCtl "Zustand der Stellwertsteuerung für das Druckregelventil" UBYTE OneToOne 1 100 0.00 255.0 FORMAT "%5.1" ECU_ADDRESS 0xD0009116 /end MEASUREMENT
/begin MEASUREMENT PCV_stAdapt "Status des Statusautomaten der Adaptionsfunktion" UBYTE OneToOne 1 100 0.00 255.0 FORMAT "%5.1" ECU_ADDRESS 0xD0009117 /end MEASUREMENT
/begin MEASUREMENT PCV_stAdaptMeUn "Freigabe-Botschaft für die Zumesseinheit" UBYTE OneToOne 1 100 0.00 255.0 FORMAT "%5.1" ECU_ADDRESS 0xD0009118 /end MEASUREMENT
/begin MEASUREMENT PCV_stEngStrtMov_mp "Motorbewegung bei der Berechnung des elektrischen Sollstroms für das Druckregelventil" UBYTE OneToOne 1 100 0.00 255.0 FORMAT "%5.1" ECU_ADDRESS 0xC00015C8 /end MEASUREMENT
/begin MEASUREMENT PCV_stSetClose_mp "Zustandsanforderung zum Schließen des Druckregelventils" UBYTE OneToOne 1 100 0.00 255.0 FORMAT "%5.1" ECU_ADDRESS 0xC00015C9 /end MEASUREMENT
/begin MEASUREMENT PCV_swtCtlState "Drucksollwert von der Raildruckregelung für das Druckregelventil" UBYTE OneToOne 1 100 0.00 255.0 FORMAT "%5.1" ECU_ADDRESS 0xD0009119 /end MEASUREMENT
/begin MEASUREMENT PCV_tiAdaptLst_mp "Zeitpunkt, bei dem die letzte Adaptierung stattgefunden hat" ULONG TimeEngOn 1 100 0.00 4294967295.00 FORMAT "%13.2" ECU_ADDRESS 0xC00015B0 /end MEASUREMENT
/begin MEASUREMENT PCV_tiSetCloseMax_mp "Verweilzeit im Zustand PCV_stActrCtl == PCV_CLOSE_MODE (0x20)" UWORD Time_ms 1 100 0.00 655350.0 FORMAT "%8.1" ECU_ADDRESS 0xC00015CA /end MEASUREMENT
/begin MEASUREMENT PCV_uRaw_mp "Sollwert Tastverhältnis für Druckregelventil" SWORD Volt 1 100 -6553.600 6553.400 FORMAT "%8.3" ECU_ADDRESS 0xC00015BC /end MEASUREMENT
/begin MEASUREMENT PFltLd_dmNO2TotMax_mp "Maximaler durch NO2-Effekt regenerierbar Rußmassenstrom" SWORD dmSoot_mg_p_s 1 100 -327.6800 327.6700 FORMAT "%8.4" ECU_ADDRESS 0xC0001634 /end MEASUREMENT
/begin MEASUREMENT PFltLd_dmNO2Tot_mp "insgesamt zur Verfügung stehender NO2-Massenstrom" SWORD dmNOx_mg_p_s 1 100 -4915.200 4915.050 FORMAT "%8.3" ECU_ADDRESS 0xC0001636 /end MEASUREMENT
/begin MEASUREMENT PFltLd_dmO2Aprx "Sauerstoff-Massenstrom nach Abgaskrummer" SWORD AirMassPerTime 1 100 -3276.800 3276.700 FORMAT "%8.3" ECU_ADDRESS 0xD0007428 /end MEASUREMENT
/begin MEASUREMENT PFltLd_dmOilAshEG_mp "Öl-Asche-Massenstrom aus dem Massenstrom in Abgaskrümmer" SWORD dmOilAsh_mg_p_s 1 100 -327.6800 327.6700 FORMAT "%8.4" ECU_ADDRESS 0xC00015D4 /end MEASUREMENT
/begin MEASUREMENT PFltLd_dmSotRaw_mp "produzierte Partikelmasse" SWORD dmSoot_mg_p_s 1 100 -327.6800 327.6700 FORMAT "%8.4" ECU_ADDRESS 0xC0001638 /end MEASUREMENT
/begin MEASUREMENT PFltLd_dmSotSim "gesamt produzierter Rußmassenstrom" SWORD dmSoot_mg_p_s 1 100 -327.6800 327.6700 FORMAT "%8.4" ECU_ADDRESS 0xD000742A /end MEASUREMENT
/begin MEASUREMENT PFltLd_dmSotSimRgnBas_mp "Basiswert für produzierter Rußmassenstrom" SWORD dmSoot_mg_p_s 1 100 -327.6800 327.6700 FORMAT "%8.4" ECU_ADDRESS 0xC000163A /end MEASUREMENT
/begin MEASUREMENT PFltLd_dmSotSimRgnNO2Raw_mp "unverzögerter abgebauter Partikelmassenstrom in Simulation durch NO2" SWORD dmSoot_mg_p_s 1 100 -327.6800 327.6700 FORMAT "%8.4" ECU_ADDRESS 0xC000163C /end MEASUREMENT
/begin MEASUREMENT PFltLd_dmSotSimRgnNO2_mp "verzögerter abgebauter Partikelmassenstrom in Simulation durch NO2" SWORD dmSoot_mg_p_s 1 100 -327.6800 327.6700 FORMAT "%8.4" ECU_ADDRESS 0xC000163E /end MEASUREMENT
/begin MEASUREMENT PFltLd_dmSotSimRgnThr_mp "abgebauter Partikelmassenstrom in Simulation durch thermische Regeneration" SWORD dmSoot_mg_p_s 1 100 -327.6800 327.6700 FORMAT "%8.4" ECU_ADDRESS 0xC0001640 /end MEASUREMENT
/begin MEASUREMENT PFltLd_dmSotSimRgn_mp "regenerierte Partikelmasse" SWORD dmSoot_mg_p_s 1 100 -327.6800 327.6700 FORMAT "%8.4" ECU_ADDRESS 0xC0001642 /end MEASUREMENT
/begin MEASUREMENT PFltLd_dpDiff_mp "DT1 gefiltert Differenzdruck über Partikelfilter" SWORD dPres_hPa_p_s 1 100 -32768.00 32767.00 FORMAT "%8.2" ECU_ADDRESS 0xC00015CE /end MEASUREMENT
/begin MEASUREMENT PFltLd_dvolPFltEGFlt_mp "Abgasvolumenstrom gefiltert" SWORD CubMtrPerHr 1 100 -3276.800 3276.700 FORMAT "%8.3" ECU_ADDRESS 0xC00015F0 /end MEASUREMENT
/begin MEASUREMENT PFltLd_facAshCor "Ash correction factor" SWORD Fact 1 100 -4.000000 3.999878 FORMAT "%8.6" ECU_ADDRESS 0xD000742C /end MEASUREMENT
/begin MEASUREMENT PFltLd_facAshVolCor_mp "Aschevolumen-abhängiger Korrekturfaktor des Differenzdrukkes" SWORD Fact4 1 100 -1638.400 1638.350 FORMAT "%8.3" ECU_ADDRESS 0xC00015F2 /end MEASUREMENT
/begin MEASUREMENT PFltLd_facO2SimRgn_mp "Korrekturfaktor für die thermische Rußabbrandsberechnung abhängig von Lambda- und sauerstoffmassenstromabhängigen" SWORD Fact 1 100 -4.000000 3.999878 FORMAT "%8.6" ECU_ADDRESS 0xC0001644 /end MEASUREMENT
/begin MEASUREMENT PFltLd_facPOpOilAshAvrg_mp "gemittelter Korrekturfaktor für Ölascheeintrag in den Partikelfilter" SWORD Fact 1 100 -4.000000 3.999878 FORMAT "%8.6" ECU_ADDRESS 0xC00015D6 /end MEASUREMENT
/begin MEASUREMENT PFltLd_facPOpOilAshSum_mp "Summe der Korrekturfaktoren für Ölascheeintrag in den Partikelfilter" SLONG Fact4 1 100 -107374182.400 107374182.350 FORMAT "%13.3" ECU_ADDRESS 0xC00015D8 /end MEASUREMENT
/begin MEASUREMENT PFltLd_facPOpOilAsh_mp "aktueller Korrekturfaktor für Ölascheeintrag in den Partikelfilter" SWORD Fact4 1 100 -1638.400 1638.350 FORMAT "%8.3" ECU_ADDRESS 0xC00015DC /end MEASUREMENT
/begin MEASUREMENT PFltLd_facSotSimRgnNO2_mp "Faktor für die NOx-Emission-Abhängigkeit von der Beladung des Partikelfilters" SWORD Fact 1 100 -4.000000 3.999878 FORMAT "%8.6" ECU_ADDRESS 0xC0001646 /end MEASUREMENT
/begin MEASUREMENT PFltLd_facSotSimRgn_mp "Korrekturfaktor für Berechnung des thermischen Rußabbrands" SWORD Fact 1 100 -4.000000 3.999878 FORMAT "%8.6" ECU_ADDRESS 0xC0001648 /end MEASUREMENT
/begin MEASUREMENT PFltLd_facTempNO2_mp "Faktor für die NOx-Emission-Abhängigkeit von der Temperatur" SWORD Fact 1 100 -4.000000 3.999878 FORMAT "%8.6" ECU_ADDRESS 0xC000164A /end MEASUREMENT
/begin MEASUREMENT PFltLd_facTempSimRgn_mp "Einfluß der Temperatur auf regenerierte Partikelmasse" SWORD Fact 1 100 -4.000000 3.999878 FORMAT "%8.6" ECU_ADDRESS 0xC000164C /end MEASUREMENT
/begin MEASUREMENT PFltLd_facVolFlwNO2_mp "Faktor für die NOx-Emission-Abhängigkeit vom Abgasvolumenstrom" SWORD Fact 1 100 -4.000000 3.999878 FORMAT "%8.6" ECU_ADDRESS 0xC000164E /end MEASUREMENT
/begin MEASUREMENT PFltLd_mOilAshEG_mp "Öl-Asche-Masse aus dem Massenstrom in Abgaskrümmer" SWORD mOilAsh_g 1 100 -327.6800 327.6700 FORMAT "%8.4" ECU_ADDRESS 0xC00015DE /end MEASUREMENT
/begin MEASUREMENT PFltLd_mSot "" SWORD mSoot_g 1 100 -327.6800 327.6700 FORMAT "%8.4" ECU_ADDRESS 0xD000742E /end MEASUREMENT
/begin MEASUREMENT PFltLd_mSotAddCorNO2_mp "Offsetwerte der gemessenen Rußmasse nach einer NO2-Regenerationsphase" SWORD mSoot_g 1 100 -327.6800 327.6700 FORMAT "%8.4" ECU_ADDRESS 0xC00015F4 /end MEASUREMENT
/begin MEASUREMENT PFltLd_mSotAddCorStrt_mp "Offsetwerte der gemessenen Rußmasse nach Motorstart" SWORD mSoot_g 1 100 -327.6800 327.6700 FORMAT "%8.4" ECU_ADDRESS 0xC00015F6 /end MEASUREMENT
/begin MEASUREMENT PFltLd_mSotBefNO2_mp "Rußmasse am Beginn der NO2-Regeneration" UBYTE mSoot_g 1 100 0.00 2.550 FORMAT "%5.3" ECU_ADDRESS 0xC00015F8 /end MEASUREMENT
/begin MEASUREMENT PFltLd_mSotCrv_mp "Partikelmasse unter Berücksichtigung des Korrekturfaktors" SWORD mSoot_g 1 100 -327.6800 327.6700 FORMAT "%8.4" ECU_ADDRESS 0xC00015FA /end MEASUREMENT
/begin MEASUREMENT PFltLd_mSotDiffNO2_mp "Änderung der Rußmasse während NO2-Regeneration" UBYTE mSoot_g 1 100 0.00 2.550 FORMAT "%5.3" ECU_ADDRESS 0xC00015FC /end MEASUREMENT
/begin MEASUREMENT PFltLd_mSotIntegIni_mp "Rußmasse zur Initialisierung der Integratoren für Rußmassensimulation" SWORD mSoot_g 1 100 -327.6800 327.6700 FORMAT "%8.4" ECU_ADDRESS 0xC0001650 /end MEASUREMENT
/begin MEASUREMENT PFltLd_mSotMeas "Partikelmasse additivkorrigiert" SWORD mSoot_g 1 100 -327.6800 327.6700 FORMAT "%8.4" ECU_ADDRESS 0xD0007430 /end MEASUREMENT
/begin MEASUREMENT PFltLd_mSotMeasBas_mp "Rußmassenbasiswert" SWORD mSoot_g 1 100 -327.6800 327.6700 FORMAT "%8.4" ECU_ADDRESS 0xC00015FE /end MEASUREMENT
/begin MEASUREMENT PFltLd_mSotMeasLstVld_mp "Letzte gültige gemessene Rußmasse vor Aktivierung der Simulation der Partikelmasse" SWORD mSoot_g 1 100 -327.6800 327.6700 FORMAT "%8.4" ECU_ADDRESS 0xC0001600 /end MEASUREMENT
/begin MEASUREMENT PFltLd_mSotMeasRaw_mp "Strömungswdst. in Partikelmasse umgerechnet" SWORD mSoot_g 1 100 -327.6800 327.6700 FORMAT "%8.4" ECU_ADDRESS 0xC0001602 /end MEASUREMENT
/begin MEASUREMENT PFltLd_mSotMeasStdByEx_mp "Letzte gültige gemessene Rußmasse vor der NO2-Regeneration" UBYTE mSoot_g 1 100 0.00 2.550 FORMAT "%5.3" ECU_ADDRESS 0xC0001604 /end MEASUREMENT
/begin MEASUREMENT PFltLd_mSotOfsNO2Act_mp "Aktueller Korrekturwert der Rußmasse für NO2-Regeneration" SWORD mSoot_g 1 100 -327.6800 327.6700 FORMAT "%8.4" ECU_ADDRESS 0xC0001606 /end MEASUREMENT
/begin MEASUREMENT PFltLd_mSotOfsNO2Max_mp "Maximaler offsetkorrekturwert der Rußmasse aus NO2-Regeneration" SWORD mSoot_g 1 100 -327.6800 327.6700 FORMAT "%8.4" ECU_ADDRESS 0xC0001608 /end MEASUREMENT
/begin MEASUREMENT PFltLd_mSotOfsNO2Sum_mp "Summe von Korrekturwerten der Rußmasse für NO2-Regeneration zur Ermittlung des Mittelwertes" SLONG mSoot_g 1 100 -21474836.4800 21474836.4700 FORMAT "%13.4" ECU_ADDRESS 0xC000160C /end MEASUREMENT
/begin MEASUREMENT PFltLd_mSotOfsNO2Tot_mp "In einer vorausgegangenen NO2-Regenerationsphase ermittelter Korrekturwert der Rußmasse" UBYTE mSoot_g 1 100 0.00 2.550 FORMAT "%5.3" ECU_ADDRESS 0xC0001610 /end MEASUREMENT
/begin MEASUREMENT PFltLd_mSotOfsNO2_mp "Ermittelten Rußmassen-Offsets für NO2 Regeneration" SWORD mSoot_g 1 100 -327.6800 327.6700 FORMAT "%8.4" ECU_ADDRESS 0xC0001612 /end MEASUREMENT
/begin MEASUREMENT PFltLd_mSotOfsStrtAct_mp "Aktueller Korrekturwert der Rußmasse für Motorstart" SWORD mSoot_g 1 100 -327.6800 327.6700 FORMAT "%8.4" ECU_ADDRESS 0xC0001614 /end MEASUREMENT
/begin MEASUREMENT PFltLd_mSotOfsStrtMax_mp "Maximaler offsetkorrekturwert der Rußmasse aus Motorstart" SWORD mSoot_g 1 100 -327.6800 327.6700 FORMAT "%8.4" ECU_ADDRESS 0xC0001616 /end MEASUREMENT
/begin MEASUREMENT PFltLd_mSotOfsStrtSum_mp "Summe von Korrekturwerten der Rußmasse für Motorstart zur Ermittlung des Mittelwertes" SLONG mSoot_g 1 100 -21474836.4800 21474836.4700 FORMAT "%13.4" ECU_ADDRESS 0xC0001618 /end MEASUREMENT
/begin MEASUREMENT PFltLd_mSotOfsStrt_mp "Ermittelten Rußmassen-Offsets für Motorstart" SWORD mSoot_g 1 100 -327.6800 327.6700 FORMAT "%8.4" ECU_ADDRESS 0xC000161C /end MEASUREMENT
/begin MEASUREMENT PFltLd_mSotResAct_mp "aktuelle betriebspunktabhängige Restrussmasse im Partikelfilter nach erflogreicher Regeneration" SWORD mSoot_g 1 100 -327.6800 327.6700 FORMAT "%8.4" ECU_ADDRESS 0xC0001652 /end MEASUREMENT
/begin MEASUREMENT PFltLd_mSotRes_mp "Restrussmasse im Partikelfilter nach erfolgreicher Regeneration" SWORD mSoot_g 1 100 -327.6800 327.6700 FORMAT "%8.4" ECU_ADDRESS 0xC0001654 /end MEASUREMENT
/begin MEASUREMENT PFltLd_mSotRgnThr_mp "" SWORD mSoot_g 1 100 -327.6800 327.6700 FORMAT "%8.4" ECU_ADDRESS 0xC0001656 /end MEASUREMENT
/begin MEASUREMENT PFltLd_mSotSim "" SWORD mSoot_g 1 100 -327.6800 327.6700 FORMAT "%8.4" ECU_ADDRESS 0xD0007432 /end MEASUREMENT
/begin MEASUREMENT PFltLd_mSotSimCont "kontinuierlich simulierte Partikelmasse" SWORD mSoot_g 1 100 -327.6800 327.6700 FORMAT "%8.4" ECU_ADDRESS 0xD0007434 /end MEASUREMENT
/begin MEASUREMENT PFltLd_mSotSimContEEP_mp "Im EEPROM gespeicherter Wert der kontinuierlich simulierte Partikelmasse" SWORD mSoot_g 1 100 -327.6800 327.6700 FORMAT "%8.4" ECU_ADDRESS 0xC0001658 /end MEASUREMENT
/begin MEASUREMENT PFltLd_mSotSimNoContEEP "Im EEPROM gespeicherter Wert der nicht kontinuierlich simulierten Partikelmasse" SWORD mSoot_g 1 100 -327.6800 327.6700 FORMAT "%8.4" ECU_ADDRESS 0xD0007436 /end MEASUREMENT
/begin MEASUREMENT PFltLd_mSotSimNoCont_mp "nicht kontinuierlich simulierte Partikelmasse" SWORD mSoot_g 1 100 -327.6800 327.6700 FORMAT "%8.4" ECU_ADDRESS 0xC000165A /end MEASUREMENT
/begin MEASUREMENT PFltLd_numValAvrgOfsNO2_mp "Anzahl der durchgeführten Mittelungszyklen für Rußmassenoffset-Berechnung bei NO2-Regeneration" UWORD OneToOne 1 100 0.00 65535.00 FORMAT "%8.2" ECU_ADDRESS 0xC000161E /end MEASUREMENT
/begin MEASUREMENT PFltLd_numValAvrgOfsStrt_mp "Anzahl der durchgeführten Mittelungszyklen für Rußmassenoffset-Berechnung bei Motorstart" UWORD OneToOne 1 100 0.00 65535.00 FORMAT "%8.2" ECU_ADDRESS 0xC0001620 /end MEASUREMENT
/begin MEASUREMENT PFltLd_pDiffAshVolCor_mp "Differenzdruck des aschebeladenen Partikelfilters" SWORD Pres_hPa 1 100 -32768.00 3500.00 FORMAT "%8.2" ECU_ADDRESS 0xC0001622 /end MEASUREMENT
/begin MEASUREMENT PFltLd_pDiffPFlt_mp "Differenzdruck des leeren Partikelfilters" SWORD Pres_hPa 1 100 -32768.00 3500.00 FORMAT "%8.2" ECU_ADDRESS 0xC0001624 /end MEASUREMENT
/begin MEASUREMENT PFltLd_pDiffSot_mp "Differenzdruckanteil des Rußes im Partikelfilter" SWORD Pres_hPa 1 100 -32768.00 3500.00 FORMAT "%8.2" ECU_ADDRESS 0xC0001626 /end MEASUREMENT
/begin MEASUREMENT PFltLd_resFlw "Strömungswiderstand des Partikelfilters" SWORD Res_hPaHrPerCM 1 100 -3.276800 3.276700 FORMAT "%8.6" ECU_ADDRESS 0xD000743C /end MEASUREMENT
/begin MEASUREMENT PFltLd_resFlwFlt "" SWORD Res_hPaHrPerCM 1 100 -3.276800 3.276700 FORMAT "%8.6" ECU_ADDRESS 0xD000743E /end MEASUREMENT
/begin MEASUREMENT PFltLd_resFlwMeasInv_mp "Strömungswiderstand aus inversem Strömungswiderstandskennfeld" SWORD Res_hPaHrPerCM 1 100 -3.276800 3.276700 FORMAT "%8.6" ECU_ADDRESS 0xC0001628 /end MEASUREMENT
/begin MEASUREMENT PFltLd_resFlwOfs "" SWORD Res_hPaHrPerCM 1 100 -3.276800 3.276700 FORMAT "%8.6" ECU_ADDRESS 0xD0007440 /end MEASUREMENT
/begin MEASUREMENT PFltLd_resFlwRaw "" SWORD Res_hPaHrPerCM 1 100 -3.276800 3.276700 FORMAT "%8.6" ECU_ADDRESS 0xD0007442 /end MEASUREMENT
/begin MEASUREMENT PFltLd_resFlwRaw_mp "Strömungswiderstand des Partikelfilters (Rohwert)" SWORD Res_hPaHrPerCM 1 100 -3.276800 3.276700 FORMAT "%8.6" ECU_ADDRESS 0xC000162A /end MEASUREMENT
/begin MEASUREMENT PFltLd_resFlwUnCor "nicht korrigierter Strömungswiderstand des Partikelfilters" SWORD Res_hPaHrPerCM 1 100 -3.276800 3.276700 FORMAT "%8.6" ECU_ADDRESS 0xD000436C /end MEASUREMENT
/begin MEASUREMENT PFltLd_rLamAprx_mp "Lambdawert vor Partikelfilter aus dem modellierten Sauerstoff nach Abgaskrümmer und dem stöchiometrischen Verhältnisses für die Verbrennung des Kraftstoffes" SWORD lambda 1 100 -32.76800 32.76700 FORMAT "%8.5" ECU_ADDRESS 0xC000165C /end MEASUREMENT
/begin MEASUREMENT PFltLd_rLam_mp "Lambdawert vor Partikelfilter" SWORD lambda 1 100 -32.76800 32.76700 FORMAT "%8.5" ECU_ADDRESS 0xC000165E /end MEASUREMENT
/begin MEASUREMENT PFltLd_rSot "Rußmasse im Partikelfilter pro Filtervolumen" SWORD Soot_gPerLtr 1 100 -327.6800 327.6700 FORMAT "%8.4" ECU_ADDRESS 0xD0007438 /end MEASUREMENT
/begin MEASUREMENT PFltLd_stAvrgTOutNO2_mp "Status Timer für die maximale Dauer der Mittelwertbildung für Rußmassenoffset-Berechnung bei NO2-Regeneration" UBYTE OneToOne 1 100 0.00 255.0 FORMAT "%5.1" ECU_ADDRESS 0xC000162C /end MEASUREMENT
/begin MEASUREMENT PFltLd_stInitAftSuc_mp "Status für die Initialisierung der Integratoren nach einer erfolgreichen Regeneration" UBYTE OneToOne 1 100 0.00 255.0 FORMAT "%5.1" ECU_ADDRESS 0xC0001660 /end MEASUREMENT
/begin MEASUREMENT PFltLd_stMsSotOfsNO2Actv_mp "Status Berechnung Rußmassenoffset bei NO2-Regeneration aktiv" UBYTE OneToOne 1 100 0.00 255.0 FORMAT "%5.1" ECU_ADDRESS 0xC000162D /end MEASUREMENT
/begin MEASUREMENT PFltLd_stMsSotOfsStrtActv_mp "Status Berechnung Rußmassenoffset bei Motorstart aktiv" UBYTE OneToOne 1 100 0.00 255.0 FORMAT "%5.1" ECU_ADDRESS 0xC000162E /end MEASUREMENT
/begin MEASUREMENT PFltLd_stMsSotResRst_mp "Status Initialisierung der Summationen für die Restrußmasse und für die Regenerationsdauer mit Null" UBYTE OneToOne 1 100 0.00 255.0 FORMAT "%5.1" ECU_ADDRESS 0xC0001661 /end MEASUREMENT
/begin MEASUREMENT PFltLd_stNO2Actv "Status NO2-Effekt aktiv" UBYTE OneToOne 1 100 0.00 255.0 FORMAT "%5.1" ECU_ADDRESS 0xD000911A /end MEASUREMENT
/begin MEASUREMENT PFltLd_stOfsNO2Rls_mp "Status für die Freigabe der Rußmassenoffset-Berechnung bei NO2-Regeneration" UBYTE OneToOne 1 100 0.00 255.0 FORMAT "%5.1" ECU_ADDRESS 0xC000162F /end MEASUREMENT
/begin MEASUREMENT PFltLd_stSimOn "" UBYTE OneToOne 1 100 0.00 255.0 FORMAT "%5.1" ECU_ADDRESS 0xD000911B /end MEASUREMENT
/begin MEASUREMENT PFltLd_stSimOnBas_mp "Bitleiste der überprüften Basis-Bedingungen zur Aktivierung der Simulation der Partikelmasse" UWORD OneToOne 1 100 0.00 65535.00 FORMAT "%8.2" ECU_ADDRESS 0xC00015D0 /end MEASUREMENT
/begin MEASUREMENT PFltLd_stSimOn_mp "Statuswort Simulation aktiv" UWORD OneToOne 1 100 0.00 65535.00 FORMAT "%8.2" ECU_ADDRESS 0xC00015D2 /end MEASUREMENT
/begin MEASUREMENT PFltLd_stSotIniCont_mp "Status Initialisierung des Integrators für kontinuierlich simulierte Rußmasse" UBYTE OneToOne 1 100 0.00 255.0 FORMAT "%5.1" ECU_ADDRESS 0xC0001662 /end MEASUREMENT
/begin MEASUREMENT PFltLd_stSotIniNoCont_mp "Status Initialisierung des Integrators für nicht kontinuierlich simulierte Rußmasse" UBYTE OneToOne 1 100 0.00 255.0 FORMAT "%5.1" ECU_ADDRESS 0xC0001663 /end MEASUREMENT
/begin MEASUREMENT PFltLd_stSotIntegIni_mp "" UBYTE OneToOne 1 100 0.00 255.0 FORMAT "%5.1" ECU_ADDRESS 0xC0001664 /end MEASUREMENT
/begin MEASUREMENT PFltLd_stsSotOfsStrtActv_mp "" UBYTE OneToOne 1 100 0.00 255.0 FORMAT "%5.1" ECU_ADDRESS 0xC0001630 /end MEASUREMENT
/begin MEASUREMENT PFltLd_stStMOfsNO2_mp "Status des Zustandsautomats für die Rußmassen-Offsetberechnung bei NO2-Regeneration" UBYTE OneToOne 1 100 0.00 255.0 FORMAT "%5.1" ECU_ADDRESS 0xC0001631 /end MEASUREMENT
/begin MEASUREMENT PFltLd_tiCorOfsNO2_mp "Zeit seit Ende der NO2-Regeneration" SWORD TimeRed 1 100 -5242.880 5242.720 FORMAT "%8.3" ECU_ADDRESS 0xC0001632 /end MEASUREMENT
/begin MEASUREMENT PFltLd_tiNO2RgnDel_mp "Verzugszeit zur Aktivierung des Zustand ""Regeneration durch NO2""" SWORD Time_s 1 100 -327.6800 327.6700 FORMAT "%8.4" ECU_ADDRESS 0xC0001666 /end MEASUREMENT
/begin MEASUREMENT PFltLd_tiOpPFltEEPROM_mp "Betriebsdauer des Partikelfilters zum Zeitpunkt des letzten Nachlaufes" SLONG TimeEngOn 1 100 -2147483648.00 2147483647.00 FORMAT "%13.2" ECU_ADDRESS 0xC00015E0 /end MEASUREMENT
/begin MEASUREMENT PFltLd_tiOpPFltSum_mp "Betriebsdauer des Partikelfilters in Stunden" SLONG TimeEngOn 1 100 -2147483648.00 2147483647.00 FORMAT "%13.2" ECU_ADDRESS 0xC00015E4 /end MEASUREMENT
/begin MEASUREMENT PFltLd_tiOpPFlt_mp "Betriebsdauer des Partikelfilters" SWORD Time_Hr 1 100 -16384.00 16383.50 FORMAT "%8.2" ECU_ADDRESS 0xC00015E8 /end MEASUREMENT
/begin MEASUREMENT PFltLd_tiRgnAct_mp "Gesamtdauer der Regeneration" SLONG Time_s 1 100 -21474836.4800 21474836.4700 FORMAT "%13.4" ECU_ADDRESS 0xC0001668 /end MEASUREMENT
/begin MEASUREMENT PFltLd_volAsh "Ash load in terms of volume" SWORD Vol 1 100 -327.6800 327.6700 FORMAT "%8.4" ECU_ADDRESS 0xD0007444 /end MEASUREMENT
/begin MEASUREMENT PFltLd_volAsh_mp "Zur ausgewählten Luftbank umgeschalteter Betriebspunktanzeiger für Kennlinie PFltLd_facMltCor_CUR" SWORD Vol 1 100 -327.6800 327.6700 FORMAT "%8.4" ECU_ADDRESS 0xC00015EA /end MEASUREMENT
/begin MEASUREMENT PFltLd_volOilAshEG_mp "Volumen der Ölasche im Partikelfilter berechnet aus dem Massenstrom in Abgaskrümmer" SWORD Vol 1 100 -327.6800 327.6700 FORMAT "%8.4" ECU_ADDRESS 0xC00015EC /end MEASUREMENT
/begin MEASUREMENT PFltLd_volOilAshTiEngOn_mp "Volumen der Ölasche im Partikelfilter berechnet aus dem Betriebsdauer der Partikelfilter" SWORD Vol 1 100 -327.6800 327.6700 FORMAT "%8.4" ECU_ADDRESS 0xC00015EE /end MEASUREMENT
/begin MEASUREMENT PFltLmp_st "" UBYTE OneToOne 1 100 0.00 255.0 FORMAT "%5.1" ECU_ADDRESS 0xD000911C /end MEASUREMENT
/begin MEASUREMENT PFltLmp_stPs "" UBYTE OneToOne 1 100 0.00 255.0 FORMAT "%5.1" ECU_ADDRESS 0xD000911D /end MEASUREMENT
/begin MEASUREMENT PFltPOp_nEngFlt "PT1 gefilterte Drehzahl" SWORD EngN 1 100 -16384.00 16383.50 FORMAT "%8.2" ECU_ADDRESS 0xD0007446 /end MEASUREMENT
/begin MEASUREMENT PFltPOp_qSetUnBalFlt "gefilterter Wert der Einspritzmenge" SWORD InjMassCyc 1 100 -327.6800 327.6700 FORMAT "%8.4" ECU_ADDRESS 0xD0007448 /end MEASUREMENT
/begin MEASUREMENT PFltPOp_rAPPFlt "gefilterter Wert des Fahrpedalsignals" SWORD Prc 1 100 -400.0000 399.9878 FORMAT "%8.4" ECU_ADDRESS 0xD000744A /end MEASUREMENT
/begin MEASUREMENT PFltPOp_RngIdx_X_mp "X-Index für Bereichsgrenzen-Matrizen" UBYTE OneToOne 1 100 0.00 255.0 FORMAT "%5.1" ECU_ADDRESS 0xC000166C /end MEASUREMENT
/begin MEASUREMENT PFltPOp_RngIdx_Y_mp "Y-Index für Bereichsgrenzen-Matrizen" UBYTE OneToOne 1 100 0.00 255.0 FORMAT "%5.1" ECU_ADDRESS 0xC000166D /end MEASUREMENT
/begin MEASUREMENT PFltPOp_stBrkDeb "Entprelltes Bremssignal" UBYTE OneToOne 1 100 0.00 255.0 FORMAT "%5.1" ECU_ADDRESS 0xD000911E /end MEASUREMENT
/begin MEASUREMENT PFltPOp_stClthDeb "Entprelltes Kupplungssignal" UBYTE OneToOne 1 100 0.00 255.0 FORMAT "%5.1" ECU_ADDRESS 0xD000911F /end MEASUREMENT
/begin MEASUREMENT PFltPOp_stEngPOp "Motorbetriebspunkt" UBYTE OneToOne 1 100 0.00 255.0 FORMAT "%5.1" ECU_ADDRESS 0xD0009120 /end MEASUREMENT
/begin MEASUREMENT PFltPOp_stEngPOp10_mp "Motorbetriebspunkt im Prüfungsbereich 10 berechnet" UBYTE OneToOne 1 100 0.00 255.0 FORMAT "%5.1" ECU_ADDRESS 0xC000166E /end MEASUREMENT
/begin MEASUREMENT PFltPOp_stEngPOp1_mp "Motorbetriebspunkt im Prüfungsbereich 1 berechnet" UBYTE OneToOne 1 100 0.00 255.0 FORMAT "%5.1" ECU_ADDRESS 0xC000166F /end MEASUREMENT
/begin MEASUREMENT PFltPOp_stEngPOp2_mp "Motorbetriebspunkt im Prüfungsbereich 2 berechnet" UBYTE OneToOne 1 100 0.00 255.0 FORMAT "%5.1" ECU_ADDRESS 0xC0001670 /end MEASUREMENT
/begin MEASUREMENT PFltPOp_stEngPOp3_mp "Motorbetriebspunkt im Prüfungsbereich 3 berechnet" UBYTE OneToOne 1 100 0.00 255.0 FORMAT "%5.1" ECU_ADDRESS 0xC0001671 /end MEASUREMENT
/begin MEASUREMENT PFltPOp_stEngPOp4_mp "Motorbetriebspunkt im Prüfungsbereich 4 berechnet" UBYTE OneToOne 1 100 0.00 255.0 FORMAT "%5.1" ECU_ADDRESS 0xC0001672 /end MEASUREMENT
/begin MEASUREMENT PFltPOp_stEngPOp5_mp "Motorbetriebspunkt im Prüfungsbereich 5 berechnet" UBYTE OneToOne 1 100 0.00 255.0 FORMAT "%5.1" ECU_ADDRESS 0xC0001673 /end MEASUREMENT
/begin MEASUREMENT PFltPOp_stEngPOp6_mp "Motorbetriebspunkt im Prüfungsbereich 6 berechnet" UBYTE OneToOne 1 100 0.00 255.0 FORMAT "%5.1" ECU_ADDRESS 0xC0001674 /end MEASUREMENT
/begin MEASUREMENT PFltPOp_stEngPOp7_mp "Motorbetriebspunkt im Prüfungsbereich 7 berechnet" UBYTE OneToOne 1 100 0.00 255.0 FORMAT "%5.1" ECU_ADDRESS 0xC0001675 /end MEASUREMENT
/begin MEASUREMENT PFltPOp_stEngPOp8_mp "Motorbetriebspunkt im Prüfungsbereich 8 berechnet" UBYTE OneToOne 1 100 0.00 255.0 FORMAT "%5.1" ECU_ADDRESS 0xC0001676 /end MEASUREMENT
/begin MEASUREMENT PFltPOp_stEngPOp9_mp "Motorbetriebspunkt im Prüfungsbereich 9 berechnet" UBYTE OneToOne 1 100 0.00 255.0 FORMAT "%5.1" ECU_ADDRESS 0xC0001677 /end MEASUREMENT
/begin MEASUREMENT PFltPOp_stEngPOpSpo_mp "Messpunkt für spontane Regeneration" UBYTE OneToOne 1 100 0.00 255.0 FORMAT "%5.1" ECU_ADDRESS 0xC0001678 /end MEASUREMENT
/begin MEASUREMENT PFltPOp_stGearDeb "entprelltes Gangsignal" UBYTE OneToOne 1 100 0.00 255.0 FORMAT "%5.1" ECU_ADDRESS 0xD0009121 /end MEASUREMENT
/begin MEASUREMENT PFltPOp_stRng10_mp "Statuswort der Regeneration im Bereich 10" UWORD OneToOne 1 100 0.00 65535.00 FORMAT "%8.2" ECU_ADDRESS 0xC000167A /end MEASUREMENT
/begin MEASUREMENT PFltPOp_stRng1_mp "Statuswort der Regeneration im Bereich 1" UWORD OneToOne 1 100 0.00 65535.00 FORMAT "%8.2" ECU_ADDRESS 0xC000167C /end MEASUREMENT
/begin MEASUREMENT PFltPOp_stRng2_mp "Statuswort der Regeneration im Bereich 2" UWORD OneToOne 1 100 0.00 65535.00 FORMAT "%8.2" ECU_ADDRESS 0xC000167E /end MEASUREMENT
/begin MEASUREMENT PFltPOp_stRng3_mp "Statuswort der Regeneration im Bereich 3" UWORD OneToOne 1 100 0.00 65535.00 FORMAT "%8.2" ECU_ADDRESS 0xC0001680 /end MEASUREMENT
/begin MEASUREMENT PFltPOp_stRng4_mp "Statuswort der Regeneration im Bereich 4" UWORD OneToOne 1 100 0.00 65535.00 FORMAT "%8.2" ECU_ADDRESS 0xC0001682 /end MEASUREMENT
/begin MEASUREMENT PFltPOp_stRng5_mp "Statuswort der Regeneration im Bereich 5" UWORD OneToOne 1 100 0.00 65535.00 FORMAT "%8.2" ECU_ADDRESS 0xC0001684 /end MEASUREMENT
/begin MEASUREMENT PFltPOp_stRng6_mp "Statuswort der Regeneration im Bereich 6" UWORD OneToOne 1 100 0.00 65535.00 FORMAT "%8.2" ECU_ADDRESS 0xC0001686 /end MEASUREMENT
/begin MEASUREMENT PFltPOp_stRng7_mp "Statuswort der Regeneration im Bereich 7" UWORD OneToOne 1 100 0.00 65535.00 FORMAT "%8.2" ECU_ADDRESS 0xC0001688 /end MEASUREMENT
/begin MEASUREMENT PFltPOp_stRng8_mp "Statuswort der Regeneration im Bereich 8" UWORD OneToOne 1 100 0.00 65535.00 FORMAT "%8.2" ECU_ADDRESS 0xC000168A /end MEASUREMENT
/begin MEASUREMENT PFltPOp_stRng9_mp "Statuswort der Regeneration im Bereich 9" UWORD OneToOne 1 100 0.00 65535.00 FORMAT "%8.2" ECU_ADDRESS 0xC000168C /end MEASUREMENT
/begin MEASUREMENT PFltPOp_stRngSpo_mp "Statuswort der spontanen Regeneration" UWORD OneToOne 1 100 0.00 65535.00 FORMAT "%8.2" ECU_ADDRESS 0xC000168E /end MEASUREMENT
/begin MEASUREMENT PFltPOp_tAdapTOxiCatUsFlt "gefilterter Wert der Temperatur vor dem Oxidationskatalysator" SWORD Temp_Cels 1 100 -3549.940 3003.560 FORMAT "%8.3" ECU_ADDRESS 0xD000744C /end MEASUREMENT
/begin MEASUREMENT PFltPOp_tAdapTPFltUsFlt "gefilterter Wert der Partikelfiltertemperatur" SWORD Temp_Cels 1 100 -3549.940 3003.560 FORMAT "%8.3" ECU_ADDRESS 0xD000744E /end MEASUREMENT
/begin MEASUREMENT PFltPOp_tAir_mp "Lufttemperatur" SWORD Temp_Cels 1 100 -3549.940 3003.560 FORMAT "%8.3" ECU_ADDRESS 0xC0001690 /end MEASUREMENT
/begin MEASUREMENT PFltPOp_tEngTempFlt "gefilterter Wert der Kühlmitteltemperatur" SWORD Temp_Cels 1 100 -3549.940 3003.560 FORMAT "%8.3" ECU_ADDRESS 0xD0007450 /end MEASUREMENT
/begin MEASUREMENT PFltPOp_tEngTemp_mp "Kühlmitteltemperatur" SWORD Temp_Cels 1 100 -3549.940 3003.560 FORMAT "%8.3" ECU_ADDRESS 0xC0001692 /end MEASUREMENT
/begin MEASUREMENT PFltPOp_uBattFlt "gefilterter Wert der Batteriespannung" SWORD Volt_Batt 1 100 -655360.0 655340.0 FORMAT "%8.1" ECU_ADDRESS 0xD0007452 /end MEASUREMENT
/begin MEASUREMENT PFltPOp_vFlt "gefilterter Wert der Fahrgeschwindigkeit" SWORD Vel 1 100 -327.6800 327.6700 FORMAT "%8.4" ECU_ADDRESS 0xD0007454 /end MEASUREMENT
/begin MEASUREMENT PFltRgn_aDynMinLim_mp "Minimale Schwelle zur Dynamikerkennung über Beschleunigung" SWORD Acc 1 100 -32.76800 32.76700 FORMAT "%8.5" ECU_ADDRESS 0xC0001714 /end MEASUREMENT
/begin MEASUREMENT PFltRgn_ctRgnDemEEP_mp "Im EEPROM gespeicherte Anzahl der angeforderten Regenerationen" UWORD OneToOne 1 100 0.00 65535.00 FORMAT "%8.2" ECU_ADDRESS 0xC000169C /end MEASUREMENT
/begin MEASUREMENT PFltRgn_ctRgnDem_mp "Anzahl der angeforderten Regenerationen" UWORD OneToOne 1 100 0.00 65535.00 FORMAT "%8.2" ECU_ADDRESS 0xC000169E /end MEASUREMENT
/begin MEASUREMENT PFltRgn_ctRgnSuc "Anzahl erfolgreicher Partikelfilterregenerationen" UWORD OneToOne 1 100 0.00 65535.00 FORMAT "%8.2" ECU_ADDRESS 0xD0007686 /end MEASUREMENT
/begin MEASUREMENT PFltRgn_ctRgnSucEEP_mp "Im EEPROM gespeicherte Anzahl erfolgreicher Partikelfilterregenerationen" UWORD OneToOne 1 100 0.00 65535.00 FORMAT "%8.2" ECU_ADDRESS 0xC00016A0 /end MEASUREMENT
/begin MEASUREMENT PFltRgn_drAccPedFlt_mp "Gefilterte Änderung des Pedalwertes" SWORD PrcPerSec 1 100 -20000.00 19999.39 FORMAT "%8.2" ECU_ADDRESS 0xC0001716 /end MEASUREMENT
/begin MEASUREMENT PFltRgn_drAccPedRaw_mp "Änderung des Pedalwertes" SWORD PrcPerSec 1 100 -20000.00 19999.39 FORMAT "%8.2" ECU_ADDRESS 0xC0001718 /end MEASUREMENT
/begin MEASUREMENT PFltRgn_dvolFlCons_mp "Kraftstoffverbrauch" SWORD FlCons_lps_q0p0001 1 100 -3.276800 3.276700 FORMAT "%8.6" ECU_ADDRESS 0xC00016D8 /end MEASUREMENT
/begin MEASUREMENT PFltRgn_facFullLdCor_mp "Korrekturfaktor für Volllasterkennung" SWORD Fact 1 100 -4.000000 3.999878 FORMAT "%8.6" ECU_ADDRESS 0xC000171A /end MEASUREMENT
/begin MEASUREMENT PFltRgn_lSnceRgn "Seit der letzten erfolgreichen Regeneration gefahrene Strecke" SLONG Length 1 100 -2147483648.00 2147483647.00 FORMAT "%13.2" ECU_ADDRESS 0xD0004370 /end MEASUREMENT
/begin MEASUREMENT PFltRgn_lSumMax_mp "Maximale Schwelle für die zurückgelegte Strecke seit der letzten erfolgreichen Regeneration" SLONG Length 1 100 -2147483648.00 2147483647.00 FORMAT "%13.2" ECU_ADDRESS 0xC00016DC /end MEASUREMENT
/begin MEASUREMENT PFltRgn_lSum_mp "Seit der letzten erfolgreichen Regeneration gesamt gefahrene Strecke" SLONG Length 1 100 -2147483648.00 2147483647.00 FORMAT "%13.2" ECU_ADDRESS 0xC00016E0 /end MEASUREMENT
/begin MEASUREMENT PFltRgn_mSotOfs_mp "Äquivalent Massenoffset" SWORD mSoot_g 1 100 -327.6800 327.6700 FORMAT "%8.4" ECU_ADDRESS 0xC00016E4 /end MEASUREMENT
/begin MEASUREMENT PFltRgn_numEngPOp_mp "Regenerationszahl nach Berücksichtigung des Motorbetriebszustands" UWORD OneToOne 1 100 0.00 65535.00 FORMAT "%8.2" ECU_ADDRESS 0xC00016A2 /end MEASUREMENT
/begin MEASUREMENT PFltRgn_numLst_mp "Regenerationsanforderung wegen Kraftstoffverbrauch, Betriebsdauer oder Strecke" UBYTE OneToOne 1 100 0.00 255.0 FORMAT "%5.1" ECU_ADDRESS 0xC00016E6 /end MEASUREMENT
/begin MEASUREMENT PFltRgn_numPrt_mp "Regenerationsanforderung wegen Motorschutz" UBYTE OneToOne 1 100 0.00 255.0 FORMAT "%5.1" ECU_ADDRESS 0xC00016E7 /end MEASUREMENT
/begin MEASUREMENT PFltRgn_numRgn "Regenerationsanforderung" UBYTE OneToOne 1 100 0.00 255.0 FORMAT "%5.1" ECU_ADDRESS 0xD0009122 /end MEASUREMENT
/begin MEASUREMENT PFltRgn_numRgn_mp "Zur ausgewählten Luftbank umgeschalteter Betriebspunktanzeiger für Array PFltRgn_numEngPOpDel_CA" UBYTE OneToOne 1 100 0.00 255.0 FORMAT "%5.1" ECU_ADDRESS 0xC00016A4 /end MEASUREMENT
/begin MEASUREMENT PFltRgn_numSot_mp "Ladezustand des Partikelfilter" UBYTE OneToOne 1 100 0.00 255.0 FORMAT "%5.1" ECU_ADDRESS 0xC00016E8 /end MEASUREMENT
/begin MEASUREMENT PFltRgn_numTot "gesamte Regenerationsanforderung" UBYTE OneToOne 1 100 0.00 255.0 FORMAT "%5.1" ECU_ADDRESS 0xD0009123 /end MEASUREMENT
/begin MEASUREMENT PFltRgn_pActEngPrt_mp "Aktueller Differenzdruck über Partikelfilter für Überprüfung der Regenerationsanforderung wegen Motorschutz" SWORD Pres_hPa 1 100 -32768.00 3500.00 FORMAT "%8.2" ECU_ADDRESS 0xC00016EA /end MEASUREMENT
/begin MEASUREMENT PFltRgn_pEngPrtMaxRaw_mp "Ungefilterter maximaler Differenzdruck für Motorschutz" SWORD Pres_hPa 1 100 -32768.00 3500.00 FORMAT "%8.2" ECU_ADDRESS 0xC00016EC /end MEASUREMENT
/begin MEASUREMENT PFltRgn_pEngPrtMax_mp "Maximaldruck Motorschutz" SWORD Pres_hPa 1 100 -32768.00 3500.00 FORMAT "%8.2" ECU_ADDRESS 0xC00016EE /end MEASUREMENT
/begin MEASUREMENT PFltRgn_pEngPrtMinRaw_mp "Ungefilterter minimaler Differenzdruck für Motorschutz" SWORD Pres_hPa 1 100 -32768.00 3500.00 FORMAT "%8.2" ECU_ADDRESS 0xC00016F0 /end MEASUREMENT
/begin MEASUREMENT PFltRgn_pEngPrtMin_mp "Minimaldruck Motorschutz" SWORD Pres_hPa 1 100 -32768.00 3500.00 FORMAT "%8.2" ECU_ADDRESS 0xC00016F2 /end MEASUREMENT
/begin MEASUREMENT PFltRgn_qFlEEP_mp "Im EEPROM gespeicherter Wert der seit der letzten erfolgreichen Regeneration verbrauchten Kraftstoffmenge" SWORD Fl_L 1 100 -327.6800 327.6700 FORMAT "%8.4" ECU_ADDRESS 0xC00016F4 /end MEASUREMENT
/begin MEASUREMENT PFltRgn_qFlMax_mp "Schwelle für den Kraftstoffverbrauch seit der letzten erfolgreichen Regeneration" SWORD Fl_L 1 100 -327.6800 327.6700 FORMAT "%8.4" ECU_ADDRESS 0xC00016F6 /end MEASUREMENT
/begin MEASUREMENT PFltRgn_qFlTot "Insgesamt verbrauchte Kraftstoffmenge seit letzter Filterreinigung" SWORD Fl_2 1 100 -327680.0 327670.0 FORMAT "%8.1" ECU_ADDRESS 0xD0007456 /end MEASUREMENT
/begin MEASUREMENT PFltRgn_qFlTotEEP_mp "Im EEPROM gespeicherter Wert der insgesamt verbrauchten Kraftstoffmenge seit letzter Filterreinigung" SLONG Fl_2 1 100 -21474836480.0 21474836470.0 FORMAT "%13.1" ECU_ADDRESS 0xC00016F8 /end MEASUREMENT
/begin MEASUREMENT PFltRgn_qFl_mp "Seit der letzten erfolgreichen Regeneration verbrauchte Kraftstoffmenge" SWORD Fl_L 1 100 -327.6800 327.6700 FORMAT "%8.4" ECU_ADDRESS 0xC00016FC /end MEASUREMENT
/begin MEASUREMENT PFltRgn_resFlwOfs_mp "Zur ausgewählten Luftbank umgeschalteter Betriebspunktanzeiger für Kennlinie PFltRgn_mSotMeas_CUR" SWORD Res_hPaHrPerCM 1 100 -3.276800 3.276700 FORMAT "%8.6" ECU_ADDRESS 0xC00016FE /end MEASUREMENT
/begin MEASUREMENT PFltRgn_rFullLdBas_mp "Grunderwert zur Volllasterkennung" SWORD Prc 1 100 -400.0000 399.9878 FORMAT "%8.4" ECU_ADDRESS 0xC000171C /end MEASUREMENT
/begin MEASUREMENT PFltRgn_rFullLd_mp "Verhältnis für Volllasterkennung" SWORD Prc 1 100 -400.0000 399.9878 FORMAT "%8.4" ECU_ADDRESS 0xC000171E /end MEASUREMENT
/begin MEASUREMENT PFltRgn_stActEngPrt_mp "Status Regenerationsanforderung wegen Motorschutz" UBYTE OneToOne 1 100 0.00 255.0 FORMAT "%5.1" ECU_ADDRESS 0xC0001700 /end MEASUREMENT
/begin MEASUREMENT PFltRgn_stChngImmd_mp "Status für einen direkten Betriebsarten- bzw. Regenerationsstufenwechsel" UBYTE OneToOne 1 100 0.00 255.0 FORMAT "%5.1" ECU_ADDRESS 0xC00016A5 /end MEASUREMENT
/begin MEASUREMENT PFltRgn_stChngRgnDelExpd_mp "Status Maximale Verzögerungszeit nach Änderung des Betriebsartenwunsches erreicht" UBYTE OneToOne 1 100 0.00 255.0 FORMAT "%5.1" ECU_ADDRESS 0xC00016A6 /end MEASUREMENT
/begin MEASUREMENT PFltRgn_stChngRgnDel_mp "Verzögerter Status für einen Betriebsarten- bzw. Regenerationsstufenwechsel" UBYTE OneToOne 1 100 0.00 255.0 FORMAT "%5.1" ECU_ADDRESS 0xC00016A7 /end MEASUREMENT
/begin MEASUREMENT PFltRgn_stChngRgn_mp "Status für einen Betriebsarten- bzw. Regenerationsstufenwechsel" UBYTE OneToOne 1 100 0.00 255.0 FORMAT "%5.1" ECU_ADDRESS 0xC00016A8 /end MEASUREMENT
/begin MEASUREMENT PFltRgn_stEngPrtActv "Status Motorschutz aktiv" UBYTE OneToOne 1 100 0.00 255.0 FORMAT "%5.1" ECU_ADDRESS 0xD0009124 /end MEASUREMENT
/begin MEASUREMENT PFltRgn_stEngPrt_mp "Status Motorschutz" UBYTE OneToOne 1 100 0.00 255.0 FORMAT "%5.1" ECU_ADDRESS 0xC0001701 /end MEASUREMENT
/begin MEASUREMENT PFltRgn_stIntr "Statuswort Regenerationsunterbrechung" UWORD OneToOne 1 100 0.00 65535.00 FORMAT "%8.2" ECU_ADDRESS 0xD0007688 /end MEASUREMENT
/begin MEASUREMENT PFltRgn_stIntrAct_mp "Basis-Statuswort Regenerationsunterbrechung" UWORD OneToOne 1 100 0.00 65535.00 FORMAT "%8.2" ECU_ADDRESS 0xC0001694 /end MEASUREMENT
/begin MEASUREMENT PFltRgn_stJmpCond_mp "Status Sprungbedingung" UBYTE OneToOne 1 100 0.00 255.0 FORMAT "%5.1" ECU_ADDRESS 0xC00016A9 /end MEASUREMENT
/begin MEASUREMENT PFltRgn_stLck "Statusbitwort Sperrung der Partikelfilterregeneration" UBYTE OneToOne 1 100 0.00 255.0 FORMAT "%5.1" ECU_ADDRESS 0xD0009125 /end MEASUREMENT
/begin MEASUREMENT PFltRgn_stLstRgnEnd_mp "Status erkennt das Ende der Regeneration aus Zählerblöcken" UBYTE OneToOne 1 100 0.00 255.0 FORMAT "%5.1" ECU_ADDRESS 0xC0001702 /end MEASUREMENT
/begin MEASUREMENT PFltRgn_stLstRgn_mp "Status Timer für Regeneration von Zählerblöcken" UBYTE OneToOne 1 100 0.00 255.0 FORMAT "%5.1" ECU_ADDRESS 0xC0001703 /end MEASUREMENT
/begin MEASUREMENT PFltRgn_stLst_mp "Status Regenerationsanforderung nach Kraftstoffverbrauch, Betriebsstunden oder gefahrener Strecke" UBYTE OneToOne 1 100 0.00 255.0 FORMAT "%5.1" ECU_ADDRESS 0xC0001704 /end MEASUREMENT
/begin MEASUREMENT PFltRgn_stNumEngPOpDelOn_mp "Statusbit verzögert wirksame Matrix zur Berücksichtigung des Motorbetriebszustandes bei Regeneration." UBYTE OneToOne 1 100 0.00 255.0 FORMAT "%5.1" ECU_ADDRESS 0xC00016AA /end MEASUREMENT
/begin MEASUREMENT PFltRgn_stNumSotSucAct_mp "Basis-Status erfolgreiche Regeneration wegen kleiner Regenerationszahl" UBYTE OneToOne 1 100 0.00 255.0 FORMAT "%5.1" ECU_ADDRESS 0xC00016AB /end MEASUREMENT
/begin MEASUREMENT PFltRgn_stNumSotSuc_mp "Status erfolgreiche Regeneration wegen kleiner Regenerationszahl" UBYTE OneToOne 1 100 0.00 255.0 FORMAT "%5.1" ECU_ADDRESS 0xC00016AC /end MEASUREMENT
/begin MEASUREMENT PFltRgn_stNumTxtMsg_mp "Status Text-Botschaft-Zahl für Partikelfilter" UBYTE OneToOne 1 100 0.00 255.0 FORMAT "%5.1" ECU_ADDRESS 0xC00016AD /end MEASUREMENT
/begin MEASUREMENT PFltRgn_stOpMode "Betriebsartenanforderung für Partikelfilter" ULONG OneToOne 1 100 0.00 4294967295.00 FORMAT "%13.2" ECU_ADDRESS 0xD00045C4 /end MEASUREMENT
/begin MEASUREMENT PFltRgn_stRgnJmp "Status der Sprungerkennung" UBYTE OneToOne 1 100 0.00 255.0 FORMAT "%5.1" ECU_ADDRESS 0xD0009126 /end MEASUREMENT
/begin MEASUREMENT PFltRgn_stRgnJmpNoMsk_mp "Unmaskierter Zustand Rampensprung möglich" UBYTE OneToOne 1 100 0.00 255.0 FORMAT "%5.1" ECU_ADDRESS 0xC0001720 /end MEASUREMENT
/begin MEASUREMENT PFltRgn_stRgnNoCmplnEEP_mp "Im EEPROM gespeicherter Status Regeneration nicht erfolgreich beendet" UBYTE OneToOne 1 100 0.00 255.0 FORMAT "%5.1" ECU_ADDRESS 0xC00016AE /end MEASUREMENT
/begin MEASUREMENT PFltRgn_stRgnNoCmpln_mp "Status Regeneration nicht erfolgreich beendet" UBYTE OneToOne 1 100 0.00 255.0 FORMAT "%5.1" ECU_ADDRESS 0xC00016AF /end MEASUREMENT
/begin MEASUREMENT PFltRgn_stRgnOpMode "Erforderliche Betriebsart gemäß Regenerationsanforderung und Motorzustand" ULONG OneToOne 1 100 0.00 4294967295.00 FORMAT "%13.2" ECU_ADDRESS 0xD00045C8 /end MEASUREMENT
/begin MEASUREMENT PFltRgn_stRgnOpModeDel_mp "Verzögerte Betriebsartenanforderung" ULONG OneToOne 1 100 0.00 4294967295.00 FORMAT "%13.2" ECU_ADDRESS 0xC00016B0 /end MEASUREMENT
/begin MEASUREMENT PFltRgn_stRgnSwtPar_mp "Status Umschaltung auf den zweiten Grenzen-Parametersatz für Regenerationsanforderung nach Kraftstoffverbrauch, Betriebsstunden oder gefahrener Strecke" UBYTE OneToOne 1 100 0.00 255.0 FORMAT "%5.1" ECU_ADDRESS 0xC0001705 /end MEASUREMENT
/begin MEASUREMENT PFltRgn_stSmkLim_mp "Status Erreichen der Rauchbegrenzungsmenge" UBYTE OneToOne 1 100 0.00 255.0 FORMAT "%5.1" ECU_ADDRESS 0xC0001721 /end MEASUREMENT
/begin MEASUREMENT PFltRgn_stSuc "Status erfolgreiche Regeneration" UBYTE OneToOne 1 100 0.00 255.0 FORMAT "%5.1" ECU_ADDRESS 0xD0009127 /end MEASUREMENT
/begin MEASUREMENT PFltRgn_stSucAct_mp "Basis-Status erfolgreiche Regeneration" UBYTE OneToOne 1 100 0.00 255.0 FORMAT "%5.1" ECU_ADDRESS 0xC00016B4 /end MEASUREMENT
/begin MEASUREMENT PFltRgn_stTxtMsg "Status Text-Botschaft für Partikelfilter" UBYTE OneToOne 1 100 0.00 255.0 FORMAT "%5.1" ECU_ADDRESS 0xD0009128 /end MEASUREMENT
/begin MEASUREMENT PFltRgn_tiChngRgnDel "Maximale Verzögerungszeit nach Änderung des Betriebsartenwunsches" SWORD Time_s 1 100 -327.6800 327.6700 FORMAT "%8.4" ECU_ADDRESS 0xD0004374 /end MEASUREMENT
/begin MEASUREMENT PFltRgn_tiChngRgnDelBas_mp "Unkorrigierte Maximale Verzögerungszeit nach Änderung des Betriebsartenwunsches" SWORD Time_s 1 100 -327.6800 327.6700 FORMAT "%8.4" ECU_ADDRESS 0xC00016B6 /end MEASUREMENT
/begin MEASUREMENT PFltRgn_tiChngRgn_mp "Zeitdauer nach Änderung des Betriebsartenwunsches" SWORD Time_s 1 100 -327.6800 327.6700 FORMAT "%8.4" ECU_ADDRESS 0xC00016B8 /end MEASUREMENT
/begin MEASUREMENT PFltRgn_tiLckRgn_mp "" SLONG Time_s 1 100 -21474836.4800 21474836.4700 FORMAT "%13.4" ECU_ADDRESS 0xC00016BC /end MEASUREMENT
/begin MEASUREMENT PFltRgn_tiOp_mp "Motorbetriebszeit bei der letzten erfolgreichen Regeneration" SLONG TimeEngOn 1 100 -2147483648.00 2147483647.00 FORMAT "%13.2" ECU_ADDRESS 0xC0001708 /end MEASUREMENT
/begin MEASUREMENT PFltRgn_tiRgnMax_mp "Maximale Regenerationszeit" SLONG Time_s 1 100 -21474836.4800 21474836.4700 FORMAT "%13.4" ECU_ADDRESS 0xC00016C0 /end MEASUREMENT
/begin MEASUREMENT PFltRgn_tiRgnSpo_mp "Spontane Regenerationszeit" SLONG Time_s 1 100 -21474836.4800 21474836.4700 FORMAT "%13.4" ECU_ADDRESS 0xC00016C4 /end MEASUREMENT
/begin MEASUREMENT PFltRgn_tiSnceRgn "Betriebsdauer seit der letzten erfolgreichen Regeneration" SLONG TimeEngOn 1 100 -2147483648.00 2147483647.00 FORMAT "%13.2" ECU_ADDRESS 0xD0004378 /end MEASUREMENT
/begin MEASUREMENT PFltRgn_tiTmrEngPrt_mp "Regenerationsanfoderungszeit wegen Motorschutz" SLONG Time_s 1 100 -21474836.4800 21474836.4700 FORMAT "%13.4" ECU_ADDRESS 0xC000170C /end MEASUREMENT
/begin MEASUREMENT PFltRgn_tiTmrLckRgnEEP_mp "Im EEPROM gespeicherte Regenerationssperrzeit" SLONG Time_s 1 100 -21474836.4800 21474836.4700 FORMAT "%13.4" ECU_ADDRESS 0xC00016C8 /end MEASUREMENT
/begin MEASUREMENT PFltRgn_tiTmrLckRgn_mp "" SLONG Time_s 1 100 -21474836.4800 21474836.4700 FORMAT "%13.4" ECU_ADDRESS 0xC00016CC /end MEASUREMENT
/begin MEASUREMENT PFltRgn_tiTmrLstRgn_mp "Regenerationsanforderungszeit wegen Kraftstoffverbrauch, Betriebsdauer oder gefahrene Strecke" SLONG Time_s 1 100 -21474836.4800 21474836.4700 FORMAT "%13.4" ECU_ADDRESS 0xC0001710 /end MEASUREMENT
/begin MEASUREMENT PFltRgn_tiTmrRgnMax_mp "" SLONG Time_s 1 100 -21474836.4800 21474836.4700 FORMAT "%13.4" ECU_ADDRESS 0xC00016D0 /end MEASUREMENT
/begin MEASUREMENT PFltRgn_tiTmrRgnSpo_mp "Spontane Regenerationszeit" SLONG Time_s 1 100 -21474836.4800 21474836.4700 FORMAT "%13.4" ECU_ADDRESS 0xC00016D4 /end MEASUREMENT
/begin MEASUREMENT PFltRgn_tiTmrStOvrRun_mp "Zeit in Schubbetrieb" SLONG Time_s 1 100 -21474836.4800 21474836.4700 FORMAT "%13.4" ECU_ADDRESS 0xC0001698 /end MEASUREMENT
/begin MEASUREMENT PFltSrv_mSotStrtMax_mp "Maximale Rußmasse zum Starten der Serviceregeneration" SWORD mSoot_g 1 100 -327.6800 327.6700 FORMAT "%8.4" ECU_ADDRESS 0xC000174C /end MEASUREMENT
/begin MEASUREMENT PFltSrv_mSotStrtMin_mp "Minimale Rußmasse zum Starten der Serviceregeneration" SWORD mSoot_g 1 100 -327.6800 327.6700 FORMAT "%8.4" ECU_ADDRESS 0xC000174E /end MEASUREMENT
/begin MEASUREMENT PFltSrv_numSrvCs "Servicefallnummer" UBYTE OneToOne 1 100 0.00 255.0 FORMAT "%5.1" ECU_ADDRESS 0xD0009129 /end MEASUREMENT
/begin MEASUREMENT PFltSrv_stClgDwnEnd_mp "Status Bedingungen zur Beendigung der Abkühlphase erfüllt" UBYTE OneToOne 1 100 0.00 255.0 FORMAT "%5.1" ECU_ADDRESS 0xC0001722 /end MEASUREMENT
/begin MEASUREMENT PFltSrv_stCond "Bitleiste Bedingungen für die Serviceregeneration" ULONG OneToOne 1 100 0.00 4294967295.00 FORMAT "%13.2" ECU_ADDRESS 0xD00045CC /end MEASUREMENT
/begin MEASUREMENT PFltSrv_stCondClgDwnEnd_mp "Bitleiste Bedingungen zur Beendigung der Abkühlphase" UBYTE OneToOne 1 100 0.00 255.0 FORMAT "%5.1" ECU_ADDRESS 0xC0001723 /end MEASUREMENT
/begin MEASUREMENT PFltSrv_stCondHldOnClgDwn_mp "Bitleiste maskierte Bedingungen zur Weiterführung der Abkühlphase" ULONG OneToOne 1 100 0.00 4294967295.00 FORMAT "%13.2" ECU_ADDRESS 0xC0001724 /end MEASUREMENT
/begin MEASUREMENT PFltSrv_stCondHldOnRgn_mp "Bitleiste maskierte Bedingungen zur Weiterführung der Serviceregeneration" ULONG OneToOne 1 100 0.00 4294967295.00 FORMAT "%13.2" ECU_ADDRESS 0xC0001728 /end MEASUREMENT
/begin MEASUREMENT PFltSrv_stCondHtUp2_mp "Bitleiste Bedingungen zum Übergang in den zweiten Auheizvorgang" UBYTE OneToOne 1 100 0.00 255.0 FORMAT "%5.1" ECU_ADDRESS 0xC000172C /end MEASUREMENT
/begin MEASUREMENT PFltSrv_stCondRgnSuc_mp "Bitleiste Bedingungen für eine erfolgreiche Serviceregeneration" UBYTE OneToOne 1 100 0.00 255.0 FORMAT "%5.1" ECU_ADDRESS 0xC000172D /end MEASUREMENT
/begin MEASUREMENT PFltSrv_stCondRgn_mp "Bitleiste Bedingungen zum Übergang in die Regeneration" UBYTE OneToOne 1 100 0.00 255.0 FORMAT "%5.1" ECU_ADDRESS 0xC000172E /end MEASUREMENT
/begin MEASUREMENT PFltSrv_stCondRls_mp "Bitleiste maskierte Bedingungen zur Freigabe der Serviceregeneration" ULONG OneToOne 1 100 0.00 4294967295.00 FORMAT "%13.2" ECU_ADDRESS 0xC0001730 /end MEASUREMENT
/begin MEASUREMENT PFltSrv_stCondTstr "Bitleiste Rückmeldung für den Servicetester über Bedingungen der Serviceregeneration" ULONG OneToOne 1 100 0.00 4294967295.00 FORMAT "%13.2" ECU_ADDRESS 0xD00045D0 /end MEASUREMENT
/begin MEASUREMENT PFltSrv_stHldOnClgDwn_mp "Status Weiterführung der Abkühlphase" UBYTE OneToOne 1 100 0.00 255.0 FORMAT "%5.1" ECU_ADDRESS 0xC0001734 /end MEASUREMENT
/begin MEASUREMENT PFltSrv_stHldOnRgn_mp "Status Weiterführung der Serviceregeneration" UBYTE OneToOne 1 100 0.00 255.0 FORMAT "%5.1" ECU_ADDRESS 0xC0001735 /end MEASUREMENT
/begin MEASUREMENT PFltSrv_stHtUp2_mp "Status Übergang in den zweiten Aufheizvorgang" UBYTE OneToOne 1 100 0.00 255.0 FORMAT "%5.1" ECU_ADDRESS 0xC0001736 /end MEASUREMENT
/begin MEASUREMENT PFltSrv_stOpMode "Anforderung der Betriebsart für die Serviceregeneration" ULONG OneToOne 1 100 0.00 4294967295.00 FORMAT "%13.2" ECU_ADDRESS 0xD00045D4 /end MEASUREMENT
/begin MEASUREMENT PFltSrv_stRgnOn "Status Partikelfilter-Serviceregeneration aktiv und freigegeben" UBYTE OneToOne 1 100 0.00 255.0 FORMAT "%5.1" ECU_ADDRESS 0xD000912A /end MEASUREMENT
/begin MEASUREMENT PFltSrv_stRgnSuc "Status Partikelfilter-Serviceregeneration erfolgreich" UBYTE OneToOne 1 100 0.00 255.0 FORMAT "%5.1" ECU_ADDRESS 0xD000912B /end MEASUREMENT
/begin MEASUREMENT PFltSrv_stRgnSuc_mp "Interner Status Partikelfilter-Serviceregeneration erfolgreich" UBYTE OneToOne 1 100 0.00 255.0 FORMAT "%5.1" ECU_ADDRESS 0xC0001737 /end MEASUREMENT
/begin MEASUREMENT PFltSrv_stRgnTstr "Status der Partikelfilter-Serviceregeneration für den Servicetester" UWORD OneToOne 1 100 0.00 65535.00 FORMAT "%8.2" ECU_ADDRESS 0xD000768A /end MEASUREMENT
/begin MEASUREMENT PFltSrv_stRgn_mp "Status Bedingungen zum Übergang in die Regeneration erfüllt" UBYTE OneToOne 1 100 0.00 255.0 FORMAT "%5.1" ECU_ADDRESS 0xC0001738 /end MEASUREMENT
/begin MEASUREMENT PFltSrv_stRls_mp "Status Bedingungen zur Freigabe der Serviceregeneration erfüllt" UBYTE OneToOne 1 100 0.00 255.0 FORMAT "%5.1" ECU_ADDRESS 0xC0001739 /end MEASUREMENT
/begin MEASUREMENT PFltSrv_stStopTmp_mp "temporärer Status Stoppen der Serviceregeneration" UBYTE OneToOne 1 100 0.00 255.0 FORMAT "%5.1" ECU_ADDRESS 0xC000173A /end MEASUREMENT
/begin MEASUREMENT PFltSrv_stStop_mp "Status Stoppen der Serviceregeneration" UBYTE OneToOne 1 100 0.00 255.0 FORMAT "%5.1" ECU_ADDRESS 0xC000173B /end MEASUREMENT
/begin MEASUREMENT PFltSrv_stStrt_mp "Status Starten der Serviceregeneration" UBYTE OneToOne 1 100 0.00 255.0 FORMAT "%5.1" ECU_ADDRESS 0xC000173C /end MEASUREMENT
/begin MEASUREMENT PFltSrv_tiClgDwn_mp "Abkühlzeit der Serviceregeneration" SLONG Time_s 1 100 -21474836.4800 21474836.4700 FORMAT "%13.4" ECU_ADDRESS 0xC0001740 /end MEASUREMENT
/begin MEASUREMENT PFltSrv_tiRgnAct_mp "Zeit Serviceregeneration aktiv" SLONG Time_s 1 100 -21474836.4800 21474836.4700 FORMAT "%13.4" ECU_ADDRESS 0xC0001750 /end MEASUREMENT
/begin MEASUREMENT PFltSrv_tiSrvIdl_mp "Zeit seitdem Drezahl im gültigen Bereich für die Serviceregeneration" SLONG Time_s 1 100 -21474836.4800 21474836.4700 FORMAT "%13.4" ECU_ADDRESS 0xC0001744 /end MEASUREMENT
/begin MEASUREMENT PFltSrv_tiTRgnSucMin_mp "Zeit seitdem minimaler Temperatur vor Partikelfilter zum Abzählen der minimalen Regenerationszeit erreicht" SLONG Time_s 1 100 -21474836.4800 21474836.4700 FORMAT "%13.4" ECU_ADDRESS 0xC0001748 /end MEASUREMENT
/begin MEASUREMENT PFltSrv_trqMax_mp "Maximales Moment für Bedingungen der Serviceregeneration" SWORD Trq 1 100 -3276.800 3276.700 FORMAT "%8.3" ECU_ADDRESS 0xC0001754 /end MEASUREMENT
/begin MEASUREMENT PFltSrv_trqMin_mp "Minimales Moment für Bedingungen der Serviceregeneration" SWORD Trq 1 100 -3276.800 3276.700 FORMAT "%8.3" ECU_ADDRESS 0xC0001756 /end MEASUREMENT
/begin MEASUREMENT PFlt_dvolMaxSty_mp "Maximaler stationärer Abgasvolumenstrom zur Überprüfung des maximalen Differenzdrucks im Nachlauf" SWORD AirVolPerTime 1 100 -3276.800 3276.700 FORMAT "%8.3" ECU_ADDRESS 0xC0001758 /end MEASUREMENT
/begin MEASUREMENT PFlt_dvolPFltEGInMon_mp "Zur ausgewählten Luftbank umgeschalteter Betriebspunktanzeiger für Kennfeld PFlt_pDiffCharMonMin_MAP" SWORD CubMtrPerHr 1 100 -3276.800 3276.700 FORMAT "%8.3" ECU_ADDRESS 0xC000175A /end MEASUREMENT
/begin MEASUREMENT PFlt_mSotDvt_mp "Abweichung zwischen gemessener und kontinuierlich simulierter Russmasse" SWORD mSoot_g 1 100 -327.6800 327.6700 FORMAT "%8.4" ECU_ADDRESS 0xC000175C /end MEASUREMENT
/begin MEASUREMENT PFlt_nMin "Minimale Drezahlanforderung für Serviceregeneration des Partikelfilters" SWORD EngN 1 100 -16384.00 16383.50 FORMAT "%8.2" ECU_ADDRESS 0xD0007458 /end MEASUREMENT
/begin MEASUREMENT PFlt_pDiffCharMonMin_mp "Grenze der Überwachung der DPF-Charakteristik mit Hilfe des Differenzdruck" SWORD Pres_hPa 1 100 -32768.00 3500.00 FORMAT "%8.2" ECU_ADDRESS 0xC000175E /end MEASUREMENT
/begin MEASUREMENT PFlt_pDiffMaxStyOfsCor_mp "Stationären Maximalwerte des Differenzdrucks nach Offset-Korrektur" SWORD Pres_hPa 1 100 -32768.00 3500.00 FORMAT "%8.2" ECU_ADDRESS 0xC0001760 /end MEASUREMENT
/begin MEASUREMENT PFlt_pDiffMaxSty_mp "Stationären Maximalwerte des Differenzdrucks" SWORD Pres_hPa 1 100 -32768.00 3500.00 FORMAT "%8.2" ECU_ADDRESS 0xC0001762 /end MEASUREMENT
/begin MEASUREMENT PFlt_pDiffNoDstrMin_mp "Von stationärem Abgasvolumenstrom abhängiger minimaler Differenzdruck in Nachlauf zur Unterstellung eines zerstörten Partikelfilters" SWORD Pres_hPa 1 100 -32768.00 3500.00 FORMAT "%8.2" ECU_ADDRESS 0xC0001764 /end MEASUREMENT
/begin MEASUREMENT PFlt_resFlwMax_mp "Maximaler Strömungswiderstand abhängig von kontinuirlich simulierter Russmasse" SWORD Res_hPaHrPerCM 1 100 -3.276800 3.276700 FORMAT "%8.6" ECU_ADDRESS 0xC0001766 /end MEASUREMENT
/begin MEASUREMENT PFlt_resFlwMin_mp "Mnimaler Strömungswiderstand abhängig von kontinuirlich simulierter Russmasse" SWORD Res_hPaHrPerCM 1 100 -3.276800 3.276700 FORMAT "%8.6" ECU_ADDRESS 0xC0001768 /end MEASUREMENT
/begin MEASUREMENT PFlt_rSotMsDvt_mp "Normierte Abweichung zwischen gemessener und kontinuierlich simulierter Russmasse" SWORD RatSotSot 1 100 -8.192000 8.191750 FORMAT "%8.6" ECU_ADDRESS 0xC000176A /end MEASUREMENT
/begin MEASUREMENT PFlt_stDvolSty_mp "Status stationärer Abgasvolumenstrom" UBYTE OneToOne 1 100 0.00 255.0 FORMAT "%5.1" ECU_ADDRESS 0xC000176C /end MEASUREMENT
/begin MEASUREMENT PFlt_stFlwRstnHi_mp "Status Strömungswiderstand zu hoch" UBYTE OneToOne 1 100 0.00 255.0 FORMAT "%5.1" ECU_ADDRESS 0xC000176D /end MEASUREMENT
/begin MEASUREMENT PFlt_stFlwRstnLo_mp "Status Strömungswiderstand zu niedrig" UBYTE OneToOne 1 100 0.00 255.0 FORMAT "%5.1" ECU_ADDRESS 0xC000176E /end MEASUREMENT
/begin MEASUREMENT PFlt_stSysFail "Status Systemfehler für Partikelfilter-Überwachung" UBYTE OneToOne 1 100 0.00 255.0 FORMAT "%5.1" ECU_ADDRESS 0xD000912C /end MEASUREMENT
/begin MEASUREMENT PFlt_stTrgCharMon_mp "Trigger für Überwachung des Partikelfilters durch Überprüfung des berechneten Strömungswiderstands" UBYTE OneToOne 1 100 0.00 255.0 FORMAT "%5.1" ECU_ADDRESS 0xC000176F /end MEASUREMENT
/begin MEASUREMENT PFlt_stTrgCharPDiffMon_mp "Trigger für Überwachung des Partikelfilters mit Hilfe des Differenzdruck" UBYTE OneToOne 1 100 0.00 255.0 FORMAT "%5.1" ECU_ADDRESS 0xC0001770 /end MEASUREMENT
/begin MEASUREMENT PFlt_stTrgChkDvt_mp "Trigger für Überwachung der Abweichung von simulierter und gemessener Partikelmasse" UBYTE OneToOne 1 100 0.00 255.0 FORMAT "%5.1" ECU_ADDRESS 0xC0001771 /end MEASUREMENT
/begin MEASUREMENT PFlt_swtActv "Message zur Deaktivierung der Partikelfilter-Funktionalität" UBYTE OneToOne 1 100 0.00 255.0 FORMAT "%5.1" ECU_ADDRESS 0xD000912D /end MEASUREMENT
/begin FUNCTION PCV_Adapt ""
 /begin DEF_CHARACTERISTIC PCV_dvolUpLim_CUR PCV_facAdaptDiffI_C PCV_facAdaptDiff_C PCV_facAdaptFlowMin_C PCV_facAdaptFlow_MAP PCV_facAdaptMax_C PCV_facAdaptMin_C PCV_facAdaptWgh_C PCV_numAdaptSum_C PCV_numAdaptThres_C PCV_numAdapt_C PCV_pAdaptThresDec_C PCV_pAdaptThresMax_C PCV_pAdaptThresMin_C PCV_pAdaptThres_C PCV_swtAdaptCPC_C PCV_swtAdaptFlow_C PCV_swtAdaptRst_C PCV_swtAdapt_C PCV_tFuelAdaptMax_C PCV_tFuelAdaptMin_C PCV_tiAdaptMax_C PCV_tSwtMeUn_C /end DEF_CHARACTERISTIC
 /begin IN_MEASUREMENT CoEng_st EngDa_tiEngOn Epm_nEng FuelT_t FuelT_tFlSys MeUn_dvolSet PCV_iDvt PCV_iSet PCV_pSet RailP_pFlt Rail_dvolPreCtl Rail_pDvt Rail_pSetPoint Rail_stCtlLoop /end IN_MEASUREMENT
 /begin OUT_MEASUREMENT PCV_facAdapt PCV_facAdaptFlow PCV_stAdaptMeUn /end OUT_MEASUREMENT
 /begin LOC_MEASUREMENT PCV_ctAdapt1_mp PCV_ctAdapt2_mp PCV_ctAdapt3_mp PCV_dvolFlow_mp PCV_pAdaptThres_mp PCV_pFltSum_mp PCV_pSetSum_mp PCV_stAdapt PCV_tiAdaptLst_mp /end LOC_MEASUREMENT
/end FUNCTION
/begin FUNCTION PCV_DDCo ""
 /begin DEF_CHARACTERISTIC PCV_CrntCtlDT1.T1_C PCV_CrntCtlDT1.Kd_C PCV_iLin_CUR PCV_Pwm.tiPer_C PCV_Pwm.stLvl_C PCV_Pwm.rMaxDty_C PCV_Pwm.rPerUn_C PCV_Pwm.tiPh_C PCV_PwmOut.rMin_C PCV_PwmOut.rMax_C PCV_PwmOut.tiBtwTstSCB_C PCV_PwmOut.tiBtwTstOT_C PCV_PwmOut.numTstMax_C PCV_PwmOut.swtBattCor_C PCV_PwmOut.swtPsInv_C PCV_resCoil_C PCV_rSetLin_CUR PCV_rTst_C PCV_SRC.uMin_C PCV_SRC.uMax_C PCV_stPwrStgActv_C PCV_stPwrStgDia_C PCV_tiTst_C /end DEF_CHARACTERISTIC
 /begin IN_MEASUREMENT BattU_facCor BattU_uRated CoEng_st DevLib_stPwrStgEnaCond PCV_iSet /end IN_MEASUREMENT
 /begin LOC_MEASUREMENT PCV_iActVal PCV_rPs_mp PCV_rSetDT1_mp PCV_rSetLin_mp PCV_rSet_mp PCV_uRaw_mp /end LOC_MEASUREMENT
/end FUNCTION
/begin FUNCTION PCV_VDCo ""
 /begin DEF_CHARACTERISTIC PCV_CrntCtlI.Ki_C PCV_CrntCtlI.KiPos_C PCV_CrntCtlI.KiNeg_C PCV_CrntCtlI.WinPos_C PCV_CrntCtlI.WinNeg_C PCV_CtlState.xVal_C PCV_CtlState.xTyp_C PCV_facCrntCtlInit_CUR PCV_facCrntCtlMax_C PCV_facCrntCtlMin_C PCV_iCnvPres_CUR PCV_iSetClose_CUR PCV_iSetMaxBattHi_C PCV_iSetMax_C PCV_iSetMin_C PCV_nSetClose_C PCV_swtClose_C PCV_tiCrntCtlInit_C PCV_tiDurClose_C PCV_tiFlt1PT1_C PCV_tiFlt2PT1_C PCV_tiFltPT1Init_C PCV_tiSetCloseMax_C PCV_tiWaitClose_C PCV_uBattHi_C PCV_uBattLo_C /end DEF_CHARACTERISTIC
 /begin IN_MEASUREMENT BattU_u CEngDsT_t CoEng_st DevLib_stMonActrPrt EpmHCrS_stSigMode Epm_nEng FuelT_tFlSys PCV_facAdapt PCV_facAdaptFlow Rail_stCtlLoop Strt_st SyC_stSub /end IN_MEASUREMENT
 /begin OUT_MEASUREMENT PCV_iDvt PCV_iSet PCV_pSet /end OUT_MEASUREMENT
 /begin LOC_MEASUREMENT PCV_facCrntCtlLim_mp PCV_iActFlt_mp PCV_iAct_mp PCV_iSetClose_mp PCV_iSetFlt_mp PCV_stActrCtl PCV_stEngStrtMov_mp PCV_stSetClose_mp PCV_swtCtlState PCV_tiSetCloseMax_mp /end LOC_MEASUREMENT
/end FUNCTION
/begin FUNCTION PCV_VDLeak "" /begin DEF_CHARACTERISTIC PCV_dvolLeak_CUR /end DEF_CHARACTERISTIC /begin IN_MEASUREMENT Rail_pSetPoint /end IN_MEASUREMENT /begin LOC_MEASUREMENT PCV_dvolLeak_mp /end LOC_MEASUREMENT /end FUNCTION
/begin FUNCTION PFltLd_Co ""
 /begin DEF_CHARACTERISTIC PFltLd_ctRgnSucMin_C PFltLd_DebSim.tiHiLo_C PFltLd_DebSim.tiLoHi_C PFltLd_dpDiffMax_C PFltLd_DT1Pres.T1_C PFltLd_DT1Pres.Kd_C PFltLd_dvolPFltMeasMin_C PFltLd_stMskRgnActv_CA PFltLd_volPFlt_C /end DEF_CHARACTERISTIC
 /begin IN_MEASUREMENT ASMod_dvolPFltEG CoEOM_stOpModeAct Exh_pAdapPPFltDiff PFltLd_mSotMeas PFltLd_mSotSim PFltLd_stNO2Actv PFltRgn_ctRgnSuc PFlt_swtActv /end IN_MEASUREMENT
 /begin OUT_MEASUREMENT PFltLd_dpDiff_mp PFltLd_mSot PFltLd_rSot PFltLd_stSimOn PFltLd_stSimOnBas_mp PFltLd_stSimOn_mp /end OUT_MEASUREMENT
/end FUNCTION
/begin FUNCTION PFltLd_SotAsh ""
 /begin DEF_CHARACTERISTIC PFltLd_facMltCor_CUR PFltLd_facPOpOilAsh_MAP PFltLd_facSumAdjMax_C PFltLd_mOilAshEGSubs_C PFltLd_rhoOilAsh_C PFltLd_swtOilAsh_C PFltLd_tiOpAdjMax_C PFltLd_volOilAshTiEngOn_CUR /end DEF_CHARACTERISTIC
 /begin IN_MEASUREMENT ASMod_dmExhMnfDs ASMod_rAshEG EngDa_tiEngOn Epm_nEng InjCtl_qSetUnBal PFltSrv_numSrvCs PFlt_swtActv /end IN_MEASUREMENT
 /begin OUT_MEASUREMENT PFltLd_facAshCor PFltLd_volAsh /end OUT_MEASUREMENT
 /begin LOC_MEASUREMENT PFltLd_dmOilAshEG_mp PFltLd_facPOpOilAshAvrg_mp PFltLd_facPOpOilAshSum_mp PFltLd_facPOpOilAsh_mp PFltLd_mOilAshEG_mp PFltLd_tiOpPFltEEPROM_mp PFltLd_tiOpPFltSum_mp PFltLd_tiOpPFlt_mp PFltLd_volAsh_mp PFltLd_volOilAshEG_mp PFltLd_volOilAshTiEngOn_mp /end LOC_MEASUREMENT
/end FUNCTION
/begin FUNCTION PFltLd_SotFlwRstn ""
 /begin DEF_CHARACTERISTIC PFltLd_facAshVolCor_MAP PFltLd_facDynVsc_CUR PFltLd_facMaxOfsNO2_C PFltLd_facMaxOfsStrt_C PFltLd_facTCorOfsNO2_CUR PFltLd_facTCorOfsStrt_CUR PFltLd_mSotMeas_MAP PFltLd_nFlwRstnSimMin_C PFltLd_numValAvrgOfsNO2_C PFltLd_numValAvrgOfsStrt_C PFltLd_pDiffPFlt_MAP PFltLd_resFlwMeasInv_MAP PFltLd_resFlwOfs_MAP PFltLd_resFlwPhysMax_C PFltLd_resFlwPhysMin_C PFltLd_resFlw_MAP PFltLd_stFlwRstnPT1RgnMsk_C PFltLd_swtSensEvalSel_C PFltLd_swtSotCalcInitOff_C PFltLd_tiFlwRstnPT1_C PFltLd_tiFlwRstnRgnPT1_C PFltLd_tiMaxOfsNO2_C PFltLd_tiMaxOfsStrt_C PFltLd_tiOfsNO2Del_C PFltLd_tiOfsStrtDel_C PFltLd_tiVolFlwPT1_C PFltLd_tiVolFlwRgnPT1_C /end DEF_CHARACTERISTIC
 /begin IN_MEASUREMENT ASMod_dvolPFltEG ASMod_tPFltSurfSim CoEng_tiNormalRed Epm_nEng Exh_pAdapPPFltDiff PFltLd_facAshCor PFltLd_mSot PFltLd_mSotSimNoContEEP PFltLd_stNO2Actv PFltLd_stSimOn PFltLd_volAsh PFlt_swtActv /end IN_MEASUREMENT
 /begin OUT_MEASUREMENT PFltLd_mSotMeas PFltLd_resFlw PFltLd_resFlwFlt PFltLd_resFlwOfs PFltLd_resFlwRaw PFltLd_resFlwUnCor /end OUT_MEASUREMENT
 /begin LOC_MEASUREMENT PFltLd_dvolPFltEGFlt_mp PFltLd_facAshVolCor_mp PFltLd_mSotAddCorNO2_mp PFltLd_mSotAddCorStrt_mp PFltLd_mSotBefNO2_mp PFltLd_mSotCrv_mp PFltLd_mSotDiffNO2_mp PFltLd_mSotMeasBas_mp PFltLd_mSotMeasLstVld_mp PFltLd_mSotMeasRaw_mp PFltLd_mSotMeasStdByEx_mp PFltLd_mSotOfsNO2Act_mp PFltLd_mSotOfsNO2Max_mp PFltLd_mSotOfsNO2Sum_mp PFltLd_mSotOfsNO2Tot_mp PFltLd_mSotOfsNO2_mp PFltLd_mSotOfsStrtAct_mp PFltLd_mSotOfsStrtMax_mp PFltLd_mSotOfsStrtSum_mp PFltLd_mSotOfsStrt_mp PFltLd_numValAvrgOfsNO2_mp PFltLd_numValAvrgOfsStrt_mp PFltLd_pDiffAshVolCor_mp PFltLd_pDiffPFlt_mp PFltLd_pDiffSot_mp PFltLd_resFlwMeasInv_mp PFltLd_resFlwRaw_mp PFltLd_stAvrgTOutNO2_mp PFltLd_stMsSotOfsNO2Actv_mp PFltLd_stMsSotOfsStrtActv_mp PFltLd_stOfsNO2Rls_mp PFltLd_stsSotOfsStrtActv_mp PFltLd_stStMOfsNO2_mp PFltLd_tiCorOfsNO2_mp /end LOC_MEASUREMENT
/end FUNCTION
/begin FUNCTION PFltLd_SotSim ""
 /begin DEF_CHARACTERISTIC PFltLd_dmSotSimRgnBas_CUR PFltLd_facCnvCatNO2_CUR PFltLd_facNO2Sot_C PFltLd_facO2SimRgn_MAP PFltLd_facSotSimRgnNO2_CUR PFltLd_facTempNO2_CUR PFltLd_facTempSimRgn_CUR PFltLd_facVolFlwNO2_CUR PFltLd_kiMSotRes_C PFltLd_mSotResAftRgn_CA PFltLd_mSotResAftRgn_MAP PFltLd_mSotSimMax_C PFltLd_mSotSimNoContSubs_C PFltLd_numLSU_C PFltLd_numRatO2_C PFltLd_rStoich_C PFltLd_stEngPOpSpoRgn_C PFltLd_stMsSotResRgnMsk_C PFltLd_swtMsSotResIniOn_C PFltLd_swtMsSotRes_C PFltLd_swtSimRgnNO2Off_C PFltLd_swtSotSim_C PFltLd_tiNO2RgnDel_MAP /end DEF_CHARACTERISTIC
 /begin IN_MEASUREMENT ASMod_dmExhMnfDs ASMod_dmNOxEG ASMod_dmSotEG ASMod_dvolPFltEG ASMod_rO2EGFld ASMod_tPFltSurfSim CoEOM_stOpModeAct Epm_nEng Exh_tAdapTOxiCatUs InjCtl_qSetUnBal LSU_rLam LSU_rO2Adap LSU_stO2IntValid PFltLd_mSot PFltLd_mSotMeas PFltLd_stSimOn PFltPOp_stEngPOp PFltRgn_stIntr PFltRgn_stLck PFltRgn_stSuc PFltSrv_numSrvCs PFlt_swtActv /end IN_MEASUREMENT
 /begin OUT_MEASUREMENT PFltLd_dmO2Aprx PFltLd_dmSotSim PFltLd_mSotSim PFltLd_mSotSimCont PFltLd_mSotSimNoContEEP PFltLd_stNO2Actv /end OUT_MEASUREMENT
 /begin LOC_MEASUREMENT PFltLd_dmNO2TotMax_mp PFltLd_dmNO2Tot_mp PFltLd_dmSotRaw_mp PFltLd_dmSotSimRgnBas_mp PFltLd_dmSotSimRgnNO2Raw_mp PFltLd_dmSotSimRgnNO2_mp PFltLd_dmSotSimRgnThr_mp PFltLd_dmSotSimRgn_mp PFltLd_facO2SimRgn_mp PFltLd_facSotSimRgnNO2_mp PFltLd_facSotSimRgn_mp PFltLd_facTempNO2_mp PFltLd_facTempSimRgn_mp PFltLd_facVolFlwNO2_mp PFltLd_mSotIntegIni_mp PFltLd_mSotResAct_mp PFltLd_mSotRes_mp PFltLd_mSotRgnThr_mp PFltLd_mSotSimContEEP_mp PFltLd_mSotSimNoCont_mp PFltLd_rLamAprx_mp PFltLd_rLam_mp PFltLd_stInitAftSuc_mp PFltLd_stMsSotResRst_mp PFltLd_stSotIniCont_mp PFltLd_stSotIniNoCont_mp PFltLd_stSotIntegIni_mp PFltLd_tiNO2RgnDel_mp PFltLd_tiRgnAct_mp /end LOC_MEASUREMENT
/end FUNCTION
/begin FUNCTION PFltLmp_DD ""
 /begin DEF_CHARACTERISTIC PFltLmp_DigOut.tiBtwTstSCB_C PFltLmp_DigOut.tiBtwTstOT_C PFltLmp_DigOut.numTstMax_C PFltLmp_stPsDiaDisbl_C PFltLmp_stPsDisbl_C /end DEF_CHARACTERISTIC
 /begin IN_MEASUREMENT DevLib_stPwrStgEnaCond /end IN_MEASUREMENT
 /begin OUT_MEASUREMENT PFltLmp_st PFltLmp_stPs /end OUT_MEASUREMENT
/end FUNCTION
/begin FUNCTION PFltPOp_RngDet ""
 /begin DEF_CHARACTERISTIC PFltPOp_nEng_CA PFltPOp_numAir_C PFltPOp_qSetUnBalRng10Max_GCUR PFltPOp_qSetUnBalRng10Min_GCUR PFltPOp_qSetUnBalRng1Max_GCUR PFltPOp_qSetUnBalRng1Min_GCUR PFltPOp_qSetUnBalRng2Max_GCUR PFltPOp_qSetUnBalRng2Min_GCUR PFltPOp_qSetUnBalRng3Max_GCUR PFltPOp_qSetUnBalRng3Min_GCUR PFltPOp_qSetUnBalRng4Max_GCUR PFltPOp_qSetUnBalRng4Min_GCUR PFltPOp_qSetUnBalRng5Max_GCUR PFltPOp_qSetUnBalRng5Min_GCUR PFltPOp_qSetUnBalRng6Max_GCUR PFltPOp_qSetUnBalRng6Min_GCUR PFltPOp_qSetUnBalRng7Max_GCUR PFltPOp_qSetUnBalRng7Min_GCUR PFltPOp_qSetUnBalRng8Max_GCUR PFltPOp_qSetUnBalRng8Min_GCUR PFltPOp_qSetUnBalRng9Max_GCUR PFltPOp_qSetUnBalRng9Min_GCUR PFltPOp_qSetUnBalRngSpoMax_GCUR PFltPOp_qSetUnBalRngSpoMin_GCUR PFltPOp_qSetUnBal_AXIS PFltPOp_rAPP_CA PFltPOp_stGear_CA PFltPOp_swtBrkRng_CA PFltPOp_swtClthRng_CA PFltPOp_tAdapTOxiCatUsOff_CA PFltPOp_tAdapTOxiCatUsOn_CA PFltPOp_tAdapTPFltUsOff_CA PFltPOp_tAdapTPFltUsOn_CA PFltPOp_tAir_CA PFltPOp_tEngTemp_CA PFltPOp_uBatt_CA PFltPOp_v_CA /end DEF_CHARACTERISTIC
 /begin IN_MEASUREMENT PFltPOp_nEngFlt PFlt_swtActv /end IN_MEASUREMENT
 /begin OUT_MEASUREMENT PFltPOp_stEngPOp /end OUT_MEASUREMENT
 /begin LOC_MEASUREMENT PFltPOp_RngIdx_X_mp PFltPOp_RngIdx_Y_mp PFltPOp_stEngPOp10_mp PFltPOp_stEngPOp1_mp PFltPOp_stEngPOp2_mp PFltPOp_stEngPOp3_mp PFltPOp_stEngPOp4_mp PFltPOp_stEngPOp5_mp PFltPOp_stEngPOp6_mp PFltPOp_stEngPOp7_mp PFltPOp_stEngPOp8_mp PFltPOp_stEngPOp9_mp PFltPOp_stEngPOpSpo_mp PFltPOp_stRng10_mp PFltPOp_stRng1_mp PFltPOp_stRng2_mp PFltPOp_stRng3_mp PFltPOp_stRng4_mp PFltPOp_stRng5_mp PFltPOp_stRng6_mp PFltPOp_stRng7_mp PFltPOp_stRng8_mp PFltPOp_stRng9_mp PFltPOp_stRngSpo_mp PFltPOp_tAir_mp /end LOC_MEASUREMENT
/end FUNCTION
/begin FUNCTION PFltPOp_SigCond ""
 /begin DEF_CHARACTERISTIC PFltPOp_DebBrk.tiHiLo_C PFltPOp_DebBrk.tiLoHi_C PFltPOp_DebClth.tiHiLo_C PFltPOp_DebClth.tiLoHi_C PFltPOp_DebGear.tiHiLo_C PFltPOp_DebGear.tiLoHi_C PFltPOp_numEngTemp_C PFltPOp_qTrq2Qnt_CUR PFltPOp_stGearDebValMax_C PFltPOp_stGearDebValMin_C PFltPOp_swtTrqQnt_C PFltPOp_tiAPPRatPT1_C PFltPOp_tiBattPT1_C PFltPOp_tiEngSpdPT1_C PFltPOp_tiEngTempPT1_C PFltPOp_tiInjMsPT1_C PFltPOp_tiSpdVehPT1_C PFltPOp_tiTempOxiCatUsPT1_C PFltPOp_tiTempPFltUsPT1_C /end DEF_CHARACTERISTIC
 /begin IN_MEASUREMENT APP_r BattU_u Brk_st Clth_st CoEng_st EngDa_tFld Epm_nEng Exh_tAdapTOxiCatUs Exh_tAdapTPFltUs InjCtl_qSetUnBal PFlt_swtActv PthSet_trqInrSet PT_numTraGear VehV_v /end IN_MEASUREMENT
 /begin OUT_MEASUREMENT PFltPOp_nEngFlt PFltPOp_qSetUnBalFlt PFltPOp_rAPPFlt PFltPOp_stBrkDeb PFltPOp_stClthDeb PFltPOp_stGearDeb PFltPOp_tAdapTOxiCatUsFlt PFltPOp_tAdapTPFltUsFlt PFltPOp_tEngTempFlt PFltPOp_uBattFlt PFltPOp_vFlt /end OUT_MEASUREMENT
 /begin LOC_MEASUREMENT PFltPOp_tEngTemp_mp /end LOC_MEASUREMENT
/end FUNCTION
/begin FUNCTION PFltRgn_CmpnPrt ""
 /begin DEF_CHARACTERISTIC PFltRgn_stLckFlMsk_C PFltRgn_stSysFailMsk_C PFltRgn_tiDebQLimErrIntr_C PFltRgn_tiDebTrqOvhtIntr_C PFltRgn_tiKpRgnOvrRun_C PFltRgn_tiSysFailDel_C PFltRgn_tOxiCatUsMaxHi_C PFltRgn_tOxiCatUsMaxLo_C PFltRgn_tPFltUsMaxHi_C PFltRgn_tPFltUsMaxLo_C PFltRgn_tPFltUsMinOvrRun_C PFltRgn_tTrbnUsMaxHi_C PFltRgn_tTrbnUsMinLo_C PFltRgn_volFlMinHi_C PFltRgn_volFlMinLo_C /end DEF_CHARACTERISTIC
 /begin OUT_MEASUREMENT PFltRgn_stIntr /end OUT_MEASUREMENT
 /begin LOC_MEASUREMENT PFltRgn_stIntrAct_mp PFltRgn_tiTmrStOvrRun_mp /end LOC_MEASUREMENT
/end FUNCTION
/begin FUNCTION PFltRgn_Co ""
 /begin DEF_CHARACTERISTIC PFltRgn_ctRgnSubs_C PFltRgn_DebLck.tiHiLo_C PFltRgn_DebLck.tiLoHi_C PFltRgn_facChngRgnDel_CA PFltRgn_numEngPOpDel_CA PFltRgn_numEngPOpIntr_CA PFltRgn_numEngPOp_CA PFltRgn_numRgnSuc_C PFltRgn_numRgnTxtMsg_C PFltRgn_stLckOpMode_C PFltRgn_stLckRgnMsk_C PFltRgn_stOpModeAct_CA PFltRgn_stOpModeDes_CA PFltRgn_stRgnNoCmplnSubs_C PFltRgn_stRgnOpMode_CA PFltRgn_swtTmrLckRst_C PFltRgn_tiChngRgnDelBas_MAP PFltRgn_tiLckRgnErr_CA PFltRgn_tiLckRgn_CA PFltRgn_tiLckSubs_C PFltRgn_tiRgnMax_CA PFltRgn_tiRgnSpo_C /end DEF_CHARACTERISTIC
 /begin IN_MEASUREMENT CoEOM_stOpModeAct CoEOM_tiRmpSlp Epm_nEng InjCtl_qSetUnBal PFltPOp_stEngPOp PFltRgn_numRgn PFltRgn_stIntr PFltRgn_stRgnJmp PFltSrv_numSrvCs PFltSrv_stOpMode PFltSrv_stRgnOn PFltSrv_stRgnSuc PFlt_swtActv PthSet_stOvrRun PthSet_trqInrSet /end IN_MEASUREMENT
 /begin OUT_MEASUREMENT PFltRgn_ctRgnSuc PFltRgn_numTot PFltRgn_stLck PFltRgn_stOpMode PFltRgn_stRgnOpMode PFltRgn_stSuc PFltRgn_stTxtMsg PFltRgn_tiChngRgnDel /end OUT_MEASUREMENT
 /begin LOC_MEASUREMENT PFltRgn_ctRgnDemEEP_mp PFltRgn_ctRgnDem_mp PFltRgn_ctRgnSucEEP_mp PFltRgn_numEngPOp_mp PFltRgn_numRgn_mp PFltRgn_stChngImmd_mp PFltRgn_stChngRgnDelExpd_mp PFltRgn_stChngRgnDel_mp PFltRgn_stChngRgn_mp PFltRgn_stJmpCond_mp PFltRgn_stNumEngPOpDelOn_mp PFltRgn_stNumSotSucAct_mp PFltRgn_stNumSotSuc_mp PFltRgn_stNumTxtMsg_mp PFltRgn_stRgnNoCmplnEEP_mp PFltRgn_stRgnNoCmpln_mp PFltRgn_stRgnOpModeDel_mp PFltRgn_stSucAct_mp PFltRgn_tiChngRgnDelBas_mp PFltRgn_tiChngRgn_mp PFltRgn_tiLckRgn_mp PFltRgn_tiRgnMax_mp PFltRgn_tiRgnSpo_mp PFltRgn_tiTmrLckRgnEEP_mp PFltRgn_tiTmrLckRgn_mp PFltRgn_tiTmrRgnMax_mp PFltRgn_tiTmrRgnSpo_mp /end LOC_MEASUREMENT
/end FUNCTION
/begin FUNCTION PFltRgn_Dem ""
 /begin DEF_CHARACTERISTIC PFltRgn_lSumMaxDef_C PFltRgn_lSumMax_C PFltRgn_lSumSubs_C PFltRgn_mSotMeas_CUR PFltRgn_mSotRngDwn_CA PFltRgn_mSotRngUp_CA PFltRgn_numLst_C PFltRgn_numPrt_C PFltRgn_pEngPrtMaxInit_C PFltRgn_pEngPrtMax_MAP PFltRgn_pEngPrtMin_MAP PFltRgn_qFlMaxDef_C PFltRgn_qFlMax_C PFltRgn_qFlSubs_C PFltRgn_stRgnActvMsk_C PFltRgn_swtAshCor_C PFltRgn_swtCntAshCor_C PFltRgn_swtMsSotRngDwnCor_C PFltRgn_swtMsSotRngUpCor_C PFltRgn_swtOfsCor_C PFltRgn_tiEngOnMaxDef_C PFltRgn_tiEngOnMax_C PFltRgn_tiEngPrtPT1_C PFltRgn_tiEngPrt_C PFltRgn_tiLstRgn_C PFltRgn_tiOpSubs_C PFltRgn_tiTmrEngPrtSubs_C PFltRgn_tiTmrLstRgnSubs_C PFltRgn_volFlConsumSubs_C /end DEF_CHARACTERISTIC
 /begin IN_MEASUREMENT CoEOM_stOpModeAct EngDa_tiEngOn Epm_nEng Exh_pAdapPPFltDiff FlSys_dvolFlCons GlbDa_lTotDst InjCtl_qSetUnBal PFltLd_facAshCor PFltLd_mSot PFltLd_resFlwOfs PFltRgn_stSuc PFltSrv_numSrvCs PFlt_swtActv /end IN_MEASUREMENT
 /begin OUT_MEASUREMENT PFltRgn_lSnceRgn PFltRgn_numRgn PFltRgn_qFlTot PFltRgn_stEngPrtActv PFltRgn_tiSnceRgn /end OUT_MEASUREMENT
 /begin LOC_MEASUREMENT PFltRgn_dvolFlCons_mp PFltRgn_lSumMax_mp PFltRgn_lSum_mp PFltRgn_mSotOfs_mp PFltRgn_numLst_mp PFltRgn_numPrt_mp PFltRgn_numSot_mp PFltRgn_pActEngPrt_mp PFltRgn_pEngPrtMaxRaw_mp PFltRgn_pEngPrtMax_mp PFltRgn_pEngPrtMinRaw_mp PFltRgn_pEngPrtMin_mp PFltRgn_qFlEEP_mp PFltRgn_qFlMax_mp PFltRgn_qFlTotEEP_mp PFltRgn_qFl_mp PFltRgn_resFlwOfs_mp PFltRgn_stActEngPrt_mp PFltRgn_stEngPrt_mp PFltRgn_stLstRgnEnd_mp PFltRgn_stLstRgn_mp PFltRgn_stLst_mp PFltRgn_stRgnSwtPar_mp PFltRgn_tiOp_mp PFltRgn_tiTmrEngPrt_mp PFltRgn_tiTmrLstRgn_mp /end LOC_MEASUREMENT
/end FUNCTION
/begin FUNCTION PFltRgn_JmpCondDet ""
 /begin DEF_CHARACTERISTIC PFltRgn_aDynMinLim_MAP PFltRgn_drAccPedDyn_C PFltRgn_drAccPedRawMax_C PFltRgn_drAccPedRawMin_C PFltRgn_DT1AccPed.T1_C PFltRgn_DT1AccPed.Kd_C PFltRgn_facDynInjQnt_C PFltRgn_facFullLdCor_MAP PFltRgn_rAccPedDynMin_C PFltRgn_rFullLdBas_MAP PFltRgn_rFullLdMax_C PFltRgn_rFullLdMin_C PFltRgn_stRgnJmpMsk_C PFltRgn_swtDynDetSmkLimOn_C PFltRgn_tiAccPedPT1_C PFltRgn_vDynDetMax_C PFltRgn_vDynDetMin_C PFltRgn_vOvrRunMax_C PFltRgn_vOvrRunMin_C /end DEF_CHARACTERISTIC
 /begin IN_MEASUREMENT APP_r Epm_nEng InjCtl_qSetUnBal PFlt_swtActv PthSet_stOvrRun PthSet_trqInrSet PT_numTraGear PT_stGrip SmkLim_qLimSmk VehV_a VehV_v /end IN_MEASUREMENT
 /begin OUT_MEASUREMENT PFltRgn_stRgnJmp /end OUT_MEASUREMENT
 /begin LOC_MEASUREMENT PFltRgn_aDynMinLim_mp PFltRgn_drAccPedFlt_mp PFltRgn_drAccPedRaw_mp PFltRgn_facFullLdCor_mp PFltRgn_rFullLdBas_mp PFltRgn_rFullLd_mp PFltRgn_stRgnJmpNoMsk_mp PFltRgn_stSmkLim_mp /end LOC_MEASUREMENT
/end FUNCTION
/begin FUNCTION PFltSrv_Lib ""
 /begin DEF_CHARACTERISTIC PFltSrv_ctRgnDemAdjMax_C PFltSrv_ctRgnSucAdjMax_C PFltSrv_dmOilAshDia_C PFltSrv_facPOpOilAshAdjMax_C PFltSrv_lSumAdjMax_C PFltSrv_lSumDiaAdjMax_C PFltSrv_mOilAshAdjMax_C PFltSrv_mSotContAdjMax_C PFltSrv_mSotDia_C PFltSrv_mSotNoContAdjMax_C PFltSrv_numAdjIdAdjMax_C PFltSrv_numSrvIdAdjMax_C PFltSrv_qFlAdjMax_C PFltSrv_stRgnNoComplAdjMax_C PFltSrv_tiEngPrtAdjMax_C PFltSrv_tiLckRlsAdjMax_C PFltSrv_tiLstRgnAdjMax_C PFltSrv_tiLstRgnDia_C PFltSrv_tiOpAdjMax_C PFltSrv_tiOpPFltAdjMax_C PFltSrv_vAvrgDia_C /end DEF_CHARACTERISTIC
 /begin IN_MEASUREMENT EngDa_tiEngOn GlbDa_lTotDst PFltSrv_stRgnTstr /end IN_MEASUREMENT
 /begin OUT_MEASUREMENT PFltSrv_numSrvCs /end OUT_MEASUREMENT
/end FUNCTION
/begin FUNCTION PFltSrv_Rgn ""
 /begin DEF_CHARACTERISTIC PFltSrv_mSotRgnSucMax_C PFltSrv_nEngIncrIdlMax_C PFltSrv_nEngIncrIdlMin_C PFltSrv_nMinClgDwn_C PFltSrv_nMinRgn_C PFltSrv_stHldOnClgDwnMsk_C PFltSrv_stHldOnRgnMsk_C PFltSrv_stOpModeClgDwn_C PFltSrv_stOpModeHtUp1_C PFltSrv_stOpModeHtUp2_C PFltSrv_stOpModeRgn_C PFltSrv_stRlsMsk_C PFltSrv_tiClgDwnMax_C PFltSrv_tiRgnSucMin_C PFltSrv_tiSrvIdlHtUp2Min_C PFltSrv_tiSrvIdlRgnMin_C PFltSrv_tOxiCUsClgDwnMax_C PFltSrv_tOxiCUsHtUp2Min_C PFltSrv_tOxiCUsRgnMin_C PFltSrv_tPFltUsClgDwnMax_C PFltSrv_tPFltUsHtUp2Min_C PFltSrv_tPFltUsRgnMin_C PFltSrv_tRgnSucMin_C /end DEF_CHARACTERISTIC
 /begin REF_CHARACTERISTIC PFltSrv_swtCalcCondClb_C /end REF_CHARACTERISTIC
 /begin IN_MEASUREMENT Epm_nEng Exh_tAdapTOxiCatUs Exh_tAdapTPFltUs PFltLd_mSot PFltSrv_stCond PFlt_swtActv /end IN_MEASUREMENT
 /begin OUT_MEASUREMENT PFltSrv_stCondTstr PFltSrv_stOpMode PFltSrv_stRgnOn PFltSrv_stRgnSuc PFltSrv_stRgnTstr PFlt_nMin /end OUT_MEASUREMENT
 /begin LOC_MEASUREMENT PFltSrv_stClgDwnEnd_mp PFltSrv_stCondClgDwnEnd_mp PFltSrv_stCondHldOnClgDwn_mp PFltSrv_stCondHldOnRgn_mp PFltSrv_stCondHtUp2_mp PFltSrv_stCondRgnSuc_mp PFltSrv_stCondRgn_mp PFltSrv_stCondRls_mp PFltSrv_stHldOnClgDwn_mp PFltSrv_stHldOnRgn_mp PFltSrv_stHtUp2_mp PFltSrv_stRgnSuc_mp PFltSrv_stRgn_mp PFltSrv_stRls_mp PFltSrv_stStopTmp_mp PFltSrv_stStop_mp PFltSrv_stStrt_mp PFltSrv_tiClgDwn_mp PFltSrv_tiSrvIdl_mp PFltSrv_tiTRgnSucMin_mp /end LOC_MEASUREMENT
/end FUNCTION
/begin FUNCTION PFltSrv_RgnCond ""
 /begin DEF_CHARACTERISTIC PFltSrv_mSotStrtMax_C PFltSrv_mSotStrtMin_C PFltSrv_nMax_C PFltSrv_nMin_C PFltSrv_pEnvMin_C PFltSrv_rAccPedMax_C PFltSrv_stRgnOpMMsk_C PFltSrv_swtCalcCondClb_C PFltSrv_swtCondAshCor_C PFltSrv_tClntMinHi_C PFltSrv_tClntMinLo_C PFltSrv_tFlMax_C PFltSrv_tiDebTOxiCUsMax_C PFltSrv_tiDebTPFltUsMax_C PFltSrv_tiEngNrm_C PFltSrv_tiHtgUpMax_C PFltSrv_tiRgnMax_C PFltSrv_tOilMinHi_C PFltSrv_tOilMinLo_C PFltSrv_tOxiCUsHtgUp_C PFltSrv_tOxiCUsMax_C PFltSrv_tOxiCUsStrtMax_C PFltSrv_tOxiCUsStrtMin_C PFltSrv_tPFltUsHtgUp_C PFltSrv_tPFltUsMax_C PFltSrv_tPFltUsStrtMax_C PFltSrv_tPFltUsStrtMin_C PFltSrv_trqMax_CUR PFltSrv_trqMin_CUR PFltSrv_uBattMin_C /end DEF_CHARACTERISTIC
 /begin REF_CHARACTERISTIC PT_numTraNoGear_C /end REF_CHARACTERISTIC
 /begin IN_MEASUREMENT APP_r CEngDsT_t Clth_st CoEng_tiNormalRed CoEOM_stOpModeAct EnvP_p Epm_nEng ESS_uBatt Exh_tAdapTOxiCatUs Exh_tAdapTPFltUs FuelT_tFlSys Oil_tSwmp PFltLd_facAshCor PFltLd_mSot PFltSrv_stRgnTstr PFlt_swtActv PthSet_trqInrSet PT_numTraGear PT_numTraGearDes VehV_v /end IN_MEASUREMENT
 /begin OUT_MEASUREMENT PFltSrv_stCond /end OUT_MEASUREMENT
 /begin LOC_MEASUREMENT PFltSrv_mSotStrtMax_mp PFltSrv_mSotStrtMin_mp PFltSrv_tiRgnAct_mp PFltSrv_trqMax_mp PFltSrv_trqMin_mp /end LOC_MEASUREMENT
/end FUNCTION
/begin FUNCTION PFlt_Adapt ""
 /begin DEF_CHARACTERISTIC ASMod_dmNOxEG_C ASMod_dmSotEG_C Exh_pOfsValActMidPPFltDiff_C Exh_stStyPPFltDiff_C Exh_stTrgAftRunPPFltDiff_C FuelLvl_vol_C /end DEF_CHARACTERISTIC
 /begin IN_MEASUREMENT PFlt_nMin /end IN_MEASUREMENT
 /begin OUT_MEASUREMENT ASMod_dmNOxEG ASMod_dmSotEG Exh_pOfsValActMidPPFltDiff Exh_stStyPPFltDiff Exh_stTrgAftRunPPFltDiff FuelLvl_vol /end OUT_MEASUREMENT
 /begin LOC_MEASUREMENT Exh_pRawAdapPPFltDiff /end LOC_MEASUREMENT
/end FUNCTION
/begin FUNCTION PFlt_Ini "" /begin DEF_CHARACTERISTIC PFlt_swtActv_C PFlt_swtSrvVal_C /end DEF_CHARACTERISTIC /begin OUT_MEASUREMENT PFlt_swtActv /end OUT_MEASUREMENT /end FUNCTION
/begin FUNCTION PFlt_Mon ""
 /begin DEF_CHARACTERISTIC PFlt_dvolCharMonMin_C PFlt_dvolChkDstrMin_C PFlt_dvolMaxVar_C PFlt_mSotChkDstrMax_C PFlt_mSotChkDstrMin_C PFlt_mSotChkDvtMin_C PFlt_mSotChkFlwRstnMin_C PFlt_mSotHysMaxDwn_C PFlt_mSotHysMaxUp_C PFlt_pDiffCharMonMin_MAP PFlt_pDiffNoDstrMin_CUR PFlt_resFlwMax_CUR PFlt_resFlwMin_CUR PFlt_rSotMsDvtMax_C PFlt_rSotMsDvtMin_C PFlt_stCharMonRgnOffMsk_CA PFlt_stChkDstrMsk_CA PFlt_swtMonAshCor_C PFlt_swtTrgCharMon_C PFlt_tiDvolStyChk_C /end DEF_CHARACTERISTIC
 /begin IN_MEASUREMENT ASMod_dvolPFltEG CoEOM_stOpModeAct Exh_pAdapPPFltDiff Exh_pOfsValActMidPPFltDiff Exh_pRawAdapPPFltDiff Exh_stStyPPFltDiff Exh_stTrgAftRunPPFltDiff PFltLd_facAshCor PFltLd_mSot PFltLd_mSotMeas PFltLd_mSotSimCont PFltLd_stSimOn PFltRgn_stEngPrtActv PFltRgn_stLck PFlt_swtActv /end IN_MEASUREMENT
 /begin OUT_MEASUREMENT PFlt_stSysFail /end OUT_MEASUREMENT
 /begin LOC_MEASUREMENT PFlt_dvolMaxSty_mp PFlt_dvolPFltEGInMon_mp PFlt_mSotDvt_mp PFlt_pDiffCharMonMin_mp PFlt_pDiffMaxStyOfsCor_mp PFlt_pDiffMaxSty_mp PFlt_pDiffNoDstrMin_mp PFlt_resFlwMax_mp PFlt_resFlwMin_mp PFlt_rSotMsDvt_mp PFlt_stDvolSty_mp PFlt_stFlwRstnHi_mp PFlt_stFlwRstnLo_mp PFlt_stTrgCharMon_mp PFlt_stTrgCharPDiffMon_mp PFlt_stTrgChkDvt_mp /end LOC_MEASUREMENT
/end FUNCTION
/begin COMPU_METHOD Acc "" RAT_FUNC "%6.5" "m/s^2" COEFFS 0 1000 0 0 0 1 /end COMPU_METHOD
/begin COMPU_METHOD AirFlRat "" RAT_FUNC "%6.4" "-" COEFFS 0 200 0 0 0 1 /end COMPU_METHOD
/begin COMPU_METHOD AirMassPerTime "" RAT_FUNC "%6.3" "Kg/h" COEFFS 0 10 0 0 0 1 /end COMPU_METHOD
/begin COMPU_METHOD AirVolPerTime "" RAT_FUNC "%6.3" "m^3/h" COEFFS 0 10 0 0 0 1 /end COMPU_METHOD
/begin COMPU_METHOD CubMtrPerHr "" RAT_FUNC "%6.3" "m^3/h" COEFFS 0 10 0 0 0 1 /end COMPU_METHOD
/begin COMPU_METHOD Curr "" RAT_FUNC "%6.2" "mA" COEFFS 0 1 0 0 0 1 /end COMPU_METHOD
/begin COMPU_METHOD dmNOx_mg_p_s "" RAT_FUNC "%6.3" "mg/s" COEFFS 0 6.66666666666667 0 0 0 1 /end COMPU_METHOD
/begin COMPU_METHOD dmOilAsh_mg_p_s "" RAT_FUNC "%6.4" "mg/s" COEFFS 0 100 0 0 0 1 /end COMPU_METHOD
/begin COMPU_METHOD dmSoot_mg_p_s "" RAT_FUNC "%6.4" "mg/s" COEFFS 0 100 0 0 0 1 /end COMPU_METHOD
/begin COMPU_METHOD dPres_hPa_p_s "" RAT_FUNC "%6.2" "hPa/s" COEFFS 0 1 0 0 0 1 /end COMPU_METHOD
/begin COMPU_METHOD DtyCyc "" RAT_FUNC "%6.4" "%" COEFFS 0 100 0 0 0 1 /end COMPU_METHOD
/begin COMPU_METHOD EngN "" RAT_FUNC "%6.3" "rpm" COEFFS 0 2 0 0 0 1 /end COMPU_METHOD
/begin COMPU_METHOD EngTempFldSel "" TAB_VERB "%6.3" "-" COMPU_TAB_REF EngTempFldSel /end COMPU_METHOD
/begin COMPU_VTAB EngTempFldSel "" TAB_VERB 3 0 "Coolant_Temperature" 1 "Oil_Temperature" 2 "EngDa_tEng" /end COMPU_VTAB
/begin COMPU_METHOD Fact "" RAT_FUNC "%6.5" "-" COEFFS 0 8192 0 0 0 1 /end COMPU_METHOD
/begin COMPU_METHOD Fact1 "" RAT_FUNC "%6.4" "-" COEFFS 0 128 0 0 0 1 /end COMPU_METHOD
/begin COMPU_METHOD Fact4 "" RAT_FUNC "%6.4" "-" COEFFS 0 20 0 0 0 1 /end COMPU_METHOD
/begin COMPU_METHOD FlCons_lps_q0p0001 "" RAT_FUNC "%7.6" "l/s" COEFFS 0 10000 0 0 0 1 /end COMPU_METHOD
/begin COMPU_METHOD Fl_2 "" RAT_FUNC "%6.1" "l" COEFFS 0 0.1 0 0 0 1 /end COMPU_METHOD
/begin COMPU_METHOD Fl_L "" RAT_FUNC "%6.4" "l" COEFFS 0 100 0 0 0 1 /end COMPU_METHOD
/begin COMPU_METHOD Fl_Vol "" RAT_FUNC "%6.5" "l/100km" COEFFS 0 1000 0 0 0 1 /end COMPU_METHOD
/begin COMPU_METHOD GC_Volt "" RAT_FUNC "%6.2" "mV" COEFFS 0 0.2046 0 0 0 1 /end COMPU_METHOD
/begin COMPU_METHOD GSSYS_TYPEEXHFLW_SY_Compu "" TAB_NOINTP "%6.3" "-" COMPU_TAB_REF GSSYS_TYPEEXHFLW_SY_Compu /end COMPU_METHOD
/begin COMPU_TAB GSSYS_TYPEEXHFLW_SY_Compu "" TAB_NOINTP 8 0 0 1 1 2 2 3 3 4 4 5 5 6 6 7 7 /end COMPU_TAB
/begin COMPU_METHOD IndSysTempFldSel "" TAB_VERB "%6.3" "-" COMPU_TAB_REF IndSysTempFldSel /end COMPU_METHOD
/begin COMPU_VTAB IndSysTempFldSel "" TAB_VERB 3 0 "CACDsT_t" 1 "AFST_t" 2 "EnvT_t" /end COMPU_VTAB
/begin COMPU_METHOD InjMass "" RAT_FUNC "%6.4" "mg/hub" COEFFS 0 100 0 0 0 1 /end COMPU_METHOD
/begin COMPU_METHOD InjMassCyc "" RAT_FUNC "%6.4" "mg/cyc" COEFFS 0 100 0 0 0 1 /end COMPU_METHOD
/begin COMPU_METHOD Kd "" RAT_FUNC "%7.6" "1/1" COEFFS 0 65536 0 0 0 1 /end COMPU_METHOD
/begin COMPU_METHOD KiRmnSotMs "" RAT_FUNC "%6.3" "1/s" COEFFS 0 2 0 0 0 1 /end COMPU_METHOD
/begin COMPU_METHOD Ki_curr2fact "" RAT_FUNC "%10.9" "1/mA*s" COEFFS 0 17592186.044416 0 0 0 1 /end COMPU_METHOD
/begin COMPU_METHOD Ki_PrcEGRRmp_2_Prc "" RAT_FUNC "%7.6" "1/s" COEFFS 0 26843.5456 0 0 0 1 /end COMPU_METHOD
/begin COMPU_METHOD lambda "" RAT_FUNC "%6.5" "-" COEFFS 0 1000 0 0 0 1 /end COMPU_METHOD
/begin COMPU_METHOD Length "" RAT_FUNC "%6.2" "m" COEFFS 0 1 0 0 0 1 /end COMPU_METHOD
/begin COMPU_METHOD mOilAsh_g "" RAT_FUNC "%6.4" "g" COEFFS 0 100 0 0 0 1 /end COMPU_METHOD
/begin COMPU_METHOD mSoot_g "" RAT_FUNC "%6.4" "g" COEFFS 0 100 0 0 0 1 /end COMPU_METHOD
/begin COMPU_METHOD NOxMassPerTime "" RAT_FUNC "%6.3" "mg/s" COEFFS 0 10 0 0 0 1 /end COMPU_METHOD
/begin COMPU_METHOD OneToOne "" RAT_FUNC "%6.2" "-" COEFFS 0 1 0 0 0 1 /end COMPU_METHOD
/begin COMPU_METHOD Period "" RAT_FUNC "%6.3" "ms" COEFFS 0 10 0 0 0 1 /end COMPU_METHOD
/begin COMPU_METHOD Prc "" RAT_FUNC "%6.4" "%" COEFFS 0 81.92 0 0 0 1 /end COMPU_METHOD
/begin COMPU_METHOD PrcPerSec "" RAT_FUNC "%6.3" "%/s" COEFFS 0 1.6384 0 0 0 1 /end COMPU_METHOD
/begin COMPU_METHOD Pres_hPa "" RAT_FUNC "%6.2" "hPa" COEFFS 0 1 0 0 0 1 /end COMPU_METHOD
/begin COMPU_METHOD Pres_Rail "" RAT_FUNC "%4.3" "bar" COEFFS 0 10.000000 0 0 0 1 /end COMPU_METHOD
/begin COMPU_METHOD Qp_mm3_sec "" RAT_FUNC "%6.1" "mm3/s" COEFFS 0 0.1 0 0 0 1 /end COMPU_METHOD
/begin COMPU_METHOD RatSotSot "" RAT_FUNC "%6.5" "-" COEFFS 0 4000 0 0 0 1 /end COMPU_METHOD
/begin COMPU_METHOD Resist_1 "" RAT_FUNC "%6.2" "mOhm" COEFFS 0 1 0 0 0 1 /end COMPU_METHOD
/begin COMPU_METHOD Res_hPaHrPerCM "" RAT_FUNC "%7.6" "hPa/(m^3/h)" COEFFS 0 10000 0 0 0 1 /end COMPU_METHOD
/begin COMPU_METHOD rhoOilAsh_g_p_l "" RAT_FUNC "%6.3" "g/l" COEFFS 0 10 0 0 0 1 /end COMPU_METHOD
/begin COMPU_METHOD Soot_gPerLtr "" RAT_FUNC "%6.4" "g/l" COEFFS 0 100 0 0 0 1 /end COMPU_METHOD
/begin COMPU_METHOD SotMassPerTime "" RAT_FUNC "%6.4" "mg/s" COEFFS 0 100 0 0 0 1 /end COMPU_METHOD
/begin COMPU_METHOD Temp_Cels "" RAT_FUNC "%6.1" "deg C" COEFFS 0 10 2731.4 0 0 1 /end COMPU_METHOD
/begin COMPU_METHOD TimeDeb "" RAT_FUNC "%6.1" "ms" COEFFS 0 0.1 0 0 0 1 /end COMPU_METHOD
/begin COMPU_METHOD TimeDelay_s "" RAT_FUNC "%12.4" "s" COEFFS 0 0 1 0 0.00023283064365387 0 /end COMPU_METHOD
/begin COMPU_METHOD TimeEngOn "" RAT_FUNC "%6.2" "s" COEFFS 0 1 0 0 0 1 /end COMPU_METHOD
/begin COMPU_METHOD TimeRed "" RAT_FUNC "%6.3" "s" COEFFS 0 6.25 0 0 0 1 /end COMPU_METHOD
/begin COMPU_METHOD Time_Hr "" RAT_FUNC "%6.3" "h" COEFFS 0 2 0 0 0 1 /end COMPU_METHOD
/begin COMPU_METHOD Time_ms "" RAT_FUNC "%6.1" "ms" COEFFS 0 0.1 0 0 0 1 /end COMPU_METHOD
/begin COMPU_METHOD Time_s "" RAT_FUNC "%6.4" "s" COEFFS 0 100 0 0 0 1 /end COMPU_METHOD
/begin COMPU_METHOD Trq "" RAT_FUNC "%6.3" "Nm" COEFFS 0 10 0 0 0 1 /end COMPU_METHOD
/begin COMPU_METHOD Vel "" RAT_FUNC "%6.4" "km/h" COEFFS 0 100 0 0 0 1 /end COMPU_METHOD
/begin COMPU_METHOD Vol "" RAT_FUNC "%6.4" "l" COEFFS 0 100 0 0 0 1 /end COMPU_METHOD
/begin COMPU_METHOD Volt "" RAT_FUNC "%6.3" "mV" COEFFS 0 5 0 0 0 1 /end COMPU_METHOD
/begin COMPU_METHOD Volt_Batt "" RAT_FUNC "%6.1" "mV" COEFFS 0 0.05 0 0 0 1 /end COMPU_METHOD
/begin RECORD_LAYOUT Cur_Xs16Ws16 NO_AXIS_PTS_X 1 SWORD AXIS_PTS_X 2 SWORD INDEX_INCR DIRECT FNC_VALUES 3 SWORD COLUMN_DIR DIRECT /end RECORD_LAYOUT
/begin RECORD_LAYOUT Gkl_Ws16 FNC_VALUES 1 SWORD COLUMN_DIR DIRECT /end RECORD_LAYOUT
/begin RECORD_LAYOUT GSst_Xs16 NO_AXIS_PTS_X 1 SWORD AXIS_PTS_X 2 SWORD INDEX_INCR DIRECT /end RECORD_LAYOUT
/begin RECORD_LAYOUT Kf_Xs16_Ys16_Ws16 NO_AXIS_PTS_X 1 SWORD NO_AXIS_PTS_Y 2 SWORD AXIS_PTS_X 3 SWORD INDEX_INCR DIRECT AXIS_PTS_Y 4 SWORD INDEX_INCR DIRECT FNC_VALUES 5 SWORD COLUMN_DIR DIRECT /end RECORD_LAYOUT
/begin RECORD_LAYOUT Kl_Xs16_Ws16 NO_AXIS_PTS_X 1 SWORD AXIS_PTS_X 2 SWORD INDEX_INCR DIRECT FNC_VALUES 3 SWORD COLUMN_DIR DIRECT /end RECORD_LAYOUT
/begin RECORD_LAYOUT Kwb_Wu32 FNC_VALUES 1 ULONG COLUMN_DIR DIRECT /end RECORD_LAYOUT
/begin RECORD_LAYOUT Kw_Ws16 FNC_VALUES 1 SWORD COLUMN_DIR DIRECT /end RECORD_LAYOUT
/begin RECORD_LAYOUT Kw_Ws32 FNC_VALUES 1 SLONG COLUMN_DIR DIRECT /end RECORD_LAYOUT
/begin RECORD_LAYOUT Kw_Wu16 FNC_VALUES 1 UWORD COLUMN_DIR DIRECT /end RECORD_LAYOUT
/begin RECORD_LAYOUT Kw_Wu32 FNC_VALUES 1 ULONG COLUMN_DIR DIRECT /end RECORD_LAYOUT
/begin RECORD_LAYOUT Kw_Wu8 FNC_VALUES 1 UBYTE COLUMN_DIR DIRECT /end RECORD_LAYOUT
/begin RECORD_LAYOUT Map_Xs16Ys16Ws16 NO_AXIS_PTS_X 1 SWORD NO_AXIS_PTS_Y 2 SWORD AXIS_PTS_X 3 SWORD INDEX_INCR DIRECT AXIS_PTS_Y 4 SWORD INDEX_INCR DIRECT FNC_VALUES 5 SWORD COLUMN_DIR DIRECT /end RECORD_LAYOUT
/begin RECORD_LAYOUT ValA_Ws16 FNC_VALUES 1 SWORD COLUMN_DIR DIRECT /end RECORD_LAYOUT
/begin RECORD_LAYOUT ValA_Ws32 FNC_VALUES 1 SLONG COLUMN_DIR DIRECT /end RECORD_LAYOUT
/begin RECORD_LAYOUT ValA_Wu32 FNC_VALUES 1 ULONG COLUMN_DIR DIRECT /end RECORD_LAYOUT
/begin RECORD_LAYOUT ValA_Wu8 FNC_VALUES 1 UBYTE COLUMN_DIR DIRECT /end RECORD_LAYOUT
/begin RECORD_LAYOUT Val_Ws16 FNC_VALUES 1 SWORD COLUMN_DIR DIRECT /end RECORD_LAYOUT
/begin RECORD_LAYOUT Val_Ws32 FNC_VALUES 1 SLONG COLUMN_DIR DIRECT /end RECORD_LAYOUT
/begin RECORD_LAYOUT Val_Ws8 FNC_VALUES 1 SBYTE COLUMN_DIR DIRECT /end RECORD_LAYOUT
/begin RECORD_LAYOUT Val_Wu16 FNC_VALUES 1 UWORD COLUMN_DIR DIRECT /end RECORD_LAYOUT
/begin RECORD_LAYOUT Val_Wu32 FNC_VALUES 1 ULONG COLUMN_DIR DIRECT /end RECORD_LAYOUT
/begin RECORD_LAYOUT Val_Wu8 FNC_VALUES 1 UBYTE COLUMN_DIR DIRECT /end RECORD_LAYOUT
/end MODULE
/end PROJECT
