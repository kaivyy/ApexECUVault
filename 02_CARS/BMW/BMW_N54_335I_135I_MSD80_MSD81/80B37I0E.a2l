ASAP2_VERSION 1 41
/begin PROJECT MSD70 "Spray Guided DI-System with Piezo Injectors for 6-Cylinder"
/begin HEADER "_default_HeaderComment" PROJECT_NO _0B /end HEADER
/begin MODULE _default_ModuleName "_default_ModuleLongIdentifier"
/begin MOD_COMMON "_default_ModCommonComment" DEPOSIT ABSOLUTE BYTE_ORDER MSB_LAST ALIGNMENT_BYTE 1 ALIGNMENT_WORD 2 ALIGNMENT_LONG 2 ALIGNMENT_FLOAT32_IEEE 2 ALIGNMENT_FLOAT64_IEEE 4 /end MOD_COMMON
/begin MEASUREMENT injr.STR_INJR_REQGNHOMS0.soi_1_homs[0] "Start of the first injection for homogeneous stratified mode" UWORD _CNV_A_R_LINEAR_____168_CM 1 100. 0. 720. DISPLAY_IDENTIFIER SOI_1_HOMS[0] ECU_ADDRESS 0xd0002a50 FORMAT "%7.3" /end MEASUREMENT
/begin MEASUREMENT injr.STR_INJR_REQGNHOMS0.soi_1_homs[1] "Start of the first injection for homogeneous stratified mode" UWORD _CNV_A_R_LINEAR_____168_CM 1 100. 0. 720. DISPLAY_IDENTIFIER SOI_1_HOMS[1] ECU_ADDRESS 0xd0002a52 FORMAT "%7.3" /end MEASUREMENT
/begin MEASUREMENT injr.STR_INJR_REQGNHOMS0.soi_1_homs[2] "Start of the first injection for homogeneous stratified mode" UWORD _CNV_A_R_LINEAR_____168_CM 1 100. 0. 720. DISPLAY_IDENTIFIER SOI_1_HOMS[2] ECU_ADDRESS 0xd0002a54 FORMAT "%7.3" /end MEASUREMENT
/begin MEASUREMENT injr.STR_INJR_REQGNHOMS0.soi_1_homs[3] "Start of the first injection for homogeneous stratified mode" UWORD _CNV_A_R_LINEAR_____168_CM 1 100. 0. 720. DISPLAY_IDENTIFIER SOI_1_HOMS[3] ECU_ADDRESS 0xd0002a56 FORMAT "%7.3" /end MEASUREMENT
/begin MEASUREMENT injr.STR_INJR_REQGNHOMS0.soi_1_homs[4] "Start of the first injection for homogeneous stratified mode" UWORD _CNV_A_R_LINEAR_____168_CM 1 100. 0. 720. DISPLAY_IDENTIFIER SOI_1_HOMS[4] ECU_ADDRESS 0xd0002a58 FORMAT "%7.3" /end MEASUREMENT
/begin MEASUREMENT injr.STR_INJR_REQGNHOMS0.soi_1_homs[5] "Start of the first injection for homogeneous stratified mode" UWORD _CNV_A_R_LINEAR_____168_CM 1 100. 0. 720. DISPLAY_IDENTIFIER SOI_1_HOMS[5] ECU_ADDRESS 0xd0002a5a FORMAT "%7.3" /end MEASUREMENT
/begin MEASUREMENT injr.STR_INJR_REQGNHOMS0.eoi_2_homs[0] "End of the second injection for homogeneous stratified mode" UWORD _CNV_A_R_LINEAR_____168_CM 1 100. 0. 720. DISPLAY_IDENTIFIER EOI_2_HOMS[0] ECU_ADDRESS 0xd0002a5c FORMAT "%7.3" /end MEASUREMENT
/begin MEASUREMENT injr.STR_INJR_REQGNHOMS0.eoi_2_homs[1] "End of the second injection for homogeneous stratified mode" UWORD _CNV_A_R_LINEAR_____168_CM 1 100. 0. 720. DISPLAY_IDENTIFIER EOI_2_HOMS[1] ECU_ADDRESS 0xd0002a5e FORMAT "%7.3" /end MEASUREMENT
/begin MEASUREMENT injr.STR_INJR_REQGNHOMS0.eoi_2_homs[2] "End of the second injection for homogeneous stratified mode" UWORD _CNV_A_R_LINEAR_____168_CM 1 100. 0. 720. DISPLAY_IDENTIFIER EOI_2_HOMS[2] ECU_ADDRESS 0xd0002a60 FORMAT "%7.3" /end MEASUREMENT
/begin MEASUREMENT injr.STR_INJR_REQGNHOMS0.eoi_2_homs[3] "End of the second injection for homogeneous stratified mode" UWORD _CNV_A_R_LINEAR_____168_CM 1 100. 0. 720. DISPLAY_IDENTIFIER EOI_2_HOMS[3] ECU_ADDRESS 0xd0002a62 FORMAT "%7.3" /end MEASUREMENT
/begin MEASUREMENT injr.STR_INJR_REQGNHOMS0.eoi_2_homs[4] "End of the second injection for homogeneous stratified mode" UWORD _CNV_A_R_LINEAR_____168_CM 1 100. 0. 720. DISPLAY_IDENTIFIER EOI_2_HOMS[4] ECU_ADDRESS 0xd0002a64 FORMAT "%7.3" /end MEASUREMENT
/begin MEASUREMENT injr.STR_INJR_REQGNHOMS0.eoi_2_homs[5] "End of the second injection for homogeneous stratified mode" UWORD _CNV_A_R_LINEAR_____168_CM 1 100. 0. 720. DISPLAY_IDENTIFIER EOI_2_HOMS[5] ECU_ADDRESS 0xd0002a66 FORMAT "%7.3" /end MEASUREMENT
/begin MEASUREMENT fmy_stat_imob_1.err_info_stat.lv_err_mem "Failure is stored in dynamic memory (2nd layer)" UWORD _CNV_S_2_RANGE__0___1_CM 1 100. 0. 1. DISPLAY_IDENTIFIER LV_ERR_MEM_IMOB_1 ECU_ADDRESS 0xd000439a BIT_MASK 0x8 /end MEASUREMENT
/begin MEASUREMENT fmy_stat_imob_1.err_info_stat.lv_ready "Readiness flag related to diagnosis XX" UWORD _CNV_S_2_RANGE__0___1_CM 1 100. 0. 1. DISPLAY_IDENTIFIER LV_READY_IMOB_1 ECU_ADDRESS 0xd000439a BIT_MASK 0x10 /end MEASUREMENT
/begin MEASUREMENT fmy_stat_imob_1.err_info_stat.lv_end_diag "End of diagnosis XX" UWORD _CNV_S_2_RANGE__0___1_CM 1 100. 0. 1. DISPLAY_IDENTIFIER LV_END_DIAG_IMOB_1 ECU_ADDRESS 0xd000439a BIT_MASK 0x20 /end MEASUREMENT
/begin MEASUREMENT fmy_stat_imob_1.err_info_stat.lv_cdn_diag "Diagnosis condition to start symptom detection (set to 1 when condition is fulfilled)" UWORD _CNV_S_2_RANGE__0___1_CM 1 100. 0. 1. DISPLAY_IDENTIFIER LV_CDN_DIAG_IMOB_1 ECU_ADDRESS 0xd000439a BIT_MASK 0x40 /end MEASUREMENT
/begin MEASUREMENT fmy_stat_imob_1.err_info_stat.err_sym "For each symptom: status of failure (set to 1 when failure symptom is detected)" UWORD _CNV_S_16_RANGE_ERR__485_CM 1 100. 0. 15. DISPLAY_IDENTIFIER ERR_SYM_IMOB_1 ECU_ADDRESS 0xd000439a BIT_MASK 0x780 /end MEASUREMENT
/begin MEASUREMENT fmy_stat_imob_2.err_info_stat.lv_err_mem "Failure is stored in dynamic memory (2nd layer)" UWORD _CNV_S_2_RANGE__0___1_CM 1 100. 0. 1. DISPLAY_IDENTIFIER LV_ERR_MEM_IMOB_2 ECU_ADDRESS 0xd000439e BIT_MASK 0x8 /end MEASUREMENT
/begin MEASUREMENT fmy_stat_imob_2.err_info_stat.lv_ready "Readiness flag related to diagnosis XX" UWORD _CNV_S_2_RANGE__0___1_CM 1 100. 0. 1. DISPLAY_IDENTIFIER LV_READY_IMOB_2 ECU_ADDRESS 0xd000439e BIT_MASK 0x10 /end MEASUREMENT
/begin MEASUREMENT fmy_stat_imob_2.err_info_stat.lv_end_diag "End of diagnosis XX" UWORD _CNV_S_2_RANGE__0___1_CM 1 100. 0. 1. DISPLAY_IDENTIFIER LV_END_DIAG_IMOB_2 ECU_ADDRESS 0xd000439e BIT_MASK 0x20 /end MEASUREMENT
/begin MEASUREMENT fmy_stat_imob_2.err_info_stat.lv_cdn_diag "Diagnosis condition to start symptom detection (set to 1 when condition is fulfilled)" UWORD _CNV_S_2_RANGE__0___1_CM 1 100. 0. 1. DISPLAY_IDENTIFIER LV_CDN_DIAG_IMOB_2 ECU_ADDRESS 0xd000439e BIT_MASK 0x40 /end MEASUREMENT
/begin MEASUREMENT fmy_stat_imob_2.err_info_stat.err_sym "For each symptom: status of failure (set to 1 when failure symptom is detected)" UWORD _CNV_S_16_RANGE_ERR__485_CM 1 100. 0. 15. DISPLAY_IDENTIFIER ERR_SYM_IMOB_2 ECU_ADDRESS 0xd000439e BIT_MASK 0x780 /end MEASUREMENT
/begin MEASUREMENT fmy_stat_imob_3.err_info_stat.lv_err_mem "Failure is stored in dynamic memory (2nd layer)" UWORD _CNV_S_2_RANGE__0___1_CM 1 100. 0. 1. DISPLAY_IDENTIFIER LV_ERR_MEM_IMOB_3 ECU_ADDRESS 0xd00043a2 BIT_MASK 0x8 /end MEASUREMENT
/begin MEASUREMENT fmy_stat_imob_3.err_info_stat.lv_ready "Readiness flag related to diagnosis XX" UWORD _CNV_S_2_RANGE__0___1_CM 1 100. 0. 1. DISPLAY_IDENTIFIER LV_READY_IMOB_3 ECU_ADDRESS 0xd00043a2 BIT_MASK 0x10 /end MEASUREMENT
/begin MEASUREMENT fmy_stat_imob_3.err_info_stat.lv_end_diag "End of diagnosis XX" UWORD _CNV_S_2_RANGE__0___1_CM 1 100. 0. 1. DISPLAY_IDENTIFIER LV_END_DIAG_IMOB_3 ECU_ADDRESS 0xd00043a2 BIT_MASK 0x20 /end MEASUREMENT
/begin MEASUREMENT fmy_stat_imob_3.err_info_stat.lv_cdn_diag "Diagnosis condition to start symptom detection (set to 1 when condition is fulfilled)" UWORD _CNV_S_2_RANGE__0___1_CM 1 100. 0. 1. DISPLAY_IDENTIFIER LV_CDN_DIAG_IMOB_3 ECU_ADDRESS 0xd00043a2 BIT_MASK 0x40 /end MEASUREMENT
/begin MEASUREMENT fmy_stat_imob_3.err_info_stat.err_sym "For each symptom: status of failure (set to 1 when failure symptom is detected)" UWORD _CNV_S_16_RANGE_ERR__485_CM 1 100. 0. 15. DISPLAY_IDENTIFIER ERR_SYM_IMOB_3 ECU_ADDRESS 0xd00043a2 BIT_MASK 0x780 /end MEASUREMENT
/begin MEASUREMENT fmy_stat_tco_el.ctr_abc "anti-bounce counter for diagnosis XX" UBYTE _CNV_A_R_LINEAR_____0_CM 1 100. 0. 255. DISPLAY_IDENTIFIER CTR_ABC_TCO_EL ECU_ADDRESS 0xd0004588 FORMAT "%3.0" /end MEASUREMENT
/begin MEASUREMENT fmy_stat_tco_el.ctr_end_diag "Counter for the end of diagnosis XX generation" UBYTE _CNV_A_R_LINEAR_____0_CM 1 100. 0. 255. DISPLAY_IDENTIFIER CTR_ABC_END_DIAG_TCO_EL ECU_ADDRESS 0xd0004589 FORMAT "%3.0" /end MEASUREMENT
/begin MEASUREMENT fmy_stat_tco_el.err_info_stat.lv_err_mem "Failure is stored in dynamic memory (2nd layer)" UWORD _CNV_S_2_RANGE__0___1_CM 1 100. 0. 1. DISPLAY_IDENTIFIER LV_ERR_MEM_TCO_EL ECU_ADDRESS 0xd000458a BIT_MASK 0x8 /end MEASUREMENT
/begin MEASUREMENT fmy_stat_tco_el.err_info_stat.lv_ready "Readiness flag related to diagnosis XX" UWORD _CNV_S_2_RANGE__0___1_CM 1 100. 0. 1. DISPLAY_IDENTIFIER LV_READY_TCO_EL ECU_ADDRESS 0xd000458a BIT_MASK 0x10 /end MEASUREMENT
/begin MEASUREMENT fmy_stat_tco_el.err_info_stat.lv_end_diag "End of diagnosis XX" UWORD _CNV_S_2_RANGE__0___1_CM 1 100. 0. 1. DISPLAY_IDENTIFIER LV_END_DIAG_TCO_EL ECU_ADDRESS 0xd000458a BIT_MASK 0x20 /end MEASUREMENT
/begin MEASUREMENT fmy_stat_tco_el.err_info_stat.lv_cdn_diag "Diagnosis condition to start symptom detection (set to 1 when condition is fulfilled)" UWORD _CNV_S_2_RANGE__0___1_CM 1 100. 0. 1. DISPLAY_IDENTIFIER LV_CDN_DIAG_TCO_EL ECU_ADDRESS 0xd000458a BIT_MASK 0x40 /end MEASUREMENT
/begin MEASUREMENT fmy_stat_tco_el.err_info_stat.err_sym "For each symptom: status of failure (set to 1 when failure symptom is detected)" UWORD _CNV_S_16_RANGE_ERR__485_CM 1 100. 0. 15. DISPLAY_IDENTIFIER ERR_SYM_TCO_EL ECU_ADDRESS 0xd000458a BIT_MASK 0x780 /end MEASUREMENT
/begin MEASUREMENT fmy_stat_tco_grd.ctr_abc "anti-bounce counter for diagnosis XX" UBYTE _CNV_A_R_LINEAR_____0_CM 1 100. 0. 255. DISPLAY_IDENTIFIER CTR_ABC_TCO_GRD ECU_ADDRESS 0xd000458c FORMAT "%3.0" /end MEASUREMENT
/begin MEASUREMENT fmy_stat_tco_grd.ctr_end_diag "Counter for the end of diagnosis XX generation" UBYTE _CNV_A_R_LINEAR_____0_CM 1 100. 0. 255. DISPLAY_IDENTIFIER CTR_ABC_END_DIAG_TCO_GRD ECU_ADDRESS 0xd000458d FORMAT "%3.0" /end MEASUREMENT
/begin MEASUREMENT fmy_stat_tco_grd.err_info_stat.lv_err_mem "Failure is stored in dynamic memory (2nd layer)" UWORD _CNV_S_2_RANGE__0___1_CM 1 100. 0. 1. DISPLAY_IDENTIFIER LV_ERR_MEM_TCO_GRD ECU_ADDRESS 0xd000458e BIT_MASK 0x8 /end MEASUREMENT
/begin MEASUREMENT fmy_stat_tco_grd.err_info_stat.lv_ready "Readiness flag related to diagnosis XX" UWORD _CNV_S_2_RANGE__0___1_CM 1 100. 0. 1. DISPLAY_IDENTIFIER LV_READY_TCO_GRD ECU_ADDRESS 0xd000458e BIT_MASK 0x10 /end MEASUREMENT
/begin MEASUREMENT fmy_stat_tco_grd.err_info_stat.lv_end_diag "End of diagnosis XX" UWORD _CNV_S_2_RANGE__0___1_CM 1 100. 0. 1. DISPLAY_IDENTIFIER LV_END_DIAG_TCO_GRD ECU_ADDRESS 0xd000458e BIT_MASK 0x20 /end MEASUREMENT
/begin MEASUREMENT fmy_stat_tco_grd.err_info_stat.lv_cdn_diag "Diagnosis condition to start symptom detection (set to 1 when condition is fulfilled)" UWORD _CNV_S_2_RANGE__0___1_CM 1 100. 0. 1. DISPLAY_IDENTIFIER LV_CDN_DIAG_TCO_GRD ECU_ADDRESS 0xd000458e BIT_MASK 0x40 /end MEASUREMENT
/begin MEASUREMENT fmy_stat_tco_grd.err_info_stat.err_sym "For each symptom: status of failure (set to 1 when failure symptom is detected)" UWORD _CNV_S_16_RANGE_ERR__485_CM 1 100. 0. 15. DISPLAY_IDENTIFIER ERR_SYM_TCO_GRD ECU_ADDRESS 0xd000458e BIT_MASK 0x780 /end MEASUREMENT
/begin MEASUREMENT fmy_stat_tco_stuck.ctr_abc "anti-bounce counter for diagnosis XX" UBYTE _CNV_A_R_LINEAR_____0_CM 1 100. 0. 255. DISPLAY_IDENTIFIER CTR_ABC_TCO_STUCK ECU_ADDRESS 0xd0004594 FORMAT "%3.0" /end MEASUREMENT
/begin MEASUREMENT fmy_stat_tco_stuck.ctr_end_diag "Counter for the end of diagnosis XX generation" UBYTE _CNV_A_R_LINEAR_____0_CM 1 100. 0. 255. DISPLAY_IDENTIFIER CTR_ABC_END_DIAG_TCO_STUCK ECU_ADDRESS 0xd0004595 FORMAT "%3.0" /end MEASUREMENT
/begin MEASUREMENT fmy_stat_tco_stuck.err_info_stat.lv_err_mem "Failure is stored in dynamic memory (2nd layer)" UWORD _CNV_S_2_RANGE__0___1_CM 1 100. 0. 1. DISPLAY_IDENTIFIER LV_ERR_MEM_TCO_STUCK ECU_ADDRESS 0xd0004596 BIT_MASK 0x8 /end MEASUREMENT
/begin MEASUREMENT fmy_stat_tco_stuck.err_info_stat.lv_ready "Readiness flag related to diagnosis XX" UWORD _CNV_S_2_RANGE__0___1_CM 1 100. 0. 1. DISPLAY_IDENTIFIER LV_READY_TCO_STUCK ECU_ADDRESS 0xd0004596 BIT_MASK 0x10 /end MEASUREMENT
/begin MEASUREMENT fmy_stat_tco_stuck.err_info_stat.lv_end_diag "End of diagnosis XX" UWORD _CNV_S_2_RANGE__0___1_CM 1 100. 0. 1. DISPLAY_IDENTIFIER LV_END_DIAG_TCO_STUCK ECU_ADDRESS 0xd0004596 BIT_MASK 0x20 /end MEASUREMENT
/begin MEASUREMENT fmy_stat_tco_stuck.err_info_stat.lv_cdn_diag "Diagnosis condition to start symptom detection (set to 1 when condition is fulfilled)" UWORD _CNV_S_2_RANGE__0___1_CM 1 100. 0. 1. DISPLAY_IDENTIFIER LV_CDN_DIAG_TCO_STUCK ECU_ADDRESS 0xd0004596 BIT_MASK 0x40 /end MEASUREMENT
/begin MEASUREMENT fmy_stat_tco_stuck.err_info_stat.err_sym "For each symptom: status of failure (set to 1 when failure symptom is detected)" UWORD _CNV_S_16_RANGE_ERR__485_CM 1 100. 0. 15. DISPLAY_IDENTIFIER ERR_SYM_TCO_STUCK ECU_ADDRESS 0xd0004596 BIT_MASK 0x780 /end MEASUREMENT
/begin MEASUREMENT fmy_stat_tco_plaus.ctr_abc "anti-bounce counter for diagnosis XX" UBYTE _CNV_A_R_LINEAR_____0_CM 1 100. 0. 255. DISPLAY_IDENTIFIER CTR_ABC_TCO_PLAUS ECU_ADDRESS 0xd0004590 FORMAT "%3.0" /end MEASUREMENT
/begin MEASUREMENT fmy_stat_tco_plaus.ctr_end_diag "Counter for the end of diagnosis XX generation" UBYTE _CNV_A_R_LINEAR_____0_CM 1 100. 0. 255. DISPLAY_IDENTIFIER CTR_ABC_END_DIAG_TCO_PLAUS ECU_ADDRESS 0xd0004591 FORMAT "%3.0" /end MEASUREMENT
/begin MEASUREMENT fmy_stat_tco_plaus.err_info_stat.lv_err_mem "Failure is stored in dynamic memory (2nd layer)" UWORD _CNV_S_2_RANGE__0___1_CM 1 100. 0. 1. DISPLAY_IDENTIFIER LV_ERR_MEM_TCO_PLAUS ECU_ADDRESS 0xd0004592 BIT_MASK 0x8 /end MEASUREMENT
/begin MEASUREMENT fmy_stat_tco_plaus.err_info_stat.lv_ready "Readiness flag related to diagnosis XX" UWORD _CNV_S_2_RANGE__0___1_CM 1 100. 0. 1. DISPLAY_IDENTIFIER LV_READY_TCO_PLAUS ECU_ADDRESS 0xd0004592 BIT_MASK 0x10 /end MEASUREMENT
/begin MEASUREMENT fmy_stat_tco_plaus.err_info_stat.lv_end_diag "End of diagnosis XX" UWORD _CNV_S_2_RANGE__0___1_CM 1 100. 0. 1. DISPLAY_IDENTIFIER LV_END_DIAG_TCO_PLAUS ECU_ADDRESS 0xd0004592 BIT_MASK 0x20 /end MEASUREMENT
/begin MEASUREMENT fmy_stat_tco_plaus.err_info_stat.lv_cdn_diag "Diagnosis condition to start symptom detection (set to 1 when condition is fulfilled)" UWORD _CNV_S_2_RANGE__0___1_CM 1 100. 0. 1. DISPLAY_IDENTIFIER LV_CDN_DIAG_TCO_PLAUS ECU_ADDRESS 0xd0004592 BIT_MASK 0x40 /end MEASUREMENT
/begin MEASUREMENT fmy_stat_tco_plaus.err_info_stat.err_sym "For each symptom: status of failure (set to 1 when failure symptom is detected)" UWORD _CNV_S_16_RANGE_ERR__485_CM 1 100. 0. 15. DISPLAY_IDENTIFIER ERR_SYM_TCO_PLAUS ECU_ADDRESS 0xd0004592 BIT_MASK 0x780 /end MEASUREMENT
/begin MEASUREMENT fmy_stat_tco_2_el.ctr_abc "anti-bounce counter for diagnosis XX" UBYTE _CNV_A_R_LINEAR_____0_CM 1 100. 0. 255. DISPLAY_IDENTIFIER CTR_ABC_TCO_2_EL ECU_ADDRESS 0xd000457c FORMAT "%3.0" /end MEASUREMENT
/begin MEASUREMENT fmy_stat_tco_2_el.ctr_end_diag "Counter for the end of diagnosis XX generation" UBYTE _CNV_A_R_LINEAR_____0_CM 1 100. 0. 255. DISPLAY_IDENTIFIER CTR_ABC_END_DIAG_TCO_2_EL ECU_ADDRESS 0xd000457d FORMAT "%3.0" /end MEASUREMENT
/begin MEASUREMENT fmy_stat_tco_2_el.err_info_stat.lv_err_mem "Failure is stored in dynamic memory (2nd layer)" UWORD _CNV_S_2_RANGE__0___1_CM 1 100. 0. 1. DISPLAY_IDENTIFIER LV_ERR_MEM_TCO_2_EL ECU_ADDRESS 0xd000457e BIT_MASK 0x8 /end MEASUREMENT
/begin MEASUREMENT fmy_stat_tco_2_el.err_info_stat.lv_ready "Readiness flag related to diagnosis XX" UWORD _CNV_S_2_RANGE__0___1_CM 1 100. 0. 1. DISPLAY_IDENTIFIER LV_READY_TCO_2_EL ECU_ADDRESS 0xd000457e BIT_MASK 0x10 /end MEASUREMENT
/begin MEASUREMENT fmy_stat_tco_2_el.err_info_stat.lv_end_diag "End of diagnosis XX" UWORD _CNV_S_2_RANGE__0___1_CM 1 100. 0. 1. DISPLAY_IDENTIFIER LV_END_DIAG_TCO_2_EL ECU_ADDRESS 0xd000457e BIT_MASK 0x20 /end MEASUREMENT
/begin MEASUREMENT fmy_stat_tco_2_el.err_info_stat.lv_cdn_diag "Diagnosis condition to start symptom detection (set to 1 when condition is fulfilled)" UWORD _CNV_S_2_RANGE__0___1_CM 1 100. 0. 1. DISPLAY_IDENTIFIER LV_CDN_DIAG_TCO_2_EL ECU_ADDRESS 0xd000457e BIT_MASK 0x40 /end MEASUREMENT
/begin MEASUREMENT fmy_stat_tco_2_el.err_info_stat.err_sym "For each symptom: status of failure (set to 1 when failure symptom is detected)" UWORD _CNV_S_16_RANGE_ERR__485_CM 1 100. 0. 15. DISPLAY_IDENTIFIER ERR_SYM_TCO_2_EL ECU_ADDRESS 0xd000457e BIT_MASK 0x780 /end MEASUREMENT
/begin MEASUREMENT fmy_stat_tco_2_grd.ctr_abc "anti-bounce counter for diagnosis XX" UBYTE _CNV_A_R_LINEAR_____0_CM 1 100. 0. 255. DISPLAY_IDENTIFIER CTR_ABC_TCO_2_GRD ECU_ADDRESS 0xd0004580 FORMAT "%3.0" /end MEASUREMENT
/begin MEASUREMENT fmy_stat_tco_2_grd.ctr_end_diag "Counter for the end of diagnosis XX generation" UBYTE _CNV_A_R_LINEAR_____0_CM 1 100. 0. 255. DISPLAY_IDENTIFIER CTR_ABC_END_DIAG_TCO_2_GRD ECU_ADDRESS 0xd0004581 FORMAT "%3.0" /end MEASUREMENT
/begin MEASUREMENT fmy_stat_tco_2_grd.err_info_stat.lv_err_mem "Failure is stored in dynamic memory (2nd layer)" UWORD _CNV_S_2_RANGE__0___1_CM 1 100. 0. 1. DISPLAY_IDENTIFIER LV_ERR_MEM_TCO_2_GRD ECU_ADDRESS 0xd0004582 BIT_MASK 0x8 /end MEASUREMENT
/begin MEASUREMENT fmy_stat_tco_2_grd.err_info_stat.lv_ready "Readiness flag related to diagnosis XX" UWORD _CNV_S_2_RANGE__0___1_CM 1 100. 0. 1. DISPLAY_IDENTIFIER LV_READY_TCO_2_GRD ECU_ADDRESS 0xd0004582 BIT_MASK 0x10 /end MEASUREMENT
/begin MEASUREMENT fmy_stat_tco_2_grd.err_info_stat.lv_end_diag "End of diagnosis XX" UWORD _CNV_S_2_RANGE__0___1_CM 1 100. 0. 1. DISPLAY_IDENTIFIER LV_END_DIAG_TCO_2_GRD ECU_ADDRESS 0xd0004582 BIT_MASK 0x20 /end MEASUREMENT
/begin MEASUREMENT fmy_stat_tco_2_grd.err_info_stat.lv_cdn_diag "Diagnosis condition to start symptom detection (set to 1 when condition is fulfilled)" UWORD _CNV_S_2_RANGE__0___1_CM 1 100. 0. 1. DISPLAY_IDENTIFIER LV_CDN_DIAG_TCO_2_GRD ECU_ADDRESS 0xd0004582 BIT_MASK 0x40 /end MEASUREMENT
/begin MEASUREMENT fmy_stat_tco_2_grd.err_info_stat.err_sym "For each symptom: status of failure (set to 1 when failure symptom is detected)" UWORD _CNV_S_16_RANGE_ERR__485_CM 1 100. 0. 15. DISPLAY_IDENTIFIER ERR_SYM_TCO_2_GRD ECU_ADDRESS 0xd0004582 BIT_MASK 0x780 /end MEASUREMENT
/begin MEASUREMENT fmy_stat_tco_2_plaus.ctr_abc "anti-bounce counter for diagnosis XX" UBYTE _CNV_A_R_LINEAR_____0_CM 1 100. 0. 255. DISPLAY_IDENTIFIER CTR_ABC_TCO_2_PLAUS ECU_ADDRESS 0xd0004584 FORMAT "%3.0" /end MEASUREMENT
/begin MEASUREMENT fmy_stat_tco_2_plaus.ctr_end_diag "Counter for the end of diagnosis XX generation" UBYTE _CNV_A_R_LINEAR_____0_CM 1 100. 0. 255. DISPLAY_IDENTIFIER CTR_ABC_END_DIAG_TCO_2_PLAUS ECU_ADDRESS 0xd0004585 FORMAT "%3.0" /end MEASUREMENT
/begin MEASUREMENT fmy_stat_tco_2_plaus.err_info_stat.lv_err_mem "Failure is stored in dynamic memory (2nd layer)" UWORD _CNV_S_2_RANGE__0___1_CM 1 100. 0. 1. DISPLAY_IDENTIFIER LV_ERR_MEM_TCO_2_PLAUS ECU_ADDRESS 0xd0004586 BIT_MASK 0x8 /end MEASUREMENT
/begin MEASUREMENT fmy_stat_tco_2_plaus.err_info_stat.lv_ready "Readiness flag related to diagnosis XX" UWORD _CNV_S_2_RANGE__0___1_CM 1 100. 0. 1. DISPLAY_IDENTIFIER LV_READY_TCO_2_PLAUS ECU_ADDRESS 0xd0004586 BIT_MASK 0x10 /end MEASUREMENT
/begin MEASUREMENT fmy_stat_tco_2_plaus.err_info_stat.lv_end_diag "End of diagnosis XX" UWORD _CNV_S_2_RANGE__0___1_CM 1 100. 0. 1. DISPLAY_IDENTIFIER LV_END_DIAG_TCO_2_PLAUS ECU_ADDRESS 0xd0004586 BIT_MASK 0x20 /end MEASUREMENT
/begin MEASUREMENT fmy_stat_tco_2_plaus.err_info_stat.lv_cdn_diag "Diagnosis condition to start symptom detection (set to 1 when condition is fulfilled)" UWORD _CNV_S_2_RANGE__0___1_CM 1 100. 0. 1. DISPLAY_IDENTIFIER LV_CDN_DIAG_TCO_2_PLAUS ECU_ADDRESS 0xd0004586 BIT_MASK 0x40 /end MEASUREMENT
/begin MEASUREMENT fmy_stat_tco_2_plaus.err_info_stat.err_sym "For each symptom: status of failure (set to 1 when failure symptom is detected)" UWORD _CNV_S_16_RANGE_ERR__485_CM 1 100. 0. 15. DISPLAY_IDENTIFIER ERR_SYM_TCO_2_PLAUS ECU_ADDRESS 0xd0004586 BIT_MASK 0x780 /end MEASUREMENT
/begin MEASUREMENT fmy_stat_ect_el.ctr_abc "anti-bounce counter for diagnosis XX" UBYTE _CNV_A_R_LINEAR_____0_CM 1 100. 0. 255. DISPLAY_IDENTIFIER CTR_ABC_ECT_EL ECU_ADDRESS 0xd00042e0 FORMAT "%3.0" /end MEASUREMENT
/begin MEASUREMENT fmy_stat_ect_el.ctr_end_diag "Counter for the end of diagnosis XX generation" UBYTE _CNV_A_R_LINEAR_____0_CM 1 100. 0. 255. DISPLAY_IDENTIFIER CTR_ABC_END_DIAG_ECT_EL ECU_ADDRESS 0xd00042e1 FORMAT "%3.0" /end MEASUREMENT
/begin MEASUREMENT fmy_stat_ect_el.err_info_stat.lv_err_mem "Failure is stored in dynamic memory (2nd layer)" UWORD _CNV_S_2_RANGE__0___1_CM 1 100. 0. 1. DISPLAY_IDENTIFIER LV_ERR_MEM_ECT_EL ECU_ADDRESS 0xd00042e2 BIT_MASK 0x8 /end MEASUREMENT
/begin MEASUREMENT fmy_stat_ect_el.err_info_stat.lv_ready "Readiness flag related to diagnosis XX" UWORD _CNV_S_2_RANGE__0___1_CM 1 100. 0. 1. DISPLAY_IDENTIFIER LV_READY_ECT_EL ECU_ADDRESS 0xd00042e2 BIT_MASK 0x10 /end MEASUREMENT
/begin MEASUREMENT fmy_stat_ect_el.err_info_stat.lv_end_diag "End of diagnosis XX" UWORD _CNV_S_2_RANGE__0___1_CM 1 100. 0. 1. DISPLAY_IDENTIFIER LV_END_DIAG_ECT_EL ECU_ADDRESS 0xd00042e2 BIT_MASK 0x20 /end MEASUREMENT
/begin MEASUREMENT fmy_stat_ect_el.err_info_stat.lv_cdn_diag "Diagnosis condition to start symptom detection (set to 1 when condition is fulfilled)" UWORD _CNV_S_2_RANGE__0___1_CM 1 100. 0. 1. DISPLAY_IDENTIFIER LV_CDN_DIAG_ECT_EL ECU_ADDRESS 0xd00042e2 BIT_MASK 0x40 /end MEASUREMENT
/begin MEASUREMENT fmy_stat_ect_el.err_info_stat.err_sym "For each symptom: status of failure (set to 1 when failure symptom is detected)" UWORD _CNV_S_16_RANGE_ERR__485_CM 1 100. 0. 15. DISPLAY_IDENTIFIER ERR_SYM_ECT_EL ECU_ADDRESS 0xd00042e2 BIT_MASK 0x780 /end MEASUREMENT
/begin MEASUREMENT fmy_stat_ecf_el_1.ctr_abc "anti-bounce counter for diagnosis XX" UBYTE _CNV_A_R_LINEAR_____0_CM 1 100. 0. 255. DISPLAY_IDENTIFIER CTR_ABC_ECF_EL_1 ECU_ADDRESS 0xd00042d0 FORMAT "%3.0" /end MEASUREMENT
/begin MEASUREMENT fmy_stat_ecf_el_1.ctr_end_diag "Counter for the end of diagnosis XX generation" UBYTE _CNV_A_R_LINEAR_____0_CM 1 100. 0. 255. DISPLAY_IDENTIFIER CTR_ABC_END_DIAG_ECF_EL_1 ECU_ADDRESS 0xd00042d1 FORMAT "%3.0" /end MEASUREMENT
/begin MEASUREMENT fmy_stat_ecf_el_1.err_info_stat.lv_err_mem "Failure is stored in dynamic memory (2nd layer)" UWORD _CNV_S_2_RANGE__0___1_CM 1 100. 0. 1. DISPLAY_IDENTIFIER LV_ERR_MEM_ECF_EL_1 ECU_ADDRESS 0xd00042d2 BIT_MASK 0x8 /end MEASUREMENT
/begin MEASUREMENT fmy_stat_ecf_el_1.err_info_stat.lv_ready "Readiness flag related to diagnosis XX" UWORD _CNV_S_2_RANGE__0___1_CM 1 100. 0. 1. DISPLAY_IDENTIFIER LV_READY_ECF_EL_1 ECU_ADDRESS 0xd00042d2 BIT_MASK 0x10 /end MEASUREMENT
/begin MEASUREMENT fmy_stat_ecf_el_1.err_info_stat.lv_end_diag "End of diagnosis XX" UWORD _CNV_S_2_RANGE__0___1_CM 1 100. 0. 1. DISPLAY_IDENTIFIER LV_END_DIAG_ECF_EL_1 ECU_ADDRESS 0xd00042d2 BIT_MASK 0x20 /end MEASUREMENT
/begin MEASUREMENT fmy_stat_ecf_el_1.err_info_stat.lv_cdn_diag "Diagnosis condition to start symptom detection (set to 1 when condition is fulfilled)" UWORD _CNV_S_2_RANGE__0___1_CM 1 100. 0. 1. DISPLAY_IDENTIFIER LV_CDN_DIAG_ECF_EL_1 ECU_ADDRESS 0xd00042d2 BIT_MASK 0x40 /end MEASUREMENT
/begin MEASUREMENT fmy_stat_ecf_el_1.err_info_stat.err_sym "For each symptom: status of failure (set to 1 when failure symptom is detected)" UWORD _CNV_S_16_RANGE_ERR__485_CM 1 100. 0. 15. DISPLAY_IDENTIFIER ERR_SYM_ECF_EL_1 ECU_ADDRESS 0xd00042d2 BIT_MASK 0x780 /end MEASUREMENT
/begin MEASUREMENT fmy_stat_ecfpwm_fb_1.ctr_abc "anti-bounce counter for diagnosis XX" UBYTE _CNV_A_R_LINEAR_____0_CM 1 100. 0. 255. DISPLAY_IDENTIFIER CTR_ABC_ECFPWM_FB_1 ECU_ADDRESS 0xd00042d4 FORMAT "%3.0" /end MEASUREMENT
/begin MEASUREMENT fmy_stat_ecfpwm_fb_1.ctr_end_diag "Counter for the end of diagnosis XX generation" UBYTE _CNV_A_R_LINEAR_____0_CM 1 100. 0. 255. DISPLAY_IDENTIFIER CTR_ABC_END_DIAG_ECFPWM_FB_1 ECU_ADDRESS 0xd00042d5 FORMAT "%3.0" /end MEASUREMENT
/begin MEASUREMENT fmy_stat_ecfpwm_fb_1.err_info_stat.lv_err_mem "Failure is stored in dynamic memory (2nd layer)" UWORD _CNV_S_2_RANGE__0___1_CM 1 100. 0. 1. DISPLAY_IDENTIFIER LV_ERR_MEM_ECFPWM_FB_1 ECU_ADDRESS 0xd00042d6 BIT_MASK 0x8 /end MEASUREMENT
/begin MEASUREMENT fmy_stat_ecfpwm_fb_1.err_info_stat.lv_ready "Readiness flag related to diagnosis XX" UWORD _CNV_S_2_RANGE__0___1_CM 1 100. 0. 1. DISPLAY_IDENTIFIER LV_READY_ECFPWM_FB_1 ECU_ADDRESS 0xd00042d6 BIT_MASK 0x10 /end MEASUREMENT
/begin MEASUREMENT fmy_stat_ecfpwm_fb_1.err_info_stat.lv_end_diag "End of diagnosis XX" UWORD _CNV_S_2_RANGE__0___1_CM 1 100. 0. 1. DISPLAY_IDENTIFIER LV_END_DIAG_ECFPWM_FB_1 ECU_ADDRESS 0xd00042d6 BIT_MASK 0x20 /end MEASUREMENT
/begin MEASUREMENT fmy_stat_ecfpwm_fb_1.err_info_stat.lv_cdn_diag "Diagnosis condition to start symptom detection (set to 1 when condition is fulfilled)" UWORD _CNV_S_2_RANGE__0___1_CM 1 100. 0. 1. DISPLAY_IDENTIFIER LV_CDN_DIAG_ECFPWM_FB_1 ECU_ADDRESS 0xd00042d6 BIT_MASK 0x40 /end MEASUREMENT
/begin MEASUREMENT fmy_stat_ecfpwm_fb_1.err_info_stat.err_sym "For each symptom: status of failure (set to 1 when failure symptom is detected)" UWORD _CNV_S_16_RANGE_ERR__485_CM 1 100. 0. 15. DISPLAY_IDENTIFIER ERR_SYM_ECFPWM_FB_1 ECU_ADDRESS 0xd00042d6 BIT_MASK 0x780 /end MEASUREMENT
/begin MEASUREMENT fmy_stat_th.ctr_abc "anti-bounce counter for diagnosis XX" UBYTE _CNV_A_R_LINEAR_____0_CM 1 100. 0. 255. DISPLAY_IDENTIFIER CTR_ABC_TH ECU_ADDRESS 0xd00045a4 FORMAT "%3.0" /end MEASUREMENT
/begin MEASUREMENT fmy_stat_th.ctr_end_diag "Counter for the end of diagnosis XX generation" UBYTE _CNV_A_R_LINEAR_____0_CM 1 100. 0. 255. DISPLAY_IDENTIFIER CTR_ABC_END_DIAG_TH ECU_ADDRESS 0xd00045a5 FORMAT "%3.0" /end MEASUREMENT
/begin MEASUREMENT fmy_stat_th.err_info_stat.lv_err_mem "Failure is stored in dynamic memory (2nd layer)" UWORD _CNV_S_2_RANGE__0___1_CM 1 100. 0. 1. DISPLAY_IDENTIFIER LV_ERR_MEM_TH ECU_ADDRESS 0xd00045a6 BIT_MASK 0x8 /end MEASUREMENT
/begin MEASUREMENT fmy_stat_th.err_info_stat.lv_ready "Readiness flag related to diagnosis XX" UWORD _CNV_S_2_RANGE__0___1_CM 1 100. 0. 1. DISPLAY_IDENTIFIER LV_READY_TH ECU_ADDRESS 0xd00045a6 BIT_MASK 0x10 /end MEASUREMENT
/begin MEASUREMENT fmy_stat_th.err_info_stat.lv_end_diag "End of diagnosis XX" UWORD _CNV_S_2_RANGE__0___1_CM 1 100. 0. 1. DISPLAY_IDENTIFIER LV_END_DIAG_TH ECU_ADDRESS 0xd00045a6 BIT_MASK 0x20 /end MEASUREMENT
/begin MEASUREMENT fmy_stat_th.err_info_stat.lv_cdn_diag "Diagnosis condition to start symptom detection (set to 1 when condition is fulfilled)" UWORD _CNV_S_2_RANGE__0___1_CM 1 100. 0. 1. DISPLAY_IDENTIFIER LV_CDN_DIAG_TH ECU_ADDRESS 0xd00045a6 BIT_MASK 0x40 /end MEASUREMENT
/begin MEASUREMENT fmy_stat_th.err_info_stat.err_sym "For each symptom: status of failure (set to 1 when failure symptom is detected)" UWORD _CNV_S_16_RANGE_ERR__485_CM 1 100. 0. 15. DISPLAY_IDENTIFIER ERR_SYM_TH ECU_ADDRESS 0xd00045a6 BIT_MASK 0x780 /end MEASUREMENT
/begin MEASUREMENT fmy_stat_ftl_min.ctr_abc "anti-bounce counter for diagnosis XX" UBYTE _CNV_A_R_LINEAR_____0_CM 1 100. 0. 255. DISPLAY_IDENTIFIER CTR_ABC_FTL_MIN ECU_ADDRESS 0xd0004324 FORMAT "%3.0" /end MEASUREMENT
/begin MEASUREMENT fmy_stat_ftl_min.ctr_end_diag "Counter for the end of diagnosis XX generation" UBYTE _CNV_A_R_LINEAR_____0_CM 1 100. 0. 255. DISPLAY_IDENTIFIER CTR_ABC_END_DIAG_FTL_MIN ECU_ADDRESS 0xd0004325 FORMAT "%3.0" /end MEASUREMENT
/begin MEASUREMENT fmy_stat_ftl_min.err_info_stat.lv_err_mem "Failure is stored in dynamic memory (2nd layer)" UWORD _CNV_S_2_RANGE__0___1_CM 1 100. 0. 1. DISPLAY_IDENTIFIER LV_ERR_MEM_FTL_MIN ECU_ADDRESS 0xd0004326 BIT_MASK 0x8 /end MEASUREMENT
/begin MEASUREMENT fmy_stat_ftl_min.err_info_stat.lv_ready "Readiness flag related to diagnosis XX" UWORD _CNV_S_2_RANGE__0___1_CM 1 100. 0. 1. DISPLAY_IDENTIFIER LV_READY_FTL_MIN ECU_ADDRESS 0xd0004326 BIT_MASK 0x10 /end MEASUREMENT
/begin MEASUREMENT fmy_stat_ftl_min.err_info_stat.lv_end_diag "End of diagnosis XX" UWORD _CNV_S_2_RANGE__0___1_CM 1 100. 0. 1. DISPLAY_IDENTIFIER LV_END_DIAG_FTL_MIN ECU_ADDRESS 0xd0004326 BIT_MASK 0x20 /end MEASUREMENT
/begin MEASUREMENT fmy_stat_ftl_min.err_info_stat.lv_cdn_diag "Diagnosis condition to start symptom detection (set to 1 when condition is fulfilled)" UWORD _CNV_S_2_RANGE__0___1_CM 1 100. 0. 1. DISPLAY_IDENTIFIER LV_CDN_DIAG_FTL_MIN ECU_ADDRESS 0xd0004326 BIT_MASK 0x40 /end MEASUREMENT
/begin MEASUREMENT fmy_stat_ftl_min.err_info_stat.err_sym "For each symptom: status of failure (set to 1 when failure symptom is detected)" UWORD _CNV_S_16_RANGE_ERR__485_CM 1 100. 0. 15. DISPLAY_IDENTIFIER ERR_SYM_FTL_MIN ECU_ADDRESS 0xd0004326 BIT_MASK 0x780 /end MEASUREMENT
/begin MEASUREMENT fmy_stat_tia_el.ctr_abc "anti-bounce counter for diagnosis XX" UBYTE _CNV_A_R_LINEAR_____0_CM 1 100. 0. 255. DISPLAY_IDENTIFIER CTR_ABC_TIA_EL ECU_ADDRESS 0xd00045a8 FORMAT "%3.0" /end MEASUREMENT
/begin MEASUREMENT fmy_stat_tia_el.ctr_end_diag "Counter for the end of diagnosis XX generation" UBYTE _CNV_A_R_LINEAR_____0_CM 1 100. 0. 255. DISPLAY_IDENTIFIER CTR_ABC_END_DIAG_TIA_EL ECU_ADDRESS 0xd00045a9 FORMAT "%3.0" /end MEASUREMENT
/begin MEASUREMENT fmy_stat_tia_el.err_info_stat.lv_err_mem "Failure is stored in dynamic memory (2nd layer)" UWORD _CNV_S_2_RANGE__0___1_CM 1 100. 0. 1. DISPLAY_IDENTIFIER LV_ERR_MEM_TIA_EL ECU_ADDRESS 0xd00045aa BIT_MASK 0x8 /end MEASUREMENT
/begin MEASUREMENT fmy_stat_tia_el.err_info_stat.lv_ready "Readiness flag related to diagnosis XX" UWORD _CNV_S_2_RANGE__0___1_CM 1 100. 0. 1. DISPLAY_IDENTIFIER LV_READY_TIA_EL ECU_ADDRESS 0xd00045aa BIT_MASK 0x10 /end MEASUREMENT
/begin MEASUREMENT fmy_stat_tia_el.err_info_stat.lv_end_diag "End of diagnosis XX" UWORD _CNV_S_2_RANGE__0___1_CM 1 100. 0. 1. DISPLAY_IDENTIFIER LV_END_DIAG_TIA_EL ECU_ADDRESS 0xd00045aa BIT_MASK 0x20 /end MEASUREMENT
/begin MEASUREMENT fmy_stat_tia_el.err_info_stat.lv_cdn_diag "Diagnosis condition to start symptom detection (set to 1 when condition is fulfilled)" UWORD _CNV_S_2_RANGE__0___1_CM 1 100. 0. 1. DISPLAY_IDENTIFIER LV_CDN_DIAG_TIA_EL ECU_ADDRESS 0xd00045aa BIT_MASK 0x40 /end MEASUREMENT
/begin MEASUREMENT fmy_stat_tia_el.err_info_stat.err_sym "For each symptom: status of failure (set to 1 when failure symptom is detected)" UWORD _CNV_S_16_RANGE_ERR__485_CM 1 100. 0. 15. DISPLAY_IDENTIFIER ERR_SYM_TIA_EL ECU_ADDRESS 0xd00045aa BIT_MASK 0x780 /end MEASUREMENT
/begin MEASUREMENT fmy_stat_amp.ctr_abc "anti-bounce counter for diagnosis XX" UBYTE _CNV_A_R_LINEAR_____0_CM 1 100. 0. 255. DISPLAY_IDENTIFIER CTR_ABC_AMP ECU_ADDRESS 0xd00041b0 FORMAT "%3.0" /end MEASUREMENT
/begin MEASUREMENT fmy_stat_amp.ctr_end_diag "Counter for the end of diagnosis XX generation" UBYTE _CNV_A_R_LINEAR_____0_CM 1 100. 0. 255. DISPLAY_IDENTIFIER CTR_ABC_END_DIAG_AMP ECU_ADDRESS 0xd00041b1 FORMAT "%3.0" /end MEASUREMENT
/begin MEASUREMENT fmy_stat_amp.err_info_stat.lv_err_mem "Failure is stored in dynamic memory (2nd layer)" UWORD _CNV_S_2_RANGE__0___1_CM 1 100. 0. 1. DISPLAY_IDENTIFIER LV_ERR_MEM_AMP ECU_ADDRESS 0xd00041b2 BIT_MASK 0x8 /end MEASUREMENT
/begin MEASUREMENT fmy_stat_amp.err_info_stat.lv_ready "Readiness flag related to diagnosis XX" UWORD _CNV_S_2_RANGE__0___1_CM 1 100. 0. 1. DISPLAY_IDENTIFIER LV_READY_AMP ECU_ADDRESS 0xd00041b2 BIT_MASK 0x10 /end MEASUREMENT
/begin MEASUREMENT fmy_stat_amp.err_info_stat.lv_end_diag "End of diagnosis XX" UWORD _CNV_S_2_RANGE__0___1_CM 1 100. 0. 1. DISPLAY_IDENTIFIER LV_END_DIAG_AMP ECU_ADDRESS 0xd00041b2 BIT_MASK 0x20 /end MEASUREMENT
/begin MEASUREMENT fmy_stat_amp.err_info_stat.lv_cdn_diag "Diagnosis condition to start symptom detection (set to 1 when condition is fulfilled)" UWORD _CNV_S_2_RANGE__0___1_CM 1 100. 0. 1. DISPLAY_IDENTIFIER LV_CDN_DIAG_AMP ECU_ADDRESS 0xd00041b2 BIT_MASK 0x40 /end MEASUREMENT
/begin MEASUREMENT fmy_stat_amp.err_info_stat.err_sym "For each symptom: status of failure (set to 1 when failure symptom is detected)" UWORD _CNV_S_16_RANGE_ERR__485_CM 1 100. 0. 15. DISPLAY_IDENTIFIER ERR_SYM_AMP ECU_ADDRESS 0xd00041b2 BIT_MASK 0x780 /end MEASUREMENT
/begin MEASUREMENT fmy_stat_amp_plaus.ctr_abc "anti-bounce counter for diagnosis XX" UBYTE _CNV_A_R_LINEAR_____0_CM 1 100. 0. 255. DISPLAY_IDENTIFIER CTR_ABC_AMP_PLAUS ECU_ADDRESS 0xd00041b4 FORMAT "%3.0" /end MEASUREMENT
/begin MEASUREMENT fmy_stat_amp_plaus.ctr_end_diag "Counter for the end of diagnosis XX generation" UBYTE _CNV_A_R_LINEAR_____0_CM 1 100. 0. 255. DISPLAY_IDENTIFIER CTR_ABC_END_DIAG_AMP_PLAUS ECU_ADDRESS 0xd00041b5 FORMAT "%3.0" /end MEASUREMENT
/begin MEASUREMENT fmy_stat_amp_plaus.err_info_stat.lv_err_mem "Failure is stored in dynamic memory (2nd layer)" UWORD _CNV_S_2_RANGE__0___1_CM 1 100. 0. 1. DISPLAY_IDENTIFIER LV_ERR_MEM_AMP_PLAUS ECU_ADDRESS 0xd00041b6 BIT_MASK 0x8 /end MEASUREMENT
/begin MEASUREMENT fmy_stat_amp_plaus.err_info_stat.lv_ready "Readiness flag related to diagnosis XX" UWORD _CNV_S_2_RANGE__0___1_CM 1 100. 0. 1. DISPLAY_IDENTIFIER LV_READY_AMP_PLAUS ECU_ADDRESS 0xd00041b6 BIT_MASK 0x10 /end MEASUREMENT
/begin MEASUREMENT fmy_stat_amp_plaus.err_info_stat.lv_end_diag "End of diagnosis XX" UWORD _CNV_S_2_RANGE__0___1_CM 1 100. 0. 1. DISPLAY_IDENTIFIER LV_END_DIAG_AMP_PLAUS ECU_ADDRESS 0xd00041b6 BIT_MASK 0x20 /end MEASUREMENT
/begin MEASUREMENT fmy_stat_amp_plaus.err_info_stat.lv_cdn_diag "Diagnosis condition to start symptom detection (set to 1 when condition is fulfilled)" UWORD _CNV_S_2_RANGE__0___1_CM 1 100. 0. 1. DISPLAY_IDENTIFIER LV_CDN_DIAG_AMP_PLAUS ECU_ADDRESS 0xd00041b6 BIT_MASK 0x40 /end MEASUREMENT
/begin MEASUREMENT fmy_stat_amp_plaus.err_info_stat.err_sym "For each symptom: status of failure (set to 1 when failure symptom is detected)" UWORD _CNV_S_16_RANGE_ERR__485_CM 1 100. 0. 15. DISPLAY_IDENTIFIER ERR_SYM_AMP_PLAUS ECU_ADDRESS 0xd00041b6 BIT_MASK 0x780 /end MEASUREMENT
/begin MEASUREMENT fmy_stat_maf.ctr_abc "anti-bounce counter for diagnosis XX" UBYTE _CNV_A_R_LINEAR_____0_CM 1 100. 0. 255. DISPLAY_IDENTIFIER CTR_ABC_MAF ECU_ADDRESS 0xd00043f8 FORMAT "%3.0" /end MEASUREMENT
/begin MEASUREMENT fmy_stat_maf.ctr_end_diag "Counter for the end of diagnosis XX generation" UBYTE _CNV_A_R_LINEAR_____0_CM 1 100. 0. 255. DISPLAY_IDENTIFIER CTR_ABC_END_DIAG_MAF ECU_ADDRESS 0xd00043f9 FORMAT "%3.0" /end MEASUREMENT
/begin MEASUREMENT fmy_stat_maf.err_info_stat.lv_err_mem "Failure is stored in dynamic memory (2nd layer)" UWORD _CNV_S_2_RANGE__0___1_CM 1 100. 0. 1. DISPLAY_IDENTIFIER LV_ERR_MEM_MAF ECU_ADDRESS 0xd00043fa BIT_MASK 0x8 /end MEASUREMENT
/begin MEASUREMENT fmy_stat_maf.err_info_stat.lv_ready "Readiness flag related to diagnosis XX" UWORD _CNV_S_2_RANGE__0___1_CM 1 100. 0. 1. DISPLAY_IDENTIFIER LV_READY_MAF ECU_ADDRESS 0xd00043fa BIT_MASK 0x10 /end MEASUREMENT
/begin MEASUREMENT fmy_stat_maf.err_info_stat.lv_end_diag "End of diagnosis XX" UWORD _CNV_S_2_RANGE__0___1_CM 1 100. 0. 1. DISPLAY_IDENTIFIER LV_END_DIAG_MAF ECU_ADDRESS 0xd00043fa BIT_MASK 0x20 /end MEASUREMENT
/begin MEASUREMENT fmy_stat_maf.err_info_stat.lv_cdn_diag "Diagnosis condition to start symptom detection (set to 1 when condition is fulfilled)" UWORD _CNV_S_2_RANGE__0___1_CM 1 100. 0. 1. DISPLAY_IDENTIFIER LV_CDN_DIAG_MAF ECU_ADDRESS 0xd00043fa BIT_MASK 0x40 /end MEASUREMENT
/begin MEASUREMENT fmy_stat_maf.err_info_stat.err_sym "For each symptom: status of failure (set to 1 when failure symptom is detected)" UWORD _CNV_S_16_RANGE_ERR__485_CM 1 100. 0. 15. DISPLAY_IDENTIFIER ERR_SYM_MAF ECU_ADDRESS 0xd00043fa BIT_MASK 0x780 /end MEASUREMENT
/begin MEASUREMENT fmy_stat_iv_0.ctr_abc "anti-bounce counter for diagnosis XX" UBYTE _CNV_A_R_LINEAR_____0_CM 1 100. 0. 255. DISPLAY_IDENTIFIER CTR_ABC_IV_0 ECU_ADDRESS 0xd00043a8 FORMAT "%3.0" /end MEASUREMENT
/begin MEASUREMENT fmy_stat_iv_0.ctr_end_diag "Counter for the end of diagnosis XX generation" UBYTE _CNV_A_R_LINEAR_____0_CM 1 100. 0. 255. DISPLAY_IDENTIFIER CTR_ABC_END_DIAG_IV_0 ECU_ADDRESS 0xd00043a9 FORMAT "%3.0" /end MEASUREMENT
/begin MEASUREMENT fmy_stat_iv_0.err_info_stat.lv_err_mem "Failure is stored in dynamic memory (2nd layer)" UWORD _CNV_S_2_RANGE__0___1_CM 1 100. 0. 1. DISPLAY_IDENTIFIER LV_ERR_MEM_IV_0 ECU_ADDRESS 0xd00043aa BIT_MASK 0x8 /end MEASUREMENT
/begin MEASUREMENT fmy_stat_iv_0.err_info_stat.lv_ready "Readiness flag related to diagnosis XX" UWORD _CNV_S_2_RANGE__0___1_CM 1 100. 0. 1. DISPLAY_IDENTIFIER LV_READY_IV_0 ECU_ADDRESS 0xd00043aa BIT_MASK 0x10 /end MEASUREMENT
/begin MEASUREMENT fmy_stat_iv_0.err_info_stat.lv_end_diag "End of diagnosis XX" UWORD _CNV_S_2_RANGE__0___1_CM 1 100. 0. 1. DISPLAY_IDENTIFIER LV_END_DIAG_IV_0 ECU_ADDRESS 0xd00043aa BIT_MASK 0x20 /end MEASUREMENT
/begin MEASUREMENT fmy_stat_iv_0.err_info_stat.lv_cdn_diag "Diagnosis condition to start symptom detection (set to 1 when condition is fulfilled)" UWORD _CNV_S_2_RANGE__0___1_CM 1 100. 0. 1. DISPLAY_IDENTIFIER LV_CDN_DIAG_IV_0 ECU_ADDRESS 0xd00043aa BIT_MASK 0x40 /end MEASUREMENT
/begin MEASUREMENT fmy_stat_iv_0.err_info_stat.err_sym "For each symptom: status of failure (set to 1 when failure symptom is detected)" UWORD _CNV_S_16_RANGE_ERR__485_CM 1 100. 0. 15. DISPLAY_IDENTIFIER ERR_SYM_IV_0 ECU_ADDRESS 0xd00043aa BIT_MASK 0x780 /end MEASUREMENT
/begin MEASUREMENT fmy_stat_iv_1.ctr_abc "anti-bounce counter for diagnosis XX" UBYTE _CNV_A_R_LINEAR_____0_CM 1 100. 0. 255. DISPLAY_IDENTIFIER CTR_ABC_IV_1 ECU_ADDRESS 0xd00043ac FORMAT "%3.0" /end MEASUREMENT
/begin MEASUREMENT fmy_stat_iv_1.ctr_end_diag "Counter for the end of diagnosis XX generation" UBYTE _CNV_A_R_LINEAR_____0_CM 1 100. 0. 255. DISPLAY_IDENTIFIER CTR_ABC_END_DIAG_IV_1 ECU_ADDRESS 0xd00043ad FORMAT "%3.0" /end MEASUREMENT
/begin MEASUREMENT fmy_stat_iv_1.err_info_stat.lv_err_mem "Failure is stored in dynamic memory (2nd layer)" UWORD _CNV_S_2_RANGE__0___1_CM 1 100. 0. 1. DISPLAY_IDENTIFIER LV_ERR_MEM_IV_1 ECU_ADDRESS 0xd00043ae BIT_MASK 0x8 /end MEASUREMENT
/begin MEASUREMENT fmy_stat_iv_1.err_info_stat.lv_ready "Readiness flag related to diagnosis XX" UWORD _CNV_S_2_RANGE__0___1_CM 1 100. 0. 1. DISPLAY_IDENTIFIER LV_READY_IV_1 ECU_ADDRESS 0xd00043ae BIT_MASK 0x10 /end MEASUREMENT
/begin MEASUREMENT fmy_stat_iv_1.err_info_stat.lv_end_diag "End of diagnosis XX" UWORD _CNV_S_2_RANGE__0___1_CM 1 100. 0. 1. DISPLAY_IDENTIFIER LV_END_DIAG_IV_1 ECU_ADDRESS 0xd00043ae BIT_MASK 0x20 /end MEASUREMENT
/begin MEASUREMENT fmy_stat_iv_1.err_info_stat.lv_cdn_diag "Diagnosis condition to start symptom detection (set to 1 when condition is fulfilled)" UWORD _CNV_S_2_RANGE__0___1_CM 1 100. 0. 1. DISPLAY_IDENTIFIER LV_CDN_DIAG_IV_1 ECU_ADDRESS 0xd00043ae BIT_MASK 0x40 /end MEASUREMENT
/begin MEASUREMENT fmy_stat_iv_1.err_info_stat.err_sym "For each symptom: status of failure (set to 1 when failure symptom is detected)" UWORD _CNV_S_16_RANGE_ERR__485_CM 1 100. 0. 15. DISPLAY_IDENTIFIER ERR_SYM_IV_1 ECU_ADDRESS 0xd00043ae BIT_MASK 0x780 /end MEASUREMENT
/begin MEASUREMENT fmy_stat_iv_2.ctr_abc "anti-bounce counter for diagnosis XX" UBYTE _CNV_A_R_LINEAR_____0_CM 1 100. 0. 255. DISPLAY_IDENTIFIER CTR_ABC_IV_2 ECU_ADDRESS 0xd00043b0 FORMAT "%3.0" /end MEASUREMENT
/begin MEASUREMENT fmy_stat_iv_2.ctr_end_diag "Counter for the end of diagnosis XX generation" UBYTE _CNV_A_R_LINEAR_____0_CM 1 100. 0. 255. DISPLAY_IDENTIFIER CTR_ABC_END_DIAG_IV_2 ECU_ADDRESS 0xd00043b1 FORMAT "%3.0" /end MEASUREMENT
/begin MEASUREMENT fmy_stat_iv_2.err_info_stat.lv_err_mem "Failure is stored in dynamic memory (2nd layer)" UWORD _CNV_S_2_RANGE__0___1_CM 1 100. 0. 1. DISPLAY_IDENTIFIER LV_ERR_MEM_IV_2 ECU_ADDRESS 0xd00043b2 BIT_MASK 0x8 /end MEASUREMENT
/begin MEASUREMENT fmy_stat_iv_2.err_info_stat.lv_ready "Readiness flag related to diagnosis XX" UWORD _CNV_S_2_RANGE__0___1_CM 1 100. 0. 1. DISPLAY_IDENTIFIER LV_READY_IV_2 ECU_ADDRESS 0xd00043b2 BIT_MASK 0x10 /end MEASUREMENT
/begin MEASUREMENT fmy_stat_iv_2.err_info_stat.lv_end_diag "End of diagnosis XX" UWORD _CNV_S_2_RANGE__0___1_CM 1 100. 0. 1. DISPLAY_IDENTIFIER LV_END_DIAG_IV_2 ECU_ADDRESS 0xd00043b2 BIT_MASK 0x20 /end MEASUREMENT
/begin MEASUREMENT fmy_stat_iv_2.err_info_stat.lv_cdn_diag "Diagnosis condition to start symptom detection (set to 1 when condition is fulfilled)" UWORD _CNV_S_2_RANGE__0___1_CM 1 100. 0. 1. DISPLAY_IDENTIFIER LV_CDN_DIAG_IV_2 ECU_ADDRESS 0xd00043b2 BIT_MASK 0x40 /end MEASUREMENT
/begin MEASUREMENT fmy_stat_iv_2.err_info_stat.err_sym "For each symptom: status of failure (set to 1 when failure symptom is detected)" UWORD _CNV_S_16_RANGE_ERR__485_CM 1 100. 0. 15. DISPLAY_IDENTIFIER ERR_SYM_IV_2 ECU_ADDRESS 0xd00043b2 BIT_MASK 0x780 /end MEASUREMENT
/begin MEASUREMENT fmy_stat_iv_3.ctr_abc "anti-bounce counter for diagnosis XX" UBYTE _CNV_A_R_LINEAR_____0_CM 1 100. 0. 255. DISPLAY_IDENTIFIER CTR_ABC_IV_3 ECU_ADDRESS 0xd00043b4 FORMAT "%3.0" /end MEASUREMENT
/begin MEASUREMENT fmy_stat_iv_3.ctr_end_diag "Counter for the end of diagnosis XX generation" UBYTE _CNV_A_R_LINEAR_____0_CM 1 100. 0. 255. DISPLAY_IDENTIFIER CTR_ABC_END_DIAG_IV_3 ECU_ADDRESS 0xd00043b5 FORMAT "%3.0" /end MEASUREMENT
/begin MEASUREMENT fmy_stat_iv_3.err_info_stat.lv_err_mem "Failure is stored in dynamic memory (2nd layer)" UWORD _CNV_S_2_RANGE__0___1_CM 1 100. 0. 1. DISPLAY_IDENTIFIER LV_ERR_MEM_IV_3 ECU_ADDRESS 0xd00043b6 BIT_MASK 0x8 /end MEASUREMENT
/begin MEASUREMENT fmy_stat_iv_3.err_info_stat.lv_ready "Readiness flag related to diagnosis XX" UWORD _CNV_S_2_RANGE__0___1_CM 1 100. 0. 1. DISPLAY_IDENTIFIER LV_READY_IV_3 ECU_ADDRESS 0xd00043b6 BIT_MASK 0x10 /end MEASUREMENT
/begin MEASUREMENT fmy_stat_iv_3.err_info_stat.lv_end_diag "End of diagnosis XX" UWORD _CNV_S_2_RANGE__0___1_CM 1 100. 0. 1. DISPLAY_IDENTIFIER LV_END_DIAG_IV_3 ECU_ADDRESS 0xd00043b6 BIT_MASK 0x20 /end MEASUREMENT
/begin MEASUREMENT fmy_stat_iv_3.err_info_stat.lv_cdn_diag "Diagnosis condition to start symptom detection (set to 1 when condition is fulfilled)" UWORD _CNV_S_2_RANGE__0___1_CM 1 100. 0. 1. DISPLAY_IDENTIFIER LV_CDN_DIAG_IV_3 ECU_ADDRESS 0xd00043b6 BIT_MASK 0x40 /end MEASUREMENT
/begin MEASUREMENT fmy_stat_iv_3.err_info_stat.err_sym "For each symptom: status of failure (set to 1 when failure symptom is detected)" UWORD _CNV_S_16_RANGE_ERR__485_CM 1 100. 0. 15. DISPLAY_IDENTIFIER ERR_SYM_IV_3 ECU_ADDRESS 0xd00043b6 BIT_MASK 0x780 /end MEASUREMENT
/begin MEASUREMENT fmy_stat_iv_4.ctr_abc "anti-bounce counter for diagnosis XX" UBYTE _CNV_A_R_LINEAR_____0_CM 1 100. 0. 255. DISPLAY_IDENTIFIER CTR_ABC_IV_4 ECU_ADDRESS 0xd00043b8 FORMAT "%3.0" /end MEASUREMENT
/begin MEASUREMENT fmy_stat_iv_4.ctr_end_diag "Counter for the end of diagnosis XX generation" UBYTE _CNV_A_R_LINEAR_____0_CM 1 100. 0. 255. DISPLAY_IDENTIFIER CTR_ABC_END_DIAG_IV_4 ECU_ADDRESS 0xd00043b9 FORMAT "%3.0" /end MEASUREMENT
/begin MEASUREMENT fmy_stat_iv_4.err_info_stat.lv_err_mem "Failure is stored in dynamic memory (2nd layer)" UWORD _CNV_S_2_RANGE__0___1_CM 1 100. 0. 1. DISPLAY_IDENTIFIER LV_ERR_MEM_IV_4 ECU_ADDRESS 0xd00043ba BIT_MASK 0x8 /end MEASUREMENT
/begin MEASUREMENT fmy_stat_iv_4.err_info_stat.lv_ready "Readiness flag related to diagnosis XX" UWORD _CNV_S_2_RANGE__0___1_CM 1 100. 0. 1. DISPLAY_IDENTIFIER LV_READY_IV_4 ECU_ADDRESS 0xd00043ba BIT_MASK 0x10 /end MEASUREMENT
/begin MEASUREMENT fmy_stat_iv_4.err_info_stat.lv_end_diag "End of diagnosis XX" UWORD _CNV_S_2_RANGE__0___1_CM 1 100. 0. 1. DISPLAY_IDENTIFIER LV_END_DIAG_IV_4 ECU_ADDRESS 0xd00043ba BIT_MASK 0x20 /end MEASUREMENT
/begin MEASUREMENT fmy_stat_iv_4.err_info_stat.lv_cdn_diag "Diagnosis condition to start symptom detection (set to 1 when condition is fulfilled)" UWORD _CNV_S_2_RANGE__0___1_CM 1 100. 0. 1. DISPLAY_IDENTIFIER LV_CDN_DIAG_IV_4 ECU_ADDRESS 0xd00043ba BIT_MASK 0x40 /end MEASUREMENT
/begin MEASUREMENT fmy_stat_iv_4.err_info_stat.err_sym "For each symptom: status of failure (set to 1 when failure symptom is detected)" UWORD _CNV_S_16_RANGE_ERR__485_CM 1 100. 0. 15. DISPLAY_IDENTIFIER ERR_SYM_IV_4 ECU_ADDRESS 0xd00043ba BIT_MASK 0x780 /end MEASUREMENT
/begin MEASUREMENT fmy_stat_iv_5.ctr_abc "anti-bounce counter for diagnosis XX" UBYTE _CNV_A_R_LINEAR_____0_CM 1 100. 0. 255. DISPLAY_IDENTIFIER CTR_ABC_IV_5 ECU_ADDRESS 0xd00043bc FORMAT "%3.0" /end MEASUREMENT
/begin MEASUREMENT fmy_stat_iv_5.ctr_end_diag "Counter for the end of diagnosis XX generation" UBYTE _CNV_A_R_LINEAR_____0_CM 1 100. 0. 255. DISPLAY_IDENTIFIER CTR_ABC_END_DIAG_IV_5 ECU_ADDRESS 0xd00043bd FORMAT "%3.0" /end MEASUREMENT
/begin MEASUREMENT fmy_stat_iv_5.err_info_stat.lv_err_mem "Failure is stored in dynamic memory (2nd layer)" UWORD _CNV_S_2_RANGE__0___1_CM 1 100. 0. 1. DISPLAY_IDENTIFIER LV_ERR_MEM_IV_5 ECU_ADDRESS 0xd00043be BIT_MASK 0x8 /end MEASUREMENT
/begin MEASUREMENT fmy_stat_iv_5.err_info_stat.lv_ready "Readiness flag related to diagnosis XX" UWORD _CNV_S_2_RANGE__0___1_CM 1 100. 0. 1. DISPLAY_IDENTIFIER LV_READY_IV_5 ECU_ADDRESS 0xd00043be BIT_MASK 0x10 /end MEASUREMENT
/begin MEASUREMENT fmy_stat_iv_5.err_info_stat.lv_end_diag "End of diagnosis XX" UWORD _CNV_S_2_RANGE__0___1_CM 1 100. 0. 1. DISPLAY_IDENTIFIER LV_END_DIAG_IV_5 ECU_ADDRESS 0xd00043be BIT_MASK 0x20 /end MEASUREMENT
/begin MEASUREMENT fmy_stat_iv_5.err_info_stat.lv_cdn_diag "Diagnosis condition to start symptom detection (set to 1 when condition is fulfilled)" UWORD _CNV_S_2_RANGE__0___1_CM 1 100. 0. 1. DISPLAY_IDENTIFIER LV_CDN_DIAG_IV_5 ECU_ADDRESS 0xd00043be BIT_MASK 0x40 /end MEASUREMENT
/begin MEASUREMENT fmy_stat_iv_5.err_info_stat.err_sym "For each symptom: status of failure (set to 1 when failure symptom is detected)" UWORD _CNV_S_16_RANGE_ERR__485_CM 1 100. 0. 15. DISPLAY_IDENTIFIER ERR_SYM_IV_5 ECU_ADDRESS 0xd00043be BIT_MASK 0x780 /end MEASUREMENT
/begin MEASUREMENT fmy_stat_rly_efp.ctr_abc "anti-bounce counter for diagnosis XX" UBYTE _CNV_A_R_LINEAR_____0_CM 1 100. 0. 255. DISPLAY_IDENTIFIER CTR_ABC_RLY_EFP ECU_ADDRESS 0xd00044f4 FORMAT "%3.0" /end MEASUREMENT
/begin MEASUREMENT fmy_stat_rly_efp.ctr_end_diag "Counter for the end of diagnosis XX generation" UBYTE _CNV_A_R_LINEAR_____0_CM 1 100. 0. 255. DISPLAY_IDENTIFIER CTR_ABC_END_DIAG_RLY_EFP ECU_ADDRESS 0xd00044f5 FORMAT "%3.0" /end MEASUREMENT
/begin MEASUREMENT fmy_stat_rly_efp.err_info_stat.lv_err_mem "Failure is stored in dynamic memory (2nd layer)" UWORD _CNV_S_2_RANGE__0___1_CM 1 100. 0. 1. DISPLAY_IDENTIFIER LV_ERR_MEM_RLY_EFP ECU_ADDRESS 0xd00044f6 BIT_MASK 0x8 /end MEASUREMENT
/begin MEASUREMENT fmy_stat_rly_efp.err_info_stat.lv_ready "Readiness flag related to diagnosis XX" UWORD _CNV_S_2_RANGE__0___1_CM 1 100. 0. 1. DISPLAY_IDENTIFIER LV_READY_RLY_EFP ECU_ADDRESS 0xd00044f6 BIT_MASK 0x10 /end MEASUREMENT
/begin MEASUREMENT fmy_stat_rly_efp.err_info_stat.lv_end_diag "End of diagnosis XX" UWORD _CNV_S_2_RANGE__0___1_CM 1 100. 0. 1. DISPLAY_IDENTIFIER LV_END_DIAG_RLY_EFP ECU_ADDRESS 0xd00044f6 BIT_MASK 0x20 /end MEASUREMENT
/begin MEASUREMENT fmy_stat_rly_efp.err_info_stat.lv_cdn_diag "Diagnosis condition to start symptom detection (set to 1 when condition is fulfilled)" UWORD _CNV_S_2_RANGE__0___1_CM 1 100. 0. 1. DISPLAY_IDENTIFIER LV_CDN_DIAG_RLY_EFP ECU_ADDRESS 0xd00044f6 BIT_MASK 0x40 /end MEASUREMENT
/begin MEASUREMENT fmy_stat_rly_efp.err_info_stat.err_sym "For each symptom: status of failure (set to 1 when failure symptom is detected)" UWORD _CNV_S_16_RANGE_ERR__485_CM 1 100. 0. 15. DISPLAY_IDENTIFIER ERR_SYM_RLY_EFP ECU_ADDRESS 0xd00044f6 BIT_MASK 0x780 /end MEASUREMENT
/begin MEASUREMENT fmy_stat_el_cps.ctr_abc "anti-bounce counter for diagnosis XX" UBYTE _CNV_A_R_LINEAR_____0_CM 1 100. 0. 255. DISPLAY_IDENTIFIER CTR_ABC_EL_CPS ECU_ADDRESS 0xd0004304 FORMAT "%3.0" /end MEASUREMENT
/begin MEASUREMENT fmy_stat_el_cps.ctr_end_diag "Counter for the end of diagnosis XX generation" UBYTE _CNV_A_R_LINEAR_____0_CM 1 100. 0. 255. DISPLAY_IDENTIFIER CTR_ABC_END_DIAG_EL_CPS ECU_ADDRESS 0xd0004305 FORMAT "%3.0" /end MEASUREMENT
/begin MEASUREMENT fmy_stat_el_cps.err_info_stat.lv_err_mem "Failure is stored in dynamic memory (2nd layer)" UWORD _CNV_S_2_RANGE__0___1_CM 1 100. 0. 1. DISPLAY_IDENTIFIER LV_ERR_MEM_EL_CPS ECU_ADDRESS 0xd0004306 BIT_MASK 0x8 /end MEASUREMENT
/begin MEASUREMENT fmy_stat_el_cps.err_info_stat.lv_ready "Readiness flag related to diagnosis XX" UWORD _CNV_S_2_RANGE__0___1_CM 1 100. 0. 1. DISPLAY_IDENTIFIER LV_READY_EL_CPS ECU_ADDRESS 0xd0004306 BIT_MASK 0x10 /end MEASUREMENT
/begin MEASUREMENT fmy_stat_el_cps.err_info_stat.lv_end_diag "End of diagnosis XX" UWORD _CNV_S_2_RANGE__0___1_CM 1 100. 0. 1. DISPLAY_IDENTIFIER LV_END_DIAG_EL_CPS ECU_ADDRESS 0xd0004306 BIT_MASK 0x20 /end MEASUREMENT
/begin MEASUREMENT fmy_stat_el_cps.err_info_stat.lv_cdn_diag "Diagnosis condition to start symptom detection (set to 1 when condition is fulfilled)" UWORD _CNV_S_2_RANGE__0___1_CM 1 100. 0. 1. DISPLAY_IDENTIFIER LV_CDN_DIAG_EL_CPS ECU_ADDRESS 0xd0004306 BIT_MASK 0x40 /end MEASUREMENT
/begin MEASUREMENT fmy_stat_el_cps.err_info_stat.err_sym "For each symptom: status of failure (set to 1 when failure symptom is detected)" UWORD _CNV_S_16_RANGE_ERR__485_CM 1 100. 0. 15. DISPLAY_IDENTIFIER ERR_SYM_EL_CPS ECU_ADDRESS 0xd0004306 BIT_MASK 0x780 /end MEASUREMENT
/begin MEASUREMENT fmy_stat_slv_ivvt_in.ctr_abc "anti-bounce counter for diagnosis XX" UBYTE _CNV_A_R_LINEAR_____0_CM 1 100. 0. 255. DISPLAY_IDENTIFIER CTR_ABC_SLV_IVVT_IN ECU_ADDRESS 0xd000453c FORMAT "%3.0" /end MEASUREMENT
/begin MEASUREMENT fmy_stat_slv_ivvt_in.ctr_end_diag "Counter for the end of diagnosis XX generation" UBYTE _CNV_A_R_LINEAR_____0_CM 1 100. 0. 255. DISPLAY_IDENTIFIER CTR_ABC_END_DIAG_SLV_IVVT_IN ECU_ADDRESS 0xd000453d FORMAT "%3.0" /end MEASUREMENT
/begin MEASUREMENT fmy_stat_slv_ivvt_in.err_info_stat.lv_err_mem "Failure is stored in dynamic memory (2nd layer)" UWORD _CNV_S_2_RANGE__0___1_CM 1 100. 0. 1. DISPLAY_IDENTIFIER LV_ERR_MEM_SLV_IVVT_IN ECU_ADDRESS 0xd000453e BIT_MASK 0x8 /end MEASUREMENT
/begin MEASUREMENT fmy_stat_slv_ivvt_in.err_info_stat.lv_ready "Readiness flag related to diagnosis XX" UWORD _CNV_S_2_RANGE__0___1_CM 1 100. 0. 1. DISPLAY_IDENTIFIER LV_READY_SLV_IVVT_IN ECU_ADDRESS 0xd000453e BIT_MASK 0x10 /end MEASUREMENT
/begin MEASUREMENT fmy_stat_slv_ivvt_in.err_info_stat.lv_end_diag "End of diagnosis XX" UWORD _CNV_S_2_RANGE__0___1_CM 1 100. 0. 1. DISPLAY_IDENTIFIER LV_END_DIAG_SLV_IVVT_IN ECU_ADDRESS 0xd000453e BIT_MASK 0x20 /end MEASUREMENT
/begin MEASUREMENT fmy_stat_slv_ivvt_in.err_info_stat.lv_cdn_diag "Diagnosis condition to start symptom detection (set to 1 when condition is fulfilled)" UWORD _CNV_S_2_RANGE__0___1_CM 1 100. 0. 1. DISPLAY_IDENTIFIER LV_CDN_DIAG_SLV_IVVT_IN ECU_ADDRESS 0xd000453e BIT_MASK 0x40 /end MEASUREMENT
/begin MEASUREMENT fmy_stat_slv_ivvt_in.err_info_stat.err_sym "For each symptom: status of failure (set to 1 when failure symptom is detected)" UWORD _CNV_S_16_RANGE_ERR__485_CM 1 100. 0. 15. DISPLAY_IDENTIFIER ERR_SYM_SLV_IVVT_IN ECU_ADDRESS 0xd000453e BIT_MASK 0x780 /end MEASUREMENT
/begin MEASUREMENT fmy_stat_slv_ivvt_ex.ctr_abc "anti-bounce counter for diagnosis XX" UBYTE _CNV_A_R_LINEAR_____0_CM 1 100. 0. 255. DISPLAY_IDENTIFIER CTR_ABC_SLV_IVVT_EX ECU_ADDRESS 0xd0004538 FORMAT "%3.0" /end MEASUREMENT
/begin MEASUREMENT fmy_stat_slv_ivvt_ex.ctr_end_diag "Counter for the end of diagnosis XX generation" UBYTE _CNV_A_R_LINEAR_____0_CM 1 100. 0. 255. DISPLAY_IDENTIFIER CTR_ABC_END_DIAG_SLV_IVVT_EX ECU_ADDRESS 0xd0004539 FORMAT "%3.0" /end MEASUREMENT
/begin MEASUREMENT fmy_stat_slv_ivvt_ex.err_info_stat.lv_err_mem "Failure is stored in dynamic memory (2nd layer)" UWORD _CNV_S_2_RANGE__0___1_CM 1 100. 0. 1. DISPLAY_IDENTIFIER LV_ERR_MEM_SLV_IVVT_EX ECU_ADDRESS 0xd000453a BIT_MASK 0x8 /end MEASUREMENT
/begin MEASUREMENT fmy_stat_slv_ivvt_ex.err_info_stat.lv_ready "Readiness flag related to diagnosis XX" UWORD _CNV_S_2_RANGE__0___1_CM 1 100. 0. 1. DISPLAY_IDENTIFIER LV_READY_SLV_IVVT_EX ECU_ADDRESS 0xd000453a BIT_MASK 0x10 /end MEASUREMENT
/begin MEASUREMENT fmy_stat_slv_ivvt_ex.err_info_stat.lv_end_diag "End of diagnosis XX" UWORD _CNV_S_2_RANGE__0___1_CM 1 100. 0. 1. DISPLAY_IDENTIFIER LV_END_DIAG_SLV_IVVT_EX ECU_ADDRESS 0xd000453a BIT_MASK 0x20 /end MEASUREMENT
/begin MEASUREMENT fmy_stat_slv_ivvt_ex.err_info_stat.lv_cdn_diag "Diagnosis condition to start symptom detection (set to 1 when condition is fulfilled)" UWORD _CNV_S_2_RANGE__0___1_CM 1 100. 0. 1. DISPLAY_IDENTIFIER LV_CDN_DIAG_SLV_IVVT_EX ECU_ADDRESS 0xd000453a BIT_MASK 0x40 /end MEASUREMENT
/begin MEASUREMENT fmy_stat_slv_ivvt_ex.err_info_stat.err_sym "For each symptom: status of failure (set to 1 when failure symptom is detected)" UWORD _CNV_S_16_RANGE_ERR__485_CM 1 100. 0. 15. DISPLAY_IDENTIFIER ERR_SYM_SLV_IVVT_EX ECU_ADDRESS 0xd000453a BIT_MASK 0x780 /end MEASUREMENT
/begin MEASUREMENT fmy_stat_ecu_cks.ctr_abc "anti-bounce counter for diagnosis XX" UBYTE _CNV_A_R_LINEAR_____0_CM 1 100. 0. 255. DISPLAY_IDENTIFIER CTR_ABC_ECU_CKS ECU_ADDRESS 0xd00042e4 FORMAT "%3.0" /end MEASUREMENT
/begin MEASUREMENT fmy_stat_ecu_cks.ctr_end_diag "Counter for the end of diagnosis XX generation" UBYTE _CNV_A_R_LINEAR_____0_CM 1 100. 0. 255. DISPLAY_IDENTIFIER CTR_ABC_END_DIAG_ECU_CKS ECU_ADDRESS 0xd00042e5 FORMAT "%3.0" /end MEASUREMENT
/begin MEASUREMENT fmy_stat_ecu_cks.err_info_stat.lv_err_mem "Failure is stored in dynamic memory (2nd layer)" UWORD _CNV_S_2_RANGE__0___1_CM 1 100. 0. 1. DISPLAY_IDENTIFIER LV_ERR_MEM_ECU_CKS ECU_ADDRESS 0xd00042e6 BIT_MASK 0x8 /end MEASUREMENT
/begin MEASUREMENT fmy_stat_ecu_cks.err_info_stat.lv_ready "Readiness flag related to diagnosis XX" UWORD _CNV_S_2_RANGE__0___1_CM 1 100. 0. 1. DISPLAY_IDENTIFIER LV_READY_ECU_CKS ECU_ADDRESS 0xd00042e6 BIT_MASK 0x10 /end MEASUREMENT
/begin MEASUREMENT fmy_stat_ecu_cks.err_info_stat.lv_end_diag "End of diagnosis XX" UWORD _CNV_S_2_RANGE__0___1_CM 1 100. 0. 1. DISPLAY_IDENTIFIER LV_END_DIAG_ECU_CKS ECU_ADDRESS 0xd00042e6 BIT_MASK 0x20 /end MEASUREMENT
/begin MEASUREMENT fmy_stat_ecu_cks.err_info_stat.lv_cdn_diag "Diagnosis condition to start symptom detection (set to 1 when condition is fulfilled)" UWORD _CNV_S_2_RANGE__0___1_CM 1 100. 0. 1. DISPLAY_IDENTIFIER LV_CDN_DIAG_ECU_CKS ECU_ADDRESS 0xd00042e6 BIT_MASK 0x40 /end MEASUREMENT
/begin MEASUREMENT fmy_stat_ecu_cks.err_info_stat.err_sym "For each symptom: status of failure (set to 1 when failure symptom is detected)" UWORD _CNV_S_16_RANGE_ERR__485_CM 1 100. 0. 15. DISPLAY_IDENTIFIER ERR_SYM_ECU_CKS ECU_ADDRESS 0xd00042e6 BIT_MASK 0x780 /end MEASUREMENT
/begin MEASUREMENT fmy_stat_tout_etcu_1.ctr_abc "anti-bounce counter for diagnosis XX" UBYTE _CNV_A_R_LINEAR_____0_CM 1 100. 0. 255. DISPLAY_IDENTIFIER CTR_ABC_TOUT_ETCU_1 ECU_ADDRESS 0xd00045c8 FORMAT "%3.0" /end MEASUREMENT
/begin MEASUREMENT fmy_stat_tout_etcu_1.ctr_end_diag "Counter for the end of diagnosis XX generation" UBYTE _CNV_A_R_LINEAR_____0_CM 1 100. 0. 255. DISPLAY_IDENTIFIER CTR_ABC_END_DIAG_TOUT_ETCU_1 ECU_ADDRESS 0xd00045c9 FORMAT "%3.0" /end MEASUREMENT
/begin MEASUREMENT fmy_stat_tout_etcu_1.err_info_stat.lv_err_mem "Failure is stored in dynamic memory (2nd layer)" UWORD _CNV_S_2_RANGE__0___1_CM 1 100. 0. 1. DISPLAY_IDENTIFIER LV_ERR_MEM_TOUT_ETCU_1 ECU_ADDRESS 0xd00045ca BIT_MASK 0x8 /end MEASUREMENT
/begin MEASUREMENT fmy_stat_tout_etcu_1.err_info_stat.lv_ready "Readiness flag related to diagnosis XX" UWORD _CNV_S_2_RANGE__0___1_CM 1 100. 0. 1. DISPLAY_IDENTIFIER LV_READY_TOUT_ETCU_1 ECU_ADDRESS 0xd00045ca BIT_MASK 0x10 /end MEASUREMENT
/begin MEASUREMENT fmy_stat_tout_etcu_1.err_info_stat.lv_end_diag "End of diagnosis XX" UWORD _CNV_S_2_RANGE__0___1_CM 1 100. 0. 1. DISPLAY_IDENTIFIER LV_END_DIAG_TOUT_ETCU_1 ECU_ADDRESS 0xd00045ca BIT_MASK 0x20 /end MEASUREMENT
/begin MEASUREMENT fmy_stat_tout_etcu_1.err_info_stat.lv_cdn_diag "Diagnosis condition to start symptom detection (set to 1 when condition is fulfilled)" UWORD _CNV_S_2_RANGE__0___1_CM 1 100. 0. 1. DISPLAY_IDENTIFIER LV_CDN_DIAG_TOUT_ETCU_1 ECU_ADDRESS 0xd00045ca BIT_MASK 0x40 /end MEASUREMENT
/begin MEASUREMENT fmy_stat_tout_etcu_1.err_info_stat.err_sym "For each symptom: status of failure (set to 1 when failure symptom is detected)" UWORD _CNV_S_16_RANGE_ERR__485_CM 1 100. 0. 15. DISPLAY_IDENTIFIER ERR_SYM_TOUT_ETCU_1 ECU_ADDRESS 0xd00045ca BIT_MASK 0x780 /end MEASUREMENT
/begin MEASUREMENT fmy_stat_tout_etcu_2.ctr_abc "anti-bounce counter for diagnosis XX" UBYTE _CNV_A_R_LINEAR_____0_CM 1 100. 0. 255. DISPLAY_IDENTIFIER CTR_ABC_TOUT_ETCU_2 ECU_ADDRESS 0xd00045cc FORMAT "%3.0" /end MEASUREMENT
/begin MEASUREMENT fmy_stat_tout_etcu_2.ctr_end_diag "Counter for the end of diagnosis XX generation" UBYTE _CNV_A_R_LINEAR_____0_CM 1 100. 0. 255. DISPLAY_IDENTIFIER CTR_ABC_END_DIAG_TOUT_ETCU_2 ECU_ADDRESS 0xd00045cd FORMAT "%3.0" /end MEASUREMENT
/begin MEASUREMENT fmy_stat_tout_etcu_2.err_info_stat.lv_err_mem "Failure is stored in dynamic memory (2nd layer)" UWORD _CNV_S_2_RANGE__0___1_CM 1 100. 0. 1. DISPLAY_IDENTIFIER LV_ERR_MEM_TOUT_ETCU_2 ECU_ADDRESS 0xd00045ce BIT_MASK 0x8 /end MEASUREMENT
/begin MEASUREMENT fmy_stat_tout_etcu_2.err_info_stat.lv_ready "Readiness flag related to diagnosis XX" UWORD _CNV_S_2_RANGE__0___1_CM 1 100. 0. 1. DISPLAY_IDENTIFIER LV_READY_TOUT_ETCU_2 ECU_ADDRESS 0xd00045ce BIT_MASK 0x10 /end MEASUREMENT
/begin MEASUREMENT fmy_stat_tout_etcu_2.err_info_stat.lv_end_diag "End of diagnosis XX" UWORD _CNV_S_2_RANGE__0___1_CM 1 100. 0. 1. DISPLAY_IDENTIFIER LV_END_DIAG_TOUT_ETCU_2 ECU_ADDRESS 0xd00045ce BIT_MASK 0x20 /end MEASUREMENT
/begin MEASUREMENT fmy_stat_tout_etcu_2.err_info_stat.lv_cdn_diag "Diagnosis condition to start symptom detection (set to 1 when condition is fulfilled)" UWORD _CNV_S_2_RANGE__0___1_CM 1 100. 0. 1. DISPLAY_IDENTIFIER LV_CDN_DIAG_TOUT_ETCU_2 ECU_ADDRESS 0xd00045ce BIT_MASK 0x40 /end MEASUREMENT
/begin MEASUREMENT fmy_stat_tout_etcu_2.err_info_stat.err_sym "For each symptom: status of failure (set to 1 when failure symptom is detected)" UWORD _CNV_S_16_RANGE_ERR__485_CM 1 100. 0. 15. DISPLAY_IDENTIFIER ERR_SYM_TOUT_ETCU_2 ECU_ADDRESS 0xd00045ce BIT_MASK 0x780 /end MEASUREMENT
/begin MEASUREMENT fmy_stat_tout_icl_2.ctr_abc "anti-bounce counter for diagnosis XX" UBYTE _CNV_A_R_LINEAR_____0_CM 1 100. 0. 255. DISPLAY_IDENTIFIER CTR_ABC_TOUT_ICL_2 ECU_ADDRESS 0xd00045d0 FORMAT "%3.0" /end MEASUREMENT
/begin MEASUREMENT fmy_stat_tout_icl_2.ctr_end_diag "Counter for the end of diagnosis XX generation" UBYTE _CNV_A_R_LINEAR_____0_CM 1 100. 0. 255. DISPLAY_IDENTIFIER CTR_ABC_END_DIAG_TOUT_ICL_2 ECU_ADDRESS 0xd00045d1 FORMAT "%3.0" /end MEASUREMENT
/begin MEASUREMENT fmy_stat_tout_icl_2.err_info_stat.lv_err_mem "Failure is stored in dynamic memory (2nd layer)" UWORD _CNV_S_2_RANGE__0___1_CM 1 100. 0. 1. DISPLAY_IDENTIFIER LV_ERR_MEM_TOUT_ICL_2 ECU_ADDRESS 0xd00045d2 BIT_MASK 0x8 /end MEASUREMENT
/begin MEASUREMENT fmy_stat_tout_icl_2.err_info_stat.lv_ready "Readiness flag related to diagnosis XX" UWORD _CNV_S_2_RANGE__0___1_CM 1 100. 0. 1. DISPLAY_IDENTIFIER LV_READY_TOUT_ICL_2 ECU_ADDRESS 0xd00045d2 BIT_MASK 0x10 /end MEASUREMENT
/begin MEASUREMENT fmy_stat_tout_icl_2.err_info_stat.lv_end_diag "End of diagnosis XX" UWORD _CNV_S_2_RANGE__0___1_CM 1 100. 0. 1. DISPLAY_IDENTIFIER LV_END_DIAG_TOUT_ICL_2 ECU_ADDRESS 0xd00045d2 BIT_MASK 0x20 /end MEASUREMENT
/begin MEASUREMENT fmy_stat_tout_icl_2.err_info_stat.lv_cdn_diag "Diagnosis condition to start symptom detection (set to 1 when condition is fulfilled)" UWORD _CNV_S_2_RANGE__0___1_CM 1 100. 0. 1. DISPLAY_IDENTIFIER LV_CDN_DIAG_TOUT_ICL_2 ECU_ADDRESS 0xd00045d2 BIT_MASK 0x40 /end MEASUREMENT
/begin MEASUREMENT fmy_stat_tout_icl_2.err_info_stat.err_sym "For each symptom: status of failure (set to 1 when failure symptom is detected)" UWORD _CNV_S_16_RANGE_ERR__485_CM 1 100. 0. 15. DISPLAY_IDENTIFIER ERR_SYM_TOUT_ICL_2 ECU_ADDRESS 0xd00045d2 BIT_MASK 0x780 /end MEASUREMENT
/begin MEASUREMENT fmy_stat_tout_icl_3.ctr_abc "anti-bounce counter for diagnosis XX" UBYTE _CNV_A_R_LINEAR_____0_CM 1 100. 0. 255. DISPLAY_IDENTIFIER CTR_ABC_TOUT_ICL_3 ECU_ADDRESS 0xd00045d4 FORMAT "%3.0" /end MEASUREMENT
/begin MEASUREMENT fmy_stat_tout_icl_3.ctr_end_diag "Counter for the end of diagnosis XX generation" UBYTE _CNV_A_R_LINEAR_____0_CM 1 100. 0. 255. DISPLAY_IDENTIFIER CTR_ABC_END_DIAG_TOUT_ICL_3 ECU_ADDRESS 0xd00045d5 FORMAT "%3.0" /end MEASUREMENT
/begin MEASUREMENT fmy_stat_tout_icl_3.err_info_stat.lv_err_mem "Failure is stored in dynamic memory (2nd layer)" UWORD _CNV_S_2_RANGE__0___1_CM 1 100. 0. 1. DISPLAY_IDENTIFIER LV_ERR_MEM_TOUT_ICL_3 ECU_ADDRESS 0xd00045d6 BIT_MASK 0x8 /end MEASUREMENT
/begin MEASUREMENT fmy_stat_tout_icl_3.err_info_stat.lv_ready "Readiness flag related to diagnosis XX" UWORD _CNV_S_2_RANGE__0___1_CM 1 100. 0. 1. DISPLAY_IDENTIFIER LV_READY_TOUT_ICL_3 ECU_ADDRESS 0xd00045d6 BIT_MASK 0x10 /end MEASUREMENT
/begin MEASUREMENT fmy_stat_tout_icl_3.err_info_stat.lv_end_diag "End of diagnosis XX" UWORD _CNV_S_2_RANGE__0___1_CM 1 100. 0. 1. DISPLAY_IDENTIFIER LV_END_DIAG_TOUT_ICL_3 ECU_ADDRESS 0xd00045d6 BIT_MASK 0x20 /end MEASUREMENT
/begin MEASUREMENT fmy_stat_tout_icl_3.err_info_stat.lv_cdn_diag "Diagnosis condition to start symptom detection (set to 1 when condition is fulfilled)" UWORD _CNV_S_2_RANGE__0___1_CM 1 100. 0. 1. DISPLAY_IDENTIFIER LV_CDN_DIAG_TOUT_ICL_3 ECU_ADDRESS 0xd00045d6 BIT_MASK 0x40 /end MEASUREMENT
/begin MEASUREMENT fmy_stat_tout_icl_3.err_info_stat.err_sym "For each symptom: status of failure (set to 1 when failure symptom is detected)" UWORD _CNV_S_16_RANGE_ERR__485_CM 1 100. 0. 15. DISPLAY_IDENTIFIER ERR_SYM_TOUT_ICL_3 ECU_ADDRESS 0xd00045d6 BIT_MASK 0x780 /end MEASUREMENT
/begin MEASUREMENT fmy_stat_tout_asr_1.ctr_abc "anti-bounce counter for diagnosis XX" UBYTE _CNV_A_R_LINEAR_____0_CM 1 100. 0. 255. DISPLAY_IDENTIFIER CTR_ABC_TOUT_ASR_1 ECU_ADDRESS 0xd00045b8 FORMAT "%3.0" /end MEASUREMENT
/begin MEASUREMENT fmy_stat_tout_asr_1.ctr_end_diag "Counter for the end of diagnosis XX generation" UBYTE _CNV_A_R_LINEAR_____0_CM 1 100. 0. 255. DISPLAY_IDENTIFIER CTR_ABC_END_DIAG_TOUT_ASR_1 ECU_ADDRESS 0xd00045b9 FORMAT "%3.0" /end MEASUREMENT
/begin MEASUREMENT fmy_stat_tout_asr_1.err_info_stat.lv_err_mem "Failure is stored in dynamic memory (2nd layer)" UWORD _CNV_S_2_RANGE__0___1_CM 1 100. 0. 1. DISPLAY_IDENTIFIER LV_ERR_MEM_TOUT_ASR_1 ECU_ADDRESS 0xd00045ba BIT_MASK 0x8 /end MEASUREMENT
/begin MEASUREMENT fmy_stat_tout_asr_1.err_info_stat.lv_ready "Readiness flag related to diagnosis XX" UWORD _CNV_S_2_RANGE__0___1_CM 1 100. 0. 1. DISPLAY_IDENTIFIER LV_READY_TOUT_ASR_1 ECU_ADDRESS 0xd00045ba BIT_MASK 0x10 /end MEASUREMENT
/begin MEASUREMENT fmy_stat_tout_asr_1.err_info_stat.lv_end_diag "End of diagnosis XX" UWORD _CNV_S_2_RANGE__0___1_CM 1 100. 0. 1. DISPLAY_IDENTIFIER LV_END_DIAG_TOUT_ASR_1 ECU_ADDRESS 0xd00045ba BIT_MASK 0x20 /end MEASUREMENT
/begin MEASUREMENT fmy_stat_tout_asr_1.err_info_stat.lv_cdn_diag "Diagnosis condition to start symptom detection (set to 1 when condition is fulfilled)" UWORD _CNV_S_2_RANGE__0___1_CM 1 100. 0. 1. DISPLAY_IDENTIFIER LV_CDN_DIAG_TOUT_ASR_1 ECU_ADDRESS 0xd00045ba BIT_MASK 0x40 /end MEASUREMENT
/begin MEASUREMENT fmy_stat_tout_asr_1.err_info_stat.err_sym "For each symptom: status of failure (set to 1 when failure symptom is detected)" UWORD _CNV_S_16_RANGE_ERR__485_CM 1 100. 0. 15. DISPLAY_IDENTIFIER ERR_SYM_TOUT_ASR_1 ECU_ADDRESS 0xd00045ba BIT_MASK 0x780 /end MEASUREMENT
/begin MEASUREMENT fmy_stat_tout_asr_3.ctr_abc "anti-bounce counter for diagnosis XX" UBYTE _CNV_A_R_LINEAR_____0_CM 1 100. 0. 255. DISPLAY_IDENTIFIER CTR_ABC_TOUT_ASR_3 ECU_ADDRESS 0xd00045bc FORMAT "%3.0" /end MEASUREMENT
/begin MEASUREMENT fmy_stat_tout_asr_3.ctr_end_diag "Counter for the end of diagnosis XX generation" UBYTE _CNV_A_R_LINEAR_____0_CM 1 100. 0. 255. DISPLAY_IDENTIFIER CTR_ABC_END_DIAG_TOUT_ASR_3 ECU_ADDRESS 0xd00045bd FORMAT "%3.0" /end MEASUREMENT
/begin MEASUREMENT fmy_stat_tout_asr_3.err_info_stat.lv_err_mem "Failure is stored in dynamic memory (2nd layer)" UWORD _CNV_S_2_RANGE__0___1_CM 1 100. 0. 1. DISPLAY_IDENTIFIER LV_ERR_MEM_TOUT_ASR_3 ECU_ADDRESS 0xd00045be BIT_MASK 0x8 /end MEASUREMENT
/begin MEASUREMENT fmy_stat_tout_asr_3.err_info_stat.lv_ready "Readiness flag related to diagnosis XX" UWORD _CNV_S_2_RANGE__0___1_CM 1 100. 0. 1. DISPLAY_IDENTIFIER LV_READY_TOUT_ASR_3 ECU_ADDRESS 0xd00045be BIT_MASK 0x10 /end MEASUREMENT
/begin MEASUREMENT fmy_stat_tout_asr_3.err_info_stat.lv_end_diag "End of diagnosis XX" UWORD _CNV_S_2_RANGE__0___1_CM 1 100. 0. 1. DISPLAY_IDENTIFIER LV_END_DIAG_TOUT_ASR_3 ECU_ADDRESS 0xd00045be BIT_MASK 0x20 /end MEASUREMENT
/begin MEASUREMENT fmy_stat_tout_asr_3.err_info_stat.lv_cdn_diag "Diagnosis condition to start symptom detection (set to 1 when condition is fulfilled)" UWORD _CNV_S_2_RANGE__0___1_CM 1 100. 0. 1. DISPLAY_IDENTIFIER LV_CDN_DIAG_TOUT_ASR_3 ECU_ADDRESS 0xd00045be BIT_MASK 0x40 /end MEASUREMENT
/begin MEASUREMENT fmy_stat_tout_asr_3.err_info_stat.err_sym "For each symptom: status of failure (set to 1 when failure symptom is detected)" UWORD _CNV_S_16_RANGE_ERR__485_CM 1 100. 0. 15. DISPLAY_IDENTIFIER ERR_SYM_TOUT_ASR_3 ECU_ADDRESS 0xd00045be BIT_MASK 0x780 /end MEASUREMENT
/begin MEASUREMENT fmy_stat_tout_asr_4.ctr_abc "anti-bounce counter for diagnosis XX" UBYTE _CNV_A_R_LINEAR_____0_CM 1 100. 0. 255. DISPLAY_IDENTIFIER CTR_ABC_TOUT_ASR_4 ECU_ADDRESS 0xd00045c0 FORMAT "%3.0" /end MEASUREMENT
/begin MEASUREMENT fmy_stat_tout_asr_4.ctr_end_diag "Counter for the end of diagnosis XX generation" UBYTE _CNV_A_R_LINEAR_____0_CM 1 100. 0. 255. DISPLAY_IDENTIFIER CTR_ABC_END_DIAG_TOUT_ASR_4 ECU_ADDRESS 0xd00045c1 FORMAT "%3.0" /end MEASUREMENT
/begin MEASUREMENT fmy_stat_tout_asr_4.err_info_stat.lv_err_mem "Failure is stored in dynamic memory (2nd layer)" UWORD _CNV_S_2_RANGE__0___1_CM 1 100. 0. 1. DISPLAY_IDENTIFIER LV_ERR_MEM_TOUT_ASR_4 ECU_ADDRESS 0xd00045c2 BIT_MASK 0x8 /end MEASUREMENT
/begin MEASUREMENT fmy_stat_tout_asr_4.err_info_stat.lv_ready "Readiness flag related to diagnosis XX" UWORD _CNV_S_2_RANGE__0___1_CM 1 100. 0. 1. DISPLAY_IDENTIFIER LV_READY_TOUT_ASR_4 ECU_ADDRESS 0xd00045c2 BIT_MASK 0x10 /end MEASUREMENT
/begin MEASUREMENT fmy_stat_tout_asr_4.err_info_stat.lv_end_diag "End of diagnosis XX" UWORD _CNV_S_2_RANGE__0___1_CM 1 100. 0. 1. DISPLAY_IDENTIFIER LV_END_DIAG_TOUT_ASR_4 ECU_ADDRESS 0xd00045c2 BIT_MASK 0x20 /end MEASUREMENT
/begin MEASUREMENT fmy_stat_tout_asr_4.err_info_stat.lv_cdn_diag "Diagnosis condition to start symptom detection (set to 1 when condition is fulfilled)" UWORD _CNV_S_2_RANGE__0___1_CM 1 100. 0. 1. DISPLAY_IDENTIFIER LV_CDN_DIAG_TOUT_ASR_4 ECU_ADDRESS 0xd00045c2 BIT_MASK 0x40 /end MEASUREMENT
/begin MEASUREMENT fmy_stat_tout_asr_4.err_info_stat.err_sym "For each symptom: status of failure (set to 1 when failure symptom is detected)" UWORD _CNV_S_16_RANGE_ERR__485_CM 1 100. 0. 15. DISPLAY_IDENTIFIER ERR_SYM_TOUT_ASR_4 ECU_ADDRESS 0xd00045c2 BIT_MASK 0x780 /end MEASUREMENT
/begin MEASUREMENT fmy_stat_tout_pste_1.ctr_abc "anti-bounce counter for diagnosis XX" UBYTE _CNV_A_R_LINEAR_____0_CM 1 100. 0. 255. DISPLAY_IDENTIFIER CTR_ABC_TOUT_PSTE_1 ECU_ADDRESS 0xd00045e0 FORMAT "%3.0" /end MEASUREMENT
/begin MEASUREMENT fmy_stat_tout_pste_1.ctr_end_diag "Counter for the end of diagnosis XX generation" UBYTE _CNV_A_R_LINEAR_____0_CM 1 100. 0. 255. DISPLAY_IDENTIFIER CTR_ABC_END_DIAG_TOUT_PSTE_1 ECU_ADDRESS 0xd00045e1 FORMAT "%3.0" /end MEASUREMENT
/begin MEASUREMENT fmy_stat_tout_pste_1.err_info_stat.lv_err_mem "Failure is stored in dynamic memory (2nd layer)" UWORD _CNV_S_2_RANGE__0___1_CM 1 100. 0. 1. DISPLAY_IDENTIFIER LV_ERR_MEM_TOUT_PSTE_1 ECU_ADDRESS 0xd00045e2 BIT_MASK 0x8 /end MEASUREMENT
/begin MEASUREMENT fmy_stat_tout_pste_1.err_info_stat.lv_ready "Readiness flag related to diagnosis XX" UWORD _CNV_S_2_RANGE__0___1_CM 1 100. 0. 1. DISPLAY_IDENTIFIER LV_READY_TOUT_PSTE_1 ECU_ADDRESS 0xd00045e2 BIT_MASK 0x10 /end MEASUREMENT
/begin MEASUREMENT fmy_stat_tout_pste_1.err_info_stat.lv_end_diag "End of diagnosis XX" UWORD _CNV_S_2_RANGE__0___1_CM 1 100. 0. 1. DISPLAY_IDENTIFIER LV_END_DIAG_TOUT_PSTE_1 ECU_ADDRESS 0xd00045e2 BIT_MASK 0x20 /end MEASUREMENT
/begin MEASUREMENT fmy_stat_tout_pste_1.err_info_stat.lv_cdn_diag "Diagnosis condition to start symptom detection (set to 1 when condition is fulfilled)" UWORD _CNV_S_2_RANGE__0___1_CM 1 100. 0. 1. DISPLAY_IDENTIFIER LV_CDN_DIAG_TOUT_PSTE_1 ECU_ADDRESS 0xd00045e2 BIT_MASK 0x40 /end MEASUREMENT
/begin MEASUREMENT fmy_stat_tout_pste_1.err_info_stat.err_sym "For each symptom: status of failure (set to 1 when failure symptom is detected)" UWORD _CNV_S_16_RANGE_ERR__485_CM 1 100. 0. 15. DISPLAY_IDENTIFIER ERR_SYM_TOUT_PSTE_1 ECU_ADDRESS 0xd00045e2 BIT_MASK 0x780 /end MEASUREMENT
/begin MEASUREMENT fmy_stat_tout_amt_1.ctr_abc "anti-bounce counter for diagnosis XX" UBYTE _CNV_A_R_LINEAR_____0_CM 1 100. 0. 255. DISPLAY_IDENTIFIER CTR_ABC_TOUT_AMT_1 ECU_ADDRESS 0xd00045b4 FORMAT "%3.0" /end MEASUREMENT
/begin MEASUREMENT fmy_stat_tout_amt_1.ctr_end_diag "Counter for the end of diagnosis XX generation" UBYTE _CNV_A_R_LINEAR_____0_CM 1 100. 0. 255. DISPLAY_IDENTIFIER CTR_ABC_END_DIAG_TOUT_AMT_1 ECU_ADDRESS 0xd00045b5 FORMAT "%3.0" /end MEASUREMENT
/begin MEASUREMENT fmy_stat_tout_amt_1.err_info_stat.lv_err_mem "Failure is stored in dynamic memory (2nd layer)" UWORD _CNV_S_2_RANGE__0___1_CM 1 100. 0. 1. DISPLAY_IDENTIFIER LV_ERR_MEM_TOUT_AMT_1 ECU_ADDRESS 0xd00045b6 BIT_MASK 0x8 /end MEASUREMENT
/begin MEASUREMENT fmy_stat_tout_amt_1.err_info_stat.lv_ready "Readiness flag related to diagnosis XX" UWORD _CNV_S_2_RANGE__0___1_CM 1 100. 0. 1. DISPLAY_IDENTIFIER LV_READY_TOUT_AMT_1 ECU_ADDRESS 0xd00045b6 BIT_MASK 0x10 /end MEASUREMENT
/begin MEASUREMENT fmy_stat_tout_amt_1.err_info_stat.lv_end_diag "End of diagnosis XX" UWORD _CNV_S_2_RANGE__0___1_CM 1 100. 0. 1. DISPLAY_IDENTIFIER LV_END_DIAG_TOUT_AMT_1 ECU_ADDRESS 0xd00045b6 BIT_MASK 0x20 /end MEASUREMENT
/begin MEASUREMENT fmy_stat_tout_amt_1.err_info_stat.lv_cdn_diag "Diagnosis condition to start symptom detection (set to 1 when condition is fulfilled)" UWORD _CNV_S_2_RANGE__0___1_CM 1 100. 0. 1. DISPLAY_IDENTIFIER LV_CDN_DIAG_TOUT_AMT_1 ECU_ADDRESS 0xd00045b6 BIT_MASK 0x40 /end MEASUREMENT
/begin MEASUREMENT fmy_stat_tout_amt_1.err_info_stat.err_sym "For each symptom: status of failure (set to 1 when failure symptom is detected)" UWORD _CNV_S_16_RANGE_ERR__485_CM 1 100. 0. 15. DISPLAY_IDENTIFIER ERR_SYM_TOUT_AMT_1 ECU_ADDRESS 0xd00045b6 BIT_MASK 0x780 /end MEASUREMENT
/begin MEASUREMENT fmy_stat_vs.ctr_abc "anti-bounce counter for diagnosis XX" UBYTE _CNV_A_R_LINEAR_____0_CM 1 100. 0. 255. DISPLAY_IDENTIFIER CTR_ABC_VS ECU_ADDRESS 0xd0004658 FORMAT "%3.0" /end MEASUREMENT
/begin MEASUREMENT fmy_stat_vs.ctr_end_diag "Counter for the end of diagnosis XX generation" UBYTE _CNV_A_R_LINEAR_____0_CM 1 100. 0. 255. DISPLAY_IDENTIFIER CTR_ABC_END_DIAG_VS ECU_ADDRESS 0xd0004659 FORMAT "%3.0" /end MEASUREMENT
/begin MEASUREMENT fmy_stat_vs.err_info_stat.lv_err_mem "Failure is stored in dynamic memory (2nd layer)" UWORD _CNV_S_2_RANGE__0___1_CM 1 100. 0. 1. DISPLAY_IDENTIFIER LV_ERR_MEM_VS ECU_ADDRESS 0xd000465a BIT_MASK 0x8 /end MEASUREMENT
/begin MEASUREMENT fmy_stat_vs.err_info_stat.lv_ready "Readiness flag related to diagnosis XX" UWORD _CNV_S_2_RANGE__0___1_CM 1 100. 0. 1. DISPLAY_IDENTIFIER LV_READY_VS ECU_ADDRESS 0xd000465a BIT_MASK 0x10 /end MEASUREMENT
/begin MEASUREMENT fmy_stat_vs.err_info_stat.lv_end_diag "End of diagnosis XX" UWORD _CNV_S_2_RANGE__0___1_CM 1 100. 0. 1. DISPLAY_IDENTIFIER LV_END_DIAG_VS ECU_ADDRESS 0xd000465a BIT_MASK 0x20 /end MEASUREMENT
/begin MEASUREMENT fmy_stat_vs.err_info_stat.lv_cdn_diag "Diagnosis condition to start symptom detection (set to 1 when condition is fulfilled)" UWORD _CNV_S_2_RANGE__0___1_CM 1 100. 0. 1. DISPLAY_IDENTIFIER LV_CDN_DIAG_VS ECU_ADDRESS 0xd000465a BIT_MASK 0x40 /end MEASUREMENT
/begin MEASUREMENT fmy_stat_vs.err_info_stat.err_sym "For each symptom: status of failure (set to 1 when failure symptom is detected)" UWORD _CNV_S_16_RANGE_ERR__485_CM 1 100. 0. 15. DISPLAY_IDENTIFIER ERR_SYM_VS ECU_ADDRESS 0xd000465a BIT_MASK 0x780 /end MEASUREMENT
/begin MEASUREMENT fmy_stat_knks_1.ctr_abc "anti-bounce counter for diagnosis XX" UBYTE _CNV_A_R_LINEAR_____0_CM 1 100. 0. 255. DISPLAY_IDENTIFIER CTR_ABC_KNKS_1 ECU_ADDRESS 0xd00043c0 FORMAT "%3.0" /end MEASUREMENT
/begin MEASUREMENT fmy_stat_knks_1.ctr_end_diag "Counter for the end of diagnosis XX generation" UBYTE _CNV_A_R_LINEAR_____0_CM 1 100. 0. 255. DISPLAY_IDENTIFIER CTR_ABC_END_DIAG_KNKS_1 ECU_ADDRESS 0xd00043c1 FORMAT "%3.0" /end MEASUREMENT
/begin MEASUREMENT fmy_stat_knks_1.err_info_stat.lv_err_mem "Failure is stored in dynamic memory (2nd layer)" UWORD _CNV_S_2_RANGE__0___1_CM 1 100. 0. 1. DISPLAY_IDENTIFIER LV_ERR_MEM_KNKS_1 ECU_ADDRESS 0xd00043c2 BIT_MASK 0x8 /end MEASUREMENT
/begin MEASUREMENT fmy_stat_knks_1.err_info_stat.lv_ready "Readiness flag related to diagnosis XX" UWORD _CNV_S_2_RANGE__0___1_CM 1 100. 0. 1. DISPLAY_IDENTIFIER LV_READY_KNKS_1 ECU_ADDRESS 0xd00043c2 BIT_MASK 0x10 /end MEASUREMENT
/begin MEASUREMENT fmy_stat_knks_1.err_info_stat.lv_end_diag "End of diagnosis XX" UWORD _CNV_S_2_RANGE__0___1_CM 1 100. 0. 1. DISPLAY_IDENTIFIER LV_END_DIAG_KNKS_1 ECU_ADDRESS 0xd00043c2 BIT_MASK 0x20 /end MEASUREMENT
/begin MEASUREMENT fmy_stat_knks_1.err_info_stat.lv_cdn_diag "Diagnosis condition to start symptom detection (set to 1 when condition is fulfilled)" UWORD _CNV_S_2_RANGE__0___1_CM 1 100. 0. 1. DISPLAY_IDENTIFIER LV_CDN_DIAG_KNKS_1 ECU_ADDRESS 0xd00043c2 BIT_MASK 0x40 /end MEASUREMENT
/begin MEASUREMENT fmy_stat_knks_1.err_info_stat.err_sym "For each symptom: status of failure (set to 1 when failure symptom is detected)" UWORD _CNV_S_16_RANGE_ERR__485_CM 1 100. 0. 15. DISPLAY_IDENTIFIER ERR_SYM_KNKS_1 ECU_ADDRESS 0xd00043c2 BIT_MASK 0x780 /end MEASUREMENT
/begin MEASUREMENT fmy_stat_knks_2.ctr_abc "anti-bounce counter for diagnosis XX" UBYTE _CNV_A_R_LINEAR_____0_CM 1 100. 0. 255. DISPLAY_IDENTIFIER CTR_ABC_KNKS_2 ECU_ADDRESS 0xd00043c4 FORMAT "%3.0" /end MEASUREMENT
/begin MEASUREMENT fmy_stat_knks_2.ctr_end_diag "Counter for the end of diagnosis XX generation" UBYTE _CNV_A_R_LINEAR_____0_CM 1 100. 0. 255. DISPLAY_IDENTIFIER CTR_ABC_END_DIAG_KNKS_2 ECU_ADDRESS 0xd00043c5 FORMAT "%3.0" /end MEASUREMENT
/begin MEASUREMENT fmy_stat_knks_2.err_info_stat.lv_err_mem "Failure is stored in dynamic memory (2nd layer)" UWORD _CNV_S_2_RANGE__0___1_CM 1 100. 0. 1. DISPLAY_IDENTIFIER LV_ERR_MEM_KNKS_2 ECU_ADDRESS 0xd00043c6 BIT_MASK 0x8 /end MEASUREMENT
/begin MEASUREMENT fmy_stat_knks_2.err_info_stat.lv_ready "Readiness flag related to diagnosis XX" UWORD _CNV_S_2_RANGE__0___1_CM 1 100. 0. 1. DISPLAY_IDENTIFIER LV_READY_KNKS_2 ECU_ADDRESS 0xd00043c6 BIT_MASK 0x10 /end MEASUREMENT
/begin MEASUREMENT fmy_stat_knks_2.err_info_stat.lv_end_diag "End of diagnosis XX" UWORD _CNV_S_2_RANGE__0___1_CM 1 100. 0. 1. DISPLAY_IDENTIFIER LV_END_DIAG_KNKS_2 ECU_ADDRESS 0xd00043c6 BIT_MASK 0x20 /end MEASUREMENT
/begin MEASUREMENT fmy_stat_knks_2.err_info_stat.lv_cdn_diag "Diagnosis condition to start symptom detection (set to 1 when condition is fulfilled)" UWORD _CNV_S_2_RANGE__0___1_CM 1 100. 0. 1. DISPLAY_IDENTIFIER LV_CDN_DIAG_KNKS_2 ECU_ADDRESS 0xd00043c6 BIT_MASK 0x40 /end MEASUREMENT
/begin MEASUREMENT fmy_stat_knks_2.err_info_stat.err_sym "For each symptom: status of failure (set to 1 when failure symptom is detected)" UWORD _CNV_S_16_RANGE_ERR__485_CM 1 100. 0. 15. DISPLAY_IDENTIFIER ERR_SYM_KNKS_2 ECU_ADDRESS 0xd00043c6 BIT_MASK 0x780 /end MEASUREMENT
/begin MEASUREMENT fmy_stat_igc_scp_0.ctr_abc "anti-bounce counter for diagnosis XX" UBYTE _CNV_A_R_LINEAR_____0_CM 1 100. 0. 255. DISPLAY_IDENTIFIER CTR_ABC_IGC_SCP_0 ECU_ADDRESS 0xd0004378 FORMAT "%3.0" /end MEASUREMENT
/begin MEASUREMENT fmy_stat_igc_scp_0.ctr_end_diag "Counter for the end of diagnosis XX generation" UBYTE _CNV_A_R_LINEAR_____0_CM 1 100. 0. 255. DISPLAY_IDENTIFIER CTR_ABC_END_DIAG_IGC_SCP_0 ECU_ADDRESS 0xd0004379 FORMAT "%3.0" /end MEASUREMENT
/begin MEASUREMENT fmy_stat_igc_scp_0.err_info_stat.lv_err_mem "Failure is stored in dynamic memory (2nd layer)" UWORD _CNV_S_2_RANGE__0___1_CM 1 100. 0. 1. DISPLAY_IDENTIFIER LV_ERR_MEM_IGC_SCP_0 ECU_ADDRESS 0xd000437a BIT_MASK 0x8 /end MEASUREMENT
/begin MEASUREMENT fmy_stat_igc_scp_0.err_info_stat.lv_ready "Readiness flag related to diagnosis XX" UWORD _CNV_S_2_RANGE__0___1_CM 1 100. 0. 1. DISPLAY_IDENTIFIER LV_READY_IGC_SCP_0 ECU_ADDRESS 0xd000437a BIT_MASK 0x10 /end MEASUREMENT
/begin MEASUREMENT fmy_stat_igc_scp_0.err_info_stat.lv_end_diag "End of diagnosis XX" UWORD _CNV_S_2_RANGE__0___1_CM 1 100. 0. 1. DISPLAY_IDENTIFIER LV_END_DIAG_IGC_SCP_0 ECU_ADDRESS 0xd000437a BIT_MASK 0x20 /end MEASUREMENT
/begin MEASUREMENT fmy_stat_igc_scp_0.err_info_stat.lv_cdn_diag "Diagnosis condition to start symptom detection (set to 1 when condition is fulfilled)" UWORD _CNV_S_2_RANGE__0___1_CM 1 100. 0. 1. DISPLAY_IDENTIFIER LV_CDN_DIAG_IGC_SCP_0 ECU_ADDRESS 0xd000437a BIT_MASK 0x40 /end MEASUREMENT
/begin MEASUREMENT fmy_stat_igc_scp_0.err_info_stat.err_sym "For each symptom: status of failure (set to 1 when failure symptom is detected)" UWORD _CNV_S_16_RANGE_ERR__485_CM 1 100. 0. 15. DISPLAY_IDENTIFIER ERR_SYM_IGC_SCP_0 ECU_ADDRESS 0xd000437a BIT_MASK 0x780 /end MEASUREMENT
/begin MEASUREMENT fmy_stat_igc_scp_1.ctr_abc "anti-bounce counter for diagnosis XX" UBYTE _CNV_A_R_LINEAR_____0_CM 1 100. 0. 255. DISPLAY_IDENTIFIER CTR_ABC_IGC_SCP_1 ECU_ADDRESS 0xd000437c FORMAT "%3.0" /end MEASUREMENT
/begin MEASUREMENT fmy_stat_igc_scp_1.ctr_end_diag "Counter for the end of diagnosis XX generation" UBYTE _CNV_A_R_LINEAR_____0_CM 1 100. 0. 255. DISPLAY_IDENTIFIER CTR_ABC_END_DIAG_IGC_SCP_1 ECU_ADDRESS 0xd000437d FORMAT "%3.0" /end MEASUREMENT
/begin MEASUREMENT fmy_stat_igc_scp_1.err_info_stat.lv_err_mem "Failure is stored in dynamic memory (2nd layer)" UWORD _CNV_S_2_RANGE__0___1_CM 1 100. 0. 1. DISPLAY_IDENTIFIER LV_ERR_MEM_IGC_SCP_1 ECU_ADDRESS 0xd000437e BIT_MASK 0x8 /end MEASUREMENT
/begin MEASUREMENT fmy_stat_igc_scp_1.err_info_stat.lv_ready "Readiness flag related to diagnosis XX" UWORD _CNV_S_2_RANGE__0___1_CM 1 100. 0. 1. DISPLAY_IDENTIFIER LV_READY_IGC_SCP_1 ECU_ADDRESS 0xd000437e BIT_MASK 0x10 /end MEASUREMENT
/begin MEASUREMENT fmy_stat_igc_scp_1.err_info_stat.lv_end_diag "End of diagnosis XX" UWORD _CNV_S_2_RANGE__0___1_CM 1 100. 0. 1. DISPLAY_IDENTIFIER LV_END_DIAG_IGC_SCP_1 ECU_ADDRESS 0xd000437e BIT_MASK 0x20 /end MEASUREMENT
/begin MEASUREMENT fmy_stat_igc_scp_1.err_info_stat.lv_cdn_diag "Diagnosis condition to start symptom detection (set to 1 when condition is fulfilled)" UWORD _CNV_S_2_RANGE__0___1_CM 1 100. 0. 1. DISPLAY_IDENTIFIER LV_CDN_DIAG_IGC_SCP_1 ECU_ADDRESS 0xd000437e BIT_MASK 0x40 /end MEASUREMENT
/begin MEASUREMENT fmy_stat_igc_scp_1.err_info_stat.err_sym "For each symptom: status of failure (set to 1 when failure symptom is detected)" UWORD _CNV_S_16_RANGE_ERR__485_CM 1 100. 0. 15. DISPLAY_IDENTIFIER ERR_SYM_IGC_SCP_1 ECU_ADDRESS 0xd000437e BIT_MASK 0x780 /end MEASUREMENT
/begin MEASUREMENT fmy_stat_igc_scp_2.ctr_abc "anti-bounce counter for diagnosis XX" UBYTE _CNV_A_R_LINEAR_____0_CM 1 100. 0. 255. DISPLAY_IDENTIFIER CTR_ABC_IGC_SCP_2 ECU_ADDRESS 0xd0004380 FORMAT "%3.0" /end MEASUREMENT
/begin MEASUREMENT fmy_stat_igc_scp_2.ctr_end_diag "Counter for the end of diagnosis XX generation" UBYTE _CNV_A_R_LINEAR_____0_CM 1 100. 0. 255. DISPLAY_IDENTIFIER CTR_ABC_END_DIAG_IGC_SCP_2 ECU_ADDRESS 0xd0004381 FORMAT "%3.0" /end MEASUREMENT
/begin MEASUREMENT fmy_stat_igc_scp_2.err_info_stat.lv_err_mem "Failure is stored in dynamic memory (2nd layer)" UWORD _CNV_S_2_RANGE__0___1_CM 1 100. 0. 1. DISPLAY_IDENTIFIER LV_ERR_MEM_IGC_SCP_2 ECU_ADDRESS 0xd0004382 BIT_MASK 0x8 /end MEASUREMENT
/begin MEASUREMENT fmy_stat_igc_scp_2.err_info_stat.lv_ready "Readiness flag related to diagnosis XX" UWORD _CNV_S_2_RANGE__0___1_CM 1 100. 0. 1. DISPLAY_IDENTIFIER LV_READY_IGC_SCP_2 ECU_ADDRESS 0xd0004382 BIT_MASK 0x10 /end MEASUREMENT
/begin MEASUREMENT fmy_stat_igc_scp_2.err_info_stat.lv_end_diag "End of diagnosis XX" UWORD _CNV_S_2_RANGE__0___1_CM 1 100. 0. 1. DISPLAY_IDENTIFIER LV_END_DIAG_IGC_SCP_2 ECU_ADDRESS 0xd0004382 BIT_MASK 0x20 /end MEASUREMENT
/begin MEASUREMENT fmy_stat_igc_scp_2.err_info_stat.lv_cdn_diag "Diagnosis condition to start symptom detection (set to 1 when condition is fulfilled)" UWORD _CNV_S_2_RANGE__0___1_CM 1 100. 0. 1. DISPLAY_IDENTIFIER LV_CDN_DIAG_IGC_SCP_2 ECU_ADDRESS 0xd0004382 BIT_MASK 0x40 /end MEASUREMENT
/begin MEASUREMENT fmy_stat_igc_scp_2.err_info_stat.err_sym "For each symptom: status of failure (set to 1 when failure symptom is detected)" UWORD _CNV_S_16_RANGE_ERR__485_CM 1 100. 0. 15. DISPLAY_IDENTIFIER ERR_SYM_IGC_SCP_2 ECU_ADDRESS 0xd0004382 BIT_MASK 0x780 /end MEASUREMENT
/begin MEASUREMENT fmy_stat_igc_scp_3.ctr_abc "anti-bounce counter for diagnosis XX" UBYTE _CNV_A_R_LINEAR_____0_CM 1 100. 0. 255. DISPLAY_IDENTIFIER CTR_ABC_IGC_SCP_3 ECU_ADDRESS 0xd0004384 FORMAT "%3.0" /end MEASUREMENT
/begin MEASUREMENT fmy_stat_igc_scp_3.ctr_end_diag "Counter for the end of diagnosis XX generation" UBYTE _CNV_A_R_LINEAR_____0_CM 1 100. 0. 255. DISPLAY_IDENTIFIER CTR_ABC_END_DIAG_IGC_SCP_3 ECU_ADDRESS 0xd0004385 FORMAT "%3.0" /end MEASUREMENT
/begin MEASUREMENT fmy_stat_igc_scp_3.err_info_stat.lv_err_mem "Failure is stored in dynamic memory (2nd layer)" UWORD _CNV_S_2_RANGE__0___1_CM 1 100. 0. 1. DISPLAY_IDENTIFIER LV_ERR_MEM_IGC_SCP_3 ECU_ADDRESS 0xd0004386 BIT_MASK 0x8 /end MEASUREMENT
/begin MEASUREMENT fmy_stat_igc_scp_3.err_info_stat.lv_ready "Readiness flag related to diagnosis XX" UWORD _CNV_S_2_RANGE__0___1_CM 1 100. 0. 1. DISPLAY_IDENTIFIER LV_READY_IGC_SCP_3 ECU_ADDRESS 0xd0004386 BIT_MASK 0x10 /end MEASUREMENT
/begin MEASUREMENT fmy_stat_igc_scp_3.err_info_stat.lv_end_diag "End of diagnosis XX" UWORD _CNV_S_2_RANGE__0___1_CM 1 100. 0. 1. DISPLAY_IDENTIFIER LV_END_DIAG_IGC_SCP_3 ECU_ADDRESS 0xd0004386 BIT_MASK 0x20 /end MEASUREMENT
/begin MEASUREMENT fmy_stat_igc_scp_3.err_info_stat.lv_cdn_diag "Diagnosis condition to start symptom detection (set to 1 when condition is fulfilled)" UWORD _CNV_S_2_RANGE__0___1_CM 1 100. 0. 1. DISPLAY_IDENTIFIER LV_CDN_DIAG_IGC_SCP_3 ECU_ADDRESS 0xd0004386 BIT_MASK 0x40 /end MEASUREMENT
/begin MEASUREMENT fmy_stat_igc_scp_3.err_info_stat.err_sym "For each symptom: status of failure (set to 1 when failure symptom is detected)" UWORD _CNV_S_16_RANGE_ERR__485_CM 1 100. 0. 15. DISPLAY_IDENTIFIER ERR_SYM_IGC_SCP_3 ECU_ADDRESS 0xd0004386 BIT_MASK 0x780 /end MEASUREMENT
/begin MEASUREMENT fmy_stat_igc_scp_4.ctr_abc "anti-bounce counter for diagnosis XX" UBYTE _CNV_A_R_LINEAR_____0_CM 1 100. 0. 255. DISPLAY_IDENTIFIER CTR_ABC_IGC_SCP_4 ECU_ADDRESS 0xd0004388 FORMAT "%3.0" /end MEASUREMENT
/begin MEASUREMENT fmy_stat_igc_scp_4.ctr_end_diag "Counter for the end of diagnosis XX generation" UBYTE _CNV_A_R_LINEAR_____0_CM 1 100. 0. 255. DISPLAY_IDENTIFIER CTR_ABC_END_DIAG_IGC_SCP_4 ECU_ADDRESS 0xd0004389 FORMAT "%3.0" /end MEASUREMENT
/begin MEASUREMENT fmy_stat_igc_scp_4.err_info_stat.lv_err_mem "Failure is stored in dynamic memory (2nd layer)" UWORD _CNV_S_2_RANGE__0___1_CM 1 100. 0. 1. DISPLAY_IDENTIFIER LV_ERR_MEM_IGC_SCP_4 ECU_ADDRESS 0xd000438a BIT_MASK 0x8 /end MEASUREMENT
/begin MEASUREMENT fmy_stat_igc_scp_4.err_info_stat.lv_ready "Readiness flag related to diagnosis XX" UWORD _CNV_S_2_RANGE__0___1_CM 1 100. 0. 1. DISPLAY_IDENTIFIER LV_READY_IGC_SCP_4 ECU_ADDRESS 0xd000438a BIT_MASK 0x10 /end MEASUREMENT
/begin MEASUREMENT fmy_stat_igc_scp_4.err_info_stat.lv_end_diag "End of diagnosis XX" UWORD _CNV_S_2_RANGE__0___1_CM 1 100. 0. 1. DISPLAY_IDENTIFIER LV_END_DIAG_IGC_SCP_4 ECU_ADDRESS 0xd000438a BIT_MASK 0x20 /end MEASUREMENT
/begin MEASUREMENT fmy_stat_igc_scp_4.err_info_stat.lv_cdn_diag "Diagnosis condition to start symptom detection (set to 1 when condition is fulfilled)" UWORD _CNV_S_2_RANGE__0___1_CM 1 100. 0. 1. DISPLAY_IDENTIFIER LV_CDN_DIAG_IGC_SCP_4 ECU_ADDRESS 0xd000438a BIT_MASK 0x40 /end MEASUREMENT
/begin MEASUREMENT fmy_stat_igc_scp_4.err_info_stat.err_sym "For each symptom: status of failure (set to 1 when failure symptom is detected)" UWORD _CNV_S_16_RANGE_ERR__485_CM 1 100. 0. 15. DISPLAY_IDENTIFIER ERR_SYM_IGC_SCP_4 ECU_ADDRESS 0xd000438a BIT_MASK 0x780 /end MEASUREMENT
/begin MEASUREMENT fmy_stat_igc_scp_5.ctr_abc "anti-bounce counter for diagnosis XX" UBYTE _CNV_A_R_LINEAR_____0_CM 1 100. 0. 255. DISPLAY_IDENTIFIER CTR_ABC_IGC_SCP_5 ECU_ADDRESS 0xd000438c FORMAT "%3.0" /end MEASUREMENT
/begin MEASUREMENT fmy_stat_igc_scp_5.ctr_end_diag "Counter for the end of diagnosis XX generation" UBYTE _CNV_A_R_LINEAR_____0_CM 1 100. 0. 255. DISPLAY_IDENTIFIER CTR_ABC_END_DIAG_IGC_SCP_5 ECU_ADDRESS 0xd000438d FORMAT "%3.0" /end MEASUREMENT
/begin MEASUREMENT fmy_stat_igc_scp_5.err_info_stat.lv_err_mem "Failure is stored in dynamic memory (2nd layer)" UWORD _CNV_S_2_RANGE__0___1_CM 1 100. 0. 1. DISPLAY_IDENTIFIER LV_ERR_MEM_IGC_SCP_5 ECU_ADDRESS 0xd000438e BIT_MASK 0x8 /end MEASUREMENT
/begin MEASUREMENT fmy_stat_igc_scp_5.err_info_stat.lv_ready "Readiness flag related to diagnosis XX" UWORD _CNV_S_2_RANGE__0___1_CM 1 100. 0. 1. DISPLAY_IDENTIFIER LV_READY_IGC_SCP_5 ECU_ADDRESS 0xd000438e BIT_MASK 0x10 /end MEASUREMENT
/begin MEASUREMENT fmy_stat_igc_scp_5.err_info_stat.lv_end_diag "End of diagnosis XX" UWORD _CNV_S_2_RANGE__0___1_CM 1 100. 0. 1. DISPLAY_IDENTIFIER LV_END_DIAG_IGC_SCP_5 ECU_ADDRESS 0xd000438e BIT_MASK 0x20 /end MEASUREMENT
/begin MEASUREMENT fmy_stat_igc_scp_5.err_info_stat.lv_cdn_diag "Diagnosis condition to start symptom detection (set to 1 when condition is fulfilled)" UWORD _CNV_S_2_RANGE__0___1_CM 1 100. 0. 1. DISPLAY_IDENTIFIER LV_CDN_DIAG_IGC_SCP_5 ECU_ADDRESS 0xd000438e BIT_MASK 0x40 /end MEASUREMENT
/begin MEASUREMENT fmy_stat_igc_scp_5.err_info_stat.err_sym "For each symptom: status of failure (set to 1 when failure symptom is detected)" UWORD _CNV_S_16_RANGE_ERR__485_CM 1 100. 0. 15. DISPLAY_IDENTIFIER ERR_SYM_IGC_SCP_5 ECU_ADDRESS 0xd000438e BIT_MASK 0x780 /end MEASUREMENT
/begin MEASUREMENT fmy_stat_igc_scg_0.ctr_abc "anti-bounce counter for diagnosis XX" UBYTE _CNV_A_R_LINEAR_____0_CM 1 100. 0. 255. DISPLAY_IDENTIFIER CTR_ABC_IGC_SCG_0 ECU_ADDRESS 0xd0004360 FORMAT "%3.0" /end MEASUREMENT
/begin MEASUREMENT fmy_stat_igc_scg_0.ctr_end_diag "Counter for the end of diagnosis XX generation" UBYTE _CNV_A_R_LINEAR_____0_CM 1 100. 0. 255. DISPLAY_IDENTIFIER CTR_ABC_END_DIAG_IGC_SCG_0 ECU_ADDRESS 0xd0004361 FORMAT "%3.0" /end MEASUREMENT
/begin MEASUREMENT fmy_stat_igc_scg_0.err_info_stat.lv_err_mem "Failure is stored in dynamic memory (2nd layer)" UWORD _CNV_S_2_RANGE__0___1_CM 1 100. 0. 1. DISPLAY_IDENTIFIER LV_ERR_MEM_IGC_SCG_0 ECU_ADDRESS 0xd0004362 BIT_MASK 0x8 /end MEASUREMENT
/begin MEASUREMENT fmy_stat_igc_scg_0.err_info_stat.lv_ready "Readiness flag related to diagnosis XX" UWORD _CNV_S_2_RANGE__0___1_CM 1 100. 0. 1. DISPLAY_IDENTIFIER LV_READY_IGC_SCG_0 ECU_ADDRESS 0xd0004362 BIT_MASK 0x10 /end MEASUREMENT
/begin MEASUREMENT fmy_stat_igc_scg_0.err_info_stat.lv_end_diag "End of diagnosis XX" UWORD _CNV_S_2_RANGE__0___1_CM 1 100. 0. 1. DISPLAY_IDENTIFIER LV_END_DIAG_IGC_SCG_0 ECU_ADDRESS 0xd0004362 BIT_MASK 0x20 /end MEASUREMENT
/begin MEASUREMENT fmy_stat_igc_scg_0.err_info_stat.lv_cdn_diag "Diagnosis condition to start symptom detection (set to 1 when condition is fulfilled)" UWORD _CNV_S_2_RANGE__0___1_CM 1 100. 0. 1. DISPLAY_IDENTIFIER LV_CDN_DIAG_IGC_SCG_0 ECU_ADDRESS 0xd0004362 BIT_MASK 0x40 /end MEASUREMENT
/begin MEASUREMENT fmy_stat_igc_scg_0.err_info_stat.err_sym "For each symptom: status of failure (set to 1 when failure symptom is detected)" UWORD _CNV_S_16_RANGE_ERR__485_CM 1 100. 0. 15. DISPLAY_IDENTIFIER ERR_SYM_IGC_SCG_0 ECU_ADDRESS 0xd0004362 BIT_MASK 0x780 /end MEASUREMENT
/begin MEASUREMENT fmy_stat_igc_scg_1.ctr_abc "anti-bounce counter for diagnosis XX" UBYTE _CNV_A_R_LINEAR_____0_CM 1 100. 0. 255. DISPLAY_IDENTIFIER CTR_ABC_IGC_SCG_1 ECU_ADDRESS 0xd0004364 FORMAT "%3.0" /end MEASUREMENT
/begin MEASUREMENT fmy_stat_igc_scg_1.ctr_end_diag "Counter for the end of diagnosis XX generation" UBYTE _CNV_A_R_LINEAR_____0_CM 1 100. 0. 255. DISPLAY_IDENTIFIER CTR_ABC_END_DIAG_IGC_SCG_1 ECU_ADDRESS 0xd0004365 FORMAT "%3.0" /end MEASUREMENT
/begin MEASUREMENT fmy_stat_igc_scg_1.err_info_stat.lv_err_mem "Failure is stored in dynamic memory (2nd layer)" UWORD _CNV_S_2_RANGE__0___1_CM 1 100. 0. 1. DISPLAY_IDENTIFIER LV_ERR_MEM_IGC_SCG_1 ECU_ADDRESS 0xd0004366 BIT_MASK 0x8 /end MEASUREMENT
/begin MEASUREMENT fmy_stat_igc_scg_1.err_info_stat.lv_ready "Readiness flag related to diagnosis XX" UWORD _CNV_S_2_RANGE__0___1_CM 1 100. 0. 1. DISPLAY_IDENTIFIER LV_READY_IGC_SCG_1 ECU_ADDRESS 0xd0004366 BIT_MASK 0x10 /end MEASUREMENT
/begin MEASUREMENT fmy_stat_igc_scg_1.err_info_stat.lv_end_diag "End of diagnosis XX" UWORD _CNV_S_2_RANGE__0___1_CM 1 100. 0. 1. DISPLAY_IDENTIFIER LV_END_DIAG_IGC_SCG_1 ECU_ADDRESS 0xd0004366 BIT_MASK 0x20 /end MEASUREMENT
/begin MEASUREMENT fmy_stat_igc_scg_1.err_info_stat.lv_cdn_diag "Diagnosis condition to start symptom detection (set to 1 when condition is fulfilled)" UWORD _CNV_S_2_RANGE__0___1_CM 1 100. 0. 1. DISPLAY_IDENTIFIER LV_CDN_DIAG_IGC_SCG_1 ECU_ADDRESS 0xd0004366 BIT_MASK 0x40 /end MEASUREMENT
/begin MEASUREMENT fmy_stat_igc_scg_1.err_info_stat.err_sym "For each symptom: status of failure (set to 1 when failure symptom is detected)" UWORD _CNV_S_16_RANGE_ERR__485_CM 1 100. 0. 15. DISPLAY_IDENTIFIER ERR_SYM_IGC_SCG_1 ECU_ADDRESS 0xd0004366 BIT_MASK 0x780 /end MEASUREMENT
/begin MEASUREMENT fmy_stat_igc_scg_2.ctr_abc "anti-bounce counter for diagnosis XX" UBYTE _CNV_A_R_LINEAR_____0_CM 1 100. 0. 255. DISPLAY_IDENTIFIER CTR_ABC_IGC_SCG_2 ECU_ADDRESS 0xd0004368 FORMAT "%3.0" /end MEASUREMENT
/begin MEASUREMENT fmy_stat_igc_scg_2.ctr_end_diag "Counter for the end of diagnosis XX generation" UBYTE _CNV_A_R_LINEAR_____0_CM 1 100. 0. 255. DISPLAY_IDENTIFIER CTR_ABC_END_DIAG_IGC_SCG_2 ECU_ADDRESS 0xd0004369 FORMAT "%3.0" /end MEASUREMENT
/begin MEASUREMENT fmy_stat_igc_scg_2.err_info_stat.lv_err_mem "Failure is stored in dynamic memory (2nd layer)" UWORD _CNV_S_2_RANGE__0___1_CM 1 100. 0. 1. DISPLAY_IDENTIFIER LV_ERR_MEM_IGC_SCG_2 ECU_ADDRESS 0xd000436a BIT_MASK 0x8 /end MEASUREMENT
/begin MEASUREMENT fmy_stat_igc_scg_2.err_info_stat.lv_ready "Readiness flag related to diagnosis XX" UWORD _CNV_S_2_RANGE__0___1_CM 1 100. 0. 1. DISPLAY_IDENTIFIER LV_READY_IGC_SCG_2 ECU_ADDRESS 0xd000436a BIT_MASK 0x10 /end MEASUREMENT
/begin MEASUREMENT fmy_stat_igc_scg_2.err_info_stat.lv_end_diag "End of diagnosis XX" UWORD _CNV_S_2_RANGE__0___1_CM 1 100. 0. 1. DISPLAY_IDENTIFIER LV_END_DIAG_IGC_SCG_2 ECU_ADDRESS 0xd000436a BIT_MASK 0x20 /end MEASUREMENT
/begin MEASUREMENT fmy_stat_igc_scg_2.err_info_stat.lv_cdn_diag "Diagnosis condition to start symptom detection (set to 1 when condition is fulfilled)" UWORD _CNV_S_2_RANGE__0___1_CM 1 100. 0. 1. DISPLAY_IDENTIFIER LV_CDN_DIAG_IGC_SCG_2 ECU_ADDRESS 0xd000436a BIT_MASK 0x40 /end MEASUREMENT
/begin MEASUREMENT fmy_stat_igc_scg_2.err_info_stat.err_sym "For each symptom: status of failure (set to 1 when failure symptom is detected)" UWORD _CNV_S_16_RANGE_ERR__485_CM 1 100. 0. 15. DISPLAY_IDENTIFIER ERR_SYM_IGC_SCG_2 ECU_ADDRESS 0xd000436a BIT_MASK 0x780 /end MEASUREMENT
/begin MEASUREMENT fmy_stat_igc_scg_3.ctr_abc "anti-bounce counter for diagnosis XX" UBYTE _CNV_A_R_LINEAR_____0_CM 1 100. 0. 255. DISPLAY_IDENTIFIER CTR_ABC_IGC_SCG_3 ECU_ADDRESS 0xd000436c FORMAT "%3.0" /end MEASUREMENT
/begin MEASUREMENT fmy_stat_igc_scg_3.ctr_end_diag "Counter for the end of diagnosis XX generation" UBYTE _CNV_A_R_LINEAR_____0_CM 1 100. 0. 255. DISPLAY_IDENTIFIER CTR_ABC_END_DIAG_IGC_SCG_3 ECU_ADDRESS 0xd000436d FORMAT "%3.0" /end MEASUREMENT
/begin MEASUREMENT fmy_stat_igc_scg_3.err_info_stat.lv_err_mem "Failure is stored in dynamic memory (2nd layer)" UWORD _CNV_S_2_RANGE__0___1_CM 1 100. 0. 1. DISPLAY_IDENTIFIER LV_ERR_MEM_IGC_SCG_3 ECU_ADDRESS 0xd000436e BIT_MASK 0x8 /end MEASUREMENT
/begin MEASUREMENT fmy_stat_igc_scg_3.err_info_stat.lv_ready "Readiness flag related to diagnosis XX" UWORD _CNV_S_2_RANGE__0___1_CM 1 100. 0. 1. DISPLAY_IDENTIFIER LV_READY_IGC_SCG_3 ECU_ADDRESS 0xd000436e BIT_MASK 0x10 /end MEASUREMENT
/begin MEASUREMENT fmy_stat_igc_scg_3.err_info_stat.lv_end_diag "End of diagnosis XX" UWORD _CNV_S_2_RANGE__0___1_CM 1 100. 0. 1. DISPLAY_IDENTIFIER LV_END_DIAG_IGC_SCG_3 ECU_ADDRESS 0xd000436e BIT_MASK 0x20 /end MEASUREMENT
/begin MEASUREMENT fmy_stat_igc_scg_3.err_info_stat.lv_cdn_diag "Diagnosis condition to start symptom detection (set to 1 when condition is fulfilled)" UWORD _CNV_S_2_RANGE__0___1_CM 1 100. 0. 1. DISPLAY_IDENTIFIER LV_CDN_DIAG_IGC_SCG_3 ECU_ADDRESS 0xd000436e BIT_MASK 0x40 /end MEASUREMENT
/begin MEASUREMENT fmy_stat_igc_scg_3.err_info_stat.err_sym "For each symptom: status of failure (set to 1 when failure symptom is detected)" UWORD _CNV_S_16_RANGE_ERR__485_CM 1 100. 0. 15. DISPLAY_IDENTIFIER ERR_SYM_IGC_SCG_3 ECU_ADDRESS 0xd000436e BIT_MASK 0x780 /end MEASUREMENT
/begin MEASUREMENT fmy_stat_igc_scg_4.ctr_abc "anti-bounce counter for diagnosis XX" UBYTE _CNV_A_R_LINEAR_____0_CM 1 100. 0. 255. DISPLAY_IDENTIFIER CTR_ABC_IGC_SCG_4 ECU_ADDRESS 0xd0004370 FORMAT "%3.0" /end MEASUREMENT
/begin MEASUREMENT fmy_stat_igc_scg_4.ctr_end_diag "Counter for the end of diagnosis XX generation" UBYTE _CNV_A_R_LINEAR_____0_CM 1 100. 0. 255. DISPLAY_IDENTIFIER CTR_ABC_END_DIAG_IGC_SCG_4 ECU_ADDRESS 0xd0004371 FORMAT "%3.0" /end MEASUREMENT
/begin MEASUREMENT fmy_stat_igc_scg_4.err_info_stat.lv_err_mem "Failure is stored in dynamic memory (2nd layer)" UWORD _CNV_S_2_RANGE__0___1_CM 1 100. 0. 1. DISPLAY_IDENTIFIER LV_ERR_MEM_IGC_SCG_4 ECU_ADDRESS 0xd0004372 BIT_MASK 0x8 /end MEASUREMENT
/begin MEASUREMENT fmy_stat_igc_scg_4.err_info_stat.lv_ready "Readiness flag related to diagnosis XX" UWORD _CNV_S_2_RANGE__0___1_CM 1 100. 0. 1. DISPLAY_IDENTIFIER LV_READY_IGC_SCG_4 ECU_ADDRESS 0xd0004372 BIT_MASK 0x10 /end MEASUREMENT
/begin MEASUREMENT fmy_stat_igc_scg_4.err_info_stat.lv_end_diag "End of diagnosis XX" UWORD _CNV_S_2_RANGE__0___1_CM 1 100. 0. 1. DISPLAY_IDENTIFIER LV_END_DIAG_IGC_SCG_4 ECU_ADDRESS 0xd0004372 BIT_MASK 0x20 /end MEASUREMENT
/begin MEASUREMENT fmy_stat_igc_scg_4.err_info_stat.lv_cdn_diag "Diagnosis condition to start symptom detection (set to 1 when condition is fulfilled)" UWORD _CNV_S_2_RANGE__0___1_CM 1 100. 0. 1. DISPLAY_IDENTIFIER LV_CDN_DIAG_IGC_SCG_4 ECU_ADDRESS 0xd0004372 BIT_MASK 0x40 /end MEASUREMENT
/begin MEASUREMENT fmy_stat_igc_scg_4.err_info_stat.err_sym "For each symptom: status of failure (set to 1 when failure symptom is detected)" UWORD _CNV_S_16_RANGE_ERR__485_CM 1 100. 0. 15. DISPLAY_IDENTIFIER ERR_SYM_IGC_SCG_4 ECU_ADDRESS 0xd0004372 BIT_MASK 0x780 /end MEASUREMENT
/begin MEASUREMENT fmy_stat_igc_scg_5.ctr_abc "anti-bounce counter for diagnosis XX" UBYTE _CNV_A_R_LINEAR_____0_CM 1 100. 0. 255. DISPLAY_IDENTIFIER CTR_ABC_IGC_SCG_5 ECU_ADDRESS 0xd0004374 FORMAT "%3.0" /end MEASUREMENT
/begin MEASUREMENT fmy_stat_igc_scg_5.ctr_end_diag "Counter for the end of diagnosis XX generation" UBYTE _CNV_A_R_LINEAR_____0_CM 1 100. 0. 255. DISPLAY_IDENTIFIER CTR_ABC_END_DIAG_IGC_SCG_5 ECU_ADDRESS 0xd0004375 FORMAT "%3.0" /end MEASUREMENT
/begin MEASUREMENT fmy_stat_igc_scg_5.err_info_stat.lv_err_mem "Failure is stored in dynamic memory (2nd layer)" UWORD _CNV_S_2_RANGE__0___1_CM 1 100. 0. 1. DISPLAY_IDENTIFIER LV_ERR_MEM_IGC_SCG_5 ECU_ADDRESS 0xd0004376 BIT_MASK 0x8 /end MEASUREMENT
/begin MEASUREMENT fmy_stat_igc_scg_5.err_info_stat.lv_ready "Readiness flag related to diagnosis XX" UWORD _CNV_S_2_RANGE__0___1_CM 1 100. 0. 1. DISPLAY_IDENTIFIER LV_READY_IGC_SCG_5 ECU_ADDRESS 0xd0004376 BIT_MASK 0x10 /end MEASUREMENT
/begin MEASUREMENT fmy_stat_igc_scg_5.err_info_stat.lv_end_diag "End of diagnosis XX" UWORD _CNV_S_2_RANGE__0___1_CM 1 100. 0. 1. DISPLAY_IDENTIFIER LV_END_DIAG_IGC_SCG_5 ECU_ADDRESS 0xd0004376 BIT_MASK 0x20 /end MEASUREMENT
/begin MEASUREMENT fmy_stat_igc_scg_5.err_info_stat.lv_cdn_diag "Diagnosis condition to start symptom detection (set to 1 when condition is fulfilled)" UWORD _CNV_S_2_RANGE__0___1_CM 1 100. 0. 1. DISPLAY_IDENTIFIER LV_CDN_DIAG_IGC_SCG_5 ECU_ADDRESS 0xd0004376 BIT_MASK 0x40 /end MEASUREMENT
/begin MEASUREMENT fmy_stat_igc_scg_5.err_info_stat.err_sym "For each symptom: status of failure (set to 1 when failure symptom is detected)" UWORD _CNV_S_16_RANGE_ERR__485_CM 1 100. 0. 15. DISPLAY_IDENTIFIER ERR_SYM_IGC_SCG_5 ECU_ADDRESS 0xd0004376 BIT_MASK 0x780 /end MEASUREMENT
/begin MEASUREMENT fmy_stat_igc_ol_0.ctr_abc "anti-bounce counter for diagnosis XX" UBYTE _CNV_A_R_LINEAR_____0_CM 1 100. 0. 255. DISPLAY_IDENTIFIER CTR_ABC_IGC_OL_0 ECU_ADDRESS 0xd0004348 FORMAT "%3.0" /end MEASUREMENT
/begin MEASUREMENT fmy_stat_igc_ol_0.ctr_end_diag "Counter for the end of diagnosis XX generation" UBYTE _CNV_A_R_LINEAR_____0_CM 1 100. 0. 255. DISPLAY_IDENTIFIER CTR_ABC_END_DIAG_IGC_OL_0 ECU_ADDRESS 0xd0004349 FORMAT "%3.0" /end MEASUREMENT
/begin MEASUREMENT fmy_stat_igc_ol_0.err_info_stat.lv_err_mem "Failure is stored in dynamic memory (2nd layer)" UWORD _CNV_S_2_RANGE__0___1_CM 1 100. 0. 1. DISPLAY_IDENTIFIER LV_ERR_MEM_IGC_OL_0 ECU_ADDRESS 0xd000434a BIT_MASK 0x8 /end MEASUREMENT
/begin MEASUREMENT fmy_stat_igc_ol_0.err_info_stat.lv_ready "Readiness flag related to diagnosis XX" UWORD _CNV_S_2_RANGE__0___1_CM 1 100. 0. 1. DISPLAY_IDENTIFIER LV_READY_IGC_OL_0 ECU_ADDRESS 0xd000434a BIT_MASK 0x10 /end MEASUREMENT
/begin MEASUREMENT fmy_stat_igc_ol_0.err_info_stat.lv_end_diag "End of diagnosis XX" UWORD _CNV_S_2_RANGE__0___1_CM 1 100. 0. 1. DISPLAY_IDENTIFIER LV_END_DIAG_IGC_OL_0 ECU_ADDRESS 0xd000434a BIT_MASK 0x20 /end MEASUREMENT
/begin MEASUREMENT fmy_stat_igc_ol_0.err_info_stat.lv_cdn_diag "Diagnosis condition to start symptom detection (set to 1 when condition is fulfilled)" UWORD _CNV_S_2_RANGE__0___1_CM 1 100. 0. 1. DISPLAY_IDENTIFIER LV_CDN_DIAG_IGC_OL_0 ECU_ADDRESS 0xd000434a BIT_MASK 0x40 /end MEASUREMENT
/begin MEASUREMENT fmy_stat_igc_ol_0.err_info_stat.err_sym "For each symptom: status of failure (set to 1 when failure symptom is detected)" UWORD _CNV_S_16_RANGE_ERR__485_CM 1 100. 0. 15. DISPLAY_IDENTIFIER ERR_SYM_IGC_OL_0 ECU_ADDRESS 0xd000434a BIT_MASK 0x780 /end MEASUREMENT
/begin MEASUREMENT fmy_stat_igc_ol_1.ctr_abc "anti-bounce counter for diagnosis XX" UBYTE _CNV_A_R_LINEAR_____0_CM 1 100. 0. 255. DISPLAY_IDENTIFIER CTR_ABC_IGC_OL_1 ECU_ADDRESS 0xd000434c FORMAT "%3.0" /end MEASUREMENT
/begin MEASUREMENT fmy_stat_igc_ol_1.ctr_end_diag "Counter for the end of diagnosis XX generation" UBYTE _CNV_A_R_LINEAR_____0_CM 1 100. 0. 255. DISPLAY_IDENTIFIER CTR_ABC_END_DIAG_IGC_OL_1 ECU_ADDRESS 0xd000434d FORMAT "%3.0" /end MEASUREMENT
/begin MEASUREMENT fmy_stat_igc_ol_1.err_info_stat.lv_err_mem "Failure is stored in dynamic memory (2nd layer)" UWORD _CNV_S_2_RANGE__0___1_CM 1 100. 0. 1. DISPLAY_IDENTIFIER LV_ERR_MEM_IGC_OL_1 ECU_ADDRESS 0xd000434e BIT_MASK 0x8 /end MEASUREMENT
/begin MEASUREMENT fmy_stat_igc_ol_1.err_info_stat.lv_ready "Readiness flag related to diagnosis XX" UWORD _CNV_S_2_RANGE__0___1_CM 1 100. 0. 1. DISPLAY_IDENTIFIER LV_READY_IGC_OL_1 ECU_ADDRESS 0xd000434e BIT_MASK 0x10 /end MEASUREMENT
/begin MEASUREMENT fmy_stat_igc_ol_1.err_info_stat.lv_end_diag "End of diagnosis XX" UWORD _CNV_S_2_RANGE__0___1_CM 1 100. 0. 1. DISPLAY_IDENTIFIER LV_END_DIAG_IGC_OL_1 ECU_ADDRESS 0xd000434e BIT_MASK 0x20 /end MEASUREMENT
/begin MEASUREMENT fmy_stat_igc_ol_1.err_info_stat.lv_cdn_diag "Diagnosis condition to start symptom detection (set to 1 when condition is fulfilled)" UWORD _CNV_S_2_RANGE__0___1_CM 1 100. 0. 1. DISPLAY_IDENTIFIER LV_CDN_DIAG_IGC_OL_1 ECU_ADDRESS 0xd000434e BIT_MASK 0x40 /end MEASUREMENT
/begin MEASUREMENT fmy_stat_igc_ol_1.err_info_stat.err_sym "For each symptom: status of failure (set to 1 when failure symptom is detected)" UWORD _CNV_S_16_RANGE_ERR__485_CM 1 100. 0. 15. DISPLAY_IDENTIFIER ERR_SYM_IGC_OL_1 ECU_ADDRESS 0xd000434e BIT_MASK 0x780 /end MEASUREMENT
/begin MEASUREMENT fmy_stat_igc_ol_2.ctr_abc "anti-bounce counter for diagnosis XX" UBYTE _CNV_A_R_LINEAR_____0_CM 1 100. 0. 255. DISPLAY_IDENTIFIER CTR_ABC_IGC_OL_2 ECU_ADDRESS 0xd0004350 FORMAT "%3.0" /end MEASUREMENT
/begin MEASUREMENT fmy_stat_igc_ol_2.ctr_end_diag "Counter for the end of diagnosis XX generation" UBYTE _CNV_A_R_LINEAR_____0_CM 1 100. 0. 255. DISPLAY_IDENTIFIER CTR_ABC_END_DIAG_IGC_OL_2 ECU_ADDRESS 0xd0004351 FORMAT "%3.0" /end MEASUREMENT
/begin MEASUREMENT fmy_stat_igc_ol_2.err_info_stat.lv_err_mem "Failure is stored in dynamic memory (2nd layer)" UWORD _CNV_S_2_RANGE__0___1_CM 1 100. 0. 1. DISPLAY_IDENTIFIER LV_ERR_MEM_IGC_OL_2 ECU_ADDRESS 0xd0004352 BIT_MASK 0x8 /end MEASUREMENT
/begin MEASUREMENT fmy_stat_igc_ol_2.err_info_stat.lv_ready "Readiness flag related to diagnosis XX" UWORD _CNV_S_2_RANGE__0___1_CM 1 100. 0. 1. DISPLAY_IDENTIFIER LV_READY_IGC_OL_2 ECU_ADDRESS 0xd0004352 BIT_MASK 0x10 /end MEASUREMENT
/begin MEASUREMENT fmy_stat_igc_ol_2.err_info_stat.lv_end_diag "End of diagnosis XX" UWORD _CNV_S_2_RANGE__0___1_CM 1 100. 0. 1. DISPLAY_IDENTIFIER LV_END_DIAG_IGC_OL_2 ECU_ADDRESS 0xd0004352 BIT_MASK 0x20 /end MEASUREMENT
/begin MEASUREMENT fmy_stat_igc_ol_2.err_info_stat.lv_cdn_diag "Diagnosis condition to start symptom detection (set to 1 when condition is fulfilled)" UWORD _CNV_S_2_RANGE__0___1_CM 1 100. 0. 1. DISPLAY_IDENTIFIER LV_CDN_DIAG_IGC_OL_2 ECU_ADDRESS 0xd0004352 BIT_MASK 0x40 /end MEASUREMENT
/begin MEASUREMENT fmy_stat_igc_ol_2.err_info_stat.err_sym "For each symptom: status of failure (set to 1 when failure symptom is detected)" UWORD _CNV_S_16_RANGE_ERR__485_CM 1 100. 0. 15. DISPLAY_IDENTIFIER ERR_SYM_IGC_OL_2 ECU_ADDRESS 0xd0004352 BIT_MASK 0x780 /end MEASUREMENT
/begin MEASUREMENT fmy_stat_igc_ol_3.ctr_abc "anti-bounce counter for diagnosis XX" UBYTE _CNV_A_R_LINEAR_____0_CM 1 100. 0. 255. DISPLAY_IDENTIFIER CTR_ABC_IGC_OL_3 ECU_ADDRESS 0xd0004354 FORMAT "%3.0" /end MEASUREMENT
/begin MEASUREMENT fmy_stat_igc_ol_3.ctr_end_diag "Counter for the end of diagnosis XX generation" UBYTE _CNV_A_R_LINEAR_____0_CM 1 100. 0. 255. DISPLAY_IDENTIFIER CTR_ABC_END_DIAG_IGC_OL_3 ECU_ADDRESS 0xd0004355 FORMAT "%3.0" /end MEASUREMENT
/begin MEASUREMENT fmy_stat_igc_ol_3.err_info_stat.lv_err_mem "Failure is stored in dynamic memory (2nd layer)" UWORD _CNV_S_2_RANGE__0___1_CM 1 100. 0. 1. DISPLAY_IDENTIFIER LV_ERR_MEM_IGC_OL_3 ECU_ADDRESS 0xd0004356 BIT_MASK 0x8 /end MEASUREMENT
/begin MEASUREMENT fmy_stat_igc_ol_3.err_info_stat.lv_ready "Readiness flag related to diagnosis XX" UWORD _CNV_S_2_RANGE__0___1_CM 1 100. 0. 1. DISPLAY_IDENTIFIER LV_READY_IGC_OL_3 ECU_ADDRESS 0xd0004356 BIT_MASK 0x10 /end MEASUREMENT
/begin MEASUREMENT fmy_stat_igc_ol_3.err_info_stat.lv_end_diag "End of diagnosis XX" UWORD _CNV_S_2_RANGE__0___1_CM 1 100. 0. 1. DISPLAY_IDENTIFIER LV_END_DIAG_IGC_OL_3 ECU_ADDRESS 0xd0004356 BIT_MASK 0x20 /end MEASUREMENT
/begin MEASUREMENT fmy_stat_igc_ol_3.err_info_stat.lv_cdn_diag "Diagnosis condition to start symptom detection (set to 1 when condition is fulfilled)" UWORD _CNV_S_2_RANGE__0___1_CM 1 100. 0. 1. DISPLAY_IDENTIFIER LV_CDN_DIAG_IGC_OL_3 ECU_ADDRESS 0xd0004356 BIT_MASK 0x40 /end MEASUREMENT
/begin MEASUREMENT fmy_stat_igc_ol_3.err_info_stat.err_sym "For each symptom: status of failure (set to 1 when failure symptom is detected)" UWORD _CNV_S_16_RANGE_ERR__485_CM 1 100. 0. 15. DISPLAY_IDENTIFIER ERR_SYM_IGC_OL_3 ECU_ADDRESS 0xd0004356 BIT_MASK 0x780 /end MEASUREMENT
/begin MEASUREMENT fmy_stat_igc_ol_4.ctr_abc "anti-bounce counter for diagnosis XX" UBYTE _CNV_A_R_LINEAR_____0_CM 1 100. 0. 255. DISPLAY_IDENTIFIER CTR_ABC_IGC_OL_4 ECU_ADDRESS 0xd0004358 FORMAT "%3.0" /end MEASUREMENT
/begin MEASUREMENT fmy_stat_igc_ol_4.ctr_end_diag "Counter for the end of diagnosis XX generation" UBYTE _CNV_A_R_LINEAR_____0_CM 1 100. 0. 255. DISPLAY_IDENTIFIER CTR_ABC_END_DIAG_IGC_OL_4 ECU_ADDRESS 0xd0004359 FORMAT "%3.0" /end MEASUREMENT
/begin MEASUREMENT fmy_stat_igc_ol_4.err_info_stat.lv_err_mem "Failure is stored in dynamic memory (2nd layer)" UWORD _CNV_S_2_RANGE__0___1_CM 1 100. 0. 1. DISPLAY_IDENTIFIER LV_ERR_MEM_IGC_OL_4 ECU_ADDRESS 0xd000435a BIT_MASK 0x8 /end MEASUREMENT
/begin MEASUREMENT fmy_stat_igc_ol_4.err_info_stat.lv_ready "Readiness flag related to diagnosis XX" UWORD _CNV_S_2_RANGE__0___1_CM 1 100. 0. 1. DISPLAY_IDENTIFIER LV_READY_IGC_OL_4 ECU_ADDRESS 0xd000435a BIT_MASK 0x10 /end MEASUREMENT
/begin MEASUREMENT fmy_stat_igc_ol_4.err_info_stat.lv_end_diag "End of diagnosis XX" UWORD _CNV_S_2_RANGE__0___1_CM 1 100. 0. 1. DISPLAY_IDENTIFIER LV_END_DIAG_IGC_OL_4 ECU_ADDRESS 0xd000435a BIT_MASK 0x20 /end MEASUREMENT
/begin MEASUREMENT fmy_stat_igc_ol_4.err_info_stat.lv_cdn_diag "Diagnosis condition to start symptom detection (set to 1 when condition is fulfilled)" UWORD _CNV_S_2_RANGE__0___1_CM 1 100. 0. 1. DISPLAY_IDENTIFIER LV_CDN_DIAG_IGC_OL_4 ECU_ADDRESS 0xd000435a BIT_MASK 0x40 /end MEASUREMENT
/begin MEASUREMENT fmy_stat_igc_ol_4.err_info_stat.err_sym "For each symptom: status of failure (set to 1 when failure symptom is detected)" UWORD _CNV_S_16_RANGE_ERR__485_CM 1 100. 0. 15. DISPLAY_IDENTIFIER ERR_SYM_IGC_OL_4 ECU_ADDRESS 0xd000435a BIT_MASK 0x780 /end MEASUREMENT
/begin MEASUREMENT fmy_stat_igc_ol_5.ctr_abc "anti-bounce counter for diagnosis XX" UBYTE _CNV_A_R_LINEAR_____0_CM 1 100. 0. 255. DISPLAY_IDENTIFIER CTR_ABC_IGC_OL_5 ECU_ADDRESS 0xd000435c FORMAT "%3.0" /end MEASUREMENT
/begin MEASUREMENT fmy_stat_igc_ol_5.ctr_end_diag "Counter for the end of diagnosis XX generation" UBYTE _CNV_A_R_LINEAR_____0_CM 1 100. 0. 255. DISPLAY_IDENTIFIER CTR_ABC_END_DIAG_IGC_OL_5 ECU_ADDRESS 0xd000435d FORMAT "%3.0" /end MEASUREMENT
/begin MEASUREMENT fmy_stat_igc_ol_5.err_info_stat.lv_err_mem "Failure is stored in dynamic memory (2nd layer)" UWORD _CNV_S_2_RANGE__0___1_CM 1 100. 0. 1. DISPLAY_IDENTIFIER LV_ERR_MEM_IGC_OL_5 ECU_ADDRESS 0xd000435e BIT_MASK 0x8 /end MEASUREMENT
/begin MEASUREMENT fmy_stat_igc_ol_5.err_info_stat.lv_ready "Readiness flag related to diagnosis XX" UWORD _CNV_S_2_RANGE__0___1_CM 1 100. 0. 1. DISPLAY_IDENTIFIER LV_READY_IGC_OL_5 ECU_ADDRESS 0xd000435e BIT_MASK 0x10 /end MEASUREMENT
/begin MEASUREMENT fmy_stat_igc_ol_5.err_info_stat.lv_end_diag "End of diagnosis XX" UWORD _CNV_S_2_RANGE__0___1_CM 1 100. 0. 1. DISPLAY_IDENTIFIER LV_END_DIAG_IGC_OL_5 ECU_ADDRESS 0xd000435e BIT_MASK 0x20 /end MEASUREMENT
/begin MEASUREMENT fmy_stat_igc_ol_5.err_info_stat.lv_cdn_diag "Diagnosis condition to start symptom detection (set to 1 when condition is fulfilled)" UWORD _CNV_S_2_RANGE__0___1_CM 1 100. 0. 1. DISPLAY_IDENTIFIER LV_CDN_DIAG_IGC_OL_5 ECU_ADDRESS 0xd000435e BIT_MASK 0x40 /end MEASUREMENT
/begin MEASUREMENT fmy_stat_igc_ol_5.err_info_stat.err_sym "For each symptom: status of failure (set to 1 when failure symptom is detected)" UWORD _CNV_S_16_RANGE_ERR__485_CM 1 100. 0. 15. DISPLAY_IDENTIFIER ERR_SYM_IGC_OL_5 ECU_ADDRESS 0xd000435e BIT_MASK 0x780 /end MEASUREMENT
/begin MEASUREMENT fmy_stat_tps_1.ctr_abc "anti-bounce counter for diagnosis XX" UBYTE _CNV_A_R_LINEAR_____0_CM 1 100. 0. 255. DISPLAY_IDENTIFIER CTR_ABC_TPS_1 ECU_ADDRESS 0xd00045e4 FORMAT "%3.0" /end MEASUREMENT
/begin MEASUREMENT fmy_stat_tps_1.ctr_end_diag "Counter for the end of diagnosis XX generation" UBYTE _CNV_A_R_LINEAR_____0_CM 1 100. 0. 255. DISPLAY_IDENTIFIER CTR_ABC_END_DIAG_TPS_1 ECU_ADDRESS 0xd00045e5 FORMAT "%3.0" /end MEASUREMENT
/begin MEASUREMENT fmy_stat_tps_1.err_info_stat.lv_err_mem "Failure is stored in dynamic memory (2nd layer)" UWORD _CNV_S_2_RANGE__0___1_CM 1 100. 0. 1. DISPLAY_IDENTIFIER LV_ERR_MEM_TPS_1 ECU_ADDRESS 0xd00045e6 BIT_MASK 0x8 /end MEASUREMENT
/begin MEASUREMENT fmy_stat_tps_1.err_info_stat.lv_ready "Readiness flag related to diagnosis XX" UWORD _CNV_S_2_RANGE__0___1_CM 1 100. 0. 1. DISPLAY_IDENTIFIER LV_READY_TPS_1 ECU_ADDRESS 0xd00045e6 BIT_MASK 0x10 /end MEASUREMENT
/begin MEASUREMENT fmy_stat_tps_1.err_info_stat.lv_end_diag "End of diagnosis XX" UWORD _CNV_S_2_RANGE__0___1_CM 1 100. 0. 1. DISPLAY_IDENTIFIER LV_END_DIAG_TPS_1 ECU_ADDRESS 0xd00045e6 BIT_MASK 0x20 /end MEASUREMENT
/begin MEASUREMENT fmy_stat_tps_1.err_info_stat.lv_cdn_diag "Diagnosis condition to start symptom detection (set to 1 when condition is fulfilled)" UWORD _CNV_S_2_RANGE__0___1_CM 1 100. 0. 1. DISPLAY_IDENTIFIER LV_CDN_DIAG_TPS_1 ECU_ADDRESS 0xd00045e6 BIT_MASK 0x40 /end MEASUREMENT
/begin MEASUREMENT fmy_stat_tps_1.err_info_stat.err_sym "For each symptom: status of failure (set to 1 when failure symptom is detected)" UWORD _CNV_S_16_RANGE_ERR__485_CM 1 100. 0. 15. DISPLAY_IDENTIFIER ERR_SYM_TPS_1 ECU_ADDRESS 0xd00045e6 BIT_MASK 0x780 /end MEASUREMENT
/begin MEASUREMENT fmy_stat_tps_2.ctr_abc "anti-bounce counter for diagnosis XX" UBYTE _CNV_A_R_LINEAR_____0_CM 1 100. 0. 255. DISPLAY_IDENTIFIER CTR_ABC_TPS_2 ECU_ADDRESS 0xd00045e8 FORMAT "%3.0" /end MEASUREMENT
/begin MEASUREMENT fmy_stat_tps_2.ctr_end_diag "Counter for the end of diagnosis XX generation" UBYTE _CNV_A_R_LINEAR_____0_CM 1 100. 0. 255. DISPLAY_IDENTIFIER CTR_ABC_END_DIAG_TPS_2 ECU_ADDRESS 0xd00045e9 FORMAT "%3.0" /end MEASUREMENT
/begin MEASUREMENT fmy_stat_tps_2.err_info_stat.lv_err_mem "Failure is stored in dynamic memory (2nd layer)" UWORD _CNV_S_2_RANGE__0___1_CM 1 100. 0. 1. DISPLAY_IDENTIFIER LV_ERR_MEM_TPS_2 ECU_ADDRESS 0xd00045ea BIT_MASK 0x8 /end MEASUREMENT
/begin MEASUREMENT fmy_stat_tps_2.err_info_stat.lv_ready "Readiness flag related to diagnosis XX" UWORD _CNV_S_2_RANGE__0___1_CM 1 100. 0. 1. DISPLAY_IDENTIFIER LV_READY_TPS_2 ECU_ADDRESS 0xd00045ea BIT_MASK 0x10 /end MEASUREMENT
/begin MEASUREMENT fmy_stat_tps_2.err_info_stat.lv_end_diag "End of diagnosis XX" UWORD _CNV_S_2_RANGE__0___1_CM 1 100. 0. 1. DISPLAY_IDENTIFIER LV_END_DIAG_TPS_2 ECU_ADDRESS 0xd00045ea BIT_MASK 0x20 /end MEASUREMENT
/begin MEASUREMENT fmy_stat_tps_2.err_info_stat.lv_cdn_diag "Diagnosis condition to start symptom detection (set to 1 when condition is fulfilled)" UWORD _CNV_S_2_RANGE__0___1_CM 1 100. 0. 1. DISPLAY_IDENTIFIER LV_CDN_DIAG_TPS_2 ECU_ADDRESS 0xd00045ea BIT_MASK 0x40 /end MEASUREMENT
/begin MEASUREMENT fmy_stat_tps_2.err_info_stat.err_sym "For each symptom: status of failure (set to 1 when failure symptom is detected)" UWORD _CNV_S_16_RANGE_ERR__485_CM 1 100. 0. 15. DISPLAY_IDENTIFIER ERR_SYM_TPS_2 ECU_ADDRESS 0xd00045ea BIT_MASK 0x780 /end MEASUREMENT
/begin MEASUREMENT fmy_stat_tps_maf_1.ctr_abc "anti-bounce counter for diagnosis XX" UBYTE _CNV_A_R_LINEAR_____0_CM 1 100. 0. 255. DISPLAY_IDENTIFIER CTR_ABC_TPS_MAF_1 ECU_ADDRESS 0xd00045f4 FORMAT "%3.0" /end MEASUREMENT
/begin MEASUREMENT fmy_stat_tps_maf_1.ctr_end_diag "Counter for the end of diagnosis XX generation" UBYTE _CNV_A_R_LINEAR_____0_CM 1 100. 0. 255. DISPLAY_IDENTIFIER CTR_ABC_END_DIAG_TPS_MAF_1 ECU_ADDRESS 0xd00045f5 FORMAT "%3.0" /end MEASUREMENT
/begin MEASUREMENT fmy_stat_tps_maf_1.err_info_stat.lv_err_mem "Failure is stored in dynamic memory (2nd layer)" UWORD _CNV_S_2_RANGE__0___1_CM 1 100. 0. 1. DISPLAY_IDENTIFIER LV_ERR_MEM_TPS_MAF_1 ECU_ADDRESS 0xd00045f6 BIT_MASK 0x8 /end MEASUREMENT
/begin MEASUREMENT fmy_stat_tps_maf_1.err_info_stat.lv_ready "Readiness flag related to diagnosis XX" UWORD _CNV_S_2_RANGE__0___1_CM 1 100. 0. 1. DISPLAY_IDENTIFIER LV_READY_TPS_MAF_1 ECU_ADDRESS 0xd00045f6 BIT_MASK 0x10 /end MEASUREMENT
/begin MEASUREMENT fmy_stat_tps_maf_1.err_info_stat.lv_end_diag "End of diagnosis XX" UWORD _CNV_S_2_RANGE__0___1_CM 1 100. 0. 1. DISPLAY_IDENTIFIER LV_END_DIAG_TPS_MAF_1 ECU_ADDRESS 0xd00045f6 BIT_MASK 0x20 /end MEASUREMENT
/begin MEASUREMENT fmy_stat_tps_maf_1.err_info_stat.lv_cdn_diag "Diagnosis condition to start symptom detection (set to 1 when condition is fulfilled)" UWORD _CNV_S_2_RANGE__0___1_CM 1 100. 0. 1. DISPLAY_IDENTIFIER LV_CDN_DIAG_TPS_MAF_1 ECU_ADDRESS 0xd00045f6 BIT_MASK 0x40 /end MEASUREMENT
/begin MEASUREMENT fmy_stat_tps_maf_1.err_info_stat.err_sym "For each symptom: status of failure (set to 1 when failure symptom is detected)" UWORD _CNV_S_16_RANGE_ERR__485_CM 1 100. 0. 15. DISPLAY_IDENTIFIER ERR_SYM_TPS_MAF_1 ECU_ADDRESS 0xd00045f6 BIT_MASK 0x780 /end MEASUREMENT
/begin MEASUREMENT fmy_stat_tps_maf_2.ctr_abc "anti-bounce counter for diagnosis XX" UBYTE _CNV_A_R_LINEAR_____0_CM 1 100. 0. 255. DISPLAY_IDENTIFIER CTR_ABC_TPS_MAF_2 ECU_ADDRESS 0xd00045f8 FORMAT "%3.0" /end MEASUREMENT
/begin MEASUREMENT fmy_stat_tps_maf_2.ctr_end_diag "Counter for the end of diagnosis XX generation" UBYTE _CNV_A_R_LINEAR_____0_CM 1 100. 0. 255. DISPLAY_IDENTIFIER CTR_ABC_END_DIAG_TPS_MAF_2 ECU_ADDRESS 0xd00045f9 FORMAT "%3.0" /end MEASUREMENT
/begin MEASUREMENT fmy_stat_tps_maf_2.err_info_stat.lv_err_mem "Failure is stored in dynamic memory (2nd layer)" UWORD _CNV_S_2_RANGE__0___1_CM 1 100. 0. 1. DISPLAY_IDENTIFIER LV_ERR_MEM_TPS_MAF_2 ECU_ADDRESS 0xd00045fa BIT_MASK 0x8 /end MEASUREMENT
/begin MEASUREMENT fmy_stat_tps_maf_2.err_info_stat.lv_ready "Readiness flag related to diagnosis XX" UWORD _CNV_S_2_RANGE__0___1_CM 1 100. 0. 1. DISPLAY_IDENTIFIER LV_READY_TPS_MAF_2 ECU_ADDRESS 0xd00045fa BIT_MASK 0x10 /end MEASUREMENT
/begin MEASUREMENT fmy_stat_tps_maf_2.err_info_stat.lv_end_diag "End of diagnosis XX" UWORD _CNV_S_2_RANGE__0___1_CM 1 100. 0. 1. DISPLAY_IDENTIFIER LV_END_DIAG_TPS_MAF_2 ECU_ADDRESS 0xd00045fa BIT_MASK 0x20 /end MEASUREMENT
/begin MEASUREMENT fmy_stat_tps_maf_2.err_info_stat.lv_cdn_diag "Diagnosis condition to start symptom detection (set to 1 when condition is fulfilled)" UWORD _CNV_S_2_RANGE__0___1_CM 1 100. 0. 1. DISPLAY_IDENTIFIER LV_CDN_DIAG_TPS_MAF_2 ECU_ADDRESS 0xd00045fa BIT_MASK 0x40 /end MEASUREMENT
/begin MEASUREMENT fmy_stat_tps_maf_2.err_info_stat.err_sym "For each symptom: status of failure (set to 1 when failure symptom is detected)" UWORD _CNV_S_16_RANGE_ERR__485_CM 1 100. 0. 15. DISPLAY_IDENTIFIER ERR_SYM_TPS_MAF_2 ECU_ADDRESS 0xd00045fa BIT_MASK 0x780 /end MEASUREMENT
/begin MEASUREMENT fmy_stat_tps_ratio.ctr_abc "anti-bounce counter for diagnosis XX" UBYTE _CNV_A_R_LINEAR_____0_CM 1 100. 0. 255. DISPLAY_IDENTIFIER CTR_ABC_TPS_RATIO ECU_ADDRESS 0xd00045fc FORMAT "%3.0" /end MEASUREMENT
/begin MEASUREMENT fmy_stat_tps_ratio.ctr_end_diag "Counter for the end of diagnosis XX generation" UBYTE _CNV_A_R_LINEAR_____0_CM 1 100. 0. 255. DISPLAY_IDENTIFIER CTR_ABC_END_DIAG_TPS_RATIO ECU_ADDRESS 0xd00045fd FORMAT "%3.0" /end MEASUREMENT
/begin MEASUREMENT fmy_stat_tps_ratio.err_info_stat.lv_err_mem "Failure is stored in dynamic memory (2nd layer)" UWORD _CNV_S_2_RANGE__0___1_CM 1 100. 0. 1. DISPLAY_IDENTIFIER LV_ERR_MEM_TPS_RATIO ECU_ADDRESS 0xd00045fe BIT_MASK 0x8 /end MEASUREMENT
/begin MEASUREMENT fmy_stat_tps_ratio.err_info_stat.lv_ready "Readiness flag related to diagnosis XX" UWORD _CNV_S_2_RANGE__0___1_CM 1 100. 0. 1. DISPLAY_IDENTIFIER LV_READY_TPS_RATIO ECU_ADDRESS 0xd00045fe BIT_MASK 0x10 /end MEASUREMENT
/begin MEASUREMENT fmy_stat_tps_ratio.err_info_stat.lv_end_diag "End of diagnosis XX" UWORD _CNV_S_2_RANGE__0___1_CM 1 100. 0. 1. DISPLAY_IDENTIFIER LV_END_DIAG_TPS_RATIO ECU_ADDRESS 0xd00045fe BIT_MASK 0x20 /end MEASUREMENT
/begin MEASUREMENT fmy_stat_tps_ratio.err_info_stat.lv_cdn_diag "Diagnosis condition to start symptom detection (set to 1 when condition is fulfilled)" UWORD _CNV_S_2_RANGE__0___1_CM 1 100. 0. 1. DISPLAY_IDENTIFIER LV_CDN_DIAG_TPS_RATIO ECU_ADDRESS 0xd00045fe BIT_MASK 0x40 /end MEASUREMENT
/begin MEASUREMENT fmy_stat_tps_ratio.err_info_stat.err_sym "For each symptom: status of failure (set to 1 when failure symptom is detected)" UWORD _CNV_S_16_RANGE_ERR__485_CM 1 100. 0. 15. DISPLAY_IDENTIFIER ERR_SYM_TPS_RATIO ECU_ADDRESS 0xd00045fe BIT_MASK 0x780 /end MEASUREMENT
/begin MEASUREMENT fmy_stat_v_ref_1.ctr_abc "anti-bounce counter for diagnosis XX" UBYTE _CNV_A_R_LINEAR_____0_CM 1 100. 0. 255. DISPLAY_IDENTIFIER CTR_ABC_V_REF_1 ECU_ADDRESS 0xd0004624 FORMAT "%3.0" /end MEASUREMENT
/begin MEASUREMENT fmy_stat_v_ref_1.ctr_end_diag "Counter for the end of diagnosis XX generation" UBYTE _CNV_A_R_LINEAR_____0_CM 1 100. 0. 255. DISPLAY_IDENTIFIER CTR_ABC_END_DIAG_V_REF_1 ECU_ADDRESS 0xd0004625 FORMAT "%3.0" /end MEASUREMENT
/begin MEASUREMENT fmy_stat_v_ref_1.err_info_stat.lv_err_mem "Failure is stored in dynamic memory (2nd layer)" UWORD _CNV_S_2_RANGE__0___1_CM 1 100. 0. 1. DISPLAY_IDENTIFIER LV_ERR_MEM_V_REF_1 ECU_ADDRESS 0xd0004626 BIT_MASK 0x8 /end MEASUREMENT
/begin MEASUREMENT fmy_stat_v_ref_1.err_info_stat.lv_ready "Readiness flag related to diagnosis XX" UWORD _CNV_S_2_RANGE__0___1_CM 1 100. 0. 1. DISPLAY_IDENTIFIER LV_READY_V_REF_1 ECU_ADDRESS 0xd0004626 BIT_MASK 0x10 /end MEASUREMENT
/begin MEASUREMENT fmy_stat_v_ref_1.err_info_stat.lv_end_diag "End of diagnosis XX" UWORD _CNV_S_2_RANGE__0___1_CM 1 100. 0. 1. DISPLAY_IDENTIFIER LV_END_DIAG_V_REF_1 ECU_ADDRESS 0xd0004626 BIT_MASK 0x20 /end MEASUREMENT
/begin MEASUREMENT fmy_stat_v_ref_1.err_info_stat.lv_cdn_diag "Diagnosis condition to start symptom detection (set to 1 when condition is fulfilled)" UWORD _CNV_S_2_RANGE__0___1_CM 1 100. 0. 1. DISPLAY_IDENTIFIER LV_CDN_DIAG_V_REF_1 ECU_ADDRESS 0xd0004626 BIT_MASK 0x40 /end MEASUREMENT
/begin MEASUREMENT fmy_stat_v_ref_1.err_info_stat.err_sym "For each symptom: status of failure (set to 1 when failure symptom is detected)" UWORD _CNV_S_16_RANGE_ERR__485_CM 1 100. 0. 15. DISPLAY_IDENTIFIER ERR_SYM_V_REF_1 ECU_ADDRESS 0xd0004626 BIT_MASK 0x780 /end MEASUREMENT
/begin MEASUREMENT fmy_stat_v_ref_2.ctr_abc "anti-bounce counter for diagnosis XX" UBYTE _CNV_A_R_LINEAR_____0_CM 1 100. 0. 255. DISPLAY_IDENTIFIER CTR_ABC_V_REF_2 ECU_ADDRESS 0xd0004628 FORMAT "%3.0" /end MEASUREMENT
/begin MEASUREMENT fmy_stat_v_ref_2.ctr_end_diag "Counter for the end of diagnosis XX generation" UBYTE _CNV_A_R_LINEAR_____0_CM 1 100. 0. 255. DISPLAY_IDENTIFIER CTR_ABC_END_DIAG_V_REF_2 ECU_ADDRESS 0xd0004629 FORMAT "%3.0" /end MEASUREMENT
/begin MEASUREMENT fmy_stat_v_ref_2.err_info_stat.lv_err_mem "Failure is stored in dynamic memory (2nd layer)" UWORD _CNV_S_2_RANGE__0___1_CM 1 100. 0. 1. DISPLAY_IDENTIFIER LV_ERR_MEM_V_REF_2 ECU_ADDRESS 0xd000462a BIT_MASK 0x8 /end MEASUREMENT
/begin MEASUREMENT fmy_stat_v_ref_2.err_info_stat.lv_ready "Readiness flag related to diagnosis XX" UWORD _CNV_S_2_RANGE__0___1_CM 1 100. 0. 1. DISPLAY_IDENTIFIER LV_READY_V_REF_2 ECU_ADDRESS 0xd000462a BIT_MASK 0x10 /end MEASUREMENT
/begin MEASUREMENT fmy_stat_v_ref_2.err_info_stat.lv_end_diag "End of diagnosis XX" UWORD _CNV_S_2_RANGE__0___1_CM 1 100. 0. 1. DISPLAY_IDENTIFIER LV_END_DIAG_V_REF_2 ECU_ADDRESS 0xd000462a BIT_MASK 0x20 /end MEASUREMENT
/begin MEASUREMENT fmy_stat_v_ref_2.err_info_stat.lv_cdn_diag "Diagnosis condition to start symptom detection (set to 1 when condition is fulfilled)" UWORD _CNV_S_2_RANGE__0___1_CM 1 100. 0. 1. DISPLAY_IDENTIFIER LV_CDN_DIAG_V_REF_2 ECU_ADDRESS 0xd000462a BIT_MASK 0x40 /end MEASUREMENT
/begin MEASUREMENT fmy_stat_v_ref_2.err_info_stat.err_sym "For each symptom: status of failure (set to 1 when failure symptom is detected)" UWORD _CNV_S_16_RANGE_ERR__485_CM 1 100. 0. 15. DISPLAY_IDENTIFIER ERR_SYM_V_REF_2 ECU_ADDRESS 0xd000462a BIT_MASK 0x780 /end MEASUREMENT
/begin MEASUREMENT fmy_stat_pvs_1.ctr_abc "anti-bounce counter for diagnosis XX" UBYTE _CNV_A_R_LINEAR_____0_CM 1 100. 0. 255. DISPLAY_IDENTIFIER CTR_ABC_PVS_1 ECU_ADDRESS 0xd00044bc FORMAT "%3.0" /end MEASUREMENT
/begin MEASUREMENT fmy_stat_pvs_1.ctr_end_diag "Counter for the end of diagnosis XX generation" UBYTE _CNV_A_R_LINEAR_____0_CM 1 100. 0. 255. DISPLAY_IDENTIFIER CTR_ABC_END_DIAG_PVS_1 ECU_ADDRESS 0xd00044bd FORMAT "%3.0" /end MEASUREMENT
/begin MEASUREMENT fmy_stat_pvs_1.err_info_stat.lv_err_mem "Failure is stored in dynamic memory (2nd layer)" UWORD _CNV_S_2_RANGE__0___1_CM 1 100. 0. 1. DISPLAY_IDENTIFIER LV_ERR_MEM_PVS_1 ECU_ADDRESS 0xd00044be BIT_MASK 0x8 /end MEASUREMENT
/begin MEASUREMENT fmy_stat_pvs_1.err_info_stat.lv_ready "Readiness flag related to diagnosis XX" UWORD _CNV_S_2_RANGE__0___1_CM 1 100. 0. 1. DISPLAY_IDENTIFIER LV_READY_PVS_1 ECU_ADDRESS 0xd00044be BIT_MASK 0x10 /end MEASUREMENT
/begin MEASUREMENT fmy_stat_pvs_1.err_info_stat.lv_end_diag "End of diagnosis XX" UWORD _CNV_S_2_RANGE__0___1_CM 1 100. 0. 1. DISPLAY_IDENTIFIER LV_END_DIAG_PVS_1 ECU_ADDRESS 0xd00044be BIT_MASK 0x20 /end MEASUREMENT
/begin MEASUREMENT fmy_stat_pvs_1.err_info_stat.lv_cdn_diag "Diagnosis condition to start symptom detection (set to 1 when condition is fulfilled)" UWORD _CNV_S_2_RANGE__0___1_CM 1 100. 0. 1. DISPLAY_IDENTIFIER LV_CDN_DIAG_PVS_1 ECU_ADDRESS 0xd00044be BIT_MASK 0x40 /end MEASUREMENT
/begin MEASUREMENT fmy_stat_pvs_1.err_info_stat.err_sym "For each symptom: status of failure (set to 1 when failure symptom is detected)" UWORD _CNV_S_16_RANGE_ERR__485_CM 1 100. 0. 15. DISPLAY_IDENTIFIER ERR_SYM_PVS_1 ECU_ADDRESS 0xd00044be BIT_MASK 0x780 /end MEASUREMENT
/begin MEASUREMENT fmy_stat_pvs_2.ctr_abc "anti-bounce counter for diagnosis XX" UBYTE _CNV_A_R_LINEAR_____0_CM 1 100. 0. 255. DISPLAY_IDENTIFIER CTR_ABC_PVS_2 ECU_ADDRESS 0xd00044c0 FORMAT "%3.0" /end MEASUREMENT
/begin MEASUREMENT fmy_stat_pvs_2.ctr_end_diag "Counter for the end of diagnosis XX generation" UBYTE _CNV_A_R_LINEAR_____0_CM 1 100. 0. 255. DISPLAY_IDENTIFIER CTR_ABC_END_DIAG_PVS_2 ECU_ADDRESS 0xd00044c1 FORMAT "%3.0" /end MEASUREMENT
/begin MEASUREMENT fmy_stat_pvs_2.err_info_stat.lv_err_mem "Failure is stored in dynamic memory (2nd layer)" UWORD _CNV_S_2_RANGE__0___1_CM 1 100. 0. 1. DISPLAY_IDENTIFIER LV_ERR_MEM_PVS_2 ECU_ADDRESS 0xd00044c2 BIT_MASK 0x8 /end MEASUREMENT
/begin MEASUREMENT fmy_stat_pvs_2.err_info_stat.lv_ready "Readiness flag related to diagnosis XX" UWORD _CNV_S_2_RANGE__0___1_CM 1 100. 0. 1. DISPLAY_IDENTIFIER LV_READY_PVS_2 ECU_ADDRESS 0xd00044c2 BIT_MASK 0x10 /end MEASUREMENT
/begin MEASUREMENT fmy_stat_pvs_2.err_info_stat.lv_end_diag "End of diagnosis XX" UWORD _CNV_S_2_RANGE__0___1_CM 1 100. 0. 1. DISPLAY_IDENTIFIER LV_END_DIAG_PVS_2 ECU_ADDRESS 0xd00044c2 BIT_MASK 0x20 /end MEASUREMENT
/begin MEASUREMENT fmy_stat_pvs_2.err_info_stat.lv_cdn_diag "Diagnosis condition to start symptom detection (set to 1 when condition is fulfilled)" UWORD _CNV_S_2_RANGE__0___1_CM 1 100. 0. 1. DISPLAY_IDENTIFIER LV_CDN_DIAG_PVS_2 ECU_ADDRESS 0xd00044c2 BIT_MASK 0x40 /end MEASUREMENT
/begin MEASUREMENT fmy_stat_pvs_2.err_info_stat.err_sym "For each symptom: status of failure (set to 1 when failure symptom is detected)" UWORD _CNV_S_16_RANGE_ERR__485_CM 1 100. 0. 15. DISPLAY_IDENTIFIER ERR_SYM_PVS_2 ECU_ADDRESS 0xd00044c2 BIT_MASK 0x780 /end MEASUREMENT
/begin MEASUREMENT fmy_stat_pvs_ratio.ctr_abc "anti-bounce counter for diagnosis XX" UBYTE _CNV_A_R_LINEAR_____0_CM 1 100. 0. 255. DISPLAY_IDENTIFIER CTR_ABC_PVS_RATIO ECU_ADDRESS 0xd00044d0 FORMAT "%3.0" /end MEASUREMENT
/begin MEASUREMENT fmy_stat_pvs_ratio.ctr_end_diag "Counter for the end of diagnosis XX generation" UBYTE _CNV_A_R_LINEAR_____0_CM 1 100. 0. 255. DISPLAY_IDENTIFIER CTR_ABC_END_DIAG_PVS_RATIO ECU_ADDRESS 0xd00044d1 FORMAT "%3.0" /end MEASUREMENT
/begin MEASUREMENT fmy_stat_pvs_ratio.err_info_stat.lv_err_mem "Failure is stored in dynamic memory (2nd layer)" UWORD _CNV_S_2_RANGE__0___1_CM 1 100. 0. 1. DISPLAY_IDENTIFIER LV_ERR_MEM_PVS_RATIO ECU_ADDRESS 0xd00044d2 BIT_MASK 0x8 /end MEASUREMENT
/begin MEASUREMENT fmy_stat_pvs_ratio.err_info_stat.lv_ready "Readiness flag related to diagnosis XX" UWORD _CNV_S_2_RANGE__0___1_CM 1 100. 0. 1. DISPLAY_IDENTIFIER LV_READY_PVS_RATIO ECU_ADDRESS 0xd00044d2 BIT_MASK 0x10 /end MEASUREMENT
/begin MEASUREMENT fmy_stat_pvs_ratio.err_info_stat.lv_end_diag "End of diagnosis XX" UWORD _CNV_S_2_RANGE__0___1_CM 1 100. 0. 1. DISPLAY_IDENTIFIER LV_END_DIAG_PVS_RATIO ECU_ADDRESS 0xd00044d2 BIT_MASK 0x20 /end MEASUREMENT
/begin MEASUREMENT fmy_stat_pvs_ratio.err_info_stat.lv_cdn_diag "Diagnosis condition to start symptom detection (set to 1 when condition is fulfilled)" UWORD _CNV_S_2_RANGE__0___1_CM 1 100. 0. 1. DISPLAY_IDENTIFIER LV_CDN_DIAG_PVS_RATIO ECU_ADDRESS 0xd00044d2 BIT_MASK 0x40 /end MEASUREMENT
/begin MEASUREMENT fmy_stat_pvs_ratio.err_info_stat.err_sym "For each symptom: status of failure (set to 1 when failure symptom is detected)" UWORD _CNV_S_16_RANGE_ERR__485_CM 1 100. 0. 15. DISPLAY_IDENTIFIER ERR_SYM_PVS_RATIO ECU_ADDRESS 0xd00044d2 BIT_MASK 0x780 /end MEASUREMENT
/begin MEASUREMENT fmy_stat_pvs_double.ctr_abc "anti-bounce counter for diagnosis XX" UBYTE _CNV_A_R_LINEAR_____0_CM 1 100. 0. 255. DISPLAY_IDENTIFIER CTR_ABC_PVS_DOUBLE ECU_ADDRESS 0xd00044c8 FORMAT "%3.0" /end MEASUREMENT
/begin MEASUREMENT fmy_stat_pvs_double.ctr_end_diag "Counter for the end of diagnosis XX generation" UBYTE _CNV_A_R_LINEAR_____0_CM 1 100. 0. 255. DISPLAY_IDENTIFIER CTR_ABC_END_DIAG_PVS_DOUBLE ECU_ADDRESS 0xd00044c9 FORMAT "%3.0" /end MEASUREMENT
/begin MEASUREMENT fmy_stat_pvs_double.err_info_stat.lv_err_mem "Failure is stored in dynamic memory (2nd layer)" UWORD _CNV_S_2_RANGE__0___1_CM 1 100. 0. 1. DISPLAY_IDENTIFIER LV_ERR_MEM_PVS_DOUBLE ECU_ADDRESS 0xd00044ca BIT_MASK 0x8 /end MEASUREMENT
/begin MEASUREMENT fmy_stat_pvs_double.err_info_stat.lv_ready "Readiness flag related to diagnosis XX" UWORD _CNV_S_2_RANGE__0___1_CM 1 100. 0. 1. DISPLAY_IDENTIFIER LV_READY_PVS_DOUBLE ECU_ADDRESS 0xd00044ca BIT_MASK 0x10 /end MEASUREMENT
/begin MEASUREMENT fmy_stat_pvs_double.err_info_stat.lv_end_diag "End of diagnosis XX" UWORD _CNV_S_2_RANGE__0___1_CM 1 100. 0. 1. DISPLAY_IDENTIFIER LV_END_DIAG_PVS_DOUBLE ECU_ADDRESS 0xd00044ca BIT_MASK 0x20 /end MEASUREMENT
/begin MEASUREMENT fmy_stat_pvs_double.err_info_stat.lv_cdn_diag "Diagnosis condition to start symptom detection (set to 1 when condition is fulfilled)" UWORD _CNV_S_2_RANGE__0___1_CM 1 100. 0. 1. DISPLAY_IDENTIFIER LV_CDN_DIAG_PVS_DOUBLE ECU_ADDRESS 0xd00044ca BIT_MASK 0x40 /end MEASUREMENT
/begin MEASUREMENT fmy_stat_pvs_double.err_info_stat.err_sym "For each symptom: status of failure (set to 1 when failure symptom is detected)" UWORD _CNV_S_16_RANGE_ERR__485_CM 1 100. 0. 15. DISPLAY_IDENTIFIER ERR_SYM_PVS_DOUBLE ECU_ADDRESS 0xd00044ca BIT_MASK 0x780 /end MEASUREMENT
/begin MEASUREMENT fmy_stat_pvs_bls_not_plaus.ctr_abc "anti-bounce counter for diagnosis XX" UBYTE _CNV_A_R_LINEAR_____0_CM 1 100. 0. 255. DISPLAY_IDENTIFIER CTR_ABC_PVS_BLS_NOT_PLAUS ECU_ADDRESS 0xd00044c4 FORMAT "%3.0" /end MEASUREMENT
/begin MEASUREMENT fmy_stat_pvs_bls_not_plaus.ctr_end_diag "Counter for the end of diagnosis XX generation" UBYTE _CNV_A_R_LINEAR_____0_CM 1 100. 0. 255. DISPLAY_IDENTIFIER CTR_ABC_END_DIAG_PVS_BLS_NOT_PLAUS ECU_ADDRESS 0xd00044c5 FORMAT "%3.0" /end MEASUREMENT
/begin MEASUREMENT fmy_stat_pvs_bls_not_plaus.err_info_stat.lv_err_mem "Failure is stored in dynamic memory (2nd layer)" UWORD _CNV_S_2_RANGE__0___1_CM 1 100. 0. 1. DISPLAY_IDENTIFIER LV_ERR_MEM_PVS_BLS_NOT_PLAUS ECU_ADDRESS 0xd00044c6 BIT_MASK 0x8 /end MEASUREMENT
/begin MEASUREMENT fmy_stat_pvs_bls_not_plaus.err_info_stat.lv_ready "Readiness flag related to diagnosis XX" UWORD _CNV_S_2_RANGE__0___1_CM 1 100. 0. 1. DISPLAY_IDENTIFIER LV_READY_PVS_BLS_NOT_PLAUS ECU_ADDRESS 0xd00044c6 BIT_MASK 0x10 /end MEASUREMENT
/begin MEASUREMENT fmy_stat_pvs_bls_not_plaus.err_info_stat.lv_end_diag "End of diagnosis XX" UWORD _CNV_S_2_RANGE__0___1_CM 1 100. 0. 1. DISPLAY_IDENTIFIER LV_END_DIAG_PVS_BLS_NOT_PLAUS ECU_ADDRESS 0xd00044c6 BIT_MASK 0x20 /end MEASUREMENT
/begin MEASUREMENT fmy_stat_pvs_bls_not_plaus.err_info_stat.lv_cdn_diag "Diagnosis condition to start symptom detection (set to 1 when condition is fulfilled)" UWORD _CNV_S_2_RANGE__0___1_CM 1 100. 0. 1. DISPLAY_IDENTIFIER LV_CDN_DIAG_PVS_BLS_NOT_PLAUS ECU_ADDRESS 0xd00044c6 BIT_MASK 0x40 /end MEASUREMENT
/begin MEASUREMENT fmy_stat_pvs_bls_not_plaus.err_info_stat.err_sym "For each symptom: status of failure (set to 1 when failure symptom is detected)" UWORD _CNV_S_16_RANGE_ERR__485_CM 1 100. 0. 15. DISPLAY_IDENTIFIER ERR_SYM_PVS_BLS_NOT_PLAUS ECU_ADDRESS 0xd00044c6 BIT_MASK 0x780 /end MEASUREMENT
/begin MEASUREMENT fmy_stat_mtc_dr.ctr_abc "anti-bounce counter for diagnosis XX" UBYTE _CNV_A_R_LINEAR_____0_CM 1 100. 0. 255. DISPLAY_IDENTIFIER CTR_ABC_MTC_DR ECU_ADDRESS 0xd000444c FORMAT "%3.0" /end MEASUREMENT
/begin MEASUREMENT fmy_stat_mtc_dr.ctr_end_diag "Counter for the end of diagnosis XX generation" UBYTE _CNV_A_R_LINEAR_____0_CM 1 100. 0. 255. DISPLAY_IDENTIFIER CTR_ABC_END_DIAG_MTC_DR ECU_ADDRESS 0xd000444d FORMAT "%3.0" /end MEASUREMENT
/begin MEASUREMENT fmy_stat_mtc_dr.err_info_stat.lv_err_mem "Failure is stored in dynamic memory (2nd layer)" UWORD _CNV_S_2_RANGE__0___1_CM 1 100. 0. 1. DISPLAY_IDENTIFIER LV_ERR_MEM_MTC_DR ECU_ADDRESS 0xd000444e BIT_MASK 0x8 /end MEASUREMENT
/begin MEASUREMENT fmy_stat_mtc_dr.err_info_stat.lv_ready "Readiness flag related to diagnosis XX" UWORD _CNV_S_2_RANGE__0___1_CM 1 100. 0. 1. DISPLAY_IDENTIFIER LV_READY_MTC_DR ECU_ADDRESS 0xd000444e BIT_MASK 0x10 /end MEASUREMENT
/begin MEASUREMENT fmy_stat_mtc_dr.err_info_stat.lv_end_diag "End of diagnosis XX" UWORD _CNV_S_2_RANGE__0___1_CM 1 100. 0. 1. DISPLAY_IDENTIFIER LV_END_DIAG_MTC_DR ECU_ADDRESS 0xd000444e BIT_MASK 0x20 /end MEASUREMENT
/begin MEASUREMENT fmy_stat_mtc_dr.err_info_stat.lv_cdn_diag "Diagnosis condition to start symptom detection (set to 1 when condition is fulfilled)" UWORD _CNV_S_2_RANGE__0___1_CM 1 100. 0. 1. DISPLAY_IDENTIFIER LV_CDN_DIAG_MTC_DR ECU_ADDRESS 0xd000444e BIT_MASK 0x40 /end MEASUREMENT
/begin MEASUREMENT fmy_stat_mtc_dr.err_info_stat.err_sym "For each symptom: status of failure (set to 1 when failure symptom is detected)" UWORD _CNV_S_16_RANGE_ERR__485_CM 1 100. 0. 15. DISPLAY_IDENTIFIER ERR_SYM_MTC_DR ECU_ADDRESS 0xd000444e BIT_MASK 0x780 /end MEASUREMENT
/begin MEASUREMENT fmy_stat_mtc_ctl_1.ctr_abc "anti-bounce counter for diagnosis XX" UBYTE _CNV_A_R_LINEAR_____0_CM 1 100. 0. 255. DISPLAY_IDENTIFIER CTR_ABC_MTC_CTL_1 ECU_ADDRESS 0xd0004440 FORMAT "%3.0" /end MEASUREMENT
/begin MEASUREMENT fmy_stat_mtc_ctl_1.ctr_end_diag "Counter for the end of diagnosis XX generation" UBYTE _CNV_A_R_LINEAR_____0_CM 1 100. 0. 255. DISPLAY_IDENTIFIER CTR_ABC_END_DIAG_MTC_CTL_1 ECU_ADDRESS 0xd0004441 FORMAT "%3.0" /end MEASUREMENT
/begin MEASUREMENT fmy_stat_mtc_ctl_1.err_info_stat.lv_err_mem "Failure is stored in dynamic memory (2nd layer)" UWORD _CNV_S_2_RANGE__0___1_CM 1 100. 0. 1. DISPLAY_IDENTIFIER LV_ERR_MEM_MTC_CTL_1 ECU_ADDRESS 0xd0004442 BIT_MASK 0x8 /end MEASUREMENT
/begin MEASUREMENT fmy_stat_mtc_ctl_1.err_info_stat.lv_ready "Readiness flag related to diagnosis XX" UWORD _CNV_S_2_RANGE__0___1_CM 1 100. 0. 1. DISPLAY_IDENTIFIER LV_READY_MTC_CTL_1 ECU_ADDRESS 0xd0004442 BIT_MASK 0x10 /end MEASUREMENT
/begin MEASUREMENT fmy_stat_mtc_ctl_1.err_info_stat.lv_end_diag "End of diagnosis XX" UWORD _CNV_S_2_RANGE__0___1_CM 1 100. 0. 1. DISPLAY_IDENTIFIER LV_END_DIAG_MTC_CTL_1 ECU_ADDRESS 0xd0004442 BIT_MASK 0x20 /end MEASUREMENT
/begin MEASUREMENT fmy_stat_mtc_ctl_1.err_info_stat.lv_cdn_diag "Diagnosis condition to start symptom detection (set to 1 when condition is fulfilled)" UWORD _CNV_S_2_RANGE__0___1_CM 1 100. 0. 1. DISPLAY_IDENTIFIER LV_CDN_DIAG_MTC_CTL_1 ECU_ADDRESS 0xd0004442 BIT_MASK 0x40 /end MEASUREMENT
/begin MEASUREMENT fmy_stat_mtc_ctl_1.err_info_stat.err_sym "For each symptom: status of failure (set to 1 when failure symptom is detected)" UWORD _CNV_S_16_RANGE_ERR__485_CM 1 100. 0. 15. DISPLAY_IDENTIFIER ERR_SYM_MTC_CTL_1 ECU_ADDRESS 0xd0004442 BIT_MASK 0x780 /end MEASUREMENT
/begin MEASUREMENT fmy_stat_mtc_ctl_2.ctr_abc "anti-bounce counter for diagnosis XX" UBYTE _CNV_A_R_LINEAR_____0_CM 1 100. 0. 255. DISPLAY_IDENTIFIER CTR_ABC_MTC_CTL_2 ECU_ADDRESS 0xd0004444 FORMAT "%3.0" /end MEASUREMENT
/begin MEASUREMENT fmy_stat_mtc_ctl_2.ctr_end_diag "Counter for the end of diagnosis XX generation" UBYTE _CNV_A_R_LINEAR_____0_CM 1 100. 0. 255. DISPLAY_IDENTIFIER CTR_ABC_END_DIAG_MTC_CTL_2 ECU_ADDRESS 0xd0004445 FORMAT "%3.0" /end MEASUREMENT
/begin MEASUREMENT fmy_stat_mtc_ctl_2.err_info_stat.lv_err_mem "Failure is stored in dynamic memory (2nd layer)" UWORD _CNV_S_2_RANGE__0___1_CM 1 100. 0. 1. DISPLAY_IDENTIFIER LV_ERR_MEM_MTC_CTL_2 ECU_ADDRESS 0xd0004446 BIT_MASK 0x8 /end MEASUREMENT
/begin MEASUREMENT fmy_stat_mtc_ctl_2.err_info_stat.lv_ready "Readiness flag related to diagnosis XX" UWORD _CNV_S_2_RANGE__0___1_CM 1 100. 0. 1. DISPLAY_IDENTIFIER LV_READY_MTC_CTL_2 ECU_ADDRESS 0xd0004446 BIT_MASK 0x10 /end MEASUREMENT
/begin MEASUREMENT fmy_stat_mtc_ctl_2.err_info_stat.lv_end_diag "End of diagnosis XX" UWORD _CNV_S_2_RANGE__0___1_CM 1 100. 0. 1. DISPLAY_IDENTIFIER LV_END_DIAG_MTC_CTL_2 ECU_ADDRESS 0xd0004446 BIT_MASK 0x20 /end MEASUREMENT
/begin MEASUREMENT fmy_stat_mtc_ctl_2.err_info_stat.lv_cdn_diag "Diagnosis condition to start symptom detection (set to 1 when condition is fulfilled)" UWORD _CNV_S_2_RANGE__0___1_CM 1 100. 0. 1. DISPLAY_IDENTIFIER LV_CDN_DIAG_MTC_CTL_2 ECU_ADDRESS 0xd0004446 BIT_MASK 0x40 /end MEASUREMENT
/begin MEASUREMENT fmy_stat_mtc_ctl_2.err_info_stat.err_sym "For each symptom: status of failure (set to 1 when failure symptom is detected)" UWORD _CNV_S_16_RANGE_ERR__485_CM 1 100. 0. 15. DISPLAY_IDENTIFIER ERR_SYM_MTC_CTL_2 ECU_ADDRESS 0xd0004446 BIT_MASK 0x780 /end MEASUREMENT
/begin MEASUREMENT fmy_stat_mtc_ctl_3.ctr_abc "anti-bounce counter for diagnosis XX" UBYTE _CNV_A_R_LINEAR_____0_CM 1 100. 0. 255. DISPLAY_IDENTIFIER CTR_ABC_MTC_CTL_3 ECU_ADDRESS 0xd0004448 FORMAT "%3.0" /end MEASUREMENT
/begin MEASUREMENT fmy_stat_mtc_ctl_3.ctr_end_diag "Counter for the end of diagnosis XX generation" UBYTE _CNV_A_R_LINEAR_____0_CM 1 100. 0. 255. DISPLAY_IDENTIFIER CTR_ABC_END_DIAG_MTC_CTL_3 ECU_ADDRESS 0xd0004449 FORMAT "%3.0" /end MEASUREMENT
/begin MEASUREMENT fmy_stat_mtc_ctl_3.err_info_stat.lv_err_mem "Failure is stored in dynamic memory (2nd layer)" UWORD _CNV_S_2_RANGE__0___1_CM 1 100. 0. 1. DISPLAY_IDENTIFIER LV_ERR_MEM_MTC_CTL_3 ECU_ADDRESS 0xd000444a BIT_MASK 0x8 /end MEASUREMENT
/begin MEASUREMENT fmy_stat_mtc_ctl_3.err_info_stat.lv_ready "Readiness flag related to diagnosis XX" UWORD _CNV_S_2_RANGE__0___1_CM 1 100. 0. 1. DISPLAY_IDENTIFIER LV_READY_MTC_CTL_3 ECU_ADDRESS 0xd000444a BIT_MASK 0x10 /end MEASUREMENT
/begin MEASUREMENT fmy_stat_mtc_ctl_3.err_info_stat.lv_end_diag "End of diagnosis XX" UWORD _CNV_S_2_RANGE__0___1_CM 1 100. 0. 1. DISPLAY_IDENTIFIER LV_END_DIAG_MTC_CTL_3 ECU_ADDRESS 0xd000444a BIT_MASK 0x20 /end MEASUREMENT
/begin MEASUREMENT fmy_stat_mtc_ctl_3.err_info_stat.lv_cdn_diag "Diagnosis condition to start symptom detection (set to 1 when condition is fulfilled)" UWORD _CNV_S_2_RANGE__0___1_CM 1 100. 0. 1. DISPLAY_IDENTIFIER LV_CDN_DIAG_MTC_CTL_3 ECU_ADDRESS 0xd000444a BIT_MASK 0x40 /end MEASUREMENT
/begin MEASUREMENT fmy_stat_mtc_ctl_3.err_info_stat.err_sym "For each symptom: status of failure (set to 1 when failure symptom is detected)" UWORD _CNV_S_16_RANGE_ERR__485_CM 1 100. 0. 15. DISPLAY_IDENTIFIER ERR_SYM_MTC_CTL_3 ECU_ADDRESS 0xd000444a BIT_MASK 0x780 /end MEASUREMENT
/begin MEASUREMENT fmy_stat_tps_ad.ctr_abc "anti-bounce counter for diagnosis XX" UBYTE _CNV_A_R_LINEAR_____0_CM 1 100. 0. 255. DISPLAY_IDENTIFIER CTR_ABC_TPS_AD ECU_ADDRESS 0xd00045ec FORMAT "%3.0" /end MEASUREMENT
/begin MEASUREMENT fmy_stat_tps_ad.ctr_end_diag "Counter for the end of diagnosis XX generation" UBYTE _CNV_A_R_LINEAR_____0_CM 1 100. 0. 255. DISPLAY_IDENTIFIER CTR_ABC_END_DIAG_TPS_AD ECU_ADDRESS 0xd00045ed FORMAT "%3.0" /end MEASUREMENT
/begin MEASUREMENT fmy_stat_tps_ad.err_info_stat.lv_err_mem "Failure is stored in dynamic memory (2nd layer)" UWORD _CNV_S_2_RANGE__0___1_CM 1 100. 0. 1. DISPLAY_IDENTIFIER LV_ERR_MEM_TPS_AD ECU_ADDRESS 0xd00045ee BIT_MASK 0x8 /end MEASUREMENT
/begin MEASUREMENT fmy_stat_tps_ad.err_info_stat.lv_ready "Readiness flag related to diagnosis XX" UWORD _CNV_S_2_RANGE__0___1_CM 1 100. 0. 1. DISPLAY_IDENTIFIER LV_READY_TPS_AD ECU_ADDRESS 0xd00045ee BIT_MASK 0x10 /end MEASUREMENT
/begin MEASUREMENT fmy_stat_tps_ad.err_info_stat.lv_end_diag "End of diagnosis XX" UWORD _CNV_S_2_RANGE__0___1_CM 1 100. 0. 1. DISPLAY_IDENTIFIER LV_END_DIAG_TPS_AD ECU_ADDRESS 0xd00045ee BIT_MASK 0x20 /end MEASUREMENT
/begin MEASUREMENT fmy_stat_tps_ad.err_info_stat.lv_cdn_diag "Diagnosis condition to start symptom detection (set to 1 when condition is fulfilled)" UWORD _CNV_S_2_RANGE__0___1_CM 1 100. 0. 1. DISPLAY_IDENTIFIER LV_CDN_DIAG_TPS_AD ECU_ADDRESS 0xd00045ee BIT_MASK 0x40 /end MEASUREMENT
/begin MEASUREMENT fmy_stat_tps_ad.err_info_stat.err_sym "For each symptom: status of failure (set to 1 when failure symptom is detected)" UWORD _CNV_S_16_RANGE_ERR__485_CM 1 100. 0. 15. DISPLAY_IDENTIFIER ERR_SYM_TPS_AD ECU_ADDRESS 0xd00045ee BIT_MASK 0x780 /end MEASUREMENT
/begin MEASUREMENT fmy_stat_tps_ad_bol.ctr_abc "anti-bounce counter for diagnosis XX" UBYTE _CNV_A_R_LINEAR_____0_CM 1 100. 0. 255. DISPLAY_IDENTIFIER CTR_ABC_TPS_AD_BOL ECU_ADDRESS 0xd00045f0 FORMAT "%3.0" /end MEASUREMENT
/begin MEASUREMENT fmy_stat_tps_ad_bol.ctr_end_diag "Counter for the end of diagnosis XX generation" UBYTE _CNV_A_R_LINEAR_____0_CM 1 100. 0. 255. DISPLAY_IDENTIFIER CTR_ABC_END_DIAG_TPS_AD_BOL ECU_ADDRESS 0xd00045f1 FORMAT "%3.0" /end MEASUREMENT
/begin MEASUREMENT fmy_stat_tps_ad_bol.err_info_stat.lv_err_mem "Failure is stored in dynamic memory (2nd layer)" UWORD _CNV_S_2_RANGE__0___1_CM 1 100. 0. 1. DISPLAY_IDENTIFIER LV_ERR_MEM_TPS_AD_BOL ECU_ADDRESS 0xd00045f2 BIT_MASK 0x8 /end MEASUREMENT
/begin MEASUREMENT fmy_stat_tps_ad_bol.err_info_stat.lv_ready "Readiness flag related to diagnosis XX" UWORD _CNV_S_2_RANGE__0___1_CM 1 100. 0. 1. DISPLAY_IDENTIFIER LV_READY_TPS_AD_BOL ECU_ADDRESS 0xd00045f2 BIT_MASK 0x10 /end MEASUREMENT
/begin MEASUREMENT fmy_stat_tps_ad_bol.err_info_stat.lv_end_diag "End of diagnosis XX" UWORD _CNV_S_2_RANGE__0___1_CM 1 100. 0. 1. DISPLAY_IDENTIFIER LV_END_DIAG_TPS_AD_BOL ECU_ADDRESS 0xd00045f2 BIT_MASK 0x20 /end MEASUREMENT
/begin MEASUREMENT fmy_stat_tps_ad_bol.err_info_stat.lv_cdn_diag "Diagnosis condition to start symptom detection (set to 1 when condition is fulfilled)" UWORD _CNV_S_2_RANGE__0___1_CM 1 100. 0. 1. DISPLAY_IDENTIFIER LV_CDN_DIAG_TPS_AD_BOL ECU_ADDRESS 0xd00045f2 BIT_MASK 0x40 /end MEASUREMENT
/begin MEASUREMENT fmy_stat_tps_ad_bol.err_info_stat.err_sym "For each symptom: status of failure (set to 1 when failure symptom is detected)" UWORD _CNV_S_16_RANGE_ERR__485_CM 1 100. 0. 15. DISPLAY_IDENTIFIER ERR_SYM_TPS_AD_BOL ECU_ADDRESS 0xd00045f2 BIT_MASK 0x780 /end MEASUREMENT
/begin MEASUREMENT fmy_stat_tps_st_chk_1.ctr_abc "anti-bounce counter for diagnosis XX" UBYTE _CNV_A_R_LINEAR_____0_CM 1 100. 0. 255. DISPLAY_IDENTIFIER CTR_ABC_TPS_ST_CHK_1 ECU_ADDRESS 0xd0004600 FORMAT "%3.0" /end MEASUREMENT
/begin MEASUREMENT fmy_stat_tps_st_chk_1.ctr_end_diag "Counter for the end of diagnosis XX generation" UBYTE _CNV_A_R_LINEAR_____0_CM 1 100. 0. 255. DISPLAY_IDENTIFIER CTR_ABC_END_DIAG_TPS_ST_CHK_1 ECU_ADDRESS 0xd0004601 FORMAT "%3.0" /end MEASUREMENT
/begin MEASUREMENT fmy_stat_tps_st_chk_1.err_info_stat.lv_err_mem "Failure is stored in dynamic memory (2nd layer)" UWORD _CNV_S_2_RANGE__0___1_CM 1 100. 0. 1. DISPLAY_IDENTIFIER LV_ERR_MEM_TPS_ST_CHK_1 ECU_ADDRESS 0xd0004602 BIT_MASK 0x8 /end MEASUREMENT
/begin MEASUREMENT fmy_stat_tps_st_chk_1.err_info_stat.lv_ready "Readiness flag related to diagnosis XX" UWORD _CNV_S_2_RANGE__0___1_CM 1 100. 0. 1. DISPLAY_IDENTIFIER LV_READY_TPS_ST_CHK_1 ECU_ADDRESS 0xd0004602 BIT_MASK 0x10 /end MEASUREMENT
/begin MEASUREMENT fmy_stat_tps_st_chk_1.err_info_stat.lv_end_diag "End of diagnosis XX" UWORD _CNV_S_2_RANGE__0___1_CM 1 100. 0. 1. DISPLAY_IDENTIFIER LV_END_DIAG_TPS_ST_CHK_1 ECU_ADDRESS 0xd0004602 BIT_MASK 0x20 /end MEASUREMENT
/begin MEASUREMENT fmy_stat_tps_st_chk_1.err_info_stat.lv_cdn_diag "Diagnosis condition to start symptom detection (set to 1 when condition is fulfilled)" UWORD _CNV_S_2_RANGE__0___1_CM 1 100. 0. 1. DISPLAY_IDENTIFIER LV_CDN_DIAG_TPS_ST_CHK_1 ECU_ADDRESS 0xd0004602 BIT_MASK 0x40 /end MEASUREMENT
/begin MEASUREMENT fmy_stat_tps_st_chk_1.err_info_stat.err_sym "For each symptom: status of failure (set to 1 when failure symptom is detected)" UWORD _CNV_S_16_RANGE_ERR__485_CM 1 100. 0. 15. DISPLAY_IDENTIFIER ERR_SYM_TPS_ST_CHK_1 ECU_ADDRESS 0xd0004602 BIT_MASK 0x780 /end MEASUREMENT
/begin MEASUREMENT fmy_stat_tps_st_chk_2.ctr_abc "anti-bounce counter for diagnosis XX" UBYTE _CNV_A_R_LINEAR_____0_CM 1 100. 0. 255. DISPLAY_IDENTIFIER CTR_ABC_TPS_ST_CHK_2 ECU_ADDRESS 0xd0004604 FORMAT "%3.0" /end MEASUREMENT
/begin MEASUREMENT fmy_stat_tps_st_chk_2.ctr_end_diag "Counter for the end of diagnosis XX generation" UBYTE _CNV_A_R_LINEAR_____0_CM 1 100. 0. 255. DISPLAY_IDENTIFIER CTR_ABC_END_DIAG_TPS_ST_CHK_2 ECU_ADDRESS 0xd0004605 FORMAT "%3.0" /end MEASUREMENT
/begin MEASUREMENT fmy_stat_tps_st_chk_2.err_info_stat.lv_err_mem "Failure is stored in dynamic memory (2nd layer)" UWORD _CNV_S_2_RANGE__0___1_CM 1 100. 0. 1. DISPLAY_IDENTIFIER LV_ERR_MEM_TPS_ST_CHK_2 ECU_ADDRESS 0xd0004606 BIT_MASK 0x8 /end MEASUREMENT
/begin MEASUREMENT fmy_stat_tps_st_chk_2.err_info_stat.lv_ready "Readiness flag related to diagnosis XX" UWORD _CNV_S_2_RANGE__0___1_CM 1 100. 0. 1. DISPLAY_IDENTIFIER LV_READY_TPS_ST_CHK_2 ECU_ADDRESS 0xd0004606 BIT_MASK 0x10 /end MEASUREMENT
/begin MEASUREMENT fmy_stat_tps_st_chk_2.err_info_stat.lv_end_diag "End of diagnosis XX" UWORD _CNV_S_2_RANGE__0___1_CM 1 100. 0. 1. DISPLAY_IDENTIFIER LV_END_DIAG_TPS_ST_CHK_2 ECU_ADDRESS 0xd0004606 BIT_MASK 0x20 /end MEASUREMENT
/begin MEASUREMENT fmy_stat_tps_st_chk_2.err_info_stat.lv_cdn_diag "Diagnosis condition to start symptom detection (set to 1 when condition is fulfilled)" UWORD _CNV_S_2_RANGE__0___1_CM 1 100. 0. 1. DISPLAY_IDENTIFIER LV_CDN_DIAG_TPS_ST_CHK_2 ECU_ADDRESS 0xd0004606 BIT_MASK 0x40 /end MEASUREMENT
/begin MEASUREMENT fmy_stat_tps_st_chk_2.err_info_stat.err_sym "For each symptom: status of failure (set to 1 when failure symptom is detected)" UWORD _CNV_S_16_RANGE_ERR__485_CM 1 100. 0. 15. DISPLAY_IDENTIFIER ERR_SYM_TPS_ST_CHK_2 ECU_ADDRESS 0xd0004606 BIT_MASK 0x780 /end MEASUREMENT
/begin MEASUREMENT fmy_stat_gen.ctr_abc "anti-bounce counter for diagnosis XX" UBYTE _CNV_A_R_LINEAR_____0_CM 1 100. 0. 255. DISPLAY_IDENTIFIER CTR_ABC_GEN ECU_ADDRESS 0xd0004338 FORMAT "%3.0" /end MEASUREMENT
/begin MEASUREMENT fmy_stat_gen.ctr_end_diag "Counter for the end of diagnosis XX generation" UBYTE _CNV_A_R_LINEAR_____0_CM 1 100. 0. 255. DISPLAY_IDENTIFIER CTR_ABC_END_DIAG_GEN ECU_ADDRESS 0xd0004339 FORMAT "%3.0" /end MEASUREMENT
/begin MEASUREMENT fmy_stat_gen.err_info_stat.lv_err_mem "Failure is stored in dynamic memory (2nd layer)" UWORD _CNV_S_2_RANGE__0___1_CM 1 100. 0. 1. DISPLAY_IDENTIFIER LV_ERR_MEM_GEN ECU_ADDRESS 0xd000433a BIT_MASK 0x8 /end MEASUREMENT
/begin MEASUREMENT fmy_stat_gen.err_info_stat.lv_ready "Readiness flag related to diagnosis XX" UWORD _CNV_S_2_RANGE__0___1_CM 1 100. 0. 1. DISPLAY_IDENTIFIER LV_READY_GEN ECU_ADDRESS 0xd000433a BIT_MASK 0x10 /end MEASUREMENT
/begin MEASUREMENT fmy_stat_gen.err_info_stat.lv_end_diag "End of diagnosis XX" UWORD _CNV_S_2_RANGE__0___1_CM 1 100. 0. 1. DISPLAY_IDENTIFIER LV_END_DIAG_GEN ECU_ADDRESS 0xd000433a BIT_MASK 0x20 /end MEASUREMENT
/begin MEASUREMENT fmy_stat_gen.err_info_stat.lv_cdn_diag "Diagnosis condition to start symptom detection (set to 1 when condition is fulfilled)" UWORD _CNV_S_2_RANGE__0___1_CM 1 100. 0. 1. DISPLAY_IDENTIFIER LV_CDN_DIAG_GEN ECU_ADDRESS 0xd000433a BIT_MASK 0x40 /end MEASUREMENT
/begin MEASUREMENT fmy_stat_gen.err_info_stat.err_sym "For each symptom: status of failure (set to 1 when failure symptom is detected)" UWORD _CNV_S_16_RANGE_ERR__485_CM 1 100. 0. 15. DISPLAY_IDENTIFIER ERR_SYM_GEN ECU_ADDRESS 0xd000433a BIT_MASK 0x780 /end MEASUREMENT
/begin MEASUREMENT fmy_stat_gen_diag.ctr_abc "anti-bounce counter for diagnosis XX" UBYTE _CNV_A_R_LINEAR_____0_CM 1 100. 0. 255. DISPLAY_IDENTIFIER CTR_ABC_GEN_DIAG ECU_ADDRESS 0xd000433c FORMAT "%3.0" /end MEASUREMENT
/begin MEASUREMENT fmy_stat_gen_diag.ctr_end_diag "Counter for the end of diagnosis XX generation" UBYTE _CNV_A_R_LINEAR_____0_CM 1 100. 0. 255. DISPLAY_IDENTIFIER CTR_ABC_END_DIAG_GEN_DIAG ECU_ADDRESS 0xd000433d FORMAT "%3.0" /end MEASUREMENT
/begin MEASUREMENT fmy_stat_gen_diag.err_info_stat.lv_err_mem "Failure is stored in dynamic memory (2nd layer)" UWORD _CNV_S_2_RANGE__0___1_CM 1 100. 0. 1. DISPLAY_IDENTIFIER LV_ERR_MEM_GEN_DIAG ECU_ADDRESS 0xd000433e BIT_MASK 0x8 /end MEASUREMENT
/begin MEASUREMENT fmy_stat_gen_diag.err_info_stat.lv_ready "Readiness flag related to diagnosis XX" UWORD _CNV_S_2_RANGE__0___1_CM 1 100. 0. 1. DISPLAY_IDENTIFIER LV_READY_GEN_DIAG ECU_ADDRESS 0xd000433e BIT_MASK 0x10 /end MEASUREMENT
/begin MEASUREMENT fmy_stat_gen_diag.err_info_stat.lv_end_diag "End of diagnosis XX" UWORD _CNV_S_2_RANGE__0___1_CM 1 100. 0. 1. DISPLAY_IDENTIFIER LV_END_DIAG_GEN_DIAG ECU_ADDRESS 0xd000433e BIT_MASK 0x20 /end MEASUREMENT
/begin MEASUREMENT fmy_stat_gen_diag.err_info_stat.lv_cdn_diag "Diagnosis condition to start symptom detection (set to 1 when condition is fulfilled)" UWORD _CNV_S_2_RANGE__0___1_CM 1 100. 0. 1. DISPLAY_IDENTIFIER LV_CDN_DIAG_GEN_DIAG ECU_ADDRESS 0xd000433e BIT_MASK 0x40 /end MEASUREMENT
/begin MEASUREMENT fmy_stat_gen_diag.err_info_stat.err_sym "For each symptom: status of failure (set to 1 when failure symptom is detected)" UWORD _CNV_S_16_RANGE_ERR__485_CM 1 100. 0. 15. DISPLAY_IDENTIFIER ERR_SYM_GEN_DIAG ECU_ADDRESS 0xd000433e BIT_MASK 0x780 /end MEASUREMENT
/begin MEASUREMENT fmy_stat_alter_bn.ctr_abc "anti-bounce counter for diagnosis XX" UBYTE _CNV_A_R_LINEAR_____0_CM 1 100. 0. 255. DISPLAY_IDENTIFIER CTR_ABC_ALTER_BN ECU_ADDRESS 0xd00041a0 FORMAT "%3.0" /end MEASUREMENT
/begin MEASUREMENT fmy_stat_alter_bn.ctr_end_diag "Counter for the end of diagnosis XX generation" UBYTE _CNV_A_R_LINEAR_____0_CM 1 100. 0. 255. DISPLAY_IDENTIFIER CTR_ABC_END_DIAG_ALTER_BN ECU_ADDRESS 0xd00041a1 FORMAT "%3.0" /end MEASUREMENT
/begin MEASUREMENT fmy_stat_alter_bn.err_info_stat.lv_err_mem "Failure is stored in dynamic memory (2nd layer)" UWORD _CNV_S_2_RANGE__0___1_CM 1 100. 0. 1. DISPLAY_IDENTIFIER LV_ERR_MEM_ALTER_BN ECU_ADDRESS 0xd00041a2 BIT_MASK 0x8 /end MEASUREMENT
/begin MEASUREMENT fmy_stat_alter_bn.err_info_stat.lv_ready "Readiness flag related to diagnosis XX" UWORD _CNV_S_2_RANGE__0___1_CM 1 100. 0. 1. DISPLAY_IDENTIFIER LV_READY_ALTER_BN ECU_ADDRESS 0xd00041a2 BIT_MASK 0x10 /end MEASUREMENT
/begin MEASUREMENT fmy_stat_alter_bn.err_info_stat.lv_end_diag "End of diagnosis XX" UWORD _CNV_S_2_RANGE__0___1_CM 1 100. 0. 1. DISPLAY_IDENTIFIER LV_END_DIAG_ALTER_BN ECU_ADDRESS 0xd00041a2 BIT_MASK 0x20 /end MEASUREMENT
/begin MEASUREMENT fmy_stat_alter_bn.err_info_stat.lv_cdn_diag "Diagnosis condition to start symptom detection (set to 1 when condition is fulfilled)" UWORD _CNV_S_2_RANGE__0___1_CM 1 100. 0. 1. DISPLAY_IDENTIFIER LV_CDN_DIAG_ALTER_BN ECU_ADDRESS 0xd00041a2 BIT_MASK 0x40 /end MEASUREMENT
/begin MEASUREMENT fmy_stat_alter_bn.err_info_stat.err_sym "For each symptom: status of failure (set to 1 when failure symptom is detected)" UWORD _CNV_S_16_RANGE_ERR__485_CM 1 100. 0. 15. DISPLAY_IDENTIFIER ERR_SYM_ALTER_BN ECU_ADDRESS 0xd00041a2 BIT_MASK 0x780 /end MEASUREMENT
/begin MEASUREMENT fmy_stat_alter_bn_bat.ctr_abc "anti-bounce counter for diagnosis XX" UBYTE _CNV_A_R_LINEAR_____0_CM 1 100. 0. 255. DISPLAY_IDENTIFIER CTR_ABC_ALTER_BN_BAT ECU_ADDRESS 0xd00041a4 FORMAT "%3.0" /end MEASUREMENT
/begin MEASUREMENT fmy_stat_alter_bn_bat.ctr_end_diag "Counter for the end of diagnosis XX generation" UBYTE _CNV_A_R_LINEAR_____0_CM 1 100. 0. 255. DISPLAY_IDENTIFIER CTR_ABC_END_DIAG_ALTER_BN_BAT ECU_ADDRESS 0xd00041a5 FORMAT "%3.0" /end MEASUREMENT
/begin MEASUREMENT fmy_stat_alter_bn_bat.err_info_stat.lv_err_mem "Failure is stored in dynamic memory (2nd layer)" UWORD _CNV_S_2_RANGE__0___1_CM 1 100. 0. 1. DISPLAY_IDENTIFIER LV_ERR_MEM_ALTER_BN_BAT ECU_ADDRESS 0xd00041a6 BIT_MASK 0x8 /end MEASUREMENT
/begin CHARACTERISTIC ip_egy_step_inj_cha_grd[0] "Piezo injector energy charge and discharge gradient for a single step" CURVE 0xa10083d8 _REC_CUR_20_u2_u1 100. _CNV_A_R_INJR_LINEA_480_CM 0. 100. DISPLAY_IDENTIFIER IP_EGY_STEP_INJ_CHA_GRD[0] FORMAT "%7.3"
 /begin AXIS_DESCR COM_AXIS tfu_inj _CNV_A_R_LINEAR_____16_CM 6 -48. 142.5 FORMAT "%6.2" AXIS_PTS_REF ldp_tfu_ip_egy_step_inj_cha_grd /end AXIS_DESCR
/end CHARACTERISTIC
/begin CHARACTERISTIC ip_egy_step_inj_cha_grd[1] "Piezo injector energy charge and discharge gradient for a single step" CURVE 0xa10083e4 _REC_CUR_20_u2_u1 100. _CNV_A_R_INJR_LINEA_480_CM 0. 100. DISPLAY_IDENTIFIER IP_EGY_STEP_INJ_CHA_GRD[1] FORMAT "%7.3"
 /begin AXIS_DESCR COM_AXIS tfu_inj _CNV_A_R_LINEAR_____16_CM 6 -48. 142.5 FORMAT "%6.2" AXIS_PTS_REF ldp_tfu_ip_egy_step_inj_cha_grd /end AXIS_DESCR
/end CHARACTERISTIC
/begin CHARACTERISTIC ip_egy_step_inj_cha_grd[2] "Piezo injector energy charge and discharge gradient for a single step" CURVE 0xa10083f0 _REC_CUR_20_u2_u1 100. _CNV_A_R_INJR_LINEA_480_CM 0. 100. DISPLAY_IDENTIFIER IP_EGY_STEP_INJ_CHA_GRD[2] FORMAT "%7.3"
 /begin AXIS_DESCR COM_AXIS tfu_inj _CNV_A_R_LINEAR_____16_CM 6 -48. 142.5 FORMAT "%6.2" AXIS_PTS_REF ldp_tfu_ip_egy_step_inj_cha_grd /end AXIS_DESCR
/end CHARACTERISTIC
/begin CHARACTERISTIC ip_egy_step_inj_cha_grd[3] "Piezo injector energy charge and discharge gradient for a single step" CURVE 0xa10083fc _REC_CUR_20_u2_u1 100. _CNV_A_R_INJR_LINEA_480_CM 0. 100. DISPLAY_IDENTIFIER IP_EGY_STEP_INJ_CHA_GRD[3] FORMAT "%7.3"
 /begin AXIS_DESCR COM_AXIS tfu_inj _CNV_A_R_LINEAR_____16_CM 6 -48. 142.5 FORMAT "%6.2" AXIS_PTS_REF ldp_tfu_ip_egy_step_inj_cha_grd /end AXIS_DESCR
/end CHARACTERISTIC
/begin CHARACTERISTIC ip_egy_step_inj_cha_grd[4] "Piezo injector energy charge and discharge gradient for a single step" CURVE 0xa1008408 _REC_CUR_20_u2_u1 100. _CNV_A_R_INJR_LINEA_480_CM 0. 100. DISPLAY_IDENTIFIER IP_EGY_STEP_INJ_CHA_GRD[4] FORMAT "%7.3"
 /begin AXIS_DESCR COM_AXIS tfu_inj _CNV_A_R_LINEAR_____16_CM 6 -48. 142.5 FORMAT "%6.2" AXIS_PTS_REF ldp_tfu_ip_egy_step_inj_cha_grd /end AXIS_DESCR
/end CHARACTERISTIC
/begin CHARACTERISTIC ip_egy_step_inj_cha_grd[5] "Piezo injector energy charge and discharge gradient for a single step" CURVE 0xa1008414 _REC_CUR_20_u2_u1 100. _CNV_A_R_INJR_LINEA_480_CM 0. 100. DISPLAY_IDENTIFIER IP_EGY_STEP_INJ_CHA_GRD[5] FORMAT "%7.3"
 /begin AXIS_DESCR COM_AXIS tfu_inj _CNV_A_R_LINEAR_____16_CM 6 -48. 142.5 FORMAT "%6.2" AXIS_PTS_REF ldp_tfu_ip_egy_step_inj_cha_grd /end AXIS_DESCR
/end CHARACTERISTIC
/begin CHARACTERISTIC ip_egy_step_inj_add_cor "Piezo injector energy additive charge correction depending on engine speed and load" MAP 0xa1008358 _REC_MAP_20_u2_u2_u2 100. _CNV_A_R_INJR_LINEA_540_CM -50. 50. DISPLAY_IDENTIFIER IP_EGY_STEP_INJ_ADD_COR FORMAT "%7.3"
 /begin AXIS_DESCR COM_AXIS n _CNV_A_R_LINEAR_____13_CM 8 0. 8160. FORMAT "%4.0" AXIS_PTS_REF ldp_n_egy_step_inj_add /end AXIS_DESCR
 /begin AXIS_DESCR COM_AXIS mff_sp_mv _CNV_A_R_LINEAR_____108_CM 8 0. 1389. FORMAT "%7.2" AXIS_PTS_REF ldp_mff_sp_egy_step_inj_add /end AXIS_DESCR
/end CHARACTERISTIC
/begin AXIS_PTS ldp_n_egy_step_inj_add "" 0xa1008228 n _REC_AXS_20_u2 8160. _CNV_A_R_LINEAR_____13_CM 8 0. 8160. FORMAT "%4.0" /end AXIS_PTS
/begin MEASUREMENT min_inj_egy_level "Minimum correction value of injector energy level (calibrateable)" SWORD _CNV_A_R_INJR_LINEA_480_CM 1 100. -50. 50. DISPLAY_IDENTIFIER MIN_INJ_EGY_LEVEL ECU_ADDRESS 0xd0002b24 /end MEASUREMENT
/begin CHARACTERISTIC c_max_inj_egy_level_cor "Maximum correction value of injector energy level" VALUE 0xa1008a2a _REC_VAL_20_s2 100. _CNV_A_R_INJR_LINEA_480_CM -50. 50. DISPLAY_IDENTIFIER C_MAX_INJ_EGY_LEVEL_COR /end CHARACTERISTIC
/begin CHARACTERISTIC c_min_inj_egy_level_cor "Minimum correction value of injector energy level" VALUE 0xa1008a2c _REC_VAL_20_s2 100. _CNV_A_R_INJR_LINEA_480_CM -50. 50. DISPLAY_IDENTIFIER C_MIN_INJ_EGY_LEVEL_COR /end CHARACTERISTIC
/begin MEASUREMENT egy_step_inj_dcha_grd[0] "Piezo injector energy discharge gradient for a single step" UWORD _CNV_A_R_INJR_LINEA_480_CM 1 100. 0. 100. DISPLAY_IDENTIFIER EGY_STEP_INJ_DCHA_GRD[0] ECU_ADDRESS 0xd0002ab4 FORMAT "%7.3" /end MEASUREMENT
/begin MEASUREMENT egy_step_inj_dcha_grd[1] "Piezo injector energy discharge gradient for a single step" UWORD _CNV_A_R_INJR_LINEA_480_CM 1 100. 0. 100. DISPLAY_IDENTIFIER EGY_STEP_INJ_DCHA_GRD[1] ECU_ADDRESS 0xd0002ab6 FORMAT "%7.3" /end MEASUREMENT
/begin MEASUREMENT egy_step_inj_dcha_grd[2] "Piezo injector energy discharge gradient for a single step" UWORD _CNV_A_R_INJR_LINEA_480_CM 1 100. 0. 100. DISPLAY_IDENTIFIER EGY_STEP_INJ_DCHA_GRD[2] ECU_ADDRESS 0xd0002ab8 FORMAT "%7.3" /end MEASUREMENT
/begin MEASUREMENT egy_step_inj_dcha_grd[3] "Piezo injector energy discharge gradient for a single step" UWORD _CNV_A_R_INJR_LINEA_480_CM 1 100. 0. 100. DISPLAY_IDENTIFIER EGY_STEP_INJ_DCHA_GRD[3] ECU_ADDRESS 0xd0002aba FORMAT "%7.3" /end MEASUREMENT
/begin MEASUREMENT egy_step_inj_dcha_grd[4] "Piezo injector energy discharge gradient for a single step" UWORD _CNV_A_R_INJR_LINEA_480_CM 1 100. 0. 100. DISPLAY_IDENTIFIER EGY_STEP_INJ_DCHA_GRD[4] ECU_ADDRESS 0xd0002abc FORMAT "%7.3" /end MEASUREMENT
/begin MEASUREMENT egy_step_inj_dcha_grd[5] "Piezo injector energy discharge gradient for a single step" UWORD _CNV_A_R_INJR_LINEA_480_CM 1 100. 0. 100. DISPLAY_IDENTIFIER EGY_STEP_INJ_DCHA_GRD[5] ECU_ADDRESS 0xd0002abe FORMAT "%7.3" /end MEASUREMENT
/begin MEASUREMENT egy_step_inj_cha_grd_bas[0] "Piezo injector base energy charge gradient for a single step, without adaptation corrections." UWORD _CNV_A_R_INJR_LINEA_480_CM 1 100. 0. 100. DISPLAY_IDENTIFIER EGY_STEP_INJ_CHA_GRD_BAS[0] ECU_ADDRESS 0xd0002a84 FORMAT "%7.3" /end MEASUREMENT
/begin MEASUREMENT egy_step_inj_cha_grd_bas[1] "Piezo injector base energy charge gradient for a single step, without adaptation corrections." UWORD _CNV_A_R_INJR_LINEA_480_CM 1 100. 0. 100. DISPLAY_IDENTIFIER EGY_STEP_INJ_CHA_GRD_BAS[1] ECU_ADDRESS 0xd0002a86 FORMAT "%7.3" /end MEASUREMENT
/begin MEASUREMENT egy_step_inj_cha_grd_bas[2] "Piezo injector base energy charge gradient for a single step, without adaptation corrections." UWORD _CNV_A_R_INJR_LINEA_480_CM 1 100. 0. 100. DISPLAY_IDENTIFIER EGY_STEP_INJ_CHA_GRD_BAS[2] ECU_ADDRESS 0xd0002a88 FORMAT "%7.3" /end MEASUREMENT
/begin MEASUREMENT egy_step_inj_cha_grd_bas[3] "Piezo injector base energy charge gradient for a single step, without adaptation corrections." UWORD _CNV_A_R_INJR_LINEA_480_CM 1 100. 0. 100. DISPLAY_IDENTIFIER EGY_STEP_INJ_CHA_GRD_BAS[3] ECU_ADDRESS 0xd0002a8a FORMAT "%7.3" /end MEASUREMENT
/begin MEASUREMENT egy_step_inj_cha_grd_bas[4] "Piezo injector base energy charge gradient for a single step, without adaptation corrections." UWORD _CNV_A_R_INJR_LINEA_480_CM 1 100. 0. 100. DISPLAY_IDENTIFIER EGY_STEP_INJ_CHA_GRD_BAS[4] ECU_ADDRESS 0xd0002a8c FORMAT "%7.3" /end MEASUREMENT
/begin MEASUREMENT egy_step_inj_cha_grd_bas[5] "Piezo injector base energy charge gradient for a single step, without adaptation corrections." UWORD _CNV_A_R_INJR_LINEA_480_CM 1 100. 0. 100. DISPLAY_IDENTIFIER EGY_STEP_INJ_CHA_GRD_BAS[5] ECU_ADDRESS 0xd0002a8e FORMAT "%7.3" /end MEASUREMENT
/begin MEASUREMENT egy_step_inj_cha_grd_ctl[0] "Controller output value for calculation of piezo injector energy charge gradient" UWORD _CNV_A_R_INJR_LINEA_480_CM 1 100. 0. 100. DISPLAY_IDENTIFIER EGY_STEP_INJ_CHA_GRD_CTL[0] ECU_ADDRESS 0xd0002a90 FORMAT "%7.3" /end MEASUREMENT
/begin MEASUREMENT egy_step_inj_cha_grd_ctl[1] "Controller output value for calculation of piezo injector energy charge gradient" UWORD _CNV_A_R_INJR_LINEA_480_CM 1 100. 0. 100. DISPLAY_IDENTIFIER EGY_STEP_INJ_CHA_GRD_CTL[1] ECU_ADDRESS 0xd0002a92 FORMAT "%7.3" /end MEASUREMENT
/begin MEASUREMENT egy_step_inj_cha_grd_ctl[2] "Controller output value for calculation of piezo injector energy charge gradient" UWORD _CNV_A_R_INJR_LINEA_480_CM 1 100. 0. 100. DISPLAY_IDENTIFIER EGY_STEP_INJ_CHA_GRD_CTL[2] ECU_ADDRESS 0xd0002a94 FORMAT "%7.3" /end MEASUREMENT
/begin MEASUREMENT egy_step_inj_cha_grd_ctl[3] "Controller output value for calculation of piezo injector energy charge gradient" UWORD _CNV_A_R_INJR_LINEA_480_CM 1 100. 0. 100. DISPLAY_IDENTIFIER EGY_STEP_INJ_CHA_GRD_CTL[3] ECU_ADDRESS 0xd0002a96 FORMAT "%7.3" /end MEASUREMENT
/begin MEASUREMENT egy_step_inj_cha_grd_ctl[4] "Controller output value for calculation of piezo injector energy charge gradient" UWORD _CNV_A_R_INJR_LINEA_480_CM 1 100. 0. 100. DISPLAY_IDENTIFIER EGY_STEP_INJ_CHA_GRD_CTL[4] ECU_ADDRESS 0xd0002a98 FORMAT "%7.3" /end MEASUREMENT
/begin MEASUREMENT egy_step_inj_cha_grd_ctl[5] "Controller output value for calculation of piezo injector energy charge gradient" UWORD _CNV_A_R_INJR_LINEA_480_CM 1 100. 0. 100. DISPLAY_IDENTIFIER EGY_STEP_INJ_CHA_GRD_CTL[5] ECU_ADDRESS 0xd0002a9a FORMAT "%7.3" /end MEASUREMENT
/begin MEASUREMENT egy_step_inj_cha_lim_dif[0] "Difference of piezo stack energy, which is over the voltage limit" UWORD _CNV_A_R_INJR_LINEA_480_CM 1 100. 0. 100. DISPLAY_IDENTIFIER EGY_STEP_INJ_CHA_LIM_DIF[0] ECU_ADDRESS 0xd0002aa8 FORMAT "%7.3" /end MEASUREMENT
/begin MEASUREMENT egy_step_inj_cha_lim_dif[1] "Difference of piezo stack energy, which is over the voltage limit" UWORD _CNV_A_R_INJR_LINEA_480_CM 1 100. 0. 100. DISPLAY_IDENTIFIER EGY_STEP_INJ_CHA_LIM_DIF[1] ECU_ADDRESS 0xd0002aaa FORMAT "%7.3" /end MEASUREMENT
/begin MEASUREMENT egy_step_inj_cha_lim_dif[2] "Difference of piezo stack energy, which is over the voltage limit" UWORD _CNV_A_R_INJR_LINEA_480_CM 1 100. 0. 100. DISPLAY_IDENTIFIER EGY_STEP_INJ_CHA_LIM_DIF[2] ECU_ADDRESS 0xd0002aac FORMAT "%7.3" /end MEASUREMENT
/begin MEASUREMENT egy_step_inj_cha_lim_dif[3] "Difference of piezo stack energy, which is over the voltage limit" UWORD _CNV_A_R_INJR_LINEA_480_CM 1 100. 0. 100. DISPLAY_IDENTIFIER EGY_STEP_INJ_CHA_LIM_DIF[3] ECU_ADDRESS 0xd0002aae FORMAT "%7.3" /end MEASUREMENT
/begin MEASUREMENT egy_step_inj_cha_lim_dif[4] "Difference of piezo stack energy, which is over the voltage limit" UWORD _CNV_A_R_INJR_LINEA_480_CM 1 100. 0. 100. DISPLAY_IDENTIFIER EGY_STEP_INJ_CHA_LIM_DIF[4] ECU_ADDRESS 0xd0002ab0 FORMAT "%7.3" /end MEASUREMENT
/begin MEASUREMENT egy_step_inj_cha_lim_dif[5] "Difference of piezo stack energy, which is over the voltage limit" UWORD _CNV_A_R_INJR_LINEA_480_CM 1 100. 0. 100. DISPLAY_IDENTIFIER EGY_STEP_INJ_CHA_LIM_DIF[5] ECU_ADDRESS 0xd0002ab2 FORMAT "%7.3" /end MEASUREMENT
/begin MEASUREMENT nr_egy_step_inj_l "Number of charge steps for low piezo energy range" UBYTE _CNV_A_R_LINEAR_____0_CM 1 100. 0. 31. DISPLAY_IDENTIFIER NR_EGY_STEP_INJ_L ECU_ADDRESS 0xd0002eeb FORMAT "%2.0" /end MEASUREMENT
/begin MEASUREMENT nr_egy_step_inj_h "Number of charge steps for high piezo energy range" UBYTE _CNV_A_R_LINEAR_____0_CM 1 100. 0. 31. DISPLAY_IDENTIFIER NR_EGY_STEP_INJ_H ECU_ADDRESS 0xd0002eea FORMAT "%2.0" /end MEASUREMENT
/begin MEASUREMENT lv_egy_step_inj_cha_lim[0] "Piezo stack energy is out of limit (over-voltage protection)" UBYTE _CNV_A_R_LINEAR_____0_CM 1 100. 0. 1. DISPLAY_IDENTIFIER LV_EGY_STEP_INJ_CHA_LIM[0] ECU_ADDRESS 0xd0002f04 FORMAT "%1.0" /end MEASUREMENT
/begin MEASUREMENT lv_egy_step_inj_cha_lim[1] "Piezo stack energy is out of limit (over-voltage protection)" UBYTE _CNV_A_R_LINEAR_____0_CM 1 100. 0. 1. DISPLAY_IDENTIFIER LV_EGY_STEP_INJ_CHA_LIM[1] ECU_ADDRESS 0xd0002f05 FORMAT "%1.0" /end MEASUREMENT
/begin MEASUREMENT lv_egy_step_inj_cha_lim[2] "Piezo stack energy is out of limit (over-voltage protection)" UBYTE _CNV_A_R_LINEAR_____0_CM 1 100. 0. 1. DISPLAY_IDENTIFIER LV_EGY_STEP_INJ_CHA_LIM[2] ECU_ADDRESS 0xd0002f06 FORMAT "%1.0" /end MEASUREMENT
/begin MEASUREMENT lv_egy_step_inj_cha_lim[3] "Piezo stack energy is out of limit (over-voltage protection)" UBYTE _CNV_A_R_LINEAR_____0_CM 1 100. 0. 1. DISPLAY_IDENTIFIER LV_EGY_STEP_INJ_CHA_LIM[3] ECU_ADDRESS 0xd0002f07 FORMAT "%1.0" /end MEASUREMENT
/begin MEASUREMENT lv_egy_step_inj_cha_lim[4] "Piezo stack energy is out of limit (over-voltage protection)" UBYTE _CNV_A_R_LINEAR_____0_CM 1 100. 0. 1. DISPLAY_IDENTIFIER LV_EGY_STEP_INJ_CHA_LIM[4] ECU_ADDRESS 0xd0002f08 FORMAT "%1.0" /end MEASUREMENT
/begin MEASUREMENT lv_egy_step_inj_cha_lim[5] "Piezo stack energy is out of limit (over-voltage protection)" UBYTE _CNV_A_R_LINEAR_____0_CM 1 100. 0. 1. DISPLAY_IDENTIFIER LV_EGY_STEP_INJ_CHA_LIM[5] ECU_ADDRESS 0xd0002f09 FORMAT "%1.0" /end MEASUREMENT
/begin MEASUREMENT egy_step_inj_cha_grd_raw[0] "Piezo injector energy charge gradient for a single step, raw value (without over-voltage protection)" UWORD _CNV_A_R_INJR_LINEA_480_CM 1 100. 0. 100. DISPLAY_IDENTIFIER EGY_STEP_INJ_CHA_GRD_RAW[0] ECU_ADDRESS 0xd0002a9c FORMAT "%7.3" /end MEASUREMENT
/begin MEASUREMENT egy_step_inj_cha_grd_raw[1] "Piezo injector energy charge gradient for a single step, raw value (without over-voltage protection)" UWORD _CNV_A_R_INJR_LINEA_480_CM 1 100. 0. 100. DISPLAY_IDENTIFIER EGY_STEP_INJ_CHA_GRD_RAW[1] ECU_ADDRESS 0xd0002a9e FORMAT "%7.3" /end MEASUREMENT
/begin MEASUREMENT egy_step_inj_cha_grd_raw[2] "Piezo injector energy charge gradient for a single step, raw value (without over-voltage protection)" UWORD _CNV_A_R_INJR_LINEA_480_CM 1 100. 0. 100. DISPLAY_IDENTIFIER EGY_STEP_INJ_CHA_GRD_RAW[2] ECU_ADDRESS 0xd0002aa0 FORMAT "%7.3" /end MEASUREMENT
/begin MEASUREMENT egy_step_inj_cha_grd_raw[3] "Piezo injector energy charge gradient for a single step, raw value (without over-voltage protection)" UWORD _CNV_A_R_INJR_LINEA_480_CM 1 100. 0. 100. DISPLAY_IDENTIFIER EGY_STEP_INJ_CHA_GRD_RAW[3] ECU_ADDRESS 0xd0002aa2 FORMAT "%7.3" /end MEASUREMENT
/begin MEASUREMENT egy_step_inj_cha_grd_raw[4] "Piezo injector energy charge gradient for a single step, raw value (without over-voltage protection)" UWORD _CNV_A_R_INJR_LINEA_480_CM 1 100. 0. 100. DISPLAY_IDENTIFIER EGY_STEP_INJ_CHA_GRD_RAW[4] ECU_ADDRESS 0xd0002aa4 FORMAT "%7.3" /end MEASUREMENT
/begin MEASUREMENT egy_step_inj_cha_grd_raw[5] "Piezo injector energy charge gradient for a single step, raw value (without over-voltage protection)" UWORD _CNV_A_R_INJR_LINEA_480_CM 1 100. 0. 100. DISPLAY_IDENTIFIER EGY_STEP_INJ_CHA_GRD_RAW[5] ECU_ADDRESS 0xd0002aa6 FORMAT "%7.3" /end MEASUREMENT
/begin MEASUREMENT max_inj_egy_level "Maximum correction value of injector energy level (calibrateable)" SWORD _CNV_A_R_INJR_LINEA_480_CM 1 100. -50. 50. DISPLAY_IDENTIFIER MAX_INJ_EGY_LEVEL ECU_ADDRESS 0xd0002b14 /end MEASUREMENT
/begin MEASUREMENT fac_egy_pwm_ad[0] "Conversion factor for calculation of energy to PWM" UWORD _CNV_A_R_LINEAR_____8_CM 1 100. 0. 1.99996948242188 DISPLAY_IDENTIFIER FAC_EGY_PWM_AD[0] ECU_ADDRESS 0xd0002af8 FORMAT "%7.5" /end MEASUREMENT
/begin MEASUREMENT fac_egy_pwm_ad[1] "Conversion factor for calculation of energy to PWM" UWORD _CNV_A_R_LINEAR_____8_CM 1 100. 0. 1.99996948242188 DISPLAY_IDENTIFIER FAC_EGY_PWM_AD[1] ECU_ADDRESS 0xd0002afa FORMAT "%7.5" /end MEASUREMENT
/begin MEASUREMENT fac_egy_pwm_ad[2] "Conversion factor for calculation of energy to PWM" UWORD _CNV_A_R_LINEAR_____8_CM 1 100. 0. 1.99996948242188 DISPLAY_IDENTIFIER FAC_EGY_PWM_AD[2] ECU_ADDRESS 0xd0002afc FORMAT "%7.5" /end MEASUREMENT
/begin MEASUREMENT fac_egy_pwm_ad[3] "Conversion factor for calculation of energy to PWM" UWORD _CNV_A_R_LINEAR_____8_CM 1 100. 0. 1.99996948242188 DISPLAY_IDENTIFIER FAC_EGY_PWM_AD[3] ECU_ADDRESS 0xd0002afe FORMAT "%7.5" /end MEASUREMENT
/begin MEASUREMENT fac_egy_pwm_ad[4] "Conversion factor for calculation of energy to PWM" UWORD _CNV_A_R_LINEAR_____8_CM 1 100. 0. 1.99996948242188 DISPLAY_IDENTIFIER FAC_EGY_PWM_AD[4] ECU_ADDRESS 0xd0002b00 FORMAT "%7.5" /end MEASUREMENT
/begin MEASUREMENT fac_egy_pwm_ad[5] "Conversion factor for calculation of energy to PWM" UWORD _CNV_A_R_LINEAR_____8_CM 1 100. 0. 1.99996948242188 DISPLAY_IDENTIFIER FAC_EGY_PWM_AD[5] ECU_ADDRESS 0xd0002b02 FORMAT "%7.5" /end MEASUREMENT
/begin MEASUREMENT lv_egy_step_inj_vld "Piezo injector base energy charge gradient inside adaptation memory valid" UBYTE _CNV_A_R_LINEAR_____0_CM 1 100. 0. 1. DISPLAY_IDENTIFIER LV_EGY_STEP_INJ_VLD ECU_ADDRESS 0xd0002f0a FORMAT "%1.0" /end MEASUREMENT
/begin MEASUREMENT lv_egy_add_ad_ena "Enable adaptive correction values from CYBL + CILC for piezo injector energy calculation" UBYTE _CNV_A_R_LINEAR_____0_CM 1 100. 0. 1. DISPLAY_IDENTIFIER LV_EGY_ADD_AD_ENA ECU_ADDRESS 0xd0002f03 FORMAT "%1.0" /end MEASUREMENT
/begin MEASUREMENT egy_step_inj_cha_grd[0] "Piezo injector energy charge gradient for a single step" UWORD _CNV_A_R_INJR_LINEA_480_CM 1 100. 0. 100. DISPLAY_IDENTIFIER EGY_STEP_INJ_CHA_GRD[0] ECU_ADDRESS 0xd0002a78 FORMAT "%7.3" /end MEASUREMENT
/begin MEASUREMENT egy_step_inj_cha_grd[1] "Piezo injector energy charge gradient for a single step" UWORD _CNV_A_R_INJR_LINEA_480_CM 1 100. 0. 100. DISPLAY_IDENTIFIER EGY_STEP_INJ_CHA_GRD[1] ECU_ADDRESS 0xd0002a7a FORMAT "%7.3" /end MEASUREMENT
/begin MEASUREMENT egy_step_inj_cha_grd[2] "Piezo injector energy charge gradient for a single step" UWORD _CNV_A_R_INJR_LINEA_480_CM 1 100. 0. 100. DISPLAY_IDENTIFIER EGY_STEP_INJ_CHA_GRD[2] ECU_ADDRESS 0xd0002a7c FORMAT "%7.3" /end MEASUREMENT
/begin MEASUREMENT egy_step_inj_cha_grd[3] "Piezo injector energy charge gradient for a single step" UWORD _CNV_A_R_INJR_LINEA_480_CM 1 100. 0. 100. DISPLAY_IDENTIFIER EGY_STEP_INJ_CHA_GRD[3] ECU_ADDRESS 0xd0002a7e FORMAT "%7.3" /end MEASUREMENT
/begin MEASUREMENT egy_step_inj_cha_grd[4] "Piezo injector energy charge gradient for a single step" UWORD _CNV_A_R_INJR_LINEA_480_CM 1 100. 0. 100. DISPLAY_IDENTIFIER EGY_STEP_INJ_CHA_GRD[4] ECU_ADDRESS 0xd0002a80 FORMAT "%7.3" /end MEASUREMENT
/begin MEASUREMENT egy_step_inj_cha_grd[5] "Piezo injector energy charge gradient for a single step" UWORD _CNV_A_R_INJR_LINEA_480_CM 1 100. 0. 100. DISPLAY_IDENTIFIER EGY_STEP_INJ_CHA_GRD[5] ECU_ADDRESS 0xd0002a82 FORMAT "%7.3" /end MEASUREMENT
/begin MEASUREMENT egy_step_inj_add_cor "Piezo injector energy additive charge correction depending on engine speed and load" UWORD _CNV_A_R_INJR_LINEA_540_CM 1 100. -50. 50. DISPLAY_IDENTIFIER EGY_STEP_INJ_ADD_COR ECU_ADDRESS 0xd0002a76 FORMAT "%7.3" /end MEASUREMENT
/begin CHARACTERISTIC c_nr_egy_step_inj_l "Number of charge steps for a low piezo energy range" VALUE 0xa1008a32 _REC_VAL_20_u1 29. _CNV_A_R_LINEAR_____0_CM 2. 31. DISPLAY_IDENTIFIER C_NR_EGY_STEP_INJ_L FORMAT "%2.0" /end CHARACTERISTIC
/begin CHARACTERISTIC c_nr_egy_step_inj_h "Number of charge steps for a high piezo energy range" VALUE 0xa1008a31 _REC_VAL_20_u1 29. _CNV_A_R_LINEAR_____0_CM 2. 31. DISPLAY_IDENTIFIER C_NR_EGY_STEP_INJ_H FORMAT "%2.0" /end CHARACTERISTIC
/begin AXIS_PTS ldp_tfu_ip_egy_step_inj_cha_grd "Piezo injector energy charge and discharge gradient for a single step" 0xa10082a6 tfu_inj _REC_AXS_20_u1 190.5 _CNV_A_R_LINEAR_____16_CM 6 -48. 142.5 FORMAT "%6.2" /end AXIS_PTS
/begin AXIS_PTS ldp_mff_sp_egy_step_inj_add "" 0xa10081d4 mff_sp_mv _REC_AXS_20_u2 1389. _CNV_A_R_LINEAR_____108_CM 8 0. 1389. FORMAT "%7.2" /end AXIS_PTS
/begin CHARACTERISTIC c_fac_cor_egy_step_inj_dcha_grd "Multiplicative correction factor for cylinder balancing influence on discharge gradient calculation" VALUE 0xa1008a26 _REC_VAL_20_u2 1.99996948242188 _CNV_A_R_LINEAR_____8_CM 0. 1.99996948242188 DISPLAY_IDENTIFIER C_FAC_COR_EGY_STEP_INJ_DCHA_GRD FORMAT "%7.5" /end CHARACTERISTIC
/begin CHARACTERISTIC c_egy_ctl_i_gain "Integral gain for energy adaptation controller" VALUE 0xa1008a0a _REC_VAL_20_u2 1.99996948242188 _CNV_A_R_LINEAR_____8_CM 0. 1.99996948242188 DISPLAY_IDENTIFIER C_EGY_CTL_I_GAIN FORMAT "%7.5" /end CHARACTERISTIC
/begin CHARACTERISTIC c_egy_ctl_p_gain "Proportional gain for energy adaptation controller" VALUE 0xa1008a0c _REC_VAL_20_u2 1.99996948242188 _CNV_A_R_LINEAR_____8_CM 0. 1.99996948242188 DISPLAY_IDENTIFIER C_EGY_CTL_P_GAIN FORMAT "%7.5" /end CHARACTERISTIC
/begin CHARACTERISTIC c_egy_step_inj_cha_grd_sp "Base energy set-point for piezo energy controller" VALUE 0xa1008a16 _REC_VAL_20_u2 255. _CNV_A_R_INJR_LINEA_478_CM 0. 255. DISPLAY_IDENTIFIER C_EGY_STEP_INJ_CHA_GRD_SP FORMAT "%7.3" /end CHARACTERISTIC
/begin CHARACTERISTIC c_nr_adap_egy_ctl "Number of energy control steps, before the piezo energy controller value will be valid" VALUE 0xa1008a2e _REC_VAL_20_u2 65535. _CNV_A_R_LINEAR_____0_CM 0. 65535. DISPLAY_IDENTIFIER C_NR_ADAP_EGY_CTL FORMAT "%5.0" /end CHARACTERISTIC
/begin CHARACTERISTIC c_v_iv_max "Max voltage on piezo injector" VALUE 0xa1008a78 _REC_VAL_20_u2 639.98046875 _CNV_A_R_LINEAR_____195_CM 0. 639.98046875 DISPLAY_IDENTIFIER C_V_IV_MAX FORMAT "%6.2" /end CHARACTERISTIC
/begin CHARACTERISTIC lc_egy_step_ctl_dyn_ena "Enable complete piezo energy controller" VALUE 0xa1008a7a _REC_VAL_20_u1 1. _CNV_A_R_LINEAR_____0_CM 0. 1. DISPLAY_IDENTIFIER LC_EGY_STEP_CTL_DYN_ENA FORMAT "%1.0" /end CHARACTERISTIC
/begin CHARACTERISTIC lc_ena_adap_egy_ctl "Enable new adaptation of piezo energy controller values after engine start" VALUE 0xa1008a7b _REC_VAL_20_u1 1. _CNV_A_R_LINEAR_____0_CM 0. 1. DISPLAY_IDENTIFIER LC_ENA_ADAP_EGY_CTL FORMAT "%1.0" /end CHARACTERISTIC
/begin MEASUREMENT egy_add_fup "Additive piezo energy correction depending on the fuel pressure" SWORD _CNV_A_R_INJR_LINEA_480_CM 1 100. -50. 50. DISPLAY_IDENTIFIER EGY_ADD_FUP ECU_ADDRESS 0xd0002a72 FORMAT "%7.3" /end MEASUREMENT
/begin AXIS_PTS ldp_fup_ip_egy_add_fup "" 0xa10081c0 fup_h _REC_AXS_20_u2 347776. _CNV_A_R_LINEAR_____152_CM 8 0. 347776. FORMAT "%8.1" /end AXIS_PTS
/begin CHARACTERISTIC ip_egy_add_fup "Additive piezo energy correction depending on the fuel pressure" CURVE 0xa1008338 _REC_CUR_20_u2_u2 100. _CNV_A_R_INJR_LINEA_540_CM -50. 50. DISPLAY_IDENTIFIER IP_EGY_ADD_FUP FORMAT "%7.3"
 /begin AXIS_DESCR COM_AXIS fup_h _CNV_A_R_LINEAR_____152_CM 8 0. 347776. FORMAT "%8.1" AXIS_PTS_REF ldp_fup_ip_egy_add_fup /end AXIS_DESCR
/end CHARACTERISTIC
/begin CHARACTERISTIC lc_eoi_2_homs_man "Switch to activate the manual setpoint for EOI_2, homogeneous stratified mode" VALUE 0xa1008a7e _REC_VAL_20_u1 1. _CNV_A_R_LINEAR_____0_CM 0. 1. DISPLAY_IDENTIFIER LC_EOI_2_HOMS_MAN FORMAT "%1.0" /end CHARACTERISTIC
/begin CHARACTERISTIC lc_soi_1_homs_man "Switch to activate the manual setpoint for SOI_1, homogeneous stratified mode" VALUE 0xa1008a84 _REC_VAL_20_u1 1. _CNV_A_R_LINEAR_____0_CM 0. 1. DISPLAY_IDENTIFIER LC_SOI_1_HOMS_MAN FORMAT "%1.0" /end CHARACTERISTIC
/begin CHARACTERISTIC c_soi_1_homs_man "Manual setpoint for SOI of the first pulse during homogeneous stratified mode" VALUE 0xa1008a38 _REC_VAL_20_u2 720. _CNV_A_R_LINEAR_____168_CM 0. 720. DISPLAY_IDENTIFIER C_SOI_1_HOMS_MAN FORMAT "%7.3" /end CHARACTERISTIC
/begin CHARACTERISTIC c_eoi_2_homs_man "Manual setpoint for EOI of the second pulse during homogeneous stratified mode" VALUE 0xa1008a1c _REC_VAL_20_u2 720. _CNV_A_R_LINEAR_____168_CM 0. 720. DISPLAY_IDENTIFIER C_EOI_2_HOMS_MAN FORMAT "%7.3" /end CHARACTERISTIC
/begin COMPU_METHOD _CNV_A_R_LINEAR_____0_CM "" RAT_FUNC "%6.3" "-" COEFFS 0 1. 0. 0 0 1 /end COMPU_METHOD
/begin COMPU_METHOD _CNV_S_2_RANGE__0___1_CM "" TAB_VERB "%6.3" "-" COMPU_TAB_REF _CNV_S_2_RANGE__0___1 /end COMPU_METHOD
/begin COMPU_VTAB _CNV_S_2_RANGE__0___1 "" TAB_VERB 2 0 "0" 1 "1" /end COMPU_VTAB
/begin COMPU_METHOD _CNV_A_R_LINEAR_____8_CM "" RAT_FUNC "%6.3" "-" COEFFS 0 32767.99999999992 0. 0 0 1 /end COMPU_METHOD
/begin COMPU_METHOD _CNV_A_R_LINEAR_____13_CM "" RAT_FUNC "%6.3" "rpm" COEFFS 0 1. 0. 0 0 1 /end COMPU_METHOD
/begin COMPU_METHOD _CNV_A_R_LINEAR_____16_CM "" RAT_FUNC "%6.3" "°C" COEFFS 0 1.333333333333333 64. 0 0 1 /end COMPU_METHOD
/begin COMPU_METHOD _CNV_A_R_LINEAR_____108_CM "" RAT_FUNC "%6.3" "mg/stk" COEFFS 0 47.18142548596112 0. 0 0 1 /end COMPU_METHOD
/begin COMPU_METHOD _CNV_A_R_LINEAR_____152_CM "" RAT_FUNC "%6.3" "hPa" COEFFS 0 0.1884402603974972 0. 0 0 1 /end COMPU_METHOD
/begin COMPU_METHOD _CNV_A_R_LINEAR_____168_CM "" RAT_FUNC "%6.3" "°CRK" COEFFS 0 2.666666666666667 0. 0 0 1 /end COMPU_METHOD
/begin COMPU_METHOD _CNV_A_R_LINEAR_____195_CM "" RAT_FUNC "%6.3" "V" COEFFS 0 51.2 0. 0 0 1 /end COMPU_METHOD
/begin COMPU_METHOD _CNV_A_R_INJR_LINEA_478_CM "" RAT_FUNC "%6.3" "mJ" COEFFS 0 257. 0. 0 0 1 /end COMPU_METHOD
/begin COMPU_METHOD _CNV_A_R_INJR_LINEA_480_CM "" RAT_FUNC "%6.3" "%" COEFFS 0 163.84 0. 0 0 1 /end COMPU_METHOD
/begin COMPU_METHOD _CNV_S_16_RANGE_ERR__485_CM "" TAB_VERB "%6.3" "-" COMPU_TAB_REF _CNV_S_16_RANGE_ERR__485 /end COMPU_METHOD
/begin COMPU_VTAB _CNV_S_16_RANGE_ERR__485 "" TAB_VERB 16 0 "NO_SYM" 1 "SYM_0" 2 "SYM_1" 3 "SYM_0, SYM_1" 4 "SYM_2" 5 "SYM_0, SYM_2" 6 "SYM_1, SYM_2" 7 "SYM_0, SYM_1, SYM_2" 8 "SYM_3" 9 "SYM_0, SYM_3" 10 "SYM_1, SYM_3" 11 "SYM_0, SYM_1,SYM_3" 12 "SYM_2, SYM_3" 13 "SYM_0, SYM_2, SYM_3" 14 "SYM_1, SYM_2, SYM_3" 15 "SYM_0, SYM_1, SYM_2, SYM_3" /end COMPU_VTAB
/begin COMPU_METHOD _CNV_A_R_INJR_LINEA_540_CM "" RAT_FUNC "%6.3" "%" COEFFS 0 163.84 8192. 0 0 1 /end COMPU_METHOD
/begin RECORD_LAYOUT _REC_VAL_20_u1 FNC_VALUES 1 UBYTE COLUMN_DIR DIRECT /end RECORD_LAYOUT
/begin RECORD_LAYOUT _REC_VAL_20_u2 FNC_VALUES 1 UWORD COLUMN_DIR DIRECT /end RECORD_LAYOUT
/begin RECORD_LAYOUT _REC_AXS_20_u1 NO_AXIS_PTS_X 1 UBYTE AXIS_PTS_X 2 UBYTE INDEX_INCR DIRECT /end RECORD_LAYOUT
/begin RECORD_LAYOUT _REC_VAL_20_s2 FNC_VALUES 1 SWORD COLUMN_DIR DIRECT /end RECORD_LAYOUT
/begin RECORD_LAYOUT _REC_AXS_20_u2 NO_AXIS_PTS_X 1 UWORD AXIS_PTS_X 2 UWORD INDEX_INCR DIRECT /end RECORD_LAYOUT
/begin RECORD_LAYOUT _REC_CUR_20_u2_u1 FNC_VALUES 1 UWORD COLUMN_DIR DIRECT /end RECORD_LAYOUT
/begin RECORD_LAYOUT _REC_CUR_20_u2_u2 FNC_VALUES 1 UWORD COLUMN_DIR DIRECT /end RECORD_LAYOUT
/begin RECORD_LAYOUT _REC_MAP_20_u2_u2_u2 FNC_VALUES 1 UWORD COLUMN_DIR DIRECT /end RECORD_LAYOUT
/begin FUNCTION INJR_Injector_needle_lift_control ""
 /begin DEF_CHARACTERISTIC ip_egy_step_inj_cha_grd[0] ip_egy_step_inj_cha_grd[1] ip_egy_step_inj_cha_grd[2] ip_egy_step_inj_cha_grd[3] ip_egy_step_inj_cha_grd[4] ip_egy_step_inj_cha_grd[5] ip_egy_step_inj_add_cor ldp_n_egy_step_inj_add c_max_inj_egy_level_cor c_min_inj_egy_level_cor c_nr_egy_step_inj_l c_nr_egy_step_inj_h ldp_tfu_ip_egy_step_inj_cha_grd ldp_mff_sp_egy_step_inj_add c_fac_cor_egy_step_inj_dcha_grd c_egy_ctl_i_gain c_egy_ctl_p_gain c_egy_step_inj_cha_grd_sp c_nr_adap_egy_ctl c_v_iv_max lc_egy_step_ctl_dyn_ena lc_ena_adap_egy_ctl /end DEF_CHARACTERISTIC
 /begin OUT_MEASUREMENT min_inj_egy_level egy_step_inj_dcha_grd[0] egy_step_inj_dcha_grd[1] egy_step_inj_dcha_grd[2] egy_step_inj_dcha_grd[3] egy_step_inj_dcha_grd[4] egy_step_inj_dcha_grd[5] egy_step_inj_cha_grd_bas[0] egy_step_inj_cha_grd_bas[1] egy_step_inj_cha_grd_bas[2] egy_step_inj_cha_grd_bas[3] egy_step_inj_cha_grd_bas[4] egy_step_inj_cha_grd_bas[5] egy_step_inj_cha_grd_ctl[0] egy_step_inj_cha_grd_ctl[1] egy_step_inj_cha_grd_ctl[2] egy_step_inj_cha_grd_ctl[3] egy_step_inj_cha_grd_ctl[4] egy_step_inj_cha_grd_ctl[5] egy_step_inj_cha_lim_dif[0] egy_step_inj_cha_lim_dif[1] egy_step_inj_cha_lim_dif[2] egy_step_inj_cha_lim_dif[3] egy_step_inj_cha_lim_dif[4] egy_step_inj_cha_lim_dif[5] nr_egy_step_inj_l nr_egy_step_inj_h lv_egy_step_inj_cha_lim[0] lv_egy_step_inj_cha_lim[1] lv_egy_step_inj_cha_lim[2] lv_egy_step_inj_cha_lim[3] lv_egy_step_inj_cha_lim[4] lv_egy_step_inj_cha_lim[5] egy_step_inj_cha_grd_raw[0] egy_step_inj_cha_grd_raw[1] egy_step_inj_cha_grd_raw[2] egy_step_inj_cha_grd_raw[3] egy_step_inj_cha_grd_raw[4] egy_step_inj_cha_grd_raw[5] max_inj_egy_level fac_egy_pwm_ad[0] fac_egy_pwm_ad[1] fac_egy_pwm_ad[2] fac_egy_pwm_ad[3] fac_egy_pwm_ad[4] fac_egy_pwm_ad[5] lv_egy_step_inj_vld lv_egy_add_ad_ena egy_step_inj_cha_grd[0] egy_step_inj_cha_grd[1] egy_step_inj_cha_grd[2] egy_step_inj_cha_grd[3] egy_step_inj_cha_grd[4] egy_step_inj_cha_grd[5] egy_step_inj_add_cor /end OUT_MEASUREMENT
/end FUNCTION
/begin FUNCTION INJR_Comp_of_fuel_pres_influence "" /begin DEF_CHARACTERISTIC ldp_fup_ip_egy_add_fup ip_egy_add_fup /end DEF_CHARACTERISTIC /begin OUT_MEASUREMENT egy_add_fup /end OUT_MEASUREMENT /end FUNCTION
/begin FUNCTION INJR_Inj_phase_hom_strat_mode ""
 /begin DEF_CHARACTERISTIC lc_eoi_2_homs_man lc_soi_1_homs_man c_soi_1_homs_man c_eoi_2_homs_man /end DEF_CHARACTERISTIC
 /begin OUT_MEASUREMENT injr.STR_INJR_REQGNHOMS0.soi_1_homs[0] injr.STR_INJR_REQGNHOMS0.soi_1_homs[1] injr.STR_INJR_REQGNHOMS0.soi_1_homs[2] injr.STR_INJR_REQGNHOMS0.soi_1_homs[3] injr.STR_INJR_REQGNHOMS0.soi_1_homs[4] injr.STR_INJR_REQGNHOMS0.soi_1_homs[5] injr.STR_INJR_REQGNHOMS0.eoi_2_homs[0] injr.STR_INJR_REQGNHOMS0.eoi_2_homs[1] injr.STR_INJR_REQGNHOMS0.eoi_2_homs[2] injr.STR_INJR_REQGNHOMS0.eoi_2_homs[3] injr.STR_INJR_REQGNHOMS0.eoi_2_homs[4] injr.STR_INJR_REQGNHOMS0.eoi_2_homs[5] /end OUT_MEASUREMENT
/end FUNCTION
/begin FUNCTION C_A_INJR ""
 /begin SUB_FUNCTION INJR_Injection_valve_diagnosis_Appl_Inc INJR_VBoost_Diag_Appl_Inc INJR_VBoost_diagnosis INJR_Injection_valve_diagnosis /end SUB_FUNCTION
/end FUNCTION
/begin FUNCTION INJR_Injection_valve_diagnosis_Appl_Inc "" /end FUNCTION
/begin FUNCTION INJR_VBoost_Diag_Appl_Inc "" /end FUNCTION
/begin FUNCTION INJR_VBoost_diagnosis "" /end FUNCTION
/begin FUNCTION INJR_Injection_valve_diagnosis "" /end FUNCTION
/begin FUNCTION C_4_INJR "" /begin SUB_FUNCTION INJR_Boost_voltage /end SUB_FUNCTION /end FUNCTION
/begin FUNCTION INJR_Boost_voltage "" /end FUNCTION
/begin FUNCTION C_A_ERRM "C_A_ERRM"
 /begin SUB_FUNCTION ERRM_Table_of_Failures ERRM_Anti_bounce_Algorithm ERRM_Debounce_algorithm_Appl_Inc /end SUB_FUNCTION
/end FUNCTION
/begin FUNCTION ERRM_Table_of_Failures "Table_of_Failures"
 /begin OUT_MEASUREMENT fmy_stat_imob_1.err_info_stat.lv_err_mem fmy_stat_imob_1.err_info_stat.lv_ready fmy_stat_imob_1.err_info_stat.lv_end_diag fmy_stat_imob_1.err_info_stat.lv_cdn_diag fmy_stat_imob_1.err_info_stat.err_sym fmy_stat_imob_2.err_info_stat.lv_err_mem fmy_stat_imob_2.err_info_stat.lv_ready fmy_stat_imob_2.err_info_stat.lv_end_diag fmy_stat_imob_2.err_info_stat.lv_cdn_diag fmy_stat_imob_2.err_info_stat.err_sym fmy_stat_imob_3.err_info_stat.lv_err_mem fmy_stat_imob_3.err_info_stat.lv_ready fmy_stat_imob_3.err_info_stat.lv_end_diag fmy_stat_imob_3.err_info_stat.lv_cdn_diag fmy_stat_imob_3.err_info_stat.err_sym fmy_stat_tco_el.ctr_abc fmy_stat_tco_el.ctr_end_diag fmy_stat_tco_el.err_info_stat.lv_err_mem fmy_stat_tco_el.err_info_stat.lv_ready fmy_stat_tco_el.err_info_stat.lv_end_diag fmy_stat_tco_el.err_info_stat.lv_cdn_diag fmy_stat_tco_el.err_info_stat.err_sym fmy_stat_tco_grd.ctr_abc fmy_stat_tco_grd.ctr_end_diag fmy_stat_tco_grd.err_info_stat.lv_err_mem fmy_stat_tco_grd.err_info_stat.lv_ready fmy_stat_tco_grd.err_info_stat.lv_end_diag fmy_stat_tco_grd.err_info_stat.lv_cdn_diag fmy_stat_tco_grd.err_info_stat.err_sym fmy_stat_tco_stuck.ctr_abc fmy_stat_tco_stuck.ctr_end_diag fmy_stat_tco_stuck.err_info_stat.lv_err_mem fmy_stat_tco_stuck.err_info_stat.lv_ready fmy_stat_tco_stuck.err_info_stat.lv_end_diag fmy_stat_tco_stuck.err_info_stat.lv_cdn_diag fmy_stat_tco_stuck.err_info_stat.err_sym fmy_stat_tco_plaus.ctr_abc fmy_stat_tco_plaus.ctr_end_diag fmy_stat_tco_plaus.err_info_stat.lv_err_mem fmy_stat_tco_plaus.err_info_stat.lv_ready fmy_stat_tco_plaus.err_info_stat.lv_end_diag fmy_stat_tco_plaus.err_info_stat.lv_cdn_diag fmy_stat_tco_plaus.err_info_stat.err_sym fmy_stat_tco_2_el.ctr_abc fmy_stat_tco_2_el.ctr_end_diag fmy_stat_tco_2_el.err_info_stat.lv_err_mem fmy_stat_tco_2_el.err_info_stat.lv_ready fmy_stat_tco_2_el.err_info_stat.lv_end_diag fmy_stat_tco_2_el.err_info_stat.lv_cdn_diag fmy_stat_tco_2_el.err_info_stat.err_sym fmy_stat_tco_2_grd.ctr_abc fmy_stat_tco_2_grd.ctr_end_diag fmy_stat_tco_2_grd.err_info_stat.lv_err_mem fmy_stat_tco_2_grd.err_info_stat.lv_ready fmy_stat_tco_2_grd.err_info_stat.lv_end_diag fmy_stat_tco_2_grd.err_info_stat.lv_cdn_diag fmy_stat_tco_2_grd.err_info_stat.err_sym fmy_stat_tco_2_plaus.ctr_abc fmy_stat_tco_2_plaus.ctr_end_diag fmy_stat_tco_2_plaus.err_info_stat.lv_err_mem fmy_stat_tco_2_plaus.err_info_stat.lv_ready fmy_stat_tco_2_plaus.err_info_stat.lv_end_diag fmy_stat_tco_2_plaus.err_info_stat.lv_cdn_diag fmy_stat_tco_2_plaus.err_info_stat.err_sym fmy_stat_ect_el.ctr_abc fmy_stat_ect_el.ctr_end_diag fmy_stat_ect_el.err_info_stat.lv_err_mem fmy_stat_ect_el.err_info_stat.lv_ready fmy_stat_ect_el.err_info_stat.lv_end_diag fmy_stat_ect_el.err_info_stat.lv_cdn_diag fmy_stat_ect_el.err_info_stat.err_sym fmy_stat_ecf_el_1.ctr_abc fmy_stat_ecf_el_1.ctr_end_diag fmy_stat_ecf_el_1.err_info_stat.lv_err_mem fmy_stat_ecf_el_1.err_info_stat.lv_ready fmy_stat_ecf_el_1.err_info_stat.lv_end_diag fmy_stat_ecf_el_1.err_info_stat.lv_cdn_diag fmy_stat_ecf_el_1.err_info_stat.err_sym fmy_stat_ecfpwm_fb_1.ctr_abc fmy_stat_ecfpwm_fb_1.ctr_end_diag fmy_stat_ecfpwm_fb_1.err_info_stat.lv_err_mem fmy_stat_ecfpwm_fb_1.err_info_stat.lv_ready fmy_stat_ecfpwm_fb_1.err_info_stat.lv_end_diag fmy_stat_ecfpwm_fb_1.err_info_stat.lv_cdn_diag fmy_stat_ecfpwm_fb_1.err_info_stat.err_sym fmy_stat_th.ctr_abc fmy_stat_th.ctr_end_diag fmy_stat_th.err_info_stat.lv_err_mem fmy_stat_th.err_info_stat.lv_ready fmy_stat_th.err_info_stat.lv_end_diag fmy_stat_th.err_info_stat.lv_cdn_diag fmy_stat_th.err_info_stat.err_sym fmy_stat_ftl_min.ctr_abc fmy_stat_ftl_min.ctr_end_diag fmy_stat_ftl_min.err_info_stat.lv_err_mem fmy_stat_ftl_min.err_info_stat.lv_ready fmy_stat_ftl_min.err_info_stat.lv_end_diag fmy_stat_ftl_min.err_info_stat.lv_cdn_diag fmy_stat_ftl_min.err_info_stat.err_sym fmy_stat_tia_el.ctr_abc fmy_stat_tia_el.ctr_end_diag fmy_stat_tia_el.err_info_stat.lv_err_mem fmy_stat_tia_el.err_info_stat.lv_ready fmy_stat_tia_el.err_info_stat.lv_end_diag fmy_stat_tia_el.err_info_stat.lv_cdn_diag fmy_stat_tia_el.err_info_stat.err_sym fmy_stat_amp.ctr_abc fmy_stat_amp.ctr_end_diag fmy_stat_amp.err_info_stat.lv_err_mem fmy_stat_amp.err_info_stat.lv_ready fmy_stat_amp.err_info_stat.lv_end_diag fmy_stat_amp.err_info_stat.lv_cdn_diag fmy_stat_amp.err_info_stat.err_sym fmy_stat_amp_plaus.ctr_abc fmy_stat_amp_plaus.ctr_end_diag fmy_stat_amp_plaus.err_info_stat.lv_err_mem fmy_stat_amp_plaus.err_info_stat.lv_ready fmy_stat_amp_plaus.err_info_stat.lv_end_diag fmy_stat_amp_plaus.err_info_stat.lv_cdn_diag fmy_stat_amp_plaus.err_info_stat.err_sym fmy_stat_maf.ctr_abc fmy_stat_maf.ctr_end_diag fmy_stat_maf.err_info_stat.lv_err_mem fmy_stat_maf.err_info_stat.lv_ready fmy_stat_maf.err_info_stat.lv_end_diag fmy_stat_maf.err_info_stat.lv_cdn_diag fmy_stat_maf.err_info_stat.err_sym fmy_stat_iv_0.ctr_abc fmy_stat_iv_0.ctr_end_diag fmy_stat_iv_0.err_info_stat.lv_err_mem fmy_stat_iv_0.err_info_stat.lv_ready fmy_stat_iv_0.err_info_stat.lv_end_diag fmy_stat_iv_0.err_info_stat.lv_cdn_diag fmy_stat_iv_0.err_info_stat.err_sym fmy_stat_iv_1.ctr_abc fmy_stat_iv_1.ctr_end_diag fmy_stat_iv_1.err_info_stat.lv_err_mem fmy_stat_iv_1.err_info_stat.lv_ready fmy_stat_iv_1.err_info_stat.lv_end_diag fmy_stat_iv_1.err_info_stat.lv_cdn_diag fmy_stat_iv_1.err_info_stat.err_sym fmy_stat_iv_2.ctr_abc fmy_stat_iv_2.ctr_end_diag fmy_stat_iv_2.err_info_stat.lv_err_mem fmy_stat_iv_2.err_info_stat.lv_ready fmy_stat_iv_2.err_info_stat.lv_end_diag fmy_stat_iv_2.err_info_stat.lv_cdn_diag fmy_stat_iv_2.err_info_stat.err_sym fmy_stat_iv_3.ctr_abc fmy_stat_iv_3.ctr_end_diag fmy_stat_iv_3.err_info_stat.lv_err_mem fmy_stat_iv_3.err_info_stat.lv_ready fmy_stat_iv_3.err_info_stat.lv_end_diag fmy_stat_iv_3.err_info_stat.lv_cdn_diag fmy_stat_iv_3.err_info_stat.err_sym fmy_stat_iv_4.ctr_abc fmy_stat_iv_4.ctr_end_diag fmy_stat_iv_4.err_info_stat.lv_err_mem fmy_stat_iv_4.err_info_stat.lv_ready fmy_stat_iv_4.err_info_stat.lv_end_diag fmy_stat_iv_4.err_info_stat.lv_cdn_diag fmy_stat_iv_4.err_info_stat.err_sym fmy_stat_iv_5.ctr_abc fmy_stat_iv_5.ctr_end_diag fmy_stat_iv_5.err_info_stat.lv_err_mem fmy_stat_iv_5.err_info_stat.lv_ready fmy_stat_iv_5.err_info_stat.lv_end_diag fmy_stat_iv_5.err_info_stat.lv_cdn_diag fmy_stat_iv_5.err_info_stat.err_sym fmy_stat_rly_efp.ctr_abc fmy_stat_rly_efp.ctr_end_diag fmy_stat_rly_efp.err_info_stat.lv_err_mem fmy_stat_rly_efp.err_info_stat.lv_ready fmy_stat_rly_efp.err_info_stat.lv_end_diag fmy_stat_rly_efp.err_info_stat.lv_cdn_diag fmy_stat_rly_efp.err_info_stat.err_sym fmy_stat_el_cps.ctr_abc fmy_stat_el_cps.ctr_end_diag fmy_stat_el_cps.err_info_stat.lv_err_mem fmy_stat_el_cps.err_info_stat.lv_ready fmy_stat_el_cps.err_info_stat.lv_end_diag fmy_stat_el_cps.err_info_stat.lv_cdn_diag fmy_stat_el_cps.err_info_stat.err_sym fmy_stat_slv_ivvt_in.ctr_abc fmy_stat_slv_ivvt_in.ctr_end_diag fmy_stat_slv_ivvt_in.err_info_stat.lv_err_mem fmy_stat_slv_ivvt_in.err_info_stat.lv_ready fmy_stat_slv_ivvt_in.err_info_stat.lv_end_diag fmy_stat_slv_ivvt_in.err_info_stat.lv_cdn_diag fmy_stat_slv_ivvt_in.err_info_stat.err_sym fmy_stat_slv_ivvt_ex.ctr_abc fmy_stat_slv_ivvt_ex.ctr_end_diag fmy_stat_slv_ivvt_ex.err_info_stat.lv_err_mem fmy_stat_slv_ivvt_ex.err_info_stat.lv_ready fmy_stat_slv_ivvt_ex.err_info_stat.lv_end_diag fmy_stat_slv_ivvt_ex.err_info_stat.lv_cdn_diag fmy_stat_slv_ivvt_ex.err_info_stat.err_sym fmy_stat_ecu_cks.ctr_abc fmy_stat_ecu_cks.ctr_end_diag fmy_stat_ecu_cks.err_info_stat.lv_err_mem fmy_stat_ecu_cks.err_info_stat.lv_ready fmy_stat_ecu_cks.err_info_stat.lv_end_diag fmy_stat_ecu_cks.err_info_stat.lv_cdn_diag fmy_stat_ecu_cks.err_info_stat.err_sym fmy_stat_tout_etcu_1.ctr_abc fmy_stat_tout_etcu_1.ctr_end_diag fmy_stat_tout_etcu_1.err_info_stat.lv_err_mem fmy_stat_tout_etcu_1.err_info_stat.lv_ready fmy_stat_tout_etcu_1.err_info_stat.lv_end_diag fmy_stat_tout_etcu_1.err_info_stat.lv_cdn_diag fmy_stat_tout_etcu_1.err_info_stat.err_sym fmy_stat_tout_etcu_2.ctr_abc fmy_stat_tout_etcu_2.ctr_end_diag fmy_stat_tout_etcu_2.err_info_stat.lv_err_mem fmy_stat_tout_etcu_2.err_info_stat.lv_ready fmy_stat_tout_etcu_2.err_info_stat.lv_end_diag fmy_stat_tout_etcu_2.err_info_stat.lv_cdn_diag fmy_stat_tout_etcu_2.err_info_stat.err_sym fmy_stat_tout_icl_2.ctr_abc fmy_stat_tout_icl_2.ctr_end_diag fmy_stat_tout_icl_2.err_info_stat.lv_err_mem fmy_stat_tout_icl_2.err_info_stat.lv_ready fmy_stat_tout_icl_2.err_info_stat.lv_end_diag fmy_stat_tout_icl_2.err_info_stat.lv_cdn_diag fmy_stat_tout_icl_2.err_info_stat.err_sym fmy_stat_tout_icl_3.ctr_abc fmy_stat_tout_icl_3.ctr_end_diag fmy_stat_tout_icl_3.err_info_stat.lv_err_mem fmy_stat_tout_icl_3.err_info_stat.lv_ready fmy_stat_tout_icl_3.err_info_stat.lv_end_diag fmy_stat_tout_icl_3.err_info_stat.lv_cdn_diag fmy_stat_tout_icl_3.err_info_stat.err_sym fmy_stat_tout_asr_1.ctr_abc fmy_stat_tout_asr_1.ctr_end_diag fmy_stat_tout_asr_1.err_info_stat.lv_err_mem fmy_stat_tout_asr_1.err_info_stat.lv_ready fmy_stat_tout_asr_1.err_info_stat.lv_end_diag fmy_stat_tout_asr_1.err_info_stat.lv_cdn_diag fmy_stat_tout_asr_1.err_info_stat.err_sym fmy_stat_tout_asr_3.ctr_abc fmy_stat_tout_asr_3.ctr_end_diag fmy_stat_tout_asr_3.err_info_stat.lv_err_mem fmy_stat_tout_asr_3.err_info_stat.lv_ready fmy_stat_tout_asr_3.err_info_stat.lv_end_diag fmy_stat_tout_asr_3.err_info_stat.lv_cdn_diag fmy_stat_tout_asr_3.err_info_stat.err_sym fmy_stat_tout_asr_4.ctr_abc fmy_stat_tout_asr_4.ctr_end_diag fmy_stat_tout_asr_4.err_info_stat.lv_err_mem fmy_stat_tout_asr_4.err_info_stat.lv_ready fmy_stat_tout_asr_4.err_info_stat.lv_end_diag fmy_stat_tout_asr_4.err_info_stat.lv_cdn_diag fmy_stat_tout_asr_4.err_info_stat.err_sym fmy_stat_tout_pste_1.ctr_abc fmy_stat_tout_pste_1.ctr_end_diag fmy_stat_tout_pste_1.err_info_stat.lv_err_mem fmy_stat_tout_pste_1.err_info_stat.lv_ready fmy_stat_tout_pste_1.err_info_stat.lv_end_diag fmy_stat_tout_pste_1.err_info_stat.lv_cdn_diag fmy_stat_tout_pste_1.err_info_stat.err_sym fmy_stat_tout_amt_1.ctr_abc fmy_stat_tout_amt_1.ctr_end_diag fmy_stat_tout_amt_1.err_info_stat.lv_err_mem fmy_stat_tout_amt_1.err_info_stat.lv_ready fmy_stat_tout_amt_1.err_info_stat.lv_end_diag fmy_stat_tout_amt_1.err_info_stat.lv_cdn_diag fmy_stat_tout_amt_1.err_info_stat.err_sym fmy_stat_vs.ctr_abc fmy_stat_vs.ctr_end_diag fmy_stat_vs.err_info_stat.lv_err_mem fmy_stat_vs.err_info_stat.lv_ready fmy_stat_vs.err_info_stat.lv_end_diag fmy_stat_vs.err_info_stat.lv_cdn_diag fmy_stat_vs.err_info_stat.err_sym fmy_stat_knks_1.ctr_abc fmy_stat_knks_1.ctr_end_diag fmy_stat_knks_1.err_info_stat.lv_err_mem fmy_stat_knks_1.err_info_stat.lv_ready fmy_stat_knks_1.err_info_stat.lv_end_diag fmy_stat_knks_1.err_info_stat.lv_cdn_diag fmy_stat_knks_1.err_info_stat.err_sym fmy_stat_knks_2.ctr_abc fmy_stat_knks_2.ctr_end_diag fmy_stat_knks_2.err_info_stat.lv_err_mem fmy_stat_knks_2.err_info_stat.lv_ready fmy_stat_knks_2.err_info_stat.lv_end_diag fmy_stat_knks_2.err_info_stat.lv_cdn_diag fmy_stat_knks_2.err_info_stat.err_sym fmy_stat_igc_scp_0.ctr_abc fmy_stat_igc_scp_0.ctr_end_diag fmy_stat_igc_scp_0.err_info_stat.lv_err_mem fmy_stat_igc_scp_0.err_info_stat.lv_ready fmy_stat_igc_scp_0.err_info_stat.lv_end_diag fmy_stat_igc_scp_0.err_info_stat.lv_cdn_diag fmy_stat_igc_scp_0.err_info_stat.err_sym fmy_stat_igc_scp_1.ctr_abc fmy_stat_igc_scp_1.ctr_end_diag fmy_stat_igc_scp_1.err_info_stat.lv_err_mem fmy_stat_igc_scp_1.err_info_stat.lv_ready fmy_stat_igc_scp_1.err_info_stat.lv_end_diag fmy_stat_igc_scp_1.err_info_stat.lv_cdn_diag fmy_stat_igc_scp_1.err_info_stat.err_sym fmy_stat_igc_scp_2.ctr_abc fmy_stat_igc_scp_2.ctr_end_diag fmy_stat_igc_scp_2.err_info_stat.lv_err_mem fmy_stat_igc_scp_2.err_info_stat.lv_ready fmy_stat_igc_scp_2.err_info_stat.lv_end_diag fmy_stat_igc_scp_2.err_info_stat.lv_cdn_diag fmy_stat_igc_scp_2.err_info_stat.err_sym fmy_stat_igc_scp_3.ctr_abc fmy_stat_igc_scp_3.ctr_end_diag fmy_stat_igc_scp_3.err_info_stat.lv_err_mem fmy_stat_igc_scp_3.err_info_stat.lv_ready fmy_stat_igc_scp_3.err_info_stat.lv_end_diag fmy_stat_igc_scp_3.err_info_stat.lv_cdn_diag fmy_stat_igc_scp_3.err_info_stat.err_sym fmy_stat_igc_scp_4.ctr_abc fmy_stat_igc_scp_4.ctr_end_diag fmy_stat_igc_scp_4.err_info_stat.lv_err_mem fmy_stat_igc_scp_4.err_info_stat.lv_ready fmy_stat_igc_scp_4.err_info_stat.lv_end_diag fmy_stat_igc_scp_4.err_info_stat.lv_cdn_diag fmy_stat_igc_scp_4.err_info_stat.err_sym fmy_stat_igc_scp_5.ctr_abc fmy_stat_igc_scp_5.ctr_end_diag fmy_stat_igc_scp_5.err_info_stat.lv_err_mem fmy_stat_igc_scp_5.err_info_stat.lv_ready fmy_stat_igc_scp_5.err_info_stat.lv_end_diag fmy_stat_igc_scp_5.err_info_stat.lv_cdn_diag fmy_stat_igc_scp_5.err_info_stat.err_sym fmy_stat_igc_scg_0.ctr_abc fmy_stat_igc_scg_0.ctr_end_diag fmy_stat_igc_scg_0.err_info_stat.lv_err_mem fmy_stat_igc_scg_0.err_info_stat.lv_ready fmy_stat_igc_scg_0.err_info_stat.lv_end_diag fmy_stat_igc_scg_0.err_info_stat.lv_cdn_diag fmy_stat_igc_scg_0.err_info_stat.err_sym fmy_stat_igc_scg_1.ctr_abc fmy_stat_igc_scg_1.ctr_end_diag fmy_stat_igc_scg_1.err_info_stat.lv_err_mem fmy_stat_igc_scg_1.err_info_stat.lv_ready fmy_stat_igc_scg_1.err_info_stat.lv_end_diag fmy_stat_igc_scg_1.err_info_stat.lv_cdn_diag fmy_stat_igc_scg_1.err_info_stat.err_sym fmy_stat_igc_scg_2.ctr_abc fmy_stat_igc_scg_2.ctr_end_diag fmy_stat_igc_scg_2.err_info_stat.lv_err_mem fmy_stat_igc_scg_2.err_info_stat.lv_ready fmy_stat_igc_scg_2.err_info_stat.lv_end_diag fmy_stat_igc_scg_2.err_info_stat.lv_cdn_diag fmy_stat_igc_scg_2.err_info_stat.err_sym fmy_stat_igc_scg_3.ctr_abc fmy_stat_igc_scg_3.ctr_end_diag fmy_stat_igc_scg_3.err_info_stat.lv_err_mem fmy_stat_igc_scg_3.err_info_stat.lv_ready fmy_stat_igc_scg_3.err_info_stat.lv_end_diag fmy_stat_igc_scg_3.err_info_stat.lv_cdn_diag fmy_stat_igc_scg_3.err_info_stat.err_sym fmy_stat_igc_scg_4.ctr_abc fmy_stat_igc_scg_4.ctr_end_diag fmy_stat_igc_scg_4.err_info_stat.lv_err_mem fmy_stat_igc_scg_4.err_info_stat.lv_ready fmy_stat_igc_scg_4.err_info_stat.lv_end_diag fmy_stat_igc_scg_4.err_info_stat.lv_cdn_diag fmy_stat_igc_scg_4.err_info_stat.err_sym fmy_stat_igc_scg_5.ctr_abc fmy_stat_igc_scg_5.ctr_end_diag fmy_stat_igc_scg_5.err_info_stat.lv_err_mem fmy_stat_igc_scg_5.err_info_stat.lv_ready fmy_stat_igc_scg_5.err_info_stat.lv_end_diag fmy_stat_igc_scg_5.err_info_stat.lv_cdn_diag fmy_stat_igc_scg_5.err_info_stat.err_sym fmy_stat_igc_ol_0.ctr_abc fmy_stat_igc_ol_0.ctr_end_diag fmy_stat_igc_ol_0.err_info_stat.lv_err_mem fmy_stat_igc_ol_0.err_info_stat.lv_ready fmy_stat_igc_ol_0.err_info_stat.lv_end_diag fmy_stat_igc_ol_0.err_info_stat.lv_cdn_diag fmy_stat_igc_ol_0.err_info_stat.err_sym fmy_stat_igc_ol_1.ctr_abc fmy_stat_igc_ol_1.ctr_end_diag fmy_stat_igc_ol_1.err_info_stat.lv_err_mem fmy_stat_igc_ol_1.err_info_stat.lv_ready fmy_stat_igc_ol_1.err_info_stat.lv_end_diag fmy_stat_igc_ol_1.err_info_stat.lv_cdn_diag fmy_stat_igc_ol_1.err_info_stat.err_sym fmy_stat_igc_ol_2.ctr_abc fmy_stat_igc_ol_2.ctr_end_diag fmy_stat_igc_ol_2.err_info_stat.lv_err_mem fmy_stat_igc_ol_2.err_info_stat.lv_ready fmy_stat_igc_ol_2.err_info_stat.lv_end_diag fmy_stat_igc_ol_2.err_info_stat.lv_cdn_diag fmy_stat_igc_ol_2.err_info_stat.err_sym fmy_stat_igc_ol_3.ctr_abc fmy_stat_igc_ol_3.ctr_end_diag fmy_stat_igc_ol_3.err_info_stat.lv_err_mem fmy_stat_igc_ol_3.err_info_stat.lv_ready fmy_stat_igc_ol_3.err_info_stat.lv_end_diag fmy_stat_igc_ol_3.err_info_stat.lv_cdn_diag fmy_stat_igc_ol_3.err_info_stat.err_sym fmy_stat_igc_ol_4.ctr_abc fmy_stat_igc_ol_4.ctr_end_diag fmy_stat_igc_ol_4.err_info_stat.lv_err_mem fmy_stat_igc_ol_4.err_info_stat.lv_ready fmy_stat_igc_ol_4.err_info_stat.lv_end_diag fmy_stat_igc_ol_4.err_info_stat.lv_cdn_diag fmy_stat_igc_ol_4.err_info_stat.err_sym fmy_stat_igc_ol_5.ctr_abc fmy_stat_igc_ol_5.ctr_end_diag fmy_stat_igc_ol_5.err_info_stat.lv_err_mem fmy_stat_igc_ol_5.err_info_stat.lv_ready fmy_stat_igc_ol_5.err_info_stat.lv_end_diag fmy_stat_igc_ol_5.err_info_stat.lv_cdn_diag fmy_stat_igc_ol_5.err_info_stat.err_sym fmy_stat_tps_1.ctr_abc fmy_stat_tps_1.ctr_end_diag fmy_stat_tps_1.err_info_stat.lv_err_mem fmy_stat_tps_1.err_info_stat.lv_ready fmy_stat_tps_1.err_info_stat.lv_end_diag fmy_stat_tps_1.err_info_stat.lv_cdn_diag fmy_stat_tps_1.err_info_stat.err_sym fmy_stat_tps_2.ctr_abc fmy_stat_tps_2.ctr_end_diag fmy_stat_tps_2.err_info_stat.lv_err_mem fmy_stat_tps_2.err_info_stat.lv_ready fmy_stat_tps_2.err_info_stat.lv_end_diag fmy_stat_tps_2.err_info_stat.lv_cdn_diag fmy_stat_tps_2.err_info_stat.err_sym fmy_stat_tps_maf_1.ctr_abc fmy_stat_tps_maf_1.ctr_end_diag fmy_stat_tps_maf_1.err_info_stat.lv_err_mem fmy_stat_tps_maf_1.err_info_stat.lv_ready fmy_stat_tps_maf_1.err_info_stat.lv_end_diag fmy_stat_tps_maf_1.err_info_stat.lv_cdn_diag fmy_stat_tps_maf_1.err_info_stat.err_sym fmy_stat_tps_maf_2.ctr_abc fmy_stat_tps_maf_2.ctr_end_diag fmy_stat_tps_maf_2.err_info_stat.lv_err_mem fmy_stat_tps_maf_2.err_info_stat.lv_ready fmy_stat_tps_maf_2.err_info_stat.lv_end_diag fmy_stat_tps_maf_2.err_info_stat.lv_cdn_diag fmy_stat_tps_maf_2.err_info_stat.err_sym fmy_stat_tps_ratio.ctr_abc fmy_stat_tps_ratio.ctr_end_diag fmy_stat_tps_ratio.err_info_stat.lv_err_mem fmy_stat_tps_ratio.err_info_stat.lv_ready fmy_stat_tps_ratio.err_info_stat.lv_end_diag fmy_stat_tps_ratio.err_info_stat.lv_cdn_diag fmy_stat_tps_ratio.err_info_stat.err_sym fmy_stat_v_ref_1.ctr_abc fmy_stat_v_ref_1.ctr_end_diag fmy_stat_v_ref_1.err_info_stat.lv_err_mem fmy_stat_v_ref_1.err_info_stat.lv_ready fmy_stat_v_ref_1.err_info_stat.lv_end_diag fmy_stat_v_ref_1.err_info_stat.lv_cdn_diag fmy_stat_v_ref_1.err_info_stat.err_sym fmy_stat_v_ref_2.ctr_abc fmy_stat_v_ref_2.ctr_end_diag fmy_stat_v_ref_2.err_info_stat.lv_err_mem fmy_stat_v_ref_2.err_info_stat.lv_ready fmy_stat_v_ref_2.err_info_stat.lv_end_diag fmy_stat_v_ref_2.err_info_stat.lv_cdn_diag fmy_stat_v_ref_2.err_info_stat.err_sym fmy_stat_pvs_1.ctr_abc fmy_stat_pvs_1.ctr_end_diag fmy_stat_pvs_1.err_info_stat.lv_err_mem fmy_stat_pvs_1.err_info_stat.lv_ready fmy_stat_pvs_1.err_info_stat.lv_end_diag fmy_stat_pvs_1.err_info_stat.lv_cdn_diag fmy_stat_pvs_1.err_info_stat.err_sym fmy_stat_pvs_2.ctr_abc fmy_stat_pvs_2.ctr_end_diag fmy_stat_pvs_2.err_info_stat.lv_err_mem fmy_stat_pvs_2.err_info_stat.lv_ready fmy_stat_pvs_2.err_info_stat.lv_end_diag fmy_stat_pvs_2.err_info_stat.lv_cdn_diag fmy_stat_pvs_2.err_info_stat.err_sym fmy_stat_pvs_ratio.ctr_abc fmy_stat_pvs_ratio.ctr_end_diag fmy_stat_pvs_ratio.err_info_stat.lv_err_mem fmy_stat_pvs_ratio.err_info_stat.lv_ready fmy_stat_pvs_ratio.err_info_stat.lv_end_diag fmy_stat_pvs_ratio.err_info_stat.lv_cdn_diag fmy_stat_pvs_ratio.err_info_stat.err_sym fmy_stat_pvs_double.ctr_abc fmy_stat_pvs_double.ctr_end_diag fmy_stat_pvs_double.err_info_stat.lv_err_mem fmy_stat_pvs_double.err_info_stat.lv_ready fmy_stat_pvs_double.err_info_stat.lv_end_diag fmy_stat_pvs_double.err_info_stat.lv_cdn_diag fmy_stat_pvs_double.err_info_stat.err_sym fmy_stat_pvs_bls_not_plaus.ctr_abc fmy_stat_pvs_bls_not_plaus.ctr_end_diag fmy_stat_pvs_bls_not_plaus.err_info_stat.lv_err_mem fmy_stat_pvs_bls_not_plaus.err_info_stat.lv_ready fmy_stat_pvs_bls_not_plaus.err_info_stat.lv_end_diag fmy_stat_pvs_bls_not_plaus.err_info_stat.lv_cdn_diag fmy_stat_pvs_bls_not_plaus.err_info_stat.err_sym fmy_stat_mtc_dr.ctr_abc fmy_stat_mtc_dr.ctr_end_diag fmy_stat_mtc_dr.err_info_stat.lv_err_mem fmy_stat_mtc_dr.err_info_stat.lv_ready fmy_stat_mtc_dr.err_info_stat.lv_end_diag fmy_stat_mtc_dr.err_info_stat.lv_cdn_diag fmy_stat_mtc_dr.err_info_stat.err_sym fmy_stat_mtc_ctl_1.ctr_abc fmy_stat_mtc_ctl_1.ctr_end_diag fmy_stat_mtc_ctl_1.err_info_stat.lv_err_mem fmy_stat_mtc_ctl_1.err_info_stat.lv_ready fmy_stat_mtc_ctl_1.err_info_stat.lv_end_diag fmy_stat_mtc_ctl_1.err_info_stat.lv_cdn_diag fmy_stat_mtc_ctl_1.err_info_stat.err_sym fmy_stat_mtc_ctl_2.ctr_abc fmy_stat_mtc_ctl_2.ctr_end_diag fmy_stat_mtc_ctl_2.err_info_stat.lv_err_mem fmy_stat_mtc_ctl_2.err_info_stat.lv_ready fmy_stat_mtc_ctl_2.err_info_stat.lv_end_diag fmy_stat_mtc_ctl_2.err_info_stat.lv_cdn_diag fmy_stat_mtc_ctl_2.err_info_stat.err_sym fmy_stat_mtc_ctl_3.ctr_abc fmy_stat_mtc_ctl_3.ctr_end_diag fmy_stat_mtc_ctl_3.err_info_stat.lv_err_mem fmy_stat_mtc_ctl_3.err_info_stat.lv_ready fmy_stat_mtc_ctl_3.err_info_stat.lv_end_diag fmy_stat_mtc_ctl_3.err_info_stat.lv_cdn_diag fmy_stat_mtc_ctl_3.err_info_stat.err_sym fmy_stat_tps_ad.ctr_abc fmy_stat_tps_ad.ctr_end_diag fmy_stat_tps_ad.err_info_stat.lv_err_mem fmy_stat_tps_ad.err_info_stat.lv_ready fmy_stat_tps_ad.err_info_stat.lv_end_diag fmy_stat_tps_ad.err_info_stat.lv_cdn_diag fmy_stat_tps_ad.err_info_stat.err_sym fmy_stat_tps_ad_bol.ctr_abc fmy_stat_tps_ad_bol.ctr_end_diag fmy_stat_tps_ad_bol.err_info_stat.lv_err_mem fmy_stat_tps_ad_bol.err_info_stat.lv_ready fmy_stat_tps_ad_bol.err_info_stat.lv_end_diag fmy_stat_tps_ad_bol.err_info_stat.lv_cdn_diag fmy_stat_tps_ad_bol.err_info_stat.err_sym fmy_stat_tps_st_chk_1.ctr_abc fmy_stat_tps_st_chk_1.ctr_end_diag fmy_stat_tps_st_chk_1.err_info_stat.lv_err_mem fmy_stat_tps_st_chk_1.err_info_stat.lv_ready fmy_stat_tps_st_chk_1.err_info_stat.lv_end_diag fmy_stat_tps_st_chk_1.err_info_stat.lv_cdn_diag fmy_stat_tps_st_chk_1.err_info_stat.err_sym fmy_stat_tps_st_chk_2.ctr_abc fmy_stat_tps_st_chk_2.ctr_end_diag fmy_stat_tps_st_chk_2.err_info_stat.lv_err_mem fmy_stat_tps_st_chk_2.err_info_stat.lv_ready fmy_stat_tps_st_chk_2.err_info_stat.lv_end_diag fmy_stat_tps_st_chk_2.err_info_stat.lv_cdn_diag fmy_stat_tps_st_chk_2.err_info_stat.err_sym fmy_stat_gen.ctr_abc fmy_stat_gen.ctr_end_diag fmy_stat_gen.err_info_stat.lv_err_mem fmy_stat_gen.err_info_stat.lv_ready fmy_stat_gen.err_info_stat.lv_end_diag fmy_stat_gen.err_info_stat.lv_cdn_diag fmy_stat_gen.err_info_stat.err_sym fmy_stat_gen_diag.ctr_abc fmy_stat_gen_diag.ctr_end_diag fmy_stat_gen_diag.err_info_stat.lv_err_mem fmy_stat_gen_diag.err_info_stat.lv_ready fmy_stat_gen_diag.err_info_stat.lv_end_diag fmy_stat_gen_diag.err_info_stat.lv_cdn_diag fmy_stat_gen_diag.err_info_stat.err_sym fmy_stat_alter_bn.ctr_abc fmy_stat_alter_bn.ctr_end_diag fmy_stat_alter_bn.err_info_stat.lv_err_mem fmy_stat_alter_bn.err_info_stat.lv_ready fmy_stat_alter_bn.err_info_stat.lv_end_diag fmy_stat_alter_bn.err_info_stat.lv_cdn_diag fmy_stat_alter_bn.err_info_stat.err_sym fmy_stat_alter_bn_bat.ctr_abc fmy_stat_alter_bn_bat.ctr_end_diag fmy_stat_alter_bn_bat.err_info_stat.lv_err_mem /end OUT_MEASUREMENT
/end FUNCTION
/end MODULE
/end PROJECT
