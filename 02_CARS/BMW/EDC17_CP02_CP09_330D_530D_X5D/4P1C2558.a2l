ASAP2_VERSION 1 4
/begin PROJECT P_558 "EDC17_CP02"
/begin HEADER "" VERSION "V1C1" PROJECT_NO P_558 /end HEADER
/begin MODULE DIM ""
/begin MOD_COMMON "" BYTE_ORDER MSB_LAST ALIGNMENT_BYTE 1 ALIGNMENT_WORD 2 ALIGNMENT_LONG 4 ALIGNMENT_FLOAT32_IEEE 4 /end MOD_COMMON
/begin CHARACTERISTIC InjCtl_facAdjSrvMax_C "Maximalwert für Serviceabgleichfaktor" VALUE 0x8006353E Kw_Ws16 3.000000 Fact 0.00 3.000000 FORMAT "%8.6" EXTENDED_LIMITS -4.000000 3.999878 /end CHARACTERISTIC
/begin CHARACTERISTIC InjCtl_facAdjSrvMin_C "Minimalwert für Serviceabgleichfaktor" VALUE 0x80063540 Kw_Ws16 3.000000 Fact 0.00 3.000000 FORMAT "%8.6" EXTENDED_LIMITS -4.000000 3.999878 /end CHARACTERISTIC
/begin CHARACTERISTIC InjCtl_facAdjSrvUnlimDfl_C "Vorgabewert für Serviceabgleichfaktor" VALUE 0x80063542 Kw_Ws16 3.000000 Fact 0.00 3.000000 FORMAT "%8.6" EXTENDED_LIMITS -4.000000 3.999878 /end CHARACTERISTIC
/begin CHARACTERISTIC InjCtl_qAdjQntMax_C "Maximalwert für Mengenabgleich" VALUE 0x80063544 Kw_Ws16 327.6700 InjMassCyc 0.00 327.6700 FORMAT "%8.4" EXTENDED_LIMITS -327.6800 327.6700 /end CHARACTERISTIC
/begin CHARACTERISTIC InjCtl_qAdjQntMin_C "Minimalwert für Mengenabgleich" VALUE 0x80063546 Kw_Ws16 327.6700 InjMassCyc 0.00 327.6700 FORMAT "%8.4" EXTENDED_LIMITS -327.6800 327.6700 /end CHARACTERISTIC
/begin CHARACTERISTIC InjCtl_qAdjQnt_MAP "Neutralkennfeld für Mengenabgleich" MAP 0x80063548 Kf_Xs16_Ys16_Ws16 327.6700 InjMassCyc 0.00 327.6700 FORMAT "%8.4" EXTENDED_LIMITS -327.6800 327.6700
 /begin AXIS_DESCR STD_AXIS Epm_nEng EngN 8 0.00 6000.000 FORMAT "%8.3" EXTENDED_LIMITS -16384.00 16383.50 DEPOSIT ABSOLUTE /end AXIS_DESCR
 /begin AXIS_DESCR STD_AXIS InjCtl_qSetUnCor_mp InjMassCyc 6 0.00 327.6700 FORMAT "%8.4" EXTENDED_LIMITS -327.6800 327.6700 DEPOSIT ABSOLUTE /end AXIS_DESCR
/end CHARACTERISTIC
/begin CHARACTERISTIC InjCtl_qDriftComp_MAP "Kennfeld für Mengendriftkompensation" MAP 0x800635C8 Kf_Xs16_Ys16_Ws16 327.6700 InjMassCyc 0.00 327.6700 FORMAT "%8.4" EXTENDED_LIMITS -327.6800 327.6700
 /begin AXIS_DESCR STD_AXIS InjCtl_qSetUnBal InjMass 8 0.00 327.6700 FORMAT "%8.4" EXTENDED_LIMITS -327.6800 327.6700 DEPOSIT ABSOLUTE /end AXIS_DESCR
 /begin AXIS_DESCR STD_AXIS InjCtl_tiEngOn_mp TimeEngOnHrs 4 0.00 596497.0 FORMAT "%8.1" EXTENDED_LIMITS -596515.2 596497.0 DEPOSIT ABSOLUTE /end AXIS_DESCR
/end CHARACTERISTIC
/begin CHARACTERISTIC InjCtl_qDriftMax2_C "Mengendriftkompensationsbegrenzung (Datensatz)" VALUE 0x80063624 Kw_Ws16 327.6700 InjMassCyc 0.00 327.6700 FORMAT "%8.4" EXTENDED_LIMITS -327.6800 327.6700 /end CHARACTERISTIC
/begin CHARACTERISTIC InjCtl_qDriftMin2_C "Mengendriftkompensationsbegrenzung (Datensatz)" VALUE 0x80063626 Kw_Ws16 327.6700 InjMassCyc 0.00 327.6700 FORMAT "%8.4" EXTENDED_LIMITS -327.6800 327.6700 /end CHARACTERISTIC
/begin CHARACTERISTIC InjCtl_qLimSoftShOff_CUR "limitation value in case of soft shutoff" CURVE 0x80063628 Kl_Xs16_Ws16 327.6700 InjMassCyc 0.00 327.6700 FORMAT "%8.4" EXTENDED_LIMITS -327.6800 327.6700
 /begin AXIS_DESCR STD_AXIS Epm_nEng EngN 16 0.00 6000.000 FORMAT "%8.3" EXTENDED_LIMITS -16384.00 16383.50 DEPOSIT ABSOLUTE /end AXIS_DESCR
/end CHARACTERISTIC
/begin CHARACTERISTIC InjSys_ctTempSel_C "Auszulesende Motortemperatur aus dem Motortemperaturenfeld" VALUE 0x8007A4AC Val_Wu8 2.00000000000 EngTempFldSel 0.00 2.00000000000 FORMAT "%13.11" /end CHARACTERISTIC
/begin CHARACTERISTIC InjSys_dqLim.Pos_C "/" VALUE 0x8007A4B0 Kw_Ws32 327679.999847 RmpInjMass 0.00 327679.999847 FORMAT "%13.6" EXTENDED_LIMITS -327680.000000 327679.999847 /end CHARACTERISTIC
/begin CHARACTERISTIC InjSys_dqLim.Neg_C "/" VALUE 0x8007A4B4 Kw_Ws32 327679.999847 RmpInjMass 0.00 327679.999847 FORMAT "%13.6" EXTENDED_LIMITS -327680.000000 327679.999847 /end CHARACTERISTIC
/begin CHARACTERISTIC InjSys_qTempFuelErr_CUR "Motordrehzahl abhängiges Einspritzungquantität Curve" CURVE 0x8007A4B8 Kl_Xs16_Ws16 327.6700 InjMass 0.00 327.6700 FORMAT "%8.4" EXTENDED_LIMITS -327.6800 327.6700
 /begin AXIS_DESCR STD_AXIS Epm_nEng EngN 21 0.00 6000.000 FORMAT "%8.3" EXTENDED_LIMITS -16384.00 16383.50 DEPOSIT ABSOLUTE /end AXIS_DESCR
/end CHARACTERISTIC
/begin CHARACTERISTIC InjSys_qTempFuel_MAP "Kraftstofftemperatur abhängiges Einspritzungquantität Map" MAP 0x8007A50E Kf_Xs16_Ys16_Ws16 327.6700 InjMass 0.00 327.6700 FORMAT "%8.4" EXTENDED_LIMITS -327.6800 327.6700
 /begin AXIS_DESCR STD_AXIS Epm_nEng EngN 12 0.00 6000.000 FORMAT "%8.3" EXTENDED_LIMITS -16384.00 16383.50 DEPOSIT ABSOLUTE /end AXIS_DESCR
 /begin AXIS_DESCR STD_AXIS FuelT_t Temp_Cels 5 -50.14000 149.8600 FORMAT "%8.4" EXTENDED_LIMITS -3549.940 3003.560 DEPOSIT ABSOLUTE /end AXIS_DESCR
/end CHARACTERISTIC
/begin CHARACTERISTIC InjUn_ctSyncStrtPls_C "" VALUE 0x80062BE0 Val_Wu16 65535.00 OneToOne 0.00 65535.00 FORMAT "%8.2" /end CHARACTERISTIC
/begin CHARACTERISTIC InjUn_nStrtLim_C "" VALUE 0x80062BE2 Val_Ws16 5000.000 EngN 0.00 5000.000 FORMAT "%8.3" EXTENDED_LIMITS -16384.00 16383.50 /end CHARACTERISTIC
/begin CHARACTERISTIC InjUn_stShOffStrt_C "" VALUE 0x80062BE4 Val_Wu32 4294967295.00 OneToOne 0.00 4294967295.00 FORMAT "%13.2" /end CHARACTERISTIC
/begin CHARACTERISTIC InjUn_swtStrtPls_C "" VALUE 0x80062BE8 Val_Wu8 7.000 OneToOne 0.00 7.000 FORMAT "%5.3" EXTENDED_LIMITS 0.00 255.0 /end CHARACTERISTIC
/begin CHARACTERISTIC InjUn_tiIRevShOffStrtPls_C "" VALUE 0x80062BEA Val_Ws16 387680.0 Time_ms -327680.0 60000.00 FORMAT "%8.1" EXTENDED_LIMITS -327680.0 327670.0 /end CHARACTERISTIC
/begin CHARACTERISTIC InjUn_tiRailStrtPls_C "" VALUE 0x80062BEC Val_Ws16 387680.0 Time_ms -327680.0 60000.00 FORMAT "%8.1" EXTENDED_LIMITS -327680.0 327670.0 /end CHARACTERISTIC
/begin CHARACTERISTIC InjUn_tiRevShOffStrtPls_C "" VALUE 0x80062BEE Val_Ws16 387680.0 Time_ms -327680.0 60000.00 FORMAT "%8.1" EXTENDED_LIMITS -327680.0 327670.0 /end CHARACTERISTIC
/begin CHARACTERISTIC InjUn_tiSpdStrtPls_C "" VALUE 0x80062BF0 Val_Ws16 387680.0 Time_ms -327680.0 60000.00 FORMAT "%8.1" EXTENDED_LIMITS -327680.0 327670.0 /end CHARACTERISTIC
/begin CHARACTERISTIC InjVlv_facAddBalRls_MAP "Freigabekennfeld zur Aufrechnung der Mengenkorrektur" MAP 0x80062BF4 Map_Xs16Ys16Ws16 1.000000 Fact 0.00 1.000000 FORMAT "%8.6" EXTENDED_LIMITS -4.000000 3.999878
 /begin AXIS_DESCR STD_AXIS RailP_pFlt Pres_Rail 3 0.00 2000.000 FORMAT "%5.3" EXTENDED_LIMITS -3276.800 3276.700 DEPOSIT ABSOLUTE /end AXIS_DESCR
 /begin AXIS_DESCR STD_AXIS InjCtl_qSetUnBal InjMass 2 0.00 327.6700 FORMAT "%8.4" EXTENDED_LIMITS -327.6800 327.6700 DEPOSIT ABSOLUTE /end AXIS_DESCR
/end CHARACTERISTIC
/begin CHARACTERISTIC InjVlv_facBalMax_C "Maximaler Korrekturfaktor für FBC-Eingriff" VALUE 0x80062C0E Val_Ws16 3.999878 Fact 0.00 3.999878 FORMAT "%8.6" EXTENDED_LIMITS -4.000000 3.999878 /end CHARACTERISTIC
/begin CHARACTERISTIC InjVlv_nETMaxLim_C "maximale Drehzahl für die Begrenzung der Ansteuerdauer MI" VALUE 0x80062C10 Val_Ws16 32767.50 EngN -16384.00 16383.50 FORMAT "%8.2" /end CHARACTERISTIC
/begin CHARACTERISTIC InjVlv_numBnkTDC_CA "Banknummer des Injektors" VAL_BLK 0x8006328A ValA_Wu8 4.000 OneToOne 0.00 4.000 FORMAT "%5.3" EXTENDED_LIMITS 0.00 255.0 NUMBER 6 /end CHARACTERISTIC
/begin CHARACTERISTIC InjVlv_numECUTDC_CA "Steuergerät, auf dem der Zylinder liegt" VAL_BLK 0x80063290 ValA_Wu8 4.000 OneToOne 0.00 4.000 FORMAT "%5.3" EXTENDED_LIMITS 0.00 255.0 NUMBER 6 /end CHARACTERISTIC
/begin CHARACTERISTIC InjVlv_numInjChrgBal_MAP "max. Anzahl an Einspritzungen aufgrund Ladungsbilanz Boosterkondensators" MAP 0x80062C2C Map_Xs16Ys16Ws16 6.000000 OneToOne 0.00 6.000000 FORMAT "%8.6" EXTENDED_LIMITS -32768.00 32767.00
 /begin AXIS_DESCR STD_AXIS Epm_nEng EngN 15 0.00 6000.000 FORMAT "%8.3" EXTENDED_LIMITS -16384.00 16383.50 DEPOSIT ABSOLUTE /end AXIS_DESCR
 /begin AXIS_DESCR STD_AXIS BattU_u Volt_Batt 6 -655360.0 655340.0 FORMAT "%8.1" DEPOSIT ABSOLUTE /end AXIS_DESCR
/end CHARACTERISTIC
/begin CHARACTERISTIC InjVlv_numPsTDC_CA "Zuordnung zwischen Zylindernummer und Endstufennummer" VAL_BLK 0x80063296 ValA_Wu8 4.000 OneToOne 0.00 4.000 FORMAT "%5.3" EXTENDED_LIMITS 0.00 255.0 NUMBER 6 /end CHARACTERISTIC
/begin CHARACTERISTIC InjVlv_pMin_C "Injektorabhängige Druckschwelle zur Freigabe/Sperrung der Einspritzung" VALUE 0x800632A8 Val_Ws16 2000.000 Pres_Rail 0.00 2000.000 FORMAT "%5.3" EXTENDED_LIMITS -3276.800 3276.700 /end CHARACTERISTIC
/begin CHARACTERISTIC InjVlv_pMin_CUR "Kühlmitteltemperaturabhängige Druckschwelle zur Freigabe der Einspritzungen" CURVE 0x800632AA Cur_Xs16Ws16 2000.000 Pres_Rail 0.00 2000.000 FORMAT "%5.3" EXTENDED_LIMITS -3276.800 3276.700
 /begin AXIS_DESCR STD_AXIS EngDa_tEng Temp_Cels 8 -50.14000 199.8600 FORMAT "%8.4" EXTENDED_LIMITS -3549.940 3003.560 DEPOSIT ABSOLUTE /end AXIS_DESCR
/end CHARACTERISTIC
/begin AXIS_PTS InjVlv_pRailZFCETCor_AXIS "gemeinsame Raildruck-Achse für ZFC Ansteuerdauerkorrektur-Kennfelder" 0x800632DA RailP_pCurr_mp Axis_Xs16 600000.0 Pres_Rail 6 200000.0 800000.0 FORMAT "%8.1" EXTENDED_LIMITS -3276800. 3276700. DEPOSIT ABSOLUTE /end AXIS_PTS
/begin CHARACTERISTIC InjVlv_PZOSW_C "Software Version" VALUE 0x800632D0 Val_Wu32 4294967295.00 OneToOne 0.00 4294967295.00 FORMAT "%13.2" READ_ONLY /end CHARACTERISTIC
/begin CHARACTERISTIC InjVlv_qPoI1Min_C "Minimale Menge für die Nacheinspritzung 1" VALUE 0x800632A6 Val_Ws16 327.6700 InjMass 0.00 327.6700 FORMAT "%8.4" EXTENDED_LIMITS -327.6800 327.6700 /end CHARACTERISTIC
/begin AXIS_PTS InjVlv_qZFCETCor_AXIS "Stützstellen der Menge für Korrekturfaktor-Gruppenkennfelder der Ansteuerdauerkorrektur der Nullmengenkalibrierung" 0x800632E8 InjVlv_qInZFCETGMap_mp Axis_Xs16 3.000000 InjMass 6 0.00 3.000000 FORMAT "%8.6" EXTENDED_LIMITS -327.6800 327.6700 DEPOSIT ABSOLUTE /end AXIS_PTS
/begin CHARACTERISTIC InjVlv_rChrgBalEngSpdHys_C "Drehzahl Hystereseschwelle für die Auswahl der max. Anzahl an Einspritzungen aufgrund der Ladungsbilanz des Boosterkondensators" VALUE 0x80062D0E Val_Ws16 50.00000 Prc 0.00 50.00000 FORMAT "%8.5" EXTENDED_LIMITS -400.0000 399.9878 /end CHARACTERISTIC
/begin CHARACTERISTIC InjVlv_rChrgBalVltgHys_C "Batteriespannungs- Hystereseschwelle für Auswahl der max. Anzahl an Einspritzungen aufgrund Ladungsbilanz Boosterkondensators" VALUE 0x80062D10 Val_Ws16 50.00000 Prc 0.00 50.00000 FORMAT "%8.5" EXTENDED_LIMITS -400.0000 399.9878 /end CHARACTERISTIC
/begin CHARACTERISTIC InjVlv_rZFCETDif0_GMAP "Gruppenkennfeld Bewertungsfaktor für Ansteuerdauerkorrektur durch Nullmengenkalibrierung am Raildruck-Kalibrierpunkt 0" MAP 0x800632F6 MapG_Ws16 100.0000 Prc 0.00 100.0000 FORMAT "%8.4" EXTENDED_LIMITS -400.0000 399.9878
 /begin AXIS_DESCR COM_AXIS RailP_pCurr_mp Pres_Rail 6 200.0000 2000.0000 FORMAT "%5.4" EXTENDED_LIMITS -3276.8000 3276.7000 AXIS_PTS_REF InjVlv_pRailZFCETCor_AXIS /end AXIS_DESCR
 /begin AXIS_DESCR COM_AXIS InjVlv_qInZFCETGMap_mp InjMass 6 0.00 3.000000 FORMAT "%8.6" EXTENDED_LIMITS -327.6800 327.6700 AXIS_PTS_REF InjVlv_qZFCETCor_AXIS /end AXIS_DESCR
/end CHARACTERISTIC
/begin CHARACTERISTIC InjVlv_rZFCETDif1_GMAP "Gruppenkennfeld Bewertungsfaktor für Ansteuerdauerkorrektur durch Nullmengenkalibrierung am Raildruck-Kalibrierpunkt 1" MAP 0x8006333E MapG_Ws16 100.0000 Prc 0.00 100.0000 FORMAT "%8.4" EXTENDED_LIMITS -400.0000 399.9878
 /begin AXIS_DESCR COM_AXIS RailP_pCurr_mp Pres_Rail 6 200.0000 2000.0000 FORMAT "%5.4" EXTENDED_LIMITS -3276.8000 3276.7000 AXIS_PTS_REF InjVlv_pRailZFCETCor_AXIS /end AXIS_DESCR
 /begin AXIS_DESCR COM_AXIS InjVlv_qInZFCETGMap_mp InjMass 6 0.00 3.000000 FORMAT "%8.6" EXTENDED_LIMITS -327.6800 327.6700 AXIS_PTS_REF InjVlv_qZFCETCor_AXIS /end AXIS_DESCR
/end CHARACTERISTIC
/begin CHARACTERISTIC InjVlv_rZFCETDif2_GMAP "" MAP 0x80063386 MapG_Ws16 100.0000 Prc 0.00 100.0000 FORMAT "%8.4" EXTENDED_LIMITS -400.0000 399.9878
 /begin AXIS_DESCR COM_AXIS RailP_pCurr_mp Pres_Rail 6 200.0000 2000.0000 FORMAT "%5.4" EXTENDED_LIMITS -3276.8000 3276.7000 AXIS_PTS_REF InjVlv_pRailZFCETCor_AXIS /end AXIS_DESCR
 /begin AXIS_DESCR COM_AXIS InjVlv_qInZFCETGMap_mp InjMass 6 0.00 3.000000 FORMAT "%8.6" EXTENDED_LIMITS -327.6800 327.6700 AXIS_PTS_REF InjVlv_qZFCETCor_AXIS /end AXIS_DESCR
/end CHARACTERISTIC
/begin CHARACTERISTIC InjVlv_rZFCETDif3_GMAP "" MAP 0x800633CE MapG_Ws16 100.0000 Prc 0.00 100.0000 FORMAT "%8.4" EXTENDED_LIMITS -400.0000 399.9878
 /begin AXIS_DESCR COM_AXIS RailP_pCurr_mp Pres_Rail 6 200.0000 2000.0000 FORMAT "%5.4" EXTENDED_LIMITS -3276.8000 3276.7000 AXIS_PTS_REF InjVlv_pRailZFCETCor_AXIS /end AXIS_DESCR
 /begin AXIS_DESCR COM_AXIS InjVlv_qInZFCETGMap_mp InjMass 6 0.00 3.000000 FORMAT "%8.6" EXTENDED_LIMITS -327.6800 327.6700 AXIS_PTS_REF InjVlv_qZFCETCor_AXIS /end AXIS_DESCR
/end CHARACTERISTIC
/begin CHARACTERISTIC InjVlv_rZFCETDif4_GMAP "" MAP 0x80063416 MapG_Ws16 100.0000 Prc 0.00 100.0000 FORMAT "%8.4" EXTENDED_LIMITS -400.0000 399.9878
 /begin AXIS_DESCR COM_AXIS RailP_pCurr_mp Pres_Rail 6 200.0000 2000.0000 FORMAT "%5.4" EXTENDED_LIMITS -3276.8000 3276.7000 AXIS_PTS_REF InjVlv_pRailZFCETCor_AXIS /end AXIS_DESCR
 /begin AXIS_DESCR COM_AXIS InjVlv_qInZFCETGMap_mp InjMass 6 0.00 3.000000 FORMAT "%8.6" EXTENDED_LIMITS -327.6800 327.6700 AXIS_PTS_REF InjVlv_qZFCETCor_AXIS /end AXIS_DESCR
/end CHARACTERISTIC
/begin CHARACTERISTIC InjVlv_rZFCETDif5_GMAP "" MAP 0x8006345E MapG_Ws16 100.0000 Prc 0.00 100.0000 FORMAT "%8.4" EXTENDED_LIMITS -400.0000 399.9878
 /begin AXIS_DESCR COM_AXIS RailP_pCurr_mp Pres_Rail 6 200.0000 2000.0000 FORMAT "%5.4" EXTENDED_LIMITS -3276.8000 3276.7000 AXIS_PTS_REF InjVlv_pRailZFCETCor_AXIS /end AXIS_DESCR
 /begin AXIS_DESCR COM_AXIS InjVlv_qInZFCETGMap_mp InjMass 6 0.00 3.000000 FORMAT "%8.6" EXTENDED_LIMITS -327.6800 327.6700 AXIS_PTS_REF InjVlv_qZFCETCor_AXIS /end AXIS_DESCR
/end CHARACTERISTIC
/begin CHARACTERISTIC InjVlv_rZFCETDif6_GMAP "" MAP 0x800634A6 MapG_Ws16 100.0000 Prc 0.00 100.0000 FORMAT "%8.4" EXTENDED_LIMITS -400.0000 399.9878
 /begin AXIS_DESCR COM_AXIS RailP_pCurr_mp Pres_Rail 6 200.0000 2000.0000 FORMAT "%5.4" EXTENDED_LIMITS -3276.8000 3276.7000 AXIS_PTS_REF InjVlv_pRailZFCETCor_AXIS /end AXIS_DESCR
 /begin AXIS_DESCR COM_AXIS InjVlv_qInZFCETGMap_mp InjMass 6 0.00 3.000000 FORMAT "%8.6" EXTENDED_LIMITS -327.6800 327.6700 AXIS_PTS_REF InjVlv_qZFCETCor_AXIS /end AXIS_DESCR
/end CHARACTERISTIC
/begin CHARACTERISTIC InjVlv_rZFCETMsk_GMAP "Gruppenkennfeld Gesamtbewertungsfaktor der Ansteuerdauerkorrektur durch Nullmengenkalibrierung" MAP 0x800634EE MapG_Ws16 100.0000 Prc 0.00 100.0000 FORMAT "%8.4" EXTENDED_LIMITS -400.0000 399.9878
 /begin AXIS_DESCR COM_AXIS RailP_pCurr_mp Pres_Rail 6 200.0000 2000.0000 FORMAT "%5.4" EXTENDED_LIMITS -3276.8000 3276.7000 AXIS_PTS_REF InjVlv_pRailZFCETCor_AXIS /end AXIS_DESCR
 /begin AXIS_DESCR COM_AXIS InjVlv_qInZFCETGMap_mp InjMass 6 0.00 3.000000 FORMAT "%8.6" EXTENDED_LIMITS -327.6800 327.6700 AXIS_PTS_REF InjVlv_qZFCETCor_AXIS /end AXIS_DESCR
/end CHARACTERISTIC
/begin CHARACTERISTIC InjVlv_stInjCharComp_C "Status der Kompensation der freigegebenen Einspritzungen" VALUE 0x8006329E Val_Wu8 255.0 OneToOne 0.00 255.0 FORMAT "%5.1" /end CHARACTERISTIC
/begin CHARACTERISTIC InjVlv_stInjCoRC_C "Zustand: Remotewert für den Ansteuerkoordinator" VALUE 0x8006329C Val_Wu8 255.0 OneToOne 0.00 255.0 FORMAT "%5.1" /end CHARACTERISTIC
/begin CHARACTERISTIC InjVlv_stInjMode_C "Verhalten der Umschaltung von Anzugsphase auf Haltephase" VALUE 0x800632D4 Val_Wu8 3.000 OneToOne 0.00 3.000 FORMAT "%5.3" EXTENDED_LIMITS 0.00 255.0 /end CHARACTERISTIC
/begin CHARACTERISTIC InjVlv_stInjRls_CA "status der freigegebenen Einspritzungen" VAL_BLK 0x8006329F ValA_Wu8 255.0 OneToOne 0.00 255.0 FORMAT "%5.1" NUMBER 6 /end CHARACTERISTIC
/begin CHARACTERISTIC InjVlv_stInputZFCETGMap_C "Auswahl der Menge für Anzeige der Gruppenkennfelder InjVlv_rZFCETDif0_GMAP, ...Dif1_GMAP, ...Msk_GMAP" VALUE 0x80063536 Val_Wu8 255.0 OneToOne 0.00 255.0 FORMAT "%5.1" /end CHARACTERISTIC
/begin CHARACTERISTIC InjVlv_stZFCETCorActv_C "Aktivierungsstatus der ZFC Ansteuerdauerkorrektur (0 = keine Korrektur)" VALUE 0x80063537 Val_Wu8 0.00 OneToOne 0.00 0.00 FORMAT "%5.2" EXTENDED_LIMITS 0.00 255.0 /end CHARACTERISTIC
/begin CHARACTERISTIC InjVlv_swtEnaAgDiff_C "Ein-/Ausschalter zur Berechnung des Differenzwinkels (1: ein, 0: aus)" VALUE 0x800632D5 Val_Wu8 1.000 OneToOne 0.00 1.000 FORMAT "%5.3" EXTENDED_LIMITS 0.00 255.0 /end CHARACTERISTIC
/begin CHARACTERISTIC InjVlv_swtInjCoRC_C "Schalter: Zustand des Ansteuerkoordinators wird per Remote gestellt" VALUE 0x8006329D Val_Wu8 255.0 OneToOne 0.00 255.0 FORMAT "%5.1" /end CHARACTERISTIC
/begin CHARACTERISTIC InjVlv_swtInputETMAP_C "Auswahl der Eingangsgrössen zur Darstellung von InjVlv_tiET_MAP auf dem Applikationstool." VALUE 0x80062D12 Val_Wu8 15.00 OneToOne 0.00 15.00 FORMAT "%5.2" EXTENDED_LIMITS 0.00 255.0 /end CHARACTERISTIC
/begin CHARACTERISTIC InjVlv_swtTiMI1ET_C "Schalter des Fernsteuerwerts der Ansteuerdauer MI" VALUE 0x80062C12 Val_Wu8 1.000 OneToOne 0.00 1.000 FORMAT "%5.3" EXTENDED_LIMITS 0.00 255.0 /end CHARACTERISTIC
/begin CHARACTERISTIC InjVlv_swtTiPiI1ET_C "Schalter des Fernsteuerwerts der Ansteuerdauer PiI1" VALUE 0x80062C18 Val_Wu8 1.000 OneToOne 0.00 1.000 FORMAT "%5.3" EXTENDED_LIMITS 0.00 255.0 /end CHARACTERISTIC
/begin CHARACTERISTIC InjVlv_swtTiPiI2ET_C "Schalter des Fernsteuerwerts der Ansteuerdauer PiI2" VALUE 0x80062C1C Val_Wu8 1.000 OneToOne 0.00 1.000 FORMAT "%5.3" EXTENDED_LIMITS 0.00 255.0 /end CHARACTERISTIC
/begin CHARACTERISTIC InjVlv_swtTiPiI3ET_C "Schalter des Fernsteuerwerts der Ansteuerdauer PiI3" VALUE 0x80062C20 Val_Wu8 1.000 OneToOne 0.00 1.000 FORMAT "%5.3" EXTENDED_LIMITS 0.00 255.0 /end CHARACTERISTIC
/begin CHARACTERISTIC InjVlv_swtTiPoI1ET_C "Schalter des Fernsteuerwerts der Ansteuerdauer PoI1" VALUE 0x80062C24 Val_Wu8 1.000 OneToOne 0.00 1.000 FORMAT "%5.3" EXTENDED_LIMITS 0.00 255.0 /end CHARACTERISTIC
/begin CHARACTERISTIC InjVlv_swtTiPoI2ET_C "Schalter des Fernsteuerwerts der Ansteuerdauer PoI2" VALUE 0x80062C28 Val_Wu8 1.000 OneToOne 0.00 1.000 FORMAT "%5.3" EXTENDED_LIMITS 0.00 255.0 /end CHARACTERISTIC
/begin CHARACTERISTIC InjVlv_swtZFCCorOvrRunOn_C "minimale ZFC Ansteuerdauerkorrektur" VALUE 0x80063538 Val_Wu8 0.00 OneToOne 0.00 0.00 FORMAT "%5.2" EXTENDED_LIMITS 0.00 255.0 /end CHARACTERISTIC
/begin CHARACTERISTIC InjVlv_tiBusyMax_C "" VALUE 0x800632CC Kw_Ws16 5000.0000 InjTime_us 0.00 5000.0000 FORMAT "%8.4" EXTENDED_LIMITS -13107.20 13106.80 /end CHARACTERISTIC
/begin CHARACTERISTIC InjVlv_tiETMax_C "maximale Ansteuerdauer MI" VALUE 0x80062C14 Val_Ws16 18107.20 InjTime_us -13107.20 5000.00 FORMAT "%8.2" EXTENDED_LIMITS -13107.20 13106.80 /end CHARACTERISTIC
/begin CHARACTERISTIC InjVlv_tiETMinLow_C "Minimale Ansteuerdauer" VALUE 0x800632D6 Val_Ws16 18107.20 InjTime_us -13107.20 5000.00 FORMAT "%8.2" EXTENDED_LIMITS -13107.20 13106.80 /end CHARACTERISTIC
/begin CHARACTERISTIC InjVlv_tiET_MAP "Kennfeld zur Umrechnung von Einspritzmengen in Ansteuerdauer. Gilt für alle Einspritzungen." MAP 0x80062D14 Map_Xs16Ys16Ws16 5000.000 InjTime_us 0.00 5000.000 FORMAT "%8.3" EXTENDED_LIMITS -13107.20 13106.80
 /begin AXIS_DESCR STD_AXIS InjVlv_pInET_mp Pres_Rail 16 0.00 2000.000 FORMAT "%5.3" EXTENDED_LIMITS -3276.800 3276.700 DEPOSIT ABSOLUTE /end AXIS_DESCR
 /begin AXIS_DESCR STD_AXIS InjVlv_volInET_mp InjQntInj 40 0.00 327.6700 FORMAT "%8.4" EXTENDED_LIMITS -327.6800 327.6700 DEPOSIT ABSOLUTE /end AXIS_DESCR
/end CHARACTERISTIC
/begin CHARACTERISTIC InjVlv_tiMI1ET_C "Fernsteuerwert der Ansteuerdauer MI" VALUE 0x80062C16 Val_Ws16 18107.20 InjTime_us -13107.20 5000.00 FORMAT "%8.2" EXTENDED_LIMITS -13107.20 13106.80 /end CHARACTERISTIC
/begin CHARACTERISTIC InjVlv_tiPause_C "physikalische bedingte Mindestzeit zwischen 2 Einspritzungen" VALUE 0x800632D8 Val_Ws16 18107.20 InjTime_us -13107.20 5000.00 FORMAT "%8.2" EXTENDED_LIMITS -13107.20 13106.80 /end CHARACTERISTIC
/begin CHARACTERISTIC InjVlv_tiPiI1ET_C "Fernsteuerwert der Ansteuerdauer PiI1" VALUE 0x80062C1A Val_Ws16 18107.20 InjTime_us -13107.20 5000.00 FORMAT "%8.2" EXTENDED_LIMITS -13107.20 13106.80 /end CHARACTERISTIC
/begin CHARACTERISTIC InjVlv_tiPiI2ET_C "Fernsteuerwert der Ansteuerdauer PiI2" VALUE 0x80062C1E Val_Ws16 18107.20 InjTime_us -13107.20 5000.00 FORMAT "%8.2" EXTENDED_LIMITS -13107.20 13106.80 /end CHARACTERISTIC
/begin CHARACTERISTIC InjVlv_tiPiI3ET_C "Fernsteuerwert der Ansteuerdauer PiI3" VALUE 0x80062C22 Val_Ws16 18107.20 InjTime_us -13107.20 5000.00 FORMAT "%8.2" EXTENDED_LIMITS -13107.20 13106.80 /end CHARACTERISTIC
/begin CHARACTERISTIC InjVlv_tiPoI1ET_C "Fernsteuerwert der Ansteuerdauer PoI1" VALUE 0x80062C26 Val_Ws16 18107.20 InjTime_us -13107.20 5000.00 FORMAT "%8.2" EXTENDED_LIMITS -13107.20 13106.80 /end CHARACTERISTIC
/begin CHARACTERISTIC InjVlv_tiPoI2ET_C "Fernsteuerwert der Ansteuerdauer PoI2" VALUE 0x80062C2A Val_Ws16 18107.20 InjTime_us -13107.20 5000.00 FORMAT "%8.2" EXTENDED_LIMITS -13107.20 13106.80 /end CHARACTERISTIC
/begin CHARACTERISTIC InjVlv_tiWup2On_C "Zeit zwischen dynamischem Interrupt und Bestromungsbeginn" VALUE 0x80063288 Val_Ws16 4900.000 InjTime_us 100.0000 5000.000 FORMAT "%8.3" EXTENDED_LIMITS -13107.20 13106.80 /end CHARACTERISTIC
/begin CHARACTERISTIC InjVlv_tiZFCETCorMax_C "maximale ZFC Ansteuerdauerkorrektur" VALUE 0x8006353A Val_Ws16 5300.0000 InjTime_us -300.0000 5000.0000 FORMAT "%8.4" EXTENDED_LIMITS -13107.20 13106.80 /end CHARACTERISTIC
/begin CHARACTERISTIC InjVlv_tiZFCETCorMin_C "minimale ZFC Ansteuerdauerkorrektur" VALUE 0x8006353C Val_Ws16 5300.0000 InjTime_us -300.0000 5000.0000 FORMAT "%8.4" EXTENDED_LIMITS -13107.20 13106.80 /end CHARACTERISTIC
/begin CHARACTERISTIC ISC_stPrio_CA "Priorisierung der ISC Anforderer" VAL_BLK 0x8004EC4C ValA_Ws16 2.00000000000 ISCstPrioSel 1.00000000000 3.00000000000 FORMAT "%13.11" NUMBER 2 /end CHARACTERISTIC
/begin CHARACTERISTIC ISC_tiPT1TrqFlt_CUR "Kennlinie der Zeitkonstanten für die PT1-Flterung des ISC Ausgangsdrehmoments" CURVE 0x8004EC50 Cur_Xs16Ws16 5.000000 TimeDelay_s_Lin_16 0.00 5.000000 FORMAT "%8.6" EXTENDED_LIMITS -5.000153 5.000000
 /begin AXIS_DESCR STD_AXIS ISC_nDiffLoFlt_mp EngN 25 -16384.00 16383.50 FORMAT "%8.2" DEPOSIT ABSOLUTE /end AXIS_DESCR
/end CHARACTERISTIC
/begin CHARACTERISTIC IVActr_chgChrgRC_C "" VALUE 0x8004ED1C Val_Ws16 65535.00 Charge_PA -32768.00 32767.00 FORMAT "%8.2" /end CHARACTERISTIC
/begin CHARACTERISTIC IVActr_iCondDisCh_CUR "Kennlinie: Entladestromgrenze für Aktorkonditionierung" CURVE 0x8004ECB6 Cur_Xs16Ws16 65535.00 Curr -32768.00 32767.00 FORMAT "%8.2"
 /begin AXIS_DESCR STD_AXIS IVActr_uCondChrg_mp Vltg_PA 5 -327.6800 327.6700 FORMAT "%8.4" DEPOSIT ABSOLUTE /end AXIS_DESCR
/end CHARACTERISTIC
/begin CHARACTERISTIC IVActr_numCond_C "Anzahl der Aktivierungen pro Aktor für die Aktorkonditionierung" VALUE 0x8004ECCC Val_Wu8 255.0 OneToOne 0.00 255.0 FORMAT "%5.1" /end CHARACTERISTIC
/begin CHARACTERISTIC IVActr_numIntrGetMeas_C "Max. Anzahl Interrups des gemessenen Einspritztyps zwischen Start und Auswertung der Aktormessung" VALUE 0x8004ED1E Val_Wu8 255.0 OneToOne 0.00 255.0 FORMAT "%5.1" /end CHARACTERISTIC
/begin CHARACTERISTIC IVActr_pCondMax_C "Raildruckschwelle zur Verriegelung der Aktorkonditionierung" VALUE 0x8004ECCE Val_Ws16 5276.800 Pres_Rail -3276.800 2000.000 FORMAT "%5.3" EXTENDED_LIMITS -3276.800 3276.700 /end CHARACTERISTIC
/begin CHARACTERISTIC IVActr_pRailLnkRC_C "Remote-Wert für gepaarten Raildruck der gemessenen Einspritzung" VALUE 0x8004ED20 Val_Ws16 5276.800 Pres_Rail -3276.800 2000.000 FORMAT "%5.3" EXTENDED_LIMITS -3276.800 3276.700 /end CHARACTERISTIC
/begin CHARACTERISTIC IVActr_SelTemp.xVal_C "Struktur des SW-Schalters der Temperaturauswahl/" VALUE 0x8004ED50 Kw_Wu8 1.000 OneToOne 0.00 1.000 FORMAT "%5.3" EXTENDED_LIMITS 0.00 255.0 /end CHARACTERISTIC
/begin CHARACTERISTIC IVActr_SelTemp.xTyp_C "Struktur des SW-Schalters der Temperaturauswahl/" VALUE 0x8004ED51 Kw_Wu8 2.000 OneToOne 0.00 2.000 FORMAT "%5.3" EXTENDED_LIMITS 0.00 255.0 /end CHARACTERISTIC
/begin CHARACTERISTIC IVActr_stChgChrgRC_C "" VALUE 0x8004ED22 Val_Wu8 255.0 OneToOne 0.00 255.0 FORMAT "%5.1" /end CHARACTERISTIC
/begin CHARACTERISTIC IVActr_stCondRC_C "Zustand: Remote-Wert für IVActr_stCond" VALUE 0x8004ECD0 Val_Wu8 255.0 OneToOne 0.00 255.0 FORMAT "%5.1" /end CHARACTERISTIC
/begin CHARACTERISTIC IVActr_stTiDisChRC_C "Remote-Wert für Status der Aktor-Entladezeit" VALUE 0x8004ED23 Val_Wu8 255.0 OneToOne 0.00 255.0 FORMAT "%5.1" /end CHARACTERISTIC
/begin CHARACTERISTIC IVActr_stTiETMeasRC_C "Remote-Wert für Status der gemessenen Ansteuerdauer" VALUE 0x8004ED24 Val_Wu8 255.0 OneToOne 0.00 255.0 FORMAT "%5.1" /end CHARACTERISTIC
/begin CHARACTERISTIC IVActr_stUChrgUpRC_C "Remote-Schalter für Status der Aktorspannung nach dem Laden" VALUE 0x8004ED25 Val_Wu8 255.0 OneToOne 0.00 255.0 FORMAT "%5.1" /end CHARACTERISTIC
/begin CHARACTERISTIC IVActr_stUDisChStopRC_C "Remote-Wert für Status der Aktorspannung nach dem Entladen" VALUE 0x8004ED26 Val_Wu8 255.0 OneToOne 0.00 255.0 FORMAT "%5.1" /end CHARACTERISTIC
/begin CHARACTERISTIC IVActr_stUUpRC_C "Remote-Wert für Status der Aktorspannung Up-Niveau" VALUE 0x8004ED27 Val_Wu8 255.0 OneToOne 0.00 255.0 FORMAT "%5.1" /end CHARACTERISTIC
/begin CHARACTERISTIC IVActr_swtChgChrgRC_C "" VALUE 0x8004ED28 Val_Wu8 255.0 OneToOne 0.00 255.0 FORMAT "%5.1" /end CHARACTERISTIC
/begin CHARACTERISTIC IVActr_swtCondRC_C "Schalter: Zustand der Aktorkonditionierung per Remote schalten" VALUE 0x8004ECD1 Val_Wu8 255.0 OneToOne 0.00 255.0 FORMAT "%5.1" /end CHARACTERISTIC
/begin CHARACTERISTIC IVActr_swtPRailLnkRC_C "Remote-Schalter für gepaarten Raildruck der gemessenen Einspritzung" VALUE 0x8004ED29 Val_Wu8 255.0 OneToOne 0.00 255.0 FORMAT "%5.1" /end CHARACTERISTIC
/begin CHARACTERISTIC IVActr_swtTiChrgLnkRC_C "Remote-Schalter für gepaarte Soll-Ladezeit" VALUE 0x8004ED2A Val_Wu8 255.0 OneToOne 0.00 255.0 FORMAT "%5.1" /end CHARACTERISTIC
/begin CHARACTERISTIC IVActr_swtTiDisChLnkRC_C "Remote-Schalter für die gepaarte Soll-Entladezeit" VALUE 0x8004ED2B Val_Wu8 255.0 OneToOne 0.00 255.0 FORMAT "%5.1" /end CHARACTERISTIC
/begin CHARACTERISTIC IVActr_swtTiDisChRC_C "Remote-Schalter für Aktor-Entladezeit" VALUE 0x8004ED2C Val_Wu8 255.0 OneToOne 0.00 255.0 FORMAT "%5.1" /end CHARACTERISTIC
/begin CHARACTERISTIC IVActr_swtTiETMeasRC_C "Remote-Schalter für gemessene Ansteuerdauer" VALUE 0x8004ED2D Val_Wu8 255.0 OneToOne 0.00 255.0 FORMAT "%5.1" /end CHARACTERISTIC
/begin CHARACTERISTIC IVActr_swtUChrgUpRC_C "Remote-Schalter für Aktorspannung nach dem Laden" VALUE 0x8004ED2E Val_Wu8 255.0 OneToOne 0.00 255.0 FORMAT "%5.1" /end CHARACTERISTIC
/begin CHARACTERISTIC IVActr_swtUDisChStopRC_C "Remote-Schalter für Aktorspannung nach dem Entladen" VALUE 0x8004ED2F Val_Wu8 255.0 OneToOne 0.00 255.0 FORMAT "%5.1" /end CHARACTERISTIC
/begin CHARACTERISTIC IVActr_swtUUpLnkRC_C "Remote-Schalter für gepaarten Aktor-Sollspannungswert Up-Niveau" VALUE 0x8004ED30 Val_Wu8 255.0 OneToOne 0.00 255.0 FORMAT "%5.1" /end CHARACTERISTIC
/begin CHARACTERISTIC IVActr_swtUUpRC_C "Remote-Schalter für Aktorspannung Up-Niveau" VALUE 0x8004ED31 Val_Wu8 255.0 OneToOne 0.00 255.0 FORMAT "%5.1" /end CHARACTERISTIC
/begin CHARACTERISTIC IVActr_tActrDfl_C "Defaultaktortemperatur" VALUE 0x8004ED52 Val_Ws16 6553.500 Temp_Cels -3549.940 3003.560 FORMAT "%8.3" /end CHARACTERISTIC
/begin CHARACTERISTIC IVActr_tActr_CUR "Kennlinie: Anpassung der Aktortemperatur zur vorgegebenen Temperatur" CURVE 0x8004ED54 Cur_Xs16Ws16 220.0000 Temp_Cels -40.04000 179.9600 FORMAT "%8.4" EXTENDED_LIMITS -3549.940 3003.560
 /begin AXIS_DESCR STD_AXIS IVActr_tActrUnCor_mp Temp_Cels 4 -50.14000 199.8600 FORMAT "%8.4" EXTENDED_LIMITS -3549.940 3003.560 DEPOSIT ABSOLUTE /end AXIS_DESCR
/end CHARACTERISTIC
/begin CHARACTERISTIC IVActr_tCondMax_C "Maximal zulässige Temperatur für die Aktorkonditionierung" VALUE 0x8004ECD2 Val_Ws16 6553.500 Temp_Cels -3549.940 3003.560 FORMAT "%8.3" /end CHARACTERISTIC
/begin CHARACTERISTIC IVActr_tiChrgLnkRC_C "Remote-Wert für gepaarte Soll-Ladezeit" VALUE 0x8004ED32 Val_Ws16 18107.20 InjTime_us -13107.20 5000.00 FORMAT "%8.2" EXTENDED_LIMITS -13107.20 13106.80 /end CHARACTERISTIC
/begin CHARACTERISTIC IVActr_tiCondChrg_CUR "Kennlinie: Berechnung der Ladeszeit aus der Temperatur" CURVE 0x8004ECD4 Cur_Xs16Ws16 18107.20 InjTime_us -13107.20 5000.00 FORMAT "%8.2" EXTENDED_LIMITS -13107.20 13106.80
 /begin AXIS_DESCR STD_AXIS IVActr_tActr Temp_Cels 4 -3549.940 3003.560 FORMAT "%8.3" DEPOSIT ABSOLUTE /end AXIS_DESCR
/end CHARACTERISTIC
/begin CHARACTERISTIC IVActr_tiCondET_CUR "Kennlinie: Berechnung der Ansteuerdauer aus der Termperatur für die Aktorkonditionierung" CURVE 0x8004ECE6 Cur_Xs16Ws16 18107.20 InjTime_us -13107.20 5000.00 FORMAT "%8.2" EXTENDED_LIMITS -13107.20 13106.80
 /begin AXIS_DESCR STD_AXIS IVActr_tActr Temp_Cels 4 -3549.940 3003.560 FORMAT "%8.3" DEPOSIT ABSOLUTE /end AXIS_DESCR
/end CHARACTERISTIC
/begin CHARACTERISTIC IVActr_tiCondPseDisCh_CUR "Kennlinie: Berechnung der Entladestrom-Pulspausezeit aus der Aktorsollspannung" CURVE 0x8004ECF8 Cur_Xs16Ws16 655.3500 Time_PzoChrgPse -327.6800 327.6700 FORMAT "%8.4"
 /begin AXIS_DESCR STD_AXIS IVActr_uCondChrg_mp Vltg_PA 4 -327.6800 327.6700 FORMAT "%8.4" DEPOSIT ABSOLUTE /end AXIS_DESCR
/end CHARACTERISTIC
/begin CHARACTERISTIC IVActr_tiDisChLnkRC_C "Remote-Wert für die gepaarte Soll-Entladezeit" VALUE 0x8004ED34 Val_Ws16 18107.20 InjTime_us -13107.20 5000.00 FORMAT "%8.2" EXTENDED_LIMITS -13107.20 13106.80 /end CHARACTERISTIC
/begin CHARACTERISTIC IVActr_tiDisChRC_C "Remote-Wert für Aktor-Entladezeit" VALUE 0x8004ED36 Val_Ws16 18107.20 InjTime_us -13107.20 5000.00 FORMAT "%8.2" EXTENDED_LIMITS -13107.20 13106.80 /end CHARACTERISTIC
/begin CHARACTERISTIC IVActr_tiETMeasRC_C "Remote-Wert für gemessene Ansteuerdauer" VALUE 0x8004ED38 Val_Ws16 18107.20 InjTime_us -13107.20 5000.00 FORMAT "%8.2" EXTENDED_LIMITS -13107.20 13106.80 /end CHARACTERISTIC
/begin CHARACTERISTIC IVActr_uActrLin_CUR "Linearisierungs-Kennlinie für Aktorspannung" CURVE 0x8004ED3A Cur_Xs16Ws16 655.3500 Vltg_PA -327.6800 327.6700 FORMAT "%8.4"
 /begin AXIS_DESCR STD_AXIS IVActr_uActrRaw_mp Volt 2 0.00 5200.000 FORMAT "%8.3" EXTENDED_LIMITS -6553.600 6553.400 DEPOSIT ABSOLUTE /end AXIS_DESCR
/end CHARACTERISTIC
/begin CHARACTERISTIC IVActr_uChrgUpRC_C "Remote-Wert für Aktorspannung nach dem Laden" VALUE 0x8004ED44 Val_Ws16 655.3500 Vltg_PA -327.6800 327.6700 FORMAT "%8.4" /end CHARACTERISTIC
/begin CHARACTERISTIC IVActr_uCondChrg_CUR "Sollspannung der Aktorkonditionierung" CURVE 0x8004ED0A Cur_Xs16Ws16 655.3500 Vltg_PA -327.6800 327.6700 FORMAT "%8.4"
 /begin AXIS_DESCR STD_AXIS IVActr_tActr Temp_Cels 4 -3549.940 3003.560 FORMAT "%8.3" DEPOSIT ABSOLUTE /end AXIS_DESCR
/end CHARACTERISTIC
/begin CHARACTERISTIC IVActr_uDisChStopRC_C "Remote-Wert für Aktorspannung nach dem Entladen" VALUE 0x8004ED46 Val_Ws16 655.3500 Vltg_PA -327.6800 327.6700 FORMAT "%8.4" /end CHARACTERISTIC
/begin CHARACTERISTIC IVActr_uUpLnkRC_C "Remote-Wert für gepaarten Aktor-Sollspannungswert Up-Niveau" VALUE 0x8004ED48 Val_Ws16 655.3500 Vltg_PA -327.6800 327.6700 FORMAT "%8.4" /end CHARACTERISTIC
/begin CHARACTERISTIC IVActr_uUpRC_C "Remote-Wert für Aktorspannung Up-Niveau" VALUE 0x8004ED4A Val_Ws16 655.3500 Vltg_PA -327.6800 327.6700 FORMAT "%8.4" /end CHARACTERISTIC
/begin CHARACTERISTIC IVActr_Vltg_SRC.uMin_C "Klasseninstanz für Aktorspannungs Signal Range Check/" VALUE 0x8004ED4C Val_Ws16 5200.000 Volt 0.00 5200.000 FORMAT "%8.3" EXTENDED_LIMITS -6553.600 6553.400 /end CHARACTERISTIC
/begin CHARACTERISTIC IVActr_Vltg_SRC.uMax_C "Klasseninstanz für Aktorspannungs Signal Range Check/" VALUE 0x8004ED4E Val_Ws16 5200.000 Volt 0.00 5200.000 FORMAT "%8.3" EXTENDED_LIMITS -6553.600 6553.400 /end CHARACTERISTIC
/begin CHARACTERISTIC IVAdj_facNVCDfl_CA "" VAL_BLK 0x8004EE66 ValA_Ws16 1.000000 Fact 0.5000000 1.500000 FORMAT "%8.6" EXTENDED_LIMITS -4.000000 3.999878 NUMBER 6 /end CHARACTERISTIC
/begin CHARACTERISTIC IVAdj_numClsIVAMax_C "höchste erlaubte ISA-Klasse" VALUE 0x8004EE64 Val_Wu8 0.00 OneToOne 10.00 10.00 FORMAT "%5.2" EXTENDED_LIMITS 0.00 255.0 /end CHARACTERISTIC
/begin CHARACTERISTIC IVAdj_numClsIVAMin_C "kleinste erlaubte ISA-Klasse" VALUE 0x8004EE65 Val_Wu8 0.00 OneToOne 2.000 2.000 FORMAT "%5.3" EXTENDED_LIMITS 0.00 255.0 /end CHARACTERISTIC
/begin CHARACTERISTIC IVAdj_stQntAdj_MAP "Statuskennfeld (Index und Gewichtungsfaktor) für den Injektor-Mengenabgleich" MAP 0x8004ED68 Map_Xs16Ys16Ws16 32767.00 OneToOne 0.00 32767.00 FORMAT "%8.2" EXTENDED_LIMITS -32768.00 32767.00
 /begin AXIS_DESCR STD_AXIS RailP_pFlt Pres_Rail 5 0.00 2000.000 FORMAT "%5.3" EXTENDED_LIMITS -3276.800 3276.700 DEPOSIT ABSOLUTE /end AXIS_DESCR
 /begin AXIS_DESCR STD_AXIS InjVlv_volMI1Cor_mp InjQntInj 6 0.00 100.0000 FORMAT "%8.4" EXTENDED_LIMITS -327.6800 327.6700 DEPOSIT ABSOLUTE /end AXIS_DESCR
/end CHARACTERISTIC
/begin CHARACTERISTIC IVAdj_stRawValRepl_C "Ersatzwerte für Injektorabgleich" VAL_BLK 0x8004EDC0 ValA_Wu32 4294967295.00 OneToOne 0.00 4294967295.00 FORMAT "%13.2" NUMBER 12 /end CHARACTERISTIC
/begin CHARACTERISTIC IVAdj_swtRawValRepl_C "Schalter zum Ersetzen der Injektorabgleichwerte (0...EEPROM, 1...Ersatzwerte)" VALUE 0x8004EDF0 Val_Wu8 1.000 OneToOne 0.00 1.000 FORMAT "%5.3" EXTENDED_LIMITS 0.00 255.0 /end CHARACTERISTIC
/begin CHARACTERISTIC IVAdj_volQntAdjLim_C "symmetrische Begrenzung des Mengen-Abgleichwertes" VALUE 0x8004EDF2 Val_Ws16 128.0000 InjQntInj 0.00 128.0000 FORMAT "%8.4" EXTENDED_LIMITS -327.6800 327.6700 /end CHARACTERISTIC
/begin CHARACTERISTIC IVAdj_volQntAdjMax0_C "obere Grenzwerte der Mengen-Abgleichwerte für die 0-Quantisierungsschrittweite (0d=00b)" VAL_BLK 0x8004EDF4 ValA_Ws16 6.300000 InjQntInj 0.00 6.300000 FORMAT "%8.6" EXTENDED_LIMITS -327.6800 327.6700 NUMBER 7 /end CHARACTERISTIC
/begin CHARACTERISTIC IVAdj_volQntAdjMax1_C "obere Grenzwerte der Mengen-Abgleichwerte für die 1-Quantisierungsschrittweite (1d=01b)" VAL_BLK 0x8004EE02 ValA_Ws16 9.450000 InjQntInj 0.00 9.450000 FORMAT "%8.6" EXTENDED_LIMITS -327.6800 327.6700 NUMBER 7 /end CHARACTERISTIC
/begin CHARACTERISTIC IVAdj_volQntAdjMax2_C "obere Grenzwerte der Mengen-Abgleichwerte für die 2-Quantisierungsschrittweite (2d=10b)" VAL_BLK 0x8004EE10 ValA_Ws16 15.75000 InjQntInj 0.00 15.75000 FORMAT "%8.5" EXTENDED_LIMITS -327.6800 327.6700 NUMBER 7 /end CHARACTERISTIC
/begin CHARACTERISTIC IVAdj_volQntAdjMax3_C "obere Grenzwerte der Mengen-Abgleichwerte für die 3-Quantisierungsschrittweite (3d=11b)" VAL_BLK 0x8004EE1E ValA_Ws16 31.50000 InjQntInj 0.00 31.50000 FORMAT "%8.5" EXTENDED_LIMITS -327.6800 327.6700 NUMBER 7 /end CHARACTERISTIC
/begin CHARACTERISTIC IVAdj_volQntAdjMin0_C "untere Grenzwerte der Mengen-Abgleichwerte für die 0-Quantisierungsschrittweite (0d=00b)" VAL_BLK 0x8004EE2C ValA_Ws16 6.400000 InjQntInj -6.400000 0.00 FORMAT "%8.6" EXTENDED_LIMITS -327.6800 327.6700 NUMBER 7 /end CHARACTERISTIC
/begin CHARACTERISTIC IVAdj_volQntAdjMin1_C "untere Grenzwerte der Mengen-Abgleichwerte für die 1-Quantisierungsschrittweite (1d=01b)" VAL_BLK 0x8004EE3A ValA_Ws16 9.600000 InjQntInj -9.600000 0.00 FORMAT "%8.6" EXTENDED_LIMITS -327.6800 327.6700 NUMBER 7 /end CHARACTERISTIC
/begin CHARACTERISTIC IVAdj_volQntAdjMin2_C "untere Grenzwerte der Mengen-Abgleichwerte für die 2-Quantisierungsschrittweite (2d=10b)" VAL_BLK 0x8004EE48 ValA_Ws16 16.00000 InjQntInj -16.00000 0.00 FORMAT "%8.5" EXTENDED_LIMITS -327.6800 327.6700 NUMBER 7 /end CHARACTERISTIC
/begin CHARACTERISTIC IVAdj_volQntAdjMin3_C "untere Grenzwerte der Mengen-Abgleichwerte für die 3-Quantisierungsschrittweite (3d=11b)" VAL_BLK 0x8004EE56 ValA_Ws16 32.00000 InjQntInj -32.00000 0.00 FORMAT "%8.5" EXTENDED_LIMITS -327.6800 327.6700 NUMBER 7 /end CHARACTERISTIC
/begin CHARACTERISTIC IVCtl_facVltgTempCor_CUR "Kennlinie: Bestimmung der Spannungskompensation aus der Aktortemperatur" CURVE 0x8004EF44 Cur_Xs16Ws16 0.2099609 Fact 1.000000 1.209961 FORMAT "%8.6" EXTENDED_LIMITS -4.000000 3.999878
 /begin AXIS_DESCR STD_AXIS IVActr_tActr Temp_Cels 10 -40.04000 179.9600 FORMAT "%8.4" EXTENDED_LIMITS -3549.940 3003.560 DEPOSIT ABSOLUTE /end AXIS_DESCR
/end CHARACTERISTIC
/begin CHARACTERISTIC IVCtl_iChrgRC_CA "Remotewert für IVCtl_iChrg" VAL_BLK 0x8004EF6E ValA_Ws16 20000.00 Curr 0.00 20000.00 FORMAT "%8.2" EXTENDED_LIMITS -32768.00 32767.00 NUMBER 6 /end CHARACTERISTIC
/begin CHARACTERISTIC IVCtl_iChrg_MAP "Kennfeld: Bestimmung der Ladestromgrenze aus der Soll-Ladezeit und -Spannung" MAP 0x8004EF7A Map_Xs16Ys16Ws16 65535.00 Curr -32768.00 32767.00 FORMAT "%8.2"
 /begin AXIS_DESCR STD_AXIS IVCtl_uChrgMapIn_mp Vltg_PA 25 0.00 250.0000 FORMAT "%8.4" EXTENDED_LIMITS -327.6800 327.6700 DEPOSIT ABSOLUTE /end AXIS_DESCR
 /begin AXIS_DESCR STD_AXIS IVCtl_tiChrg InjTime_us 6 0.00 5000.00 FORMAT "%8.2" EXTENDED_LIMITS -13107.20 13106.80 DEPOSIT ABSOLUTE /end AXIS_DESCR
/end CHARACTERISTIC
/begin CHARACTERISTIC IVCtl_iCorPIRC_CA "Remotewerte für IVCtl_iCorPI" VAL_BLK 0x8004EE74 ValA_Ws16 255.0000 Curr 0.00 255.0000 FORMAT "%8.4" EXTENDED_LIMITS -32768.00 32767.00 NUMBER 6 /end CHARACTERISTIC
/begin CHARACTERISTIC IVCtl_iDisChRC_CA "Remotewert für IVCtl_iDisCh" VAL_BLK 0x8004EEB4 ValA_Ws16 60000.00 Curr -30000.00 30000.00 FORMAT "%8.2" EXTENDED_LIMITS -32768.00 32767.00 NUMBER 6 /end CHARACTERISTIC
/begin CHARACTERISTIC IVCtl_iDisCh_MAP "Kennfeld: Berechnung der unkorrigierten Entladestromgrenze aus der Soll-Entladezeit und der Sollspannung vor dem Entladen" MAP 0x8004EEC0 Map_Xs16Ys16Ws16 60000.00 Curr -30000.00 30000.00 FORMAT "%8.2" EXTENDED_LIMITS -32768.00 32767.00
 /begin AXIS_DESCR STD_AXIS IVCtl_uUpMapIn_mp Vltg_PA 14 -327.6800 327.6700 FORMAT "%8.4" DEPOSIT ABSOLUTE /end AXIS_DESCR
 /begin AXIS_DESCR STD_AXIS IVCtl_tiDisCh InjTime_us 1 -30000.00 5000.00 FORMAT "%8.2" EXTENDED_LIMITS -13107.20 13106.80 DEPOSIT ABSOLUTE /end AXIS_DESCR
/end CHARACTERISTIC
/begin CHARACTERISTIC IVCtl_iPIMax_C "Begrenzung: Maximalwert des PI-Reglerausgangs der Entladezeitregelung" VALUE 0x8004EE80 Val_Ws16 20000.00 Curr -10000.00 10000.00 FORMAT "%8.2" EXTENDED_LIMITS -32768.00 32767.00 /end CHARACTERISTIC
/begin CHARACTERISTIC IVCtl_iPIMin_C "Begrenzung: Minimalwert des PI-Reglerausgangs der Entladezeitregelung" VALUE 0x8004EE82 Val_Ws16 20000.00 Curr -10000.00 10000.00 FORMAT "%8.2" EXTENDED_LIMITS -32768.00 32767.00 /end CHARACTERISTIC
/begin CHARACTERISTIC IVCtl_ITGov_CSTR.Ki_C "I-Parameter des Entladezeitreglers/" VALUE 0x8004EE84 Val_Ws32 4999999.99884 Ki_InjTime_us2Curr -2500000.00000 2499999.99884 FORMAT "%13.5" /end CHARACTERISTIC
/begin CHARACTERISTIC IVCtl_ITGov_CSTR.KiPos_C "I-Parameter des Entladezeitreglers/" VALUE 0x8004EE88 Val_Ws32 4999999.99884 Ki_InjTime_us2Curr -2500000.00000 2499999.99884 FORMAT "%13.5" /end CHARACTERISTIC
/begin CHARACTERISTIC IVCtl_ITGov_CSTR.KiNeg_C "I-Parameter des Entladezeitreglers/" VALUE 0x8004EE8C Val_Ws32 4999999.99884 Ki_InjTime_us2Curr -2500000.00000 2499999.99884 FORMAT "%13.5" /end CHARACTERISTIC
/begin CHARACTERISTIC IVCtl_ITGov_CSTR.WinPos_C "I-Parameter des Entladezeitreglers/" VALUE 0x8004EE90 Val_Ws32 858998459.200 InjTime_us -858993459.200 5000.000 FORMAT "%13.3" EXTENDED_LIMITS -858993459.200 858993458.800 /end CHARACTERISTIC
/begin CHARACTERISTIC IVCtl_ITGov_CSTR.WinNeg_C "I-Parameter des Entladezeitreglers/" VALUE 0x8004EE94 Val_Ws32 858998459.200 InjTime_us -858993459.200 5000.000 FORMAT "%13.3" EXTENDED_LIMITS -858993459.200 858993458.800 /end CHARACTERISTIC
/begin CHARACTERISTIC IVCtl_IVltgGov_CSTR.Ki_C "I-values if actuator voltage governor/" VALUE 0x8004F150 Kw_Ws32 1999999.99953 Ki_Vltg_PA2Vltg_PA -1000000.00000 999999.999534 FORMAT "%13.5" /end CHARACTERISTIC
/begin CHARACTERISTIC IVCtl_IVltgGov_CSTR.KiPos_C "I-values if actuator voltage governor/" VALUE 0x8004F154 Kw_Ws32 1999999.99953 Ki_Vltg_PA2Vltg_PA -1000000.00000 999999.999534 FORMAT "%13.5" /end CHARACTERISTIC
/begin CHARACTERISTIC IVCtl_IVltgGov_CSTR.KiNeg_C "I-values if actuator voltage governor/" VALUE 0x8004F158 Kw_Ws32 1999999.99953 Ki_Vltg_PA2Vltg_PA -1000000.00000 999999.999534 FORMAT "%13.5" /end CHARACTERISTIC
/begin CHARACTERISTIC IVCtl_IVltgGov_CSTR.WinPos_C "I-values if actuator voltage governor/" VALUE 0x8004F15C Kw_Ws32 42949672.9500 Vltg_PA -21474836.4800 21474836.4700 FORMAT "%13.4" /end CHARACTERISTIC
/begin CHARACTERISTIC IVCtl_IVltgGov_CSTR.WinNeg_C "I-values if actuator voltage governor/" VALUE 0x8004F160 Kw_Ws32 42949672.9500 Vltg_PA -21474836.4800 21474836.4700 FORMAT "%13.4" /end CHARACTERISTIC
/begin CHARACTERISTIC IVCtl_mskTGov_C "Bitmaske: gesetzte Bits in IVActr_stUUp fürhen zur Verriegelung des PI-Reglers der Aktorspannungsregelung" VALUE 0x8004EE98 Val_Wu8 255.0 OneToOne 0.00 255.0 FORMAT "%5.1" /end CHARACTERISTIC
/begin CHARACTERISTIC IVCtl_mskVltgGov_C "Bitmaske: gesetzte Bits in IVActr_stUUp fürhen zur Verriegelung des PI-Reglers der Aktorspannungsregelung" VALUE 0x8004F164 Val_Wu8 255.0 OneToOne 0.00 255.0 FORMAT "%5.1" /end CHARACTERISTIC
/begin CHARACTERISTIC IVCtl_pRC_C "" VALUE 0x8004F0E8 Val_Ws16 2000.000 Pres_Rail 0.00 2000.000 FORMAT "%5.3" EXTENDED_LIMITS -3276.800 3276.700 /end CHARACTERISTIC
/begin CHARACTERISTIC IVCtl_PTGov_CSTR.Kp_C "P-Parameter des Entladezeitreglers/" VALUE 0x8004EE9C Val_Ws32 327679.999924 Kp_InjTime_us2Curr -163840.000000 163839.999924 FORMAT "%13.6" /end CHARACTERISTIC
/begin CHARACTERISTIC IVCtl_PTGov_CSTR.KpPos_C "P-Parameter des Entladezeitreglers/" VALUE 0x8004EEA0 Val_Ws32 327679.999924 Kp_InjTime_us2Curr -163840.000000 163839.999924 FORMAT "%13.6" /end CHARACTERISTIC
/begin CHARACTERISTIC IVCtl_PTGov_CSTR.KpNeg_C "P-Parameter des Entladezeitreglers/" VALUE 0x8004EEA4 Val_Ws32 327679.999924 Kp_InjTime_us2Curr -163840.000000 163839.999924 FORMAT "%13.6" /end CHARACTERISTIC
/begin CHARACTERISTIC IVCtl_PTGov_CSTR.WinPos_C "P-Parameter des Entladezeitreglers/" VALUE 0x8004EEA8 Val_Ws32 858998459.200 InjTime_us -858993459.200 5000.000 FORMAT "%13.3" EXTENDED_LIMITS -858993459.200 858993458.800 /end CHARACTERISTIC
/begin CHARACTERISTIC IVCtl_PTGov_CSTR.WinNeg_C "P-Parameter des Entladezeitreglers/" VALUE 0x8004EEAC Val_Ws32 858998459.200 InjTime_us -858993459.200 5000.000 FORMAT "%13.3" EXTENDED_LIMITS -858993459.200 858993458.800 /end CHARACTERISTIC
/begin CHARACTERISTIC IVCtl_PVltgGov_CSTR.Kp_C "P-Values of actuator voltage governor/" VALUE 0x8004F168 Kw_Ws32 131071.999969 Kp_Vltg_PA2Vltg_PA -65536.0000000 65535.9999695 FORMAT "%13.7" /end CHARACTERISTIC
/begin CHARACTERISTIC IVCtl_PVltgGov_CSTR.KpPos_C "P-Values of actuator voltage governor/" VALUE 0x8004F16C Kw_Ws32 131071.999969 Kp_Vltg_PA2Vltg_PA -65536.0000000 65535.9999695 FORMAT "%13.7" /end CHARACTERISTIC
/begin CHARACTERISTIC IVCtl_PVltgGov_CSTR.KpNeg_C "P-Values of actuator voltage governor/" VALUE 0x8004F170 Kw_Ws32 131071.999969 Kp_Vltg_PA2Vltg_PA -65536.0000000 65535.9999695 FORMAT "%13.7" /end CHARACTERISTIC
/begin CHARACTERISTIC IVCtl_PVltgGov_CSTR.WinPos_C "P-Values of actuator voltage governor/" VALUE 0x8004F174 Kw_Ws32 42949672.9500 Vltg_PA -21474836.4800 21474836.4700 FORMAT "%13.4" /end CHARACTERISTIC
/begin CHARACTERISTIC IVCtl_PVltgGov_CSTR.WinNeg_C "P-Values of actuator voltage governor/" VALUE 0x8004F178 Kw_Ws32 42949672.9500 Vltg_PA -21474836.4800 21474836.4700 FORMAT "%13.4" /end CHARACTERISTIC
/begin CHARACTERISTIC IVCtl_stStrtRC_C "Remotewert für IVCtl_stStrt" VALUE 0x8004F270 Val_Wu8 1.000 OneToOne 0.00 1.000 FORMAT "%5.3" EXTENDED_LIMITS 0.00 255.0 /end CHARACTERISTIC
/begin CHARACTERISTIC IVCtl_swtIChrgRC_C "Schalter: IVCtl_iChrg wird auf Remoterwerte IVCtl_iChrgRC_CA gesetzt" VALUE 0x8004F0EA Val_Wu8 255.0 OneToOne 0.00 255.0 FORMAT "%5.1" /end CHARACTERISTIC
/begin CHARACTERISTIC IVCtl_swtICorPIRC_C "Schalter: IVCtl_iCorPI wird auf Remotewerte IVCtl_iCorPIRC_CA gesetzt" VALUE 0x8004EEB0 Val_Wu8 255.0 OneToOne 0.00 255.0 FORMAT "%5.1" /end CHARACTERISTIC
/begin CHARACTERISTIC IVCtl_swtIDisChRC_C "Schalter: IVCtl_iDisCh wird auf Remoterwerte IVCtl_iDisChRC_CA gesetzt." VALUE 0x8004EEFE Val_Wu8 255.0 OneToOne 0.00 255.0 FORMAT "%5.1" /end CHARACTERISTIC
/begin CHARACTERISTIC IVCtl_swtPRC_C "" VALUE 0x8004F0EB Val_Wu8 1.000 OneToOne 0.00 1.000 FORMAT "%5.3" EXTENDED_LIMITS 0.00 255.0 /end CHARACTERISTIC
/begin CHARACTERISTIC IVCtl_swtStrtRC_C "Schalter: IVCtl_stStrt wird durch Remotewert IVCtl_stStrtRC_C gesetzt" VALUE 0x8004F271 Val_Wu8 1.000 OneToOne 0.00 1.000 FORMAT "%5.3" EXTENDED_LIMITS 0.00 255.0 /end CHARACTERISTIC
/begin CHARACTERISTIC IVCtl_swtTiChrgRC_C "" VALUE 0x8004EEFF Val_Wu8 1.000 OneToOne 0.00 1.000 FORMAT "%5.3" EXTENDED_LIMITS 0.00 255.0 /end CHARACTERISTIC
/begin CHARACTERISTIC IVCtl_swtTiDisChRC_C "" VALUE 0x8004EF00 Val_Wu8 1.000 OneToOne 0.00 1.000 FORMAT "%5.3" EXTENDED_LIMITS 0.00 255.0 /end CHARACTERISTIC
/begin CHARACTERISTIC IVCtl_swtTiPseChrgRC_C "" VALUE 0x8004EF01 Val_Wu8 1.000 OneToOne 0.00 1.000 FORMAT "%5.3" EXTENDED_LIMITS 0.00 255.0 /end CHARACTERISTIC
/begin CHARACTERISTIC IVCtl_swtTiPseDisChRC_C "" VALUE 0x8004EF02 Val_Wu8 1.000 OneToOne 0.00 1.000 FORMAT "%5.3" EXTENDED_LIMITS 0.00 255.0 /end CHARACTERISTIC
/begin CHARACTERISTIC IVCtl_swtUCorPIRC_C "Schalter: IVCtl_uCorPI wird duch Remotewerte IVCtl_uCurPIRC_CA gesetzt" VALUE 0x8004F17C Val_Wu8 255.0 OneToOne 0.00 255.0 FORMAT "%5.1" /end CHARACTERISTIC
/begin CHARACTERISTIC IVCtl_swtUUpRC_C "Remoteschalter für die gemessene Akuatorspannung" VALUE 0x8004F0EC Val_Wu8 255.0 OneToOne 0.00 255.0 FORMAT "%5.1" /end CHARACTERISTIC
/begin CHARACTERISTIC IVCtl_tiChrgRC_C "Remote Control Wert der Ladezeit" VALUE 0x8004EF04 Val_Ws16 5000.0000 InjTime_us 0.00 5000.0000 FORMAT "%8.4" EXTENDED_LIMITS -13107.20 13106.80 /end CHARACTERISTIC
/begin CHARACTERISTIC IVCtl_tiChrg_CUR "Kennlinie: Bestimmung der Solladezeit aus dem Raildruck" CURVE 0x8004EF06 Cur_Xs16Ws16 5000.0000 InjTime_us 0.00 5000.0000 FORMAT "%8.4" EXTENDED_LIMITS -13107.20 13106.80
 /begin AXIS_DESCR STD_AXIS RailP_pFlt Pres_Rail 4 -3276.800 2000.000 FORMAT "%5.3" EXTENDED_LIMITS -3276.800 3276.700 DEPOSIT ABSOLUTE /end AXIS_DESCR
/end CHARACTERISTIC
/begin CHARACTERISTIC IVCtl_tiDisChRC_C "" VALUE 0x8004EF18 Val_Ws16 5000.0000 InjTime_us 0.00 5000.0000 FORMAT "%8.4" EXTENDED_LIMITS -13107.20 13106.80 /end CHARACTERISTIC
/begin CHARACTERISTIC IVCtl_tiDisCh_CUR "Kennlinie: Berechnung der Entladezeit aus dem Raildruck" CURVE 0x8004EF1A Cur_Xs16Ws16 35000.00 InjTime_us -30000.00 5000.00 FORMAT "%8.2" EXTENDED_LIMITS -13107.20 13106.80
 /begin AXIS_DESCR STD_AXIS RailP_pFlt Pres_Rail 4 -3276.800 2000.000 FORMAT "%5.3" EXTENDED_LIMITS -3276.800 3276.700 DEPOSIT ABSOLUTE /end AXIS_DESCR
/end CHARACTERISTIC
/begin CHARACTERISTIC IVCtl_tiPseChrgRC_C "" VALUE 0x8004EF2C Val_Ws16 400.0000 Time_PzoChrgPse 0.00 400.0000 FORMAT "%8.4" EXTENDED_LIMITS -327.6800 327.6700 /end CHARACTERISTIC
/begin CHARACTERISTIC IVCtl_tiPseChrg_CUR "Kennlinie: Bestimmung der Ladepuls-Pausezeit aus der Sollladezeit" CURVE 0x8004EF2E Cur_Xs16Ws16 18.00000 Time_PzoChrgPse 2.000000 20.00000 FORMAT "%8.5" EXTENDED_LIMITS -327.6800 327.6700
 /begin AXIS_DESCR STD_AXIS IVCtl_tiChrg InjTime_us 2 -13107.20 5000.00 FORMAT "%8.2" EXTENDED_LIMITS -13107.20 13106.80 DEPOSIT ABSOLUTE /end AXIS_DESCR
/end CHARACTERISTIC
/begin CHARACTERISTIC IVCtl_tiPseDisChRC_C "" VALUE 0x8004EF38 Val_Ws16 400.0000 Time_PzoChrgPse 0.00 400.0000 FORMAT "%8.4" EXTENDED_LIMITS -327.6800 327.6700 /end CHARACTERISTIC
/begin CHARACTERISTIC IVCtl_tiPseDisCh_CUR "Kennlinie: Bestimmung der Entladepuls-Pausezeit aus der Soll-Entladezeit" CURVE 0x8004EF3A Cur_Xs16Ws16 18.00000 Time_PzoChrgPse 2.000000 20.00000 FORMAT "%8.5" EXTENDED_LIMITS -327.6800 327.6700
 /begin AXIS_DESCR STD_AXIS IVCtl_tiDisCh InjTime_us 2 0.00 5000.0000 FORMAT "%8.4" EXTENDED_LIMITS -13107.20 13106.80 DEPOSIT ABSOLUTE /end AXIS_DESCR
/end CHARACTERISTIC
/begin CHARACTERISTIC IVCtl_tiStrtMax_C "Umschaltzeitpunkt zur Startspannung des Piezoaktors" VALUE 0x8004F272 Val_Ws16 655350.0 Time_ms -327680.0 327670.0 FORMAT "%8.1" /end CHARACTERISTIC
/begin CHARACTERISTIC IVCtl_uCorPIRC_CA "Remotewerte für den Ausgang des PI-Reglers der Aktorspannungsregelung" VAL_BLK 0x8004F17E ValA_Ws16 500.0000 Vltg_PA -250.0000 250.0000 FORMAT "%8.4" EXTENDED_LIMITS -327.6800 327.6700 NUMBER 6 /end CHARACTERISTIC
/begin CHARACTERISTIC IVCtl_uCorPreCtl_CUR "Kennlinie der Vorsteuerspannung" CURVE 0x8004F0EE Cur_Xs16Ws16 20.00000 Vltg_PA 0.00 20.00000 FORMAT "%8.5" EXTENDED_LIMITS -327.6800 327.6700
 /begin AXIS_DESCR STD_AXIS IVCtl_p Pres_Rail 20 0.00 2000.000 FORMAT "%5.3" EXTENDED_LIMITS -3276.800 3276.700 DEPOSIT ABSOLUTE /end AXIS_DESCR
/end CHARACTERISTIC
/begin CHARACTERISTIC IVCtl_uPIMax_C "Begrenzung: Maximalwert des PI-Reglerausgangs der Aktorspannungsregelung" VALUE 0x8004F18A Val_Ws16 500.0000 Vltg_PA -250.0000 250.0000 FORMAT "%8.4" EXTENDED_LIMITS -327.6800 327.6700 /end CHARACTERISTIC
/begin CHARACTERISTIC IVCtl_uPIMin_C "Begrenzung: Minimalwert des PI-Reglerausgangs der Aktorspannungsregelung" VALUE 0x8004F18C Val_Ws16 500.0000 Vltg_PA -250.0000 250.0000 FORMAT "%8.4" EXTENDED_LIMITS -327.6800 327.6700 /end CHARACTERISTIC
/begin CHARACTERISTIC IVCtl_uSetPress0_CUR "Sollspannungskennlinie für ISA-Klasse 0" CURVE 0x8004F190 Cur_Xs16Ws16 500.0000 Vltg_PA -250.0000 250.0000 FORMAT "%8.4" EXTENDED_LIMITS -327.6800 327.6700
 /begin AXIS_DESCR STD_AXIS IVCtl_p Pres_Rail 3 0.00 2000.000 FORMAT "%5.3" EXTENDED_LIMITS -3276.800 3276.700 DEPOSIT ABSOLUTE /end AXIS_DESCR
/end CHARACTERISTIC
/begin CHARACTERISTIC IVCtl_uSetPress10_CUR "Sollspannungskennlinie für ISA-Klasse 10" CURVE 0x8004F19E Cur_Xs16Ws16 500.0000 Vltg_PA -250.0000 250.0000 FORMAT "%8.4" EXTENDED_LIMITS -327.6800 327.6700
 /begin AXIS_DESCR STD_AXIS IVCtl_p Pres_Rail 3 0.00 2000.000 FORMAT "%5.3" EXTENDED_LIMITS -3276.800 3276.700 DEPOSIT ABSOLUTE /end AXIS_DESCR
/end CHARACTERISTIC
/begin CHARACTERISTIC IVCtl_uSetPress11_CUR "Sollspannungskennlinie für ISA-Klasse 11" CURVE 0x8004F1AC Cur_Xs16Ws16 500.0000 Vltg_PA -250.0000 250.0000 FORMAT "%8.4" EXTENDED_LIMITS -327.6800 327.6700
 /begin AXIS_DESCR STD_AXIS IVCtl_p Pres_Rail 3 0.00 2000.000 FORMAT "%5.3" EXTENDED_LIMITS -3276.800 3276.700 DEPOSIT ABSOLUTE /end AXIS_DESCR
/end CHARACTERISTIC
/begin CHARACTERISTIC IVCtl_uSetPress12_CUR "Sollspannungskennlinie für ISA-Klasse 12" CURVE 0x8004F1BA Cur_Xs16Ws16 500.0000 Vltg_PA -250.0000 250.0000 FORMAT "%8.4" EXTENDED_LIMITS -327.6800 327.6700
 /begin AXIS_DESCR STD_AXIS IVCtl_p Pres_Rail 3 0.00 2000.000 FORMAT "%5.3" EXTENDED_LIMITS -3276.800 3276.700 DEPOSIT ABSOLUTE /end AXIS_DESCR
/end CHARACTERISTIC
/begin CHARACTERISTIC IVCtl_uSetPress13_CUR "Sollspannungskennlinie für ISA-Klasse 13" CURVE 0x8004F1C8 Cur_Xs16Ws16 500.0000 Vltg_PA -250.0000 250.0000 FORMAT "%8.4" EXTENDED_LIMITS -327.6800 327.6700
 /begin AXIS_DESCR STD_AXIS IVCtl_p Pres_Rail 3 0.00 2000.000 FORMAT "%5.3" EXTENDED_LIMITS -3276.800 3276.700 DEPOSIT ABSOLUTE /end AXIS_DESCR
/end CHARACTERISTIC
/begin CHARACTERISTIC IVCtl_uSetPress14_CUR "Sollspannungskennlinie für ISA-Klasse 14" CURVE 0x8004F1D6 Cur_Xs16Ws16 500.0000 Vltg_PA -250.0000 250.0000 FORMAT "%8.4" EXTENDED_LIMITS -327.6800 327.6700
 /begin AXIS_DESCR STD_AXIS IVCtl_p Pres_Rail 3 0.00 2000.000 FORMAT "%5.3" EXTENDED_LIMITS -3276.800 3276.700 DEPOSIT ABSOLUTE /end AXIS_DESCR
/end CHARACTERISTIC
/begin CHARACTERISTIC IVCtl_uSetPress15_CUR "Sollspannungskennlinie für ISA-Klasse 15" CURVE 0x8004F1E4 Cur_Xs16Ws16 500.0000 Vltg_PA -250.0000 250.0000 FORMAT "%8.4" EXTENDED_LIMITS -327.6800 327.6700
 /begin AXIS_DESCR STD_AXIS IVCtl_p Pres_Rail 3 -3276.800 2000.000 FORMAT "%5.3" EXTENDED_LIMITS -3276.800 3276.700 DEPOSIT ABSOLUTE /end AXIS_DESCR
/end CHARACTERISTIC
/begin CHARACTERISTIC IVCtl_uSetPress1_CUR "Sollspannungskennlinie für ISA-Klasse 1" CURVE 0x8004F1F2 Cur_Xs16Ws16 500.0000 Vltg_PA -250.0000 250.0000 FORMAT "%8.4" EXTENDED_LIMITS -327.6800 327.6700
 /begin AXIS_DESCR STD_AXIS IVCtl_p Pres_Rail 3 0.00 2000.000 FORMAT "%5.3" EXTENDED_LIMITS -3276.800 3276.700 DEPOSIT ABSOLUTE /end AXIS_DESCR
/end CHARACTERISTIC
/begin CHARACTERISTIC IVCtl_uSetPress2_CUR "Sollspannungskennlinie für ISA-Klasse 2" CURVE 0x8004F200 Cur_Xs16Ws16 500.0000 Vltg_PA -250.0000 250.0000 FORMAT "%8.4" EXTENDED_LIMITS -327.6800 327.6700
 /begin AXIS_DESCR STD_AXIS IVCtl_p Pres_Rail 3 0.00 2000.000 FORMAT "%5.3" EXTENDED_LIMITS -3276.800 3276.700 DEPOSIT ABSOLUTE /end AXIS_DESCR
/end CHARACTERISTIC
/begin CHARACTERISTIC IVCtl_uSetPress3_CUR "Sollspannungskennlinie für ISA-Klasse 3" CURVE 0x8004F20E Cur_Xs16Ws16 500.0000 Vltg_PA -250.0000 250.0000 FORMAT "%8.4" EXTENDED_LIMITS -327.6800 327.6700
 /begin AXIS_DESCR STD_AXIS IVCtl_p Pres_Rail 3 0.00 2000.000 FORMAT "%5.3" EXTENDED_LIMITS -3276.800 3276.700 DEPOSIT ABSOLUTE /end AXIS_DESCR
/end CHARACTERISTIC
/begin CHARACTERISTIC IVCtl_uSetPress4_CUR "Sollspannungskennlinie für ISA-Klasse 4" CURVE 0x8004F21C Cur_Xs16Ws16 500.0000 Vltg_PA -250.0000 250.0000 FORMAT "%8.4" EXTENDED_LIMITS -327.6800 327.6700
 /begin AXIS_DESCR STD_AXIS IVCtl_p Pres_Rail 3 0.00 2000.000 FORMAT "%5.3" EXTENDED_LIMITS -3276.800 3276.700 DEPOSIT ABSOLUTE /end AXIS_DESCR
/end CHARACTERISTIC
/begin CHARACTERISTIC IVCtl_uSetPress5_CUR "Sollspannungskennlinie für ISA-Klasse 5" CURVE 0x8004F22A Cur_Xs16Ws16 500.0000 Vltg_PA -250.0000 250.0000 FORMAT "%8.4" EXTENDED_LIMITS -327.6800 327.6700
 /begin AXIS_DESCR STD_AXIS IVCtl_p Pres_Rail 3 0.00 2000.000 FORMAT "%5.3" EXTENDED_LIMITS -3276.800 3276.700 DEPOSIT ABSOLUTE /end AXIS_DESCR
/end CHARACTERISTIC
/begin CHARACTERISTIC IVCtl_uSetPress6_CUR "Sollspannungskennlinie für ISA-Klasse 6" CURVE 0x8004F238 Cur_Xs16Ws16 500.0000 Vltg_PA -250.0000 250.0000 FORMAT "%8.4" EXTENDED_LIMITS -327.6800 327.6700
 /begin AXIS_DESCR STD_AXIS IVCtl_p Pres_Rail 3 0.00 2000.000 FORMAT "%5.3" EXTENDED_LIMITS -3276.800 3276.700 DEPOSIT ABSOLUTE /end AXIS_DESCR
/end CHARACTERISTIC
/begin CHARACTERISTIC IVCtl_uSetPress7_CUR "Sollspannungskennlinie für ISA-Klasse 7" CURVE 0x8004F246 Cur_Xs16Ws16 500.0000 Vltg_PA -250.0000 250.0000 FORMAT "%8.4" EXTENDED_LIMITS -327.6800 327.6700
 /begin AXIS_DESCR STD_AXIS IVCtl_p Pres_Rail 3 0.00 2000.000 FORMAT "%5.3" EXTENDED_LIMITS -3276.800 3276.700 DEPOSIT ABSOLUTE /end AXIS_DESCR
/end CHARACTERISTIC
/begin CHARACTERISTIC IVCtl_uSetPress8_CUR "Sollspannungskennlinie für ISA-Klasse 8" CURVE 0x8004F254 Cur_Xs16Ws16 500.0000 Vltg_PA -250.0000 250.0000 FORMAT "%8.4" EXTENDED_LIMITS -327.6800 327.6700
 /begin AXIS_DESCR STD_AXIS IVCtl_p Pres_Rail 3 0.00 2000.000 FORMAT "%5.3" EXTENDED_LIMITS -3276.800 3276.700 DEPOSIT ABSOLUTE /end AXIS_DESCR
/end CHARACTERISTIC
/begin CHARACTERISTIC IVCtl_uSetPress9_CUR "Sollspannungskennlinie für ISA-Klasse 9" CURVE 0x8004F262 Cur_Xs16Ws16 500.0000 Vltg_PA -250.0000 250.0000 FORMAT "%8.4" EXTENDED_LIMITS -327.6800 327.6700
 /begin AXIS_DESCR STD_AXIS IVCtl_p Pres_Rail 3 0.00 2000.000 FORMAT "%5.3" EXTENDED_LIMITS -3276.800 3276.700 DEPOSIT ABSOLUTE /end AXIS_DESCR
/end CHARACTERISTIC
/begin CHARACTERISTIC IVCtl_uUpMax_C "Obere Begrenzung von IVCtl_uUp" VALUE 0x8004F140 Val_Ws16 250.0000 Vltg_PA 0.00 250.0000 FORMAT "%8.4" EXTENDED_LIMITS -327.6800 327.6700 /end CHARACTERISTIC
/begin CHARACTERISTIC IVCtl_uUpMin_C "Untere Begrenzung von IVCtl_uUp" VALUE 0x8004F142 Val_Ws16 250.0000 Vltg_PA 0.00 250.0000 FORMAT "%8.4" EXTENDED_LIMITS -327.6800 327.6700 /end CHARACTERISTIC
/begin CHARACTERISTIC IVCtl_uUpRC_CA "Remotewert für IVCtl_uUp" VAL_BLK 0x8004F144 ValA_Ws16 250.0000 Vltg_PA 0.00 250.0000 FORMAT "%8.4" EXTENDED_LIMITS -327.6800 327.6700 NUMBER 6 /end CHARACTERISTIC
/begin CHARACTERISTIC IVCtl_uUpStrt_C "Startspannung des Piezoaktors" VALUE 0x8004F274 Val_Ws16 210.0000 Vltg_PA 0.00 210.0000 FORMAT "%8.4" EXTENDED_LIMITS -327.6800 327.6700 /end CHARACTERISTIC
/begin CHARACTERISTIC IVDia_facUPlaus_CA "Faktor zu Umrechnung der Schwelle für Plausibilitätprüfung der Aktorspannung" VAL_BLK 0x8004F2B4 ValA_Ws16 2.000000 Fact 0.00 2.000000 FORMAT "%8.6" EXTENDED_LIMITS -4.000000 3.999878 NUMBER 3 /end CHARACTERISTIC
/begin CHARACTERISTIC IVDia_numBnkRegSPI_CA "Zuordnungstabelle von Bankmummer zu SPI-Zylinderinfo." VAL_BLK 0x8004F276 ValA_Wu8 3.000 OneToOne 0.00 3.000 FORMAT "%5.3" EXTENDED_LIMITS 0.00 255.0 NUMBER 6 /end CHARACTERISTIC
/begin CHARACTERISTIC IVDia_numNoLoadCylMax_C "maximale zulässige Anzahl von Zylindern mit Lastabfall" VALUE 0x8004F27C Val_Wu8 8.000 OneToOne 0.00 8.000 FORMAT "%5.3" EXTENDED_LIMITS 0.00 255.0 /end CHARACTERISTIC
/begin CHARACTERISTIC IVDia_numPsRegSPI_CA "Zuordernungstabele von SPI-Zylinderinfo. zu PS-Nummer" VAL_BLK 0x8004F27D ValA_Wu8 3.000 OneToOne 0.00 3.000 FORMAT "%5.3" EXTENDED_LIMITS 0.00 255.0 NUMBER 6 /end CHARACTERISTIC
/begin CHARACTERISTIC IVDia_stErrMskPattern_CA "Fehlermuster" VAL_BLK 0x8004F284 ValA_Wu16 65535.00 OneToOne 0.00 65535.00 FORMAT "%8.2" NUMBER 12 /end CHARACTERISTIC
/begin CHARACTERISTIC IVDia_stErrMskSelect_CA "Fehler Selekt-Matrix" VAL_BLK 0x8004F29C ValA_Wu16 65535.00 OneToOne 0.00 65535.00 FORMAT "%8.2" NUMBER 12 /end CHARACTERISTIC
/begin CHARACTERISTIC IVH_iChrgSOPT_C "" VALUE 0x8004F2BA Val_Ws16 30000.00 Curr 0.00 30000.00 FORMAT "%8.2" EXTENDED_LIMITS -32768.00 32767.00 /end CHARACTERISTIC
/begin CHARACTERISTIC IVH_iDisChSOPT_C "" VALUE 0x8004F2BC Val_Ws16 30000.00 Curr 0.00 30000.00 FORMAT "%8.2" EXTENDED_LIMITS -32768.00 32767.00 /end CHARACTERISTIC
/begin CHARACTERISTIC IVH_tiChrgSOPT_C "" VALUE 0x8004F2BE Val_Ws16 18107.20 InjTime_us -13107.20 5000.00 FORMAT "%8.2" EXTENDED_LIMITS -13107.20 13106.80 /end CHARACTERISTIC
/begin CHARACTERISTIC IVH_tiPseChrgSOPT_C "" VALUE 0x8004F2C0 Val_Ws16 20.00000 Time_PzoChrgPse 0.00 20.00000 FORMAT "%8.5" EXTENDED_LIMITS -327.6800 327.6700 /end CHARACTERISTIC
/begin CHARACTERISTIC IVH_tiPseDisChSOPT_C "" VALUE 0x8004F2C2 Val_Ws16 20.00000 Time_PzoChrgPse 0.00 20.00000 FORMAT "%8.5" EXTENDED_LIMITS -327.6800 327.6700 /end CHARACTERISTIC
/begin CHARACTERISTIC IVPlaus_numSegOfs1_C "Segmentoffset der zylinderselektiven Drehzahlberechnung für Modus A" VALUE 0x8004F2E4 Val_Wu8 11.00 OneToOne 0.00 11.00 FORMAT "%5.2" EXTENDED_LIMITS 0.00 255.0 /end CHARACTERISTIC
/begin CHARACTERISTIC IVPlaus_numSegOfs2_C "Segmentoffset der zylinderselektiven Drehzahlberechnung für Modi B und C" VALUE 0x8004F2E5 Val_Wu8 11.00 OneToOne 0.00 11.00 FORMAT "%5.2" EXTENDED_LIMITS 0.00 255.0 /end CHARACTERISTIC
/begin CHARACTERISTIC IVPlaus_stCylChk_C "Schalter für zylinderselektive Drehzahl" VALUE 0x8004F2E6 Val_Wu8 1.000 OneToOne 0.00 1.000 FORMAT "%5.3" EXTENDED_LIMITS 0.00 255.0 /end CHARACTERISTIC
/begin CHARACTERISTIC IVPSply_numIntrBufMeas_C "Max. Anzahl Interrups des gemessenen Einspritztyps zwischen Start und Auswertung der Bufferspannungsmessung" VALUE 0x8004F2C4 Val_Wu8 255.0 OneToOne 0.00 255.0 FORMAT "%5.1" /end CHARACTERISTIC
/begin CHARACTERISTIC IVPSply_stUBufRC_C "Remote-Wert für Status der Bufferspannung" VALUE 0x8004F2C5 Val_Wu8 255.0 OneToOne 0.00 255.0 FORMAT "%5.1" /end CHARACTERISTIC
/begin CHARACTERISTIC IVPSply_swtEnaBufVltg_C "Schalter für Freigabe der Bufferspannungsmessung" VALUE 0x8004F2C6 Val_Wu8 255.0 OneToOne 0.00 255.0 FORMAT "%5.1" /end CHARACTERISTIC
/begin CHARACTERISTIC IVPSply_swtUBufRC_C "Remote-Schalter für Bufferspannung" VALUE 0x8004F2C7 Val_Wu8 255.0 OneToOne 0.00 255.0 FORMAT "%5.1" /end CHARACTERISTIC
/begin CHARACTERISTIC IVPSply_tiADCBusyMax_C "Max. ADC-Wandlungszeit aller piezospezifischen Messwerte" VALUE 0x8004F2C8 Val_Wu16 5000.00 InjTime_us 0.00 5000.00 FORMAT "%8.2" EXTENDED_LIMITS 0.00 26214.00 /end CHARACTERISTIC
/begin CHARACTERISTIC IVPSply_tiBufMeasChk_C "Max. Zeitdifferenz für Freigabeprüfung der Bufferspannungsmessung" VALUE 0x8004F2CC Val_Wu32 234505214.307 Time_PzoMeas 0.00 234505214.307 FORMAT "%13.3" /end CHARACTERISTIC
/begin CHARACTERISTIC IVPSply_tiDCDCWait_C "Wartezeit für geladenen DCDC-Kondensator" VALUE 0x8004F2E0 Val_Wu32 4294967295.00 OneToOne 0.00 4294967295.00 FORMAT "%13.2" /end CHARACTERISTIC
/begin CHARACTERISTIC IVPSply_uBufLin_CUR "Linearisierungskurve für Bufferspannungsmessung" CURVE 0x8004F2D0 Cur_Xs16Ws16 5200.000 Vltg_PA 0.00 5200.000 FORMAT "%8.3" EXTENDED_LIMITS -327.6800 327.6700
 /begin AXIS_DESCR STD_AXIS IVPSply_uBufRaw_mp Volt 2 0.00 5200.000 FORMAT "%8.3" EXTENDED_LIMITS -6553.600 6553.400 DEPOSIT ABSOLUTE /end AXIS_DESCR
/end CHARACTERISTIC
/begin CHARACTERISTIC IVPSply_uBufRC_C "Remote-Wert für Bufferspannung" VALUE 0x8004F2DA Val_Ws16 655.3500 Vltg_PA -327.6800 327.6700 FORMAT "%8.4" /end CHARACTERISTIC
/begin CHARACTERISTIC IVPSply_Vltg_SRC.uMin_C "Klasseninstanz für Signal Range Check der Bufferspannungsmessung/" VALUE 0x8004F2DC Val_Ws16 5200.000 Volt 0.00 5200.000 FORMAT "%8.3" EXTENDED_LIMITS -6553.600 6553.400 /end CHARACTERISTIC
/begin CHARACTERISTIC IVPSply_Vltg_SRC.uMax_C "Klasseninstanz für Signal Range Check der Bufferspannungsmessung/" VALUE 0x8004F2DE Val_Ws16 5200.000 Volt 0.00 5200.000 FORMAT "%8.3" EXTENDED_LIMITS -6553.600 6553.400 /end CHARACTERISTIC
/begin CHARACTERISTIC LLim_aDifNeg_C "" VALUE 0x8007A5AC Kw_Ws16 65.53500 Acc -32.76800 32.76700 FORMAT "%8.5" /end CHARACTERISTIC
/begin CHARACTERISTIC LLim_aDifPos_C "" VALUE 0x8007A5AE Kw_Ws16 65.53500 Acc -32.76800 32.76700 FORMAT "%8.5" /end CHARACTERISTIC
/begin CHARACTERISTIC LLim_aMSL_CUR "" CURVE 0x8007A5B0 Kl_Xs16_Ws16 65.53500 Acc -32.76800 32.76700 FORMAT "%8.5"
 /begin AXIS_DESCR STD_AXIS LLim_dvMSL_mp Vel 15 -327.6800 327.6700 FORMAT "%8.4" DEPOSIT ABSOLUTE /end AXIS_DESCR
/end CHARACTERISTIC
/begin CHARACTERISTIC LLim_axMax_C "" VALUE 0x8007A5EE Kw_Ws16 65.53500 Acc -32.76800 32.76700 FORMAT "%8.5" /end CHARACTERISTIC
/begin CHARACTERISTIC LLim_vMaxFix_C "" VALUE 0x8007A5F0 Kw_Ws16 655.3500 Vel -327.6800 327.6700 FORMAT "%8.4" /end CHARACTERISTIC
/begin CHARACTERISTIC LLim_vThres_C "" VALUE 0x8007A5F2 Kw_Ws16 655.3500 Vel -327.6800 327.6700 FORMAT "%8.4" /end CHARACTERISTIC
/begin CHARACTERISTIC LsComp_facCompTot_C "Absoluter Gewichtungsfaktor" VALUE 0x8007A5F4 Val_Ws16 1.000000 FactLow 0.00 1.000000 FORMAT "%8.6" EXTENDED_LIMITS -32.00000 31.99902 /end CHARACTERISTIC
/begin CHARACTERISTIC LsComp_facDynCompOvrRun_C "Gewichtungsfaktor zur dynamischen Kompensation im Schub" VALUE 0x8007A5F6 Val_Ws16 1.000000 FactLow 0.00 1.000000 FORMAT "%8.6" EXTENDED_LIMITS -32.00000 31.99902 /end CHARACTERISTIC
/begin CHARACTERISTIC LsComp_facDynComp_C "Gewichtungsfaktor zur dynamischen Kompensation" VALUE 0x8007A5F8 Val_Ws16 1.000000 FactLow 0.00 1.000000 FORMAT "%8.6" EXTENDED_LIMITS -32.00000 31.99902 /end CHARACTERISTIC
/begin CHARACTERISTIC LsComp_facStab_C "Gewichtungsfaktor für Drehzahlreglermoment" VALUE 0x8007A5FA Val_Ws16 1.000000 FactLow 1.000000 2.000000 FORMAT "%8.6" EXTENDED_LIMITS -32.00000 31.99902 /end CHARACTERISTIC
/begin CHARACTERISTIC LsComp_T1Flt_C "Zeitkonstante für PT1-Glied der dynamischen Kompsenation" VALUE 0x8007A5FC Val_Ws32 4294.9672940 TimeDelay_s 0.000002000000001 4294.9672960 FORMAT "%12.7" /end CHARACTERISTIC
/begin CHARACTERISTIC LSU_dcycMax_C "" VALUE 0x8006368C Val_Ws16 655.3500 DtyCyc -327.6800 327.6700 FORMAT "%8.4" /end CHARACTERISTIC
/begin CHARACTERISTIC LSU_dcycMinGrad_C "" VALUE 0x8006377C Val_Ws16 655.3500 DtyCyc -327.6800 327.6700 FORMAT "%8.4" /end CHARACTERISTIC
/begin CHARACTERISTIC LSU_dmEGHtCoupActv_C "" VALUE 0x8006377E Val_Ws16 1000.000 AirMassPerTime 0.00 1000.000 FORMAT "%8.3" EXTENDED_LIMITS -3276.800 3276.700 /end CHARACTERISTIC
/begin CHARACTERISTIC LSU_dNumHtCoup_C "" VALUE 0x80063780 Val_Wu16 65535.00 OneToOne 0.00 65535.00 FORMAT "%8.2" /end CHARACTERISTIC
/begin CHARACTERISTIC LSU_facUToRi_C "" VALUE 0x8006371C Val_Ws16 32.76750 VoltToRes -16.38400 16.38350 FORMAT "%8.5" /end CHARACTERISTIC
/begin CHARACTERISTIC LSU_nMaxClb1_C "" VALUE 0x8006366C Val_Ws16 32767.50 EngN -16384.00 16383.50 FORMAT "%8.2" /end CHARACTERISTIC
/begin CHARACTERISTIC LSU_nMaxClb2_C "" VALUE 0x8006366E Val_Ws16 32767.50 EngN -16384.00 16383.50 FORMAT "%8.2" /end CHARACTERISTIC
/begin CHARACTERISTIC LSU_nMinClb1_C "" VALUE 0x80063670 Val_Ws16 32767.50 EngN -16384.00 16383.50 FORMAT "%8.2" /end CHARACTERISTIC
/begin CHARACTERISTIC LSU_nMinClb2_C "" VALUE 0x80063672 Val_Ws16 32767.50 EngN -16384.00 16383.50 FORMAT "%8.2" /end CHARACTERISTIC
/begin CHARACTERISTIC LSU_Pwm.tiPer_C "/" VALUE 0x8006368E Val_Ws16 6553.500 Period -3276.800 3276.700 FORMAT "%8.3" /end CHARACTERISTIC
/begin CHARACTERISTIC LSU_Pwm.stLvl_C "/" VALUE 0x80063690 Val_Wu8 1.00000000000 PwmOutLevel 0.00 1.00000000000 FORMAT "%13.11" /end CHARACTERISTIC
/begin CHARACTERISTIC LSU_Pwm.rMaxDty_C "/" VALUE 0x80063692 Val_Ws16 655.3500 DtyCyc -327.6800 327.6700 FORMAT "%8.4" /end CHARACTERISTIC
/begin CHARACTERISTIC LSU_Pwm.rPerUn_C "/" VALUE 0x80063694 Val_Ws16 65535.00 OneToOne -32768.00 32767.00 FORMAT "%8.2" /end CHARACTERISTIC
/begin CHARACTERISTIC LSU_Pwm.tiPh_C "/" VALUE 0x80063696 Val_Ws16 65535.00 OneToOne -32768.00 32767.00 FORMAT "%8.2" /end CHARACTERISTIC
/begin CHARACTERISTIC LSU_PwmOut.rMin_C "/" VALUE 0x80063698 Kw_Ws16 100.0000 DtyCyc 0.00 100.0000 FORMAT "%8.4" EXTENDED_LIMITS -327.6800 327.6700 /end CHARACTERISTIC
/begin CHARACTERISTIC LSU_PwmOut.rMax_C "/" VALUE 0x8006369A Kw_Ws16 100.0000 DtyCyc 0.00 100.0000 FORMAT "%8.4" EXTENDED_LIMITS -327.6800 327.6700 /end CHARACTERISTIC
/begin CHARACTERISTIC LSU_PwmOut.tiBtwTstSCB_C "/" VALUE 0x8006369C Kw_Ws16 1000.000 Time_ms 0.00 1000.000 FORMAT "%8.3" EXTENDED_LIMITS -327680.0 327670.0 /end CHARACTERISTIC
/begin CHARACTERISTIC LSU_PwmOut.tiBtwTstOT_C "/" VALUE 0x8006369E Kw_Ws16 327.6700 Time_s 0.00 327.6700 FORMAT "%8.4" EXTENDED_LIMITS -327.6800 327.6700 /end CHARACTERISTIC
/begin CHARACTERISTIC LSU_PwmOut.numTstMax_C "/" VALUE 0x800636A0 Kw_Wu16 65535.00 OneToOne 0.00 65535.00 FORMAT "%8.2" /end CHARACTERISTIC
/begin CHARACTERISTIC LSU_PwmOut.swtBattCor_C "/" VALUE 0x800636A2 Kw_Wu8 1.000 OneToOne 0.00 1.000 FORMAT "%5.3" EXTENDED_LIMITS 0.00 255.0 /end CHARACTERISTIC
/begin CHARACTERISTIC LSU_PwmOut.swtPsInv_C "/" VALUE 0x800636A3 Kw_Wu8 255.0 OneToOne 0.00 255.0 FORMAT "%5.1" /end CHARACTERISTIC
/begin CHARACTERISTIC LSU_qMaxClb1_C "" VALUE 0x80063674 Val_Ws16 655.3500 InjMass -327.6800 327.6700 FORMAT "%8.4" /end CHARACTERISTIC
/begin CHARACTERISTIC LSU_qMaxClb2_C "" VALUE 0x80063676 Val_Ws16 655.3500 InjMass -327.6800 327.6700 FORMAT "%8.4" /end CHARACTERISTIC
/begin CHARACTERISTIC LSU_qMinClb1_C "" VALUE 0x80063678 Val_Ws16 655.3500 InjMass -327.6800 327.6700 FORMAT "%8.4" /end CHARACTERISTIC
/begin CHARACTERISTIC LSU_qMinClb2_C "" VALUE 0x8006367A Val_Ws16 655.3500 InjMass -327.6800 327.6700 FORMAT "%8.4" /end CHARACTERISTIC
/begin CHARACTERISTIC LSU_resRiClbMax_C "" VALUE 0x8006371E Val_Ws16 6553.500 Resist -3276.800 3276.700 FORMAT "%8.3" /end CHARACTERISTIC
/begin CHARACTERISTIC LSU_resRiClbMin_C "" VALUE 0x80063720 Val_Ws16 6553.500 Resist -3276.800 3276.700 FORMAT "%8.3" /end CHARACTERISTIC
/begin CHARACTERISTIC LSU_resRiClbRef_C "" VALUE 0x80063722 Val_Ws16 6553.500 Resist -3276.800 3276.700 FORMAT "%8.3" /end CHARACTERISTIC
/begin CHARACTERISTIC LSU_resRiMaxGrad_C "" VALUE 0x80063782 Val_Ws16 6553.500 Resist -3276.800 3276.700 FORMAT "%8.3" /end CHARACTERISTIC
/begin CHARACTERISTIC LSU_rO2IsolChkMax_C "" VALUE 0x80063784 Val_Ws16 0.6553500 O2 -0.3276800 0.3276700 FORMAT "%9.7" /end CHARACTERISTIC
/begin CHARACTERISTIC LSU_rO2IsolChkMin_C "" VALUE 0x80063786 Val_Ws16 0.6553500 O2 -0.3276800 0.3276700 FORMAT "%9.7" /end CHARACTERISTIC
/begin CHARACTERISTIC LSU_rO2Transf_CUR "" CURVE 0x800636B0 Cur_Xs16Ws16 0.6000000 O2 -0.3000000 0.3000000 FORMAT "%9.7" EXTENDED_LIMITS -0.3276800 0.3276700
 /begin AXIS_DESCR STD_AXIS LSU_uO2RawOfsCorLast_mp Volt 15 -1600.000 4000.000 FORMAT "%8.3" EXTENDED_LIMITS -6553.600 6553.400 DEPOSIT ABSOLUTE /end AXIS_DESCR
/end CHARACTERISTIC
/begin CHARACTERISTIC LSU_stChpClbActv_C "" VALUE 0x8006367C Val_Wu8 3.000 OneToOne 0.00 3.000 FORMAT "%5.3" EXTENDED_LIMITS 0.00 255.0 /end CHARACTERISTIC
/begin CHARACTERISTIC LSU_stEGTClbOff_C "" VALUE 0x80063680 Val_Wu32 4294967295.00 OneToOne 0.00 4294967295.00 FORMAT "%13.2" /end CHARACTERISTIC
/begin CHARACTERISTIC LSU_stHtDis_C "" VALUE 0x800636A4 Val_Wu8 255.0 OneToOne 0.00 255.0 FORMAT "%5.1" /end CHARACTERISTIC
/begin CHARACTERISTIC LSU_stHtrPwrStgSel_C "" VALUE 0x800636A5 Val_Wu8 255.0 OneToOne 0.00 255.0 FORMAT "%5.1" /end CHARACTERISTIC
/begin CHARACTERISTIC LSU_stPwrStgDia_C "" VALUE 0x800636A6 Val_Wu8 255.0 OneToOne 0.00 255.0 FORMAT "%5.1" /end CHARACTERISTIC
/begin CHARACTERISTIC LSU_stRefCurrHi_C "" VALUE 0x80063778 Val_Wu8 15.0000000000 CurRefPump 0.00 15.0000000000 FORMAT "%13.10" /end CHARACTERISTIC
/begin CHARACTERISTIC LSU_stRefCurrNrm_C "" VALUE 0x80063779 Val_Wu8 15.0000000000 CurRefPump 0.00 15.0000000000 FORMAT "%13.10" /end CHARACTERISTIC
/begin CHARACTERISTIC LSU_stRefPmpDisbl_C "" VALUE 0x80063714 Val_Wu8 255.0 OneToOne 0.00 255.0 FORMAT "%5.1" /end CHARACTERISTIC
/begin CHARACTERISTIC LSU_stWireDiaActv_C "" VALUE 0x80063788 Val_Wu16 65535.00 OneToOne 0.00 65535.00 FORMAT "%8.2" /end CHARACTERISTIC
/begin CHARACTERISTIC LSU_swtO2Flt_C "" VALUE 0x800636EE Val_Wu8 1.000 OneToOne 0.00 1.000 FORMAT "%5.3" EXTENDED_LIMITS 0.00 255.0 /end CHARACTERISTIC
/begin CHARACTERISTIC LSU_swtSensPrs_C "" VALUE 0x800636EF Val_Wu8 1.000 OneToOne 0.00 1.000 FORMAT "%5.3" EXTENDED_LIMITS 0.00 255.0 /end CHARACTERISTIC
/begin CHARACTERISTIC LSU_ti1stClb_C "" VALUE 0x80063684 Val_Wu16 655.3500 Time_s 0.00 655.3500 FORMAT "%8.4" /end CHARACTERISTIC
/begin CHARACTERISTIC LSU_tiClgLstRun_C "" VALUE 0x8006378C Val_Ws32 21474836.4700 Time_s 0.00 21474836.4700 FORMAT "%13.4" EXTENDED_LIMITS -21474836.4800 21474836.4700 /end CHARACTERISTIC
/begin CHARACTERISTIC LSU_tiDelO2Clb_C "" VALUE 0x800636F0 Val_Wu16 100.0000 Time_ms 0.00 100.0000 FORMAT "%8.4" EXTENDED_LIMITS 0.00 655350.0 /end CHARACTERISTIC
/begin CHARACTERISTIC LSU_tiDelO2Val_C "" VALUE 0x800636F2 Val_Wu16 100.0000 Time_ms 0.00 100.0000 FORMAT "%8.4" EXTENDED_LIMITS 0.00 655350.0 /end CHARACTERISTIC
/begin CHARACTERISTIC LSU_tiDelRiClb_C "" VALUE 0x80063724 Val_Wu16 100.0000 Time_ms 0.00 100.0000 FORMAT "%8.4" EXTENDED_LIMITS 0.00 655350.0 /end CHARACTERISTIC
/begin CHARACTERISTIC LSU_tiDelRiVal_C "" VALUE 0x80063726 Val_Wu16 100.0000 Time_ms 0.00 100.0000 FORMAT "%8.4" EXTENDED_LIMITS 0.00 655350.0 /end CHARACTERISTIC
/begin CHARACTERISTIC LSU_tiHtCoupChk_C "" VALUE 0x80063790 Val_Wu16 655.3500 Time_s 0.00 655.3500 FORMAT "%8.4" /end CHARACTERISTIC
/begin CHARACTERISTIC LSU_tiHtCoupFlt_C "" VALUE 0x80063794 Val_Ws32 4294967.2940 TimeDelay_ms 0.0020000000009 4294967.2960 FORMAT "%12.4" /end CHARACTERISTIC
/begin CHARACTERISTIC LSU_tiHtCoupPer_C "" VALUE 0x80063798 Val_Wu16 655.3500 Time_s 0.00 655.3500 FORMAT "%8.4" /end CHARACTERISTIC
/begin CHARACTERISTIC LSU_tiHtrBattDefDel_C "" VALUE 0x800636A8 Val_Wu16 655350.0 Time_ms 0.00 655350.0 FORMAT "%8.1" /end CHARACTERISTIC
/begin CHARACTERISTIC LSU_tiIsolChkErr_C "" VALUE 0x8006379A Val_Wu16 655.3500 Time_s 0.00 655.3500 FORMAT "%8.4" /end CHARACTERISTIC
/begin CHARACTERISTIC LSU_tiIsolChkPer_C "" VALUE 0x8006379C Val_Wu16 655.3500 Time_s 0.00 655.3500 FORMAT "%8.4" /end CHARACTERISTIC
/begin CHARACTERISTIC LSU_tiIsolChkPmp_C "" VALUE 0x8006379E Val_Wu16 655.3500 Time_s 0.00 655.3500 FORMAT "%8.4" /end CHARACTERISTIC
/begin CHARACTERISTIC LSU_tiO2ClbPT1_C "" VALUE 0x800636F4 Val_Ws32 4294967.2940 TimeDelay_ms 0.0020000000009 4294967.2960 FORMAT "%12.4" /end CHARACTERISTIC
/begin CHARACTERISTIC LSU_tiO2Clb_C "" VALUE 0x800636F8 Val_Wu16 100.0000 Time_ms 0.00 100.0000 FORMAT "%8.4" EXTENDED_LIMITS 0.00 655350.0 /end CHARACTERISTIC
/begin CHARACTERISTIC LSU_tiO2PT1_C "" VALUE 0x800636FC Val_Ws32 4294967.2940 TimeDelay_ms 0.0020000000009 4294967.2960 FORMAT "%12.4" /end CHARACTERISTIC
/begin CHARACTERISTIC LSU_tiPerClb_C "" VALUE 0x80063686 Val_Wu16 655.3500 Time_s 0.00 655.3500 FORMAT "%8.4" /end CHARACTERISTIC
/begin CHARACTERISTIC LSU_tiPT1FltO2Raw_C "" VALUE 0x8006370C Val_Ws32 4294967.2940 TimeDelay_ms 0.0020000000009 4294967.2960 FORMAT "%12.4" /end CHARACTERISTIC
/begin CHARACTERISTIC LSU_tiPT1fltRiRaw_C "" VALUE 0x80063710 Val_Ws32 4294967.2940 TimeDelay_ms 0.0020000000009 4294967.2960 FORMAT "%12.4" /end CHARACTERISTIC
/begin CHARACTERISTIC LSU_tiRefPmpHi_C "" VALUE 0x80063716 Val_Wu16 655350.0 Time_ms 0.00 655350.0 FORMAT "%8.1" /end CHARACTERISTIC
/begin CHARACTERISTIC LSU_tiRefTransLo_C "" VALUE 0x80063718 Val_Wu16 655350.0 Time_ms 0.00 655350.0 FORMAT "%8.1" /end CHARACTERISTIC
/begin CHARACTERISTIC LSU_tiRiClbPT1_C "" VALUE 0x80063728 Val_Ws32 4294.9672940 TimeDelay_s 0.000002000000001 4294.9672960 FORMAT "%12.7" /end CHARACTERISTIC
/begin CHARACTERISTIC LSU_tiRiClb_C "" VALUE 0x8006372C Val_Wu16 150.0000 Time_ms 0.00 150.0000 FORMAT "%8.4" EXTENDED_LIMITS 0.00 655350.0 /end CHARACTERISTIC
/begin CHARACTERISTIC LSU_tiRiPT1_C "" VALUE 0x80063730 Val_Ws32 4294.9672940 TimeDelay_s 0.000002000000001 4294.9672960 FORMAT "%12.7" /end CHARACTERISTIC
/begin CHARACTERISTIC LSU_tRi_CUR "" CURVE 0x80063734 Cur_Xs16Ws16 1200.000 Temp_Cels 99.96000 1299.960 FORMAT "%8.3" EXTENDED_LIMITS -3549.940 3003.560
 /begin AXIS_DESCR STD_AXIS LSU_resRi_mp Resist 16 0.00 3000.00000000 FORMAT "%13.8" EXTENDED_LIMITS -214748364.800 214748364.700 DEPOSIT ABSOLUTE /end AXIS_DESCR
/end CHARACTERISTIC
/begin CHARACTERISTIC LSU_uBattMaxHigh_C "" VALUE 0x800636AA Val_Ws16 680360.0 Volt_Batt -655360.0 25000.00 FORMAT "%8.1" EXTENDED_LIMITS -655360.0 655340.0 /end CHARACTERISTIC
/begin CHARACTERISTIC LSU_uBattMaxLow_C "" VALUE 0x800636AC Val_Ws16 680360.0 Volt_Batt -655360.0 25000.00 FORMAT "%8.1" EXTENDED_LIMITS -655360.0 655340.0 /end CHARACTERISTIC
/begin CHARACTERISTIC LSU_uBattNominal_C "" VALUE 0x800636AE Val_Wu16 16000.00 Volt_Batt 0.00 16000.00 FORMAT "%8.2" EXTENDED_LIMITS 0.00 1310700. /end CHARACTERISTIC
/begin CHARACTERISTIC LSU_uMinClb_C "" VALUE 0x80063688 Val_Wu16 16000.00 Volt_Batt 0.00 16000.00 FORMAT "%8.2" EXTENDED_LIMITS 0.00 1310700. /end CHARACTERISTIC
/begin CHARACTERISTIC LSU_uO2ClbMax_C "" VALUE 0x80063700 Val_Ws16 13107.00 Volt -6553.600 6553.400 FORMAT "%8.3" /end CHARACTERISTIC
/begin CHARACTERISTIC LSU_uO2ClbMin_C "" VALUE 0x80063702 Val_Ws16 13107.00 Volt -6553.600 6553.400 FORMAT "%8.3" /end CHARACTERISTIC
/begin CHARACTERISTIC LSU_uO2MaxGrad_C "" VALUE 0x800637A0 Val_Ws16 13107.00 Volt -6553.600 6553.400 FORMAT "%8.3" /end CHARACTERISTIC
/begin CHARACTERISTIC LSU_uO2MaxRippel_C "" VALUE 0x800637A2 Val_Ws16 13107.00 Volt -6553.600 6553.400 FORMAT "%8.3" /end CHARACTERISTIC
/begin CHARACTERISTIC LSU_uO2Max_C "" VALUE 0x80063704 Val_Ws16 5000.000 Volt 0.00 5000.000 FORMAT "%8.3" EXTENDED_LIMITS -6553.600 6553.400 /end CHARACTERISTIC
/begin CHARACTERISTIC LSU_uO2Min_C "" VALUE 0x80063706 Val_Ws16 5000.000 Volt 0.00 5000.000 FORMAT "%8.3" EXTENDED_LIMITS -6553.600 6553.400 /end CHARACTERISTIC
/begin CHARACTERISTIC LSU_uO2Ref_C "" VALUE 0x80063708 Val_Ws16 5000.000 Volt 0.00 5000.000 FORMAT "%8.3" EXTENDED_LIMITS -6553.600 6553.400 /end CHARACTERISTIC
/begin CHARACTERISTIC LSU_uRiOfs_C "" VALUE 0x80063776 Val_Ws16 5000.000 Volt 0.00 5000.000 FORMAT "%8.3" EXTENDED_LIMITS -6553.600 6553.400 /end CHARACTERISTIC
/begin MEASUREMENT Alt_uAltLayer "" SWORD Volt_Batt 1 100 -655360.0 655340.0 FORMAT "%8.1" ECU_ADDRESS 0xD0006BF8 /end MEASUREMENT
/begin MEASUREMENT CoVeh_facCompTot "Absoluter Kompensationsfaktor" SWORD Fact 1 100 -4.000000 3.999878 FORMAT "%8.6" ECU_ADDRESS 0xD0006CCA /end MEASUREMENT
/begin MEASUREMENT CoVeh_facTrqDem "Kompensationsfaktor" SWORD Fact 1 100 -4.000000 3.999878 FORMAT "%8.6" ECU_ADDRESS 0xD0006CCC /end MEASUREMENT
/begin MEASUREMENT CoVeh_trqDesComp "Zu kompensierendes Verlustmoment" SWORD Trq 1 100 -3276.800 3276.700 FORMAT "%8.3" ECU_ADDRESS 0xD0006CD8 /end MEASUREMENT
/begin MEASUREMENT CoVeh_trqResv "Zu kompensierende Momentenreserve" SWORD Trq 1 100 -3276.800 3276.700 FORMAT "%8.3" ECU_ADDRESS 0xD0006CDC /end MEASUREMENT
/begin MEASUREMENT InjCtl_dAdjQntCS_mp "Checksumme der Mengenabgleichkennfeldwerte (im EEPROM abgelegt)" UBYTE OneToOne 1 100 0.00 255.0 FORMAT "%5.1" ECU_ADDRESS 0xC0000F34 /end MEASUREMENT
/begin MEASUREMENT InjCtl_dDriftCS_mp "Checksumme der Mengendriftkompensationswerte (im EEPROM abgelegt)" UBYTE OneToOne 1 100 0.00 255.0 FORMAT "%5.1" ECU_ADDRESS 0xC0000F35 /end MEASUREMENT
/begin MEASUREMENT InjCtl_facAdjSrvUnlim_mp "Serviceabgleich Faktor (im EEPROM abgelegt)" SWORD Fact 1 100 -4.000000 3.999878 FORMAT "%8.6" ECU_ADDRESS 0xC0000F36 /end MEASUREMENT
/begin MEASUREMENT InjCtl_facAdjSrv_mp "Serviceabgleichfaktor (nach Limitierung)" SWORD Fact 1 100 -4.000000 3.999878 FORMAT "%8.6" ECU_ADDRESS 0xC0000F38 /end MEASUREMENT
/begin MEASUREMENT InjCtl_qAdjQntUnlim_mp "Mengenabgleichwert vor Begrenzung" SWORD InjMassCyc 1 100 -327.6800 327.6700 FORMAT "%8.4" ECU_ADDRESS 0xC0000F3A /end MEASUREMENT
/begin MEASUREMENT InjCtl_qAdjQnt_mp "Mengenabgleichwert" SWORD InjMassCyc 1 100 -327.6800 327.6700 FORMAT "%8.4" ECU_ADDRESS 0xC0000F3C /end MEASUREMENT
/begin MEASUREMENT InjCtl_qCurr "Einspritzmenge aktueller Wert" SWORD InjMass 1 100 -327.6800 327.6700 FORMAT "%8.4" ECU_ADDRESS 0xD00072BC /end MEASUREMENT
/begin MEASUREMENT InjCtl_qCurrAdd_mp "Additiver Bypasseingrif für Einspritzmenge aktueller Wert" SWORD InjMass 1 100 -327.6800 327.6700 FORMAT "%8.4" ECU_ADDRESS 0xC0000F58 /end MEASUREMENT
/begin MEASUREMENT InjCtl_qCurrB1 "" SWORD InjMass 1 100 -327.6800 327.6700 FORMAT "%8.4" ECU_ADDRESS 0xD00072BE /end MEASUREMENT
/begin MEASUREMENT InjCtl_qCurrB2 "" SWORD InjMass 1 100 -327.6800 327.6700 FORMAT "%8.4" ECU_ADDRESS 0xD00072C0 /end MEASUREMENT
/begin MEASUREMENT InjCtl_qCurrByp_mp "Messpunkt zum Lesen der aktuellen Einspritzmenge über ASCET vor dem Bypass" SWORD InjMass 1 100 -327.6800 327.6700 FORMAT "%8.4" ECU_ADDRESS 0xC0000F3E /end MEASUREMENT
/begin MEASUREMENT InjCtl_qDriftComp_mp "Mengendriftkompensationswert" SWORD InjMassCyc 1 100 -327.6800 327.6700 FORMAT "%8.4" ECU_ADDRESS 0xC0000F40 /end MEASUREMENT
/begin MEASUREMENT InjCtl_qDriftLim1_mp "Mengendriftkompensationwert nach Begrenzung durch EEPROM-Werte" SWORD InjMassCyc 1 100 -327.6800 327.6700 FORMAT "%8.4" ECU_ADDRESS 0xC0000F42 /end MEASUREMENT
/begin MEASUREMENT InjCtl_qDriftLim2_mp "Mengendriftkompensationswert nach Begrenzung durch Datensatz" SWORD InjMassCyc 1 100 -327.6800 327.6700 FORMAT "%8.4" ECU_ADDRESS 0xC0000F44 /end MEASUREMENT
/begin MEASUREMENT InjCtl_qDriftMax1_mp "Mengendriftkompensationsbegrenzung (im EEPROM abgelegt)" SWORD InjMassCyc 1 100 -327.6800 327.6700 FORMAT "%8.4" ECU_ADDRESS 0xC0000F46 /end MEASUREMENT
/begin MEASUREMENT InjCtl_qDriftMin1_mp "Mengendriftkompensationsbegrenzung (im EEPROM abgelegt)" SWORD InjMassCyc 1 100 -327.6800 327.6700 FORMAT "%8.4" ECU_ADDRESS 0xC0000F48 /end MEASUREMENT
/begin MEASUREMENT InjCtl_qDriftUnlim_mp "Mengendriftkompensation unbegrenzt" SWORD InjMassCyc 1 100 -327.6800 327.6700 FORMAT "%8.4" ECU_ADDRESS 0xC0000F4A /end MEASUREMENT
/begin MEASUREMENT InjCtl_qLimSoftShOff_mp "soft shutoff limit" SWORD InjMassCyc 1 100 -327.6800 327.6700 FORMAT "%8.4" ECU_ADDRESS 0xC0000F4C /end MEASUREMENT
/begin MEASUREMENT InjCtl_qRaw "Einspritzmenge Rohwert" SWORD InjMass 1 100 -327.6800 327.6700 FORMAT "%8.4" ECU_ADDRESS 0xD00072C2 /end MEASUREMENT
/begin MEASUREMENT InjCtl_qRawAdd_mp "Additiver Bypasseingriff für den Rohwert der Einspritzmenge" SWORD InjMass 1 100 -327.6800 327.6700 FORMAT "%8.4" ECU_ADDRESS 0xC0000F5A /end MEASUREMENT
/begin MEASUREMENT InjCtl_qRawB1 "Einspritzmenge Rohwert Bank 1" SWORD InjMass 1 100 -327.6800 327.6700 FORMAT "%8.4" ECU_ADDRESS 0xD00072C4 /end MEASUREMENT
/begin MEASUREMENT InjCtl_qRawB2 "Einspritzmenge Rohwert Bank 2" SWORD InjMass 1 100 -327.6800 327.6700 FORMAT "%8.4" ECU_ADDRESS 0xD00072C6 /end MEASUREMENT
/begin MEASUREMENT InjCtl_qRawByp_mp "Messpunkt zum Lesen des Rohwertes der Einspritzmenge über ASCET vor dem Bypass" SWORD InjMass 1 100 -327.6800 327.6700 FORMAT "%8.4" ECU_ADDRESS 0xC0000F4E /end MEASUREMENT
/begin MEASUREMENT InjCtl_qSetUnBal "Einspritzmenge Sollwert ohne Mengenausgleichsregelung" SWORD InjMass 1 100 -327.6800 327.6700 FORMAT "%8.4" ECU_ADDRESS 0xD00072C8 /end MEASUREMENT
/begin MEASUREMENT InjCtl_qSetUnBalAdd_mp "Additiver Bypasseingriff für den Sollwert der Einspritzmenge" SWORD InjMass 1 100 -327.6800 327.6700 FORMAT "%8.4" ECU_ADDRESS 0xC0000F5C /end MEASUREMENT
/begin MEASUREMENT InjCtl_qSetUnBalB1 "" SWORD InjMass 1 100 -327.6800 327.6700 FORMAT "%8.4" ECU_ADDRESS 0xD00072CA /end MEASUREMENT
/begin MEASUREMENT InjCtl_qSetUnBalB2 "" SWORD InjMass 1 100 -327.6800 327.6700 FORMAT "%8.4" ECU_ADDRESS 0xD00072CC /end MEASUREMENT
/begin MEASUREMENT InjCtl_qSetUnBalByp_mp "Meßpunkt für Bypass" SWORD InjMass 1 100 -327.6800 327.6700 FORMAT "%8.4" ECU_ADDRESS 0xC0000F50 /end MEASUREMENT
/begin MEASUREMENT InjCtl_qSetUnCor_mp "Menge vor Eingriff von Mengenabgleich, Serviceabgleich, Mengendriftkompensation" SWORD InjMassCyc 1 100 -327.6800 327.6700 FORMAT "%8.4" ECU_ADDRESS 0xC0000F52 /end MEASUREMENT
/begin MEASUREMENT InjCtl_stAdjQnt_mp "Status vom Mengenabgleich" UBYTE OneToOne 1 100 0.00 255.0 FORMAT "%5.1" ECU_ADDRESS 0xC0000F54 /end MEASUREMENT
/begin MEASUREMENT InjCtl_tiEngOn_mp "Betriebsstundenzähler" SWORD TimeEngOnHrs 1 100 -596515.2 596497.0 FORMAT "%8.1" ECU_ADDRESS 0xC0000F56 /end MEASUREMENT
/begin MEASUREMENT InjCtl_trqInrLim "" SWORD Trq 1 100 -3276.800 3276.700 FORMAT "%8.3" ECU_ADDRESS 0xD00072CE /end MEASUREMENT
/begin MEASUREMENT InjSys_qInrCmb "Im Motor verbrannte Einspritzmenge" SWORD InjMass 1 100 -327.6800 327.6700 FORMAT "%8.4" ARRAY_SIZE 6 ECU_ADDRESS 0xD00072D0 /end MEASUREMENT
/begin MEASUREMENT InjSys_qLim "" SWORD InjMass 1 100 -327.6800 327.6700 FORMAT "%8.4" ECU_ADDRESS 0xD00072DC /end MEASUREMENT
/begin MEASUREMENT InjSys_qOutrCmb "Ausserhalb des Motors umgesetzte Einspritzmenge" SWORD InjMass 1 100 -327.6800 327.6700 FORMAT "%8.4" ARRAY_SIZE 6 ECU_ADDRESS 0xD00072DE /end MEASUREMENT
/begin MEASUREMENT InjSys_qTempFuel "Abhängige Einspritzungquantität der Kraftstofftemperatur" SWORD InjMass 1 100 -327.6800 327.6700 FORMAT "%8.4" ECU_ADDRESS 0xD00072EA /end MEASUREMENT
/begin MEASUREMENT InjSys_qTot "Gesamteinspritzmenge" SWORD InjMass 1 100 -327.6800 327.6700 FORMAT "%8.4" ECU_ADDRESS 0xD00072EC /end MEASUREMENT
/begin MEASUREMENT InjSys_st "" UWORD OneToOne 1 100 0.00 65535.00 FORMAT "%8.2" ECU_ADDRESS 0xD000766C /end MEASUREMENT
/begin MEASUREMENT InjSys_stCtlQnt "Status der Kontrollmenge" UBYTE OneToOne 1 100 0.00 255.0 FORMAT "%5.1" ECU_ADDRESS 0xD000909E /end MEASUREMENT
/begin MEASUREMENT InjSys_stqLimErrActive "" UBYTE OneToOne 1 100 0.00 255.0 FORMAT "%5.1" ECU_ADDRESS 0xD000922D /end MEASUREMENT
/begin MEASUREMENT InjSys_tEng "selektierte Motortemperatur für das Einspritzsystem" SWORD Temp_Cels 1 100 -3549.940 3003.560 FORMAT "%8.3" ECU_ADDRESS 0xD00072F0 /end MEASUREMENT
/begin MEASUREMENT InjSys_trqLoss "Verlustmoment des Einspritzsystems" SWORD Trq 1 100 -3276.800 3276.700 FORMAT "%8.3" ECU_ADDRESS 0xD00072F2 /end MEASUREMENT
/begin MEASUREMENT InjUn_stStrt "" UBYTE OneToOne 1 100 0.00 255.0 FORMAT "%5.1" ECU_ADDRESS 0xD000909F /end MEASUREMENT
/begin MEASUREMENT InjUn_stStrtCsBlk_mp "" UBYTE OneToOne 1 100 0.00 255.0 FORMAT "%5.1" ECU_ADDRESS 0xC0000F5E /end MEASUREMENT
/begin MEASUREMENT InjVlv_ctCylMI1_mp "Zylinder aktuell benutzt für 1. Haupteinspritzung" UBYTE OneToOne 1 100 0.00 255.0 FORMAT "%5.1" ECU_ADDRESS 0xC0000F84 /end MEASUREMENT
/begin MEASUREMENT InjVlv_ctCylMI2_mp "Zylinder aktuell benutzt für 2. Haupteinspritzung" UBYTE OneToOne 1 100 0.00 255.0 FORMAT "%5.1" ECU_ADDRESS 0xC0000F8C /end MEASUREMENT
/begin MEASUREMENT InjVlv_ctCylPiI1_mp "Zylindernummer zugehörend zur Voreinspritzung 1" UBYTE OneToOne 1 100 0.00 255.0 FORMAT "%5.1" ECU_ADDRESS 0xC0000F8D /end MEASUREMENT
/begin MEASUREMENT InjVlv_ctCylPiI2_mp "Zylindernummer zugehörend zur Voreinspritzung 2" UBYTE OneToOne 1 100 0.00 255.0 FORMAT "%5.1" ECU_ADDRESS 0xC0000F94 /end MEASUREMENT
/begin MEASUREMENT InjVlv_ctCylPiI3_mp "Zylindernummer zugehörend zur Voreinspritzung 3" UBYTE OneToOne 1 100 0.00 255.0 FORMAT "%5.1" ECU_ADDRESS 0xC0000F9C /end MEASUREMENT
/begin MEASUREMENT InjVlv_ctCylPoI1_mp "Zylindernummer zugehörend zur Nacheinspritzung 1" UBYTE OneToOne 1 100 0.00 255.0 FORMAT "%5.1" ECU_ADDRESS 0xC0000FA4 /end MEASUREMENT
/begin MEASUREMENT InjVlv_ctCylPoI2_mp "Zylindernummer zugehörend zur Nacheinspritzung 2" UBYTE OneToOne 1 100 0.00 255.0 FORMAT "%5.1" ECU_ADDRESS 0xC0000FAC /end MEASUREMENT
/begin MEASUREMENT InjVlv_ctMI1AgDiff_mp "Zähler für Winkelverletzungen bei Programmierung des Ansteuerbeginns der MI1" UWORD OneToOne 1 100 0.00 65535.00 FORMAT "%8.2" ECU_ADDRESS 0xC0000FBC /end MEASUREMENT
/begin MEASUREMENT InjVlv_ctPiI1AgDiff_mp "Zähler für Winkelverletzungen bei Programmierung des Ansteuerbeginns der PiI1" UWORD OneToOne 1 100 0.00 65535.00 FORMAT "%8.2" ECU_ADDRESS 0xC0000FC0 /end MEASUREMENT
/begin MEASUREMENT InjVlv_ctPiI2AgDiff_mp "Zähler für Winkelverletzungen bei Programmierung des Ansteuerbeginns der PiI2" UWORD OneToOne 1 100 0.00 65535.00 FORMAT "%8.2" ECU_ADDRESS 0xC0000FC4 /end MEASUREMENT
/begin MEASUREMENT InjVlv_ctPiI3AgDiff_mp "Zähler für Winkelverletzungen bei Programmierung des Ansteuerbeginns der PiI3" UWORD OneToOne 1 100 0.00 65535.00 FORMAT "%8.2" ECU_ADDRESS 0xC0000FC8 /end MEASUREMENT
/begin MEASUREMENT InjVlv_facAddBalRls "Ergebnis aus Freigabekennfeld zur Aufrechnung der Mengenkorrektur als Array (zylinderspezifisch)" SWORD Fact 1 100 -4.000000 3.999878 FORMAT "%8.6" ARRAY_SIZE 6 ECU_ADDRESS 0xD00072F4 /end MEASUREMENT
/begin MEASUREMENT InjVlv_numInjChrgBal_mp "Maximale Anzahl an Einspritzungen aufgrund der Ladungsbilanz des Boosterkondensators" UBYTE OneToOne 1 100 0.00 255.0 FORMAT "%5.1" ECU_ADDRESS 0xC0000F7C /end MEASUREMENT
/begin MEASUREMENT InjVlv_phiMI1Diff_mp "Winkeldifferenz zwischen dem gewünschten Ansteuerbeginn und dem systembed. frühesten Ansteuerbeginn der MI1" SWORD AngleCrS 1 100 -720.0220 720.0000 FORMAT "%8.4" ECU_ADDRESS 0xC0000FBE /end MEASUREMENT
/begin MEASUREMENT InjVlv_phiPiI1Diff_mp "Winkeldifferenz zwischen dem gewünschten Ansteuerbeginn und dem systembed. frühesten Ansteuerbeginn der PiI1" SWORD AngleCrS 1 100 -720.0220 720.0000 FORMAT "%8.4" ECU_ADDRESS 0xC0000FC2 /end MEASUREMENT
/begin MEASUREMENT InjVlv_phiPiI2Diff_mp "Winkeldifferenz zwischen dem gewünschten Ansteuerbeginn und dem systembed. frühesten Ansteuerbeginn der PiI2" SWORD AngleCrS 1 100 -720.0220 720.0000 FORMAT "%8.4" ECU_ADDRESS 0xC0000FC6 /end MEASUREMENT
/begin MEASUREMENT InjVlv_phiPiI3Diff_mp "Winkeldifferenz zwischen dem gewünschten Ansteuerbeginn und dem systembed. frühesten Ansteuerbeginn der PiI3" SWORD AngleCrS 1 100 -720.0220 720.0000 FORMAT "%8.4" ECU_ADDRESS 0xC0000FCA /end MEASUREMENT
/begin MEASUREMENT InjVlv_pInET_mp "X-Eingang des Kennfeldes InjVlv_tiET_MAP auf dem Applikationswerkzeug" SWORD Pres_Rail 1 100 -3276.800 2000.000 FORMAT "%5.3" ECU_ADDRESS 0xC0000F7E /end MEASUREMENT
/begin MEASUREMENT InjVlv_PsIcStIniDiag "" UWORD OneToOne 1 100 0.00 65535.00 FORMAT "%8.2" ARRAY_SIZE 1 ECU_ADDRESS 0xD000766E /end MEASUREMENT
/begin MEASUREMENT InjVlv_PsIcStIniTrans "" ULONG OneToOne 1 100 0.00 4294967295.00 FORMAT "%13.2" ARRAY_SIZE 1 ECU_ADDRESS 0xD00045A0 /end MEASUREMENT
/begin MEASUREMENT InjVlv_qInZFCETGMap_mp "Menge für Eingangsanzeige der Gruppenkennfelder InjVlv_rZFCETMsk_GMAP, ...Dif0_GMAP, ...Dif1_GMAP" SWORD InjMass 1 100 -327.6800 327.6700 FORMAT "%8.4" ECU_ADDRESS 0xC0001002 /end MEASUREMENT
/begin MEASUREMENT InjVlv_qMI1Bal_mp "Korrekturmenge Haupteinspritzung 1" SWORD InjMass 1 100 -327.6800 327.6700 FORMAT "%8.4" ECU_ADDRESS 0xC0000F60 /end MEASUREMENT
/begin MEASUREMENT InjVlv_qMI1Cor_mp "Korrigierte Menge der Haupteinspritzung 1" SWORD InjMass 1 100 -327.6800 327.6700 FORMAT "%8.4" ECU_ADDRESS 0xC0000F86 /end MEASUREMENT
/begin MEASUREMENT InjVlv_qPiI1Bal_mp "Korrekturmenge Voreinspritzung 1" SWORD InjMass 1 100 -327.6800 327.6700 FORMAT "%8.4" ECU_ADDRESS 0xC0000F62 /end MEASUREMENT
/begin MEASUREMENT InjVlv_qPiI1Cor_mp "Korrigierte Menge der Voreinspritzung 1" SWORD InjMass 1 100 -327.6800 327.6700 FORMAT "%8.4" ECU_ADDRESS 0xC0000F8E /end MEASUREMENT
/begin MEASUREMENT InjVlv_qPiI2Bal_mp "Korrekturmenge Voreinspritzung 2" SWORD InjMass 1 100 -327.6800 327.6700 FORMAT "%8.4" ECU_ADDRESS 0xC0000F64 /end MEASUREMENT
/begin MEASUREMENT InjVlv_qPiI2Cor_mp "Korrigierte Menge der Voreinspritzung 2" SWORD InjMass 1 100 -327.6800 327.6700 FORMAT "%8.4" ECU_ADDRESS 0xC0000F96 /end MEASUREMENT
/begin MEASUREMENT InjVlv_qPiI3Bal_mp "Korrekturmenge Voreinspritzung 3" SWORD InjMass 1 100 -327.6800 327.6700 FORMAT "%8.4" ECU_ADDRESS 0xC0000F66 /end MEASUREMENT
/begin MEASUREMENT InjVlv_qPiI3Cor_mp "Korrigierte Menge der Voreinspritzung 3" SWORD InjMass 1 100 -327.6800 327.6700 FORMAT "%8.4" ECU_ADDRESS 0xC0000F9E /end MEASUREMENT
/begin MEASUREMENT InjVlv_qPoI1Bal_mp "Korrekturmenge Nacheinspritzung 1" SWORD InjMass 1 100 -327.6800 327.6700 FORMAT "%8.4" ECU_ADDRESS 0xC0000F68 /end MEASUREMENT
/begin MEASUREMENT InjVlv_qPoI1Cor_mp "Korrigierte Menge der Nacheinspritzung 1" SWORD InjMass 1 100 -327.6800 327.6700 FORMAT "%8.4" ECU_ADDRESS 0xC0000FA6 /end MEASUREMENT
/begin MEASUREMENT InjVlv_qPoI2BalEff_mp "Korrekturmenge für Nacheinspritzung 2, Moment bildender Teil" SWORD InjMass 1 100 -327.6800 327.6700 FORMAT "%8.4" ECU_ADDRESS 0xC0000F6A /end MEASUREMENT
/begin MEASUREMENT InjVlv_qPoI2Bal_mp "Korrekturmenge Nacheinspritzung 2" SWORD InjMass 1 100 -327.6800 327.6700 FORMAT "%8.4" ECU_ADDRESS 0xC0000F6C /end MEASUREMENT
/begin MEASUREMENT InjVlv_qPoI2Cor_mp "Korrigierte Menge der Nacheinspritzung 2" SWORD InjMass 1 100 -327.6800 327.6700 FORMAT "%8.4" ECU_ADDRESS 0xC0000FAE /end MEASUREMENT
/begin MEASUREMENT InjVlv_rZFCETCoeffDif_mp "Bewertungsfaktoren für Ansteuerdauerkorrektur durch Nullmengenkalibrierung" SWORD Prc 1 100 -400.0000 399.9878 FORMAT "%8.4" ARRAY_SIZE 2 ECU_ADDRESS 0xC0001004 /end MEASUREMENT
/begin MEASUREMENT InjVlv_rZFCETCoeffMsk_mp "Gesamtbewertungsfaktor der Ansteuerdauerkorrektur durch Nullmengenkalibrierung" SWORD Prc 1 100 -400.0000 399.9878 FORMAT "%8.4" ECU_ADDRESS 0xC0001008 /end MEASUREMENT
/begin MEASUREMENT InjVlv_st "Allgemeine Statusbotschaft des Einspritzventils" UBYTE OneToOne 1 100 0.00 255.0 FORMAT "%5.1" ECU_ADDRESS 0xD00090A0 /end MEASUREMENT
/begin MEASUREMENT InjVlv_stInjCharComp "status der Kompensation der freigegebenen Einspritzungen" UBYTE OneToOne 1 100 0.00 255.0 FORMAT "%5.1" ECU_ADDRESS 0xD00090A1 /end MEASUREMENT
/begin MEASUREMENT InjVlv_stInjCo "Zustand des Ansteuerkoorinators" UBYTE OneToOne 1 100 0.00 255.0 FORMAT "%5.1" ECU_ADDRESS 0xD0008EEE /end MEASUREMENT
/begin MEASUREMENT InjVlv_stInjCoRun_mp "Zustand: Bearbeitete Zustände von InjVlv_stInjCo" UWORD OneToOne 1 100 0.00 65535.00 FORMAT "%8.2" ECU_ADDRESS 0xC0000F82 /end MEASUREMENT
/begin MEASUREMENT InjVlv_stInjMI1_mp "Status der Haupteinspritzung-1-Programmierung" UBYTE OneToOne 1 100 0.00 255.0 FORMAT "%5.1" ECU_ADDRESS 0xC0000FB4 /end MEASUREMENT
/begin MEASUREMENT InjVlv_stInjMI2_mp "Status der Haupteinspritzung-2-Programmierung" UBYTE OneToOne 1 100 0.00 255.0 FORMAT "%5.1" ECU_ADDRESS 0xC0000FB5 /end MEASUREMENT
/begin MEASUREMENT InjVlv_stInjPiI1_mp "Status der Voreinspritzung-1-Programmierung" UBYTE OneToOne 1 100 0.00 255.0 FORMAT "%5.1" ECU_ADDRESS 0xC0000FB6 /end MEASUREMENT
/begin MEASUREMENT InjVlv_stInjPiI2_mp "Status der Voreinspritzung-2-Programmierung" UBYTE OneToOne 1 100 0.00 255.0 FORMAT "%5.1" ECU_ADDRESS 0xC0000FB7 /end MEASUREMENT
/begin MEASUREMENT InjVlv_stInjPiI3_mp "Status der Voreinspritzung-3-Programmierung" UBYTE OneToOne 1 100 0.00 255.0 FORMAT "%5.1" ECU_ADDRESS 0xC0000FB8 /end MEASUREMENT
/begin MEASUREMENT InjVlv_stInjPoI1_mp "Status der Nacheinspritzung-1-Programmierung" UBYTE OneToOne 1 100 0.00 255.0 FORMAT "%5.1" ECU_ADDRESS 0xC0000FB9 /end MEASUREMENT
/begin MEASUREMENT InjVlv_stInjPoI2_mp "Status der Nacheinspritzung-2-Programmierung" UBYTE OneToOne 1 100 0.00 255.0 FORMAT "%5.1" ECU_ADDRESS 0xC0000FBA /end MEASUREMENT
/begin MEASUREMENT InjVlv_stInjRls "status der freigegebenen Einspritzungen" UBYTE OneToOne 1 100 0.00 255.0 FORMAT "%5.1" ARRAY_SIZE 6 ECU_ADDRESS 0xD00090A2 /end MEASUREMENT
/begin MEASUREMENT InjVlv_stInjZFC_mp "Status der ZFC Programmierung" UBYTE OneToOne 1 100 0.00 255.0 FORMAT "%5.1" ECU_ADDRESS 0xC0000FBB /end MEASUREMENT
/begin MEASUREMENT InjVlv_stPsIcChipVer_mp "" UBYTE OneToOne 1 100 0.00 255.0 FORMAT "%5.1" ARRAY_SIZE 1 ECU_ADDRESS 0xC0000FCD /end MEASUREMENT
/begin MEASUREMENT InjVlv_stPsIcDia_mp "" UWORD OneToOne 1 100 0.00 65535.00 FORMAT "%8.2" ARRAY_SIZE 1 ECU_ADDRESS 0xC0000FD4 /end MEASUREMENT
/begin MEASUREMENT InjVlv_stPsIcIni_mp "" ULONG OneToOne 1 100 0.00 4294967295.00 FORMAT "%13.2" ARRAY_SIZE 1 ECU_ADDRESS 0xC0000FD0 /end MEASUREMENT
/begin MEASUREMENT InjVlv_stPsIcNumBnkPcP_mp "" ULONG OneToOne 1 100 0.00 4294967295.00 FORMAT "%13.2" ARRAY_SIZE 1 ECU_ADDRESS 0xC0000FD8 /end MEASUREMENT
/begin MEASUREMENT InjVlv_stPsIcNumBnk_mp "" ULONG OneToOne 1 100 0.00 4294967295.00 FORMAT "%13.2" ARRAY_SIZE 1 ECU_ADDRESS 0xC0000FDC /end MEASUREMENT
/begin MEASUREMENT InjVlv_stPsIcNumChipPcP_mp "" ULONG OneToOne 1 100 0.00 4294967295.00 FORMAT "%13.2" ARRAY_SIZE 1 ECU_ADDRESS 0xC0000FE0 /end MEASUREMENT
/begin MEASUREMENT InjVlv_stPsIcNumChip_mp "" ULONG OneToOne 1 100 0.00 4294967295.00 FORMAT "%13.2" ARRAY_SIZE 1 ECU_ADDRESS 0xC0000FE4 /end MEASUREMENT
/begin MEASUREMENT InjVlv_stPsIcNumDatEx_mp "" ULONG OneToOne 1 100 0.00 4294967295.00 FORMAT "%13.2" ECU_ADDRESS 0xC0000FE8 /end MEASUREMENT
/begin MEASUREMENT InjVlv_stPsIcNumTrgTra_mp "" ULONG OneToOne 1 100 0.00 4294967295.00 FORMAT "%13.2" ECU_ADDRESS 0xC0000FEC /end MEASUREMENT
/begin MEASUREMENT InjVlv_stPsIcRdBufIdx_mp "" UBYTE OneToOne 1 100 0.00 255.0 FORMAT "%5.1" ARRAY_SIZE 1 ECU_ADDRESS 0xC0000FF0 /end MEASUREMENT
/begin MEASUREMENT InjVlv_stPsIcStBufDatEx_mp "" ULONG OneToOne 1 100 0.00 4294967295.00 FORMAT "%13.2" ARRAY_SIZE 1 ECU_ADDRESS 0xC0000FF4 /end MEASUREMENT
/begin MEASUREMENT InjVlv_stPsIcStBufTraInj_mp "" ULONG OneToOne 1 100 0.00 4294967295.00 FORMAT "%13.2" ARRAY_SIZE 1 ECU_ADDRESS 0xC0000FF8 /end MEASUREMENT
/begin MEASUREMENT InjVlv_stPsIcTra_mp "" ULONG OneToOne 1 100 0.00 4294967295.00 FORMAT "%13.2" ARRAY_SIZE 1 ECU_ADDRESS 0xC0000FFC /end MEASUREMENT
/begin MEASUREMENT InjVlv_stPsIcWrBufIdx_mp "" UBYTE OneToOne 1 100 0.00 255.0 FORMAT "%5.1" ARRAY_SIZE 1 ECU_ADDRESS 0xC0001000 /end MEASUREMENT
/begin MEASUREMENT InjVlv_stTCtlInj_mp "" UBYTE OneToOne 1 100 0.00 255.0 FORMAT "%5.1" ECU_ADDRESS 0xC0000FCC /end MEASUREMENT
/begin MEASUREMENT InjVlv_tiMI1ETUnLim_mp "unbegrenzte Ansteuerdauer MI" SWORD InjTime_us 1 100 -13107.20 5000.00 FORMAT "%8.2" ECU_ADDRESS 0xC0000F6E /end MEASUREMENT
/begin MEASUREMENT InjVlv_tiMI1ET_mp "Ansteuerdauer MI" SWORD InjTime_us 1 100 -13107.20 5000.00 FORMAT "%8.2" ECU_ADDRESS 0xC0000F70 /end MEASUREMENT
/begin MEASUREMENT InjVlv_tiPiI1ET_mp "Ansteuerdauer der Voreinspritzung 1" SWORD InjTime_us 1 100 -13107.20 5000.00 FORMAT "%8.2" ECU_ADDRESS 0xC0000F72 /end MEASUREMENT
/begin MEASUREMENT InjVlv_tiPiI1ZFCETCor_mp "Ansteuerdauerkorrektur der ZFC für Voreinspritzung 1 und jeden Zylinder" SWORD InjTime_us 1 100 -13107.20 5000.00 FORMAT "%8.2" ARRAY_SIZE 6 ECU_ADDRESS 0xC000100A /end MEASUREMENT
/begin MEASUREMENT InjVlv_tiPiI2ET_mp "Ansteuerdauer PiI2" SWORD InjTime_us 1 100 -13107.20 5000.00 FORMAT "%8.2" ECU_ADDRESS 0xC0000F74 /end MEASUREMENT
/begin MEASUREMENT InjVlv_tiPiI2ZFCETCor_mp "Ansteuerdauerkorrektur der ZFC für Voreinspritzung 2 und jeden Zylinder" SWORD InjTime_us 1 100 -13107.20 5000.00 FORMAT "%8.2" ARRAY_SIZE 6 ECU_ADDRESS 0xC0001016 /end MEASUREMENT
/begin MEASUREMENT InjVlv_tiPiI3ET_mp "Ansteuerdauer PiI3" SWORD InjTime_us 1 100 -13107.20 5000.00 FORMAT "%8.2" ECU_ADDRESS 0xC0000F76 /end MEASUREMENT
/begin MEASUREMENT InjVlv_tiPiI3ZFCETCor_mp "Ansteuerdauerkorrektur der ZFC für Voreinspritzung 3 und jeden Zylinder" SWORD InjTime_us 1 100 -13107.20 5000.00 FORMAT "%8.2" ARRAY_SIZE 6 ECU_ADDRESS 0xC0001022 /end MEASUREMENT
/begin MEASUREMENT InjVlv_tiPoI1ET_mp "Ansteuerdauer PoI1" SWORD InjTime_us 1 100 -13107.20 5000.00 FORMAT "%8.2" ECU_ADDRESS 0xC0000F78 /end MEASUREMENT
/begin MEASUREMENT InjVlv_tiPoI2ET_mp "Ansteuerdauer PoI2" SWORD InjTime_us 1 100 -13107.20 5000.00 FORMAT "%8.2" ECU_ADDRESS 0xC0000F7A /end MEASUREMENT
/begin MEASUREMENT InjVlv_tiPse "feste oder gemessene Mindestzeit zwischen 2 Einspritzungen" SWORD InjTime_us 1 100 -13107.20 5000.00 FORMAT "%8.2" ECU_ADDRESS 0xD0007300 /end MEASUREMENT
/begin MEASUREMENT InjVlv_tiZFCPiI1ETCor "ZFC Ansteuerdauerkorrektur für Voreinspritzung 1" SWORD InjTime_us 1 100 -13107.20 5000.00 FORMAT "%8.2" ECU_ADDRESS 0xD0007302 /end MEASUREMENT
/begin MEASUREMENT InjVlv_tiZFCPiI2ETCor "korrigierte Ansteuerdauer PiI2" SWORD InjTime_us 1 100 -13107.20 5000.00 FORMAT "%8.2" ECU_ADDRESS 0xD0007304 /end MEASUREMENT
/begin MEASUREMENT InjVlv_tiZFCPiI3ETCor "korrigierte Ansteuerdauer PiI3" SWORD InjTime_us 1 100 -13107.20 5000.00 FORMAT "%8.2" ECU_ADDRESS 0xD0007306 /end MEASUREMENT
/begin MEASUREMENT InjVlv_volInET_mp "Y-Eingang des Kennfeldes InjVlv_tiET_MAP auf dem Applikationswerkzeug" SWORD InjQntInj 1 100 -327.6800 327.6700 FORMAT "%8.4" ECU_ADDRESS 0xC0000F80 /end MEASUREMENT
/begin MEASUREMENT InjVlv_volMI1CorCyc "zylinderspezifisches Korrekturvolumen aus Mengenausgleichsregelung und Injektor-Abgleichmenge für MI1" SWORD InjQntInj 1 100 -327.6800 327.6700 FORMAT "%8.4" ARRAY_SIZE 6 ECU_ADDRESS 0xD0007308 /end MEASUREMENT
/begin MEASUREMENT InjVlv_volMI1Cor_mp "Korrigierte Menge der Haupteinspritzung 1" SWORD InjQntInj 1 100 -327.6800 327.6700 FORMAT "%8.4" ECU_ADDRESS 0xC0000F88 /end MEASUREMENT
/begin MEASUREMENT InjVlv_volMI1_mp "Einspritzvolumen der Haupteinspritzung 1 nach Mengenabgleich" SWORD InjQntInj 1 100 -327.6800 327.6700 FORMAT "%8.4" ECU_ADDRESS 0xC0000F8A /end MEASUREMENT
/begin MEASUREMENT InjVlv_volPiI1CorCyc "zylinderspezifisches Korrekturvolumen aus Mengenausgleichsregelung und Injektor-Abgleichmenge für PiI1" SWORD InjQntInj 1 100 -327.6800 327.6700 FORMAT "%8.4" ARRAY_SIZE 6 ECU_ADDRESS 0xD0007314 /end MEASUREMENT
/begin MEASUREMENT InjVlv_volPiI1Cor_mp "Korrigiertes Volumen der Voreinspritzung 1" SWORD InjQntInj 1 100 -327.6800 327.6700 FORMAT "%8.4" ECU_ADDRESS 0xC0000F90 /end MEASUREMENT
/begin MEASUREMENT InjVlv_volPiI1_mp "Einspritzvolumen der Voreinspritzung 1 nach Mengenabgleich" SWORD InjQntInj 1 100 -327.6800 327.6700 FORMAT "%8.4" ECU_ADDRESS 0xC0000F92 /end MEASUREMENT
/begin MEASUREMENT InjVlv_volPiI2CorCyc "zylinderspezifisches Korrekturvolumen aus Mengenausgleichsregelung und Injektor-Abgleichmenge für PiI2" SWORD InjQntInj 1 100 -327.6800 327.6700 FORMAT "%8.4" ARRAY_SIZE 6 ECU_ADDRESS 0xD0007320 /end MEASUREMENT
/begin MEASUREMENT InjVlv_volPiI2Cor_mp "Korrigiertes Volumen der Voreinspritzung 2" SWORD InjQntInj 1 100 -327.6800 327.6700 FORMAT "%8.4" ECU_ADDRESS 0xC0000F98 /end MEASUREMENT
/begin MEASUREMENT InjVlv_volPiI2_mp "Einspritzvolumen der Voreinspritzung 2 nach Mengenabgleich" SWORD InjQntInj 1 100 -327.6800 327.6700 FORMAT "%8.4" ECU_ADDRESS 0xC0000F9A /end MEASUREMENT
/begin MEASUREMENT InjVlv_volPiI3Cor_mp "Korrigierte Menge der Voreinspritzung 3" SWORD InjQntInj 1 100 -327.6800 327.6700 FORMAT "%8.4" ECU_ADDRESS 0xC0000FA0 /end MEASUREMENT
/begin MEASUREMENT InjVlv_volPiI3_mp "Korrigiertes Volumen der Voreinspritzung 3" SWORD InjQntInj 1 100 -327.6800 327.6700 FORMAT "%8.4" ECU_ADDRESS 0xC0000FA2 /end MEASUREMENT
/begin MEASUREMENT InjVlv_volPoI1Cor_mp "Korrigiertes Volumen der Nacheinspritzung 1" SWORD InjQntInj 1 100 -327.6800 327.6700 FORMAT "%8.4" ECU_ADDRESS 0xC0000FA8 /end MEASUREMENT
/begin MEASUREMENT InjVlv_volPoI1_mp "Einspritzvolumen der Nacheinspritzung 1 nach Mengenabgleich" SWORD InjQntInj 1 100 -327.6800 327.6700 FORMAT "%8.4" ECU_ADDRESS 0xC0000FAA /end MEASUREMENT
/begin MEASUREMENT InjVlv_volPoI2Cor_mp "Korrigiertes Volumen der Nacheinspritzung 2" SWORD InjQntInj 1 100 -327.6800 327.6700 FORMAT "%8.4" ECU_ADDRESS 0xC0000FB0 /end MEASUREMENT
/begin MEASUREMENT InjVlv_volPoI2_mp "Einspritzvolumen der Nacheinspritzung 2 nach Mengenabgleich" SWORD InjQntInj 1 100 -327.6800 327.6700 FORMAT "%8.4" ECU_ADDRESS 0xC0000FB2 /end MEASUREMENT
/begin MEASUREMENT ISC_dnAccLimCurr_mp "Maximale zulässige Beschleunigung (Motordrehzahl)" FLOAT32_IEEE ISC_dnEng_float 1 100 0.00 12000.0000 FORMAT "%10.4" ECU_ADDRESS 0xC0001068 /end MEASUREMENT
/begin MEASUREMENT ISC_dnDeclLimCurr_mp "Maximale zulässige Verzögerung (Motordrehzahl)" FLOAT32_IEEE ISC_dnEng_float 1 100 -12000.0000 0.00 FORMAT "%10.4" ECU_ADDRESS 0xC000106C /end MEASUREMENT
/begin MEASUREMENT ISC_InrtDrvTrnCurr_mp "Massenträgheitsmoment vom Antriebstarng inkl. Motor" FLOAT32_IEEE ISC_Inirtia_float 1 100 0.00 20.0000000 FORMAT "%10.7" ECU_ADDRESS 0xC0001070 /end MEASUREMENT
/begin MEASUREMENT ISC_InrtDrvTrnSet_mp "Massenträgheitsmoment des Fahrzeuges ohne Motor" FLOAT32_IEEE ISC_Inirtia_float 1 100 0.00 20.0000000 FORMAT "%10.7" ECU_ADDRESS 0xC0001074 /end MEASUREMENT
/begin MEASUREMENT ISC_InrtEngCurr_mp "Massenträgheitsmoment des offenen Antriebstrang" FLOAT32_IEEE ISC_Inirtia_float 1 100 0.00 20.0000000 FORMAT "%10.7" ECU_ADDRESS 0xC0001078 /end MEASUREMENT
/begin MEASUREMENT ISC_InrtVehCurr_mp "Massenträgheitsmoment vom gesamten Fahrzeug" FLOAT32_IEEE ISC_Inirtia_float 1 100 0.00 20.0000000 FORMAT "%10.7" ECU_ADDRESS 0xC000107C /end MEASUREMENT
/begin MEASUREMENT ISC_InrtVehSet_mp "Massenträgheitsmoment des Fahrzeuges ohne Antriebstrang" FLOAT32_IEEE ISC_Inirtia_float 1 100 0.00 20.0000000 FORMAT "%10.7" ECU_ADDRESS 0xC0001080 /end MEASUREMENT
/begin MEASUREMENT ISC_IWinNegLoCurr_mp "aktuelles negatives Kleinsignalfenster I-Anteil unterer Pfad" FLOAT32_IEEE EngN_float 1 100 -6000.00000 6000.00000 FORMAT "%10.5" ECU_ADDRESS 0xC0001084 /end MEASUREMENT
/begin MEASUREMENT ISC_IWinPosLoCurr_mp "aktuelles positives Kleinsignalfenster I-Anteil unterer Pfad" FLOAT32_IEEE EngN_float 1 100 -6000.00000 6000.00000 FORMAT "%10.5" ECU_ADDRESS 0xC0001088 /end MEASUREMENT
/begin MEASUREMENT ISC_KiLoCurr_mp "aktuelle Kleinsignalverstärkung I-Anteil unterer Pfad" FLOAT32_IEEE ISC_Ki_rpm2Nm_float 1 100 0.00 20.0000000 FORMAT "%10.7" ECU_ADDRESS 0xC000108C /end MEASUREMENT
/begin MEASUREMENT ISC_KiNegLoCurr_mp "aktuelle Großsignalverstärkung (negativ) I-Anteil unterer Pfad" FLOAT32_IEEE ISC_Ki_rpm2Nm_float 1 100 0.00 20.0000000 FORMAT "%10.7" ECU_ADDRESS 0xC0001090 /end MEASUREMENT
/begin MEASUREMENT ISC_KiPosLoCurr_mp "aktuelle Großsignalverstärkung (positiv) I-Anteil unterer Pfad" FLOAT32_IEEE ISC_Ki_rpm2Nm_float 1 100 0.00 20.0000000 FORMAT "%10.7" ECU_ADDRESS 0xC0001094 /end MEASUREMENT
/begin MEASUREMENT ISC_KpHiCurr_mp "aktuelle Kleinsignalverstärkung P-Anteil oberer Pfad" FLOAT32_IEEE ISC_Kp_rpm2Nm_float 1 100 0.00 20.0000000 FORMAT "%10.7" ECU_ADDRESS 0xC0001030 /end MEASUREMENT
/begin MEASUREMENT ISC_KpLoCurr_mp "aktuelle Kleinsignalverstärkung P-Anteil unterer Pfad" FLOAT32_IEEE ISC_Kp_rpm2Nm_float 1 100 0.00 20.0000000 FORMAT "%10.7" ECU_ADDRESS 0xC0001098 /end MEASUREMENT
/begin MEASUREMENT ISC_KpNegHiCurr_mp "aktuelles negatives Kleinsignalfenster P-Anteil oberer Pfad" FLOAT32_IEEE ISC_Kp_rpm2Nm_float 1 100 0.00 20.0000000 FORMAT "%10.7" ECU_ADDRESS 0xC0001034 /end MEASUREMENT
/begin MEASUREMENT ISC_KpNegLoCurr_mp "aktuelles negatives Kleinsignalfenster P-Anteil unterer Pfad" FLOAT32_IEEE ISC_Kp_rpm2Nm_float 1 100 0.00 20.0000000 FORMAT "%10.7" ECU_ADDRESS 0xC000109C /end MEASUREMENT
/begin MEASUREMENT ISC_KpPosHiCurr_mp "aktuelles positives Kleinsignalfenster P-Anteil oberer Pfad" FLOAT32_IEEE ISC_Kp_rpm2Nm_float 1 100 0.00 20.0000000 FORMAT "%10.7" ECU_ADDRESS 0xC0001038 /end MEASUREMENT
/begin MEASUREMENT ISC_KpPosLoCurr_mp "aktuelles positives Kleinsignalfenster P-Anteil unterer Pfad" FLOAT32_IEEE ISC_Kp_rpm2Nm_float 1 100 0.00 20.0000000 FORMAT "%10.7" ECU_ADDRESS 0xC00010A0 /end MEASUREMENT
/begin MEASUREMENT ISC_nAvrgPT1Out_mp "PT1 gefilterte Motordrehzahl" FLOAT32_IEEE EngN_float 1 100 0.00 6000.00000 FORMAT "%10.5" ECU_ADDRESS 0xC00010A4 /end MEASUREMENT
/begin MEASUREMENT ISC_nAvrgPT2Out_mp "PT2 gefilterte Motordrehzahl" FLOAT32_IEEE EngN_float 1 100 0.00 6000.00000 FORMAT "%10.5" ECU_ADDRESS 0xC00010A8 /end MEASUREMENT
/begin MEASUREMENT ISC_nDiffHi_mp "Regelabweichung zur oberen Drehzahlgrenze" FLOAT32_IEEE EngN_float 1 100 -6000.00000 6000.00000 FORMAT "%10.5" ECU_ADDRESS 0xC000103C /end MEASUREMENT
/begin MEASUREMENT ISC_nDiffLoFlt_mp "Regelabweichung zwischen unterer Solldrehzahl und aktueller Motordrehzahl für die Berechnung der PT1-Filterzeitkonstanten" SWORD EngN 1 100 -16384.00 16383.50 FORMAT "%8.2" ECU_ADDRESS 0xC0001100 /end MEASUREMENT
/begin MEASUREMENT ISC_nDiffLo_mp "Regelabweichung zur unteren Drehzahlgrenze" FLOAT32_IEEE EngN_float 1 100 -6000.00000 6000.00000 FORMAT "%10.5" ECU_ADDRESS 0xC00010AC /end MEASUREMENT
/begin MEASUREMENT ISC_nEngPT2Ftl "" FLOAT32_IEEE EngN_float 1 100 0.00 6000.00000 FORMAT "%10.5" ECU_ADDRESS 0xD00042A4 /end MEASUREMENT
/begin MEASUREMENT ISC_nInTra_mp "Getriebeeingangdrehzahl zur Berechnung der Beschleunigung Moment" FLOAT32_IEEE EngN_float 1 100 0.00 6000.00000 FORMAT "%10.5" ECU_ADDRESS 0xC00010B0 /end MEASUREMENT
/begin MEASUREMENT ISC_nSetPHi "Obergrenze Drehzahlintervall (Maximaldrehzahl) des ISC" SWORD EngN 1 100 -16384.00 16383.50 FORMAT "%8.2" ECU_ADDRESS 0xD0006FAC /end MEASUREMENT
/begin MEASUREMENT ISC_nSetPLo "Untergrenze Drehzahlintervall (Solldrehzahl) des ISC" SWORD EngN 1 100 -16384.00 16383.50 FORMAT "%8.2" ECU_ADDRESS 0xD0006FAE /end MEASUREMENT
/begin MEASUREMENT ISC_numCurrFunc "Identifikationsname / -nummer des aktuell aktiven ISC Clients, der die aktuellen Reglerparameter bestimmt" SWORD ISCCurrFu 1 100 -1.00000000000 128.000000000 FORMAT "%13.9" ECU_ADDRESS 0xD0006FB0 /end MEASUREMENT
/begin MEASUREMENT ISC_numCurrFuncSetPHi "Identifikationsname / -nummer des ISC Clients, der die obere Drehzahlgrenze bestimmt" SWORD ISCCurrFu 1 100 -1.00000000000 128.000000000 FORMAT "%13.9" ECU_ADDRESS 0xD0006FB2 /end MEASUREMENT
/begin MEASUREMENT ISC_numCurrFuncSetPLo "Identifikationsname / -nummer des ISC Clients, der die untere Drehzahlgrenze bestimmt" SWORD ISCCurrFu 1 100 -1.00000000000 128.000000000 FORMAT "%13.9" ECU_ADDRESS 0xD0006FB4 /end MEASUREMENT
/begin MEASUREMENT ISC_nVehBd_mp "Motordrehzahl berechnet aus Fahrzeuggeschwingdigkeit zur Berechnung vom Beschleunigungsmoments" FLOAT32_IEEE EngN_float 1 100 0.00 6000.00000 FORMAT "%10.5" ECU_ADDRESS 0xC00010B4 /end MEASUREMENT
/begin MEASUREMENT ISC_PWinNegHiCurr_mp "aktuelles negatives Kleinsignalfenster P-Anteil oberer Pfad" FLOAT32_IEEE EngN_float 1 100 -6000.00000 6000.00000 FORMAT "%10.5" ECU_ADDRESS 0xC0001040 /end MEASUREMENT
/begin MEASUREMENT ISC_PWinNegLoCurr_mp "aktuelles negatives Kleinsignalfenster P-Anteil unterer Pfad" FLOAT32_IEEE EngN_float 1 100 -6000.00000 6000.00000 FORMAT "%10.5" ECU_ADDRESS 0xC00010B8 /end MEASUREMENT
/begin MEASUREMENT ISC_PWinPosHiCurr_mp "aktuelles positives Kleinsignalfenster P-Anteil oberer Pfad" FLOAT32_IEEE EngN_float 1 100 -6000.00000 6000.00000 FORMAT "%10.5" ECU_ADDRESS 0xC0001044 /end MEASUREMENT
/begin MEASUREMENT ISC_PWinPosLoCurr_mp "aktuelles positives Kleinsignalfenster P-Anteil unterer Pfad" FLOAT32_IEEE EngN_float 1 100 -6000.00000 6000.00000 FORMAT "%10.5" ECU_ADDRESS 0xC00010BC /end MEASUREMENT
/begin MEASUREMENT ISC_rnEngvVehCurr_mp "Verhältnis Motordrehzahl zu Fahrzeuggeschwindigkeit" FLOAT32_IEEE ISC_rnEng2vVeh_float 1 100 0.00 1000.00000 FORMAT "%10.5" ECU_ADDRESS 0xC00010C0 /end MEASUREMENT
/begin MEASUREMENT ISC_st "Statusinformation des ISC und seiner Clients" ULONG OneToOne 1 100 0.00 4294967295.00 FORMAT "%13.2" ARRAY_SIZE 3 ECU_ADDRESS 0xC0001104 /end MEASUREMENT
/begin MEASUREMENT ISC_stExtIni_mp "aktuelle Initialisierungsart" SWORD OneToOne 1 100 -32768.00 32767.00 FORMAT "%8.2" ECU_ADDRESS 0xC00010C4 /end MEASUREMENT
/begin MEASUREMENT ISC_stHiLo_mp "Zustand der Drehzahlbereich, in dem sich der Motordrehzahl befindet" UBYTE OneToOne 1 100 0.00 255.0 FORMAT "%5.1" ECU_ADDRESS 0xC0001048 /end MEASUREMENT
/begin MEASUREMENT ISC_stPthSel_mp "aktuelle Aufschalstrategie der beiden ISC-Pfade" UBYTE OneToOne 1 100 0.00 255.0 FORMAT "%5.1" ECU_ADDRESS 0xC0001049 /end MEASUREMENT
/begin MEASUREMENT ISC_tiFltLosTrqEstCurr_mp "Zeitkonstante für die Lastmomentabschaltzung (PT1-Glieder)" FLOAT32_IEEE ISC_tiPTsTrqLoss_float 1 100 0.00 60.0000000 FORMAT "%10.7" ECU_ADDRESS 0xC00010C8 /end MEASUREMENT
/begin MEASUREMENT ISC_tiFltnEngCurr_mp "Zeitkonstante für die PT2-Filterung der Motordrehzahl" FLOAT32_IEEE ISC_tiPT2nEng_float 1 100 0.00 60.0000000 FORMAT "%10.7" ECU_ADDRESS 0xC00010CC /end MEASUREMENT
/begin MEASUREMENT ISC_tiPT1TrqFlt "Filterzeitkonstante für das gefilterte ISC Ausgangsdrehmoment" FLOAT32_IEEE ISC_tiPTsTrqLoss_float 1 100 0.00 60.0000000 FORMAT "%10.7" ECU_ADDRESS 0xD00042A8 /end MEASUREMENT
/begin MEASUREMENT ISC_trq "Stellgröße des ISC" SWORD Trq 1 100 -3276.800 3276.700 FORMAT "%8.3" ECU_ADDRESS 0xD0006FB6 /end MEASUREMENT
/begin MEASUREMENT ISC_trqAcc_mp "resulierendes Beschleunigungsmoment aus aus Motor, Antriebstrang und Fahrzeug" FLOAT32_IEEE Trq_float 1 100 -500.000000 1000.00000 FORMAT "%10.5" ECU_ADDRESS 0xC00010D0 /end MEASUREMENT
/begin MEASUREMENT ISC_trqDrvTrnAcc_mp "Beschleunigungsmoment berechnet aus Getriebeeingangsdrehzahl und Massenträgheitsmoment vom Antriebstrang ohne Motor" FLOAT32_IEEE Trq_float 1 100 -500.000000 1000.00000 FORMAT "%10.5" ECU_ADDRESS 0xC00010D4 /end MEASUREMENT
/begin MEASUREMENT ISC_trqEngAcc_mp "Beschleunigsmoment berechnet aus Motordrehzahl und Motormassenträgheit" FLOAT32_IEEE Trq_float 1 100 -500.000000 1000.00000 FORMAT "%10.5" ECU_ADDRESS 0xC00010D8 /end MEASUREMENT
/begin MEASUREMENT ISC_trqFlt "gefilterte Stellgröße des ISC" SWORD Trq 1 100 -3276.800 3276.700 FORMAT "%8.3" ECU_ADDRESS 0xD0006FB8 /end MEASUREMENT
/begin MEASUREMENT ISC_trqHiLimMax_mp "obere Drehmomentenbegrenzung des Stelleingriffs für oberen ISC-Pfad" FLOAT32_IEEE Trq_float 1 100 -500.000000 1000.00000 FORMAT "%10.5" ECU_ADDRESS 0xC000104C /end MEASUREMENT
/begin MEASUREMENT ISC_trqHiLimMin_mp "untere Drehmomentenbegrenzung des Stelleingriffs für oberen ISC-Pfad" FLOAT32_IEEE Trq_float 1 100 -500.000000 1000.00000 FORMAT "%10.5" ECU_ADDRESS 0xC0001050 /end MEASUREMENT
/begin MEASUREMENT ISC_trqILoLtd_mp "begrenzter I-Anteil des unteren Pfades" FLOAT32_IEEE Trq_float 1 100 -500.000000 1000.00000 FORMAT "%10.5" ECU_ADDRESS 0xC00010DC /end MEASUREMENT
/begin MEASUREMENT ISC_trqIscAsd_mp "Summe aus SpdGov_trqInrLimSet und Führungsformerausgang(ASDrf_trqInrSet)" FLOAT32_IEEE Trq_float 1 100 -500.000000 1000.00000 FORMAT "%10.5" ECU_ADDRESS 0xC0001054 /end MEASUREMENT
/begin MEASUREMENT ISC_trqLoLimMax "obere Drehmomentstellgrenze für den unteren Pfad des ISC" FLOAT32_IEEE Trq_float 1 100 -500.000000 1000.00000 FORMAT "%10.5" ECU_ADDRESS 0xD00042AC /end MEASUREMENT
/begin MEASUREMENT ISC_trqLoLimMin "untere Drehmomentstellgrenze für den unteren Pfad des ISC" FLOAT32_IEEE Trq_float 1 100 -500.000000 1000.00000 FORMAT "%10.5" ECU_ADDRESS 0xD00042B0 /end MEASUREMENT
/begin MEASUREMENT ISC_trqLoLtd "Ausgangdrehmoment der unteren ISC-Pfades" SWORD Trq 1 100 -3276.800 3276.700 FORMAT "%8.3" ECU_ADDRESS 0xD0006FBA /end MEASUREMENT
/begin MEASUREMENT ISC_trqLoNoPreCtlLtd_mp "Drehmoment des unteren ISC-Pfades vor der Aufschaltung von Vorsteuermoment (ISC_trqPreCtl)" FLOAT32_IEEE Trq_float 1 100 -500.000000 1000.00000 FORMAT "%10.5" ECU_ADDRESS 0xC00010E0 /end MEASUREMENT
/begin MEASUREMENT ISC_trqLoPreCtlLtd_mp "Drehmoment des unteren ISC-Pfades nach der Aufschaltung von Vorsteuermoment (ISC_trqPreCtl)" FLOAT32_IEEE Trq_float 1 100 -500.000000 1000.00000 FORMAT "%10.5" ECU_ADDRESS 0xC00010E4 /end MEASUREMENT
/begin MEASUREMENT ISC_trqLossFlt "gefiltertes abgeschätztes Verlustmoment" FLOAT32_IEEE Trq_float 1 100 -500.000000 1000.00000 FORMAT "%10.5" ECU_ADDRESS 0xD00042B4 /end MEASUREMENT
/begin MEASUREMENT ISC_trqLossFltK1_mp "gefiltertes abgeschätztes Verlustmoment" FLOAT32_IEEE Trq_float 1 100 -500.000000 1000.00000 FORMAT "%10.5" ECU_ADDRESS 0xC00010E8 /end MEASUREMENT
/begin MEASUREMENT ISC_trqLossFltK2_mp "gefiltertes abgeschätztes Verlustmoment nach Aufschaltung des unteren Integratormoments" FLOAT32_IEEE Trq_float 1 100 -500.000000 1000.00000 FORMAT "%10.5" ECU_ADDRESS 0xC00010EC /end MEASUREMENT
/begin MEASUREMENT ISC_trqLossFltK3_mp "gefiltertes abgeschätztes Verlustmoment nach einer Parametersatzwechsel (P-Parameter)" FLOAT32_IEEE Trq_float 1 100 -500.000000 1000.00000 FORMAT "%10.5" ECU_ADDRESS 0xC00010F0 /end MEASUREMENT
/begin MEASUREMENT ISC_trqLossFltK4_mp "gefiltertes abgeschätztes Verlustmoment nach einer Parametersatzwechsel des oberen P-Glides (P-Parameter)" FLOAT32_IEEE Trq_float 1 100 -500.000000 1000.00000 FORMAT "%10.5" ECU_ADDRESS 0xC0001058 /end MEASUREMENT
/begin MEASUREMENT ISC_trqLossUnFlt_mp "Ungefiltertes abgeschätztes Verlustmoment" FLOAT32_IEEE Trq_float 1 100 -500.000000 1000.00000 FORMAT "%10.5" ECU_ADDRESS 0xC00010F4 /end MEASUREMENT
/begin MEASUREMENT ISC_trqPHi_mp "P-Anteil des oberen Pfades" FLOAT32_IEEE Trq_float 1 100 -500.000000 1000.00000 FORMAT "%10.5" ECU_ADDRESS 0xC000105C /end MEASUREMENT
/begin MEASUREMENT ISC_trqPLo_mp "P-Anteil des unteres Pfades" FLOAT32_IEEE Trq_float 1 100 -500.000000 1000.00000 FORMAT "%10.5" ECU_ADDRESS 0xC00010F8 /end MEASUREMENT
/begin MEASUREMENT ISC_trqReq "ausgewählte Anforderung (aus allen Anforderungen der aktiven ISC Clients) für ein Initialisierungsdrehmoment an den ISC" FLOAT32_IEEE Trq_float 1 100 -500.000000 1000.00000 FORMAT "%10.5" ECU_ADDRESS 0xD00042B8 /end MEASUREMENT
/begin MEASUREMENT ISC_trqSetLtd_mp "Limitierter Ausgang des ISC ohne berücksichtigung des Führungsformerausganges (ASDrf_trqInrSet)" FLOAT32_IEEE Trq_float 1 100 -500.000000 1000.00000 FORMAT "%10.5" ECU_ADDRESS 0xC0001060 /end MEASUREMENT
/begin MEASUREMENT ISC_trqSet_mp "Nicht limitierter Ausgang des ISC ohne berücksichtigung des Führungsformerausganges (ASDrf_trqInrSet)" FLOAT32_IEEE Trq_float 1 100 -500.000000 1000.00000 FORMAT "%10.5" ECU_ADDRESS 0xC0001064 /end MEASUREMENT
/begin MEASUREMENT ISC_trqVehAcc_mp "Beschleunigungsmoment berechnet aus und Massenträgheitsmoment vom Antriebstrang ohne Motor" FLOAT32_IEEE Trq_float 1 100 -500.000000 1000.00000 FORMAT "%10.5" ECU_ADDRESS 0xC00010FC /end MEASUREMENT
/begin MEASUREMENT IVActr_chgChrg "" SWORD Charge_PA 1 100 -32768.00 32767.00 FORMAT "%8.2" ARRAY_SIZE 6 ECU_ADDRESS 0xD0006FBC /end MEASUREMENT
/begin MEASUREMENT IVActr_ctIntrGetMeas "Anzahl Interrups des gemessenen Einspritztyps zwischen Start und Auswertung der Aktormessung" UBYTE OneToOne 1 100 0.00 255.0 FORMAT "%5.1" ARRAY_SIZE 6 ECU_ADDRESS 0xD0009034 /end MEASUREMENT
/begin MEASUREMENT IVActr_iCondChrg_mp "Lade-Sollstromgrenze für die Aktorkonditionierung" SWORD Curr 1 100 -32768.00 32767.00 FORMAT "%8.2" ECU_ADDRESS 0xC0001110 /end MEASUREMENT
/begin MEASUREMENT IVActr_iCondDisCh_mp "Entlade-Sollstromgrenze für die Aktorkonditionierung" SWORD Curr 1 100 -32768.00 32767.00 FORMAT "%8.2" ECU_ADDRESS 0xC0001112 /end MEASUREMENT
/begin MEASUREMENT IVActr_numCondLeft_mp "Countdown Zähler: noch zu programmierende Ansteuerungen" UBYTE OneToOne 1 100 0.00 255.0 FORMAT "%5.1" ECU_ADDRESS 0xC0001114 /end MEASUREMENT
/begin MEASUREMENT IVActr_numCylMeasNxt "Nächster zu messender Zylinder für Aktormessung" ULONG OneToOne 1 100 0.00 4294967295.00 FORMAT "%13.2" ECU_ADDRESS 0xD0004514 /end MEASUREMENT
/begin MEASUREMENT IVActr_pRailLnk "gepaarten Raildruck der gemessenen Einspritzung" SWORD Pres_Rail 1 100 -3276.800 2000.000 FORMAT "%5.3" ARRAY_SIZE 6 ECU_ADDRESS 0xD0006FC8 /end MEASUREMENT
/begin MEASUREMENT IVActr_stChgChrg "" UBYTE OneToOne 1 100 0.00 255.0 FORMAT "%5.1" ARRAY_SIZE 6 ECU_ADDRESS 0xD000903A /end MEASUREMENT
/begin MEASUREMENT IVActr_stCond "Zustand der Aktorkonditoinierung" UBYTE OneToOne 1 100 0.00 255.0 FORMAT "%5.1" ECU_ADDRESS 0xD0009040 /end MEASUREMENT
/begin MEASUREMENT IVActr_stCondInjErr_mp "Zylinderspezifischer Zustand: Programmierung mindestens einer Ansteuerung war fehlerhaft" UBYTE OneToOne 1 100 0.00 255.0 FORMAT "%5.1" ECU_ADDRESS 0xC0001115 /end MEASUREMENT
/begin MEASUREMENT IVActr_stCondInjOK_mp "Zylinderspezifischer Zustand: Programmierung mindestens einer Ansteuerung erfolgreich" UBYTE OneToOne 1 100 0.00 255.0 FORMAT "%5.1" ECU_ADDRESS 0xC0001116 /end MEASUREMENT
/begin MEASUREMENT IVActr_stCondPreCond_mp "Status: Vorbedingungen für Aktorkonditionierung erfüllt" UBYTE OneToOne 1 100 0.00 255.0 FORMAT "%5.1" ECU_ADDRESS 0xC0001117 /end MEASUREMENT
/begin MEASUREMENT IVActr_stGetMeas "Status der Aktormessung" UBYTE OneToOne 1 100 0.00 255.0 FORMAT "%5.1" ARRAY_SIZE 6 ECU_ADDRESS 0xD0009041 /end MEASUREMENT
/begin MEASUREMENT IVActr_stTiDisCh "Status der Aktor-Entladezeit" UBYTE OneToOne 1 100 0.00 255.0 FORMAT "%5.1" ARRAY_SIZE 6 ECU_ADDRESS 0xD0009047 /end MEASUREMENT
/begin MEASUREMENT IVActr_stTiETMeas "Status der gemessenen Ansteuerdauer" UBYTE OneToOne 1 100 0.00 255.0 FORMAT "%5.1" ARRAY_SIZE 6 ECU_ADDRESS 0xD000904D /end MEASUREMENT
/begin MEASUREMENT IVActr_stUChrgUp "Status der Aktorspannung nach dem Laden" UBYTE OneToOne 1 100 0.00 255.0 FORMAT "%5.1" ARRAY_SIZE 6 ECU_ADDRESS 0xD0009053 /end MEASUREMENT
/begin MEASUREMENT IVActr_stUDisChStop "Status der Aktorspannung nach dem Entladen" UBYTE OneToOne 1 100 0.00 255.0 FORMAT "%5.1" ARRAY_SIZE 6 ECU_ADDRESS 0xD0009059 /end MEASUREMENT
/begin MEASUREMENT IVActr_stUUp "Status der Aktorspannung Up-Niveau" UBYTE OneToOne 1 100 0.00 255.0 FORMAT "%5.1" ARRAY_SIZE 6 ECU_ADDRESS 0xD000905F /end MEASUREMENT
/begin MEASUREMENT IVActr_swtSelTemp "SW-Schalter der Temperaturauswahl" UBYTE OneToOne 1 100 0.00 255.0 FORMAT "%5.1" ECU_ADDRESS 0xD0009065 /end MEASUREMENT
/begin MEASUREMENT IVActr_tActr "Aktortemperatur" SWORD Temp_Cels 1 100 -3549.940 3003.560 FORMAT "%8.3" ECU_ADDRESS 0xD0006FD4 /end MEASUREMENT
/begin MEASUREMENT IVActr_tActrUnCor_mp "unkorrigierte Aktortemperatur" SWORD Temp_Cels 1 100 -3549.940 3003.560 FORMAT "%8.3" ECU_ADDRESS 0xC0001124 /end MEASUREMENT
/begin MEASUREMENT IVActr_tiActrMeasCurr "Zylinderspezifischer Zeitstempel der letzen Aktormessung" ULONG Time_PzoMeas 1 100 0.00 234505214.307 FORMAT "%13.3" ARRAY_SIZE 6 ECU_ADDRESS 0xD0004518 /end MEASUREMENT
/begin MEASUREMENT IVActr_tiActrMeasLst "" ULONG Time_PzoMeas 1 100 0.00 234505214.307 FORMAT "%13.3" ECU_ADDRESS 0xD0004530 /end MEASUREMENT
/begin MEASUREMENT IVActr_tiChrgLnk "gepaarte Soll-Ladezeit" SWORD InjTime_us 1 100 -13107.20 5000.00 FORMAT "%8.2" ARRAY_SIZE 6 ECU_ADDRESS 0xD0006FD6 /end MEASUREMENT
/begin MEASUREMENT IVActr_tiCondChrg_mp "Ladezeit der Aktorkonditionierung" SWORD InjTime_us 1 100 -13107.20 5000.00 FORMAT "%8.2" ECU_ADDRESS 0xC0001118 /end MEASUREMENT
/begin MEASUREMENT IVActr_tiCondET_mp "Ansteuerdauer der Aktorkonditionierung" SWORD InjTime_us 1 100 -13107.20 5000.00 FORMAT "%8.2" ECU_ADDRESS 0xC000111A /end MEASUREMENT
/begin MEASUREMENT IVActr_tiCondPseChrg_mp "Ladestrompuls Pausezeit für die Aktorkonditionierung" SWORD Time_PzoChrgPse 1 100 -327.6800 327.6700 FORMAT "%8.4" ECU_ADDRESS 0xC000111C /end MEASUREMENT
/begin MEASUREMENT IVActr_tiCondPseDisCh_mp "Entladestrompuls Pausezeit für die Aktorkonditionierung" SWORD Time_PzoChrgPse 1 100 -327.6800 327.6700 FORMAT "%8.4" ECU_ADDRESS 0xC000111E /end MEASUREMENT
/begin MEASUREMENT IVActr_tiDisCh "Aktor-Entladezeit" SWORD InjTime_us 1 100 -13107.20 5000.00 FORMAT "%8.2" ARRAY_SIZE 6 ECU_ADDRESS 0xD0006FEE /end MEASUREMENT
/begin MEASUREMENT IVActr_tiDisChLnk "gepaarte Soll-Entladezeit" SWORD InjTime_us 1 100 -13107.20 5000.00 FORMAT "%8.2" ARRAY_SIZE 6 ECU_ADDRESS 0xD0006FE2 /end MEASUREMENT
/begin MEASUREMENT IVActr_tiETMeas "Gemessene Ansteuerdauer" SWORD InjTime_us 1 100 -13107.20 5000.00 FORMAT "%8.2" ARRAY_SIZE 6 ECU_ADDRESS 0xD0006FFA /end MEASUREMENT
/begin MEASUREMENT IVActr_uActrRaw_mp "ADC-Rohwert der Aktorspannung für IVActr_uActrLin_CUR" SWORD Volt 1 100 -6553.600 6553.400 FORMAT "%8.3" ECU_ADDRESS 0xC0001122 /end MEASUREMENT
/begin MEASUREMENT IVActr_uChrgUp "Aktorspannung nach dem Laden" SWORD Vltg_PA 1 100 -327.6800 327.6700 FORMAT "%8.4" ARRAY_SIZE 6 ECU_ADDRESS 0xD0007006 /end MEASUREMENT
/begin MEASUREMENT IVActr_uCondChrg_mp "Lade-Sollspannung der Aktorkonditionierung" SWORD Vltg_PA 1 100 -327.6800 327.6700 FORMAT "%8.4" ECU_ADDRESS 0xC0001120 /end MEASUREMENT
/begin MEASUREMENT IVActr_uDisChStop "Aktorspannung nach dem Entladen" SWORD Vltg_PA 1 100 -327.6800 327.6700 FORMAT "%8.4" ARRAY_SIZE 6 ECU_ADDRESS 0xD0007012 /end MEASUREMENT
/begin MEASUREMENT IVActr_uUp "Aktorspannung Up-Niveau" SWORD Vltg_PA 1 100 -327.6800 327.6700 FORMAT "%8.4" ARRAY_SIZE 6 ECU_ADDRESS 0xD000702A /end MEASUREMENT
/begin MEASUREMENT IVActr_uUpLnk "gepaarte Aktor-Sollspannung Up-Niveau" SWORD Vltg_PA 1 100 -327.6800 327.6700 FORMAT "%8.4" ARRAY_SIZE 6 ECU_ADDRESS 0xD000701E /end MEASUREMENT
/begin MEASUREMENT IVAdj_clsIVA "InjektorSpannungsAbgeich-Klasse des Piezo-Aktors" UBYTE OneToOne 1 100 0.00 255.0 FORMAT "%5.1" ARRAY_SIZE 6 ECU_ADDRESS 0xD0009066 /end MEASUREMENT
/begin MEASUREMENT IVAdj_facNVC "NVC Korrekturfaktor" SWORD Fact 1 100 -4.000000 3.999878 FORMAT "%8.6" ARRAY_SIZE 6 ECU_ADDRESS 0xD0007036 /end MEASUREMENT
/begin MEASUREMENT IVAdj_stChkErr_mp "Status des Checksummenfehlers" ULONG OneToOne 1 100 0.00 4294967295.00 FORMAT "%13.2" ECU_ADDRESS 0xC0001134 /end MEASUREMENT
/begin MEASUREMENT IVAdj_stChkSumErrAdj_mp "Fehlerstatus der Prüfsummen-Verletzung der Injektorabgleichwerte" UBYTE OneToOne 1 100 0.00 255.0 FORMAT "%5.1" ECU_ADDRESS 0xC0001126 /end MEASUREMENT
/begin MEASUREMENT IVAdj_stIVALimMaxErr_mp "Fehlerstatus der Verletzung des oberen ISA-Grenzwertes" UBYTE OneToOne 1 100 0.00 255.0 FORMAT "%5.1" ECU_ADDRESS 0xC0001138 /end MEASUREMENT
/begin MEASUREMENT IVAdj_stIVALimMinErr_mp "Fehlerstatus der Verletzung des unteren ISA-Grenzwertes" UBYTE OneToOne 1 100 0.00 255.0 FORMAT "%5.1" ECU_ADDRESS 0xC0001139 /end MEASUREMENT
/begin MEASUREMENT IVAdj_volMI1QntAdj_mp "Injektor-Abgleichmenge der Haupteinspritzung 1" SWORD InjQntInj 1 100 -327.6800 327.6700 FORMAT "%8.4" ECU_ADDRESS 0xC0001128 /end MEASUREMENT
/begin MEASUREMENT IVAdj_volPiI1QntAdj_mp "Injektor-Abgleichmenge der Voreinspritzung 1" SWORD InjQntInj 1 100 -327.6800 327.6700 FORMAT "%8.4" ECU_ADDRESS 0xC000112A /end MEASUREMENT
/begin MEASUREMENT IVAdj_volPiI2QntAdj_mp "Injektor-Abgleichmenge der Voreinspritzung 2" SWORD InjQntInj 1 100 -327.6800 327.6700 FORMAT "%8.4" ECU_ADDRESS 0xC000112C /end MEASUREMENT
/begin MEASUREMENT IVAdj_volPiI3QntAdj_mp "Injektor-Abgleichmenge der Voreinspritzung 3" SWORD InjQntInj 1 100 -327.6800 327.6700 FORMAT "%8.4" ECU_ADDRESS 0xC000112E /end MEASUREMENT
/begin MEASUREMENT IVAdj_volPoI1QntAdj_mp "Injektor-Abgleichmenge der Nacheinspritzung 1" SWORD InjQntInj 1 100 -327.6800 327.6700 FORMAT "%8.4" ECU_ADDRESS 0xC0001130 /end MEASUREMENT
/begin MEASUREMENT IVAdj_volPoI2QntAdj_mp "Injektor-Abgleichmenge der Nacheinspritzung 2" SWORD InjQntInj 1 100 -327.6800 327.6700 FORMAT "%8.4" ECU_ADDRESS 0xC0001132 /end MEASUREMENT
/begin MEASUREMENT IVCtl_clsIVA_mp "InjektorSpannungsAbgleich-Klasse (Eingang für IVCtl_uSetPressX_CUR)" UBYTE OneToOne 1 100 0.00 255.0 FORMAT "%5.1" ARRAY_SIZE 6 ECU_ADDRESS 0xC00011A4 /end MEASUREMENT
/begin MEASUREMENT IVCtl_facVltgTempCor "Temperaturkompensationsfaktor der Aktorspannung" SWORD Fact 1 100 -4.000000 3.999878 FORMAT "%8.6" ECU_ADDRESS 0xD0007042 /end MEASUREMENT
/begin MEASUREMENT IVCtl_iChrg "Ladestrom-Grenze" SWORD Curr 1 100 0.00 20000.00 FORMAT "%8.2" ARRAY_SIZE 6 ECU_ADDRESS 0xD0007044 /end MEASUREMENT
/begin MEASUREMENT IVCtl_iCorPI "Ausgang des Entladezeitreglers" SWORD Curr 1 100 -10000.00 10000.00 FORMAT "%8.2" ARRAY_SIZE 6 ECU_ADDRESS 0xD000695A /end MEASUREMENT
/begin MEASUREMENT IVCtl_iCorPIUnLim_mp "Unbegrenzter Reglerausgang des PI-Reglers der Entladezeitregelung" SWORD Curr 1 100 -32768.00 32767.00 FORMAT "%8.2" ARRAY_SIZE 6 ECU_ADDRESS 0xC000113A /end MEASUREMENT
/begin MEASUREMENT IVCtl_iDisCh "Entladestrom-Grenze" SWORD Curr 1 100 -30000.00 30000.00 FORMAT "%8.2" ARRAY_SIZE 6 ECU_ADDRESS 0xD0007050 /end MEASUREMENT
/begin MEASUREMENT IVCtl_iDisChUnCor_mp "Unkorrigierte Entladepuls-Stromgrenze" SWORD Curr 1 100 -30000.00 30000.00 FORMAT "%8.2" ARRAY_SIZE 6 ECU_ADDRESS 0xC0001148 /end MEASUREMENT
/begin MEASUREMENT IVCtl_p "aktueller Raildruck der Spannungssollwertberechnung" SWORD Pres_Rail 1 100 -3276.800 2000.000 FORMAT "%5.3" ECU_ADDRESS 0xD000705C /end MEASUREMENT
/begin MEASUREMENT IVCtl_stStrt "Zustand: Startspannung des Einspritzventils aktiv" UBYTE OneToOne 1 100 0.00 1.000 FORMAT "%5.3" ECU_ADDRESS 0xD000906C /end MEASUREMENT
/begin MEASUREMENT IVCtl_stTGovPIHi_mp "Zylinderspezifischer Zustand: PI-Regler der Entladezeitregelung ist am oberen Anschlag" UBYTE OneToOne 1 100 0.00 255.0 FORMAT "%5.1" ECU_ADDRESS 0xC0001146 /end MEASUREMENT
/begin MEASUREMENT IVCtl_stTGovPILo_mp "Zylinderspezifischer Zustand: PI-Regler der Entladezeitregelung ist am unteren Anschlag" UBYTE OneToOne 1 100 0.00 255.0 FORMAT "%5.1" ECU_ADDRESS 0xC0001147 /end MEASUREMENT
/begin MEASUREMENT IVCtl_stVltgGovPIHi_mp "Zylinderspezifischer Zustand: Ausgang des Aktorspannunsreglers überschreitet Grenzwert" UBYTE OneToOne 1 100 0.00 255.0 FORMAT "%5.1" ECU_ADDRESS 0xC0001194 /end MEASUREMENT
/begin MEASUREMENT IVCtl_stVltgGovPILo_mp "Zylinderspezifischer Zustand: PI-Regler der Aktorspannungsregelung ist am oberen Anschlag" UBYTE OneToOne 1 100 0.00 255.0 FORMAT "%5.1" ECU_ADDRESS 0xC0001195 /end MEASUREMENT
/begin MEASUREMENT IVCtl_tiChrg "Ladezeitsollwert" SWORD InjTime_us 1 100 0.00 5000.0000 FORMAT "%8.4" ECU_ADDRESS 0xD000705E /end MEASUREMENT
/begin MEASUREMENT IVCtl_tiDiff "Eingang des Entladezeitreglers" SWORD InjTime_us 1 100 -13107.20 5000.00 FORMAT "%8.2" ARRAY_SIZE 6 ECU_ADDRESS 0xD0007060 /end MEASUREMENT
/begin MEASUREMENT IVCtl_tiDisCh "Entladezeitsollwert" SWORD InjTime_us 1 100 0.00 5000.0000 FORMAT "%8.4" ECU_ADDRESS 0xD000706C /end MEASUREMENT
/begin MEASUREMENT IVCtl_tiPseChrg "Ladepuls-Pausezeit" SWORD Time_PzoChrgPse 1 100 2.000000 20.00000 FORMAT "%8.5" ECU_ADDRESS 0xD000706E /end MEASUREMENT
/begin MEASUREMENT IVCtl_tiPseDisCh "Entladestrompuls Pausezeit" SWORD Time_PzoChrgPse 1 100 2.000000 20.00000 FORMAT "%8.5" ECU_ADDRESS 0xD0007070 /end MEASUREMENT
/begin MEASUREMENT IVCtl_tiStrt_mp "Zeit ""Motorstart verzögert""" SWORD Time_ms 1 100 -327680.0 327670.0 FORMAT "%8.1" ECU_ADDRESS 0xC00011A6 /end MEASUREMENT
/begin MEASUREMENT IVCtl_tiTGovCalc "Zeitstempel: Letzte Berechnung des Entladezeitreglers" ULONG Time_PzoMeas 1 100 0.00 234505214.307 FORMAT "%13.3" ARRAY_SIZE 6 ECU_ADDRESS 0xD0004534 /end MEASUREMENT
/begin MEASUREMENT IVCtl_tiVltgGovCalc "Zeitstempel: Letzte Berechnung des Spannungsreglers" ULONG Time_PzoMeas 1 100 0.00 234505214.307 FORMAT "%13.3" ARRAY_SIZE 6 ECU_ADDRESS 0xD000454C /end MEASUREMENT
/begin MEASUREMENT IVCtl_uChrgMapIn_mp "Eingang für IVCtl_iChrg_MAP" SWORD Vltg_PA 1 100 -327.6800 327.6700 FORMAT "%8.4" ECU_ADDRESS 0xC0001156 /end MEASUREMENT
/begin MEASUREMENT IVCtl_uChrgUp "Sollspannung nach dem Laden" SWORD Vltg_PA 1 100 0.00 250.0000 FORMAT "%8.4" ARRAY_SIZE 6 ECU_ADDRESS 0xD0007072 /end MEASUREMENT
/begin MEASUREMENT IVCtl_uChrgUpUnCor_mp "Unkorrigierter Spannungssollwert ChrgUp Niveau" SWORD Vltg_PA 1 100 0.00 250.0000 FORMAT "%8.4" ARRAY_SIZE 6 ECU_ADDRESS 0xC0001158 /end MEASUREMENT
/begin MEASUREMENT IVCtl_uCorPI "Ausgang des Aktorspannungsreglers" SWORD Vltg_PA 1 100 -327.6800 327.6700 FORMAT "%8.4" ARRAY_SIZE 6 ECU_ADDRESS 0xD0006966 /end MEASUREMENT
/begin MEASUREMENT IVCtl_uCorPIUnLim_mp "Unbegrenzter Reglerausgang des PI-Reglers der Aktorspannungsregelung" SWORD Vltg_PA 1 100 -327.6800 327.6700 FORMAT "%8.4" ARRAY_SIZE 6 ECU_ADDRESS 0xC0001198 /end MEASUREMENT
/begin MEASUREMENT IVCtl_uCorPreCtl_mp "Vorsteuerspannung" SWORD Vltg_PA 1 100 0.00 250.0000 FORMAT "%8.4" ARRAY_SIZE 6 ECU_ADDRESS 0xC0001164 /end MEASUREMENT
/begin MEASUREMENT IVCtl_uDiffUp "Eingang des Aktorspannungsreglers" SWORD Vltg_PA 1 100 -327.6800 327.6700 FORMAT "%8.4" ARRAY_SIZE 6 ECU_ADDRESS 0xD000707E /end MEASUREMENT
/begin MEASUREMENT IVCtl_uUp "Spannungssollwert Up-Niveau" SWORD Vltg_PA 1 100 0.00 250.0000 FORMAT "%8.4" ARRAY_SIZE 6 ECU_ADDRESS 0xD000708C /end MEASUREMENT
/begin MEASUREMENT IVCtl_uUpMapIn_mp "Eingangsgröße für IVCtl_iDisCh_MAP" SWORD Vltg_PA 1 100 -327.6800 327.6700 FORMAT "%8.4" ECU_ADDRESS 0xC0001154 /end MEASUREMENT
/begin MEASUREMENT IVCtl_uUpStrt "Startspannung des Piezoaktors" SWORD Vltg_PA 1 100 0.00 210.0000 FORMAT "%8.4" ECU_ADDRESS 0xD000708A /end MEASUREMENT
/begin MEASUREMENT IVCtl_uUpTempCor_mp "Temperatur korrigierter Spannungssollwert Up-Niveau" SWORD Vltg_PA 1 100 0.00 250.0000 FORMAT "%8.4" ARRAY_SIZE 6 ECU_ADDRESS 0xC0001170 /end MEASUREMENT
/begin MEASUREMENT IVCtl_uUpUnCor_mp "Unkorrigierter Spannungssollwert Up-Niveau" SWORD Vltg_PA 1 100 0.00 250.0000 FORMAT "%8.4" ARRAY_SIZE 6 ECU_ADDRESS 0xC000117C /end MEASUREMENT
/begin MEASUREMENT IVCtl_uUpUnLim_mp "Unbegrenzter Spannungssollwert Up-Niveau" SWORD Vltg_PA 1 100 0.00 250.0000 FORMAT "%8.4" ARRAY_SIZE 6 ECU_ADDRESS 0xC0001188 /end MEASUREMENT
/begin MEASUREMENT IVDia_numIdxErrCyl_mp "Index der zylinderspezifische Fehler welche erkannt konnten werden sollen" UBYTE OneToOne 1 100 0.00 255.0 FORMAT "%5.1" ARRAY_SIZE 6 ECU_ADDRESS 0xC00011A8 /end MEASUREMENT
/begin MEASUREMENT IVDia_st "Botschaft zur Erkennung von mehrfachem Lastabfall" UBYTE OneToOne 1 100 0.00 255.0 FORMAT "%5.1" ECU_ADDRESS 0xD000906D /end MEASUREMENT
/begin MEASUREMENT IVDia_stErrClctCyl_mp "Messpunkt des Fehlermusters, der sammelt die Fehler aus Diagnoseregister und Plausibilitätsprüfung" UWORD OneToOne 1 100 0.00 65535.00 FORMAT "%8.2" ARRAY_SIZE 6 ECU_ADDRESS 0xC00011AE /end MEASUREMENT
/begin MEASUREMENT IVDia_stErrCyl_mp "Zylinderspezifische Diagnoseinformation" UBYTE OneToOne 1 100 0.00 255.0 FORMAT "%5.1" ARRAY_SIZE 6 ECU_ADDRESS 0xC00011BA /end MEASUREMENT
/begin MEASUREMENT IVDia_stPsIcChp "Chipspezifisch Diagnose-Information der SPI-Übertragung und SPI Control-Byte" UWORD OneToOne 1 100 0.00 65535.00 FORMAT "%8.2" ARRAY_SIZE 1 ECU_ADDRESS 0xD000766A /end MEASUREMENT
/begin MEASUREMENT IVDia_stPsIcCyl "Cylinderspezifische Diagnoseinformation aus PsIc Diagnose-Register" UBYTE OneToOne 1 100 0.00 255.0 FORMAT "%5.1" ARRAY_SIZE 6 ECU_ADDRESS 0xD000906E /end MEASUREMENT
/begin MEASUREMENT IVDia_stUPlausBnk "Bankspezifische Spannungsplausibilität-Statusmessages" UBYTE OneToOne 1 100 0.00 255.0 FORMAT "%5.1" ARRAY_SIZE 1 ECU_ADDRESS 0xD0009074 /end MEASUREMENT
/begin MEASUREMENT IVDia_stUPlausCyl "Zylinderspezifische Spannungsplausibilität-Statusmessage der Aktorspannungsmessung" UBYTE OneToOne 1 100 0.00 255.0 FORMAT "%5.1" ARRAY_SIZE 6 ECU_ADDRESS 0xD0009075 /end MEASUREMENT
/begin MEASUREMENT IVDia_uThres_mp "Schwelle der Plausibilitätprüfung" SWORD Vltg_PA 1 100 -327.6800 327.6700 FORMAT "%8.4" ARRAY_SIZE 3 ECU_ADDRESS 0xC00011C0 /end MEASUREMENT
/begin MEASUREMENT IVPlaus_nCyl "zylinderselektive Drehzahl" SWORD EngN 1 100 -16384.00 16383.50 FORMAT "%8.2" ARRAY_SIZE 6 ECU_ADDRESS 0xD000709A /end MEASUREMENT
/begin MEASUREMENT IVPlaus_qFBCCyl "zylinderselektive Mengenkorrektur des Laufruhereglers" SWORD InjMass 1 100 -327.6800 327.6700 FORMAT "%8.4" ARRAY_SIZE 6 ECU_ADDRESS 0xD00070A6 /end MEASUREMENT
/begin MEASUREMENT IVPSply_ctIntrBufMeas "Anzahl Interrups des gemessenen Einspritztyps zwischen Start und Auswertung der Bufferspannungsmessung" UBYTE OneToOne 1 100 0.00 255.0 FORMAT "%5.1" ARRAY_SIZE 6 ECU_ADDRESS 0xD000907B /end MEASUREMENT
/begin MEASUREMENT IVPSply_stBufErr "Zustand: Bufferkondensator nicht geladen" UBYTE OneToOne 1 100 0.00 255.0 FORMAT "%5.1" ECU_ADDRESS 0xD0009081 /end MEASUREMENT
/begin MEASUREMENT IVPSply_stGetBufVltg "Status der Bufferspannungsmessung" UBYTE OneToOne 1 100 0.00 255.0 FORMAT "%5.1" ARRAY_SIZE 6 ECU_ADDRESS 0xD0009082 /end MEASUREMENT
/begin MEASUREMENT IVPSply_stOffDCDC "Status der Abschaltung des DCDC-Wandlers" UBYTE OneToOne 1 100 0.00 255.0 FORMAT "%5.1" ECU_ADDRESS 0xD0009088 /end MEASUREMENT
/begin MEASUREMENT IVPSply_stUBuf "Bufferspannungs-Status" UBYTE OneToOne 1 100 0.00 255.0 FORMAT "%5.1" ARRAY_SIZE 1 ECU_ADDRESS 0xD0009089 /end MEASUREMENT
/begin MEASUREMENT IVPSply_tiBufMeasCurr "Zeitstempel der aktuellen Bufferspannungsmessung" ULONG Time_PzoMeas 1 100 0.00 234505214.307 FORMAT "%13.3" ARRAY_SIZE 1 ECU_ADDRESS 0xD0004564 /end MEASUREMENT
/begin MEASUREMENT IVPSply_tiDCDCChrg_mp "Zeitstempel: alle DCDC-Konverter geladen" ULONG OneToOne 1 100 0.00 4294967295.00 FORMAT "%13.2" ECU_ADDRESS 0xC00011C8 /end MEASUREMENT
/begin MEASUREMENT IVPSply_tiDCDCStrt_mp "Zeitstempel: DCDC-Konverter gestartet" ULONG OneToOne 1 100 0.00 4294967295.00 FORMAT "%13.2" ECU_ADDRESS 0xC00011CC /end MEASUREMENT
/begin MEASUREMENT IVPSply_uBuf "Bufferspannung" SWORD Vltg_PA 1 100 -327.6800 327.6700 FORMAT "%8.4" ARRAY_SIZE 1 ECU_ADDRESS 0xD0007098 /end MEASUREMENT
/begin MEASUREMENT IVPSply_uBufRaw_mp "ADC Bufferspannungs-Rohwert für IVPSply_uBufLin_CUR" SWORD Volt 1 100 -6553.600 6553.400 FORMAT "%8.3" ECU_ADDRESS 0xC00011C6 /end MEASUREMENT
/begin MEASUREMENT Layer_stLayer "" UWORD OneToOne 1 100 0.00 65535.00 FORMAT "%8.2" ECU_ADDRESS 0xD000767A /end MEASUREMENT
/begin MEASUREMENT LLim_aMSL_mp "" SWORD Acc 1 100 -32.76800 32.76700 FORMAT "%8.5" ECU_ADDRESS 0xC00011D0 /end MEASUREMENT
/begin MEASUREMENT LLim_aReq "" SWORD Acc 1 100 -32.76800 32.76700 FORMAT "%8.5" ECU_ADDRESS 0xD000732C /end MEASUREMENT
/begin MEASUREMENT LLim_dvMSL_mp "" SWORD Vel 1 100 -327.6800 327.6700 FORMAT "%8.4" ECU_ADDRESS 0xC00011D2 /end MEASUREMENT
/begin MEASUREMENT LLim_stMSLActv_mp "" UBYTE OneToOne 1 100 0.00 255.0 FORMAT "%5.1" ECU_ADDRESS 0xC00011D4 /end MEASUREMENT
/begin MEASUREMENT LLim_stReq "" UBYTE OneToOne 1 100 0.00 255.0 FORMAT "%5.1" ECU_ADDRESS 0xD00090A8 /end MEASUREMENT
/begin MEASUREMENT LLim_vMaxMSL_mp "" SWORD Vel 1 100 -327.6800 327.6700 FORMAT "%8.4" ECU_ADDRESS 0xC00011D6 /end MEASUREMENT
/begin MEASUREMENT LSU_ctHtCoup "" UWORD OneToOne 1 100 0.00 65535.00 FORMAT "%8.2" ARRAY_SIZE 1 ECU_ADDRESS 0xD0007670 /end MEASUREMENT
/begin MEASUREMENT LSU_dcycHtCor "" SWORD DtyCyc 1 100 -327.6800 327.6700 FORMAT "%8.4" ARRAY_SIZE 1 ECU_ADDRESS 0xD0007330 /end MEASUREMENT
/begin MEASUREMENT LSU_dcycHtCoupStp1 "" SWORD DtyCyc 1 100 -327.6800 327.6700 FORMAT "%8.4" ARRAY_SIZE 1 ECU_ADDRESS 0xD0007332 /end MEASUREMENT
/begin MEASUREMENT LSU_dcycHtCoupStp2 "" SWORD DtyCyc 1 100 -327.6800 327.6700 FORMAT "%8.4" ARRAY_SIZE 1 ECU_ADDRESS 0xD0007334 /end MEASUREMENT
/begin MEASUREMENT LSU_dcycHtCoupStp3 "" SWORD DtyCyc 1 100 -327.6800 327.6700 FORMAT "%8.4" ARRAY_SIZE 1 ECU_ADDRESS 0xD0007336 /end MEASUREMENT
/begin MEASUREMENT LSU_dcycLimActHt "" SWORD DtyCyc 1 100 -327.6800 327.6700 FORMAT "%8.4" ECU_ADDRESS 0xD000733E /end MEASUREMENT
/begin MEASUREMENT LSU_dcycRippel_mp "" SWORD DtyCyc 1 100 -327.6800 327.6700 FORMAT "%8.4" ARRAY_SIZE 1 ECU_ADDRESS 0xC00011F6 /end MEASUREMENT
/begin MEASUREMENT LSU_dHtCoupStepLast "" UBYTE OneToOne 1 100 0.00 255.0 FORMAT "%5.1" ECU_ADDRESS 0xD00090A9 /end MEASUREMENT
/begin MEASUREMENT LSU_dHtCoupStp "" UBYTE OneToOne 1 100 0.00 255.0 FORMAT "%5.1" ECU_ADDRESS 0xD00090AA /end MEASUREMENT
/begin MEASUREMENT LSU_facUCor_mp "" SWORD Fact 1 100 -4.000000 3.999878 FORMAT "%8.6" ECU_ADDRESS 0xC00011DC /end MEASUREMENT
/begin MEASUREMENT LSU_resRi "" SWORD Resist 1 100 -3276.800 3276.700 FORMAT "%8.3" ARRAY_SIZE 1 ECU_ADDRESS 0xD000735A /end MEASUREMENT
/begin MEASUREMENT LSU_resRiClb "" SWORD Resist 1 100 -3276.800 3276.700 FORMAT "%8.3" ARRAY_SIZE 1 ECU_ADDRESS 0xD0007350 /end MEASUREMENT
/begin MEASUREMENT LSU_resRiClbRaw_mp "" SWORD Resist 1 100 -3276.800 3276.700 FORMAT "%8.3" ARRAY_SIZE 1 ECU_ADDRESS 0xC00011EE /end MEASUREMENT
/begin MEASUREMENT LSU_resRiHtCoupStp1 "" SWORD Resist 1 100 -3276.800 3276.700 FORMAT "%8.3" ARRAY_SIZE 1 ECU_ADDRESS 0xD0007352 /end MEASUREMENT
/begin MEASUREMENT LSU_resRiHtCoupStp2 "" SWORD Resist 1 100 -3276.800 3276.700 FORMAT "%8.3" ARRAY_SIZE 1 ECU_ADDRESS 0xD0007354 /end MEASUREMENT
/begin MEASUREMENT LSU_resRiHtCoupStp3 "" SWORD Resist 1 100 -3276.800 3276.700 FORMAT "%8.3" ARRAY_SIZE 1 ECU_ADDRESS 0xD0007356 /end MEASUREMENT
/begin MEASUREMENT LSU_resRiRaw "" SWORD Resist 1 100 -3276.800 3276.700 FORMAT "%8.3" ARRAY_SIZE 1 ECU_ADDRESS 0xD0007358 /end MEASUREMENT
/begin MEASUREMENT LSU_resRiRippel_mp "" SWORD Resist 1 100 -3276.800 3276.700 FORMAT "%8.3" ARRAY_SIZE 1 ECU_ADDRESS 0xC00011F8 /end MEASUREMENT
/begin MEASUREMENT LSU_resRi_mp "" SLONG Resist 1 100 -214748364.800 214748364.700 FORMAT "%13.3" ECU_ADDRESS 0xC00011F0 /end MEASUREMENT
/begin MEASUREMENT LSU_rO2Act "" SWORD O2 1 100 -0.3276800 0.3276700 FORMAT "%9.7" ARRAY_SIZE 1 ECU_ADDRESS 0xD0007346 /end MEASUREMENT
/begin MEASUREMENT LSU_rO2Raw "" SWORD O2 1 100 -0.3276800 0.3276700 FORMAT "%9.7" ARRAY_SIZE 1 ECU_ADDRESS 0xD000734C /end MEASUREMENT
/begin MEASUREMENT LSU_rOutHWE_mp "" SWORD DtyCyc 1 100 -327.6800 327.6700 FORMAT "%8.4" ARRAY_SIZE 1 ECU_ADDRESS 0xC00011DE /end MEASUREMENT
/begin MEASUREMENT LSU_stCirModeNew "" UWORD OneToOne 1 100 0.00 65535.00 FORMAT "%8.2" ARRAY_SIZE 1 ECU_ADDRESS 0xD0007672 /end MEASUREMENT
/begin MEASUREMENT LSU_stClbDisable "" UBYTE OneToOne 1 100 0.00 255.0 FORMAT "%5.1" ECU_ADDRESS 0xD00090AC /end MEASUREMENT
/begin MEASUREMENT LSU_stClbTrg_mp "" UBYTE OneToOne 1 100 0.00 255.0 FORMAT "%5.1" ECU_ADDRESS 0xC00011D8 /end MEASUREMENT
/begin MEASUREMENT LSU_stDiaIAEna "" UBYTE OneToOne 1 100 0.00 255.0 FORMAT "%5.1" ARRAY_SIZE 1 ECU_ADDRESS 0xD00090AE /end MEASUREMENT
/begin MEASUREMENT LSU_stHtCoupActv "" UBYTE OneToOne 1 100 0.00 255.0 FORMAT "%5.1" ECU_ADDRESS 0xD00090AF /end MEASUREMENT
/begin MEASUREMENT LSU_stHtDis "" UBYTE OneToOne 1 100 0.00 255.0 FORMAT "%5.1" ECU_ADDRESS 0xD00090B1 /end MEASUREMENT
/begin MEASUREMENT LSU_stHtDisbl "" UBYTE OneToOne 1 100 0.00 255.0 FORMAT "%5.1" ARRAY_SIZE 1 ECU_ADDRESS 0xD00090B2 /end MEASUREMENT
/begin MEASUREMENT LSU_stIniClb "" UBYTE OneToOne 1 100 0.00 255.0 FORMAT "%5.1" ECU_ADDRESS 0xD00090B3 /end MEASUREMENT
/begin MEASUREMENT LSU_stIpHiCurrEna "" UBYTE OneToOne 1 100 0.00 255.0 FORMAT "%5.1" ARRAY_SIZE 1 ECU_ADDRESS 0xD00090B4 /end MEASUREMENT
/begin MEASUREMENT LSU_stIpNrmCurrEna "" UBYTE OneToOne 1 100 0.00 255.0 FORMAT "%5.1" ARRAY_SIZE 1 ECU_ADDRESS 0xD00090B5 /end MEASUREMENT
/begin MEASUREMENT LSU_stIsolChkActv "" UBYTE OneToOne 1 100 0.00 255.0 FORMAT "%5.1" ARRAY_SIZE 1 ECU_ADDRESS 0xD00090B6 /end MEASUREMENT
/begin MEASUREMENT LSU_stIsolChkO2Last "" UBYTE OneToOne 1 100 0.00 255.0 FORMAT "%5.1" ARRAY_SIZE 1 ECU_ADDRESS 0xD00090B7 /end MEASUREMENT
/begin MEASUREMENT LSU_stIsolChkStrt "" UBYTE OneToOne 1 100 0.00 255.0 FORMAT "%5.1" ARRAY_SIZE 1 ECU_ADDRESS 0xD00090B8 /end MEASUREMENT
/begin MEASUREMENT LSU_stNotOpPoint1_mp "" UBYTE OneToOne 1 100 0.00 255.0 FORMAT "%5.1" ECU_ADDRESS 0xC00011D9 /end MEASUREMENT
/begin MEASUREMENT LSU_stNotOpPoint2_mp "" UBYTE OneToOne 1 100 0.00 255.0 FORMAT "%5.1" ECU_ADDRESS 0xC00011DA /end MEASUREMENT
/begin MEASUREMENT LSU_stO2Act "" UBYTE OneToOne 1 100 0.00 255.0 FORMAT "%5.1" ARRAY_SIZE 1 ECU_ADDRESS 0xD00090B9 /end MEASUREMENT
/begin MEASUREMENT LSU_stO2ClbEna "" UBYTE OneToOne 1 100 0.00 255.0 FORMAT "%5.1" ECU_ADDRESS 0xD00090BA /end MEASUREMENT
/begin MEASUREMENT LSU_stO2Clb_mp "" UBYTE OneToOne 1 100 0.00 255.0 FORMAT "%5.1" ECU_ADDRESS 0xC00011E0 /end MEASUREMENT
/begin MEASUREMENT LSU_stO2IntValid "" UBYTE OneToOne 1 100 0.00 255.0 FORMAT "%5.1" ARRAY_SIZE 1 ECU_ADDRESS 0xD00090BB /end MEASUREMENT
/begin MEASUREMENT LSU_stO2SPICalDem "" UBYTE OneToOne 1 100 0.00 255.0 FORMAT "%5.1" ECU_ADDRESS 0xD00090BC /end MEASUREMENT
/begin MEASUREMENT LSU_stPmpDemRef "" UBYTE OneToOne 1 100 0.00 255.0 FORMAT "%5.1" ARRAY_SIZE 1 ECU_ADDRESS 0xD00090C1 /end MEASUREMENT
/begin MEASUREMENT LSU_stPmpEna "" UBYTE OneToOne 1 100 0.00 255.0 FORMAT "%5.1" ARRAY_SIZE 1 ECU_ADDRESS 0xD00090C2 /end MEASUREMENT
/begin MEASUREMENT LSU_stRecValEval_mp "" UBYTE OneToOne 1 100 0.00 255.0 FORMAT "%5.1" ARRAY_SIZE 1 ECU_ADDRESS 0xC00011FA /end MEASUREMENT
/begin MEASUREMENT LSU_stRefPmp "" UBYTE OneToOne 1 100 0.00 255.0 FORMAT "%5.1" ARRAY_SIZE 1 ECU_ADDRESS 0xD00090C3 /end MEASUREMENT
/begin MEASUREMENT LSU_stRiClb "" UBYTE OneToOne 1 100 0.00 255.0 FORMAT "%5.1" ECU_ADDRESS 0xD00090C4 /end MEASUREMENT
/begin MEASUREMENT LSU_stRiClbEna "" UBYTE OneToOne 1 100 0.00 255.0 FORMAT "%5.1" ECU_ADDRESS 0xD00090C5 /end MEASUREMENT
/begin MEASUREMENT LSU_stRiSPICalDem "" UBYTE OneToOne 1 100 0.00 255.0 FORMAT "%5.1" ECU_ADDRESS 0xD00090C6 /end MEASUREMENT
/begin MEASUREMENT LSU_stRiValid "" UBYTE OneToOne 1 100 0.00 255.0 FORMAT "%5.1" ARRAY_SIZE 1 ECU_ADDRESS 0xD00090C7 /end MEASUREMENT
/begin MEASUREMENT LSU_stSPIIniVal "" UWORD OneToOne 1 100 0.00 65535.00 FORMAT "%8.2" ARRAY_SIZE 1 ECU_ADDRESS 0xD0007678 /end MEASUREMENT
/begin MEASUREMENT LSU_stStrtClb "" UBYTE OneToOne 1 100 0.00 255.0 FORMAT "%5.1" ECU_ADDRESS 0xD00090C9 /end MEASUREMENT
/begin MEASUREMENT LSU_stTmrClbPerRun "" UBYTE OneToOne 1 100 0.00 255.0 FORMAT "%5.1" ECU_ADDRESS 0xD00090CA /end MEASUREMENT
/begin MEASUREMENT LSU_stTstTrigger_mp "" UBYTE OneToOne 1 100 0.00 255.0 FORMAT "%5.1" ARRAY_SIZE 1 ECU_ADDRESS 0xC00011FB /end MEASUREMENT
/begin MEASUREMENT LSU_stWireDiaChk_mp "" UBYTE OneToOne 1 100 0.00 255.0 FORMAT "%5.1" ARRAY_SIZE 1 ECU_ADDRESS 0xC00011FC /end MEASUREMENT
/begin MEASUREMENT LSU_stWireDiaErr_mp "" UBYTE OneToOne 1 100 0.00 255.0 FORMAT "%5.1" ARRAY_SIZE 1 ECU_ADDRESS 0xC00011FD /end MEASUREMENT
/begin MEASUREMENT LSU_swtEna "" UBYTE OneToOne 1 100 0.00 255.0 FORMAT "%5.1" ECU_ADDRESS 0xD00090CC /end MEASUREMENT
/begin MEASUREMENT LSU_tiPT1FltO2RawConst "" SLONG TimeDelay_ms 1 100 0.0020000000009 4294967.2960 FORMAT "%12.4" ECU_ADDRESS 0xD0004348 /end MEASUREMENT
/begin MEASUREMENT LSU_tiPT1FltRiRawConst "" SLONG TimeDelay_ms 1 100 0.0020000000009 4294967.2960 FORMAT "%12.4" ECU_ADDRESS 0xD000434C /end MEASUREMENT
/begin MEASUREMENT LSU_tRi "" SWORD Temp_Cels 1 100 -3549.940 3003.560 FORMAT "%8.3" ARRAY_SIZE 1 ECU_ADDRESS 0xD000735C /end MEASUREMENT
/begin MEASUREMENT LSU_uO2Clb "" SWORD Volt 1 100 -6553.600 6553.400 FORMAT "%8.3" ARRAY_SIZE 1 ECU_ADDRESS 0xD000735E /end MEASUREMENT
/begin MEASUREMENT LSU_uO2Flt "" SWORD Volt 1 100 -6553.600 6553.400 FORMAT "%8.3" ARRAY_SIZE 1 ECU_ADDRESS 0xD0007360 /end MEASUREMENT
/begin MEASUREMENT LSU_uO2FltRippel_mp "" SWORD Volt 1 100 -6553.600 6553.400 FORMAT "%8.3" ARRAY_SIZE 1 ECU_ADDRESS 0xC00011FE /end MEASUREMENT
/begin MEASUREMENT LSU_uO2FltSegOld_mp "" SLONG Volt 1 100 -429496729.600 429496729.400 FORMAT "%13.3" ECU_ADDRESS 0xC00011E8 /end MEASUREMENT
/begin MEASUREMENT LSU_uO2Grad_mp "" SWORD Volt 1 100 -6553.600 6553.400 FORMAT "%8.3" ARRAY_SIZE 1 ECU_ADDRESS 0xC0001200 /end MEASUREMENT
/begin MEASUREMENT LSU_uO2HtCoupStp1 "" SWORD Volt 1 100 -6553.600 6553.400 FORMAT "%8.3" ARRAY_SIZE 1 ECU_ADDRESS 0xD0007362 /end MEASUREMENT
/begin MEASUREMENT LSU_uO2HtCoupStp2 "" SWORD Volt 1 100 -6553.600 6553.400 FORMAT "%8.3" ARRAY_SIZE 1 ECU_ADDRESS 0xD0007364 /end MEASUREMENT
/begin MEASUREMENT LSU_uO2HtCoupStp3 "" SWORD Volt 1 100 -6553.600 6553.400 FORMAT "%8.3" ARRAY_SIZE 1 ECU_ADDRESS 0xD0007366 /end MEASUREMENT
/begin MEASUREMENT LSU_uO2Raw "" SWORD Volt 1 100 -6553.600 6553.400 FORMAT "%8.3" ARRAY_SIZE 1 ECU_ADDRESS 0xD000736A /end MEASUREMENT
/begin MEASUREMENT LSU_uO2RawAdcDirect_mp "" SWORD Volt 1 100 -6553.600 6553.400 FORMAT "%8.3" ARRAY_SIZE 1 ECU_ADDRESS 0xC00011EC /end MEASUREMENT
/begin MEASUREMENT LSU_uO2RawOfsCor "" SWORD Volt 1 100 -6553.600 6553.400 FORMAT "%8.3" ARRAY_SIZE 1 ECU_ADDRESS 0xD0007368 /end MEASUREMENT
/begin MEASUREMENT LSU_uO2RawOfsCorLast_mp "" SWORD Volt 1 100 -6553.600 6553.400 FORMAT "%8.3" ECU_ADDRESS 0xC00011E4 /end MEASUREMENT
/begin MEASUREMENT LSU_uO2Raw_mp "" SWORD Volt 1 100 -6553.600 6553.400 FORMAT "%8.3" ARRAY_SIZE 1 ECU_ADDRESS 0xC00011E2 /end MEASUREMENT
/begin MEASUREMENT LSU_uO2Rippel_mp "" SWORD Volt 1 100 -6553.600 6553.400 FORMAT "%8.3" ARRAY_SIZE 1 ECU_ADDRESS 0xC0001202 /end MEASUREMENT
/begin MEASUREMENT LSU_uRiFlt "" SWORD Volt 1 100 -6553.600 6553.400 FORMAT "%8.3" ARRAY_SIZE 1 ECU_ADDRESS 0xD000736C /end MEASUREMENT
/begin MEASUREMENT LSU_uRiRaw "" SWORD Volt 1 100 -6553.600 6553.400 FORMAT "%8.3" ARRAY_SIZE 1 ECU_ADDRESS 0xD0007370 /end MEASUREMENT
/begin MEASUREMENT LSU_uRiRawOfsCor "" SWORD Volt 1 100 -6553.600 6553.400 FORMAT "%8.3" ARRAY_SIZE 1 ECU_ADDRESS 0xD000736E /end MEASUREMENT
/begin MEASUREMENT LSU_uRiRaw_mp "" SWORD Volt 1 100 -6553.600 6553.400 FORMAT "%8.3" ARRAY_SIZE 1 ECU_ADDRESS 0xC00011F4 /end MEASUREMENT
/begin MEASUREMENT TrbnDsRLam_stO2IntValid "" UBYTE OneToOne 1 100 0.00 255.0 FORMAT "%5.1" ECU_ADDRESS 0xD000918C /end MEASUREMENT
/begin FUNCTION Injctl_qCo ""
 /begin DEF_CHARACTERISTIC InjCtl_facAdjSrvMax_C InjCtl_facAdjSrvMin_C InjCtl_facAdjSrvUnlimDfl_C InjCtl_qAdjQntMax_C InjCtl_qAdjQntMin_C InjCtl_qAdjQnt_MAP InjCtl_qDriftComp_MAP InjCtl_qDriftMax2_C InjCtl_qDriftMin2_C InjCtl_qLimSoftShOff_CUR /end DEF_CHARACTERISTIC
 /begin IN_MEASUREMENT ASMod_qCor CnvLead_qCurr CnvLead_qRaw CnvSet_qSet CnvSet_qStrt CoEng_st CoEng_stAftRunPath CoEng_stShutOffPath Epm_nEng InjSys_qLim /end IN_MEASUREMENT
 /begin OUT_MEASUREMENT InjCtl_qCurr InjCtl_qCurrAdd_mp InjCtl_qCurrB1 InjCtl_qCurrB2 InjCtl_qRaw InjCtl_qRawAdd_mp InjCtl_qRawB1 InjCtl_qRawB2 InjCtl_qSetUnBal InjCtl_qSetUnBalAdd_mp InjCtl_qSetUnBalB1 InjCtl_qSetUnBalB2 /end OUT_MEASUREMENT
 /begin LOC_MEASUREMENT InjCtl_dAdjQntCS_mp InjCtl_dDriftCS_mp InjCtl_facAdjSrvUnlim_mp InjCtl_facAdjSrv_mp InjCtl_qAdjQntUnlim_mp InjCtl_qAdjQnt_mp InjCtl_qCurrByp_mp InjCtl_qDriftComp_mp InjCtl_qDriftLim1_mp InjCtl_qDriftLim2_mp InjCtl_qDriftMax1_mp InjCtl_qDriftMin1_mp InjCtl_qDriftUnlim_mp InjCtl_qLimSoftShOff_mp InjCtl_qRawByp_mp InjCtl_qSetUnBalByp_mp InjCtl_qSetUnCor_mp InjCtl_stAdjQnt_mp InjCtl_tiEngOn_mp InjCtl_trqInrLim /end LOC_MEASUREMENT
/end FUNCTION
/begin FUNCTION injsys_co ""
 /begin DEF_CHARACTERISTIC InjSys_ctTempSel_C InjSys_dqLim.Pos_C InjSys_dqLim.Neg_C InjSys_qTempFuelErr_CUR InjSys_qTempFuel_MAP /end DEF_CHARACTERISTIC
 /begin IN_MEASUREMENT Epm_nEng FuelT_t HPUn_qLim HPUn_trqLoss /end IN_MEASUREMENT
 /begin OUT_MEASUREMENT InjSys_qLim InjSys_qTempFuel InjSys_stqLimErrActive InjSys_tEng InjSys_trqLoss /end OUT_MEASUREMENT
/end FUNCTION
/begin FUNCTION InjSys_CtlQnt ""
 /begin IN_MEASUREMENT CoEng_stShutOffPath Epm_ctCyl InjCrv_qMI1Des InjCrv_qPiI1Des InjCrv_qPiI2Des InjCrv_qPiI3Des InjCrv_qPoI1Des InjCrv_qPoI2Des InjCrv_stInjCharActVal PthSet_stDisable /end IN_MEASUREMENT
 /begin OUT_MEASUREMENT InjSys_qInrCmb InjSys_qOutrCmb InjSys_qTot /end OUT_MEASUREMENT
 /begin LOC_MEASUREMENT InjSys_stCtlQnt /end LOC_MEASUREMENT
/end FUNCTION
/begin FUNCTION InjSys_Lib ""
 /begin IN_MEASUREMENT InjCrv_qPiI1Des InjCrv_qPiI2Des InjCrv_qPiI3Des InjCrv_qPoI1Des InjCrv_qPoI2Des InjCrv_qPoI2Eff InjSys_qInrCmb InjSys_qOutrCmb /end IN_MEASUREMENT
/end FUNCTION
/begin FUNCTION InjSys_State "" /begin OUT_MEASUREMENT InjSys_st /end OUT_MEASUREMENT /end FUNCTION
/begin FUNCTION InjUn_MassCnv "" /end FUNCTION
/begin FUNCTION InjUn_StrtTst ""
 /begin DEF_CHARACTERISTIC InjUn_ctSyncStrtPls_C InjUn_nStrtLim_C InjUn_stShOffStrt_C InjUn_swtStrtPls_C InjUn_tiIRevShOffStrtPls_C InjUn_tiRailStrtPls_C InjUn_tiRevShOffStrtPls_C InjUn_tiSpdStrtPls_C /end DEF_CHARACTERISTIC
 /begin IN_MEASUREMENT CoEng_st CoEng_stIRevShutOff CoEng_stRevShutOff Epm_nEng Epm_stSync InjVlv_st /end IN_MEASUREMENT
 /begin OUT_MEASUREMENT InjUn_stStrt /end OUT_MEASUREMENT
 /begin LOC_MEASUREMENT InjUn_stStrtCsBlk_mp /end LOC_MEASUREMENT
/end FUNCTION
/begin FUNCTION InjVlv_AddBal "" /begin DEF_CHARACTERISTIC InjVlv_facAddBalRls_MAP /end DEF_CHARACTERISTIC /begin IN_MEASUREMENT Epm_ctCyl InjCtl_qSetUnBal RailP_pFlt /end IN_MEASUREMENT /begin OUT_MEASUREMENT InjVlv_facAddBalRls /end OUT_MEASUREMENT /end FUNCTION
/begin FUNCTION InjVlv_AddBalLib "" /begin DEF_CHARACTERISTIC InjVlv_facBalMax_C /end DEF_CHARACTERISTIC
 /begin LOC_MEASUREMENT InjVlv_qMI1Bal_mp InjVlv_qPiI1Bal_mp InjVlv_qPiI2Bal_mp InjVlv_qPiI3Bal_mp InjVlv_qPoI1Bal_mp InjVlv_qPoI2BalEff_mp InjVlv_qPoI2Bal_mp /end LOC_MEASUREMENT
/end FUNCTION
/begin FUNCTION InjVlv_AddBalZFC "" /end FUNCTION
/begin FUNCTION injvlv_auto "" /end FUNCTION
/begin FUNCTION InjVlv_CalcMI1ET ""
 /begin DEF_CHARACTERISTIC InjVlv_nETMaxLim_C InjVlv_swtTiMI1ET_C InjVlv_tiETMax_C InjVlv_tiMI1ET_C /end DEF_CHARACTERISTIC
 /begin REF_CHARACTERISTIC InjVlv_tiETMinLow_C /end REF_CHARACTERISTIC
 /begin LOC_MEASUREMENT InjVlv_tiMI1ETUnLim_mp InjVlv_tiMI1ET_mp /end LOC_MEASUREMENT
/end FUNCTION
/begin FUNCTION InjVlv_CalcPiI1ET "" /begin DEF_CHARACTERISTIC InjVlv_swtTiPiI1ET_C InjVlv_tiPiI1ET_C /end DEF_CHARACTERISTIC /begin REF_CHARACTERISTIC InjVlv_tiETMinLow_C /end REF_CHARACTERISTIC /begin OUT_MEASUREMENT InjVlv_tiZFCPiI1ETCor /end OUT_MEASUREMENT /begin LOC_MEASUREMENT InjVlv_tiPiI1ET_mp /end LOC_MEASUREMENT /end FUNCTION
/begin FUNCTION InjVlv_CalcPiI2ET "" /begin DEF_CHARACTERISTIC InjVlv_swtTiPiI2ET_C InjVlv_tiPiI2ET_C /end DEF_CHARACTERISTIC /begin REF_CHARACTERISTIC InjVlv_tiETMinLow_C /end REF_CHARACTERISTIC /begin OUT_MEASUREMENT InjVlv_tiZFCPiI2ETCor /end OUT_MEASUREMENT /begin LOC_MEASUREMENT InjVlv_tiPiI2ET_mp /end LOC_MEASUREMENT /end FUNCTION
/begin FUNCTION InjVlv_CalcPiI3Et "" /begin DEF_CHARACTERISTIC InjVlv_swtTiPiI3ET_C InjVlv_tiPiI3ET_C /end DEF_CHARACTERISTIC /begin REF_CHARACTERISTIC InjVlv_tiETMinLow_C /end REF_CHARACTERISTIC /begin OUT_MEASUREMENT InjVlv_tiZFCPiI3ETCor /end OUT_MEASUREMENT /begin LOC_MEASUREMENT InjVlv_tiPiI3ET_mp /end LOC_MEASUREMENT /end FUNCTION
/begin FUNCTION InjVlv_CalcPoI1ET "" /begin DEF_CHARACTERISTIC InjVlv_swtTiPoI1ET_C InjVlv_tiPoI1ET_C /end DEF_CHARACTERISTIC /begin REF_CHARACTERISTIC InjVlv_tiETMinLow_C /end REF_CHARACTERISTIC /begin LOC_MEASUREMENT InjVlv_tiPoI1ET_mp /end LOC_MEASUREMENT /end FUNCTION
/begin FUNCTION InjVlv_CalcPoI2ET "" /begin DEF_CHARACTERISTIC InjVlv_swtTiPoI2ET_C InjVlv_tiPoI2ET_C /end DEF_CHARACTERISTIC /begin REF_CHARACTERISTIC InjVlv_tiETMinLow_C /end REF_CHARACTERISTIC /begin LOC_MEASUREMENT InjVlv_tiPoI2ET_mp /end LOC_MEASUREMENT /end FUNCTION
/begin FUNCTION InjVlv_ChrgBalInjLim ""
 /begin DEF_CHARACTERISTIC InjVlv_numInjChrgBal_MAP InjVlv_rChrgBalEngSpdHys_C InjVlv_rChrgBalVltgHys_C /end DEF_CHARACTERISTIC
 /begin IN_MEASUREMENT BattU_u Epm_nEng /end IN_MEASUREMENT
 /begin LOC_MEASUREMENT InjVlv_numInjChrgBal_mp /end LOC_MEASUREMENT
/end FUNCTION
/begin FUNCTION InjVlv_EstET "" /end FUNCTION
/begin FUNCTION InjVlv_GetBgn "" /end FUNCTION
/begin FUNCTION InjVlv_GetET "" /begin DEF_CHARACTERISTIC InjVlv_swtInputETMAP_C InjVlv_tiET_MAP /end DEF_CHARACTERISTIC /begin LOC_MEASUREMENT InjVlv_pInET_mp InjVlv_volInET_mp /end LOC_MEASUREMENT /end FUNCTION
/begin FUNCTION InjVlv_GetInfo "" /end FUNCTION
/begin FUNCTION InjVlv_GetOvrInf "" /end FUNCTION
/begin FUNCTION InjVlv_HDIni "" /begin DEF_CHARACTERISTIC InjVlv_tiWup2On_C /end DEF_CHARACTERISTIC /begin REF_CHARACTERISTIC InjVlv_tiETMinLow_C /end REF_CHARACTERISTIC /end FUNCTION
/begin FUNCTION InjVlv_HDLib "" /begin DEF_CHARACTERISTIC InjVlv_numBnkTDC_CA InjVlv_numECUTDC_CA InjVlv_numPsTDC_CA /end DEF_CHARACTERISTIC /begin IN_MEASUREMENT Epm_nEng Epm_numCyl /end IN_MEASUREMENT /end FUNCTION
/begin FUNCTION InjVlv_InjCo "" /begin DEF_CHARACTERISTIC InjVlv_stInjCoRC_C InjVlv_swtInjCoRC_C /end DEF_CHARACTERISTIC /begin IN_MEASUREMENT IVActr_stCond IVPSply_stBufErr MoCSOP_stActvMsg /end IN_MEASUREMENT /begin OUT_MEASUREMENT InjVlv_stInjCo /end OUT_MEASUREMENT /begin LOC_MEASUREMENT InjVlv_stInjCoRun_mp /end LOC_MEASUREMENT /end FUNCTION
/begin FUNCTION InjVlv_InjRls "" /begin DEF_CHARACTERISTIC InjVlv_stInjCharComp_C InjVlv_stInjRls_CA /end DEF_CHARACTERISTIC /begin IN_MEASUREMENT Epm_ctCyl /end IN_MEASUREMENT /begin OUT_MEASUREMENT InjVlv_stInjCharComp InjVlv_stInjRls /end OUT_MEASUREMENT /end FUNCTION
/begin FUNCTION InjVlv_MI1DynQntCor ""
 /begin LOC_MEASUREMENT InjVlv_ctCylMI1_mp InjVlv_qMI1Cor_mp InjVlv_volMI1Cor_mp InjVlv_volMI1_mp /end LOC_MEASUREMENT
/end FUNCTION
/begin FUNCTION InjVlv_MI2DynQntCor "" /begin LOC_MEASUREMENT InjVlv_ctCylMI2_mp /end LOC_MEASUREMENT /end FUNCTION
/begin FUNCTION InjVlv_PiI1DynQntCor ""
 /begin LOC_MEASUREMENT InjVlv_ctCylPiI1_mp InjVlv_qPiI1Cor_mp InjVlv_volPiI1Cor_mp InjVlv_volPiI1_mp /end LOC_MEASUREMENT
/end FUNCTION
/begin FUNCTION InjVlv_PiI2DynQntCor ""
 /begin LOC_MEASUREMENT InjVlv_ctCylPiI2_mp InjVlv_qPiI2Cor_mp InjVlv_volPiI2Cor_mp InjVlv_volPiI2_mp /end LOC_MEASUREMENT
/end FUNCTION
/begin FUNCTION InjVlv_PiI3DynQntCor ""
 /begin LOC_MEASUREMENT InjVlv_ctCylPiI3_mp InjVlv_qPiI3Cor_mp InjVlv_volPiI3Cor_mp InjVlv_volPiI3_mp /end LOC_MEASUREMENT
/end FUNCTION
/begin FUNCTION InjVlv_PoI1DynQntCor "" /begin DEF_CHARACTERISTIC InjVlv_qPoI1Min_C /end DEF_CHARACTERISTIC
 /begin LOC_MEASUREMENT InjVlv_ctCylPoI1_mp InjVlv_qPoI1Cor_mp InjVlv_volPoI1Cor_mp InjVlv_volPoI1_mp /end LOC_MEASUREMENT
/end FUNCTION
/begin FUNCTION InjVlv_PoI2DynQntCor ""
 /begin LOC_MEASUREMENT InjVlv_ctCylPoI2_mp InjVlv_qPoI2Cor_mp InjVlv_volPoI2Cor_mp InjVlv_volPoI2_mp /end LOC_MEASUREMENT
/end FUNCTION
/begin FUNCTION InjVlv_PresMin "" /begin DEF_CHARACTERISTIC InjVlv_pMin_C InjVlv_pMin_CUR /end DEF_CHARACTERISTIC /begin IN_MEASUREMENT CoEng_st EngDa_tEng Rail_stCtlLoop /end IN_MEASUREMENT /end FUNCTION
/begin FUNCTION InjVlv_ProgETLib ""
 /begin LOC_MEASUREMENT InjVlv_stInjMI1_mp InjVlv_stInjMI2_mp InjVlv_stInjPiI1_mp InjVlv_stInjPiI2_mp InjVlv_stInjPiI3_mp InjVlv_stInjPoI1_mp InjVlv_stInjPoI2_mp /end LOC_MEASUREMENT
/end FUNCTION
/begin FUNCTION InjVlv_ProgETZFC "" /begin LOC_MEASUREMENT InjVlv_stInjZFC_mp /end LOC_MEASUREMENT /end FUNCTION
/begin FUNCTION InjVlv_ProgMI "" /begin LOC_MEASUREMENT InjVlv_ctMI1AgDiff_mp InjVlv_phiMI1Diff_mp /end LOC_MEASUREMENT /end FUNCTION
/begin FUNCTION InjVlv_ProgPiI "" /begin LOC_MEASUREMENT InjVlv_ctPiI1AgDiff_mp InjVlv_phiPiI1Diff_mp /end LOC_MEASUREMENT /end FUNCTION
/begin FUNCTION InjVlv_ProgPiI2 "" /begin LOC_MEASUREMENT InjVlv_ctPiI2AgDiff_mp InjVlv_phiPiI2Diff_mp /end LOC_MEASUREMENT /end FUNCTION
/begin FUNCTION InjVlv_ProgPiI3 "" /begin LOC_MEASUREMENT InjVlv_ctPiI3AgDiff_mp InjVlv_phiPiI3Diff_mp /end LOC_MEASUREMENT /end FUNCTION
/begin FUNCTION InjVlv_ProgPoI1 "" /end FUNCTION
/begin FUNCTION InjVlv_ProgPoI2 "" /end FUNCTION
/begin FUNCTION InjVlv_ProgZFC "" /end FUNCTION
/begin FUNCTION InjVlv_PsICLib "" /begin DEF_CHARACTERISTIC InjVlv_tiBusyMax_C /end DEF_CHARACTERISTIC /end FUNCTION
/begin FUNCTION InjVlv_Sched ""
 /begin DEF_CHARACTERISTIC InjVlv_PZOSW_C InjVlv_stInjMode_C InjVlv_swtEnaAgDiff_C InjVlv_tiETMinLow_C /end DEF_CHARACTERISTIC
 /begin IN_MEASUREMENT CoEng_stShutOffPath Epm_ctCyl Epm_nEng Epm_numCyl FBC_qArr FlSys_rhoFl InjCrv_qMI1Des InjCrv_qPiI1Des InjCrv_qPiI2Des InjCrv_qPiI3Des InjCrv_qPoI1Des InjCrv_qPoI2Des InjCrv_qPoI2Eff InjCrv_stInjCharActVal InjCtl_qSetUnBal InjVlv_facAddBalRls IVCtl_iChrg IVCtl_iDisCh IVCtl_tiChrg IVCtl_tiPseChrg IVCtl_tiPseDisCh QWC_facFTS QWC_qNorm QWC_st RailP_pFlt /end IN_MEASUREMENT
 /begin OUT_MEASUREMENT InjVlv_stTCtlInj_mp InjVlv_volMI1CorCyc InjVlv_volPiI1CorCyc InjVlv_volPiI2CorCyc /end OUT_MEASUREMENT
/end FUNCTION
/begin FUNCTION InjVlv_SetBgn "" /end FUNCTION
/begin FUNCTION InjVlv_SetDur "" /end FUNCTION
/begin FUNCTION InjVlv_SetImmdInj "" /end FUNCTION
/begin FUNCTION InjVlv_SetTiPse "" /begin DEF_CHARACTERISTIC InjVlv_tiPause_C /end DEF_CHARACTERISTIC /begin OUT_MEASUREMENT InjVlv_tiPse /end OUT_MEASUREMENT /end FUNCTION
/begin FUNCTION InjVlv_SetupInjProc "" /end FUNCTION
/begin FUNCTION InjVlv_SPIDia "" /end FUNCTION
/begin FUNCTION InjVlv_SPIIni "" /begin REF_CHARACTERISTIC InjVlv_numBnkTDC_CA /end REF_CHARACTERISTIC
 /begin OUT_MEASUREMENT InjVlv_PsIcStIniDiag InjVlv_PsIcStIniTrans InjVlv_stPsIcChipVer_mp InjVlv_stPsIcIni_mp /end OUT_MEASUREMENT
/end FUNCTION
/begin FUNCTION InjVlv_SPIInjDia ""
 /begin LOC_MEASUREMENT InjVlv_stPsIcDia_mp InjVlv_stPsIcNumBnkPcP_mp InjVlv_stPsIcNumBnk_mp InjVlv_stPsIcNumChipPcP_mp InjVlv_stPsIcNumChip_mp InjVlv_stPsIcNumDatEx_mp InjVlv_stPsIcNumTrgTra_mp InjVlv_stPsIcRdBufIdx_mp InjVlv_stPsIcStBufDatEx_mp InjVlv_stPsIcStBufTraInj_mp InjVlv_stPsIcTra_mp InjVlv_stPsIcWrBufIdx_mp /end LOC_MEASUREMENT
/end FUNCTION
/begin FUNCTION InjVlv_SPILib "" /end FUNCTION
/begin FUNCTION InjVlv_SPIMemChk "" /end FUNCTION
/begin FUNCTION InjVlv_State "" /begin IN_MEASUREMENT EngDa_tEng InjVlv_stInjCo IVDia_st RailP_pFlt /end IN_MEASUREMENT /begin OUT_MEASUREMENT InjVlv_st /end OUT_MEASUREMENT /end FUNCTION
/begin FUNCTION InjVlv_ZFCETCor ""
 /begin DEF_CHARACTERISTIC InjVlv_pRailZFCETCor_AXIS InjVlv_qZFCETCor_AXIS InjVlv_rZFCETDif0_GMAP InjVlv_rZFCETDif1_GMAP InjVlv_rZFCETDif2_GMAP InjVlv_rZFCETDif3_GMAP InjVlv_rZFCETDif4_GMAP InjVlv_rZFCETDif5_GMAP InjVlv_rZFCETDif6_GMAP InjVlv_rZFCETMsk_GMAP InjVlv_stInputZFCETGMap_C InjVlv_stZFCETCorActv_C InjVlv_swtZFCCorOvrRunOn_C InjVlv_tiZFCETCorMax_C InjVlv_tiZFCETCorMin_C /end DEF_CHARACTERISTIC
 /begin IN_MEASUREMENT MoFOvR_stActvMsg RailP_pCurr_mp /end IN_MEASUREMENT
 /begin LOC_MEASUREMENT InjVlv_qInZFCETGMap_mp InjVlv_rZFCETCoeffDif_mp InjVlv_rZFCETCoeffMsk_mp InjVlv_tiPiI1ZFCETCor_mp InjVlv_tiPiI2ZFCETCor_mp InjVlv_tiPiI3ZFCETCor_mp /end LOC_MEASUREMENT
/end FUNCTION
/begin FUNCTION ISC_CoreHiPth ""
 /begin IN_MEASUREMENT ASDrf_trqInrSet Epm_nEng ISC_nEngPT2Ftl ISC_nSetPHi ISC_nSetPLo ISC_numCurrFunc ISC_st ISC_tiPT1TrqFlt ISC_trqLoLimMax ISC_trqLoLimMin ISC_trqLossFlt PthSet_trqInrSet SpdGov_trqInrLimSet /end IN_MEASUREMENT
 /begin OUT_MEASUREMENT ISC_trq ISC_trqFlt /end OUT_MEASUREMENT
 /begin LOC_MEASUREMENT ISC_KpHiCurr_mp ISC_KpNegHiCurr_mp ISC_KpPosHiCurr_mp ISC_nDiffHi_mp ISC_PWinNegHiCurr_mp ISC_PWinPosHiCurr_mp ISC_stHiLo_mp ISC_stPthSel_mp ISC_trqHiLimMax_mp ISC_trqHiLimMin_mp ISC_trqIscAsd_mp ISC_trqLossFltK4_mp ISC_trqPHi_mp ISC_trqSetLtd_mp ISC_trqSet_mp /end LOC_MEASUREMENT
/end FUNCTION
/begin FUNCTION ISC_CoreLoPth ""
 /begin IN_MEASUREMENT Com_vBd Conv_bTrbnSpdCan Conv_nTrbn Conv_nTrbnMod CoPT_trqDesCompEng Epm_nEng ISC_nSetPHi ISC_nSetPLo ISC_numCurrFunc ISC_trqLoLimMax ISC_trqLoLimMin ISC_trqReq PthSet_trqInrSet VehMot_stSlip /end IN_MEASUREMENT
 /begin OUT_MEASUREMENT ISC_nEngPT2Ftl ISC_trqLoLtd ISC_trqLossFlt /end OUT_MEASUREMENT
 /begin LOC_MEASUREMENT ISC_dnAccLimCurr_mp ISC_dnDeclLimCurr_mp ISC_InrtDrvTrnCurr_mp ISC_InrtDrvTrnSet_mp ISC_InrtEngCurr_mp ISC_InrtVehCurr_mp ISC_InrtVehSet_mp ISC_IWinNegLoCurr_mp ISC_IWinPosLoCurr_mp ISC_KiLoCurr_mp ISC_KiNegLoCurr_mp ISC_KiPosLoCurr_mp ISC_KpLoCurr_mp ISC_KpNegLoCurr_mp ISC_KpPosLoCurr_mp ISC_nAvrgPT1Out_mp ISC_nAvrgPT2Out_mp ISC_nDiffLo_mp ISC_nInTra_mp ISC_nVehBd_mp ISC_PWinNegLoCurr_mp ISC_PWinPosLoCurr_mp ISC_rnEngvVehCurr_mp ISC_stExtIni_mp ISC_tiFltLosTrqEstCurr_mp ISC_tiFltnEngCurr_mp ISC_trqAcc_mp ISC_trqDrvTrnAcc_mp ISC_trqEngAcc_mp ISC_trqILoLtd_mp ISC_trqLoNoPreCtlLtd_mp ISC_trqLoPreCtlLtd_mp ISC_trqLossFltK1_mp ISC_trqLossFltK2_mp ISC_trqLossFltK3_mp ISC_trqLossUnFlt_mp ISC_trqPLo_mp ISC_trqVehAcc_mp /end LOC_MEASUREMENT
/end FUNCTION
/begin FUNCTION ISC_Global "" /end FUNCTION
/begin FUNCTION ISC_SelPar "" /begin DEF_CHARACTERISTIC ISC_stPrio_CA ISC_tiPT1TrqFlt_CUR /end DEF_CHARACTERISTIC /begin IN_MEASUREMENT EngICO_nCtOff Epm_nEng HLSDem_nSetPHi HLSDem_nSetPLo /end IN_MEASUREMENT
 /begin OUT_MEASUREMENT ISC_nSetPHi ISC_nSetPLo ISC_numCurrFunc ISC_numCurrFuncSetPHi ISC_numCurrFuncSetPLo ISC_st ISC_tiPT1TrqFlt /end OUT_MEASUREMENT
 /begin LOC_MEASUREMENT ISC_nDiffLoFlt_mp /end LOC_MEASUREMENT
/end FUNCTION
/begin FUNCTION ISC_SelTrqLimTrjPln ""
 /begin IN_MEASUREMENT CoETS_trqInrLim CoPT_trqDesCompEng HLSDem_trqLoLimMax HLSDem_trqLoLimMin HLSDem_trqReq ISC_nSetPLo ISC_numCurrFunc ISC_st ISC_trq PthSet_trqInrSet /end IN_MEASUREMENT
 /begin OUT_MEASUREMENT ISC_trqLoLimMax ISC_trqLoLimMin ISC_trqReq /end OUT_MEASUREMENT
/end FUNCTION
/begin FUNCTION IVActr_Cond ""
 /begin DEF_CHARACTERISTIC IVActr_iCondDisCh_CUR IVActr_numCond_C IVActr_pCondMax_C IVActr_stCondRC_C IVActr_swtCondRC_C IVActr_tCondMax_C IVActr_tiCondChrg_CUR IVActr_tiCondET_CUR IVActr_tiCondPseDisCh_CUR IVActr_uCondChrg_CUR /end DEF_CHARACTERISTIC
 /begin REF_CHARACTERISTIC InjVlv_numBnkTDC_CA IVCtl_iChrg_MAP IVCtl_tiPseChrg_CUR /end REF_CHARACTERISTIC
 /begin IN_MEASUREMENT Epm_numCyl InjVlv_stInjCo IVActr_tActr IVPSply_stBufErr RailP_pFlt /end IN_MEASUREMENT
 /begin OUT_MEASUREMENT IVActr_iCondChrg_mp IVActr_iCondDisCh_mp IVActr_numCondLeft_mp IVActr_stCond IVActr_stCondInjErr_mp IVActr_stCondInjOK_mp IVActr_stCondPreCond_mp IVActr_tiCondChrg_mp IVActr_tiCondET_mp IVActr_tiCondPseChrg_mp IVActr_tiCondPseDisCh_mp IVActr_uCondChrg_mp /end OUT_MEASUREMENT
/end FUNCTION
/begin FUNCTION IVActr_GetMeas ""
 /begin DEF_CHARACTERISTIC IVActr_chgChrgRC_C IVActr_numIntrGetMeas_C IVActr_pRailLnkRC_C IVActr_stChgChrgRC_C IVActr_stTiDisChRC_C IVActr_stTiETMeasRC_C IVActr_stUChrgUpRC_C IVActr_stUDisChStopRC_C IVActr_stUUpRC_C IVActr_swtChgChrgRC_C IVActr_swtPRailLnkRC_C IVActr_swtTiChrgLnkRC_C IVActr_swtTiDisChLnkRC_C IVActr_swtTiDisChRC_C IVActr_swtTiETMeasRC_C IVActr_swtUChrgUpRC_C IVActr_swtUDisChStopRC_C IVActr_swtUUpLnkRC_C IVActr_swtUUpRC_C IVActr_tiChrgLnkRC_C IVActr_tiDisChLnkRC_C IVActr_tiDisChRC_C IVActr_tiETMeasRC_C IVActr_uActrLin_CUR IVActr_uChrgUpRC_C IVActr_uDisChStopRC_C IVActr_uUpLnkRC_C IVActr_uUpRC_C IVActr_Vltg_SRC.uMin_C IVActr_Vltg_SRC.uMax_C /end DEF_CHARACTERISTIC
 /begin IN_MEASUREMENT IVCtl_p IVCtl_tiChrg IVCtl_tiDisCh IVCtl_uUp /end IN_MEASUREMENT
 /begin OUT_MEASUREMENT IVActr_chgChrg IVActr_ctIntrGetMeas IVActr_numCylMeasNxt IVActr_pRailLnk IVActr_stChgChrg IVActr_stGetMeas IVActr_stTiDisCh IVActr_stTiETMeas IVActr_stUChrgUp IVActr_stUDisChStop IVActr_stUUp IVActr_tiActrMeasCurr IVActr_tiActrMeasLst IVActr_tiChrgLnk IVActr_tiDisCh IVActr_tiDisChLnk IVActr_tiETMeas IVActr_uChrgUp IVActr_uDisChStop IVActr_uUp IVActr_uUpLnk /end OUT_MEASUREMENT
 /begin LOC_MEASUREMENT IVActr_uActrRaw_mp /end LOC_MEASUREMENT
/end FUNCTION
/begin FUNCTION IVActr_Temp ""
 /begin DEF_CHARACTERISTIC IVActr_SelTemp.xVal_C IVActr_SelTemp.xTyp_C IVActr_tActrDfl_C IVActr_tActr_CUR /end DEF_CHARACTERISTIC
 /begin IN_MEASUREMENT CEngDsT_t FuelT_t /end IN_MEASUREMENT
 /begin OUT_MEASUREMENT IVActr_tActr /end OUT_MEASUREMENT
 /begin LOC_MEASUREMENT IVActr_swtSelTemp IVActr_tActrUnCor_mp /end LOC_MEASUREMENT
/end FUNCTION
/begin FUNCTION IVAdj_Co ""
 /begin DEF_CHARACTERISTIC IVAdj_stQntAdj_MAP IVAdj_stRawValRepl_C IVAdj_swtRawValRepl_C IVAdj_volQntAdjLim_C IVAdj_volQntAdjMax0_C IVAdj_volQntAdjMax1_C IVAdj_volQntAdjMax2_C IVAdj_volQntAdjMax3_C IVAdj_volQntAdjMin0_C IVAdj_volQntAdjMin1_C IVAdj_volQntAdjMin2_C IVAdj_volQntAdjMin3_C /end DEF_CHARACTERISTIC
 /begin IN_MEASUREMENT Epm_numCyl InjVlv_volMI1Cor_mp RailP_pFlt /end IN_MEASUREMENT
 /begin LOC_MEASUREMENT IVAdj_stChkSumErrAdj_mp IVAdj_volMI1QntAdj_mp IVAdj_volPiI1QntAdj_mp IVAdj_volPiI2QntAdj_mp IVAdj_volPiI3QntAdj_mp IVAdj_volPoI1QntAdj_mp IVAdj_volPoI2QntAdj_mp /end LOC_MEASUREMENT
/end FUNCTION
/begin FUNCTION IVAdj_CoLib "" /begin DEF_CHARACTERISTIC IVAdj_numClsIVAMax_C IVAdj_numClsIVAMin_C /end DEF_CHARACTERISTIC /begin OUT_MEASUREMENT IVAdj_clsIVA /end OUT_MEASUREMENT
 /begin LOC_MEASUREMENT IVAdj_stChkErr_mp IVAdj_stIVALimMaxErr_mp IVAdj_stIVALimMinErr_mp /end LOC_MEASUREMENT
/end FUNCTION
/begin FUNCTION IVAdj_NVC "" /begin DEF_CHARACTERISTIC IVAdj_facNVCDfl_CA /end DEF_CHARACTERISTIC /begin OUT_MEASUREMENT IVAdj_facNVC /end OUT_MEASUREMENT /end FUNCTION
/begin FUNCTION IVCtl_TGov ""
 /begin DEF_CHARACTERISTIC IVCtl_iCorPIRC_CA IVCtl_iPIMax_C IVCtl_iPIMin_C IVCtl_ITGov_CSTR.Ki_C IVCtl_ITGov_CSTR.KiPos_C IVCtl_ITGov_CSTR.KiNeg_C IVCtl_ITGov_CSTR.WinPos_C IVCtl_ITGov_CSTR.WinNeg_C IVCtl_mskTGov_C IVCtl_PTGov_CSTR.Kp_C IVCtl_PTGov_CSTR.KpPos_C IVCtl_PTGov_CSTR.KpNeg_C IVCtl_PTGov_CSTR.WinPos_C IVCtl_PTGov_CSTR.WinNeg_C IVCtl_swtICorPIRC_C /end DEF_CHARACTERISTIC
 /begin IN_MEASUREMENT IVActr_stTiDisCh IVActr_tiActrMeasCurr IVActr_tiDisCh IVActr_tiDisChLnk IVCtl_tiChrg /end IN_MEASUREMENT
 /begin OUT_MEASUREMENT IVCtl_iCorPI IVCtl_tiDiff /end OUT_MEASUREMENT
 /begin LOC_MEASUREMENT IVCtl_iCorPIUnLim_mp IVCtl_stTGovPIHi_mp IVCtl_stTGovPILo_mp IVCtl_tiTGovCalc /end LOC_MEASUREMENT
/end FUNCTION
/begin FUNCTION IVCtl_TSetP ""
 /begin DEF_CHARACTERISTIC IVCtl_iDisChRC_CA IVCtl_iDisCh_MAP IVCtl_swtIDisChRC_C IVCtl_swtTiChrgRC_C IVCtl_swtTiDisChRC_C IVCtl_swtTiPseChrgRC_C IVCtl_swtTiPseDisChRC_C IVCtl_tiChrgRC_C IVCtl_tiChrg_CUR IVCtl_tiDisChRC_C IVCtl_tiDisCh_CUR IVCtl_tiPseChrgRC_C IVCtl_tiPseChrg_CUR IVCtl_tiPseDisChRC_C IVCtl_tiPseDisCh_CUR /end DEF_CHARACTERISTIC
 /begin IN_MEASUREMENT IVCtl_iCorPI IVCtl_p IVCtl_uUp RailP_pFlt /end IN_MEASUREMENT
 /begin OUT_MEASUREMENT IVCtl_iDisCh IVCtl_tiChrg IVCtl_tiDisCh IVCtl_tiPseChrg IVCtl_tiPseDisCh /end OUT_MEASUREMENT
 /begin LOC_MEASUREMENT IVCtl_iDisChUnCor_mp IVCtl_uUpMapIn_mp /end LOC_MEASUREMENT
/end FUNCTION
/begin FUNCTION IVCtl_VltgCo ""
 /begin DEF_CHARACTERISTIC IVCtl_facVltgTempCor_CUR IVCtl_iChrgRC_CA IVCtl_iChrg_MAP IVCtl_pRC_C IVCtl_swtIChrgRC_C IVCtl_swtPRC_C IVCtl_swtUUpRC_C IVCtl_uCorPreCtl_CUR IVCtl_uUpMax_C IVCtl_uUpMin_C IVCtl_uUpRC_CA /end DEF_CHARACTERISTIC
 /begin IN_MEASUREMENT IVActr_tActr IVAdj_clsIVA IVAdj_facNVC IVCtl_stStrt IVCtl_tiChrg IVCtl_uCorPI IVCtl_uUpStrt RailP_pFlt /end IN_MEASUREMENT
 /begin OUT_MEASUREMENT IVCtl_iChrg IVCtl_p IVCtl_uUp /end OUT_MEASUREMENT
 /begin LOC_MEASUREMENT IVCtl_facVltgTempCor IVCtl_uChrgMapIn_mp IVCtl_uChrgUp IVCtl_uChrgUpUnCor_mp IVCtl_uCorPreCtl_mp IVCtl_uUpTempCor_mp IVCtl_uUpUnCor_mp IVCtl_uUpUnLim_mp /end LOC_MEASUREMENT
/end FUNCTION
/begin FUNCTION IVCtl_VltgGov ""
 /begin DEF_CHARACTERISTIC IVCtl_IVltgGov_CSTR.Ki_C IVCtl_IVltgGov_CSTR.KiPos_C IVCtl_IVltgGov_CSTR.KiNeg_C IVCtl_IVltgGov_CSTR.WinPos_C IVCtl_IVltgGov_CSTR.WinNeg_C IVCtl_mskVltgGov_C IVCtl_PVltgGov_CSTR.Kp_C IVCtl_PVltgGov_CSTR.KpPos_C IVCtl_PVltgGov_CSTR.KpNeg_C IVCtl_PVltgGov_CSTR.WinPos_C IVCtl_PVltgGov_CSTR.WinNeg_C IVCtl_swtUCorPIRC_C IVCtl_uCorPIRC_CA IVCtl_uPIMax_C IVCtl_uPIMin_C /end DEF_CHARACTERISTIC
 /begin IN_MEASUREMENT IVActr_stUUp IVActr_tiActrMeasCurr IVActr_uUp IVActr_uUpLnk IVCtl_p /end IN_MEASUREMENT
 /begin OUT_MEASUREMENT IVCtl_uCorPI IVCtl_uDiffUp /end OUT_MEASUREMENT
 /begin LOC_MEASUREMENT IVCtl_stVltgGovPIHi_mp IVCtl_stVltgGovPILo_mp IVCtl_tiVltgGovCalc IVCtl_uCorPIUnLim_mp /end LOC_MEASUREMENT
/end FUNCTION
/begin FUNCTION IVCtl_VltgSetP ""
 /begin DEF_CHARACTERISTIC IVCtl_uSetPress0_CUR IVCtl_uSetPress10_CUR IVCtl_uSetPress11_CUR IVCtl_uSetPress12_CUR IVCtl_uSetPress13_CUR IVCtl_uSetPress14_CUR IVCtl_uSetPress15_CUR IVCtl_uSetPress1_CUR IVCtl_uSetPress2_CUR IVCtl_uSetPress3_CUR IVCtl_uSetPress4_CUR IVCtl_uSetPress5_CUR IVCtl_uSetPress6_CUR IVCtl_uSetPress7_CUR IVCtl_uSetPress8_CUR IVCtl_uSetPress9_CUR /end DEF_CHARACTERISTIC
 /begin IN_MEASUREMENT IVAdj_clsIVA IVCtl_p /end IN_MEASUREMENT
 /begin LOC_MEASUREMENT IVCtl_clsIVA_mp /end LOC_MEASUREMENT
/end FUNCTION
/begin FUNCTION IVCtl_VltgStrt ""
 /begin DEF_CHARACTERISTIC IVCtl_stStrtRC_C IVCtl_swtStrtRC_C IVCtl_tiStrtMax_C IVCtl_uUpStrt_C /end DEF_CHARACTERISTIC
 /begin IN_MEASUREMENT CoEng_st /end IN_MEASUREMENT
 /begin OUT_MEASUREMENT IVCtl_stStrt IVCtl_uUpStrt /end OUT_MEASUREMENT
 /begin LOC_MEASUREMENT IVCtl_tiStrt_mp /end LOC_MEASUREMENT
/end FUNCTION
/begin FUNCTION IVDia_Co ""
 /begin DEF_CHARACTERISTIC IVDia_numBnkRegSPI_CA IVDia_numNoLoadCylMax_C IVDia_numPsRegSPI_CA IVDia_stErrMskPattern_CA IVDia_stErrMskSelect_CA /end DEF_CHARACTERISTIC
 /begin REF_CHARACTERISTIC InjVlv_numBnkTDC_CA /end REF_CHARACTERISTIC
 /begin OUT_MEASUREMENT IVDia_st IVDia_stPsIcChp IVDia_stPsIcCyl /end OUT_MEASUREMENT
 /begin LOC_MEASUREMENT IVDia_numIdxErrCyl_mp IVDia_stErrClctCyl_mp IVDia_stErrCyl_mp /end LOC_MEASUREMENT
/end FUNCTION
/begin FUNCTION IVDia_Plaus "" /begin DEF_CHARACTERISTIC IVDia_facUPlaus_CA /end DEF_CHARACTERISTIC /begin IN_MEASUREMENT IVActr_tiActrMeasCurr /end IN_MEASUREMENT /begin OUT_MEASUREMENT IVDia_stUPlausBnk IVDia_stUPlausCyl /end OUT_MEASUREMENT /begin LOC_MEASUREMENT IVDia_uThres_mp /end LOC_MEASUREMENT /end FUNCTION
/begin FUNCTION IVH_ADCInt "" /end FUNCTION
/begin FUNCTION IVH_BusyInt "" /begin IN_MEASUREMENT IVActr_numCylMeasNxt /end IN_MEASUREMENT /end FUNCTION
/begin FUNCTION IVH_Ini "" /begin IN_MEASUREMENT IVActr_numCylMeasNxt /end IN_MEASUREMENT /end FUNCTION
/begin FUNCTION IVH_ProgSOIInt "" /end FUNCTION
/begin FUNCTION IVH_SetupInjInt "" /end FUNCTION
/begin FUNCTION IVH_SOPTst ""
 /begin DEF_CHARACTERISTIC IVH_iChrgSOPT_C IVH_iDisChSOPT_C IVH_tiChrgSOPT_C IVH_tiPseChrgSOPT_C IVH_tiPseDisChSOPT_C /end DEF_CHARACTERISTIC
/end FUNCTION
/begin FUNCTION IVH_SPIInt "" /end FUNCTION
/begin FUNCTION IVH_WupInt "" /end FUNCTION
/begin FUNCTION IVPlaus_CylChk ""
 /begin DEF_CHARACTERISTIC IVPlaus_numSegOfs1_C IVPlaus_numSegOfs2_C IVPlaus_stCylChk_C /end DEF_CHARACTERISTIC
 /begin IN_MEASUREMENT CoEng_stTst EpmCrS_numSeg Epm_nEng Epm_nEngCurr Epm_numCyl FBC_qDvtCyl /end IN_MEASUREMENT
 /begin LOC_MEASUREMENT IVPlaus_nCyl IVPlaus_qFBCCyl /end LOC_MEASUREMENT
/end FUNCTION
/begin FUNCTION IVPSply_BufVltg ""
 /begin DEF_CHARACTERISTIC IVPSply_numIntrBufMeas_C IVPSply_stUBufRC_C IVPSply_swtEnaBufVltg_C IVPSply_swtUBufRC_C IVPSply_tiADCBusyMax_C IVPSply_tiBufMeasChk_C IVPSply_uBufLin_CUR IVPSply_uBufRC_C IVPSply_Vltg_SRC.uMin_C IVPSply_Vltg_SRC.uMax_C /end DEF_CHARACTERISTIC
 /begin REF_CHARACTERISTIC InjVlv_numBnkTDC_CA /end REF_CHARACTERISTIC
 /begin IN_MEASUREMENT IVActr_numCylMeasNxt /end IN_MEASUREMENT
 /begin OUT_MEASUREMENT IVPSply_ctIntrBufMeas IVPSply_stGetBufVltg IVPSply_stUBuf IVPSply_tiBufMeasCurr IVPSply_uBuf /end OUT_MEASUREMENT
 /begin LOC_MEASUREMENT IVPSply_uBufRaw_mp /end LOC_MEASUREMENT
/end FUNCTION
/begin FUNCTION IVPSply_DCDC "" /begin DEF_CHARACTERISTIC IVPSply_tiDCDCWait_C /end DEF_CHARACTERISTIC /begin OUT_MEASUREMENT IVPSply_stBufErr /end OUT_MEASUREMENT /begin LOC_MEASUREMENT IVPSply_tiDCDCChrg_mp IVPSply_tiDCDCStrt_mp /end LOC_MEASUREMENT /end FUNCTION
/begin FUNCTION IVPSply_ShOff "" /begin LOC_MEASUREMENT IVPSply_stOffDCDC /end LOC_MEASUREMENT /end FUNCTION
/begin FUNCTION layer2edc_adap "" /begin OUT_MEASUREMENT Alt_uAltLayer /end OUT_MEASUREMENT /end FUNCTION
/begin FUNCTION layer_proc "" /begin IN_MEASUREMENT SyC_stSub /end IN_MEASUREMENT /begin OUT_MEASUREMENT Layer_stLayer /end OUT_MEASUREMENT /end FUNCTION
/begin FUNCTION layer_proc_compu "" /end FUNCTION
/begin FUNCTION llim_calclim ""
 /begin DEF_CHARACTERISTIC LLim_aDifNeg_C LLim_aDifPos_C LLim_aMSL_CUR LLim_axMax_C LLim_vMaxFix_C LLim_vThres_C /end DEF_CHARACTERISTIC
 /begin IN_MEASUREMENT GlbDa_vXFlt VehMot_aPrpCurr /end IN_MEASUREMENT
 /begin OUT_MEASUREMENT LLim_aMSL_mp LLim_aReq LLim_dvMSL_mp LLim_stMSLActv_mp LLim_stReq LLim_vMaxMSL_mp /end OUT_MEASUREMENT
/end FUNCTION
/begin FUNCTION lscomp_trqcalc ""
 /begin DEF_CHARACTERISTIC LsComp_facCompTot_C LsComp_facDynCompOvrRun_C LsComp_facDynComp_C LsComp_facStab_C LsComp_T1Flt_C /end DEF_CHARACTERISTIC
 /begin IN_MEASUREMENT CoME_trqDesComp CoME_trqResv PT_trqWhlMinEng RngMod_trqClthMin SpdGov_trqSet VehMot_facCompAcs VehMot_stAccPedOvrRun VMD_trqDes /end IN_MEASUREMENT
 /begin OUT_MEASUREMENT CoVeh_facCompTot CoVeh_facTrqDem CoVeh_trqDesComp CoVeh_trqResv /end OUT_MEASUREMENT
/end FUNCTION
/begin FUNCTION lscomp_trqcalc_var "" /end FUNCTION
/begin FUNCTION LSU_DDClbSched ""
 /begin DEF_CHARACTERISTIC LSU_nMaxClb1_C LSU_nMaxClb2_C LSU_nMinClb1_C LSU_nMinClb2_C LSU_qMaxClb1_C LSU_qMaxClb2_C LSU_qMinClb1_C LSU_qMinClb2_C LSU_stChpClbActv_C LSU_stEGTClbOff_C LSU_ti1stClb_C LSU_tiPerClb_C LSU_uMinClb_C /end DEF_CHARACTERISTIC
 /begin IN_MEASUREMENT Epm_ctCyl InjSys_qInrCmb /end IN_MEASUREMENT
 /begin OUT_MEASUREMENT LSU_stClbDisable LSU_stClbTrg_mp LSU_stIniClb LSU_stNotOpPoint1_mp LSU_stNotOpPoint2_mp LSU_stO2ClbEna LSU_stRiClbEna LSU_stStrtClb LSU_stTmrClbPerRun /end OUT_MEASUREMENT
/end FUNCTION
/begin FUNCTION LSU_DDHtr ""
 /begin DEF_CHARACTERISTIC LSU_dcycMax_C LSU_Pwm.tiPer_C LSU_Pwm.stLvl_C LSU_Pwm.rMaxDty_C LSU_Pwm.rPerUn_C LSU_Pwm.tiPh_C LSU_PwmOut.rMin_C LSU_PwmOut.rMax_C LSU_PwmOut.tiBtwTstSCB_C LSU_PwmOut.tiBtwTstOT_C LSU_PwmOut.numTstMax_C LSU_PwmOut.swtBattCor_C LSU_PwmOut.swtPsInv_C LSU_stHtDis_C LSU_stHtrPwrStgSel_C LSU_stPwrStgDia_C LSU_tiHtrBattDefDel_C LSU_uBattMaxHigh_C LSU_uBattMaxLow_C LSU_uBattNominal_C /end DEF_CHARACTERISTIC
 /begin IN_MEASUREMENT BattU_facCor DevLib_stPwrStgEnaCond /end IN_MEASUREMENT
 /begin OUT_MEASUREMENT LSU_dcycHtCor LSU_dcycLimActHt LSU_facUCor_mp LSU_rOutHWE_mp LSU_stHtDis /end OUT_MEASUREMENT
/end FUNCTION
/begin FUNCTION LSU_DDO2Raw ""
 /begin DEF_CHARACTERISTIC LSU_rO2Transf_CUR LSU_swtO2Flt_C LSU_swtSensPrs_C LSU_tiDelO2Clb_C LSU_tiDelO2Val_C LSU_tiO2ClbPT1_C LSU_tiO2Clb_C LSU_tiO2PT1_C LSU_uO2ClbMax_C LSU_uO2ClbMin_C LSU_uO2Max_C LSU_uO2Min_C LSU_uO2Ref_C /end DEF_CHARACTERISTIC
 /begin OUT_MEASUREMENT LSU_rO2Act LSU_rO2Raw LSU_stO2Act LSU_stO2IntValid LSU_stO2SPICalDem LSU_swtEna LSU_uO2Clb LSU_uO2Raw LSU_uO2RawOfsCor LSU_uO2RawOfsCorLast_mp TrbnDsRLam_stO2IntValid /end OUT_MEASUREMENT
 /begin LOC_MEASUREMENT LSU_stO2Clb_mp LSU_uO2Raw_mp /end LOC_MEASUREMENT
/end FUNCTION
/begin FUNCTION LSU_DDO2RawFlt "" /begin IN_MEASUREMENT EpmCrS_numSeg /end IN_MEASUREMENT /begin OUT_MEASUREMENT LSU_uO2Flt /end OUT_MEASUREMENT /begin LOC_MEASUREMENT LSU_uO2FltSegOld_mp LSU_uO2RawAdcDirect_mp /end LOC_MEASUREMENT /end FUNCTION
/begin FUNCTION LSU_DDPT1FltConstCalc "" /begin DEF_CHARACTERISTIC LSU_tiPT1FltO2Raw_C LSU_tiPT1fltRiRaw_C /end DEF_CHARACTERISTIC /begin OUT_MEASUREMENT LSU_tiPT1FltO2RawConst LSU_tiPT1FltRiRawConst /end OUT_MEASUREMENT /end FUNCTION
/begin FUNCTION LSU_DDRefPmp "" /begin DEF_CHARACTERISTIC LSU_stRefPmpDisbl_C LSU_tiRefPmpHi_C LSU_tiRefTransLo_C /end DEF_CHARACTERISTIC
 /begin OUT_MEASUREMENT LSU_stIpHiCurrEna LSU_stIpNrmCurrEna LSU_stPmpDemRef LSU_stRefPmp /end OUT_MEASUREMENT
/end FUNCTION
/begin FUNCTION LSU_DDRiRaw ""
 /begin DEF_CHARACTERISTIC LSU_facUToRi_C LSU_resRiClbMax_C LSU_resRiClbMin_C LSU_resRiClbRef_C LSU_tiDelRiClb_C LSU_tiDelRiVal_C LSU_tiRiClbPT1_C LSU_tiRiClb_C LSU_tiRiPT1_C LSU_tRi_CUR LSU_uRiOfs_C /end DEF_CHARACTERISTIC
 /begin OUT_MEASUREMENT LSU_resRi LSU_resRiClb LSU_resRiClbRaw_mp LSU_resRiRaw LSU_resRi_mp LSU_stRiClb LSU_stRiSPICalDem LSU_stRiValid LSU_tRi LSU_uRiRaw LSU_uRiRawOfsCor /end OUT_MEASUREMENT
/end FUNCTION
/begin FUNCTION LSU_DDRiRawFlt "" /begin OUT_MEASUREMENT LSU_uRiFlt LSU_uRiRaw_mp /end OUT_MEASUREMENT /end FUNCTION
/begin FUNCTION LSU_DDSPI "" /begin DEF_CHARACTERISTIC LSU_stRefCurrHi_C LSU_stRefCurrNrm_C /end DEF_CHARACTERISTIC /begin OUT_MEASUREMENT LSU_stCirModeNew LSU_stSPIIniVal /end OUT_MEASUREMENT /end FUNCTION
/begin FUNCTION LSU_DDWireDia ""
 /begin DEF_CHARACTERISTIC LSU_dcycMinGrad_C LSU_dmEGHtCoupActv_C LSU_dNumHtCoup_C LSU_resRiMaxGrad_C LSU_rO2IsolChkMax_C LSU_rO2IsolChkMin_C LSU_stWireDiaActv_C LSU_tiClgLstRun_C LSU_tiHtCoupChk_C LSU_tiHtCoupFlt_C LSU_tiHtCoupPer_C LSU_tiIsolChkErr_C LSU_tiIsolChkPer_C LSU_tiIsolChkPmp_C LSU_uO2MaxGrad_C LSU_uO2MaxRippel_C /end DEF_CHARACTERISTIC
 /begin IN_MEASUREMENT ASMod_dmExhMnfDs ASMod_tiClg /end IN_MEASUREMENT
 /begin OUT_MEASUREMENT LSU_ctHtCoup LSU_dcycHtCoupStp1 LSU_dcycHtCoupStp2 LSU_dcycHtCoupStp3 LSU_dcycRippel_mp LSU_dHtCoupStepLast LSU_dHtCoupStp LSU_resRiHtCoupStp1 LSU_resRiHtCoupStp2 LSU_resRiHtCoupStp3 LSU_resRiRippel_mp LSU_stDiaIAEna LSU_stHtCoupActv LSU_stHtDisbl LSU_stIsolChkActv LSU_stIsolChkO2Last LSU_stIsolChkStrt LSU_stPmpEna LSU_stRecValEval_mp LSU_stTstTrigger_mp LSU_stWireDiaChk_mp LSU_stWireDiaErr_mp LSU_uO2FltRippel_mp LSU_uO2Grad_mp LSU_uO2HtCoupStp1 LSU_uO2HtCoupStp2 LSU_uO2HtCoupStp3 LSU_uO2Rippel_mp /end OUT_MEASUREMENT
/end FUNCTION
/begin COMPU_METHOD Acc "" RAT_FUNC "%6.5" "m/s^2" COEFFS 0 1000 0 0 0 1 /end COMPU_METHOD
/begin COMPU_METHOD AirMassPerTime "" RAT_FUNC "%6.3" "Kg/h" COEFFS 0 10 0 0 0 1 /end COMPU_METHOD
/begin COMPU_METHOD AngleCrS "" RAT_FUNC "%6.4" "deg CrS" COEFFS 0 45.5097222222222 0 0 0 1 /end COMPU_METHOD
/begin COMPU_METHOD Charge_PA "" RAT_FUNC "%6.2" "uC" COEFFS 0 1 0 0 0 1 /end COMPU_METHOD
/begin COMPU_METHOD Curr "" RAT_FUNC "%6.2" "mA" COEFFS 0 1 0 0 0 1 /end COMPU_METHOD
/begin COMPU_METHOD CurRefPump "" TAB_VERB "%6.3" "-" COMPU_TAB_REF CurRefPump /end COMPU_METHOD
/begin COMPU_VTAB CurRefPump "" TAB_VERB 16 0 "0 uA" 1 "10 uA" 2 "20 uA" 3 "30 uA" 4 "40 uA" 5 "50 uA" 6 "60 uA" 7 "70 uA" 8 "80 uA" 9 "90 uA" 10 "100 uA" 11 "110 uA" 12 "120 uA" 13 "130 uA" 14 "140 uA" 15 "150 uA" /end COMPU_VTAB
/begin COMPU_METHOD DtyCyc "" RAT_FUNC "%6.4" "%" COEFFS 0 100 0 0 0 1 /end COMPU_METHOD
/begin COMPU_METHOD EngN "" RAT_FUNC "%6.3" "rpm" COEFFS 0 2 0 0 0 1 /end COMPU_METHOD
/begin COMPU_METHOD EngN_float "" RAT_FUNC "%6.2" "rpm" COEFFS 0 1 0 0 0 1 /end COMPU_METHOD
/begin COMPU_METHOD EngTempFldSel "" TAB_VERB "%6.3" "-" COMPU_TAB_REF EngTempFldSel /end COMPU_METHOD
/begin COMPU_VTAB EngTempFldSel "" TAB_VERB 3 0 "Coolant_Temperature" 1 "Oil_Temperature" 2 "EngDa_tEng" /end COMPU_VTAB
/begin COMPU_METHOD Fact "" RAT_FUNC "%6.5" "-" COEFFS 0 8192 0 0 0 1 /end COMPU_METHOD
/begin COMPU_METHOD FactLow "" RAT_FUNC "%6.5" "-" COEFFS 0 1024 0 0 0 1 /end COMPU_METHOD
/begin COMPU_METHOD GC_Volt "" RAT_FUNC "%6.2" "mV" COEFFS 0 0.2046 0 0 0 1 /end COMPU_METHOD
/begin COMPU_METHOD GSSYS_TYPEEXHFLW_SY_Compu "" TAB_NOINTP "%6.3" "-" COMPU_TAB_REF GSSYS_TYPEEXHFLW_SY_Compu /end COMPU_METHOD
/begin COMPU_TAB GSSYS_TYPEEXHFLW_SY_Compu "" TAB_NOINTP 8 0 0 1 1 2 2 3 3 4 4 5 5 6 6 7 7 /end COMPU_TAB
/begin COMPU_METHOD InjMass "" RAT_FUNC "%6.4" "mg/hub" COEFFS 0 100 0 0 0 1 /end COMPU_METHOD
/begin COMPU_METHOD InjMassCyc "" RAT_FUNC "%6.4" "mg/cyc" COEFFS 0 100 0 0 0 1 /end COMPU_METHOD
/begin COMPU_METHOD InjQntInj "" RAT_FUNC "%6.4" "mm^3/inj" COEFFS 0 100 0 0 0 1 /end COMPU_METHOD
/begin COMPU_METHOD InjTime_us "" RAT_FUNC "%6.3" "us" COEFFS 0 2.5 0 0 0 1 /end COMPU_METHOD
/begin COMPU_METHOD ISCCurrFu "Verbale Umrechnung für den zur Zeit aktiven ISC Anforderer" TAB_VERB "%6.3" "-" COMPU_TAB_REF ISCCurrFu /end COMPU_METHOD
/begin COMPU_VTAB ISCCurrFu "Verbale Umrechnung für den zur Zeit aktiven ISC Anforderer" TAB_VERB 6 -1 "no active ISC client" 0 "ISC" 1 "HLSDem" 2 "GSHDem" 3 "WESDem" 128 "EngICO" /end COMPU_VTAB
/begin COMPU_METHOD ISCstPrioSel "Verbale Umrechnung für die Priorisierung der verschiedenen ISC Anforderer" TAB_VERB "%6.3" "-" COMPU_TAB_REF ISCstPrioSel /end COMPU_METHOD
/begin COMPU_VTAB ISCstPrioSel "Verbale Umrechnung für die Priorisierung der verschiedenen ISC Anforderer" TAB_VERB 3 1 "HLSDem" 2 "GSHDem" 3 "WESDem" /end COMPU_VTAB
/begin COMPU_METHOD ISC_dnEng_float "Umrechnung für die Drehzahlbeschleunigung (Float Implementierung)" RAT_FUNC "%6.2" "rpm/s" COEFFS 0 1 0 0 0 1 /end COMPU_METHOD
/begin COMPU_METHOD ISC_Inirtia_float "Umrechnung für Massenträgheitsmoment (Float Implementierung)" RAT_FUNC "%6.2" "Nm/(rpm/s)" COEFFS 0 1 0 0 0 1 /end COMPU_METHOD
/begin COMPU_METHOD ISC_Ki_rpm2Nm_float "Umrechnung für Verstärkung I-Anteil (Float Implementierung)" RAT_FUNC "%6.2" "Nm/(rpm*s)" COEFFS 0 1 0 0 0 1 /end COMPU_METHOD
/begin COMPU_METHOD ISC_Kp_rpm2Nm_float "Umrechnung für Verstärkung P-Anteil (Float Implementierung)" RAT_FUNC "%6.2" "Nm/rpm" COEFFS 0 1 0 0 0 1 /end COMPU_METHOD
/begin COMPU_METHOD ISC_rnEng2vVeh_float "Umrechnung für das Verhältnis Motordrehzahl zu Fahrzeuggeschwindigkeit (Float Implementierung)" RAT_FUNC "%6.2" "rpm/(Km/h)" COEFFS 0 1 0 0 0 1 /end COMPU_METHOD
/begin COMPU_METHOD ISC_tiPT2nEng_float "Umrechnung für Zeitkonstante der PT2-Filterung der Motordrehzahl (Float Implementierung)" RAT_FUNC "%6.2" "s" COEFFS 0 1 0 0 0 1 /end COMPU_METHOD
/begin COMPU_METHOD ISC_tiPTsTrqLoss_float "Umrechnung für die Zeitkonstante für die Filterung bei der Lastmomentabschätzung (Float Implementierung)" RAT_FUNC "%6.2" "s" COEFFS 0 1 0 0 0 1 /end COMPU_METHOD
/begin COMPU_METHOD Ki_InjTime_us2Curr "" RAT_FUNC "%6.4" "mA/us/s" COEFFS 0 858.9934592 0 0 0 1 /end COMPU_METHOD
/begin COMPU_METHOD Ki_PrcEGRRmp_2_Prc "" RAT_FUNC "%7.6" "1/s" COEFFS 0 26843.5456 0 0 0 1 /end COMPU_METHOD
/begin COMPU_METHOD Ki_Temp2EGTFact "" RAT_FUNC "%8.7" "-" COEFFS 0 429496.7296 0 0 0 1 /end COMPU_METHOD
/begin COMPU_METHOD Ki_Vltg_PA2Vltg_PA "" RAT_FUNC "%6.5" "V/V/s" COEFFS 0 2147.483648 0 0 0 1 /end COMPU_METHOD
/begin COMPU_METHOD Kp_InjTime_us2Curr "" RAT_FUNC "%7.6" "mA/us" COEFFS 0 13107.2 0 0 0 1 /end COMPU_METHOD
/begin COMPU_METHOD Kp_LmbdRec2InjMass_1 "" RAT_FUNC "%6.4" "mg/stroke" COEFFS 0 81.92 0 0 0 1 /end COMPU_METHOD
/begin COMPU_METHOD Kp_Vltg_PA2Vltg_PA "" RAT_FUNC "%7.6" "V/V" COEFFS 0 32768 0 0 0 1 /end COMPU_METHOD
/begin COMPU_METHOD lambdaRec "" RAT_FUNC "%7.6" "-" COEFFS 0 10000 0 0 0 1 /end COMPU_METHOD
/begin COMPU_METHOD LengthCpp "" RAT_FUNC "%8.7" "m" COEFFS 0 100000 0 0 0 1 /end COMPU_METHOD
/begin COMPU_METHOD O2 "" RAT_FUNC "%8.7" "-" COEFFS 0 100000 0 0 0 1 /end COMPU_METHOD
/begin COMPU_METHOD OneToOne "" RAT_FUNC "%6.2" "-" COEFFS 0 1 0 0 0 1 /end COMPU_METHOD
/begin COMPU_METHOD Period "" RAT_FUNC "%6.3" "ms" COEFFS 0 10 0 0 0 1 /end COMPU_METHOD
/begin COMPU_METHOD PERMSPLYSYS_SY_Compu "" TAB_VERB "%6.3" "-" COMPU_TAB_REF PERMSPLYSYS_SY_Compu /end COMPU_METHOD
/begin COMPU_VTAB PERMSPLYSYS_SY_Compu "" TAB_VERB 2 0 "FALSE" 1 "TRUE" /end COMPU_VTAB
/begin COMPU_METHOD PosMCKd "" RAT_FUNC "%8.7" "%/AgCA" COEFFS 0 144004.394665365 0 0 0 1 /end COMPU_METHOD
/begin COMPU_METHOD Prc "" RAT_FUNC "%6.4" "%" COEFFS 0 81.92 0 0 0 1 /end COMPU_METHOD
/begin COMPU_METHOD Pres_Rail "" RAT_FUNC "%4.3" "bar" COEFFS 0 10.000000 0 0 0 1 /end COMPU_METHOD
/begin COMPU_METHOD PwmOutLevel "" TAB_VERB "%6.3" "-" COMPU_TAB_REF PwmOutLevel /end COMPU_METHOD
/begin COMPU_VTAB PwmOutLevel "" TAB_VERB 2 0 "Lo" 1 "Hi" /end COMPU_VTAB
/begin COMPU_METHOD Resist "" RAT_FUNC "%6.3" "Ohm" COEFFS 0 10 0 0 0 1 /end COMPU_METHOD
/begin COMPU_METHOD RmpInjMass "" RAT_FUNC "%6.5" "(mg/stroke)/s" COEFFS 0 6553.6 0 0 0 1 /end COMPU_METHOD
/begin COMPU_METHOD Temp_Cels "" RAT_FUNC "%6.1" "deg C" COEFFS 0 10 2731.4 0 0 1 /end COMPU_METHOD
/begin COMPU_METHOD TimeDelay_ms "" RAT_FUNC "%12.1" "ms" COEFFS 0 0 1 0 2.3283064365387e-007 0 /end COMPU_METHOD
/begin COMPU_METHOD TimeDelay_s "" RAT_FUNC "%12.4" "s" COEFFS 0 0 1 0 0.00023283064365387 0 /end COMPU_METHOD
/begin COMPU_METHOD TimeDelay_s_Lin_16 "" RAT_FUNC "%6.5" "s" COEFFS 0 6553.4 0 0 0 1 /end COMPU_METHOD
/begin COMPU_METHOD TimeEngOnHrs "" RAT_FUNC "%6.1" "h" COEFFS 0 1 0 0 0 18.2042 /end COMPU_METHOD
/begin COMPU_METHOD Time_ms "" RAT_FUNC "%6.1" "ms" COEFFS 0 0.1 0 0 0 1 /end COMPU_METHOD
/begin COMPU_METHOD Time_PzoChrgPse "" RAT_FUNC "%6.4" "us" COEFFS 0 100 0 0 0 1 /end COMPU_METHOD
/begin COMPU_METHOD Time_PzoMeas "" RAT_FUNC "%6.4" "ms" COEFFS 0 18.3150183150183 0 0 0 1 /end COMPU_METHOD
/begin COMPU_METHOD Time_s "" RAT_FUNC "%6.4" "s" COEFFS 0 100 0 0 0 1 /end COMPU_METHOD
/begin COMPU_METHOD Trq "" RAT_FUNC "%6.3" "Nm" COEFFS 0 10 0 0 0 1 /end COMPU_METHOD
/begin COMPU_METHOD Trq_float "" RAT_FUNC "%6.2" "Nm" COEFFS 0 1 0 0 0 1 /end COMPU_METHOD
/begin COMPU_METHOD Vel "" RAT_FUNC "%6.4" "km/h" COEFFS 0 100 0 0 0 1 /end COMPU_METHOD
/begin COMPU_METHOD Vltg_PA "" RAT_FUNC "%6.4" "V" COEFFS 0 100 0 0 0 1 /end COMPU_METHOD
/begin COMPU_METHOD Volt "" RAT_FUNC "%6.3" "mV" COEFFS 0 5 0 0 0 1 /end COMPU_METHOD
/begin COMPU_METHOD VoltToRes "" RAT_FUNC "%6.5" "Ohm/mV" COEFFS 0 2000 0 0 0 1 /end COMPU_METHOD
/begin COMPU_METHOD Volt_Batt "" RAT_FUNC "%6.1" "mV" COEFFS 0 0.05 0 0 0 1 /end COMPU_METHOD
/begin RECORD_LAYOUT Axis_Xs16 NO_AXIS_PTS_X 1 SWORD AXIS_PTS_X 2 SWORD INDEX_INCR DIRECT /end RECORD_LAYOUT
/begin RECORD_LAYOUT Cur_Xs16Ws16 NO_AXIS_PTS_X 1 SWORD AXIS_PTS_X 2 SWORD INDEX_INCR DIRECT FNC_VALUES 3 SWORD COLUMN_DIR DIRECT /end RECORD_LAYOUT
/begin RECORD_LAYOUT Kf_Xs16_Ys16_Ws16 NO_AXIS_PTS_X 1 SWORD NO_AXIS_PTS_Y 2 SWORD AXIS_PTS_X 3 SWORD INDEX_INCR DIRECT AXIS_PTS_Y 4 SWORD INDEX_INCR DIRECT FNC_VALUES 5 SWORD COLUMN_DIR DIRECT /end RECORD_LAYOUT
/begin RECORD_LAYOUT Kl_Xs16_Ws16 NO_AXIS_PTS_X 1 SWORD AXIS_PTS_X 2 SWORD INDEX_INCR DIRECT FNC_VALUES 3 SWORD COLUMN_DIR DIRECT /end RECORD_LAYOUT
/begin RECORD_LAYOUT Kw_Ws16 FNC_VALUES 1 SWORD COLUMN_DIR DIRECT /end RECORD_LAYOUT
/begin RECORD_LAYOUT Kw_Ws32 FNC_VALUES 1 SLONG COLUMN_DIR DIRECT /end RECORD_LAYOUT
/begin RECORD_LAYOUT Kw_Wu16 FNC_VALUES 1 UWORD COLUMN_DIR DIRECT /end RECORD_LAYOUT
/begin RECORD_LAYOUT Kw_Wu8 FNC_VALUES 1 UBYTE COLUMN_DIR DIRECT /end RECORD_LAYOUT
/begin RECORD_LAYOUT MapG_Ws16 FNC_VALUES 1 SWORD COLUMN_DIR DIRECT /end RECORD_LAYOUT
/begin RECORD_LAYOUT Map_Xs16Ys16Ws16 NO_AXIS_PTS_X 1 SWORD NO_AXIS_PTS_Y 2 SWORD AXIS_PTS_X 3 SWORD INDEX_INCR DIRECT AXIS_PTS_Y 4 SWORD INDEX_INCR DIRECT FNC_VALUES 5 SWORD COLUMN_DIR DIRECT /end RECORD_LAYOUT
/begin RECORD_LAYOUT ValA_Ws16 FNC_VALUES 1 SWORD COLUMN_DIR DIRECT /end RECORD_LAYOUT
/begin RECORD_LAYOUT ValA_Wu16 FNC_VALUES 1 UWORD COLUMN_DIR DIRECT /end RECORD_LAYOUT
/begin RECORD_LAYOUT ValA_Wu32 FNC_VALUES 1 ULONG COLUMN_DIR DIRECT /end RECORD_LAYOUT
/begin RECORD_LAYOUT ValA_Wu8 FNC_VALUES 1 UBYTE COLUMN_DIR DIRECT /end RECORD_LAYOUT
/begin RECORD_LAYOUT Val_Ws16 FNC_VALUES 1 SWORD COLUMN_DIR DIRECT /end RECORD_LAYOUT
/begin RECORD_LAYOUT Val_Ws32 FNC_VALUES 1 SLONG COLUMN_DIR DIRECT /end RECORD_LAYOUT
/begin RECORD_LAYOUT Val_Wu16 FNC_VALUES 1 UWORD COLUMN_DIR DIRECT /end RECORD_LAYOUT
/begin RECORD_LAYOUT Val_Wu32 FNC_VALUES 1 ULONG COLUMN_DIR DIRECT /end RECORD_LAYOUT
/begin RECORD_LAYOUT Val_Wu8 FNC_VALUES 1 UBYTE COLUMN_DIR DIRECT /end RECORD_LAYOUT
/end MODULE
/end PROJECT
