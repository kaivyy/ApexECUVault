ASAP2_VERSION 1 3
/begin PROJECT P390 "BMW DDE6.2 6-Zylinder VR0.1 15.03.2004 CAN11/12H"
/begin HEADER "" VERSION "VR0.1_6Z_CAN11/12H" PROJECT_NO P390 /end HEADER
/begin MODULE DIM ""
/begin MOD_COMMON "" BYTE_ORDER MSB_FIRST ALIGNMENT_BYTE 1 ALIGNMENT_WORD 2 ALIGNMENT_LONG 4 ALIGNMENT_FLOAT32_IEEE 4 /end MOD_COMMON
/begin MEASUREMENT AirCtl_dnAvrg_mp "Drehzahlgradient der gefilterten Drehzahlbeschleunigung gegen Laderpumpen" SWORD dn_dZ20 1 100 -327680.0 327670.0 FORMAT "%8.1" ECU_ADDRESS 0x8FE376 /end MEASUREMENT
/begin MEASUREMENT AirCtl_dnSurgeHigh_mp "Aktuelle obere Grenze für Drehzahlgradienten Hysterese" SWORD dn_dZ20 1 100 -327680.0 327670.0 FORMAT "%8.1" ECU_ADDRESS 0x8FE378 /end MEASUREMENT
/begin MEASUREMENT AirCtl_dnSurgeLow_mp "aktuelle untere Grenze für Drehzahlgradienten Hysterese gegen Laderpumpen" SWORD dn_dZ20 1 100 -327680.0 327670.0 FORMAT "%8.1" ECU_ADDRESS 0x8FE37A /end MEASUREMENT
/begin MEASUREMENT AirCtl_dqRaw_mp "Value after getting filtered(DT1 Filter) for message InjCtl_qRaw" SWORD InjMassPerSec_20ms 1 100 -16384.00 16383.50 FORMAT "%8.2" ECU_ADDRESS 0x8FE37C /end MEASUREMENT
/begin MEASUREMENT AirCtl_facNQParRgn_mp "Faktor für Parameteradaptation in Regenerationsbetrieb" SWORD Fact1 1 100 -256.0000 255.9922 FORMAT "%8.4" ECU_ADDRESS 0x8FE34A /end MEASUREMENT
/begin MEASUREMENT AirCtl_facPresDiffCor_mp "Faktor für Parameteradaption über Differenzdruck Partikelfilter im Normalbetrieb" SWORD Fact1 1 100 -256.0000 255.9922 FORMAT "%8.4" ECU_ADDRESS 0x8FE34C /end MEASUREMENT
/begin MEASUREMENT AirCtl_mDesMax_mp "Kalkulierte Luftmassenstrom bei geschlossener ARF" SWORD AirMassPerCyl 1 100 -3276.800 3276.700 FORMAT "%8.3" ECU_ADDRESS 0x8FE37E /end MEASUREMENT
/begin MEASUREMENT AirCtl_mMaxDvt "Obergrenze für Erkennung einer bleibenden Regelabweichung" SWORD AirMassPerCyl 1 100 -3276.800 3276.700 FORMAT "%8.3" ECU_ADDRESS 0x7F8AAC /end MEASUREMENT
/begin MEASUREMENT AirCtl_mMaxDvtRgn_mp "Obergrenze für Erkennung einer bleibenden Regelabweichung" SWORD AirMassPerCyl 1 100 -3276.800 3276.700 FORMAT "%8.3" ECU_ADDRESS 0x8FE398 /end MEASUREMENT
/begin MEASUREMENT AirCtl_mMinDvt "Untergrenze für Erkennung einer bleibenden Regelabweichung" SWORD AirMassPerCyl 1 100 -3276.800 3276.700 FORMAT "%8.3" ECU_ADDRESS 0x7F8AAE /end MEASUREMENT
/begin MEASUREMENT AirCtl_mMinDvtRgn_mp "Untergrenze für Erkennung einer bleibenden Regelabwei-chung" SWORD AirMassPerCyl 1 100 -3276.800 3276.700 FORMAT "%8.3" ECU_ADDRESS 0x8FE39A /end MEASUREMENT
/begin MEASUREMENT AirCtl_qCurrRmp_mp "Meßpunkt nach Rampung der ungefilterten Einspritzmenge" SWORD InjMass 1 100 -327.6800 327.6700 FORMAT "%8.4" ECU_ADDRESS 0x8FE380 /end MEASUREMENT
/begin MEASUREMENT AirCtl_qSurgeHigh_mp "aktuelle obere Grenze für Mengen Hysterese gegen Laderpumpen" SWORD InjMass 1 100 -327.6800 327.6700 FORMAT "%8.4" ECU_ADDRESS 0x8FE382 /end MEASUREMENT
/begin MEASUREMENT AirCtl_qSurgeLow_mp "aktuelle untere Grenze für Mengen Hysterese gegen Laderpumpen" SWORD InjMass 1 100 -327.6800 327.6700 FORMAT "%8.4" ECU_ADDRESS 0x8FE384 /end MEASUREMENT
/begin MEASUREMENT AirCtl_rBrkRmp_mp "Rampen Ausgang bei Bremssignal Auswertung" SWORD Prc 1 100 -400.0000 399.9878 FORMAT "%8.4" ECU_ADDRESS 0x8FE386 /end MEASUREMENT
/begin MEASUREMENT AirCtl_rEGR "Stellgröße für das ARF-Ventil" SWORD Prc 1 100 -400.0000 399.9878 FORMAT "%8.4" ECU_ADDRESS 0x7F8AB2 /end MEASUREMENT
/begin MEASUREMENT AirCtl_rEGR2 "Stellwert 2 für Abgasregelung" SWORD Prc 1 100 -400.0000 399.9878 FORMAT "%8.4" ECU_ADDRESS 0x7F8AB4 /end MEASUREMENT
/begin MEASUREMENT AirCtl_rEGRByp_mp "Bypass-Label, Kopie von AirCtl_rEGR" SWORD Prc 1 100 -400.0000 399.9878 FORMAT "%8.4" ECU_ADDRESS 0x8FE388 /end MEASUREMENT
/begin MEASUREMENT AirCtl_rEGRNrmRgn2_mp "Stellgröße für das ARF-Ventil im Übergang von Normal- nach Regenerationsbetrieb" SWORD Prc 1 100 -400.0000 399.9878 FORMAT "%8.4" ECU_ADDRESS 0x8FE34E /end MEASUREMENT
/begin MEASUREMENT AirCtl_rEGRNrmRgn_mp "Stellgröße für das ARF-Ventil im Übergang von Normal- nach Regenerationsbetrieb" SWORD Prc 1 100 -400.0000 399.9878 FORMAT "%8.4" ECU_ADDRESS 0x8FE350 /end MEASUREMENT
/begin MEASUREMENT AirCtl_rEGRRgnNrm2_mp "Stellgröße für ARF-Ventil im Übergang von Regenerations- zum Normalbetrieb" SWORD Prc 1 100 -400.0000 399.9878 FORMAT "%8.4" ECU_ADDRESS 0x8FE352 /end MEASUREMENT
/begin MEASUREMENT AirCtl_rEGRRgnNrm_mp "Stellgröße für ARF-Ventil im Übergang von Regenerations- zum Normalbetrieb" SWORD Prc 1 100 -400.0000 399.9878 FORMAT "%8.4" ECU_ADDRESS 0x8FE354 /end MEASUREMENT
/begin MEASUREMENT AirCtl_rEGRRgnVal2_mp "Stellgröße für ARF- Ventil im Regenerationsbetrieb" SWORD Prc 1 100 -400.0000 399.9878 FORMAT "%8.4" ECU_ADDRESS 0x8FE356 /end MEASUREMENT
/begin MEASUREMENT AirCtl_rEGRRgnVal_mp "Stellgröße für ARF- Ventil im Regenerationsbetrieb" SWORD Prc 1 100 -400.0000 399.9878 FORMAT "%8.4" ECU_ADDRESS 0x8FE358 /end MEASUREMENT
/begin MEASUREMENT AirCtl_rGvnrCalc2_mp "aus der Stellgröße für das ARF-Ventil rückgerechneter Reglerausgang" SWORD Prc 1 100 -400.0000 399.9878 FORMAT "%8.4" ECU_ADDRESS 0x8FE35A /end MEASUREMENT
/begin MEASUREMENT AirCtl_rGvnrCalc_mp "aus der Stellgröße für das ARF-Ventil rückgerechneter Reglerausgang" SWORD Prc 1 100 -400.0000 399.9878 FORMAT "%8.4" ECU_ADDRESS 0x8FE35C /end MEASUREMENT
/begin MEASUREMENT AirCtl_rGvnrDvtNrm "normierte Regelabweichung" SWORD Prc 1 100 -400.0000 399.9878 FORMAT "%8.4" ECU_ADDRESS 0x7F8AB6 /end MEASUREMENT
/begin MEASUREMENT AirCtl_rRgnBgnInit2_mp "Initialisierungswert für Regler-I-Anteil bei Regenerationsbeginn" SWORD Prc 1 100 -400.0000 399.9878 FORMAT "%8.4" ECU_ADDRESS 0x8FE35E /end MEASUREMENT
/begin MEASUREMENT AirCtl_rRgnBgnInit_mp "Initialisierungswert für Regler-I-Anteil bei Regenerationsbeginn" SWORD Prc 1 100 -400.0000 399.9878 FORMAT "%8.4" ECU_ADDRESS 0x8FE360 /end MEASUREMENT
/begin MEASUREMENT AirCtl_rRgnEndInit2_mp "Initialisierungswert für Regler-I-Anteil bei Regenerationsende" SWORD Prc 1 100 -400.0000 399.9878 FORMAT "%8.4" ECU_ADDRESS 0x8FE362 /end MEASUREMENT
/begin MEASUREMENT AirCtl_rRgnEndInit_mp "Initialisierungswert für Regler-I-Anteil bei Regenerationsende" SWORD Prc 1 100 -400.0000 399.9878 FORMAT "%8.4" ECU_ADDRESS 0x8FE364 /end MEASUREMENT
/begin MEASUREMENT AirCtl_rTVA "Sollposition des Regelklappen-Stellers" SWORD Prc 1 100 -400.0000 399.9878 FORMAT "%8.4" ECU_ADDRESS 0x7F8AC0 /end MEASUREMENT
/begin MEASUREMENT AirCtl_rTVA2 "Verhältnis von TVA2" SWORD Prc 1 100 -400.0000 399.9878 FORMAT "%8.4" ECU_ADDRESS 0x7F8AC2 /end MEASUREMENT
/begin MEASUREMENT AirCtl_rTVAByp_mp "Bypass-Label, Kopie von AirCtl_rTVA" SWORD Prc 1 100 -400.0000 399.9878 FORMAT "%8.4" ECU_ADDRESS 0x8FE38A /end MEASUREMENT
/begin MEASUREMENT AirCtl_rTVACtlAPSCor_mp "Atmosphärendruck-Korrekturwert des Tastverhältnisses für TVA" SWORD Prc 1 100 -400.0000 399.9878 FORMAT "%8.4" ECU_ADDRESS 0x8FE366 /end MEASUREMENT
/begin MEASUREMENT AirCtl_rTVACtlATCor_mp "Ansauglufttemperatur-Korrekturwert des Tastverhältnisses für TVA" SWORD Prc 1 100 -400.0000 399.9878 FORMAT "%8.4" ECU_ADDRESS 0x8FE368 /end MEASUREMENT
/begin MEASUREMENT AirCtl_rTVACtlBas_mp "Grundwert des Tastverhältnisses für TVA" SWORD Prc 1 100 -400.0000 399.9878 FORMAT "%8.4" ECU_ADDRESS 0x8FE36A /end MEASUREMENT
/begin MEASUREMENT AirCtl_rTVACtlCTCor_mp "Kühlmitteltemperatur-Korrekturwert des Tastverhältnisses für TVA" SWORD Prc 1 100 -400.0000 399.9878 FORMAT "%8.4" ECU_ADDRESS 0x8FE36C /end MEASUREMENT
/begin MEASUREMENT AirCtl_rTVACtl_mp "Tastverhältnis TVA im gesteuerten Betrieb" SWORD Prc 1 100 -400.0000 399.9878 FORMAT "%8.4" ECU_ADDRESS 0x8FE36E /end MEASUREMENT
/begin MEASUREMENT AirCtl_rTVARgnVal2_mp "Stellgröße für die Drosselklappe im Regenerationsbetrieb" SWORD Prc 1 100 -400.0000 399.9878 FORMAT "%8.4" ECU_ADDRESS 0x8FE370 /end MEASUREMENT
/begin MEASUREMENT AirCtl_rTVARgnVal_mp "Stellgröße für die Drosselklappe im Regenerationsbetrieb" SWORD Prc 1 100 -400.0000 399.9878 FORMAT "%8.4" ECU_ADDRESS 0x8FE372 /end MEASUREMENT
/begin MEASUREMENT AirCtl_stAirCtl "Anzeige der Abschaltursache in der ARF-Überwachung" UBYTE OneToOne 1 100 0.00 255.0 FORMAT "%5.1" ECU_ADDRESS 0x7F87C3 /end MEASUREMENT
/begin MEASUREMENT AirCtl_stAirCtlBits "Bitorientierte Anzeige aller Abschaltursachen" ULONG OneToOne 1 100 0.00 4294967295.00 FORMAT "%13.2" ECU_ADDRESS 0x7F9160 /end MEASUREMENT
/begin MEASUREMENT AirCtl_stAirCtlBits1_mp "AirCtl_stAirCtlBits_mp LowByte (->Signals)" UWORD OneToOne 1 100 0.00 65535.00 FORMAT "%8.2" ECU_ADDRESS 0x6F8002 /end MEASUREMENT
/begin MEASUREMENT AirCtl_stAirCtlBits2_mp "AirCtl_stAirCtlBits_mp HighByte (->Signals)" UWORD OneToOne 1 100 0.00 65535.00 FORMAT "%8.2" ECU_ADDRESS 0x6F8004 /end MEASUREMENT
/begin MEASUREMENT AirCtl_stAirCtlBits_mp "Anzeige der Abschaltursache in der ARF-Überwachung (bitorientiert)" ULONG OneToOne 1 100 0.00 4294967295.00 FORMAT "%13.2" ECU_ADDRESS 0x8FE38C /end MEASUREMENT
/begin MEASUREMENT AirCtl_stDebBrkpressed_mp "Deaktivierung der Überwachung der negativen Regelabweichung bei mehrmals betätigter Bremse" UBYTE OneToOne 1 100 0.00 255.0 FORMAT "%5.1" ECU_ADDRESS 0x8FE390 /end MEASUREMENT
/begin MEASUREMENT AirCtl_stDebDefNrm_mp "Status, ob Regelabweichung im Normalbetrieb überwacht" UBYTE OneToOne 1 100 0.00 255.0 FORMAT "%5.1" ECU_ADDRESS 0x8FE39C /end MEASUREMENT
/begin MEASUREMENT AirCtl_stDebDefRgn_mp "Status, ob Regelabweichung Regenerationsbetrieb überwacht" UBYTE OneToOne 1 100 0.00 255.0 FORMAT "%5.1" ECU_ADDRESS 0x8FE39D /end MEASUREMENT
/begin MEASUREMENT AirCtl_stDebDef_mp "Statusangabe, ob Regelabweichung überwacht wird" UBYTE OneToOne 1 100 0.00 255.0 FORMAT "%5.1" ECU_ADDRESS 0x8FE391 /end MEASUREMENT
/begin MEASUREMENT AirCtl_stDesChk_mp "Status ob AirCtl_mDesVal Maximum überschreitet" UBYTE OneToOne 1 100 0.00 255.0 FORMAT "%5.1" ECU_ADDRESS 0x8FE392 /end MEASUREMENT
/begin MEASUREMENT AirCtl_stGearShiftHighLoad_mp "status of gear control" UBYTE OneToOne 1 100 0.00 255.0 FORMAT "%5.1" ECU_ADDRESS 0x8FE393 /end MEASUREMENT
/begin MEASUREMENT AirCtl_stHealDef_mp "Status, ob Heilung von erkannter bleibender Regelabweichung zulässig" UBYTE OneToOne 1 100 0.00 255.0 FORMAT "%5.1" ECU_ADDRESS 0x8FE394 /end MEASUREMENT
/begin MEASUREMENT AirCtl_stMonitor "Status: Abschaltfall der Regelung" UBYTE OneToOne 1 100 0.00 255.0 FORMAT "%5.1" ECU_ADDRESS 0x7F87C6 /end MEASUREMENT
/begin MEASUREMENT AirCtl_stPlateBreak_mp "State for plate break" UBYTE OneToOne 1 100 0.00 255.0 FORMAT "%5.1" ECU_ADDRESS 0x8FE395 /end MEASUREMENT
/begin MEASUREMENT AirCtl_stRgnDes_mp "Statusbit für Regenerationswunsch" UBYTE OneToOne 1 100 0.00 255.0 FORMAT "%5.1" ECU_ADDRESS 0x8FE374 /end MEASUREMENT
/begin MEASUREMENT AirCtl_tiStrtDel_mp "Zeit, in der die Regelung nach Startabwurf abgeschaltet bleibt" UWORD Time_ms 1 100 0.00 655350.0 FORMAT "%8.1" ECU_ADDRESS 0x8FE396 /end MEASUREMENT
/begin MEASUREMENT AirSys_stCmpntActv "Statusvariable für Endstufenabschaltung" UWORD OneToOne 1 100 0.00 65535.00 FORMAT "%8.2" ECU_ADDRESS 0x7F8AC4 /end MEASUREMENT
/begin MEASUREMENT AirSys_stTstDem "Statusvariable für Stellertest bei Diagnoseeingriff" UWORD OneToOne 1 100 0.00 65535.00 FORMAT "%8.2" ECU_ADDRESS 0x7F8AC6 /end MEASUREMENT
/begin MEASUREMENT AltCD_ctPosPins "Highbyte: Zähler für Funktionsaufrufe; Lowbyte: Zähler für positve Pins" SWORD OneToOne 1 100 -32768.00 32767.00 FORMAT "%8.2" ECU_ADDRESS 0x7F8AC8 /end MEASUREMENT
/begin MEASUREMENT AltCD_dcycAltLdPT1_mp "Generatorlast nach PT1-Filterung" UWORD DtyCyc 1 100 0.00 655.3500 FORMAT "%8.4" ECU_ADDRESS 0x8FE3A4 /end MEASUREMENT
/begin MEASUREMENT AltCD_dcycAltLoad "gemessenes Tastverhältnis des Generatorlastsignals" SWORD DtyCyc 1 100 -327.6800 327.6700 FORMAT "%8.4" ECU_ADDRESS 0x7F8ACA /end MEASUREMENT
/begin MEASUREMENT AltCD_rAltLoad "Linearisiertes und fehlerentprelltes Generatorlastsignals" SWORD Prc 1 100 -400.0000 399.9878 FORMAT "%8.4" ECU_ADDRESS 0x7F8ACC /end MEASUREMENT
/begin MEASUREMENT AltCD_stAltCtl_mp "Spannungsregelung - Status" UBYTE OneToOne 1 100 0.00 255.0 FORMAT "%5.1" ECU_ADDRESS 0x8FE3A6 /end MEASUREMENT
/begin MEASUREMENT AltCD_stErrAlt "Generator Fehlerbits" UBYTE OneToOne 1 100 0.00 255.0 FORMAT "%5.1" ECU_ADDRESS 0x7F87CD /end MEASUREMENT
/begin MEASUREMENT AltCD_stErrSig "entprelltes Generatorfehler Signal (Klemme 61)" UBYTE OneToOne 1 100 0.00 255.0 FORMAT "%5.1" ECU_ADDRESS 0x7F87CE /end MEASUREMENT
/begin MEASUREMENT AltCD_stErrSigDeb_mp "debounced value of terminal 61 signal" UBYTE OneToOne 1 100 0.00 255.0 FORMAT "%5.1" ECU_ADDRESS 0x8FE3A7 /end MEASUREMENT
/begin MEASUREMENT AltCD_stGenManuFak "message manufacturer of alternator" UBYTE OneToOne 1 100 0.00 255.0 FORMAT "%5.1" ECU_ADDRESS 0x7F87CF /end MEASUREMENT
/begin MEASUREMENT AltCD_stGenTypKenn "message alternator type" UBYTE OneToOne 1 100 0.00 255.0 FORMAT "%5.1" ECU_ADDRESS 0x7F87D0 /end MEASUREMENT
/begin MEASUREMENT AltCD_stLROff_mp "status of load response switch off" UBYTE OneToOne 1 100 0.00 255.0 FORMAT "%5.1" ECU_ADDRESS 0x8FE3A8 /end MEASUREMENT
/begin MEASUREMENT AltCD_stSRCdis_mp "Ausblendmaske für Generatorlastsignal" UBYTE OneToOne 1 100 0.00 255.0 FORMAT "%5.1" ECU_ADDRESS 0x8FE3A9 /end MEASUREMENT
/begin MEASUREMENT AltCD_tiLR_mp "Load Response Time, vom Generator zurückgelesener Wert" UWORD Time_s 1 100 0.00 655.3500 FORMAT "%8.4" ECU_ADDRESS 0x8FE3AA /end MEASUREMENT
/begin MEASUREMENT AltCD_uAlt "Generatorspannungs-Sollwert, vom Generator zurückgelesener Wert" SWORD Volt_Batt 1 100 -640625.6 640606.1 FORMAT "%8.1" ECU_ADDRESS 0x7F8ACE /end MEASUREMENT
/begin MEASUREMENT AltCD_uAlt_mp "Generatorspannungs-Sollwert, vom Generator zurückgelesener Wert" SWORD Volt_Batt 1 100 -640625.6 640606.1 FORMAT "%8.1" ECU_ADDRESS 0x8FE3AC /end MEASUREMENT
/begin MEASUREMENT Alt_n_mp "Drehzahl für Leistungsbedarfberechnung Generator" SWORD EngN 1 100 -32768.00 32767.00 FORMAT "%8.2" ECU_ADDRESS 0x8FE39E /end MEASUREMENT
/begin MEASUREMENT Alt_pwrDes "mechanischer Leistungsbedarf des Generators" SWORD Pwr 1 100 -308831.1 308821.7 FORMAT "%8.1" ECU_ADDRESS 0x7F8AD0 /end MEASUREMENT
/begin MEASUREMENT Alt_pwrLead "Vorhaltleistung des Generators" SWORD Pwr 1 100 -308831.1 308821.7 FORMAT "%8.1" ECU_ADDRESS 0x7F8AD2 /end MEASUREMENT
/begin MEASUREMENT Alt_pwrUnCor_mp "Generator Leistungsbedarf vor Korrektur" SWORD Pwr 1 100 -308831.1 308821.7 FORMAT "%8.1" ECU_ADDRESS 0x8FE3A0 /end MEASUREMENT
/begin MEASUREMENT Alt_rAdjVal_mp "Abgleichwert" SWORD Fact 1 100 -4.000000 3.999878 FORMAT "%8.6" ECU_ADDRESS 0x8FE3A2 /end MEASUREMENT
/begin MEASUREMENT anzmark "Anzahl Geschwindigkeits-Marken Stufentempomat" UBYTE dez 1 100 0.00 255.0 FORMAT "%5.1" ECU_ADDRESS 0x7F89E3 /end MEASUREMENT
/begin MEASUREMENT AOHtCD_rOut_mp "Meßpunkt fuer korrigiertes Tastverhaeltnis der Zuheizeransteuerung" SWORD DtyCyc 1 100 -327.6800 327.6700 FORMAT "%8.4" ECU_ADDRESS 0x6F8008 /end MEASUREMENT
/begin MEASUREMENT AOHtCD_stHtgReq "Heizleistungsanforderung von Hardware-Pin (Heizungssteuerung)" UBYTE OneToOne 1 100 0.00 255.0 FORMAT "%5.1" ECU_ADDRESS 0x7F87B5 /end MEASUREMENT
/begin MEASUREMENT AOHt_nMin "Minimum Leerlaufsolldrehzahlanforderung durch Zuheizer" SWORD EngN 1 100 -32768.00 32767.00 FORMAT "%8.2" ECU_ADDRESS 0x7F8A40 /end MEASUREMENT
/begin MEASUREMENT AOHt_rAltLd_mp "Ausgang - Generatorlastkennlinie" SWORD DtyCyc 1 100 -327.6800 327.6700 FORMAT "%8.4" ECU_ADDRESS 0x8FE3AE /end MEASUREMENT
/begin MEASUREMENT AOHt_rHtgOut "Heizleitungsanforderung, Zuheizer (Tastverhältnis)" SWORD DtyCyc 1 100 -327.6800 327.6700 FORMAT "%8.4" ECU_ADDRESS 0x7F8A42 /end MEASUREMENT
/begin MEASUREMENT AOHt_rIGov_mp "I-Anteil des PI-Reglers" SWORD DtyCyc 1 100 -327.6800 327.6700 FORMAT "%8.4" ECU_ADDRESS 0x8FE3B0 /end MEASUREMENT
/begin MEASUREMENT AOHt_rNAvrgDeb_mp "PT1 gefilterter Motordrehzahl-TV-Wert" SWORD DtyCyc 1 100 -327.6800 327.6700 FORMAT "%8.4" ECU_ADDRESS 0x8FE3B2 /end MEASUREMENT
/begin MEASUREMENT AOHt_rNAvrg_mp "umgerechnete Motordrehzahl (in %-TV) - nach Kennlinie" SWORD DtyCyc 1 100 -327.6800 327.6700 FORMAT "%8.4" ECU_ADDRESS 0x8FE3B4 /end MEASUREMENT
/begin MEASUREMENT AOHt_rPGov_mp "P-Anteil des PI-Reglers" SWORD DtyCyc 1 100 -327.6800 327.6700 FORMAT "%8.4" ECU_ADDRESS 0x8FE3B6 /end MEASUREMENT
/begin MEASUREMENT AOHt_rPI_mp "Eingangsgroesse des PI-Reglers (Regelabweichung)" SWORD DtyCyc 1 100 -327.6800 327.6700 FORMAT "%8.4" ECU_ADDRESS 0x8FE3B8 /end MEASUREMENT
/begin MEASUREMENT AOHt_stAC_mp "States of ACceleration logic" UBYTE OneToOne 1 100 0.00 255.0 FORMAT "%5.1" ECU_ADDRESS 0x8FE3BA /end MEASUREMENT
/begin MEASUREMENT AOHt_stDA_mp "States of Drive Away logic" UBYTE OneToOne 1 100 0.00 255.0 FORMAT "%5.1" ECU_ADDRESS 0x8FE3BB /end MEASUREMENT
/begin MEASUREMENT AOHt_stHtgUp "Warmlaufzustand des Motors" UBYTE OneToOne 1 100 0.00 255.0 FORMAT "%5.1" ECU_ADDRESS 0x7F87B6 /end MEASUREMENT
/begin MEASUREMENT AOHt_stShutOff_mp "Überblick auf alle Abschaltbedingungen" UWORD OneToOne 1 100 0.00 65535.00 FORMAT "%8.2" ECU_ADDRESS 0x6F8006 /end MEASUREMENT
/begin MEASUREMENT AOHt_tEnvLin_mp "Umgebungstemperatur nach Kennlinie" SWORD Temp_Cels 1 100 -50.140 899.860 FORMAT "%8.3" ECU_ADDRESS 0x8FE3BC /end MEASUREMENT
/begin MEASUREMENT APPCD_drAPP1UnFlt "Differenz der Fahrpedal 1 Position ungefilterter Wert" SWORD PrcPerSec 1 100 -20000.00 19999.39 FORMAT "%8.2" ECU_ADDRESS 0x7F8A44 /end MEASUREMENT
/begin MEASUREMENT APPCD_rAPP1UnFlt "Fahrpedal 1 position ungefilterter Rohwert" SWORD Prc 1 100 -400.0000 399.9878 FORMAT "%8.4" ECU_ADDRESS 0x7F8A46 /end MEASUREMENT
/begin MEASUREMENT APPCD_rFlt "gefiltertes Pedalwertgebersignal" SWORD Prc 1 100 -400.0000 399.9878 FORMAT "%8.4" ECU_ADDRESS 0x7F8A48 /end MEASUREMENT
/begin MEASUREMENT APPCD_rFlt_mp "gefilterter PWG Positions Wert ohne PTO Eingriff" SWORD Prc 1 100 -400.0000 399.9878 FORMAT "%8.4" ECU_ADDRESS 0x8FE3BE /end MEASUREMENT
/begin MEASUREMENT APPCD_rNextThr "Berechneter Wert des nächsten Schwellwertes" SWORD Prc 1 100 -400.0000 399.9878 FORMAT "%8.4" ECU_ADDRESS 0x7F8A4A /end MEASUREMENT
/begin MEASUREMENT APPCD_rStepLim_mp "Limitierter Stufen-Wert" SWORD Prc 1 100 -400.0000 399.9878 FORMAT "%8.4" ECU_ADDRESS 0x8FE3C0 /end MEASUREMENT
/begin MEASUREMENT APPCD_stAPP12def_mp "Messpunkt für unentprellten Gleichlauffehler APP1/APP2" UBYTE OneToOne 1 100 0.00 255.0 FORMAT "%5.1" ECU_ADDRESS 0x8FE3C2 /end MEASUREMENT
/begin MEASUREMENT APPCD_stErr1_mp "Fehlerzustand von APP1/2 Signal" UWORD OneToOne 1 100 0.00 65535.00 FORMAT "%8.2" ECU_ADDRESS 0x8FE3C4 /end MEASUREMENT
/begin MEASUREMENT APPCD_stKickDown "Kick Down Zustand des Fahrpedals" UBYTE OneToOne 1 100 0.00 255.0 FORMAT "%5.1" ECU_ADDRESS 0x7F87B7 /end MEASUREMENT
/begin MEASUREMENT APPCD_stLimp "Status Notfahrbetrieb APP" UBYTE OneToOne 1 100 0.00 255.0 FORMAT "%5.1" ECU_ADDRESS 0x7F87B8 /end MEASUREMENT
/begin MEASUREMENT APPCD_stPos "Status der PWG Position" UBYTE OneToOne 1 100 0.00 255.0 FORMAT "%5.1" ECU_ADDRESS 0x7F87B9 /end MEASUREMENT
/begin MEASUREMENT APPCD_stSigSrc "Status der ausgewaehlten Signalquelle APP" UBYTE OneToOne 1 100 0.00 255.0 FORMAT "%5.1" ECU_ADDRESS 0x7F87BA /end MEASUREMENT
/begin MEASUREMENT APPCD_stTempErr_mp "Messpunkt für vorläufigen APP-Fehler" UBYTE OneToOne 1 100 0.00 255.0 FORMAT "%5.1" ECU_ADDRESS 0x8FE3C6 /end MEASUREMENT
/begin MEASUREMENT APPCD_stTempHeal_mp "Messpunkt für die vorläufig geheilten APP1/APP2 Fehler" UBYTE OneToOne 1 100 0.00 255.0 FORMAT "%5.1" ECU_ADDRESS 0x8FE3C7 /end MEASUREMENT
/begin MEASUREMENT APPCD_uAPPunJit_mp "Messpunkt der  APP Rohspannung vor Entjitterung" SWORD Volt 1 100 -160156.4 160151.5 FORMAT "%8.1" ECU_ADDRESS 0x8FE3C8 /end MEASUREMENT
/begin MEASUREMENT APPCD_uDiffMax_mp "Maximal zulässige Differenz der Rohspannungen" SWORD Volt 1 100 -160156.4 160151.5 FORMAT "%8.1" ECU_ADDRESS 0x8FE3CA /end MEASUREMENT
/begin MEASUREMENT APPCD_uRawAPP1 "Fahrpedal 1 Position Rohwert" SWORD Volt 1 100 -160156.4 160151.5 FORMAT "%8.1" ECU_ADDRESS 0x7F8A4C /end MEASUREMENT
/begin MEASUREMENT APPCD_uRawAPP1half_mp "Halbierte APP1 Rohspannung" SWORD Volt 1 100 -160156.4 160151.5 FORMAT "%8.1" ECU_ADDRESS 0x8FE3CC /end MEASUREMENT
/begin MEASUREMENT APPCD_uRawAPP2 "Fahrpedal 2 Position Rohwert" SWORD Volt 1 100 -160156.4 160151.5 FORMAT "%8.1" ECU_ADDRESS 0x7F8A4E /end MEASUREMENT
/begin MEASUREMENT APPCD_uRawAPP2dbl_mp "Verdoppelte APP2 Rohspannung" SWORD Volt 1 100 -160156.4 160151.5 FORMAT "%8.1" ECU_ADDRESS 0x8FE3CE /end MEASUREMENT
/begin MEASUREMENT APPCD_uRawDiff_mp "Betrag der Differenz der Rohspannungen von APP1 und APP2" SWORD Volt 1 100 -160156.4 160151.5 FORMAT "%8.1" ECU_ADDRESS 0x8FE3D0 /end MEASUREMENT
/begin MEASUREMENT APPCD_uRaw_mp "Messpunkt der ausgewaehlten APP Rohspannung" SWORD Volt 1 100 -160156.4 160151.5 FORMAT "%8.1" ECU_ADDRESS 0x8FE3D2 /end MEASUREMENT
/begin MEASUREMENT APSCD_BpsAllowed_mp "Wahlschalter - Atmosphaerendruck gemessen (wenn verbaut) od. gerechnet von Ladedrucksensor" UWORD OneToOne 1 100 0.00 65535.00 FORMAT "%8.2" ECU_ADDRESS 0x8FE3D4 /end MEASUREMENT
/begin MEASUREMENT APSCD_pCorVal_mp "Korrekturwert fuer Atmosphaerendruck von Ladedrucksensor" SWORD Pres_hPa 1 100 -32768.00 32767.00 FORMAT "%8.2" ECU_ADDRESS 0x8FE3D6 /end MEASUREMENT
/begin MEASUREMENT APSCD_pLinVal "Rohwert Atmosphärendruck über ADC" SWORD Pres_hPa 1 100 -32768.00 32767.00 FORMAT "%8.2" ECU_ADDRESS 0x7F8A50 /end MEASUREMENT
/begin MEASUREMENT APSCD_pPhyVal_mp "Rohwert Atmosphärendruck über ADC" SWORD Pres_hPa 1 100 -32768.00 32767.00 FORMAT "%8.2" ECU_ADDRESS 0x8FE3D8 /end MEASUREMENT
/begin MEASUREMENT APSCD_pSensorVal "Atmosphaerendruck Sensorwert" SWORD Pres_hPa 1 100 -32768.00 32767.00 FORMAT "%8.2" ECU_ADDRESS 0x7F8A52 /end MEASUREMENT
/begin MEASUREMENT APSCD_pVal "Atmosphärendruck" SWORD Pres_hPa 1 100 -32768.00 32767.00 FORMAT "%8.2" ECU_ADDRESS 0x7F8A54 /end MEASUREMENT
/begin MEASUREMENT APSCD_stSensorInst "Status, ob Atmosphärendrucksensor eingebaut ist (0 == nicht eingebaut)" UBYTE OneToOne 1 100 0.00 255.0 FORMAT "%5.1" ECU_ADDRESS 0x7F87BB /end MEASUREMENT
/begin MEASUREMENT APSCD_swtSig "Atmosphaerendruck Funktionsschalter - Signalwert von CAN od. ADC" UBYTE OneToOne 1 100 0.00 255.0 FORMAT "%5.1" ECU_ADDRESS 0x7F87BC /end MEASUREMENT
/begin MEASUREMENT APSCD_uRaw "Rohspannung ADC-Signal Atmosphärendruck" SWORD Volt 1 100 -160156.4 160151.5 FORMAT "%8.1" ECU_ADDRESS 0x7F8A56 /end MEASUREMENT
/begin MEASUREMENT ARS_pwrDes "Current power requirement of ARS module" SWORD Pwr 1 100 -308831.1 308821.7 FORMAT "%8.1" ECU_ADDRESS 0x7F8A58 /end MEASUREMENT
/begin MEASUREMENT ARS_pwrLead "Current power requirement of ARS module for monitoring" SWORD Pwr 1 100 -308831.1 308821.7 FORMAT "%8.1" ECU_ADDRESS 0x7F8A5A /end MEASUREMENT
/begin MEASUREMENT ARS_st "Status of power requirement of ARS" UBYTE OneToOne 1 100 0.00 255.0 FORMAT "%5.1" ECU_ADDRESS 0x7F87BD /end MEASUREMENT
/begin MEASUREMENT ARS_stRecARS "Status of ARS detection" UBYTE OneToOne 1 100 0.00 255.0 FORMAT "%5.1" ECU_ADDRESS 0x7F87BE /end MEASUREMENT
/begin MEASUREMENT ARS_trqCor_mp "Corrected current torque" SWORD Trq 1 100 -3276.800 3276.700 FORMAT "%8.3" ECU_ADDRESS 0x8FE3DA /end MEASUREMENT
/begin MEASUREMENT ARS_trqCurMax_mp "corrected maximum torque" SWORD Trq 1 100 -3276.800 3276.700 FORMAT "%8.3" ECU_ADDRESS 0x8FE3DC /end MEASUREMENT
/begin MEASUREMENT ARS_trqDesMax_mp "Maximum desired torque" SWORD Trq 1 100 -3276.800 3276.700 FORMAT "%8.3" ECU_ADDRESS 0x8FE3DE /end MEASUREMENT
/begin MEASUREMENT ARS_trqDesOld_mp "Desired torque of previous cycle" SWORD Trq 1 100 -3276.800 3276.700 FORMAT "%8.3" ECU_ADDRESS 0x8FE3E0 /end MEASUREMENT
/begin MEASUREMENT ARS_trqDes_mp "Desired torque after correction" SWORD Trq 1 100 -3276.800 3276.700 FORMAT "%8.3" ECU_ADDRESS 0x8FE3E2 /end MEASUREMENT
/begin MEASUREMENT ASDdc_KdCurr_mp "Aktueller Parameter Kd des Störungsreglers" FLOAT32_IEEE ASD_GvrnDT1Kd_float 1 100 -1.00000000 100.000000 FORMAT "%10.6" ECU_ADDRESS 0x8FE3E4 /end MEASUREMENT
/begin MEASUREMENT ASDdc_nAvrg_mp "Motordrehzahl für die Parametersatzauswahl beim ASDdc" SWORD EngN 1 100 -32768.00 32767.00 FORMAT "%8.2" ECU_ADDRESS 0x8FE3EC /end MEASUREMENT
/begin MEASUREMENT ASDdc_stCluPS_mp "Kupplungs PS aktiv/nicht aktiv" UBYTE OneToOne 1 100 0.00 255.0 FORMAT "%5.1" ECU_ADDRESS 0x8FE3EE /end MEASUREMENT
/begin MEASUREMENT ASDdc_stCond_mp "Zustand der Eingangsbedingungen" UWORD OneToOne 1 100 0.00 65535.00 FORMAT "%8.2" ECU_ADDRESS 0x8FE3F0 /end MEASUREMENT
/begin MEASUREMENT ASDdc_stPrioState_mp "Primärzustand mit der höchsten Priorität" UWORD OneToOne 1 100 0.00 65535.00 FORMAT "%8.2" ECU_ADDRESS 0x8FE3F2 /end MEASUREMENT
/begin MEASUREMENT ASDdc_stREinit_mp "Zustand Reinit (deaktivieren)" UBYTE OneToOne 1 100 0.00 255.0 FORMAT "%5.1" ECU_ADDRESS 0x8FE3F4 /end MEASUREMENT
/begin MEASUREMENT ASDdc_stSelectState_mp "Ausgewählter Primärzustand" UWORD ASDdcState 1 100 0.00 65535.00 FORMAT "%8.2" ECU_ADDRESS 0x8FE3F6 /end MEASUREMENT
/begin MEASUREMENT ASDdc_stStates_mp "Zustand der Primärzustände" UWORD OneToOne 1 100 0.00 65535.00 FORMAT "%8.2" ECU_ADDRESS 0x8FE3F8 /end MEASUREMENT
/begin MEASUREMENT ASDdc_T1Curr_mp "Aktueller Parameter T1 des Störungsreglers" FLOAT32_IEEE ASD_GvrnDT1T1_float 1 100 -1.00000000 100.000000 FORMAT "%10.6" ECU_ADDRESS 0x8FE3E8 /end MEASUREMENT
/begin MEASUREMENT ASDdc_trq "Momentforderung Aktiver Ruckeldämpfer (Störungsregler)" SWORD Trq 1 100 -3276.800 3276.700 FORMAT "%8.3" ECU_ADDRESS 0x7F8A5C /end MEASUREMENT
/begin MEASUREMENT ASDrf_CoeffALossCurr_mp "Aktueller Kennwert für den Koeffitienten zweiter Ordnung der LSD Steigungsbegrenzung." SWORD CoeffA 1 100 -160.0000 159.9951 FORMAT "%8.4" ECU_ADDRESS 0x8FE3FA /end MEASUREMENT
/begin MEASUREMENT ASDrf_CoeffBLossCurr_mp "Aktueller Kennwert für den Koeffitienten nullter Ordnung der LSD Steigungsbegrenzung." SWORD dTrq 1 100 -3276.800 3276.700 FORMAT "%8.3" ECU_ADDRESS 0x8FE3FC /end MEASUREMENT
/begin MEASUREMENT ASDrf_dtrqDecMax_mp "Max. Drehmomentsteigung aufgrund der Gradientenbegrenzung bei Momentenabsenkung." SWORD dTrq 1 100 -3276.800 3276.700 FORMAT "%8.3" ECU_ADDRESS 0x8FE3FE /end MEASUREMENT
/begin MEASUREMENT ASDrf_dtrqDecMin_mp "Min. Drehmomentsteigung aufgrund der Gradientenbegrenzung bei Momentenabsenkung." SWORD dTrq 1 100 -3276.800 3276.700 FORMAT "%8.3" ECU_ADDRESS 0x8FE400 /end MEASUREMENT
/begin MEASUREMENT ASDrf_dtrqInrLtd_mp "zeitliche Ableitung von CoEng_trqInrLtd" SWORD dTrq 1 100 -3276.800 3276.700 FORMAT "%8.3" ECU_ADDRESS 0x8FE402 /end MEASUREMENT
/begin MEASUREMENT ASDrf_dtrqLim_mp "durch ASDrf_dtrqInrLtdLim_CUR begrenzte zeitliche Ableitung von CoEng_trqInrLtd" SLONG dTrq 1 100 -214748364.800 214748364.700 FORMAT "%13.3" ECU_ADDRESS 0x8FE404 /end MEASUREMENT
/begin MEASUREMENT ASDrf_dtrqLossMax_mp "Maximale Drehmomentsteigung der Steigungsbegrenzung um das Verlustmoment." SWORD dTrq 1 100 -3276.800 3276.700 FORMAT "%8.3" ECU_ADDRESS 0x8FE408 /end MEASUREMENT
/begin MEASUREMENT ASDrf_dtrqLossMin_mp "Maximale Drehmomentsteigung der Steigungsbegrenzung um das Verlustmoment." SWORD dTrq 1 100 -3276.800 3276.700 FORMAT "%8.3" ECU_ADDRESS 0x8FE40A /end MEASUREMENT
/begin MEASUREMENT ASDrf_dtrqMax_mp "Max. Drehmomentsteigung in der Umgebung des Verlustmoments oder durch die Begrenzung bei Drehmomentabsenkung." SWORD dTrq 1 100 -3276.800 3276.700 FORMAT "%8.3" ECU_ADDRESS 0x8FE40C /end MEASUREMENT
/begin MEASUREMENT ASDrf_dtrqMin_mp "Min. Drehmomentsteigung in der Umgebung des Verlustmoments oder durch die Begrenzung bei Drehmomentabsenkung." SWORD dTrq 1 100 -3276.800 3276.700 FORMAT "%8.3" ECU_ADDRESS 0x8FE40E /end MEASUREMENT
/begin MEASUREMENT ASDrf_KdCurr_mp "Aktueller Parameter Kd des ARD-FF (ASDrf)" SLONG Kd 1 100 -32768.0000000 32767.9999847 FORMAT "%13.7" ECU_ADDRESS 0x8FE410 /end MEASUREMENT
/begin MEASUREMENT ASDrf_stCond_mp "Status der Eingangsbedingungen" UWORD OneToOne 1 100 0.00 65535.00 FORMAT "%8.2" ECU_ADDRESS 0x8FE452 /end MEASUREMENT
/begin MEASUREMENT ASDrf_stDecLimState_mp "Status des Zustandsautomaten für Steigungsbegrenzung bei Momentenabsenkung." UBYTE OneToOne 1 100 0.00 255.0 FORMAT "%5.1" ECU_ADDRESS 0x8FE414 /end MEASUREMENT
/begin MEASUREMENT ASDrf_stIncLim_mp "Aktueller Zustand für flachen(=1) / steilen(=0) Drehmoment Anstieg." SWORD OneToOne 1 100 -32768.00 32767.00 FORMAT "%8.2" ECU_ADDRESS 0x8FE416 /end MEASUREMENT
/begin MEASUREMENT ASDrf_stInit "Initialisierungsanforderungen/Quittierungen an PT1, PDT1-Glieder" UBYTE OneToOne 1 100 0.00 255.0 FORMAT "%5.1" ECU_ADDRESS 0x6F800A /end MEASUREMENT
/begin MEASUREMENT ASDrf_stInitdtrqSteep_mp "Reinitialisierung bei Parametersatzänderung aktiv/inaktiv" UBYTE OneToOne 1 100 0.00 255.0 FORMAT "%5.1" ECU_ADDRESS 0x8FE418 /end MEASUREMENT
/begin MEASUREMENT ASDrf_stLAD "Zustandsvariable für den Automaten zur LSD Steuerung." UBYTE OneToOne 1 100 0.00 255.0 FORMAT "%5.1" ECU_ADDRESS 0x7F87BF /end MEASUREMENT
/begin MEASUREMENT ASDrf_stPosNeg_mp "aktueller pos/neg Zustand" UBYTE OneToOne 1 100 0.00 255.0 FORMAT "%5.1" ECU_ADDRESS 0x8FE419 /end MEASUREMENT
/begin MEASUREMENT ASDrf_stPrioState_mp "Aktiver Zustand nach der Priorisierung" UWORD OneToOne 1 100 0.00 65535.00 FORMAT "%8.2" ECU_ADDRESS 0x8FE454 /end MEASUREMENT
/begin MEASUREMENT ASDrf_stSelectState_mp "Aktiver Zustand, genau ein Primärzustand ist aktive" UWORD ASDrf_stPrimState 1 100 0.00 32.0000000000 FORMAT "%13.10" ECU_ADDRESS 0x8FE456 /end MEASUREMENT
/begin MEASUREMENT ASDrf_stStates_mp "Auswertung der Primärzustände (konkurrierende Zustände möglich)" UWORD OneToOne 1 100 0.00 65535.00 FORMAT "%8.2" ECU_ADDRESS 0x8FE458 /end MEASUREMENT
/begin MEASUREMENT ASDrf_stTrqLim_mp "Zustand der Drehmoment Gradientenbegrenzung (0=inaktiv, 1=aktiv)" UBYTE OneToOne 1 100 0.00 255.0 FORMAT "%5.1" ECU_ADDRESS 0x8FE41A /end MEASUREMENT
/begin MEASUREMENT ASDrf_T1Curr_mp "Aktueller Parameter T1 des ARD-FF (ASDrf)" ULONG TimeDelay_s 1 100 0.0000010000000 4294.9673 FORMAT "%9.4" ECU_ADDRESS 0x8FE41C /end MEASUREMENT
/begin MEASUREMENT ASDrf_trqASDSum_mp "Aktuelles ASD Moment (Berechnung abhängig von ASDrf_swtCalcTrq_C)" SWORD Trq 1 100 -3276.800 3276.700 FORMAT "%8.3" ECU_ADDRESS 0x8FE420 /end MEASUREMENT
/begin MEASUREMENT ASDrf_trqCompOfs_mp "Offset auf den PT1 Eingang zur Polkompensation." SLONG Trq 1 100 -214748364.800 214748364.700 FORMAT "%13.3" ECU_ADDRESS 0x8FE424 /end MEASUREMENT
/begin MEASUREMENT ASDrf_trqDecLimStrt_mp "Startpunkt / Scheitelpunkt für die Steigungsbegrenzung bei Drehmomentabsenkung" SWORD Trq 1 100 -3276.800 3276.700 FORMAT "%8.3" ECU_ADDRESS 0x8FE428 /end MEASUREMENT
/begin MEASUREMENT ASDrf_trqInit_mp "berechneter Initialisierungswert für PT1 Zustandsvariable" SWORD Trq 1 100 -3276.800 3276.700 FORMAT "%8.3" ECU_ADDRESS 0x8FE42A /end MEASUREMENT
/begin MEASUREMENT ASDrf_trqInr "ARD Führungsformer Momentausgang (inneres Moment)" SWORD Trq 1 100 -3276.800 3276.700 FORMAT "%8.3" ECU_ADDRESS 0x7F8A5E /end MEASUREMENT
/begin MEASUREMENT ASDrf_trqInrLtdFlt_mp "Gefiltertes Eingangssignal CoEng_trqInrLtd" SWORD Trq 1 100 -3276.800 3276.700 FORMAT "%8.3" ECU_ADDRESS 0x8FE42C /end MEASUREMENT
/begin MEASUREMENT ASDrf_trqInrMaxUnLim_mp "Aktuelle Obergrenze für ASDrf_trqInr vor der Begrenzung mit CoEng_trqInrLim (abhängig von ASDrf_swtLim_C)." SLONG Trq32 1 100 -3276.80000000 3276.79999847 FORMAT "%13.8" ECU_ADDRESS 0x8FE430 /end MEASUREMENT
/begin MEASUREMENT ASDrf_trqInrMax_mp "Max. zulässiges Moment durch Steigungsbegrenzung." SLONG Trq32 1 100 -3276.80000000 3276.79999847 FORMAT "%13.8" ECU_ADDRESS 0x8FE434 /end MEASUREMENT
/begin MEASUREMENT ASDrf_trqInrMinUnLim_mp "Aktuelle Untergrenze für ASDrf_trqInr vor der Begrenzung mit 0 (abhängig von ASDrf_swtLim_C)." SLONG Trq32 1 100 -3276.80000000 3276.79999847 FORMAT "%13.8" ECU_ADDRESS 0x8FE438 /end MEASUREMENT
/begin MEASUREMENT ASDrf_trqInrMin_mp "Min. zulässiges Moment durch Steigungsbegrenzung." SLONG Trq32 1 100 -3276.80000000 3276.79999847 FORMAT "%13.8" ECU_ADDRESS 0x8FE43C /end MEASUREMENT
/begin MEASUREMENT ASDrf_trqInrUnLim_mp "Ausgang des PDT1-Glieds, vor der Steigungsbegrenzung des Führungsformers." SWORD Trq 1 100 -3276.800 3276.700 FORMAT "%8.3" ECU_ADDRESS 0x8FE440 /end MEASUREMENT
/begin MEASUREMENT ASDrf_trqLossNeg "Verlustmoment bei negativem Zustand von ASDrf_stPosNeg." SWORD Trq 1 100 -3276.800 3276.700 FORMAT "%8.3" ECU_ADDRESS 0x7F8A60 /end MEASUREMENT
/begin MEASUREMENT ASDrf_trqLossPos "Verlustmoment bei positivem Zustand von ASDrf_stPosNeg." SWORD Trq 1 100 -3276.800 3276.700 FORMAT "%8.3" ECU_ADDRESS 0x7F8A62 /end MEASUREMENT
/begin MEASUREMENT ASDrf_trqLoss_mp "Reibmoment inc. Nebenaggregate" SWORD Trq 1 100 -3276.800 3276.700 FORMAT "%8.3" ECU_ADDRESS 0x8FE442 /end MEASUREMENT
/begin MEASUREMENT ASDrf_trqPT1In_mp "aktueller PT1 Eingangswert" SLONG Trq 1 100 -214748364.800 214748364.700 FORMAT "%13.3" ECU_ADDRESS 0x8FE444 /end MEASUREMENT
/begin MEASUREMENT ASDrf_trqPT1Out_mp "aktueller PT1 Ausgangswert" SWORD Trq 1 100 -3276.800 3276.700 FORMAT "%8.3" ECU_ADDRESS 0x8FE448 /end MEASUREMENT
/begin MEASUREMENT ASDrf_trqPT1P_mp "Ausgang P-Anteil in PT1 gefiltertem Signal" SWORD Trq 1 100 -3276.800 3276.700 FORMAT "%8.3" ECU_ADDRESS 0x8FE44A /end MEASUREMENT
/begin MEASUREMENT ASDrf_trqP_mp "Ausgang ASDrf P-Anteil" SWORD Trq 1 100 -3276.800 3276.700 FORMAT "%8.3" ECU_ADDRESS 0x8FE44C /end MEASUREMENT
/begin MEASUREMENT ASDrf_trqStyHigh_mp "Obere Grenze des Momentenintervalls für die Erkennung eines stationären Zustands." SWORD Trq 1 100 -3276.800 3276.700 FORMAT "%8.3" ECU_ADDRESS 0x8FE44E /end MEASUREMENT
/begin MEASUREMENT ASDrf_trqStyLow_mp "Untere Grenze des Momentenintervalls für die Erkennung eines stationären Zustands." SWORD Trq 1 100 -3276.800 3276.700 FORMAT "%8.3" ECU_ADDRESS 0x8FE450 /end MEASUREMENT
/begin MEASUREMENT ASMod_dmAirPerTimeCorr "dynamisch korrigierter Frischluftmassenstrom vor Mischstelle" SWORD AirMassPerTime 1 100 -3276.800 3276.700 FORMAT "%8.3" ECU_ADDRESS 0x7F8A64 /end MEASUREMENT
/begin MEASUREMENT ASMod_dmEGR_mp "rückgeführter Abgasmassenstrom" SWORD AirMassPerTime 1 100 -3276.800 3276.700 FORMAT "%8.3" ECU_ADDRESS 0x8FE45A /end MEASUREMENT
/begin MEASUREMENT ASMod_dmEG_mp "Abgasmassenstrom nach Verbrennung" SWORD AirMassPerTime 1 100 -3276.800 3276.700 FORMAT "%8.3" ECU_ADDRESS 0x8FE464 /end MEASUREMENT
/begin MEASUREMENT ASMod_dmExhMnfPre "Abgasmassenstrom am Eintritt des Abgaskrümmers" SWORD AirMassPerTime 1 100 -3276.800 3276.700 FORMAT "%8.3" ECU_ADDRESS 0x7F8A66 /end MEASUREMENT
/begin MEASUREMENT ASMod_dmExhMnfPst "Abgasmassenstrom am Austritt des Abgaskrümmers" SWORD AirMassPerTime 1 100 -3276.800 3276.700 FORMAT "%8.3" ECU_ADDRESS 0x7F8A68 /end MEASUREMENT
/begin MEASUREMENT ASMod_dmFlBurned_mp "Massenstrom des verbrannten Kraftstoffs" SWORD InjMassPerTime 1 100 -327.6800 327.6700 FORMAT "%8.4" ECU_ADDRESS 0x8FE466 /end MEASUREMENT
/begin MEASUREMENT ASMod_dmFlPerTime_mp "eingespritzter Kraftstoffmassenstrom" SWORD InjMassPerTime 1 100 -327.6800 327.6700 FORMAT "%8.4" ECU_ADDRESS 0x8FE468 /end MEASUREMENT
/begin MEASUREMENT ASMod_dmIndAir "Gasmassenstrom in den Motor" SWORD AirMassPerTime 1 100 -3276.800 3276.700 FORMAT "%8.3" ECU_ADDRESS 0x7F8A6A /end MEASUREMENT
/begin MEASUREMENT ASMod_dmIndAirRef "Referenz des Gasmassenstroms in den Motor während geschlossener Abgasrückführung" SWORD AirMassPerTime 1 100 -3276.800 3276.700 FORMAT "%8.3" ECU_ADDRESS 0x7F8A6C /end MEASUREMENT
/begin MEASUREMENT ASMod_dmIndAirRef_mp "Referenz des Gasmassenstroms in den Motor" SWORD AirMassPerTime 1 100 -3276.800 3276.700 FORMAT "%8.3" ECU_ADDRESS 0x8FE46A /end MEASUREMENT
/begin MEASUREMENT ASMod_dmIndAir_mp "Gasmassenstrom in den Motor" SWORD AirMassPerTime 1 100 -3276.800 3276.700 FORMAT "%8.3" ECU_ADDRESS 0x8FE45C /end MEASUREMENT
/begin MEASUREMENT ASMod_dmIndVol_mp "zeitliche Änderung der Gasmasse im Ansaugvolumen" SWORD AirMassPerTime 1 100 -3276.800 3276.700 FORMAT "%8.3" ECU_ADDRESS 0x8FE488 /end MEASUREMENT
/begin MEASUREMENT ASMod_dmO2EG_mp "Sauerstoffmassenstrom nach Verbrennung" SWORD O2MassPerTime 1 100 -327.6800 327.6700 FORMAT "%8.4" ECU_ADDRESS 0x8FE46C /end MEASUREMENT
/begin MEASUREMENT ASMod_dmO2IndAir "Sauerstoffmassenstrom in den Motor" SWORD O2MassPerTime 1 100 -327.6800 327.6700 FORMAT "%8.4" ECU_ADDRESS 0x7F8A6E /end MEASUREMENT
/begin MEASUREMENT ASMod_dvolIndAirRef "Referenz des Gasvolumenstroms in den Motor" SWORD AirVolPerTime 1 100 -3276.800 3276.700 FORMAT "%8.3" ECU_ADDRESS 0x7F8A70 /end MEASUREMENT
/begin MEASUREMENT ASMod_facAMCor "Korrekturfaktor für Luftmassensignal" SWORD Fact 1 100 -4.000000 3.999878 FORMAT "%8.6" ECU_ADDRESS 0x7F8A72 /end MEASUREMENT
/begin MEASUREMENT ASMod_facDMCorTDiff_mp "Korrekturfaktor der Temperaturerhöhung aufgrund des aktuellen Gasmassenstroms" SWORD Fact 1 100 -4.000000 3.999878 FORMAT "%8.6" ECU_ADDRESS 0x8FE46E /end MEASUREMENT
/begin MEASUREMENT ASMod_facSOICorTDiff_mp "Korrekturfaktor der Temperaturerhöhung aufgrund des aktuellen Spritzbeginns" SWORD Fact 1 100 -4.000000 3.999878 FORMAT "%8.6" ECU_ADDRESS 0x8FE470 /end MEASUREMENT
/begin MEASUREMENT ASMod_facTIndAirCor_mp "Korrekturfaktor für Luftaufwand" SWORD RatAirMass 1 100 -32.76800 32.76700 FORMAT "%8.5" ECU_ADDRESS 0x8FE48C /end MEASUREMENT
/begin MEASUREMENT ASMod_facVolEff_mp "Luftaufwand aus Grundkennfeld" SWORD RatAirMass 1 100 -32.76800 32.76700 FORMAT "%8.5" ECU_ADDRESS 0x8FE48E /end MEASUREMENT
/begin MEASUREMENT ASMod_facVSACorVolEff_mp "Korrekturfaktor für Luftaufwand aufgrund aktueller Drallklappenposition" SWORD RatAirMass 1 100 -32.76800 32.76700 FORMAT "%8.5" ECU_ADDRESS 0x8FE490 /end MEASUREMENT
/begin MEASUREMENT ASMod_mAirPerCylCorr "dynamisch korrigierte Luftmasse pro Zylinder vor Mischstelle" SWORD AirMassPerCyl 1 100 -3276.800 3276.700 FORMAT "%8.3" ECU_ADDRESS 0x7F8A74 /end MEASUREMENT
/begin MEASUREMENT ASMod_mIndVol_mp "Gasmasse im Einlassvolumen" SWORD AirMass 1 100 -327.6800 327.6700 FORMAT "%8.4" ECU_ADDRESS 0x8FE48A /end MEASUREMENT
/begin MEASUREMENT ASMod_phiSOIRef_mp "Referenz des Spritzbeginns der MI1" SWORD AngleCrS 1 100 -768.0000 767.9766 FORMAT "%8.4" ECU_ADDRESS 0x8FE472 /end MEASUREMENT
/begin MEASUREMENT ASMod_qBurned_mp "Menge des verbrannten Kraftstoffes" SWORD InjMass 1 100 -327.6800 327.6700 FORMAT "%8.4" ECU_ADDRESS 0x8FE474 /end MEASUREMENT
/begin MEASUREMENT ASMod_qCor "Korrekturmenge für Mengensignal" SWORD InjMass 1 100 -327.6800 327.6700 FORMAT "%8.4" ECU_ADDRESS 0x7F8A76 /end MEASUREMENT
/begin MEASUREMENT ASMod_qLmbdCtlCorr_mp "korrigierte Lambdakontrollmenge" SWORD InjMass 1 100 -327.6800 327.6700 FORMAT "%8.4" ECU_ADDRESS 0x8FE476 /end MEASUREMENT
/begin MEASUREMENT ASMod_rDMIndAir_mp "relative Abweichung von der Referenz des Gasmassenstroms" SWORD RatAirMass 1 100 -32.76800 32.76700 FORMAT "%8.5" ECU_ADDRESS 0x8FE478 /end MEASUREMENT
/begin MEASUREMENT ASMod_rFlBurned_mp "Verhältnis der verbrannten zur eingespritzten Kraftstoffmasse" SWORD RatFuelMass 1 100 -327.6800 327.6700 FORMAT "%8.4" ECU_ADDRESS 0x8FE47A /end MEASUREMENT
/begin MEASUREMENT ASMod_rLmbdRecEG "schnelles reziprokes Lambda-Signal nach Verbrennung" SWORD lambdaRecVal 1 100 -32.76800 32.76700 FORMAT "%8.5" ECU_ADDRESS 0x7F8A78 /end MEASUREMENT
/begin MEASUREMENT ASMod_rLmbdRecExhMnfPst "reziprokes Lambdasignal am Ausgang des Abgaskrümmers" SWORD lambdaRecVal 1 100 -32.76800 32.76700 FORMAT "%8.5" ECU_ADDRESS 0x7F8A7A /end MEASUREMENT
/begin MEASUREMENT ASMod_rO2EG_mp "Sauerstoffmassenanteil des Abgases nach Verbrennung" SWORD O2 1 100 -0.3276800 0.3276700 FORMAT "%9.7" ECU_ADDRESS 0x8FE47C /end MEASUREMENT
/begin MEASUREMENT ASMod_rO2ExhMnfPre "Sauerstoffmassenanteil des Abgases am Eintritt des Abgaskrümmers" SWORD O2 1 100 -0.3276800 0.3276700 FORMAT "%9.7" ECU_ADDRESS 0x7F8A7C /end MEASUREMENT
/begin MEASUREMENT ASMod_rO2ExhMnfPst_mp "Sauerstoffmassenanteil des Abgases am Austritt des Abgaskrümmers" SWORD O2 1 100 -0.3276800 0.3276700 FORMAT "%9.7" ECU_ADDRESS 0x8FE45E /end MEASUREMENT
/begin MEASUREMENT ASMod_rO2IndAir_mp "Sauerstoffmassenanteil des Massenstroms in den Motor" SWORD O2 1 100 -0.3276800 0.3276700 FORMAT "%9.7" ECU_ADDRESS 0x8FE460 /end MEASUREMENT
/begin MEASUREMENT ASMod_rRelPosVSA "relative Position der Drallklappe" SWORD Prc 1 100 -400.0000 399.9878 FORMAT "%8.4" ECU_ADDRESS 0x7F8A7E /end MEASUREMENT
/begin MEASUREMENT ASMod_tDiffEG_mp "Temperaturerhöhung des Gasmassenstroms durch Verbrennung" SWORD TempDiff_Cels 1 100 -3276.800 3276.700 FORMAT "%8.3" ECU_ADDRESS 0x8FE47E /end MEASUREMENT
/begin MEASUREMENT ASMod_tDiffEng_mp "Temperaturerhöhung des Gasmassenstroms aus dem Grundkennfeld" SWORD TempDiff_Cels 1 100 -3276.800 3276.700 FORMAT "%8.3" ECU_ADDRESS 0x8FE480 /end MEASUREMENT
/begin MEASUREMENT ASMod_tEG_mp "Temperatur des Abgases nach Verbrennung" SWORD Temp_Cels 1 100 -50.140 899.860 FORMAT "%8.3" ECU_ADDRESS 0x8FE482 /end MEASUREMENT
/begin MEASUREMENT ASMod_tEngCorTDiff_mp "Korrektur der Temperaturerhöhung aufgrund der Motortemperatur" SWORD TempDiff_Cels 1 100 -3276.800 3276.700 FORMAT "%8.3" ECU_ADDRESS 0x8FE484 /end MEASUREMENT
/begin MEASUREMENT ASMod_tExhMnfPre "Abgastemperatur am Eintritt des Abgaskrümmers" SWORD Temp_Cels 1 100 -50.140 899.860 FORMAT "%8.3" ECU_ADDRESS 0x7F8A80 /end MEASUREMENT
/begin MEASUREMENT ASMod_tExhMnfPst_mp "Temperatur des Gasmassenstroms am Austritt des Abgaskrümmers" SWORD Temp_Cels 1 100 -50.140 899.860 FORMAT "%8.3" ECU_ADDRESS 0x8FE462 /end MEASUREMENT
/begin MEASUREMENT ASMod_tiDdTm_mp "Gaslaufzeit durch den Motor" SWORD TimeDeb 1 100 -327680.0 327670.0 FORMAT "%8.1" ECU_ADDRESS 0x8FE486 /end MEASUREMENT
/begin MEASUREMENT ASMod_tIndAir "Temperatur des Gasmassenstroms in den Motor" SWORD Temp_Cels 1 100 -50.140 899.860 FORMAT "%8.3" ECU_ADDRESS 0x7F8A82 /end MEASUREMENT
/begin MEASUREMENT ASMod_tIndAirRef "Referenz der Gastemperatur vor Einlass" SWORD Temp_Cels 1 100 -50.140 899.860 FORMAT "%8.3" ECU_ADDRESS 0x7F8A84 /end MEASUREMENT
/begin MEASUREMENT ASMod_tIntakeAir_mp "Ansauglufttemperatur" SWORD Temp_Cels 1 100 -50.140 899.860 FORMAT "%8.3" ECU_ADDRESS 0x8FE492 /end MEASUREMENT
/begin MEASUREMENT BattCD_u "Batteriespannung" SWORD Volt_Batt 1 100 -640625.6 640606.1 FORMAT "%8.1" ECU_ADDRESS 0x7F8AEE /end MEASUREMENT
/begin MEASUREMENT BattCD_uLin "Linearisierter Wert der Batteriespannung" SWORD Volt_Batt 1 100 -640625.6 640606.1 FORMAT "%8.1" ECU_ADDRESS 0x7F8AF0 /end MEASUREMENT
/begin MEASUREMENT BattCD_uRaw "Rohwert ADC-Signalspannung für Batteriespannung" SWORD Volt 1 100 -160156.4 160151.5 FORMAT "%8.1" ECU_ADDRESS 0x7F8AF2 /end MEASUREMENT
/begin MEASUREMENT Batt_facCor "Faktor für Batteriespannungskorrektur" SWORD Fact 1 100 -4.000000 3.999878 FORMAT "%8.6" ECU_ADDRESS 0x7F8AF4 /end MEASUREMENT
/begin MEASUREMENT BdInt_nMax "Schutzdrehzahl für Karosserie und Innenraum" SWORD EngN 1 100 -32768.00 32767.00 FORMAT "%8.2" ECU_ADDRESS 0x7F8AF6 /end MEASUREMENT
/begin MEASUREMENT BdInt_nMin "Anforderung Leerlaufdrehzahl durch Karosserie & Innenraum" SWORD EngN 1 100 -32768.00 32767.00 FORMAT "%8.2" ECU_ADDRESS 0x7F8AF8 /end MEASUREMENT
/begin MEASUREMENT BdInt_pwrDes "Leistungsanforderung Wunsch Karosserie & Innenraum" SWORD Pwr 1 100 -308831.1 308821.7 FORMAT "%8.1" ECU_ADDRESS 0x7F8AFA /end MEASUREMENT
/begin MEASUREMENT BdInt_pwrLead "Leistungsanforderung Vorhalt Karosserie & Innenraum" SWORD Pwr 1 100 -308831.1 308821.7 FORMAT "%8.1" ECU_ADDRESS 0x7F8AFC /end MEASUREMENT
/begin MEASUREMENT BGSTUTlokbits0 "keine Funktion" UWORD dez 1 100 0.00 65535.00 FORMAT "%8.2" ECU_ADDRESS 0x7F8AD4 /end MEASUREMENT
/begin MEASUREMENT BPACD_rCnv_mp "Tastverhältnis basierend auf dem Ausgang des Ladedrucksreglers" SWORD DtyCyc 1 100 -327.6800 327.6700 FORMAT "%8.4" ECU_ADDRESS 0x8FE498 /end MEASUREMENT
/begin MEASUREMENT BPACD_rOut "Tastverhältnis zür Endstufenansteuerung" SWORD DtyCyc 1 100 -327.6800 327.6700 FORMAT "%8.4" ECU_ADDRESS 0x7F8AD6 /end MEASUREMENT
/begin MEASUREMENT BPA_rBPAByp_mp "Bypass-Label, Kopie von BPA_rBPA" SWORD Prc 1 100 -400.0000 399.9878 FORMAT "%8.4" ECU_ADDRESS 0x8FE494 /end MEASUREMENT
/begin MEASUREMENT BPA_rBPACD "Stellgröße für Ladedrucksteller (Stellerkoordinatorausgang)" SWORD Prc 1 100 -400.0000 399.9878 FORMAT "%8.4" ECU_ADDRESS 0x7F8ADA /end MEASUREMENT
/begin MEASUREMENT BPA_rLPAByp_mp "LPACD TV rohwert vor ASCET bypass" SWORD Prc 1 100 -400.0000 399.9878 FORMAT "%8.4" ECU_ADDRESS 0x8FE496 /end MEASUREMENT
/begin MEASUREMENT BPA_rLPACD "Sollwert Ladedrucksteller Koordinator Niederdruckstufe" SWORD Prc 1 100 -400.0000 399.9878 FORMAT "%8.4" ECU_ADDRESS 0x7F8ADC /end MEASUREMENT
/begin MEASUREMENT BPSCD_dFltValDT1 "differentiated value of Filtered value of Boost pressure" SWORD dp_dZ10 1 100 -327680.0 327670.0 FORMAT "%8.1" ECU_ADDRESS 0x7F8ADE /end MEASUREMENT
/begin MEASUREMENT BPSCD_dpOutVal "Ladedruckgradient" SWORD dp_dZ10 1 100 -327680.0 327670.0 FORMAT "%8.1" ECU_ADDRESS 0x7F8AE0 /end MEASUREMENT
/begin MEASUREMENT BPSCD_pFltVal "gefilterter Wert des Ladedrucks" SWORD Pres_hPa 1 100 -32768.00 32767.00 FORMAT "%8.2" ECU_ADDRESS 0x7F8AE2 /end MEASUREMENT
/begin MEASUREMENT BPSCD_pIntVal "aktueller Ladedruck" SWORD Pres_hPa 1 100 -32768.00 32767.00 FORMAT "%8.2" ECU_ADDRESS 0x7F8AE4 /end MEASUREMENT
/begin MEASUREMENT BPSCD_pLin "Mittelere Ladedruck-Wert (liniarisiert)" SWORD Pres_hPa 1 100 -32768.00 32767.00 FORMAT "%8.2" ECU_ADDRESS 0x7F8AE6 /end MEASUREMENT
/begin MEASUREMENT BPSCD_pOutVal "Ladedruckwert" SWORD Pres_hPa 1 100 -32768.00 32767.00 FORMAT "%8.2" ECU_ADDRESS 0x7F8AE8 /end MEASUREMENT
/begin MEASUREMENT BPSCD_pPhyVal "Ladedruck in diesem Zyklus" SWORD Pres_hPa 1 100 -32768.00 32767.00 FORMAT "%8.2" ECU_ADDRESS 0x7F8AEA /end MEASUREMENT
/begin MEASUREMENT BPSCD_stErr "Fehlererkennung (falls einer auftritt) des Ladedrucksensors in einem Zyklus" UBYTE OneToOne 1 100 0.00 255.0 FORMAT "%5.1" ECU_ADDRESS 0x7F87D1 /end MEASUREMENT
/begin MEASUREMENT BPSCD_stPlausErr "Plausibilitaetsfehler Status ( zwischen BPSCD und APSCD )" UBYTE OneToOne 1 100 0.00 255.0 FORMAT "%5.1" ECU_ADDRESS 0x7F87D2 /end MEASUREMENT
/begin MEASUREMENT BPSCD_uRawVal "Spannungsrohwert des Ladedrucksensors" SWORD Volt 1 100 -160156.4 160151.5 FORMAT "%8.1" ECU_ADDRESS 0x7F8AEC /end MEASUREMENT
/begin MEASUREMENT BrkCD_ctUnPlaus_mp "Unplausibilitätszähler" UWORD OneToOne 1 100 0.00 65535.00 FORMAT "%8.2" ECU_ADDRESS 0x6F800C /end MEASUREMENT
/begin MEASUREMENT BrkCD_stDeb_mp "Bremskontaktschalter - Status Fehlerentprellung Plausibilitaetspruefung" UBYTE OneToOne 1 100 0.00 255.0 FORMAT "%5.1" ECU_ADDRESS 0x8FE49A /end MEASUREMENT
/begin MEASUREMENT BrkCD_stMnSwtDebVal "Digitalsignal Bremskontakt entprellt" UBYTE OneToOne 1 100 0.00 255.0 FORMAT "%5.1" ECU_ADDRESS 0x7F87F2 /end MEASUREMENT
/begin MEASUREMENT BrkCD_stMnSwtLastDebVal "Letzter logischer Entprellwert vom Bremspedal" UBYTE OneToOne 1 100 0.00 255.0 FORMAT "%5.1" ECU_ADDRESS 0x7F87F3 /end MEASUREMENT
/begin MEASUREMENT BrkCD_stMnSwtLogVal_mp "Digitalsignal redundanter Bremskontakt nicht entprellt" UBYTE OneToOne 1 100 0.00 255.0 FORMAT "%5.1" ECU_ADDRESS 0x8FE49B /end MEASUREMENT
/begin MEASUREMENT BrkCD_stMnSwtRawVal "Rohwert Bremskontakt nicht entprellt" UBYTE OneToOne 1 100 0.00 255.0 FORMAT "%5.1" ECU_ADDRESS 0x7F87F4 /end MEASUREMENT
/begin MEASUREMENT BrkCD_stPressed "Meldung Bremse betätigt" UBYTE OneToOne 1 100 0.00 255.0 FORMAT "%5.1" ECU_ADDRESS 0x7F87F5 /end MEASUREMENT
/begin MEASUREMENT BrkCD_stRedSwtDebVal "Digitalsignal redundanter Bremskontakt entprellt" UBYTE OneToOne 1 100 0.00 255.0 FORMAT "%5.1" ECU_ADDRESS 0x7F87F6 /end MEASUREMENT
/begin MEASUREMENT BrkCD_stRedSwtLastDebVal "Letzter logischer Entprellwert vom redundanten Bremspedal" UBYTE OneToOne 1 100 0.00 255.0 FORMAT "%5.1" ECU_ADDRESS 0x7F87F7 /end MEASUREMENT
/begin MEASUREMENT BrkCD_stRedSwtLogVal_mp "Digitalsignal redundanter Bremskontakt nicht entprellt" UBYTE OneToOne 1 100 0.00 255.0 FORMAT "%5.1" ECU_ADDRESS 0x8FE49C /end MEASUREMENT
/begin MEASUREMENT BrkCD_stRedSwtPresent "Redundanter Bremskontakt Aktivinformation" UBYTE OneToOne 1 100 0.00 255.0 FORMAT "%5.1" ECU_ADDRESS 0x7F87F8 /end MEASUREMENT
/begin MEASUREMENT BrkCD_stRedSwtRawVal "Rohwert redundanter Bremskontakt nicht entprellt" UBYTE OneToOne 1 100 0.00 255.0 FORMAT "%5.1" ECU_ADDRESS 0x7F87F9 /end MEASUREMENT
/begin MEASUREMENT BrkCD_stResUnPlaus_mp "Zustandsbits zum Rücksetzen der Unplausibilität" UBYTE OneToOne 1 100 0.00 255.0 FORMAT "%5.1" ECU_ADDRESS 0x8FE49D /end MEASUREMENT
/begin MEASUREMENT BrkCD_stRun_mp "Laufzeitmesspunkt" UWORD OneToOne 1 100 0.00 65535.00 FORMAT "%8.2" ECU_ADDRESS 0x8FE49E /end MEASUREMENT
/begin MEASUREMENT BrkCD_swtSig "Signalquelle Schalter - DIO/CAN" UBYTE OneToOne 1 100 0.00 255.0 FORMAT "%5.1" ECU_ADDRESS 0x7F87FA /end MEASUREMENT
/begin MEASUREMENT BypEtk_ctStepDelayNsync_u8 "ETK Bypass Schritt drehzahlsynchron" UBYTE OneToOne 1 100 0.00 255.0 FORMAT "%5.1" ECU_ADDRESS 0x802126 /end MEASUREMENT
/begin MEASUREMENT BypEtk_ctStepDelayTsync_u8 "ETK Bypass Schritt zeitsynchron" UBYTE OneToOne 1 100 0.00 255.0 FORMAT "%5.1" ECU_ADDRESS 0x802127 /end MEASUREMENT
/begin MEASUREMENT BypEtk_stEcu_u8 "Status ETK-Bypass in SG (0: inaktiv im SG; 1: aktiv im SG; 2: wartet auf Kommunikation)" UBYTE OneToOne 1 100 0.00 255.0 FORMAT "%5.1" ECU_ADDRESS 0x802125 /end MEASUREMENT
/begin MEASUREMENT BypInt_stEcu_u8 "Status interner Bypass in SG (0: inaktiv im SG; 1: aktiv im SG; 2: wartet auf Kommunikation)" UBYTE OneToOne 1 100 0.00 255.0 FORMAT "%5.1" ECU_ADDRESS 0x802131 /end MEASUREMENT
/begin MEASUREMENT B_acc "Bedingung ACC-Steuergerät vorhanden" UBYTE B_TRUE 1 100 0.00 1.00000000000 BIT_MASK 0x1 FORMAT "%13.11" ECU_ADDRESS 0x7F87D3 /end MEASUREMENT
/begin MEASUREMENT B_acmsggts "Bed. Min. Zeit in der keine Bit gesendet wurde ist verstrichen + Ereignis aufgetreten" UBYTE B_TRUE 1 100 0.00 1.00000000000 BIT_MASK 0x1 FORMAT "%13.11" ECU_ADDRESS 0x7F87D4 /end MEASUREMENT
/begin MEASUREMENT B_besch "Bedingung FGR im Zustand Beschleunigen" UBYTE B_TRUE 1 100 0.00 1.00000000000 BIT_MASK 0x1 FORMAT "%13.11" ECU_ADDRESS 0x7F87D5 /end MEASUREMENT
/begin MEASUREMENT B_beveh "Bedingung Halten der Beschleunigen- oder Verzögerungs-Taste" UBYTE B_TRUE 1 100 0.00 1.00000000000 FORMAT "%13.11" ECU_ADDRESS 0x7F87D6 /end MEASUREMENT
/begin MEASUREMENT B_bv1 "Bedingung Bediensignal Stufentempomat Beschleunigen oder Verzögern 1. Stufe" UBYTE B_TRUE 1 100 0.00 1.00000000000 FORMAT "%13.11" ECU_ADDRESS 0x7F87D7 /end MEASUREMENT
/begin MEASUREMENT B_bv2 "Bedingung Bediensignal Stufentempomat Beschleunigen oder Verzögern 2. Stufe" UBYTE B_TRUE 1 100 0.00 1.00000000000 FORMAT "%13.11" ECU_ADDRESS 0x7F87D8 /end MEASUREMENT
/begin MEASUREMENT B_cmsggts "Trigger Bit zum Senden der Botschaft" UBYTE B_TRUE 1 100 0.00 1.00000000000 BIT_MASK 0x1 FORMAT "%13.11" ECU_ADDRESS 0x7F87D9 /end MEASUREMENT
/begin MEASUREMENT B_envtwa "Bedingung FGR aktiv vor Betätigung der Wiederaufnahme-Taste" UBYTE B_TRUE 1 100 0.00 1.00000000000 FORMAT "%13.11" ECU_ADDRESS 0x7F87DA /end MEASUREMENT
/begin MEASUREMENT B_ergacgt "Bedingung Ereignis (Änderung) bei Stufentempomat aufgetreten" UBYTE B_TRUE 1 100 0.00 1.00000000000 BIT_MASK 0x1 FORMAT "%13.11" ECU_ADDRESS 0x7F87DB /end MEASUREMENT
/begin MEASUREMENT B_fgrat "Bedingung: Tip-Schalter Aus am FGR-Bedienteil betätigt" UBYTE B_TRUE 1 100 0.00 1.00000000000 BIT_MASK 0x1 FORMAT "%13.11" ECU_ADDRESS 0x7F87DC /end MEASUREMENT
/begin MEASUREMENT B_fgren "Bedingung Fahrgeschwindigkeitsregelung aktiv (Enable)" UBYTE B_TRUE 1 100 0.00 1.00000000000 BIT_MASK 0x1 FORMAT "%13.11" ECU_ADDRESS 0x7F87DD /end MEASUREMENT
/begin MEASUREMENT B_fgrepa "Status in Cruise control" UBYTE B_TRUE 1 100 0.00 1.00000000000 FORMAT "%13.11" ECU_ADDRESS 0x7F87DE /end MEASUREMENT
/begin MEASUREMENT B_fgresv "" UBYTE B_TRUE 1 100 0.00 1.00000000000 BIT_MASK 0x1 FORMAT "%13.11" ECU_ADDRESS 0x7F87DF /end MEASUREMENT
/begin MEASUREMENT B_fgrtb2 "Bedingung FGR-Taste Auswahl der nächsthöheren Zielgeschwindigkeit" UBYTE B_TRUE 1 100 0.00 1.00000000000 BIT_MASK 0x1 FORMAT "%13.11" ECU_ADDRESS 0x7F87E0 /end MEASUREMENT
/begin MEASUREMENT B_fgrtbe "Bedingung FGR-Taste Beschleunigen" UBYTE B_TRUE 1 100 0.00 1.00000000000 BIT_MASK 0x1 FORMAT "%13.11" ECU_ADDRESS 0x7F87E1 /end MEASUREMENT
/begin MEASUREMENT B_fgrtv2 "Bedingung FGR-Taste Auswahl der nächstniederen Zielgeschwindigkeit" UBYTE B_TRUE 1 100 0.00 1.00000000000 BIT_MASK 0x1 FORMAT "%13.11" ECU_ADDRESS 0x7F87E2 /end MEASUREMENT
/begin MEASUREMENT B_fgrtve "Bedingung FGR-Taste Verzöägern" UBYTE B_TRUE 1 100 0.00 1.00000000000 BIT_MASK 0x1 FORMAT "%13.11" ECU_ADDRESS 0x7F87E3 /end MEASUREMENT
/begin MEASUREMENT B_fgrtwa "Bedingung FGR-Taste Wiederaufnahme" UBYTE B_TRUE 1 100 0.00 1.00000000000 BIT_MASK 0x1 FORMAT "%13.11" ECU_ADDRESS 0x7F87E4 /end MEASUREMENT
/begin MEASUREMENT B_fgrvem "Bedingung: FGR im Zustand Verzögern (aus ME)" UBYTE B_TRUE 1 100 0.00 1.00000000000 BIT_MASK 0x1 FORMAT "%13.11" ECU_ADDRESS 0x7F87E5 /end MEASUREMENT
/begin MEASUREMENT B_insfgre "Bedingung Fehler im INST-Kombi, FGR muss abgeschaltet werden" UBYTE B_TRUE 1 100 0.00 1.00000000000 BIT_MASK 0x1 FORMAT "%13.11" ECU_ADDRESS 0x7F87E6 /end MEASUREMENT
/begin MEASUREMENT B_kl15 "Bedingung Klemme 15" UBYTE B_TRUE 1 100 0.00 1.00000000000 BIT_MASK 0x1 FORMAT "%13.11" ECU_ADDRESS 0x7F87E7 /end MEASUREMENT
/begin MEASUREMENT B_km "Bedingung CAN-Kombi-Kodierung in km/h" UBYTE B_TRUE 1 100 0.00 1.00000000000 BIT_MASK 0x1 FORMAT "%13.11" ECU_ADDRESS 0x7F87E8 /end MEASUREMENT
/begin MEASUREMENT B_mmiena "Status bit" UBYTE B_TRUE 1 100 0.00 1.00000000000 BIT_MASK 0x1 FORMAT "%13.11" ECU_ADDRESS 0x7F87E9 /end MEASUREMENT
/begin MEASUREMENT B_mrkbli "Bedingung Blinken der Markenanzeige" UBYTE B_TRUE 1 100 0.00 1.00000000000 FORMAT "%13.11" ECU_ADDRESS 0x7F87EA /end MEASUREMENT
/begin MEASUREMENT B_mrkein "Bedingung Anzeige Geschwindigkeits-Marken im Kombi ein" UBYTE B_TRUE 1 100 0.00 1.00000000000 BIT_MASK 0x1 FORMAT "%13.11" ECU_ADDRESS 0x7F87EB /end MEASUREMENT
/begin MEASUREMENT B_mrkv "Bedingung Veränderung der Geschwindigkeits-Marken Stufentempomat" UBYTE B_TRUE 1 100 0.00 1.00000000000 BIT_MASK 0x1 FORMAT "%13.11" ECU_ADDRESS 0x7F87EC /end MEASUREMENT
/begin MEASUREMENT B_mrkvff "Bedingung Merker das B:_mrkv (Marker Veränderung) gesetzt war" UBYTE B_TRUE 1 100 0.00 1.00000000000 BIT_MASK 0x1 FORMAT "%13.11" ECU_ADDRESS 0x7F87ED /end MEASUREMENT
/begin MEASUREMENT B_prgmod "Bedingung Programmiermodus Stufentempomat" UBYTE B_TRUE 1 100 0.00 1.00000000000 FORMAT "%13.11" ECU_ADDRESS 0x7F87EE /end MEASUREMENT
/begin MEASUREMENT B_tmark "Bedingung Taste Aus für die Zeit TMARK betätigt" UBYTE B_TRUE 1 100 0.00 1.00000000000 FORMAT "%13.11" ECU_ADDRESS 0x7F87EF /end MEASUREMENT
/begin MEASUREMENT B_tmrkbli "Bedingung"" Blinken der Markenanzeige""" UBYTE B_TRUE 1 100 0.00 1.00000000000 FORMAT "%13.11" ECU_ADDRESS 0x7F87F0 /end MEASUREMENT
/begin MEASUREMENT B_vziels "Bedingung Übernahme berechnete Zielgeschwindigkeit" UBYTE B_TRUE 1 100 0.00 1.00000000000 BIT_MASK 0x1 FORMAT "%13.11" ECU_ADDRESS 0x7F87F1 /end MEASUREMENT
/begin MEASUREMENT canzbl "Zähler für Aus-/Ein-Schaltungen beim Blinken der Markenanzeige" UBYTE dez 1 100 0.00 255.0 FORMAT "%5.1" ECU_ADDRESS 0x7F89E4 /end MEASUREMENT
/begin MEASUREMENT CaSCD_ctEdgCaSRev_mp "Anzahl sämtlicher Phasensignale während einer Nockenwellenumdrehung" UBYTE OneToOne 1 100 0.00 255.0 FORMAT "%5.1" ECU_ADDRESS 0x8FE4A0 /end MEASUREMENT
/begin MEASUREMENT CaSCD_ctEdgOfs_mp "Zähler erkannter Nockenwellenflanken mit Verdrehung" UBYTE OneToOne 1 100 0.00 255.0 FORMAT "%5.1" ECU_ADDRESS 0x8FE4A1 /end MEASUREMENT
/begin MEASUREMENT CaSCD_ctEdgOrd_mp "Zähler erkannter Nockenwellenflanken in korrekter Reihenfolge" UBYTE OneToOne 1 100 0.00 255.0 FORMAT "%5.1" ECU_ADDRESS 0x8FE4A2 /end MEASUREMENT
/begin MEASUREMENT CaSCD_ctErrEdg_mp "Anzahl erkannter Störungen auf einer Nockenwellenumdrehung" UBYTE OneToOne 1 100 0.00 255.0 FORMAT "%5.1" ECU_ADDRESS 0x8FE4A3 /end MEASUREMENT
/begin MEASUREMENT CaSCD_ctPhRevEdges_mp "Zähler der Phasengeberflanken über einer Phasengeberradumdrehung" UBYTE OneToOne 1 100 0.00 255.0 FORMAT "%5.1" ECU_ADDRESS 0x8FE4A4 /end MEASUREMENT
/begin MEASUREMENT CaSCD_ctPhRev_mp "Umdrehungszähler des Phasengeberrades" UBYTE OneToOne 1 100 0.00 255.0 FORMAT "%5.1" ECU_ADDRESS 0x8FE4A5 /end MEASUREMENT
/begin MEASUREMENT CaSCD_ctSegEdg_mp "Anzahl erkannter SEG Flanken" UBYTE OneToOne 1 100 0.00 255.0 FORMAT "%5.1" ECU_ADDRESS 0x8FE4A6 /end MEASUREMENT
/begin MEASUREMENT CaSCD_ctShftPos_mp "Zähler verschobene Nockenwellenflanken" UBYTE OneToOne 1 100 0.00 255.0 FORMAT "%5.1" ECU_ADDRESS 0x8FE4A7 /end MEASUREMENT
/begin MEASUREMENT CaSCD_ctSyncEdg_mp "Anzahl erkannter SYNC Flanken" UBYTE OneToOne 1 100 0.00 255.0 FORMAT "%5.1" ECU_ADDRESS 0x8FE4A8 /end MEASUREMENT
/begin MEASUREMENT CaSCD_nPeriod "Phasengeberraddrehzahl basierent auf einer konstanten Phasengebersegmentlänge" SWORD EngN 1 100 -32768.00 32767.00 FORMAT "%8.2" ECU_ADDRESS 0x7F8B08 /end MEASUREMENT
/begin MEASUREMENT CaSCD_nSeg "Die aktuelle Nockenwellensegmentdrehzahl im BackUp-Modus" SWORD EngN 1 100 -32768.00 32767.00 FORMAT "%8.2" ECU_ADDRESS 0x7F8B0A /end MEASUREMENT
/begin MEASUREMENT CaSCD_numFrstInt_mp "Interruptart bei Start der Verifikation CaS/CrS" UBYTE OneToOne 1 100 0.00 255.0 FORMAT "%5.1" ECU_ADDRESS 0x8FE4A9 /end MEASUREMENT
/begin MEASUREMENT CaSCD_numFrstTDC_mp "Zylinderzählerstand bei Start der Verifikation CaS/CrS" UBYTE OneToOne 1 100 0.00 255.0 FORMAT "%5.1" ECU_ADDRESS 0x8FE4AA /end MEASUREMENT
/begin MEASUREMENT CaSCD_phiCurr_mp "Aktuelle Winkelposition des Phasengebers" SWORD AngleCrS 1 100 -768.0000 767.9766 FORMAT "%8.4" ECU_ADDRESS 0x8FE4AC /end MEASUREMENT
/begin MEASUREMENT CaSCD_phiLstEdge_mp "Position der letzten Phasengeberflanke" SWORD AngleCrS 1 100 -768.0000 767.9766 FORMAT "%8.4" ECU_ADDRESS 0x8FE4AE /end MEASUREMENT
/begin MEASUREMENT CaSCD_stPhaseErr_mp "Fehlerstatus des Phasensystems" UWORD OneToOne 1 100 0.00 65535.00 FORMAT "%8.2" ECU_ADDRESS 0x8FE4B0 /end MEASUREMENT
/begin MEASUREMENT CaSCD_stPhaseSig_mp "Status des Phasengebersignals (Signalgüte)" UWORD OneToOne 1 100 0.00 65535.00 FORMAT "%8.2" ECU_ADDRESS 0x8FE4B2 /end MEASUREMENT
/begin MEASUREMENT CaSCD_stPhaseSync_mp "Status der Phasengebersynchronisation (Signalformerkennung)" UWORD OneToOne 1 100 0.00 65535.00 FORMAT "%8.2" ECU_ADDRESS 0x8FE4B4 /end MEASUREMENT
/begin MEASUREMENT CaSCD_stSegCylEdg_mp "Status erkannter SEG Flanken" UWORD OneToOne 1 100 0.00 65535.00 FORMAT "%8.2" ECU_ADDRESS 0x8FE4B6 /end MEASUREMENT
/begin MEASUREMENT CaSCD_stSyncCylEdg_mp "Status erkannter SYNC Flanken" UWORD OneToOne 1 100 0.00 65535.00 FORMAT "%8.2" ECU_ADDRESS 0x8FE4B8 /end MEASUREMENT
/begin MEASUREMENT CaSCD_tiPeriodRev "Periodendauer einer Umdrehung des Phasengeberrades" SWORD Period_ms 1 100 -3276.800 3276.700 FORMAT "%8.3" ECU_ADDRESS 0x7F8B0C /end MEASUREMENT
/begin MEASUREMENT CaSCD_tiPeriodRevHold "Vorletzte Periodendauer einer Umdrehung des Phasengeberrades" SWORD Period_ms 1 100 -3276.800 3276.700 FORMAT "%8.3" ECU_ADDRESS 0x7F8B0E /end MEASUREMENT
/begin MEASUREMENT CaSCD_tiSeg "aktuelle Segmentzeit der Nockenwelle im Backup Mode" ULONG Per_Dur 1 100 0.00 4294967295.00 FORMAT "%13.2" ECU_ADDRESS 0x7F9164 /end MEASUREMENT
/begin MEASUREMENT CaSCD_tiSigTimOut_mp "Timeoutwert des Phasengebersignals" SWORD Period_ms 1 100 -3276.800 3276.700 FORMAT "%8.3" ECU_ADDRESS 0x8FE4BA /end MEASUREMENT
/begin MEASUREMENT CBACD_stLogicOut_mp "duty-cycle given to the actuator" UBYTE OneToOne 1 100 0.00 255.0 FORMAT "%5.1" ECU_ADDRESS 0x6F800E /end MEASUREMENT
/begin MEASUREMENT Clg_dtDynTst "Ansteig der Wassertemperatur seit start" SWORD TempDiff_Cels 1 100 -3276.800 3276.700 FORMAT "%8.3" ECU_ADDRESS 0x7F8B10 /end MEASUREMENT
/begin MEASUREMENT Clg_dtMinDynTst "Kopie von Clg_dtMinDynTst_C fuer Tester" SWORD TempDiff_Cels 1 100 -3276.800 3276.700 FORMAT "%8.3" ECU_ADDRESS 0x7F8B12 /end MEASUREMENT
/begin MEASUREMENT Clg_tClntStrtVal_mp "Wassertemperatur zu Beginn des dynamischen Plausibilitätstests" SWORD Temp_Cels 1 100 -50.140 899.860 FORMAT "%8.3" ECU_ADDRESS 0x8FE4BC /end MEASUREMENT
/begin MEASUREMENT Clg_tEndDynTst "CTSCD_tClnt am Ende des Tests" SWORD Temp_Cels 1 100 -50.140 899.860 FORMAT "%8.3" ECU_ADDRESS 0x7F8B14 /end MEASUREMENT
/begin MEASUREMENT Clg_tiDynTst "Abgelaufene Zeit, seit der der dynamische plausibilitätstest aktiv ist" ULONG Time_s 1 100 0.00 42949672.9500 FORMAT "%13.4" ECU_ADDRESS 0x7F9168 /end MEASUREMENT
/begin MEASUREMENT Clg_tiMaxDynTst "Maximal zulässige Testzeit des dynamischen Plausibilitätstest" ULONG Time_s 1 100 0.00 42949672.9500 FORMAT "%13.4" ECU_ADDRESS 0x7F916C /end MEASUREMENT
/begin MEASUREMENT Clg_tMinClntDynTst "Kopie von Clg_tMinClntDynTst_C fuer Tester" SWORD Temp_Cels 1 100 -50.140 899.860 FORMAT "%8.3" ECU_ADDRESS 0x7F8B16 /end MEASUREMENT
/begin MEASUREMENT CmbChb_ctEngRevLogBuf1_mp "Meßpunkt für die Anzahl bewerteten Motorumdrehungen der Kurbelwelle des Puffer1" UWORD OneToOne 1 100 0.00 65535.00 FORMAT "%8.2" ECU_ADDRESS 0x8FE4E8 /end MEASUREMENT
/begin MEASUREMENT CmbChb_ctEngRevLogBuf2_mp "Meßpunkt für die Anzahl bewerteten Motorumdrehungen der Kurbelwelle des Puffer2" UWORD OneToOne 1 100 0.00 65535.00 FORMAT "%8.2" ECU_ADDRESS 0x8FE4EA /end MEASUREMENT
/begin MEASUREMENT CmbChb_ctEngRevLogMem_mp "Kurbelwellen-Umdrehungszähler" UWORD OneToOne 1 100 0.00 65535.00 FORMAT "%8.2" ECU_ADDRESS 0x8FE4EC /end MEASUREMENT
/begin MEASUREMENT CmbChb_ctEngRevPerBlk_mp "Meßpunkt für die Anzahl der Blockgroesse für die bewerteten Motorumdrehungen der Kurbelwelle" UWORD OneToOne 1 100 0.00 65535.00 FORMAT "%8.2" ECU_ADDRESS 0x8FE4EE /end MEASUREMENT
/begin MEASUREMENT CmbChb_ctMifBuf1_mp "Meßpunkt für die Erkennung der Fehlzündungen der einzelnen Zylinder, Puffer1" UWORD OneToOne 1 100 0.00 65535.00 FORMAT "%8.2" ARRAY_SIZE 7 ECU_ADDRESS 0x8FE4BE /end MEASUREMENT
/begin MEASUREMENT CmbChb_ctMifBuf2_mp "Meßpunkt für die Erkennung der Fehlzündungen der einzelnen Zylinder, Puffer2" UWORD OneToOne 1 100 0.00 65535.00 FORMAT "%8.2" ARRAY_SIZE 7 ECU_ADDRESS 0x8FE4CC /end MEASUREMENT
/begin MEASUREMENT CmbChb_ctMifMem_mp "Meßpunkt für die Erkennung der Fehlzündungen der einzelnen Zylinder, Logging Speicher" UWORD OneToOne 1 100 0.00 65535.00 FORMAT "%8.2" ARRAY_SIZE 7 ECU_ADDRESS 0x8FE4DA /end MEASUREMENT
/begin MEASUREMENT CmbChb_dnSegMinPerCyl_mp "minimaler Drehzahlanstiege pro Zylinder" SWORD EngN 1 100 -32768.00 32767.00 FORMAT "%8.2" ECU_ADDRESS 0x8FE4F0 /end MEASUREMENT
/begin MEASUREMENT CmbChb_nSegEven_mp "Summe der Drehzahl fuer jede gerade Segmentnummer (von zwei Umdrehungen)" SWORD EngN 1 100 -32768.00 32767.00 FORMAT "%8.2" ECU_ADDRESS 0x8FE4F2 /end MEASUREMENT
/begin MEASUREMENT CmbChb_nSegOdd_mp "Summe der Drehzahl fuer jede ungerade Segmentnummer (von zwei Umdrehungen)" SWORD EngN 1 100 -32768.00 32767.00 FORMAT "%8.2" ECU_ADDRESS 0x8FE4F4 /end MEASUREMENT
/begin MEASUREMENT CmbChb_st "Status der Fehlzündungserkennung" UBYTE OneToOne 1 100 0.00 255.0 FORMAT "%5.1" ECU_ADDRESS 0x7F87FE /end MEASUREMENT
/begin MEASUREMENT CmbChb_swtMonClutch "SW-Schalter Aktivierung/Deaktivierung Überwachung Zündaussetzererkennung" UBYTE OneToOne 1 100 0.00 3.000 FORMAT "%5.3" ECU_ADDRESS 0x7F87FF /end MEASUREMENT
/begin MEASUREMENT CoDT_dnAbsEng_mp "Absolute value of DT1 filtered engine speed" SWORD dn_dZfine 1 100 -32768.00 32767.00 FORMAT "%8.2" ECU_ADDRESS 0x8FE4FC /end MEASUREMENT
/begin MEASUREMENT CoDT_dnEng_mp "DT1 filtered Engine speed" SWORD dn_dZfine 1 100 -32768.00 32767.00 FORMAT "%8.2" ECU_ADDRESS 0x8FE4FE /end MEASUREMENT
/begin MEASUREMENT CoDT_dnGrip_mp "Expected change in torque" SWORD dn_dZfine 1 100 -32768.00 32767.00 FORMAT "%8.2" ECU_ADDRESS 0x8FE500 /end MEASUREMENT
/begin MEASUREMENT CoDT_dnNoGrip_mp "Expected change in engine speed" SWORD dn_dZfine 1 100 -32768.00 32767.00 FORMAT "%8.2" ECU_ADDRESS 0x8FE502 /end MEASUREMENT
/begin MEASUREMENT CoDT_Grip "Kraftschluß innerhalb Antrieb" UBYTE OneToOne 1 100 0.00 255.0 FORMAT "%5.1" ECU_ADDRESS 0x7F8800 /end MEASUREMENT
/begin MEASUREMENT CoDT_nMax "Drehzahlforderung Maximalwert Triebstrangkoordinator" SWORD EngN 1 100 -32768.00 32767.00 FORMAT "%8.2" ECU_ADDRESS 0x7F8B1A /end MEASUREMENT
/begin MEASUREMENT CoDT_nMin "Drehzahlforderung Minimalwert Triebstrangkoordinator" SWORD EngN 1 100 -32768.00 32767.00 FORMAT "%8.2" ECU_ADDRESS 0x7F8B1C /end MEASUREMENT
/begin MEASUREMENT CoDT_stGripDeb "Zustand der Kraftschlußentprellung" UBYTE OneToOne 1 100 0.00 255.0 FORMAT "%5.1" ECU_ADDRESS 0x7F8801 /end MEASUREMENT
/begin MEASUREMENT CoDT_stNoGripDet_mp "Bit coded status message" UBYTE OneToOne 1 100 0.00 255.0 FORMAT "%5.1" ECU_ADDRESS 0x8FE504 /end MEASUREMENT
/begin MEASUREMENT CoDT_stOrd "Randbedingungen für physikalischen Auftrag" UBYTE OneToOne 1 100 0.00 255.0 FORMAT "%5.1" ECU_ADDRESS 0x7F8802 /end MEASUREMENT
/begin MEASUREMENT CoDT_swtCoType "0: conventional; 1: mastershift" UBYTE OneToOne 1 100 0.00 255.0 FORMAT "%5.1" ECU_ADDRESS 0x7F8803 /end MEASUREMENT
/begin MEASUREMENT CoDT_trq "aktuelles Getriebeausgangsmoment" SWORD TrqPrp 1 100 -6553.600 6553.400 FORMAT "%8.3" ECU_ADDRESS 0x7F8B1E /end MEASUREMENT
/begin MEASUREMENT CoDT_trqAbsGbxPT1_mp "Absolute value of delayed gearbox torque input" SWORD Trq 1 100 -3276.800 3276.700 FORMAT "%8.3" ECU_ADDRESS 0x8FE506 /end MEASUREMENT
/begin MEASUREMENT CoDT_trqAcsDes "torque electrical components" SWORD Trq 1 100 -3276.800 3276.700 FORMAT "%8.3" ECU_ADDRESS 0x7F8B20 /end MEASUREMENT
/begin MEASUREMENT CoDT_trqAcsMax_mp "maximales Nebenaggregatmoment" SWORD Trq 1 100 -3276.800 3276.700 FORMAT "%8.3" ECU_ADDRESS 0x8FE50C /end MEASUREMENT
/begin MEASUREMENT CoDT_trqAcsMin "minimaler Momentenbedarf der Nebenaggregate" SWORD Trq 1 100 -3276.800 3276.700 FORMAT "%8.3" ECU_ADDRESS 0x7F8B22 /end MEASUREMENT
/begin MEASUREMENT CoDT_trqAcs_mp "ungefilterter Momentenbedarf der Nebenaggregate" SWORD Trq 1 100 -3276.800 3276.700 FORMAT "%8.3" ECU_ADDRESS 0x8FE50E /end MEASUREMENT
/begin MEASUREMENT CoDT_trqActAcs_mp "aktuelle Momentenanforderung der Nebenaggregate" SWORD Trq 1 100 -3276.800 3276.700 FORMAT "%8.3" ECU_ADDRESS 0x8FE50A /end MEASUREMENT
/begin MEASUREMENT CoDT_trqCurr "Momentenanforderung Triebstrang Vorhaltewert" SWORD Trq 1 100 -3276.800 3276.700 FORMAT "%8.3" ECU_ADDRESS 0x7F8B24 /end MEASUREMENT
/begin MEASUREMENT CoDT_trqCurrLim "Minimum aller Begrenzungen im Getriebeausgangsmoment" SWORD TrqPrp 1 100 -6553.600 6553.400 FORMAT "%8.3" ECU_ADDRESS 0x7F8B26 /end MEASUREMENT
/begin MEASUREMENT CoDT_trqDes "Momentenanforderung Triebstrangkoordinator Wunschwert" SWORD Trq 1 100 -3276.800 3276.700 FORMAT "%8.3" ECU_ADDRESS 0x7F8B2E /end MEASUREMENT
/begin MEASUREMENT CoDT_trqDTInCurr "Momentenanforderung Vorhalt Triebstrangkoordinator (Kupplungseingang) (curr-Pfad)" SWORD Trq 1 100 -3276.800 3276.700 FORMAT "%8.3" ECU_ADDRESS 0x7F8B28 /end MEASUREMENT
/begin MEASUREMENT CoDT_trqDTInDecLead_mp "Momentenanforderung Triebstrang nach reduzierenden Getriebeeingriffen" SWORD Trq 1 100 -3276.800 3276.700 FORMAT "%8.3" ECU_ADDRESS 0x8FE4F6 /end MEASUREMENT
/begin MEASUREMENT CoDT_trqDTInDes "Momentenanforderung Triebstrang (Kupplungseingang) Wunschwert" SWORD Trq 1 100 -3276.800 3276.700 FORMAT "%8.3" ECU_ADDRESS 0x7F8B2A /end MEASUREMENT
/begin MEASUREMENT CoDT_trqDTInIncLead_mp "Momentenanforderung Triebstrang nach erhöhenden Getriebeeingriffen" SWORD Trq 1 100 -3276.800 3276.700 FORMAT "%8.3" ECU_ADDRESS 0x8FE4F8 /end MEASUREMENT
/begin MEASUREMENT CoDT_trqDTInLead "Momentenanforderung Triebstrang (Kupplungseingang) Vorhaltewert" SWORD Trq 1 100 -3276.800 3276.700 FORMAT "%8.3" ECU_ADDRESS 0x7F8B2C /end MEASUREMENT
/begin MEASUREMENT CoDT_trqGbx "aktuelles Eingangsmoment Getriebe" SWORD Trq 1 100 -3276.800 3276.700 FORMAT "%8.3" ECU_ADDRESS 0x7F8B30 /end MEASUREMENT
/begin MEASUREMENT CoDT_trqGbxMax "maximales Getriebeeingangsmoment" SWORD Trq 1 100 -3276.800 3276.700 FORMAT "%8.3" ECU_ADDRESS 0x7F8B32 /end MEASUREMENT
/begin MEASUREMENT CoDT_trqGbxMin "minimales Getriebeeingangsmoment" SWORD Trq 1 100 -3276.800 3276.700 FORMAT "%8.3" ECU_ADDRESS 0x7F8B34 /end MEASUREMENT
/begin MEASUREMENT CoDT_trqGbxPT1_mp "Delayed gearbox torque input" SWORD Trq 1 100 -3276.800 3276.700 FORMAT "%8.3" ECU_ADDRESS 0x8FE508 /end MEASUREMENT
/begin MEASUREMENT CoDT_trqGearbxDes "Getriebeeingangsmoment Fahrerwunsch" SWORD Trq 1 100 -3276.800 3276.700 FORMAT "%8.3" ECU_ADDRESS 0x7F8B36 /end MEASUREMENT
/begin MEASUREMENT CoDT_trqGearbxLead_mp "Getriebeeingangsmoment Vorhaltewert" SWORD Trq 1 100 -3276.800 3276.700 FORMAT "%8.3" ECU_ADDRESS 0x8FE4FA /end MEASUREMENT
/begin MEASUREMENT CoDT_trqLead "Momentenanforderung Vorhaltewert" SWORD Trq 1 100 -3276.800 3276.700 FORMAT "%8.3" ECU_ADDRESS 0x7F8B38 /end MEASUREMENT
/begin MEASUREMENT CoDT_trqMax "maximal mögliches Antriebsmoment (Getriebeausgang)" SWORD TrqPrp 1 100 -6553.600 6553.400 FORMAT "%8.3" ECU_ADDRESS 0x7F8B3A /end MEASUREMENT
/begin MEASUREMENT CoDT_trqMin "minimal mögliches Antriebsmoment (Getriebeausgang)" SWORD TrqPrp 1 100 -6553.600 6553.400 FORMAT "%8.3" ECU_ADDRESS 0x7F8B3C /end MEASUREMENT
/begin MEASUREMENT CoEng_CoordPrioFld_mp "Messpunktarray zur Darstellung der dynamische Priorität" UWORD OneToOne 1 100 0.00 65535.00 FORMAT "%8.2" ARRAY_SIZE 3 ECU_ADDRESS 0x8FE520 /end MEASUREMENT
/begin MEASUREMENT CoEng_dnEngnAvrg_mp "Meßpunkt für Overfueling Drehzahlgradienten" SWORD dn_dZ20 1 100 -327680.0 327670.0 FORMAT "%8.1" ECU_ADDRESS 0x8FE554 /end MEASUREMENT
/begin MEASUREMENT CoEng_dvolFlConsum "Kraftstoffverbrauch" SWORD FlConsum_l_h 1 100 -327.6800 327.6700 FORMAT "%8.4" ECU_ADDRESS 0x7F8B3E /end MEASUREMENT
/begin MEASUREMENT CoEng_dVolFlt_mp "Gefilterter Volumenstrom für Berechnung" SWORD CubMtrPerHr 1 100 -3276.800 3276.700 FORMAT "%8.3" ECU_ADDRESS 0x8FE556 /end MEASUREMENT
/begin MEASUREMENT CoEng_dvolPerStroke_mp "Kraftstoffverbrauch" SWORD InjQnt 1 100 -3276.800 3276.700 FORMAT "%8.3" ECU_ADDRESS 0x8FE512 /end MEASUREMENT
/begin MEASUREMENT CoEng_facAdj "EEPROM Abgleichwert zur Korrektur des Begrenzungsmomentes" SWORD Fact 1 100 -4.000000 3.999878 FORMAT "%8.6" ECU_ADDRESS 0x7F8B40 /end MEASUREMENT
/begin MEASUREMENT CoEng_facFlConsumAdj_mp "Abgleichwert - Krafstoffverbrauchsabgleich" SWORD Fact 1 100 -4.000000 3.999878 FORMAT "%8.6" ECU_ADDRESS 0x8FE514 /end MEASUREMENT
/begin MEASUREMENT CoEng_nMax "Drehzahlintervall Maximum" SWORD EngN 1 100 -32768.00 32767.00 FORMAT "%8.2" ECU_ADDRESS 0x7F8B42 /end MEASUREMENT
/begin MEASUREMENT CoEng_nMin "Drehzahlintervall Minimum" SWORD EngN 1 100 -32768.00 32767.00 FORMAT "%8.2" ECU_ADDRESS 0x7F8B44 /end MEASUREMENT
/begin MEASUREMENT CoEng_numShOffTstNewSel "ausgewählter Abstelltest des gegenwaertigen Fahrzyklus" UBYTE OneToOne 1 100 0.00 255.0 FORMAT "%5.1" ECU_ADDRESS 0x7F8804 /end MEASUREMENT
/begin MEASUREMENT CoEng_pDiffPFltPrdc_mp "Vorhergesagter Differenzdruck über Partikelfilter" SWORD Pres_hPa 1 100 -32768.00 32767.00 FORMAT "%8.2" ECU_ADDRESS 0x8FE558 /end MEASUREMENT
/begin MEASUREMENT CoEng_pRailT15Off "Raildruck bei Klemme 15 aus" SWORD Pres_Rail 1 100 -3276.800 3276.700 FORMAT "%5.3" ECU_ADDRESS 0x7F8B46 /end MEASUREMENT
/begin MEASUREMENT CoEng_qSubs_mp "Ersatzeinspritzmenge für KVA Berechnung" SWORD InjMassCyc 1 100 -327.6800 327.6700 FORMAT "%8.4" ECU_ADDRESS 0x8FE516 /end MEASUREMENT
/begin MEASUREMENT CoEng_qSum_mp "tatsächlicher Kraftstoffverbrauch" SWORD InjMassCyc 1 100 -327.6800 327.6700 FORMAT "%8.4" ECU_ADDRESS 0x8FE518 /end MEASUREMENT
/begin MEASUREMENT CoEng_resFlowFlt_mp "Gefilterter Strömungswiderstand für Berechnung" SWORD Res_hPaHrPerCM 1 100 -32.76800 32.76700 FORMAT "%8.5" ECU_ADDRESS 0x8FE55A /end MEASUREMENT
/begin MEASUREMENT CoEng_rTrq "Verhältnis aktuelles Moment zu Maximalmoment" SWORD Prc 1 100 -400.0000 399.9878 FORMAT "%8.4" ECU_ADDRESS 0x7F8B48 /end MEASUREMENT
/begin MEASUREMENT CoEng_stAftRun "nachlauf-interner Nachlauf-Zustand" UBYTE OneToOne 1 100 0.00 255.0 FORMAT "%5.1" ECU_ADDRESS 0x7F8805 /end MEASUREMENT
/begin MEASUREMENT CoEng_stAftRunPath "Abschaltpfade aufgrund Motorzustand Nachlauf" ULONG OneToOne 1 100 0.00 4294967295.00 FORMAT "%13.2" ECU_ADDRESS 0x7F9170 /end MEASUREMENT
/begin MEASUREMENT CoEng_stCoordFuncFld_mp "Messpunktarray zur Statusanzeige Schubkoordinator" UWORD OneToOne 1 100 0.00 65535.00 FORMAT "%8.2" ARRAY_SIZE 3 ECU_ADDRESS 0x8FE526 /end MEASUREMENT
/begin MEASUREMENT CoEng_stCoordFuncPref_mp "Status Zustand Koordinator" UBYTE OneToOne 1 100 0.00 255.0 FORMAT "%5.1" ECU_ADDRESS 0x8FE52C /end MEASUREMENT
/begin MEASUREMENT CoEng_stCurrLim "Statuswort zur Markierung der niedrigsten Begrenzungsmomente" UWORD OneToOne 1 100 0.00 65535.00 FORMAT "%8.2" ECU_ADDRESS 0x7F8B4A /end MEASUREMENT
/begin MEASUREMENT CoEng_stCurrLimActive "Statusword zur Markierung der wirksamen niedrigsten Begrenzungsmomente" UWORD OneToOne 1 100 0.00 65535.00 FORMAT "%8.2" ECU_ADDRESS 0x7F8B4C /end MEASUREMENT
/begin MEASUREMENT CoEng_stDisable "Status Schubabschaltung: 1: abgeschalten; 0: nicht abgeschalten" UBYTE OneToOne 1 100 0.00 255.0 FORMAT "%5.1" ECU_ADDRESS 0x7F8806 /end MEASUREMENT
/begin MEASUREMENT CoEng_stDlyT15_mp "Status Variable für Verzögerungszeti nach Klemme 15 ein" UBYTE OneToOne 1 100 0.00 255.0 FORMAT "%5.1" ECU_ADDRESS 0x8FE52E /end MEASUREMENT
/begin MEASUREMENT CoEng_stEEPStore_mp "Speicherstatus für EEPROM während Nachlauf" UBYTE OneToOne 1 100 0.00 255.0 FORMAT "%5.1" ECU_ADDRESS 0x8FE510 /end MEASUREMENT
/begin MEASUREMENT CoEng_stEng "aktueller Motorzustand" UBYTE OneToOne 1 100 0.00 255.0 FORMAT "%5.1" ECU_ADDRESS 0x7F8807 /end MEASUREMENT
/begin MEASUREMENT CoEng_stEngOld "Motorstatus vor aktuellem Status" UBYTE OneToOne 1 100 0.00 255.0 FORMAT "%5.1" ECU_ADDRESS 0x7F8808 /end MEASUREMENT
/begin MEASUREMENT CoEng_stExtWait "Zustand ""warten auf externe Ereignisse vor Schreiben des EEPROM""" UBYTE OneToOne 1 100 0.00 255.0 FORMAT "%5.1" ECU_ADDRESS 0x7F8809 /end MEASUREMENT
/begin MEASUREMENT CoEng_stExtWait2 "Zustand ""Warten auf externe Ereignisse vor Öffnen des Hauptrelais""" UBYTE OneToOne 1 100 0.00 255.0 FORMAT "%5.1" ECU_ADDRESS 0x7F880A /end MEASUREMENT
/begin MEASUREMENT CoEng_stIRevShutOff "irreversible Abschaltursachen (nach Maskierung)" ULONG OneToOne 1 100 0.00 4294967295.00 FORMAT "%13.2" ECU_ADDRESS 0x7F9174 /end MEASUREMENT
/begin MEASUREMENT CoEng_stMonActrPrt "Zustand der Steuerung Stellerschutz" UBYTE OneToOne 1 100 0.00 255.0 FORMAT "%5.1" ECU_ADDRESS 0x7F880B /end MEASUREMENT
/begin MEASUREMENT CoEng_stMonShOff "aktueller Zustand der Abstellsteuerung im Nachlauf" UBYTE OneToOne 1 100 0.00 255.0 FORMAT "%5.1" ECU_ADDRESS 0x7F880C /end MEASUREMENT
/begin MEASUREMENT CoEng_stOvrFul_mp "Status Overfueling" UBYTE OneToOne 1 100 0.00 255.0 FORMAT "%5.1" ECU_ADDRESS 0x8FE55C /end MEASUREMENT
/begin MEASUREMENT CoEng_stOvrRun "Zustand Schuberkennung (0: kein Schub, 1: Schub)" UBYTE OneToOne 1 100 0.00 255.0 FORMAT "%5.1" ECU_ADDRESS 0x7F880D /end MEASUREMENT
/begin MEASUREMENT CoEng_stOvrRunCoord "Status Schuberkennung des Schubkoordinators (0: kein Schub; 1: Schub)" UBYTE OneToOne 1 100 0.00 255.0 FORMAT "%5.1" ECU_ADDRESS 0x7F880E /end MEASUREMENT
/begin MEASUREMENT CoEng_stOvrRunEGT_mp "Status Regenerationsanforderung Abgasnachbehandlung im Sinne des Schubkoordinators, 1:keine Freigabe für Funktionen" UBYTE OneToOne 1 100 0.00 255.0 FORMAT "%5.1" ECU_ADDRESS 0x8FE52D /end MEASUREMENT
/begin MEASUREMENT CoEng_stPwrDwn "Status des Diagnose Modus Power-down" UBYTE OneToOne 1 100 0.00 255.0 FORMAT "%5.1" ECU_ADDRESS 0x7F880F /end MEASUREMENT
/begin MEASUREMENT CoEng_stPwrStgEnaCond "Steuergerätestatus, der für die Abschaltung der Endstufe/Endstufenfehlerdiagnose relevant ist" UBYTE OneToOne 1 100 0.00 255.0 FORMAT "%5.1" ECU_ADDRESS 0x7F8810 /end MEASUREMENT
/begin MEASUREMENT CoEng_stRevShutOff "reversible Abschaltursachen (nach Maskierung)" ULONG OneToOne 1 100 0.00 4294967295.00 FORMAT "%13.2" ECU_ADDRESS 0x7F9178 /end MEASUREMENT
/begin MEASUREMENT CoEng_stRmp_mp "Status: Rampe der Schubabschaltung, 0: inaktiv, 1: aktiv" UBYTE OneToOne 1 100 0.00 255.0 FORMAT "%5.1" ECU_ADDRESS 0x8FE536 /end MEASUREMENT
/begin MEASUREMENT CoEng_stShOffAddReqIRev "Kundenspezifische irreversible Abschaltanforderung" UBYTE OneToOne 1 100 0.00 255.0 FORMAT "%5.1" ECU_ADDRESS 0x7F8811 /end MEASUREMENT
/begin MEASUREMENT CoEng_stShOffAddReqRev "Kundenspezifische reversible Abschaltanforderung" UBYTE OneToOne 1 100 0.00 255.0 FORMAT "%5.1" ECU_ADDRESS 0x7F8812 /end MEASUREMENT
/begin MEASUREMENT CoEng_stShOffTst "Status des Abstelltest" UBYTE OneToOne 1 100 0.00 255.0 FORMAT "%5.1" ECU_ADDRESS 0x7F8813 /end MEASUREMENT
/begin MEASUREMENT CoEng_stShOffTstOldRes_mp "Testergebnis des letzten Fahrzyklus" UBYTE OneToOne 1 100 0.00 255.0 FORMAT "%5.1" ECU_ADDRESS 0x8FE52F /end MEASUREMENT
/begin MEASUREMENT CoEng_stShutOff "Typ der wirksamen Abschaltursache (0: Nachlauf; 1: reversibel; 2: irreversibel)" UBYTE OneToOne 1 100 0.00 255.0 FORMAT "%5.1" ECU_ADDRESS 0x7F8814 /end MEASUREMENT
/begin MEASUREMENT CoEng_stShutOffPath "aktive Abstellpfade resultierend aus aktiven reversiblen, irreversiblen und Nachlauf-Abstellpfaden" ULONG OneToOne 1 100 0.00 4294967295.00 FORMAT "%13.2" ECU_ADDRESS 0x7F917C /end MEASUREMENT
/begin MEASUREMENT CoEng_stTrqLimErr "Status Begrenzungsmoment im Systemfehlerfall. Bit0: Begrenzung aktiv; Bit1: Rampe von/zu Begrenzungswert aktiv" UBYTE OneToOne 1 100 0.00 255.0 FORMAT "%5.1" ECU_ADDRESS 0x7F8815 /end MEASUREMENT
/begin MEASUREMENT CoEng_stTrqLimErr1 "Begrenzungsmoment im Fehlerfall" UBYTE OneToOne 1 100 0.00 255.0 FORMAT "%5.1" ECU_ADDRESS 0x7F8816 /end MEASUREMENT
/begin MEASUREMENT CoEng_stTrqLimErr2 "Begrenzungsmoment im Fehlerfall 2" UBYTE OneToOne 1 100 0.00 255.0 FORMAT "%5.1" ECU_ADDRESS 0x7F8817 /end MEASUREMENT
/begin MEASUREMENT CoEng_stTrqLimErr3 "Begrenzungsmoment im Fehlerfall" UBYTE OneToOne 1 100 0.00 255.0 FORMAT "%5.1" ECU_ADDRESS 0x7F8818 /end MEASUREMENT
/begin MEASUREMENT CoEng_stTrqLimErr4 "Begrenzungsmoment im Fehlerfall" UBYTE OneToOne 1 100 0.00 255.0 FORMAT "%5.1" ECU_ADDRESS 0x7F8819 /end MEASUREMENT
/begin MEASUREMENT CoEng_stTrqLimPFltErr "" UBYTE OneToOne 1 100 0.00 255.0 FORMAT "%5.1" ECU_ADDRESS 0x7F881A /end MEASUREMENT
/begin MEASUREMENT CoEng_stTst "Zustand des Motortestkoordinators (= aktiver Testmodus)" UBYTE OneToOne 1 100 0.00 255.0 FORMAT "%5.1" ECU_ADDRESS 0x7F881B /end MEASUREMENT
/begin MEASUREMENT CoEng_stZFCEmissionRoll "Freigabe Status der ZFC am Rollentester" UBYTE OneToOne 1 100 0.00 255.0 FORMAT "%5.1" ECU_ADDRESS 0x7F881C /end MEASUREMENT
/begin MEASUREMENT CoEng_tiAfterrun "Zeit seit Erreichen des Motorzustands Nachlauf (COENG_STAFTERRUN)" ULONG Time_ms 1 100 0.00 42949672950.0 FORMAT "%13.1" ECU_ADDRESS 0x7F9180 /end MEASUREMENT
/begin MEASUREMENT CoEng_tiAfterrunRed "Zeit seit Erreichen des Motorzustands Nachlauf (COENG_STAFTERRUN, 0x30) mit reduzierter Auflösung als KL/KF Eingang" SWORD TimeRed 1 100 -5242.880 5242.720 FORMAT "%8.3" ECU_ADDRESS 0x7F8B4E /end MEASUREMENT
/begin MEASUREMENT CoEng_tiMinAftRun "Minimale Zeitdauer für die Verbindung vom elektronischen Steuergerät zum Hauptrelais" ULONG Time_ms 1 100 0.00 42949672950.0 FORMAT "%13.1" ECU_ADDRESS 0x7F9184 /end MEASUREMENT
/begin MEASUREMENT CoEng_tiNormal "Zeit seit Erreichen des Zustands NORMAL" ULONG Time_ms 1 100 0.00 42949672950.0 FORMAT "%13.1" ECU_ADDRESS 0x7F9188 /end MEASUREMENT
/begin MEASUREMENT CoEng_tiNormalRed "Zeit seit Erreichen Motorzustand NORMAL (0x04), mit reduzierter Auflösung als KL/KF Eingang" SWORD TimeRed 1 100 -5242.880 5242.720 FORMAT "%8.3" ECU_ADDRESS 0x7F8B50 /end MEASUREMENT
/begin MEASUREMENT CoEng_tiOvRMon_mp "Zeit seit Schub erkannt wurde und die Schubüberwachung aktiv ist" SWORD Time_ms 1 100 -327680.0 327670.0 FORMAT "%8.1" ECU_ADDRESS 0x8FE538 /end MEASUREMENT
/begin MEASUREMENT CoEng_tiRmpStrt "Time for Ramp Start" UWORD Time_ms 1 100 0.00 655350.0 FORMAT "%8.1" ECU_ADDRESS 0x7F8B52 /end MEASUREMENT
/begin MEASUREMENT CoEng_tiSoftShOff_mp "time delay for soft shutoff" UWORD Time_ms 1 100 0.00 655350.0 FORMAT "%8.1" ECU_ADDRESS 0x8FE530 /end MEASUREMENT
/begin MEASUREMENT CoEng_tiStart "Zeit seit Erreichen Motorzustand START (0x02)" ULONG Time_ms 1 100 0.00 42949672950.0 FORMAT "%13.1" ECU_ADDRESS 0x7F918C /end MEASUREMENT
/begin MEASUREMENT CoEng_tiStartRed "Zeit seit Erreichen Motorzustand START (0x02), mit reduzierter Auflösung als KL/KF Eingang" SWORD TimeRed 1 100 -5242.880 5242.720 FORMAT "%8.3" ECU_ADDRESS 0x7F8B54 /end MEASUREMENT
/begin MEASUREMENT CoEng_tiSwtOff "Time for Switch Off" UWORD Time_ms 1 100 0.00 655350.0 FORMAT "%8.1" ECU_ADDRESS 0x7F8B56 /end MEASUREMENT
/begin MEASUREMENT CoEng_tiWakeUp "Zeit seit Erreichen Zustand WAKEUP" ULONG Time_ms 1 100 0.00 42949672950.0 FORMAT "%13.1" ECU_ADDRESS 0x7F9190 /end MEASUREMENT
/begin MEASUREMENT CoEng_trq "aktuelles Motorausgangsmoment" SWORD Trq 1 100 -3276.800 3276.700 FORMAT "%8.3" ECU_ADDRESS 0x7F8B58 /end MEASUREMENT
/begin MEASUREMENT CoEng_trqBefRmp_mp "Sollmoment nach zweiter Begrenzung, vor Schubabschaltung in CoEng (als inneres Motormoment)" SWORD Trq 1 100 -3276.800 3276.700 FORMAT "%8.3" ECU_ADDRESS 0x8FE53A /end MEASUREMENT
/begin MEASUREMENT CoEng_trqCurrLim "Minimum aller Begrenzungen als aktuelles Motorausgangsmoment" SWORD Trq 1 100 -3276.800 3276.700 FORMAT "%8.3" ECU_ADDRESS 0x7F8B5A /end MEASUREMENT
/begin MEASUREMENT CoEng_trqInrCurr "inneres Moment aktueller Wert" SWORD Trq 1 100 -3276.800 3276.700 FORMAT "%8.3" ECU_ADDRESS 0x7F8B5C /end MEASUREMENT
/begin MEASUREMENT CoEng_trqInrCurrFast "inneres Wunschmoment (schneller Pfad) erzeugt aus CoDT_trqCurr" SWORD Trq 1 100 -3276.800 3276.700 FORMAT "%8.3" ECU_ADDRESS 0x7F8B5E /end MEASUREMENT
/begin MEASUREMENT CoEng_trqInrCurrFastBase_mp "inneres schnelles Wunschmoment im Curr-Pfad" SWORD Trq 1 100 -3276.800 3276.700 FORMAT "%8.3" ECU_ADDRESS 0x8FE54E /end MEASUREMENT
/begin MEASUREMENT CoEng_trqInrCurrLim "aktuell kleinstes Begrenzungsmoment (inneres Motormoment)" SWORD Trq 1 100 -3276.800 3276.700 FORMAT "%8.3" ECU_ADDRESS 0x7F8B60 /end MEASUREMENT
/begin MEASUREMENT CoEng_trqInrCurrPre_mp "aktuelles inneres Moment ahne Leerlaufreglerstellgrösse" SWORD Trq 1 100 -3276.800 3276.700 FORMAT "%8.3" ECU_ADDRESS 0x8FE53C /end MEASUREMENT
/begin MEASUREMENT CoEng_trqInrDes "Wunschmoment (inneres Motormoment)" SWORD Trq 1 100 -3276.800 3276.700 FORMAT "%8.3" ECU_ADDRESS 0x7F8B62 /end MEASUREMENT
/begin MEASUREMENT CoEng_trqInrDesFast "Wunschmoment (inneres Motormoment) (schneller Pfad) erzeugt aus CoDT_trqLead" SWORD Trq 1 100 -3276.800 3276.700 FORMAT "%8.3" ECU_ADDRESS 0x7F8B64 /end MEASUREMENT
/begin MEASUREMENT CoEng_trqInrDesFastBase_mp "inneres schnelles Wunschmoment ohne Veränderung" SWORD Trq 1 100 -3276.800 3276.700 FORMAT "%8.3" ECU_ADDRESS 0x8FE550 /end MEASUREMENT
/begin MEASUREMENT CoEng_trqInrDesFastUnLim_mp "inneres schnelles Wunschmoment vor Begrenzung" SWORD Trq 1 100 -3276.800 3276.700 FORMAT "%8.3" ECU_ADDRESS 0x8FE552 /end MEASUREMENT
/begin MEASUREMENT CoEng_trqInrDesSlow "inneres Moment Wunschwert (normaler Pfad) erzeugt aus CoDT_trqDes" SWORD Trq 1 100 -3276.800 3276.700 FORMAT "%8.3" ECU_ADDRESS 0x7F8B66 /end MEASUREMENT
/begin MEASUREMENT CoEng_trqInrDesSlowBase_mp "inneres langsames Wunschmoment ohne Veränderung" SWORD Trq 1 100 -3276.800 3276.700 FORMAT "%8.3" ECU_ADDRESS 0x8FE53E /end MEASUREMENT
/begin MEASUREMENT CoEng_trqInrDesSlowUnLim_mp "inneres langsames Wunschmoment vor Begrenzung" SWORD Trq 1 100 -3276.800 3276.700 FORMAT "%8.3" ECU_ADDRESS 0x8FE540 /end MEASUREMENT
/begin MEASUREMENT CoEng_trqInrGearbxInMax_mp "maximales Getriebeeingangsmoment als inneres Motormoment" SWORD Trq 1 100 -3276.800 3276.700 FORMAT "%8.3" ECU_ADDRESS 0x8FE532 /end MEASUREMENT
/begin MEASUREMENT CoEng_trqInrLiDesSlw "Momentenführungswert mit LiGov Ausgngswert beaufschlagt" SWORD Trq 1 100 -3276.800 3276.700 FORMAT "%8.3" ECU_ADDRESS 0x7F8B68 /end MEASUREMENT
/begin MEASUREMENT CoEng_trqInrLim "Begrenzungsmoment (inneres Motormoment)" SWORD Trq 1 100 -3276.800 3276.700 FORMAT "%8.3" ECU_ADDRESS 0x7F8B6A /end MEASUREMENT
/begin MEASUREMENT CoEng_trqInrLimDes "Begrenzungsmoment als inneres Motormoment, korrigiert um Leerlaufreglerstellgröße" SWORD Trq 1 100 -3276.800 3276.700 FORMAT "%8.3" ECU_ADDRESS 0x7F8B6C /end MEASUREMENT
/begin MEASUREMENT CoEng_trqInrLimLead "Begrenzungsmoment mit lang anhaltenden Begrenzungen" SWORD Trq 1 100 -3276.800 3276.700 FORMAT "%8.3" ECU_ADDRESS 0x7F8B6E /end MEASUREMENT
/begin MEASUREMENT CoEng_trqInrLimLead0_mp "Torque lead limitation after error condition #0" SWORD Trq 1 100 -3276.800 3276.700 FORMAT "%8.3" ECU_ADDRESS 0x8FE55E /end MEASUREMENT
/begin MEASUREMENT CoEng_trqInrLimLead1_mp "Torque lead limitation after error condition #1" SWORD Trq 1 100 -3276.800 3276.700 FORMAT "%8.3" ECU_ADDRESS 0x8FE560 /end MEASUREMENT
/begin MEASUREMENT CoEng_trqInrLimLead2_mp "Torque lead limitation after error condition #2" SWORD Trq 1 100 -3276.800 3276.700 FORMAT "%8.3" ECU_ADDRESS 0x8FE562 /end MEASUREMENT
/begin MEASUREMENT CoEng_trqInrLtd "inneres Moment Sollwert nach Begrenzung, vor Eingriff ARD-Störungsregler" SWORD Trq 1 100 -3276.800 3276.700 FORMAT "%8.3" ECU_ADDRESS 0x7F8B70 /end MEASUREMENT
/begin MEASUREMENT CoEng_trqInrPrpLimErr_mp "Begrenzungsmoment für Vortrieb im Falle eines Systemfehlers als inneres Motormoment" SWORD Trq 1 100 -3276.800 3276.700 FORMAT "%8.3" ECU_ADDRESS 0x8FE534 /end MEASUREMENT
/begin MEASUREMENT CoEng_trqInrRaw "inneres Moment Rohwert" SWORD Trq 1 100 -3276.800 3276.700 FORMAT "%8.3" ECU_ADDRESS 0x7F8B72 /end MEASUREMENT
/begin MEASUREMENT CoEng_trqInrRawPre_mp "Rohwet inneres Moment ohne Leerlaufreglerstellgrösse" SWORD Trq 1 100 -3276.800 3276.700 FORMAT "%8.3" ECU_ADDRESS 0x8FE542 /end MEASUREMENT
/begin MEASUREMENT CoEng_trqInrSet "inneres Moment Sollwert (>Mengenberechnung)" SWORD Trq 1 100 -3276.800 3276.700 FORMAT "%8.3" ECU_ADDRESS 0x7F8B74 /end MEASUREMENT
/begin MEASUREMENT CoEng_trqInrSetLim_mp "Begrenzter Sollwert des inneren Moments, wenn Schub erkannt wurde und die Schubüberwachung aktiv ist" SWORD Trq 1 100 -3276.800 3276.700 FORMAT "%8.3" ECU_ADDRESS 0x8FE544 /end MEASUREMENT
/begin MEASUREMENT CoEng_trqInrSetUnLtd_mp "Unbegrenzter Sollwert des inneren Moments bei erkanntem Schub" SWORD Trq 1 100 -3276.800 3276.700 FORMAT "%8.3" ECU_ADDRESS 0x8FE546 /end MEASUREMENT
/begin MEASUREMENT CoEng_trqLiLtd "begrenztes Leerlaufreglermoment" SWORD Trq 1 100 -3276.800 3276.700 FORMAT "%8.3" ECU_ADDRESS 0x7F8B76 /end MEASUREMENT
/begin MEASUREMENT CoEng_trqLimErr "Begrenzungsmoment im Falle eines Systemfehlers" SWORD Trq 1 100 -3276.800 3276.700 FORMAT "%8.3" ECU_ADDRESS 0x7F8B78 /end MEASUREMENT
/begin MEASUREMENT CoEng_trqLimErr1 "Begrenzungsmoment im Falle Systemfehler 1" SWORD Trq 1 100 -3276.800 3276.700 FORMAT "%8.3" ECU_ADDRESS 0x7F8B7A /end MEASUREMENT
/begin MEASUREMENT CoEng_trqLimErr2 "Begrenzungsmoment im Fall Systemfahler 2" SWORD Trq 1 100 -3276.800 3276.700 FORMAT "%8.3" ECU_ADDRESS 0x7F8B7C /end MEASUREMENT
/begin MEASUREMENT CoEng_trqLimErr3 "Begrenzungsmoment im Falle Systemfehler3" SWORD Trq 1 100 -3276.800 3276.700 FORMAT "%8.3" ECU_ADDRESS 0x7F8B7E /end MEASUREMENT
/begin MEASUREMENT CoEng_trqLimErr4 "Begrenzungsmoment im Fall Systemfehler 4" SWORD Trq 1 100 -3276.800 3276.700 FORMAT "%8.3" ECU_ADDRESS 0x7F8B80 /end MEASUREMENT
/begin MEASUREMENT CoEng_trqLimMin1_mp "Minimum von Motormechanikschutz und Rauchbegrenzung" SWORD Trq 1 100 -3276.800 3276.700 FORMAT "%8.3" ECU_ADDRESS 0x8FE564 /end MEASUREMENT
/begin MEASUREMENT CoEng_trqLimMinEEPVal_mp "Stored in EEPROM in case of errors in particle filter" SWORD Trq 1 100 -3276.800 3276.700 FORMAT "%8.3" ECU_ADDRESS 0x8FE566 /end MEASUREMENT
/begin MEASUREMENT CoEng_trqLimMin_mp "Begrenzungsmoment, falls kein momentenbegrenzender Systemfehler vorliegt (Minimum aus Rauchgrenze un Motormech.schutz)" SWORD Trq 1 100 -3276.800 3276.700 FORMAT "%8.3" ECU_ADDRESS 0x6F8010 /end MEASUREMENT
/begin MEASUREMENT CoEng_trqLimOffs "current torque limitation with offset for ASDdc" SWORD Trq 1 100 -3276.800 3276.700 FORMAT "%8.3" ECU_ADDRESS 0x7F8B82 /end MEASUREMENT
/begin MEASUREMENT CoEng_trqLimOffs_mp "aktueller Momentgrenzwert mit Offset f. ARD" SWORD Trq 1 100 -3276.800 3276.700 FORMAT "%8.3" ECU_ADDRESS 0x8FE548 /end MEASUREMENT
/begin MEASUREMENT CoEng_trqLimPDiff "Momentenbegrenzung aufgrund Druckdifferenz über Partikelfilter" SWORD Trq 1 100 -3276.800 3276.700 FORMAT "%8.3" ECU_ADDRESS 0x7F8B84 /end MEASUREMENT
/begin MEASUREMENT CoEng_trqLimPDiffNOffs_mp "" SWORD Trq 1 100 -3276.800 3276.700 FORMAT "%8.3" ECU_ADDRESS 0x8FE568 /end MEASUREMENT
/begin MEASUREMENT CoEng_trqLimPFlt1_mp "Pressure difference conversion to torque" SWORD Trq 1 100 -3276.800 3276.700 FORMAT "%8.3" ECU_ADDRESS 0x8FE56A /end MEASUREMENT
/begin MEASUREMENT CoEng_trqLimSwt "Ausgang des RampSwitch-Block zur Momentbegrenzung im Systemfehlerfall" SWORD Trq 1 100 -3276.800 3276.700 FORMAT "%8.3" ECU_ADDRESS 0x7F8B86 /end MEASUREMENT
/begin MEASUREMENT CoEng_trqLimSwt1_mp "Begrenzungsmoment im Fehlerfall" SWORD Trq 1 100 -3276.800 3276.700 FORMAT "%8.3" ECU_ADDRESS 0x8FE56C /end MEASUREMENT
/begin MEASUREMENT CoEng_trqLimSwt2_mp "Begrenzungsmoment im Fehlerfall 2" SWORD Trq 1 100 -3276.800 3276.700 FORMAT "%8.3" ECU_ADDRESS 0x8FE56E /end MEASUREMENT
/begin MEASUREMENT CoEng_trqLimSwt3_mp "Begrenzungsmoment im Fehlerfall" SWORD Trq 1 100 -3276.800 3276.700 FORMAT "%8.3" ECU_ADDRESS 0x8FE570 /end MEASUREMENT
/begin MEASUREMENT CoEng_trqLimSwt4_mp "Begrenzungsmoment im Fehlerfall" SWORD Trq 1 100 -3276.800 3276.700 FORMAT "%8.3" ECU_ADDRESS 0x8FE572 /end MEASUREMENT
/begin MEASUREMENT CoEng_trqMax "Momentintervall Maximum" SWORD Trq 1 100 -3276.800 3276.700 FORMAT "%8.3" ECU_ADDRESS 0x7F8B88 /end MEASUREMENT
/begin MEASUREMENT CoEng_trqMin "Schleppmoment" SWORD Trq 1 100 -3276.800 3276.700 FORMAT "%8.3" ECU_ADDRESS 0x7F8B8A /end MEASUREMENT
/begin MEASUREMENT CoEng_trqOvrFul "Overfueling Menge nach Rampe" SWORD Trq 1 100 -3276.800 3276.700 FORMAT "%8.3" ECU_ADDRESS 0x7F8B8C /end MEASUREMENT
/begin MEASUREMENT CoEng_trqRmp_mp "Ausgangsmoment Rampe der Schubabschaltung" SWORD Trq 1 100 -3276.800 3276.700 FORMAT "%8.3" ECU_ADDRESS 0x8FE54A /end MEASUREMENT
/begin MEASUREMENT CoEng_trqSetASDdc_mp "Sollmoment nach Eingriff Ruckeldämfer vor zweiter Begrenzung (mit Offset)" SWORD Trq 1 100 -3276.800 3276.700 FORMAT "%8.3" ECU_ADDRESS 0x8FE54C /end MEASUREMENT
/begin MEASUREMENT CoEng_trqSlpLim "Begrenzungsmoment für Rauchbegrenzung nach Turboschubbegrenzung" SWORD Trq 1 100 -3276.800 3276.700 FORMAT "%8.3" ECU_ADDRESS 0x7F8B90 /end MEASUREMENT
/begin MEASUREMENT CoEng_volFlConsum "absoluter Verbrauch" SLONG FlConsum_ul_20ms 1 100 -2147483648.00 2147483647.00 FORMAT "%13.2" ECU_ADDRESS 0x7F9194 /end MEASUREMENT
/begin MEASUREMENT CoEng_volFlConsumAdj_mp "abgeglicher Kraftstoffverbrauch" SLONG FlConsum_ul_20ms 1 100 -2147483648.00 2147483647.00 FORMAT "%13.2" ECU_ADDRESS 0x8FE51C /end MEASUREMENT
/begin MEASUREMENT CoEng_voltotFlConsum "Absoluter Kraftstoffverbrauch" SLONG FlConsum_ul 1 100 -2147483648.00 2147483647.00 FORMAT "%13.2" ECU_ADDRESS 0x7F9198 /end MEASUREMENT
/begin MEASUREMENT ComBas_stDiaReq "Message: Antwort von der Diagnose-Schnittstelle" UBYTE OneToOne 1 100 0.00 255.0 FORMAT "%5.1" ECU_ADDRESS 0x7F8825 /end MEASUREMENT
/begin MEASUREMENT ConvCD_ctClutchDfct_mp "Defektzähler von Plausibitätfehler des Kupplungssignals" UWORD OneToOne 1 100 0.00 65535.00 FORMAT "%8.2" ECU_ADDRESS 0x8FE574 /end MEASUREMENT
/begin MEASUREMENT ConvCD_stClth "Kupplungszustand" UBYTE OneToOne 1 100 0.00 255.0 FORMAT "%5.1" ECU_ADDRESS 0x7F8826 /end MEASUREMENT
/begin MEASUREMENT ConvCD_stClthRaw "Kupplungszustand nicht überwacht" UBYTE OneToOne 1 100 0.00 255.0 FORMAT "%5.1" ECU_ADDRESS 0x7F8827 /end MEASUREMENT
/begin MEASUREMENT ConvCD_stClutchRecord "Message zur Kupplungsstatus Wechsel ( 0 --> 1)" UBYTE OneToOne 1 100 0.00 255.0 FORMAT "%5.1" ECU_ADDRESS 0x7F8828 /end MEASUREMENT
/begin MEASUREMENT ConvCD_stDebVal "entprelltes Kupplungssignal" UBYTE OneToOne 1 100 0.00 255.0 FORMAT "%5.1" ECU_ADDRESS 0x7F8829 /end MEASUREMENT
/begin MEASUREMENT ConvCD_stIntDebVal "Entprellt Kupplung Status zur internen Verwendung" UBYTE OneToOne 1 100 0.00 255.0 FORMAT "%5.1" ECU_ADDRESS 0x7F882A /end MEASUREMENT
/begin MEASUREMENT ConvCD_stLastDebVal "Letzter Kupplungssignalstatus." UBYTE OneToOne 1 100 0.00 255.0 FORMAT "%5.1" ECU_ADDRESS 0x7F882B /end MEASUREMENT
/begin MEASUREMENT ConvCD_stLastGear "Gang von den letzten Zyklus" SBYTE OneToOne 1 100 -128.0 127.0 FORMAT "%5.1" ECU_ADDRESS 0x7F882C /end MEASUREMENT
/begin MEASUREMENT ConvCD_stOldGear "Letzte gültigen Gang" SBYTE OneToOne 1 100 -128.0 127.0 FORMAT "%5.1" ECU_ADDRESS 0x7F882D /end MEASUREMENT
/begin MEASUREMENT ConvCD_stRawVal "Kupplungssignal Rohwert" UBYTE OneToOne 1 100 0.00 255.0 FORMAT "%5.1" ECU_ADDRESS 0x7F882E /end MEASUREMENT
/begin MEASUREMENT ConvCD_swtSig "Schalter für Kupplungssignalquelle (DIO/CAN)." UBYTE OneToOne 1 100 0.00 255.0 FORMAT "%5.1" ECU_ADDRESS 0x7F882F /end MEASUREMENT
/begin MEASUREMENT Conv_rTrans "Übertragungsverhältins Momentenwandler (Kupplung)" SWORD TransR 1 100 -327.6800 327.6700 FORMAT "%8.4" ECU_ADDRESS 0x7F8BBE /end MEASUREMENT
/begin MEASUREMENT CoVeh_nAcsMax "maximale Drehzahl Nebenaggregate" SWORD EngN 1 100 -32768.00 32767.00 FORMAT "%8.2" ECU_ADDRESS 0x7F8BA0 /end MEASUREMENT
/begin MEASUREMENT CoVeh_nAcsMin "minimale Drehzahl Nebenaggregate" SWORD EngN 1 100 -32768.00 32767.00 FORMAT "%8.2" ECU_ADDRESS 0x7F8BA2 /end MEASUREMENT
/begin MEASUREMENT CoVeh_nLimEngSpd "limitierte Motordrehzahl für die Drehmomentenberechnung" SWORD EngN 1 100 -32768.00 32767.00 FORMAT "%8.2" ECU_ADDRESS 0x7F8BA4 /end MEASUREMENT
/begin MEASUREMENT CoVeh_nMax "Auftrag maximale Motordrehzahl" SWORD EngN 1 100 -32768.00 32767.00 FORMAT "%8.2" ECU_ADDRESS 0x7F8BA6 /end MEASUREMENT
/begin MEASUREMENT CoVeh_nMin "Auftrag minimale Motordrehzahl" SWORD EngN 1 100 -32768.00 32767.00 FORMAT "%8.2" ECU_ADDRESS 0x7F8BA8 /end MEASUREMENT
/begin MEASUREMENT CoVeh_pwrAcsDes "Nebenaggregatleistung Auftrag" SWORD Pwr 1 100 -308831.1 308821.7 FORMAT "%8.1" ECU_ADDRESS 0x7F8BAA /end MEASUREMENT
/begin MEASUREMENT CoVeh_pwrAcsLead "Vorhalt Nebenaggregatleistung Auftrag" SWORD Pwr 1 100 -308831.1 308821.7 FORMAT "%8.1" ECU_ADDRESS 0x7F8BAC /end MEASUREMENT
/begin MEASUREMENT CoVeh_pwrAcsTempLim_mp "Power demand for all temporary accessories - limited based on PrpBrk_trqDes" SWORD Pwr 1 100 -308831.1 308821.7 FORMAT "%8.1" ECU_ADDRESS 0x8FE576 /end MEASUREMENT
/begin MEASUREMENT CoVeh_stOrd "Randbedingungen für physikalischen Auftrag" UBYTE OneToOne 1 100 0.00 255.0 FORMAT "%5.1" ECU_ADDRESS 0x7F8823 /end MEASUREMENT
/begin MEASUREMENT CoVeh_trqAcs "Momentenanforderung der Nebenaggregate" SWORD Trq 1 100 -3276.800 3276.700 FORMAT "%8.3" ECU_ADDRESS 0x7F8BAE /end MEASUREMENT
/begin MEASUREMENT CoVeh_trqAcsDes "Momentenanforderung Nebenaggregate Wunschwert" SWORD Trq 1 100 -3276.800 3276.700 FORMAT "%8.3" ECU_ADDRESS 0x7F8BB0 /end MEASUREMENT
/begin MEASUREMENT CoVeh_trqAcsLead "Momentenanforderung Nebenaggregate Vorhaltewert" SWORD Trq 1 100 -3276.800 3276.700 FORMAT "%8.3" ECU_ADDRESS 0x7F8BB2 /end MEASUREMENT
/begin MEASUREMENT CoVeh_trqAcsLimCrSDes_mp "Torque demand" SWORD Trq 1 100 -3276.800 3276.700 FORMAT "%8.3" ECU_ADDRESS 0x8FE578 /end MEASUREMENT
/begin MEASUREMENT CoVeh_trqAcsPerm "Momentenbedarf permanente Nebenaggregate" SWORD Trq 1 100 -3276.800 3276.700 FORMAT "%8.3" ECU_ADDRESS 0x7F8BB4 /end MEASUREMENT
/begin MEASUREMENT CoVeh_trqAcsTemp "Momentenbedarf zuschaltbare Nebenaggregate" SWORD Trq 1 100 -3276.800 3276.700 FORMAT "%8.3" ECU_ADDRESS 0x7F8BB6 /end MEASUREMENT
/begin MEASUREMENT CoVeh_trqPrpDes "Vortriebsmoment Wunschwert" SWORD TrqPrp 1 100 -6553.600 6553.400 FORMAT "%8.3" ECU_ADDRESS 0x7F8BB8 /end MEASUREMENT
/begin MEASUREMENT CoVeh_trqPrpLead "Vortriebsmoment Vorhaltewert" SWORD TrqPrp 1 100 -6553.600 6553.400 FORMAT "%8.3" ECU_ADDRESS 0x7F8BBA /end MEASUREMENT
/begin MEASUREMENT CoVeh_trqPrpLimErr "Begrenzungsmoment für Vortrieb im Falle eines Systemfehlers" SWORD TrqPrp 1 100 -6553.600 6553.400 FORMAT "%8.3" ECU_ADDRESS 0x7F8BBC /end MEASUREMENT
/begin MEASUREMENT CoVM_amAct_mp "Aktueller Integrationswert des  MSR-Momentenüberschußintegrals" SWORD TrqPrpDT 1 100 -163840.0 163835.0 FORMAT "%8.1" ECU_ADDRESS 0x8FE57A /end MEASUREMENT
/begin MEASUREMENT CoVM_stActDem "Status aktiv wirkender Fahrdynamikeingriffe" UBYTE OneToOne 1 100 0.00 255.0 FORMAT "%5.1" ECU_ADDRESS 0x7F881D /end MEASUREMENT
/begin MEASUREMENT CoVM_stDemCheck "Steuerbits der Abschaltsteuerung der Fahrdynamikeingriffe" UBYTE OneToOne 1 100 0.00 255.0 FORMAT "%5.1" ECU_ADDRESS 0x7F881E /end MEASUREMENT
/begin MEASUREMENT CoVM_stDemUnplaus_mp "Status der DCS Überwachung" UBYTE OneToOne 1 100 0.00 255.0 FORMAT "%5.1" ECU_ADDRESS 0x8FE57C /end MEASUREMENT
/begin MEASUREMENT CoVM_stOrd "Randbedingungen für physikalischen Auftrag" UBYTE OneToOne 1 100 0.00 255.0 FORMAT "%5.1" ECU_ADDRESS 0x7F881F /end MEASUREMENT
/begin MEASUREMENT CoVM_stTrqLeadFrz "current status if SW timer running" UBYTE OneToOne 1 100 0.00 255.0 FORMAT "%5.1" ECU_ADDRESS 0x7F8820 /end MEASUREMENT
/begin MEASUREMENT CoVM_swtSlipCtl "Fahrdynamik-Konfiguration (0: ASR aus, MSR aus; 1: ASR an, MSR aus;  2: ASR aus, MSR an;  3: ASR an, MSR an)" UBYTE OneToOne 1 100 0.00 255.0 FORMAT "%5.1" ECU_ADDRESS 0x7F8822 /end MEASUREMENT
/begin MEASUREMENT CoVM_trqDec "Momenteneingriff von ASR" SWORD TrqPrp 1 100 -6553.600 6553.400 FORMAT "%8.3" ECU_ADDRESS 0x7F8B94 /end MEASUREMENT
/begin MEASUREMENT CoVM_trqDecSetVal_mp "decreasing  torque set value wheel-torque" SWORD TrqPrp 1 100 -6553.600 6553.400 FORMAT "%8.3" ECU_ADDRESS 0x8FE584 /end MEASUREMENT
/begin MEASUREMENT CoVM_trqDesIncMax_mp "Messpunkt des Maximumwertes zwischen PrpBrk_trqDes & CoVM_trqInc" SWORD TrqPrp 1 100 -6553.600 6553.400 FORMAT "%8.3" ECU_ADDRESS 0x8FE580 /end MEASUREMENT
/begin MEASUREMENT CoVM_trqDVCH "Fahrerwunschmoment für DSC, EGS" SWORD Trq 1 100 -3276.800 3276.700 FORMAT "%8.3" ECU_ADDRESS 0x7F8B92 /end MEASUREMENT
/begin MEASUREMENT CoVM_trqGearbxMax "Momentbegrenzung reduzierender Getriebeeingriff" SWORD Trq 1 100 -3276.800 3276.700 FORMAT "%8.3" ECU_ADDRESS 0x7F8B96 /end MEASUREMENT
/begin MEASUREMENT CoVM_trqGearbxMin "Momentbegrenzung erhöhender Getriebeeingriff" SWORD Trq 1 100 -3276.800 3276.700 FORMAT "%8.3" ECU_ADDRESS 0x7F8B98 /end MEASUREMENT
/begin MEASUREMENT CoVM_trqInc "Momenteneingriff von MSR" SWORD TrqPrp 1 100 -6553.600 6553.400 FORMAT "%8.3" ECU_ADDRESS 0x7F8B9A /end MEASUREMENT
/begin MEASUREMENT CoVM_trqIncSetVal_mp "increasing  torque set value  of wheel-torque" SWORD TrqPrp 1 100 -6553.600 6553.400 FORMAT "%8.3" ECU_ADDRESS 0x8FE586 /end MEASUREMENT
/begin MEASUREMENT CoVM_trqInt_mp "Aktuelles  Integrationsmoment des MSR-Momentenüberschußintegrals" SWORD TrqPrp 1 100 -6553.600 6553.400 FORMAT "%8.3" ECU_ADDRESS 0x8FE57E /end MEASUREMENT
/begin MEASUREMENT CoVM_trqLeadIncMax_mp "Messpunkt des Maximumwertes zwischen PrpBrk_trqLead & CoVM_trqInc" SWORD TrqPrp 1 100 -6553.600 6553.400 FORMAT "%8.3" ECU_ADDRESS 0x8FE582 /end MEASUREMENT
/begin MEASUREMENT CoVM_trqPrpDes "Wunsch Vortriebsmoment" SWORD TrqPrp 1 100 -6553.600 6553.400 FORMAT "%8.3" ECU_ADDRESS 0x7F8B9C /end MEASUREMENT
/begin MEASUREMENT CoVM_trqPrpLead "Vorhalt Vortriebsmoment" SWORD TrqPrp 1 100 -6553.600 6553.400 FORMAT "%8.3" ECU_ADDRESS 0x7F8B9E /end MEASUREMENT
/begin MEASUREMENT CpBVlv_qClose_mp "mp für niedrigeren Schwellenwert der Einspriztmenge (Schließung)" SWORD InjMassCyc 1 100 -327.6800 327.6700 FORMAT "%8.4" ECU_ADDRESS 0x8FE588 /end MEASUREMENT
/begin MEASUREMENT CpBVlv_qOpn_mp "mp für höheren Schwellenwert der der Einspriztmenge  (Eröffnung)" SWORD InjMassCyc 1 100 -327.6800 327.6700 FORMAT "%8.4" ECU_ADDRESS 0x8FE58A /end MEASUREMENT
/begin MEASUREMENT CpBVlv_stLogic "Logikstatus fuer Verdichterbypass" UBYTE OneToOne 1 100 0.00 255.0 FORMAT "%5.1" ECU_ADDRESS 0x7F8830 /end MEASUREMENT
/begin MEASUREMENT CpBVlv_stOff_mp "mp für shutoff" UBYTE OneToOne 1 100 0.00 255.0 FORMAT "%5.1" ECU_ADDRESS 0x8FE58C /end MEASUREMENT
/begin MEASUREMENT CpBVlv_stOpn "Zustand Kompressorbypass-Ventil" UBYTE OneToOne 1 100 0.00 255.0 FORMAT "%5.1" ECU_ADDRESS 0x7F8831 /end MEASUREMENT
/begin MEASUREMENT CrCCD_dMFLData_mp "Rohdaten vom MFL" UBYTE OneToOne 1 100 0.00 255.0 FORMAT "%5.1" ECU_ADDRESS 0x8FE58D /end MEASUREMENT
/begin MEASUREMENT CrCCD_stDev "Status FGR-Bedienteil (zusätzliche Abschaltbedingungen)" UBYTE OneToOne 1 100 0.00 255.0 FORMAT "%5.1" ECU_ADDRESS 0x7F8832 /end MEASUREMENT
/begin MEASUREMENT CrCCD_stKey "Rückgabewert ""Taste gedrückt""" UBYTE OneToOne 1 100 0.00 255.0 FORMAT "%5.1" ECU_ADDRESS 0x7F8833 /end MEASUREMENT
/begin MEASUREMENT CrCCD_stKeyOff "tip up und tip down Taste bei deaktivierten CrCtl Hauptschalter" UBYTE OneToOne 1 100 0.00 255.0 FORMAT "%5.1" ECU_ADDRESS 0x7F8834 /end MEASUREMENT
/begin MEASUREMENT CrCCD_swtDev "SW-Schalter eingebauter Typ FGR Bedienteil" UBYTE OneToOne 1 100 0.00 255.0 FORMAT "%5.1" ECU_ADDRESS 0x7F8835 /end MEASUREMENT
/begin MEASUREMENT CrCCD_swtMSW "Schalterstellung vom MSW (1...MSW ein/0...MSW aus)" UBYTE OneToOne 1 100 0.00 255.0 FORMAT "%5.1" ECU_ADDRESS 0x7F8836 /end MEASUREMENT
/begin MEASUREMENT CrCtl_BGSTUTbits2_mp "" UWORD OneToOne 1 100 0.00 65535.00 FORMAT "%8.2" ECU_ADDRESS 0x8FE5A6 /end MEASUREMENT
/begin MEASUREMENT CrCtl_dvAcc_mp "Rampensteigung bei Beschleunigung SET+" SWORD dVel_20ms 1 100 -16384.00 16383.50 FORMAT "%8.2" ECU_ADDRESS 0x8FE592 /end MEASUREMENT
/begin MEASUREMENT CrCtl_dvDecl_mp "Rampensteigung bei Verzögerung SET-" SWORD dVel_20ms 1 100 -16384.00 16383.50 FORMAT "%8.2" ECU_ADDRESS 0x8FE594 /end MEASUREMENT
/begin MEASUREMENT CrCtl_dvResAbv_mp "Rampensteigung bei WA-" SWORD dVel_20ms 1 100 -16384.00 16383.50 FORMAT "%8.2" ECU_ADDRESS 0x8FE596 /end MEASUREMENT
/begin MEASUREMENT CrCtl_dvResBlw_mp "Rampensteigung WA+" SWORD dVel_20ms 1 100 -16384.00 16383.50 FORMAT "%8.2" ECU_ADDRESS 0x8FE598 /end MEASUREMENT
/begin MEASUREMENT CrCtl_mrkeinvp_mp "" UBYTE OneToOne 1 100 0.00 255.0 FORMAT "%5.1" ECU_ADDRESS 0x8FE5A8 /end MEASUREMENT
/begin MEASUREMENT CrCtl_numGear "Gang FGR" SBYTE OneToOne 1 100 -128.0 127.0 FORMAT "%5.1" ECU_ADDRESS 0x7F8837 /end MEASUREMENT
/begin MEASUREMENT CrCtl_numVMrk "1 Index für vmrki..." UBYTE OneToOne 1 100 0.00 255.0 FORMAT "%5.1" ECU_ADDRESS 0x7F8838 /end MEASUREMENT
/begin MEASUREMENT CrCtl_rVnBeg "Verhältnis Geschwindigkeit zu Drehzahl bei Aktivierung FGR" SWORD VelToN 1 100 0.00 0.3276700 FORMAT "%9.7" ECU_ADDRESS 0x7F8BC0 /end MEASUREMENT
/begin MEASUREMENT CrCtl_st "Status FGR" UBYTE OneToOne 1 100 0.00 255.0 FORMAT "%5.1" ECU_ADDRESS 0x7F8839 /end MEASUREMENT
/begin MEASUREMENT CrCtl_stActive "Flag aktiver FGR" UBYTE OneToOne 1 100 0.00 255.0 FORMAT "%5.1" ECU_ADDRESS 0x7F883A /end MEASUREMENT
/begin MEASUREMENT CrCtl_stBrkBeforeCruise_mp "Meßpunkt für Bremsenanforderung" UBYTE OneToOne 1 100 0.00 255.0 FORMAT "%5.1" ECU_ADDRESS 0x8FE58E /end MEASUREMENT
/begin MEASUREMENT CrCtl_stCAN "Status der CrCtl für CAN" UBYTE OneToOne 1 100 0.00 255.0 FORMAT "%5.1" ECU_ADDRESS 0x7F883B /end MEASUREMENT
/begin MEASUREMENT CrCtl_stCC "Status FGR" UBYTE OneToOne 1 100 0.00 255.0 FORMAT "%5.1" ECU_ADDRESS 0x7F883C /end MEASUREMENT
/begin MEASUREMENT CrCtl_stClCtr_mp "Status nach DSC, ASC & MSR Eingriffen" UWORD OneToOne 1 100 0.00 65535.00 FORMAT "%8.2" ECU_ADDRESS 0x8FE590 /end MEASUREMENT
/begin MEASUREMENT CrCtl_stLampOut "Status der CrCtl-Lampe (wird über CAN versendet)" UBYTE OneToOne 1 100 0.00 255.0 FORMAT "%5.1" ECU_ADDRESS 0x7F883D /end MEASUREMENT
/begin MEASUREMENT CrCtl_stRecFGR "Status ob FGR im Fahrzeug verbaut ist" UBYTE OneToOne 1 100 0.00 255.0 FORMAT "%5.1" ECU_ADDRESS 0x7F883E /end MEASUREMENT
/begin MEASUREMENT CrCtl_stShutOffCode "Abschaltgrund FGR" ULONG OneToOne 1 100 0.00 4294967295.00 FORMAT "%13.2" ECU_ADDRESS 0x7F919C /end MEASUREMENT
/begin MEASUREMENT CrCtl_stShutOffCode1_mp "Low Byte von CrCtl_shutOffCode (Verwendung als Signal)" UWORD OneToOne 1 100 0.00 65535.00 FORMAT "%8.2" ECU_ADDRESS 0x6F8012 /end MEASUREMENT
/begin MEASUREMENT CrCtl_stShutOffCode2_mp "Low Byte von CrCtl_shutOffCode (Verwendung als Signal)" UWORD OneToOne 1 100 0.00 65535.00 FORMAT "%8.2" ECU_ADDRESS 0x6F8014 /end MEASUREMENT
/begin MEASUREMENT CrCtl_stShutOffFrz1_mp "latched shutoff reason" UWORD OneToOne 1 100 0.00 65535.00 FORMAT "%8.2" ECU_ADDRESS 0x6F8016 /end MEASUREMENT
/begin MEASUREMENT CrCtl_stShutOffFrz2_mp "latched shutoff reason" UWORD OneToOne 1 100 0.00 65535.00 FORMAT "%8.2" ECU_ADDRESS 0x6F8018 /end MEASUREMENT
/begin MEASUREMENT CrCtl_stShutOffFrz_mp "eingefrorener Abschaltgrund FGR" ULONG OneToOne 1 100 0.00 4294967295.00 FORMAT "%13.2" ECU_ADDRESS 0x6F801C /end MEASUREMENT
/begin MEASUREMENT CrCtl_stUpdateVMrk "Trigger zum senden der Botschaft" UBYTE OneToOne 1 100 0.00 255.0 FORMAT "%5.1" ECU_ADDRESS 0x7F883F /end MEASUREMENT
/begin MEASUREMENT CrCtl_stVCrCtl "Diagnosefreigabestatus für Anzeigegeschwindigkeit" UBYTE OneToOne 1 100 0.00 255.0 FORMAT "%5.1" ECU_ADDRESS 0x7F8840 /end MEASUREMENT
/begin MEASUREMENT CrCtl_stVDisp "Marke aus/ein" UBYTE OneToOne 1 100 0.00 255.0 FORMAT "%5.1" ECU_ADDRESS 0x7F8841 /end MEASUREMENT
/begin MEASUREMENT CrCtl_stVSetNew "neue Sollgeschwindigkeit aus Stufentempomat übernehmen" UBYTE OneToOne 1 100 0.00 255.0 FORMAT "%5.1" ECU_ADDRESS 0x7F8842 /end MEASUREMENT
/begin MEASUREMENT CrCtl_trqDes "Momentenanforderung FGR" SWORD TrqPrp 1 100 -6553.600 6553.400 FORMAT "%8.3" ECU_ADDRESS 0x7F8BC2 /end MEASUREMENT
/begin MEASUREMENT CrCtl_trqDT1_mp "DT1 Ausgang FGR" SWORD TrqPrp 1 100 -6553.600 6553.400 FORMAT "%8.3" ECU_ADDRESS 0x8FE59A /end MEASUREMENT
/begin MEASUREMENT CrCtl_trqI_mp "I-Anteil FGR" SWORD TrqPrp 1 100 -6553.600 6553.400 FORMAT "%8.3" ECU_ADDRESS 0x8FE59C /end MEASUREMENT
/begin MEASUREMENT CrCtl_trqLead "Vorhaltmoment des FGR" SWORD TrqPrp 1 100 -6553.600 6553.400 FORMAT "%8.3" ECU_ADDRESS 0x7F8BC4 /end MEASUREMENT
/begin MEASUREMENT CrCtl_trqMax_mp "Maximales Moment FGR" SWORD TrqPrp 1 100 -6553.600 6553.400 FORMAT "%8.3" ECU_ADDRESS 0x8FE59E /end MEASUREMENT
/begin MEASUREMENT CrCtl_trqP_mp "P-Anteil der Fahrgeschwindigkeits PI-Regelung" SWORD TrqPrp 1 100 -6553.600 6553.400 FORMAT "%8.3" ECU_ADDRESS 0x8FE5A0 /end MEASUREMENT
/begin MEASUREMENT CrCtl_vAlwMax "Obere Grenze für FGR-Sollgeschwindigkeit" SWORD Vel 1 100 0.00 300.0000 FORMAT "%8.4" ECU_ADDRESS 0x7F8BC6 /end MEASUREMENT
/begin MEASUREMENT CrCtl_vAlwMin "min. mögliche Setzgeschwindigkeit" SWORD Vel 1 100 0.00 300.0000 FORMAT "%8.4" ECU_ADDRESS 0x7F8BC8 /end MEASUREMENT
/begin MEASUREMENT CrCtl_vBeg "FGR: Fahrgeschwindigkeit am Anfang von EIN+, EIN- und WA" SWORD Vel 1 100 0.00 300.0000 FORMAT "%8.4" ECU_ADDRESS 0x7F8BCA /end MEASUREMENT
/begin MEASUREMENT CrCtl_vCurr "Fahrzeuggeschwindigkeit für FGR" SWORD Vel 1 100 0.00 300.0000 FORMAT "%8.4" ECU_ADDRESS 0x7F8BCC /end MEASUREMENT
/begin MEASUREMENT CrCtl_vDes "Sollgeschwindigkeit FGR" SWORD Vel 1 100 0.00 300.0000 FORMAT "%8.4" ECU_ADDRESS 0x7F8BCE /end MEASUREMENT
/begin MEASUREMENT CrCtl_vDesDisp "aktuelle Zielgeschwindigkeit STUT" SWORD Vel 1 100 0.00 300.0000 FORMAT "%8.4" ECU_ADDRESS 0x7F8BD0 /end MEASUREMENT
/begin MEASUREMENT CrCtl_vDiffRed_mp "Geschwindigkeitsdifferenz für Abflachungskennlinie" SWORD Vel 1 100 -327.6800 327.6700 FORMAT "%8.4" ECU_ADDRESS 0x8FE5A2 /end MEASUREMENT
/begin MEASUREMENT CrCtl_vDiff_mp "FGR: | CrCtl_vDes - CrCtl_vBeg |, Differenz V_SOLL und v bei Anfang EIN+, EIN- und WA" SWORD Vel 1 100 -327.6800 327.6700 FORMAT "%8.4" ECU_ADDRESS 0x8FE5A4 /end MEASUREMENT
/begin MEASUREMENT CrCtl_vDispOffset "Abweichung Anzeigegeschwindigkeit - gef. Messgeschwindigkeit" SWORD Vel 1 100 0.00 300.0000 FORMAT "%8.4" ECU_ADDRESS 0x7F8BD2 /end MEASUREMENT
/begin MEASUREMENT CrCtl_vMrk1 "v-Marke 1 für Botschaft" SWORD Vel 1 100 0.00 300.0000 FORMAT "%8.4" ECU_ADDRESS 0x7F8BD4 /end MEASUREMENT
/begin MEASUREMENT CrCtl_vMrk2 "v-Marke für 2 Botschaft" SWORD Vel 1 100 0.00 300.0000 FORMAT "%8.4" ECU_ADDRESS 0x7F8BD6 /end MEASUREMENT
/begin MEASUREMENT CrCtl_vMrk3 "v-Marke 3 für Botschaft" SWORD Vel 1 100 0.00 300.0000 FORMAT "%8.4" ECU_ADDRESS 0x7F8BD8 /end MEASUREMENT
/begin MEASUREMENT CrCtl_vRmp "Rampenzielgeschwindigkeit FGR" SWORD Vel 1 100 0.00 300.0000 FORMAT "%8.4" ECU_ADDRESS 0x7F8BDA /end MEASUREMENT
/begin MEASUREMENT CrCtl_vSetNew "neue Sollgeschwindigkeit aus Stufentempomat" SWORD Vel 1 100 0.00 300.0000 FORMAT "%8.4" ECU_ADDRESS 0x7F8BDC /end MEASUREMENT
/begin MEASUREMENT CrSCD_dSegMisf "Verschiebung Segmentsystem für Aussetzererkennung" SBYTE OneToOne 1 100 -128.0 127.0 FORMAT "%5.1" ECU_ADDRESS 0x7F8843 /end MEASUREMENT
/begin MEASUREMENT CrSCD_incNextIntDelta_mp "Anzahl der Inkrements bis zum nächsten statischen  Interrupt" SWORD OneToOne 1 100 -32768.00 32767.00 FORMAT "%8.2" ECU_ADDRESS 0x8FE5C0 /end MEASUREMENT
/begin MEASUREMENT CrSCD_incNextInt_mp "Anzahl der Inkrements bis zum nächsten statischen  Interrupt" SBYTE OneToOne 1 100 -128.0 127.0 FORMAT "%5.1" ECU_ADDRESS 0x8FE5C2 /end MEASUREMENT
/begin MEASUREMENT CrSCD_nAvrg "gemittelte Kurbelwellendrehzahl des letzten und vorletzten segmentes" SWORD EngN 1 100 -32768.00 32767.00 FORMAT "%8.2" ECU_ADDRESS 0x7F8BDE /end MEASUREMENT
/begin MEASUREMENT CrSCD_nAvrgHiRes "Gemittelte hochauflösende Drehzahl" SLONG EngN_HiRes 1 100 -268435456.000 268435455.875 FORMAT "%13.3" ECU_ADDRESS 0x7F91A4 /end MEASUREMENT
/begin MEASUREMENT CrSCD_nCurr "aktuelle Motordrehzahl aus der letzten Segmentperiode" SWORD EngN 1 100 -32768.00 32767.00 FORMAT "%8.2" ECU_ADDRESS 0x7F8BE0 /end MEASUREMENT
/begin MEASUREMENT CrSCD_nCurrHiRes "Aktuelle hochauflösende Drehzahl" SLONG EngN_HiRes 1 100 -268435456.000 268435455.875 FORMAT "%13.3" ECU_ADDRESS 0x7F91A8 /end MEASUREMENT
/begin MEASUREMENT CrSCD_nDyn "aktuelle Motordrehzahl mit Filter für Segment der Dekompressionsphase" SWORD EngN 1 100 -32768.00 32767.00 FORMAT "%8.2" ECU_ADDRESS 0x7F8BE2 /end MEASUREMENT
/begin MEASUREMENT CrSCD_nHold "aktuelle Motordrehzahl des vorletzten Segmentes" SWORD EngN 1 100 -32768.00 32767.00 FORMAT "%8.2" ECU_ADDRESS 0x7F8BE4 /end MEASUREMENT
/begin MEASUREMENT CrSCD_nIncr "Motordrehzahl aus Inkrementperiode" SWORD EngN 1 100 -32768.00 32767.00 FORMAT "%8.2" ECU_ADDRESS 0x7F8BE6 /end MEASUREMENT
/begin MEASUREMENT CrSCD_nMisf "Drehzahlsignal für ODB-Zündaussetzererkennung" SWORD EngN 1 100 -32768.00 32767.00 FORMAT "%8.2" ECU_ADDRESS 0x7F8BE8 /end MEASUREMENT
/begin MEASUREMENT CrSCD_numSeg "aktuelle Segmentnummer  (Segment 0 ist bei OT 1)" UBYTE OneToOne 1 100 0.00 255.0 FORMAT "%5.1" ECU_ADDRESS 0x7F8844 /end MEASUREMENT
/begin MEASUREMENT CrSCD_phiCurr_mp "Aktueller Winkel basierent auf dem Inkrementsystem" SWORD AngleCrS 1 100 -768.0000 767.9766 FORMAT "%8.4" ECU_ADDRESS 0x8FE5C4 /end MEASUREMENT
/begin MEASUREMENT CrSCD_phiIncCor "aktuelle Phasenkorrektur des Inkrementsystems der Kurbelwelle" SWORD AngleCrS 1 100 -768.0000 767.9766 FORMAT "%8.4" ECU_ADDRESS 0x7F8BEA /end MEASUREMENT
/begin MEASUREMENT CrSCD_phiIncr "Winkel eines Inkrements in Grad Kurbelwelle" SWORD AngleCrS 1 100 -768.0000 767.9766 FORMAT "%8.4" ECU_ADDRESS 0x7F8BEC /end MEASUREMENT
/begin MEASUREMENT CrSCD_phiSegGrid_mp "Berechnete Drehzahlsegmentlänge" SWORD AngleCrS 1 100 -768.0000 767.9766 FORMAT "%8.4" ECU_ADDRESS 0x8FE5C6 /end MEASUREMENT
/begin MEASUREMENT CrSCD_stIncErr_mp "Fehlerstatus des Inkrementgebersignals (Signalstöhrungen, Frequenzstatus, Inkrementpufferstatus)" UBYTE OneToOne 1 100 0.00 255.0 FORMAT "%5.1" ECU_ADDRESS 0x8FE5C8 /end MEASUREMENT
/begin MEASUREMENT CrSCD_stIncSig_mp "Status des Inkrementgeber Signalauswertung (Plausibilisierung der Zahnflankenzeiten und -anzahl)" UBYTE OneToOne 1 100 0.00 255.0 FORMAT "%5.1" ECU_ADDRESS 0x8FE5C9 /end MEASUREMENT
/begin MEASUREMENT CrSCD_stIncSyncInc_mp "Synchronisationsstatus des Inkrementgebersignals nach Aufruf von CrSCD_UpdPos (Intern, Debugging)" UBYTE OneToOne 1 100 0.00 255.0 FORMAT "%5.1" ECU_ADDRESS 0x8FE5CA /end MEASUREMENT
/begin MEASUREMENT CrSCD_stIncSyncPhase_mp "Synchronisationsstatus des Inkrementgebersignals nach Aufruf von CaSCD_GetPos (Intern, Debugging)" UBYTE OneToOne 1 100 0.00 255.0 FORMAT "%5.1" ECU_ADDRESS 0x8FE5CB /end MEASUREMENT
/begin MEASUREMENT CrSCD_tiIncr "aktuelle Inkrementperiode (1 Inkrement = Winkelbereich aus 360°KW/CrSCD_ctIncs_C, Abtastung = 2ms)" UWORD TimeDT 1 100 0.00 65535.00 FORMAT "%8.2" ECU_ADDRESS 0x7F8BEE /end MEASUREMENT
/begin MEASUREMENT CrSCD_tiSeg "aktuelle Segmentperiode (1 Segment = Winkelbereich der über CrSCD_phiSeg_C appliziert ist, Abtastung = n-sync.)" ULONG Per_Dur 1 100 0.00 4294967295.00 FORMAT "%13.2" ECU_ADDRESS 0x7F91AC /end MEASUREMENT
/begin MEASUREMENT CrS_ctInjStrt_mp "Anzahl der durchgeführten Testeinspritzungen" UWORD OneToOne 1 100 0.00 65535.00 FORMAT "%8.2" ECU_ADDRESS 0x8FE5AA /end MEASUREMENT
/begin MEASUREMENT CrS_facSegTime_mp "Verhältnis der Segmentzeiten" SLONG Fact1 1 100 -16777216.0000 16777215.9922 FORMAT "%13.4" ECU_ADDRESS 0x8FE5AC /end MEASUREMENT
/begin MEASUREMENT CrS_numTDCStrtLst_mp "Zeigt den Zylinder an, in den als letztes eingespritzt wurde" UWORD OneToOne 1 100 0.00 65535.00 FORMAT "%8.2" ECU_ADDRESS 0x8FE5B0 /end MEASUREMENT
/begin MEASUREMENT CrS_numTDCStrt_mp "Zeigt die Zylinder an, in die bereits eingespritzt wurde" UWORD OneToOne 1 100 0.00 65535.00 FORMAT "%8.2" ECU_ADDRESS 0x8FE5B2 /end MEASUREMENT
/begin MEASUREMENT CrS_stStrt_mp "Messpunkt für Zustandsautomat" UBYTE OneToOne 1 100 0.00 255.0 FORMAT "%5.1" ECU_ADDRESS 0x8FE5B4 /end MEASUREMENT
/begin MEASUREMENT CrS_tiSegOld_mp "Segmentzeit vor einer Testeinspritzung" SLONG Per_Dur 1 100 -2147483648.00 2147483647.00 FORMAT "%13.2" ECU_ADDRESS 0x8FE5B8 /end MEASUREMENT
/begin MEASUREMENT CrS_tiSeg_mp "Segmentzeit nach einer Testeinspritzung" SLONG Per_Dur 1 100 -2147483648.00 2147483647.00 FORMAT "%13.2" ECU_ADDRESS 0x8FE5BC /end MEASUREMENT
/begin MEASUREMENT ctblink "Zeitzähler für Blinken der Markenanzeige" UBYTE t20msxs_ub_b5p1 1 100 0.00 5.100 FORMAT "%5.3" ECU_ADDRESS 0x7F89E5 /end MEASUREMENT
/begin MEASUREMENT CTSCD_dtClnt "Wechselrate der Kuehlwassertemperatur" SWORD TempCels_100ms 1 100 -32768.00 32767.00 FORMAT "%8.2" ECU_ADDRESS 0x7F8AFE /end MEASUREMENT
/begin MEASUREMENT CTSCD_stErrIni "Fehlerstatus ADC Kanal Kühlwassertemperatur während SG-Hochlauf" UBYTE OneToOne 1 100 0.00 255.0 FORMAT "%5.1" ECU_ADDRESS 0x7F87FB /end MEASUREMENT
/begin MEASUREMENT CTSCD_stPHtr "Heater Temperature status" UBYTE OneToOne 1 100 0.00 255.0 FORMAT "%5.1" ECU_ADDRESS 0x7F87FC /end MEASUREMENT
/begin MEASUREMENT CTSCD_stRmp_mp "Zustandsinformation aktiver Rampensteigungsparametersatz" UBYTE OneToOne 1 100 0.00 255.0 FORMAT "%5.1" ECU_ADDRESS 0x8FE5CC /end MEASUREMENT
/begin MEASUREMENT CTSCD_swtSig "Wassertemperatur über CAN oder ADC" UBYTE OneToOne 1 100 0.00 255.0 FORMAT "%5.1" ECU_ADDRESS 0x7F87FD /end MEASUREMENT
/begin MEASUREMENT CTSCD_tClnt "Kühlmitteltemperatur" SWORD Temp_Cels 1 100 -50.140 899.860 FORMAT "%8.3" ECU_ADDRESS 0x7F8B00 /end MEASUREMENT
/begin MEASUREMENT CTSCD_tClntLin "linearisierter Wert aus HWK vorm Aufruf der Übergangsfunktion" SWORD Temp_Cels 1 100 -50.140 899.860 FORMAT "%8.3" ECU_ADDRESS 0x7F8B02 /end MEASUREMENT
/begin MEASUREMENT CTSCD_tClntP "Coolant Temperature Before correction" SWORD Temp_Cels 1 100 -50.140 899.860 FORMAT "%8.3" ECU_ADDRESS 0x7F8B04 /end MEASUREMENT
/begin MEASUREMENT CTSCD_uRaw "Wassertemperatur Spannungsrohwert" SWORD Volt 1 100 -160156.4 160151.5 FORMAT "%8.1" ECU_ADDRESS 0x7F8B06 /end MEASUREMENT
/begin MEASUREMENT CycSigCheck_stTest "" UBYTE OneToOne 1 100 0.00 255.0 FORMAT "%5.1" ECU_ADDRESS 0x7F8845 /end MEASUREMENT
/begin MEASUREMENT DCC_nDvthires_mp "Regelabweichung Drehzahlregelung DCC mit höhere Auflösung" SWORD EngN_HiRes 1 100 -4096.000 4095.875 FORMAT "%8.3" ECU_ADDRESS 0x8FE5CE /end MEASUREMENT
/begin MEASUREMENT DCC_nDvt_mp "Regelabweichung Drehzahlregelung DCC" SWORD EngN 1 100 -32768.00 32767.00 FORMAT "%8.2" ECU_ADDRESS 0x8FE5D0 /end MEASUREMENT
/begin MEASUREMENT DCC_nSetPointRaw_mp "Roherwert Sollwert Drehzahlregelung DCC" SWORD EngN 1 100 -32768.00 32767.00 FORMAT "%8.2" ECU_ADDRESS 0x8FE5D2 /end MEASUREMENT
/begin MEASUREMENT DCC_nSetPoint_mp "Sollwert Drehzahlregelung DCC" SWORD EngN 1 100 -32768.00 32767.00 FORMAT "%8.2" ECU_ADDRESS 0x8FE5D4 /end MEASUREMENT
/begin MEASUREMENT DCC_nShft_mp "Motordrehzahl freezed während der Gangschaltungen" SWORD EngN 1 100 -32768.00 32767.00 FORMAT "%8.2" ECU_ADDRESS 0x8FE5D6 /end MEASUREMENT
/begin MEASUREMENT DCC_nWheel_mp "Fahrzeugraddrehzahl" SWORD WheelN 1 100 -32768.00 32767.00 FORMAT "%8.2" ECU_ADDRESS 0x8FE5D8 /end MEASUREMENT
/begin MEASUREMENT DCC_rTransDTNext_mp "Uebersetzungverhaeltnis des wahrscheinlichen Zielganges" SWORD TransR 1 100 -327.6800 327.6700 FORMAT "%8.4" ECU_ADDRESS 0x8FE5DA /end MEASUREMENT
/begin MEASUREMENT DCC_stAckEngDCC "Status Quittierung Antreibstrang" UBYTE OneToOne 1 100 0.00 255.0 FORMAT "%5.1" ECU_ADDRESS 0x7F8846 /end MEASUREMENT
/begin MEASUREMENT DCC_stActive "Radmoment-Anforderung aktiv" UBYTE OneToOne 1 100 0.00 255.0 FORMAT "%5.1" ECU_ADDRESS 0x7F8847 /end MEASUREMENT
/begin MEASUREMENT DCC_stBrkPressed_mp "Status der Bremse" UBYTE OneToOne 1 100 0.00 255.0 FORMAT "%5.1" ECU_ADDRESS 0x8FE5DC /end MEASUREMENT
/begin MEASUREMENT DCC_stCtlVel "Status regelung Geschwindigkeit" UBYTE OneToOne 1 100 0.00 255.0 FORMAT "%5.1" ECU_ADDRESS 0x7F8848 /end MEASUREMENT
/begin MEASUREMENT DCC_stDCC "Zustandautomat DCC" UBYTE OneToOne 1 100 0.00 255.0 FORMAT "%5.1" ECU_ADDRESS 0x7F8849 /end MEASUREMENT
/begin MEASUREMENT DCC_stError "Fehlerzustand in DCC" UBYTE OneToOne 1 100 0.00 255.0 FORMAT "%5.1" ECU_ADDRESS 0x7F884A /end MEASUREMENT
/begin MEASUREMENT DCC_stGearNext_mp "Wahrscheinlicher Zielgang" SBYTE OneToOne 1 100 -128.0 127.0 FORMAT "%5.1" ECU_ADDRESS 0x8FE5DD /end MEASUREMENT
/begin MEASUREMENT DCC_stGearOld_mp "Eingelegter Gang vor grip Verlust" SBYTE OneToOne 1 100 -128.0 127.0 FORMAT "%5.1" ECU_ADDRESS 0x8FE5DE /end MEASUREMENT
/begin MEASUREMENT DCC_stRecDCC "Status ob DCC im fahrzeug verbaut ist" UBYTE OneToOne 1 100 0.00 255.0 FORMAT "%5.1" ECU_ADDRESS 0x7F884B /end MEASUREMENT
/begin MEASUREMENT DCC_stRls "Status freigabe DCC Eingriff" UBYTE OneToOne 1 100 0.00 255.0 FORMAT "%5.1" ECU_ADDRESS 0x7F884C /end MEASUREMENT
/begin MEASUREMENT DCC_stRlsMT_mp "Status freigabe DCC Eingriff fuer Handschalter" UBYTE OneToOne 1 100 0.00 255.0 FORMAT "%5.1" ECU_ADDRESS 0x8FE5DF /end MEASUREMENT
/begin MEASUREMENT DCC_swtPosAT_mp "Rampenschalterstellung Automatik" UBYTE OneToOne 1 100 0.00 255.0 FORMAT "%5.1" ECU_ADDRESS 0x8FE5E0 /end MEASUREMENT
/begin MEASUREMENT DCC_swtPosBrk_mp "Rampenschalterstellung im Ueberwachung des DCC-Moment" UBYTE OneToOne 1 100 0.00 255.0 FORMAT "%5.1" ECU_ADDRESS 0x8FE5E1 /end MEASUREMENT
/begin MEASUREMENT DCC_swtPosES_mp "Rampenschalterstellung drehzahlregelung" UBYTE OneToOne 1 100 0.00 255.0 FORMAT "%5.1" ECU_ADDRESS 0x8FE5E2 /end MEASUREMENT
/begin MEASUREMENT DCC_swtPosMT_mp "Rampenschalterstellung Handschalter" UBYTE OneToOne 1 100 0.00 255.0 FORMAT "%5.1" ECU_ADDRESS 0x8FE5E3 /end MEASUREMENT
/begin MEASUREMENT DCC_trqDes "Wunschmoment DCC" SWORD TrqPrp 1 100 -6553.600 6553.400 FORMAT "%8.3" ECU_ADDRESS 0x7F8BF0 /end MEASUREMENT
/begin MEASUREMENT DCC_trqDesDCCFlt_mp "PT1 gefilterter Werte Moment-Anforderung ueber Can" SWORD TrqPrp 1 100 -6553.600 6553.400 FORMAT "%8.3" ECU_ADDRESS 0x8FE5E4 /end MEASUREMENT
/begin MEASUREMENT DCC_trqDesDCCMT_mp "DCC Wunschmoment fuer Handschalter" SWORD TrqPrp 1 100 -6553.600 6553.400 FORMAT "%8.3" ECU_ADDRESS 0x8FE5E6 /end MEASUREMENT
/begin MEASUREMENT DCC_trqEngSpdRaw_mp "Drehmoment Drehzahlregler - Rohwert" SWORD Trq 1 100 -3276.800 3276.700 FORMAT "%8.3" ECU_ADDRESS 0x8FE5E8 /end MEASUREMENT
/begin MEASUREMENT DCC_trqEngSpd_mp "Drehmoment Drehzahlregler" SWORD TrqPrp 1 100 -6553.600 6553.400 FORMAT "%8.3" ECU_ADDRESS 0x8FE5EA /end MEASUREMENT
/begin MEASUREMENT DCC_trqIEngSpd_mp "I-Anteil Drehzahlregler" SWORD Trq 1 100 -3276.800 3276.700 FORMAT "%8.3" ECU_ADDRESS 0x8FE5EC /end MEASUREMENT
/begin MEASUREMENT DCC_trqIInit_mp "Initialisierungswert fuer Motordrehzahlregler" SWORD Trq 1 100 -3276.800 3276.700 FORMAT "%8.3" ECU_ADDRESS 0x8FE5EE /end MEASUREMENT
/begin MEASUREMENT DCC_trqPEngSpd_mp "P-Anteil Drehzahlregler" SWORD Trq 1 100 -3276.800 3276.700 FORMAT "%8.3" ECU_ADDRESS 0x8FE5F0 /end MEASUREMENT
/begin MEASUREMENT DCC_trqRaw "Rohwert Radmoment" SWORD TrqPrp 1 100 -6553.600 6553.400 FORMAT "%8.3" ECU_ADDRESS 0x7F8BF2 /end MEASUREMENT
/begin MEASUREMENT DCC_trqRaw_mp "Rohwert Radmoment" SWORD TrqPrp 1 100 -6553.600 6553.400 FORMAT "%8.3" ECU_ADDRESS 0x8FE5F2 /end MEASUREMENT
/begin MEASUREMENT DCC_trqsaveStI_mp "Vorhergehender Wert des I-Zustandes des Motordrehzahlreglers" SWORD Trq 1 100 -3276.800 3276.700 FORMAT "%8.3" ECU_ADDRESS 0x8FE5F4 /end MEASUREMENT
/begin MEASUREMENT DCC_trqShft_mp "Drehmoment zur Initialisierung des Drehzahl Reglers" SWORD Trq 1 100 -3276.800 3276.700 FORMAT "%8.3" ECU_ADDRESS 0x8FE5F6 /end MEASUREMENT
/begin MEASUREMENT DCC_trqStI_mp "Anwesender Wert des I-Zustandes des Motordrehzahlreglers" SWORD Trq 1 100 -3276.800 3276.700 FORMAT "%8.3" ECU_ADDRESS 0x8FE5F8 /end MEASUREMENT
/begin MEASUREMENT DCC_vConv_mp "Fahrgeschwindigkeit (metres/min)" SLONG Vel_mpm 1 100 -21474836.4800 21474836.4700 FORMAT "%13.4" ECU_ADDRESS 0x8FE5FC /end MEASUREMENT
/begin MEASUREMENT DrvTrn_rFlatTransDT "Zugverhältnis für flache Drehkraftstruktur fahren" SWORD TransR 1 100 -327.6800 327.6700 FORMAT "%8.4" ECU_ADDRESS 0x7F8C00 /end MEASUREMENT
/begin MEASUREMENT DrvTrn_rTransDT "Triebstrang-Übersetzung (Radmoment pro Motormoment)" SWORD TransR 1 100 -327.6800 327.6700 FORMAT "%8.4" ECU_ADDRESS 0x7F8C02 /end MEASUREMENT
/begin MEASUREMENT DrvTrn_rTransDTact_mp "aktueller Wert der Triebstrangübersetzung" SWORD TransR 1 100 -327.6800 327.6700 FORMAT "%8.4" ECU_ADDRESS 0x8FE600 /end MEASUREMENT
/begin MEASUREMENT DrvTrn_rTransDTRmpIn_mp "Input to the ramp for delaying torque requests" SWORD TransR 1 100 -327.6800 327.6700 FORMAT "%8.4" ECU_ADDRESS 0x8FE602 /end MEASUREMENT
/begin MEASUREMENT DSC_stTstTrigger_mp "Zustand Testeranforderung an DSM Scheduler" UBYTE OneToOne 1 100 0.00 255.0 FORMAT "%5.1" ECU_ADDRESS 0x8FE604 /end MEASUREMENT
/begin MEASUREMENT DSMDur_ctDfctDur1 "Wert Fehlerdauerzähler" UWORD OneToOne 1 100 0.00 65535.00 FORMAT "%8.2" ECU_ADDRESS 0x7F8BF4 /end MEASUREMENT
/begin MEASUREMENT DSMDur_ctDfctDur2 "Wert Fehlerdauerzähler 2" UWORD OneToOne 1 100 0.00 65535.00 FORMAT "%8.2" ECU_ADDRESS 0x7F8BF6 /end MEASUREMENT
/begin MEASUREMENT DSMDur_stGlobalDefCnt_mp "Aktivierungs und Resetzustand der beiden globalen Fehlerdauerzähler" UBYTE OneToOne 1 100 0.00 255.0 FORMAT "%5.1" ECU_ADDRESS 0x6F808C /end MEASUREMENT
/begin MEASUREMENT dvmark_w "Mindestabstand von Geschwindigkeitsmarken beim Stufentempomat" UWORD Vel 1 100 0.00 655.3500 FORMAT "%8.4" ECU_ADDRESS 0x7F912C /end MEASUREMENT
/begin MEASUREMENT dvprg_w "Schrittweite bei Anzeige der Regelgeschwindigkeit im Programmiermodus" UWORD Vel 1 100 0.00 655.3500 FORMAT "%8.4" ECU_ADDRESS 0x7F912E /end MEASUREMENT
/begin MEASUREMENT dvstutom_w "Schrittweite für Verstellung der Zielgeschwindigkeit ohne programmierte Marken" UWORD Vel 1 100 0.00 655.3500 FORMAT "%8.4" ECU_ADDRESS 0x7F9130 /end MEASUREMENT
/begin MEASUREMENT indexmrst "Index für vmrki..." UBYTE dez 1 100 0.00 255.0 FORMAT "%5.1" ECU_ADDRESS 0x7F89E6 /end MEASUREMENT
/begin MEASUREMENT mmimrk_w "ported from ME9" UWORD Vel 1 100 0.00 655.3500 FORMAT "%8.4" ARRAY_SIZE 15 ECU_ADDRESS 0x7F94D0 /end MEASUREMENT
/begin MEASUREMENT mrknrc "Nummer veränderte Geschwindigkeits-Marke für schnelle CAN- Übertragung" UBYTE dez 1 100 0.00 255.0 FORMAT "%5.1" ECU_ADDRESS 0x7F89E7 /end MEASUREMENT
/begin MEASUREMENT mrknrcan "Nummer Geschwindigkeits-Marken Stufentempomat f ür CAN- Übertragung" UBYTE dez 1 100 0.00 255.0 FORMAT "%5.1" ARRAY_SIZE 15 ECU_ADDRESS 0x7F9482 /end MEASUREMENT
/begin MEASUREMENT mrknrint "Nummer Geschwindigkeits-Marken Stufentempomat intern" UBYTE dez 1 100 0.00 255.0 FORMAT "%5.1" ARRAY_SIZE 15 ECU_ADDRESS 0x7F9491 /end MEASUREMENT
/begin MEASUREMENT mrkstut_w "Geschwindigkeits-Marken Stufentempomat" UWORD Vel 1 100 0.00 655.3500 FORMAT "%8.4" ARRAY_SIZE 15 ECU_ADDRESS 0x7F94EE /end MEASUREMENT
/begin MEASUREMENT statvza "Status Zielgeschwindigkeit für Kombi-Anzeige Stufentempomat" UBYTE dez 1 100 0.00 255.0 FORMAT "%5.1" ECU_ADDRESS 0x7F89EC /end MEASUREMENT
/begin MEASUREMENT tnomgs60ms "Zeit in der keine CAN-Botschaft G_T versendet wurde" UBYTE t20msxs_ub_b5p1 1 100 0.00 5.100 FORMAT "%5.3" ECU_ADDRESS 0x7F89ED /end MEASUREMENT
/begin MEASUREMENT vfgr_w "Fahrzeug-Ist-Geschwindigkeit für FGR" UWORD Vel 1 100 0.00 655.3500 FORMAT "%8.4" ECU_ADDRESS 0x7F9134 /end MEASUREMENT
/begin MEASUREMENT vmrki1_w "v-Marke 1 für Botschaft" UWORD Vel 1 100 0.00 655.3500 FORMAT "%8.4" ECU_ADDRESS 0x7F9136 /end MEASUREMENT
/begin MEASUREMENT vmrki2_w "v-Marke 2 für Botschaft" UWORD Vel 1 100 0.00 655.3500 FORMAT "%8.4" ECU_ADDRESS 0x7F9138 /end MEASUREMENT
/begin MEASUREMENT vmrki3_w "v-Marke 3 für Botschaft" UWORD Vel 1 100 0.00 655.3500 FORMAT "%8.4" ECU_ADDRESS 0x7F913A /end MEASUREMENT
/begin MEASUREMENT vreglmax_w "Maximal zulässige Sollgeschwindigkeit für FGR" UWORD Vel 1 100 0.00 655.3500 FORMAT "%8.4" ECU_ADDRESS 0x7F913C /end MEASUREMENT
/begin MEASUREMENT vreglmin_w "minimal zulässige Sollgeschwindigkeit für FGR" UWORD Vel 1 100 0.00 655.3500 FORMAT "%8.4" ECU_ADDRESS 0x7F913E /end MEASUREMENT
/begin MEASUREMENT vzielakvp_w "Variable für Zielgeschwindigkeit im Kombi" UWORD Vel 1 100 0.00 655.3500 FORMAT "%8.4" ECU_ADDRESS 0x7F9144 /end MEASUREMENT
/begin MEASUREMENT vzielak_w "Zielgeschwindigkeit für Kombi-Anzeige Stufentempomat" UWORD Vel 1 100 0.00 655.3500 FORMAT "%8.4" ECU_ADDRESS 0x7F9142 /end MEASUREMENT
/begin MEASUREMENT vziels_w "Berechnete Soll-Zielgeschwindigkeit für FGR" UWORD Vel 1 100 0.00 655.3500 FORMAT "%8.4" ECU_ADDRESS 0x7F9146 /end MEASUREMENT
/begin MEASUREMENT vziel_w "Zielgeschwindigkeit für FGR" UWORD Vel 1 100 0.00 655.3500 FORMAT "%8.4" ECU_ADDRESS 0x7F9140 /end MEASUREMENT
/begin FUNCTION airctl_governor_var_uic ""
 /begin OUT_MEASUREMENT AirCtl_facNQParRgn_mp AirCtl_facPresDiffCor_mp AirCtl_rEGRNrmRgn2_mp AirCtl_rEGRNrmRgn_mp AirCtl_rEGRRgnNrm2_mp AirCtl_rEGRRgnNrm_mp AirCtl_rEGRRgnVal2_mp AirCtl_rEGRRgnVal_mp AirCtl_rGvnrCalc2_mp AirCtl_rGvnrCalc_mp AirCtl_rRgnBgnInit2_mp AirCtl_rRgnBgnInit_mp AirCtl_rRgnEndInit2_mp AirCtl_rRgnEndInit_mp AirCtl_rTVACtlAPSCor_mp AirCtl_rTVACtlATCor_mp AirCtl_rTVACtlBas_mp AirCtl_rTVACtlCTCor_mp AirCtl_rTVACtl_mp AirCtl_rTVARgnVal2_mp AirCtl_rTVARgnVal_mp AirCtl_stRgnDes_mp /end OUT_MEASUREMENT
/end FUNCTION
/begin FUNCTION airctl_monitor "Abgasrückführregelung - Überwachung und Abschaltung" /begin DEF_CHARACTERISTIC /end DEF_CHARACTERISTIC /begin IN_MEASUREMENT CTSCD_tClnt Eng_nAvrg InjCtl_qCurrCor /end IN_MEASUREMENT /end FUNCTION
/begin FUNCTION airctl_monitor_msg ""
 /begin OUT_MEASUREMENT AirCtl_mMaxDvt AirCtl_mMinDvt AirCtl_rEGR AirCtl_rEGR2 AirCtl_rGvnrDvtNrm AirCtl_rTVA AirCtl_rTVA2 AirCtl_stAirCtl AirCtl_stAirCtlBits AirCtl_stMonitor /end OUT_MEASUREMENT
/end FUNCTION
/begin FUNCTION airctl_monitor_uic "" /begin DEF_CHARACTERISTIC /end DEF_CHARACTERISTIC
 /begin OUT_MEASUREMENT AirCtl_dnAvrg_mp AirCtl_dnSurgeHigh_mp AirCtl_dnSurgeLow_mp AirCtl_dqRaw_mp AirCtl_mDesMax_mp AirCtl_qCurrRmp_mp AirCtl_qSurgeHigh_mp AirCtl_qSurgeLow_mp AirCtl_rBrkRmp_mp AirCtl_rEGRByp_mp AirCtl_rTVAByp_mp AirCtl_stAirCtlBits1_mp AirCtl_stAirCtlBits2_mp AirCtl_stAirCtlBits_mp AirCtl_stDebBrkpressed_mp AirCtl_stDebDef_mp AirCtl_stDesChk_mp AirCtl_stGearShiftHighLoad_mp AirCtl_stHealDef_mp AirCtl_stPlateBreak_mp AirCtl_tiStrtDel_mp /end OUT_MEASUREMENT
/end FUNCTION
/begin FUNCTION airctl_monitor_var "" /begin DEF_CHARACTERISTIC /end DEF_CHARACTERISTIC /begin IN_MEASUREMENT Eng_nAvrg InjCtl_qCurrCor /end IN_MEASUREMENT /end FUNCTION
/begin FUNCTION airctl_monitor_var_msg "" /end FUNCTION
/begin FUNCTION airctl_monitor_var_uic ""
 /begin OUT_MEASUREMENT AirCtl_mMaxDvtRgn_mp AirCtl_mMinDvtRgn_mp AirCtl_stDebDefNrm_mp AirCtl_stDebDefRgn_mp /end OUT_MEASUREMENT
/end FUNCTION
/begin FUNCTION airsys_cocmpntactv "Endstufenabschaltungskoordinator Luftsystem" /end FUNCTION
/begin FUNCTION airsys_cocmpntactv_msg "" /begin OUT_MEASUREMENT AirSys_stCmpntActv /end OUT_MEASUREMENT /end FUNCTION
/begin FUNCTION airsys_cocmpntactv_uic "" /end FUNCTION
/begin FUNCTION airsys_cotstdem_msg "" /begin OUT_MEASUREMENT AirSys_stTstDem /end OUT_MEASUREMENT /end FUNCTION
/begin FUNCTION alt "Generator" /begin DEF_CHARACTERISTIC /end DEF_CHARACTERISTIC /begin IN_MEASUREMENT Alt_n_mp /end IN_MEASUREMENT /end FUNCTION
/begin FUNCTION altcd "Komponententreiber Generator" /begin DEF_CHARACTERISTIC /end DEF_CHARACTERISTIC /begin IN_MEASUREMENT AltCD_dcycAltLdPT1_mp /end IN_MEASUREMENT /end FUNCTION
/begin FUNCTION altcd_msg ""
 /begin OUT_MEASUREMENT AltCD_ctPosPins AltCD_dcycAltLoad AltCD_rAltLoad AltCD_stErrAlt AltCD_stErrSig AltCD_stGenManuFak AltCD_stGenTypKenn AltCD_uAlt /end OUT_MEASUREMENT
/end FUNCTION
/begin FUNCTION altcd_uic ""
 /begin OUT_MEASUREMENT AltCD_dcycAltLdPT1_mp AltCD_stAltCtl_mp AltCD_stErrSigDeb_mp AltCD_stLROff_mp AltCD_stSRCdis_mp AltCD_tiLR_mp AltCD_uAlt_mp /end OUT_MEASUREMENT
/end FUNCTION
/begin FUNCTION alt_msg "" /begin OUT_MEASUREMENT Alt_pwrDes Alt_pwrLead /end OUT_MEASUREMENT /end FUNCTION
/begin FUNCTION alt_uic "" /begin DEF_CHARACTERISTIC /end DEF_CHARACTERISTIC /begin OUT_MEASUREMENT Alt_n_mp Alt_pwrUnCor_mp Alt_rAdjVal_mp /end OUT_MEASUREMENT /end FUNCTION
/begin FUNCTION alt_var "" /end FUNCTION
/begin FUNCTION alt_var_uic "" /end FUNCTION
/begin FUNCTION aoht "Zuheizer" /begin DEF_CHARACTERISTIC /end DEF_CHARACTERISTIC /begin IN_MEASUREMENT Eng_nAvrg FrmMng_tEnv /end IN_MEASUREMENT /end FUNCTION
/begin FUNCTION aohtcd "Zuheizer Komponententreiber" /begin DEF_CHARACTERISTIC /end DEF_CHARACTERISTIC /end FUNCTION
/begin FUNCTION aohtcd_msg "" /begin OUT_MEASUREMENT AOHtCD_stHtgReq /end OUT_MEASUREMENT /end FUNCTION
/begin FUNCTION aohtcd_uic "" /begin OUT_MEASUREMENT AOHtCD_rOut_mp /end OUT_MEASUREMENT /end FUNCTION
/begin FUNCTION aoht_msg "" /begin OUT_MEASUREMENT AOHt_nMin AOHt_rHtgOut AOHt_stHtgUp /end OUT_MEASUREMENT /end FUNCTION
/begin FUNCTION aoht_uic "" /begin DEF_CHARACTERISTIC /end DEF_CHARACTERISTIC
 /begin OUT_MEASUREMENT AOHt_rAltLd_mp AOHt_rIGov_mp AOHt_rNAvrgDeb_mp AOHt_rNAvrg_mp AOHt_rPGov_mp AOHt_rPI_mp AOHt_stAC_mp AOHt_stDA_mp AOHt_stShutOff_mp AOHt_tEnvLin_mp /end OUT_MEASUREMENT
/end FUNCTION
/begin FUNCTION appcd "Fahrpedal Komponententreiber" /begin DEF_CHARACTERISTIC /end DEF_CHARACTERISTIC /begin IN_MEASUREMENT APPCD_uRawAPP1 APPCD_uRaw_mp /end IN_MEASUREMENT /end FUNCTION
/begin FUNCTION appcd_msg ""
 /begin OUT_MEASUREMENT APPCD_drAPP1UnFlt APPCD_rAPP1UnFlt APPCD_rFlt APPCD_rNextThr APPCD_stKickDown APPCD_stLimp APPCD_stPos APPCD_stSigSrc APPCD_uRawAPP1 APPCD_uRawAPP2 /end OUT_MEASUREMENT
/end FUNCTION
/begin FUNCTION appcd_uic ""
 /begin OUT_MEASUREMENT APPCD_rFlt_mp APPCD_rStepLim_mp APPCD_stAPP12def_mp APPCD_stErr1_mp APPCD_stTempErr_mp APPCD_stTempHeal_mp APPCD_uAPPunJit_mp APPCD_uDiffMax_mp APPCD_uRawAPP1half_mp APPCD_uRawAPP2dbl_mp APPCD_uRawDiff_mp APPCD_uRaw_mp /end OUT_MEASUREMENT
/end FUNCTION
/begin FUNCTION applib "" /end FUNCTION
/begin FUNCTION apscd "Atmosphärendruckfühler Komponententreiber" /begin DEF_CHARACTERISTIC /end DEF_CHARACTERISTIC /begin IN_MEASUREMENT APSCD_uRaw Eng_dnAvrg Eng_nAvrg /end IN_MEASUREMENT /end FUNCTION
/begin FUNCTION apscd_msg ""
 /begin OUT_MEASUREMENT APSCD_pLinVal APSCD_pSensorVal APSCD_pVal APSCD_stSensorInst APSCD_swtSig APSCD_uRaw /end OUT_MEASUREMENT
/end FUNCTION
/begin FUNCTION apscd_uic "" /begin OUT_MEASUREMENT APSCD_BpsAllowed_mp APSCD_pCorVal_mp APSCD_pPhyVal_mp /end OUT_MEASUREMENT /end FUNCTION
/begin FUNCTION apscd_variant "" /end FUNCTION
/begin FUNCTION ars_detarspwr "Calculation of desired and the lead power of ARS" /begin DEF_CHARACTERISTIC /end DEF_CHARACTERISTIC /begin IN_MEASUREMENT FrmMng_aSide VSSCD_v /end IN_MEASUREMENT /end FUNCTION
/begin FUNCTION ars_detarspwr_msg "" /begin OUT_MEASUREMENT ARS_pwrDes ARS_pwrLead ARS_st ARS_stRecARS /end OUT_MEASUREMENT /end FUNCTION
/begin FUNCTION ars_detarspwr_uic ""
 /begin OUT_MEASUREMENT ARS_trqCor_mp ARS_trqCurMax_mp ARS_trqDesMax_mp ARS_trqDesOld_mp ARS_trqDes_mp /end OUT_MEASUREMENT
/end FUNCTION
/begin FUNCTION asddc "Aktive Ruckeldämpfung Störgrößenregler (ARD)" /begin DEF_CHARACTERISTIC /end DEF_CHARACTERISTIC /begin IN_MEASUREMENT ASDdc_nAvrg_mp DrvTrn_rTransDT /end IN_MEASUREMENT /begin OUT_MEASUREMENT ASDdc_KdCurr_mp ASDdc_T1Curr_mp /end OUT_MEASUREMENT /end FUNCTION
/begin FUNCTION asddc_msg "" /begin OUT_MEASUREMENT ASDdc_trq /end OUT_MEASUREMENT /end FUNCTION
/begin FUNCTION asddc_uic "" /begin DEF_CHARACTERISTIC /end DEF_CHARACTERISTIC
 /begin OUT_MEASUREMENT ASDdc_nAvrg_mp ASDdc_stCluPS_mp ASDdc_stCond_mp ASDdc_stPrioState_mp ASDdc_stREinit_mp ASDdc_stSelectState_mp ASDdc_stStates_mp /end OUT_MEASUREMENT
/end FUNCTION
/begin FUNCTION asddc_var "" /begin DEF_CHARACTERISTIC /end DEF_CHARACTERISTIC /begin IN_MEASUREMENT ASDdc_nAvrg_mp DrvTrn_rTransDT /end IN_MEASUREMENT /end FUNCTION
/begin FUNCTION asddc_var_uic "" /end FUNCTION
/begin FUNCTION asdrf_governor "ARD-Regelalgoithmus, Führungsformer" /begin DEF_CHARACTERISTIC /end DEF_CHARACTERISTIC /begin IN_MEASUREMENT ASDrf_dtrqInrLtd_mp /end IN_MEASUREMENT /end FUNCTION
/begin FUNCTION asdrf_governor_msg "" /begin OUT_MEASUREMENT ASDrf_stLAD ASDrf_trqInr /end OUT_MEASUREMENT /end FUNCTION
/begin FUNCTION asdrf_governor_uic "" /begin DEF_CHARACTERISTIC /end DEF_CHARACTERISTIC
 /begin OUT_MEASUREMENT ASDrf_CoeffALossCurr_mp ASDrf_CoeffBLossCurr_mp ASDrf_dtrqDecMax_mp ASDrf_dtrqDecMin_mp ASDrf_dtrqInrLtd_mp ASDrf_dtrqLim_mp ASDrf_dtrqLossMax_mp ASDrf_dtrqLossMin_mp ASDrf_dtrqMax_mp ASDrf_dtrqMin_mp ASDrf_KdCurr_mp ASDrf_stDecLimState_mp ASDrf_stIncLim_mp ASDrf_stInitdtrqSteep_mp ASDrf_stPosNeg_mp ASDrf_stTrqLim_mp ASDrf_T1Curr_mp ASDrf_trqASDSum_mp ASDrf_trqCompOfs_mp ASDrf_trqDecLimStrt_mp ASDrf_trqInit_mp ASDrf_trqInrLtdFlt_mp ASDrf_trqInrMaxUnLim_mp ASDrf_trqInrMax_mp ASDrf_trqInrMinUnLim_mp ASDrf_trqInrMin_mp ASDrf_trqInrUnLim_mp ASDrf_trqLoss_mp ASDrf_trqPT1In_mp ASDrf_trqPT1Out_mp ASDrf_trqPT1P_mp ASDrf_trqP_mp ASDrf_trqStyHigh_mp ASDrf_trqStyLow_mp /end OUT_MEASUREMENT
/end FUNCTION
/begin FUNCTION asdrf_selectparameter "Parametersatzauswahl ARD Führungsformer" /begin DEF_CHARACTERISTIC /end DEF_CHARACTERISTIC /begin IN_MEASUREMENT Eng_nAvrg /end IN_MEASUREMENT /begin OUT_MEASUREMENT ASDrf_stInit /end OUT_MEASUREMENT /end FUNCTION
/begin FUNCTION asdrf_selectparameter_msg "" /begin OUT_MEASUREMENT ASDrf_trqLossNeg ASDrf_trqLossPos /end OUT_MEASUREMENT /end FUNCTION
/begin FUNCTION asdrf_selectparameter_uic ""
 /begin OUT_MEASUREMENT ASDrf_stCond_mp ASDrf_stPrioState_mp ASDrf_stSelectState_mp ASDrf_stStates_mp /end OUT_MEASUREMENT
/end FUNCTION
/begin FUNCTION asdrf_selectparameter_var "" /begin DEF_CHARACTERISTIC /end DEF_CHARACTERISTIC /begin IN_MEASUREMENT DrvTrn_rTransDT /end IN_MEASUREMENT /end FUNCTION
/begin FUNCTION asmod_co "interface coordinator" /end FUNCTION
/begin FUNCTION asmod_co_msg "" /begin OUT_MEASUREMENT ASMod_facAMCor ASMod_qCor ASMod_rRelPosVSA /end OUT_MEASUREMENT /end FUNCTION
/begin FUNCTION asmod_co_uic "" /end FUNCTION
/begin FUNCTION asmod_detcylch "Füllungserfassung" /end FUNCTION
/begin FUNCTION asmod_detcylch_msg ""
 /begin OUT_MEASUREMENT ASMod_dmExhMnfPst ASMod_dmIndAir ASMod_dmO2IndAir ASMod_rLmbdRecExhMnfPst ASMod_tIndAir /end OUT_MEASUREMENT
/end FUNCTION
/begin FUNCTION asmod_detcylch_uic ""
 /begin OUT_MEASUREMENT ASMod_dmEGR_mp ASMod_dmIndAir_mp ASMod_rO2ExhMnfPst_mp ASMod_rO2IndAir_mp ASMod_tExhMnfPst_mp /end OUT_MEASUREMENT
/end FUNCTION
/begin FUNCTION asmod_eng "Motor" /begin DEF_CHARACTERISTIC /end DEF_CHARACTERISTIC
 /begin IN_MEASUREMENT ASMod_qBurned_mp ASMod_qLmbdCtlCorr_mp ASMod_rDMIndAir_mp ASMod_tEngCorTDiff_mp Eng_nAvrg InjCrv_phiMI1Des /end IN_MEASUREMENT
/end FUNCTION
/begin FUNCTION asmod_eng_msg ""
 /begin OUT_MEASUREMENT ASMod_dmExhMnfPre ASMod_rLmbdRecEG ASMod_rO2ExhMnfPre ASMod_tExhMnfPre /end OUT_MEASUREMENT
/end FUNCTION
/begin FUNCTION asmod_eng_uic ""
 /begin OUT_MEASUREMENT ASMod_dmEG_mp ASMod_dmFlBurned_mp ASMod_dmFlPerTime_mp ASMod_dmIndAirRef_mp ASMod_dmO2EG_mp ASMod_facDMCorTDiff_mp ASMod_facSOICorTDiff_mp ASMod_phiSOIRef_mp ASMod_qBurned_mp ASMod_qLmbdCtlCorr_mp ASMod_rDMIndAir_mp ASMod_rFlBurned_mp ASMod_rO2EG_mp ASMod_tDiffEG_mp ASMod_tDiffEng_mp ASMod_tEG_mp ASMod_tEngCorTDiff_mp ASMod_tiDdTm_mp /end OUT_MEASUREMENT
/end FUNCTION
/begin FUNCTION asmod_indvol "Modell des Einlaßvolumens" /begin DEF_CHARACTERISTIC /end DEF_CHARACTERISTIC /end FUNCTION
/begin FUNCTION asmod_indvol_msg "" /begin OUT_MEASUREMENT ASMod_dmAirPerTimeCorr ASMod_mAirPerCylCorr /end OUT_MEASUREMENT /end FUNCTION
/begin FUNCTION asmod_indvol_uic "" /begin OUT_MEASUREMENT ASMod_dmIndVol_mp ASMod_mIndVol_mp /end OUT_MEASUREMENT /end FUNCTION
/begin FUNCTION asmod_voleff "Luftaufwand" /begin DEF_CHARACTERISTIC /end DEF_CHARACTERISTIC /begin IN_MEASUREMENT ASMod_rRelPosVSA Eng_nAvrg InjCtl_qCurr /end IN_MEASUREMENT /end FUNCTION
/begin FUNCTION asmod_voleff_msg "" /begin OUT_MEASUREMENT ASMod_dmIndAirRef ASMod_dvolIndAirRef ASMod_tIndAirRef /end OUT_MEASUREMENT /end FUNCTION
/begin FUNCTION asmod_voleff_uic ""
 /begin OUT_MEASUREMENT ASMod_facTIndAirCor_mp ASMod_facVolEff_mp ASMod_facVSACorVolEff_mp ASMod_tIntakeAir_mp /end OUT_MEASUREMENT
/end FUNCTION
/begin FUNCTION battcd "Komponententreiber Batteriespannung" /begin DEF_CHARACTERISTIC /end DEF_CHARACTERISTIC /begin IN_MEASUREMENT BattCD_uRaw /end IN_MEASUREMENT /end FUNCTION
/begin FUNCTION battcd_msg "" /begin OUT_MEASUREMENT BattCD_u BattCD_uLin BattCD_uRaw /end OUT_MEASUREMENT /end FUNCTION
/begin FUNCTION battcd_uic "" /end FUNCTION
/begin FUNCTION batt_corfac "" /begin DEF_CHARACTERISTIC /end DEF_CHARACTERISTIC /end FUNCTION
/begin FUNCTION batt_corfac_msg "" /begin OUT_MEASUREMENT Batt_facCor /end OUT_MEASUREMENT /end FUNCTION
/begin FUNCTION bdint "Karosserie und Innenraum" /end FUNCTION
/begin FUNCTION bdint_msg "" /begin OUT_MEASUREMENT BdInt_nMax BdInt_nMin BdInt_pwrDes BdInt_pwrLead /end OUT_MEASUREMENT /end FUNCTION
/begin FUNCTION bpacd "Komponententreiber des Ladedruckstellers" /begin DEF_CHARACTERISTIC /end DEF_CHARACTERISTIC /begin IN_MEASUREMENT BPA_rBPACD /end IN_MEASUREMENT /end FUNCTION
/begin FUNCTION bpacd_msg "" /begin OUT_MEASUREMENT BPACD_rOut /end OUT_MEASUREMENT /end FUNCTION
/begin FUNCTION bpacd_uic "" /begin OUT_MEASUREMENT BPACD_rCnv_mp /end OUT_MEASUREMENT /end FUNCTION
/begin FUNCTION bpa_co "Stellerkoordinator für Ladedrucksteller" /end FUNCTION
/begin FUNCTION bpa_co_msg "" /begin OUT_MEASUREMENT BPA_rBPACD /end OUT_MEASUREMENT /end FUNCTION
/begin FUNCTION bpa_co_uic "" /begin DEF_CHARACTERISTIC /end DEF_CHARACTERISTIC /begin OUT_MEASUREMENT BPA_rBPAByp_mp /end OUT_MEASUREMENT /end FUNCTION
/begin FUNCTION bpa_lpco "" /end FUNCTION
/begin FUNCTION bpa_lpco_msg "" /begin OUT_MEASUREMENT BPA_rLPACD /end OUT_MEASUREMENT /end FUNCTION
/begin FUNCTION bpa_lpco_uic "" /begin DEF_CHARACTERISTIC /end DEF_CHARACTERISTIC /begin OUT_MEASUREMENT BPA_rLPAByp_mp /end OUT_MEASUREMENT /end FUNCTION
/begin FUNCTION bpscd "Komponententreiber des Ladedruckfühlers" /begin DEF_CHARACTERISTIC /end DEF_CHARACTERISTIC /begin IN_MEASUREMENT BPSCD_uRawVal /end IN_MEASUREMENT /end FUNCTION
/begin FUNCTION bpscd_msg ""
 /begin OUT_MEASUREMENT BPSCD_dFltValDT1 BPSCD_dpOutVal BPSCD_pFltVal BPSCD_pIntVal BPSCD_pLin BPSCD_pOutVal BPSCD_pPhyVal BPSCD_stErr BPSCD_stPlausErr BPSCD_uRawVal /end OUT_MEASUREMENT
/end FUNCTION
/begin FUNCTION bpscd_uic "" /end FUNCTION
/begin FUNCTION brkcd "Komponententreiber zur Erfassung aller Bremssignale" /begin DEF_CHARACTERISTIC /end DEF_CHARACTERISTIC /end FUNCTION
/begin FUNCTION brkcd_msg ""
 /begin OUT_MEASUREMENT BrkCD_stMnSwtDebVal BrkCD_stMnSwtLastDebVal BrkCD_stMnSwtRawVal BrkCD_stPressed BrkCD_stRedSwtDebVal BrkCD_stRedSwtLastDebVal BrkCD_stRedSwtPresent BrkCD_stRedSwtRawVal BrkCD_swtSig /end OUT_MEASUREMENT
/end FUNCTION
/begin FUNCTION brkcd_uic ""
 /begin OUT_MEASUREMENT BrkCD_ctUnPlaus_mp BrkCD_stDeb_mp BrkCD_stMnSwtLogVal_mp BrkCD_stRedSwtLogVal_mp BrkCD_stResUnPlaus_mp BrkCD_stRun_mp /end OUT_MEASUREMENT
/end FUNCTION
/begin FUNCTION bss "Servicetask für Bit Serielle Schnittstelle" /begin DEF_CHARACTERISTIC /end DEF_CHARACTERISTIC /end FUNCTION
/begin FUNCTION bypetk "" /begin DEF_CHARACTERISTIC /end DEF_CHARACTERISTIC /end FUNCTION
/begin FUNCTION bypetk_msg ""
 /begin OUT_MEASUREMENT BypEtk_ctStepDelayNsync_u8 BypEtk_ctStepDelayTsync_u8 BypEtk_stEcu_u8 /end OUT_MEASUREMENT
/end FUNCTION
/begin FUNCTION bypint "" /begin DEF_CHARACTERISTIC /end DEF_CHARACTERISTIC /end FUNCTION
/begin FUNCTION bypint_msg "" /begin OUT_MEASUREMENT BypInt_stEcu_u8 /end OUT_MEASUREMENT /end FUNCTION
/begin FUNCTION carb "CARB Einstellungen" /begin DEF_CHARACTERISTIC /end DEF_CHARACTERISTIC /end FUNCTION
/begin FUNCTION cascd "Komponententreiber Nockenwelle" /begin DEF_CHARACTERISTIC /end DEF_CHARACTERISTIC /begin IN_MEASUREMENT CaSCD_tiPeriodRev CaSCD_tiPeriodRevHold /end IN_MEASUREMENT /end FUNCTION
/begin FUNCTION cascd_backup "" /end FUNCTION
/begin FUNCTION cascd_msg ""
 /begin OUT_MEASUREMENT CaSCD_nPeriod CaSCD_nSeg CaSCD_tiPeriodRev CaSCD_tiPeriodRevHold CaSCD_tiSeg /end OUT_MEASUREMENT
/end FUNCTION
/begin FUNCTION cascd_uic ""
 /begin OUT_MEASUREMENT CaSCD_ctEdgCaSRev_mp CaSCD_ctEdgOfs_mp CaSCD_ctEdgOrd_mp CaSCD_ctErrEdg_mp CaSCD_ctPhRevEdges_mp CaSCD_ctPhRev_mp CaSCD_ctSegEdg_mp CaSCD_ctShftPos_mp CaSCD_ctSyncEdg_mp CaSCD_numFrstInt_mp CaSCD_numFrstTDC_mp CaSCD_phiCurr_mp CaSCD_phiLstEdge_mp CaSCD_stPhaseErr_mp CaSCD_stPhaseSig_mp CaSCD_stPhaseSync_mp CaSCD_stSegCylEdg_mp CaSCD_stSyncCylEdg_mp CaSCD_tiSigTimOut_mp /end OUT_MEASUREMENT
/end FUNCTION
/begin FUNCTION cbacd "" /begin DEF_CHARACTERISTIC /end DEF_CHARACTERISTIC /end FUNCTION
/begin FUNCTION cbacd_uic "" /begin OUT_MEASUREMENT CBACD_stLogicOut_mp /end OUT_MEASUREMENT /end FUNCTION
/begin FUNCTION clg "Kühlung" /begin DEF_CHARACTERISTIC /end DEF_CHARACTERISTIC /begin IN_MEASUREMENT Clg_tClntStrtVal_mp /end IN_MEASUREMENT /end FUNCTION
/begin FUNCTION clg_msg ""
 /begin OUT_MEASUREMENT Clg_dtDynTst Clg_dtMinDynTst Clg_tEndDynTst Clg_tiDynTst Clg_tiMaxDynTst Clg_tMinClntDynTst /end OUT_MEASUREMENT
/end FUNCTION
/begin FUNCTION clg_uic "" /begin OUT_MEASUREMENT Clg_tClntStrtVal_mp /end OUT_MEASUREMENT /end FUNCTION
/begin FUNCTION cmbchb_misfire "Brennräume Fehlzündungserkennung" /begin DEF_CHARACTERISTIC /end DEF_CHARACTERISTIC /begin OUT_MEASUREMENT CmbChb_ctMifBuf1_mp CmbChb_ctMifBuf2_mp CmbChb_ctMifMem_mp /end OUT_MEASUREMENT /end FUNCTION
/begin FUNCTION cmbchb_misfire_msg "" /begin OUT_MEASUREMENT CmbChb_st CmbChb_swtMonClutch /end OUT_MEASUREMENT /end FUNCTION
/begin FUNCTION cmbchb_misfire_uic ""
 /begin OUT_MEASUREMENT CmbChb_ctEngRevLogBuf1_mp CmbChb_ctEngRevLogBuf2_mp CmbChb_ctEngRevLogMem_mp CmbChb_ctEngRevPerBlk_mp CmbChb_dnSegMinPerCyl_mp CmbChb_nSegEven_mp CmbChb_nSegOdd_mp /end OUT_MEASUREMENT
/end FUNCTION
/begin FUNCTION codt_drvtrncord "Antriebs-Koordination" /begin DEF_CHARACTERISTIC /end DEF_CHARACTERISTIC /end FUNCTION
/begin FUNCTION codt_drvtrncordlead_uic ""
 /begin OUT_MEASUREMENT CoDT_trqDTInDecLead_mp CoDT_trqDTInIncLead_mp CoDT_trqGearbxLead_mp /end OUT_MEASUREMENT
/end FUNCTION
/begin FUNCTION codt_drvtrncord_msg ""
 /begin OUT_MEASUREMENT CoDT_nMax CoDT_nMin CoDT_stOrd CoDT_swtCoType CoDT_trqAcsDes CoDT_trqCurr CoDT_trqDes CoDT_trqDTInCurr CoDT_trqDTInDes CoDT_trqDTInLead CoDT_trqGearbxDes CoDT_trqLead /end OUT_MEASUREMENT
/end FUNCTION
/begin FUNCTION codt_drvtrncord_uic "" /end FUNCTION
/begin FUNCTION codt_grip "Kraftschluß innerhalb Antrieb" /begin DEF_CHARACTERISTIC /end DEF_CHARACTERISTIC /end FUNCTION
/begin FUNCTION codt_grip_msg "" /begin OUT_MEASUREMENT CoDT_Grip CoDT_stGripDeb /end OUT_MEASUREMENT /end FUNCTION
/begin FUNCTION codt_grip_uic ""
 /begin OUT_MEASUREMENT CoDT_dnAbsEng_mp CoDT_dnEng_mp CoDT_dnGrip_mp CoDT_dnNoGrip_mp CoDT_stNoGripDet_mp CoDT_trqAbsGbxPT1_mp CoDT_trqGbxPT1_mp /end OUT_MEASUREMENT
/end FUNCTION
/begin FUNCTION codt_prptrqcurrcalc "Antriebsmoment-Berechnung" /end FUNCTION
/begin FUNCTION codt_prptrqcurrcalc_msg "" /begin OUT_MEASUREMENT CoDT_trq CoDT_trqCurrLim CoDT_trqGbx /end OUT_MEASUREMENT /end FUNCTION
/begin FUNCTION codt_prptrqcurrcalc_uic "" /begin OUT_MEASUREMENT CoDT_trqActAcs_mp /end OUT_MEASUREMENT /end FUNCTION
/begin FUNCTION codt_prptrqrngcalc "Bereitstellung Momentenintervall" /begin DEF_CHARACTERISTIC /end DEF_CHARACTERISTIC /end FUNCTION
/begin FUNCTION codt_prptrqrngcalc_msg ""
 /begin OUT_MEASUREMENT CoDT_trqAcsMin CoDT_trqGbxMax CoDT_trqGbxMin CoDT_trqMax CoDT_trqMin /end OUT_MEASUREMENT
/end FUNCTION
/begin FUNCTION codt_prptrqrngcalc_uic "" /begin OUT_MEASUREMENT CoDT_trqAcsMax_mp CoDT_trqAcs_mp /end OUT_MEASUREMENT /end FUNCTION
/begin FUNCTION coeng_actrprt "Steuerung Stellerschutz" /begin DEF_CHARACTERISTIC /end DEF_CHARACTERISTIC /end FUNCTION
/begin FUNCTION coeng_actrprt_uic "" /end FUNCTION
/begin FUNCTION coeng_aftrun "" /begin DEF_CHARACTERISTIC /end DEF_CHARACTERISTIC /end FUNCTION
/begin FUNCTION coeng_aftrunextwait "Warten auf externe Ereignisse während Nachlauf" /begin DEF_CHARACTERISTIC /end DEF_CHARACTERISTIC /end FUNCTION
/begin FUNCTION coeng_aftrunextwait_msg "" /begin OUT_MEASUREMENT CoEng_stExtWait CoEng_stExtWait2 CoEng_tiMinAftRun /end OUT_MEASUREMENT /end FUNCTION
/begin FUNCTION coeng_aftrunextwait_uic "" /end FUNCTION
/begin FUNCTION coeng_aftrun_msg "" /begin OUT_MEASUREMENT CoEng_stAftRun CoEng_stAftRunPath /end OUT_MEASUREMENT /end FUNCTION
/begin FUNCTION coeng_aftrun_uic "" /begin OUT_MEASUREMENT CoEng_stEEPStore_mp /end OUT_MEASUREMENT /end FUNCTION
/begin FUNCTION coeng_flconsum "Verbrauchsberechnung" /begin DEF_CHARACTERISTIC /end DEF_CHARACTERISTIC /begin IN_MEASUREMENT CoEng_trq Eng_nAvrg /end IN_MEASUREMENT /end FUNCTION
/begin FUNCTION coeng_flconsum_uic ""
 /begin OUT_MEASUREMENT CoEng_dvolPerStroke_mp CoEng_facFlConsumAdj_mp CoEng_qSubs_mp CoEng_qSum_mp CoEng_volFlConsumAdj_mp /end OUT_MEASUREMENT
/end FUNCTION
/begin FUNCTION coeng_flconsum_var "" /end FUNCTION
/begin FUNCTION coeng_flconsum_var_msg "" /end FUNCTION
/begin FUNCTION coeng_mon "Abschaltkoordinator" /begin DEF_CHARACTERISTIC /end DEF_CHARACTERISTIC /end FUNCTION
/begin FUNCTION coeng_monaddreq "Kundenspezifische Abschaltanforderungen an Abschaltkoordinator" /end FUNCTION
/begin FUNCTION coeng_monaddreq_msg "" /begin OUT_MEASUREMENT CoEng_stShOffAddReqIRev CoEng_stShOffAddReqRev /end OUT_MEASUREMENT /end FUNCTION
/begin FUNCTION coeng_monaddreq_uic "" /end FUNCTION
/begin FUNCTION coeng_mon_uic "" /end FUNCTION
/begin FUNCTION coeng_msg ""
 /begin OUT_MEASUREMENT CoEng_dvolFlConsum CoEng_facAdj CoEng_nMax CoEng_nMin CoEng_stDisable CoEng_stIRevShutOff CoEng_stMonActrPrt CoEng_stMonShOff CoEng_stOvrRun CoEng_stPwrDwn CoEng_stPwrStgEnaCond CoEng_stRevShutOff CoEng_stShutOff CoEng_stShutOffPath CoEng_stTrqLimErr CoEng_stTrqLimErr1 CoEng_stTrqLimErr2 CoEng_stTrqLimErr3 CoEng_stTrqLimErr4 CoEng_stTrqLimPFltErr CoEng_tiWakeUp CoEng_trq CoEng_trqCurrLim CoEng_trqInrCurr CoEng_trqInrCurrFast CoEng_trqInrDes CoEng_trqInrDesFast CoEng_trqInrDesSlow CoEng_trqInrLim CoEng_trqInrLimDes CoEng_trqInrLimLead CoEng_trqInrLtd CoEng_trqInrRaw CoEng_trqInrSet CoEng_trqLiLtd CoEng_trqLimErr CoEng_trqLimErr1 CoEng_trqLimErr2 CoEng_trqLimErr3 CoEng_trqLimErr4 CoEng_trqLimPDiff CoEng_trqLimSwt CoEng_trqMax CoEng_trqMin CoEng_trqOvrFul CoEng_trqSlpLim CoEng_volFlConsum CoEng_voltotFlConsum /end OUT_MEASUREMENT
/end FUNCTION
/begin FUNCTION coeng_ovrruncoord "Schubkoordinator" /begin DEF_CHARACTERISTIC /end DEF_CHARACTERISTIC /end FUNCTION
/begin FUNCTION coeng_ovrruncoord_msg "" /begin OUT_MEASUREMENT CoEng_stOvrRunCoord CoEng_stZFCEmissionRoll /end OUT_MEASUREMENT /end FUNCTION
/begin FUNCTION coeng_ovrruncoord_uic ""
 /begin OUT_MEASUREMENT CoEng_CoordPrioFld_mp CoEng_stCoordFuncFld_mp CoEng_stCoordFuncPref_mp CoEng_stOvrRunEGT_mp /end OUT_MEASUREMENT
/end FUNCTION
/begin FUNCTION coeng_pwrstgstatecalc "Endstufenkoordinator" /begin DEF_CHARACTERISTIC /end DEF_CHARACTERISTIC /end FUNCTION
/begin FUNCTION coeng_pwrstgstatecalc_uic "" /begin OUT_MEASUREMENT CoEng_stDlyT15_mp /end OUT_MEASUREMENT /end FUNCTION
/begin FUNCTION coeng_shoff "Abstellsteuerung im Nachlauf" /begin DEF_CHARACTERISTIC /end DEF_CHARACTERISTIC /begin IN_MEASUREMENT Eng_nAvrg /end IN_MEASUREMENT /end FUNCTION
/begin FUNCTION coeng_shofflib "" /begin DEF_CHARACTERISTIC /end DEF_CHARACTERISTIC /end FUNCTION
/begin FUNCTION coeng_shofflib_uic "" /end FUNCTION
/begin FUNCTION coeng_shoff_msg "" /begin OUT_MEASUREMENT CoEng_numShOffTstNewSel CoEng_pRailT15Off CoEng_stShOffTst /end OUT_MEASUREMENT /end FUNCTION
/begin FUNCTION coeng_shoff_uic "" /begin OUT_MEASUREMENT CoEng_stShOffTstOldRes_mp CoEng_tiSoftShOff_mp /end OUT_MEASUREMENT /end FUNCTION
/begin FUNCTION coeng_steng "aktueller Motorzustand [-]" /begin DEF_CHARACTERISTIC /end DEF_CHARACTERISTIC /end FUNCTION
/begin FUNCTION coeng_steng_msg ""
 /begin OUT_MEASUREMENT CoEng_stEng CoEng_stEngOld CoEng_tiAfterrun CoEng_tiAfterrunRed CoEng_tiNormal CoEng_tiNormalRed CoEng_tiStart CoEng_tiStartRed /end OUT_MEASUREMENT
/end FUNCTION
/begin FUNCTION coeng_steng_uic "" /end FUNCTION
/begin FUNCTION coeng_sttrqlimcalc "" /end FUNCTION
/begin FUNCTION coeng_sttrqlimcalc_msg ""
 /begin OUT_MEASUREMENT CoEng_rTrq CoEng_stCurrLim CoEng_stCurrLimActive CoEng_trqInrCurrLim /end OUT_MEASUREMENT
/end FUNCTION
/begin FUNCTION coeng_sttrqlimcalc_uic "" /begin OUT_MEASUREMENT CoEng_trqInrGearbxInMax_mp CoEng_trqInrPrpLimErr_mp /end OUT_MEASUREMENT /end FUNCTION
/begin FUNCTION coeng_trqcalc "Motormomentenberechnung" /begin DEF_CHARACTERISTIC /end DEF_CHARACTERISTIC /begin IN_MEASUREMENT CoEng_tiOvRMon_mp DrvTrn_rTransDT /end IN_MEASUREMENT /end FUNCTION
/begin FUNCTION coeng_trqcalclead "" /end FUNCTION
/begin FUNCTION coeng_trqcalclead_uic ""
 /begin OUT_MEASUREMENT CoEng_trqInrCurrFastBase_mp CoEng_trqInrDesFastBase_mp CoEng_trqInrDesFastUnLim_mp /end OUT_MEASUREMENT
/end FUNCTION
/begin FUNCTION coeng_trqcalc_msg ""
 /begin OUT_MEASUREMENT CoEng_tiRmpStrt CoEng_tiSwtOff CoEng_trqInrLiDesSlw CoEng_trqLimOffs /end OUT_MEASUREMENT
/end FUNCTION
/begin FUNCTION coeng_trqcalc_uic ""
 /begin OUT_MEASUREMENT CoEng_stRmp_mp CoEng_tiOvRMon_mp CoEng_trqBefRmp_mp CoEng_trqInrCurrPre_mp CoEng_trqInrDesSlowBase_mp CoEng_trqInrDesSlowUnLim_mp CoEng_trqInrRawPre_mp CoEng_trqInrSetLim_mp CoEng_trqInrSetUnLtd_mp CoEng_trqLimOffs_mp CoEng_trqRmp_mp CoEng_trqSetASDdc_mp /end OUT_MEASUREMENT
/end FUNCTION
/begin FUNCTION coeng_trqcalc_var "" /end FUNCTION
/begin FUNCTION coeng_trqcalc_var_uic "" /end FUNCTION
/begin FUNCTION coeng_trqlim "Momentenbegrenzung als Motormoment" /begin DEF_CHARACTERISTIC /end DEF_CHARACTERISTIC /begin IN_MEASUREMENT CoEng_pDiffPFltPrdc_mp Eng_nAvrg PFlt_pDiff /end IN_MEASUREMENT /end FUNCTION
/begin FUNCTION coeng_trqlim_uic ""
 /begin OUT_MEASUREMENT CoEng_dnEngnAvrg_mp CoEng_dVolFlt_mp CoEng_pDiffPFltPrdc_mp CoEng_resFlowFlt_mp CoEng_stOvrFul_mp CoEng_trqInrLimLead0_mp CoEng_trqInrLimLead1_mp CoEng_trqInrLimLead2_mp CoEng_trqLimMin1_mp CoEng_trqLimMinEEPVal_mp CoEng_trqLimMin_mp CoEng_trqLimPDiffNOffs_mp CoEng_trqLimPFlt1_mp CoEng_trqLimSwt1_mp CoEng_trqLimSwt2_mp CoEng_trqLimSwt3_mp CoEng_trqLimSwt4_mp /end OUT_MEASUREMENT
/end FUNCTION
/begin FUNCTION coeng_trqslplim "Begrenzungsmoment für Rauchbegrenzung nach Turboschubbegrenzung" /begin DEF_CHARACTERISTIC /end DEF_CHARACTERISTIC /end FUNCTION
/begin FUNCTION coeng_trqslplim_uic "" /begin DEF_CHARACTERISTIC /end DEF_CHARACTERISTIC /end FUNCTION
/begin FUNCTION coeng_tstco "Motortestkoordinator" /begin DEF_CHARACTERISTIC /end DEF_CHARACTERISTIC /end FUNCTION
/begin FUNCTION coeng_tstco_msg "" /begin OUT_MEASUREMENT CoEng_stTst /end OUT_MEASUREMENT /end FUNCTION
/begin FUNCTION coeng_var "" /end FUNCTION
/begin FUNCTION coeng_var_ers "" /end FUNCTION
/begin FUNCTION coeng_var_ers_msg "" /end FUNCTION
/begin FUNCTION coeng_var_ers_uic "" /end FUNCTION
/begin FUNCTION combas_msg "" /begin OUT_MEASUREMENT ComBas_stDiaReq /end OUT_MEASUREMENT /end FUNCTION
/begin FUNCTION conf_proj "" /end FUNCTION
/begin FUNCTION convcd_co "Komponententreiber zur Mapping Funktion auf Struktur" /begin DEF_CHARACTERISTIC /end DEF_CHARACTERISTIC /end FUNCTION
/begin FUNCTION convcd_co_uic "" /begin OUT_MEASUREMENT ConvCD_ctClutchDfct_mp /end OUT_MEASUREMENT /end FUNCTION
/begin FUNCTION convcd_msg ""
 /begin OUT_MEASUREMENT ConvCD_stClth ConvCD_stClthRaw ConvCD_stClutchRecord ConvCD_stDebVal ConvCD_stIntDebVal ConvCD_stLastDebVal ConvCD_stLastGear ConvCD_stOldGear ConvCD_stRawVal ConvCD_swtSig /end OUT_MEASUREMENT
/end FUNCTION
/begin FUNCTION conv_grip "Function to calculate converter amplification factor" /end FUNCTION
/begin FUNCTION conv_grip_msg "" /begin OUT_MEASUREMENT Conv_rTrans /end OUT_MEASUREMENT /end FUNCTION
/begin FUNCTION coveh_acsmng "Koordination Nebenaggregate" /begin DEF_CHARACTERISTIC /end DEF_CHARACTERISTIC /end FUNCTION
/begin FUNCTION coveh_acsmng_msg ""
 /begin OUT_MEASUREMENT CoVeh_nAcsMax CoVeh_nAcsMin CoVeh_nLimEngSpd CoVeh_pwrAcsDes CoVeh_pwrAcsLead CoVeh_trqAcs CoVeh_trqAcsDes CoVeh_trqAcsLead CoVeh_trqAcsPerm CoVeh_trqAcsTemp /end OUT_MEASUREMENT
/end FUNCTION
/begin FUNCTION coveh_acsmng_uic "" /begin OUT_MEASUREMENT CoVeh_pwrAcsTempLim_mp CoVeh_trqAcsLimCrSDes_mp /end OUT_MEASUREMENT /end FUNCTION
/begin FUNCTION coveh_drvtrnord "Auftrag für Antrieb" /begin DEF_CHARACTERISTIC /end DEF_CHARACTERISTIC /begin IN_MEASUREMENT Eng_nAvrg /end IN_MEASUREMENT /end FUNCTION
/begin FUNCTION coveh_drvtrnordlead_uic "" /begin DEF_CHARACTERISTIC /end DEF_CHARACTERISTIC /end FUNCTION
/begin FUNCTION coveh_drvtrnord_msg ""
 /begin OUT_MEASUREMENT CoVeh_nMax CoVeh_nMin CoVeh_stOrd CoVeh_trqPrpDes CoVeh_trqPrpLead CoVeh_trqPrpLimErr /end OUT_MEASUREMENT
/end FUNCTION
/begin FUNCTION coveh_drvtrnord_uic "" /begin DEF_CHARACTERISTIC /end DEF_CHARACTERISTIC /end FUNCTION
/begin FUNCTION covm_demcheck "Vortriebsstabilisierungsprüfung" /begin DEF_CHARACTERISTIC /end DEF_CHARACTERISTIC /end FUNCTION
/begin FUNCTION covm_demcheck_msg "" /begin OUT_MEASUREMENT CoVM_stDemCheck CoVM_swtSlipCtl /end OUT_MEASUREMENT /end FUNCTION
/begin FUNCTION covm_demcheck_uic "" /begin OUT_MEASUREMENT CoVM_amAct_mp CoVM_stDemUnplaus_mp CoVM_trqInt_mp /end OUT_MEASUREMENT /end FUNCTION
/begin FUNCTION covm_demcord "Anforderungskoordination" /begin DEF_CHARACTERISTIC /end DEF_CHARACTERISTIC /end FUNCTION
/begin FUNCTION covm_demcordlead_uic "" /begin OUT_MEASUREMENT CoVM_trqLeadIncMax_mp /end OUT_MEASUREMENT /end FUNCTION
/begin FUNCTION covm_demcord_msg ""
 /begin OUT_MEASUREMENT CoVM_stActDem CoVM_stOrd CoVM_stTrqLeadFrz CoVM_trqDVCH CoVM_trqGearbxMax CoVM_trqGearbxMin CoVM_trqPrpDes CoVM_trqPrpLead /end OUT_MEASUREMENT
/end FUNCTION
/begin FUNCTION covm_demcord_uic "" /begin OUT_MEASUREMENT CoVM_trqDesIncMax_mp /end OUT_MEASUREMENT /end FUNCTION
/begin FUNCTION covm_stabdem "Vortriebsstabilisierung" /begin DEF_CHARACTERISTIC /end DEF_CHARACTERISTIC /end FUNCTION
/begin FUNCTION covm_stabdem_msg "" /begin OUT_MEASUREMENT CoVM_trqDec CoVM_trqInc /end OUT_MEASUREMENT /end FUNCTION
/begin FUNCTION covm_stabdem_uic "" /begin OUT_MEASUREMENT CoVM_trqDecSetVal_mp CoVM_trqIncSetVal_mp /end OUT_MEASUREMENT /end FUNCTION
/begin FUNCTION cpbvlv_logic "" /begin DEF_CHARACTERISTIC /end DEF_CHARACTERISTIC /begin IN_MEASUREMENT APSCD_pVal Eng_nAvrg /end IN_MEASUREMENT /end FUNCTION
/begin FUNCTION cpbvlv_logic_msg "" /begin OUT_MEASUREMENT CpBVlv_stLogic CpBVlv_stOpn /end OUT_MEASUREMENT /end FUNCTION
/begin FUNCTION cpbvlv_logic_uic "" /begin OUT_MEASUREMENT CpBVlv_qClose_mp CpBVlv_qOpn_mp CpBVlv_stOff_mp /end OUT_MEASUREMENT /end FUNCTION
/begin FUNCTION crccd_keydet "Bedienteilerfassung Fahrgeschwindigkeitsregler" /begin DEF_CHARACTERISTIC /end DEF_CHARACTERISTIC /end FUNCTION
/begin FUNCTION crccd_keydet_msg ""
 /begin OUT_MEASUREMENT CrCCD_stDev CrCCD_stKey CrCCD_stKeyOff CrCCD_swtDev CrCCD_swtMSW /end OUT_MEASUREMENT
/end FUNCTION
/begin FUNCTION crccd_keydet_uic "" /begin OUT_MEASUREMENT CrCCD_dMFLData_mp /end OUT_MEASUREMENT /end FUNCTION
/begin FUNCTION crctl_detcrctl "" /end FUNCTION
/begin FUNCTION crctl_detcrctl_msg "" /begin OUT_MEASUREMENT CrCtl_stRecFGR /end OUT_MEASUREMENT /end FUNCTION
/begin FUNCTION crctl_detcrctl_uic "" /end FUNCTION
/begin FUNCTION crctl_msg "" /begin OUT_MEASUREMENT CrCtl_stActive CrCtl_trqDes CrCtl_trqLead /end OUT_MEASUREMENT /end FUNCTION
/begin FUNCTION crctl_sendvmrk "Aufbereitung Stufentempomatinformation für Kombi" /begin DEF_CHARACTERISTIC /end DEF_CHARACTERISTIC /end FUNCTION
/begin FUNCTION crctl_sendvmrk_msg ""
 /begin OUT_MEASUREMENT B_acmsggts B_cmsggts B_ergacgt B_mrkvff indexmrst tnomgs60ms vmrki1_w vmrki2_w vmrki3_w /end OUT_MEASUREMENT
/end FUNCTION
/begin FUNCTION crctl_sendvmrk_uic "" /end FUNCTION
/begin FUNCTION crctl_shutoff "FGR-Abschaltung" /begin DEF_CHARACTERISTIC /end DEF_CHARACTERISTIC /end FUNCTION
/begin FUNCTION crctl_shutoff_msg "" /begin OUT_MEASUREMENT CrCtl_numGear CrCtl_stShutOffCode /end OUT_MEASUREMENT /end FUNCTION
/begin FUNCTION crctl_shutoff_uic ""
 /begin OUT_MEASUREMENT CrCtl_stBrkBeforeCruise_mp CrCtl_stClCtr_mp CrCtl_stShutOffCode1_mp CrCtl_stShutOffCode2_mp CrCtl_stShutOffFrz1_mp CrCtl_stShutOffFrz2_mp CrCtl_stShutOffFrz_mp /end OUT_MEASUREMENT
/end FUNCTION
/begin FUNCTION crctl_updatedem "FGR-Anforderungen Update (Abschalten + Regler)" /begin DEF_CHARACTERISTIC /end DEF_CHARACTERISTIC
 /begin IN_MEASUREMENT CrCtl_vBeg CrCtl_vDiffRed_mp CrCtl_vDiff_mp Gearbx_stGear Rail_tiThresMonEna /end IN_MEASUREMENT
/end FUNCTION
/begin FUNCTION crctl_updatedem_msg ""
 /begin OUT_MEASUREMENT CrCtl_rVnBeg CrCtl_st CrCtl_stCAN CrCtl_stLampOut CrCtl_vBeg CrCtl_vDes CrCtl_vRmp /end OUT_MEASUREMENT
/end FUNCTION
/begin FUNCTION crctl_updatedem_uic "" /begin DEF_CHARACTERISTIC /end DEF_CHARACTERISTIC
 /begin OUT_MEASUREMENT CrCtl_dvAcc_mp CrCtl_dvDecl_mp CrCtl_dvResAbv_mp CrCtl_dvResBlw_mp CrCtl_trqDT1_mp CrCtl_trqI_mp CrCtl_trqMax_mp CrCtl_trqP_mp CrCtl_vDiffRed_mp CrCtl_vDiff_mp /end OUT_MEASUREMENT
/end FUNCTION
/begin FUNCTION crctl_vcrctl "" /begin DEF_CHARACTERISTIC /end DEF_CHARACTERISTIC /end FUNCTION
/begin FUNCTION crctl_vcrctl_msg ""
 /begin OUT_MEASUREMENT CrCtl_stVCrCtl CrCtl_vAlwMax CrCtl_vAlwMin CrCtl_vCurr CrCtl_vDispOffset /end OUT_MEASUREMENT
/end FUNCTION
/begin FUNCTION crctl_vcrctl_uic "" /end FUNCTION
/begin FUNCTION crctl_vsetstep "Stufentempomat" /begin DEF_CHARACTERISTIC /end DEF_CHARACTERISTIC /end FUNCTION
/begin FUNCTION crctl_vsetstep_msg ""
 /begin OUT_MEASUREMENT anzmark BGSTUTlokbits0 B_beveh B_bv1 B_bv2 B_envtwa B_fgrepa B_mrkbli B_mrkein B_mrkv B_prgmod B_tmark B_tmrkbli B_vziels canzbl ctblink dvmark_w dvprg_w dvstutom_w mrknrc mrknrcan mrknrint mrkstut_w statvza vzielakvp_w vzielak_w vziels_w /end OUT_MEASUREMENT
/end FUNCTION
/begin FUNCTION crctl_vsetstep_uic "" /begin OUT_MEASUREMENT CrCtl_BGSTUTbits2_mp CrCtl_mrkeinvp_mp /end OUT_MEASUREMENT /end FUNCTION
/begin FUNCTION crctl_vstepadapt "Aufbereitung der Größen für den Stufentempomaten" /end FUNCTION
/begin FUNCTION crctl_vstepadapt_msg ""
 /begin OUT_MEASUREMENT B_acc B_besch B_fgrat B_fgren B_fgresv B_fgrtb2 B_fgrtbe B_fgrtv2 B_fgrtve B_fgrtwa B_fgrvem B_insfgre B_kl15 B_km B_mmiena CrCtl_numVMrk CrCtl_stCC CrCtl_stUpdateVMrk CrCtl_stVDisp CrCtl_stVSetNew CrCtl_vDesDisp CrCtl_vMrk1 CrCtl_vMrk2 CrCtl_vMrk3 CrCtl_vSetNew mmimrk_w vfgr_w vreglmax_w vreglmin_w vziel_w /end OUT_MEASUREMENT
/end FUNCTION
/begin FUNCTION crctl_vstepadapt_uic "" /end FUNCTION
/begin FUNCTION crscd "Komponententreiber Kurbelwelle" /begin DEF_CHARACTERISTIC /end DEF_CHARACTERISTIC /begin IN_MEASUREMENT CrSCD_nAvrg /end IN_MEASUREMENT /end FUNCTION
/begin FUNCTION crscd_msg ""
 /begin OUT_MEASUREMENT CrSCD_dSegMisf CrSCD_nAvrg CrSCD_nAvrgHiRes CrSCD_nCurr CrSCD_nCurrHiRes CrSCD_nDyn CrSCD_nHold CrSCD_nMisf CrSCD_numSeg CrSCD_phiIncCor CrSCD_phiIncr CrSCD_tiSeg /end OUT_MEASUREMENT
/end FUNCTION
/begin FUNCTION crscd_thresctl "" /begin DEF_CHARACTERISTIC /end DEF_CHARACTERISTIC /end FUNCTION
/begin FUNCTION crscd_uic ""
 /begin OUT_MEASUREMENT CrSCD_incNextIntDelta_mp CrSCD_incNextInt_mp CrSCD_phiCurr_mp CrSCD_phiSegGrid_mp CrSCD_stIncErr_mp CrSCD_stIncSig_mp CrSCD_stIncSyncInc_mp CrSCD_stIncSyncPhase_mp /end OUT_MEASUREMENT
/end FUNCTION
/begin FUNCTION crscd_var "" /begin DEF_CHARACTERISTIC /end DEF_CHARACTERISTIC /begin IN_MEASUREMENT CrSCD_tiIncr /end IN_MEASUREMENT /end FUNCTION
/begin FUNCTION crscd_var_msg "" /begin OUT_MEASUREMENT CrSCD_nIncr CrSCD_tiIncr /end OUT_MEASUREMENT /end FUNCTION
/begin FUNCTION crs_chkstrtspd "Redundanter Start nur mit Kurbelwelle" /begin DEF_CHARACTERISTIC /end DEF_CHARACTERISTIC /end FUNCTION
/begin FUNCTION crs_chkstrtspd_uic ""
 /begin OUT_MEASUREMENT CrS_ctInjStrt_mp CrS_facSegTime_mp CrS_numTDCStrtLst_mp CrS_numTDCStrt_mp CrS_stStrt_mp CrS_tiSegOld_mp CrS_tiSeg_mp /end OUT_MEASUREMENT
/end FUNCTION
/begin FUNCTION ctscd "Wassertemperaturfühler Komponententreiber" /begin DEF_CHARACTERISTIC /end DEF_CHARACTERISTIC /begin IN_MEASUREMENT CTSCD_uRaw /end IN_MEASUREMENT /end FUNCTION
/begin FUNCTION ctscd_msg ""
 /begin OUT_MEASUREMENT CTSCD_dtClnt CTSCD_stErrIni CTSCD_stPHtr CTSCD_swtSig CTSCD_tClnt CTSCD_tClntLin CTSCD_tClntP CTSCD_uRaw /end OUT_MEASUREMENT
/end FUNCTION
/begin FUNCTION ctscd_uic "" /begin OUT_MEASUREMENT CTSCD_stRmp_mp /end OUT_MEASUREMENT /end FUNCTION
/begin FUNCTION ctscd_var "" /end FUNCTION
/begin FUNCTION ctscd_var_msg "" /end FUNCTION
/begin FUNCTION curmap_size_base "" /end FUNCTION
/begin FUNCTION curmap_size_proj "" /end FUNCTION
/begin FUNCTION curmap_size_sys "" /end FUNCTION
/begin FUNCTION cycsigcheck "" /begin DEF_CHARACTERISTIC /end DEF_CHARACTERISTIC /end FUNCTION
/begin FUNCTION cycsigcheck_msg "" /begin OUT_MEASUREMENT CycSigCheck_stTest /end OUT_MEASUREMENT /end FUNCTION
/begin FUNCTION dcc_updatedem "Fahrgeschwindigkeitregelung" /begin DEF_CHARACTERISTIC /end DEF_CHARACTERISTIC /begin IN_MEASUREMENT DCC_nSetPointRaw_mp Eng_nAvrg /end IN_MEASUREMENT /end FUNCTION
/begin FUNCTION dcc_updatedem_msg ""
 /begin OUT_MEASUREMENT DCC_stAckEngDCC DCC_stActive DCC_stCtlVel DCC_stDCC DCC_stError DCC_stRecDCC DCC_stRls DCC_trqDes DCC_trqRaw /end OUT_MEASUREMENT
/end FUNCTION
/begin FUNCTION dcc_updatedem_uic ""
 /begin OUT_MEASUREMENT DCC_nDvthires_mp DCC_nDvt_mp DCC_nSetPointRaw_mp DCC_nSetPoint_mp DCC_nShft_mp DCC_nWheel_mp DCC_rTransDTNext_mp DCC_stBrkPressed_mp DCC_stGearNext_mp DCC_stGearOld_mp DCC_stRlsMT_mp DCC_swtPosAT_mp DCC_swtPosBrk_mp DCC_swtPosES_mp DCC_swtPosMT_mp DCC_trqDesDCCFlt_mp DCC_trqDesDCCMT_mp DCC_trqEngSpdRaw_mp DCC_trqEngSpd_mp DCC_trqIEngSpd_mp DCC_trqIInit_mp DCC_trqPEngSpd_mp DCC_trqRaw_mp DCC_trqsaveStI_mp DCC_trqShft_mp DCC_trqStI_mp DCC_vConv_mp /end OUT_MEASUREMENT
/end FUNCTION
/begin FUNCTION drvtrn "Antriebsstrang" /begin DEF_CHARACTERISTIC /end DEF_CHARACTERISTIC /end FUNCTION
/begin FUNCTION drvtrn_msg "" /begin OUT_MEASUREMENT DrvTrn_rFlatTransDT DrvTrn_rTransDT /end OUT_MEASUREMENT /end FUNCTION
/begin FUNCTION drvtrn_uic "" /begin OUT_MEASUREMENT DrvTrn_rTransDTact_mp DrvTrn_rTransDTRmpIn_mp /end OUT_MEASUREMENT /end FUNCTION
/begin FUNCTION dsched "" /begin DEF_CHARACTERISTIC /end DEF_CHARACTERISTIC /end FUNCTION
/begin FUNCTION dsched_msg "" /end FUNCTION
/begin FUNCTION dsched_uic "" /begin OUT_MEASUREMENT DSC_stTstTrigger_mp /end OUT_MEASUREMENT /end FUNCTION
/begin FUNCTION dsm "" /begin DEF_CHARACTERISTIC /end DEF_CHARACTERISTIC /end FUNCTION
/begin FUNCTION dsmdur "" /begin DEF_CHARACTERISTIC /end DEF_CHARACTERISTIC /end FUNCTION
/begin FUNCTION dsmdur_msg "" /begin OUT_MEASUREMENT DSMDur_ctDfctDur1 DSMDur_ctDfctDur2 /end OUT_MEASUREMENT /end FUNCTION
/begin FUNCTION dsmdur_uic "" /begin OUT_MEASUREMENT DSMDur_stGlobalDefCnt_mp /end OUT_MEASUREMENT /end FUNCTION
/begin FUNCTION dsm_auto_blk "" /begin DEF_CHARACTERISTIC /end DEF_CHARACTERISTIC /end FUNCTION
/begin FUNCTION dsm_auto_cdc "" /begin DEF_CHARACTERISTIC /end DEF_CHARACTERISTIC /end FUNCTION
/begin FUNCTION dsm_auto_cdk "" /begin DEF_CHARACTERISTIC /end DEF_CHARACTERISTIC /end FUNCTION
/begin FUNCTION dsm_auto_debclass "" /begin DEF_CHARACTERISTIC /end DEF_CHARACTERISTIC /end FUNCTION
/begin COMPU_METHOD Def_i_ub_q0p08 "Def_i_ub_q0p08" RAT_FUNC "%5.2" "A" COEFFS 0 25 0 0 0 2 /end COMPU_METHOD
/begin COMPU_METHOD Def_td_ub_q0p05 "Def_td_ub_q0p05" RAT_FUNC "%5.2" "s" COEFFS 0 20 0 0 0 1 /end COMPU_METHOD
/begin COMPU_METHOD Def_td_ub_q0p00625 "Def_td_ub_q0p00625" RAT_FUNC "%7.4" "s" COEFFS 0 160 0 0 0 1 /end COMPU_METHOD
/begin COMPU_METHOD Def_u_ub_q0p0196 "Def_u_ub_q0p0196" RAT_FUNC "%7.4" "V" COEFFS 0 1 0 0 0 0.0196 /end COMPU_METHOD
/begin COMPU_METHOD Def_td_uw_q0p05 "Def_td_uw_q0p05" RAT_FUNC "%7.2" "s" COEFFS 0 20 0 0 0 1 /end COMPU_METHOD
/begin COMPU_METHOD Def_f_uw_b256 "Def_f_uw_b256" RAT_FUNC "%8.3" "-" COEFFS 0 65536 0 0 0 256 /end COMPU_METHOD
/begin COMPU_METHOD Def_p_uw_q039 "Def_p_uw_q039" RAT_FUNC "%8.3" "hPa" COEFFS 0 256 0 0 0 10 /end COMPU_METHOD
/begin COMPU_METHOD Def_f_ub_b0p5 "Def_f_ub_b0p5" RAT_FUNC "%6.3" "-" COEFFS 0 256 0 0 0 0.5 /end COMPU_METHOD
/begin COMPU_METHOD Def_f_ub_b0p25 "Def_f_ub_b0p25" RAT_FUNC "%7.4" "-" COEFFS 0 256 0 0 0 0.25 /end COMPU_METHOD
/begin COMPU_METHOD Def_f_sw_b1 "Def_f_sw_b1" RAT_FUNC "%14.5" "-" COEFFS 0 65536 0 0 0 2 /end COMPU_METHOD
/begin COMPU_METHOD Def_niv_sb_b37p5 "Def_niv_sb_b37p5" RAT_FUNC "%5.2" "" COEFFS 0 256 0 0 0 75 /end COMPU_METHOD
/begin COMPU_METHOD Def_niv_uw_b75 "Def_niv_uw_b75" RAT_FUNC "%7.2" "mm" COEFFS 0 256 0 0 0 75 /end COMPU_METHOD
/begin COMPU_METHOD Def_niv_sw_b37p5 "Def_niv_sw_b37p5" RAT_FUNC "%7.2" "" COEFFS 0 256 0 0 0 75 /end COMPU_METHOD
/begin COMPU_METHOD Def_kw_ub_q0p0234 "Def_kw_ub_q0p0234" RAT_FUNC "%6.3" "°KW" COEFFS 0 256 0 0 0 6 /end COMPU_METHOD
/begin COMPU_METHOD Def_td_ub_q0p9333 "Def_td_ub_q0p9333" RAT_FUNC "%7.4" "min" COEFFS 0 15 0 0 0 14 /end COMPU_METHOD
/begin COMPU_METHOD Def_f_ub_q0p001 "Def_f_ub_q0p001" RAT_FUNC "%6.3" "" COEFFS 0 1000 0 0 0 1 /end COMPU_METHOD
/begin COMPU_METHOD Def_i_ub_b1000 "Def_i_ub_b1000" RAT_FUNC "%6.3" "A" COEFFS 0 256 0 0 0 1000 /end COMPU_METHOD
/begin COMPU_METHOD AirMass "Luftmasse" RAT_FUNC "%6.4" "g" COEFFS 0 100 0 0 0 1 /end COMPU_METHOD
/begin COMPU_METHOD AirMassPerCyl "Luftmasse pro Zylinder" RAT_FUNC "%6.3" "mg/Hub" COEFFS 0 10 0 0 0 1 /end COMPU_METHOD
/begin COMPU_METHOD AirMassPerTime "Luftmasse pro Zeit" RAT_FUNC "%6.3" "Kg/h" COEFFS 0 10 0 0 0 1 /end COMPU_METHOD
/begin COMPU_METHOD AirVolPerTime "Umrechnungsformel für Luftvolumenstrom" RAT_FUNC "%6.3" "m^3/h" COEFFS 0 10 0 0 0 1 /end COMPU_METHOD
/begin COMPU_METHOD AngleCaS "Winkel Nockenwelle" RAT_FUNC "%6.4" "deg CaS" COEFFS 0 85.3333333333334 0 0 0 1 /end COMPU_METHOD
/begin COMPU_METHOD AngleCrS "Winkel Kurbelwelle" RAT_FUNC "%6.4" "deg CrS" COEFFS 0 42.6666666666667 0 0 0 1 /end COMPU_METHOD
/begin COMPU_METHOD ASDrf_numDefaultState "Nummer des Default-Primärzustandes" TAB_VERB "%6.3" "-" COMPU_TAB_REF ASDrf_numDefaultState /end COMPU_METHOD
/begin COMPU_VTAB ASDrf_numDefaultState "Nummer des Default-Primärzustandes" TAB_VERB 6 0 "ExtInt" 1 "Clutch" 2 "Grip" 3 "State3" 4 "State4" 5 "Sport mode" /end COMPU_VTAB
/begin COMPU_METHOD ASDrf_stPrimState "Auswahl des Primärstatus in der Statusvariabel sollte übereinstimmedn mit der in der Definition asdrf_selectparemeter.col sein" TAB_VERB "%6.3" "-" COMPU_TAB_REF ASDrf_stPrimState /end COMPU_METHOD
/begin COMPU_VTAB ASDrf_stPrimState "Auswahl des Primärstatus in der Statusvariabel sollte übereinstimmedn mit der in der Definition asdrf_selectparemeter.col sein" TAB_VERB 7 0 "Void" 1 "ExtInt" 2 "Clutch" 4 "Grip" 8 "State3" 16 "State4" 32 "Sport mode" /end COMPU_VTAB
/begin COMPU_METHOD ASDdcState "Verbale Umrechnung für ADSdc-Parametersatzwahl" TAB_VERB "%6.3" "-" COMPU_TAB_REF dcState /end COMPU_METHOD
/begin COMPU_VTAB dcState "Verbale Umrechnung für ADSdc-Parametersatzwahl" TAB_VERB 7 1 "GripMAP" 2 "Clutch " 4 "ExtInt " 8 "State3 " 16 "State4 " 32 "SlipMAP" 64 "SportMAP" /end COMPU_VTAB
/begin COMPU_METHOD ASD_GvrnDT1Kd_float "Differentialverstärkung Kd (Motordrehzahl EngN zu Motormoment Trq)" RAT_FUNC "%6.2" "(Nm/rpm)^0.5" COEFFS 0 1 0 0 0 1 /end COMPU_METHOD
/begin COMPU_METHOD ASD_GvrnDT1T1_float "Zeitkonstante T1 (in s) für PT1, DT1 beim ARD" RAT_FUNC "%6.2" "s" COEFFS 0 1 0 0 0 1 /end COMPU_METHOD
/begin COMPU_METHOD B_TRUE "Umrechnung   ----> FALSE;    TRUE = TRUE" TAB_VERB "%6.3" "-" COMPU_TAB_REF B_TRUE /end COMPU_METHOD
/begin COMPU_VTAB B_TRUE "Umrechnung   ----> FALSE;    TRUE = TRUE" TAB_VERB 2 0 "FALSE" 1 "TRUE" /end COMPU_VTAB
/begin COMPU_METHOD Calory "Heizwert" RAT_FUNC "%6.2" "J/g" COEFFS 0 1 0 0 0 1 /end COMPU_METHOD
/begin COMPU_METHOD Can "Umrechnungsfaktor für CAN-bezogene Größen" RAT_FUNC "%6.5" "-" COEFFS 0 1000 0 0 0 1 /end COMPU_METHOD
/begin COMPU_METHOD Can1 "Umsetzungsfaktor fuer CAN verwandte Groeßen" RAT_FUNC "%7.6" "-" COEFFS 0 10000 0 0 0 1 /end COMPU_METHOD
/begin COMPU_METHOD ClassTrigger "Verbale Umrechnung für DSM_Class%TFlc_C und DSM_Class%THlc_C" TAB_VERB "%6.3" "-" COMPU_TAB_REF ClassTrigger /end COMPU_METHOD
/begin COMPU_VTAB ClassTrigger "Verbale Umrechnung für DSM_Class%TFlc_C und DSM_Class%THlc_C" TAB_VERB 4 0 "no handling" 1 "time quantum" 2 "driving cycle" 3 "warm up cycle" /end COMPU_VTAB
/begin COMPU_METHOD ClassTriggerTDlc "Verbale Umrechnung für DSM_Class%TDlc_C und DSM_Class%TDlcPen_C" TAB_VERB "%6.3" "-" COMPU_TAB_REF ClassTriggerTDlc /end COMPU_METHOD
/begin COMPU_VTAB ClassTriggerTDlc "Verbale Umrechnung für DSM_Class%TDlc_C und DSM_Class%TDlcPen_C" TAB_VERB 4 0 "no handling" 1 "each afterrun_1" 2 "each afterrun_2" 3 "warm up cycle" /end COMPU_VTAB
/begin COMPU_METHOD CoeffA "Koeffizient A in der Parabel dTrq = A * Trq^2 + Trq" RAT_FUNC "%6.4" "1/(s*Nm)" COEFFS 0 204.8 0 0 0 1 /end COMPU_METHOD
/begin COMPU_METHOD CubMtrPerHr "Volumsstrom in m^3/h" RAT_FUNC "%6.3" "m^3/h" COEFFS 0 10 0 0 0 1 /end COMPU_METHOD
/begin COMPU_METHOD CurRefPump "Applizierbarer Pumpreferenzstrom" TAB_VERB "%6.3" "-" COMPU_TAB_REF CurRefPump /end COMPU_METHOD
/begin COMPU_VTAB CurRefPump "Applizierbarer Pumpreferenzstrom" TAB_VERB 16 0 "0 uA" 1 "10 uA" 2 "20 uA" 3 "30 uA" 4 "40 uA" 5 "50 uA" 6 "60 uA" 7 "70 uA" 8 "80 uA" 9 "90 uA" 10 "100 uA" 11 "110 uA" 12 "120 uA" 13 "130 uA" 14 "140 uA" 15 "150 uA" /end COMPU_VTAB
/begin COMPU_METHOD Curr_10mA "Spannung in mA" RAT_FUNC "%6.1" "mA" COEFFS 0 0.1 0 0 0 1 /end COMPU_METHOD
/begin COMPU_METHOD Delta_Volt_INT "ADC Spannungsgradient" RAT_FUNC "%6.2" "mV/ms" COEFFS 0 1 0 0 0 1 /end COMPU_METHOD
/begin COMPU_METHOD Delta_Volt_PA "Spannungsgradient der Piezo-Aktoren" RAT_FUNC "%7.6" "V/usec" COEFFS 0 10000 0 0 0 1 /end COMPU_METHOD
/begin COMPU_METHOD dez "K3 Umwandlungen" RAT_FUNC "%6.2" "-" COEFFS 0 1 0 0 0 1 /end COMPU_METHOD
/begin COMPU_METHOD dFlConsum "Ableitung des Kraftstoffverbrauchs" RAT_FUNC "%6.4" "l/h/s" COEFFS 0 100 0 0 0 1 /end COMPU_METHOD
/begin COMPU_METHOD Dia "Durchmesser des Rades" RAT_FUNC "%7.6" "m" COEFFS 0 10000 0 0 0 1 /end COMPU_METHOD
/begin COMPU_METHOD dn_dZ20 "Motorbeschleunigung pro Zeit (dn/dt) (im 20 ms Raster)" RAT_FUNC "%6.1" "rmp/s" COEFFS 0 0.1 0 0 0 1 /end COMPU_METHOD
/begin COMPU_METHOD dn_dZfine "Engine acceleration per time (dn/dt) fine resolution" RAT_FUNC "%6.2" "rpm/s" COEFFS 0 1 0 0 0 1 /end COMPU_METHOD
/begin COMPU_METHOD dp_dZ10 "boost pressure per time (dp/dt) every 10ms" RAT_FUNC "%6.1" "hPa/s" COEFFS 0 0.1 0 0 0 1 /end COMPU_METHOD
/begin COMPU_METHOD dTrq "Umrtechnungsformel dTrq/dTime" RAT_FUNC "%6.3" "Nm/s" COEFFS 0 10 0 0 0 1 /end COMPU_METHOD
/begin COMPU_METHOD dTrqPrp_20ms "Anstieg Vortriebsmoment im 20 ms Raster" RAT_FUNC "%6.1" "Nm/s" COEFFS 0 0.1 0 0 0 1 /end COMPU_METHOD
/begin COMPU_METHOD DtyCyc "Tastverhaeltnis" RAT_FUNC "%6.4" "%" COEFFS 0 100 0 0 0 1 /end COMPU_METHOD
/begin COMPU_METHOD dVel_20ms "Anstieg Fahrgeschwindigkeit im 20 ms Raster" RAT_FUNC "%6.3" "(km/h)/s" COEFFS 0 2 0 0 0 1 /end COMPU_METHOD
/begin COMPU_METHOD EGTRmp "Zeitrampe verwendet von EGT Lib Funktionen" RAT_FUNC "%6.3" "s" COEFFS 0 0 1 0 0.0152587890625 0 /end COMPU_METHOD
/begin COMPU_METHOD EngN "Motordrehzahl" RAT_FUNC "%6.2" "rpm" COEFFS 0 1 0 0 0 1 /end COMPU_METHOD
/begin COMPU_METHOD EngN_float "Formel fuer die Drehzahl (Fließkomma)" RAT_FUNC "%6.2" "rpm" COEFFS 0 1 0 0 0 1 /end COMPU_METHOD
/begin COMPU_METHOD EngN_HiRes "Motordrehzahl, höhere Auflösung als EngM" RAT_FUNC "%6.3" "rpm" COEFFS 0 8 0 0 0 1 /end COMPU_METHOD
/begin COMPU_METHOD EngTempFldSel "Verbale Umrechnung für Auswahl aus dem Motortemperatur-Feld Eng_tFld" TAB_VERB "%6.3" "-" COMPU_TAB_REF EngTempFldSel /end COMPU_METHOD
/begin COMPU_VTAB EngTempFldSel "Verbale Umrechnung für Auswahl aus dem Motortemperatur-Feld Eng_tFld" TAB_VERB 3 0 "Coolant_Temperature" 1 "Oil_Temperature" 2 "Eng_tEng" /end COMPU_VTAB
/begin COMPU_METHOD Fact "Faktor mit Auflösung 1 / 8192, hauptsächlich für einen Faktorenbereich 0...1 verwendet" RAT_FUNC "%6.5" "-" COEFFS 0 8192 0 0 0 1 /end COMPU_METHOD
/begin COMPU_METHOD Fact1 "Faktor mit Auflösung 0,01 (100 mal höherer Bereich als Fact)" RAT_FUNC "%6.4" "-" COEFFS 0 128 0 0 0 1 /end COMPU_METHOD
/begin COMPU_METHOD Fact2 "Faktor mit Auflösung 0.001, für einen Faktorenbereich 0...5,46117 verwendet" RAT_FUNC "%7.6" "-" COEFFS 0 16384 0 0 0 1 /end COMPU_METHOD
/begin COMPU_METHOD FactHigh "Faktor mit Auflösung 1/4096, hauptsächlich für einen Faktorenbereich 0.1...10 verwendet" RAT_FUNC "%6.5" "-" COEFFS 0 8192 0 0 0 1 /end COMPU_METHOD
/begin COMPU_METHOD FactLow "Faktor mit Auflösung 1/1024, hauptsächlich für einen Faktorenbereich 1...50 verwendet" RAT_FUNC "%6.5" "-" COEFFS 0 8192 0 0 0 1 /end COMPU_METHOD
/begin COMPU_METHOD Fact_HFM6 "Umrechnung für einen Faktor mit 14 Bit Auflösung" RAT_FUNC "%7.6" "-" COEFFS 0 16384 0 0 0 1 /end COMPU_METHOD
/begin COMPU_METHOD Fact_Inc "Faktor für Inkrement/Gap Plausibilitäts-Fenster" RAT_FUNC "%6.4" "-" COEFFS 0 256 0 0 0 1 /end COMPU_METHOD
/begin COMPU_METHOD FBC_GvrnIKi_float "Integrationskonstante für FBC" RAT_FUNC "%6.2" "mg/((1/min^2)*s)" COEFFS 0 1 0 0 0 1 /end COMPU_METHOD
/begin COMPU_METHOD FBC_GvrnPKp_float "Proportinalitäts-Faktor für FBC" RAT_FUNC "%6.2" "mg/(1/min^2)" COEFFS 0 1 0 0 0 1 /end COMPU_METHOD
/begin COMPU_METHOD FlConsum_l_h "Kraftstoffverbrauch" RAT_FUNC "%6.4" "l/h" COEFFS 0 100 0 0 0 1 /end COMPU_METHOD
/begin COMPU_METHOD FlConsum_ul "Verbrauchsintegral (in Mikroliter)" RAT_FUNC "%6.2" "ul" COEFFS 0 1 0 0 0 1 /end COMPU_METHOD
/begin COMPU_METHOD FlConsum_ul_20ms "Verbrauchsintegral (in Mikroliter pro 20ms)" RAT_FUNC "%6.2" "ul/20ms" COEFFS 0 1 0 0 0 1 /end COMPU_METHOD
/begin COMPU_METHOD InjMass "Einspritzmenge" RAT_FUNC "%6.4" "mg/hub" COEFFS 0 100 0 0 0 1 /end COMPU_METHOD
/begin COMPU_METHOD InjMassCyc "Einspritzmenge pro Zyklus (mg/Zyklus)" RAT_FUNC "%6.4" "mg/cyc" COEFFS 0 100 0 0 0 1 /end COMPU_METHOD
/begin COMPU_METHOD InjMassPerSec_20ms "Einspritzmengenänderung pro Sekunde für 20ms-Tasks" RAT_FUNC "%6.3" "mg/hub/s" COEFFS 0 2 0 0 0 1 /end COMPU_METHOD
/begin COMPU_METHOD InjMassPerTime "Kraftstoffmassenstrom" RAT_FUNC "%6.4" "kg/h" COEFFS 0 100 0 0 0 1 /end COMPU_METHOD
/begin COMPU_METHOD InjQnt "Einspritzvolumen/Hub" RAT_FUNC "%6.3" "mm^3/hub" COEFFS 0 10 0 0 0 1 /end COMPU_METHOD
/begin COMPU_METHOD Kd "Differentialverstärkung Kd (gleiche Einheit/Umrechnungsformel an Ein- und Ausgang)" RAT_FUNC "%7.6" "1/1" COEFFS 0 65536 0 0 0 1 /end COMPU_METHOD
/begin COMPU_METHOD lambdaRecVal "Reziproker Lambda Wert" RAT_FUNC "%6.5" "-" COEFFS 0 1000 0 0 0 1 /end COMPU_METHOD
/begin COMPU_METHOD O2 "Sauerstoffkonzentration" RAT_FUNC "%8.7" "-" COEFFS 0 100000 0 0 0 1 /end COMPU_METHOD
/begin COMPU_METHOD O2MassPerTime "Sauerstoffmassenstrom" RAT_FUNC "%6.4" "kg/h" COEFFS 0 100 0 0 0 1 /end COMPU_METHOD
/begin COMPU_METHOD OneToOne "eins zu eins (physikalischer Wert ist gleich dem internen Wert)" RAT_FUNC "%6.2" "-" COEFFS 0 1 0 0 0 1 /end COMPU_METHOD
/begin COMPU_METHOD Period_ms "Periodendauer in ms" RAT_FUNC "%6.3" "ms" COEFFS 0 10 0 0 0 1 /end COMPU_METHOD
/begin COMPU_METHOD Per_Dur "Periodendauer Segmentzeit" RAT_FUNC "%6.2" "usec" COEFFS 0 1 0 0 0 1 /end COMPU_METHOD
/begin COMPU_METHOD Prc "Prozent, gleiche interne Auflösung wie Fact, aber Darstellung in Prozent (0...100%)" RAT_FUNC "%6.4" "%" COEFFS 0 81.92 0 0 0 1 /end COMPU_METHOD
/begin COMPU_METHOD PrcPerSec "Prozentänderung pro Sekunde für 20ms-Tasks" RAT_FUNC "%6.3" "%/s" COEFFS 0 1.6384 0 0 0 1 /end COMPU_METHOD
/begin COMPU_METHOD Pres_hPa "Druck (angezeigt in [hPa])" RAT_FUNC "%6.2" "hPa" COEFFS 0 1 0 0 0 1 /end COMPU_METHOD
/begin COMPU_METHOD Pres_Rail "Raildruck in hPa" RAT_FUNC "%4.3" "bar" COEFFS 0 10.000000 0 0 0 1 /end COMPU_METHOD
/begin COMPU_METHOD Pwr "Leistung" RAT_FUNC "%6.2" "W" COEFFS 0 0.10610329539459 0 0 0 1 /end COMPU_METHOD
/begin COMPU_METHOD RatAirMass "Luftmassenverhältnis" RAT_FUNC "%6.5" "-" COEFFS 0 1000 0 0 0 1 /end COMPU_METHOD
/begin COMPU_METHOD RatFuelMass "Kraftstoffmassenverhältnis" RAT_FUNC "%6.4" "-" COEFFS 0 100 0 0 0 1 /end COMPU_METHOD
/begin COMPU_METHOD Res_hPaHrPerCM "Strömungswiderstand [hPa h/m3]" RAT_FUNC "%6.5" "hPa/(m^3/h)" COEFFS 0 1000 0 0 0 1 /end COMPU_METHOD
/begin COMPU_METHOD t20msxs_ub_b5p1 "K3 Umwandlungen" RAT_FUNC "%6.4" "s" COEFFS 0 1 0 0 0 0.02 /end COMPU_METHOD
/begin COMPU_METHOD TempCels_100ms "Temperatur Differenz in Grad C/sec (bezgl. 100ms task)" RAT_FUNC "%6.2" "deg C/s" COEFFS 0 1 0 0 0 1 /end COMPU_METHOD
/begin COMPU_METHOD TempDiff_Cels "difference/offset temperature displayed in degree celcius" RAT_FUNC "%6.3" "deg C" COEFFS 0 10 0 0 0 1 /end COMPU_METHOD
/begin COMPU_METHOD Temp_Cels "Temperatur dargestellt in °C (gleiche interne Darstellung wie Temp_Kelv)" RAT_FUNC "%6.1" "deg C" COEFFS 0 10 2731.4 0 0 1 /end COMPU_METHOD
/begin COMPU_METHOD TimeDeb "Entprellzeit in Millisekunden für Libraryfunktion Debounce" RAT_FUNC "%6.1" "ms" COEFFS 0 0.1 0 0 0 1 /end COMPU_METHOD
/begin COMPU_METHOD TimeDelay_s "Zeitkonstante T1 (in s) für PT1, DT1, etc." RAT_FUNC "%9.3" "s" COEFFS 0 0 1 0 0.00023283064365387 0 /end COMPU_METHOD
/begin COMPU_METHOD TimeDT "Abtastzeit (in us) für Library Regler, Filter, etc." RAT_FUNC "%6.2" "us" COEFFS 0 1 0 0 0 1 /end COMPU_METHOD
/begin COMPU_METHOD TimeRed "Zeit in Sekunden mit reduzierter Auflösung für Ein/Ausgänge von KL/KF (sint16)" RAT_FUNC "%6.3" "s" COEFFS 0 6.25 0 0 0 1 /end COMPU_METHOD
/begin COMPU_METHOD Time_ms "Zeit in ms für Fehlerentprellung (DSM) und SW-Timer" RAT_FUNC "%6.1" "ms" COEFFS 0 0.1 0 0 0 1 /end COMPU_METHOD
/begin COMPU_METHOD Time_s "Zeit in s für Fehlerentprellung (DSM) und SW-Timer" RAT_FUNC "%6.4" "s" COEFFS 0 100 0 0 0 1 /end COMPU_METHOD
/begin COMPU_METHOD TransR "Übersetzungsverhältnis (Getriebe etc.)" RAT_FUNC "%6.4" "-" COEFFS 0 100 0 0 0 1 /end COMPU_METHOD
/begin COMPU_METHOD Trq "Motormoment" RAT_FUNC "%6.3" "Nm" COEFFS 0 10 0 0 0 1 /end COMPU_METHOD
/begin COMPU_METHOD Trq32 "Umrechungsformel für inneres Moment in 32bit Zahlendarstellung" RAT_FUNC "%8.7" "Nm" COEFFS 0 655360 0 0 0 1 /end COMPU_METHOD
/begin COMPU_METHOD TrqPrp "Vortriebsmoment" RAT_FUNC "%6.3" "Nm" COEFFS 0 5 0 0 0 1 /end COMPU_METHOD
/begin COMPU_METHOD TrqPrpDT "zeitlich aufintegriertes Vortriebsmoment" RAT_FUNC "%6.2" "Nm*s" COEFFS 0 0.2 0 0 0 1 /end COMPU_METHOD
/begin COMPU_METHOD Vel "Fahrzeuggeschwindigkeit, gleiche interne Auflösung wie Vel_SI" RAT_FUNC "%6.4" "km/h" COEFFS 0 100 0 0 0 1 /end COMPU_METHOD
/begin COMPU_METHOD VelToN "Verhältnis Fahrzeuggeschwindigkeit zu Motordrehzahl v/n" RAT_FUNC "%8.7" "(km/h)/rpm" COEFFS 0 100000 0 0 0 1 /end COMPU_METHOD
/begin COMPU_METHOD Vel_mpm "Umrechnung von Kmph nach mpm" RAT_FUNC "%6.4" "m/min" COEFFS 0 100 0 0 0 1 /end COMPU_METHOD
/begin COMPU_METHOD Volt "Spannung in V (von ADC)" RAT_FUNC "%6.2" "mV" COEFFS 0 0.2046 0 0 0 1 /end COMPU_METHOD
/begin COMPU_METHOD Volt_Batt "Batteriespannung" RAT_FUNC "%6.1" "mV" COEFFS 0 0.05115 0 0 0 1 /end COMPU_METHOD
/begin COMPU_METHOD WheelN "Umrechnung fuer RPM" RAT_FUNC "%6.2" "rpm" COEFFS 0 1 0 0 0 1 /end COMPU_METHOD
/end MODULE
/end PROJECT
