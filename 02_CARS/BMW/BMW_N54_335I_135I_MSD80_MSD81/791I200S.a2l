ASAP2_VERSION 1 41
/begin PROJECT MSD85 "Spray Guided DI-System with Piezo Injectors for 8-Cylinder"
/begin HEADER "_default_HeaderComment" PROJECT_NO _91 /end HEADER
/begin MODULE _default_ModuleName "_default_ModuleLongIdentifier"
/begin MOD_COMMON "_default_ModCommonComment" DEPOSIT ABSOLUTE BYTE_ORDER MSB_LAST ALIGNMENT_BYTE 1 ALIGNMENT_WORD 2 ALIGNMENT_LONG 2 ALIGNMENT_FLOAT32_IEEE 2 ALIGNMENT_FLOAT64_IEEE 4 /end MOD_COMMON
/begin MEASUREMENT fmy_stat_acr_dr.ctr_abc "anti bounce counter for diagnosis instance ACR_DR" UBYTE _CNV_A_R_LINEAR_____0_CM 1 100. 0. 255. DISPLAY_IDENTIFIER CTR_ABC_ACR_DR ECU_ADDRESS 0xd00093c0 FORMAT "%3.0" /end MEASUREMENT
/begin MEASUREMENT fmy_stat_acr_dr.ctr_end_diag "counter for end of diagnosis for diagnosis instance ACR_DR" UBYTE _CNV_A_R_LINEAR_____0_CM 1 100. 0. 255. DISPLAY_IDENTIFIER CTR_ABC_END_DIAG_ACR_DR ECU_ADDRESS 0xd00093c1 FORMAT "%3.0" /end MEASUREMENT
/begin MEASUREMENT fmy_stat_acr_dr.err_info_stat.lv_err_mem "storage in dynamic failure memory of the diagnosis instance ACR_DR" UWORD _CNV_S_2_RANGE__0___1_CM 1 100. 0. 1. DISPLAY_IDENTIFIER LV_ERR_MEM_ACR_DR ECU_ADDRESS 0xd00093c2 BIT_MASK 0x8 /end MEASUREMENT
/begin MEASUREMENT fmy_stat_acr_dr.err_info_stat.lv_ready "readiness status of the diagnosis instance ACR_DR" UWORD _CNV_S_2_RANGE__0___1_CM 1 100. 0. 1. DISPLAY_IDENTIFIER LV_READY_ACR_DR ECU_ADDRESS 0xd00093c2 BIT_MASK 0x10 /end MEASUREMENT
/begin MEASUREMENT fmy_stat_acr_dr.err_info_stat.lv_end_diag "end of diagnosis of the diagnosis instance ACR_DR" UWORD _CNV_S_2_RANGE__0___1_CM 1 100. 0. 1. DISPLAY_IDENTIFIER LV_END_DIAG_ACR_DR ECU_ADDRESS 0xd00093c2 BIT_MASK 0x20 /end MEASUREMENT
/begin MEASUREMENT fmy_stat_acr_dr.err_info_stat.lv_cdn_diag "diagnosis condition of the diagnosis instance ACR_DR" UWORD _CNV_S_2_RANGE__0___1_CM 1 100. 0. 1. DISPLAY_IDENTIFIER LV_CDN_DIAG_ACR_DR ECU_ADDRESS 0xd00093c2 BIT_MASK 0x40 /end MEASUREMENT
/begin MEASUREMENT fmy_stat_acr_dr.err_info_stat.err_sym "symptoms of the diagnosis instance ACR_DR" UWORD _CNV_S_16_RANGE_ERR__349_CM 1 100. 0. 15. DISPLAY_IDENTIFIER ERR_SYM_ACR_DR ECU_ADDRESS 0xd00093c2 BIT_MASK 0x780 /end MEASUREMENT
/begin MEASUREMENT fmy_stat_var_cod.ctr_abc "anti bounce counter for diagnosis instance VAR_COD" UBYTE _CNV_A_R_LINEAR_____0_CM 1 100. 0. 255. DISPLAY_IDENTIFIER CTR_ABC_VAR_COD ECU_ADDRESS 0xd0009ae4 FORMAT "%3.0" /end MEASUREMENT
/begin MEASUREMENT fmy_stat_var_cod.ctr_end_diag "counter for end of diagnosis for diagnosis instance VAR_COD" UBYTE _CNV_A_R_LINEAR_____0_CM 1 100. 0. 255. DISPLAY_IDENTIFIER CTR_ABC_END_DIAG_VAR_COD ECU_ADDRESS 0xd0009ae5 FORMAT "%3.0" /end MEASUREMENT
/begin MEASUREMENT fmy_stat_var_cod.err_info_stat.lv_err_mem "storage in dynamic failure memory of the diagnosis instance VAR_COD" UWORD _CNV_S_2_RANGE__0___1_CM 1 100. 0. 1. DISPLAY_IDENTIFIER LV_ERR_MEM_VAR_COD ECU_ADDRESS 0xd0009ae6 BIT_MASK 0x8 /end MEASUREMENT
/begin MEASUREMENT fmy_stat_var_cod.err_info_stat.lv_ready "readiness status of the diagnosis instance VAR_COD" UWORD _CNV_S_2_RANGE__0___1_CM 1 100. 0. 1. DISPLAY_IDENTIFIER LV_READY_VAR_COD ECU_ADDRESS 0xd0009ae6 BIT_MASK 0x10 /end MEASUREMENT
/begin MEASUREMENT fmy_stat_var_cod.err_info_stat.lv_end_diag "end of diagnosis of the diagnosis instance VAR_COD" UWORD _CNV_S_2_RANGE__0___1_CM 1 100. 0. 1. DISPLAY_IDENTIFIER LV_END_DIAG_VAR_COD ECU_ADDRESS 0xd0009ae6 BIT_MASK 0x20 /end MEASUREMENT
/begin MEASUREMENT fmy_stat_var_cod.err_info_stat.lv_cdn_diag "diagnosis condition of the diagnosis instance VAR_COD" UWORD _CNV_S_2_RANGE__0___1_CM 1 100. 0. 1. DISPLAY_IDENTIFIER LV_CDN_DIAG_VAR_COD ECU_ADDRESS 0xd0009ae6 BIT_MASK 0x40 /end MEASUREMENT
/begin MEASUREMENT fmy_stat_var_cod.err_info_stat.err_sym "symptoms of the diagnosis instance VAR_COD" UWORD _CNV_S_16_RANGE_ERR__349_CM 1 100. 0. 15. DISPLAY_IDENTIFIER ERR_SYM_VAR_COD ECU_ADDRESS 0xd0009ae6 BIT_MASK 0x780 /end MEASUREMENT
/begin MEASUREMENT fmy_stat_veh_pow_var.ctr_abc "anti bounce counter for diagnosis instance VEH_POW_VAR" UBYTE _CNV_A_R_LINEAR_____0_CM 1 100. 0. 255. DISPLAY_IDENTIFIER CTR_ABC_VEH_POW_VAR ECU_ADDRESS 0xd0009af0 FORMAT "%3.0" /end MEASUREMENT
/begin MEASUREMENT fmy_stat_veh_pow_var.ctr_end_diag "counter for end of diagnosis for diagnosis instance VEH_POW_VAR" UBYTE _CNV_A_R_LINEAR_____0_CM 1 100. 0. 255. DISPLAY_IDENTIFIER CTR_ABC_END_DIAG_VEH_POW_VAR ECU_ADDRESS 0xd0009af1 FORMAT "%3.0" /end MEASUREMENT
/begin MEASUREMENT fmy_stat_veh_pow_var.err_info_stat.lv_err_mem "storage in dynamic failure memory of the diagnosis instance VEH_POW_VAR" UWORD _CNV_S_2_RANGE__0___1_CM 1 100. 0. 1. DISPLAY_IDENTIFIER LV_ERR_MEM_VEH_POW_VAR ECU_ADDRESS 0xd0009af2 BIT_MASK 0x8 /end MEASUREMENT
/begin MEASUREMENT fmy_stat_veh_pow_var.err_info_stat.lv_ready "readiness status of the diagnosis instance VEH_POW_VAR" UWORD _CNV_S_2_RANGE__0___1_CM 1 100. 0. 1. DISPLAY_IDENTIFIER LV_READY_VEH_POW_VAR ECU_ADDRESS 0xd0009af2 BIT_MASK 0x10 /end MEASUREMENT
/begin MEASUREMENT fmy_stat_veh_pow_var.err_info_stat.lv_end_diag "end of diagnosis of the diagnosis instance VEH_POW_VAR" UWORD _CNV_S_2_RANGE__0___1_CM 1 100. 0. 1. DISPLAY_IDENTIFIER LV_END_DIAG_VEH_POW_VAR ECU_ADDRESS 0xd0009af2 BIT_MASK 0x20 /end MEASUREMENT
/begin MEASUREMENT fmy_stat_veh_pow_var.err_info_stat.lv_cdn_diag "diagnosis condition of the diagnosis instance VEH_POW_VAR" UWORD _CNV_S_2_RANGE__0___1_CM 1 100. 0. 1. DISPLAY_IDENTIFIER LV_CDN_DIAG_VEH_POW_VAR ECU_ADDRESS 0xd0009af2 BIT_MASK 0x40 /end MEASUREMENT
/begin MEASUREMENT fmy_stat_veh_pow_var.err_info_stat.err_sym "symptoms of the diagnosis instance VEH_POW_VAR" UWORD _CNV_S_16_RANGE_ERR__349_CM 1 100. 0. 15. DISPLAY_IDENTIFIER ERR_SYM_VEH_POW_VAR ECU_ADDRESS 0xd0009af2 BIT_MASK 0x780 /end MEASUREMENT
/begin MEASUREMENT fmy_stat_fup_mfp_plaus.ctr_abc "anti bounce counter for diagnosis instance FUP_MFP_PLAUS" UBYTE _CNV_A_R_LINEAR_____0_CM 1 100. 0. 255. DISPLAY_IDENTIFIER CTR_ABC_FUP_MFP_PLAUS ECU_ADDRESS 0xd00096b8 FORMAT "%3.0" /end MEASUREMENT
/begin MEASUREMENT fmy_stat_fup_mfp_plaus.ctr_end_diag "counter for end of diagnosis for diagnosis instance FUP_MFP_PLAUS" UBYTE _CNV_A_R_LINEAR_____0_CM 1 100. 0. 255. DISPLAY_IDENTIFIER CTR_ABC_END_DIAG_FUP_MFP_PLAUS ECU_ADDRESS 0xd00096b9 FORMAT "%3.0" /end MEASUREMENT
/begin MEASUREMENT fmy_stat_fup_mfp_plaus.err_info_stat.lv_err_mem "storage in dynamic failure memory of the diagnosis instance FUP_MFP_PLAUS" UWORD _CNV_S_2_RANGE__0___1_CM 1 100. 0. 1. DISPLAY_IDENTIFIER LV_ERR_MEM_FUP_MFP_PLAUS ECU_ADDRESS 0xd00096ba BIT_MASK 0x8 /end MEASUREMENT
/begin MEASUREMENT fmy_stat_fup_mfp_plaus.err_info_stat.lv_ready "readiness status of the diagnosis instance FUP_MFP_PLAUS" UWORD _CNV_S_2_RANGE__0___1_CM 1 100. 0. 1. DISPLAY_IDENTIFIER LV_READY_FUP_MFP_PLAUS ECU_ADDRESS 0xd00096ba BIT_MASK 0x10 /end MEASUREMENT
/begin MEASUREMENT fmy_stat_fup_mfp_plaus.err_info_stat.lv_end_diag "end of diagnosis of the diagnosis instance FUP_MFP_PLAUS" UWORD _CNV_S_2_RANGE__0___1_CM 1 100. 0. 1. DISPLAY_IDENTIFIER LV_END_DIAG_FUP_MFP_PLAUS ECU_ADDRESS 0xd00096ba BIT_MASK 0x20 /end MEASUREMENT
/begin MEASUREMENT fmy_stat_fup_mfp_plaus.err_info_stat.lv_cdn_diag "diagnosis condition of the diagnosis instance FUP_MFP_PLAUS" UWORD _CNV_S_2_RANGE__0___1_CM 1 100. 0. 1. DISPLAY_IDENTIFIER LV_CDN_DIAG_FUP_MFP_PLAUS ECU_ADDRESS 0xd00096ba BIT_MASK 0x40 /end MEASUREMENT
/begin MEASUREMENT fmy_stat_fup_mfp_plaus.err_info_stat.err_sym "symptoms of the diagnosis instance FUP_MFP_PLAUS" UWORD _CNV_S_16_RANGE_ERR__349_CM 1 100. 0. 15. DISPLAY_IDENTIFIER ERR_SYM_FUP_MFP_PLAUS ECU_ADDRESS 0xd00096ba BIT_MASK 0x780 /end MEASUREMENT
/begin MEASUREMENT fmy_stat_h_prs_sys.ctr_abc "anti bounce counter for diagnosis instance H_PRS_SYS" UBYTE _CNV_A_R_LINEAR_____0_CM 1 100. 0. 255. DISPLAY_IDENTIFIER CTR_ABC_H_PRS_SYS ECU_ADDRESS 0xd00096e8 FORMAT "%3.0" /end MEASUREMENT
/begin MEASUREMENT fmy_stat_h_prs_sys.ctr_end_diag "counter for end of diagnosis for diagnosis instance H_PRS_SYS" UBYTE _CNV_A_R_LINEAR_____0_CM 1 100. 0. 255. DISPLAY_IDENTIFIER CTR_ABC_END_DIAG_H_PRS_SYS ECU_ADDRESS 0xd00096e9 FORMAT "%3.0" /end MEASUREMENT
/begin MEASUREMENT fmy_stat_h_prs_sys.err_info_stat.lv_err_mem "storage in dynamic failure memory of the diagnosis instance H_PRS_SYS" UWORD _CNV_S_2_RANGE__0___1_CM 1 100. 0. 1. DISPLAY_IDENTIFIER LV_ERR_MEM_H_PRS_SYS ECU_ADDRESS 0xd00096ea BIT_MASK 0x8 /end MEASUREMENT
/begin MEASUREMENT fmy_stat_h_prs_sys.err_info_stat.lv_ready "readiness status of the diagnosis instance H_PRS_SYS" UWORD _CNV_S_2_RANGE__0___1_CM 1 100. 0. 1. DISPLAY_IDENTIFIER LV_READY_H_PRS_SYS ECU_ADDRESS 0xd00096ea BIT_MASK 0x10 /end MEASUREMENT
/begin MEASUREMENT fmy_stat_h_prs_sys.err_info_stat.lv_end_diag "end of diagnosis of the diagnosis instance H_PRS_SYS" UWORD _CNV_S_2_RANGE__0___1_CM 1 100. 0. 1. DISPLAY_IDENTIFIER LV_END_DIAG_H_PRS_SYS ECU_ADDRESS 0xd00096ea BIT_MASK 0x20 /end MEASUREMENT
/begin MEASUREMENT fmy_stat_h_prs_sys.err_info_stat.lv_cdn_diag "diagnosis condition of the diagnosis instance H_PRS_SYS" UWORD _CNV_S_2_RANGE__0___1_CM 1 100. 0. 1. DISPLAY_IDENTIFIER LV_CDN_DIAG_H_PRS_SYS ECU_ADDRESS 0xd00096ea BIT_MASK 0x40 /end MEASUREMENT
/begin MEASUREMENT fmy_stat_h_prs_sys.err_info_stat.err_sym "symptoms of the diagnosis instance H_PRS_SYS" UWORD _CNV_S_16_RANGE_ERR__349_CM 1 100. 0. 15. DISPLAY_IDENTIFIER ERR_SYM_H_PRS_SYS ECU_ADDRESS 0xd00096ea BIT_MASK 0x780 /end MEASUREMENT
/begin MEASUREMENT fmy_stat_fup_0.ctr_abc "anti bounce counter for diagnosis instance FUP_0" UBYTE _CNV_A_R_LINEAR_____0_CM 1 100. 0. 255. DISPLAY_IDENTIFIER CTR_ABC_FUP_0 ECU_ADDRESS 0xd00096ac FORMAT "%3.0" /end MEASUREMENT
/begin MEASUREMENT fmy_stat_fup_0.ctr_end_diag "counter for end of diagnosis for diagnosis instance FUP_0" UBYTE _CNV_A_R_LINEAR_____0_CM 1 100. 0. 255. DISPLAY_IDENTIFIER CTR_ABC_END_DIAG_FUP_0 ECU_ADDRESS 0xd00096ad FORMAT "%3.0" /end MEASUREMENT
/begin MEASUREMENT fmy_stat_fup_0.err_info_stat.lv_err_mem "storage in dynamic failure memory of the diagnosis instance FUP_0" UWORD _CNV_S_2_RANGE__0___1_CM 1 100. 0. 1. DISPLAY_IDENTIFIER LV_ERR_MEM_FUP_0 ECU_ADDRESS 0xd00096ae BIT_MASK 0x8 /end MEASUREMENT
/begin MEASUREMENT fmy_stat_fup_0.err_info_stat.lv_ready "readiness status of the diagnosis instance FUP_0" UWORD _CNV_S_2_RANGE__0___1_CM 1 100. 0. 1. DISPLAY_IDENTIFIER LV_READY_FUP_0 ECU_ADDRESS 0xd00096ae BIT_MASK 0x10 /end MEASUREMENT
/begin MEASUREMENT fmy_stat_fup_0.err_info_stat.lv_end_diag "end of diagnosis of the diagnosis instance FUP_0" UWORD _CNV_S_2_RANGE__0___1_CM 1 100. 0. 1. DISPLAY_IDENTIFIER LV_END_DIAG_FUP_0 ECU_ADDRESS 0xd00096ae BIT_MASK 0x20 /end MEASUREMENT
/begin MEASUREMENT fmy_stat_fup_0.err_info_stat.lv_cdn_diag "diagnosis condition of the diagnosis instance FUP_0" UWORD _CNV_S_2_RANGE__0___1_CM 1 100. 0. 1. DISPLAY_IDENTIFIER LV_CDN_DIAG_FUP_0 ECU_ADDRESS 0xd00096ae BIT_MASK 0x40 /end MEASUREMENT
/begin MEASUREMENT fmy_stat_fup_0.err_info_stat.err_sym "symptoms of the diagnosis instance FUP_0" UWORD _CNV_S_16_RANGE_ERR__349_CM 1 100. 0. 15. DISPLAY_IDENTIFIER ERR_SYM_FUP_0 ECU_ADDRESS 0xd00096ae BIT_MASK 0x780 /end MEASUREMENT
/begin MEASUREMENT fmy_stat_fup_1.ctr_abc "anti bounce counter for diagnosis instance FUP_1" UBYTE _CNV_A_R_LINEAR_____0_CM 1 100. 0. 255. DISPLAY_IDENTIFIER CTR_ABC_FUP_1 ECU_ADDRESS 0xd00096b0 FORMAT "%3.0" /end MEASUREMENT
/begin MEASUREMENT fmy_stat_fup_1.ctr_end_diag "counter for end of diagnosis for diagnosis instance FUP_1" UBYTE _CNV_A_R_LINEAR_____0_CM 1 100. 0. 255. DISPLAY_IDENTIFIER CTR_ABC_END_DIAG_FUP_1 ECU_ADDRESS 0xd00096b1 FORMAT "%3.0" /end MEASUREMENT
/begin MEASUREMENT fmy_stat_fup_1.err_info_stat.lv_err_mem "storage in dynamic failure memory of the diagnosis instance FUP_1" UWORD _CNV_S_2_RANGE__0___1_CM 1 100. 0. 1. DISPLAY_IDENTIFIER LV_ERR_MEM_FUP_1 ECU_ADDRESS 0xd00096b2 BIT_MASK 0x8 /end MEASUREMENT
/begin MEASUREMENT fmy_stat_fup_1.err_info_stat.lv_ready "readiness status of the diagnosis instance FUP_1" UWORD _CNV_S_2_RANGE__0___1_CM 1 100. 0. 1. DISPLAY_IDENTIFIER LV_READY_FUP_1 ECU_ADDRESS 0xd00096b2 BIT_MASK 0x10 /end MEASUREMENT
/begin MEASUREMENT fmy_stat_fup_1.err_info_stat.lv_end_diag "end of diagnosis of the diagnosis instance FUP_1" UWORD _CNV_S_2_RANGE__0___1_CM 1 100. 0. 1. DISPLAY_IDENTIFIER LV_END_DIAG_FUP_1 ECU_ADDRESS 0xd00096b2 BIT_MASK 0x20 /end MEASUREMENT
/begin MEASUREMENT fmy_stat_fup_1.err_info_stat.lv_cdn_diag "diagnosis condition of the diagnosis instance FUP_1" UWORD _CNV_S_2_RANGE__0___1_CM 1 100. 0. 1. DISPLAY_IDENTIFIER LV_CDN_DIAG_FUP_1 ECU_ADDRESS 0xd00096b2 BIT_MASK 0x40 /end MEASUREMENT
/begin MEASUREMENT fmy_stat_fup_1.err_info_stat.err_sym "symptoms of the diagnosis instance FUP_1" UWORD _CNV_S_16_RANGE_ERR__349_CM 1 100. 0. 15. DISPLAY_IDENTIFIER ERR_SYM_FUP_1 ECU_ADDRESS 0xd00096b2 BIT_MASK 0x780 /end MEASUREMENT
/begin MEASUREMENT fmy_stat_vcv_fpc_0.ctr_abc "anti bounce counter for diagnosis instance VCV_FPC_0" UBYTE _CNV_A_R_LINEAR_____0_CM 1 100. 0. 255. DISPLAY_IDENTIFIER CTR_ABC_VCV_FPC_0 ECU_ADDRESS 0xd0009ae8 FORMAT "%3.0" /end MEASUREMENT
/begin MEASUREMENT fmy_stat_vcv_fpc_0.ctr_end_diag "counter for end of diagnosis for diagnosis instance VCV_FPC_0" UBYTE _CNV_A_R_LINEAR_____0_CM 1 100. 0. 255. DISPLAY_IDENTIFIER CTR_ABC_END_DIAG_VCV_FPC_0 ECU_ADDRESS 0xd0009ae9 FORMAT "%3.0" /end MEASUREMENT
/begin MEASUREMENT fmy_stat_vcv_fpc_0.err_info_stat.lv_err_mem "storage in dynamic failure memory of the diagnosis instance VCV_FPC_0" UWORD _CNV_S_2_RANGE__0___1_CM 1 100. 0. 1. DISPLAY_IDENTIFIER LV_ERR_MEM_VCV_FPC_0 ECU_ADDRESS 0xd0009aea BIT_MASK 0x8 /end MEASUREMENT
/begin MEASUREMENT fmy_stat_vcv_fpc_0.err_info_stat.lv_ready "readiness status of the diagnosis instance VCV_FPC_0" UWORD _CNV_S_2_RANGE__0___1_CM 1 100. 0. 1. DISPLAY_IDENTIFIER LV_READY_VCV_FPC_0 ECU_ADDRESS 0xd0009aea BIT_MASK 0x10 /end MEASUREMENT
/begin MEASUREMENT fmy_stat_vcv_fpc_0.err_info_stat.lv_end_diag "end of diagnosis of the diagnosis instance VCV_FPC_0" UWORD _CNV_S_2_RANGE__0___1_CM 1 100. 0. 1. DISPLAY_IDENTIFIER LV_END_DIAG_VCV_FPC_0 ECU_ADDRESS 0xd0009aea BIT_MASK 0x20 /end MEASUREMENT
/begin MEASUREMENT fmy_stat_vcv_fpc_0.err_info_stat.lv_cdn_diag "diagnosis condition of the diagnosis instance VCV_FPC_0" UWORD _CNV_S_2_RANGE__0___1_CM 1 100. 0. 1. DISPLAY_IDENTIFIER LV_CDN_DIAG_VCV_FPC_0 ECU_ADDRESS 0xd0009aea BIT_MASK 0x40 /end MEASUREMENT
/begin MEASUREMENT fmy_stat_vcv_fpc_0.err_info_stat.err_sym "symptoms of the diagnosis instance VCV_FPC_0" UWORD _CNV_S_16_RANGE_ERR__349_CM 1 100. 0. 15. DISPLAY_IDENTIFIER ERR_SYM_VCV_FPC_0 ECU_ADDRESS 0xd0009aea BIT_MASK 0x780 /end MEASUREMENT
/begin MEASUREMENT fmy_stat_fup_efp.ctr_abc "anti bounce counter for diagnosis instance FUP_EFP" UBYTE _CNV_A_R_LINEAR_____0_CM 1 100. 0. 255. DISPLAY_IDENTIFIER CTR_ABC_FUP_EFP ECU_ADDRESS 0xd00096b4 FORMAT "%3.0" /end MEASUREMENT
/begin MEASUREMENT fmy_stat_fup_efp.ctr_end_diag "counter for end of diagnosis for diagnosis instance FUP_EFP" UBYTE _CNV_A_R_LINEAR_____0_CM 1 100. 0. 255. DISPLAY_IDENTIFIER CTR_ABC_END_DIAG_FUP_EFP ECU_ADDRESS 0xd00096b5 FORMAT "%3.0" /end MEASUREMENT
/begin MEASUREMENT fmy_stat_fup_efp.err_info_stat.lv_err_mem "storage in dynamic failure memory of the diagnosis instance FUP_EFP" UWORD _CNV_S_2_RANGE__0___1_CM 1 100. 0. 1. DISPLAY_IDENTIFIER LV_ERR_MEM_FUP_EFP ECU_ADDRESS 0xd00096b6 BIT_MASK 0x8 /end MEASUREMENT
/begin MEASUREMENT fmy_stat_fup_efp.err_info_stat.lv_ready "readiness status of the diagnosis instance FUP_EFP" UWORD _CNV_S_2_RANGE__0___1_CM 1 100. 0. 1. DISPLAY_IDENTIFIER LV_READY_FUP_EFP ECU_ADDRESS 0xd00096b6 BIT_MASK 0x10 /end MEASUREMENT
/begin MEASUREMENT fmy_stat_fup_efp.err_info_stat.lv_end_diag "end of diagnosis of the diagnosis instance FUP_EFP" UWORD _CNV_S_2_RANGE__0___1_CM 1 100. 0. 1. DISPLAY_IDENTIFIER LV_END_DIAG_FUP_EFP ECU_ADDRESS 0xd00096b6 BIT_MASK 0x20 /end MEASUREMENT
/begin MEASUREMENT fmy_stat_fup_efp.err_info_stat.lv_cdn_diag "diagnosis condition of the diagnosis instance FUP_EFP" UWORD _CNV_S_2_RANGE__0___1_CM 1 100. 0. 1. DISPLAY_IDENTIFIER LV_CDN_DIAG_FUP_EFP ECU_ADDRESS 0xd00096b6 BIT_MASK 0x40 /end MEASUREMENT
/begin MEASUREMENT fmy_stat_fup_efp.err_info_stat.err_sym "symptoms of the diagnosis instance FUP_EFP" UWORD _CNV_S_16_RANGE_ERR__349_CM 1 100. 0. 15. DISPLAY_IDENTIFIER ERR_SYM_FUP_EFP ECU_ADDRESS 0xd00096b6 BIT_MASK 0x780 /end MEASUREMENT
/begin MEASUREMENT fmy_stat_efppwm_plaus.ctr_abc "anti bounce counter for diagnosis instance EFPPWM_PLAUS" UBYTE _CNV_A_R_LINEAR_____0_CM 1 100. 0. 255. DISPLAY_IDENTIFIER CTR_ABC_EFPPWM_PLAUS ECU_ADDRESS 0xd0009650 FORMAT "%3.0" /end MEASUREMENT
/begin MEASUREMENT fmy_stat_efppwm_plaus.ctr_end_diag "counter for end of diagnosis for diagnosis instance EFPPWM_PLAUS" UBYTE _CNV_A_R_LINEAR_____0_CM 1 100. 0. 255. DISPLAY_IDENTIFIER CTR_ABC_END_DIAG_EFPPWM_PLAUS ECU_ADDRESS 0xd0009651 FORMAT "%3.0" /end MEASUREMENT
/begin MEASUREMENT fmy_stat_efppwm_plaus.err_info_stat.lv_err_mem "storage in dynamic failure memory of the diagnosis instance EFPPWM_PLAUS" UWORD _CNV_S_2_RANGE__0___1_CM 1 100. 0. 1. DISPLAY_IDENTIFIER LV_ERR_MEM_EFPPWM_PLAUS ECU_ADDRESS 0xd0009652 BIT_MASK 0x8 /end MEASUREMENT
/begin MEASUREMENT fmy_stat_efppwm_plaus.err_info_stat.lv_ready "readiness status of the diagnosis instance EFPPWM_PLAUS" UWORD _CNV_S_2_RANGE__0___1_CM 1 100. 0. 1. DISPLAY_IDENTIFIER LV_READY_EFPPWM_PLAUS ECU_ADDRESS 0xd0009652 BIT_MASK 0x10 /end MEASUREMENT
/begin MEASUREMENT fmy_stat_efppwm_plaus.err_info_stat.lv_end_diag "end of diagnosis of the diagnosis instance EFPPWM_PLAUS" UWORD _CNV_S_2_RANGE__0___1_CM 1 100. 0. 1. DISPLAY_IDENTIFIER LV_END_DIAG_EFPPWM_PLAUS ECU_ADDRESS 0xd0009652 BIT_MASK 0x20 /end MEASUREMENT
/begin MEASUREMENT fmy_stat_efppwm_plaus.err_info_stat.lv_cdn_diag "diagnosis condition of the diagnosis instance EFPPWM_PLAUS" UWORD _CNV_S_2_RANGE__0___1_CM 1 100. 0. 1. DISPLAY_IDENTIFIER LV_CDN_DIAG_EFPPWM_PLAUS ECU_ADDRESS 0xd0009652 BIT_MASK 0x40 /end MEASUREMENT
/begin MEASUREMENT fmy_stat_efppwm_plaus.err_info_stat.err_sym "symptoms of the diagnosis instance EFPPWM_PLAUS" UWORD _CNV_S_16_RANGE_ERR__349_CM 1 100. 0. 15. DISPLAY_IDENTIFIER ERR_SYM_EFPPWM_PLAUS ECU_ADDRESS 0xd0009652 BIT_MASK 0x780 /end MEASUREMENT
/begin MEASUREMENT fmy_stat_l_prs_sys.ctr_abc "anti bounce counter for diagnosis instance L_PRS_SYS" UBYTE _CNV_A_R_LINEAR_____0_CM 1 100. 0. 255. DISPLAY_IDENTIFIER CTR_ABC_L_PRS_SYS ECU_ADDRESS 0xd00097bc FORMAT "%3.0" /end MEASUREMENT
/begin MEASUREMENT fmy_stat_l_prs_sys.ctr_end_diag "counter for end of diagnosis for diagnosis instance L_PRS_SYS" UBYTE _CNV_A_R_LINEAR_____0_CM 1 100. 0. 255. DISPLAY_IDENTIFIER CTR_ABC_END_DIAG_L_PRS_SYS ECU_ADDRESS 0xd00097bd FORMAT "%3.0" /end MEASUREMENT
/begin MEASUREMENT fmy_stat_l_prs_sys.err_info_stat.lv_err_mem "storage in dynamic failure memory of the diagnosis instance L_PRS_SYS" UWORD _CNV_S_2_RANGE__0___1_CM 1 100. 0. 1. DISPLAY_IDENTIFIER LV_ERR_MEM_L_PRS_SYS ECU_ADDRESS 0xd00097be BIT_MASK 0x8 /end MEASUREMENT
/begin MEASUREMENT fmy_stat_l_prs_sys.err_info_stat.lv_ready "readiness status of the diagnosis instance L_PRS_SYS" UWORD _CNV_S_2_RANGE__0___1_CM 1 100. 0. 1. DISPLAY_IDENTIFIER LV_READY_L_PRS_SYS ECU_ADDRESS 0xd00097be BIT_MASK 0x10 /end MEASUREMENT
/begin MEASUREMENT fmy_stat_l_prs_sys.err_info_stat.lv_end_diag "end of diagnosis of the diagnosis instance L_PRS_SYS" UWORD _CNV_S_2_RANGE__0___1_CM 1 100. 0. 1. DISPLAY_IDENTIFIER LV_END_DIAG_L_PRS_SYS ECU_ADDRESS 0xd00097be BIT_MASK 0x20 /end MEASUREMENT
/begin MEASUREMENT fmy_stat_l_prs_sys.err_info_stat.lv_cdn_diag "diagnosis condition of the diagnosis instance L_PRS_SYS" UWORD _CNV_S_2_RANGE__0___1_CM 1 100. 0. 1. DISPLAY_IDENTIFIER LV_CDN_DIAG_L_PRS_SYS ECU_ADDRESS 0xd00097be BIT_MASK 0x40 /end MEASUREMENT
/begin MEASUREMENT fmy_stat_l_prs_sys.err_info_stat.err_sym "symptoms of the diagnosis instance L_PRS_SYS" UWORD _CNV_S_16_RANGE_ERR__349_CM 1 100. 0. 15. DISPLAY_IDENTIFIER ERR_SYM_L_PRS_SYS ECU_ADDRESS 0xd00097be BIT_MASK 0x780 /end MEASUREMENT
/begin MEASUREMENT fmy_stat_vcv_fpc_1.ctr_abc "anti bounce counter for diagnosis instance VCV_FPC_1" UBYTE _CNV_A_R_LINEAR_____0_CM 1 100. 0. 255. DISPLAY_IDENTIFIER CTR_ABC_VCV_FPC_1 ECU_ADDRESS 0xd0009aec FORMAT "%3.0" /end MEASUREMENT
/begin MEASUREMENT fmy_stat_vcv_fpc_1.ctr_end_diag "counter for end of diagnosis for diagnosis instance VCV_FPC_1" UBYTE _CNV_A_R_LINEAR_____0_CM 1 100. 0. 255. DISPLAY_IDENTIFIER CTR_ABC_END_DIAG_VCV_FPC_1 ECU_ADDRESS 0xd0009aed FORMAT "%3.0" /end MEASUREMENT
/begin MEASUREMENT fmy_stat_vcv_fpc_1.err_info_stat.lv_err_mem "storage in dynamic failure memory of the diagnosis instance VCV_FPC_1" UWORD _CNV_S_2_RANGE__0___1_CM 1 100. 0. 1. DISPLAY_IDENTIFIER LV_ERR_MEM_VCV_FPC_1 ECU_ADDRESS 0xd0009aee BIT_MASK 0x8 /end MEASUREMENT
/begin MEASUREMENT fmy_stat_vcv_fpc_1.err_info_stat.lv_ready "readiness status of the diagnosis instance VCV_FPC_1" UWORD _CNV_S_2_RANGE__0___1_CM 1 100. 0. 1. DISPLAY_IDENTIFIER LV_READY_VCV_FPC_1 ECU_ADDRESS 0xd0009aee BIT_MASK 0x10 /end MEASUREMENT
/begin MEASUREMENT fmy_stat_vcv_fpc_1.err_info_stat.lv_end_diag "end of diagnosis of the diagnosis instance VCV_FPC_1" UWORD _CNV_S_2_RANGE__0___1_CM 1 100. 0. 1. DISPLAY_IDENTIFIER LV_END_DIAG_VCV_FPC_1 ECU_ADDRESS 0xd0009aee BIT_MASK 0x20 /end MEASUREMENT
/begin MEASUREMENT fmy_stat_vcv_fpc_1.err_info_stat.lv_cdn_diag "diagnosis condition of the diagnosis instance VCV_FPC_1" UWORD _CNV_S_2_RANGE__0___1_CM 1 100. 0. 1. DISPLAY_IDENTIFIER LV_CDN_DIAG_VCV_FPC_1 ECU_ADDRESS 0xd0009aee BIT_MASK 0x40 /end MEASUREMENT
/begin MEASUREMENT fmy_stat_vcv_fpc_1.err_info_stat.err_sym "symptoms of the diagnosis instance VCV_FPC_1" UWORD _CNV_S_16_RANGE_ERR__349_CM 1 100. 0. 15. DISPLAY_IDENTIFIER ERR_SYM_VCV_FPC_1 ECU_ADDRESS 0xd0009aee BIT_MASK 0x780 /end MEASUREMENT
/begin MEASUREMENT fmy_stat_fsd_1.ctr_abc "anti bounce counter for diagnosis instance FSD_1" UBYTE _CNV_A_R_LINEAR_____0_CM 1 100. 0. 255. DISPLAY_IDENTIFIER CTR_ABC_FSD_1 ECU_ADDRESS 0xd0009684 FORMAT "%3.0" /end MEASUREMENT
/begin MEASUREMENT fmy_stat_fsd_1.ctr_end_diag "counter for end of diagnosis for diagnosis instance FSD_1" UBYTE _CNV_A_R_LINEAR_____0_CM 1 100. 0. 255. DISPLAY_IDENTIFIER CTR_ABC_END_DIAG_FSD_1 ECU_ADDRESS 0xd0009685 FORMAT "%3.0" /end MEASUREMENT
/begin MEASUREMENT fmy_stat_fsd_1.err_info_stat.lv_err_mem "storage in dynamic failure memory of the diagnosis instance FSD_1" UWORD _CNV_S_2_RANGE__0___1_CM 1 100. 0. 1. DISPLAY_IDENTIFIER LV_ERR_MEM_FSD_1 ECU_ADDRESS 0xd0009686 BIT_MASK 0x8 /end MEASUREMENT
/begin MEASUREMENT fmy_stat_fsd_1.err_info_stat.lv_ready "readiness status of the diagnosis instance FSD_1" UWORD _CNV_S_2_RANGE__0___1_CM 1 100. 0. 1. DISPLAY_IDENTIFIER LV_READY_FSD_1 ECU_ADDRESS 0xd0009686 BIT_MASK 0x10 /end MEASUREMENT
/begin MEASUREMENT fmy_stat_fsd_1.err_info_stat.lv_end_diag "end of diagnosis of the diagnosis instance FSD_1" UWORD _CNV_S_2_RANGE__0___1_CM 1 100. 0. 1. DISPLAY_IDENTIFIER LV_END_DIAG_FSD_1 ECU_ADDRESS 0xd0009686 BIT_MASK 0x20 /end MEASUREMENT
/begin MEASUREMENT fmy_stat_fsd_1.err_info_stat.lv_cdn_diag "diagnosis condition of the diagnosis instance FSD_1" UWORD _CNV_S_2_RANGE__0___1_CM 1 100. 0. 1. DISPLAY_IDENTIFIER LV_CDN_DIAG_FSD_1 ECU_ADDRESS 0xd0009686 BIT_MASK 0x40 /end MEASUREMENT
/begin MEASUREMENT fmy_stat_fsd_1.err_info_stat.err_sym "symptoms of the diagnosis instance FSD_1" UWORD _CNV_S_16_RANGE_ERR__349_CM 1 100. 0. 15. DISPLAY_IDENTIFIER ERR_SYM_FSD_1 ECU_ADDRESS 0xd0009686 BIT_MASK 0x780 /end MEASUREMENT
/begin MEASUREMENT fmy_stat_fsd_2.ctr_abc "anti bounce counter for diagnosis instance FSD_2" UBYTE _CNV_A_R_LINEAR_____0_CM 1 100. 0. 255. DISPLAY_IDENTIFIER CTR_ABC_FSD_2 ECU_ADDRESS 0xd0009688 FORMAT "%3.0" /end MEASUREMENT
/begin MEASUREMENT fmy_stat_fsd_2.ctr_end_diag "counter for end of diagnosis for diagnosis instance FSD_2" UBYTE _CNV_A_R_LINEAR_____0_CM 1 100. 0. 255. DISPLAY_IDENTIFIER CTR_ABC_END_DIAG_FSD_2 ECU_ADDRESS 0xd0009689 FORMAT "%3.0" /end MEASUREMENT
/begin MEASUREMENT fmy_stat_fsd_2.err_info_stat.lv_err_mem "storage in dynamic failure memory of the diagnosis instance FSD_2" UWORD _CNV_S_2_RANGE__0___1_CM 1 100. 0. 1. DISPLAY_IDENTIFIER LV_ERR_MEM_FSD_2 ECU_ADDRESS 0xd000968a BIT_MASK 0x8 /end MEASUREMENT
/begin MEASUREMENT fmy_stat_fsd_2.err_info_stat.lv_ready "readiness status of the diagnosis instance FSD_2" UWORD _CNV_S_2_RANGE__0___1_CM 1 100. 0. 1. DISPLAY_IDENTIFIER LV_READY_FSD_2 ECU_ADDRESS 0xd000968a BIT_MASK 0x10 /end MEASUREMENT
/begin MEASUREMENT fmy_stat_fsd_2.err_info_stat.lv_end_diag "end of diagnosis of the diagnosis instance FSD_2" UWORD _CNV_S_2_RANGE__0___1_CM 1 100. 0. 1. DISPLAY_IDENTIFIER LV_END_DIAG_FSD_2 ECU_ADDRESS 0xd000968a BIT_MASK 0x20 /end MEASUREMENT
/begin MEASUREMENT fmy_stat_fsd_2.err_info_stat.lv_cdn_diag "diagnosis condition of the diagnosis instance FSD_2" UWORD _CNV_S_2_RANGE__0___1_CM 1 100. 0. 1. DISPLAY_IDENTIFIER LV_CDN_DIAG_FSD_2 ECU_ADDRESS 0xd000968a BIT_MASK 0x40 /end MEASUREMENT
/begin MEASUREMENT fmy_stat_fsd_2.err_info_stat.err_sym "symptoms of the diagnosis instance FSD_2" UWORD _CNV_S_16_RANGE_ERR__349_CM 1 100. 0. 15. DISPLAY_IDENTIFIER ERR_SYM_FSD_2 ECU_ADDRESS 0xd000968a BIT_MASK 0x780 /end MEASUREMENT
/begin MEASUREMENT fmy_stat_fsd_lam_lim_1.ctr_abc "anti bounce counter for diagnosis instance FSD_LAM_LIM_1" UBYTE _CNV_A_R_LINEAR_____0_CM 1 100. 0. 255. DISPLAY_IDENTIFIER CTR_ABC_FSD_LAM_LIM_1 ECU_ADDRESS 0xd0009694 FORMAT "%3.0" /end MEASUREMENT
/begin MEASUREMENT fmy_stat_fsd_lam_lim_1.ctr_end_diag "counter for end of diagnosis for diagnosis instance FSD_LAM_LIM_1" UBYTE _CNV_A_R_LINEAR_____0_CM 1 100. 0. 255. DISPLAY_IDENTIFIER CTR_ABC_END_DIAG_FSD_LAM_LIM_1 ECU_ADDRESS 0xd0009695 FORMAT "%3.0" /end MEASUREMENT
/begin MEASUREMENT fmy_stat_fsd_lam_lim_1.err_info_stat.lv_err_mem "storage in dynamic failure memory of the diagnosis instance FSD_LAM_LIM_1" UWORD _CNV_S_2_RANGE__0___1_CM 1 100. 0. 1. DISPLAY_IDENTIFIER LV_ERR_MEM_FSD_LAM_LIM_1 ECU_ADDRESS 0xd0009696 BIT_MASK 0x8 /end MEASUREMENT
/begin MEASUREMENT fmy_stat_fsd_lam_lim_1.err_info_stat.lv_ready "readiness status of the diagnosis instance FSD_LAM_LIM_1" UWORD _CNV_S_2_RANGE__0___1_CM 1 100. 0. 1. DISPLAY_IDENTIFIER LV_READY_FSD_LAM_LIM_1 ECU_ADDRESS 0xd0009696 BIT_MASK 0x10 /end MEASUREMENT
/begin MEASUREMENT fmy_stat_fsd_lam_lim_1.err_info_stat.lv_end_diag "end of diagnosis of the diagnosis instance FSD_LAM_LIM_1" UWORD _CNV_S_2_RANGE__0___1_CM 1 100. 0. 1. DISPLAY_IDENTIFIER LV_END_DIAG_FSD_LAM_LIM_1 ECU_ADDRESS 0xd0009696 BIT_MASK 0x20 /end MEASUREMENT
/begin MEASUREMENT fmy_stat_fsd_lam_lim_1.err_info_stat.lv_cdn_diag "diagnosis condition of the diagnosis instance FSD_LAM_LIM_1" UWORD _CNV_S_2_RANGE__0___1_CM 1 100. 0. 1. DISPLAY_IDENTIFIER LV_CDN_DIAG_FSD_LAM_LIM_1 ECU_ADDRESS 0xd0009696 BIT_MASK 0x40 /end MEASUREMENT
/begin MEASUREMENT fmy_stat_fsd_lam_lim_1.err_info_stat.err_sym "symptoms of the diagnosis instance FSD_LAM_LIM_1" UWORD _CNV_S_16_RANGE_ERR__349_CM 1 100. 0. 15. DISPLAY_IDENTIFIER ERR_SYM_FSD_LAM_LIM_1 ECU_ADDRESS 0xd0009696 BIT_MASK 0x780 /end MEASUREMENT
/begin MEASUREMENT fmy_stat_fsd_lam_lim_2.ctr_abc "anti bounce counter for diagnosis instance FSD_LAM_LIM_2" UBYTE _CNV_A_R_LINEAR_____0_CM 1 100. 0. 255. DISPLAY_IDENTIFIER CTR_ABC_FSD_LAM_LIM_2 ECU_ADDRESS 0xd0009698 FORMAT "%3.0" /end MEASUREMENT
/begin MEASUREMENT fmy_stat_fsd_lam_lim_2.ctr_end_diag "counter for end of diagnosis for diagnosis instance FSD_LAM_LIM_2" UBYTE _CNV_A_R_LINEAR_____0_CM 1 100. 0. 255. DISPLAY_IDENTIFIER CTR_ABC_END_DIAG_FSD_LAM_LIM_2 ECU_ADDRESS 0xd0009699 FORMAT "%3.0" /end MEASUREMENT
/begin MEASUREMENT fmy_stat_fsd_lam_lim_2.err_info_stat.lv_err_mem "storage in dynamic failure memory of the diagnosis instance FSD_LAM_LIM_2" UWORD _CNV_S_2_RANGE__0___1_CM 1 100. 0. 1. DISPLAY_IDENTIFIER LV_ERR_MEM_FSD_LAM_LIM_2 ECU_ADDRESS 0xd000969a BIT_MASK 0x8 /end MEASUREMENT
/begin MEASUREMENT fmy_stat_fsd_lam_lim_2.err_info_stat.lv_ready "readiness status of the diagnosis instance FSD_LAM_LIM_2" UWORD _CNV_S_2_RANGE__0___1_CM 1 100. 0. 1. DISPLAY_IDENTIFIER LV_READY_FSD_LAM_LIM_2 ECU_ADDRESS 0xd000969a BIT_MASK 0x10 /end MEASUREMENT
/begin MEASUREMENT fmy_stat_fsd_lam_lim_2.err_info_stat.lv_end_diag "end of diagnosis of the diagnosis instance FSD_LAM_LIM_2" UWORD _CNV_S_2_RANGE__0___1_CM 1 100. 0. 1. DISPLAY_IDENTIFIER LV_END_DIAG_FSD_LAM_LIM_2 ECU_ADDRESS 0xd000969a BIT_MASK 0x20 /end MEASUREMENT
/begin MEASUREMENT fmy_stat_fsd_lam_lim_2.err_info_stat.lv_cdn_diag "diagnosis condition of the diagnosis instance FSD_LAM_LIM_2" UWORD _CNV_S_2_RANGE__0___1_CM 1 100. 0. 1. DISPLAY_IDENTIFIER LV_CDN_DIAG_FSD_LAM_LIM_2 ECU_ADDRESS 0xd000969a BIT_MASK 0x40 /end MEASUREMENT
/begin MEASUREMENT fmy_stat_fsd_lam_lim_2.err_info_stat.err_sym "symptoms of the diagnosis instance FSD_LAM_LIM_2" UWORD _CNV_S_16_RANGE_ERR__349_CM 1 100. 0. 15. DISPLAY_IDENTIFIER ERR_SYM_FSD_LAM_LIM_2 ECU_ADDRESS 0xd000969a BIT_MASK 0x780 /end MEASUREMENT
/begin MEASUREMENT fmy_stat_fsd_h_rng_1.ctr_abc "anti bounce counter for diagnosis instance FSD_H_RNG_1" UBYTE _CNV_A_R_LINEAR_____0_CM 1 100. 0. 255. DISPLAY_IDENTIFIER CTR_ABC_FSD_H_RNG_1 ECU_ADDRESS 0xd000968c FORMAT "%3.0" /end MEASUREMENT
/begin MEASUREMENT fmy_stat_fsd_h_rng_1.ctr_end_diag "counter for end of diagnosis for diagnosis instance FSD_H_RNG_1" UBYTE _CNV_A_R_LINEAR_____0_CM 1 100. 0. 255. DISPLAY_IDENTIFIER CTR_ABC_END_DIAG_FSD_H_RNG_1 ECU_ADDRESS 0xd000968d FORMAT "%3.0" /end MEASUREMENT
/begin MEASUREMENT fmy_stat_fsd_h_rng_1.err_info_stat.lv_err_mem "storage in dynamic failure memory of the diagnosis instance FSD_H_RNG_1" UWORD _CNV_S_2_RANGE__0___1_CM 1 100. 0. 1. DISPLAY_IDENTIFIER LV_ERR_MEM_FSD_H_RNG_1 ECU_ADDRESS 0xd000968e BIT_MASK 0x8 /end MEASUREMENT
/begin MEASUREMENT fmy_stat_fsd_h_rng_1.err_info_stat.lv_ready "readiness status of the diagnosis instance FSD_H_RNG_1" UWORD _CNV_S_2_RANGE__0___1_CM 1 100. 0. 1. DISPLAY_IDENTIFIER LV_READY_FSD_H_RNG_1 ECU_ADDRESS 0xd000968e BIT_MASK 0x10 /end MEASUREMENT
/begin MEASUREMENT fmy_stat_fsd_h_rng_1.err_info_stat.lv_end_diag "end of diagnosis of the diagnosis instance FSD_H_RNG_1" UWORD _CNV_S_2_RANGE__0___1_CM 1 100. 0. 1. DISPLAY_IDENTIFIER LV_END_DIAG_FSD_H_RNG_1 ECU_ADDRESS 0xd000968e BIT_MASK 0x20 /end MEASUREMENT
/begin MEASUREMENT fmy_stat_fsd_h_rng_1.err_info_stat.lv_cdn_diag "diagnosis condition of the diagnosis instance FSD_H_RNG_1" UWORD _CNV_S_2_RANGE__0___1_CM 1 100. 0. 1. DISPLAY_IDENTIFIER LV_CDN_DIAG_FSD_H_RNG_1 ECU_ADDRESS 0xd000968e BIT_MASK 0x40 /end MEASUREMENT
/begin MEASUREMENT fmy_stat_fsd_h_rng_1.err_info_stat.err_sym "symptoms of the diagnosis instance FSD_H_RNG_1" UWORD _CNV_S_16_RANGE_ERR__349_CM 1 100. 0. 15. DISPLAY_IDENTIFIER ERR_SYM_FSD_H_RNG_1 ECU_ADDRESS 0xd000968e BIT_MASK 0x780 /end MEASUREMENT
/begin MEASUREMENT fmy_stat_fsd_h_rng_2.ctr_abc "anti bounce counter for diagnosis instance FSD_H_RNG_2" UBYTE _CNV_A_R_LINEAR_____0_CM 1 100. 0. 255. DISPLAY_IDENTIFIER CTR_ABC_FSD_H_RNG_2 ECU_ADDRESS 0xd0009690 FORMAT "%3.0" /end MEASUREMENT
/begin MEASUREMENT fmy_stat_fsd_h_rng_2.ctr_end_diag "counter for end of diagnosis for diagnosis instance FSD_H_RNG_2" UBYTE _CNV_A_R_LINEAR_____0_CM 1 100. 0. 255. DISPLAY_IDENTIFIER CTR_ABC_END_DIAG_FSD_H_RNG_2 ECU_ADDRESS 0xd0009691 FORMAT "%3.0" /end MEASUREMENT
/begin MEASUREMENT fmy_stat_fsd_h_rng_2.err_info_stat.lv_err_mem "storage in dynamic failure memory of the diagnosis instance FSD_H_RNG_2" UWORD _CNV_S_2_RANGE__0___1_CM 1 100. 0. 1. DISPLAY_IDENTIFIER LV_ERR_MEM_FSD_H_RNG_2 ECU_ADDRESS 0xd0009692 BIT_MASK 0x8 /end MEASUREMENT
/begin MEASUREMENT fmy_stat_fsd_h_rng_2.err_info_stat.lv_ready "readiness status of the diagnosis instance FSD_H_RNG_2" UWORD _CNV_S_2_RANGE__0___1_CM 1 100. 0. 1. DISPLAY_IDENTIFIER LV_READY_FSD_H_RNG_2 ECU_ADDRESS 0xd0009692 BIT_MASK 0x10 /end MEASUREMENT
/begin MEASUREMENT fmy_stat_fsd_h_rng_2.err_info_stat.lv_end_diag "end of diagnosis of the diagnosis instance FSD_H_RNG_2" UWORD _CNV_S_2_RANGE__0___1_CM 1 100. 0. 1. DISPLAY_IDENTIFIER LV_END_DIAG_FSD_H_RNG_2 ECU_ADDRESS 0xd0009692 BIT_MASK 0x20 /end MEASUREMENT
/begin MEASUREMENT fmy_stat_fsd_h_rng_2.err_info_stat.lv_cdn_diag "diagnosis condition of the diagnosis instance FSD_H_RNG_2" UWORD _CNV_S_2_RANGE__0___1_CM 1 100. 0. 1. DISPLAY_IDENTIFIER LV_CDN_DIAG_FSD_H_RNG_2 ECU_ADDRESS 0xd0009692 BIT_MASK 0x40 /end MEASUREMENT
/begin MEASUREMENT fmy_stat_fsd_h_rng_2.err_info_stat.err_sym "symptoms of the diagnosis instance FSD_H_RNG_2" UWORD _CNV_S_16_RANGE_ERR__349_CM 1 100. 0. 15. DISPLAY_IDENTIFIER ERR_SYM_FSD_H_RNG_2 ECU_ADDRESS 0xd0009692 BIT_MASK 0x780 /end MEASUREMENT
/begin MEASUREMENT fmy_stat_cyl_bal_lam_0.ctr_abc "anti bounce counter for diagnosis instance CYL_BAL_LAM_0" UBYTE _CNV_A_R_LINEAR_____0_CM 1 100. 0. 255. DISPLAY_IDENTIFIER CTR_ABC_CYL_BAL_LAM_0 ECU_ADDRESS 0xd00095c4 FORMAT "%3.0" /end MEASUREMENT
/begin MEASUREMENT fmy_stat_cyl_bal_lam_0.ctr_end_diag "counter for end of diagnosis for diagnosis instance CYL_BAL_LAM_0" UBYTE _CNV_A_R_LINEAR_____0_CM 1 100. 0. 255. DISPLAY_IDENTIFIER CTR_ABC_END_DIAG_CYL_BAL_LAM_0 ECU_ADDRESS 0xd00095c5 FORMAT "%3.0" /end MEASUREMENT
/begin MEASUREMENT fmy_stat_cyl_bal_lam_0.err_info_stat.lv_err_mem "storage in dynamic failure memory of the diagnosis instance CYL_BAL_LAM_0" UWORD _CNV_S_2_RANGE__0___1_CM 1 100. 0. 1. DISPLAY_IDENTIFIER LV_ERR_MEM_CYL_BAL_LAM_0 ECU_ADDRESS 0xd00095c6 BIT_MASK 0x8 /end MEASUREMENT
/begin MEASUREMENT fmy_stat_cyl_bal_lam_0.err_info_stat.lv_ready "readiness status of the diagnosis instance CYL_BAL_LAM_0" UWORD _CNV_S_2_RANGE__0___1_CM 1 100. 0. 1. DISPLAY_IDENTIFIER LV_READY_CYL_BAL_LAM_0 ECU_ADDRESS 0xd00095c6 BIT_MASK 0x10 /end MEASUREMENT
/begin MEASUREMENT fmy_stat_cyl_bal_lam_0.err_info_stat.lv_end_diag "end of diagnosis of the diagnosis instance CYL_BAL_LAM_0" UWORD _CNV_S_2_RANGE__0___1_CM 1 100. 0. 1. DISPLAY_IDENTIFIER LV_END_DIAG_CYL_BAL_LAM_0 ECU_ADDRESS 0xd00095c6 BIT_MASK 0x20 /end MEASUREMENT
/begin MEASUREMENT fmy_stat_cyl_bal_lam_0.err_info_stat.lv_cdn_diag "diagnosis condition of the diagnosis instance CYL_BAL_LAM_0" UWORD _CNV_S_2_RANGE__0___1_CM 1 100. 0. 1. DISPLAY_IDENTIFIER LV_CDN_DIAG_CYL_BAL_LAM_0 ECU_ADDRESS 0xd00095c6 BIT_MASK 0x40 /end MEASUREMENT
/begin MEASUREMENT fmy_stat_cyl_bal_lam_0.err_info_stat.err_sym "symptoms of the diagnosis instance CYL_BAL_LAM_0" UWORD _CNV_S_16_RANGE_ERR__349_CM 1 100. 0. 15. DISPLAY_IDENTIFIER ERR_SYM_CYL_BAL_LAM_0 ECU_ADDRESS 0xd00095c6 BIT_MASK 0x780 /end MEASUREMENT
/begin MEASUREMENT fmy_stat_cyl_bal_lam_1.ctr_abc "anti bounce counter for diagnosis instance CYL_BAL_LAM_1" UBYTE _CNV_A_R_LINEAR_____0_CM 1 100. 0. 255. DISPLAY_IDENTIFIER CTR_ABC_CYL_BAL_LAM_1 ECU_ADDRESS 0xd00095c8 FORMAT "%3.0" /end MEASUREMENT
/begin MEASUREMENT fmy_stat_cyl_bal_lam_1.ctr_end_diag "counter for end of diagnosis for diagnosis instance CYL_BAL_LAM_1" UBYTE _CNV_A_R_LINEAR_____0_CM 1 100. 0. 255. DISPLAY_IDENTIFIER CTR_ABC_END_DIAG_CYL_BAL_LAM_1 ECU_ADDRESS 0xd00095c9 FORMAT "%3.0" /end MEASUREMENT
/begin MEASUREMENT fmy_stat_cyl_bal_lam_1.err_info_stat.lv_err_mem "storage in dynamic failure memory of the diagnosis instance CYL_BAL_LAM_1" UWORD _CNV_S_2_RANGE__0___1_CM 1 100. 0. 1. DISPLAY_IDENTIFIER LV_ERR_MEM_CYL_BAL_LAM_1 ECU_ADDRESS 0xd00095ca BIT_MASK 0x8 /end MEASUREMENT
/begin MEASUREMENT fmy_stat_cyl_bal_lam_1.err_info_stat.lv_ready "readiness status of the diagnosis instance CYL_BAL_LAM_1" UWORD _CNV_S_2_RANGE__0___1_CM 1 100. 0. 1. DISPLAY_IDENTIFIER LV_READY_CYL_BAL_LAM_1 ECU_ADDRESS 0xd00095ca BIT_MASK 0x10 /end MEASUREMENT
/begin MEASUREMENT fmy_stat_cyl_bal_lam_1.err_info_stat.lv_end_diag "end of diagnosis of the diagnosis instance CYL_BAL_LAM_1" UWORD _CNV_S_2_RANGE__0___1_CM 1 100. 0. 1. DISPLAY_IDENTIFIER LV_END_DIAG_CYL_BAL_LAM_1 ECU_ADDRESS 0xd00095ca BIT_MASK 0x20 /end MEASUREMENT
/begin MEASUREMENT fmy_stat_cyl_bal_lam_1.err_info_stat.lv_cdn_diag "diagnosis condition of the diagnosis instance CYL_BAL_LAM_1" UWORD _CNV_S_2_RANGE__0___1_CM 1 100. 0. 1. DISPLAY_IDENTIFIER LV_CDN_DIAG_CYL_BAL_LAM_1 ECU_ADDRESS 0xd00095ca BIT_MASK 0x40 /end MEASUREMENT
/begin MEASUREMENT fmy_stat_cyl_bal_lam_1.err_info_stat.err_sym "symptoms of the diagnosis instance CYL_BAL_LAM_1" UWORD _CNV_S_16_RANGE_ERR__349_CM 1 100. 0. 15. DISPLAY_IDENTIFIER ERR_SYM_CYL_BAL_LAM_1 ECU_ADDRESS 0xd00095ca BIT_MASK 0x780 /end MEASUREMENT
/begin MEASUREMENT fmy_stat_cyl_bal_lam_2.ctr_abc "anti bounce counter for diagnosis instance CYL_BAL_LAM_2" UBYTE _CNV_A_R_LINEAR_____0_CM 1 100. 0. 255. DISPLAY_IDENTIFIER CTR_ABC_CYL_BAL_LAM_2 ECU_ADDRESS 0xd00095cc FORMAT "%3.0" /end MEASUREMENT
/begin MEASUREMENT fmy_stat_cyl_bal_lam_2.ctr_end_diag "counter for end of diagnosis for diagnosis instance CYL_BAL_LAM_2" UBYTE _CNV_A_R_LINEAR_____0_CM 1 100. 0. 255. DISPLAY_IDENTIFIER CTR_ABC_END_DIAG_CYL_BAL_LAM_2 ECU_ADDRESS 0xd00095cd FORMAT "%3.0" /end MEASUREMENT
/begin MEASUREMENT fmy_stat_cyl_bal_lam_2.err_info_stat.lv_err_mem "storage in dynamic failure memory of the diagnosis instance CYL_BAL_LAM_2" UWORD _CNV_S_2_RANGE__0___1_CM 1 100. 0. 1. DISPLAY_IDENTIFIER LV_ERR_MEM_CYL_BAL_LAM_2 ECU_ADDRESS 0xd00095ce BIT_MASK 0x8 /end MEASUREMENT
/begin MEASUREMENT fmy_stat_cyl_bal_lam_2.err_info_stat.lv_ready "readiness status of the diagnosis instance CYL_BAL_LAM_2" UWORD _CNV_S_2_RANGE__0___1_CM 1 100. 0. 1. DISPLAY_IDENTIFIER LV_READY_CYL_BAL_LAM_2 ECU_ADDRESS 0xd00095ce BIT_MASK 0x10 /end MEASUREMENT
/begin MEASUREMENT fmy_stat_cyl_bal_lam_2.err_info_stat.lv_end_diag "end of diagnosis of the diagnosis instance CYL_BAL_LAM_2" UWORD _CNV_S_2_RANGE__0___1_CM 1 100. 0. 1. DISPLAY_IDENTIFIER LV_END_DIAG_CYL_BAL_LAM_2 ECU_ADDRESS 0xd00095ce BIT_MASK 0x20 /end MEASUREMENT
/begin MEASUREMENT fmy_stat_cyl_bal_lam_2.err_info_stat.lv_cdn_diag "diagnosis condition of the diagnosis instance CYL_BAL_LAM_2" UWORD _CNV_S_2_RANGE__0___1_CM 1 100. 0. 1. DISPLAY_IDENTIFIER LV_CDN_DIAG_CYL_BAL_LAM_2 ECU_ADDRESS 0xd00095ce BIT_MASK 0x40 /end MEASUREMENT
/begin MEASUREMENT fmy_stat_cyl_bal_lam_2.err_info_stat.err_sym "symptoms of the diagnosis instance CYL_BAL_LAM_2" UWORD _CNV_S_16_RANGE_ERR__349_CM 1 100. 0. 15. DISPLAY_IDENTIFIER ERR_SYM_CYL_BAL_LAM_2 ECU_ADDRESS 0xd00095ce BIT_MASK 0x780 /end MEASUREMENT
/begin MEASUREMENT fmy_stat_cyl_bal_lam_3.ctr_abc "anti bounce counter for diagnosis instance CYL_BAL_LAM_3" UBYTE _CNV_A_R_LINEAR_____0_CM 1 100. 0. 255. DISPLAY_IDENTIFIER CTR_ABC_CYL_BAL_LAM_3 ECU_ADDRESS 0xd00095d0 FORMAT "%3.0" /end MEASUREMENT
/begin MEASUREMENT fmy_stat_cyl_bal_lam_3.ctr_end_diag "counter for end of diagnosis for diagnosis instance CYL_BAL_LAM_3" UBYTE _CNV_A_R_LINEAR_____0_CM 1 100. 0. 255. DISPLAY_IDENTIFIER CTR_ABC_END_DIAG_CYL_BAL_LAM_3 ECU_ADDRESS 0xd00095d1 FORMAT "%3.0" /end MEASUREMENT
/begin MEASUREMENT fmy_stat_cyl_bal_lam_3.err_info_stat.lv_err_mem "storage in dynamic failure memory of the diagnosis instance CYL_BAL_LAM_3" UWORD _CNV_S_2_RANGE__0___1_CM 1 100. 0. 1. DISPLAY_IDENTIFIER LV_ERR_MEM_CYL_BAL_LAM_3 ECU_ADDRESS 0xd00095d2 BIT_MASK 0x8 /end MEASUREMENT
/begin MEASUREMENT fmy_stat_cyl_bal_lam_3.err_info_stat.lv_ready "readiness status of the diagnosis instance CYL_BAL_LAM_3" UWORD _CNV_S_2_RANGE__0___1_CM 1 100. 0. 1. DISPLAY_IDENTIFIER LV_READY_CYL_BAL_LAM_3 ECU_ADDRESS 0xd00095d2 BIT_MASK 0x10 /end MEASUREMENT
/begin MEASUREMENT fmy_stat_cyl_bal_lam_3.err_info_stat.lv_end_diag "end of diagnosis of the diagnosis instance CYL_BAL_LAM_3" UWORD _CNV_S_2_RANGE__0___1_CM 1 100. 0. 1. DISPLAY_IDENTIFIER LV_END_DIAG_CYL_BAL_LAM_3 ECU_ADDRESS 0xd00095d2 BIT_MASK 0x20 /end MEASUREMENT
/begin MEASUREMENT fmy_stat_cyl_bal_lam_3.err_info_stat.lv_cdn_diag "diagnosis condition of the diagnosis instance CYL_BAL_LAM_3" UWORD _CNV_S_2_RANGE__0___1_CM 1 100. 0. 1. DISPLAY_IDENTIFIER LV_CDN_DIAG_CYL_BAL_LAM_3 ECU_ADDRESS 0xd00095d2 BIT_MASK 0x40 /end MEASUREMENT
/begin MEASUREMENT fmy_stat_cyl_bal_lam_3.err_info_stat.err_sym "symptoms of the diagnosis instance CYL_BAL_LAM_3" UWORD _CNV_S_16_RANGE_ERR__349_CM 1 100. 0. 15. DISPLAY_IDENTIFIER ERR_SYM_CYL_BAL_LAM_3 ECU_ADDRESS 0xd00095d2 BIT_MASK 0x780 /end MEASUREMENT
/begin MEASUREMENT fmy_stat_cyl_bal_lam_4.ctr_abc "anti bounce counter for diagnosis instance CYL_BAL_LAM_4" UBYTE _CNV_A_R_LINEAR_____0_CM 1 100. 0. 255. DISPLAY_IDENTIFIER CTR_ABC_CYL_BAL_LAM_4 ECU_ADDRESS 0xd00095d4 FORMAT "%3.0" /end MEASUREMENT
/begin MEASUREMENT fmy_stat_cyl_bal_lam_4.ctr_end_diag "counter for end of diagnosis for diagnosis instance CYL_BAL_LAM_4" UBYTE _CNV_A_R_LINEAR_____0_CM 1 100. 0. 255. DISPLAY_IDENTIFIER CTR_ABC_END_DIAG_CYL_BAL_LAM_4 ECU_ADDRESS 0xd00095d5 FORMAT "%3.0" /end MEASUREMENT
/begin MEASUREMENT fmy_stat_cyl_bal_lam_4.err_info_stat.lv_err_mem "storage in dynamic failure memory of the diagnosis instance CYL_BAL_LAM_4" UWORD _CNV_S_2_RANGE__0___1_CM 1 100. 0. 1. DISPLAY_IDENTIFIER LV_ERR_MEM_CYL_BAL_LAM_4 ECU_ADDRESS 0xd00095d6 BIT_MASK 0x8 /end MEASUREMENT
/begin MEASUREMENT fmy_stat_cyl_bal_lam_4.err_info_stat.lv_ready "readiness status of the diagnosis instance CYL_BAL_LAM_4" UWORD _CNV_S_2_RANGE__0___1_CM 1 100. 0. 1. DISPLAY_IDENTIFIER LV_READY_CYL_BAL_LAM_4 ECU_ADDRESS 0xd00095d6 BIT_MASK 0x10 /end MEASUREMENT
/begin MEASUREMENT fmy_stat_cyl_bal_lam_4.err_info_stat.lv_end_diag "end of diagnosis of the diagnosis instance CYL_BAL_LAM_4" UWORD _CNV_S_2_RANGE__0___1_CM 1 100. 0. 1. DISPLAY_IDENTIFIER LV_END_DIAG_CYL_BAL_LAM_4 ECU_ADDRESS 0xd00095d6 BIT_MASK 0x20 /end MEASUREMENT
/begin MEASUREMENT fmy_stat_cyl_bal_lam_4.err_info_stat.lv_cdn_diag "diagnosis condition of the diagnosis instance CYL_BAL_LAM_4" UWORD _CNV_S_2_RANGE__0___1_CM 1 100. 0. 1. DISPLAY_IDENTIFIER LV_CDN_DIAG_CYL_BAL_LAM_4 ECU_ADDRESS 0xd00095d6 BIT_MASK 0x40 /end MEASUREMENT
/begin MEASUREMENT fmy_stat_cyl_bal_lam_4.err_info_stat.err_sym "symptoms of the diagnosis instance CYL_BAL_LAM_4" UWORD _CNV_S_16_RANGE_ERR__349_CM 1 100. 0. 15. DISPLAY_IDENTIFIER ERR_SYM_CYL_BAL_LAM_4 ECU_ADDRESS 0xd00095d6 BIT_MASK 0x780 /end MEASUREMENT
/begin MEASUREMENT fmy_stat_cyl_bal_lam_5.ctr_abc "anti bounce counter for diagnosis instance CYL_BAL_LAM_5" UBYTE _CNV_A_R_LINEAR_____0_CM 1 100. 0. 255. DISPLAY_IDENTIFIER CTR_ABC_CYL_BAL_LAM_5 ECU_ADDRESS 0xd00095d8 FORMAT "%3.0" /end MEASUREMENT
/begin MEASUREMENT fmy_stat_cyl_bal_lam_5.ctr_end_diag "counter for end of diagnosis for diagnosis instance CYL_BAL_LAM_5" UBYTE _CNV_A_R_LINEAR_____0_CM 1 100. 0. 255. DISPLAY_IDENTIFIER CTR_ABC_END_DIAG_CYL_BAL_LAM_5 ECU_ADDRESS 0xd00095d9 FORMAT "%3.0" /end MEASUREMENT
/begin MEASUREMENT fmy_stat_cyl_bal_lam_5.err_info_stat.lv_err_mem "storage in dynamic failure memory of the diagnosis instance CYL_BAL_LAM_5" UWORD _CNV_S_2_RANGE__0___1_CM 1 100. 0. 1. DISPLAY_IDENTIFIER LV_ERR_MEM_CYL_BAL_LAM_5 ECU_ADDRESS 0xd00095da BIT_MASK 0x8 /end MEASUREMENT
/begin MEASUREMENT fmy_stat_cyl_bal_lam_5.err_info_stat.lv_ready "readiness status of the diagnosis instance CYL_BAL_LAM_5" UWORD _CNV_S_2_RANGE__0___1_CM 1 100. 0. 1. DISPLAY_IDENTIFIER LV_READY_CYL_BAL_LAM_5 ECU_ADDRESS 0xd00095da BIT_MASK 0x10 /end MEASUREMENT
/begin MEASUREMENT fmy_stat_cyl_bal_lam_5.err_info_stat.lv_end_diag "end of diagnosis of the diagnosis instance CYL_BAL_LAM_5" UWORD _CNV_S_2_RANGE__0___1_CM 1 100. 0. 1. DISPLAY_IDENTIFIER LV_END_DIAG_CYL_BAL_LAM_5 ECU_ADDRESS 0xd00095da BIT_MASK 0x20 /end MEASUREMENT
/begin MEASUREMENT fmy_stat_cyl_bal_lam_5.err_info_stat.lv_cdn_diag "diagnosis condition of the diagnosis instance CYL_BAL_LAM_5" UWORD _CNV_S_2_RANGE__0___1_CM 1 100. 0. 1. DISPLAY_IDENTIFIER LV_CDN_DIAG_CYL_BAL_LAM_5 ECU_ADDRESS 0xd00095da BIT_MASK 0x40 /end MEASUREMENT
/begin MEASUREMENT fmy_stat_cyl_bal_lam_5.err_info_stat.err_sym "symptoms of the diagnosis instance CYL_BAL_LAM_5" UWORD _CNV_S_16_RANGE_ERR__349_CM 1 100. 0. 15. DISPLAY_IDENTIFIER ERR_SYM_CYL_BAL_LAM_5 ECU_ADDRESS 0xd00095da BIT_MASK 0x780 /end MEASUREMENT
/begin MEASUREMENT fmy_stat_cyl_bal_lam_6.ctr_abc "anti bounce counter for diagnosis instance CYL_BAL_LAM_6" UBYTE _CNV_A_R_LINEAR_____0_CM 1 100. 0. 255. DISPLAY_IDENTIFIER CTR_ABC_CYL_BAL_LAM_6 ECU_ADDRESS 0xd00095dc FORMAT "%3.0" /end MEASUREMENT
/begin MEASUREMENT fmy_stat_cyl_bal_lam_6.ctr_end_diag "counter for end of diagnosis for diagnosis instance CYL_BAL_LAM_6" UBYTE _CNV_A_R_LINEAR_____0_CM 1 100. 0. 255. DISPLAY_IDENTIFIER CTR_ABC_END_DIAG_CYL_BAL_LAM_6 ECU_ADDRESS 0xd00095dd FORMAT "%3.0" /end MEASUREMENT
/begin MEASUREMENT fmy_stat_cyl_bal_lam_6.err_info_stat.lv_err_mem "storage in dynamic failure memory of the diagnosis instance CYL_BAL_LAM_6" UWORD _CNV_S_2_RANGE__0___1_CM 1 100. 0. 1. DISPLAY_IDENTIFIER LV_ERR_MEM_CYL_BAL_LAM_6 ECU_ADDRESS 0xd00095de BIT_MASK 0x8 /end MEASUREMENT
/begin MEASUREMENT fmy_stat_cyl_bal_lam_6.err_info_stat.lv_ready "readiness status of the diagnosis instance CYL_BAL_LAM_6" UWORD _CNV_S_2_RANGE__0___1_CM 1 100. 0. 1. DISPLAY_IDENTIFIER LV_READY_CYL_BAL_LAM_6 ECU_ADDRESS 0xd00095de BIT_MASK 0x10 /end MEASUREMENT
/begin MEASUREMENT fmy_stat_cyl_bal_lam_6.err_info_stat.lv_end_diag "end of diagnosis of the diagnosis instance CYL_BAL_LAM_6" UWORD _CNV_S_2_RANGE__0___1_CM 1 100. 0. 1. DISPLAY_IDENTIFIER LV_END_DIAG_CYL_BAL_LAM_6 ECU_ADDRESS 0xd00095de BIT_MASK 0x20 /end MEASUREMENT
/begin MEASUREMENT fmy_stat_cyl_bal_lam_6.err_info_stat.lv_cdn_diag "diagnosis condition of the diagnosis instance CYL_BAL_LAM_6" UWORD _CNV_S_2_RANGE__0___1_CM 1 100. 0. 1. DISPLAY_IDENTIFIER LV_CDN_DIAG_CYL_BAL_LAM_6 ECU_ADDRESS 0xd00095de BIT_MASK 0x40 /end MEASUREMENT
/begin MEASUREMENT fmy_stat_cyl_bal_lam_6.err_info_stat.err_sym "symptoms of the diagnosis instance CYL_BAL_LAM_6" UWORD _CNV_S_16_RANGE_ERR__349_CM 1 100. 0. 15. DISPLAY_IDENTIFIER ERR_SYM_CYL_BAL_LAM_6 ECU_ADDRESS 0xd00095de BIT_MASK 0x780 /end MEASUREMENT
/begin MEASUREMENT fmy_stat_cyl_bal_lam_7.ctr_abc "anti bounce counter for diagnosis instance CYL_BAL_LAM_7" UBYTE _CNV_A_R_LINEAR_____0_CM 1 100. 0. 255. DISPLAY_IDENTIFIER CTR_ABC_CYL_BAL_LAM_7 ECU_ADDRESS 0xd00095e0 FORMAT "%3.0" /end MEASUREMENT
/begin MEASUREMENT fmy_stat_cyl_bal_lam_7.ctr_end_diag "counter for end of diagnosis for diagnosis instance CYL_BAL_LAM_7" UBYTE _CNV_A_R_LINEAR_____0_CM 1 100. 0. 255. DISPLAY_IDENTIFIER CTR_ABC_END_DIAG_CYL_BAL_LAM_7 ECU_ADDRESS 0xd00095e1 FORMAT "%3.0" /end MEASUREMENT
/begin MEASUREMENT fmy_stat_cyl_bal_lam_7.err_info_stat.lv_err_mem "storage in dynamic failure memory of the diagnosis instance CYL_BAL_LAM_7" UWORD _CNV_S_2_RANGE__0___1_CM 1 100. 0. 1. DISPLAY_IDENTIFIER LV_ERR_MEM_CYL_BAL_LAM_7 ECU_ADDRESS 0xd00095e2 BIT_MASK 0x8 /end MEASUREMENT
/begin MEASUREMENT fmy_stat_cyl_bal_lam_7.err_info_stat.lv_ready "readiness status of the diagnosis instance CYL_BAL_LAM_7" UWORD _CNV_S_2_RANGE__0___1_CM 1 100. 0. 1. DISPLAY_IDENTIFIER LV_READY_CYL_BAL_LAM_7 ECU_ADDRESS 0xd00095e2 BIT_MASK 0x10 /end MEASUREMENT
/begin MEASUREMENT fmy_stat_cyl_bal_lam_7.err_info_stat.lv_end_diag "end of diagnosis of the diagnosis instance CYL_BAL_LAM_7" UWORD _CNV_S_2_RANGE__0___1_CM 1 100. 0. 1. DISPLAY_IDENTIFIER LV_END_DIAG_CYL_BAL_LAM_7 ECU_ADDRESS 0xd00095e2 BIT_MASK 0x20 /end MEASUREMENT
/begin MEASUREMENT fmy_stat_cyl_bal_lam_7.err_info_stat.lv_cdn_diag "diagnosis condition of the diagnosis instance CYL_BAL_LAM_7" UWORD _CNV_S_2_RANGE__0___1_CM 1 100. 0. 1. DISPLAY_IDENTIFIER LV_CDN_DIAG_CYL_BAL_LAM_7 ECU_ADDRESS 0xd00095e2 BIT_MASK 0x40 /end MEASUREMENT
/begin MEASUREMENT fmy_stat_cyl_bal_lam_7.err_info_stat.err_sym "symptoms of the diagnosis instance CYL_BAL_LAM_7" UWORD _CNV_S_16_RANGE_ERR__349_CM 1 100. 0. 15. DISPLAY_IDENTIFIER ERR_SYM_CYL_BAL_LAM_7 ECU_ADDRESS 0xd00095e2 BIT_MASK 0x780 /end MEASUREMENT
/begin MEASUREMENT fmy_stat_cyl_bal_er_0.ctr_abc "anti bounce counter for diagnosis instance CYL_BAL_ER_0" UBYTE _CNV_A_R_LINEAR_____0_CM 1 100. 0. 255. DISPLAY_IDENTIFIER CTR_ABC_CYL_BAL_ER_0 ECU_ADDRESS 0xd00095a4 FORMAT "%3.0" /end MEASUREMENT
/begin MEASUREMENT fmy_stat_cyl_bal_er_0.ctr_end_diag "counter for end of diagnosis for diagnosis instance CYL_BAL_ER_0" UBYTE _CNV_A_R_LINEAR_____0_CM 1 100. 0. 255. DISPLAY_IDENTIFIER CTR_ABC_END_DIAG_CYL_BAL_ER_0 ECU_ADDRESS 0xd00095a5 FORMAT "%3.0" /end MEASUREMENT
/begin MEASUREMENT fmy_stat_cyl_bal_er_0.err_info_stat.lv_err_mem "storage in dynamic failure memory of the diagnosis instance CYL_BAL_ER_0" UWORD _CNV_S_2_RANGE__0___1_CM 1 100. 0. 1. DISPLAY_IDENTIFIER LV_ERR_MEM_CYL_BAL_ER_0 ECU_ADDRESS 0xd00095a6 BIT_MASK 0x8 /end MEASUREMENT
/begin MEASUREMENT fmy_stat_cyl_bal_er_0.err_info_stat.lv_ready "readiness status of the diagnosis instance CYL_BAL_ER_0" UWORD _CNV_S_2_RANGE__0___1_CM 1 100. 0. 1. DISPLAY_IDENTIFIER LV_READY_CYL_BAL_ER_0 ECU_ADDRESS 0xd00095a6 BIT_MASK 0x10 /end MEASUREMENT
/begin MEASUREMENT fmy_stat_cyl_bal_er_0.err_info_stat.lv_end_diag "end of diagnosis of the diagnosis instance CYL_BAL_ER_0" UWORD _CNV_S_2_RANGE__0___1_CM 1 100. 0. 1. DISPLAY_IDENTIFIER LV_END_DIAG_CYL_BAL_ER_0 ECU_ADDRESS 0xd00095a6 BIT_MASK 0x20 /end MEASUREMENT
/begin MEASUREMENT fmy_stat_cyl_bal_er_0.err_info_stat.lv_cdn_diag "diagnosis condition of the diagnosis instance CYL_BAL_ER_0" UWORD _CNV_S_2_RANGE__0___1_CM 1 100. 0. 1. DISPLAY_IDENTIFIER LV_CDN_DIAG_CYL_BAL_ER_0 ECU_ADDRESS 0xd00095a6 BIT_MASK 0x40 /end MEASUREMENT
/begin MEASUREMENT fmy_stat_cyl_bal_er_0.err_info_stat.err_sym "symptoms of the diagnosis instance CYL_BAL_ER_0" UWORD _CNV_S_16_RANGE_ERR__349_CM 1 100. 0. 15. DISPLAY_IDENTIFIER ERR_SYM_CYL_BAL_ER_0 ECU_ADDRESS 0xd00095a6 BIT_MASK 0x780 /end MEASUREMENT
/begin MEASUREMENT fmy_stat_cyl_bal_er_1.ctr_abc "anti bounce counter for diagnosis instance CYL_BAL_ER_1" UBYTE _CNV_A_R_LINEAR_____0_CM 1 100. 0. 255. DISPLAY_IDENTIFIER CTR_ABC_CYL_BAL_ER_1 ECU_ADDRESS 0xd00095a8 FORMAT "%3.0" /end MEASUREMENT
/begin MEASUREMENT fmy_stat_cyl_bal_er_1.ctr_end_diag "counter for end of diagnosis for diagnosis instance CYL_BAL_ER_1" UBYTE _CNV_A_R_LINEAR_____0_CM 1 100. 0. 255. DISPLAY_IDENTIFIER CTR_ABC_END_DIAG_CYL_BAL_ER_1 ECU_ADDRESS 0xd00095a9 FORMAT "%3.0" /end MEASUREMENT
/begin MEASUREMENT fmy_stat_cyl_bal_er_1.err_info_stat.lv_err_mem "storage in dynamic failure memory of the diagnosis instance CYL_BAL_ER_1" UWORD _CNV_S_2_RANGE__0___1_CM 1 100. 0. 1. DISPLAY_IDENTIFIER LV_ERR_MEM_CYL_BAL_ER_1 ECU_ADDRESS 0xd00095aa BIT_MASK 0x8 /end MEASUREMENT
/begin MEASUREMENT fmy_stat_cyl_bal_er_1.err_info_stat.lv_ready "readiness status of the diagnosis instance CYL_BAL_ER_1" UWORD _CNV_S_2_RANGE__0___1_CM 1 100. 0. 1. DISPLAY_IDENTIFIER LV_READY_CYL_BAL_ER_1 ECU_ADDRESS 0xd00095aa BIT_MASK 0x10 /end MEASUREMENT
/begin MEASUREMENT fmy_stat_cyl_bal_er_1.err_info_stat.lv_end_diag "end of diagnosis of the diagnosis instance CYL_BAL_ER_1" UWORD _CNV_S_2_RANGE__0___1_CM 1 100. 0. 1. DISPLAY_IDENTIFIER LV_END_DIAG_CYL_BAL_ER_1 ECU_ADDRESS 0xd00095aa BIT_MASK 0x20 /end MEASUREMENT
/begin MEASUREMENT fmy_stat_cyl_bal_er_1.err_info_stat.lv_cdn_diag "diagnosis condition of the diagnosis instance CYL_BAL_ER_1" UWORD _CNV_S_2_RANGE__0___1_CM 1 100. 0. 1. DISPLAY_IDENTIFIER LV_CDN_DIAG_CYL_BAL_ER_1 ECU_ADDRESS 0xd00095aa BIT_MASK 0x40 /end MEASUREMENT
/begin MEASUREMENT fmy_stat_cyl_bal_er_1.err_info_stat.err_sym "symptoms of the diagnosis instance CYL_BAL_ER_1" UWORD _CNV_S_16_RANGE_ERR__349_CM 1 100. 0. 15. DISPLAY_IDENTIFIER ERR_SYM_CYL_BAL_ER_1 ECU_ADDRESS 0xd00095aa BIT_MASK 0x780 /end MEASUREMENT
/begin MEASUREMENT fmy_stat_cyl_bal_er_2.ctr_abc "anti bounce counter for diagnosis instance CYL_BAL_ER_2" UBYTE _CNV_A_R_LINEAR_____0_CM 1 100. 0. 255. DISPLAY_IDENTIFIER CTR_ABC_CYL_BAL_ER_2 ECU_ADDRESS 0xd00095ac FORMAT "%3.0" /end MEASUREMENT
/begin MEASUREMENT fmy_stat_cyl_bal_er_2.ctr_end_diag "counter for end of diagnosis for diagnosis instance CYL_BAL_ER_2" UBYTE _CNV_A_R_LINEAR_____0_CM 1 100. 0. 255. DISPLAY_IDENTIFIER CTR_ABC_END_DIAG_CYL_BAL_ER_2 ECU_ADDRESS 0xd00095ad FORMAT "%3.0" /end MEASUREMENT
/begin MEASUREMENT fmy_stat_cyl_bal_er_2.err_info_stat.lv_err_mem "storage in dynamic failure memory of the diagnosis instance CYL_BAL_ER_2" UWORD _CNV_S_2_RANGE__0___1_CM 1 100. 0. 1. DISPLAY_IDENTIFIER LV_ERR_MEM_CYL_BAL_ER_2 ECU_ADDRESS 0xd00095ae BIT_MASK 0x8 /end MEASUREMENT
/begin MEASUREMENT fmy_stat_cyl_bal_er_2.err_info_stat.lv_ready "readiness status of the diagnosis instance CYL_BAL_ER_2" UWORD _CNV_S_2_RANGE__0___1_CM 1 100. 0. 1. DISPLAY_IDENTIFIER LV_READY_CYL_BAL_ER_2 ECU_ADDRESS 0xd00095ae BIT_MASK 0x10 /end MEASUREMENT
/begin MEASUREMENT fmy_stat_cyl_bal_er_2.err_info_stat.lv_end_diag "end of diagnosis of the diagnosis instance CYL_BAL_ER_2" UWORD _CNV_S_2_RANGE__0___1_CM 1 100. 0. 1. DISPLAY_IDENTIFIER LV_END_DIAG_CYL_BAL_ER_2 ECU_ADDRESS 0xd00095ae BIT_MASK 0x20 /end MEASUREMENT
/begin MEASUREMENT fmy_stat_cyl_bal_er_2.err_info_stat.lv_cdn_diag "diagnosis condition of the diagnosis instance CYL_BAL_ER_2" UWORD _CNV_S_2_RANGE__0___1_CM 1 100. 0. 1. DISPLAY_IDENTIFIER LV_CDN_DIAG_CYL_BAL_ER_2 ECU_ADDRESS 0xd00095ae BIT_MASK 0x40 /end MEASUREMENT
/begin MEASUREMENT fmy_stat_cyl_bal_er_2.err_info_stat.err_sym "symptoms of the diagnosis instance CYL_BAL_ER_2" UWORD _CNV_S_16_RANGE_ERR__349_CM 1 100. 0. 15. DISPLAY_IDENTIFIER ERR_SYM_CYL_BAL_ER_2 ECU_ADDRESS 0xd00095ae BIT_MASK 0x780 /end MEASUREMENT
/begin MEASUREMENT fmy_stat_cyl_bal_er_3.ctr_abc "anti bounce counter for diagnosis instance CYL_BAL_ER_3" UBYTE _CNV_A_R_LINEAR_____0_CM 1 100. 0. 255. DISPLAY_IDENTIFIER CTR_ABC_CYL_BAL_ER_3 ECU_ADDRESS 0xd00095b0 FORMAT "%3.0" /end MEASUREMENT
/begin MEASUREMENT fmy_stat_cyl_bal_er_3.ctr_end_diag "counter for end of diagnosis for diagnosis instance CYL_BAL_ER_3" UBYTE _CNV_A_R_LINEAR_____0_CM 1 100. 0. 255. DISPLAY_IDENTIFIER CTR_ABC_END_DIAG_CYL_BAL_ER_3 ECU_ADDRESS 0xd00095b1 FORMAT "%3.0" /end MEASUREMENT
/begin MEASUREMENT fmy_stat_cyl_bal_er_3.err_info_stat.lv_err_mem "storage in dynamic failure memory of the diagnosis instance CYL_BAL_ER_3" UWORD _CNV_S_2_RANGE__0___1_CM 1 100. 0. 1. DISPLAY_IDENTIFIER LV_ERR_MEM_CYL_BAL_ER_3 ECU_ADDRESS 0xd00095b2 BIT_MASK 0x8 /end MEASUREMENT
/begin MEASUREMENT fmy_stat_cyl_bal_er_3.err_info_stat.lv_ready "readiness status of the diagnosis instance CYL_BAL_ER_3" UWORD _CNV_S_2_RANGE__0___1_CM 1 100. 0. 1. DISPLAY_IDENTIFIER LV_READY_CYL_BAL_ER_3 ECU_ADDRESS 0xd00095b2 BIT_MASK 0x10 /end MEASUREMENT
/begin MEASUREMENT fmy_stat_cyl_bal_er_3.err_info_stat.lv_end_diag "end of diagnosis of the diagnosis instance CYL_BAL_ER_3" UWORD _CNV_S_2_RANGE__0___1_CM 1 100. 0. 1. DISPLAY_IDENTIFIER LV_END_DIAG_CYL_BAL_ER_3 ECU_ADDRESS 0xd00095b2 BIT_MASK 0x20 /end MEASUREMENT
/begin MEASUREMENT fmy_stat_cyl_bal_er_3.err_info_stat.lv_cdn_diag "diagnosis condition of the diagnosis instance CYL_BAL_ER_3" UWORD _CNV_S_2_RANGE__0___1_CM 1 100. 0. 1. DISPLAY_IDENTIFIER LV_CDN_DIAG_CYL_BAL_ER_3 ECU_ADDRESS 0xd00095b2 BIT_MASK 0x40 /end MEASUREMENT
/begin MEASUREMENT fmy_stat_cyl_bal_er_3.err_info_stat.err_sym "symptoms of the diagnosis instance CYL_BAL_ER_3" UWORD _CNV_S_16_RANGE_ERR__349_CM 1 100. 0. 15. DISPLAY_IDENTIFIER ERR_SYM_CYL_BAL_ER_3 ECU_ADDRESS 0xd00095b2 BIT_MASK 0x780 /end MEASUREMENT
/begin MEASUREMENT fmy_stat_cyl_bal_er_4.ctr_abc "anti bounce counter for diagnosis instance CYL_BAL_ER_4" UBYTE _CNV_A_R_LINEAR_____0_CM 1 100. 0. 255. DISPLAY_IDENTIFIER CTR_ABC_CYL_BAL_ER_4 ECU_ADDRESS 0xd00095b4 FORMAT "%3.0" /end MEASUREMENT
/begin MEASUREMENT fmy_stat_cyl_bal_er_4.ctr_end_diag "counter for end of diagnosis for diagnosis instance CYL_BAL_ER_4" UBYTE _CNV_A_R_LINEAR_____0_CM 1 100. 0. 255. DISPLAY_IDENTIFIER CTR_ABC_END_DIAG_CYL_BAL_ER_4 ECU_ADDRESS 0xd00095b5 FORMAT "%3.0" /end MEASUREMENT
/begin MEASUREMENT fmy_stat_cyl_bal_er_4.err_info_stat.lv_err_mem "storage in dynamic failure memory of the diagnosis instance CYL_BAL_ER_4" UWORD _CNV_S_2_RANGE__0___1_CM 1 100. 0. 1. DISPLAY_IDENTIFIER LV_ERR_MEM_CYL_BAL_ER_4 ECU_ADDRESS 0xd00095b6 BIT_MASK 0x8 /end MEASUREMENT
/begin MEASUREMENT fmy_stat_cyl_bal_er_4.err_info_stat.lv_ready "readiness status of the diagnosis instance CYL_BAL_ER_4" UWORD _CNV_S_2_RANGE__0___1_CM 1 100. 0. 1. DISPLAY_IDENTIFIER LV_READY_CYL_BAL_ER_4 ECU_ADDRESS 0xd00095b6 BIT_MASK 0x10 /end MEASUREMENT
/begin MEASUREMENT fmy_stat_cyl_bal_er_4.err_info_stat.lv_end_diag "end of diagnosis of the diagnosis instance CYL_BAL_ER_4" UWORD _CNV_S_2_RANGE__0___1_CM 1 100. 0. 1. DISPLAY_IDENTIFIER LV_END_DIAG_CYL_BAL_ER_4 ECU_ADDRESS 0xd00095b6 BIT_MASK 0x20 /end MEASUREMENT
/begin MEASUREMENT fmy_stat_cyl_bal_er_4.err_info_stat.lv_cdn_diag "diagnosis condition of the diagnosis instance CYL_BAL_ER_4" UWORD _CNV_S_2_RANGE__0___1_CM 1 100. 0. 1. DISPLAY_IDENTIFIER LV_CDN_DIAG_CYL_BAL_ER_4 ECU_ADDRESS 0xd00095b6 BIT_MASK 0x40 /end MEASUREMENT
/begin MEASUREMENT fmy_stat_cyl_bal_er_4.err_info_stat.err_sym "symptoms of the diagnosis instance CYL_BAL_ER_4" UWORD _CNV_S_16_RANGE_ERR__349_CM 1 100. 0. 15. DISPLAY_IDENTIFIER ERR_SYM_CYL_BAL_ER_4 ECU_ADDRESS 0xd00095b6 BIT_MASK 0x780 /end MEASUREMENT
/begin MEASUREMENT fmy_stat_cyl_bal_er_5.ctr_abc "anti bounce counter for diagnosis instance CYL_BAL_ER_5" UBYTE _CNV_A_R_LINEAR_____0_CM 1 100. 0. 255. DISPLAY_IDENTIFIER CTR_ABC_CYL_BAL_ER_5 ECU_ADDRESS 0xd00095b8 FORMAT "%3.0" /end MEASUREMENT
/begin MEASUREMENT fmy_stat_cyl_bal_er_5.ctr_end_diag "counter for end of diagnosis for diagnosis instance CYL_BAL_ER_5" UBYTE _CNV_A_R_LINEAR_____0_CM 1 100. 0. 255. DISPLAY_IDENTIFIER CTR_ABC_END_DIAG_CYL_BAL_ER_5 ECU_ADDRESS 0xd00095b9 FORMAT "%3.0" /end MEASUREMENT
/begin MEASUREMENT fmy_stat_cyl_bal_er_5.err_info_stat.lv_err_mem "storage in dynamic failure memory of the diagnosis instance CYL_BAL_ER_5" UWORD _CNV_S_2_RANGE__0___1_CM 1 100. 0. 1. DISPLAY_IDENTIFIER LV_ERR_MEM_CYL_BAL_ER_5 ECU_ADDRESS 0xd00095ba BIT_MASK 0x8 /end MEASUREMENT
/begin MEASUREMENT fmy_stat_cyl_bal_er_5.err_info_stat.lv_ready "readiness status of the diagnosis instance CYL_BAL_ER_5" UWORD _CNV_S_2_RANGE__0___1_CM 1 100. 0. 1. DISPLAY_IDENTIFIER LV_READY_CYL_BAL_ER_5 ECU_ADDRESS 0xd00095ba BIT_MASK 0x10 /end MEASUREMENT
/begin MEASUREMENT fmy_stat_cyl_bal_er_5.err_info_stat.lv_end_diag "end of diagnosis of the diagnosis instance CYL_BAL_ER_5" UWORD _CNV_S_2_RANGE__0___1_CM 1 100. 0. 1. DISPLAY_IDENTIFIER LV_END_DIAG_CYL_BAL_ER_5 ECU_ADDRESS 0xd00095ba BIT_MASK 0x20 /end MEASUREMENT
/begin MEASUREMENT fmy_stat_cyl_bal_er_5.err_info_stat.lv_cdn_diag "diagnosis condition of the diagnosis instance CYL_BAL_ER_5" UWORD _CNV_S_2_RANGE__0___1_CM 1 100. 0. 1. DISPLAY_IDENTIFIER LV_CDN_DIAG_CYL_BAL_ER_5 ECU_ADDRESS 0xd00095ba BIT_MASK 0x40 /end MEASUREMENT
/begin MEASUREMENT fmy_stat_cyl_bal_er_5.err_info_stat.err_sym "symptoms of the diagnosis instance CYL_BAL_ER_5" UWORD _CNV_S_16_RANGE_ERR__349_CM 1 100. 0. 15. DISPLAY_IDENTIFIER ERR_SYM_CYL_BAL_ER_5 ECU_ADDRESS 0xd00095ba BIT_MASK 0x780 /end MEASUREMENT
/begin MEASUREMENT fmy_stat_cyl_bal_er_6.ctr_abc "anti bounce counter for diagnosis instance CYL_BAL_ER_6" UBYTE _CNV_A_R_LINEAR_____0_CM 1 100. 0. 255. DISPLAY_IDENTIFIER CTR_ABC_CYL_BAL_ER_6 ECU_ADDRESS 0xd00095bc FORMAT "%3.0" /end MEASUREMENT
/begin MEASUREMENT fmy_stat_cyl_bal_er_6.ctr_end_diag "counter for end of diagnosis for diagnosis instance CYL_BAL_ER_6" UBYTE _CNV_A_R_LINEAR_____0_CM 1 100. 0. 255. DISPLAY_IDENTIFIER CTR_ABC_END_DIAG_CYL_BAL_ER_6 ECU_ADDRESS 0xd00095bd FORMAT "%3.0" /end MEASUREMENT
/begin MEASUREMENT fmy_stat_cyl_bal_er_6.err_info_stat.lv_err_mem "storage in dynamic failure memory of the diagnosis instance CYL_BAL_ER_6" UWORD _CNV_S_2_RANGE__0___1_CM 1 100. 0. 1. DISPLAY_IDENTIFIER LV_ERR_MEM_CYL_BAL_ER_6 ECU_ADDRESS 0xd00095be BIT_MASK 0x8 /end MEASUREMENT
/begin MEASUREMENT fmy_stat_cyl_bal_er_6.err_info_stat.lv_ready "readiness status of the diagnosis instance CYL_BAL_ER_6" UWORD _CNV_S_2_RANGE__0___1_CM 1 100. 0. 1. DISPLAY_IDENTIFIER LV_READY_CYL_BAL_ER_6 ECU_ADDRESS 0xd00095be BIT_MASK 0x10 /end MEASUREMENT
/begin MEASUREMENT fmy_stat_cyl_bal_er_6.err_info_stat.lv_end_diag "end of diagnosis of the diagnosis instance CYL_BAL_ER_6" UWORD _CNV_S_2_RANGE__0___1_CM 1 100. 0. 1. DISPLAY_IDENTIFIER LV_END_DIAG_CYL_BAL_ER_6 ECU_ADDRESS 0xd00095be BIT_MASK 0x20 /end MEASUREMENT
/begin MEASUREMENT fmy_stat_cyl_bal_er_6.err_info_stat.lv_cdn_diag "diagnosis condition of the diagnosis instance CYL_BAL_ER_6" UWORD _CNV_S_2_RANGE__0___1_CM 1 100. 0. 1. DISPLAY_IDENTIFIER LV_CDN_DIAG_CYL_BAL_ER_6 ECU_ADDRESS 0xd00095be BIT_MASK 0x40 /end MEASUREMENT
/begin MEASUREMENT fmy_stat_cyl_bal_er_6.err_info_stat.err_sym "symptoms of the diagnosis instance CYL_BAL_ER_6" UWORD _CNV_S_16_RANGE_ERR__349_CM 1 100. 0. 15. DISPLAY_IDENTIFIER ERR_SYM_CYL_BAL_ER_6 ECU_ADDRESS 0xd00095be BIT_MASK 0x780 /end MEASUREMENT
/begin MEASUREMENT fmy_stat_cyl_bal_er_7.ctr_abc "anti bounce counter for diagnosis instance CYL_BAL_ER_7" UBYTE _CNV_A_R_LINEAR_____0_CM 1 100. 0. 255. DISPLAY_IDENTIFIER CTR_ABC_CYL_BAL_ER_7 ECU_ADDRESS 0xd00095c0 FORMAT "%3.0" /end MEASUREMENT
/begin MEASUREMENT fmy_stat_cyl_bal_er_7.ctr_end_diag "counter for end of diagnosis for diagnosis instance CYL_BAL_ER_7" UBYTE _CNV_A_R_LINEAR_____0_CM 1 100. 0. 255. DISPLAY_IDENTIFIER CTR_ABC_END_DIAG_CYL_BAL_ER_7 ECU_ADDRESS 0xd00095c1 FORMAT "%3.0" /end MEASUREMENT
/begin MEASUREMENT fmy_stat_cyl_bal_er_7.err_info_stat.lv_err_mem "storage in dynamic failure memory of the diagnosis instance CYL_BAL_ER_7" UWORD _CNV_S_2_RANGE__0___1_CM 1 100. 0. 1. DISPLAY_IDENTIFIER LV_ERR_MEM_CYL_BAL_ER_7 ECU_ADDRESS 0xd00095c2 BIT_MASK 0x8 /end MEASUREMENT
/begin MEASUREMENT fmy_stat_cyl_bal_er_7.err_info_stat.lv_ready "readiness status of the diagnosis instance CYL_BAL_ER_7" UWORD _CNV_S_2_RANGE__0___1_CM 1 100. 0. 1. DISPLAY_IDENTIFIER LV_READY_CYL_BAL_ER_7 ECU_ADDRESS 0xd00095c2 BIT_MASK 0x10 /end MEASUREMENT
/begin MEASUREMENT fmy_stat_cyl_bal_er_7.err_info_stat.lv_end_diag "end of diagnosis of the diagnosis instance CYL_BAL_ER_7" UWORD _CNV_S_2_RANGE__0___1_CM 1 100. 0. 1. DISPLAY_IDENTIFIER LV_END_DIAG_CYL_BAL_ER_7 ECU_ADDRESS 0xd00095c2 BIT_MASK 0x20 /end MEASUREMENT
/begin MEASUREMENT fmy_stat_cyl_bal_er_7.err_info_stat.lv_cdn_diag "diagnosis condition of the diagnosis instance CYL_BAL_ER_7" UWORD _CNV_S_2_RANGE__0___1_CM 1 100. 0. 1. DISPLAY_IDENTIFIER LV_CDN_DIAG_CYL_BAL_ER_7 ECU_ADDRESS 0xd00095c2 BIT_MASK 0x40 /end MEASUREMENT
/begin MEASUREMENT fmy_stat_cyl_bal_er_7.err_info_stat.err_sym "symptoms of the diagnosis instance CYL_BAL_ER_7" UWORD _CNV_S_16_RANGE_ERR__349_CM 1 100. 0. 15. DISPLAY_IDENTIFIER ERR_SYM_CYL_BAL_ER_7 ECU_ADDRESS 0xd00095c2 BIT_MASK 0x780 /end MEASUREMENT
/begin MEASUREMENT fmy_stat_mon_3.ctr_abc "anti bounce counter for diagnosis instance MON_3" UBYTE _CNV_A_R_LINEAR_____0_CM 1 100. 0. 255. DISPLAY_IDENTIFIER CTR_ABC_MON_3 ECU_ADDRESS 0xd0009858 FORMAT "%3.0" /end MEASUREMENT
/begin MEASUREMENT fmy_stat_mon_3.ctr_end_diag "counter for end of diagnosis for diagnosis instance MON_3" UBYTE _CNV_A_R_LINEAR_____0_CM 1 100. 0. 255. DISPLAY_IDENTIFIER CTR_ABC_END_DIAG_MON_3 ECU_ADDRESS 0xd0009859 FORMAT "%3.0" /end MEASUREMENT
/begin MEASUREMENT fmy_stat_mon_3.err_info_stat.lv_err_mem "storage in dynamic failure memory of the diagnosis instance MON_3" UWORD _CNV_S_2_RANGE__0___1_CM 1 100. 0. 1. DISPLAY_IDENTIFIER LV_ERR_MEM_MON_3 ECU_ADDRESS 0xd000985a BIT_MASK 0x8 /end MEASUREMENT
/begin MEASUREMENT fmy_stat_mon_3.err_info_stat.lv_ready "readiness status of the diagnosis instance MON_3" UWORD _CNV_S_2_RANGE__0___1_CM 1 100. 0. 1. DISPLAY_IDENTIFIER LV_READY_MON_3 ECU_ADDRESS 0xd000985a BIT_MASK 0x10 /end MEASUREMENT
/begin MEASUREMENT fmy_stat_mon_3.err_info_stat.lv_end_diag "end of diagnosis of the diagnosis instance MON_3" UWORD _CNV_S_2_RANGE__0___1_CM 1 100. 0. 1. DISPLAY_IDENTIFIER LV_END_DIAG_MON_3 ECU_ADDRESS 0xd000985a BIT_MASK 0x20 /end MEASUREMENT
/begin MEASUREMENT fmy_stat_mon_3.err_info_stat.lv_cdn_diag "diagnosis condition of the diagnosis instance MON_3" UWORD _CNV_S_2_RANGE__0___1_CM 1 100. 0. 1. DISPLAY_IDENTIFIER LV_CDN_DIAG_MON_3 ECU_ADDRESS 0xd000985a BIT_MASK 0x40 /end MEASUREMENT
/begin MEASUREMENT fmy_stat_mon_3.err_info_stat.err_sym "symptoms of the diagnosis instance MON_3" UWORD _CNV_S_16_RANGE_ERR__349_CM 1 100. 0. 15. DISPLAY_IDENTIFIER ERR_SYM_MON_3 ECU_ADDRESS 0xd000985a BIT_MASK 0x780 /end MEASUREMENT
/begin MEASUREMENT fmy_stat_maf_frq_rng_0.ctr_abc "anti bounce counter for diagnosis instance MAF_FRQ_RNG_0" UBYTE _CNV_A_R_LINEAR_____0_CM 1 100. 0. 255. DISPLAY_IDENTIFIER CTR_ABC_MAF_FRQ_RNG_0 ECU_ADDRESS 0xd0009800 FORMAT "%3.0" /end MEASUREMENT
/begin MEASUREMENT fmy_stat_maf_frq_rng_0.ctr_end_diag "counter for end of diagnosis for diagnosis instance MAF_FRQ_RNG_0" UBYTE _CNV_A_R_LINEAR_____0_CM 1 100. 0. 255. DISPLAY_IDENTIFIER CTR_ABC_END_DIAG_MAF_FRQ_RNG_0 ECU_ADDRESS 0xd0009801 FORMAT "%3.0" /end MEASUREMENT
/begin MEASUREMENT fmy_stat_maf_frq_rng_0.err_info_stat.lv_err_mem "storage in dynamic failure memory of the diagnosis instance MAF_FRQ_RNG_0" UWORD _CNV_S_2_RANGE__0___1_CM 1 100. 0. 1. DISPLAY_IDENTIFIER LV_ERR_MEM_MAF_FRQ_RNG_0 ECU_ADDRESS 0xd0009802 BIT_MASK 0x8 /end MEASUREMENT
/begin MEASUREMENT fmy_stat_maf_frq_rng_0.err_info_stat.lv_ready "readiness status of the diagnosis instance MAF_FRQ_RNG_0" UWORD _CNV_S_2_RANGE__0___1_CM 1 100. 0. 1. DISPLAY_IDENTIFIER LV_READY_MAF_FRQ_RNG_0 ECU_ADDRESS 0xd0009802 BIT_MASK 0x10 /end MEASUREMENT
/begin MEASUREMENT fmy_stat_maf_frq_rng_0.err_info_stat.lv_end_diag "end of diagnosis of the diagnosis instance MAF_FRQ_RNG_0" UWORD _CNV_S_2_RANGE__0___1_CM 1 100. 0. 1. DISPLAY_IDENTIFIER LV_END_DIAG_MAF_FRQ_RNG_0 ECU_ADDRESS 0xd0009802 BIT_MASK 0x20 /end MEASUREMENT
/begin MEASUREMENT fmy_stat_maf_frq_rng_0.err_info_stat.lv_cdn_diag "diagnosis condition of the diagnosis instance MAF_FRQ_RNG_0" UWORD _CNV_S_2_RANGE__0___1_CM 1 100. 0. 1. DISPLAY_IDENTIFIER LV_CDN_DIAG_MAF_FRQ_RNG_0 ECU_ADDRESS 0xd0009802 BIT_MASK 0x40 /end MEASUREMENT
/begin MEASUREMENT fmy_stat_maf_frq_rng_0.err_info_stat.err_sym "symptoms of the diagnosis instance MAF_FRQ_RNG_0" UWORD _CNV_S_16_RANGE_ERR__349_CM 1 100. 0. 15. DISPLAY_IDENTIFIER ERR_SYM_MAF_FRQ_RNG_0 ECU_ADDRESS 0xd0009802 BIT_MASK 0x780 /end MEASUREMENT
/begin MEASUREMENT fmy_stat_maf_frq_grd_0.ctr_abc "anti bounce counter for diagnosis instance MAF_FRQ_GRD_0" UBYTE _CNV_A_R_LINEAR_____0_CM 1 100. 0. 255. DISPLAY_IDENTIFIER CTR_ABC_MAF_FRQ_GRD_0 ECU_ADDRESS 0xd00097f8 FORMAT "%3.0" /end MEASUREMENT
/begin MEASUREMENT fmy_stat_maf_frq_grd_0.ctr_end_diag "counter for end of diagnosis for diagnosis instance MAF_FRQ_GRD_0" UBYTE _CNV_A_R_LINEAR_____0_CM 1 100. 0. 255. DISPLAY_IDENTIFIER CTR_ABC_END_DIAG_MAF_FRQ_GRD_0 ECU_ADDRESS 0xd00097f9 FORMAT "%3.0" /end MEASUREMENT
/begin MEASUREMENT fmy_stat_maf_frq_grd_0.err_info_stat.lv_err_mem "storage in dynamic failure memory of the diagnosis instance MAF_FRQ_GRD_0" UWORD _CNV_S_2_RANGE__0___1_CM 1 100. 0. 1. DISPLAY_IDENTIFIER LV_ERR_MEM_MAF_FRQ_GRD_0 ECU_ADDRESS 0xd00097fa BIT_MASK 0x8 /end MEASUREMENT
/begin MEASUREMENT fmy_stat_maf_frq_grd_0.err_info_stat.lv_ready "readiness status of the diagnosis instance MAF_FRQ_GRD_0" UWORD _CNV_S_2_RANGE__0___1_CM 1 100. 0. 1. DISPLAY_IDENTIFIER LV_READY_MAF_FRQ_GRD_0 ECU_ADDRESS 0xd00097fa BIT_MASK 0x10 /end MEASUREMENT
/begin MEASUREMENT fmy_stat_maf_frq_grd_0.err_info_stat.lv_end_diag "end of diagnosis of the diagnosis instance MAF_FRQ_GRD_0" UWORD _CNV_S_2_RANGE__0___1_CM 1 100. 0. 1. DISPLAY_IDENTIFIER LV_END_DIAG_MAF_FRQ_GRD_0 ECU_ADDRESS 0xd00097fa BIT_MASK 0x20 /end MEASUREMENT
/begin MEASUREMENT fmy_stat_maf_frq_grd_0.err_info_stat.lv_cdn_diag "diagnosis condition of the diagnosis instance MAF_FRQ_GRD_0" UWORD _CNV_S_2_RANGE__0___1_CM 1 100. 0. 1. DISPLAY_IDENTIFIER LV_CDN_DIAG_MAF_FRQ_GRD_0 ECU_ADDRESS 0xd00097fa BIT_MASK 0x40 /end MEASUREMENT
/begin MEASUREMENT fmy_stat_maf_frq_grd_0.err_info_stat.err_sym "symptoms of the diagnosis instance MAF_FRQ_GRD_0" UWORD _CNV_S_16_RANGE_ERR__349_CM 1 100. 0. 15. DISPLAY_IDENTIFIER ERR_SYM_MAF_FRQ_GRD_0 ECU_ADDRESS 0xd00097fa BIT_MASK 0x780 /end MEASUREMENT
/begin MEASUREMENT fmy_stat_maf_frq_el_0.ctr_abc "anti bounce counter for diagnosis instance MAF_FRQ_EL_0" UBYTE _CNV_A_R_LINEAR_____0_CM 1 100. 0. 255. DISPLAY_IDENTIFIER CTR_ABC_MAF_FRQ_EL_0 ECU_ADDRESS 0xd00097f0 FORMAT "%3.0" /end MEASUREMENT
/begin MEASUREMENT fmy_stat_maf_frq_el_0.ctr_end_diag "counter for end of diagnosis for diagnosis instance MAF_FRQ_EL_0" UBYTE _CNV_A_R_LINEAR_____0_CM 1 100. 0. 255. DISPLAY_IDENTIFIER CTR_ABC_END_DIAG_MAF_FRQ_EL_0 ECU_ADDRESS 0xd00097f1 FORMAT "%3.0" /end MEASUREMENT
/begin MEASUREMENT fmy_stat_maf_frq_el_0.err_info_stat.lv_err_mem "storage in dynamic failure memory of the diagnosis instance MAF_FRQ_EL_0" UWORD _CNV_S_2_RANGE__0___1_CM 1 100. 0. 1. DISPLAY_IDENTIFIER LV_ERR_MEM_MAF_FRQ_EL_0 ECU_ADDRESS 0xd00097f2 BIT_MASK 0x8 /end MEASUREMENT
/begin MEASUREMENT fmy_stat_maf_frq_el_0.err_info_stat.lv_ready "readiness status of the diagnosis instance MAF_FRQ_EL_0" UWORD _CNV_S_2_RANGE__0___1_CM 1 100. 0. 1. DISPLAY_IDENTIFIER LV_READY_MAF_FRQ_EL_0 ECU_ADDRESS 0xd00097f2 BIT_MASK 0x10 /end MEASUREMENT
/begin MEASUREMENT fmy_stat_maf_frq_el_0.err_info_stat.lv_end_diag "end of diagnosis of the diagnosis instance MAF_FRQ_EL_0" UWORD _CNV_S_2_RANGE__0___1_CM 1 100. 0. 1. DISPLAY_IDENTIFIER LV_END_DIAG_MAF_FRQ_EL_0 ECU_ADDRESS 0xd00097f2 BIT_MASK 0x20 /end MEASUREMENT
/begin MEASUREMENT fmy_stat_maf_frq_el_0.err_info_stat.lv_cdn_diag "diagnosis condition of the diagnosis instance MAF_FRQ_EL_0" UWORD _CNV_S_2_RANGE__0___1_CM 1 100. 0. 1. DISPLAY_IDENTIFIER LV_CDN_DIAG_MAF_FRQ_EL_0 ECU_ADDRESS 0xd00097f2 BIT_MASK 0x40 /end MEASUREMENT
/begin MEASUREMENT fmy_stat_maf_frq_el_0.err_info_stat.err_sym "symptoms of the diagnosis instance MAF_FRQ_EL_0" UWORD _CNV_S_16_RANGE_ERR__349_CM 1 100. 0. 15. DISPLAY_IDENTIFIER ERR_SYM_MAF_FRQ_EL_0 ECU_ADDRESS 0xd00097f2 BIT_MASK 0x780 /end MEASUREMENT
/begin MEASUREMENT fmy_stat_maf_frq_rng_1.ctr_abc "anti bounce counter for diagnosis instance MAF_FRQ_RNG_1" UBYTE _CNV_A_R_LINEAR_____0_CM 1 100. 0. 255. DISPLAY_IDENTIFIER CTR_ABC_MAF_FRQ_RNG_1 ECU_ADDRESS 0xd0009804 FORMAT "%3.0" /end MEASUREMENT
/begin MEASUREMENT fmy_stat_maf_frq_rng_1.ctr_end_diag "counter for end of diagnosis for diagnosis instance MAF_FRQ_RNG_1" UBYTE _CNV_A_R_LINEAR_____0_CM 1 100. 0. 255. DISPLAY_IDENTIFIER CTR_ABC_END_DIAG_MAF_FRQ_RNG_1 ECU_ADDRESS 0xd0009805 FORMAT "%3.0" /end MEASUREMENT
/begin MEASUREMENT fmy_stat_maf_frq_rng_1.err_info_stat.lv_err_mem "storage in dynamic failure memory of the diagnosis instance MAF_FRQ_RNG_1" UWORD _CNV_S_2_RANGE__0___1_CM 1 100. 0. 1. DISPLAY_IDENTIFIER LV_ERR_MEM_MAF_FRQ_RNG_1 ECU_ADDRESS 0xd0009806 BIT_MASK 0x8 /end MEASUREMENT
/begin MEASUREMENT fmy_stat_maf_frq_rng_1.err_info_stat.lv_ready "readiness status of the diagnosis instance MAF_FRQ_RNG_1" UWORD _CNV_S_2_RANGE__0___1_CM 1 100. 0. 1. DISPLAY_IDENTIFIER LV_READY_MAF_FRQ_RNG_1 ECU_ADDRESS 0xd0009806 BIT_MASK 0x10 /end MEASUREMENT
/begin MEASUREMENT fmy_stat_maf_frq_rng_1.err_info_stat.lv_end_diag "end of diagnosis of the diagnosis instance MAF_FRQ_RNG_1" UWORD _CNV_S_2_RANGE__0___1_CM 1 100. 0. 1. DISPLAY_IDENTIFIER LV_END_DIAG_MAF_FRQ_RNG_1 ECU_ADDRESS 0xd0009806 BIT_MASK 0x20 /end MEASUREMENT
/begin MEASUREMENT fmy_stat_maf_frq_rng_1.err_info_stat.lv_cdn_diag "diagnosis condition of the diagnosis instance MAF_FRQ_RNG_1" UWORD _CNV_S_2_RANGE__0___1_CM 1 100. 0. 1. DISPLAY_IDENTIFIER LV_CDN_DIAG_MAF_FRQ_RNG_1 ECU_ADDRESS 0xd0009806 BIT_MASK 0x40 /end MEASUREMENT
/begin MEASUREMENT fmy_stat_maf_frq_rng_1.err_info_stat.err_sym "symptoms of the diagnosis instance MAF_FRQ_RNG_1" UWORD _CNV_S_16_RANGE_ERR__349_CM 1 100. 0. 15. DISPLAY_IDENTIFIER ERR_SYM_MAF_FRQ_RNG_1 ECU_ADDRESS 0xd0009806 BIT_MASK 0x780 /end MEASUREMENT
/begin MEASUREMENT fmy_stat_maf_frq_grd_1.ctr_abc "anti bounce counter for diagnosis instance MAF_FRQ_GRD_1" UBYTE _CNV_A_R_LINEAR_____0_CM 1 100. 0. 255. DISPLAY_IDENTIFIER CTR_ABC_MAF_FRQ_GRD_1 ECU_ADDRESS 0xd00097fc FORMAT "%3.0" /end MEASUREMENT
/begin MEASUREMENT fmy_stat_maf_frq_grd_1.ctr_end_diag "counter for end of diagnosis for diagnosis instance MAF_FRQ_GRD_1" UBYTE _CNV_A_R_LINEAR_____0_CM 1 100. 0. 255. DISPLAY_IDENTIFIER CTR_ABC_END_DIAG_MAF_FRQ_GRD_1 ECU_ADDRESS 0xd00097fd FORMAT "%3.0" /end MEASUREMENT
/begin MEASUREMENT fmy_stat_maf_frq_grd_1.err_info_stat.lv_err_mem "storage in dynamic failure memory of the diagnosis instance MAF_FRQ_GRD_1" UWORD _CNV_S_2_RANGE__0___1_CM 1 100. 0. 1. DISPLAY_IDENTIFIER LV_ERR_MEM_MAF_FRQ_GRD_1 ECU_ADDRESS 0xd00097fe BIT_MASK 0x8 /end MEASUREMENT
/begin MEASUREMENT fmy_stat_maf_frq_grd_1.err_info_stat.lv_ready "readiness status of the diagnosis instance MAF_FRQ_GRD_1" UWORD _CNV_S_2_RANGE__0___1_CM 1 100. 0. 1. DISPLAY_IDENTIFIER LV_READY_MAF_FRQ_GRD_1 ECU_ADDRESS 0xd00097fe BIT_MASK 0x10 /end MEASUREMENT
/begin MEASUREMENT fmy_stat_maf_frq_grd_1.err_info_stat.lv_end_diag "end of diagnosis of the diagnosis instance MAF_FRQ_GRD_1" UWORD _CNV_S_2_RANGE__0___1_CM 1 100. 0. 1. DISPLAY_IDENTIFIER LV_END_DIAG_MAF_FRQ_GRD_1 ECU_ADDRESS 0xd00097fe BIT_MASK 0x20 /end MEASUREMENT
/begin MEASUREMENT fmy_stat_maf_frq_grd_1.err_info_stat.lv_cdn_diag "diagnosis condition of the diagnosis instance MAF_FRQ_GRD_1" UWORD _CNV_S_2_RANGE__0___1_CM 1 100. 0. 1. DISPLAY_IDENTIFIER LV_CDN_DIAG_MAF_FRQ_GRD_1 ECU_ADDRESS 0xd00097fe BIT_MASK 0x40 /end MEASUREMENT
/begin MEASUREMENT fmy_stat_maf_frq_grd_1.err_info_stat.err_sym "symptoms of the diagnosis instance MAF_FRQ_GRD_1" UWORD _CNV_S_16_RANGE_ERR__349_CM 1 100. 0. 15. DISPLAY_IDENTIFIER ERR_SYM_MAF_FRQ_GRD_1 ECU_ADDRESS 0xd00097fe BIT_MASK 0x780 /end MEASUREMENT
/begin MEASUREMENT fmy_stat_maf_frq_el_1.ctr_abc "anti bounce counter for diagnosis instance MAF_FRQ_EL_1" UBYTE _CNV_A_R_LINEAR_____0_CM 1 100. 0. 255. DISPLAY_IDENTIFIER CTR_ABC_MAF_FRQ_EL_1 ECU_ADDRESS 0xd00097f4 FORMAT "%3.0" /end MEASUREMENT
/begin MEASUREMENT fmy_stat_maf_frq_el_1.ctr_end_diag "counter for end of diagnosis for diagnosis instance MAF_FRQ_EL_1" UBYTE _CNV_A_R_LINEAR_____0_CM 1 100. 0. 255. DISPLAY_IDENTIFIER CTR_ABC_END_DIAG_MAF_FRQ_EL_1 ECU_ADDRESS 0xd00097f5 FORMAT "%3.0" /end MEASUREMENT
/begin MEASUREMENT fmy_stat_maf_frq_el_1.err_info_stat.lv_err_mem "storage in dynamic failure memory of the diagnosis instance MAF_FRQ_EL_1" UWORD _CNV_S_2_RANGE__0___1_CM 1 100. 0. 1. DISPLAY_IDENTIFIER LV_ERR_MEM_MAF_FRQ_EL_1 ECU_ADDRESS 0xd00097f6 BIT_MASK 0x8 /end MEASUREMENT
/begin MEASUREMENT fmy_stat_maf_frq_el_1.err_info_stat.lv_ready "readiness status of the diagnosis instance MAF_FRQ_EL_1" UWORD _CNV_S_2_RANGE__0___1_CM 1 100. 0. 1. DISPLAY_IDENTIFIER LV_READY_MAF_FRQ_EL_1 ECU_ADDRESS 0xd00097f6 BIT_MASK 0x10 /end MEASUREMENT
/begin MEASUREMENT fmy_stat_maf_frq_el_1.err_info_stat.lv_end_diag "end of diagnosis of the diagnosis instance MAF_FRQ_EL_1" UWORD _CNV_S_2_RANGE__0___1_CM 1 100. 0. 1. DISPLAY_IDENTIFIER LV_END_DIAG_MAF_FRQ_EL_1 ECU_ADDRESS 0xd00097f6 BIT_MASK 0x20 /end MEASUREMENT
/begin MEASUREMENT fmy_stat_maf_frq_el_1.err_info_stat.lv_cdn_diag "diagnosis condition of the diagnosis instance MAF_FRQ_EL_1" UWORD _CNV_S_2_RANGE__0___1_CM 1 100. 0. 1. DISPLAY_IDENTIFIER LV_CDN_DIAG_MAF_FRQ_EL_1 ECU_ADDRESS 0xd00097f6 BIT_MASK 0x40 /end MEASUREMENT
/begin MEASUREMENT fmy_stat_maf_frq_el_1.err_info_stat.err_sym "symptoms of the diagnosis instance MAF_FRQ_EL_1" UWORD _CNV_S_16_RANGE_ERR__349_CM 1 100. 0. 15. DISPLAY_IDENTIFIER ERR_SYM_MAF_FRQ_EL_1 ECU_ADDRESS 0xd00097f6 BIT_MASK 0x780 /end MEASUREMENT
/begin MEASUREMENT fmy_stat_tps_1_1.ctr_abc "anti bounce counter for diagnosis instance TPS_1_1" UBYTE _CNV_A_R_LINEAR_____0_CM 1 100. 0. 255. DISPLAY_IDENTIFIER CTR_ABC_TPS_1_1 ECU_ADDRESS 0xd0009a74 FORMAT "%3.0" /end MEASUREMENT
/begin MEASUREMENT fmy_stat_tps_1_1.ctr_end_diag "counter for end of diagnosis for diagnosis instance TPS_1_1" UBYTE _CNV_A_R_LINEAR_____0_CM 1 100. 0. 255. DISPLAY_IDENTIFIER CTR_ABC_END_DIAG_TPS_1_1 ECU_ADDRESS 0xd0009a75 FORMAT "%3.0" /end MEASUREMENT
/begin MEASUREMENT fmy_stat_tps_1_1.err_info_stat.lv_err_mem "storage in dynamic failure memory of the diagnosis instance TPS_1_1" UWORD _CNV_S_2_RANGE__0___1_CM 1 100. 0. 1. DISPLAY_IDENTIFIER LV_ERR_MEM_TPS_1_1 ECU_ADDRESS 0xd0009a76 BIT_MASK 0x8 /end MEASUREMENT
/begin MEASUREMENT fmy_stat_tps_1_1.err_info_stat.lv_ready "readiness status of the diagnosis instance TPS_1_1" UWORD _CNV_S_2_RANGE__0___1_CM 1 100. 0. 1. DISPLAY_IDENTIFIER LV_READY_TPS_1_1 ECU_ADDRESS 0xd0009a76 BIT_MASK 0x10 /end MEASUREMENT
/begin MEASUREMENT fmy_stat_tps_1_1.err_info_stat.lv_end_diag "end of diagnosis of the diagnosis instance TPS_1_1" UWORD _CNV_S_2_RANGE__0___1_CM 1 100. 0. 1. DISPLAY_IDENTIFIER LV_END_DIAG_TPS_1_1 ECU_ADDRESS 0xd0009a76 BIT_MASK 0x20 /end MEASUREMENT
/begin MEASUREMENT fmy_stat_tps_1_1.err_info_stat.lv_cdn_diag "diagnosis condition of the diagnosis instance TPS_1_1" UWORD _CNV_S_2_RANGE__0___1_CM 1 100. 0. 1. DISPLAY_IDENTIFIER LV_CDN_DIAG_TPS_1_1 ECU_ADDRESS 0xd0009a76 BIT_MASK 0x40 /end MEASUREMENT
/begin MEASUREMENT fmy_stat_tps_1_1.err_info_stat.err_sym "symptoms of the diagnosis instance TPS_1_1" UWORD _CNV_S_16_RANGE_ERR__349_CM 1 100. 0. 15. DISPLAY_IDENTIFIER ERR_SYM_TPS_1_1 ECU_ADDRESS 0xd0009a76 BIT_MASK 0x780 /end MEASUREMENT
/begin MEASUREMENT fmy_stat_tps_1_2.ctr_abc "anti bounce counter for diagnosis instance TPS_1_2" UBYTE _CNV_A_R_LINEAR_____0_CM 1 100. 0. 255. DISPLAY_IDENTIFIER CTR_ABC_TPS_1_2 ECU_ADDRESS 0xd0009a78 FORMAT "%3.0" /end MEASUREMENT
/begin MEASUREMENT fmy_stat_tps_1_2.ctr_end_diag "counter for end of diagnosis for diagnosis instance TPS_1_2" UBYTE _CNV_A_R_LINEAR_____0_CM 1 100. 0. 255. DISPLAY_IDENTIFIER CTR_ABC_END_DIAG_TPS_1_2 ECU_ADDRESS 0xd0009a79 FORMAT "%3.0" /end MEASUREMENT
/begin MEASUREMENT fmy_stat_tps_1_2.err_info_stat.lv_err_mem "storage in dynamic failure memory of the diagnosis instance TPS_1_2" UWORD _CNV_S_2_RANGE__0___1_CM 1 100. 0. 1. DISPLAY_IDENTIFIER LV_ERR_MEM_TPS_1_2 ECU_ADDRESS 0xd0009a7a BIT_MASK 0x8 /end MEASUREMENT
/begin MEASUREMENT fmy_stat_tps_1_2.err_info_stat.lv_ready "readiness status of the diagnosis instance TPS_1_2" UWORD _CNV_S_2_RANGE__0___1_CM 1 100. 0. 1. DISPLAY_IDENTIFIER LV_READY_TPS_1_2 ECU_ADDRESS 0xd0009a7a BIT_MASK 0x10 /end MEASUREMENT
/begin MEASUREMENT fmy_stat_tps_1_2.err_info_stat.lv_end_diag "end of diagnosis of the diagnosis instance TPS_1_2" UWORD _CNV_S_2_RANGE__0___1_CM 1 100. 0. 1. DISPLAY_IDENTIFIER LV_END_DIAG_TPS_1_2 ECU_ADDRESS 0xd0009a7a BIT_MASK 0x20 /end MEASUREMENT
/begin MEASUREMENT fmy_stat_tps_1_2.err_info_stat.lv_cdn_diag "diagnosis condition of the diagnosis instance TPS_1_2" UWORD _CNV_S_2_RANGE__0___1_CM 1 100. 0. 1. DISPLAY_IDENTIFIER LV_CDN_DIAG_TPS_1_2 ECU_ADDRESS 0xd0009a7a BIT_MASK 0x40 /end MEASUREMENT
/begin MEASUREMENT fmy_stat_tps_1_2.err_info_stat.err_sym "symptoms of the diagnosis instance TPS_1_2" UWORD _CNV_S_16_RANGE_ERR__349_CM 1 100. 0. 15. DISPLAY_IDENTIFIER ERR_SYM_TPS_1_2 ECU_ADDRESS 0xd0009a7a BIT_MASK 0x780 /end MEASUREMENT
/begin MEASUREMENT fmy_stat_tps_2_1.ctr_abc "anti bounce counter for diagnosis instance TPS_2_1" UBYTE _CNV_A_R_LINEAR_____0_CM 1 100. 0. 255. DISPLAY_IDENTIFIER CTR_ABC_TPS_2_1 ECU_ADDRESS 0xd0009a7c FORMAT "%3.0" /end MEASUREMENT
/begin MEASUREMENT fmy_stat_tps_2_1.ctr_end_diag "counter for end of diagnosis for diagnosis instance TPS_2_1" UBYTE _CNV_A_R_LINEAR_____0_CM 1 100. 0. 255. DISPLAY_IDENTIFIER CTR_ABC_END_DIAG_TPS_2_1 ECU_ADDRESS 0xd0009a7d FORMAT "%3.0" /end MEASUREMENT
/begin MEASUREMENT fmy_stat_tps_2_1.err_info_stat.lv_err_mem "storage in dynamic failure memory of the diagnosis instance TPS_2_1" UWORD _CNV_S_2_RANGE__0___1_CM 1 100. 0. 1. DISPLAY_IDENTIFIER LV_ERR_MEM_TPS_2_1 ECU_ADDRESS 0xd0009a7e BIT_MASK 0x8 /end MEASUREMENT
/begin MEASUREMENT fmy_stat_tps_2_1.err_info_stat.lv_ready "readiness status of the diagnosis instance TPS_2_1" UWORD _CNV_S_2_RANGE__0___1_CM 1 100. 0. 1. DISPLAY_IDENTIFIER LV_READY_TPS_2_1 ECU_ADDRESS 0xd0009a7e BIT_MASK 0x10 /end MEASUREMENT
/begin MEASUREMENT fmy_stat_tps_2_1.err_info_stat.lv_end_diag "end of diagnosis of the diagnosis instance TPS_2_1" UWORD _CNV_S_2_RANGE__0___1_CM 1 100. 0. 1. DISPLAY_IDENTIFIER LV_END_DIAG_TPS_2_1 ECU_ADDRESS 0xd0009a7e BIT_MASK 0x20 /end MEASUREMENT
/begin MEASUREMENT fmy_stat_tps_2_1.err_info_stat.lv_cdn_diag "diagnosis condition of the diagnosis instance TPS_2_1" UWORD _CNV_S_2_RANGE__0___1_CM 1 100. 0. 1. DISPLAY_IDENTIFIER LV_CDN_DIAG_TPS_2_1 ECU_ADDRESS 0xd0009a7e BIT_MASK 0x40 /end MEASUREMENT
/begin MEASUREMENT fmy_stat_tps_2_1.err_info_stat.err_sym "symptoms of the diagnosis instance TPS_2_1" UWORD _CNV_S_16_RANGE_ERR__349_CM 1 100. 0. 15. DISPLAY_IDENTIFIER ERR_SYM_TPS_2_1 ECU_ADDRESS 0xd0009a7e BIT_MASK 0x780 /end MEASUREMENT
/begin MEASUREMENT fmy_stat_tps_2_2.ctr_abc "anti bounce counter for diagnosis instance TPS_2_2" UBYTE _CNV_A_R_LINEAR_____0_CM 1 100. 0. 255. DISPLAY_IDENTIFIER CTR_ABC_TPS_2_2 ECU_ADDRESS 0xd0009a80 FORMAT "%3.0" /end MEASUREMENT
/begin MEASUREMENT fmy_stat_tps_2_2.ctr_end_diag "counter for end of diagnosis for diagnosis instance TPS_2_2" UBYTE _CNV_A_R_LINEAR_____0_CM 1 100. 0. 255. DISPLAY_IDENTIFIER CTR_ABC_END_DIAG_TPS_2_2 ECU_ADDRESS 0xd0009a81 FORMAT "%3.0" /end MEASUREMENT
/begin MEASUREMENT fmy_stat_tps_2_2.err_info_stat.lv_err_mem "storage in dynamic failure memory of the diagnosis instance TPS_2_2" UWORD _CNV_S_2_RANGE__0___1_CM 1 100. 0. 1. DISPLAY_IDENTIFIER LV_ERR_MEM_TPS_2_2 ECU_ADDRESS 0xd0009a82 BIT_MASK 0x8 /end MEASUREMENT
/begin MEASUREMENT fmy_stat_tps_2_2.err_info_stat.lv_ready "readiness status of the diagnosis instance TPS_2_2" UWORD _CNV_S_2_RANGE__0___1_CM 1 100. 0. 1. DISPLAY_IDENTIFIER LV_READY_TPS_2_2 ECU_ADDRESS 0xd0009a82 BIT_MASK 0x10 /end MEASUREMENT
/begin MEASUREMENT fmy_stat_tps_2_2.err_info_stat.lv_end_diag "end of diagnosis of the diagnosis instance TPS_2_2" UWORD _CNV_S_2_RANGE__0___1_CM 1 100. 0. 1. DISPLAY_IDENTIFIER LV_END_DIAG_TPS_2_2 ECU_ADDRESS 0xd0009a82 BIT_MASK 0x20 /end MEASUREMENT
/begin MEASUREMENT fmy_stat_tps_2_2.err_info_stat.lv_cdn_diag "diagnosis condition of the diagnosis instance TPS_2_2" UWORD _CNV_S_2_RANGE__0___1_CM 1 100. 0. 1. DISPLAY_IDENTIFIER LV_CDN_DIAG_TPS_2_2 ECU_ADDRESS 0xd0009a82 BIT_MASK 0x40 /end MEASUREMENT
/begin MEASUREMENT fmy_stat_tps_2_2.err_info_stat.err_sym "symptoms of the diagnosis instance TPS_2_2" UWORD _CNV_S_16_RANGE_ERR__349_CM 1 100. 0. 15. DISPLAY_IDENTIFIER ERR_SYM_TPS_2_2 ECU_ADDRESS 0xd0009a82 BIT_MASK 0x780 /end MEASUREMENT
/begin MEASUREMENT fmy_stat_tps_maf_1_1.ctr_abc "anti bounce counter for diagnosis instance TPS_MAF_1_1" UBYTE _CNV_A_R_LINEAR_____0_CM 1 100. 0. 255. DISPLAY_IDENTIFIER CTR_ABC_TPS_MAF_1_1 ECU_ADDRESS 0xd0009a94 FORMAT "%3.0" /end MEASUREMENT
/begin MEASUREMENT fmy_stat_tps_maf_1_1.ctr_end_diag "counter for end of diagnosis for diagnosis instance TPS_MAF_1_1" UBYTE _CNV_A_R_LINEAR_____0_CM 1 100. 0. 255. DISPLAY_IDENTIFIER CTR_ABC_END_DIAG_TPS_MAF_1_1 ECU_ADDRESS 0xd0009a95 FORMAT "%3.0" /end MEASUREMENT
/begin MEASUREMENT fmy_stat_tps_maf_1_1.err_info_stat.lv_err_mem "storage in dynamic failure memory of the diagnosis instance TPS_MAF_1_1" UWORD _CNV_S_2_RANGE__0___1_CM 1 100. 0. 1. DISPLAY_IDENTIFIER LV_ERR_MEM_TPS_MAF_1_1 ECU_ADDRESS 0xd0009a96 BIT_MASK 0x8 /end MEASUREMENT
/begin MEASUREMENT fmy_stat_tps_maf_1_1.err_info_stat.lv_ready "readiness status of the diagnosis instance TPS_MAF_1_1" UWORD _CNV_S_2_RANGE__0___1_CM 1 100. 0. 1. DISPLAY_IDENTIFIER LV_READY_TPS_MAF_1_1 ECU_ADDRESS 0xd0009a96 BIT_MASK 0x10 /end MEASUREMENT
/begin MEASUREMENT fmy_stat_tps_maf_1_1.err_info_stat.lv_end_diag "end of diagnosis of the diagnosis instance TPS_MAF_1_1" UWORD _CNV_S_2_RANGE__0___1_CM 1 100. 0. 1. DISPLAY_IDENTIFIER LV_END_DIAG_TPS_MAF_1_1 ECU_ADDRESS 0xd0009a96 BIT_MASK 0x20 /end MEASUREMENT
/begin MEASUREMENT fmy_stat_tps_maf_1_1.err_info_stat.lv_cdn_diag "diagnosis condition of the diagnosis instance TPS_MAF_1_1" UWORD _CNV_S_2_RANGE__0___1_CM 1 100. 0. 1. DISPLAY_IDENTIFIER LV_CDN_DIAG_TPS_MAF_1_1 ECU_ADDRESS 0xd0009a96 BIT_MASK 0x40 /end MEASUREMENT
/begin MEASUREMENT fmy_stat_tps_maf_1_1.err_info_stat.err_sym "symptoms of the diagnosis instance TPS_MAF_1_1" UWORD _CNV_S_16_RANGE_ERR__349_CM 1 100. 0. 15. DISPLAY_IDENTIFIER ERR_SYM_TPS_MAF_1_1 ECU_ADDRESS 0xd0009a96 BIT_MASK 0x780 /end MEASUREMENT
/begin MEASUREMENT fmy_stat_tps_maf_1_2.ctr_abc "anti bounce counter for diagnosis instance TPS_MAF_1_2" UBYTE _CNV_A_R_LINEAR_____0_CM 1 100. 0. 255. DISPLAY_IDENTIFIER CTR_ABC_TPS_MAF_1_2 ECU_ADDRESS 0xd0009a98 FORMAT "%3.0" /end MEASUREMENT
/begin MEASUREMENT fmy_stat_tps_maf_1_2.ctr_end_diag "counter for end of diagnosis for diagnosis instance TPS_MAF_1_2" UBYTE _CNV_A_R_LINEAR_____0_CM 1 100. 0. 255. DISPLAY_IDENTIFIER CTR_ABC_END_DIAG_TPS_MAF_1_2 ECU_ADDRESS 0xd0009a99 FORMAT "%3.0" /end MEASUREMENT
/begin MEASUREMENT fmy_stat_tps_maf_1_2.err_info_stat.lv_err_mem "storage in dynamic failure memory of the diagnosis instance TPS_MAF_1_2" UWORD _CNV_S_2_RANGE__0___1_CM 1 100. 0. 1. DISPLAY_IDENTIFIER LV_ERR_MEM_TPS_MAF_1_2 ECU_ADDRESS 0xd0009a9a BIT_MASK 0x8 /end MEASUREMENT
/begin MEASUREMENT fmy_stat_tps_maf_1_2.err_info_stat.lv_ready "readiness status of the diagnosis instance TPS_MAF_1_2" UWORD _CNV_S_2_RANGE__0___1_CM 1 100. 0. 1. DISPLAY_IDENTIFIER LV_READY_TPS_MAF_1_2 ECU_ADDRESS 0xd0009a9a BIT_MASK 0x10 /end MEASUREMENT
/begin MEASUREMENT fmy_stat_tps_maf_1_2.err_info_stat.lv_end_diag "end of diagnosis of the diagnosis instance TPS_MAF_1_2" UWORD _CNV_S_2_RANGE__0___1_CM 1 100. 0. 1. DISPLAY_IDENTIFIER LV_END_DIAG_TPS_MAF_1_2 ECU_ADDRESS 0xd0009a9a BIT_MASK 0x20 /end MEASUREMENT
/begin MEASUREMENT fmy_stat_tps_maf_1_2.err_info_stat.lv_cdn_diag "diagnosis condition of the diagnosis instance TPS_MAF_1_2" UWORD _CNV_S_2_RANGE__0___1_CM 1 100. 0. 1. DISPLAY_IDENTIFIER LV_CDN_DIAG_TPS_MAF_1_2 ECU_ADDRESS 0xd0009a9a BIT_MASK 0x40 /end MEASUREMENT
/begin MEASUREMENT fmy_stat_tps_maf_1_2.err_info_stat.err_sym "symptoms of the diagnosis instance TPS_MAF_1_2" UWORD _CNV_S_16_RANGE_ERR__349_CM 1 100. 0. 15. DISPLAY_IDENTIFIER ERR_SYM_TPS_MAF_1_2 ECU_ADDRESS 0xd0009a9a BIT_MASK 0x780 /end MEASUREMENT
/begin MEASUREMENT fmy_stat_tps_maf_2_1.ctr_abc "anti bounce counter for diagnosis instance TPS_MAF_2_1" UBYTE _CNV_A_R_LINEAR_____0_CM 1 100. 0. 255. DISPLAY_IDENTIFIER CTR_ABC_TPS_MAF_2_1 ECU_ADDRESS 0xd0009a9c FORMAT "%3.0" /end MEASUREMENT
/begin MEASUREMENT fmy_stat_tps_maf_2_1.ctr_end_diag "counter for end of diagnosis for diagnosis instance TPS_MAF_2_1" UBYTE _CNV_A_R_LINEAR_____0_CM 1 100. 0. 255. DISPLAY_IDENTIFIER CTR_ABC_END_DIAG_TPS_MAF_2_1 ECU_ADDRESS 0xd0009a9d FORMAT "%3.0" /end MEASUREMENT
/begin MEASUREMENT fmy_stat_tps_maf_2_1.err_info_stat.lv_err_mem "storage in dynamic failure memory of the diagnosis instance TPS_MAF_2_1" UWORD _CNV_S_2_RANGE__0___1_CM 1 100. 0. 1. DISPLAY_IDENTIFIER LV_ERR_MEM_TPS_MAF_2_1 ECU_ADDRESS 0xd0009a9e BIT_MASK 0x8 /end MEASUREMENT
/begin MEASUREMENT fmy_stat_tps_maf_2_1.err_info_stat.lv_ready "readiness status of the diagnosis instance TPS_MAF_2_1" UWORD _CNV_S_2_RANGE__0___1_CM 1 100. 0. 1. DISPLAY_IDENTIFIER LV_READY_TPS_MAF_2_1 ECU_ADDRESS 0xd0009a9e BIT_MASK 0x10 /end MEASUREMENT
/begin MEASUREMENT fmy_stat_tps_maf_2_1.err_info_stat.lv_end_diag "end of diagnosis of the diagnosis instance TPS_MAF_2_1" UWORD _CNV_S_2_RANGE__0___1_CM 1 100. 0. 1. DISPLAY_IDENTIFIER LV_END_DIAG_TPS_MAF_2_1 ECU_ADDRESS 0xd0009a9e BIT_MASK 0x20 /end MEASUREMENT
/begin MEASUREMENT fmy_stat_tps_maf_2_1.err_info_stat.lv_cdn_diag "diagnosis condition of the diagnosis instance TPS_MAF_2_1" UWORD _CNV_S_2_RANGE__0___1_CM 1 100. 0. 1. DISPLAY_IDENTIFIER LV_CDN_DIAG_TPS_MAF_2_1 ECU_ADDRESS 0xd0009a9e BIT_MASK 0x40 /end MEASUREMENT
/begin MEASUREMENT fmy_stat_tps_maf_2_1.err_info_stat.err_sym "symptoms of the diagnosis instance TPS_MAF_2_1" UWORD _CNV_S_16_RANGE_ERR__349_CM 1 100. 0. 15. DISPLAY_IDENTIFIER ERR_SYM_TPS_MAF_2_1 ECU_ADDRESS 0xd0009a9e BIT_MASK 0x780 /end MEASUREMENT
/begin MEASUREMENT fmy_stat_tps_maf_2_2.ctr_abc "anti bounce counter for diagnosis instance TPS_MAF_2_2" UBYTE _CNV_A_R_LINEAR_____0_CM 1 100. 0. 255. DISPLAY_IDENTIFIER CTR_ABC_TPS_MAF_2_2 ECU_ADDRESS 0xd0009aa0 FORMAT "%3.0" /end MEASUREMENT
/begin MEASUREMENT fmy_stat_tps_maf_2_2.ctr_end_diag "counter for end of diagnosis for diagnosis instance TPS_MAF_2_2" UBYTE _CNV_A_R_LINEAR_____0_CM 1 100. 0. 255. DISPLAY_IDENTIFIER CTR_ABC_END_DIAG_TPS_MAF_2_2 ECU_ADDRESS 0xd0009aa1 FORMAT "%3.0" /end MEASUREMENT
/begin MEASUREMENT fmy_stat_tps_maf_2_2.err_info_stat.lv_err_mem "storage in dynamic failure memory of the diagnosis instance TPS_MAF_2_2" UWORD _CNV_S_2_RANGE__0___1_CM 1 100. 0. 1. DISPLAY_IDENTIFIER LV_ERR_MEM_TPS_MAF_2_2 ECU_ADDRESS 0xd0009aa2 BIT_MASK 0x8 /end MEASUREMENT
/begin MEASUREMENT fmy_stat_tps_maf_2_2.err_info_stat.lv_ready "readiness status of the diagnosis instance TPS_MAF_2_2" UWORD _CNV_S_2_RANGE__0___1_CM 1 100. 0. 1. DISPLAY_IDENTIFIER LV_READY_TPS_MAF_2_2 ECU_ADDRESS 0xd0009aa2 BIT_MASK 0x10 /end MEASUREMENT
/begin MEASUREMENT fmy_stat_tps_maf_2_2.err_info_stat.lv_end_diag "end of diagnosis of the diagnosis instance TPS_MAF_2_2" UWORD _CNV_S_2_RANGE__0___1_CM 1 100. 0. 1. DISPLAY_IDENTIFIER LV_END_DIAG_TPS_MAF_2_2 ECU_ADDRESS 0xd0009aa2 BIT_MASK 0x20 /end MEASUREMENT
/begin MEASUREMENT fmy_stat_tps_maf_2_2.err_info_stat.lv_cdn_diag "diagnosis condition of the diagnosis instance TPS_MAF_2_2" UWORD _CNV_S_2_RANGE__0___1_CM 1 100. 0. 1. DISPLAY_IDENTIFIER LV_CDN_DIAG_TPS_MAF_2_2 ECU_ADDRESS 0xd0009aa2 BIT_MASK 0x40 /end MEASUREMENT
/begin MEASUREMENT fmy_stat_tps_maf_2_2.err_info_stat.err_sym "symptoms of the diagnosis instance TPS_MAF_2_2" UWORD _CNV_S_16_RANGE_ERR__349_CM 1 100. 0. 15. DISPLAY_IDENTIFIER ERR_SYM_TPS_MAF_2_2 ECU_ADDRESS 0xd0009aa2 BIT_MASK 0x780 /end MEASUREMENT
/begin MEASUREMENT fmy_stat_tps_ratio_1.ctr_abc "anti bounce counter for diagnosis instance TPS_RATIO_1" UBYTE _CNV_A_R_LINEAR_____0_CM 1 100. 0. 255. DISPLAY_IDENTIFIER CTR_ABC_TPS_RATIO_1 ECU_ADDRESS 0xd0009aa4 FORMAT "%3.0" /end MEASUREMENT
/begin MEASUREMENT fmy_stat_tps_ratio_1.ctr_end_diag "counter for end of diagnosis for diagnosis instance TPS_RATIO_1" UBYTE _CNV_A_R_LINEAR_____0_CM 1 100. 0. 255. DISPLAY_IDENTIFIER CTR_ABC_END_DIAG_TPS_RATIO_1 ECU_ADDRESS 0xd0009aa5 FORMAT "%3.0" /end MEASUREMENT
/begin MEASUREMENT fmy_stat_tps_ratio_1.err_info_stat.lv_err_mem "storage in dynamic failure memory of the diagnosis instance TPS_RATIO_1" UWORD _CNV_S_2_RANGE__0___1_CM 1 100. 0. 1. DISPLAY_IDENTIFIER LV_ERR_MEM_TPS_RATIO_1 ECU_ADDRESS 0xd0009aa6 BIT_MASK 0x8 /end MEASUREMENT
/begin MEASUREMENT fmy_stat_tps_ratio_1.err_info_stat.lv_ready "readiness status of the diagnosis instance TPS_RATIO_1" UWORD _CNV_S_2_RANGE__0___1_CM 1 100. 0. 1. DISPLAY_IDENTIFIER LV_READY_TPS_RATIO_1 ECU_ADDRESS 0xd0009aa6 BIT_MASK 0x10 /end MEASUREMENT
/begin MEASUREMENT fmy_stat_tps_ratio_1.err_info_stat.lv_end_diag "end of diagnosis of the diagnosis instance TPS_RATIO_1" UWORD _CNV_S_2_RANGE__0___1_CM 1 100. 0. 1. DISPLAY_IDENTIFIER LV_END_DIAG_TPS_RATIO_1 ECU_ADDRESS 0xd0009aa6 BIT_MASK 0x20 /end MEASUREMENT
/begin MEASUREMENT fmy_stat_tps_ratio_1.err_info_stat.lv_cdn_diag "diagnosis condition of the diagnosis instance TPS_RATIO_1" UWORD _CNV_S_2_RANGE__0___1_CM 1 100. 0. 1. DISPLAY_IDENTIFIER LV_CDN_DIAG_TPS_RATIO_1 ECU_ADDRESS 0xd0009aa6 BIT_MASK 0x40 /end MEASUREMENT
/begin MEASUREMENT fmy_stat_tps_ratio_1.err_info_stat.err_sym "symptoms of the diagnosis instance TPS_RATIO_1" UWORD _CNV_S_16_RANGE_ERR__349_CM 1 100. 0. 15. DISPLAY_IDENTIFIER ERR_SYM_TPS_RATIO_1 ECU_ADDRESS 0xd0009aa6 BIT_MASK 0x780 /end MEASUREMENT
/begin MEASUREMENT fmy_stat_tps_ratio_2.ctr_abc "anti bounce counter for diagnosis instance TPS_RATIO_2" UBYTE _CNV_A_R_LINEAR_____0_CM 1 100. 0. 255. DISPLAY_IDENTIFIER CTR_ABC_TPS_RATIO_2 ECU_ADDRESS 0xd0009aa8 FORMAT "%3.0" /end MEASUREMENT
/begin MEASUREMENT fmy_stat_tps_ratio_2.ctr_end_diag "counter for end of diagnosis for diagnosis instance TPS_RATIO_2" UBYTE _CNV_A_R_LINEAR_____0_CM 1 100. 0. 255. DISPLAY_IDENTIFIER CTR_ABC_END_DIAG_TPS_RATIO_2 ECU_ADDRESS 0xd0009aa9 FORMAT "%3.0" /end MEASUREMENT
/begin MEASUREMENT fmy_stat_tps_ratio_2.err_info_stat.lv_err_mem "storage in dynamic failure memory of the diagnosis instance TPS_RATIO_2" UWORD _CNV_S_2_RANGE__0___1_CM 1 100. 0. 1. DISPLAY_IDENTIFIER LV_ERR_MEM_TPS_RATIO_2 ECU_ADDRESS 0xd0009aaa BIT_MASK 0x8 /end MEASUREMENT
/begin MEASUREMENT fmy_stat_tps_ratio_2.err_info_stat.lv_ready "readiness status of the diagnosis instance TPS_RATIO_2" UWORD _CNV_S_2_RANGE__0___1_CM 1 100. 0. 1. DISPLAY_IDENTIFIER LV_READY_TPS_RATIO_2 ECU_ADDRESS 0xd0009aaa BIT_MASK 0x10 /end MEASUREMENT
/begin MEASUREMENT fmy_stat_tps_ratio_2.err_info_stat.lv_end_diag "end of diagnosis of the diagnosis instance TPS_RATIO_2" UWORD _CNV_S_2_RANGE__0___1_CM 1 100. 0. 1. DISPLAY_IDENTIFIER LV_END_DIAG_TPS_RATIO_2 ECU_ADDRESS 0xd0009aaa BIT_MASK 0x20 /end MEASUREMENT
/begin MEASUREMENT fmy_stat_tps_ratio_2.err_info_stat.lv_cdn_diag "diagnosis condition of the diagnosis instance TPS_RATIO_2" UWORD _CNV_S_2_RANGE__0___1_CM 1 100. 0. 1. DISPLAY_IDENTIFIER LV_CDN_DIAG_TPS_RATIO_2 ECU_ADDRESS 0xd0009aaa BIT_MASK 0x40 /end MEASUREMENT
/begin MEASUREMENT fmy_stat_tps_ratio_2.err_info_stat.err_sym "symptoms of the diagnosis instance TPS_RATIO_2" UWORD _CNV_S_16_RANGE_ERR__349_CM 1 100. 0. 15. DISPLAY_IDENTIFIER ERR_SYM_TPS_RATIO_2 ECU_ADDRESS 0xd0009aaa BIT_MASK 0x780 /end MEASUREMENT
/begin MEASUREMENT fmy_stat_tps_ad_1.ctr_abc "anti bounce counter for diagnosis instance TPS_AD_1" UBYTE _CNV_A_R_LINEAR_____0_CM 1 100. 0. 255. DISPLAY_IDENTIFIER CTR_ABC_TPS_AD_1 ECU_ADDRESS 0xd0009a84 FORMAT "%3.0" /end MEASUREMENT
/begin MEASUREMENT fmy_stat_tps_ad_1.ctr_end_diag "counter for end of diagnosis for diagnosis instance TPS_AD_1" UBYTE _CNV_A_R_LINEAR_____0_CM 1 100. 0. 255. DISPLAY_IDENTIFIER CTR_ABC_END_DIAG_TPS_AD_1 ECU_ADDRESS 0xd0009a85 FORMAT "%3.0" /end MEASUREMENT
/begin MEASUREMENT fmy_stat_tps_ad_1.err_info_stat.lv_err_mem "storage in dynamic failure memory of the diagnosis instance TPS_AD_1" UWORD _CNV_S_2_RANGE__0___1_CM 1 100. 0. 1. DISPLAY_IDENTIFIER LV_ERR_MEM_TPS_AD_1 ECU_ADDRESS 0xd0009a86 BIT_MASK 0x8 /end MEASUREMENT
/begin MEASUREMENT fmy_stat_tps_ad_1.err_info_stat.lv_ready "readiness status of the diagnosis instance TPS_AD_1" UWORD _CNV_S_2_RANGE__0___1_CM 1 100. 0. 1. DISPLAY_IDENTIFIER LV_READY_TPS_AD_1 ECU_ADDRESS 0xd0009a86 BIT_MASK 0x10 /end MEASUREMENT
/begin MEASUREMENT fmy_stat_tps_ad_1.err_info_stat.lv_end_diag "end of diagnosis of the diagnosis instance TPS_AD_1" UWORD _CNV_S_2_RANGE__0___1_CM 1 100. 0. 1. DISPLAY_IDENTIFIER LV_END_DIAG_TPS_AD_1 ECU_ADDRESS 0xd0009a86 BIT_MASK 0x20 /end MEASUREMENT
/begin MEASUREMENT fmy_stat_tps_ad_1.err_info_stat.lv_cdn_diag "diagnosis condition of the diagnosis instance TPS_AD_1" UWORD _CNV_S_2_RANGE__0___1_CM 1 100. 0. 1. DISPLAY_IDENTIFIER LV_CDN_DIAG_TPS_AD_1 ECU_ADDRESS 0xd0009a86 BIT_MASK 0x40 /end MEASUREMENT
/begin MEASUREMENT fmy_stat_tps_ad_1.err_info_stat.err_sym "symptoms of the diagnosis instance TPS_AD_1" UWORD _CNV_S_16_RANGE_ERR__349_CM 1 100. 0. 15. DISPLAY_IDENTIFIER ERR_SYM_TPS_AD_1 ECU_ADDRESS 0xd0009a86 BIT_MASK 0x780 /end MEASUREMENT
/begin MEASUREMENT fmy_stat_tps_ad_2.ctr_abc "anti bounce counter for diagnosis instance TPS_AD_2" UBYTE _CNV_A_R_LINEAR_____0_CM 1 100. 0. 255. DISPLAY_IDENTIFIER CTR_ABC_TPS_AD_2 ECU_ADDRESS 0xd0009a88 FORMAT "%3.0" /end MEASUREMENT
/begin MEASUREMENT fmy_stat_tps_ad_2.ctr_end_diag "counter for end of diagnosis for diagnosis instance TPS_AD_2" UBYTE _CNV_A_R_LINEAR_____0_CM 1 100. 0. 255. DISPLAY_IDENTIFIER CTR_ABC_END_DIAG_TPS_AD_2 ECU_ADDRESS 0xd0009a89 FORMAT "%3.0" /end MEASUREMENT
/begin MEASUREMENT fmy_stat_tps_ad_2.err_info_stat.lv_err_mem "storage in dynamic failure memory of the diagnosis instance TPS_AD_2" UWORD _CNV_S_2_RANGE__0___1_CM 1 100. 0. 1. DISPLAY_IDENTIFIER LV_ERR_MEM_TPS_AD_2 ECU_ADDRESS 0xd0009a8a BIT_MASK 0x8 /end MEASUREMENT
/begin MEASUREMENT fmy_stat_tps_ad_2.err_info_stat.lv_ready "readiness status of the diagnosis instance TPS_AD_2" UWORD _CNV_S_2_RANGE__0___1_CM 1 100. 0. 1. DISPLAY_IDENTIFIER LV_READY_TPS_AD_2 ECU_ADDRESS 0xd0009a8a BIT_MASK 0x10 /end MEASUREMENT
/begin MEASUREMENT fmy_stat_tps_ad_2.err_info_stat.lv_end_diag "end of diagnosis of the diagnosis instance TPS_AD_2" UWORD _CNV_S_2_RANGE__0___1_CM 1 100. 0. 1. DISPLAY_IDENTIFIER LV_END_DIAG_TPS_AD_2 ECU_ADDRESS 0xd0009a8a BIT_MASK 0x20 /end MEASUREMENT
/begin MEASUREMENT fmy_stat_tps_ad_2.err_info_stat.lv_cdn_diag "diagnosis condition of the diagnosis instance TPS_AD_2" UWORD _CNV_S_2_RANGE__0___1_CM 1 100. 0. 1. DISPLAY_IDENTIFIER LV_CDN_DIAG_TPS_AD_2 ECU_ADDRESS 0xd0009a8a BIT_MASK 0x40 /end MEASUREMENT
/begin MEASUREMENT fmy_stat_tps_ad_2.err_info_stat.err_sym "symptoms of the diagnosis instance TPS_AD_2" UWORD _CNV_S_16_RANGE_ERR__349_CM 1 100. 0. 15. DISPLAY_IDENTIFIER ERR_SYM_TPS_AD_2 ECU_ADDRESS 0xd0009a8a BIT_MASK 0x780 /end MEASUREMENT
/begin MEASUREMENT fmy_stat_etc_pwm_1.ctr_abc "anti bounce counter for diagnosis instance ETC_PWM_1" UBYTE _CNV_A_R_LINEAR_____0_CM 1 100. 0. 255. DISPLAY_IDENTIFIER CTR_ABC_ETC_PWM_1 ECU_ADDRESS 0xd0009674 FORMAT "%3.0" /end MEASUREMENT
/begin MEASUREMENT fmy_stat_etc_pwm_1.ctr_end_diag "counter for end of diagnosis for diagnosis instance ETC_PWM_1" UBYTE _CNV_A_R_LINEAR_____0_CM 1 100. 0. 255. DISPLAY_IDENTIFIER CTR_ABC_END_DIAG_ETC_PWM_1 ECU_ADDRESS 0xd0009675 FORMAT "%3.0" /end MEASUREMENT
/begin MEASUREMENT fmy_stat_etc_pwm_1.err_info_stat.lv_err_mem "storage in dynamic failure memory of the diagnosis instance ETC_PWM_1" UWORD _CNV_S_2_RANGE__0___1_CM 1 100. 0. 1. DISPLAY_IDENTIFIER LV_ERR_MEM_ETC_PWM_1 ECU_ADDRESS 0xd0009676 BIT_MASK 0x8 /end MEASUREMENT
/begin MEASUREMENT fmy_stat_etc_pwm_1.err_info_stat.lv_ready "readiness status of the diagnosis instance ETC_PWM_1" UWORD _CNV_S_2_RANGE__0___1_CM 1 100. 0. 1. DISPLAY_IDENTIFIER LV_READY_ETC_PWM_1 ECU_ADDRESS 0xd0009676 BIT_MASK 0x10 /end MEASUREMENT
/begin MEASUREMENT fmy_stat_etc_pwm_1.err_info_stat.lv_end_diag "end of diagnosis of the diagnosis instance ETC_PWM_1" UWORD _CNV_S_2_RANGE__0___1_CM 1 100. 0. 1. DISPLAY_IDENTIFIER LV_END_DIAG_ETC_PWM_1 ECU_ADDRESS 0xd0009676 BIT_MASK 0x20 /end MEASUREMENT
/begin MEASUREMENT fmy_stat_etc_pwm_1.err_info_stat.lv_cdn_diag "diagnosis condition of the diagnosis instance ETC_PWM_1" UWORD _CNV_S_2_RANGE__0___1_CM 1 100. 0. 1. DISPLAY_IDENTIFIER LV_CDN_DIAG_ETC_PWM_1 ECU_ADDRESS 0xd0009676 BIT_MASK 0x40 /end MEASUREMENT
/begin MEASUREMENT fmy_stat_etc_pwm_1.err_info_stat.err_sym "symptoms of the diagnosis instance ETC_PWM_1" UWORD _CNV_S_16_RANGE_ERR__349_CM 1 100. 0. 15. DISPLAY_IDENTIFIER ERR_SYM_ETC_PWM_1 ECU_ADDRESS 0xd0009676 BIT_MASK 0x780 /end MEASUREMENT
/begin MEASUREMENT fmy_stat_etc_pwm_2.ctr_abc "anti bounce counter for diagnosis instance ETC_PWM_2" UBYTE _CNV_A_R_LINEAR_____0_CM 1 100. 0. 255. DISPLAY_IDENTIFIER CTR_ABC_ETC_PWM_2 ECU_ADDRESS 0xd0009678 FORMAT "%3.0" /end MEASUREMENT
/begin MEASUREMENT fmy_stat_etc_pwm_2.ctr_end_diag "counter for end of diagnosis for diagnosis instance ETC_PWM_2" UBYTE _CNV_A_R_LINEAR_____0_CM 1 100. 0. 255. DISPLAY_IDENTIFIER CTR_ABC_END_DIAG_ETC_PWM_2 ECU_ADDRESS 0xd0009679 FORMAT "%3.0" /end MEASUREMENT
/begin MEASUREMENT fmy_stat_etc_pwm_2.err_info_stat.lv_err_mem "storage in dynamic failure memory of the diagnosis instance ETC_PWM_2" UWORD _CNV_S_2_RANGE__0___1_CM 1 100. 0. 1. DISPLAY_IDENTIFIER LV_ERR_MEM_ETC_PWM_2 ECU_ADDRESS 0xd000967a BIT_MASK 0x8 /end MEASUREMENT
/begin MEASUREMENT fmy_stat_etc_pwm_2.err_info_stat.lv_ready "readiness status of the diagnosis instance ETC_PWM_2" UWORD _CNV_S_2_RANGE__0___1_CM 1 100. 0. 1. DISPLAY_IDENTIFIER LV_READY_ETC_PWM_2 ECU_ADDRESS 0xd000967a BIT_MASK 0x10 /end MEASUREMENT
/begin MEASUREMENT fmy_stat_etc_pwm_2.err_info_stat.lv_end_diag "end of diagnosis of the diagnosis instance ETC_PWM_2" UWORD _CNV_S_2_RANGE__0___1_CM 1 100. 0. 1. DISPLAY_IDENTIFIER LV_END_DIAG_ETC_PWM_2 ECU_ADDRESS 0xd000967a BIT_MASK 0x20 /end MEASUREMENT
/begin MEASUREMENT fmy_stat_etc_pwm_2.err_info_stat.lv_cdn_diag "diagnosis condition of the diagnosis instance ETC_PWM_2" UWORD _CNV_S_2_RANGE__0___1_CM 1 100. 0. 1. DISPLAY_IDENTIFIER LV_CDN_DIAG_ETC_PWM_2 ECU_ADDRESS 0xd000967a BIT_MASK 0x40 /end MEASUREMENT
/begin MEASUREMENT fmy_stat_etc_pwm_2.err_info_stat.err_sym "symptoms of the diagnosis instance ETC_PWM_2" UWORD _CNV_S_16_RANGE_ERR__349_CM 1 100. 0. 15. DISPLAY_IDENTIFIER ERR_SYM_ETC_PWM_2 ECU_ADDRESS 0xd000967a BIT_MASK 0x780 /end MEASUREMENT
/begin MEASUREMENT fmy_stat_etc_ctl_1.ctr_abc "anti bounce counter for diagnosis instance ETC_CTL_1" UBYTE _CNV_A_R_LINEAR_____0_CM 1 100. 0. 255. DISPLAY_IDENTIFIER CTR_ABC_ETC_CTL_1 ECU_ADDRESS 0xd0009664 FORMAT "%3.0" /end MEASUREMENT
/begin MEASUREMENT fmy_stat_etc_ctl_1.ctr_end_diag "counter for end of diagnosis for diagnosis instance ETC_CTL_1" UBYTE _CNV_A_R_LINEAR_____0_CM 1 100. 0. 255. DISPLAY_IDENTIFIER CTR_ABC_END_DIAG_ETC_CTL_1 ECU_ADDRESS 0xd0009665 FORMAT "%3.0" /end MEASUREMENT
/begin MEASUREMENT fmy_stat_etc_ctl_1.err_info_stat.lv_err_mem "storage in dynamic failure memory of the diagnosis instance ETC_CTL_1" UWORD _CNV_S_2_RANGE__0___1_CM 1 100. 0. 1. DISPLAY_IDENTIFIER LV_ERR_MEM_ETC_CTL_1 ECU_ADDRESS 0xd0009666 BIT_MASK 0x8 /end MEASUREMENT
/begin MEASUREMENT fmy_stat_etc_ctl_1.err_info_stat.lv_ready "readiness status of the diagnosis instance ETC_CTL_1" UWORD _CNV_S_2_RANGE__0___1_CM 1 100. 0. 1. DISPLAY_IDENTIFIER LV_READY_ETC_CTL_1 ECU_ADDRESS 0xd0009666 BIT_MASK 0x10 /end MEASUREMENT
/begin MEASUREMENT fmy_stat_etc_ctl_1.err_info_stat.lv_end_diag "end of diagnosis of the diagnosis instance ETC_CTL_1" UWORD _CNV_S_2_RANGE__0___1_CM 1 100. 0. 1. DISPLAY_IDENTIFIER LV_END_DIAG_ETC_CTL_1 ECU_ADDRESS 0xd0009666 BIT_MASK 0x20 /end MEASUREMENT
/begin MEASUREMENT fmy_stat_etc_ctl_1.err_info_stat.lv_cdn_diag "diagnosis condition of the diagnosis instance ETC_CTL_1" UWORD _CNV_S_2_RANGE__0___1_CM 1 100. 0. 1. DISPLAY_IDENTIFIER LV_CDN_DIAG_ETC_CTL_1 ECU_ADDRESS 0xd0009666 BIT_MASK 0x40 /end MEASUREMENT
/begin MEASUREMENT fmy_stat_etc_ctl_1.err_info_stat.err_sym "symptoms of the diagnosis instance ETC_CTL_1" UWORD _CNV_S_16_RANGE_ERR__349_CM 1 100. 0. 15. DISPLAY_IDENTIFIER ERR_SYM_ETC_CTL_1 ECU_ADDRESS 0xd0009666 BIT_MASK 0x780 /end MEASUREMENT
/begin MEASUREMENT fmy_stat_etc_ctl_2.ctr_abc "anti bounce counter for diagnosis instance ETC_CTL_2" UBYTE _CNV_A_R_LINEAR_____0_CM 1 100. 0. 255. DISPLAY_IDENTIFIER CTR_ABC_ETC_CTL_2 ECU_ADDRESS 0xd0009668 FORMAT "%3.0" /end MEASUREMENT
/begin MEASUREMENT fmy_stat_etc_ctl_2.ctr_end_diag "counter for end of diagnosis for diagnosis instance ETC_CTL_2" UBYTE _CNV_A_R_LINEAR_____0_CM 1 100. 0. 255. DISPLAY_IDENTIFIER CTR_ABC_END_DIAG_ETC_CTL_2 ECU_ADDRESS 0xd0009669 FORMAT "%3.0" /end MEASUREMENT
/begin MEASUREMENT fmy_stat_etc_ctl_2.err_info_stat.lv_err_mem "storage in dynamic failure memory of the diagnosis instance ETC_CTL_2" UWORD _CNV_S_2_RANGE__0___1_CM 1 100. 0. 1. DISPLAY_IDENTIFIER LV_ERR_MEM_ETC_CTL_2 ECU_ADDRESS 0xd000966a BIT_MASK 0x8 /end MEASUREMENT
/begin MEASUREMENT fmy_stat_etc_ctl_2.err_info_stat.lv_ready "readiness status of the diagnosis instance ETC_CTL_2" UWORD _CNV_S_2_RANGE__0___1_CM 1 100. 0. 1. DISPLAY_IDENTIFIER LV_READY_ETC_CTL_2 ECU_ADDRESS 0xd000966a BIT_MASK 0x10 /end MEASUREMENT
/begin MEASUREMENT fmy_stat_etc_ctl_2.err_info_stat.lv_end_diag "end of diagnosis of the diagnosis instance ETC_CTL_2" UWORD _CNV_S_2_RANGE__0___1_CM 1 100. 0. 1. DISPLAY_IDENTIFIER LV_END_DIAG_ETC_CTL_2 ECU_ADDRESS 0xd000966a BIT_MASK 0x20 /end MEASUREMENT
/begin MEASUREMENT fmy_stat_etc_ctl_2.err_info_stat.lv_cdn_diag "diagnosis condition of the diagnosis instance ETC_CTL_2" UWORD _CNV_S_2_RANGE__0___1_CM 1 100. 0. 1. DISPLAY_IDENTIFIER LV_CDN_DIAG_ETC_CTL_2 ECU_ADDRESS 0xd000966a BIT_MASK 0x40 /end MEASUREMENT
/begin MEASUREMENT fmy_stat_etc_ctl_2.err_info_stat.err_sym "symptoms of the diagnosis instance ETC_CTL_2" UWORD _CNV_S_16_RANGE_ERR__349_CM 1 100. 0. 15. DISPLAY_IDENTIFIER ERR_SYM_ETC_CTL_2 ECU_ADDRESS 0xd000966a BIT_MASK 0x780 /end MEASUREMENT
/begin MEASUREMENT fmy_stat_tps_ad_spr_1.ctr_abc "anti bounce counter for diagnosis instance TPS_AD_SPR_1" UBYTE _CNV_A_R_LINEAR_____0_CM 1 100. 0. 255. DISPLAY_IDENTIFIER CTR_ABC_TPS_AD_SPR_1 ECU_ADDRESS 0xd0009a8c FORMAT "%3.0" /end MEASUREMENT
/begin MEASUREMENT fmy_stat_tps_ad_spr_1.ctr_end_diag "counter for end of diagnosis for diagnosis instance TPS_AD_SPR_1" UBYTE _CNV_A_R_LINEAR_____0_CM 1 100. 0. 255. DISPLAY_IDENTIFIER CTR_ABC_END_DIAG_TPS_AD_SPR_1 ECU_ADDRESS 0xd0009a8d FORMAT "%3.0" /end MEASUREMENT
/begin MEASUREMENT fmy_stat_tps_ad_spr_1.err_info_stat.lv_err_mem "storage in dynamic failure memory of the diagnosis instance TPS_AD_SPR_1" UWORD _CNV_S_2_RANGE__0___1_CM 1 100. 0. 1. DISPLAY_IDENTIFIER LV_ERR_MEM_TPS_AD_SPR_1 ECU_ADDRESS 0xd0009a8e BIT_MASK 0x8 /end MEASUREMENT
/begin MEASUREMENT fmy_stat_tps_ad_spr_1.err_info_stat.lv_ready "readiness status of the diagnosis instance TPS_AD_SPR_1" UWORD _CNV_S_2_RANGE__0___1_CM 1 100. 0. 1. DISPLAY_IDENTIFIER LV_READY_TPS_AD_SPR_1 ECU_ADDRESS 0xd0009a8e BIT_MASK 0x10 /end MEASUREMENT
/begin MEASUREMENT fmy_stat_tps_ad_spr_1.err_info_stat.lv_end_diag "end of diagnosis of the diagnosis instance TPS_AD_SPR_1" UWORD _CNV_S_2_RANGE__0___1_CM 1 100. 0. 1. DISPLAY_IDENTIFIER LV_END_DIAG_TPS_AD_SPR_1 ECU_ADDRESS 0xd0009a8e BIT_MASK 0x20 /end MEASUREMENT
/begin MEASUREMENT fmy_stat_tps_ad_spr_1.err_info_stat.lv_cdn_diag "diagnosis condition of the diagnosis instance TPS_AD_SPR_1" UWORD _CNV_S_2_RANGE__0___1_CM 1 100. 0. 1. DISPLAY_IDENTIFIER LV_CDN_DIAG_TPS_AD_SPR_1 ECU_ADDRESS 0xd0009a8e BIT_MASK 0x40 /end MEASUREMENT
/begin MEASUREMENT fmy_stat_tps_ad_spr_1.err_info_stat.err_sym "symptoms of the diagnosis instance TPS_AD_SPR_1" UWORD _CNV_S_16_RANGE_ERR__349_CM 1 100. 0. 15. DISPLAY_IDENTIFIER ERR_SYM_TPS_AD_SPR_1 ECU_ADDRESS 0xd0009a8e BIT_MASK 0x780 /end MEASUREMENT
/begin MEASUREMENT fmy_stat_tps_ad_spr_2.ctr_abc "anti bounce counter for diagnosis instance TPS_AD_SPR_2" UBYTE _CNV_A_R_LINEAR_____0_CM 1 100. 0. 255. DISPLAY_IDENTIFIER CTR_ABC_TPS_AD_SPR_2 ECU_ADDRESS 0xd0009a90 FORMAT "%3.0" /end MEASUREMENT
/begin MEASUREMENT fmy_stat_tps_ad_spr_2.ctr_end_diag "counter for end of diagnosis for diagnosis instance TPS_AD_SPR_2" UBYTE _CNV_A_R_LINEAR_____0_CM 1 100. 0. 255. DISPLAY_IDENTIFIER CTR_ABC_END_DIAG_TPS_AD_SPR_2 ECU_ADDRESS 0xd0009a91 FORMAT "%3.0" /end MEASUREMENT
/begin MEASUREMENT fmy_stat_tps_ad_spr_2.err_info_stat.lv_err_mem "storage in dynamic failure memory of the diagnosis instance TPS_AD_SPR_2" UWORD _CNV_S_2_RANGE__0___1_CM 1 100. 0. 1. DISPLAY_IDENTIFIER LV_ERR_MEM_TPS_AD_SPR_2 ECU_ADDRESS 0xd0009a92 BIT_MASK 0x8 /end MEASUREMENT
/begin MEASUREMENT fmy_stat_tps_ad_spr_2.err_info_stat.lv_ready "readiness status of the diagnosis instance TPS_AD_SPR_2" UWORD _CNV_S_2_RANGE__0___1_CM 1 100. 0. 1. DISPLAY_IDENTIFIER LV_READY_TPS_AD_SPR_2 ECU_ADDRESS 0xd0009a92 BIT_MASK 0x10 /end MEASUREMENT
/begin MEASUREMENT fmy_stat_tps_ad_spr_2.err_info_stat.lv_end_diag "end of diagnosis of the diagnosis instance TPS_AD_SPR_2" UWORD _CNV_S_2_RANGE__0___1_CM 1 100. 0. 1. DISPLAY_IDENTIFIER LV_END_DIAG_TPS_AD_SPR_2 ECU_ADDRESS 0xd0009a92 BIT_MASK 0x20 /end MEASUREMENT
/begin MEASUREMENT fmy_stat_tps_ad_spr_2.err_info_stat.lv_cdn_diag "diagnosis condition of the diagnosis instance TPS_AD_SPR_2" UWORD _CNV_S_2_RANGE__0___1_CM 1 100. 0. 1. DISPLAY_IDENTIFIER LV_CDN_DIAG_TPS_AD_SPR_2 ECU_ADDRESS 0xd0009a92 BIT_MASK 0x40 /end MEASUREMENT
/begin MEASUREMENT fmy_stat_tps_ad_spr_2.err_info_stat.err_sym "symptoms of the diagnosis instance TPS_AD_SPR_2" UWORD _CNV_S_16_RANGE_ERR__349_CM 1 100. 0. 15. DISPLAY_IDENTIFIER ERR_SYM_TPS_AD_SPR_2 ECU_ADDRESS 0xd0009a92 BIT_MASK 0x780 /end MEASUREMENT
/begin MEASUREMENT fmy_stat_etc_dr_1.ctr_abc "anti bounce counter for diagnosis instance ETC_DR_1" UBYTE _CNV_A_R_LINEAR_____0_CM 1 100. 0. 255. DISPLAY_IDENTIFIER CTR_ABC_ETC_DR_1 ECU_ADDRESS 0xd000966c FORMAT "%3.0" /end MEASUREMENT
/begin MEASUREMENT fmy_stat_etc_dr_1.ctr_end_diag "counter for end of diagnosis for diagnosis instance ETC_DR_1" UBYTE _CNV_A_R_LINEAR_____0_CM 1 100. 0. 255. DISPLAY_IDENTIFIER CTR_ABC_END_DIAG_ETC_DR_1 ECU_ADDRESS 0xd000966d FORMAT "%3.0" /end MEASUREMENT
/begin MEASUREMENT fmy_stat_etc_dr_1.err_info_stat.lv_err_mem "storage in dynamic failure memory of the diagnosis instance ETC_DR_1" UWORD _CNV_S_2_RANGE__0___1_CM 1 100. 0. 1. DISPLAY_IDENTIFIER LV_ERR_MEM_ETC_DR_1 ECU_ADDRESS 0xd000966e BIT_MASK 0x8 /end MEASUREMENT
/begin MEASUREMENT fmy_stat_etc_dr_1.err_info_stat.lv_ready "readiness status of the diagnosis instance ETC_DR_1" UWORD _CNV_S_2_RANGE__0___1_CM 1 100. 0. 1. DISPLAY_IDENTIFIER LV_READY_ETC_DR_1 ECU_ADDRESS 0xd000966e BIT_MASK 0x10 /end MEASUREMENT
/begin MEASUREMENT fmy_stat_etc_dr_1.err_info_stat.lv_end_diag "end of diagnosis of the diagnosis instance ETC_DR_1" UWORD _CNV_S_2_RANGE__0___1_CM 1 100. 0. 1. DISPLAY_IDENTIFIER LV_END_DIAG_ETC_DR_1 ECU_ADDRESS 0xd000966e BIT_MASK 0x20 /end MEASUREMENT
/begin MEASUREMENT fmy_stat_etc_dr_1.err_info_stat.lv_cdn_diag "diagnosis condition of the diagnosis instance ETC_DR_1" UWORD _CNV_S_2_RANGE__0___1_CM 1 100. 0. 1. DISPLAY_IDENTIFIER LV_CDN_DIAG_ETC_DR_1 ECU_ADDRESS 0xd000966e BIT_MASK 0x40 /end MEASUREMENT
/begin MEASUREMENT fmy_stat_etc_dr_1.err_info_stat.err_sym "symptoms of the diagnosis instance ETC_DR_1" UWORD _CNV_S_16_RANGE_ERR__349_CM 1 100. 0. 15. DISPLAY_IDENTIFIER ERR_SYM_ETC_DR_1 ECU_ADDRESS 0xd000966e BIT_MASK 0x780 /end MEASUREMENT
/begin MEASUREMENT fmy_stat_etc_dr_2.ctr_abc "anti bounce counter for diagnosis instance ETC_DR_2" UBYTE _CNV_A_R_LINEAR_____0_CM 1 100. 0. 255. DISPLAY_IDENTIFIER CTR_ABC_ETC_DR_2 ECU_ADDRESS 0xd0009670 FORMAT "%3.0" /end MEASUREMENT
/begin MEASUREMENT fmy_stat_etc_dr_2.ctr_end_diag "counter for end of diagnosis for diagnosis instance ETC_DR_2" UBYTE _CNV_A_R_LINEAR_____0_CM 1 100. 0. 255. DISPLAY_IDENTIFIER CTR_ABC_END_DIAG_ETC_DR_2 ECU_ADDRESS 0xd0009671 FORMAT "%3.0" /end MEASUREMENT
/begin MEASUREMENT fmy_stat_etc_dr_2.err_info_stat.lv_err_mem "storage in dynamic failure memory of the diagnosis instance ETC_DR_2" UWORD _CNV_S_2_RANGE__0___1_CM 1 100. 0. 1. DISPLAY_IDENTIFIER LV_ERR_MEM_ETC_DR_2 ECU_ADDRESS 0xd0009672 BIT_MASK 0x8 /end MEASUREMENT
/begin MEASUREMENT fmy_stat_etc_dr_2.err_info_stat.lv_ready "readiness status of the diagnosis instance ETC_DR_2" UWORD _CNV_S_2_RANGE__0___1_CM 1 100. 0. 1. DISPLAY_IDENTIFIER LV_READY_ETC_DR_2 ECU_ADDRESS 0xd0009672 BIT_MASK 0x10 /end MEASUREMENT
/begin MEASUREMENT fmy_stat_etc_dr_2.err_info_stat.lv_end_diag "end of diagnosis of the diagnosis instance ETC_DR_2" UWORD _CNV_S_2_RANGE__0___1_CM 1 100. 0. 1. DISPLAY_IDENTIFIER LV_END_DIAG_ETC_DR_2 ECU_ADDRESS 0xd0009672 BIT_MASK 0x20 /end MEASUREMENT
/begin MEASUREMENT fmy_stat_etc_dr_2.err_info_stat.lv_cdn_diag "diagnosis condition of the diagnosis instance ETC_DR_2" UWORD _CNV_S_2_RANGE__0___1_CM 1 100. 0. 1. DISPLAY_IDENTIFIER LV_CDN_DIAG_ETC_DR_2 ECU_ADDRESS 0xd0009672 BIT_MASK 0x40 /end MEASUREMENT
/begin MEASUREMENT fmy_stat_etc_dr_2.err_info_stat.err_sym "symptoms of the diagnosis instance ETC_DR_2" UWORD _CNV_S_16_RANGE_ERR__349_CM 1 100. 0. 15. DISPLAY_IDENTIFIER ERR_SYM_ETC_DR_2 ECU_ADDRESS 0xd0009672 BIT_MASK 0x780 /end MEASUREMENT
/begin MEASUREMENT fmy_stat_tps_st_chk_1.ctr_abc "anti bounce counter for diagnosis instance TPS_ST_CHK_1" UBYTE _CNV_A_R_LINEAR_____0_CM 1 100. 0. 255. DISPLAY_IDENTIFIER CTR_ABC_TPS_ST_CHK_1 ECU_ADDRESS 0xd0009aac FORMAT "%3.0" /end MEASUREMENT
/begin MEASUREMENT fmy_stat_tps_st_chk_1.ctr_end_diag "counter for end of diagnosis for diagnosis instance TPS_ST_CHK_1" UBYTE _CNV_A_R_LINEAR_____0_CM 1 100. 0. 255. DISPLAY_IDENTIFIER CTR_ABC_END_DIAG_TPS_ST_CHK_1 ECU_ADDRESS 0xd0009aad FORMAT "%3.0" /end MEASUREMENT
/begin MEASUREMENT fmy_stat_tps_st_chk_1.err_info_stat.lv_err_mem "storage in dynamic failure memory of the diagnosis instance TPS_ST_CHK_1" UWORD _CNV_S_2_RANGE__0___1_CM 1 100. 0. 1. DISPLAY_IDENTIFIER LV_ERR_MEM_TPS_ST_CHK_1 ECU_ADDRESS 0xd0009aae BIT_MASK 0x8 /end MEASUREMENT
/begin MEASUREMENT fmy_stat_tps_st_chk_1.err_info_stat.lv_ready "readiness status of the diagnosis instance TPS_ST_CHK_1" UWORD _CNV_S_2_RANGE__0___1_CM 1 100. 0. 1. DISPLAY_IDENTIFIER LV_READY_TPS_ST_CHK_1 ECU_ADDRESS 0xd0009aae BIT_MASK 0x10 /end MEASUREMENT
/begin MEASUREMENT fmy_stat_tps_st_chk_1.err_info_stat.lv_end_diag "end of diagnosis of the diagnosis instance TPS_ST_CHK_1" UWORD _CNV_S_2_RANGE__0___1_CM 1 100. 0. 1. DISPLAY_IDENTIFIER LV_END_DIAG_TPS_ST_CHK_1 ECU_ADDRESS 0xd0009aae BIT_MASK 0x20 /end MEASUREMENT
/begin MEASUREMENT fmy_stat_tps_st_chk_1.err_info_stat.lv_cdn_diag "diagnosis condition of the diagnosis instance TPS_ST_CHK_1" UWORD _CNV_S_2_RANGE__0___1_CM 1 100. 0. 1. DISPLAY_IDENTIFIER LV_CDN_DIAG_TPS_ST_CHK_1 ECU_ADDRESS 0xd0009aae BIT_MASK 0x40 /end MEASUREMENT
/begin MEASUREMENT fmy_stat_tps_st_chk_1.err_info_stat.err_sym "symptoms of the diagnosis instance TPS_ST_CHK_1" UWORD _CNV_S_16_RANGE_ERR__349_CM 1 100. 0. 15. DISPLAY_IDENTIFIER ERR_SYM_TPS_ST_CHK_1 ECU_ADDRESS 0xd0009aae BIT_MASK 0x780 /end MEASUREMENT
/begin MEASUREMENT fmy_stat_tps_st_chk_2.ctr_abc "anti bounce counter for diagnosis instance TPS_ST_CHK_2" UBYTE _CNV_A_R_LINEAR_____0_CM 1 100. 0. 255. DISPLAY_IDENTIFIER CTR_ABC_TPS_ST_CHK_2 ECU_ADDRESS 0xd0009ab0 FORMAT "%3.0" /end MEASUREMENT
/begin MEASUREMENT fmy_stat_tps_st_chk_2.ctr_end_diag "counter for end of diagnosis for diagnosis instance TPS_ST_CHK_2" UBYTE _CNV_A_R_LINEAR_____0_CM 1 100. 0. 255. DISPLAY_IDENTIFIER CTR_ABC_END_DIAG_TPS_ST_CHK_2 ECU_ADDRESS 0xd0009ab1 FORMAT "%3.0" /end MEASUREMENT
/begin MEASUREMENT fmy_stat_tps_st_chk_2.err_info_stat.lv_err_mem "storage in dynamic failure memory of the diagnosis instance TPS_ST_CHK_2" UWORD _CNV_S_2_RANGE__0___1_CM 1 100. 0. 1. DISPLAY_IDENTIFIER LV_ERR_MEM_TPS_ST_CHK_2 ECU_ADDRESS 0xd0009ab2 BIT_MASK 0x8 /end MEASUREMENT
/begin MEASUREMENT fmy_stat_tps_st_chk_2.err_info_stat.lv_ready "readiness status of the diagnosis instance TPS_ST_CHK_2" UWORD _CNV_S_2_RANGE__0___1_CM 1 100. 0. 1. DISPLAY_IDENTIFIER LV_READY_TPS_ST_CHK_2 ECU_ADDRESS 0xd0009ab2 BIT_MASK 0x10 /end MEASUREMENT
/begin MEASUREMENT fmy_stat_tps_st_chk_2.err_info_stat.lv_end_diag "end of diagnosis of the diagnosis instance TPS_ST_CHK_2" UWORD _CNV_S_2_RANGE__0___1_CM 1 100. 0. 1. DISPLAY_IDENTIFIER LV_END_DIAG_TPS_ST_CHK_2 ECU_ADDRESS 0xd0009ab2 BIT_MASK 0x20 /end MEASUREMENT
/begin MEASUREMENT fmy_stat_tps_st_chk_2.err_info_stat.lv_cdn_diag "diagnosis condition of the diagnosis instance TPS_ST_CHK_2" UWORD _CNV_S_2_RANGE__0___1_CM 1 100. 0. 1. DISPLAY_IDENTIFIER LV_CDN_DIAG_TPS_ST_CHK_2 ECU_ADDRESS 0xd0009ab2 BIT_MASK 0x40 /end MEASUREMENT
/begin MEASUREMENT fmy_stat_tps_st_chk_2.err_info_stat.err_sym "symptoms of the diagnosis instance TPS_ST_CHK_2" UWORD _CNV_S_16_RANGE_ERR__349_CM 1 100. 0. 15. DISPLAY_IDENTIFIER ERR_SYM_TPS_ST_CHK_2 ECU_ADDRESS 0xd0009ab2 BIT_MASK 0x780 /end MEASUREMENT
/begin MEASUREMENT fmy_stat_com_1_tq_loss_cord.ctr_abc "anti bounce counter for diagnosis instance COM_1_TQ_LOSS_CORD" UBYTE _CNV_A_R_LINEAR_____0_CM 1 100. 0. 255. DISPLAY_IDENTIFIER CTR_ABC_COM_1_TQ_LOSS_CORD ECU_ADDRESS 0xd00094d4 FORMAT "%3.0" /end MEASUREMENT
/begin MEASUREMENT fmy_stat_com_1_tq_loss_cord.ctr_end_diag "counter for end of diagnosis for diagnosis instance COM_1_TQ_LOSS_CORD" UBYTE _CNV_A_R_LINEAR_____0_CM 1 100. 0. 255. DISPLAY_IDENTIFIER CTR_ABC_END_DIAG_COM_1_TQ_LOSS_CORD ECU_ADDRESS 0xd00094d5 FORMAT "%3.0" /end MEASUREMENT
/begin MEASUREMENT fmy_stat_com_1_tq_loss_cord.err_info_stat.lv_err_mem "storage in dynamic failure memory of the diagnosis instance COM_1_TQ_LOSS_CORD" UWORD _CNV_S_2_RANGE__0___1_CM 1 100. 0. 1. DISPLAY_IDENTIFIER LV_ERR_MEM_COM_1_TQ_LOSS_CORD ECU_ADDRESS 0xd00094d6 BIT_MASK 0x8 /end MEASUREMENT
/begin MEASUREMENT fmy_stat_com_1_tq_loss_cord.err_info_stat.lv_ready "readiness status of the diagnosis instance COM_1_TQ_LOSS_CORD" UWORD _CNV_S_2_RANGE__0___1_CM 1 100. 0. 1. DISPLAY_IDENTIFIER LV_READY_COM_1_TQ_LOSS_CORD ECU_ADDRESS 0xd00094d6 BIT_MASK 0x10 /end MEASUREMENT
/begin MEASUREMENT fmy_stat_com_1_tq_loss_cord.err_info_stat.lv_end_diag "end of diagnosis of the diagnosis instance COM_1_TQ_LOSS_CORD" UWORD _CNV_S_2_RANGE__0___1_CM 1 100. 0. 1. DISPLAY_IDENTIFIER LV_END_DIAG_COM_1_TQ_LOSS_CORD ECU_ADDRESS 0xd00094d6 BIT_MASK 0x20 /end MEASUREMENT
/begin MEASUREMENT fmy_stat_com_1_tq_loss_cord.err_info_stat.lv_cdn_diag "diagnosis condition of the diagnosis instance COM_1_TQ_LOSS_CORD" UWORD _CNV_S_2_RANGE__0___1_CM 1 100. 0. 1. DISPLAY_IDENTIFIER LV_CDN_DIAG_COM_1_TQ_LOSS_CORD ECU_ADDRESS 0xd00094d6 BIT_MASK 0x40 /end MEASUREMENT
/begin MEASUREMENT fmy_stat_com_1_tq_loss_cord.err_info_stat.err_sym "symptoms of the diagnosis instance COM_1_TQ_LOSS_CORD" UWORD _CNV_S_16_RANGE_ERR__349_CM 1 100. 0. 15. DISPLAY_IDENTIFIER ERR_SYM_COM_1_TQ_LOSS_CORD ECU_ADDRESS 0xd00094d6 BIT_MASK 0x780 /end MEASUREMENT
/begin MEASUREMENT fmy_stat_com_1_swi_gear.ctr_abc "anti bounce counter for diagnosis instance COM_1_SWI_GEAR" UBYTE _CNV_A_R_LINEAR_____0_CM 1 100. 0. 255. DISPLAY_IDENTIFIER CTR_ABC_COM_1_SWI_GEAR ECU_ADDRESS 0xd00094c4 FORMAT "%3.0" /end MEASUREMENT
/begin MEASUREMENT fmy_stat_com_1_swi_gear.ctr_end_diag "counter for end of diagnosis for diagnosis instance COM_1_SWI_GEAR" UBYTE _CNV_A_R_LINEAR_____0_CM 1 100. 0. 255. DISPLAY_IDENTIFIER CTR_ABC_END_DIAG_COM_1_SWI_GEAR ECU_ADDRESS 0xd00094c5 FORMAT "%3.0" /end MEASUREMENT
/begin MEASUREMENT fmy_stat_com_1_swi_gear.err_info_stat.lv_err_mem "storage in dynamic failure memory of the diagnosis instance COM_1_SWI_GEAR" UWORD _CNV_S_2_RANGE__0___1_CM 1 100. 0. 1. DISPLAY_IDENTIFIER LV_ERR_MEM_COM_1_SWI_GEAR ECU_ADDRESS 0xd00094c6 BIT_MASK 0x8 /end MEASUREMENT
/begin MEASUREMENT fmy_stat_com_1_swi_gear.err_info_stat.lv_ready "readiness status of the diagnosis instance COM_1_SWI_GEAR" UWORD _CNV_S_2_RANGE__0___1_CM 1 100. 0. 1. DISPLAY_IDENTIFIER LV_READY_COM_1_SWI_GEAR ECU_ADDRESS 0xd00094c6 BIT_MASK 0x10 /end MEASUREMENT
/begin MEASUREMENT fmy_stat_com_1_swi_gear.err_info_stat.lv_end_diag "end of diagnosis of the diagnosis instance COM_1_SWI_GEAR" UWORD _CNV_S_2_RANGE__0___1_CM 1 100. 0. 1. DISPLAY_IDENTIFIER LV_END_DIAG_COM_1_SWI_GEAR ECU_ADDRESS 0xd00094c6 BIT_MASK 0x20 /end MEASUREMENT
/begin MEASUREMENT fmy_stat_com_1_swi_gear.err_info_stat.lv_cdn_diag "diagnosis condition of the diagnosis instance COM_1_SWI_GEAR" UWORD _CNV_S_2_RANGE__0___1_CM 1 100. 0. 1. DISPLAY_IDENTIFIER LV_CDN_DIAG_COM_1_SWI_GEAR ECU_ADDRESS 0xd00094c6 BIT_MASK 0x40 /end MEASUREMENT
/begin MEASUREMENT fmy_stat_com_1_swi_gear.err_info_stat.err_sym "symptoms of the diagnosis instance COM_1_SWI_GEAR" UWORD _CNV_S_16_RANGE_ERR__349_CM 1 100. 0. 15. DISPLAY_IDENTIFIER ERR_SYM_COM_1_SWI_GEAR ECU_ADDRESS 0xd00094c6 BIT_MASK 0x780 /end MEASUREMENT
/begin MEASUREMENT fmy_stat_com_1_veh_mod.ctr_abc "anti bounce counter for diagnosis instance COM_1_VEH_MOD" UBYTE _CNV_A_R_LINEAR_____0_CM 1 100. 0. 255. DISPLAY_IDENTIFIER CTR_ABC_COM_1_VEH_MOD ECU_ADDRESS 0xd00094e4 FORMAT "%3.0" /end MEASUREMENT
/begin MEASUREMENT fmy_stat_com_1_veh_mod.ctr_end_diag "counter for end of diagnosis for diagnosis instance COM_1_VEH_MOD" UBYTE _CNV_A_R_LINEAR_____0_CM 1 100. 0. 255. DISPLAY_IDENTIFIER CTR_ABC_END_DIAG_COM_1_VEH_MOD ECU_ADDRESS 0xd00094e5 FORMAT "%3.0" /end MEASUREMENT
/begin MEASUREMENT fmy_stat_com_1_veh_mod.err_info_stat.lv_err_mem "storage in dynamic failure memory of the diagnosis instance COM_1_VEH_MOD" UWORD _CNV_S_2_RANGE__0___1_CM 1 100. 0. 1. DISPLAY_IDENTIFIER LV_ERR_MEM_COM_1_VEH_MOD ECU_ADDRESS 0xd00094e6 BIT_MASK 0x8 /end MEASUREMENT
/begin MEASUREMENT fmy_stat_com_1_veh_mod.err_info_stat.lv_ready "readiness status of the diagnosis instance COM_1_VEH_MOD" UWORD _CNV_S_2_RANGE__0___1_CM 1 100. 0. 1. DISPLAY_IDENTIFIER LV_READY_COM_1_VEH_MOD ECU_ADDRESS 0xd00094e6 BIT_MASK 0x10 /end MEASUREMENT
/begin MEASUREMENT fmy_stat_com_1_veh_mod.err_info_stat.lv_end_diag "end of diagnosis of the diagnosis instance COM_1_VEH_MOD" UWORD _CNV_S_2_RANGE__0___1_CM 1 100. 0. 1. DISPLAY_IDENTIFIER LV_END_DIAG_COM_1_VEH_MOD ECU_ADDRESS 0xd00094e6 BIT_MASK 0x20 /end MEASUREMENT
/begin MEASUREMENT fmy_stat_com_1_veh_mod.err_info_stat.lv_cdn_diag "diagnosis condition of the diagnosis instance COM_1_VEH_MOD" UWORD _CNV_S_2_RANGE__0___1_CM 1 100. 0. 1. DISPLAY_IDENTIFIER LV_CDN_DIAG_COM_1_VEH_MOD ECU_ADDRESS 0xd00094e6 BIT_MASK 0x40 /end MEASUREMENT
/begin MEASUREMENT fmy_stat_com_1_veh_mod.err_info_stat.err_sym "symptoms of the diagnosis instance COM_1_VEH_MOD" UWORD _CNV_S_16_RANGE_ERR__349_CM 1 100. 0. 15. DISPLAY_IDENTIFIER ERR_SYM_COM_1_VEH_MOD ECU_ADDRESS 0xd00094e6 BIT_MASK 0x780 /end MEASUREMENT
/begin MEASUREMENT fmy_stat_com_1_brake_tcs.ctr_abc "anti bounce counter for diagnosis instance COM_1_BRAKE_TCS" UBYTE _CNV_A_R_LINEAR_____0_CM 1 100. 0. 255. DISPLAY_IDENTIFIER CTR_ABC_COM_1_BRAKE_TCS ECU_ADDRESS 0xd00094bc FORMAT "%3.0" /end MEASUREMENT
/begin MEASUREMENT fmy_stat_com_1_brake_tcs.ctr_end_diag "counter for end of diagnosis for diagnosis instance COM_1_BRAKE_TCS" UBYTE _CNV_A_R_LINEAR_____0_CM 1 100. 0. 255. DISPLAY_IDENTIFIER CTR_ABC_END_DIAG_COM_1_BRAKE_TCS ECU_ADDRESS 0xd00094bd FORMAT "%3.0" /end MEASUREMENT
/begin MEASUREMENT fmy_stat_com_1_brake_tcs.err_info_stat.lv_err_mem "storage in dynamic failure memory of the diagnosis instance COM_1_BRAKE_TCS" UWORD _CNV_S_2_RANGE__0___1_CM 1 100. 0. 1. DISPLAY_IDENTIFIER LV_ERR_MEM_COM_1_BRAKE_TCS ECU_ADDRESS 0xd00094be BIT_MASK 0x8 /end MEASUREMENT
/begin MEASUREMENT fmy_stat_com_1_brake_tcs.err_info_stat.lv_ready "readiness status of the diagnosis instance COM_1_BRAKE_TCS" UWORD _CNV_S_2_RANGE__0___1_CM 1 100. 0. 1. DISPLAY_IDENTIFIER LV_READY_COM_1_BRAKE_TCS ECU_ADDRESS 0xd00094be BIT_MASK 0x10 /end MEASUREMENT
/begin MEASUREMENT fmy_stat_com_1_brake_tcs.err_info_stat.lv_end_diag "end of diagnosis of the diagnosis instance COM_1_BRAKE_TCS" UWORD _CNV_S_2_RANGE__0___1_CM 1 100. 0. 1. DISPLAY_IDENTIFIER LV_END_DIAG_COM_1_BRAKE_TCS ECU_ADDRESS 0xd00094be BIT_MASK 0x20 /end MEASUREMENT
/begin MEASUREMENT fmy_stat_com_1_brake_tcs.err_info_stat.lv_cdn_diag "diagnosis condition of the diagnosis instance COM_1_BRAKE_TCS" UWORD _CNV_S_2_RANGE__0___1_CM 1 100. 0. 1. DISPLAY_IDENTIFIER LV_CDN_DIAG_COM_1_BRAKE_TCS ECU_ADDRESS 0xd00094be BIT_MASK 0x40 /end MEASUREMENT
/begin MEASUREMENT fmy_stat_com_1_brake_tcs.err_info_stat.err_sym "symptoms of the diagnosis instance COM_1_BRAKE_TCS" UWORD _CNV_S_16_RANGE_ERR__349_CM 1 100. 0. 15. DISPLAY_IDENTIFIER ERR_SYM_COM_1_BRAKE_TCS ECU_ADDRESS 0xd00094be BIT_MASK 0x780 /end MEASUREMENT
/begin MEASUREMENT fmy_stat_com_1_tq_driv_asi.ctr_abc "anti bounce counter for diagnosis instance COM_1_TQ_DRIV_ASI" UBYTE _CNV_A_R_LINEAR_____0_CM 1 100. 0. 255. DISPLAY_IDENTIFIER CTR_ABC_COM_1_TQ_DRIV_ASI ECU_ADDRESS 0xd00094d0 FORMAT "%3.0" /end MEASUREMENT
/begin MEASUREMENT fmy_stat_com_1_tq_driv_asi.ctr_end_diag "counter for end of diagnosis for diagnosis instance COM_1_TQ_DRIV_ASI" UBYTE _CNV_A_R_LINEAR_____0_CM 1 100. 0. 255. DISPLAY_IDENTIFIER CTR_ABC_END_DIAG_COM_1_TQ_DRIV_ASI ECU_ADDRESS 0xd00094d1 FORMAT "%3.0" /end MEASUREMENT
/begin MEASUREMENT fmy_stat_com_1_tq_driv_asi.err_info_stat.lv_err_mem "storage in dynamic failure memory of the diagnosis instance COM_1_TQ_DRIV_ASI" UWORD _CNV_S_2_RANGE__0___1_CM 1 100. 0. 1. DISPLAY_IDENTIFIER LV_ERR_MEM_COM_1_TQ_DRIV_ASI ECU_ADDRESS 0xd00094d2 BIT_MASK 0x8 /end MEASUREMENT
/begin MEASUREMENT fmy_stat_com_1_tq_driv_asi.err_info_stat.lv_ready "readiness status of the diagnosis instance COM_1_TQ_DRIV_ASI" UWORD _CNV_S_2_RANGE__0___1_CM 1 100. 0. 1. DISPLAY_IDENTIFIER LV_READY_COM_1_TQ_DRIV_ASI ECU_ADDRESS 0xd00094d2 BIT_MASK 0x10 /end MEASUREMENT
/begin MEASUREMENT fmy_stat_com_1_tq_driv_asi.err_info_stat.lv_end_diag "end of diagnosis of the diagnosis instance COM_1_TQ_DRIV_ASI" UWORD _CNV_S_2_RANGE__0___1_CM 1 100. 0. 1. DISPLAY_IDENTIFIER LV_END_DIAG_COM_1_TQ_DRIV_ASI ECU_ADDRESS 0xd00094d2 BIT_MASK 0x20 /end MEASUREMENT
/begin MEASUREMENT fmy_stat_com_1_tq_driv_asi.err_info_stat.lv_cdn_diag "diagnosis condition of the diagnosis instance COM_1_TQ_DRIV_ASI" UWORD _CNV_S_2_RANGE__0___1_CM 1 100. 0. 1. DISPLAY_IDENTIFIER LV_CDN_DIAG_COM_1_TQ_DRIV_ASI ECU_ADDRESS 0xd00094d2 BIT_MASK 0x40 /end MEASUREMENT
/begin MEASUREMENT fmy_stat_com_1_tq_driv_asi.err_info_stat.err_sym "symptoms of the diagnosis instance COM_1_TQ_DRIV_ASI" UWORD _CNV_S_16_RANGE_ERR__349_CM 1 100. 0. 15. DISPLAY_IDENTIFIER ERR_SYM_COM_1_TQ_DRIV_ASI ECU_ADDRESS 0xd00094d2 BIT_MASK 0x780 /end MEASUREMENT
/begin MEASUREMENT fmy_stat_com_1_tq_tcs.ctr_abc "anti bounce counter for diagnosis instance COM_1_TQ_TCS" UBYTE _CNV_A_R_LINEAR_____0_CM 1 100. 0. 255. DISPLAY_IDENTIFIER CTR_ABC_COM_1_TQ_TCS ECU_ADDRESS 0xd00094dc FORMAT "%3.0" /end MEASUREMENT
/begin MEASUREMENT fmy_stat_com_1_tq_tcs.ctr_end_diag "counter for end of diagnosis for diagnosis instance COM_1_TQ_TCS" UBYTE _CNV_A_R_LINEAR_____0_CM 1 100. 0. 255. DISPLAY_IDENTIFIER CTR_ABC_END_DIAG_COM_1_TQ_TCS ECU_ADDRESS 0xd00094dd FORMAT "%3.0" /end MEASUREMENT
/begin MEASUREMENT fmy_stat_com_1_tq_tcs.err_info_stat.lv_err_mem "storage in dynamic failure memory of the diagnosis instance COM_1_TQ_TCS" UWORD _CNV_S_2_RANGE__0___1_CM 1 100. 0. 1. DISPLAY_IDENTIFIER LV_ERR_MEM_COM_1_TQ_TCS ECU_ADDRESS 0xd00094de BIT_MASK 0x8 /end MEASUREMENT
/begin MEASUREMENT fmy_stat_com_1_tq_tcs.err_info_stat.lv_ready "readiness status of the diagnosis instance COM_1_TQ_TCS" UWORD _CNV_S_2_RANGE__0___1_CM 1 100. 0. 1. DISPLAY_IDENTIFIER LV_READY_COM_1_TQ_TCS ECU_ADDRESS 0xd00094de BIT_MASK 0x10 /end MEASUREMENT
/begin MEASUREMENT fmy_stat_com_1_tq_tcs.err_info_stat.lv_end_diag "end of diagnosis of the diagnosis instance COM_1_TQ_TCS" UWORD _CNV_S_2_RANGE__0___1_CM 1 100. 0. 1. DISPLAY_IDENTIFIER LV_END_DIAG_COM_1_TQ_TCS ECU_ADDRESS 0xd00094de BIT_MASK 0x20 /end MEASUREMENT
/begin MEASUREMENT fmy_stat_com_1_tq_tcs.err_info_stat.lv_cdn_diag "diagnosis condition of the diagnosis instance COM_1_TQ_TCS" UWORD _CNV_S_2_RANGE__0___1_CM 1 100. 0. 1. DISPLAY_IDENTIFIER LV_CDN_DIAG_COM_1_TQ_TCS ECU_ADDRESS 0xd00094de BIT_MASK 0x40 /end MEASUREMENT
/begin MEASUREMENT fmy_stat_com_1_tq_tcs.err_info_stat.err_sym "symptoms of the diagnosis instance COM_1_TQ_TCS" UWORD _CNV_S_16_RANGE_ERR__349_CM 1 100. 0. 15. DISPLAY_IDENTIFIER ERR_SYM_COM_1_TQ_TCS ECU_ADDRESS 0xd00094de BIT_MASK 0x780 /end MEASUREMENT
/begin MEASUREMENT fmy_stat_com_1_tqb_tcs.ctr_abc "anti bounce counter for diagnosis instance COM_1_TQB_TCS" UBYTE _CNV_A_R_LINEAR_____0_CM 1 100. 0. 255. DISPLAY_IDENTIFIER CTR_ABC_COM_1_TQB_TCS ECU_ADDRESS 0xd00094e0 FORMAT "%3.0" /end MEASUREMENT
/begin MEASUREMENT fmy_stat_com_1_tqb_tcs.ctr_end_diag "counter for end of diagnosis for diagnosis instance COM_1_TQB_TCS" UBYTE _CNV_A_R_LINEAR_____0_CM 1 100. 0. 255. DISPLAY_IDENTIFIER CTR_ABC_END_DIAG_COM_1_TQB_TCS ECU_ADDRESS 0xd00094e1 FORMAT "%3.0" /end MEASUREMENT
/begin MEASUREMENT fmy_stat_com_1_tqb_tcs.err_info_stat.lv_err_mem "storage in dynamic failure memory of the diagnosis instance COM_1_TQB_TCS" UWORD _CNV_S_2_RANGE__0___1_CM 1 100. 0. 1. DISPLAY_IDENTIFIER LV_ERR_MEM_COM_1_TQB_TCS ECU_ADDRESS 0xd00094e2 BIT_MASK 0x8 /end MEASUREMENT
/begin MEASUREMENT fmy_stat_com_1_tqb_tcs.err_info_stat.lv_ready "readiness status of the diagnosis instance COM_1_TQB_TCS" UWORD _CNV_S_2_RANGE__0___1_CM 1 100. 0. 1. DISPLAY_IDENTIFIER LV_READY_COM_1_TQB_TCS ECU_ADDRESS 0xd00094e2 BIT_MASK 0x10 /end MEASUREMENT
/begin MEASUREMENT fmy_stat_com_1_tqb_tcs.err_info_stat.lv_end_diag "end of diagnosis of the diagnosis instance COM_1_TQB_TCS" UWORD _CNV_S_2_RANGE__0___1_CM 1 100. 0. 1. DISPLAY_IDENTIFIER LV_END_DIAG_COM_1_TQB_TCS ECU_ADDRESS 0xd00094e2 BIT_MASK 0x20 /end MEASUREMENT
/begin MEASUREMENT fmy_stat_com_1_tqb_tcs.err_info_stat.lv_cdn_diag "diagnosis condition of the diagnosis instance COM_1_TQB_TCS" UWORD _CNV_S_2_RANGE__0___1_CM 1 100. 0. 1. DISPLAY_IDENTIFIER LV_CDN_DIAG_COM_1_TQB_TCS ECU_ADDRESS 0xd00094e2 BIT_MASK 0x40 /end MEASUREMENT
/begin MEASUREMENT fmy_stat_com_1_tqb_tcs.err_info_stat.err_sym "symptoms of the diagnosis instance COM_1_TQB_TCS" UWORD _CNV_S_16_RANGE_ERR__349_CM 1 100. 0. 15. DISPLAY_IDENTIFIER ERR_SYM_COM_1_TQB_TCS ECU_ADDRESS 0xd00094e2 BIT_MASK 0x780 /end MEASUREMENT
/begin MEASUREMENT fmy_stat_com_1_wheel_tcs.ctr_abc "anti bounce counter for diagnosis instance COM_1_WHEEL_TCS" UBYTE _CNV_A_R_LINEAR_____0_CM 1 100. 0. 255. DISPLAY_IDENTIFIER CTR_ABC_COM_1_WHEEL_TCS ECU_ADDRESS 0xd00094ec FORMAT "%3.0" /end MEASUREMENT
/begin MEASUREMENT fmy_stat_com_1_wheel_tcs.ctr_end_diag "counter for end of diagnosis for diagnosis instance COM_1_WHEEL_TCS" UBYTE _CNV_A_R_LINEAR_____0_CM 1 100. 0. 255. DISPLAY_IDENTIFIER CTR_ABC_END_DIAG_COM_1_WHEEL_TCS ECU_ADDRESS 0xd00094ed FORMAT "%3.0" /end MEASUREMENT
/begin MEASUREMENT fmy_stat_com_1_wheel_tcs.err_info_stat.lv_err_mem "storage in dynamic failure memory of the diagnosis instance COM_1_WHEEL_TCS" UWORD _CNV_S_2_RANGE__0___1_CM 1 100. 0. 1. DISPLAY_IDENTIFIER LV_ERR_MEM_COM_1_WHEEL_TCS ECU_ADDRESS 0xd00094ee BIT_MASK 0x8 /end MEASUREMENT
/begin MEASUREMENT fmy_stat_com_1_wheel_tcs.err_info_stat.lv_ready "readiness status of the diagnosis instance COM_1_WHEEL_TCS" UWORD _CNV_S_2_RANGE__0___1_CM 1 100. 0. 1. DISPLAY_IDENTIFIER LV_READY_COM_1_WHEEL_TCS ECU_ADDRESS 0xd00094ee BIT_MASK 0x10 /end MEASUREMENT
/begin MEASUREMENT fmy_stat_com_1_wheel_tcs.err_info_stat.lv_end_diag "end of diagnosis of the diagnosis instance COM_1_WHEEL_TCS" UWORD _CNV_S_2_RANGE__0___1_CM 1 100. 0. 1. DISPLAY_IDENTIFIER LV_END_DIAG_COM_1_WHEEL_TCS ECU_ADDRESS 0xd00094ee BIT_MASK 0x20 /end MEASUREMENT
/begin MEASUREMENT fmy_stat_com_1_wheel_tcs.err_info_stat.lv_cdn_diag "diagnosis condition of the diagnosis instance COM_1_WHEEL_TCS" UWORD _CNV_S_2_RANGE__0___1_CM 1 100. 0. 1. DISPLAY_IDENTIFIER LV_CDN_DIAG_COM_1_WHEEL_TCS ECU_ADDRESS 0xd00094ee BIT_MASK 0x40 /end MEASUREMENT
/begin MEASUREMENT fmy_stat_com_1_wheel_tcs.err_info_stat.err_sym "symptoms of the diagnosis instance COM_1_WHEEL_TCS" UWORD _CNV_S_16_RANGE_ERR__349_CM 1 100. 0. 15. DISPLAY_IDENTIFIER ERR_SYM_COM_1_WHEEL_TCS ECU_ADDRESS 0xd00094ee BIT_MASK 0x780 /end MEASUREMENT
/begin MEASUREMENT fmy_stat_com_1_req_tqdw.ctr_abc "anti bounce counter for diagnosis instance COM_1_REQ_TQDW" UBYTE _CNV_A_R_LINEAR_____0_CM 1 100. 0. 255. DISPLAY_IDENTIFIER CTR_ABC_COM_1_REQ_TQDW ECU_ADDRESS 0xd00094c0 FORMAT "%3.0" /end MEASUREMENT
/begin MEASUREMENT fmy_stat_com_1_req_tqdw.ctr_end_diag "counter for end of diagnosis for diagnosis instance COM_1_REQ_TQDW" UBYTE _CNV_A_R_LINEAR_____0_CM 1 100. 0. 255. DISPLAY_IDENTIFIER CTR_ABC_END_DIAG_COM_1_REQ_TQDW ECU_ADDRESS 0xd00094c1 FORMAT "%3.0" /end MEASUREMENT
/begin MEASUREMENT fmy_stat_com_1_req_tqdw.err_info_stat.lv_err_mem "storage in dynamic failure memory of the diagnosis instance COM_1_REQ_TQDW" UWORD _CNV_S_2_RANGE__0___1_CM 1 100. 0. 1. DISPLAY_IDENTIFIER LV_ERR_MEM_COM_1_REQ_TQDW ECU_ADDRESS 0xd00094c2 BIT_MASK 0x8 /end MEASUREMENT
/begin MEASUREMENT fmy_stat_com_1_req_tqdw.err_info_stat.lv_ready "readiness status of the diagnosis instance COM_1_REQ_TQDW" UWORD _CNV_S_2_RANGE__0___1_CM 1 100. 0. 1. DISPLAY_IDENTIFIER LV_READY_COM_1_REQ_TQDW ECU_ADDRESS 0xd00094c2 BIT_MASK 0x10 /end MEASUREMENT
/begin MEASUREMENT fmy_stat_com_1_req_tqdw.err_info_stat.lv_end_diag "end of diagnosis of the diagnosis instance COM_1_REQ_TQDW" UWORD _CNV_S_2_RANGE__0___1_CM 1 100. 0. 1. DISPLAY_IDENTIFIER LV_END_DIAG_COM_1_REQ_TQDW ECU_ADDRESS 0xd00094c2 BIT_MASK 0x20 /end MEASUREMENT
/begin MEASUREMENT fmy_stat_com_1_req_tqdw.err_info_stat.lv_cdn_diag "diagnosis condition of the diagnosis instance COM_1_REQ_TQDW" UWORD _CNV_S_2_RANGE__0___1_CM 1 100. 0. 1. DISPLAY_IDENTIFIER LV_CDN_DIAG_COM_1_REQ_TQDW ECU_ADDRESS 0xd00094c2 BIT_MASK 0x40 /end MEASUREMENT
/begin MEASUREMENT fmy_stat_com_1_req_tqdw.err_info_stat.err_sym "symptoms of the diagnosis instance COM_1_REQ_TQDW" UWORD _CNV_S_16_RANGE_ERR__349_CM 1 100. 0. 15. DISPLAY_IDENTIFIER ERR_SYM_COM_1_REQ_TQDW ECU_ADDRESS 0xd00094c2 BIT_MASK 0x780 /end MEASUREMENT
/begin MEASUREMENT fmy_stat_com_1_tq_pste.ctr_abc "anti bounce counter for diagnosis instance COM_1_TQ_PSTE" UBYTE _CNV_A_R_LINEAR_____0_CM 1 100. 0. 255. DISPLAY_IDENTIFIER CTR_ABC_COM_1_TQ_PSTE ECU_ADDRESS 0xd00094d8 FORMAT "%3.0" /end MEASUREMENT
/begin MEASUREMENT fmy_stat_com_1_tq_pste.ctr_end_diag "counter for end of diagnosis for diagnosis instance COM_1_TQ_PSTE" UBYTE _CNV_A_R_LINEAR_____0_CM 1 100. 0. 255. DISPLAY_IDENTIFIER CTR_ABC_END_DIAG_COM_1_TQ_PSTE ECU_ADDRESS 0xd00094d9 FORMAT "%3.0" /end MEASUREMENT
/begin MEASUREMENT fmy_stat_com_1_tq_pste.err_info_stat.lv_err_mem "storage in dynamic failure memory of the diagnosis instance COM_1_TQ_PSTE" UWORD _CNV_S_2_RANGE__0___1_CM 1 100. 0. 1. DISPLAY_IDENTIFIER LV_ERR_MEM_COM_1_TQ_PSTE ECU_ADDRESS 0xd00094da BIT_MASK 0x8 /end MEASUREMENT
/begin MEASUREMENT fmy_stat_com_1_tq_pste.err_info_stat.lv_ready "readiness status of the diagnosis instance COM_1_TQ_PSTE" UWORD _CNV_S_2_RANGE__0___1_CM 1 100. 0. 1. DISPLAY_IDENTIFIER LV_READY_COM_1_TQ_PSTE ECU_ADDRESS 0xd00094da BIT_MASK 0x10 /end MEASUREMENT
/begin MEASUREMENT fmy_stat_com_1_tq_pste.err_info_stat.lv_end_diag "end of diagnosis of the diagnosis instance COM_1_TQ_PSTE" UWORD _CNV_S_2_RANGE__0___1_CM 1 100. 0. 1. DISPLAY_IDENTIFIER LV_END_DIAG_COM_1_TQ_PSTE ECU_ADDRESS 0xd00094da BIT_MASK 0x20 /end MEASUREMENT
/begin MEASUREMENT fmy_stat_com_1_tq_pste.err_info_stat.lv_cdn_diag "diagnosis condition of the diagnosis instance COM_1_TQ_PSTE" UWORD _CNV_S_2_RANGE__0___1_CM 1 100. 0. 1. DISPLAY_IDENTIFIER LV_CDN_DIAG_COM_1_TQ_PSTE ECU_ADDRESS 0xd00094da BIT_MASK 0x40 /end MEASUREMENT
/begin MEASUREMENT fmy_stat_com_1_tq_pste.err_info_stat.err_sym "symptoms of the diagnosis instance COM_1_TQ_PSTE" UWORD _CNV_S_16_RANGE_ERR__349_CM 1 100. 0. 15. DISPLAY_IDENTIFIER ERR_SYM_COM_1_TQ_PSTE ECU_ADDRESS 0xd00094da BIT_MASK 0x780 /end MEASUREMENT
/begin MEASUREMENT fmy_stat_com_1_ang_pste.ctr_abc "anti bounce counter for diagnosis instance COM_1_ANG_PSTE" UBYTE _CNV_A_R_LINEAR_____0_CM 1 100. 0. 255. DISPLAY_IDENTIFIER CTR_ABC_COM_1_ANG_PSTE ECU_ADDRESS 0xd00094b0 FORMAT "%3.0" /end MEASUREMENT
/begin MEASUREMENT fmy_stat_com_1_ang_pste.ctr_end_diag "counter for end of diagnosis for diagnosis instance COM_1_ANG_PSTE" UBYTE _CNV_A_R_LINEAR_____0_CM 1 100. 0. 255. DISPLAY_IDENTIFIER CTR_ABC_END_DIAG_COM_1_ANG_PSTE ECU_ADDRESS 0xd00094b1 FORMAT "%3.0" /end MEASUREMENT
/begin MEASUREMENT fmy_stat_com_1_ang_pste.err_info_stat.lv_err_mem "storage in dynamic failure memory of the diagnosis instance COM_1_ANG_PSTE" UWORD _CNV_S_2_RANGE__0___1_CM 1 100. 0. 1. DISPLAY_IDENTIFIER LV_ERR_MEM_COM_1_ANG_PSTE ECU_ADDRESS 0xd00094b2 BIT_MASK 0x8 /end MEASUREMENT
/begin MEASUREMENT fmy_stat_com_1_ang_pste.err_info_stat.lv_ready "readiness status of the diagnosis instance COM_1_ANG_PSTE" UWORD _CNV_S_2_RANGE__0___1_CM 1 100. 0. 1. DISPLAY_IDENTIFIER LV_READY_COM_1_ANG_PSTE ECU_ADDRESS 0xd00094b2 BIT_MASK 0x10 /end MEASUREMENT
/begin MEASUREMENT fmy_stat_com_1_ang_pste.err_info_stat.lv_end_diag "end of diagnosis of the diagnosis instance COM_1_ANG_PSTE" UWORD _CNV_S_2_RANGE__0___1_CM 1 100. 0. 1. DISPLAY_IDENTIFIER LV_END_DIAG_COM_1_ANG_PSTE ECU_ADDRESS 0xd00094b2 BIT_MASK 0x20 /end MEASUREMENT
/begin MEASUREMENT fmy_stat_com_1_ang_pste.err_info_stat.lv_cdn_diag "diagnosis condition of the diagnosis instance COM_1_ANG_PSTE" UWORD _CNV_S_2_RANGE__0___1_CM 1 100. 0. 1. DISPLAY_IDENTIFIER LV_CDN_DIAG_COM_1_ANG_PSTE ECU_ADDRESS 0xd00094b2 BIT_MASK 0x40 /end MEASUREMENT
/begin MEASUREMENT fmy_stat_com_1_ang_pste.err_info_stat.err_sym "symptoms of the diagnosis instance COM_1_ANG_PSTE" UWORD _CNV_S_16_RANGE_ERR__349_CM 1 100. 0. 15. DISPLAY_IDENTIFIER ERR_SYM_COM_1_ANG_PSTE ECU_ADDRESS 0xd00094b2 BIT_MASK 0x780 /end MEASUREMENT
/begin MEASUREMENT fmy_stat_com_1_ac_trv.ctr_abc "anti bounce counter for diagnosis instance COM_1_AC_TRV" UBYTE _CNV_A_R_LINEAR_____0_CM 1 100. 0. 255. DISPLAY_IDENTIFIER CTR_ABC_COM_1_AC_TRV ECU_ADDRESS 0xd00094ac FORMAT "%3.0" /end MEASUREMENT
/begin MEASUREMENT fmy_stat_com_1_ac_trv.ctr_end_diag "counter for end of diagnosis for diagnosis instance COM_1_AC_TRV" UBYTE _CNV_A_R_LINEAR_____0_CM 1 100. 0. 255. DISPLAY_IDENTIFIER CTR_ABC_END_DIAG_COM_1_AC_TRV ECU_ADDRESS 0xd00094ad FORMAT "%3.0" /end MEASUREMENT
/begin MEASUREMENT fmy_stat_com_1_ac_trv.err_info_stat.lv_err_mem "storage in dynamic failure memory of the diagnosis instance COM_1_AC_TRV" UWORD _CNV_S_2_RANGE__0___1_CM 1 100. 0. 1. DISPLAY_IDENTIFIER LV_ERR_MEM_COM_1_AC_TRV ECU_ADDRESS 0xd00094ae BIT_MASK 0x8 /end MEASUREMENT
/begin MEASUREMENT fmy_stat_com_1_ac_trv.err_info_stat.lv_ready "readiness status of the diagnosis instance COM_1_AC_TRV" UWORD _CNV_S_2_RANGE__0___1_CM 1 100. 0. 1. DISPLAY_IDENTIFIER LV_READY_COM_1_AC_TRV ECU_ADDRESS 0xd00094ae BIT_MASK 0x10 /end MEASUREMENT
/begin MEASUREMENT fmy_stat_com_1_ac_trv.err_info_stat.lv_end_diag "end of diagnosis of the diagnosis instance COM_1_AC_TRV" UWORD _CNV_S_2_RANGE__0___1_CM 1 100. 0. 1. DISPLAY_IDENTIFIER LV_END_DIAG_COM_1_AC_TRV ECU_ADDRESS 0xd00094ae BIT_MASK 0x20 /end MEASUREMENT
/begin MEASUREMENT fmy_stat_com_1_ac_trv.err_info_stat.lv_cdn_diag "diagnosis condition of the diagnosis instance COM_1_AC_TRV" UWORD _CNV_S_2_RANGE__0___1_CM 1 100. 0. 1. DISPLAY_IDENTIFIER LV_CDN_DIAG_COM_1_AC_TRV ECU_ADDRESS 0xd00094ae BIT_MASK 0x40 /end MEASUREMENT
/begin MEASUREMENT fmy_stat_com_1_ac_trv.err_info_stat.err_sym "symptoms of the diagnosis instance COM_1_AC_TRV" UWORD _CNV_S_16_RANGE_ERR__349_CM 1 100. 0. 15. DISPLAY_IDENTIFIER ERR_SYM_COM_1_AC_TRV ECU_ADDRESS 0xd00094ae BIT_MASK 0x780 /end MEASUREMENT
/begin MEASUREMENT fmy_stat_com_1_ac_lgt.ctr_abc "anti bounce counter for diagnosis instance COM_1_AC_LGT" UBYTE _CNV_A_R_LINEAR_____0_CM 1 100. 0. 255. DISPLAY_IDENTIFIER CTR_ABC_COM_1_AC_LGT ECU_ADDRESS 0xd00094a8 FORMAT "%3.0" /end MEASUREMENT
/begin MEASUREMENT fmy_stat_com_1_ac_lgt.ctr_end_diag "counter for end of diagnosis for diagnosis instance COM_1_AC_LGT" UBYTE _CNV_A_R_LINEAR_____0_CM 1 100. 0. 255. DISPLAY_IDENTIFIER CTR_ABC_END_DIAG_COM_1_AC_LGT ECU_ADDRESS 0xd00094a9 FORMAT "%3.0" /end MEASUREMENT
/begin MEASUREMENT fmy_stat_com_1_ac_lgt.err_info_stat.lv_err_mem "storage in dynamic failure memory of the diagnosis instance COM_1_AC_LGT" UWORD _CNV_S_2_RANGE__0___1_CM 1 100. 0. 1. DISPLAY_IDENTIFIER LV_ERR_MEM_COM_1_AC_LGT ECU_ADDRESS 0xd00094aa BIT_MASK 0x8 /end MEASUREMENT
/begin MEASUREMENT fmy_stat_com_1_ac_lgt.err_info_stat.lv_ready "readiness status of the diagnosis instance COM_1_AC_LGT" UWORD _CNV_S_2_RANGE__0___1_CM 1 100. 0. 1. DISPLAY_IDENTIFIER LV_READY_COM_1_AC_LGT ECU_ADDRESS 0xd00094aa BIT_MASK 0x10 /end MEASUREMENT
/begin MEASUREMENT fmy_stat_com_1_ac_lgt.err_info_stat.lv_end_diag "end of diagnosis of the diagnosis instance COM_1_AC_LGT" UWORD _CNV_S_2_RANGE__0___1_CM 1 100. 0. 1. DISPLAY_IDENTIFIER LV_END_DIAG_COM_1_AC_LGT ECU_ADDRESS 0xd00094aa BIT_MASK 0x20 /end MEASUREMENT
/begin MEASUREMENT fmy_stat_com_1_ac_lgt.err_info_stat.lv_cdn_diag "diagnosis condition of the diagnosis instance COM_1_AC_LGT" UWORD _CNV_S_2_RANGE__0___1_CM 1 100. 0. 1. DISPLAY_IDENTIFIER LV_CDN_DIAG_COM_1_AC_LGT ECU_ADDRESS 0xd00094aa BIT_MASK 0x40 /end MEASUREMENT
/begin MEASUREMENT fmy_stat_com_1_ac_lgt.err_info_stat.err_sym "symptoms of the diagnosis instance COM_1_AC_LGT" UWORD _CNV_S_16_RANGE_ERR__349_CM 1 100. 0. 15. DISPLAY_IDENTIFIER ERR_SYM_COM_1_AC_LGT ECU_ADDRESS 0xd00094aa BIT_MASK 0x780 /end MEASUREMENT
/begin MEASUREMENT fmy_stat_com_1_tq_ars.ctr_abc "anti bounce counter for diagnosis instance COM_1_TQ_ARS" UBYTE _CNV_A_R_LINEAR_____0_CM 1 100. 0. 255. DISPLAY_IDENTIFIER CTR_ABC_COM_1_TQ_ARS ECU_ADDRESS 0xd00094cc FORMAT "%3.0" /end MEASUREMENT
/begin MEASUREMENT fmy_stat_com_1_tq_ars.ctr_end_diag "counter for end of diagnosis for diagnosis instance COM_1_TQ_ARS" UBYTE _CNV_A_R_LINEAR_____0_CM 1 100. 0. 255. DISPLAY_IDENTIFIER CTR_ABC_END_DIAG_COM_1_TQ_ARS ECU_ADDRESS 0xd00094cd FORMAT "%3.0" /end MEASUREMENT
/begin MEASUREMENT fmy_stat_com_1_tq_ars.err_info_stat.lv_err_mem "storage in dynamic failure memory of the diagnosis instance COM_1_TQ_ARS" UWORD _CNV_S_2_RANGE__0___1_CM 1 100. 0. 1. DISPLAY_IDENTIFIER LV_ERR_MEM_COM_1_TQ_ARS ECU_ADDRESS 0xd00094ce BIT_MASK 0x8 /end MEASUREMENT
/begin MEASUREMENT fmy_stat_com_1_tq_ars.err_info_stat.lv_ready "readiness status of the diagnosis instance COM_1_TQ_ARS" UWORD _CNV_S_2_RANGE__0___1_CM 1 100. 0. 1. DISPLAY_IDENTIFIER LV_READY_COM_1_TQ_ARS ECU_ADDRESS 0xd00094ce BIT_MASK 0x10 /end MEASUREMENT
/begin MEASUREMENT fmy_stat_com_1_tq_ars.err_info_stat.lv_end_diag "end of diagnosis of the diagnosis instance COM_1_TQ_ARS" UWORD _CNV_S_2_RANGE__0___1_CM 1 100. 0. 1. DISPLAY_IDENTIFIER LV_END_DIAG_COM_1_TQ_ARS ECU_ADDRESS 0xd00094ce BIT_MASK 0x20 /end MEASUREMENT
/begin MEASUREMENT fmy_stat_com_1_tq_ars.err_info_stat.lv_cdn_diag "diagnosis condition of the diagnosis instance COM_1_TQ_ARS" UWORD _CNV_S_2_RANGE__0___1_CM 1 100. 0. 1. DISPLAY_IDENTIFIER LV_CDN_DIAG_COM_1_TQ_ARS ECU_ADDRESS 0xd00094ce BIT_MASK 0x40 /end MEASUREMENT
/begin MEASUREMENT fmy_stat_com_1_tq_ars.err_info_stat.err_sym "symptoms of the diagnosis instance COM_1_TQ_ARS" UWORD _CNV_S_16_RANGE_ERR__349_CM 1 100. 0. 15. DISPLAY_IDENTIFIER ERR_SYM_COM_1_TQ_ARS ECU_ADDRESS 0xd00094ce BIT_MASK 0x780 /end MEASUREMENT
/begin MEASUREMENT fmy_stat_com_1_ars.ctr_abc "anti bounce counter for diagnosis instance COM_1_ARS" UBYTE _CNV_A_R_LINEAR_____0_CM 1 100. 0. 255. DISPLAY_IDENTIFIER CTR_ABC_COM_1_ARS ECU_ADDRESS 0xd00094b4 FORMAT "%3.0" /end MEASUREMENT
/begin MEASUREMENT fmy_stat_com_1_ars.ctr_end_diag "counter for end of diagnosis for diagnosis instance COM_1_ARS" UBYTE _CNV_A_R_LINEAR_____0_CM 1 100. 0. 255. DISPLAY_IDENTIFIER CTR_ABC_END_DIAG_COM_1_ARS ECU_ADDRESS 0xd00094b5 FORMAT "%3.0" /end MEASUREMENT
/begin MEASUREMENT fmy_stat_com_1_ars.err_info_stat.lv_err_mem "storage in dynamic failure memory of the diagnosis instance COM_1_ARS" UWORD _CNV_S_2_RANGE__0___1_CM 1 100. 0. 1. DISPLAY_IDENTIFIER LV_ERR_MEM_COM_1_ARS ECU_ADDRESS 0xd00094b6 BIT_MASK 0x8 /end MEASUREMENT
/begin MEASUREMENT fmy_stat_com_1_ars.err_info_stat.lv_ready "readiness status of the diagnosis instance COM_1_ARS" UWORD _CNV_S_2_RANGE__0___1_CM 1 100. 0. 1. DISPLAY_IDENTIFIER LV_READY_COM_1_ARS ECU_ADDRESS 0xd00094b6 BIT_MASK 0x10 /end MEASUREMENT
/begin MEASUREMENT fmy_stat_com_1_ars.err_info_stat.lv_end_diag "end of diagnosis of the diagnosis instance COM_1_ARS" UWORD _CNV_S_2_RANGE__0___1_CM 1 100. 0. 1. DISPLAY_IDENTIFIER LV_END_DIAG_COM_1_ARS ECU_ADDRESS 0xd00094b6 BIT_MASK 0x20 /end MEASUREMENT
/begin MEASUREMENT fmy_stat_com_1_ars.err_info_stat.lv_cdn_diag "diagnosis condition of the diagnosis instance COM_1_ARS" UWORD _CNV_S_2_RANGE__0___1_CM 1 100. 0. 1. DISPLAY_IDENTIFIER LV_CDN_DIAG_COM_1_ARS ECU_ADDRESS 0xd00094b6 BIT_MASK 0x40 /end MEASUREMENT
/begin MEASUREMENT fmy_stat_com_1_ars.err_info_stat.err_sym "symptoms of the diagnosis instance COM_1_ARS" UWORD _CNV_S_16_RANGE_ERR__349_CM 1 100. 0. 15. DISPLAY_IDENTIFIER ERR_SYM_COM_1_ARS ECU_ADDRESS 0xd00094b6 BIT_MASK 0x780 /end MEASUREMENT
/begin MEASUREMENT fmy_stat_com_1_vs.ctr_abc "anti bounce counter for diagnosis instance COM_1_VS" UBYTE _CNV_A_R_LINEAR_____0_CM 1 100. 0. 255. DISPLAY_IDENTIFIER CTR_ABC_COM_1_VS ECU_ADDRESS 0xd00094e8 FORMAT "%3.0" /end MEASUREMENT
/begin MEASUREMENT fmy_stat_com_1_vs.ctr_end_diag "counter for end of diagnosis for diagnosis instance COM_1_VS" UBYTE _CNV_A_R_LINEAR_____0_CM 1 100. 0. 255. DISPLAY_IDENTIFIER CTR_ABC_END_DIAG_COM_1_VS ECU_ADDRESS 0xd00094e9 FORMAT "%3.0" /end MEASUREMENT
/begin MEASUREMENT fmy_stat_com_1_vs.err_info_stat.lv_err_mem "storage in dynamic failure memory of the diagnosis instance COM_1_VS" UWORD _CNV_S_2_RANGE__0___1_CM 1 100. 0. 1. DISPLAY_IDENTIFIER LV_ERR_MEM_COM_1_VS ECU_ADDRESS 0xd00094ea BIT_MASK 0x8 /end MEASUREMENT
/begin MEASUREMENT fmy_stat_com_1_vs.err_info_stat.lv_ready "readiness status of the diagnosis instance COM_1_VS" UWORD _CNV_S_2_RANGE__0___1_CM 1 100. 0. 1. DISPLAY_IDENTIFIER LV_READY_COM_1_VS ECU_ADDRESS 0xd00094ea BIT_MASK 0x10 /end MEASUREMENT
/begin MEASUREMENT fmy_stat_com_1_vs.err_info_stat.lv_end_diag "end of diagnosis of the diagnosis instance COM_1_VS" UWORD _CNV_S_2_RANGE__0___1_CM 1 100. 0. 1. DISPLAY_IDENTIFIER LV_END_DIAG_COM_1_VS ECU_ADDRESS 0xd00094ea BIT_MASK 0x20 /end MEASUREMENT
/begin MEASUREMENT fmy_stat_com_1_vs.err_info_stat.lv_cdn_diag "diagnosis condition of the diagnosis instance COM_1_VS" UWORD _CNV_S_2_RANGE__0___1_CM 1 100. 0. 1. DISPLAY_IDENTIFIER LV_CDN_DIAG_COM_1_VS ECU_ADDRESS 0xd00094ea BIT_MASK 0x40 /end MEASUREMENT
/begin MEASUREMENT fmy_stat_com_1_vs.err_info_stat.err_sym "symptoms of the diagnosis instance COM_1_VS" UWORD _CNV_S_16_RANGE_ERR__349_CM 1 100. 0. 15. DISPLAY_IDENTIFIER ERR_SYM_COM_1_VS ECU_ADDRESS 0xd00094ea BIT_MASK 0x780 /end MEASUREMENT
/begin MEASUREMENT fmy_stat_com_1_tcs.ctr_abc "anti bounce counter for diagnosis instance COM_1_TCS" UBYTE _CNV_A_R_LINEAR_____0_CM 1 100. 0. 255. DISPLAY_IDENTIFIER CTR_ABC_COM_1_TCS ECU_ADDRESS 0xd00094c8 FORMAT "%3.0" /end MEASUREMENT
/begin MEASUREMENT fmy_stat_com_1_tcs.ctr_end_diag "counter for end of diagnosis for diagnosis instance COM_1_TCS" UBYTE _CNV_A_R_LINEAR_____0_CM 1 100. 0. 255. DISPLAY_IDENTIFIER CTR_ABC_END_DIAG_COM_1_TCS ECU_ADDRESS 0xd00094c9 FORMAT "%3.0" /end MEASUREMENT
/begin MEASUREMENT fmy_stat_com_1_tcs.err_info_stat.lv_err_mem "storage in dynamic failure memory of the diagnosis instance COM_1_TCS" UWORD _CNV_S_2_RANGE__0___1_CM 1 100. 0. 1. DISPLAY_IDENTIFIER LV_ERR_MEM_COM_1_TCS ECU_ADDRESS 0xd00094ca BIT_MASK 0x8 /end MEASUREMENT
/begin MEASUREMENT fmy_stat_com_1_tcs.err_info_stat.lv_ready "readiness status of the diagnosis instance COM_1_TCS" UWORD _CNV_S_2_RANGE__0___1_CM 1 100. 0. 1. DISPLAY_IDENTIFIER LV_READY_COM_1_TCS ECU_ADDRESS 0xd00094ca BIT_MASK 0x10 /end MEASUREMENT
/begin MEASUREMENT fmy_stat_com_1_tcs.err_info_stat.lv_end_diag "end of diagnosis of the diagnosis instance COM_1_TCS" UWORD _CNV_S_2_RANGE__0___1_CM 1 100. 0. 1. DISPLAY_IDENTIFIER LV_END_DIAG_COM_1_TCS ECU_ADDRESS 0xd00094ca BIT_MASK 0x20 /end MEASUREMENT
/begin MEASUREMENT fmy_stat_com_1_tcs.err_info_stat.lv_cdn_diag "diagnosis condition of the diagnosis instance COM_1_TCS" UWORD _CNV_S_2_RANGE__0___1_CM 1 100. 0. 1. DISPLAY_IDENTIFIER LV_CDN_DIAG_COM_1_TCS ECU_ADDRESS 0xd00094ca BIT_MASK 0x40 /end MEASUREMENT
/begin MEASUREMENT fmy_stat_com_1_tcs.err_info_stat.err_sym "symptoms of the diagnosis instance COM_1_TCS" UWORD _CNV_S_16_RANGE_ERR__349_CM 1 100. 0. 15. DISPLAY_IDENTIFIER ERR_SYM_COM_1_TCS ECU_ADDRESS 0xd00094ca BIT_MASK 0x780 /end MEASUREMENT
/begin MEASUREMENT fmy_stat_com_1_boff.ctr_abc "anti bounce counter for diagnosis instance COM_1_BOFF" UBYTE _CNV_A_R_LINEAR_____0_CM 1 100. 0. 255. DISPLAY_IDENTIFIER CTR_ABC_COM_1_BOFF ECU_ADDRESS 0xd00094b8 FORMAT "%3.0" /end MEASUREMENT
/begin MEASUREMENT fmy_stat_com_1_boff.ctr_end_diag "counter for end of diagnosis for diagnosis instance COM_1_BOFF" UBYTE _CNV_A_R_LINEAR_____0_CM 1 100. 0. 255. DISPLAY_IDENTIFIER CTR_ABC_END_DIAG_COM_1_BOFF ECU_ADDRESS 0xd00094b9 FORMAT "%3.0" /end MEASUREMENT
/begin MEASUREMENT fmy_stat_com_1_boff.err_info_stat.lv_err_mem "storage in dynamic failure memory of the diagnosis instance COM_1_BOFF" UWORD _CNV_S_2_RANGE__0___1_CM 1 100. 0. 1. DISPLAY_IDENTIFIER LV_ERR_MEM_COM_1_BOFF ECU_ADDRESS 0xd00094ba BIT_MASK 0x8 /end MEASUREMENT
/begin MEASUREMENT fmy_stat_com_1_boff.err_info_stat.lv_ready "readiness status of the diagnosis instance COM_1_BOFF" UWORD _CNV_S_2_RANGE__0___1_CM 1 100. 0. 1. DISPLAY_IDENTIFIER LV_READY_COM_1_BOFF ECU_ADDRESS 0xd00094ba BIT_MASK 0x10 /end MEASUREMENT
/begin MEASUREMENT fmy_stat_com_1_boff.err_info_stat.lv_end_diag "end of diagnosis of the diagnosis instance COM_1_BOFF" UWORD _CNV_S_2_RANGE__0___1_CM 1 100. 0. 1. DISPLAY_IDENTIFIER LV_END_DIAG_COM_1_BOFF ECU_ADDRESS 0xd00094ba BIT_MASK 0x20 /end MEASUREMENT
/begin MEASUREMENT fmy_stat_com_1_boff.err_info_stat.lv_cdn_diag "diagnosis condition of the diagnosis instance COM_1_BOFF" UWORD _CNV_S_2_RANGE__0___1_CM 1 100. 0. 1. DISPLAY_IDENTIFIER LV_CDN_DIAG_COM_1_BOFF ECU_ADDRESS 0xd00094ba BIT_MASK 0x40 /end MEASUREMENT
/begin MEASUREMENT fmy_stat_com_1_boff.err_info_stat.err_sym "symptoms of the diagnosis instance COM_1_BOFF" UWORD _CNV_S_16_RANGE_ERR__349_CM 1 100. 0. 15. DISPLAY_IDENTIFIER ERR_SYM_COM_1_BOFF ECU_ADDRESS 0xd00094ba BIT_MASK 0x780 /end MEASUREMENT
/begin MEASUREMENT fmy_stat_com_2_efp_crash.ctr_abc "anti bounce counter for diagnosis instance COM_2_EFP_CRASH" UBYTE _CNV_A_R_LINEAR_____0_CM 1 100. 0. 255. DISPLAY_IDENTIFIER CTR_ABC_COM_2_EFP_CRASH ECU_ADDRESS 0xd0009508 FORMAT "%3.0" /end MEASUREMENT
/begin MEASUREMENT fmy_stat_com_2_efp_crash.ctr_end_diag "counter for end of diagnosis for diagnosis instance COM_2_EFP_CRASH" UBYTE _CNV_A_R_LINEAR_____0_CM 1 100. 0. 255. DISPLAY_IDENTIFIER CTR_ABC_END_DIAG_COM_2_EFP_CRASH ECU_ADDRESS 0xd0009509 FORMAT "%3.0" /end MEASUREMENT
/begin MEASUREMENT fmy_stat_com_2_efp_crash.err_info_stat.lv_err_mem "storage in dynamic failure memory of the diagnosis instance COM_2_EFP_CRASH" UWORD _CNV_S_2_RANGE__0___1_CM 1 100. 0. 1. DISPLAY_IDENTIFIER LV_ERR_MEM_COM_2_EFP_CRASH ECU_ADDRESS 0xd000950a BIT_MASK 0x8 /end MEASUREMENT
/begin MEASUREMENT fmy_stat_com_2_efp_crash.err_info_stat.lv_ready "readiness status of the diagnosis instance COM_2_EFP_CRASH" UWORD _CNV_S_2_RANGE__0___1_CM 1 100. 0. 1. DISPLAY_IDENTIFIER LV_READY_COM_2_EFP_CRASH ECU_ADDRESS 0xd000950a BIT_MASK 0x10 /end MEASUREMENT
/begin MEASUREMENT fmy_stat_com_2_efp_crash.err_info_stat.lv_end_diag "end of diagnosis of the diagnosis instance COM_2_EFP_CRASH" UWORD _CNV_S_2_RANGE__0___1_CM 1 100. 0. 1. DISPLAY_IDENTIFIER LV_END_DIAG_COM_2_EFP_CRASH ECU_ADDRESS 0xd000950a BIT_MASK 0x20 /end MEASUREMENT
/begin MEASUREMENT fmy_stat_com_2_efp_crash.err_info_stat.lv_cdn_diag "diagnosis condition of the diagnosis instance COM_2_EFP_CRASH" UWORD _CNV_S_2_RANGE__0___1_CM 1 100. 0. 1. DISPLAY_IDENTIFIER LV_CDN_DIAG_COM_2_EFP_CRASH ECU_ADDRESS 0xd000950a BIT_MASK 0x40 /end MEASUREMENT
/begin MEASUREMENT fmy_stat_com_2_efp_crash.err_info_stat.err_sym "symptoms of the diagnosis instance COM_2_EFP_CRASH" UWORD _CNV_S_16_RANGE_ERR__349_CM 1 100. 0. 15. DISPLAY_IDENTIFIER ERR_SYM_COM_2_EFP_CRASH ECU_ADDRESS 0xd000950a BIT_MASK 0x780 /end MEASUREMENT
/begin MEASUREMENT fmy_stat_com_2_gb.ctr_abc "anti bounce counter for diagnosis instance COM_2_GB" UBYTE _CNV_A_R_LINEAR_____0_CM 1 100. 0. 255. DISPLAY_IDENTIFIER CTR_ABC_COM_2_GB ECU_ADDRESS 0xd0009514 FORMAT "%3.0" /end MEASUREMENT
/begin MEASUREMENT fmy_stat_com_2_gb.ctr_end_diag "counter for end of diagnosis for diagnosis instance COM_2_GB" UBYTE _CNV_A_R_LINEAR_____0_CM 1 100. 0. 255. DISPLAY_IDENTIFIER CTR_ABC_END_DIAG_COM_2_GB ECU_ADDRESS 0xd0009515 FORMAT "%3.0" /end MEASUREMENT
/begin MEASUREMENT fmy_stat_com_2_gb.err_info_stat.lv_err_mem "storage in dynamic failure memory of the diagnosis instance COM_2_GB" UWORD _CNV_S_2_RANGE__0___1_CM 1 100. 0. 1. DISPLAY_IDENTIFIER LV_ERR_MEM_COM_2_GB ECU_ADDRESS 0xd0009516 BIT_MASK 0x8 /end MEASUREMENT
/begin MEASUREMENT fmy_stat_com_2_gb.err_info_stat.lv_ready "readiness status of the diagnosis instance COM_2_GB" UWORD _CNV_S_2_RANGE__0___1_CM 1 100. 0. 1. DISPLAY_IDENTIFIER LV_READY_COM_2_GB ECU_ADDRESS 0xd0009516 BIT_MASK 0x10 /end MEASUREMENT
/begin MEASUREMENT fmy_stat_com_2_gb.err_info_stat.lv_end_diag "end of diagnosis of the diagnosis instance COM_2_GB" UWORD _CNV_S_2_RANGE__0___1_CM 1 100. 0. 1. DISPLAY_IDENTIFIER LV_END_DIAG_COM_2_GB ECU_ADDRESS 0xd0009516 BIT_MASK 0x20 /end MEASUREMENT
/begin MEASUREMENT fmy_stat_com_2_gb.err_info_stat.lv_cdn_diag "diagnosis condition of the diagnosis instance COM_2_GB" UWORD _CNV_S_2_RANGE__0___1_CM 1 100. 0. 1. DISPLAY_IDENTIFIER LV_CDN_DIAG_COM_2_GB ECU_ADDRESS 0xd0009516 BIT_MASK 0x40 /end MEASUREMENT
/begin MEASUREMENT fmy_stat_com_2_gb.err_info_stat.err_sym "symptoms of the diagnosis instance COM_2_GB" UWORD _CNV_S_16_RANGE_ERR__349_CM 1 100. 0. 15. DISPLAY_IDENTIFIER ERR_SYM_COM_2_GB ECU_ADDRESS 0xd0009516 BIT_MASK 0x780 /end MEASUREMENT
/begin MEASUREMENT fmy_stat_com_2_etcu.ctr_abc "anti bounce counter for diagnosis instance COM_2_ETCU" UBYTE _CNV_A_R_LINEAR_____0_CM 1 100. 0. 255. DISPLAY_IDENTIFIER CTR_ABC_COM_2_ETCU ECU_ADDRESS 0xd000950c FORMAT "%3.0" /end MEASUREMENT
/begin MEASUREMENT fmy_stat_com_2_etcu.ctr_end_diag "counter for end of diagnosis for diagnosis instance COM_2_ETCU" UBYTE _CNV_A_R_LINEAR_____0_CM 1 100. 0. 255. DISPLAY_IDENTIFIER CTR_ABC_END_DIAG_COM_2_ETCU ECU_ADDRESS 0xd000950d FORMAT "%3.0" /end MEASUREMENT
/begin MEASUREMENT fmy_stat_com_2_etcu.err_info_stat.lv_err_mem "storage in dynamic failure memory of the diagnosis instance COM_2_ETCU" UWORD _CNV_S_2_RANGE__0___1_CM 1 100. 0. 1. DISPLAY_IDENTIFIER LV_ERR_MEM_COM_2_ETCU ECU_ADDRESS 0xd000950e BIT_MASK 0x8 /end MEASUREMENT
/begin MEASUREMENT fmy_stat_com_2_etcu.err_info_stat.lv_ready "readiness status of the diagnosis instance COM_2_ETCU" UWORD _CNV_S_2_RANGE__0___1_CM 1 100. 0. 1. DISPLAY_IDENTIFIER LV_READY_COM_2_ETCU ECU_ADDRESS 0xd000950e BIT_MASK 0x10 /end MEASUREMENT
/begin MEASUREMENT fmy_stat_com_2_etcu.err_info_stat.lv_end_diag "end of diagnosis of the diagnosis instance COM_2_ETCU" UWORD _CNV_S_2_RANGE__0___1_CM 1 100. 0. 1. DISPLAY_IDENTIFIER LV_END_DIAG_COM_2_ETCU ECU_ADDRESS 0xd000950e BIT_MASK 0x20 /end MEASUREMENT
/begin MEASUREMENT fmy_stat_com_2_etcu.err_info_stat.lv_cdn_diag "diagnosis condition of the diagnosis instance COM_2_ETCU" UWORD _CNV_S_2_RANGE__0___1_CM 1 100. 0. 1. DISPLAY_IDENTIFIER LV_CDN_DIAG_COM_2_ETCU ECU_ADDRESS 0xd000950e BIT_MASK 0x40 /end MEASUREMENT
/begin MEASUREMENT fmy_stat_com_2_etcu.err_info_stat.err_sym "symptoms of the diagnosis instance COM_2_ETCU" UWORD _CNV_S_16_RANGE_ERR__349_CM 1 100. 0. 15. DISPLAY_IDENTIFIER ERR_SYM_COM_2_ETCU ECU_ADDRESS 0xd000950e BIT_MASK 0x780 /end MEASUREMENT
/begin MEASUREMENT fmy_stat_com_2_tq_etcu.ctr_abc "anti bounce counter for diagnosis instance COM_2_TQ_ETCU" UBYTE _CNV_A_R_LINEAR_____0_CM 1 100. 0. 255. DISPLAY_IDENTIFIER CTR_ABC_COM_2_TQ_ETCU ECU_ADDRESS 0xd0009540 FORMAT "%3.0" /end MEASUREMENT
/begin MEASUREMENT fmy_stat_com_2_tq_etcu.ctr_end_diag "counter for end of diagnosis for diagnosis instance COM_2_TQ_ETCU" UBYTE _CNV_A_R_LINEAR_____0_CM 1 100. 0. 255. DISPLAY_IDENTIFIER CTR_ABC_END_DIAG_COM_2_TQ_ETCU ECU_ADDRESS 0xd0009541 FORMAT "%3.0" /end MEASUREMENT
/begin MEASUREMENT fmy_stat_com_2_tq_etcu.err_info_stat.lv_err_mem "storage in dynamic failure memory of the diagnosis instance COM_2_TQ_ETCU" UWORD _CNV_S_2_RANGE__0___1_CM 1 100. 0. 1. DISPLAY_IDENTIFIER LV_ERR_MEM_COM_2_TQ_ETCU ECU_ADDRESS 0xd0009542 BIT_MASK 0x8 /end MEASUREMENT
/begin MEASUREMENT fmy_stat_com_2_tq_etcu.err_info_stat.lv_ready "readiness status of the diagnosis instance COM_2_TQ_ETCU" UWORD _CNV_S_2_RANGE__0___1_CM 1 100. 0. 1. DISPLAY_IDENTIFIER LV_READY_COM_2_TQ_ETCU ECU_ADDRESS 0xd0009542 BIT_MASK 0x10 /end MEASUREMENT
/begin MEASUREMENT fmy_stat_com_2_tq_etcu.err_info_stat.lv_end_diag "end of diagnosis of the diagnosis instance COM_2_TQ_ETCU" UWORD _CNV_S_2_RANGE__0___1_CM 1 100. 0. 1. DISPLAY_IDENTIFIER LV_END_DIAG_COM_2_TQ_ETCU ECU_ADDRESS 0xd0009542 BIT_MASK 0x20 /end MEASUREMENT
/begin MEASUREMENT fmy_stat_com_2_tq_etcu.err_info_stat.lv_cdn_diag "diagnosis condition of the diagnosis instance COM_2_TQ_ETCU" UWORD _CNV_S_2_RANGE__0___1_CM 1 100. 0. 1. DISPLAY_IDENTIFIER LV_CDN_DIAG_COM_2_TQ_ETCU ECU_ADDRESS 0xd0009542 BIT_MASK 0x40 /end MEASUREMENT
/begin MEASUREMENT fmy_stat_com_2_tq_etcu.err_info_stat.err_sym "symptoms of the diagnosis instance COM_2_TQ_ETCU" UWORD _CNV_S_16_RANGE_ERR__349_CM 1 100. 0. 15. DISPLAY_IDENTIFIER ERR_SYM_COM_2_TQ_ETCU ECU_ADDRESS 0xd0009542 BIT_MASK 0x780 /end MEASUREMENT
/begin MEASUREMENT fmy_stat_com_2_state_veh.ctr_abc "anti bounce counter for diagnosis instance COM_2_STATE_VEH" UBYTE _CNV_A_R_LINEAR_____0_CM 1 100. 0. 255. DISPLAY_IDENTIFIER CTR_ABC_COM_2_STATE_VEH ECU_ADDRESS 0xd000952c FORMAT "%3.0" /end MEASUREMENT
/begin MEASUREMENT fmy_stat_com_2_state_veh.ctr_end_diag "counter for end of diagnosis for diagnosis instance COM_2_STATE_VEH" UBYTE _CNV_A_R_LINEAR_____0_CM 1 100. 0. 255. DISPLAY_IDENTIFIER CTR_ABC_END_DIAG_COM_2_STATE_VEH ECU_ADDRESS 0xd000952d FORMAT "%3.0" /end MEASUREMENT
/begin MEASUREMENT fmy_stat_com_2_state_veh.err_info_stat.lv_err_mem "storage in dynamic failure memory of the diagnosis instance COM_2_STATE_VEH" UWORD _CNV_S_2_RANGE__0___1_CM 1 100. 0. 1. DISPLAY_IDENTIFIER LV_ERR_MEM_COM_2_STATE_VEH ECU_ADDRESS 0xd000952e BIT_MASK 0x8 /end MEASUREMENT
/begin MEASUREMENT fmy_stat_com_2_state_veh.err_info_stat.lv_ready "readiness status of the diagnosis instance COM_2_STATE_VEH" UWORD _CNV_S_2_RANGE__0___1_CM 1 100. 0. 1. DISPLAY_IDENTIFIER LV_READY_COM_2_STATE_VEH ECU_ADDRESS 0xd000952e BIT_MASK 0x10 /end MEASUREMENT
/begin MEASUREMENT fmy_stat_com_2_state_veh.err_info_stat.lv_end_diag "end of diagnosis of the diagnosis instance COM_2_STATE_VEH" UWORD _CNV_S_2_RANGE__0___1_CM 1 100. 0. 1. DISPLAY_IDENTIFIER LV_END_DIAG_COM_2_STATE_VEH ECU_ADDRESS 0xd000952e BIT_MASK 0x20 /end MEASUREMENT
/begin MEASUREMENT fmy_stat_com_2_state_veh.err_info_stat.lv_cdn_diag "diagnosis condition of the diagnosis instance COM_2_STATE_VEH" UWORD _CNV_S_2_RANGE__0___1_CM 1 100. 0. 1. DISPLAY_IDENTIFIER LV_CDN_DIAG_COM_2_STATE_VEH ECU_ADDRESS 0xd000952e BIT_MASK 0x40 /end MEASUREMENT
/begin MEASUREMENT fmy_stat_com_2_state_veh.err_info_stat.err_sym "symptoms of the diagnosis instance COM_2_STATE_VEH" UWORD _CNV_S_16_RANGE_ERR__349_CM 1 100. 0. 15. DISPLAY_IDENTIFIER ERR_SYM_COM_2_STATE_VEH ECU_ADDRESS 0xd000952e BIT_MASK 0x780 /end MEASUREMENT
/begin MEASUREMENT fmy_stat_com_2_cas_2.ctr_abc "anti bounce counter for diagnosis instance COM_2_CAS_2" UBYTE _CNV_A_R_LINEAR_____0_CM 1 100. 0. 255. DISPLAY_IDENTIFIER CTR_ABC_COM_2_CAS_2 ECU_ADDRESS 0xd0009500 FORMAT "%3.0" /end MEASUREMENT
/begin MEASUREMENT fmy_stat_com_2_cas_2.ctr_end_diag "counter for end of diagnosis for diagnosis instance COM_2_CAS_2" UBYTE _CNV_A_R_LINEAR_____0_CM 1 100. 0. 255. DISPLAY_IDENTIFIER CTR_ABC_END_DIAG_COM_2_CAS_2 ECU_ADDRESS 0xd0009501 FORMAT "%3.0" /end MEASUREMENT
/begin MEASUREMENT fmy_stat_com_2_cas_2.err_info_stat.lv_err_mem "storage in dynamic failure memory of the diagnosis instance COM_2_CAS_2" UWORD _CNV_S_2_RANGE__0___1_CM 1 100. 0. 1. DISPLAY_IDENTIFIER LV_ERR_MEM_COM_2_CAS_2 ECU_ADDRESS 0xd0009502 BIT_MASK 0x8 /end MEASUREMENT
/begin MEASUREMENT fmy_stat_com_2_cas_2.err_info_stat.lv_ready "readiness status of the diagnosis instance COM_2_CAS_2" UWORD _CNV_S_2_RANGE__0___1_CM 1 100. 0. 1. DISPLAY_IDENTIFIER LV_READY_COM_2_CAS_2 ECU_ADDRESS 0xd0009502 BIT_MASK 0x10 /end MEASUREMENT
/begin MEASUREMENT fmy_stat_com_2_cas_2.err_info_stat.lv_end_diag "end of diagnosis of the diagnosis instance COM_2_CAS_2" UWORD _CNV_S_2_RANGE__0___1_CM 1 100. 0. 1. DISPLAY_IDENTIFIER LV_END_DIAG_COM_2_CAS_2 ECU_ADDRESS 0xd0009502 BIT_MASK 0x20 /end MEASUREMENT
/begin MEASUREMENT fmy_stat_com_2_cas_2.err_info_stat.lv_cdn_diag "diagnosis condition of the diagnosis instance COM_2_CAS_2" UWORD _CNV_S_2_RANGE__0___1_CM 1 100. 0. 1. DISPLAY_IDENTIFIER LV_CDN_DIAG_COM_2_CAS_2 ECU_ADDRESS 0xd0009502 BIT_MASK 0x40 /end MEASUREMENT
/begin MEASUREMENT fmy_stat_com_2_cas_2.err_info_stat.err_sym "symptoms of the diagnosis instance COM_2_CAS_2" UWORD _CNV_S_16_RANGE_ERR__349_CM 1 100. 0. 15. DISPLAY_IDENTIFIER ERR_SYM_COM_2_CAS_2 ECU_ADDRESS 0xd0009502 BIT_MASK 0x780 /end MEASUREMENT
/begin MEASUREMENT fmy_stat_com_2_acc.ctr_abc "anti bounce counter for diagnosis instance COM_2_ACC" UBYTE _CNV_A_R_LINEAR_____0_CM 1 100. 0. 255. DISPLAY_IDENTIFIER CTR_ABC_COM_2_ACC ECU_ADDRESS 0xd00094f4 FORMAT "%3.0" /end MEASUREMENT
/begin MEASUREMENT fmy_stat_com_2_acc.ctr_end_diag "counter for end of diagnosis for diagnosis instance COM_2_ACC" UBYTE _CNV_A_R_LINEAR_____0_CM 1 100. 0. 255. DISPLAY_IDENTIFIER CTR_ABC_END_DIAG_COM_2_ACC ECU_ADDRESS 0xd00094f5 FORMAT "%3.0" /end MEASUREMENT
/begin MEASUREMENT fmy_stat_com_2_acc.err_info_stat.lv_err_mem "storage in dynamic failure memory of the diagnosis instance COM_2_ACC" UWORD _CNV_S_2_RANGE__0___1_CM 1 100. 0. 1. DISPLAY_IDENTIFIER LV_ERR_MEM_COM_2_ACC ECU_ADDRESS 0xd00094f6 BIT_MASK 0x8 /end MEASUREMENT
/begin MEASUREMENT fmy_stat_com_2_acc.err_info_stat.lv_ready "readiness status of the diagnosis instance COM_2_ACC" UWORD _CNV_S_2_RANGE__0___1_CM 1 100. 0. 1. DISPLAY_IDENTIFIER LV_READY_COM_2_ACC ECU_ADDRESS 0xd00094f6 BIT_MASK 0x10 /end MEASUREMENT
/begin MEASUREMENT fmy_stat_com_2_acc.err_info_stat.lv_end_diag "end of diagnosis of the diagnosis instance COM_2_ACC" UWORD _CNV_S_2_RANGE__0___1_CM 1 100. 0. 1. DISPLAY_IDENTIFIER LV_END_DIAG_COM_2_ACC ECU_ADDRESS 0xd00094f6 BIT_MASK 0x20 /end MEASUREMENT
/begin MEASUREMENT fmy_stat_com_2_acc.err_info_stat.lv_cdn_diag "diagnosis condition of the diagnosis instance COM_2_ACC" UWORD _CNV_S_2_RANGE__0___1_CM 1 100. 0. 1. DISPLAY_IDENTIFIER LV_CDN_DIAG_COM_2_ACC ECU_ADDRESS 0xd00094f6 BIT_MASK 0x40 /end MEASUREMENT
/begin MEASUREMENT fmy_stat_com_2_acc.err_info_stat.err_sym "symptoms of the diagnosis instance COM_2_ACC" UWORD _CNV_S_16_RANGE_ERR__349_CM 1 100. 0. 15. DISPLAY_IDENTIFIER ERR_SYM_COM_2_ACC ECU_ADDRESS 0xd00094f6 BIT_MASK 0x780 /end MEASUREMENT
/begin MEASUREMENT fmy_stat_com_2_km_icl.ctr_abc "anti bounce counter for diagnosis instance COM_2_KM_ICL" UBYTE _CNV_A_R_LINEAR_____0_CM 1 100. 0. 255. DISPLAY_IDENTIFIER CTR_ABC_COM_2_KM_ICL ECU_ADDRESS 0xd0009524 FORMAT "%3.0" /end MEASUREMENT
/begin MEASUREMENT fmy_stat_com_2_km_icl.ctr_end_diag "counter for end of diagnosis for diagnosis instance COM_2_KM_ICL" UBYTE _CNV_A_R_LINEAR_____0_CM 1 100. 0. 255. DISPLAY_IDENTIFIER CTR_ABC_END_DIAG_COM_2_KM_ICL ECU_ADDRESS 0xd0009525 FORMAT "%3.0" /end MEASUREMENT
/begin MEASUREMENT fmy_stat_com_2_km_icl.err_info_stat.lv_err_mem "storage in dynamic failure memory of the diagnosis instance COM_2_KM_ICL" UWORD _CNV_S_2_RANGE__0___1_CM 1 100. 0. 1. DISPLAY_IDENTIFIER LV_ERR_MEM_COM_2_KM_ICL ECU_ADDRESS 0xd0009526 BIT_MASK 0x8 /end MEASUREMENT
/begin MEASUREMENT fmy_stat_com_2_km_icl.err_info_stat.lv_ready "readiness status of the diagnosis instance COM_2_KM_ICL" UWORD _CNV_S_2_RANGE__0___1_CM 1 100. 0. 1. DISPLAY_IDENTIFIER LV_READY_COM_2_KM_ICL ECU_ADDRESS 0xd0009526 BIT_MASK 0x10 /end MEASUREMENT
/begin MEASUREMENT fmy_stat_com_2_km_icl.err_info_stat.lv_end_diag "end of diagnosis of the diagnosis instance COM_2_KM_ICL" UWORD _CNV_S_2_RANGE__0___1_CM 1 100. 0. 1. DISPLAY_IDENTIFIER LV_END_DIAG_COM_2_KM_ICL ECU_ADDRESS 0xd0009526 BIT_MASK 0x20 /end MEASUREMENT
/begin MEASUREMENT fmy_stat_com_2_km_icl.err_info_stat.lv_cdn_diag "diagnosis condition of the diagnosis instance COM_2_KM_ICL" UWORD _CNV_S_2_RANGE__0___1_CM 1 100. 0. 1. DISPLAY_IDENTIFIER LV_CDN_DIAG_COM_2_KM_ICL ECU_ADDRESS 0xd0009526 BIT_MASK 0x40 /end MEASUREMENT
/begin MEASUREMENT fmy_stat_com_2_km_icl.err_info_stat.err_sym "symptoms of the diagnosis instance COM_2_KM_ICL" UWORD _CNV_S_16_RANGE_ERR__349_CM 1 100. 0. 15. DISPLAY_IDENTIFIER ERR_SYM_COM_2_KM_ICL ECU_ADDRESS 0xd0009526 BIT_MASK 0x780 /end MEASUREMENT
/begin MEASUREMENT fmy_stat_com_2_t_icl.ctr_abc "anti bounce counter for diagnosis instance COM_2_T_ICL" UBYTE _CNV_A_R_LINEAR_____0_CM 1 100. 0. 255. DISPLAY_IDENTIFIER CTR_ABC_COM_2_T_ICL ECU_ADDRESS 0xd0009538 FORMAT "%3.0" /end MEASUREMENT
/begin MEASUREMENT fmy_stat_com_2_t_icl.ctr_end_diag "counter for end of diagnosis for diagnosis instance COM_2_T_ICL" UBYTE _CNV_A_R_LINEAR_____0_CM 1 100. 0. 255. DISPLAY_IDENTIFIER CTR_ABC_END_DIAG_COM_2_T_ICL ECU_ADDRESS 0xd0009539 FORMAT "%3.0" /end MEASUREMENT
/begin MEASUREMENT fmy_stat_com_2_t_icl.err_info_stat.lv_err_mem "storage in dynamic failure memory of the diagnosis instance COM_2_T_ICL" UWORD _CNV_S_2_RANGE__0___1_CM 1 100. 0. 1. DISPLAY_IDENTIFIER LV_ERR_MEM_COM_2_T_ICL ECU_ADDRESS 0xd000953a BIT_MASK 0x8 /end MEASUREMENT
/begin MEASUREMENT fmy_stat_com_2_t_icl.err_info_stat.lv_ready "readiness status of the diagnosis instance COM_2_T_ICL" UWORD _CNV_S_2_RANGE__0___1_CM 1 100. 0. 1. DISPLAY_IDENTIFIER LV_READY_COM_2_T_ICL ECU_ADDRESS 0xd000953a BIT_MASK 0x10 /end MEASUREMENT
/begin MEASUREMENT fmy_stat_com_2_t_icl.err_info_stat.lv_end_diag "end of diagnosis of the diagnosis instance COM_2_T_ICL" UWORD _CNV_S_2_RANGE__0___1_CM 1 100. 0. 1. DISPLAY_IDENTIFIER LV_END_DIAG_COM_2_T_ICL ECU_ADDRESS 0xd000953a BIT_MASK 0x20 /end MEASUREMENT
/begin MEASUREMENT fmy_stat_com_2_t_icl.err_info_stat.lv_cdn_diag "diagnosis condition of the diagnosis instance COM_2_T_ICL" UWORD _CNV_S_2_RANGE__0___1_CM 1 100. 0. 1. DISPLAY_IDENTIFIER LV_CDN_DIAG_COM_2_T_ICL ECU_ADDRESS 0xd000953a BIT_MASK 0x40 /end MEASUREMENT
/begin MEASUREMENT fmy_stat_com_2_t_icl.err_info_stat.err_sym "symptoms of the diagnosis instance COM_2_T_ICL" UWORD _CNV_S_16_RANGE_ERR__349_CM 1 100. 0. 15. DISPLAY_IDENTIFIER ERR_SYM_COM_2_T_ICL ECU_ADDRESS 0xd000953a BIT_MASK 0x780 /end MEASUREMENT
/begin MEASUREMENT fmy_stat_com_2_tam_icl.ctr_abc "anti bounce counter for diagnosis instance COM_2_TAM_ICL" UBYTE _CNV_A_R_LINEAR_____0_CM 1 100. 0. 255. DISPLAY_IDENTIFIER CTR_ABC_COM_2_TAM_ICL ECU_ADDRESS 0xd000953c FORMAT "%3.0" /end MEASUREMENT
/begin MEASUREMENT fmy_stat_com_2_tam_icl.ctr_end_diag "counter for end of diagnosis for diagnosis instance COM_2_TAM_ICL" UBYTE _CNV_A_R_LINEAR_____0_CM 1 100. 0. 255. DISPLAY_IDENTIFIER CTR_ABC_END_DIAG_COM_2_TAM_ICL ECU_ADDRESS 0xd000953d FORMAT "%3.0" /end MEASUREMENT
/begin MEASUREMENT fmy_stat_com_2_tam_icl.err_info_stat.lv_err_mem "storage in dynamic failure memory of the diagnosis instance COM_2_TAM_ICL" UWORD _CNV_S_2_RANGE__0___1_CM 1 100. 0. 1. DISPLAY_IDENTIFIER LV_ERR_MEM_COM_2_TAM_ICL ECU_ADDRESS 0xd000953e BIT_MASK 0x8 /end MEASUREMENT
/begin MEASUREMENT fmy_stat_com_2_tam_icl.err_info_stat.lv_ready "readiness status of the diagnosis instance COM_2_TAM_ICL" UWORD _CNV_S_2_RANGE__0___1_CM 1 100. 0. 1. DISPLAY_IDENTIFIER LV_READY_COM_2_TAM_ICL ECU_ADDRESS 0xd000953e BIT_MASK 0x10 /end MEASUREMENT
/begin MEASUREMENT fmy_stat_com_2_tam_icl.err_info_stat.lv_end_diag "end of diagnosis of the diagnosis instance COM_2_TAM_ICL" UWORD _CNV_S_2_RANGE__0___1_CM 1 100. 0. 1. DISPLAY_IDENTIFIER LV_END_DIAG_COM_2_TAM_ICL ECU_ADDRESS 0xd000953e BIT_MASK 0x20 /end MEASUREMENT
/begin MEASUREMENT fmy_stat_com_2_tam_icl.err_info_stat.lv_cdn_diag "diagnosis condition of the diagnosis instance COM_2_TAM_ICL" UWORD _CNV_S_2_RANGE__0___1_CM 1 100. 0. 1. DISPLAY_IDENTIFIER LV_CDN_DIAG_COM_2_TAM_ICL ECU_ADDRESS 0xd000953e BIT_MASK 0x40 /end MEASUREMENT
/begin MEASUREMENT fmy_stat_com_2_tam_icl.err_info_stat.err_sym "symptoms of the diagnosis instance COM_2_TAM_ICL" UWORD _CNV_S_16_RANGE_ERR__349_CM 1 100. 0. 15. DISPLAY_IDENTIFIER ERR_SYM_COM_2_TAM_ICL ECU_ADDRESS 0xd000953e BIT_MASK 0x780 /end MEASUREMENT
/begin MEASUREMENT fmy_stat_com_2_t_clk.ctr_abc "anti bounce counter for diagnosis instance COM_2_T_CLK" UBYTE _CNV_A_R_LINEAR_____0_CM 1 100. 0. 255. DISPLAY_IDENTIFIER CTR_ABC_COM_2_T_CLK ECU_ADDRESS 0xd0009534 FORMAT "%3.0" /end MEASUREMENT
/begin MEASUREMENT fmy_stat_com_2_t_clk.ctr_end_diag "counter for end of diagnosis for diagnosis instance COM_2_T_CLK" UBYTE _CNV_A_R_LINEAR_____0_CM 1 100. 0. 255. DISPLAY_IDENTIFIER CTR_ABC_END_DIAG_COM_2_T_CLK ECU_ADDRESS 0xd0009535 FORMAT "%3.0" /end MEASUREMENT
/begin MEASUREMENT fmy_stat_com_2_t_clk.err_info_stat.lv_err_mem "storage in dynamic failure memory of the diagnosis instance COM_2_T_CLK" UWORD _CNV_S_2_RANGE__0___1_CM 1 100. 0. 1. DISPLAY_IDENTIFIER LV_ERR_MEM_COM_2_T_CLK ECU_ADDRESS 0xd0009536 BIT_MASK 0x8 /end MEASUREMENT
/begin MEASUREMENT fmy_stat_com_2_t_clk.err_info_stat.lv_ready "readiness status of the diagnosis instance COM_2_T_CLK" UWORD _CNV_S_2_RANGE__0___1_CM 1 100. 0. 1. DISPLAY_IDENTIFIER LV_READY_COM_2_T_CLK ECU_ADDRESS 0xd0009536 BIT_MASK 0x10 /end MEASUREMENT
/begin MEASUREMENT fmy_stat_com_2_t_clk.err_info_stat.lv_end_diag "end of diagnosis of the diagnosis instance COM_2_T_CLK" UWORD _CNV_S_2_RANGE__0___1_CM 1 100. 0. 1. DISPLAY_IDENTIFIER LV_END_DIAG_COM_2_T_CLK ECU_ADDRESS 0xd0009536 BIT_MASK 0x20 /end MEASUREMENT
/begin MEASUREMENT fmy_stat_com_2_t_clk.err_info_stat.lv_cdn_diag "diagnosis condition of the diagnosis instance COM_2_T_CLK" UWORD _CNV_S_2_RANGE__0___1_CM 1 100. 0. 1. DISPLAY_IDENTIFIER LV_CDN_DIAG_COM_2_T_CLK ECU_ADDRESS 0xd0009536 BIT_MASK 0x40 /end MEASUREMENT
/begin MEASUREMENT fmy_stat_com_2_t_clk.err_info_stat.err_sym "symptoms of the diagnosis instance COM_2_T_CLK" UWORD _CNV_S_16_RANGE_ERR__349_CM 1 100. 0. 15. DISPLAY_IDENTIFIER ERR_SYM_COM_2_T_CLK ECU_ADDRESS 0xd0009536 BIT_MASK 0x780 /end MEASUREMENT
/begin MEASUREMENT fmy_stat_com_2_boff.ctr_abc "anti bounce counter for diagnosis instance COM_2_BOFF" UBYTE _CNV_A_R_LINEAR_____0_CM 1 100. 0. 255. DISPLAY_IDENTIFIER CTR_ABC_COM_2_BOFF ECU_ADDRESS 0xd00094f8 FORMAT "%3.0" /end MEASUREMENT
/begin MEASUREMENT fmy_stat_com_2_boff.ctr_end_diag "counter for end of diagnosis for diagnosis instance COM_2_BOFF" UBYTE _CNV_A_R_LINEAR_____0_CM 1 100. 0. 255. DISPLAY_IDENTIFIER CTR_ABC_END_DIAG_COM_2_BOFF ECU_ADDRESS 0xd00094f9 FORMAT "%3.0" /end MEASUREMENT
/begin COMPU_METHOD _CNV_A_R_LINEAR_____0_CM "" RAT_FUNC "%6.3" "-" COEFFS 0 1. 0. 0 0 1 /end COMPU_METHOD
/begin COMPU_METHOD _CNV_S_2_RANGE__0___1_CM "" TAB_VERB "%6.3" "-" COMPU_TAB_REF _CNV_S_2_RANGE__0___1 /end COMPU_METHOD
/begin COMPU_VTAB _CNV_S_2_RANGE__0___1 "" TAB_VERB 2 0 "0" 1 "1" /end COMPU_VTAB
/begin COMPU_METHOD _CNV_S_16_RANGE_ERR__349_CM "" TAB_VERB "%6.3" "-" COMPU_TAB_REF _CNV_S_16_RANGE_ERR__349 /end COMPU_METHOD
/begin COMPU_VTAB _CNV_S_16_RANGE_ERR__349 "" TAB_VERB 16 0 "NO_SYM" 1 "SYM_0" 2 "SYM_1" 3 "SYM_0, SYM_1" 4 "SYM_2" 5 "SYM_0, SYM_2" 6 "SYM_1, SYM_2" 7 "SYM_0, SYM_1, SYM_2" 8 "SYM_3" 9 "SYM_0, SYM_3" 10 "SYM_1, SYM_3" 11 "SYM_0, SYM_1,SYM_3" 12 "SYM_2, SYM_3" 13 "SYM_0, SYM_2, SYM_3" 14 "SYM_1, SYM_2, SYM_3" 15 "SYM_0, SYM_1, SYM_2, SYM_3" /end COMPU_VTAB
/begin FUNCTION ERRM_Table_of_Failures "Table_of_Failures"
 /begin OUT_MEASUREMENT fmy_stat_acr_dr.ctr_abc fmy_stat_acr_dr.ctr_end_diag fmy_stat_acr_dr.err_info_stat.lv_err_mem fmy_stat_acr_dr.err_info_stat.lv_ready fmy_stat_acr_dr.err_info_stat.lv_end_diag fmy_stat_acr_dr.err_info_stat.lv_cdn_diag fmy_stat_acr_dr.err_info_stat.err_sym fmy_stat_var_cod.ctr_abc fmy_stat_var_cod.ctr_end_diag fmy_stat_var_cod.err_info_stat.lv_err_mem fmy_stat_var_cod.err_info_stat.lv_ready fmy_stat_var_cod.err_info_stat.lv_end_diag fmy_stat_var_cod.err_info_stat.lv_cdn_diag fmy_stat_var_cod.err_info_stat.err_sym fmy_stat_veh_pow_var.ctr_abc fmy_stat_veh_pow_var.ctr_end_diag fmy_stat_veh_pow_var.err_info_stat.lv_err_mem fmy_stat_veh_pow_var.err_info_stat.lv_ready fmy_stat_veh_pow_var.err_info_stat.lv_end_diag fmy_stat_veh_pow_var.err_info_stat.lv_cdn_diag fmy_stat_veh_pow_var.err_info_stat.err_sym fmy_stat_fup_mfp_plaus.ctr_abc fmy_stat_fup_mfp_plaus.ctr_end_diag fmy_stat_fup_mfp_plaus.err_info_stat.lv_err_mem fmy_stat_fup_mfp_plaus.err_info_stat.lv_ready fmy_stat_fup_mfp_plaus.err_info_stat.lv_end_diag fmy_stat_fup_mfp_plaus.err_info_stat.lv_cdn_diag fmy_stat_fup_mfp_plaus.err_info_stat.err_sym fmy_stat_h_prs_sys.ctr_abc fmy_stat_h_prs_sys.ctr_end_diag fmy_stat_h_prs_sys.err_info_stat.lv_err_mem fmy_stat_h_prs_sys.err_info_stat.lv_ready fmy_stat_h_prs_sys.err_info_stat.lv_end_diag fmy_stat_h_prs_sys.err_info_stat.lv_cdn_diag fmy_stat_h_prs_sys.err_info_stat.err_sym fmy_stat_fup_0.ctr_abc fmy_stat_fup_0.ctr_end_diag fmy_stat_fup_0.err_info_stat.lv_err_mem fmy_stat_fup_0.err_info_stat.lv_ready fmy_stat_fup_0.err_info_stat.lv_end_diag fmy_stat_fup_0.err_info_stat.lv_cdn_diag fmy_stat_fup_0.err_info_stat.err_sym fmy_stat_fup_1.ctr_abc fmy_stat_fup_1.ctr_end_diag fmy_stat_fup_1.err_info_stat.lv_err_mem fmy_stat_fup_1.err_info_stat.lv_ready fmy_stat_fup_1.err_info_stat.lv_end_diag fmy_stat_fup_1.err_info_stat.lv_cdn_diag fmy_stat_fup_1.err_info_stat.err_sym fmy_stat_vcv_fpc_0.ctr_abc fmy_stat_vcv_fpc_0.ctr_end_diag fmy_stat_vcv_fpc_0.err_info_stat.lv_err_mem fmy_stat_vcv_fpc_0.err_info_stat.lv_ready fmy_stat_vcv_fpc_0.err_info_stat.lv_end_diag fmy_stat_vcv_fpc_0.err_info_stat.lv_cdn_diag fmy_stat_vcv_fpc_0.err_info_stat.err_sym fmy_stat_fup_efp.ctr_abc fmy_stat_fup_efp.ctr_end_diag fmy_stat_fup_efp.err_info_stat.lv_err_mem fmy_stat_fup_efp.err_info_stat.lv_ready fmy_stat_fup_efp.err_info_stat.lv_end_diag fmy_stat_fup_efp.err_info_stat.lv_cdn_diag fmy_stat_fup_efp.err_info_stat.err_sym fmy_stat_efppwm_plaus.ctr_abc fmy_stat_efppwm_plaus.ctr_end_diag fmy_stat_efppwm_plaus.err_info_stat.lv_err_mem fmy_stat_efppwm_plaus.err_info_stat.lv_ready fmy_stat_efppwm_plaus.err_info_stat.lv_end_diag fmy_stat_efppwm_plaus.err_info_stat.lv_cdn_diag fmy_stat_efppwm_plaus.err_info_stat.err_sym fmy_stat_l_prs_sys.ctr_abc fmy_stat_l_prs_sys.ctr_end_diag fmy_stat_l_prs_sys.err_info_stat.lv_err_mem fmy_stat_l_prs_sys.err_info_stat.lv_ready fmy_stat_l_prs_sys.err_info_stat.lv_end_diag fmy_stat_l_prs_sys.err_info_stat.lv_cdn_diag fmy_stat_l_prs_sys.err_info_stat.err_sym fmy_stat_vcv_fpc_1.ctr_abc fmy_stat_vcv_fpc_1.ctr_end_diag fmy_stat_vcv_fpc_1.err_info_stat.lv_err_mem fmy_stat_vcv_fpc_1.err_info_stat.lv_ready fmy_stat_vcv_fpc_1.err_info_stat.lv_end_diag fmy_stat_vcv_fpc_1.err_info_stat.lv_cdn_diag fmy_stat_vcv_fpc_1.err_info_stat.err_sym fmy_stat_fsd_1.ctr_abc fmy_stat_fsd_1.ctr_end_diag fmy_stat_fsd_1.err_info_stat.lv_err_mem fmy_stat_fsd_1.err_info_stat.lv_ready fmy_stat_fsd_1.err_info_stat.lv_end_diag fmy_stat_fsd_1.err_info_stat.lv_cdn_diag fmy_stat_fsd_1.err_info_stat.err_sym fmy_stat_fsd_2.ctr_abc fmy_stat_fsd_2.ctr_end_diag fmy_stat_fsd_2.err_info_stat.lv_err_mem fmy_stat_fsd_2.err_info_stat.lv_ready fmy_stat_fsd_2.err_info_stat.lv_end_diag fmy_stat_fsd_2.err_info_stat.lv_cdn_diag fmy_stat_fsd_2.err_info_stat.err_sym fmy_stat_fsd_lam_lim_1.ctr_abc fmy_stat_fsd_lam_lim_1.ctr_end_diag fmy_stat_fsd_lam_lim_1.err_info_stat.lv_err_mem fmy_stat_fsd_lam_lim_1.err_info_stat.lv_ready fmy_stat_fsd_lam_lim_1.err_info_stat.lv_end_diag fmy_stat_fsd_lam_lim_1.err_info_stat.lv_cdn_diag fmy_stat_fsd_lam_lim_1.err_info_stat.err_sym fmy_stat_fsd_lam_lim_2.ctr_abc fmy_stat_fsd_lam_lim_2.ctr_end_diag fmy_stat_fsd_lam_lim_2.err_info_stat.lv_err_mem fmy_stat_fsd_lam_lim_2.err_info_stat.lv_ready fmy_stat_fsd_lam_lim_2.err_info_stat.lv_end_diag fmy_stat_fsd_lam_lim_2.err_info_stat.lv_cdn_diag fmy_stat_fsd_lam_lim_2.err_info_stat.err_sym fmy_stat_fsd_h_rng_1.ctr_abc fmy_stat_fsd_h_rng_1.ctr_end_diag fmy_stat_fsd_h_rng_1.err_info_stat.lv_err_mem fmy_stat_fsd_h_rng_1.err_info_stat.lv_ready fmy_stat_fsd_h_rng_1.err_info_stat.lv_end_diag fmy_stat_fsd_h_rng_1.err_info_stat.lv_cdn_diag fmy_stat_fsd_h_rng_1.err_info_stat.err_sym fmy_stat_fsd_h_rng_2.ctr_abc fmy_stat_fsd_h_rng_2.ctr_end_diag fmy_stat_fsd_h_rng_2.err_info_stat.lv_err_mem fmy_stat_fsd_h_rng_2.err_info_stat.lv_ready fmy_stat_fsd_h_rng_2.err_info_stat.lv_end_diag fmy_stat_fsd_h_rng_2.err_info_stat.lv_cdn_diag fmy_stat_fsd_h_rng_2.err_info_stat.err_sym fmy_stat_cyl_bal_lam_0.ctr_abc fmy_stat_cyl_bal_lam_0.ctr_end_diag fmy_stat_cyl_bal_lam_0.err_info_stat.lv_err_mem fmy_stat_cyl_bal_lam_0.err_info_stat.lv_ready fmy_stat_cyl_bal_lam_0.err_info_stat.lv_end_diag fmy_stat_cyl_bal_lam_0.err_info_stat.lv_cdn_diag fmy_stat_cyl_bal_lam_0.err_info_stat.err_sym fmy_stat_cyl_bal_lam_1.ctr_abc fmy_stat_cyl_bal_lam_1.ctr_end_diag fmy_stat_cyl_bal_lam_1.err_info_stat.lv_err_mem fmy_stat_cyl_bal_lam_1.err_info_stat.lv_ready fmy_stat_cyl_bal_lam_1.err_info_stat.lv_end_diag fmy_stat_cyl_bal_lam_1.err_info_stat.lv_cdn_diag fmy_stat_cyl_bal_lam_1.err_info_stat.err_sym fmy_stat_cyl_bal_lam_2.ctr_abc fmy_stat_cyl_bal_lam_2.ctr_end_diag fmy_stat_cyl_bal_lam_2.err_info_stat.lv_err_mem fmy_stat_cyl_bal_lam_2.err_info_stat.lv_ready fmy_stat_cyl_bal_lam_2.err_info_stat.lv_end_diag fmy_stat_cyl_bal_lam_2.err_info_stat.lv_cdn_diag fmy_stat_cyl_bal_lam_2.err_info_stat.err_sym fmy_stat_cyl_bal_lam_3.ctr_abc fmy_stat_cyl_bal_lam_3.ctr_end_diag fmy_stat_cyl_bal_lam_3.err_info_stat.lv_err_mem fmy_stat_cyl_bal_lam_3.err_info_stat.lv_ready fmy_stat_cyl_bal_lam_3.err_info_stat.lv_end_diag fmy_stat_cyl_bal_lam_3.err_info_stat.lv_cdn_diag fmy_stat_cyl_bal_lam_3.err_info_stat.err_sym fmy_stat_cyl_bal_lam_4.ctr_abc fmy_stat_cyl_bal_lam_4.ctr_end_diag fmy_stat_cyl_bal_lam_4.err_info_stat.lv_err_mem fmy_stat_cyl_bal_lam_4.err_info_stat.lv_ready fmy_stat_cyl_bal_lam_4.err_info_stat.lv_end_diag fmy_stat_cyl_bal_lam_4.err_info_stat.lv_cdn_diag fmy_stat_cyl_bal_lam_4.err_info_stat.err_sym fmy_stat_cyl_bal_lam_5.ctr_abc fmy_stat_cyl_bal_lam_5.ctr_end_diag fmy_stat_cyl_bal_lam_5.err_info_stat.lv_err_mem fmy_stat_cyl_bal_lam_5.err_info_stat.lv_ready fmy_stat_cyl_bal_lam_5.err_info_stat.lv_end_diag fmy_stat_cyl_bal_lam_5.err_info_stat.lv_cdn_diag fmy_stat_cyl_bal_lam_5.err_info_stat.err_sym fmy_stat_cyl_bal_lam_6.ctr_abc fmy_stat_cyl_bal_lam_6.ctr_end_diag fmy_stat_cyl_bal_lam_6.err_info_stat.lv_err_mem fmy_stat_cyl_bal_lam_6.err_info_stat.lv_ready fmy_stat_cyl_bal_lam_6.err_info_stat.lv_end_diag fmy_stat_cyl_bal_lam_6.err_info_stat.lv_cdn_diag fmy_stat_cyl_bal_lam_6.err_info_stat.err_sym fmy_stat_cyl_bal_lam_7.ctr_abc fmy_stat_cyl_bal_lam_7.ctr_end_diag fmy_stat_cyl_bal_lam_7.err_info_stat.lv_err_mem fmy_stat_cyl_bal_lam_7.err_info_stat.lv_ready fmy_stat_cyl_bal_lam_7.err_info_stat.lv_end_diag fmy_stat_cyl_bal_lam_7.err_info_stat.lv_cdn_diag fmy_stat_cyl_bal_lam_7.err_info_stat.err_sym fmy_stat_cyl_bal_er_0.ctr_abc fmy_stat_cyl_bal_er_0.ctr_end_diag fmy_stat_cyl_bal_er_0.err_info_stat.lv_err_mem fmy_stat_cyl_bal_er_0.err_info_stat.lv_ready fmy_stat_cyl_bal_er_0.err_info_stat.lv_end_diag fmy_stat_cyl_bal_er_0.err_info_stat.lv_cdn_diag fmy_stat_cyl_bal_er_0.err_info_stat.err_sym fmy_stat_cyl_bal_er_1.ctr_abc fmy_stat_cyl_bal_er_1.ctr_end_diag fmy_stat_cyl_bal_er_1.err_info_stat.lv_err_mem fmy_stat_cyl_bal_er_1.err_info_stat.lv_ready fmy_stat_cyl_bal_er_1.err_info_stat.lv_end_diag fmy_stat_cyl_bal_er_1.err_info_stat.lv_cdn_diag fmy_stat_cyl_bal_er_1.err_info_stat.err_sym fmy_stat_cyl_bal_er_2.ctr_abc fmy_stat_cyl_bal_er_2.ctr_end_diag fmy_stat_cyl_bal_er_2.err_info_stat.lv_err_mem fmy_stat_cyl_bal_er_2.err_info_stat.lv_ready fmy_stat_cyl_bal_er_2.err_info_stat.lv_end_diag fmy_stat_cyl_bal_er_2.err_info_stat.lv_cdn_diag fmy_stat_cyl_bal_er_2.err_info_stat.err_sym fmy_stat_cyl_bal_er_3.ctr_abc fmy_stat_cyl_bal_er_3.ctr_end_diag fmy_stat_cyl_bal_er_3.err_info_stat.lv_err_mem fmy_stat_cyl_bal_er_3.err_info_stat.lv_ready fmy_stat_cyl_bal_er_3.err_info_stat.lv_end_diag fmy_stat_cyl_bal_er_3.err_info_stat.lv_cdn_diag fmy_stat_cyl_bal_er_3.err_info_stat.err_sym fmy_stat_cyl_bal_er_4.ctr_abc fmy_stat_cyl_bal_er_4.ctr_end_diag fmy_stat_cyl_bal_er_4.err_info_stat.lv_err_mem fmy_stat_cyl_bal_er_4.err_info_stat.lv_ready fmy_stat_cyl_bal_er_4.err_info_stat.lv_end_diag fmy_stat_cyl_bal_er_4.err_info_stat.lv_cdn_diag fmy_stat_cyl_bal_er_4.err_info_stat.err_sym fmy_stat_cyl_bal_er_5.ctr_abc fmy_stat_cyl_bal_er_5.ctr_end_diag fmy_stat_cyl_bal_er_5.err_info_stat.lv_err_mem fmy_stat_cyl_bal_er_5.err_info_stat.lv_ready fmy_stat_cyl_bal_er_5.err_info_stat.lv_end_diag fmy_stat_cyl_bal_er_5.err_info_stat.lv_cdn_diag fmy_stat_cyl_bal_er_5.err_info_stat.err_sym fmy_stat_cyl_bal_er_6.ctr_abc fmy_stat_cyl_bal_er_6.ctr_end_diag fmy_stat_cyl_bal_er_6.err_info_stat.lv_err_mem fmy_stat_cyl_bal_er_6.err_info_stat.lv_ready fmy_stat_cyl_bal_er_6.err_info_stat.lv_end_diag fmy_stat_cyl_bal_er_6.err_info_stat.lv_cdn_diag fmy_stat_cyl_bal_er_6.err_info_stat.err_sym fmy_stat_cyl_bal_er_7.ctr_abc fmy_stat_cyl_bal_er_7.ctr_end_diag fmy_stat_cyl_bal_er_7.err_info_stat.lv_err_mem fmy_stat_cyl_bal_er_7.err_info_stat.lv_ready fmy_stat_cyl_bal_er_7.err_info_stat.lv_end_diag fmy_stat_cyl_bal_er_7.err_info_stat.lv_cdn_diag fmy_stat_cyl_bal_er_7.err_info_stat.err_sym fmy_stat_mon_3.ctr_abc fmy_stat_mon_3.ctr_end_diag fmy_stat_mon_3.err_info_stat.lv_err_mem fmy_stat_mon_3.err_info_stat.lv_ready fmy_stat_mon_3.err_info_stat.lv_end_diag fmy_stat_mon_3.err_info_stat.lv_cdn_diag fmy_stat_mon_3.err_info_stat.err_sym fmy_stat_maf_frq_rng_0.ctr_abc fmy_stat_maf_frq_rng_0.ctr_end_diag fmy_stat_maf_frq_rng_0.err_info_stat.lv_err_mem fmy_stat_maf_frq_rng_0.err_info_stat.lv_ready fmy_stat_maf_frq_rng_0.err_info_stat.lv_end_diag fmy_stat_maf_frq_rng_0.err_info_stat.lv_cdn_diag fmy_stat_maf_frq_rng_0.err_info_stat.err_sym fmy_stat_maf_frq_grd_0.ctr_abc fmy_stat_maf_frq_grd_0.ctr_end_diag fmy_stat_maf_frq_grd_0.err_info_stat.lv_err_mem fmy_stat_maf_frq_grd_0.err_info_stat.lv_ready fmy_stat_maf_frq_grd_0.err_info_stat.lv_end_diag fmy_stat_maf_frq_grd_0.err_info_stat.lv_cdn_diag fmy_stat_maf_frq_grd_0.err_info_stat.err_sym fmy_stat_maf_frq_el_0.ctr_abc fmy_stat_maf_frq_el_0.ctr_end_diag fmy_stat_maf_frq_el_0.err_info_stat.lv_err_mem fmy_stat_maf_frq_el_0.err_info_stat.lv_ready fmy_stat_maf_frq_el_0.err_info_stat.lv_end_diag fmy_stat_maf_frq_el_0.err_info_stat.lv_cdn_diag fmy_stat_maf_frq_el_0.err_info_stat.err_sym fmy_stat_maf_frq_rng_1.ctr_abc fmy_stat_maf_frq_rng_1.ctr_end_diag fmy_stat_maf_frq_rng_1.err_info_stat.lv_err_mem fmy_stat_maf_frq_rng_1.err_info_stat.lv_ready fmy_stat_maf_frq_rng_1.err_info_stat.lv_end_diag fmy_stat_maf_frq_rng_1.err_info_stat.lv_cdn_diag fmy_stat_maf_frq_rng_1.err_info_stat.err_sym fmy_stat_maf_frq_grd_1.ctr_abc fmy_stat_maf_frq_grd_1.ctr_end_diag fmy_stat_maf_frq_grd_1.err_info_stat.lv_err_mem fmy_stat_maf_frq_grd_1.err_info_stat.lv_ready fmy_stat_maf_frq_grd_1.err_info_stat.lv_end_diag fmy_stat_maf_frq_grd_1.err_info_stat.lv_cdn_diag fmy_stat_maf_frq_grd_1.err_info_stat.err_sym fmy_stat_maf_frq_el_1.ctr_abc fmy_stat_maf_frq_el_1.ctr_end_diag fmy_stat_maf_frq_el_1.err_info_stat.lv_err_mem fmy_stat_maf_frq_el_1.err_info_stat.lv_ready fmy_stat_maf_frq_el_1.err_info_stat.lv_end_diag fmy_stat_maf_frq_el_1.err_info_stat.lv_cdn_diag fmy_stat_maf_frq_el_1.err_info_stat.err_sym fmy_stat_tps_1_1.ctr_abc fmy_stat_tps_1_1.ctr_end_diag fmy_stat_tps_1_1.err_info_stat.lv_err_mem fmy_stat_tps_1_1.err_info_stat.lv_ready fmy_stat_tps_1_1.err_info_stat.lv_end_diag fmy_stat_tps_1_1.err_info_stat.lv_cdn_diag fmy_stat_tps_1_1.err_info_stat.err_sym fmy_stat_tps_1_2.ctr_abc fmy_stat_tps_1_2.ctr_end_diag fmy_stat_tps_1_2.err_info_stat.lv_err_mem fmy_stat_tps_1_2.err_info_stat.lv_ready fmy_stat_tps_1_2.err_info_stat.lv_end_diag fmy_stat_tps_1_2.err_info_stat.lv_cdn_diag fmy_stat_tps_1_2.err_info_stat.err_sym fmy_stat_tps_2_1.ctr_abc fmy_stat_tps_2_1.ctr_end_diag fmy_stat_tps_2_1.err_info_stat.lv_err_mem fmy_stat_tps_2_1.err_info_stat.lv_ready fmy_stat_tps_2_1.err_info_stat.lv_end_diag fmy_stat_tps_2_1.err_info_stat.lv_cdn_diag fmy_stat_tps_2_1.err_info_stat.err_sym fmy_stat_tps_2_2.ctr_abc fmy_stat_tps_2_2.ctr_end_diag fmy_stat_tps_2_2.err_info_stat.lv_err_mem fmy_stat_tps_2_2.err_info_stat.lv_ready fmy_stat_tps_2_2.err_info_stat.lv_end_diag fmy_stat_tps_2_2.err_info_stat.lv_cdn_diag fmy_stat_tps_2_2.err_info_stat.err_sym fmy_stat_tps_maf_1_1.ctr_abc fmy_stat_tps_maf_1_1.ctr_end_diag fmy_stat_tps_maf_1_1.err_info_stat.lv_err_mem fmy_stat_tps_maf_1_1.err_info_stat.lv_ready fmy_stat_tps_maf_1_1.err_info_stat.lv_end_diag fmy_stat_tps_maf_1_1.err_info_stat.lv_cdn_diag fmy_stat_tps_maf_1_1.err_info_stat.err_sym fmy_stat_tps_maf_1_2.ctr_abc fmy_stat_tps_maf_1_2.ctr_end_diag fmy_stat_tps_maf_1_2.err_info_stat.lv_err_mem fmy_stat_tps_maf_1_2.err_info_stat.lv_ready fmy_stat_tps_maf_1_2.err_info_stat.lv_end_diag fmy_stat_tps_maf_1_2.err_info_stat.lv_cdn_diag fmy_stat_tps_maf_1_2.err_info_stat.err_sym fmy_stat_tps_maf_2_1.ctr_abc fmy_stat_tps_maf_2_1.ctr_end_diag fmy_stat_tps_maf_2_1.err_info_stat.lv_err_mem fmy_stat_tps_maf_2_1.err_info_stat.lv_ready fmy_stat_tps_maf_2_1.err_info_stat.lv_end_diag fmy_stat_tps_maf_2_1.err_info_stat.lv_cdn_diag fmy_stat_tps_maf_2_1.err_info_stat.err_sym fmy_stat_tps_maf_2_2.ctr_abc fmy_stat_tps_maf_2_2.ctr_end_diag fmy_stat_tps_maf_2_2.err_info_stat.lv_err_mem fmy_stat_tps_maf_2_2.err_info_stat.lv_ready fmy_stat_tps_maf_2_2.err_info_stat.lv_end_diag fmy_stat_tps_maf_2_2.err_info_stat.lv_cdn_diag fmy_stat_tps_maf_2_2.err_info_stat.err_sym fmy_stat_tps_ratio_1.ctr_abc fmy_stat_tps_ratio_1.ctr_end_diag fmy_stat_tps_ratio_1.err_info_stat.lv_err_mem fmy_stat_tps_ratio_1.err_info_stat.lv_ready fmy_stat_tps_ratio_1.err_info_stat.lv_end_diag fmy_stat_tps_ratio_1.err_info_stat.lv_cdn_diag fmy_stat_tps_ratio_1.err_info_stat.err_sym fmy_stat_tps_ratio_2.ctr_abc fmy_stat_tps_ratio_2.ctr_end_diag fmy_stat_tps_ratio_2.err_info_stat.lv_err_mem fmy_stat_tps_ratio_2.err_info_stat.lv_ready fmy_stat_tps_ratio_2.err_info_stat.lv_end_diag fmy_stat_tps_ratio_2.err_info_stat.lv_cdn_diag fmy_stat_tps_ratio_2.err_info_stat.err_sym fmy_stat_tps_ad_1.ctr_abc fmy_stat_tps_ad_1.ctr_end_diag fmy_stat_tps_ad_1.err_info_stat.lv_err_mem fmy_stat_tps_ad_1.err_info_stat.lv_ready fmy_stat_tps_ad_1.err_info_stat.lv_end_diag fmy_stat_tps_ad_1.err_info_stat.lv_cdn_diag fmy_stat_tps_ad_1.err_info_stat.err_sym fmy_stat_tps_ad_2.ctr_abc fmy_stat_tps_ad_2.ctr_end_diag fmy_stat_tps_ad_2.err_info_stat.lv_err_mem fmy_stat_tps_ad_2.err_info_stat.lv_ready fmy_stat_tps_ad_2.err_info_stat.lv_end_diag fmy_stat_tps_ad_2.err_info_stat.lv_cdn_diag fmy_stat_tps_ad_2.err_info_stat.err_sym fmy_stat_etc_pwm_1.ctr_abc fmy_stat_etc_pwm_1.ctr_end_diag fmy_stat_etc_pwm_1.err_info_stat.lv_err_mem fmy_stat_etc_pwm_1.err_info_stat.lv_ready fmy_stat_etc_pwm_1.err_info_stat.lv_end_diag fmy_stat_etc_pwm_1.err_info_stat.lv_cdn_diag fmy_stat_etc_pwm_1.err_info_stat.err_sym fmy_stat_etc_pwm_2.ctr_abc fmy_stat_etc_pwm_2.ctr_end_diag fmy_stat_etc_pwm_2.err_info_stat.lv_err_mem fmy_stat_etc_pwm_2.err_info_stat.lv_ready fmy_stat_etc_pwm_2.err_info_stat.lv_end_diag fmy_stat_etc_pwm_2.err_info_stat.lv_cdn_diag fmy_stat_etc_pwm_2.err_info_stat.err_sym fmy_stat_etc_ctl_1.ctr_abc fmy_stat_etc_ctl_1.ctr_end_diag fmy_stat_etc_ctl_1.err_info_stat.lv_err_mem fmy_stat_etc_ctl_1.err_info_stat.lv_ready fmy_stat_etc_ctl_1.err_info_stat.lv_end_diag fmy_stat_etc_ctl_1.err_info_stat.lv_cdn_diag fmy_stat_etc_ctl_1.err_info_stat.err_sym fmy_stat_etc_ctl_2.ctr_abc fmy_stat_etc_ctl_2.ctr_end_diag fmy_stat_etc_ctl_2.err_info_stat.lv_err_mem fmy_stat_etc_ctl_2.err_info_stat.lv_ready fmy_stat_etc_ctl_2.err_info_stat.lv_end_diag fmy_stat_etc_ctl_2.err_info_stat.lv_cdn_diag fmy_stat_etc_ctl_2.err_info_stat.err_sym fmy_stat_tps_ad_spr_1.ctr_abc fmy_stat_tps_ad_spr_1.ctr_end_diag fmy_stat_tps_ad_spr_1.err_info_stat.lv_err_mem fmy_stat_tps_ad_spr_1.err_info_stat.lv_ready fmy_stat_tps_ad_spr_1.err_info_stat.lv_end_diag fmy_stat_tps_ad_spr_1.err_info_stat.lv_cdn_diag fmy_stat_tps_ad_spr_1.err_info_stat.err_sym fmy_stat_tps_ad_spr_2.ctr_abc fmy_stat_tps_ad_spr_2.ctr_end_diag fmy_stat_tps_ad_spr_2.err_info_stat.lv_err_mem fmy_stat_tps_ad_spr_2.err_info_stat.lv_ready fmy_stat_tps_ad_spr_2.err_info_stat.lv_end_diag fmy_stat_tps_ad_spr_2.err_info_stat.lv_cdn_diag fmy_stat_tps_ad_spr_2.err_info_stat.err_sym fmy_stat_etc_dr_1.ctr_abc fmy_stat_etc_dr_1.ctr_end_diag fmy_stat_etc_dr_1.err_info_stat.lv_err_mem fmy_stat_etc_dr_1.err_info_stat.lv_ready fmy_stat_etc_dr_1.err_info_stat.lv_end_diag fmy_stat_etc_dr_1.err_info_stat.lv_cdn_diag fmy_stat_etc_dr_1.err_info_stat.err_sym fmy_stat_etc_dr_2.ctr_abc fmy_stat_etc_dr_2.ctr_end_diag fmy_stat_etc_dr_2.err_info_stat.lv_err_mem fmy_stat_etc_dr_2.err_info_stat.lv_ready fmy_stat_etc_dr_2.err_info_stat.lv_end_diag fmy_stat_etc_dr_2.err_info_stat.lv_cdn_diag fmy_stat_etc_dr_2.err_info_stat.err_sym fmy_stat_tps_st_chk_1.ctr_abc fmy_stat_tps_st_chk_1.ctr_end_diag fmy_stat_tps_st_chk_1.err_info_stat.lv_err_mem fmy_stat_tps_st_chk_1.err_info_stat.lv_ready fmy_stat_tps_st_chk_1.err_info_stat.lv_end_diag fmy_stat_tps_st_chk_1.err_info_stat.lv_cdn_diag fmy_stat_tps_st_chk_1.err_info_stat.err_sym fmy_stat_tps_st_chk_2.ctr_abc fmy_stat_tps_st_chk_2.ctr_end_diag fmy_stat_tps_st_chk_2.err_info_stat.lv_err_mem fmy_stat_tps_st_chk_2.err_info_stat.lv_ready fmy_stat_tps_st_chk_2.err_info_stat.lv_end_diag fmy_stat_tps_st_chk_2.err_info_stat.lv_cdn_diag fmy_stat_tps_st_chk_2.err_info_stat.err_sym fmy_stat_com_1_tq_loss_cord.ctr_abc fmy_stat_com_1_tq_loss_cord.ctr_end_diag fmy_stat_com_1_tq_loss_cord.err_info_stat.lv_err_mem fmy_stat_com_1_tq_loss_cord.err_info_stat.lv_ready fmy_stat_com_1_tq_loss_cord.err_info_stat.lv_end_diag fmy_stat_com_1_tq_loss_cord.err_info_stat.lv_cdn_diag fmy_stat_com_1_tq_loss_cord.err_info_stat.err_sym fmy_stat_com_1_swi_gear.ctr_abc fmy_stat_com_1_swi_gear.ctr_end_diag fmy_stat_com_1_swi_gear.err_info_stat.lv_err_mem fmy_stat_com_1_swi_gear.err_info_stat.lv_ready fmy_stat_com_1_swi_gear.err_info_stat.lv_end_diag fmy_stat_com_1_swi_gear.err_info_stat.lv_cdn_diag fmy_stat_com_1_swi_gear.err_info_stat.err_sym fmy_stat_com_1_veh_mod.ctr_abc fmy_stat_com_1_veh_mod.ctr_end_diag fmy_stat_com_1_veh_mod.err_info_stat.lv_err_mem fmy_stat_com_1_veh_mod.err_info_stat.lv_ready fmy_stat_com_1_veh_mod.err_info_stat.lv_end_diag fmy_stat_com_1_veh_mod.err_info_stat.lv_cdn_diag fmy_stat_com_1_veh_mod.err_info_stat.err_sym fmy_stat_com_1_brake_tcs.ctr_abc fmy_stat_com_1_brake_tcs.ctr_end_diag fmy_stat_com_1_brake_tcs.err_info_stat.lv_err_mem fmy_stat_com_1_brake_tcs.err_info_stat.lv_ready fmy_stat_com_1_brake_tcs.err_info_stat.lv_end_diag fmy_stat_com_1_brake_tcs.err_info_stat.lv_cdn_diag fmy_stat_com_1_brake_tcs.err_info_stat.err_sym fmy_stat_com_1_tq_driv_asi.ctr_abc fmy_stat_com_1_tq_driv_asi.ctr_end_diag fmy_stat_com_1_tq_driv_asi.err_info_stat.lv_err_mem fmy_stat_com_1_tq_driv_asi.err_info_stat.lv_ready fmy_stat_com_1_tq_driv_asi.err_info_stat.lv_end_diag fmy_stat_com_1_tq_driv_asi.err_info_stat.lv_cdn_diag fmy_stat_com_1_tq_driv_asi.err_info_stat.err_sym fmy_stat_com_1_tq_tcs.ctr_abc fmy_stat_com_1_tq_tcs.ctr_end_diag fmy_stat_com_1_tq_tcs.err_info_stat.lv_err_mem fmy_stat_com_1_tq_tcs.err_info_stat.lv_ready fmy_stat_com_1_tq_tcs.err_info_stat.lv_end_diag fmy_stat_com_1_tq_tcs.err_info_stat.lv_cdn_diag fmy_stat_com_1_tq_tcs.err_info_stat.err_sym fmy_stat_com_1_tqb_tcs.ctr_abc fmy_stat_com_1_tqb_tcs.ctr_end_diag fmy_stat_com_1_tqb_tcs.err_info_stat.lv_err_mem fmy_stat_com_1_tqb_tcs.err_info_stat.lv_ready fmy_stat_com_1_tqb_tcs.err_info_stat.lv_end_diag fmy_stat_com_1_tqb_tcs.err_info_stat.lv_cdn_diag fmy_stat_com_1_tqb_tcs.err_info_stat.err_sym fmy_stat_com_1_wheel_tcs.ctr_abc fmy_stat_com_1_wheel_tcs.ctr_end_diag fmy_stat_com_1_wheel_tcs.err_info_stat.lv_err_mem fmy_stat_com_1_wheel_tcs.err_info_stat.lv_ready fmy_stat_com_1_wheel_tcs.err_info_stat.lv_end_diag fmy_stat_com_1_wheel_tcs.err_info_stat.lv_cdn_diag fmy_stat_com_1_wheel_tcs.err_info_stat.err_sym fmy_stat_com_1_req_tqdw.ctr_abc fmy_stat_com_1_req_tqdw.ctr_end_diag fmy_stat_com_1_req_tqdw.err_info_stat.lv_err_mem fmy_stat_com_1_req_tqdw.err_info_stat.lv_ready fmy_stat_com_1_req_tqdw.err_info_stat.lv_end_diag fmy_stat_com_1_req_tqdw.err_info_stat.lv_cdn_diag fmy_stat_com_1_req_tqdw.err_info_stat.err_sym fmy_stat_com_1_tq_pste.ctr_abc fmy_stat_com_1_tq_pste.ctr_end_diag fmy_stat_com_1_tq_pste.err_info_stat.lv_err_mem fmy_stat_com_1_tq_pste.err_info_stat.lv_ready fmy_stat_com_1_tq_pste.err_info_stat.lv_end_diag fmy_stat_com_1_tq_pste.err_info_stat.lv_cdn_diag fmy_stat_com_1_tq_pste.err_info_stat.err_sym fmy_stat_com_1_ang_pste.ctr_abc fmy_stat_com_1_ang_pste.ctr_end_diag fmy_stat_com_1_ang_pste.err_info_stat.lv_err_mem fmy_stat_com_1_ang_pste.err_info_stat.lv_ready fmy_stat_com_1_ang_pste.err_info_stat.lv_end_diag fmy_stat_com_1_ang_pste.err_info_stat.lv_cdn_diag fmy_stat_com_1_ang_pste.err_info_stat.err_sym fmy_stat_com_1_ac_trv.ctr_abc fmy_stat_com_1_ac_trv.ctr_end_diag fmy_stat_com_1_ac_trv.err_info_stat.lv_err_mem fmy_stat_com_1_ac_trv.err_info_stat.lv_ready fmy_stat_com_1_ac_trv.err_info_stat.lv_end_diag fmy_stat_com_1_ac_trv.err_info_stat.lv_cdn_diag fmy_stat_com_1_ac_trv.err_info_stat.err_sym fmy_stat_com_1_ac_lgt.ctr_abc fmy_stat_com_1_ac_lgt.ctr_end_diag fmy_stat_com_1_ac_lgt.err_info_stat.lv_err_mem fmy_stat_com_1_ac_lgt.err_info_stat.lv_ready fmy_stat_com_1_ac_lgt.err_info_stat.lv_end_diag fmy_stat_com_1_ac_lgt.err_info_stat.lv_cdn_diag fmy_stat_com_1_ac_lgt.err_info_stat.err_sym fmy_stat_com_1_tq_ars.ctr_abc fmy_stat_com_1_tq_ars.ctr_end_diag fmy_stat_com_1_tq_ars.err_info_stat.lv_err_mem fmy_stat_com_1_tq_ars.err_info_stat.lv_ready fmy_stat_com_1_tq_ars.err_info_stat.lv_end_diag fmy_stat_com_1_tq_ars.err_info_stat.lv_cdn_diag fmy_stat_com_1_tq_ars.err_info_stat.err_sym fmy_stat_com_1_ars.ctr_abc fmy_stat_com_1_ars.ctr_end_diag fmy_stat_com_1_ars.err_info_stat.lv_err_mem fmy_stat_com_1_ars.err_info_stat.lv_ready fmy_stat_com_1_ars.err_info_stat.lv_end_diag fmy_stat_com_1_ars.err_info_stat.lv_cdn_diag fmy_stat_com_1_ars.err_info_stat.err_sym fmy_stat_com_1_vs.ctr_abc fmy_stat_com_1_vs.ctr_end_diag fmy_stat_com_1_vs.err_info_stat.lv_err_mem fmy_stat_com_1_vs.err_info_stat.lv_ready fmy_stat_com_1_vs.err_info_stat.lv_end_diag fmy_stat_com_1_vs.err_info_stat.lv_cdn_diag fmy_stat_com_1_vs.err_info_stat.err_sym fmy_stat_com_1_tcs.ctr_abc fmy_stat_com_1_tcs.ctr_end_diag fmy_stat_com_1_tcs.err_info_stat.lv_err_mem fmy_stat_com_1_tcs.err_info_stat.lv_ready fmy_stat_com_1_tcs.err_info_stat.lv_end_diag fmy_stat_com_1_tcs.err_info_stat.lv_cdn_diag fmy_stat_com_1_tcs.err_info_stat.err_sym fmy_stat_com_1_boff.ctr_abc fmy_stat_com_1_boff.ctr_end_diag fmy_stat_com_1_boff.err_info_stat.lv_err_mem fmy_stat_com_1_boff.err_info_stat.lv_ready fmy_stat_com_1_boff.err_info_stat.lv_end_diag fmy_stat_com_1_boff.err_info_stat.lv_cdn_diag fmy_stat_com_1_boff.err_info_stat.err_sym fmy_stat_com_2_efp_crash.ctr_abc fmy_stat_com_2_efp_crash.ctr_end_diag fmy_stat_com_2_efp_crash.err_info_stat.lv_err_mem fmy_stat_com_2_efp_crash.err_info_stat.lv_ready fmy_stat_com_2_efp_crash.err_info_stat.lv_end_diag fmy_stat_com_2_efp_crash.err_info_stat.lv_cdn_diag fmy_stat_com_2_efp_crash.err_info_stat.err_sym fmy_stat_com_2_gb.ctr_abc fmy_stat_com_2_gb.ctr_end_diag fmy_stat_com_2_gb.err_info_stat.lv_err_mem fmy_stat_com_2_gb.err_info_stat.lv_ready fmy_stat_com_2_gb.err_info_stat.lv_end_diag fmy_stat_com_2_gb.err_info_stat.lv_cdn_diag fmy_stat_com_2_gb.err_info_stat.err_sym fmy_stat_com_2_etcu.ctr_abc fmy_stat_com_2_etcu.ctr_end_diag fmy_stat_com_2_etcu.err_info_stat.lv_err_mem fmy_stat_com_2_etcu.err_info_stat.lv_ready fmy_stat_com_2_etcu.err_info_stat.lv_end_diag fmy_stat_com_2_etcu.err_info_stat.lv_cdn_diag fmy_stat_com_2_etcu.err_info_stat.err_sym fmy_stat_com_2_tq_etcu.ctr_abc fmy_stat_com_2_tq_etcu.ctr_end_diag fmy_stat_com_2_tq_etcu.err_info_stat.lv_err_mem fmy_stat_com_2_tq_etcu.err_info_stat.lv_ready fmy_stat_com_2_tq_etcu.err_info_stat.lv_end_diag fmy_stat_com_2_tq_etcu.err_info_stat.lv_cdn_diag fmy_stat_com_2_tq_etcu.err_info_stat.err_sym fmy_stat_com_2_state_veh.ctr_abc fmy_stat_com_2_state_veh.ctr_end_diag fmy_stat_com_2_state_veh.err_info_stat.lv_err_mem fmy_stat_com_2_state_veh.err_info_stat.lv_ready fmy_stat_com_2_state_veh.err_info_stat.lv_end_diag fmy_stat_com_2_state_veh.err_info_stat.lv_cdn_diag fmy_stat_com_2_state_veh.err_info_stat.err_sym fmy_stat_com_2_cas_2.ctr_abc fmy_stat_com_2_cas_2.ctr_end_diag fmy_stat_com_2_cas_2.err_info_stat.lv_err_mem fmy_stat_com_2_cas_2.err_info_stat.lv_ready fmy_stat_com_2_cas_2.err_info_stat.lv_end_diag fmy_stat_com_2_cas_2.err_info_stat.lv_cdn_diag fmy_stat_com_2_cas_2.err_info_stat.err_sym fmy_stat_com_2_acc.ctr_abc fmy_stat_com_2_acc.ctr_end_diag fmy_stat_com_2_acc.err_info_stat.lv_err_mem fmy_stat_com_2_acc.err_info_stat.lv_ready fmy_stat_com_2_acc.err_info_stat.lv_end_diag fmy_stat_com_2_acc.err_info_stat.lv_cdn_diag fmy_stat_com_2_acc.err_info_stat.err_sym fmy_stat_com_2_km_icl.ctr_abc fmy_stat_com_2_km_icl.ctr_end_diag fmy_stat_com_2_km_icl.err_info_stat.lv_err_mem fmy_stat_com_2_km_icl.err_info_stat.lv_ready fmy_stat_com_2_km_icl.err_info_stat.lv_end_diag fmy_stat_com_2_km_icl.err_info_stat.lv_cdn_diag fmy_stat_com_2_km_icl.err_info_stat.err_sym fmy_stat_com_2_t_icl.ctr_abc fmy_stat_com_2_t_icl.ctr_end_diag fmy_stat_com_2_t_icl.err_info_stat.lv_err_mem fmy_stat_com_2_t_icl.err_info_stat.lv_ready fmy_stat_com_2_t_icl.err_info_stat.lv_end_diag fmy_stat_com_2_t_icl.err_info_stat.lv_cdn_diag fmy_stat_com_2_t_icl.err_info_stat.err_sym fmy_stat_com_2_tam_icl.ctr_abc fmy_stat_com_2_tam_icl.ctr_end_diag fmy_stat_com_2_tam_icl.err_info_stat.lv_err_mem fmy_stat_com_2_tam_icl.err_info_stat.lv_ready fmy_stat_com_2_tam_icl.err_info_stat.lv_end_diag fmy_stat_com_2_tam_icl.err_info_stat.lv_cdn_diag fmy_stat_com_2_tam_icl.err_info_stat.err_sym fmy_stat_com_2_t_clk.ctr_abc fmy_stat_com_2_t_clk.ctr_end_diag fmy_stat_com_2_t_clk.err_info_stat.lv_err_mem fmy_stat_com_2_t_clk.err_info_stat.lv_ready fmy_stat_com_2_t_clk.err_info_stat.lv_end_diag fmy_stat_com_2_t_clk.err_info_stat.lv_cdn_diag fmy_stat_com_2_t_clk.err_info_stat.err_sym fmy_stat_com_2_boff.ctr_abc fmy_stat_com_2_boff.ctr_end_diag /end OUT_MEASUREMENT
/end FUNCTION
/end MODULE
/end PROJECT
