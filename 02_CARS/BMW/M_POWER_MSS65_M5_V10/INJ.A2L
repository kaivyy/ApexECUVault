/* File created by ROBGEN 5.33.05.softing - 32bit - Created by Softing AG - Copyright (C) 1995-2002 BMW AG */
/begin PROJECT MSS65-inj "Generiert am 05.06.02 um 07:53:23"
/begin HEADER "" VERSION "R341" /end HEADER
/begin MODULE _MSS65-inj "Generiert am 05.06.02 um 07:53:23"
/* ( interne Register ... ) */
/* leider verschluckt der Robgen noch die Darstellung - wird noch optimiert !! */
/* Formel fuer 1:1-Wiedergabe ohne Einheit */
/begin MOD_PAR "" VERSION "ccp 2.1" ADDR_EPK 0x0 EPK "" SUPPLIER "EE-24" CUSTOMER "ZS-M-52" CUSTOMER_NO "xxx" USER "Q......." ECU "MSS65-INJ" /* Description of memory-segments. There has to be a CODE and DATA-Segment to */ /* support the generation of valid flashable HEX-Files */
 /begin MEMORY_SEGMENT /* The new keyword MEMORY_SEGMENT is */ CODESEG1 "Program" CODE FLASH INTERN 0x0000 0x60000 -1 -1 -1 -1 -1 /end MEMORY_SEGMENT
 /begin MEMORY_SEGMENT /* The new keyword MEMORY_SEGMENT is */ DATASEG1 "Appl.-DATA" DATA FLASH /* Memorytype; RAM wird nicht unterstützt */ INTERN 0x60000 0x10000 -1 -1 -1 -1 -1 /end MEMORY_SEGMENT
 /begin MEMORY_SEGMENT /* The new keyword MEMORY_SEGMENT */ VARSEG "Variablen" VARIABLES RAM INTERN 0x3F9800 0x6800 -1 -1 -1 -1 -1 /end MEMORY_SEGMENT
/end MOD_PAR
/begin MOD_COMMON "" BYTE_ORDER MSB_FIRST /* Default byteorder (Motorola) */ /end MOD_COMMON
/begin IF_DATA ASAP1B_CCP /* spezific definition for CCP */ /* schnelle zeitsynchrone DAQ-Liste */
 /begin SOURCE "5 ms" 3 /* Basic Scale Unit: 3 -> 1ms */ 5 /* Rate: 5 * 1ms = 5ms */
  /begin QP_BLOB /* The QP-BLOB specifies the behavior of*/ 0 LENGTH 20 CAN_ID_FIXED 0x510 RASTER 0 /end QP_BLOB
 /end SOURCE
 /* langsame zeitsynchrone DAQ-Liste */
 /begin SOURCE "100 ms" 5 /* Basic Scale Unit: 5 -> 100ms */ 1 /* Rate: 1 * 100ms = 100ms */
  /begin QP_BLOB /* The QP-BLOB specifies the behavior of*/ 1 LENGTH 10 CAN_ID_FIXED 0x511 RASTER 1 /end QP_BLOB
 /end SOURCE
 /* winkelsynchrone DAQ-Liste */
 /begin SOURCE "segment-synchron" 103 /* Basic Scale Unit: 103 -> Segment */ 1 /* Rate: 1 * Seg = Seg */
  /begin QP_BLOB /* The QP-BLOB specify the behavior of */ 2 LENGTH 10 CAN_ID_FIXED 0x512 RASTER 2 /* noch pruefen!!!! p_wax */ /end QP_BLOB
 /end SOURCE
 /begin RASTER "5ms-Task" "5ms" 0 3 /* Scaling Unit: 3 = 1 msec */ 5 /* Rate in Scaling Unit: 5 */ /end RASTER
 /begin RASTER "100ms-Task" "100ms" 1 5 /* Scaling Unit: 5 = 100 msec */ 1 /* Rate in Scaling Unit: 1 */ /end RASTER
 /begin RASTER "sync-Task" "sync" 2 103 /* Scaling Unit: 103 = cylinder segment */ 1 /* Rate in Scaling Unit: 1 */ /end RASTER
 /begin TP_BLOB /* This BLOB describes all parameters */ /* that are necessary for CAN-timing and*/ /* ECU-calibration-technics */ 0x0201 /* CCP-Version V2.1 => 0x0201 */ 0x0202 /* BLOB-Version V2.2 => 0x0202 */ 0x500 /* CAN-ID INCA -> ECU */ 0x501 /* CAN-ID ECU -> INCA */ 0x1234 /* ECU CCP-Address */ 1 /* Byte-order: 1 - High-Byte-First (MOT)*/ /* 2 - Low-Byte-First(INTEL)*/
  /begin CAN_PARAM /* Interface CAN-Conrtoller settings */ 0x01f4 /* CAN-Baudrate in kBd: 0x01F4 = 500 kBd*/ 0x41 /* Bittimingregister BTR0: 0X41 */ 0x25 /* Bittimingregister BTR1: 0x25 */ /end CAN_PARAM
  /begin DEFINED_PAGES /* Description of the memory-page */ 1 /* Logical-page-number */ "Workingpage" /* Name of page */ 0x0000 /* Address-Extension */ /* (only low-byte sgnificant) */ 0xc60000 /* Address of Memorypage */ 0x10000 /* Memorysize */ RAM RAM_INIT_BY_ECU /* Initialisationmethode: die ECU initialisiert die WP eigenstaendig */ /* INCA vermeidet mit dieser Einstellung das Senden des MOVE-Commands */ /* beim CCP-Session-Login. */ /end DEFINED_PAGES
  /begin DEFINED_PAGES /* Description of the memory-page */ 2 /* Logical-page-number */ "Referenzpage" /* Name of page */ 0x0000 /* Address-Extension */ /* (only low-byte sgnificant) */ 0x60000 /* Address of Memorypage */ 0x10000 /* Memorysize */ ROM RAM_INIT_BY_ECU /* Initialisationmethode: die ECU initialisiert die WP eigenstaendig */ /* INCA vermeidet mit dieser Einstellung das Senden des MOVE-Commands */ /* beim CCP-Session-Login. */ /end DEFINED_PAGES
  OPTIONAL_CMD 0x0C OPTIONAL_CMD 0x0D OPTIONAL_CMD 0x0E OPTIONAL_CMD 0x11 /* optional CCP-command: SELECT_CAL_PAGE */ OPTIONAL_CMD 0x19 /* optional CCP-command of(quatsch! nix 'of') the ECU */ OPTIONAL_CMD 0x12 OPTIONAL_CMD 0x13 /end TP_BLOB
/end IF_DATA
/begin IF_DATA EDIC_ISO_DS2 "V1.0" 0x12 25 1 SUPP_SERVICE READMEM SUPP_SERVICE WRITEMEM SUPP_SERVICE ACK TELDATA 0x9E /end IF_DATA
/* ------------------ Abschnitt erzeugt aus debug.dat ------------------ */
/begin COMPU_METHOD FORMULA_0000 "FORMULA_0000" RAT_FUNC "%5.0" "-" COEFFS 0 1 0 0 0 1 /end COMPU_METHOD
/begin COMPU_METHOD FORMULA_0001 "FORMULA_0001" RAT_FUNC "%7.0" "-" COEFFS 0 1 0 0 0 1 /end COMPU_METHOD
/* ------------------ Abschnitt erzeugt aus eeprom.dat ------------------ */
/begin COMPU_METHOD FORMULA_0002 "FORMULA_0002" TAB_VERB "%3.0" "Seite" COMPU_TAB_REF FORMULA_0002_VTAB /end COMPU_METHOD
/begin COMPU_VTAB FORMULA_0002_VTAB "FORMULA_0002_VTAB" TAB_VERB 1 128 "Keine Daten)" /end COMPU_VTAB
/begin COMPU_METHOD FORMULA_0003 "FORMULA_0003" TAB_VERB "%3.0" "Seite" COMPU_TAB_REF FORMULA_0003_VTAB /end COMPU_METHOD
/begin COMPU_VTAB FORMULA_0003_VTAB "FORMULA_0003_VTAB" TAB_VERB 2 64 "Sektoren voll->A" 96 "Sektoren voll->B" /end COMPU_VTAB
/* ------------------ Abschnitt erzeugt aus glob.dat ------------------ */
/begin COMPU_METHOD FORMULA_0004 "FORMULA_0004" RAT_FUNC "%8.3" "-" COEFFS 0 16384 0 0 0 1 /end COMPU_METHOD
/begin COMPU_METHOD FORMULA_0005 "FORMULA_0005" RAT_FUNC "%5.0" "mg" COEFFS 0 1 0 0 0 1 /end COMPU_METHOD
/begin COMPU_METHOD FORMULA_0006 "FORMULA_0006" RAT_FUNC "%8.3" "-" COEFFS 0 10000 0 0 0 1 /end COMPU_METHOD
/begin COMPU_METHOD FORMULA_0007 "FORMULA_0007" RAT_FUNC "%7.2" "-" COEFFS 0 10000 0 0 0 1 /end COMPU_METHOD
/begin COMPU_METHOD FORMULA_0008 "FORMULA_0008" RAT_FUNC "%3.0" "-" COEFFS 0 1 0 0 0 1 /end COMPU_METHOD
/begin COMPU_METHOD FORMULA_0009 "FORMULA_0009" RAT_FUNC "%6.1" "mg/asp" COEFFS 0 10 0 0 0 1 /end COMPU_METHOD
/begin COMPU_METHOD FORMULA_0010 "FORMULA_0010" RAT_FUNC "%6.1" "kg/h" COEFFS 0 10 0 0 0 1 /end COMPU_METHOD
/begin COMPU_METHOD FORMULA_0011 "FORMULA_0011" RAT_FUNC "%5.0" "Upm" COEFFS 0 1 0 0 0 1 /end COMPU_METHOD
/begin COMPU_METHOD FORMULA_0012 "FORMULA_0012" RAT_FUNC "%5.0" "Upm/s" COEFFS 0 1 0 0 0 1 /end COMPU_METHOD
/begin COMPU_METHOD FORMULA_0013 "FORMULA_0013" RAT_FUNC "%6.1" "km/h" COEFFS 0 16 0 0 0 1 /end COMPU_METHOD
/begin COMPU_METHOD FORMULA_0014 "FORMULA_0014" TAB_VERB "%7.2" "-" COMPU_TAB_REF FORMULA_0014_VTAB /end COMPU_METHOD
/begin COMPU_VTAB FORMULA_0014_VTAB "FORMULA_0014_VTAB" TAB_VERB 5 1 "VL defekt" 2 "VR defekt" 4 "HL defekt" 8 "HR defekt" 15 "alle defekt" /end COMPU_VTAB
/begin COMPU_METHOD FORMULA_0015 "FORMULA_0015" TAB_VERB "%5.2" "-" COMPU_TAB_REF FORMULA_0015_VTAB /end COMPU_METHOD
/begin COMPU_VTAB FORMULA_0015_VTAB "FORMULA_0015_VTAB" TAB_VERB 7 0 "Inaktiv" 1 "Trigger" 2 "Bereit" 3 "Tr+Be" 4 "Aktiv" 7 "Tr+Be+Aktiv" 8 "WE" /end COMPU_VTAB
/begin COMPU_METHOD FORMULA_0016 "FORMULA_0016" RAT_FUNC "%8.3" "bar" COEFFS 0 1000 0 0 0 1 /end COMPU_METHOD
/begin COMPU_METHOD FORMULA_0017 "FORMULA_0017" TAB_VERB "%7.2" "-" COMPU_TAB_REF FORMULA_0017_VTAB /end COMPU_METHOD
/begin COMPU_VTAB FORMULA_0017_VTAB "FORMULA_0017_VTAB" TAB_VERB 15 0 "O.K." 1 "SH_TO_UB" 2 "SH_TO_GND" 4 "OPENLOAD" 8 "UNPLAUSIBEL" 32 "FILTER" 33 "FILTER/SH_TO_UB" 34 "FILTER/SH_TO_GND" 36 "FILTER/OPENLOAD" 40 "FILTER/UNPLAUSIBEL" 96 "FEHLER" 97 "FEHLER/SH_TO_UB" 98 "FEHLER/SH_TO_GND" 100 "FEHLER/OPENLOAD" 104 "FEHLER/UNPLAUSIBEL" /end COMPU_VTAB
/begin COMPU_METHOD FORMULA_0018 "FORMULA_0018" RAT_FUNC "%6.1" "Nm" COEFFS 0 10 0 0 0 1 /end COMPU_METHOD
/begin COMPU_METHOD FORMULA_0019 "FORMULA_0019" RAT_FUNC "%6.1" "øC" COEFFS 0 10 2732 0 0 1 /end COMPU_METHOD
/begin COMPU_METHOD FORMULA_0020 "FORMULA_0020" RAT_FUNC "%7.2" "%" COEFFS 0 16384 0 0 0 100 /end COMPU_METHOD
/begin COMPU_METHOD FORMULA_0021 "FORMULA_0021" TAB_VERB "%7.2" "-" COMPU_TAB_REF FORMULA_0021_VTAB /end COMPU_METHOD
/begin COMPU_VTAB FORMULA_0021_VTAB "FORMULA_0021_VTAB" TAB_VERB 11 1 "Motor steht" 2 "Motor presync" 4 "Start" 8 "LLOKS" 16 "LLMKS" 32 "TL" 64 "VL" 128 "SA" 256 "NL" 512 "Abgew." 1024 "Kl15 aus" DEFAULT_VALUE "undefiniert" /end COMPU_VTAB
/begin COMPU_METHOD FORMULA_0022 "FORMULA_0022" RAT_FUNC "%6.1" "%" COEFFS 0 10 0 0 0 1 /end COMPU_METHOD
/begin COMPU_METHOD FORMULA_0023 "FORMULA_0023" TAB_VERB "%5.2" "-" COMPU_TAB_REF FORMULA_0023_VTAB /end COMPU_METHOD
/begin COMPU_VTAB FORMULA_0023_VTAB "FORMULA_0023_VTAB" TAB_VERB 4 0 "inaktiv" 1 "Momenteneingriff" 2 "Einspritzausblendung" 3 "Md + TT-Eingriff" /end COMPU_VTAB
/begin COMPU_METHOD FORMULA_0024 "FORMULA_0024" RAT_FUNC "%7.2" "-" COEFFS 0 1 0 0 0 1 /end COMPU_METHOD
/begin COMPU_METHOD FORMULA_0025 "FORMULA_0025" TAB_VERB "%7.2" "-" COMPU_TAB_REF FORMULA_0025_VTAB /end COMPU_METHOD
/begin COMPU_VTAB FORMULA_0025_VTAB "FORMULA_0025_VTAB" TAB_VERB 2 0 "BLS aus" 1 "BLS ein" /end COMPU_VTAB
/begin COMPU_METHOD FORMULA_0026 "FORMULA_0026" TAB_VERB "%7.2" "-" COMPU_TAB_REF FORMULA_0026_VTAB /end COMPU_METHOD
/begin COMPU_VTAB FORMULA_0026_VTAB "FORMULA_0026_VTAB" TAB_VERB 2 0 "offen" 2 "Kraftschluss" /end COMPU_VTAB
/begin COMPU_METHOD FORMULA_0027 "FORMULA_0027" TAB_VERB "%7.2" "-" COMPU_TAB_REF FORMULA_0027_VTAB /end COMPU_METHOD
/begin COMPU_VTAB FORMULA_0027_VTAB "FORMULA_0027_VTAB" TAB_VERB 2 0 "offen" 4 "Kraftschluss" /end COMPU_VTAB
/begin COMPU_METHOD FORMULA_0028 "FORMULA_0028" TAB_VERB "%7.2" "-" COMPU_TAB_REF FORMULA_0028_VTAB /end COMPU_METHOD
/begin COMPU_VTAB FORMULA_0028_VTAB "FORMULA_0028_VTAB" TAB_VERB 2 0 "Kl15 aus" 8 "Kl15 ein" /end COMPU_VTAB
/begin COMPU_METHOD FORMULA_0029 "FORMULA_0029" TAB_VERB "%7.2" "-" COMPU_TAB_REF FORMULA_0029_VTAB /end COMPU_METHOD
/begin COMPU_VTAB FORMULA_0029_VTAB "FORMULA_0029_VTAB" TAB_VERB 2 0 "Sport aus" 16 "Sport ein" /end COMPU_VTAB
/begin COMPU_METHOD FORMULA_0030 "FORMULA_0030" TAB_VERB "%7.2" "-" COMPU_TAB_REF FORMULA_0030_VTAB /end COMPU_METHOD
/begin COMPU_VTAB FORMULA_0030_VTAB "FORMULA_0030_VTAB" TAB_VERB 2 0 "Komfort" 64 "Sport" /end COMPU_VTAB
/begin COMPU_METHOD FORMULA_0031 "FORMULA_0031" RAT_FUNC "%6.1" "mbar" COEFFS 0 16 0 0 0 1 /end COMPU_METHOD
/begin COMPU_METHOD FORMULA_0032 "FORMULA_0032" TAB_VERB "%5.2" "-" COMPU_TAB_REF FORMULA_0032_VTAB /end COMPU_METHOD
/begin COMPU_VTAB FORMULA_0032_VTAB "FORMULA_0032_VTAB" TAB_VERB 4 0 "in Ordnung" 1 "kein Wert empf." 128 "Err/TUMG" 129 "Fehler/TAN" /end COMPU_VTAB
/begin COMPU_METHOD FORMULA_0033 "FORMULA_0033" RAT_FUNC "%9.2" "min" COEFFS 0 60 0 0 0 1 /end COMPU_METHOD
/begin COMPU_METHOD FORMULA_0034 "FORMULA_0034" RAT_FUNC "%5.0" "Tage" COEFFS 0 1 0 0 0 1 /end COMPU_METHOD
/begin COMPU_METHOD FORMULA_0035 "FORMULA_0035" RAT_FUNC "%8.3" "-" COEFFS 0 1024 0 0 0 1 /end COMPU_METHOD
/begin COMPU_METHOD FORMULA_0036 "FORMULA_0036" RAT_FUNC "%3.0" ".Gang" COEFFS 0 1 0 0 0 1 /end COMPU_METHOD
/begin COMPU_METHOD FORMULA_0037 "FORMULA_0037" RAT_FUNC "%6.1" "ø" COEFFS 0 10 0 0 0 1 /end COMPU_METHOD
/begin COMPU_METHOD FORMULA_0038 "FORMULA_0038" TAB_VERB "%7.2" "-" COMPU_TAB_REF FORMULA_0038_VTAB /end COMPU_METHOD
/begin COMPU_VTAB FORMULA_0038_VTAB "FORMULA_0038_VTAB" TAB_VERB 4 0 "O.K." 1 "LLS-Fehler" 2 "DK-Fehler" 4 "WDK-Fehler" DEFAULT_VALUE "Mehrfachfehler" /end COMPU_VTAB
/begin COMPU_METHOD FORMULA_0039 "FORMULA_0039" TAB_VERB "%5.2" "-" COMPU_TAB_REF FORMULA_0039_VTAB /end COMPU_METHOD
/begin COMPU_VTAB FORMULA_0039_VTAB "FORMULA_0039_VTAB" TAB_VERB 2 0 "kein Kickdown" 1 "Kickdown" /end COMPU_VTAB
/begin COMPU_METHOD FORMULA_0040 "FORMULA_0040" TAB_VERB "%3.0" "-" COMPU_TAB_REF FORMULA_0040_VTAB /end COMPU_METHOD
/begin COMPU_VTAB FORMULA_0040_VTAB "FORMULA_0040_VTAB" TAB_VERB 6 0 "O.K." 1 "Kanalfilter" 2 "Kanalfehler" 3 "PWG2_Fehler" 4 "PWG1_Fehler" 5 "Totalausfall" DEFAULT_VALUE "undefiniert" /end COMPU_VTAB
/begin COMPU_METHOD FORMULA_0041 "FORMULA_0041" TAB_VERB "%7.2" "-" COMPU_TAB_REF FORMULA_0041_VTAB /end COMPU_METHOD
/begin COMPU_VTAB FORMULA_0041_VTAB "FORMULA_0041_VTAB" TAB_VERB 2 0 "BLTS aus" 2 "BLTS ein" /end COMPU_VTAB
/begin COMPU_METHOD FORMULA_0042 "FORMULA_0042" TAB_VERB "%7.2" "-" COMPU_TAB_REF FORMULA_0042_VTAB /end COMPU_METHOD
/begin COMPU_VTAB FORMULA_0042_VTAB "FORMULA_0042_VTAB" TAB_VERB 2 0 "Kl15 aus" 4 "Kl15 ein" /end COMPU_VTAB
/begin COMPU_METHOD FORMULA_0043 "FORMULA_0043" TAB_VERB "%7.2" "-" COMPU_TAB_REF FORMULA_0043_VTAB /end COMPU_METHOD
/begin COMPU_VTAB FORMULA_0043_VTAB "FORMULA_0043_VTAB" TAB_VERB 2 0 "Kl87 aus" 8 "Kl87 ein" /end COMPU_VTAB
/begin COMPU_METHOD FORMULA_0044 "FORMULA_0044" TAB_VERB "%7.2" "-" COMPU_TAB_REF FORMULA_0044_VTAB /end COMPU_METHOD
/begin COMPU_VTAB FORMULA_0044_VTAB "FORMULA_0044_VTAB" TAB_VERB 2 0 "Kl50 aus" 16 "Kl50 ein" /end COMPU_VTAB
/begin COMPU_METHOD FORMULA_0045 "FORMULA_0045" RAT_FUNC "%6.1" "V" COEFFS 0 10 0 0 0 1 /end COMPU_METHOD
/begin COMPU_METHOD FORMULA_0046 "FORMULA_0046" RAT_FUNC "%7.2" "V" COEFFS 0 1966080 0 0 0 200 /end COMPU_METHOD
/begin COMPU_METHOD FORMULA_0047 "FORMULA_0047" RAT_FUNC "%5.2" "-" COEFFS 0 1 0 0 0 1 /end COMPU_METHOD
/begin COMPU_METHOD FORMULA_0048 "FORMULA_0048" TAB_VERB "%5.2" "-" COMPU_TAB_REF FORMULA_0048_VTAB /end COMPU_METHOD
/begin COMPU_VTAB FORMULA_0048_VTAB "FORMULA_0048_VTAB" TAB_VERB 2 0 "Kein KATS_B1" 1 "KATS_B1" /end COMPU_VTAB
/begin COMPU_METHOD FORMULA_0049 "FORMULA_0049" TAB_VERB "%5.2" "-" COMPU_TAB_REF FORMULA_0049_VTAB /end COMPU_METHOD
/begin COMPU_VTAB FORMULA_0049_VTAB "FORMULA_0049_VTAB" TAB_VERB 2 0 "Kein KATS_B2" 2 "KATS_B2" /end COMPU_VTAB
/begin COMPU_METHOD FORMULA_0050 "FORMULA_0050" TAB_VERB "%5.2" "-" COMPU_TAB_REF FORMULA_0050_VTAB /end COMPU_METHOD
/begin COMPU_VTAB FORMULA_0050_VTAB "FORMULA_0050_VTAB" TAB_VERB 2 0 "Abregeln_B1" 4 "Aufregeln_B1" /end COMPU_VTAB
/begin COMPU_METHOD FORMULA_0051 "FORMULA_0051" TAB_VERB "%5.2" "-" COMPU_TAB_REF FORMULA_0051_VTAB /end COMPU_METHOD
/begin COMPU_VTAB FORMULA_0051_VTAB "FORMULA_0051_VTAB" TAB_VERB 2 0 "Abregeln_B2" 8 "Aufregeln_B2" /end COMPU_VTAB
/begin COMPU_METHOD FORMULA_0052 "FORMULA_0052" TAB_VERB "%5.2" "-" COMPU_TAB_REF FORMULA_0052_VTAB /end COMPU_METHOD
/begin COMPU_VTAB FORMULA_0052_VTAB "FORMULA_0052_VTAB" TAB_VERB 2 0 "kein INIT" 128 "INIT" /end COMPU_VTAB
/begin COMPU_METHOD FORMULA_0053 "FORMULA_0053" TAB_VERB "%7.2" "-" COMPU_TAB_REF FORMULA_0053_VTAB /end COMPU_METHOD
/begin COMPU_VTAB FORMULA_0053_VTAB "FORMULA_0053_VTAB" TAB_VERB 2 0 "kein Abbruch" 1 "Abbruch" /end COMPU_VTAB
/begin COMPU_METHOD FORMULA_0054 "FORMULA_0054" TAB_VERB "%7.2" "-" COMPU_TAB_REF FORMULA_0054_VTAB /end COMPU_METHOD
/begin COMPU_VTAB FORMULA_0054_VTAB "FORMULA_0054_VTAB" TAB_VERB 2 0 "in Ordnung" 2 "Fehler" /end COMPU_VTAB
/begin COMPU_METHOD FORMULA_0055 "FORMULA_0055" TAB_VERB "%7.2" "-" COMPU_TAB_REF FORMULA_0055_VTAB /end COMPU_METHOD
/begin COMPU_VTAB FORMULA_0055_VTAB "FORMULA_0055_VTAB" TAB_VERB 2 0 "nicht geprueft" 4 "Sensor OK" /end COMPU_VTAB
/begin COMPU_METHOD FORMULA_0056 "FORMULA_0056" TAB_VERB "%7.2" "-" COMPU_TAB_REF FORMULA_0056_VTAB /end COMPU_METHOD
/begin COMPU_VTAB FORMULA_0056_VTAB "FORMULA_0056_VTAB" TAB_VERB 2 0 "nicht geprueft" 8 "offen" /end COMPU_VTAB
/begin COMPU_METHOD FORMULA_0057 "FORMULA_0057" TAB_VERB "%7.2" "-" COMPU_TAB_REF FORMULA_0057_VTAB /end COMPU_METHOD
/begin COMPU_VTAB FORMULA_0057_VTAB "FORMULA_0057_VTAB" TAB_VERB 2 0 "nicht geprueft" 16 "unlpausibel" /end COMPU_VTAB
/begin COMPU_METHOD FORMULA_0058 "FORMULA_0058" TAB_VERB "%7.2" "-" COMPU_TAB_REF FORMULA_0058_VTAB /end COMPU_METHOD
/begin COMPU_VTAB FORMULA_0058_VTAB "FORMULA_0058_VTAB" TAB_VERB 2 0 "kein Blockheater" 32 "Blockheater" /end COMPU_VTAB
/begin COMPU_METHOD FORMULA_0059 "FORMULA_0059" TAB_VERB "%7.2" "-" COMPU_TAB_REF FORMULA_0059_VTAB /end COMPU_METHOD
/begin COMPU_VTAB FORMULA_0059_VTAB "FORMULA_0059_VTAB" TAB_VERB 2 0 "normale Fkt." 64 "Zwangseinschalten" /end COMPU_VTAB
/begin COMPU_METHOD FORMULA_0060 "FORMULA_0060" TAB_VERB "%7.2" "-" COMPU_TAB_REF FORMULA_0060_VTAB /end COMPU_METHOD
/begin COMPU_VTAB FORMULA_0060_VTAB "FORMULA_0060_VTAB" TAB_VERB 2 0 "nicht geprueft" 128 "Thermo OK" /end COMPU_VTAB
/begin COMPU_METHOD FORMULA_0061 "FORMULA_0061" TAB_VERB "%7.2" "-" COMPU_TAB_REF FORMULA_0061_VTAB /end COMPU_METHOD
/begin COMPU_VTAB FORMULA_0061_VTAB "FORMULA_0061_VTAB" TAB_VERB 2 0 "keine INIT" 256 "initialisiert" /end COMPU_VTAB
/begin COMPU_METHOD FORMULA_0062 "FORMULA_0062" TAB_VERB "%7.2" "-" COMPU_TAB_REF FORMULA_0062_VTAB /end COMPU_METHOD
/begin COMPU_VTAB FORMULA_0062_VTAB "FORMULA_0062_VTAB" TAB_VERB 2 0 "kein Stop" 512 "Stop" /end COMPU_VTAB
/begin COMPU_METHOD FORMULA_0063 "FORMULA_0063" TAB_VERB "%7.2" "-" COMPU_TAB_REF FORMULA_0063_VTAB /end COMPU_METHOD
/begin COMPU_VTAB FORMULA_0063_VTAB "FORMULA_0063_VTAB" TAB_VERB 2 0 "Rampe startet" 32768 "Rampe laeuft" /end COMPU_VTAB
/begin COMPU_METHOD FORMULA_0064 "FORMULA_0064" TAB_VERB "%3.0" "-" COMPU_TAB_REF FORMULA_0064_VTAB /end COMPU_METHOD
/begin COMPU_VTAB FORMULA_0064_VTAB "FORMULA_0064_VTAB" TAB_VERB 3 0 "in Ordnung" 1 "Uebertemperatur" 2 "Wartezeit" /end COMPU_VTAB
/begin COMPU_METHOD FORMULA_0065 "FORMULA_0065" TAB_VERB "%5.2" "-" COMPU_TAB_REF FORMULA_0065_VTAB /end COMPU_METHOD
/begin COMPU_VTAB FORMULA_0065_VTAB "FORMULA_0065_VTAB" TAB_VERB 2 0 "nicht abgeschl." 1 "abgeschl." /end COMPU_VTAB
/begin COMPU_METHOD FORMULA_0066 "FORMULA_0066" TAB_VERB "%5.2" "-" COMPU_TAB_REF FORMULA_0066_VTAB /end COMPU_METHOD
/begin COMPU_VTAB FORMULA_0066_VTAB "FORMULA_0066_VTAB" TAB_VERB 2 0 "KL15 aus" 2 "KL15 an" /end COMPU_VTAB
/begin COMPU_METHOD FORMULA_0067 "FORMULA_0067" TAB_VERB "%3.0" "-" COMPU_TAB_REF FORMULA_0067_VTAB /end COMPU_METHOD
/begin COMPU_VTAB FORMULA_0067_VTAB "FORMULA_0067_VTAB" TAB_VERB 6 17 "FP im RAM" 51 "FP warten" 119 "FP fertig" 136 "Rueckflashen" 170 "RF warten" 238 "RF fertig" /end COMPU_VTAB
/* ------------------ Abschnitt erzeugt aus adapt_inj.dat ------------------ */
/begin COMPU_METHOD FORMULA_0084 "FORMULA_0084" RAT_FUNC "%7.0" "mal" COEFFS 0 1 0 0 0 1 /end COMPU_METHOD
/begin COMPU_METHOD FORMULA_0085 "FORMULA_0085" RAT_FUNC "%5.0" "VERS" COEFFS 0 1 0 0 0 1 /end COMPU_METHOD
/begin COMPU_METHOD FORMULA_0086 "FORMULA_0086" RAT_FUNC "%7.2" "mg" COEFFS 0 32 0 0 0 1 /end COMPU_METHOD
/begin COMPU_METHOD FORMULA_0087 "FORMULA_0087" RAT_FUNC "%9.4" "-" COEFFS 0 32768 0 0 0 1 /end COMPU_METHOD
/begin COMPU_METHOD FORMULA_0088 "FORMULA_0088" RAT_FUNC "%8.3" "mg/ASP" COEFFS 0 64 0 0 0 1 /end COMPU_METHOD
/begin COMPU_METHOD FORMULA_0089 "FORMULA_0089" RAT_FUNC "%5.0" "mV" COEFFS 0 1024 0 0 0 5000 /end COMPU_METHOD
/begin COMPU_METHOD FORMULA_0090 "FORMULA_0090" RAT_FUNC "%7.0" "s" COEFFS 0 1 0 0 0 1 /end COMPU_METHOD
/* ------------------ Abschnitt erzeugt aus elu.dat ------------------ */
/begin COMPU_METHOD FORMULA_0104 "FORMULA_0104" TAB_VERB "%3.0" "-" COMPU_TAB_REF FORMULA_0104_VTAB /end COMPU_METHOD
/begin COMPU_VTAB FORMULA_0104_VTAB "FORMULA_0104_VTAB" TAB_VERB 2 0 "ELU aus" 64 "ELU ein" /end COMPU_VTAB
/begin COMPU_METHOD FORMULA_0105 "FORMULA_0105" RAT_FUNC "%3.0" "%" COEFFS 0 1 0 0 0 1 /end COMPU_METHOD
/begin COMPU_METHOD FORMULA_0106 "FORMULA_0106" RAT_FUNC "%5.0" "%" COEFFS 0 1 0 0 0 1 /end COMPU_METHOD
/begin COMPU_METHOD FORMULA_0107 "FORMULA_0107" RAT_FUNC "%6.1" "Kelvin" COEFFS 0 10 0 0 0 1 /end COMPU_METHOD
/begin COMPU_METHOD FORMULA_0108 "FORMULA_0108" RAT_FUNC "%5.2" "s" COEFFS 0 0 25.6 0 1 0 /end COMPU_METHOD
/begin COMPU_METHOD FORMULA_0109 "FORMULA_0109" RAT_FUNC "%5.0" "ms" COEFFS 0 1 0 0 0 10 /end COMPU_METHOD
/begin COMPU_METHOD FORMULA_0110 "FORMULA_0110" RAT_FUNC "%8.3" "-" COEFFS 0 128 0 0 0 1 /end COMPU_METHOD
/* ------------------ Abschnitt erzeugt aus gang.dat ------------------ */
/begin COMPU_METHOD FORMULA_0111 "FORMULA_0111" RAT_FUNC "%6.1" "U/kmh" COEFFS 0 10 0 0 0 1 /end COMPU_METHOD
/* ------------------ Abschnitt erzeugt aus hfm.dat ------------------ */
/begin COMPU_METHOD FORMULA_0112 "FORMULA_0112" RAT_FUNC "%5.0" "digit" COEFFS 0 1 0 0 0 1 /end COMPU_METHOD
/begin COMPU_METHOD FORMULA_0113 "FORMULA_0113" RAT_FUNC "%3.0" "z/asp" COEFFS 0 1 0 0 0 1 /end COMPU_METHOD
/begin COMPU_METHOD FORMULA_0114 "FORMULA_0114" RAT_FUNC "%7.2" "s" COEFFS 0 0 25.6 0 1 0 /end COMPU_METHOD
/begin COMPU_METHOD FORMULA_0115 "FORMULA_0115" RAT_FUNC "%5.2" "s" COEFFS 0 0 2.56 0 1 0 /end COMPU_METHOD
/* ------------------ Abschnitt erzeugt aus kva.dat ------------------ */
/begin COMPU_METHOD FORMULA_0118 "FORMULA_0118" RAT_FUNC "%9.2" "-" COEFFS 0 1 0 0 0 1 /end COMPU_METHOD
/begin COMPU_METHOD FORMULA_0119 "FORMULA_0119" RAT_FUNC "%6.1" "kg/m³" COEFFS 0 10 0 0 0 1 /end COMPU_METHOD
/begin COMPU_METHOD FORMULA_0120 "FORMULA_0120" RAT_FUNC "%8.3" "-" COEFFS 0 256 0 0 0 1 /end COMPU_METHOD
/begin COMPU_METHOD FORMULA_0125 "FORMULA_0125" RAT_FUNC "%7.2" "mg" COEFFS 0 64 0 0 0 1 /end COMPU_METHOD
/begin COMPU_METHOD FORMULA_0135 "FORMULA_0135" RAT_FUNC "%7.2" "ms" COEFFS 0 1000 0 0 0 1 /end COMPU_METHOD
/begin COMPU_METHOD FORMULA_0144 "FORMULA_0144" RAT_FUNC "%7.2" "mg" COEFFS 0 10 0 0 0 1 /end COMPU_METHOD
/begin COMPU_METHOD FORMULA_0145 "FORMULA_0145" RAT_FUNC "%5.0" "sec" COEFFS 0 1 0 0 0 1 /end COMPU_METHOD
/begin COMPU_METHOD FORMULA_0146 "FORMULA_0146" RAT_FUNC "%6.1" "°C" COEFFS 0 10 0 0 0 1 /end COMPU_METHOD
/begin COMPU_METHOD FORMULA_0150 "FORMULA_0150" RAT_FUNC "%7.2" "-" COEFFS 0 128 0 0 0 1 /end COMPU_METHOD
/* ------------------ Abschnitt erzeugt aus n_inj.dat ------------------ */
/begin COMPU_METHOD FORMULA_0165 "FORMULA_0165" RAT_FUNC "%7.2" "ms" COEFFS 0 625 0 0 0 1 /end COMPU_METHOD
/begin COMPU_METHOD FORMULA_0166 "FORMULA_0166" TAB_VERB "%5.2" "-" COMPU_TAB_REF FORMULA_0166_VTAB /end COMPU_METHOD
/begin COMPU_VTAB FORMULA_0166_VTAB "FORMULA_0166_VTAB" TAB_VERB 4 0 "in Ordnung" 30 "Segment gesperrt" 31 "inaktiv" 95 "eingefroren" DEFAULT_VALUE "Stoerung" /end COMPU_VTAB
/begin COMPU_METHOD FORMULA_0167 "FORMULA_0167" RAT_FUNC "%5.2" "s" COEFFS 0 100 0 0 0 1 /end COMPU_METHOD
/begin COMPU_METHOD FORMULA_0168 "FORMULA_0168" RAT_FUNC "%5.0" ".Gang" COEFFS 0 1 0 0 0 1 /end COMPU_METHOD
/* ------------------ Abschnitt erzeugt aus rg.dat ------------------ */
/begin COMPU_METHOD FORMULA_0187 "FORMULA_0187" RAT_FUNC "%7.2" "ms" COEFFS 0 100 0 0 0 1 /end COMPU_METHOD
/begin COMPU_METHOD FORMULA_0188 "FORMULA_0188" RAT_FUNC "%6.1" "øKW" COEFFS 0 10 0 0 0 1 /end COMPU_METHOD
/* ------------------ Abschnitt erzeugt aus ti.dat ------------------ */
/begin COMPU_METHOD FORMULA_0205 "FORMULA_0205" RAT_FUNC "%7.2" "mg" COEFFS 0 16 0 0 0 1 /end COMPU_METHOD
/begin COMPU_METHOD FORMULA_0206 "FORMULA_0206" RAT_FUNC "%8.3" "mg/ms" COEFFS 0 1024 0 0 0 1 /end COMPU_METHOD
/begin COMPU_METHOD FORMULA_0207 "FORMULA_0207" RAT_FUNC "%7.2" "m/s" COEFFS 0 10 0 0 0 1 /end COMPU_METHOD
/begin COMPU_METHOD FORMULA_0208 "FORMULA_0208" TAB_VERB "%7.2" "-" COMPU_TAB_REF FORMULA_0208_VTAB /end COMPU_METHOD
/begin COMPU_VTAB FORMULA_0208_VTAB "FORMULA_0208_VTAB" TAB_VERB 27 1 "Heisstart" 2 "Kaltstart" 4 "WKS" 8 "Normalstart" 16 "Flag-WKS gesetzt" 17 "HS/FLAG_WKS" 18 "KS/FLAG_WKS" 20 "WKS/FLAG_WKS" 24 "NS/FLAG_WKS" 32 "B1" 33 "Heisstart/B1" 34 "Kaltstart/B1" 36 "WKS/B1" 40 "Normalstart/B1" 49 "HS/B1/FLAG_WKS" 50 "KS/B1/FLAG_WKS" 52 "WKS/B1/FLAG_WKS" 56 "NS/B1/FLAG_WKS" 64 "B2" 65 "Heisstart/B2" 66 "Kaltstart/B2" 68 "WKS/B2" 72 "Normalstart/B2" 81 "HS/B2/FLAG_WKS" 82 "KS/B2/FLAG_WKS" 84 "WKS/B2/FLAG_WKS" 88 "NS/B2/FLAG_WKS" DEFAULT_VALUE "kein Start" /end COMPU_VTAB
/begin COMPU_METHOD FORMULA_0209 "FORMULA_0209" RAT_FUNC "%8.3" "m2/s2" COEFFS 0 40 0 0 0 1 /end COMPU_METHOD
/begin COMPU_METHOD FORMULA_0210 "FORMULA_0210" RAT_FUNC "%7.2" "mm2" COEFFS 0 10 0 0 0 1 /end COMPU_METHOD
/begin COMPU_METHOD FORMULA_0211 "FORMULA_0211" RAT_FUNC "%7.2" "mm" COEFFS 0 10 0 0 0 1 /end COMPU_METHOD
/begin COMPU_METHOD FORMULA_0212 "FORMULA_0212" RAT_FUNC "%7.2" "kg/dm3" COEFFS 0 100 0 0 0 1 /end COMPU_METHOD
/begin COMPU_METHOD FORMULA_0213 "FORMULA_0213" RAT_FUNC "%9.4" "m" COEFFS 0 16384 0 0 0 1 /end COMPU_METHOD
/begin COMPU_METHOD FORMULA_0214 "FORMULA_0214" RAT_FUNC "%5.0" "1/NO-Umdr." COEFFS 0 1 0 0 0 1 /end COMPU_METHOD
/begin COMPU_METHOD FORMULA_0215 "FORMULA_0215" RAT_FUNC "%7.2" "ms" COEFFS 0 64 0 0 0 10 /end COMPU_METHOD
/begin COMPU_METHOD FORMULA_0216 "FORMULA_0216" RAT_FUNC "%5.0" "1/No-Udr." COEFFS 0 1 0 0 0 1 /end COMPU_METHOD
/begin COMPU_METHOD FORMULA_0217 "FORMULA_0217" RAT_FUNC "%7.2" "s" COEFFS 0 1 0 0 0 1 /end COMPU_METHOD
/begin COMPU_METHOD FORMULA_0218 "FORMULA_0218" RAT_FUNC "%5.0" "-" COEFFS 0 -1 1 0 0 -1 /end COMPU_METHOD
/* ------------------ Abschnitt erzeugt aus eeprom.dat ------------------ */
/begin MEASUREMENT eeprom_seite_lesen "Wo wurde der letzte Datensatz gefunden" UBYTE FORMULA_0002 0 0 0.0 255.0 ECU_ADDRESS 0x3FB62E /begin FUNCTION_LIST EEPROM /end FUNCTION_LIST /end MEASUREMENT
/begin MEASUREMENT eeprom_seite_lesen_hdw "Wo wurde der letzte HDW-Datensatz gefunden" UBYTE FORMULA_0002 0 0 0.0 255.0 ECU_ADDRESS 0x3FB62F /begin FUNCTION_LIST EEPROM /end FUNCTION_LIST /end MEASUREMENT
/begin MEASUREMENT eeprom_seite_schreiben "Wo hin soll der naechste Datensatz geschrieben werden" UBYTE FORMULA_0003 0 0 0.0 255.0 ECU_ADDRESS 0x3FB630 /begin FUNCTION_LIST EEPROM /end FUNCTION_LIST /end MEASUREMENT
/* ------------------ Abschnitt erzeugt aus glob.dat ------------------ */
/begin MEASUREMENT lam_ist_mw_b1 "Mittelwert IST-Lambda" UWORD FORMULA_0004 0 0 0.0 3.9990 ECU_ADDRESS 0x3F9978 /begin FUNCTION_LIST Global /end FUNCTION_LIST /end MEASUREMENT
/begin MEASUREMENT lam_ist_mw_b2 "Mittelwert IST-Lambda" UWORD FORMULA_0004 0 0 0.0 3.9990 ECU_ADDRESS 0x3F997A /begin FUNCTION_LIST Global /end FUNCTION_LIST /end MEASUREMENT
/begin MEASUREMENT lam_soll_ms_kat_b1 "gespeicherte Sauerstoffmasse im KAT" SWORD FORMULA_0005 0 0 -32768.0000 32767.0000 ECU_ADDRESS 0x3F997C /begin FUNCTION_LIST Global /end FUNCTION_LIST /end MEASUREMENT
/begin MEASUREMENT lam_soll_ms_kat_b2 "gespeicherte Sauerstoffmasse im KAT" SWORD FORMULA_0005 0 0 -32768.0000 32767.0000 ECU_ADDRESS 0x3F997E /begin FUNCTION_LIST Global /end FUNCTION_LIST /end MEASUREMENT
/begin MEASUREMENT lam_delta_lim_1of2_ "begrenzte Regelabweichung" SWORD FORMULA_0004 0 0 -2.0000 1.9999 ECU_ADDRESS 0x3F9980 /begin FUNCTION_LIST Global /end FUNCTION_LIST /end MEASUREMENT
/begin MEASUREMENT lam_delta_lim_2of2_ "begrenzte Regelabweichung" SWORD FORMULA_0004 0 0 -2.0000 1.9999 ECU_ADDRESS 0x3F9982 /begin FUNCTION_LIST Global /end FUNCTION_LIST /end MEASUREMENT
/begin MEASUREMENT rf_b1 "relative Fuellung" SWORD FORMULA_0006 0 0 0.0 2.0000 ECU_ADDRESS 0x3F9984 /begin FUNCTION_LIST Global /end FUNCTION_LIST /end MEASUREMENT
/begin MEASUREMENT rf_b2 "relative Fuellung" SWORD FORMULA_0006 0 0 0.0 2.0000 ECU_ADDRESS 0x3F9986 /begin FUNCTION_LIST Global /end FUNCTION_LIST /end MEASUREMENT
/begin MEASUREMENT rg_x_1of2_ "Restgasgehalt" SWORD FORMULA_0007 0 0 -0.1000 0.5000 ECU_ADDRESS 0x3F9988 /begin FUNCTION_LIST Global /end FUNCTION_LIST /end MEASUREMENT
/begin MEASUREMENT rg_x_2of2_ "Restgasgehalt" SWORD FORMULA_0007 0 0 -0.1000 0.5000 ECU_ADDRESS 0x3F998A /begin FUNCTION_LIST Global /end FUNCTION_LIST /end MEASUREMENT
/begin MEASUREMENT rg_x_m "gem. Restgasgehalt" SWORD FORMULA_0007 0 0 -0.1000 0.5000 ECU_ADDRESS 0x3F998C /begin FUNCTION_LIST Global /end FUNCTION_LIST /end MEASUREMENT
/begin MEASUREMENT rg_x_m_stat "gem. Restgasgehalt" SWORD FORMULA_0007 0 0 -0.1000 0.5000 ECU_ADDRESS 0x3F998E /begin FUNCTION_LIST Global /end FUNCTION_LIST /end MEASUREMENT
/begin MEASUREMENT ti_ausblend_ist_b1 "Zyl-Ausblendung pro Bank" UBYTE FORMULA_0008 0 0 0.0 255.0000 ECU_ADDRESS 0x3F9994 /begin FUNCTION_LIST Global /end FUNCTION_LIST /end MEASUREMENT
/begin MEASUREMENT ti_ausblend_ist_b2 "Zyl-Ausblendung pro Bank" UBYTE FORMULA_0008 0 0 0.0 255.0000 ECU_ADDRESS 0x3F9995 /begin FUNCTION_LIST Global /end FUNCTION_LIST /end MEASUREMENT
/begin MEASUREMENT rg_m_av_max "Restgasmasse ueber Auslaß nach Einlaß oeffnen" SWORD FORMULA_0009 0 0 -500.0000 1500.0000 ECU_ADDRESS 0x3F9996 /begin FUNCTION_LIST Global /end FUNCTION_LIST /end MEASUREMENT
/begin MEASUREMENT ml_b1 "Luftmassenstrom" SWORD FORMULA_0010 0 0 -100.0000 1400.0000 ECU_ADDRESS 0x3F9998 /begin FUNCTION_LIST Global /end FUNCTION_LIST /end MEASUREMENT
/begin MEASUREMENT ml_b2 "Luftmassenstrom" SWORD FORMULA_0010 0 0 -100.0000 1400.0000 ECU_ADDRESS 0x3F999A /begin FUNCTION_LIST Global /end FUNCTION_LIST /end MEASUREMENT
/begin MEASUREMENT rf_m "relative Fuellung Mittel zwischen Bank 1 und 2" SWORD FORMULA_0006 0 0 0.0 2.0000 ECU_ADDRESS 0x3F999C /begin FUNCTION_LIST Global /end FUNCTION_LIST /end MEASUREMENT
/begin MEASUREMENT ml_ges "Luftmassenstrom Bank 1 und 2" SWORD FORMULA_0010 0 0 -100.0000 1400.0000 ECU_ADDRESS 0x3F999E /begin FUNCTION_LIST Global /end FUNCTION_LIST /end MEASUREMENT
/begin MEASUREMENT rps_zyl_nr "Zylinder-RPS" UBYTE FORMULA_0008 0 0 0.0 255.0000 ECU_ADDRESS 0x3F99A0 /begin FUNCTION_LIST Global /end FUNCTION_LIST /end MEASUREMENT
/begin MEASUREMENT rps_ionen_st "Status Ionen-RPS" UWORD FORMULA_0000 0 0 0.0 65535.0000 ECU_ADDRESS 0x3F99A2 /begin FUNCTION_LIST Global /end FUNCTION_LIST /end MEASUREMENT
/begin MEASUREMENT rps_ionen_stufe "Stufe Ionen-RPS" UWORD FORMULA_0000 0 0 0.0 65535.0000 ECU_ADDRESS 0x3F99A4 /begin FUNCTION_LIST Global /end FUNCTION_LIST /end MEASUREMENT
/begin MEASUREMENT rps_auss_st "Status Aussetzer-RPS" UWORD FORMULA_0000 0 0 0.0 65535.0000 ECU_ADDRESS 0x3F99A6 /begin FUNCTION_LIST Global /end FUNCTION_LIST /end MEASUREMENT
/begin MEASUREMENT n "Motordrehzahl" SWORD FORMULA_0011 0 0 0.0 10000.0000 ECU_ADDRESS 0x3F99A8 /begin FUNCTION_LIST Global /end FUNCTION_LIST /end MEASUREMENT
/begin MEASUREMENT dn_segment "Drehzahlgradient" SWORD FORMULA_0012 0 0 -10000.0000 10000.0000 ECU_ADDRESS 0x3F99AA /begin FUNCTION_LIST Global /end FUNCTION_LIST /end MEASUREMENT
/begin MEASUREMENT dn_asp "Drehzahlgradient (Arbeitsspiel)" SWORD FORMULA_0012 0 0 -10000.0000 10000.0000 ECU_ADDRESS 0x3F99AC /begin FUNCTION_LIST Global /end FUNCTION_LIST /end MEASUREMENT
/begin MEASUREMENT lam_soll_vl_max "Soll-Lambda bei max VL" UWORD FORMULA_0004 0 0 0.0 3.9990 ECU_ADDRESS 0x3F99AE /begin FUNCTION_LIST Global /end FUNCTION_LIST /end MEASUREMENT
/begin MEASUREMENT v_rad_vl "v-Rad vorne-links" SWORD FORMULA_0013 0 0 -360.0000 360.0000 ECU_ADDRESS 0x3F99B0 /begin FUNCTION_LIST Global /end FUNCTION_LIST /end MEASUREMENT
/begin MEASUREMENT v_rad_vr "v-Rad vorne-rechts" SWORD FORMULA_0013 0 0 -360.0000 360.0000 ECU_ADDRESS 0x3F99B2 /begin FUNCTION_LIST Global /end FUNCTION_LIST /end MEASUREMENT
/begin MEASUREMENT v_rad_hl "v-Rad hinten-links" SWORD FORMULA_0013 0 0 -360.0000 360.0000 ECU_ADDRESS 0x3F99B4 /begin FUNCTION_LIST Global /end FUNCTION_LIST /end MEASUREMENT
/begin MEASUREMENT v_rad_hr "v-Rad hinten-rechts" SWORD FORMULA_0013 0 0 -360.0000 360.0000 ECU_ADDRESS 0x3F99B6 /begin FUNCTION_LIST Global /end FUNCTION_LIST /end MEASUREMENT
/begin MEASUREMENT v_rad_st "v-Rad-Status" UWORD FORMULA_0014 0 0 0.0 65535.0 ECU_ADDRESS 0x3F99B8 /begin FUNCTION_LIST Global /end FUNCTION_LIST /end MEASUREMENT
/begin MEASUREMENT v_vorne "v-Vorderachse" SWORD FORMULA_0013 0 0 -360.0000 360.0000 ECU_ADDRESS 0x3F99BA /begin FUNCTION_LIST Global /end FUNCTION_LIST /end MEASUREMENT
/begin MEASUREMENT v_hinten "v-Hinterachse" SWORD FORMULA_0013 0 0 -360.0000 360.0000 ECU_ADDRESS 0x3F99BC /begin FUNCTION_LIST Global /end FUNCTION_LIST /end MEASUREMENT
/begin MEASUREMENT sa_we_st "SAWE-Status" UBYTE FORMULA_0015 0 0 0.0 255.0 ECU_ADDRESS 0x3F99BE /begin FUNCTION_LIST Global /end FUNCTION_LIST /end MEASUREMENT
/begin MEASUREMENT pks_ist "Kraftstoffdruck, absolut, gefiltert" SWORD FORMULA_0016 0 0 0.0 10.0000 ECU_ADDRESS 0x3F99C0 /begin FUNCTION_LIST Global /end FUNCTION_LIST /end MEASUREMENT
/begin MEASUREMENT pks_ed "Eigendiagnose Kraftstoffdruck" UWORD FORMULA_0017 0 0 0.0 111.0 ECU_ADDRESS 0x3F99C2 /begin FUNCTION_LIST Global /end FUNCTION_LIST BIT_MASK 0x6F /end MEASUREMENT
/begin MEASUREMENT rps_cfg "Auswahl RPS-Modell" UBYTE FORMULA_0008 0 0 0.0 255.0000 ECU_ADDRESS 0x3F99C4 /begin FUNCTION_LIST Global /end FUNCTION_LIST /end MEASUREMENT
/begin MEASUREMENT rps_rec1_cnt "Rec1-Fehlerzaehler" UBYTE FORMULA_0008 0 0 0.0 255.0000 ECU_ADDRESS 0x3F99C5 /begin FUNCTION_LIST Global /end FUNCTION_LIST /end MEASUREMENT
/begin MEASUREMENT rps_rec2_cnt "Rec2-Fehlerzaehler" UBYTE FORMULA_0008 0 0 0.0 255.0000 ECU_ADDRESS 0x3F99C6 /begin FUNCTION_LIST Global /end FUNCTION_LIST /end MEASUREMENT
/begin MEASUREMENT rps_llr_st "Status LLR-RPS" UBYTE FORMULA_0008 0 0 0.0 255.0000 ECU_ADDRESS 0x3F99C7 /begin FUNCTION_LIST Global /end FUNCTION_LIST /end MEASUREMENT
/begin MEASUREMENT rps_llr_md_p "P-Anteil LLR-RPS" SWORD FORMULA_0018 0 0 -100.0000 1000.0000 ECU_ADDRESS 0x3F99C8 /begin FUNCTION_LIST Global /end FUNCTION_LIST /end MEASUREMENT
/begin MEASUREMENT rps_llr_md_i "I-Anteil LLR-RPS" SWORD FORMULA_0018 0 0 -100.0000 1000.0000 ECU_ADDRESS 0x3F99CA /begin FUNCTION_LIST Global /end FUNCTION_LIST /end MEASUREMENT
/begin MEASUREMENT rps_llr_md_tz "TZ-Anteil LLR-RPS" SWORD FORMULA_0018 0 0 -100.0000 1000.0000 ECU_ADDRESS 0x3F99CC /begin FUNCTION_LIST Global /end FUNCTION_LIST /end MEASUREMENT
/begin MEASUREMENT rps_llr_md_ad "Adaptionswert LLR-RPS" SWORD FORMULA_0018 0 0 -100.0000 1000.0000 ECU_ADDRESS 0x3F99CE /begin FUNCTION_LIST Global /end FUNCTION_LIST /end MEASUREMENT
/begin MEASUREMENT rps_llr_n_soll "Sollwert LLR-RPS" SWORD FORMULA_0011 0 0 0.0 10000.0000 ECU_ADDRESS 0x3F99D0 /begin FUNCTION_LIST Global /end FUNCTION_LIST /end MEASUREMENT
/begin MEASUREMENT tks "Kraftstofftemperatur" SWORD FORMULA_0019 0 0 -50.0000 150.0000 ECU_ADDRESS 0x3F99D2 /begin FUNCTION_LIST Global /end FUNCTION_LIST /end MEASUREMENT
/begin MEASUREMENT tks_ed "Eigendiagnose Kraftstofftemperatur" UWORD FORMULA_0017 0 0 0.0 111.0 ECU_ADDRESS 0x3F99D4 /begin FUNCTION_LIST Global /end FUNCTION_LIST BIT_MASK 0x6F /end MEASUREMENT
/begin MEASUREMENT can_kkos_md "Md-Aufnahme KKOS" SWORD FORMULA_0018 0 0 -100.0000 1000.0000 ECU_ADDRESS 0x3F99D6 /begin FUNCTION_LIST Global /end FUNCTION_LIST /end MEASUREMENT
/begin MEASUREMENT dr_rel_1of2_ "relative Drosselung" SWORD FORMULA_0020 0 0 0.0 199.9938 ECU_ADDRESS 0x3F99D8 /begin FUNCTION_LIST Global /end FUNCTION_LIST /end MEASUREMENT
/begin MEASUREMENT dr_rel_2of2_ "relative Drosselung" SWORD FORMULA_0020 0 0 0.0 199.9938 ECU_ADDRESS 0x3F99DA /begin FUNCTION_LIST Global /end FUNCTION_LIST /end MEASUREMENT
/begin MEASUREMENT zustand_motor "Betriebszustand der Motorsteuerung" UWORD FORMULA_0021 0 0 0.0 65535.0 ECU_ADDRESS 0x3F99DC /begin FUNCTION_LIST Global /end FUNCTION_LIST /end MEASUREMENT
/begin MEASUREMENT zust_md_rel_tl_vl "rel. Übergangsmoment TL-VL" SWORD FORMULA_0022 0 0 0.0 100.0000 ECU_ADDRESS 0x3F99DE /begin FUNCTION_LIST Global /end FUNCTION_LIST /end MEASUREMENT
/begin MEASUREMENT n_begr_st "Statusvariable Drehzahlbegrenzung" UBYTE FORMULA_0023 0 0 0.0 8.0 ECU_ADDRESS 0x3F99E0 /begin FUNCTION_LIST Global /end FUNCTION_LIST /end MEASUREMENT
/begin MEASUREMENT schalter_st_inj "Schalterstatus" UWORD FORMULA_0024 0 0 0.0 65535.0000 ECU_ADDRESS 0x3F99E2 /begin FUNCTION_LIST Global /end FUNCTION_LIST /end MEASUREMENT
/begin MEASUREMENT schalter_bls_inj "Schalterstatus" UWORD FORMULA_0025 0 0 0.0 65535.0 ECU_ADDRESS 0x3F99E2 /begin FUNCTION_LIST Global /end FUNCTION_LIST BIT_MASK 0x1 /end MEASUREMENT
/begin MEASUREMENT schalter_kupplung "Schalterstatus" UWORD FORMULA_0026 0 0 0.0 65535.0 ECU_ADDRESS 0x3F99E2 /begin FUNCTION_LIST Global /end FUNCTION_LIST BIT_MASK 0x2 /end MEASUREMENT
/begin MEASUREMENT schalter_getriebe "Schalterstatus" UWORD FORMULA_0027 0 0 0.0 65535.0 ECU_ADDRESS 0x3F99E2 /begin FUNCTION_LIST Global /end FUNCTION_LIST BIT_MASK 0x4 /end MEASUREMENT
/begin MEASUREMENT schalter_kl15_inj "Schalterstatus" UWORD FORMULA_0028 0 0 0.0 65535.0 ECU_ADDRESS 0x3F99E2 /begin FUNCTION_LIST Global /end FUNCTION_LIST BIT_MASK 0x8 /end MEASUREMENT
/begin MEASUREMENT schalter_sport "Schalterstatus" UWORD FORMULA_0029 0 0 0.0 65535.0 ECU_ADDRESS 0x3F99E2 /begin FUNCTION_LIST Global /end FUNCTION_LIST BIT_MASK 0x10 /end MEASUREMENT
/begin MEASUREMENT schalter_zustand_sport "Schalterstatus" UWORD FORMULA_0030 0 0 0.0 65535.0 ECU_ADDRESS 0x3F99E2 /begin FUNCTION_LIST Global /end FUNCTION_LIST BIT_MASK 0x40 /end MEASUREMENT
/begin MEASUREMENT pumg "Gefilterter Messwert" SWORD FORMULA_0031 0 0 400.0000 1200.0000 ECU_ADDRESS 0x3F99E8 /begin FUNCTION_LIST Global /end FUNCTION_LIST /end MEASUREMENT
/begin MEASUREMENT pumg_ed "Eigendiagnose Umgebungsdruck" UWORD FORMULA_0017 0 0 0.0 111.0 ECU_ADDRESS 0x3F99EA /begin FUNCTION_LIST Global /end FUNCTION_LIST BIT_MASK 0x6F /end MEASUREMENT
/begin MEASUREMENT tumg "Umgebungstemperatur" SWORD FORMULA_0019 0 0 -50.0000 150.0000 ECU_ADDRESS 0x3F99F4 /begin FUNCTION_LIST Global /end FUNCTION_LIST /end MEASUREMENT
/begin MEASUREMENT tumg_st "Status Umgebungstemperatur" UBYTE FORMULA_0032 0 0 0.0 255.0 ECU_ADDRESS 0x3F99F6 /begin FUNCTION_LIST Global /end FUNCTION_LIST /end MEASUREMENT
/begin MEASUREMENT time_rel "Relativzeit" ULONG FORMULA_0033 0 0 0.0 35791394.1166 ECU_ADDRESS 0x3F99F8 /begin FUNCTION_LIST Global /end FUNCTION_LIST /end MEASUREMENT
/begin MEASUREMENT time_abs "Absolutzeit seit 1.1.2000" UWORD FORMULA_0034 0 0 0.0 65535.0000 ECU_ADDRESS 0x3F99FC /begin FUNCTION_LIST Global /end FUNCTION_LIST /end MEASUREMENT
/begin MEASUREMENT time_ms "Zeit seit Motor steht" ULONG FORMULA_0033 0 0 0.0 35791394.1166 ECU_ADDRESS 0x3F9A00 /begin FUNCTION_LIST Global /end FUNCTION_LIST /end MEASUREMENT
/begin MEASUREMENT time_ml "3HaxenSchnurrZeit" ULONG FORMULA_0033 0 0 0.0 35791394.1166 ECU_ADDRESS 0x3F9A04 /begin FUNCTION_LIST Global /end FUNCTION_LIST /end MEASUREMENT
/begin MEASUREMENT rf_pt_korr "Korrektur der relativen Fuellung" UWORD FORMULA_0035 0 0 0.0 4.0000 ECU_ADDRESS 0x3F9A08 /begin FUNCTION_LIST Global /end FUNCTION_LIST /end MEASUREMENT
/begin MEASUREMENT gang "Gang" SBYTE FORMULA_0036 0 0 -1.0000 10.0000 ECU_ADDRESS 0x3F9A0A /begin FUNCTION_LIST Global /end FUNCTION_LIST /end MEASUREMENT
/begin MEASUREMENT tz_zyl_ti "Zylinder selektive Abschaltung der Einspritzung" UWORD FORMULA_0024 0 0 0.0 65535.0000 ECU_ADDRESS 0x3F9A0C /begin FUNCTION_LIST Global /end FUNCTION_LIST /end MEASUREMENT
/begin MEASUREMENT egas_ist_wdk_b1 "Istwert (analog)" SWORD FORMULA_0022 0 0 -10.0000 120.0000 ECU_ADDRESS 0x3F9A0E /begin FUNCTION_LIST Global /end FUNCTION_LIST /end MEASUREMENT
/begin MEASUREMENT egas_ist_wdk_b2 "Istwert (analog)" SWORD FORMULA_0022 0 0 -10.0000 120.0000 ECU_ADDRESS 0x3F9A10 /begin FUNCTION_LIST Global /end FUNCTION_LIST /end MEASUREMENT
/begin MEASUREMENT md_kupp_ist_ve "Moment an der Kupplung vor Eingriff" SWORD FORMULA_0018 0 0 -100.0000 1000.0000 ECU_ADDRESS 0x3F9A12 /begin FUNCTION_LIST Global /end FUNCTION_LIST /end MEASUREMENT
/begin MEASUREMENT md_kupp_ist "Moment an der Kupplung" SWORD FORMULA_0018 0 0 -100.0000 1000.0000 ECU_ADDRESS 0x3F9A14 /begin FUNCTION_LIST Global /end FUNCTION_LIST /end MEASUREMENT
/begin MEASUREMENT md_ind_ne "ind. Moment nach Eingriff" SWORD FORMULA_0018 0 0 -100.0000 1000.0000 ECU_ADDRESS 0x3F9A16 /begin FUNCTION_LIST Global /end FUNCTION_LIST /end MEASUREMENT
/begin MEASUREMENT md_tz_soll_mittel "mittlerer Soll-TZ" SWORD FORMULA_0037 0 0 -50.0000 60.0000 ECU_ADDRESS 0x3F9A18 /begin FUNCTION_LIST Global /end FUNCTION_LIST /end MEASUREMENT
/begin MEASUREMENT md_fw_rel "rel. Wunschmoment" SWORD FORMULA_0022 0 0 0.0 100.0000 ECU_ADDRESS 0x3F9A1C /begin FUNCTION_LIST Global /end FUNCTION_LIST /end MEASUREMENT
/begin MEASUREMENT md_wunsch_rel "Ergebnis der Max-Auswahl" SWORD FORMULA_0022 0 0 0.0 100.0000 ECU_ADDRESS 0x3F9A1E /begin FUNCTION_LIST Global /end FUNCTION_LIST /end MEASUREMENT
/begin MEASUREMENT md_kupp_wunsch_begr "begrenztes Wunschmoment" SWORD FORMULA_0018 0 0 -100.0000 1000.0000 ECU_ADDRESS 0x3F9A20 /begin FUNCTION_LIST Global /end FUNCTION_LIST /end MEASUREMENT
/begin MEASUREMENT md_st "MD-Stati" UWORD FORMULA_0000 0 0 0.0 65535.0000 ECU_ADDRESS 0x3F9A22 /begin FUNCTION_LIST Global /end FUNCTION_LIST /end MEASUREMENT
/begin MEASUREMENT egas_soll_dk_b1 "DK-Sollwert" SWORD FORMULA_0022 0 0 -10.0000 120.0000 ECU_ADDRESS 0x3F9A24 /begin FUNCTION_LIST Global /end FUNCTION_LIST /end MEASUREMENT
/begin MEASUREMENT egas_soll_dk_b2 "DK-Sollwert" SWORD FORMULA_0022 0 0 -10.0000 120.0000 ECU_ADDRESS 0x3F9A26 /begin FUNCTION_LIST Global /end FUNCTION_LIST /end MEASUREMENT
/begin MEASUREMENT egas_soll_lls_b1 "LLS-Sollwert" SWORD FORMULA_0022 0 0 -10.0000 120.0000 ECU_ADDRESS 0x3F9A28 /begin FUNCTION_LIST Global /end FUNCTION_LIST /end MEASUREMENT
/begin MEASUREMENT egas_soll_lls_b2 "LLS-Sollwert" SWORD FORMULA_0022 0 0 -10.0000 120.0000 ECU_ADDRESS 0x3F9A2A /begin FUNCTION_LIST Global /end FUNCTION_LIST /end MEASUREMENT
/begin MEASUREMENT egas_ist_dk_b1 "Istwert (CAN)" SWORD FORMULA_0022 0 0 -10.0000 120.0000 ECU_ADDRESS 0x3F9A2C /begin FUNCTION_LIST Global /end FUNCTION_LIST /end MEASUREMENT
/begin MEASUREMENT egas_ist_dk_b2 "Istwert (CAN)" SWORD FORMULA_0022 0 0 -10.0000 120.0000 ECU_ADDRESS 0x3F9A2E /begin FUNCTION_LIST Global /end FUNCTION_LIST /end MEASUREMENT
/begin MEASUREMENT egas_ist_lls_b1 "Istwert (CAN)" SWORD FORMULA_0022 0 0 -10.0000 120.0000 ECU_ADDRESS 0x3F9A30 /begin FUNCTION_LIST Global /end FUNCTION_LIST /end MEASUREMENT
/begin MEASUREMENT egas_ist_lls_b2 "Istwert (CAN)" SWORD FORMULA_0022 0 0 -10.0000 120.0000 ECU_ADDRESS 0x3F9A32 /begin FUNCTION_LIST Global /end FUNCTION_LIST /end MEASUREMENT
/begin MEASUREMENT egas_ist_st_b1 "Status Istwerte" UWORD FORMULA_0038 0 0 0.0 65535.0 ECU_ADDRESS 0x3F9A34 /begin FUNCTION_LIST Global /end FUNCTION_LIST /end MEASUREMENT
/begin MEASUREMENT egas_ist_st_b2 "Status Istwerte" UWORD FORMULA_0038 0 0 0.0 65535.0 ECU_ADDRESS 0x3F9A36 /begin FUNCTION_LIST Global /end FUNCTION_LIST /end MEASUREMENT
/begin MEASUREMENT egas_ist_wdk_rf_b1 "Fuellung aus WDK" SWORD FORMULA_0006 0 0 0.0 2.0000 ECU_ADDRESS 0x3F9A38 /begin FUNCTION_LIST Global /end FUNCTION_LIST /end MEASUREMENT
/begin MEASUREMENT egas_ist_wdk_rf_b2 "Fuellung aus WDK" SWORD FORMULA_0006 0 0 0.0 2.0000 ECU_ADDRESS 0x3F9A3A /begin FUNCTION_LIST Global /end FUNCTION_LIST /end MEASUREMENT
/begin MEASUREMENT egas_ist_lls_rf_b1 "Fuellung aus LLS" SWORD FORMULA_0006 0 0 0.0 2.0000 ECU_ADDRESS 0x3F9A3C /begin FUNCTION_LIST Global /end FUNCTION_LIST /end MEASUREMENT
/begin MEASUREMENT egas_ist_lls_rf_b2 "Fuellung aus LLS" SWORD FORMULA_0006 0 0 0.0 2.0000 ECU_ADDRESS 0x3F9A3E /begin FUNCTION_LIST Global /end FUNCTION_LIST /end MEASUREMENT
/begin MEASUREMENT pwg_kd_st "Kickdown-Status" UBYTE FORMULA_0008 0 0 0.0 255.0000 ECU_ADDRESS 0x3F9A40 /begin FUNCTION_LIST Global /end FUNCTION_LIST BIT_MASK 0x1 /end MEASUREMENT
/begin MEASUREMENT pwg_kd_st_kickdown "Kickdown-Status" UBYTE FORMULA_0039 0 0 0.0 255.0 ECU_ADDRESS 0x3F9A40 /begin FUNCTION_LIST Global /end FUNCTION_LIST BIT_MASK 0x1 /end MEASUREMENT
/begin MEASUREMENT pwg_mode "Ausgabezustand der Pedalwertgebererfassung" UBYTE FORMULA_0040 0 0 0.0 255.0 ECU_ADDRESS 0x3F9A41 /begin FUNCTION_LIST Global /end FUNCTION_LIST /end MEASUREMENT
/begin MEASUREMENT schalter_st_ign "Schalterstatus" UWORD FORMULA_0024 0 0 0.0 65535.0000 ECU_ADDRESS 0x3F9A44 /begin FUNCTION_LIST Global /end FUNCTION_LIST /end MEASUREMENT
/begin MEASUREMENT schalter_bls_ign "Schalterstatus" UWORD FORMULA_0025 0 0 0.0 65535.0 ECU_ADDRESS 0x3F9A44 /begin FUNCTION_LIST Global /end FUNCTION_LIST BIT_MASK 0x1 /end MEASUREMENT
/begin MEASUREMENT schalter_blts "Schalterstatus" UWORD FORMULA_0041 0 0 0.0 65535.0 ECU_ADDRESS 0x3F9A44 /begin FUNCTION_LIST Global /end FUNCTION_LIST BIT_MASK 0x2 /end MEASUREMENT
/begin MEASUREMENT schalter_kl15 "Schalterstatus" UWORD FORMULA_0042 0 0 0.0 65535.0 ECU_ADDRESS 0x3F9A44 /begin FUNCTION_LIST Global /end FUNCTION_LIST BIT_MASK 0x4 /end MEASUREMENT
/begin MEASUREMENT schalter_kl87 "Schalterstatus" UWORD FORMULA_0043 0 0 0.0 65535.0 ECU_ADDRESS 0x3F9A44 /begin FUNCTION_LIST Global /end FUNCTION_LIST BIT_MASK 0x8 /end MEASUREMENT
/begin MEASUREMENT schalter_kl50 "Schalterstatus" UWORD FORMULA_0044 0 0 0.0 65535.0 ECU_ADDRESS 0x3F9A44 /begin FUNCTION_LIST Global /end FUNCTION_LIST BIT_MASK 0x10 /end MEASUREMENT
/begin MEASUREMENT ub_15 "Spannungswert U_KL15" SWORD FORMULA_0045 0 0 0.0 28.0000 ECU_ADDRESS 0x3F9A46 /begin FUNCTION_LIST Global /end FUNCTION_LIST /end MEASUREMENT
/begin MEASUREMENT ub "Spannungswert U_KL87" SWORD FORMULA_0045 0 0 0.0 28.0000 ECU_ADDRESS 0x3F9A48 /begin FUNCTION_LIST Global /end FUNCTION_LIST /end MEASUREMENT
/begin MEASUREMENT ub_15_ed "Eigendiagnose U_KL15" UWORD FORMULA_0017 0 0 0.0 111.0 ECU_ADDRESS 0x3F9A4A /begin FUNCTION_LIST Global /end FUNCTION_LIST BIT_MASK 0x6F /end MEASUREMENT
/begin MEASUREMENT ub_ed "Eigendiagnose U_KL87" UWORD FORMULA_0017 0 0 0.0 111.0 ECU_ADDRESS 0x3F9A4C /begin FUNCTION_LIST Global /end FUNCTION_LIST BIT_MASK 0x6F /end MEASUREMENT
/begin MEASUREMENT uext_pin_m18 "Versorgungsspannung" UWORD FORMULA_0046 0 0 0.0 6.6665 ECU_ADDRESS 0x3F9A4E /begin FUNCTION_LIST Global /end FUNCTION_LIST /end MEASUREMENT
/begin MEASUREMENT uext_pin_m66 "Versorgungsspannung" UWORD FORMULA_0046 0 0 0.0 6.6665 ECU_ADDRESS 0x3F9A50 /begin FUNCTION_LIST Global /end FUNCTION_LIST /end MEASUREMENT
/begin MEASUREMENT uext_pin_f43 "Versorgungsspannung" UWORD FORMULA_0046 0 0 0.0 6.6665 ECU_ADDRESS 0x3F9A52 /begin FUNCTION_LIST Global /end FUNCTION_LIST /end MEASUREMENT
/begin MEASUREMENT uext_pin_f56 "Versorgungsspannung" UWORD FORMULA_0046 0 0 0.0 6.6665 ECU_ADDRESS 0x3F9A54 /begin FUNCTION_LIST Global /end FUNCTION_LIST /end MEASUREMENT
/begin MEASUREMENT uext_korr_pin_m18 "Korrekturfaktor fuer UEXT" UWORD FORMULA_0035 0 0 0.0 4.0000 ECU_ADDRESS 0x3F9A56 /begin FUNCTION_LIST Global /end FUNCTION_LIST /end MEASUREMENT
/begin MEASUREMENT uext_korr_pin_m66 "Korrekturfaktor fuer UEXT" UWORD FORMULA_0035 0 0 0.0 4.0000 ECU_ADDRESS 0x3F9A58 /begin FUNCTION_LIST Global /end FUNCTION_LIST /end MEASUREMENT
/begin MEASUREMENT uext_korr_pin_f43 "Korrekturfaktor fuer UEXT" UWORD FORMULA_0035 0 0 0.0 4.0000 ECU_ADDRESS 0x3F9A5A /begin FUNCTION_LIST Global /end FUNCTION_LIST /end MEASUREMENT
/begin MEASUREMENT uext_korr_pin_f56 "Korrekturfaktor fuer UEXT" UWORD FORMULA_0035 0 0 0.0 4.0000 ECU_ADDRESS 0x3F9A5C /begin FUNCTION_LIST Global /end FUNCTION_LIST /end MEASUREMENT
/begin MEASUREMENT uext_ed_pin_m18 "Eigendiagnose UEXT" UWORD FORMULA_0017 0 0 0.0 111.0 ECU_ADDRESS 0x3F9A5E /begin FUNCTION_LIST Global /end FUNCTION_LIST BIT_MASK 0x6F /end MEASUREMENT
/begin MEASUREMENT uext_ed_pin_m66 "Eigendiagnose UEXT" UWORD FORMULA_0017 0 0 0.0 111.0 ECU_ADDRESS 0x3F9A60 /begin FUNCTION_LIST Global /end FUNCTION_LIST BIT_MASK 0x6F /end MEASUREMENT
/begin MEASUREMENT uext_ed_pin_f43 "Eigendiagnose UEXT" UWORD FORMULA_0017 0 0 0.0 111.0 ECU_ADDRESS 0x3F9A62 /begin FUNCTION_LIST Global /end FUNCTION_LIST BIT_MASK 0x6F /end MEASUREMENT
/begin MEASUREMENT uext_ed_pin_f56 "Eigendiagnose UEXT" UWORD FORMULA_0017 0 0 0.0 111.0 ECU_ADDRESS 0x3F9A64 /begin FUNCTION_LIST Global /end FUNCTION_LIST BIT_MASK 0x6F /end MEASUREMENT
/begin MEASUREMENT md_kupp_min "Minimalmoment an der Kupplung" SWORD FORMULA_0018 0 0 -100.0000 1000.0000 ECU_ADDRESS 0x3F9A66 /begin FUNCTION_LIST Global /end FUNCTION_LIST /end MEASUREMENT
/begin MEASUREMENT llr_n_soll "Leerlaufdrehzahl" SWORD FORMULA_0011 0 0 0.0 10000.0000 ECU_ADDRESS 0x3F9A6C /begin FUNCTION_LIST Global /end FUNCTION_LIST /end MEASUREMENT
/begin MEASUREMENT md_sk_ti_st "SK-Ausblendmaske" UWORD FORMULA_0000 0 0 0.0 65535.0000 ECU_ADDRESS 0x3F9A6E /begin FUNCTION_LIST Global /end FUNCTION_LIST /end MEASUREMENT
/begin MEASUREMENT tz_min "minimal zulaessiger Zuendwinkel" SWORD FORMULA_0037 0 0 -50.0000 60.0000 ECU_ADDRESS 0x3F9A70 /begin FUNCTION_LIST Global /end FUNCTION_LIST /end MEASUREMENT
/begin MEASUREMENT tabg_b1 "Abgastemperatur" SWORD FORMULA_0019 0 0 -50.0000 1250.0000 ECU_ADDRESS 0x3F9A72 /begin FUNCTION_LIST Global /end FUNCTION_LIST /end MEASUREMENT
/begin MEASUREMENT tabg_b2 "Abgastemperatur" SWORD FORMULA_0019 0 0 -50.0000 1250.0000 ECU_ADDRESS 0x3F9A74 /begin FUNCTION_LIST Global /end FUNCTION_LIST /end MEASUREMENT
/begin MEASUREMENT tabg_lw_b1 "Abgastemperatur Ladungswechsel" SWORD FORMULA_0019 0 0 -50.0000 1250.0000 ECU_ADDRESS 0x3F9A76 /begin FUNCTION_LIST Global /end FUNCTION_LIST /end MEASUREMENT
/begin MEASUREMENT tabg_lw_b2 "Abgastemperatur Ladungswechsel" SWORD FORMULA_0019 0 0 -50.0000 1250.0000 ECU_ADDRESS 0x3F9A78 /begin FUNCTION_LIST Global /end FUNCTION_LIST /end MEASUREMENT
/begin MEASUREMENT tabg_vkat_b1 "Abgastemperatur vorm Kat" SWORD FORMULA_0019 0 0 -50.0000 1250.0000 ECU_ADDRESS 0x3F9A7A /begin FUNCTION_LIST Global /end FUNCTION_LIST /end MEASUREMENT
/begin MEASUREMENT tabg_vkat_b2 "Abgastemperatur vorm Kat" SWORD FORMULA_0019 0 0 -50.0000 1250.0000 ECU_ADDRESS 0x3F9A7C /begin FUNCTION_LIST Global /end FUNCTION_LIST /end MEASUREMENT
/begin MEASUREMENT tabg_mkat_b1 "Abgastemperatur in der Katmitte" SWORD FORMULA_0019 0 0 -50.0000 1250.0000 ECU_ADDRESS 0x3F9A7E /begin FUNCTION_LIST Global /end FUNCTION_LIST /end MEASUREMENT
/begin MEASUREMENT tabg_mkat_b2 "Abgastemperatur in der Katmitte" SWORD FORMULA_0019 0 0 -50.0000 1250.0000 ECU_ADDRESS 0x3F9A80 /begin FUNCTION_LIST Global /end FUNCTION_LIST /end MEASUREMENT
/begin MEASUREMENT tabg_mkat_mw "Abgastemperaturmittelwert in der Katmitte" SWORD FORMULA_0019 0 0 -50.0000 1250.0000 ECU_ADDRESS 0x3F9A82 /begin FUNCTION_LIST Global /end FUNCTION_LIST /end MEASUREMENT
/begin MEASUREMENT tabg_nkat_b1 "Abgastemperatur nach dem Kat" SWORD FORMULA_0019 0 0 -50.0000 1250.0000 ECU_ADDRESS 0x3F9A84 /begin FUNCTION_LIST Global /end FUNCTION_LIST /end MEASUREMENT
/begin MEASUREMENT tabg_nkat_b2 "Abgastemperatur nach dem Kat" SWORD FORMULA_0019 0 0 -50.0000 1250.0000 ECU_ADDRESS 0x3F9A86 /begin FUNCTION_LIST Global /end FUNCTION_LIST /end MEASUREMENT
/begin MEASUREMENT tabg_lw_verh_b1 "Verhaeltnis der Ladungswechseltemperaturen" UWORD FORMULA_0035 0 0 0.0 4.0000 ECU_ADDRESS 0x3F9A88 /begin FUNCTION_LIST Global /end FUNCTION_LIST /end MEASUREMENT
/begin MEASUREMENT tabg_lw_verh_b2 "Verhaeltnis der Ladungswechseltemperaturen" UWORD FORMULA_0035 0 0 0.0 4.0000 ECU_ADDRESS 0x3F9A8A /begin FUNCTION_LIST Global /end FUNCTION_LIST /end MEASUREMENT
/begin MEASUREMENT tabg_lw_verh_wurzel_b1 "Wurzel-Verhaeltnis der Ladungswechseltemperaturen" UWORD FORMULA_0035 0 0 0.0 4.0000 ECU_ADDRESS 0x3F9A8C /begin FUNCTION_LIST Global /end FUNCTION_LIST /end MEASUREMENT
/begin MEASUREMENT tabg_lw_verh_wurzel_b2 "Wurzel-Verhaeltnis der Ladungswechseltemperaturen" UWORD FORMULA_0035 0 0 0.0 4.0000 ECU_ADDRESS 0x3F9A8E /begin FUNCTION_LIST Global /end FUNCTION_LIST /end MEASUREMENT
/begin MEASUREMENT tabg_ed_b1 "Eigendiagnose Abgastemperatur" UWORD FORMULA_0017 0 0 0.0 111.0 ECU_ADDRESS 0x3F9A90 /begin FUNCTION_LIST Global /end FUNCTION_LIST BIT_MASK 0x6F /end MEASUREMENT
/begin MEASUREMENT tabg_ed_b2 "Eigendiagnose Abgastemperatur" UWORD FORMULA_0017 0 0 0.0 111.0 ECU_ADDRESS 0x3F9A92 /begin FUNCTION_LIST Global /end FUNCTION_LIST BIT_MASK 0x6F /end MEASUREMENT
/begin MEASUREMENT tabg_st "TABG-Status" UBYTE FORMULA_0047 0 0 0.0 255.0000 ECU_ADDRESS 0x3F9A94 /begin FUNCTION_LIST Global /end FUNCTION_LIST /end MEASUREMENT
/begin MEASUREMENT tabg_st_kats_b1 "Katschutz Bank 1" UBYTE FORMULA_0048 0 0 0.0 255.0 ECU_ADDRESS 0x3F9A94 /begin FUNCTION_LIST Global /end FUNCTION_LIST BIT_MASK 0x1 /end MEASUREMENT
/begin MEASUREMENT tabg_st_kats_b2 "Katschutz Bank 2" UBYTE FORMULA_0049 0 0 0.0 255.0 ECU_ADDRESS 0x3F9A94 /begin FUNCTION_LIST Global /end FUNCTION_LIST BIT_MASK 0x2 /end MEASUREMENT
/begin MEASUREMENT tabg_st_aufregeln_b1 "Kat-Enthalpie Bank 1" UBYTE FORMULA_0050 0 0 0.0 255.0 ECU_ADDRESS 0x3F9A94 /begin FUNCTION_LIST Global /end FUNCTION_LIST BIT_MASK 0x4 /end MEASUREMENT
/begin MEASUREMENT tabg_st_aufregeln_b2 "Kat-Enthalpie Bank 2" UBYTE FORMULA_0051 0 0 0.0 255.0 ECU_ADDRESS 0x3F9A94 /begin FUNCTION_LIST Global /end FUNCTION_LIST BIT_MASK 0x8 /end MEASUREMENT
/begin MEASUREMENT tabg_st_init "TABG-Init-Status" UBYTE FORMULA_0052 0 0 0.0 255.0 ECU_ADDRESS 0x3F9A94 /begin FUNCTION_LIST Global /end FUNCTION_LIST BIT_MASK 0x80 /end MEASUREMENT
/begin MEASUREMENT tan_b1 "Ansauglufttemperatur" SWORD FORMULA_0019 0 0 -50.0000 150.0000 ECU_ADDRESS 0x3F9A96 /begin FUNCTION_LIST Global /end FUNCTION_LIST /end MEASUREMENT
/begin MEASUREMENT tan_b2 "Ansauglufttemperatur" SWORD FORMULA_0019 0 0 -50.0000 150.0000 ECU_ADDRESS 0x3F9A98 /begin FUNCTION_LIST Global /end FUNCTION_LIST /end MEASUREMENT
/begin MEASUREMENT tan_ed_b1 "Eigendiagnose Ansauglufttemperatur" UWORD FORMULA_0017 0 0 0.0 111.0 ECU_ADDRESS 0x3F9A9A /begin FUNCTION_LIST Global /end FUNCTION_LIST BIT_MASK 0x6F /end MEASUREMENT
/begin MEASUREMENT tan_ed_b2 "Eigendiagnose Ansauglufttemperatur" UWORD FORMULA_0017 0 0 0.0 111.0 ECU_ADDRESS 0x3F9A9C /begin FUNCTION_LIST Global /end FUNCTION_LIST BIT_MASK 0x6F /end MEASUREMENT
/begin MEASUREMENT tdme "Steuergeraetetemperatur" SWORD FORMULA_0019 0 0 -50.0000 150.0000 ECU_ADDRESS 0x3F9A9E /begin FUNCTION_LIST Global /end FUNCTION_LIST /end MEASUREMENT
/begin MEASUREMENT tdme_ed "Eigendiagnose Steuergeraetetemperatur" UWORD FORMULA_0017 0 0 0.0 111.0 ECU_ADDRESS 0x3F9AA0 /begin FUNCTION_LIST Global /end FUNCTION_LIST BIT_MASK 0x6F /end MEASUREMENT
/begin MEASUREMENT tka "Kuehlwasseraustrittstemperatur" SWORD FORMULA_0019 0 0 -50.0000 150.0000 ECU_ADDRESS 0x3F9AA2 /begin FUNCTION_LIST Global /end FUNCTION_LIST /end MEASUREMENT
/begin MEASUREMENT tka_ed "Eigendiagnose Kuehlwasseraustrittstemperatur" UWORD FORMULA_0017 0 0 0.0 111.0 ECU_ADDRESS 0x3F9AA4 /begin FUNCTION_LIST Global /end FUNCTION_LIST BIT_MASK 0x6F /end MEASUREMENT
/begin MEASUREMENT tmot "Motortemperatur-Kuehlwasser" SWORD FORMULA_0019 0 0 -50.0000 150.0000 ECU_ADDRESS 0x3F9AA6 /begin FUNCTION_LIST Global /end FUNCTION_LIST /end MEASUREMENT
/begin MEASUREMENT tmot_ed "Eigendiagnose Kuehlwassertemperatur" UWORD FORMULA_0017 0 0 0.0 111.0 ECU_ADDRESS 0x3F9AA8 /begin FUNCTION_LIST Global /end FUNCTION_LIST BIT_MASK 0x6F /end MEASUREMENT
/begin MEASUREMENT tmot_st "TMOT-Status" UWORD FORMULA_0024 0 0 0.0 65535.0000 ECU_ADDRESS 0x3F9AAA /begin FUNCTION_LIST Global /end FUNCTION_LIST /end MEASUREMENT
/begin MEASUREMENT tmot_st_sa_abbruch "TMOT-Status" UWORD FORMULA_0053 0 0 0.0 65535.0 ECU_ADDRESS 0x3F9AAA /begin FUNCTION_LIST Global /end FUNCTION_LIST BIT_MASK 0x1 /end MEASUREMENT
/begin MEASUREMENT tmot_st_min_max_fehler "TMOT-Status" UWORD FORMULA_0054 0 0 0.0 65535.0 ECU_ADDRESS 0x3F9AAA /begin FUNCTION_LIST Global /end FUNCTION_LIST BIT_MASK 0x2 /end MEASUREMENT
/begin MEASUREMENT tmot_st_sensor_ok "TMOT-Status" UWORD FORMULA_0055 0 0 0.0 65535.0 ECU_ADDRESS 0x3F9AAA /begin FUNCTION_LIST Global /end FUNCTION_LIST BIT_MASK 0x4 /end MEASUREMENT
/begin MEASUREMENT tmot_st_thermo_offen "TMOT-Status" UWORD FORMULA_0056 0 0 0.0 65535.0 ECU_ADDRESS 0x3F9AAA /begin FUNCTION_LIST Global /end FUNCTION_LIST BIT_MASK 0x8 /end MEASUREMENT
/begin MEASUREMENT tmot_st_sensor_unplaus "TMOT-Status" UWORD FORMULA_0057 0 0 0.0 65535.0 ECU_ADDRESS 0x3F9AAA /begin FUNCTION_LIST Global /end FUNCTION_LIST BIT_MASK 0x10 /end MEASUREMENT
/begin MEASUREMENT tmot_st_blockheater "TMOT-Status" UWORD FORMULA_0058 0 0 0.0 65535.0 ECU_ADDRESS 0x3F9AAA /begin FUNCTION_LIST Global /end FUNCTION_LIST BIT_MASK 0x20 /end MEASUREMENT
/begin MEASUREMENT tmot_st_la_einschalten "TMOT-Status" UWORD FORMULA_0059 0 0 0.0 65535.0 ECU_ADDRESS 0x3F9AAA /begin FUNCTION_LIST Global /end FUNCTION_LIST BIT_MASK 0x40 /end MEASUREMENT
/begin MEASUREMENT tmot_st_thermo_ok "TMOT-Status" UWORD FORMULA_0060 0 0 0.0 65535.0 ECU_ADDRESS 0x3F9AAA /begin FUNCTION_LIST Global /end FUNCTION_LIST BIT_MASK 0x80 /end MEASUREMENT
/begin MEASUREMENT tmot_st_modell_init "TMOT-Status" UWORD FORMULA_0061 0 0 0.0 65535.0 ECU_ADDRESS 0x3F9AAA /begin FUNCTION_LIST Global /end FUNCTION_LIST BIT_MASK 0x100 /end MEASUREMENT
/begin MEASUREMENT tmot_st_diagnose_stop "TMOT-Status" UWORD FORMULA_0062 0 0 0.0 65535.0 ECU_ADDRESS 0x3F9AAA /begin FUNCTION_LIST Global /end FUNCTION_LIST BIT_MASK 0x200 /end MEASUREMENT
/begin MEASUREMENT tmot_st_ersatz_init "TMOT-Status" UWORD FORMULA_0063 0 0 0.0 65535.0 ECU_ADDRESS 0x3F9AAA /begin FUNCTION_LIST Global /end FUNCTION_LIST BIT_MASK 0x8000 /end MEASUREMENT
/begin MEASUREMENT tmot_sta "Status Uebertemperaturanzeige" UBYTE FORMULA_0064 0 0 0.0 2.0 ECU_ADDRESS 0x3F9AAC /begin FUNCTION_LIST Global /end FUNCTION_LIST /end MEASUREMENT
/begin MEASUREMENT toel "Temperatur in Celsius" SWORD FORMULA_0019 0 0 -50.0000 150.0000 ECU_ADDRESS 0x3F9AAE /begin FUNCTION_LIST Global /end FUNCTION_LIST /end MEASUREMENT
/begin MEASUREMENT tsgrw_m "Mittelwert Saugrohrwandtemperatur" SWORD FORMULA_0019 0 0 -50.0000 150.0000 ECU_ADDRESS 0x3F9AB2 /begin FUNCTION_LIST Global /end FUNCTION_LIST /end MEASUREMENT
/begin MEASUREMENT tsgrw_b1 "Saugrohrwandtemperatur" SWORD FORMULA_0019 0 0 -50.0000 150.0000 ECU_ADDRESS 0x3F9AB4 /begin FUNCTION_LIST Global /end FUNCTION_LIST /end MEASUREMENT
/begin MEASUREMENT tsgrw_b2 "Saugrohrwandtemperatur" SWORD FORMULA_0019 0 0 -50.0000 150.0000 ECU_ADDRESS 0x3F9AB6 /begin FUNCTION_LIST Global /end FUNCTION_LIST /end MEASUREMENT
/begin MEASUREMENT tumg_ersatz "Ersatzwert der Umgebungstemperatur" SWORD FORMULA_0019 0 0 -50.0000 150.0000 ECU_ADDRESS 0x3F9AB8 /begin FUNCTION_LIST Global /end FUNCTION_LIST /end MEASUREMENT
/begin MEASUREMENT md_kupp_max "Maximalmoment an der Kupplung" SWORD FORMULA_0018 0 0 -100.0000 1000.0000 ECU_ADDRESS 0x3F9ABA /begin FUNCTION_LIST Global /end FUNCTION_LIST /end MEASUREMENT
/begin MEASUREMENT md_ind_schlepp_ist "Schleppmoment (aktuell)" SWORD FORMULA_0018 0 0 -100.0000 1000.0000 ECU_ADDRESS 0x3F9ABC /begin FUNCTION_LIST Global /end FUNCTION_LIST /end MEASUREMENT
/begin MEASUREMENT md_ind_opt_la_rg_zw_min "Moment mit LA/RG bei min. ZW" SWORD FORMULA_0018 0 0 -100.0000 1000.0000 ECU_ADDRESS 0x3F9ABE /begin FUNCTION_LIST Global /end FUNCTION_LIST /end MEASUREMENT
/begin MEASUREMENT md_rf_max "rf_max mit pt-Korr" SWORD FORMULA_0006 0 0 0.0 2.0000 ECU_ADDRESS 0x3F9AC0 /begin FUNCTION_LIST Global /end FUNCTION_LIST /end MEASUREMENT
/begin MEASUREMENT nachl_st_ign "Nachlaufstatus fuer den IGN Proz" UBYTE FORMULA_0047 0 0 0.0 255.0000 ECU_ADDRESS 0x600DD6 /begin FUNCTION_LIST Global /end FUNCTION_LIST /end MEASUREMENT
/begin MEASUREMENT nachl_ign "" UBYTE FORMULA_0065 0 0 0.0 255.0 ECU_ADDRESS 0x600DD6 /begin FUNCTION_LIST Global /end FUNCTION_LIST BIT_MASK 0x1 /end MEASUREMENT
/begin MEASUREMENT nachl_ign_KL15 "" UBYTE FORMULA_0066 0 0 0.0 255.0 ECU_ADDRESS 0x600DD6 /begin FUNCTION_LIST Global /end FUNCTION_LIST BIT_MASK 0x2 /end MEASUREMENT
/begin MEASUREMENT ccp_fp_st_inj "Status CCP-FP" UBYTE FORMULA_0067 0 0 0.0 255.0 ECU_ADDRESS 0x600DD7 /begin FUNCTION_LIST Global /end FUNCTION_LIST /end MEASUREMENT
/begin MEASUREMENT ccp_fp_vers_inj "neue Version bei CCP-FP" UWORD FORMULA_0000 0 0 0.0 65535.0000 ECU_ADDRESS 0x600DD8 /begin FUNCTION_LIST Global /end FUNCTION_LIST /end MEASUREMENT
/begin MEASUREMENT ccp_fp_st_ign "Status CCP-FP" UBYTE FORMULA_0067 0 0 0.0 255.0 ECU_ADDRESS 0x600DDA /begin FUNCTION_LIST Global /end FUNCTION_LIST /end MEASUREMENT
/begin MEASUREMENT ccp_fp_vers_ign "neue Version bei CCP-FP" UWORD FORMULA_0000 0 0 0.0 65535.0000 ECU_ADDRESS 0x600DDC /begin FUNCTION_LIST Global /end FUNCTION_LIST /end MEASUREMENT
/* ------------------ Abschnitt erzeugt aus adapt_inj.dat ------------------ */
/begin MEASUREMENT eeprom_anzahl_schreiben "Anzahl der Schreibvorgaenge ins Flash" ULONG FORMULA_0084 0 0 0.0 2147483647.0000 ECU_ADDRESS 0x3F9AC4 /begin FUNCTION_LIST Adaptionswerte /end FUNCTION_LIST /end MEASUREMENT
/begin MEASUREMENT eeprom_version_prog "Programmversion beim Abspeichern" UWORD FORMULA_0085 0 0 0.0 65535.0000 ECU_ADDRESS 0x3F9AC8 /begin FUNCTION_LIST Adaptionswerte /end FUNCTION_LIST /end MEASUREMENT
/begin MEASUREMENT hdw_1 "HDW" ULONG FORMULA_0001 0 0 0.0 2147483647.0000 ECU_ADDRESS 0x3F9ACC /begin FUNCTION_LIST Adaptionswerte /end FUNCTION_LIST /end MEASUREMENT
/begin MEASUREMENT hdw_2 "HDW" ULONG FORMULA_0001 0 0 0.0 2147483647.0000 ECU_ADDRESS 0x3F9AD0 /begin FUNCTION_LIST Adaptionswerte /end FUNCTION_LIST /end MEASUREMENT
/begin MEASUREMENT hdw_3 "HDW" ULONG FORMULA_0001 0 0 0.0 2147483647.0000 ECU_ADDRESS 0x3F9AD4 /begin FUNCTION_LIST Adaptionswerte /end FUNCTION_LIST /end MEASUREMENT
/begin MEASUREMENT psau_adapt_b1 "Adaptionswert zur PSAU1 im GLOBbereich" SWORD FORMULA_0031 0 0 -100.0000 200.0000 ECU_ADDRESS 0x3F9AD8 /begin FUNCTION_LIST Adaptionswerte /end FUNCTION_LIST /end MEASUREMENT
/begin MEASUREMENT psau_adapt_b2 "Adaptionswert zur PSAU1 im GLOBbereich" SWORD FORMULA_0031 0 0 -100.0000 200.0000 ECU_ADDRESS 0x3F9ADA /begin FUNCTION_LIST Adaptionswerte /end FUNCTION_LIST /end MEASUREMENT
/begin MEASUREMENT wf_ist_zyl1 "Wandfilmistmenge" UWORD FORMULA_0086 0 0 0.0 2000.0000 ECU_ADDRESS 0x3F9ADC /begin FUNCTION_LIST Adaptionswerte /end FUNCTION_LIST /end MEASUREMENT
/begin MEASUREMENT wf_ist_zyl2 "Wandfilmistmenge" UWORD FORMULA_0086 0 0 0.0 2000.0000 ECU_ADDRESS 0x3F9ADE /begin FUNCTION_LIST Adaptionswerte /end FUNCTION_LIST /end MEASUREMENT
/begin MEASUREMENT wf_ist_zyl3 "Wandfilmistmenge" UWORD FORMULA_0086 0 0 0.0 2000.0000 ECU_ADDRESS 0x3F9AE0 /begin FUNCTION_LIST Adaptionswerte /end FUNCTION_LIST /end MEASUREMENT
/begin MEASUREMENT wf_ist_zyl4 "Wandfilmistmenge" UWORD FORMULA_0086 0 0 0.0 2000.0000 ECU_ADDRESS 0x3F9AE2 /begin FUNCTION_LIST Adaptionswerte /end FUNCTION_LIST /end MEASUREMENT
/begin MEASUREMENT wf_ist_zyl5 "Wandfilmistmenge" UWORD FORMULA_0086 0 0 0.0 2000.0000 ECU_ADDRESS 0x3F9AE4 /begin FUNCTION_LIST Adaptionswerte /end FUNCTION_LIST /end MEASUREMENT
/begin MEASUREMENT wf_ist_zyl6 "Wandfilmistmenge" UWORD FORMULA_0086 0 0 0.0 2000.0000 ECU_ADDRESS 0x3F9AE6 /begin FUNCTION_LIST Adaptionswerte /end FUNCTION_LIST /end MEASUREMENT
/begin MEASUREMENT wf_ist_zyl7 "Wandfilmistmenge" UWORD FORMULA_0086 0 0 0.0 2000.0000 ECU_ADDRESS 0x3F9AE8 /begin FUNCTION_LIST Adaptionswerte /end FUNCTION_LIST /end MEASUREMENT
/begin MEASUREMENT wf_ist_zyl8 "Wandfilmistmenge" UWORD FORMULA_0086 0 0 0.0 2000.0000 ECU_ADDRESS 0x3F9AEA /begin FUNCTION_LIST Adaptionswerte /end FUNCTION_LIST /end MEASUREMENT
/begin MEASUREMENT wf_ist_zyl9 "Wandfilmistmenge" UWORD FORMULA_0086 0 0 0.0 2000.0000 ECU_ADDRESS 0x3F9AEC /begin FUNCTION_LIST Adaptionswerte /end FUNCTION_LIST /end MEASUREMENT
/begin MEASUREMENT wf_ist_zyl10 "Wandfilmistmenge" UWORD FORMULA_0086 0 0 0.0 2000.0000 ECU_ADDRESS 0x3F9AEE /begin FUNCTION_LIST Adaptionswerte /end FUNCTION_LIST /end MEASUREMENT
/begin MEASUREMENT wf_ist_zyl11 "Wandfilmistmenge" UWORD FORMULA_0086 0 0 0.0 2000.0000 ECU_ADDRESS 0x3F9AF0 /begin FUNCTION_LIST Adaptionswerte /end FUNCTION_LIST /end MEASUREMENT
/begin MEASUREMENT wf_ist_zyl12 "Wandfilmistmenge" UWORD FORMULA_0086 0 0 0.0 2000.0000 ECU_ADDRESS 0x3F9AF2 /begin FUNCTION_LIST Adaptionswerte /end FUNCTION_LIST /end MEASUREMENT
/begin MEASUREMENT laa_f_1of2_ "Faktor-Lambdaadaption" UWORD FORMULA_0087 0 0 0.0 1.9990 ECU_ADDRESS 0x3F9AF4 /begin FUNCTION_LIST Adaptionswerte /end FUNCTION_LIST /end MEASUREMENT
/begin MEASUREMENT laa_f_2of2_ "Faktor-Lambdaadaption" UWORD FORMULA_0087 0 0 0.0 1.9990 ECU_ADDRESS 0x3F9AF6 /begin FUNCTION_LIST Adaptionswerte /end FUNCTION_LIST /end MEASUREMENT
/begin MEASUREMENT laa_offs_1of2_ "Offset-Lambdaadaption" SWORD FORMULA_0088 0 0 -512.0000 511.0000 ECU_ADDRESS 0x3F9AF8 /begin FUNCTION_LIST Adaptionswerte /end FUNCTION_LIST /end MEASUREMENT
/begin MEASUREMENT laa_offs_2of2_ "Offset-Lambdaadaption" SWORD FORMULA_0088 0 0 -512.0000 511.0000 ECU_ADDRESS 0x3F9AFA /begin FUNCTION_LIST Adaptionswerte /end FUNCTION_LIST /end MEASUREMENT
/begin MEASUREMENT lavk_adap_f_1of2_ "Faktor-Sondenadaption" UWORD FORMULA_0035 0 0 0.0 4.0000 ECU_ADDRESS 0x3F9AFC /begin FUNCTION_LIST Adaptionswerte /end FUNCTION_LIST /end MEASUREMENT
/begin MEASUREMENT lavk_adap_f_2of2_ "Faktor-Sondenadaption" UWORD FORMULA_0035 0 0 0.0 4.0000 ECU_ADDRESS 0x3F9AFE /begin FUNCTION_LIST Adaptionswerte /end FUNCTION_LIST /end MEASUREMENT
/begin MEASUREMENT lavk_adap_offs_1of2_ "Offset-Sondenadaption" SWORD FORMULA_0089 0 0 -5000.0000 5000.0000 ECU_ADDRESS 0x3F9B00 /begin FUNCTION_LIST Adaptionswerte /end FUNCTION_LIST /end MEASUREMENT
/begin MEASUREMENT lavk_adap_offs_2of2_ "Offset-Sondenadaption" SWORD FORMULA_0089 0 0 -5000.0000 5000.0000 ECU_ADDRESS 0x3F9B02 /begin FUNCTION_LIST Adaptionswerte /end FUNCTION_LIST /end MEASUREMENT
/begin MEASUREMENT t_mot_steht_1s "Zeitpunkt sei dem Motor steht" ULONG FORMULA_0090 0 0 0.0 2147483647.0000 ECU_ADDRESS 0x3F9B04 /begin FUNCTION_LIST Adaptionswerte /end FUNCTION_LIST /end MEASUREMENT
/begin MEASUREMENT ipk_sync_errorcount "Fehlerzaehler fuer Sync-Timeout" UBYTE FORMULA_0008 0 0 0.0 255.0000 ECU_ADDRESS 0x3F9B08 /begin FUNCTION_LIST Adaptionswerte /end FUNCTION_LIST /end MEASUREMENT
/begin MEASUREMENT ipk_sync_error_st "Telegramm-Maske fuer Sync-Timeout" UBYTE FORMULA_0008 0 0 0.0 255.0000 ECU_ADDRESS 0x3F9B09 /begin FUNCTION_LIST Adaptionswerte /end FUNCTION_LIST /end MEASUREMENT
/* ------------------ Abschnitt erzeugt aus elu.dat ------------------ */
/begin CHARACTERISTIC K_ELU_HYS_SCHLEPP "Hysterese Schleppzeiger" VALUE 0x60330 TKW_VV_VV_UB 100.0 FORMULA_0105 0.0 100.0000 /begin FUNCTION_LIST Elektroluefter /end FUNCTION_LIST /end CHARACTERISTIC
/begin CHARACTERISTIC K_ELU_TKA_TMOT_DIFF "Differenz zu tmot bei defektem Kuehleraustritt" VALUE 0x60332 TKW_VV_VV_SW 100.0 FORMULA_0107 0.0 1000.0000 /begin FUNCTION_LIST Elektroluefter /end FUNCTION_LIST FORMAT "%4.1" /end CHARACTERISTIC
/begin CHARACTERISTIC K_ELU_PWM_MIN "Minimal ausgegebenes Tastverhaeltnis bei Luefterfunktion" VALUE 0x60334 TKW_VV_VV_UB 100.0 FORMULA_0105 0.0 49.0000 /begin FUNCTION_LIST Elektroluefter /end FUNCTION_LIST /end CHARACTERISTIC
/begin CHARACTERISTIC K_ELU_PWM_MAX "Maximal ausgegebenes Tastverhaeltnis" VALUE 0x60335 TKW_VV_VV_UB 100.0 FORMULA_0105 50.0000 100.0000 /begin FUNCTION_LIST Elektroluefter /end FUNCTION_LIST /end CHARACTERISTIC
/begin CHARACTERISTIC K_ELU_PWM_AUS "Tastverhaeltnis bei ausgeschaltenem Luefter" VALUE 0x60336 TKW_VV_VV_UB 100.0 FORMULA_0105 0.0 10.0000 /begin FUNCTION_LIST Elektroluefter /end FUNCTION_LIST /end CHARACTERISTIC
/begin CHARACTERISTIC K_ELU_PWM_TAU "Filterkonstante fuer ELU-PWM-Ausgabe" VALUE 0x60337 TKW_VV_VV_UB 100.0 FORMULA_0108 0.1004 25.6000 /begin FUNCTION_LIST Elektroluefter /end FUNCTION_LIST /end CHARACTERISTIC
/begin CHARACTERISTIC K_ELU_START_TIME "Verweilzeit nach Startende" VALUE 0x60338 TKW_VV_VV_UW 100.0 FORMULA_0109 0.0 655350.0000 /begin FUNCTION_LIST Elektroluefter /end FUNCTION_LIST /end CHARACTERISTIC
/begin CHARACTERISTIC K_ELU_UB_NORM "Bordspannungsbezug der ELU-Drehzahlberechnung" VALUE 0x6033A TKW_VV_VV_SW 100.0 FORMULA_0045 5.0000 16.0000 /begin FUNCTION_LIST Elektroluefter /end FUNCTION_LIST FORMAT "%4.1" /end CHARACTERISTIC
/begin CHARACTERISTIC K_ELU_TAN "Obere Grenze von TAN - Einschalten vom ELU" VALUE 0x6033C TKW_VV_VV_SW 100.0 FORMULA_0019 -50.0000 150.0000 /begin FUNCTION_LIST Elektroluefter /end FUNCTION_LIST FORMAT "%4.1" /end CHARACTERISTIC
/begin CHARACTERISTIC K_ELU_TAN_HYS "Hysterese - Ausschalten vom ELU" VALUE 0x6033E TKW_VV_VV_SW 100.0 FORMULA_0107 0.0 1000.0000 /begin FUNCTION_LIST Elektroluefter /end FUNCTION_LIST FORMAT "%4.1" /end CHARACTERISTIC
/begin CHARACTERISTIC K_ELU_TAN_DREH "Drehzahl bei TAN-Anforderung" VALUE 0x60340 TKW_VV_VV_UB 100.0 FORMULA_0105 0.0 100.0000 /begin FUNCTION_LIST Elektroluefter /end FUNCTION_LIST /end CHARACTERISTIC
/begin CHARACTERISTIC K_ELU_KKOS_ERSATZ "Drehzahl bei CAN-KKOS-FEHLER" VALUE 0x60341 TKW_VV_VV_UB 100.0 FORMULA_0105 0.0 100.0000 /begin FUNCTION_LIST Elektroluefter /end FUNCTION_LIST /end CHARACTERISTIC
/begin CHARACTERISTIC K_ELU_KKOS_1of15_ "Drehzahl bei CAN-KKOS-Anforderung" VALUE 0x60344 TKW_VV_VV_UB 100.0 FORMULA_0105 0.0 100.0000 /begin FUNCTION_LIST Elektroluefter /end FUNCTION_LIST /end CHARACTERISTIC
/begin CHARACTERISTIC K_ELU_KKOS_2of15_ "Drehzahl bei CAN-KKOS-Anforderung" VALUE 0x60345 TKW_VV_VV_UB 100.0 FORMULA_0105 0.0 100.0000 /begin FUNCTION_LIST Elektroluefter /end FUNCTION_LIST /end CHARACTERISTIC
/begin CHARACTERISTIC K_ELU_KKOS_3of15_ "Drehzahl bei CAN-KKOS-Anforderung" VALUE 0x60346 TKW_VV_VV_UB 100.0 FORMULA_0105 0.0 100.0000 /begin FUNCTION_LIST Elektroluefter /end FUNCTION_LIST /end CHARACTERISTIC
/begin CHARACTERISTIC K_ELU_KKOS_4of15_ "Drehzahl bei CAN-KKOS-Anforderung" VALUE 0x60347 TKW_VV_VV_UB 100.0 FORMULA_0105 0.0 100.0000 /begin FUNCTION_LIST Elektroluefter /end FUNCTION_LIST /end CHARACTERISTIC
/begin CHARACTERISTIC K_ELU_KKOS_5of15_ "Drehzahl bei CAN-KKOS-Anforderung" VALUE 0x60348 TKW_VV_VV_UB 100.0 FORMULA_0105 0.0 100.0000 /begin FUNCTION_LIST Elektroluefter /end FUNCTION_LIST /end CHARACTERISTIC
/begin CHARACTERISTIC K_ELU_KKOS_6of15_ "Drehzahl bei CAN-KKOS-Anforderung" VALUE 0x60349 TKW_VV_VV_UB 100.0 FORMULA_0105 0.0 100.0000 /begin FUNCTION_LIST Elektroluefter /end FUNCTION_LIST /end CHARACTERISTIC
/begin CHARACTERISTIC K_ELU_KKOS_7of15_ "Drehzahl bei CAN-KKOS-Anforderung" VALUE 0x6034A TKW_VV_VV_UB 100.0 FORMULA_0105 0.0 100.0000 /begin FUNCTION_LIST Elektroluefter /end FUNCTION_LIST /end CHARACTERISTIC
/begin CHARACTERISTIC K_ELU_KKOS_8of15_ "Drehzahl bei CAN-KKOS-Anforderung" VALUE 0x6034B TKW_VV_VV_UB 100.0 FORMULA_0105 0.0 100.0000 /begin FUNCTION_LIST Elektroluefter /end FUNCTION_LIST /end CHARACTERISTIC
/begin CHARACTERISTIC K_ELU_KKOS_9of15_ "Drehzahl bei CAN-KKOS-Anforderung" VALUE 0x6034C TKW_VV_VV_UB 100.0 FORMULA_0105 0.0 100.0000 /begin FUNCTION_LIST Elektroluefter /end FUNCTION_LIST /end CHARACTERISTIC
/begin CHARACTERISTIC K_ELU_KKOS_10of15_ "Drehzahl bei CAN-KKOS-Anforderung" VALUE 0x6034D TKW_VV_VV_UB 100.0 FORMULA_0105 0.0 100.0000 /begin FUNCTION_LIST Elektroluefter /end FUNCTION_LIST /end CHARACTERISTIC
/begin CHARACTERISTIC K_ELU_KKOS_11of15_ "Drehzahl bei CAN-KKOS-Anforderung" VALUE 0x6034E TKW_VV_VV_UB 100.0 FORMULA_0105 0.0 100.0000 /begin FUNCTION_LIST Elektroluefter /end FUNCTION_LIST /end CHARACTERISTIC
/begin CHARACTERISTIC K_ELU_KKOS_12of15_ "Drehzahl bei CAN-KKOS-Anforderung" VALUE 0x6034F TKW_VV_VV_UB 100.0 FORMULA_0105 0.0 100.0000 /begin FUNCTION_LIST Elektroluefter /end FUNCTION_LIST /end CHARACTERISTIC
/begin CHARACTERISTIC K_ELU_KKOS_13of15_ "Drehzahl bei CAN-KKOS-Anforderung" VALUE 0x60350 TKW_VV_VV_UB 100.0 FORMULA_0105 0.0 100.0000 /begin FUNCTION_LIST Elektroluefter /end FUNCTION_LIST /end CHARACTERISTIC
/begin CHARACTERISTIC K_ELU_KKOS_14of15_ "Drehzahl bei CAN-KKOS-Anforderung" VALUE 0x60351 TKW_VV_VV_UB 100.0 FORMULA_0105 0.0 100.0000 /begin FUNCTION_LIST Elektroluefter /end FUNCTION_LIST /end CHARACTERISTIC
/begin CHARACTERISTIC K_ELU_KKOS_15of15_ "Drehzahl bei CAN-KKOS-Anforderung" VALUE 0x60352 TKW_VV_VV_UB 100.0 FORMULA_0105 0.0 100.0000 /begin FUNCTION_LIST Elektroluefter /end FUNCTION_LIST /end CHARACTERISTIC
/begin CHARACTERISTIC KL_ELU_TKA "Kennlinie ELU_TKA" CURVE 0x60354 TKL_SW_VV_UW 100.0 FORMULA_0106 0.0 100.0000 /begin FUNCTION_LIST Elektroluefter /end FUNCTION_LIST
 /begin AXIS_DESCR STD_AXIS tka FORMULA_0019 6 -50.0000 150.0000 FORMAT "%4.1" /end AXIS_DESCR
/end CHARACTERISTIC
/begin CHARACTERISTIC KL_ELU_V "Kennlinie ELU_V" CURVE 0x6036E TKL_SW_VV_UW 100.0 FORMULA_0110 0.0 1.0000 /begin FUNCTION_LIST Elektroluefter /end FUNCTION_LIST /begin AXIS_DESCR STD_AXIS v FORMULA_0013 6 -360.0000 360.0000 FORMAT "%4.1" /end AXIS_DESCR FORMAT "%6.3" /end CHARACTERISTIC
/begin MEASUREMENT elu_st "Status ELU" UBYTE FORMULA_0104 0 0 0.0 255.0 ECU_ADDRESS 0x3FB634 /begin FUNCTION_LIST Elektroluefter /end FUNCTION_LIST BIT_MASK 0x40 /end MEASUREMENT
/begin MEASUREMENT elu_dreh "geforderte E-Luefterdrehzahl" UBYTE FORMULA_0105 0 0 0.0 100.0000 ECU_ADDRESS 0x3FB635 /begin FUNCTION_LIST Elektroluefter /end FUNCTION_LIST /end MEASUREMENT
/begin MEASUREMENT elu_min_hys "minimale ELU-Hysteres" UBYTE FORMULA_0105 0 0 0.0 100.0000 ECU_ADDRESS 0x3FB636 /begin FUNCTION_LIST Elektroluefter /end FUNCTION_LIST /end MEASUREMENT
/begin MEASUREMENT elu_dreh_sch "Schleppzeiger gefilterte ELU-Drehzahl" UBYTE FORMULA_0105 0 0 0.0 255.0000 ECU_ADDRESS 0x3FB637 /begin FUNCTION_LIST Elektroluefter /end FUNCTION_LIST /end MEASUREMENT
/begin MEASUREMENT elu_pwm_ber "Berechnetes PWM-Signal" SWORD FORMULA_0106 0 0 -32768.0000 32767.0000 ECU_ADDRESS 0x3FB638 /begin FUNCTION_LIST Elektroluefter /end FUNCTION_LIST /end MEASUREMENT
/begin MEASUREMENT elu_pwm "Auszugebendes PWM-Signal" UBYTE FORMULA_0105 0 0 0.0 100.0000 ECU_ADDRESS 0x3FB63A /begin FUNCTION_LIST Elektroluefter /end FUNCTION_LIST /end MEASUREMENT
/* ------------------ Abschnitt erzeugt aus gang.dat ------------------ */
/begin CHARACTERISTIC K_GANG_GRENZE1_2 "Grenze1_2 des Uebersetzungsverhaeltnis" VALUE 0x60388 TKW_VV_VV_UW 100.0 FORMULA_0111 0.0 6553.5000 /begin FUNCTION_LIST Gangerkennung /end FUNCTION_LIST FORMAT "%4.1" /end CHARACTERISTIC
/begin CHARACTERISTIC K_GANG_GRENZE2_3 "Grenze2_3 des Uebersetzungsverhaeltnis" VALUE 0x6038A TKW_VV_VV_UW 100.0 FORMULA_0111 0.0 6553.5000 /begin FUNCTION_LIST Gangerkennung /end FUNCTION_LIST FORMAT "%4.1" /end CHARACTERISTIC
/begin CHARACTERISTIC K_GANG_GRENZE3_4 "Grenze3_4 des Uebersetzungsverhaeltnis" VALUE 0x6038C TKW_VV_VV_UW 100.0 FORMULA_0111 0.0 6553.5000 /begin FUNCTION_LIST Gangerkennung /end FUNCTION_LIST FORMAT "%4.1" /end CHARACTERISTIC
/begin CHARACTERISTIC K_GANG_GRENZE4_5 "Grenze4_5 des Uebersetzungsverhaeltnis" VALUE 0x6038E TKW_VV_VV_UW 100.0 FORMULA_0111 0.0 6553.5000 /begin FUNCTION_LIST Gangerkennung /end FUNCTION_LIST FORMAT "%4.1" /end CHARACTERISTIC
/begin CHARACTERISTIC K_GANG_GRENZE5_6 "Grenze5_6 des Uebersetzungsverhaeltnis" VALUE 0x60390 TKW_VV_VV_UW 100.0 FORMULA_0111 0.0 6553.5000 /begin FUNCTION_LIST Gangerkennung /end FUNCTION_LIST FORMAT "%4.1" /end CHARACTERISTIC
/begin MEASUREMENT gang_nv "Uebersetzungsverhaeltnis" UWORD FORMULA_0111 0 0 0.0 6553.5000 ECU_ADDRESS 0x3FB63C /begin FUNCTION_LIST Gangerkennung /end FUNCTION_LIST /end MEASUREMENT
/* ------------------ Abschnitt erzeugt aus heimatlos_inj.dat ------------------ */
/begin CHARACTERISTIC K_LAM_ZUSTAND "lam_zustand" VALUE 0x60392 TKW_VV_VV_UW 100.0 FORMULA_0000 0.0 65535.0000 /begin FUNCTION_LIST Heimatlos /end FUNCTION_LIST /end CHARACTERISTIC
/begin CHARACTERISTIC K_MOTOR_ZUSTAND "motor_zustand" VALUE 0x60394 TKW_VV_VV_UW 100.0 FORMULA_0000 0.0 65535.0000 /begin FUNCTION_LIST Heimatlos /end FUNCTION_LIST /end CHARACTERISTIC
/begin CHARACTERISTIC K_ED_UBMIN "untere UB-Schwelle fuer elektr. Diagnosen" VALUE 0x60396 TKW_VV_VV_SW 100.0 FORMULA_0045 0.0 28.0000 /begin FUNCTION_LIST Heimatlos /end FUNCTION_LIST FORMAT "%4.1" /end CHARACTERISTIC
/begin MEASUREMENT ed_fsp "-" ULONG FORMULA_0001 0 0 0.0 2147483647.0000 ECU_ADDRESS 0x3FB640 /begin FUNCTION_LIST Heimatlos /end FUNCTION_LIST /end MEASUREMENT
/begin MEASUREMENT ml_slp_b1 "Sekund. Pumpe" SWORD FORMULA_0010 0 0 -100.0000 1400.0000 ECU_ADDRESS 0x3FB644 /begin FUNCTION_LIST Heimatlos /end FUNCTION_LIST /end MEASUREMENT
/begin MEASUREMENT ml_slp_b2 "Sekund. Pumpe" SWORD FORMULA_0010 0 0 -100.0000 1400.0000 ECU_ADDRESS 0x3FB646 /begin FUNCTION_LIST Heimatlos /end FUNCTION_LIST /end MEASUREMENT
/* ------------------ Abschnitt erzeugt aus hfm.dat ------------------ */
/begin CHARACTERISTIC K_HFM_DIAG_ML_MAX "MAX ML fuer Diagnose " VALUE 0x60398 TKW_VV_VV_SW 100.0 FORMULA_0010 -50.0000 1400.0000 /begin FUNCTION_LIST HFM /end FUNCTION_LIST FORMAT "%4.1" /end CHARACTERISTIC
/begin CHARACTERISTIC K_HFM_DIAG_ML_MIN "MAX ML fuer Diagnose " VALUE 0x6039A TKW_VV_VV_SW 100.0 FORMULA_0010 -50.0000 1400.0000 /begin FUNCTION_LIST HFM /end FUNCTION_LIST FORMAT "%4.1" /end CHARACTERISTIC
/begin CHARACTERISTIC K_HFM_ERSATZ "Ersatzwert fuer HFM" VALUE 0x6039C TKW_VV_VV_SW 100.0 FORMULA_0010 -50.0000 1400.0000 /begin FUNCTION_LIST HFM /end FUNCTION_LIST FORMAT "%4.1" /end CHARACTERISTIC
/begin CHARACTERISTIC KL_HFM_ANZ_SEG_N "Anzahl der Seg. fuer die MW" CURVE 0x6039E TKL_SW_VV_UW 100.0 FORMULA_0024 1.0000 6.0000 /begin FUNCTION_LIST HFM /end FUNCTION_LIST /begin AXIS_DESCR STD_AXIS n FORMULA_0011 4 0.0 10000.0000 /end AXIS_DESCR FORMAT "%5.2" /end CHARACTERISTIC
/begin CHARACTERISTIC KL_RF_TAN_KORR "-" CURVE 0x603B0 TKL_SW_VV_UW 100.0 FORMULA_0035 0.0 4.0000 /begin FUNCTION_LIST HFM /end FUNCTION_LIST
 /begin AXIS_DESCR STD_AXIS temperatur FORMULA_0019 8 -50.0000 150.0000 FORMAT "%4.1" /end AXIS_DESCR
 FORMAT "%6.3" /end CHARACTERISTIC
/begin CHARACTERISTIC KL_RF_PUMG_KORR "Korrekturfaktor in Abh. vom Luftdruck" CURVE 0x603D2 TKL_SW_VV_UW 100.0 FORMULA_0035 0.0 4.0000 /begin FUNCTION_LIST HFM /end FUNCTION_LIST
 /begin AXIS_DESCR STD_AXIS pumg FORMULA_0031 8 400.0000 1200.0000 FORMAT "%4.1" /end AXIS_DESCR
 FORMAT "%6.3" /end CHARACTERISTIC
/begin CHARACTERISTIC KL_HFM_TAU "Filterkonstanten fuer die HFM Erfassung" CURVE 0x603F4 TKL_SW_VV_UB 100.0 FORMULA_0115 0.0101 2.5600 /begin FUNCTION_LIST HFM /end FUNCTION_LIST /begin AXIS_DESCR STD_AXIS n FORMULA_0011 4 0.0 10000.0000 /end AXIS_DESCR /end CHARACTERISTIC
/begin CHARACTERISTIC KF_HFM_KORR_ML_TAN "ml Korrektur ueber TAN und ml" MAP 0x60402 TKF_SW_SW_UW 100.0 FORMULA_0035 0.0 4.0000 /begin FUNCTION_LIST HFM /end FUNCTION_LIST
 /begin AXIS_DESCR STD_AXIS ml FORMULA_0010 4 -100.0000 1400.0000 FORMAT "%4.1" /end AXIS_DESCR
 /begin AXIS_DESCR STD_AXIS temperatur FORMULA_0019 4 -50.0000 150.0000 FORMAT "%4.1" /end AXIS_DESCR
 FORMAT "%6.3" /end CHARACTERISTIC
/begin MEASUREMENT hfm_b1.seg_error "Segment Errors Anzahl der Triggers per Segment ungueltig" UBYTE FORMULA_0047 0 0 0.0 255.0000 ECU_ADDRESS 0x3FB66C /begin FUNCTION_LIST HFM /end FUNCTION_LIST /end MEASUREMENT
/begin MEASUREMENT hfm_b2.seg_error "Segment Errors Anzahl der Triggers per Segment ungueltig" UBYTE FORMULA_0047 0 0 0.0 255.0000 ECU_ADDRESS 0x3FB71E /begin FUNCTION_LIST HFM /end FUNCTION_LIST /end MEASUREMENT
/begin MEASUREMENT hfm_b1.trig_seg "Samples per Segment" UBYTE FORMULA_0047 0 0 0.0 255.0000 ECU_ADDRESS 0x3FB66D /begin FUNCTION_LIST HFM /end FUNCTION_LIST /end MEASUREMENT
/begin MEASUREMENT hfm_b2.trig_seg "Samples per Segment" UBYTE FORMULA_0047 0 0 0.0 255.0000 ECU_ADDRESS 0x3FB71F /begin FUNCTION_LIST HFM /end FUNCTION_LIST /end MEASUREMENT
/begin MEASUREMENT hfm_b1.tan_korr "TAN Korrektur" UWORD FORMULA_0035 0 0 0.0 4.0000 ECU_ADDRESS 0x3FB66E /begin FUNCTION_LIST HFM /end FUNCTION_LIST /end MEASUREMENT
/begin MEASUREMENT hfm_b2.tan_korr "TAN Korrektur" UWORD FORMULA_0035 0 0 0.0 4.0000 ECU_ADDRESS 0x3FB720 /begin FUNCTION_LIST HFM /end FUNCTION_LIST /end MEASUREMENT
/begin MEASUREMENT hfm_b1.ed "Eigendiagnose hfm" UWORD FORMULA_0017 0 0 0.0 111.0 ECU_ADDRESS 0x3FB670 /begin FUNCTION_LIST HFM /end FUNCTION_LIST BIT_MASK 0x6F /end MEASUREMENT
/begin MEASUREMENT hfm_b2.ed "Eigendiagnose hfm" UWORD FORMULA_0017 0 0 0.0 111.0 ECU_ADDRESS 0x3FB722 /begin FUNCTION_LIST HFM /end FUNCTION_LIST BIT_MASK 0x6F /end MEASUREMENT
/begin MEASUREMENT hfm_b1.ad "Eingelesener Spannungswert" SWORD FORMULA_0112 0 0 0.0 1023.0000 ECU_ADDRESS 0x3FB672 /begin FUNCTION_LIST HFM /end FUNCTION_LIST /end MEASUREMENT
/begin MEASUREMENT hfm_b2.ad "Eingelesener Spannungswert" SWORD FORMULA_0112 0 0 0.0 1023.0000 ECU_ADDRESS 0x3FB724 /begin FUNCTION_LIST HFM /end FUNCTION_LIST /end MEASUREMENT
/begin MEASUREMENT hfm_b1.phy "Physikalischer Wert ohne Diagnose und ohne Filter" SWORD FORMULA_0010 0 0 -100.0000 1400.0000 ECU_ADDRESS 0x3FB674 /begin FUNCTION_LIST HFM /end FUNCTION_LIST /end MEASUREMENT
/begin MEASUREMENT hfm_b2.phy "Physikalischer Wert ohne Diagnose und ohne Filter" SWORD FORMULA_0010 0 0 -100.0000 1400.0000 ECU_ADDRESS 0x3FB726 /begin FUNCTION_LIST HFM /end FUNCTION_LIST /end MEASUREMENT
/begin MEASUREMENT hfm_b1.roh "Physikalischer Wert mit Diagnose jedoch ohne Filter" SWORD FORMULA_0010 0 0 -100.0000 1400.0000 ECU_ADDRESS 0x3FB676 /begin FUNCTION_LIST HFM /end FUNCTION_LIST /end MEASUREMENT
/begin MEASUREMENT hfm_b2.roh "Physikalischer Wert mit Diagnose jedoch ohne Filter" SWORD FORMULA_0010 0 0 -100.0000 1400.0000 ECU_ADDRESS 0x3FB728 /begin FUNCTION_LIST HFM /end FUNCTION_LIST /end MEASUREMENT
/begin MEASUREMENT ml_hfm_b1 "Luftmassenstrom aus HFM" SWORD FORMULA_0010 0 0 -100.0000 1400.0000 ECU_ADDRESS 0x3FB678 /begin FUNCTION_LIST HFM /end FUNCTION_LIST /end MEASUREMENT
/begin MEASUREMENT ml_hfm_b2 "Luftmassenstrom aus HFM" SWORD FORMULA_0010 0 0 -100.0000 1400.0000 ECU_ADDRESS 0x3FB72A /begin FUNCTION_LIST HFM /end FUNCTION_LIST /end MEASUREMENT
/begin MEASUREMENT rf_hfm_b1 "relative Fuellung aus HFM" SWORD FORMULA_0006 0 0 0.0 2.0000 ECU_ADDRESS 0x3FB67A /begin FUNCTION_LIST HFM /end FUNCTION_LIST /end MEASUREMENT
/begin MEASUREMENT rf_hfm_b2 "relative Fuellung aus HFM" SWORD FORMULA_0006 0 0 0.0 2.0000 ECU_ADDRESS 0x3FB72C /begin FUNCTION_LIST HFM /end FUNCTION_LIST /end MEASUREMENT
/begin MEASUREMENT hfm_qadc_ovr_error_cnt "HFM Overflow error in QADC queue" UWORD FORMULA_0000 0 0 0.0 65535.0000 ECU_ADDRESS 0x3FB7D0 /begin FUNCTION_LIST HFM /end FUNCTION_LIST /end MEASUREMENT
/begin MEASUREMENT hfm_qadc_no_sample_cnt "Zaehler wieoft die Qadc Auswertfunktion ohne Werte " UWORD FORMULA_0000 0 0 0.0 65535.0000 ECU_ADDRESS 0x3FB7D2 /begin FUNCTION_LIST HFM /end FUNCTION_LIST /end MEASUREMENT
/begin MEASUREMENT hfm_stat_trig_seg_1of15_ "Zaehler Array fuer Triggers per Segment" UWORD FORMULA_0000 0 0 0.0 65535.0000 ECU_ADDRESS 0x3FB7D4 /begin FUNCTION_LIST HFM /end FUNCTION_LIST /end MEASUREMENT
/begin MEASUREMENT hfm_stat_trig_seg_2of15_ "Zaehler Array fuer Triggers per Segment" UWORD FORMULA_0000 0 0 0.0 65535.0000 ECU_ADDRESS 0x3FB7D6 /begin FUNCTION_LIST HFM /end FUNCTION_LIST /end MEASUREMENT
/begin MEASUREMENT hfm_stat_trig_seg_3of15_ "Zaehler Array fuer Triggers per Segment" UWORD FORMULA_0000 0 0 0.0 65535.0000 ECU_ADDRESS 0x3FB7D8 /begin FUNCTION_LIST HFM /end FUNCTION_LIST /end MEASUREMENT
/begin MEASUREMENT hfm_stat_trig_seg_4of15_ "Zaehler Array fuer Triggers per Segment" UWORD FORMULA_0000 0 0 0.0 65535.0000 ECU_ADDRESS 0x3FB7DA /begin FUNCTION_LIST HFM /end FUNCTION_LIST /end MEASUREMENT
/begin MEASUREMENT hfm_stat_trig_seg_5of15_ "Zaehler Array fuer Triggers per Segment" UWORD FORMULA_0000 0 0 0.0 65535.0000 ECU_ADDRESS 0x3FB7DC /begin FUNCTION_LIST HFM /end FUNCTION_LIST /end MEASUREMENT
/begin MEASUREMENT hfm_stat_trig_seg_6of15_ "Zaehler Array fuer Triggers per Segment" UWORD FORMULA_0000 0 0 0.0 65535.0000 ECU_ADDRESS 0x3FB7DE /begin FUNCTION_LIST HFM /end FUNCTION_LIST /end MEASUREMENT
/begin MEASUREMENT hfm_stat_trig_seg_7of15_ "Zaehler Array fuer Triggers per Segment" UWORD FORMULA_0000 0 0 0.0 65535.0000 ECU_ADDRESS 0x3FB7E0 /begin FUNCTION_LIST HFM /end FUNCTION_LIST /end MEASUREMENT
/begin MEASUREMENT hfm_stat_trig_seg_8of15_ "Zaehler Array fuer Triggers per Segment" UWORD FORMULA_0000 0 0 0.0 65535.0000 ECU_ADDRESS 0x3FB7E2 /begin FUNCTION_LIST HFM /end FUNCTION_LIST /end MEASUREMENT
/begin MEASUREMENT hfm_stat_trig_seg_9of15_ "Zaehler Array fuer Triggers per Segment" UWORD FORMULA_0000 0 0 0.0 65535.0000 ECU_ADDRESS 0x3FB7E4 /begin FUNCTION_LIST HFM /end FUNCTION_LIST /end MEASUREMENT
/begin MEASUREMENT hfm_stat_trig_seg_10of15_ "Zaehler Array fuer Triggers per Segment" UWORD FORMULA_0000 0 0 0.0 65535.0000 ECU_ADDRESS 0x3FB7E6 /begin FUNCTION_LIST HFM /end FUNCTION_LIST /end MEASUREMENT
/begin MEASUREMENT hfm_stat_trig_seg_11of15_ "Zaehler Array fuer Triggers per Segment" UWORD FORMULA_0000 0 0 0.0 65535.0000 ECU_ADDRESS 0x3FB7E8 /begin FUNCTION_LIST HFM /end FUNCTION_LIST /end MEASUREMENT
/begin MEASUREMENT hfm_stat_trig_seg_12of15_ "Zaehler Array fuer Triggers per Segment" UWORD FORMULA_0000 0 0 0.0 65535.0000 ECU_ADDRESS 0x3FB7EA /begin FUNCTION_LIST HFM /end FUNCTION_LIST /end MEASUREMENT
/begin MEASUREMENT hfm_stat_trig_seg_13of15_ "Zaehler Array fuer Triggers per Segment" UWORD FORMULA_0000 0 0 0.0 65535.0000 ECU_ADDRESS 0x3FB7EC /begin FUNCTION_LIST HFM /end FUNCTION_LIST /end MEASUREMENT
/begin MEASUREMENT hfm_stat_trig_seg_14of15_ "Zaehler Array fuer Triggers per Segment" UWORD FORMULA_0000 0 0 0.0 65535.0000 ECU_ADDRESS 0x3FB7EE /begin FUNCTION_LIST HFM /end FUNCTION_LIST /end MEASUREMENT
/begin MEASUREMENT hfm_stat_trig_seg_15of15_ "Zaehler Array fuer Triggers per Segment" UWORD FORMULA_0000 0 0 0.0 65535.0000 ECU_ADDRESS 0x3FB7F0 /begin FUNCTION_LIST HFM /end FUNCTION_LIST /end MEASUREMENT
/begin MEASUREMENT hfm_zz_upd "Zahnzaehler bei letztem queue update" UBYTE FORMULA_0113 0 0 0.0 119.0000 ECU_ADDRESS 0x3FB7F2 /begin FUNCTION_LIST HFM /end FUNCTION_LIST /end MEASUREMENT
/begin MEASUREMENT hfm_qadc_anz_read "Anzahl der Samples in der Queue" UWORD FORMULA_0024 0 0 0.0 65535.0000 ECU_ADDRESS 0x3FB7F4 /begin FUNCTION_LIST HFM /end FUNCTION_LIST /end MEASUREMENT
/begin MEASUREMENT hfm_tau "Filtertaukonstante" UWORD FORMULA_0114 0 0 0.1000 25.6000 ECU_ADDRESS 0x3FB7F6 /begin FUNCTION_LIST HFM /end FUNCTION_LIST /end MEASUREMENT
/* ------------------ Abschnitt erzeugt aus kva.dat ------------------ */
/begin CHARACTERISTIC K_KVA_SPEC_WEIGHT "Dichte von Ottokraftstoff unverbleit." VALUE 0x60438 TKW_VV_VV_UW 100.0 FORMULA_0119 0.0 1000.0000 /begin FUNCTION_LIST Einspritzung /end FUNCTION_LIST FORMAT "%4.1" /end CHARACTERISTIC
/begin CHARACTERISTIC K_KVA_CORRECTION "Korrekturkonstante von KVA." VALUE 0x6043A TKW_VV_VV_UW 100.0 FORMULA_0120 0.0 4.0000 /begin FUNCTION_LIST Einspritzung /end FUNCTION_LIST FORMAT "%6.3" /end CHARACTERISTIC
/begin MEASUREMENT kva_last_cnt "Letzter Kraftstoffverbrauchszaehler der TPU." ULONG FORMULA_0118 0 0 0.0 2147483647.0000 ECU_ADDRESS 0x3FB89C /begin FUNCTION_LIST Einspritzung /end FUNCTION_LIST /end MEASUREMENT
/begin MEASUREMENT kva_can "Letzter Kraftstoffverbrauch in µl." UWORD FORMULA_0024 0 0 0.0 65535.0000 ECU_ADDRESS 0x3FB8A0 /begin FUNCTION_LIST Einspritzung /end FUNCTION_LIST /end MEASUREMENT
/* ------------------ Abschnitt erzeugt aus n_inj.dat ------------------ */
/begin CHARACTERISTIC K_N_OBERGRENZE "Plausibilitätsgrenze fuer die n-Erfassung" VALUE 0x6079C TKW_VV_VV_SW 100.0 FORMULA_0011 0.0 20000.0000 /begin FUNCTION_LIST Drehzahlerfassung /end FUNCTION_LIST /end CHARACTERISTIC
/begin CHARACTERISTIC K_N_ZEIT_STOERUNG "Einfrierzeit Drehzahlerfassung nach TPU Stoerung" VALUE 0x6079E TKW_VV_VV_SB 100.0 FORMULA_0167 0.0 1.2700 /begin FUNCTION_LIST Drehzahlerfassung /end FUNCTION_LIST /end CHARACTERISTIC
/begin CHARACTERISTIC K_N_BEGR_TI_OFFSET "N-Offset zwischen Momenteneingriff und Einspritzausblendung" VALUE 0x607A0 TKW_VV_VV_SW 100.0 FORMULA_0011 0.0 5000.0000 /begin FUNCTION_LIST Drehzahlerfassung /end FUNCTION_LIST /end CHARACTERISTIC
/begin CHARACTERISTIC K_N_BEGR_TI_HYS "Hysterese fuer N-Begrenzung über Einspritzausblendung" VALUE 0x607A2 TKW_VV_VV_SW 100.0 FORMULA_0011 0.0 500.0000 /begin FUNCTION_LIST Drehzahlerfassung /end FUNCTION_LIST /end CHARACTERISTIC
/begin CHARACTERISTIC KL_N_BEGR_GANG "gangabhaengige Drehzahlbegrenzung" CURVE 0x607A4 TKL_SW_VV_SW 100.0 FORMULA_0011 0.0 10000.0000 /begin FUNCTION_LIST Drehzahlerfassung /end FUNCTION_LIST /begin AXIS_DESCR STD_AXIS gang FORMULA_0168 8 -1.0000 10.0000 /end AXIS_DESCR /end CHARACTERISTIC
/begin MEASUREMENT n_zahn "Drehzahl aus Zahnabstand" SWORD FORMULA_0011 0 0 0.0 10000.0000 ECU_ADDRESS 0x3FBA8C /begin FUNCTION_LIST Drehzahlerfassung /end FUNCTION_LIST /end MEASUREMENT
/begin MEASUREMENT n_segm1 "Drehzahl aus Segmentabstand Bank1" SWORD FORMULA_0011 0 0 0.0 10000.0000 ECU_ADDRESS 0x3FBA8E /begin FUNCTION_LIST Drehzahlerfassung /end FUNCTION_LIST /end MEASUREMENT
/begin MEASUREMENT n_segm2 "Drehzahl aus Segmentabstand Bank2" SWORD FORMULA_0011 0 0 0.0 10000.0000 ECU_ADDRESS 0x3FBA90 /begin FUNCTION_LIST Drehzahlerfassung /end FUNCTION_LIST /end MEASUREMENT
/begin MEASUREMENT t_segm1 "Segmentdrehzahl Bank1" UWORD FORMULA_0165 0 0 0.0 104.8560 ECU_ADDRESS 0x3FBA92 /begin FUNCTION_LIST Drehzahlerfassung /end FUNCTION_LIST /end MEASUREMENT
/begin MEASUREMENT t_segm2 "Segmentdrehzahl Bank2" UWORD FORMULA_0165 0 0 0.0 104.8560 ECU_ADDRESS 0x3FBA94 /begin FUNCTION_LIST Drehzahlerfassung /end FUNCTION_LIST /end MEASUREMENT
/begin MEASUREMENT n_begr_egas "Drehzahlbegrenzung ueber Momenteneingriff" SWORD FORMULA_0011 0 0 0.0 10000.0000 ECU_ADDRESS 0x3FBA96 /begin FUNCTION_LIST Drehzahlerfassung /end FUNCTION_LIST /end MEASUREMENT
/begin MEASUREMENT n_begr_ti "Drehzahlbegrenzung ueber Einspritzausblendung" SWORD FORMULA_0011 0 0 0.0 10000.0000 ECU_ADDRESS 0x3FBA98 /begin FUNCTION_LIST Drehzahlerfassung /end FUNCTION_LIST /end MEASUREMENT
/begin MEASUREMENT n_st "Status Drehzahlerfassung" UBYTE FORMULA_0166 0 0 0.0 255.0 ECU_ADDRESS 0x3FBA9A /begin FUNCTION_LIST Drehzahlerfassung /end FUNCTION_LIST /end MEASUREMENT
/begin MEASUREMENT n_timer_stoerung "Zeitzaehler fuer Freeze Drehzahlerfassung" SBYTE FORMULA_0167 0 0 -1.2800 1.2700 ECU_ADDRESS 0x3FBA9B /begin FUNCTION_LIST Drehzahlerfassung /end FUNCTION_LIST /end MEASUREMENT
/* ------------------ Abschnitt erzeugt aus ti.dat ------------------ */
/begin CHARACTERISTIC K_TI_ON "" VALUE 0x60D52 TKW_VV_VV_UW 100.0 FORMULA_0024 0.0 1.0000 /begin FUNCTION_LIST Einspritzung /end FUNCTION_LIST FORMAT "%5.2" /end CHARACTERISTIC
/begin CHARACTERISTIC K_TI_VSP_CFG "FREIGABE VSP" VALUE 0x60D54 TKW_VV_VV_UW 100.0 FORMULA_0000 0.0 1023.0000 /begin FUNCTION_LIST Einspritzung /end FUNCTION_LIST /end CHARACTERISTIC
/begin CHARACTERISTIC K_TI_VSP_MIN "min. Begrenzung VSP-Wert" VALUE 0x60D56 TKW_VV_VV_UW 100.0 FORMULA_0187 0.0 655.3500 /begin FUNCTION_LIST Einspritzung /end FUNCTION_LIST FORMAT "%5.2" /end CHARACTERISTIC
/begin CHARACTERISTIC K_TI_VSP_MAX "max. Begrenzung VSP-Wert" VALUE 0x60D58 TKW_VV_VV_UW 100.0 FORMULA_0187 0.0 655.3500 /begin FUNCTION_LIST Einspritzung /end FUNCTION_LIST FORMAT "%5.2" /end CHARACTERISTIC
/begin CHARACTERISTIC K_TI_GRUND_ML_CFG "Freigabe Berechnung mit ML_SR" VALUE 0x60D5A TKW_VV_VV_UB 100.0 FORMULA_0008 0.0 1.0000 /begin FUNCTION_LIST Einspritzung /end FUNCTION_LIST /end CHARACTERISTIC
/begin CHARACTERISTIC K_TI_MKS_TE_CFG "Einrechnung TE-MKS" VALUE 0x60D5B TKW_VV_VV_UB 100.0 FORMULA_0008 0.0 1.0000 /begin FUNCTION_LIST Einspritzung /end FUNCTION_LIST /end CHARACTERISTIC
/begin CHARACTERISTIC K_TI_MKS_OELV_CFG "Einrechnung OELV-MKS" VALUE 0x60D5C TKW_VV_VV_UB 100.0 FORMULA_0008 0.0 1.0000 /begin FUNCTION_LIST Einspritzung /end FUNCTION_LIST /end CHARACTERISTIC
/begin CHARACTERISTIC K_TI_MKS_LWV_CFG "Einrechnung LWV-MKS" VALUE 0x60D5D TKW_VV_VV_UB 100.0 FORMULA_0008 0.0 1.0000 /begin FUNCTION_LIST Einspritzung /end FUNCTION_LIST /end CHARACTERISTIC
/begin CHARACTERISTIC K_TI_MKS_WF_CFG "Einrechnung WF-MKS" VALUE 0x60D5E TKW_VV_VV_UB 100.0 FORMULA_0008 0.0 1.0000 /begin FUNCTION_LIST Einspritzung /end FUNCTION_LIST /end CHARACTERISTIC
/begin CHARACTERISTIC K_TI_VSP_WF_CFG "Einrechnung VSP-WF-MKS" VALUE 0x60D5F TKW_VV_VV_UB 100.0 FORMULA_0008 0.0 1.0000 /begin FUNCTION_LIST Einspritzung /end FUNCTION_LIST /end CHARACTERISTIC
/begin CHARACTERISTIC K_TI_GA "Grundadaptionsfaktor" VALUE 0x60D60 TKW_VV_VV_UW 100.0 FORMULA_0150 0.0 10.0000 /begin FUNCTION_LIST Einspritzung /end FUNCTION_LIST FORMAT "%5.2" /end CHARACTERISTIC
/begin CHARACTERISTIC K_TI_GRUND_STOECH "stoechometrischer Faktor" VALUE 0x60D62 TKW_VV_VV_UW 100.0 FORMULA_0150 0.0 511.9921 /begin FUNCTION_LIST Einspritzung /end FUNCTION_LIST FORMAT "%5.2" /end CHARACTERISTIC
/begin CHARACTERISTIC K_TI_MAX_OFFS "Offset f. max. TI" VALUE 0x60D64 TKW_VV_VV_UW 100.0 FORMULA_0135 0.0 65.5350 /begin FUNCTION_LIST Einspritzung /end FUNCTION_LIST FORMAT "%5.2" /end CHARACTERISTIC
/begin CHARACTERISTIC K_TI_MIN_MAX_HYS "Hysterese f. MIN/MAX-TI" VALUE 0x60D66 TKW_VV_VV_UW 100.0 FORMULA_0135 0.0 65.5350 /begin FUNCTION_LIST Einspritzung /end FUNCTION_LIST FORMAT "%5.2" /end CHARACTERISTIC
/begin CHARACTERISTIC K_TI_PHI_ENDE_ES "Schliesswinkel Einlassventil" VALUE 0x60D68 TKW_VV_VV_SW 100.0 FORMULA_0188 -72.0000 1440.0000 /begin FUNCTION_LIST Einspritzung /end FUNCTION_LIST FORMAT "%4.1" /end CHARACTERISTIC
/begin CHARACTERISTIC K_TI_PHI_ENDE_A_ZYL "Zylinderflaeche" VALUE 0x60D6A TKW_VV_VV_UW 100.0 FORMULA_0210 0.0 6553.5000 /begin FUNCTION_LIST Einspritzung /end FUNCTION_LIST FORMAT "%5.2" /end CHARACTERISTIC
/begin CHARACTERISTIC K_TI_PHI_ENDE_S_HUB "Kolbenhub" VALUE 0x60D6C TKW_VV_VV_UW 100.0 FORMULA_0211 0.0 150.0000 /begin FUNCTION_LIST Einspritzung /end FUNCTION_LIST FORMAT "%5.2" /end CHARACTERISTIC
/begin CHARACTERISTIC K_TI_PHI_ENDE_A_SAUG "mittlerer Saugrohrquerschnitt" VALUE 0x60D6E TKW_VV_VV_UW 100.0 FORMULA_0210 0.0 2000.0000 /begin FUNCTION_LIST Einspritzung /end FUNCTION_LIST FORMAT "%5.2" /end CHARACTERISTIC
/begin CHARACTERISTIC K_TI_PHI_ENDE_ROH_KST "Kraftstoffdichte" VALUE 0x60D70 TKW_VV_VV_UW 100.0 FORMULA_0212 0.0 2.0000 /begin FUNCTION_LIST Einspritzung /end FUNCTION_LIST FORMAT "%5.2" /end CHARACTERISTIC
/begin CHARACTERISTIC K_TI_PHI_ENDE_S_ESV_EV "Strecke zwischen EV zu EV" VALUE 0x60D72 TKW_VV_VV_UW 100.0 FORMULA_0213 0.0 0.6103 /begin FUNCTION_LIST Einspritzung /end FUNCTION_LIST FORMAT "%7.4" /end CHARACTERISTIC
/begin CHARACTERISTIC K_TI_WL_TMOT "Freigabe WL ueber TMOT" VALUE 0x60D74 TKW_VV_VV_SW 100.0 FORMULA_0019 -50.0000 150.0000 /begin FUNCTION_LIST Einspritzung /end FUNCTION_LIST FORMAT "%4.1" /end CHARACTERISTIC
/begin CHARACTERISTIC K_TI_WL_TMOT_HYS "Temperatur in Kelvin" VALUE 0x60D76 TKW_VV_VV_SW 100.0 FORMULA_0146 0.0 1000.0000 /begin FUNCTION_LIST Einspritzung /end FUNCTION_LIST FORMAT "%4.1" /end CHARACTERISTIC
/begin CHARACTERISTIC K_TI_WL_F "Warmlauffaktor" VALUE 0x60D78 TKW_VV_VV_UW 100.0 FORMULA_0150 0.0 511.9921 /begin FUNCTION_LIST Einspritzung /end FUNCTION_LIST FORMAT "%5.2" /end CHARACTERISTIC
/begin CHARACTERISTIC K_TI_START_WKS_B1 "Faktor f. WKS in B1" VALUE 0x60D7A TKW_VV_VV_UW 100.0 FORMULA_0150 0.0 511.9921 /begin FUNCTION_LIST Einspritzung /end FUNCTION_LIST FORMAT "%5.2" /end CHARACTERISTIC
/begin CHARACTERISTIC K_TI_START_WKS_B2 "Faktor f. WKS in B2" VALUE 0x60D7C TKW_VV_VV_UW 100.0 FORMULA_0150 0.0 511.9921 /begin FUNCTION_LIST Einspritzung /end FUNCTION_LIST FORMAT "%5.2" /end CHARACTERISTIC
/begin CHARACTERISTIC K_TI_START_HS_TMOT "Temperaturschwelle f. Heisstart" VALUE 0x60D7E TKW_VV_VV_SW 100.0 FORMULA_0019 -50.0000 150.0000 /begin FUNCTION_LIST Einspritzung /end FUNCTION_LIST FORMAT "%4.1" /end CHARACTERISTIC
/begin CHARACTERISTIC K_TI_START_KS_TMOT "Temperaturschwelle fuer Kaltstart" VALUE 0x60D80 TKW_VV_VV_SW 100.0 FORMULA_0019 -50.0000 150.0000 /begin FUNCTION_LIST Einspritzung /end FUNCTION_LIST FORMAT "%4.1" /end CHARACTERISTIC
/begin CHARACTERISTIC K_TI_START_NO_CNT "NO-Schwelle" VALUE 0x60D82 TKW_VV_VV_UW 100.0 FORMULA_0214 0.0 65535.0000 /begin FUNCTION_LIST Einspritzung /end FUNCTION_LIST /end CHARACTERISTIC
/begin CHARACTERISTIC K_TI_MIN_OFF_TIME "Minimale Ventilauszeit." VALUE 0x60D84 TKW_VV_VV_UW 100.0 FORMULA_0215 0.0 65.5350 /begin FUNCTION_LIST Einspritzung /end FUNCTION_LIST FORMAT "%5.2" /end CHARACTERISTIC
/begin CHARACTERISTIC KL_TI_VSP_MKS "MKS im START - VSP" CURVE 0x60D86 TKL_SW_VV_UW 100.0 FORMULA_0205 0.0 2500.0000 /begin FUNCTION_LIST Einspritzung /end FUNCTION_LIST
 /begin AXIS_DESCR STD_AXIS tan FORMULA_0019 7 -50.0000 150.0000 FORMAT "%4.1" /end AXIS_DESCR
 FORMAT "%5.2" /end CHARACTERISTIC
/begin CHARACTERISTIC KL_TI_SOLL_RHO_F "Kompensationsfak. Kraftsoffdichte" CURVE 0x60DA4 TKL_SW_VV_UW 100.0 FORMULA_0150 0.0 10.0000 /begin FUNCTION_LIST Einspritzung /end FUNCTION_LIST
 /begin AXIS_DESCR STD_AXIS tks FORMULA_0019 4 -50.0000 150.0000 FORMAT "%4.1" /end AXIS_DESCR
 FORMAT "%5.2" /end CHARACTERISTIC
/begin CHARACTERISTIC KL_TI_SOLL_QSTAT_F "proportionaler Ventilparameter" CURVE 0x60DB6 TKL_SW_VV_UW 100.0 FORMULA_0206 0.0 6.0000 /begin FUNCTION_LIST Einspritzung /end FUNCTION_LIST /begin AXIS_DESCR STD_AXIS pdiff FORMULA_0016 4 0.0 10.0000 FORMAT "%6.3" /end AXIS_DESCR FORMAT "%6.3" /end CHARACTERISTIC
/begin CHARACTERISTIC KL_TI_SOLL_LIN_OFFS "Linearisierungskompensation" CURVE 0x60DC8 TKL_UW_VV_SW 100.0 FORMULA_0135 -2.0000 2.0000 /begin FUNCTION_LIST Einspritzung /end FUNCTION_LIST /begin AXIS_DESCR STD_AXIS ti_soll FORMULA_0135 6 0.0 65.5350 FORMAT "%5.2" /end AXIS_DESCR FORMAT "%5.2" /end CHARACTERISTIC
/begin CHARACTERISTIC KL_TI_PHI_ENDE_START "ti_ende im START" CURVE 0x60DE2 TKL_SW_VV_SW 100.0 FORMULA_0188 -72.0000 1440.0000 /begin FUNCTION_LIST Einspritzung /end FUNCTION_LIST
 /begin AXIS_DESCR STD_AXIS tmot FORMULA_0019 7 -50.0000 150.0000 FORMAT "%4.1" /end AXIS_DESCR
 FORMAT "%4.1" /end CHARACTERISTIC
/begin CHARACTERISTIC KL_TI_PHI_EV_WURZEL "Darstellung Wurzel-Fluggeschwindigkeit" CURVE 0x60E00 TKL_UW_VV_SW 100.0 FORMULA_0207 0.0 220.0000 /begin FUNCTION_LIST Einspritzung /end FUNCTION_LIST
 /begin AXIS_DESCR STD_AXIS ti_phi_ev_v_wurz FORMULA_0209 10 0.0 1638.3750 FORMAT "%6.3" /end AXIS_DESCR
 FORMAT "%5.2" /end CHARACTERISTIC
/begin CHARACTERISTIC KL_TI_START_HS_TAN_F "TAN-abhaengiger START-Faktor" CURVE 0x60E2A TKL_SW_VV_UW 100.0 FORMULA_0150 0.0 511.9921 /begin FUNCTION_LIST Einspritzung /end FUNCTION_LIST
 /begin AXIS_DESCR STD_AXIS tan FORMULA_0019 4 -50.0000 150.0000 FORMAT "%4.1" /end AXIS_DESCR
 FORMAT "%5.2" /end CHARACTERISTIC
/begin CHARACTERISTIC KL_TI_START_B2_N_F "N-abhaengiger START-Faktor" CURVE 0x60E3C TKL_SW_VV_UW 100.0 FORMULA_0150 0.0 511.9921 /begin FUNCTION_LIST Einspritzung /end FUNCTION_LIST /begin AXIS_DESCR STD_AXIS n FORMULA_0011 3 0.0 10000.0000 /end AXIS_DESCR FORMAT "%5.2" /end CHARACTERISTIC
/begin CHARACTERISTIC KL_TI_START_B2_N "Drehzahlschwelle f. B_B2" CURVE 0x60E4A TKL_SW_VV_SW 100.0 FORMULA_0011 0.0 10000.0000 /begin FUNCTION_LIST Einspritzung /end FUNCTION_LIST
 /begin AXIS_DESCR STD_AXIS tmot FORMULA_0019 2 -50.0000 150.0000 FORMAT "%4.1" /end AXIS_DESCR
/end CHARACTERISTIC
/begin CHARACTERISTIC KL_TI_START_KS_TMOT_F "TMOT-abhaengiger START-Faktor" CURVE 0x60E54 TKL_SW_VV_UW 100.0 FORMULA_0150 0.0 511.9921 /begin FUNCTION_LIST Einspritzung /end FUNCTION_LIST
 /begin AXIS_DESCR STD_AXIS tmot FORMULA_0019 7 -50.0000 150.0000 FORMAT "%4.1" /end AXIS_DESCR
 FORMAT "%5.2" /end CHARACTERISTIC
/begin CHARACTERISTIC KL_TI_START_KS_NO_CNT "Abregelfaktor ueber NO-Zaehler" CURVE 0x60E72 TKL_UW_VV_UW 100.0 FORMULA_0150 0.0 511.9921 /begin FUNCTION_LIST Einspritzung /end FUNCTION_LIST /begin AXIS_DESCR STD_AXIS nw_zaehler FORMULA_0216 4 0.0 65535.0000 /end AXIS_DESCR FORMAT "%5.2" /end CHARACTERISTIC
/begin CHARACTERISTIC KL_TI_START_WKS_MS "WKS-Schwelle f. Zeit seit Motor steht" CURVE 0x60E84 TKL_SW_VV_UW 100.0 FORMULA_0217 0.0 65535.0000 /begin FUNCTION_LIST Einspritzung /end FUNCTION_LIST
 /begin AXIS_DESCR STD_AXIS tmot FORMULA_0019 4 -50.0000 150.0000 FORMAT "%4.1" /end AXIS_DESCR
 FORMAT "%5.2" /end CHARACTERISTIC
/begin CHARACTERISTIC KL_TI_START_WKS_ML "Zeitschwelle f. WKS-Erkennung" CURVE 0x60E96 TKL_SW_VV_UW 100.0 FORMULA_0145 0.0 65535.0000 /begin FUNCTION_LIST Einspritzung /end FUNCTION_LIST
 /begin AXIS_DESCR STD_AXIS tmot_start FORMULA_0019 4 -50.0000 150.0000 FORMAT "%4.1" /end AXIS_DESCR
/end CHARACTERISTIC
/begin CHARACTERISTIC KF_TI_SOLL_UB_OFFS "UB-abhaengiger TI-Offset " MAP 0x60EA8 TKF_SW_SW_UW 100.0 FORMULA_0135 0.0 65.5350 /begin FUNCTION_LIST Einspritzung /end FUNCTION_LIST /begin AXIS_DESCR STD_AXIS ub FORMULA_0045 5 0.0 28.0000 FORMAT "%4.1" /end AXIS_DESCR /begin AXIS_DESCR STD_AXIS pks-psau FORMULA_0016 4 0.0 10.0000 FORMAT "%6.3" /end AXIS_DESCR FORMAT "%5.2" /end CHARACTERISTIC
/begin CHARACTERISTIC KF_TI_SOLL_MIN "minimale Einspritzzeit" MAP 0x60EE4 TKF_SW_SW_UW 100.0 FORMULA_0135 0.0 65.5350 /begin FUNCTION_LIST Einspritzung /end FUNCTION_LIST /begin AXIS_DESCR STD_AXIS ub FORMULA_0045 5 0.0 28.0000 FORMAT "%4.1" /end AXIS_DESCR /begin AXIS_DESCR STD_AXIS pks-psau FORMULA_0016 4 0.0 10.0000 FORMAT "%6.3" /end AXIS_DESCR FORMAT "%5.2" /end CHARACTERISTIC
/begin CHARACTERISTIC KF_TI_PHI_ENDE_OFFS "Offset Einspritzendewinkel" MAP 0x60F20 TKF_SW_SW_SW 100.0 FORMULA_0188 -72.0000 1440.0000 /begin FUNCTION_LIST Einspritzung /end FUNCTION_LIST
 /begin AXIS_DESCR STD_AXIS tmot FORMULA_0019 7 -50.0000 150.0000 FORMAT "%4.1" /end AXIS_DESCR
 /begin AXIS_DESCR STD_AXIS tan FORMULA_0019 7 -50.0000 150.0000 FORMAT "%4.1" /end AXIS_DESCR
 FORMAT "%4.1" /end CHARACTERISTIC
/begin CHARACTERISTIC KF_TI_PHI_ENDE_GRUND "Vorlagerungswinkel aus Grundkennfeld" MAP 0x60FA0 TKF_SW_SW_SW 100.0 FORMULA_0188 -72.0000 1440.0000 /begin FUNCTION_LIST Einspritzung /end FUNCTION_LIST /begin AXIS_DESCR STD_AXIS n FORMULA_0011 6 0.0 10000.0000 /end AXIS_DESCR
 /begin AXIS_DESCR STD_AXIS psau_rel FORMULA_0020 5 0.0 120.0000 FORMAT "%5.2" /end AXIS_DESCR
 FORMAT "%4.1" /end CHARACTERISTIC
/begin CHARACTERISTIC KF_TI_TU_F "Tuning-Faktor f. TI" MAP 0x60FF4 TKF_SW_SW_UW 100.0 FORMULA_0150 0.0 10.0000 /begin FUNCTION_LIST Einspritzung /end FUNCTION_LIST /begin AXIS_DESCR STD_AXIS n FORMULA_0011 6 0.0 10000.0000 /end AXIS_DESCR /begin AXIS_DESCR STD_AXIS Zylinder FORMULA_0218 12 1.0000 12.0000 /end AXIS_DESCR FORMAT "%5.2" /end CHARACTERISTIC
/begin MEASUREMENT ti_b1.vsp_mks_tan "MKS im START - VSP" UWORD FORMULA_0205 0 0 0.0 2500.0000 ECU_ADDRESS 0x3FBD52 /begin FUNCTION_LIST Einspritzung /end FUNCTION_LIST /end MEASUREMENT
/begin MEASUREMENT ti_b2.vsp_mks_tan "MKS im START - VSP" UWORD FORMULA_0205 0 0 0.0 2500.0000 ECU_ADDRESS 0x3FBD78 /begin FUNCTION_LIST Einspritzung /end FUNCTION_LIST /end MEASUREMENT
/begin MEASUREMENT ti_b1.pdiff "Differenz pks-psau" SWORD FORMULA_0016 0 0 0.0 10.0000 ECU_ADDRESS 0x3FBD54 /begin FUNCTION_LIST Einspritzung /end FUNCTION_LIST /end MEASUREMENT
/begin MEASUREMENT ti_b2.pdiff "Differenz pks-psau" SWORD FORMULA_0016 0 0 0.0 10.0000 ECU_ADDRESS 0x3FBD7A /begin FUNCTION_LIST Einspritzung /end FUNCTION_LIST /end MEASUREMENT
/begin MEASUREMENT ti_b1.rho_f "Kompensationsfak. Kraftsoffdichte" UWORD FORMULA_0150 0 0 0.0 511.9921 ECU_ADDRESS 0x3FBD56 /begin FUNCTION_LIST Einspritzung /end FUNCTION_LIST /end MEASUREMENT
/begin MEASUREMENT ti_b2.rho_f "Kompensationsfak. Kraftsoffdichte" UWORD FORMULA_0150 0 0 0.0 511.9921 ECU_ADDRESS 0x3FBD7C /begin FUNCTION_LIST Einspritzung /end FUNCTION_LIST /end MEASUREMENT
/begin MEASUREMENT ti_b1.qstat_f "proportionaler Ventilparameter" UWORD FORMULA_0206 0 0 0.0 6.0000 ECU_ADDRESS 0x3FBD58 /begin FUNCTION_LIST Einspritzung /end FUNCTION_LIST /end MEASUREMENT
/begin MEASUREMENT ti_b2.qstat_f "proportionaler Ventilparameter" UWORD FORMULA_0206 0 0 0.0 6.0000 ECU_ADDRESS 0x3FBD7E /begin FUNCTION_LIST Einspritzung /end FUNCTION_LIST /end MEASUREMENT
/begin MEASUREMENT ti_b1.ub_offs "UB-abhaengiger TI-Offset " UWORD FORMULA_0135 0 0 0.0 65.5350 ECU_ADDRESS 0x3FBD5A /begin FUNCTION_LIST Einspritzung /end FUNCTION_LIST /end MEASUREMENT
/begin MEASUREMENT ti_b2.ub_offs "UB-abhaengiger TI-Offset " UWORD FORMULA_0135 0 0 0.0 65.5350 ECU_ADDRESS 0x3FBD80 /begin FUNCTION_LIST Einspritzung /end FUNCTION_LIST /end MEASUREMENT
/begin MEASUREMENT ti_b1.min "min. TI-Zeit" UWORD FORMULA_0135 0 0 0.0 65.5350 ECU_ADDRESS 0x3FBD5C /begin FUNCTION_LIST Einspritzung /end FUNCTION_LIST /end MEASUREMENT
/begin MEASUREMENT ti_b2.min "min. TI-Zeit" UWORD FORMULA_0135 0 0 0.0 65.5350 ECU_ADDRESS 0x3FBD82 /begin FUNCTION_LIST Einspritzung /end FUNCTION_LIST /end MEASUREMENT
/begin MEASUREMENT ti_b1.ml_mg_zyl "zyl. Luftmasse in mg/ASP" SWORD FORMULA_0144 0 0 -3276.7000 3276.7000 ECU_ADDRESS 0x3FBD5E /begin FUNCTION_LIST Einspritzung /end FUNCTION_LIST /end MEASUREMENT
/begin MEASUREMENT ti_b2.ml_mg_zyl "zyl. Luftmasse in mg/ASP" SWORD FORMULA_0144 0 0 -3276.7000 3276.7000 ECU_ADDRESS 0x3FBD84 /begin FUNCTION_LIST Einspritzung /end FUNCTION_LIST /end MEASUREMENT
/begin MEASUREMENT ti_b1.ml_mg_la "Luftmasse/Zyl incl. LA-Einfl." UWORD FORMULA_0125 0 0 0.0 1023.9843 ECU_ADDRESS 0x3FBD60 /begin FUNCTION_LIST Einspritzung /end FUNCTION_LIST /end MEASUREMENT
/begin MEASUREMENT ti_b2.ml_mg_la "Luftmasse/Zyl incl. LA-Einfl." UWORD FORMULA_0125 0 0 0.0 1023.9843 ECU_ADDRESS 0x3FBD86 /begin FUNCTION_LIST Einspritzung /end FUNCTION_LIST /end MEASUREMENT
/begin MEASUREMENT ti_b1.mks_grund "Grundeinspritzmasse" UWORD FORMULA_0125 0 0 0.0 1023.9843 ECU_ADDRESS 0x3FBD62 /begin FUNCTION_LIST Einspritzung /end FUNCTION_LIST /end MEASUREMENT
/begin MEASUREMENT ti_b2.mks_grund "Grundeinspritzmasse" UWORD FORMULA_0125 0 0 0.0 1023.9843 ECU_ADDRESS 0x3FBD88 /begin FUNCTION_LIST Einspritzung /end FUNCTION_LIST /end MEASUREMENT
/begin MEASUREMENT ti_b1.wl_f "Warmlauffaktor" UWORD FORMULA_0150 0 0 0.0 511.9921 ECU_ADDRESS 0x3FBD64 /begin FUNCTION_LIST Einspritzung /end FUNCTION_LIST /end MEASUREMENT
/begin MEASUREMENT ti_b2.wl_f "Warmlauffaktor" UWORD FORMULA_0150 0 0 0.0 511.9921 ECU_ADDRESS 0x3FBD8A /begin FUNCTION_LIST Einspritzung /end FUNCTION_LIST /end MEASUREMENT
/begin MEASUREMENT ti_b1.phi_ende "Einspritzendewinkel" SWORD FORMULA_0188 0 0 -72.0000 1440.0000 ECU_ADDRESS 0x3FBD66 /begin FUNCTION_LIST Einspritzung /end FUNCTION_LIST /end MEASUREMENT
/begin MEASUREMENT ti_b2.phi_ende "Einspritzendewinkel" SWORD FORMULA_0188 0 0 -72.0000 1440.0000 ECU_ADDRESS 0x3FBD8C /begin FUNCTION_LIST Einspritzung /end FUNCTION_LIST /end MEASUREMENT
/begin MEASUREMENT ti_b1.phi_ende_grund "Vorlagerungsgrundwinkel" SWORD FORMULA_0188 0 0 -72.0000 1440.0000 ECU_ADDRESS 0x3FBD68 /begin FUNCTION_LIST Einspritzung /end FUNCTION_LIST /end MEASUREMENT
/begin MEASUREMENT ti_b2.phi_ende_grund "Vorlagerungsgrundwinkel" SWORD FORMULA_0188 0 0 -72.0000 1440.0000 ECU_ADDRESS 0x3FBD8E /begin FUNCTION_LIST Einspritzung /end FUNCTION_LIST /end MEASUREMENT
/begin MEASUREMENT ti_b1.phi_ev_v "Fluggeschwindigkeit Kraftstoff" SWORD FORMULA_0207 0 0 0.0 220.0000 ECU_ADDRESS 0x3FBD6A /begin FUNCTION_LIST Einspritzung /end FUNCTION_LIST /end MEASUREMENT
/begin MEASUREMENT ti_b2.phi_ev_v "Fluggeschwindigkeit Kraftstoff" SWORD FORMULA_0207 0 0 0.0 220.0000 ECU_ADDRESS 0x3FBD90 /begin FUNCTION_LIST Einspritzung /end FUNCTION_LIST /end MEASUREMENT
/begin MEASUREMENT ti_b1.phi_ks_v "Fluggeschwindigkeit Kraftstoff" SWORD FORMULA_0207 0 0 0.0 220.0000 ECU_ADDRESS 0x3FBD6C /begin FUNCTION_LIST Einspritzung /end FUNCTION_LIST /end MEASUREMENT
/begin MEASUREMENT ti_b2.phi_ks_v "Fluggeschwindigkeit Kraftstoff" SWORD FORMULA_0207 0 0 0.0 220.0000 ECU_ADDRESS 0x3FBD92 /begin FUNCTION_LIST Einspritzung /end FUNCTION_LIST /end MEASUREMENT
/begin MEASUREMENT ti_b1.phi_ende_flug "Flugwinkel Kraftstoff" SWORD FORMULA_0188 0 0 -72.0000 1440.0000 ECU_ADDRESS 0x3FBD6E /begin FUNCTION_LIST Einspritzung /end FUNCTION_LIST /end MEASUREMENT
/begin MEASUREMENT ti_b2.phi_ende_flug "Flugwinkel Kraftstoff" SWORD FORMULA_0188 0 0 -72.0000 1440.0000 ECU_ADDRESS 0x3FBD94 /begin FUNCTION_LIST Einspritzung /end FUNCTION_LIST /end MEASUREMENT
/begin MEASUREMENT ti_b1.phi_ende_min "min. Einspritzendewinkel" SWORD FORMULA_0188 0 0 -72.0000 1440.0000 ECU_ADDRESS 0x3FBD70 /begin FUNCTION_LIST Einspritzung /end FUNCTION_LIST /end MEASUREMENT
/begin MEASUREMENT ti_b2.phi_ende_min "min. Einspritzendewinkel" SWORD FORMULA_0188 0 0 -72.0000 1440.0000 ECU_ADDRESS 0x3FBD96 /begin FUNCTION_LIST Einspritzung /end FUNCTION_LIST /end MEASUREMENT
/begin MEASUREMENT ti_vsp_st "TI-VSP-Status" UWORD FORMULA_0024 0 0 0.0 65535.0000 ECU_ADDRESS 0x3FBD9E /begin FUNCTION_LIST Einspritzung /end FUNCTION_LIST /end MEASUREMENT
/begin MEASUREMENT ti_tpu_st "TI-TPU-Status" UWORD FORMULA_0024 0 0 0.0 65535.0000 ECU_ADDRESS 0x3FBDA0 /begin FUNCTION_LIST Einspritzung /end FUNCTION_LIST /end MEASUREMENT
/begin MEASUREMENT ti_vsp_soll_zyl1 "SOLL-VSP ohne Korrekturen" UWORD FORMULA_0187 0 0 0.0 655.3500 ECU_ADDRESS 0x3FBDA2 /begin FUNCTION_LIST Einspritzung /end FUNCTION_LIST /end MEASUREMENT
/begin MEASUREMENT ti_vsp_soll_zyl2 "SOLL-VSP ohne Korrekturen" UWORD FORMULA_0187 0 0 0.0 655.3500 ECU_ADDRESS 0x3FBDA4 /begin FUNCTION_LIST Einspritzung /end FUNCTION_LIST /end MEASUREMENT
/begin MEASUREMENT ti_vsp_soll_zyl3 "SOLL-VSP ohne Korrekturen" UWORD FORMULA_0187 0 0 0.0 655.3500 ECU_ADDRESS 0x3FBDA6 /begin FUNCTION_LIST Einspritzung /end FUNCTION_LIST /end MEASUREMENT
/begin MEASUREMENT ti_vsp_soll_zyl4 "SOLL-VSP ohne Korrekturen" UWORD FORMULA_0187 0 0 0.0 655.3500 ECU_ADDRESS 0x3FBDA8 /begin FUNCTION_LIST Einspritzung /end FUNCTION_LIST /end MEASUREMENT
/begin MEASUREMENT ti_vsp_soll_zyl5 "SOLL-VSP ohne Korrekturen" UWORD FORMULA_0187 0 0 0.0 655.3500 ECU_ADDRESS 0x3FBDAA /begin FUNCTION_LIST Einspritzung /end FUNCTION_LIST /end MEASUREMENT
/begin MEASUREMENT ti_vsp_soll_zyl6 "SOLL-VSP ohne Korrekturen" UWORD FORMULA_0187 0 0 0.0 655.3500 ECU_ADDRESS 0x3FBDAC /begin FUNCTION_LIST Einspritzung /end FUNCTION_LIST /end MEASUREMENT
/begin MEASUREMENT ti_vsp_soll_zyl7 "SOLL-VSP ohne Korrekturen" UWORD FORMULA_0187 0 0 0.0 655.3500 ECU_ADDRESS 0x3FBDAE /begin FUNCTION_LIST Einspritzung /end FUNCTION_LIST /end MEASUREMENT
/begin MEASUREMENT ti_vsp_soll_zyl8 "SOLL-VSP ohne Korrekturen" UWORD FORMULA_0187 0 0 0.0 655.3500 ECU_ADDRESS 0x3FBDB0 /begin FUNCTION_LIST Einspritzung /end FUNCTION_LIST /end MEASUREMENT
/begin MEASUREMENT ti_vsp_soll_zyl9 "SOLL-VSP ohne Korrekturen" UWORD FORMULA_0187 0 0 0.0 655.3500 ECU_ADDRESS 0x3FBDB2 /begin FUNCTION_LIST Einspritzung /end FUNCTION_LIST /end MEASUREMENT
/begin MEASUREMENT ti_vsp_soll_zyl10 "SOLL-VSP ohne Korrekturen" UWORD FORMULA_0187 0 0 0.0 655.3500 ECU_ADDRESS 0x3FBDB4 /begin FUNCTION_LIST Einspritzung /end FUNCTION_LIST /end MEASUREMENT
/begin MEASUREMENT ti_vsp_soll_zyl11 "SOLL-VSP ohne Korrekturen" UWORD FORMULA_0187 0 0 0.0 655.3500 ECU_ADDRESS 0x3FBDB6 /begin FUNCTION_LIST Einspritzung /end FUNCTION_LIST /end MEASUREMENT
/begin MEASUREMENT ti_vsp_soll_zyl12 "SOLL-VSP ohne Korrekturen" UWORD FORMULA_0187 0 0 0.0 655.3500 ECU_ADDRESS 0x3FBDB8 /begin FUNCTION_LIST Einspritzung /end FUNCTION_LIST /end MEASUREMENT
/begin MEASUREMENT ti_vsp_zyl1 "TI-VSP mit allen Korrekturen" UWORD FORMULA_0187 0 0 0.0 655.3500 ECU_ADDRESS 0x3FBDBA /begin FUNCTION_LIST Einspritzung /end FUNCTION_LIST /end MEASUREMENT
/begin MEASUREMENT ti_vsp_zyl2 "TI-VSP mit allen Korrekturen" UWORD FORMULA_0187 0 0 0.0 655.3500 ECU_ADDRESS 0x3FBDBC /begin FUNCTION_LIST Einspritzung /end FUNCTION_LIST /end MEASUREMENT
/begin MEASUREMENT ti_vsp_zyl3 "TI-VSP mit allen Korrekturen" UWORD FORMULA_0187 0 0 0.0 655.3500 ECU_ADDRESS 0x3FBDBE /begin FUNCTION_LIST Einspritzung /end FUNCTION_LIST /end MEASUREMENT
/begin MEASUREMENT ti_vsp_zyl4 "TI-VSP mit allen Korrekturen" UWORD FORMULA_0187 0 0 0.0 655.3500 ECU_ADDRESS 0x3FBDC0 /begin FUNCTION_LIST Einspritzung /end FUNCTION_LIST /end MEASUREMENT
/begin MEASUREMENT ti_vsp_zyl5 "TI-VSP mit allen Korrekturen" UWORD FORMULA_0187 0 0 0.0 655.3500 ECU_ADDRESS 0x3FBDC2 /begin FUNCTION_LIST Einspritzung /end FUNCTION_LIST /end MEASUREMENT
/begin MEASUREMENT ti_vsp_zyl6 "TI-VSP mit allen Korrekturen" UWORD FORMULA_0187 0 0 0.0 655.3500 ECU_ADDRESS 0x3FBDC4 /begin FUNCTION_LIST Einspritzung /end FUNCTION_LIST /end MEASUREMENT
/begin MEASUREMENT ti_vsp_zyl7 "TI-VSP mit allen Korrekturen" UWORD FORMULA_0187 0 0 0.0 655.3500 ECU_ADDRESS 0x3FBDC6 /begin FUNCTION_LIST Einspritzung /end FUNCTION_LIST /end MEASUREMENT
/begin MEASUREMENT ti_vsp_zyl8 "TI-VSP mit allen Korrekturen" UWORD FORMULA_0187 0 0 0.0 655.3500 ECU_ADDRESS 0x3FBDC8 /begin FUNCTION_LIST Einspritzung /end FUNCTION_LIST /end MEASUREMENT
/begin MEASUREMENT ti_vsp_zyl9 "TI-VSP mit allen Korrekturen" UWORD FORMULA_0187 0 0 0.0 655.3500 ECU_ADDRESS 0x3FBDCA /begin FUNCTION_LIST Einspritzung /end FUNCTION_LIST /end MEASUREMENT
/begin MEASUREMENT ti_vsp_zyl10 "TI-VSP mit allen Korrekturen" UWORD FORMULA_0187 0 0 0.0 655.3500 ECU_ADDRESS 0x3FBDCC /begin FUNCTION_LIST Einspritzung /end FUNCTION_LIST /end MEASUREMENT
/begin MEASUREMENT ti_vsp_zyl11 "TI-VSP mit allen Korrekturen" UWORD FORMULA_0187 0 0 0.0 655.3500 ECU_ADDRESS 0x3FBDCE /begin FUNCTION_LIST Einspritzung /end FUNCTION_LIST /end MEASUREMENT
/begin MEASUREMENT ti_vsp_zyl12 "TI-VSP mit allen Korrekturen" UWORD FORMULA_0187 0 0 0.0 655.3500 ECU_ADDRESS 0x3FBDD0 /begin FUNCTION_LIST Einspritzung /end FUNCTION_LIST /end MEASUREMENT
/begin MEASUREMENT ti_lin_offs_zyl1 "Kompensationsoffset" SWORD FORMULA_0135 0 0 -32.3680 32.7670 ECU_ADDRESS 0x3FBDD2 /begin FUNCTION_LIST Einspritzung /end FUNCTION_LIST /end MEASUREMENT
/begin MEASUREMENT ti_lin_offs_zyl2 "Kompensationsoffset" SWORD FORMULA_0135 0 0 -32.3680 32.7670 ECU_ADDRESS 0x3FBDD4 /begin FUNCTION_LIST Einspritzung /end FUNCTION_LIST /end MEASUREMENT
/begin MEASUREMENT ti_lin_offs_zyl3 "Kompensationsoffset" SWORD FORMULA_0135 0 0 -32.3680 32.7670 ECU_ADDRESS 0x3FBDD6 /begin FUNCTION_LIST Einspritzung /end FUNCTION_LIST /end MEASUREMENT
/begin MEASUREMENT ti_lin_offs_zyl4 "Kompensationsoffset" SWORD FORMULA_0135 0 0 -32.3680 32.7670 ECU_ADDRESS 0x3FBDD8 /begin FUNCTION_LIST Einspritzung /end FUNCTION_LIST /end MEASUREMENT
/begin MEASUREMENT ti_lin_offs_zyl5 "Kompensationsoffset" SWORD FORMULA_0135 0 0 -32.3680 32.7670 ECU_ADDRESS 0x3FBDDA /begin FUNCTION_LIST Einspritzung /end FUNCTION_LIST /end MEASUREMENT
/begin MEASUREMENT ti_lin_offs_zyl6 "Kompensationsoffset" SWORD FORMULA_0135 0 0 -32.3680 32.7670 ECU_ADDRESS 0x3FBDDC /begin FUNCTION_LIST Einspritzung /end FUNCTION_LIST /end MEASUREMENT
/begin MEASUREMENT ti_lin_offs_zyl7 "Kompensationsoffset" SWORD FORMULA_0135 0 0 -32.3680 32.7670 ECU_ADDRESS 0x3FBDDE /begin FUNCTION_LIST Einspritzung /end FUNCTION_LIST /end MEASUREMENT
/begin MEASUREMENT ti_lin_offs_zyl8 "Kompensationsoffset" SWORD FORMULA_0135 0 0 -32.3680 32.7670 ECU_ADDRESS 0x3FBDE0 /begin FUNCTION_LIST Einspritzung /end FUNCTION_LIST /end MEASUREMENT
/begin MEASUREMENT ti_lin_offs_zyl9 "Kompensationsoffset" SWORD FORMULA_0135 0 0 -32.3680 32.7670 ECU_ADDRESS 0x3FBDE2 /begin FUNCTION_LIST Einspritzung /end FUNCTION_LIST /end MEASUREMENT
/begin MEASUREMENT ti_lin_offs_zyl10 "Kompensationsoffset" SWORD FORMULA_0135 0 0 -32.3680 32.7670 ECU_ADDRESS 0x3FBDE4 /begin FUNCTION_LIST Einspritzung /end FUNCTION_LIST /end MEASUREMENT
/begin MEASUREMENT ti_lin_offs_zyl11 "Kompensationsoffset" SWORD FORMULA_0135 0 0 -32.3680 32.7670 ECU_ADDRESS 0x3FBDE6 /begin FUNCTION_LIST Einspritzung /end FUNCTION_LIST /end MEASUREMENT
/begin MEASUREMENT ti_lin_offs_zyl12 "Kompensationsoffset" SWORD FORMULA_0135 0 0 -32.3680 32.7670 ECU_ADDRESS 0x3FBDE8 /begin FUNCTION_LIST Einspritzung /end FUNCTION_LIST /end MEASUREMENT
/begin MEASUREMENT ti_mks_soll_zyl1 "SOLL-Einspritzmasse" UWORD FORMULA_0125 0 0 0.0 1023.9843 ECU_ADDRESS 0x3FBDEA /begin FUNCTION_LIST Einspritzung /end FUNCTION_LIST /end MEASUREMENT
/begin MEASUREMENT ti_mks_soll_zyl2 "SOLL-Einspritzmasse" UWORD FORMULA_0125 0 0 0.0 1023.9843 ECU_ADDRESS 0x3FBDEC /begin FUNCTION_LIST Einspritzung /end FUNCTION_LIST /end MEASUREMENT
/begin MEASUREMENT ti_mks_soll_zyl3 "SOLL-Einspritzmasse" UWORD FORMULA_0125 0 0 0.0 1023.9843 ECU_ADDRESS 0x3FBDEE /begin FUNCTION_LIST Einspritzung /end FUNCTION_LIST /end MEASUREMENT
/begin MEASUREMENT ti_mks_soll_zyl4 "SOLL-Einspritzmasse" UWORD FORMULA_0125 0 0 0.0 1023.9843 ECU_ADDRESS 0x3FBDF0 /begin FUNCTION_LIST Einspritzung /end FUNCTION_LIST /end MEASUREMENT
/begin MEASUREMENT ti_mks_soll_zyl5 "SOLL-Einspritzmasse" UWORD FORMULA_0125 0 0 0.0 1023.9843 ECU_ADDRESS 0x3FBDF2 /begin FUNCTION_LIST Einspritzung /end FUNCTION_LIST /end MEASUREMENT
/begin MEASUREMENT ti_mks_soll_zyl6 "SOLL-Einspritzmasse" UWORD FORMULA_0125 0 0 0.0 1023.9843 ECU_ADDRESS 0x3FBDF4 /begin FUNCTION_LIST Einspritzung /end FUNCTION_LIST /end MEASUREMENT
/begin MEASUREMENT ti_mks_soll_zyl7 "SOLL-Einspritzmasse" UWORD FORMULA_0125 0 0 0.0 1023.9843 ECU_ADDRESS 0x3FBDF6 /begin FUNCTION_LIST Einspritzung /end FUNCTION_LIST /end MEASUREMENT
/begin MEASUREMENT ti_mks_soll_zyl8 "SOLL-Einspritzmasse" UWORD FORMULA_0125 0 0 0.0 1023.9843 ECU_ADDRESS 0x3FBDF8 /begin FUNCTION_LIST Einspritzung /end FUNCTION_LIST /end MEASUREMENT
/begin MEASUREMENT ti_mks_soll_zyl9 "SOLL-Einspritzmasse" UWORD FORMULA_0125 0 0 0.0 1023.9843 ECU_ADDRESS 0x3FBDFA /begin FUNCTION_LIST Einspritzung /end FUNCTION_LIST /end MEASUREMENT
/begin MEASUREMENT ti_mks_soll_zyl10 "SOLL-Einspritzmasse" UWORD FORMULA_0125 0 0 0.0 1023.9843 ECU_ADDRESS 0x3FBDFC /begin FUNCTION_LIST Einspritzung /end FUNCTION_LIST /end MEASUREMENT
/begin MEASUREMENT ti_mks_soll_zyl11 "SOLL-Einspritzmasse" UWORD FORMULA_0125 0 0 0.0 1023.9843 ECU_ADDRESS 0x3FBDFE /begin FUNCTION_LIST Einspritzung /end FUNCTION_LIST /end MEASUREMENT
/begin MEASUREMENT ti_mks_soll_zyl12 "SOLL-Einspritzmasse" UWORD FORMULA_0125 0 0 0.0 1023.9843 ECU_ADDRESS 0x3FBE00 /begin FUNCTION_LIST Einspritzung /end FUNCTION_LIST /end MEASUREMENT
/begin MEASUREMENT ti_max "max. TI" UWORD FORMULA_0135 0 0 0.0 65.5350 ECU_ADDRESS 0x3FBE02 /begin FUNCTION_LIST Einspritzung /end FUNCTION_LIST /end MEASUREMENT
/begin MEASUREMENT ti_soll_zyl1 "SOLL-TI ohne Korrekturen" UWORD FORMULA_0135 0 0 0.0 65.5350 ECU_ADDRESS 0x3FBE04 /begin FUNCTION_LIST Einspritzung /end FUNCTION_LIST /end MEASUREMENT
/begin MEASUREMENT ti_soll_zyl2 "SOLL-TI ohne Korrekturen" UWORD FORMULA_0135 0 0 0.0 65.5350 ECU_ADDRESS 0x3FBE06 /begin FUNCTION_LIST Einspritzung /end FUNCTION_LIST /end MEASUREMENT
/begin MEASUREMENT ti_soll_zyl3 "SOLL-TI ohne Korrekturen" UWORD FORMULA_0135 0 0 0.0 65.5350 ECU_ADDRESS 0x3FBE08 /begin FUNCTION_LIST Einspritzung /end FUNCTION_LIST /end MEASUREMENT
/begin MEASUREMENT ti_soll_zyl4 "SOLL-TI ohne Korrekturen" UWORD FORMULA_0135 0 0 0.0 65.5350 ECU_ADDRESS 0x3FBE0A /begin FUNCTION_LIST Einspritzung /end FUNCTION_LIST /end MEASUREMENT
/begin MEASUREMENT ti_soll_zyl5 "SOLL-TI ohne Korrekturen" UWORD FORMULA_0135 0 0 0.0 65.5350 ECU_ADDRESS 0x3FBE0C /begin FUNCTION_LIST Einspritzung /end FUNCTION_LIST /end MEASUREMENT
/begin MEASUREMENT ti_soll_zyl6 "SOLL-TI ohne Korrekturen" UWORD FORMULA_0135 0 0 0.0 65.5350 ECU_ADDRESS 0x3FBE0E /begin FUNCTION_LIST Einspritzung /end FUNCTION_LIST /end MEASUREMENT
/begin MEASUREMENT ti_soll_zyl7 "SOLL-TI ohne Korrekturen" UWORD FORMULA_0135 0 0 0.0 65.5350 ECU_ADDRESS 0x3FBE10 /begin FUNCTION_LIST Einspritzung /end FUNCTION_LIST /end MEASUREMENT
/begin MEASUREMENT ti_soll_zyl8 "SOLL-TI ohne Korrekturen" UWORD FORMULA_0135 0 0 0.0 65.5350 ECU_ADDRESS 0x3FBE12 /begin FUNCTION_LIST Einspritzung /end FUNCTION_LIST /end MEASUREMENT
/begin MEASUREMENT ti_soll_zyl9 "SOLL-TI ohne Korrekturen" UWORD FORMULA_0135 0 0 0.0 65.5350 ECU_ADDRESS 0x3FBE14 /begin FUNCTION_LIST Einspritzung /end FUNCTION_LIST /end MEASUREMENT
/begin MEASUREMENT ti_soll_zyl10 "SOLL-TI ohne Korrekturen" UWORD FORMULA_0135 0 0 0.0 65.5350 ECU_ADDRESS 0x3FBE16 /begin FUNCTION_LIST Einspritzung /end FUNCTION_LIST /end MEASUREMENT
/begin MEASUREMENT ti_soll_zyl11 "SOLL-TI ohne Korrekturen" UWORD FORMULA_0135 0 0 0.0 65.5350 ECU_ADDRESS 0x3FBE18 /begin FUNCTION_LIST Einspritzung /end FUNCTION_LIST /end MEASUREMENT
/begin MEASUREMENT ti_soll_zyl12 "SOLL-TI ohne Korrekturen" UWORD FORMULA_0135 0 0 0.0 65.5350 ECU_ADDRESS 0x3FBE1A /begin FUNCTION_LIST Einspritzung /end FUNCTION_LIST /end MEASUREMENT
/begin MEASUREMENT ti_berech_zyl1 "TI mit allen Korrekturen" UWORD FORMULA_0135 0 0 0.0 65.5350 ECU_ADDRESS 0x3FBE1C /begin FUNCTION_LIST Einspritzung /end FUNCTION_LIST /end MEASUREMENT
/begin MEASUREMENT ti_berech_zyl2 "TI mit allen Korrekturen" UWORD FORMULA_0135 0 0 0.0 65.5350 ECU_ADDRESS 0x3FBE1E /begin FUNCTION_LIST Einspritzung /end FUNCTION_LIST /end MEASUREMENT
/begin MEASUREMENT ti_berech_zyl3 "TI mit allen Korrekturen" UWORD FORMULA_0135 0 0 0.0 65.5350 ECU_ADDRESS 0x3FBE20 /begin FUNCTION_LIST Einspritzung /end FUNCTION_LIST /end MEASUREMENT
/begin MEASUREMENT ti_berech_zyl4 "TI mit allen Korrekturen" UWORD FORMULA_0135 0 0 0.0 65.5350 ECU_ADDRESS 0x3FBE22 /begin FUNCTION_LIST Einspritzung /end FUNCTION_LIST /end MEASUREMENT
/begin MEASUREMENT ti_berech_zyl5 "TI mit allen Korrekturen" UWORD FORMULA_0135 0 0 0.0 65.5350 ECU_ADDRESS 0x3FBE24 /begin FUNCTION_LIST Einspritzung /end FUNCTION_LIST /end MEASUREMENT
/begin MEASUREMENT ti_berech_zyl6 "TI mit allen Korrekturen" UWORD FORMULA_0135 0 0 0.0 65.5350 ECU_ADDRESS 0x3FBE26 /begin FUNCTION_LIST Einspritzung /end FUNCTION_LIST /end MEASUREMENT
/begin MEASUREMENT ti_berech_zyl7 "TI mit allen Korrekturen" UWORD FORMULA_0135 0 0 0.0 65.5350 ECU_ADDRESS 0x3FBE28 /begin FUNCTION_LIST Einspritzung /end FUNCTION_LIST /end MEASUREMENT
/begin MEASUREMENT ti_berech_zyl8 "TI mit allen Korrekturen" UWORD FORMULA_0135 0 0 0.0 65.5350 ECU_ADDRESS 0x3FBE2A /begin FUNCTION_LIST Einspritzung /end FUNCTION_LIST /end MEASUREMENT
/begin MEASUREMENT ti_berech_zyl9 "TI mit allen Korrekturen" UWORD FORMULA_0135 0 0 0.0 65.5350 ECU_ADDRESS 0x3FBE2C /begin FUNCTION_LIST Einspritzung /end FUNCTION_LIST /end MEASUREMENT
/begin MEASUREMENT ti_berech_zyl10 "TI mit allen Korrekturen" UWORD FORMULA_0135 0 0 0.0 65.5350 ECU_ADDRESS 0x3FBE2E /begin FUNCTION_LIST Einspritzung /end FUNCTION_LIST /end MEASUREMENT
/begin MEASUREMENT ti_berech_zyl11 "TI mit allen Korrekturen" UWORD FORMULA_0135 0 0 0.0 65.5350 ECU_ADDRESS 0x3FBE30 /begin FUNCTION_LIST Einspritzung /end FUNCTION_LIST /end MEASUREMENT
/begin MEASUREMENT ti_berech_zyl12 "TI mit allen Korrekturen" UWORD FORMULA_0135 0 0 0.0 65.5350 ECU_ADDRESS 0x3FBE32 /begin FUNCTION_LIST Einspritzung /end FUNCTION_LIST /end MEASUREMENT
/begin MEASUREMENT ti_tpu_zyl1 "begrenztes, ausgegebenes TI" UWORD FORMULA_0135 0 0 0.0 65.5350 ECU_ADDRESS 0x3FBE34 /begin FUNCTION_LIST Einspritzung /end FUNCTION_LIST /end MEASUREMENT
/begin MEASUREMENT ti_tpu_zyl2 "begrenztes, ausgegebenes TI" UWORD FORMULA_0135 0 0 0.0 65.5350 ECU_ADDRESS 0x3FBE36 /begin FUNCTION_LIST Einspritzung /end FUNCTION_LIST /end MEASUREMENT
/begin MEASUREMENT ti_tpu_zyl3 "begrenztes, ausgegebenes TI" UWORD FORMULA_0135 0 0 0.0 65.5350 ECU_ADDRESS 0x3FBE38 /begin FUNCTION_LIST Einspritzung /end FUNCTION_LIST /end MEASUREMENT
/begin MEASUREMENT ti_tpu_zyl4 "begrenztes, ausgegebenes TI" UWORD FORMULA_0135 0 0 0.0 65.5350 ECU_ADDRESS 0x3FBE3A /begin FUNCTION_LIST Einspritzung /end FUNCTION_LIST /end MEASUREMENT
/begin MEASUREMENT ti_tpu_zyl5 "begrenztes, ausgegebenes TI" UWORD FORMULA_0135 0 0 0.0 65.5350 ECU_ADDRESS 0x3FBE3C /begin FUNCTION_LIST Einspritzung /end FUNCTION_LIST /end MEASUREMENT
/begin MEASUREMENT ti_tpu_zyl6 "begrenztes, ausgegebenes TI" UWORD FORMULA_0135 0 0 0.0 65.5350 ECU_ADDRESS 0x3FBE3E /begin FUNCTION_LIST Einspritzung /end FUNCTION_LIST /end MEASUREMENT
/begin MEASUREMENT ti_tpu_zyl7 "begrenztes, ausgegebenes TI" UWORD FORMULA_0135 0 0 0.0 65.5350 ECU_ADDRESS 0x3FBE40 /begin FUNCTION_LIST Einspritzung /end FUNCTION_LIST /end MEASUREMENT
/begin MEASUREMENT ti_tpu_zyl8 "begrenztes, ausgegebenes TI" UWORD FORMULA_0135 0 0 0.0 65.5350 ECU_ADDRESS 0x3FBE42 /begin FUNCTION_LIST Einspritzung /end FUNCTION_LIST /end MEASUREMENT
/begin MEASUREMENT ti_tpu_zyl9 "begrenztes, ausgegebenes TI" UWORD FORMULA_0135 0 0 0.0 65.5350 ECU_ADDRESS 0x3FBE44 /begin FUNCTION_LIST Einspritzung /end FUNCTION_LIST /end MEASUREMENT
/begin MEASUREMENT ti_tpu_zyl10 "begrenztes, ausgegebenes TI" UWORD FORMULA_0135 0 0 0.0 65.5350 ECU_ADDRESS 0x3FBE46 /begin FUNCTION_LIST Einspritzung /end FUNCTION_LIST /end MEASUREMENT
/begin MEASUREMENT ti_tpu_zyl11 "begrenztes, ausgegebenes TI" UWORD FORMULA_0135 0 0 0.0 65.5350 ECU_ADDRESS 0x3FBE48 /begin FUNCTION_LIST Einspritzung /end FUNCTION_LIST /end MEASUREMENT
/begin MEASUREMENT ti_tpu_zyl12 "begrenztes, ausgegebenes TI" UWORD FORMULA_0135 0 0 0.0 65.5350 ECU_ADDRESS 0x3FBE4A /begin FUNCTION_LIST Einspritzung /end FUNCTION_LIST /end MEASUREMENT
/begin MEASUREMENT ti_start_st "START-Bereich-Status" UWORD FORMULA_0208 0 0 0.0 65535.0 ECU_ADDRESS 0x3FBE4C /begin FUNCTION_LIST Einspritzung /end FUNCTION_LIST BIT_MASK 0x7F /end MEASUREMENT
/begin MEASUREMENT ti_start_tan "TAN-abhaengiger START-Faktor" UWORD FORMULA_0150 0 0 0.0 511.9921 ECU_ADDRESS 0x3FBE4E /begin FUNCTION_LIST Einspritzung /end FUNCTION_LIST /end MEASUREMENT
/begin MEASUREMENT ti_start_n "N-abhaengiger START-Faktor" UWORD FORMULA_0150 0 0 0.0 511.9921 ECU_ADDRESS 0x3FBE50 /begin FUNCTION_LIST Einspritzung /end FUNCTION_LIST /end MEASUREMENT
/begin MEASUREMENT ti_start_tmot "TMOT-abhaengiger START-Faktor" UWORD FORMULA_0150 0 0 0.0 511.9921 ECU_ADDRESS 0x3FBE52 /begin FUNCTION_LIST Einspritzung /end FUNCTION_LIST /end MEASUREMENT
/begin MEASUREMENT ti_start_no_cnt "Abregelfaktor ueber NO-Zaehler" UWORD FORMULA_0150 0 0 0.0 511.9921 ECU_ADDRESS 0x3FBE54 /begin FUNCTION_LIST Einspritzung /end FUNCTION_LIST /end MEASUREMENT
/begin MEASUREMENT ti_start_f "Starteinspritzmassenfaktor" UWORD FORMULA_0150 0 0 0.0 511.9921 ECU_ADDRESS 0x3FBE56 /begin FUNCTION_LIST Einspritzung /end FUNCTION_LIST /end MEASUREMENT
/begin MEASUREMENT ti_phi_ende_start "ti_ende im START" SWORD FORMULA_0188 0 0 -72.0000 1440.0000 ECU_ADDRESS 0x3FBE58 /begin FUNCTION_LIST Einspritzung /end FUNCTION_LIST /end MEASUREMENT
/begin MEASUREMENT ti_phi_ende_offs "Offset Einspritzendewinkel" SWORD FORMULA_0188 0 0 -72.0000 1440.0000 ECU_ADDRESS 0x3FBE5A /begin FUNCTION_LIST Einspritzung /end FUNCTION_LIST /end MEASUREMENT
/begin MEASUREMENT ti_phi_flug_v "Fluggeschwindigkeit Kraftstoff" SWORD FORMULA_0207 0 0 0.0 220.0000 ECU_ADDRESS 0x3FBE5C /begin FUNCTION_LIST Einspritzung /end FUNCTION_LIST /end MEASUREMENT
/begin MEASUREMENT ti_phi_ev_v_wurz "Beschleunigung Kraftstoff" UWORD FORMULA_0209 0 0 0.0 1638.3750 ECU_ADDRESS 0x3FBE5E /begin FUNCTION_LIST Einspritzung /end FUNCTION_LIST /end MEASUREMENT
/begin MEASUREMENT ti_pks_down_st "TI-PKS_DOWN-Status" UWORD FORMULA_0024 0 0 0.0 65535.0000 ECU_ADDRESS 0x3FBE60 /begin FUNCTION_LIST Einspritzung /end FUNCTION_LIST /end MEASUREMENT
/begin MEASUREMENT ti_pks_up_st "TI-PKS-UP-Status" UWORD FORMULA_0024 0 0 0.0 65535.0000 ECU_ADDRESS 0x3FBE62 /begin FUNCTION_LIST Einspritzung /end FUNCTION_LIST /end MEASUREMENT
/begin MEASUREMENT te_mks_b1 "MKS aus d. Tankentlueftung" SWORD FORMULA_0125 0 0 -512.0000 511.0000 ECU_ADDRESS 0x3FBE64 /begin FUNCTION_LIST Einspritzung /end FUNCTION_LIST /end MEASUREMENT
/begin MEASUREMENT te_mks_b2 "MKS aus d. Tankentlueftung" SWORD FORMULA_0125 0 0 -512.0000 511.0000 ECU_ADDRESS 0x3FBE66 /begin FUNCTION_LIST Einspritzung /end FUNCTION_LIST /end MEASUREMENT
/begin MEASUREMENT oelv_mks "MKS aus Oelverduennungsmodell" SWORD FORMULA_0125 0 0 -512.0000 511.0000 ECU_ADDRESS 0x3FBE68 /begin FUNCTION_LIST Einspritzung /end FUNCTION_LIST /end MEASUREMENT
/begin MEASUREMENT lwv_mks "MKS aus Ladungswechselmodell" SWORD FORMULA_0125 0 0 -512.0000 511.0000 ECU_ADDRESS 0x3FBE6A /begin FUNCTION_LIST Einspritzung /end FUNCTION_LIST /end MEASUREMENT
/begin FUNCTION Adaptionswerte "Adaptionswerte" /end FUNCTION
/begin FUNCTION Drehzahlerfassung "Drehzahlerfassung" /end FUNCTION
/begin FUNCTION EEPROM "EEPROM" /end FUNCTION
/begin FUNCTION Einspritzung "Einspritzung" /end FUNCTION
/begin FUNCTION Elektroluefter "Elektroluefter" /end FUNCTION
/begin FUNCTION Gangerkennung "Gangerkennung" /end FUNCTION
/begin FUNCTION Global "Global" /end FUNCTION
/begin FUNCTION HFM "HFM" /end FUNCTION
/begin FUNCTION Heimatlos "Heimatlos" /end FUNCTION
/begin RECORD_LAYOUT TKW_VV_VV_UB FNC_VALUES 1 UBYTE COLUMN_DIR DIRECT /end RECORD_LAYOUT
/begin RECORD_LAYOUT TKW_VV_VV_SB FNC_VALUES 1 SBYTE COLUMN_DIR DIRECT /end RECORD_LAYOUT
/begin RECORD_LAYOUT TKW_VV_VV_UW FNC_VALUES 1 UWORD COLUMN_DIR DIRECT /end RECORD_LAYOUT
/begin RECORD_LAYOUT TKW_VV_VV_SW FNC_VALUES 1 SWORD COLUMN_DIR DIRECT /end RECORD_LAYOUT
/begin RECORD_LAYOUT TKL_UW_VV_UW NO_AXIS_PTS_X 1 UBYTE RESERVED 2 BYTE AXIS_PTS_X 3 UWORD INDEX_INCR DIRECT FNC_VALUES 4 UWORD COLUMN_DIR DIRECT /end RECORD_LAYOUT
/begin RECORD_LAYOUT TKL_UW_VV_SW NO_AXIS_PTS_X 1 UBYTE RESERVED 2 BYTE AXIS_PTS_X 3 UWORD INDEX_INCR DIRECT FNC_VALUES 4 SWORD COLUMN_DIR DIRECT /end RECORD_LAYOUT
/begin RECORD_LAYOUT TKL_SW_VV_UB NO_AXIS_PTS_X 1 UBYTE RESERVED 2 BYTE AXIS_PTS_X 3 SWORD INDEX_INCR DIRECT FNC_VALUES 4 UBYTE COLUMN_DIR DIRECT /end RECORD_LAYOUT
/begin RECORD_LAYOUT TKL_SW_VV_UW NO_AXIS_PTS_X 1 UBYTE RESERVED 2 BYTE AXIS_PTS_X 3 SWORD INDEX_INCR DIRECT FNC_VALUES 4 UWORD COLUMN_DIR DIRECT /end RECORD_LAYOUT
/begin RECORD_LAYOUT TKL_SW_VV_SW NO_AXIS_PTS_X 1 UBYTE RESERVED 2 BYTE AXIS_PTS_X 3 SWORD INDEX_INCR DIRECT FNC_VALUES 4 SWORD COLUMN_DIR DIRECT /end RECORD_LAYOUT
/begin RECORD_LAYOUT TKF_SW_SW_UW NO_AXIS_PTS_X 1 UBYTE NO_AXIS_PTS_Y 2 UBYTE AXIS_PTS_X 3 SWORD INDEX_INCR DIRECT AXIS_PTS_Y 4 SWORD INDEX_INCR DIRECT FNC_VALUES 5 UWORD COLUMN_DIR DIRECT /end RECORD_LAYOUT
/begin RECORD_LAYOUT TKF_SW_SW_SW NO_AXIS_PTS_X 1 UBYTE NO_AXIS_PTS_Y 2 UBYTE AXIS_PTS_X 3 SWORD INDEX_INCR DIRECT AXIS_PTS_Y 4 SWORD INDEX_INCR DIRECT FNC_VALUES 5 SWORD COLUMN_DIR DIRECT /end RECORD_LAYOUT
/end MODULE
/end PROJECT
