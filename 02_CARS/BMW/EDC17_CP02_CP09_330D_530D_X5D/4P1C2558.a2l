ASAP2_VERSION 1 4
/begin PROJECT P_558 "EDC17_CP02"
/begin HEADER "" VERSION "V1C1" PROJECT_NO P_558 /end HEADER
/begin MODULE DIM ""
/begin MOD_COMMON "" BYTE_ORDER MSB_LAST ALIGNMENT_BYTE 1 ALIGNMENT_WORD 2 ALIGNMENT_LONG 4 ALIGNMENT_FLOAT32_IEEE 4 /end MOD_COMMON
/begin CHARACTERISTIC DFES_EnvRef.DFC_AirCtlGovDvtEOMMax_C "/" VALUE 0x80074812 Val_Wu16 109. DFES_EnvTabVerb 0.00 109. FORMAT "%2.0" /end CHARACTERISTIC
/begin CHARACTERISTIC DFES_EnvRef.DFC_AirCtlGovDvtEOMMin_C "/" VALUE 0x80074814 Val_Wu16 109. DFES_EnvTabVerb 0.00 109. FORMAT "%2.0" /end CHARACTERISTIC
/begin CHARACTERISTIC DFES_EnvRef.DFC_AirCtlGovDvtMax_C "/" VALUE 0x80074816 Val_Wu16 109. DFES_EnvTabVerb 0.00 109. FORMAT "%2.0" /end CHARACTERISTIC
/begin CHARACTERISTIC DFES_EnvRef.DFC_AirCtlGovDvtMin_C "/" VALUE 0x80074818 Val_Wu16 109. DFES_EnvTabVerb 0.00 109. FORMAT "%2.0" /end CHARACTERISTIC
/begin CHARACTERISTIC DFES_EnvRef.DFC_Cj945SpiCom1_C "/" VALUE 0x8007481A Val_Wu16 109. DFES_EnvTabVerb 0.00 109. FORMAT "%2.0" /end CHARACTERISTIC
/begin CHARACTERISTIC DFES_EnvRef.DFC_ComButtonMSASig_C "/" VALUE 0x8007481C Val_Wu16 109. DFES_EnvTabVerb 0.00 109. FORMAT "%2.0" /end CHARACTERISTIC
/begin CHARACTERISTIC DFES_EnvRef.DFC_ComButtonMSATo_C "/" VALUE 0x8007481E Val_Wu16 109. DFES_EnvTabVerb 0.00 109. FORMAT "%2.0" /end CHARACTERISTIC
/begin CHARACTERISTIC DFES_EnvRef.DFC_ComGearboxData2Sig_C "/" VALUE 0x80074820 Val_Wu16 109. DFES_EnvTabVerb 0.00 109. FORMAT "%2.0" /end CHARACTERISTIC
/begin CHARACTERISTIC DFES_EnvRef.DFC_ComGearboxData2To_C "/" VALUE 0x80074822 Val_Wu16 109. DFES_EnvTabVerb 0.00 109. FORMAT "%2.0" /end CHARACTERISTIC
/begin CHARACTERISTIC DFES_EnvRef.DFC_ComGearboxDataSig_C "/" VALUE 0x80074824 Val_Wu16 109. DFES_EnvTabVerb 0.00 109. FORMAT "%2.0" /end CHARACTERISTIC
/begin CHARACTERISTIC DFES_EnvRef.DFC_ComGearboxDataTo_C "/" VALUE 0x80074826 Val_Wu16 109. DFES_EnvTabVerb 0.00 109. FORMAT "%2.0" /end CHARACTERISTIC
/begin CHARACTERISTIC DFES_EnvRef.DFC_ComHeatACSig_C "/" VALUE 0x80074828 Val_Wu16 109. DFES_EnvTabVerb 0.00 109. FORMAT "%2.0" /end CHARACTERISTIC
/begin CHARACTERISTIC DFES_EnvRef.DFC_ComHeatACTo_C "/" VALUE 0x8007482A Val_Wu16 109. DFES_EnvTabVerb 0.00 109. FORMAT "%2.0" /end CHARACTERISTIC
/begin CHARACTERISTIC DFES_EnvRef.DFC_ComLenkradwinkelSig_C "/" VALUE 0x8007482C Val_Wu16 109. DFES_EnvTabVerb 0.00 109. FORMAT "%2.0" /end CHARACTERISTIC
/begin CHARACTERISTIC DFES_EnvRef.DFC_ComLenkradwinkelTo_C "/" VALUE 0x8007482E Val_Wu16 109. DFES_EnvTabVerb 0.00 109. FORMAT "%2.0" /end CHARACTERISTIC
/begin CHARACTERISTIC DFES_EnvRef.DFC_ComMileageRangeSig_C "/" VALUE 0x80074830 Val_Wu16 109. DFES_EnvTabVerb 0.00 109. FORMAT "%2.0" /end CHARACTERISTIC
/begin CHARACTERISTIC DFES_EnvRef.DFC_ComMileageRangeTo_C "/" VALUE 0x80074832 Val_Wu16 109. DFES_EnvTabVerb 0.00 109. FORMAT "%2.0" /end CHARACTERISTIC
/begin CHARACTERISTIC DFES_EnvRef.DFC_ComPspSig_C "/" VALUE 0x80074834 Val_Wu16 109. DFES_EnvTabVerb 0.00 109. FORMAT "%2.0" /end CHARACTERISTIC
/begin CHARACTERISTIC DFES_EnvRef.DFC_ComPspTo_C "/" VALUE 0x80074836 Val_Wu16 109. DFES_EnvTabVerb 0.00 109. FORMAT "%2.0" /end CHARACTERISTIC
/begin CHARACTERISTIC DFES_EnvRef.DFC_ComShutOffPSPSig_C "/" VALUE 0x80074838 Val_Wu16 109. DFES_EnvTabVerb 0.00 109. FORMAT "%2.0" /end CHARACTERISTIC
/begin CHARACTERISTIC DFES_EnvRef.DFC_ComShutOffPSPTo_C "/" VALUE 0x8007483A Val_Wu16 109. DFES_EnvTabVerb 0.00 109. FORMAT "%2.0" /end CHARACTERISTIC
/begin CHARACTERISTIC DFES_EnvRef.DFC_ComStKombiCtr_C "/" VALUE 0x8007483C Val_Wu16 109. DFES_EnvTabVerb 0.00 109. FORMAT "%2.0" /end CHARACTERISTIC
/begin CHARACTERISTIC DFES_EnvRef.DFC_ComStKombiSig_C "/" VALUE 0x8007483E Val_Wu16 109. DFES_EnvTabVerb 0.00 109. FORMAT "%2.0" /end CHARACTERISTIC
/begin CHARACTERISTIC DFES_EnvRef.DFC_ComStKombiTo_C "/" VALUE 0x80074840 Val_Wu16 109. DFES_EnvTabVerb 0.00 109. FORMAT "%2.0" /end CHARACTERISTIC
/begin CHARACTERISTIC DFES_EnvRef.DFC_ComStateARSCtr_C "/" VALUE 0x80074842 Val_Wu16 109. DFES_EnvTabVerb 0.00 109. FORMAT "%2.0" /end CHARACTERISTIC
/begin CHARACTERISTIC DFES_EnvRef.DFC_ComStateARSSig_C "/" VALUE 0x80074844 Val_Wu16 109. DFES_EnvTabVerb 0.00 109. FORMAT "%2.0" /end CHARACTERISTIC
/begin CHARACTERISTIC DFES_EnvRef.DFC_ComStateARSTo_C "/" VALUE 0x80074846 Val_Wu16 109. DFES_EnvTabVerb 0.00 109. FORMAT "%2.0" /end CHARACTERISTIC
/begin CHARACTERISTIC DFES_EnvRef.DFC_ComStateDscSig_C "/" VALUE 0x80074848 Val_Wu16 109. DFES_EnvTabVerb 0.00 109. FORMAT "%2.0" /end CHARACTERISTIC
/begin CHARACTERISTIC DFES_EnvRef.DFC_ComStateDscTo_C "/" VALUE 0x8007484A Val_Wu16 109. DFES_EnvTabVerb 0.00 109. FORMAT "%2.0" /end CHARACTERISTIC
/begin CHARACTERISTIC DFES_EnvRef.DFC_ComStateSeatSig_C "/" VALUE 0x8007484C Val_Wu16 109. DFES_EnvTabVerb 0.00 109. FORMAT "%2.0" /end CHARACTERISTIC
/begin CHARACTERISTIC DFES_EnvRef.DFC_ComStateSeatTo_C "/" VALUE 0x8007484E Val_Wu16 109. DFES_EnvTabVerb 0.00 109. FORMAT "%2.0" /end CHARACTERISTIC
/begin CHARACTERISTIC DFES_EnvRef.DFC_ComTempRelTimeSig_C "/" VALUE 0x80074850 Val_Wu16 109. DFES_EnvTabVerb 0.00 109. FORMAT "%2.0" /end CHARACTERISTIC
/begin CHARACTERISTIC DFES_EnvRef.DFC_ComTempRelTimeTo_C "/" VALUE 0x80074852 Val_Wu16 109. DFES_EnvTabVerb 0.00 109. FORMAT "%2.0" /end CHARACTERISTIC
/begin CHARACTERISTIC DFES_EnvRef.DFC_ComTerminalChk_C "/" VALUE 0x80074854 Val_Wu16 109. DFES_EnvTabVerb 0.00 109. FORMAT "%2.0" /end CHARACTERISTIC
/begin CHARACTERISTIC DFES_EnvRef.DFC_ComTerminalCtr_C "/" VALUE 0x80074856 Val_Wu16 109. DFES_EnvTabVerb 0.00 109. FORMAT "%2.0" /end CHARACTERISTIC
/begin CHARACTERISTIC DFES_EnvRef.DFC_ComTerminalSig_C "/" VALUE 0x80074858 Val_Wu16 109. DFES_EnvTabVerb 0.00 109. FORMAT "%2.0" /end CHARACTERISTIC
/begin CHARACTERISTIC DFES_EnvRef.DFC_ComTerminalTo_C "/" VALUE 0x8007485A Val_Wu16 109. DFES_EnvTabVerb 0.00 109. FORMAT "%2.0" /end CHARACTERISTIC
/begin CHARACTERISTIC DFES_EnvRef.DFC_ComTimeDateSig_C "/" VALUE 0x8007485C Val_Wu16 109. DFES_EnvTabVerb 0.00 109. FORMAT "%2.0" /end CHARACTERISTIC
/begin CHARACTERISTIC DFES_EnvRef.DFC_ComTimeDateTo_C "/" VALUE 0x8007485E Val_Wu16 109. DFES_EnvTabVerb 0.00 109. FORMAT "%2.0" /end CHARACTERISTIC
/begin CHARACTERISTIC DFES_EnvRef.DFC_ComTrailerSig_C "/" VALUE 0x80074860 Val_Wu16 109. DFES_EnvTabVerb 0.00 109. FORMAT "%2.0" /end CHARACTERISTIC
/begin CHARACTERISTIC DFES_EnvRef.DFC_ComTrailerTo_C "/" VALUE 0x80074862 Val_Wu16 109. DFES_EnvTabVerb 0.00 109. FORMAT "%2.0" /end CHARACTERISTIC
/begin CHARACTERISTIC DFES_EnvRef.DFC_ComTrqDemandAfsChk_C "/" VALUE 0x80074864 Val_Wu16 109. DFES_EnvTabVerb 0.00 109. FORMAT "%2.0" /end CHARACTERISTIC
/begin CHARACTERISTIC DFES_EnvRef.DFC_ComTrqDemandAfsCtr_C "/" VALUE 0x80074866 Val_Wu16 109. DFES_EnvTabVerb 0.00 109. FORMAT "%2.0" /end CHARACTERISTIC
/begin CHARACTERISTIC DFES_EnvRef.DFC_ComTrqDemandAfsSig_C "/" VALUE 0x80074868 Val_Wu16 109. DFES_EnvTabVerb 0.00 109. FORMAT "%2.0" /end CHARACTERISTIC
/begin CHARACTERISTIC DFES_EnvRef.DFC_ComTrqDemandAfsTo_C "/" VALUE 0x8007486A Val_Wu16 109. DFES_EnvTabVerb 0.00 109. FORMAT "%2.0" /end CHARACTERISTIC
/begin CHARACTERISTIC DFES_EnvRef.DFC_ComTrqDemandDscChk_C "/" VALUE 0x8007486C Val_Wu16 109. DFES_EnvTabVerb 0.00 109. FORMAT "%2.0" /end CHARACTERISTIC
/begin CHARACTERISTIC DFES_EnvRef.DFC_ComTrqDemandDscCtr_C "/" VALUE 0x8007486E Val_Wu16 109. DFES_EnvTabVerb 0.00 109. FORMAT "%2.0" /end CHARACTERISTIC
/begin CHARACTERISTIC DFES_EnvRef.DFC_ComTrqDemandDscSig_C "/" VALUE 0x80074870 Val_Wu16 109. DFES_EnvTabVerb 0.00 109. FORMAT "%2.0" /end CHARACTERISTIC
/begin CHARACTERISTIC DFES_EnvRef.DFC_ComTrqDemandDscTo_C "/" VALUE 0x80074872 Val_Wu16 109. DFES_EnvTabVerb 0.00 109. FORMAT "%2.0" /end CHARACTERISTIC
/begin CHARACTERISTIC DFES_EnvRef.DFC_ComTrqDemandGbxChk_C "/" VALUE 0x80074874 Val_Wu16 109. DFES_EnvTabVerb 0.00 109. FORMAT "%2.0" /end CHARACTERISTIC
/begin CHARACTERISTIC DFES_EnvRef.DFC_ComTrqDemandGbxCtr_C "/" VALUE 0x80074876 Val_Wu16 109. DFES_EnvTabVerb 0.00 109. FORMAT "%2.0" /end CHARACTERISTIC
/begin CHARACTERISTIC DFES_EnvRef.DFC_ComTrqDemandGbxSig_C "/" VALUE 0x80074878 Val_Wu16 109. DFES_EnvTabVerb 0.00 109. FORMAT "%2.0" /end CHARACTERISTIC
/begin CHARACTERISTIC DFES_EnvRef.DFC_ComTrqDemandGbxTo_C "/" VALUE 0x8007487A Val_Wu16 109. DFES_EnvTabVerb 0.00 109. FORMAT "%2.0" /end CHARACTERISTIC
/begin CHARACTERISTIC DFES_EnvRef.DFC_ComVelocitySig_C "/" VALUE 0x8007487C Val_Wu16 109. DFES_EnvTabVerb 0.00 109. FORMAT "%2.0" /end CHARACTERISTIC
/begin CHARACTERISTIC DFES_EnvRef.DFC_ComVelocityTo_C "/" VALUE 0x8007487E Val_Wu16 109. DFES_EnvTabVerb 0.00 109. FORMAT "%2.0" /end CHARACTERISTIC
/begin CHARACTERISTIC DFES_EnvRef.DFC_ComWheelSpeedSig_C "/" VALUE 0x80074880 Val_Wu16 109. DFES_EnvTabVerb 0.00 109. FORMAT "%2.0" /end CHARACTERISTIC
/begin CHARACTERISTIC DFES_EnvRef.DFC_ComWheelSpeedTo_C "/" VALUE 0x80074882 Val_Wu16 109. DFES_EnvTabVerb 0.00 109. FORMAT "%2.0" /end CHARACTERISTIC
/begin CHARACTERISTIC DFES_EnvRef.DFC_ComZvKlappenSig_C "/" VALUE 0x80074884 Val_Wu16 109. DFES_EnvTabVerb 0.00 109. FORMAT "%2.0" /end CHARACTERISTIC
/begin CHARACTERISTIC DFES_EnvRef.DFC_ComZvKlappenTo_C "/" VALUE 0x80074886 Val_Wu16 109. DFES_EnvTabVerb 0.00 109. FORMAT "%2.0" /end CHARACTERISTIC
/begin CHARACTERISTIC DFES_EnvRef.DFC_Cy150SpiCom_C "/" VALUE 0x80074888 Val_Wu16 109. DFES_EnvTabVerb 0.00 109. FORMAT "%2.0" /end CHARACTERISTIC
/begin CHARACTERISTIC DFES_EnvRef.DFC_Cy320SpiCom_C "/" VALUE 0x8007488A Val_Wu16 109. DFES_EnvTabVerb 0.00 109. FORMAT "%2.0" /end CHARACTERISTIC
/begin CHARACTERISTIC DFES_EnvRef.DFC_ETCtlDvtInrMax_C "/" VALUE 0x8007488C Val_Wu16 109. DFES_EnvTabVerb 0.00 109. FORMAT "%2.0" /end CHARACTERISTIC
/begin CHARACTERISTIC DFES_EnvRef.DFC_ETCtlDvtInrMin_C "/" VALUE 0x8007488E Val_Wu16 109. DFES_EnvTabVerb 0.00 109. FORMAT "%2.0" /end CHARACTERISTIC
/begin CHARACTERISTIC DFES_EnvRef.DFC_ETCtlDvtOutrMax_C "/" VALUE 0x80074890 Val_Wu16 109. DFES_EnvTabVerb 0.00 109. FORMAT "%2.0" /end CHARACTERISTIC
/begin CHARACTERISTIC DFES_EnvRef.DFC_ETCtlDvtOutrMin_C "/" VALUE 0x80074892 Val_Wu16 109. DFES_EnvTabVerb 0.00 109. FORMAT "%2.0" /end CHARACTERISTIC
/begin CHARACTERISTIC DFES_EnvRef.DFC_Fan4WinErr1_C "/" VALUE 0x80074894 Val_Wu16 109. DFES_EnvTabVerb 0.00 109. FORMAT "%2.0" /end CHARACTERISTIC
/begin CHARACTERISTIC DFES_EnvRef.DFC_Fan4WinErr2_C "/" VALUE 0x80074896 Val_Wu16 109. DFES_EnvTabVerb 0.00 109. FORMAT "%2.0" /end CHARACTERISTIC
/begin CHARACTERISTIC DFES_EnvRef.DFC_Fan4WinErr3_C "/" VALUE 0x80074898 Val_Wu16 109. DFES_EnvTabVerb 0.00 109. FORMAT "%2.0" /end CHARACTERISTIC
/begin CHARACTERISTIC DFES_EnvRef.DFC_Fan4WinErr4_C "/" VALUE 0x8007489A Val_Wu16 109. DFES_EnvTabVerb 0.00 109. FORMAT "%2.0" /end CHARACTERISTIC
/begin CHARACTERISTIC DFES_EnvRef.DFC_FanSCG_C "/" VALUE 0x8007489C Val_Wu16 109. DFES_EnvTabVerb 0.00 109. FORMAT "%2.0" /end CHARACTERISTIC
/begin CHARACTERISTIC DFES_EnvRef.DFC_PCRGovDvtLPMax_C "/" VALUE 0x8007489E Val_Wu16 109. DFES_EnvTabVerb 0.00 109. FORMAT "%2.0" /end CHARACTERISTIC
/begin CHARACTERISTIC DFES_EnvRef.DFC_PCRGovDvtLPMin_C "/" VALUE 0x800748A0 Val_Wu16 109. DFES_EnvTabVerb 0.00 109. FORMAT "%2.0" /end CHARACTERISTIC
/begin CHARACTERISTIC DFES_EnvRef.DFC_PCRGovDvtMax_C "/" VALUE 0x800748A2 Val_Wu16 109. DFES_EnvTabVerb 0.00 109. FORMAT "%2.0" /end CHARACTERISTIC
/begin CHARACTERISTIC DFES_EnvRef.DFC_PCRGovDvtMin_C "/" VALUE 0x800748A4 Val_Wu16 109. DFES_EnvTabVerb 0.00 109. FORMAT "%2.0" /end CHARACTERISTIC
/begin CHARACTERISTIC DFES_EnvRef.DFC_RailCPC1_C "/" VALUE 0x800748A6 Val_Wu16 109. DFES_EnvTabVerb 0.00 109. FORMAT "%2.0" /end CHARACTERISTIC
/begin CHARACTERISTIC DFES_EnvRef.DFC_RailCPC3_C "/" VALUE 0x800748A8 Val_Wu16 109. DFES_EnvTabVerb 0.00 109. FORMAT "%2.0" /end CHARACTERISTIC
/begin CHARACTERISTIC DFES_EnvRef.DFC_RailCPC4_C "/" VALUE 0x800748AA Val_Wu16 109. DFES_EnvTabVerb 0.00 109. FORMAT "%2.0" /end CHARACTERISTIC
/begin CHARACTERISTIC DFES_EnvRef.DFC_RailMeUn0_C "/" VALUE 0x800748AC Val_Wu16 109. DFES_EnvTabVerb 0.00 109. FORMAT "%2.0" /end CHARACTERISTIC
/begin CHARACTERISTIC DFES_EnvRef.DFC_RailMeUn1_C "/" VALUE 0x800748AE Val_Wu16 109. DFES_EnvTabVerb 0.00 109. FORMAT "%2.0" /end CHARACTERISTIC
/begin CHARACTERISTIC DFES_EnvRef.DFC_RailMeUn2_C "/" VALUE 0x800748B0 Val_Wu16 109. DFES_EnvTabVerb 0.00 109. FORMAT "%2.0" /end CHARACTERISTIC
/begin CHARACTERISTIC DFES_EnvRef.DFC_RailMeUn3_C "/" VALUE 0x800748B2 Val_Wu16 109. DFES_EnvTabVerb 0.00 109. FORMAT "%2.0" /end CHARACTERISTIC
/begin CHARACTERISTIC DFES_EnvRef.DFC_RailMeUn4_C "/" VALUE 0x800748B4 Val_Wu16 109. DFES_EnvTabVerb 0.00 109. FORMAT "%2.0" /end CHARACTERISTIC
/begin CHARACTERISTIC DFES_EnvRef.DFC_RailPCV0_C "/" VALUE 0x800748B6 Val_Wu16 109. DFES_EnvTabVerb 0.00 109. FORMAT "%2.0" /end CHARACTERISTIC
/begin CHARACTERISTIC DFES_EnvRef.DFC_RailPCV1_C "/" VALUE 0x800748B8 Val_Wu16 109. DFES_EnvTabVerb 0.00 109. FORMAT "%2.0" /end CHARACTERISTIC
/begin CHARACTERISTIC DFES_EnvRef.DFC_RailPCV2_C "/" VALUE 0x800748BA Val_Wu16 109. DFES_EnvTabVerb 0.00 109. FORMAT "%2.0" /end CHARACTERISTIC
/begin CHARACTERISTIC DFES_EnvRef.DFC_RailPCV3_C "/" VALUE 0x800748BC Val_Wu16 109. DFES_EnvTabVerb 0.00 109. FORMAT "%2.0" /end CHARACTERISTIC
/begin CHARACTERISTIC DFES_EnvRef.DFC_RailPCV4_C "/" VALUE 0x800748BE Val_Wu16 109. DFES_EnvTabVerb 0.00 109. FORMAT "%2.0" /end CHARACTERISTIC
/begin CHARACTERISTIC DFES_EnvRef.DFC_RailPMonStrt_C "/" VALUE 0x800748C0 Val_Wu16 109. DFES_EnvTabVerb 0.00 109. FORMAT "%2.0" /end CHARACTERISTIC
/begin CHARACTERISTIC DFES_EnvRef.DFC_SSpMon1_C "/" VALUE 0x800748C2 Val_Wu16 109. DFES_EnvTabVerb 0.00 109. FORMAT "%2.0" /end CHARACTERISTIC
/begin CHARACTERISTIC DFES_EnvRef.DFC_SSpMon2_C "/" VALUE 0x800748C4 Val_Wu16 109. DFES_EnvTabVerb 0.00 109. FORMAT "%2.0" /end CHARACTERISTIC
/begin CHARACTERISTIC DFES_EnvRef.DFC_SSpMon3_C "/" VALUE 0x800748C6 Val_Wu16 109. DFES_EnvTabVerb 0.00 109. FORMAT "%2.0" /end CHARACTERISTIC
/begin CHARACTERISTIC DFES_EnvRef.DFC_Sia_E1_C "/" VALUE 0x800748C8 Val_Wu16 109. DFES_EnvTabVerb 0.00 109. FORMAT "%2.0" /end CHARACTERISTIC
/begin CHARACTERISTIC DFES_EnvRef.DFC_Sia_E10_C "/" VALUE 0x800748CA Val_Wu16 109. DFES_EnvTabVerb 0.00 109. FORMAT "%2.0" /end CHARACTERISTIC
/begin CHARACTERISTIC DFES_EnvRef.DFC_Sia_E11_C "/" VALUE 0x800748CC Val_Wu16 109. DFES_EnvTabVerb 0.00 109. FORMAT "%2.0" /end CHARACTERISTIC
/begin CHARACTERISTIC DFES_EnvRef.DFC_Sia_E12_C "/" VALUE 0x800748CE Val_Wu16 109. DFES_EnvTabVerb 0.00 109. FORMAT "%2.0" /end CHARACTERISTIC
/begin CHARACTERISTIC DFES_EnvRef.DFC_Sia_E13_C "/" VALUE 0x800748D0 Val_Wu16 109. DFES_EnvTabVerb 0.00 109. FORMAT "%2.0" /end CHARACTERISTIC
/begin CHARACTERISTIC DFES_EnvRef.DFC_Sia_E14_C "/" VALUE 0x800748D2 Val_Wu16 109. DFES_EnvTabVerb 0.00 109. FORMAT "%2.0" /end CHARACTERISTIC
/begin CHARACTERISTIC DFES_EnvRef.DFC_Sia_E15_C "/" VALUE 0x800748D4 Val_Wu16 109. DFES_EnvTabVerb 0.00 109. FORMAT "%2.0" /end CHARACTERISTIC
/begin CHARACTERISTIC DFES_EnvRef.DFC_Sia_E2_C "/" VALUE 0x800748D6 Val_Wu16 109. DFES_EnvTabVerb 0.00 109. FORMAT "%2.0" /end CHARACTERISTIC
/begin CHARACTERISTIC DFES_EnvRef.DFC_Sia_E3_C "/" VALUE 0x800748D8 Val_Wu16 109. DFES_EnvTabVerb 0.00 109. FORMAT "%2.0" /end CHARACTERISTIC
/begin CHARACTERISTIC DFES_EnvRef.DFC_Sia_E4_C "/" VALUE 0x800748DA Val_Wu16 109. DFES_EnvTabVerb 0.00 109. FORMAT "%2.0" /end CHARACTERISTIC
/begin CHARACTERISTIC DFES_EnvRef.DFC_Sia_E5_C "/" VALUE 0x800748DC Val_Wu16 109. DFES_EnvTabVerb 0.00 109. FORMAT "%2.0" /end CHARACTERISTIC
/begin CHARACTERISTIC DFES_EnvRef.DFC_Sia_E6_C "/" VALUE 0x800748DE Val_Wu16 109. DFES_EnvTabVerb 0.00 109. FORMAT "%2.0" /end CHARACTERISTIC
/begin CHARACTERISTIC DFES_EnvRef.DFC_Sia_E7_C "/" VALUE 0x800748E0 Val_Wu16 109. DFES_EnvTabVerb 0.00 109. FORMAT "%2.0" /end CHARACTERISTIC
/begin CHARACTERISTIC DFES_EnvRef.DFC_Sia_E8_C "/" VALUE 0x800748E2 Val_Wu16 109. DFES_EnvTabVerb 0.00 109. FORMAT "%2.0" /end CHARACTERISTIC
/begin CHARACTERISTIC DFES_EnvRef.DFC_Sia_E9_C "/" VALUE 0x800748E4 Val_Wu16 109. DFES_EnvTabVerb 0.00 109. FORMAT "%2.0" /end CHARACTERISTIC
/begin CHARACTERISTIC DFES_EnvRef.DFC_ThrVlv4WinErr1_C "/" VALUE 0x800748E6 Val_Wu16 109. DFES_EnvTabVerb 0.00 109. FORMAT "%2.0" /end CHARACTERISTIC
/begin CHARACTERISTIC DFES_EnvRef.DFC_ThrVlv4WinErr2_C "/" VALUE 0x800748E8 Val_Wu16 109. DFES_EnvTabVerb 0.00 109. FORMAT "%2.0" /end CHARACTERISTIC
/begin CHARACTERISTIC DFES_EnvRef.DFC_ThrVlv4WinErr3_C "/" VALUE 0x800748EA Val_Wu16 109. DFES_EnvTabVerb 0.00 109. FORMAT "%2.0" /end CHARACTERISTIC
/begin CHARACTERISTIC DFES_EnvRef.DFC_ThrVlv4WinErr4_C "/" VALUE 0x800748EC Val_Wu16 109. DFES_EnvTabVerb 0.00 109. FORMAT "%2.0" /end CHARACTERISTIC
/begin CHARACTERISTIC DFES_EnvRef.DFC_ThrVlvSCG_C "/" VALUE 0x800748EE Val_Wu16 109. DFES_EnvTabVerb 0.00 109. FORMAT "%2.0" /end CHARACTERISTIC
/begin CHARACTERISTIC DFES_EnvRef.DFC_TrbCh4WinErr1_C "/" VALUE 0x800748F0 Val_Wu16 109. DFES_EnvTabVerb 0.00 109. FORMAT "%2.0" /end CHARACTERISTIC
/begin CHARACTERISTIC DFES_EnvRef.DFC_TrbCh4WinErr2_C "/" VALUE 0x800748F2 Val_Wu16 109. DFES_EnvTabVerb 0.00 109. FORMAT "%2.0" /end CHARACTERISTIC
/begin CHARACTERISTIC DFES_EnvRef.DFC_TrbCh4WinErr3_C "/" VALUE 0x800748F4 Val_Wu16 109. DFES_EnvTabVerb 0.00 109. FORMAT "%2.0" /end CHARACTERISTIC
/begin CHARACTERISTIC DFES_EnvRef.DFC_TrbCh4WinErr4_C "/" VALUE 0x800748F6 Val_Wu16 109. DFES_EnvTabVerb 0.00 109. FORMAT "%2.0" /end CHARACTERISTIC
/begin CHARACTERISTIC DFES_EnvRef.DFC_TrbChSCG_C "/" VALUE 0x800748F8 Val_Wu16 109. DFES_EnvTabVerb 0.00 109. FORMAT "%2.0" /end CHARACTERISTIC
/begin CHARACTERISTIC DFES_EnvRef.DFC_TrbChSRCMax_C "/" VALUE 0x800748FA Val_Wu16 109. DFES_EnvTabVerb 0.00 109. FORMAT "%2.0" /end CHARACTERISTIC
/begin CHARACTERISTIC DFES_EnvRef.DFC_TrbChSRCMin_C "/" VALUE 0x800748FC Val_Wu16 109. DFES_EnvTabVerb 0.00 109. FORMAT "%2.0" /end CHARACTERISTIC
/begin CHARACTERISTIC DFES_EnvRef.DFC_WaHtEl4WinErr1_C "/" VALUE 0x800748FE Val_Wu16 109. DFES_EnvTabVerb 0.00 109. FORMAT "%2.0" /end CHARACTERISTIC
/begin CHARACTERISTIC DFES_EnvRef.DFC_WaHtEl4WinErr2_C "/" VALUE 0x80074900 Val_Wu16 109. DFES_EnvTabVerb 0.00 109. FORMAT "%2.0" /end CHARACTERISTIC
/begin CHARACTERISTIC DFES_EnvRef.DFC_WaHtEl4WinErr3_C "/" VALUE 0x80074902 Val_Wu16 109. DFES_EnvTabVerb 0.00 109. FORMAT "%2.0" /end CHARACTERISTIC
/begin CHARACTERISTIC DFES_EnvRef.DFC_WaHtEl4WinErr4_C "/" VALUE 0x80074904 Val_Wu16 109. DFES_EnvTabVerb 0.00 109. FORMAT "%2.0" /end CHARACTERISTIC
/begin CHARACTERISTIC DFES_EnvRef.DFC_WaHtElSCG_C "/" VALUE 0x80074906 Val_Wu16 109. DFES_EnvTabVerb 0.00 109. FORMAT "%2.0" /end CHARACTERISTIC
/begin CHARACTERISTIC DFES_EnvRef.DFC_ETClbETFltMax_C "/" VALUE 0x80074908 Val_Wu16 109. DFES_EnvTabVerb 0.00 109. FORMAT "%2.0" /end CHARACTERISTIC
/begin CHARACTERISTIC DFES_EnvRef.DFC_ETClbETFltMin_C "/" VALUE 0x8007490A Val_Wu16 109. DFES_EnvTabVerb 0.00 109. FORMAT "%2.0" /end CHARACTERISTIC
/begin CHARACTERISTIC DFES_EnvRef.DFC_InjCrvInjLimChrgBal_C "/" VALUE 0x8007490C Val_Wu16 109. DFES_EnvTabVerb 0.00 109. FORMAT "%2.0" /end CHARACTERISTIC
/begin CHARACTERISTIC DFES_EnvRef.DFC_InjCrvInjLimQntBal_C "/" VALUE 0x8007490E Val_Wu16 109. DFES_EnvTabVerb 0.00 109. FORMAT "%2.0" /end CHARACTERISTIC
/begin CHARACTERISTIC DFES_EnvRef.DFC_InjCrvInjLimSys_C "/" VALUE 0x80074910 Val_Wu16 109. DFES_EnvTabVerb 0.00 109. FORMAT "%2.0" /end CHARACTERISTIC
/begin CHARACTERISTIC DFES_EnvRef.DFC_InjCrvNumInjRtmLim_C "/" VALUE 0x80074912 Val_Wu16 109. DFES_EnvTabVerb 0.00 109. FORMAT "%2.0" /end CHARACTERISTIC
/begin CHARACTERISTIC DFES_EnvRef.DFC_LSUHtCoupSig_0_C "/" VALUE 0x80074914 Val_Wu16 109. DFES_EnvTabVerb 0.00 109. FORMAT "%2.0" /end CHARACTERISTIC
/begin CHARACTERISTIC DFES_EnvRef.DFC_LSUHtCoupSig_1_C "/" VALUE 0x80074916 Val_Wu16 109. DFES_EnvTabVerb 0.00 109. FORMAT "%2.0" /end CHARACTERISTIC
/begin CHARACTERISTIC DFES_EnvRef.DFC_LSUHtCoupSig_2_C "/" VALUE 0x80074918 Val_Wu16 109. DFES_EnvTabVerb 0.00 109. FORMAT "%2.0" /end CHARACTERISTIC
/begin CHARACTERISTIC DFES_EnvRef.DFC_LSUHtCoupSig_3_C "/" VALUE 0x8007491A Val_Wu16 109. DFES_EnvTabVerb 0.00 109. FORMAT "%2.0" /end CHARACTERISTIC
/begin CHARACTERISTIC DFES_EnvRef.DFC_CtT_C "/" VALUE 0x8007491C Val_Wu16 109. DFES_EnvTabVerb 0.00 109. FORMAT "%2.0" /end CHARACTERISTIC
/begin CHARACTERISTIC DFES_EnvRef.DFC_DSMDummy_C "/" VALUE 0x8007491E Val_Wu16 109. DFES_EnvTabVerb 0.00 109. FORMAT "%2.0" /end CHARACTERISTIC
/begin CHARACTERISTIC DFES_EnvRef.DFC_MeUnOL_C "/" VALUE 0x80074920 Val_Wu16 109. DFES_EnvTabVerb 0.00 109. FORMAT "%2.0" /end CHARACTERISTIC
/begin CHARACTERISTIC DFES_EnvRef.DFC_MeUnSCB_C "/" VALUE 0x80074922 Val_Wu16 109. DFES_EnvTabVerb 0.00 109. FORMAT "%2.0" /end CHARACTERISTIC
/begin CHARACTERISTIC DFES_EnvRef.DFC_MeUnSRCMax_C "/" VALUE 0x80074924 Val_Wu16 109. DFES_EnvTabVerb 0.00 109. FORMAT "%2.0" /end CHARACTERISTIC
/begin CHARACTERISTIC DFES_EnvRef.DFC_MeUnSRCMin_C "/" VALUE 0x80074926 Val_Wu16 109. DFES_EnvTabVerb 0.00 109. FORMAT "%2.0" /end CHARACTERISTIC
/begin CHARACTERISTIC DFES_EnvRef.DFC_PCVOL_C "/" VALUE 0x80074928 Val_Wu16 109. DFES_EnvTabVerb 0.00 109. FORMAT "%2.0" /end CHARACTERISTIC
/begin CHARACTERISTIC DFES_EnvRef.DFC_PCVSCB_C "/" VALUE 0x8007492A Val_Wu16 109. DFES_EnvTabVerb 0.00 109. FORMAT "%2.0" /end CHARACTERISTIC
/begin CHARACTERISTIC DFES_EnvRef.DFC_PCVSRCMax_C "/" VALUE 0x8007492C Val_Wu16 109. DFES_EnvTabVerb 0.00 109. FORMAT "%2.0" /end CHARACTERISTIC
/begin CHARACTERISTIC DFES_EnvRef.DFC_PCVSRCMin_C "/" VALUE 0x8007492E Val_Wu16 109. DFES_EnvTabVerb 0.00 109. FORMAT "%2.0" /end CHARACTERISTIC
/begin CHARACTERISTIC DFES_EnvRef.DFC_RailPSRCMax_C "/" VALUE 0x80074930 Val_Wu16 109. DFES_EnvTabVerb 0.00 109. FORMAT "%2.0" /end CHARACTERISTIC
/begin CHARACTERISTIC DFES_EnvRef.DFC_RailPSRCMin_C "/" VALUE 0x80074932 Val_Wu16 109. DFES_EnvTabVerb 0.00 109. FORMAT "%2.0" /end CHARACTERISTIC
/begin CHARACTERISTIC DFES_EnvRef.DFC_IVActrVltgSRCMax_C "/" VALUE 0x80074934 Val_Wu16 109. DFES_EnvTabVerb 0.00 109. FORMAT "%2.0" /end CHARACTERISTIC
/begin CHARACTERISTIC DFES_EnvRef.DFC_IVActrVltgSRCMin_C "/" VALUE 0x80074936 Val_Wu16 109. DFES_EnvTabVerb 0.00 109. FORMAT "%2.0" /end CHARACTERISTIC
/begin CHARACTERISTIC DFES_EnvRef.DFC_IVPSplyDCDC_C "/" VALUE 0x80074938 Val_Wu16 109. DFES_EnvTabVerb 0.00 109. FORMAT "%2.0" /end CHARACTERISTIC
/begin CHARACTERISTIC DFES_EnvRef.DFC_IVPSplyVltgSRCMax_C "/" VALUE 0x8007493A Val_Wu16 109. DFES_EnvTabVerb 0.00 109. FORMAT "%2.0" /end CHARACTERISTIC
/begin CHARACTERISTIC DFES_EnvRef.DFC_IVPSplyVltgSRCMin_C "/" VALUE 0x8007493C Val_Wu16 109. DFES_EnvTabVerb 0.00 109. FORMAT "%2.0" /end CHARACTERISTIC
/begin CHARACTERISTIC DFES_EnvRef.DFC_AFSOffsDrftMax_C "/" VALUE 0x8007493E Val_Wu16 109. DFES_EnvTabVerb 0.00 109. FORMAT "%2.0" /end CHARACTERISTIC
/begin CHARACTERISTIC DFES_EnvRef.DFC_AFSOffsDrftMin_C "/" VALUE 0x80074940 Val_Wu16 109. DFES_EnvTabVerb 0.00 109. FORMAT "%2.0" /end CHARACTERISTIC
/begin CHARACTERISTIC DFES_EnvRef.DFC_AFSSRCCorMax_C "/" VALUE 0x80074942 Val_Wu16 109. DFES_EnvTabVerb 0.00 109. FORMAT "%2.0" /end CHARACTERISTIC
/begin CHARACTERISTIC DFES_EnvRef.DFC_AFSSRCCorMin_C "/" VALUE 0x80074944 Val_Wu16 109. DFES_EnvTabVerb 0.00 109. FORMAT "%2.0" /end CHARACTERISTIC
/begin CHARACTERISTIC DFES_EnvRef.DFC_AFSSRCRawMax_C "/" VALUE 0x80074946 Val_Wu16 109. DFES_EnvTabVerb 0.00 109. FORMAT "%2.0" /end CHARACTERISTIC
/begin CHARACTERISTIC DFES_EnvRef.DFC_AFSSRCRawMin_C "/" VALUE 0x80074948 Val_Wu16 109. DFES_EnvTabVerb 0.00 109. FORMAT "%2.0" /end CHARACTERISTIC
/begin CHARACTERISTIC DFES_EnvRef.DFC_AFSSetyDrftMax_C "/" VALUE 0x8007494A Val_Wu16 109. DFES_EnvTabVerb 0.00 109. FORMAT "%2.0" /end CHARACTERISTIC
/begin CHARACTERISTIC DFES_EnvRef.DFC_AFSSetyDrftMin_C "/" VALUE 0x8007494C Val_Wu16 109. DFES_EnvTabVerb 0.00 109. FORMAT "%2.0" /end CHARACTERISTIC
/begin CHARACTERISTIC DFES_EnvRef.DFC_AirCClntPAnaSRCMax_C "/" VALUE 0x8007494E Val_Wu16 109. DFES_EnvTabVerb 0.00 109. FORMAT "%2.0" /end CHARACTERISTIC
/begin CHARACTERISTIC DFES_EnvRef.DFC_AirCClntPAnaSRCMin_C "/" VALUE 0x80074950 Val_Wu16 109. DFES_EnvTabVerb 0.00 109. FORMAT "%2.0" /end CHARACTERISTIC
/begin CHARACTERISTIC DFES_EnvRef.DFC_AirCClntPPerSRCMax_C "/" VALUE 0x80074952 Val_Wu16 109. DFES_EnvTabVerb 0.00 109. FORMAT "%2.0" /end CHARACTERISTIC
/begin CHARACTERISTIC DFES_EnvRef.DFC_AirCClntPPerSRCMin_C "/" VALUE 0x80074954 Val_Wu16 109. DFES_EnvTabVerb 0.00 109. FORMAT "%2.0" /end CHARACTERISTIC
/begin CHARACTERISTIC DFES_EnvRef.DFC_AirCClntPdcycSRCMax_C "/" VALUE 0x80074956 Val_Wu16 109. DFES_EnvTabVerb 0.00 109. FORMAT "%2.0" /end CHARACTERISTIC
/begin CHARACTERISTIC DFES_EnvRef.DFC_AirCClntPdcycSRCMin_C "/" VALUE 0x80074958 Val_Wu16 109. DFES_EnvTabVerb 0.00 109. FORMAT "%2.0" /end CHARACTERISTIC
/begin CHARACTERISTIC DFES_EnvRef.DFC_AirCCmprOL_C "/" VALUE 0x8007495A Val_Wu16 109. DFES_EnvTabVerb 0.00 109. FORMAT "%2.0" /end CHARACTERISTIC
/begin CHARACTERISTIC DFES_EnvRef.DFC_AirCCmprRedTrqOL_C "/" VALUE 0x8007495C Val_Wu16 109. DFES_EnvTabVerb 0.00 109. FORMAT "%2.0" /end CHARACTERISTIC
/begin CHARACTERISTIC DFES_EnvRef.DFC_AirCCmprRedTrqSCB_C "/" VALUE 0x8007495E Val_Wu16 109. DFES_EnvTabVerb 0.00 109. FORMAT "%2.0" /end CHARACTERISTIC
/begin CHARACTERISTIC DFES_EnvRef.DFC_AirCCmprRedTrqSCG_C "/" VALUE 0x80074960 Val_Wu16 109. DFES_EnvTabVerb 0.00 109. FORMAT "%2.0" /end CHARACTERISTIC
/begin CHARACTERISTIC DFES_EnvRef.DFC_AirCCmprSCB_C "/" VALUE 0x80074962 Val_Wu16 109. DFES_EnvTabVerb 0.00 109. FORMAT "%2.0" /end CHARACTERISTIC
/begin CHARACTERISTIC DFES_EnvRef.DFC_AirCCmprSCG_C "/" VALUE 0x80074964 Val_Wu16 109. DFES_EnvTabVerb 0.00 109. FORMAT "%2.0" /end CHARACTERISTIC
/begin CHARACTERISTIC DFES_EnvRef.DFC_AirCSwtNpl_C "/" VALUE 0x80074966 Val_Wu16 109. DFES_EnvTabVerb 0.00 109. FORMAT "%2.0" /end CHARACTERISTIC
/begin CHARACTERISTIC DFES_EnvRef.DFC_AirCSwtSig_C "/" VALUE 0x80074968 Val_Wu16 109. DFES_EnvTabVerb 0.00 109. FORMAT "%2.0" /end CHARACTERISTIC
/begin CHARACTERISTIC DFES_EnvRef.DFC_BattUSRCMax_C "/" VALUE 0x8007496A Val_Wu16 109. DFES_EnvTabVerb 0.00 109. FORMAT "%2.0" /end CHARACTERISTIC
/begin CHARACTERISTIC DFES_EnvRef.DFC_BattUSRCMin_C "/" VALUE 0x8007496C Val_Wu16 109. DFES_EnvTabVerb 0.00 109. FORMAT "%2.0" /end CHARACTERISTIC
/begin CHARACTERISTIC DFES_EnvRef.DFC_BrkNpl_C "/" VALUE 0x8007496E Val_Wu16 109. DFES_EnvTabVerb 0.00 109. FORMAT "%2.0" /end CHARACTERISTIC
/begin CHARACTERISTIC DFES_EnvRef.DFC_BrkPSRCMax_C "/" VALUE 0x80074970 Val_Wu16 109. DFES_EnvTabVerb 0.00 109. FORMAT "%2.0" /end CHARACTERISTIC
/begin CHARACTERISTIC DFES_EnvRef.DFC_BrkPSRCMin_C "/" VALUE 0x80074972 Val_Wu16 109. DFES_EnvTabVerb 0.00 109. FORMAT "%2.0" /end CHARACTERISTIC
/begin CHARACTERISTIC DFES_EnvRef.DFC_BrkSig_C "/" VALUE 0x80074974 Val_Wu16 109. DFES_EnvTabVerb 0.00 109. FORMAT "%2.0" /end CHARACTERISTIC
/begin CHARACTERISTIC DFES_EnvRef.DFC_CByVlvOL_C "/" VALUE 0x80074976 Val_Wu16 109. DFES_EnvTabVerb 0.00 109. FORMAT "%2.0" /end CHARACTERISTIC
/begin CHARACTERISTIC DFES_EnvRef.DFC_CByVlvSCB_C "/" VALUE 0x80074978 Val_Wu16 109. DFES_EnvTabVerb 0.00 109. FORMAT "%2.0" /end CHARACTERISTIC
/begin CHARACTERISTIC DFES_EnvRef.DFC_CByVlvSCG_C "/" VALUE 0x8007497A Val_Wu16 109. DFES_EnvTabVerb 0.00 109. FORMAT "%2.0" /end CHARACTERISTIC
/begin CHARACTERISTIC DFES_EnvRef.DFC_CEngDsTSRCMax_C "/" VALUE 0x8007497C Val_Wu16 109. DFES_EnvTabVerb 0.00 109. FORMAT "%2.0" /end CHARACTERISTIC
/begin CHARACTERISTIC DFES_EnvRef.DFC_CEngDsTSRCMin_C "/" VALUE 0x8007497E Val_Wu16 109. DFES_EnvTabVerb 0.00 109. FORMAT "%2.0" /end CHARACTERISTIC
/begin CHARACTERISTIC DFES_EnvRef.DFC_CEngDsTSig_C "/" VALUE 0x80074980 Val_Wu16 109. DFES_EnvTabVerb 0.00 109. FORMAT "%2.0" /end CHARACTERISTIC
/begin CHARACTERISTIC DFES_EnvRef.DFC_CEngUsTSRCMax_C "/" VALUE 0x80074982 Val_Wu16 109. DFES_EnvTabVerb 0.00 109. FORMAT "%2.0" /end CHARACTERISTIC
/begin CHARACTERISTIC DFES_EnvRef.DFC_CEngUsTSRCMin_C "/" VALUE 0x80074984 Val_Wu16 109. DFES_EnvTabVerb 0.00 109. FORMAT "%2.0" /end CHARACTERISTIC
/begin CHARACTERISTIC DFES_EnvRef.DFC_CThmstOL_C "/" VALUE 0x80074986 Val_Wu16 109. DFES_EnvTabVerb 0.00 109. FORMAT "%2.0" /end CHARACTERISTIC
/begin CHARACTERISTIC DFES_EnvRef.DFC_CThmstSCB_C "/" VALUE 0x80074988 Val_Wu16 109. DFES_EnvTabVerb 0.00 109. FORMAT "%2.0" /end CHARACTERISTIC
/begin CHARACTERISTIC DFES_EnvRef.DFC_CThmstSCG_C "/" VALUE 0x8007498A Val_Wu16 109. DFES_EnvTabVerb 0.00 109. FORMAT "%2.0" /end CHARACTERISTIC
/begin CHARACTERISTIC DFES_EnvRef.DFC_ClthSig_C "/" VALUE 0x8007498C Val_Wu16 109. DFES_EnvTabVerb 0.00 109. FORMAT "%2.0" /end CHARACTERISTIC
/begin CHARACTERISTIC DFES_EnvRef.DFC_ECBVlvOL_C "/" VALUE 0x8007498E Val_Wu16 109. DFES_EnvTabVerb 0.00 109. FORMAT "%2.0" /end CHARACTERISTIC
/begin CHARACTERISTIC DFES_EnvRef.DFC_ECBVlvSCB_C "/" VALUE 0x80074990 Val_Wu16 109. DFES_EnvTabVerb 0.00 109. FORMAT "%2.0" /end CHARACTERISTIC
/begin CHARACTERISTIC DFES_EnvRef.DFC_ECBVlvSCG_C "/" VALUE 0x80074992 Val_Wu16 109. DFES_EnvTabVerb 0.00 109. FORMAT "%2.0" /end CHARACTERISTIC
/begin CHARACTERISTIC DFES_EnvRef.DFC_ECBVlvSRCMax_C "/" VALUE 0x80074994 Val_Wu16 109. DFES_EnvTabVerb 0.00 109. FORMAT "%2.0" /end CHARACTERISTIC
/begin CHARACTERISTIC DFES_EnvRef.DFC_ECBVlvSRCMin_C "/" VALUE 0x80074996 Val_Wu16 109. DFES_EnvTabVerb 0.00 109. FORMAT "%2.0" /end CHARACTERISTIC
/begin CHARACTERISTIC DFES_EnvRef.DFC_EGRVlvGovDvtMax_C "/" VALUE 0x80074998 Val_Wu16 109. DFES_EnvTabVerb 0.00 109. FORMAT "%2.0" /end CHARACTERISTIC
/begin CHARACTERISTIC DFES_EnvRef.DFC_EGRVlvGovDvtMin_C "/" VALUE 0x8007499A Val_Wu16 109. DFES_EnvTabVerb 0.00 109. FORMAT "%2.0" /end CHARACTERISTIC
/begin CHARACTERISTIC DFES_EnvRef.DFC_EGRVlvOL_C "/" VALUE 0x8007499C Val_Wu16 109. DFES_EnvTabVerb 0.00 109. FORMAT "%2.0" /end CHARACTERISTIC
/begin CHARACTERISTIC DFES_EnvRef.DFC_EGRVlvSCB_C "/" VALUE 0x8007499E Val_Wu16 109. DFES_EnvTabVerb 0.00 109. FORMAT "%2.0" /end CHARACTERISTIC
/begin CHARACTERISTIC DFES_EnvRef.DFC_EGRVlvSCG_C "/" VALUE 0x800749A0 Val_Wu16 109. DFES_EnvTabVerb 0.00 109. FORMAT "%2.0" /end CHARACTERISTIC
/begin CHARACTERISTIC DFES_EnvRef.DFC_EGRVlvSRCMax_C "/" VALUE 0x800749A2 Val_Wu16 109. DFES_EnvTabVerb 0.00 109. FORMAT "%2.0" /end CHARACTERISTIC
/begin CHARACTERISTIC DFES_EnvRef.DFC_EGRVlvSRCMin_C "/" VALUE 0x800749A4 Val_Wu16 109. DFES_EnvTabVerb 0.00 109. FORMAT "%2.0" /end CHARACTERISTIC
/begin CHARACTERISTIC DFES_EnvRef.DFC_EMDmpOL_0_C "/" VALUE 0x800749A6 Val_Wu16 109. DFES_EnvTabVerb 0.00 109. FORMAT "%2.0" /end CHARACTERISTIC
/begin CHARACTERISTIC DFES_EnvRef.DFC_EMDmpOL_1_C "/" VALUE 0x800749A8 Val_Wu16 109. DFES_EnvTabVerb 0.00 109. FORMAT "%2.0" /end CHARACTERISTIC
/begin CHARACTERISTIC DFES_EnvRef.DFC_EMDmpSCB_0_C "/" VALUE 0x800749AA Val_Wu16 109. DFES_EnvTabVerb 0.00 109. FORMAT "%2.0" /end CHARACTERISTIC
/begin CHARACTERISTIC DFES_EnvRef.DFC_EMDmpSCB_1_C "/" VALUE 0x800749AC Val_Wu16 109. DFES_EnvTabVerb 0.00 109. FORMAT "%2.0" /end CHARACTERISTIC
/begin CHARACTERISTIC DFES_EnvRef.DFC_EMDmpSCG_0_C "/" VALUE 0x800749AE Val_Wu16 109. DFES_EnvTabVerb 0.00 109. FORMAT "%2.0" /end CHARACTERISTIC
/begin CHARACTERISTIC DFES_EnvRef.DFC_EMDmpSCG_1_C "/" VALUE 0x800749B0 Val_Wu16 109. DFES_EnvTabVerb 0.00 109. FORMAT "%2.0" /end CHARACTERISTIC
/begin CHARACTERISTIC DFES_EnvRef.DFC_EngStAOL_C "/" VALUE 0x800749B2 Val_Wu16 109. DFES_EnvTabVerb 0.00 109. FORMAT "%2.0" /end CHARACTERISTIC
/begin CHARACTERISTIC DFES_EnvRef.DFC_EngStASCB_C "/" VALUE 0x800749B4 Val_Wu16 109. DFES_EnvTabVerb 0.00 109. FORMAT "%2.0" /end CHARACTERISTIC
/begin CHARACTERISTIC DFES_EnvRef.DFC_EngStASCG_C "/" VALUE 0x800749B6 Val_Wu16 109. DFES_EnvTabVerb 0.00 109. FORMAT "%2.0" /end CHARACTERISTIC
/begin CHARACTERISTIC DFES_EnvRef.DFC_EnvPSRCMax_C "/" VALUE 0x800749B8 Val_Wu16 109. DFES_EnvTabVerb 0.00 109. FORMAT "%2.0" /end CHARACTERISTIC
/begin CHARACTERISTIC DFES_EnvRef.DFC_EnvPSRCMin_C "/" VALUE 0x800749BA Val_Wu16 109. DFES_EnvTabVerb 0.00 109. FORMAT "%2.0" /end CHARACTERISTIC
/begin CHARACTERISTIC DFES_EnvRef.DFC_EnvPSig_C "/" VALUE 0x800749BC Val_Wu16 109. DFES_EnvTabVerb 0.00 109. FORMAT "%2.0" /end CHARACTERISTIC
/begin CHARACTERISTIC DFES_EnvRef.DFC_EnvTSRCMax_C "/" VALUE 0x800749BE Val_Wu16 109. DFES_EnvTabVerb 0.00 109. FORMAT "%2.0" /end CHARACTERISTIC
/begin CHARACTERISTIC DFES_EnvRef.DFC_EnvTSRCMin_C "/" VALUE 0x800749C0 Val_Wu16 109. DFES_EnvTabVerb 0.00 109. FORMAT "%2.0" /end CHARACTERISTIC
/begin CHARACTERISTIC DFES_EnvRef.DFC_FanOL_C "/" VALUE 0x800749C2 Val_Wu16 109. DFES_EnvTabVerb 0.00 109. FORMAT "%2.0" /end CHARACTERISTIC
/begin CHARACTERISTIC DFES_EnvRef.DFC_FanSCB_C "/" VALUE 0x800749C4 Val_Wu16 109. DFES_EnvTabVerb 0.00 109. FORMAT "%2.0" /end CHARACTERISTIC
/begin CHARACTERISTIC DFES_EnvRef.DFC_FlFltSig_C "/" VALUE 0x800749C6 Val_Wu16 109. DFES_EnvTabVerb 0.00 109. FORMAT "%2.0" /end CHARACTERISTIC
/begin CHARACTERISTIC DFES_EnvRef.DFC_FuelTSRCMax_C "/" VALUE 0x800749C8 Val_Wu16 109. DFES_EnvTabVerb 0.00 109. FORMAT "%2.0" /end CHARACTERISTIC
/begin CHARACTERISTIC DFES_EnvRef.DFC_FuelTSRCMin_C "/" VALUE 0x800749CA Val_Wu16 109. DFES_EnvTabVerb 0.00 109. FORMAT "%2.0" /end CHARACTERISTIC
/begin CHARACTERISTIC DFES_EnvRef.DFC_GbxNPosPPerSRCMax_C "/" VALUE 0x800749CC Val_Wu16 109. DFES_EnvTabVerb 0.00 109. FORMAT "%2.0" /end CHARACTERISTIC
/begin CHARACTERISTIC DFES_EnvRef.DFC_GbxNPosPPerSRCMin_C "/" VALUE 0x800749CE Val_Wu16 109. DFES_EnvTabVerb 0.00 109. FORMAT "%2.0" /end CHARACTERISTIC
/begin CHARACTERISTIC DFES_EnvRef.DFC_GbxNPosPdcycSRCMax_C "/" VALUE 0x800749D0 Val_Wu16 109. DFES_EnvTabVerb 0.00 109. FORMAT "%2.0" /end CHARACTERISTIC
/begin CHARACTERISTIC DFES_EnvRef.DFC_GbxNPosPdcycSRCMin_C "/" VALUE 0x800749D2 Val_Wu16 109. DFES_EnvTabVerb 0.00 109. FORMAT "%2.0" /end CHARACTERISTIC
/begin CHARACTERISTIC DFES_EnvRef.DFC_GbxNPosSig_C "/" VALUE 0x800749D4 Val_Wu16 109. DFES_EnvTabVerb 0.00 109. FORMAT "%2.0" /end CHARACTERISTIC
/begin CHARACTERISTIC DFES_EnvRef.DFC_GlwPlgBSDOL_0_C "/" VALUE 0x800749D6 Val_Wu16 109. DFES_EnvTabVerb 0.00 109. FORMAT "%2.0" /end CHARACTERISTIC
/begin CHARACTERISTIC DFES_EnvRef.DFC_GlwPlgBSDOL_1_C "/" VALUE 0x800749D8 Val_Wu16 109. DFES_EnvTabVerb 0.00 109. FORMAT "%2.0" /end CHARACTERISTIC
/begin CHARACTERISTIC DFES_EnvRef.DFC_GlwPlgBSDOL_2_C "/" VALUE 0x800749DA Val_Wu16 109. DFES_EnvTabVerb 0.00 109. FORMAT "%2.0" /end CHARACTERISTIC
/begin CHARACTERISTIC DFES_EnvRef.DFC_GlwPlgBSDOL_3_C "/" VALUE 0x800749DC Val_Wu16 109. DFES_EnvTabVerb 0.00 109. FORMAT "%2.0" /end CHARACTERISTIC
/begin CHARACTERISTIC DFES_EnvRef.DFC_GlwPlgBSDOL_4_C "/" VALUE 0x800749DE Val_Wu16 109. DFES_EnvTabVerb 0.00 109. FORMAT "%2.0" /end CHARACTERISTIC
/begin CHARACTERISTIC DFES_EnvRef.DFC_GlwPlgBSDOL_5_C "/" VALUE 0x800749E0 Val_Wu16 109. DFES_EnvTabVerb 0.00 109. FORMAT "%2.0" /end CHARACTERISTIC
/begin CHARACTERISTIC DFES_EnvRef.DFC_GlwPlgBSDOL_6_C "/" VALUE 0x800749E2 Val_Wu16 109. DFES_EnvTabVerb 0.00 109. FORMAT "%2.0" /end CHARACTERISTIC
/begin CHARACTERISTIC DFES_EnvRef.DFC_GlwPlgBSDOL_7_C "/" VALUE 0x800749E4 Val_Wu16 109. DFES_EnvTabVerb 0.00 109. FORMAT "%2.0" /end CHARACTERISTIC
/begin CHARACTERISTIC DFES_EnvRef.DFC_GlwPlgBSDOT_0_C "/" VALUE 0x800749E6 Val_Wu16 109. DFES_EnvTabVerb 0.00 109. FORMAT "%2.0" /end CHARACTERISTIC
/begin CHARACTERISTIC DFES_EnvRef.DFC_GlwPlgBSDOT_1_C "/" VALUE 0x800749E8 Val_Wu16 109. DFES_EnvTabVerb 0.00 109. FORMAT "%2.0" /end CHARACTERISTIC
/begin CHARACTERISTIC DFES_EnvRef.DFC_GlwPlgBSDOT_2_C "/" VALUE 0x800749EA Val_Wu16 109. DFES_EnvTabVerb 0.00 109. FORMAT "%2.0" /end CHARACTERISTIC
/begin CHARACTERISTIC DFES_EnvRef.DFC_GlwPlgBSDOT_3_C "/" VALUE 0x800749EC Val_Wu16 109. DFES_EnvTabVerb 0.00 109. FORMAT "%2.0" /end CHARACTERISTIC
/begin CHARACTERISTIC DFES_EnvRef.DFC_GlwPlgBSDOT_4_C "/" VALUE 0x800749EE Val_Wu16 109. DFES_EnvTabVerb 0.00 109. FORMAT "%2.0" /end CHARACTERISTIC
/begin CHARACTERISTIC DFES_EnvRef.DFC_GlwPlgBSDOT_5_C "/" VALUE 0x800749F0 Val_Wu16 109. DFES_EnvTabVerb 0.00 109. FORMAT "%2.0" /end CHARACTERISTIC
/begin CHARACTERISTIC DFES_EnvRef.DFC_GlwPlgBSDOT_6_C "/" VALUE 0x800749F2 Val_Wu16 109. DFES_EnvTabVerb 0.00 109. FORMAT "%2.0" /end CHARACTERISTIC
/begin CHARACTERISTIC DFES_EnvRef.DFC_GlwPlgBSDOT_7_C "/" VALUE 0x800749F4 Val_Wu16 109. DFES_EnvTabVerb 0.00 109. FORMAT "%2.0" /end CHARACTERISTIC
/begin CHARACTERISTIC DFES_EnvRef.DFC_GlwPlgBSDSC_0_C "/" VALUE 0x800749F6 Val_Wu16 109. DFES_EnvTabVerb 0.00 109. FORMAT "%2.0" /end CHARACTERISTIC
/begin CHARACTERISTIC DFES_EnvRef.DFC_GlwPlgBSDSC_1_C "/" VALUE 0x800749F8 Val_Wu16 109. DFES_EnvTabVerb 0.00 109. FORMAT "%2.0" /end CHARACTERISTIC
/begin CHARACTERISTIC DFES_EnvRef.DFC_GlwPlgBSDSC_2_C "/" VALUE 0x800749FA Val_Wu16 109. DFES_EnvTabVerb 0.00 109. FORMAT "%2.0" /end CHARACTERISTIC
/begin CHARACTERISTIC DFES_EnvRef.DFC_GlwPlgBSDSC_3_C "/" VALUE 0x800749FC Val_Wu16 109. DFES_EnvTabVerb 0.00 109. FORMAT "%2.0" /end CHARACTERISTIC
/begin CHARACTERISTIC DFES_EnvRef.DFC_GlwPlgBSDSC_4_C "/" VALUE 0x800749FE Val_Wu16 109. DFES_EnvTabVerb 0.00 109. FORMAT "%2.0" /end CHARACTERISTIC
/begin CHARACTERISTIC DFES_EnvRef.DFC_GlwPlgBSDSC_5_C "/" VALUE 0x80074A00 Val_Wu16 109. DFES_EnvTabVerb 0.00 109. FORMAT "%2.0" /end CHARACTERISTIC
/begin CHARACTERISTIC DFES_EnvRef.DFC_GlwPlgBSDSC_6_C "/" VALUE 0x80074A02 Val_Wu16 109. DFES_EnvTabVerb 0.00 109. FORMAT "%2.0" /end CHARACTERISTIC
/begin CHARACTERISTIC DFES_EnvRef.DFC_GlwPlgBSDSC_7_C "/" VALUE 0x80074A04 Val_Wu16 109. DFES_EnvTabVerb 0.00 109. FORMAT "%2.0" /end CHARACTERISTIC
/begin CHARACTERISTIC DFES_EnvRef.DFC_GlwPlgComErr_C "/" VALUE 0x80074A06 Val_Wu16 109. DFES_EnvTabVerb 0.00 109. FORMAT "%2.0" /end CHARACTERISTIC
/begin CHARACTERISTIC DFES_EnvRef.DFC_InjVlvPresMin_C "/" VALUE 0x80074A08 Val_Wu16 109. DFES_EnvTabVerb 0.00 109. FORMAT "%2.0" /end CHARACTERISTIC
/begin CHARACTERISTIC DFES_EnvRef.DFC_LSUCircNernstMax_0_C "/" VALUE 0x80074A0A Val_Wu16 109. DFES_EnvTabVerb 0.00 109. FORMAT "%2.0" /end CHARACTERISTIC
/begin CHARACTERISTIC DFES_EnvRef.DFC_LSUCircNernstMax_1_C "/" VALUE 0x80074A0C Val_Wu16 109. DFES_EnvTabVerb 0.00 109. FORMAT "%2.0" /end CHARACTERISTIC
/begin CHARACTERISTIC DFES_EnvRef.DFC_LSUCircNernstMax_2_C "/" VALUE 0x80074A0E Val_Wu16 109. DFES_EnvTabVerb 0.00 109. FORMAT "%2.0" /end CHARACTERISTIC
/begin CHARACTERISTIC DFES_EnvRef.DFC_LSUCircNernstMax_3_C "/" VALUE 0x80074A10 Val_Wu16 109. DFES_EnvTabVerb 0.00 109. FORMAT "%2.0" /end CHARACTERISTIC
/begin CHARACTERISTIC DFES_EnvRef.DFC_LSUCircNernstMin_0_C "/" VALUE 0x80074A12 Val_Wu16 109. DFES_EnvTabVerb 0.00 109. FORMAT "%2.0" /end CHARACTERISTIC
/begin CHARACTERISTIC DFES_EnvRef.DFC_LSUCircNernstMin_1_C "/" VALUE 0x80074A14 Val_Wu16 109. DFES_EnvTabVerb 0.00 109. FORMAT "%2.0" /end CHARACTERISTIC
/begin CHARACTERISTIC DFES_EnvRef.DFC_LSUCircNernstMin_2_C "/" VALUE 0x80074A16 Val_Wu16 109. DFES_EnvTabVerb 0.00 109. FORMAT "%2.0" /end CHARACTERISTIC
/begin CHARACTERISTIC DFES_EnvRef.DFC_LSUCircNernstMin_3_C "/" VALUE 0x80074A18 Val_Wu16 109. DFES_EnvTabVerb 0.00 109. FORMAT "%2.0" /end CHARACTERISTIC
/begin CHARACTERISTIC DFES_EnvRef.DFC_LSUCircNernstSig_0_C "/" VALUE 0x80074A1A Val_Wu16 109. DFES_EnvTabVerb 0.00 109. FORMAT "%2.0" /end CHARACTERISTIC
/begin CHARACTERISTIC DFES_EnvRef.DFC_LSUCircNernstSig_1_C "/" VALUE 0x80074A1C Val_Wu16 109. DFES_EnvTabVerb 0.00 109. FORMAT "%2.0" /end CHARACTERISTIC
/begin CHARACTERISTIC DFES_EnvRef.DFC_LSUCircNernstSig_2_C "/" VALUE 0x80074A1E Val_Wu16 109. DFES_EnvTabVerb 0.00 109. FORMAT "%2.0" /end CHARACTERISTIC
/begin CHARACTERISTIC DFES_EnvRef.DFC_LSUCircNernstSig_3_C "/" VALUE 0x80074A20 Val_Wu16 109. DFES_EnvTabVerb 0.00 109. FORMAT "%2.0" /end CHARACTERISTIC
/begin CHARACTERISTIC DFES_EnvRef.DFC_LSUCircPmpCurMax_0_C "/" VALUE 0x80074A22 Val_Wu16 109. DFES_EnvTabVerb 0.00 109. FORMAT "%2.0" /end CHARACTERISTIC
/begin CHARACTERISTIC DFES_EnvRef.DFC_LSUCircPmpCurMax_1_C "/" VALUE 0x80074A24 Val_Wu16 109. DFES_EnvTabVerb 0.00 109. FORMAT "%2.0" /end CHARACTERISTIC
/begin CHARACTERISTIC DFES_EnvRef.DFC_LSUCircPmpCurMax_2_C "/" VALUE 0x80074A26 Val_Wu16 109. DFES_EnvTabVerb 0.00 109. FORMAT "%2.0" /end CHARACTERISTIC
/begin CHARACTERISTIC DFES_EnvRef.DFC_LSUCircPmpCurMax_3_C "/" VALUE 0x80074A28 Val_Wu16 109. DFES_EnvTabVerb 0.00 109. FORMAT "%2.0" /end CHARACTERISTIC
/begin CHARACTERISTIC DFES_EnvRef.DFC_LSUCircPmpCurMin_0_C "/" VALUE 0x80074A2A Val_Wu16 109. DFES_EnvTabVerb 0.00 109. FORMAT "%2.0" /end CHARACTERISTIC
/begin CHARACTERISTIC DFES_EnvRef.DFC_LSUCircPmpCurMin_1_C "/" VALUE 0x80074A2C Val_Wu16 109. DFES_EnvTabVerb 0.00 109. FORMAT "%2.0" /end CHARACTERISTIC
/begin CHARACTERISTIC DFES_EnvRef.DFC_LSUCircPmpCurMin_2_C "/" VALUE 0x80074A2E Val_Wu16 109. DFES_EnvTabVerb 0.00 109. FORMAT "%2.0" /end CHARACTERISTIC
/begin CHARACTERISTIC DFES_EnvRef.DFC_LSUCircPmpCurMin_3_C "/" VALUE 0x80074A30 Val_Wu16 109. DFES_EnvTabVerb 0.00 109. FORMAT "%2.0" /end CHARACTERISTIC
/begin CHARACTERISTIC DFES_EnvRef.DFC_LSUCircPmpCurSig_0_C "/" VALUE 0x80074A32 Val_Wu16 109. DFES_EnvTabVerb 0.00 109. FORMAT "%2.0" /end CHARACTERISTIC
/begin CHARACTERISTIC DFES_EnvRef.DFC_LSUCircPmpCurSig_1_C "/" VALUE 0x80074A34 Val_Wu16 109. DFES_EnvTabVerb 0.00 109. FORMAT "%2.0" /end CHARACTERISTIC
/begin CHARACTERISTIC DFES_EnvRef.DFC_LSUCircPmpCurSig_2_C "/" VALUE 0x80074A36 Val_Wu16 109. DFES_EnvTabVerb 0.00 109. FORMAT "%2.0" /end CHARACTERISTIC
/begin CHARACTERISTIC DFES_EnvRef.DFC_LSUCircPmpCurSig_3_C "/" VALUE 0x80074A38 Val_Wu16 109. DFES_EnvTabVerb 0.00 109. FORMAT "%2.0" /end CHARACTERISTIC
/begin CHARACTERISTIC DFES_EnvRef.DFC_LSUCircVirtGndMax_0_C "/" VALUE 0x80074A3A Val_Wu16 109. DFES_EnvTabVerb 0.00 109. FORMAT "%2.0" /end CHARACTERISTIC
/begin CHARACTERISTIC DFES_EnvRef.DFC_LSUCircVirtGndMax_1_C "/" VALUE 0x80074A3C Val_Wu16 109. DFES_EnvTabVerb 0.00 109. FORMAT "%2.0" /end CHARACTERISTIC
/begin CHARACTERISTIC DFES_EnvRef.DFC_LSUCircVirtGndMax_2_C "/" VALUE 0x80074A3E Val_Wu16 109. DFES_EnvTabVerb 0.00 109. FORMAT "%2.0" /end CHARACTERISTIC
/begin CHARACTERISTIC DFES_EnvRef.DFC_LSUCircVirtGndMax_3_C "/" VALUE 0x80074A40 Val_Wu16 109. DFES_EnvTabVerb 0.00 109. FORMAT "%2.0" /end CHARACTERISTIC
/begin CHARACTERISTIC DFES_EnvRef.DFC_LSUCircVirtGndMin_0_C "/" VALUE 0x80074A42 Val_Wu16 109. DFES_EnvTabVerb 0.00 109. FORMAT "%2.0" /end CHARACTERISTIC
/begin CHARACTERISTIC DFES_EnvRef.DFC_LSUCircVirtGndMin_1_C "/" VALUE 0x80074A44 Val_Wu16 109. DFES_EnvTabVerb 0.00 109. FORMAT "%2.0" /end CHARACTERISTIC
/begin CHARACTERISTIC DFES_EnvRef.DFC_LSUCircVirtGndMin_2_C "/" VALUE 0x80074A46 Val_Wu16 109. DFES_EnvTabVerb 0.00 109. FORMAT "%2.0" /end CHARACTERISTIC
/begin CHARACTERISTIC DFES_EnvRef.DFC_LSUCircVirtGndMin_3_C "/" VALUE 0x80074A48 Val_Wu16 109. DFES_EnvTabVerb 0.00 109. FORMAT "%2.0" /end CHARACTERISTIC
/begin CHARACTERISTIC DFES_EnvRef.DFC_LSUCircVirtGndSig_0_C "/" VALUE 0x80074A4A Val_Wu16 109. DFES_EnvTabVerb 0.00 109. FORMAT "%2.0" /end CHARACTERISTIC
/begin CHARACTERISTIC DFES_EnvRef.DFC_LSUCircVirtGndSig_1_C "/" VALUE 0x80074A4C Val_Wu16 109. DFES_EnvTabVerb 0.00 109. FORMAT "%2.0" /end CHARACTERISTIC
/begin CHARACTERISTIC DFES_EnvRef.DFC_LSUCircVirtGndSig_2_C "/" VALUE 0x80074A4E Val_Wu16 109. DFES_EnvTabVerb 0.00 109. FORMAT "%2.0" /end CHARACTERISTIC
/begin CHARACTERISTIC DFES_EnvRef.DFC_LSUCircVirtGndSig_3_C "/" VALUE 0x80074A50 Val_Wu16 109. DFES_EnvTabVerb 0.00 109. FORMAT "%2.0" /end CHARACTERISTIC
/begin CHARACTERISTIC DFES_EnvRef.DFC_LSUHtrMax_0_C "/" VALUE 0x80074A52 Val_Wu16 109. DFES_EnvTabVerb 0.00 109. FORMAT "%2.0" /end CHARACTERISTIC
/begin CHARACTERISTIC DFES_EnvRef.DFC_LSUHtrMax_1_C "/" VALUE 0x80074A54 Val_Wu16 109. DFES_EnvTabVerb 0.00 109. FORMAT "%2.0" /end CHARACTERISTIC
/begin CHARACTERISTIC DFES_EnvRef.DFC_LSUHtrMax_2_C "/" VALUE 0x80074A56 Val_Wu16 109. DFES_EnvTabVerb 0.00 109. FORMAT "%2.0" /end CHARACTERISTIC
/begin CHARACTERISTIC DFES_EnvRef.DFC_LSUHtrMax_3_C "/" VALUE 0x80074A58 Val_Wu16 109. DFES_EnvTabVerb 0.00 109. FORMAT "%2.0" /end CHARACTERISTIC
/begin CHARACTERISTIC DFES_EnvRef.DFC_LSUHtrMin_0_C "/" VALUE 0x80074A5A Val_Wu16 109. DFES_EnvTabVerb 0.00 109. FORMAT "%2.0" /end CHARACTERISTIC
/begin CHARACTERISTIC DFES_EnvRef.DFC_LSUHtrMin_1_C "/" VALUE 0x80074A5C Val_Wu16 109. DFES_EnvTabVerb 0.00 109. FORMAT "%2.0" /end CHARACTERISTIC
/begin CHARACTERISTIC DFES_EnvRef.DFC_LSUHtrMin_2_C "/" VALUE 0x80074A5E Val_Wu16 109. DFES_EnvTabVerb 0.00 109. FORMAT "%2.0" /end CHARACTERISTIC
/begin CHARACTERISTIC DFES_EnvRef.DFC_LSUHtrMin_3_C "/" VALUE 0x80074A60 Val_Wu16 109. DFES_EnvTabVerb 0.00 109. FORMAT "%2.0" /end CHARACTERISTIC
/begin CHARACTERISTIC DFES_EnvRef.DFC_LSUHtrSig_0_C "/" VALUE 0x80074A62 Val_Wu16 109. DFES_EnvTabVerb 0.00 109. FORMAT "%2.0" /end CHARACTERISTIC
/begin CHARACTERISTIC DFES_EnvRef.DFC_LSUHtrSig_1_C "/" VALUE 0x80074A64 Val_Wu16 109. DFES_EnvTabVerb 0.00 109. FORMAT "%2.0" /end CHARACTERISTIC
/begin CHARACTERISTIC DFES_EnvRef.DFC_LSUHtrSig_2_C "/" VALUE 0x80074A66 Val_Wu16 109. DFES_EnvTabVerb 0.00 109. FORMAT "%2.0" /end CHARACTERISTIC
/begin CHARACTERISTIC DFES_EnvRef.DFC_LSUHtrSig_3_C "/" VALUE 0x80074A68 Val_Wu16 109. DFES_EnvTabVerb 0.00 109. FORMAT "%2.0" /end CHARACTERISTIC
/begin CHARACTERISTIC DFES_EnvRef.DFC_LSUO2Max_0_C "/" VALUE 0x80074A6A Val_Wu16 109. DFES_EnvTabVerb 0.00 109. FORMAT "%2.0" /end CHARACTERISTIC
/begin CHARACTERISTIC DFES_EnvRef.DFC_LSUO2Max_1_C "/" VALUE 0x80074A6C Val_Wu16 109. DFES_EnvTabVerb 0.00 109. FORMAT "%2.0" /end CHARACTERISTIC
/begin CHARACTERISTIC DFES_EnvRef.DFC_LSUO2Max_2_C "/" VALUE 0x80074A6E Val_Wu16 109. DFES_EnvTabVerb 0.00 109. FORMAT "%2.0" /end CHARACTERISTIC
/begin CHARACTERISTIC DFES_EnvRef.DFC_LSUO2Max_3_C "/" VALUE 0x80074A70 Val_Wu16 109. DFES_EnvTabVerb 0.00 109. FORMAT "%2.0" /end CHARACTERISTIC
/begin CHARACTERISTIC DFES_EnvRef.DFC_LSUO2Min_0_C "/" VALUE 0x80074A72 Val_Wu16 109. DFES_EnvTabVerb 0.00 109. FORMAT "%2.0" /end CHARACTERISTIC
/begin CHARACTERISTIC DFES_EnvRef.DFC_LSUO2Min_1_C "/" VALUE 0x80074A74 Val_Wu16 109. DFES_EnvTabVerb 0.00 109. FORMAT "%2.0" /end CHARACTERISTIC
/begin CHARACTERISTIC DFES_EnvRef.DFC_LSUO2Min_2_C "/" VALUE 0x80074A76 Val_Wu16 109. DFES_EnvTabVerb 0.00 109. FORMAT "%2.0" /end CHARACTERISTIC
/begin CHARACTERISTIC DFES_EnvRef.DFC_LSUO2Min_3_C "/" VALUE 0x80074A78 Val_Wu16 109. DFES_EnvTabVerb 0.00 109. FORMAT "%2.0" /end CHARACTERISTIC
/begin CHARACTERISTIC DFES_EnvRef.DFC_LSUSPIBattLowMin_0_C "/" VALUE 0x80074A7A Val_Wu16 109. DFES_EnvTabVerb 0.00 109. FORMAT "%2.0" /end CHARACTERISTIC
/begin CHARACTERISTIC DFES_EnvRef.DFC_LSUSPIBattLowMin_1_C "/" VALUE 0x80074A7C Val_Wu16 109. DFES_EnvTabVerb 0.00 109. FORMAT "%2.0" /end CHARACTERISTIC
/begin CHARACTERISTIC DFES_EnvRef.DFC_LSUSPIBattLowMin_2_C "/" VALUE 0x80074A7E Val_Wu16 109. DFES_EnvTabVerb 0.00 109. FORMAT "%2.0" /end CHARACTERISTIC
/begin CHARACTERISTIC DFES_EnvRef.DFC_LSUSPIBattLowMin_3_C "/" VALUE 0x80074A80 Val_Wu16 109. DFES_EnvTabVerb 0.00 109. FORMAT "%2.0" /end CHARACTERISTIC
/begin CHARACTERISTIC DFES_EnvRef.DFC_LSUSPISig_0_C "/" VALUE 0x80074A82 Val_Wu16 109. DFES_EnvTabVerb 0.00 109. FORMAT "%2.0" /end CHARACTERISTIC
/begin CHARACTERISTIC DFES_EnvRef.DFC_LSUSPISig_1_C "/" VALUE 0x80074A84 Val_Wu16 109. DFES_EnvTabVerb 0.00 109. FORMAT "%2.0" /end CHARACTERISTIC
/begin CHARACTERISTIC DFES_EnvRef.DFC_LSUSPISig_2_C "/" VALUE 0x80074A86 Val_Wu16 109. DFES_EnvTabVerb 0.00 109. FORMAT "%2.0" /end CHARACTERISTIC
/begin CHARACTERISTIC DFES_EnvRef.DFC_LSUSPISig_3_C "/" VALUE 0x80074A88 Val_Wu16 109. DFES_EnvTabVerb 0.00 109. FORMAT "%2.0" /end CHARACTERISTIC
/begin CHARACTERISTIC DFES_EnvRef.DFC_LSUtExcMax_0_C "/" VALUE 0x80074A8A Val_Wu16 109. DFES_EnvTabVerb 0.00 109. FORMAT "%2.0" /end CHARACTERISTIC
/begin CHARACTERISTIC DFES_EnvRef.DFC_LSUtExcMax_1_C "/" VALUE 0x80074A8C Val_Wu16 109. DFES_EnvTabVerb 0.00 109. FORMAT "%2.0" /end CHARACTERISTIC
/begin CHARACTERISTIC DFES_EnvRef.DFC_LSUtExcMax_2_C "/" VALUE 0x80074A8E Val_Wu16 109. DFES_EnvTabVerb 0.00 109. FORMAT "%2.0" /end CHARACTERISTIC
/begin CHARACTERISTIC DFES_EnvRef.DFC_LSUtExcMax_3_C "/" VALUE 0x80074A90 Val_Wu16 109. DFES_EnvTabVerb 0.00 109. FORMAT "%2.0" /end CHARACTERISTIC
/begin CHARACTERISTIC DFES_EnvRef.DFC_LSUtExcMin_0_C "/" VALUE 0x80074A92 Val_Wu16 109. DFES_EnvTabVerb 0.00 109. FORMAT "%2.0" /end CHARACTERISTIC
/begin CHARACTERISTIC DFES_EnvRef.DFC_LSUtExcMin_1_C "/" VALUE 0x80074A94 Val_Wu16 109. DFES_EnvTabVerb 0.00 109. FORMAT "%2.0" /end CHARACTERISTIC
/begin CHARACTERISTIC DFES_EnvRef.DFC_LSUtExcMin_2_C "/" VALUE 0x80074A96 Val_Wu16 109. DFES_EnvTabVerb 0.00 109. FORMAT "%2.0" /end CHARACTERISTIC
/begin CHARACTERISTIC DFES_EnvRef.DFC_LSUtExcMin_3_C "/" VALUE 0x80074A98 Val_Wu16 109. DFES_EnvTabVerb 0.00 109. FORMAT "%2.0" /end CHARACTERISTIC
/begin CHARACTERISTIC DFES_EnvRef.DFC_MILOL_C "/" VALUE 0x80074A9A Val_Wu16 109. DFES_EnvTabVerb 0.00 109. FORMAT "%2.0" /end CHARACTERISTIC
/begin CHARACTERISTIC DFES_EnvRef.DFC_MILSCB_C "/" VALUE 0x80074A9C Val_Wu16 109. DFES_EnvTabVerb 0.00 109. FORMAT "%2.0" /end CHARACTERISTIC
/begin CHARACTERISTIC DFES_EnvRef.DFC_MILSCG_C "/" VALUE 0x80074A9E Val_Wu16 109. DFES_EnvTabVerb 0.00 109. FORMAT "%2.0" /end CHARACTERISTIC
/begin CHARACTERISTIC DFES_EnvRef.DFC_MeUnSCG_C "/" VALUE 0x80074AA0 Val_Wu16 109. DFES_EnvTabVerb 0.00 109. FORMAT "%2.0" /end CHARACTERISTIC
/begin CHARACTERISTIC DFES_EnvRef.DFC_NplHsChngPPFltDiff_C "/" VALUE 0x80074AA2 Val_Wu16 109. DFES_EnvTabVerb 0.00 109. FORMAT "%2.0" /end CHARACTERISTIC
/begin CHARACTERISTIC DFES_EnvRef.DFC_NplPAirFltDs_C "/" VALUE 0x80074AA4 Val_Wu16 109. DFES_EnvTabVerb 0.00 109. FORMAT "%2.0" /end CHARACTERISTIC
/begin CHARACTERISTIC DFES_EnvRef.DFC_NplTPFltUs_C "/" VALUE 0x80074AA6 Val_Wu16 109. DFES_EnvTabVerb 0.00 109. FORMAT "%2.0" /end CHARACTERISTIC
/begin CHARACTERISTIC DFES_EnvRef.DFC_OilComErr_C "/" VALUE 0x80074AA8 Val_Wu16 109. DFES_EnvTabVerb 0.00 109. FORMAT "%2.0" /end CHARACTERISTIC
/begin CHARACTERISTIC DFES_EnvRef.DFC_OilPLmpOL_C "/" VALUE 0x80074AAA Val_Wu16 109. DFES_EnvTabVerb 0.00 109. FORMAT "%2.0" /end CHARACTERISTIC
/begin CHARACTERISTIC DFES_EnvRef.DFC_OilPLmpSCB_C "/" VALUE 0x80074AAC Val_Wu16 109. DFES_EnvTabVerb 0.00 109. FORMAT "%2.0" /end CHARACTERISTIC
/begin CHARACTERISTIC DFES_EnvRef.DFC_OilPLmpSCG_C "/" VALUE 0x80074AAE Val_Wu16 109. DFES_EnvTabVerb 0.00 109. FORMAT "%2.0" /end CHARACTERISTIC
/begin CHARACTERISTIC DFES_EnvRef.DFC_OilPNpl_C "/" VALUE 0x80074AB0 Val_Wu16 109. DFES_EnvTabVerb 0.00 109. FORMAT "%2.0" /end CHARACTERISTIC
/begin CHARACTERISTIC DFES_EnvRef.DFC_OilTNpl_C "/" VALUE 0x80074AB2 Val_Wu16 109. DFES_EnvTabVerb 0.00 109. FORMAT "%2.0" /end CHARACTERISTIC
/begin CHARACTERISTIC DFES_EnvRef.DFC_OilTSRCMax_C "/" VALUE 0x80074AB4 Val_Wu16 109. DFES_EnvTabVerb 0.00 109. FORMAT "%2.0" /end CHARACTERISTIC
/begin CHARACTERISTIC DFES_EnvRef.DFC_OilTSRCMin_C "/" VALUE 0x80074AB6 Val_Wu16 109. DFES_EnvTabVerb 0.00 109. FORMAT "%2.0" /end CHARACTERISTIC
/begin CHARACTERISTIC DFES_EnvRef.DFC_PCACDsEnvPPls_C "/" VALUE 0x80074AB8 Val_Wu16 109. DFES_EnvTabVerb 0.00 109. FORMAT "%2.0" /end CHARACTERISTIC
/begin CHARACTERISTIC DFES_EnvRef.DFC_PCACDsSRCMax_C "/" VALUE 0x80074ABA Val_Wu16 109. DFES_EnvTabVerb 0.00 109. FORMAT "%2.0" /end CHARACTERISTIC
/begin CHARACTERISTIC DFES_EnvRef.DFC_PCACDsSRCMin_C "/" VALUE 0x80074ABC Val_Wu16 109. DFES_EnvTabVerb 0.00 109. FORMAT "%2.0" /end CHARACTERISTIC
/begin CHARACTERISTIC DFES_EnvRef.DFC_PCVSCG_C "/" VALUE 0x80074ABE Val_Wu16 109. DFES_EnvTabVerb 0.00 109. FORMAT "%2.0" /end CHARACTERISTIC
/begin CHARACTERISTIC DFES_EnvRef.DFC_PFltCharPDiffMin_C "/" VALUE 0x80074AC0 Val_Wu16 109. DFES_EnvTabVerb 0.00 109. FORMAT "%2.0" /end CHARACTERISTIC
/begin CHARACTERISTIC DFES_EnvRef.DFC_PFltDstrMin_C "/" VALUE 0x80074AC2 Val_Wu16 109. DFES_EnvTabVerb 0.00 109. FORMAT "%2.0" /end CHARACTERISTIC
/begin CHARACTERISTIC DFES_EnvRef.DFC_PFltEngPrt_C "/" VALUE 0x80074AC4 Val_Wu16 109. DFES_EnvTabVerb 0.00 109. FORMAT "%2.0" /end CHARACTERISTIC
/begin CHARACTERISTIC DFES_EnvRef.DFC_PFltLmpOL_C "/" VALUE 0x80074AC6 Val_Wu16 109. DFES_EnvTabVerb 0.00 109. FORMAT "%2.0" /end CHARACTERISTIC
/begin CHARACTERISTIC DFES_EnvRef.DFC_PFltLmpSCB_C "/" VALUE 0x80074AC8 Val_Wu16 109. DFES_EnvTabVerb 0.00 109. FORMAT "%2.0" /end CHARACTERISTIC
/begin CHARACTERISTIC DFES_EnvRef.DFC_PFltLmpSCG_C "/" VALUE 0x80074ACA Val_Wu16 109. DFES_EnvTabVerb 0.00 109. FORMAT "%2.0" /end CHARACTERISTIC
/begin CHARACTERISTIC DFES_EnvRef.DFC_PFltRgnPerm_C "/" VALUE 0x80074ACC Val_Wu16 109. DFES_EnvTabVerb 0.00 109. FORMAT "%2.0" /end CHARACTERISTIC
/begin CHARACTERISTIC DFES_EnvRef.DFC_PFltSRCMaxFlwRstn_C "/" VALUE 0x80074ACE Val_Wu16 109. DFES_EnvTabVerb 0.00 109. FORMAT "%2.0" /end CHARACTERISTIC
/begin CHARACTERISTIC DFES_EnvRef.DFC_PFltSRCMinFlwRstn_C "/" VALUE 0x80074AD0 Val_Wu16 109. DFES_EnvTabVerb 0.00 109. FORMAT "%2.0" /end CHARACTERISTIC
/begin CHARACTERISTIC DFES_EnvRef.DFC_PFltSotMsDvtMax_C "/" VALUE 0x80074AD2 Val_Wu16 109. DFES_EnvTabVerb 0.00 109. FORMAT "%2.0" /end CHARACTERISTIC
/begin CHARACTERISTIC DFES_EnvRef.DFC_PFltSotMsDvtMin_C "/" VALUE 0x80074AD4 Val_Wu16 109. DFES_EnvTabVerb 0.00 109. FORMAT "%2.0" /end CHARACTERISTIC
/begin CHARACTERISTIC DFES_EnvRef.DFC_PFltSotMsMax_C "/" VALUE 0x80074AD6 Val_Wu16 109. DFES_EnvTabVerb 0.00 109. FORMAT "%2.0" /end CHARACTERISTIC
/begin CHARACTERISTIC DFES_EnvRef.DFC_PSPOL_C "/" VALUE 0x80074AD8 Val_Wu16 109. DFES_EnvTabVerb 0.00 109. FORMAT "%2.0" /end CHARACTERISTIC
/begin CHARACTERISTIC DFES_EnvRef.DFC_PSPSCB_C "/" VALUE 0x80074ADA Val_Wu16 109. DFES_EnvTabVerb 0.00 109. FORMAT "%2.0" /end CHARACTERISTIC
/begin CHARACTERISTIC DFES_EnvRef.DFC_PSPSCG_C "/" VALUE 0x80074ADC Val_Wu16 109. DFES_EnvTabVerb 0.00 109. FORMAT "%2.0" /end CHARACTERISTIC
/begin CHARACTERISTIC DFES_EnvRef.DFC_SRCHighAPP1_C "/" VALUE 0x80074ADE Val_Wu16 109. DFES_EnvTabVerb 0.00 109. FORMAT "%2.0" /end CHARACTERISTIC
/begin CHARACTERISTIC DFES_EnvRef.DFC_SRCHighAPP2_C "/" VALUE 0x80074AE0 Val_Wu16 109. DFES_EnvTabVerb 0.00 109. FORMAT "%2.0" /end CHARACTERISTIC
/begin CHARACTERISTIC DFES_EnvRef.DFC_SRCLowAPP1_C "/" VALUE 0x80074AE2 Val_Wu16 109. DFES_EnvTabVerb 0.00 109. FORMAT "%2.0" /end CHARACTERISTIC
/begin CHARACTERISTIC DFES_EnvRef.DFC_SRCLowAPP2_C "/" VALUE 0x80074AE4 Val_Wu16 109. DFES_EnvTabVerb 0.00 109. FORMAT "%2.0" /end CHARACTERISTIC
/begin CHARACTERISTIC DFES_EnvRef.DFC_SRCMaxPAirFltDs_C "/" VALUE 0x80074AE6 Val_Wu16 109. DFES_EnvTabVerb 0.00 109. FORMAT "%2.0" /end CHARACTERISTIC
/begin CHARACTERISTIC DFES_EnvRef.DFC_SRCMaxPPFltUs_C "/" VALUE 0x80074AE8 Val_Wu16 109. DFES_EnvTabVerb 0.00 109. FORMAT "%2.0" /end CHARACTERISTIC
/begin CHARACTERISTIC DFES_EnvRef.DFC_SRCMaxTECU_C "/" VALUE 0x80074AEA Val_Wu16 109. DFES_EnvTabVerb 0.00 109. FORMAT "%2.0" /end CHARACTERISTIC
/begin CHARACTERISTIC DFES_EnvRef.DFC_SRCMaxTOxiCatUs_C "/" VALUE 0x80074AEC Val_Wu16 109. DFES_EnvTabVerb 0.00 109. FORMAT "%2.0" /end CHARACTERISTIC
/begin CHARACTERISTIC DFES_EnvRef.DFC_SRCMaxTPFltUs_C "/" VALUE 0x80074AEE Val_Wu16 109. DFES_EnvTabVerb 0.00 109. FORMAT "%2.0" /end CHARACTERISTIC
/begin CHARACTERISTIC DFES_EnvRef.DFC_SRCMinPAirFltDs_C "/" VALUE 0x80074AF0 Val_Wu16 109. DFES_EnvTabVerb 0.00 109. FORMAT "%2.0" /end CHARACTERISTIC
/begin CHARACTERISTIC DFES_EnvRef.DFC_SRCMinPPFltUs_C "/" VALUE 0x80074AF2 Val_Wu16 109. DFES_EnvTabVerb 0.00 109. FORMAT "%2.0" /end CHARACTERISTIC
/begin CHARACTERISTIC DFES_EnvRef.DFC_SRCMinTECU_C "/" VALUE 0x80074AF4 Val_Wu16 109. DFES_EnvTabVerb 0.00 109. FORMAT "%2.0" /end CHARACTERISTIC
/begin CHARACTERISTIC DFES_EnvRef.DFC_SRCMinTOxiCatUs_C "/" VALUE 0x80074AF6 Val_Wu16 109. DFES_EnvTabVerb 0.00 109. FORMAT "%2.0" /end CHARACTERISTIC
/begin CHARACTERISTIC DFES_EnvRef.DFC_SRCMinTPFltUs_C "/" VALUE 0x80074AF8 Val_Wu16 109. DFES_EnvTabVerb 0.00 109. FORMAT "%2.0" /end CHARACTERISTIC
/begin CHARACTERISTIC DFES_EnvRef.DFC_SVSOL_C "/" VALUE 0x80074AFA Val_Wu16 109. DFES_EnvTabVerb 0.00 109. FORMAT "%2.0" /end CHARACTERISTIC
/begin CHARACTERISTIC DFES_EnvRef.DFC_SVSSCB_C "/" VALUE 0x80074AFC Val_Wu16 109. DFES_EnvTabVerb 0.00 109. FORMAT "%2.0" /end CHARACTERISTIC
/begin CHARACTERISTIC DFES_EnvRef.DFC_SVSSCG_C "/" VALUE 0x80074AFE Val_Wu16 109. DFES_EnvTabVerb 0.00 109. FORMAT "%2.0" /end CHARACTERISTIC
/begin CHARACTERISTIC DFES_EnvRef.DFC_StrtOL_C "/" VALUE 0x80074B00 Val_Wu16 109. DFES_EnvTabVerb 0.00 109. FORMAT "%2.0" /end CHARACTERISTIC
/begin CHARACTERISTIC DFES_EnvRef.DFC_StrtSCB_C "/" VALUE 0x80074B02 Val_Wu16 109. DFES_EnvTabVerb 0.00 109. FORMAT "%2.0" /end CHARACTERISTIC
/begin CHARACTERISTIC DFES_EnvRef.DFC_StrtSCG_C "/" VALUE 0x80074B04 Val_Wu16 109. DFES_EnvTabVerb 0.00 109. FORMAT "%2.0" /end CHARACTERISTIC
/begin CHARACTERISTIC DFES_EnvRef.DFC_SyncAPP_C "/" VALUE 0x80074B06 Val_Wu16 109. DFES_EnvTabVerb 0.00 109. FORMAT "%2.0" /end CHARACTERISTIC
/begin CHARACTERISTIC DFES_EnvRef.DFC_T15Npl_C "/" VALUE 0x80074B08 Val_Wu16 109. DFES_EnvTabVerb 0.00 109. FORMAT "%2.0" /end CHARACTERISTIC
/begin CHARACTERISTIC DFES_EnvRef.DFC_TAFSDtyCycHi_C "/" VALUE 0x80074B0A Val_Wu16 109. DFES_EnvTabVerb 0.00 109. FORMAT "%2.0" /end CHARACTERISTIC
/begin CHARACTERISTIC DFES_EnvRef.DFC_TAFSDtyCycLo_C "/" VALUE 0x80074B0C Val_Wu16 109. DFES_EnvTabVerb 0.00 109. FORMAT "%2.0" /end CHARACTERISTIC
/begin CHARACTERISTIC DFES_EnvRef.DFC_TAFSPerHi_C "/" VALUE 0x80074B0E Val_Wu16 109. DFES_EnvTabVerb 0.00 109. FORMAT "%2.0" /end CHARACTERISTIC
/begin CHARACTERISTIC DFES_EnvRef.DFC_TAFSPerLo_C "/" VALUE 0x80074B10 Val_Wu16 109. DFES_EnvTabVerb 0.00 109. FORMAT "%2.0" /end CHARACTERISTIC
/begin CHARACTERISTIC DFES_EnvRef.DFC_TCACDsSRCMax_C "/" VALUE 0x80074B12 Val_Wu16 109. DFES_EnvTabVerb 0.00 109. FORMAT "%2.0" /end CHARACTERISTIC
/begin CHARACTERISTIC DFES_EnvRef.DFC_TCACDsSRCMin_C "/" VALUE 0x80074B14 Val_Wu16 109. DFES_EnvTabVerb 0.00 109. FORMAT "%2.0" /end CHARACTERISTIC
/begin CHARACTERISTIC DFES_EnvRef.DFC_ThrVlvOL_C "/" VALUE 0x80074B16 Val_Wu16 109. DFES_EnvTabVerb 0.00 109. FORMAT "%2.0" /end CHARACTERISTIC
/begin CHARACTERISTIC DFES_EnvRef.DFC_ThrVlvSCB_C "/" VALUE 0x80074B18 Val_Wu16 109. DFES_EnvTabVerb 0.00 109. FORMAT "%2.0" /end CHARACTERISTIC
/begin CHARACTERISTIC DFES_EnvRef.DFC_ThrVlvSRCMax_C "/" VALUE 0x80074B1A Val_Wu16 109. DFES_EnvTabVerb 0.00 109. FORMAT "%2.0" /end CHARACTERISTIC
/begin CHARACTERISTIC DFES_EnvRef.DFC_ThrVlvSRCMin_C "/" VALUE 0x80074B1C Val_Wu16 109. DFES_EnvTabVerb 0.00 109. FORMAT "%2.0" /end CHARACTERISTIC
/begin CHARACTERISTIC DFES_EnvRef.DFC_TrbChLPOL_C "/" VALUE 0x80074B1E Val_Wu16 109. DFES_EnvTabVerb 0.00 109. FORMAT "%2.0" /end CHARACTERISTIC
/begin CHARACTERISTIC DFES_EnvRef.DFC_TrbChLPSCB_C "/" VALUE 0x80074B20 Val_Wu16 109. DFES_EnvTabVerb 0.00 109. FORMAT "%2.0" /end CHARACTERISTIC
/begin CHARACTERISTIC DFES_EnvRef.DFC_TrbChLPSCG_C "/" VALUE 0x80074B22 Val_Wu16 109. DFES_EnvTabVerb 0.00 109. FORMAT "%2.0" /end CHARACTERISTIC
/begin CHARACTERISTIC DFES_EnvRef.DFC_TrbChOL_C "/" VALUE 0x80074B24 Val_Wu16 109. DFES_EnvTabVerb 0.00 109. FORMAT "%2.0" /end CHARACTERISTIC
/begin CHARACTERISTIC DFES_EnvRef.DFC_TrbChSCB_C "/" VALUE 0x80074B26 Val_Wu16 109. DFES_EnvTabVerb 0.00 109. FORMAT "%2.0" /end CHARACTERISTIC
/begin CHARACTERISTIC DFES_EnvRef.DFC_VSwVlvGovDvtMax_C "/" VALUE 0x80074B28 Val_Wu16 109. DFES_EnvTabVerb 0.00 109. FORMAT "%2.0" /end CHARACTERISTIC
/begin CHARACTERISTIC DFES_EnvRef.DFC_VSwVlvGovDvtMin_C "/" VALUE 0x80074B2A Val_Wu16 109. DFES_EnvTabVerb 0.00 109. FORMAT "%2.0" /end CHARACTERISTIC
/begin CHARACTERISTIC DFES_EnvRef.DFC_VSwVlvOL_C "/" VALUE 0x80074B2C Val_Wu16 109. DFES_EnvTabVerb 0.00 109. FORMAT "%2.0" /end CHARACTERISTIC
/begin CHARACTERISTIC DFES_EnvRef.DFC_VSwVlvSCB_C "/" VALUE 0x80074B2E Val_Wu16 109. DFES_EnvTabVerb 0.00 109. FORMAT "%2.0" /end CHARACTERISTIC
/begin CHARACTERISTIC DFES_EnvRef.DFC_VSwVlvSCG_C "/" VALUE 0x80074B30 Val_Wu16 109. DFES_EnvTabVerb 0.00 109. FORMAT "%2.0" /end CHARACTERISTIC
/begin CHARACTERISTIC DFES_EnvRef.DFC_VSwVlvSRCMax_C "/" VALUE 0x80074B32 Val_Wu16 109. DFES_EnvTabVerb 0.00 109. FORMAT "%2.0" /end CHARACTERISTIC
/begin CHARACTERISTIC DFES_EnvRef.DFC_VSwVlvSRCMin_C "/" VALUE 0x80074B34 Val_Wu16 109. DFES_EnvTabVerb 0.00 109. FORMAT "%2.0" /end CHARACTERISTIC
/begin CHARACTERISTIC DFES_EnvRef.DFC_VehVHW_C "/" VALUE 0x80074B36 Val_Wu16 109. DFES_EnvTabVerb 0.00 109. FORMAT "%2.0" /end CHARACTERISTIC
/begin CHARACTERISTIC DFES_EnvRef.DFC_VehVMax_C "/" VALUE 0x80074B38 Val_Wu16 109. DFES_EnvTabVerb 0.00 109. FORMAT "%2.0" /end CHARACTERISTIC
/begin CHARACTERISTIC DFES_EnvRef.DFC_VehVPlaus_C "/" VALUE 0x80074B3A Val_Wu16 109. DFES_EnvTabVerb 0.00 109. FORMAT "%2.0" /end CHARACTERISTIC
/begin CHARACTERISTIC DFES_EnvRef.DFC_VehVSig_C "/" VALUE 0x80074B3C Val_Wu16 109. DFES_EnvTabVerb 0.00 109. FORMAT "%2.0" /end CHARACTERISTIC
/begin CHARACTERISTIC DFES_EnvRef.DFC_WaHtElOL_C "/" VALUE 0x80074B3E Val_Wu16 109. DFES_EnvTabVerb 0.00 109. FORMAT "%2.0" /end CHARACTERISTIC
/begin CHARACTERISTIC DFES_EnvRef.DFC_WaHtElSCB_C "/" VALUE 0x80074B40 Val_Wu16 109. DFES_EnvTabVerb 0.00 109. FORMAT "%2.0" /end CHARACTERISTIC
/begin CHARACTERISTIC DFES_EnvRef.DFC_ClthNpl_C "/" VALUE 0x80074B42 Val_Wu16 109. DFES_EnvTabVerb 0.00 109. FORMAT "%2.0" /end CHARACTERISTIC
/begin CHARACTERISTIC DFES_EnvRef.DFC_ETClbETMax_0_C "/" VALUE 0x80074B44 Val_Wu16 109. DFES_EnvTabVerb 0.00 109. FORMAT "%2.0" /end CHARACTERISTIC
/begin CHARACTERISTIC DFES_EnvRef.DFC_ETClbETMax_1_C "/" VALUE 0x80074B46 Val_Wu16 109. DFES_EnvTabVerb 0.00 109. FORMAT "%2.0" /end CHARACTERISTIC
/begin CHARACTERISTIC DFES_EnvRef.DFC_ETClbETMax_2_C "/" VALUE 0x80074B48 Val_Wu16 109. DFES_EnvTabVerb 0.00 109. FORMAT "%2.0" /end CHARACTERISTIC
/begin CHARACTERISTIC DFES_EnvRef.DFC_ETClbETMax_3_C "/" VALUE 0x80074B4A Val_Wu16 109. DFES_EnvTabVerb 0.00 109. FORMAT "%2.0" /end CHARACTERISTIC
/begin CHARACTERISTIC DFES_EnvRef.DFC_ETClbETMax_4_C "/" VALUE 0x80074B4C Val_Wu16 109. DFES_EnvTabVerb 0.00 109. FORMAT "%2.0" /end CHARACTERISTIC
/begin CHARACTERISTIC DFES_EnvRef.DFC_ETClbETMax_5_C "/" VALUE 0x80074B4E Val_Wu16 109. DFES_EnvTabVerb 0.00 109. FORMAT "%2.0" /end CHARACTERISTIC
/begin CHARACTERISTIC DFES_EnvRef.DFC_ETClbETMin_0_C "/" VALUE 0x80074B50 Val_Wu16 109. DFES_EnvTabVerb 0.00 109. FORMAT "%2.0" /end CHARACTERISTIC
/begin CHARACTERISTIC DFES_EnvRef.DFC_ETClbETMin_1_C "/" VALUE 0x80074B52 Val_Wu16 109. DFES_EnvTabVerb 0.00 109. FORMAT "%2.0" /end CHARACTERISTIC
/begin CHARACTERISTIC DFES_EnvRef.DFC_ETClbETMin_2_C "/" VALUE 0x80074B54 Val_Wu16 109. DFES_EnvTabVerb 0.00 109. FORMAT "%2.0" /end CHARACTERISTIC
/begin CHARACTERISTIC DFES_EnvRef.DFC_ETClbETMin_3_C "/" VALUE 0x80074B56 Val_Wu16 109. DFES_EnvTabVerb 0.00 109. FORMAT "%2.0" /end CHARACTERISTIC
/begin CHARACTERISTIC DFES_EnvRef.DFC_ETClbETMin_4_C "/" VALUE 0x80074B58 Val_Wu16 109. DFES_EnvTabVerb 0.00 109. FORMAT "%2.0" /end CHARACTERISTIC
/begin CHARACTERISTIC DFES_EnvRef.DFC_ETClbETMin_5_C "/" VALUE 0x80074B5A Val_Wu16 109. DFES_EnvTabVerb 0.00 109. FORMAT "%2.0" /end CHARACTERISTIC
/begin CHARACTERISTIC DFES_EnvRef.DFC_IVDiaBnkShCirBSH_0_C "/" VALUE 0x80074B5C Val_Wu16 109. DFES_EnvTabVerb 0.00 109. FORMAT "%2.0" /end CHARACTERISTIC
/begin CHARACTERISTIC DFES_EnvRef.DFC_IVDiaBnkShCirBSH_1_C "/" VALUE 0x80074B5E Val_Wu16 109. DFES_EnvTabVerb 0.00 109. FORMAT "%2.0" /end CHARACTERISTIC
/begin CHARACTERISTIC DFES_EnvRef.DFC_IVDiaBnkShCirChSwt_0_C "/" VALUE 0x80074B60 Val_Wu16 109. DFES_EnvTabVerb 0.00 109. FORMAT "%2.0" /end CHARACTERISTIC
/begin CHARACTERISTIC DFES_EnvRef.DFC_IVDiaBnkShCirChSwt_1_C "/" VALUE 0x80074B62 Val_Wu16 109. DFES_EnvTabVerb 0.00 109. FORMAT "%2.0" /end CHARACTERISTIC
/begin CHARACTERISTIC DFES_EnvRef.DFC_IVDiaBnkShCirHSBatt_0_C "/" VALUE 0x80074B64 Val_Wu16 109. DFES_EnvTabVerb 0.00 109. FORMAT "%2.0" /end CHARACTERISTIC
/begin CHARACTERISTIC DFES_EnvRef.DFC_IVDiaBnkShCirHSBatt_1_C "/" VALUE 0x80074B66 Val_Wu16 109. DFES_EnvTabVerb 0.00 109. FORMAT "%2.0" /end CHARACTERISTIC
/begin CHARACTERISTIC DFES_EnvRef.DFC_IVDiaBnkShCirHiRstnc_0_C "/" VALUE 0x80074B68 Val_Wu16 109. DFES_EnvTabVerb 0.00 109. FORMAT "%2.0" /end CHARACTERISTIC
/begin CHARACTERISTIC DFES_EnvRef.DFC_IVDiaBnkShCirHiRstnc_1_C "/" VALUE 0x80074B6A Val_Wu16 109. DFES_EnvTabVerb 0.00 109. FORMAT "%2.0" /end CHARACTERISTIC
/begin CHARACTERISTIC DFES_EnvRef.DFC_IVDiaBnkShCirLSHSGnd_0_C "/" VALUE 0x80074B6C Val_Wu16 109. DFES_EnvTabVerb 0.00 109. FORMAT "%2.0" /end CHARACTERISTIC
/begin CHARACTERISTIC DFES_EnvRef.DFC_IVDiaBnkShCirLSHSGnd_1_C "/" VALUE 0x80074B6E Val_Wu16 109. DFES_EnvTabVerb 0.00 109. FORMAT "%2.0" /end CHARACTERISTIC
/begin CHARACTERISTIC DFES_EnvRef.DFC_IVDiaBnkShCirTransfer_0_C "/" VALUE 0x80074B70 Val_Wu16 109. DFES_EnvTabVerb 0.00 109. FORMAT "%2.0" /end CHARACTERISTIC
/begin CHARACTERISTIC DFES_EnvRef.DFC_IVDiaBnkShCirTransfer_1_C "/" VALUE 0x80074B72 Val_Wu16 109. DFES_EnvTabVerb 0.00 109. FORMAT "%2.0" /end CHARACTERISTIC
/begin CHARACTERISTIC DFES_EnvRef.DFC_IVDiaCylNoCls_0_C "/" VALUE 0x80074B74 Val_Wu16 109. DFES_EnvTabVerb 0.00 109. FORMAT "%2.0" /end CHARACTERISTIC
/begin CHARACTERISTIC DFES_EnvRef.DFC_IVDiaCylNoCls_1_C "/" VALUE 0x80074B76 Val_Wu16 109. DFES_EnvTabVerb 0.00 109. FORMAT "%2.0" /end CHARACTERISTIC
/begin CHARACTERISTIC DFES_EnvRef.DFC_IVDiaCylNoCls_2_C "/" VALUE 0x80074B78 Val_Wu16 109. DFES_EnvTabVerb 0.00 109. FORMAT "%2.0" /end CHARACTERISTIC
/begin CHARACTERISTIC DFES_EnvRef.DFC_IVDiaCylNoCls_3_C "/" VALUE 0x80074B7A Val_Wu16 109. DFES_EnvTabVerb 0.00 109. FORMAT "%2.0" /end CHARACTERISTIC
/begin CHARACTERISTIC DFES_EnvRef.DFC_IVDiaCylNoCls_4_C "/" VALUE 0x80074B7C Val_Wu16 109. DFES_EnvTabVerb 0.00 109. FORMAT "%2.0" /end CHARACTERISTIC
/begin CHARACTERISTIC DFES_EnvRef.DFC_IVDiaCylNoCls_5_C "/" VALUE 0x80074B7E Val_Wu16 109. DFES_EnvTabVerb 0.00 109. FORMAT "%2.0" /end CHARACTERISTIC
/begin CHARACTERISTIC DFES_EnvRef.DFC_IVDiaCylNoLd_0_C "/" VALUE 0x80074B80 Val_Wu16 109. DFES_EnvTabVerb 0.00 109. FORMAT "%2.0" /end CHARACTERISTIC
/begin CHARACTERISTIC DFES_EnvRef.DFC_IVDiaCylNoLd_1_C "/" VALUE 0x80074B82 Val_Wu16 109. DFES_EnvTabVerb 0.00 109. FORMAT "%2.0" /end CHARACTERISTIC
/begin CHARACTERISTIC DFES_EnvRef.DFC_IVDiaCylNoLd_2_C "/" VALUE 0x80074B84 Val_Wu16 109. DFES_EnvTabVerb 0.00 109. FORMAT "%2.0" /end CHARACTERISTIC
/begin CHARACTERISTIC DFES_EnvRef.DFC_IVDiaCylNoLd_3_C "/" VALUE 0x80074B86 Val_Wu16 109. DFES_EnvTabVerb 0.00 109. FORMAT "%2.0" /end CHARACTERISTIC
/begin CHARACTERISTIC DFES_EnvRef.DFC_IVDiaCylNoLd_4_C "/" VALUE 0x80074B88 Val_Wu16 109. DFES_EnvTabVerb 0.00 109. FORMAT "%2.0" /end CHARACTERISTIC
/begin CHARACTERISTIC DFES_EnvRef.DFC_IVDiaCylNoLd_5_C "/" VALUE 0x80074B8A Val_Wu16 109. DFES_EnvTabVerb 0.00 109. FORMAT "%2.0" /end CHARACTERISTIC
/begin CHARACTERISTIC DFES_EnvRef.DFC_IVDiaCylShCirHiRstnc_0_C "/" VALUE 0x80074B8C Val_Wu16 109. DFES_EnvTabVerb 0.00 109. FORMAT "%2.0" /end CHARACTERISTIC
/begin CHARACTERISTIC DFES_EnvRef.DFC_IVDiaCylShCirHiRstnc_1_C "/" VALUE 0x80074B8E Val_Wu16 109. DFES_EnvTabVerb 0.00 109. FORMAT "%2.0" /end CHARACTERISTIC
/begin CHARACTERISTIC DFES_EnvRef.DFC_IVDiaCylShCirHiRstnc_2_C "/" VALUE 0x80074B90 Val_Wu16 109. DFES_EnvTabVerb 0.00 109. FORMAT "%2.0" /end CHARACTERISTIC
/begin CHARACTERISTIC DFES_EnvRef.DFC_IVDiaCylShCirHiRstnc_3_C "/" VALUE 0x80074B92 Val_Wu16 109. DFES_EnvTabVerb 0.00 109. FORMAT "%2.0" /end CHARACTERISTIC
/begin CHARACTERISTIC DFES_EnvRef.DFC_IVDiaCylShCirHiRstnc_4_C "/" VALUE 0x80074B94 Val_Wu16 109. DFES_EnvTabVerb 0.00 109. FORMAT "%2.0" /end CHARACTERISTIC
/begin CHARACTERISTIC DFES_EnvRef.DFC_IVDiaCylShCirHiRstnc_5_C "/" VALUE 0x80074B96 Val_Wu16 109. DFES_EnvTabVerb 0.00 109. FORMAT "%2.0" /end CHARACTERISTIC
/begin CHARACTERISTIC DFES_EnvRef.DFC_IVDiaCylShCirLSBatt_0_C "/" VALUE 0x80074B98 Val_Wu16 109. DFES_EnvTabVerb 0.00 109. FORMAT "%2.0" /end CHARACTERISTIC
/begin CHARACTERISTIC DFES_EnvRef.DFC_IVDiaCylShCirLSBatt_1_C "/" VALUE 0x80074B9A Val_Wu16 109. DFES_EnvTabVerb 0.00 109. FORMAT "%2.0" /end CHARACTERISTIC
/begin CHARACTERISTIC DFES_EnvRef.DFC_IVDiaCylShCirLSBatt_2_C "/" VALUE 0x80074B9C Val_Wu16 109. DFES_EnvTabVerb 0.00 109. FORMAT "%2.0" /end CHARACTERISTIC
/begin CHARACTERISTIC DFES_EnvRef.DFC_IVDiaCylShCirLSBatt_3_C "/" VALUE 0x80074B9E Val_Wu16 109. DFES_EnvTabVerb 0.00 109. FORMAT "%2.0" /end CHARACTERISTIC
/begin CHARACTERISTIC DFES_EnvRef.DFC_IVDiaCylShCirLSBatt_4_C "/" VALUE 0x80074BA0 Val_Wu16 109. DFES_EnvTabVerb 0.00 109. FORMAT "%2.0" /end CHARACTERISTIC
/begin CHARACTERISTIC DFES_EnvRef.DFC_IVDiaCylShCirLSBatt_5_C "/" VALUE 0x80074BA2 Val_Wu16 109. DFES_EnvTabVerb 0.00 109. FORMAT "%2.0" /end CHARACTERISTIC
/begin CHARACTERISTIC DFES_EnvRef.DFC_IVDiaCylShCirLSHS_0_C "/" VALUE 0x80074BA4 Val_Wu16 109. DFES_EnvTabVerb 0.00 109. FORMAT "%2.0" /end CHARACTERISTIC
/begin CHARACTERISTIC DFES_EnvRef.DFC_IVDiaCylShCirLSHS_1_C "/" VALUE 0x80074BA6 Val_Wu16 109. DFES_EnvTabVerb 0.00 109. FORMAT "%2.0" /end CHARACTERISTIC
/begin CHARACTERISTIC DFES_EnvRef.DFC_IVDiaCylShCirLSHS_2_C "/" VALUE 0x80074BA8 Val_Wu16 109. DFES_EnvTabVerb 0.00 109. FORMAT "%2.0" /end CHARACTERISTIC
/begin CHARACTERISTIC DFES_EnvRef.DFC_IVDiaCylShCirLSHS_3_C "/" VALUE 0x80074BAA Val_Wu16 109. DFES_EnvTabVerb 0.00 109. FORMAT "%2.0" /end CHARACTERISTIC
/begin CHARACTERISTIC DFES_EnvRef.DFC_IVDiaCylShCirLSHS_4_C "/" VALUE 0x80074BAC Val_Wu16 109. DFES_EnvTabVerb 0.00 109. FORMAT "%2.0" /end CHARACTERISTIC
/begin CHARACTERISTIC DFES_EnvRef.DFC_IVDiaCylShCirLSHS_5_C "/" VALUE 0x80074BAE Val_Wu16 109. DFES_EnvTabVerb 0.00 109. FORMAT "%2.0" /end CHARACTERISTIC
/begin CHARACTERISTIC DFES_EnvRef.DFC_IVDiaCylShCirLsLs_0_C "/" VALUE 0x80074BB0 Val_Wu16 109. DFES_EnvTabVerb 0.00 109. FORMAT "%2.0" /end CHARACTERISTIC
/begin CHARACTERISTIC DFES_EnvRef.DFC_IVDiaCylShCirLsLs_1_C "/" VALUE 0x80074BB2 Val_Wu16 109. DFES_EnvTabVerb 0.00 109. FORMAT "%2.0" /end CHARACTERISTIC
/begin CHARACTERISTIC DFES_EnvRef.DFC_IVDiaCylShCirLsLs_2_C "/" VALUE 0x80074BB4 Val_Wu16 109. DFES_EnvTabVerb 0.00 109. FORMAT "%2.0" /end CHARACTERISTIC
/begin CHARACTERISTIC DFES_EnvRef.DFC_IVDiaCylShCirLsLs_3_C "/" VALUE 0x80074BB6 Val_Wu16 109. DFES_EnvTabVerb 0.00 109. FORMAT "%2.0" /end CHARACTERISTIC
/begin CHARACTERISTIC DFES_EnvRef.DFC_IVDiaCylShCirLsLs_4_C "/" VALUE 0x80074BB8 Val_Wu16 109. DFES_EnvTabVerb 0.00 109. FORMAT "%2.0" /end CHARACTERISTIC
/begin CHARACTERISTIC DFES_EnvRef.DFC_IVDiaCylShCirLsLs_5_C "/" VALUE 0x80074BBA Val_Wu16 109. DFES_EnvTabVerb 0.00 109. FORMAT "%2.0" /end CHARACTERISTIC
/begin CHARACTERISTIC DFES_EnvRef.DFC_IVDiaSPICfg_C "/" VALUE 0x80074BBC Val_Wu16 109. DFES_EnvTabVerb 0.00 109. FORMAT "%2.0" /end CHARACTERISTIC
/begin CHARACTERISTIC DFES_EnvRef.DFC_IVDiaSPIColl_C "/" VALUE 0x80074BBE Val_Wu16 109. DFES_EnvTabVerb 0.00 109. FORMAT "%2.0" /end CHARACTERISTIC
/begin CHARACTERISTIC DFES_EnvRef.DFC_IVDiaSPICtrl_C "/" VALUE 0x80074BC0 Val_Wu16 109. DFES_EnvTabVerb 0.00 109. FORMAT "%2.0" /end CHARACTERISTIC
/begin CHARACTERISTIC DFES_EnvRef.DFC_IVDiaSPIRam_C "/" VALUE 0x80074BC2 Val_Wu16 109. DFES_EnvTabVerb 0.00 109. FORMAT "%2.0" /end CHARACTERISTIC
/begin CHARACTERISTIC DFES_EnvRef.DFC_IVDiaSPITrans_C "/" VALUE 0x80074BC4 Val_Wu16 109. DFES_EnvTabVerb 0.00 109. FORMAT "%2.0" /end CHARACTERISTIC
/begin CHARACTERISTIC DFES_EnvRef.DFC_LSUCmpChk_0_C "/" VALUE 0x80074BC6 Val_Wu16 109. DFES_EnvTabVerb 0.00 109. FORMAT "%2.0" /end CHARACTERISTIC
/begin CHARACTERISTIC DFES_EnvRef.DFC_LSUCmpChk_1_C "/" VALUE 0x80074BC8 Val_Wu16 109. DFES_EnvTabVerb 0.00 109. FORMAT "%2.0" /end CHARACTERISTIC
/begin CHARACTERISTIC DFES_EnvRef.DFC_LSUCmpChk_2_C "/" VALUE 0x80074BCA Val_Wu16 109. DFES_EnvTabVerb 0.00 109. FORMAT "%2.0" /end CHARACTERISTIC
/begin CHARACTERISTIC DFES_EnvRef.DFC_LSUCmpChk_3_C "/" VALUE 0x80074BCC Val_Wu16 109. DFES_EnvTabVerb 0.00 109. FORMAT "%2.0" /end CHARACTERISTIC
/begin CHARACTERISTIC DFES_EnvRef.DFC_LSUCmpChk_4_C "/" VALUE 0x80074BCE Val_Wu16 109. DFES_EnvTabVerb 0.00 109. FORMAT "%2.0" /end CHARACTERISTIC
/begin CHARACTERISTIC DFES_EnvRef.DFC_LSUCmpChk_5_C "/" VALUE 0x80074BD0 Val_Wu16 109. DFES_EnvTabVerb 0.00 109. FORMAT "%2.0" /end CHARACTERISTIC
/begin CHARACTERISTIC DFES_EnvRef.DFC_LSUDynChk_0_C "/" VALUE 0x80074BD2 Val_Wu16 109. DFES_EnvTabVerb 0.00 109. FORMAT "%2.0" /end CHARACTERISTIC
/begin CHARACTERISTIC DFES_EnvRef.DFC_LSUDynChk_1_C "/" VALUE 0x80074BD4 Val_Wu16 109. DFES_EnvTabVerb 0.00 109. FORMAT "%2.0" /end CHARACTERISTIC
/begin CHARACTERISTIC DFES_EnvRef.DFC_LSUDynChk_2_C "/" VALUE 0x80074BD6 Val_Wu16 109. DFES_EnvTabVerb 0.00 109. FORMAT "%2.0" /end CHARACTERISTIC
/begin CHARACTERISTIC DFES_EnvRef.DFC_LSUDynChk_3_C "/" VALUE 0x80074BD8 Val_Wu16 109. DFES_EnvTabVerb 0.00 109. FORMAT "%2.0" /end CHARACTERISTIC
/begin CHARACTERISTIC DFES_EnvRef.DFC_LSUO2ClbMax_0_C "/" VALUE 0x80074BDA Val_Wu16 109. DFES_EnvTabVerb 0.00 109. FORMAT "%2.0" /end CHARACTERISTIC
/begin CHARACTERISTIC DFES_EnvRef.DFC_LSUO2ClbMax_1_C "/" VALUE 0x80074BDC Val_Wu16 109. DFES_EnvTabVerb 0.00 109. FORMAT "%2.0" /end CHARACTERISTIC
/begin CHARACTERISTIC DFES_EnvRef.DFC_LSUO2ClbMax_2_C "/" VALUE 0x80074BDE Val_Wu16 109. DFES_EnvTabVerb 0.00 109. FORMAT "%2.0" /end CHARACTERISTIC
/begin CHARACTERISTIC DFES_EnvRef.DFC_LSUO2ClbMax_3_C "/" VALUE 0x80074BE0 Val_Wu16 109. DFES_EnvTabVerb 0.00 109. FORMAT "%2.0" /end CHARACTERISTIC
/begin CHARACTERISTIC DFES_EnvRef.DFC_LSUO2ClbMin_0_C "/" VALUE 0x80074BE2 Val_Wu16 109. DFES_EnvTabVerb 0.00 109. FORMAT "%2.0" /end CHARACTERISTIC
/begin CHARACTERISTIC DFES_EnvRef.DFC_LSUO2ClbMin_1_C "/" VALUE 0x80074BE4 Val_Wu16 109. DFES_EnvTabVerb 0.00 109. FORMAT "%2.0" /end CHARACTERISTIC
/begin CHARACTERISTIC DFES_EnvRef.DFC_LSUO2ClbMin_2_C "/" VALUE 0x80074BE6 Val_Wu16 109. DFES_EnvTabVerb 0.00 109. FORMAT "%2.0" /end CHARACTERISTIC
/begin CHARACTERISTIC DFES_EnvRef.DFC_LSUO2ClbMin_3_C "/" VALUE 0x80074BE8 Val_Wu16 109. DFES_EnvTabVerb 0.00 109. FORMAT "%2.0" /end CHARACTERISTIC
/begin CHARACTERISTIC DFES_EnvRef.DFC_LSUO2PlausMax_0_C "/" VALUE 0x80074BEA Val_Wu16 109. DFES_EnvTabVerb 0.00 109. FORMAT "%2.0" /end CHARACTERISTIC
/begin CHARACTERISTIC DFES_EnvRef.DFC_LSUO2PlausMax_1_C "/" VALUE 0x80074BEC Val_Wu16 109. DFES_EnvTabVerb 0.00 109. FORMAT "%2.0" /end CHARACTERISTIC
/begin CHARACTERISTIC DFES_EnvRef.DFC_LSUO2PlausMax_2_C "/" VALUE 0x80074BEE Val_Wu16 109. DFES_EnvTabVerb 0.00 109. FORMAT "%2.0" /end CHARACTERISTIC
/begin CHARACTERISTIC DFES_EnvRef.DFC_LSUO2PlausMax_3_C "/" VALUE 0x80074BF0 Val_Wu16 109. DFES_EnvTabVerb 0.00 109. FORMAT "%2.0" /end CHARACTERISTIC
/begin CHARACTERISTIC DFES_EnvRef.DFC_LSUO2PlausMin_0_C "/" VALUE 0x80074BF2 Val_Wu16 109. DFES_EnvTabVerb 0.00 109. FORMAT "%2.0" /end CHARACTERISTIC
/begin CHARACTERISTIC DFES_EnvRef.DFC_LSUO2PlausMin_1_C "/" VALUE 0x80074BF4 Val_Wu16 109. DFES_EnvTabVerb 0.00 109. FORMAT "%2.0" /end CHARACTERISTIC
/begin CHARACTERISTIC DFES_EnvRef.DFC_LSUO2PlausMin_2_C "/" VALUE 0x80074BF6 Val_Wu16 109. DFES_EnvTabVerb 0.00 109. FORMAT "%2.0" /end CHARACTERISTIC
/begin CHARACTERISTIC DFES_EnvRef.DFC_LSUO2PlausMin_3_C "/" VALUE 0x80074BF8 Val_Wu16 109. DFES_EnvTabVerb 0.00 109. FORMAT "%2.0" /end CHARACTERISTIC
/begin CHARACTERISTIC DFES_EnvRef.DFC_LSURiClbMax_0_C "/" VALUE 0x80074BFA Val_Wu16 109. DFES_EnvTabVerb 0.00 109. FORMAT "%2.0" /end CHARACTERISTIC
/begin CHARACTERISTIC DFES_EnvRef.DFC_LSURiClbMax_1_C "/" VALUE 0x80074BFC Val_Wu16 109. DFES_EnvTabVerb 0.00 109. FORMAT "%2.0" /end CHARACTERISTIC
/begin CHARACTERISTIC DFES_EnvRef.DFC_LSURiClbMax_2_C "/" VALUE 0x80074BFE Val_Wu16 109. DFES_EnvTabVerb 0.00 109. FORMAT "%2.0" /end CHARACTERISTIC
/begin CHARACTERISTIC DFES_EnvRef.DFC_LSURiClbMax_3_C "/" VALUE 0x80074C00 Val_Wu16 109. DFES_EnvTabVerb 0.00 109. FORMAT "%2.0" /end CHARACTERISTIC
/begin CHARACTERISTIC DFES_EnvRef.DFC_LSURiClbMin_0_C "/" VALUE 0x80074C02 Val_Wu16 109. DFES_EnvTabVerb 0.00 109. FORMAT "%2.0" /end CHARACTERISTIC
/begin CHARACTERISTIC DFES_EnvRef.DFC_LSURiClbMin_1_C "/" VALUE 0x80074C04 Val_Wu16 109. DFES_EnvTabVerb 0.00 109. FORMAT "%2.0" /end CHARACTERISTIC
/begin CHARACTERISTIC DFES_EnvRef.DFC_LSURiClbMin_2_C "/" VALUE 0x80074C06 Val_Wu16 109. DFES_EnvTabVerb 0.00 109. FORMAT "%2.0" /end CHARACTERISTIC
/begin CHARACTERISTIC DFES_EnvRef.DFC_LSURiClbMin_3_C "/" VALUE 0x80074C08 Val_Wu16 109. DFES_EnvTabVerb 0.00 109. FORMAT "%2.0" /end CHARACTERISTIC
/begin CHARACTERISTIC DFES_EnvRef.DFC_LSUWireIPSig_0_C "/" VALUE 0x80074C0A Val_Wu16 109. DFES_EnvTabVerb 0.00 109. FORMAT "%2.0" /end CHARACTERISTIC
/begin CHARACTERISTIC DFES_EnvRef.DFC_LSUWireIPSig_1_C "/" VALUE 0x80074C0C Val_Wu16 109. DFES_EnvTabVerb 0.00 109. FORMAT "%2.0" /end CHARACTERISTIC
/begin CHARACTERISTIC DFES_EnvRef.DFC_LSUWireIPSig_2_C "/" VALUE 0x80074C0E Val_Wu16 109. DFES_EnvTabVerb 0.00 109. FORMAT "%2.0" /end CHARACTERISTIC
/begin CHARACTERISTIC DFES_EnvRef.DFC_LSUWireIPSig_3_C "/" VALUE 0x80074C10 Val_Wu16 109. DFES_EnvTabVerb 0.00 109. FORMAT "%2.0" /end CHARACTERISTIC
/begin CHARACTERISTIC DFES_EnvRef.DFC_AFSDrftIdlAdjVal_C "/" VALUE 0x80074C12 Val_Wu16 109. DFES_EnvTabVerb 0.00 109. FORMAT "%2.0" /end CHARACTERISTIC
/begin CHARACTERISTIC DFES_EnvRef.DFC_AFSDrftLdAdjVal_C "/" VALUE 0x80074C14 Val_Wu16 109. DFES_EnvTabVerb 0.00 109. FORMAT "%2.0" /end CHARACTERISTIC
/begin CHARACTERISTIC DFES_EnvRef.DFC_AdcI_ADC0_Cal_C "/" VALUE 0x80074C16 Val_Wu16 109. DFES_EnvTabVerb 0.00 109. FORMAT "%2.0" /end CHARACTERISTIC
/begin CHARACTERISTIC DFES_EnvRef.DFC_AdcI_ADC0_Conv_C "/" VALUE 0x80074C18 Val_Wu16 109. DFES_EnvTabVerb 0.00 109. FORMAT "%2.0" /end CHARACTERISTIC
/begin CHARACTERISTIC DFES_EnvRef.DFC_CmbChbMisfireMax_0_C "/" VALUE 0x80074C1A Val_Wu16 109. DFES_EnvTabVerb 0.00 109. FORMAT "%2.0" /end CHARACTERISTIC
/begin CHARACTERISTIC DFES_EnvRef.DFC_CmbChbMisfireMax_1_C "/" VALUE 0x80074C1C Val_Wu16 109. DFES_EnvTabVerb 0.00 109. FORMAT "%2.0" /end CHARACTERISTIC
/begin CHARACTERISTIC DFES_EnvRef.DFC_CmbChbMisfireMax_2_C "/" VALUE 0x80074C1E Val_Wu16 109. DFES_EnvTabVerb 0.00 109. FORMAT "%2.0" /end CHARACTERISTIC
/begin CHARACTERISTIC DFES_EnvRef.DFC_CmbChbMisfireMax_3_C "/" VALUE 0x80074C20 Val_Wu16 109. DFES_EnvTabVerb 0.00 109. FORMAT "%2.0" /end CHARACTERISTIC
/begin CHARACTERISTIC DFES_EnvRef.DFC_CmbChbMisfireMax_4_C "/" VALUE 0x80074C22 Val_Wu16 109. DFES_EnvTabVerb 0.00 109. FORMAT "%2.0" /end CHARACTERISTIC
/begin CHARACTERISTIC DFES_EnvRef.DFC_CmbChbMisfireMax_5_C "/" VALUE 0x80074C24 Val_Wu16 109. DFES_EnvTabVerb 0.00 109. FORMAT "%2.0" /end CHARACTERISTIC
/begin CHARACTERISTIC DFES_EnvRef.DFC_CmbChbMisfireMul_C "/" VALUE 0x80074C26 Val_Wu16 109. DFES_EnvTabVerb 0.00 109. FORMAT "%2.0" /end CHARACTERISTIC
/begin CHARACTERISTIC DFES_EnvRef.DFC_INJVLVBUSY_C "/" VALUE 0x80074C28 Val_Wu16 109. DFES_EnvTabVerb 0.00 109. FORMAT "%2.0" /end CHARACTERISTIC
/begin CHARACTERISTIC DFES_EnvRef.DFC_IVAdjIVA_0_C "/" VALUE 0x80074C2A Val_Wu16 109. DFES_EnvTabVerb 0.00 109. FORMAT "%2.0" /end CHARACTERISTIC
/begin CHARACTERISTIC DFES_EnvRef.DFC_IVAdjIVA_1_C "/" VALUE 0x80074C2C Val_Wu16 109. DFES_EnvTabVerb 0.00 109. FORMAT "%2.0" /end CHARACTERISTIC
/begin CHARACTERISTIC DFES_EnvRef.DFC_IVAdjIVA_2_C "/" VALUE 0x80074C2E Val_Wu16 109. DFES_EnvTabVerb 0.00 109. FORMAT "%2.0" /end CHARACTERISTIC
/begin CHARACTERISTIC DFES_EnvRef.DFC_IVAdjIVA_3_C "/" VALUE 0x80074C30 Val_Wu16 109. DFES_EnvTabVerb 0.00 109. FORMAT "%2.0" /end CHARACTERISTIC
/begin CHARACTERISTIC DFES_EnvRef.DFC_IVAdjIVA_4_C "/" VALUE 0x80074C32 Val_Wu16 109. DFES_EnvTabVerb 0.00 109. FORMAT "%2.0" /end CHARACTERISTIC
/begin CHARACTERISTIC DFES_EnvRef.DFC_IVAdjIVA_5_C "/" VALUE 0x80074C34 Val_Wu16 109. DFES_EnvTabVerb 0.00 109. FORMAT "%2.0" /end CHARACTERISTIC
/begin CHARACTERISTIC DFES_EnvRef.DFC_InjCtlAdjQntEEPCS_C "/" VALUE 0x80074C36 Val_Wu16 109. DFES_EnvTabVerb 0.00 109. FORMAT "%2.0" /end CHARACTERISTIC
/begin CHARACTERISTIC DFES_EnvRef.DFC_InjCtlDriftEEPCS_C "/" VALUE 0x80074C38 Val_Wu16 109. DFES_EnvTabVerb 0.00 109. FORMAT "%2.0" /end CHARACTERISTIC
/begin CHARACTERISTIC DFES_EnvRef.DFC_MRlyErlyOpng_C "/" VALUE 0x80074C3A Val_Wu16 109. DFES_EnvTabVerb 0.00 109. FORMAT "%2.0" /end CHARACTERISTIC
/begin CHARACTERISTIC DFES_EnvRef.DFC_MRlyStk_C "/" VALUE 0x80074C3C Val_Wu16 109. DFES_EnvTabVerb 0.00 109. FORMAT "%2.0" /end CHARACTERISTIC
/begin CHARACTERISTIC DFES_EnvRef.DFC_SensFrzPPFltUs_C "/" VALUE 0x80074C3E Val_Wu16 109. DFES_EnvTabVerb 0.00 109. FORMAT "%2.0" /end CHARACTERISTIC
/begin CHARACTERISTIC DFES_EnvRef.DFC_T15Sig_C "/" VALUE 0x80074C40 Val_Wu16 109. DFES_EnvTabVerb 0.00 109. FORMAT "%2.0" /end CHARACTERISTIC
/begin CHARACTERISTIC DFES_EnvRef.DFC_AirCtlRmpTOut_C "/" VALUE 0x80074C42 Val_Wu16 109. DFES_EnvTabVerb 0.00 109. FORMAT "%2.0" /end CHARACTERISTIC
/begin CHARACTERISTIC DFES_EnvRef.DFC_CEngDsTDynTst_C "/" VALUE 0x80074C44 Val_Wu16 109. DFES_EnvTabVerb 0.00 109. FORMAT "%2.0" /end CHARACTERISTIC
/begin CHARACTERISTIC DFES_EnvRef.DFC_EGRVlvJamVlvClsd_C "/" VALUE 0x80074C46 Val_Wu16 109. DFES_EnvTabVerb 0.00 109. FORMAT "%2.0" /end CHARACTERISTIC
/begin CHARACTERISTIC DFES_EnvRef.DFC_EGRVlvJamVlvOpn_C "/" VALUE 0x80074C48 Val_Wu16 109. DFES_EnvTabVerb 0.00 109. FORMAT "%2.0" /end CHARACTERISTIC
/begin CHARACTERISTIC DFES_EnvRef.DFC_EGRVlvLgTDrft_C "/" VALUE 0x80074C4A Val_Wu16 109. DFES_EnvTabVerb 0.00 109. FORMAT "%2.0" /end CHARACTERISTIC
/begin CHARACTERISTIC DFES_EnvRef.DFC_EGRVlvOfsLrnJamVlv_C "/" VALUE 0x80074C4C Val_Wu16 109. DFES_EnvTabVerb 0.00 109. FORMAT "%2.0" /end CHARACTERISTIC
/begin CHARACTERISTIC DFES_EnvRef.DFC_EGRVlvShTDrft_C "/" VALUE 0x80074C4E Val_Wu16 109. DFES_EnvTabVerb 0.00 109. FORMAT "%2.0" /end CHARACTERISTIC
/begin CHARACTERISTIC DFES_EnvRef.DFC_EGTRgnOilDilMax_C "/" VALUE 0x80074C50 Val_Wu16 109. DFES_EnvTabVerb 0.00 109. FORMAT "%2.0" /end CHARACTERISTIC
/begin CHARACTERISTIC DFES_EnvRef.DFC_EngICO_C "/" VALUE 0x80074C52 Val_Wu16 109. DFES_EnvTabVerb 0.00 109. FORMAT "%2.0" /end CHARACTERISTIC
/begin CHARACTERISTIC DFES_EnvRef.DFC_EpmCaSI1ErrSig_C "/" VALUE 0x80074C54 Val_Wu16 109. DFES_EnvTabVerb 0.00 109. FORMAT "%2.0" /end CHARACTERISTIC
/begin CHARACTERISTIC DFES_EnvRef.DFC_EpmCaSI1NoSig_C "/" VALUE 0x80074C56 Val_Wu16 109. DFES_EnvTabVerb 0.00 109. FORMAT "%2.0" /end CHARACTERISTIC
/begin CHARACTERISTIC DFES_EnvRef.DFC_EpmCaSI1OfsErr_C "/" VALUE 0x80074C58 Val_Wu16 109. DFES_EnvTabVerb 0.00 109. FORMAT "%2.0" /end CHARACTERISTIC
/begin CHARACTERISTIC DFES_EnvRef.DFC_EpmCrSErrSig_C "/" VALUE 0x80074C5A Val_Wu16 109. DFES_EnvTabVerb 0.00 109. FORMAT "%2.0" /end CHARACTERISTIC
/begin CHARACTERISTIC DFES_EnvRef.DFC_EpmCrSNoSig_C "/" VALUE 0x80074C5C Val_Wu16 109. DFES_EnvTabVerb 0.00 109. FORMAT "%2.0" /end CHARACTERISTIC
/begin CHARACTERISTIC DFES_EnvRef.DFC_MoCADCCmp_C "/" VALUE 0x80074C5E Val_Wu16 109. DFES_EnvTabVerb 0.00 109. FORMAT "%2.0" /end CHARACTERISTIC
/begin CHARACTERISTIC DFES_EnvRef.DFC_MoCADCTst_C "/" VALUE 0x80074C60 Val_Wu16 109. DFES_EnvTabVerb 0.00 109. FORMAT "%2.0" /end CHARACTERISTIC
/begin CHARACTERISTIC DFES_EnvRef.DFC_MoCADCVltgRatio_C "/" VALUE 0x80074C62 Val_Wu16 109. DFES_EnvTabVerb 0.00 109. FORMAT "%2.0" /end CHARACTERISTIC
/begin CHARACTERISTIC DFES_EnvRef.DFC_MoCSOPLoLi_C "/" VALUE 0x80074C64 Val_Wu16 109. DFES_EnvTabVerb 0.00 109. FORMAT "%2.0" /end CHARACTERISTIC
/begin CHARACTERISTIC DFES_EnvRef.DFC_MoCSOPMM_C "/" VALUE 0x80074C66 Val_Wu16 109. DFES_EnvTabVerb 0.00 109. FORMAT "%2.0" /end CHARACTERISTIC
/begin CHARACTERISTIC DFES_EnvRef.DFC_MoCSOPTimeOut_C "/" VALUE 0x80074C68 Val_Wu16 109. DFES_EnvTabVerb 0.00 109. FORMAT "%2.0" /end CHARACTERISTIC
/begin CHARACTERISTIC DFES_EnvRef.DFC_MoCSOPUpLi_C "/" VALUE 0x80074C6A Val_Wu16 109. DFES_EnvTabVerb 0.00 109. FORMAT "%2.0" /end CHARACTERISTIC
/begin CHARACTERISTIC DFES_EnvRef.DFC_MoFAPP_C "/" VALUE 0x80074C6C Val_Wu16 109. DFES_EnvTabVerb 0.00 109. FORMAT "%2.0" /end CHARACTERISTIC
/begin CHARACTERISTIC DFES_EnvRef.DFC_MoFESpd_C "/" VALUE 0x80074C6E Val_Wu16 109. DFES_EnvTabVerb 0.00 109. FORMAT "%2.0" /end CHARACTERISTIC
/begin CHARACTERISTIC DFES_EnvRef.DFC_MoFInjDatPhi_C "/" VALUE 0x80074C70 Val_Wu16 109. DFES_EnvTabVerb 0.00 109. FORMAT "%2.0" /end CHARACTERISTIC
/begin CHARACTERISTIC DFES_EnvRef.DFC_MoFInjDatQnt_C "/" VALUE 0x80074C72 Val_Wu16 109. DFES_EnvTabVerb 0.00 109. FORMAT "%2.0" /end CHARACTERISTIC
/begin CHARACTERISTIC DFES_EnvRef.DFC_MoFInjQnt_C "/" VALUE 0x80074C74 Val_Wu16 109. DFES_EnvTabVerb 0.00 109. FORMAT "%2.0" /end CHARACTERISTIC
/begin CHARACTERISTIC DFES_EnvRef.DFC_MoFOvR_C "/" VALUE 0x80074C76 Val_Wu16 109. DFES_EnvTabVerb 0.00 109. FORMAT "%2.0" /end CHARACTERISTIC
/begin CHARACTERISTIC DFES_EnvRef.DFC_MoFQntCor_C "/" VALUE 0x80074C78 Val_Wu16 109. DFES_EnvTabVerb 0.00 109. FORMAT "%2.0" /end CHARACTERISTIC
/begin CHARACTERISTIC DFES_EnvRef.DFC_MoFTrqCmp_C "/" VALUE 0x80074C7A Val_Wu16 109. DFES_EnvTabVerb 0.00 109. FORMAT "%2.0" /end CHARACTERISTIC
/begin CHARACTERISTIC DFES_EnvRef.DFC_NplTOxiCatUs_C "/" VALUE 0x80074C7C Val_Wu16 109. DFES_EnvTabVerb 0.00 109. FORMAT "%2.0" /end CHARACTERISTIC
/begin CHARACTERISTIC DFES_EnvRef.DFC_PhyModNonMonMapNpl_C "/" VALUE 0x80074C7E Val_Wu16 109. DFES_EnvTabVerb 0.00 109. FORMAT "%2.0" /end CHARACTERISTIC
/begin CHARACTERISTIC DFES_EnvRef.DFC_RailPOfsTstMax_C "/" VALUE 0x80074C80 Val_Wu16 109. DFES_EnvTabVerb 0.00 109. FORMAT "%2.0" /end CHARACTERISTIC
/begin CHARACTERISTIC DFES_EnvRef.DFC_RailPOfsTstMin_C "/" VALUE 0x80074C82 Val_Wu16 109. DFES_EnvTabVerb 0.00 109. FORMAT "%2.0" /end CHARACTERISTIC
/begin CHARACTERISTIC DFES_EnvRef.DFC_SWReset_0_C "/" VALUE 0x80074C84 Val_Wu16 109. DFES_EnvTabVerb 0.00 109. FORMAT "%2.0" /end CHARACTERISTIC
/begin CHARACTERISTIC DFES_EnvRef.DFC_SWReset_1_C "/" VALUE 0x80074C86 Val_Wu16 109. DFES_EnvTabVerb 0.00 109. FORMAT "%2.0" /end CHARACTERISTIC
/begin CHARACTERISTIC DFES_EnvRef.DFC_SWReset_2_C "/" VALUE 0x80074C88 Val_Wu16 109. DFES_EnvTabVerb 0.00 109. FORMAT "%2.0" /end CHARACTERISTIC
/begin CHARACTERISTIC DFES_EnvRef.DFC_VSwVlvJamVlv_C "/" VALUE 0x80074C8A Val_Wu16 109. DFES_EnvTabVerb 0.00 109. FORMAT "%2.0" /end CHARACTERISTIC
/begin CHARACTERISTIC DFES_EnvRef.DFC_VSwVlvLgTDrft_C "/" VALUE 0x80074C8C Val_Wu16 109. DFES_EnvTabVerb 0.00 109. FORMAT "%2.0" /end CHARACTERISTIC
/begin CHARACTERISTIC DFES_EnvRef.DFC_VSwVlvOfsLrnJamVlv_C "/" VALUE 0x80074C8E Val_Wu16 109. DFES_EnvTabVerb 0.00 109. FORMAT "%2.0" /end CHARACTERISTIC
/begin CHARACTERISTIC DFES_EnvRef.DFC_VSwVlvShTDrft_C "/" VALUE 0x80074C90 Val_Wu16 109. DFES_EnvTabVerb 0.00 109. FORMAT "%2.0" /end CHARACTERISTIC
/begin CHARACTERISTIC DFES_MonEvtMSK0_C "" VALUE 0x8004B862 Val_Wu16 65535.00 OneToOne 0.00 65535.00 FORMAT "%8.2" /end CHARACTERISTIC
/begin CHARACTERISTIC DFES_MonEvtMSK1_C "" VALUE 0x8004B864 Val_Wu16 65535.00 OneToOne 0.00 65535.00 FORMAT "%8.2" /end CHARACTERISTIC
/begin CHARACTERISTIC DFES_MonRepeat_C "" VALUE 0x8004B866 Val_Wu8 255.0 OneToOne 0.00 255.0 FORMAT "%5.1" /end CHARACTERISTIC
/begin MEASUREMENT DFES_MonEvnt "" UWORD DFES_Mon_Verb 1 100 0.00 16386.0000000 FORMAT "%13.7" ARRAY_SIZE 16 ECU_ADDRESS 0xD000CE22 /end MEASUREMENT
/begin MEASUREMENT DFES_MonObjt "" UWORD OneToOne 1 100 0.00 65535.00 FORMAT "%8.2" ARRAY_SIZE 16 ECU_ADDRESS 0xD000CE42 /end MEASUREMENT
/begin MEASUREMENT DFES_MonParm "" UWORD OneToOne 1 100 0.00 65535.00 FORMAT "%8.2" ARRAY_SIZE 16 ECU_ADDRESS 0xD000CE62 /end MEASUREMENT
/begin MEASUREMENT DFES_MonPtr "" UBYTE DFES_OneToOne 1 100 0.00 255.0 FORMAT "%5.1" ECU_ADDRESS 0xD000CE20 /end MEASUREMENT
/begin FUNCTION dfes_envref_auto ""
 /begin DEF_CHARACTERISTIC DFES_EnvRef.DFC_AirCtlGovDvtEOMMax_C DFES_EnvRef.DFC_AirCtlGovDvtEOMMin_C DFES_EnvRef.DFC_AirCtlGovDvtMax_C DFES_EnvRef.DFC_AirCtlGovDvtMin_C DFES_EnvRef.DFC_Cj945SpiCom1_C DFES_EnvRef.DFC_ComButtonMSASig_C DFES_EnvRef.DFC_ComButtonMSATo_C DFES_EnvRef.DFC_ComGearboxData2Sig_C DFES_EnvRef.DFC_ComGearboxData2To_C DFES_EnvRef.DFC_ComGearboxDataSig_C DFES_EnvRef.DFC_ComGearboxDataTo_C DFES_EnvRef.DFC_ComHeatACSig_C DFES_EnvRef.DFC_ComHeatACTo_C DFES_EnvRef.DFC_ComLenkradwinkelSig_C DFES_EnvRef.DFC_ComLenkradwinkelTo_C DFES_EnvRef.DFC_ComMileageRangeSig_C DFES_EnvRef.DFC_ComMileageRangeTo_C DFES_EnvRef.DFC_ComPspSig_C DFES_EnvRef.DFC_ComPspTo_C DFES_EnvRef.DFC_ComShutOffPSPSig_C DFES_EnvRef.DFC_ComShutOffPSPTo_C DFES_EnvRef.DFC_ComStKombiCtr_C DFES_EnvRef.DFC_ComStKombiSig_C DFES_EnvRef.DFC_ComStKombiTo_C DFES_EnvRef.DFC_ComStateARSCtr_C DFES_EnvRef.DFC_ComStateARSSig_C DFES_EnvRef.DFC_ComStateARSTo_C DFES_EnvRef.DFC_ComStateDscSig_C DFES_EnvRef.DFC_ComStateDscTo_C DFES_EnvRef.DFC_ComStateSeatSig_C DFES_EnvRef.DFC_ComStateSeatTo_C DFES_EnvRef.DFC_ComTempRelTimeSig_C DFES_EnvRef.DFC_ComTempRelTimeTo_C DFES_EnvRef.DFC_ComTerminalChk_C DFES_EnvRef.DFC_ComTerminalCtr_C DFES_EnvRef.DFC_ComTerminalSig_C DFES_EnvRef.DFC_ComTerminalTo_C DFES_EnvRef.DFC_ComTimeDateSig_C DFES_EnvRef.DFC_ComTimeDateTo_C DFES_EnvRef.DFC_ComTrailerSig_C DFES_EnvRef.DFC_ComTrailerTo_C DFES_EnvRef.DFC_ComTrqDemandAfsChk_C DFES_EnvRef.DFC_ComTrqDemandAfsCtr_C DFES_EnvRef.DFC_ComTrqDemandAfsSig_C DFES_EnvRef.DFC_ComTrqDemandAfsTo_C DFES_EnvRef.DFC_ComTrqDemandDscChk_C DFES_EnvRef.DFC_ComTrqDemandDscCtr_C DFES_EnvRef.DFC_ComTrqDemandDscSig_C DFES_EnvRef.DFC_ComTrqDemandDscTo_C DFES_EnvRef.DFC_ComTrqDemandGbxChk_C DFES_EnvRef.DFC_ComTrqDemandGbxCtr_C DFES_EnvRef.DFC_ComTrqDemandGbxSig_C DFES_EnvRef.DFC_ComTrqDemandGbxTo_C DFES_EnvRef.DFC_ComVelocitySig_C DFES_EnvRef.DFC_ComVelocityTo_C DFES_EnvRef.DFC_ComWheelSpeedSig_C DFES_EnvRef.DFC_ComWheelSpeedTo_C DFES_EnvRef.DFC_ComZvKlappenSig_C DFES_EnvRef.DFC_ComZvKlappenTo_C DFES_EnvRef.DFC_Cy150SpiCom_C DFES_EnvRef.DFC_Cy320SpiCom_C DFES_EnvRef.DFC_ETCtlDvtInrMax_C DFES_EnvRef.DFC_ETCtlDvtInrMin_C DFES_EnvRef.DFC_ETCtlDvtOutrMax_C DFES_EnvRef.DFC_ETCtlDvtOutrMin_C DFES_EnvRef.DFC_Fan4WinErr1_C DFES_EnvRef.DFC_Fan4WinErr2_C DFES_EnvRef.DFC_Fan4WinErr3_C DFES_EnvRef.DFC_Fan4WinErr4_C DFES_EnvRef.DFC_FanSCG_C DFES_EnvRef.DFC_PCRGovDvtLPMax_C DFES_EnvRef.DFC_PCRGovDvtLPMin_C DFES_EnvRef.DFC_PCRGovDvtMax_C DFES_EnvRef.DFC_PCRGovDvtMin_C DFES_EnvRef.DFC_RailCPC1_C DFES_EnvRef.DFC_RailCPC3_C DFES_EnvRef.DFC_RailCPC4_C DFES_EnvRef.DFC_RailMeUn0_C DFES_EnvRef.DFC_RailMeUn1_C DFES_EnvRef.DFC_RailMeUn2_C DFES_EnvRef.DFC_RailMeUn3_C DFES_EnvRef.DFC_RailMeUn4_C DFES_EnvRef.DFC_RailPCV0_C DFES_EnvRef.DFC_RailPCV1_C DFES_EnvRef.DFC_RailPCV2_C DFES_EnvRef.DFC_RailPCV3_C DFES_EnvRef.DFC_RailPCV4_C DFES_EnvRef.DFC_RailPMonStrt_C DFES_EnvRef.DFC_SSpMon1_C DFES_EnvRef.DFC_SSpMon2_C DFES_EnvRef.DFC_SSpMon3_C DFES_EnvRef.DFC_Sia_E1_C DFES_EnvRef.DFC_Sia_E10_C DFES_EnvRef.DFC_Sia_E11_C DFES_EnvRef.DFC_Sia_E12_C DFES_EnvRef.DFC_Sia_E13_C DFES_EnvRef.DFC_Sia_E14_C DFES_EnvRef.DFC_Sia_E15_C DFES_EnvRef.DFC_Sia_E2_C DFES_EnvRef.DFC_Sia_E3_C DFES_EnvRef.DFC_Sia_E4_C DFES_EnvRef.DFC_Sia_E5_C DFES_EnvRef.DFC_Sia_E6_C DFES_EnvRef.DFC_Sia_E7_C DFES_EnvRef.DFC_Sia_E8_C DFES_EnvRef.DFC_Sia_E9_C DFES_EnvRef.DFC_ThrVlv4WinErr1_C DFES_EnvRef.DFC_ThrVlv4WinErr2_C DFES_EnvRef.DFC_ThrVlv4WinErr3_C DFES_EnvRef.DFC_ThrVlv4WinErr4_C DFES_EnvRef.DFC_ThrVlvSCG_C DFES_EnvRef.DFC_TrbCh4WinErr1_C DFES_EnvRef.DFC_TrbCh4WinErr2_C DFES_EnvRef.DFC_TrbCh4WinErr3_C DFES_EnvRef.DFC_TrbCh4WinErr4_C DFES_EnvRef.DFC_TrbChSCG_C DFES_EnvRef.DFC_TrbChSRCMax_C DFES_EnvRef.DFC_TrbChSRCMin_C DFES_EnvRef.DFC_WaHtEl4WinErr1_C DFES_EnvRef.DFC_WaHtEl4WinErr2_C DFES_EnvRef.DFC_WaHtEl4WinErr3_C DFES_EnvRef.DFC_WaHtEl4WinErr4_C DFES_EnvRef.DFC_WaHtElSCG_C DFES_EnvRef.DFC_ETClbETFltMax_C DFES_EnvRef.DFC_ETClbETFltMin_C DFES_EnvRef.DFC_InjCrvInjLimChrgBal_C DFES_EnvRef.DFC_InjCrvInjLimQntBal_C DFES_EnvRef.DFC_InjCrvInjLimSys_C DFES_EnvRef.DFC_InjCrvNumInjRtmLim_C DFES_EnvRef.DFC_LSUHtCoupSig_0_C DFES_EnvRef.DFC_LSUHtCoupSig_1_C DFES_EnvRef.DFC_LSUHtCoupSig_2_C DFES_EnvRef.DFC_LSUHtCoupSig_3_C DFES_EnvRef.DFC_CtT_C DFES_EnvRef.DFC_DSMDummy_C DFES_EnvRef.DFC_MeUnOL_C DFES_EnvRef.DFC_MeUnSCB_C DFES_EnvRef.DFC_MeUnSRCMax_C DFES_EnvRef.DFC_MeUnSRCMin_C DFES_EnvRef.DFC_PCVOL_C DFES_EnvRef.DFC_PCVSCB_C DFES_EnvRef.DFC_PCVSRCMax_C DFES_EnvRef.DFC_PCVSRCMin_C DFES_EnvRef.DFC_RailPSRCMax_C DFES_EnvRef.DFC_RailPSRCMin_C DFES_EnvRef.DFC_IVActrVltgSRCMax_C DFES_EnvRef.DFC_IVActrVltgSRCMin_C DFES_EnvRef.DFC_IVPSplyDCDC_C DFES_EnvRef.DFC_IVPSplyVltgSRCMax_C DFES_EnvRef.DFC_IVPSplyVltgSRCMin_C DFES_EnvRef.DFC_AFSOffsDrftMax_C DFES_EnvRef.DFC_AFSOffsDrftMin_C DFES_EnvRef.DFC_AFSSRCCorMax_C DFES_EnvRef.DFC_AFSSRCCorMin_C DFES_EnvRef.DFC_AFSSRCRawMax_C DFES_EnvRef.DFC_AFSSRCRawMin_C DFES_EnvRef.DFC_AFSSetyDrftMax_C DFES_EnvRef.DFC_AFSSetyDrftMin_C DFES_EnvRef.DFC_AirCClntPAnaSRCMax_C DFES_EnvRef.DFC_AirCClntPAnaSRCMin_C DFES_EnvRef.DFC_AirCClntPPerSRCMax_C DFES_EnvRef.DFC_AirCClntPPerSRCMin_C DFES_EnvRef.DFC_AirCClntPdcycSRCMax_C DFES_EnvRef.DFC_AirCClntPdcycSRCMin_C DFES_EnvRef.DFC_AirCCmprOL_C DFES_EnvRef.DFC_AirCCmprRedTrqOL_C DFES_EnvRef.DFC_AirCCmprRedTrqSCB_C DFES_EnvRef.DFC_AirCCmprRedTrqSCG_C DFES_EnvRef.DFC_AirCCmprSCB_C DFES_EnvRef.DFC_AirCCmprSCG_C DFES_EnvRef.DFC_AirCSwtNpl_C DFES_EnvRef.DFC_AirCSwtSig_C DFES_EnvRef.DFC_BattUSRCMax_C DFES_EnvRef.DFC_BattUSRCMin_C DFES_EnvRef.DFC_BrkNpl_C DFES_EnvRef.DFC_BrkPSRCMax_C DFES_EnvRef.DFC_BrkPSRCMin_C DFES_EnvRef.DFC_BrkSig_C DFES_EnvRef.DFC_CByVlvOL_C DFES_EnvRef.DFC_CByVlvSCB_C DFES_EnvRef.DFC_CByVlvSCG_C DFES_EnvRef.DFC_CEngDsTSRCMax_C DFES_EnvRef.DFC_CEngDsTSRCMin_C DFES_EnvRef.DFC_CEngDsTSig_C DFES_EnvRef.DFC_CEngUsTSRCMax_C DFES_EnvRef.DFC_CEngUsTSRCMin_C DFES_EnvRef.DFC_CThmstOL_C DFES_EnvRef.DFC_CThmstSCB_C DFES_EnvRef.DFC_CThmstSCG_C DFES_EnvRef.DFC_ClthSig_C DFES_EnvRef.DFC_ECBVlvOL_C DFES_EnvRef.DFC_ECBVlvSCB_C DFES_EnvRef.DFC_ECBVlvSCG_C DFES_EnvRef.DFC_ECBVlvSRCMax_C DFES_EnvRef.DFC_ECBVlvSRCMin_C DFES_EnvRef.DFC_EGRVlvGovDvtMax_C DFES_EnvRef.DFC_EGRVlvGovDvtMin_C DFES_EnvRef.DFC_EGRVlvOL_C DFES_EnvRef.DFC_EGRVlvSCB_C DFES_EnvRef.DFC_EGRVlvSCG_C DFES_EnvRef.DFC_EGRVlvSRCMax_C DFES_EnvRef.DFC_EGRVlvSRCMin_C DFES_EnvRef.DFC_EMDmpOL_0_C DFES_EnvRef.DFC_EMDmpOL_1_C DFES_EnvRef.DFC_EMDmpSCB_0_C DFES_EnvRef.DFC_EMDmpSCB_1_C DFES_EnvRef.DFC_EMDmpSCG_0_C DFES_EnvRef.DFC_EMDmpSCG_1_C DFES_EnvRef.DFC_EngStAOL_C DFES_EnvRef.DFC_EngStASCB_C DFES_EnvRef.DFC_EngStASCG_C DFES_EnvRef.DFC_EnvPSRCMax_C DFES_EnvRef.DFC_EnvPSRCMin_C DFES_EnvRef.DFC_EnvPSig_C DFES_EnvRef.DFC_EnvTSRCMax_C DFES_EnvRef.DFC_EnvTSRCMin_C DFES_EnvRef.DFC_FanOL_C DFES_EnvRef.DFC_FanSCB_C DFES_EnvRef.DFC_FlFltSig_C DFES_EnvRef.DFC_FuelTSRCMax_C DFES_EnvRef.DFC_FuelTSRCMin_C DFES_EnvRef.DFC_GbxNPosPPerSRCMax_C DFES_EnvRef.DFC_GbxNPosPPerSRCMin_C DFES_EnvRef.DFC_GbxNPosPdcycSRCMax_C DFES_EnvRef.DFC_GbxNPosPdcycSRCMin_C DFES_EnvRef.DFC_GbxNPosSig_C DFES_EnvRef.DFC_GlwPlgBSDOL_0_C DFES_EnvRef.DFC_GlwPlgBSDOL_1_C DFES_EnvRef.DFC_GlwPlgBSDOL_2_C DFES_EnvRef.DFC_GlwPlgBSDOL_3_C DFES_EnvRef.DFC_GlwPlgBSDOL_4_C DFES_EnvRef.DFC_GlwPlgBSDOL_5_C DFES_EnvRef.DFC_GlwPlgBSDOL_6_C DFES_EnvRef.DFC_GlwPlgBSDOL_7_C DFES_EnvRef.DFC_GlwPlgBSDOT_0_C DFES_EnvRef.DFC_GlwPlgBSDOT_1_C DFES_EnvRef.DFC_GlwPlgBSDOT_2_C DFES_EnvRef.DFC_GlwPlgBSDOT_3_C DFES_EnvRef.DFC_GlwPlgBSDOT_4_C DFES_EnvRef.DFC_GlwPlgBSDOT_5_C DFES_EnvRef.DFC_GlwPlgBSDOT_6_C DFES_EnvRef.DFC_GlwPlgBSDOT_7_C DFES_EnvRef.DFC_GlwPlgBSDSC_0_C DFES_EnvRef.DFC_GlwPlgBSDSC_1_C DFES_EnvRef.DFC_GlwPlgBSDSC_2_C DFES_EnvRef.DFC_GlwPlgBSDSC_3_C DFES_EnvRef.DFC_GlwPlgBSDSC_4_C DFES_EnvRef.DFC_GlwPlgBSDSC_5_C DFES_EnvRef.DFC_GlwPlgBSDSC_6_C DFES_EnvRef.DFC_GlwPlgBSDSC_7_C DFES_EnvRef.DFC_GlwPlgComErr_C DFES_EnvRef.DFC_InjVlvPresMin_C DFES_EnvRef.DFC_LSUCircNernstMax_0_C DFES_EnvRef.DFC_LSUCircNernstMax_1_C DFES_EnvRef.DFC_LSUCircNernstMax_2_C DFES_EnvRef.DFC_LSUCircNernstMax_3_C DFES_EnvRef.DFC_LSUCircNernstMin_0_C DFES_EnvRef.DFC_LSUCircNernstMin_1_C DFES_EnvRef.DFC_LSUCircNernstMin_2_C DFES_EnvRef.DFC_LSUCircNernstMin_3_C DFES_EnvRef.DFC_LSUCircNernstSig_0_C DFES_EnvRef.DFC_LSUCircNernstSig_1_C DFES_EnvRef.DFC_LSUCircNernstSig_2_C DFES_EnvRef.DFC_LSUCircNernstSig_3_C DFES_EnvRef.DFC_LSUCircPmpCurMax_0_C DFES_EnvRef.DFC_LSUCircPmpCurMax_1_C DFES_EnvRef.DFC_LSUCircPmpCurMax_2_C DFES_EnvRef.DFC_LSUCircPmpCurMax_3_C DFES_EnvRef.DFC_LSUCircPmpCurMin_0_C DFES_EnvRef.DFC_LSUCircPmpCurMin_1_C DFES_EnvRef.DFC_LSUCircPmpCurMin_2_C DFES_EnvRef.DFC_LSUCircPmpCurMin_3_C DFES_EnvRef.DFC_LSUCircPmpCurSig_0_C DFES_EnvRef.DFC_LSUCircPmpCurSig_1_C DFES_EnvRef.DFC_LSUCircPmpCurSig_2_C DFES_EnvRef.DFC_LSUCircPmpCurSig_3_C DFES_EnvRef.DFC_LSUCircVirtGndMax_0_C DFES_EnvRef.DFC_LSUCircVirtGndMax_1_C DFES_EnvRef.DFC_LSUCircVirtGndMax_2_C DFES_EnvRef.DFC_LSUCircVirtGndMax_3_C DFES_EnvRef.DFC_LSUCircVirtGndMin_0_C DFES_EnvRef.DFC_LSUCircVirtGndMin_1_C DFES_EnvRef.DFC_LSUCircVirtGndMin_2_C DFES_EnvRef.DFC_LSUCircVirtGndMin_3_C DFES_EnvRef.DFC_LSUCircVirtGndSig_0_C DFES_EnvRef.DFC_LSUCircVirtGndSig_1_C DFES_EnvRef.DFC_LSUCircVirtGndSig_2_C DFES_EnvRef.DFC_LSUCircVirtGndSig_3_C DFES_EnvRef.DFC_LSUHtrMax_0_C DFES_EnvRef.DFC_LSUHtrMax_1_C DFES_EnvRef.DFC_LSUHtrMax_2_C DFES_EnvRef.DFC_LSUHtrMax_3_C DFES_EnvRef.DFC_LSUHtrMin_0_C DFES_EnvRef.DFC_LSUHtrMin_1_C DFES_EnvRef.DFC_LSUHtrMin_2_C DFES_EnvRef.DFC_LSUHtrMin_3_C DFES_EnvRef.DFC_LSUHtrSig_0_C DFES_EnvRef.DFC_LSUHtrSig_1_C DFES_EnvRef.DFC_LSUHtrSig_2_C DFES_EnvRef.DFC_LSUHtrSig_3_C DFES_EnvRef.DFC_LSUO2Max_0_C DFES_EnvRef.DFC_LSUO2Max_1_C DFES_EnvRef.DFC_LSUO2Max_2_C DFES_EnvRef.DFC_LSUO2Max_3_C DFES_EnvRef.DFC_LSUO2Min_0_C DFES_EnvRef.DFC_LSUO2Min_1_C DFES_EnvRef.DFC_LSUO2Min_2_C DFES_EnvRef.DFC_LSUO2Min_3_C DFES_EnvRef.DFC_LSUSPIBattLowMin_0_C DFES_EnvRef.DFC_LSUSPIBattLowMin_1_C DFES_EnvRef.DFC_LSUSPIBattLowMin_2_C DFES_EnvRef.DFC_LSUSPIBattLowMin_3_C DFES_EnvRef.DFC_LSUSPISig_0_C DFES_EnvRef.DFC_LSUSPISig_1_C DFES_EnvRef.DFC_LSUSPISig_2_C DFES_EnvRef.DFC_LSUSPISig_3_C DFES_EnvRef.DFC_LSUtExcMax_0_C DFES_EnvRef.DFC_LSUtExcMax_1_C DFES_EnvRef.DFC_LSUtExcMax_2_C DFES_EnvRef.DFC_LSUtExcMax_3_C DFES_EnvRef.DFC_LSUtExcMin_0_C DFES_EnvRef.DFC_LSUtExcMin_1_C DFES_EnvRef.DFC_LSUtExcMin_2_C DFES_EnvRef.DFC_LSUtExcMin_3_C DFES_EnvRef.DFC_MILOL_C DFES_EnvRef.DFC_MILSCB_C DFES_EnvRef.DFC_MILSCG_C DFES_EnvRef.DFC_MeUnSCG_C DFES_EnvRef.DFC_NplHsChngPPFltDiff_C DFES_EnvRef.DFC_NplPAirFltDs_C DFES_EnvRef.DFC_NplTPFltUs_C DFES_EnvRef.DFC_OilComErr_C DFES_EnvRef.DFC_OilPLmpOL_C DFES_EnvRef.DFC_OilPLmpSCB_C DFES_EnvRef.DFC_OilPLmpSCG_C DFES_EnvRef.DFC_OilPNpl_C DFES_EnvRef.DFC_OilTNpl_C DFES_EnvRef.DFC_OilTSRCMax_C DFES_EnvRef.DFC_OilTSRCMin_C DFES_EnvRef.DFC_PCACDsEnvPPls_C DFES_EnvRef.DFC_PCACDsSRCMax_C DFES_EnvRef.DFC_PCACDsSRCMin_C DFES_EnvRef.DFC_PCVSCG_C DFES_EnvRef.DFC_PFltCharPDiffMin_C DFES_EnvRef.DFC_PFltDstrMin_C DFES_EnvRef.DFC_PFltEngPrt_C DFES_EnvRef.DFC_PFltLmpOL_C DFES_EnvRef.DFC_PFltLmpSCB_C DFES_EnvRef.DFC_PFltLmpSCG_C DFES_EnvRef.DFC_PFltRgnPerm_C DFES_EnvRef.DFC_PFltSRCMaxFlwRstn_C DFES_EnvRef.DFC_PFltSRCMinFlwRstn_C DFES_EnvRef.DFC_PFltSotMsDvtMax_C DFES_EnvRef.DFC_PFltSotMsDvtMin_C DFES_EnvRef.DFC_PFltSotMsMax_C DFES_EnvRef.DFC_PSPOL_C DFES_EnvRef.DFC_PSPSCB_C DFES_EnvRef.DFC_PSPSCG_C DFES_EnvRef.DFC_SRCHighAPP1_C DFES_EnvRef.DFC_SRCHighAPP2_C DFES_EnvRef.DFC_SRCLowAPP1_C DFES_EnvRef.DFC_SRCLowAPP2_C DFES_EnvRef.DFC_SRCMaxPAirFltDs_C DFES_EnvRef.DFC_SRCMaxPPFltUs_C DFES_EnvRef.DFC_SRCMaxTECU_C DFES_EnvRef.DFC_SRCMaxTOxiCatUs_C DFES_EnvRef.DFC_SRCMaxTPFltUs_C DFES_EnvRef.DFC_SRCMinPAirFltDs_C DFES_EnvRef.DFC_SRCMinPPFltUs_C DFES_EnvRef.DFC_SRCMinTECU_C DFES_EnvRef.DFC_SRCMinTOxiCatUs_C DFES_EnvRef.DFC_SRCMinTPFltUs_C DFES_EnvRef.DFC_SVSOL_C DFES_EnvRef.DFC_SVSSCB_C DFES_EnvRef.DFC_SVSSCG_C DFES_EnvRef.DFC_StrtOL_C DFES_EnvRef.DFC_StrtSCB_C DFES_EnvRef.DFC_StrtSCG_C DFES_EnvRef.DFC_SyncAPP_C DFES_EnvRef.DFC_T15Npl_C DFES_EnvRef.DFC_TAFSDtyCycHi_C DFES_EnvRef.DFC_TAFSDtyCycLo_C DFES_EnvRef.DFC_TAFSPerHi_C DFES_EnvRef.DFC_TAFSPerLo_C DFES_EnvRef.DFC_TCACDsSRCMax_C DFES_EnvRef.DFC_TCACDsSRCMin_C DFES_EnvRef.DFC_ThrVlvOL_C DFES_EnvRef.DFC_ThrVlvSCB_C DFES_EnvRef.DFC_ThrVlvSRCMax_C DFES_EnvRef.DFC_ThrVlvSRCMin_C DFES_EnvRef.DFC_TrbChLPOL_C DFES_EnvRef.DFC_TrbChLPSCB_C DFES_EnvRef.DFC_TrbChLPSCG_C DFES_EnvRef.DFC_TrbChOL_C DFES_EnvRef.DFC_TrbChSCB_C DFES_EnvRef.DFC_VSwVlvGovDvtMax_C DFES_EnvRef.DFC_VSwVlvGovDvtMin_C DFES_EnvRef.DFC_VSwVlvOL_C DFES_EnvRef.DFC_VSwVlvSCB_C DFES_EnvRef.DFC_VSwVlvSCG_C DFES_EnvRef.DFC_VSwVlvSRCMax_C DFES_EnvRef.DFC_VSwVlvSRCMin_C DFES_EnvRef.DFC_VehVHW_C DFES_EnvRef.DFC_VehVMax_C DFES_EnvRef.DFC_VehVPlaus_C DFES_EnvRef.DFC_VehVSig_C DFES_EnvRef.DFC_WaHtElOL_C DFES_EnvRef.DFC_WaHtElSCB_C DFES_EnvRef.DFC_ClthNpl_C DFES_EnvRef.DFC_ETClbETMax_0_C DFES_EnvRef.DFC_ETClbETMax_1_C DFES_EnvRef.DFC_ETClbETMax_2_C DFES_EnvRef.DFC_ETClbETMax_3_C DFES_EnvRef.DFC_ETClbETMax_4_C DFES_EnvRef.DFC_ETClbETMax_5_C DFES_EnvRef.DFC_ETClbETMin_0_C DFES_EnvRef.DFC_ETClbETMin_1_C DFES_EnvRef.DFC_ETClbETMin_2_C DFES_EnvRef.DFC_ETClbETMin_3_C DFES_EnvRef.DFC_ETClbETMin_4_C DFES_EnvRef.DFC_ETClbETMin_5_C DFES_EnvRef.DFC_IVDiaBnkShCirBSH_0_C DFES_EnvRef.DFC_IVDiaBnkShCirBSH_1_C DFES_EnvRef.DFC_IVDiaBnkShCirChSwt_0_C DFES_EnvRef.DFC_IVDiaBnkShCirChSwt_1_C DFES_EnvRef.DFC_IVDiaBnkShCirHSBatt_0_C DFES_EnvRef.DFC_IVDiaBnkShCirHSBatt_1_C DFES_EnvRef.DFC_IVDiaBnkShCirHiRstnc_0_C DFES_EnvRef.DFC_IVDiaBnkShCirHiRstnc_1_C DFES_EnvRef.DFC_IVDiaBnkShCirLSHSGnd_0_C DFES_EnvRef.DFC_IVDiaBnkShCirLSHSGnd_1_C DFES_EnvRef.DFC_IVDiaBnkShCirTransfer_0_C DFES_EnvRef.DFC_IVDiaBnkShCirTransfer_1_C DFES_EnvRef.DFC_IVDiaCylNoCls_0_C DFES_EnvRef.DFC_IVDiaCylNoCls_1_C DFES_EnvRef.DFC_IVDiaCylNoCls_2_C DFES_EnvRef.DFC_IVDiaCylNoCls_3_C DFES_EnvRef.DFC_IVDiaCylNoCls_4_C DFES_EnvRef.DFC_IVDiaCylNoCls_5_C DFES_EnvRef.DFC_IVDiaCylNoLd_0_C DFES_EnvRef.DFC_IVDiaCylNoLd_1_C DFES_EnvRef.DFC_IVDiaCylNoLd_2_C DFES_EnvRef.DFC_IVDiaCylNoLd_3_C DFES_EnvRef.DFC_IVDiaCylNoLd_4_C DFES_EnvRef.DFC_IVDiaCylNoLd_5_C DFES_EnvRef.DFC_IVDiaCylShCirHiRstnc_0_C DFES_EnvRef.DFC_IVDiaCylShCirHiRstnc_1_C DFES_EnvRef.DFC_IVDiaCylShCirHiRstnc_2_C DFES_EnvRef.DFC_IVDiaCylShCirHiRstnc_3_C DFES_EnvRef.DFC_IVDiaCylShCirHiRstnc_4_C DFES_EnvRef.DFC_IVDiaCylShCirHiRstnc_5_C DFES_EnvRef.DFC_IVDiaCylShCirLSBatt_0_C DFES_EnvRef.DFC_IVDiaCylShCirLSBatt_1_C DFES_EnvRef.DFC_IVDiaCylShCirLSBatt_2_C DFES_EnvRef.DFC_IVDiaCylShCirLSBatt_3_C DFES_EnvRef.DFC_IVDiaCylShCirLSBatt_4_C DFES_EnvRef.DFC_IVDiaCylShCirLSBatt_5_C DFES_EnvRef.DFC_IVDiaCylShCirLSHS_0_C DFES_EnvRef.DFC_IVDiaCylShCirLSHS_1_C DFES_EnvRef.DFC_IVDiaCylShCirLSHS_2_C DFES_EnvRef.DFC_IVDiaCylShCirLSHS_3_C DFES_EnvRef.DFC_IVDiaCylShCirLSHS_4_C DFES_EnvRef.DFC_IVDiaCylShCirLSHS_5_C DFES_EnvRef.DFC_IVDiaCylShCirLsLs_0_C DFES_EnvRef.DFC_IVDiaCylShCirLsLs_1_C DFES_EnvRef.DFC_IVDiaCylShCirLsLs_2_C DFES_EnvRef.DFC_IVDiaCylShCirLsLs_3_C DFES_EnvRef.DFC_IVDiaCylShCirLsLs_4_C DFES_EnvRef.DFC_IVDiaCylShCirLsLs_5_C DFES_EnvRef.DFC_IVDiaSPICfg_C DFES_EnvRef.DFC_IVDiaSPIColl_C DFES_EnvRef.DFC_IVDiaSPICtrl_C DFES_EnvRef.DFC_IVDiaSPIRam_C DFES_EnvRef.DFC_IVDiaSPITrans_C DFES_EnvRef.DFC_LSUCmpChk_0_C DFES_EnvRef.DFC_LSUCmpChk_1_C DFES_EnvRef.DFC_LSUCmpChk_2_C DFES_EnvRef.DFC_LSUCmpChk_3_C DFES_EnvRef.DFC_LSUCmpChk_4_C DFES_EnvRef.DFC_LSUCmpChk_5_C DFES_EnvRef.DFC_LSUDynChk_0_C DFES_EnvRef.DFC_LSUDynChk_1_C DFES_EnvRef.DFC_LSUDynChk_2_C DFES_EnvRef.DFC_LSUDynChk_3_C DFES_EnvRef.DFC_LSUO2ClbMax_0_C DFES_EnvRef.DFC_LSUO2ClbMax_1_C DFES_EnvRef.DFC_LSUO2ClbMax_2_C DFES_EnvRef.DFC_LSUO2ClbMax_3_C DFES_EnvRef.DFC_LSUO2ClbMin_0_C DFES_EnvRef.DFC_LSUO2ClbMin_1_C DFES_EnvRef.DFC_LSUO2ClbMin_2_C DFES_EnvRef.DFC_LSUO2ClbMin_3_C DFES_EnvRef.DFC_LSUO2PlausMax_0_C DFES_EnvRef.DFC_LSUO2PlausMax_1_C DFES_EnvRef.DFC_LSUO2PlausMax_2_C DFES_EnvRef.DFC_LSUO2PlausMax_3_C DFES_EnvRef.DFC_LSUO2PlausMin_0_C DFES_EnvRef.DFC_LSUO2PlausMin_1_C DFES_EnvRef.DFC_LSUO2PlausMin_2_C DFES_EnvRef.DFC_LSUO2PlausMin_3_C DFES_EnvRef.DFC_LSURiClbMax_0_C DFES_EnvRef.DFC_LSURiClbMax_1_C DFES_EnvRef.DFC_LSURiClbMax_2_C DFES_EnvRef.DFC_LSURiClbMax_3_C DFES_EnvRef.DFC_LSURiClbMin_0_C DFES_EnvRef.DFC_LSURiClbMin_1_C DFES_EnvRef.DFC_LSURiClbMin_2_C DFES_EnvRef.DFC_LSURiClbMin_3_C DFES_EnvRef.DFC_LSUWireIPSig_0_C DFES_EnvRef.DFC_LSUWireIPSig_1_C DFES_EnvRef.DFC_LSUWireIPSig_2_C DFES_EnvRef.DFC_LSUWireIPSig_3_C DFES_EnvRef.DFC_AFSDrftIdlAdjVal_C DFES_EnvRef.DFC_AFSDrftLdAdjVal_C DFES_EnvRef.DFC_AdcI_ADC0_Cal_C DFES_EnvRef.DFC_AdcI_ADC0_Conv_C DFES_EnvRef.DFC_CmbChbMisfireMax_0_C DFES_EnvRef.DFC_CmbChbMisfireMax_1_C DFES_EnvRef.DFC_CmbChbMisfireMax_2_C DFES_EnvRef.DFC_CmbChbMisfireMax_3_C DFES_EnvRef.DFC_CmbChbMisfireMax_4_C DFES_EnvRef.DFC_CmbChbMisfireMax_5_C DFES_EnvRef.DFC_CmbChbMisfireMul_C DFES_EnvRef.DFC_INJVLVBUSY_C DFES_EnvRef.DFC_IVAdjIVA_0_C DFES_EnvRef.DFC_IVAdjIVA_1_C DFES_EnvRef.DFC_IVAdjIVA_2_C DFES_EnvRef.DFC_IVAdjIVA_3_C DFES_EnvRef.DFC_IVAdjIVA_4_C DFES_EnvRef.DFC_IVAdjIVA_5_C DFES_EnvRef.DFC_InjCtlAdjQntEEPCS_C DFES_EnvRef.DFC_InjCtlDriftEEPCS_C DFES_EnvRef.DFC_MRlyErlyOpng_C DFES_EnvRef.DFC_MRlyStk_C DFES_EnvRef.DFC_SensFrzPPFltUs_C DFES_EnvRef.DFC_T15Sig_C DFES_EnvRef.DFC_AirCtlRmpTOut_C DFES_EnvRef.DFC_CEngDsTDynTst_C DFES_EnvRef.DFC_EGRVlvJamVlvClsd_C DFES_EnvRef.DFC_EGRVlvJamVlvOpn_C DFES_EnvRef.DFC_EGRVlvLgTDrft_C DFES_EnvRef.DFC_EGRVlvOfsLrnJamVlv_C DFES_EnvRef.DFC_EGRVlvShTDrft_C DFES_EnvRef.DFC_EGTRgnOilDilMax_C DFES_EnvRef.DFC_EngICO_C DFES_EnvRef.DFC_EpmCaSI1ErrSig_C DFES_EnvRef.DFC_EpmCaSI1NoSig_C DFES_EnvRef.DFC_EpmCaSI1OfsErr_C DFES_EnvRef.DFC_EpmCrSErrSig_C DFES_EnvRef.DFC_EpmCrSNoSig_C DFES_EnvRef.DFC_MoCADCCmp_C DFES_EnvRef.DFC_MoCADCTst_C DFES_EnvRef.DFC_MoCADCVltgRatio_C DFES_EnvRef.DFC_MoCSOPLoLi_C DFES_EnvRef.DFC_MoCSOPMM_C DFES_EnvRef.DFC_MoCSOPTimeOut_C DFES_EnvRef.DFC_MoCSOPUpLi_C DFES_EnvRef.DFC_MoFAPP_C DFES_EnvRef.DFC_MoFESpd_C DFES_EnvRef.DFC_MoFInjDatPhi_C DFES_EnvRef.DFC_MoFInjDatQnt_C DFES_EnvRef.DFC_MoFInjQnt_C DFES_EnvRef.DFC_MoFOvR_C DFES_EnvRef.DFC_MoFQntCor_C DFES_EnvRef.DFC_MoFTrqCmp_C DFES_EnvRef.DFC_NplTOxiCatUs_C DFES_EnvRef.DFC_PhyModNonMonMapNpl_C DFES_EnvRef.DFC_RailPOfsTstMax_C DFES_EnvRef.DFC_RailPOfsTstMin_C DFES_EnvRef.DFC_SWReset_0_C DFES_EnvRef.DFC_SWReset_1_C DFES_EnvRef.DFC_SWReset_2_C DFES_EnvRef.DFC_VSwVlvJamVlv_C DFES_EnvRef.DFC_VSwVlvLgTDrft_C DFES_EnvRef.DFC_VSwVlvOfsLrnJamVlv_C DFES_EnvRef.DFC_VSwVlvShTDrft_C /end DEF_CHARACTERISTIC
/end FUNCTION
/begin FUNCTION DFES_Mon "" /begin DEF_CHARACTERISTIC DFES_MonEvtMSK0_C DFES_MonEvtMSK1_C DFES_MonRepeat_C /end DEF_CHARACTERISTIC /begin OUT_MEASUREMENT DFES_MonEvnt DFES_MonObjt DFES_MonParm DFES_MonPtr /end OUT_MEASUREMENT /end FUNCTION
/begin COMPU_METHOD DFES_EnvTabVerb "" TAB_VERB "%2.1" "-" COMPU_TAB_REF DFES_EnvTabVerb /end COMPU_METHOD
/begin COMPU_VTAB DFES_EnvTabVerb "" TAB_VERB 110 0 "xSet1" 1 "xSet2" 2 "xSet3" 3 "xSet4" 4 "xSet5" 5 "xSet6" 6 "xSet7" 7 "xSet8" 8 "xSet9" 9 "xSet10" 10 "xSet11" 11 "xSet12" 12 "xSet13" 13 "xSet14" 14 "xSet15" 15 "xSet16" 16 "xSet17" 17 "xSet18" 18 "xSet19" 19 "xSet20" 20 "xSet21" 21 "xSet22" 22 "xSet23" 23 "xSet24" 24 "xSet25" 25 "xSet26" 26 "xSet27" 27 "xSet28" 28 "xSet29" 29 "xSet30" 30 "xSet31" 31 "xSet32" 32 "xSet33" 33 "xSet34" 34 "xSet35" 35 "xSet36" 36 "xSet37" 37 "xSet38" 38 "xSet39" 39 "xSet40" 40 "xSet41" 41 "xSet42" 42 "xSet43" 43 "xSet44" 44 "xSet45" 45 "xSet46" 46 "xSet47" 47 "xSet48" 48 "xSet49" 49 "xSet50" 50 "xSet51" 51 "xSet52" 52 "xSet53" 53 "xSet54" 54 "xSet55" 55 "xSet56" 56 "xSet57" 57 "xSet58" 58 "xSet59" 59 "xSet60" 60 "xSet61" 61 "xSet62" 62 "xSet63" 63 "xSet64" 64 "xSet65" 65 "xSet66" 66 "xSet67" 67 "xSet68" 68 "xSet69" 69 "xSet70" 70 "xSet71" 71 "xSet72" 72 "xSet73" 73 "xSet74" 74 "xSet75" 75 "xSet76" 76 "xSet77" 77 "xSet78" 78 "xSet79" 79 "xSet80" 80 "xSet81" 81 "xSet82" 82 "xSet83" 83 "xSet84" 84 "xSet85" 85 "xSet86" 86 "xSet87" 87 "xSet88" 88 "xSet89" 89 "xSet90" 90 "xSet91" 91 "xSet92" 92 "xSet93" 93 "xSet94" 94 "xSet95" 95 "xSet96" 96 "xSet97" 97 "xSet98" 98 "xSet99" 99 "xSet100" 100 "xSet101" 101 "xSet102" 102 "xSet103" 103 "xSet104" 104 "xSet105" 105 "xSet106" 106 "xSet107" 107 "xSet108" 108 "xSet109" 109 "xSet110" DEFAULT_VALUE "---" /end COMPU_VTAB
/begin COMPU_METHOD DFES_Mon_Verb "" TAB_VERB "%6.3" "-" COMPU_TAB_REF DFES_Mon_Verb /end COMPU_METHOD
/begin COMPU_VTAB DFES_Mon_Verb "" TAB_VERB 30 0 "-----" 4097 "entry_rejected" 4098 "entry_preempted" 4099 "replaced_entry" 4100 "remaining_entry" 4112 "del_mismatch" 8193 "double entry" 8194 "no hash entry" 8195 "invalid hash" 8196 "missing hash entry" 8197 "ok no tst - inkonsist" 8198 "def no tst - inkonsist" 8199 "ok tsted - inkonsist" 8200 "def tsted - inkonsist" 8201 "Counter exceeds" 8202 "DEL Counter Serv ex" 8203 "DEL Counter Pend ex" 8204 "DEL Counter OBD ex" 8205 "MEM missing" 8206 "Hash 2 empty line" 8209 "MEM no Hash" 8210 "Deb ok missing" 8211 "Deb def missing" 8212 "retry entry" 8225 "Hash link exceeds" 8226 "min hash line" 8227 "MIS MOD hashkey" 8228 "insert line 2 hash" 16385 "pot_sus_ffr" 16386 "used_sus_ffr" /end COMPU_VTAB
/begin COMPU_METHOD DFES_OneToOne "" RAT_FUNC "%6.2" "-" COEFFS 0 1 0 0 0 1 /end COMPU_METHOD
/begin COMPU_METHOD OneToOne "" RAT_FUNC "%6.2" "-" COEFFS 0 1 0 0 0 1 /end COMPU_METHOD
/begin RECORD_LAYOUT Val_Wu16 FNC_VALUES 1 UWORD COLUMN_DIR DIRECT /end RECORD_LAYOUT
/begin RECORD_LAYOUT Val_Wu8 FNC_VALUES 1 UBYTE COLUMN_DIR DIRECT /end RECORD_LAYOUT
/end MODULE
/end PROJECT
