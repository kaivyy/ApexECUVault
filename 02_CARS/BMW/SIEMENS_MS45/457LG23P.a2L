ASAP2_VERSION 1 31
/begin PROJECT MS45 "BMW Motorsteuerung R6"
/begin HEADER "_default_HeaderComment" PROJECT_NO _57 /end HEADER
/begin MODULE _default_ModuleName "_default_ModuleLongIdentifier"
/begin MOD_COMMON "_default_ModCommonComment" DEPOSIT ABSOLUTE BYTE_ORDER MSB_FIRST ALIGNMENT_BYTE 1 ALIGNMENT_WORD 2 ALIGNMENT_LONG 4 ALIGNMENT_FLOAT32_IEEE 4 ALIGNMENT_FLOAT64_IEEE 8 /end MOD_COMMON
/begin CHARACTERISTIC c_det_max_dmtlh "Maximum value of the anti - bounce counter" VALUE 0xffe406ff _REC_VAL_20_u1 254. _CNV_A_R_LINEAR_____0_CM 1. 255. DISPLAY_IDENTIFIER C_DET_MAX_DMTLH FORMAT "%3.0" /end CHARACTERISTIC
/begin CHARACTERISTIC c_det_inc_dmtlh "Anti - bounce counter increment" VALUE 0xffe406ec _REC_VAL_20_u1 255. _CNV_A_R_LINEAR_____0_CM 0. 255. DISPLAY_IDENTIFIER C_DET_INC_DMTLH FORMAT "%3.0" /end CHARACTERISTIC
/begin CHARACTERISTIC c_det_inc_dmtl_pump "Anti - bounce counter increment" VALUE 0xffe406eb _REC_VAL_20_u1 255. _CNV_A_R_LINEAR_____0_CM 0. 255. DISPLAY_IDENTIFIER C_DET_INC_DMTL_PUMP FORMAT "%3.0" /end CHARACTERISTIC
/begin CHARACTERISTIC c_det_max_dmtl_pump "Debounce counter maximum value" VALUE 0xffe406fe _REC_VAL_20_u1 254. _CNV_A_R_LINEAR_____0_CM 1. 255. DISPLAY_IDENTIFIER C_DET_MAX_DMTL_PUMP FORMAT "%3.0" /end CHARACTERISTIC
/begin CHARACTERISTIC c_det_inc_dmtls "Anti - bounce counter increment" VALUE 0xffe406ed _REC_VAL_20_u1 255. _CNV_A_R_LINEAR_____0_CM 0. 255. DISPLAY_IDENTIFIER C_DET_INC_DMTLS FORMAT "%3.0" /end CHARACTERISTIC
/begin CHARACTERISTIC c_det_max_dmtls "Debounce counter maximum value" VALUE 0xffe40700 _REC_VAL_20_u1 254. _CNV_A_R_LINEAR_____0_CM 1. 255. DISPLAY_IDENTIFIER C_DET_MAX_DMTLS FORMAT "%3.0" /end CHARACTERISTIC
/begin CHARACTERISTIC c_det_inc_rly_accout "Debounce counter increment- RLY_ACCOUT diagnosis" VALUE 0xffe406f7 _REC_VAL_20_u1 255. _CNV_A_R_LINEAR_____0_CM 0. 255. DISPLAY_IDENTIFIER C_DET_INC_RLY_ACCOUT FORMAT "%3.0" /end CHARACTERISTIC
/begin CHARACTERISTIC c_det_max_rly_accout "Debounce counter maximum value - RLY_ACCOUT diagnosis" VALUE 0xffe4070a _REC_VAL_20_u1 254. _CNV_A_R_LINEAR_____0_CM 1. 255. DISPLAY_IDENTIFIER C_DET_MAX_RLY_ACCOUT FORMAT "%3.0" /end CHARACTERISTIC
/begin CHARACTERISTIC c_det_max_ebox_cfa "Debounce counter maximum value" VALUE 0xffe40701 _REC_VAL_20_u1 254. _CNV_A_R_LINEAR_____0_CM 1. 255. DISPLAY_IDENTIFIER C_DET_MAX_EBOX_CFA FORMAT "%3.0" /end CHARACTERISTIC
/begin CHARACTERISTIC c_det_inc_ebox_cfa "Debounce counter increment" VALUE 0xffe406ee _REC_VAL_20_u1 255. _CNV_A_R_LINEAR_____0_CM 0. 255. DISPLAY_IDENTIFIER C_DET_INC_EBOX_CFA FORMAT "%3.0" /end CHARACTERISTIC
/begin CHARACTERISTIC c_det_max_ef "Debounce counter maximum value" VALUE 0xffe40705 _REC_VAL_20_u1 254. _CNV_A_R_LINEAR_____0_CM 1. 255. DISPLAY_IDENTIFIER C_DET_MAX_EF FORMAT "%3.0" /end CHARACTERISTIC
/begin CHARACTERISTIC c_det_inc_ef "Debounce counter increment" VALUE 0xffe406f2 _REC_VAL_20_u1 255. _CNV_A_R_LINEAR_____0_CM 0. 255. DISPLAY_IDENTIFIER C_DET_INC_EF FORMAT "%3.0" /end CHARACTERISTIC
/begin CHARACTERISTIC c_det_inc_ecras "Anti - bounce counter increment ECRAS diagnosis" VALUE 0xffe406f0 _REC_VAL_20_u1 255. _CNV_A_R_LINEAR_____0_CM 0. 255. DISPLAY_IDENTIFIER C_DET_INC_ECRAS FORMAT "%3.0" /end CHARACTERISTIC
/begin CHARACTERISTIC c_det_max_ecras "Maximum value of the anti - bounce counter ECRAS diagnosis" VALUE 0xffe40703 _REC_VAL_20_u1 254. _CNV_A_R_LINEAR_____0_CM 1. 255. DISPLAY_IDENTIFIER C_DET_MAX_ECRAS FORMAT "%3.0" /end CHARACTERISTIC
/begin CHARACTERISTIC c_det_inc_sav "Debounce counter increment- SAV diagnosis" VALUE 0xffe406fa _REC_VAL_20_u1 255. _CNV_A_R_LINEAR_____0_CM 0. 255. DISPLAY_IDENTIFIER C_DET_INC_SAV FORMAT "%3.0" /end CHARACTERISTIC
/begin CHARACTERISTIC c_det_max_sav "Debounce counter maximum value - SAV diagnosis" VALUE 0xffe4070d _REC_VAL_20_u1 254. _CNV_A_R_LINEAR_____0_CM 1. 255. DISPLAY_IDENTIFIER C_DET_MAX_SAV FORMAT "%3.0" /end CHARACTERISTIC
/begin CHARACTERISTIC c_det_max_vim "Maximum value of anti - Debounce counter increment for VIM driver diagnosis" VALUE 0xffe4070f _REC_VAL_20_u1 254. _CNV_A_R_LINEAR_____0_CM 1. 255. DISPLAY_IDENTIFIER C_DET_MAX_VIM FORMAT "%3.0" /end CHARACTERISTIC
/begin CHARACTERISTIC c_det_inc_vim "Anti - Debounce counter increment for VIM driver diagnosis" VALUE 0xffe406fc _REC_VAL_20_u1 255. _CNV_A_R_LINEAR_____0_CM 0. 255. DISPLAY_IDENTIFIER C_DET_INC_VIM FORMAT "%3.0" /end CHARACTERISTIC
/begin CHARACTERISTIC c_det_inc_rly_st "anti-bounce increment value" VALUE 0xffe406f8 _REC_VAL_20_u1 255. _CNV_A_R_LINEAR_____0_CM 0. 255. DISPLAY_IDENTIFIER C_DET_INC_RLY_ST FORMAT "%3.0" /end CHARACTERISTIC
/begin CHARACTERISTIC c_det_max_rly_st "anti-bounce maximum value" VALUE 0xffe4070b _REC_VAL_20_u1 254. _CNV_A_R_LINEAR_____0_CM 1. 255. DISPLAY_IDENTIFIER C_DET_MAX_RLY_ST FORMAT "%3.0" /end CHARACTERISTIC
/begin CHARACTERISTIC c_det_inc_lsh_down "Anti-bounce increment value for lsh down" VALUE 0xffe406f5 _REC_VAL_20_u1 255. _CNV_A_R_LINEAR_____0_CM 0. 255. DISPLAY_IDENTIFIER C_DET_INC_LSH_DOWN FORMAT "%3.0" /end CHARACTERISTIC
/begin CHARACTERISTIC c_det_max_lsh_down "Anti-bounce maximum value for lsh down" VALUE 0xffe40708 _REC_VAL_20_u1 254. _CNV_A_R_LINEAR_____0_CM 1. 255. DISPLAY_IDENTIFIER C_DET_MAX_LSH_DOWN FORMAT "%3.0" /end CHARACTERISTIC
/begin CHARACTERISTIC c_det_max_lsh_up "Anti-bounce increment value for LSH_UP" VALUE 0xffe40709 _REC_VAL_20_u1 254. _CNV_A_R_LINEAR_____0_CM 1. 255. DISPLAY_IDENTIFIER C_DET_MAX_LSH_UP FORMAT "%3.0" /end CHARACTERISTIC
/begin CHARACTERISTIC c_det_inc_lsh_up "Anti-bounce maximum value for LSH_UP" VALUE 0xffe406f6 _REC_VAL_20_u1 255. _CNV_A_R_LINEAR_____0_CM 0. 255. DISPLAY_IDENTIFIER C_DET_INC_LSH_UP FORMAT "%3.0" /end CHARACTERISTIC
/begin CHARACTERISTIC c_det_max_isa_1 "Anti-bounce increment value for ISA_1" VALUE 0xffe40706 _REC_VAL_20_u1 254. _CNV_A_R_LINEAR_____0_CM 1. 255. DISPLAY_IDENTIFIER C_DET_MAX_ISA_1 FORMAT "%3.0" /end CHARACTERISTIC
/begin CHARACTERISTIC c_det_max_isa_2 "Anti-bounce increment value for ISA_2" VALUE 0xffe40707 _REC_VAL_20_u1 254. _CNV_A_R_LINEAR_____0_CM 1. 255. DISPLAY_IDENTIFIER C_DET_MAX_ISA_2 FORMAT "%3.0" /end CHARACTERISTIC
/begin CHARACTERISTIC c_det_inc_isa_1 "Anti-bounce maximum value for ISA_1" VALUE 0xffe406f3 _REC_VAL_20_u1 255. _CNV_A_R_LINEAR_____0_CM 0. 255. DISPLAY_IDENTIFIER C_DET_INC_ISA_1 FORMAT "%3.0" /end CHARACTERISTIC
/begin CHARACTERISTIC c_det_inc_isa_2 "Anti-bounce maximum value for ISA_2" VALUE 0xffe406f4 _REC_VAL_20_u1 255. _CNV_A_R_LINEAR_____0_CM 0. 255. DISPLAY_IDENTIFIER C_DET_INC_ISA_2 FORMAT "%3.0" /end CHARACTERISTIC
/begin CHARACTERISTIC c_det_max_slv_ivvt "Debounce counter maximum value - VANOS diagnosis magnetic valves" VALUE 0xffe4070e _REC_VAL_20_u1 254. _CNV_A_R_LINEAR_____0_CM 1. 255. DISPLAY_IDENTIFIER C_DET_MAX_SLV_IVVT FORMAT "%3.0" /end CHARACTERISTIC
/begin CHARACTERISTIC c_det_inc_slv_ivvt "Debounce counter increment - VANOS diagnosis magnetic valve CAM_IN" VALUE 0xffe406fb _REC_VAL_20_u1 255. _CNV_A_R_LINEAR_____0_CM 0. 255. DISPLAY_IDENTIFIER C_DET_INC_SLV_IVVT FORMAT "%3.0" /end CHARACTERISTIC
/begin CHARACTERISTIC c_det_inc_sap "Debounce counter increment- SAP diagnosis" VALUE 0xffe406f9 _REC_VAL_20_u1 255. _CNV_A_R_LINEAR_____0_CM 0. 255. DISPLAY_IDENTIFIER C_DET_INC_SAP FORMAT "%3.0" /end CHARACTERISTIC
/begin CHARACTERISTIC c_det_max_sap "Debounce counter maximum value - SAP diagnosis" VALUE 0xffe4070c _REC_VAL_20_u1 254. _CNV_A_R_LINEAR_____0_CM 1. 255. DISPLAY_IDENTIFIER C_DET_MAX_SAP FORMAT "%3.0" /end CHARACTERISTIC
/begin CHARACTERISTIC c_abc_inc_rly_efp "Debounce counter increment RLY_EFP" VALUE 0xffe4058e _REC_VAL_20_u1 255. _CNV_A_R_LINEAR_____0_CM 0. 255. DISPLAY_IDENTIFIER C_ABC_INC_RLY_EFP FORMAT "%3.0" /end CHARACTERISTIC
/begin CHARACTERISTIC c_abc_max_rly_efp "Debounce counter maximum value RLY_EFP" VALUE 0xffe40600 _REC_VAL_20_u1 254. _CNV_A_R_LINEAR_____0_CM 1. 255. DISPLAY_IDENTIFIER C_ABC_MAX_RLY_EFP FORMAT "%3.0" /end CHARACTERISTIC
/begin CHARACTERISTIC c_det_max_cps "Debounce counter maximum value - CPS diagnosis" VALUE 0xffe406fd _REC_VAL_20_u1 254. _CNV_A_R_LINEAR_____0_CM 1. 255. DISPLAY_IDENTIFIER C_DET_MAX_CPS FORMAT "%3.0" /end CHARACTERISTIC
/begin CHARACTERISTIC c_det_inc_cps "Debounce counter increment - CPS diagnosis" VALUE 0xffe406ea _REC_VAL_20_u1 255. _CNV_A_R_LINEAR_____0_CM 0. 255. DISPLAY_IDENTIFIER C_DET_INC_CPS FORMAT "%3.0" /end CHARACTERISTIC
/begin CHARACTERISTIC c_det_max_ect_el "Debounce counter maximum value - Thermostat heating diagnosis" VALUE 0xffe40704 _REC_VAL_20_u1 254. _CNV_A_R_LINEAR_____0_CM 1. 255. DISPLAY_IDENTIFIER C_DET_MAX_ECT_EL FORMAT "%3.0" /end CHARACTERISTIC
/begin CHARACTERISTIC c_det_inc_ect_el "Debounce counter increment - Thermostat heating diagnosis" VALUE 0xffe406f1 _REC_VAL_20_u1 255. _CNV_A_R_LINEAR_____0_CM 0. 255. DISPLAY_IDENTIFIER C_DET_INC_ECT_EL FORMAT "%3.0" /end CHARACTERISTIC
/begin CHARACTERISTIC c_det_max_ecf "Debounce counter maximum value -  ECF diagnosis" VALUE 0xffe40702 _REC_VAL_20_u1 254. _CNV_A_R_LINEAR_____0_CM 1. 255. DISPLAY_IDENTIFIER C_DET_MAX_ECF FORMAT "%3.0" /end CHARACTERISTIC
/begin CHARACTERISTIC c_det_inc_ecf "Debounce counter increment - ECF diagnosis" VALUE 0xffe406ef _REC_VAL_20_u1 255. _CNV_A_R_LINEAR_____0_CM 0. 255. DISPLAY_IDENTIFIER C_DET_INC_ECF FORMAT "%3.0" /end CHARACTERISTIC
/begin CHARACTERISTIC c_abc_inc_iv "Debounce counter increment" VALUE 0xffe40576 _REC_VAL_20_u1 255. _CNV_A_R_LINEAR_____0_CM 0. 255. DISPLAY_IDENTIFIER C_ABC_INC_IV FORMAT "%3.0" /end CHARACTERISTIC
/begin CHARACTERISTIC c_abc_max_iv "Debounce counter maximum value" VALUE 0xffe405e9 _REC_VAL_20_u1 254. _CNV_A_R_LINEAR_____0_CM 1. 255. DISPLAY_IDENTIFIER C_ABC_MAX_IV FORMAT "%3.0" /end CHARACTERISTIC
/begin CHARACTERISTIC c_abc_inc_imob_2 "" VALUE 0xffe40574 _REC_VAL_20_u1 254. _CNV_A_R_LINEAR_____0_CM 1. 255. DISPLAY_IDENTIFIER C_ABC_INC_IMOB_2 FORMAT "%3.0" /end CHARACTERISTIC
/begin CHARACTERISTIC c_abc_inc_imob_1 "" VALUE 0xffe40573 _REC_VAL_20_u1 254. _CNV_A_R_LINEAR_____0_CM 1. 255. DISPLAY_IDENTIFIER C_ABC_INC_IMOB_1 FORMAT "%3.0" /end CHARACTERISTIC
/begin CHARACTERISTIC c_abc_max_imob_2 "" VALUE 0xffe405e7 _REC_VAL_20_u1 254. _CNV_A_R_LINEAR_____0_CM 1. 255. DISPLAY_IDENTIFIER C_ABC_MAX_IMOB_2 FORMAT "%3.0" /end CHARACTERISTIC
/begin CHARACTERISTIC c_abc_max_imob_1 "" VALUE 0xffe405e6 _REC_VAL_20_u1 254. _CNV_A_R_LINEAR_____0_CM 1. 255. DISPLAY_IDENTIFIER C_ABC_MAX_IMOB_1 FORMAT "%3.0" /end CHARACTERISTIC
/begin CHARACTERISTIC c_abc_inc_sof_inh_mon "Anti - bounce counter increment" VALUE 0xffe51f41 _REC_VAL_20_u1 255. _CNV_A_R_LINEAR_____0_CM 0. 255. DISPLAY_IDENTIFIER C_ABC_INC_SOF_INH_MON FORMAT "%3.0" /end CHARACTERISTIC
/begin CHARACTERISTIC c_abc_max_sof_inh_mon "Debounce counter maximum value" VALUE 0xffe51f56 _REC_VAL_20_u1 254. _CNV_A_R_LINEAR_____0_CM 1. 255. DISPLAY_IDENTIFIER C_ABC_MAX_SOF_INH_MON FORMAT "%3.0" /end CHARACTERISTIC
/begin CHARACTERISTIC c_abc_inc_amp "Anti - bounce counter increment" VALUE 0xffe40545 _REC_VAL_20_u1 255. _CNV_A_R_LINEAR_____0_CM 0. 255. DISPLAY_IDENTIFIER C_ABC_INC_AMP FORMAT "%3.0" /end CHARACTERISTIC
/begin CHARACTERISTIC c_abc_max_amp "Maximum value of the anti - bounce counter" VALUE 0xffe405bb _REC_VAL_20_u1 254. _CNV_A_R_LINEAR_____0_CM 1. 255. DISPLAY_IDENTIFIER C_ABC_MAX_AMP FORMAT "%3.0" /end CHARACTERISTIC
/begin CHARACTERISTIC c_abc_inc_im_bts_plaus "BTS debounce counter increment  " VALUE 0xffe40572 _REC_VAL_20_u1 255. _CNV_A_R_LINEAR_____0_CM 0. 255. DISPLAY_IDENTIFIER C_ABC_INC_IM_BTS_PLAUS FORMAT "%3.0" /end CHARACTERISTIC
/begin CHARACTERISTIC c_abc_inc_im_bls_plaus "BLS debounce counter increment  " VALUE 0xffe40571 _REC_VAL_20_u1 255. _CNV_A_R_LINEAR_____0_CM 0. 255. DISPLAY_IDENTIFIER C_ABC_INC_IM_BLS_PLAUS FORMAT "%3.0" /end CHARACTERISTIC
/begin CHARACTERISTIC c_abc_max_im_bts_plaus "BTS debounce counter maximum value, error debounce" VALUE 0xffe405e5 _REC_VAL_20_u1 254. _CNV_A_R_LINEAR_____0_CM 1. 255. DISPLAY_IDENTIFIER C_ABC_MAX_IM_BTS_PLAUS FORMAT "%3.0" /end CHARACTERISTIC
/begin CHARACTERISTIC c_abc_max_im_bls_plaus "BLS debounce counter maximum value" VALUE 0xffe405e4 _REC_VAL_20_u1 254. _CNV_A_R_LINEAR_____0_CM 1. 255. DISPLAY_IDENTIFIER C_ABC_MAX_IM_BLS_PLAUS FORMAT "%3.0" /end CHARACTERISTIC
/begin CHARACTERISTIC c_abc_inc_bn_tq_dcc "Anti - bounce counter increment BN2000 Diagnosis" VALUE 0xffe40557 _REC_VAL_20_u1 255. _CNV_A_R_LINEAR_____0_CM 0. 255. DISPLAY_IDENTIFIER C_ABC_INC_BN_TQ_DCC FORMAT "%3.0" /end CHARACTERISTIC
/begin CHARACTERISTIC c_abc_inc_bn_tq_tcs "Anti - bounce counter increment BN2000 Diagnosis" VALUE 0xffe4055a _REC_VAL_20_u1 255. _CNV_A_R_LINEAR_____0_CM 0. 255. DISPLAY_IDENTIFIER C_ABC_INC_BN_TQ_TCS FORMAT "%3.0" /end CHARACTERISTIC
/begin CHARACTERISTIC c_abc_inc_bn_vs_tcs "Anti - bounce counter increment BN2000 Diagnosis" VALUE 0xffe4055c _REC_VAL_20_u1 255. _CNV_A_R_LINEAR_____0_CM 0. 255. DISPLAY_IDENTIFIER C_ABC_INC_BN_VS_TCS FORMAT "%3.0" /end CHARACTERISTIC
/begin CHARACTERISTIC c_abc_inc_bn_tcs "Anti - bounce counter increment BN2000 Diagnosis" VALUE 0xffe40555 _REC_VAL_20_u1 255. _CNV_A_R_LINEAR_____0_CM 0. 255. DISPLAY_IDENTIFIER C_ABC_INC_BN_TCS FORMAT "%3.0" /end CHARACTERISTIC
/begin CHARACTERISTIC c_abc_inc_bn_tq_etcu "Anti - bounce counter increment BN2000 Diagnosis" VALUE 0xffe40558 _REC_VAL_20_u1 255. _CNV_A_R_LINEAR_____0_CM 0. 255. DISPLAY_IDENTIFIER C_ABC_INC_BN_TQ_ETCU FORMAT "%3.0" /end CHARACTERISTIC
/begin CHARACTERISTIC c_abc_inc_bn_cas "Anti - bounce counter increment BN2000 Diagnosis" VALUE 0xffe4054c _REC_VAL_20_u1 255. _CNV_A_R_LINEAR_____0_CM 0. 255. DISPLAY_IDENTIFIER C_ABC_INC_BN_CAS FORMAT "%3.0" /end CHARACTERISTIC
/begin CHARACTERISTIC c_abc_inc_bn_etcu "Anti - bounce counter increment BN2000 Diagnosis" VALUE 0xffe4054e _REC_VAL_20_u1 255. _CNV_A_R_LINEAR_____0_CM 0. 255. DISPLAY_IDENTIFIER C_ABC_INC_BN_ETCU FORMAT "%3.0" /end CHARACTERISTIC
/begin CHARACTERISTIC c_abc_inc_bn_tq_amt "Anti - bounce counter increment BN2000 Diagnosis" VALUE 0xffe40556 _REC_VAL_20_u1 255. _CNV_A_R_LINEAR_____0_CM 0. 255. DISPLAY_IDENTIFIER C_ABC_INC_BN_TQ_AMT FORMAT "%3.0" /end CHARACTERISTIC
/begin CHARACTERISTIC c_abc_inc_bn_acc "Anti - bounce counter increment BN2000 Diagnosis" VALUE 0xffe40549 _REC_VAL_20_u1 255. _CNV_A_R_LINEAR_____0_CM 0. 255. DISPLAY_IDENTIFIER C_ABC_INC_BN_ACC FORMAT "%3.0" /end CHARACTERISTIC
/begin CHARACTERISTIC c_abc_inc_bn_icl "Anti - bounce counter increment BN2000 Diagnosis" VALUE 0xffe4054f _REC_VAL_20_u1 255. _CNV_A_R_LINEAR_____0_CM 0. 255. DISPLAY_IDENTIFIER C_ABC_INC_BN_ICL FORMAT "%3.0" /end CHARACTERISTIC
/begin CHARACTERISTIC c_abc_inc_bn_km_icl "Anti - bounce counter increment BN2000 Diagnosis" VALUE 0xffe40550 _REC_VAL_20_u1 255. _CNV_A_R_LINEAR_____0_CM 0. 255. DISPLAY_IDENTIFIER C_ABC_INC_BN_KM_ICL FORMAT "%3.0" /end CHARACTERISTIC
/begin CHARACTERISTIC c_abc_inc_bn_veh_mod "Anti - bounce counter increment BN2000 Diagnosis" VALUE 0xffe4055b _REC_VAL_20_u1 255. _CNV_A_R_LINEAR_____0_CM 0. 255. DISPLAY_IDENTIFIER C_ABC_INC_BN_VEH_MOD FORMAT "%3.0" /end CHARACTERISTIC
/begin CHARACTERISTIC c_abc_inc_bn_t_icl "Anti - bounce counter increment BN2000 Diagnosis" VALUE 0xffe40554 _REC_VAL_20_u1 255. _CNV_A_R_LINEAR_____0_CM 0. 255. DISPLAY_IDENTIFIER C_ABC_INC_BN_T_ICL FORMAT "%3.0" /end CHARACTERISTIC
/begin CHARACTERISTIC c_abc_inc_bn_pow_vb "Anti - bounce counter increment BN2000 Diagnosis" VALUE 0xffe40553 _REC_VAL_20_u1 255. _CNV_A_R_LINEAR_____0_CM 0. 255. DISPLAY_IDENTIFIER C_ABC_INC_BN_POW_VB FORMAT "%3.0" /end CHARACTERISTIC
/begin CHARACTERISTIC c_abc_inc_bn_pow_gen "Anti - bounce counter increment BN2000 Diagnosis" VALUE 0xffe40552 _REC_VAL_20_u1 255. _CNV_A_R_LINEAR_____0_CM 0. 255. DISPLAY_IDENTIFIER C_ABC_INC_BN_POW_GEN FORMAT "%3.0" /end CHARACTERISTIC
/begin CHARACTERISTIC c_abc_inc_bn_msw "Anti - bounce counter increment BN2000 Diagnosis" VALUE 0xffe40551 _REC_VAL_20_u1 255. _CNV_A_R_LINEAR_____0_CM 0. 255. DISPLAY_IDENTIFIER C_ABC_INC_BN_MSW FORMAT "%3.0" /end CHARACTERISTIC
/begin CHARACTERISTIC c_abc_inc_bn_ang_pste "Anti - bounce counter increment BN2000 Diagnosis" VALUE 0xffe4054a _REC_VAL_20_u1 255. _CNV_A_R_LINEAR_____0_CM 0. 255. DISPLAY_IDENTIFIER C_ABC_INC_BN_ANG_PSTE FORMAT "%3.0" /end CHARACTERISTIC
/begin CHARACTERISTIC c_abc_max_bn_cas "Maximum value of the anti - bounce counter BN2000 diagnosis" VALUE 0xffe405c2 _REC_VAL_20_u1 254. _CNV_A_R_LINEAR_____0_CM 1. 255. DISPLAY_IDENTIFIER C_ABC_MAX_BN_CAS FORMAT "%3.0" /end CHARACTERISTIC
/begin CHARACTERISTIC c_abc_max_bn_tq_tcs "Maximum value of the anti - bounce counter BN2000 diagnosis" VALUE 0xffe405d0 _REC_VAL_20_u1 254. _CNV_A_R_LINEAR_____0_CM 1. 255. DISPLAY_IDENTIFIER C_ABC_MAX_BN_TQ_TCS FORMAT "%3.0" /end CHARACTERISTIC
/begin CHARACTERISTIC c_abc_max_bn_vs_tcs "Maximum value of the anti - bounce counter BN2000 diagnosis" VALUE 0xffe405d2 _REC_VAL_20_u1 254. _CNV_A_R_LINEAR_____0_CM 1. 255. DISPLAY_IDENTIFIER C_ABC_MAX_BN_VS_TCS FORMAT "%3.0" /end CHARACTERISTIC
/begin CHARACTERISTIC c_abc_max_bn_tcs "Maximum value of the anti - bounce counter BN2000 diagnosis" VALUE 0xffe405cb _REC_VAL_20_u1 254. _CNV_A_R_LINEAR_____0_CM 1. 255. DISPLAY_IDENTIFIER C_ABC_MAX_BN_TCS FORMAT "%3.0" /end CHARACTERISTIC
/begin CHARACTERISTIC c_abc_max_bn_tq_etcu "Maximum value of the anti - bounce counter BN2000 diagnosis" VALUE 0xffe405ce _REC_VAL_20_u1 254. _CNV_A_R_LINEAR_____0_CM 1. 255. DISPLAY_IDENTIFIER C_ABC_MAX_BN_TQ_ETCU FORMAT "%3.0" /end CHARACTERISTIC
/begin CHARACTERISTIC c_abc_max_bn_etcu "Maximum value of the anti - bounce counter BN2000 diagnosis" VALUE 0xffe405c4 _REC_VAL_20_u1 254. _CNV_A_R_LINEAR_____0_CM 1. 255. DISPLAY_IDENTIFIER C_ABC_MAX_BN_ETCU FORMAT "%3.0" /end CHARACTERISTIC
/begin CHARACTERISTIC c_abc_max_bn_tq_amt "Maximum value of the anti - bounce counter BN2000 diagnosis" VALUE 0xffe405cc _REC_VAL_20_u1 254. _CNV_A_R_LINEAR_____0_CM 1. 255. DISPLAY_IDENTIFIER C_ABC_MAX_BN_TQ_AMT FORMAT "%3.0" /end CHARACTERISTIC
/begin CHARACTERISTIC c_abc_max_bn_acc "Maximum value of the anti - bounce counter BN2000 diagnosis" VALUE 0xffe405bf _REC_VAL_20_u1 254. _CNV_A_R_LINEAR_____0_CM 1. 255. DISPLAY_IDENTIFIER C_ABC_MAX_BN_ACC FORMAT "%3.0" /end CHARACTERISTIC
/begin CHARACTERISTIC c_abc_max_bn_t_icl "Maximum value of the anti - bounce counter BN2000 diagnosis" VALUE 0xffe405ca _REC_VAL_20_u1 254. _CNV_A_R_LINEAR_____0_CM 1. 255. DISPLAY_IDENTIFIER C_ABC_MAX_BN_T_ICL FORMAT "%3.0" /end CHARACTERISTIC
/begin CHARACTERISTIC c_abc_max_bn_km_icl "Maximum value of the anti - bounce counter BN2000 diagnosis" VALUE 0xffe405c6 _REC_VAL_20_u1 254. _CNV_A_R_LINEAR_____0_CM 1. 255. DISPLAY_IDENTIFIER C_ABC_MAX_BN_KM_ICL FORMAT "%3.0" /end CHARACTERISTIC
/begin CHARACTERISTIC c_abc_max_bn_veh_mod "Maximum value of the anti - bounce counter BN2000 diagnosis" VALUE 0xffe405d1 _REC_VAL_20_u1 254. _CNV_A_R_LINEAR_____0_CM 1. 255. DISPLAY_IDENTIFIER C_ABC_MAX_BN_VEH_MOD FORMAT "%3.0" /end CHARACTERISTIC
/begin CHARACTERISTIC c_abc_max_bn_icl "Maximum value of the anti - bounce counter BN2000 diagnosis" VALUE 0xffe405c5 _REC_VAL_20_u1 254. _CNV_A_R_LINEAR_____0_CM 1. 255. DISPLAY_IDENTIFIER C_ABC_MAX_BN_ICL FORMAT "%3.0" /end CHARACTERISTIC
/begin CHARACTERISTIC c_abc_max_bn_pow_vb "Maximum value of the anti - bounce counter BN2000 diagnosis" VALUE 0xffe405c9 _REC_VAL_20_u1 254. _CNV_A_R_LINEAR_____0_CM 1. 255. DISPLAY_IDENTIFIER C_ABC_MAX_BN_POW_VB FORMAT "%3.0" /end CHARACTERISTIC
/begin CHARACTERISTIC c_abc_max_bn_pow_gen "Maximum value of the anti - bounce counter BN2000 diagnosis" VALUE 0xffe405c8 _REC_VAL_20_u1 254. _CNV_A_R_LINEAR_____0_CM 1. 255. DISPLAY_IDENTIFIER C_ABC_MAX_BN_POW_GEN FORMAT "%3.0" /end CHARACTERISTIC
/begin CHARACTERISTIC c_abc_max_bn_msw "Maximum value of the anti - bounce counter BN2000 diagnosis" VALUE 0xffe405c7 _REC_VAL_20_u1 254. _CNV_A_R_LINEAR_____0_CM 1. 255. DISPLAY_IDENTIFIER C_ABC_MAX_BN_MSW FORMAT "%3.0" /end CHARACTERISTIC
/begin CHARACTERISTIC c_abc_max_bn_tq_dcc "Maximum value of the anti - bounce counter BN2000 diagnosis" VALUE 0xffe405cd _REC_VAL_20_u1 254. _CNV_A_R_LINEAR_____0_CM 1. 255. DISPLAY_IDENTIFIER C_ABC_MAX_BN_TQ_DCC FORMAT "%3.0" /end CHARACTERISTIC
/begin CHARACTERISTIC c_abc_max_bn_ang_pste "Maximum value of the anti - bounce counter BN2000 diagnosis" VALUE 0xffe405c0 _REC_VAL_20_u1 254. _CNV_A_R_LINEAR_____0_CM 1. 255. DISPLAY_IDENTIFIER C_ABC_MAX_BN_ANG_PSTE FORMAT "%3.0" /end CHARACTERISTIC
/begin CHARACTERISTIC c_ctr_diag_tcc_can_max_ars "Maximum number of wrong ATCC_CAN count events before error detection of BN2000 message" VALUE 0xffe406af _REC_VAL_20_u1 255. _CNV_A_R_LINEAR_____0_CM 0. 255. DISPLAY_IDENTIFIER C_CTR_DIAG_TCC_CAN_MAX_ARS FORMAT "%3.0" /end CHARACTERISTIC
/begin CHARACTERISTIC c_ctr_diag_tcc_can_max_cas "Maximum number of wrong ATCC_CAN count events before error detection of BN2000 message" VALUE 0xffe406b0 _REC_VAL_20_u1 255. _CNV_A_R_LINEAR_____0_CM 0. 255. DISPLAY_IDENTIFIER C_CTR_DIAG_TCC_CAN_MAX_CAS FORMAT "%3.0" /end CHARACTERISTIC
/begin CHARACTERISTIC c_ctr_diag_tcc_can_max_tq_tcs "Maximum number of wrong ATCC_CAN count events before error detection of BN2000 message" VALUE 0xffe406b7 _REC_VAL_20_u1 255. _CNV_A_R_LINEAR_____0_CM 0. 255. DISPLAY_IDENTIFIER C_CTR_DIAG_TCC_CAN_MAX_TQ_TCS FORMAT "%3.0" /end CHARACTERISTIC
/begin CHARACTERISTIC c_ctr_diag_tcc_can_max_tq_etcu "Maximum number of wrong ATCC_CAN count events before error detection of BN2000 message" VALUE 0xffe406b5 _REC_VAL_20_u1 255. _CNV_A_R_LINEAR_____0_CM 0. 255. DISPLAY_IDENTIFIER C_CTR_DIAG_TCC_CAN_MAX_TQ_ETCU FORMAT "%3.0" /end CHARACTERISTIC
/begin CHARACTERISTIC c_ctr_diag_tcc_can_max_tq_amt "Maximum number of wrong ATCC_CAN count events before error detection of BN2000 message" VALUE 0xffe406b3 _REC_VAL_20_u1 255. _CNV_A_R_LINEAR_____0_CM 0. 255. DISPLAY_IDENTIFIER C_CTR_DIAG_TCC_CAN_MAX_TQ_AMT FORMAT "%3.0" /end CHARACTERISTIC
/begin CHARACTERISTIC c_ctr_diag_tcc_can_max_veh_mod "Maximum number of wrong ATCC_CAN count events before error detection of BN2000 message" VALUE 0xffe406b8 _REC_VAL_20_u1 255. _CNV_A_R_LINEAR_____0_CM 0. 255. DISPLAY_IDENTIFIER C_CTR_DIAG_TCC_CAN_MAX_VEH_MOD FORMAT "%3.0" /end CHARACTERISTIC
/begin CHARACTERISTIC c_ctr_diag_tcc_can_max_icl "Maximum number of wrong ATCC_CAN count events before error detection of BN2000 message" VALUE 0xffe406b1 _REC_VAL_20_u1 255. _CNV_A_R_LINEAR_____0_CM 0. 255. DISPLAY_IDENTIFIER C_CTR_DIAG_TCC_CAN_MAX_ICL FORMAT "%3.0" /end CHARACTERISTIC
/begin CHARACTERISTIC c_ctr_diag_tcc_can_max_msw "Maximum number of wrong ATCC_CAN count events before error detection of BN2000 message" VALUE 0xffe406b2 _REC_VAL_20_u1 255. _CNV_A_R_LINEAR_____0_CM 0. 255. DISPLAY_IDENTIFIER C_CTR_DIAG_TCC_CAN_MAX_MSW FORMAT "%3.0" /end CHARACTERISTIC
/begin CHARACTERISTIC c_ctr_diag_tcc_can_max_tq_dcc "Maximum number of wrong ATCC_CAN count events before error detection of BN2000 message" VALUE 0xffe406b4 _REC_VAL_20_u1 255. _CNV_A_R_LINEAR_____0_CM 0. 255. DISPLAY_IDENTIFIER C_CTR_DIAG_TCC_CAN_MAX_TQ_DCC FORMAT "%3.0" /end CHARACTERISTIC
/begin CHARACTERISTIC c_ctr_diag_cks_max_cas "Maximum number of wrong checksum calculation events before error detection of BN2000 message" VALUE 0xffe406a4 _REC_VAL_20_u1 255. _CNV_A_R_LINEAR_____0_CM 0. 255. DISPLAY_IDENTIFIER C_CTR_DIAG_CKS_MAX_CAS FORMAT "%3.0" /end CHARACTERISTIC
/begin CHARACTERISTIC c_ctr_diag_cks_max_tq_tcs "Maximum number of wrong checksum calculation events before error detection of BN2000 message" VALUE 0xffe406aa _REC_VAL_20_u1 255. _CNV_A_R_LINEAR_____0_CM 0. 255. DISPLAY_IDENTIFIER C_CTR_DIAG_CKS_MAX_TQ_TCS FORMAT "%3.0" /end CHARACTERISTIC
/begin CHARACTERISTIC c_ctr_diag_cks_max_tq_etcu "Maximum number of wrong checksum calculation events before error detection of BN2000 message" VALUE 0xffe406a8 _REC_VAL_20_u1 255. _CNV_A_R_LINEAR_____0_CM 0. 255. DISPLAY_IDENTIFIER C_CTR_DIAG_CKS_MAX_TQ_ETCU FORMAT "%3.0" /end CHARACTERISTIC
/begin CHARACTERISTIC c_ctr_diag_cks_max_tq_amt "Maximum number of wrong checksum calculation events before error detection of BN2000 message" VALUE 0xffe406a6 _REC_VAL_20_u1 255. _CNV_A_R_LINEAR_____0_CM 0. 255. DISPLAY_IDENTIFIER C_CTR_DIAG_CKS_MAX_TQ_AMT FORMAT "%3.0" /end CHARACTERISTIC
/begin CHARACTERISTIC c_ctr_diag_cks_max_veh_mod "Maximum number of wrong checksum calculation events before error detection of BN2000 message" VALUE 0xffe406ab _REC_VAL_20_u1 255. _CNV_A_R_LINEAR_____0_CM 0. 255. DISPLAY_IDENTIFIER C_CTR_DIAG_CKS_MAX_VEH_MOD FORMAT "%3.0" /end CHARACTERISTIC
/begin CHARACTERISTIC c_ctr_diag_cks_max_msw "Maximum number of wrong checksum calculation events before error detection of BN2000 message" VALUE 0xffe406a5 _REC_VAL_20_u1 255. _CNV_A_R_LINEAR_____0_CM 0. 255. DISPLAY_IDENTIFIER C_CTR_DIAG_CKS_MAX_MSW FORMAT "%3.0" /end CHARACTERISTIC
/begin CHARACTERISTIC c_ctr_diag_cks_max_tq_dcc "Maximum number of wrong checksum calculation events before error detection of BN2000 message" VALUE 0xffe406a7 _REC_VAL_20_u1 255. _CNV_A_R_LINEAR_____0_CM 0. 255. DISPLAY_IDENTIFIER C_CTR_DIAG_CKS_MAX_TQ_DCC FORMAT "%3.0" /end CHARACTERISTIC
/begin CHARACTERISTIC c_ctr_diag_tout_max_ars "Maximum number of missing message events before error detection of BN2000 message" VALUE 0xffe406bb _REC_VAL_20_u1 255. _CNV_A_R_LINEAR_____0_CM 0. 255. DISPLAY_IDENTIFIER C_CTR_DIAG_TOUT_MAX_ARS FORMAT "%3.0" /end CHARACTERISTIC
/begin CHARACTERISTIC c_ctr_diag_tout_max_cas "Maximum number of missing message events before error detection of BN2000 message" VALUE 0xffe406bc _REC_VAL_20_u1 255. _CNV_A_R_LINEAR_____0_CM 0. 255. DISPLAY_IDENTIFIER C_CTR_DIAG_TOUT_MAX_CAS FORMAT "%3.0" /end CHARACTERISTIC
/begin CHARACTERISTIC c_ctr_diag_tout_max_tq_tcs "Maximum number of missing message events before error detection of BN2000 message" VALUE 0xffe406ca _REC_VAL_20_u1 255. _CNV_A_R_LINEAR_____0_CM 0. 255. DISPLAY_IDENTIFIER C_CTR_DIAG_TOUT_MAX_TQ_TCS FORMAT "%3.0" /end CHARACTERISTIC
/begin CHARACTERISTIC c_ctr_diag_tout_max_vs_tcs "Maximum number of missing message events before error detection of BN2000 message" VALUE 0xffe406cc _REC_VAL_20_u1 255. _CNV_A_R_LINEAR_____0_CM 0. 255. DISPLAY_IDENTIFIER C_CTR_DIAG_TOUT_MAX_VS_TCS FORMAT "%3.0" /end CHARACTERISTIC
/begin CHARACTERISTIC c_ctr_diag_tout_max_tcs "Maximum number of missing message events before error detection of BN2000 message" VALUE 0xffe406c5 _REC_VAL_20_u1 255. _CNV_A_R_LINEAR_____0_CM 0. 255. DISPLAY_IDENTIFIER C_CTR_DIAG_TOUT_MAX_TCS FORMAT "%3.0" /end CHARACTERISTIC
/begin CHARACTERISTIC c_ctr_diag_tout_max_tq_etcu "Maximum number of missing message events before error detection of BN2000 message" VALUE 0xffe406c8 _REC_VAL_20_u1 255. _CNV_A_R_LINEAR_____0_CM 0. 255. DISPLAY_IDENTIFIER C_CTR_DIAG_TOUT_MAX_TQ_ETCU FORMAT "%3.0" /end CHARACTERISTIC
/begin CHARACTERISTIC c_ctr_diag_tout_max_tq_dcc "Maximum number of missing message events before error detection of BN2000 message" VALUE 0xffe406c7 _REC_VAL_20_u1 255. _CNV_A_R_LINEAR_____0_CM 0. 255. DISPLAY_IDENTIFIER C_CTR_DIAG_TOUT_MAX_TQ_DCC FORMAT "%3.0" /end CHARACTERISTIC
/begin CHARACTERISTIC c_ctr_diag_tout_max_tq_amt "Maximum number of missing message events before error detection of BN2000 message" VALUE 0xffe406c6 _REC_VAL_20_u1 255. _CNV_A_R_LINEAR_____0_CM 0. 255. DISPLAY_IDENTIFIER C_CTR_DIAG_TOUT_MAX_TQ_AMT FORMAT "%3.0" /end CHARACTERISTIC
/begin CHARACTERISTIC c_ctr_diag_tout_max_acc "Maximum number of missing message events before error detection of BN2000 message" VALUE 0xffe406b9 _REC_VAL_20_u1 255. _CNV_A_R_LINEAR_____0_CM 0. 255. DISPLAY_IDENTIFIER C_CTR_DIAG_TOUT_MAX_ACC FORMAT "%3.0" /end CHARACTERISTIC
/begin CHARACTERISTIC c_ctr_diag_tout_max_t_icl "Maximum number of missing message events before error detection of BN2000 message" VALUE 0xffe406c4 _REC_VAL_20_u1 255. _CNV_A_R_LINEAR_____0_CM 0. 255. DISPLAY_IDENTIFIER C_CTR_DIAG_TOUT_MAX_T_ICL FORMAT "%3.0" /end CHARACTERISTIC
/begin CHARACTERISTIC c_ctr_diag_tout_max_veh_mod "Maximum number of missing message events before error detection of BN2000 message" VALUE 0xffe406cb _REC_VAL_20_u1 255. _CNV_A_R_LINEAR_____0_CM 0. 255. DISPLAY_IDENTIFIER C_CTR_DIAG_TOUT_MAX_VEH_MOD FORMAT "%3.0" /end CHARACTERISTIC
/begin CHARACTERISTIC c_ctr_diag_tout_max_km_icl "Maximum number of missing message events before error detection of BN2000 message" VALUE 0xffe406c0 _REC_VAL_20_u1 255. _CNV_A_R_LINEAR_____0_CM 0. 255. DISPLAY_IDENTIFIER C_CTR_DIAG_TOUT_MAX_KM_ICL FORMAT "%3.0" /end CHARACTERISTIC
/begin CHARACTERISTIC c_ctr_diag_tout_max_icl "Maximum number of missing message events before error detection of BN2000 message" VALUE 0xffe406bf _REC_VAL_20_u1 255. _CNV_A_R_LINEAR_____0_CM 0. 255. DISPLAY_IDENTIFIER C_CTR_DIAG_TOUT_MAX_ICL FORMAT "%3.0" /end CHARACTERISTIC
/begin MEASUREMENT fmy_stat_sof_req.err_info_stat.err_sym "" UBYTE _CNV_S_6_RANGE_ERR__193_CM 1 100. 0. 15. DISPLAY_IDENTIFIER ERR_SYM_SOF_REQ ECU_ADDRESS 0x3fba75 BIT_MASK 0xF /end MEASUREMENT
/begin MEASUREMENT fmy_stat_rly_st.err_info_stat.lv_err_mem "" UBYTE _CNV_S_2_RANGE______21_CM 1 100. 0. 1. DISPLAY_IDENTIFIER LV_ERR_MEM_RLY_ST ECU_ADDRESS 0x3fba79 BIT_MASK 0x80 /end MEASUREMENT
/begin MEASUREMENT fmy_stat_rly_st.err_info_stat.lv_ready "" UBYTE _CNV_S_2_RANGE______21_CM 1 100. 0. 1. DISPLAY_IDENTIFIER LV_READY_RLY_ST ECU_ADDRESS 0x3fba79 BIT_MASK 0x40 /end MEASUREMENT
/begin MEASUREMENT fmy_stat_rly_st.err_info_stat.lv_end_diag "" UBYTE _CNV_S_2_RANGE______21_CM 1 100. 0. 1. DISPLAY_IDENTIFIER LV_END_DIAG_RLY_ST ECU_ADDRESS 0x3fba79 BIT_MASK 0x20 /end MEASUREMENT
/begin MEASUREMENT fmy_stat_rly_st.err_info_stat.lv_cdn_diag "" UBYTE _CNV_S_2_RANGE______21_CM 1 100. 0. 1. DISPLAY_IDENTIFIER LV_CDN_DIAG_RLY_ST ECU_ADDRESS 0x3fba79 BIT_MASK 0x10 /end MEASUREMENT
/begin MEASUREMENT fmy_stat_rly_st.err_info_stat.err_sym "" UBYTE _CNV_S_6_RANGE_ERR__193_CM 1 100. 0. 15. DISPLAY_IDENTIFIER ERR_SYM_RLY_ST ECU_ADDRESS 0x3fba79 BIT_MASK 0xF /end MEASUREMENT
/begin MEASUREMENT fmy_stat_bsd.ctr_abc "" UBYTE _CNV_A_R_LINEAR_____0_CM 1 100. 0. 255. DISPLAY_IDENTIFIER CTR_ABC_BSD ECU_ADDRESS 0x3fba7f FORMAT "%3.0" /end MEASUREMENT
/begin MEASUREMENT fmy_stat_bsd.ctr_end_diag "" UBYTE _CNV_A_R_LINEAR_____0_CM 1 100. 0. 255. DISPLAY_IDENTIFIER CTR_ABC_END_DIAG_BSD ECU_ADDRESS 0x3fba7e FORMAT "%3.0" /end MEASUREMENT
/begin MEASUREMENT fmy_stat_bsd.err_info_stat.lv_err_mem "" UBYTE _CNV_S_2_RANGE______21_CM 1 100. 0. 1. DISPLAY_IDENTIFIER LV_ERR_MEM_BSD ECU_ADDRESS 0x3fba7d BIT_MASK 0x80 /end MEASUREMENT
/begin MEASUREMENT fmy_stat_bsd.err_info_stat.lv_ready "" UBYTE _CNV_S_2_RANGE______21_CM 1 100. 0. 1. DISPLAY_IDENTIFIER LV_READY_BSD ECU_ADDRESS 0x3fba7d BIT_MASK 0x40 /end MEASUREMENT
/begin MEASUREMENT fmy_stat_bsd.err_info_stat.lv_end_diag "" UBYTE _CNV_S_2_RANGE______21_CM 1 100. 0. 1. DISPLAY_IDENTIFIER LV_END_DIAG_BSD ECU_ADDRESS 0x3fba7d BIT_MASK 0x20 /end MEASUREMENT
/begin MEASUREMENT fmy_stat_bsd.err_info_stat.lv_cdn_diag "" UBYTE _CNV_S_2_RANGE______21_CM 1 100. 0. 1. DISPLAY_IDENTIFIER LV_CDN_DIAG_BSD ECU_ADDRESS 0x3fba7d BIT_MASK 0x10 /end MEASUREMENT
/begin MEASUREMENT fmy_stat_bsd.err_info_stat.err_sym "" UBYTE _CNV_S_6_RANGE_ERR__193_CM 1 100. 0. 15. DISPLAY_IDENTIFIER ERR_SYM_BSD ECU_ADDRESS 0x3fba7d BIT_MASK 0xF /end MEASUREMENT
/begin MEASUREMENT fmy_stat_poil_swi.ctr_abc "" UBYTE _CNV_A_R_LINEAR_____0_CM 1 100. 0. 255. DISPLAY_IDENTIFIER CTR_ABC_POIL_SWI ECU_ADDRESS 0x3fba83 FORMAT "%3.0" /end MEASUREMENT
/begin MEASUREMENT fmy_stat_poil_swi.ctr_end_diag "" UBYTE _CNV_A_R_LINEAR_____0_CM 1 100. 0. 255. DISPLAY_IDENTIFIER CTR_ABC_END_DIAG_POIL_SWI ECU_ADDRESS 0x3fba82 FORMAT "%3.0" /end MEASUREMENT
/begin MEASUREMENT fmy_stat_poil_swi.err_info_stat.lv_err_mem "" UBYTE _CNV_S_2_RANGE______21_CM 1 100. 0. 1. DISPLAY_IDENTIFIER LV_ERR_MEM_POIL_SWI ECU_ADDRESS 0x3fba81 BIT_MASK 0x80 /end MEASUREMENT
/begin MEASUREMENT fmy_stat_poil_swi.err_info_stat.lv_ready "" UBYTE _CNV_S_2_RANGE______21_CM 1 100. 0. 1. DISPLAY_IDENTIFIER LV_READY_POIL_SWI ECU_ADDRESS 0x3fba81 BIT_MASK 0x40 /end MEASUREMENT
/begin MEASUREMENT fmy_stat_poil_swi.err_info_stat.lv_end_diag "" UBYTE _CNV_S_2_RANGE______21_CM 1 100. 0. 1. DISPLAY_IDENTIFIER LV_END_DIAG_POIL_SWI ECU_ADDRESS 0x3fba81 BIT_MASK 0x20 /end MEASUREMENT
/begin MEASUREMENT fmy_stat_poil_swi.err_info_stat.lv_cdn_diag "" UBYTE _CNV_S_2_RANGE______21_CM 1 100. 0. 1. DISPLAY_IDENTIFIER LV_CDN_DIAG_POIL_SWI ECU_ADDRESS 0x3fba81 BIT_MASK 0x10 /end MEASUREMENT
/begin MEASUREMENT fmy_stat_poil_swi.err_info_stat.err_sym "" UBYTE _CNV_S_6_RANGE_ERR__193_CM 1 100. 0. 15. DISPLAY_IDENTIFIER ERR_SYM_POIL_SWI ECU_ADDRESS 0x3fba81 BIT_MASK 0xF /end MEASUREMENT
/begin MEASUREMENT fmy_stat_tout_efp.ctr_abc "" UBYTE _CNV_A_R_LINEAR_____0_CM 1 100. 0. 255. DISPLAY_IDENTIFIER CTR_ABC_TOUT_EFP ECU_ADDRESS 0x3fba87 FORMAT "%3.0" /end MEASUREMENT
/begin MEASUREMENT fmy_stat_tout_efp.ctr_end_diag "" UBYTE _CNV_A_R_LINEAR_____0_CM 1 100. 0. 255. DISPLAY_IDENTIFIER CTR_ABC_END_DIAG_TOUT_EFP ECU_ADDRESS 0x3fba86 FORMAT "%3.0" /end MEASUREMENT
/begin MEASUREMENT fmy_stat_tout_efp.err_info_stat.lv_err_mem "" UBYTE _CNV_S_2_RANGE______21_CM 1 100. 0. 1. DISPLAY_IDENTIFIER LV_ERR_MEM_TOUT_EFP ECU_ADDRESS 0x3fba85 BIT_MASK 0x80 /end MEASUREMENT
/begin MEASUREMENT fmy_stat_tout_efp.err_info_stat.lv_ready "" UBYTE _CNV_S_2_RANGE______21_CM 1 100. 0. 1. DISPLAY_IDENTIFIER LV_READY_TOUT_EFP ECU_ADDRESS 0x3fba85 BIT_MASK 0x40 /end MEASUREMENT
/begin MEASUREMENT fmy_stat_tout_efp.err_info_stat.lv_end_diag "" UBYTE _CNV_S_2_RANGE______21_CM 1 100. 0. 1. DISPLAY_IDENTIFIER LV_END_DIAG_TOUT_EFP ECU_ADDRESS 0x3fba85 BIT_MASK 0x20 /end MEASUREMENT
/begin MEASUREMENT fmy_stat_tout_efp.err_info_stat.lv_cdn_diag "" UBYTE _CNV_S_2_RANGE______21_CM 1 100. 0. 1. DISPLAY_IDENTIFIER LV_CDN_DIAG_TOUT_EFP ECU_ADDRESS 0x3fba85 BIT_MASK 0x10 /end MEASUREMENT
/begin MEASUREMENT fmy_stat_tout_efp.err_info_stat.err_sym "" UBYTE _CNV_S_6_RANGE_ERR__193_CM 1 100. 0. 15. DISPLAY_IDENTIFIER ERR_SYM_TOUT_EFP ECU_ADDRESS 0x3fba85 BIT_MASK 0xF /end MEASUREMENT
/begin MEASUREMENT fmy_stat_diagcps.ctr_abc "" UBYTE _CNV_A_R_LINEAR_____0_CM 1 100. 0. 255. DISPLAY_IDENTIFIER CTR_ABC_DIAGCPS ECU_ADDRESS 0x3fba8b FORMAT "%3.0" /end MEASUREMENT
/begin MEASUREMENT fmy_stat_diagcps.ctr_end_diag "" UBYTE _CNV_A_R_LINEAR_____0_CM 1 100. 0. 255. DISPLAY_IDENTIFIER CTR_ABC_END_DIAG_DIAGCPS ECU_ADDRESS 0x3fba8a FORMAT "%3.0" /end MEASUREMENT
/begin MEASUREMENT fmy_stat_diagcps.err_info_stat.lv_err_mem "" UBYTE _CNV_S_2_RANGE______21_CM 1 100. 0. 1. DISPLAY_IDENTIFIER LV_ERR_MEM_DIAGCPS ECU_ADDRESS 0x3fba89 BIT_MASK 0x80 /end MEASUREMENT
/begin MEASUREMENT fmy_stat_diagcps.err_info_stat.lv_ready "" UBYTE _CNV_S_2_RANGE______21_CM 1 100. 0. 1. DISPLAY_IDENTIFIER LV_READY_DIAGCPS ECU_ADDRESS 0x3fba89 BIT_MASK 0x40 /end MEASUREMENT
/begin MEASUREMENT fmy_stat_diagcps.err_info_stat.lv_end_diag "" UBYTE _CNV_S_2_RANGE______21_CM 1 100. 0. 1. DISPLAY_IDENTIFIER LV_END_DIAG_DIAGCPS ECU_ADDRESS 0x3fba89 BIT_MASK 0x20 /end MEASUREMENT
/begin MEASUREMENT fmy_stat_diagcps.err_info_stat.lv_cdn_diag "" UBYTE _CNV_S_2_RANGE______21_CM 1 100. 0. 1. DISPLAY_IDENTIFIER LV_CDN_DIAG_DIAGCPS ECU_ADDRESS 0x3fba89 BIT_MASK 0x10 /end MEASUREMENT
/begin MEASUREMENT fmy_stat_diagcps.err_info_stat.err_sym "" UBYTE _CNV_S_6_RANGE_ERR__193_CM 1 100. 0. 15. DISPLAY_IDENTIFIER ERR_SYM_DIAGCPS ECU_ADDRESS 0x3fba89 BIT_MASK 0xF /end MEASUREMENT
/begin MEASUREMENT fmy_stat_tq_gs_inc_plaus.ctr_abc "" UBYTE _CNV_A_R_LINEAR_____0_CM 1 100. 0. 255. DISPLAY_IDENTIFIER CTR_ABC_TQ_GS_INC_PLAUS ECU_ADDRESS 0x3fba8f FORMAT "%3.0" /end MEASUREMENT
/begin MEASUREMENT fmy_stat_tq_gs_inc_plaus.ctr_end_diag "" UBYTE _CNV_A_R_LINEAR_____0_CM 1 100. 0. 255. DISPLAY_IDENTIFIER CTR_ABC_END_DIAG_TQ_GS_INC_PLAUS ECU_ADDRESS 0x3fba8e FORMAT "%3.0" /end MEASUREMENT
/begin MEASUREMENT fmy_stat_tq_gs_inc_plaus.err_info_stat.lv_err_mem "" UBYTE _CNV_S_2_RANGE______21_CM 1 100. 0. 1. DISPLAY_IDENTIFIER LV_ERR_MEM_TQ_GS_INC_PLAUS ECU_ADDRESS 0x3fba8d BIT_MASK 0x80 /end MEASUREMENT
/begin MEASUREMENT fmy_stat_tq_gs_inc_plaus.err_info_stat.lv_ready "" UBYTE _CNV_S_2_RANGE______21_CM 1 100. 0. 1. DISPLAY_IDENTIFIER LV_READY_TQ_GS_INC_PLAUS ECU_ADDRESS 0x3fba8d BIT_MASK 0x40 /end MEASUREMENT
/begin MEASUREMENT fmy_stat_tq_gs_inc_plaus.err_info_stat.lv_end_diag "" UBYTE _CNV_S_2_RANGE______21_CM 1 100. 0. 1. DISPLAY_IDENTIFIER LV_END_DIAG_TQ_GS_INC_PLAUS ECU_ADDRESS 0x3fba8d BIT_MASK 0x20 /end MEASUREMENT
/begin MEASUREMENT fmy_stat_tq_gs_inc_plaus.err_info_stat.lv_cdn_diag "" UBYTE _CNV_S_2_RANGE______21_CM 1 100. 0. 1. DISPLAY_IDENTIFIER LV_CDN_DIAG_TQ_GS_INC_PLAUS ECU_ADDRESS 0x3fba8d BIT_MASK 0x10 /end MEASUREMENT
/begin MEASUREMENT fmy_stat_tq_gs_inc_plaus.err_info_stat.err_sym "" UBYTE _CNV_S_6_RANGE_ERR__193_CM 1 100. 0. 15. DISPLAY_IDENTIFIER ERR_SYM_TQ_GS_INC_PLAUS ECU_ADDRESS 0x3fba8d BIT_MASK 0xF /end MEASUREMENT
/begin MEASUREMENT fmy_stat_dcc.ctr_abc "" UBYTE _CNV_A_R_LINEAR_____0_CM 1 100. 0. 255. DISPLAY_IDENTIFIER CTR_ABC_DCC ECU_ADDRESS 0x3fba93 FORMAT "%3.0" /end MEASUREMENT
/begin MEASUREMENT fmy_stat_dcc.ctr_end_diag "" UBYTE _CNV_A_R_LINEAR_____0_CM 1 100. 0. 255. DISPLAY_IDENTIFIER CTR_ABC_END_DIAG_DCC ECU_ADDRESS 0x3fba92 FORMAT "%3.0" /end MEASUREMENT
/begin MEASUREMENT fmy_stat_dcc.err_info_stat.lv_err_mem "" UBYTE _CNV_S_2_RANGE______21_CM 1 100. 0. 1. DISPLAY_IDENTIFIER LV_ERR_MEM_DCC ECU_ADDRESS 0x3fba91 BIT_MASK 0x80 /end MEASUREMENT
/begin MEASUREMENT fmy_stat_dcc.err_info_stat.lv_ready "" UBYTE _CNV_S_2_RANGE______21_CM 1 100. 0. 1. DISPLAY_IDENTIFIER LV_READY_DCC ECU_ADDRESS 0x3fba91 BIT_MASK 0x40 /end MEASUREMENT
/begin MEASUREMENT fmy_stat_dcc.err_info_stat.lv_end_diag "" UBYTE _CNV_S_2_RANGE______21_CM 1 100. 0. 1. DISPLAY_IDENTIFIER LV_END_DIAG_DCC ECU_ADDRESS 0x3fba91 BIT_MASK 0x20 /end MEASUREMENT
/begin MEASUREMENT fmy_stat_dcc.err_info_stat.lv_cdn_diag "" UBYTE _CNV_S_2_RANGE______21_CM 1 100. 0. 1. DISPLAY_IDENTIFIER LV_CDN_DIAG_DCC ECU_ADDRESS 0x3fba91 BIT_MASK 0x10 /end MEASUREMENT
/begin MEASUREMENT fmy_stat_dcc.err_info_stat.err_sym "" UBYTE _CNV_S_6_RANGE_ERR__193_CM 1 100. 0. 15. DISPLAY_IDENTIFIER ERR_SYM_DCC ECU_ADDRESS 0x3fba91 BIT_MASK 0xF /end MEASUREMENT
/begin MEASUREMENT fmy_stat_ecras.err_info_stat.lv_err_mem "" UBYTE _CNV_S_2_RANGE______21_CM 1 100. 0. 1. DISPLAY_IDENTIFIER LV_ERR_MEM_ECRAS ECU_ADDRESS 0x3fba95 BIT_MASK 0x80 /end MEASUREMENT
/begin MEASUREMENT fmy_stat_ecras.err_info_stat.lv_ready "" UBYTE _CNV_S_2_RANGE______21_CM 1 100. 0. 1. DISPLAY_IDENTIFIER LV_READY_ECRAS ECU_ADDRESS 0x3fba95 BIT_MASK 0x40 /end MEASUREMENT
/begin MEASUREMENT fmy_stat_ecras.err_info_stat.lv_end_diag "" UBYTE _CNV_S_2_RANGE______21_CM 1 100. 0. 1. DISPLAY_IDENTIFIER LV_END_DIAG_ECRAS ECU_ADDRESS 0x3fba95 BIT_MASK 0x20 /end MEASUREMENT
/begin MEASUREMENT fmy_stat_ecras.err_info_stat.lv_cdn_diag "" UBYTE _CNV_S_2_RANGE______21_CM 1 100. 0. 1. DISPLAY_IDENTIFIER LV_CDN_DIAG_ECRAS ECU_ADDRESS 0x3fba95 BIT_MASK 0x10 /end MEASUREMENT
/begin MEASUREMENT fmy_stat_ecras.err_info_stat.err_sym "" UBYTE _CNV_S_6_RANGE_ERR__193_CM 1 100. 0. 15. DISPLAY_IDENTIFIER ERR_SYM_ECRAS ECU_ADDRESS 0x3fba95 BIT_MASK 0xF /end MEASUREMENT
/begin MEASUREMENT fmy_stat_dmtlh.err_info_stat.lv_err_mem "" UBYTE _CNV_S_2_RANGE______21_CM 1 100. 0. 1. DISPLAY_IDENTIFIER LV_ERR_MEM_DMTLH ECU_ADDRESS 0x3fba99 BIT_MASK 0x80 /end MEASUREMENT
/begin MEASUREMENT fmy_stat_dmtlh.err_info_stat.lv_ready "" UBYTE _CNV_S_2_RANGE______21_CM 1 100. 0. 1. DISPLAY_IDENTIFIER LV_READY_DMTLH ECU_ADDRESS 0x3fba99 BIT_MASK 0x40 /end MEASUREMENT
/begin MEASUREMENT fmy_stat_dmtlh.err_info_stat.lv_end_diag "" UBYTE _CNV_S_2_RANGE______21_CM 1 100. 0. 1. DISPLAY_IDENTIFIER LV_END_DIAG_DMTLH ECU_ADDRESS 0x3fba99 BIT_MASK 0x20 /end MEASUREMENT
/begin MEASUREMENT fmy_stat_dmtlh.err_info_stat.lv_cdn_diag "" UBYTE _CNV_S_2_RANGE______21_CM 1 100. 0. 1. DISPLAY_IDENTIFIER LV_CDN_DIAG_DMTLH ECU_ADDRESS 0x3fba99 BIT_MASK 0x10 /end MEASUREMENT
/begin MEASUREMENT fmy_stat_dmtlh.err_info_stat.err_sym "" UBYTE _CNV_S_6_RANGE_ERR__193_CM 1 100. 0. 15. DISPLAY_IDENTIFIER ERR_SYM_DMTLH ECU_ADDRESS 0x3fba99 BIT_MASK 0xF /end MEASUREMENT
/begin MEASUREMENT fmy_stat_cs.ctr_abc "" UBYTE _CNV_A_R_LINEAR_____0_CM 1 100. 0. 255. DISPLAY_IDENTIFIER CTR_ABC_CS ECU_ADDRESS 0x3fba9f FORMAT "%3.0" /end MEASUREMENT
/begin MEASUREMENT fmy_stat_cs.ctr_end_diag "" UBYTE _CNV_A_R_LINEAR_____0_CM 1 100. 0. 255. DISPLAY_IDENTIFIER CTR_ABC_END_DIAG_CS ECU_ADDRESS 0x3fba9e FORMAT "%3.0" /end MEASUREMENT
/begin MEASUREMENT fmy_stat_cs.err_info_stat.lv_err_mem "" UBYTE _CNV_S_2_RANGE______21_CM 1 100. 0. 1. DISPLAY_IDENTIFIER LV_ERR_MEM_CS ECU_ADDRESS 0x3fba9d BIT_MASK 0x80 /end MEASUREMENT
/begin MEASUREMENT fmy_stat_cs.err_info_stat.lv_ready "" UBYTE _CNV_S_2_RANGE______21_CM 1 100. 0. 1. DISPLAY_IDENTIFIER LV_READY_CS ECU_ADDRESS 0x3fba9d BIT_MASK 0x40 /end MEASUREMENT
/begin MEASUREMENT fmy_stat_cs.err_info_stat.lv_end_diag "" UBYTE _CNV_S_2_RANGE______21_CM 1 100. 0. 1. DISPLAY_IDENTIFIER LV_END_DIAG_CS ECU_ADDRESS 0x3fba9d BIT_MASK 0x20 /end MEASUREMENT
/begin MEASUREMENT fmy_stat_cs.err_info_stat.lv_cdn_diag "" UBYTE _CNV_S_2_RANGE______21_CM 1 100. 0. 1. DISPLAY_IDENTIFIER LV_CDN_DIAG_CS ECU_ADDRESS 0x3fba9d BIT_MASK 0x10 /end MEASUREMENT
/begin MEASUREMENT fmy_stat_cs.err_info_stat.err_sym "" UBYTE _CNV_S_6_RANGE_ERR__193_CM 1 100. 0. 15. DISPLAY_IDENTIFIER ERR_SYM_CS ECU_ADDRESS 0x3fba9d BIT_MASK 0xF /end MEASUREMENT
/begin MEASUREMENT fmy_stat_spi_mps.ctr_abc "" UBYTE _CNV_A_R_LINEAR_____0_CM 1 100. 0. 255. DISPLAY_IDENTIFIER CTR_ABC_SPI_MPS ECU_ADDRESS 0x3fbaa3 FORMAT "%3.0" /end MEASUREMENT
/begin MEASUREMENT fmy_stat_spi_mps.ctr_end_diag "" UBYTE _CNV_A_R_LINEAR_____0_CM 1 100. 0. 255. DISPLAY_IDENTIFIER CTR_ABC_END_DIAG_SPI_MPS ECU_ADDRESS 0x3fbaa2 FORMAT "%3.0" /end MEASUREMENT
/begin MEASUREMENT fmy_stat_spi_mps.err_info_stat.lv_err_mem "" UBYTE _CNV_S_2_RANGE______21_CM 1 100. 0. 1. DISPLAY_IDENTIFIER LV_ERR_MEM_SPI_MPS ECU_ADDRESS 0x3fbaa1 BIT_MASK 0x80 /end MEASUREMENT
/begin MEASUREMENT fmy_stat_spi_mps.err_info_stat.lv_ready "" UBYTE _CNV_S_2_RANGE______21_CM 1 100. 0. 1. DISPLAY_IDENTIFIER LV_READY_SPI_MPS ECU_ADDRESS 0x3fbaa1 BIT_MASK 0x40 /end MEASUREMENT
/begin MEASUREMENT fmy_stat_spi_mps.err_info_stat.lv_end_diag "" UBYTE _CNV_S_2_RANGE______21_CM 1 100. 0. 1. DISPLAY_IDENTIFIER LV_END_DIAG_SPI_MPS ECU_ADDRESS 0x3fbaa1 BIT_MASK 0x20 /end MEASUREMENT
/begin MEASUREMENT fmy_stat_spi_mps.err_info_stat.lv_cdn_diag "" UBYTE _CNV_S_2_RANGE______21_CM 1 100. 0. 1. DISPLAY_IDENTIFIER LV_CDN_DIAG_SPI_MPS ECU_ADDRESS 0x3fbaa1 BIT_MASK 0x10 /end MEASUREMENT
/begin MEASUREMENT fmy_stat_spi_mps.err_info_stat.err_sym "" UBYTE _CNV_S_6_RANGE_ERR__193_CM 1 100. 0. 15. DISPLAY_IDENTIFIER ERR_SYM_SPI_MPS ECU_ADDRESS 0x3fbaa1 BIT_MASK 0xF /end MEASUREMENT
/begin MEASUREMENT fmy_stat_spi_knk.ctr_abc "" UBYTE _CNV_A_R_LINEAR_____0_CM 1 100. 0. 255. DISPLAY_IDENTIFIER CTR_ABC_SPI_KNK ECU_ADDRESS 0x3fbaa7 FORMAT "%3.0" /end MEASUREMENT
/begin MEASUREMENT fmy_stat_spi_knk.ctr_end_diag "" UBYTE _CNV_A_R_LINEAR_____0_CM 1 100. 0. 255. DISPLAY_IDENTIFIER CTR_ABC_END_DIAG_SPI_KNK ECU_ADDRESS 0x3fbaa6 FORMAT "%3.0" /end MEASUREMENT
/begin MEASUREMENT fmy_stat_spi_knk.err_info_stat.lv_err_mem "" UBYTE _CNV_S_2_RANGE______21_CM 1 100. 0. 1. DISPLAY_IDENTIFIER LV_ERR_MEM_SPI_KNK ECU_ADDRESS 0x3fbaa5 BIT_MASK 0x80 /end MEASUREMENT
/begin MEASUREMENT fmy_stat_spi_knk.err_info_stat.lv_ready "" UBYTE _CNV_S_2_RANGE______21_CM 1 100. 0. 1. DISPLAY_IDENTIFIER LV_READY_SPI_KNK ECU_ADDRESS 0x3fbaa5 BIT_MASK 0x40 /end MEASUREMENT
/begin MEASUREMENT fmy_stat_spi_knk.err_info_stat.lv_end_diag "" UBYTE _CNV_S_2_RANGE______21_CM 1 100. 0. 1. DISPLAY_IDENTIFIER LV_END_DIAG_SPI_KNK ECU_ADDRESS 0x3fbaa5 BIT_MASK 0x20 /end MEASUREMENT
/begin MEASUREMENT fmy_stat_spi_knk.err_info_stat.lv_cdn_diag "" UBYTE _CNV_S_2_RANGE______21_CM 1 100. 0. 1. DISPLAY_IDENTIFIER LV_CDN_DIAG_SPI_KNK ECU_ADDRESS 0x3fbaa5 BIT_MASK 0x10 /end MEASUREMENT
/begin MEASUREMENT fmy_stat_spi_knk.err_info_stat.err_sym "" UBYTE _CNV_S_6_RANGE_ERR__193_CM 1 100. 0. 15. DISPLAY_IDENTIFIER ERR_SYM_SPI_KNK ECU_ADDRESS 0x3fbaa5 BIT_MASK 0xF /end MEASUREMENT
/begin MEASUREMENT fmy_stat_bn_tq_dcc.ctr_abc "" UBYTE _CNV_A_R_LINEAR_____0_CM 1 100. 0. 255. DISPLAY_IDENTIFIER CTR_ABC_BN_TQ_DCC ECU_ADDRESS 0x3fbaab FORMAT "%3.0" /end MEASUREMENT
/begin MEASUREMENT fmy_stat_bn_tq_dcc.ctr_end_diag "" UBYTE _CNV_A_R_LINEAR_____0_CM 1 100. 0. 255. DISPLAY_IDENTIFIER CTR_ABC_END_DIAG_BN_TQ_DCC ECU_ADDRESS 0x3fbaaa FORMAT "%3.0" /end MEASUREMENT
/begin MEASUREMENT fmy_stat_bn_tq_dcc.err_info_stat.lv_err_mem "" UBYTE _CNV_S_2_RANGE______21_CM 1 100. 0. 1. DISPLAY_IDENTIFIER LV_ERR_MEM_BN_TQ_DCC ECU_ADDRESS 0x3fbaa9 BIT_MASK 0x80 /end MEASUREMENT
/begin MEASUREMENT fmy_stat_bn_tq_dcc.err_info_stat.lv_ready "" UBYTE _CNV_S_2_RANGE______21_CM 1 100. 0. 1. DISPLAY_IDENTIFIER LV_READY_BN_TQ_DCC ECU_ADDRESS 0x3fbaa9 BIT_MASK 0x40 /end MEASUREMENT
/begin MEASUREMENT fmy_stat_bn_tq_dcc.err_info_stat.lv_end_diag "" UBYTE _CNV_S_2_RANGE______21_CM 1 100. 0. 1. DISPLAY_IDENTIFIER LV_END_DIAG_BN_TQ_DCC ECU_ADDRESS 0x3fbaa9 BIT_MASK 0x20 /end MEASUREMENT
/begin MEASUREMENT fmy_stat_bn_tq_dcc.err_info_stat.lv_cdn_diag "" UBYTE _CNV_S_2_RANGE______21_CM 1 100. 0. 1. DISPLAY_IDENTIFIER LV_CDN_DIAG_BN_TQ_DCC ECU_ADDRESS 0x3fbaa9 BIT_MASK 0x10 /end MEASUREMENT
/begin MEASUREMENT fmy_stat_bn_tq_dcc.err_info_stat.err_sym "" UBYTE _CNV_S_6_RANGE_ERR__193_CM 1 100. 0. 15. DISPLAY_IDENTIFIER ERR_SYM_BN_TQ_DCC ECU_ADDRESS 0x3fbaa9 BIT_MASK 0xF /end MEASUREMENT
/begin MEASUREMENT fmy_stat_bn_tq_pste_2.ctr_abc "" UBYTE _CNV_A_R_LINEAR_____0_CM 1 100. 0. 255. DISPLAY_IDENTIFIER CTR_ABC_BN_TQ_PSTE_2 ECU_ADDRESS 0x3fbaaf FORMAT "%3.0" /end MEASUREMENT
/begin MEASUREMENT fmy_stat_bn_tq_pste_2.ctr_end_diag "" UBYTE _CNV_A_R_LINEAR_____0_CM 1 100. 0. 255. DISPLAY_IDENTIFIER CTR_ABC_END_DIAG_BN_TQ_PSTE_2 ECU_ADDRESS 0x3fbaae FORMAT "%3.0" /end MEASUREMENT
/begin MEASUREMENT fmy_stat_bn_tq_pste_2.err_info_stat.lv_err_mem "" UBYTE _CNV_S_2_RANGE______21_CM 1 100. 0. 1. DISPLAY_IDENTIFIER LV_ERR_MEM_BN_TQ_PSTE_2 ECU_ADDRESS 0x3fbaad BIT_MASK 0x80 /end MEASUREMENT
/begin MEASUREMENT fmy_stat_bn_tq_pste_2.err_info_stat.lv_ready "" UBYTE _CNV_S_2_RANGE______21_CM 1 100. 0. 1. DISPLAY_IDENTIFIER LV_READY_BN_TQ_PSTE_2 ECU_ADDRESS 0x3fbaad BIT_MASK 0x40 /end MEASUREMENT
/begin MEASUREMENT fmy_stat_bn_tq_pste_2.err_info_stat.lv_end_diag "" UBYTE _CNV_S_2_RANGE______21_CM 1 100. 0. 1. DISPLAY_IDENTIFIER LV_END_DIAG_BN_TQ_PSTE_2 ECU_ADDRESS 0x3fbaad BIT_MASK 0x20 /end MEASUREMENT
/begin MEASUREMENT fmy_stat_bn_tq_pste_2.err_info_stat.lv_cdn_diag "" UBYTE _CNV_S_2_RANGE______21_CM 1 100. 0. 1. DISPLAY_IDENTIFIER LV_CDN_DIAG_BN_TQ_PSTE_2 ECU_ADDRESS 0x3fbaad BIT_MASK 0x10 /end MEASUREMENT
/begin MEASUREMENT fmy_stat_bn_tq_pste_2.err_info_stat.err_sym "" UBYTE _CNV_S_6_RANGE_ERR__193_CM 1 100. 0. 15. DISPLAY_IDENTIFIER ERR_SYM_BN_TQ_PSTE_2 ECU_ADDRESS 0x3fbaad BIT_MASK 0xF /end MEASUREMENT
/begin MEASUREMENT fmy_stat_bn_ars.ctr_abc "" UBYTE _CNV_A_R_LINEAR_____0_CM 1 100. 0. 255. DISPLAY_IDENTIFIER CTR_ABC_BN_ARS ECU_ADDRESS 0x3fbab3 FORMAT "%3.0" /end MEASUREMENT
/begin MEASUREMENT fmy_stat_bn_ars.ctr_end_diag "" UBYTE _CNV_A_R_LINEAR_____0_CM 1 100. 0. 255. DISPLAY_IDENTIFIER CTR_ABC_END_DIAG_BN_ARS ECU_ADDRESS 0x3fbab2 FORMAT "%3.0" /end MEASUREMENT
/begin MEASUREMENT fmy_stat_bn_ars.err_info_stat.lv_err_mem "" UBYTE _CNV_S_2_RANGE______21_CM 1 100. 0. 1. DISPLAY_IDENTIFIER LV_ERR_MEM_BN_ARS ECU_ADDRESS 0x3fbab1 BIT_MASK 0x80 /end MEASUREMENT
/begin MEASUREMENT fmy_stat_bn_ars.err_info_stat.lv_ready "" UBYTE _CNV_S_2_RANGE______21_CM 1 100. 0. 1. DISPLAY_IDENTIFIER LV_READY_BN_ARS ECU_ADDRESS 0x3fbab1 BIT_MASK 0x40 /end MEASUREMENT
/begin MEASUREMENT fmy_stat_bn_ars.err_info_stat.lv_end_diag "" UBYTE _CNV_S_2_RANGE______21_CM 1 100. 0. 1. DISPLAY_IDENTIFIER LV_END_DIAG_BN_ARS ECU_ADDRESS 0x3fbab1 BIT_MASK 0x20 /end MEASUREMENT
/begin MEASUREMENT fmy_stat_bn_ars.err_info_stat.lv_cdn_diag "" UBYTE _CNV_S_2_RANGE______21_CM 1 100. 0. 1. DISPLAY_IDENTIFIER LV_CDN_DIAG_BN_ARS ECU_ADDRESS 0x3fbab1 BIT_MASK 0x10 /end MEASUREMENT
/begin MEASUREMENT fmy_stat_bn_ars.err_info_stat.err_sym "" UBYTE _CNV_S_6_RANGE_ERR__193_CM 1 100. 0. 15. DISPLAY_IDENTIFIER ERR_SYM_BN_ARS ECU_ADDRESS 0x3fbab1 BIT_MASK 0xF /end MEASUREMENT
/begin MEASUREMENT fmy_stat_bn_cas.ctr_abc "" UBYTE _CNV_A_R_LINEAR_____0_CM 1 100. 0. 255. DISPLAY_IDENTIFIER CTR_ABC_BN_CAS ECU_ADDRESS 0x3fbab7 FORMAT "%3.0" /end MEASUREMENT
/begin MEASUREMENT fmy_stat_bn_cas.ctr_end_diag "" UBYTE _CNV_A_R_LINEAR_____0_CM 1 100. 0. 255. DISPLAY_IDENTIFIER CTR_ABC_END_DIAG_BN_CAS ECU_ADDRESS 0x3fbab6 FORMAT "%3.0" /end MEASUREMENT
/begin MEASUREMENT fmy_stat_bn_cas.err_info_stat.lv_err_mem "" UBYTE _CNV_S_2_RANGE______21_CM 1 100. 0. 1. DISPLAY_IDENTIFIER LV_ERR_MEM_BN_CAS ECU_ADDRESS 0x3fbab5 BIT_MASK 0x80 /end MEASUREMENT
/begin MEASUREMENT fmy_stat_bn_cas.err_info_stat.lv_ready "" UBYTE _CNV_S_2_RANGE______21_CM 1 100. 0. 1. DISPLAY_IDENTIFIER LV_READY_BN_CAS ECU_ADDRESS 0x3fbab5 BIT_MASK 0x40 /end MEASUREMENT
/begin MEASUREMENT fmy_stat_bn_cas.err_info_stat.lv_end_diag "" UBYTE _CNV_S_2_RANGE______21_CM 1 100. 0. 1. DISPLAY_IDENTIFIER LV_END_DIAG_BN_CAS ECU_ADDRESS 0x3fbab5 BIT_MASK 0x20 /end MEASUREMENT
/begin MEASUREMENT fmy_stat_bn_cas.err_info_stat.lv_cdn_diag "" UBYTE _CNV_S_2_RANGE______21_CM 1 100. 0. 1. DISPLAY_IDENTIFIER LV_CDN_DIAG_BN_CAS ECU_ADDRESS 0x3fbab5 BIT_MASK 0x10 /end MEASUREMENT
/begin MEASUREMENT fmy_stat_bn_cas.err_info_stat.err_sym "" UBYTE _CNV_S_6_RANGE_ERR__193_CM 1 100. 0. 15. DISPLAY_IDENTIFIER ERR_SYM_BN_CAS ECU_ADDRESS 0x3fbab5 BIT_MASK 0xF /end MEASUREMENT
/begin MEASUREMENT fmy_stat_bn_tq_tcs.ctr_abc "" UBYTE _CNV_A_R_LINEAR_____0_CM 1 100. 0. 255. DISPLAY_IDENTIFIER CTR_ABC_BN_TQ_TCS ECU_ADDRESS 0x3fbabb FORMAT "%3.0" /end MEASUREMENT
/begin MEASUREMENT fmy_stat_bn_tq_tcs.ctr_end_diag "" UBYTE _CNV_A_R_LINEAR_____0_CM 1 100. 0. 255. DISPLAY_IDENTIFIER CTR_ABC_END_DIAG_BN_TQ_TCS ECU_ADDRESS 0x3fbaba FORMAT "%3.0" /end MEASUREMENT
/begin MEASUREMENT fmy_stat_bn_tq_tcs.err_info_stat.lv_err_mem "" UBYTE _CNV_S_2_RANGE______21_CM 1 100. 0. 1. DISPLAY_IDENTIFIER LV_ERR_MEM_BN_TQ_TCS ECU_ADDRESS 0x3fbab9 BIT_MASK 0x80 /end MEASUREMENT
/begin MEASUREMENT fmy_stat_bn_tq_tcs.err_info_stat.lv_ready "" UBYTE _CNV_S_2_RANGE______21_CM 1 100. 0. 1. DISPLAY_IDENTIFIER LV_READY_BN_TQ_TCS ECU_ADDRESS 0x3fbab9 BIT_MASK 0x40 /end MEASUREMENT
/begin MEASUREMENT fmy_stat_bn_tq_tcs.err_info_stat.lv_end_diag "" UBYTE _CNV_S_2_RANGE______21_CM 1 100. 0. 1. DISPLAY_IDENTIFIER LV_END_DIAG_BN_TQ_TCS ECU_ADDRESS 0x3fbab9 BIT_MASK 0x20 /end MEASUREMENT
/begin MEASUREMENT fmy_stat_bn_tq_tcs.err_info_stat.lv_cdn_diag "" UBYTE _CNV_S_2_RANGE______21_CM 1 100. 0. 1. DISPLAY_IDENTIFIER LV_CDN_DIAG_BN_TQ_TCS ECU_ADDRESS 0x3fbab9 BIT_MASK 0x10 /end MEASUREMENT
/begin MEASUREMENT fmy_stat_bn_tq_tcs.err_info_stat.err_sym "" UBYTE _CNV_S_6_RANGE_ERR__193_CM 1 100. 0. 15. DISPLAY_IDENTIFIER ERR_SYM_BN_TQ_TCS ECU_ADDRESS 0x3fbab9 BIT_MASK 0xF /end MEASUREMENT
/begin MEASUREMENT fmy_stat_bn_vs_tcs.ctr_abc "" UBYTE _CNV_A_R_LINEAR_____0_CM 1 100. 0. 255. DISPLAY_IDENTIFIER CTR_ABC_BN_VS_TCS ECU_ADDRESS 0x3fbabf FORMAT "%3.0" /end MEASUREMENT
/begin MEASUREMENT fmy_stat_bn_vs_tcs.ctr_end_diag "" UBYTE _CNV_A_R_LINEAR_____0_CM 1 100. 0. 255. DISPLAY_IDENTIFIER CTR_ABC_END_DIAG_BN_VS_TCS ECU_ADDRESS 0x3fbabe FORMAT "%3.0" /end MEASUREMENT
/begin MEASUREMENT fmy_stat_bn_vs_tcs.err_info_stat.lv_err_mem "" UBYTE _CNV_S_2_RANGE______21_CM 1 100. 0. 1. DISPLAY_IDENTIFIER LV_ERR_MEM_BN_VS_TCS ECU_ADDRESS 0x3fbabd BIT_MASK 0x80 /end MEASUREMENT
/begin MEASUREMENT fmy_stat_bn_vs_tcs.err_info_stat.lv_ready "" UBYTE _CNV_S_2_RANGE______21_CM 1 100. 0. 1. DISPLAY_IDENTIFIER LV_READY_BN_VS_TCS ECU_ADDRESS 0x3fbabd BIT_MASK 0x40 /end MEASUREMENT
/begin MEASUREMENT fmy_stat_bn_vs_tcs.err_info_stat.lv_end_diag "" UBYTE _CNV_S_2_RANGE______21_CM 1 100. 0. 1. DISPLAY_IDENTIFIER LV_END_DIAG_BN_VS_TCS ECU_ADDRESS 0x3fbabd BIT_MASK 0x20 /end MEASUREMENT
/begin MEASUREMENT fmy_stat_bn_vs_tcs.err_info_stat.lv_cdn_diag "" UBYTE _CNV_S_2_RANGE______21_CM 1 100. 0. 1. DISPLAY_IDENTIFIER LV_CDN_DIAG_BN_VS_TCS ECU_ADDRESS 0x3fbabd BIT_MASK 0x10 /end MEASUREMENT
/begin MEASUREMENT fmy_stat_bn_vs_tcs.err_info_stat.err_sym "" UBYTE _CNV_S_6_RANGE_ERR__193_CM 1 100. 0. 15. DISPLAY_IDENTIFIER ERR_SYM_BN_VS_TCS ECU_ADDRESS 0x3fbabd BIT_MASK 0xF /end MEASUREMENT
/begin MEASUREMENT fmy_stat_bn_tcs.ctr_abc "" UBYTE _CNV_A_R_LINEAR_____0_CM 1 100. 0. 255. DISPLAY_IDENTIFIER CTR_ABC_BN_TCS ECU_ADDRESS 0x3fbac3 FORMAT "%3.0" /end MEASUREMENT
/begin MEASUREMENT fmy_stat_bn_tcs.ctr_end_diag "" UBYTE _CNV_A_R_LINEAR_____0_CM 1 100. 0. 255. DISPLAY_IDENTIFIER CTR_ABC_END_DIAG_BN_TCS ECU_ADDRESS 0x3fbac2 FORMAT "%3.0" /end MEASUREMENT
/begin MEASUREMENT fmy_stat_bn_tcs.err_info_stat.lv_err_mem "" UBYTE _CNV_S_2_RANGE______21_CM 1 100. 0. 1. DISPLAY_IDENTIFIER LV_ERR_MEM_BN_TCS ECU_ADDRESS 0x3fbac1 BIT_MASK 0x80 /end MEASUREMENT
/begin MEASUREMENT fmy_stat_bn_tcs.err_info_stat.lv_ready "" UBYTE _CNV_S_2_RANGE______21_CM 1 100. 0. 1. DISPLAY_IDENTIFIER LV_READY_BN_TCS ECU_ADDRESS 0x3fbac1 BIT_MASK 0x40 /end MEASUREMENT
/begin MEASUREMENT fmy_stat_bn_tcs.err_info_stat.lv_end_diag "" UBYTE _CNV_S_2_RANGE______21_CM 1 100. 0. 1. DISPLAY_IDENTIFIER LV_END_DIAG_BN_TCS ECU_ADDRESS 0x3fbac1 BIT_MASK 0x20 /end MEASUREMENT
/begin MEASUREMENT fmy_stat_bn_tcs.err_info_stat.lv_cdn_diag "" UBYTE _CNV_S_2_RANGE______21_CM 1 100. 0. 1. DISPLAY_IDENTIFIER LV_CDN_DIAG_BN_TCS ECU_ADDRESS 0x3fbac1 BIT_MASK 0x10 /end MEASUREMENT
/begin MEASUREMENT fmy_stat_bn_tcs.err_info_stat.err_sym "" UBYTE _CNV_S_6_RANGE_ERR__193_CM 1 100. 0. 15. DISPLAY_IDENTIFIER ERR_SYM_BN_TCS ECU_ADDRESS 0x3fbac1 BIT_MASK 0xF /end MEASUREMENT
/begin MEASUREMENT fmy_stat_bn_tq_etcu.ctr_abc "" UBYTE _CNV_A_R_LINEAR_____0_CM 1 100. 0. 255. DISPLAY_IDENTIFIER CTR_ABC_BN_TQ_ETCU ECU_ADDRESS 0x3fbac7 FORMAT "%3.0" /end MEASUREMENT
/begin MEASUREMENT fmy_stat_bn_tq_etcu.ctr_end_diag "" UBYTE _CNV_A_R_LINEAR_____0_CM 1 100. 0. 255. DISPLAY_IDENTIFIER CTR_ABC_END_DIAG_BN_TQ_ETCU ECU_ADDRESS 0x3fbac6 FORMAT "%3.0" /end MEASUREMENT
/begin MEASUREMENT fmy_stat_bn_tq_etcu.err_info_stat.lv_err_mem "" UBYTE _CNV_S_2_RANGE______21_CM 1 100. 0. 1. DISPLAY_IDENTIFIER LV_ERR_MEM_BN_TQ_ETCU ECU_ADDRESS 0x3fbac5 BIT_MASK 0x80 /end MEASUREMENT
/begin MEASUREMENT fmy_stat_bn_tq_etcu.err_info_stat.lv_ready "" UBYTE _CNV_S_2_RANGE______21_CM 1 100. 0. 1. DISPLAY_IDENTIFIER LV_READY_BN_TQ_ETCU ECU_ADDRESS 0x3fbac5 BIT_MASK 0x40 /end MEASUREMENT
/begin MEASUREMENT fmy_stat_bn_tq_etcu.err_info_stat.lv_end_diag "" UBYTE _CNV_S_2_RANGE______21_CM 1 100. 0. 1. DISPLAY_IDENTIFIER LV_END_DIAG_BN_TQ_ETCU ECU_ADDRESS 0x3fbac5 BIT_MASK 0x20 /end MEASUREMENT
/begin MEASUREMENT fmy_stat_bn_tq_etcu.err_info_stat.lv_cdn_diag "" UBYTE _CNV_S_2_RANGE______21_CM 1 100. 0. 1. DISPLAY_IDENTIFIER LV_CDN_DIAG_BN_TQ_ETCU ECU_ADDRESS 0x3fbac5 BIT_MASK 0x10 /end MEASUREMENT
/begin MEASUREMENT fmy_stat_bn_tq_etcu.err_info_stat.err_sym "" UBYTE _CNV_S_6_RANGE_ERR__193_CM 1 100. 0. 15. DISPLAY_IDENTIFIER ERR_SYM_BN_TQ_ETCU ECU_ADDRESS 0x3fbac5 BIT_MASK 0xF /end MEASUREMENT
/begin MEASUREMENT fmy_stat_bn_etcu.ctr_abc "" UBYTE _CNV_A_R_LINEAR_____0_CM 1 100. 0. 255. DISPLAY_IDENTIFIER CTR_ABC_BN_ETCU ECU_ADDRESS 0x3fbacb FORMAT "%3.0" /end MEASUREMENT
/begin MEASUREMENT fmy_stat_bn_etcu.ctr_end_diag "" UBYTE _CNV_A_R_LINEAR_____0_CM 1 100. 0. 255. DISPLAY_IDENTIFIER CTR_ABC_END_DIAG_BN_ETCU ECU_ADDRESS 0x3fbaca FORMAT "%3.0" /end MEASUREMENT
/begin MEASUREMENT fmy_stat_bn_etcu.err_info_stat.lv_err_mem "" UBYTE _CNV_S_2_RANGE______21_CM 1 100. 0. 1. DISPLAY_IDENTIFIER LV_ERR_MEM_BN_ETCU ECU_ADDRESS 0x3fbac9 BIT_MASK 0x80 /end MEASUREMENT
/begin MEASUREMENT fmy_stat_bn_etcu.err_info_stat.lv_ready "" UBYTE _CNV_S_2_RANGE______21_CM 1 100. 0. 1. DISPLAY_IDENTIFIER LV_READY_BN_ETCU ECU_ADDRESS 0x3fbac9 BIT_MASK 0x40 /end MEASUREMENT
/begin MEASUREMENT fmy_stat_bn_etcu.err_info_stat.lv_end_diag "" UBYTE _CNV_S_2_RANGE______21_CM 1 100. 0. 1. DISPLAY_IDENTIFIER LV_END_DIAG_BN_ETCU ECU_ADDRESS 0x3fbac9 BIT_MASK 0x20 /end MEASUREMENT
/begin MEASUREMENT fmy_stat_bn_etcu.err_info_stat.lv_cdn_diag "" UBYTE _CNV_S_2_RANGE______21_CM 1 100. 0. 1. DISPLAY_IDENTIFIER LV_CDN_DIAG_BN_ETCU ECU_ADDRESS 0x3fbac9 BIT_MASK 0x10 /end MEASUREMENT
/begin MEASUREMENT fmy_stat_bn_etcu.err_info_stat.err_sym "" UBYTE _CNV_S_6_RANGE_ERR__193_CM 1 100. 0. 15. DISPLAY_IDENTIFIER ERR_SYM_BN_ETCU ECU_ADDRESS 0x3fbac9 BIT_MASK 0xF /end MEASUREMENT
/begin MEASUREMENT fmy_stat_bn_tq_amt.ctr_abc "" UBYTE _CNV_A_R_LINEAR_____0_CM 1 100. 0. 255. DISPLAY_IDENTIFIER CTR_ABC_BN_TQ_AMT ECU_ADDRESS 0x3fbacf FORMAT "%3.0" /end MEASUREMENT
/begin MEASUREMENT fmy_stat_bn_tq_amt.ctr_end_diag "" UBYTE _CNV_A_R_LINEAR_____0_CM 1 100. 0. 255. DISPLAY_IDENTIFIER CTR_ABC_END_DIAG_BN_TQ_AMT ECU_ADDRESS 0x3fbace FORMAT "%3.0" /end MEASUREMENT
/begin MEASUREMENT fmy_stat_bn_tq_amt.err_info_stat.lv_err_mem "" UBYTE _CNV_S_2_RANGE______21_CM 1 100. 0. 1. DISPLAY_IDENTIFIER LV_ERR_MEM_BN_TQ_AMT ECU_ADDRESS 0x3fbacd BIT_MASK 0x80 /end MEASUREMENT
/begin MEASUREMENT fmy_stat_bn_tq_amt.err_info_stat.lv_ready "" UBYTE _CNV_S_2_RANGE______21_CM 1 100. 0. 1. DISPLAY_IDENTIFIER LV_READY_BN_TQ_AMT ECU_ADDRESS 0x3fbacd BIT_MASK 0x40 /end MEASUREMENT
/begin MEASUREMENT fmy_stat_bn_tq_amt.err_info_stat.lv_end_diag "" UBYTE _CNV_S_2_RANGE______21_CM 1 100. 0. 1. DISPLAY_IDENTIFIER LV_END_DIAG_BN_TQ_AMT ECU_ADDRESS 0x3fbacd BIT_MASK 0x20 /end MEASUREMENT
/begin MEASUREMENT fmy_stat_bn_tq_amt.err_info_stat.lv_cdn_diag "" UBYTE _CNV_S_2_RANGE______21_CM 1 100. 0. 1. DISPLAY_IDENTIFIER LV_CDN_DIAG_BN_TQ_AMT ECU_ADDRESS 0x3fbacd BIT_MASK 0x10 /end MEASUREMENT
/begin MEASUREMENT fmy_stat_bn_tq_amt.err_info_stat.err_sym "" UBYTE _CNV_S_6_RANGE_ERR__193_CM 1 100. 0. 15. DISPLAY_IDENTIFIER ERR_SYM_BN_TQ_AMT ECU_ADDRESS 0x3fbacd BIT_MASK 0xF /end MEASUREMENT
/begin MEASUREMENT fmy_stat_bn_acc.ctr_abc "" UBYTE _CNV_A_R_LINEAR_____0_CM 1 100. 0. 255. DISPLAY_IDENTIFIER CTR_ABC_BN_ACC ECU_ADDRESS 0x3fbad3 FORMAT "%3.0" /end MEASUREMENT
/begin MEASUREMENT fmy_stat_bn_acc.ctr_end_diag "" UBYTE _CNV_A_R_LINEAR_____0_CM 1 100. 0. 255. DISPLAY_IDENTIFIER CTR_ABC_END_DIAG_BN_ACC ECU_ADDRESS 0x3fbad2 FORMAT "%3.0" /end MEASUREMENT
/begin MEASUREMENT fmy_stat_bn_acc.err_info_stat.lv_err_mem "" UBYTE _CNV_S_2_RANGE______21_CM 1 100. 0. 1. DISPLAY_IDENTIFIER LV_ERR_MEM_BN_ACC ECU_ADDRESS 0x3fbad1 BIT_MASK 0x80 /end MEASUREMENT
/begin MEASUREMENT fmy_stat_bn_acc.err_info_stat.lv_ready "" UBYTE _CNV_S_2_RANGE______21_CM 1 100. 0. 1. DISPLAY_IDENTIFIER LV_READY_BN_ACC ECU_ADDRESS 0x3fbad1 BIT_MASK 0x40 /end MEASUREMENT
/begin MEASUREMENT fmy_stat_bn_acc.err_info_stat.lv_end_diag "" UBYTE _CNV_S_2_RANGE______21_CM 1 100. 0. 1. DISPLAY_IDENTIFIER LV_END_DIAG_BN_ACC ECU_ADDRESS 0x3fbad1 BIT_MASK 0x20 /end MEASUREMENT
/begin MEASUREMENT fmy_stat_bn_acc.err_info_stat.lv_cdn_diag "" UBYTE _CNV_S_2_RANGE______21_CM 1 100. 0. 1. DISPLAY_IDENTIFIER LV_CDN_DIAG_BN_ACC ECU_ADDRESS 0x3fbad1 BIT_MASK 0x10 /end MEASUREMENT
/begin MEASUREMENT fmy_stat_bn_acc.err_info_stat.err_sym "" UBYTE _CNV_S_6_RANGE_ERR__193_CM 1 100. 0. 15. DISPLAY_IDENTIFIER ERR_SYM_BN_ACC ECU_ADDRESS 0x3fbad1 BIT_MASK 0xF /end MEASUREMENT
/begin MEASUREMENT fmy_stat_bn_t_icl.ctr_abc "" UBYTE _CNV_A_R_LINEAR_____0_CM 1 100. 0. 255. DISPLAY_IDENTIFIER CTR_ABC_BN_T_ICL ECU_ADDRESS 0x3fbad7 FORMAT "%3.0" /end MEASUREMENT
/begin MEASUREMENT fmy_stat_bn_t_icl.ctr_end_diag "" UBYTE _CNV_A_R_LINEAR_____0_CM 1 100. 0. 255. DISPLAY_IDENTIFIER CTR_ABC_END_DIAG_BN_T_ICL ECU_ADDRESS 0x3fbad6 FORMAT "%3.0" /end MEASUREMENT
/begin MEASUREMENT fmy_stat_bn_t_icl.err_info_stat.lv_err_mem "" UBYTE _CNV_S_2_RANGE______21_CM 1 100. 0. 1. DISPLAY_IDENTIFIER LV_ERR_MEM_BN_T_ICL ECU_ADDRESS 0x3fbad5 BIT_MASK 0x80 /end MEASUREMENT
/begin MEASUREMENT fmy_stat_bn_t_icl.err_info_stat.lv_ready "" UBYTE _CNV_S_2_RANGE______21_CM 1 100. 0. 1. DISPLAY_IDENTIFIER LV_READY_BN_T_ICL ECU_ADDRESS 0x3fbad5 BIT_MASK 0x40 /end MEASUREMENT
/begin MEASUREMENT fmy_stat_bn_t_icl.err_info_stat.lv_end_diag "" UBYTE _CNV_S_2_RANGE______21_CM 1 100. 0. 1. DISPLAY_IDENTIFIER LV_END_DIAG_BN_T_ICL ECU_ADDRESS 0x3fbad5 BIT_MASK 0x20 /end MEASUREMENT
/begin MEASUREMENT fmy_stat_bn_t_icl.err_info_stat.lv_cdn_diag "" UBYTE _CNV_S_2_RANGE______21_CM 1 100. 0. 1. DISPLAY_IDENTIFIER LV_CDN_DIAG_BN_T_ICL ECU_ADDRESS 0x3fbad5 BIT_MASK 0x10 /end MEASUREMENT
/begin MEASUREMENT fmy_stat_bn_t_icl.err_info_stat.err_sym "" UBYTE _CNV_S_6_RANGE_ERR__193_CM 1 100. 0. 15. DISPLAY_IDENTIFIER ERR_SYM_BN_T_ICL ECU_ADDRESS 0x3fbad5 BIT_MASK 0xF /end MEASUREMENT
/begin MEASUREMENT fmy_stat_bn_veh_mod.ctr_abc "" UBYTE _CNV_A_R_LINEAR_____0_CM 1 100. 0. 255. DISPLAY_IDENTIFIER CTR_ABC_BN_VEH_MOD ECU_ADDRESS 0x3fbadb FORMAT "%3.0" /end MEASUREMENT
/begin MEASUREMENT fmy_stat_bn_veh_mod.ctr_end_diag "" UBYTE _CNV_A_R_LINEAR_____0_CM 1 100. 0. 255. DISPLAY_IDENTIFIER CTR_ABC_END_DIAG_BN_VEH_MOD ECU_ADDRESS 0x3fbada FORMAT "%3.0" /end MEASUREMENT
/begin MEASUREMENT fmy_stat_bn_veh_mod.err_info_stat.lv_err_mem "" UBYTE _CNV_S_2_RANGE______21_CM 1 100. 0. 1. DISPLAY_IDENTIFIER LV_ERR_MEM_BN_VEH_MOD ECU_ADDRESS 0x3fbad9 BIT_MASK 0x80 /end MEASUREMENT
/begin MEASUREMENT fmy_stat_bn_veh_mod.err_info_stat.lv_ready "" UBYTE _CNV_S_2_RANGE______21_CM 1 100. 0. 1. DISPLAY_IDENTIFIER LV_READY_BN_VEH_MOD ECU_ADDRESS 0x3fbad9 BIT_MASK 0x40 /end MEASUREMENT
/begin MEASUREMENT fmy_stat_bn_veh_mod.err_info_stat.lv_end_diag "" UBYTE _CNV_S_2_RANGE______21_CM 1 100. 0. 1. DISPLAY_IDENTIFIER LV_END_DIAG_BN_VEH_MOD ECU_ADDRESS 0x3fbad9 BIT_MASK 0x20 /end MEASUREMENT
/begin MEASUREMENT fmy_stat_bn_veh_mod.err_info_stat.lv_cdn_diag "" UBYTE _CNV_S_2_RANGE______21_CM 1 100. 0. 1. DISPLAY_IDENTIFIER LV_CDN_DIAG_BN_VEH_MOD ECU_ADDRESS 0x3fbad9 BIT_MASK 0x10 /end MEASUREMENT
/begin MEASUREMENT fmy_stat_bn_veh_mod.err_info_stat.err_sym "" UBYTE _CNV_S_6_RANGE_ERR__193_CM 1 100. 0. 15. DISPLAY_IDENTIFIER ERR_SYM_BN_VEH_MOD ECU_ADDRESS 0x3fbad9 BIT_MASK 0xF /end MEASUREMENT
/begin MEASUREMENT fmy_stat_bn_km_icl.ctr_abc "" UBYTE _CNV_A_R_LINEAR_____0_CM 1 100. 0. 255. DISPLAY_IDENTIFIER CTR_ABC_BN_KM_ICL ECU_ADDRESS 0x3fbadf FORMAT "%3.0" /end MEASUREMENT
/begin MEASUREMENT fmy_stat_bn_km_icl.ctr_end_diag "" UBYTE _CNV_A_R_LINEAR_____0_CM 1 100. 0. 255. DISPLAY_IDENTIFIER CTR_ABC_END_DIAG_BN_KM_ICL ECU_ADDRESS 0x3fbade FORMAT "%3.0" /end MEASUREMENT
/begin MEASUREMENT fmy_stat_bn_km_icl.err_info_stat.lv_err_mem "" UBYTE _CNV_S_2_RANGE______21_CM 1 100. 0. 1. DISPLAY_IDENTIFIER LV_ERR_MEM_BN_KM_ICL ECU_ADDRESS 0x3fbadd BIT_MASK 0x80 /end MEASUREMENT
/begin MEASUREMENT fmy_stat_bn_km_icl.err_info_stat.lv_ready "" UBYTE _CNV_S_2_RANGE______21_CM 1 100. 0. 1. DISPLAY_IDENTIFIER LV_READY_BN_KM_ICL ECU_ADDRESS 0x3fbadd BIT_MASK 0x40 /end MEASUREMENT
/begin MEASUREMENT fmy_stat_bn_km_icl.err_info_stat.lv_end_diag "" UBYTE _CNV_S_2_RANGE______21_CM 1 100. 0. 1. DISPLAY_IDENTIFIER LV_END_DIAG_BN_KM_ICL ECU_ADDRESS 0x3fbadd BIT_MASK 0x20 /end MEASUREMENT
/begin MEASUREMENT fmy_stat_bn_km_icl.err_info_stat.lv_cdn_diag "" UBYTE _CNV_S_2_RANGE______21_CM 1 100. 0. 1. DISPLAY_IDENTIFIER LV_CDN_DIAG_BN_KM_ICL ECU_ADDRESS 0x3fbadd BIT_MASK 0x10 /end MEASUREMENT
/begin MEASUREMENT fmy_stat_bn_km_icl.err_info_stat.err_sym "" UBYTE _CNV_S_6_RANGE_ERR__193_CM 1 100. 0. 15. DISPLAY_IDENTIFIER ERR_SYM_BN_KM_ICL ECU_ADDRESS 0x3fbadd BIT_MASK 0xF /end MEASUREMENT
/begin MEASUREMENT fmy_stat_bn_icl.ctr_abc "" UBYTE _CNV_A_R_LINEAR_____0_CM 1 100. 0. 255. DISPLAY_IDENTIFIER CTR_ABC_BN_ICL ECU_ADDRESS 0x3fbae3 FORMAT "%3.0" /end MEASUREMENT
/begin MEASUREMENT fmy_stat_bn_icl.ctr_end_diag "" UBYTE _CNV_A_R_LINEAR_____0_CM 1 100. 0. 255. DISPLAY_IDENTIFIER CTR_ABC_END_DIAG_BN_ICL ECU_ADDRESS 0x3fbae2 FORMAT "%3.0" /end MEASUREMENT
/begin MEASUREMENT fmy_stat_bn_icl.err_info_stat.lv_err_mem "" UBYTE _CNV_S_2_RANGE______21_CM 1 100. 0. 1. DISPLAY_IDENTIFIER LV_ERR_MEM_BN_ICL ECU_ADDRESS 0x3fbae1 BIT_MASK 0x80 /end MEASUREMENT
/begin MEASUREMENT fmy_stat_bn_icl.err_info_stat.lv_ready "" UBYTE _CNV_S_2_RANGE______21_CM 1 100. 0. 1. DISPLAY_IDENTIFIER LV_READY_BN_ICL ECU_ADDRESS 0x3fbae1 BIT_MASK 0x40 /end MEASUREMENT
/begin MEASUREMENT fmy_stat_bn_icl.err_info_stat.lv_end_diag "" UBYTE _CNV_S_2_RANGE______21_CM 1 100. 0. 1. DISPLAY_IDENTIFIER LV_END_DIAG_BN_ICL ECU_ADDRESS 0x3fbae1 BIT_MASK 0x20 /end MEASUREMENT
/begin MEASUREMENT fmy_stat_bn_icl.err_info_stat.lv_cdn_diag "" UBYTE _CNV_S_2_RANGE______21_CM 1 100. 0. 1. DISPLAY_IDENTIFIER LV_CDN_DIAG_BN_ICL ECU_ADDRESS 0x3fbae1 BIT_MASK 0x10 /end MEASUREMENT
/begin MEASUREMENT fmy_stat_bn_icl.err_info_stat.err_sym "" UBYTE _CNV_S_6_RANGE_ERR__193_CM 1 100. 0. 15. DISPLAY_IDENTIFIER ERR_SYM_BN_ICL ECU_ADDRESS 0x3fbae1 BIT_MASK 0xF /end MEASUREMENT
/begin MEASUREMENT fmy_stat_bn_pow_vb.ctr_abc "" UBYTE _CNV_A_R_LINEAR_____0_CM 1 100. 0. 255. DISPLAY_IDENTIFIER CTR_ABC_BN_POW_VB ECU_ADDRESS 0x3fbae7 FORMAT "%3.0" /end MEASUREMENT
/begin MEASUREMENT fmy_stat_bn_pow_vb.ctr_end_diag "" UBYTE _CNV_A_R_LINEAR_____0_CM 1 100. 0. 255. DISPLAY_IDENTIFIER CTR_ABC_END_DIAG_BN_POW_VB ECU_ADDRESS 0x3fbae6 FORMAT "%3.0" /end MEASUREMENT
/begin MEASUREMENT fmy_stat_bn_pow_vb.err_info_stat.lv_err_mem "" UBYTE _CNV_S_2_RANGE______21_CM 1 100. 0. 1. DISPLAY_IDENTIFIER LV_ERR_MEM_BN_POW_VB ECU_ADDRESS 0x3fbae5 BIT_MASK 0x80 /end MEASUREMENT
/begin MEASUREMENT fmy_stat_bn_pow_vb.err_info_stat.lv_ready "" UBYTE _CNV_S_2_RANGE______21_CM 1 100. 0. 1. DISPLAY_IDENTIFIER LV_READY_BN_POW_VB ECU_ADDRESS 0x3fbae5 BIT_MASK 0x40 /end MEASUREMENT
/begin MEASUREMENT fmy_stat_bn_pow_vb.err_info_stat.lv_end_diag "" UBYTE _CNV_S_2_RANGE______21_CM 1 100. 0. 1. DISPLAY_IDENTIFIER LV_END_DIAG_BN_POW_VB ECU_ADDRESS 0x3fbae5 BIT_MASK 0x20 /end MEASUREMENT
/begin MEASUREMENT fmy_stat_bn_pow_vb.err_info_stat.lv_cdn_diag "" UBYTE _CNV_S_2_RANGE______21_CM 1 100. 0. 1. DISPLAY_IDENTIFIER LV_CDN_DIAG_BN_POW_VB ECU_ADDRESS 0x3fbae5 BIT_MASK 0x10 /end MEASUREMENT
/begin MEASUREMENT fmy_stat_bn_pow_vb.err_info_stat.err_sym "" UBYTE _CNV_S_6_RANGE_ERR__193_CM 1 100. 0. 15. DISPLAY_IDENTIFIER ERR_SYM_BN_POW_VB ECU_ADDRESS 0x3fbae5 BIT_MASK 0xF /end MEASUREMENT
/begin MEASUREMENT fmy_stat_bn_pow_gen.ctr_abc "" UBYTE _CNV_A_R_LINEAR_____0_CM 1 100. 0. 255. DISPLAY_IDENTIFIER CTR_ABC_BN_POW_GEN ECU_ADDRESS 0x3fbaeb FORMAT "%3.0" /end MEASUREMENT
/begin MEASUREMENT fmy_stat_bn_pow_gen.ctr_end_diag "" UBYTE _CNV_A_R_LINEAR_____0_CM 1 100. 0. 255. DISPLAY_IDENTIFIER CTR_ABC_END_DIAG_BN_POW_GEN ECU_ADDRESS 0x3fbaea FORMAT "%3.0" /end MEASUREMENT
/begin MEASUREMENT fmy_stat_bn_pow_gen.err_info_stat.lv_err_mem "" UBYTE _CNV_S_2_RANGE______21_CM 1 100. 0. 1. DISPLAY_IDENTIFIER LV_ERR_MEM_BN_POW_GEN ECU_ADDRESS 0x3fbae9 BIT_MASK 0x80 /end MEASUREMENT
/begin MEASUREMENT fmy_stat_bn_pow_gen.err_info_stat.lv_ready "" UBYTE _CNV_S_2_RANGE______21_CM 1 100. 0. 1. DISPLAY_IDENTIFIER LV_READY_BN_POW_GEN ECU_ADDRESS 0x3fbae9 BIT_MASK 0x40 /end MEASUREMENT
/begin MEASUREMENT fmy_stat_bn_pow_gen.err_info_stat.lv_end_diag "" UBYTE _CNV_S_2_RANGE______21_CM 1 100. 0. 1. DISPLAY_IDENTIFIER LV_END_DIAG_BN_POW_GEN ECU_ADDRESS 0x3fbae9 BIT_MASK 0x20 /end MEASUREMENT
/begin MEASUREMENT fmy_stat_bn_pow_gen.err_info_stat.lv_cdn_diag "" UBYTE _CNV_S_2_RANGE______21_CM 1 100. 0. 1. DISPLAY_IDENTIFIER LV_CDN_DIAG_BN_POW_GEN ECU_ADDRESS 0x3fbae9 BIT_MASK 0x10 /end MEASUREMENT
/begin MEASUREMENT fmy_stat_bn_pow_gen.err_info_stat.err_sym "" UBYTE _CNV_S_6_RANGE_ERR__193_CM 1 100. 0. 15. DISPLAY_IDENTIFIER ERR_SYM_BN_POW_GEN ECU_ADDRESS 0x3fbae9 BIT_MASK 0xF /end MEASUREMENT
/begin MEASUREMENT fmy_stat_bn_msw.ctr_abc "" UBYTE _CNV_A_R_LINEAR_____0_CM 1 100. 0. 255. DISPLAY_IDENTIFIER CTR_ABC_BN_MSW ECU_ADDRESS 0x3fbaef FORMAT "%3.0" /end MEASUREMENT
/begin MEASUREMENT fmy_stat_bn_msw.ctr_end_diag "" UBYTE _CNV_A_R_LINEAR_____0_CM 1 100. 0. 255. DISPLAY_IDENTIFIER CTR_ABC_END_DIAG_BN_MSW ECU_ADDRESS 0x3fbaee FORMAT "%3.0" /end MEASUREMENT
/begin MEASUREMENT fmy_stat_bn_msw.err_info_stat.lv_err_mem "" UBYTE _CNV_S_2_RANGE______21_CM 1 100. 0. 1. DISPLAY_IDENTIFIER LV_ERR_MEM_BN_MSW ECU_ADDRESS 0x3fbaed BIT_MASK 0x80 /end MEASUREMENT
/begin MEASUREMENT fmy_stat_bn_msw.err_info_stat.lv_ready "" UBYTE _CNV_S_2_RANGE______21_CM 1 100. 0. 1. DISPLAY_IDENTIFIER LV_READY_BN_MSW ECU_ADDRESS 0x3fbaed BIT_MASK 0x40 /end MEASUREMENT
/begin MEASUREMENT fmy_stat_bn_msw.err_info_stat.lv_end_diag "" UBYTE _CNV_S_2_RANGE______21_CM 1 100. 0. 1. DISPLAY_IDENTIFIER LV_END_DIAG_BN_MSW ECU_ADDRESS 0x3fbaed BIT_MASK 0x20 /end MEASUREMENT
/begin MEASUREMENT fmy_stat_bn_msw.err_info_stat.lv_cdn_diag "" UBYTE _CNV_S_2_RANGE______21_CM 1 100. 0. 1. DISPLAY_IDENTIFIER LV_CDN_DIAG_BN_MSW ECU_ADDRESS 0x3fbaed BIT_MASK 0x10 /end MEASUREMENT
/begin MEASUREMENT fmy_stat_bn_msw.err_info_stat.err_sym "" UBYTE _CNV_S_6_RANGE_ERR__193_CM 1 100. 0. 15. DISPLAY_IDENTIFIER ERR_SYM_BN_MSW ECU_ADDRESS 0x3fbaed BIT_MASK 0xF /end MEASUREMENT
/begin MEASUREMENT fmy_stat_bn_ang_pste.ctr_abc "" UBYTE _CNV_A_R_LINEAR_____0_CM 1 100. 0. 255. DISPLAY_IDENTIFIER CTR_ABC_BN_ANG_PSTE ECU_ADDRESS 0x3fbaf3 FORMAT "%3.0" /end MEASUREMENT
/begin MEASUREMENT fmy_stat_bn_ang_pste.ctr_end_diag "" UBYTE _CNV_A_R_LINEAR_____0_CM 1 100. 0. 255. DISPLAY_IDENTIFIER CTR_ABC_END_DIAG_BN_ANG_PSTE ECU_ADDRESS 0x3fbaf2 FORMAT "%3.0" /end MEASUREMENT
/begin MEASUREMENT fmy_stat_bn_ang_pste.err_info_stat.lv_err_mem "" UBYTE _CNV_S_2_RANGE______21_CM 1 100. 0. 1. DISPLAY_IDENTIFIER LV_ERR_MEM_BN_ANG_PSTE ECU_ADDRESS 0x3fbaf1 BIT_MASK 0x80 /end MEASUREMENT
/begin MEASUREMENT fmy_stat_bn_ang_pste.err_info_stat.lv_ready "" UBYTE _CNV_S_2_RANGE______21_CM 1 100. 0. 1. DISPLAY_IDENTIFIER LV_READY_BN_ANG_PSTE ECU_ADDRESS 0x3fbaf1 BIT_MASK 0x40 /end MEASUREMENT
/begin MEASUREMENT fmy_stat_bn_ang_pste.err_info_stat.lv_end_diag "" UBYTE _CNV_S_2_RANGE______21_CM 1 100. 0. 1. DISPLAY_IDENTIFIER LV_END_DIAG_BN_ANG_PSTE ECU_ADDRESS 0x3fbaf1 BIT_MASK 0x20 /end MEASUREMENT
/begin MEASUREMENT fmy_stat_bn_ang_pste.err_info_stat.lv_cdn_diag "" UBYTE _CNV_S_2_RANGE______21_CM 1 100. 0. 1. DISPLAY_IDENTIFIER LV_CDN_DIAG_BN_ANG_PSTE ECU_ADDRESS 0x3fbaf1 BIT_MASK 0x10 /end MEASUREMENT
/begin MEASUREMENT fmy_stat_bn_ang_pste.err_info_stat.err_sym "" UBYTE _CNV_S_6_RANGE_ERR__193_CM 1 100. 0. 15. DISPLAY_IDENTIFIER ERR_SYM_BN_ANG_PSTE ECU_ADDRESS 0x3fbaf1 BIT_MASK 0xF /end MEASUREMENT
/begin MEASUREMENT fmy_stat_bn_efp.ctr_abc "" UBYTE _CNV_A_R_LINEAR_____0_CM 1 100. 0. 255. DISPLAY_IDENTIFIER CTR_ABC_BN_EFP ECU_ADDRESS 0x3fbaf7 FORMAT "%3.0" /end MEASUREMENT
/begin MEASUREMENT fmy_stat_bn_efp.ctr_end_diag "" UBYTE _CNV_A_R_LINEAR_____0_CM 1 100. 0. 255. DISPLAY_IDENTIFIER CTR_ABC_END_DIAG_BN_EFP ECU_ADDRESS 0x3fbaf6 FORMAT "%3.0" /end MEASUREMENT
/begin MEASUREMENT fmy_stat_bn_efp.err_info_stat.lv_err_mem "" UBYTE _CNV_S_2_RANGE______21_CM 1 100. 0. 1. DISPLAY_IDENTIFIER LV_ERR_MEM_BN_EFP ECU_ADDRESS 0x3fbaf5 BIT_MASK 0x80 /end MEASUREMENT
/begin MEASUREMENT fmy_stat_bn_efp.err_info_stat.lv_ready "" UBYTE _CNV_S_2_RANGE______21_CM 1 100. 0. 1. DISPLAY_IDENTIFIER LV_READY_BN_EFP ECU_ADDRESS 0x3fbaf5 BIT_MASK 0x40 /end MEASUREMENT
/begin MEASUREMENT fmy_stat_bn_efp.err_info_stat.lv_end_diag "" UBYTE _CNV_S_2_RANGE______21_CM 1 100. 0. 1. DISPLAY_IDENTIFIER LV_END_DIAG_BN_EFP ECU_ADDRESS 0x3fbaf5 BIT_MASK 0x20 /end MEASUREMENT
/begin MEASUREMENT fmy_stat_bn_efp.err_info_stat.lv_cdn_diag "" UBYTE _CNV_S_2_RANGE______21_CM 1 100. 0. 1. DISPLAY_IDENTIFIER LV_CDN_DIAG_BN_EFP ECU_ADDRESS 0x3fbaf5 BIT_MASK 0x10 /end MEASUREMENT
/begin MEASUREMENT fmy_stat_bn_efp.err_info_stat.err_sym "" UBYTE _CNV_S_6_RANGE_ERR__193_CM 1 100. 0. 15. DISPLAY_IDENTIFIER ERR_SYM_BN_EFP ECU_ADDRESS 0x3fbaf5 BIT_MASK 0xF /end MEASUREMENT
/begin MEASUREMENT fmy_stat_load_tps_plaus.ctr_abc "" UBYTE _CNV_A_R_LINEAR_____0_CM 1 100. 0. 255. DISPLAY_IDENTIFIER CTR_ABC_LOAD_TPS_PLAUS ECU_ADDRESS 0x3fbafb FORMAT "%3.0" /end MEASUREMENT
/begin MEASUREMENT fmy_stat_load_tps_plaus.ctr_end_diag "" UBYTE _CNV_A_R_LINEAR_____0_CM 1 100. 0. 255. DISPLAY_IDENTIFIER CTR_ABC_END_DIAG_LOAD_TPS_PLAUS ECU_ADDRESS 0x3fbafa FORMAT "%3.0" /end MEASUREMENT
/begin MEASUREMENT fmy_stat_load_tps_plaus.err_info_stat.lv_err_mem "" UBYTE _CNV_S_2_RANGE______21_CM 1 100. 0. 1. DISPLAY_IDENTIFIER LV_ERR_MEM_LOAD_TPS_PLAUS ECU_ADDRESS 0x3fbaf9 BIT_MASK 0x80 /end MEASUREMENT
/begin MEASUREMENT fmy_stat_load_tps_plaus.err_info_stat.lv_ready "" UBYTE _CNV_S_2_RANGE______21_CM 1 100. 0. 1. DISPLAY_IDENTIFIER LV_READY_LOAD_TPS_PLAUS ECU_ADDRESS 0x3fbaf9 BIT_MASK 0x40 /end MEASUREMENT
/begin MEASUREMENT fmy_stat_load_tps_plaus.err_info_stat.lv_end_diag "" UBYTE _CNV_S_2_RANGE______21_CM 1 100. 0. 1. DISPLAY_IDENTIFIER LV_END_DIAG_LOAD_TPS_PLAUS ECU_ADDRESS 0x3fbaf9 BIT_MASK 0x20 /end MEASUREMENT
/begin MEASUREMENT fmy_stat_load_tps_plaus.err_info_stat.lv_cdn_diag "" UBYTE _CNV_S_2_RANGE______21_CM 1 100. 0. 1. DISPLAY_IDENTIFIER LV_CDN_DIAG_LOAD_TPS_PLAUS ECU_ADDRESS 0x3fbaf9 BIT_MASK 0x10 /end MEASUREMENT
/begin MEASUREMENT fmy_stat_load_tps_plaus.err_info_stat.err_sym "" UBYTE _CNV_S_6_RANGE_ERR__193_CM 1 100. 0. 15. DISPLAY_IDENTIFIER ERR_SYM_LOAD_TPS_PLAUS ECU_ADDRESS 0x3fbaf9 BIT_MASK 0xF /end MEASUREMENT
/begin MEASUREMENT fmy_stat_efp_crash.ctr_abc "" UBYTE _CNV_A_R_LINEAR_____0_CM 1 100. 0. 255. DISPLAY_IDENTIFIER CTR_ABC_EFP_CRASH ECU_ADDRESS 0x3fbaff FORMAT "%3.0" /end MEASUREMENT
/begin MEASUREMENT fmy_stat_efp_crash.ctr_end_diag "" UBYTE _CNV_A_R_LINEAR_____0_CM 1 100. 0. 255. DISPLAY_IDENTIFIER CTR_ABC_END_DIAG_EFP_CRASH ECU_ADDRESS 0x3fbafe FORMAT "%3.0" /end MEASUREMENT
/begin MEASUREMENT fmy_stat_efp_crash.err_info_stat.lv_err_mem "" UBYTE _CNV_S_2_RANGE______21_CM 1 100. 0. 1. DISPLAY_IDENTIFIER LV_ERR_MEM_EFP_CRASH ECU_ADDRESS 0x3fbafd BIT_MASK 0x80 /end MEASUREMENT
/begin MEASUREMENT fmy_stat_efp_crash.err_info_stat.lv_ready "" UBYTE _CNV_S_2_RANGE______21_CM 1 100. 0. 1. DISPLAY_IDENTIFIER LV_READY_EFP_CRASH ECU_ADDRESS 0x3fbafd BIT_MASK 0x40 /end MEASUREMENT
/begin MEASUREMENT fmy_stat_efp_crash.err_info_stat.lv_end_diag "" UBYTE _CNV_S_2_RANGE______21_CM 1 100. 0. 1. DISPLAY_IDENTIFIER LV_END_DIAG_EFP_CRASH ECU_ADDRESS 0x3fbafd BIT_MASK 0x20 /end MEASUREMENT
/begin MEASUREMENT fmy_stat_efp_crash.err_info_stat.lv_cdn_diag "" UBYTE _CNV_S_2_RANGE______21_CM 1 100. 0. 1. DISPLAY_IDENTIFIER LV_CDN_DIAG_EFP_CRASH ECU_ADDRESS 0x3fbafd BIT_MASK 0x10 /end MEASUREMENT
/begin MEASUREMENT fmy_stat_efp_crash.err_info_stat.err_sym "" UBYTE _CNV_S_6_RANGE_ERR__193_CM 1 100. 0. 15. DISPLAY_IDENTIFIER ERR_SYM_EFP_CRASH ECU_ADDRESS 0x3fbafd BIT_MASK 0xF /end MEASUREMENT
/begin MEASUREMENT fmy_stat_efp.ctr_abc "" UBYTE _CNV_A_R_LINEAR_____0_CM 1 100. 0. 255. DISPLAY_IDENTIFIER CTR_ABC_EFP ECU_ADDRESS 0x3fbb03 FORMAT "%3.0" /end MEASUREMENT
/begin MEASUREMENT fmy_stat_efp.ctr_end_diag "" UBYTE _CNV_A_R_LINEAR_____0_CM 1 100. 0. 255. DISPLAY_IDENTIFIER CTR_ABC_END_DIAG_EFP ECU_ADDRESS 0x3fbb02 FORMAT "%3.0" /end MEASUREMENT
/begin MEASUREMENT fmy_stat_efp.err_info_stat.lv_err_mem "" UBYTE _CNV_S_2_RANGE______21_CM 1 100. 0. 1. DISPLAY_IDENTIFIER LV_ERR_MEM_EFP ECU_ADDRESS 0x3fbb01 BIT_MASK 0x80 /end MEASUREMENT
/begin MEASUREMENT fmy_stat_efp.err_info_stat.lv_ready "" UBYTE _CNV_S_2_RANGE______21_CM 1 100. 0. 1. DISPLAY_IDENTIFIER LV_READY_EFP ECU_ADDRESS 0x3fbb01 BIT_MASK 0x40 /end MEASUREMENT
/begin MEASUREMENT fmy_stat_efp.err_info_stat.lv_end_diag "" UBYTE _CNV_S_2_RANGE______21_CM 1 100. 0. 1. DISPLAY_IDENTIFIER LV_END_DIAG_EFP ECU_ADDRESS 0x3fbb01 BIT_MASK 0x20 /end MEASUREMENT
/begin MEASUREMENT fmy_stat_efp.err_info_stat.lv_cdn_diag "" UBYTE _CNV_S_2_RANGE______21_CM 1 100. 0. 1. DISPLAY_IDENTIFIER LV_CDN_DIAG_EFP ECU_ADDRESS 0x3fbb01 BIT_MASK 0x10 /end MEASUREMENT
/begin MEASUREMENT fmy_stat_efp.err_info_stat.err_sym "" UBYTE _CNV_S_6_RANGE_ERR__193_CM 1 100. 0. 15. DISPLAY_IDENTIFIER ERR_SYM_EFP ECU_ADDRESS 0x3fbb01 BIT_MASK 0xF /end MEASUREMENT
/begin MEASUREMENT fmy_stat_locan_boff.ctr_abc "" UBYTE _CNV_A_R_LINEAR_____0_CM 1 100. 0. 255. DISPLAY_IDENTIFIER CTR_ABC_LOCAN_BOFF ECU_ADDRESS 0x3fbb07 FORMAT "%3.0" /end MEASUREMENT
/begin MEASUREMENT fmy_stat_locan_boff.ctr_end_diag "" UBYTE _CNV_A_R_LINEAR_____0_CM 1 100. 0. 255. DISPLAY_IDENTIFIER CTR_ABC_END_DIAG_LOCAN_BOFF ECU_ADDRESS 0x3fbb06 FORMAT "%3.0" /end MEASUREMENT
/begin MEASUREMENT fmy_stat_locan_boff.err_info_stat.lv_err_mem "" UBYTE _CNV_S_2_RANGE______21_CM 1 100. 0. 1. DISPLAY_IDENTIFIER LV_ERR_MEM_LOCAN_BOFF ECU_ADDRESS 0x3fbb05 BIT_MASK 0x80 /end MEASUREMENT
/begin MEASUREMENT fmy_stat_locan_boff.err_info_stat.lv_ready "" UBYTE _CNV_S_2_RANGE______21_CM 1 100. 0. 1. DISPLAY_IDENTIFIER LV_READY_LOCAN_BOFF ECU_ADDRESS 0x3fbb05 BIT_MASK 0x40 /end MEASUREMENT
/begin MEASUREMENT fmy_stat_locan_boff.err_info_stat.lv_end_diag "" UBYTE _CNV_S_2_RANGE______21_CM 1 100. 0. 1. DISPLAY_IDENTIFIER LV_END_DIAG_LOCAN_BOFF ECU_ADDRESS 0x3fbb05 BIT_MASK 0x20 /end MEASUREMENT
/begin MEASUREMENT fmy_stat_locan_boff.err_info_stat.lv_cdn_diag "" UBYTE _CNV_S_2_RANGE______21_CM 1 100. 0. 1. DISPLAY_IDENTIFIER LV_CDN_DIAG_LOCAN_BOFF ECU_ADDRESS 0x3fbb05 BIT_MASK 0x10 /end MEASUREMENT
/begin MEASUREMENT fmy_stat_locan_boff.err_info_stat.err_sym "" UBYTE _CNV_S_6_RANGE_ERR__193_CM 1 100. 0. 15. DISPLAY_IDENTIFIER ERR_SYM_LOCAN_BOFF ECU_ADDRESS 0x3fbb05 BIT_MASK 0xF /end MEASUREMENT
/begin MEASUREMENT fmy_stat_chg_ls_up.ctr_abc "" UBYTE _CNV_A_R_LINEAR_____0_CM 1 100. 0. 255. DISPLAY_IDENTIFIER CTR_ABC_CHG_LS_UP ECU_ADDRESS 0x3fbb0b FORMAT "%3.0" /end MEASUREMENT
/begin MEASUREMENT fmy_stat_chg_ls_up.ctr_end_diag "" UBYTE _CNV_A_R_LINEAR_____0_CM 1 100. 0. 255. DISPLAY_IDENTIFIER CTR_ABC_END_DIAG_CHG_LS_UP ECU_ADDRESS 0x3fbb0a FORMAT "%3.0" /end MEASUREMENT
/begin MEASUREMENT fmy_stat_chg_ls_up.err_info_stat.lv_err_mem "" UBYTE _CNV_S_2_RANGE______21_CM 1 100. 0. 1. DISPLAY_IDENTIFIER LV_ERR_MEM_CHG_LS_UP ECU_ADDRESS 0x3fbb09 BIT_MASK 0x80 /end MEASUREMENT
/begin MEASUREMENT fmy_stat_chg_ls_up.err_info_stat.lv_ready "" UBYTE _CNV_S_2_RANGE______21_CM 1 100. 0. 1. DISPLAY_IDENTIFIER LV_READY_CHG_LS_UP ECU_ADDRESS 0x3fbb09 BIT_MASK 0x40 /end MEASUREMENT
/begin MEASUREMENT fmy_stat_chg_ls_up.err_info_stat.lv_end_diag "" UBYTE _CNV_S_2_RANGE______21_CM 1 100. 0. 1. DISPLAY_IDENTIFIER LV_END_DIAG_CHG_LS_UP ECU_ADDRESS 0x3fbb09 BIT_MASK 0x20 /end MEASUREMENT
/begin MEASUREMENT fmy_stat_chg_ls_up.err_info_stat.lv_cdn_diag "" UBYTE _CNV_S_2_RANGE______21_CM 1 100. 0. 1. DISPLAY_IDENTIFIER LV_CDN_DIAG_CHG_LS_UP ECU_ADDRESS 0x3fbb09 BIT_MASK 0x10 /end MEASUREMENT
/begin MEASUREMENT fmy_stat_chg_ls_up.err_info_stat.err_sym "" UBYTE _CNV_S_6_RANGE_ERR__193_CM 1 100. 0. 15. DISPLAY_IDENTIFIER ERR_SYM_CHG_LS_UP ECU_ADDRESS 0x3fbb09 BIT_MASK 0xF /end MEASUREMENT
/begin MEASUREMENT fmy_stat_chg_ls_down.ctr_abc "" UBYTE _CNV_A_R_LINEAR_____0_CM 1 100. 0. 255. DISPLAY_IDENTIFIER CTR_ABC_CHG_LS_DOWN ECU_ADDRESS 0x3fbb0f FORMAT "%3.0" /end MEASUREMENT
/begin MEASUREMENT fmy_stat_chg_ls_down.ctr_end_diag "" UBYTE _CNV_A_R_LINEAR_____0_CM 1 100. 0. 255. DISPLAY_IDENTIFIER CTR_ABC_END_DIAG_CHG_LS_DOWN ECU_ADDRESS 0x3fbb0e FORMAT "%3.0" /end MEASUREMENT
/begin MEASUREMENT fmy_stat_chg_ls_down.err_info_stat.lv_err_mem "" UBYTE _CNV_S_2_RANGE______21_CM 1 100. 0. 1. DISPLAY_IDENTIFIER LV_ERR_MEM_CHG_LS_DOWN ECU_ADDRESS 0x3fbb0d BIT_MASK 0x80 /end MEASUREMENT
/begin MEASUREMENT fmy_stat_chg_ls_down.err_info_stat.lv_ready "" UBYTE _CNV_S_2_RANGE______21_CM 1 100. 0. 1. DISPLAY_IDENTIFIER LV_READY_CHG_LS_DOWN ECU_ADDRESS 0x3fbb0d BIT_MASK 0x40 /end MEASUREMENT
/begin MEASUREMENT fmy_stat_chg_ls_down.err_info_stat.lv_end_diag "" UBYTE _CNV_S_2_RANGE______21_CM 1 100. 0. 1. DISPLAY_IDENTIFIER LV_END_DIAG_CHG_LS_DOWN ECU_ADDRESS 0x3fbb0d BIT_MASK 0x20 /end MEASUREMENT
/begin MEASUREMENT fmy_stat_chg_ls_down.err_info_stat.lv_cdn_diag "" UBYTE _CNV_S_2_RANGE______21_CM 1 100. 0. 1. DISPLAY_IDENTIFIER LV_CDN_DIAG_CHG_LS_DOWN ECU_ADDRESS 0x3fbb0d BIT_MASK 0x10 /end MEASUREMENT
/begin MEASUREMENT fmy_stat_chg_ls_down.err_info_stat.err_sym "" UBYTE _CNV_S_6_RANGE_ERR__193_CM 1 100. 0. 15. DISPLAY_IDENTIFIER ERR_SYM_CHG_LS_DOWN ECU_ADDRESS 0x3fbb0d BIT_MASK 0xF /end MEASUREMENT
/begin MEASUREMENT fmy_stat_qoil_sens.ctr_abc "" UBYTE _CNV_A_R_LINEAR_____0_CM 1 100. 0. 255. DISPLAY_IDENTIFIER CTR_ABC_QOIL_SENS ECU_ADDRESS 0x3fbb13 FORMAT "%3.0" /end MEASUREMENT
/begin MEASUREMENT fmy_stat_qoil_sens.ctr_end_diag "" UBYTE _CNV_A_R_LINEAR_____0_CM 1 100. 0. 255. DISPLAY_IDENTIFIER CTR_ABC_END_DIAG_QOIL_SENS ECU_ADDRESS 0x3fbb12 FORMAT "%3.0" /end MEASUREMENT
/begin MEASUREMENT fmy_stat_qoil_sens.err_info_stat.lv_err_mem "" UBYTE _CNV_S_2_RANGE______21_CM 1 100. 0. 1. DISPLAY_IDENTIFIER LV_ERR_MEM_QOIL_SENS ECU_ADDRESS 0x3fbb11 BIT_MASK 0x80 /end MEASUREMENT
/begin MEASUREMENT fmy_stat_qoil_sens.err_info_stat.lv_ready "" UBYTE _CNV_S_2_RANGE______21_CM 1 100. 0. 1. DISPLAY_IDENTIFIER LV_READY_QOIL_SENS ECU_ADDRESS 0x3fbb11 BIT_MASK 0x40 /end MEASUREMENT
/begin MEASUREMENT fmy_stat_qoil_sens.err_info_stat.lv_end_diag "" UBYTE _CNV_S_2_RANGE______21_CM 1 100. 0. 1. DISPLAY_IDENTIFIER LV_END_DIAG_QOIL_SENS ECU_ADDRESS 0x3fbb11 BIT_MASK 0x20 /end MEASUREMENT
/begin MEASUREMENT fmy_stat_qoil_sens.err_info_stat.lv_cdn_diag "" UBYTE _CNV_S_2_RANGE______21_CM 1 100. 0. 1. DISPLAY_IDENTIFIER LV_CDN_DIAG_QOIL_SENS ECU_ADDRESS 0x3fbb11 BIT_MASK 0x10 /end MEASUREMENT
/begin MEASUREMENT fmy_stat_qoil_sens.err_info_stat.err_sym "" UBYTE _CNV_S_6_RANGE_ERR__193_CM 1 100. 0. 15. DISPLAY_IDENTIFIER ERR_SYM_QOIL_SENS ECU_ADDRESS 0x3fbb11 BIT_MASK 0xF /end MEASUREMENT
/begin MEASUREMENT fmy_stat_bat_sens.ctr_abc "" UBYTE _CNV_A_R_LINEAR_____0_CM 1 100. 0. 255. DISPLAY_IDENTIFIER CTR_ABC_BAT_SENS ECU_ADDRESS 0x3fbb17 FORMAT "%3.0" /end MEASUREMENT
/begin MEASUREMENT fmy_stat_bat_sens.ctr_end_diag "" UBYTE _CNV_A_R_LINEAR_____0_CM 1 100. 0. 255. DISPLAY_IDENTIFIER CTR_ABC_END_DIAG_BAT_SENS ECU_ADDRESS 0x3fbb16 FORMAT "%3.0" /end MEASUREMENT
/begin MEASUREMENT fmy_stat_bat_sens.err_info_stat.lv_err_mem "" UBYTE _CNV_S_2_RANGE______21_CM 1 100. 0. 1. DISPLAY_IDENTIFIER LV_ERR_MEM_BAT_SENS ECU_ADDRESS 0x3fbb15 BIT_MASK 0x80 /end MEASUREMENT
/begin MEASUREMENT fmy_stat_bat_sens.err_info_stat.lv_ready "" UBYTE _CNV_S_2_RANGE______21_CM 1 100. 0. 1. DISPLAY_IDENTIFIER LV_READY_BAT_SENS ECU_ADDRESS 0x3fbb15 BIT_MASK 0x40 /end MEASUREMENT
/begin MEASUREMENT fmy_stat_bat_sens.err_info_stat.lv_end_diag "" UBYTE _CNV_S_2_RANGE______21_CM 1 100. 0. 1. DISPLAY_IDENTIFIER LV_END_DIAG_BAT_SENS ECU_ADDRESS 0x3fbb15 BIT_MASK 0x20 /end MEASUREMENT
/begin MEASUREMENT fmy_stat_bat_sens.err_info_stat.lv_cdn_diag "" UBYTE _CNV_S_2_RANGE______21_CM 1 100. 0. 1. DISPLAY_IDENTIFIER LV_CDN_DIAG_BAT_SENS ECU_ADDRESS 0x3fbb15 BIT_MASK 0x10 /end MEASUREMENT
/begin MEASUREMENT fmy_stat_bat_sens.err_info_stat.err_sym "" UBYTE _CNV_S_6_RANGE_ERR__193_CM 1 100. 0. 15. DISPLAY_IDENTIFIER ERR_SYM_BAT_SENS ECU_ADDRESS 0x3fbb15 BIT_MASK 0xF /end MEASUREMENT
/begin MEASUREMENT fmy_stat_bat_sens_it.ctr_abc "" UBYTE _CNV_A_R_LINEAR_____0_CM 1 100. 0. 255. DISPLAY_IDENTIFIER CTR_ABC_BAT_SENS_IT ECU_ADDRESS 0x3fbb1b FORMAT "%3.0" /end MEASUREMENT
/begin MEASUREMENT fmy_stat_bat_sens_it.ctr_end_diag "" UBYTE _CNV_A_R_LINEAR_____0_CM 1 100. 0. 255. DISPLAY_IDENTIFIER CTR_ABC_END_DIAG_BAT_SENS_IT ECU_ADDRESS 0x3fbb1a FORMAT "%3.0" /end MEASUREMENT
/begin MEASUREMENT fmy_stat_bat_sens_it.err_info_stat.lv_err_mem "" UBYTE _CNV_S_2_RANGE______21_CM 1 100. 0. 1. DISPLAY_IDENTIFIER LV_ERR_MEM_BAT_SENS_IT ECU_ADDRESS 0x3fbb19 BIT_MASK 0x80 /end MEASUREMENT
/begin MEASUREMENT fmy_stat_bat_sens_it.err_info_stat.lv_ready "" UBYTE _CNV_S_2_RANGE______21_CM 1 100. 0. 1. DISPLAY_IDENTIFIER LV_READY_BAT_SENS_IT ECU_ADDRESS 0x3fbb19 BIT_MASK 0x40 /end MEASUREMENT
/begin MEASUREMENT fmy_stat_bat_sens_it.err_info_stat.lv_end_diag "" UBYTE _CNV_S_2_RANGE______21_CM 1 100. 0. 1. DISPLAY_IDENTIFIER LV_END_DIAG_BAT_SENS_IT ECU_ADDRESS 0x3fbb19 BIT_MASK 0x20 /end MEASUREMENT
/begin MEASUREMENT fmy_stat_bat_sens_it.err_info_stat.lv_cdn_diag "" UBYTE _CNV_S_2_RANGE______21_CM 1 100. 0. 1. DISPLAY_IDENTIFIER LV_CDN_DIAG_BAT_SENS_IT ECU_ADDRESS 0x3fbb19 BIT_MASK 0x10 /end MEASUREMENT
/begin MEASUREMENT fmy_stat_bat_sens_it.err_info_stat.err_sym "" UBYTE _CNV_S_6_RANGE_ERR__193_CM 1 100. 0. 15. DISPLAY_IDENTIFIER ERR_SYM_BAT_SENS_IT ECU_ADDRESS 0x3fbb19 BIT_MASK 0xF /end MEASUREMENT
/begin MEASUREMENT fmy_stat_bat_sens_it_el.ctr_abc "" UBYTE _CNV_A_R_LINEAR_____0_CM 1 100. 0. 255. DISPLAY_IDENTIFIER CTR_ABC_BAT_SENS_IT_EL ECU_ADDRESS 0x3fbb1f FORMAT "%3.0" /end MEASUREMENT
/begin MEASUREMENT fmy_stat_bat_sens_it_el.ctr_end_diag "" UBYTE _CNV_A_R_LINEAR_____0_CM 1 100. 0. 255. DISPLAY_IDENTIFIER CTR_ABC_END_DIAG_BAT_SENS_IT_EL ECU_ADDRESS 0x3fbb1e FORMAT "%3.0" /end MEASUREMENT
/begin MEASUREMENT fmy_stat_bat_sens_it_el.err_info_stat.lv_err_mem "" UBYTE _CNV_S_2_RANGE______21_CM 1 100. 0. 1. DISPLAY_IDENTIFIER LV_ERR_MEM_BAT_SENS_IT_EL ECU_ADDRESS 0x3fbb1d BIT_MASK 0x80 /end MEASUREMENT
/begin MEASUREMENT fmy_stat_bat_sens_it_el.err_info_stat.lv_ready "" UBYTE _CNV_S_2_RANGE______21_CM 1 100. 0. 1. DISPLAY_IDENTIFIER LV_READY_BAT_SENS_IT_EL ECU_ADDRESS 0x3fbb1d BIT_MASK 0x40 /end MEASUREMENT
/begin MEASUREMENT fmy_stat_bat_sens_it_el.err_info_stat.lv_end_diag "" UBYTE _CNV_S_2_RANGE______21_CM 1 100. 0. 1. DISPLAY_IDENTIFIER LV_END_DIAG_BAT_SENS_IT_EL ECU_ADDRESS 0x3fbb1d BIT_MASK 0x20 /end MEASUREMENT
/begin MEASUREMENT fmy_stat_bat_sens_it_el.err_info_stat.lv_cdn_diag "" UBYTE _CNV_S_2_RANGE______21_CM 1 100. 0. 1. DISPLAY_IDENTIFIER LV_CDN_DIAG_BAT_SENS_IT_EL ECU_ADDRESS 0x3fbb1d BIT_MASK 0x10 /end MEASUREMENT
/begin MEASUREMENT fmy_stat_bat_sens_it_el.err_info_stat.err_sym "" UBYTE _CNV_S_6_RANGE_ERR__193_CM 1 100. 0. 15. DISPLAY_IDENTIFIER ERR_SYM_BAT_SENS_IT_EL ECU_ADDRESS 0x3fbb1d BIT_MASK 0xF /end MEASUREMENT
/begin MEASUREMENT fmy_stat_ecu_nvmy.ctr_abc "" UBYTE _CNV_A_R_LINEAR_____0_CM 1 100. 0. 255. DISPLAY_IDENTIFIER CTR_ABC_ECU_NVMY ECU_ADDRESS 0x3fbb23 FORMAT "%3.0" /end MEASUREMENT
/begin MEASUREMENT fmy_stat_ecu_nvmy.ctr_end_diag "" UBYTE _CNV_A_R_LINEAR_____0_CM 1 100. 0. 255. DISPLAY_IDENTIFIER CTR_ABC_END_DIAG_ECU_NVMY ECU_ADDRESS 0x3fbb22 FORMAT "%3.0" /end MEASUREMENT
/begin MEASUREMENT fmy_stat_ecu_nvmy.err_info_stat.lv_err_mem "" UBYTE _CNV_S_2_RANGE______21_CM 1 100. 0. 1. DISPLAY_IDENTIFIER LV_ERR_MEM_ECU_NVMY ECU_ADDRESS 0x3fbb21 BIT_MASK 0x80 /end MEASUREMENT
/begin MEASUREMENT fmy_stat_ecu_nvmy.err_info_stat.lv_ready "" UBYTE _CNV_S_2_RANGE______21_CM 1 100. 0. 1. DISPLAY_IDENTIFIER LV_READY_ECU_NVMY ECU_ADDRESS 0x3fbb21 BIT_MASK 0x40 /end MEASUREMENT
/begin MEASUREMENT fmy_stat_ecu_nvmy.err_info_stat.lv_end_diag "" UBYTE _CNV_S_2_RANGE______21_CM 1 100. 0. 1. DISPLAY_IDENTIFIER LV_END_DIAG_ECU_NVMY ECU_ADDRESS 0x3fbb21 BIT_MASK 0x20 /end MEASUREMENT
/begin MEASUREMENT fmy_stat_ecu_nvmy.err_info_stat.lv_cdn_diag "" UBYTE _CNV_S_2_RANGE______21_CM 1 100. 0. 1. DISPLAY_IDENTIFIER LV_CDN_DIAG_ECU_NVMY ECU_ADDRESS 0x3fbb21 BIT_MASK 0x10 /end MEASUREMENT
/begin MEASUREMENT fmy_stat_ecu_nvmy.err_info_stat.err_sym "" UBYTE _CNV_S_6_RANGE_ERR__193_CM 1 100. 0. 15. DISPLAY_IDENTIFIER ERR_SYM_ECU_NVMY ECU_ADDRESS 0x3fbb21 BIT_MASK 0xF /end MEASUREMENT
/begin MEASUREMENT fmy_stat_gs.ctr_abc "" UBYTE _CNV_A_R_LINEAR_____0_CM 1 100. 0. 255. DISPLAY_IDENTIFIER CTR_ABC_GS ECU_ADDRESS 0x3fbb27 FORMAT "%3.0" /end MEASUREMENT
/begin MEASUREMENT fmy_stat_gs.ctr_end_diag "" UBYTE _CNV_A_R_LINEAR_____0_CM 1 100. 0. 255. DISPLAY_IDENTIFIER CTR_ABC_END_DIAG_GS ECU_ADDRESS 0x3fbb26 FORMAT "%3.0" /end MEASUREMENT
/begin MEASUREMENT fmy_stat_gs.err_info_stat.lv_err_mem "" UBYTE _CNV_S_2_RANGE______21_CM 1 100. 0. 1. DISPLAY_IDENTIFIER LV_ERR_MEM_GS ECU_ADDRESS 0x3fbb25 BIT_MASK 0x80 /end MEASUREMENT
/begin MEASUREMENT fmy_stat_gs.err_info_stat.lv_ready "" UBYTE _CNV_S_2_RANGE______21_CM 1 100. 0. 1. DISPLAY_IDENTIFIER LV_READY_GS ECU_ADDRESS 0x3fbb25 BIT_MASK 0x40 /end MEASUREMENT
/begin MEASUREMENT fmy_stat_gs.err_info_stat.lv_end_diag "" UBYTE _CNV_S_2_RANGE______21_CM 1 100. 0. 1. DISPLAY_IDENTIFIER LV_END_DIAG_GS ECU_ADDRESS 0x3fbb25 BIT_MASK 0x20 /end MEASUREMENT
/begin MEASUREMENT fmy_stat_gs.err_info_stat.lv_cdn_diag "" UBYTE _CNV_S_2_RANGE______21_CM 1 100. 0. 1. DISPLAY_IDENTIFIER LV_CDN_DIAG_GS ECU_ADDRESS 0x3fbb25 BIT_MASK 0x10 /end MEASUREMENT
/begin MEASUREMENT fmy_stat_gs.err_info_stat.err_sym "" UBYTE _CNV_S_6_RANGE_ERR__193_CM 1 100. 0. 15. DISPLAY_IDENTIFIER ERR_SYM_GS ECU_ADDRESS 0x3fbb25 BIT_MASK 0xF /end MEASUREMENT
/begin MEASUREMENT fmy_stat_o3_conc.ctr_abc "" UBYTE _CNV_A_R_LINEAR_____0_CM 1 100. 0. 255. DISPLAY_IDENTIFIER CTR_ABC_O3_CONC ECU_ADDRESS 0x3fbb2b FORMAT "%3.0" /end MEASUREMENT
/begin MEASUREMENT fmy_stat_o3_conc.ctr_end_diag "" UBYTE _CNV_A_R_LINEAR_____0_CM 1 100. 0. 255. DISPLAY_IDENTIFIER CTR_ABC_END_DIAG_O3_CONC ECU_ADDRESS 0x3fbb2a FORMAT "%3.0" /end MEASUREMENT
/begin MEASUREMENT fmy_stat_o3_conc.err_info_stat.lv_err_mem "" UBYTE _CNV_S_2_RANGE______21_CM 1 100. 0. 1. DISPLAY_IDENTIFIER LV_ERR_MEM_O3_CONC ECU_ADDRESS 0x3fbb29 BIT_MASK 0x80 /end MEASUREMENT
/begin MEASUREMENT fmy_stat_o3_conc.err_info_stat.lv_ready "" UBYTE _CNV_S_2_RANGE______21_CM 1 100. 0. 1. DISPLAY_IDENTIFIER LV_READY_O3_CONC ECU_ADDRESS 0x3fbb29 BIT_MASK 0x40 /end MEASUREMENT
/begin MEASUREMENT fmy_stat_o3_conc.err_info_stat.lv_end_diag "" UBYTE _CNV_S_2_RANGE______21_CM 1 100. 0. 1. DISPLAY_IDENTIFIER LV_END_DIAG_O3_CONC ECU_ADDRESS 0x3fbb29 BIT_MASK 0x20 /end MEASUREMENT
/begin MEASUREMENT fmy_stat_o3_conc.err_info_stat.lv_cdn_diag "" UBYTE _CNV_S_2_RANGE______21_CM 1 100. 0. 1. DISPLAY_IDENTIFIER LV_CDN_DIAG_O3_CONC ECU_ADDRESS 0x3fbb29 BIT_MASK 0x10 /end MEASUREMENT
/begin MEASUREMENT fmy_stat_o3_conc.err_info_stat.err_sym "" UBYTE _CNV_S_6_RANGE_ERR__193_CM 1 100. 0. 15. DISPLAY_IDENTIFIER ERR_SYM_O3_CONC ECU_ADDRESS 0x3fbb29 BIT_MASK 0xF /end MEASUREMENT
/begin MEASUREMENT fmy_stat_ls_up_shift_afl_1.ctr_abc "" UBYTE _CNV_A_R_LINEAR_____0_CM 1 100. 0. 255. DISPLAY_IDENTIFIER CTR_ABC_LS_UP_SHIFT_AFL_1 ECU_ADDRESS 0x3fbb2f FORMAT "%3.0" /end MEASUREMENT
/begin MEASUREMENT fmy_stat_ls_up_shift_afl_1.ctr_end_diag "" UBYTE _CNV_A_R_LINEAR_____0_CM 1 100. 0. 255. DISPLAY_IDENTIFIER CTR_ABC_END_DIAG_LS_UP_SHIFT_AFL ECU_ADDRESS 0x3fbb2e FORMAT "%3.0" /end MEASUREMENT
/begin MEASUREMENT fmy_stat_ls_up_shift_afl_1.err_info_stat.lv_err_mem "" UBYTE _CNV_S_2_RANGE______21_CM 1 100. 0. 1. DISPLAY_IDENTIFIER LV_ERR_MEM_LS_UP_SHIFT_AFL_1 ECU_ADDRESS 0x3fbb2d BIT_MASK 0x80 /end MEASUREMENT
/begin MEASUREMENT fmy_stat_ls_up_shift_afl_1.err_info_stat.lv_ready "" UBYTE _CNV_S_2_RANGE______21_CM 1 100. 0. 1. DISPLAY_IDENTIFIER LV_READY_LS_UP_SHIFT_AFL_1 ECU_ADDRESS 0x3fbb2d BIT_MASK 0x40 /end MEASUREMENT
/begin MEASUREMENT fmy_stat_ls_up_shift_afl_1.err_info_stat.lv_end_diag "" UBYTE _CNV_S_2_RANGE______21_CM 1 100. 0. 1. DISPLAY_IDENTIFIER LV_END_DIAG_LS_UP_SHIFT_AFL_1 ECU_ADDRESS 0x3fbb2d BIT_MASK 0x20 /end MEASUREMENT
/begin MEASUREMENT fmy_stat_ls_up_shift_afl_1.err_info_stat.lv_cdn_diag "" UBYTE _CNV_S_2_RANGE______21_CM 1 100. 0. 1. DISPLAY_IDENTIFIER LV_CDN_DIAG_LS_UP_SHIFT_AFL_1 ECU_ADDRESS 0x3fbb2d BIT_MASK 0x10 /end MEASUREMENT
/begin MEASUREMENT fmy_stat_ls_up_shift_afl_1.err_info_stat.err_sym "" UBYTE _CNV_S_6_RANGE_ERR__193_CM 1 100. 0. 15. DISPLAY_IDENTIFIER ERR_SYM_LS_UP_SHIFT_AFL_1 ECU_ADDRESS 0x3fbb2d BIT_MASK 0xF /end MEASUREMENT
/begin MEASUREMENT fmy_stat_ls_up_shift_afl_2.ctr_abc "" UBYTE _CNV_A_R_LINEAR_____0_CM 1 100. 0. 255. DISPLAY_IDENTIFIER CTR_ABC_LS_UP_SHIFT_AFL_2 ECU_ADDRESS 0x3fbb33 FORMAT "%3.0" /end MEASUREMENT
/begin MEASUREMENT fmy_stat_ls_up_shift_afl_2.ctr_end_diag "" UBYTE _CNV_A_R_LINEAR_____0_CM 1 100. 0. 255. DISPLAY_IDENTIFIER CTR_ABC_END_DIAG_LS_UP_SHIFT_AFL ECU_ADDRESS 0x3fbb32 FORMAT "%3.0" /end MEASUREMENT
/begin MEASUREMENT fmy_stat_ls_up_shift_afl_2.err_info_stat.lv_err_mem "" UBYTE _CNV_S_2_RANGE______21_CM 1 100. 0. 1. DISPLAY_IDENTIFIER LV_ERR_MEM_LS_UP_SHIFT_AFL_2 ECU_ADDRESS 0x3fbb31 BIT_MASK 0x80 /end MEASUREMENT
/begin MEASUREMENT fmy_stat_ls_up_shift_afl_2.err_info_stat.lv_ready "" UBYTE _CNV_S_2_RANGE______21_CM 1 100. 0. 1. DISPLAY_IDENTIFIER LV_READY_LS_UP_SHIFT_AFL_2 ECU_ADDRESS 0x3fbb31 BIT_MASK 0x40 /end MEASUREMENT
/begin MEASUREMENT fmy_stat_ls_up_shift_afl_2.err_info_stat.lv_end_diag "" UBYTE _CNV_S_2_RANGE______21_CM 1 100. 0. 1. DISPLAY_IDENTIFIER LV_END_DIAG_LS_UP_SHIFT_AFL_2 ECU_ADDRESS 0x3fbb31 BIT_MASK 0x20 /end MEASUREMENT
/begin MEASUREMENT fmy_stat_ls_up_shift_afl_2.err_info_stat.lv_cdn_diag "" UBYTE _CNV_S_2_RANGE______21_CM 1 100. 0. 1. DISPLAY_IDENTIFIER LV_CDN_DIAG_LS_UP_SHIFT_AFL_2 ECU_ADDRESS 0x3fbb31 BIT_MASK 0x10 /end MEASUREMENT
/begin MEASUREMENT fmy_stat_ls_up_shift_afl_2.err_info_stat.err_sym "" UBYTE _CNV_S_6_RANGE_ERR__193_CM 1 100. 0. 15. DISPLAY_IDENTIFIER ERR_SYM_LS_UP_SHIFT_AFL_2 ECU_ADDRESS 0x3fbb31 BIT_MASK 0xF /end MEASUREMENT
/begin MEASUREMENT fmy_stat_ls_up_shift_afr_1.ctr_abc "" UBYTE _CNV_A_R_LINEAR_____0_CM 1 100. 0. 255. DISPLAY_IDENTIFIER CTR_ABC_LS_UP_SHIFT_AFR_1 ECU_ADDRESS 0x3fbb37 FORMAT "%3.0" /end MEASUREMENT
/begin MEASUREMENT fmy_stat_ls_up_shift_afr_1.ctr_end_diag "" UBYTE _CNV_A_R_LINEAR_____0_CM 1 100. 0. 255. DISPLAY_IDENTIFIER CTR_ABC_END_DIAG_LS_UP_SHIFT_AFR ECU_ADDRESS 0x3fbb36 FORMAT "%3.0" /end MEASUREMENT
/begin MEASUREMENT fmy_stat_ls_up_shift_afr_1.err_info_stat.lv_err_mem "" UBYTE _CNV_S_2_RANGE______21_CM 1 100. 0. 1. DISPLAY_IDENTIFIER LV_ERR_MEM_LS_UP_SHIFT_AFR_1 ECU_ADDRESS 0x3fbb35 BIT_MASK 0x80 /end MEASUREMENT
/begin MEASUREMENT fmy_stat_ls_up_shift_afr_1.err_info_stat.lv_ready "" UBYTE _CNV_S_2_RANGE______21_CM 1 100. 0. 1. DISPLAY_IDENTIFIER LV_READY_LS_UP_SHIFT_AFR_1 ECU_ADDRESS 0x3fbb35 BIT_MASK 0x40 /end MEASUREMENT
/begin MEASUREMENT fmy_stat_ls_up_shift_afr_1.err_info_stat.lv_end_diag "" UBYTE _CNV_S_2_RANGE______21_CM 1 100. 0. 1. DISPLAY_IDENTIFIER LV_END_DIAG_LS_UP_SHIFT_AFR_1 ECU_ADDRESS 0x3fbb35 BIT_MASK 0x20 /end MEASUREMENT
/begin MEASUREMENT fmy_stat_ls_up_shift_afr_1.err_info_stat.lv_cdn_diag "" UBYTE _CNV_S_2_RANGE______21_CM 1 100. 0. 1. DISPLAY_IDENTIFIER LV_CDN_DIAG_LS_UP_SHIFT_AFR_1 ECU_ADDRESS 0x3fbb35 BIT_MASK 0x10 /end MEASUREMENT
/begin MEASUREMENT fmy_stat_ls_up_shift_afr_1.err_info_stat.err_sym "" UBYTE _CNV_S_6_RANGE_ERR__193_CM 1 100. 0. 15. DISPLAY_IDENTIFIER ERR_SYM_LS_UP_SHIFT_AFR_1 ECU_ADDRESS 0x3fbb35 BIT_MASK 0xF /end MEASUREMENT
/begin MEASUREMENT fmy_stat_ls_up_shift_afr_2.ctr_abc "" UBYTE _CNV_A_R_LINEAR_____0_CM 1 100. 0. 255. DISPLAY_IDENTIFIER CTR_ABC_LS_UP_SHIFT_AFR_2 ECU_ADDRESS 0x3fbb3b FORMAT "%3.0" /end MEASUREMENT
/begin MEASUREMENT fmy_stat_ls_up_shift_afr_2.ctr_end_diag "" UBYTE _CNV_A_R_LINEAR_____0_CM 1 100. 0. 255. DISPLAY_IDENTIFIER CTR_ABC_END_DIAG_LS_UP_SHIFT_AFR ECU_ADDRESS 0x3fbb3a FORMAT "%3.0" /end MEASUREMENT
/begin MEASUREMENT fmy_stat_ls_up_shift_afr_2.err_info_stat.lv_err_mem "" UBYTE _CNV_S_2_RANGE______21_CM 1 100. 0. 1. DISPLAY_IDENTIFIER LV_ERR_MEM_LS_UP_SHIFT_AFR_2 ECU_ADDRESS 0x3fbb39 BIT_MASK 0x80 /end MEASUREMENT
/begin MEASUREMENT fmy_stat_ls_up_shift_afr_2.err_info_stat.lv_ready "" UBYTE _CNV_S_2_RANGE______21_CM 1 100. 0. 1. DISPLAY_IDENTIFIER LV_READY_LS_UP_SHIFT_AFR_2 ECU_ADDRESS 0x3fbb39 BIT_MASK 0x40 /end MEASUREMENT
/begin MEASUREMENT fmy_stat_ls_up_shift_afr_2.err_info_stat.lv_end_diag "" UBYTE _CNV_S_2_RANGE______21_CM 1 100. 0. 1. DISPLAY_IDENTIFIER LV_END_DIAG_LS_UP_SHIFT_AFR_2 ECU_ADDRESS 0x3fbb39 BIT_MASK 0x20 /end MEASUREMENT
/begin MEASUREMENT fmy_stat_ls_up_shift_afr_2.err_info_stat.lv_cdn_diag "" UBYTE _CNV_S_2_RANGE______21_CM 1 100. 0. 1. DISPLAY_IDENTIFIER LV_CDN_DIAG_LS_UP_SHIFT_AFR_2 ECU_ADDRESS 0x3fbb39 BIT_MASK 0x10 /end MEASUREMENT
/begin MEASUREMENT fmy_stat_ls_up_shift_afr_2.err_info_stat.err_sym "" UBYTE _CNV_S_6_RANGE_ERR__193_CM 1 100. 0. 15. DISPLAY_IDENTIFIER ERR_SYM_LS_UP_SHIFT_AFR_2 ECU_ADDRESS 0x3fbb39 BIT_MASK 0xF /end MEASUREMENT
/begin MEASUREMENT fmy_stat_oc_lsl_1.ctr_abc "" UBYTE _CNV_A_R_LINEAR_____0_CM 1 100. 0. 255. DISPLAY_IDENTIFIER CTR_ABC_OC_LSL_1 ECU_ADDRESS 0x3fbb3f FORMAT "%3.0" /end MEASUREMENT
/begin MEASUREMENT fmy_stat_oc_lsl_1.ctr_end_diag "" UBYTE _CNV_A_R_LINEAR_____0_CM 1 100. 0. 255. DISPLAY_IDENTIFIER CTR_ABC_END_DIAG_OC_LSL_1 ECU_ADDRESS 0x3fbb3e FORMAT "%3.0" /end MEASUREMENT
/begin MEASUREMENT fmy_stat_oc_lsl_1.err_info_stat.lv_err_mem "" UBYTE _CNV_S_2_RANGE______21_CM 1 100. 0. 1. DISPLAY_IDENTIFIER LV_ERR_MEM_OC_LSL_1 ECU_ADDRESS 0x3fbb3d BIT_MASK 0x80 /end MEASUREMENT
/begin MEASUREMENT fmy_stat_oc_lsl_1.err_info_stat.lv_ready "" UBYTE _CNV_S_2_RANGE______21_CM 1 100. 0. 1. DISPLAY_IDENTIFIER LV_READY_OC_LSL_1 ECU_ADDRESS 0x3fbb3d BIT_MASK 0x40 /end MEASUREMENT
/begin MEASUREMENT fmy_stat_oc_lsl_1.err_info_stat.lv_end_diag "" UBYTE _CNV_S_2_RANGE______21_CM 1 100. 0. 1. DISPLAY_IDENTIFIER LV_END_DIAG_OC_LSL_1 ECU_ADDRESS 0x3fbb3d BIT_MASK 0x20 /end MEASUREMENT
/begin MEASUREMENT fmy_stat_oc_lsl_1.err_info_stat.lv_cdn_diag "" UBYTE _CNV_S_2_RANGE______21_CM 1 100. 0. 1. DISPLAY_IDENTIFIER LV_CDN_DIAG_OC_LSL_1 ECU_ADDRESS 0x3fbb3d BIT_MASK 0x10 /end MEASUREMENT
/begin MEASUREMENT fmy_stat_oc_lsl_1.err_info_stat.err_sym "" UBYTE _CNV_S_6_RANGE_ERR__193_CM 1 100. 0. 15. DISPLAY_IDENTIFIER ERR_SYM_OC_LSL_1 ECU_ADDRESS 0x3fbb3d BIT_MASK 0xF /end MEASUREMENT
/begin MEASUREMENT fmy_stat_oc_lsl_2.ctr_abc "" UBYTE _CNV_A_R_LINEAR_____0_CM 1 100. 0. 255. DISPLAY_IDENTIFIER CTR_ABC_OC_LSL_2 ECU_ADDRESS 0x3fbb43 FORMAT "%3.0" /end MEASUREMENT
/begin MEASUREMENT fmy_stat_oc_lsl_2.ctr_end_diag "" UBYTE _CNV_A_R_LINEAR_____0_CM 1 100. 0. 255. DISPLAY_IDENTIFIER CTR_ABC_END_DIAG_OC_LSL_2 ECU_ADDRESS 0x3fbb42 FORMAT "%3.0" /end MEASUREMENT
/begin MEASUREMENT fmy_stat_oc_lsl_2.err_info_stat.lv_err_mem "" UBYTE _CNV_S_2_RANGE______21_CM 1 100. 0. 1. DISPLAY_IDENTIFIER LV_ERR_MEM_OC_LSL_2 ECU_ADDRESS 0x3fbb41 BIT_MASK 0x80 /end MEASUREMENT
/begin MEASUREMENT fmy_stat_oc_lsl_2.err_info_stat.lv_ready "" UBYTE _CNV_S_2_RANGE______21_CM 1 100. 0. 1. DISPLAY_IDENTIFIER LV_READY_OC_LSL_2 ECU_ADDRESS 0x3fbb41 BIT_MASK 0x40 /end MEASUREMENT
/begin MEASUREMENT fmy_stat_oc_lsl_2.err_info_stat.lv_end_diag "" UBYTE _CNV_S_2_RANGE______21_CM 1 100. 0. 1. DISPLAY_IDENTIFIER LV_END_DIAG_OC_LSL_2 ECU_ADDRESS 0x3fbb41 BIT_MASK 0x20 /end MEASUREMENT
/begin MEASUREMENT fmy_stat_oc_lsl_2.err_info_stat.lv_cdn_diag "" UBYTE _CNV_S_2_RANGE______21_CM 1 100. 0. 1. DISPLAY_IDENTIFIER LV_CDN_DIAG_OC_LSL_2 ECU_ADDRESS 0x3fbb41 BIT_MASK 0x10 /end MEASUREMENT
/begin MEASUREMENT fmy_stat_oc_lsl_2.err_info_stat.err_sym "" UBYTE _CNV_S_6_RANGE_ERR__193_CM 1 100. 0. 15. DISPLAY_IDENTIFIER ERR_SYM_OC_LSL_2 ECU_ADDRESS 0x3fbb41 BIT_MASK 0xF /end MEASUREMENT
/begin MEASUREMENT fmy_stat_cat_diag_1.ctr_abc "" UBYTE _CNV_A_R_LINEAR_____0_CM 1 100. 0. 255. DISPLAY_IDENTIFIER CTR_ABC_CAT_DIAG_1 ECU_ADDRESS 0x3fbb47 FORMAT "%3.0" /end MEASUREMENT
/begin MEASUREMENT fmy_stat_cat_diag_1.ctr_end_diag "" UBYTE _CNV_A_R_LINEAR_____0_CM 1 100. 0. 255. DISPLAY_IDENTIFIER CTR_ABC_END_DIAG_CAT_DIAG_1 ECU_ADDRESS 0x3fbb46 FORMAT "%3.0" /end MEASUREMENT
/begin MEASUREMENT fmy_stat_cat_diag_1.err_info_stat.lv_err_mem "" UBYTE _CNV_S_2_RANGE______21_CM 1 100. 0. 1. DISPLAY_IDENTIFIER LV_ERR_MEM_CAT_DIAG_1 ECU_ADDRESS 0x3fbb45 BIT_MASK 0x80 /end MEASUREMENT
/begin MEASUREMENT fmy_stat_cat_diag_1.err_info_stat.lv_ready "" UBYTE _CNV_S_2_RANGE______21_CM 1 100. 0. 1. DISPLAY_IDENTIFIER LV_READY_CAT_DIAG_1 ECU_ADDRESS 0x3fbb45 BIT_MASK 0x40 /end MEASUREMENT
/begin MEASUREMENT fmy_stat_cat_diag_1.err_info_stat.lv_end_diag "" UBYTE _CNV_S_2_RANGE______21_CM 1 100. 0. 1. DISPLAY_IDENTIFIER LV_END_DIAG_CAT_DIAG_1 ECU_ADDRESS 0x3fbb45 BIT_MASK 0x20 /end MEASUREMENT
/begin MEASUREMENT fmy_stat_cat_diag_1.err_info_stat.lv_cdn_diag "" UBYTE _CNV_S_2_RANGE______21_CM 1 100. 0. 1. DISPLAY_IDENTIFIER LV_CDN_DIAG_CAT_DIAG_1 ECU_ADDRESS 0x3fbb45 BIT_MASK 0x10 /end MEASUREMENT
/begin MEASUREMENT fmy_stat_cat_diag_1.err_info_stat.err_sym "" UBYTE _CNV_S_6_RANGE_ERR__193_CM 1 100. 0. 15. DISPLAY_IDENTIFIER ERR_SYM_CAT_DIAG_1 ECU_ADDRESS 0x3fbb45 BIT_MASK 0xF /end MEASUREMENT
/begin MEASUREMENT fmy_stat_cat_diag_2.ctr_abc "" UBYTE _CNV_A_R_LINEAR_____0_CM 1 100. 0. 255. DISPLAY_IDENTIFIER CTR_ABC_CAT_DIAG_2 ECU_ADDRESS 0x3fbb4b FORMAT "%3.0" /end MEASUREMENT
/begin MEASUREMENT fmy_stat_cat_diag_2.ctr_end_diag "" UBYTE _CNV_A_R_LINEAR_____0_CM 1 100. 0. 255. DISPLAY_IDENTIFIER CTR_ABC_END_DIAG_CAT_DIAG_2 ECU_ADDRESS 0x3fbb4a FORMAT "%3.0" /end MEASUREMENT
/begin MEASUREMENT fmy_stat_cat_diag_2.err_info_stat.lv_err_mem "" UBYTE _CNV_S_2_RANGE______21_CM 1 100. 0. 1. DISPLAY_IDENTIFIER LV_ERR_MEM_CAT_DIAG_2 ECU_ADDRESS 0x3fbb49 BIT_MASK 0x80 /end MEASUREMENT
/begin MEASUREMENT fmy_stat_cat_diag_2.err_info_stat.lv_ready "" UBYTE _CNV_S_2_RANGE______21_CM 1 100. 0. 1. DISPLAY_IDENTIFIER LV_READY_CAT_DIAG_2 ECU_ADDRESS 0x3fbb49 BIT_MASK 0x40 /end MEASUREMENT
/begin MEASUREMENT fmy_stat_cat_diag_2.err_info_stat.lv_end_diag "" UBYTE _CNV_S_2_RANGE______21_CM 1 100. 0. 1. DISPLAY_IDENTIFIER LV_END_DIAG_CAT_DIAG_2 ECU_ADDRESS 0x3fbb49 BIT_MASK 0x20 /end MEASUREMENT
/begin MEASUREMENT fmy_stat_cat_diag_2.err_info_stat.lv_cdn_diag "" UBYTE _CNV_S_2_RANGE______21_CM 1 100. 0. 1. DISPLAY_IDENTIFIER LV_CDN_DIAG_CAT_DIAG_2 ECU_ADDRESS 0x3fbb49 BIT_MASK 0x10 /end MEASUREMENT
/begin MEASUREMENT fmy_stat_cat_diag_2.err_info_stat.err_sym "" UBYTE _CNV_S_6_RANGE_ERR__193_CM 1 100. 0. 15. DISPLAY_IDENTIFIER ERR_SYM_CAT_DIAG_2 ECU_ADDRESS 0x3fbb49 BIT_MASK 0xF /end MEASUREMENT
/begin MEASUREMENT fmy_stat_el_lsl_1.ctr_abc "" UBYTE _CNV_A_R_LINEAR_____0_CM 1 100. 0. 255. DISPLAY_IDENTIFIER CTR_ABC_EL_LSL_1 ECU_ADDRESS 0x3fbb4f FORMAT "%3.0" /end MEASUREMENT
/begin MEASUREMENT fmy_stat_el_lsl_1.ctr_end_diag "" UBYTE _CNV_A_R_LINEAR_____0_CM 1 100. 0. 255. DISPLAY_IDENTIFIER CTR_ABC_END_DIAG_EL_LSL_1 ECU_ADDRESS 0x3fbb4e FORMAT "%3.0" /end MEASUREMENT
/begin MEASUREMENT fmy_stat_el_lsl_1.err_info_stat.lv_err_mem "" UBYTE _CNV_S_2_RANGE______21_CM 1 100. 0. 1. DISPLAY_IDENTIFIER LV_ERR_MEM_EL_LSL_1 ECU_ADDRESS 0x3fbb4d BIT_MASK 0x80 /end MEASUREMENT
/begin MEASUREMENT fmy_stat_el_lsl_1.err_info_stat.lv_ready "" UBYTE _CNV_S_2_RANGE______21_CM 1 100. 0. 1. DISPLAY_IDENTIFIER LV_READY_EL_LSL_1 ECU_ADDRESS 0x3fbb4d BIT_MASK 0x40 /end MEASUREMENT
/begin MEASUREMENT fmy_stat_el_lsl_1.err_info_stat.lv_end_diag "" UBYTE _CNV_S_2_RANGE______21_CM 1 100. 0. 1. DISPLAY_IDENTIFIER LV_END_DIAG_EL_LSL_1 ECU_ADDRESS 0x3fbb4d BIT_MASK 0x20 /end MEASUREMENT
/begin MEASUREMENT fmy_stat_el_lsl_1.err_info_stat.lv_cdn_diag "" UBYTE _CNV_S_2_RANGE______21_CM 1 100. 0. 1. DISPLAY_IDENTIFIER LV_CDN_DIAG_EL_LSL_1 ECU_ADDRESS 0x3fbb4d BIT_MASK 0x10 /end MEASUREMENT
/begin MEASUREMENT fmy_stat_el_lsl_1.err_info_stat.err_sym "" UBYTE _CNV_S_6_RANGE_ERR__193_CM 1 100. 0. 15. DISPLAY_IDENTIFIER ERR_SYM_EL_LSL_1 ECU_ADDRESS 0x3fbb4d BIT_MASK 0xF /end MEASUREMENT
/begin MEASUREMENT fmy_stat_el_lsl_2.ctr_abc "" UBYTE _CNV_A_R_LINEAR_____0_CM 1 100. 0. 255. DISPLAY_IDENTIFIER CTR_ABC_EL_LSL_2 ECU_ADDRESS 0x3fbb53 FORMAT "%3.0" /end MEASUREMENT
/begin MEASUREMENT fmy_stat_el_lsl_2.ctr_end_diag "" UBYTE _CNV_A_R_LINEAR_____0_CM 1 100. 0. 255. DISPLAY_IDENTIFIER CTR_ABC_END_DIAG_EL_LSL_2 ECU_ADDRESS 0x3fbb52 FORMAT "%3.0" /end MEASUREMENT
/begin MEASUREMENT fmy_stat_el_lsl_2.err_info_stat.lv_err_mem "" UBYTE _CNV_S_2_RANGE______21_CM 1 100. 0. 1. DISPLAY_IDENTIFIER LV_ERR_MEM_EL_LSL_2 ECU_ADDRESS 0x3fbb51 BIT_MASK 0x80 /end MEASUREMENT
/begin MEASUREMENT fmy_stat_el_lsl_2.err_info_stat.lv_ready "" UBYTE _CNV_S_2_RANGE______21_CM 1 100. 0. 1. DISPLAY_IDENTIFIER LV_READY_EL_LSL_2 ECU_ADDRESS 0x3fbb51 BIT_MASK 0x40 /end MEASUREMENT
/begin MEASUREMENT fmy_stat_el_lsl_2.err_info_stat.lv_end_diag "" UBYTE _CNV_S_2_RANGE______21_CM 1 100. 0. 1. DISPLAY_IDENTIFIER LV_END_DIAG_EL_LSL_2 ECU_ADDRESS 0x3fbb51 BIT_MASK 0x20 /end MEASUREMENT
/begin MEASUREMENT fmy_stat_el_lsl_2.err_info_stat.lv_cdn_diag "" UBYTE _CNV_S_2_RANGE______21_CM 1 100. 0. 1. DISPLAY_IDENTIFIER LV_CDN_DIAG_EL_LSL_2 ECU_ADDRESS 0x3fbb51 BIT_MASK 0x10 /end MEASUREMENT
/begin MEASUREMENT fmy_stat_el_lsl_2.err_info_stat.err_sym "" UBYTE _CNV_S_6_RANGE_ERR__193_CM 1 100. 0. 15. DISPLAY_IDENTIFIER ERR_SYM_EL_LSL_2 ECU_ADDRESS 0x3fbb51 BIT_MASK 0xF /end MEASUREMENT
/begin MEASUREMENT fmy_stat_cat_diag_nox_1.ctr_abc "" UBYTE _CNV_A_R_LINEAR_____0_CM 1 100. 0. 255. DISPLAY_IDENTIFIER CTR_ABC_CAT_DIAG_NOX_1 ECU_ADDRESS 0x3fbb57 FORMAT "%3.0" /end MEASUREMENT
/begin MEASUREMENT fmy_stat_cat_diag_nox_1.ctr_end_diag "" UBYTE _CNV_A_R_LINEAR_____0_CM 1 100. 0. 255. DISPLAY_IDENTIFIER CTR_ABC_END_DIAG_CAT_DIAG_NOX_1 ECU_ADDRESS 0x3fbb56 FORMAT "%3.0" /end MEASUREMENT
/begin MEASUREMENT fmy_stat_cat_diag_nox_1.err_info_stat.lv_err_mem "" UBYTE _CNV_S_2_RANGE______21_CM 1 100. 0. 1. DISPLAY_IDENTIFIER LV_ERR_MEM_CAT_DIAG_NOX_1 ECU_ADDRESS 0x3fbb55 BIT_MASK 0x80 /end MEASUREMENT
/begin MEASUREMENT fmy_stat_cat_diag_nox_1.err_info_stat.lv_ready "" UBYTE _CNV_S_2_RANGE______21_CM 1 100. 0. 1. DISPLAY_IDENTIFIER LV_READY_CAT_DIAG_NOX_1 ECU_ADDRESS 0x3fbb55 BIT_MASK 0x40 /end MEASUREMENT
/begin MEASUREMENT fmy_stat_cat_diag_nox_1.err_info_stat.lv_end_diag "" UBYTE _CNV_S_2_RANGE______21_CM 1 100. 0. 1. DISPLAY_IDENTIFIER LV_END_DIAG_CAT_DIAG_NOX_1 ECU_ADDRESS 0x3fbb55 BIT_MASK 0x20 /end MEASUREMENT
/begin MEASUREMENT fmy_stat_cat_diag_nox_1.err_info_stat.lv_cdn_diag "" UBYTE _CNV_S_2_RANGE______21_CM 1 100. 0. 1. DISPLAY_IDENTIFIER LV_CDN_DIAG_CAT_DIAG_NOX_1 ECU_ADDRESS 0x3fbb55 BIT_MASK 0x10 /end MEASUREMENT
/begin MEASUREMENT fmy_stat_cat_diag_nox_1.err_info_stat.err_sym "" UBYTE _CNV_S_6_RANGE_ERR__193_CM 1 100. 0. 15. DISPLAY_IDENTIFIER ERR_SYM_CAT_DIAG_NOX_1 ECU_ADDRESS 0x3fbb55 BIT_MASK 0xF /end MEASUREMENT
/begin MEASUREMENT fmy_stat_cat_diag_nox_2.ctr_abc "" UBYTE _CNV_A_R_LINEAR_____0_CM 1 100. 0. 255. DISPLAY_IDENTIFIER CTR_ABC_CAT_DIAG_NOX_2 ECU_ADDRESS 0x3fbb5b FORMAT "%3.0" /end MEASUREMENT
/begin MEASUREMENT fmy_stat_cat_diag_nox_2.ctr_end_diag "" UBYTE _CNV_A_R_LINEAR_____0_CM 1 100. 0. 255. DISPLAY_IDENTIFIER CTR_ABC_END_DIAG_CAT_DIAG_NOX_2 ECU_ADDRESS 0x3fbb5a FORMAT "%3.0" /end MEASUREMENT
/begin MEASUREMENT fmy_stat_cat_diag_nox_2.err_info_stat.lv_err_mem "" UBYTE _CNV_S_2_RANGE______21_CM 1 100. 0. 1. DISPLAY_IDENTIFIER LV_ERR_MEM_CAT_DIAG_NOX_2 ECU_ADDRESS 0x3fbb59 BIT_MASK 0x80 /end MEASUREMENT
/begin MEASUREMENT fmy_stat_cat_diag_nox_2.err_info_stat.lv_ready "" UBYTE _CNV_S_2_RANGE______21_CM 1 100. 0. 1. DISPLAY_IDENTIFIER LV_READY_CAT_DIAG_NOX_2 ECU_ADDRESS 0x3fbb59 BIT_MASK 0x40 /end MEASUREMENT
/begin MEASUREMENT fmy_stat_cat_diag_nox_2.err_info_stat.lv_end_diag "" UBYTE _CNV_S_2_RANGE______21_CM 1 100. 0. 1. DISPLAY_IDENTIFIER LV_END_DIAG_CAT_DIAG_NOX_2 ECU_ADDRESS 0x3fbb59 BIT_MASK 0x20 /end MEASUREMENT
/begin MEASUREMENT fmy_stat_cat_diag_nox_2.err_info_stat.lv_cdn_diag "" UBYTE _CNV_S_2_RANGE______21_CM 1 100. 0. 1. DISPLAY_IDENTIFIER LV_CDN_DIAG_CAT_DIAG_NOX_2 ECU_ADDRESS 0x3fbb59 BIT_MASK 0x10 /end MEASUREMENT
/begin MEASUREMENT fmy_stat_cat_diag_nox_2.err_info_stat.err_sym "" UBYTE _CNV_S_6_RANGE_ERR__193_CM 1 100. 0. 15. DISPLAY_IDENTIFIER ERR_SYM_CAT_DIAG_NOX_2 ECU_ADDRESS 0x3fbb59 BIT_MASK 0xF /end MEASUREMENT
/begin MEASUREMENT fmy_stat_vls_down_puc_1.ctr_abc "" UBYTE _CNV_A_R_LINEAR_____0_CM 1 100. 0. 255. DISPLAY_IDENTIFIER CTR_ABC_VLS_DOWN_PUC_1 ECU_ADDRESS 0x3fbb5f FORMAT "%3.0" /end MEASUREMENT
/begin MEASUREMENT fmy_stat_vls_down_puc_1.ctr_end_diag "" UBYTE _CNV_A_R_LINEAR_____0_CM 1 100. 0. 255. DISPLAY_IDENTIFIER CTR_ABC_END_DIAG_VLS_DOWN_PUC_1 ECU_ADDRESS 0x3fbb5e FORMAT "%3.0" /end MEASUREMENT
/begin MEASUREMENT fmy_stat_vls_down_puc_1.err_info_stat.lv_err_mem "" UBYTE _CNV_S_2_RANGE______21_CM 1 100. 0. 1. DISPLAY_IDENTIFIER LV_ERR_MEM_VLS_DOWN_PUC_1 ECU_ADDRESS 0x3fbb5d BIT_MASK 0x80 /end MEASUREMENT
/begin MEASUREMENT fmy_stat_vls_down_puc_1.err_info_stat.lv_ready "" UBYTE _CNV_S_2_RANGE______21_CM 1 100. 0. 1. DISPLAY_IDENTIFIER LV_READY_VLS_DOWN_PUC_1 ECU_ADDRESS 0x3fbb5d BIT_MASK 0x40 /end MEASUREMENT
/begin MEASUREMENT fmy_stat_vls_down_puc_1.err_info_stat.lv_end_diag "" UBYTE _CNV_S_2_RANGE______21_CM 1 100. 0. 1. DISPLAY_IDENTIFIER LV_END_DIAG_VLS_DOWN_PUC_1 ECU_ADDRESS 0x3fbb5d BIT_MASK 0x20 /end MEASUREMENT
/begin MEASUREMENT fmy_stat_vls_down_puc_1.err_info_stat.lv_cdn_diag "" UBYTE _CNV_S_2_RANGE______21_CM 1 100. 0. 1. DISPLAY_IDENTIFIER LV_CDN_DIAG_VLS_DOWN_PUC_1 ECU_ADDRESS 0x3fbb5d BIT_MASK 0x10 /end MEASUREMENT
/begin MEASUREMENT fmy_stat_vls_down_puc_1.err_info_stat.err_sym "" UBYTE _CNV_S_6_RANGE_ERR__193_CM 1 100. 0. 15. DISPLAY_IDENTIFIER ERR_SYM_VLS_DOWN_PUC_1 ECU_ADDRESS 0x3fbb5d BIT_MASK 0xF /end MEASUREMENT
/begin MEASUREMENT fmy_stat_vls_down_puc_2.ctr_abc "" UBYTE _CNV_A_R_LINEAR_____0_CM 1 100. 0. 255. DISPLAY_IDENTIFIER CTR_ABC_VLS_DOWN_PUC_2 ECU_ADDRESS 0x3fbb63 FORMAT "%3.0" /end MEASUREMENT
/begin MEASUREMENT fmy_stat_vls_down_puc_2.ctr_end_diag "" UBYTE _CNV_A_R_LINEAR_____0_CM 1 100. 0. 255. DISPLAY_IDENTIFIER CTR_ABC_END_DIAG_VLS_DOWN_PUC_2 ECU_ADDRESS 0x3fbb62 FORMAT "%3.0" /end MEASUREMENT
/begin MEASUREMENT fmy_stat_vls_down_puc_2.err_info_stat.lv_err_mem "" UBYTE _CNV_S_2_RANGE______21_CM 1 100. 0. 1. DISPLAY_IDENTIFIER LV_ERR_MEM_VLS_DOWN_PUC_2 ECU_ADDRESS 0x3fbb61 BIT_MASK 0x80 /end MEASUREMENT
/begin MEASUREMENT fmy_stat_vls_down_puc_2.err_info_stat.lv_ready "" UBYTE _CNV_S_2_RANGE______21_CM 1 100. 0. 1. DISPLAY_IDENTIFIER LV_READY_VLS_DOWN_PUC_2 ECU_ADDRESS 0x3fbb61 BIT_MASK 0x40 /end MEASUREMENT
/begin MEASUREMENT fmy_stat_vls_down_puc_2.err_info_stat.lv_end_diag "" UBYTE _CNV_S_2_RANGE______21_CM 1 100. 0. 1. DISPLAY_IDENTIFIER LV_END_DIAG_VLS_DOWN_PUC_2 ECU_ADDRESS 0x3fbb61 BIT_MASK 0x20 /end MEASUREMENT
/begin MEASUREMENT fmy_stat_vls_down_puc_2.err_info_stat.lv_cdn_diag "" UBYTE _CNV_S_2_RANGE______21_CM 1 100. 0. 1. DISPLAY_IDENTIFIER LV_CDN_DIAG_VLS_DOWN_PUC_2 ECU_ADDRESS 0x3fbb61 BIT_MASK 0x10 /end MEASUREMENT
/begin MEASUREMENT fmy_stat_vls_down_puc_2.err_info_stat.err_sym "" UBYTE _CNV_S_6_RANGE_ERR__193_CM 1 100. 0. 15. DISPLAY_IDENTIFIER ERR_SYM_VLS_DOWN_PUC_2 ECU_ADDRESS 0x3fbb61 BIT_MASK 0xF /end MEASUREMENT
/begin MEASUREMENT fmy_stat_vls_down_fl_1.ctr_abc "" UBYTE _CNV_A_R_LINEAR_____0_CM 1 100. 0. 255. DISPLAY_IDENTIFIER CTR_ABC_VLS_DOWN_FL_1 ECU_ADDRESS 0x3fbb67 FORMAT "%3.0" /end MEASUREMENT
/begin MEASUREMENT fmy_stat_vls_down_fl_1.ctr_end_diag "" UBYTE _CNV_A_R_LINEAR_____0_CM 1 100. 0. 255. DISPLAY_IDENTIFIER CTR_ABC_END_DIAG_VLS_DOWN_FL_1 ECU_ADDRESS 0x3fbb66 FORMAT "%3.0" /end MEASUREMENT
/begin MEASUREMENT fmy_stat_vls_down_fl_1.err_info_stat.lv_err_mem "" UBYTE _CNV_S_2_RANGE______21_CM 1 100. 0. 1. DISPLAY_IDENTIFIER LV_ERR_MEM_VLS_DOWN_FL_1 ECU_ADDRESS 0x3fbb65 BIT_MASK 0x80 /end MEASUREMENT
/begin MEASUREMENT fmy_stat_vls_down_fl_1.err_info_stat.lv_ready "" UBYTE _CNV_S_2_RANGE______21_CM 1 100. 0. 1. DISPLAY_IDENTIFIER LV_READY_VLS_DOWN_FL_1 ECU_ADDRESS 0x3fbb65 BIT_MASK 0x40 /end MEASUREMENT
/begin MEASUREMENT fmy_stat_vls_down_fl_1.err_info_stat.lv_end_diag "" UBYTE _CNV_S_2_RANGE______21_CM 1 100. 0. 1. DISPLAY_IDENTIFIER LV_END_DIAG_VLS_DOWN_FL_1 ECU_ADDRESS 0x3fbb65 BIT_MASK 0x20 /end MEASUREMENT
/begin MEASUREMENT fmy_stat_vls_down_fl_1.err_info_stat.lv_cdn_diag "" UBYTE _CNV_S_2_RANGE______21_CM 1 100. 0. 1. DISPLAY_IDENTIFIER LV_CDN_DIAG_VLS_DOWN_FL_1 ECU_ADDRESS 0x3fbb65 BIT_MASK 0x10 /end MEASUREMENT
/begin MEASUREMENT fmy_stat_vls_down_fl_1.err_info_stat.err_sym "" UBYTE _CNV_S_6_RANGE_ERR__193_CM 1 100. 0. 15. DISPLAY_IDENTIFIER ERR_SYM_VLS_DOWN_FL_1 ECU_ADDRESS 0x3fbb65 BIT_MASK 0xF /end MEASUREMENT
/begin MEASUREMENT fmy_stat_vls_down_fl_2.ctr_abc "" UBYTE _CNV_A_R_LINEAR_____0_CM 1 100. 0. 255. DISPLAY_IDENTIFIER CTR_ABC_VLS_DOWN_FL_2 ECU_ADDRESS 0x3fbb6b FORMAT "%3.0" /end MEASUREMENT
/begin MEASUREMENT fmy_stat_vls_down_fl_2.ctr_end_diag "" UBYTE _CNV_A_R_LINEAR_____0_CM 1 100. 0. 255. DISPLAY_IDENTIFIER CTR_ABC_END_DIAG_VLS_DOWN_FL_2 ECU_ADDRESS 0x3fbb6a FORMAT "%3.0" /end MEASUREMENT
/begin MEASUREMENT fmy_stat_vls_down_fl_2.err_info_stat.lv_err_mem "" UBYTE _CNV_S_2_RANGE______21_CM 1 100. 0. 1. DISPLAY_IDENTIFIER LV_ERR_MEM_VLS_DOWN_FL_2 ECU_ADDRESS 0x3fbb69 BIT_MASK 0x80 /end MEASUREMENT
/begin MEASUREMENT fmy_stat_vls_down_fl_2.err_info_stat.lv_ready "" UBYTE _CNV_S_2_RANGE______21_CM 1 100. 0. 1. DISPLAY_IDENTIFIER LV_READY_VLS_DOWN_FL_2 ECU_ADDRESS 0x3fbb69 BIT_MASK 0x40 /end MEASUREMENT
/begin MEASUREMENT fmy_stat_vls_down_fl_2.err_info_stat.lv_end_diag "" UBYTE _CNV_S_2_RANGE______21_CM 1 100. 0. 1. DISPLAY_IDENTIFIER LV_END_DIAG_VLS_DOWN_FL_2 ECU_ADDRESS 0x3fbb69 BIT_MASK 0x20 /end MEASUREMENT
/begin MEASUREMENT fmy_stat_vls_down_fl_2.err_info_stat.lv_cdn_diag "" UBYTE _CNV_S_2_RANGE______21_CM 1 100. 0. 1. DISPLAY_IDENTIFIER LV_CDN_DIAG_VLS_DOWN_FL_2 ECU_ADDRESS 0x3fbb69 BIT_MASK 0x10 /end MEASUREMENT
/begin MEASUREMENT fmy_stat_vls_down_fl_2.err_info_stat.err_sym "" UBYTE _CNV_S_6_RANGE_ERR__193_CM 1 100. 0. 15. DISPLAY_IDENTIFIER ERR_SYM_VLS_DOWN_FL_2 ECU_ADDRESS 0x3fbb69 BIT_MASK 0xF /end MEASUREMENT
/begin MEASUREMENT fmy_stat_chk_ls_down_1.ctr_abc "" UBYTE _CNV_A_R_LINEAR_____0_CM 1 100. 0. 255. DISPLAY_IDENTIFIER CTR_ABC_CHK_LS_DOWN_1 ECU_ADDRESS 0x3fbb6f FORMAT "%3.0" /end MEASUREMENT
/begin MEASUREMENT fmy_stat_chk_ls_down_1.ctr_end_diag "" UBYTE _CNV_A_R_LINEAR_____0_CM 1 100. 0. 255. DISPLAY_IDENTIFIER CTR_ABC_END_DIAG_CHK_LS_DOWN_1 ECU_ADDRESS 0x3fbb6e FORMAT "%3.0" /end MEASUREMENT
/begin MEASUREMENT fmy_stat_chk_ls_down_1.err_info_stat.lv_err_mem "" UBYTE _CNV_S_2_RANGE______21_CM 1 100. 0. 1. DISPLAY_IDENTIFIER LV_ERR_MEM_CHK_LS_DOWN_1 ECU_ADDRESS 0x3fbb6d BIT_MASK 0x80 /end MEASUREMENT
/begin MEASUREMENT fmy_stat_chk_ls_down_1.err_info_stat.lv_ready "" UBYTE _CNV_S_2_RANGE______21_CM 1 100. 0. 1. DISPLAY_IDENTIFIER LV_READY_CHK_LS_DOWN_1 ECU_ADDRESS 0x3fbb6d BIT_MASK 0x40 /end MEASUREMENT
/begin MEASUREMENT fmy_stat_chk_ls_down_1.err_info_stat.lv_end_diag "" UBYTE _CNV_S_2_RANGE______21_CM 1 100. 0. 1. DISPLAY_IDENTIFIER LV_END_DIAG_CHK_LS_DOWN_1 ECU_ADDRESS 0x3fbb6d BIT_MASK 0x20 /end MEASUREMENT
/begin MEASUREMENT fmy_stat_chk_ls_down_1.err_info_stat.lv_cdn_diag "" UBYTE _CNV_S_2_RANGE______21_CM 1 100. 0. 1. DISPLAY_IDENTIFIER LV_CDN_DIAG_CHK_LS_DOWN_1 ECU_ADDRESS 0x3fbb6d BIT_MASK 0x10 /end MEASUREMENT
/begin MEASUREMENT fmy_stat_chk_ls_down_1.err_info_stat.err_sym "" UBYTE _CNV_S_6_RANGE_ERR__193_CM 1 100. 0. 15. DISPLAY_IDENTIFIER ERR_SYM_CHK_LS_DOWN_1 ECU_ADDRESS 0x3fbb6d BIT_MASK 0xF /end MEASUREMENT
/begin MEASUREMENT fmy_stat_chk_ls_down_2.ctr_abc "" UBYTE _CNV_A_R_LINEAR_____0_CM 1 100. 0. 255. DISPLAY_IDENTIFIER CTR_ABC_CHK_LS_DOWN_2 ECU_ADDRESS 0x3fbb73 FORMAT "%3.0" /end MEASUREMENT
/begin MEASUREMENT fmy_stat_chk_ls_down_2.ctr_end_diag "" UBYTE _CNV_A_R_LINEAR_____0_CM 1 100. 0. 255. DISPLAY_IDENTIFIER CTR_ABC_END_DIAG_CHK_LS_DOWN_2 ECU_ADDRESS 0x3fbb72 FORMAT "%3.0" /end MEASUREMENT
/begin MEASUREMENT fmy_stat_chk_ls_down_2.err_info_stat.lv_err_mem "" UBYTE _CNV_S_2_RANGE______21_CM 1 100. 0. 1. DISPLAY_IDENTIFIER LV_ERR_MEM_CHK_LS_DOWN_2 ECU_ADDRESS 0x3fbb71 BIT_MASK 0x80 /end MEASUREMENT
/begin MEASUREMENT fmy_stat_chk_ls_down_2.err_info_stat.lv_ready "" UBYTE _CNV_S_2_RANGE______21_CM 1 100. 0. 1. DISPLAY_IDENTIFIER LV_READY_CHK_LS_DOWN_2 ECU_ADDRESS 0x3fbb71 BIT_MASK 0x40 /end MEASUREMENT
/begin MEASUREMENT fmy_stat_chk_ls_down_2.err_info_stat.lv_end_diag "" UBYTE _CNV_S_2_RANGE______21_CM 1 100. 0. 1. DISPLAY_IDENTIFIER LV_END_DIAG_CHK_LS_DOWN_2 ECU_ADDRESS 0x3fbb71 BIT_MASK 0x20 /end MEASUREMENT
/begin MEASUREMENT fmy_stat_chk_ls_down_2.err_info_stat.lv_cdn_diag "" UBYTE _CNV_S_2_RANGE______21_CM 1 100. 0. 1. DISPLAY_IDENTIFIER LV_CDN_DIAG_CHK_LS_DOWN_2 ECU_ADDRESS 0x3fbb71 BIT_MASK 0x10 /end MEASUREMENT
/begin MEASUREMENT fmy_stat_chk_ls_down_2.err_info_stat.err_sym "" UBYTE _CNV_S_6_RANGE_ERR__193_CM 1 100. 0. 15. DISPLAY_IDENTIFIER ERR_SYM_CHK_LS_DOWN_2 ECU_ADDRESS 0x3fbb71 BIT_MASK 0xF /end MEASUREMENT
/begin MEASUREMENT fmy_stat_delta_lamb_i_1.ctr_abc "" UBYTE _CNV_A_R_LINEAR_____0_CM 1 100. 0. 255. DISPLAY_IDENTIFIER CTR_ABC_DELTA_LAMB_I_1 ECU_ADDRESS 0x3fbb77 FORMAT "%3.0" /end MEASUREMENT
/begin MEASUREMENT fmy_stat_delta_lamb_i_1.ctr_end_diag "" UBYTE _CNV_A_R_LINEAR_____0_CM 1 100. 0. 255. DISPLAY_IDENTIFIER CTR_ABC_END_DIAG_DELTA_LAMB_I_1 ECU_ADDRESS 0x3fbb76 FORMAT "%3.0" /end MEASUREMENT
/begin MEASUREMENT fmy_stat_delta_lamb_i_1.err_info_stat.lv_err_mem "" UBYTE _CNV_S_2_RANGE______21_CM 1 100. 0. 1. DISPLAY_IDENTIFIER LV_ERR_MEM_DELTA_LAMB_I_1 ECU_ADDRESS 0x3fbb75 BIT_MASK 0x80 /end MEASUREMENT
/begin MEASUREMENT fmy_stat_delta_lamb_i_1.err_info_stat.lv_ready "" UBYTE _CNV_S_2_RANGE______21_CM 1 100. 0. 1. DISPLAY_IDENTIFIER LV_READY_DELTA_LAMB_I_1 ECU_ADDRESS 0x3fbb75 BIT_MASK 0x40 /end MEASUREMENT
/begin MEASUREMENT fmy_stat_delta_lamb_i_1.err_info_stat.lv_end_diag "" UBYTE _CNV_S_2_RANGE______21_CM 1 100. 0. 1. DISPLAY_IDENTIFIER LV_END_DIAG_DELTA_LAMB_I_1 ECU_ADDRESS 0x3fbb75 BIT_MASK 0x20 /end MEASUREMENT
/begin MEASUREMENT fmy_stat_delta_lamb_i_1.err_info_stat.lv_cdn_diag "" UBYTE _CNV_S_2_RANGE______21_CM 1 100. 0. 1. DISPLAY_IDENTIFIER LV_CDN_DIAG_DELTA_LAMB_I_1 ECU_ADDRESS 0x3fbb75 BIT_MASK 0x10 /end MEASUREMENT
/begin MEASUREMENT fmy_stat_delta_lamb_i_1.err_info_stat.err_sym "" UBYTE _CNV_S_6_RANGE_ERR__193_CM 1 100. 0. 15. DISPLAY_IDENTIFIER ERR_SYM_DELTA_LAMB_I_1 ECU_ADDRESS 0x3fbb75 BIT_MASK 0xF /end MEASUREMENT
/begin MEASUREMENT fmy_stat_delta_lamb_i_2.ctr_abc "" UBYTE _CNV_A_R_LINEAR_____0_CM 1 100. 0. 255. DISPLAY_IDENTIFIER CTR_ABC_DELTA_LAMB_I_2 ECU_ADDRESS 0x3fbb7b FORMAT "%3.0" /end MEASUREMENT
/begin MEASUREMENT fmy_stat_delta_lamb_i_2.ctr_end_diag "" UBYTE _CNV_A_R_LINEAR_____0_CM 1 100. 0. 255. DISPLAY_IDENTIFIER CTR_ABC_END_DIAG_DELTA_LAMB_I_2 ECU_ADDRESS 0x3fbb7a FORMAT "%3.0" /end MEASUREMENT
/begin MEASUREMENT fmy_stat_delta_lamb_i_2.err_info_stat.lv_err_mem "" UBYTE _CNV_S_2_RANGE______21_CM 1 100. 0. 1. DISPLAY_IDENTIFIER LV_ERR_MEM_DELTA_LAMB_I_2 ECU_ADDRESS 0x3fbb79 BIT_MASK 0x80 /end MEASUREMENT
/begin MEASUREMENT fmy_stat_delta_lamb_i_2.err_info_stat.lv_ready "" UBYTE _CNV_S_2_RANGE______21_CM 1 100. 0. 1. DISPLAY_IDENTIFIER LV_READY_DELTA_LAMB_I_2 ECU_ADDRESS 0x3fbb79 BIT_MASK 0x40 /end MEASUREMENT
/begin MEASUREMENT fmy_stat_delta_lamb_i_2.err_info_stat.lv_end_diag "" UBYTE _CNV_S_2_RANGE______21_CM 1 100. 0. 1. DISPLAY_IDENTIFIER LV_END_DIAG_DELTA_LAMB_I_2 ECU_ADDRESS 0x3fbb79 BIT_MASK 0x20 /end MEASUREMENT
/begin MEASUREMENT fmy_stat_delta_lamb_i_2.err_info_stat.lv_cdn_diag "" UBYTE _CNV_S_2_RANGE______21_CM 1 100. 0. 1. DISPLAY_IDENTIFIER LV_CDN_DIAG_DELTA_LAMB_I_2 ECU_ADDRESS 0x3fbb79 BIT_MASK 0x10 /end MEASUREMENT
/begin MEASUREMENT fmy_stat_delta_lamb_i_2.err_info_stat.err_sym "" UBYTE _CNV_S_6_RANGE_ERR__193_CM 1 100. 0. 15. DISPLAY_IDENTIFIER ERR_SYM_DELTA_LAMB_I_2 ECU_ADDRESS 0x3fbb79 BIT_MASK 0xF /end MEASUREMENT
/begin MEASUREMENT fmy_stat_o3_up.ctr_abc "" UBYTE _CNV_A_R_LINEAR_____0_CM 1 100. 0. 255. DISPLAY_IDENTIFIER CTR_ABC_O3_UP ECU_ADDRESS 0x3fbb7f FORMAT "%3.0" /end MEASUREMENT
/begin MEASUREMENT fmy_stat_o3_up.ctr_end_diag "" UBYTE _CNV_A_R_LINEAR_____0_CM 1 100. 0. 255. DISPLAY_IDENTIFIER CTR_ABC_END_DIAG_O3_UP ECU_ADDRESS 0x3fbb7e FORMAT "%3.0" /end MEASUREMENT
/begin MEASUREMENT fmy_stat_o3_up.err_info_stat.lv_err_mem "" UBYTE _CNV_S_2_RANGE______21_CM 1 100. 0. 1. DISPLAY_IDENTIFIER LV_ERR_MEM_O3_UP ECU_ADDRESS 0x3fbb7d BIT_MASK 0x80 /end MEASUREMENT
/begin MEASUREMENT fmy_stat_o3_up.err_info_stat.lv_ready "" UBYTE _CNV_S_2_RANGE______21_CM 1 100. 0. 1. DISPLAY_IDENTIFIER LV_READY_O3_UP ECU_ADDRESS 0x3fbb7d BIT_MASK 0x40 /end MEASUREMENT
/begin MEASUREMENT fmy_stat_o3_up.err_info_stat.lv_end_diag "" UBYTE _CNV_S_2_RANGE______21_CM 1 100. 0. 1. DISPLAY_IDENTIFIER LV_END_DIAG_O3_UP ECU_ADDRESS 0x3fbb7d BIT_MASK 0x20 /end MEASUREMENT
/begin MEASUREMENT fmy_stat_o3_up.err_info_stat.lv_cdn_diag "" UBYTE _CNV_S_2_RANGE______21_CM 1 100. 0. 1. DISPLAY_IDENTIFIER LV_CDN_DIAG_O3_UP ECU_ADDRESS 0x3fbb7d BIT_MASK 0x10 /end MEASUREMENT
/begin MEASUREMENT fmy_stat_o3_up.err_info_stat.err_sym "" UBYTE _CNV_S_6_RANGE_ERR__193_CM 1 100. 0. 15. DISPLAY_IDENTIFIER ERR_SYM_O3_UP ECU_ADDRESS 0x3fbb7d BIT_MASK 0xF /end MEASUREMENT
/begin MEASUREMENT fmy_stat_o3_down.ctr_abc "" UBYTE _CNV_A_R_LINEAR_____0_CM 1 100. 0. 255. DISPLAY_IDENTIFIER CTR_ABC_O3_DOWN ECU_ADDRESS 0x3fbb83 FORMAT "%3.0" /end MEASUREMENT
/begin MEASUREMENT fmy_stat_o3_down.ctr_end_diag "" UBYTE _CNV_A_R_LINEAR_____0_CM 1 100. 0. 255. DISPLAY_IDENTIFIER CTR_ABC_END_DIAG_O3_DOWN ECU_ADDRESS 0x3fbb82 FORMAT "%3.0" /end MEASUREMENT
/begin MEASUREMENT fmy_stat_o3_down.err_info_stat.lv_err_mem "" UBYTE _CNV_S_2_RANGE______21_CM 1 100. 0. 1. DISPLAY_IDENTIFIER LV_ERR_MEM_O3_DOWN ECU_ADDRESS 0x3fbb81 BIT_MASK 0x80 /end MEASUREMENT
/begin MEASUREMENT fmy_stat_o3_down.err_info_stat.lv_ready "" UBYTE _CNV_S_2_RANGE______21_CM 1 100. 0. 1. DISPLAY_IDENTIFIER LV_READY_O3_DOWN ECU_ADDRESS 0x3fbb81 BIT_MASK 0x40 /end MEASUREMENT
/begin MEASUREMENT fmy_stat_o3_down.err_info_stat.lv_end_diag "" UBYTE _CNV_S_2_RANGE______21_CM 1 100. 0. 1. DISPLAY_IDENTIFIER LV_END_DIAG_O3_DOWN ECU_ADDRESS 0x3fbb81 BIT_MASK 0x20 /end MEASUREMENT
/begin MEASUREMENT fmy_stat_o3_down.err_info_stat.lv_cdn_diag "" UBYTE _CNV_S_2_RANGE______21_CM 1 100. 0. 1. DISPLAY_IDENTIFIER LV_CDN_DIAG_O3_DOWN ECU_ADDRESS 0x3fbb81 BIT_MASK 0x10 /end MEASUREMENT
/begin MEASUREMENT fmy_stat_o3_down.err_info_stat.err_sym "" UBYTE _CNV_S_6_RANGE_ERR__193_CM 1 100. 0. 15. DISPLAY_IDENTIFIER ERR_SYM_O3_DOWN ECU_ADDRESS 0x3fbb81 BIT_MASK 0xF /end MEASUREMENT
/begin MEASUREMENT fmy_stat_obd2_ttip_ls_up_1.ctr_abc "" UBYTE _CNV_A_R_LINEAR_____0_CM 1 100. 0. 255. DISPLAY_IDENTIFIER CTR_ABC_OBD2_TTIP_LS_UP_1 ECU_ADDRESS 0x3fbb87 FORMAT "%3.0" /end MEASUREMENT
/begin MEASUREMENT fmy_stat_obd2_ttip_ls_up_1.ctr_end_diag "" UBYTE _CNV_A_R_LINEAR_____0_CM 1 100. 0. 255. DISPLAY_IDENTIFIER CTR_ABC_END_DIAG_OBD2_TTIP_LS_UP ECU_ADDRESS 0x3fbb86 FORMAT "%3.0" /end MEASUREMENT
/begin MEASUREMENT fmy_stat_obd2_ttip_ls_up_1.err_info_stat.lv_err_mem "" UBYTE _CNV_S_2_RANGE______21_CM 1 100. 0. 1. DISPLAY_IDENTIFIER LV_ERR_MEM_OBD2_TTIP_LS_UP_1 ECU_ADDRESS 0x3fbb85 BIT_MASK 0x80 /end MEASUREMENT
/begin MEASUREMENT fmy_stat_obd2_ttip_ls_up_1.err_info_stat.lv_ready "" UBYTE _CNV_S_2_RANGE______21_CM 1 100. 0. 1. DISPLAY_IDENTIFIER LV_READY_OBD2_TTIP_LS_UP_1 ECU_ADDRESS 0x3fbb85 BIT_MASK 0x40 /end MEASUREMENT
/begin MEASUREMENT fmy_stat_obd2_ttip_ls_up_1.err_info_stat.lv_end_diag "" UBYTE _CNV_S_2_RANGE______21_CM 1 100. 0. 1. DISPLAY_IDENTIFIER LV_END_DIAG_OBD2_TTIP_LS_UP_1 ECU_ADDRESS 0x3fbb85 BIT_MASK 0x20 /end MEASUREMENT
/begin MEASUREMENT fmy_stat_obd2_ttip_ls_up_1.err_info_stat.lv_cdn_diag "" UBYTE _CNV_S_2_RANGE______21_CM 1 100. 0. 1. DISPLAY_IDENTIFIER LV_CDN_DIAG_OBD2_TTIP_LS_UP_1 ECU_ADDRESS 0x3fbb85 BIT_MASK 0x10 /end MEASUREMENT
/begin MEASUREMENT fmy_stat_obd2_ttip_ls_up_1.err_info_stat.err_sym "" UBYTE _CNV_S_6_RANGE_ERR__193_CM 1 100. 0. 15. DISPLAY_IDENTIFIER ERR_SYM_OBD2_TTIP_LS_UP_1 ECU_ADDRESS 0x3fbb85 BIT_MASK 0xF /end MEASUREMENT
/begin MEASUREMENT fmy_stat_obd2_ttip_ls_up_2.ctr_abc "" UBYTE _CNV_A_R_LINEAR_____0_CM 1 100. 0. 255. DISPLAY_IDENTIFIER CTR_ABC_OBD2_TTIP_LS_UP_2 ECU_ADDRESS 0x3fbb8b FORMAT "%3.0" /end MEASUREMENT
/begin MEASUREMENT fmy_stat_obd2_ttip_ls_up_2.ctr_end_diag "" UBYTE _CNV_A_R_LINEAR_____0_CM 1 100. 0. 255. DISPLAY_IDENTIFIER CTR_ABC_END_DIAG_OBD2_TTIP_LS_UP ECU_ADDRESS 0x3fbb8a FORMAT "%3.0" /end MEASUREMENT
/begin MEASUREMENT fmy_stat_obd2_ttip_ls_up_2.err_info_stat.lv_err_mem "" UBYTE _CNV_S_2_RANGE______21_CM 1 100. 0. 1. DISPLAY_IDENTIFIER LV_ERR_MEM_OBD2_TTIP_LS_UP_2 ECU_ADDRESS 0x3fbb89 BIT_MASK 0x80 /end MEASUREMENT
/begin MEASUREMENT fmy_stat_obd2_ttip_ls_up_2.err_info_stat.lv_ready "" UBYTE _CNV_S_2_RANGE______21_CM 1 100. 0. 1. DISPLAY_IDENTIFIER LV_READY_OBD2_TTIP_LS_UP_2 ECU_ADDRESS 0x3fbb89 BIT_MASK 0x40 /end MEASUREMENT
/begin MEASUREMENT fmy_stat_obd2_ttip_ls_up_2.err_info_stat.lv_end_diag "" UBYTE _CNV_S_2_RANGE______21_CM 1 100. 0. 1. DISPLAY_IDENTIFIER LV_END_DIAG_OBD2_TTIP_LS_UP_2 ECU_ADDRESS 0x3fbb89 BIT_MASK 0x20 /end MEASUREMENT
/begin MEASUREMENT fmy_stat_obd2_ttip_ls_up_2.err_info_stat.lv_cdn_diag "" UBYTE _CNV_S_2_RANGE______21_CM 1 100. 0. 1. DISPLAY_IDENTIFIER LV_CDN_DIAG_OBD2_TTIP_LS_UP_2 ECU_ADDRESS 0x3fbb89 BIT_MASK 0x10 /end MEASUREMENT
/begin MEASUREMENT fmy_stat_obd2_ttip_ls_up_2.err_info_stat.err_sym "" UBYTE _CNV_S_6_RANGE_ERR__193_CM 1 100. 0. 15. DISPLAY_IDENTIFIER ERR_SYM_OBD2_TTIP_LS_UP_2 ECU_ADDRESS 0x3fbb89 BIT_MASK 0xF /end MEASUREMENT
/begin MEASUREMENT fmy_stat_lsh_ls_up_1.ctr_abc "" UBYTE _CNV_A_R_LINEAR_____0_CM 1 100. 0. 255. DISPLAY_IDENTIFIER CTR_ABC_LSH_LS_UP_1 ECU_ADDRESS 0x3fbb8f FORMAT "%3.0" /end MEASUREMENT
/begin MEASUREMENT fmy_stat_lsh_ls_up_1.ctr_end_diag "" UBYTE _CNV_A_R_LINEAR_____0_CM 1 100. 0. 255. DISPLAY_IDENTIFIER CTR_ABC_END_DIAG_LSH_LS_UP_1 ECU_ADDRESS 0x3fbb8e FORMAT "%3.0" /end MEASUREMENT
/begin MEASUREMENT fmy_stat_lsh_ls_up_1.err_info_stat.lv_err_mem "" UBYTE _CNV_S_2_RANGE______21_CM 1 100. 0. 1. DISPLAY_IDENTIFIER LV_ERR_MEM_LSH_LS_UP_1 ECU_ADDRESS 0x3fbb8d BIT_MASK 0x80 /end MEASUREMENT
/begin MEASUREMENT fmy_stat_lsh_ls_up_1.err_info_stat.lv_ready "" UBYTE _CNV_S_2_RANGE______21_CM 1 100. 0. 1. DISPLAY_IDENTIFIER LV_READY_LSH_LS_UP_1 ECU_ADDRESS 0x3fbb8d BIT_MASK 0x40 /end MEASUREMENT
/begin MEASUREMENT fmy_stat_lsh_ls_up_1.err_info_stat.lv_end_diag "" UBYTE _CNV_S_2_RANGE______21_CM 1 100. 0. 1. DISPLAY_IDENTIFIER LV_END_DIAG_LSH_LS_UP_1 ECU_ADDRESS 0x3fbb8d BIT_MASK 0x20 /end MEASUREMENT
/begin MEASUREMENT fmy_stat_lsh_ls_up_1.err_info_stat.lv_cdn_diag "" UBYTE _CNV_S_2_RANGE______21_CM 1 100. 0. 1. DISPLAY_IDENTIFIER LV_CDN_DIAG_LSH_LS_UP_1 ECU_ADDRESS 0x3fbb8d BIT_MASK 0x10 /end MEASUREMENT
/begin MEASUREMENT fmy_stat_lsh_ls_up_1.err_info_stat.err_sym "" UBYTE _CNV_S_6_RANGE_ERR__193_CM 1 100. 0. 15. DISPLAY_IDENTIFIER ERR_SYM_LSH_LS_UP_1 ECU_ADDRESS 0x3fbb8d BIT_MASK 0xF /end MEASUREMENT
/begin MEASUREMENT fmy_stat_lsh_ls_up_2.ctr_abc "" UBYTE _CNV_A_R_LINEAR_____0_CM 1 100. 0. 255. DISPLAY_IDENTIFIER CTR_ABC_LSH_LS_UP_2 ECU_ADDRESS 0x3fbb93 FORMAT "%3.0" /end MEASUREMENT
/begin MEASUREMENT fmy_stat_lsh_ls_up_2.ctr_end_diag "" UBYTE _CNV_A_R_LINEAR_____0_CM 1 100. 0. 255. DISPLAY_IDENTIFIER CTR_ABC_END_DIAG_LSH_LS_UP_2 ECU_ADDRESS 0x3fbb92 FORMAT "%3.0" /end MEASUREMENT
/begin MEASUREMENT fmy_stat_lsh_ls_up_2.err_info_stat.lv_err_mem "" UBYTE _CNV_S_2_RANGE______21_CM 1 100. 0. 1. DISPLAY_IDENTIFIER LV_ERR_MEM_LSH_LS_UP_2 ECU_ADDRESS 0x3fbb91 BIT_MASK 0x80 /end MEASUREMENT
/begin MEASUREMENT fmy_stat_lsh_ls_up_2.err_info_stat.lv_ready "" UBYTE _CNV_S_2_RANGE______21_CM 1 100. 0. 1. DISPLAY_IDENTIFIER LV_READY_LSH_LS_UP_2 ECU_ADDRESS 0x3fbb91 BIT_MASK 0x40 /end MEASUREMENT
/begin MEASUREMENT fmy_stat_lsh_ls_up_2.err_info_stat.lv_end_diag "" UBYTE _CNV_S_2_RANGE______21_CM 1 100. 0. 1. DISPLAY_IDENTIFIER LV_END_DIAG_LSH_LS_UP_2 ECU_ADDRESS 0x3fbb91 BIT_MASK 0x20 /end MEASUREMENT
/begin MEASUREMENT fmy_stat_lsh_ls_up_2.err_info_stat.lv_cdn_diag "" UBYTE _CNV_S_2_RANGE______21_CM 1 100. 0. 1. DISPLAY_IDENTIFIER LV_CDN_DIAG_LSH_LS_UP_2 ECU_ADDRESS 0x3fbb91 BIT_MASK 0x10 /end MEASUREMENT
/begin MEASUREMENT fmy_stat_lsh_ls_up_2.err_info_stat.err_sym "" UBYTE _CNV_S_6_RANGE_ERR__193_CM 1 100. 0. 15. DISPLAY_IDENTIFIER ERR_SYM_LSH_LS_UP_2 ECU_ADDRESS 0x3fbb91 BIT_MASK 0xF /end MEASUREMENT
/begin MEASUREMENT fmy_stat_vls_up_thd_over_1.ctr_abc "" UBYTE _CNV_A_R_LINEAR_____0_CM 1 100. 0. 255. DISPLAY_IDENTIFIER CTR_ABC_VLS_UP_THD_OVER_1 ECU_ADDRESS 0x3fbb97 FORMAT "%3.0" /end MEASUREMENT
/begin MEASUREMENT fmy_stat_vls_up_thd_over_1.ctr_end_diag "" UBYTE _CNV_A_R_LINEAR_____0_CM 1 100. 0. 255. DISPLAY_IDENTIFIER CTR_ABC_END_DIAG_VLS_UP_THD_OVER ECU_ADDRESS 0x3fbb96 FORMAT "%3.0" /end MEASUREMENT
/begin MEASUREMENT fmy_stat_vls_up_thd_over_1.err_info_stat.lv_err_mem "" UBYTE _CNV_S_2_RANGE______21_CM 1 100. 0. 1. DISPLAY_IDENTIFIER LV_ERR_MEM_VLS_UP_THD_OVER_1 ECU_ADDRESS 0x3fbb95 BIT_MASK 0x80 /end MEASUREMENT
/begin MEASUREMENT fmy_stat_vls_up_thd_over_1.err_info_stat.lv_ready "" UBYTE _CNV_S_2_RANGE______21_CM 1 100. 0. 1. DISPLAY_IDENTIFIER LV_READY_VLS_UP_THD_OVER_1 ECU_ADDRESS 0x3fbb95 BIT_MASK 0x40 /end MEASUREMENT
/begin MEASUREMENT fmy_stat_vls_up_thd_over_1.err_info_stat.lv_end_diag "" UBYTE _CNV_S_2_RANGE______21_CM 1 100. 0. 1. DISPLAY_IDENTIFIER LV_END_DIAG_VLS_UP_THD_OVER_1 ECU_ADDRESS 0x3fbb95 BIT_MASK 0x20 /end MEASUREMENT
/begin MEASUREMENT fmy_stat_vls_up_thd_over_1.err_info_stat.lv_cdn_diag "" UBYTE _CNV_S_2_RANGE______21_CM 1 100. 0. 1. DISPLAY_IDENTIFIER LV_CDN_DIAG_VLS_UP_THD_OVER_1 ECU_ADDRESS 0x3fbb95 BIT_MASK 0x10 /end MEASUREMENT
/begin MEASUREMENT fmy_stat_vls_up_thd_over_1.err_info_stat.err_sym "" UBYTE _CNV_S_6_RANGE_ERR__193_CM 1 100. 0. 15. DISPLAY_IDENTIFIER ERR_SYM_VLS_UP_THD_OVER_1 ECU_ADDRESS 0x3fbb95 BIT_MASK 0xF /end MEASUREMENT
/begin MEASUREMENT fmy_stat_vls_up_thd_over_2.ctr_abc "" UBYTE _CNV_A_R_LINEAR_____0_CM 1 100. 0. 255. DISPLAY_IDENTIFIER CTR_ABC_VLS_UP_THD_OVER_2 ECU_ADDRESS 0x3fbb9b FORMAT "%3.0" /end MEASUREMENT
/begin MEASUREMENT fmy_stat_vls_up_thd_over_2.ctr_end_diag "" UBYTE _CNV_A_R_LINEAR_____0_CM 1 100. 0. 255. DISPLAY_IDENTIFIER CTR_ABC_END_DIAG_VLS_UP_THD_OVER ECU_ADDRESS 0x3fbb9a FORMAT "%3.0" /end MEASUREMENT
/begin MEASUREMENT fmy_stat_vls_up_thd_over_2.err_info_stat.lv_err_mem "" UBYTE _CNV_S_2_RANGE______21_CM 1 100. 0. 1. DISPLAY_IDENTIFIER LV_ERR_MEM_VLS_UP_THD_OVER_2 ECU_ADDRESS 0x3fbb99 BIT_MASK 0x80 /end MEASUREMENT
/begin MEASUREMENT fmy_stat_vls_up_thd_over_2.err_info_stat.lv_ready "" UBYTE _CNV_S_2_RANGE______21_CM 1 100. 0. 1. DISPLAY_IDENTIFIER LV_READY_VLS_UP_THD_OVER_2 ECU_ADDRESS 0x3fbb99 BIT_MASK 0x40 /end MEASUREMENT
/begin MEASUREMENT fmy_stat_vls_up_thd_over_2.err_info_stat.lv_end_diag "" UBYTE _CNV_S_2_RANGE______21_CM 1 100. 0. 1. DISPLAY_IDENTIFIER LV_END_DIAG_VLS_UP_THD_OVER_2 ECU_ADDRESS 0x3fbb99 BIT_MASK 0x20 /end MEASUREMENT
/begin MEASUREMENT fmy_stat_vls_up_thd_over_2.err_info_stat.lv_cdn_diag "" UBYTE _CNV_S_2_RANGE______21_CM 1 100. 0. 1. DISPLAY_IDENTIFIER LV_CDN_DIAG_VLS_UP_THD_OVER_2 ECU_ADDRESS 0x3fbb99 BIT_MASK 0x10 /end MEASUREMENT
/begin MEASUREMENT fmy_stat_vls_up_thd_over_2.err_info_stat.err_sym "" UBYTE _CNV_S_6_RANGE_ERR__193_CM 1 100. 0. 15. DISPLAY_IDENTIFIER ERR_SYM_VLS_UP_THD_OVER_2 ECU_ADDRESS 0x3fbb99 BIT_MASK 0xF /end MEASUREMENT
/begin MEASUREMENT fmy_stat_tout_nox_sens_1.ctr_abc "" UBYTE _CNV_A_R_LINEAR_____0_CM 1 100. 0. 255. DISPLAY_IDENTIFIER CTR_ABC_TOUT_NOX_SENS_1 ECU_ADDRESS 0x3fbb9f FORMAT "%3.0" /end MEASUREMENT
/begin MEASUREMENT fmy_stat_tout_nox_sens_1.ctr_end_diag "" UBYTE _CNV_A_R_LINEAR_____0_CM 1 100. 0. 255. DISPLAY_IDENTIFIER CTR_ABC_END_DIAG_TOUT_NOX_SENS_1 ECU_ADDRESS 0x3fbb9e FORMAT "%3.0" /end MEASUREMENT
/begin MEASUREMENT fmy_stat_tout_nox_sens_1.err_info_stat.lv_err_mem "" UBYTE _CNV_S_2_RANGE______21_CM 1 100. 0. 1. DISPLAY_IDENTIFIER LV_ERR_MEM_TOUT_NOX_SENS_1 ECU_ADDRESS 0x3fbb9d BIT_MASK 0x80 /end MEASUREMENT
/begin MEASUREMENT fmy_stat_tout_nox_sens_1.err_info_stat.lv_ready "" UBYTE _CNV_S_2_RANGE______21_CM 1 100. 0. 1. DISPLAY_IDENTIFIER LV_READY_TOUT_NOX_SENS_1 ECU_ADDRESS 0x3fbb9d BIT_MASK 0x40 /end MEASUREMENT
/begin MEASUREMENT fmy_stat_tout_nox_sens_1.err_info_stat.lv_end_diag "" UBYTE _CNV_S_2_RANGE______21_CM 1 100. 0. 1. DISPLAY_IDENTIFIER LV_END_DIAG_TOUT_NOX_SENS_1 ECU_ADDRESS 0x3fbb9d BIT_MASK 0x20 /end MEASUREMENT
/begin MEASUREMENT fmy_stat_tout_nox_sens_1.err_info_stat.lv_cdn_diag "" UBYTE _CNV_S_2_RANGE______21_CM 1 100. 0. 1. DISPLAY_IDENTIFIER LV_CDN_DIAG_TOUT_NOX_SENS_1 ECU_ADDRESS 0x3fbb9d BIT_MASK 0x10 /end MEASUREMENT
/begin MEASUREMENT fmy_stat_tout_nox_sens_1.err_info_stat.err_sym "" UBYTE _CNV_S_6_RANGE_ERR__193_CM 1 100. 0. 15. DISPLAY_IDENTIFIER ERR_SYM_TOUT_NOX_SENS_1 ECU_ADDRESS 0x3fbb9d BIT_MASK 0xF /end MEASUREMENT
/begin MEASUREMENT fmy_stat_nox_sens_1.ctr_abc "" UBYTE _CNV_A_R_LINEAR_____0_CM 1 100. 0. 255. DISPLAY_IDENTIFIER CTR_ABC_NOX_SENS_1 ECU_ADDRESS 0x3fbba3 FORMAT "%3.0" /end MEASUREMENT
/begin MEASUREMENT fmy_stat_nox_sens_1.ctr_end_diag "" UBYTE _CNV_A_R_LINEAR_____0_CM 1 100. 0. 255. DISPLAY_IDENTIFIER CTR_ABC_END_DIAG_NOX_SENS_1 ECU_ADDRESS 0x3fbba2 FORMAT "%3.0" /end MEASUREMENT
/begin MEASUREMENT fmy_stat_nox_sens_1.err_info_stat.lv_err_mem "" UBYTE _CNV_S_2_RANGE______21_CM 1 100. 0. 1. DISPLAY_IDENTIFIER LV_ERR_MEM_NOX_SENS_1 ECU_ADDRESS 0x3fbba1 BIT_MASK 0x80 /end MEASUREMENT
/begin MEASUREMENT fmy_stat_nox_sens_1.err_info_stat.lv_ready "" UBYTE _CNV_S_2_RANGE______21_CM 1 100. 0. 1. DISPLAY_IDENTIFIER LV_READY_NOX_SENS_1 ECU_ADDRESS 0x3fbba1 BIT_MASK 0x40 /end MEASUREMENT
/begin MEASUREMENT fmy_stat_nox_sens_1.err_info_stat.lv_end_diag "" UBYTE _CNV_S_2_RANGE______21_CM 1 100. 0. 1. DISPLAY_IDENTIFIER LV_END_DIAG_NOX_SENS_1 ECU_ADDRESS 0x3fbba1 BIT_MASK 0x20 /end MEASUREMENT
/begin MEASUREMENT fmy_stat_nox_sens_1.err_info_stat.lv_cdn_diag "" UBYTE _CNV_S_2_RANGE______21_CM 1 100. 0. 1. DISPLAY_IDENTIFIER LV_CDN_DIAG_NOX_SENS_1 ECU_ADDRESS 0x3fbba1 BIT_MASK 0x10 /end MEASUREMENT
/begin MEASUREMENT fmy_stat_nox_sens_1.err_info_stat.err_sym "" UBYTE _CNV_S_6_RANGE_ERR__193_CM 1 100. 0. 15. DISPLAY_IDENTIFIER ERR_SYM_NOX_SENS_1 ECU_ADDRESS 0x3fbba1 BIT_MASK 0xF /end MEASUREMENT
/begin MEASUREMENT fmy_stat_tout_nox_sens_2.ctr_abc "" UBYTE _CNV_A_R_LINEAR_____0_CM 1 100. 0. 255. DISPLAY_IDENTIFIER CTR_ABC_TOUT_NOX_SENS_2 ECU_ADDRESS 0x3fbba7 FORMAT "%3.0" /end MEASUREMENT
/begin MEASUREMENT fmy_stat_tout_nox_sens_2.ctr_end_diag "" UBYTE _CNV_A_R_LINEAR_____0_CM 1 100. 0. 255. DISPLAY_IDENTIFIER CTR_ABC_END_DIAG_TOUT_NOX_SENS_2 ECU_ADDRESS 0x3fbba6 FORMAT "%3.0" /end MEASUREMENT
/begin MEASUREMENT fmy_stat_tout_nox_sens_2.err_info_stat.lv_err_mem "" UBYTE _CNV_S_2_RANGE______21_CM 1 100. 0. 1. DISPLAY_IDENTIFIER LV_ERR_MEM_TOUT_NOX_SENS_2 ECU_ADDRESS 0x3fbba5 BIT_MASK 0x80 /end MEASUREMENT
/begin MEASUREMENT fmy_stat_tout_nox_sens_2.err_info_stat.lv_ready "" UBYTE _CNV_S_2_RANGE______21_CM 1 100. 0. 1. DISPLAY_IDENTIFIER LV_READY_TOUT_NOX_SENS_2 ECU_ADDRESS 0x3fbba5 BIT_MASK 0x40 /end MEASUREMENT
/begin MEASUREMENT fmy_stat_tout_nox_sens_2.err_info_stat.lv_end_diag "" UBYTE _CNV_S_2_RANGE______21_CM 1 100. 0. 1. DISPLAY_IDENTIFIER LV_END_DIAG_TOUT_NOX_SENS_2 ECU_ADDRESS 0x3fbba5 BIT_MASK 0x20 /end MEASUREMENT
/begin MEASUREMENT fmy_stat_tout_nox_sens_2.err_info_stat.lv_cdn_diag "" UBYTE _CNV_S_2_RANGE______21_CM 1 100. 0. 1. DISPLAY_IDENTIFIER LV_CDN_DIAG_TOUT_NOX_SENS_2 ECU_ADDRESS 0x3fbba5 BIT_MASK 0x10 /end MEASUREMENT
/begin MEASUREMENT fmy_stat_tout_nox_sens_2.err_info_stat.err_sym "" UBYTE _CNV_S_6_RANGE_ERR__193_CM 1 100. 0. 15. DISPLAY_IDENTIFIER ERR_SYM_TOUT_NOX_SENS_2 ECU_ADDRESS 0x3fbba5 BIT_MASK 0xF /end MEASUREMENT
/begin MEASUREMENT fmy_stat_nox_sens_2.ctr_abc "" UBYTE _CNV_A_R_LINEAR_____0_CM 1 100. 0. 255. DISPLAY_IDENTIFIER CTR_ABC_NOX_SENS_2 ECU_ADDRESS 0x3fbbab FORMAT "%3.0" /end MEASUREMENT
/begin MEASUREMENT fmy_stat_nox_sens_2.ctr_end_diag "" UBYTE _CNV_A_R_LINEAR_____0_CM 1 100. 0. 255. DISPLAY_IDENTIFIER CTR_ABC_END_DIAG_NOX_SENS_2 ECU_ADDRESS 0x3fbbaa FORMAT "%3.0" /end MEASUREMENT
/begin MEASUREMENT fmy_stat_nox_sens_2.err_info_stat.lv_err_mem "" UBYTE _CNV_S_2_RANGE______21_CM 1 100. 0. 1. DISPLAY_IDENTIFIER LV_ERR_MEM_NOX_SENS_2 ECU_ADDRESS 0x3fbba9 BIT_MASK 0x80 /end MEASUREMENT
/begin MEASUREMENT fmy_stat_nox_sens_2.err_info_stat.lv_ready "" UBYTE _CNV_S_2_RANGE______21_CM 1 100. 0. 1. DISPLAY_IDENTIFIER LV_READY_NOX_SENS_2 ECU_ADDRESS 0x3fbba9 BIT_MASK 0x40 /end MEASUREMENT
/begin MEASUREMENT fmy_stat_nox_sens_2.err_info_stat.lv_end_diag "" UBYTE _CNV_S_2_RANGE______21_CM 1 100. 0. 1. DISPLAY_IDENTIFIER LV_END_DIAG_NOX_SENS_2 ECU_ADDRESS 0x3fbba9 BIT_MASK 0x20 /end MEASUREMENT
/begin MEASUREMENT fmy_stat_nox_sens_2.err_info_stat.lv_cdn_diag "" UBYTE _CNV_S_2_RANGE______21_CM 1 100. 0. 1. DISPLAY_IDENTIFIER LV_CDN_DIAG_NOX_SENS_2 ECU_ADDRESS 0x3fbba9 BIT_MASK 0x10 /end MEASUREMENT
/begin MEASUREMENT fmy_stat_nox_sens_2.err_info_stat.err_sym "" UBYTE _CNV_S_6_RANGE_ERR__193_CM 1 100. 0. 15. DISPLAY_IDENTIFIER ERR_SYM_NOX_SENS_2 ECU_ADDRESS 0x3fbba9 BIT_MASK 0xF /end MEASUREMENT
/begin MEASUREMENT fmy_stat_if_lsl_1.ctr_abc "" UBYTE _CNV_A_R_LINEAR_____0_CM 1 100. 0. 255. DISPLAY_IDENTIFIER CTR_ABC_IF_LSL_1 ECU_ADDRESS 0x3fbbaf FORMAT "%3.0" /end MEASUREMENT
/begin MEASUREMENT fmy_stat_if_lsl_1.ctr_end_diag "" UBYTE _CNV_A_R_LINEAR_____0_CM 1 100. 0. 255. DISPLAY_IDENTIFIER CTR_ABC_END_DIAG_IF_LSL_1 ECU_ADDRESS 0x3fbbae FORMAT "%3.0" /end MEASUREMENT
/begin MEASUREMENT fmy_stat_if_lsl_1.err_info_stat.lv_err_mem "" UBYTE _CNV_S_2_RANGE______21_CM 1 100. 0. 1. DISPLAY_IDENTIFIER LV_ERR_MEM_IF_LSL_1 ECU_ADDRESS 0x3fbbad BIT_MASK 0x80 /end MEASUREMENT
/begin MEASUREMENT fmy_stat_if_lsl_1.err_info_stat.lv_ready "" UBYTE _CNV_S_2_RANGE______21_CM 1 100. 0. 1. DISPLAY_IDENTIFIER LV_READY_IF_LSL_1 ECU_ADDRESS 0x3fbbad BIT_MASK 0x40 /end MEASUREMENT
/begin MEASUREMENT fmy_stat_if_lsl_1.err_info_stat.lv_end_diag "" UBYTE _CNV_S_2_RANGE______21_CM 1 100. 0. 1. DISPLAY_IDENTIFIER LV_END_DIAG_IF_LSL_1 ECU_ADDRESS 0x3fbbad BIT_MASK 0x20 /end MEASUREMENT
/begin MEASUREMENT fmy_stat_if_lsl_1.err_info_stat.lv_cdn_diag "" UBYTE _CNV_S_2_RANGE______21_CM 1 100. 0. 1. DISPLAY_IDENTIFIER LV_CDN_DIAG_IF_LSL_1 ECU_ADDRESS 0x3fbbad BIT_MASK 0x10 /end MEASUREMENT
/begin MEASUREMENT fmy_stat_if_lsl_1.err_info_stat.err_sym "" UBYTE _CNV_S_6_RANGE_ERR__193_CM 1 100. 0. 15. DISPLAY_IDENTIFIER ERR_SYM_IF_LSL_1 ECU_ADDRESS 0x3fbbad BIT_MASK 0xF /end MEASUREMENT
/begin MEASUREMENT fmy_stat_if_lsl_2.ctr_abc "" UBYTE _CNV_A_R_LINEAR_____0_CM 1 100. 0. 255. DISPLAY_IDENTIFIER CTR_ABC_IF_LSL_2 ECU_ADDRESS 0x3fbbb3 FORMAT "%3.0" /end MEASUREMENT
/begin MEASUREMENT fmy_stat_if_lsl_2.ctr_end_diag "" UBYTE _CNV_A_R_LINEAR_____0_CM 1 100. 0. 255. DISPLAY_IDENTIFIER CTR_ABC_END_DIAG_IF_LSL_2 ECU_ADDRESS 0x3fbbb2 FORMAT "%3.0" /end MEASUREMENT
/begin MEASUREMENT fmy_stat_if_lsl_2.err_info_stat.lv_err_mem "" UBYTE _CNV_S_2_RANGE______21_CM 1 100. 0. 1. DISPLAY_IDENTIFIER LV_ERR_MEM_IF_LSL_2 ECU_ADDRESS 0x3fbbb1 BIT_MASK 0x80 /end MEASUREMENT
/begin MEASUREMENT fmy_stat_if_lsl_2.err_info_stat.lv_ready "" UBYTE _CNV_S_2_RANGE______21_CM 1 100. 0. 1. DISPLAY_IDENTIFIER LV_READY_IF_LSL_2 ECU_ADDRESS 0x3fbbb1 BIT_MASK 0x40 /end MEASUREMENT
/begin MEASUREMENT fmy_stat_if_lsl_2.err_info_stat.lv_end_diag "" UBYTE _CNV_S_2_RANGE______21_CM 1 100. 0. 1. DISPLAY_IDENTIFIER LV_END_DIAG_IF_LSL_2 ECU_ADDRESS 0x3fbbb1 BIT_MASK 0x20 /end MEASUREMENT
/begin MEASUREMENT fmy_stat_if_lsl_2.err_info_stat.lv_cdn_diag "" UBYTE _CNV_S_2_RANGE______21_CM 1 100. 0. 1. DISPLAY_IDENTIFIER LV_CDN_DIAG_IF_LSL_2 ECU_ADDRESS 0x3fbbb1 BIT_MASK 0x10 /end MEASUREMENT
/begin MEASUREMENT fmy_stat_if_lsl_2.err_info_stat.err_sym "" UBYTE _CNV_S_6_RANGE_ERR__193_CM 1 100. 0. 15. DISPLAY_IDENTIFIER ERR_SYM_IF_LSL_2 ECU_ADDRESS 0x3fbbb1 BIT_MASK 0xF /end MEASUREMENT
/begin MEASUREMENT fmy_stat_ls_up_dyn_vld_1.ctr_abc "" UBYTE _CNV_A_R_LINEAR_____0_CM 1 100. 0. 255. DISPLAY_IDENTIFIER CTR_ABC_LS_UP_DYN_VLD_1 ECU_ADDRESS 0x3fbbb7 FORMAT "%3.0" /end MEASUREMENT
/begin MEASUREMENT fmy_stat_ls_up_dyn_vld_1.ctr_end_diag "" UBYTE _CNV_A_R_LINEAR_____0_CM 1 100. 0. 255. DISPLAY_IDENTIFIER CTR_ABC_END_DIAG_LS_UP_DYN_VLD_1 ECU_ADDRESS 0x3fbbb6 FORMAT "%3.0" /end MEASUREMENT
/begin MEASUREMENT fmy_stat_ls_up_dyn_vld_1.err_info_stat.lv_err_mem "" UBYTE _CNV_S_2_RANGE______21_CM 1 100. 0. 1. DISPLAY_IDENTIFIER LV_ERR_MEM_LS_UP_DYN_VLD_1 ECU_ADDRESS 0x3fbbb5 BIT_MASK 0x80 /end MEASUREMENT
/begin MEASUREMENT fmy_stat_ls_up_dyn_vld_1.err_info_stat.lv_ready "" UBYTE _CNV_S_2_RANGE______21_CM 1 100. 0. 1. DISPLAY_IDENTIFIER LV_READY_LS_UP_DYN_VLD_1 ECU_ADDRESS 0x3fbbb5 BIT_MASK 0x40 /end MEASUREMENT
/begin MEASUREMENT fmy_stat_ls_up_dyn_vld_1.err_info_stat.lv_end_diag "" UBYTE _CNV_S_2_RANGE______21_CM 1 100. 0. 1. DISPLAY_IDENTIFIER LV_END_DIAG_LS_UP_DYN_VLD_1 ECU_ADDRESS 0x3fbbb5 BIT_MASK 0x20 /end MEASUREMENT
/begin MEASUREMENT fmy_stat_ls_up_dyn_vld_1.err_info_stat.lv_cdn_diag "" UBYTE _CNV_S_2_RANGE______21_CM 1 100. 0. 1. DISPLAY_IDENTIFIER LV_CDN_DIAG_LS_UP_DYN_VLD_1 ECU_ADDRESS 0x3fbbb5 BIT_MASK 0x10 /end MEASUREMENT
/begin MEASUREMENT fmy_stat_ls_up_dyn_vld_1.err_info_stat.err_sym "" UBYTE _CNV_S_6_RANGE_ERR__193_CM 1 100. 0. 15. DISPLAY_IDENTIFIER ERR_SYM_LS_UP_DYN_VLD_1 ECU_ADDRESS 0x3fbbb5 BIT_MASK 0xF /end MEASUREMENT
/begin MEASUREMENT fmy_stat_ls_up_dyn_vld_2.ctr_abc "" UBYTE _CNV_A_R_LINEAR_____0_CM 1 100. 0. 255. DISPLAY_IDENTIFIER CTR_ABC_LS_UP_DYN_VLD_2 ECU_ADDRESS 0x3fbbbb FORMAT "%3.0" /end MEASUREMENT
/begin MEASUREMENT fmy_stat_ls_up_dyn_vld_2.ctr_end_diag "" UBYTE _CNV_A_R_LINEAR_____0_CM 1 100. 0. 255. DISPLAY_IDENTIFIER CTR_ABC_END_DIAG_LS_UP_DYN_VLD_2 ECU_ADDRESS 0x3fbbba FORMAT "%3.0" /end MEASUREMENT
/begin MEASUREMENT fmy_stat_ls_up_dyn_vld_2.err_info_stat.lv_err_mem "" UBYTE _CNV_S_2_RANGE______21_CM 1 100. 0. 1. DISPLAY_IDENTIFIER LV_ERR_MEM_LS_UP_DYN_VLD_2 ECU_ADDRESS 0x3fbbb9 BIT_MASK 0x80 /end MEASUREMENT
/begin MEASUREMENT fmy_stat_ls_up_dyn_vld_2.err_info_stat.lv_ready "" UBYTE _CNV_S_2_RANGE______21_CM 1 100. 0. 1. DISPLAY_IDENTIFIER LV_READY_LS_UP_DYN_VLD_2 ECU_ADDRESS 0x3fbbb9 BIT_MASK 0x40 /end MEASUREMENT
/begin MEASUREMENT fmy_stat_ls_up_dyn_vld_2.err_info_stat.lv_end_diag "" UBYTE _CNV_S_2_RANGE______21_CM 1 100. 0. 1. DISPLAY_IDENTIFIER LV_END_DIAG_LS_UP_DYN_VLD_2 ECU_ADDRESS 0x3fbbb9 BIT_MASK 0x20 /end MEASUREMENT
/begin MEASUREMENT fmy_stat_ls_up_dyn_vld_2.err_info_stat.lv_cdn_diag "" UBYTE _CNV_S_2_RANGE______21_CM 1 100. 0. 1. DISPLAY_IDENTIFIER LV_CDN_DIAG_LS_UP_DYN_VLD_2 ECU_ADDRESS 0x3fbbb9 BIT_MASK 0x10 /end MEASUREMENT
/begin MEASUREMENT fmy_stat_ls_up_dyn_vld_2.err_info_stat.err_sym "" UBYTE _CNV_S_6_RANGE_ERR__193_CM 1 100. 0. 15. DISPLAY_IDENTIFIER ERR_SYM_LS_UP_DYN_VLD_2 ECU_ADDRESS 0x3fbbb9 BIT_MASK 0xF /end MEASUREMENT
/begin MEASUREMENT fmy_stat_ls_up_puc_vld_1.ctr_abc "" UBYTE _CNV_A_R_LINEAR_____0_CM 1 100. 0. 255. DISPLAY_IDENTIFIER CTR_ABC_LS_UP_PUC_VLD_1 ECU_ADDRESS 0x3fbbbf FORMAT "%3.0" /end MEASUREMENT
/begin MEASUREMENT fmy_stat_ls_up_puc_vld_1.ctr_end_diag "" UBYTE _CNV_A_R_LINEAR_____0_CM 1 100. 0. 255. DISPLAY_IDENTIFIER CTR_ABC_END_DIAG_LS_UP_PUC_VLD_1 ECU_ADDRESS 0x3fbbbe FORMAT "%3.0" /end MEASUREMENT
/begin MEASUREMENT fmy_stat_ls_up_puc_vld_1.err_info_stat.lv_err_mem "" UBYTE _CNV_S_2_RANGE______21_CM 1 100. 0. 1. DISPLAY_IDENTIFIER LV_ERR_MEM_LS_UP_PUC_VLD_1 ECU_ADDRESS 0x3fbbbd BIT_MASK 0x80 /end MEASUREMENT
/begin MEASUREMENT fmy_stat_ls_up_puc_vld_1.err_info_stat.lv_ready "" UBYTE _CNV_S_2_RANGE______21_CM 1 100. 0. 1. DISPLAY_IDENTIFIER LV_READY_LS_UP_PUC_VLD_1 ECU_ADDRESS 0x3fbbbd BIT_MASK 0x40 /end MEASUREMENT
/begin MEASUREMENT fmy_stat_ls_up_puc_vld_1.err_info_stat.lv_end_diag "" UBYTE _CNV_S_2_RANGE______21_CM 1 100. 0. 1. DISPLAY_IDENTIFIER LV_END_DIAG_LS_UP_PUC_VLD_1 ECU_ADDRESS 0x3fbbbd BIT_MASK 0x20 /end MEASUREMENT
/begin MEASUREMENT fmy_stat_ls_up_puc_vld_1.err_info_stat.lv_cdn_diag "" UBYTE _CNV_S_2_RANGE______21_CM 1 100. 0. 1. DISPLAY_IDENTIFIER LV_CDN_DIAG_LS_UP_PUC_VLD_1 ECU_ADDRESS 0x3fbbbd BIT_MASK 0x10 /end MEASUREMENT
/begin MEASUREMENT fmy_stat_ls_up_puc_vld_1.err_info_stat.err_sym "" UBYTE _CNV_S_6_RANGE_ERR__193_CM 1 100. 0. 15. DISPLAY_IDENTIFIER ERR_SYM_LS_UP_PUC_VLD_1 ECU_ADDRESS 0x3fbbbd BIT_MASK 0xF /end MEASUREMENT
/begin MEASUREMENT fmy_stat_ls_up_puc_vld_2.ctr_abc "" UBYTE _CNV_A_R_LINEAR_____0_CM 1 100. 0. 255. DISPLAY_IDENTIFIER CTR_ABC_LS_UP_PUC_VLD_2 ECU_ADDRESS 0x3fbbc3 FORMAT "%3.0" /end MEASUREMENT
/begin MEASUREMENT fmy_stat_ls_up_puc_vld_2.ctr_end_diag "" UBYTE _CNV_A_R_LINEAR_____0_CM 1 100. 0. 255. DISPLAY_IDENTIFIER CTR_ABC_END_DIAG_LS_UP_PUC_VLD_2 ECU_ADDRESS 0x3fbbc2 FORMAT "%3.0" /end MEASUREMENT
/begin MEASUREMENT fmy_stat_ls_up_puc_vld_2.err_info_stat.lv_err_mem "" UBYTE _CNV_S_2_RANGE______21_CM 1 100. 0. 1. DISPLAY_IDENTIFIER LV_ERR_MEM_LS_UP_PUC_VLD_2 ECU_ADDRESS 0x3fbbc1 BIT_MASK 0x80 /end MEASUREMENT
/begin MEASUREMENT fmy_stat_ls_up_puc_vld_2.err_info_stat.lv_ready "" UBYTE _CNV_S_2_RANGE______21_CM 1 100. 0. 1. DISPLAY_IDENTIFIER LV_READY_LS_UP_PUC_VLD_2 ECU_ADDRESS 0x3fbbc1 BIT_MASK 0x40 /end MEASUREMENT
/begin MEASUREMENT fmy_stat_ls_up_puc_vld_2.err_info_stat.lv_end_diag "" UBYTE _CNV_S_2_RANGE______21_CM 1 100. 0. 1. DISPLAY_IDENTIFIER LV_END_DIAG_LS_UP_PUC_VLD_2 ECU_ADDRESS 0x3fbbc1 BIT_MASK 0x20 /end MEASUREMENT
/begin MEASUREMENT fmy_stat_ls_up_puc_vld_2.err_info_stat.lv_cdn_diag "" UBYTE _CNV_S_2_RANGE______21_CM 1 100. 0. 1. DISPLAY_IDENTIFIER LV_CDN_DIAG_LS_UP_PUC_VLD_2 ECU_ADDRESS 0x3fbbc1 BIT_MASK 0x10 /end MEASUREMENT
/begin MEASUREMENT fmy_stat_ls_up_puc_vld_2.err_info_stat.err_sym "" UBYTE _CNV_S_6_RANGE_ERR__193_CM 1 100. 0. 15. DISPLAY_IDENTIFIER ERR_SYM_LS_UP_PUC_VLD_2 ECU_ADDRESS 0x3fbbc1 BIT_MASK 0xF /end MEASUREMENT
/begin MEASUREMENT fmy_stat_lsh_up_obd2_vld_1.ctr_abc "" UBYTE _CNV_A_R_LINEAR_____0_CM 1 100. 0. 255. DISPLAY_IDENTIFIER CTR_ABC_LSH_UP_OBD2_VLD_1 ECU_ADDRESS 0x3fbbc7 FORMAT "%3.0" /end MEASUREMENT
/begin MEASUREMENT fmy_stat_lsh_up_obd2_vld_1.ctr_end_diag "" UBYTE _CNV_A_R_LINEAR_____0_CM 1 100. 0. 255. DISPLAY_IDENTIFIER CTR_ABC_END_DIAG_LSH_UP_OBD2_VLD ECU_ADDRESS 0x3fbbc6 FORMAT "%3.0" /end MEASUREMENT
/begin MEASUREMENT fmy_stat_lsh_up_obd2_vld_1.err_info_stat.lv_err_mem "" UBYTE _CNV_S_2_RANGE______21_CM 1 100. 0. 1. DISPLAY_IDENTIFIER LV_ERR_MEM_LSH_UP_OBD2_VLD_1 ECU_ADDRESS 0x3fbbc5 BIT_MASK 0x80 /end MEASUREMENT
/begin MEASUREMENT fmy_stat_lsh_up_obd2_vld_1.err_info_stat.lv_ready "" UBYTE _CNV_S_2_RANGE______21_CM 1 100. 0. 1. DISPLAY_IDENTIFIER LV_READY_LSH_UP_OBD2_VLD_1 ECU_ADDRESS 0x3fbbc5 BIT_MASK 0x40 /end MEASUREMENT
/begin MEASUREMENT fmy_stat_lsh_up_obd2_vld_1.err_info_stat.lv_end_diag "" UBYTE _CNV_S_2_RANGE______21_CM 1 100. 0. 1. DISPLAY_IDENTIFIER LV_END_DIAG_LSH_UP_OBD2_VLD_1 ECU_ADDRESS 0x3fbbc5 BIT_MASK 0x20 /end MEASUREMENT
/begin MEASUREMENT fmy_stat_lsh_up_obd2_vld_1.err_info_stat.lv_cdn_diag "" UBYTE _CNV_S_2_RANGE______21_CM 1 100. 0. 1. DISPLAY_IDENTIFIER LV_CDN_DIAG_LSH_UP_OBD2_VLD_1 ECU_ADDRESS 0x3fbbc5 BIT_MASK 0x10 /end MEASUREMENT
/begin MEASUREMENT fmy_stat_lsh_up_obd2_vld_1.err_info_stat.err_sym "" UBYTE _CNV_S_6_RANGE_ERR__193_CM 1 100. 0. 15. DISPLAY_IDENTIFIER ERR_SYM_LSH_UP_OBD2_VLD_1 ECU_ADDRESS 0x3fbbc5 BIT_MASK 0xF /end MEASUREMENT
/begin MEASUREMENT fmy_stat_lsh_up_obd2_vld_2.ctr_abc "" UBYTE _CNV_A_R_LINEAR_____0_CM 1 100. 0. 255. DISPLAY_IDENTIFIER CTR_ABC_LSH_UP_OBD2_VLD_2 ECU_ADDRESS 0x3fbbcb FORMAT "%3.0" /end MEASUREMENT
/begin MEASUREMENT fmy_stat_lsh_up_obd2_vld_2.ctr_end_diag "" UBYTE _CNV_A_R_LINEAR_____0_CM 1 100. 0. 255. DISPLAY_IDENTIFIER CTR_ABC_END_DIAG_LSH_UP_OBD2_VLD ECU_ADDRESS 0x3fbbca FORMAT "%3.0" /end MEASUREMENT
/begin MEASUREMENT fmy_stat_lsh_up_obd2_vld_2.err_info_stat.lv_err_mem "" UBYTE _CNV_S_2_RANGE______21_CM 1 100. 0. 1. DISPLAY_IDENTIFIER LV_ERR_MEM_LSH_UP_OBD2_VLD_2 ECU_ADDRESS 0x3fbbc9 BIT_MASK 0x80 /end MEASUREMENT
/begin MEASUREMENT fmy_stat_lsh_up_obd2_vld_2.err_info_stat.lv_ready "" UBYTE _CNV_S_2_RANGE______21_CM 1 100. 0. 1. DISPLAY_IDENTIFIER LV_READY_LSH_UP_OBD2_VLD_2 ECU_ADDRESS 0x3fbbc9 BIT_MASK 0x40 /end MEASUREMENT
/begin MEASUREMENT fmy_stat_lsh_up_obd2_vld_2.err_info_stat.lv_end_diag "" UBYTE _CNV_S_2_RANGE______21_CM 1 100. 0. 1. DISPLAY_IDENTIFIER LV_END_DIAG_LSH_UP_OBD2_VLD_2 ECU_ADDRESS 0x3fbbc9 BIT_MASK 0x20 /end MEASUREMENT
/begin MEASUREMENT fmy_stat_lsh_up_obd2_vld_2.err_info_stat.lv_cdn_diag "" UBYTE _CNV_S_2_RANGE______21_CM 1 100. 0. 1. DISPLAY_IDENTIFIER LV_CDN_DIAG_LSH_UP_OBD2_VLD_2 ECU_ADDRESS 0x3fbbc9 BIT_MASK 0x10 /end MEASUREMENT
/begin MEASUREMENT fmy_stat_lsh_up_obd2_vld_2.err_info_stat.err_sym "" UBYTE _CNV_S_6_RANGE_ERR__193_CM 1 100. 0. 15. DISPLAY_IDENTIFIER ERR_SYM_LSH_UP_OBD2_VLD_2 ECU_ADDRESS 0x3fbbc9 BIT_MASK 0xF /end MEASUREMENT
/begin MEASUREMENT fmy_stat_nox_sens_htp_1.ctr_abc "" UBYTE _CNV_A_R_LINEAR_____0_CM 1 100. 0. 255. DISPLAY_IDENTIFIER CTR_ABC_NOX_SENS_HTP_1 ECU_ADDRESS 0x3fbbcf FORMAT "%3.0" /end MEASUREMENT
/begin MEASUREMENT fmy_stat_nox_sens_htp_1.ctr_end_diag "" UBYTE _CNV_A_R_LINEAR_____0_CM 1 100. 0. 255. DISPLAY_IDENTIFIER CTR_ABC_END_DIAG_NOX_SENS_HTP_1 ECU_ADDRESS 0x3fbbce FORMAT "%3.0" /end MEASUREMENT
/begin MEASUREMENT fmy_stat_nox_sens_htp_1.err_info_stat.lv_err_mem "" UBYTE _CNV_S_2_RANGE______21_CM 1 100. 0. 1. DISPLAY_IDENTIFIER LV_ERR_MEM_NOX_SENS_HTP_1 ECU_ADDRESS 0x3fbbcd BIT_MASK 0x80 /end MEASUREMENT
/begin MEASUREMENT fmy_stat_nox_sens_htp_1.err_info_stat.lv_ready "" UBYTE _CNV_S_2_RANGE______21_CM 1 100. 0. 1. DISPLAY_IDENTIFIER LV_READY_NOX_SENS_HTP_1 ECU_ADDRESS 0x3fbbcd BIT_MASK 0x40 /end MEASUREMENT
/begin MEASUREMENT fmy_stat_nox_sens_htp_1.err_info_stat.lv_end_diag "" UBYTE _CNV_S_2_RANGE______21_CM 1 100. 0. 1. DISPLAY_IDENTIFIER LV_END_DIAG_NOX_SENS_HTP_1 ECU_ADDRESS 0x3fbbcd BIT_MASK 0x20 /end MEASUREMENT
/begin MEASUREMENT fmy_stat_nox_sens_htp_1.err_info_stat.lv_cdn_diag "" UBYTE _CNV_S_2_RANGE______21_CM 1 100. 0. 1. DISPLAY_IDENTIFIER LV_CDN_DIAG_NOX_SENS_HTP_1 ECU_ADDRESS 0x3fbbcd BIT_MASK 0x10 /end MEASUREMENT
/begin MEASUREMENT fmy_stat_nox_sens_htp_1.err_info_stat.err_sym "" UBYTE _CNV_S_6_RANGE_ERR__193_CM 1 100. 0. 15. DISPLAY_IDENTIFIER ERR_SYM_NOX_SENS_HTP_1 ECU_ADDRESS 0x3fbbcd BIT_MASK 0xF /end MEASUREMENT
/begin MEASUREMENT fmy_stat_nox_sens_plaus_1.ctr_abc "" UBYTE _CNV_A_R_LINEAR_____0_CM 1 100. 0. 255. DISPLAY_IDENTIFIER CTR_ABC_NOX_SENS_PLAUS_1 ECU_ADDRESS 0x3fbbd3 FORMAT "%3.0" /end MEASUREMENT
/begin MEASUREMENT fmy_stat_nox_sens_plaus_1.ctr_end_diag "" UBYTE _CNV_A_R_LINEAR_____0_CM 1 100. 0. 255. DISPLAY_IDENTIFIER CTR_ABC_END_DIAG_NOX_SENS_PLAUS_ ECU_ADDRESS 0x3fbbd2 FORMAT "%3.0" /end MEASUREMENT
/begin MEASUREMENT fmy_stat_nox_sens_plaus_1.err_info_stat.lv_err_mem "" UBYTE _CNV_S_2_RANGE______21_CM 1 100. 0. 1. DISPLAY_IDENTIFIER LV_ERR_MEM_NOX_SENS_PLAUS_1 ECU_ADDRESS 0x3fbbd1 BIT_MASK 0x80 /end MEASUREMENT
/begin MEASUREMENT fmy_stat_nox_sens_plaus_1.err_info_stat.lv_ready "" UBYTE _CNV_S_2_RANGE______21_CM 1 100. 0. 1. DISPLAY_IDENTIFIER LV_READY_NOX_SENS_PLAUS_1 ECU_ADDRESS 0x3fbbd1 BIT_MASK 0x40 /end MEASUREMENT
/begin MEASUREMENT fmy_stat_nox_sens_plaus_1.err_info_stat.lv_end_diag "" UBYTE _CNV_S_2_RANGE______21_CM 1 100. 0. 1. DISPLAY_IDENTIFIER LV_END_DIAG_NOX_SENS_PLAUS_1 ECU_ADDRESS 0x3fbbd1 BIT_MASK 0x20 /end MEASUREMENT
/begin MEASUREMENT fmy_stat_nox_sens_plaus_1.err_info_stat.lv_cdn_diag "" UBYTE _CNV_S_2_RANGE______21_CM 1 100. 0. 1. DISPLAY_IDENTIFIER LV_CDN_DIAG_NOX_SENS_PLAUS_1 ECU_ADDRESS 0x3fbbd1 BIT_MASK 0x10 /end MEASUREMENT
/begin MEASUREMENT fmy_stat_nox_sens_plaus_1.err_info_stat.err_sym "" UBYTE _CNV_S_6_RANGE_ERR__193_CM 1 100. 0. 15. DISPLAY_IDENTIFIER ERR_SYM_NOX_SENS_PLAUS_1 ECU_ADDRESS 0x3fbbd1 BIT_MASK 0xF /end MEASUREMENT
/begin MEASUREMENT fmy_stat_nox_sens_avl_1.ctr_abc "" UBYTE _CNV_A_R_LINEAR_____0_CM 1 100. 0. 255. DISPLAY_IDENTIFIER CTR_ABC_NOX_SENS_AVL_1 ECU_ADDRESS 0x3fbbd7 FORMAT "%3.0" /end MEASUREMENT
/begin MEASUREMENT fmy_stat_nox_sens_avl_1.ctr_end_diag "" UBYTE _CNV_A_R_LINEAR_____0_CM 1 100. 0. 255. DISPLAY_IDENTIFIER CTR_ABC_END_DIAG_NOX_SENS_AVL_1 ECU_ADDRESS 0x3fbbd6 FORMAT "%3.0" /end MEASUREMENT
/begin MEASUREMENT fmy_stat_nox_sens_avl_1.err_info_stat.lv_err_mem "" UBYTE _CNV_S_2_RANGE______21_CM 1 100. 0. 1. DISPLAY_IDENTIFIER LV_ERR_MEM_NOX_SENS_AVL_1 ECU_ADDRESS 0x3fbbd5 BIT_MASK 0x80 /end MEASUREMENT
/begin MEASUREMENT fmy_stat_nox_sens_avl_1.err_info_stat.lv_ready "" UBYTE _CNV_S_2_RANGE______21_CM 1 100. 0. 1. DISPLAY_IDENTIFIER LV_READY_NOX_SENS_AVL_1 ECU_ADDRESS 0x3fbbd5 BIT_MASK 0x40 /end MEASUREMENT
/begin MEASUREMENT fmy_stat_nox_sens_avl_1.err_info_stat.lv_end_diag "" UBYTE _CNV_S_2_RANGE______21_CM 1 100. 0. 1. DISPLAY_IDENTIFIER LV_END_DIAG_NOX_SENS_AVL_1 ECU_ADDRESS 0x3fbbd5 BIT_MASK 0x20 /end MEASUREMENT
/begin MEASUREMENT fmy_stat_nox_sens_avl_1.err_info_stat.lv_cdn_diag "" UBYTE _CNV_S_2_RANGE______21_CM 1 100. 0. 1. DISPLAY_IDENTIFIER LV_CDN_DIAG_NOX_SENS_AVL_1 ECU_ADDRESS 0x3fbbd5 BIT_MASK 0x10 /end MEASUREMENT
/begin MEASUREMENT fmy_stat_nox_sens_avl_1.err_info_stat.err_sym "" UBYTE _CNV_S_6_RANGE_ERR__193_CM 1 100. 0. 15. DISPLAY_IDENTIFIER ERR_SYM_NOX_SENS_AVL_1 ECU_ADDRESS 0x3fbbd5 BIT_MASK 0xF /end MEASUREMENT
/begin MEASUREMENT fmy_stat_nox_sens_dyn_1.ctr_abc "" UBYTE _CNV_A_R_LINEAR_____0_CM 1 100. 0. 255. DISPLAY_IDENTIFIER CTR_ABC_NOX_SENS_DYN_1 ECU_ADDRESS 0x3fbbdb FORMAT "%3.0" /end MEASUREMENT
/begin MEASUREMENT fmy_stat_nox_sens_dyn_1.ctr_end_diag "" UBYTE _CNV_A_R_LINEAR_____0_CM 1 100. 0. 255. DISPLAY_IDENTIFIER CTR_ABC_END_DIAG_NOX_SENS_DYN_1 ECU_ADDRESS 0x3fbbda FORMAT "%3.0" /end MEASUREMENT
/begin MEASUREMENT fmy_stat_nox_sens_dyn_1.err_info_stat.lv_err_mem "" UBYTE _CNV_S_2_RANGE______21_CM 1 100. 0. 1. DISPLAY_IDENTIFIER LV_ERR_MEM_NOX_SENS_DYN_1 ECU_ADDRESS 0x3fbbd9 BIT_MASK 0x80 /end MEASUREMENT
/begin MEASUREMENT fmy_stat_nox_sens_dyn_1.err_info_stat.lv_ready "" UBYTE _CNV_S_2_RANGE______21_CM 1 100. 0. 1. DISPLAY_IDENTIFIER LV_READY_NOX_SENS_DYN_1 ECU_ADDRESS 0x3fbbd9 BIT_MASK 0x40 /end MEASUREMENT
/begin MEASUREMENT fmy_stat_nox_sens_dyn_1.err_info_stat.lv_end_diag "" UBYTE _CNV_S_2_RANGE______21_CM 1 100. 0. 1. DISPLAY_IDENTIFIER LV_END_DIAG_NOX_SENS_DYN_1 ECU_ADDRESS 0x3fbbd9 BIT_MASK 0x20 /end MEASUREMENT
/begin MEASUREMENT fmy_stat_nox_sens_dyn_1.err_info_stat.lv_cdn_diag "" UBYTE _CNV_S_2_RANGE______21_CM 1 100. 0. 1. DISPLAY_IDENTIFIER LV_CDN_DIAG_NOX_SENS_DYN_1 ECU_ADDRESS 0x3fbbd9 BIT_MASK 0x10 /end MEASUREMENT
/begin MEASUREMENT fmy_stat_nox_sens_dyn_1.err_info_stat.err_sym "" UBYTE _CNV_S_6_RANGE_ERR__193_CM 1 100. 0. 15. DISPLAY_IDENTIFIER ERR_SYM_NOX_SENS_DYN_1 ECU_ADDRESS 0x3fbbd9 BIT_MASK 0xF /end MEASUREMENT
/begin MEASUREMENT fmy_stat_nox_sens_ref_air_1.ctr_abc "" UBYTE _CNV_A_R_LINEAR_____0_CM 1 100. 0. 255. DISPLAY_IDENTIFIER CTR_ABC_NOX_SENS_REF_AIR_1 ECU_ADDRESS 0x3fbbdf FORMAT "%3.0" /end MEASUREMENT
/begin MEASUREMENT fmy_stat_nox_sens_ref_air_1.ctr_end_diag "" UBYTE _CNV_A_R_LINEAR_____0_CM 1 100. 0. 255. DISPLAY_IDENTIFIER CTR_ABC_END_DIAG_NOX_SENS_REF_AI ECU_ADDRESS 0x3fbbde FORMAT "%3.0" /end MEASUREMENT
/begin MEASUREMENT fmy_stat_nox_sens_ref_air_1.err_info_stat.lv_err_mem "" UBYTE _CNV_S_2_RANGE______21_CM 1 100. 0. 1. DISPLAY_IDENTIFIER LV_ERR_MEM_NOX_SENS_REF_AIR_1 ECU_ADDRESS 0x3fbbdd BIT_MASK 0x80 /end MEASUREMENT
/begin MEASUREMENT fmy_stat_nox_sens_ref_air_1.err_info_stat.lv_ready "" UBYTE _CNV_S_2_RANGE______21_CM 1 100. 0. 1. DISPLAY_IDENTIFIER LV_READY_NOX_SENS_REF_AIR_1 ECU_ADDRESS 0x3fbbdd BIT_MASK 0x40 /end MEASUREMENT
/begin MEASUREMENT fmy_stat_nox_sens_ref_air_1.err_info_stat.lv_end_diag "" UBYTE _CNV_S_2_RANGE______21_CM 1 100. 0. 1. DISPLAY_IDENTIFIER LV_END_DIAG_NOX_SENS_REF_AIR_1 ECU_ADDRESS 0x3fbbdd BIT_MASK 0x20 /end MEASUREMENT
/begin MEASUREMENT fmy_stat_nox_sens_ref_air_1.err_info_stat.lv_cdn_diag "" UBYTE _CNV_S_2_RANGE______21_CM 1 100. 0. 1. DISPLAY_IDENTIFIER LV_CDN_DIAG_NOX_SENS_REF_AIR_1 ECU_ADDRESS 0x3fbbdd BIT_MASK 0x10 /end MEASUREMENT
/begin MEASUREMENT fmy_stat_nox_sens_ref_air_1.err_info_stat.err_sym "" UBYTE _CNV_S_6_RANGE_ERR__193_CM 1 100. 0. 15. DISPLAY_IDENTIFIER ERR_SYM_NOX_SENS_REF_AIR_1 ECU_ADDRESS 0x3fbbdd BIT_MASK 0xF /end MEASUREMENT
/begin MEASUREMENT fmy_stat_nox_sens_htp_2.ctr_abc "" UBYTE _CNV_A_R_LINEAR_____0_CM 1 100. 0. 255. DISPLAY_IDENTIFIER CTR_ABC_NOX_SENS_HTP_2 ECU_ADDRESS 0x3fbbe3 FORMAT "%3.0" /end MEASUREMENT
/begin MEASUREMENT fmy_stat_nox_sens_htp_2.ctr_end_diag "" UBYTE _CNV_A_R_LINEAR_____0_CM 1 100. 0. 255. DISPLAY_IDENTIFIER CTR_ABC_END_DIAG_NOX_SENS_HTP_2 ECU_ADDRESS 0x3fbbe2 FORMAT "%3.0" /end MEASUREMENT
/begin MEASUREMENT fmy_stat_nox_sens_htp_2.err_info_stat.lv_err_mem "" UBYTE _CNV_S_2_RANGE______21_CM 1 100. 0. 1. DISPLAY_IDENTIFIER LV_ERR_MEM_NOX_SENS_HTP_2 ECU_ADDRESS 0x3fbbe1 BIT_MASK 0x80 /end MEASUREMENT
/begin MEASUREMENT fmy_stat_nox_sens_htp_2.err_info_stat.lv_ready "" UBYTE _CNV_S_2_RANGE______21_CM 1 100. 0. 1. DISPLAY_IDENTIFIER LV_READY_NOX_SENS_HTP_2 ECU_ADDRESS 0x3fbbe1 BIT_MASK 0x40 /end MEASUREMENT
/begin MEASUREMENT fmy_stat_nox_sens_htp_2.err_info_stat.lv_end_diag "" UBYTE _CNV_S_2_RANGE______21_CM 1 100. 0. 1. DISPLAY_IDENTIFIER LV_END_DIAG_NOX_SENS_HTP_2 ECU_ADDRESS 0x3fbbe1 BIT_MASK 0x20 /end MEASUREMENT
/begin MEASUREMENT fmy_stat_nox_sens_htp_2.err_info_stat.lv_cdn_diag "" UBYTE _CNV_S_2_RANGE______21_CM 1 100. 0. 1. DISPLAY_IDENTIFIER LV_CDN_DIAG_NOX_SENS_HTP_2 ECU_ADDRESS 0x3fbbe1 BIT_MASK 0x10 /end MEASUREMENT
/begin MEASUREMENT fmy_stat_nox_sens_htp_2.err_info_stat.err_sym "" UBYTE _CNV_S_6_RANGE_ERR__193_CM 1 100. 0. 15. DISPLAY_IDENTIFIER ERR_SYM_NOX_SENS_HTP_2 ECU_ADDRESS 0x3fbbe1 BIT_MASK 0xF /end MEASUREMENT
/begin MEASUREMENT fmy_stat_nox_sens_plaus_2.ctr_abc "" UBYTE _CNV_A_R_LINEAR_____0_CM 1 100. 0. 255. DISPLAY_IDENTIFIER CTR_ABC_NOX_SENS_PLAUS_2 ECU_ADDRESS 0x3fbbe7 FORMAT "%3.0" /end MEASUREMENT
/begin MEASUREMENT fmy_stat_nox_sens_plaus_2.ctr_end_diag "" UBYTE _CNV_A_R_LINEAR_____0_CM 1 100. 0. 255. DISPLAY_IDENTIFIER CTR_ABC_END_DIAG_NOX_SENS_PLAUS_ ECU_ADDRESS 0x3fbbe6 FORMAT "%3.0" /end MEASUREMENT
/begin MEASUREMENT fmy_stat_nox_sens_plaus_2.err_info_stat.lv_err_mem "" UBYTE _CNV_S_2_RANGE______21_CM 1 100. 0. 1. DISPLAY_IDENTIFIER LV_ERR_MEM_NOX_SENS_PLAUS_2 ECU_ADDRESS 0x3fbbe5 BIT_MASK 0x80 /end MEASUREMENT
/begin MEASUREMENT fmy_stat_nox_sens_plaus_2.err_info_stat.lv_ready "" UBYTE _CNV_S_2_RANGE______21_CM 1 100. 0. 1. DISPLAY_IDENTIFIER LV_READY_NOX_SENS_PLAUS_2 ECU_ADDRESS 0x3fbbe5 BIT_MASK 0x40 /end MEASUREMENT
/begin MEASUREMENT fmy_stat_nox_sens_plaus_2.err_info_stat.lv_end_diag "" UBYTE _CNV_S_2_RANGE______21_CM 1 100. 0. 1. DISPLAY_IDENTIFIER LV_END_DIAG_NOX_SENS_PLAUS_2 ECU_ADDRESS 0x3fbbe5 BIT_MASK 0x20 /end MEASUREMENT
/begin MEASUREMENT fmy_stat_nox_sens_plaus_2.err_info_stat.lv_cdn_diag "" UBYTE _CNV_S_2_RANGE______21_CM 1 100. 0. 1. DISPLAY_IDENTIFIER LV_CDN_DIAG_NOX_SENS_PLAUS_2 ECU_ADDRESS 0x3fbbe5 BIT_MASK 0x10 /end MEASUREMENT
/begin MEASUREMENT fmy_stat_nox_sens_plaus_2.err_info_stat.err_sym "" UBYTE _CNV_S_6_RANGE_ERR__193_CM 1 100. 0. 15. DISPLAY_IDENTIFIER ERR_SYM_NOX_SENS_PLAUS_2 ECU_ADDRESS 0x3fbbe5 BIT_MASK 0xF /end MEASUREMENT
/begin MEASUREMENT fmy_stat_nox_sens_avl_2.ctr_abc "" UBYTE _CNV_A_R_LINEAR_____0_CM 1 100. 0. 255. DISPLAY_IDENTIFIER CTR_ABC_NOX_SENS_AVL_2 ECU_ADDRESS 0x3fbbeb FORMAT "%3.0" /end MEASUREMENT
/begin MEASUREMENT fmy_stat_nox_sens_avl_2.ctr_end_diag "" UBYTE _CNV_A_R_LINEAR_____0_CM 1 100. 0. 255. DISPLAY_IDENTIFIER CTR_ABC_END_DIAG_NOX_SENS_AVL_2 ECU_ADDRESS 0x3fbbea FORMAT "%3.0" /end MEASUREMENT
/begin MEASUREMENT fmy_stat_nox_sens_avl_2.err_info_stat.lv_err_mem "" UBYTE _CNV_S_2_RANGE______21_CM 1 100. 0. 1. DISPLAY_IDENTIFIER LV_ERR_MEM_NOX_SENS_AVL_2 ECU_ADDRESS 0x3fbbe9 BIT_MASK 0x80 /end MEASUREMENT
/begin MEASUREMENT fmy_stat_nox_sens_avl_2.err_info_stat.lv_ready "" UBYTE _CNV_S_2_RANGE______21_CM 1 100. 0. 1. DISPLAY_IDENTIFIER LV_READY_NOX_SENS_AVL_2 ECU_ADDRESS 0x3fbbe9 BIT_MASK 0x40 /end MEASUREMENT
/begin MEASUREMENT fmy_stat_nox_sens_avl_2.err_info_stat.lv_end_diag "" UBYTE _CNV_S_2_RANGE______21_CM 1 100. 0. 1. DISPLAY_IDENTIFIER LV_END_DIAG_NOX_SENS_AVL_2 ECU_ADDRESS 0x3fbbe9 BIT_MASK 0x20 /end MEASUREMENT
/begin MEASUREMENT fmy_stat_nox_sens_avl_2.err_info_stat.lv_cdn_diag "" UBYTE _CNV_S_2_RANGE______21_CM 1 100. 0. 1. DISPLAY_IDENTIFIER LV_CDN_DIAG_NOX_SENS_AVL_2 ECU_ADDRESS 0x3fbbe9 BIT_MASK 0x10 /end MEASUREMENT
/begin MEASUREMENT fmy_stat_nox_sens_avl_2.err_info_stat.err_sym "" UBYTE _CNV_S_6_RANGE_ERR__193_CM 1 100. 0. 15. DISPLAY_IDENTIFIER ERR_SYM_NOX_SENS_AVL_2 ECU_ADDRESS 0x3fbbe9 BIT_MASK 0xF /end MEASUREMENT
/begin MEASUREMENT fmy_stat_nox_sens_dyn_2.ctr_abc "" UBYTE _CNV_A_R_LINEAR_____0_CM 1 100. 0. 255. DISPLAY_IDENTIFIER CTR_ABC_NOX_SENS_DYN_2 ECU_ADDRESS 0x3fbbef FORMAT "%3.0" /end MEASUREMENT
/begin MEASUREMENT fmy_stat_nox_sens_dyn_2.ctr_end_diag "" UBYTE _CNV_A_R_LINEAR_____0_CM 1 100. 0. 255. DISPLAY_IDENTIFIER CTR_ABC_END_DIAG_NOX_SENS_DYN_2 ECU_ADDRESS 0x3fbbee FORMAT "%3.0" /end MEASUREMENT
/begin MEASUREMENT fmy_stat_nox_sens_dyn_2.err_info_stat.lv_err_mem "" UBYTE _CNV_S_2_RANGE______21_CM 1 100. 0. 1. DISPLAY_IDENTIFIER LV_ERR_MEM_NOX_SENS_DYN_2 ECU_ADDRESS 0x3fbbed BIT_MASK 0x80 /end MEASUREMENT
/begin MEASUREMENT fmy_stat_nox_sens_dyn_2.err_info_stat.lv_ready "" UBYTE _CNV_S_2_RANGE______21_CM 1 100. 0. 1. DISPLAY_IDENTIFIER LV_READY_NOX_SENS_DYN_2 ECU_ADDRESS 0x3fbbed BIT_MASK 0x40 /end MEASUREMENT
/begin MEASUREMENT fmy_stat_nox_sens_dyn_2.err_info_stat.lv_end_diag "" UBYTE _CNV_S_2_RANGE______21_CM 1 100. 0. 1. DISPLAY_IDENTIFIER LV_END_DIAG_NOX_SENS_DYN_2 ECU_ADDRESS 0x3fbbed BIT_MASK 0x20 /end MEASUREMENT
/begin MEASUREMENT fmy_stat_nox_sens_dyn_2.err_info_stat.lv_cdn_diag "" UBYTE _CNV_S_2_RANGE______21_CM 1 100. 0. 1. DISPLAY_IDENTIFIER LV_CDN_DIAG_NOX_SENS_DYN_2 ECU_ADDRESS 0x3fbbed BIT_MASK 0x10 /end MEASUREMENT
/begin MEASUREMENT fmy_stat_nox_sens_dyn_2.err_info_stat.err_sym "" UBYTE _CNV_S_6_RANGE_ERR__193_CM 1 100. 0. 15. DISPLAY_IDENTIFIER ERR_SYM_NOX_SENS_DYN_2 ECU_ADDRESS 0x3fbbed BIT_MASK 0xF /end MEASUREMENT
/begin MEASUREMENT fmy_stat_nox_sens_ref_air_2.ctr_abc "" UBYTE _CNV_A_R_LINEAR_____0_CM 1 100. 0. 255. DISPLAY_IDENTIFIER CTR_ABC_NOX_SENS_REF_AIR_2 ECU_ADDRESS 0x3fbbf3 FORMAT "%3.0" /end MEASUREMENT
/begin MEASUREMENT fmy_stat_nox_sens_ref_air_2.ctr_end_diag "" UBYTE _CNV_A_R_LINEAR_____0_CM 1 100. 0. 255. DISPLAY_IDENTIFIER CTR_ABC_END_DIAG_NOX_SENS_REF_AI ECU_ADDRESS 0x3fbbf2 FORMAT "%3.0" /end MEASUREMENT
/begin MEASUREMENT fmy_stat_nox_sens_ref_air_2.err_info_stat.lv_err_mem "" UBYTE _CNV_S_2_RANGE______21_CM 1 100. 0. 1. DISPLAY_IDENTIFIER LV_ERR_MEM_NOX_SENS_REF_AIR_2 ECU_ADDRESS 0x3fbbf1 BIT_MASK 0x80 /end MEASUREMENT
/begin MEASUREMENT fmy_stat_nox_sens_ref_air_2.err_info_stat.lv_ready "" UBYTE _CNV_S_2_RANGE______21_CM 1 100. 0. 1. DISPLAY_IDENTIFIER LV_READY_NOX_SENS_REF_AIR_2 ECU_ADDRESS 0x3fbbf1 BIT_MASK 0x40 /end MEASUREMENT
/begin MEASUREMENT fmy_stat_nox_sens_ref_air_2.err_info_stat.lv_end_diag "" UBYTE _CNV_S_2_RANGE______21_CM 1 100. 0. 1. DISPLAY_IDENTIFIER LV_END_DIAG_NOX_SENS_REF_AIR_2 ECU_ADDRESS 0x3fbbf1 BIT_MASK 0x20 /end MEASUREMENT
/begin MEASUREMENT fmy_stat_nox_sens_ref_air_2.err_info_stat.lv_cdn_diag "" UBYTE _CNV_S_2_RANGE______21_CM 1 100. 0. 1. DISPLAY_IDENTIFIER LV_CDN_DIAG_NOX_SENS_REF_AIR_2 ECU_ADDRESS 0x3fbbf1 BIT_MASK 0x10 /end MEASUREMENT
/begin MEASUREMENT fmy_stat_nox_sens_ref_air_2.err_info_stat.err_sym "" UBYTE _CNV_S_6_RANGE_ERR__193_CM 1 100. 0. 15. DISPLAY_IDENTIFIER ERR_SYM_NOX_SENS_REF_AIR_2 ECU_ADDRESS 0x3fbbf1 BIT_MASK 0xF /end MEASUREMENT
/begin COMPU_METHOD _CNV_A_R_LINEAR_____0_CM "" RAT_FUNC "%6.3" "-" COEFFS 0 1. 0. 0 0 1 /end COMPU_METHOD
/begin COMPU_METHOD _CNV_S_2_RANGE______21_CM "" TAB_VERB "%6.3" "-" COMPU_TAB_REF _CNV_S_2_RANGE______21 /end COMPU_METHOD
/begin COMPU_VTAB _CNV_S_2_RANGE______21 "" TAB_VERB 2 0 "0" 1 "1" /end COMPU_VTAB
/begin COMPU_METHOD _CNV_S_6_RANGE_ERR__193_CM "" TAB_VERB "%6.3" "-" COMPU_TAB_REF _CNV_S_6_RANGE_ERR__193 /end COMPU_METHOD
/begin COMPU_VTAB _CNV_S_6_RANGE_ERR__193 "" TAB_VERB 6 0 "NO_SYM" 1 "SYM_0" 2 "SYM_1" 4 "SYM_2" 8 "SYM_3" 15 "BENCH_MODE" /end COMPU_VTAB
/begin RECORD_LAYOUT _REC_VAL_20_u1 FNC_VALUES 1 UBYTE COLUMN_DIR DIRECT /end RECORD_LAYOUT
/begin FUNCTION DIA_Anti_bounce_algorithm "_Anti-bounce-algorithm"
 /begin DEF_CHARACTERISTIC c_det_max_dmtlh c_det_inc_dmtlh c_det_inc_dmtl_pump c_det_max_dmtl_pump c_det_inc_dmtls c_det_max_dmtls c_det_inc_rly_accout c_det_max_rly_accout c_det_max_ebox_cfa c_det_inc_ebox_cfa c_det_max_ef c_det_inc_ef c_det_inc_ecras c_det_max_ecras c_det_inc_sav c_det_max_sav c_det_max_vim c_det_inc_vim c_det_inc_rly_st c_det_max_rly_st c_det_inc_lsh_down c_det_max_lsh_down c_det_max_lsh_up c_det_inc_lsh_up c_det_max_isa_1 c_det_max_isa_2 c_det_inc_isa_1 c_det_inc_isa_2 c_det_max_slv_ivvt c_det_inc_slv_ivvt c_det_inc_sap c_det_max_sap c_abc_inc_rly_efp c_abc_max_rly_efp c_det_max_cps c_det_inc_cps c_det_max_ect_el c_det_inc_ect_el c_det_max_ecf c_det_inc_ecf c_abc_inc_iv c_abc_max_iv c_abc_inc_imob_2 c_abc_inc_imob_1 c_abc_max_imob_2 c_abc_max_imob_1 c_abc_inc_sof_inh_mon c_abc_max_sof_inh_mon c_abc_inc_amp c_abc_max_amp c_abc_inc_im_bts_plaus c_abc_inc_im_bls_plaus c_abc_max_im_bts_plaus c_abc_max_im_bls_plaus c_abc_inc_bn_tq_dcc c_abc_inc_bn_tq_tcs c_abc_inc_bn_vs_tcs c_abc_inc_bn_tcs c_abc_inc_bn_tq_etcu c_abc_inc_bn_cas c_abc_inc_bn_etcu c_abc_inc_bn_tq_amt c_abc_inc_bn_acc c_abc_inc_bn_icl c_abc_inc_bn_km_icl c_abc_inc_bn_veh_mod c_abc_inc_bn_t_icl c_abc_inc_bn_pow_vb c_abc_inc_bn_pow_gen c_abc_inc_bn_msw c_abc_inc_bn_ang_pste c_abc_max_bn_cas c_abc_max_bn_tq_tcs c_abc_max_bn_vs_tcs c_abc_max_bn_tcs c_abc_max_bn_tq_etcu c_abc_max_bn_etcu c_abc_max_bn_tq_amt c_abc_max_bn_acc c_abc_max_bn_t_icl c_abc_max_bn_km_icl c_abc_max_bn_veh_mod c_abc_max_bn_icl c_abc_max_bn_pow_vb c_abc_max_bn_pow_gen c_abc_max_bn_msw c_abc_max_bn_tq_dcc c_abc_max_bn_ang_pste c_ctr_diag_tcc_can_max_ars c_ctr_diag_tcc_can_max_cas c_ctr_diag_tcc_can_max_tq_tcs c_ctr_diag_tcc_can_max_tq_etcu c_ctr_diag_tcc_can_max_tq_amt c_ctr_diag_tcc_can_max_veh_mod c_ctr_diag_tcc_can_max_icl c_ctr_diag_tcc_can_max_msw c_ctr_diag_tcc_can_max_tq_dcc c_ctr_diag_cks_max_cas c_ctr_diag_cks_max_tq_tcs c_ctr_diag_cks_max_tq_etcu c_ctr_diag_cks_max_tq_amt c_ctr_diag_cks_max_veh_mod c_ctr_diag_cks_max_msw c_ctr_diag_cks_max_tq_dcc c_ctr_diag_tout_max_ars c_ctr_diag_tout_max_cas c_ctr_diag_tout_max_tq_tcs c_ctr_diag_tout_max_vs_tcs c_ctr_diag_tout_max_tcs c_ctr_diag_tout_max_tq_etcu c_ctr_diag_tout_max_tq_dcc c_ctr_diag_tout_max_tq_amt c_ctr_diag_tout_max_acc c_ctr_diag_tout_max_t_icl c_ctr_diag_tout_max_veh_mod c_ctr_diag_tout_max_km_icl c_ctr_diag_tout_max_icl /end DEF_CHARACTERISTIC
 /begin OUT_MEASUREMENT fmy_stat_sof_req.err_info_stat.err_sym fmy_stat_rly_st.err_info_stat.lv_err_mem fmy_stat_rly_st.err_info_stat.lv_ready fmy_stat_rly_st.err_info_stat.lv_end_diag fmy_stat_rly_st.err_info_stat.lv_cdn_diag fmy_stat_rly_st.err_info_stat.err_sym fmy_stat_bsd.ctr_abc fmy_stat_bsd.ctr_end_diag fmy_stat_bsd.err_info_stat.lv_err_mem fmy_stat_bsd.err_info_stat.lv_ready fmy_stat_bsd.err_info_stat.lv_end_diag fmy_stat_bsd.err_info_stat.lv_cdn_diag fmy_stat_bsd.err_info_stat.err_sym fmy_stat_poil_swi.ctr_abc fmy_stat_poil_swi.ctr_end_diag fmy_stat_poil_swi.err_info_stat.lv_err_mem fmy_stat_poil_swi.err_info_stat.lv_ready fmy_stat_poil_swi.err_info_stat.lv_end_diag fmy_stat_poil_swi.err_info_stat.lv_cdn_diag fmy_stat_poil_swi.err_info_stat.err_sym fmy_stat_tout_efp.ctr_abc fmy_stat_tout_efp.ctr_end_diag fmy_stat_tout_efp.err_info_stat.lv_err_mem fmy_stat_tout_efp.err_info_stat.lv_ready fmy_stat_tout_efp.err_info_stat.lv_end_diag fmy_stat_tout_efp.err_info_stat.lv_cdn_diag fmy_stat_tout_efp.err_info_stat.err_sym fmy_stat_diagcps.ctr_abc fmy_stat_diagcps.ctr_end_diag fmy_stat_diagcps.err_info_stat.lv_err_mem fmy_stat_diagcps.err_info_stat.lv_ready fmy_stat_diagcps.err_info_stat.lv_end_diag fmy_stat_diagcps.err_info_stat.lv_cdn_diag fmy_stat_diagcps.err_info_stat.err_sym fmy_stat_tq_gs_inc_plaus.ctr_abc fmy_stat_tq_gs_inc_plaus.ctr_end_diag fmy_stat_tq_gs_inc_plaus.err_info_stat.lv_err_mem fmy_stat_tq_gs_inc_plaus.err_info_stat.lv_ready fmy_stat_tq_gs_inc_plaus.err_info_stat.lv_end_diag fmy_stat_tq_gs_inc_plaus.err_info_stat.lv_cdn_diag fmy_stat_tq_gs_inc_plaus.err_info_stat.err_sym fmy_stat_dcc.ctr_abc fmy_stat_dcc.ctr_end_diag fmy_stat_dcc.err_info_stat.lv_err_mem fmy_stat_dcc.err_info_stat.lv_ready fmy_stat_dcc.err_info_stat.lv_end_diag fmy_stat_dcc.err_info_stat.lv_cdn_diag fmy_stat_dcc.err_info_stat.err_sym fmy_stat_ecras.err_info_stat.lv_err_mem fmy_stat_ecras.err_info_stat.lv_ready fmy_stat_ecras.err_info_stat.lv_end_diag fmy_stat_ecras.err_info_stat.lv_cdn_diag fmy_stat_ecras.err_info_stat.err_sym fmy_stat_dmtlh.err_info_stat.lv_err_mem fmy_stat_dmtlh.err_info_stat.lv_ready fmy_stat_dmtlh.err_info_stat.lv_end_diag fmy_stat_dmtlh.err_info_stat.lv_cdn_diag fmy_stat_dmtlh.err_info_stat.err_sym fmy_stat_cs.ctr_abc fmy_stat_cs.ctr_end_diag fmy_stat_cs.err_info_stat.lv_err_mem fmy_stat_cs.err_info_stat.lv_ready fmy_stat_cs.err_info_stat.lv_end_diag fmy_stat_cs.err_info_stat.lv_cdn_diag fmy_stat_cs.err_info_stat.err_sym fmy_stat_spi_mps.ctr_abc fmy_stat_spi_mps.ctr_end_diag fmy_stat_spi_mps.err_info_stat.lv_err_mem fmy_stat_spi_mps.err_info_stat.lv_ready fmy_stat_spi_mps.err_info_stat.lv_end_diag fmy_stat_spi_mps.err_info_stat.lv_cdn_diag fmy_stat_spi_mps.err_info_stat.err_sym fmy_stat_spi_knk.ctr_abc fmy_stat_spi_knk.ctr_end_diag fmy_stat_spi_knk.err_info_stat.lv_err_mem fmy_stat_spi_knk.err_info_stat.lv_ready fmy_stat_spi_knk.err_info_stat.lv_end_diag fmy_stat_spi_knk.err_info_stat.lv_cdn_diag fmy_stat_spi_knk.err_info_stat.err_sym fmy_stat_bn_tq_dcc.ctr_abc fmy_stat_bn_tq_dcc.ctr_end_diag fmy_stat_bn_tq_dcc.err_info_stat.lv_err_mem fmy_stat_bn_tq_dcc.err_info_stat.lv_ready fmy_stat_bn_tq_dcc.err_info_stat.lv_end_diag fmy_stat_bn_tq_dcc.err_info_stat.lv_cdn_diag fmy_stat_bn_tq_dcc.err_info_stat.err_sym fmy_stat_bn_tq_pste_2.ctr_abc fmy_stat_bn_tq_pste_2.ctr_end_diag fmy_stat_bn_tq_pste_2.err_info_stat.lv_err_mem fmy_stat_bn_tq_pste_2.err_info_stat.lv_ready fmy_stat_bn_tq_pste_2.err_info_stat.lv_end_diag fmy_stat_bn_tq_pste_2.err_info_stat.lv_cdn_diag fmy_stat_bn_tq_pste_2.err_info_stat.err_sym fmy_stat_bn_ars.ctr_abc fmy_stat_bn_ars.ctr_end_diag fmy_stat_bn_ars.err_info_stat.lv_err_mem fmy_stat_bn_ars.err_info_stat.lv_ready fmy_stat_bn_ars.err_info_stat.lv_end_diag fmy_stat_bn_ars.err_info_stat.lv_cdn_diag fmy_stat_bn_ars.err_info_stat.err_sym fmy_stat_bn_cas.ctr_abc fmy_stat_bn_cas.ctr_end_diag fmy_stat_bn_cas.err_info_stat.lv_err_mem fmy_stat_bn_cas.err_info_stat.lv_ready fmy_stat_bn_cas.err_info_stat.lv_end_diag fmy_stat_bn_cas.err_info_stat.lv_cdn_diag fmy_stat_bn_cas.err_info_stat.err_sym fmy_stat_bn_tq_tcs.ctr_abc fmy_stat_bn_tq_tcs.ctr_end_diag fmy_stat_bn_tq_tcs.err_info_stat.lv_err_mem fmy_stat_bn_tq_tcs.err_info_stat.lv_ready fmy_stat_bn_tq_tcs.err_info_stat.lv_end_diag fmy_stat_bn_tq_tcs.err_info_stat.lv_cdn_diag fmy_stat_bn_tq_tcs.err_info_stat.err_sym fmy_stat_bn_vs_tcs.ctr_abc fmy_stat_bn_vs_tcs.ctr_end_diag fmy_stat_bn_vs_tcs.err_info_stat.lv_err_mem fmy_stat_bn_vs_tcs.err_info_stat.lv_ready fmy_stat_bn_vs_tcs.err_info_stat.lv_end_diag fmy_stat_bn_vs_tcs.err_info_stat.lv_cdn_diag fmy_stat_bn_vs_tcs.err_info_stat.err_sym fmy_stat_bn_tcs.ctr_abc fmy_stat_bn_tcs.ctr_end_diag fmy_stat_bn_tcs.err_info_stat.lv_err_mem fmy_stat_bn_tcs.err_info_stat.lv_ready fmy_stat_bn_tcs.err_info_stat.lv_end_diag fmy_stat_bn_tcs.err_info_stat.lv_cdn_diag fmy_stat_bn_tcs.err_info_stat.err_sym fmy_stat_bn_tq_etcu.ctr_abc fmy_stat_bn_tq_etcu.ctr_end_diag fmy_stat_bn_tq_etcu.err_info_stat.lv_err_mem fmy_stat_bn_tq_etcu.err_info_stat.lv_ready fmy_stat_bn_tq_etcu.err_info_stat.lv_end_diag fmy_stat_bn_tq_etcu.err_info_stat.lv_cdn_diag fmy_stat_bn_tq_etcu.err_info_stat.err_sym fmy_stat_bn_etcu.ctr_abc fmy_stat_bn_etcu.ctr_end_diag fmy_stat_bn_etcu.err_info_stat.lv_err_mem fmy_stat_bn_etcu.err_info_stat.lv_ready fmy_stat_bn_etcu.err_info_stat.lv_end_diag fmy_stat_bn_etcu.err_info_stat.lv_cdn_diag fmy_stat_bn_etcu.err_info_stat.err_sym fmy_stat_bn_tq_amt.ctr_abc fmy_stat_bn_tq_amt.ctr_end_diag fmy_stat_bn_tq_amt.err_info_stat.lv_err_mem fmy_stat_bn_tq_amt.err_info_stat.lv_ready fmy_stat_bn_tq_amt.err_info_stat.lv_end_diag fmy_stat_bn_tq_amt.err_info_stat.lv_cdn_diag fmy_stat_bn_tq_amt.err_info_stat.err_sym fmy_stat_bn_acc.ctr_abc fmy_stat_bn_acc.ctr_end_diag fmy_stat_bn_acc.err_info_stat.lv_err_mem fmy_stat_bn_acc.err_info_stat.lv_ready fmy_stat_bn_acc.err_info_stat.lv_end_diag fmy_stat_bn_acc.err_info_stat.lv_cdn_diag fmy_stat_bn_acc.err_info_stat.err_sym fmy_stat_bn_t_icl.ctr_abc fmy_stat_bn_t_icl.ctr_end_diag fmy_stat_bn_t_icl.err_info_stat.lv_err_mem fmy_stat_bn_t_icl.err_info_stat.lv_ready fmy_stat_bn_t_icl.err_info_stat.lv_end_diag fmy_stat_bn_t_icl.err_info_stat.lv_cdn_diag fmy_stat_bn_t_icl.err_info_stat.err_sym fmy_stat_bn_veh_mod.ctr_abc fmy_stat_bn_veh_mod.ctr_end_diag fmy_stat_bn_veh_mod.err_info_stat.lv_err_mem fmy_stat_bn_veh_mod.err_info_stat.lv_ready fmy_stat_bn_veh_mod.err_info_stat.lv_end_diag fmy_stat_bn_veh_mod.err_info_stat.lv_cdn_diag fmy_stat_bn_veh_mod.err_info_stat.err_sym fmy_stat_bn_km_icl.ctr_abc fmy_stat_bn_km_icl.ctr_end_diag fmy_stat_bn_km_icl.err_info_stat.lv_err_mem fmy_stat_bn_km_icl.err_info_stat.lv_ready fmy_stat_bn_km_icl.err_info_stat.lv_end_diag fmy_stat_bn_km_icl.err_info_stat.lv_cdn_diag fmy_stat_bn_km_icl.err_info_stat.err_sym fmy_stat_bn_icl.ctr_abc fmy_stat_bn_icl.ctr_end_diag fmy_stat_bn_icl.err_info_stat.lv_err_mem fmy_stat_bn_icl.err_info_stat.lv_ready fmy_stat_bn_icl.err_info_stat.lv_end_diag fmy_stat_bn_icl.err_info_stat.lv_cdn_diag fmy_stat_bn_icl.err_info_stat.err_sym fmy_stat_bn_pow_vb.ctr_abc fmy_stat_bn_pow_vb.ctr_end_diag fmy_stat_bn_pow_vb.err_info_stat.lv_err_mem fmy_stat_bn_pow_vb.err_info_stat.lv_ready fmy_stat_bn_pow_vb.err_info_stat.lv_end_diag fmy_stat_bn_pow_vb.err_info_stat.lv_cdn_diag fmy_stat_bn_pow_vb.err_info_stat.err_sym fmy_stat_bn_pow_gen.ctr_abc fmy_stat_bn_pow_gen.ctr_end_diag fmy_stat_bn_pow_gen.err_info_stat.lv_err_mem fmy_stat_bn_pow_gen.err_info_stat.lv_ready fmy_stat_bn_pow_gen.err_info_stat.lv_end_diag fmy_stat_bn_pow_gen.err_info_stat.lv_cdn_diag fmy_stat_bn_pow_gen.err_info_stat.err_sym fmy_stat_bn_msw.ctr_abc fmy_stat_bn_msw.ctr_end_diag fmy_stat_bn_msw.err_info_stat.lv_err_mem fmy_stat_bn_msw.err_info_stat.lv_ready fmy_stat_bn_msw.err_info_stat.lv_end_diag fmy_stat_bn_msw.err_info_stat.lv_cdn_diag fmy_stat_bn_msw.err_info_stat.err_sym fmy_stat_bn_ang_pste.ctr_abc fmy_stat_bn_ang_pste.ctr_end_diag fmy_stat_bn_ang_pste.err_info_stat.lv_err_mem fmy_stat_bn_ang_pste.err_info_stat.lv_ready fmy_stat_bn_ang_pste.err_info_stat.lv_end_diag fmy_stat_bn_ang_pste.err_info_stat.lv_cdn_diag fmy_stat_bn_ang_pste.err_info_stat.err_sym fmy_stat_bn_efp.ctr_abc fmy_stat_bn_efp.ctr_end_diag fmy_stat_bn_efp.err_info_stat.lv_err_mem fmy_stat_bn_efp.err_info_stat.lv_ready fmy_stat_bn_efp.err_info_stat.lv_end_diag fmy_stat_bn_efp.err_info_stat.lv_cdn_diag fmy_stat_bn_efp.err_info_stat.err_sym fmy_stat_load_tps_plaus.ctr_abc fmy_stat_load_tps_plaus.ctr_end_diag fmy_stat_load_tps_plaus.err_info_stat.lv_err_mem fmy_stat_load_tps_plaus.err_info_stat.lv_ready fmy_stat_load_tps_plaus.err_info_stat.lv_end_diag fmy_stat_load_tps_plaus.err_info_stat.lv_cdn_diag fmy_stat_load_tps_plaus.err_info_stat.err_sym fmy_stat_efp_crash.ctr_abc fmy_stat_efp_crash.ctr_end_diag fmy_stat_efp_crash.err_info_stat.lv_err_mem fmy_stat_efp_crash.err_info_stat.lv_ready fmy_stat_efp_crash.err_info_stat.lv_end_diag fmy_stat_efp_crash.err_info_stat.lv_cdn_diag fmy_stat_efp_crash.err_info_stat.err_sym fmy_stat_efp.ctr_abc fmy_stat_efp.ctr_end_diag fmy_stat_efp.err_info_stat.lv_err_mem fmy_stat_efp.err_info_stat.lv_ready fmy_stat_efp.err_info_stat.lv_end_diag fmy_stat_efp.err_info_stat.lv_cdn_diag fmy_stat_efp.err_info_stat.err_sym fmy_stat_locan_boff.ctr_abc fmy_stat_locan_boff.ctr_end_diag fmy_stat_locan_boff.err_info_stat.lv_err_mem fmy_stat_locan_boff.err_info_stat.lv_ready fmy_stat_locan_boff.err_info_stat.lv_end_diag fmy_stat_locan_boff.err_info_stat.lv_cdn_diag fmy_stat_locan_boff.err_info_stat.err_sym fmy_stat_chg_ls_up.ctr_abc fmy_stat_chg_ls_up.ctr_end_diag fmy_stat_chg_ls_up.err_info_stat.lv_err_mem fmy_stat_chg_ls_up.err_info_stat.lv_ready fmy_stat_chg_ls_up.err_info_stat.lv_end_diag fmy_stat_chg_ls_up.err_info_stat.lv_cdn_diag fmy_stat_chg_ls_up.err_info_stat.err_sym fmy_stat_chg_ls_down.ctr_abc fmy_stat_chg_ls_down.ctr_end_diag fmy_stat_chg_ls_down.err_info_stat.lv_err_mem fmy_stat_chg_ls_down.err_info_stat.lv_ready fmy_stat_chg_ls_down.err_info_stat.lv_end_diag fmy_stat_chg_ls_down.err_info_stat.lv_cdn_diag fmy_stat_chg_ls_down.err_info_stat.err_sym fmy_stat_qoil_sens.ctr_abc fmy_stat_qoil_sens.ctr_end_diag fmy_stat_qoil_sens.err_info_stat.lv_err_mem fmy_stat_qoil_sens.err_info_stat.lv_ready fmy_stat_qoil_sens.err_info_stat.lv_end_diag fmy_stat_qoil_sens.err_info_stat.lv_cdn_diag fmy_stat_qoil_sens.err_info_stat.err_sym fmy_stat_bat_sens.ctr_abc fmy_stat_bat_sens.ctr_end_diag fmy_stat_bat_sens.err_info_stat.lv_err_mem fmy_stat_bat_sens.err_info_stat.lv_ready fmy_stat_bat_sens.err_info_stat.lv_end_diag fmy_stat_bat_sens.err_info_stat.lv_cdn_diag fmy_stat_bat_sens.err_info_stat.err_sym fmy_stat_bat_sens_it.ctr_abc fmy_stat_bat_sens_it.ctr_end_diag fmy_stat_bat_sens_it.err_info_stat.lv_err_mem fmy_stat_bat_sens_it.err_info_stat.lv_ready fmy_stat_bat_sens_it.err_info_stat.lv_end_diag fmy_stat_bat_sens_it.err_info_stat.lv_cdn_diag fmy_stat_bat_sens_it.err_info_stat.err_sym fmy_stat_bat_sens_it_el.ctr_abc fmy_stat_bat_sens_it_el.ctr_end_diag fmy_stat_bat_sens_it_el.err_info_stat.lv_err_mem fmy_stat_bat_sens_it_el.err_info_stat.lv_ready fmy_stat_bat_sens_it_el.err_info_stat.lv_end_diag fmy_stat_bat_sens_it_el.err_info_stat.lv_cdn_diag fmy_stat_bat_sens_it_el.err_info_stat.err_sym fmy_stat_ecu_nvmy.ctr_abc fmy_stat_ecu_nvmy.ctr_end_diag fmy_stat_ecu_nvmy.err_info_stat.lv_err_mem fmy_stat_ecu_nvmy.err_info_stat.lv_ready fmy_stat_ecu_nvmy.err_info_stat.lv_end_diag fmy_stat_ecu_nvmy.err_info_stat.lv_cdn_diag fmy_stat_ecu_nvmy.err_info_stat.err_sym fmy_stat_gs.ctr_abc fmy_stat_gs.ctr_end_diag fmy_stat_gs.err_info_stat.lv_err_mem fmy_stat_gs.err_info_stat.lv_ready fmy_stat_gs.err_info_stat.lv_end_diag fmy_stat_gs.err_info_stat.lv_cdn_diag fmy_stat_gs.err_info_stat.err_sym fmy_stat_o3_conc.ctr_abc fmy_stat_o3_conc.ctr_end_diag fmy_stat_o3_conc.err_info_stat.lv_err_mem fmy_stat_o3_conc.err_info_stat.lv_ready fmy_stat_o3_conc.err_info_stat.lv_end_diag fmy_stat_o3_conc.err_info_stat.lv_cdn_diag fmy_stat_o3_conc.err_info_stat.err_sym fmy_stat_ls_up_shift_afl_1.ctr_abc fmy_stat_ls_up_shift_afl_1.ctr_end_diag fmy_stat_ls_up_shift_afl_1.err_info_stat.lv_err_mem fmy_stat_ls_up_shift_afl_1.err_info_stat.lv_ready fmy_stat_ls_up_shift_afl_1.err_info_stat.lv_end_diag fmy_stat_ls_up_shift_afl_1.err_info_stat.lv_cdn_diag fmy_stat_ls_up_shift_afl_1.err_info_stat.err_sym fmy_stat_ls_up_shift_afl_2.ctr_abc fmy_stat_ls_up_shift_afl_2.ctr_end_diag fmy_stat_ls_up_shift_afl_2.err_info_stat.lv_err_mem fmy_stat_ls_up_shift_afl_2.err_info_stat.lv_ready fmy_stat_ls_up_shift_afl_2.err_info_stat.lv_end_diag fmy_stat_ls_up_shift_afl_2.err_info_stat.lv_cdn_diag fmy_stat_ls_up_shift_afl_2.err_info_stat.err_sym fmy_stat_ls_up_shift_afr_1.ctr_abc fmy_stat_ls_up_shift_afr_1.ctr_end_diag fmy_stat_ls_up_shift_afr_1.err_info_stat.lv_err_mem fmy_stat_ls_up_shift_afr_1.err_info_stat.lv_ready fmy_stat_ls_up_shift_afr_1.err_info_stat.lv_end_diag fmy_stat_ls_up_shift_afr_1.err_info_stat.lv_cdn_diag fmy_stat_ls_up_shift_afr_1.err_info_stat.err_sym fmy_stat_ls_up_shift_afr_2.ctr_abc fmy_stat_ls_up_shift_afr_2.ctr_end_diag fmy_stat_ls_up_shift_afr_2.err_info_stat.lv_err_mem fmy_stat_ls_up_shift_afr_2.err_info_stat.lv_ready fmy_stat_ls_up_shift_afr_2.err_info_stat.lv_end_diag fmy_stat_ls_up_shift_afr_2.err_info_stat.lv_cdn_diag fmy_stat_ls_up_shift_afr_2.err_info_stat.err_sym fmy_stat_oc_lsl_1.ctr_abc fmy_stat_oc_lsl_1.ctr_end_diag fmy_stat_oc_lsl_1.err_info_stat.lv_err_mem fmy_stat_oc_lsl_1.err_info_stat.lv_ready fmy_stat_oc_lsl_1.err_info_stat.lv_end_diag fmy_stat_oc_lsl_1.err_info_stat.lv_cdn_diag fmy_stat_oc_lsl_1.err_info_stat.err_sym fmy_stat_oc_lsl_2.ctr_abc fmy_stat_oc_lsl_2.ctr_end_diag fmy_stat_oc_lsl_2.err_info_stat.lv_err_mem fmy_stat_oc_lsl_2.err_info_stat.lv_ready fmy_stat_oc_lsl_2.err_info_stat.lv_end_diag fmy_stat_oc_lsl_2.err_info_stat.lv_cdn_diag fmy_stat_oc_lsl_2.err_info_stat.err_sym fmy_stat_cat_diag_1.ctr_abc fmy_stat_cat_diag_1.ctr_end_diag fmy_stat_cat_diag_1.err_info_stat.lv_err_mem fmy_stat_cat_diag_1.err_info_stat.lv_ready fmy_stat_cat_diag_1.err_info_stat.lv_end_diag fmy_stat_cat_diag_1.err_info_stat.lv_cdn_diag fmy_stat_cat_diag_1.err_info_stat.err_sym fmy_stat_cat_diag_2.ctr_abc fmy_stat_cat_diag_2.ctr_end_diag fmy_stat_cat_diag_2.err_info_stat.lv_err_mem fmy_stat_cat_diag_2.err_info_stat.lv_ready fmy_stat_cat_diag_2.err_info_stat.lv_end_diag fmy_stat_cat_diag_2.err_info_stat.lv_cdn_diag fmy_stat_cat_diag_2.err_info_stat.err_sym fmy_stat_el_lsl_1.ctr_abc fmy_stat_el_lsl_1.ctr_end_diag fmy_stat_el_lsl_1.err_info_stat.lv_err_mem fmy_stat_el_lsl_1.err_info_stat.lv_ready fmy_stat_el_lsl_1.err_info_stat.lv_end_diag fmy_stat_el_lsl_1.err_info_stat.lv_cdn_diag fmy_stat_el_lsl_1.err_info_stat.err_sym fmy_stat_el_lsl_2.ctr_abc fmy_stat_el_lsl_2.ctr_end_diag fmy_stat_el_lsl_2.err_info_stat.lv_err_mem fmy_stat_el_lsl_2.err_info_stat.lv_ready fmy_stat_el_lsl_2.err_info_stat.lv_end_diag fmy_stat_el_lsl_2.err_info_stat.lv_cdn_diag fmy_stat_el_lsl_2.err_info_stat.err_sym fmy_stat_cat_diag_nox_1.ctr_abc fmy_stat_cat_diag_nox_1.ctr_end_diag fmy_stat_cat_diag_nox_1.err_info_stat.lv_err_mem fmy_stat_cat_diag_nox_1.err_info_stat.lv_ready fmy_stat_cat_diag_nox_1.err_info_stat.lv_end_diag fmy_stat_cat_diag_nox_1.err_info_stat.lv_cdn_diag fmy_stat_cat_diag_nox_1.err_info_stat.err_sym fmy_stat_cat_diag_nox_2.ctr_abc fmy_stat_cat_diag_nox_2.ctr_end_diag fmy_stat_cat_diag_nox_2.err_info_stat.lv_err_mem fmy_stat_cat_diag_nox_2.err_info_stat.lv_ready fmy_stat_cat_diag_nox_2.err_info_stat.lv_end_diag fmy_stat_cat_diag_nox_2.err_info_stat.lv_cdn_diag fmy_stat_cat_diag_nox_2.err_info_stat.err_sym fmy_stat_vls_down_puc_1.ctr_abc fmy_stat_vls_down_puc_1.ctr_end_diag fmy_stat_vls_down_puc_1.err_info_stat.lv_err_mem fmy_stat_vls_down_puc_1.err_info_stat.lv_ready fmy_stat_vls_down_puc_1.err_info_stat.lv_end_diag fmy_stat_vls_down_puc_1.err_info_stat.lv_cdn_diag fmy_stat_vls_down_puc_1.err_info_stat.err_sym fmy_stat_vls_down_puc_2.ctr_abc fmy_stat_vls_down_puc_2.ctr_end_diag fmy_stat_vls_down_puc_2.err_info_stat.lv_err_mem fmy_stat_vls_down_puc_2.err_info_stat.lv_ready fmy_stat_vls_down_puc_2.err_info_stat.lv_end_diag fmy_stat_vls_down_puc_2.err_info_stat.lv_cdn_diag fmy_stat_vls_down_puc_2.err_info_stat.err_sym fmy_stat_vls_down_fl_1.ctr_abc fmy_stat_vls_down_fl_1.ctr_end_diag fmy_stat_vls_down_fl_1.err_info_stat.lv_err_mem fmy_stat_vls_down_fl_1.err_info_stat.lv_ready fmy_stat_vls_down_fl_1.err_info_stat.lv_end_diag fmy_stat_vls_down_fl_1.err_info_stat.lv_cdn_diag fmy_stat_vls_down_fl_1.err_info_stat.err_sym fmy_stat_vls_down_fl_2.ctr_abc fmy_stat_vls_down_fl_2.ctr_end_diag fmy_stat_vls_down_fl_2.err_info_stat.lv_err_mem fmy_stat_vls_down_fl_2.err_info_stat.lv_ready fmy_stat_vls_down_fl_2.err_info_stat.lv_end_diag fmy_stat_vls_down_fl_2.err_info_stat.lv_cdn_diag fmy_stat_vls_down_fl_2.err_info_stat.err_sym fmy_stat_chk_ls_down_1.ctr_abc fmy_stat_chk_ls_down_1.ctr_end_diag fmy_stat_chk_ls_down_1.err_info_stat.lv_err_mem fmy_stat_chk_ls_down_1.err_info_stat.lv_ready fmy_stat_chk_ls_down_1.err_info_stat.lv_end_diag fmy_stat_chk_ls_down_1.err_info_stat.lv_cdn_diag fmy_stat_chk_ls_down_1.err_info_stat.err_sym fmy_stat_chk_ls_down_2.ctr_abc fmy_stat_chk_ls_down_2.ctr_end_diag fmy_stat_chk_ls_down_2.err_info_stat.lv_err_mem fmy_stat_chk_ls_down_2.err_info_stat.lv_ready fmy_stat_chk_ls_down_2.err_info_stat.lv_end_diag fmy_stat_chk_ls_down_2.err_info_stat.lv_cdn_diag fmy_stat_chk_ls_down_2.err_info_stat.err_sym fmy_stat_delta_lamb_i_1.ctr_abc fmy_stat_delta_lamb_i_1.ctr_end_diag fmy_stat_delta_lamb_i_1.err_info_stat.lv_err_mem fmy_stat_delta_lamb_i_1.err_info_stat.lv_ready fmy_stat_delta_lamb_i_1.err_info_stat.lv_end_diag fmy_stat_delta_lamb_i_1.err_info_stat.lv_cdn_diag fmy_stat_delta_lamb_i_1.err_info_stat.err_sym fmy_stat_delta_lamb_i_2.ctr_abc fmy_stat_delta_lamb_i_2.ctr_end_diag fmy_stat_delta_lamb_i_2.err_info_stat.lv_err_mem fmy_stat_delta_lamb_i_2.err_info_stat.lv_ready fmy_stat_delta_lamb_i_2.err_info_stat.lv_end_diag fmy_stat_delta_lamb_i_2.err_info_stat.lv_cdn_diag fmy_stat_delta_lamb_i_2.err_info_stat.err_sym fmy_stat_o3_up.ctr_abc fmy_stat_o3_up.ctr_end_diag fmy_stat_o3_up.err_info_stat.lv_err_mem fmy_stat_o3_up.err_info_stat.lv_ready fmy_stat_o3_up.err_info_stat.lv_end_diag fmy_stat_o3_up.err_info_stat.lv_cdn_diag fmy_stat_o3_up.err_info_stat.err_sym fmy_stat_o3_down.ctr_abc fmy_stat_o3_down.ctr_end_diag fmy_stat_o3_down.err_info_stat.lv_err_mem fmy_stat_o3_down.err_info_stat.lv_ready fmy_stat_o3_down.err_info_stat.lv_end_diag fmy_stat_o3_down.err_info_stat.lv_cdn_diag fmy_stat_o3_down.err_info_stat.err_sym fmy_stat_obd2_ttip_ls_up_1.ctr_abc fmy_stat_obd2_ttip_ls_up_1.ctr_end_diag fmy_stat_obd2_ttip_ls_up_1.err_info_stat.lv_err_mem fmy_stat_obd2_ttip_ls_up_1.err_info_stat.lv_ready fmy_stat_obd2_ttip_ls_up_1.err_info_stat.lv_end_diag fmy_stat_obd2_ttip_ls_up_1.err_info_stat.lv_cdn_diag fmy_stat_obd2_ttip_ls_up_1.err_info_stat.err_sym fmy_stat_obd2_ttip_ls_up_2.ctr_abc fmy_stat_obd2_ttip_ls_up_2.ctr_end_diag fmy_stat_obd2_ttip_ls_up_2.err_info_stat.lv_err_mem fmy_stat_obd2_ttip_ls_up_2.err_info_stat.lv_ready fmy_stat_obd2_ttip_ls_up_2.err_info_stat.lv_end_diag fmy_stat_obd2_ttip_ls_up_2.err_info_stat.lv_cdn_diag fmy_stat_obd2_ttip_ls_up_2.err_info_stat.err_sym fmy_stat_lsh_ls_up_1.ctr_abc fmy_stat_lsh_ls_up_1.ctr_end_diag fmy_stat_lsh_ls_up_1.err_info_stat.lv_err_mem fmy_stat_lsh_ls_up_1.err_info_stat.lv_ready fmy_stat_lsh_ls_up_1.err_info_stat.lv_end_diag fmy_stat_lsh_ls_up_1.err_info_stat.lv_cdn_diag fmy_stat_lsh_ls_up_1.err_info_stat.err_sym fmy_stat_lsh_ls_up_2.ctr_abc fmy_stat_lsh_ls_up_2.ctr_end_diag fmy_stat_lsh_ls_up_2.err_info_stat.lv_err_mem fmy_stat_lsh_ls_up_2.err_info_stat.lv_ready fmy_stat_lsh_ls_up_2.err_info_stat.lv_end_diag fmy_stat_lsh_ls_up_2.err_info_stat.lv_cdn_diag fmy_stat_lsh_ls_up_2.err_info_stat.err_sym fmy_stat_vls_up_thd_over_1.ctr_abc fmy_stat_vls_up_thd_over_1.ctr_end_diag fmy_stat_vls_up_thd_over_1.err_info_stat.lv_err_mem fmy_stat_vls_up_thd_over_1.err_info_stat.lv_ready fmy_stat_vls_up_thd_over_1.err_info_stat.lv_end_diag fmy_stat_vls_up_thd_over_1.err_info_stat.lv_cdn_diag fmy_stat_vls_up_thd_over_1.err_info_stat.err_sym fmy_stat_vls_up_thd_over_2.ctr_abc fmy_stat_vls_up_thd_over_2.ctr_end_diag fmy_stat_vls_up_thd_over_2.err_info_stat.lv_err_mem fmy_stat_vls_up_thd_over_2.err_info_stat.lv_ready fmy_stat_vls_up_thd_over_2.err_info_stat.lv_end_diag fmy_stat_vls_up_thd_over_2.err_info_stat.lv_cdn_diag fmy_stat_vls_up_thd_over_2.err_info_stat.err_sym fmy_stat_tout_nox_sens_1.ctr_abc fmy_stat_tout_nox_sens_1.ctr_end_diag fmy_stat_tout_nox_sens_1.err_info_stat.lv_err_mem fmy_stat_tout_nox_sens_1.err_info_stat.lv_ready fmy_stat_tout_nox_sens_1.err_info_stat.lv_end_diag fmy_stat_tout_nox_sens_1.err_info_stat.lv_cdn_diag fmy_stat_tout_nox_sens_1.err_info_stat.err_sym fmy_stat_nox_sens_1.ctr_abc fmy_stat_nox_sens_1.ctr_end_diag fmy_stat_nox_sens_1.err_info_stat.lv_err_mem fmy_stat_nox_sens_1.err_info_stat.lv_ready fmy_stat_nox_sens_1.err_info_stat.lv_end_diag fmy_stat_nox_sens_1.err_info_stat.lv_cdn_diag fmy_stat_nox_sens_1.err_info_stat.err_sym fmy_stat_tout_nox_sens_2.ctr_abc fmy_stat_tout_nox_sens_2.ctr_end_diag fmy_stat_tout_nox_sens_2.err_info_stat.lv_err_mem fmy_stat_tout_nox_sens_2.err_info_stat.lv_ready fmy_stat_tout_nox_sens_2.err_info_stat.lv_end_diag fmy_stat_tout_nox_sens_2.err_info_stat.lv_cdn_diag fmy_stat_tout_nox_sens_2.err_info_stat.err_sym fmy_stat_nox_sens_2.ctr_abc fmy_stat_nox_sens_2.ctr_end_diag fmy_stat_nox_sens_2.err_info_stat.lv_err_mem fmy_stat_nox_sens_2.err_info_stat.lv_ready fmy_stat_nox_sens_2.err_info_stat.lv_end_diag fmy_stat_nox_sens_2.err_info_stat.lv_cdn_diag fmy_stat_nox_sens_2.err_info_stat.err_sym fmy_stat_if_lsl_1.ctr_abc fmy_stat_if_lsl_1.ctr_end_diag fmy_stat_if_lsl_1.err_info_stat.lv_err_mem fmy_stat_if_lsl_1.err_info_stat.lv_ready fmy_stat_if_lsl_1.err_info_stat.lv_end_diag fmy_stat_if_lsl_1.err_info_stat.lv_cdn_diag fmy_stat_if_lsl_1.err_info_stat.err_sym fmy_stat_if_lsl_2.ctr_abc fmy_stat_if_lsl_2.ctr_end_diag fmy_stat_if_lsl_2.err_info_stat.lv_err_mem fmy_stat_if_lsl_2.err_info_stat.lv_ready fmy_stat_if_lsl_2.err_info_stat.lv_end_diag fmy_stat_if_lsl_2.err_info_stat.lv_cdn_diag fmy_stat_if_lsl_2.err_info_stat.err_sym fmy_stat_ls_up_dyn_vld_1.ctr_abc fmy_stat_ls_up_dyn_vld_1.ctr_end_diag fmy_stat_ls_up_dyn_vld_1.err_info_stat.lv_err_mem fmy_stat_ls_up_dyn_vld_1.err_info_stat.lv_ready fmy_stat_ls_up_dyn_vld_1.err_info_stat.lv_end_diag fmy_stat_ls_up_dyn_vld_1.err_info_stat.lv_cdn_diag fmy_stat_ls_up_dyn_vld_1.err_info_stat.err_sym fmy_stat_ls_up_dyn_vld_2.ctr_abc fmy_stat_ls_up_dyn_vld_2.ctr_end_diag fmy_stat_ls_up_dyn_vld_2.err_info_stat.lv_err_mem fmy_stat_ls_up_dyn_vld_2.err_info_stat.lv_ready fmy_stat_ls_up_dyn_vld_2.err_info_stat.lv_end_diag fmy_stat_ls_up_dyn_vld_2.err_info_stat.lv_cdn_diag fmy_stat_ls_up_dyn_vld_2.err_info_stat.err_sym fmy_stat_ls_up_puc_vld_1.ctr_abc fmy_stat_ls_up_puc_vld_1.ctr_end_diag fmy_stat_ls_up_puc_vld_1.err_info_stat.lv_err_mem fmy_stat_ls_up_puc_vld_1.err_info_stat.lv_ready fmy_stat_ls_up_puc_vld_1.err_info_stat.lv_end_diag fmy_stat_ls_up_puc_vld_1.err_info_stat.lv_cdn_diag fmy_stat_ls_up_puc_vld_1.err_info_stat.err_sym fmy_stat_ls_up_puc_vld_2.ctr_abc fmy_stat_ls_up_puc_vld_2.ctr_end_diag fmy_stat_ls_up_puc_vld_2.err_info_stat.lv_err_mem fmy_stat_ls_up_puc_vld_2.err_info_stat.lv_ready fmy_stat_ls_up_puc_vld_2.err_info_stat.lv_end_diag fmy_stat_ls_up_puc_vld_2.err_info_stat.lv_cdn_diag fmy_stat_ls_up_puc_vld_2.err_info_stat.err_sym fmy_stat_lsh_up_obd2_vld_1.ctr_abc fmy_stat_lsh_up_obd2_vld_1.ctr_end_diag fmy_stat_lsh_up_obd2_vld_1.err_info_stat.lv_err_mem fmy_stat_lsh_up_obd2_vld_1.err_info_stat.lv_ready fmy_stat_lsh_up_obd2_vld_1.err_info_stat.lv_end_diag fmy_stat_lsh_up_obd2_vld_1.err_info_stat.lv_cdn_diag fmy_stat_lsh_up_obd2_vld_1.err_info_stat.err_sym fmy_stat_lsh_up_obd2_vld_2.ctr_abc fmy_stat_lsh_up_obd2_vld_2.ctr_end_diag fmy_stat_lsh_up_obd2_vld_2.err_info_stat.lv_err_mem fmy_stat_lsh_up_obd2_vld_2.err_info_stat.lv_ready fmy_stat_lsh_up_obd2_vld_2.err_info_stat.lv_end_diag fmy_stat_lsh_up_obd2_vld_2.err_info_stat.lv_cdn_diag fmy_stat_lsh_up_obd2_vld_2.err_info_stat.err_sym fmy_stat_nox_sens_htp_1.ctr_abc fmy_stat_nox_sens_htp_1.ctr_end_diag fmy_stat_nox_sens_htp_1.err_info_stat.lv_err_mem fmy_stat_nox_sens_htp_1.err_info_stat.lv_ready fmy_stat_nox_sens_htp_1.err_info_stat.lv_end_diag fmy_stat_nox_sens_htp_1.err_info_stat.lv_cdn_diag fmy_stat_nox_sens_htp_1.err_info_stat.err_sym fmy_stat_nox_sens_plaus_1.ctr_abc fmy_stat_nox_sens_plaus_1.ctr_end_diag fmy_stat_nox_sens_plaus_1.err_info_stat.lv_err_mem fmy_stat_nox_sens_plaus_1.err_info_stat.lv_ready fmy_stat_nox_sens_plaus_1.err_info_stat.lv_end_diag fmy_stat_nox_sens_plaus_1.err_info_stat.lv_cdn_diag fmy_stat_nox_sens_plaus_1.err_info_stat.err_sym fmy_stat_nox_sens_avl_1.ctr_abc fmy_stat_nox_sens_avl_1.ctr_end_diag fmy_stat_nox_sens_avl_1.err_info_stat.lv_err_mem fmy_stat_nox_sens_avl_1.err_info_stat.lv_ready fmy_stat_nox_sens_avl_1.err_info_stat.lv_end_diag fmy_stat_nox_sens_avl_1.err_info_stat.lv_cdn_diag fmy_stat_nox_sens_avl_1.err_info_stat.err_sym fmy_stat_nox_sens_dyn_1.ctr_abc fmy_stat_nox_sens_dyn_1.ctr_end_diag fmy_stat_nox_sens_dyn_1.err_info_stat.lv_err_mem fmy_stat_nox_sens_dyn_1.err_info_stat.lv_ready fmy_stat_nox_sens_dyn_1.err_info_stat.lv_end_diag fmy_stat_nox_sens_dyn_1.err_info_stat.lv_cdn_diag fmy_stat_nox_sens_dyn_1.err_info_stat.err_sym fmy_stat_nox_sens_ref_air_1.ctr_abc fmy_stat_nox_sens_ref_air_1.ctr_end_diag fmy_stat_nox_sens_ref_air_1.err_info_stat.lv_err_mem fmy_stat_nox_sens_ref_air_1.err_info_stat.lv_ready fmy_stat_nox_sens_ref_air_1.err_info_stat.lv_end_diag fmy_stat_nox_sens_ref_air_1.err_info_stat.lv_cdn_diag fmy_stat_nox_sens_ref_air_1.err_info_stat.err_sym fmy_stat_nox_sens_htp_2.ctr_abc fmy_stat_nox_sens_htp_2.ctr_end_diag fmy_stat_nox_sens_htp_2.err_info_stat.lv_err_mem fmy_stat_nox_sens_htp_2.err_info_stat.lv_ready fmy_stat_nox_sens_htp_2.err_info_stat.lv_end_diag fmy_stat_nox_sens_htp_2.err_info_stat.lv_cdn_diag fmy_stat_nox_sens_htp_2.err_info_stat.err_sym fmy_stat_nox_sens_plaus_2.ctr_abc fmy_stat_nox_sens_plaus_2.ctr_end_diag fmy_stat_nox_sens_plaus_2.err_info_stat.lv_err_mem fmy_stat_nox_sens_plaus_2.err_info_stat.lv_ready fmy_stat_nox_sens_plaus_2.err_info_stat.lv_end_diag fmy_stat_nox_sens_plaus_2.err_info_stat.lv_cdn_diag fmy_stat_nox_sens_plaus_2.err_info_stat.err_sym fmy_stat_nox_sens_avl_2.ctr_abc fmy_stat_nox_sens_avl_2.ctr_end_diag fmy_stat_nox_sens_avl_2.err_info_stat.lv_err_mem fmy_stat_nox_sens_avl_2.err_info_stat.lv_ready fmy_stat_nox_sens_avl_2.err_info_stat.lv_end_diag fmy_stat_nox_sens_avl_2.err_info_stat.lv_cdn_diag fmy_stat_nox_sens_avl_2.err_info_stat.err_sym fmy_stat_nox_sens_dyn_2.ctr_abc fmy_stat_nox_sens_dyn_2.ctr_end_diag fmy_stat_nox_sens_dyn_2.err_info_stat.lv_err_mem fmy_stat_nox_sens_dyn_2.err_info_stat.lv_ready fmy_stat_nox_sens_dyn_2.err_info_stat.lv_end_diag fmy_stat_nox_sens_dyn_2.err_info_stat.lv_cdn_diag fmy_stat_nox_sens_dyn_2.err_info_stat.err_sym fmy_stat_nox_sens_ref_air_2.ctr_abc fmy_stat_nox_sens_ref_air_2.ctr_end_diag fmy_stat_nox_sens_ref_air_2.err_info_stat.lv_err_mem fmy_stat_nox_sens_ref_air_2.err_info_stat.lv_ready fmy_stat_nox_sens_ref_air_2.err_info_stat.lv_end_diag fmy_stat_nox_sens_ref_air_2.err_info_stat.lv_cdn_diag fmy_stat_nox_sens_ref_air_2.err_info_stat.err_sym /end OUT_MEASUREMENT
/end FUNCTION
/end MODULE
/end PROJECT
