ASAP2_VERSION 1 41
/begin PROJECT MSD70 "Spray Guided DI-System with Piezo Injectors for 6-Cylinder"
/begin HEADER "_default_HeaderComment" PROJECT_NO _0B /end HEADER
/begin MODULE _default_ModuleName "_default_ModuleLongIdentifier"
/begin MOD_COMMON "_default_ModCommonComment" DEPOSIT ABSOLUTE BYTE_ORDER MSB_LAST ALIGNMENT_BYTE 1 ALIGNMENT_WORD 2 ALIGNMENT_LONG 2 ALIGNMENT_FLOAT32_IEEE 2 ALIGNMENT_FLOAT64_IEEE 4 /end MOD_COMMON
/begin CHARACTERISTIC fmy_id_imob_1.envd "Freeze frame FRF_CUS_SET_SPC: environmental data contents for failure XX" CURVE 0xa1004320 _REC_CUR_20_u1_u1 254. _CNV_A_R_LINEAR_____0_CM 1. 255. DISPLAY_IDENTIFIER ID_ERR_ENVD_IMOB_1 FORMAT "%3.0"
 /begin AXIS_DESCR COM_AXIS errm_online_dummy _CNV_A_R_LINEAR_____0_CM 4 0. 255. FORMAT "%3.0" AXIS_PTS_REF ldpm_fmy_envd /end AXIS_DESCR
/end CHARACTERISTIC
/begin CHARACTERISTIC fmy_id_imob_2.envd "Freeze frame FRF_CUS_SET_SPC: environmental data contents for failure XX" CURVE 0xa1004334 _REC_CUR_20_u1_u1 254. _CNV_A_R_LINEAR_____0_CM 1. 255. DISPLAY_IDENTIFIER ID_ERR_ENVD_IMOB_2 FORMAT "%3.0"
 /begin AXIS_DESCR COM_AXIS errm_online_dummy _CNV_A_R_LINEAR_____0_CM 4 0. 255. FORMAT "%3.0" AXIS_PTS_REF ldpm_fmy_envd /end AXIS_DESCR
/end CHARACTERISTIC
/begin CHARACTERISTIC fmy_id_imob_3.envd "Freeze frame FRF_CUS_SET_SPC: environmental data contents for failure XX" CURVE 0xa1004348 _REC_CUR_20_u1_u1 254. _CNV_A_R_LINEAR_____0_CM 1. 255. DISPLAY_IDENTIFIER ID_ERR_ENVD_IMOB_3 FORMAT "%3.0"
 /begin AXIS_DESCR COM_AXIS errm_online_dummy _CNV_A_R_LINEAR_____0_CM 4 0. 255. FORMAT "%3.0" AXIS_PTS_REF ldpm_fmy_envd /end AXIS_DESCR
/end CHARACTERISTIC
/begin CHARACTERISTIC fmy_id_tco_el.envd "Freeze frame FRF_CUS_SET_SPC: environmental data contents for failure XX" CURVE 0xa1004cd0 _REC_CUR_20_u1_u1 254. _CNV_A_R_LINEAR_____0_CM 1. 255. DISPLAY_IDENTIFIER ID_ERR_ENVD_TCO_EL FORMAT "%3.0"
 /begin AXIS_DESCR COM_AXIS errm_online_dummy _CNV_A_R_LINEAR_____0_CM 4 0. 255. FORMAT "%3.0" AXIS_PTS_REF ldpm_fmy_envd /end AXIS_DESCR
/end CHARACTERISTIC
/begin CHARACTERISTIC fmy_id_tco_grd.envd "Freeze frame FRF_CUS_SET_SPC: environmental data contents for failure XX" CURVE 0xa1004ce4 _REC_CUR_20_u1_u1 254. _CNV_A_R_LINEAR_____0_CM 1. 255. DISPLAY_IDENTIFIER ID_ERR_ENVD_TCO_GRD FORMAT "%3.0"
 /begin AXIS_DESCR COM_AXIS errm_online_dummy _CNV_A_R_LINEAR_____0_CM 4 0. 255. FORMAT "%3.0" AXIS_PTS_REF ldpm_fmy_envd /end AXIS_DESCR
/end CHARACTERISTIC
/begin CHARACTERISTIC fmy_id_tco_stuck.envd "Freeze frame FRF_CUS_SET_SPC: environmental data contents for failure XX" CURVE 0xa1004d0c _REC_CUR_20_u1_u1 254. _CNV_A_R_LINEAR_____0_CM 1. 255. DISPLAY_IDENTIFIER ID_ERR_ENVD_TCO_STUCK FORMAT "%3.0"
 /begin AXIS_DESCR COM_AXIS errm_online_dummy _CNV_A_R_LINEAR_____0_CM 4 0. 255. FORMAT "%3.0" AXIS_PTS_REF ldpm_fmy_envd /end AXIS_DESCR
/end CHARACTERISTIC
/begin CHARACTERISTIC fmy_id_tco_plaus.envd "Freeze frame FRF_CUS_SET_SPC: environmental data contents for failure XX" CURVE 0xa1004cf8 _REC_CUR_20_u1_u1 254. _CNV_A_R_LINEAR_____0_CM 1. 255. DISPLAY_IDENTIFIER ID_ERR_ENVD_TCO_PLAUS FORMAT "%3.0"
 /begin AXIS_DESCR COM_AXIS errm_online_dummy _CNV_A_R_LINEAR_____0_CM 4 0. 255. FORMAT "%3.0" AXIS_PTS_REF ldpm_fmy_envd /end AXIS_DESCR
/end CHARACTERISTIC
/begin CHARACTERISTIC fmy_id_tco_2_el.envd "Freeze frame FRF_CUS_SET_SPC: environmental data contents for failure XX" CURVE 0xa1004c94 _REC_CUR_20_u1_u1 254. _CNV_A_R_LINEAR_____0_CM 1. 255. DISPLAY_IDENTIFIER ID_ERR_ENVD_TCO_2_EL FORMAT "%3.0"
 /begin AXIS_DESCR COM_AXIS errm_online_dummy _CNV_A_R_LINEAR_____0_CM 4 0. 255. FORMAT "%3.0" AXIS_PTS_REF ldpm_fmy_envd /end AXIS_DESCR
/end CHARACTERISTIC
/begin CHARACTERISTIC fmy_id_tco_2_grd.envd "Freeze frame FRF_CUS_SET_SPC: environmental data contents for failure XX" CURVE 0xa1004ca8 _REC_CUR_20_u1_u1 254. _CNV_A_R_LINEAR_____0_CM 1. 255. DISPLAY_IDENTIFIER ID_ERR_ENVD_TCO_2_GRD FORMAT "%3.0"
 /begin AXIS_DESCR COM_AXIS errm_online_dummy _CNV_A_R_LINEAR_____0_CM 4 0. 255. FORMAT "%3.0" AXIS_PTS_REF ldpm_fmy_envd /end AXIS_DESCR
/end CHARACTERISTIC
/begin CHARACTERISTIC fmy_id_tco_2_plaus.envd "Freeze frame FRF_CUS_SET_SPC: environmental data contents for failure XX" CURVE 0xa1004cbc _REC_CUR_20_u1_u1 254. _CNV_A_R_LINEAR_____0_CM 1. 255. DISPLAY_IDENTIFIER ID_ERR_ENVD_TCO_2_PLAUS FORMAT "%3.0"
 /begin AXIS_DESCR COM_AXIS errm_online_dummy _CNV_A_R_LINEAR_____0_CM 4 0. 255. FORMAT "%3.0" AXIS_PTS_REF ldpm_fmy_envd /end AXIS_DESCR
/end CHARACTERISTIC
/begin CHARACTERISTIC fmy_id_ect_el.envd "Freeze frame FRF_CUS_SET_SPC: environmental data contents for failure XX" CURVE 0xa1003f88 _REC_CUR_20_u1_u1 254. _CNV_A_R_LINEAR_____0_CM 1. 255. DISPLAY_IDENTIFIER ID_ERR_ENVD_ECT_EL FORMAT "%3.0"
 /begin AXIS_DESCR COM_AXIS errm_online_dummy _CNV_A_R_LINEAR_____0_CM 4 0. 255. FORMAT "%3.0" AXIS_PTS_REF ldpm_fmy_envd /end AXIS_DESCR
/end CHARACTERISTIC
/begin CHARACTERISTIC fmy_id_ecf_el_1.envd "Freeze frame FRF_CUS_SET_SPC: environmental data contents for failure XX" CURVE 0xa1003f38 _REC_CUR_20_u1_u1 254. _CNV_A_R_LINEAR_____0_CM 1. 255. DISPLAY_IDENTIFIER ID_ERR_ENVD_ECF_EL_1 FORMAT "%3.0"
 /begin AXIS_DESCR COM_AXIS errm_online_dummy _CNV_A_R_LINEAR_____0_CM 4 0. 255. FORMAT "%3.0" AXIS_PTS_REF ldpm_fmy_envd /end AXIS_DESCR
/end CHARACTERISTIC
/begin CHARACTERISTIC fmy_id_ecfpwm_fb_1.envd "Freeze frame FRF_CUS_SET_SPC: environmental data contents for failure XX" CURVE 0xa1003f4c _REC_CUR_20_u1_u1 254. _CNV_A_R_LINEAR_____0_CM 1. 255. DISPLAY_IDENTIFIER ID_ERR_ENVD_ECFPWM_FB_1 FORMAT "%3.0"
 /begin AXIS_DESCR COM_AXIS errm_online_dummy _CNV_A_R_LINEAR_____0_CM 4 0. 255. FORMAT "%3.0" AXIS_PTS_REF ldpm_fmy_envd /end AXIS_DESCR
/end CHARACTERISTIC
/begin CHARACTERISTIC fmy_id_th.envd "Freeze frame FRF_CUS_SET_SPC: environmental data contents for failure XX" CURVE 0xa1004d5c _REC_CUR_20_u1_u1 254. _CNV_A_R_LINEAR_____0_CM 1. 255. DISPLAY_IDENTIFIER ID_ERR_ENVD_TH FORMAT "%3.0"
 /begin AXIS_DESCR COM_AXIS errm_online_dummy _CNV_A_R_LINEAR_____0_CM 4 0. 255. FORMAT "%3.0" AXIS_PTS_REF ldpm_fmy_envd /end AXIS_DESCR
/end CHARACTERISTIC
/begin CHARACTERISTIC fmy_id_ftl_min.envd "Freeze frame FRF_CUS_SET_SPC: environmental data contents for failure XX" CURVE 0xa10040dc _REC_CUR_20_u1_u1 254. _CNV_A_R_LINEAR_____0_CM 1. 255. DISPLAY_IDENTIFIER ID_ERR_ENVD_FTL_MIN FORMAT "%3.0"
 /begin AXIS_DESCR COM_AXIS errm_online_dummy _CNV_A_R_LINEAR_____0_CM 4 0. 255. FORMAT "%3.0" AXIS_PTS_REF ldpm_fmy_envd /end AXIS_DESCR
/end CHARACTERISTIC
/begin CHARACTERISTIC fmy_id_tia_el.envd "Freeze frame FRF_CUS_SET_SPC: environmental data contents for failure XX" CURVE 0xa1004d70 _REC_CUR_20_u1_u1 254. _CNV_A_R_LINEAR_____0_CM 1. 255. DISPLAY_IDENTIFIER ID_ERR_ENVD_TIA_EL FORMAT "%3.0"
 /begin AXIS_DESCR COM_AXIS errm_online_dummy _CNV_A_R_LINEAR_____0_CM 4 0. 255. FORMAT "%3.0" AXIS_PTS_REF ldpm_fmy_envd /end AXIS_DESCR
/end CHARACTERISTIC
/begin CHARACTERISTIC fmy_id_amp.envd "Freeze frame FRF_CUS_SET_SPC: environmental data contents for failure XX" CURVE 0xa1003998 _REC_CUR_20_u1_u1 254. _CNV_A_R_LINEAR_____0_CM 1. 255. DISPLAY_IDENTIFIER ID_ERR_ENVD_AMP FORMAT "%3.0"
 /begin AXIS_DESCR COM_AXIS errm_online_dummy _CNV_A_R_LINEAR_____0_CM 4 0. 255. FORMAT "%3.0" AXIS_PTS_REF ldpm_fmy_envd /end AXIS_DESCR
/end CHARACTERISTIC
/begin CHARACTERISTIC fmy_id_amp_plaus.envd "Freeze frame FRF_CUS_SET_SPC: environmental data contents for failure XX" CURVE 0xa10039ac _REC_CUR_20_u1_u1 254. _CNV_A_R_LINEAR_____0_CM 1. 255. DISPLAY_IDENTIFIER ID_ERR_ENVD_AMP_PLAUS FORMAT "%3.0"
 /begin AXIS_DESCR COM_AXIS errm_online_dummy _CNV_A_R_LINEAR_____0_CM 4 0. 255. FORMAT "%3.0" AXIS_PTS_REF ldpm_fmy_envd /end AXIS_DESCR
/end CHARACTERISTIC
/begin CHARACTERISTIC fmy_id_maf.envd "Freeze frame FRF_CUS_SET_SPC: environmental data contents for failure XX" CURVE 0xa1004500 _REC_CUR_20_u1_u1 254. _CNV_A_R_LINEAR_____0_CM 1. 255. DISPLAY_IDENTIFIER ID_ERR_ENVD_MAF FORMAT "%3.0"
 /begin AXIS_DESCR COM_AXIS errm_online_dummy _CNV_A_R_LINEAR_____0_CM 4 0. 255. FORMAT "%3.0" AXIS_PTS_REF ldpm_fmy_envd /end AXIS_DESCR
/end CHARACTERISTIC
/begin CHARACTERISTIC fmy_id_iv_0.envd "Freeze frame FRF_CUS_SET_SPC: environmental data contents for failure XX" CURVE 0xa1004370 _REC_CUR_20_u1_u1 254. _CNV_A_R_LINEAR_____0_CM 1. 255. DISPLAY_IDENTIFIER ID_ERR_ENVD_IV_0 FORMAT "%3.0"
 /begin AXIS_DESCR COM_AXIS errm_online_dummy _CNV_A_R_LINEAR_____0_CM 4 0. 255. FORMAT "%3.0" AXIS_PTS_REF ldpm_fmy_envd /end AXIS_DESCR
/end CHARACTERISTIC
/begin CHARACTERISTIC fmy_id_iv_1.envd "Freeze frame FRF_CUS_SET_SPC: environmental data contents for failure XX" CURVE 0xa1004384 _REC_CUR_20_u1_u1 254. _CNV_A_R_LINEAR_____0_CM 1. 255. DISPLAY_IDENTIFIER ID_ERR_ENVD_IV_1 FORMAT "%3.0"
 /begin AXIS_DESCR COM_AXIS errm_online_dummy _CNV_A_R_LINEAR_____0_CM 4 0. 255. FORMAT "%3.0" AXIS_PTS_REF ldpm_fmy_envd /end AXIS_DESCR
/end CHARACTERISTIC
/begin CHARACTERISTIC fmy_id_iv_2.envd "Freeze frame FRF_CUS_SET_SPC: environmental data contents for failure XX" CURVE 0xa1004398 _REC_CUR_20_u1_u1 254. _CNV_A_R_LINEAR_____0_CM 1. 255. DISPLAY_IDENTIFIER ID_ERR_ENVD_IV_2 FORMAT "%3.0"
 /begin AXIS_DESCR COM_AXIS errm_online_dummy _CNV_A_R_LINEAR_____0_CM 4 0. 255. FORMAT "%3.0" AXIS_PTS_REF ldpm_fmy_envd /end AXIS_DESCR
/end CHARACTERISTIC
/begin CHARACTERISTIC fmy_id_iv_3.envd "Freeze frame FRF_CUS_SET_SPC: environmental data contents for failure XX" CURVE 0xa10043ac _REC_CUR_20_u1_u1 254. _CNV_A_R_LINEAR_____0_CM 1. 255. DISPLAY_IDENTIFIER ID_ERR_ENVD_IV_3 FORMAT "%3.0"
 /begin AXIS_DESCR COM_AXIS errm_online_dummy _CNV_A_R_LINEAR_____0_CM 4 0. 255. FORMAT "%3.0" AXIS_PTS_REF ldpm_fmy_envd /end AXIS_DESCR
/end CHARACTERISTIC
/begin CHARACTERISTIC fmy_id_iv_4.envd "Freeze frame FRF_CUS_SET_SPC: environmental data contents for failure XX" CURVE 0xa10043c0 _REC_CUR_20_u1_u1 254. _CNV_A_R_LINEAR_____0_CM 1. 255. DISPLAY_IDENTIFIER ID_ERR_ENVD_IV_4 FORMAT "%3.0"
 /begin AXIS_DESCR COM_AXIS errm_online_dummy _CNV_A_R_LINEAR_____0_CM 4 0. 255. FORMAT "%3.0" AXIS_PTS_REF ldpm_fmy_envd /end AXIS_DESCR
/end CHARACTERISTIC
/begin CHARACTERISTIC fmy_id_iv_5.envd "Freeze frame FRF_CUS_SET_SPC: environmental data contents for failure XX" CURVE 0xa10043d4 _REC_CUR_20_u1_u1 254. _CNV_A_R_LINEAR_____0_CM 1. 255. DISPLAY_IDENTIFIER ID_ERR_ENVD_IV_5 FORMAT "%3.0"
 /begin AXIS_DESCR COM_AXIS errm_online_dummy _CNV_A_R_LINEAR_____0_CM 4 0. 255. FORMAT "%3.0" AXIS_PTS_REF ldpm_fmy_envd /end AXIS_DESCR
/end CHARACTERISTIC
/begin CHARACTERISTIC fmy_id_rly_efp.envd "Freeze frame FRF_CUS_SET_SPC: environmental data contents for failure XX" CURVE 0xa10049ec _REC_CUR_20_u1_u1 254. _CNV_A_R_LINEAR_____0_CM 1. 255. DISPLAY_IDENTIFIER ID_ERR_ENVD_RLY_EFP FORMAT "%3.0"
 /begin AXIS_DESCR COM_AXIS errm_online_dummy _CNV_A_R_LINEAR_____0_CM 4 0. 255. FORMAT "%3.0" AXIS_PTS_REF ldpm_fmy_envd /end AXIS_DESCR
/end CHARACTERISTIC
/begin CHARACTERISTIC fmy_id_el_cps.envd "Freeze frame FRF_CUS_SET_SPC: environmental data contents for failure XX" CURVE 0xa100403c _REC_CUR_20_u1_u1 254. _CNV_A_R_LINEAR_____0_CM 1. 255. DISPLAY_IDENTIFIER ID_ERR_ENVD_EL_CPS FORMAT "%3.0"
 /begin AXIS_DESCR COM_AXIS errm_online_dummy _CNV_A_R_LINEAR_____0_CM 4 0. 255. FORMAT "%3.0" AXIS_PTS_REF ldpm_fmy_envd /end AXIS_DESCR
/end CHARACTERISTIC
/begin CHARACTERISTIC fmy_id_slv_ivvt_in.envd "Freeze frame FRF_CUS_SET_SPC: environmental data contents for failure XX" CURVE 0xa1004b54 _REC_CUR_20_u1_u1 254. _CNV_A_R_LINEAR_____0_CM 1. 255. DISPLAY_IDENTIFIER ID_ERR_ENVD_SLV_IVVT_IN FORMAT "%3.0"
 /begin AXIS_DESCR COM_AXIS errm_online_dummy _CNV_A_R_LINEAR_____0_CM 4 0. 255. FORMAT "%3.0" AXIS_PTS_REF ldpm_fmy_envd /end AXIS_DESCR
/end CHARACTERISTIC
/begin CHARACTERISTIC fmy_id_slv_ivvt_ex.envd "Freeze frame FRF_CUS_SET_SPC: environmental data contents for failure XX" CURVE 0xa1004b40 _REC_CUR_20_u1_u1 254. _CNV_A_R_LINEAR_____0_CM 1. 255. DISPLAY_IDENTIFIER ID_ERR_ENVD_SLV_IVVT_EX FORMAT "%3.0"
 /begin AXIS_DESCR COM_AXIS errm_online_dummy _CNV_A_R_LINEAR_____0_CM 4 0. 255. FORMAT "%3.0" AXIS_PTS_REF ldpm_fmy_envd /end AXIS_DESCR
/end CHARACTERISTIC
/begin CHARACTERISTIC fmy_id_ecu_cks.envd "Freeze frame FRF_CUS_SET_SPC: environmental data contents for failure XX" CURVE 0xa1003f9c _REC_CUR_20_u1_u1 254. _CNV_A_R_LINEAR_____0_CM 1. 255. DISPLAY_IDENTIFIER ID_ERR_ENVD_ECU_CKS FORMAT "%3.0"
 /begin AXIS_DESCR COM_AXIS errm_online_dummy _CNV_A_R_LINEAR_____0_CM 4 0. 255. FORMAT "%3.0" AXIS_PTS_REF ldpm_fmy_envd /end AXIS_DESCR
/end CHARACTERISTIC
/begin CHARACTERISTIC fmy_id_tout_etcu_1.envd "Freeze frame FRF_CUS_SET_SPC: environmental data contents for failure XX" CURVE 0xa1004e10 _REC_CUR_20_u1_u1 254. _CNV_A_R_LINEAR_____0_CM 1. 255. DISPLAY_IDENTIFIER ID_ERR_ENVD_TOUT_ETCU_1 FORMAT "%3.0"
 /begin AXIS_DESCR COM_AXIS errm_online_dummy _CNV_A_R_LINEAR_____0_CM 4 0. 255. FORMAT "%3.0" AXIS_PTS_REF ldpm_fmy_envd /end AXIS_DESCR
/end CHARACTERISTIC
/begin CHARACTERISTIC fmy_id_tout_etcu_2.envd "Freeze frame FRF_CUS_SET_SPC: environmental data contents for failure XX" CURVE 0xa1004e24 _REC_CUR_20_u1_u1 254. _CNV_A_R_LINEAR_____0_CM 1. 255. DISPLAY_IDENTIFIER ID_ERR_ENVD_TOUT_ETCU_2 FORMAT "%3.0"
 /begin AXIS_DESCR COM_AXIS errm_online_dummy _CNV_A_R_LINEAR_____0_CM 4 0. 255. FORMAT "%3.0" AXIS_PTS_REF ldpm_fmy_envd /end AXIS_DESCR
/end CHARACTERISTIC
/begin CHARACTERISTIC fmy_id_tout_icl_2.envd "Freeze frame FRF_CUS_SET_SPC: environmental data contents for failure XX" CURVE 0xa1004e38 _REC_CUR_20_u1_u1 254. _CNV_A_R_LINEAR_____0_CM 1. 255. DISPLAY_IDENTIFIER ID_ERR_ENVD_TOUT_ICL_2 FORMAT "%3.0"
 /begin AXIS_DESCR COM_AXIS errm_online_dummy _CNV_A_R_LINEAR_____0_CM 4 0. 255. FORMAT "%3.0" AXIS_PTS_REF ldpm_fmy_envd /end AXIS_DESCR
/end CHARACTERISTIC
/begin CHARACTERISTIC fmy_id_tout_icl_3.envd "Freeze frame FRF_CUS_SET_SPC: environmental data contents for failure XX" CURVE 0xa1004e4c _REC_CUR_20_u1_u1 254. _CNV_A_R_LINEAR_____0_CM 1. 255. DISPLAY_IDENTIFIER ID_ERR_ENVD_TOUT_ICL_3 FORMAT "%3.0"
 /begin AXIS_DESCR COM_AXIS errm_online_dummy _CNV_A_R_LINEAR_____0_CM 4 0. 255. FORMAT "%3.0" AXIS_PTS_REF ldpm_fmy_envd /end AXIS_DESCR
/end CHARACTERISTIC
/begin CHARACTERISTIC fmy_id_tout_asr_1.envd "Freeze frame FRF_CUS_SET_SPC: environmental data contents for failure XX" CURVE 0xa1004dc0 _REC_CUR_20_u1_u1 254. _CNV_A_R_LINEAR_____0_CM 1. 255. DISPLAY_IDENTIFIER ID_ERR_ENVD_TOUT_ASR_1 FORMAT "%3.0"
 /begin AXIS_DESCR COM_AXIS errm_online_dummy _CNV_A_R_LINEAR_____0_CM 4 0. 255. FORMAT "%3.0" AXIS_PTS_REF ldpm_fmy_envd /end AXIS_DESCR
/end CHARACTERISTIC
/begin CHARACTERISTIC fmy_id_tout_asr_3.envd "Freeze frame FRF_CUS_SET_SPC: environmental data contents for failure XX" CURVE 0xa1004dd4 _REC_CUR_20_u1_u1 254. _CNV_A_R_LINEAR_____0_CM 1. 255. DISPLAY_IDENTIFIER ID_ERR_ENVD_TOUT_ASR_3 FORMAT "%3.0"
 /begin AXIS_DESCR COM_AXIS errm_online_dummy _CNV_A_R_LINEAR_____0_CM 4 0. 255. FORMAT "%3.0" AXIS_PTS_REF ldpm_fmy_envd /end AXIS_DESCR
/end CHARACTERISTIC
/begin CHARACTERISTIC fmy_id_tout_asr_4.envd "Freeze frame FRF_CUS_SET_SPC: environmental data contents for failure XX" CURVE 0xa1004de8 _REC_CUR_20_u1_u1 254. _CNV_A_R_LINEAR_____0_CM 1. 255. DISPLAY_IDENTIFIER ID_ERR_ENVD_TOUT_ASR_4 FORMAT "%3.0"
 /begin AXIS_DESCR COM_AXIS errm_online_dummy _CNV_A_R_LINEAR_____0_CM 4 0. 255. FORMAT "%3.0" AXIS_PTS_REF ldpm_fmy_envd /end AXIS_DESCR
/end CHARACTERISTIC
/begin CHARACTERISTIC fmy_id_tout_pste_1.envd "Freeze frame FRF_CUS_SET_SPC: environmental data contents for failure XX" CURVE 0xa1004e88 _REC_CUR_20_u1_u1 254. _CNV_A_R_LINEAR_____0_CM 1. 255. DISPLAY_IDENTIFIER ID_ERR_ENVD_TOUT_PSTE_1 FORMAT "%3.0"
 /begin AXIS_DESCR COM_AXIS errm_online_dummy _CNV_A_R_LINEAR_____0_CM 4 0. 255. FORMAT "%3.0" AXIS_PTS_REF ldpm_fmy_envd /end AXIS_DESCR
/end CHARACTERISTIC
/begin CHARACTERISTIC fmy_id_tout_amt_1.envd "Freeze frame FRF_CUS_SET_SPC: environmental data contents for failure XX" CURVE 0xa1004dac _REC_CUR_20_u1_u1 254. _CNV_A_R_LINEAR_____0_CM 1. 255. DISPLAY_IDENTIFIER ID_ERR_ENVD_TOUT_AMT_1 FORMAT "%3.0"
 /begin AXIS_DESCR COM_AXIS errm_online_dummy _CNV_A_R_LINEAR_____0_CM 4 0. 255. FORMAT "%3.0" AXIS_PTS_REF ldpm_fmy_envd /end AXIS_DESCR
/end CHARACTERISTIC
/begin CHARACTERISTIC fmy_id_vs.envd "Freeze frame FRF_CUS_SET_SPC: environmental data contents for failure XX" CURVE 0xa10050e0 _REC_CUR_20_u1_u1 254. _CNV_A_R_LINEAR_____0_CM 1. 255. DISPLAY_IDENTIFIER ID_ERR_ENVD_VS FORMAT "%3.0"
 /begin AXIS_DESCR COM_AXIS errm_online_dummy _CNV_A_R_LINEAR_____0_CM 4 0. 255. FORMAT "%3.0" AXIS_PTS_REF ldpm_fmy_envd /end AXIS_DESCR
/end CHARACTERISTIC
/begin CHARACTERISTIC fmy_id_knks_1.envd "Freeze frame FRF_CUS_SET_SPC: environmental data contents for failure XX" CURVE 0xa10043e8 _REC_CUR_20_u1_u1 254. _CNV_A_R_LINEAR_____0_CM 1. 255. DISPLAY_IDENTIFIER ID_ERR_ENVD_KNKS_1 FORMAT "%3.0"
 /begin AXIS_DESCR COM_AXIS errm_online_dummy _CNV_A_R_LINEAR_____0_CM 4 0. 255. FORMAT "%3.0" AXIS_PTS_REF ldpm_fmy_envd /end AXIS_DESCR
/end CHARACTERISTIC
/begin CHARACTERISTIC fmy_id_knks_2.envd "Freeze frame FRF_CUS_SET_SPC: environmental data contents for failure XX" CURVE 0xa10043fc _REC_CUR_20_u1_u1 254. _CNV_A_R_LINEAR_____0_CM 1. 255. DISPLAY_IDENTIFIER ID_ERR_ENVD_KNKS_2 FORMAT "%3.0"
 /begin AXIS_DESCR COM_AXIS errm_online_dummy _CNV_A_R_LINEAR_____0_CM 4 0. 255. FORMAT "%3.0" AXIS_PTS_REF ldpm_fmy_envd /end AXIS_DESCR
/end CHARACTERISTIC
/begin CHARACTERISTIC fmy_id_igc_scp_0.envd "Freeze frame FRF_CUS_SET_SPC: environmental data contents for failure XX" CURVE 0xa1004280 _REC_CUR_20_u1_u1 254. _CNV_A_R_LINEAR_____0_CM 1. 255. DISPLAY_IDENTIFIER ID_ERR_ENVD_IGC_SCP_0 FORMAT "%3.0"
 /begin AXIS_DESCR COM_AXIS errm_online_dummy _CNV_A_R_LINEAR_____0_CM 4 0. 255. FORMAT "%3.0" AXIS_PTS_REF ldpm_fmy_envd /end AXIS_DESCR
/end CHARACTERISTIC
/begin CHARACTERISTIC fmy_id_igc_scp_1.envd "Freeze frame FRF_CUS_SET_SPC: environmental data contents for failure XX" CURVE 0xa1004294 _REC_CUR_20_u1_u1 254. _CNV_A_R_LINEAR_____0_CM 1. 255. DISPLAY_IDENTIFIER ID_ERR_ENVD_IGC_SCP_1 FORMAT "%3.0"
 /begin AXIS_DESCR COM_AXIS errm_online_dummy _CNV_A_R_LINEAR_____0_CM 4 0. 255. FORMAT "%3.0" AXIS_PTS_REF ldpm_fmy_envd /end AXIS_DESCR
/end CHARACTERISTIC
/begin CHARACTERISTIC fmy_id_igc_scp_2.envd "Freeze frame FRF_CUS_SET_SPC: environmental data contents for failure XX" CURVE 0xa10042a8 _REC_CUR_20_u1_u1 254. _CNV_A_R_LINEAR_____0_CM 1. 255. DISPLAY_IDENTIFIER ID_ERR_ENVD_IGC_SCP_2 FORMAT "%3.0"
 /begin AXIS_DESCR COM_AXIS errm_online_dummy _CNV_A_R_LINEAR_____0_CM 4 0. 255. FORMAT "%3.0" AXIS_PTS_REF ldpm_fmy_envd /end AXIS_DESCR
/end CHARACTERISTIC
/begin CHARACTERISTIC fmy_id_igc_scp_3.envd "Freeze frame FRF_CUS_SET_SPC: environmental data contents for failure XX" CURVE 0xa10042bc _REC_CUR_20_u1_u1 254. _CNV_A_R_LINEAR_____0_CM 1. 255. DISPLAY_IDENTIFIER ID_ERR_ENVD_IGC_SCP_3 FORMAT "%3.0"
 /begin AXIS_DESCR COM_AXIS errm_online_dummy _CNV_A_R_LINEAR_____0_CM 4 0. 255. FORMAT "%3.0" AXIS_PTS_REF ldpm_fmy_envd /end AXIS_DESCR
/end CHARACTERISTIC
/begin CHARACTERISTIC fmy_id_igc_scp_4.envd "Freeze frame FRF_CUS_SET_SPC: environmental data contents for failure XX" CURVE 0xa10042d0 _REC_CUR_20_u1_u1 254. _CNV_A_R_LINEAR_____0_CM 1. 255. DISPLAY_IDENTIFIER ID_ERR_ENVD_IGC_SCP_4 FORMAT "%3.0"
 /begin AXIS_DESCR COM_AXIS errm_online_dummy _CNV_A_R_LINEAR_____0_CM 4 0. 255. FORMAT "%3.0" AXIS_PTS_REF ldpm_fmy_envd /end AXIS_DESCR
/end CHARACTERISTIC
/begin CHARACTERISTIC fmy_id_igc_scp_5.envd "Freeze frame FRF_CUS_SET_SPC: environmental data contents for failure XX" CURVE 0xa10042e4 _REC_CUR_20_u1_u1 254. _CNV_A_R_LINEAR_____0_CM 1. 255. DISPLAY_IDENTIFIER ID_ERR_ENVD_IGC_SCP_5 FORMAT "%3.0"
 /begin AXIS_DESCR COM_AXIS errm_online_dummy _CNV_A_R_LINEAR_____0_CM 4 0. 255. FORMAT "%3.0" AXIS_PTS_REF ldpm_fmy_envd /end AXIS_DESCR
/end CHARACTERISTIC
/begin CHARACTERISTIC fmy_id_igc_scg_0.envd "Freeze frame FRF_CUS_SET_SPC: environmental data contents for failure XX" CURVE 0xa1004208 _REC_CUR_20_u1_u1 254. _CNV_A_R_LINEAR_____0_CM 1. 255. DISPLAY_IDENTIFIER ID_ERR_ENVD_IGC_SCG_0 FORMAT "%3.0"
 /begin AXIS_DESCR COM_AXIS errm_online_dummy _CNV_A_R_LINEAR_____0_CM 4 0. 255. FORMAT "%3.0" AXIS_PTS_REF ldpm_fmy_envd /end AXIS_DESCR
/end CHARACTERISTIC
/begin CHARACTERISTIC fmy_id_igc_scg_1.envd "Freeze frame FRF_CUS_SET_SPC: environmental data contents for failure XX" CURVE 0xa100421c _REC_CUR_20_u1_u1 254. _CNV_A_R_LINEAR_____0_CM 1. 255. DISPLAY_IDENTIFIER ID_ERR_ENVD_IGC_SCG_1 FORMAT "%3.0"
 /begin AXIS_DESCR COM_AXIS errm_online_dummy _CNV_A_R_LINEAR_____0_CM 4 0. 255. FORMAT "%3.0" AXIS_PTS_REF ldpm_fmy_envd /end AXIS_DESCR
/end CHARACTERISTIC
/begin CHARACTERISTIC fmy_id_igc_scg_2.envd "Freeze frame FRF_CUS_SET_SPC: environmental data contents for failure XX" CURVE 0xa1004230 _REC_CUR_20_u1_u1 254. _CNV_A_R_LINEAR_____0_CM 1. 255. DISPLAY_IDENTIFIER ID_ERR_ENVD_IGC_SCG_2 FORMAT "%3.0"
 /begin AXIS_DESCR COM_AXIS errm_online_dummy _CNV_A_R_LINEAR_____0_CM 4 0. 255. FORMAT "%3.0" AXIS_PTS_REF ldpm_fmy_envd /end AXIS_DESCR
/end CHARACTERISTIC
/begin CHARACTERISTIC fmy_id_igc_scg_3.envd "Freeze frame FRF_CUS_SET_SPC: environmental data contents for failure XX" CURVE 0xa1004244 _REC_CUR_20_u1_u1 254. _CNV_A_R_LINEAR_____0_CM 1. 255. DISPLAY_IDENTIFIER ID_ERR_ENVD_IGC_SCG_3 FORMAT "%3.0"
 /begin AXIS_DESCR COM_AXIS errm_online_dummy _CNV_A_R_LINEAR_____0_CM 4 0. 255. FORMAT "%3.0" AXIS_PTS_REF ldpm_fmy_envd /end AXIS_DESCR
/end CHARACTERISTIC
/begin CHARACTERISTIC fmy_id_igc_scg_4.envd "Freeze frame FRF_CUS_SET_SPC: environmental data contents for failure XX" CURVE 0xa1004258 _REC_CUR_20_u1_u1 254. _CNV_A_R_LINEAR_____0_CM 1. 255. DISPLAY_IDENTIFIER ID_ERR_ENVD_IGC_SCG_4 FORMAT "%3.0"
 /begin AXIS_DESCR COM_AXIS errm_online_dummy _CNV_A_R_LINEAR_____0_CM 4 0. 255. FORMAT "%3.0" AXIS_PTS_REF ldpm_fmy_envd /end AXIS_DESCR
/end CHARACTERISTIC
/begin CHARACTERISTIC fmy_id_igc_scg_5.envd "Freeze frame FRF_CUS_SET_SPC: environmental data contents for failure XX" CURVE 0xa100426c _REC_CUR_20_u1_u1 254. _CNV_A_R_LINEAR_____0_CM 1. 255. DISPLAY_IDENTIFIER ID_ERR_ENVD_IGC_SCG_5 FORMAT "%3.0"
 /begin AXIS_DESCR COM_AXIS errm_online_dummy _CNV_A_R_LINEAR_____0_CM 4 0. 255. FORMAT "%3.0" AXIS_PTS_REF ldpm_fmy_envd /end AXIS_DESCR
/end CHARACTERISTIC
/begin CHARACTERISTIC fmy_id_igc_ol_0.envd "Freeze frame FRF_CUS_SET_SPC: environmental data contents for failure XX" CURVE 0xa1004190 _REC_CUR_20_u1_u1 254. _CNV_A_R_LINEAR_____0_CM 1. 255. DISPLAY_IDENTIFIER ID_ERR_ENVD_IGC_OL_0 FORMAT "%3.0"
 /begin AXIS_DESCR COM_AXIS errm_online_dummy _CNV_A_R_LINEAR_____0_CM 4 0. 255. FORMAT "%3.0" AXIS_PTS_REF ldpm_fmy_envd /end AXIS_DESCR
/end CHARACTERISTIC
/begin CHARACTERISTIC fmy_id_igc_ol_1.envd "Freeze frame FRF_CUS_SET_SPC: environmental data contents for failure XX" CURVE 0xa10041a4 _REC_CUR_20_u1_u1 254. _CNV_A_R_LINEAR_____0_CM 1. 255. DISPLAY_IDENTIFIER ID_ERR_ENVD_IGC_OL_1 FORMAT "%3.0"
 /begin AXIS_DESCR COM_AXIS errm_online_dummy _CNV_A_R_LINEAR_____0_CM 4 0. 255. FORMAT "%3.0" AXIS_PTS_REF ldpm_fmy_envd /end AXIS_DESCR
/end CHARACTERISTIC
/begin CHARACTERISTIC fmy_id_igc_ol_2.envd "Freeze frame FRF_CUS_SET_SPC: environmental data contents for failure XX" CURVE 0xa10041b8 _REC_CUR_20_u1_u1 254. _CNV_A_R_LINEAR_____0_CM 1. 255. DISPLAY_IDENTIFIER ID_ERR_ENVD_IGC_OL_2 FORMAT "%3.0"
 /begin AXIS_DESCR COM_AXIS errm_online_dummy _CNV_A_R_LINEAR_____0_CM 4 0. 255. FORMAT "%3.0" AXIS_PTS_REF ldpm_fmy_envd /end AXIS_DESCR
/end CHARACTERISTIC
/begin CHARACTERISTIC fmy_id_igc_ol_3.envd "Freeze frame FRF_CUS_SET_SPC: environmental data contents for failure XX" CURVE 0xa10041cc _REC_CUR_20_u1_u1 254. _CNV_A_R_LINEAR_____0_CM 1. 255. DISPLAY_IDENTIFIER ID_ERR_ENVD_IGC_OL_3 FORMAT "%3.0"
 /begin AXIS_DESCR COM_AXIS errm_online_dummy _CNV_A_R_LINEAR_____0_CM 4 0. 255. FORMAT "%3.0" AXIS_PTS_REF ldpm_fmy_envd /end AXIS_DESCR
/end CHARACTERISTIC
/begin CHARACTERISTIC fmy_id_igc_ol_4.envd "Freeze frame FRF_CUS_SET_SPC: environmental data contents for failure XX" CURVE 0xa10041e0 _REC_CUR_20_u1_u1 254. _CNV_A_R_LINEAR_____0_CM 1. 255. DISPLAY_IDENTIFIER ID_ERR_ENVD_IGC_OL_4 FORMAT "%3.0"
 /begin AXIS_DESCR COM_AXIS errm_online_dummy _CNV_A_R_LINEAR_____0_CM 4 0. 255. FORMAT "%3.0" AXIS_PTS_REF ldpm_fmy_envd /end AXIS_DESCR
/end CHARACTERISTIC
/begin CHARACTERISTIC fmy_id_igc_ol_5.envd "Freeze frame FRF_CUS_SET_SPC: environmental data contents for failure XX" CURVE 0xa10041f4 _REC_CUR_20_u1_u1 254. _CNV_A_R_LINEAR_____0_CM 1. 255. DISPLAY_IDENTIFIER ID_ERR_ENVD_IGC_OL_5 FORMAT "%3.0"
 /begin AXIS_DESCR COM_AXIS errm_online_dummy _CNV_A_R_LINEAR_____0_CM 4 0. 255. FORMAT "%3.0" AXIS_PTS_REF ldpm_fmy_envd /end AXIS_DESCR
/end CHARACTERISTIC
/begin CHARACTERISTIC fmy_id_tps_1.envd "Freeze frame FRF_CUS_SET_SPC: environmental data contents for failure XX" CURVE 0xa1004e9c _REC_CUR_20_u1_u1 254. _CNV_A_R_LINEAR_____0_CM 1. 255. DISPLAY_IDENTIFIER ID_ERR_ENVD_TPS_1 FORMAT "%3.0"
 /begin AXIS_DESCR COM_AXIS errm_online_dummy _CNV_A_R_LINEAR_____0_CM 4 0. 255. FORMAT "%3.0" AXIS_PTS_REF ldpm_fmy_envd /end AXIS_DESCR
/end CHARACTERISTIC
/begin CHARACTERISTIC fmy_id_tps_2.envd "Freeze frame FRF_CUS_SET_SPC: environmental data contents for failure XX" CURVE 0xa1004eb0 _REC_CUR_20_u1_u1 254. _CNV_A_R_LINEAR_____0_CM 1. 255. DISPLAY_IDENTIFIER ID_ERR_ENVD_TPS_2 FORMAT "%3.0"
 /begin AXIS_DESCR COM_AXIS errm_online_dummy _CNV_A_R_LINEAR_____0_CM 4 0. 255. FORMAT "%3.0" AXIS_PTS_REF ldpm_fmy_envd /end AXIS_DESCR
/end CHARACTERISTIC
/begin CHARACTERISTIC fmy_id_tps_maf_1.envd "Freeze frame FRF_CUS_SET_SPC: environmental data contents for failure XX" CURVE 0xa1004eec _REC_CUR_20_u1_u1 254. _CNV_A_R_LINEAR_____0_CM 1. 255. DISPLAY_IDENTIFIER ID_ERR_ENVD_TPS_MAF_1 FORMAT "%3.0"
 /begin AXIS_DESCR COM_AXIS errm_online_dummy _CNV_A_R_LINEAR_____0_CM 4 0. 255. FORMAT "%3.0" AXIS_PTS_REF ldpm_fmy_envd /end AXIS_DESCR
/end CHARACTERISTIC
/begin CHARACTERISTIC fmy_id_tps_maf_2.envd "Freeze frame FRF_CUS_SET_SPC: environmental data contents for failure XX" CURVE 0xa1004f00 _REC_CUR_20_u1_u1 254. _CNV_A_R_LINEAR_____0_CM 1. 255. DISPLAY_IDENTIFIER ID_ERR_ENVD_TPS_MAF_2 FORMAT "%3.0"
 /begin AXIS_DESCR COM_AXIS errm_online_dummy _CNV_A_R_LINEAR_____0_CM 4 0. 255. FORMAT "%3.0" AXIS_PTS_REF ldpm_fmy_envd /end AXIS_DESCR
/end CHARACTERISTIC
/begin CHARACTERISTIC fmy_id_tps_ratio.envd "Freeze frame FRF_CUS_SET_SPC: environmental data contents for failure XX" CURVE 0xa1004f14 _REC_CUR_20_u1_u1 254. _CNV_A_R_LINEAR_____0_CM 1. 255. DISPLAY_IDENTIFIER ID_ERR_ENVD_TPS_RATIO FORMAT "%3.0"
 /begin AXIS_DESCR COM_AXIS errm_online_dummy _CNV_A_R_LINEAR_____0_CM 4 0. 255. FORMAT "%3.0" AXIS_PTS_REF ldpm_fmy_envd /end AXIS_DESCR
/end CHARACTERISTIC
/begin CHARACTERISTIC fmy_id_v_ref_1.envd "Freeze frame FRF_CUS_SET_SPC: environmental data contents for failure XX" CURVE 0xa1004fdc _REC_CUR_20_u1_u1 254. _CNV_A_R_LINEAR_____0_CM 1. 255. DISPLAY_IDENTIFIER ID_ERR_ENVD_V_REF_1 FORMAT "%3.0"
 /begin AXIS_DESCR COM_AXIS errm_online_dummy _CNV_A_R_LINEAR_____0_CM 4 0. 255. FORMAT "%3.0" AXIS_PTS_REF ldpm_fmy_envd /end AXIS_DESCR
/end CHARACTERISTIC
/begin CHARACTERISTIC fmy_id_v_ref_2.envd "Freeze frame FRF_CUS_SET_SPC: environmental data contents for failure XX" CURVE 0xa1004ff0 _REC_CUR_20_u1_u1 254. _CNV_A_R_LINEAR_____0_CM 1. 255. DISPLAY_IDENTIFIER ID_ERR_ENVD_V_REF_2 FORMAT "%3.0"
 /begin AXIS_DESCR COM_AXIS errm_online_dummy _CNV_A_R_LINEAR_____0_CM 4 0. 255. FORMAT "%3.0" AXIS_PTS_REF ldpm_fmy_envd /end AXIS_DESCR
/end CHARACTERISTIC
/begin CHARACTERISTIC fmy_id_pvs_1.envd "Freeze frame FRF_CUS_SET_SPC: environmental data contents for failure XX" CURVE 0xa10048d4 _REC_CUR_20_u1_u1 254. _CNV_A_R_LINEAR_____0_CM 1. 255. DISPLAY_IDENTIFIER ID_ERR_ENVD_PVS_1 FORMAT "%3.0"
 /begin AXIS_DESCR COM_AXIS errm_online_dummy _CNV_A_R_LINEAR_____0_CM 4 0. 255. FORMAT "%3.0" AXIS_PTS_REF ldpm_fmy_envd /end AXIS_DESCR
/end CHARACTERISTIC
/begin CHARACTERISTIC fmy_id_pvs_2.envd "Freeze frame FRF_CUS_SET_SPC: environmental data contents for failure XX" CURVE 0xa10048e8 _REC_CUR_20_u1_u1 254. _CNV_A_R_LINEAR_____0_CM 1. 255. DISPLAY_IDENTIFIER ID_ERR_ENVD_PVS_2 FORMAT "%3.0"
 /begin AXIS_DESCR COM_AXIS errm_online_dummy _CNV_A_R_LINEAR_____0_CM 4 0. 255. FORMAT "%3.0" AXIS_PTS_REF ldpm_fmy_envd /end AXIS_DESCR
/end CHARACTERISTIC
/begin CHARACTERISTIC fmy_id_pvs_ratio.envd "Freeze frame FRF_CUS_SET_SPC: environmental data contents for failure XX" CURVE 0xa1004938 _REC_CUR_20_u1_u1 254. _CNV_A_R_LINEAR_____0_CM 1. 255. DISPLAY_IDENTIFIER ID_ERR_ENVD_PVS_RATIO FORMAT "%3.0"
 /begin AXIS_DESCR COM_AXIS errm_online_dummy _CNV_A_R_LINEAR_____0_CM 4 0. 255. FORMAT "%3.0" AXIS_PTS_REF ldpm_fmy_envd /end AXIS_DESCR
/end CHARACTERISTIC
/begin CHARACTERISTIC fmy_id_pvs_double.envd "Freeze frame FRF_CUS_SET_SPC: environmental data contents for failure XX" CURVE 0xa1004910 _REC_CUR_20_u1_u1 254. _CNV_A_R_LINEAR_____0_CM 1. 255. DISPLAY_IDENTIFIER ID_ERR_ENVD_PVS_DOUBLE FORMAT "%3.0"
 /begin AXIS_DESCR COM_AXIS errm_online_dummy _CNV_A_R_LINEAR_____0_CM 4 0. 255. FORMAT "%3.0" AXIS_PTS_REF ldpm_fmy_envd /end AXIS_DESCR
/end CHARACTERISTIC
/begin CHARACTERISTIC fmy_id_pvs_bls_not_plaus.envd "Freeze frame FRF_CUS_SET_SPC: environmental data contents for failure XX" CURVE 0xa10048fc _REC_CUR_20_u1_u1 254. _CNV_A_R_LINEAR_____0_CM 1. 255. DISPLAY_IDENTIFIER ID_ERR_ENVD_PVS_BLS_NOT_PLAUS FORMAT "%3.0"
 /begin AXIS_DESCR COM_AXIS errm_online_dummy _CNV_A_R_LINEAR_____0_CM 4 0. 255. FORMAT "%3.0" AXIS_PTS_REF ldpm_fmy_envd /end AXIS_DESCR
/end CHARACTERISTIC
/begin CHARACTERISTIC fmy_id_mtc_dr.envd "Freeze frame FRF_CUS_SET_SPC: environmental data contents for failure XX" CURVE 0xa10046a4 _REC_CUR_20_u1_u1 254. _CNV_A_R_LINEAR_____0_CM 1. 255. DISPLAY_IDENTIFIER ID_ERR_ENVD_MTC_DR FORMAT "%3.0"
 /begin AXIS_DESCR COM_AXIS errm_online_dummy _CNV_A_R_LINEAR_____0_CM 4 0. 255. FORMAT "%3.0" AXIS_PTS_REF ldpm_fmy_envd /end AXIS_DESCR
/end CHARACTERISTIC
/begin CHARACTERISTIC fmy_id_mtc_ctl_1.envd "Freeze frame FRF_CUS_SET_SPC: environmental data contents for failure XX" CURVE 0xa1004668 _REC_CUR_20_u1_u1 254. _CNV_A_R_LINEAR_____0_CM 1. 255. DISPLAY_IDENTIFIER ID_ERR_ENVD_MTC_CTL_1 FORMAT "%3.0"
 /begin AXIS_DESCR COM_AXIS errm_online_dummy _CNV_A_R_LINEAR_____0_CM 4 0. 255. FORMAT "%3.0" AXIS_PTS_REF ldpm_fmy_envd /end AXIS_DESCR
/end CHARACTERISTIC
/begin CHARACTERISTIC fmy_id_mtc_ctl_2.envd "Freeze frame FRF_CUS_SET_SPC: environmental data contents for failure XX" CURVE 0xa100467c _REC_CUR_20_u1_u1 254. _CNV_A_R_LINEAR_____0_CM 1. 255. DISPLAY_IDENTIFIER ID_ERR_ENVD_MTC_CTL_2 FORMAT "%3.0"
 /begin AXIS_DESCR COM_AXIS errm_online_dummy _CNV_A_R_LINEAR_____0_CM 4 0. 255. FORMAT "%3.0" AXIS_PTS_REF ldpm_fmy_envd /end AXIS_DESCR
/end CHARACTERISTIC
/begin CHARACTERISTIC fmy_id_mtc_ctl_3.envd "Freeze frame FRF_CUS_SET_SPC: environmental data contents for failure XX" CURVE 0xa1004690 _REC_CUR_20_u1_u1 254. _CNV_A_R_LINEAR_____0_CM 1. 255. DISPLAY_IDENTIFIER ID_ERR_ENVD_MTC_CTL_3 FORMAT "%3.0"
 /begin AXIS_DESCR COM_AXIS errm_online_dummy _CNV_A_R_LINEAR_____0_CM 4 0. 255. FORMAT "%3.0" AXIS_PTS_REF ldpm_fmy_envd /end AXIS_DESCR
/end CHARACTERISTIC
/begin CHARACTERISTIC fmy_id_tps_ad.envd "Freeze frame FRF_CUS_SET_SPC: environmental data contents for failure XX" CURVE 0xa1004ec4 _REC_CUR_20_u1_u1 254. _CNV_A_R_LINEAR_____0_CM 1. 255. DISPLAY_IDENTIFIER ID_ERR_ENVD_TPS_AD FORMAT "%3.0"
 /begin AXIS_DESCR COM_AXIS errm_online_dummy _CNV_A_R_LINEAR_____0_CM 4 0. 255. FORMAT "%3.0" AXIS_PTS_REF ldpm_fmy_envd /end AXIS_DESCR
/end CHARACTERISTIC
/begin CHARACTERISTIC fmy_id_tps_ad_bol.envd "Freeze frame FRF_CUS_SET_SPC: environmental data contents for failure XX" CURVE 0xa1004ed8 _REC_CUR_20_u1_u1 254. _CNV_A_R_LINEAR_____0_CM 1. 255. DISPLAY_IDENTIFIER ID_ERR_ENVD_TPS_AD_BOL FORMAT "%3.0"
 /begin AXIS_DESCR COM_AXIS errm_online_dummy _CNV_A_R_LINEAR_____0_CM 4 0. 255. FORMAT "%3.0" AXIS_PTS_REF ldpm_fmy_envd /end AXIS_DESCR
/end CHARACTERISTIC
/begin CHARACTERISTIC fmy_id_tps_st_chk_1.envd "Freeze frame FRF_CUS_SET_SPC: environmental data contents for failure XX" CURVE 0xa1004f28 _REC_CUR_20_u1_u1 254. _CNV_A_R_LINEAR_____0_CM 1. 255. DISPLAY_IDENTIFIER ID_ERR_ENVD_TPS_ST_CHK_1 FORMAT "%3.0"
 /begin AXIS_DESCR COM_AXIS errm_online_dummy _CNV_A_R_LINEAR_____0_CM 4 0. 255. FORMAT "%3.0" AXIS_PTS_REF ldpm_fmy_envd /end AXIS_DESCR
/end CHARACTERISTIC
/begin CHARACTERISTIC fmy_id_tps_st_chk_2.envd "Freeze frame FRF_CUS_SET_SPC: environmental data contents for failure XX" CURVE 0xa1004f3c _REC_CUR_20_u1_u1 254. _CNV_A_R_LINEAR_____0_CM 1. 255. DISPLAY_IDENTIFIER ID_ERR_ENVD_TPS_ST_CHK_2 FORMAT "%3.0"
 /begin AXIS_DESCR COM_AXIS errm_online_dummy _CNV_A_R_LINEAR_____0_CM 4 0. 255. FORMAT "%3.0" AXIS_PTS_REF ldpm_fmy_envd /end AXIS_DESCR
/end CHARACTERISTIC
/begin CHARACTERISTIC fmy_id_gen.envd "Freeze frame FRF_CUS_SET_SPC: environmental data contents for failure XX" CURVE 0xa1004140 _REC_CUR_20_u1_u1 254. _CNV_A_R_LINEAR_____0_CM 1. 255. DISPLAY_IDENTIFIER ID_ERR_ENVD_GEN FORMAT "%3.0"
 /begin AXIS_DESCR COM_AXIS errm_online_dummy _CNV_A_R_LINEAR_____0_CM 4 0. 255. FORMAT "%3.0" AXIS_PTS_REF ldpm_fmy_envd /end AXIS_DESCR
/end CHARACTERISTIC
/begin CHARACTERISTIC fmy_id_gen_diag.envd "Freeze frame FRF_CUS_SET_SPC: environmental data contents for failure XX" CURVE 0xa1004154 _REC_CUR_20_u1_u1 254. _CNV_A_R_LINEAR_____0_CM 1. 255. DISPLAY_IDENTIFIER ID_ERR_ENVD_GEN_DIAG FORMAT "%3.0"
 /begin AXIS_DESCR COM_AXIS errm_online_dummy _CNV_A_R_LINEAR_____0_CM 4 0. 255. FORMAT "%3.0" AXIS_PTS_REF ldpm_fmy_envd /end AXIS_DESCR
/end CHARACTERISTIC
/begin CHARACTERISTIC fmy_id_alter_bn.envd "Freeze frame FRF_CUS_SET_SPC: environmental data contents for failure XX" CURVE 0xa1003948 _REC_CUR_20_u1_u1 254. _CNV_A_R_LINEAR_____0_CM 1. 255. DISPLAY_IDENTIFIER ID_ERR_ENVD_ALTER_BN FORMAT "%3.0"
 /begin AXIS_DESCR COM_AXIS errm_online_dummy _CNV_A_R_LINEAR_____0_CM 4 0. 255. FORMAT "%3.0" AXIS_PTS_REF ldpm_fmy_envd /end AXIS_DESCR
/end CHARACTERISTIC
/begin CHARACTERISTIC fmy_id_alter_bn_bat.envd "Freeze frame FRF_CUS_SET_SPC: environmental data contents for failure XX" CURVE 0xa100395c _REC_CUR_20_u1_u1 254. _CNV_A_R_LINEAR_____0_CM 1. 255. DISPLAY_IDENTIFIER ID_ERR_ENVD_ALTER_BN_BAT FORMAT "%3.0"
 /begin AXIS_DESCR COM_AXIS errm_online_dummy _CNV_A_R_LINEAR_____0_CM 4 0. 255. FORMAT "%3.0" AXIS_PTS_REF ldpm_fmy_envd /end AXIS_DESCR
/end CHARACTERISTIC
/begin CHARACTERISTIC fmy_id_vim_1_el.envd "Freeze frame FRF_CUS_SET_SPC: environmental data contents for failure XX" CURVE 0xa1005054 _REC_CUR_20_u1_u1 254. _CNV_A_R_LINEAR_____0_CM 1. 255. DISPLAY_IDENTIFIER ID_ERR_ENVD_VIM_1_EL FORMAT "%3.0"
 /begin AXIS_DESCR COM_AXIS errm_online_dummy _CNV_A_R_LINEAR_____0_CM 4 0. 255. FORMAT "%3.0" AXIS_PTS_REF ldpm_fmy_envd /end AXIS_DESCR
/end CHARACTERISTIC
/begin CHARACTERISTIC fmy_id_vim_2_el.envd "Freeze frame FRF_CUS_SET_SPC: environmental data contents for failure XX" CURVE 0xa1005068 _REC_CUR_20_u1_u1 254. _CNV_A_R_LINEAR_____0_CM 1. 255. DISPLAY_IDENTIFIER ID_ERR_ENVD_VIM_2_EL FORMAT "%3.0"
 /begin AXIS_DESCR COM_AXIS errm_online_dummy _CNV_A_R_LINEAR_____0_CM 4 0. 255. FORMAT "%3.0" AXIS_PTS_REF ldpm_fmy_envd /end AXIS_DESCR
/end CHARACTERISTIC
/begin CHARACTERISTIC fmy_id_vimpwm_1_fb.envd "Freeze frame FRF_CUS_SET_SPC: environmental data contents for failure XX" CURVE 0xa1005090 _REC_CUR_20_u1_u1 254. _CNV_A_R_LINEAR_____0_CM 1. 255. DISPLAY_IDENTIFIER ID_ERR_ENVD_VIMPWM_1_FB FORMAT "%3.0"
 /begin AXIS_DESCR COM_AXIS errm_online_dummy _CNV_A_R_LINEAR_____0_CM 4 0. 255. FORMAT "%3.0" AXIS_PTS_REF ldpm_fmy_envd /end AXIS_DESCR
/end CHARACTERISTIC
/begin CHARACTERISTIC fmy_id_vimpwm_2_fb.envd "Freeze frame FRF_CUS_SET_SPC: environmental data contents for failure XX" CURVE 0xa10050a4 _REC_CUR_20_u1_u1 254. _CNV_A_R_LINEAR_____0_CM 1. 255. DISPLAY_IDENTIFIER ID_ERR_ENVD_VIMPWM_2_FB FORMAT "%3.0"
 /begin AXIS_DESCR COM_AXIS errm_online_dummy _CNV_A_R_LINEAR_____0_CM 4 0. 255. FORMAT "%3.0" AXIS_PTS_REF ldpm_fmy_envd /end AXIS_DESCR
/end CHARACTERISTIC
/begin CHARACTERISTIC fmy_id_t_es.envd "Freeze frame FRF_CUS_SET_SPC: environmental data contents for failure XX" CURVE 0xa1004c44 _REC_CUR_20_u1_u1 254. _CNV_A_R_LINEAR_____0_CM 1. 255. DISPLAY_IDENTIFIER ID_ERR_ENVD_T_ES FORMAT "%3.0"
 /begin AXIS_DESCR COM_AXIS errm_online_dummy _CNV_A_R_LINEAR_____0_CM 4 0. 255. FORMAT "%3.0" AXIS_PTS_REF ldpm_fmy_envd /end AXIS_DESCR
/end CHARACTERISTIC
/begin CHARACTERISTIC fmy_id_map_dip_plaus.envd "Freeze frame FRF_CUS_SET_SPC: environmental data contents for failure XX" CURVE 0xa1004514 _REC_CUR_20_u1_u1 254. _CNV_A_R_LINEAR_____0_CM 1. 255. DISPLAY_IDENTIFIER ID_ERR_ENVD_MAP_DIP_PLAUS FORMAT "%3.0"
 /begin AXIS_DESCR COM_AXIS errm_online_dummy _CNV_A_R_LINEAR_____0_CM 4 0. 255. FORMAT "%3.0" AXIS_PTS_REF ldpm_fmy_envd /end AXIS_DESCR
/end CHARACTERISTIC
/begin CHARACTERISTIC fmy_id_toil_level.envd "Freeze frame FRF_CUS_SET_SPC: environmental data contents for failure XX" CURVE 0xa1004d98 _REC_CUR_20_u1_u1 254. _CNV_A_R_LINEAR_____0_CM 1. 255. DISPLAY_IDENTIFIER ID_ERR_ENVD_TOIL_LEVEL FORMAT "%3.0"
 /begin AXIS_DESCR COM_AXIS errm_online_dummy _CNV_A_R_LINEAR_____0_CM 4 0. 255. FORMAT "%3.0" AXIS_PTS_REF ldpm_fmy_envd /end AXIS_DESCR
/end CHARACTERISTIC
/begin CHARACTERISTIC fmy_id_vim_plaus.envd "Freeze frame FRF_CUS_SET_SPC: environmental data contents for failure XX" CURVE 0xa100507c _REC_CUR_20_u1_u1 254. _CNV_A_R_LINEAR_____0_CM 1. 255. DISPLAY_IDENTIFIER ID_ERR_ENVD_VIM_PLAUS FORMAT "%3.0"
 /begin AXIS_DESCR COM_AXIS errm_online_dummy _CNV_A_R_LINEAR_____0_CM 4 0. 255. FORMAT "%3.0" AXIS_PTS_REF ldpm_fmy_envd /end AXIS_DESCR
/end CHARACTERISTIC
/begin CHARACTERISTIC fmy_id_alter_bn_rgn.envd "Freeze frame FRF_CUS_SET_SPC: environmental data contents for failure XX" CURVE 0xa1003970 _REC_CUR_20_u1_u1 254. _CNV_A_R_LINEAR_____0_CM 1. 255. DISPLAY_IDENTIFIER ID_ERR_ENVD_ALTER_BN_RGN FORMAT "%3.0"
 /begin AXIS_DESCR COM_AXIS errm_online_dummy _CNV_A_R_LINEAR_____0_CM 4 0. 255. FORMAT "%3.0" AXIS_PTS_REF ldpm_fmy_envd /end AXIS_DESCR
/end CHARACTERISTIC
/begin CHARACTERISTIC fmy_id_per_cam_in_1.envd "Freeze frame FRF_CUS_SET_SPC: environmental data contents for failure XX" CURVE 0xa10047f8 _REC_CUR_20_u1_u1 254. _CNV_A_R_LINEAR_____0_CM 1. 255. DISPLAY_IDENTIFIER ID_ERR_ENVD_PER_CAM_IN_1 FORMAT "%3.0"
 /begin AXIS_DESCR COM_AXIS errm_online_dummy _CNV_A_R_LINEAR_____0_CM 4 0. 255. FORMAT "%3.0" AXIS_PTS_REF ldpm_fmy_envd /end AXIS_DESCR
/end CHARACTERISTIC
/begin CHARACTERISTIC fmy_id_per_cam_ex_1.envd "Freeze frame FRF_CUS_SET_SPC: environmental data contents for failure XX" CURVE 0xa10047e4 _REC_CUR_20_u1_u1 254. _CNV_A_R_LINEAR_____0_CM 1. 255. DISPLAY_IDENTIFIER ID_ERR_ENVD_PER_CAM_EX_1 FORMAT "%3.0"
 /begin AXIS_DESCR COM_AXIS errm_online_dummy _CNV_A_R_LINEAR_____0_CM 4 0. 255. FORMAT "%3.0" AXIS_PTS_REF ldpm_fmy_envd /end AXIS_DESCR
/end CHARACTERISTIC
/begin CHARACTERISTIC fmy_id_syn_cam_in_1.envd "Freeze frame FRF_CUS_SET_SPC: environmental data contents for failure XX" CURVE 0xa1004c08 _REC_CUR_20_u1_u1 254. _CNV_A_R_LINEAR_____0_CM 1. 255. DISPLAY_IDENTIFIER ID_ERR_ENVD_SYN_CAM_IN_1 FORMAT "%3.0"
 /begin AXIS_DESCR COM_AXIS errm_online_dummy _CNV_A_R_LINEAR_____0_CM 4 0. 255. FORMAT "%3.0" AXIS_PTS_REF ldpm_fmy_envd /end AXIS_DESCR
/end CHARACTERISTIC
/begin CHARACTERISTIC fmy_id_syn_cam_ex_1.envd "Freeze frame FRF_CUS_SET_SPC: environmental data contents for failure XX" CURVE 0xa1004bf4 _REC_CUR_20_u1_u1 254. _CNV_A_R_LINEAR_____0_CM 1. 255. DISPLAY_IDENTIFIER ID_ERR_ENVD_SYN_CAM_EX_1 FORMAT "%3.0"
 /begin AXIS_DESCR COM_AXIS errm_online_dummy _CNV_A_R_LINEAR_____0_CM 4 0. 255. FORMAT "%3.0" AXIS_PTS_REF ldpm_fmy_envd /end AXIS_DESCR
/end CHARACTERISTIC
/begin CHARACTERISTIC fmy_id_ref_crk_cam_in_1.envd "Freeze frame FRF_CUS_SET_SPC: environmental data contents for failure XX" CURVE 0xa1004988 _REC_CUR_20_u1_u1 254. _CNV_A_R_LINEAR_____0_CM 1. 255. DISPLAY_IDENTIFIER ID_ERR_ENVD_REF_CRK_CAM_IN_1 FORMAT "%3.0"
 /begin AXIS_DESCR COM_AXIS errm_online_dummy _CNV_A_R_LINEAR_____0_CM 4 0. 255. FORMAT "%3.0" AXIS_PTS_REF ldpm_fmy_envd /end AXIS_DESCR
/end CHARACTERISTIC
/begin CHARACTERISTIC fmy_id_ref_crk_cam_ex_1.envd "Freeze frame FRF_CUS_SET_SPC: environmental data contents for failure XX" CURVE 0xa1004974 _REC_CUR_20_u1_u1 254. _CNV_A_R_LINEAR_____0_CM 1. 255. DISPLAY_IDENTIFIER ID_ERR_ENVD_REF_CRK_CAM_EX_1 FORMAT "%3.0"
 /begin AXIS_DESCR COM_AXIS errm_online_dummy _CNV_A_R_LINEAR_____0_CM 4 0. 255. FORMAT "%3.0" AXIS_PTS_REF ldpm_fmy_envd /end AXIS_DESCR
/end CHARACTERISTIC
/begin CHARACTERISTIC fmy_id_crk_tooth.envd "Freeze frame FRF_CUS_SET_SPC: environmental data contents for failure XX" CURVE 0xa1003d80 _REC_CUR_20_u1_u1 254. _CNV_A_R_LINEAR_____0_CM 1. 255. DISPLAY_IDENTIFIER ID_ERR_ENVD_CRK_TOOTH FORMAT "%3.0"
 /begin AXIS_DESCR COM_AXIS errm_online_dummy _CNV_A_R_LINEAR_____0_CM 4 0. 255. FORMAT "%3.0" AXIS_PTS_REF ldpm_fmy_envd /end AXIS_DESCR
/end CHARACTERISTIC
/begin CHARACTERISTIC fmy_id_crk_tooth_per.envd "Freeze frame FRF_CUS_SET_SPC: environmental data contents for failure XX" CURVE 0xa1003d94 _REC_CUR_20_u1_u1 254. _CNV_A_R_LINEAR_____0_CM 1. 255. DISPLAY_IDENTIFIER ID_ERR_ENVD_CRK_TOOTH_PER FORMAT "%3.0"
 /begin AXIS_DESCR COM_AXIS errm_online_dummy _CNV_A_R_LINEAR_____0_CM 4 0. 255. FORMAT "%3.0" AXIS_PTS_REF ldpm_fmy_envd /end AXIS_DESCR
/end CHARACTERISTIC
/begin CHARACTERISTIC fmy_id_crk_syn.envd "Freeze frame FRF_CUS_SET_SPC: environmental data contents for failure XX" CURVE 0xa1003d6c _REC_CUR_20_u1_u1 254. _CNV_A_R_LINEAR_____0_CM 1. 255. DISPLAY_IDENTIFIER ID_ERR_ENVD_CRK_SYN FORMAT "%3.0"
 /begin AXIS_DESCR COM_AXIS errm_online_dummy _CNV_A_R_LINEAR_____0_CM 4 0. 255. FORMAT "%3.0" AXIS_PTS_REF ldpm_fmy_envd /end AXIS_DESCR
/end CHARACTERISTIC
/begin CHARACTERISTIC fmy_id_crk_plaus.envd "Freeze frame FRF_CUS_SET_SPC: environmental data contents for failure XX" CURVE 0xa1003d58 _REC_CUR_20_u1_u1 254. _CNV_A_R_LINEAR_____0_CM 1. 255. DISPLAY_IDENTIFIER ID_ERR_ENVD_CRK_PLAUS FORMAT "%3.0"
 /begin AXIS_DESCR COM_AXIS errm_online_dummy _CNV_A_R_LINEAR_____0_CM 4 0. 255. FORMAT "%3.0" AXIS_PTS_REF ldpm_fmy_envd /end AXIS_DESCR
/end CHARACTERISTIC
/begin CHARACTERISTIC fmy_id_plaus_cam_in_1.envd "Freeze frame FRF_CUS_SET_SPC: environmental data contents for failure XX" CURVE 0xa1004820 _REC_CUR_20_u1_u1 254. _CNV_A_R_LINEAR_____0_CM 1. 255. DISPLAY_IDENTIFIER ID_ERR_ENVD_PLAUS_CAM_IN_1 FORMAT "%3.0"
 /begin AXIS_DESCR COM_AXIS errm_online_dummy _CNV_A_R_LINEAR_____0_CM 4 0. 255. FORMAT "%3.0" AXIS_PTS_REF ldpm_fmy_envd /end AXIS_DESCR
/end CHARACTERISTIC
/begin CHARACTERISTIC fmy_id_plaus_cam_ex_1.envd "Freeze frame FRF_CUS_SET_SPC: environmental data contents for failure XX" CURVE 0xa100480c _REC_CUR_20_u1_u1 254. _CNV_A_R_LINEAR_____0_CM 1. 255. DISPLAY_IDENTIFIER ID_ERR_ENVD_PLAUS_CAM_EX_1 FORMAT "%3.0"
 /begin AXIS_DESCR COM_AXIS errm_online_dummy _CNV_A_R_LINEAR_____0_CM 4 0. 255. FORMAT "%3.0" AXIS_PTS_REF ldpm_fmy_envd /end AXIS_DESCR
/end CHARACTERISTIC
/begin CHARACTERISTIC fmy_id_syn_crk_cam_in_1.envd "Freeze frame FRF_CUS_SET_SPC: environmental data contents for failure XX" CURVE 0xa1004c30 _REC_CUR_20_u1_u1 254. _CNV_A_R_LINEAR_____0_CM 1. 255. DISPLAY_IDENTIFIER ID_ERR_ENVD_SYN_CRK_CAM_IN_1 FORMAT "%3.0"
 /begin AXIS_DESCR COM_AXIS errm_online_dummy _CNV_A_R_LINEAR_____0_CM 4 0. 255. FORMAT "%3.0" AXIS_PTS_REF ldpm_fmy_envd /end AXIS_DESCR
/end CHARACTERISTIC
/begin CHARACTERISTIC fmy_id_syn_crk_cam_ex_1.envd "Freeze frame FRF_CUS_SET_SPC: environmental data contents for failure XX" CURVE 0xa1004c1c _REC_CUR_20_u1_u1 254. _CNV_A_R_LINEAR_____0_CM 1. 255. DISPLAY_IDENTIFIER ID_ERR_ENVD_SYN_CRK_CAM_EX_1 FORMAT "%3.0"
 /begin AXIS_DESCR COM_AXIS errm_online_dummy _CNV_A_R_LINEAR_____0_CM 4 0. 255. FORMAT "%3.0" AXIS_PTS_REF ldpm_fmy_envd /end AXIS_DESCR
/end CHARACTERISTIC
/begin CHARACTERISTIC fmy_id_can_boff_B.envd "Freeze frame FRF_CUS_SET_SPC: environmental data contents for failure XX" CURVE 0xa1003c54 _REC_CUR_20_u1_u1 254. _CNV_A_R_LINEAR_____0_CM 1. 255. DISPLAY_IDENTIFIER ID_ERR_ENVD_CAN_BOFF_B FORMAT "%3.0"
 /begin AXIS_DESCR COM_AXIS errm_online_dummy _CNV_A_R_LINEAR_____0_CM 4 0. 255. FORMAT "%3.0" AXIS_PTS_REF ldpm_fmy_envd /end AXIS_DESCR
/end CHARACTERISTIC
/begin CHARACTERISTIC fmy_id_can_boff_C.envd "Freeze frame FRF_CUS_SET_SPC: environmental data contents for failure XX" CURVE 0xa1003c68 _REC_CUR_20_u1_u1 254. _CNV_A_R_LINEAR_____0_CM 1. 255. DISPLAY_IDENTIFIER ID_ERR_ENVD_CAN_BOFF_C FORMAT "%3.0"
 /begin AXIS_DESCR COM_AXIS errm_online_dummy _CNV_A_R_LINEAR_____0_CM 4 0. 255. FORMAT "%3.0" AXIS_PTS_REF ldpm_fmy_envd /end AXIS_DESCR
/end CHARACTERISTIC
/begin CHARACTERISTIC fmy_id_rly_main.envd "Freeze frame FRF_CUS_SET_SPC: environmental data contents for failure XX" CURVE 0xa1004a00 _REC_CUR_20_u1_u1 254. _CNV_A_R_LINEAR_____0_CM 1. 255. DISPLAY_IDENTIFIER ID_ERR_ENVD_RLY_MAIN FORMAT "%3.0"
 /begin AXIS_DESCR COM_AXIS errm_online_dummy _CNV_A_R_LINEAR_____0_CM 4 0. 255. FORMAT "%3.0" AXIS_PTS_REF ldpm_fmy_envd /end AXIS_DESCR
/end CHARACTERISTIC
/begin CHARACTERISTIC fmy_id_rly_main_dly.envd "Freeze frame FRF_CUS_SET_SPC: environmental data contents for failure XX" CURVE 0xa1004a14 _REC_CUR_20_u1_u1 254. _CNV_A_R_LINEAR_____0_CM 1. 255. DISPLAY_IDENTIFIER ID_ERR_ENVD_RLY_MAIN_DLY FORMAT "%3.0"
 /begin AXIS_DESCR COM_AXIS errm_online_dummy _CNV_A_R_LINEAR_____0_CM 4 0. 255. FORMAT "%3.0" AXIS_PTS_REF ldpm_fmy_envd /end AXIS_DESCR
/end CHARACTERISTIC
/begin CHARACTERISTIC fmy_id_rly_accout.envd "Freeze frame FRF_CUS_SET_SPC: environmental data contents for failure XX" CURVE 0xa10049c4 _REC_CUR_20_u1_u1 254. _CNV_A_R_LINEAR_____0_CM 1. 255. DISPLAY_IDENTIFIER ID_ERR_ENVD_RLY_ACCOUT FORMAT "%3.0"
 /begin AXIS_DESCR COM_AXIS errm_online_dummy _CNV_A_R_LINEAR_____0_CM 4 0. 255. FORMAT "%3.0" AXIS_PTS_REF ldpm_fmy_envd /end AXIS_DESCR
/end CHARACTERISTIC
/begin CHARACTERISTIC fmy_id_isc.envd "Freeze frame FRF_CUS_SET_SPC: environmental data contents for failure XX" CURVE 0xa100435c _REC_CUR_20_u1_u1 254. _CNV_A_R_LINEAR_____0_CM 1. 255. DISPLAY_IDENTIFIER ID_ERR_ENVD_ISC FORMAT "%3.0"
 /begin AXIS_DESCR COM_AXIS errm_online_dummy _CNV_A_R_LINEAR_____0_CM 4 0. 255. FORMAT "%3.0" AXIS_PTS_REF ldpm_fmy_envd /end AXIS_DESCR
/end CHARACTERISTIC
/begin CHARACTERISTIC fmy_id_im_bls_plaus.envd "Freeze frame FRF_CUS_SET_SPC: environmental data contents for failure XX" CURVE 0xa10042f8 _REC_CUR_20_u1_u1 254. _CNV_A_R_LINEAR_____0_CM 1. 255. DISPLAY_IDENTIFIER ID_ERR_ENVD_IM_BLS_PLAUS FORMAT "%3.0"
 /begin AXIS_DESCR COM_AXIS errm_online_dummy _CNV_A_R_LINEAR_____0_CM 4 0. 255. FORMAT "%3.0" AXIS_PTS_REF ldpm_fmy_envd /end AXIS_DESCR
/end CHARACTERISTIC
/begin CHARACTERISTIC fmy_id_im_bts_plaus.envd "Freeze frame FRF_CUS_SET_SPC: environmental data contents for failure XX" CURVE 0xa100430c _REC_CUR_20_u1_u1 254. _CNV_A_R_LINEAR_____0_CM 1. 255. DISPLAY_IDENTIFIER ID_ERR_ENVD_IM_BTS_PLAUS FORMAT "%3.0"
 /begin AXIS_DESCR COM_AXIS errm_online_dummy _CNV_A_R_LINEAR_____0_CM 4 0. 255. FORMAT "%3.0" AXIS_PTS_REF ldpm_fmy_envd /end AXIS_DESCR
/end CHARACTERISTIC
/begin CHARACTERISTIC fmy_id_msw_tog.envd "Freeze frame FRF_CUS_SET_SPC: environmental data contents for failure XX" CURVE 0xa1004654 _REC_CUR_20_u1_u1 254. _CNV_A_R_LINEAR_____0_CM 1. 255. DISPLAY_IDENTIFIER ID_ERR_ENVD_MSW_TOG FORMAT "%3.0"
 /begin AXIS_DESCR COM_AXIS errm_online_dummy _CNV_A_R_LINEAR_____0_CM 4 0. 255. FORMAT "%3.0" AXIS_PTS_REF ldpm_fmy_envd /end AXIS_DESCR
/end CHARACTERISTIC
/begin CHARACTERISTIC fmy_id_msw_2.envd "Freeze frame FRF_CUS_SET_SPC: environmental data contents for failure XX" CURVE 0xa100462c _REC_CUR_20_u1_u1 254. _CNV_A_R_LINEAR_____0_CM 1. 255. DISPLAY_IDENTIFIER ID_ERR_ENVD_MSW_2 FORMAT "%3.0"
 /begin AXIS_DESCR COM_AXIS errm_online_dummy _CNV_A_R_LINEAR_____0_CM 4 0. 255. FORMAT "%3.0" AXIS_PTS_REF ldpm_fmy_envd /end AXIS_DESCR
/end CHARACTERISTIC
/begin CHARACTERISTIC fmy_id_msw_3.envd "Freeze frame FRF_CUS_SET_SPC: environmental data contents for failure XX" CURVE 0xa1004640 _REC_CUR_20_u1_u1 254. _CNV_A_R_LINEAR_____0_CM 1. 255. DISPLAY_IDENTIFIER ID_ERR_ENVD_MSW_3 FORMAT "%3.0"
 /begin AXIS_DESCR COM_AXIS errm_online_dummy _CNV_A_R_LINEAR_____0_CM 4 0. 255. FORMAT "%3.0" AXIS_PTS_REF ldpm_fmy_envd /end AXIS_DESCR
/end CHARACTERISTIC
/begin CHARACTERISTIC fmy_id_mis_0.envd "Freeze frame FRF_CUS_SET_SPC: environmental data contents for failure XX" CURVE 0xa100458c _REC_CUR_20_u1_u1 254. _CNV_A_R_LINEAR_____0_CM 1. 255. DISPLAY_IDENTIFIER ID_ERR_ENVD_MIS_0 FORMAT "%3.0"
 /begin AXIS_DESCR COM_AXIS errm_online_dummy _CNV_A_R_LINEAR_____0_CM 4 0. 255. FORMAT "%3.0" AXIS_PTS_REF ldpm_fmy_envd /end AXIS_DESCR
/end CHARACTERISTIC
/begin CHARACTERISTIC fmy_id_mis_1.envd "Freeze frame FRF_CUS_SET_SPC: environmental data contents for failure XX" CURVE 0xa10045a0 _REC_CUR_20_u1_u1 254. _CNV_A_R_LINEAR_____0_CM 1. 255. DISPLAY_IDENTIFIER ID_ERR_ENVD_MIS_1 FORMAT "%3.0"
 /begin AXIS_DESCR COM_AXIS errm_online_dummy _CNV_A_R_LINEAR_____0_CM 4 0. 255. FORMAT "%3.0" AXIS_PTS_REF ldpm_fmy_envd /end AXIS_DESCR
/end CHARACTERISTIC
/begin CHARACTERISTIC fmy_id_mis_2.envd "Freeze frame FRF_CUS_SET_SPC: environmental data contents for failure XX" CURVE 0xa10045b4 _REC_CUR_20_u1_u1 254. _CNV_A_R_LINEAR_____0_CM 1. 255. DISPLAY_IDENTIFIER ID_ERR_ENVD_MIS_2 FORMAT "%3.0"
 /begin AXIS_DESCR COM_AXIS errm_online_dummy _CNV_A_R_LINEAR_____0_CM 4 0. 255. FORMAT "%3.0" AXIS_PTS_REF ldpm_fmy_envd /end AXIS_DESCR
/end CHARACTERISTIC
/begin CHARACTERISTIC fmy_id_mis_3.envd "Freeze frame FRF_CUS_SET_SPC: environmental data contents for failure XX" CURVE 0xa10045c8 _REC_CUR_20_u1_u1 254. _CNV_A_R_LINEAR_____0_CM 1. 255. DISPLAY_IDENTIFIER ID_ERR_ENVD_MIS_3 FORMAT "%3.0"
 /begin AXIS_DESCR COM_AXIS errm_online_dummy _CNV_A_R_LINEAR_____0_CM 4 0. 255. FORMAT "%3.0" AXIS_PTS_REF ldpm_fmy_envd /end AXIS_DESCR
/end CHARACTERISTIC
/begin CHARACTERISTIC fmy_id_mis_4.envd "Freeze frame FRF_CUS_SET_SPC: environmental data contents for failure XX" CURVE 0xa10045dc _REC_CUR_20_u1_u1 254. _CNV_A_R_LINEAR_____0_CM 1. 255. DISPLAY_IDENTIFIER ID_ERR_ENVD_MIS_4 FORMAT "%3.0"
 /begin AXIS_DESCR COM_AXIS errm_online_dummy _CNV_A_R_LINEAR_____0_CM 4 0. 255. FORMAT "%3.0" AXIS_PTS_REF ldpm_fmy_envd /end AXIS_DESCR
/end CHARACTERISTIC
/begin CHARACTERISTIC fmy_id_mis_5.envd "Freeze frame FRF_CUS_SET_SPC: environmental data contents for failure XX" CURVE 0xa10045f0 _REC_CUR_20_u1_u1 254. _CNV_A_R_LINEAR_____0_CM 1. 255. DISPLAY_IDENTIFIER ID_ERR_ENVD_MIS_5 FORMAT "%3.0"
 /begin AXIS_DESCR COM_AXIS errm_online_dummy _CNV_A_R_LINEAR_____0_CM 4 0. 255. FORMAT "%3.0" AXIS_PTS_REF ldpm_fmy_envd /end AXIS_DESCR
/end CHARACTERISTIC
/begin CHARACTERISTIC fmy_id_mis_mpl.envd "Freeze frame FRF_CUS_SET_SPC: environmental data contents for failure XX" CURVE 0xa1004618 _REC_CUR_20_u1_u1 254. _CNV_A_R_LINEAR_____0_CM 1. 255. DISPLAY_IDENTIFIER ID_ERR_ENVD_MIS_MPL FORMAT "%3.0"
 /begin AXIS_DESCR COM_AXIS errm_online_dummy _CNV_A_R_LINEAR_____0_CM 4 0. 255. FORMAT "%3.0" AXIS_PTS_REF ldpm_fmy_envd /end AXIS_DESCR
/end CHARACTERISTIC
/begin CHARACTERISTIC fmy_id_mis_ftl_l.envd "Freeze frame FRF_CUS_SET_SPC: environmental data contents for failure XX" CURVE 0xa1004604 _REC_CUR_20_u1_u1 254. _CNV_A_R_LINEAR_____0_CM 1. 255. DISPLAY_IDENTIFIER ID_ERR_ENVD_MIS_FTL_L FORMAT "%3.0"
 /begin AXIS_DESCR COM_AXIS errm_online_dummy _CNV_A_R_LINEAR_____0_CM 4 0. 255. FORMAT "%3.0" AXIS_PTS_REF ldpm_fmy_envd /end AXIS_DESCR
/end CHARACTERISTIC
/begin CHARACTERISTIC fmy_id_fsd_1.envd "Freeze frame FRF_CUS_SET_SPC: environmental data contents for failure XX" CURVE 0xa10040a0 _REC_CUR_20_u1_u1 254. _CNV_A_R_LINEAR_____0_CM 1. 255. DISPLAY_IDENTIFIER ID_ERR_ENVD_FSD_1 FORMAT "%3.0"
 /begin AXIS_DESCR COM_AXIS errm_online_dummy _CNV_A_R_LINEAR_____0_CM 4 0. 255. FORMAT "%3.0" AXIS_PTS_REF ldpm_fmy_envd /end AXIS_DESCR
/end CHARACTERISTIC
/begin CHARACTERISTIC fmy_id_fsd_2.envd "Freeze frame FRF_CUS_SET_SPC: environmental data contents for failure XX" CURVE 0xa10040b4 _REC_CUR_20_u1_u1 254. _CNV_A_R_LINEAR_____0_CM 1. 255. DISPLAY_IDENTIFIER ID_ERR_ENVD_FSD_2 FORMAT "%3.0"
 /begin AXIS_DESCR COM_AXIS errm_online_dummy _CNV_A_R_LINEAR_____0_CM 4 0. 255. FORMAT "%3.0" AXIS_PTS_REF ldpm_fmy_envd /end AXIS_DESCR
/end CHARACTERISTIC
/begin CHARACTERISTIC fmy_id_ef.envd "Freeze frame FRF_CUS_SET_SPC: environmental data contents for failure XX" CURVE 0xa1003fd8 _REC_CUR_20_u1_u1 254. _CNV_A_R_LINEAR_____0_CM 1. 255. DISPLAY_IDENTIFIER ID_ERR_ENVD_EF FORMAT "%3.0"
 /begin AXIS_DESCR COM_AXIS errm_online_dummy _CNV_A_R_LINEAR_____0_CM 4 0. 255. FORMAT "%3.0" AXIS_PTS_REF ldpm_fmy_envd /end AXIS_DESCR
/end CHARACTERISTIC
/begin CHARACTERISTIC fmy_id_tecu.envd "Freeze frame FRF_CUS_SET_SPC: environmental data contents for failure XX" CURVE 0xa1004d20 _REC_CUR_20_u1_u1 254. _CNV_A_R_LINEAR_____0_CM 1. 255. DISPLAY_IDENTIFIER ID_ERR_ENVD_TECU FORMAT "%3.0"
 /begin AXIS_DESCR COM_AXIS errm_online_dummy _CNV_A_R_LINEAR_____0_CM 4 0. 255. FORMAT "%3.0" AXIS_PTS_REF ldpm_fmy_envd /end AXIS_DESCR
/end CHARACTERISTIC
/begin CHARACTERISTIC fmy_id_ebox_cfa.envd "Freeze frame FRF_CUS_SET_SPC: environmental data contents for failure XX" CURVE 0xa1003f24 _REC_CUR_20_u1_u1 254. _CNV_A_R_LINEAR_____0_CM 1. 255. DISPLAY_IDENTIFIER ID_ERR_ENVD_EBOX_CFA FORMAT "%3.0"
 /begin AXIS_DESCR COM_AXIS errm_online_dummy _CNV_A_R_LINEAR_____0_CM 4 0. 255. FORMAT "%3.0" AXIS_PTS_REF ldpm_fmy_envd /end AXIS_DESCR
/end CHARACTERISTIC
/begin CHARACTERISTIC fmy_id_ecu_ram.envd "Freeze frame FRF_CUS_SET_SPC: environmental data contents for failure XX" CURVE 0xa1003fc4 _REC_CUR_20_u1_u1 254. _CNV_A_R_LINEAR_____0_CM 1. 255. DISPLAY_IDENTIFIER ID_ERR_ENVD_ECU_RAM FORMAT "%3.0"
 /begin AXIS_DESCR COM_AXIS errm_online_dummy _CNV_A_R_LINEAR_____0_CM 4 0. 255. FORMAT "%3.0" AXIS_PTS_REF ldpm_fmy_envd /end AXIS_DESCR
/end CHARACTERISTIC
/begin CHARACTERISTIC fmy_id_tqi_lim.envd "Freeze frame FRF_CUS_SET_SPC: environmental data contents for failure XX" CURVE 0xa1004fb4 _REC_CUR_20_u1_u1 254. _CNV_A_R_LINEAR_____0_CM 1. 255. DISPLAY_IDENTIFIER ID_ERR_ENVD_TQI_LIM FORMAT "%3.0"
 /begin AXIS_DESCR COM_AXIS errm_online_dummy _CNV_A_R_LINEAR_____0_CM 4 0. 255. FORMAT "%3.0" AXIS_PTS_REF ldpm_fmy_envd /end AXIS_DESCR
/end CHARACTERISTIC
/begin CHARACTERISTIC fmy_id_obd2_lsh_down_1.envd "Freeze frame FRF_CUS_SET_SPC: environmental data contents for failure XX" CURVE 0xa1004708 _REC_CUR_20_u1_u1 254. _CNV_A_R_LINEAR_____0_CM 1. 255. DISPLAY_IDENTIFIER ID_ERR_ENVD_OBD2_LSH_DOWN_1 FORMAT "%3.0"
 /begin AXIS_DESCR COM_AXIS errm_online_dummy _CNV_A_R_LINEAR_____0_CM 4 0. 255. FORMAT "%3.0" AXIS_PTS_REF ldpm_fmy_envd /end AXIS_DESCR
/end CHARACTERISTIC
/begin CHARACTERISTIC fmy_id_obd2_lsh_down_2.envd "Freeze frame FRF_CUS_SET_SPC: environmental data contents for failure XX" CURVE 0xa100471c _REC_CUR_20_u1_u1 254. _CNV_A_R_LINEAR_____0_CM 1. 255. DISPLAY_IDENTIFIER ID_ERR_ENVD_OBD2_LSH_DOWN_2 FORMAT "%3.0"
 /begin AXIS_DESCR COM_AXIS errm_online_dummy _CNV_A_R_LINEAR_____0_CM 4 0. 255. FORMAT "%3.0" AXIS_PTS_REF ldpm_fmy_envd /end AXIS_DESCR
/end CHARACTERISTIC
/begin CHARACTERISTIC fmy_id_dmtls.envd "Freeze frame FRF_CUS_SET_SPC: environmental data contents for failure XX" CURVE 0xa1003ed4 _REC_CUR_20_u1_u1 254. _CNV_A_R_LINEAR_____0_CM 1. 255. DISPLAY_IDENTIFIER ID_ERR_ENVD_DMTLS FORMAT "%3.0"
 /begin AXIS_DESCR COM_AXIS errm_online_dummy _CNV_A_R_LINEAR_____0_CM 4 0. 255. FORMAT "%3.0" AXIS_PTS_REF ldpm_fmy_envd /end AXIS_DESCR
/end CHARACTERISTIC
/begin CHARACTERISTIC fmy_id_dmtl_pump.envd "Freeze frame FRF_CUS_SET_SPC: environmental data contents for failure XX" CURVE 0xa1003e98 _REC_CUR_20_u1_u1 254. _CNV_A_R_LINEAR_____0_CM 1. 255. DISPLAY_IDENTIFIER ID_ERR_ENVD_DMTL_PUMP FORMAT "%3.0"
 /begin AXIS_DESCR COM_AXIS errm_online_dummy _CNV_A_R_LINEAR_____0_CM 4 0. 255. FORMAT "%3.0" AXIS_PTS_REF ldpm_fmy_envd /end AXIS_DESCR
/end CHARACTERISTIC
/begin CHARACTERISTIC fmy_id_dmtlm.envd "Freeze frame FRF_CUS_SET_SPC: environmental data contents for failure XX" CURVE 0xa1003ec0 _REC_CUR_20_u1_u1 254. _CNV_A_R_LINEAR_____0_CM 1. 255. DISPLAY_IDENTIFIER ID_ERR_ENVD_DMTLM FORMAT "%3.0"
 /begin AXIS_DESCR COM_AXIS errm_online_dummy _CNV_A_R_LINEAR_____0_CM 4 0. 255. FORMAT "%3.0" AXIS_PTS_REF ldpm_fmy_envd /end AXIS_DESCR
/end CHARACTERISTIC
/begin CHARACTERISTIC fmy_id_rough_leak.envd "Freeze frame FRF_CUS_SET_SPC: environmental data contents for failure XX" CURVE 0xa1004a50 _REC_CUR_20_u1_u1 254. _CNV_A_R_LINEAR_____0_CM 1. 255. DISPLAY_IDENTIFIER ID_ERR_ENVD_ROUGH_LEAK FORMAT "%3.0"
 /begin AXIS_DESCR COM_AXIS errm_online_dummy _CNV_A_R_LINEAR_____0_CM 4 0. 255. FORMAT "%3.0" AXIS_PTS_REF ldpm_fmy_envd /end AXIS_DESCR
/end CHARACTERISTIC
/begin CHARACTERISTIC fmy_id_small_leak.envd "Freeze frame FRF_CUS_SET_SPC: environmental data contents for failure XX" CURVE 0xa1004b68 _REC_CUR_20_u1_u1 254. _CNV_A_R_LINEAR_____0_CM 1. 255. DISPLAY_IDENTIFIER ID_ERR_ENVD_SMALL_LEAK FORMAT "%3.0"
 /begin AXIS_DESCR COM_AXIS errm_online_dummy _CNV_A_R_LINEAR_____0_CM 4 0. 255. FORMAT "%3.0" AXIS_PTS_REF ldpm_fmy_envd /end AXIS_DESCR
/end CHARACTERISTIC
/begin CHARACTERISTIC fmy_id_chk_fuc.envd "Freeze frame FRF_CUS_SET_SPC: environmental data contents for failure XX" CURVE 0xa1003cf4 _REC_CUR_20_u1_u1 254. _CNV_A_R_LINEAR_____0_CM 1. 255. DISPLAY_IDENTIFIER ID_ERR_ENVD_CHK_FUC FORMAT "%3.0"
 /begin AXIS_DESCR COM_AXIS errm_online_dummy _CNV_A_R_LINEAR_____0_CM 4 0. 255. FORMAT "%3.0" AXIS_PTS_REF ldpm_fmy_envd /end AXIS_DESCR
/end CHARACTERISTIC
/begin CHARACTERISTIC fmy_id_sof.envd "Freeze frame FRF_CUS_SET_SPC: environmental data contents for failure XX" CURVE 0xa1004b7c _REC_CUR_20_u1_u1 254. _CNV_A_R_LINEAR_____0_CM 1. 255. DISPLAY_IDENTIFIER ID_ERR_ENVD_SOF FORMAT "%3.0"
 /begin AXIS_DESCR COM_AXIS errm_online_dummy _CNV_A_R_LINEAR_____0_CM 4 0. 255. FORMAT "%3.0" AXIS_PTS_REF ldpm_fmy_envd /end AXIS_DESCR
/end CHARACTERISTIC
/begin CHARACTERISTIC fmy_id_sof_req.envd "Freeze frame FRF_CUS_SET_SPC: environmental data contents for failure XX" CURVE 0xa1004b90 _REC_CUR_20_u1_u1 254. _CNV_A_R_LINEAR_____0_CM 1. 255. DISPLAY_IDENTIFIER ID_ERR_ENVD_SOF_REQ FORMAT "%3.0"
 /begin AXIS_DESCR COM_AXIS errm_online_dummy _CNV_A_R_LINEAR_____0_CM 4 0. 255. FORMAT "%3.0" AXIS_PTS_REF ldpm_fmy_envd /end AXIS_DESCR
/end CHARACTERISTIC
/begin CHARACTERISTIC fmy_id_rly_crcv_heat.envd "Freeze frame FRF_CUS_SET_SPC: environmental data contents for failure XX" CURVE 0xa10049d8 _REC_CUR_20_u1_u1 254. _CNV_A_R_LINEAR_____0_CM 1. 255. DISPLAY_IDENTIFIER ID_ERR_ENVD_RLY_CRCV_HEAT FORMAT "%3.0"
 /begin AXIS_DESCR COM_AXIS errm_online_dummy _CNV_A_R_LINEAR_____0_CM 4 0. 255. FORMAT "%3.0" AXIS_PTS_REF ldpm_fmy_envd /end AXIS_DESCR
/end CHARACTERISTIC
/begin CHARACTERISTIC fmy_id_rly_st.envd "Freeze frame FRF_CUS_SET_SPC: environmental data contents for failure XX" CURVE 0xa1004a28 _REC_CUR_20_u1_u1 254. _CNV_A_R_LINEAR_____0_CM 1. 255. DISPLAY_IDENTIFIER ID_ERR_ENVD_RLY_ST FORMAT "%3.0"
 /begin AXIS_DESCR COM_AXIS errm_online_dummy _CNV_A_R_LINEAR_____0_CM 4 0. 255. FORMAT "%3.0" AXIS_PTS_REF ldpm_fmy_envd /end AXIS_DESCR
/end CHARACTERISTIC
/begin CHARACTERISTIC fmy_id_bsd.envd "Freeze frame FRF_CUS_SET_SPC: environmental data contents for failure XX" CURVE 0xa1003c40 _REC_CUR_20_u1_u1 254. _CNV_A_R_LINEAR_____0_CM 1. 255. DISPLAY_IDENTIFIER ID_ERR_ENVD_BSD FORMAT "%3.0"
 /begin AXIS_DESCR COM_AXIS errm_online_dummy _CNV_A_R_LINEAR_____0_CM 4 0. 255. FORMAT "%3.0" AXIS_PTS_REF ldpm_fmy_envd /end AXIS_DESCR
/end CHARACTERISTIC
/begin CHARACTERISTIC fmy_id_poil_swi.envd "Freeze frame FRF_CUS_SET_SPC: environmental data contents for failure XX" CURVE 0xa1004848 _REC_CUR_20_u1_u1 254. _CNV_A_R_LINEAR_____0_CM 1. 255. DISPLAY_IDENTIFIER ID_ERR_ENVD_POIL_SWI FORMAT "%3.0"
 /begin AXIS_DESCR COM_AXIS errm_online_dummy _CNV_A_R_LINEAR_____0_CM 4 0. 255. FORMAT "%3.0" AXIS_PTS_REF ldpm_fmy_envd /end AXIS_DESCR
/end CHARACTERISTIC
/begin CHARACTERISTIC fmy_id_tout_efp_can.envd "Freeze frame FRF_CUS_SET_SPC: environmental data contents for failure XX" CURVE 0xa1004dfc _REC_CUR_20_u1_u1 254. _CNV_A_R_LINEAR_____0_CM 1. 255. DISPLAY_IDENTIFIER ID_ERR_ENVD_TOUT_EFP_CAN FORMAT "%3.0"
 /begin AXIS_DESCR COM_AXIS errm_online_dummy _CNV_A_R_LINEAR_____0_CM 4 0. 255. FORMAT "%3.0" AXIS_PTS_REF ldpm_fmy_envd /end AXIS_DESCR
/end CHARACTERISTIC
/begin CHARACTERISTIC fmy_id_diagcps.envd "Freeze frame FRF_CUS_SET_SPC: environmental data contents for failure XX" CURVE 0xa1003e84 _REC_CUR_20_u1_u1 254. _CNV_A_R_LINEAR_____0_CM 1. 255. DISPLAY_IDENTIFIER ID_ERR_ENVD_DIAGCPS FORMAT "%3.0"
 /begin AXIS_DESCR COM_AXIS errm_online_dummy _CNV_A_R_LINEAR_____0_CM 4 0. 255. FORMAT "%3.0" AXIS_PTS_REF ldpm_fmy_envd /end AXIS_DESCR
/end CHARACTERISTIC
/begin CHARACTERISTIC fmy_id_dcc.envd "Freeze frame FRF_CUS_SET_SPC: environmental data contents for failure XX" CURVE 0xa1003e48 _REC_CUR_20_u1_u1 254. _CNV_A_R_LINEAR_____0_CM 1. 255. DISPLAY_IDENTIFIER ID_ERR_ENVD_DCC FORMAT "%3.0"
 /begin AXIS_DESCR COM_AXIS errm_online_dummy _CNV_A_R_LINEAR_____0_CM 4 0. 255. FORMAT "%3.0" AXIS_PTS_REF ldpm_fmy_envd /end AXIS_DESCR
/end CHARACTERISTIC
/begin CHARACTERISTIC fmy_id_ldm.envd "Freeze frame FRF_CUS_SET_SPC: environmental data contents for failure XX" CURVE 0xa1004424 _REC_CUR_20_u1_u1 254. _CNV_A_R_LINEAR_____0_CM 1. 255. DISPLAY_IDENTIFIER ID_ERR_ENVD_LDM FORMAT "%3.0"
 /begin AXIS_DESCR COM_AXIS errm_online_dummy _CNV_A_R_LINEAR_____0_CM 4 0. 255. FORMAT "%3.0" AXIS_PTS_REF ldpm_fmy_envd /end AXIS_DESCR
/end CHARACTERISTIC
/begin CHARACTERISTIC fmy_id_dmtlh.envd "Freeze frame FRF_CUS_SET_SPC: environmental data contents for failure XX" CURVE 0xa1003eac _REC_CUR_20_u1_u1 254. _CNV_A_R_LINEAR_____0_CM 1. 255. DISPLAY_IDENTIFIER ID_ERR_ENVD_DMTLH FORMAT "%3.0"
 /begin AXIS_DESCR COM_AXIS errm_online_dummy _CNV_A_R_LINEAR_____0_CM 4 0. 255. FORMAT "%3.0" AXIS_PTS_REF ldpm_fmy_envd /end AXIS_DESCR
/end CHARACTERISTIC
/begin CHARACTERISTIC fmy_id_cs.envd "Freeze frame FRF_CUS_SET_SPC: environmental data contents for failure XX" CURVE 0xa1003dbc _REC_CUR_20_u1_u1 254. _CNV_A_R_LINEAR_____0_CM 1. 255. DISPLAY_IDENTIFIER ID_ERR_ENVD_CS FORMAT "%3.0"
 /begin AXIS_DESCR COM_AXIS errm_online_dummy _CNV_A_R_LINEAR_____0_CM 4 0. 255. FORMAT "%3.0" AXIS_PTS_REF ldpm_fmy_envd /end AXIS_DESCR
/end CHARACTERISTIC
/begin CHARACTERISTIC fmy_id_spi_mps.envd "Freeze frame FRF_CUS_SET_SPC: environmental data contents for failure XX" CURVE 0xa1004bb8 _REC_CUR_20_u1_u1 254. _CNV_A_R_LINEAR_____0_CM 1. 255. DISPLAY_IDENTIFIER ID_ERR_ENVD_SPI_MPS FORMAT "%3.0"
 /begin AXIS_DESCR COM_AXIS errm_online_dummy _CNV_A_R_LINEAR_____0_CM 4 0. 255. FORMAT "%3.0" AXIS_PTS_REF ldpm_fmy_envd /end AXIS_DESCR
/end CHARACTERISTIC
/begin CHARACTERISTIC fmy_id_spi_knk.envd "Freeze frame FRF_CUS_SET_SPC: environmental data contents for failure XX" CURVE 0xa1004ba4 _REC_CUR_20_u1_u1 254. _CNV_A_R_LINEAR_____0_CM 1. 255. DISPLAY_IDENTIFIER ID_ERR_ENVD_SPI_KNK FORMAT "%3.0"
 /begin AXIS_DESCR COM_AXIS errm_online_dummy _CNV_A_R_LINEAR_____0_CM 4 0. 255. FORMAT "%3.0" AXIS_PTS_REF ldpm_fmy_envd /end AXIS_DESCR
/end CHARACTERISTIC
/begin CHARACTERISTIC fmy_id_bn_tq_dcc.envd "Freeze frame FRF_CUS_SET_SPC: environmental data contents for failure XX" CURVE 0xa1003bb4 _REC_CUR_20_u1_u1 254. _CNV_A_R_LINEAR_____0_CM 1. 255. DISPLAY_IDENTIFIER ID_ERR_ENVD_BN_TQ_DCC FORMAT "%3.0"
 /begin AXIS_DESCR COM_AXIS errm_online_dummy _CNV_A_R_LINEAR_____0_CM 4 0. 255. FORMAT "%3.0" AXIS_PTS_REF ldpm_fmy_envd /end AXIS_DESCR
/end CHARACTERISTIC
/begin CHARACTERISTIC fmy_id_bn_tq_pste_2.envd "Freeze frame FRF_CUS_SET_SPC: environmental data contents for failure XX" CURVE 0xa1003bdc _REC_CUR_20_u1_u1 254. _CNV_A_R_LINEAR_____0_CM 1. 255. DISPLAY_IDENTIFIER ID_ERR_ENVD_BN_TQ_PSTE_2 FORMAT "%3.0"
 /begin AXIS_DESCR COM_AXIS errm_online_dummy _CNV_A_R_LINEAR_____0_CM 4 0. 255. FORMAT "%3.0" AXIS_PTS_REF ldpm_fmy_envd /end AXIS_DESCR
/end CHARACTERISTIC
/begin CHARACTERISTIC fmy_id_bn_ars.envd "Freeze frame FRF_CUS_SET_SPC: environmental data contents for failure XX" CURVE 0xa1003a24 _REC_CUR_20_u1_u1 254. _CNV_A_R_LINEAR_____0_CM 1. 255. DISPLAY_IDENTIFIER ID_ERR_ENVD_BN_ARS FORMAT "%3.0"
 /begin AXIS_DESCR COM_AXIS errm_online_dummy _CNV_A_R_LINEAR_____0_CM 4 0. 255. FORMAT "%3.0" AXIS_PTS_REF ldpm_fmy_envd /end AXIS_DESCR
/end CHARACTERISTIC
/begin CHARACTERISTIC fmy_id_bn_cas.envd "Freeze frame FRF_CUS_SET_SPC: environmental data contents for failure XX" CURVE 0xa1003a38 _REC_CUR_20_u1_u1 254. _CNV_A_R_LINEAR_____0_CM 1. 255. DISPLAY_IDENTIFIER ID_ERR_ENVD_BN_CAS FORMAT "%3.0"
 /begin AXIS_DESCR COM_AXIS errm_online_dummy _CNV_A_R_LINEAR_____0_CM 4 0. 255. FORMAT "%3.0" AXIS_PTS_REF ldpm_fmy_envd /end AXIS_DESCR
/end CHARACTERISTIC
/begin CHARACTERISTIC fmy_id_bn_tq_tcs.envd "Freeze frame FRF_CUS_SET_SPC: environmental data contents for failure XX" CURVE 0xa1003bf0 _REC_CUR_20_u1_u1 254. _CNV_A_R_LINEAR_____0_CM 1. 255. DISPLAY_IDENTIFIER ID_ERR_ENVD_BN_TQ_TCS FORMAT "%3.0"
 /begin AXIS_DESCR COM_AXIS errm_online_dummy _CNV_A_R_LINEAR_____0_CM 4 0. 255. FORMAT "%3.0" AXIS_PTS_REF ldpm_fmy_envd /end AXIS_DESCR
/end CHARACTERISTIC
/begin CHARACTERISTIC fmy_id_bn_vs_tcs.envd "Freeze frame FRF_CUS_SET_SPC: environmental data contents for failure XX" CURVE 0xa1003c2c _REC_CUR_20_u1_u1 254. _CNV_A_R_LINEAR_____0_CM 1. 255. DISPLAY_IDENTIFIER ID_ERR_ENVD_BN_VS_TCS FORMAT "%3.0"
 /begin AXIS_DESCR COM_AXIS errm_online_dummy _CNV_A_R_LINEAR_____0_CM 4 0. 255. FORMAT "%3.0" AXIS_PTS_REF ldpm_fmy_envd /end AXIS_DESCR
/end CHARACTERISTIC
/begin CHARACTERISTIC fmy_id_bn_tcs.envd "Freeze frame FRF_CUS_SET_SPC: environmental data contents for failure XX" CURVE 0xa1003b8c _REC_CUR_20_u1_u1 254. _CNV_A_R_LINEAR_____0_CM 1. 255. DISPLAY_IDENTIFIER ID_ERR_ENVD_BN_TCS FORMAT "%3.0"
 /begin AXIS_DESCR COM_AXIS errm_online_dummy _CNV_A_R_LINEAR_____0_CM 4 0. 255. FORMAT "%3.0" AXIS_PTS_REF ldpm_fmy_envd /end AXIS_DESCR
/end CHARACTERISTIC
/begin CHARACTERISTIC fmy_id_bn_tq_etcu.envd "Freeze frame FRF_CUS_SET_SPC: environmental data contents for failure XX" CURVE 0xa1003bc8 _REC_CUR_20_u1_u1 254. _CNV_A_R_LINEAR_____0_CM 1. 255. DISPLAY_IDENTIFIER ID_ERR_ENVD_BN_TQ_ETCU FORMAT "%3.0"
 /begin AXIS_DESCR COM_AXIS errm_online_dummy _CNV_A_R_LINEAR_____0_CM 4 0. 255. FORMAT "%3.0" AXIS_PTS_REF ldpm_fmy_envd /end AXIS_DESCR
/end CHARACTERISTIC
/begin CHARACTERISTIC fmy_id_bn_etcu.envd "Freeze frame FRF_CUS_SET_SPC: environmental data contents for failure XX" CURVE 0xa1003a74 _REC_CUR_20_u1_u1 254. _CNV_A_R_LINEAR_____0_CM 1. 255. DISPLAY_IDENTIFIER ID_ERR_ENVD_BN_ETCU FORMAT "%3.0"
 /begin AXIS_DESCR COM_AXIS errm_online_dummy _CNV_A_R_LINEAR_____0_CM 4 0. 255. FORMAT "%3.0" AXIS_PTS_REF ldpm_fmy_envd /end AXIS_DESCR
/end CHARACTERISTIC
/begin CHARACTERISTIC fmy_id_bn_etcu_2.envd "Freeze frame FRF_CUS_SET_SPC: environmental data contents for failure XX" CURVE 0xa1003a88 _REC_CUR_20_u1_u1 254. _CNV_A_R_LINEAR_____0_CM 1. 255. DISPLAY_IDENTIFIER ID_ERR_ENVD_BN_ETCU_2 FORMAT "%3.0"
 /begin AXIS_DESCR COM_AXIS errm_online_dummy _CNV_A_R_LINEAR_____0_CM 4 0. 255. FORMAT "%3.0" AXIS_PTS_REF ldpm_fmy_envd /end AXIS_DESCR
/end CHARACTERISTIC
/begin CHARACTERISTIC fmy_id_bn_etcu_disp.envd "Freeze frame FRF_CUS_SET_SPC: environmental data contents for failure XX" CURVE 0xa1003a9c _REC_CUR_20_u1_u1 254. _CNV_A_R_LINEAR_____0_CM 1. 255. DISPLAY_IDENTIFIER ID_ERR_ENVD_BN_ETCU_DISP FORMAT "%3.0"
 /begin AXIS_DESCR COM_AXIS errm_online_dummy _CNV_A_R_LINEAR_____0_CM 4 0. 255. FORMAT "%3.0" AXIS_PTS_REF ldpm_fmy_envd /end AXIS_DESCR
/end CHARACTERISTIC
/begin CHARACTERISTIC fmy_id_bn_tq_amt.envd "Freeze frame FRF_CUS_SET_SPC: environmental data contents for failure XX" CURVE 0xa1003ba0 _REC_CUR_20_u1_u1 254. _CNV_A_R_LINEAR_____0_CM 1. 255. DISPLAY_IDENTIFIER ID_ERR_ENVD_BN_TQ_AMT FORMAT "%3.0"
 /begin AXIS_DESCR COM_AXIS errm_online_dummy _CNV_A_R_LINEAR_____0_CM 4 0. 255. FORMAT "%3.0" AXIS_PTS_REF ldpm_fmy_envd /end AXIS_DESCR
/end CHARACTERISTIC
/begin CHARACTERISTIC fmy_id_bn_acc.envd "Freeze frame FRF_CUS_SET_SPC: environmental data contents for failure XX" CURVE 0xa10039fc _REC_CUR_20_u1_u1 254. _CNV_A_R_LINEAR_____0_CM 1. 255. DISPLAY_IDENTIFIER ID_ERR_ENVD_BN_ACC FORMAT "%3.0"
 /begin AXIS_DESCR COM_AXIS errm_online_dummy _CNV_A_R_LINEAR_____0_CM 4 0. 255. FORMAT "%3.0" AXIS_PTS_REF ldpm_fmy_envd /end AXIS_DESCR
/end CHARACTERISTIC
/begin CHARACTERISTIC fmy_id_bn_t_icl.envd "Freeze frame FRF_CUS_SET_SPC: environmental data contents for failure XX" CURVE 0xa1003b78 _REC_CUR_20_u1_u1 254. _CNV_A_R_LINEAR_____0_CM 1. 255. DISPLAY_IDENTIFIER ID_ERR_ENVD_BN_T_ICL FORMAT "%3.0"
 /begin AXIS_DESCR COM_AXIS errm_online_dummy _CNV_A_R_LINEAR_____0_CM 4 0. 255. FORMAT "%3.0" AXIS_PTS_REF ldpm_fmy_envd /end AXIS_DESCR
/end CHARACTERISTIC
/begin CHARACTERISTIC fmy_id_bn_veh_mod.envd "Freeze frame FRF_CUS_SET_SPC: environmental data contents for failure XX" CURVE 0xa1003c18 _REC_CUR_20_u1_u1 254. _CNV_A_R_LINEAR_____0_CM 1. 255. DISPLAY_IDENTIFIER ID_ERR_ENVD_BN_VEH_MOD FORMAT "%3.0"
 /begin AXIS_DESCR COM_AXIS errm_online_dummy _CNV_A_R_LINEAR_____0_CM 4 0. 255. FORMAT "%3.0" AXIS_PTS_REF ldpm_fmy_envd /end AXIS_DESCR
/end CHARACTERISTIC
/begin CHARACTERISTIC fmy_id_bn_km_icl.envd "Freeze frame FRF_CUS_SET_SPC: environmental data contents for failure XX" CURVE 0xa1003aec _REC_CUR_20_u1_u1 254. _CNV_A_R_LINEAR_____0_CM 1. 255. DISPLAY_IDENTIFIER ID_ERR_ENVD_BN_KM_ICL FORMAT "%3.0"
 /begin AXIS_DESCR COM_AXIS errm_online_dummy _CNV_A_R_LINEAR_____0_CM 4 0. 255. FORMAT "%3.0" AXIS_PTS_REF ldpm_fmy_envd /end AXIS_DESCR
/end CHARACTERISTIC
/begin CHARACTERISTIC fmy_id_bn_icl.envd "Freeze frame FRF_CUS_SET_SPC: environmental data contents for failure XX" CURVE 0xa1003ad8 _REC_CUR_20_u1_u1 254. _CNV_A_R_LINEAR_____0_CM 1. 255. DISPLAY_IDENTIFIER ID_ERR_ENVD_BN_ICL FORMAT "%3.0"
 /begin AXIS_DESCR COM_AXIS errm_online_dummy _CNV_A_R_LINEAR_____0_CM 4 0. 255. FORMAT "%3.0" AXIS_PTS_REF ldpm_fmy_envd /end AXIS_DESCR
/end CHARACTERISTIC
/begin CHARACTERISTIC fmy_id_bn_pow_vb.envd "Freeze frame FRF_CUS_SET_SPC: environmental data contents for failure XX" CURVE 0xa1003b50 _REC_CUR_20_u1_u1 254. _CNV_A_R_LINEAR_____0_CM 1. 255. DISPLAY_IDENTIFIER ID_ERR_ENVD_BN_POW_VB FORMAT "%3.0"
 /begin AXIS_DESCR COM_AXIS errm_online_dummy _CNV_A_R_LINEAR_____0_CM 4 0. 255. FORMAT "%3.0" AXIS_PTS_REF ldpm_fmy_envd /end AXIS_DESCR
/end CHARACTERISTIC
/begin CHARACTERISTIC fmy_id_bn_pow_gen.envd "Freeze frame FRF_CUS_SET_SPC: environmental data contents for failure XX" CURVE 0xa1003b3c _REC_CUR_20_u1_u1 254. _CNV_A_R_LINEAR_____0_CM 1. 255. DISPLAY_IDENTIFIER ID_ERR_ENVD_BN_POW_GEN FORMAT "%3.0"
 /begin AXIS_DESCR COM_AXIS errm_online_dummy _CNV_A_R_LINEAR_____0_CM 4 0. 255. FORMAT "%3.0" AXIS_PTS_REF ldpm_fmy_envd /end AXIS_DESCR
/end CHARACTERISTIC
/begin CHARACTERISTIC fmy_id_bn_msw.envd "Freeze frame FRF_CUS_SET_SPC: environmental data contents for failure XX" CURVE 0xa1003b28 _REC_CUR_20_u1_u1 254. _CNV_A_R_LINEAR_____0_CM 1. 255. DISPLAY_IDENTIFIER ID_ERR_ENVD_BN_MSW FORMAT "%3.0"
 /begin AXIS_DESCR COM_AXIS errm_online_dummy _CNV_A_R_LINEAR_____0_CM 4 0. 255. FORMAT "%3.0" AXIS_PTS_REF ldpm_fmy_envd /end AXIS_DESCR
/end CHARACTERISTIC
/begin CHARACTERISTIC fmy_id_bn_ang_pste.envd "Freeze frame FRF_CUS_SET_SPC: environmental data contents for failure XX" CURVE 0xa1003a10 _REC_CUR_20_u1_u1 254. _CNV_A_R_LINEAR_____0_CM 1. 255. DISPLAY_IDENTIFIER ID_ERR_ENVD_BN_ANG_PSTE FORMAT "%3.0"
 /begin AXIS_DESCR COM_AXIS errm_online_dummy _CNV_A_R_LINEAR_____0_CM 4 0. 255. FORMAT "%3.0" AXIS_PTS_REF ldpm_fmy_envd /end AXIS_DESCR
/end CHARACTERISTIC
/begin CHARACTERISTIC fmy_id_bn_gear_rev.envd "Freeze frame FRF_CUS_SET_SPC: environmental data contents for failure XX" CURVE 0xa1003ab0 _REC_CUR_20_u1_u1 254. _CNV_A_R_LINEAR_____0_CM 1. 255. DISPLAY_IDENTIFIER ID_ERR_ENVD_BN_GEAR_REV FORMAT "%3.0"
 /begin AXIS_DESCR COM_AXIS errm_online_dummy _CNV_A_R_LINEAR_____0_CM 4 0. 255. FORMAT "%3.0" AXIS_PTS_REF ldpm_fmy_envd /end AXIS_DESCR
/end CHARACTERISTIC
/begin CHARACTERISTIC fmy_id_bn_ltg_hdlp_l.envd "Freeze frame FRF_CUS_SET_SPC: environmental data contents for failure XX" CURVE 0xa1003b14 _REC_CUR_20_u1_u1 254. _CNV_A_R_LINEAR_____0_CM 1. 255. DISPLAY_IDENTIFIER ID_ERR_ENVD_BN_LTG_HDLP_L FORMAT "%3.0"
 /begin AXIS_DESCR COM_AXIS errm_online_dummy _CNV_A_R_LINEAR_____0_CM 4 0. 255. FORMAT "%3.0" AXIS_PTS_REF ldpm_fmy_envd /end AXIS_DESCR
/end CHARACTERISTIC
/begin CHARACTERISTIC fmy_id_bn_ldm.envd "Freeze frame FRF_CUS_SET_SPC: environmental data contents for failure XX" CURVE 0xa1003b00 _REC_CUR_20_u1_u1 254. _CNV_A_R_LINEAR_____0_CM 1. 255. DISPLAY_IDENTIFIER ID_ERR_ENVD_BN_LDM FORMAT "%3.0"
 /begin AXIS_DESCR COM_AXIS errm_online_dummy _CNV_A_R_LINEAR_____0_CM 4 0. 255. FORMAT "%3.0" AXIS_PTS_REF ldpm_fmy_envd /end AXIS_DESCR
/end CHARACTERISTIC
/begin CHARACTERISTIC fmy_id_bn_trl.envd "Freeze frame FRF_CUS_SET_SPC: environmental data contents for failure XX" CURVE 0xa1003c04 _REC_CUR_20_u1_u1 254. _CNV_A_R_LINEAR_____0_CM 1. 255. DISPLAY_IDENTIFIER ID_ERR_ENVD_BN_TRL FORMAT "%3.0"
 /begin AXIS_DESCR COM_AXIS errm_online_dummy _CNV_A_R_LINEAR_____0_CM 4 0. 255. FORMAT "%3.0" AXIS_PTS_REF ldpm_fmy_envd /end AXIS_DESCR
/end CHARACTERISTIC
/begin CHARACTERISTIC fmy_id_bn_hiv.envd "Freeze frame FRF_CUS_SET_SPC: environmental data contents for failure XX" CURVE 0xa1003ac4 _REC_CUR_20_u1_u1 254. _CNV_A_R_LINEAR_____0_CM 1. 255. DISPLAY_IDENTIFIER ID_ERR_ENVD_BN_HIV FORMAT "%3.0"
 /begin AXIS_DESCR COM_AXIS errm_online_dummy _CNV_A_R_LINEAR_____0_CM 4 0. 255. FORMAT "%3.0" AXIS_PTS_REF ldpm_fmy_envd /end AXIS_DESCR
/end CHARACTERISTIC
/begin CHARACTERISTIC fmy_id_bn_t_clk.envd "Freeze frame FRF_CUS_SET_SPC: environmental data contents for failure XX" CURVE 0xa1003b64 _REC_CUR_20_u1_u1 254. _CNV_A_R_LINEAR_____0_CM 1. 255. DISPLAY_IDENTIFIER ID_ERR_ENVD_BN_T_CLK FORMAT "%3.0"
 /begin AXIS_DESCR COM_AXIS errm_online_dummy _CNV_A_R_LINEAR_____0_CM 4 0. 255. FORMAT "%3.0" AXIS_PTS_REF ldpm_fmy_envd /end AXIS_DESCR
/end CHARACTERISTIC
/begin CHARACTERISTIC fmy_id_bn_efp_crash.envd "Freeze frame FRF_CUS_SET_SPC: environmental data contents for failure XX" CURVE 0xa1003a60 _REC_CUR_20_u1_u1 254. _CNV_A_R_LINEAR_____0_CM 1. 255. DISPLAY_IDENTIFIER ID_ERR_ENVD_BN_EFP_CRASH FORMAT "%3.0"
 /begin AXIS_DESCR COM_AXIS errm_online_dummy _CNV_A_R_LINEAR_____0_CM 4 0. 255. FORMAT "%3.0" AXIS_PTS_REF ldpm_fmy_envd /end AXIS_DESCR
/end CHARACTERISTIC
/begin CHARACTERISTIC fmy_id_bn_efp.envd "Freeze frame FRF_CUS_SET_SPC: environmental data contents for failure XX" CURVE 0xa1003a4c _REC_CUR_20_u1_u1 254. _CNV_A_R_LINEAR_____0_CM 1. 255. DISPLAY_IDENTIFIER ID_ERR_ENVD_BN_EFP FORMAT "%3.0"
 /begin AXIS_DESCR COM_AXIS errm_online_dummy _CNV_A_R_LINEAR_____0_CM 4 0. 255. FORMAT "%3.0" AXIS_PTS_REF ldpm_fmy_envd /end AXIS_DESCR
/end CHARACTERISTIC
/begin CHARACTERISTIC fmy_id_load_tps_plaus.envd "Freeze frame FRF_CUS_SET_SPC: environmental data contents for failure XX" CURVE 0xa1004438 _REC_CUR_20_u1_u1 254. _CNV_A_R_LINEAR_____0_CM 1. 255. DISPLAY_IDENTIFIER ID_ERR_ENVD_LOAD_TPS_PLAUS FORMAT "%3.0"
 /begin AXIS_DESCR COM_AXIS errm_online_dummy _CNV_A_R_LINEAR_____0_CM 4 0. 255. FORMAT "%3.0" AXIS_PTS_REF ldpm_fmy_envd /end AXIS_DESCR
/end CHARACTERISTIC
/begin CHARACTERISTIC fmy_id_egy_min.envd "Freeze frame FRF_CUS_SET_SPC: environmental data contents for failure XX" CURVE 0xa1004028 _REC_CUR_20_u1_u1 254. _CNV_A_R_LINEAR_____0_CM 1. 255. DISPLAY_IDENTIFIER ID_ERR_ENVD_EGY_MIN FORMAT "%3.0"
 /begin AXIS_DESCR COM_AXIS errm_online_dummy _CNV_A_R_LINEAR_____0_CM 4 0. 255. FORMAT "%3.0" AXIS_PTS_REF ldpm_fmy_envd /end AXIS_DESCR
/end CHARACTERISTIC
/begin CHARACTERISTIC fmy_id_efp_crash.envd "Freeze frame FRF_CUS_SET_SPC: environmental data contents for failure XX" CURVE 0xa1004000 _REC_CUR_20_u1_u1 254. _CNV_A_R_LINEAR_____0_CM 1. 255. DISPLAY_IDENTIFIER ID_ERR_ENVD_EFP_CRASH FORMAT "%3.0"
 /begin AXIS_DESCR COM_AXIS errm_online_dummy _CNV_A_R_LINEAR_____0_CM 4 0. 255. FORMAT "%3.0" AXIS_PTS_REF ldpm_fmy_envd /end AXIS_DESCR
/end CHARACTERISTIC
/begin CHARACTERISTIC fmy_id_efp.envd "Freeze frame FRF_CUS_SET_SPC: environmental data contents for failure XX" CURVE 0xa1003fec _REC_CUR_20_u1_u1 254. _CNV_A_R_LINEAR_____0_CM 1. 255. DISPLAY_IDENTIFIER ID_ERR_ENVD_EFP FORMAT "%3.0"
 /begin AXIS_DESCR COM_AXIS errm_online_dummy _CNV_A_R_LINEAR_____0_CM 4 0. 255. FORMAT "%3.0" AXIS_PTS_REF ldpm_fmy_envd /end AXIS_DESCR
/end CHARACTERISTIC
/begin CHARACTERISTIC fmy_id_locan_boff.envd "Freeze frame FRF_CUS_SET_SPC: environmental data contents for failure XX" CURVE 0xa100444c _REC_CUR_20_u1_u1 254. _CNV_A_R_LINEAR_____0_CM 1. 255. DISPLAY_IDENTIFIER ID_ERR_ENVD_LOCAN_BOFF FORMAT "%3.0"
 /begin AXIS_DESCR COM_AXIS errm_online_dummy _CNV_A_R_LINEAR_____0_CM 4 0. 255. FORMAT "%3.0" AXIS_PTS_REF ldpm_fmy_envd /end AXIS_DESCR
/end CHARACTERISTIC
/begin CHARACTERISTIC fmy_id_cwp_plaus.envd "Freeze frame FRF_CUS_SET_SPC: environmental data contents for failure XX" CURVE 0xa1003e20 _REC_CUR_20_u1_u1 254. _CNV_A_R_LINEAR_____0_CM 1. 255. DISPLAY_IDENTIFIER ID_ERR_ENVD_CWP_PLAUS FORMAT "%3.0"
 /begin AXIS_DESCR COM_AXIS errm_online_dummy _CNV_A_R_LINEAR_____0_CM 4 0. 255. FORMAT "%3.0" AXIS_PTS_REF ldpm_fmy_envd /end AXIS_DESCR
/end CHARACTERISTIC
/begin CHARACTERISTIC fmy_id_cwp_int_off.envd "Freeze frame FRF_CUS_SET_SPC: environmental data contents for failure XX" CURVE 0xa1003e0c _REC_CUR_20_u1_u1 254. _CNV_A_R_LINEAR_____0_CM 1. 255. DISPLAY_IDENTIFIER ID_ERR_ENVD_CWP_INT_OFF FORMAT "%3.0"
 /begin AXIS_DESCR COM_AXIS errm_online_dummy _CNV_A_R_LINEAR_____0_CM 4 0. 255. FORMAT "%3.0" AXIS_PTS_REF ldpm_fmy_envd /end AXIS_DESCR
/end CHARACTERISTIC
/begin CHARACTERISTIC fmy_id_cwp_pwr.envd "Freeze frame FRF_CUS_SET_SPC: environmental data contents for failure XX" CURVE 0xa1003e34 _REC_CUR_20_u1_u1 254. _CNV_A_R_LINEAR_____0_CM 1. 255. DISPLAY_IDENTIFIER ID_ERR_ENVD_CWP_PWR FORMAT "%3.0"
 /begin AXIS_DESCR COM_AXIS errm_online_dummy _CNV_A_R_LINEAR_____0_CM 4 0. 255. FORMAT "%3.0" AXIS_PTS_REF ldpm_fmy_envd /end AXIS_DESCR
/end CHARACTERISTIC
/begin CHARACTERISTIC fmy_id_cwp_com_plaus.envd "Freeze frame FRF_CUS_SET_SPC: environmental data contents for failure XX" CURVE 0xa1003df8 _REC_CUR_20_u1_u1 254. _CNV_A_R_LINEAR_____0_CM 1. 255. DISPLAY_IDENTIFIER ID_ERR_ENVD_CWP_COM_PLAUS FORMAT "%3.0"
 /begin AXIS_DESCR COM_AXIS errm_online_dummy _CNV_A_R_LINEAR_____0_CM 4 0. 255. FORMAT "%3.0" AXIS_PTS_REF ldpm_fmy_envd /end AXIS_DESCR
/end CHARACTERISTIC
/begin CHARACTERISTIC fmy_id_qoil_sens.envd "Freeze frame FRF_CUS_SET_SPC: environmental data contents for failure XX" CURVE 0xa1004960 _REC_CUR_20_u1_u1 254. _CNV_A_R_LINEAR_____0_CM 1. 255. DISPLAY_IDENTIFIER ID_ERR_ENVD_QOIL_SENS FORMAT "%3.0"
 /begin AXIS_DESCR COM_AXIS errm_online_dummy _CNV_A_R_LINEAR_____0_CM 4 0. 255. FORMAT "%3.0" AXIS_PTS_REF ldpm_fmy_envd /end AXIS_DESCR
/end CHARACTERISTIC
/begin CHARACTERISTIC fmy_id_bat_sens.envd "Freeze frame FRF_CUS_SET_SPC: environmental data contents for failure XX" CURVE 0xa10039c0 _REC_CUR_20_u1_u1 254. _CNV_A_R_LINEAR_____0_CM 1. 255. DISPLAY_IDENTIFIER ID_ERR_ENVD_BAT_SENS FORMAT "%3.0"
 /begin AXIS_DESCR COM_AXIS errm_online_dummy _CNV_A_R_LINEAR_____0_CM 4 0. 255. FORMAT "%3.0" AXIS_PTS_REF ldpm_fmy_envd /end AXIS_DESCR
/end CHARACTERISTIC
/begin CHARACTERISTIC fmy_id_bat_sens_it.envd "Freeze frame FRF_CUS_SET_SPC: environmental data contents for failure XX" CURVE 0xa10039d4 _REC_CUR_20_u1_u1 254. _CNV_A_R_LINEAR_____0_CM 1. 255. DISPLAY_IDENTIFIER ID_ERR_ENVD_BAT_SENS_IT FORMAT "%3.0"
 /begin AXIS_DESCR COM_AXIS errm_online_dummy _CNV_A_R_LINEAR_____0_CM 4 0. 255. FORMAT "%3.0" AXIS_PTS_REF ldpm_fmy_envd /end AXIS_DESCR
/end CHARACTERISTIC
/begin CHARACTERISTIC fmy_id_bat_sens_it_el.envd "Freeze frame FRF_CUS_SET_SPC: environmental data contents for failure XX" CURVE 0xa10039e8 _REC_CUR_20_u1_u1 254. _CNV_A_R_LINEAR_____0_CM 1. 255. DISPLAY_IDENTIFIER ID_ERR_ENVD_BAT_SENS_IT_EL FORMAT "%3.0"
 /begin AXIS_DESCR COM_AXIS errm_online_dummy _CNV_A_R_LINEAR_____0_CM 4 0. 255. FORMAT "%3.0" AXIS_PTS_REF ldpm_fmy_envd /end AXIS_DESCR
/end CHARACTERISTIC
/begin CHARACTERISTIC fmy_id_ecu_nvmy.envd "Freeze frame FRF_CUS_SET_SPC: environmental data contents for failure XX" CURVE 0xa1003fb0 _REC_CUR_20_u1_u1 254. _CNV_A_R_LINEAR_____0_CM 1. 255. DISPLAY_IDENTIFIER ID_ERR_ENVD_ECU_NVMY FORMAT "%3.0"
 /begin AXIS_DESCR COM_AXIS errm_online_dummy _CNV_A_R_LINEAR_____0_CM 4 0. 255. FORMAT "%3.0" AXIS_PTS_REF ldpm_fmy_envd /end AXIS_DESCR
/end CHARACTERISTIC
/begin CHARACTERISTIC fmy_id_gs.envd "Freeze frame FRF_CUS_SET_SPC: environmental data contents for failure XX" CURVE 0xa1004168 _REC_CUR_20_u1_u1 254. _CNV_A_R_LINEAR_____0_CM 1. 255. DISPLAY_IDENTIFIER ID_ERR_ENVD_GS FORMAT "%3.0"
 /begin AXIS_DESCR COM_AXIS errm_online_dummy _CNV_A_R_LINEAR_____0_CM 4 0. 255. FORMAT "%3.0" AXIS_PTS_REF ldpm_fmy_envd /end AXIS_DESCR
/end CHARACTERISTIC
/begin CHARACTERISTIC fmy_id_plaus_igk_bn.envd "Freeze frame FRF_CUS_SET_SPC: environmental data contents for failure XX" CURVE 0xa1004834 _REC_CUR_20_u1_u1 254. _CNV_A_R_LINEAR_____0_CM 1. 255. DISPLAY_IDENTIFIER ID_ERR_ENVD_PLAUS_IGK_BN FORMAT "%3.0"
 /begin AXIS_DESCR COM_AXIS errm_online_dummy _CNV_A_R_LINEAR_____0_CM 4 0. 255. FORMAT "%3.0" AXIS_PTS_REF ldpm_fmy_envd /end AXIS_DESCR
/end CHARACTERISTIC
/begin CHARACTERISTIC fmy_id_tq_req_can.envd "Freeze frame FRF_CUS_SET_SPC: environmental data contents for failure XX" CURVE 0xa1004f78 _REC_CUR_20_u1_u1 254. _CNV_A_R_LINEAR_____0_CM 1. 255. DISPLAY_IDENTIFIER ID_ERR_ENVD_TQ_REQ_CAN FORMAT "%3.0"
 /begin AXIS_DESCR COM_AXIS errm_online_dummy _CNV_A_R_LINEAR_____0_CM 4 0. 255. FORMAT "%3.0" AXIS_PTS_REF ldpm_fmy_envd /end AXIS_DESCR
/end CHARACTERISTIC
/begin CHARACTERISTIC fmy_id_map_dip_sens.envd "Freeze frame FRF_CUS_SET_SPC: environmental data contents for failure XX" CURVE 0xa1004528 _REC_CUR_20_u1_u1 254. _CNV_A_R_LINEAR_____0_CM 1. 255. DISPLAY_IDENTIFIER ID_ERR_ENVD_MAP_DIP_SENS FORMAT "%3.0"
 /begin AXIS_DESCR COM_AXIS errm_online_dummy _CNV_A_R_LINEAR_____0_CM 4 0. 255. FORMAT "%3.0" AXIS_PTS_REF ldpm_fmy_envd /end AXIS_DESCR
/end CHARACTERISTIC
/begin CHARACTERISTIC fmy_id_mec_ivvt_in.envd "Freeze frame FRF_CUS_SET_SPC: environmental data contents for failure XX" CURVE 0xa1004564 _REC_CUR_20_u1_u1 254. _CNV_A_R_LINEAR_____0_CM 1. 255. DISPLAY_IDENTIFIER ID_ERR_ENVD_MEC_IVVT_IN FORMAT "%3.0"
 /begin AXIS_DESCR COM_AXIS errm_online_dummy _CNV_A_R_LINEAR_____0_CM 4 0. 255. FORMAT "%3.0" AXIS_PTS_REF ldpm_fmy_envd /end AXIS_DESCR
/end CHARACTERISTIC
/begin CHARACTERISTIC fmy_id_mec_ivvt_ex.envd "Freeze frame FRF_CUS_SET_SPC: environmental data contents for failure XX" CURVE 0xa1004550 _REC_CUR_20_u1_u1 254. _CNV_A_R_LINEAR_____0_CM 1. 255. DISPLAY_IDENTIFIER ID_ERR_ENVD_MEC_IVVT_EX FORMAT "%3.0"
 /begin AXIS_DESCR COM_AXIS errm_online_dummy _CNV_A_R_LINEAR_____0_CM 4 0. 255. FORMAT "%3.0" AXIS_PTS_REF ldpm_fmy_envd /end AXIS_DESCR
/end CHARACTERISTIC
/begin CHARACTERISTIC fmy_id_tout_nox_sens_1.envd "Freeze frame FRF_CUS_SET_SPC: environmental data contents for failure XX" CURVE 0xa1004e60 _REC_CUR_20_u1_u1 254. _CNV_A_R_LINEAR_____0_CM 1. 255. DISPLAY_IDENTIFIER ID_ERR_ENVD_TOUT_NOX_SENS_1 FORMAT "%3.0"
 /begin AXIS_DESCR COM_AXIS errm_online_dummy _CNV_A_R_LINEAR_____0_CM 4 0. 255. FORMAT "%3.0" AXIS_PTS_REF ldpm_fmy_envd /end AXIS_DESCR
/end CHARACTERISTIC
/begin CHARACTERISTIC fmy_id_tout_nox_sens_2.envd "Freeze frame FRF_CUS_SET_SPC: environmental data contents for failure XX" CURVE 0xa1004e74 _REC_CUR_20_u1_u1 254. _CNV_A_R_LINEAR_____0_CM 1. 255. DISPLAY_IDENTIFIER ID_ERR_ENVD_TOUT_NOX_SENS_2 FORMAT "%3.0"
 /begin AXIS_DESCR COM_AXIS errm_online_dummy _CNV_A_R_LINEAR_____0_CM 4 0. 255. FORMAT "%3.0" AXIS_PTS_REF ldpm_fmy_envd /end AXIS_DESCR
/end CHARACTERISTIC
/begin CHARACTERISTIC fmy_id_vvl_rot.envd "Freeze frame FRF_CUS_SET_SPC: environmental data contents for failure XX" CURVE 0xa1005108 _REC_CUR_20_u1_u1 254. _CNV_A_R_LINEAR_____0_CM 1. 255. DISPLAY_IDENTIFIER ID_ERR_ENVD_VVL_ROT FORMAT "%3.0"
 /begin AXIS_DESCR COM_AXIS errm_online_dummy _CNV_A_R_LINEAR_____0_CM 4 0. 255. FORMAT "%3.0" AXIS_PTS_REF ldpm_fmy_envd /end AXIS_DESCR
/end CHARACTERISTIC
/begin CHARACTERISTIC fmy_id_rly_vvl.envd "Freeze frame FRF_CUS_SET_SPC: environmental data contents for failure XX" CURVE 0xa1004a3c _REC_CUR_20_u1_u1 254. _CNV_A_R_LINEAR_____0_CM 1. 255. DISPLAY_IDENTIFIER ID_ERR_ENVD_RLY_VVL FORMAT "%3.0"
 /begin AXIS_DESCR COM_AXIS errm_online_dummy _CNV_A_R_LINEAR_____0_CM 4 0. 255. FORMAT "%3.0" AXIS_PTS_REF ldpm_fmy_envd /end AXIS_DESCR
/end CHARACTERISTIC
/begin CHARACTERISTIC fmy_id_nox_sens_1.envd "Freeze frame FRF_CUS_SET_SPC: environmental data contents for failure XX" CURVE 0xa10046e0 _REC_CUR_20_u1_u1 254. _CNV_A_R_LINEAR_____0_CM 1. 255. DISPLAY_IDENTIFIER ID_ERR_ENVD_NOX_SENS_1 FORMAT "%3.0"
 /begin AXIS_DESCR COM_AXIS errm_online_dummy _CNV_A_R_LINEAR_____0_CM 4 0. 255. FORMAT "%3.0" AXIS_PTS_REF ldpm_fmy_envd /end AXIS_DESCR
/end CHARACTERISTIC
/begin CHARACTERISTIC fmy_id_ovl_ecu_vvl.envd "Freeze frame FRF_CUS_SET_SPC: environmental data contents for failure XX" CURVE 0xa10047d0 _REC_CUR_20_u1_u1 254. _CNV_A_R_LINEAR_____0_CM 1. 255. DISPLAY_IDENTIFIER ID_ERR_ENVD_OVL_ECU_VVL FORMAT "%3.0"
 /begin AXIS_DESCR COM_AXIS errm_online_dummy _CNV_A_R_LINEAR_____0_CM 4 0. 255. FORMAT "%3.0" AXIS_PTS_REF ldpm_fmy_envd /end AXIS_DESCR
/end CHARACTERISTIC
/begin CHARACTERISTIC fmy_id_dr_sc_vvl.envd "Freeze frame FRF_CUS_SET_SPC: environmental data contents for failure XX" CURVE 0xa1003ee8 _REC_CUR_20_u1_u1 254. _CNV_A_R_LINEAR_____0_CM 1. 255. DISPLAY_IDENTIFIER ID_ERR_ENVD_DR_SC_VVL FORMAT "%3.0"
 /begin AXIS_DESCR COM_AXIS errm_online_dummy _CNV_A_R_LINEAR_____0_CM 4 0. 255. FORMAT "%3.0" AXIS_PTS_REF ldpm_fmy_envd /end AXIS_DESCR
/end CHARACTERISTIC
/begin CHARACTERISTIC fmy_id_crit_ovl_ecu_vvl.envd "Freeze frame FRF_CUS_SET_SPC: environmental data contents for failure XX" CURVE 0xa1003d44 _REC_CUR_20_u1_u1 254. _CNV_A_R_LINEAR_____0_CM 1. 255. DISPLAY_IDENTIFIER ID_ERR_ENVD_CRIT_OVL_ECU_VVL FORMAT "%3.0"
 /begin AXIS_DESCR COM_AXIS errm_online_dummy _CNV_A_R_LINEAR_____0_CM 4 0. 255. FORMAT "%3.0" AXIS_PTS_REF ldpm_fmy_envd /end AXIS_DESCR
/end CHARACTERISTIC
/begin CHARACTERISTIC fmy_id_nox_sens_2.envd "Freeze frame FRF_CUS_SET_SPC: environmental data contents for failure XX" CURVE 0xa10046f4 _REC_CUR_20_u1_u1 254. _CNV_A_R_LINEAR_____0_CM 1. 255. DISPLAY_IDENTIFIER ID_ERR_ENVD_NOX_SENS_2 FORMAT "%3.0"
 /begin AXIS_DESCR COM_AXIS errm_online_dummy _CNV_A_R_LINEAR_____0_CM 4 0. 255. FORMAT "%3.0" AXIS_PTS_REF ldpm_fmy_envd /end AXIS_DESCR
/end CHARACTERISTIC
/begin CHARACTERISTIC fmy_id_cur_h_vvl.envd "Freeze frame FRF_CUS_SET_SPC: environmental data contents for failure XX" CURVE 0xa1003dd0 _REC_CUR_20_u1_u1 254. _CNV_A_R_LINEAR_____0_CM 1. 255. DISPLAY_IDENTIFIER ID_ERR_ENVD_CUR_H_VVL FORMAT "%3.0"
 /begin AXIS_DESCR COM_AXIS errm_online_dummy _CNV_A_R_LINEAR_____0_CM 4 0. 255. FORMAT "%3.0" AXIS_PTS_REF ldpm_fmy_envd /end AXIS_DESCR
/end CHARACTERISTIC
/begin CHARACTERISTIC fmy_id_teg_pcat_down_1.envd "Freeze frame FRF_CUS_SET_SPC: environmental data contents for failure XX" CURVE 0xa1004d34 _REC_CUR_20_u1_u1 254. _CNV_A_R_LINEAR_____0_CM 1. 255. DISPLAY_IDENTIFIER ID_ERR_ENVD_TEG_PCAT_DOWN_1 FORMAT "%3.0"
 /begin AXIS_DESCR COM_AXIS errm_online_dummy _CNV_A_R_LINEAR_____0_CM 4 0. 255. FORMAT "%3.0" AXIS_PTS_REF ldpm_fmy_envd /end AXIS_DESCR
/end CHARACTERISTIC
/begin CHARACTERISTIC fmy_id_teg_pcat_down_2.envd "Freeze frame FRF_CUS_SET_SPC: environmental data contents for failure XX" CURVE 0xa1004d48 _REC_CUR_20_u1_u1 254. _CNV_A_R_LINEAR_____0_CM 1. 255. DISPLAY_IDENTIFIER ID_ERR_ENVD_TEG_PCAT_DOWN_2 FORMAT "%3.0"
 /begin AXIS_DESCR COM_AXIS errm_online_dummy _CNV_A_R_LINEAR_____0_CM 4 0. 255. FORMAT "%3.0" AXIS_PTS_REF ldpm_fmy_envd /end AXIS_DESCR
/end CHARACTERISTIC
/begin CHARACTERISTIC fmy_id_t_seg_er.envd "Freeze frame FRF_CUS_SET_SPC: environmental data contents for failure XX" CURVE 0xa1004c58 _REC_CUR_20_u1_u1 254. _CNV_A_R_LINEAR_____0_CM 1. 255. DISPLAY_IDENTIFIER ID_ERR_ENVD_T_SEG_ER FORMAT "%3.0"
 /begin AXIS_DESCR COM_AXIS errm_online_dummy _CNV_A_R_LINEAR_____0_CM 4 0. 255. FORMAT "%3.0" AXIS_PTS_REF ldpm_fmy_envd /end AXIS_DESCR
/end CHARACTERISTIC
/begin CHARACTERISTIC fmy_id_seg_ad_er.envd "Freeze frame FRF_CUS_SET_SPC: environmental data contents for failure XX" CURVE 0xa1004ab4 _REC_CUR_20_u1_u1 254. _CNV_A_R_LINEAR_____0_CM 1. 255. DISPLAY_IDENTIFIER ID_ERR_ENVD_SEG_AD_ER FORMAT "%3.0"
 /begin AXIS_DESCR COM_AXIS errm_online_dummy _CNV_A_R_LINEAR_____0_CM 4 0. 255. FORMAT "%3.0" AXIS_PTS_REF ldpm_fmy_envd /end AXIS_DESCR
/end CHARACTERISTIC
/begin CHARACTERISTIC fmy_id_vs_plaus.envd "Freeze frame FRF_CUS_SET_SPC: environmental data contents for failure XX" CURVE 0xa10050f4 _REC_CUR_20_u1_u1 254. _CNV_A_R_LINEAR_____0_CM 1. 255. DISPLAY_IDENTIFIER ID_ERR_ENVD_VS_PLAUS FORMAT "%3.0"
 /begin AXIS_DESCR COM_AXIS errm_online_dummy _CNV_A_R_LINEAR_____0_CM 4 0. 255. FORMAT "%3.0" AXIS_PTS_REF ldpm_fmy_envd /end AXIS_DESCR
/end CHARACTERISTIC
/begin CHARACTERISTIC fmy_id_ftl_obd.envd "Freeze frame FRF_CUS_SET_SPC: environmental data contents for failure XX" CURVE 0xa10040f0 _REC_CUR_20_u1_u1 254. _CNV_A_R_LINEAR_____0_CM 1. 255. DISPLAY_IDENTIFIER ID_ERR_ENVD_FTL_OBD FORMAT "%3.0"
 /begin AXIS_DESCR COM_AXIS errm_online_dummy _CNV_A_R_LINEAR_____0_CM 4 0. 255. FORMAT "%3.0" AXIS_PTS_REF ldpm_fmy_envd /end AXIS_DESCR
/end CHARACTERISTIC
/begin CHARACTERISTIC fmy_id_ftl_can.envd "Freeze frame FRF_CUS_SET_SPC: environmental data contents for failure XX" CURVE 0xa10040c8 _REC_CUR_20_u1_u1 254. _CNV_A_R_LINEAR_____0_CM 1. 255. DISPLAY_IDENTIFIER ID_ERR_ENVD_FTL_CAN FORMAT "%3.0"
 /begin AXIS_DESCR COM_AXIS errm_online_dummy _CNV_A_R_LINEAR_____0_CM 4 0. 255. FORMAT "%3.0" AXIS_PTS_REF ldpm_fmy_envd /end AXIS_DESCR
/end CHARACTERISTIC
/begin CHARACTERISTIC fmy_id_tia_plaus.envd "Freeze frame FRF_CUS_SET_SPC: environmental data contents for failure XX" CURVE 0xa1004d84 _REC_CUR_20_u1_u1 254. _CNV_A_R_LINEAR_____0_CM 1. 255. DISPLAY_IDENTIFIER ID_ERR_ENVD_TIA_PLAUS FORMAT "%3.0"
 /begin AXIS_DESCR COM_AXIS errm_online_dummy _CNV_A_R_LINEAR_____0_CM 4 0. 255. FORMAT "%3.0" AXIS_PTS_REF ldpm_fmy_envd /end AXIS_DESCR
/end CHARACTERISTIC
/begin CHARACTERISTIC fmy_id_tam_can.envd "Freeze frame FRF_CUS_SET_SPC: environmental data contents for failure XX" CURVE 0xa1004c6c _REC_CUR_20_u1_u1 254. _CNV_A_R_LINEAR_____0_CM 1. 255. DISPLAY_IDENTIFIER ID_ERR_ENVD_TAM_CAN FORMAT "%3.0"
 /begin AXIS_DESCR COM_AXIS errm_online_dummy _CNV_A_R_LINEAR_____0_CM 4 0. 255. FORMAT "%3.0" AXIS_PTS_REF ldpm_fmy_envd /end AXIS_DESCR
/end CHARACTERISTIC
/begin CHARACTERISTIC fmy_id_tam_plaus.envd "Freeze frame FRF_CUS_SET_SPC: environmental data contents for failure XX" CURVE 0xa1004c80 _REC_CUR_20_u1_u1 254. _CNV_A_R_LINEAR_____0_CM 1. 255. DISPLAY_IDENTIFIER ID_ERR_ENVD_TAM_PLAUS FORMAT "%3.0"
 /begin AXIS_DESCR COM_AXIS errm_online_dummy _CNV_A_R_LINEAR_____0_CM 4 0. 255. FORMAT "%3.0" AXIS_PTS_REF ldpm_fmy_envd /end AXIS_DESCR
/end CHARACTERISTIC
/begin CHARACTERISTIC fmy_id_map_dip_shift.envd "Freeze frame FRF_CUS_SET_SPC: environmental data contents for failure XX" CURVE 0xa100453c _REC_CUR_20_u1_u1 254. _CNV_A_R_LINEAR_____0_CM 1. 255. DISPLAY_IDENTIFIER ID_ERR_ENVD_MAP_DIP_SHIFT FORMAT "%3.0"
 /begin AXIS_DESCR COM_AXIS errm_online_dummy _CNV_A_R_LINEAR_____0_CM 4 0. 255. FORMAT "%3.0" AXIS_PTS_REF ldpm_fmy_envd /end AXIS_DESCR
/end CHARACTERISTIC
/begin CHARACTERISTIC fmy_id_cat_diag_1.envd "Freeze frame FRF_CUS_SET_SPC: environmental data contents for failure XX" CURVE 0xa1003c7c _REC_CUR_20_u1_u1 254. _CNV_A_R_LINEAR_____0_CM 1. 255. DISPLAY_IDENTIFIER ID_ERR_ENVD_CAT_DIAG_1 FORMAT "%3.0"
 /begin AXIS_DESCR COM_AXIS errm_online_dummy _CNV_A_R_LINEAR_____0_CM 4 0. 255. FORMAT "%3.0" AXIS_PTS_REF ldpm_fmy_envd /end AXIS_DESCR
/end CHARACTERISTIC
/begin CHARACTERISTIC fmy_id_cat_diag_2.envd "Freeze frame FRF_CUS_SET_SPC: environmental data contents for failure XX" CURVE 0xa1003c90 _REC_CUR_20_u1_u1 254. _CNV_A_R_LINEAR_____0_CM 1. 255. DISPLAY_IDENTIFIER ID_ERR_ENVD_CAT_DIAG_2 FORMAT "%3.0"
 /begin AXIS_DESCR COM_AXIS errm_online_dummy _CNV_A_R_LINEAR_____0_CM 4 0. 255. FORMAT "%3.0" AXIS_PTS_REF ldpm_fmy_envd /end AXIS_DESCR
/end CHARACTERISTIC
/begin CHARACTERISTIC fmy_id_cat_diag_afl_1.envd "Freeze frame FRF_CUS_SET_SPC: environmental data contents for failure XX" CURVE 0xa1003ca4 _REC_CUR_20_u1_u1 254. _CNV_A_R_LINEAR_____0_CM 1. 255. DISPLAY_IDENTIFIER ID_ERR_ENVD_CAT_DIAG_AFL_1 FORMAT "%3.0"
 /begin AXIS_DESCR COM_AXIS errm_online_dummy _CNV_A_R_LINEAR_____0_CM 4 0. 255. FORMAT "%3.0" AXIS_PTS_REF ldpm_fmy_envd /end AXIS_DESCR
/end CHARACTERISTIC
/begin CHARACTERISTIC fmy_id_cat_diag_afl_2.envd "Freeze frame FRF_CUS_SET_SPC: environmental data contents for failure XX" CURVE 0xa1003cb8 _REC_CUR_20_u1_u1 254. _CNV_A_R_LINEAR_____0_CM 1. 255. DISPLAY_IDENTIFIER ID_ERR_ENVD_CAT_DIAG_AFL_2 FORMAT "%3.0"
 /begin AXIS_DESCR COM_AXIS errm_online_dummy _CNV_A_R_LINEAR_____0_CM 4 0. 255. FORMAT "%3.0" AXIS_PTS_REF ldpm_fmy_envd /end AXIS_DESCR
/end CHARACTERISTIC
/begin CHARACTERISTIC fmy_id_scg_ls_down_1.envd "Freeze frame FRF_CUS_SET_SPC: environmental data contents for failure XX" CURVE 0xa1004a64 _REC_CUR_20_u1_u1 254. _CNV_A_R_LINEAR_____0_CM 1. 255. DISPLAY_IDENTIFIER ID_ERR_ENVD_SCG_LS_DOWN_1 FORMAT "%3.0"
 /begin AXIS_DESCR COM_AXIS errm_online_dummy _CNV_A_R_LINEAR_____0_CM 4 0. 255. FORMAT "%3.0" AXIS_PTS_REF ldpm_fmy_envd /end AXIS_DESCR
/end CHARACTERISTIC
/begin CHARACTERISTIC fmy_id_scp_ls_down_1.envd "Freeze frame FRF_CUS_SET_SPC: environmental data contents for failure XX" CURVE 0xa1004a8c _REC_CUR_20_u1_u1 254. _CNV_A_R_LINEAR_____0_CM 1. 255. DISPLAY_IDENTIFIER ID_ERR_ENVD_SCP_LS_DOWN_1 FORMAT "%3.0"
 /begin AXIS_DESCR COM_AXIS errm_online_dummy _CNV_A_R_LINEAR_____0_CM 4 0. 255. FORMAT "%3.0" AXIS_PTS_REF ldpm_fmy_envd /end AXIS_DESCR
/end CHARACTERISTIC
/begin CHARACTERISTIC fmy_id_oc_ls_down_1.envd "Freeze frame FRF_CUS_SET_SPC: environmental data contents for failure XX" CURVE 0xa1004780 _REC_CUR_20_u1_u1 254. _CNV_A_R_LINEAR_____0_CM 1. 255. DISPLAY_IDENTIFIER ID_ERR_ENVD_OC_LS_DOWN_1 FORMAT "%3.0"
 /begin AXIS_DESCR COM_AXIS errm_online_dummy _CNV_A_R_LINEAR_____0_CM 4 0. 255. FORMAT "%3.0" AXIS_PTS_REF ldpm_fmy_envd /end AXIS_DESCR
/end CHARACTERISTIC
/begin CHARACTERISTIC fmy_id_puc_ls_down_1.envd "Freeze frame FRF_CUS_SET_SPC: environmental data contents for failure XX" CURVE 0xa100485c _REC_CUR_20_u1_u1 254. _CNV_A_R_LINEAR_____0_CM 1. 255. DISPLAY_IDENTIFIER ID_ERR_ENVD_PUC_LS_DOWN_1 FORMAT "%3.0"
 /begin AXIS_DESCR COM_AXIS errm_online_dummy _CNV_A_R_LINEAR_____0_CM 4 0. 255. FORMAT "%3.0" AXIS_PTS_REF ldpm_fmy_envd /end AXIS_DESCR
/end CHARACTERISTIC
/begin CHARACTERISTIC fmy_id_fl_ls_down_1.envd "Freeze frame FRF_CUS_SET_SPC: environmental data contents for failure XX" CURVE 0xa1004078 _REC_CUR_20_u1_u1 254. _CNV_A_R_LINEAR_____0_CM 1. 255. DISPLAY_IDENTIFIER ID_ERR_ENVD_FL_LS_DOWN_1 FORMAT "%3.0"
 /begin AXIS_DESCR COM_AXIS errm_online_dummy _CNV_A_R_LINEAR_____0_CM 4 0. 255. FORMAT "%3.0" AXIS_PTS_REF ldpm_fmy_envd /end AXIS_DESCR
/end CHARACTERISTIC
/begin CHARACTERISTIC fmy_id_lsl_up_if_1.envd "Freeze frame FRF_CUS_SET_SPC: environmental data contents for failure XX" CURVE 0xa10044d8 _REC_CUR_20_u1_u1 254. _CNV_A_R_LINEAR_____0_CM 1. 255. DISPLAY_IDENTIFIER ID_ERR_ENVD_LSL_UP_IF_1 FORMAT "%3.0"
 /begin AXIS_DESCR COM_AXIS errm_online_dummy _CNV_A_R_LINEAR_____0_CM 4 0. 255. FORMAT "%3.0" AXIS_PTS_REF ldpm_fmy_envd /end AXIS_DESCR
/end CHARACTERISTIC
/begin CHARACTERISTIC fmy_id_el_lsl_up_1.envd "Freeze frame FRF_CUS_SET_SPC: environmental data contents for failure XX" CURVE 0xa1004050 _REC_CUR_20_u1_u1 254. _CNV_A_R_LINEAR_____0_CM 1. 255. DISPLAY_IDENTIFIER ID_ERR_ENVD_EL_LSL_UP_1 FORMAT "%3.0"
 /begin AXIS_DESCR COM_AXIS errm_online_dummy _CNV_A_R_LINEAR_____0_CM 4 0. 255. FORMAT "%3.0" AXIS_PTS_REF ldpm_fmy_envd /end AXIS_DESCR
/end CHARACTERISTIC
/begin CHARACTERISTIC fmy_id_lsh_up_1.envd "Freeze frame FRF_CUS_SET_SPC: environmental data contents for failure XX" CURVE 0xa10044b0 _REC_CUR_20_u1_u1 254. _CNV_A_R_LINEAR_____0_CM 1. 255. DISPLAY_IDENTIFIER ID_ERR_ENVD_LSH_UP_1 FORMAT "%3.0"
 /begin AXIS_DESCR COM_AXIS errm_online_dummy _CNV_A_R_LINEAR_____0_CM 4 0. 255. FORMAT "%3.0" AXIS_PTS_REF ldpm_fmy_envd /end AXIS_DESCR
/end CHARACTERISTIC
/begin CHARACTERISTIC fmy_id_lsh_down_1.envd "Freeze frame FRF_CUS_SET_SPC: environmental data contents for failure XX" CURVE 0xa1004460 _REC_CUR_20_u1_u1 254. _CNV_A_R_LINEAR_____0_CM 1. 255. DISPLAY_IDENTIFIER ID_ERR_ENVD_LSH_DOWN_1 FORMAT "%3.0"
 /begin AXIS_DESCR COM_AXIS errm_online_dummy _CNV_A_R_LINEAR_____0_CM 4 0. 255. FORMAT "%3.0" AXIS_PTS_REF ldpm_fmy_envd /end AXIS_DESCR
/end CHARACTERISTIC
/begin CHARACTERISTIC fmy_id_vls_down_dif_1.envd "Freeze frame FRF_CUS_SET_SPC: environmental data contents for failure XX" CURVE 0xa10050b8 _REC_CUR_20_u1_u1 254. _CNV_A_R_LINEAR_____0_CM 1. 255. DISPLAY_IDENTIFIER ID_ERR_ENVD_VLS_DOWN_DIF_1 FORMAT "%3.0"
 /begin AXIS_DESCR COM_AXIS errm_online_dummy _CNV_A_R_LINEAR_____0_CM 4 0. 255. FORMAT "%3.0" AXIS_PTS_REF ldpm_fmy_envd /end AXIS_DESCR
/end CHARACTERISTIC
/begin CHARACTERISTIC fmy_id_lsh_lsl_up_1.envd "Freeze frame FRF_CUS_SET_SPC: environmental data contents for failure XX" CURVE 0xa1004488 _REC_CUR_20_u1_u1 254. _CNV_A_R_LINEAR_____0_CM 1. 255. DISPLAY_IDENTIFIER ID_ERR_ENVD_LSH_LSL_UP_1 FORMAT "%3.0"
 /begin AXIS_DESCR COM_AXIS errm_online_dummy _CNV_A_R_LINEAR_____0_CM 4 0. 255. FORMAT "%3.0" AXIS_PTS_REF ldpm_fmy_envd /end AXIS_DESCR
/end CHARACTERISTIC
/begin CHARACTERISTIC fmy_id_air_lsl_up_1.envd "Freeze frame FRF_CUS_SET_SPC: environmental data contents for failure XX" CURVE 0xa1003920 _REC_CUR_20_u1_u1 254. _CNV_A_R_LINEAR_____0_CM 1. 255. DISPLAY_IDENTIFIER ID_ERR_ENVD_AIR_LSL_UP_1 FORMAT "%3.0"
 /begin AXIS_DESCR COM_AXIS errm_online_dummy _CNV_A_R_LINEAR_____0_CM 4 0. 255. FORMAT "%3.0" AXIS_PTS_REF ldpm_fmy_envd /end AXIS_DESCR
/end CHARACTERISTIC
/begin CHARACTERISTIC fmy_id_pue_ls_down_1.envd "Freeze frame FRF_CUS_SET_SPC: environmental data contents for failure XX" CURVE 0xa10048ac _REC_CUR_20_u1_u1 254. _CNV_A_R_LINEAR_____0_CM 1. 255. DISPLAY_IDENTIFIER ID_ERR_ENVD_PUE_LS_DOWN_1 FORMAT "%3.0"
 /begin AXIS_DESCR COM_AXIS errm_online_dummy _CNV_A_R_LINEAR_____0_CM 4 0. 255. FORMAT "%3.0" AXIS_PTS_REF ldpm_fmy_envd /end AXIS_DESCR
/end CHARACTERISTIC
/begin CHARACTERISTIC fmy_id_swt_ls_down_1.envd "Freeze frame FRF_CUS_SET_SPC: environmental data contents for failure XX" CURVE 0xa1004bcc _REC_CUR_20_u1_u1 254. _CNV_A_R_LINEAR_____0_CM 1. 255. DISPLAY_IDENTIFIER ID_ERR_ENVD_SWT_LS_DOWN_1 FORMAT "%3.0"
 /begin AXIS_DESCR COM_AXIS errm_online_dummy _CNV_A_R_LINEAR_____0_CM 4 0. 255. FORMAT "%3.0" AXIS_PTS_REF ldpm_fmy_envd /end AXIS_DESCR
/end CHARACTERISTIC
/begin CHARACTERISTIC fmy_id_obd_lsh_down_1.envd "Freeze frame FRF_CUS_SET_SPC: environmental data contents for failure XX" CURVE 0xa1004730 _REC_CUR_20_u1_u1 254. _CNV_A_R_LINEAR_____0_CM 1. 255. DISPLAY_IDENTIFIER ID_ERR_ENVD_OBD_LSH_DOWN_1 FORMAT "%3.0"
 /begin AXIS_DESCR COM_AXIS errm_online_dummy _CNV_A_R_LINEAR_____0_CM 4 0. 255. FORMAT "%3.0" AXIS_PTS_REF ldpm_fmy_envd /end AXIS_DESCR
/end CHARACTERISTIC
/begin CHARACTERISTIC fmy_id_dyn_vld_ls_up_1.envd "Freeze frame FRF_CUS_SET_SPC: environmental data contents for failure XX" CURVE 0xa1003efc _REC_CUR_20_u1_u1 254. _CNV_A_R_LINEAR_____0_CM 1. 255. DISPLAY_IDENTIFIER ID_ERR_ENVD_DYN_VLD_LS_UP_1 FORMAT "%3.0"
 /begin AXIS_DESCR COM_AXIS errm_online_dummy _CNV_A_R_LINEAR_____0_CM 4 0. 255. FORMAT "%3.0" AXIS_PTS_REF ldpm_fmy_envd /end AXIS_DESCR
/end CHARACTERISTIC
/begin CHARACTERISTIC fmy_id_puc_vld_ls_up_1.envd "Freeze frame FRF_CUS_SET_SPC: environmental data contents for failure XX" CURVE 0xa1004884 _REC_CUR_20_u1_u1 254. _CNV_A_R_LINEAR_____0_CM 1. 255. DISPLAY_IDENTIFIER ID_ERR_ENVD_PUC_VLD_LS_UP_1 FORMAT "%3.0"
 /begin AXIS_DESCR COM_AXIS errm_online_dummy _CNV_A_R_LINEAR_____0_CM 4 0. 255. FORMAT "%3.0" AXIS_PTS_REF ldpm_fmy_envd /end AXIS_DESCR
/end CHARACTERISTIC
/begin CHARACTERISTIC fmy_id_obd_vld_lsh_up_1.envd "Freeze frame FRF_CUS_SET_SPC: environmental data contents for failure XX" CURVE 0xa1004758 _REC_CUR_20_u1_u1 254. _CNV_A_R_LINEAR_____0_CM 1. 255. DISPLAY_IDENTIFIER ID_ERR_ENVD_OBD_VLD_LSH_UP_1 FORMAT "%3.0"
 /begin AXIS_DESCR COM_AXIS errm_online_dummy _CNV_A_R_LINEAR_____0_CM 4 0. 255. FORMAT "%3.0" AXIS_PTS_REF ldpm_fmy_envd /end AXIS_DESCR
/end CHARACTERISTIC
/begin CHARACTERISTIC fmy_id_chk_ls_down_1.envd "Freeze frame FRF_CUS_SET_SPC: environmental data contents for failure XX" CURVE 0xa1003d08 _REC_CUR_20_u1_u1 254. _CNV_A_R_LINEAR_____0_CM 1. 255. DISPLAY_IDENTIFIER ID_ERR_ENVD_CHK_LS_DOWN_1 FORMAT "%3.0"
 /begin AXIS_DESCR COM_AXIS errm_online_dummy _CNV_A_R_LINEAR_____0_CM 4 0. 255. FORMAT "%3.0" AXIS_PTS_REF ldpm_fmy_envd /end AXIS_DESCR
/end CHARACTERISTIC
/begin CHARACTERISTIC fmy_id_shift_afl_lsl_up_1.envd "Freeze frame FRF_CUS_SET_SPC: environmental data contents for failure XX" CURVE 0xa1004af0 _REC_CUR_20_u1_u1 254. _CNV_A_R_LINEAR_____0_CM 1. 255. DISPLAY_IDENTIFIER ID_ERR_ENVD_SHIFT_AFL_LSL_UP_1 FORMAT "%3.0"
 /begin AXIS_DESCR COM_AXIS errm_online_dummy _CNV_A_R_LINEAR_____0_CM 4 0. 255. FORMAT "%3.0" AXIS_PTS_REF ldpm_fmy_envd /end AXIS_DESCR
/end CHARACTERISTIC
/begin CHARACTERISTIC fmy_id_shift_afr_lsl_up_1.envd "Freeze frame FRF_CUS_SET_SPC: environmental data contents for failure XX" CURVE 0xa1004b18 _REC_CUR_20_u1_u1 254. _CNV_A_R_LINEAR_____0_CM 1. 255. DISPLAY_IDENTIFIER ID_ERR_ENVD_SHIFT_AFR_LSL_UP_1 FORMAT "%3.0"
 /begin AXIS_DESCR COM_AXIS errm_online_dummy _CNV_A_R_LINEAR_____0_CM 4 0. 255. FORMAT "%3.0" AXIS_PTS_REF ldpm_fmy_envd /end AXIS_DESCR
/end CHARACTERISTIC
/begin CHARACTERISTIC fmy_id_oc_lsl_up_1.envd "Freeze frame FRF_CUS_SET_SPC: environmental data contents for failure XX" CURVE 0xa10047a8 _REC_CUR_20_u1_u1 254. _CNV_A_R_LINEAR_____0_CM 1. 255. DISPLAY_IDENTIFIER ID_ERR_ENVD_OC_LSL_UP_1 FORMAT "%3.0"
 /begin AXIS_DESCR COM_AXIS errm_online_dummy _CNV_A_R_LINEAR_____0_CM 4 0. 255. FORMAT "%3.0" AXIS_PTS_REF ldpm_fmy_envd /end AXIS_DESCR
/end CHARACTERISTIC
/begin CHARACTERISTIC fmy_id_delta_i_lam_1.envd "Freeze frame FRF_CUS_SET_SPC: environmental data contents for failure XX" CURVE 0xa1003e5c _REC_CUR_20_u1_u1 254. _CNV_A_R_LINEAR_____0_CM 1. 255. DISPLAY_IDENTIFIER ID_ERR_ENVD_DELTA_I_LAM_1 FORMAT "%3.0"
 /begin AXIS_DESCR COM_AXIS errm_online_dummy _CNV_A_R_LINEAR_____0_CM 4 0. 255. FORMAT "%3.0" AXIS_PTS_REF ldpm_fmy_envd /end AXIS_DESCR
/end CHARACTERISTIC
/begin CHARACTERISTIC fmy_id_rgn_nt_ls_down_1.envd "Freeze frame FRF_CUS_SET_SPC: environmental data contents for failure XX" CURVE 0xa100499c _REC_CUR_20_u1_u1 254. _CNV_A_R_LINEAR_____0_CM 1. 255. DISPLAY_IDENTIFIER ID_ERR_ENVD_RGN_NT_LS_DOWN_1 FORMAT "%3.0"
 /begin AXIS_DESCR COM_AXIS errm_online_dummy _CNV_A_R_LINEAR_____0_CM 4 0. 255. FORMAT "%3.0" AXIS_PTS_REF ldpm_fmy_envd /end AXIS_DESCR
/end CHARACTERISTIC
/begin CHARACTERISTIC fmy_id_chg_ls_down.envd "Freeze frame FRF_CUS_SET_SPC: environmental data contents for failure XX" CURVE 0xa1003ccc _REC_CUR_20_u1_u1 254. _CNV_A_R_LINEAR_____0_CM 1. 255. DISPLAY_IDENTIFIER ID_ERR_ENVD_CHG_LS_DOWN FORMAT "%3.0"
 /begin AXIS_DESCR COM_AXIS errm_online_dummy _CNV_A_R_LINEAR_____0_CM 4 0. 255. FORMAT "%3.0" AXIS_PTS_REF ldpm_fmy_envd /end AXIS_DESCR
/end CHARACTERISTIC
/begin CHARACTERISTIC fmy_id_scg_ls_down_2.envd "Freeze frame FRF_CUS_SET_SPC: environmental data contents for failure XX" CURVE 0xa1004a78 _REC_CUR_20_u1_u1 254. _CNV_A_R_LINEAR_____0_CM 1. 255. DISPLAY_IDENTIFIER ID_ERR_ENVD_SCG_LS_DOWN_2 FORMAT "%3.0"
 /begin AXIS_DESCR COM_AXIS errm_online_dummy _CNV_A_R_LINEAR_____0_CM 4 0. 255. FORMAT "%3.0" AXIS_PTS_REF ldpm_fmy_envd /end AXIS_DESCR
/end CHARACTERISTIC
/begin CHARACTERISTIC fmy_id_scp_ls_down_2.envd "Freeze frame FRF_CUS_SET_SPC: environmental data contents for failure XX" CURVE 0xa1004aa0 _REC_CUR_20_u1_u1 254. _CNV_A_R_LINEAR_____0_CM 1. 255. DISPLAY_IDENTIFIER ID_ERR_ENVD_SCP_LS_DOWN_2 FORMAT "%3.0"
 /begin AXIS_DESCR COM_AXIS errm_online_dummy _CNV_A_R_LINEAR_____0_CM 4 0. 255. FORMAT "%3.0" AXIS_PTS_REF ldpm_fmy_envd /end AXIS_DESCR
/end CHARACTERISTIC
/begin CHARACTERISTIC fmy_id_oc_ls_down_2.envd "Freeze frame FRF_CUS_SET_SPC: environmental data contents for failure XX" CURVE 0xa1004794 _REC_CUR_20_u1_u1 254. _CNV_A_R_LINEAR_____0_CM 1. 255. DISPLAY_IDENTIFIER ID_ERR_ENVD_OC_LS_DOWN_2 FORMAT "%3.0"
 /begin AXIS_DESCR COM_AXIS errm_online_dummy _CNV_A_R_LINEAR_____0_CM 4 0. 255. FORMAT "%3.0" AXIS_PTS_REF ldpm_fmy_envd /end AXIS_DESCR
/end CHARACTERISTIC
/begin CHARACTERISTIC fmy_id_puc_ls_down_2.envd "Freeze frame FRF_CUS_SET_SPC: environmental data contents for failure XX" CURVE 0xa1004870 _REC_CUR_20_u1_u1 254. _CNV_A_R_LINEAR_____0_CM 1. 255. DISPLAY_IDENTIFIER ID_ERR_ENVD_PUC_LS_DOWN_2 FORMAT "%3.0"
 /begin AXIS_DESCR COM_AXIS errm_online_dummy _CNV_A_R_LINEAR_____0_CM 4 0. 255. FORMAT "%3.0" AXIS_PTS_REF ldpm_fmy_envd /end AXIS_DESCR
/end CHARACTERISTIC
/begin CHARACTERISTIC fmy_id_fl_ls_down_2.envd "Freeze frame FRF_CUS_SET_SPC: environmental data contents for failure XX" CURVE 0xa100408c _REC_CUR_20_u1_u1 254. _CNV_A_R_LINEAR_____0_CM 1. 255. DISPLAY_IDENTIFIER ID_ERR_ENVD_FL_LS_DOWN_2 FORMAT "%3.0"
 /begin AXIS_DESCR COM_AXIS errm_online_dummy _CNV_A_R_LINEAR_____0_CM 4 0. 255. FORMAT "%3.0" AXIS_PTS_REF ldpm_fmy_envd /end AXIS_DESCR
/end CHARACTERISTIC
/begin CHARACTERISTIC fmy_id_lsl_up_if_2.envd "Freeze frame FRF_CUS_SET_SPC: environmental data contents for failure XX" CURVE 0xa10044ec _REC_CUR_20_u1_u1 254. _CNV_A_R_LINEAR_____0_CM 1. 255. DISPLAY_IDENTIFIER ID_ERR_ENVD_LSL_UP_IF_2 FORMAT "%3.0"
 /begin AXIS_DESCR COM_AXIS errm_online_dummy _CNV_A_R_LINEAR_____0_CM 4 0. 255. FORMAT "%3.0" AXIS_PTS_REF ldpm_fmy_envd /end AXIS_DESCR
/end CHARACTERISTIC
/begin CHARACTERISTIC fmy_id_el_lsl_up_2.envd "Freeze frame FRF_CUS_SET_SPC: environmental data contents for failure XX" CURVE 0xa1004064 _REC_CUR_20_u1_u1 254. _CNV_A_R_LINEAR_____0_CM 1. 255. DISPLAY_IDENTIFIER ID_ERR_ENVD_EL_LSL_UP_2 FORMAT "%3.0"
 /begin AXIS_DESCR COM_AXIS errm_online_dummy _CNV_A_R_LINEAR_____0_CM 4 0. 255. FORMAT "%3.0" AXIS_PTS_REF ldpm_fmy_envd /end AXIS_DESCR
/end CHARACTERISTIC
/begin CHARACTERISTIC fmy_id_lsh_up_2.envd "Freeze frame FRF_CUS_SET_SPC: environmental data contents for failure XX" CURVE 0xa10044c4 _REC_CUR_20_u1_u1 254. _CNV_A_R_LINEAR_____0_CM 1. 255. DISPLAY_IDENTIFIER ID_ERR_ENVD_LSH_UP_2 FORMAT "%3.0"
 /begin AXIS_DESCR COM_AXIS errm_online_dummy _CNV_A_R_LINEAR_____0_CM 4 0. 255. FORMAT "%3.0" AXIS_PTS_REF ldpm_fmy_envd /end AXIS_DESCR
/end CHARACTERISTIC
/begin CHARACTERISTIC fmy_id_lsh_down_2.envd "Freeze frame FRF_CUS_SET_SPC: environmental data contents for failure XX" CURVE 0xa1004474 _REC_CUR_20_u1_u1 254. _CNV_A_R_LINEAR_____0_CM 1. 255. DISPLAY_IDENTIFIER ID_ERR_ENVD_LSH_DOWN_2 FORMAT "%3.0"
 /begin AXIS_DESCR COM_AXIS errm_online_dummy _CNV_A_R_LINEAR_____0_CM 4 0. 255. FORMAT "%3.0" AXIS_PTS_REF ldpm_fmy_envd /end AXIS_DESCR
/end CHARACTERISTIC
/begin CHARACTERISTIC fmy_id_vls_down_dif_2.envd "Freeze frame FRF_CUS_SET_SPC: environmental data contents for failure XX" CURVE 0xa10050cc _REC_CUR_20_u1_u1 254. _CNV_A_R_LINEAR_____0_CM 1. 255. DISPLAY_IDENTIFIER ID_ERR_ENVD_VLS_DOWN_DIF_2 FORMAT "%3.0"
 /begin AXIS_DESCR COM_AXIS errm_online_dummy _CNV_A_R_LINEAR_____0_CM 4 0. 255. FORMAT "%3.0" AXIS_PTS_REF ldpm_fmy_envd /end AXIS_DESCR
/end CHARACTERISTIC
/begin CHARACTERISTIC fmy_id_lsh_lsl_up_2.envd "Freeze frame FRF_CUS_SET_SPC: environmental data contents for failure XX" CURVE 0xa100449c _REC_CUR_20_u1_u1 254. _CNV_A_R_LINEAR_____0_CM 1. 255. DISPLAY_IDENTIFIER ID_ERR_ENVD_LSH_LSL_UP_2 FORMAT "%3.0"
 /begin AXIS_DESCR COM_AXIS errm_online_dummy _CNV_A_R_LINEAR_____0_CM 4 0. 255. FORMAT "%3.0" AXIS_PTS_REF ldpm_fmy_envd /end AXIS_DESCR
/end CHARACTERISTIC
/begin CHARACTERISTIC fmy_id_air_lsl_up_2.envd "Freeze frame FRF_CUS_SET_SPC: environmental data contents for failure XX" CURVE 0xa1003934 _REC_CUR_20_u1_u1 254. _CNV_A_R_LINEAR_____0_CM 1. 255. DISPLAY_IDENTIFIER ID_ERR_ENVD_AIR_LSL_UP_2 FORMAT "%3.0"
 /begin AXIS_DESCR COM_AXIS errm_online_dummy _CNV_A_R_LINEAR_____0_CM 4 0. 255. FORMAT "%3.0" AXIS_PTS_REF ldpm_fmy_envd /end AXIS_DESCR
/end CHARACTERISTIC
/begin CHARACTERISTIC fmy_id_pue_ls_down_2.envd "Freeze frame FRF_CUS_SET_SPC: environmental data contents for failure XX" CURVE 0xa10048c0 _REC_CUR_20_u1_u1 254. _CNV_A_R_LINEAR_____0_CM 1. 255. DISPLAY_IDENTIFIER ID_ERR_ENVD_PUE_LS_DOWN_2 FORMAT "%3.0"
 /begin AXIS_DESCR COM_AXIS errm_online_dummy _CNV_A_R_LINEAR_____0_CM 4 0. 255. FORMAT "%3.0" AXIS_PTS_REF ldpm_fmy_envd /end AXIS_DESCR
/end CHARACTERISTIC
/begin CHARACTERISTIC fmy_id_swt_ls_down_2.envd "Freeze frame FRF_CUS_SET_SPC: environmental data contents for failure XX" CURVE 0xa1004be0 _REC_CUR_20_u1_u1 254. _CNV_A_R_LINEAR_____0_CM 1. 255. DISPLAY_IDENTIFIER ID_ERR_ENVD_SWT_LS_DOWN_2 FORMAT "%3.0"
 /begin AXIS_DESCR COM_AXIS errm_online_dummy _CNV_A_R_LINEAR_____0_CM 4 0. 255. FORMAT "%3.0" AXIS_PTS_REF ldpm_fmy_envd /end AXIS_DESCR
/end CHARACTERISTIC
/begin CHARACTERISTIC fmy_id_obd_lsh_down_2.envd "Freeze frame FRF_CUS_SET_SPC: environmental data contents for failure XX" CURVE 0xa1004744 _REC_CUR_20_u1_u1 254. _CNV_A_R_LINEAR_____0_CM 1. 255. DISPLAY_IDENTIFIER ID_ERR_ENVD_OBD_LSH_DOWN_2 FORMAT "%3.0"
 /begin AXIS_DESCR COM_AXIS errm_online_dummy _CNV_A_R_LINEAR_____0_CM 4 0. 255. FORMAT "%3.0" AXIS_PTS_REF ldpm_fmy_envd /end AXIS_DESCR
/end CHARACTERISTIC
/begin CHARACTERISTIC fmy_id_dyn_vld_ls_up_2.envd "Freeze frame FRF_CUS_SET_SPC: environmental data contents for failure XX" CURVE 0xa1003f10 _REC_CUR_20_u1_u1 254. _CNV_A_R_LINEAR_____0_CM 1. 255. DISPLAY_IDENTIFIER ID_ERR_ENVD_DYN_VLD_LS_UP_2 FORMAT "%3.0"
 /begin AXIS_DESCR COM_AXIS errm_online_dummy _CNV_A_R_LINEAR_____0_CM 4 0. 255. FORMAT "%3.0" AXIS_PTS_REF ldpm_fmy_envd /end AXIS_DESCR
/end CHARACTERISTIC
/begin CHARACTERISTIC fmy_id_puc_vld_ls_up_2.envd "Freeze frame FRF_CUS_SET_SPC: environmental data contents for failure XX" CURVE 0xa1004898 _REC_CUR_20_u1_u1 254. _CNV_A_R_LINEAR_____0_CM 1. 255. DISPLAY_IDENTIFIER ID_ERR_ENVD_PUC_VLD_LS_UP_2 FORMAT "%3.0"
 /begin AXIS_DESCR COM_AXIS errm_online_dummy _CNV_A_R_LINEAR_____0_CM 4 0. 255. FORMAT "%3.0" AXIS_PTS_REF ldpm_fmy_envd /end AXIS_DESCR
/end CHARACTERISTIC
/begin CHARACTERISTIC fmy_id_obd_vld_lsh_up_2.envd "Freeze frame FRF_CUS_SET_SPC: environmental data contents for failure XX" CURVE 0xa100476c _REC_CUR_20_u1_u1 254. _CNV_A_R_LINEAR_____0_CM 1. 255. DISPLAY_IDENTIFIER ID_ERR_ENVD_OBD_VLD_LSH_UP_2 FORMAT "%3.0"
 /begin AXIS_DESCR COM_AXIS errm_online_dummy _CNV_A_R_LINEAR_____0_CM 4 0. 255. FORMAT "%3.0" AXIS_PTS_REF ldpm_fmy_envd /end AXIS_DESCR
/end CHARACTERISTIC
/begin CHARACTERISTIC fmy_id_chk_ls_down_2.envd "Freeze frame FRF_CUS_SET_SPC: environmental data contents for failure XX" CURVE 0xa1003d1c _REC_CUR_20_u1_u1 254. _CNV_A_R_LINEAR_____0_CM 1. 255. DISPLAY_IDENTIFIER ID_ERR_ENVD_CHK_LS_DOWN_2 FORMAT "%3.0"
 /begin AXIS_DESCR COM_AXIS errm_online_dummy _CNV_A_R_LINEAR_____0_CM 4 0. 255. FORMAT "%3.0" AXIS_PTS_REF ldpm_fmy_envd /end AXIS_DESCR
/end CHARACTERISTIC
/begin CHARACTERISTIC fmy_id_shift_afl_lsl_up_2.envd "Freeze frame FRF_CUS_SET_SPC: environmental data contents for failure XX" CURVE 0xa1004b04 _REC_CUR_20_u1_u1 254. _CNV_A_R_LINEAR_____0_CM 1. 255. DISPLAY_IDENTIFIER ID_ERR_ENVD_SHIFT_AFL_LSL_UP_2 FORMAT "%3.0"
 /begin AXIS_DESCR COM_AXIS errm_online_dummy _CNV_A_R_LINEAR_____0_CM 4 0. 255. FORMAT "%3.0" AXIS_PTS_REF ldpm_fmy_envd /end AXIS_DESCR
/end CHARACTERISTIC
/begin CHARACTERISTIC fmy_id_shift_afr_lsl_up_2.envd "Freeze frame FRF_CUS_SET_SPC: environmental data contents for failure XX" CURVE 0xa1004b2c _REC_CUR_20_u1_u1 254. _CNV_A_R_LINEAR_____0_CM 1. 255. DISPLAY_IDENTIFIER ID_ERR_ENVD_SHIFT_AFR_LSL_UP_2 FORMAT "%3.0"
 /begin AXIS_DESCR COM_AXIS errm_online_dummy _CNV_A_R_LINEAR_____0_CM 4 0. 255. FORMAT "%3.0" AXIS_PTS_REF ldpm_fmy_envd /end AXIS_DESCR
/end CHARACTERISTIC
/begin CHARACTERISTIC fmy_id_oc_lsl_up_2.envd "Freeze frame FRF_CUS_SET_SPC: environmental data contents for failure XX" CURVE 0xa10047bc _REC_CUR_20_u1_u1 254. _CNV_A_R_LINEAR_____0_CM 1. 255. DISPLAY_IDENTIFIER ID_ERR_ENVD_OC_LSL_UP_2 FORMAT "%3.0"
 /begin AXIS_DESCR COM_AXIS errm_online_dummy _CNV_A_R_LINEAR_____0_CM 4 0. 255. FORMAT "%3.0" AXIS_PTS_REF ldpm_fmy_envd /end AXIS_DESCR
/end CHARACTERISTIC
/begin CHARACTERISTIC fmy_id_delta_i_lam_2.envd "Freeze frame FRF_CUS_SET_SPC: environmental data contents for failure XX" CURVE 0xa1003e70 _REC_CUR_20_u1_u1 254. _CNV_A_R_LINEAR_____0_CM 1. 255. DISPLAY_IDENTIFIER ID_ERR_ENVD_DELTA_I_LAM_2 FORMAT "%3.0"
 /begin AXIS_DESCR COM_AXIS errm_online_dummy _CNV_A_R_LINEAR_____0_CM 4 0. 255. FORMAT "%3.0" AXIS_PTS_REF ldpm_fmy_envd /end AXIS_DESCR
/end CHARACTERISTIC
/begin CHARACTERISTIC fmy_id_rgn_nt_ls_down_2.envd "Freeze frame FRF_CUS_SET_SPC: environmental data contents for failure XX" CURVE 0xa10049b0 _REC_CUR_20_u1_u1 254. _CNV_A_R_LINEAR_____0_CM 1. 255. DISPLAY_IDENTIFIER ID_ERR_ENVD_RGN_NT_LS_DOWN_2 FORMAT "%3.0"
 /begin AXIS_DESCR COM_AXIS errm_online_dummy _CNV_A_R_LINEAR_____0_CM 4 0. 255. FORMAT "%3.0" AXIS_PTS_REF ldpm_fmy_envd /end AXIS_DESCR
/end CHARACTERISTIC
/begin CHARACTERISTIC fmy_id_chg_ls_up.envd "Freeze frame FRF_CUS_SET_SPC: environmental data contents for failure XX" CURVE 0xa1003ce0 _REC_CUR_20_u1_u1 254. _CNV_A_R_LINEAR_____0_CM 1. 255. DISPLAY_IDENTIFIER ID_ERR_ENVD_CHG_LS_UP FORMAT "%3.0"
 /begin AXIS_DESCR COM_AXIS errm_online_dummy _CNV_A_R_LINEAR_____0_CM 4 0. 255. FORMAT "%3.0" AXIS_PTS_REF ldpm_fmy_envd /end AXIS_DESCR
/end CHARACTERISTIC
/begin CHARACTERISTIC fmy_id_alter_com.envd "Freeze frame FRF_CUS_SET_SPC: environmental data contents for failure XX" CURVE 0xa1003984 _REC_CUR_20_u1_u1 254. _CNV_A_R_LINEAR_____0_CM 1. 255. DISPLAY_IDENTIFIER ID_ERR_ENVD_ALTER_COM FORMAT "%3.0"
 /begin AXIS_DESCR COM_AXIS errm_online_dummy _CNV_A_R_LINEAR_____0_CM 4 0. 255. FORMAT "%3.0" AXIS_PTS_REF ldpm_fmy_envd /end AXIS_DESCR
/end CHARACTERISTIC
/begin CHARACTERISTIC fmy_id_cwp_com.envd "Freeze frame FRF_CUS_SET_SPC: environmental data contents for failure XX" CURVE 0xa1003de4 _REC_CUR_20_u1_u1 254. _CNV_A_R_LINEAR_____0_CM 1. 255. DISPLAY_IDENTIFIER ID_ERR_ENVD_CWP_COM FORMAT "%3.0"
 /begin AXIS_DESCR COM_AXIS errm_online_dummy _CNV_A_R_LINEAR_____0_CM 4 0. 255. FORMAT "%3.0" AXIS_PTS_REF ldpm_fmy_envd /end AXIS_DESCR
/end CHARACTERISTIC
/begin CHARACTERISTIC fmy_id_qoil_com.envd "Freeze frame FRF_CUS_SET_SPC: environmental data contents for failure XX" CURVE 0xa100494c _REC_CUR_20_u1_u1 254. _CNV_A_R_LINEAR_____0_CM 1. 255. DISPLAY_IDENTIFIER ID_ERR_ENVD_QOIL_COM FORMAT "%3.0"
 /begin AXIS_DESCR COM_AXIS errm_online_dummy _CNV_A_R_LINEAR_____0_CM 4 0. 255. FORMAT "%3.0" AXIS_PTS_REF ldpm_fmy_envd /end AXIS_DESCR
/end CHARACTERISTIC
/begin CHARACTERISTIC fmy_id_sens_bat_smt_com.envd "Freeze frame FRF_CUS_SET_SPC: environmental data contents for failure XX" CURVE 0xa1004adc _REC_CUR_20_u1_u1 254. _CNV_A_R_LINEAR_____0_CM 1. 255. DISPLAY_IDENTIFIER ID_ERR_ENVD_SENS_BAT_SMT_COM FORMAT "%3.0"
 /begin AXIS_DESCR COM_AXIS errm_online_dummy _CNV_A_R_LINEAR_____0_CM 4 0. 255. FORMAT "%3.0" AXIS_PTS_REF ldpm_fmy_envd /end AXIS_DESCR
/end CHARACTERISTIC
/begin CHARACTERISTIC fmy_id_ecraspwm_fb.envd "Freeze frame FRF_CUS_SET_SPC: environmental data contents for failure XX" CURVE 0xa1003f74 _REC_CUR_20_u1_u1 254. _CNV_A_R_LINEAR_____0_CM 1. 255. DISPLAY_IDENTIFIER ID_ERR_ENVD_ECRASPWM_FB FORMAT "%3.0"
 /begin AXIS_DESCR COM_AXIS errm_online_dummy _CNV_A_R_LINEAR_____0_CM 4 0. 255. FORMAT "%3.0" AXIS_PTS_REF ldpm_fmy_envd /end AXIS_DESCR
/end CHARACTERISTIC
/begin CHARACTERISTIC fmy_id_ecras_el.envd "Freeze frame FRF_CUS_SET_SPC: environmental data contents for failure XX" CURVE 0xa1003f60 _REC_CUR_20_u1_u1 254. _CNV_A_R_LINEAR_____0_CM 1. 255. DISPLAY_IDENTIFIER ID_ERR_ENVD_ECRAS_EL FORMAT "%3.0"
 /begin AXIS_DESCR COM_AXIS errm_online_dummy _CNV_A_R_LINEAR_____0_CM 4 0. 255. FORMAT "%3.0" AXIS_PTS_REF ldpm_fmy_envd /end AXIS_DESCR
/end CHARACTERISTIC
/begin CHARACTERISTIC fmy_id_warm_rst.envd "Freeze frame FRF_CUS_SET_SPC: environmental data contents for failure XX" CURVE 0xa100511c _REC_CUR_20_u1_u1 254. _CNV_A_R_LINEAR_____0_CM 1. 255. DISPLAY_IDENTIFIER ID_ERR_ENVD_WARM_RST FORMAT "%3.0"
 /begin AXIS_DESCR COM_AXIS errm_online_dummy _CNV_A_R_LINEAR_____0_CM 4 0. 255. FORMAT "%3.0" AXIS_PTS_REF ldpm_fmy_envd /end AXIS_DESCR
/end CHARACTERISTIC
/begin CHARACTERISTIC fmy_id_acr_ad.envd "Freeze frame FRF_CUS_SET_SPC: environmental data contents for failure XX" CURVE 0xa10038e4 _REC_CUR_20_u1_u1 254. _CNV_A_R_LINEAR_____0_CM 1. 255. DISPLAY_IDENTIFIER ID_ERR_ENVD_ACR_AD FORMAT "%3.0"
 /begin AXIS_DESCR COM_AXIS errm_online_dummy _CNV_A_R_LINEAR_____0_CM 4 0. 255. FORMAT "%3.0" AXIS_PTS_REF ldpm_fmy_envd /end AXIS_DESCR
/end CHARACTERISTIC
/begin CHARACTERISTIC fmy_id_sens_acr.envd "Freeze frame FRF_CUS_SET_SPC: environmental data contents for failure XX" CURVE 0xa1004ac8 _REC_CUR_20_u1_u1 254. _CNV_A_R_LINEAR_____0_CM 1. 255. DISPLAY_IDENTIFIER ID_ERR_ENVD_SENS_ACR FORMAT "%3.0"
 /begin AXIS_DESCR COM_AXIS errm_online_dummy _CNV_A_R_LINEAR_____0_CM 4 0. 255. FORMAT "%3.0" AXIS_PTS_REF ldpm_fmy_envd /end AXIS_DESCR
/end CHARACTERISTIC
/begin CHARACTERISTIC fmy_id_acr_ctl.envd "Freeze frame FRF_CUS_SET_SPC: environmental data contents for failure XX" CURVE 0xa10038f8 _REC_CUR_20_u1_u1 254. _CNV_A_R_LINEAR_____0_CM 1. 255. DISPLAY_IDENTIFIER ID_ERR_ENVD_ACR_CTL FORMAT "%3.0"
 /begin AXIS_DESCR COM_AXIS errm_online_dummy _CNV_A_R_LINEAR_____0_CM 4 0. 255. FORMAT "%3.0" AXIS_PTS_REF ldpm_fmy_envd /end AXIS_DESCR
/end CHARACTERISTIC
/begin CHARACTERISTIC fmy_id_acr_dr.envd "Freeze frame FRF_CUS_SET_SPC: environmental data contents for failure XX" CURVE 0xa100390c _REC_CUR_20_u1_u1 254. _CNV_A_R_LINEAR_____0_CM 1. 255. DISPLAY_IDENTIFIER ID_ERR_ENVD_ACR_DR FORMAT "%3.0"
 /begin AXIS_DESCR COM_AXIS errm_online_dummy _CNV_A_R_LINEAR_____0_CM 4 0. 255. FORMAT "%3.0" AXIS_PTS_REF ldpm_fmy_envd /end AXIS_DESCR
/end CHARACTERISTIC
/begin CHARACTERISTIC fmy_id_var_cod.envd "Freeze frame FRF_CUS_SET_SPC: environmental data contents for failure XX" CURVE 0xa1005004 _REC_CUR_20_u1_u1 254. _CNV_A_R_LINEAR_____0_CM 1. 255. DISPLAY_IDENTIFIER ID_ERR_ENVD_VAR_COD FORMAT "%3.0"
 /begin AXIS_DESCR COM_AXIS errm_online_dummy _CNV_A_R_LINEAR_____0_CM 4 0. 255. FORMAT "%3.0" AXIS_PTS_REF ldpm_fmy_envd /end AXIS_DESCR
/end CHARACTERISTIC
/begin CHARACTERISTIC fmy_id_veh_pow_var.envd "Freeze frame FRF_CUS_SET_SPC: environmental data contents for failure XX" CURVE 0xa1005040 _REC_CUR_20_u1_u1 254. _CNV_A_R_LINEAR_____0_CM 1. 255. DISPLAY_IDENTIFIER ID_ERR_ENVD_VEH_POW_VAR FORMAT "%3.0"
 /begin AXIS_DESCR COM_AXIS errm_online_dummy _CNV_A_R_LINEAR_____0_CM 4 0. 255. FORMAT "%3.0" AXIS_PTS_REF ldpm_fmy_envd /end AXIS_DESCR
/end CHARACTERISTIC
/begin CHARACTERISTIC fmy_id_fup_mfp_plaus.envd "Freeze frame FRF_CUS_SET_SPC: environmental data contents for failure XX" CURVE 0xa100412c _REC_CUR_20_u1_u1 254. _CNV_A_R_LINEAR_____0_CM 1. 255. DISPLAY_IDENTIFIER ID_ERR_ENVD_FUP_MFP_PLAUS FORMAT "%3.0"
 /begin AXIS_DESCR COM_AXIS errm_online_dummy _CNV_A_R_LINEAR_____0_CM 4 0. 255. FORMAT "%3.0" AXIS_PTS_REF ldpm_fmy_envd /end AXIS_DESCR
/end CHARACTERISTIC
/begin CHARACTERISTIC fmy_id_h_prs_sys.envd "Freeze frame FRF_CUS_SET_SPC: environmental data contents for failure XX" CURVE 0xa100417c _REC_CUR_20_u1_u1 254. _CNV_A_R_LINEAR_____0_CM 1. 255. DISPLAY_IDENTIFIER ID_ERR_ENVD_H_PRS_SYS FORMAT "%3.0"
 /begin AXIS_DESCR COM_AXIS errm_online_dummy _CNV_A_R_LINEAR_____0_CM 4 0. 255. FORMAT "%3.0" AXIS_PTS_REF ldpm_fmy_envd /end AXIS_DESCR
/end CHARACTERISTIC
/begin CHARACTERISTIC fmy_id_vcv_plaus.envd "Freeze frame FRF_CUS_SET_SPC: environmental data contents for failure XX" CURVE 0xa100502c _REC_CUR_20_u1_u1 254. _CNV_A_R_LINEAR_____0_CM 1. 255. DISPLAY_IDENTIFIER ID_ERR_ENVD_VCV_PLAUS FORMAT "%3.0"
 /begin AXIS_DESCR COM_AXIS errm_online_dummy _CNV_A_R_LINEAR_____0_CM 4 0. 255. FORMAT "%3.0" AXIS_PTS_REF ldpm_fmy_envd /end AXIS_DESCR
/end CHARACTERISTIC
/begin CHARACTERISTIC fmy_id_fup.envd "Freeze frame FRF_CUS_SET_SPC: environmental data contents for failure XX" CURVE 0xa1004104 _REC_CUR_20_u1_u1 254. _CNV_A_R_LINEAR_____0_CM 1. 255. DISPLAY_IDENTIFIER ID_ERR_ENVD_FUP FORMAT "%3.0"
 /begin AXIS_DESCR COM_AXIS errm_online_dummy _CNV_A_R_LINEAR_____0_CM 4 0. 255. FORMAT "%3.0" AXIS_PTS_REF ldpm_fmy_envd /end AXIS_DESCR
/end CHARACTERISTIC
/begin CHARACTERISTIC fmy_id_vcv.envd "Freeze frame FRF_CUS_SET_SPC: environmental data contents for failure XX" CURVE 0xa1005018 _REC_CUR_20_u1_u1 254. _CNV_A_R_LINEAR_____0_CM 1. 255. DISPLAY_IDENTIFIER ID_ERR_ENVD_VCV FORMAT "%3.0"
 /begin AXIS_DESCR COM_AXIS errm_online_dummy _CNV_A_R_LINEAR_____0_CM 4 0. 255. FORMAT "%3.0" AXIS_PTS_REF ldpm_fmy_envd /end AXIS_DESCR
/end CHARACTERISTIC
/begin CHARACTERISTIC fmy_id_fup_efp.envd "Freeze frame FRF_CUS_SET_SPC: environmental data contents for failure XX" CURVE 0xa1004118 _REC_CUR_20_u1_u1 254. _CNV_A_R_LINEAR_____0_CM 1. 255. DISPLAY_IDENTIFIER ID_ERR_ENVD_FUP_EFP FORMAT "%3.0"
 /begin AXIS_DESCR COM_AXIS errm_online_dummy _CNV_A_R_LINEAR_____0_CM 4 0. 255. FORMAT "%3.0" AXIS_PTS_REF ldpm_fmy_envd /end AXIS_DESCR
/end CHARACTERISTIC
/begin CHARACTERISTIC fmy_id_efppwm_plaus.envd "Freeze frame FRF_CUS_SET_SPC: environmental data contents for failure XX" CURVE 0xa1004014 _REC_CUR_20_u1_u1 254. _CNV_A_R_LINEAR_____0_CM 1. 255. DISPLAY_IDENTIFIER ID_ERR_ENVD_EFPPWM_PLAUS FORMAT "%3.0"
 /begin AXIS_DESCR COM_AXIS errm_online_dummy _CNV_A_R_LINEAR_____0_CM 4 0. 255. FORMAT "%3.0" AXIS_PTS_REF ldpm_fmy_envd /end AXIS_DESCR
/end CHARACTERISTIC
/begin CHARACTERISTIC fmy_id_l_prs_sys.envd "Freeze frame FRF_CUS_SET_SPC: environmental data contents for failure XX" CURVE 0xa1004410 _REC_CUR_20_u1_u1 254. _CNV_A_R_LINEAR_____0_CM 1. 255. DISPLAY_IDENTIFIER ID_ERR_ENVD_L_PRS_SYS FORMAT "%3.0"
 /begin AXIS_DESCR COM_AXIS errm_online_dummy _CNV_A_R_LINEAR_____0_CM 4 0. 255. FORMAT "%3.0" AXIS_PTS_REF ldpm_fmy_envd /end AXIS_DESCR
/end CHARACTERISTIC
/begin CHARACTERISTIC fmy_id_conv_mon_1.envd "Freeze frame FRF_CUS_SET_SPC: environmental data contents for failure XX" CURVE 0xa1003d30 _REC_CUR_20_u1_u1 254. _CNV_A_R_LINEAR_____0_CM 1. 255. DISPLAY_IDENTIFIER ID_ERR_ENVD_CONV_MON_1 FORMAT "%3.0"
 /begin AXIS_DESCR COM_AXIS errm_online_dummy _CNV_A_R_LINEAR_____0_CM 4 0. 255. FORMAT "%3.0" AXIS_PTS_REF ldpm_fmy_envd /end AXIS_DESCR
/end CHARACTERISTIC
/begin CHARACTERISTIC fmy_id_n_32_mon_1.envd "Freeze frame FRF_CUS_SET_SPC: environmental data contents for failure XX" CURVE 0xa10046b8 _REC_CUR_20_u1_u1 254. _CNV_A_R_LINEAR_____0_CM 1. 255. DISPLAY_IDENTIFIER ID_ERR_ENVD_N_32_MON_1 FORMAT "%3.0"
 /begin AXIS_DESCR COM_AXIS errm_online_dummy _CNV_A_R_LINEAR_____0_CM 4 0. 255. FORMAT "%3.0" AXIS_PTS_REF ldpm_fmy_envd /end AXIS_DESCR
/end CHARACTERISTIC
/begin CHARACTERISTIC fmy_id_pvs_mon_1.envd "Freeze frame FRF_CUS_SET_SPC: environmental data contents for failure XX" CURVE 0xa1004924 _REC_CUR_20_u1_u1 254. _CNV_A_R_LINEAR_____0_CM 1. 255. DISPLAY_IDENTIFIER ID_ERR_ENVD_PVS_MON_1 FORMAT "%3.0"
 /begin AXIS_DESCR COM_AXIS errm_online_dummy _CNV_A_R_LINEAR_____0_CM 4 0. 255. FORMAT "%3.0" AXIS_PTS_REF ldpm_fmy_envd /end AXIS_DESCR
/end CHARACTERISTIC
/begin CHARACTERISTIC fmy_id_tq_dif_isc_mon_1.envd "Freeze frame FRF_CUS_SET_SPC: environmental data contents for failure XX" CURVE 0xa1004f50 _REC_CUR_20_u1_u1 254. _CNV_A_R_LINEAR_____0_CM 1. 255. DISPLAY_IDENTIFIER ID_ERR_ENVD_TQ_DIF_ISC_MON_1 FORMAT "%3.0"
 /begin AXIS_DESCR COM_AXIS errm_online_dummy _CNV_A_R_LINEAR_____0_CM 4 0. 255. FORMAT "%3.0" AXIS_PTS_REF ldpm_fmy_envd /end AXIS_DESCR
/end CHARACTERISTIC
/begin CHARACTERISTIC fmy_id_tq_req_mon_1.envd "Freeze frame FRF_CUS_SET_SPC: environmental data contents for failure XX" CURVE 0xa1004f8c _REC_CUR_20_u1_u1 254. _CNV_A_R_LINEAR_____0_CM 1. 255. DISPLAY_IDENTIFIER ID_ERR_ENVD_TQ_REQ_MON_1 FORMAT "%3.0"
 /begin AXIS_DESCR COM_AXIS errm_online_dummy _CNV_A_R_LINEAR_____0_CM 4 0. 255. FORMAT "%3.0" AXIS_PTS_REF ldpm_fmy_envd /end AXIS_DESCR
/end CHARACTERISTIC
/begin CHARACTERISTIC fmy_id_tq_ext_mon_1.envd "Freeze frame FRF_CUS_SET_SPC: environmental data contents for failure XX" CURVE 0xa1004f64 _REC_CUR_20_u1_u1 254. _CNV_A_R_LINEAR_____0_CM 1. 255. DISPLAY_IDENTIFIER ID_ERR_ENVD_TQ_EXT_MON_1 FORMAT "%3.0"
 /begin AXIS_DESCR COM_AXIS errm_online_dummy _CNV_A_R_LINEAR_____0_CM 4 0. 255. FORMAT "%3.0" AXIS_PTS_REF ldpm_fmy_envd /end AXIS_DESCR
/end CHARACTERISTIC
/begin CHARACTERISTIC fmy_id_tqi_av_mon_1.envd "Freeze frame FRF_CUS_SET_SPC: environmental data contents for failure XX" CURVE 0xa1004fa0 _REC_CUR_20_u1_u1 254. _CNV_A_R_LINEAR_____0_CM 1. 255. DISPLAY_IDENTIFIER ID_ERR_ENVD_TQI_AV_MON_1 FORMAT "%3.0"
 /begin AXIS_DESCR COM_AXIS errm_online_dummy _CNV_A_R_LINEAR_____0_CM 4 0. 255. FORMAT "%3.0" AXIS_PTS_REF ldpm_fmy_envd /end AXIS_DESCR
/end CHARACTERISTIC
/begin CHARACTERISTIC fmy_id_tqi_n_max_mon_1.envd "Freeze frame FRF_CUS_SET_SPC: environmental data contents for failure XX" CURVE 0xa1004fc8 _REC_CUR_20_u1_u1 254. _CNV_A_R_LINEAR_____0_CM 1. 255. DISPLAY_IDENTIFIER ID_ERR_ENVD_TQI_N_MAX_MON_1 FORMAT "%3.0"
 /begin AXIS_DESCR COM_AXIS errm_online_dummy _CNV_A_R_LINEAR_____0_CM 4 0. 255. FORMAT "%3.0" AXIS_PTS_REF ldpm_fmy_envd /end AXIS_DESCR
/end CHARACTERISTIC
/begin CHARACTERISTIC fmy_id_mff_mon_1.envd "Freeze frame FRF_CUS_SET_SPC: environmental data contents for failure XX" CURVE 0xa1004578 _REC_CUR_20_u1_u1 254. _CNV_A_R_LINEAR_____0_CM 1. 255. DISPLAY_IDENTIFIER ID_ERR_ENVD_MFF_MON_1 FORMAT "%3.0"
 /begin AXIS_DESCR COM_AXIS errm_online_dummy _CNV_A_R_LINEAR_____0_CM 4 0. 255. FORMAT "%3.0" AXIS_PTS_REF ldpm_fmy_envd /end AXIS_DESCR
/end CHARACTERISTIC
/begin CHARACTERISTIC fmy_id_cru_mon_1.envd "Freeze frame FRF_CUS_SET_SPC: environmental data contents for failure XX" CURVE 0xa1003da8 _REC_CUR_20_u1_u1 254. _CNV_A_R_LINEAR_____0_CM 1. 255. DISPLAY_IDENTIFIER ID_ERR_ENVD_CRU_MON_1 FORMAT "%3.0"
 /begin AXIS_DESCR COM_AXIS errm_online_dummy _CNV_A_R_LINEAR_____0_CM 4 0. 255. FORMAT "%3.0" AXIS_PTS_REF ldpm_fmy_envd /end AXIS_DESCR
/end CHARACTERISTIC
/begin AXIS_PTS ldpm_fmy_envd "" 0xa10038d2 errm_online_dummy _REC_AXS_20_u1 255. _CNV_A_R_LINEAR_____0_CM 4 0. 255. FORMAT "%3.0" /end AXIS_PTS
/begin MEASUREMENT ctr_err_dyn_nr "Number of failure stored in dynamic memory (2nd layer)" UBYTE _CNV_A_R_LINEAR_____0_CM 1 100. 0. 255. DISPLAY_IDENTIFIER CTR_ERR_DYN_NR ECU_ADDRESS 0xd0003540 FORMAT "%3.0" /end MEASUREMENT
/begin MEASUREMENT fmy_ram_dyn[0].diag_inst "Index of diagnosis instance XX" UWORD _CNV_S_311_ERRM_RANGE_486_CM 1 100. 0. 310. DISPLAY_IDENTIFIER DIAG_INST[0] ECU_ADDRESS 0xd0004102 /end MEASUREMENT
/begin MEASUREMENT fmy_ram_dyn[0].err_info_dyn.lv_cdn_diag_dc "Flag to detect that diag conditions have been met during DC" UWORD _CNV_S_2_RANGE__0___1_CM 1 100. 0. 1. DISPLAY_IDENTIFIER LV_CDN_DIAG_DC[0] ECU_ADDRESS 0xd0004104 BIT_MASK 0x10 /end MEASUREMENT
/begin MEASUREMENT fmy_ram_dyn[0].err_info_dyn.lv_err_mkd "Marked failure status flag" UWORD _CNV_S_2_RANGE__0___1_CM 1 100. 0. 1. DISPLAY_IDENTIFIER LV_ERR_MKD[0] ECU_ADDRESS 0xd0004104 BIT_MASK 0x20 /end MEASUREMENT
/begin MEASUREMENT fmy_ram_dyn[0].err_info_dyn.lv_dc_max "Flag for the MIL state (on or off) related to the failure" UWORD _CNV_S_2_RANGE__0___1_CM 1 100. 0. 1. DISPLAY_IDENTIFIER LV_DC_MAX[0] ECU_ADDRESS 0xd0004104 BIT_MASK 0x40 /end MEASUREMENT
/begin MEASUREMENT fmy_ram_dyn[0].err_info_dyn.lv_err_disa "Disapeared failure status flag" UWORD _CNV_S_2_RANGE__0___1_CM 1 100. 0. 1. DISPLAY_IDENTIFIER LV_ERR_DISA[0] ECU_ADDRESS 0xd0004104 BIT_MASK 0x80 /end MEASUREMENT
/begin MEASUREMENT fmy_ram_dyn[0].err_info_dyn.lv_err_cfm "Confirmed failure status flag" UWORD _CNV_S_2_RANGE__0___1_CM 1 100. 0. 1. DISPLAY_IDENTIFIER LV_ERR_CFM[0] ECU_ADDRESS 0xd0004104 BIT_MASK 0x100 /end MEASUREMENT
/begin MEASUREMENT fmy_ram_dyn[0].err_info_dyn.lv_err_tmp "Temporary failure status flag" UWORD _CNV_S_2_RANGE__0___1_CM 1 100. 0. 1. DISPLAY_IDENTIFIER LV_ERR_TMP[0] ECU_ADDRESS 0xd0004104 BIT_MASK 0x200 /end MEASUREMENT
/begin MEASUREMENT fmy_ram_dyn[0].err_info_dyn.lv_err_dc "Failure present status for this driving cycle" UWORD _CNV_S_2_RANGE__0___1_CM 1 100. 0. 1. DISPLAY_IDENTIFIER LV_ERR_DC[0] ECU_ADDRESS 0xd0004104 BIT_MASK 0x400 /end MEASUREMENT
/begin MEASUREMENT fmy_ram_dyn[0].err_info_dyn.lv_err_pnd "Pending failure status flag" UWORD _CNV_S_2_RANGE__0___1_CM 1 100. 0. 1. DISPLAY_IDENTIFIER LV_ERR_PND[0] ECU_ADDRESS 0xd0004104 BIT_MASK 0x800 /end MEASUREMENT
/begin MEASUREMENT fmy_ram_dyn[0].ctr_wup_cyc "Counter for warm-up cycle" UBYTE _CNV_A_R_LINEAR_____0_CM 1 100. 0. 255. DISPLAY_IDENTIFIER CTR_WUP_CYC[0] ECU_ADDRESS 0xd0004106 FORMAT "%3.0" /end MEASUREMENT
/begin MEASUREMENT fmy_ram_dyn[0].ctr_frc "Frequency counter : number of occurrence of present failure" UBYTE _CNV_A_R_LINEAR_____0_CM 1 100. 0. 255. DISPLAY_IDENTIFIER CTR_FRC[0] ECU_ADDRESS 0xd0004107 FORMAT "%3.0" /end MEASUREMENT
/begin MEASUREMENT fmy_ram_dyn[0].ctr_dc "Counter for driving cycle" UBYTE _CNV_A_R_LINEAR_____0_CM 1 100. 0. 255. DISPLAY_IDENTIFIER CTR_DC[0] ECU_ADDRESS 0xd0004108 FORMAT "%3.0" /end MEASUREMENT
/begin MEASUREMENT fmy_ram_dyn[0].idx_frf "" UBYTE _CNV_A_R_LINEAR_____0_CM 1 100. 0. 255. DISPLAY_IDENTIFIER IDX_FRF[0] ECU_ADDRESS 0xd0004109 FORMAT "%3.0" /end MEASUREMENT
/begin MEASUREMENT fmy_ram_dyn[0].ctr_dc_err_det "Number of driving cycles since DTC detection" UBYTE _CNV_A_R_LINEAR_____0_CM 1 100. 0. 255. DISPLAY_IDENTIFIER CTR_DC_ERR_DET[0] ECU_ADDRESS 0xd000410a FORMAT "%3.0" /end MEASUREMENT
/begin MEASUREMENT fmy_ram_dyn[0].ctr_dc_err_det_diag_cdn "Number of DC since DTC detection with diag started" UBYTE _CNV_A_R_LINEAR_____0_CM 1 100. 0. 255. DISPLAY_IDENTIFIER CTR_DC_ERR_DET_DIAG_CDN[0] ECU_ADDRESS 0xd000410b FORMAT "%3.0" /end MEASUREMENT
/begin MEASUREMENT fmy_ram_dyn[0].ctr_dc_err_det_diag_cmpl "Number of DC since DTC detection with diag completed" UBYTE _CNV_A_R_LINEAR_____0_CM 1 100. 0. 255. DISPLAY_IDENTIFIER CTR_DC_ERR_DET_DIAG_CMPL[0] ECU_ADDRESS 0xd000410c FORMAT "%3.0" /end MEASUREMENT
/begin MEASUREMENT fmy_ram_dyn[0].ctr_wup_act_mil "Number of WUP since MIL activation" UBYTE _CNV_A_R_LINEAR_____0_CM 1 100. 0. 255. DISPLAY_IDENTIFIER CTR_WUP_ACT_MIL[0] ECU_ADDRESS 0xd000410d FORMAT "%3.0" /end MEASUREMENT
/begin MEASUREMENT fmy_ram_dyn[1].diag_inst "Index of diagnosis instance XX" UWORD _CNV_S_311_ERRM_RANGE_486_CM 1 100. 0. 310. DISPLAY_IDENTIFIER DIAG_INST[1] ECU_ADDRESS 0xd0004110 /end MEASUREMENT
/begin MEASUREMENT fmy_ram_dyn[1].err_info_dyn.lv_cdn_diag_dc "Flag to detect that diag conditions have been met during DC" UWORD _CNV_S_2_RANGE__0___1_CM 1 100. 0. 1. DISPLAY_IDENTIFIER LV_CDN_DIAG_DC[1] ECU_ADDRESS 0xd0004112 BIT_MASK 0x10 /end MEASUREMENT
/begin MEASUREMENT fmy_ram_dyn[1].err_info_dyn.lv_err_mkd "Marked failure status flag" UWORD _CNV_S_2_RANGE__0___1_CM 1 100. 0. 1. DISPLAY_IDENTIFIER LV_ERR_MKD[1] ECU_ADDRESS 0xd0004112 BIT_MASK 0x20 /end MEASUREMENT
/begin MEASUREMENT fmy_ram_dyn[1].err_info_dyn.lv_dc_max "Flag for the MIL state (on or off) related to the failure" UWORD _CNV_S_2_RANGE__0___1_CM 1 100. 0. 1. DISPLAY_IDENTIFIER LV_DC_MAX[1] ECU_ADDRESS 0xd0004112 BIT_MASK 0x40 /end MEASUREMENT
/begin MEASUREMENT fmy_ram_dyn[1].err_info_dyn.lv_err_disa "Disapeared failure status flag" UWORD _CNV_S_2_RANGE__0___1_CM 1 100. 0. 1. DISPLAY_IDENTIFIER LV_ERR_DISA[1] ECU_ADDRESS 0xd0004112 BIT_MASK 0x80 /end MEASUREMENT
/begin MEASUREMENT fmy_ram_dyn[1].err_info_dyn.lv_err_cfm "Confirmed failure status flag" UWORD _CNV_S_2_RANGE__0___1_CM 1 100. 0. 1. DISPLAY_IDENTIFIER LV_ERR_CFM[1] ECU_ADDRESS 0xd0004112 BIT_MASK 0x100 /end MEASUREMENT
/begin MEASUREMENT fmy_ram_dyn[1].err_info_dyn.lv_err_tmp "Temporary failure status flag" UWORD _CNV_S_2_RANGE__0___1_CM 1 100. 0. 1. DISPLAY_IDENTIFIER LV_ERR_TMP[1] ECU_ADDRESS 0xd0004112 BIT_MASK 0x200 /end MEASUREMENT
/begin MEASUREMENT fmy_ram_dyn[1].err_info_dyn.lv_err_dc "Failure present status for this driving cycle" UWORD _CNV_S_2_RANGE__0___1_CM 1 100. 0. 1. DISPLAY_IDENTIFIER LV_ERR_DC[1] ECU_ADDRESS 0xd0004112 BIT_MASK 0x400 /end MEASUREMENT
/begin MEASUREMENT fmy_ram_dyn[1].err_info_dyn.lv_err_pnd "Pending failure status flag" UWORD _CNV_S_2_RANGE__0___1_CM 1 100. 0. 1. DISPLAY_IDENTIFIER LV_ERR_PND[1] ECU_ADDRESS 0xd0004112 BIT_MASK 0x800 /end MEASUREMENT
/begin MEASUREMENT fmy_ram_dyn[1].ctr_wup_cyc "Counter for warm-up cycle" UBYTE _CNV_A_R_LINEAR_____0_CM 1 100. 0. 255. DISPLAY_IDENTIFIER CTR_WUP_CYC[1] ECU_ADDRESS 0xd0004114 FORMAT "%3.0" /end MEASUREMENT
/begin MEASUREMENT fmy_ram_dyn[1].ctr_frc "Frequency counter : number of occurrence of present failure" UBYTE _CNV_A_R_LINEAR_____0_CM 1 100. 0. 255. DISPLAY_IDENTIFIER CTR_FRC[1] ECU_ADDRESS 0xd0004115 FORMAT "%3.0" /end MEASUREMENT
/begin MEASUREMENT fmy_ram_dyn[1].ctr_dc "Counter for driving cycle" UBYTE _CNV_A_R_LINEAR_____0_CM 1 100. 0. 255. DISPLAY_IDENTIFIER CTR_DC[1] ECU_ADDRESS 0xd0004116 FORMAT "%3.0" /end MEASUREMENT
/begin MEASUREMENT fmy_ram_dyn[1].idx_frf "" UBYTE _CNV_A_R_LINEAR_____0_CM 1 100. 0. 255. DISPLAY_IDENTIFIER IDX_FRF[1] ECU_ADDRESS 0xd0004117 FORMAT "%3.0" /end MEASUREMENT
/begin MEASUREMENT fmy_ram_dyn[1].ctr_dc_err_det "Number of driving cycles since DTC detection" UBYTE _CNV_A_R_LINEAR_____0_CM 1 100. 0. 255. DISPLAY_IDENTIFIER CTR_DC_ERR_DET[1] ECU_ADDRESS 0xd0004118 FORMAT "%3.0" /end MEASUREMENT
/begin MEASUREMENT fmy_ram_dyn[1].ctr_dc_err_det_diag_cdn "Number of DC since DTC detection with diag started" UBYTE _CNV_A_R_LINEAR_____0_CM 1 100. 0. 255. DISPLAY_IDENTIFIER CTR_DC_ERR_DET_DIAG_CDN[1] ECU_ADDRESS 0xd0004119 FORMAT "%3.0" /end MEASUREMENT
/begin MEASUREMENT fmy_ram_dyn[1].ctr_dc_err_det_diag_cmpl "Number of DC since DTC detection with diag completed" UBYTE _CNV_A_R_LINEAR_____0_CM 1 100. 0. 255. DISPLAY_IDENTIFIER CTR_DC_ERR_DET_DIAG_CMPL[1] ECU_ADDRESS 0xd000411a FORMAT "%3.0" /end MEASUREMENT
/begin MEASUREMENT fmy_ram_dyn[1].ctr_wup_act_mil "Number of WUP since MIL activation" UBYTE _CNV_A_R_LINEAR_____0_CM 1 100. 0. 255. DISPLAY_IDENTIFIER CTR_WUP_ACT_MIL[1] ECU_ADDRESS 0xd000411b FORMAT "%3.0" /end MEASUREMENT
/begin MEASUREMENT fmy_ram_dyn[2].diag_inst "Index of diagnosis instance XX" UWORD _CNV_S_311_ERRM_RANGE_486_CM 1 100. 0. 310. DISPLAY_IDENTIFIER DIAG_INST[2] ECU_ADDRESS 0xd000411e /end MEASUREMENT
/begin MEASUREMENT fmy_ram_dyn[2].err_info_dyn.lv_cdn_diag_dc "Flag to detect that diag conditions have been met during DC" UWORD _CNV_S_2_RANGE__0___1_CM 1 100. 0. 1. DISPLAY_IDENTIFIER LV_CDN_DIAG_DC[2] ECU_ADDRESS 0xd0004120 BIT_MASK 0x10 /end MEASUREMENT
/begin MEASUREMENT fmy_ram_dyn[2].err_info_dyn.lv_err_mkd "Marked failure status flag" UWORD _CNV_S_2_RANGE__0___1_CM 1 100. 0. 1. DISPLAY_IDENTIFIER LV_ERR_MKD[2] ECU_ADDRESS 0xd0004120 BIT_MASK 0x20 /end MEASUREMENT
/begin MEASUREMENT fmy_ram_dyn[2].err_info_dyn.lv_dc_max "Flag for the MIL state (on or off) related to the failure" UWORD _CNV_S_2_RANGE__0___1_CM 1 100. 0. 1. DISPLAY_IDENTIFIER LV_DC_MAX[2] ECU_ADDRESS 0xd0004120 BIT_MASK 0x40 /end MEASUREMENT
/begin MEASUREMENT fmy_ram_dyn[2].err_info_dyn.lv_err_disa "Disapeared failure status flag" UWORD _CNV_S_2_RANGE__0___1_CM 1 100. 0. 1. DISPLAY_IDENTIFIER LV_ERR_DISA[2] ECU_ADDRESS 0xd0004120 BIT_MASK 0x80 /end MEASUREMENT
/begin MEASUREMENT fmy_ram_dyn[2].err_info_dyn.lv_err_cfm "Confirmed failure status flag" UWORD _CNV_S_2_RANGE__0___1_CM 1 100. 0. 1. DISPLAY_IDENTIFIER LV_ERR_CFM[2] ECU_ADDRESS 0xd0004120 BIT_MASK 0x100 /end MEASUREMENT
/begin MEASUREMENT fmy_ram_dyn[2].err_info_dyn.lv_err_tmp "Temporary failure status flag" UWORD _CNV_S_2_RANGE__0___1_CM 1 100. 0. 1. DISPLAY_IDENTIFIER LV_ERR_TMP[2] ECU_ADDRESS 0xd0004120 BIT_MASK 0x200 /end MEASUREMENT
/begin MEASUREMENT fmy_ram_dyn[2].err_info_dyn.lv_err_dc "Failure present status for this driving cycle" UWORD _CNV_S_2_RANGE__0___1_CM 1 100. 0. 1. DISPLAY_IDENTIFIER LV_ERR_DC[2] ECU_ADDRESS 0xd0004120 BIT_MASK 0x400 /end MEASUREMENT
/begin MEASUREMENT fmy_ram_dyn[2].err_info_dyn.lv_err_pnd "Pending failure status flag" UWORD _CNV_S_2_RANGE__0___1_CM 1 100. 0. 1. DISPLAY_IDENTIFIER LV_ERR_PND[2] ECU_ADDRESS 0xd0004120 BIT_MASK 0x800 /end MEASUREMENT
/begin MEASUREMENT fmy_ram_dyn[2].ctr_wup_cyc "Counter for warm-up cycle" UBYTE _CNV_A_R_LINEAR_____0_CM 1 100. 0. 255. DISPLAY_IDENTIFIER CTR_WUP_CYC[2] ECU_ADDRESS 0xd0004122 FORMAT "%3.0" /end MEASUREMENT
/begin MEASUREMENT fmy_ram_dyn[2].ctr_frc "Frequency counter : number of occurrence of present failure" UBYTE _CNV_A_R_LINEAR_____0_CM 1 100. 0. 255. DISPLAY_IDENTIFIER CTR_FRC[2] ECU_ADDRESS 0xd0004123 FORMAT "%3.0" /end MEASUREMENT
/begin MEASUREMENT fmy_ram_dyn[2].ctr_dc "Counter for driving cycle" UBYTE _CNV_A_R_LINEAR_____0_CM 1 100. 0. 255. DISPLAY_IDENTIFIER CTR_DC[2] ECU_ADDRESS 0xd0004124 FORMAT "%3.0" /end MEASUREMENT
/begin MEASUREMENT fmy_ram_dyn[2].idx_frf "" UBYTE _CNV_A_R_LINEAR_____0_CM 1 100. 0. 255. DISPLAY_IDENTIFIER IDX_FRF[2] ECU_ADDRESS 0xd0004125 FORMAT "%3.0" /end MEASUREMENT
/begin MEASUREMENT fmy_ram_dyn[2].ctr_dc_err_det "Number of driving cycles since DTC detection" UBYTE _CNV_A_R_LINEAR_____0_CM 1 100. 0. 255. DISPLAY_IDENTIFIER CTR_DC_ERR_DET[2] ECU_ADDRESS 0xd0004126 FORMAT "%3.0" /end MEASUREMENT
/begin MEASUREMENT fmy_ram_dyn[2].ctr_dc_err_det_diag_cdn "Number of DC since DTC detection with diag started" UBYTE _CNV_A_R_LINEAR_____0_CM 1 100. 0. 255. DISPLAY_IDENTIFIER CTR_DC_ERR_DET_DIAG_CDN[2] ECU_ADDRESS 0xd0004127 FORMAT "%3.0" /end MEASUREMENT
/begin MEASUREMENT fmy_ram_dyn[2].ctr_dc_err_det_diag_cmpl "Number of DC since DTC detection with diag completed" UBYTE _CNV_A_R_LINEAR_____0_CM 1 100. 0. 255. DISPLAY_IDENTIFIER CTR_DC_ERR_DET_DIAG_CMPL[2] ECU_ADDRESS 0xd0004128 FORMAT "%3.0" /end MEASUREMENT
/begin MEASUREMENT fmy_ram_dyn[2].ctr_wup_act_mil "Number of WUP since MIL activation" UBYTE _CNV_A_R_LINEAR_____0_CM 1 100. 0. 255. DISPLAY_IDENTIFIER CTR_WUP_ACT_MIL[2] ECU_ADDRESS 0xd0004129 FORMAT "%3.0" /end MEASUREMENT
/begin MEASUREMENT fmy_ram_dyn[3].diag_inst "Index of diagnosis instance XX" UWORD _CNV_S_311_ERRM_RANGE_486_CM 1 100. 0. 310. DISPLAY_IDENTIFIER DIAG_INST[3] ECU_ADDRESS 0xd000412c /end MEASUREMENT
/begin MEASUREMENT fmy_ram_dyn[3].err_info_dyn.lv_cdn_diag_dc "Flag to detect that diag conditions have been met during DC" UWORD _CNV_S_2_RANGE__0___1_CM 1 100. 0. 1. DISPLAY_IDENTIFIER LV_CDN_DIAG_DC[3] ECU_ADDRESS 0xd000412e BIT_MASK 0x10 /end MEASUREMENT
/begin MEASUREMENT fmy_ram_dyn[3].err_info_dyn.lv_err_mkd "Marked failure status flag" UWORD _CNV_S_2_RANGE__0___1_CM 1 100. 0. 1. DISPLAY_IDENTIFIER LV_ERR_MKD[3] ECU_ADDRESS 0xd000412e BIT_MASK 0x20 /end MEASUREMENT
/begin MEASUREMENT fmy_ram_dyn[3].err_info_dyn.lv_dc_max "Flag for the MIL state (on or off) related to the failure" UWORD _CNV_S_2_RANGE__0___1_CM 1 100. 0. 1. DISPLAY_IDENTIFIER LV_DC_MAX[3] ECU_ADDRESS 0xd000412e BIT_MASK 0x40 /end MEASUREMENT
/begin MEASUREMENT fmy_ram_dyn[3].err_info_dyn.lv_err_disa "Disapeared failure status flag" UWORD _CNV_S_2_RANGE__0___1_CM 1 100. 0. 1. DISPLAY_IDENTIFIER LV_ERR_DISA[3] ECU_ADDRESS 0xd000412e BIT_MASK 0x80 /end MEASUREMENT
/begin MEASUREMENT fmy_ram_dyn[3].err_info_dyn.lv_err_cfm "Confirmed failure status flag" UWORD _CNV_S_2_RANGE__0___1_CM 1 100. 0. 1. DISPLAY_IDENTIFIER LV_ERR_CFM[3] ECU_ADDRESS 0xd000412e BIT_MASK 0x100 /end MEASUREMENT
/begin MEASUREMENT fmy_ram_dyn[3].err_info_dyn.lv_err_tmp "Temporary failure status flag" UWORD _CNV_S_2_RANGE__0___1_CM 1 100. 0. 1. DISPLAY_IDENTIFIER LV_ERR_TMP[3] ECU_ADDRESS 0xd000412e BIT_MASK 0x200 /end MEASUREMENT
/begin MEASUREMENT fmy_ram_dyn[3].err_info_dyn.lv_err_dc "Failure present status for this driving cycle" UWORD _CNV_S_2_RANGE__0___1_CM 1 100. 0. 1. DISPLAY_IDENTIFIER LV_ERR_DC[3] ECU_ADDRESS 0xd000412e BIT_MASK 0x400 /end MEASUREMENT
/begin MEASUREMENT fmy_ram_dyn[3].err_info_dyn.lv_err_pnd "Pending failure status flag" UWORD _CNV_S_2_RANGE__0___1_CM 1 100. 0. 1. DISPLAY_IDENTIFIER LV_ERR_PND[3] ECU_ADDRESS 0xd000412e BIT_MASK 0x800 /end MEASUREMENT
/begin MEASUREMENT fmy_ram_dyn[3].ctr_wup_cyc "Counter for warm-up cycle" UBYTE _CNV_A_R_LINEAR_____0_CM 1 100. 0. 255. DISPLAY_IDENTIFIER CTR_WUP_CYC[3] ECU_ADDRESS 0xd0004130 FORMAT "%3.0" /end MEASUREMENT
/begin MEASUREMENT fmy_ram_dyn[3].ctr_frc "Frequency counter : number of occurrence of present failure" UBYTE _CNV_A_R_LINEAR_____0_CM 1 100. 0. 255. DISPLAY_IDENTIFIER CTR_FRC[3] ECU_ADDRESS 0xd0004131 FORMAT "%3.0" /end MEASUREMENT
/begin MEASUREMENT fmy_ram_dyn[3].ctr_dc "Counter for driving cycle" UBYTE _CNV_A_R_LINEAR_____0_CM 1 100. 0. 255. DISPLAY_IDENTIFIER CTR_DC[3] ECU_ADDRESS 0xd0004132 FORMAT "%3.0" /end MEASUREMENT
/begin MEASUREMENT fmy_ram_dyn[3].idx_frf "" UBYTE _CNV_A_R_LINEAR_____0_CM 1 100. 0. 255. DISPLAY_IDENTIFIER IDX_FRF[3] ECU_ADDRESS 0xd0004133 FORMAT "%3.0" /end MEASUREMENT
/begin MEASUREMENT fmy_ram_dyn[3].ctr_dc_err_det "Number of driving cycles since DTC detection" UBYTE _CNV_A_R_LINEAR_____0_CM 1 100. 0. 255. DISPLAY_IDENTIFIER CTR_DC_ERR_DET[3] ECU_ADDRESS 0xd0004134 FORMAT "%3.0" /end MEASUREMENT
/begin MEASUREMENT fmy_ram_dyn[3].ctr_dc_err_det_diag_cdn "Number of DC since DTC detection with diag started" UBYTE _CNV_A_R_LINEAR_____0_CM 1 100. 0. 255. DISPLAY_IDENTIFIER CTR_DC_ERR_DET_DIAG_CDN[3] ECU_ADDRESS 0xd0004135 FORMAT "%3.0" /end MEASUREMENT
/begin MEASUREMENT fmy_ram_dyn[3].ctr_dc_err_det_diag_cmpl "Number of DC since DTC detection with diag completed" UBYTE _CNV_A_R_LINEAR_____0_CM 1 100. 0. 255. DISPLAY_IDENTIFIER CTR_DC_ERR_DET_DIAG_CMPL[3] ECU_ADDRESS 0xd0004136 FORMAT "%3.0" /end MEASUREMENT
/begin MEASUREMENT fmy_ram_dyn[3].ctr_wup_act_mil "Number of WUP since MIL activation" UBYTE _CNV_A_R_LINEAR_____0_CM 1 100. 0. 255. DISPLAY_IDENTIFIER CTR_WUP_ACT_MIL[3] ECU_ADDRESS 0xd0004137 FORMAT "%3.0" /end MEASUREMENT
/begin MEASUREMENT fmy_ram_dyn[4].diag_inst "Index of diagnosis instance XX" UWORD _CNV_S_311_ERRM_RANGE_486_CM 1 100. 0. 310. DISPLAY_IDENTIFIER DIAG_INST[4] ECU_ADDRESS 0xd000413a /end MEASUREMENT
/begin MEASUREMENT fmy_ram_dyn[4].err_info_dyn.lv_cdn_diag_dc "Flag to detect that diag conditions have been met during DC" UWORD _CNV_S_2_RANGE__0___1_CM 1 100. 0. 1. DISPLAY_IDENTIFIER LV_CDN_DIAG_DC[4] ECU_ADDRESS 0xd000413c BIT_MASK 0x10 /end MEASUREMENT
/begin MEASUREMENT fmy_ram_dyn[4].err_info_dyn.lv_err_mkd "Marked failure status flag" UWORD _CNV_S_2_RANGE__0___1_CM 1 100. 0. 1. DISPLAY_IDENTIFIER LV_ERR_MKD[4] ECU_ADDRESS 0xd000413c BIT_MASK 0x20 /end MEASUREMENT
/begin MEASUREMENT fmy_ram_dyn[4].err_info_dyn.lv_dc_max "Flag for the MIL state (on or off) related to the failure" UWORD _CNV_S_2_RANGE__0___1_CM 1 100. 0. 1. DISPLAY_IDENTIFIER LV_DC_MAX[4] ECU_ADDRESS 0xd000413c BIT_MASK 0x40 /end MEASUREMENT
/begin MEASUREMENT fmy_ram_dyn[4].err_info_dyn.lv_err_disa "Disapeared failure status flag" UWORD _CNV_S_2_RANGE__0___1_CM 1 100. 0. 1. DISPLAY_IDENTIFIER LV_ERR_DISA[4] ECU_ADDRESS 0xd000413c BIT_MASK 0x80 /end MEASUREMENT
/begin MEASUREMENT fmy_ram_dyn[4].err_info_dyn.lv_err_cfm "Confirmed failure status flag" UWORD _CNV_S_2_RANGE__0___1_CM 1 100. 0. 1. DISPLAY_IDENTIFIER LV_ERR_CFM[4] ECU_ADDRESS 0xd000413c BIT_MASK 0x100 /end MEASUREMENT
/begin MEASUREMENT fmy_ram_dyn[4].err_info_dyn.lv_err_tmp "Temporary failure status flag" UWORD _CNV_S_2_RANGE__0___1_CM 1 100. 0. 1. DISPLAY_IDENTIFIER LV_ERR_TMP[4] ECU_ADDRESS 0xd000413c BIT_MASK 0x200 /end MEASUREMENT
/begin MEASUREMENT fmy_ram_dyn[4].err_info_dyn.lv_err_dc "Failure present status for this driving cycle" UWORD _CNV_S_2_RANGE__0___1_CM 1 100. 0. 1. DISPLAY_IDENTIFIER LV_ERR_DC[4] ECU_ADDRESS 0xd000413c BIT_MASK 0x400 /end MEASUREMENT
/begin MEASUREMENT fmy_ram_dyn[4].err_info_dyn.lv_err_pnd "Pending failure status flag" UWORD _CNV_S_2_RANGE__0___1_CM 1 100. 0. 1. DISPLAY_IDENTIFIER LV_ERR_PND[4] ECU_ADDRESS 0xd000413c BIT_MASK 0x800 /end MEASUREMENT
/begin MEASUREMENT fmy_ram_dyn[4].ctr_wup_cyc "Counter for warm-up cycle" UBYTE _CNV_A_R_LINEAR_____0_CM 1 100. 0. 255. DISPLAY_IDENTIFIER CTR_WUP_CYC[4] ECU_ADDRESS 0xd000413e FORMAT "%3.0" /end MEASUREMENT
/begin MEASUREMENT fmy_ram_dyn[4].ctr_frc "Frequency counter : number of occurrence of present failure" UBYTE _CNV_A_R_LINEAR_____0_CM 1 100. 0. 255. DISPLAY_IDENTIFIER CTR_FRC[4] ECU_ADDRESS 0xd000413f FORMAT "%3.0" /end MEASUREMENT
/begin MEASUREMENT fmy_ram_dyn[4].ctr_dc "Counter for driving cycle" UBYTE _CNV_A_R_LINEAR_____0_CM 1 100. 0. 255. DISPLAY_IDENTIFIER CTR_DC[4] ECU_ADDRESS 0xd0004140 FORMAT "%3.0" /end MEASUREMENT
/begin MEASUREMENT fmy_ram_dyn[4].idx_frf "" UBYTE _CNV_A_R_LINEAR_____0_CM 1 100. 0. 255. DISPLAY_IDENTIFIER IDX_FRF[4] ECU_ADDRESS 0xd0004141 FORMAT "%3.0" /end MEASUREMENT
/begin MEASUREMENT fmy_ram_dyn[4].ctr_dc_err_det "Number of driving cycles since DTC detection" UBYTE _CNV_A_R_LINEAR_____0_CM 1 100. 0. 255. DISPLAY_IDENTIFIER CTR_DC_ERR_DET[4] ECU_ADDRESS 0xd0004142 FORMAT "%3.0" /end MEASUREMENT
/begin MEASUREMENT fmy_ram_dyn[4].ctr_dc_err_det_diag_cdn "Number of DC since DTC detection with diag started" UBYTE _CNV_A_R_LINEAR_____0_CM 1 100. 0. 255. DISPLAY_IDENTIFIER CTR_DC_ERR_DET_DIAG_CDN[4] ECU_ADDRESS 0xd0004143 FORMAT "%3.0" /end MEASUREMENT
/begin MEASUREMENT fmy_ram_dyn[4].ctr_dc_err_det_diag_cmpl "Number of DC since DTC detection with diag completed" UBYTE _CNV_A_R_LINEAR_____0_CM 1 100. 0. 255. DISPLAY_IDENTIFIER CTR_DC_ERR_DET_DIAG_CMPL[4] ECU_ADDRESS 0xd0004144 FORMAT "%3.0" /end MEASUREMENT
/begin MEASUREMENT fmy_ram_dyn[4].ctr_wup_act_mil "Number of WUP since MIL activation" UBYTE _CNV_A_R_LINEAR_____0_CM 1 100. 0. 255. DISPLAY_IDENTIFIER CTR_WUP_ACT_MIL[4] ECU_ADDRESS 0xd0004145 FORMAT "%3.0" /end MEASUREMENT
/begin MEASUREMENT fmy_ram_dyn[5].diag_inst "Index of diagnosis instance XX" UWORD _CNV_S_311_ERRM_RANGE_486_CM 1 100. 0. 310. DISPLAY_IDENTIFIER DIAG_INST[5] ECU_ADDRESS 0xd0004148 /end MEASUREMENT
/begin MEASUREMENT fmy_ram_dyn[5].err_info_dyn.lv_cdn_diag_dc "Flag to detect that diag conditions have been met during DC" UWORD _CNV_S_2_RANGE__0___1_CM 1 100. 0. 1. DISPLAY_IDENTIFIER LV_CDN_DIAG_DC[5] ECU_ADDRESS 0xd000414a BIT_MASK 0x10 /end MEASUREMENT
/begin MEASUREMENT fmy_ram_dyn[5].err_info_dyn.lv_err_mkd "Marked failure status flag" UWORD _CNV_S_2_RANGE__0___1_CM 1 100. 0. 1. DISPLAY_IDENTIFIER LV_ERR_MKD[5] ECU_ADDRESS 0xd000414a BIT_MASK 0x20 /end MEASUREMENT
/begin MEASUREMENT fmy_ram_dyn[5].err_info_dyn.lv_dc_max "Flag for the MIL state (on or off) related to the failure" UWORD _CNV_S_2_RANGE__0___1_CM 1 100. 0. 1. DISPLAY_IDENTIFIER LV_DC_MAX[5] ECU_ADDRESS 0xd000414a BIT_MASK 0x40 /end MEASUREMENT
/begin MEASUREMENT fmy_ram_dyn[5].err_info_dyn.lv_err_disa "Disapeared failure status flag" UWORD _CNV_S_2_RANGE__0___1_CM 1 100. 0. 1. DISPLAY_IDENTIFIER LV_ERR_DISA[5] ECU_ADDRESS 0xd000414a BIT_MASK 0x80 /end MEASUREMENT
/begin MEASUREMENT fmy_ram_dyn[5].err_info_dyn.lv_err_cfm "Confirmed failure status flag" UWORD _CNV_S_2_RANGE__0___1_CM 1 100. 0. 1. DISPLAY_IDENTIFIER LV_ERR_CFM[5] ECU_ADDRESS 0xd000414a BIT_MASK 0x100 /end MEASUREMENT
/begin MEASUREMENT fmy_ram_dyn[5].err_info_dyn.lv_err_tmp "Temporary failure status flag" UWORD _CNV_S_2_RANGE__0___1_CM 1 100. 0. 1. DISPLAY_IDENTIFIER LV_ERR_TMP[5] ECU_ADDRESS 0xd000414a BIT_MASK 0x200 /end MEASUREMENT
/begin MEASUREMENT fmy_ram_dyn[5].err_info_dyn.lv_err_dc "Failure present status for this driving cycle" UWORD _CNV_S_2_RANGE__0___1_CM 1 100. 0. 1. DISPLAY_IDENTIFIER LV_ERR_DC[5] ECU_ADDRESS 0xd000414a BIT_MASK 0x400 /end MEASUREMENT
/begin MEASUREMENT fmy_ram_dyn[5].err_info_dyn.lv_err_pnd "Pending failure status flag" UWORD _CNV_S_2_RANGE__0___1_CM 1 100. 0. 1. DISPLAY_IDENTIFIER LV_ERR_PND[5] ECU_ADDRESS 0xd000414a BIT_MASK 0x800 /end MEASUREMENT
/begin MEASUREMENT fmy_ram_dyn[5].ctr_wup_cyc "Counter for warm-up cycle" UBYTE _CNV_A_R_LINEAR_____0_CM 1 100. 0. 255. DISPLAY_IDENTIFIER CTR_WUP_CYC[5] ECU_ADDRESS 0xd000414c FORMAT "%3.0" /end MEASUREMENT
/begin MEASUREMENT fmy_ram_dyn[5].ctr_frc "Frequency counter : number of occurrence of present failure" UBYTE _CNV_A_R_LINEAR_____0_CM 1 100. 0. 255. DISPLAY_IDENTIFIER CTR_FRC[5] ECU_ADDRESS 0xd000414d FORMAT "%3.0" /end MEASUREMENT
/begin MEASUREMENT fmy_ram_dyn[5].ctr_dc "Counter for driving cycle" UBYTE _CNV_A_R_LINEAR_____0_CM 1 100. 0. 255. DISPLAY_IDENTIFIER CTR_DC[5] ECU_ADDRESS 0xd000414e FORMAT "%3.0" /end MEASUREMENT
/begin MEASUREMENT fmy_ram_dyn[5].idx_frf "" UBYTE _CNV_A_R_LINEAR_____0_CM 1 100. 0. 255. DISPLAY_IDENTIFIER IDX_FRF[5] ECU_ADDRESS 0xd000414f FORMAT "%3.0" /end MEASUREMENT
/begin MEASUREMENT fmy_ram_dyn[5].ctr_dc_err_det "Number of driving cycles since DTC detection" UBYTE _CNV_A_R_LINEAR_____0_CM 1 100. 0. 255. DISPLAY_IDENTIFIER CTR_DC_ERR_DET[5] ECU_ADDRESS 0xd0004150 FORMAT "%3.0" /end MEASUREMENT
/begin MEASUREMENT fmy_ram_dyn[5].ctr_dc_err_det_diag_cdn "Number of DC since DTC detection with diag started" UBYTE _CNV_A_R_LINEAR_____0_CM 1 100. 0. 255. DISPLAY_IDENTIFIER CTR_DC_ERR_DET_DIAG_CDN[5] ECU_ADDRESS 0xd0004151 FORMAT "%3.0" /end MEASUREMENT
/begin MEASUREMENT fmy_ram_dyn[5].ctr_dc_err_det_diag_cmpl "Number of DC since DTC detection with diag completed" UBYTE _CNV_A_R_LINEAR_____0_CM 1 100. 0. 255. DISPLAY_IDENTIFIER CTR_DC_ERR_DET_DIAG_CMPL[5] ECU_ADDRESS 0xd0004152 FORMAT "%3.0" /end MEASUREMENT
/begin MEASUREMENT fmy_ram_dyn[5].ctr_wup_act_mil "Number of WUP since MIL activation" UBYTE _CNV_A_R_LINEAR_____0_CM 1 100. 0. 255. DISPLAY_IDENTIFIER CTR_WUP_ACT_MIL[5] ECU_ADDRESS 0xd0004153 FORMAT "%3.0" /end MEASUREMENT
/begin MEASUREMENT fmy_ram_dyn[6].diag_inst "Index of diagnosis instance XX" UWORD _CNV_S_311_ERRM_RANGE_486_CM 1 100. 0. 310. DISPLAY_IDENTIFIER DIAG_INST[6] ECU_ADDRESS 0xd0004156 /end MEASUREMENT
/begin MEASUREMENT fmy_ram_dyn[6].err_info_dyn.lv_cdn_diag_dc "Flag to detect that diag conditions have been met during DC" UWORD _CNV_S_2_RANGE__0___1_CM 1 100. 0. 1. DISPLAY_IDENTIFIER LV_CDN_DIAG_DC[6] ECU_ADDRESS 0xd0004158 BIT_MASK 0x10 /end MEASUREMENT
/begin MEASUREMENT fmy_ram_dyn[6].err_info_dyn.lv_err_mkd "Marked failure status flag" UWORD _CNV_S_2_RANGE__0___1_CM 1 100. 0. 1. DISPLAY_IDENTIFIER LV_ERR_MKD[6] ECU_ADDRESS 0xd0004158 BIT_MASK 0x20 /end MEASUREMENT
/begin MEASUREMENT fmy_ram_dyn[6].err_info_dyn.lv_dc_max "Flag for the MIL state (on or off) related to the failure" UWORD _CNV_S_2_RANGE__0___1_CM 1 100. 0. 1. DISPLAY_IDENTIFIER LV_DC_MAX[6] ECU_ADDRESS 0xd0004158 BIT_MASK 0x40 /end MEASUREMENT
/begin MEASUREMENT fmy_ram_dyn[6].err_info_dyn.lv_err_disa "Disapeared failure status flag" UWORD _CNV_S_2_RANGE__0___1_CM 1 100. 0. 1. DISPLAY_IDENTIFIER LV_ERR_DISA[6] ECU_ADDRESS 0xd0004158 BIT_MASK 0x80 /end MEASUREMENT
/begin MEASUREMENT fmy_ram_dyn[6].err_info_dyn.lv_err_cfm "Confirmed failure status flag" UWORD _CNV_S_2_RANGE__0___1_CM 1 100. 0. 1. DISPLAY_IDENTIFIER LV_ERR_CFM[6] ECU_ADDRESS 0xd0004158 BIT_MASK 0x100 /end MEASUREMENT
/begin MEASUREMENT fmy_ram_dyn[6].err_info_dyn.lv_err_tmp "Temporary failure status flag" UWORD _CNV_S_2_RANGE__0___1_CM 1 100. 0. 1. DISPLAY_IDENTIFIER LV_ERR_TMP[6] ECU_ADDRESS 0xd0004158 BIT_MASK 0x200 /end MEASUREMENT
/begin MEASUREMENT fmy_ram_dyn[6].err_info_dyn.lv_err_dc "Failure present status for this driving cycle" UWORD _CNV_S_2_RANGE__0___1_CM 1 100. 0. 1. DISPLAY_IDENTIFIER LV_ERR_DC[6] ECU_ADDRESS 0xd0004158 BIT_MASK 0x400 /end MEASUREMENT
/begin MEASUREMENT fmy_ram_dyn[6].err_info_dyn.lv_err_pnd "Pending failure status flag" UWORD _CNV_S_2_RANGE__0___1_CM 1 100. 0. 1. DISPLAY_IDENTIFIER LV_ERR_PND[6] ECU_ADDRESS 0xd0004158 BIT_MASK 0x800 /end MEASUREMENT
/begin MEASUREMENT fmy_ram_dyn[6].ctr_wup_cyc "Counter for warm-up cycle" UBYTE _CNV_A_R_LINEAR_____0_CM 1 100. 0. 255. DISPLAY_IDENTIFIER CTR_WUP_CYC[6] ECU_ADDRESS 0xd000415a FORMAT "%3.0" /end MEASUREMENT
/begin MEASUREMENT fmy_ram_dyn[6].ctr_frc "Frequency counter : number of occurrence of present failure" UBYTE _CNV_A_R_LINEAR_____0_CM 1 100. 0. 255. DISPLAY_IDENTIFIER CTR_FRC[6] ECU_ADDRESS 0xd000415b FORMAT "%3.0" /end MEASUREMENT
/begin MEASUREMENT fmy_ram_dyn[6].ctr_dc "Counter for driving cycle" UBYTE _CNV_A_R_LINEAR_____0_CM 1 100. 0. 255. DISPLAY_IDENTIFIER CTR_DC[6] ECU_ADDRESS 0xd000415c FORMAT "%3.0" /end MEASUREMENT
/begin MEASUREMENT fmy_ram_dyn[6].idx_frf "" UBYTE _CNV_A_R_LINEAR_____0_CM 1 100. 0. 255. DISPLAY_IDENTIFIER IDX_FRF[6] ECU_ADDRESS 0xd000415d FORMAT "%3.0" /end MEASUREMENT
/begin MEASUREMENT fmy_ram_dyn[6].ctr_dc_err_det "Number of driving cycles since DTC detection" UBYTE _CNV_A_R_LINEAR_____0_CM 1 100. 0. 255. DISPLAY_IDENTIFIER CTR_DC_ERR_DET[6] ECU_ADDRESS 0xd000415e FORMAT "%3.0" /end MEASUREMENT
/begin MEASUREMENT fmy_ram_dyn[6].ctr_dc_err_det_diag_cdn "Number of DC since DTC detection with diag started" UBYTE _CNV_A_R_LINEAR_____0_CM 1 100. 0. 255. DISPLAY_IDENTIFIER CTR_DC_ERR_DET_DIAG_CDN[6] ECU_ADDRESS 0xd000415f FORMAT "%3.0" /end MEASUREMENT
/begin MEASUREMENT fmy_ram_dyn[6].ctr_dc_err_det_diag_cmpl "Number of DC since DTC detection with diag completed" UBYTE _CNV_A_R_LINEAR_____0_CM 1 100. 0. 255. DISPLAY_IDENTIFIER CTR_DC_ERR_DET_DIAG_CMPL[6] ECU_ADDRESS 0xd0004160 FORMAT "%3.0" /end MEASUREMENT
/begin MEASUREMENT fmy_ram_dyn[6].ctr_wup_act_mil "Number of WUP since MIL activation" UBYTE _CNV_A_R_LINEAR_____0_CM 1 100. 0. 255. DISPLAY_IDENTIFIER CTR_WUP_ACT_MIL[6] ECU_ADDRESS 0xd0004161 FORMAT "%3.0" /end MEASUREMENT
/begin MEASUREMENT fmy_ram_dyn[7].diag_inst "Index of diagnosis instance XX" UWORD _CNV_S_311_ERRM_RANGE_486_CM 1 100. 0. 310. DISPLAY_IDENTIFIER DIAG_INST[7] ECU_ADDRESS 0xd0004164 /end MEASUREMENT
/begin MEASUREMENT fmy_ram_dyn[7].err_info_dyn.lv_cdn_diag_dc "Flag to detect that diag conditions have been met during DC" UWORD _CNV_S_2_RANGE__0___1_CM 1 100. 0. 1. DISPLAY_IDENTIFIER LV_CDN_DIAG_DC[7] ECU_ADDRESS 0xd0004166 BIT_MASK 0x10 /end MEASUREMENT
/begin MEASUREMENT fmy_ram_dyn[7].err_info_dyn.lv_err_mkd "Marked failure status flag" UWORD _CNV_S_2_RANGE__0___1_CM 1 100. 0. 1. DISPLAY_IDENTIFIER LV_ERR_MKD[7] ECU_ADDRESS 0xd0004166 BIT_MASK 0x20 /end MEASUREMENT
/begin MEASUREMENT fmy_ram_dyn[7].err_info_dyn.lv_dc_max "Flag for the MIL state (on or off) related to the failure" UWORD _CNV_S_2_RANGE__0___1_CM 1 100. 0. 1. DISPLAY_IDENTIFIER LV_DC_MAX[7] ECU_ADDRESS 0xd0004166 BIT_MASK 0x40 /end MEASUREMENT
/begin MEASUREMENT fmy_ram_dyn[7].err_info_dyn.lv_err_disa "Disapeared failure status flag" UWORD _CNV_S_2_RANGE__0___1_CM 1 100. 0. 1. DISPLAY_IDENTIFIER LV_ERR_DISA[7] ECU_ADDRESS 0xd0004166 BIT_MASK 0x80 /end MEASUREMENT
/begin MEASUREMENT fmy_ram_dyn[7].err_info_dyn.lv_err_cfm "Confirmed failure status flag" UWORD _CNV_S_2_RANGE__0___1_CM 1 100. 0. 1. DISPLAY_IDENTIFIER LV_ERR_CFM[7] ECU_ADDRESS 0xd0004166 BIT_MASK 0x100 /end MEASUREMENT
/begin MEASUREMENT fmy_ram_dyn[7].err_info_dyn.lv_err_tmp "Temporary failure status flag" UWORD _CNV_S_2_RANGE__0___1_CM 1 100. 0. 1. DISPLAY_IDENTIFIER LV_ERR_TMP[7] ECU_ADDRESS 0xd0004166 BIT_MASK 0x200 /end MEASUREMENT
/begin MEASUREMENT fmy_ram_dyn[7].err_info_dyn.lv_err_dc "Failure present status for this driving cycle" UWORD _CNV_S_2_RANGE__0___1_CM 1 100. 0. 1. DISPLAY_IDENTIFIER LV_ERR_DC[7] ECU_ADDRESS 0xd0004166 BIT_MASK 0x400 /end MEASUREMENT
/begin MEASUREMENT fmy_ram_dyn[7].err_info_dyn.lv_err_pnd "Pending failure status flag" UWORD _CNV_S_2_RANGE__0___1_CM 1 100. 0. 1. DISPLAY_IDENTIFIER LV_ERR_PND[7] ECU_ADDRESS 0xd0004166 BIT_MASK 0x800 /end MEASUREMENT
/begin MEASUREMENT fmy_ram_dyn[7].ctr_wup_cyc "Counter for warm-up cycle" UBYTE _CNV_A_R_LINEAR_____0_CM 1 100. 0. 255. DISPLAY_IDENTIFIER CTR_WUP_CYC[7] ECU_ADDRESS 0xd0004168 FORMAT "%3.0" /end MEASUREMENT
/begin MEASUREMENT fmy_ram_dyn[7].ctr_frc "Frequency counter : number of occurrence of present failure" UBYTE _CNV_A_R_LINEAR_____0_CM 1 100. 0. 255. DISPLAY_IDENTIFIER CTR_FRC[7] ECU_ADDRESS 0xd0004169 FORMAT "%3.0" /end MEASUREMENT
/begin MEASUREMENT fmy_ram_dyn[7].ctr_dc "Counter for driving cycle" UBYTE _CNV_A_R_LINEAR_____0_CM 1 100. 0. 255. DISPLAY_IDENTIFIER CTR_DC[7] ECU_ADDRESS 0xd000416a FORMAT "%3.0" /end MEASUREMENT
/begin MEASUREMENT fmy_ram_dyn[7].idx_frf "" UBYTE _CNV_A_R_LINEAR_____0_CM 1 100. 0. 255. DISPLAY_IDENTIFIER IDX_FRF[7] ECU_ADDRESS 0xd000416b FORMAT "%3.0" /end MEASUREMENT
/begin MEASUREMENT fmy_ram_dyn[7].ctr_dc_err_det "Number of driving cycles since DTC detection" UBYTE _CNV_A_R_LINEAR_____0_CM 1 100. 0. 255. DISPLAY_IDENTIFIER CTR_DC_ERR_DET[7] ECU_ADDRESS 0xd000416c FORMAT "%3.0" /end MEASUREMENT
/begin MEASUREMENT fmy_ram_dyn[7].ctr_dc_err_det_diag_cdn "Number of DC since DTC detection with diag started" UBYTE _CNV_A_R_LINEAR_____0_CM 1 100. 0. 255. DISPLAY_IDENTIFIER CTR_DC_ERR_DET_DIAG_CDN[7] ECU_ADDRESS 0xd000416d FORMAT "%3.0" /end MEASUREMENT
/begin MEASUREMENT fmy_ram_dyn[7].ctr_dc_err_det_diag_cmpl "Number of DC since DTC detection with diag completed" UBYTE _CNV_A_R_LINEAR_____0_CM 1 100. 0. 255. DISPLAY_IDENTIFIER CTR_DC_ERR_DET_DIAG_CMPL[7] ECU_ADDRESS 0xd000416e FORMAT "%3.0" /end MEASUREMENT
/begin MEASUREMENT fmy_ram_dyn[7].ctr_wup_act_mil "Number of WUP since MIL activation" UBYTE _CNV_A_R_LINEAR_____0_CM 1 100. 0. 255. DISPLAY_IDENTIFIER CTR_WUP_ACT_MIL[7] ECU_ADDRESS 0xd000416f FORMAT "%3.0" /end MEASUREMENT
/begin MEASUREMENT fmy_ram_dyn[8].diag_inst "Index of diagnosis instance XX" UWORD _CNV_S_311_ERRM_RANGE_486_CM 1 100. 0. 310. DISPLAY_IDENTIFIER DIAG_INST[8] ECU_ADDRESS 0xd0004172 /end MEASUREMENT
/begin MEASUREMENT fmy_ram_dyn[8].err_info_dyn.lv_cdn_diag_dc "Flag to detect that diag conditions have been met during DC" UWORD _CNV_S_2_RANGE__0___1_CM 1 100. 0. 1. DISPLAY_IDENTIFIER LV_CDN_DIAG_DC[8] ECU_ADDRESS 0xd0004174 BIT_MASK 0x10 /end MEASUREMENT
/begin MEASUREMENT fmy_ram_dyn[8].err_info_dyn.lv_err_mkd "Marked failure status flag" UWORD _CNV_S_2_RANGE__0___1_CM 1 100. 0. 1. DISPLAY_IDENTIFIER LV_ERR_MKD[8] ECU_ADDRESS 0xd0004174 BIT_MASK 0x20 /end MEASUREMENT
/begin MEASUREMENT fmy_ram_dyn[8].err_info_dyn.lv_dc_max "Flag for the MIL state (on or off) related to the failure" UWORD _CNV_S_2_RANGE__0___1_CM 1 100. 0. 1. DISPLAY_IDENTIFIER LV_DC_MAX[8] ECU_ADDRESS 0xd0004174 BIT_MASK 0x40 /end MEASUREMENT
/begin MEASUREMENT fmy_ram_dyn[8].err_info_dyn.lv_err_disa "Disapeared failure status flag" UWORD _CNV_S_2_RANGE__0___1_CM 1 100. 0. 1. DISPLAY_IDENTIFIER LV_ERR_DISA[8] ECU_ADDRESS 0xd0004174 BIT_MASK 0x80 /end MEASUREMENT
/begin MEASUREMENT fmy_ram_dyn[8].err_info_dyn.lv_err_cfm "Confirmed failure status flag" UWORD _CNV_S_2_RANGE__0___1_CM 1 100. 0. 1. DISPLAY_IDENTIFIER LV_ERR_CFM[8] ECU_ADDRESS 0xd0004174 BIT_MASK 0x100 /end MEASUREMENT
/begin MEASUREMENT fmy_ram_dyn[8].err_info_dyn.lv_err_tmp "Temporary failure status flag" UWORD _CNV_S_2_RANGE__0___1_CM 1 100. 0. 1. DISPLAY_IDENTIFIER LV_ERR_TMP[8] ECU_ADDRESS 0xd0004174 BIT_MASK 0x200 /end MEASUREMENT
/begin MEASUREMENT fmy_ram_dyn[8].err_info_dyn.lv_err_dc "Failure present status for this driving cycle" UWORD _CNV_S_2_RANGE__0___1_CM 1 100. 0. 1. DISPLAY_IDENTIFIER LV_ERR_DC[8] ECU_ADDRESS 0xd0004174 BIT_MASK 0x400 /end MEASUREMENT
/begin MEASUREMENT fmy_ram_dyn[8].err_info_dyn.lv_err_pnd "Pending failure status flag" UWORD _CNV_S_2_RANGE__0___1_CM 1 100. 0. 1. DISPLAY_IDENTIFIER LV_ERR_PND[8] ECU_ADDRESS 0xd0004174 BIT_MASK 0x800 /end MEASUREMENT
/begin MEASUREMENT fmy_ram_dyn[8].ctr_wup_cyc "Counter for warm-up cycle" UBYTE _CNV_A_R_LINEAR_____0_CM 1 100. 0. 255. DISPLAY_IDENTIFIER CTR_WUP_CYC[8] ECU_ADDRESS 0xd0004176 FORMAT "%3.0" /end MEASUREMENT
/begin MEASUREMENT fmy_ram_dyn[8].ctr_frc "Frequency counter : number of occurrence of present failure" UBYTE _CNV_A_R_LINEAR_____0_CM 1 100. 0. 255. DISPLAY_IDENTIFIER CTR_FRC[8] ECU_ADDRESS 0xd0004177 FORMAT "%3.0" /end MEASUREMENT
/begin MEASUREMENT fmy_ram_dyn[8].ctr_dc "Counter for driving cycle" UBYTE _CNV_A_R_LINEAR_____0_CM 1 100. 0. 255. DISPLAY_IDENTIFIER CTR_DC[8] ECU_ADDRESS 0xd0004178 FORMAT "%3.0" /end MEASUREMENT
/begin MEASUREMENT fmy_ram_dyn[8].idx_frf "" UBYTE _CNV_A_R_LINEAR_____0_CM 1 100. 0. 255. DISPLAY_IDENTIFIER IDX_FRF[8] ECU_ADDRESS 0xd0004179 FORMAT "%3.0" /end MEASUREMENT
/begin MEASUREMENT fmy_ram_dyn[8].ctr_dc_err_det "Number of driving cycles since DTC detection" UBYTE _CNV_A_R_LINEAR_____0_CM 1 100. 0. 255. DISPLAY_IDENTIFIER CTR_DC_ERR_DET[8] ECU_ADDRESS 0xd000417a FORMAT "%3.0" /end MEASUREMENT
/begin MEASUREMENT fmy_ram_dyn[8].ctr_dc_err_det_diag_cdn "Number of DC since DTC detection with diag started" UBYTE _CNV_A_R_LINEAR_____0_CM 1 100. 0. 255. DISPLAY_IDENTIFIER CTR_DC_ERR_DET_DIAG_CDN[8] ECU_ADDRESS 0xd000417b FORMAT "%3.0" /end MEASUREMENT
/begin MEASUREMENT fmy_ram_dyn[8].ctr_dc_err_det_diag_cmpl "Number of DC since DTC detection with diag completed" UBYTE _CNV_A_R_LINEAR_____0_CM 1 100. 0. 255. DISPLAY_IDENTIFIER CTR_DC_ERR_DET_DIAG_CMPL[8] ECU_ADDRESS 0xd000417c FORMAT "%3.0" /end MEASUREMENT
/begin MEASUREMENT fmy_ram_dyn[8].ctr_wup_act_mil "Number of WUP since MIL activation" UBYTE _CNV_A_R_LINEAR_____0_CM 1 100. 0. 255. DISPLAY_IDENTIFIER CTR_WUP_ACT_MIL[8] ECU_ADDRESS 0xd000417d FORMAT "%3.0" /end MEASUREMENT
/begin MEASUREMENT fmy_ram_dyn[9].diag_inst "Index of diagnosis instance XX" UWORD _CNV_S_311_ERRM_RANGE_486_CM 1 100. 0. 310. DISPLAY_IDENTIFIER DIAG_INST[9] ECU_ADDRESS 0xd0004180 /end MEASUREMENT
/begin MEASUREMENT fmy_ram_dyn[9].err_info_dyn.lv_cdn_diag_dc "Flag to detect that diag conditions have been met during DC" UWORD _CNV_S_2_RANGE__0___1_CM 1 100. 0. 1. DISPLAY_IDENTIFIER LV_CDN_DIAG_DC[9] ECU_ADDRESS 0xd0004182 BIT_MASK 0x10 /end MEASUREMENT
/begin MEASUREMENT fmy_ram_dyn[9].err_info_dyn.lv_err_mkd "Marked failure status flag" UWORD _CNV_S_2_RANGE__0___1_CM 1 100. 0. 1. DISPLAY_IDENTIFIER LV_ERR_MKD[9] ECU_ADDRESS 0xd0004182 BIT_MASK 0x20 /end MEASUREMENT
/begin MEASUREMENT fmy_ram_dyn[9].err_info_dyn.lv_dc_max "Flag for the MIL state (on or off) related to the failure" UWORD _CNV_S_2_RANGE__0___1_CM 1 100. 0. 1. DISPLAY_IDENTIFIER LV_DC_MAX[9] ECU_ADDRESS 0xd0004182 BIT_MASK 0x40 /end MEASUREMENT
/begin MEASUREMENT fmy_ram_dyn[9].err_info_dyn.lv_err_disa "Disapeared failure status flag" UWORD _CNV_S_2_RANGE__0___1_CM 1 100. 0. 1. DISPLAY_IDENTIFIER LV_ERR_DISA[9] ECU_ADDRESS 0xd0004182 BIT_MASK 0x80 /end MEASUREMENT
/begin MEASUREMENT fmy_ram_dyn[9].err_info_dyn.lv_err_cfm "Confirmed failure status flag" UWORD _CNV_S_2_RANGE__0___1_CM 1 100. 0. 1. DISPLAY_IDENTIFIER LV_ERR_CFM[9] ECU_ADDRESS 0xd0004182 BIT_MASK 0x100 /end MEASUREMENT
/begin MEASUREMENT fmy_ram_dyn[9].err_info_dyn.lv_err_tmp "Temporary failure status flag" UWORD _CNV_S_2_RANGE__0___1_CM 1 100. 0. 1. DISPLAY_IDENTIFIER LV_ERR_TMP[9] ECU_ADDRESS 0xd0004182 BIT_MASK 0x200 /end MEASUREMENT
/begin MEASUREMENT fmy_ram_dyn[9].err_info_dyn.lv_err_dc "Failure present status for this driving cycle" UWORD _CNV_S_2_RANGE__0___1_CM 1 100. 0. 1. DISPLAY_IDENTIFIER LV_ERR_DC[9] ECU_ADDRESS 0xd0004182 BIT_MASK 0x400 /end MEASUREMENT
/begin MEASUREMENT fmy_ram_dyn[9].err_info_dyn.lv_err_pnd "Pending failure status flag" UWORD _CNV_S_2_RANGE__0___1_CM 1 100. 0. 1. DISPLAY_IDENTIFIER LV_ERR_PND[9] ECU_ADDRESS 0xd0004182 BIT_MASK 0x800 /end MEASUREMENT
/begin MEASUREMENT fmy_ram_dyn[9].ctr_wup_cyc "Counter for warm-up cycle" UBYTE _CNV_A_R_LINEAR_____0_CM 1 100. 0. 255. DISPLAY_IDENTIFIER CTR_WUP_CYC[9] ECU_ADDRESS 0xd0004184 FORMAT "%3.0" /end MEASUREMENT
/begin MEASUREMENT fmy_ram_dyn[9].ctr_frc "Frequency counter : number of occurrence of present failure" UBYTE _CNV_A_R_LINEAR_____0_CM 1 100. 0. 255. DISPLAY_IDENTIFIER CTR_FRC[9] ECU_ADDRESS 0xd0004185 FORMAT "%3.0" /end MEASUREMENT
/begin MEASUREMENT fmy_ram_dyn[9].ctr_dc "Counter for driving cycle" UBYTE _CNV_A_R_LINEAR_____0_CM 1 100. 0. 255. DISPLAY_IDENTIFIER CTR_DC[9] ECU_ADDRESS 0xd0004186 FORMAT "%3.0" /end MEASUREMENT
/begin MEASUREMENT fmy_ram_dyn[9].idx_frf "" UBYTE _CNV_A_R_LINEAR_____0_CM 1 100. 0. 255. DISPLAY_IDENTIFIER IDX_FRF[9] ECU_ADDRESS 0xd0004187 FORMAT "%3.0" /end MEASUREMENT
/begin MEASUREMENT fmy_ram_dyn[9].ctr_dc_err_det "Number of driving cycles since DTC detection" UBYTE _CNV_A_R_LINEAR_____0_CM 1 100. 0. 255. DISPLAY_IDENTIFIER CTR_DC_ERR_DET[9] ECU_ADDRESS 0xd0004188 FORMAT "%3.0" /end MEASUREMENT
/begin MEASUREMENT fmy_ram_dyn[9].ctr_dc_err_det_diag_cdn "Number of DC since DTC detection with diag started" UBYTE _CNV_A_R_LINEAR_____0_CM 1 100. 0. 255. DISPLAY_IDENTIFIER CTR_DC_ERR_DET_DIAG_CDN[9] ECU_ADDRESS 0xd0004189 FORMAT "%3.0" /end MEASUREMENT
/begin MEASUREMENT fmy_ram_dyn[9].ctr_dc_err_det_diag_cmpl "Number of DC since DTC detection with diag completed" UBYTE _CNV_A_R_LINEAR_____0_CM 1 100. 0. 255. DISPLAY_IDENTIFIER CTR_DC_ERR_DET_DIAG_CMPL[9] ECU_ADDRESS 0xd000418a FORMAT "%3.0" /end MEASUREMENT
/begin MEASUREMENT fmy_ram_dyn[9].ctr_wup_act_mil "Number of WUP since MIL activation" UBYTE _CNV_A_R_LINEAR_____0_CM 1 100. 0. 255. DISPLAY_IDENTIFIER CTR_WUP_ACT_MIL[9] ECU_ADDRESS 0xd000418b FORMAT "%3.0" /end MEASUREMENT
/begin CHARACTERISTIC c_ctr_max_wup_cyc "Initialization value for the warm-up cycle of diagnostics" VALUE 0xa10051bf _REC_VAL_20_u1 255. _CNV_A_R_LINEAR_____0_CM 0. 255. DISPLAY_IDENTIFIER C_CTR_MAX_WUP_CYC FORMAT "%3.0" /end CHARACTERISTIC
/begin CHARACTERISTIC lc_err_fmy_clr "Boolean to clear failure memory when set to 1" VALUE 0xa10051d7 _REC_VAL_20_u1 1. _CNV_A_R_LINEAR_____0_CM 0. 1. DISPLAY_IDENTIFIER LC_ERR_FMY_CLR FORMAT "%1.0" /end CHARACTERISTIC
/begin MEASUREMENT state_ready_obd_1 "Readiness code completion status 1" UBYTE _CNV_A_R_LINEAR_____0_CM 1 100. 0. 255. DISPLAY_IDENTIFIER STATE_READY_OBD_1 ECU_ADDRESS 0xd0003546 FORMAT "%3.0" /end MEASUREMENT
/begin MEASUREMENT state_ready_obd_2 "Readiness code completion status 2" UBYTE _CNV_A_R_LINEAR_____0_CM 1 100. 0. 255. DISPLAY_IDENTIFIER STATE_READY_OBD_2 ECU_ADDRESS 0xd0003547 FORMAT "%3.0" /end MEASUREMENT
/begin MEASUREMENT t_act_mil "Minutes run by the engine while MIL activated" UWORD _CNV_A_R_LINEAR_____77_CM 1 100. 0. 65535. DISPLAY_IDENTIFIER T_ACT_MIL ECU_ADDRESS 0xd0004a44 FORMAT "%5.0" /end MEASUREMENT
/begin MEASUREMENT state_ena_obd "Monitor enable status for the current DC" UWORD _CNV_A_R_LINEAR_____0_CM 1 100. 0. 65535. DISPLAY_IDENTIFIER STATE_ENA_OBD ECU_ADDRESS 0xd0004a42 FORMAT "%5.0" /end MEASUREMENT
/begin MEASUREMENT state_cmpl_obd "Monitor completion status for the current DC" UWORD _CNV_A_R_LINEAR_____0_CM 1 100. 0. 65535. DISPLAY_IDENTIFIER STATE_CMPL_OBD ECU_ADDRESS 0xd0004a40 FORMAT "%5.0" /end MEASUREMENT
/begin MEASUREMENT t_dtc_clr "Time since DTC cleared" UWORD _CNV_A_R_LINEAR_____77_CM 1 100. 0. 65535. DISPLAY_IDENTIFIER T_DTC_CLR ECU_ADDRESS 0xd0004a46 FORMAT "%5.0" /end MEASUREMENT
/begin MEASUREMENT t_act_mil_60 "Seconds run by the engine while MIL activated" UBYTE _CNV_A_R_LINEAR_____35_CM 1 100. 0. 60. DISPLAY_IDENTIFIER T_ACT_MIL_60 ECU_ADDRESS 0xc0001dfd FORMAT "%3.0" /end MEASUREMENT
/begin COMPU_METHOD _CNV_A_R_LINEAR_____0_CM "" RAT_FUNC "%6.3" "-" COEFFS 0 1. 0. 0 0 1 /end COMPU_METHOD
/begin COMPU_METHOD _CNV_S_2_RANGE__0___1_CM "" TAB_VERB "%6.3" "-" COMPU_TAB_REF _CNV_S_2_RANGE__0___1 /end COMPU_METHOD
/begin COMPU_VTAB _CNV_S_2_RANGE__0___1 "" TAB_VERB 2 0 "0" 1 "1" /end COMPU_VTAB
/begin COMPU_METHOD _CNV_A_R_LINEAR_____35_CM "" RAT_FUNC "%6.3" "s" COEFFS 0 1. 0. 0 0 1 /end COMPU_METHOD
/begin COMPU_METHOD _CNV_A_R_LINEAR_____77_CM "" RAT_FUNC "%6.3" "min" COEFFS 0 1. 0. 0 0 1 /end COMPU_METHOD
/begin COMPU_METHOD _CNV_S_311_ERRM_RANGE_486_CM "" TAB_VERB "%6.3" "" COMPU_TAB_REF _CNV_S_311_ERRM_RANGE_486 /end COMPU_METHOD
/begin COMPU_VTAB _CNV_S_311_ERRM_RANGE_486 "" TAB_VERB 311 0 "NO_ERROR" 1 "IMOB_1" 2 "IMOB_2" 3 "IMOB_3" 4 "TCO_EL" 5 "TCO_GRD" 6 "TCO_STUCK" 7 "TCO_PLAUS" 8 "TCO_2_EL" 9 "TCO_2_GRD" 10 "TCO_2_PLAUS" 11 "ECT_EL" 12 "ECF_EL_1" 13 "ECFPWM_FB_1" 14 "TH" 15 "FTL_MIN" 16 "TIA_EL" 17 "AMP" 18 "AMP_PLAUS" 19 "MAF" 20 "IV_0" 21 "IV_1" 22 "IV_2" 23 "IV_3" 24 "IV_4" 25 "IV_5" 26 "RLY_EFP" 27 "EL_CPS" 28 "SLV_IVVT_IN" 29 "SLV_IVVT_EX" 30 "ECU_CKS" 31 "TOUT_ETCU_1" 32 "TOUT_ETCU_2" 33 "TOUT_ICL_2" 34 "TOUT_ICL_3" 35 "TOUT_ASR_1" 36 "TOUT_ASR_3" 37 "TOUT_ASR_4" 38 "TOUT_PSTE_1" 39 "TOUT_AMT_1" 40 "VS" 41 "KNKS_1" 42 "KNKS_2" 43 "IGC_SCP_0" 44 "IGC_SCP_1" 45 "IGC_SCP_2" 46 "IGC_SCP_3" 47 "IGC_SCP_4" 48 "IGC_SCP_5" 49 "IGC_SCG_0" 50 "IGC_SCG_1" 51 "IGC_SCG_2" 52 "IGC_SCG_3" 53 "IGC_SCG_4" 54 "IGC_SCG_5" 55 "IGC_OL_0" 56 "IGC_OL_1" 57 "IGC_OL_2" 58 "IGC_OL_3" 59 "IGC_OL_4" 60 "IGC_OL_5" 61 "TPS_1" 62 "TPS_2" 63 "TPS_MAF_1" 64 "TPS_MAF_2" 65 "TPS_RATIO" 66 "V_REF_1" 67 "V_REF_2" 68 "PVS_1" 69 "PVS_2" 70 "PVS_RATIO" 71 "PVS_DOUBLE" 72 "PVS_BLS_NOT_PLAUS" 73 "MTC_DR" 74 "MTC_CTL_1" 75 "MTC_CTL_2" 76 "MTC_CTL_3" 77 "TPS_AD" 78 "TPS_AD_BOL" 79 "TPS_ST_CHK_1" 80 "TPS_ST_CHK_2" 81 "GEN" 82 "GEN_DIAG" 83 "ALTER_BN" 84 "ALTER_BN_BAT" 85 "VIM_1_EL" 86 "VIM_2_EL" 87 "VIMPWM_1_FB" 88 "VIMPWM_2_FB" 89 "T_ES" 90 "MAP_DIP_PLAUS" 91 "TOIL_LEVEL" 92 "VIM_PLAUS" 93 "ALTER_BN_RGN" 94 "PER_CAM_IN_1" 95 "PER_CAM_EX_1" 96 "SYN_CAM_IN_1" 97 "SYN_CAM_EX_1" 98 "REF_CRK_CAM_IN_1" 99 "REF_CRK_CAM_EX_1" 100 "CRK_TOOTH" 101 "CRK_TOOTH_PER" 102 "CRK_SYN" 103 "CRK_PLAUS" 104 "PLAUS_CAM_IN_1" 105 "PLAUS_CAM_EX_1" 106 "SYN_CRK_CAM_IN_1" 107 "SYN_CRK_CAM_EX_1" 108 "CAN_BOFF_B" 109 "CAN_BOFF_C" 110 "RLY_MAIN" 111 "RLY_MAIN_DLY" 112 "RLY_ACCOUT" 113 "ISC" 114 "IM_BLS_PLAUS" 115 "IM_BTS_PLAUS" 116 "MSW_TOG" 117 "MSW_2" 118 "MSW_3" 119 "MIS_0" 120 "MIS_1" 121 "MIS_2" 122 "MIS_3" 123 "MIS_4" 124 "MIS_5" 125 "MIS_MPL" 126 "MIS_FTL_L" 127 "FSD_1" 128 "FSD_2" 129 "EF" 130 "TECU" 131 "EBOX_CFA" 132 "ECU_RAM" 133 "TQI_LIM" 134 "OBD2_LSH_DOWN_1" 135 "OBD2_LSH_DOWN_2" 136 "DMTLS" 137 "DMTL_PUMP" 138 "DMTLM" 139 "ROUGH_LEAK" 140 "SMALL_LEAK" 141 "CHK_FUC" 142 "SOF" 143 "SOF_REQ" 144 "RLY_CRCV_HEAT" 145 "RLY_ST" 146 "BSD" 147 "POIL_SWI" 148 "TOUT_EFP_CAN" 149 "DIAGCPS" 150 "DCC" 151 "LDM" 152 "DMTLH" 153 "CS" 154 "SPI_MPS" 155 "SPI_KNK" 156 "BN_TQ_DCC" 157 "BN_TQ_PSTE_2" 158 "BN_ARS" 159 "BN_CAS" 160 "BN_TQ_TCS" 161 "BN_VS_TCS" 162 "BN_TCS" 163 "BN_TQ_ETCU" 164 "BN_ETCU" 165 "BN_ETCU_2" 166 "BN_ETCU_DISP" 167 "BN_TQ_AMT" 168 "BN_ACC" 169 "BN_T_ICL" 170 "BN_VEH_MOD" 171 "BN_KM_ICL" 172 "BN_ICL" 173 "BN_POW_VB" 174 "BN_POW_GEN" 175 "BN_MSW" 176 "BN_ANG_PSTE" 177 "BN_GEAR_REV" 178 "BN_LTG_HDLP_L" 179 "BN_LDM" 180 "BN_TRL" 181 "BN_HIV" 182 "BN_T_CLK" 183 "BN_EFP_CRASH" 184 "BN_EFP" 185 "LOAD_TPS_PLAUS" 186 "EGY_MIN" 187 "EFP_CRASH" 188 "EFP" 189 "LOCAN_BOFF" 190 "CWP_PLAUS" 191 "CWP_INT_OFF" 192 "CWP_PWR" 193 "CWP_COM_PLAUS" 194 "QOIL_SENS" 195 "BAT_SENS" 196 "BAT_SENS_IT" 197 "BAT_SENS_IT_EL" 198 "ECU_NVMY" 199 "GS" 200 "PLAUS_IGK_BN" 201 "TQ_REQ_CAN" 202 "MAP_DIP_SENS" 203 "MEC_IVVT_IN" 204 "MEC_IVVT_EX" 205 "TOUT_NOX_SENS_1" 206 "TOUT_NOX_SENS_2" 207 "VVL_ROT" 208 "RLY_VVL" 209 "NOX_SENS_1" 210 "OVL_ECU_VVL" 211 "DR_SC_VVL" 212 "CRIT_OVL_ECU_VVL" 213 "NOX_SENS_2" 214 "CUR_H_VVL" 215 "TEG_PCAT_DOWN_1" 216 "TEG_PCAT_DOWN_2" 217 "T_SEG_ER" 218 "SEG_AD_ER" 219 "VS_PLAUS" 220 "FTL_OBD" 221 "FTL_CAN" 222 "TIA_PLAUS" 223 "TAM_CAN" 224 "TAM_PLAUS" 225 "MAP_DIP_SHIFT" 226 "CAT_DIAG_1" 227 "CAT_DIAG_2" 228 "CAT_DIAG_AFL_1" 229 "CAT_DIAG_AFL_2" 230 "SCG_LS_DOWN_1" 231 "SCP_LS_DOWN_1" 232 "OC_LS_DOWN_1" 233 "PUC_LS_DOWN_1" 234 "FL_LS_DOWN_1" 235 "LSL_UP_IF_1" 236 "EL_LSL_UP_1" 237 "LSH_UP_1" 238 "LSH_DOWN_1" 239 "VLS_DOWN_DIF_1" 240 "LSH_LSL_UP_1" 241 "AIR_LSL_UP_1" 242 "PUE_LS_DOWN_1" 243 "SWT_LS_DOWN_1" 244 "OBD_LSH_DOWN_1" 245 "DYN_VLD_LS_UP_1" 246 "PUC_VLD_LS_UP_1" 247 "OBD_VLD_LSH_UP_1" 248 "CHK_LS_DOWN_1" 249 "SHIFT_AFL_LSL_UP_1" 250 "SHIFT_AFR_LSL_UP_1" 251 "OC_LSL_UP_1" 252 "DELTA_I_LAM_1" 253 "RGN_NT_LS_DOWN_1" 254 "CHG_LS_DOWN" 255 "SCG_LS_DOWN_2" 256 "SCP_LS_DOWN_2" 257 "OC_LS_DOWN_2" 258 "PUC_LS_DOWN_2" 259 "FL_LS_DOWN_2" 260 "LSL_UP_IF_2" 261 "EL_LSL_UP_2" 262 "LSH_UP_2" 263 "LSH_DOWN_2" 264 "VLS_DOWN_DIF_2" 265 "LSH_LSL_UP_2" 266 "AIR_LSL_UP_2" 267 "PUE_LS_DOWN_2" 268 "SWT_LS_DOWN_2" 269 "OBD_LSH_DOWN_2" 270 "DYN_VLD_LS_UP_2" 271 "PUC_VLD_LS_UP_2" 272 "OBD_VLD_LSH_UP_2" 273 "CHK_LS_DOWN_2" 274 "SHIFT_AFL_LSL_UP_2" 275 "SHIFT_AFR_LSL_UP_2" 276 "OC_LSL_UP_2" 277 "DELTA_I_LAM_2" 278 "RGN_NT_LS_DOWN_2" 279 "CHG_LS_UP" 280 "ALTER_COM" 281 "CWP_COM" 282 "QOIL_COM" 283 "SENS_BAT_SMT_COM" 284 "ECRASPWM_FB" 285 "ECRAS_EL" 286 "WARM_RST" 287 "ACR_AD" 288 "SENS_ACR" 289 "ACR_CTL" 290 "ACR_DR" 291 "VAR_COD" 292 "VEH_POW_VAR" 293 "FUP_MFP_PLAUS" 294 "H_PRS_SYS" 295 "VCV_PLAUS" 296 "FUP" 297 "VCV" 298 "FUP_EFP" 299 "EFPPWM_PLAUS" 300 "L_PRS_SYS" 301 "CONV_MON_1" 302 "N_32_MON_1" 303 "PVS_MON_1" 304 "TQ_DIF_ISC_MON_1" 305 "TQ_REQ_MON_1" 306 "TQ_EXT_MON_1" 307 "TQI_AV_MON_1" 308 "TQI_N_MAX_MON_1" 309 "MFF_MON_1" 310 "CRU_MON_1" /end COMPU_VTAB
/begin RECORD_LAYOUT _REC_VAL_20_u1 FNC_VALUES 1 UBYTE COLUMN_DIR DIRECT /end RECORD_LAYOUT
/begin RECORD_LAYOUT _REC_AXS_20_u1 NO_AXIS_PTS_X 1 UBYTE AXIS_PTS_X 2 UBYTE INDEX_INCR DIRECT /end RECORD_LAYOUT
/begin RECORD_LAYOUT _REC_CUR_20_u1_u1 FNC_VALUES 1 UBYTE COLUMN_DIR DIRECT /end RECORD_LAYOUT
/begin FUNCTION ERRM_Dyn_Error_Management "Dyn_Error_Management_Core" /begin DEF_CHARACTERISTIC c_ctr_max_wup_cyc lc_err_fmy_clr /end DEF_CHARACTERISTIC
 /begin OUT_MEASUREMENT ctr_err_dyn_nr fmy_ram_dyn[0].diag_inst fmy_ram_dyn[0].err_info_dyn.lv_cdn_diag_dc fmy_ram_dyn[0].err_info_dyn.lv_err_mkd fmy_ram_dyn[0].err_info_dyn.lv_dc_max fmy_ram_dyn[0].err_info_dyn.lv_err_disa fmy_ram_dyn[0].err_info_dyn.lv_err_cfm fmy_ram_dyn[0].err_info_dyn.lv_err_tmp fmy_ram_dyn[0].err_info_dyn.lv_err_dc fmy_ram_dyn[0].err_info_dyn.lv_err_pnd fmy_ram_dyn[0].ctr_wup_cyc fmy_ram_dyn[0].ctr_frc fmy_ram_dyn[0].ctr_dc fmy_ram_dyn[0].idx_frf fmy_ram_dyn[0].ctr_dc_err_det fmy_ram_dyn[0].ctr_dc_err_det_diag_cdn fmy_ram_dyn[0].ctr_dc_err_det_diag_cmpl fmy_ram_dyn[0].ctr_wup_act_mil fmy_ram_dyn[1].diag_inst fmy_ram_dyn[1].err_info_dyn.lv_cdn_diag_dc fmy_ram_dyn[1].err_info_dyn.lv_err_mkd fmy_ram_dyn[1].err_info_dyn.lv_dc_max fmy_ram_dyn[1].err_info_dyn.lv_err_disa fmy_ram_dyn[1].err_info_dyn.lv_err_cfm fmy_ram_dyn[1].err_info_dyn.lv_err_tmp fmy_ram_dyn[1].err_info_dyn.lv_err_dc fmy_ram_dyn[1].err_info_dyn.lv_err_pnd fmy_ram_dyn[1].ctr_wup_cyc fmy_ram_dyn[1].ctr_frc fmy_ram_dyn[1].ctr_dc fmy_ram_dyn[1].idx_frf fmy_ram_dyn[1].ctr_dc_err_det fmy_ram_dyn[1].ctr_dc_err_det_diag_cdn fmy_ram_dyn[1].ctr_dc_err_det_diag_cmpl fmy_ram_dyn[1].ctr_wup_act_mil fmy_ram_dyn[2].diag_inst fmy_ram_dyn[2].err_info_dyn.lv_cdn_diag_dc fmy_ram_dyn[2].err_info_dyn.lv_err_mkd fmy_ram_dyn[2].err_info_dyn.lv_dc_max fmy_ram_dyn[2].err_info_dyn.lv_err_disa fmy_ram_dyn[2].err_info_dyn.lv_err_cfm fmy_ram_dyn[2].err_info_dyn.lv_err_tmp fmy_ram_dyn[2].err_info_dyn.lv_err_dc fmy_ram_dyn[2].err_info_dyn.lv_err_pnd fmy_ram_dyn[2].ctr_wup_cyc fmy_ram_dyn[2].ctr_frc fmy_ram_dyn[2].ctr_dc fmy_ram_dyn[2].idx_frf fmy_ram_dyn[2].ctr_dc_err_det fmy_ram_dyn[2].ctr_dc_err_det_diag_cdn fmy_ram_dyn[2].ctr_dc_err_det_diag_cmpl fmy_ram_dyn[2].ctr_wup_act_mil fmy_ram_dyn[3].diag_inst fmy_ram_dyn[3].err_info_dyn.lv_cdn_diag_dc fmy_ram_dyn[3].err_info_dyn.lv_err_mkd fmy_ram_dyn[3].err_info_dyn.lv_dc_max fmy_ram_dyn[3].err_info_dyn.lv_err_disa fmy_ram_dyn[3].err_info_dyn.lv_err_cfm fmy_ram_dyn[3].err_info_dyn.lv_err_tmp fmy_ram_dyn[3].err_info_dyn.lv_err_dc fmy_ram_dyn[3].err_info_dyn.lv_err_pnd fmy_ram_dyn[3].ctr_wup_cyc fmy_ram_dyn[3].ctr_frc fmy_ram_dyn[3].ctr_dc fmy_ram_dyn[3].idx_frf fmy_ram_dyn[3].ctr_dc_err_det fmy_ram_dyn[3].ctr_dc_err_det_diag_cdn fmy_ram_dyn[3].ctr_dc_err_det_diag_cmpl fmy_ram_dyn[3].ctr_wup_act_mil fmy_ram_dyn[4].diag_inst fmy_ram_dyn[4].err_info_dyn.lv_cdn_diag_dc fmy_ram_dyn[4].err_info_dyn.lv_err_mkd fmy_ram_dyn[4].err_info_dyn.lv_dc_max fmy_ram_dyn[4].err_info_dyn.lv_err_disa fmy_ram_dyn[4].err_info_dyn.lv_err_cfm fmy_ram_dyn[4].err_info_dyn.lv_err_tmp fmy_ram_dyn[4].err_info_dyn.lv_err_dc fmy_ram_dyn[4].err_info_dyn.lv_err_pnd fmy_ram_dyn[4].ctr_wup_cyc fmy_ram_dyn[4].ctr_frc fmy_ram_dyn[4].ctr_dc fmy_ram_dyn[4].idx_frf fmy_ram_dyn[4].ctr_dc_err_det fmy_ram_dyn[4].ctr_dc_err_det_diag_cdn fmy_ram_dyn[4].ctr_dc_err_det_diag_cmpl fmy_ram_dyn[4].ctr_wup_act_mil fmy_ram_dyn[5].diag_inst fmy_ram_dyn[5].err_info_dyn.lv_cdn_diag_dc fmy_ram_dyn[5].err_info_dyn.lv_err_mkd fmy_ram_dyn[5].err_info_dyn.lv_dc_max fmy_ram_dyn[5].err_info_dyn.lv_err_disa fmy_ram_dyn[5].err_info_dyn.lv_err_cfm fmy_ram_dyn[5].err_info_dyn.lv_err_tmp fmy_ram_dyn[5].err_info_dyn.lv_err_dc fmy_ram_dyn[5].err_info_dyn.lv_err_pnd fmy_ram_dyn[5].ctr_wup_cyc fmy_ram_dyn[5].ctr_frc fmy_ram_dyn[5].ctr_dc fmy_ram_dyn[5].idx_frf fmy_ram_dyn[5].ctr_dc_err_det fmy_ram_dyn[5].ctr_dc_err_det_diag_cdn fmy_ram_dyn[5].ctr_dc_err_det_diag_cmpl fmy_ram_dyn[5].ctr_wup_act_mil fmy_ram_dyn[6].diag_inst fmy_ram_dyn[6].err_info_dyn.lv_cdn_diag_dc fmy_ram_dyn[6].err_info_dyn.lv_err_mkd fmy_ram_dyn[6].err_info_dyn.lv_dc_max fmy_ram_dyn[6].err_info_dyn.lv_err_disa fmy_ram_dyn[6].err_info_dyn.lv_err_cfm fmy_ram_dyn[6].err_info_dyn.lv_err_tmp fmy_ram_dyn[6].err_info_dyn.lv_err_dc fmy_ram_dyn[6].err_info_dyn.lv_err_pnd fmy_ram_dyn[6].ctr_wup_cyc fmy_ram_dyn[6].ctr_frc fmy_ram_dyn[6].ctr_dc fmy_ram_dyn[6].idx_frf fmy_ram_dyn[6].ctr_dc_err_det fmy_ram_dyn[6].ctr_dc_err_det_diag_cdn fmy_ram_dyn[6].ctr_dc_err_det_diag_cmpl fmy_ram_dyn[6].ctr_wup_act_mil fmy_ram_dyn[7].diag_inst fmy_ram_dyn[7].err_info_dyn.lv_cdn_diag_dc fmy_ram_dyn[7].err_info_dyn.lv_err_mkd fmy_ram_dyn[7].err_info_dyn.lv_dc_max fmy_ram_dyn[7].err_info_dyn.lv_err_disa fmy_ram_dyn[7].err_info_dyn.lv_err_cfm fmy_ram_dyn[7].err_info_dyn.lv_err_tmp fmy_ram_dyn[7].err_info_dyn.lv_err_dc fmy_ram_dyn[7].err_info_dyn.lv_err_pnd fmy_ram_dyn[7].ctr_wup_cyc fmy_ram_dyn[7].ctr_frc fmy_ram_dyn[7].ctr_dc fmy_ram_dyn[7].idx_frf fmy_ram_dyn[7].ctr_dc_err_det fmy_ram_dyn[7].ctr_dc_err_det_diag_cdn fmy_ram_dyn[7].ctr_dc_err_det_diag_cmpl fmy_ram_dyn[7].ctr_wup_act_mil fmy_ram_dyn[8].diag_inst fmy_ram_dyn[8].err_info_dyn.lv_cdn_diag_dc fmy_ram_dyn[8].err_info_dyn.lv_err_mkd fmy_ram_dyn[8].err_info_dyn.lv_dc_max fmy_ram_dyn[8].err_info_dyn.lv_err_disa fmy_ram_dyn[8].err_info_dyn.lv_err_cfm fmy_ram_dyn[8].err_info_dyn.lv_err_tmp fmy_ram_dyn[8].err_info_dyn.lv_err_dc fmy_ram_dyn[8].err_info_dyn.lv_err_pnd fmy_ram_dyn[8].ctr_wup_cyc fmy_ram_dyn[8].ctr_frc fmy_ram_dyn[8].ctr_dc fmy_ram_dyn[8].idx_frf fmy_ram_dyn[8].ctr_dc_err_det fmy_ram_dyn[8].ctr_dc_err_det_diag_cdn fmy_ram_dyn[8].ctr_dc_err_det_diag_cmpl fmy_ram_dyn[8].ctr_wup_act_mil fmy_ram_dyn[9].diag_inst fmy_ram_dyn[9].err_info_dyn.lv_cdn_diag_dc fmy_ram_dyn[9].err_info_dyn.lv_err_mkd fmy_ram_dyn[9].err_info_dyn.lv_dc_max fmy_ram_dyn[9].err_info_dyn.lv_err_disa fmy_ram_dyn[9].err_info_dyn.lv_err_cfm fmy_ram_dyn[9].err_info_dyn.lv_err_tmp fmy_ram_dyn[9].err_info_dyn.lv_err_dc fmy_ram_dyn[9].err_info_dyn.lv_err_pnd fmy_ram_dyn[9].ctr_wup_cyc fmy_ram_dyn[9].ctr_frc fmy_ram_dyn[9].ctr_dc fmy_ram_dyn[9].idx_frf fmy_ram_dyn[9].ctr_dc_err_det fmy_ram_dyn[9].ctr_dc_err_det_diag_cdn fmy_ram_dyn[9].ctr_dc_err_det_diag_cmpl fmy_ram_dyn[9].ctr_wup_act_mil /end OUT_MEASUREMENT
/end FUNCTION
/begin FUNCTION ERRM_Readiness_Codes "Readiness_Codes" /begin OUT_MEASUREMENT state_ready_obd_1 state_ready_obd_2 /end OUT_MEASUREMENT /end FUNCTION
/begin FUNCTION ERRM_Environmental_data "Environmental_Data"
 /begin DEF_CHARACTERISTIC fmy_id_imob_1.envd fmy_id_imob_2.envd fmy_id_imob_3.envd fmy_id_tco_el.envd fmy_id_tco_grd.envd fmy_id_tco_stuck.envd fmy_id_tco_plaus.envd fmy_id_tco_2_el.envd fmy_id_tco_2_grd.envd fmy_id_tco_2_plaus.envd fmy_id_ect_el.envd fmy_id_ecf_el_1.envd fmy_id_ecfpwm_fb_1.envd fmy_id_th.envd fmy_id_ftl_min.envd fmy_id_tia_el.envd fmy_id_amp.envd fmy_id_amp_plaus.envd fmy_id_maf.envd fmy_id_iv_0.envd fmy_id_iv_1.envd fmy_id_iv_2.envd fmy_id_iv_3.envd fmy_id_iv_4.envd fmy_id_iv_5.envd fmy_id_rly_efp.envd fmy_id_el_cps.envd fmy_id_slv_ivvt_in.envd fmy_id_slv_ivvt_ex.envd fmy_id_ecu_cks.envd fmy_id_tout_etcu_1.envd fmy_id_tout_etcu_2.envd fmy_id_tout_icl_2.envd fmy_id_tout_icl_3.envd fmy_id_tout_asr_1.envd fmy_id_tout_asr_3.envd fmy_id_tout_asr_4.envd fmy_id_tout_pste_1.envd fmy_id_tout_amt_1.envd fmy_id_vs.envd fmy_id_knks_1.envd fmy_id_knks_2.envd fmy_id_igc_scp_0.envd fmy_id_igc_scp_1.envd fmy_id_igc_scp_2.envd fmy_id_igc_scp_3.envd fmy_id_igc_scp_4.envd fmy_id_igc_scp_5.envd fmy_id_igc_scg_0.envd fmy_id_igc_scg_1.envd fmy_id_igc_scg_2.envd fmy_id_igc_scg_3.envd fmy_id_igc_scg_4.envd fmy_id_igc_scg_5.envd fmy_id_igc_ol_0.envd fmy_id_igc_ol_1.envd fmy_id_igc_ol_2.envd fmy_id_igc_ol_3.envd fmy_id_igc_ol_4.envd fmy_id_igc_ol_5.envd fmy_id_tps_1.envd fmy_id_tps_2.envd fmy_id_tps_maf_1.envd fmy_id_tps_maf_2.envd fmy_id_tps_ratio.envd fmy_id_v_ref_1.envd fmy_id_v_ref_2.envd fmy_id_pvs_1.envd fmy_id_pvs_2.envd fmy_id_pvs_ratio.envd fmy_id_pvs_double.envd fmy_id_pvs_bls_not_plaus.envd fmy_id_mtc_dr.envd fmy_id_mtc_ctl_1.envd fmy_id_mtc_ctl_2.envd fmy_id_mtc_ctl_3.envd fmy_id_tps_ad.envd fmy_id_tps_ad_bol.envd fmy_id_tps_st_chk_1.envd fmy_id_tps_st_chk_2.envd fmy_id_gen.envd fmy_id_gen_diag.envd fmy_id_alter_bn.envd fmy_id_alter_bn_bat.envd fmy_id_vim_1_el.envd fmy_id_vim_2_el.envd fmy_id_vimpwm_1_fb.envd fmy_id_vimpwm_2_fb.envd fmy_id_t_es.envd fmy_id_map_dip_plaus.envd fmy_id_toil_level.envd fmy_id_vim_plaus.envd fmy_id_alter_bn_rgn.envd fmy_id_per_cam_in_1.envd fmy_id_per_cam_ex_1.envd fmy_id_syn_cam_in_1.envd fmy_id_syn_cam_ex_1.envd fmy_id_ref_crk_cam_in_1.envd fmy_id_ref_crk_cam_ex_1.envd fmy_id_crk_tooth.envd fmy_id_crk_tooth_per.envd fmy_id_crk_syn.envd fmy_id_crk_plaus.envd fmy_id_plaus_cam_in_1.envd fmy_id_plaus_cam_ex_1.envd fmy_id_syn_crk_cam_in_1.envd fmy_id_syn_crk_cam_ex_1.envd fmy_id_can_boff_B.envd fmy_id_can_boff_C.envd fmy_id_rly_main.envd fmy_id_rly_main_dly.envd fmy_id_rly_accout.envd fmy_id_isc.envd fmy_id_im_bls_plaus.envd fmy_id_im_bts_plaus.envd fmy_id_msw_tog.envd fmy_id_msw_2.envd fmy_id_msw_3.envd fmy_id_mis_0.envd fmy_id_mis_1.envd fmy_id_mis_2.envd fmy_id_mis_3.envd fmy_id_mis_4.envd fmy_id_mis_5.envd fmy_id_mis_mpl.envd fmy_id_mis_ftl_l.envd fmy_id_fsd_1.envd fmy_id_fsd_2.envd fmy_id_ef.envd fmy_id_tecu.envd fmy_id_ebox_cfa.envd fmy_id_ecu_ram.envd fmy_id_tqi_lim.envd fmy_id_obd2_lsh_down_1.envd fmy_id_obd2_lsh_down_2.envd fmy_id_dmtls.envd fmy_id_dmtl_pump.envd fmy_id_dmtlm.envd fmy_id_rough_leak.envd fmy_id_small_leak.envd fmy_id_chk_fuc.envd fmy_id_sof.envd fmy_id_sof_req.envd fmy_id_rly_crcv_heat.envd fmy_id_rly_st.envd fmy_id_bsd.envd fmy_id_poil_swi.envd fmy_id_tout_efp_can.envd fmy_id_diagcps.envd fmy_id_dcc.envd fmy_id_ldm.envd fmy_id_dmtlh.envd fmy_id_cs.envd fmy_id_spi_mps.envd fmy_id_spi_knk.envd fmy_id_bn_tq_dcc.envd fmy_id_bn_tq_pste_2.envd fmy_id_bn_ars.envd fmy_id_bn_cas.envd fmy_id_bn_tq_tcs.envd fmy_id_bn_vs_tcs.envd fmy_id_bn_tcs.envd fmy_id_bn_tq_etcu.envd fmy_id_bn_etcu.envd fmy_id_bn_etcu_2.envd fmy_id_bn_etcu_disp.envd fmy_id_bn_tq_amt.envd fmy_id_bn_acc.envd fmy_id_bn_t_icl.envd fmy_id_bn_veh_mod.envd fmy_id_bn_km_icl.envd fmy_id_bn_icl.envd fmy_id_bn_pow_vb.envd fmy_id_bn_pow_gen.envd fmy_id_bn_msw.envd fmy_id_bn_ang_pste.envd fmy_id_bn_gear_rev.envd fmy_id_bn_ltg_hdlp_l.envd fmy_id_bn_ldm.envd fmy_id_bn_trl.envd fmy_id_bn_hiv.envd fmy_id_bn_t_clk.envd fmy_id_bn_efp_crash.envd fmy_id_bn_efp.envd fmy_id_load_tps_plaus.envd fmy_id_egy_min.envd fmy_id_efp_crash.envd fmy_id_efp.envd fmy_id_locan_boff.envd fmy_id_cwp_plaus.envd fmy_id_cwp_int_off.envd fmy_id_cwp_pwr.envd fmy_id_cwp_com_plaus.envd fmy_id_qoil_sens.envd fmy_id_bat_sens.envd fmy_id_bat_sens_it.envd fmy_id_bat_sens_it_el.envd fmy_id_ecu_nvmy.envd fmy_id_gs.envd fmy_id_plaus_igk_bn.envd fmy_id_tq_req_can.envd fmy_id_map_dip_sens.envd fmy_id_mec_ivvt_in.envd fmy_id_mec_ivvt_ex.envd fmy_id_tout_nox_sens_1.envd fmy_id_tout_nox_sens_2.envd fmy_id_vvl_rot.envd fmy_id_rly_vvl.envd fmy_id_nox_sens_1.envd fmy_id_ovl_ecu_vvl.envd fmy_id_dr_sc_vvl.envd fmy_id_crit_ovl_ecu_vvl.envd fmy_id_nox_sens_2.envd fmy_id_cur_h_vvl.envd fmy_id_teg_pcat_down_1.envd fmy_id_teg_pcat_down_2.envd fmy_id_t_seg_er.envd fmy_id_seg_ad_er.envd fmy_id_vs_plaus.envd fmy_id_ftl_obd.envd fmy_id_ftl_can.envd fmy_id_tia_plaus.envd fmy_id_tam_can.envd fmy_id_tam_plaus.envd fmy_id_map_dip_shift.envd fmy_id_cat_diag_1.envd fmy_id_cat_diag_2.envd fmy_id_cat_diag_afl_1.envd fmy_id_cat_diag_afl_2.envd fmy_id_scg_ls_down_1.envd fmy_id_scp_ls_down_1.envd fmy_id_oc_ls_down_1.envd fmy_id_puc_ls_down_1.envd fmy_id_fl_ls_down_1.envd fmy_id_lsl_up_if_1.envd fmy_id_el_lsl_up_1.envd fmy_id_lsh_up_1.envd fmy_id_lsh_down_1.envd fmy_id_vls_down_dif_1.envd fmy_id_lsh_lsl_up_1.envd fmy_id_air_lsl_up_1.envd fmy_id_pue_ls_down_1.envd fmy_id_swt_ls_down_1.envd fmy_id_obd_lsh_down_1.envd fmy_id_dyn_vld_ls_up_1.envd fmy_id_puc_vld_ls_up_1.envd fmy_id_obd_vld_lsh_up_1.envd fmy_id_chk_ls_down_1.envd fmy_id_shift_afl_lsl_up_1.envd fmy_id_shift_afr_lsl_up_1.envd fmy_id_oc_lsl_up_1.envd fmy_id_delta_i_lam_1.envd fmy_id_rgn_nt_ls_down_1.envd fmy_id_chg_ls_down.envd fmy_id_scg_ls_down_2.envd fmy_id_scp_ls_down_2.envd fmy_id_oc_ls_down_2.envd fmy_id_puc_ls_down_2.envd fmy_id_fl_ls_down_2.envd fmy_id_lsl_up_if_2.envd fmy_id_el_lsl_up_2.envd fmy_id_lsh_up_2.envd fmy_id_lsh_down_2.envd fmy_id_vls_down_dif_2.envd fmy_id_lsh_lsl_up_2.envd fmy_id_air_lsl_up_2.envd fmy_id_pue_ls_down_2.envd fmy_id_swt_ls_down_2.envd fmy_id_obd_lsh_down_2.envd fmy_id_dyn_vld_ls_up_2.envd fmy_id_puc_vld_ls_up_2.envd fmy_id_obd_vld_lsh_up_2.envd fmy_id_chk_ls_down_2.envd fmy_id_shift_afl_lsl_up_2.envd fmy_id_shift_afr_lsl_up_2.envd fmy_id_oc_lsl_up_2.envd fmy_id_delta_i_lam_2.envd fmy_id_rgn_nt_ls_down_2.envd fmy_id_chg_ls_up.envd fmy_id_alter_com.envd fmy_id_cwp_com.envd fmy_id_qoil_com.envd fmy_id_sens_bat_smt_com.envd fmy_id_ecraspwm_fb.envd fmy_id_ecras_el.envd fmy_id_warm_rst.envd fmy_id_acr_ad.envd fmy_id_sens_acr.envd fmy_id_acr_ctl.envd fmy_id_acr_dr.envd fmy_id_var_cod.envd fmy_id_veh_pow_var.envd fmy_id_fup_mfp_plaus.envd fmy_id_h_prs_sys.envd fmy_id_vcv_plaus.envd fmy_id_fup.envd fmy_id_vcv.envd fmy_id_fup_efp.envd fmy_id_efppwm_plaus.envd fmy_id_l_prs_sys.envd fmy_id_conv_mon_1.envd fmy_id_n_32_mon_1.envd fmy_id_pvs_mon_1.envd fmy_id_tq_dif_isc_mon_1.envd fmy_id_tq_req_mon_1.envd fmy_id_tq_ext_mon_1.envd fmy_id_tqi_av_mon_1.envd fmy_id_tqi_n_max_mon_1.envd fmy_id_mff_mon_1.envd fmy_id_cru_mon_1.envd ldpm_fmy_envd /end DEF_CHARACTERISTIC
/end FUNCTION
/begin FUNCTION ERRM_Statistical_Data "Statistical data"
 /begin OUT_MEASUREMENT t_act_mil state_ena_obd state_cmpl_obd t_dtc_clr t_act_mil_60 /end OUT_MEASUREMENT
/end FUNCTION
/end MODULE
/end PROJECT
