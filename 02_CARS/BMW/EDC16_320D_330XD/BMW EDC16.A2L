ASAP2_VERSION 1 3
/begin PROJECT P383 "BMW DDE6.3 8-Zylinder V9E.3 11.10.2004 CAN12H"
/begin HEADER "" VERSION "V9E.3_8Z_CAN12H" PROJECT_NO P383 /end HEADER
/begin MODULE DIM ""
/begin MOD_COMMON "" BYTE_ORDER MSB_FIRST ALIGNMENT_BYTE 1 ALIGNMENT_WORD 2 ALIGNMENT_LONG 4 ALIGNMENT_FLOAT32_IEEE 4 /end MOD_COMMON
/begin CHARACTERISTIC DSMDur_DfctDur1Mode_C "Betriebsart des globalen Fehlerdauerzählers 1" VALUE 0xD2830 Kw_Wu8 2.000 OneToOne 0.00 2.000 FORMAT "%5.3" EXTENDED_LIMITS 0.00 255.0 /end CHARACTERISTIC
/begin CHARACTERISTIC DSMDur_DfctDur2Mode_C "Betriebsart des globalen Fehlerdauerzählers 2" VALUE 0xD2831 Kw_Wu8 2.000 OneToOne 0.00 2.000 FORMAT "%5.3" EXTENDED_LIMITS 0.00 255.0 /end CHARACTERISTIC
/begin CHARACTERISTIC DSMDur_stDfctDur1Enable_C "Aktivierungsbedingungen für den globalen Defektdauerzähler 1" VALUE 0xD2832 Kw_Wu8 255.0 OneToOne 0.00 255.0 FORMAT "%5.1" /end CHARACTERISTIC
/begin CHARACTERISTIC DSMDur_stDfctDur2Enable_C "Aktivierungsbedingungen für den globalen Defektdauerzähler 2" VALUE 0xD2833 Kw_Wu8 255.0 OneToOne 0.00 255.0 FORMAT "%5.1" /end CHARACTERISTIC
/begin CHARACTERISTIC DSMDur_stDfctDur1Reset_C "Rücksetzbedingungen für den globalen Defektdauerzähler 1" VALUE 0xD2834 Kw_Wu8 255.0 OneToOne 0.00 255.0 FORMAT "%5.1" /end CHARACTERISTIC
/begin CHARACTERISTIC DSMDur_stDfctDur2Reset_C "Rücksetzbedingungen für den globalen Defektdauerzähler 2" VALUE 0xD2835 Kw_Wu8 255.0 OneToOne 0.00 255.0 FORMAT "%5.1" /end CHARACTERISTIC
/begin CHARACTERISTIC DSM_cnvMilKmFCM_Offset_C "Offset für Umrechnung Meilen/Kilometer beim Fehlerspeicher lesen" VALUE 0xCB09E Kw_Ws16 65535.00 LengthKm -32768.00 32767.00 FORMAT "%8.2" /end CHARACTERISTIC
/begin CHARACTERISTIC DSM_cnvMilKmFCM_Slope_C "Slope für Umrechnung Meilen/Kilometer beim Fehlerspeicher lesen" VALUE 0xCB0A0 Kw_Ws16 65.53500 SlopeRes1000 -32.76800 32.76700 FORMAT "%8.5" /end CHARACTERISTIC
/begin CHARACTERISTIC DSM_Class1Mil_C "Art der MIL Ansteuerung" VALUE 0xCB0A2 Kw_Wu8 2.00000000000 Mil 0.00 2.00000000000 FORMAT "%13.11" /end CHARACTERISTIC
/begin CHARACTERISTIC DSM_Class1TFlc_C "Trigger Art für Fehlereintrags Bestätigungsentprellung (->Lampe an)" VALUE 0xCB0A3 Kw_Wu8 4.00000000000 ClassTrigger 0.00 4.00000000000 FORMAT "%13.11" /end CHARACTERISTIC
/begin CHARACTERISTIC DSM_Class1Flc_C "Anzahl Triggerereignisse für Fehlereintrags Bestätigungsentprellung (->Lampe an)" VALUE 0xCB0A4 Kw_Wu8 255.0 OneToOne 0.00 255.0 FORMAT "%5.1" /end CHARACTERISTIC
/begin CHARACTERISTIC DSM_Class1THlc_C "Trigger Art für Fehlerheilung (->Lampe aus)" VALUE 0xCB0A5 Kw_Wu8 4.00000000000 ClassTrigger 0.00 4.00000000000 FORMAT "%13.11" /end CHARACTERISTIC
/begin CHARACTERISTIC DSM_Class1Hlc_C "Anzahl Triggerereignisse für Fehlerheilung (->Lampe aus)" VALUE 0xCB0A6 Kw_Wu8 255.0 OneToOne 0.00 255.0 FORMAT "%5.1" /end CHARACTERISTIC
/begin CHARACTERISTIC DSM_Class1Scatt_C "Fehler ist lesbar für OBD Scan tool tester (SCATT) wenn Wert = 1" VALUE 0xCB0A7 Kw_Wu8 1.00000000000 Scatt 0.00 1.00000000000 FORMAT "%13.11" /end CHARACTERISTIC
/begin CHARACTERISTIC DSM_Class1TDlcPen_C "Trigger Art für Löschentprellung von nicht bestätigten Fehlern (pending)" VALUE 0xCB0A8 Kw_Wu8 3.00000000000 ClassTriggerTDlc 0.00 3.00000000000 FORMAT "%13.11" /end CHARACTERISTIC
/begin CHARACTERISTIC DSM_Class1DlcPen_C "Anzahl Triggerereignisse für die Löschung von nicht bestätigten Fehlern (pending)" VALUE 0xCB0A9 Kw_Wu8 255.0 OneToOne 0.00 255.0 FORMAT "%5.1" /end CHARACTERISTIC
/begin CHARACTERISTIC DSM_Class1TDlc_C "Trigger Art für Löschentprellung" VALUE 0xCB0AA Kw_Wu8 3.00000000000 ClassTriggerTDlc 0.00 3.00000000000 FORMAT "%13.11" /end CHARACTERISTIC
/begin CHARACTERISTIC DSM_Class1DlcKd_C "Anzahl Triggerereignisse für die Löschung von Fehlereinträgen mit Status Kundendienst" VALUE 0xCB0AB Kw_Wu8 255.0 OneToOne 0.00 255.0 FORMAT "%5.1" /end CHARACTERISTIC
/begin CHARACTERISTIC DSM_Class1Dlc_C "Anzahl Triggerereignisse für die Löschung von Fehlereinträgen" VALUE 0xCB0AC Kw_Wu8 255.0 OneToOne 0.00 255.0 FORMAT "%5.1" /end CHARACTERISTIC
/begin CHARACTERISTIC DSM_Class1Prio_C "Priorität des Fehlereintrages für Verdrängung und freeze frame Zuordnung" VALUE 0xCB0AD Kw_Wu8 255.0 OneToOne 0.00 255.0 FORMAT "%5.1" /end CHARACTERISTIC
/begin CHARACTERISTIC DSM_Class1SysLamp_C "Art der Systemlampenansteuerung" VALUE 0xCB0AE Kw_Wu8 2.00000000000 SysLamp 0.00 2.00000000000 FORMAT "%13.11" /end CHARACTERISTIC
/begin CHARACTERISTIC DSM_Class1ResErf_C "Verhalten Fehlerflags bei Reset und abgebrochenem Nachlauf" VALUE 0xCB0AF Kw_Wu8 3.00000000000 ResErf 0.00 3.00000000000 FORMAT "%13.11" /end CHARACTERISTIC
/begin CHARACTERISTIC DSM_Class1Readiness_C "Zuordnung Entprellklasse zu Readiness Flags" VALUE 0xCB0B0 Kw_Wu8 64.0000000000 Readiness 0.00 64.0000000000 FORMAT "%13.10" /end CHARACTERISTIC
/begin CHARACTERISTIC DSM_Class2Mil_C "Art der MIL Ansteuerung" VALUE 0xCB0B1 Kw_Wu8 2.00000000000 Mil 0.00 2.00000000000 FORMAT "%13.11" /end CHARACTERISTIC
/begin CHARACTERISTIC DSM_Class2TFlc_C "Trigger Art für Fehlereintrags Bestätigungsentprellung (->Lampe an)" VALUE 0xCB0B2 Kw_Wu8 4.00000000000 ClassTrigger 0.00 4.00000000000 FORMAT "%13.11" /end CHARACTERISTIC
/begin CHARACTERISTIC DSM_Class2Flc_C "Anzahl Triggerereignisse für Fehlereintrags Bestätigungsentprellung (->Lampe an)" VALUE 0xCB0B3 Kw_Wu8 255.0 OneToOne 0.00 255.0 FORMAT "%5.1" /end CHARACTERISTIC
/begin CHARACTERISTIC DSM_Class2THlc_C "Trigger Art für Fehlerheilung (->Lampe aus)" VALUE 0xCB0B4 Kw_Wu8 4.00000000000 ClassTrigger 0.00 4.00000000000 FORMAT "%13.11" /end CHARACTERISTIC
/begin CHARACTERISTIC DSM_Class2Hlc_C "Anzahl Triggerereignisse für Fehlerheilung (->Lampe aus)" VALUE 0xCB0B5 Kw_Wu8 255.0 OneToOne 0.00 255.0 FORMAT "%5.1" /end CHARACTERISTIC
/begin CHARACTERISTIC DSM_Class2Scatt_C "Fehler ist lesbar für OBD Scan tool tester (SCATT) wenn Wert = 1" VALUE 0xCB0B6 Kw_Wu8 1.00000000000 Scatt 0.00 1.00000000000 FORMAT "%13.11" /end CHARACTERISTIC
/begin CHARACTERISTIC DSM_Class2TDlcPen_C "Trigger Art für Löschentprellung von nicht bestätigten Fehlern (pending)" VALUE 0xCB0B7 Kw_Wu8 3.00000000000 ClassTriggerTDlc 0.00 3.00000000000 FORMAT "%13.11" /end CHARACTERISTIC
/begin CHARACTERISTIC DSM_Class2DlcPen_C "Anzahl Triggerereignisse für die Löschung von nicht bestätigten Fehlern (pending)" VALUE 0xCB0B8 Kw_Wu8 255.0 OneToOne 0.00 255.0 FORMAT "%5.1" /end CHARACTERISTIC
/begin CHARACTERISTIC DSM_Class2TDlc_C "Trigger Art für Löschentprellung" VALUE 0xCB0B9 Kw_Wu8 3.00000000000 ClassTriggerTDlc 0.00 3.00000000000 FORMAT "%13.11" /end CHARACTERISTIC
/begin CHARACTERISTIC DSM_Class2DlcKd_C "Anzahl Triggerereignisse für die Löschung von Fehlereinträgen mit Status Kundendienst" VALUE 0xCB0BA Kw_Wu8 255.0 OneToOne 0.00 255.0 FORMAT "%5.1" /end CHARACTERISTIC
/begin CHARACTERISTIC DSM_Class2Dlc_C "Anzahl Triggerereignisse für die Löschung von Fehlereinträgen" VALUE 0xCB0BB Kw_Wu8 255.0 OneToOne 0.00 255.0 FORMAT "%5.1" /end CHARACTERISTIC
/begin CHARACTERISTIC DSM_Class2Prio_C "Priorität des Fehlereintrages für Verdrängung und freeze frame Zuordnung" VALUE 0xCB0BC Kw_Wu8 255.0 OneToOne 0.00 255.0 FORMAT "%5.1" /end CHARACTERISTIC
/begin CHARACTERISTIC DSM_Class2SysLamp_C "Art der Systemlampenansteuerung" VALUE 0xCB0BD Kw_Wu8 2.00000000000 SysLamp 0.00 2.00000000000 FORMAT "%13.11" /end CHARACTERISTIC
/begin CHARACTERISTIC DSM_Class2ResErf_C "Verhalten Fehlerflags bei Reset und abgebrochenem Nachlauf" VALUE 0xCB0BE Kw_Wu8 3.00000000000 ResErf 0.00 3.00000000000 FORMAT "%13.11" /end CHARACTERISTIC
/begin CHARACTERISTIC DSM_Class2Readiness_C "Zuordnung Entprellklasse zu Readiness Flags" VALUE 0xCB0BF Kw_Wu8 64.0000000000 Readiness 0.00 64.0000000000 FORMAT "%13.10" /end CHARACTERISTIC
/begin CHARACTERISTIC DSM_Class3Mil_C "Art der MIL Ansteuerung" VALUE 0xCB0C0 Kw_Wu8 2.00000000000 Mil 0.00 2.00000000000 FORMAT "%13.11" /end CHARACTERISTIC
/begin CHARACTERISTIC DSM_Class3TFlc_C "Trigger Art für Fehlereintrags Bestätigungsentprellung (->Lampe an)" VALUE 0xCB0C1 Kw_Wu8 4.00000000000 ClassTrigger 0.00 4.00000000000 FORMAT "%13.11" /end CHARACTERISTIC
/begin CHARACTERISTIC DSM_Class3Flc_C "Anzahl Triggerereignisse für Fehlereintrags Bestätigungsentprellung (->Lampe an)" VALUE 0xCB0C2 Kw_Wu8 255.0 OneToOne 0.00 255.0 FORMAT "%5.1" /end CHARACTERISTIC
/begin CHARACTERISTIC DSM_Class3THlc_C "Trigger Art für Fehlerheilung (->Lampe aus)" VALUE 0xCB0C3 Kw_Wu8 4.00000000000 ClassTrigger 0.00 4.00000000000 FORMAT "%13.11" /end CHARACTERISTIC
/begin CHARACTERISTIC DSM_Class3Hlc_C "Anzahl Triggerereignisse für Fehlerheilung (->Lampe aus)" VALUE 0xCB0C4 Kw_Wu8 255.0 OneToOne 0.00 255.0 FORMAT "%5.1" /end CHARACTERISTIC
/begin CHARACTERISTIC DSM_Class3Scatt_C "Fehler ist lesbar für OBD Scan tool tester (SCATT) wenn Wert = 1" VALUE 0xCB0C5 Kw_Wu8 1.00000000000 Scatt 0.00 1.00000000000 FORMAT "%13.11" /end CHARACTERISTIC
/begin CHARACTERISTIC DSM_Class3TDlcPen_C "Trigger Art für Löschentprellung von nicht bestätigten Fehlern (pending)" VALUE 0xCB0C6 Kw_Wu8 3.00000000000 ClassTriggerTDlc 0.00 3.00000000000 FORMAT "%13.11" /end CHARACTERISTIC
/begin CHARACTERISTIC DSM_Class3DlcPen_C "Anzahl Triggerereignisse für die Löschung von nicht bestätigten Fehlern (pending)" VALUE 0xCB0C7 Kw_Wu8 255.0 OneToOne 0.00 255.0 FORMAT "%5.1" /end CHARACTERISTIC
/begin CHARACTERISTIC DSM_Class3TDlc_C "Trigger Art für Löschentprellung" VALUE 0xCB0C8 Kw_Wu8 3.00000000000 ClassTriggerTDlc 0.00 3.00000000000 FORMAT "%13.11" /end CHARACTERISTIC
/begin CHARACTERISTIC DSM_Class3DlcKd_C "Anzahl Triggerereignisse für die Löschung von Fehlereinträgen mit Status Kundendienst" VALUE 0xCB0C9 Kw_Wu8 255.0 OneToOne 0.00 255.0 FORMAT "%5.1" /end CHARACTERISTIC
/begin CHARACTERISTIC DSM_Class3Dlc_C "Anzahl Triggerereignisse für die Löschung von Fehlereinträgen" VALUE 0xCB0CA Kw_Wu8 255.0 OneToOne 0.00 255.0 FORMAT "%5.1" /end CHARACTERISTIC
/begin CHARACTERISTIC DSM_Class3Prio_C "Priorität des Fehlereintrages für Verdrängung und freeze frame Zuordnung" VALUE 0xCB0CB Kw_Wu8 255.0 OneToOne 0.00 255.0 FORMAT "%5.1" /end CHARACTERISTIC
/begin CHARACTERISTIC DSM_Class3SysLamp_C "Art der Systemlampenansteuerung" VALUE 0xCB0CC Kw_Wu8 2.00000000000 SysLamp 0.00 2.00000000000 FORMAT "%13.11" /end CHARACTERISTIC
/begin CHARACTERISTIC DSM_Class3ResErf_C "Verhalten Fehlerflags bei Reset und abgebrochenem Nachlauf" VALUE 0xCB0CD Kw_Wu8 3.00000000000 ResErf 0.00 3.00000000000 FORMAT "%13.11" /end CHARACTERISTIC
/begin CHARACTERISTIC DSM_Class3Readiness_C "Zuordnung Entprellklasse zu Readiness Flags" VALUE 0xCB0CE Kw_Wu8 64.0000000000 Readiness 0.00 64.0000000000 FORMAT "%13.10" /end CHARACTERISTIC
/begin CHARACTERISTIC DSM_Class4Mil_C "Art der MIL Ansteuerung" VALUE 0xCB0CF Kw_Wu8 2.00000000000 Mil 0.00 2.00000000000 FORMAT "%13.11" /end CHARACTERISTIC
/begin CHARACTERISTIC DSM_Class4TFlc_C "Trigger Art für Fehlereintrags Bestätigungsentprellung (->Lampe an)" VALUE 0xCB0D0 Kw_Wu8 4.00000000000 ClassTrigger 0.00 4.00000000000 FORMAT "%13.11" /end CHARACTERISTIC
/begin CHARACTERISTIC DSM_Class4Flc_C "Anzahl Triggerereignisse für Fehlereintrags Bestätigungsentprellung (->Lampe an)" VALUE 0xCB0D1 Kw_Wu8 255.0 OneToOne 0.00 255.0 FORMAT "%5.1" /end CHARACTERISTIC
/begin CHARACTERISTIC DSM_Class4THlc_C "Trigger Art für Fehlerheilung (->Lampe aus)" VALUE 0xCB0D2 Kw_Wu8 4.00000000000 ClassTrigger 0.00 4.00000000000 FORMAT "%13.11" /end CHARACTERISTIC
/begin CHARACTERISTIC DSM_Class4Hlc_C "Anzahl Triggerereignisse für Fehlerheilung (->Lampe aus)" VALUE 0xCB0D3 Kw_Wu8 255.0 OneToOne 0.00 255.0 FORMAT "%5.1" /end CHARACTERISTIC
/begin CHARACTERISTIC DSM_Class4Scatt_C "Fehler ist lesbar für OBD Scan tool tester (SCATT) wenn Wert = 1" VALUE 0xCB0D4 Kw_Wu8 1.00000000000 Scatt 0.00 1.00000000000 FORMAT "%13.11" /end CHARACTERISTIC
/begin CHARACTERISTIC DSM_Class4TDlcPen_C "Trigger Art für Löschentprellung von nicht bestätigten Fehlern (pending)" VALUE 0xCB0D5 Kw_Wu8 3.00000000000 ClassTriggerTDlc 0.00 3.00000000000 FORMAT "%13.11" /end CHARACTERISTIC
/begin CHARACTERISTIC DSM_Class4DlcPen_C "Anzahl Triggerereignisse für die Löschung von nicht bestätigten Fehlern (pending)" VALUE 0xCB0D6 Kw_Wu8 255.0 OneToOne 0.00 255.0 FORMAT "%5.1" /end CHARACTERISTIC
/begin CHARACTERISTIC DSM_Class4TDlc_C "Trigger Art für Löschentprellung" VALUE 0xCB0D7 Kw_Wu8 3.00000000000 ClassTriggerTDlc 0.00 3.00000000000 FORMAT "%13.11" /end CHARACTERISTIC
/begin CHARACTERISTIC DSM_Class4DlcKd_C "Anzahl Triggerereignisse für die Löschung von Fehlereinträgen mit Status Kundendienst" VALUE 0xCB0D8 Kw_Wu8 255.0 OneToOne 0.00 255.0 FORMAT "%5.1" /end CHARACTERISTIC
/begin CHARACTERISTIC DSM_Class4Dlc_C "Anzahl Triggerereignisse für die Löschung von Fehlereinträgen" VALUE 0xCB0D9 Kw_Wu8 255.0 OneToOne 0.00 255.0 FORMAT "%5.1" /end CHARACTERISTIC
/begin CHARACTERISTIC DSM_Class4Prio_C "Priorität des Fehlereintrages für Verdrängung und freeze frame Zuordnung" VALUE 0xCB0DA Kw_Wu8 255.0 OneToOne 0.00 255.0 FORMAT "%5.1" /end CHARACTERISTIC
/begin CHARACTERISTIC DSM_Class4SysLamp_C "Art der Systemlampenansteuerung" VALUE 0xCB0DB Kw_Wu8 2.00000000000 SysLamp 0.00 2.00000000000 FORMAT "%13.11" /end CHARACTERISTIC
/begin CHARACTERISTIC DSM_Class4ResErf_C "Verhalten Fehlerflags bei Reset und abgebrochenem Nachlauf" VALUE 0xCB0DC Kw_Wu8 3.00000000000 ResErf 0.00 3.00000000000 FORMAT "%13.11" /end CHARACTERISTIC
/begin CHARACTERISTIC DSM_Class4Readiness_C "Zuordnung Entprellklasse zu Readiness Flags" VALUE 0xCB0DD Kw_Wu8 64.0000000000 Readiness 0.00 64.0000000000 FORMAT "%13.10" /end CHARACTERISTIC
/begin CHARACTERISTIC DSM_Class5Mil_C "Art der MIL Ansteuerung" VALUE 0xCB0DE Kw_Wu8 2.00000000000 Mil 0.00 2.00000000000 FORMAT "%13.11" /end CHARACTERISTIC
/begin CHARACTERISTIC DSM_Class5TFlc_C "Trigger Art für Fehlereintrags Bestätigungsentprellung (->Lampe an)" VALUE 0xCB0DF Kw_Wu8 4.00000000000 ClassTrigger 0.00 4.00000000000 FORMAT "%13.11" /end CHARACTERISTIC
/begin CHARACTERISTIC DSM_Class5Flc_C "Anzahl Triggerereignisse für Fehlereintrags Bestätigungsentprellung (->Lampe an)" VALUE 0xCB0E0 Kw_Wu8 255.0 OneToOne 0.00 255.0 FORMAT "%5.1" /end CHARACTERISTIC
/begin CHARACTERISTIC DSM_Class5THlc_C "Trigger Art für Fehlerheilung (->Lampe aus)" VALUE 0xCB0E1 Kw_Wu8 4.00000000000 ClassTrigger 0.00 4.00000000000 FORMAT "%13.11" /end CHARACTERISTIC
/begin CHARACTERISTIC DSM_Class5Hlc_C "Anzahl Triggerereignisse für Fehlerheilung (->Lampe aus)" VALUE 0xCB0E2 Kw_Wu8 255.0 OneToOne 0.00 255.0 FORMAT "%5.1" /end CHARACTERISTIC
/begin CHARACTERISTIC DSM_Class5Scatt_C "Fehler ist lesbar für OBD Scan tool tester (SCATT) wenn Wert = 1" VALUE 0xCB0E3 Kw_Wu8 1.00000000000 Scatt 0.00 1.00000000000 FORMAT "%13.11" /end CHARACTERISTIC
/begin CHARACTERISTIC DSM_Class5TDlcPen_C "Trigger Art für Löschentprellung von nicht bestätigten Fehlern (pending)" VALUE 0xCB0E4 Kw_Wu8 3.00000000000 ClassTriggerTDlc 0.00 3.00000000000 FORMAT "%13.11" /end CHARACTERISTIC
/begin CHARACTERISTIC DSM_Class5DlcPen_C "Anzahl Triggerereignisse für die Löschung von nicht bestätigten Fehlern (pending)" VALUE 0xCB0E5 Kw_Wu8 255.0 OneToOne 0.00 255.0 FORMAT "%5.1" /end CHARACTERISTIC
/begin CHARACTERISTIC DSM_Class5TDlc_C "Trigger Art für Löschentprellung" VALUE 0xCB0E6 Kw_Wu8 3.00000000000 ClassTriggerTDlc 0.00 3.00000000000 FORMAT "%13.11" /end CHARACTERISTIC
/begin CHARACTERISTIC DSM_Class5DlcKd_C "Anzahl Triggerereignisse für die Löschung von Fehlereinträgen mit Status Kundendienst" VALUE 0xCB0E7 Kw_Wu8 255.0 OneToOne 0.00 255.0 FORMAT "%5.1" /end CHARACTERISTIC
/begin CHARACTERISTIC DSM_Class5Dlc_C "Anzahl Triggerereignisse für die Löschung von Fehlereinträgen" VALUE 0xCB0E8 Kw_Wu8 255.0 OneToOne 0.00 255.0 FORMAT "%5.1" /end CHARACTERISTIC
/begin CHARACTERISTIC DSM_Class5Prio_C "Priorität des Fehlereintrages für Verdrängung und freeze frame Zuordnung" VALUE 0xCB0E9 Kw_Wu8 255.0 OneToOne 0.00 255.0 FORMAT "%5.1" /end CHARACTERISTIC
/begin CHARACTERISTIC DSM_Class5SysLamp_C "Art der Systemlampenansteuerung" VALUE 0xCB0EA Kw_Wu8 2.00000000000 SysLamp 0.00 2.00000000000 FORMAT "%13.11" /end CHARACTERISTIC
/begin CHARACTERISTIC DSM_Class5ResErf_C "Verhalten Fehlerflags bei Reset und abgebrochenem Nachlauf" VALUE 0xCB0EB Kw_Wu8 3.00000000000 ResErf 0.00 3.00000000000 FORMAT "%13.11" /end CHARACTERISTIC
/begin CHARACTERISTIC DSM_Class5Readiness_C "Zuordnung Entprellklasse zu Readiness Flags" VALUE 0xCB0EC Kw_Wu8 64.0000000000 Readiness 0.00 64.0000000000 FORMAT "%13.10" /end CHARACTERISTIC
/begin CHARACTERISTIC DSM_Class6Mil_C "Art der MIL Ansteuerung" VALUE 0xCB0ED Kw_Wu8 2.00000000000 Mil 0.00 2.00000000000 FORMAT "%13.11" /end CHARACTERISTIC
/begin CHARACTERISTIC DSM_Class6TFlc_C "Trigger Art für Fehlereintrags Bestätigungsentprellung (->Lampe an)" VALUE 0xCB0EE Kw_Wu8 4.00000000000 ClassTrigger 0.00 4.00000000000 FORMAT "%13.11" /end CHARACTERISTIC
/begin CHARACTERISTIC DSM_Class6Flc_C "Anzahl Triggerereignisse für Fehlereintrags Bestätigungsentprellung (->Lampe an)" VALUE 0xCB0EF Kw_Wu8 255.0 OneToOne 0.00 255.0 FORMAT "%5.1" /end CHARACTERISTIC
/begin CHARACTERISTIC DSM_Class6THlc_C "Trigger Art für Fehlerheilung (->Lampe aus)" VALUE 0xCB0F0 Kw_Wu8 4.00000000000 ClassTrigger 0.00 4.00000000000 FORMAT "%13.11" /end CHARACTERISTIC
/begin CHARACTERISTIC DSM_Class6Hlc_C "Anzahl Triggerereignisse für Fehlerheilung (->Lampe aus)" VALUE 0xCB0F1 Kw_Wu8 255.0 OneToOne 0.00 255.0 FORMAT "%5.1" /end CHARACTERISTIC
/begin CHARACTERISTIC DSM_Class6Scatt_C "Fehler ist lesbar für OBD Scan tool tester (SCATT) wenn Wert = 1" VALUE 0xCB0F2 Kw_Wu8 1.00000000000 Scatt 0.00 1.00000000000 FORMAT "%13.11" /end CHARACTERISTIC
/begin CHARACTERISTIC DSM_Class6TDlcPen_C "Trigger Art für Löschentprellung von nicht bestätigten Fehlern (pending)" VALUE 0xCB0F3 Kw_Wu8 3.00000000000 ClassTriggerTDlc 0.00 3.00000000000 FORMAT "%13.11" /end CHARACTERISTIC
/begin CHARACTERISTIC DSM_Class6DlcPen_C "Anzahl Triggerereignisse für die Löschung von nicht bestätigten Fehlern (pending)" VALUE 0xCB0F4 Kw_Wu8 255.0 OneToOne 0.00 255.0 FORMAT "%5.1" /end CHARACTERISTIC
/begin CHARACTERISTIC DSM_Class6TDlc_C "Trigger Art für Löschentprellung" VALUE 0xCB0F5 Kw_Wu8 3.00000000000 ClassTriggerTDlc 0.00 3.00000000000 FORMAT "%13.11" /end CHARACTERISTIC
/begin CHARACTERISTIC DSM_Class6DlcKd_C "Anzahl Triggerereignisse für die Löschung von Fehlereinträgen mit Status Kundendienst" VALUE 0xCB0F6 Kw_Wu8 255.0 OneToOne 0.00 255.0 FORMAT "%5.1" /end CHARACTERISTIC
/begin CHARACTERISTIC DSM_Class6Dlc_C "Anzahl Triggerereignisse für die Löschung von Fehlereinträgen" VALUE 0xCB0F7 Kw_Wu8 255.0 OneToOne 0.00 255.0 FORMAT "%5.1" /end CHARACTERISTIC
/begin CHARACTERISTIC DSM_Class6Prio_C "Priorität des Fehlereintrages für Verdrängung und freeze frame Zuordnung" VALUE 0xCB0F8 Kw_Wu8 255.0 OneToOne 0.00 255.0 FORMAT "%5.1" /end CHARACTERISTIC
/begin CHARACTERISTIC DSM_Class6SysLamp_C "Art der Systemlampenansteuerung" VALUE 0xCB0F9 Kw_Wu8 2.00000000000 SysLamp 0.00 2.00000000000 FORMAT "%13.11" /end CHARACTERISTIC
/begin CHARACTERISTIC DSM_Class6ResErf_C "Verhalten Fehlerflags bei Reset und abgebrochenem Nachlauf" VALUE 0xCB0FA Kw_Wu8 3.00000000000 ResErf 0.00 3.00000000000 FORMAT "%13.11" /end CHARACTERISTIC
/begin CHARACTERISTIC DSM_Class6Readiness_C "Zuordnung Entprellklasse zu Readiness Flags" VALUE 0xCB0FB Kw_Wu8 64.0000000000 Readiness 0.00 64.0000000000 FORMAT "%13.10" /end CHARACTERISTIC
/begin CHARACTERISTIC DSM_Class7Mil_C "Art der MIL Ansteuerung" VALUE 0xCB0FC Kw_Wu8 2.00000000000 Mil 0.00 2.00000000000 FORMAT "%13.11" /end CHARACTERISTIC
/begin CHARACTERISTIC DSM_Class7TFlc_C "Trigger Art für Fehlereintrags Bestätigungsentprellung (->Lampe an)" VALUE 0xCB0FD Kw_Wu8 4.00000000000 ClassTrigger 0.00 4.00000000000 FORMAT "%13.11" /end CHARACTERISTIC
/begin CHARACTERISTIC DSM_Class7Flc_C "Anzahl Triggerereignisse für Fehlereintrags Bestätigungsentprellung (->Lampe an)" VALUE 0xCB0FE Kw_Wu8 255.0 OneToOne 0.00 255.0 FORMAT "%5.1" /end CHARACTERISTIC
/begin CHARACTERISTIC DSM_Class7THlc_C "Trigger Art für Fehlerheilung (->Lampe aus)" VALUE 0xCB0FF Kw_Wu8 4.00000000000 ClassTrigger 0.00 4.00000000000 FORMAT "%13.11" /end CHARACTERISTIC
/begin CHARACTERISTIC DSM_Class7Hlc_C "Anzahl Triggerereignisse für Fehlerheilung (->Lampe aus)" VALUE 0xCB100 Kw_Wu8 255.0 OneToOne 0.00 255.0 FORMAT "%5.1" /end CHARACTERISTIC
/begin CHARACTERISTIC DSM_Class7Scatt_C "Fehler ist lesbar für OBD Scan tool tester (SCATT) wenn Wert = 1" VALUE 0xCB101 Kw_Wu8 1.00000000000 Scatt 0.00 1.00000000000 FORMAT "%13.11" /end CHARACTERISTIC
/begin CHARACTERISTIC DSM_Class7TDlcPen_C "Trigger Art für Löschentprellung von nicht bestätigten Fehlern (pending)" VALUE 0xCB102 Kw_Wu8 3.00000000000 ClassTriggerTDlc 0.00 3.00000000000 FORMAT "%13.11" /end CHARACTERISTIC
/begin CHARACTERISTIC DSM_Class7DlcPen_C "Anzahl Triggerereignisse für die Löschung von nicht bestätigten Fehlern (pending)" VALUE 0xCB103 Kw_Wu8 255.0 OneToOne 0.00 255.0 FORMAT "%5.1" /end CHARACTERISTIC
/begin CHARACTERISTIC DSM_Class7TDlc_C "Trigger Art für Löschentprellung" VALUE 0xCB104 Kw_Wu8 3.00000000000 ClassTriggerTDlc 0.00 3.00000000000 FORMAT "%13.11" /end CHARACTERISTIC
/begin CHARACTERISTIC DSM_Class7DlcKd_C "Anzahl Triggerereignisse für die Löschung von Fehlereinträgen mit Status Kundendienst" VALUE 0xCB105 Kw_Wu8 255.0 OneToOne 0.00 255.0 FORMAT "%5.1" /end CHARACTERISTIC
/begin CHARACTERISTIC DSM_Class7Dlc_C "Anzahl Triggerereignisse für die Löschung von Fehlereinträgen" VALUE 0xCB106 Kw_Wu8 255.0 OneToOne 0.00 255.0 FORMAT "%5.1" /end CHARACTERISTIC
/begin CHARACTERISTIC DSM_Class7Prio_C "Priorität des Fehlereintrages für Verdrängung und freeze frame Zuordnung" VALUE 0xCB107 Kw_Wu8 255.0 OneToOne 0.00 255.0 FORMAT "%5.1" /end CHARACTERISTIC
/begin CHARACTERISTIC DSM_Class7SysLamp_C "Art der Systemlampenansteuerung" VALUE 0xCB108 Kw_Wu8 2.00000000000 SysLamp 0.00 2.00000000000 FORMAT "%13.11" /end CHARACTERISTIC
/begin CHARACTERISTIC DSM_Class7ResErf_C "Verhalten Fehlerflags bei Reset und abgebrochenem Nachlauf" VALUE 0xCB109 Kw_Wu8 3.00000000000 ResErf 0.00 3.00000000000 FORMAT "%13.11" /end CHARACTERISTIC
/begin CHARACTERISTIC DSM_Class7Readiness_C "Zuordnung Entprellklasse zu Readiness Flags" VALUE 0xCB10A Kw_Wu8 64.0000000000 Readiness 0.00 64.0000000000 FORMAT "%13.10" /end CHARACTERISTIC
/begin CHARACTERISTIC DSM_Class8Mil_C "Art der MIL Ansteuerung" VALUE 0xCB10B Kw_Wu8 2.00000000000 Mil 0.00 2.00000000000 FORMAT "%13.11" /end CHARACTERISTIC
/begin CHARACTERISTIC DSM_Class8TFlc_C "Trigger Art für Fehlereintrags Bestätigungsentprellung (->Lampe an)" VALUE 0xCB10C Kw_Wu8 4.00000000000 ClassTrigger 0.00 4.00000000000 FORMAT "%13.11" /end CHARACTERISTIC
/begin CHARACTERISTIC DSM_Class8Flc_C "Anzahl Triggerereignisse für Fehlereintrags Bestätigungsentprellung (->Lampe an)" VALUE 0xCB10D Kw_Wu8 255.0 OneToOne 0.00 255.0 FORMAT "%5.1" /end CHARACTERISTIC
/begin CHARACTERISTIC DSM_Class8THlc_C "Trigger Art für Fehlerheilung (->Lampe aus)" VALUE 0xCB10E Kw_Wu8 4.00000000000 ClassTrigger 0.00 4.00000000000 FORMAT "%13.11" /end CHARACTERISTIC
/begin CHARACTERISTIC DSM_Class8Hlc_C "Anzahl Triggerereignisse für Fehlerheilung (->Lampe aus)" VALUE 0xCB10F Kw_Wu8 255.0 OneToOne 0.00 255.0 FORMAT "%5.1" /end CHARACTERISTIC
/begin CHARACTERISTIC DSM_Class8Scatt_C "Fehler ist lesbar für OBD Scan tool tester (SCATT) wenn Wert = 1" VALUE 0xCB110 Kw_Wu8 1.00000000000 Scatt 0.00 1.00000000000 FORMAT "%13.11" /end CHARACTERISTIC
/begin CHARACTERISTIC DSM_Class8TDlcPen_C "Trigger Art für Löschentprellung von nicht bestätigten Fehlern (pending)" VALUE 0xCB111 Kw_Wu8 3.00000000000 ClassTriggerTDlc 0.00 3.00000000000 FORMAT "%13.11" /end CHARACTERISTIC
/begin CHARACTERISTIC DSM_Class8DlcPen_C "Anzahl Triggerereignisse für die Löschung von nicht bestätigten Fehlern (pending)" VALUE 0xCB112 Kw_Wu8 255.0 OneToOne 0.00 255.0 FORMAT "%5.1" /end CHARACTERISTIC
/begin CHARACTERISTIC DSM_Class8TDlc_C "Trigger Art für Löschentprellung" VALUE 0xCB113 Kw_Wu8 3.00000000000 ClassTriggerTDlc 0.00 3.00000000000 FORMAT "%13.11" /end CHARACTERISTIC
/begin CHARACTERISTIC DSM_Class8DlcKd_C "Anzahl Triggerereignisse für die Löschung von Fehlereinträgen mit Status Kundendienst" VALUE 0xCB114 Kw_Wu8 255.0 OneToOne 0.00 255.0 FORMAT "%5.1" /end CHARACTERISTIC
/begin CHARACTERISTIC DSM_Class8Dlc_C "Anzahl Triggerereignisse für die Löschung von Fehlereinträgen" VALUE 0xCB115 Kw_Wu8 255.0 OneToOne 0.00 255.0 FORMAT "%5.1" /end CHARACTERISTIC
/begin CHARACTERISTIC DSM_Class8Prio_C "Priorität des Fehlereintrages für Verdrängung und freeze frame Zuordnung" VALUE 0xCB116 Kw_Wu8 255.0 OneToOne 0.00 255.0 FORMAT "%5.1" /end CHARACTERISTIC
/begin CHARACTERISTIC DSM_Class8SysLamp_C "Art der Systemlampenansteuerung" VALUE 0xCB117 Kw_Wu8 2.00000000000 SysLamp 0.00 2.00000000000 FORMAT "%13.11" /end CHARACTERISTIC
/begin CHARACTERISTIC DSM_Class8ResErf_C "Verhalten Fehlerflags bei Reset und abgebrochenem Nachlauf" VALUE 0xCB118 Kw_Wu8 3.00000000000 ResErf 0.00 3.00000000000 FORMAT "%13.11" /end CHARACTERISTIC
/begin CHARACTERISTIC DSM_Class8Readiness_C "Zuordnung Entprellklasse zu Readiness Flags" VALUE 0xCB119 Kw_Wu8 64.0000000000 Readiness 0.00 64.0000000000 FORMAT "%13.10" /end CHARACTERISTIC
/begin CHARACTERISTIC DSM_Class9Mil_C "Art der MIL Ansteuerung" VALUE 0xCB11A Kw_Wu8 2.00000000000 Mil 0.00 2.00000000000 FORMAT "%13.11" /end CHARACTERISTIC
/begin CHARACTERISTIC DSM_Class9TFlc_C "Trigger Art für Fehlereintrags Bestätigungsentprellung (->Lampe an)" VALUE 0xCB11B Kw_Wu8 4.00000000000 ClassTrigger 0.00 4.00000000000 FORMAT "%13.11" /end CHARACTERISTIC
/begin CHARACTERISTIC DSM_Class9Flc_C "Anzahl Triggerereignisse für Fehlereintrags Bestätigungsentprellung (->Lampe an)" VALUE 0xCB11C Kw_Wu8 255.0 OneToOne 0.00 255.0 FORMAT "%5.1" /end CHARACTERISTIC
/begin CHARACTERISTIC DSM_Class9THlc_C "Trigger Art für Fehlerheilung (->Lampe aus)" VALUE 0xCB11D Kw_Wu8 4.00000000000 ClassTrigger 0.00 4.00000000000 FORMAT "%13.11" /end CHARACTERISTIC
/begin CHARACTERISTIC DSM_Class9Hlc_C "Anzahl Triggerereignisse für Fehlerheilung (->Lampe aus)" VALUE 0xCB11E Kw_Wu8 255.0 OneToOne 0.00 255.0 FORMAT "%5.1" /end CHARACTERISTIC
/begin CHARACTERISTIC DSM_Class9Scatt_C "Fehler ist lesbar für OBD Scan tool tester (SCATT) wenn Wert = 1" VALUE 0xCB11F Kw_Wu8 1.00000000000 Scatt 0.00 1.00000000000 FORMAT "%13.11" /end CHARACTERISTIC
/begin CHARACTERISTIC DSM_Class9TDlcPen_C "Trigger Art für Löschentprellung von nicht bestätigten Fehlern (pending)" VALUE 0xCB120 Kw_Wu8 3.00000000000 ClassTriggerTDlc 0.00 3.00000000000 FORMAT "%13.11" /end CHARACTERISTIC
/begin CHARACTERISTIC DSM_Class9DlcPen_C "Anzahl Triggerereignisse für die Löschung von nicht bestätigten Fehlern (pending)" VALUE 0xCB121 Kw_Wu8 255.0 OneToOne 0.00 255.0 FORMAT "%5.1" /end CHARACTERISTIC
/begin CHARACTERISTIC DSM_Class9TDlc_C "Trigger Art für Löschentprellung" VALUE 0xCB122 Kw_Wu8 3.00000000000 ClassTriggerTDlc 0.00 3.00000000000 FORMAT "%13.11" /end CHARACTERISTIC
/begin CHARACTERISTIC DSM_Class9DlcKd_C "Anzahl Triggerereignisse für die Löschung von Fehlereinträgen mit Status Kundendienst" VALUE 0xCB123 Kw_Wu8 255.0 OneToOne 0.00 255.0 FORMAT "%5.1" /end CHARACTERISTIC
/begin CHARACTERISTIC DSM_Class9Dlc_C "Anzahl Triggerereignisse für die Löschung von Fehlereinträgen" VALUE 0xCB124 Kw_Wu8 255.0 OneToOne 0.00 255.0 FORMAT "%5.1" /end CHARACTERISTIC
/begin CHARACTERISTIC DSM_Class9Prio_C "Priorität des Fehlereintrages für Verdrängung und freeze frame Zuordnung" VALUE 0xCB125 Kw_Wu8 255.0 OneToOne 0.00 255.0 FORMAT "%5.1" /end CHARACTERISTIC
/begin CHARACTERISTIC DSM_Class9SysLamp_C "Art der Systemlampenansteuerung" VALUE 0xCB126 Kw_Wu8 2.00000000000 SysLamp 0.00 2.00000000000 FORMAT "%13.11" /end CHARACTERISTIC
/begin CHARACTERISTIC DSM_Class9ResErf_C "Verhalten Fehlerflags bei Reset und abgebrochenem Nachlauf" VALUE 0xCB127 Kw_Wu8 3.00000000000 ResErf 0.00 3.00000000000 FORMAT "%13.11" /end CHARACTERISTIC
/begin CHARACTERISTIC DSM_Class9Readiness_C "Zuordnung Entprellklasse zu Readiness Flags" VALUE 0xCB128 Kw_Wu8 64.0000000000 Readiness 0.00 64.0000000000 FORMAT "%13.10" /end CHARACTERISTIC
/begin CHARACTERISTIC DSM_Class10Mil_C "Art der MIL Ansteuerung" VALUE 0xCB129 Kw_Wu8 2.00000000000 Mil 0.00 2.00000000000 FORMAT "%13.11" /end CHARACTERISTIC
/begin CHARACTERISTIC DSM_Class10TFlc_C "Trigger Art für Fehlereintrags Bestätigungsentprellung (->Lampe an)" VALUE 0xCB12A Kw_Wu8 4.00000000000 ClassTrigger 0.00 4.00000000000 FORMAT "%13.11" /end CHARACTERISTIC
/begin CHARACTERISTIC DSM_Class10Flc_C "Anzahl Triggerereignisse für Fehlereintrags Bestätigungsentprellung (->Lampe an)" VALUE 0xCB12B Kw_Wu8 255.0 OneToOne 0.00 255.0 FORMAT "%5.1" /end CHARACTERISTIC
/begin CHARACTERISTIC DSM_Class10THlc_C "Trigger Art für Fehlerheilung (->Lampe aus)" VALUE 0xCB12C Kw_Wu8 4.00000000000 ClassTrigger 0.00 4.00000000000 FORMAT "%13.11" /end CHARACTERISTIC
/begin CHARACTERISTIC DSM_Class10Hlc_C "Anzahl Triggerereignisse für Fehlerheilung (->Lampe aus)" VALUE 0xCB12D Kw_Wu8 255.0 OneToOne 0.00 255.0 FORMAT "%5.1" /end CHARACTERISTIC
/begin CHARACTERISTIC DSM_Class10Scatt_C "Fehler ist lesbar für OBD Scan tool tester (SCATT) wenn Wert = 1" VALUE 0xCB12E Kw_Wu8 1.00000000000 Scatt 0.00 1.00000000000 FORMAT "%13.11" /end CHARACTERISTIC
/begin CHARACTERISTIC DSM_Class10TDlcPen_C "Trigger Art für Löschentprellung von nicht bestätigten Fehlern (pending)" VALUE 0xCB12F Kw_Wu8 3.00000000000 ClassTriggerTDlc 0.00 3.00000000000 FORMAT "%13.11" /end CHARACTERISTIC
/begin CHARACTERISTIC DSM_Class10DlcPen_C "Anzahl Triggerereignisse für die Löschung von nicht bestätigten Fehlern (pending)" VALUE 0xCB130 Kw_Wu8 255.0 OneToOne 0.00 255.0 FORMAT "%5.1" /end CHARACTERISTIC
/begin CHARACTERISTIC DSM_Class10TDlc_C "Trigger Art für Löschentprellung" VALUE 0xCB131 Kw_Wu8 3.00000000000 ClassTriggerTDlc 0.00 3.00000000000 FORMAT "%13.11" /end CHARACTERISTIC
/begin CHARACTERISTIC DSM_Class10DlcKd_C "Anzahl Triggerereignisse für die Löschung von Fehlereinträgen mit Status Kundendienst" VALUE 0xCB132 Kw_Wu8 255.0 OneToOne 0.00 255.0 FORMAT "%5.1" /end CHARACTERISTIC
/begin CHARACTERISTIC DSM_Class10Dlc_C "Anzahl Triggerereignisse für die Löschung von Fehlereinträgen" VALUE 0xCB133 Kw_Wu8 255.0 OneToOne 0.00 255.0 FORMAT "%5.1" /end CHARACTERISTIC
/begin CHARACTERISTIC DSM_Class10Prio_C "Priorität des Fehlereintrages für Verdrängung und freeze frame Zuordnung" VALUE 0xCB134 Kw_Wu8 255.0 OneToOne 0.00 255.0 FORMAT "%5.1" /end CHARACTERISTIC
/begin CHARACTERISTIC DSM_Class10SysLamp_C "Art der Systemlampenansteuerung" VALUE 0xCB135 Kw_Wu8 2.00000000000 SysLamp 0.00 2.00000000000 FORMAT "%13.11" /end CHARACTERISTIC
/begin CHARACTERISTIC DSM_Class10ResErf_C "Verhalten Fehlerflags bei Reset und abgebrochenem Nachlauf" VALUE 0xCB136 Kw_Wu8 3.00000000000 ResErf 0.00 3.00000000000 FORMAT "%13.11" /end CHARACTERISTIC
/begin CHARACTERISTIC DSM_Class10Readiness_C "Zuordnung Entprellklasse zu Readiness Flags" VALUE 0xCB137 Kw_Wu8 64.0000000000 Readiness 0.00 64.0000000000 FORMAT "%13.10" /end CHARACTERISTIC
/begin CHARACTERISTIC DSM_Class11Mil_C "Art der MIL Ansteuerung" VALUE 0xCB138 Kw_Wu8 2.00000000000 Mil 0.00 2.00000000000 FORMAT "%13.11" /end CHARACTERISTIC
/begin CHARACTERISTIC DSM_Class11TFlc_C "Trigger Art für Fehlereintrags Bestätigungsentprellung (->Lampe an)" VALUE 0xCB139 Kw_Wu8 4.00000000000 ClassTrigger 0.00 4.00000000000 FORMAT "%13.11" /end CHARACTERISTIC
/begin CHARACTERISTIC DSM_Class11Flc_C "Anzahl Triggerereignisse für Fehlereintrags Bestätigungsentprellung (->Lampe an)" VALUE 0xCB13A Kw_Wu8 255.0 OneToOne 0.00 255.0 FORMAT "%5.1" /end CHARACTERISTIC
/begin CHARACTERISTIC DSM_Class11THlc_C "Trigger Art für Fehlerheilung (->Lampe aus)" VALUE 0xCB13B Kw_Wu8 4.00000000000 ClassTrigger 0.00 4.00000000000 FORMAT "%13.11" /end CHARACTERISTIC
/begin CHARACTERISTIC DSM_Class11Hlc_C "Anzahl Triggerereignisse für Fehlerheilung (->Lampe aus)" VALUE 0xCB13C Kw_Wu8 255.0 OneToOne 0.00 255.0 FORMAT "%5.1" /end CHARACTERISTIC
/begin CHARACTERISTIC DSM_Class11Scatt_C "Fehler ist lesbar für OBD Scan tool tester (SCATT) wenn Wert = 1" VALUE 0xCB13D Kw_Wu8 1.00000000000 Scatt 0.00 1.00000000000 FORMAT "%13.11" /end CHARACTERISTIC
/begin CHARACTERISTIC DSM_Class11TDlcPen_C "Trigger Art für Löschentprellung von nicht bestätigten Fehlern (pending)" VALUE 0xCB13E Kw_Wu8 3.00000000000 ClassTriggerTDlc 0.00 3.00000000000 FORMAT "%13.11" /end CHARACTERISTIC
/begin CHARACTERISTIC DSM_Class11DlcPen_C "Anzahl Triggerereignisse für die Löschung von nicht bestätigten Fehlern (pending)" VALUE 0xCB13F Kw_Wu8 255.0 OneToOne 0.00 255.0 FORMAT "%5.1" /end CHARACTERISTIC
/begin CHARACTERISTIC DSM_Class11TDlc_C "Trigger Art für Löschentprellung" VALUE 0xCB140 Kw_Wu8 3.00000000000 ClassTriggerTDlc 0.00 3.00000000000 FORMAT "%13.11" /end CHARACTERISTIC
/begin CHARACTERISTIC DSM_Class11DlcKd_C "Anzahl Triggerereignisse für die Löschung von Fehlereinträgen mit Status Kundendienst" VALUE 0xCB141 Kw_Wu8 255.0 OneToOne 0.00 255.0 FORMAT "%5.1" /end CHARACTERISTIC
/begin CHARACTERISTIC DSM_Class11Dlc_C "Anzahl Triggerereignisse für die Löschung von Fehlereinträgen" VALUE 0xCB142 Kw_Wu8 255.0 OneToOne 0.00 255.0 FORMAT "%5.1" /end CHARACTERISTIC
/begin CHARACTERISTIC DSM_Class11Prio_C "Priorität des Fehlereintrages für Verdrängung und freeze frame Zuordnung" VALUE 0xCB143 Kw_Wu8 255.0 OneToOne 0.00 255.0 FORMAT "%5.1" /end CHARACTERISTIC
/begin CHARACTERISTIC DSM_Class11SysLamp_C "Art der Systemlampenansteuerung" VALUE 0xCB144 Kw_Wu8 2.00000000000 SysLamp 0.00 2.00000000000 FORMAT "%13.11" /end CHARACTERISTIC
/begin CHARACTERISTIC DSM_Class11ResErf_C "Verhalten Fehlerflags bei Reset und abgebrochenem Nachlauf" VALUE 0xCB145 Kw_Wu8 3.00000000000 ResErf 0.00 3.00000000000 FORMAT "%13.11" /end CHARACTERISTIC
/begin CHARACTERISTIC DSM_Class11Readiness_C "Zuordnung Entprellklasse zu Readiness Flags" VALUE 0xCB146 Kw_Wu8 64.0000000000 Readiness 0.00 64.0000000000 FORMAT "%13.10" /end CHARACTERISTIC
/begin CHARACTERISTIC DSM_Class12Mil_C "Art der MIL Ansteuerung" VALUE 0xCB147 Kw_Wu8 2.00000000000 Mil 0.00 2.00000000000 FORMAT "%13.11" /end CHARACTERISTIC
/begin CHARACTERISTIC DSM_Class12TFlc_C "Trigger Art für Fehlereintrags Bestätigungsentprellung (->Lampe an)" VALUE 0xCB148 Kw_Wu8 4.00000000000 ClassTrigger 0.00 4.00000000000 FORMAT "%13.11" /end CHARACTERISTIC
/begin CHARACTERISTIC DSM_Class12Flc_C "Anzahl Triggerereignisse für Fehlereintrags Bestätigungsentprellung (->Lampe an)" VALUE 0xCB149 Kw_Wu8 255.0 OneToOne 0.00 255.0 FORMAT "%5.1" /end CHARACTERISTIC
/begin CHARACTERISTIC DSM_Class12THlc_C "Trigger Art für Fehlerheilung (->Lampe aus)" VALUE 0xCB14A Kw_Wu8 4.00000000000 ClassTrigger 0.00 4.00000000000 FORMAT "%13.11" /end CHARACTERISTIC
/begin CHARACTERISTIC DSM_Class12Hlc_C "Anzahl Triggerereignisse für Fehlerheilung (->Lampe aus)" VALUE 0xCB14B Kw_Wu8 255.0 OneToOne 0.00 255.0 FORMAT "%5.1" /end CHARACTERISTIC
/begin CHARACTERISTIC DSM_Class12Scatt_C "Fehler ist lesbar für OBD Scan tool tester (SCATT) wenn Wert = 1" VALUE 0xCB14C Kw_Wu8 1.00000000000 Scatt 0.00 1.00000000000 FORMAT "%13.11" /end CHARACTERISTIC
/begin CHARACTERISTIC DSM_Class12TDlcPen_C "Trigger Art für Löschentprellung von nicht bestätigten Fehlern (pending)" VALUE 0xCB14D Kw_Wu8 3.00000000000 ClassTriggerTDlc 0.00 3.00000000000 FORMAT "%13.11" /end CHARACTERISTIC
/begin CHARACTERISTIC DSM_Class12DlcPen_C "Anzahl Triggerereignisse für die Löschung von nicht bestätigten Fehlern (pending)" VALUE 0xCB14E Kw_Wu8 255.0 OneToOne 0.00 255.0 FORMAT "%5.1" /end CHARACTERISTIC
/begin CHARACTERISTIC DSM_Class12TDlc_C "Trigger Art für Löschentprellung" VALUE 0xCB14F Kw_Wu8 3.00000000000 ClassTriggerTDlc 0.00 3.00000000000 FORMAT "%13.11" /end CHARACTERISTIC
/begin CHARACTERISTIC DSM_Class12DlcKd_C "Anzahl Triggerereignisse für die Löschung von Fehlereinträgen mit Status Kundendienst" VALUE 0xCB150 Kw_Wu8 255.0 OneToOne 0.00 255.0 FORMAT "%5.1" /end CHARACTERISTIC
/begin CHARACTERISTIC DSM_Class12Dlc_C "Anzahl Triggerereignisse für die Löschung von Fehlereinträgen" VALUE 0xCB151 Kw_Wu8 255.0 OneToOne 0.00 255.0 FORMAT "%5.1" /end CHARACTERISTIC
/begin CHARACTERISTIC DSM_Class12Prio_C "Priorität des Fehlereintrages für Verdrängung und freeze frame Zuordnung" VALUE 0xCB152 Kw_Wu8 255.0 OneToOne 0.00 255.0 FORMAT "%5.1" /end CHARACTERISTIC
/begin CHARACTERISTIC DSM_Class12SysLamp_C "Art der Systemlampenansteuerung" VALUE 0xCB153 Kw_Wu8 2.00000000000 SysLamp 0.00 2.00000000000 FORMAT "%13.11" /end CHARACTERISTIC
/begin CHARACTERISTIC DSM_Class12ResErf_C "Verhalten Fehlerflags bei Reset und abgebrochenem Nachlauf" VALUE 0xCB154 Kw_Wu8 3.00000000000 ResErf 0.00 3.00000000000 FORMAT "%13.11" /end CHARACTERISTIC
/begin CHARACTERISTIC DSM_Class12Readiness_C "Zuordnung Entprellklasse zu Readiness Flags" VALUE 0xCB155 Kw_Wu8 64.0000000000 Readiness 0.00 64.0000000000 FORMAT "%13.10" /end CHARACTERISTIC
/begin CHARACTERISTIC DSM_Class13Mil_C "Art der MIL Ansteuerung" VALUE 0xCB156 Kw_Wu8 2.00000000000 Mil 0.00 2.00000000000 FORMAT "%13.11" /end CHARACTERISTIC
/begin CHARACTERISTIC DSM_Class13TFlc_C "Trigger Art für Fehlereintrags Bestätigungsentprellung (->Lampe an)" VALUE 0xCB157 Kw_Wu8 4.00000000000 ClassTrigger 0.00 4.00000000000 FORMAT "%13.11" /end CHARACTERISTIC
/begin CHARACTERISTIC DSM_Class13Flc_C "Anzahl Triggerereignisse für Fehlereintrags Bestätigungsentprellung (->Lampe an)" VALUE 0xCB158 Kw_Wu8 255.0 OneToOne 0.00 255.0 FORMAT "%5.1" /end CHARACTERISTIC
/begin CHARACTERISTIC DSM_Class13THlc_C "Trigger Art für Fehlerheilung (->Lampe aus)" VALUE 0xCB159 Kw_Wu8 4.00000000000 ClassTrigger 0.00 4.00000000000 FORMAT "%13.11" /end CHARACTERISTIC
/begin CHARACTERISTIC DSM_Class13Hlc_C "Anzahl Triggerereignisse für Fehlerheilung (->Lampe aus)" VALUE 0xCB15A Kw_Wu8 255.0 OneToOne 0.00 255.0 FORMAT "%5.1" /end CHARACTERISTIC
/begin CHARACTERISTIC DSM_Class13Scatt_C "Fehler ist lesbar für OBD Scan tool tester (SCATT) wenn Wert = 1" VALUE 0xCB15B Kw_Wu8 1.00000000000 Scatt 0.00 1.00000000000 FORMAT "%13.11" /end CHARACTERISTIC
/begin CHARACTERISTIC DSM_Class13TDlcPen_C "Trigger Art für Löschentprellung von nicht bestätigten Fehlern (pending)" VALUE 0xCB15C Kw_Wu8 3.00000000000 ClassTriggerTDlc 0.00 3.00000000000 FORMAT "%13.11" /end CHARACTERISTIC
/begin CHARACTERISTIC DSM_Class13DlcPen_C "Anzahl Triggerereignisse für die Löschung von nicht bestätigten Fehlern (pending)" VALUE 0xCB15D Kw_Wu8 255.0 OneToOne 0.00 255.0 FORMAT "%5.1" /end CHARACTERISTIC
/begin CHARACTERISTIC DSM_Class13TDlc_C "Trigger Art für Löschentprellung" VALUE 0xCB15E Kw_Wu8 3.00000000000 ClassTriggerTDlc 0.00 3.00000000000 FORMAT "%13.11" /end CHARACTERISTIC
/begin CHARACTERISTIC DSM_Class13DlcKd_C "Anzahl Triggerereignisse für die Löschung von Fehlereinträgen mit Status Kundendienst" VALUE 0xCB15F Kw_Wu8 255.0 OneToOne 0.00 255.0 FORMAT "%5.1" /end CHARACTERISTIC
/begin CHARACTERISTIC DSM_Class13Dlc_C "Anzahl Triggerereignisse für die Löschung von Fehlereinträgen" VALUE 0xCB160 Kw_Wu8 255.0 OneToOne 0.00 255.0 FORMAT "%5.1" /end CHARACTERISTIC
/begin CHARACTERISTIC DSM_Class13Prio_C "Priorität des Fehlereintrages für Verdrängung und freeze frame Zuordnung" VALUE 0xCB161 Kw_Wu8 255.0 OneToOne 0.00 255.0 FORMAT "%5.1" /end CHARACTERISTIC
/begin CHARACTERISTIC DSM_Class13SysLamp_C "Art der Systemlampenansteuerung" VALUE 0xCB162 Kw_Wu8 2.00000000000 SysLamp 0.00 2.00000000000 FORMAT "%13.11" /end CHARACTERISTIC
/begin CHARACTERISTIC DSM_Class13ResErf_C "Verhalten Fehlerflags bei Reset und abgebrochenem Nachlauf" VALUE 0xCB163 Kw_Wu8 3.00000000000 ResErf 0.00 3.00000000000 FORMAT "%13.11" /end CHARACTERISTIC
/begin CHARACTERISTIC DSM_Class13Readiness_C "Zuordnung Entprellklasse zu Readiness Flags" VALUE 0xCB164 Kw_Wu8 64.0000000000 Readiness 0.00 64.0000000000 FORMAT "%13.10" /end CHARACTERISTIC
/begin CHARACTERISTIC DSM_Class14Mil_C "Art der MIL Ansteuerung" VALUE 0xCB165 Kw_Wu8 2.00000000000 Mil 0.00 2.00000000000 FORMAT "%13.11" /end CHARACTERISTIC
/begin CHARACTERISTIC DSM_Class14TFlc_C "Trigger Art für Fehlereintrags Bestätigungsentprellung (->Lampe an)" VALUE 0xCB166 Kw_Wu8 4.00000000000 ClassTrigger 0.00 4.00000000000 FORMAT "%13.11" /end CHARACTERISTIC
/begin CHARACTERISTIC DSM_Class14Flc_C "Anzahl Triggerereignisse für Fehlereintrags Bestätigungsentprellung (->Lampe an)" VALUE 0xCB167 Kw_Wu8 255.0 OneToOne 0.00 255.0 FORMAT "%5.1" /end CHARACTERISTIC
/begin CHARACTERISTIC DSM_Class14THlc_C "Trigger Art für Fehlerheilung (->Lampe aus)" VALUE 0xCB168 Kw_Wu8 4.00000000000 ClassTrigger 0.00 4.00000000000 FORMAT "%13.11" /end CHARACTERISTIC
/begin CHARACTERISTIC DSM_Class14Hlc_C "Anzahl Triggerereignisse für Fehlerheilung (->Lampe aus)" VALUE 0xCB169 Kw_Wu8 255.0 OneToOne 0.00 255.0 FORMAT "%5.1" /end CHARACTERISTIC
/begin CHARACTERISTIC DSM_Class14Scatt_C "Fehler ist lesbar für OBD Scan tool tester (SCATT) wenn Wert = 1" VALUE 0xCB16A Kw_Wu8 1.00000000000 Scatt 0.00 1.00000000000 FORMAT "%13.11" /end CHARACTERISTIC
/begin CHARACTERISTIC DSM_Class14TDlcPen_C "Trigger Art für Löschentprellung von nicht bestätigten Fehlern (pending)" VALUE 0xCB16B Kw_Wu8 3.00000000000 ClassTriggerTDlc 0.00 3.00000000000 FORMAT "%13.11" /end CHARACTERISTIC
/begin CHARACTERISTIC DSM_Class14DlcPen_C "Anzahl Triggerereignisse für die Löschung von nicht bestätigten Fehlern (pending)" VALUE 0xCB16C Kw_Wu8 255.0 OneToOne 0.00 255.0 FORMAT "%5.1" /end CHARACTERISTIC
/begin CHARACTERISTIC DSM_Class14TDlc_C "Trigger Art für Löschentprellung" VALUE 0xCB16D Kw_Wu8 3.00000000000 ClassTriggerTDlc 0.00 3.00000000000 FORMAT "%13.11" /end CHARACTERISTIC
/begin CHARACTERISTIC DSM_Class14DlcKd_C "Anzahl Triggerereignisse für die Löschung von Fehlereinträgen mit Status Kundendienst" VALUE 0xCB16E Kw_Wu8 255.0 OneToOne 0.00 255.0 FORMAT "%5.1" /end CHARACTERISTIC
/begin CHARACTERISTIC DSM_Class14Dlc_C "Anzahl Triggerereignisse für die Löschung von Fehlereinträgen" VALUE 0xCB16F Kw_Wu8 255.0 OneToOne 0.00 255.0 FORMAT "%5.1" /end CHARACTERISTIC
/begin CHARACTERISTIC DSM_Class14Prio_C "Priorität des Fehlereintrages für Verdrängung und freeze frame Zuordnung" VALUE 0xCB170 Kw_Wu8 255.0 OneToOne 0.00 255.0 FORMAT "%5.1" /end CHARACTERISTIC
/begin CHARACTERISTIC DSM_Class14SysLamp_C "Art der Systemlampenansteuerung" VALUE 0xCB171 Kw_Wu8 2.00000000000 SysLamp 0.00 2.00000000000 FORMAT "%13.11" /end CHARACTERISTIC
/begin CHARACTERISTIC DSM_Class14ResErf_C "Verhalten Fehlerflags bei Reset und abgebrochenem Nachlauf" VALUE 0xCB172 Kw_Wu8 3.00000000000 ResErf 0.00 3.00000000000 FORMAT "%13.11" /end CHARACTERISTIC
/begin CHARACTERISTIC DSM_Class14Readiness_C "Zuordnung Entprellklasse zu Readiness Flags" VALUE 0xCB173 Kw_Wu8 64.0000000000 Readiness 0.00 64.0000000000 FORMAT "%13.10" /end CHARACTERISTIC
/begin CHARACTERISTIC DSM_Class15Mil_C "Art der MIL Ansteuerung" VALUE 0xCB174 Kw_Wu8 2.00000000000 Mil 0.00 2.00000000000 FORMAT "%13.11" /end CHARACTERISTIC
/begin CHARACTERISTIC DSM_Class15TFlc_C "Trigger Art für Fehlereintrags Bestätigungsentprellung (->Lampe an)" VALUE 0xCB175 Kw_Wu8 4.00000000000 ClassTrigger 0.00 4.00000000000 FORMAT "%13.11" /end CHARACTERISTIC
/begin CHARACTERISTIC DSM_Class15Flc_C "Anzahl Triggerereignisse für Fehlereintrags Bestätigungsentprellung (->Lampe an)" VALUE 0xCB176 Kw_Wu8 255.0 OneToOne 0.00 255.0 FORMAT "%5.1" /end CHARACTERISTIC
/begin CHARACTERISTIC DSM_Class15THlc_C "Trigger Art für Fehlerheilung (->Lampe aus)" VALUE 0xCB177 Kw_Wu8 4.00000000000 ClassTrigger 0.00 4.00000000000 FORMAT "%13.11" /end CHARACTERISTIC
/begin CHARACTERISTIC DSM_Class15Hlc_C "Anzahl Triggerereignisse für Fehlerheilung (->Lampe aus)" VALUE 0xCB178 Kw_Wu8 255.0 OneToOne 0.00 255.0 FORMAT "%5.1" /end CHARACTERISTIC
/begin CHARACTERISTIC DSM_Class15Scatt_C "Fehler ist lesbar für OBD Scan tool tester (SCATT) wenn Wert = 1" VALUE 0xCB179 Kw_Wu8 1.00000000000 Scatt 0.00 1.00000000000 FORMAT "%13.11" /end CHARACTERISTIC
/begin CHARACTERISTIC DSM_Class15TDlcPen_C "Trigger Art für Löschentprellung von nicht bestätigten Fehlern (pending)" VALUE 0xCB17A Kw_Wu8 3.00000000000 ClassTriggerTDlc 0.00 3.00000000000 FORMAT "%13.11" /end CHARACTERISTIC
/begin CHARACTERISTIC DSM_Class15DlcPen_C "Anzahl Triggerereignisse für die Löschung von nicht bestätigten Fehlern (pending)" VALUE 0xCB17B Kw_Wu8 255.0 OneToOne 0.00 255.0 FORMAT "%5.1" /end CHARACTERISTIC
/begin CHARACTERISTIC DSM_Class15TDlc_C "Trigger Art für Löschentprellung" VALUE 0xCB17C Kw_Wu8 3.00000000000 ClassTriggerTDlc 0.00 3.00000000000 FORMAT "%13.11" /end CHARACTERISTIC
/begin CHARACTERISTIC DSM_Class15DlcKd_C "Anzahl Triggerereignisse für die Löschung von Fehlereinträgen mit Status Kundendienst" VALUE 0xCB17D Kw_Wu8 255.0 OneToOne 0.00 255.0 FORMAT "%5.1" /end CHARACTERISTIC
/begin CHARACTERISTIC DSM_Class15Dlc_C "Anzahl Triggerereignisse für die Löschung von Fehlereinträgen" VALUE 0xCB17E Kw_Wu8 255.0 OneToOne 0.00 255.0 FORMAT "%5.1" /end CHARACTERISTIC
/begin CHARACTERISTIC DSM_Class15Prio_C "Priorität des Fehlereintrages für Verdrängung und freeze frame Zuordnung" VALUE 0xCB17F Kw_Wu8 255.0 OneToOne 0.00 255.0 FORMAT "%5.1" /end CHARACTERISTIC
/begin CHARACTERISTIC DSM_Class15SysLamp_C "Art der Systemlampenansteuerung" VALUE 0xCB180 Kw_Wu8 2.00000000000 SysLamp 0.00 2.00000000000 FORMAT "%13.11" /end CHARACTERISTIC
/begin CHARACTERISTIC DSM_Class15ResErf_C "Verhalten Fehlerflags bei Reset und abgebrochenem Nachlauf" VALUE 0xCB181 Kw_Wu8 3.00000000000 ResErf 0.00 3.00000000000 FORMAT "%13.11" /end CHARACTERISTIC
/begin CHARACTERISTIC DSM_Class15Readiness_C "Zuordnung Entprellklasse zu Readiness Flags" VALUE 0xCB182 Kw_Wu8 64.0000000000 Readiness 0.00 64.0000000000 FORMAT "%13.10" /end CHARACTERISTIC
/begin CHARACTERISTIC DSM_Class16Mil_C "Art der MIL Ansteuerung" VALUE 0xCB183 Kw_Wu8 2.00000000000 Mil 0.00 2.00000000000 FORMAT "%13.11" /end CHARACTERISTIC
/begin CHARACTERISTIC DSM_Class16TFlc_C "Trigger Art für Fehlereintrags Bestätigungsentprellung (->Lampe an)" VALUE 0xCB184 Kw_Wu8 4.00000000000 ClassTrigger 0.00 4.00000000000 FORMAT "%13.11" /end CHARACTERISTIC
/begin CHARACTERISTIC DSM_Class16Flc_C "Anzahl Triggerereignisse für Fehlereintrags Bestätigungsentprellung (->Lampe an)" VALUE 0xCB185 Kw_Wu8 255.0 OneToOne 0.00 255.0 FORMAT "%5.1" /end CHARACTERISTIC
/begin CHARACTERISTIC DSM_Class16THlc_C "Trigger Art für Fehlerheilung (->Lampe aus)" VALUE 0xCB186 Kw_Wu8 4.00000000000 ClassTrigger 0.00 4.00000000000 FORMAT "%13.11" /end CHARACTERISTIC
/begin CHARACTERISTIC DSM_Class16Hlc_C "Anzahl Triggerereignisse für Fehlerheilung (->Lampe aus)" VALUE 0xCB187 Kw_Wu8 255.0 OneToOne 0.00 255.0 FORMAT "%5.1" /end CHARACTERISTIC
/begin CHARACTERISTIC DSM_Class16Scatt_C "Fehler ist lesbar für OBD Scan tool tester (SCATT) wenn Wert = 1" VALUE 0xCB188 Kw_Wu8 1.00000000000 Scatt 0.00 1.00000000000 FORMAT "%13.11" /end CHARACTERISTIC
/begin CHARACTERISTIC DSM_Class16TDlcPen_C "Trigger Art für Löschentprellung von nicht bestätigten Fehlern (pending)" VALUE 0xCB189 Kw_Wu8 3.00000000000 ClassTriggerTDlc 0.00 3.00000000000 FORMAT "%13.11" /end CHARACTERISTIC
/begin CHARACTERISTIC DSM_Class16DlcPen_C "Anzahl Triggerereignisse für die Löschung von nicht bestätigten Fehlern (pending)" VALUE 0xCB18A Kw_Wu8 255.0 OneToOne 0.00 255.0 FORMAT "%5.1" /end CHARACTERISTIC
/begin CHARACTERISTIC DSM_Class16TDlc_C "Trigger Art für Löschentprellung" VALUE 0xCB18B Kw_Wu8 3.00000000000 ClassTriggerTDlc 0.00 3.00000000000 FORMAT "%13.11" /end CHARACTERISTIC
/begin CHARACTERISTIC DSM_Class16DlcKd_C "Anzahl Triggerereignisse für die Löschung von Fehlereinträgen mit Status Kundendienst" VALUE 0xCB18C Kw_Wu8 255.0 OneToOne 0.00 255.0 FORMAT "%5.1" /end CHARACTERISTIC
/begin CHARACTERISTIC DSM_Class16Dlc_C "Anzahl Triggerereignisse für die Löschung von Fehlereinträgen" VALUE 0xCB18D Kw_Wu8 255.0 OneToOne 0.00 255.0 FORMAT "%5.1" /end CHARACTERISTIC
/begin CHARACTERISTIC DSM_Class16Prio_C "Priorität des Fehlereintrages für Verdrängung und freeze frame Zuordnung" VALUE 0xCB18E Kw_Wu8 255.0 OneToOne 0.00 255.0 FORMAT "%5.1" /end CHARACTERISTIC
/begin CHARACTERISTIC DSM_Class16SysLamp_C "Art der Systemlampenansteuerung" VALUE 0xCB18F Kw_Wu8 2.00000000000 SysLamp 0.00 2.00000000000 FORMAT "%13.11" /end CHARACTERISTIC
/begin CHARACTERISTIC DSM_Class16ResErf_C "Verhalten Fehlerflags bei Reset und abgebrochenem Nachlauf" VALUE 0xCB190 Kw_Wu8 3.00000000000 ResErf 0.00 3.00000000000 FORMAT "%13.11" /end CHARACTERISTIC
/begin CHARACTERISTIC DSM_Class16Readiness_C "Zuordnung Entprellklasse zu Readiness Flags" VALUE 0xCB191 Kw_Wu8 64.0000000000 Readiness 0.00 64.0000000000 FORMAT "%13.10" /end CHARACTERISTIC
/begin CHARACTERISTIC DSM_Class17Mil_C "Art der MIL Ansteuerung" VALUE 0xCB192 Kw_Wu8 2.00000000000 Mil 0.00 2.00000000000 FORMAT "%13.11" /end CHARACTERISTIC
/begin CHARACTERISTIC DSM_Class17TFlc_C "Trigger Art für Fehlereintrags Bestätigungsentprellung (->Lampe an)" VALUE 0xCB193 Kw_Wu8 4.00000000000 ClassTrigger 0.00 4.00000000000 FORMAT "%13.11" /end CHARACTERISTIC
/begin CHARACTERISTIC DSM_Class17Flc_C "Anzahl Triggerereignisse für Fehlereintrags Bestätigungsentprellung (->Lampe an)" VALUE 0xCB194 Kw_Wu8 255.0 OneToOne 0.00 255.0 FORMAT "%5.1" /end CHARACTERISTIC
/begin CHARACTERISTIC DSM_Class17THlc_C "Trigger Art für Fehlerheilung (->Lampe aus)" VALUE 0xCB195 Kw_Wu8 4.00000000000 ClassTrigger 0.00 4.00000000000 FORMAT "%13.11" /end CHARACTERISTIC
/begin CHARACTERISTIC DSM_Class17Hlc_C "Anzahl Triggerereignisse für Fehlerheilung (->Lampe aus)" VALUE 0xCB196 Kw_Wu8 255.0 OneToOne 0.00 255.0 FORMAT "%5.1" /end CHARACTERISTIC
/begin CHARACTERISTIC DSM_Class17Scatt_C "Fehler ist lesbar für OBD Scan tool tester (SCATT) wenn Wert = 1" VALUE 0xCB197 Kw_Wu8 1.00000000000 Scatt 0.00 1.00000000000 FORMAT "%13.11" /end CHARACTERISTIC
/begin CHARACTERISTIC DSM_Class17TDlcPen_C "Trigger Art für Löschentprellung von nicht bestätigten Fehlern (pending)" VALUE 0xCB198 Kw_Wu8 3.00000000000 ClassTriggerTDlc 0.00 3.00000000000 FORMAT "%13.11" /end CHARACTERISTIC
/begin CHARACTERISTIC DSM_Class17DlcPen_C "Anzahl Triggerereignisse für die Löschung von nicht bestätigten Fehlern (pending)" VALUE 0xCB199 Kw_Wu8 255.0 OneToOne 0.00 255.0 FORMAT "%5.1" /end CHARACTERISTIC
/begin CHARACTERISTIC DSM_Class17TDlc_C "Trigger Art für Löschentprellung" VALUE 0xCB19A Kw_Wu8 3.00000000000 ClassTriggerTDlc 0.00 3.00000000000 FORMAT "%13.11" /end CHARACTERISTIC
/begin CHARACTERISTIC DSM_Class17DlcKd_C "Anzahl Triggerereignisse für die Löschung von Fehlereinträgen mit Status Kundendienst" VALUE 0xCB19B Kw_Wu8 255.0 OneToOne 0.00 255.0 FORMAT "%5.1" /end CHARACTERISTIC
/begin CHARACTERISTIC DSM_Class17Dlc_C "Anzahl Triggerereignisse für die Löschung von Fehlereinträgen" VALUE 0xCB19C Kw_Wu8 255.0 OneToOne 0.00 255.0 FORMAT "%5.1" /end CHARACTERISTIC
/begin CHARACTERISTIC DSM_Class17Prio_C "Priorität des Fehlereintrages für Verdrängung und freeze frame Zuordnung" VALUE 0xCB19D Kw_Wu8 255.0 OneToOne 0.00 255.0 FORMAT "%5.1" /end CHARACTERISTIC
/begin CHARACTERISTIC DSM_Class17SysLamp_C "Art der Systemlampenansteuerung" VALUE 0xCB19E Kw_Wu8 2.00000000000 SysLamp 0.00 2.00000000000 FORMAT "%13.11" /end CHARACTERISTIC
/begin CHARACTERISTIC DSM_Class17ResErf_C "Verhalten Fehlerflags bei Reset und abgebrochenem Nachlauf" VALUE 0xCB19F Kw_Wu8 3.00000000000 ResErf 0.00 3.00000000000 FORMAT "%13.11" /end CHARACTERISTIC
/begin CHARACTERISTIC DSM_Class17Readiness_C "Zuordnung Entprellklasse zu Readiness Flags" VALUE 0xCB1A0 Kw_Wu8 64.0000000000 Readiness 0.00 64.0000000000 FORMAT "%13.10" /end CHARACTERISTIC
/begin CHARACTERISTIC DSM_Class18Mil_C "Art der MIL Ansteuerung" VALUE 0xCB1A1 Kw_Wu8 2.00000000000 Mil 0.00 2.00000000000 FORMAT "%13.11" /end CHARACTERISTIC
/begin CHARACTERISTIC DSM_Class18TFlc_C "Trigger Art für Fehlereintrags Bestätigungsentprellung (->Lampe an)" VALUE 0xCB1A2 Kw_Wu8 4.00000000000 ClassTrigger 0.00 4.00000000000 FORMAT "%13.11" /end CHARACTERISTIC
/begin CHARACTERISTIC DSM_Class18Flc_C "Anzahl Triggerereignisse für Fehlereintrags Bestätigungsentprellung (->Lampe an)" VALUE 0xCB1A3 Kw_Wu8 255.0 OneToOne 0.00 255.0 FORMAT "%5.1" /end CHARACTERISTIC
/begin CHARACTERISTIC DSM_Class18THlc_C "Trigger Art für Fehlerheilung (->Lampe aus)" VALUE 0xCB1A4 Kw_Wu8 4.00000000000 ClassTrigger 0.00 4.00000000000 FORMAT "%13.11" /end CHARACTERISTIC
/begin CHARACTERISTIC DSM_Class18Hlc_C "Anzahl Triggerereignisse für Fehlerheilung (->Lampe aus)" VALUE 0xCB1A5 Kw_Wu8 255.0 OneToOne 0.00 255.0 FORMAT "%5.1" /end CHARACTERISTIC
/begin CHARACTERISTIC DSM_Class18Scatt_C "Fehler ist lesbar für OBD Scan tool tester (SCATT) wenn Wert = 1" VALUE 0xCB1A6 Kw_Wu8 1.00000000000 Scatt 0.00 1.00000000000 FORMAT "%13.11" /end CHARACTERISTIC
/begin CHARACTERISTIC DSM_Class18TDlcPen_C "Trigger Art für Löschentprellung von nicht bestätigten Fehlern (pending)" VALUE 0xCB1A7 Kw_Wu8 3.00000000000 ClassTriggerTDlc 0.00 3.00000000000 FORMAT "%13.11" /end CHARACTERISTIC
/begin CHARACTERISTIC DSM_Class18DlcPen_C "Anzahl Triggerereignisse für die Löschung von nicht bestätigten Fehlern (pending)" VALUE 0xCB1A8 Kw_Wu8 255.0 OneToOne 0.00 255.0 FORMAT "%5.1" /end CHARACTERISTIC
/begin CHARACTERISTIC DSM_Class18TDlc_C "Trigger Art für Löschentprellung" VALUE 0xCB1A9 Kw_Wu8 3.00000000000 ClassTriggerTDlc 0.00 3.00000000000 FORMAT "%13.11" /end CHARACTERISTIC
/begin CHARACTERISTIC DSM_Class18DlcKd_C "Anzahl Triggerereignisse für die Löschung von Fehlereinträgen mit Status Kundendienst" VALUE 0xCB1AA Kw_Wu8 255.0 OneToOne 0.00 255.0 FORMAT "%5.1" /end CHARACTERISTIC
/begin CHARACTERISTIC DSM_Class18Dlc_C "Anzahl Triggerereignisse für die Löschung von Fehlereinträgen" VALUE 0xCB1AB Kw_Wu8 255.0 OneToOne 0.00 255.0 FORMAT "%5.1" /end CHARACTERISTIC
/begin CHARACTERISTIC DSM_Class18Prio_C "Priorität des Fehlereintrages für Verdrängung und freeze frame Zuordnung" VALUE 0xCB1AC Kw_Wu8 255.0 OneToOne 0.00 255.0 FORMAT "%5.1" /end CHARACTERISTIC
/begin CHARACTERISTIC DSM_Class18SysLamp_C "Art der Systemlampenansteuerung" VALUE 0xCB1AD Kw_Wu8 2.00000000000 SysLamp 0.00 2.00000000000 FORMAT "%13.11" /end CHARACTERISTIC
/begin CHARACTERISTIC DSM_Class18ResErf_C "Verhalten Fehlerflags bei Reset und abgebrochenem Nachlauf" VALUE 0xCB1AE Kw_Wu8 3.00000000000 ResErf 0.00 3.00000000000 FORMAT "%13.11" /end CHARACTERISTIC
/begin CHARACTERISTIC DSM_Class18Readiness_C "Zuordnung Entprellklasse zu Readiness Flags" VALUE 0xCB1AF Kw_Wu8 64.0000000000 Readiness 0.00 64.0000000000 FORMAT "%13.10" /end CHARACTERISTIC
/begin CHARACTERISTIC DSM_Class19Mil_C "Art der MIL Ansteuerung" VALUE 0xCB1B0 Kw_Wu8 2.00000000000 Mil 0.00 2.00000000000 FORMAT "%13.11" /end CHARACTERISTIC
/begin CHARACTERISTIC DSM_Class19TFlc_C "Trigger Art für Fehlereintrags Bestätigungsentprellung (->Lampe an)" VALUE 0xCB1B1 Kw_Wu8 4.00000000000 ClassTrigger 0.00 4.00000000000 FORMAT "%13.11" /end CHARACTERISTIC
/begin CHARACTERISTIC DSM_Class19Flc_C "Anzahl Triggerereignisse für Fehlereintrags Bestätigungsentprellung (->Lampe an)" VALUE 0xCB1B2 Kw_Wu8 255.0 OneToOne 0.00 255.0 FORMAT "%5.1" /end CHARACTERISTIC
/begin CHARACTERISTIC DSM_Class19THlc_C "Trigger Art für Fehlerheilung (->Lampe aus)" VALUE 0xCB1B3 Kw_Wu8 4.00000000000 ClassTrigger 0.00 4.00000000000 FORMAT "%13.11" /end CHARACTERISTIC
/begin CHARACTERISTIC DSM_Class19Hlc_C "Anzahl Triggerereignisse für Fehlerheilung (->Lampe aus)" VALUE 0xCB1B4 Kw_Wu8 255.0 OneToOne 0.00 255.0 FORMAT "%5.1" /end CHARACTERISTIC
/begin CHARACTERISTIC DSM_Class19Scatt_C "Fehler ist lesbar für OBD Scan tool tester (SCATT) wenn Wert = 1" VALUE 0xCB1B5 Kw_Wu8 1.00000000000 Scatt 0.00 1.00000000000 FORMAT "%13.11" /end CHARACTERISTIC
/begin CHARACTERISTIC DSM_Class19TDlcPen_C "Trigger Art für Löschentprellung von nicht bestätigten Fehlern (pending)" VALUE 0xCB1B6 Kw_Wu8 3.00000000000 ClassTriggerTDlc 0.00 3.00000000000 FORMAT "%13.11" /end CHARACTERISTIC
/begin CHARACTERISTIC DSM_Class19DlcPen_C "Anzahl Triggerereignisse für die Löschung von nicht bestätigten Fehlern (pending)" VALUE 0xCB1B7 Kw_Wu8 255.0 OneToOne 0.00 255.0 FORMAT "%5.1" /end CHARACTERISTIC
/begin CHARACTERISTIC DSM_Class19TDlc_C "Trigger Art für Löschentprellung" VALUE 0xCB1B8 Kw_Wu8 3.00000000000 ClassTriggerTDlc 0.00 3.00000000000 FORMAT "%13.11" /end CHARACTERISTIC
/begin CHARACTERISTIC DSM_Class19DlcKd_C "Anzahl Triggerereignisse für die Löschung von Fehlereinträgen mit Status Kundendienst" VALUE 0xCB1B9 Kw_Wu8 255.0 OneToOne 0.00 255.0 FORMAT "%5.1" /end CHARACTERISTIC
/begin CHARACTERISTIC DSM_Class19Dlc_C "Anzahl Triggerereignisse für die Löschung von Fehlereinträgen" VALUE 0xCB1BA Kw_Wu8 255.0 OneToOne 0.00 255.0 FORMAT "%5.1" /end CHARACTERISTIC
/begin CHARACTERISTIC DSM_Class19Prio_C "Priorität des Fehlereintrages für Verdrängung und freeze frame Zuordnung" VALUE 0xCB1BB Kw_Wu8 255.0 OneToOne 0.00 255.0 FORMAT "%5.1" /end CHARACTERISTIC
/begin CHARACTERISTIC DSM_Class19SysLamp_C "Art der Systemlampenansteuerung" VALUE 0xCB1BC Kw_Wu8 2.00000000000 SysLamp 0.00 2.00000000000 FORMAT "%13.11" /end CHARACTERISTIC
/begin CHARACTERISTIC DSM_Class19ResErf_C "Verhalten Fehlerflags bei Reset und abgebrochenem Nachlauf" VALUE 0xCB1BD Kw_Wu8 3.00000000000 ResErf 0.00 3.00000000000 FORMAT "%13.11" /end CHARACTERISTIC
/begin CHARACTERISTIC DSM_Class19Readiness_C "Zuordnung Entprellklasse zu Readiness Flags" VALUE 0xCB1BE Kw_Wu8 64.0000000000 Readiness 0.00 64.0000000000 FORMAT "%13.10" /end CHARACTERISTIC
/begin CHARACTERISTIC DSM_Class20Mil_C "Art der MIL Ansteuerung" VALUE 0xCB1BF Kw_Wu8 2.00000000000 Mil 0.00 2.00000000000 FORMAT "%13.11" /end CHARACTERISTIC
/begin CHARACTERISTIC DSM_Class20TFlc_C "Trigger Art für Fehlereintrags Bestätigungsentprellung (->Lampe an)" VALUE 0xCB1C0 Kw_Wu8 4.00000000000 ClassTrigger 0.00 4.00000000000 FORMAT "%13.11" /end CHARACTERISTIC
/begin CHARACTERISTIC DSM_Class20Flc_C "Anzahl Triggerereignisse für Fehlereintrags Bestätigungsentprellung (->Lampe an)" VALUE 0xCB1C1 Kw_Wu8 255.0 OneToOne 0.00 255.0 FORMAT "%5.1" /end CHARACTERISTIC
/begin CHARACTERISTIC DSM_Class20THlc_C "Trigger Art für Fehlerheilung (->Lampe aus)" VALUE 0xCB1C2 Kw_Wu8 4.00000000000 ClassTrigger 0.00 4.00000000000 FORMAT "%13.11" /end CHARACTERISTIC
/begin CHARACTERISTIC DSM_Class20Hlc_C "Anzahl Triggerereignisse für Fehlerheilung (->Lampe aus)" VALUE 0xCB1C3 Kw_Wu8 255.0 OneToOne 0.00 255.0 FORMAT "%5.1" /end CHARACTERISTIC
/begin CHARACTERISTIC DSM_Class20Scatt_C "Fehler ist lesbar für OBD Scan tool tester (SCATT) wenn Wert = 1" VALUE 0xCB1C4 Kw_Wu8 1.00000000000 Scatt 0.00 1.00000000000 FORMAT "%13.11" /end CHARACTERISTIC
/begin CHARACTERISTIC DSM_Class20TDlcPen_C "Trigger Art für Löschentprellung von nicht bestätigten Fehlern (pending)" VALUE 0xCB1C5 Kw_Wu8 3.00000000000 ClassTriggerTDlc 0.00 3.00000000000 FORMAT "%13.11" /end CHARACTERISTIC
/begin CHARACTERISTIC DSM_Class20DlcPen_C "Anzahl Triggerereignisse für die Löschung von nicht bestätigten Fehlern (pending)" VALUE 0xCB1C6 Kw_Wu8 255.0 OneToOne 0.00 255.0 FORMAT "%5.1" /end CHARACTERISTIC
/begin CHARACTERISTIC DSM_Class20TDlc_C "Trigger Art für Löschentprellung" VALUE 0xCB1C7 Kw_Wu8 3.00000000000 ClassTriggerTDlc 0.00 3.00000000000 FORMAT "%13.11" /end CHARACTERISTIC
/begin CHARACTERISTIC DSM_Class20DlcKd_C "Anzahl Triggerereignisse für die Löschung von Fehlereinträgen mit Status Kundendienst" VALUE 0xCB1C8 Kw_Wu8 255.0 OneToOne 0.00 255.0 FORMAT "%5.1" /end CHARACTERISTIC
/begin CHARACTERISTIC DSM_Class20Dlc_C "Anzahl Triggerereignisse für die Löschung von Fehlereinträgen" VALUE 0xCB1C9 Kw_Wu8 255.0 OneToOne 0.00 255.0 FORMAT "%5.1" /end CHARACTERISTIC
/begin CHARACTERISTIC DSM_Class20Prio_C "Priorität des Fehlereintrages für Verdrängung und freeze frame Zuordnung" VALUE 0xCB1CA Kw_Wu8 255.0 OneToOne 0.00 255.0 FORMAT "%5.1" /end CHARACTERISTIC
/begin CHARACTERISTIC DSM_Class20SysLamp_C "Art der Systemlampenansteuerung" VALUE 0xCB1CB Kw_Wu8 2.00000000000 SysLamp 0.00 2.00000000000 FORMAT "%13.11" /end CHARACTERISTIC
/begin CHARACTERISTIC DSM_Class20ResErf_C "Verhalten Fehlerflags bei Reset und abgebrochenem Nachlauf" VALUE 0xCB1CC Kw_Wu8 3.00000000000 ResErf 0.00 3.00000000000 FORMAT "%13.11" /end CHARACTERISTIC
/begin CHARACTERISTIC DSM_Class20Readiness_C "Zuordnung Entprellklasse zu Readiness Flags" VALUE 0xCB1CD Kw_Wu8 64.0000000000 Readiness 0.00 64.0000000000 FORMAT "%13.10" /end CHARACTERISTIC
/begin CHARACTERISTIC DSM_FCMClear_C "Fehlerspeicher löschen über Label" VALUE 0xCB1CE Kw_Wu8 1.000 OneToOne 0.00 1.000 FORMAT "%5.3" EXTENDED_LIMITS 0.00 255.0 /end CHARACTERISTIC
/begin CHARACTERISTIC DSM_FMKDfp_Layer_TANS_C "Ausblendbedingungen fuer Fehlerpfad Dfp_Layer_TANS" VALUE 0xCB1F8 Kw_Wu8 255.0 OneToOne 0.00 255.0 FORMAT "%5.1" /end CHARACTERISTIC
/begin CHARACTERISTIC DSM_FMKDfp_ACCDSwtin_C "Ausblendbedingungen fuer Fehlerpfad Dfp_ACCDSwtin" VALUE 0xCB1F9 Kw_Wu8 255.0 OneToOne 0.00 255.0 FORMAT "%5.1" /end CHARACTERISTIC
/begin CHARACTERISTIC DSM_FMKDfp_ACC_PlausTrqDes_C "Ausblendbedingungen fuer Fehlerpfad Dfp_ACC_PlausTrqDes" VALUE 0xCB1FA Kw_Wu8 255.0 OneToOne 0.00 255.0 FORMAT "%5.1" /end CHARACTERISTIC
/begin CHARACTERISTIC DSM_FMKDfp_ACC_trqInr_C "Ausblendbedingungen fuer Fehlerpfad Dfp_ACC_trqInr" VALUE 0xCB1FB Kw_Wu8 255.0 OneToOne 0.00 255.0 FORMAT "%5.1" /end CHARACTERISTIC
/begin CHARACTERISTIC DSM_FMKDfp_ACTrq_C "Ausblendbedingungen fuer Fehlerpfad Dfp_ACTrq" VALUE 0xCB1FC Kw_Wu8 255.0 OneToOne 0.00 255.0 FORMAT "%5.1" /end CHARACTERISTIC
/begin CHARACTERISTIC DSM_FMKDfp_ADCMon_C "Ausblendbedingungen fuer Fehlerpfad Dfp_ADCMon" VALUE 0xCB1FD Kw_Wu8 255.0 OneToOne 0.00 255.0 FORMAT "%5.1" /end CHARACTERISTIC
/begin CHARACTERISTIC DSM_FMKDfp_AFSCDIdlAdjVal_C "Ausblendbedingungen fuer Fehlerpfad Dfp_AFSCDIdlAdjVal" VALUE 0xCB1FE Kw_Wu8 255.0 OneToOne 0.00 255.0 FORMAT "%5.1" /end CHARACTERISTIC
/begin CHARACTERISTIC DSM_FMKDfp_AFSCDLdAdjVal_C "Ausblendbedingungen fuer Fehlerpfad Dfp_AFSCDLdAdjVal" VALUE 0xCB1FF Kw_Wu8 255.0 OneToOne 0.00 255.0 FORMAT "%5.1" /end CHARACTERISTIC
/begin CHARACTERISTIC DSM_FMKDfp_AFSCDPlAirPerCylDif_C "Ausblendbedingungen fuer Fehlerpfad Dfp_AFSCDPlAirPerCylDif" VALUE 0xCB200 Kw_Wu8 255.0 OneToOne 0.00 255.0 FORMAT "%5.1" /end CHARACTERISTIC
/begin CHARACTERISTIC DSM_FMKDfp_AFSCD_AirTempDcyc_C "Ausblendbedingungen fuer Fehlerpfad Dfp_AFSCD_AirTempDcyc" VALUE 0xCB201 Kw_Wu8 255.0 OneToOne 0.00 255.0 FORMAT "%5.1" /end CHARACTERISTIC
/begin CHARACTERISTIC DSM_FMKDfp_AFSCD_AirTempDcyc2_C "Ausblendbedingungen fuer Fehlerpfad Dfp_AFSCD_AirTempDcyc2" VALUE 0xCB202 Kw_Wu8 255.0 OneToOne 0.00 255.0 FORMAT "%5.1" /end CHARACTERISTIC
/begin CHARACTERISTIC DSM_FMKDfp_AFSCD_PlOffsDrft_C "Ausblendbedingungen fuer Fehlerpfad Dfp_AFSCD_PlOffsDrft" VALUE 0xCB203 Kw_Wu8 255.0 OneToOne 0.00 255.0 FORMAT "%5.1" /end CHARACTERISTIC
/begin CHARACTERISTIC DSM_FMKDfp_AFSCD_PlOffsDrft2_C "Ausblendbedingungen fuer Fehlerpfad Dfp_AFSCD_PlOffsDrft2" VALUE 0xCB204 Kw_Wu8 255.0 OneToOne 0.00 255.0 FORMAT "%5.1" /end CHARACTERISTIC
/begin CHARACTERISTIC DSM_FMKDfp_AFSCD_PlSetyDrft_C "Ausblendbedingungen fuer Fehlerpfad Dfp_AFSCD_PlSetyDrft" VALUE 0xCB205 Kw_Wu8 255.0 OneToOne 0.00 255.0 FORMAT "%5.1" /end CHARACTERISTIC
/begin CHARACTERISTIC DSM_FMKDfp_AFSCD_SRCAirTemp_C "Ausblendbedingungen fuer Fehlerpfad Dfp_AFSCD_SRCAirTemp" VALUE 0xCB206 Kw_Wu8 255.0 OneToOne 0.00 255.0 FORMAT "%5.1" /end CHARACTERISTIC
/begin CHARACTERISTIC DSM_FMKDfp_AFSCD_SRCAirTemp2_C "Ausblendbedingungen fuer Fehlerpfad Dfp_AFSCD_SRCAirTemp2" VALUE 0xCB207 Kw_Wu8 255.0 OneToOne 0.00 255.0 FORMAT "%5.1" /end CHARACTERISTIC
/begin CHARACTERISTIC DSM_FMKDfp_AFSCD_SRCBatt_C "Ausblendbedingungen fuer Fehlerpfad Dfp_AFSCD_SRCBatt" VALUE 0xCB208 Kw_Wu8 255.0 OneToOne 0.00 255.0 FORMAT "%5.1" /end CHARACTERISTIC
/begin CHARACTERISTIC DSM_FMKDfp_AFSCD_SRCBatt2_C "Ausblendbedingungen fuer Fehlerpfad Dfp_AFSCD_SRCBatt2" VALUE 0xCB209 Kw_Wu8 255.0 OneToOne 0.00 255.0 FORMAT "%5.1" /end CHARACTERISTIC
/begin CHARACTERISTIC DSM_FMKDfp_AFSCD_SRCCorrAirm_C "Ausblendbedingungen fuer Fehlerpfad Dfp_AFSCD_SRCCorrAirm" VALUE 0xCB20A Kw_Wu8 255.0 OneToOne 0.00 255.0 FORMAT "%5.1" /end CHARACTERISTIC
/begin CHARACTERISTIC DSM_FMKDfp_Layer_TUMG_C "Ausblendbedingungen fuer Fehlerpfad Dfp_Layer_TUMG" VALUE 0xCB20B Kw_Wu8 255.0 OneToOne 0.00 255.0 FORMAT "%5.1" /end CHARACTERISTIC
/begin CHARACTERISTIC DSM_FMKDfp_AFSCD_SRCCorrAirm2_C "Ausblendbedingungen fuer Fehlerpfad Dfp_AFSCD_SRCCorrAirm2" VALUE 0xCB20C Kw_Wu8 255.0 OneToOne 0.00 255.0 FORMAT "%5.1" /end CHARACTERISTIC
/begin CHARACTERISTIC DSM_FMKDfp_AFSCD_SRCRawAirm_C "Ausblendbedingungen fuer Fehlerpfad Dfp_AFSCD_SRCRawAirm" VALUE 0xCB20D Kw_Wu8 255.0 OneToOne 0.00 255.0 FORMAT "%5.1" /end CHARACTERISTIC
/begin CHARACTERISTIC DSM_FMKDfp_Layer_GEN_C "Ausblendbedingungen fuer Fehlerpfad Dfp_Layer_GEN" VALUE 0xCB20E Kw_Wu8 255.0 OneToOne 0.00 255.0 FORMAT "%5.1" /end CHARACTERISTIC
/begin CHARACTERISTIC DSM_FMKDfp_Layer_BSD_C "Ausblendbedingungen fuer Fehlerpfad Dfp_Layer_BSD" VALUE 0xCB20F Kw_Wu8 255.0 OneToOne 0.00 255.0 FORMAT "%5.1" /end CHARACTERISTIC
/begin CHARACTERISTIC DSM_FMKDfp_AFSCD_SRCRawAirm2_C "Ausblendbedingungen fuer Fehlerpfad Dfp_AFSCD_SRCRawAirm2" VALUE 0xCB210 Kw_Wu8 255.0 OneToOne 0.00 255.0 FORMAT "%5.1" /end CHARACTERISTIC
/begin CHARACTERISTIC DSM_FMKDfp_AFSCD_SRCRefSigPer_C "Ausblendbedingungen fuer Fehlerpfad Dfp_AFSCD_SRCRefSigPer" VALUE 0xCB211 Kw_Wu8 255.0 OneToOne 0.00 255.0 FORMAT "%5.1" /end CHARACTERISTIC
/begin CHARACTERISTIC DSM_FMKDfp_AFSCD_SRCRefSigPer2_C "Ausblendbedingungen fuer Fehlerpfad Dfp_AFSCD_SRCRefSigPer2" VALUE 0xCB212 Kw_Wu8 255.0 OneToOne 0.00 255.0 FORMAT "%5.1" /end CHARACTERISTIC
/begin CHARACTERISTIC DSM_FMKDfp_AOHtCD_C "Ausblendbedingungen fuer Fehlerpfad Dfp_AOHtCD" VALUE 0xCB213 Kw_Wu8 255.0 OneToOne 0.00 255.0 FORMAT "%5.1" /end CHARACTERISTIC
/begin CHARACTERISTIC DSM_FMKDfp_AOHtCD_AOHtDia1_C "Ausblendbedingungen fuer Fehlerpfad Dfp_AOHtCD_AOHtDia1" VALUE 0xCB214 Kw_Wu8 255.0 OneToOne 0.00 255.0 FORMAT "%5.1" /end CHARACTERISTIC
/begin CHARACTERISTIC DSM_FMKDfp_AOHtCD_AOHtDia2_C "Ausblendbedingungen fuer Fehlerpfad Dfp_AOHtCD_AOHtDia2" VALUE 0xCB215 Kw_Wu8 255.0 OneToOne 0.00 255.0 FORMAT "%5.1" /end CHARACTERISTIC
/begin CHARACTERISTIC DSM_FMKDfp_AOHtCD_AOHtDia3_C "Ausblendbedingungen fuer Fehlerpfad Dfp_AOHtCD_AOHtDia3" VALUE 0xCB216 Kw_Wu8 255.0 OneToOne 0.00 255.0 FORMAT "%5.1" /end CHARACTERISTIC
/begin CHARACTERISTIC DSM_FMKDfp_APP1_C "Ausblendbedingungen fuer Fehlerpfad Dfp_APP1" VALUE 0xCB217 Kw_Wu8 255.0 OneToOne 0.00 255.0 FORMAT "%5.1" /end CHARACTERISTIC
/begin CHARACTERISTIC DSM_FMKDfp_APP2_C "Ausblendbedingungen fuer Fehlerpfad Dfp_APP2" VALUE 0xCB218 Kw_Wu8 255.0 OneToOne 0.00 255.0 FORMAT "%5.1" /end CHARACTERISTIC
/begin CHARACTERISTIC DSM_FMKDfp_APPCDCmpd_C "Ausblendbedingungen fuer Fehlerpfad Dfp_APPCDCmpd" VALUE 0xCB219 Kw_Wu8 255.0 OneToOne 0.00 255.0 FORMAT "%5.1" /end CHARACTERISTIC
/begin CHARACTERISTIC DSM_FMKDfp_Layer_QLT_C "Ausblendbedingungen fuer Fehlerpfad Dfp_Layer_QLT" VALUE 0xCB21A Kw_Wu8 255.0 OneToOne 0.00 255.0 FORMAT "%5.1" /end CHARACTERISTIC
/begin CHARACTERISTIC DSM_FMKDfp_APPSync_C "Ausblendbedingungen fuer Fehlerpfad Dfp_APPSync" VALUE 0xCB21B Kw_Wu8 255.0 OneToOne 0.00 255.0 FORMAT "%5.1" /end CHARACTERISTIC
/begin CHARACTERISTIC DSM_FMKDfp_Layer_IBS1_C "Ausblendbedingungen fuer Fehlerpfad Dfp_Layer_IBS1" VALUE 0xCB21C Kw_Wu8 255.0 OneToOne 0.00 255.0 FORMAT "%5.1" /end CHARACTERISTIC
/begin CHARACTERISTIC DSM_FMKDfp_Layer_IBS2_C "Ausblendbedingungen fuer Fehlerpfad Dfp_Layer_IBS2" VALUE 0xCB21D Kw_Wu8 255.0 OneToOne 0.00 255.0 FORMAT "%5.1" /end CHARACTERISTIC
/begin CHARACTERISTIC DSM_FMKDfp_Layer_IBS3_C "Ausblendbedingungen fuer Fehlerpfad Dfp_Layer_IBS3" VALUE 0xCB21E Kw_Wu8 255.0 OneToOne 0.00 255.0 FORMAT "%5.1" /end CHARACTERISTIC
/begin CHARACTERISTIC DSM_FMKDfp_Layer_PMBN_C "Ausblendbedingungen fuer Fehlerpfad Dfp_Layer_PMBN" VALUE 0xCB21F Kw_Wu8 255.0 OneToOne 0.00 255.0 FORMAT "%5.1" /end CHARACTERISTIC
/begin CHARACTERISTIC DSM_FMKDfp_Layer_PMBATT_C "Ausblendbedingungen fuer Fehlerpfad Dfp_Layer_PMBATT" VALUE 0xCB220 Kw_Wu8 255.0 OneToOne 0.00 255.0 FORMAT "%5.1" /end CHARACTERISTIC
/begin CHARACTERISTIC DSM_FMKDfp_APSCD_C "Ausblendbedingungen fuer Fehlerpfad Dfp_APSCD" VALUE 0xCB221 Kw_Wu8 255.0 OneToOne 0.00 255.0 FORMAT "%5.1" /end CHARACTERISTIC
/begin CHARACTERISTIC DSM_FMKDfp_ARS_C "Ausblendbedingungen fuer Fehlerpfad Dfp_ARS" VALUE 0xCB222 Kw_Wu8 255.0 OneToOne 0.00 255.0 FORMAT "%5.1" /end CHARACTERISTIC
/begin CHARACTERISTIC DSM_FMKDfp_AccPedPlausBrk_C "Ausblendbedingungen fuer Fehlerpfad Dfp_AccPedPlausBrk" VALUE 0xCB223 Kw_Wu8 255.0 OneToOne 0.00 255.0 FORMAT "%5.1" /end CHARACTERISTIC
/begin CHARACTERISTIC DSM_FMKDfp_AddPCDTnkLvl_C "Ausblendbedingungen fuer Fehlerpfad Dfp_AddPCDTnkLvl" VALUE 0xCB224 Kw_Wu8 255.0 OneToOne 0.00 255.0 FORMAT "%5.1" /end CHARACTERISTIC
/begin CHARACTERISTIC DSM_FMKDfp_AirCtlGvnrDvtRgnMax_C "Ausblendbedingungen fuer Fehlerpfad Dfp_AirCtlGvnrDvtRgnMax" VALUE 0xCB225 Kw_Wu8 255.0 OneToOne 0.00 255.0 FORMAT "%5.1" /end CHARACTERISTIC
/begin CHARACTERISTIC DSM_FMKDfp_AirCtlGvnrDvtRgnMin_C "Ausblendbedingungen fuer Fehlerpfad Dfp_AirCtlGvnrDvtRgnMin" VALUE 0xCB226 Kw_Wu8 255.0 OneToOne 0.00 255.0 FORMAT "%5.1" /end CHARACTERISTIC
/begin CHARACTERISTIC DSM_FMKDfp_AirCtlGvnrDvtRgnMn2_C "Ausblendbedingungen fuer Fehlerpfad Dfp_AirCtlGvnrDvtRgnMn2" VALUE 0xCB227 Kw_Wu8 255.0 OneToOne 0.00 255.0 FORMAT "%5.1" /end CHARACTERISTIC
/begin CHARACTERISTIC DSM_FMKDfp_AirCtlGvnrDvtRgnMx2_C "Ausblendbedingungen fuer Fehlerpfad Dfp_AirCtlGvnrDvtRgnMx2" VALUE 0xCB228 Kw_Wu8 255.0 OneToOne 0.00 255.0 FORMAT "%5.1" /end CHARACTERISTIC
/begin CHARACTERISTIC DSM_FMKDfp_AirCtlPlateBreak_C "DSM variable for Dfp_AirCtlPlateBreak_mp" VALUE 0xCB229 Kw_Wu8 255.0 OneToOne 0.00 255.0 FORMAT "%5.1" /end CHARACTERISTIC
/begin CHARACTERISTIC DSM_FMKDfp_AirCtlRmpTO_C "Ausblendbedingungen fuer Fehlerpfad Dfp_AirCtlRmpTO" VALUE 0xCB22A Kw_Wu8 255.0 OneToOne 0.00 255.0 FORMAT "%5.1" /end CHARACTERISTIC
/begin CHARACTERISTIC DSM_FMKDfp_AirCtl_GovNegDev_C "Ausblendbedingungen fuer Fehlerpfad Dfp_AirCtl_GovNegDev" VALUE 0xCB22B Kw_Wu8 255.0 OneToOne 0.00 255.0 FORMAT "%5.1" /end CHARACTERISTIC
/begin CHARACTERISTIC DSM_FMKDfp_AirCtl_GovNegDev2_C "Ausblendbedingungen fuer Fehlerpfad Dfp_AirCtl_GovNegDev2" VALUE 0xCB22C Kw_Wu8 255.0 OneToOne 0.00 255.0 FORMAT "%5.1" /end CHARACTERISTIC
/begin CHARACTERISTIC DSM_FMKDfp_AirCtl_GovPosDev_C "Ausblendbedingungen fuer Fehlerpfad Dfp_AirCtl_GovPosDev" VALUE 0xCB22D Kw_Wu8 255.0 OneToOne 0.00 255.0 FORMAT "%5.1" /end CHARACTERISTIC
/begin CHARACTERISTIC DSM_FMKDfp_AirCtl_GovPosDev2_C "Ausblendbedingungen fuer Fehlerpfad Dfp_AirCtl_GovPosDev2" VALUE 0xCB22E Kw_Wu8 255.0 OneToOne 0.00 255.0 FORMAT "%5.1" /end CHARACTERISTIC
/begin CHARACTERISTIC DSM_FMKDfp_AltCD_C "Ausblendbedingungen fuer Fehlerpfad Dfp_AltCD" VALUE 0xCB22F Kw_Wu8 255.0 OneToOne 0.00 255.0 FORMAT "%5.1" /end CHARACTERISTIC
/begin CHARACTERISTIC DSM_FMKDfp_BPACD_BPADia1_C "Ausblendbedingungen fuer Fehlerpfad Dfp_BPACD_BPADia1" VALUE 0xCB230 Kw_Wu8 255.0 OneToOne 0.00 255.0 FORMAT "%5.1" /end CHARACTERISTIC
/begin CHARACTERISTIC DSM_FMKDfp_BPACD_BPADia1v2_C "Ausblendbedingungen fuer Fehlerpfad Dfp_BPACD_BPADia1v2" VALUE 0xCB231 Kw_Wu8 255.0 OneToOne 0.00 255.0 FORMAT "%5.1" /end CHARACTERISTIC
/begin CHARACTERISTIC DSM_FMKDfp_BPACD_BPADia2_C "Ausblendbedingungen fuer Fehlerpfad Dfp_BPACD_BPADia2" VALUE 0xCB232 Kw_Wu8 255.0 OneToOne 0.00 255.0 FORMAT "%5.1" /end CHARACTERISTIC
/begin CHARACTERISTIC DSM_FMKDfp_BPACD_BPADia2v2_C "Ausblendbedingungen fuer Fehlerpfad Dfp_BPACD_BPADia2v2" VALUE 0xCB233 Kw_Wu8 255.0 OneToOne 0.00 255.0 FORMAT "%5.1" /end CHARACTERISTIC
/begin CHARACTERISTIC DSM_FMKDfp_BPACD_BPADia3_C "Ausblendbedingungen fuer Fehlerpfad Dfp_BPACD_BPADia3" VALUE 0xCB234 Kw_Wu8 255.0 OneToOne 0.00 255.0 FORMAT "%5.1" /end CHARACTERISTIC
/begin CHARACTERISTIC DSM_FMKDfp_BPACD_BPADia3v2_C "Ausblendbedingungen fuer Fehlerpfad Dfp_BPACD_BPADia3v2" VALUE 0xCB235 Kw_Wu8 255.0 OneToOne 0.00 255.0 FORMAT "%5.1" /end CHARACTERISTIC
/begin CHARACTERISTIC DSM_FMKDfp_BPACD_BPADia4_C "Ausblendbedingungen fuer Fehlerpfad Dfp_BPACD_BPADia4" VALUE 0xCB236 Kw_Wu8 255.0 OneToOne 0.00 255.0 FORMAT "%5.1" /end CHARACTERISTIC
/begin CHARACTERISTIC DSM_FMKDfp_BPACD_BPADia4v2_C "Ausblendbedingungen fuer Fehlerpfad Dfp_BPACD_BPADia4v2" VALUE 0xCB237 Kw_Wu8 255.0 OneToOne 0.00 255.0 FORMAT "%5.1" /end CHARACTERISTIC
/begin CHARACTERISTIC DSM_FMKDfp_BPACD_Max_C "Ausblendbedingungen fuer Fehlerpfad Dfp_BPACD_Max" VALUE 0xCB238 Kw_Wu8 255.0 OneToOne 0.00 255.0 FORMAT "%5.1" /end CHARACTERISTIC
/begin CHARACTERISTIC DSM_FMKDfp_BPACD_Max2_C "Ausblendbedingungen fuer Fehlerpfad Dfp_BPACD_Max2" VALUE 0xCB239 Kw_Wu8 255.0 OneToOne 0.00 255.0 FORMAT "%5.1" /end CHARACTERISTIC
/begin CHARACTERISTIC DSM_FMKDfp_BPACD_Min_C "Ausblendbedingungen fuer Fehlerpfad Dfp_BPACD_Min" VALUE 0xCB23A Kw_Wu8 255.0 OneToOne 0.00 255.0 FORMAT "%5.1" /end CHARACTERISTIC
/begin CHARACTERISTIC DSM_FMKDfp_BPACD_Min2_C "Ausblendbedingungen fuer Fehlerpfad Dfp_BPACD_Min2" VALUE 0xCB23B Kw_Wu8 255.0 OneToOne 0.00 255.0 FORMAT "%5.1" /end CHARACTERISTIC
/begin CHARACTERISTIC DSM_FMKDfp_BPACD_SigNpl_C "Ausblendbedingungen fuer Fehlerpfad Dfp_BPACD_SigNpl" VALUE 0xCB23C Kw_Wu8 255.0 OneToOne 0.00 255.0 FORMAT "%5.1" /end CHARACTERISTIC
/begin CHARACTERISTIC DSM_FMKDfp_BPACD_SigNpl2_C "Ausblendbedingungen fuer Fehlerpfad Dfp_BPACD_SigNpl2" VALUE 0xCB23D Kw_Wu8 255.0 OneToOne 0.00 255.0 FORMAT "%5.1" /end CHARACTERISTIC
/begin CHARACTERISTIC DSM_FMKDfp_BPSCD_C "Ausblendbedingungen fuer Fehlerpfad Dfp_BPSCD" VALUE 0xCB23E Kw_Wu8 255.0 OneToOne 0.00 255.0 FORMAT "%5.1" /end CHARACTERISTIC
/begin CHARACTERISTIC DSM_FMKDfp_BattCD_C "Ausblendbedingungen fuer Fehlerpfad Dfp_BattCD" VALUE 0xCB23F Kw_Wu8 255.0 OneToOne 0.00 255.0 FORMAT "%5.1" /end CHARACTERISTIC
/begin CHARACTERISTIC DSM_FMKDfp_BrkCD_C "Ausblendbedingungen fuer Fehlerpfad Dfp_BrkCD" VALUE 0xCB240 Kw_Wu8 255.0 OneToOne 0.00 255.0 FORMAT "%5.1" /end CHARACTERISTIC
/begin CHARACTERISTIC DSM_FMKDfp_Layer_PMRUHVERL_C "Ausblendbedingungen fuer Fehlerpfad Dfp_Layer_PMRUHVERL" VALUE 0xCB241 Kw_Wu8 255.0 OneToOne 0.00 255.0 FORMAT "%5.1" /end CHARACTERISTIC
/begin CHARACTERISTIC DSM_FMKDfp_Bss_C "Ausblendbedingungen fuer Fehlerpfad Dfp_Bss" VALUE 0xCB242 Kw_Wu8 255.0 OneToOne 0.00 255.0 FORMAT "%5.1" /end CHARACTERISTIC
/begin CHARACTERISTIC DSM_FMKDfp_CBACD_C "Ausblendbedingungen fuer Fehlerpfad Dfp_CBACD" VALUE 0xCB243 Kw_Wu8 255.0 OneToOne 0.00 255.0 FORMAT "%5.1" /end CHARACTERISTIC
/begin CHARACTERISTIC DSM_FMKDfp_CTSCD_C "Ausblendbedingungen fuer Fehlerpfad Dfp_CTSCD" VALUE 0xCB244 Kw_Wu8 255.0 OneToOne 0.00 255.0 FORMAT "%5.1" /end CHARACTERISTIC
/begin CHARACTERISTIC DSM_FMKDfp_Clg_DynTst_C "Ausblendbedingungen fuer Fehlerpfad Dfp_Clg_DynTst" VALUE 0xCB245 Kw_Wu8 255.0 OneToOne 0.00 255.0 FORMAT "%5.1" /end CHARACTERISTIC
/begin CHARACTERISTIC DSM_FMKDfp_Layer_TOENS_C "Ausblendbedingungen fuer Fehlerpfad Dfp_Layer_TOENS" VALUE 0xCB246 Kw_Wu8 255.0 OneToOne 0.00 255.0 FORMAT "%5.1" /end CHARACTERISTIC
/begin CHARACTERISTIC DSM_FMKDfp_Layer_MANHYDR_C "Ausblendbedingungen fuer Fehlerpfad Dfp_Layer_MANHYDR" VALUE 0xCB247 Kw_Wu8 255.0 OneToOne 0.00 255.0 FORMAT "%5.1" /end CHARACTERISTIC
/begin CHARACTERISTIC DSM_FMKDfp_Layer_MANLUFT_C "Ausblendbedingungen fuer Fehlerpfad Dfp_Layer_MANLUFT" VALUE 0xCB248 Kw_Wu8 255.0 OneToOne 0.00 255.0 FORMAT "%5.1" /end CHARACTERISTIC
/begin CHARACTERISTIC DSM_FMKDfp_CmbChbMisfire1_C "Ausblendbedingungen fuer Fehlerpfad Dfp_CmbChbMisfire1" VALUE 0xCB249 Kw_Wu8 255.0 OneToOne 0.00 255.0 FORMAT "%5.1" /end CHARACTERISTIC
/begin CHARACTERISTIC DSM_FMKDfp_CmbChbMisfire2_C "Ausblendbedingungen fuer Fehlerpfad Dfp_CmbChbMisfire2" VALUE 0xCB24A Kw_Wu8 255.0 OneToOne 0.00 255.0 FORMAT "%5.1" /end CHARACTERISTIC
/begin CHARACTERISTIC DSM_FMKDfp_CmbChbMisfire3_C "Ausblendbedingungen fuer Fehlerpfad Dfp_CmbChbMisfire3" VALUE 0xCB24B Kw_Wu8 255.0 OneToOne 0.00 255.0 FORMAT "%5.1" /end CHARACTERISTIC
/begin CHARACTERISTIC DSM_FMKDfp_CmbChbMisfire4_C "Ausblendbedingungen fuer Fehlerpfad Dfp_CmbChbMisfire4" VALUE 0xCB24C Kw_Wu8 255.0 OneToOne 0.00 255.0 FORMAT "%5.1" /end CHARACTERISTIC
/begin CHARACTERISTIC DSM_FMKDfp_CmbChbMisfire5_C "Ausblendbedingungen fuer Fehlerpfad Dfp_CmbChbMisfire5" VALUE 0xCB24D Kw_Wu8 255.0 OneToOne 0.00 255.0 FORMAT "%5.1" /end CHARACTERISTIC
/begin CHARACTERISTIC DSM_FMKDfp_CmbChbMisfire6_C "Ausblendbedingungen fuer Fehlerpfad Dfp_CmbChbMisfire6" VALUE 0xCB24E Kw_Wu8 255.0 OneToOne 0.00 255.0 FORMAT "%5.1" /end CHARACTERISTIC
/begin CHARACTERISTIC DSM_FMKDfp_CmbChbMisfire7_C "Ausblendbedingungen fuer Fehlerpfad Dfp_CmbChbMisfire7" VALUE 0xCB24F Kw_Wu8 255.0 OneToOne 0.00 255.0 FORMAT "%5.1" /end CHARACTERISTIC
/begin CHARACTERISTIC DSM_FMKDfp_CmbChbMisfire8_C "Ausblendbedingungen fuer Fehlerpfad Dfp_CmbChbMisfire8" VALUE 0xCB250 Kw_Wu8 255.0 OneToOne 0.00 255.0 FORMAT "%5.1" /end CHARACTERISTIC
/begin CHARACTERISTIC DSM_FMKDfp_CmbChbMisfireMul_C "Ausblendbedingungen fuer Fehlerpfad Dfp_CmbChbMisfireMul" VALUE 0xCB251 Kw_Wu8 255.0 OneToOne 0.00 255.0 FORMAT "%5.1" /end CHARACTERISTIC
/begin CHARACTERISTIC DSM_FMKDfp_CoDT_TRQ_Des_C "Ausblendbedingungen fuer Fehlerpfad Dfp_CoDT_TRQ_Des" VALUE 0xCB252 Kw_Wu8 255.0 OneToOne 0.00 255.0 FORMAT "%5.1" /end CHARACTERISTIC
/begin CHARACTERISTIC DSM_FMKDfp_CoDT_TRQ_Lead_C "Ausblendbedingungen fuer Fehlerpfad Dfp_CoDT_TRQ_Lead" VALUE 0xCB253 Kw_Wu8 255.0 OneToOne 0.00 255.0 FORMAT "%5.1" /end CHARACTERISTIC
/begin CHARACTERISTIC DSM_FMKDfp_CoEng_GbxRpmRduc_C "Ausblendbedingungen fuer Fehlerpfad Dfp_CoEng_GbxRpmRduc" VALUE 0xCB254 Kw_Wu8 255.0 OneToOne 0.00 255.0 FORMAT "%5.1" /end CHARACTERISTIC
/begin CHARACTERISTIC DSM_FMKDfp_CoVMDCSh_C "Ausblendbedingungen fuer Fehlerpfad Dfp_CoVMDCSh" VALUE 0xCB255 Kw_Wu8 255.0 OneToOne 0.00 255.0 FORMAT "%5.1" /end CHARACTERISTIC
/begin CHARACTERISTIC DSM_FMKDfp_ConvCD_C "Ausblendbedingungen fuer Fehlerpfad Dfp_ConvCD" VALUE 0xCB256 Kw_Wu8 255.0 OneToOne 0.00 255.0 FORMAT "%5.1" /end CHARACTERISTIC
/begin CHARACTERISTIC DSM_FMKDfp_CrCCDMFL_C "Ausblendbedingungen fuer Fehlerpfad Dfp_CrCCDMFL" VALUE 0xCB257 Kw_Wu8 255.0 OneToOne 0.00 255.0 FORMAT "%5.1" /end CHARACTERISTIC
/begin CHARACTERISTIC DSM_FMKDfp_CrCtl_vCrCtl_C "Ausblendbedingungen fuer Fehlerpfad Dfp_CrCtl_vCrCtl" VALUE 0xCB258 Kw_Wu8 255.0 OneToOne 0.00 255.0 FORMAT "%5.1" /end CHARACTERISTIC
/begin CHARACTERISTIC DSM_FMKDfp_EATSCD_C "Ausblendbedingungen fuer Fehlerpfad Dfp_EATSCD" VALUE 0xCB259 Kw_Wu8 255.0 OneToOne 0.00 255.0 FORMAT "%5.1" /end CHARACTERISTIC
/begin CHARACTERISTIC DSM_FMKDfp_EBAFCD_C "Ausblendbedingungen fuer Fehlerpfad Dfp_EBAFCD" VALUE 0xCB25A Kw_Wu8 255.0 OneToOne 0.00 255.0 FORMAT "%5.1" /end CHARACTERISTIC
/begin CHARACTERISTIC DSM_FMKDfp_EBFCD_C "Ausblendbedingungen fuer Fehlerpfad Dfp_EBFCD" VALUE 0xCB25B Kw_Wu8 255.0 OneToOne 0.00 255.0 FORMAT "%5.1" /end CHARACTERISTIC
/begin CHARACTERISTIC DSM_FMKDfp_EBTSCD_C "Ausblendbedingungen fuer Fehlerpfad Dfp_EBTSCD" VALUE 0xCB25C Kw_Wu8 255.0 OneToOne 0.00 255.0 FORMAT "%5.1" /end CHARACTERISTIC
/begin CHARACTERISTIC DSM_FMKDfp_EBTSCD_OvrTemp_C "Ausblendbedingungen fuer Fehlerpfad Dfp_EBTSCD_OvrTemp" VALUE 0xCB25D Kw_Wu8 255.0 OneToOne 0.00 255.0 FORMAT "%5.1" /end CHARACTERISTIC
/begin CHARACTERISTIC DSM_FMKDfp_EEPCDVarMng_C "Ausblendbedingungen fuer Fehlerpfad Dfp_EEPCDVarMng" VALUE 0xCB25E Kw_Wu8 255.0 OneToOne 0.00 255.0 FORMAT "%5.1" /end CHARACTERISTIC
/begin CHARACTERISTIC DSM_FMKDfp_EGPpCD_C "Ausblendbedingungen fuer Fehlerpfad Dfp_EGPpCD" VALUE 0xCB25F Kw_Wu8 255.0 OneToOne 0.00 255.0 FORMAT "%5.1" /end CHARACTERISTIC
/begin CHARACTERISTIC DSM_FMKDfp_EGRCD_Max_C "Ausblendbedingungen fuer Fehlerpfad Dfp_EGRCD_Max" VALUE 0xCB260 Kw_Wu8 255.0 OneToOne 0.00 255.0 FORMAT "%5.1" /end CHARACTERISTIC
/begin CHARACTERISTIC DSM_FMKDfp_EGRCD_Max2_C "Ausblendbedingungen fuer Fehlerpfad Dfp_EGRCD_Max2" VALUE 0xCB261 Kw_Wu8 255.0 OneToOne 0.00 255.0 FORMAT "%5.1" /end CHARACTERISTIC
/begin CHARACTERISTIC DSM_FMKDfp_EGRCD_Min_C "Ausblendbedingungen fuer Fehlerpfad Dfp_EGRCD_Min" VALUE 0xCB262 Kw_Wu8 255.0 OneToOne 0.00 255.0 FORMAT "%5.1" /end CHARACTERISTIC
/begin CHARACTERISTIC DSM_FMKDfp_EGRCD_Min2_C "Ausblendbedingungen fuer Fehlerpfad Dfp_EGRCD_Min2" VALUE 0xCB263 Kw_Wu8 255.0 OneToOne 0.00 255.0 FORMAT "%5.1" /end CHARACTERISTIC
/begin CHARACTERISTIC DSM_FMKDfp_EGRCD_PWMInDia1_C "Ausblendbedingungen fuer Fehlerpfad Dfp_EGRCD_PWMInDia1" VALUE 0xCB264 Kw_Wu8 255.0 OneToOne 0.00 255.0 FORMAT "%5.1" /end CHARACTERISTIC
/begin CHARACTERISTIC DSM_FMKDfp_EGRCD_PWMInDia2_C "Ausblendbedingungen fuer Fehlerpfad Dfp_EGRCD_PWMInDia2" VALUE 0xCB265 Kw_Wu8 255.0 OneToOne 0.00 255.0 FORMAT "%5.1" /end CHARACTERISTIC
/begin CHARACTERISTIC DSM_FMKDfp_EGRCD_PWMInDia21_C "Ausblendbedingungen fuer Fehlerpfad Dfp_EGRCD_PWMInDia21" VALUE 0xCB266 Kw_Wu8 255.0 OneToOne 0.00 255.0 FORMAT "%5.1" /end CHARACTERISTIC
/begin CHARACTERISTIC DSM_FMKDfp_EGRCD_PWMInDia22_C "Ausblendbedingungen fuer Fehlerpfad Dfp_EGRCD_PWMInDia22" VALUE 0xCB267 Kw_Wu8 255.0 OneToOne 0.00 255.0 FORMAT "%5.1" /end CHARACTERISTIC
/begin CHARACTERISTIC DSM_FMKDfp_EGRCD_PWMInDia23_C "Ausblendbedingungen fuer Fehlerpfad Dfp_EGRCD_PWMInDia23" VALUE 0xCB268 Kw_Wu8 255.0 OneToOne 0.00 255.0 FORMAT "%5.1" /end CHARACTERISTIC
/begin CHARACTERISTIC DSM_FMKDfp_EGRCD_PWMInDia24_C "Ausblendbedingungen fuer Fehlerpfad Dfp_EGRCD_PWMInDia24" VALUE 0xCB269 Kw_Wu8 255.0 OneToOne 0.00 255.0 FORMAT "%5.1" /end CHARACTERISTIC
/begin CHARACTERISTIC DSM_FMKDfp_EGRCD_PWMInDia3_C "Ausblendbedingungen fuer Fehlerpfad Dfp_EGRCD_PWMInDia3" VALUE 0xCB26A Kw_Wu8 255.0 OneToOne 0.00 255.0 FORMAT "%5.1" /end CHARACTERISTIC
/begin CHARACTERISTIC DSM_FMKDfp_EGRCD_PWMInDia4_C "Ausblendbedingungen fuer Fehlerpfad Dfp_EGRCD_PWMInDia4" VALUE 0xCB26B Kw_Wu8 255.0 OneToOne 0.00 255.0 FORMAT "%5.1" /end CHARACTERISTIC
/begin CHARACTERISTIC DSM_FMKDfp_EGRCD_SigDia_C "Ausblendbedingungen fuer Fehlerpfad Dfp_EGRCD_SigDia" VALUE 0xCB26C Kw_Wu8 255.0 OneToOne 0.00 255.0 FORMAT "%5.1" /end CHARACTERISTIC
/begin CHARACTERISTIC DSM_FMKDfp_EGRCD_SigDia2_C "Ausblendbedingungen fuer Fehlerpfad Dfp_EGRCD_SigDia2" VALUE 0xCB26D Kw_Wu8 255.0 OneToOne 0.00 255.0 FORMAT "%5.1" /end CHARACTERISTIC
/begin CHARACTERISTIC DSM_FMKDfp_EGRCD_SigNpl_C "Ausblendbedingungen fuer Fehlerpfad Dfp_EGRCD_SigNpl" VALUE 0xCB26E Kw_Wu8 255.0 OneToOne 0.00 255.0 FORMAT "%5.1" /end CHARACTERISTIC
/begin CHARACTERISTIC DSM_FMKDfp_EGRCD_SigNpl2_C "Ausblendbedingungen fuer Fehlerpfad Dfp_EGRCD_SigNpl2" VALUE 0xCB26F Kw_Wu8 255.0 OneToOne 0.00 255.0 FORMAT "%5.1" /end CHARACTERISTIC
/begin CHARACTERISTIC DSM_FMKDfp_EGTOilLvlCrit_C "Ausblendbedingungen fuer Fehlerpfad Dfp_EGTOilLvlCrit" VALUE 0xCB270 Kw_Wu8 255.0 OneToOne 0.00 255.0 FORMAT "%5.1" /end CHARACTERISTIC
/begin CHARACTERISTIC DSM_FMKDfp_EGTOilVscCrit_C "Ausblendbedingungen fuer Fehlerpfad Dfp_EGTOilVscCrit" VALUE 0xCB271 Kw_Wu8 255.0 OneToOne 0.00 255.0 FORMAT "%5.1" /end CHARACTERISTIC
/begin CHARACTERISTIC DSM_FMKDfp_EGTRgnOilDil_C "Ausblendbedingungen fuer Fehlerpfad Dfp_EGTRgnOilDil" VALUE 0xCB272 Kw_Wu8 255.0 OneToOne 0.00 255.0 FORMAT "%5.1" /end CHARACTERISTIC
/begin CHARACTERISTIC DSM_FMKDfp_EGTTempGvnrInrB1_C "Ausblendbedingungen fuer Fehlerpfad Dfp_EGTTempGvnrInrB1" VALUE 0xCB273 Kw_Wu8 255.0 OneToOne 0.00 255.0 FORMAT "%5.1" /end CHARACTERISTIC
/begin CHARACTERISTIC DSM_FMKDfp_EGTTempGvnrInrB2_C "Ausblendbedingungen fuer Fehlerpfad Dfp_EGTTempGvnrInrB2" VALUE 0xCB274 Kw_Wu8 255.0 OneToOne 0.00 255.0 FORMAT "%5.1" /end CHARACTERISTIC
/begin CHARACTERISTIC DSM_FMKDfp_EGTTempGvnrOutrB1_C "Ausblendbedingungen fuer Fehlerpfad Dfp_EGTTempGvnrOutrB1" VALUE 0xCB275 Kw_Wu8 255.0 OneToOne 0.00 255.0 FORMAT "%5.1" /end CHARACTERISTIC
/begin CHARACTERISTIC DSM_FMKDfp_EGTTempGvnrOutrB2_C "Ausblendbedingungen fuer Fehlerpfad Dfp_EGTTempGvnrOutrB2" VALUE 0xCB276 Kw_Wu8 255.0 OneToOne 0.00 255.0 FORMAT "%5.1" /end CHARACTERISTIC
/begin CHARACTERISTIC DSM_FMKDfp_ETClbETFltInj1_C "Ausblendbedingungen fuer Fehlerpfad Dfp_ETClbETFltInj1" VALUE 0xCB277 Kw_Wu8 255.0 OneToOne 0.00 255.0 FORMAT "%5.1" /end CHARACTERISTIC
/begin CHARACTERISTIC DSM_FMKDfp_ETClbETFltInj2_C "Ausblendbedingungen fuer Fehlerpfad Dfp_ETClbETFltInj2" VALUE 0xCB278 Kw_Wu8 255.0 OneToOne 0.00 255.0 FORMAT "%5.1" /end CHARACTERISTIC
/begin CHARACTERISTIC DSM_FMKDfp_ETClbETFltInj3_C "Ausblendbedingungen fuer Fehlerpfad Dfp_ETClbETFltInj3" VALUE 0xCB279 Kw_Wu8 255.0 OneToOne 0.00 255.0 FORMAT "%5.1" /end CHARACTERISTIC
/begin CHARACTERISTIC DSM_FMKDfp_ETClbETFltInj4_C "Ausblendbedingungen fuer Fehlerpfad Dfp_ETClbETFltInj4" VALUE 0xCB27A Kw_Wu8 255.0 OneToOne 0.00 255.0 FORMAT "%5.1" /end CHARACTERISTIC
/begin CHARACTERISTIC DSM_FMKDfp_ETClbETFltInj5_C "Ausblendbedingungen fuer Fehlerpfad Dfp_ETClbETFltInj5" VALUE 0xCB27B Kw_Wu8 255.0 OneToOne 0.00 255.0 FORMAT "%5.1" /end CHARACTERISTIC
/begin CHARACTERISTIC DSM_FMKDfp_ETClbETFltInj6_C "Ausblendbedingungen fuer Fehlerpfad Dfp_ETClbETFltInj6" VALUE 0xCB27C Kw_Wu8 255.0 OneToOne 0.00 255.0 FORMAT "%5.1" /end CHARACTERISTIC
/begin CHARACTERISTIC DSM_FMKDfp_ETClbETFltInj7_C "Ausblendbedingungen fuer Fehlerpfad Dfp_ETClbETFltInj7" VALUE 0xCB27D Kw_Wu8 255.0 OneToOne 0.00 255.0 FORMAT "%5.1" /end CHARACTERISTIC
/begin CHARACTERISTIC DSM_FMKDfp_ETClbETFltInj8_C "Ausblendbedingungen fuer Fehlerpfad Dfp_ETClbETFltInj8" VALUE 0xCB27E Kw_Wu8 255.0 OneToOne 0.00 255.0 FORMAT "%5.1" /end CHARACTERISTIC
/begin CHARACTERISTIC DSM_FMKDfp_ETClbInj1_C "Ausblendbedingungen fuer Fehlerpfad Dfp_ETClbInj1" VALUE 0xCB27F Kw_Wu8 255.0 OneToOne 0.00 255.0 FORMAT "%5.1" /end CHARACTERISTIC
/begin CHARACTERISTIC DSM_FMKDfp_ETClbInj2_C "Ausblendbedingungen fuer Fehlerpfad Dfp_ETClbInj2" VALUE 0xCB280 Kw_Wu8 255.0 OneToOne 0.00 255.0 FORMAT "%5.1" /end CHARACTERISTIC
/begin CHARACTERISTIC DSM_FMKDfp_ETClbInj3_C "Ausblendbedingungen fuer Fehlerpfad Dfp_ETClbInj3" VALUE 0xCB281 Kw_Wu8 255.0 OneToOne 0.00 255.0 FORMAT "%5.1" /end CHARACTERISTIC
/begin CHARACTERISTIC DSM_FMKDfp_ETClbInj4_C "Ausblendbedingungen fuer Fehlerpfad Dfp_ETClbInj4" VALUE 0xCB282 Kw_Wu8 255.0 OneToOne 0.00 255.0 FORMAT "%5.1" /end CHARACTERISTIC
/begin CHARACTERISTIC DSM_FMKDfp_ETClbInj5_C "Ausblendbedingungen fuer Fehlerpfad Dfp_ETClbInj5" VALUE 0xCB283 Kw_Wu8 255.0 OneToOne 0.00 255.0 FORMAT "%5.1" /end CHARACTERISTIC
/begin CHARACTERISTIC DSM_FMKDfp_ETClbInj6_C "Ausblendbedingungen fuer Fehlerpfad Dfp_ETClbInj6" VALUE 0xCB284 Kw_Wu8 255.0 OneToOne 0.00 255.0 FORMAT "%5.1" /end CHARACTERISTIC
/begin CHARACTERISTIC DSM_FMKDfp_ETClbInj7_C "Ausblendbedingungen fuer Fehlerpfad Dfp_ETClbInj7" VALUE 0xCB285 Kw_Wu8 255.0 OneToOne 0.00 255.0 FORMAT "%5.1" /end CHARACTERISTIC
/begin CHARACTERISTIC DSM_FMKDfp_ETClbInj8_C "Ausblendbedingungen fuer Fehlerpfad Dfp_ETClbInj8" VALUE 0xCB286 Kw_Wu8 255.0 OneToOne 0.00 255.0 FORMAT "%5.1" /end CHARACTERISTIC
/begin CHARACTERISTIC DSM_FMKDfp_EngMCaS1_C "Ausblendbedingungen fuer Fehlerpfad Dfp_EngMCaS1" VALUE 0xCB287 Kw_Wu8 255.0 OneToOne 0.00 255.0 FORMAT "%5.1" /end CHARACTERISTIC
/begin CHARACTERISTIC DSM_FMKDfp_EngMCrS1_C "Ausblendbedingungen fuer Fehlerpfad Dfp_EngMCrS1" VALUE 0xCB288 Kw_Wu8 255.0 OneToOne 0.00 255.0 FORMAT "%5.1" /end CHARACTERISTIC
/begin CHARACTERISTIC DSM_FMKDfp_EngMOfsCaSCrS_C "Ausblendbedingungen fuer Fehlerpfad Dfp_EngMOfsCaSCrS" VALUE 0xCB289 Kw_Wu8 255.0 OneToOne 0.00 255.0 FORMAT "%5.1" /end CHARACTERISTIC
/begin CHARACTERISTIC DSM_FMKDfp_EngMntCtlCD_C "Ausblendbedingungen fuer Fehlerpfad Dfp_EngMntCtlCD" VALUE 0xCB28A Kw_Wu8 255.0 OneToOne 0.00 255.0 FORMAT "%5.1" /end CHARACTERISTIC
/begin CHARACTERISTIC DSM_FMKDfp_FBCqDvt_C "Ausblendbedingungen fuer Fehlerpfad Dfp_FBCqDvt" VALUE 0xCB28B Kw_Wu8 255.0 OneToOne 0.00 255.0 FORMAT "%5.1" /end CHARACTERISTIC
/begin CHARACTERISTIC DSM_FMKDfp_FMAErrMod_C "Ausblendbedingungen fuer Fehlerpfad Dfp_FMAErrMod" VALUE 0xCB28C Kw_Wu8 255.0 OneToOne 0.00 255.0 FORMAT "%5.1" /end CHARACTERISTIC
/begin CHARACTERISTIC DSM_FMKDfp_FMTC_NonMonotonMap_C "Ausblendbedingungen fuer Fehlerpfad Dfp_FMTC_NonMonotonMap" VALUE 0xCB28D Kw_Wu8 255.0 OneToOne 0.00 255.0 FORMAT "%5.1" /end CHARACTERISTIC
/begin CHARACTERISTIC DSM_FMKDfp_FTSCD_C "Ausblendbedingungen fuer Fehlerpfad Dfp_FTSCD" VALUE 0xCB28E Kw_Wu8 255.0 OneToOne 0.00 255.0 FORMAT "%5.1" /end CHARACTERISTIC
/begin CHARACTERISTIC DSM_FMKDfp_FanCD_C "Ausblendbedingungen fuer Fehlerpfad Dfp_FanCD" VALUE 0xCB28F Kw_Wu8 255.0 OneToOne 0.00 255.0 FORMAT "%5.1" /end CHARACTERISTIC
/begin CHARACTERISTIC DSM_FMKDfp_FanCD_FanCtlr1_C "Ausblendbedingungen fuer Fehlerpfad Dfp_FanCD_FanCtlr1" VALUE 0xCB290 Kw_Wu8 255.0 OneToOne 0.00 255.0 FORMAT "%5.1" /end CHARACTERISTIC
/begin CHARACTERISTIC DSM_FMKDfp_FanCD_FanCtlr2_C "Ausblendbedingungen fuer Fehlerpfad Dfp_FanCD_FanCtlr2" VALUE 0xCB291 Kw_Wu8 255.0 OneToOne 0.00 255.0 FORMAT "%5.1" /end CHARACTERISTIC
/begin CHARACTERISTIC DSM_FMKDfp_FanCD_FanCtlr3_C "Ausblendbedingungen fuer Fehlerpfad Dfp_FanCD_FanCtlr3" VALUE 0xCB292 Kw_Wu8 255.0 OneToOne 0.00 255.0 FORMAT "%5.1" /end CHARACTERISTIC
/begin CHARACTERISTIC DSM_FMKDfp_FlFCD_C "Ausblendbedingungen fuer Fehlerpfad Dfp_FlFCD" VALUE 0xCB293 Kw_Wu8 255.0 OneToOne 0.00 255.0 FORMAT "%5.1" /end CHARACTERISTIC
/begin CHARACTERISTIC DSM_FMKDfp_FlMngSmkDefect_C "Ausblendbedingungen fuer Fehlerpfad Dfp_FlMngSmkDefect" VALUE 0xCB294 Kw_Wu8 255.0 OneToOne 0.00 255.0 FORMAT "%5.1" /end CHARACTERISTIC
/begin CHARACTERISTIC DSM_FMKDfp_FlSCDT1_C "Ausblendbedingungen fuer Fehlerpfad Dfp_FlSCDT1" VALUE 0xCB295 Kw_Wu8 255.0 OneToOne 0.00 255.0 FORMAT "%5.1" /end CHARACTERISTIC
/begin CHARACTERISTIC DSM_FMKDfp_FrmMngANFRADMOMPT_C "Ausblendbedingungen fuer Fehlerpfad Dfp_FrmMngANFRADMOMPT" VALUE 0xCB296 Kw_Wu8 255.0 OneToOne 0.00 255.0 FORMAT "%5.1" /end CHARACTERISTIC
/begin CHARACTERISTIC DSM_FMKDfp_FrmMngASC1_C "Ausblendbedingungen fuer Fehlerpfad Dfp_FrmMngASC1" VALUE 0xCB297 Kw_Wu8 255.0 OneToOne 0.00 255.0 FORMAT "%5.1" /end CHARACTERISTIC
/begin CHARACTERISTIC DSM_FMKDfp_FrmMngASC2_C "Ausblendbedingungen fuer Fehlerpfad Dfp_FrmMngASC2" VALUE 0xCB298 Kw_Wu8 255.0 OneToOne 0.00 255.0 FORMAT "%5.1" /end CHARACTERISTIC
/begin CHARACTERISTIC DSM_FMKDfp_FrmMngASC3_C "Ausblendbedingungen fuer Fehlerpfad Dfp_FrmMngASC3" VALUE 0xCB299 Kw_Wu8 255.0 OneToOne 0.00 255.0 FORMAT "%5.1" /end CHARACTERISTIC
/begin CHARACTERISTIC DSM_FMKDfp_FrmMngASC4_C "Ausblendbedingungen fuer Fehlerpfad Dfp_FrmMngASC4" VALUE 0xCB29A Kw_Wu8 255.0 OneToOne 0.00 255.0 FORMAT "%5.1" /end CHARACTERISTIC
/begin CHARACTERISTIC DSM_FMKDfp_FrmMngBOS_RESET_C "Ausblendbedingungen fuer Fehlerpfad Dfp_FrmMngBOS_RESET" VALUE 0xCB29B Kw_Wu8 255.0 OneToOne 0.00 255.0 FORMAT "%5.1" /end CHARACTERISTIC
/begin CHARACTERISTIC DSM_FMKDfp_FrmMngBOS_RESET2_C "Ausblendbedingungen fuer Fehlerpfad Dfp_FrmMngBOS_RESET2" VALUE 0xCB29C Kw_Wu8 255.0 OneToOne 0.00 255.0 FORMAT "%5.1" /end CHARACTERISTIC
/begin CHARACTERISTIC DSM_FMKDfp_FrmMngDMANFAFS_C "Ausblendbedingungen fuer Fehlerpfad Dfp_FrmMngDMANFAFS" VALUE 0xCB29D Kw_Wu8 255.0 OneToOne 0.00 255.0 FORMAT "%5.1" /end CHARACTERISTIC
/begin CHARACTERISTIC DSM_FMKDfp_FrmMngDRMANFSSG_C "Ausblendbedingungen fuer Fehlerpfad Dfp_FrmMngDRMANFSSG" VALUE 0xCB29E Kw_Wu8 255.0 OneToOne 0.00 255.0 FORMAT "%5.1" /end CHARACTERISTIC
/begin CHARACTERISTIC DSM_FMKDfp_FrmMngEGS1_C "Ausblendbedingungen fuer Fehlerpfad Dfp_FrmMngEGS1" VALUE 0xCB29F Kw_Wu8 255.0 OneToOne 0.00 255.0 FORMAT "%5.1" /end CHARACTERISTIC
/begin CHARACTERISTIC DSM_FMKDfp_FrmMngEGS2_C "Ausblendbedingungen fuer Fehlerpfad Dfp_FrmMngEGS2" VALUE 0xCB2A0 Kw_Wu8 255.0 OneToOne 0.00 255.0 FORMAT "%5.1" /end CHARACTERISTIC
/begin CHARACTERISTIC DSM_FMKDfp_FrmMngGEARBX_DATA_C "Ausblendbedingungen fuer Fehlerpfad Dfp_FrmMngGEARBX_DATA" VALUE 0xCB2A1 Kw_Wu8 255.0 OneToOne 0.00 255.0 FORMAT "%5.1" /end CHARACTERISTIC
/begin CHARACTERISTIC DSM_FMKDfp_FrmMngGEARBX_DATA2_C "Ausblendbedingungen fuer Fehlerpfad Dfp_FrmMngGEARBX_DATA2" VALUE 0xCB2A2 Kw_Wu8 255.0 OneToOne 0.00 255.0 FORMAT "%5.1" /end CHARACTERISTIC
/begin CHARACTERISTIC DSM_FMKDfp_FrmMngHEAT_AC_C "Ausblendbedingungen fuer Fehlerpfad Dfp_FrmMngHEAT_AC" VALUE 0xCB2A3 Kw_Wu8 255.0 OneToOne 0.00 255.0 FORMAT "%5.1" /end CHARACTERISTIC
/begin CHARACTERISTIC DSM_FMKDfp_FrmMngINSTR2_C "Ausblendbedingungen fuer Fehlerpfad Dfp_FrmMngINSTR2" VALUE 0xCB2A4 Kw_Wu8 255.0 OneToOne 0.00 255.0 FORMAT "%5.1" /end CHARACTERISTIC
/begin CHARACTERISTIC DSM_FMKDfp_FrmMngINSTR3_C "Ausblendbedingungen fuer Fehlerpfad Dfp_FrmMngINSTR3" VALUE 0xCB2A5 Kw_Wu8 255.0 OneToOne 0.00 255.0 FORMAT "%5.1" /end CHARACTERISTIC
/begin CHARACTERISTIC DSM_FMKDfp_FrmMngLENKRADWINKEL_C "Ausblendbedingungen fuer Fehlerpfad Dfp_FrmMngLENKRADWINKEL" VALUE 0xCB2A6 Kw_Wu8 255.0 OneToOne 0.00 255.0 FORMAT "%5.1" /end CHARACTERISTIC
/begin CHARACTERISTIC DSM_FMKDfp_FrmMngMILEAGE_RANGE_C "Ausblendbedingungen fuer Fehlerpfad Dfp_FrmMngMILEAGE_RANGE" VALUE 0xCB2A7 Kw_Wu8 255.0 OneToOne 0.00 255.0 FORMAT "%5.1" /end CHARACTERISTIC
/begin CHARACTERISTIC DSM_FMKDfp_FrmMngMSPHISYNC_C "Ausblendbedingungen fuer Fehlerpfad Dfp_FrmMngMSPHISYNC" VALUE 0xCB2A8 Kw_Wu8 255.0 OneToOne 0.00 255.0 FORMAT "%5.1" /end CHARACTERISTIC
/begin CHARACTERISTIC DSM_FMKDfp_FrmMngMST4_C "Ausblendbedingungen fuer Fehlerpfad Dfp_FrmMngMST4" VALUE 0xCB2A9 Kw_Wu8 255.0 OneToOne 0.00 255.0 FORMAT "%5.1" /end CHARACTERISTIC
/begin CHARACTERISTIC DSM_FMKDfp_FrmMngMST5_C "Ausblendbedingungen fuer Fehlerpfad Dfp_FrmMngMST5" VALUE 0xCB2AA Kw_Wu8 255.0 OneToOne 0.00 255.0 FORMAT "%5.1" /end CHARACTERISTIC
/begin CHARACTERISTIC DSM_FMKDfp_FrmMngOPCRCTLACC_C "Ausblendbedingungen fuer Fehlerpfad Dfp_FrmMngOPCRCTLACC" VALUE 0xCB2AB Kw_Wu8 255.0 OneToOne 0.00 255.0 FORMAT "%5.1" /end CHARACTERISTIC
/begin CHARACTERISTIC DSM_FMKDfp_FrmMngPRGG_CCTR_C "Ausblendbedingungen fuer Fehlerpfad Dfp_FrmMngPRGG_CCTR" VALUE 0xCB2AC Kw_Wu8 255.0 OneToOne 0.00 255.0 FORMAT "%5.1" /end CHARACTERISTIC
/begin CHARACTERISTIC DSM_FMKDfp_FrmMngPWRMNG_LOADV_C "Ausblendbedingungen fuer Fehlerpfad Dfp_FrmMngPWRMNG_LOADV" VALUE 0xCB2AD Kw_Wu8 255.0 OneToOne 0.00 255.0 FORMAT "%5.1" /end CHARACTERISTIC
/begin CHARACTERISTIC DSM_FMKDfp_FrmMngParkConsumer_C "Ausblendbedingungen fuer Fehlerpfad Dfp_FrmMngParkConsumer" VALUE 0xCB2AE Kw_Wu8 255.0 OneToOne 0.00 255.0 FORMAT "%5.1" /end CHARACTERISTIC
/begin CHARACTERISTIC DSM_FMKDfp_FrmMngRQSTGEFAN_C "Ausblendbedingungen fuer Fehlerpfad Dfp_FrmMngRQSTGEFAN_C" VALUE 0xCB2AF Kw_Wu8 255.0 OneToOne 0.00 255.0 FORMAT "%5.1" /end CHARACTERISTIC
/begin CHARACTERISTIC DSM_FMKDfp_FrmMngSLV4_C "Ausblendbedingungen fuer Fehlerpfad Dfp_FrmMngSLV4" VALUE 0xCB2B0 Kw_Wu8 255.0 OneToOne 0.00 255.0 FORMAT "%5.1" /end CHARACTERISTIC
/begin CHARACTERISTIC DSM_FMKDfp_FrmMngSLV5_C "Ausblendbedingungen fuer Fehlerpfad Dfp_FrmMngSLV5" VALUE 0xCB2B1 Kw_Wu8 255.0 OneToOne 0.00 255.0 FORMAT "%5.1" /end CHARACTERISTIC
/begin CHARACTERISTIC DSM_FMKDfp_FrmMngSSGErr_C "Ausblendbedingungen fuer Fehlerpfad Dfp_FrmMngSSGErr" VALUE 0xCB2B2 Kw_Wu8 255.0 OneToOne 0.00 255.0 FORMAT "%5.1" /end CHARACTERISTIC
/begin CHARACTERISTIC DSM_FMKDfp_FrmMngSSGShOff_C "Ausblendbedingungen fuer Fehlerpfad Dfp_FrmMngSSGShOff" VALUE 0xCB2B3 Kw_Wu8 255.0 OneToOne 0.00 255.0 FORMAT "%5.1" /end CHARACTERISTIC
/begin CHARACTERISTIC DSM_FMKDfp_FrmMngSTAT_ANH_C "Ausblendbedingungen fuer Fehlerpfad Dfp_FrmMngSTAT_ANH" VALUE 0xCB2B4 Kw_Wu8 255.0 OneToOne 0.00 255.0 FORMAT "%5.1" /end CHARACTERISTIC
/begin CHARACTERISTIC DSM_FMKDfp_FrmMngSTAT_ARS_C "Ausblendbedingungen fuer Fehlerpfad Dfp_FrmMngSTAT_ARS" VALUE 0xCB2B5 Kw_Wu8 255.0 OneToOne 0.00 255.0 FORMAT "%5.1" /end CHARACTERISTIC
/begin CHARACTERISTIC DSM_FMKDfp_FrmMngSTAT_DSC_C "Ausblendbedingungen fuer Fehlerpfad Dfp_FrmMngSTAT_DSC" VALUE 0xCB2B6 Kw_Wu8 255.0 OneToOne 0.00 255.0 FORMAT "%5.1" /end CHARACTERISTIC
/begin CHARACTERISTIC DSM_FMKDfp_FrmMngSTAT_EKP_C "Ausblendbedingungen fuer Fehlerpfad Dfp_FrmMngSTAT_EKP" VALUE 0xCB2B7 Kw_Wu8 255.0 OneToOne 0.00 255.0 FORMAT "%5.1" /end CHARACTERISTIC
/begin CHARACTERISTIC DSM_FMKDfp_FrmMngSTAT_KOMBI_C "Ausblendbedingungen fuer Fehlerpfad Dfp_FrmMngSTAT_KOMBI" VALUE 0xCB2B8 Kw_Wu8 255.0 OneToOne 0.00 255.0 FORMAT "%5.1" /end CHARACTERISTIC
/begin CHARACTERISTIC DSM_FMKDfp_FrmMngSTAT_SITZ_C "Ausblendbedingungen fuer Fehlerpfad  Dfp_FrmMngSTAT_SITZ" VALUE 0xCB2B9 Kw_Wu8 255.0 OneToOne 0.00 255.0 FORMAT "%5.1" /end CHARACTERISTIC
/begin CHARACTERISTIC DSM_FMKDfp_FrmMngStOBDGbxMilOf_C "Ausblendbedingungen fuer Fehlerpfad Dfp_FrmMngStOBDGbxMilOf" VALUE 0xCB2BA Kw_Wu8 255.0 OneToOne 0.00 255.0 FORMAT "%5.1" /end CHARACTERISTIC
/begin CHARACTERISTIC DSM_FMKDfp_FrmMngStOBDGbxMilOn_C "Ausblendbedingungen fuer Fehlerpfad Dfp_FrmMngStOBDGbxMilOn" VALUE 0xCB2BB Kw_Wu8 255.0 OneToOne 0.00 255.0 FORMAT "%5.1" /end CHARACTERISTIC
/begin CHARACTERISTIC DSM_FMKDfp_FrmMngTEMPRELTIME_C "Ausblendbedingungen fuer Fehlerpfad Dfp_FrmMngTEMPRELTIME" VALUE 0xCB2BC Kw_Wu8 255.0 OneToOne 0.00 255.0 FORMAT "%5.1" /end CHARACTERISTIC
/begin CHARACTERISTIC DSM_FMKDfp_FrmMngTERMINAL_C "Ausblendbedingungen fuer Fehlerpfad Dfp_FrmMngTERMINAL" VALUE 0xCB2BD Kw_Wu8 255.0 OneToOne 0.00 255.0 FORMAT "%5.1" /end CHARACTERISTIC
/begin CHARACTERISTIC DSM_FMKDfp_FrmMngTIME_DATE_C "Ausblendbedingungen fuer Fehlerpfad Dfp_FrmMngTIME_DATE" VALUE 0xCB2BE Kw_Wu8 255.0 OneToOne 0.00 255.0 FORMAT "%5.1" /end CHARACTERISTIC
/begin CHARACTERISTIC DSM_FMKDfp_FrmMngTORQUE_DSC_C "Ausblendbedingungen fuer Fehlerpfad Dfp_FrmMngTORQUE_DSC" VALUE 0xCB2BF Kw_Wu8 255.0 OneToOne 0.00 255.0 FORMAT "%5.1" /end CHARACTERISTIC
/begin CHARACTERISTIC DSM_FMKDfp_FrmMngTORQUE_GEARBX_C "Ausblendbedingungen fuer Fehlerpfad Dfp_FrmMngTORQUE_GEARBX" VALUE 0xCB2C0 Kw_Wu8 255.0 OneToOne 0.00 255.0 FORMAT "%5.1" /end CHARACTERISTIC
/begin CHARACTERISTIC DSM_FMKDfp_FrmMngTrq_ReqACC_C "Ausblendbedingungen fuer Fehlerpfad Dfp_FrmMngTrq_ReqACC" VALUE 0xCB2C1 Kw_Wu8 255.0 OneToOne 0.00 255.0 FORMAT "%5.1" /end CHARACTERISTIC
/begin CHARACTERISTIC DSM_FMKDfp_FrmMngVEH_MOD_C "Ausblendbedingungen fuer Fehlerpfad Dfp_FrmMngVEH_MOD_C" VALUE 0xCB2C2 Kw_Wu8 255.0 OneToOne 0.00 255.0 FORMAT "%5.1" /end CHARACTERISTIC
/begin CHARACTERISTIC DSM_FMKDfp_FrmMngVELOCITY_C "Ausblendbedingungen fuer Fehlerpfad Dfp_FrmMngVELOCITY" VALUE 0xCB2C3 Kw_Wu8 255.0 OneToOne 0.00 255.0 FORMAT "%5.1" /end CHARACTERISTIC
/begin CHARACTERISTIC DSM_FMKDfp_FrmMngWHEEL_SPEED_C "Ausblendbedingungen fuer Fehlerpfad Dfp_FrmMngWHEEL_SPEED" VALUE 0xCB2C4 Kw_Wu8 255.0 OneToOne 0.00 255.0 FORMAT "%5.1" /end CHARACTERISTIC
/begin CHARACTERISTIC DSM_FMKDfp_FrmMngstCurr_C "Maskenlabel für Dfp_FrmMngstCurr" VALUE 0xCB2C5 Kw_Wu8 255.0 OneToOne 0.00 255.0 FORMAT "%5.1" /end CHARACTERISTIC
/begin CHARACTERISTIC DSM_FMKDfp_FrmMngswtPSPOff_C "Maskenlabel für Dfp_FrmMngswtPSPOff" VALUE 0xCB2C6 Kw_Wu8 255.0 OneToOne 0.00 255.0 FORMAT "%5.1" /end CHARACTERISTIC
/begin CHARACTERISTIC DSM_FMKDfp_GearbxIncMax_C "Ausblendbedingungen fuer Fehlerpfad Dfp_GearbxIncMax" VALUE 0xCB2C7 Kw_Wu8 255.0 OneToOne 0.00 255.0 FORMAT "%5.1" /end CHARACTERISTIC
/begin CHARACTERISTIC DSM_FMKDfp_GlwCD_C "Ausblendbedingungen fuer Fehlerpfad Dfp_GlwCD" VALUE 0xCB2C8 Kw_Wu8 255.0 OneToOne 0.00 255.0 FORMAT "%5.1" /end CHARACTERISTIC
/begin CHARACTERISTIC DSM_FMKDfp_GlwCDGlwCirc1_C "Ausblendbedingungen fuer Fehlerpfad Dfp_GlwCDGlwCirc1" VALUE 0xCB2C9 Kw_Wu8 255.0 OneToOne 0.00 255.0 FORMAT "%5.1" /end CHARACTERISTIC
/begin CHARACTERISTIC DSM_FMKDfp_GlwCDGlwCirc2_C "Ausblendbedingungen fuer Fehlerpfad Dfp_GlwCDGlwCirc2" VALUE 0xCB2CA Kw_Wu8 255.0 OneToOne 0.00 255.0 FORMAT "%5.1" /end CHARACTERISTIC
/begin CHARACTERISTIC DSM_FMKDfp_GlwCDGlwCirc3_C "Ausblendbedingungen fuer Fehlerpfad Dfp_GlwCDGlwCirc3" VALUE 0xCB2CB Kw_Wu8 255.0 OneToOne 0.00 255.0 FORMAT "%5.1" /end CHARACTERISTIC
/begin CHARACTERISTIC DSM_FMKDfp_GlwCDGlwCirc4_C "Ausblendbedingungen fuer Fehlerpfad Dfp_GlwCDGlwCirc4" VALUE 0xCB2CC Kw_Wu8 255.0 OneToOne 0.00 255.0 FORMAT "%5.1" /end CHARACTERISTIC
/begin CHARACTERISTIC DSM_FMKDfp_GlwCDGlwCirc5_C "Ausblendbedingungen fuer Fehlerpfad Dfp_GlwCDGlwCirc5" VALUE 0xCB2CD Kw_Wu8 255.0 OneToOne 0.00 255.0 FORMAT "%5.1" /end CHARACTERISTIC
/begin CHARACTERISTIC DSM_FMKDfp_GlwCDGlwCirc6_C "Ausblendbedingungen fuer Fehlerpfad Dfp_GlwCDGlwCirc6" VALUE 0xCB2CE Kw_Wu8 255.0 OneToOne 0.00 255.0 FORMAT "%5.1" /end CHARACTERISTIC
/begin CHARACTERISTIC DSM_FMKDfp_GlwCDGlwCirc7_C "Ausblendbedingungen fuer Fehlerpfad Dfp_GlwCDGlwCirc7" VALUE 0xCB2CF Kw_Wu8 255.0 OneToOne 0.00 255.0 FORMAT "%5.1" /end CHARACTERISTIC
/begin CHARACTERISTIC DSM_FMKDfp_GlwCDGlwCirc8_C "Ausblendbedingungen fuer Fehlerpfad Dfp_GlwCDGlwCirc8" VALUE 0xCB2D0 Kw_Wu8 255.0 OneToOne 0.00 255.0 FORMAT "%5.1" /end CHARACTERISTIC
/begin CHARACTERISTIC DSM_FMKDfp_GlwCtl_C "Ausblendbedingungen fuer Fehlerpfad Dfp_GlwCtl" VALUE 0xCB2D1 Kw_Wu8 255.0 OneToOne 0.00 255.0 FORMAT "%5.1" /end CHARACTERISTIC
/begin CHARACTERISTIC DSM_FMKDfp_HWEMonCom_C "Ausblendbedingungen fuer Fehlerpfad Dfp_HWEMonCom" VALUE 0xCB2D2 Kw_Wu8 255.0 OneToOne 0.00 255.0 FORMAT "%5.1" /end CHARACTERISTIC
/begin CHARACTERISTIC DSM_FMKDfp_HWEMonEEPROM_C "Ausblendbedingungen fuer Fehlerpfad Dfp_HWEMonEEPROM" VALUE 0xCB2D3 Kw_Wu8 255.0 OneToOne 0.00 255.0 FORMAT "%5.1" /end CHARACTERISTIC
/begin CHARACTERISTIC DSM_FMKDfp_HWEMonRcyLocked_C "Ausblendbedingungen fuer Fehlerpfad Dfp_HWEMonRcyLocked" VALUE 0xCB2D4 Kw_Wu8 255.0 OneToOne 0.00 255.0 FORMAT "%5.1" /end CHARACTERISTIC
/begin CHARACTERISTIC DSM_FMKDfp_HWEMonRcySuppressed_C "Ausblendbedingungen fuer Fehlerpfad Dfp_HWEMonRcySuppressed" VALUE 0xCB2D5 Kw_Wu8 255.0 OneToOne 0.00 255.0 FORMAT "%5.1" /end CHARACTERISTIC
/begin CHARACTERISTIC DSM_FMKDfp_HWEMonRcyVisible_C "Ausblendbedingungen fuer Fehlerpfad Dfp_HWEMonRcyVisible" VALUE 0xCB2D6 Kw_Wu8 255.0 OneToOne 0.00 255.0 FORMAT "%5.1" /end CHARACTERISTIC
/begin CHARACTERISTIC DSM_FMKDfp_HWEMonUMaxSupply_C "Ausblendbedingungen fuer Fehlerpfad Dfp_HWEMonUMaxSupply" VALUE 0xCB2D7 Kw_Wu8 255.0 OneToOne 0.00 255.0 FORMAT "%5.1" /end CHARACTERISTIC
/begin CHARACTERISTIC DSM_FMKDfp_HWEMonUMinSupply_C "Ausblendbedingungen fuer Fehlerpfad Dfp_HWEMonUMinSupply" VALUE 0xCB2D8 Kw_Wu8 255.0 OneToOne 0.00 255.0 FORMAT "%5.1" /end CHARACTERISTIC
/begin CHARACTERISTIC DSM_FMKDfp_IATSCD_C "Ausblendbedingungen fuer Fehlerpfad Dfp_IATSCD" VALUE 0xCB2D9 Kw_Wu8 255.0 OneToOne 0.00 255.0 FORMAT "%5.1" /end CHARACTERISTIC
/begin CHARACTERISTIC DSM_FMKDfp_IATSCD_CATS_C "Ausblendbedingungen fuer Fehlerpfad Dfp_IATSCD_CATS" VALUE 0xCB2DA Kw_Wu8 255.0 OneToOne 0.00 255.0 FORMAT "%5.1" /end CHARACTERISTIC
/begin CHARACTERISTIC DSM_FMKDfp_IATSCD_CATSSec_C "Ausblendbedingungen fuer Fehlerpfad Dfp_IATSCD_CATSSec" VALUE 0xCB2DB Kw_Wu8 255.0 OneToOne 0.00 255.0 FORMAT "%5.1" /end CHARACTERISTIC
/begin CHARACTERISTIC DSM_FMKDfp_ImmCtlImmCD_C "Ausblendbedingungen fuer Fehlerpfad Dfp_ImmCtlImmCD" VALUE 0xCB2DC Kw_Wu8 255.0 OneToOne 0.00 255.0 FORMAT "%5.1" /end CHARACTERISTIC
/begin CHARACTERISTIC DSM_FMKDfp_ImmCtlImmEep_C "Ausblendbedingungen fuer Fehlerpfad Dfp_ImmCtlImmEep" VALUE 0xCB2DD Kw_Wu8 255.0 OneToOne 0.00 255.0 FORMAT "%5.1" /end CHARACTERISTIC
/begin CHARACTERISTIC DSM_FMKDfp_ImmCtlMpl_C "Ausblendbedingungen fuer Fehlerpfad Dfp_ImmCtlMpl" VALUE 0xCB2DE Kw_Wu8 255.0 OneToOne 0.00 255.0 FORMAT "%5.1" /end CHARACTERISTIC
/begin CHARACTERISTIC DSM_FMKDfp_IndSys1_C "Ausblendbedingungen fuer Fehlerpfad Dfp_IndSys1" VALUE 0xCB2DF Kw_Wu8 255.0 OneToOne 0.00 255.0 FORMAT "%5.1" /end CHARACTERISTIC
/begin CHARACTERISTIC DSM_FMKDfp_IndSys2_C "Ausblendbedingungen fuer Fehlerpfad Dfp_IndSys2" VALUE 0xCB2E0 Kw_Wu8 255.0 OneToOne 0.00 255.0 FORMAT "%5.1" /end CHARACTERISTIC
/begin CHARACTERISTIC DSM_FMKDfp_InjCrv_InjLim_C "Ausblendbedingungen fuer Fehlerpfad Dfp_InjCrv_InjLim" VALUE 0xCB2E1 Kw_Wu8 255.0 OneToOne 0.00 255.0 FORMAT "%5.1" /end CHARACTERISTIC
/begin CHARACTERISTIC DSM_FMKDfp_InjCtlAdjQnt_C "Ausblendbedingungen fuer Fehlerpfad Dfp_InjCtlAdjQnt" VALUE 0xCB2E2 Kw_Wu8 255.0 OneToOne 0.00 255.0 FORMAT "%5.1" /end CHARACTERISTIC
/begin CHARACTERISTIC DSM_FMKDfp_InjCtlDrift_C "Ausblendbedingungen fuer Fehlerpfad Dfp_InjCtlDrift" VALUE 0xCB2E3 Kw_Wu8 255.0 OneToOne 0.00 255.0 FORMAT "%5.1" /end CHARACTERISTIC
/begin CHARACTERISTIC DSM_FMKDfp_InjVCDActrChrg_C "Ausblendbedingungen fuer Fehlerpfad Dfp_InjVCDActrChrg" VALUE 0xCB2E4 Kw_Wu8 255.0 OneToOne 0.00 255.0 FORMAT "%5.1" /end CHARACTERISTIC
/begin CHARACTERISTIC DSM_FMKDfp_InjVCDActrEnrg1_C "Ausblendbedingungen fuer Fehlerpfad Dfp_InjVCDActrEnrg1" VALUE 0xCB2E5 Kw_Wu8 255.0 OneToOne 0.00 255.0 FORMAT "%5.1" /end CHARACTERISTIC
/begin CHARACTERISTIC DSM_FMKDfp_InjVCDActrEnrg2_C "Ausblendbedingungen fuer Fehlerpfad Dfp_InjVCDActrEnrg2" VALUE 0xCB2E6 Kw_Wu8 255.0 OneToOne 0.00 255.0 FORMAT "%5.1" /end CHARACTERISTIC
/begin CHARACTERISTIC DSM_FMKDfp_InjVCDActrEnrg3_C "Ausblendbedingungen fuer Fehlerpfad Dfp_InjVCDActrEnrg3" VALUE 0xCB2E7 Kw_Wu8 255.0 OneToOne 0.00 255.0 FORMAT "%5.1" /end CHARACTERISTIC
/begin CHARACTERISTIC DSM_FMKDfp_InjVCDActrEnrg4_C "Ausblendbedingungen fuer Fehlerpfad Dfp_InjVCDActrEnrg4" VALUE 0xCB2E8 Kw_Wu8 255.0 OneToOne 0.00 255.0 FORMAT "%5.1" /end CHARACTERISTIC
/begin CHARACTERISTIC DSM_FMKDfp_InjVCDActrEnrg5_C "Ausblendbedingungen fuer Fehlerpfad Dfp_InjVCDActrEnrg5" VALUE 0xCB2E9 Kw_Wu8 255.0 OneToOne 0.00 255.0 FORMAT "%5.1" /end CHARACTERISTIC
/begin CHARACTERISTIC DSM_FMKDfp_InjVCDActrEnrg6_C "Ausblendbedingungen fuer Fehlerpfad Dfp_InjVCDActrEnrg6" VALUE 0xCB2EA Kw_Wu8 255.0 OneToOne 0.00 255.0 FORMAT "%5.1" /end CHARACTERISTIC
/begin CHARACTERISTIC DSM_FMKDfp_InjVCDActrEnrg7_C "Ausblendbedingungen fuer Fehlerpfad Dfp_InjVCDActrEnrg7" VALUE 0xCB2EB Kw_Wu8 255.0 OneToOne 0.00 255.0 FORMAT "%5.1" /end CHARACTERISTIC
/begin CHARACTERISTIC DSM_FMKDfp_InjVCDActrEnrg8_C "Ausblendbedingungen fuer Fehlerpfad Dfp_InjVCDActrEnrg8" VALUE 0xCB2EC Kw_Wu8 255.0 OneToOne 0.00 255.0 FORMAT "%5.1" /end CHARACTERISTIC
/begin CHARACTERISTIC DSM_FMKDfp_InjVCDActrVolt_C "Ausblendbedingungen fuer Fehlerpfad Dfp_InjVCDActrVolt" VALUE 0xCB2ED Kw_Wu8 255.0 OneToOne 0.00 255.0 FORMAT "%5.1" /end CHARACTERISTIC
/begin CHARACTERISTIC DSM_FMKDfp_InjVCDClsBank1_C "Ausblendbedingungen fuer Fehlerpfad Dfp_InjVCDClsBank1" VALUE 0xCB2EE Kw_Wu8 255.0 OneToOne 0.00 255.0 FORMAT "%5.1" /end CHARACTERISTIC
/begin CHARACTERISTIC DSM_FMKDfp_InjVCDClsBank2_C "Ausblendbedingungen fuer Fehlerpfad Dfp_InjVCDClsBank2" VALUE 0xCB2EF Kw_Wu8 255.0 OneToOne 0.00 255.0 FORMAT "%5.1" /end CHARACTERISTIC
/begin CHARACTERISTIC DSM_FMKDfp_InjVCDMonCab_C "Ausblendbedingungen fuer Fehlerpfad Dfp_InjVCDMonCab" VALUE 0xCB2F0 Kw_Wu8 255.0 OneToOne 0.00 255.0 FORMAT "%5.1" /end CHARACTERISTIC
/begin CHARACTERISTIC DSM_FMKDfp_InjVCDMonSwt_C "Ausblendbedingungen fuer Fehlerpfad Dfp_InjVCDMonSwt" VALUE 0xCB2F1 Kw_Wu8 255.0 OneToOne 0.00 255.0 FORMAT "%5.1" /end CHARACTERISTIC
/begin CHARACTERISTIC DSM_FMKDfp_InjVCDShOffDCDC_C "Ausblendbedingungen fuer Fehlerpfad Dfp_InjVCDShOffDCDC" VALUE 0xCB2F2 Kw_Wu8 255.0 OneToOne 0.00 255.0 FORMAT "%5.1" /end CHARACTERISTIC
/begin CHARACTERISTIC DSM_FMKDfp_InjVCDUBuf1_C "Ausblendbedingungen fuer Fehlerpfad Dfp_InjVCDUBuf1" VALUE 0xCB2F3 Kw_Wu8 255.0 OneToOne 0.00 255.0 FORMAT "%5.1" /end CHARACTERISTIC
/begin CHARACTERISTIC DSM_FMKDfp_InjVCDUBuf2_C "Ausblendbedingungen fuer Fehlerpfad Dfp_InjVCDUBuf2" VALUE 0xCB2F4 Kw_Wu8 255.0 OneToOne 0.00 255.0 FORMAT "%5.1" /end CHARACTERISTIC
/begin CHARACTERISTIC DSM_FMKDfp_InjVCD_CY370Ampl_C "Ausblendbedingungen fuer Fehlerpfad Dfp_InjVCD_CY370Ampl" VALUE 0xCB2F5 Kw_Wu8 255.0 OneToOne 0.00 255.0 FORMAT "%5.1" /end CHARACTERISTIC
/begin CHARACTERISTIC DSM_FMKDfp_InjVCD_DrvTime_C "Ausblendbedingungen fuer Fehlerpfad Dfp_InjVCD_DrvTime" VALUE 0xCB2F6 Kw_Wu8 255.0 OneToOne 0.00 255.0 FORMAT "%5.1" /end CHARACTERISTIC
/begin CHARACTERISTIC DSM_FMKDfp_InjVCD_DrvTimeRcy_C "Ausblendbedingungen fuer Fehlerpfad Dfp_InjVCD_DrvTimeRcy" VALUE 0xCB2F7 Kw_Wu8 255.0 OneToOne 0.00 255.0 FORMAT "%5.1" /end CHARACTERISTIC
/begin CHARACTERISTIC DSM_FMKDfp_InjVCD_TPUErr_C "Ausblendbedingungen fuer Fehlerpfad Dfp_InjVCDTpuErr" VALUE 0xCB2F8 Kw_Wu8 255.0 OneToOne 0.00 255.0 FORMAT "%5.1" /end CHARACTERISTIC
/begin CHARACTERISTIC DSM_FMKDfp_InjVlvBnk1A_C "Ausblendbedingungen fuer Fehlerpfad Dfp_InjVlvBnk1A" VALUE 0xCB2F9 Kw_Wu8 255.0 OneToOne 0.00 255.0 FORMAT "%5.1" /end CHARACTERISTIC
/begin CHARACTERISTIC DSM_FMKDfp_InjVlvBnk1B_C "Ausblendbedingungen fuer Fehlerpfad Dfp_InjVlvBnk1B" VALUE 0xCB2FA Kw_Wu8 255.0 OneToOne 0.00 255.0 FORMAT "%5.1" /end CHARACTERISTIC
/begin CHARACTERISTIC DSM_FMKDfp_InjVlvBnk2A_C "Ausblendbedingungen fuer Fehlerpfad Dfp_InjVlvBnk2A" VALUE 0xCB2FB Kw_Wu8 255.0 OneToOne 0.00 255.0 FORMAT "%5.1" /end CHARACTERISTIC
/begin CHARACTERISTIC DSM_FMKDfp_InjVlvBnk2B_C "Ausblendbedingungen fuer Fehlerpfad Dfp_InjVlvBnk2B" VALUE 0xCB2FC Kw_Wu8 255.0 OneToOne 0.00 255.0 FORMAT "%5.1" /end CHARACTERISTIC
/begin CHARACTERISTIC DSM_FMKDfp_InjVlvChipA_C "Ausblendbedingungen fuer Fehlerpfad Dfp_InjVlvChipA" VALUE 0xCB2FD Kw_Wu8 255.0 OneToOne 0.00 255.0 FORMAT "%5.1" /end CHARACTERISTIC
/begin CHARACTERISTIC DSM_FMKDfp_InjVlvChipB_C "Ausblendbedingungen fuer Fehlerpfad Dfp_InjVlvChipB" VALUE 0xCB2FE Kw_Wu8 255.0 OneToOne 0.00 255.0 FORMAT "%5.1" /end CHARACTERISTIC
/begin CHARACTERISTIC DSM_FMKDfp_InjVlvCyl1A_C "Ausblendbedingungen fuer Fehlerpfad Dfp_InjVlvCyl1A" VALUE 0xCB2FF Kw_Wu8 255.0 OneToOne 0.00 255.0 FORMAT "%5.1" /end CHARACTERISTIC
/begin CHARACTERISTIC DSM_FMKDfp_InjVlvCyl1B_C "Ausblendbedingungen fuer Fehlerpfad Dfp_InjVlvCyl1B" VALUE 0xCB300 Kw_Wu8 255.0 OneToOne 0.00 255.0 FORMAT "%5.1" /end CHARACTERISTIC
/begin CHARACTERISTIC DSM_FMKDfp_InjVlvCyl1C_C "Ausblendbedingungen fuer Fehlerpfad Dfp_InjVlvCyl1C" VALUE 0xCB301 Kw_Wu8 255.0 OneToOne 0.00 255.0 FORMAT "%5.1" /end CHARACTERISTIC
/begin CHARACTERISTIC DSM_FMKDfp_InjVlvCyl2A_C "Ausblendbedingungen fuer Fehlerpfad Dfp_InjVlvCyl2A" VALUE 0xCB302 Kw_Wu8 255.0 OneToOne 0.00 255.0 FORMAT "%5.1" /end CHARACTERISTIC
/begin CHARACTERISTIC DSM_FMKDfp_InjVlvCyl2B_C "Ausblendbedingungen fuer Fehlerpfad Dfp_InjVlvCyl2B" VALUE 0xCB303 Kw_Wu8 255.0 OneToOne 0.00 255.0 FORMAT "%5.1" /end CHARACTERISTIC
/begin CHARACTERISTIC DSM_FMKDfp_InjVlvCyl2C_C "Ausblendbedingungen fuer Fehlerpfad Dfp_InjVlvCyl2C" VALUE 0xCB304 Kw_Wu8 255.0 OneToOne 0.00 255.0 FORMAT "%5.1" /end CHARACTERISTIC
/begin CHARACTERISTIC DSM_FMKDfp_InjVlvCyl3A_C "Ausblendbedingungen fuer Fehlerpfad Dfp_InjVlvCyl3A" VALUE 0xCB305 Kw_Wu8 255.0 OneToOne 0.00 255.0 FORMAT "%5.1" /end CHARACTERISTIC
/begin CHARACTERISTIC DSM_FMKDfp_InjVlvCyl3B_C "Ausblendbedingungen fuer Fehlerpfad Dfp_InjVlvCyl3B" VALUE 0xCB306 Kw_Wu8 255.0 OneToOne 0.00 255.0 FORMAT "%5.1" /end CHARACTERISTIC
/begin CHARACTERISTIC DSM_FMKDfp_InjVlvCyl3C_C "Ausblendbedingungen fuer Fehlerpfad Dfp_InjVlvCyl3C" VALUE 0xCB307 Kw_Wu8 255.0 OneToOne 0.00 255.0 FORMAT "%5.1" /end CHARACTERISTIC
/begin CHARACTERISTIC DSM_FMKDfp_InjVlvCyl4A_C "Ausblendbedingungen fuer Fehlerpfad Dfp_InjVlvCyl4A" VALUE 0xCB308 Kw_Wu8 255.0 OneToOne 0.00 255.0 FORMAT "%5.1" /end CHARACTERISTIC
/begin CHARACTERISTIC DSM_FMKDfp_InjVlvCyl4B_C "Ausblendbedingungen fuer Fehlerpfad Dfp_InjVlvCyl4B" VALUE 0xCB309 Kw_Wu8 255.0 OneToOne 0.00 255.0 FORMAT "%5.1" /end CHARACTERISTIC
/begin CHARACTERISTIC DSM_FMKDfp_InjVlvCyl4C_C "Ausblendbedingungen fuer Fehlerpfad Dfp_InjVlvCyl4C" VALUE 0xCB30A Kw_Wu8 255.0 OneToOne 0.00 255.0 FORMAT "%5.1" /end CHARACTERISTIC
/begin CHARACTERISTIC DSM_FMKDfp_InjVlvCyl5A_C "Ausblendbedingungen fuer Fehlerpfad Dfp_InjVlvCyl5A" VALUE 0xCB30B Kw_Wu8 255.0 OneToOne 0.00 255.0 FORMAT "%5.1" /end CHARACTERISTIC
/begin CHARACTERISTIC DSM_FMKDfp_InjVlvCyl5B_C "Ausblendbedingungen fuer Fehlerpfad Dfp_InjVlvCyl5B" VALUE 0xCB30C Kw_Wu8 255.0 OneToOne 0.00 255.0 FORMAT "%5.1" /end CHARACTERISTIC
/begin CHARACTERISTIC DSM_FMKDfp_InjVlvCyl5C_C "Ausblendbedingungen fuer Fehlerpfad Dfp_InjVlvCyl5C" VALUE 0xCB30D Kw_Wu8 255.0 OneToOne 0.00 255.0 FORMAT "%5.1" /end CHARACTERISTIC
/begin CHARACTERISTIC DSM_FMKDfp_InjVlvCyl6A_C "Ausblendbedingungen fuer Fehlerpfad Dfp_InjVlvCyl6A" VALUE 0xCB30E Kw_Wu8 255.0 OneToOne 0.00 255.0 FORMAT "%5.1" /end CHARACTERISTIC
/begin CHARACTERISTIC DSM_FMKDfp_InjVlvCyl6B_C "Ausblendbedingungen fuer Fehlerpfad Dfp_InjVlvCyl6B" VALUE 0xCB30F Kw_Wu8 255.0 OneToOne 0.00 255.0 FORMAT "%5.1" /end CHARACTERISTIC
/begin CHARACTERISTIC DSM_FMKDfp_InjVlvCyl6C_C "Ausblendbedingungen fuer Fehlerpfad Dfp_InjVlvCyl6C" VALUE 0xCB310 Kw_Wu8 255.0 OneToOne 0.00 255.0 FORMAT "%5.1" /end CHARACTERISTIC
/begin CHARACTERISTIC DSM_FMKDfp_InjVlvCyl7A_C "Ausblendbedingungen fuer Fehlerpfad Dfp_InjVlvCyl7A" VALUE 0xCB311 Kw_Wu8 255.0 OneToOne 0.00 255.0 FORMAT "%5.1" /end CHARACTERISTIC
/begin CHARACTERISTIC DSM_FMKDfp_InjVlvCyl7B_C "Ausblendbedingungen fuer Fehlerpfad Dfp_InjVlvCyl7B" VALUE 0xCB312 Kw_Wu8 255.0 OneToOne 0.00 255.0 FORMAT "%5.1" /end CHARACTERISTIC
/begin CHARACTERISTIC DSM_FMKDfp_InjVlvCyl7C_C "Ausblendbedingungen fuer Fehlerpfad Dfp_InjVlvCyl7C" VALUE 0xCB313 Kw_Wu8 255.0 OneToOne 0.00 255.0 FORMAT "%5.1" /end CHARACTERISTIC
/begin CHARACTERISTIC DSM_FMKDfp_InjVlvCyl8A_C "Ausblendbedingungen fuer Fehlerpfad Dfp_InjVlvCyl8A" VALUE 0xCB314 Kw_Wu8 255.0 OneToOne 0.00 255.0 FORMAT "%5.1" /end CHARACTERISTIC
/begin CHARACTERISTIC DSM_FMKDfp_InjVlvCyl8B_C "Ausblendbedingungen fuer Fehlerpfad Dfp_InjVlvCyl8B" VALUE 0xCB315 Kw_Wu8 255.0 OneToOne 0.00 255.0 FORMAT "%5.1" /end CHARACTERISTIC
/begin CHARACTERISTIC DSM_FMKDfp_InjVlvCyl8C_C "Ausblendbedingungen fuer Fehlerpfad Dfp_InjVlvCyl8C" VALUE 0xCB316 Kw_Wu8 255.0 OneToOne 0.00 255.0 FORMAT "%5.1" /end CHARACTERISTIC
/begin CHARACTERISTIC DSM_FMKDfp_InjVlvNVC1_C "Ausblendbedingungen fuer Fehlerpfad Dfp_InjVlvNVC1" VALUE 0xCB317 Kw_Wu8 255.0 OneToOne 0.00 255.0 FORMAT "%5.1" /end CHARACTERISTIC
/begin CHARACTERISTIC DSM_FMKDfp_InjVlvNVC2_C "Ausblendbedingungen fuer Fehlerpfad Dfp_InjVlvNVC2" VALUE 0xCB318 Kw_Wu8 255.0 OneToOne 0.00 255.0 FORMAT "%5.1" /end CHARACTERISTIC
/begin CHARACTERISTIC DSM_FMKDfp_InjVlvNVC3_C "Ausblendbedingungen fuer Fehlerpfad Dfp_InjVlvNVC3" VALUE 0xCB319 Kw_Wu8 255.0 OneToOne 0.00 255.0 FORMAT "%5.1" /end CHARACTERISTIC
/begin CHARACTERISTIC DSM_FMKDfp_InjVlvNVC4_C "Ausblendbedingungen fuer Fehlerpfad Dfp_InjVlvNVC4" VALUE 0xCB31A Kw_Wu8 255.0 OneToOne 0.00 255.0 FORMAT "%5.1" /end CHARACTERISTIC
/begin CHARACTERISTIC DSM_FMKDfp_InjVlvNVC5_C "Ausblendbedingungen fuer Fehlerpfad Dfp_InjVlvNVC5" VALUE 0xCB31B Kw_Wu8 255.0 OneToOne 0.00 255.0 FORMAT "%5.1" /end CHARACTERISTIC
/begin CHARACTERISTIC DSM_FMKDfp_InjVlvNVC6_C "Ausblendbedingungen fuer Fehlerpfad Dfp_InjVlvNVC6" VALUE 0xCB31C Kw_Wu8 255.0 OneToOne 0.00 255.0 FORMAT "%5.1" /end CHARACTERISTIC
/begin CHARACTERISTIC DSM_FMKDfp_InjVlvNVC7_C "Ausblendbedingungen fuer Fehlerpfad Dfp_InjVlvNVC7" VALUE 0xCB31D Kw_Wu8 255.0 OneToOne 0.00 255.0 FORMAT "%5.1" /end CHARACTERISTIC
/begin CHARACTERISTIC DSM_FMKDfp_InjVlvNVC8_C "Ausblendbedingungen fuer Fehlerpfad Dfp_InjVlvNVC8" VALUE 0xCB31E Kw_Wu8 255.0 OneToOne 0.00 255.0 FORMAT "%5.1" /end CHARACTERISTIC
/begin CHARACTERISTIC DSM_FMKDfp_KeyCheck_C "Ausblendbedingungen fuer Fehlerpfad Dfp_KeyCheck" VALUE 0xCB31F Kw_Wu8 255.0 OneToOne 0.00 255.0 FORMAT "%5.1" /end CHARACTERISTIC
/begin CHARACTERISTIC DSM_FMKDfp_LIGovECUTransMode_C "Ausblendbedingungen fuer Fehlerpfad Dfp_LIGovECUTransMode" VALUE 0xCB320 Kw_Wu8 255.0 OneToOne 0.00 255.0 FORMAT "%5.1" /end CHARACTERISTIC
/begin CHARACTERISTIC DSM_FMKDfp_LPACD_Max_C "Ausblendbedingungen fuer Fehlerpfad Dfp_LPACD_Max" VALUE 0xCB321 Kw_Wu8 255.0 OneToOne 0.00 255.0 FORMAT "%5.1" /end CHARACTERISTIC
/begin CHARACTERISTIC DSM_FMKDfp_LPACD_Min_C "Ausblendbedingungen fuer Fehlerpfad Dfp_LPACD_Min" VALUE 0xCB322 Kw_Wu8 255.0 OneToOne 0.00 255.0 FORMAT "%5.1" /end CHARACTERISTIC
/begin CHARACTERISTIC DSM_FMKDfp_LPACD_SigNpl_C "Ausblendbedingungen fuer Fehlerpfad Dfp_LPACD_SigNpl" VALUE 0xCB323 Kw_Wu8 255.0 OneToOne 0.00 255.0 FORMAT "%5.1" /end CHARACTERISTIC
/begin CHARACTERISTIC DSM_FMKDfp_LSUCDCircNernst0B1_C "Ausblendbedingungen fuer Fehlerpfad Dfp_LSUCDCircNernst0B1" VALUE 0xCB324 Kw_Wu8 255.0 OneToOne 0.00 255.0 FORMAT "%5.1" /end CHARACTERISTIC
/begin CHARACTERISTIC DSM_FMKDfp_LSUCDCircNernst0B2_C "Ausblendbedingungen fuer Fehlerpfad Dfp_LSUCDCircNernst0B2" VALUE 0xCB325 Kw_Wu8 255.0 OneToOne 0.00 255.0 FORMAT "%5.1" /end CHARACTERISTIC
/begin CHARACTERISTIC DSM_FMKDfp_LSUCDCircPumpCur0B1_C "Ausblendbedingungen fuer Fehlerpfad Dfp_LSUCDCircPumpCur0B1" VALUE 0xCB326 Kw_Wu8 255.0 OneToOne 0.00 255.0 FORMAT "%5.1" /end CHARACTERISTIC
/begin CHARACTERISTIC DSM_FMKDfp_LSUCDCircPumpCur0B2_C "Ausblendbedingungen fuer Fehlerpfad Dfp_LSUCDCircPumpCur0B2" VALUE 0xCB327 Kw_Wu8 255.0 OneToOne 0.00 255.0 FORMAT "%5.1" /end CHARACTERISTIC
/begin CHARACTERISTIC DSM_FMKDfp_LSUCDCircVirtGnd0B1_C "Ausblendbedingungen fuer Fehlerpfad Dfp_LSUCDCircVirtGnd0B1" VALUE 0xCB328 Kw_Wu8 255.0 OneToOne 0.00 255.0 FORMAT "%5.1" /end CHARACTERISTIC
/begin CHARACTERISTIC DSM_FMKDfp_LSUCDCircVirtGnd0B2_C "Ausblendbedingungen fuer Fehlerpfad Dfp_LSUCDCircVirtGnd0B2" VALUE 0xCB329 Kw_Wu8 255.0 OneToOne 0.00 255.0 FORMAT "%5.1" /end CHARACTERISTIC
/begin CHARACTERISTIC DSM_FMKDfp_LSUCDHeater0B1_C "Ausblendbedingungen fuer Fehlerpfad Dfp_LSUCDHeater0B1" VALUE 0xCB32A Kw_Wu8 255.0 OneToOne 0.00 255.0 FORMAT "%5.1" /end CHARACTERISTIC
/begin CHARACTERISTIC DSM_FMKDfp_LSUCDHeater0B2_C "Ausblendbedingungen fuer Fehlerpfad Dfp_LSUCDHeater0B2" VALUE 0xCB32B Kw_Wu8 255.0 OneToOne 0.00 255.0 FORMAT "%5.1" /end CHARACTERISTIC
/begin CHARACTERISTIC DSM_FMKDfp_LSUCDHtCoup0B1_C "Ausblendbedingungen fuer Fehlerpfad Dfp_LSUCDHtCoup0B1" VALUE 0xCB32C Kw_Wu8 255.0 OneToOne 0.00 255.0 FORMAT "%5.1" /end CHARACTERISTIC
/begin CHARACTERISTIC DSM_FMKDfp_LSUCDHtCoup0B2_C "Ausblendbedingungen fuer Fehlerpfad Dfp_LSUCDHtCoup0B2" VALUE 0xCB32D Kw_Wu8 255.0 OneToOne 0.00 255.0 FORMAT "%5.1" /end CHARACTERISTIC
/begin CHARACTERISTIC DSM_FMKDfp_LSUCDO20B1_C "Ausblendbedingungen fuer Fehlerpfad Dfp_LSUCDO20B1" VALUE 0xCB32E Kw_Wu8 255.0 OneToOne 0.00 255.0 FORMAT "%5.1" /end CHARACTERISTIC
/begin CHARACTERISTIC DSM_FMKDfp_LSUCDO20B2_C "Ausblendbedingungen fuer Fehlerpfad Dfp_LSUCDO20B2" VALUE 0xCB32F Kw_Wu8 255.0 OneToOne 0.00 255.0 FORMAT "%5.1" /end CHARACTERISTIC
/begin CHARACTERISTIC DSM_FMKDfp_LSUCDO2Clb0B1_C "Ausblendbedingungen fuer Fehlerpfad Dfp_LSUCDO2Clb0B1" VALUE 0xCB330 Kw_Wu8 255.0 OneToOne 0.00 255.0 FORMAT "%5.1" /end CHARACTERISTIC
/begin CHARACTERISTIC DSM_FMKDfp_LSUCDO2Clb0B2_C "Ausblendbedingungen fuer Fehlerpfad Dfp_LSUCDO2Clb0B2" VALUE 0xCB331 Kw_Wu8 255.0 OneToOne 0.00 255.0 FORMAT "%5.1" /end CHARACTERISTIC
/begin CHARACTERISTIC DSM_FMKDfp_LSUCDRiClb0B1_C "Ausblendbedingungen fuer Fehlerpfad Dfp_LSUCDRiClb0B1" VALUE 0xCB332 Kw_Wu8 255.0 OneToOne 0.00 255.0 FORMAT "%5.1" /end CHARACTERISTIC
/begin CHARACTERISTIC DSM_FMKDfp_LSUCDRiClb0B2_C "Ausblendbedingungen fuer Fehlerpfad Dfp_LSUCDRiClb0B2" VALUE 0xCB333 Kw_Wu8 255.0 OneToOne 0.00 255.0 FORMAT "%5.1" /end CHARACTERISTIC
/begin CHARACTERISTIC DSM_FMKDfp_LSUCDSPI0B1_C "Ausblendbedingungen fuer Fehlerpfad Dfp_LSUCDSPI0B1" VALUE 0xCB334 Kw_Wu8 255.0 OneToOne 0.00 255.0 FORMAT "%5.1" /end CHARACTERISTIC
/begin CHARACTERISTIC DSM_FMKDfp_LSUCDSPI0B2_C "Ausblendbedingungen fuer Fehlerpfad Dfp_LSUCDSPI0B2" VALUE 0xCB335 Kw_Wu8 255.0 OneToOne 0.00 255.0 FORMAT "%5.1" /end CHARACTERISTIC
/begin CHARACTERISTIC DSM_FMKDfp_LSUCDSPIBattLow0B1_C "Ausblendbedingungen fuer Fehlerpfad Dfp_LSUCDSPIBattLow0B1" VALUE 0xCB336 Kw_Wu8 255.0 OneToOne 0.00 255.0 FORMAT "%5.1" /end CHARACTERISTIC
/begin CHARACTERISTIC DSM_FMKDfp_LSUCDSPIBattLow0B2_C "Ausblendbedingungen fuer Fehlerpfad Dfp_LSUCDSPIBattLow0B2" VALUE 0xCB337 Kw_Wu8 255.0 OneToOne 0.00 255.0 FORMAT "%5.1" /end CHARACTERISTIC
/begin CHARACTERISTIC DSM_FMKDfp_LSUCDWireIP0B1_C "Ausblendbedingungen fuer Fehlerpfad Dfp_LSUCDWireIP0B1" VALUE 0xCB338 Kw_Wu8 255.0 OneToOne 0.00 255.0 FORMAT "%5.1" /end CHARACTERISTIC
/begin CHARACTERISTIC DSM_FMKDfp_LSUCDWireIP0B2_C "Ausblendbedingungen fuer Fehlerpfad Dfp_LSUCDWireIP0B2" VALUE 0xCB339 Kw_Wu8 255.0 OneToOne 0.00 255.0 FORMAT "%5.1" /end CHARACTERISTIC
/begin CHARACTERISTIC DSM_FMKDfp_LSUCtlRiExc0B1_C "Ausblendbedingungen fuer Fehlerpfad Dfp_LSUCtlRiExc0B1" VALUE 0xCB33A Kw_Wu8 255.0 OneToOne 0.00 255.0 FORMAT "%5.1" /end CHARACTERISTIC
/begin CHARACTERISTIC DSM_FMKDfp_LSUCtlRiExc0B2_C "Ausblendbedingungen fuer Fehlerpfad Dfp_LSUCtlRiExc0B2" VALUE 0xCB33B Kw_Wu8 255.0 OneToOne 0.00 255.0 FORMAT "%5.1" /end CHARACTERISTIC
/begin CHARACTERISTIC DSM_FMKDfp_LSUMon1SensB1_C "Ausblendbedingungen fuer Fehlerpfad Dfp_LSUMon1SensB1" VALUE 0xCB33C Kw_Wu8 255.0 OneToOne 0.00 255.0 FORMAT "%5.1" /end CHARACTERISTIC
/begin CHARACTERISTIC DSM_FMKDfp_LSUMon1SensB2_C "Ausblendbedingungen fuer Fehlerpfad Dfp_LSUMon1SensB2" VALUE 0xCB33D Kw_Wu8 255.0 OneToOne 0.00 255.0 FORMAT "%5.1" /end CHARACTERISTIC
/begin CHARACTERISTIC DSM_FMKDfp_LSUMon2SensB1_C "Ausblendbedingungen fuer Fehlerpfad Dfp_LSUMon2SensB1" VALUE 0xCB33E Kw_Wu8 255.0 OneToOne 0.00 255.0 FORMAT "%5.1" /end CHARACTERISTIC
/begin CHARACTERISTIC DSM_FMKDfp_LSUMon2SensB2_C "Ausblendbedingungen fuer Fehlerpfad Dfp_LSUMon2SensB2" VALUE 0xCB33F Kw_Wu8 255.0 OneToOne 0.00 255.0 FORMAT "%5.1" /end CHARACTERISTIC
/begin CHARACTERISTIC DSM_FMKDfp_MIL_C "Ausblendbedingungen fuer Fehlerpfad Dfp_MIL" VALUE 0xCB340 Kw_Wu8 255.0 OneToOne 0.00 255.0 FORMAT "%5.1" /end CHARACTERISTIC
/begin CHARACTERISTIC DSM_FMKDfp_MRlyCD_C "Ausblendbedingungen fuer Fehlerpfad Dfp_MRlyCD" VALUE 0xCB341 Kw_Wu8 255.0 OneToOne 0.00 255.0 FORMAT "%5.1" /end CHARACTERISTIC
/begin CHARACTERISTIC DSM_FMKDfp_MSMon_C "Ausblendbedingungen fuer Fehlerpfad Dfp_MSMon" VALUE 0xCB342 Kw_Wu8 255.0 OneToOne 0.00 255.0 FORMAT "%5.1" /end CHARACTERISTIC
/begin CHARACTERISTIC DSM_FMKDfp_MSMonConsist_C "Ausblendbedingungen fuer Fehlerpfad Dfp_MSMonConsist" VALUE 0xCB343 Kw_Wu8 255.0 OneToOne 0.00 255.0 FORMAT "%5.1" /end CHARACTERISTIC
/begin CHARACTERISTIC DSM_FMKDfp_MSMonPFlt1_C "Ausblendbedingungen fuer Fehlerpfad Dfp_MSMonPFlt1" VALUE 0xCB344 Kw_Wu8 255.0 OneToOne 0.00 255.0 FORMAT "%5.1" /end CHARACTERISTIC
/begin CHARACTERISTIC DSM_FMKDfp_MSMonPFlt2_C "Ausblendbedingungen fuer Fehlerpfad Dfp_MSMonPFlt2" VALUE 0xCB345 Kw_Wu8 255.0 OneToOne 0.00 255.0 FORMAT "%5.1" /end CHARACTERISTIC
/begin CHARACTERISTIC DSM_FMKDfp_MSMonPFlt3_C "Ausblendbedingungen fuer Fehlerpfad Dfp_MSMonPFlt3" VALUE 0xCB346 Kw_Wu8 255.0 OneToOne 0.00 255.0 FORMAT "%5.1" /end CHARACTERISTIC
/begin CHARACTERISTIC DSM_FMKDfp_MSMonPFlt4_C "Ausblendbedingungen fuer Fehlerpfad Dfp_MSMonPFlt4" VALUE 0xCB347 Kw_Wu8 255.0 OneToOne 0.00 255.0 FORMAT "%5.1" /end CHARACTERISTIC
/begin CHARACTERISTIC DSM_FMKDfp_MSMon_ARS_TO_C "Ausblendbedingungen fuer Fehlerpfad Dfp_MSMon_ARS_TO" VALUE 0xCB348 Kw_Wu8 255.0 OneToOne 0.00 255.0 FORMAT "%5.1" /end CHARACTERISTIC
/begin CHARACTERISTIC DSM_FMKDfp_MSMon_AirCtl_C "Ausblendbedingungen fuer Fehlerpfad Dfp_MSMon_AirCtl" VALUE 0xCB349 Kw_Wu8 255.0 OneToOne 0.00 255.0 FORMAT "%5.1" /end CHARACTERISTIC
/begin CHARACTERISTIC DSM_FMKDfp_MSMon_AirSys0_C "Ausblendbedingungen fuer Fehlerpfad Dfp_MSMon_AirSys0" VALUE 0xCB34A Kw_Wu8 255.0 OneToOne 0.00 255.0 FORMAT "%5.1" /end CHARACTERISTIC
/begin CHARACTERISTIC DSM_FMKDfp_MSMon_AirSys1_C "Ausblendbedingungen fuer Fehlerpfad Dfp_MSMon_AirSys1" VALUE 0xCB34B Kw_Wu8 255.0 OneToOne 0.00 255.0 FORMAT "%5.1" /end CHARACTERISTIC
/begin CHARACTERISTIC DSM_FMKDfp_MSMon_AirSys2_C "Ausblendbedingungen fuer Fehlerpfad Dfp_MSMon_AirSys2" VALUE 0xCB34C Kw_Wu8 255.0 OneToOne 0.00 255.0 FORMAT "%5.1" /end CHARACTERISTIC
/begin CHARACTERISTIC DSM_FMKDfp_MSMon_AirSys3_C "Ausblendbedingungen fuer Fehlerpfad Dfp_MSMon_AirSys3" VALUE 0xCB34D Kw_Wu8 255.0 OneToOne 0.00 255.0 FORMAT "%5.1" /end CHARACTERISTIC
/begin CHARACTERISTIC DSM_FMKDfp_MSMon_AirSys4_C "Ausblendbedingungen fuer Fehlerpfad Dfp_MSMon_AirSys4" VALUE 0xCB34E Kw_Wu8 255.0 OneToOne 0.00 255.0 FORMAT "%5.1" /end CHARACTERISTIC
/begin CHARACTERISTIC DSM_FMKDfp_MSMon_AirSys7_C "Ausblendbedingungen fuer Fehlerpfad Dfp_MSMon_AirSys7" VALUE 0xCB34F Kw_Wu8 255.0 OneToOne 0.00 255.0 FORMAT "%5.1" /end CHARACTERISTIC
/begin CHARACTERISTIC DSM_FMKDfp_MSMon_CanDef_C "Ausblendbedingungen fuer Fehlerpfad Dfp_MSMon_CanDef" VALUE 0xCB350 Kw_Wu8 255.0 OneToOne 0.00 255.0 FORMAT "%5.1" /end CHARACTERISTIC
/begin CHARACTERISTIC DSM_FMKDfp_MSMon_CoEng_OffVeh_C "Ausblendbedingungen fuer Fehlerpfad Dfp_MSMon_CoEng_OffVeh_C" VALUE 0xCB351 Kw_Wu8 255.0 OneToOne 0.00 255.0 FORMAT "%5.1" /end CHARACTERISTIC
/begin CHARACTERISTIC DSM_FMKDfp_MSMon_CoEng_Rev1_C "Ausblendbedingungen fuer Fehlerpfad Dfp_MSMon_CoEng_Rev1_C" VALUE 0xCB352 Kw_Wu8 255.0 OneToOne 0.00 255.0 FORMAT "%5.1" /end CHARACTERISTIC
/begin CHARACTERISTIC DSM_FMKDfp_MSMon_CoEng_Rev2_C "Ausblendbedingungen fuer Fehlerpfad Dfp_MSMon_CoEng_Rev2_C" VALUE 0xCB353 Kw_Wu8 255.0 OneToOne 0.00 255.0 FORMAT "%5.1" /end CHARACTERISTIC
/begin CHARACTERISTIC DSM_FMKDfp_MSMon_CoEng_RevMS_C "Ausblendbedingungen fuer Fehlerpfad Dfp_MSMon_CoEng_RevMS_C" VALUE 0xCB354 Kw_Wu8 255.0 OneToOne 0.00 255.0 FORMAT "%5.1" /end CHARACTERISTIC
/begin CHARACTERISTIC DSM_FMKDfp_MSMon_DSC_TO_C "Ausblendbedingungen fuer Fehlerpfad Dfp_MSMon_DSC_TO" VALUE 0xCB355 Kw_Wu8 255.0 OneToOne 0.00 255.0 FORMAT "%5.1" /end CHARACTERISTIC
/begin CHARACTERISTIC DSM_FMKDfp_MSMon_EGS_TO_C "Ausblendbedingungen fuer Fehlerpfad Dfp_MSMon_EGS_TO" VALUE 0xCB356 Kw_Wu8 255.0 OneToOne 0.00 255.0 FORMAT "%5.1" /end CHARACTERISTIC
/begin CHARACTERISTIC DSM_FMKDfp_MSMon_FrmMngCoEng_C "Ausblendbedingungen fuer Fehlerpfad Dfp_MSMon_FrmMngCoEng" VALUE 0xCB357 Kw_Wu8 255.0 OneToOne 0.00 255.0 FORMAT "%5.1" /end CHARACTERISTIC
/begin CHARACTERISTIC DSM_FMKDfp_MSMon_FrmMngPT_C "Ausblendbedingungen fuer Fehlerpfad Dfp_MSMon_FrmMngPT_C" VALUE 0xCB358 Kw_Wu8 255.0 OneToOne 0.00 255.0 FORMAT "%5.1" /end CHARACTERISTIC
/begin CHARACTERISTIC DSM_FMKDfp_MSMon_FrmMngPT2_C "Ausblendbedingungen fuer Fehlerpfad Dfp_MSMon_FrmMngPT2" VALUE 0xCB359 Kw_Wu8 255.0 OneToOne 0.00 255.0 FORMAT "%5.1" /end CHARACTERISTIC
/begin CHARACTERISTIC DSM_FMKDfp_MSMon_Mil_C "Ausblendbedingungen fuer Fehlerpfad Dfp_MSMon_Mil_C" VALUE 0xCB35A Kw_Wu8 255.0 OneToOne 0.00 255.0 FORMAT "%5.1" /end CHARACTERISTIC
/begin CHARACTERISTIC DSM_FMKDfp_MSMon_NetMngPtCan_C "Ausblendbedingungen fuer Fehlerpfad Dfp_MSMon_NetMngPtCan" VALUE 0xCB35B Kw_Wu8 255.0 OneToOne 0.00 255.0 FORMAT "%5.1" /end CHARACTERISTIC
/begin CHARACTERISTIC DSM_FMKDfp_MSMon_RailCDPMon_C "Ausblendbedingungen fuer Fehlerpfad Dfp_MSMon_RailCDPMon" VALUE 0xCB35C Kw_Wu8 255.0 OneToOne 0.00 255.0 FORMAT "%5.1" /end CHARACTERISTIC
/begin CHARACTERISTIC DSM_FMKDfp_MSMon_StEGS_C "Ausblendbedingungen fuer Fehlerpfad Dfp_MSMon_StEGS" VALUE 0xCB35D Kw_Wu8 255.0 OneToOne 0.00 255.0 FORMAT "%5.1" /end CHARACTERISTIC
/begin CHARACTERISTIC DSM_FMKDfp_MSMon_SysLamp_C "Ausblendbedingungen fuer Fehlerpfad Dfp_MSMon_SysLamp_C" VALUE 0xCB35E Kw_Wu8 255.0 OneToOne 0.00 255.0 FORMAT "%5.1" /end CHARACTERISTIC
/begin CHARACTERISTIC DSM_FMKDfp_MSMon_ZFCClbActv_C "Ausblendbedingungen fuer Fehlerpfad Dfp_MSMon_ZFCClbActv" VALUE 0xCB35F Kw_Wu8 255.0 OneToOne 0.00 255.0 FORMAT "%5.1" /end CHARACTERISTIC
/begin CHARACTERISTIC DSM_FMKDfp_MSMon_qLimErr_C "Ausblendbedingungen fuer Fehlerpfad Dfp_MSMon_qLimErr_C" VALUE 0xCB360 Kw_Wu8 255.0 OneToOne 0.00 255.0 FORMAT "%5.1" /end CHARACTERISTIC
/begin CHARACTERISTIC DSM_FMKDfp_MSMon_trqCoDT_C "Ausblendbedingungen fuer Fehlerpfad Dfp_MSMon_trqCoDT_C" VALUE 0xCB361 Kw_Wu8 255.0 OneToOne 0.00 255.0 FORMAT "%5.1" /end CHARACTERISTIC
/begin CHARACTERISTIC DSM_FMKDfp_MSMon_trqCoVeh_C "Ausblendbedingungen fuer Fehlerpfad Dfp_MSMon_trqCoVeh_C" VALUE 0xCB362 Kw_Wu8 255.0 OneToOne 0.00 255.0 FORMAT "%5.1" /end CHARACTERISTIC
/begin CHARACTERISTIC DSM_FMKDfp_MSMon_trqCoVehLim_C "Ausblendbedingungen fuer Fehlerpfad Dfp_MSMon_trqCoVehLim_C" VALUE 0xCB363 Kw_Wu8 255.0 OneToOne 0.00 255.0 FORMAT "%5.1" /end CHARACTERISTIC
/begin CHARACTERISTIC DSM_FMKDfp_MSMon_trqDesExt_C "Ausblendbedingungen fuer Fehlerpfad Dfp_MSMon_trqDesExt_C" VALUE 0xCB364 Kw_Wu8 255.0 OneToOne 0.00 255.0 FORMAT "%5.1" /end CHARACTERISTIC
/begin CHARACTERISTIC DSM_FMKDfp_MSMon_trqDesExtRev_C "Ausblendbedingungen fuer Fehlerpfad Dfp_MSMon_trqDesExtRev_C" VALUE 0xCB365 Kw_Wu8 255.0 OneToOne 0.00 255.0 FORMAT "%5.1" /end CHARACTERISTIC
/begin CHARACTERISTIC DSM_FMKDfp_MSMon_trqLimErr_C "Ausblendbedingungen fuer Fehlerpfad Dfp_MSMon_trqLimErr_C" VALUE 0xCB366 Kw_Wu8 255.0 OneToOne 0.00 255.0 FORMAT "%5.1" /end CHARACTERISTIC
/begin CHARACTERISTIC DSM_FMKDfp_MSMon_trqLimErr1_C "Ausblendbedingungen fuer Fehlerpfad Dfp_MSMon_trqLimErr1_C" VALUE 0xCB367 Kw_Wu8 255.0 OneToOne 0.00 255.0 FORMAT "%5.1" /end CHARACTERISTIC
/begin CHARACTERISTIC DSM_FMKDfp_MSMon_trqLimErr2_C "Ausblendbedingungen fuer Fehlerpfad Dfp_MSMon_trqLimErr2_C" VALUE 0xCB368 Kw_Wu8 255.0 OneToOne 0.00 255.0 FORMAT "%5.1" /end CHARACTERISTIC
/begin CHARACTERISTIC DSM_FMKDfp_MSMon_trqLimErr3_C "Ausblendbedingungen fuer Fehlerpfad Dfp_MSMon_trqLimErr3" VALUE 0xCB369 Kw_Wu8 255.0 OneToOne 0.00 255.0 FORMAT "%5.1" /end CHARACTERISTIC
/begin CHARACTERISTIC DSM_FMKDfp_MSMon_trqLimErr4_C "Ausblendbedingungen fuer Fehlerpfad Dfp_MSMon_trqLimErr4" VALUE 0xCB36A Kw_Wu8 255.0 OneToOne 0.00 255.0 FORMAT "%5.1" /end CHARACTERISTIC
/begin CHARACTERISTIC DSM_FMKDfp_MSidCD_Comm_C "Ausblendbedingungen fuer Fehlerpfad Dfp_MSidCD_Comm" VALUE 0xCB36B Kw_Wu8 255.0 OneToOne 0.00 255.0 FORMAT "%5.1" /end CHARACTERISTIC
/begin CHARACTERISTIC DSM_FMKDfp_MSidCD_EcuMixed_C "Ausblendbedingungen fuer Fehlerpfad Dfp_MSidCD_EcuMixed" VALUE 0xCB36C Kw_Wu8 255.0 OneToOne 0.00 255.0 FORMAT "%5.1" /end CHARACTERISTIC
/begin CHARACTERISTIC DSM_FMKDfp_MSidCD_Pin_C "Ausblendbedingungen fuer Fehlerpfad Dfp_MSidCD_Pin" VALUE 0xCB36D Kw_Wu8 255.0 OneToOne 0.00 255.0 FORMAT "%5.1" /end CHARACTERISTIC
/begin CHARACTERISTIC DSM_FMKDfp_MSidCD_Sel_INI_C "Ausblendbedingungen fuer Fehlerpfad Dfp_MSidCD_Sel_INI" VALUE 0xCB36E Kw_Wu8 255.0 OneToOne 0.00 255.0 FORMAT "%5.1" /end CHARACTERISTIC
/begin CHARACTERISTIC DSM_FMKDfp_MSidCD_Select_C "Ausblendbedingungen fuer Fehlerpfad Dfp_MSidCD_Select" VALUE 0xCB36F Kw_Wu8 255.0 OneToOne 0.00 255.0 FORMAT "%5.1" /end CHARACTERISTIC
/begin CHARACTERISTIC DSM_FMKDfp_MSid_SwCmp_C "Ausblendbedingungen fuer Fehlerpfad Dfp_MSid_SwCmp" VALUE 0xCB370 Kw_Wu8 255.0 OneToOne 0.00 255.0 FORMAT "%5.1" /end CHARACTERISTIC
/begin CHARACTERISTIC DSM_FMKDfp_MSid_regEEPDiff_C "Ausblendbedingungen fuer Fehlerpfad Dfp_MSid_regEEPDiff" VALUE 0xCB371 Kw_Wu8 255.0 OneToOne 0.00 255.0 FORMAT "%5.1" /end CHARACTERISTIC
/begin CHARACTERISTIC DSM_FMKDfp_MeUnCDNoLoad_C "Ausblendbedingungen fuer Fehlerpfad Dfp_MeUnCDNoLoad" VALUE 0xCB372 Kw_Wu8 255.0 OneToOne 0.00 255.0 FORMAT "%5.1" /end CHARACTERISTIC
/begin CHARACTERISTIC DSM_FMKDfp_MeUnCDSCBat_C "Ausblendbedingungen fuer Fehlerpfad Dfp_MeUnCDSCBat" VALUE 0xCB373 Kw_Wu8 255.0 OneToOne 0.00 255.0 FORMAT "%5.1" /end CHARACTERISTIC
/begin CHARACTERISTIC DSM_FMKDfp_MeUnCDSCGnd_C "Ausblendbedingungen fuer Fehlerpfad Dfp_MeUnCDSCGnd" VALUE 0xCB374 Kw_Wu8 255.0 OneToOne 0.00 255.0 FORMAT "%5.1" /end CHARACTERISTIC
/begin CHARACTERISTIC DSM_FMKDfp_MeUnCD_ADC_C "Ausblendbedingungen fuer Fehlerpfad Dfp_MeUnCD_ADC" VALUE 0xCB375 Kw_Wu8 255.0 OneToOne 0.00 255.0 FORMAT "%5.1" /end CHARACTERISTIC
/begin CHARACTERISTIC DSM_FMKDfp_MeUnCD_SigTst_C "Ausblendbedingungen fuer Fehlerpfad Dfp_MeUnCD_SigTst" VALUE 0xCB376 Kw_Wu8 255.0 OneToOne 0.00 255.0 FORMAT "%5.1" /end CHARACTERISTIC
/begin CHARACTERISTIC DSM_FMKDfp_Montr_C "Ausblendbedingungen fuer Fehlerpfad Dfp_Montr" VALUE 0xCB377 Kw_Wu8 255.0 OneToOne 0.00 255.0 FORMAT "%5.1" /end CHARACTERISTIC
/begin CHARACTERISTIC DSM_FMKDfp_NetMngDeviceA_C "Ausblendbedingungen fuer Fehlerpfad Dfp_NetMngDeviceA" VALUE 0xCB378 Kw_Wu8 255.0 OneToOne 0.00 255.0 FORMAT "%5.1" /end CHARACTERISTIC
/begin CHARACTERISTIC DSM_FMKDfp_NetMngDeviceB_C "Ausblendbedingungen fuer Fehlerpfad Dfp_NetMngDeviceB" VALUE 0xCB379 Kw_Wu8 255.0 OneToOne 0.00 255.0 FORMAT "%5.1" /end CHARACTERISTIC
/begin CHARACTERISTIC DSM_FMKDfp_NetMngDeviceC_C "Ausblendbedingungen fuer Fehlerpfad Dfp_NetMngDeviceC" VALUE 0xCB37A Kw_Wu8 255.0 OneToOne 0.00 255.0 FORMAT "%5.1" /end CHARACTERISTIC
/begin CHARACTERISTIC DSM_FMKDfp_NetMngPrvCan_C "Ausblendbedingungen fuer Fehlerpfad Dfp_NetMngPrvCan" VALUE 0xCB37B Kw_Wu8 255.0 OneToOne 0.00 255.0 FORMAT "%5.1" /end CHARACTERISTIC
/begin CHARACTERISTIC DSM_FMKDfp_NetMngPrvCanSlave_C "Ausblendbedingungen fuer Fehlerpfad Dfp_NetMngPrvCanSlave" VALUE 0xCB37C Kw_Wu8 255.0 OneToOne 0.00 255.0 FORMAT "%5.1" /end CHARACTERISTIC
/begin CHARACTERISTIC DSM_FMKDfp_NetMngPtCan_C "Ausblendbedingungen fuer Fehlerpfad Dfp_NetMngPtCan" VALUE 0xCB37D Kw_Wu8 255.0 OneToOne 0.00 255.0 FORMAT "%5.1" /end CHARACTERISTIC
/begin CHARACTERISTIC DSM_FMKDfp_NetMngPtCanSlave_C "Ausblendbedingungen fuer Fehlerpfad Dfp_NetMngPtCanSlave" VALUE 0xCB37E Kw_Wu8 255.0 OneToOne 0.00 255.0 FORMAT "%5.1" /end CHARACTERISTIC
/begin CHARACTERISTIC DSM_FMKDfp_OPSCD_Lamp_C "Ausblendbedingungen fuer Fehlerpfad Dfp_OPSCD_Lamp" VALUE 0xCB37F Kw_Wu8 255.0 OneToOne 0.00 255.0 FORMAT "%5.1" /end CHARACTERISTIC
/begin CHARACTERISTIC DSM_FMKDfp_OPSCD_anain_C "Ausblendbedingungen fuer Fehlerpfad Dfp_OPSCD_anain" VALUE 0xCB380 Kw_Wu8 255.0 OneToOne 0.00 255.0 FORMAT "%5.1" /end CHARACTERISTIC
/begin CHARACTERISTIC DSM_FMKDfp_OTSCD_C "Ausblendbedingungen fuer Fehlerpfad Dfp_OTSCD" VALUE 0xCB381 Kw_Wu8 255.0 OneToOne 0.00 255.0 FORMAT "%5.1" /end CHARACTERISTIC
/begin CHARACTERISTIC DSM_FMKDfp_OvRMon_C "Ausblendbedingungen fuer Fehlerpfad Dfp_OvRMon" VALUE 0xCB382 Kw_Wu8 255.0 OneToOne 0.00 255.0 FORMAT "%5.1" /end CHARACTERISTIC
/begin CHARACTERISTIC DSM_FMKDfp_OvRMonSigA_C "Ausblendbedingungen fuer Fehlerpfad Dfp_OvRMonSigA" VALUE 0xCB383 Kw_Wu8 255.0 OneToOne 0.00 255.0 FORMAT "%5.1" /end CHARACTERISTIC
/begin CHARACTERISTIC DSM_FMKDfp_OxiCCDTPreB1_C "Ausblendbedingungen fuer Fehlerpfad Dfp_OxiCCDTPreB1" VALUE 0xCB384 Kw_Wu8 255.0 OneToOne 0.00 255.0 FORMAT "%5.1" /end CHARACTERISTIC
/begin CHARACTERISTIC DSM_FMKDfp_OxiCCDTPreB2_C "Ausblendbedingungen fuer Fehlerpfad Dfp_OxiCCDTPreB2" VALUE 0xCB385 Kw_Wu8 255.0 OneToOne 0.00 255.0 FORMAT "%5.1" /end CHARACTERISTIC
/begin CHARACTERISTIC DSM_FMKDfp_PCBS_C "Ausblendbedingungen fuer Fehlerpfad Dfp_PCBS" VALUE 0xCB386 Kw_Wu8 255.0 OneToOne 0.00 255.0 FORMAT "%5.1" /end CHARACTERISTIC
/begin CHARACTERISTIC DSM_FMKDfp_PCR_BalGvnr_C "Ausblendbedingungen fuer Fehlerpfad Dfp_PCR_BalGvnr" VALUE 0xCB387 Kw_Wu8 255.0 OneToOne 0.00 255.0 FORMAT "%5.1" /end CHARACTERISTIC
/begin CHARACTERISTIC DSM_FMKDfp_PCR_GovDevNeg_C "Ausblendbedingungen fuer Fehlerpfad Dfp_PCR_GovDevNeg" VALUE 0xCB388 Kw_Wu8 255.0 OneToOne 0.00 255.0 FORMAT "%5.1" /end CHARACTERISTIC
/begin CHARACTERISTIC DSM_FMKDfp_PCR_GovDevPos_C "Ausblendbedingungen fuer Fehlerpfad Dfp_PCR_GovDevPos" VALUE 0xCB389 Kw_Wu8 255.0 OneToOne 0.00 255.0 FORMAT "%5.1" /end CHARACTERISTIC
/begin CHARACTERISTIC DSM_FMKDfp_PCR_LPGvnrDvtNeg_C "Ausblendbedingungen fuer Fehlerpfad Dfp_PCR_LPGvnrDvtNeg" VALUE 0xCB38A Kw_Wu8 255.0 OneToOne 0.00 255.0 FORMAT "%5.1" /end CHARACTERISTIC
/begin CHARACTERISTIC DSM_FMKDfp_PCR_LPGvnrDvtPos_C "Ausblendbedingungen fuer Fehlerpfad Dfp_PCR_LPGvnrDvtPos" VALUE 0xCB38B Kw_Wu8 255.0 OneToOne 0.00 255.0 FORMAT "%5.1" /end CHARACTERISTIC
/begin CHARACTERISTIC DSM_FMKDfp_PCVCDNoLoad_C "Ausblendbedingungen fuer Fehlerpfad Dfp_PCVCDNoLoad" VALUE 0xCB38C Kw_Wu8 255.0 OneToOne 0.00 255.0 FORMAT "%5.1" /end CHARACTERISTIC
/begin CHARACTERISTIC DSM_FMKDfp_PCVCDSCBat_C "Ausblendbedingungen fuer Fehlerpfad Dfp_PCVCDSCBat" VALUE 0xCB38D Kw_Wu8 255.0 OneToOne 0.00 255.0 FORMAT "%5.1" /end CHARACTERISTIC
/begin CHARACTERISTIC DSM_FMKDfp_PCVCDSCGnd_C "Ausblendbedingungen fuer Fehlerpfad Dfp_PCVCDSCGnd" VALUE 0xCB38E Kw_Wu8 255.0 OneToOne 0.00 255.0 FORMAT "%5.1" /end CHARACTERISTIC
/begin CHARACTERISTIC DSM_FMKDfp_PCVCD_ADC_C "Ausblendbedingungen fuer Fehlerpfad Dfp_PCVCD_ADC" VALUE 0xCB38F Kw_Wu8 255.0 OneToOne 0.00 255.0 FORMAT "%5.1" /end CHARACTERISTIC
/begin CHARACTERISTIC DSM_FMKDfp_PCVCD_SigTst_C "Ausblendbedingungen fuer Fehlerpfad Dfp_PCVCD_SigTst" VALUE 0xCB390 Kw_Wu8 255.0 OneToOne 0.00 255.0 FORMAT "%5.1" /end CHARACTERISTIC
/begin CHARACTERISTIC DSM_FMKDfp_PFltAPSPlaus_C "Ausblendbedingungen fuer Fehlerpfad Dfp_PFltAPSPlaus" VALUE 0xCB391 Kw_Wu8 255.0 OneToOne 0.00 255.0 FORMAT "%5.1" /end CHARACTERISTIC
/begin CHARACTERISTIC DSM_FMKDfp_PFltAPSensB1_C "Ausblendbedingungen fuer Fehlerpfad Dfp_PFltAPSensB1" VALUE 0xCB392 Kw_Wu8 255.0 OneToOne 0.00 255.0 FORMAT "%5.1" /end CHARACTERISTIC
/begin CHARACTERISTIC DSM_FMKDfp_PFltAPSensB2_C "Ausblendbedingungen fuer Fehlerpfad Dfp_PFltAPSensB2" VALUE 0xCB393 Kw_Wu8 255.0 OneToOne 0.00 255.0 FORMAT "%5.1" /end CHARACTERISTIC
/begin CHARACTERISTIC DSM_FMKDfp_PFltBPSPlaus_C "Ausblendbedingungen fuer Fehlerpfad Dfp_PFltBPSPlaus" VALUE 0xCB394 Kw_Wu8 255.0 OneToOne 0.00 255.0 FORMAT "%5.1" /end CHARACTERISTIC
/begin CHARACTERISTIC DSM_FMKDfp_PFltCDPPreB1_C "Ausblendbedingungen fuer Fehlerpfad Dfp_PFltCDPPreB1" VALUE 0xCB395 Kw_Wu8 255.0 OneToOne 0.00 255.0 FORMAT "%5.1" /end CHARACTERISTIC
/begin CHARACTERISTIC DSM_FMKDfp_PFltCDPPreB2_C "Ausblendbedingungen fuer Fehlerpfad Dfp_PFltCDPPreB2" VALUE 0xCB396 Kw_Wu8 255.0 OneToOne 0.00 255.0 FORMAT "%5.1" /end CHARACTERISTIC
/begin CHARACTERISTIC DSM_FMKDfp_PFltCDTPreB1_C "Ausblendbedingungen fuer Fehlerpfad Dfp_PFltCDTPreB1" VALUE 0xCB397 Kw_Wu8 255.0 OneToOne 0.00 255.0 FORMAT "%5.1" /end CHARACTERISTIC
/begin CHARACTERISTIC DSM_FMKDfp_PFltCDTPreB2_C "Ausblendbedingungen fuer Fehlerpfad Dfp_PFltCDTPreB2" VALUE 0xCB398 Kw_Wu8 255.0 OneToOne 0.00 255.0 FORMAT "%5.1" /end CHARACTERISTIC
/begin CHARACTERISTIC DSM_FMKDfp_PFltCharB1_C "Ausblendbedingungen fuer Fehlerpfad Dfp_PFltCharB1" VALUE 0xCB399 Kw_Wu8 255.0 OneToOne 0.00 255.0 FORMAT "%5.1" /end CHARACTERISTIC
/begin CHARACTERISTIC DSM_FMKDfp_PFltCharB2_C "Ausblendbedingungen fuer Fehlerpfad Dfp_PFltCharB2" VALUE 0xCB39A Kw_Wu8 255.0 OneToOne 0.00 255.0 FORMAT "%5.1" /end CHARACTERISTIC
/begin CHARACTERISTIC DSM_FMKDfp_PFltDltOxiPreTwFlw_C "Ausblendbedingungen fuer Fehlerpfad Dfp_PFltDltOxiPreTwFlw" VALUE 0xCB39B Kw_Wu8 255.0 OneToOne 0.00 255.0 FORMAT "%5.1" /end CHARACTERISTIC
/begin CHARACTERISTIC DSM_FMKDfp_PFltDltPreTwFlw_C "Ausblendbedingungen fuer Fehlerpfad Dfp_PFltDltPreTwFlw" VALUE 0xCB39C Kw_Wu8 255.0 OneToOne 0.00 255.0 FORMAT "%5.1" /end CHARACTERISTIC
/begin CHARACTERISTIC DSM_FMKDfp_PFltEngPrtB1_C "Ausblendbedingungen fuer Fehlerpfad Dfp_PFltEngPrtB1" VALUE 0xCB39D Kw_Wu8 255.0 OneToOne 0.00 255.0 FORMAT "%5.1" /end CHARACTERISTIC
/begin CHARACTERISTIC DSM_FMKDfp_PFltEngPrtB2_C "Ausblendbedingungen fuer Fehlerpfad Dfp_PFltEngPrtB2" VALUE 0xCB39E Kw_Wu8 255.0 OneToOne 0.00 255.0 FORMAT "%5.1" /end CHARACTERISTIC
/begin CHARACTERISTIC DSM_FMKDfp_PFltOvldInhRgnB1_C "Ausblendbedingungen fuer Fehlerpfad Dfp_PFltOvldInhRgnB1" VALUE 0xCB39F Kw_Wu8 255.0 OneToOne 0.00 255.0 FORMAT "%5.1" /end CHARACTERISTIC
/begin CHARACTERISTIC DSM_FMKDfp_PFltOvldInhRgnB2_C "Ausblendbedingungen fuer Fehlerpfad Dfp_PFltOvldInhRgnB2" VALUE 0xCB3A0 Kw_Wu8 255.0 OneToOne 0.00 255.0 FORMAT "%5.1" /end CHARACTERISTIC
/begin CHARACTERISTIC DSM_FMKDfp_PFltOvldTrqLimB1_C "Ausblendbedingungen fuer Fehlerpfad Dfp_PFltOvldTrqLimB1" VALUE 0xCB3A1 Kw_Wu8 255.0 OneToOne 0.00 255.0 FORMAT "%5.1" /end CHARACTERISTIC
/begin CHARACTERISTIC DSM_FMKDfp_PFltOvldTrqLimB2_C "Ausblendbedingungen fuer Fehlerpfad Dfp_PFltOvldTrqLimB2" VALUE 0xCB3A2 Kw_Wu8 255.0 OneToOne 0.00 255.0 FORMAT "%5.1" /end CHARACTERISTIC
/begin CHARACTERISTIC DSM_FMKDfp_PFltPresDynPlausB1_C "Ausblendbedingungen fuer Fehlerpfad Dfp_PFltPresDynPlausB1" VALUE 0xCB3A3 Kw_Wu8 255.0 OneToOne 0.00 255.0 FORMAT "%5.1" /end CHARACTERISTIC
/begin CHARACTERISTIC DSM_FMKDfp_PFltPresDynPlausB2_C "Ausblendbedingungen fuer Fehlerpfad Dfp_PFltPresDynPlausB2" VALUE 0xCB3A4 Kw_Wu8 255.0 OneToOne 0.00 255.0 FORMAT "%5.1" /end CHARACTERISTIC
/begin CHARACTERISTIC DSM_FMKDfp_PFltPresPlausB1_C "Ausblendbedingungen fuer Fehlerpfad Dfp_PFltPresPlausB1" VALUE 0xCB3A5 Kw_Wu8 255.0 OneToOne 0.00 255.0 FORMAT "%5.1" /end CHARACTERISTIC
/begin CHARACTERISTIC DSM_FMKDfp_PFltPresPlausB2_C "Ausblendbedingungen fuer Fehlerpfad Dfp_PFltPresPlausB2" VALUE 0xCB3A6 Kw_Wu8 255.0 OneToOne 0.00 255.0 FORMAT "%5.1" /end CHARACTERISTIC
/begin CHARACTERISTIC DSM_FMKDfp_PFltPresSensB1_C "Ausblendbedingungen fuer Fehlerpfad Dfp_PFltPresSensB1" VALUE 0xCB3A7 Kw_Wu8 255.0 OneToOne 0.00 255.0 FORMAT "%5.1" /end CHARACTERISTIC
/begin CHARACTERISTIC DSM_FMKDfp_PFltPresSensB2_C "Ausblendbedingungen fuer Fehlerpfad Dfp_PFltPresSensB2" VALUE 0xCB3A8 Kw_Wu8 255.0 OneToOne 0.00 255.0 FORMAT "%5.1" /end CHARACTERISTIC
/begin CHARACTERISTIC DSM_FMKDfp_PFltPresSensFrz_C "Ausblendbedingungen fuer Fehlerpfad Dfp_PFltPresSensFrz" VALUE 0xCB3A9 Kw_Wu8 255.0 OneToOne 0.00 255.0 FORMAT "%5.1" /end CHARACTERISTIC
/begin CHARACTERISTIC DSM_FMKDfp_PFltPresSensHsLnB1_C "Ausblendbedingungen fuer Fehlerpfad Dfp_PFltPresSensHsLnB1" VALUE 0xCB3AA Kw_Wu8 255.0 OneToOne 0.00 255.0 FORMAT "%5.1" /end CHARACTERISTIC
/begin CHARACTERISTIC DSM_FMKDfp_PFltPresSensHsLnB2_C "Ausblendbedingungen fuer Fehlerpfad Dfp_PFltPresSensHsLnB2" VALUE 0xCB3AB Kw_Wu8 255.0 OneToOne 0.00 255.0 FORMAT "%5.1" /end CHARACTERISTIC
/begin CHARACTERISTIC DSM_FMKDfp_PFltPresSensSotB1_C "Ausblendbedingungen fuer Fehlerpfad Dfp_PFltPresSensSotB1" VALUE 0xCB3AC Kw_Wu8 255.0 OneToOne 0.00 255.0 FORMAT "%5.1" /end CHARACTERISTIC
/begin CHARACTERISTIC DSM_FMKDfp_PFltPresSensSotB2_C "Ausblendbedingungen fuer Fehlerpfad Dfp_PFltPresSensSotB2" VALUE 0xCB3AD Kw_Wu8 255.0 OneToOne 0.00 255.0 FORMAT "%5.1" /end CHARACTERISTIC
/begin CHARACTERISTIC DSM_FMKDfp_PFltRgnPerm_C "Ausblendbedingungen fuer Fehlerpfad Dfp_PFltRgnPerm" VALUE 0xCB3AE Kw_Wu8 255.0 OneToOne 0.00 255.0 FORMAT "%5.1" /end CHARACTERISTIC
/begin CHARACTERISTIC DSM_FMKDfp_PFltTempDwnStrmB1_C "Ausblendbedingungen fuer Fehlerpfad Dfp_PFltTempDwnStrmB1" VALUE 0xCB3AF Kw_Wu8 255.0 OneToOne 0.00 255.0 FORMAT "%5.1" /end CHARACTERISTIC
/begin CHARACTERISTIC DSM_FMKDfp_PFltTempDwnStrmB2_C "Ausblendbedingungen fuer Fehlerpfad Dfp_PFltTempDwnStrmB2" VALUE 0xCB3B0 Kw_Wu8 255.0 OneToOne 0.00 255.0 FORMAT "%5.1" /end CHARACTERISTIC
/begin CHARACTERISTIC DSM_FMKDfp_PFltTempSensB1_C "Ausblendbedingungen fuer Fehlerpfad Dfp_PFltTempSensB1" VALUE 0xCB3B1 Kw_Wu8 255.0 OneToOne 0.00 255.0 FORMAT "%5.1" /end CHARACTERISTIC
/begin CHARACTERISTIC DSM_FMKDfp_PFltTempSensB2_C "Ausblendbedingungen fuer Fehlerpfad Dfp_PFltTempSensB2" VALUE 0xCB3B2 Kw_Wu8 255.0 OneToOne 0.00 255.0 FORMAT "%5.1" /end CHARACTERISTIC
/begin CHARACTERISTIC DSM_FMKDfp_PFltTempUpStrmB1_C "Ausblendbedingungen fuer Fehlerpfad Dfp_PFltTempUpStrmB1" VALUE 0xCB3B3 Kw_Wu8 255.0 OneToOne 0.00 255.0 FORMAT "%5.1" /end CHARACTERISTIC
/begin CHARACTERISTIC DSM_FMKDfp_PFltTempUpStrmB2_C "Ausblendbedingungen fuer Fehlerpfad Dfp_PFltTempUpStrmB2" VALUE 0xCB3B4 Kw_Wu8 255.0 OneToOne 0.00 255.0 FORMAT "%5.1" /end CHARACTERISTIC
/begin CHARACTERISTIC DSM_FMKDfp_PFlt_tOxiPreMaxB1_C "Ausblendbedingungen fuer Fehlerpfad Dfp_PFlt_tOxiPreMaxB1" VALUE 0xCB3B5 Kw_Wu8 255.0 OneToOne 0.00 255.0 FORMAT "%5.1" /end CHARACTERISTIC
/begin CHARACTERISTIC DSM_FMKDfp_PFlt_tOxiPreMaxB2_C "Ausblendbedingungen fuer Fehlerpfad Dfp_PFlt_tOxiPreMaxB2" VALUE 0xCB3B6 Kw_Wu8 255.0 OneToOne 0.00 255.0 FORMAT "%5.1" /end CHARACTERISTIC
/begin CHARACTERISTIC DSM_FMKDfp_PFlt_tOxiPreMxRgnB1_C "Ausblendbedingungen fuer Fehlerpfad Dfp_PFlt_tOxiPreMxRgnB1" VALUE 0xCB3B7 Kw_Wu8 255.0 OneToOne 0.00 255.0 FORMAT "%5.1" /end CHARACTERISTIC
/begin CHARACTERISTIC DSM_FMKDfp_PFlt_tOxiPreMxRgnB2_C "Ausblendbedingungen fuer Fehlerpfad Dfp_PFlt_tOxiPreMxRgnB2" VALUE 0xCB3B8 Kw_Wu8 255.0 OneToOne 0.00 255.0 FORMAT "%5.1" /end CHARACTERISTIC
/begin CHARACTERISTIC DSM_FMKDfp_PFlt_tPreMaxB1_C "Ausblendbedingungen fuer Fehlerpfad Dfp_PFlt_tPreMaxB1" VALUE 0xCB3B9 Kw_Wu8 255.0 OneToOne 0.00 255.0 FORMAT "%5.1" /end CHARACTERISTIC
/begin CHARACTERISTIC DSM_FMKDfp_PFlt_tPreMaxB2_C "Ausblendbedingungen fuer Fehlerpfad Dfp_PFlt_tPreMaxB2" VALUE 0xCB3BA Kw_Wu8 255.0 OneToOne 0.00 255.0 FORMAT "%5.1" /end CHARACTERISTIC
/begin CHARACTERISTIC DSM_FMKDfp_PFlt_tPreMaxRgnB1_C "Ausblendbedingungen fuer Fehlerpfad Dfp_PFlt_tPreMaxRgnB1" VALUE 0xCB3BB Kw_Wu8 255.0 OneToOne 0.00 255.0 FORMAT "%5.1" /end CHARACTERISTIC
/begin CHARACTERISTIC DSM_FMKDfp_PFlt_tPreMaxRgnB2_C "Ausblendbedingungen fuer Fehlerpfad Dfp_PFlt_tPreMaxRgnB2" VALUE 0xCB3BC Kw_Wu8 255.0 OneToOne 0.00 255.0 FORMAT "%5.1" /end CHARACTERISTIC
/begin CHARACTERISTIC DSM_FMKDfp_PFltmSotDiffMaxB1_C "Ausblendbedingungen fuer Fehlerpfad Dfp_PFltmSotDiffMaxB1" VALUE 0xCB3BD Kw_Wu8 255.0 OneToOne 0.00 255.0 FORMAT "%5.1" /end CHARACTERISTIC
/begin CHARACTERISTIC DSM_FMKDfp_PFltmSotDiffMaxB2_C "Ausblendbedingungen fuer Fehlerpfad Dfp_PFltmSotDiffMaxB2" VALUE 0xCB3BE Kw_Wu8 255.0 OneToOne 0.00 255.0 FORMAT "%5.1" /end CHARACTERISTIC
/begin CHARACTERISTIC DSM_FMKDfp_PresPlausDblDef_C "Ausblendbedingungen fuer Fehlerpfad Dfp_PresPlausDblDef" VALUE 0xCB3BF Kw_Wu8 255.0 OneToOne 0.00 255.0 FORMAT "%5.1" /end CHARACTERISTIC
/begin CHARACTERISTIC DSM_FMKDfp_QLTCD_C "Ausblendbedingungen fuer Fehlerpfad Dfp_QLTCD" VALUE 0xCB3C0 Kw_Wu8 255.0 OneToOne 0.00 255.0 FORMAT "%5.1" /end CHARACTERISTIC
/begin CHARACTERISTIC DSM_FMKDfp_RailCD_C "Ausblendbedingungen fuer Fehlerpfad Dfp_RailCD" VALUE 0xCB3C1 Kw_Wu8 255.0 OneToOne 0.00 255.0 FORMAT "%5.1" /end CHARACTERISTIC
/begin CHARACTERISTIC DSM_FMKDfp_RailCDOfsTst_C "Ausblendbedingungen fuer Fehlerpfad Dfp_RailCDOfsTst" VALUE 0xCB3C2 Kw_Wu8 255.0 OneToOne 0.00 255.0 FORMAT "%5.1" /end CHARACTERISTIC
/begin CHARACTERISTIC DSM_FMKDfp_RailCD_PMonStrt_C "Ausblendbedingungen fuer Fehlerpfad Dfp_RailCD_PMonStrt" VALUE 0xCB3C3 Kw_Wu8 255.0 OneToOne 0.00 255.0 FORMAT "%5.1" /end CHARACTERISTIC
/begin CHARACTERISTIC DSM_FMKDfp_RailCPC1_C "Ausblendbedingungen fuer Fehlerpfad Dfp_RailCPC1" VALUE 0xCB3C4 Kw_Wu8 255.0 OneToOne 0.00 255.0 FORMAT "%5.1" /end CHARACTERISTIC
/begin CHARACTERISTIC DSM_FMKDfp_RailCPC3_C "Ausblendbedingungen fuer Fehlerpfad Dfp_RailCPC3" VALUE 0xCB3C5 Kw_Wu8 255.0 OneToOne 0.00 255.0 FORMAT "%5.1" /end CHARACTERISTIC
/begin CHARACTERISTIC DSM_FMKDfp_RailCPC4_C "Ausblendbedingungen fuer Fehlerpfad Dfp_RailCPC4" VALUE 0xCB3C6 Kw_Wu8 255.0 OneToOne 0.00 255.0 FORMAT "%5.1" /end CHARACTERISTIC
/begin CHARACTERISTIC DSM_FMKDfp_RailCtlModeMeUnDiag_C "Ausblendbedingungen fuer Fehlerpfad Dfp_RailCtlModeMeUnDiag" VALUE 0xCB3C7 Kw_Wu8 255.0 OneToOne 0.00 255.0 FORMAT "%5.1" /end CHARACTERISTIC
/begin CHARACTERISTIC DSM_FMKDfp_RailCtlModePCVDiag_C "Ausblendbedingungen fuer Fehlerpfad Dfp_RailCtlModePCVDiag" VALUE 0xCB3C8 Kw_Wu8 255.0 OneToOne 0.00 255.0 FORMAT "%5.1" /end CHARACTERISTIC
/begin CHARACTERISTIC DSM_FMKDfp_RailMeUn0_C "Ausblendbedingungen fuer Fehlerpfad Dfp_RailMeUn0" VALUE 0xCB3C9 Kw_Wu8 255.0 OneToOne 0.00 255.0 FORMAT "%5.1" /end CHARACTERISTIC
/begin CHARACTERISTIC DSM_FMKDfp_RailMeUn1_C "Ausblendbedingungen fuer Fehlerpfad Dfp_RailMeUn1" VALUE 0xCB3CA Kw_Wu8 255.0 OneToOne 0.00 255.0 FORMAT "%5.1" /end CHARACTERISTIC
/begin CHARACTERISTIC DSM_FMKDfp_RailMeUn2_C "Ausblendbedingungen fuer Fehlerpfad Dfp_RailMeUn2" VALUE 0xCB3CB Kw_Wu8 255.0 OneToOne 0.00 255.0 FORMAT "%5.1" /end CHARACTERISTIC
/begin CHARACTERISTIC DSM_FMKDfp_RailMeUn3_C "Ausblendbedingungen fuer Fehlerpfad Dfp_RailMeUn3" VALUE 0xCB3CC Kw_Wu8 255.0 OneToOne 0.00 255.0 FORMAT "%5.1" /end CHARACTERISTIC
/begin CHARACTERISTIC DSM_FMKDfp_RailMeUn4_C "Ausblendbedingungen fuer Fehlerpfad Dfp_RailMeUn4" VALUE 0xCB3CD Kw_Wu8 255.0 OneToOne 0.00 255.0 FORMAT "%5.1" /end CHARACTERISTIC
/begin CHARACTERISTIC DSM_FMKDfp_RailPCV0_C "Ausblendbedingungen fuer Fehlerpfad Dfp_RailPCV0" VALUE 0xCB3CE Kw_Wu8 255.0 OneToOne 0.00 255.0 FORMAT "%5.1" /end CHARACTERISTIC
/begin CHARACTERISTIC DSM_FMKDfp_RailPCV1_C "Ausblendbedingungen fuer Fehlerpfad Dfp_RailPCV1" VALUE 0xCB3CF Kw_Wu8 255.0 OneToOne 0.00 255.0 FORMAT "%5.1" /end CHARACTERISTIC
/begin CHARACTERISTIC DSM_FMKDfp_RailPCV2_C "Ausblendbedingungen fuer Fehlerpfad Dfp_RailPCV2" VALUE 0xCB3D0 Kw_Wu8 255.0 OneToOne 0.00 255.0 FORMAT "%5.1" /end CHARACTERISTIC
/begin CHARACTERISTIC DSM_FMKDfp_RailPCV3_C "Ausblendbedingungen fuer Fehlerpfad Dfp_RailPCV3" VALUE 0xCB3D1 Kw_Wu8 255.0 OneToOne 0.00 255.0 FORMAT "%5.1" /end CHARACTERISTIC
/begin CHARACTERISTIC DSM_FMKDfp_RailPCV4_C "Ausblendbedingungen fuer Fehlerpfad Dfp_RailPCV4" VALUE 0xCB3D2 Kw_Wu8 255.0 OneToOne 0.00 255.0 FORMAT "%5.1" /end CHARACTERISTIC
/begin CHARACTERISTIC DSM_FMKDfp_RailPCV5_C "Ausblendbedingungen fuer Fehlerpfad Dfp_RailPCV5" VALUE 0xCB3D3 Kw_Wu8 255.0 OneToOne 0.00 255.0 FORMAT "%5.1" /end CHARACTERISTIC
/begin CHARACTERISTIC DSM_FMKDfp_SOPTst_C "Ausblendbedingungen fuer Fehlerpfad Dfp_SOPTst" VALUE 0xCB3D4 Kw_Wu8 255.0 OneToOne 0.00 255.0 FORMAT "%5.1" /end CHARACTERISTIC
/begin CHARACTERISTIC DSM_FMKDfp_SSpMon1_C "Ausblendbedingungen fuer Fehlerpfad Dfp_SSpMon1" VALUE 0xCB3D5 Kw_Wu8 255.0 OneToOne 0.00 255.0 FORMAT "%5.1" /end CHARACTERISTIC
/begin CHARACTERISTIC DSM_FMKDfp_SSpMon2_C "Ausblendbedingungen fuer Fehlerpfad Dfp_SSpMon2" VALUE 0xCB3D6 Kw_Wu8 255.0 OneToOne 0.00 255.0 FORMAT "%5.1" /end CHARACTERISTIC
/begin CHARACTERISTIC DSM_FMKDfp_SSpMon3_C "Ausblendbedingungen fuer Fehlerpfad Dfp_SSpMon3" VALUE 0xCB3D7 Kw_Wu8 255.0 OneToOne 0.00 255.0 FORMAT "%5.1" /end CHARACTERISTIC
/begin CHARACTERISTIC DSM_FMKDfp_SSpMon4_C "Ausblendbedingungen fuer Fehlerpfad Dfp_SSpMon4" VALUE 0xCB3D8 Kw_Wu8 255.0 OneToOne 0.00 255.0 FORMAT "%5.1" /end CHARACTERISTIC
/begin CHARACTERISTIC DSM_FMKDfp_SSpMon5_C "Ausblendbedingungen fuer Fehlerpfad Dfp_SSpMon5" VALUE 0xCB3D9 Kw_Wu8 255.0 OneToOne 0.00 255.0 FORMAT "%5.1" /end CHARACTERISTIC
/begin CHARACTERISTIC DSM_FMKDfp_SSpMon6_C "Ausblendbedingungen fuer Fehlerpfad Dfp_SSpMon6" VALUE 0xCB3DA Kw_Wu8 255.0 OneToOne 0.00 255.0 FORMAT "%5.1" /end CHARACTERISTIC
/begin CHARACTERISTIC DSM_FMKDfp_SWChk_CycSigChkDat_C "Ausblendbedingungen fuer Fehlerpfad Dfp_SWChk_CycSigChkDat" VALUE 0xCB3DB Kw_Wu8 255.0 OneToOne 0.00 255.0 FORMAT "%5.1" /end CHARACTERISTIC
/begin CHARACTERISTIC DSM_FMKDfp_SWChk_CycSigChkPrg_C "Ausblendbedingungen fuer Fehlerpfad Dfp_SWChk_CycSigChkPrg" VALUE 0xCB3DC Kw_Wu8 255.0 OneToOne 0.00 255.0 FORMAT "%5.1" /end CHARACTERISTIC
/begin CHARACTERISTIC DSM_FMKDfp_StSysTrqShutOff_C "Ausblendbedingungen fuer Fehlerpfad Dfp_StSysTrqShutOff" VALUE 0xCB3DD Kw_Wu8 255.0 OneToOne 0.00 255.0 FORMAT "%5.1" /end CHARACTERISTIC
/begin CHARACTERISTIC DSM_FMKDfp_StrtCD_Actr_C "Ausblendbedingungen fuer Fehlerpfad Dfp_StrtCD_Actr" VALUE 0xCB3DE Kw_Wu8 255.0 OneToOne 0.00 255.0 FORMAT "%5.1" /end CHARACTERISTIC
/begin CHARACTERISTIC DSM_FMKDfp_SysLamp_C "Ausblendbedingungen fuer Fehlerpfad Dfp_SysLamp" VALUE 0xCB3DF Kw_Wu8 255.0 OneToOne 0.00 255.0 FORMAT "%5.1" /end CHARACTERISTIC
/begin CHARACTERISTIC DSM_FMKDfp_T15CD_C "Ausblendbedingungen fuer Fehlerpfad Dfp_T15CD" VALUE 0xCB3E0 Kw_Wu8 255.0 OneToOne 0.00 255.0 FORMAT "%5.1" /end CHARACTERISTIC
/begin CHARACTERISTIC DSM_FMKDfp_TGearbx_C "Ausblendbedingungen fuer Fehlerpfad Dfp_TGearbx" VALUE 0xCB3E1 Kw_Wu8 255.0 OneToOne 0.00 255.0 FORMAT "%5.1" /end CHARACTERISTIC
/begin CHARACTERISTIC DSM_FMKDfp_TPUMon_C "Ausblendbedingungen fuer Fehlerpfad Dfp_TPUMon" VALUE 0xCB3E2 Kw_Wu8 255.0 OneToOne 0.00 255.0 FORMAT "%5.1" /end CHARACTERISTIC
/begin CHARACTERISTIC DSM_FMKDfp_TVACD_AirMon1_C "Ausblendbedingungen fuer Fehlerpfad Dfp_TVACD_AirMon1" VALUE 0xCB3E3 Kw_Wu8 255.0 OneToOne 0.00 255.0 FORMAT "%5.1" /end CHARACTERISTIC
/begin CHARACTERISTIC DSM_FMKDfp_TVACD_AirMon2_C "Ausblendbedingungen fuer Fehlerpfad Dfp_TVACD_AirMon2" VALUE 0xCB3E4 Kw_Wu8 255.0 OneToOne 0.00 255.0 FORMAT "%5.1" /end CHARACTERISTIC
/begin CHARACTERISTIC DSM_FMKDfp_TVACD_Max_C "Ausblendbedingungen fuer Fehlerpfad Dfp_TVACD_Max" VALUE 0xCB3E5 Kw_Wu8 255.0 OneToOne 0.00 255.0 FORMAT "%5.1" /end CHARACTERISTIC
/begin CHARACTERISTIC DSM_FMKDfp_TVACD_Max2_C "Ausblendbedingungen fuer Fehlerpfad Dfp_TVACD_Max2" VALUE 0xCB3E6 Kw_Wu8 255.0 OneToOne 0.00 255.0 FORMAT "%5.1" /end CHARACTERISTIC
/begin CHARACTERISTIC DSM_FMKDfp_TVACD_Min_C "Ausblendbedingungen fuer Fehlerpfad Dfp_TVACD_Min" VALUE 0xCB3E7 Kw_Wu8 255.0 OneToOne 0.00 255.0 FORMAT "%5.1" /end CHARACTERISTIC
/begin CHARACTERISTIC DSM_FMKDfp_TVACD_Min2_C "Ausblendbedingungen fuer Fehlerpfad Dfp_TVACD_Min2" VALUE 0xCB3E8 Kw_Wu8 255.0 OneToOne 0.00 255.0 FORMAT "%5.1" /end CHARACTERISTIC
/begin CHARACTERISTIC DSM_FMKDfp_TVACD_SigNpl_C "Ausblendbedingungen fuer Fehlerpfad Dfp_TVACD_SigNpl" VALUE 0xCB3E9 Kw_Wu8 255.0 OneToOne 0.00 255.0 FORMAT "%5.1" /end CHARACTERISTIC
/begin CHARACTERISTIC DSM_FMKDfp_TVACD_SigNpl2_C "Ausblendbedingungen fuer Fehlerpfad Dfp_TVACD_SigNpl2" VALUE 0xCB3EA Kw_Wu8 255.0 OneToOne 0.00 255.0 FORMAT "%5.1" /end CHARACTERISTIC
/begin CHARACTERISTIC DSM_FMKDfp_TVACD_TVADia1_C "Ausblendbedingungen fuer Fehlerpfad Dfp_TVACD_TVADia1" VALUE 0xCB3EB Kw_Wu8 255.0 OneToOne 0.00 255.0 FORMAT "%5.1" /end CHARACTERISTIC
/begin CHARACTERISTIC DSM_FMKDfp_TVACD_TVADia2_C "Ausblendbedingungen fuer Fehlerpfad Dfp_TVACD_TVADia2" VALUE 0xCB3EC Kw_Wu8 255.0 OneToOne 0.00 255.0 FORMAT "%5.1" /end CHARACTERISTIC
/begin CHARACTERISTIC DSM_FMKDfp_TVACD_TVADia21_C "Ausblendbedingungen fuer Fehlerpfad Dfp_TVACD_TVADia21" VALUE 0xCB3ED Kw_Wu8 255.0 OneToOne 0.00 255.0 FORMAT "%5.1" /end CHARACTERISTIC
/begin CHARACTERISTIC DSM_FMKDfp_TVACD_TVADia22_C "Ausblendbedingungen fuer Fehlerpfad Dfp_TVACD_TVADia22" VALUE 0xCB3EE Kw_Wu8 255.0 OneToOne 0.00 255.0 FORMAT "%5.1" /end CHARACTERISTIC
/begin CHARACTERISTIC DSM_FMKDfp_TVACD_TVADia23_C "Ausblendbedingungen fuer Fehlerpfad Dfp_TVACD_TVADia23" VALUE 0xCB3EF Kw_Wu8 255.0 OneToOne 0.00 255.0 FORMAT "%5.1" /end CHARACTERISTIC
/begin CHARACTERISTIC DSM_FMKDfp_TVACD_TVADia24_C "Ausblendbedingungen fuer Fehlerpfad Dfp_TVACD_TVADia24" VALUE 0xCB3F0 Kw_Wu8 255.0 OneToOne 0.00 255.0 FORMAT "%5.1" /end CHARACTERISTIC
/begin CHARACTERISTIC DSM_FMKDfp_TVACD_TVADia3_C "Ausblendbedingungen fuer Fehlerpfad Dfp_TVACD_TVADia3" VALUE 0xCB3F1 Kw_Wu8 255.0 OneToOne 0.00 255.0 FORMAT "%5.1" /end CHARACTERISTIC
/begin CHARACTERISTIC DSM_FMKDfp_TVACD_TVADia4_C "Ausblendbedingungen fuer Fehlerpfad Dfp_TVACD_TVADia4" VALUE 0xCB3F2 Kw_Wu8 255.0 OneToOne 0.00 255.0 FORMAT "%5.1" /end CHARACTERISTIC
/begin CHARACTERISTIC DSM_FMKDfp_ThrVlvMon_C "Ausblendbedingungen fuer Fehlerpfad Dfp_ThrVlvMon" VALUE 0xCB3F3 Kw_Wu8 255.0 OneToOne 0.00 255.0 FORMAT "%5.1" /end CHARACTERISTIC
/begin CHARACTERISTIC DSM_FMKDfp_VSACD_DiaDet_C "Ausblendbedingungen fuer Fehlerpfad Dfp_VSACD_DiaDet" VALUE 0xCB3F4 Kw_Wu8 255.0 OneToOne 0.00 255.0 FORMAT "%5.1" /end CHARACTERISTIC
/begin CHARACTERISTIC DSM_FMKDfp_VSACD_DioInDia1_C "Ausblendbedingungen fuer Fehlerpfad Dfp_VSACD_DioInDia1" VALUE 0xCB3F5 Kw_Wu8 255.0 OneToOne 0.00 255.0 FORMAT "%5.1" /end CHARACTERISTIC
/begin CHARACTERISTIC DSM_FMKDfp_VSACD_DioInDia2_C "Ausblendbedingungen fuer Fehlerpfad Dfp_VSACD_DioInDia2" VALUE 0xCB3F6 Kw_Wu8 255.0 OneToOne 0.00 255.0 FORMAT "%5.1" /end CHARACTERISTIC
/begin CHARACTERISTIC DSM_FMKDfp_VSACD_DioInDia3_C "Ausblendbedingungen fuer Fehlerpfad Dfp_VSACD_DioInDia3" VALUE 0xCB3F7 Kw_Wu8 255.0 OneToOne 0.00 255.0 FORMAT "%5.1" /end CHARACTERISTIC
/begin CHARACTERISTIC DSM_FMKDfp_VSACD_DioInDia4_C "Ausblendbedingungen fuer Fehlerpfad Dfp_VSACD_DioInDia4" VALUE 0xCB3F8 Kw_Wu8 255.0 OneToOne 0.00 255.0 FORMAT "%5.1" /end CHARACTERISTIC
/begin CHARACTERISTIC DSM_FMKDfp_VSACD_DioInMin_C "Ausblendbedingungen fuer Fehlerpfad Dfp_VSACD_DioInMin" VALUE 0xCB3F9 Kw_Wu8 255.0 OneToOne 0.00 255.0 FORMAT "%5.1" /end CHARACTERISTIC
/begin CHARACTERISTIC DSM_FMKDfp_VSACD_Max_C "Ausblendbedingungen fuer Fehlerpfad Dfp_VSACD_Max" VALUE 0xCB3FA Kw_Wu8 255.0 OneToOne 0.00 255.0 FORMAT "%5.1" /end CHARACTERISTIC
/begin CHARACTERISTIC DSM_FMKDfp_VSACD_Min_C "Ausblendbedingungen fuer Fehlerpfad Dfp_VSACD_Min" VALUE 0xCB3FB Kw_Wu8 255.0 OneToOne 0.00 255.0 FORMAT "%5.1" /end CHARACTERISTIC
/begin CHARACTERISTIC DSM_FMKDfp_VSACD_SigNpl_C "Ausblendbedingungen fuer Fehlerpfad Dfp_VSACD_SigNpl" VALUE 0xCB3FC Kw_Wu8 255.0 OneToOne 0.00 255.0 FORMAT "%5.1" /end CHARACTERISTIC
/begin CHARACTERISTIC DSM_FMKDfp_VSACD_VSADia1_C "Ausblendbedingungen fuer Fehlerpfad Dfp_VSACD_VSADia1" VALUE 0xCB3FD Kw_Wu8 255.0 OneToOne 0.00 255.0 FORMAT "%5.1" /end CHARACTERISTIC
/begin CHARACTERISTIC DSM_FMKDfp_VSACD_VSADia2_C "Ausblendbedingungen fuer Fehlerpfad Dfp_VSACD_VSADia2" VALUE 0xCB3FE Kw_Wu8 255.0 OneToOne 0.00 255.0 FORMAT "%5.1" /end CHARACTERISTIC
/begin CHARACTERISTIC DSM_FMKDfp_VSACD_VSADia3_C "Ausblendbedingungen fuer Fehlerpfad Dfp_VSACD_VSADia3" VALUE 0xCB3FF Kw_Wu8 255.0 OneToOne 0.00 255.0 FORMAT "%5.1" /end CHARACTERISTIC
/begin CHARACTERISTIC DSM_FMKDfp_VSACD_VSADia4_C "Ausblendbedingungen fuer Fehlerpfad Dfp_VSACD_VSADia4" VALUE 0xCB400 Kw_Wu8 255.0 OneToOne 0.00 255.0 FORMAT "%5.1" /end CHARACTERISTIC
/begin CHARACTERISTIC DSM_FMKDfp_VSSCD1_C "Ausblendbedingungen fuer Fehlerpfad Dfp_VSSCD1" VALUE 0xCB401 Kw_Wu8 255.0 OneToOne 0.00 255.0 FORMAT "%5.1" /end CHARACTERISTIC
/begin CHARACTERISTIC DSM_FMKDfp_VSSCD2_C "Ausblendbedingungen fuer Fehlerpfad Dfp_VSSCD2" VALUE 0xCB402 Kw_Wu8 255.0 OneToOne 0.00 255.0 FORMAT "%5.1" /end CHARACTERISTIC
/begin CHARACTERISTIC DSM_FMKDfp_WdCom_C "Ausblendbedingungen fuer Fehlerpfad Dfp_WdCom" VALUE 0xCB403 Kw_Wu8 255.0 OneToOne 0.00 255.0 FORMAT "%5.1" /end CHARACTERISTIC
/begin CHARACTERISTIC DSM_FrzFrEnvironment_C "Freeze frame, Auswahl der Umweltbedingungen" VAL_BLK 0xCB1D0 Kwb_Wu16 255.000000000 SigName 0.00 255.000000000 FORMAT "%13.9" NUMBER 11 /end CHARACTERISTIC
/begin CHARACTERISTIC DSM_SIG_Rec1_C "Label mit Signalnummer, die während Recovery beschrieben werden" VALUE 0xCB1E6 Kw_Wu8 255.000000000 SigName 0.00 255.000000000 FORMAT "%13.9" READ_ONLY /end CHARACTERISTIC
/begin CHARACTERISTIC DSM_SIG_Rec2_C "Label mit Signalnummer, die während Recovery beschrieben werden" VALUE 0xCB1E7 Kw_Wu8 255.000000000 SigName 0.00 255.000000000 FORMAT "%13.9" READ_ONLY /end CHARACTERISTIC
/begin CHARACTERISTIC DSM_SIG_Rec3_C "Label mit Signalnummer, die während Recovery beschrieben werden" VALUE 0xCB1E8 Kw_Wu8 255.000000000 SigName 0.00 255.000000000 FORMAT "%13.9" READ_ONLY /end CHARACTERISTIC
/begin CHARACTERISTIC DSM_SIG_Rec4_C "Label mit Signalnummer, die während Recovery beschrieben werden" VALUE 0xCB1E9 Kw_Wu8 255.000000000 SigName 0.00 255.000000000 FORMAT "%13.9" READ_ONLY /end CHARACTERISTIC
/begin CHARACTERISTIC DSM_SIG_Rec5_C "Label mit Signalnummer, die während Recovery beschrieben werden" VALUE 0xCB1EA Kw_Wu8 255.000000000 SigName 0.00 255.000000000 FORMAT "%13.9" READ_ONLY /end CHARACTERISTIC
/begin CHARACTERISTIC DSM_stStepWidth_CA "Schrittweite der Ereignisentprellung der up/down counter" VAL_BLK 0xCB1EB Kwb_Wu8 255.0 OneToOne 0.00 255.0 FORMAT "%5.1" NUMBER 4 /end CHARACTERISTIC
/begin CHARACTERISTIC DSM_SysLampMode_C "Aktivierungsbedingung der System Lampe (1= aktuelle Fehler, 0 = bestätigte Fehlerspeichereinträge)" VALUE 0xCB1EF Kw_Wu8 2.00000000000 SysLampMode 0.00 2.00000000000 FORMAT "%13.11" /end CHARACTERISTIC
/begin CHARACTERISTIC DSM_tiDCMin_C "Mindestzeit für driving cycle Erkennung (Maximalwert = Nachlauf)" VALUE 0xCB1F0 Kw_Wu16 65535.00 TimeDsmDC 0.00 65535.00 FORMAT "%8.2" /end CHARACTERISTIC
/begin CHARACTERISTIC DSM_tiWucDelay_C "Zeitverzögerung für die Abtasung der Kühlwassertemperatur bei Start zur Warm Up Cycle Ermittlung" VALUE 0xCB1F2 Kw_Wu16 655350.0 Time_ms 0.00 655350.0 FORMAT "%8.1" /end CHARACTERISTIC
/begin CHARACTERISTIC DSM_WucMinDiff_C "Minimale Differenztemperatur für warm up cycle" VALUE 0xCB1F4 Kw_Ws16 6553.500 TempDiff_Cels -3276.800 3276.700 FORMAT "%8.3" /end CHARACTERISTIC
/begin CHARACTERISTIC DSM_WucMinTemp_C "Minimaltemperatur für warm up cycle" VALUE 0xCB1F6 Kw_Ws16 950.000 Temp_Cels -50.140 899.860 FORMAT "%8.3" EXTENDED_LIMITS -3549.940 3003.560 /end CHARACTERISTIC
/begin MEASUREMENT DSMDur_ctDfctDur1 "Wert Fehlerdauerzähler" UWORD OneToOne 1 100 0.00 65535.00 FORMAT "%8.2" ECU_ADDRESS 0x7F8C6E /end MEASUREMENT
/begin MEASUREMENT DSMDur_ctDfctDur2 "Wert Fehlerdauerzähler 2" UWORD OneToOne 1 100 0.00 65535.00 FORMAT "%8.2" ECU_ADDRESS 0x7F8C70 /end MEASUREMENT
/begin MEASUREMENT DSMDur_stGlobalDefCnt_mp "Aktivierungs und Resetzustand der beiden globalen Fehlerdauerzähler" UBYTE OneToOne 1 100 0.00 255.0 FORMAT "%5.1" ECU_ADDRESS 0x6F80B0 /end MEASUREMENT
/begin FUNCTION dsm ""
 /begin DEF_CHARACTERISTIC DSM_cnvMilKmFCM_Offset_C DSM_cnvMilKmFCM_Slope_C DSM_Class1Mil_C DSM_Class1TFlc_C DSM_Class1Flc_C DSM_Class1THlc_C DSM_Class1Hlc_C DSM_Class1Scatt_C DSM_Class1TDlcPen_C DSM_Class1DlcPen_C DSM_Class1TDlc_C DSM_Class1DlcKd_C DSM_Class1Dlc_C DSM_Class1Prio_C DSM_Class1SysLamp_C DSM_Class1ResErf_C DSM_Class1Readiness_C DSM_Class2Mil_C DSM_Class2TFlc_C DSM_Class2Flc_C DSM_Class2THlc_C DSM_Class2Hlc_C DSM_Class2Scatt_C DSM_Class2TDlcPen_C DSM_Class2DlcPen_C DSM_Class2TDlc_C DSM_Class2DlcKd_C DSM_Class2Dlc_C DSM_Class2Prio_C DSM_Class2SysLamp_C DSM_Class2ResErf_C DSM_Class2Readiness_C DSM_Class3Mil_C DSM_Class3TFlc_C DSM_Class3Flc_C DSM_Class3THlc_C DSM_Class3Hlc_C DSM_Class3Scatt_C DSM_Class3TDlcPen_C DSM_Class3DlcPen_C DSM_Class3TDlc_C DSM_Class3DlcKd_C DSM_Class3Dlc_C DSM_Class3Prio_C DSM_Class3SysLamp_C DSM_Class3ResErf_C DSM_Class3Readiness_C DSM_Class4Mil_C DSM_Class4TFlc_C DSM_Class4Flc_C DSM_Class4THlc_C DSM_Class4Hlc_C DSM_Class4Scatt_C DSM_Class4TDlcPen_C DSM_Class4DlcPen_C DSM_Class4TDlc_C DSM_Class4DlcKd_C DSM_Class4Dlc_C DSM_Class4Prio_C DSM_Class4SysLamp_C DSM_Class4ResErf_C DSM_Class4Readiness_C DSM_Class5Mil_C DSM_Class5TFlc_C DSM_Class5Flc_C DSM_Class5THlc_C DSM_Class5Hlc_C DSM_Class5Scatt_C DSM_Class5TDlcPen_C DSM_Class5DlcPen_C DSM_Class5TDlc_C DSM_Class5DlcKd_C DSM_Class5Dlc_C DSM_Class5Prio_C DSM_Class5SysLamp_C DSM_Class5ResErf_C DSM_Class5Readiness_C DSM_Class6Mil_C DSM_Class6TFlc_C DSM_Class6Flc_C DSM_Class6THlc_C DSM_Class6Hlc_C DSM_Class6Scatt_C DSM_Class6TDlcPen_C DSM_Class6DlcPen_C DSM_Class6TDlc_C DSM_Class6DlcKd_C DSM_Class6Dlc_C DSM_Class6Prio_C DSM_Class6SysLamp_C DSM_Class6ResErf_C DSM_Class6Readiness_C DSM_Class7Mil_C DSM_Class7TFlc_C DSM_Class7Flc_C DSM_Class7THlc_C DSM_Class7Hlc_C DSM_Class7Scatt_C DSM_Class7TDlcPen_C DSM_Class7DlcPen_C DSM_Class7TDlc_C DSM_Class7DlcKd_C DSM_Class7Dlc_C DSM_Class7Prio_C DSM_Class7SysLamp_C DSM_Class7ResErf_C DSM_Class7Readiness_C DSM_Class8Mil_C DSM_Class8TFlc_C DSM_Class8Flc_C DSM_Class8THlc_C DSM_Class8Hlc_C DSM_Class8Scatt_C DSM_Class8TDlcPen_C DSM_Class8DlcPen_C DSM_Class8TDlc_C DSM_Class8DlcKd_C DSM_Class8Dlc_C DSM_Class8Prio_C DSM_Class8SysLamp_C DSM_Class8ResErf_C DSM_Class8Readiness_C DSM_Class9Mil_C DSM_Class9TFlc_C DSM_Class9Flc_C DSM_Class9THlc_C DSM_Class9Hlc_C DSM_Class9Scatt_C DSM_Class9TDlcPen_C DSM_Class9DlcPen_C DSM_Class9TDlc_C DSM_Class9DlcKd_C DSM_Class9Dlc_C DSM_Class9Prio_C DSM_Class9SysLamp_C DSM_Class9ResErf_C DSM_Class9Readiness_C DSM_Class10Mil_C DSM_Class10TFlc_C DSM_Class10Flc_C DSM_Class10THlc_C DSM_Class10Hlc_C DSM_Class10Scatt_C DSM_Class10TDlcPen_C DSM_Class10DlcPen_C DSM_Class10TDlc_C DSM_Class10DlcKd_C DSM_Class10Dlc_C DSM_Class10Prio_C DSM_Class10SysLamp_C DSM_Class10ResErf_C DSM_Class10Readiness_C DSM_Class11Mil_C DSM_Class11TFlc_C DSM_Class11Flc_C DSM_Class11THlc_C DSM_Class11Hlc_C DSM_Class11Scatt_C DSM_Class11TDlcPen_C DSM_Class11DlcPen_C DSM_Class11TDlc_C DSM_Class11DlcKd_C DSM_Class11Dlc_C DSM_Class11Prio_C DSM_Class11SysLamp_C DSM_Class11ResErf_C DSM_Class11Readiness_C DSM_Class12Mil_C DSM_Class12TFlc_C DSM_Class12Flc_C DSM_Class12THlc_C DSM_Class12Hlc_C DSM_Class12Scatt_C DSM_Class12TDlcPen_C DSM_Class12DlcPen_C DSM_Class12TDlc_C DSM_Class12DlcKd_C DSM_Class12Dlc_C DSM_Class12Prio_C DSM_Class12SysLamp_C DSM_Class12ResErf_C DSM_Class12Readiness_C DSM_Class13Mil_C DSM_Class13TFlc_C DSM_Class13Flc_C DSM_Class13THlc_C DSM_Class13Hlc_C DSM_Class13Scatt_C DSM_Class13TDlcPen_C DSM_Class13DlcPen_C DSM_Class13TDlc_C DSM_Class13DlcKd_C DSM_Class13Dlc_C DSM_Class13Prio_C DSM_Class13SysLamp_C DSM_Class13ResErf_C DSM_Class13Readiness_C DSM_Class14Mil_C DSM_Class14TFlc_C DSM_Class14Flc_C DSM_Class14THlc_C DSM_Class14Hlc_C DSM_Class14Scatt_C DSM_Class14TDlcPen_C DSM_Class14DlcPen_C DSM_Class14TDlc_C DSM_Class14DlcKd_C DSM_Class14Dlc_C DSM_Class14Prio_C DSM_Class14SysLamp_C DSM_Class14ResErf_C DSM_Class14Readiness_C DSM_Class15Mil_C DSM_Class15TFlc_C DSM_Class15Flc_C DSM_Class15THlc_C DSM_Class15Hlc_C DSM_Class15Scatt_C DSM_Class15TDlcPen_C DSM_Class15DlcPen_C DSM_Class15TDlc_C DSM_Class15DlcKd_C DSM_Class15Dlc_C DSM_Class15Prio_C DSM_Class15SysLamp_C DSM_Class15ResErf_C DSM_Class15Readiness_C DSM_Class16Mil_C DSM_Class16TFlc_C DSM_Class16Flc_C DSM_Class16THlc_C DSM_Class16Hlc_C DSM_Class16Scatt_C DSM_Class16TDlcPen_C DSM_Class16DlcPen_C DSM_Class16TDlc_C DSM_Class16DlcKd_C DSM_Class16Dlc_C DSM_Class16Prio_C DSM_Class16SysLamp_C DSM_Class16ResErf_C DSM_Class16Readiness_C DSM_Class17Mil_C DSM_Class17TFlc_C DSM_Class17Flc_C DSM_Class17THlc_C DSM_Class17Hlc_C DSM_Class17Scatt_C DSM_Class17TDlcPen_C DSM_Class17DlcPen_C DSM_Class17TDlc_C DSM_Class17DlcKd_C DSM_Class17Dlc_C DSM_Class17Prio_C DSM_Class17SysLamp_C DSM_Class17ResErf_C DSM_Class17Readiness_C DSM_Class18Mil_C DSM_Class18TFlc_C DSM_Class18Flc_C DSM_Class18THlc_C DSM_Class18Hlc_C DSM_Class18Scatt_C DSM_Class18TDlcPen_C DSM_Class18DlcPen_C DSM_Class18TDlc_C DSM_Class18DlcKd_C DSM_Class18Dlc_C DSM_Class18Prio_C DSM_Class18SysLamp_C DSM_Class18ResErf_C DSM_Class18Readiness_C DSM_Class19Mil_C DSM_Class19TFlc_C DSM_Class19Flc_C DSM_Class19THlc_C DSM_Class19Hlc_C DSM_Class19Scatt_C DSM_Class19TDlcPen_C DSM_Class19DlcPen_C DSM_Class19TDlc_C DSM_Class19DlcKd_C DSM_Class19Dlc_C DSM_Class19Prio_C DSM_Class19SysLamp_C DSM_Class19ResErf_C DSM_Class19Readiness_C DSM_Class20Mil_C DSM_Class20TFlc_C DSM_Class20Flc_C DSM_Class20THlc_C DSM_Class20Hlc_C DSM_Class20Scatt_C DSM_Class20TDlcPen_C DSM_Class20DlcPen_C DSM_Class20TDlc_C DSM_Class20DlcKd_C DSM_Class20Dlc_C DSM_Class20Prio_C DSM_Class20SysLamp_C DSM_Class20ResErf_C DSM_Class20Readiness_C DSM_FCMClear_C DSM_FrzFrEnvironment_C DSM_SIG_Rec1_C DSM_SIG_Rec2_C DSM_SIG_Rec3_C DSM_SIG_Rec4_C DSM_SIG_Rec5_C DSM_stStepWidth_CA DSM_SysLampMode_C DSM_tiDCMin_C DSM_tiWucDelay_C DSM_WucMinDiff_C DSM_WucMinTemp_C /end DEF_CHARACTERISTIC
/end FUNCTION
/begin FUNCTION dsmdur ""
 /begin DEF_CHARACTERISTIC DSMDur_DfctDur1Mode_C DSMDur_DfctDur2Mode_C DSMDur_stDfctDur1Enable_C DSMDur_stDfctDur2Enable_C DSMDur_stDfctDur1Reset_C DSMDur_stDfctDur2Reset_C /end DEF_CHARACTERISTIC
/end FUNCTION
/begin FUNCTION dsmdur_msg "" /begin OUT_MEASUREMENT DSMDur_ctDfctDur1 DSMDur_ctDfctDur2 /end OUT_MEASUREMENT /end FUNCTION
/begin FUNCTION dsmdur_uic "" /begin OUT_MEASUREMENT DSMDur_stGlobalDefCnt_mp /end OUT_MEASUREMENT /end FUNCTION
/begin FUNCTION dsm_auto_blk ""
 /begin DEF_CHARACTERISTIC DSM_FMKDfp_Layer_TANS_C DSM_FMKDfp_ACCDSwtin_C DSM_FMKDfp_ACC_PlausTrqDes_C DSM_FMKDfp_ACC_trqInr_C DSM_FMKDfp_ACTrq_C DSM_FMKDfp_ADCMon_C DSM_FMKDfp_AFSCDIdlAdjVal_C DSM_FMKDfp_AFSCDLdAdjVal_C DSM_FMKDfp_AFSCDPlAirPerCylDif_C DSM_FMKDfp_AFSCD_AirTempDcyc_C DSM_FMKDfp_AFSCD_AirTempDcyc2_C DSM_FMKDfp_AFSCD_PlOffsDrft_C DSM_FMKDfp_AFSCD_PlOffsDrft2_C DSM_FMKDfp_AFSCD_PlSetyDrft_C DSM_FMKDfp_AFSCD_SRCAirTemp_C DSM_FMKDfp_AFSCD_SRCAirTemp2_C DSM_FMKDfp_AFSCD_SRCBatt_C DSM_FMKDfp_AFSCD_SRCBatt2_C DSM_FMKDfp_AFSCD_SRCCorrAirm_C DSM_FMKDfp_Layer_TUMG_C DSM_FMKDfp_AFSCD_SRCCorrAirm2_C DSM_FMKDfp_AFSCD_SRCRawAirm_C DSM_FMKDfp_Layer_GEN_C DSM_FMKDfp_Layer_BSD_C DSM_FMKDfp_AFSCD_SRCRawAirm2_C DSM_FMKDfp_AFSCD_SRCRefSigPer_C DSM_FMKDfp_AFSCD_SRCRefSigPer2_C DSM_FMKDfp_AOHtCD_C DSM_FMKDfp_AOHtCD_AOHtDia1_C DSM_FMKDfp_AOHtCD_AOHtDia2_C DSM_FMKDfp_AOHtCD_AOHtDia3_C DSM_FMKDfp_APP1_C DSM_FMKDfp_APP2_C DSM_FMKDfp_APPCDCmpd_C DSM_FMKDfp_Layer_QLT_C DSM_FMKDfp_APPSync_C DSM_FMKDfp_Layer_IBS1_C DSM_FMKDfp_Layer_IBS2_C DSM_FMKDfp_Layer_IBS3_C DSM_FMKDfp_Layer_PMBN_C DSM_FMKDfp_Layer_PMBATT_C DSM_FMKDfp_APSCD_C DSM_FMKDfp_ARS_C DSM_FMKDfp_AccPedPlausBrk_C DSM_FMKDfp_AddPCDTnkLvl_C DSM_FMKDfp_AirCtlGvnrDvtRgnMax_C DSM_FMKDfp_AirCtlGvnrDvtRgnMin_C DSM_FMKDfp_AirCtlGvnrDvtRgnMn2_C DSM_FMKDfp_AirCtlGvnrDvtRgnMx2_C DSM_FMKDfp_AirCtlPlateBreak_C DSM_FMKDfp_AirCtlRmpTO_C DSM_FMKDfp_AirCtl_GovNegDev_C DSM_FMKDfp_AirCtl_GovNegDev2_C DSM_FMKDfp_AirCtl_GovPosDev_C DSM_FMKDfp_AirCtl_GovPosDev2_C DSM_FMKDfp_AltCD_C DSM_FMKDfp_BPACD_BPADia1_C DSM_FMKDfp_BPACD_BPADia1v2_C DSM_FMKDfp_BPACD_BPADia2_C DSM_FMKDfp_BPACD_BPADia2v2_C DSM_FMKDfp_BPACD_BPADia3_C DSM_FMKDfp_BPACD_BPADia3v2_C DSM_FMKDfp_BPACD_BPADia4_C DSM_FMKDfp_BPACD_BPADia4v2_C DSM_FMKDfp_BPACD_Max_C DSM_FMKDfp_BPACD_Max2_C DSM_FMKDfp_BPACD_Min_C DSM_FMKDfp_BPACD_Min2_C DSM_FMKDfp_BPACD_SigNpl_C DSM_FMKDfp_BPACD_SigNpl2_C DSM_FMKDfp_BPSCD_C DSM_FMKDfp_BattCD_C DSM_FMKDfp_BrkCD_C DSM_FMKDfp_Layer_PMRUHVERL_C DSM_FMKDfp_Bss_C DSM_FMKDfp_CBACD_C DSM_FMKDfp_CTSCD_C DSM_FMKDfp_Clg_DynTst_C DSM_FMKDfp_Layer_TOENS_C DSM_FMKDfp_Layer_MANHYDR_C DSM_FMKDfp_Layer_MANLUFT_C DSM_FMKDfp_CmbChbMisfire1_C DSM_FMKDfp_CmbChbMisfire2_C DSM_FMKDfp_CmbChbMisfire3_C DSM_FMKDfp_CmbChbMisfire4_C DSM_FMKDfp_CmbChbMisfire5_C DSM_FMKDfp_CmbChbMisfire6_C DSM_FMKDfp_CmbChbMisfire7_C DSM_FMKDfp_CmbChbMisfire8_C DSM_FMKDfp_CmbChbMisfireMul_C DSM_FMKDfp_CoDT_TRQ_Des_C DSM_FMKDfp_CoDT_TRQ_Lead_C DSM_FMKDfp_CoEng_GbxRpmRduc_C DSM_FMKDfp_CoVMDCSh_C DSM_FMKDfp_ConvCD_C DSM_FMKDfp_CrCCDMFL_C DSM_FMKDfp_CrCtl_vCrCtl_C DSM_FMKDfp_EATSCD_C DSM_FMKDfp_EBAFCD_C DSM_FMKDfp_EBFCD_C DSM_FMKDfp_EBTSCD_C DSM_FMKDfp_EBTSCD_OvrTemp_C DSM_FMKDfp_EEPCDVarMng_C DSM_FMKDfp_EGPpCD_C DSM_FMKDfp_EGRCD_Max_C DSM_FMKDfp_EGRCD_Max2_C DSM_FMKDfp_EGRCD_Min_C DSM_FMKDfp_EGRCD_Min2_C DSM_FMKDfp_EGRCD_PWMInDia1_C DSM_FMKDfp_EGRCD_PWMInDia2_C DSM_FMKDfp_EGRCD_PWMInDia21_C DSM_FMKDfp_EGRCD_PWMInDia22_C DSM_FMKDfp_EGRCD_PWMInDia23_C DSM_FMKDfp_EGRCD_PWMInDia24_C DSM_FMKDfp_EGRCD_PWMInDia3_C DSM_FMKDfp_EGRCD_PWMInDia4_C DSM_FMKDfp_EGRCD_SigDia_C DSM_FMKDfp_EGRCD_SigDia2_C DSM_FMKDfp_EGRCD_SigNpl_C DSM_FMKDfp_EGRCD_SigNpl2_C DSM_FMKDfp_EGTOilLvlCrit_C DSM_FMKDfp_EGTOilVscCrit_C DSM_FMKDfp_EGTRgnOilDil_C DSM_FMKDfp_EGTTempGvnrInrB1_C DSM_FMKDfp_EGTTempGvnrInrB2_C DSM_FMKDfp_EGTTempGvnrOutrB1_C DSM_FMKDfp_EGTTempGvnrOutrB2_C DSM_FMKDfp_ETClbETFltInj1_C DSM_FMKDfp_ETClbETFltInj2_C DSM_FMKDfp_ETClbETFltInj3_C DSM_FMKDfp_ETClbETFltInj4_C DSM_FMKDfp_ETClbETFltInj5_C DSM_FMKDfp_ETClbETFltInj6_C DSM_FMKDfp_ETClbETFltInj7_C DSM_FMKDfp_ETClbETFltInj8_C DSM_FMKDfp_ETClbInj1_C DSM_FMKDfp_ETClbInj2_C DSM_FMKDfp_ETClbInj3_C DSM_FMKDfp_ETClbInj4_C DSM_FMKDfp_ETClbInj5_C DSM_FMKDfp_ETClbInj6_C DSM_FMKDfp_ETClbInj7_C DSM_FMKDfp_ETClbInj8_C DSM_FMKDfp_EngMCaS1_C DSM_FMKDfp_EngMCrS1_C DSM_FMKDfp_EngMOfsCaSCrS_C DSM_FMKDfp_EngMntCtlCD_C DSM_FMKDfp_FBCqDvt_C DSM_FMKDfp_FMAErrMod_C DSM_FMKDfp_FMTC_NonMonotonMap_C DSM_FMKDfp_FTSCD_C DSM_FMKDfp_FanCD_C DSM_FMKDfp_FanCD_FanCtlr1_C DSM_FMKDfp_FanCD_FanCtlr2_C DSM_FMKDfp_FanCD_FanCtlr3_C DSM_FMKDfp_FlFCD_C DSM_FMKDfp_FlMngSmkDefect_C DSM_FMKDfp_FlSCDT1_C DSM_FMKDfp_FrmMngANFRADMOMPT_C DSM_FMKDfp_FrmMngASC1_C DSM_FMKDfp_FrmMngASC2_C DSM_FMKDfp_FrmMngASC3_C DSM_FMKDfp_FrmMngASC4_C DSM_FMKDfp_FrmMngBOS_RESET_C DSM_FMKDfp_FrmMngBOS_RESET2_C DSM_FMKDfp_FrmMngDMANFAFS_C DSM_FMKDfp_FrmMngDRMANFSSG_C DSM_FMKDfp_FrmMngEGS1_C DSM_FMKDfp_FrmMngEGS2_C DSM_FMKDfp_FrmMngGEARBX_DATA_C DSM_FMKDfp_FrmMngGEARBX_DATA2_C DSM_FMKDfp_FrmMngHEAT_AC_C DSM_FMKDfp_FrmMngINSTR2_C DSM_FMKDfp_FrmMngINSTR3_C DSM_FMKDfp_FrmMngLENKRADWINKEL_C DSM_FMKDfp_FrmMngMILEAGE_RANGE_C DSM_FMKDfp_FrmMngMSPHISYNC_C DSM_FMKDfp_FrmMngMST4_C DSM_FMKDfp_FrmMngMST5_C DSM_FMKDfp_FrmMngOPCRCTLACC_C DSM_FMKDfp_FrmMngPRGG_CCTR_C DSM_FMKDfp_FrmMngPWRMNG_LOADV_C DSM_FMKDfp_FrmMngParkConsumer_C DSM_FMKDfp_FrmMngRQSTGEFAN_C DSM_FMKDfp_FrmMngSLV4_C DSM_FMKDfp_FrmMngSLV5_C DSM_FMKDfp_FrmMngSSGErr_C DSM_FMKDfp_FrmMngSSGShOff_C DSM_FMKDfp_FrmMngSTAT_ANH_C DSM_FMKDfp_FrmMngSTAT_ARS_C DSM_FMKDfp_FrmMngSTAT_DSC_C DSM_FMKDfp_FrmMngSTAT_EKP_C DSM_FMKDfp_FrmMngSTAT_KOMBI_C DSM_FMKDfp_FrmMngSTAT_SITZ_C DSM_FMKDfp_FrmMngStOBDGbxMilOf_C DSM_FMKDfp_FrmMngStOBDGbxMilOn_C DSM_FMKDfp_FrmMngTEMPRELTIME_C DSM_FMKDfp_FrmMngTERMINAL_C DSM_FMKDfp_FrmMngTIME_DATE_C DSM_FMKDfp_FrmMngTORQUE_DSC_C DSM_FMKDfp_FrmMngTORQUE_GEARBX_C DSM_FMKDfp_FrmMngTrq_ReqACC_C DSM_FMKDfp_FrmMngVEH_MOD_C DSM_FMKDfp_FrmMngVELOCITY_C DSM_FMKDfp_FrmMngWHEEL_SPEED_C DSM_FMKDfp_FrmMngstCurr_C DSM_FMKDfp_FrmMngswtPSPOff_C DSM_FMKDfp_GearbxIncMax_C DSM_FMKDfp_GlwCD_C DSM_FMKDfp_GlwCDGlwCirc1_C DSM_FMKDfp_GlwCDGlwCirc2_C DSM_FMKDfp_GlwCDGlwCirc3_C DSM_FMKDfp_GlwCDGlwCirc4_C DSM_FMKDfp_GlwCDGlwCirc5_C DSM_FMKDfp_GlwCDGlwCirc6_C DSM_FMKDfp_GlwCDGlwCirc7_C DSM_FMKDfp_GlwCDGlwCirc8_C DSM_FMKDfp_GlwCtl_C DSM_FMKDfp_HWEMonCom_C DSM_FMKDfp_HWEMonEEPROM_C DSM_FMKDfp_HWEMonRcyLocked_C DSM_FMKDfp_HWEMonRcySuppressed_C DSM_FMKDfp_HWEMonRcyVisible_C DSM_FMKDfp_HWEMonUMaxSupply_C DSM_FMKDfp_HWEMonUMinSupply_C DSM_FMKDfp_IATSCD_C DSM_FMKDfp_IATSCD_CATS_C DSM_FMKDfp_IATSCD_CATSSec_C DSM_FMKDfp_ImmCtlImmCD_C DSM_FMKDfp_ImmCtlImmEep_C DSM_FMKDfp_ImmCtlMpl_C DSM_FMKDfp_IndSys1_C DSM_FMKDfp_IndSys2_C DSM_FMKDfp_InjCrv_InjLim_C DSM_FMKDfp_InjCtlAdjQnt_C DSM_FMKDfp_InjCtlDrift_C DSM_FMKDfp_InjVCDActrChrg_C DSM_FMKDfp_InjVCDActrEnrg1_C DSM_FMKDfp_InjVCDActrEnrg2_C DSM_FMKDfp_InjVCDActrEnrg3_C DSM_FMKDfp_InjVCDActrEnrg4_C DSM_FMKDfp_InjVCDActrEnrg5_C DSM_FMKDfp_InjVCDActrEnrg6_C DSM_FMKDfp_InjVCDActrEnrg7_C DSM_FMKDfp_InjVCDActrEnrg8_C DSM_FMKDfp_InjVCDActrVolt_C DSM_FMKDfp_InjVCDClsBank1_C DSM_FMKDfp_InjVCDClsBank2_C DSM_FMKDfp_InjVCDMonCab_C DSM_FMKDfp_InjVCDMonSwt_C DSM_FMKDfp_InjVCDShOffDCDC_C DSM_FMKDfp_InjVCDUBuf1_C DSM_FMKDfp_InjVCDUBuf2_C DSM_FMKDfp_InjVCD_CY370Ampl_C DSM_FMKDfp_InjVCD_DrvTime_C DSM_FMKDfp_InjVCD_DrvTimeRcy_C DSM_FMKDfp_InjVCD_TPUErr_C DSM_FMKDfp_InjVlvBnk1A_C DSM_FMKDfp_InjVlvBnk1B_C DSM_FMKDfp_InjVlvBnk2A_C DSM_FMKDfp_InjVlvBnk2B_C DSM_FMKDfp_InjVlvChipA_C DSM_FMKDfp_InjVlvChipB_C DSM_FMKDfp_InjVlvCyl1A_C DSM_FMKDfp_InjVlvCyl1B_C DSM_FMKDfp_InjVlvCyl1C_C DSM_FMKDfp_InjVlvCyl2A_C DSM_FMKDfp_InjVlvCyl2B_C DSM_FMKDfp_InjVlvCyl2C_C DSM_FMKDfp_InjVlvCyl3A_C DSM_FMKDfp_InjVlvCyl3B_C DSM_FMKDfp_InjVlvCyl3C_C DSM_FMKDfp_InjVlvCyl4A_C DSM_FMKDfp_InjVlvCyl4B_C DSM_FMKDfp_InjVlvCyl4C_C DSM_FMKDfp_InjVlvCyl5A_C DSM_FMKDfp_InjVlvCyl5B_C DSM_FMKDfp_InjVlvCyl5C_C DSM_FMKDfp_InjVlvCyl6A_C DSM_FMKDfp_InjVlvCyl6B_C DSM_FMKDfp_InjVlvCyl6C_C DSM_FMKDfp_InjVlvCyl7A_C DSM_FMKDfp_InjVlvCyl7B_C DSM_FMKDfp_InjVlvCyl7C_C DSM_FMKDfp_InjVlvCyl8A_C DSM_FMKDfp_InjVlvCyl8B_C DSM_FMKDfp_InjVlvCyl8C_C DSM_FMKDfp_InjVlvNVC1_C DSM_FMKDfp_InjVlvNVC2_C DSM_FMKDfp_InjVlvNVC3_C DSM_FMKDfp_InjVlvNVC4_C DSM_FMKDfp_InjVlvNVC5_C DSM_FMKDfp_InjVlvNVC6_C DSM_FMKDfp_InjVlvNVC7_C DSM_FMKDfp_InjVlvNVC8_C DSM_FMKDfp_KeyCheck_C DSM_FMKDfp_LIGovECUTransMode_C DSM_FMKDfp_LPACD_Max_C DSM_FMKDfp_LPACD_Min_C DSM_FMKDfp_LPACD_SigNpl_C DSM_FMKDfp_LSUCDCircNernst0B1_C DSM_FMKDfp_LSUCDCircNernst0B2_C DSM_FMKDfp_LSUCDCircPumpCur0B1_C DSM_FMKDfp_LSUCDCircPumpCur0B2_C DSM_FMKDfp_LSUCDCircVirtGnd0B1_C DSM_FMKDfp_LSUCDCircVirtGnd0B2_C DSM_FMKDfp_LSUCDHeater0B1_C DSM_FMKDfp_LSUCDHeater0B2_C DSM_FMKDfp_LSUCDHtCoup0B1_C DSM_FMKDfp_LSUCDHtCoup0B2_C DSM_FMKDfp_LSUCDO20B1_C DSM_FMKDfp_LSUCDO20B2_C DSM_FMKDfp_LSUCDO2Clb0B1_C DSM_FMKDfp_LSUCDO2Clb0B2_C DSM_FMKDfp_LSUCDRiClb0B1_C DSM_FMKDfp_LSUCDRiClb0B2_C DSM_FMKDfp_LSUCDSPI0B1_C DSM_FMKDfp_LSUCDSPI0B2_C DSM_FMKDfp_LSUCDSPIBattLow0B1_C DSM_FMKDfp_LSUCDSPIBattLow0B2_C DSM_FMKDfp_LSUCDWireIP0B1_C DSM_FMKDfp_LSUCDWireIP0B2_C DSM_FMKDfp_LSUCtlRiExc0B1_C DSM_FMKDfp_LSUCtlRiExc0B2_C DSM_FMKDfp_LSUMon1SensB1_C DSM_FMKDfp_LSUMon1SensB2_C DSM_FMKDfp_LSUMon2SensB1_C DSM_FMKDfp_LSUMon2SensB2_C DSM_FMKDfp_MIL_C DSM_FMKDfp_MRlyCD_C DSM_FMKDfp_MSMon_C DSM_FMKDfp_MSMonConsist_C DSM_FMKDfp_MSMonPFlt1_C DSM_FMKDfp_MSMonPFlt2_C DSM_FMKDfp_MSMonPFlt3_C DSM_FMKDfp_MSMonPFlt4_C DSM_FMKDfp_MSMon_ARS_TO_C DSM_FMKDfp_MSMon_AirCtl_C DSM_FMKDfp_MSMon_AirSys0_C DSM_FMKDfp_MSMon_AirSys1_C DSM_FMKDfp_MSMon_AirSys2_C DSM_FMKDfp_MSMon_AirSys3_C DSM_FMKDfp_MSMon_AirSys4_C DSM_FMKDfp_MSMon_AirSys7_C DSM_FMKDfp_MSMon_CanDef_C DSM_FMKDfp_MSMon_CoEng_OffVeh_C DSM_FMKDfp_MSMon_CoEng_Rev1_C DSM_FMKDfp_MSMon_CoEng_Rev2_C DSM_FMKDfp_MSMon_CoEng_RevMS_C DSM_FMKDfp_MSMon_DSC_TO_C DSM_FMKDfp_MSMon_EGS_TO_C DSM_FMKDfp_MSMon_FrmMngCoEng_C DSM_FMKDfp_MSMon_FrmMngPT_C DSM_FMKDfp_MSMon_FrmMngPT2_C DSM_FMKDfp_MSMon_Mil_C DSM_FMKDfp_MSMon_NetMngPtCan_C DSM_FMKDfp_MSMon_RailCDPMon_C DSM_FMKDfp_MSMon_StEGS_C DSM_FMKDfp_MSMon_SysLamp_C DSM_FMKDfp_MSMon_ZFCClbActv_C DSM_FMKDfp_MSMon_qLimErr_C DSM_FMKDfp_MSMon_trqCoDT_C DSM_FMKDfp_MSMon_trqCoVeh_C DSM_FMKDfp_MSMon_trqCoVehLim_C DSM_FMKDfp_MSMon_trqDesExt_C DSM_FMKDfp_MSMon_trqDesExtRev_C DSM_FMKDfp_MSMon_trqLimErr_C DSM_FMKDfp_MSMon_trqLimErr1_C DSM_FMKDfp_MSMon_trqLimErr2_C DSM_FMKDfp_MSMon_trqLimErr3_C DSM_FMKDfp_MSMon_trqLimErr4_C DSM_FMKDfp_MSidCD_Comm_C DSM_FMKDfp_MSidCD_EcuMixed_C DSM_FMKDfp_MSidCD_Pin_C DSM_FMKDfp_MSidCD_Sel_INI_C DSM_FMKDfp_MSidCD_Select_C DSM_FMKDfp_MSid_SwCmp_C DSM_FMKDfp_MSid_regEEPDiff_C DSM_FMKDfp_MeUnCDNoLoad_C DSM_FMKDfp_MeUnCDSCBat_C DSM_FMKDfp_MeUnCDSCGnd_C DSM_FMKDfp_MeUnCD_ADC_C DSM_FMKDfp_MeUnCD_SigTst_C DSM_FMKDfp_Montr_C DSM_FMKDfp_NetMngDeviceA_C DSM_FMKDfp_NetMngDeviceB_C DSM_FMKDfp_NetMngDeviceC_C DSM_FMKDfp_NetMngPrvCan_C DSM_FMKDfp_NetMngPrvCanSlave_C DSM_FMKDfp_NetMngPtCan_C DSM_FMKDfp_NetMngPtCanSlave_C DSM_FMKDfp_OPSCD_Lamp_C DSM_FMKDfp_OPSCD_anain_C DSM_FMKDfp_OTSCD_C DSM_FMKDfp_OvRMon_C DSM_FMKDfp_OvRMonSigA_C DSM_FMKDfp_OxiCCDTPreB1_C DSM_FMKDfp_OxiCCDTPreB2_C DSM_FMKDfp_PCBS_C DSM_FMKDfp_PCR_BalGvnr_C DSM_FMKDfp_PCR_GovDevNeg_C DSM_FMKDfp_PCR_GovDevPos_C DSM_FMKDfp_PCR_LPGvnrDvtNeg_C DSM_FMKDfp_PCR_LPGvnrDvtPos_C DSM_FMKDfp_PCVCDNoLoad_C DSM_FMKDfp_PCVCDSCBat_C DSM_FMKDfp_PCVCDSCGnd_C DSM_FMKDfp_PCVCD_ADC_C DSM_FMKDfp_PCVCD_SigTst_C DSM_FMKDfp_PFltAPSPlaus_C DSM_FMKDfp_PFltAPSensB1_C DSM_FMKDfp_PFltAPSensB2_C DSM_FMKDfp_PFltBPSPlaus_C DSM_FMKDfp_PFltCDPPreB1_C DSM_FMKDfp_PFltCDPPreB2_C DSM_FMKDfp_PFltCDTPreB1_C DSM_FMKDfp_PFltCDTPreB2_C DSM_FMKDfp_PFltCharB1_C DSM_FMKDfp_PFltCharB2_C DSM_FMKDfp_PFltDltOxiPreTwFlw_C DSM_FMKDfp_PFltDltPreTwFlw_C DSM_FMKDfp_PFltEngPrtB1_C DSM_FMKDfp_PFltEngPrtB2_C DSM_FMKDfp_PFltOvldInhRgnB1_C DSM_FMKDfp_PFltOvldInhRgnB2_C DSM_FMKDfp_PFltOvldTrqLimB1_C DSM_FMKDfp_PFltOvldTrqLimB2_C DSM_FMKDfp_PFltPresDynPlausB1_C DSM_FMKDfp_PFltPresDynPlausB2_C DSM_FMKDfp_PFltPresPlausB1_C DSM_FMKDfp_PFltPresPlausB2_C DSM_FMKDfp_PFltPresSensB1_C DSM_FMKDfp_PFltPresSensB2_C DSM_FMKDfp_PFltPresSensFrz_C DSM_FMKDfp_PFltPresSensHsLnB1_C DSM_FMKDfp_PFltPresSensHsLnB2_C DSM_FMKDfp_PFltPresSensSotB1_C DSM_FMKDfp_PFltPresSensSotB2_C DSM_FMKDfp_PFltRgnPerm_C DSM_FMKDfp_PFltTempDwnStrmB1_C DSM_FMKDfp_PFltTempDwnStrmB2_C DSM_FMKDfp_PFltTempSensB1_C DSM_FMKDfp_PFltTempSensB2_C DSM_FMKDfp_PFltTempUpStrmB1_C DSM_FMKDfp_PFltTempUpStrmB2_C DSM_FMKDfp_PFlt_tOxiPreMaxB1_C DSM_FMKDfp_PFlt_tOxiPreMaxB2_C DSM_FMKDfp_PFlt_tOxiPreMxRgnB1_C DSM_FMKDfp_PFlt_tOxiPreMxRgnB2_C DSM_FMKDfp_PFlt_tPreMaxB1_C DSM_FMKDfp_PFlt_tPreMaxB2_C DSM_FMKDfp_PFlt_tPreMaxRgnB1_C DSM_FMKDfp_PFlt_tPreMaxRgnB2_C DSM_FMKDfp_PFltmSotDiffMaxB1_C DSM_FMKDfp_PFltmSotDiffMaxB2_C DSM_FMKDfp_PresPlausDblDef_C DSM_FMKDfp_QLTCD_C DSM_FMKDfp_RailCD_C DSM_FMKDfp_RailCDOfsTst_C DSM_FMKDfp_RailCD_PMonStrt_C DSM_FMKDfp_RailCPC1_C DSM_FMKDfp_RailCPC3_C DSM_FMKDfp_RailCPC4_C DSM_FMKDfp_RailCtlModeMeUnDiag_C DSM_FMKDfp_RailCtlModePCVDiag_C DSM_FMKDfp_RailMeUn0_C DSM_FMKDfp_RailMeUn1_C DSM_FMKDfp_RailMeUn2_C DSM_FMKDfp_RailMeUn3_C DSM_FMKDfp_RailMeUn4_C DSM_FMKDfp_RailPCV0_C DSM_FMKDfp_RailPCV1_C DSM_FMKDfp_RailPCV2_C DSM_FMKDfp_RailPCV3_C DSM_FMKDfp_RailPCV4_C DSM_FMKDfp_RailPCV5_C DSM_FMKDfp_SOPTst_C DSM_FMKDfp_SSpMon1_C DSM_FMKDfp_SSpMon2_C DSM_FMKDfp_SSpMon3_C DSM_FMKDfp_SSpMon4_C DSM_FMKDfp_SSpMon5_C DSM_FMKDfp_SSpMon6_C DSM_FMKDfp_SWChk_CycSigChkDat_C DSM_FMKDfp_SWChk_CycSigChkPrg_C DSM_FMKDfp_StSysTrqShutOff_C DSM_FMKDfp_StrtCD_Actr_C DSM_FMKDfp_SysLamp_C DSM_FMKDfp_T15CD_C DSM_FMKDfp_TGearbx_C DSM_FMKDfp_TPUMon_C DSM_FMKDfp_TVACD_AirMon1_C DSM_FMKDfp_TVACD_AirMon2_C DSM_FMKDfp_TVACD_Max_C DSM_FMKDfp_TVACD_Max2_C DSM_FMKDfp_TVACD_Min_C DSM_FMKDfp_TVACD_Min2_C DSM_FMKDfp_TVACD_SigNpl_C DSM_FMKDfp_TVACD_SigNpl2_C DSM_FMKDfp_TVACD_TVADia1_C DSM_FMKDfp_TVACD_TVADia2_C DSM_FMKDfp_TVACD_TVADia21_C DSM_FMKDfp_TVACD_TVADia22_C DSM_FMKDfp_TVACD_TVADia23_C DSM_FMKDfp_TVACD_TVADia24_C DSM_FMKDfp_TVACD_TVADia3_C DSM_FMKDfp_TVACD_TVADia4_C DSM_FMKDfp_ThrVlvMon_C DSM_FMKDfp_VSACD_DiaDet_C DSM_FMKDfp_VSACD_DioInDia1_C DSM_FMKDfp_VSACD_DioInDia2_C DSM_FMKDfp_VSACD_DioInDia3_C DSM_FMKDfp_VSACD_DioInDia4_C DSM_FMKDfp_VSACD_DioInMin_C DSM_FMKDfp_VSACD_Max_C DSM_FMKDfp_VSACD_Min_C DSM_FMKDfp_VSACD_SigNpl_C DSM_FMKDfp_VSACD_VSADia1_C DSM_FMKDfp_VSACD_VSADia2_C DSM_FMKDfp_VSACD_VSADia3_C DSM_FMKDfp_VSACD_VSADia4_C DSM_FMKDfp_VSSCD1_C DSM_FMKDfp_VSSCD2_C DSM_FMKDfp_WdCom_C /end DEF_CHARACTERISTIC
/end FUNCTION
/begin COMPU_METHOD ClassTrigger "Verbale Umrechnung für DSM_Class%TFlc_C und DSM_Class%THlc_C" TAB_VERB "%6.3" "-" COMPU_TAB_REF ClassTrigger /end COMPU_METHOD
/begin COMPU_VTAB ClassTrigger "Verbale Umrechnung für DSM_Class%TFlc_C und DSM_Class%THlc_C" TAB_VERB 5 0 "no handling" 1 "time quantum" 2 "driving cycle" 3 "warm up cycle" 4 "flc driving cycle" /end COMPU_VTAB
/begin COMPU_METHOD ClassTriggerTDlc "Verbale Umrechnung für DSM_Class%TDlc_C und DSM_Class%TDlcPen_C" TAB_VERB "%6.3" "-" COMPU_TAB_REF ClassTriggerTDlc /end COMPU_METHOD
/begin COMPU_VTAB ClassTriggerTDlc "Verbale Umrechnung für DSM_Class%TDlc_C und DSM_Class%TDlcPen_C" TAB_VERB 4 0 "no handling" 1 "each afterrun_1" 2 "each afterrun_2" 3 "warm up cycle" /end COMPU_VTAB
/begin COMPU_METHOD LengthKm "Länge in Kilometer" RAT_FUNC "%6.2" "km" COEFFS 0 1 0 0 0 1 /end COMPU_METHOD
/begin COMPU_METHOD Mil "Verbale Umrechnung für DSM_Class%Mil_C" TAB_VERB "%6.3" "-" COMPU_TAB_REF Mil /end COMPU_METHOD
/begin COMPU_VTAB Mil "Verbale Umrechnung für DSM_Class%Mil_C" TAB_VERB 3 0 "Mil OFF" 1 "Mil ON" 2 "Mil BLINK" /end COMPU_VTAB
/begin COMPU_METHOD OneToOne "eins zu eins (physikalischer Wert ist gleich dem internen Wert)" RAT_FUNC "%6.2" "-" COEFFS 0 1 0 0 0 1 /end COMPU_METHOD
/begin COMPU_METHOD Readiness "Verbale Umrechnung für DSM_Class%Readiness_C" TAB_VERB "%6.3" "-" COMPU_TAB_REF Readiness /end COMPU_METHOD
/begin COMPU_VTAB Readiness "Verbale Umrechnung für DSM_Class%Readiness_C" TAB_VERB 8 0 "non" 1 "EGR system monitoring" 2 "catalyst monitoring" 4 "misfire monitoring" 8 "fuel system" 16 "comprehensive components" 32 "oxygen sensor" 64 "oxygen sensor heater" /end COMPU_VTAB
/begin COMPU_METHOD ResErf "Verbale Umrechnung für DSM_Class%ResErf_C" TAB_VERB "%6.3" "-" COMPU_TAB_REF ResErf /end COMPU_METHOD
/begin COMPU_VTAB ResErf "Verbale Umrechnung für DSM_Class%ResErf_C" TAB_VERB 4 0 "no Reset" 1 "Reset on Init" 2 "Reset on Restart" 3 "Reset on Init or Restart" /end COMPU_VTAB
/begin COMPU_METHOD Scatt "Verbale Umrechnugn für DSM_Class%Scatt_C" TAB_VERB "%6.3" "-" COMPU_TAB_REF Scatt /end COMPU_METHOD
/begin COMPU_VTAB Scatt "Verbale Umrechnugn für DSM_Class%Scatt_C" TAB_VERB 2 0 "not visible for OBD-Tester" 1 "visible for OBD-Tester" /end COMPU_VTAB
/begin COMPU_METHOD SigName "Verbale Umrechnung für Signal Referenz Nummern" TAB_VERB "%6.3" "-" COMPU_TAB_REF SigName /end COMPU_METHOD
/begin COMPU_VTAB SigName "Verbale Umrechnung für Signal Referenz Nummern" TAB_VERB 136 0 "Sig_unused" 4 "CoEng_rTrq__Carb_r_DLen1" 5 "CTSCD_tClntLin__Carb_t_DLen1" 11 "BPSCD_pLin__Carb_p_DLen1" 12 "Eng_nAvrg__Carb_n_DLen2" 13 "VSSCD_vSensVal__Carb_v_DLen1" 15 "AFSCD_tAir_mp__Carb_t_DLen1" 16 "AFSCD_dmAirRawPerTime__Carb_mAirTim_DLen2" 28 "Signals_PID0x1C_C__OneToOne_DLen1" 33 "DSMDur_ctDfctDur1__Carb_l_DLen2" 128 "AFSCD_dmAirPerTime__mAirTim_DLen2" 129 "AFSCD_mAirPerCyl__mAirCyl_DLen2" 130 "AFSCD_mAirPerCyl2__mAirCyl_DLen2" 131 "AFSCD_rAir__dcyc_DLen2" 132 "AFSCD_rAir2__dcyc_DLen2" 133 "AOHtCD_rOut_mp__dcyc_DLen2" 134 "APPCD_rFlt__r_DLen2" 135 "PFlt_pPreCorrB2_mp__p_DLen2" 137 "APPCD_uRawAPP1__u_DLen2" 138 "APPCD_uRawAPP2__u_DLen2" 139 "APSCD_pVal__p_DLen2" 140 "APSCD_uRaw__u_DLen2" 141 "AirCtl_mDesVal__mAirCyl_DLen2" 142 "AltCD_rAltLoad__r_DLen2" 143 "BPACD_rOut__dcyc_DLen2" 144 "BPACD_rOut2__dcyc_DLen2" 145 "BPSCD_pOutVal__p_DLen2" 146 "BPSCD_uRawVal__u_DLen2" 147 "BattCD_u__uBatt_DLen2" 148 "CBACD_stLogicOut_mp__OneToOne_DLen1" 149 "CTSCD_tClnt__t_DLen2" 150 "CTSCD_uRaw__u_DLen2" 151 "CoEng_trq__trq_DLen2" 152 "EBAFCD_stSigOut__OneToOne_DLen1" 153 "EGRCD_rOut__dcyc_DLen2" 154 "EGRCD_rOut2__dcyc_DLen2" 155 "EGT_st__ShftRght0Byte_DLen2" 156 "EngM_stOut__OneToOne_DLen1" 157 "EngM_stSync__OneToOne_DLen1" 158 "Eng_nAvrg__n_DLen2" 159 "FMTC_trqInr__trq_DLen2" 160 "FTSCD_tFuel__t_DLen2" 161 "FTSCD_uRaw__u_DLen2" 162 "FanCD_dcycRaw_mp__dcyc_DLen2" 163 "FlFCD_stFlFltRawVal__OneToOne_DLen1" 164 "FrmMng_nPSP__nPSPSpd_DLen2" 165 "FrmMng_rPSPSetPoint__r_DLen2" 166 "GlwCtl_rPwrOut__OneToOne_DLen1" 167 "GlwCtl_stLampOut__OneToOne_DLen1" 168 "HWEMon_numRecovery__ShftRght0Byte_DLen2" 169 "HWEMon_numRecovery__ShftRght1Byte_DLen2" 170 "HWEMon_recLocLow_mp__ShftRght0Byte_DLen2" 171 "HWEMon_recLocLow_mp__ShftRght1Byte_DLen2" 172 "HWEMon_recLocHigh_mp__ShftRght0Byte_DLen2" 173 "IATSCD_tAir__t_DLen2" 174 "IATSCD_tAirCats__t_DLen2" 175 "IATSCD_tAirCatsSec__t_DLen2" 176 "IATSCD_uRawCats__u_DLen2" 177 "IATSCD_uRawCatsSec__u_DLen2" 178 "Tn_abstell__DezUwQ1_DLen2" 179 "U_gen__UUwQ0p1_DLen2" 180 "HWEMon_numEEPBlockfailed__OneToOne_DLen1" 181 "InjCtl_qCurr__qInjMassCyc_DLen2" 182 "InjCtl_qSetUnBal__qInjMassCyc_DLen2" 183 "LIGov_nSetpoint__n_DLen2" 184 "LIGov_trq__trq_DLen2" 185 "LPACD_rOut__dcyc_DLen2" 186 "AFSCD_tAir1__t_DLen2" 187 "AFSCD_tAir2__t_DLen2" 188 "CoEng_stEng__OneToOne_DLen1" 189 "LSU_rO2Adpt[0]__O2_DLen2" 190 "MeUnCD_dcycOut_mp__dcyc_DLen2" 191 "OPSCD_stSigOut__OneToOne_DLen1" 192 "PFlt_pDiffB2__p_DLen2" 193 "OTSCD_tEngOil__t_DLen2" 194 "OxiCCD_tPreB1__tExhaustgas_DLen2" 195 "OxiCCD_tPreB2__tExhaustgas_DLen2" 196 "OxiCCD_uRawTempPreB1__u_DLen2" 197 "OxiCCD_uRawTempPreB2__u_DLen2" 198 "PCR_pDesVal__p_DLen2" 199 "PCVCD_dcycOut_mp__dcyc_DLen2" 200 "PFltCD_pPreB1__p_DLen2" 201 "PFltCD_pPreB2__p_DLen2" 202 "PFltCD_tPreB1__tExhaustgas_DLen2" 203 "PFltCD_tPreB2__tExhaustgas_DLen2" 204 "PFltCD_uRawPresPreB1__u_DLen2" 205 "PFltCD_uRawPresPreB2__u_DLen2" 206 "PFltCD_uRawTempPreB1__u_DLen2" 207 "PFltCD_uRawTempPreB2__u_DLen2" 208 "PFlt_dvol__volph_DLen2" 209 "PFlt_lSnceRgnu16B1_mp__lenrgnu16PFlt_DLen2" 210 "PFlt_lSnceRgnu16B2_mp__lenrgnu16PFlt_DLen2" 211 "PFlt_mAshOilB1__mSoot_DLen2" 212 "PFlt_mSotB1__mSoot_DLen2" 213 "PFlt_mSotSimB1__mSoot_DLen2" 214 "PFlt_dvolB1__volph_DLen2" 215 "PFlt_dvolB2__volph_DLen2" 216 "PFlt_pDiffB1__p_DLen2" 217 "PFlt_qFlB1_mp__FlConPFlt_DLen2" 218 "PFlt_qFlB2_mp__FlConPFlt_DLen2" 219 "AFSCD_mAirPerCyl1__mAirCyl_DLen2" 221 "PFlt_stLck_mp__OneToOne_DLen1" 222 "PSPCD_dvolOut__FlCon_DLen2" 223 "RailCD_pPeak__pRail_DLen2" 224 "RailCD_uPeakRaw__u_DLen2" 225 "Rail_pSetPoint__pRail_DLen2" 226 "TVACD_rOut__dcyc_DLen2" 227 "TVACD_rOut2__dcyc_DLen2" 228 "VSACD_rOut__dcyc_DLen2" 229 "VSSCD_v__v_DLen2" 230 "VehDa_tiEngOn__timEng_DLen2" 231 "PFlt_pPreCorrB1_mp__p_DLen2" 232 "PFlt_stPresPlaus_mp__OneToOne_DLen1" 233 "PFlt_mAshOilB2__mSoot_DLen2" 234 "EGPpCD_stActrOut__OneToOne_DLen1" 235 "PFlt_mSotSimB2__mSoot_DLen2" 236 "OvRMon_tiTDCAvrg__InjTim_DLen2" 237 "OvRMon_tiOvRMonActive_mp__tims_DLen2" 238 "CoEng_trqInrSet__trq_DLen2" 239 "InjCtl_qSet__qInjMassCyc_DLen2" 240 "Absch_korr__FSwQ0p00153_DLen2" 241 "D_soc__FSwB100_DLen2" 242 "I_batt__IUwQ0p08O200_DLen2" 243 "Oz_oelkm__KmUwQ10_DLen2" 244 "Oz_oelnivkurz__TdUbQ0p5_DLen1" 245 "Oz_oelnivnorm__TdUbQ0p5_DLen1" 246 "Oz_oelnivori__TdUbQ0p5_DLen1" 247 "PFlt_mSotB2__mSoot_DLen2" 248 "Stat_sv_reg1__DezUbQ1_DLen1" 249 "Stat_sv_reg2__DezUbQ1_DLen1" 250 "T2histshort__TdUbQ14p9333_DLen1" 251 "T3histshort__TdUbQ14p9333_DLen1" 252 "T4histshort__TdUbQ14p9333_DLen1" 253 "Toel__TSwQ0p1_DLen2" 254 "T_batt__TSwQ0p1_DLen2" 255 "U_batt__UUwQ0p25em3_DLen2" /end COMPU_VTAB
/begin COMPU_METHOD SlopeRes1000 "Umrechnung für Slope: Slopewert mit Verhältnis 0,001" RAT_FUNC "%6.5" "-" COEFFS 0 1000 0 0 0 1 /end COMPU_METHOD
/begin COMPU_METHOD SysLamp "Verbale Umrechnung für DSM_Class%SysLamp_C" TAB_VERB "%6.3" "-" COMPU_TAB_REF SysLamp /end COMPU_METHOD
/begin COMPU_VTAB SysLamp "Verbale Umrechnung für DSM_Class%SysLamp_C" TAB_VERB 3 0 "SysLamp OFF" 1 "SysLamp ON" 2 "SysLamp BLINK" /end COMPU_VTAB
/begin COMPU_METHOD SysLampMode "Verbale Umrechnung für DSM_SysLampMode_C" TAB_VERB "%6.3" "-" COMPU_TAB_REF SysLampMode /end COMPU_METHOD
/begin COMPU_VTAB SysLampMode "Verbale Umrechnung für DSM_SysLampMode_C" TAB_VERB 3 0 "controlled by entry defect Status" 1 "controlled by FCM Statemachine" 2 "controlled by dfp Status" /end COMPU_VTAB
/begin COMPU_METHOD TempDiff_Cels "difference/offset temperature displayed in degree celcius" RAT_FUNC "%6.3" "deg C" COEFFS 0 10 0 0 0 1 /end COMPU_METHOD
/begin COMPU_METHOD Temp_Cels "Temperatur dargestellt in °C (gleiche interne Darstellung wie Temp_Kelv)" RAT_FUNC "%6.1" "deg C" COEFFS 0 10 2731.4 0 0 1 /end COMPU_METHOD
/begin COMPU_METHOD TimeDsmDC "Skalierung Zeit DSM Driving cycle Verzögerung" RAT_FUNC "%6.2" "s" COEFFS 0 1 0 0 0 1 /end COMPU_METHOD
/begin COMPU_METHOD Time_ms "Zeit in ms für Fehlerentprellung (DSM) und SW-Timer" RAT_FUNC "%6.1" "ms" COEFFS 0 0.1 0 0 0 1 /end COMPU_METHOD
/begin RECORD_LAYOUT Kwb_Wu16 FNC_VALUES 1 UWORD COLUMN_DIR DIRECT /end RECORD_LAYOUT
/begin RECORD_LAYOUT Kwb_Wu8 FNC_VALUES 1 UBYTE COLUMN_DIR DIRECT /end RECORD_LAYOUT
/begin RECORD_LAYOUT Kw_Ws16 FNC_VALUES 1 SWORD COLUMN_DIR DIRECT /end RECORD_LAYOUT
/begin RECORD_LAYOUT Kw_Wu16 FNC_VALUES 1 UWORD COLUMN_DIR DIRECT /end RECORD_LAYOUT
/begin RECORD_LAYOUT Kw_Wu8 FNC_VALUES 1 UBYTE COLUMN_DIR DIRECT /end RECORD_LAYOUT
/end MODULE
/end PROJECT
