ASAP2_VERSION 1 3
/begin PROJECT P390 "BMW DDE6.2 6-Zylinder VP0.1 11.11.2003 CAN12H"
/begin HEADER "" VERSION "VP01_6Z_CAN12H" PROJECT_NO P390 /end HEADER
/begin MODULE DIM ""
/begin MOD_COMMON "" BYTE_ORDER MSB_FIRST ALIGNMENT_BYTE 1 ALIGNMENT_WORD 2 ALIGNMENT_LONG 4 ALIGNMENT_FLOAT32_IEEE 4 /end MOD_COMMON
/begin CHARACTERISTIC CBATT_DEF "Ersatzwert Batteriekapazität" VALUE 0xc23c0 TKW_VV_VV_UB 100.0 Def_ql_ub_q1 1.0000 255.0000 /begin FUNCTION_LIST PMSOCCALC /end FUNCTION_LIST /end CHARACTERISTIC
/begin CHARACTERISTIC CW_BNSUMAX "" VALUE 0xc2688 TKW_VV_VV_UB 100.0 Def_st_ub_q1 0.0 255.0000 /begin FUNCTION_LIST UGENKOR /end FUNCTION_LIST /end CHARACTERISTIC
/begin CHARACTERISTIC CW_CCMASK "CC-Meldung Maske" VALUE 0xc20a4 TKW_VV_VV_UB 100.0 Def_dez_ub_q1 0.0 255.0000 /begin FUNCTION_LIST PMDIAG /end FUNCTION_LIST /end CHARACTERISTIC
/begin CHARACTERISTIC CW_PMDEFMASK "Bitcodierte Maske zum Setzen von PM Defekt" VALUE 0xc20a5 TKW_VV_VV_UB 100.0 Def_dez_ub_q1 0.0 255.0000 /begin FUNCTION_LIST PMDIAG /end FUNCTION_LIST /end CHARACTERISTIC
/begin CHARACTERISTIC CW_PMMASKDFP "Powermanagement Fehlerpseicher Maske" VALUE 0xc20c2 TKW_VV_VV_UB 100.0 Def_dez_ub_q1 0.0 255.0000 /begin FUNCTION_LIST PMDIAG /end FUNCTION_LIST /end CHARACTERISTIC
/begin CHARACTERISTIC KF_IBTSOLL "KFSollstrom aufgrund von Batterietemperatur und Ladezustand." MAP 0xc2364 TKF_SW_SW_UW 100.0 Def_i_uw_q0p08_o200 -200.0000 5042.8000 /begin FUNCTION_LIST PMPRSVCALC /end FUNCTION_LIST
 /begin AXIS_DESCR STD_AXIS T_batt Def_t_sw_q0p1 5 -3276.8000 3276.7000 FORMAT "%4.1" /end AXIS_DESCR
 /begin AXIS_DESCR STD_AXIS D_soc Def_f_sw_b100 6 -100.0000 99.9969 FORMAT "%6.3" /end AXIS_DESCR
 FORMAT "%6.3" /end CHARACTERISTIC
/begin CHARACTERISTIC KF_PMRIBAT1 "Kennfeld Innenwiderstand Batterie" MAP 0xc254a TKF_UW_SW_UB 100.0 Def_f_ub_q0p001 0.0 0.2550 /begin FUNCTION_LIST PMSOCFIT /end FUNCTION_LIST
 /begin AXIS_DESCR STD_AXIS T_batt Def_t_sw_q0p1 4 -3276.8000 3276.7000 FORMAT "%4.1" /end AXIS_DESCR
 /begin AXIS_DESCR STD_AXIS I_batt Def_i_uw_q0p08_o200 6 -200.0000 5042.8000 FORMAT "%6.3" /end AXIS_DESCR
/end CHARACTERISTIC
/begin CHARACTERISTIC KF_PMRIBAT2 "Kennfeld Innenwiderstand Batterie2" MAP 0xc251c TKF_UW_SW_UB 100.0 Def_f_ub_q0p001 0.0 0.2550 /begin FUNCTION_LIST PMSOCFIT /end FUNCTION_LIST
 /begin AXIS_DESCR STD_AXIS T_batt Def_t_sw_q0p1 4 -3276.8000 3276.7000 FORMAT "%4.1" /end AXIS_DESCR
 /begin AXIS_DESCR STD_AXIS I_batt Def_i_uw_q0p08_o200 6 -200.0000 5042.8000 FORMAT "%6.3" /end AXIS_DESCR
/end CHARACTERISTIC
/begin CHARACTERISTIC KF_PMRIBAT3 "Kennfeld Innenwiderstand Batterie3" MAP 0xc24c0 TKF_UW_SW_UB 100.0 Def_f_ub_q0p001 0.0 0.2550 /begin FUNCTION_LIST PMSOCFIT /end FUNCTION_LIST
 /begin AXIS_DESCR STD_AXIS T_batt Def_t_sw_q0p1 4 -3276.8000 3276.7000 FORMAT "%4.1" /end AXIS_DESCR
 /begin AXIS_DESCR STD_AXIS I_batt Def_i_uw_q0p08_o200 6 -200.0000 5042.8000 FORMAT "%6.3" /end AXIS_DESCR
/end CHARACTERISTIC
/begin CHARACTERISTIC KF_PMRIBAT4 "Kennfeld Innenwiderstand Batterie4" MAP 0xc24ee TKF_UW_SW_UB 100.0 Def_f_ub_q0p001 0.0 0.2550 /begin FUNCTION_LIST PMSOCFIT /end FUNCTION_LIST
 /begin AXIS_DESCR STD_AXIS T_batt Def_t_sw_q0p1 4 -3276.8000 3276.7000 FORMAT "%4.1" /end AXIS_DESCR
 /begin AXIS_DESCR STD_AXIS I_batt Def_i_uw_q0p08_o200 6 -200.0000 5042.8000 FORMAT "%6.3" /end AXIS_DESCR
/end CHARACTERISTIC
/begin CHARACTERISTIC KF_PMRIBAT5 "Kennfeld Innenwiderstand Batterie5" MAP 0xc2492 TKF_UW_SW_UB 100.0 Def_f_ub_q0p001 0.0 0.2550 /begin FUNCTION_LIST PMSOCFIT /end FUNCTION_LIST
 /begin AXIS_DESCR STD_AXIS T_batt Def_t_sw_q0p1 4 -3276.8000 3276.7000 FORMAT "%4.1" /end AXIS_DESCR
 /begin AXIS_DESCR STD_AXIS I_batt Def_i_uw_q0p08_o200 6 -200.0000 5042.8000 FORMAT "%6.3" /end AXIS_DESCR
/end CHARACTERISTIC
/begin CHARACTERISTIC KF_PMRIBAT6 "Kennfeld Innenwiderstand Batterie6" MAP 0xc2464 TKF_UW_SW_UB 100.0 Def_f_ub_q0p001 0.0 0.2550 /begin FUNCTION_LIST PMSOCFIT /end FUNCTION_LIST
 /begin AXIS_DESCR STD_AXIS T_batt Def_t_sw_q0p1 4 -3276.8000 3276.7000 FORMAT "%4.1" /end AXIS_DESCR
 /begin AXIS_DESCR STD_AXIS I_batt Def_i_uw_q0p08_o200 6 -200.0000 5042.8000 FORMAT "%6.3" /end AXIS_DESCR
/end CHARACTERISTIC
/begin CHARACTERISTIC KF_PMRIBAT7 "Kennfeld Innenwiderstand Batterie7" MAP 0xc2578 TKF_UW_SW_UB 100.0 Def_f_ub_q0p001 0.0 0.2550 /begin FUNCTION_LIST PMSOCFIT /end FUNCTION_LIST
 /begin AXIS_DESCR STD_AXIS T_batt Def_t_sw_q0p1 4 -3276.8000 3276.7000 FORMAT "%4.1" /end AXIS_DESCR
 /begin AXIS_DESCR STD_AXIS I_batt Def_i_uw_q0p08_o200 6 -200.0000 5042.8000 FORMAT "%6.3" /end AXIS_DESCR
/end CHARACTERISTIC
/begin CHARACTERISTIC KF_PMRIBAT8 "Kennfeld Innenwiderstand Batterie8" MAP 0xc2436 TKF_UW_SW_UB 100.0 Def_f_ub_q0p001 0.0 0.2550 /begin FUNCTION_LIST PMSOCFIT /end FUNCTION_LIST
 /begin AXIS_DESCR STD_AXIS T_batt Def_t_sw_q0p1 4 -3276.8000 3276.7000 FORMAT "%4.1" /end AXIS_DESCR
 /begin AXIS_DESCR STD_AXIS I_batt Def_i_uw_q0p08_o200 6 -200.0000 5042.8000 FORMAT "%6.3" /end AXIS_DESCR
/end CHARACTERISTIC
/begin CHARACTERISTIC KF_SOC0UBIB "" MAP 0xc23f0 TKF_SW_UW_UW 100.0 Def_ql_uw_q0p0182 0.0 1192.7502 /begin FUNCTION_LIST PMSOCCALC /end FUNCTION_LIST
 /begin AXIS_DESCR STD_AXIS Ubatt0 Def_u_uw_q0p25em3_o6 3 6.0000 22.3837 FORMAT "%7.4" /end AXIS_DESCR
 /begin AXIS_DESCR STD_AXIS Isoc0loc Def_i_sw_q0p02 5 -655.3600 655.3400 FORMAT "%6.3" /end AXIS_DESCR
 FORMAT "%6.3" /end CHARACTERISTIC
/begin CHARACTERISTIC KF_SOCLF "Ladefaktor in Abhängigkeit von Temperatur und Ladezustand" MAP 0xc23d8 TKF_UW_SW_UB 100.0 Def_f_ub_b4 0.0 3.9843 /begin FUNCTION_LIST PMSOCCALC /end FUNCTION_LIST
 /begin AXIS_DESCR STD_AXIS T_batt Def_t_sw_q0p1 3 -3276.8000 3276.7000 FORMAT "%4.1" /end AXIS_DESCR
 /begin AXIS_DESCR STD_AXIS Soc_b_loc Def_ql_uw_q0p0182 3 0.0 1192.7502 FORMAT "%6.3" /end AXIS_DESCR
/end CHARACTERISTIC
/begin CHARACTERISTIC KF_USOLL "Batteriesollspannung aufgrund der Temperatur und soc." MAP 0xc2650 TKF_UW_SW_UW 100.0 Def_u_uw_q0p25em3_o6 6.0000 22.3837 /begin FUNCTION_LIST PMUGENCALC /end FUNCTION_LIST
 /begin AXIS_DESCR STD_AXIS T_batt Def_t_sw_q0p1 3 -3276.8000 3276.7000 FORMAT "%4.1" /end AXIS_DESCR
 /begin AXIS_DESCR STD_AXIS Soc_rel Def_f_uw_b100 3 0.0 99.9984 FORMAT "%6.3" /end AXIS_DESCR
 FORMAT "%7.4" /end CHARACTERISTIC
/begin CHARACTERISTIC KL_CLASS2IND "Batterieklasse -> Batterieindex" CURVE 0xc20fd TKL_UB_VV_UB 100.0 Def_dez_ub_q1 0.0 255.0000 /begin FUNCTION_LIST PMDIAG /end FUNCTION_LIST /begin AXIS_DESCR STD_AXIS Batt_class Def_dez_ub_q1 8 0.0 255.0000 /end AXIS_DESCR /end CHARACTERISTIC
/begin CHARACTERISTIC KL_CLASS2NENN "Batterieklasse -> Batteriegroesse" CURVE 0xc20cd TKL_UB_VV_UB 100.0 Def_ql_ub_q1 0.0 255.0000 /begin FUNCTION_LIST PMDIAG /end FUNCTION_LIST /begin AXIS_DESCR STD_AXIS Batt_class Def_dez_ub_q1 8 0.0 255.0000 /end AXIS_DESCR /end CHARACTERISTIC
/begin CHARACTERISTIC KL_DFPRIO "Dffgen Prio Übersetzer" CURVE 0xc229c TKL_UB_VV_SW 100.0 Def_f_sw_p0q25 -100.0000 100.0000 /begin FUNCTION_LIST PMPRSVCALC /end FUNCTION_LIST /begin AXIS_DESCR STD_AXIS Dfpt1filt Def_f_ub_b100 6 0.0 99.6093 /end AXIS_DESCR FORMAT "%5.2" /end CHARACTERISTIC
/begin CHARACTERISTIC KL_DFPTC "Gefiltertes dffgen -> Prio_Gewichtung -Übersetzer" CURVE 0xc2234 TKL_UB_VV_SW 100.0 Def_f_sw_p0q25 -100.0000 100.0000 /begin FUNCTION_LIST PMPRSVCALC /end FUNCTION_LIST /begin AXIS_DESCR STD_AXIS Dfpt1ptc Def_f_ub_b100 6 0.0 99.6093 /end AXIS_DESCR FORMAT "%5.2" /end CHARACTERISTIC
/begin CHARACTERISTIC KL_DSOCPRIO "" CURVE 0xc2336 TKL_SW_VV_UW 100.0 Def_f_uw_b512 0.0 511.9921 /begin FUNCTION_LIST PMPRSVCALC /end FUNCTION_LIST
 /begin AXIS_DESCR STD_AXIS D_soc Def_f_sw_b100 5 -100.0000 99.9969 FORMAT "%6.3" /end AXIS_DESCR
 FORMAT "%6.3" /end CHARACTERISTIC
/begin CHARACTERISTIC KL_DSOCPTC "Kennlinie dsoc auf PTC-Ansteuerung Übersetzer" CURVE 0xc230a TKL_SW_VV_SW 100.0 Def_f_sw_p0q25 -150.0000 150.0000 /begin FUNCTION_LIST PMPRSVCALC /end FUNCTION_LIST
 /begin AXIS_DESCR STD_AXIS D_soc Def_f_sw_b100 4 -100.0000 99.9969 FORMAT "%6.3" /end AXIS_DESCR
 FORMAT "%5.2" /end CHARACTERISTIC
/begin CHARACTERISTIC KL_DUDTPTC "Übersetzer dudtmul -> PTC Add. Gewichtung" CURVE 0xc22f4 TKL_SW_VV_UW 100.0 Def_f_uw_q0p25 0.0 550.0000 /begin FUNCTION_LIST PMPRSVCALC /end FUNCTION_LIST
 /begin AXIS_DESCR STD_AXIS Dudtmul Def_f_sw_q0p000147 5 -48.2304 48.2289 FORMAT "%7.4" /end AXIS_DESCR
 FORMAT "%6.3" /end CHARACTERISTIC
/begin CHARACTERISTIC KL_FITGRZ "Grenzwert für soc_fit" CURVE 0xc25d2 TKL_SW_VV_UW 100.0 Def_f_uw_b100 0.0 99.9984 /begin FUNCTION_LIST PMSOCKOR /end FUNCTION_LIST
 /begin AXIS_DESCR STD_AXIS T_saison Def_t_sw_q0p1 4 -3276.8000 3276.7000 FORMAT "%4.1" /end AXIS_DESCR
 FORMAT "%6.3" /end CHARACTERISTIC
/begin CHARACTERISTIC KL_I2PTC "I-Delta Übersetzer zu PTC Ansteuerung" CURVE 0xc21d8 TKL_UW_VV_SW 100.0 Def_f_sw_p0q25 -100.0000 100.0000 /begin FUNCTION_LIST PMPRSVCALC /end FUNCTION_LIST
 /begin AXIS_DESCR STD_AXIS Isolldiff Def_i_uw_q0p08_o200 6 -200.0000 5042.8000 FORMAT "%6.3" /end AXIS_DESCR
 FORMAT "%5.2" /end CHARACTERISTIC
/begin CHARACTERISTIC KL_IREST "Noch verfuegbare Restleistung vom Generator." CURVE 0xc22ca TKL_UW_VV_SW 100.0 Def_f_sw_p0q25 -100.0000 100.0000 /begin FUNCTION_LIST PMPRSVCALC /end FUNCTION_LIST
 /begin AXIS_DESCR STD_AXIS Pgenrest Def_f_uw_q0p25 10 0.0 16383.7500 FORMAT "%6.3" /end AXIS_DESCR
 FORMAT "%5.2" /end CHARACTERISTIC
/begin CHARACTERISTIC KL_ISOLLPR "Delta-I -> Prio Übersetzer" CURVE 0xc231c TKL_UW_VV_SW 100.0 Def_f_sw_p0q25 -100.0000 100.0000 /begin FUNCTION_LIST PMPRSVCALC /end FUNCTION_LIST
 /begin AXIS_DESCR STD_AXIS Ibtdiff Def_i_uw_q0p08_o200 6 -200.0000 5042.8000 FORMAT "%6.3" /end AXIS_DESCR
 FORMAT "%5.2" /end CHARACTERISTIC
/begin CHARACTERISTIC KL_ITNSTART "Startspannung abh. vom Itnstart" CURVE 0xc2614 TKL_UB_VV_UW 100.0 Def_u_uw_q0p25em3_o6 6.0000 22.3837 /begin FUNCTION_LIST PMSOCSTART /end FUNCTION_LIST /begin AXIS_DESCR STD_AXIS NO_INPUT_QUANTITY Def_i_ub_b1000 4 0.0 996.0937 /end AXIS_DESCR FORMAT "%7.4" /end CHARACTERISTIC
/begin CHARACTERISTIC KL_PMSOCVU "SoC-Wert aus der Fitberechnung" CURVE 0xc2428 TKL_UW_VV_UW 100.0 Def_f_uw_b100 0.0 99.9984 /begin FUNCTION_LIST PMSOCFIT /end FUNCTION_LIST
 /begin AXIS_DESCR STD_AXIS Ubatts2 Def_u_uw_q0p25em3_o6 3 6.0000 22.3837 FORMAT "%7.4" /end AXIS_DESCR
 FORMAT "%6.3" /end CHARACTERISTIC
/begin CHARACTERISTIC KL_PRIO2PTC "Gewichtung der Prios auf Gewichtung fuer PTC Ansteuerung" CURVE 0xc2274 TKL_UW_VV_SW 100.0 Def_f_sw_p0q25 -100.0000 100.0000 /begin FUNCTION_LIST PMPRSVCALC /end FUNCTION_LIST
 /begin AXIS_DESCR STD_AXIS Dfprio Def_f_uw_q0p25 5 0.0 16383.7500 FORMAT "%6.3" /end AXIS_DESCR
 FORMAT "%5.2" /end CHARACTERISTIC
/begin CHARACTERISTIC KL_PRIOCF "" CURVE 0xc21f2 TKL_SW_VV_UB 100.0 Def_dez_ub_q1 0.0 6.0000 /begin FUNCTION_LIST PMPRSVCALC /end FUNCTION_LIST
 /begin AXIS_DESCR STD_AXIS Dsoc2pi Def_f_sw_p0q25 7 -8192.0000 8191.7500 FORMAT "%5.2" /end AXIS_DESCR
/end CHARACTERISTIC
/begin CHARACTERISTIC KL_PRIODF "" CURVE 0xc234c TKL_UW_VV_UB 100.0 Def_dez_ub_q1 0.0 6.0000 /begin FUNCTION_LIST PMPRSVCALC /end FUNCTION_LIST
 /begin AXIS_DESCR STD_AXIS Dfprio Def_f_uw_q0p25 7 0.0 16383.7500 FORMAT "%6.3" /end AXIS_DESCR
/end CHARACTERISTIC
/begin CHARACTERISTIC KL_PTC "PWM-Übersetzer für PTC-Ansteuerung" CURVE 0xc21c6 TKL_UW_VV_UB 100.0 Def_f_ub_b127p5 0.0 127.5000 /begin FUNCTION_LIST PMPRSVCALC /end FUNCTION_LIST
 /begin AXIS_DESCR STD_AXIS Allptcfilt Def_f_uw_q0p25 5 0.0 16383.7500 FORMAT "%6.3" /end AXIS_DESCR
/end CHARACTERISTIC
/begin CHARACTERISTIC KL_PWRCF "" CURVE 0xc220a TKL_SW_VV_UB 100.0 Def_dez_ub_q1 0.0 6.0000 /begin FUNCTION_LIST PMPRSVCALC /end FUNCTION_LIST
 /begin AXIS_DESCR STD_AXIS Dsoc2pi Def_f_sw_p0q25 7 -8192.0000 8191.7500 FORMAT "%5.2" /end AXIS_DESCR
/end CHARACTERISTIC
/begin CHARACTERISTIC KL_PWRDF "" CURVE 0xc2248 TKL_UW_VV_UB 100.0 Def_dez_ub_q1 0.0 13.0000 /begin FUNCTION_LIST PMPRSVCALC /end FUNCTION_LIST
 /begin AXIS_DESCR STD_AXIS Dfprio Def_f_uw_q0p25 14 0.0 16383.7500 FORMAT "%6.3" /end AXIS_DESCR
/end CHARACTERISTIC
/begin CHARACTERISTIC KL_SOC0TEMP "Temperaturabhängige Stromkorrektur für Ruhespannungsmessung" CURVE 0xc23c6 TKL_SW_VV_UB 100.0 Def_f_ub_b2 0.0 1.9921 /begin FUNCTION_LIST PMSOCCALC /end FUNCTION_LIST
 /begin AXIS_DESCR STD_AXIS Tsocloc Def_t_sw_q0p1 5 -3276.8000 3276.7000 FORMAT "%4.1" /end AXIS_DESCR
/end CHARACTERISTIC
/begin CHARACTERISTIC KL_SOCPRIO "dsoc -> Prio Übersetzer" CURVE 0xc228a TKL_SW_VV_SW 100.0 Def_f_sw_p0q25 -150.0000 150.0000 /begin FUNCTION_LIST PMPRSVCALC /end FUNCTION_LIST
 /begin AXIS_DESCR STD_AXIS D_soc Def_f_sw_b100 4 -100.0000 99.9969 FORMAT "%6.3" /end AXIS_DESCR
 FORMAT "%5.2" /end CHARACTERISTIC
/begin CHARACTERISTIC KL_SSOC "soc_s in Abh. von tsaison" CURVE 0xc25e4 TKL_SW_VV_UW 100.0 Def_f_uw_b100 0.0 99.9984 /begin FUNCTION_LIST PMSOCKOR /end FUNCTION_LIST
 /begin AXIS_DESCR STD_AXIS T_saison Def_t_sw_q0p1 4 -3276.8000 3276.7000 FORMAT "%4.1" /end AXIS_DESCR
 FORMAT "%6.3" /end CHARACTERISTIC
/begin CHARACTERISTIC KL_T2RELMAX "T2relativ Max. Toleranzwert" CURVE 0xc20e9 TKL_UB_VV_UB 100.0 Def_f_ub_b1 0.0 0.9960 /begin FUNCTION_LIST PMDIAG /end FUNCTION_LIST /begin AXIS_DESCR STD_AXIS T_histsum Def_td_ub_q14336 4 0.0 3655680.0000 /end AXIS_DESCR /end CHARACTERISTIC
/begin CHARACTERISTIC KL_T2RELMXRG "T2relativ Max. Toleranzwert bei Ringshift" CURVE 0xc20df TKL_UB_VV_UB 100.0 Def_f_ub_b1 0.0 0.9960 /begin FUNCTION_LIST PMDIAG /end FUNCTION_LIST /begin AXIS_DESCR STD_AXIS T_histsum Def_td_ub_q14336 4 0.0 3655680.0000 /end AXIS_DESCR /end CHARACTERISTIC
/begin CHARACTERISTIC KL_T3RELMAX "T2relativ Max. Toleranzwert" CURVE 0xc20f3 TKL_UB_VV_UB 100.0 Def_f_ub_b1 0.0 0.9960 /begin FUNCTION_LIST PMDIAG /end FUNCTION_LIST /begin AXIS_DESCR STD_AXIS T_histsum Def_td_ub_q14336 4 0.0 3655680.0000 /end AXIS_DESCR /end CHARACTERISTIC
/begin CHARACTERISTIC KL_T3RELMXRG "T3relativ Max. Toleranzwert bei Ringshift" CURVE 0xc210f TKL_UB_VV_UB 100.0 Def_f_ub_b1 0.0 0.9960 /begin FUNCTION_LIST PMDIAG /end FUNCTION_LIST /begin AXIS_DESCR STD_AXIS T_histsum Def_td_ub_q14336 4 0.0 3655680.0000 /end AXIS_DESCR /end CHARACTERISTIC
/begin CHARACTERISTIC KL_T4RELMAX "T2relativ Max. Toleranzwert" CURVE 0xc2119 TKL_UB_VV_UB 100.0 Def_f_ub_b1 0.0 0.9960 /begin FUNCTION_LIST PMDIAG /end FUNCTION_LIST /begin AXIS_DESCR STD_AXIS T_histsum Def_td_ub_q14336 4 0.0 3655680.0000 /end AXIS_DESCR /end CHARACTERISTIC
/begin CHARACTERISTIC KL_T4RELMXRG "T2relativ Max. Toleranzwert bei Ringshift" CURVE 0xc20c3 TKL_UB_VV_UB 100.0 Def_f_ub_b1 0.0 0.9960 /begin FUNCTION_LIST PMDIAG /end FUNCTION_LIST /begin AXIS_DESCR STD_AXIS T_histsum Def_td_ub_q14336 4 0.0 3655680.0000 /end AXIS_DESCR /end CHARACTERISTIC
/begin CHARACTERISTIC KL_UBTPRIO "Delta-Spannung -> Prio Übersetzer" CURVE 0xc22b0 TKL_SW_VV_SW 100.0 Def_f_sw_p0q25 -100.0000 100.0000 /begin FUNCTION_LIST PMPRSVCALC /end FUNCTION_LIST
 /begin AXIS_DESCR STD_AXIS Ubdiffilt Def_f_sw_b32 6 -32.0000 31.9990 FORMAT "%7.4" /end AXIS_DESCR
 FORMAT "%5.2" /end CHARACTERISTIC
/begin CHARACTERISTIC KL_UB_PTC "UBatt-Kennlinie für Ansteuerung PTC" CURVE 0xc21ac TKL_SW_VV_SW 100.0 Def_f_sw_p0q25 -100.0000 100.0000 /begin FUNCTION_LIST PMPRSVCALC /end FUNCTION_LIST
 /begin AXIS_DESCR STD_AXIS Ubtpt1ptc Def_f_sw_b32 6 -32.0000 31.9990 FORMAT "%7.4" /end AXIS_DESCR
 FORMAT "%5.2" /end CHARACTERISTIC
/begin CHARACTERISTIC KL_UNSTART "Startspannung abhängig v.Motordrehzahl" CURVE 0xc260a TKL_SW_VV_UW 100.0 Def_u_uw_q0p25em3_o6 6.0000 22.3837 /begin FUNCTION_LIST PMSOCSTART /end FUNCTION_LIST /begin AXIS_DESCR STD_AXIS Nnmstart Def_n_sw_q1p0 2 -32768.0000 32767.0000 /end AXIS_DESCR FORMAT "%7.4" /end CHARACTERISTIC
/begin CHARACTERISTIC KL_USOLL "Batteriesollspannung aufgrund von tbatt" CURVE 0xc2642 TKL_SW_VV_UW 100.0 Def_u_uw_q0p25em3_o6 6.0000 22.3837 /begin FUNCTION_LIST PMUGENCALC /end FUNCTION_LIST
 /begin AXIS_DESCR STD_AXIS T_batt Def_t_sw_q0p1 3 -3276.8000 3276.7000 FORMAT "%4.1" /end AXIS_DESCR
 FORMAT "%7.4" /end CHARACTERISTIC
/begin CHARACTERISTIC KL_UTSTART "Startspannung in Abhängigkeit von Temperatur Batterie" CURVE 0xc2622 TKL_SW_VV_SW 100.0 Def_u_sw_q0p00025 -8.1920 8.1917 /begin FUNCTION_LIST PMSOCSTART /end FUNCTION_LIST
 /begin AXIS_DESCR STD_AXIS T_batt Def_t_sw_q0p1 3 -3276.8000 3276.7000 FORMAT "%4.1" /end AXIS_DESCR
 FORMAT "%7.4" /end CHARACTERISTIC
/begin CHARACTERISTIC KL_WUBPTC "KL Multiplikationsfaktor W_ub bei SpgEinbruch" CURVE 0xc2222 TKL_UW_VV_UB 100.0 Def_f_ub_b4 0.0 3.9843 /begin FUNCTION_LIST PMPRSVCALC /end FUNCTION_LIST /begin AXIS_DESCR STD_AXIS Ub Def_u_uw_q0p0942 5 0.0 6173.3970 FORMAT "%4.1" /end AXIS_DESCR /end CHARACTERISTIC
/begin CHARACTERISTIC K_ABKORROVER "schlechter absch_korr Schwelle ueberschritten" VALUE 0xc208c TKW_VV_VV_SW 100.0 Def_f_sw_q0p00153 -50.0000 49.9984 /begin FUNCTION_LIST PMDIAG /end FUNCTION_LIST FORMAT "%6.3" /end CHARACTERISTIC
/begin CHARACTERISTIC K_ABSCHKORA "Applikationswert für Korrektur Abschaltung" VALUE 0xc25a6 TKW_VV_VV_SW 100.0 Def_f_sw_q0p00153 -50.0000 49.9984 /begin FUNCTION_LIST PMSOCKOR /end FUNCTION_LIST FORMAT "%6.3" /end CHARACTERISTIC
/begin CHARACTERISTIC K_APP_UGEN "Umschaltung auf manuelle Generatorspannungsvorgabe" VALUE 0xc2689 TKW_VV_VV_UB 100.0 Def_st_ub_q1 0.0 255.0000 /begin FUNCTION_LIST UGENKOR /end FUNCTION_LIST /end CHARACTERISTIC
/begin CHARACTERISTIC K_BATTINDAPP "batt_index appl." VALUE 0xc20a6 TKW_VV_VV_UB 100.0 Def_dez_ub_q1 0.0 255.0000 /begin FUNCTION_LIST PMDIAG /end FUNCTION_LIST /end CHARACTERISTIC
/begin CHARACTERISTIC K_BATTREGAPP "Batterietauschregristrieren App" VALUE 0xc20a7 TKW_VV_VV_UB 100.0 Def_dez_ub_q1 0.0 255.0000 /begin FUNCTION_LIST PMDIAG /end FUNCTION_LIST /end CHARACTERISTIC
/begin CHARACTERISTIC K_BILA_OGRZ "Grenzwert oberhalb dessen eine Apassung durch soc_kor nicht zulässig ist" VALUE 0xc25b2 TKW_VV_VV_UW 100.0 Def_f_uw_b100 0.0 99.9984 /begin FUNCTION_LIST PMSOCKOR /end FUNCTION_LIST FORMAT "%6.3" /end CHARACTERISTIC
/begin CHARACTERISTIC K_BILA_UGRZ "" VALUE 0xc25b4 TKW_VV_VV_UW 100.0 Def_f_uw_b100 0.0 99.9984 /begin FUNCTION_LIST PMSOCKOR /end FUNCTION_LIST FORMAT "%6.3" /end CHARACTERISTIC
/begin CHARACTERISTIC K_BNSMAX "Bordnetz Instabil Schwelle" VALUE 0xc2084 TKW_VV_VV_UB 100.0 Def_dez_ub_q1 0.0 255.0000 /begin FUNCTION_LIST PMBNSTAB /end FUNCTION_LIST /end CHARACTERISTIC
/begin CHARACTERISTIC K_BNS_CTRINC "bnsctr inkrement" VALUE 0xc2085 TKW_VV_VV_UB 100.0 Def_dez_ub_q1 0.0 255.0000 /begin FUNCTION_LIST PMBNSTAB /end FUNCTION_LIST /end CHARACTERISTIC
/begin CHARACTERISTIC K_BNS_SCHW1 "BN Instabilitätsschwelle 1" VALUE 0xc2086 TKW_VV_VV_UB 100.0 Def_dez_ub_q1 0.0 255.0000 /begin FUNCTION_LIST PMBNSTAB /end FUNCTION_LIST /end CHARACTERISTIC
/begin CHARACTERISTIC K_BNS_UBMAX "BN Spg. max. Schwelle" VALUE 0xc2087 TKW_VV_VV_UB 100.0 Def_u_ub_q0p0942 0.0 24.0210 /begin FUNCTION_LIST PMBNSTAB /end FUNCTION_LIST /end CHARACTERISTIC
/begin CHARACTERISTIC K_BNS_UBMIN "BN Spg. untere Schwelle" VALUE 0xc2088 TKW_VV_VV_UB 100.0 Def_u_ub_q0p0942 0.0 24.0210 /begin FUNCTION_LIST PMBNSTAB /end FUNCTION_LIST /end CHARACTERISTIC
/begin CHARACTERISTIC K_BNS_VFZG "Schwelle Geschwindigkeit fuer BNS" VALUE 0xc2082 TKW_VV_VV_UW 100.0 Def_v_uw_q1p0 0.0 65535.0000 /begin FUNCTION_LIST PMBNSTAB /end FUNCTION_LIST /end CHARACTERISTIC
/begin CHARACTERISTIC K_CBATTAPP "Cbattnenn appl." VALUE 0xc20a8 TKW_VV_VV_UB 100.0 Def_ql_ub_q1 0.0 255.0000 /begin FUNCTION_LIST PMDIAG /end FUNCTION_LIST /end CHARACTERISTIC
/begin CHARACTERISTIC K_CCPRIOSET "Schwelle von E65Prios ab dem ccmeldung aktiv ist." VALUE 0xc20a9 TKW_VV_VV_UB 100.0 Def_dez_ub_q1 0.0 7.0000 /begin FUNCTION_LIST PMDIAG /end FUNCTION_LIST /end CHARACTERISTIC
/begin CHARACTERISTIC K_CCPRIOTIME "Zeitverschiebung bis ccmeldung gesetzt wird." VALUE 0xc20aa TKW_VV_VV_UB 100.0 Def_td_ub_q0p1 0.0 25.5000 /begin FUNCTION_LIST PMDIAG /end FUNCTION_LIST /end CHARACTERISTIC
/begin CHARACTERISTIC K_CCPWRSET "ctrpwrcos Schwelle ab dem CC Meldung aktiviert wird. " VALUE 0xc2096 TKW_VV_VV_UW 100.0 Def_dez_uw_q1 0.0 65535.0000 /begin FUNCTION_LIST PMDIAG /end FUNCTION_LIST /end CHARACTERISTIC
/begin CHARACTERISTIC K_CTRCBRA "" VALUE 0xc2174 TKW_VV_VV_UB 100.0 Def_dez_ub_q1 0.0 255.0000 /begin FUNCTION_LIST PMPRSVCALC /end FUNCTION_LIST /end CHARACTERISTIC
/begin CHARACTERISTIC K_CTRCBRAPP "Steuerung Stromzweige Applikationsgroesse" VALUE 0xc2175 TKW_VV_VV_UB 100.0 Def_dez_ub_q1 0.0 255.0000 /begin FUNCTION_LIST PMPRSVCALC /end FUNCTION_LIST /end CHARACTERISTIC
/begin CHARACTERISTIC K_CTRCBRKBM "CTRCBR APP bei B_startfgk" VALUE 0xc2176 TKW_VV_VV_UB 100.0 Def_dez_ub_q1 0.0 255.0000 /begin FUNCTION_LIST PMPRSVCALC /end FUNCTION_LIST /end CHARACTERISTIC
/begin CHARACTERISTIC K_CTRPCOSAPP "Steuerung Standverbraucher Applikationsgroesse" VALUE 0xc2177 TKW_VV_VV_UB 100.0 Def_dez_ub_q1 0.0 3.0000 /begin FUNCTION_LIST PMPRSVCALC /end FUNCTION_LIST /end CHARACTERISTIC
/begin CHARACTERISTIC K_CTRPRIOAPP "Steuerung Spitzenreduzierung Prioritaet Applikationsgroesse" VALUE 0xc2178 TKW_VV_VV_UB 100.0 Def_dez_ub_q1 0.0 7.0000 /begin FUNCTION_LIST PMPRSVCALC /end FUNCTION_LIST /end CHARACTERISTIC
/begin CHARACTERISTIC K_CTRPRIOCF "" VAL_BLK 0xc219c TKW_VV_VV_UB 100.0 Def_dez_ub_q1 0.0 255.0000 /begin FUNCTION_LIST PMPRSVCALC /end FUNCTION_LIST NUMBER 7 /end CHARACTERISTIC
/begin CHARACTERISTIC K_CTRPWRCF "" VAL_BLK 0xc214a TKW_VV_VV_UW 100.0 Def_dez_uw_q1 0.0 65535.0000 /begin FUNCTION_LIST PMPRSVCALC /end FUNCTION_LIST NUMBER 7 /end CHARACTERISTIC
/begin CHARACTERISTIC K_CTRPWRDF "" VAL_BLK 0xc2158 TKW_VV_VV_UW 100.0 Def_dez_uw_q1 0.0 65535.0000 /begin FUNCTION_LIST PMPRSVCALC /end FUNCTION_LIST NUMBER 14 /end CHARACTERISTIC
/begin CHARACTERISTIC K_DAB_KORR1 "Korrekturkonstante 1 für Abschaltung" VALUE 0xc25a8 TKW_VV_VV_SW 100.0 Def_f_sw_q0p00153 -50.0000 49.9984 /begin FUNCTION_LIST PMSOCKOR /end FUNCTION_LIST FORMAT "%6.3" /end CHARACTERISTIC
/begin CHARACTERISTIC K_DAB_KORR2 "Korrekturkonstante 2 für Abschaltung" VALUE 0xc25aa TKW_VV_VV_SW 100.0 Def_f_sw_q0p00153 -50.0000 49.9984 /begin FUNCTION_LIST PMSOCKOR /end FUNCTION_LIST FORMAT "%6.3" /end CHARACTERISTIC
/begin CHARACTERISTIC K_DAB_KORR3 "Korrekturkonstante 3 für Abschaltung" VALUE 0xc25ac TKW_VV_VV_SW 100.0 Def_f_sw_q0p00153 -50.0000 49.9984 /begin FUNCTION_LIST PMSOCKOR /end FUNCTION_LIST FORMAT "%6.3" /end CHARACTERISTIC
/begin CHARACTERISTIC K_DFFILTAPP "Schalter, um dffgenfilt auf DFFILT_APP umzustellen" VALUE 0xc2179 TKW_VV_VV_UB 100.0 Def_f_ub_b100 0.0 99.6093 /begin FUNCTION_LIST PMPRSVCALC /end FUNCTION_LIST /end CHARACTERISTIC
/begin CHARACTERISTIC K_DFOVERRIDE "Schwellwert wann Generator als ueberlastet erkannt wird" VALUE 0xc263e TKW_VV_VV_UB 100.0 Def_f_ub_b100 0.0 99.6093 /begin FUNCTION_LIST PMUGENCALC /end FUNCTION_LIST /end CHARACTERISTIC
/begin CHARACTERISTIC K_DFPTC_LP "K-Faktor des df-Tiefpass Filters zur Berechnung von PTC" VALUE 0xc217a TKW_VV_VV_UB 100.0 Def_f_ub_b1 0.0 0.9960 /begin FUNCTION_LIST PMPRSVCALC /end FUNCTION_LIST /end CHARACTERISTIC
/begin CHARACTERISTIC K_DF_LP "K-Faktor des df-Tiefpass Filters zur Berechnung von ctrpwrdf" VALUE 0xc217b TKW_VV_VV_UB 100.0 Def_f_ub_b1 0.0 0.9960 /begin FUNCTION_LIST PMPRSVCALC /end FUNCTION_LIST /end CHARACTERISTIC
/begin CHARACTERISTIC K_DSOCA "Applikationsgrösse für d_soc" VALUE 0xc25ae TKW_VV_VV_SW 100.0 Def_f_sw_b100 -100.0000 99.9969 /begin FUNCTION_LIST PMSOCKOR /end FUNCTION_LIST FORMAT "%6.3" /end CHARACTERISTIC
/begin CHARACTERISTIC K_DSOCABSCH "Applikationsgrösse für d_soc" VALUE 0xc25b0 TKW_VV_VV_SW 100.0 Def_f_sw_b100 -100.0000 99.9969 /begin FUNCTION_LIST PMSOCKOR /end FUNCTION_LIST FORMAT "%6.3" /end CHARACTERISTIC
/begin CHARACTERISTIC K_DSOCHYSTCC "DSOC Hyst. fuer B_ccbtnach reset " VALUE 0xc208e TKW_VV_VV_SW 100.0 Def_f_sw_b100 -100.0000 99.9969 /begin FUNCTION_LIST PMDIAG /end FUNCTION_LIST FORMAT "%6.3" /end CHARACTERISTIC
/begin CHARACTERISTIC K_DSOCLOW "DSOC Grenze f. CCmeld Batt Nachladen" VALUE 0xc2090 TKW_VV_VV_SW 100.0 Def_f_sw_b100 -100.0000 99.9969 /begin FUNCTION_LIST PMDIAG /end FUNCTION_LIST FORMAT "%6.3" /end CHARACTERISTIC
/begin CHARACTERISTIC K_DSOCPCOS "dsoc, unterhalb derer die Standverbraucher deaktiviert werden." VALUE 0xc2124 TKW_VV_VV_SW 100.0 Def_f_sw_b100 -100.0000 99.9969 /begin FUNCTION_LIST PMPRSVCALC /end FUNCTION_LIST FORMAT "%6.3" /end CHARACTERISTIC
/begin CHARACTERISTIC K_DUDTPTCAUS "K-Faktor für dudt-PTC Abschaltung" VALUE 0xc212a TKW_VV_VV_UW 100.0 Def_f_uw_b1 0.0 9.99984741210938e-1 /begin FUNCTION_LIST PMPRSVCALC /end FUNCTION_LIST /end CHARACTERISTIC
/begin CHARACTERISTIC K_ENGENTOGGL "Freigabe Generatortoggeln" VALUE 0xc268a TKW_VV_VV_UB 100.0 Identity 0.0 1.0000 /begin FUNCTION_LIST UGENKOR /end FUNCTION_LIST /end CHARACTERISTIC
/begin CHARACTERISTIC K_GENOFFTIME "maximale Generatorauszeit" VALUE 0xc2676 TKW_VV_VV_UW 100.0 Def_td_uw_q0p1 0.0 6553.5000 /begin FUNCTION_LIST UGENKOR /end FUNCTION_LIST FORMAT "%4.1" /end CHARACTERISTIC
/begin CHARACTERISTIC K_GENUMAX "maximale Generatorspannung" VALUE 0xc2678 TKW_VV_VV_UW 100.0 Def_u_uw_q0p1 0.0 6553.5000 /begin FUNCTION_LIST UGENKOR /end FUNCTION_LIST FORMAT "%6.3" /end CHARACTERISTIC
/begin CHARACTERISTIC K_GENURAMP "Spannungsinkrement fuer Rampe" VALUE 0xc267a TKW_VV_VV_UW 100.0 Def_u_uw_q0p1 0.0 6553.5000 /begin FUNCTION_LIST UGENKOR /end FUNCTION_LIST FORMAT "%6.3" /end CHARACTERISTIC
/begin CHARACTERISTIC K_GENURAMPOF "Spannungsinkrement fuer Rampe, Generator ausschalten" VALUE 0xc267c TKW_VV_VV_UW 100.0 Def_u_uw_q0p1 0.0 6553.5000 /begin FUNCTION_LIST UGENKOR /end FUNCTION_LIST FORMAT "%6.3" /end CHARACTERISTIC
/begin CHARACTERISTIC K_GEN_APPUG "Manuelle Generatorspannungsvorgabe" VALUE 0xc267e TKW_VV_VV_UW 100.0 Def_u_uw_q0p1 0.0 6553.5000 /begin FUNCTION_LIST UGENKOR /end FUNCTION_LIST FORMAT "%6.3" /end CHARACTERISTIC
/begin CHARACTERISTIC K_HISTDMERST "Manueller Reset d. Histogramm in der DME" VALUE 0xc20ab TKW_VV_VV_UB 100.0 Def_dez_ub_q1 0.0 255.0000 /begin FUNCTION_LIST PMDIAG /end FUNCTION_LIST /end CHARACTERISTIC
/begin CHARACTERISTIC K_HISTIBSRST "Manueller Histogramm Reset in IBS" VALUE 0xc20ac TKW_VV_VV_UB 100.0 Def_dez_ub_q1 0.0 255.0000 /begin FUNCTION_LIST PMDIAG /end FUNCTION_LIST /end CHARACTERISTIC
/begin CHARACTERISTIC K_IBSWAKEAPP "Bit, ob IBS Bus wecken darf oder nicht. Applikationsgroesse." VALUE 0xc217c TKW_VV_VV_UB 100.0 Def_dez_ub_q1 0.0 255.0000 /begin FUNCTION_LIST PMPRSVCALC /end FUNCTION_LIST /end CHARACTERISTIC
/begin CHARACTERISTIC K_IB_COMMVAL "Anzahl Taskaufrufe zwischen periodischer Abfrage qlad und qelad" VALUE 0xc23c1 TKW_VV_VV_UB 100.0 Def_dez_ub_q1 0.0 255.0000 /begin FUNCTION_LIST PMSOCCALC /end FUNCTION_LIST /end CHARACTERISTIC
/begin CHARACTERISTIC K_IPMPMDEC "Prio-dekrementfaktor aufgrund IPM" VALUE 0xc212c TKW_VV_VV_UW 100.0 Def_f_uw_q0p25 0.0 450.0000 /begin FUNCTION_LIST PMPRSVCALC /end FUNCTION_LIST FORMAT "%6.3" /end CHARACTERISTIC
/begin CHARACTERISTIC K_IPMPMINC "Prio-Inkrementfaktor aufgrund IPM" VALUE 0xc212e TKW_VV_VV_UW 100.0 Def_f_uw_q0p25 0.0 450.0000 /begin FUNCTION_LIST PMPRSVCALC /end FUNCTION_LIST FORMAT "%6.3" /end CHARACTERISTIC
/begin CHARACTERISTIC K_IWAKEAPP "Wakeupgrenze Appl." VALUE 0xc20ad TKW_VV_VV_UB 100.0 Def_i_ub_q0p00125 0.0 0.2550 /begin FUNCTION_LIST PMDIAG /end FUNCTION_LIST /end CHARACTERISTIC
/begin CHARACTERISTIC K_I_FITAUSW "Grenzwert Fitstrom" VALUE 0xc2420 TKW_VV_VV_UW 100.0 Def_i_uw_q0p08_o200 -200.0000 5042.8000 /begin FUNCTION_LIST PMSOCFIT /end FUNCTION_LIST FORMAT "%6.3" /end CHARACTERISTIC
/begin CHARACTERISTIC K_KBMCNT_APP "Zeit, indem KBM alle Straenge einschalten soll." VALUE 0xc217d TKW_VV_VV_UB 100.0 Def_td_ub_q0p1 0.0 25.5000 /begin FUNCTION_LIST PMPRSVCALC /end FUNCTION_LIST /end CHARACTERISTIC
/begin CHARACTERISTIC K_KSOGRZAPP "Ikurz_ogrz appl." VALUE 0xc20ae TKW_VV_VV_UB 100.0 Def_i_ub_q5p12 0.0 998.4000 /begin FUNCTION_LIST PMDIAG /end FUNCTION_LIST /end CHARACTERISTIC
/begin CHARACTERISTIC K_KSUGRZAPP "Ikurz_ugrz Appl." VALUE 0xc20af TKW_VV_VV_UB 100.0 Def_i_ub_q5p12 0.0 1000.0000 /begin FUNCTION_LIST PMDIAG /end FUNCTION_LIST /end CHARACTERISTIC
/begin CHARACTERISTIC K_LLPMFILTK "Filterkonstante : Tiefpassfilter DF-Signal" VALUE 0xc217e TKW_VV_VV_UB 100.0 Def_f_ub_b1 0.0 0.9960 /begin FUNCTION_LIST PMPRSVCALC /end FUNCTION_LIST /end CHARACTERISTIC
/begin CHARACTERISTIC K_MN_PTCPI "Minimalwert des PI-Reglers PTC Ansteuerung" VALUE 0xc2130 TKW_VV_VV_UW 100.0 Def_f_uw_b512 0.0 511.9921 /begin FUNCTION_LIST PMPRSVCALC /end FUNCTION_LIST FORMAT "%6.3" /end CHARACTERISTIC
/begin CHARACTERISTIC K_MN_PWRDFPI "Minimaler Wert PI-Regler df Prio" VALUE 0xc2132 TKW_VV_VV_UW 100.0 Def_f_uw_b512 0.0 511.9921 /begin FUNCTION_LIST PMPRSVCALC /end FUNCTION_LIST FORMAT "%6.3" /end CHARACTERISTIC
/begin CHARACTERISTIC K_MX_PTCPI "Maximalwert des PI-Reglers PTC Ansteuerung" VALUE 0xc2134 TKW_VV_VV_UW 100.0 Def_f_uw_b512 0.0 511.9921 /begin FUNCTION_LIST PMPRSVCALC /end FUNCTION_LIST FORMAT "%6.3" /end CHARACTERISTIC
/begin CHARACTERISTIC K_NKW2HIPTC "Nkw i.O. PTC darf zugeschaltet werden." VALUE 0xc2126 TKW_VV_VV_SW 100.0 Def_n_sw_q1p0 -32768.0000 32767.0000 /begin FUNCTION_LIST PMPRSVCALC /end FUNCTION_LIST /end CHARACTERISTIC
/begin CHARACTERISTIC K_NKW2LOWPTC "Nkw zu niedrig, PTC wird abgeschaltet" VALUE 0xc2128 TKW_VV_VV_SW 100.0 Def_n_sw_q1p0 -32768.0000 32767.0000 /begin FUNCTION_LIST PMPRSVCALC /end FUNCTION_LIST /end CHARACTERISTIC
/begin CHARACTERISTIC K_OSPGAPP "Oberspannungsschwelle" VALUE 0xc2098 TKW_VV_VV_UW 100.0 Def_u_uw_q0p25em3_o6 6.0000 22.3837 /begin FUNCTION_LIST PMDIAG /end FUNCTION_LIST FORMAT "%7.4" /end CHARACTERISTIC
/begin CHARACTERISTIC K_OSPGHYST "Unterspannungshysterese" VALUE 0xc2092 TKW_VV_VV_SW 100.0 Def_u_sw_q0p00025 -8.1920 8.1917 /begin FUNCTION_LIST PMDIAG /end FUNCTION_LIST FORMAT "%7.4" /end CHARACTERISTIC
/begin CHARACTERISTIC K_OSPGPRELLZ "Anzahl der Entprellungen für Oberspannungsfehlereintrag" VALUE 0xc20b0 TKW_VV_VV_UB 100.0 Def_dez_ub_q1 0.0 255.0000 /begin FUNCTION_LIST PMDIAG /end FUNCTION_LIST /end CHARACTERISTIC
/begin CHARACTERISTIC K_OSPRELLDEC "Dekrement auf Entprellcounter Oberspannung" VALUE 0xc20b1 TKW_VV_VV_UB 100.0 Def_dez_ub_q1 0.0 255.0000 /begin FUNCTION_LIST PMDIAG /end FUNCTION_LIST /end CHARACTERISTIC
/begin CHARACTERISTIC K_OSPRELLINC "Inkrement auf Entprellcounter Oberspannung" VALUE 0xc20b2 TKW_VV_VV_UB 100.0 Def_dez_ub_q1 0.0 255.0000 /begin FUNCTION_LIST PMDIAG /end FUNCTION_LIST /end CHARACTERISTIC
/begin CHARACTERISTIC K_OZANFANZ "BOS-Startanzeigewert Restlaufstrecke" VALUE 0xc2066 TKW_VV_VV_UW 100.0 Def_km_uw_q10 0.0 655350.0000 /begin FUNCTION_LIST OZRESTKM /end FUNCTION_LIST /end CHARACTERISTIC
/begin CHARACTERISTIC K_OZDAEMPF "" VALUE 0xc2079 TKW_VV_VV_UB 100.0 Def_f_ub_b1 0.0 0.9960 /begin FUNCTION_LIST OZRESTKM /end FUNCTION_LIST /end CHARACTERISTIC
/begin CHARACTERISTIC K_OZKMMAXK11 "Maximalintervall" VALUE 0xc2068 TKW_VV_VV_UW 100.0 Def_km_uw_q10 0.0 655350.0000 /begin FUNCTION_LIST OZRESTKM /end FUNCTION_LIST /end CHARACTERISTIC
/begin CHARACTERISTIC K_OZKVB96 "Typprüfkraftstoffverbrauch" VALUE 0xc207a TKW_VV_VV_UB 100.0 Def_f_ub_b32 0.0 31.8750 /begin FUNCTION_LIST OZRESTKM /end FUNCTION_LIST /end CHARACTERISTIC
/begin CHARACTERISTIC K_OZKVBMXK18 "maximal zulässige Gesamtkraftstoffbonusmenge" VALUE 0xc206a TKW_VV_VV_UW 100.0 Def_dez_uw_q1 0.0 65535.0000 /begin FUNCTION_LIST OZRESTKM /end FUNCTION_LIST /end CHARACTERISTIC
/begin CHARACTERISTIC K_OZKVBOK16 "Kraftstoffbonusmenge in [l] je 0,5l Ölnachfüllung" VALUE 0xc206c TKW_VV_VV_UW 100.0 Def_dez_uw_q1 0.0 65535.0000 /begin FUNCTION_LIST OZRESTKM /end FUNCTION_LIST /end CHARACTERISTIC
/begin CHARACTERISTIC K_OZLF1 "Länderfaktor 1 Festwert" VALUE 0xc207b TKW_VV_VV_UB 100.0 Def_lf_ub_q0p01 0.0 2.5500 /begin FUNCTION_LIST OZRESTKM /end FUNCTION_LIST /end CHARACTERISTIC
/begin CHARACTERISTIC K_OZLF2 "Länderfaktor 2 Festwert" VALUE 0xc207c TKW_VV_VV_UB 100.0 Def_lf_ub_q0p01 0.0 2.5500 /begin FUNCTION_LIST OZRESTKM /end FUNCTION_LIST /end CHARACTERISTIC
/begin CHARACTERISTIC K_OZMNKMBO "Wegstrecke ab der eine Bonuszuteilung erfolgt" VALUE 0xc206e TKW_VV_VV_UW 100.0 Def_km_uw_q10 0.0 655350.0000 /begin FUNCTION_LIST OZRESTKM /end FUNCTION_LIST /end CHARACTERISTIC
/begin CHARACTERISTIC K_OZMXOHK15 "Max Tage für den Ölservice" VALUE 0xc2070 TKW_VV_VV_UW 100.0 Def_dez_uw_q1 0.0 65535.0000 /begin FUNCTION_LIST OZRESTKM /end FUNCTION_LIST /end CHARACTERISTIC
/begin CHARACTERISTIC K_OZPERBOK17 "Er-Bonusbetrag je 0,5l Ölnachfüllung" VALUE 0xc2072 TKW_VV_VV_UW 100.0 Def_perm_uw_b6 0.0 5.9999 /begin FUNCTION_LIST OZRESTKM /end FUNCTION_LIST /end CHARACTERISTIC
/begin CHARACTERISTIC K_OZPERBRK14 "Begrenzungsfaktor für Restweg aus der Permittivität" VALUE 0xc207d TKW_VV_VV_UB 100.0 Def_kw_ub_q0p0234 0.0 5.9765 /begin FUNCTION_LIST OZRESTKM /end FUNCTION_LIST /end CHARACTERISTIC
/begin CHARACTERISTIC K_OZPERXK10 "zulässige Permittivitätsänderung im Ölwechselintervall" VALUE 0xc2074 TKW_VV_VV_UW 100.0 Def_perm_uw_b6 0.0 5.9999 /begin FUNCTION_LIST OZRESTKM /end FUNCTION_LIST /end CHARACTERISTIC
/begin CHARACTERISTIC K_OZSTATERR "" VALUE 0xc207e TKW_VV_VV_UB 100.0 Def_dez_ub_q1 0.0 255.0000 /begin FUNCTION_LIST OZRESTKM /end FUNCTION_LIST /end CHARACTERISTIC
/begin CHARACTERISTIC K_OZTAGCTERR "Wert für unplausibel Tagezähler" VALUE 0xc2076 TKW_VV_VV_UW 100.0 Def_dez_uw_q1 0.0 65535.0000 /begin FUNCTION_LIST OZRESTKM /end FUNCTION_LIST /end CHARACTERISTIC
/begin CHARACTERISTIC K_OZUEBERTEMP "Schwelle für die Ölsübertemperatur-Kontrolle" VALUE 0xc2064 TKW_VV_VV_SW 100.0 Def_t_sw_q0p1 -3276.8000 3276.7000 /begin FUNCTION_LIST OZRESTKM /end FUNCTION_LIST FORMAT "%4.1" /end CHARACTERISTIC
/begin CHARACTERISTIC K_OZUTFAK "Faktor für den Kraftstoffverbrauch bei Übertemperatur" VALUE 0xc207f TKW_VV_VV_UB 100.0 Def_dez_ub_q1 0.0 255.0000 /begin FUNCTION_LIST OZRESTKM /end FUNCTION_LIST /end CHARACTERISTIC
/begin CHARACTERISTIC K_OZZEITFAKT "Bereich der gesamten Laufstrecke wo die Berechnung des Zeit-RW Beainfluss hat" VALUE 0xc2078 TKW_VV_VV_UB 100.0 Def_f_ub_b1 0.0 0.9960 /begin FUNCTION_LIST OZRESTKM /end FUNCTION_LIST /end CHARACTERISTIC
/begin CHARACTERISTIC K_OZZEITINT "Zeitintervall für Ölwechsel in Monate (CBS4)" VALUE 0xc2080 TKW_VV_VV_UB 100.0 Def_dez_ub_q1 0.0 255.0000 /begin FUNCTION_LIST OZRESTKM /end FUNCTION_LIST /end CHARACTERISTIC
/begin CHARACTERISTIC K_PMQ_UX "Ruhespannung Extrapolationsteiler" VALUE 0xc23c2 TKW_VV_VV_UB 100.0 Def_f_ub_b8 0.0313 7.9687 /begin FUNCTION_LIST PMSOCCALC /end FUNCTION_LIST /end CHARACTERISTIC
/begin CHARACTERISTIC K_PMTIMERSQ1 "Startwert Timer für soc_quali" VALUE 0xc25b6 TKW_VV_VV_UW 100.0 Def_st_uw_q1 0.0 65535.0000 /begin FUNCTION_LIST PMSOCKOR /end FUNCTION_LIST /end CHARACTERISTIC
/begin CHARACTERISTIC K_PMUBAT_MAX "Max. zugelassene Batteriespg " VALUE 0xc263a TKW_VV_VV_UW 100.0 Def_u_uw_q0p25em3_o6 6.0000 22.3837 /begin FUNCTION_LIST PMUGENCALC /end FUNCTION_LIST FORMAT "%7.4" /end CHARACTERISTIC
/begin CHARACTERISTIC K_PMUBAT_MIN "Min. zugelassene Batteriespg" VALUE 0xc263c TKW_VV_VV_UW 100.0 Def_u_uw_q0p25em3_o6 6.0000 22.3837 /begin FUNCTION_LIST PMUGENCALC /end FUNCTION_LIST FORMAT "%7.4" /end CHARACTERISTIC
/begin CHARACTERISTIC K_PMUGEN_MAX "Max zugelassene Generatorspg" VALUE 0xc2630 TKW_VV_VV_SW 100.0 Def_u_sw_b128 -128.0000 127.9960 /begin FUNCTION_LIST PMUGENCALC /end FUNCTION_LIST FORMAT "%6.3" /end CHARACTERISTIC
/begin CHARACTERISTIC K_PMUGEN_MIN "Min zugelassene Generatorspg" VALUE 0xc2632 TKW_VV_VV_SW 100.0 Def_u_sw_b128 -128.0000 127.9960 /begin FUNCTION_LIST PMUGENCALC /end FUNCTION_LIST FORMAT "%6.3" /end CHARACTERISTIC
/begin CHARACTERISTIC K_PM_IPMON "IPM Massnahmen bzgl. PM aktiviert" VALUE 0xc217f TKW_VV_VV_UB 100.0 Def_dez_ub_q1 0.0 3.0000 /begin FUNCTION_LIST PMPRSVCALC /end FUNCTION_LIST /end CHARACTERISTIC
/begin CHARACTERISTIC K_PM_TABSMN "Applikationsgrösse für Abstellzeit tabsmn_w" VALUE 0xc25b8 TKW_VV_VV_UW 100.0 Def_td_uw_q1 0.0 65535.0000 /begin FUNCTION_LIST PMSOCKOR /end FUNCTION_LIST /end CHARACTERISTIC
/begin CHARACTERISTIC K_PRIO15 "Prios bei Kl.15, Motor aus" VALUE 0xc2180 TKW_VV_VV_UB 100.0 Def_dez_ub_q1 0.0 7.0000 /begin FUNCTION_LIST PMPRSVCALC /end FUNCTION_LIST /end CHARACTERISTIC
/begin CHARACTERISTIC K_PRIOCF15 "PrioCF bei kl.15, Motor aus" VALUE 0xc2181 TKW_VV_VV_UB 100.0 Def_dez_ub_q1 0.0 7.0000 /begin FUNCTION_LIST PMPRSVCALC /end FUNCTION_LIST /end CHARACTERISTIC
/begin CHARACTERISTIC K_PRIOCFAPP "Steuerung Spitzenreduzierung Prioritaet Komfort App" VALUE 0xc2182 TKW_VV_VV_UB 100.0 Def_dez_ub_q1 0.0 7.0000 /begin FUNCTION_LIST PMPRSVCALC /end FUNCTION_LIST /end CHARACTERISTIC
/begin CHARACTERISTIC K_PRIOCF_R "Prio Comfort Bei Kl.R" VALUE 0xc2183 TKW_VV_VV_UB 100.0 Def_dez_ub_q1 0.0 7.0000 /begin FUNCTION_LIST PMPRSVCALC /end FUNCTION_LIST /end CHARACTERISTIC
/begin CHARACTERISTIC K_PRIODF "" VAL_BLK 0xc21a4 TKW_VV_VV_UB 100.0 Def_dez_ub_q1 0.0 255.0000 /begin FUNCTION_LIST PMPRSVCALC /end FUNCTION_LIST NUMBER 7 /end CHARACTERISTIC
/begin CHARACTERISTIC K_PRIO_R "Prio Bei Kl.R" VALUE 0xc2184 TKW_VV_VV_UB 100.0 Def_dez_ub_q1 0.0 7.0000 /begin FUNCTION_LIST PMPRSVCALC /end FUNCTION_LIST /end CHARACTERISTIC
/begin CHARACTERISTIC K_PTCPWRAPP "Ansteuerung PWM-Ausgang für PTC-Zuheizer. Applikationsgroesse." VALUE 0xc2185 TKW_VV_VV_UB 100.0 Def_f_ub_b127p5 0.0 127.5000 /begin FUNCTION_LIST PMPRSVCALC /end FUNCTION_LIST /end CHARACTERISTIC
/begin CHARACTERISTIC K_PTC_PI "K-Faktor des PI-Reglers PTC-Ansteuerung" VALUE 0xc2186 TKW_VV_VV_UB 100.0 Def_f_ub_b1 0.0 0.9960 /begin FUNCTION_LIST PMPRSVCALC /end FUNCTION_LIST /end CHARACTERISTIC
/begin CHARACTERISTIC K_PWRCOS15 "PWRCOS bei Kl.15, Motor aus" VALUE 0xc2136 TKW_VV_VV_UW 100.0 Def_dez_uw_q1 0.0 65535.0000 /begin FUNCTION_LIST PMPRSVCALC /end FUNCTION_LIST /end CHARACTERISTIC
/begin CHARACTERISTIC K_PWRCOSAPP "Steuerung Leistung Verbraucher bitcodiert Applikationsgroesse" VALUE 0xc2138 TKW_VV_VV_UW 100.0 Def_dez_uw_q1 0.0 65535.0000 /begin FUNCTION_LIST PMPRSVCALC /end FUNCTION_LIST /end CHARACTERISTIC
/begin CHARACTERISTIC K_PWRCOS_R "PowerCos Bitcodiert bei Kl.R" VALUE 0xc213a TKW_VV_VV_UW 100.0 Def_dez_uw_q1 0.0 65535.0000 /begin FUNCTION_LIST PMPRSVCALC /end FUNCTION_LIST /end CHARACTERISTIC
/begin CHARACTERISTIC K_PWRDF_PI "K-Faktor des PI Reglers zur Berechnung von ctrpwrdf" VALUE 0xc2187 TKW_VV_VV_UB 100.0 Def_f_ub_b1 0.0 0.9960 /begin FUNCTION_LIST PMPRSVCALC /end FUNCTION_LIST /end CHARACTERISTIC
/begin CHARACTERISTIC K_QSOCCL1 "Grenze zur Ladezustandsqualitätsklasse1" VALUE 0xc25ba TKW_VV_VV_UW 100.0 Def_ql_uw_q0p0182 0.0 1193.0282 /begin FUNCTION_LIST PMSOCKOR /end FUNCTION_LIST FORMAT "%6.3" /end CHARACTERISTIC
/begin CHARACTERISTIC K_QSOCCL2 "Grenze zur Ladezustandsqualitätsklasse2" VALUE 0xc25bc TKW_VV_VV_UW 100.0 Def_ql_uw_q0p0182 0.0 1193.0282 /begin FUNCTION_LIST PMSOCKOR /end FUNCTION_LIST FORMAT "%6.3" /end CHARACTERISTIC
/begin CHARACTERISTIC K_QSOCCL3 "Grenze zur Ladezustandsqualitätsklasse3" VALUE 0xc25be TKW_VV_VV_UW 100.0 Def_ql_uw_q0p0182 0.0 1193.0282 /begin FUNCTION_LIST PMSOCKOR /end FUNCTION_LIST FORMAT "%6.3" /end CHARACTERISTIC
/begin CHARACTERISTIC K_QSTARTFGA "Applikationswert für q_startfgk" VALUE 0xc25c0 TKW_VV_VV_UW 100.0 Def_ql_uw_q0p0182 0.0 1193.0282 /begin FUNCTION_LIST PMSOCKOR /end FUNCTION_LIST FORMAT "%6.3" /end CHARACTERISTIC
/begin CHARACTERISTIC K_Q_BILAPWF "Defaultwert für q_bila nach Powerfail" VALUE 0xc23b8 TKW_VV_VV_UW 100.0 Def_ql_uw_q0p0182 0.0 1193.0282 /begin FUNCTION_LIST PMSOCCALC /end FUNCTION_LIST FORMAT "%6.3" /end CHARACTERISTIC
/begin CHARACTERISTIC K_RESET_PI "PI-Reset-Zeit bei steigender Kl.15" VALUE 0xc2188 TKW_VV_VV_UB 100.0 Def_td_ub_q0p1 0.0 25.5000 /begin FUNCTION_LIST PMPRSVCALC /end FUNCTION_LIST /end CHARACTERISTIC
/begin CHARACTERISTIC K_RIN_GRENZ1 "Grenzwert Innenwiderstand Batterie1" VALUE 0xc25fc TKW_VV_VV_UB 100.0 Def_f_ub_b32 0.0 31.8750 /begin FUNCTION_LIST PMSOCSTART /end FUNCTION_LIST /end CHARACTERISTIC
/begin CHARACTERISTIC K_RIN_GRENZ2 "Grenzwert Innenwiderstand Batterie2" VALUE 0xc25fd TKW_VV_VV_UB 100.0 Def_f_ub_b32 0.0 31.8750 /begin FUNCTION_LIST PMSOCSTART /end FUNCTION_LIST /end CHARACTERISTIC
/begin CHARACTERISTIC K_RIN_GRENZ3 "Grenzwert Innenwiderstand Batterie3" VALUE 0xc25fe TKW_VV_VV_UB 100.0 Def_f_ub_b32 0.0 31.8750 /begin FUNCTION_LIST PMSOCSTART /end FUNCTION_LIST /end CHARACTERISTIC
/begin CHARACTERISTIC K_RIN_GRENZ4 "Grenzwert Innenwiderstand Batterie4" VALUE 0xc25ff TKW_VV_VV_UB 100.0 Def_f_ub_b32 0.0 31.8750 /begin FUNCTION_LIST PMSOCSTART /end FUNCTION_LIST /end CHARACTERISTIC
/begin CHARACTERISTIC K_RIN_GRENZ5 "Grenzwert Innenwiderstand Batterie5" VALUE 0xc2600 TKW_VV_VV_UB 100.0 Def_f_ub_b32 0.0 31.8750 /begin FUNCTION_LIST PMSOCSTART /end FUNCTION_LIST /end CHARACTERISTIC
/begin CHARACTERISTIC K_RIN_GRENZ6 "Grenzwert Innenwiderstand Batterie6" VALUE 0xc2601 TKW_VV_VV_UB 100.0 Def_f_ub_b32 0.0 31.8750 /begin FUNCTION_LIST PMSOCSTART /end FUNCTION_LIST /end CHARACTERISTIC
/begin CHARACTERISTIC K_RIN_GRENZ7 "Grenzwert Innenwiderstand Batterie7" VALUE 0xc2602 TKW_VV_VV_UB 100.0 Def_f_ub_b32 0.0 31.8750 /begin FUNCTION_LIST PMSOCSTART /end FUNCTION_LIST /end CHARACTERISTIC
/begin CHARACTERISTIC K_RIN_GRENZ8 "Grenzwert Innenwiderstand Batterie8" VALUE 0xc2603 TKW_VV_VV_UB 100.0 Def_f_ub_b32 0.0 31.8750 /begin FUNCTION_LIST PMSOCSTART /end FUNCTION_LIST /end CHARACTERISTIC
/begin CHARACTERISTIC K_RQPCOSA "Parameter für SV-Anmeldung" VALUE 0xc2189 TKW_VV_VV_UB 100.0 Def_dez_ub_q1 0.0 3.0000 /begin FUNCTION_LIST PMPRSVCALC /end FUNCTION_LIST /end CHARACTERISTIC
/begin CHARACTERISTIC K_RQPCOSAPP "Anforderung Standverbraucher Applikationsgroesse" VALUE 0xc218a TKW_VV_VV_UB 100.0 Def_dez_ub_q1 0.0 3.0000 /begin FUNCTION_LIST PMPRSVCALC /end FUNCTION_LIST /end CHARACTERISTIC
/begin CHARACTERISTIC K_RQPCOSB "RQPCOS Master umschalter" VALUE 0xc218b TKW_VV_VV_UB 100.0 Def_dez_ub_q1 0.0 4.0000 /begin FUNCTION_LIST PMPRSVCALC /end FUNCTION_LIST /end CHARACTERISTIC
/begin CHARACTERISTIC K_RUHVERMODE "Ruhestromverletzungserkennungsmode" VALUE 0xc20b3 TKW_VV_VV_UB 100.0 Def_dez_ub_q1 0.0 255.0000 /begin FUNCTION_LIST PMDIAG /end FUNCTION_LIST /end CHARACTERISTIC
/begin CHARACTERISTIC K_SELSPCOSA "Spezialverbraucher" VALUE 0xc218c TKW_VV_VV_UB 100.0 Def_dez_ub_q1 0.0 15.0000 /begin FUNCTION_LIST PMPRSVCALC /end FUNCTION_LIST /end CHARACTERISTIC
/begin CHARACTERISTIC K_SELSPCSAPP "Auswahl Sonderverbraucher Applikationsgroesse" VALUE 0xc218d TKW_VV_VV_UB 100.0 Def_dez_ub_q1 0.0 15.0000 /begin FUNCTION_LIST PMPRSVCALC /end FUNCTION_LIST /end CHARACTERISTIC
/begin CHARACTERISTIC K_SOCFITAPP "Applikationwert Soc aus der Fitberechnung" VALUE 0xc2422 TKW_VV_VV_UW 100.0 Def_f_uw_b100 0.0 99.9984 /begin FUNCTION_LIST PMSOCFIT /end FUNCTION_LIST FORMAT "%6.3" /end CHARACTERISTIC
/begin CHARACTERISTIC K_SOCFITGRZ "Grenzwert für soc_fit" VALUE 0xc25c2 TKW_VV_VV_UW 100.0 Def_f_uw_b100 0.0 99.9984 /begin FUNCTION_LIST PMSOCKOR /end FUNCTION_LIST FORMAT "%6.3" /end CHARACTERISTIC
/begin CHARACTERISTIC K_SOCFITLIMH "Applikationskonstante zur Verbesserung SoC aus der Fitberechnung" VALUE 0xc25c4 TKW_VV_VV_UW 100.0 Def_f_uw_b100 0.0 99.9984 /begin FUNCTION_LIST PMSOCKOR /end FUNCTION_LIST FORMAT "%6.3" /end CHARACTERISTIC
/begin CHARACTERISTIC K_SOCFITLIML "Applikationskonstante zur Abwertung SoC aus der Fitberechnung" VALUE 0xc25c6 TKW_VV_VV_UW 100.0 Def_f_uw_b100 0.0 99.9984 /begin FUNCTION_LIST PMSOCKOR /end FUNCTION_LIST FORMAT "%6.3" /end CHARACTERISTIC
/begin CHARACTERISTIC K_SOC_BILAWA "Applikationswert soc_bila" VALUE 0xc23ba TKW_VV_VV_UW 100.0 Def_f_uw_b100 0.0 99.9984 /begin FUNCTION_LIST PMSOCCALC /end FUNCTION_LIST FORMAT "%6.3" /end CHARACTERISTIC
/begin CHARACTERISTIC K_SOC_QPWF "Ladezustandsqualität nach Powerfail" VALUE 0xc23bc TKW_VV_VV_UW 100.0 Def_ql_uw_q0p0182 0.0 1193.0282 /begin FUNCTION_LIST PMSOCCALC /end FUNCTION_LIST FORMAT "%6.3" /end CHARACTERISTIC
/begin CHARACTERISTIC K_SOC_QUALIA "Applikationswert soc_quali" VALUE 0xc23be TKW_VV_VV_UW 100.0 Def_ql_uw_q0p0182 0.0 1193.0282 /begin FUNCTION_LIST PMSOCCALC /end FUNCTION_LIST FORMAT "%6.3" /end CHARACTERISTIC
/begin CHARACTERISTIC K_SOC_STAFGA "Applikationswert für SoC aus der Startfähigkeit" VALUE 0xc25c8 TKW_VV_VV_UW 100.0 Def_f_uw_b100 0.0 99.9984 /begin FUNCTION_LIST PMSOCKOR /end FUNCTION_LIST FORMAT "%6.3" /end CHARACTERISTIC
/begin CHARACTERISTIC K_STPCOSAPP "Status Standverbraucher Applikationsgroesse" VALUE 0xc218e TKW_VV_VV_UB 100.0 Def_dez_ub_q1 0.0 3.0000 /begin FUNCTION_LIST PMPRSVCALC /end FUNCTION_LIST /end CHARACTERISTIC
/begin CHARACTERISTIC K_T1PMINFO "T1 Zykluszeit fuer PM Fehlerinfo" VALUE 0xc20b4 TKW_VV_VV_UB 100.0 Def_td_ub_q0p1 0.0 25.5000 /begin FUNCTION_LIST PMDIAG /end FUNCTION_LIST /end CHARACTERISTIC
/begin CHARACTERISTIC K_T2PMINFO "T2 Zykluszeit fuer PM Fehlerinfo" VALUE 0xc209a TKW_VV_VV_UW 100.0 Def_td_uw_q0p1 0.0 6553.5000 /begin FUNCTION_LIST PMDIAG /end FUNCTION_LIST FORMAT "%4.1" /end CHARACTERISTIC
/begin CHARACTERISTIC K_T3PMINFO "T3 Zykluszeit fuer PM Fehlerinfo" VALUE 0xc209c TKW_VV_VV_UW 100.0 Def_td_uw_q0p1 0.0 6553.5000 /begin FUNCTION_LIST PMDIAG /end FUNCTION_LIST FORMAT "%4.1" /end CHARACTERISTIC
/begin CHARACTERISTIC K_TBATNACHL "B_ccbtnach wird nach dieser Zeit aktiviert" VALUE 0xc209e TKW_VV_VV_UW 100.0 Def_td_uw_q0p1 0.0 6553.5000 /begin FUNCTION_LIST PMDIAG /end FUNCTION_LIST FORMAT "%4.1" /end CHARACTERISTIC
/begin CHARACTERISTIC K_TCODIERPM "T1 Zyklus fuer Fehlerinfo" VALUE 0xc20b5 TKW_VV_VV_UB 100.0 Def_td_ub_q0p1 0.0 25.5000 /begin FUNCTION_LIST PMDIAG /end FUNCTION_LIST /end CHARACTERISTIC
/begin CHARACTERISTIC K_TD_BNMOT "Zeit nach Motorlauf, wo die stufenweise (USTEPMIN) Berechnung von uibs aktiviert wird." VALUE 0xc263f TKW_VV_VV_UB 100.0 Def_td_ub_q1 0.0 255.0000 /begin FUNCTION_LIST PMUGENCALC /end FUNCTION_LIST /end CHARACTERISTIC
/begin CHARACTERISTIC K_TD_PMUGEN "Taskzeit von PMUGENCALC, = Zeit wo die stufenweise Setzung von uibs berechnet wird." VALUE 0xc2640 TKW_VV_VV_UB 100.0 Def_td_ub_q1 0.0 255.0000 /begin FUNCTION_LIST PMUGENCALC /end FUNCTION_LIST /end CHARACTERISTIC
/begin CHARACTERISTIC K_TD_PWRDFPI "K-Faktor des PI Reglers zur Berechnung von ctrpwrdf" VALUE 0xc213c TKW_VV_VV_UW 100.0 Def_td_uw_q0p1 0.1000 6553.5000 /begin FUNCTION_LIST PMPRSVCALC /end FUNCTION_LIST FORMAT "%4.1" /end CHARACTERISTIC
/begin CHARACTERISTIC K_TIME_START "Zeittriggerschwelle nach Motorstart" VALUE 0xc25f6 TKW_VV_VV_UW 100.0 Def_td_uw_q0p01 0.0 655.3500 /begin FUNCTION_LIST PMSOCSTART /end FUNCTION_LIST FORMAT "%5.2" /end CHARACTERISTIC
/begin CHARACTERISTIC K_TRINGSHIFT "Ruhezeit nachdem der Ruhestrom-Ringspeicher eingetragen wird." VALUE 0xc20b6 TKW_VV_VV_UB 100.0 Def_td_ub_q14p9333 0.0 3808.0000 /begin FUNCTION_LIST PMDIAG /end FUNCTION_LIST /end CHARACTERISTIC
/begin CHARACTERISTIC K_TSAISONFIL "Filterkonstante für t_saison" VALUE 0xc25ca TKW_VV_VV_UW 100.0 Def_dez_uw_q1 1.0000 65535.0000 /begin FUNCTION_LIST PMSOCKOR /end FUNCTION_LIST /end CHARACTERISTIC
/begin CHARACTERISTIC K_T_BNSDELAY "Delayzeit nach Motorstartende für BNS Überwachung" VALUE 0xc2089 TKW_VV_VV_UB 100.0 Def_td_ub_q1 0.0 255.0000 /begin FUNCTION_LIST PMBNSTAB /end FUNCTION_LIST /end CHARACTERISTIC
/begin CHARACTERISTIC K_T_CCRUHVER "Dauer fuer CC-Meld. erhoehter Ruhestrom" VALUE 0xc20a0 TKW_VV_VV_UW 100.0 Def_td_uw_q0p1 0.0 6553.5000 /begin FUNCTION_LIST PMDIAG /end FUNCTION_LIST FORMAT "%4.1" /end CHARACTERISTIC
/begin CHARACTERISTIC K_T_IPMPRIO "max. Zeit, indem Prio aufgrund IPM gesteuert wird" VALUE 0xc218f TKW_VV_VV_UB 100.0 Def_td_ub_q0p1 0.0 25.5000 /begin FUNCTION_LIST PMPRSVCALC /end FUNCTION_LIST /end CHARACTERISTIC
/begin CHARACTERISTIC K_T_NKPTCAUS "Zeit PTC aus aufgrund NKW zu niedrig." VALUE 0xc2190 TKW_VV_VV_UB 100.0 Def_td_ub_q0p1 0.0 25.5000 /begin FUNCTION_LIST PMPRSVCALC /end FUNCTION_LIST /end CHARACTERISTIC
/begin CHARACTERISTIC K_T_OSPGRSET "Zeit für 1x Oberspannungsentprellungrücknahme" VALUE 0xc20b7 TKW_VV_VV_UB 100.0 Def_td_ub_q0p1 0.0 25.5000 /begin FUNCTION_LIST PMDIAG /end FUNCTION_LIST /end CHARACTERISTIC
/begin CHARACTERISTIC K_T_OSPGSET "Entrpellzeit FS_oberspannungserkennung" VALUE 0xc20b8 TKW_VV_VV_UB 100.0 Def_td_ub_q0p1 0.0 25.5000 /begin FUNCTION_LIST PMDIAG /end FUNCTION_LIST /end CHARACTERISTIC
/begin CHARACTERISTIC K_T_PMBS "Zeit bis zum nächsten zyklischen senden" VALUE 0xc2191 TKW_VV_VV_UB 100.0 Def_td_ub_q1 0.0 255.0000 /begin FUNCTION_LIST PMPRSVCALC /end FUNCTION_LIST /end CHARACTERISTIC
/begin CHARACTERISTIC K_T_PMVS "Zeit zwischen zwei zyklischen Sendungen von 3b3 " VALUE 0xc2192 TKW_VV_VV_UB 100.0 Def_td_ub_q1 0.0 255.0000 /begin FUNCTION_LIST PMPRSVCALC /end FUNCTION_LIST /end CHARACTERISTIC
/begin CHARACTERISTIC K_T_PTCKWAN "PTC-Ein Wartezeit nach Motor an." VALUE 0xc2193 TKW_VV_VV_UB 100.0 Def_td_ub_q0p1 0.0 25.5000 /begin FUNCTION_LIST PMPRSVCALC /end FUNCTION_LIST /end CHARACTERISTIC
/begin CHARACTERISTIC K_T_PTCPI "T-Faktor des PI-Reglers für PTC-Ansteuerung" VALUE 0xc213e TKW_VV_VV_UW 100.0 Def_td_uw_q0p1 0.1000 6553.5000 /begin FUNCTION_LIST PMPRSVCALC /end FUNCTION_LIST FORMAT "%4.1" /end CHARACTERISTIC
/begin CHARACTERISTIC K_T_RUHAUSW "Minimal verstrichene Zeit für Ruheverl. Auswertung" VALUE 0xc20b9 TKW_VV_VV_UB 100.0 Def_td_ub_q14p9333 0.0 3808.0000 /begin FUNCTION_LIST PMDIAG /end FUNCTION_LIST /end CHARACTERISTIC
/begin CHARACTERISTIC K_T_USPGRSET "Uterspannung Resetzeit" VALUE 0xc20ba TKW_VV_VV_UB 100.0 Def_td_ub_q0p1 0.0 25.5000 /begin FUNCTION_LIST PMDIAG /end FUNCTION_LIST /end CHARACTERISTIC
/begin CHARACTERISTIC K_T_USPGSET "Zeit für 1x Unterspannungsentprellung" VALUE 0xc20bb TKW_VV_VV_UB 100.0 Def_td_ub_q0p1 0.0 25.5000 /begin FUNCTION_LIST PMDIAG /end FUNCTION_LIST /end CHARACTERISTIC
/begin CHARACTERISTIC K_T_VERBON "Verzugszeit Verbraucherzuschaltung nach Aufhebung Genertorreduzierung" VALUE 0xc268b TKW_VV_VV_UB 100.0 Def_td_ub_q0p1 0.0 25.5000 /begin FUNCTION_LIST UGENKOR /end FUNCTION_LIST /end CHARACTERISTIC
/begin CHARACTERISTIC K_UBAT_LP "K-Faktor des ubatt-tiefpass Filters zur Berechnung von ctrpwrdf" VALUE 0xc2140 TKW_VV_VV_UW 100.0 Def_f_uw_b1 0.0 9.99984741210938e-1 /begin FUNCTION_LIST PMPRSVCALC /end FUNCTION_LIST /end CHARACTERISTIC
/begin CHARACTERISTIC K_UBNS "" VALUE 0xc2680 TKW_VV_VV_UW 100.0 Def_u_uw_q0p1 0.0 6553.5000 /begin FUNCTION_LIST UGENKOR /end FUNCTION_LIST FORMAT "%6.3" /end CHARACTERISTIC
/begin CHARACTERISTIC K_UBPTC_LP "K-Faktor des ubatt-Tiefpass Filters zur Berechnung von PTC" VALUE 0xc2142 TKW_VV_VV_UW 100.0 Def_f_uw_b1 0.0 9.99984741210938e-1 /begin FUNCTION_LIST PMPRSVCALC /end FUNCTION_LIST /end CHARACTERISTIC
/begin CHARACTERISTIC K_UBTAPP "Batteriespannung Applikationsgroesse" VALUE 0xc2144 TKW_VV_VV_UW 100.0 Def_u_uw_q0p015 0.0 61.4250 /begin FUNCTION_LIST PMPRSVCALC /end FUNCTION_LIST FORMAT "%6.3" /end CHARACTERISTIC
/begin CHARACTERISTIC K_UBTLOWMAX "Obere Unterspannungsgrenze" VALUE 0xc2146 TKW_VV_VV_UW 100.0 Def_u_uw_q0p25em3_o6 6.0000 16.0000 /begin FUNCTION_LIST PMPRSVCALC /end FUNCTION_LIST FORMAT "%7.4" /end CHARACTERISTIC
/begin CHARACTERISTIC K_UBTLOWMIN "Untere Unterspannungsgrenze" VALUE 0xc2148 TKW_VV_VV_UW 100.0 Def_u_uw_q0p25em3_o6 6.0000 16.0000 /begin FUNCTION_LIST PMPRSVCALC /end FUNCTION_LIST FORMAT "%7.4" /end CHARACTERISTIC
/begin CHARACTERISTIC K_UB_GRENZ "Grenzwert Gradient d. Bordnetzspannung" VALUE 0xc25f8 TKW_VV_VV_UW 100.0 Def_u_uw_q0p0942 0.0 6173.3970 /begin FUNCTION_LIST PMSOCSTART /end FUNCTION_LIST FORMAT "%4.1" /end CHARACTERISTIC
/begin CHARACTERISTIC K_UGENDELTA "" VALUE 0xc2682 TKW_VV_VV_UW 100.0 Def_u_uw_q0p1 0.0 6553.5000 /begin FUNCTION_LIST UGENKOR /end FUNCTION_LIST FORMAT "%6.3" /end CHARACTERISTIC
/begin CHARACTERISTIC K_UGENNORM "Generator Normspannung" VALUE 0xc2634 TKW_VV_VV_SW 100.0 Def_u_sw_b128 -128.0000 127.9960 /begin FUNCTION_LIST PMUGENCALC /end FUNCTION_LIST FORMAT "%6.3" /end CHARACTERISTIC
/begin CHARACTERISTIC K_UGENOFF "Generatorauschaltspannung bei vfzg = 0" VALUE 0xc2684 TKW_VV_VV_UW 100.0 Def_u_uw_q0p1 0.0 6553.5000 /begin FUNCTION_LIST UGENKOR /end FUNCTION_LIST FORMAT "%6.3" /end CHARACTERISTIC
/begin CHARACTERISTIC K_UGENOFFV0 "Generatorauschaltspannung bei vfzg != 0" VALUE 0xc2686 TKW_VV_VV_UW 100.0 Def_u_uw_q0p1 0.0 6553.5000 /begin FUNCTION_LIST UGENKOR /end FUNCTION_LIST FORMAT "%6.3" /end CHARACTERISTIC
/begin CHARACTERISTIC K_UIBSAPP "Manueller Applikationswert von Uibs an UGENKOR" VALUE 0xc2636 TKW_VV_VV_SW 100.0 Def_u_sw_b128 -128.0000 127.9960 /begin FUNCTION_LIST PMUGENCALC /end FUNCTION_LIST FORMAT "%6.3" /end CHARACTERISTIC
/begin CHARACTERISTIC K_ULEVA "Spannungslevel" VALUE 0xc2194 TKW_VV_VV_UB 100.0 Def_dez_ub_q1 0.0 255.0000 /begin FUNCTION_LIST PMPRSVCALC /end FUNCTION_LIST /end CHARACTERISTIC
/begin CHARACTERISTIC K_ULEVAPP "Spannungsebene Applikationsgroesse" VALUE 0xc2195 TKW_VV_VV_UB 100.0 Def_dez_ub_q1 0.0 15.0000 /begin FUNCTION_LIST PMPRSVCALC /end FUNCTION_LIST /end CHARACTERISTIC
/begin CHARACTERISTIC K_ULOWSETAPP "Entrpellzeit zentrale Unterspannung" VALUE 0xc2196 TKW_VV_VV_UB 100.0 Def_td_ub_q0p1 0.0 25.5000 /begin FUNCTION_LIST PMPRSVCALC /end FUNCTION_LIST /end CHARACTERISTIC
/begin CHARACTERISTIC K_USPGAPP "Unterspannungschwelle" VALUE 0xc20a2 TKW_VV_VV_UW 100.0 Def_u_uw_q0p25em3_o6 6.0000 22.3837 /begin FUNCTION_LIST PMDIAG /end FUNCTION_LIST FORMAT "%7.4" /end CHARACTERISTIC
/begin CHARACTERISTIC K_USPGHYST "Unterspannungshysterese" VALUE 0xc2094 TKW_VV_VV_SW 100.0 Def_u_sw_q0p00025 -8.1920 8.1917 /begin FUNCTION_LIST PMDIAG /end FUNCTION_LIST FORMAT "%7.4" /end CHARACTERISTIC
/begin CHARACTERISTIC K_USPGPRELLZ "Anzahl der FS_uspg Entprellungen für Fehlereintrag" VALUE 0xc20bc TKW_VV_VV_UB 100.0 Def_dez_ub_q1 0.0 255.0000 /begin FUNCTION_LIST PMDIAG /end FUNCTION_LIST /end CHARACTERISTIC
/begin CHARACTERISTIC K_USPRELLDEC "Dekrement auf Entprellcounter Unterspannung" VALUE 0xc20bd TKW_VV_VV_UB 100.0 Def_dez_ub_q1 0.0 255.0000 /begin FUNCTION_LIST PMDIAG /end FUNCTION_LIST /end CHARACTERISTIC
/begin CHARACTERISTIC K_USPRELLINC "Inkrement auf Entprellcounter Unterspannung" VALUE 0xc20be TKW_VV_VV_UB 100.0 Def_dez_ub_q1 0.0 255.0000 /begin FUNCTION_LIST PMDIAG /end FUNCTION_LIST /end CHARACTERISTIC
/begin CHARACTERISTIC K_USTARTGRZ "Spannungsgrenzwert für Startauswertung " VALUE 0xc25fa TKW_VV_VV_UW 100.0 Def_u_uw_q0p25em3_o6 6.0000 22.3837 /begin FUNCTION_LIST PMSOCSTART /end FUNCTION_LIST FORMAT "%7.4" /end CHARACTERISTIC
/begin CHARACTERISTIC K_USTEPMIN "Min. Delta zw. Battsollspg und Battspg damit uibs veraendert wird." VALUE 0xc2638 TKW_VV_VV_SW 100.0 Def_u_sw_b128 -128.0000 127.9960 /begin FUNCTION_LIST PMUGENCALC /end FUNCTION_LIST FORMAT "%6.3" /end CHARACTERISTIC
/begin CHARACTERISTIC S_ABSCHK "Schalter für Applikationswert absch_korr" VALUE 0xc25cc TKW_VV_VV_UB 100.0 Def_dez_ub_q1 0.0 255.0000 /begin FUNCTION_LIST PMSOCKOR /end FUNCTION_LIST /end CHARACTERISTIC
/begin CHARACTERISTIC S_BNSCLRAPP "BNS Daten löschen" VALUE 0xc208a TKW_VV_VV_UB 100.0 Def_dez_ub_q1 0.0 255.0000 /begin FUNCTION_LIST PMBNSTAB /end FUNCTION_LIST /end CHARACTERISTIC
/begin CHARACTERISTIC S_BSOCCALC "Enable Rücksetzten Ruhespannungen IBS" VALUE 0xc23c3 TKW_VV_VV_UB 100.0 Def_dez_ub_q1 0.0 255.0000 /begin FUNCTION_LIST PMSOCCALC /end FUNCTION_LIST /end CHARACTERISTIC
/begin CHARACTERISTIC S_DSOCS "Schalter für Applikationswert Delta SoC" VALUE 0xc25cd TKW_VV_VV_UB 100.0 Def_dez_ub_q1 0.0 255.0000 /begin FUNCTION_LIST PMSOCKOR /end FUNCTION_LIST /end CHARACTERISTIC
/begin CHARACTERISTIC S_GOFFRAMP "Schalter Sprung auf 10,6V unverzoegert" VALUE 0xc268c TKW_VV_VV_UB 100.0 Def_st_ub_q1 0.0 255.0000 /begin FUNCTION_LIST UGENKOR /end FUNCTION_LIST /end CHARACTERISTIC
/begin CHARACTERISTIC S_NKWITNSTRT "0 = Nkw-Auswertung, 1=Itnstart Auswertung" VALUE 0xc2604 TKW_VV_VV_UB 100.0 Identity 0.0 1.0000 /begin FUNCTION_LIST PMSOCSTART /end FUNCTION_LIST /end CHARACTERISTIC
/begin CHARACTERISTIC S_PMMESS "Schalter Messemode aktiv" VALUE 0xc2197 TKW_VV_VV_UB 100.0 Identity 0.0 1.0000 /begin FUNCTION_LIST PMPRSVCALC /end FUNCTION_LIST /end CHARACTERISTIC
/begin CHARACTERISTIC S_PMSOCFIT "Schalter zur Applikation SoC aus der Fitberechnung" VALUE 0xc2426 TKW_VV_VV_UB 100.0 Def_dez_ub_q1 0.0 255.0000 /begin FUNCTION_LIST PMSOCFIT /end FUNCTION_LIST /end CHARACTERISTIC
/begin CHARACTERISTIC S_PMSTARTQ "Applikationsschalter f. B_pmstartq" VALUE 0xc2605 TKW_VV_VV_UB 100.0 Def_dez_ub_q1 0.0 255.0000 /begin FUNCTION_LIST PMSOCSTART /end FUNCTION_LIST /end CHARACTERISTIC
/begin CHARACTERISTIC S_PMSV_HEIZ "Standheizen wird für Nibble-historie ausgewertet" VALUE 0xc20bf TKW_VV_VV_UB 100.0 Identity 0.0 1.0000 /begin FUNCTION_LIST PMDIAG /end FUNCTION_LIST /end CHARACTERISTIC
/begin CHARACTERISTIC S_PMSV_KLIMA "Standklimatisierung wird für Nibble-historie ausgewertet" VALUE 0xc20c0 TKW_VV_VV_UB 100.0 Identity 0.0 1.0000 /begin FUNCTION_LIST PMDIAG /end FUNCTION_LIST /end CHARACTERISTIC
/begin CHARACTERISTIC S_PMSV_LUFT "Standlueften wird für Nibble-historie ausgewertet" VALUE 0xc20c1 TKW_VV_VV_UB 100.0 Identity 0.0 1.0000 /begin FUNCTION_LIST PMDIAG /end FUNCTION_LIST /end CHARACTERISTIC
/begin CHARACTERISTIC S_PMTABSMN "Schalter für Applikation der Abstellzeit tabsmn_w" VALUE 0xc25ce TKW_VV_VV_UB 100.0 Def_dez_ub_q1 0.0 255.0000 /begin FUNCTION_LIST PMSOCKOR /end FUNCTION_LIST /end CHARACTERISTIC
/begin CHARACTERISTIC S_PM_TEST1 "Applikationsschalter um die Startberechnung zu erzwingen" VALUE 0xc2606 TKW_VV_VV_UB 100.0 Def_dez_ub_q1 0.0 255.0000 /begin FUNCTION_LIST PMSOCSTART /end FUNCTION_LIST /end CHARACTERISTIC
/begin CHARACTERISTIC S_PRIOMANUAL "Manueller Schalter fuer E60/E65-Can Botschaften" VALUE 0xc2198 TKW_VV_VV_UB 100.0 Def_dez_ub_q1 0.0 255.0000 /begin FUNCTION_LIST PMPRSVCALC /end FUNCTION_LIST /end CHARACTERISTIC
/begin CHARACTERISTIC S_PTCKOOR "Schalter Aktivierung PTC Koordinator im PMPRSVCALC" VALUE 0xc2199 TKW_VV_VV_UB 100.0 Identity 0.0 1.0000 /begin FUNCTION_LIST PMPRSVCALC /end FUNCTION_LIST /end CHARACTERISTIC
/begin CHARACTERISTIC S_PTCMANUAL "Schalter manueller PTC Wert aktivieren." VALUE 0xc219a TKW_VV_VV_UB 100.0 Identity 0.0 1.0000 /begin FUNCTION_LIST PMPRSVCALC /end FUNCTION_LIST /end CHARACTERISTIC
/begin CHARACTERISTIC S_QSTARTFK "Schalter für Applikation q_startfgk" VALUE 0xc25cf TKW_VV_VV_UB 100.0 Def_dez_ub_q1 0.0 255.0000 /begin FUNCTION_LIST PMSOCKOR /end FUNCTION_LIST /end CHARACTERISTIC
/begin CHARACTERISTIC S_RIN "Schalter Applikation Innenwiderstandsprüfung" VALUE 0xc2607 TKW_VV_VV_UB 100.0 Def_dez_ub_q1 0.0 255.0000 /begin FUNCTION_LIST PMSOCSTART /end FUNCTION_LIST /end CHARACTERISTIC
/begin CHARACTERISTIC S_SOCSTAFK "Schalter für Applikation SoC aus der Startfähigkeit" VALUE 0xc25d0 TKW_VV_VV_UB 100.0 Def_dez_ub_q1 0.0 255.0000 /begin FUNCTION_LIST PMSOCKOR /end FUNCTION_LIST /end CHARACTERISTIC
/begin CHARACTERISTIC S_SOC_BILA "Schalter für Applik. soc_bila" VALUE 0xc23c4 TKW_VV_VV_UB 100.0 Def_dez_ub_q1 0.0 255.0000 /begin FUNCTION_LIST PMSOCCALC /end FUNCTION_LIST /end CHARACTERISTIC
/begin CHARACTERISTIC S_SOC_QUAL "Schalter für Applik. soc_quali" VALUE 0xc23c5 TKW_VV_VV_UB 100.0 Def_dez_ub_q1 0.0 255.0000 /begin FUNCTION_LIST PMSOCCALC /end FUNCTION_LIST /end CHARACTERISTIC
/begin CHARACTERISTIC S_STARTAW "Startauswertung fertig" VALUE 0xc2608 TKW_VV_VV_UB 100.0 Def_dez_ub_q1 0.0 255.0000 /begin FUNCTION_LIST PMSOCSTART /end FUNCTION_LIST /end CHARACTERISTIC
/begin CHARACTERISTIC S_UIBS "Schalter für UIBS, wenn True dann uibs=UIBSAPP" VALUE 0xc2641 TKW_VV_VV_UB 100.0 Identity 0.0 1.0000 /begin FUNCTION_LIST PMUGENCALC /end FUNCTION_LIST /end CHARACTERISTIC
/begin CHARACTERISTIC ZK_PMSOC "Zeitfaktor" VALUE 0xc2424 TKW_VV_VV_UW 100.0 Def_f_uw_b1 0.0 9.99984741210938e-1 /begin FUNCTION_LIST PMSOCFIT /end FUNCTION_LIST /end CHARACTERISTIC
/begin MEASUREMENT Absch_korr "Korrekturwert Abschaltung" SWORD Def_f_sw_q0p00153 0 0 -40.0000 40.0000 ECU_ADDRESS 0x7FDFF6 /begin FUNCTION_LIST PMSOCKOR /end FUNCTION_LIST /end MEASUREMENT
/begin MEASUREMENT All2ptc "Gesamtgewichtung für PTC-Ansteuerung" SWORD Def_f_sw_p0q25 0 0 -500.0000 550.0000 ECU_ADDRESS 0x7FDF56 /begin FUNCTION_LIST PMPRSVCALC /end FUNCTION_LIST /end MEASUREMENT
/begin MEASUREMENT Allptcfilt "pi-geregelte Gewichtung für PTC-Ansteuerung" UWORD Def_f_uw_q0p25 0 0 0.0 550.0000 ECU_ADDRESS 0x7FDF7C /begin FUNCTION_LIST PMPRSVCALC /end FUNCTION_LIST /end MEASUREMENT
/begin MEASUREMENT Batt_index "Batterie Index" UBYTE Def_dez_ub_q1 0 0 0.0 255.0000 ECU_ADDRESS 0x7FDF38 /begin FUNCTION_LIST PMDIAG /end FUNCTION_LIST /end MEASUREMENT
/begin MEASUREMENT Bnctrmx1s "" UBYTE Def_dez_ub_q1 0 0 0.0 255.0000 ECU_ADDRESS 0x7FDEB0 /begin FUNCTION_LIST PMBNSTAB /end FUNCTION_LIST /end MEASUREMENT
/begin MEASUREMENT Bnsctr "Counter Bordnetzspannungsplausibilisierung" UBYTE Def_dez_ub_q1 0 0 0.0 255.0000 ECU_ADDRESS 0x7FDEAE /begin FUNCTION_LIST PMBNSTAB /end FUNCTION_LIST /end MEASUREMENT
/begin MEASUREMENT Bnsctrant0 "Counter 1 sec-Anteile ohne Grenzwertüberschreitung" ULONG Def_dez_ul_q1 0 0 0.0 4294967295.0000 ECU_ADDRESS 0x7FDEA4 /begin FUNCTION_LIST PMBNSTAB /end FUNCTION_LIST /end MEASUREMENT
/begin MEASUREMENT Bnsctrant1 "Counter 1 sec-Anteile 1. Bereich" UWORD Def_dez_uw_q1 0 0 0.0 65535.0000 ECU_ADDRESS 0x7FDEA8 /begin FUNCTION_LIST PMBNSTAB /end FUNCTION_LIST /end MEASUREMENT
/begin MEASUREMENT Bnsctrant2 "Counter 1 sec-Anteile 2. Bereich" UWORD Def_dez_uw_q1 0 0 0.0 65535.0000 ECU_ADDRESS 0x7FDEAA /begin FUNCTION_LIST PMBNSTAB /end FUNCTION_LIST /end MEASUREMENT
/begin MEASUREMENT Bnsctrant3 "Counter 1 sec-Anteile 3. Bereich" UWORD Def_dez_uw_q1 0 0 0.0 65535.0000 ECU_ADDRESS 0x7FDEAC /begin FUNCTION_LIST PMBNSTAB /end FUNCTION_LIST /end MEASUREMENT
/begin MEASUREMENT C_battnenn "Batteriekapazitaet" UBYTE Def_ql_ub_q1 0 0 0.0 255.0000 ECU_ADDRESS 0x7FDF39 /begin FUNCTION_LIST PMDIAG /end FUNCTION_LIST /end MEASUREMENT
/begin MEASUREMENT Cbatt_lo "Nennkapazität Batterie, lokal" UBYTE Def_ql_ub_q1 0 0 1.0000 255.0000 ECU_ADDRESS 0x7FC798 /begin FUNCTION_LIST PMSOCCALC /end FUNCTION_LIST /end MEASUREMENT
/begin MEASUREMENT Codiercnt "Internet Zaehler fuer Anfrage Codierung" UBYTE Def_td_ub_q0p1 0 0 0.0 25.5000 ECU_ADDRESS 0x7FDF3A /begin FUNCTION_LIST PMDIAG /end FUNCTION_LIST /end MEASUREMENT
/begin MEASUREMENT Ctrcbr "Steuerung_Stromzweige" UBYTE Def_dez_ub_q1 0 0 0.0 255.0000 ECU_ADDRESS 0x7FDFBF /begin FUNCTION_LIST PMPRSVCALC /end FUNCTION_LIST /end MEASUREMENT
/begin MEASUREMENT Ctrcbr7 "lokales ctrcbr" UBYTE Def_dez_ub_q1 0 0 0.0 255.0000 ECU_ADDRESS 0x7FDFC0 /begin FUNCTION_LIST PMPRSVCALC /end FUNCTION_LIST /end MEASUREMENT
/begin MEASUREMENT Ctrcbrmem "altes ctrbr" UBYTE Def_dez_ub_q1 0 0 0.0 255.0000 ECU_ADDRESS 0x7FDFC1 /begin FUNCTION_LIST PMPRSVCALC /end FUNCTION_LIST /end MEASUREMENT
/begin MEASUREMENT Ctrpcos "Steuerung_Standverbraucher" UBYTE Def_dez_ub_q1 0 0 0.0 3.0000 ECU_ADDRESS 0x7FDFC2 /begin FUNCTION_LIST PMPRSVCALC /end FUNCTION_LIST /end MEASUREMENT
/begin MEASUREMENT Ctrpcos7 "lokales ctrpcos" UBYTE Def_dez_ub_q1 0 0 0.0 3.0000 ECU_ADDRESS 0x7FDF54 /begin FUNCTION_LIST PMPRSVCALC /end FUNCTION_LIST /end MEASUREMENT
/begin MEASUREMENT Ctrpcosmem "altes ctrpcos" UBYTE Def_dez_ub_q1 0 0 0.0 3.0000 ECU_ADDRESS 0x7FDFC3 /begin FUNCTION_LIST PMPRSVCALC /end FUNCTION_LIST /end MEASUREMENT
/begin MEASUREMENT Ctrprio "Steuerung_Spitzenreduzierung_Priorität" UBYTE Def_dez_ub_q1 0 0 0.0 7.0000 ECU_ADDRESS 0x7FDFC4 /begin FUNCTION_LIST PMPRSVCALC /end FUNCTION_LIST /end MEASUREMENT
/begin MEASUREMENT Ctrprio7 "lokales ctrprio" UBYTE Def_dez_ub_q1 0 0 0.0 7.0000 ECU_ADDRESS 0x7FDFC5 /begin FUNCTION_LIST PMPRSVCALC /end FUNCTION_LIST /end MEASUREMENT
/begin MEASUREMENT Ctrpriocf "Steuerung_Spitzenreduzierung_Priorität_Komfort" UBYTE Def_dez_ub_q1 0 0 0.0 7.0000 ECU_ADDRESS 0x7FDFC6 /begin FUNCTION_LIST PMPRSVCALC /end FUNCTION_LIST /end MEASUREMENT
/begin MEASUREMENT Ctrpriocf7 "lokales ctrpriocf" UBYTE Def_dez_ub_q1 0 0 0.0 7.0000 ECU_ADDRESS 0x7FDFC7 /begin FUNCTION_LIST PMPRSVCALC /end FUNCTION_LIST /end MEASUREMENT
/begin MEASUREMENT Ctrpriocfm "altes ctrpriocf" UBYTE Def_dez_ub_q1 0 0 0.0 7.0000 ECU_ADDRESS 0x7FDFC8 /begin FUNCTION_LIST PMPRSVCALC /end FUNCTION_LIST /end MEASUREMENT
/begin MEASUREMENT Ctrpriomem "altes ctrprio" UBYTE Def_dez_ub_q1 0 0 0.0 7.0000 ECU_ADDRESS 0x7FDFC9 /begin FUNCTION_LIST PMPRSVCALC /end FUNCTION_LIST /end MEASUREMENT
/begin MEASUREMENT Ctrpwrcf "Komfort-Teil von ctrpwrcos" UWORD Def_dez_uw_q1 0 0 0.0 65535.0000 ECU_ADDRESS 0x7FDF7E /begin FUNCTION_LIST PMPRSVCALC /end FUNCTION_LIST /end MEASUREMENT
/begin MEASUREMENT Ctrpwrcos "Steuerung_Leistung_Verbraucher" UWORD Def_dez_uw_q1 0 0 0.0 65535.0000 ECU_ADDRESS 0x7FDF80 /begin FUNCTION_LIST PMPRSVCALC /end FUNCTION_LIST /end MEASUREMENT
/begin MEASUREMENT Ctrpwrcos7 "lokales ctrpwrcos" UWORD Def_dez_uw_q1 0 0 0.0 65535.0000 ECU_ADDRESS 0x7FDF82 /begin FUNCTION_LIST PMPRSVCALC /end FUNCTION_LIST /end MEASUREMENT
/begin MEASUREMENT Ctrpwrdf "df-Teil von ctrpwrcos" UWORD Def_dez_uw_q1 0 0 0.0 65535.0000 ECU_ADDRESS 0x7FDF84 /begin FUNCTION_LIST PMPRSVCALC /end FUNCTION_LIST /end MEASUREMENT
/begin MEASUREMENT Ctrpwrmem "altes ctrpwrcos" UWORD Def_dez_uw_q1 0 0 0.0 65535.0000 ECU_ADDRESS 0x7FDF86 /begin FUNCTION_LIST PMPRSVCALC /end FUNCTION_LIST /end MEASUREMENT
/begin MEASUREMENT Ctrpwspcos "Steuerung_Leistung_Sonderverbraucher" UBYTE Def_f_ub_b127p5 0 0 0.0 127.5000 ECU_ADDRESS 0x7FDFCA /begin FUNCTION_LIST PMPRSVCALC /end FUNCTION_LIST /end MEASUREMENT
/begin MEASUREMENT D_qelad "Delta Kapazität entladen" UWORD Def_ql_uw_q0p0182 0 0 0.0 1193.0282 ECU_ADDRESS 0x7FC78E /begin FUNCTION_LIST PMSOCCALC /end FUNCTION_LIST /end MEASUREMENT
/begin MEASUREMENT D_qlad "Delta Kapazität geladen" UWORD Def_ql_uw_q0p0182 0 0 0.0 1193.0282 ECU_ADDRESS 0x7FC790 /begin FUNCTION_LIST PMSOCCALC /end FUNCTION_LIST /end MEASUREMENT
/begin MEASUREMENT D_soc "Abstand zur Startfähigkeitsgrenze" SWORD Def_f_sw_b100 0 0 -100.0000 99.9969 ECU_ADDRESS 0x7FDFF8 /begin FUNCTION_LIST PMSOCKOR /end FUNCTION_LIST /end MEASUREMENT
/begin MEASUREMENT D_socw "Delta SoC" SWORD Def_f_sw_b100 0 0 -100.0000 99.9969 ECU_ADDRESS 0x7FC7AE /begin FUNCTION_LIST PMSOCKOR /end FUNCTION_LIST /end MEASUREMENT
/begin MEASUREMENT D_udtptc "Spannungsdifferenz in 10ms" SBYTE Def_u_sb_q0p0942 0 0 -12.0576 11.9634 ECU_ADDRESS 0x7FDFBE /begin FUNCTION_LIST PMPRSVCALC /end FUNCTION_LIST /end MEASUREMENT
/begin MEASUREMENT Df2pi "DF-Gewichtung auf Prios" SWORD Def_f_sw_p0q25 0 0 -100.0000 100.0000 ECU_ADDRESS 0x7FDF58 /begin FUNCTION_LIST PMPRSVCALC /end FUNCTION_LIST /end MEASUREMENT
/begin MEASUREMENT Dfall2pi "Gesamtgewichtung auf Prios" SWORD Def_f_sw_p0q25 0 0 -500.0000 500.0000 ECU_ADDRESS 0x7FDF5A /begin FUNCTION_LIST PMPRSVCALC /end FUNCTION_LIST /end MEASUREMENT
/begin MEASUREMENT Dfallpi "PI-Geregelte Gesamtgewichtung auf Prios" UWORD Def_f_uw_q0p25 0 0 0.0 450.0000 ECU_ADDRESS 0x7FDF88 /begin FUNCTION_LIST PMPRSVCALC /end FUNCTION_LIST /end MEASUREMENT
/begin MEASUREMENT Dff_filt7 "lokales dffgenflit" UBYTE Def_f_ub_b100 0 0 0.0 99.6093 ECU_ADDRESS 0x7FDFCB /begin FUNCTION_LIST PMPRSVCALC /end FUNCTION_LIST /end MEASUREMENT
/begin MEASUREMENT Dfgenfilt "Über PT-1 gefiltertes dffgen-Signal" UBYTE Def_f_ub_b100 0 0 0.0 99.6093 ECU_ADDRESS 0x7FDFCC /begin FUNCTION_LIST PMPRSVCALC /end FUNCTION_LIST /end MEASUREMENT
/begin MEASUREMENT Dfpi2ptc "Gewichtung der Prios -> Gewichtung für PTC Ansteuerung" SWORD Def_f_sw_p0q25 0 0 -100.0000 100.0000 ECU_ADDRESS 0x7FDF5C /begin FUNCTION_LIST PMPRSVCALC /end FUNCTION_LIST /end MEASUREMENT
/begin MEASUREMENT Dfprio "" UWORD Def_f_uw_q0p25 0 0 0.0 450.0000 ECU_ADDRESS 0x7FDF8A /begin FUNCTION_LIST PMPRSVCALC /end FUNCTION_LIST /end MEASUREMENT
/begin MEASUREMENT Dfpt1_2ptc "gefiltertes dffgen Gewichtung auf PTC-Ansteuerung" SWORD Def_f_sw_p0q25 0 0 -100.0000 100.0000 ECU_ADDRESS 0x7FDF5E /begin FUNCTION_LIST PMPRSVCALC /end FUNCTION_LIST /end MEASUREMENT
/begin MEASUREMENT Dfpt1filt "Wert nach DF-Tiefpass Prio" UBYTE Def_f_ub_b100 0 0 0.0 99.6093 ECU_ADDRESS 0x7FDFCD /begin FUNCTION_LIST PMPRSVCALC /end FUNCTION_LIST /end MEASUREMENT
/begin MEASUREMENT Dfpt1ptc "Wert nach DFFGEN-Filter PTC" UBYTE Def_f_ub_b100 0 0 0.0 99.6093 ECU_ADDRESS 0x7FDFCE /begin FUNCTION_LIST PMPRSVCALC /end FUNCTION_LIST /end MEASUREMENT
/begin MEASUREMENT Dqelad7 "diff = qelad-qeladold7" UWORD Def_ql_uw_q0p29127 0 0 0.0 19088.4522 ECU_ADDRESS 0x7FDF26 /begin FUNCTION_LIST PMDIAG /end FUNCTION_LIST /end MEASUREMENT
/begin MEASUREMENT Dqlad7 "diff = qlad-qladold7" UWORD Def_ql_uw_q0p29127 0 0 0.0 19088.4522 ECU_ADDRESS 0x7FDF28 /begin FUNCTION_LIST PMDIAG /end FUNCTION_LIST /end MEASUREMENT
/begin MEASUREMENT Dsoc2pi "Batterieladezustand-Gewichtung auf Prios" SWORD Def_f_sw_p0q25 0 0 -150.0000 150.0000 ECU_ADDRESS 0x7FDF60 /begin FUNCTION_LIST PMPRSVCALC /end FUNCTION_LIST /end MEASUREMENT
/begin MEASUREMENT Dsoc2ptc "dsoc Gewichtung auf PTC-Ansteuerung" SWORD Def_f_sw_p0q25 0 0 -150.0000 150.0000 ECU_ADDRESS 0x7FDF62 /begin FUNCTION_LIST PMPRSVCALC /end FUNCTION_LIST /end MEASUREMENT
/begin MEASUREMENT Dudtmul "PTC dudt : gewichtetes Dudt" SWORD Def_f_sw_q0p000147 0 0 -48.2304 48.2289 ECU_ADDRESS 0x7FDF64 /begin FUNCTION_LIST PMPRSVCALC /end FUNCTION_LIST /end MEASUREMENT
/begin MEASUREMENT F_dudtptc "Inkrement auf Ptc_pwr aufgrund du/dt" UWORD Def_f_uw_q0p25 0 0 0.0 550.0000 ECU_ADDRESS 0x7FDF8C /begin FUNCTION_LIST PMPRSVCALC /end FUNCTION_LIST /end MEASUREMENT
/begin MEASUREMENT Fs_pm "Fehlerspeicher Powermanagement, Bitcodiert" UBYTE Def_dez_ub_q1 0 0 0.0 255.0000 ECU_ADDRESS 0x7FDF06 /begin FUNCTION_LIST PMDIAG /end FUNCTION_LIST /end MEASUREMENT
/begin MEASUREMENT Ib_commcnt "Zähler Taskaufrufe zwischen periodischer Abfrage qlad und qelad" UBYTE Def_dez_ub_q1 0 0 0.0 255.0000 ECU_ADDRESS 0x7FC799 /begin FUNCTION_LIST PMSOCCALC /end FUNCTION_LIST /end MEASUREMENT
/begin MEASUREMENT Ib_commsta "Statemaschine zeiger zur Abfrage qlad und qelad" UBYTE Def_dez_ub_q1 0 0 0.0 255.0000 ECU_ADDRESS 0x7FC79A /begin FUNCTION_LIST PMSOCCALC /end FUNCTION_LIST /end MEASUREMENT
/begin MEASUREMENT Ibsbor_hb "highbyte ibsborctr" UBYTE Def_dez_ub_q1 0 0 0.0 255.0000 ECU_ADDRESS 0x7FDF3B /begin FUNCTION_LIST PMDIAG /end FUNCTION_LIST /end MEASUREMENT
/begin MEASUREMENT Ibtdiff "Delta Ibtsoll-Ibatt" UWORD Def_i_uw_q0p08_o200 0 0 -200.0000 5042.8000 ECU_ADDRESS 0x7FDF8E /begin FUNCTION_LIST PMPRSVCALC /end FUNCTION_LIST /end MEASUREMENT
/begin MEASUREMENT Ibtdiff2pi "Batterie-soll-strom Gewichtung auf Prios" SWORD Def_f_sw_p0q25 0 0 -100.0000 100.0000 ECU_ADDRESS 0x7FDF66 /begin FUNCTION_LIST PMPRSVCALC /end FUNCTION_LIST /end MEASUREMENT
/begin MEASUREMENT Ibtsoll "Sollstrom aufgrund von tbatt und dsoc" UWORD Def_i_uw_q0p08_o200 0 0 -200.0000 5042.8000 ECU_ADDRESS 0x7FDF90 /begin FUNCTION_LIST PMPRSVCALC /end FUNCTION_LIST /end MEASUREMENT
/begin MEASUREMENT Ideltaabs "Differenz der Startströme" UWORD Def_i_uw_q0p02 0 0 0.0200 1310.7000 ECU_ADDRESS 0x7FE00C /begin FUNCTION_LIST PMSOCSTART /end FUNCTION_LIST /end MEASUREMENT
/begin MEASUREMENT Idiff2ptc "idiff Gewichtung auf die PTC-Ansteuerung" SWORD Def_f_sw_p0q25 0 0 -100.0000 100.0000 ECU_ADDRESS 0x7FDF68 /begin FUNCTION_LIST PMPRSVCALC /end FUNCTION_LIST /end MEASUREMENT
/begin MEASUREMENT Igenrest "Generatorreststrom modelliert" UBYTE Def_i_ub_q1 0 0 0.0 255.0000 ECU_ADDRESS 0x7FDFCF /begin FUNCTION_LIST PMPRSVCALC /end FUNCTION_LIST /end MEASUREMENT
/begin MEASUREMENT Ikurz_ogrz "Obere Grenze Kurzschlußstrom" UBYTE Def_i_ub_q10 0 0 0.0 2550.0000 ECU_ADDRESS 0x7FDF3C /begin FUNCTION_LIST PMDIAG /end FUNCTION_LIST /end MEASUREMENT
/begin MEASUREMENT Ikurz_ugrz "Untere Grenze Kurzschlußstrom" UBYTE Def_i_ub_q10 0 0 0.0 2550.0000 ECU_ADDRESS 0x7FDF3D /begin FUNCTION_LIST PMDIAG /end FUNCTION_LIST /end MEASUREMENT
/begin MEASUREMENT Ipmdfprio "lokale Prioberechnungsvariable bei IPM aktiv" UWORD Def_f_uw_q0p25 0 0 0.0 450.0000 ECU_ADDRESS 0x7FDF92 /begin FUNCTION_LIST PMPRSVCALC /end FUNCTION_LIST /end MEASUREMENT
/begin MEASUREMENT Isoc0loc "Batteriestrom zum Zeitpunkt der Ruhespannungsmessung (lokal)" SWORD Def_i_sw_q0p02 0 0 -655.3600 655.3400 ECU_ADDRESS 0x7FC79C /begin FUNCTION_LIST PMSOCCALC /end FUNCTION_LIST /end MEASUREMENT
/begin MEASUREMENT Isolldiff "Differenz isoll - ibatt_w für PTC Ansteuerung" UWORD Def_i_uw_q0p08_o200 0 0 -200.0000 5042.8000 ECU_ADDRESS 0x7FDF94 /begin FUNCTION_LIST PMPRSVCALC /end FUNCTION_LIST /end MEASUREMENT
/begin MEASUREMENT Iwakeupgrz "Ruhestromverletzungsgrenze, ab hier weckt u.U. das IBS." UBYTE Def_i_ub_q0p00125 0 0 0.0 0.2550 ECU_ADDRESS 0x7FDF3E /begin FUNCTION_LIST PMDIAG /end FUNCTION_LIST /end MEASUREMENT
/begin MEASUREMENT Kalevcnt "Anzahl der Ruhespannungsmessungen" UBYTE Def_dez_ub_q1 0 0 0.0 255.0000 ECU_ADDRESS 0x7FC79B /begin FUNCTION_LIST PMSOCCALC /end FUNCTION_LIST /end MEASUREMENT
/begin MEASUREMENT Memprio1 "memory 1 PI-Regler dfall2pi E60Prio" UWORD Def_f_uw_b512 0 0 0.0 511.9921 ECU_ADDRESS 0x7FDF96 /begin FUNCTION_LIST PMPRSVCALC /end FUNCTION_LIST /end MEASUREMENT
/begin MEASUREMENT Memprio2 "memory 2 PI-Regler dfall2pi E60Prio" UWORD Def_f_uw_b512 0 0 0.0 511.9921 ECU_ADDRESS 0x7FDF98 /begin FUNCTION_LIST PMPRSVCALC /end FUNCTION_LIST /end MEASUREMENT
/begin MEASUREMENT Memptc1 "memory 1 PI-Regler all2ptc PTC" UWORD Def_f_uw_b512 0 0 0.0 511.9921 ECU_ADDRESS 0x7FDF9A /begin FUNCTION_LIST PMPRSVCALC /end FUNCTION_LIST /end MEASUREMENT
/begin MEASUREMENT Memptc2 "memory 2 PI-Regler all2ptc PTC" UWORD Def_f_uw_b512 0 0 0.0 511.9921 ECU_ADDRESS 0x7FDF9C /begin FUNCTION_LIST PMPRSVCALC /end FUNCTION_LIST /end MEASUREMENT
/begin MEASUREMENT Nnmstart "Motordrehzahl nach Motorstart" SWORD Def_n_sw_q1p0 0 0 -32768.0000 32767.0000 ECU_ADDRESS 0x7FE008 /begin FUNCTION_LIST PMSOCSTART /end FUNCTION_LIST /end MEASUREMENT
/begin MEASUREMENT Ospgcnt "fs_Oberspannungscounter" UBYTE Def_td_ub_q0p1 0 0 0.0 25.5000 ECU_ADDRESS 0x7FDF3F /begin FUNCTION_LIST PMDIAG /end FUNCTION_LIST /end MEASUREMENT
/begin MEASUREMENT Ospgprell "Anzahl der entprellten FS_Oberspannungserkennung" UBYTE Def_dez_ub_q1 0 0 0.0 255.0000 ECU_ADDRESS 0x7FDF40 /begin FUNCTION_LIST PMDIAG /end FUNCTION_LIST /end MEASUREMENT
/begin MEASUREMENT Ospgstat "Status Oberspannungserkennung" UBYTE Def_dez_ub_q1 0 0 0.0 255.0000 ECU_ADDRESS 0x7FDF41 /begin FUNCTION_LIST PMDIAG /end FUNCTION_LIST /end MEASUREMENT
/begin MEASUREMENT Oz_cttagini "Tag beim Ölwechsel" SWORD Def_dez_sw_q1 0 0 -32768.0000 32767.0000 ECU_ADDRESS 0x7FDE78 /begin FUNCTION_LIST OZRESTKM /end FUNCTION_LIST /end MEASUREMENT
/begin MEASUREMENT Oz_intprog "Prognose_Intervall_Zeit_BOS_Meldung_2" UBYTE Def_dez_ub_q1 0 0 0.0 255.0000 ECU_ADDRESS 0x7FDE99 /begin FUNCTION_LIST OZRESTKM /end FUNCTION_LIST /end MEASUREMENT
/begin MEASUREMENT Oz_kmstrw0 "Kilometerstand bei Restweg = Null" UWORD Def_km_uw_q10 0 0 0.0 655350.0000 ECU_ADDRESS 0x7FDE7A /begin FUNCTION_LIST OZRESTKM /end FUNCTION_LIST /end MEASUREMENT
/begin MEASUREMENT Oz_kvbmw "" ULONG Def_fuel_ul_q0p000122 0 0 0.0 524287.9998 ECU_ADDRESS 0x7FDE74 /begin FUNCTION_LIST OZRESTKM /end FUNCTION_LIST /end MEASUREMENT
/begin MEASUREMENT Oz_kvbmwtmp "" UWORD Def_f_uw_b64 0 0 0.0 63.9990 ECU_ADDRESS 0x7FDE7E /begin FUNCTION_LIST OZRESTKM /end FUNCTION_LIST /end MEASUREMENT
/begin MEASUREMENT Oz_kvbmx "" UWORD Def_dez_uw_q1 0 0 0.0 65535.0000 ECU_ADDRESS 0x7FDE80 /begin FUNCTION_LIST OZRESTKM /end FUNCTION_LIST /end MEASUREMENT
/begin MEASUREMENT Oz_kvbog "zugeteilte Bonuskraftstoffmenge" UWORD Def_dez_uw_q1 0 0 0.0 65535.0000 ECU_ADDRESS 0x7FDE6A /begin FUNCTION_LIST OZRESTKM /end FUNCTION_LIST /end MEASUREMENT
/begin MEASUREMENT Oz_kvbsm "" ULONG Def_fuel_ul_q0p000122 0 0 0.0 524287.9998 ECU_ADDRESS 0x7FDE94 /begin FUNCTION_LIST OZRESTKM /end FUNCTION_LIST /end MEASUREMENT
/begin MEASUREMENT Oz_kvbsm_ul "" ULONG Def_fuel_ul_q0p000122 0 0 0.0 524287.9998 ECU_ADDRESS 0x7FDE64 /begin FUNCTION_LIST OZRESTKM /end FUNCTION_LIST /end MEASUREMENT
/begin MEASUREMENT Oz_kvbtmp2 "" UWORD Def_km_uw_q10 0 0 0.0 655350.0000 ECU_ADDRESS 0x7FDE82 /begin FUNCTION_LIST OZRESTKM /end FUNCTION_LIST /end MEASUREMENT
/begin MEASUREMENT Oz_lf1t "Länderfaktor 1" UBYTE Def_lf_ub_q0p01 0 0 0.0 2.5500 ECU_ADDRESS 0x7FDE6E /begin FUNCTION_LIST OZRESTKM /end FUNCTION_LIST /end MEASUREMENT
/begin MEASUREMENT Oz_lf2t "Länderfaktor 2" UBYTE Def_lf_ub_q0p01 0 0 0.0 2.5500 ECU_ADDRESS 0x7FDE6F /begin FUNCTION_LIST OZRESTKM /end FUNCTION_LIST /end MEASUREMENT
/begin MEASUREMENT Oz_litges "Gesamtverbrauch für Ölwechsel" UWORD Def_dez_uw_q1 0 0 0.0 65535.0000 ECU_ADDRESS 0x7FDE84 /begin FUNCTION_LIST OZRESTKM /end FUNCTION_LIST /end MEASUREMENT
/begin MEASUREMENT Oz_litgesk "Gesamtverbrauch für Ölwechsel" UWORD Def_dez_uw_q1 0 0 0.0 65535.0000 ECU_ADDRESS 0x7FDE86 /begin FUNCTION_LIST OZRESTKM /end FUNCTION_LIST /end MEASUREMENT
/begin MEASUREMENT Oz_oelzeit "Öl-Alter in Monate" UWORD Def_dez_uw_q1 0 0 0.0 65535.0000 ECU_ADDRESS 0x7FDE8E /begin FUNCTION_LIST OZRESTKM /end FUNCTION_LIST /end MEASUREMENT
/begin MEASUREMENT Oz_oelzeitt "Öl-Alter in Tage" UWORD Def_dez_uw_q1 0 0 0.0 65535.0000 ECU_ADDRESS 0x7FDE90 /begin FUNCTION_LIST OZRESTKM /end FUNCTION_LIST /end MEASUREMENT
/begin MEASUREMENT Oz_permbog "zugeteilter Permittivitätsbonus" UWORD Def_perm_uw_b6 0 0 0.0 5.9999 ECU_ADDRESS 0x7FDE6C /begin FUNCTION_LIST OZRESTKM /end FUNCTION_LIST /end MEASUREMENT
/begin MEASUREMENT Oz_rwanz "anzuzeigender Restweg" SWORD Def_km_sw_q10 0 0 -327680.0000 327670.0000 ECU_ADDRESS 0x7FDE68 /begin FUNCTION_LIST OZRESTKM /end FUNCTION_LIST /end MEASUREMENT
/begin MEASUREMENT Oz_rwkvb "" SWORD Def_km_sw_q10 0 0 -327680.0000 327670.0000 ECU_ADDRESS 0x7FDE88 /begin FUNCTION_LIST OZRESTKM /end FUNCTION_LIST /end MEASUREMENT
/begin MEASUREMENT Oz_rwperm "Restweg aus Permittivität abgeleitet" SWORD Def_km_sw_q10 0 0 -327680.0000 327670.0000 ECU_ADDRESS 0x7FDE8A /begin FUNCTION_LIST OZRESTKM /end FUNCTION_LIST /end MEASUREMENT
/begin MEASUREMENT Oz_rwprog "Prognose_Intervall_Weg_BOS_Meldung_2" UWORD Def_km_uw_q10 0 0 0.0 655350.0000 ECU_ADDRESS 0x7FDE92 /begin FUNCTION_LIST OZRESTKM /end FUNCTION_LIST /end MEASUREMENT
/begin MEASUREMENT Oz_rwzeit "Restweg laut Zeitverlauf" SWORD Def_km_sw_q10 0 0 -327680.0000 327670.0000 ECU_ADDRESS 0x7FDE8C /begin FUNCTION_LIST OZRESTKM /end FUNCTION_LIST /end MEASUREMENT
/begin MEASUREMENT Oz_tempf "" SWORD Def_t_sw_q0p1 0 0 -3276.8000 3276.7000 ECU_ADDRESS 0x7FDE9C /begin FUNCTION_LIST OZTEMP /end FUNCTION_LIST /end MEASUREMENT
/begin MEASUREMENT Oz_utzeit "Zeit Öl in Übertemperatur" UWORD Def_dez_uw_q1 0 0 0.0 65535.0000 ECU_ADDRESS 0x7FDE7C /begin FUNCTION_LIST OZRESTKM /end FUNCTION_LIST /end MEASUREMENT
/begin MEASUREMENT Oz_vfanz "anzuzeigende Verfügbarkeit" UBYTE Def_lf_ub_q0p01 0 0 0.0 2.5500 ECU_ADDRESS 0x7FDE9A /begin FUNCTION_LIST OZRESTKM /end FUNCTION_LIST /end MEASUREMENT
/begin MEASUREMENT Oz_vfperm "Verfügbarkeit aus der Permittivität" UBYTE Def_lf_ub_q0p01 0 0 0.0 2.5500 ECU_ADDRESS 0x7FDE98 /begin FUNCTION_LIST OZRESTKM /end FUNCTION_LIST /end MEASUREMENT
/begin MEASUREMENT Oz_zieljahr "" UBYTE Def_dez_ub_q1 0 0 0.0 255.0000 ECU_ADDRESS 0x7FDE70 /begin FUNCTION_LIST OZRESTKM /end FUNCTION_LIST /end MEASUREMENT
/begin MEASUREMENT Oz_zielmon "" UBYTE Def_dez_ub_q1 0 0 0.0 255.0000 ECU_ADDRESS 0x7FDE71 /begin FUNCTION_LIST OZRESTKM /end FUNCTION_LIST /end MEASUREMENT
/begin MEASUREMENT Pgen2ptc "Gewichtung der Generatorrestleistung für PTC-Ansteuerung" SWORD Def_f_sw_p0q25 0 0 -100.0000 100.0000 ECU_ADDRESS 0x7FDF6A /begin FUNCTION_LIST PMPRSVCALC /end FUNCTION_LIST /end MEASUREMENT
/begin MEASUREMENT Pgenrest "Generatorrestleistung (igenrest*ubatt_w)" UWORD Def_f_uw_q0p25 0 0 0.0 6400.0000 ECU_ADDRESS 0x7FDF9E /begin FUNCTION_LIST PMPRSVCALC /end FUNCTION_LIST /end MEASUREMENT
/begin MEASUREMENT Picntr "Counter fuer PI-Reset" UBYTE Def_td_ub_q0p1 0 0 0.0 25.5000 ECU_ADDRESS 0x7FDFD0 /begin FUNCTION_LIST PMPRSVCALC /end FUNCTION_LIST /end MEASUREMENT
/begin MEASUREMENT Pm_klemmstat "Umweltbed. Klemmenstatus" UBYTE Def_dez_ub_q1 0 0 0.0 255.0000 ECU_ADDRESS 0x7FDF42 /begin FUNCTION_LIST PMDIAG /end FUNCTION_LIST /end MEASUREMENT
/begin MEASUREMENT Pm_tsrdy "Status Berechnung Tsaison" UBYTE Identity 0 0 0.0 1.0000 ECU_ADDRESS 0x7FE006 /begin FUNCTION_LIST PMSOCKOR /end FUNCTION_LIST /end MEASUREMENT
/begin MEASUREMENT Pmbscount "zyklisches Senden entspricht 5 sek" UBYTE Def_dez_ub_q1 0 0 0.0 255.0000 ECU_ADDRESS 0x7FDFD1 /begin FUNCTION_LIST PMPRSVCALC /end FUNCTION_LIST /end MEASUREMENT
/begin MEASUREMENT Pminfo1 "Infospeicher 1 vom Powermanagement" UWORD Def_dez_uw_q1 0 0 0.0 65535.0000 ECU_ADDRESS 0x7FDEB6 ARRAY_SIZE 37 /begin FUNCTION_LIST PMDIAG /end FUNCTION_LIST /end MEASUREMENT
/begin MEASUREMENT Pminfo2 "Fehlerinfo2 vom Powermanagement" UBYTE Def_dez_ub_q1 0 0 0.0 255.0000 ECU_ADDRESS 0x7FDF08 ARRAY_SIZE 29 /begin FUNCTION_LIST PMDIAG /end FUNCTION_LIST /end MEASUREMENT
/begin MEASUREMENT Pmstartsta "Schalter für Ablaufsteuerung" UBYTE Def_dez_ub_q1 0 0 0.0 255.0000 ECU_ADDRESS 0x7FE013 /begin FUNCTION_LIST PMSOCSTART /end FUNCTION_LIST /end MEASUREMENT
/begin MEASUREMENT Pmvscount "Zähler bis zum nächsten zyklischen Senden von 3b3" UBYTE Def_dez_ub_q1 0 0 0.0 255.0000 ECU_ADDRESS 0x7FDFD2 /begin FUNCTION_LIST PMPRSVCALC /end FUNCTION_LIST /end MEASUREMENT
/begin MEASUREMENT Priopizw1 "Pi-Regler zw1" SLONG Def_f_sl_q0p007 0 0 -512.0000 512.0000 ECU_ADDRESS 0x7FDFAC /begin FUNCTION_LIST PMPRSVCALC /end FUNCTION_LIST /end MEASUREMENT
/begin MEASUREMENT Priopizw2 "Pi-Regler zw2" SLONG Def_f_sl_q0p007 0 0 -512.0000 512.0000 ECU_ADDRESS 0x7FDFB0 /begin FUNCTION_LIST PMPRSVCALC /end FUNCTION_LIST /end MEASUREMENT
/begin MEASUREMENT Ptc_pwr "Maximale Leistung, die der PTC einstellen darf." UBYTE Def_f_ub_b127p5 0 0 0.0 127.5000 ECU_ADDRESS 0x7FDFD3 /begin FUNCTION_LIST PMPRSVCALC /end FUNCTION_LIST /end MEASUREMENT
/begin MEASUREMENT Ptc_pwr7 "lokales ptc_pwr" UBYTE Def_f_ub_b127p5 0 0 0.0 127.5000 ECU_ADDRESS 0x7FDFD4 /begin FUNCTION_LIST PMPRSVCALC /end FUNCTION_LIST /end MEASUREMENT
/begin MEASUREMENT Ptcadd "Wg. Spgeinbruch zu addierender PTC Faktor" UWORD Def_f_uw_q0p25 0 0 0.0 550.0000 ECU_ADDRESS 0x7FDFA0 /begin FUNCTION_LIST PMPRSVCALC /end FUNCTION_LIST /end MEASUREMENT
/begin MEASUREMENT Ptcpizw1 "PTC PI Regler zw1" SLONG Def_f_sl_q0p007 0 0 -512.0000 512.0000 ECU_ADDRESS 0x7FDFB4 /begin FUNCTION_LIST PMPRSVCALC /end FUNCTION_LIST /end MEASUREMENT
/begin MEASUREMENT Ptcpizw2 "PTC PI zw2" SLONG Def_f_sl_q0p007 0 0 -512.0000 512.0000 ECU_ADDRESS 0x7FDFB8 /begin FUNCTION_LIST PMPRSVCALC /end FUNCTION_LIST /end MEASUREMENT
/begin MEASUREMENT Pwrspmem "altes ctrpwspcos" UBYTE Def_f_ub_b127p5 0 0 0.0 127.5000 ECU_ADDRESS 0x7FDFD5 /begin FUNCTION_LIST PMPRSVCALC /end FUNCTION_LIST /end MEASUREMENT
/begin MEASUREMENT Q_bila "Kapazität Batterie (long)" ULONG Def_ql_ul_q2p7Em7 0 0 0.0 1193.0464 ECU_ADDRESS 0x7FDFE8 /begin FUNCTION_LIST PMSOCCALC /end FUNCTION_LIST /end MEASUREMENT
/begin MEASUREMENT Q_startfgk "Abstand zur Startfähigkeitsgrenze" UWORD Def_ql_uw_q0p0182 0 0 0.0 1193.0282 ECU_ADDRESS 0x7FDFFE /begin FUNCTION_LIST PMSOCKOR /end FUNCTION_LIST /end MEASUREMENT
/begin MEASUREMENT Qeladold "Kapazität Entladen vor Abstellen" UWORD Def_ql_uw_q0p0182 0 0 0.0 1193.0282 ECU_ADDRESS 0x7FDFEC /begin FUNCTION_LIST PMSOCCALC /end FUNCTION_LIST /end MEASUREMENT
/begin MEASUREMENT Qeladold7 "zuletzt gesp. qelad" UWORD Def_ql_uw_q0p0182 0 0 0.0 1193.0282 ECU_ADDRESS 0x7FDF00 /begin FUNCTION_LIST PMDIAG /end FUNCTION_LIST /end MEASUREMENT
/begin MEASUREMENT Qladold "Kapazität Getladen vor Abstellen" UWORD Def_ql_uw_q0p0182 0 0 0.0 1193.0282 ECU_ADDRESS 0x7FDFEE /begin FUNCTION_LIST PMSOCCALC /end FUNCTION_LIST /end MEASUREMENT
/begin MEASUREMENT Qladold7 "zuletzt gesp. qlad" UWORD Def_ql_uw_q0p0182 0 0 0.0 1193.0282 ECU_ADDRESS 0x7FDF02 /begin FUNCTION_LIST PMDIAG /end FUNCTION_LIST /end MEASUREMENT
/begin MEASUREMENT Qladzwsp7 "qlad uebertragspeicher" UWORD Def_dez_uw_q1 0 0 0.0 65535.0000 ECU_ADDRESS 0x7FDF2A /begin FUNCTION_LIST PMDIAG /end FUNCTION_LIST /end MEASUREMENT
/begin MEASUREMENT Rin_grenzh "Batt.Innenwiderstand Grenze" UBYTE Def_f_ub_b32 0 0 0.0 31.8750 ECU_ADDRESS 0x7FE014 /begin FUNCTION_LIST PMSOCSTART /end FUNCTION_LIST /end MEASUREMENT
/begin MEASUREMENT Rin_start "Innenwiderstand Batterie beim Start" UBYTE Def_f_ub_b32 0 0 0.0 31.8750 ECU_ADDRESS 0x7FE015 /begin FUNCTION_LIST PMSOCSTART /end FUNCTION_LIST /end MEASUREMENT
/begin MEASUREMENT Rqpcos "Anforderung_Standverbraucher" UBYTE Def_dez_ub_q1 0 0 0.0 3.0000 ECU_ADDRESS 0x7FDFD6 /begin FUNCTION_LIST PMPRSVCALC /end FUNCTION_LIST /end MEASUREMENT
/begin MEASUREMENT Rqpcos7 "lokales rqpcos" UBYTE Def_dez_ub_q1 0 0 0.0 3.0000 ECU_ADDRESS 0x7FDFD7 /begin FUNCTION_LIST PMPRSVCALC /end FUNCTION_LIST /end MEASUREMENT
/begin MEASUREMENT Rqpcosmem "altes rqpcos" UBYTE Def_dez_ub_q1 0 0 0.0 3.0000 ECU_ADDRESS 0x7FDFD8 /begin FUNCTION_LIST PMPRSVCALC /end FUNCTION_LIST /end MEASUREMENT
/begin MEASUREMENT Selspcos "Auswahl_Sonderverbraucher" UBYTE Def_dez_ub_q1 0 0 0.0 15.0000 ECU_ADDRESS 0x7FDFD9 /begin FUNCTION_LIST PMPRSVCALC /end FUNCTION_LIST /end MEASUREMENT
/begin MEASUREMENT Selspcosme "altes selspcos" UBYTE Def_dez_ub_q1 0 0 0.0 15.0000 ECU_ADDRESS 0x7FDFDA /begin FUNCTION_LIST PMPRSVCALC /end FUNCTION_LIST /end MEASUREMENT
/begin MEASUREMENT Soc_b_loc "lokal soc_bila f. KFSOCLF" UWORD Def_f_uw_b100 0 0 0.0 99.9984 ECU_ADDRESS 0x7FDFF0 /begin FUNCTION_LIST PMSOCCALC /end FUNCTION_LIST /end MEASUREMENT
/begin MEASUREMENT Soc_bila "Ladezustand durch Bilanzierung und Ruhespannungsmessung ermittelt" UWORD Def_f_uw_b100 0 0 0.0 99.9984 ECU_ADDRESS 0x7FC792 /begin FUNCTION_LIST PMSOCCALC /end FUNCTION_LIST /end MEASUREMENT
/begin MEASUREMENT Soc_fit "SoC aus der Fitformel" UWORD Def_f_uw_b100 0 0 0.0 99.9984 ECU_ADDRESS 0x7FDFF4 /begin FUNCTION_LIST PMSOCFIT /end FUNCTION_LIST /end MEASUREMENT
/begin MEASUREMENT Soc_fit_temp "" UWORD Def_f_uw_b100 0 0 0.0 99.9984 ECU_ADDRESS 0x7FC7A4 /begin FUNCTION_LIST PMSOCFIT /end FUNCTION_LIST /end MEASUREMENT
/begin MEASUREMENT Soc_korr "Korrekturwert soc_bila" SWORD Def_f_sw_b100 0 0 -100.0000 99.9969 ECU_ADDRESS 0x7FDFFA /begin FUNCTION_LIST PMSOCKOR /end FUNCTION_LIST /end MEASUREMENT
/begin MEASUREMENT Soc_q_kor "Korrekturwert Genauigkeit Ladezustandsbestimmung" UWORD Def_ql_uw_q0p0182 0 0 0.0 1193.0282 ECU_ADDRESS 0x7FE000 /begin FUNCTION_LIST PMSOCKOR /end FUNCTION_LIST /end MEASUREMENT
/begin MEASUREMENT Soc_q_loc "lokaler Zähler Genauigkeit Ladeztustandsbestimmung" UWORD Def_ql_uw_q0p0182 0 0 0.0 1193.0282 ECU_ADDRESS 0x7FDFF2 /begin FUNCTION_LIST PMSOCCALC /end FUNCTION_LIST /end MEASUREMENT
/begin MEASUREMENT Soc_quali "Zähler Genauigkeit Ladeztustandsbestimmung" UWORD Def_ql_uw_q0p0182 0 0 0.0 1193.0282 ECU_ADDRESS 0x7FC794 /begin FUNCTION_LIST PMSOCCALC /end FUNCTION_LIST /end MEASUREMENT
/begin MEASUREMENT Soc_rel "Relativzähler für Ladezustand SoC" UWORD Def_f_uw_b100 0 0 0.0 99.9984 ECU_ADDRESS 0x7FE002 /begin FUNCTION_LIST PMSOCKOR /end FUNCTION_LIST /end MEASUREMENT
/begin MEASUREMENT Soc_stfgk "Startfähigkeitsgrenze" UWORD Def_f_uw_b100 0 0 0.0 99.9984 ECU_ADDRESS 0x7FE004 /begin FUNCTION_LIST PMSOCKOR /end FUNCTION_LIST /end MEASUREMENT
/begin MEASUREMENT Soc_stfgkw "SoC Startfähigkeit" UWORD Def_f_uw_b100 0 0 0.0 99.9984 ECU_ADDRESS 0x7FC7B2 /begin FUNCTION_LIST PMSOCKOR /end FUNCTION_LIST /end MEASUREMENT
/begin MEASUREMENT St_bns "Statuswort" UBYTE Def_st_ub_q1 0 0 0.0 255.0000 ECU_ADDRESS 0x7FDEA0 /begin FUNCTION_LIST PMBNSTAB /end FUNCTION_LIST /end MEASUREMENT
/begin MEASUREMENT St_bns.B_bns "lokales B_nachlaufende" UBYTE Def_bit_ub_0 0 0 0.0 255.0 ECU_ADDRESS 0x7FDEA0 /begin FUNCTION_LIST PMBNSTAB /end FUNCTION_LIST BIT_MASK 0x1 /end MEASUREMENT
/begin MEASUREMENT St_bns2 "Statuswort" UBYTE Def_st_ub_q1 0 0 0.0 255.0000 ECU_ADDRESS 0x7FDEAF /begin FUNCTION_LIST PMBNSTAB /end FUNCTION_LIST /end MEASUREMENT
/begin MEASUREMENT St_bns2.B_nachlnd7 "Bordnetzstabilitätsmaßnahmen aktiv" UBYTE Def_bit_ub_0 0 0 0.0 255.0 ECU_ADDRESS 0x7FDEAF /begin FUNCTION_LIST PMBNSTAB /end FUNCTION_LIST BIT_MASK 0x1 /end MEASUREMENT
/begin MEASUREMENT St_ozrestkm_nv0 "Statuswort" UBYTE Def_st_ub_q1 0 0 0.0 255.0000 ECU_ADDRESS 0x7FDE60 /begin FUNCTION_LIST OZRESTKM /end FUNCTION_LIST /end MEASUREMENT
/begin MEASUREMENT St_ozrestkm_nv0.B_ozcntini "Tageberechnung initialisiert" UBYTE Def_bit_ub_3 0 0 0.0 255.0 ECU_ADDRESS 0x7FDE60 /begin FUNCTION_LIST OZRESTKM /end FUNCTION_LIST BIT_MASK 0x8 /end MEASUREMENT
/begin MEASUREMENT St_ozrestkm_nv0.B_ozini "Bedingung für Restweganzeige = Null" UBYTE Def_bit_ub_2 0 0 0.0 255.0 ECU_ADDRESS 0x7FDE60 /begin FUNCTION_LIST OZRESTKM /end FUNCTION_LIST BIT_MASK 0x4 /end MEASUREMENT
/begin MEASUREMENT St_ozrestkm_nv0.B_ozvfk "Prognose und KVB aus der Kombi-Verfügbarkeit berechnet " UBYTE Def_bit_ub_1 0 0 0.0 255.0 ECU_ADDRESS 0x7FDE60 /begin FUNCTION_LIST OZRESTKM /end FUNCTION_LIST BIT_MASK 0x2 /end MEASUREMENT
/begin MEASUREMENT St_ozrestkm_nv0.B_rwanz0 "" UBYTE Def_bit_ub_0 0 0 0.0 255.0 ECU_ADDRESS 0x7FDE60 /begin FUNCTION_LIST OZRESTKM /end FUNCTION_LIST BIT_MASK 0x1 /end MEASUREMENT
/begin MEASUREMENT St_pmdiag0 "Statuswort" UBYTE Def_st_ub_q1 0 0 0.0 255.0000 ECU_ADDRESS 0x7FDF36 /begin FUNCTION_LIST PMDIAG /end FUNCTION_LIST /end MEASUREMENT
/begin MEASUREMENT St_pmdiag0.B_ccbtnach "IHKA Standverbraucher aktiv" UBYTE Def_bit_ub_6 0 0 0.0 255.0 ECU_ADDRESS 0x7FDF36 /begin FUNCTION_LIST PMDIAG /end FUNCTION_LIST BIT_MASK 0x40 /end MEASUREMENT
/begin MEASUREMENT St_pmdiag0.B_ccbttdfk "CC Meldung : Komfortverbraucher eingeschraenkt" UBYTE Def_bit_ub_2 0 0 0.0 255.0 ECU_ADDRESS 0x7FDF36 /begin FUNCTION_LIST PMDIAG /end FUNCTION_LIST BIT_MASK 0x4 /end MEASUREMENT
/begin MEASUREMENT St_pmdiag0.B_ccbttknt "Ruhestromverletzung derzeit vorhanden." UBYTE Def_bit_ub_4 0 0 0.0 255.0 ECU_ADDRESS 0x7FDF36 /begin FUNCTION_LIST PMDIAG /end FUNCTION_LIST BIT_MASK 0x10 /end MEASUREMENT
/begin MEASUREMENT St_pmdiag0.B_ccpmerr "CC Meldung : Batterie Nachladen" UBYTE Def_bit_ub_3 0 0 0.0 255.0 ECU_ADDRESS 0x7FDF36 /begin FUNCTION_LIST PMDIAG /end FUNCTION_LIST BIT_MASK 0x8 /end MEASUREMENT
/begin MEASUREMENT St_pmdiag0.B_ccprio "Anfrage an CAS die Codierdaten erneut fuer PM zu senden." UBYTE Def_bit_ub_1 0 0 0.0 255.0 ECU_ADDRESS 0x7FDF36 /begin FUNCTION_LIST PMDIAG /end FUNCTION_LIST BIT_MASK 0x2 /end MEASUREMENT
/begin MEASUREMENT St_pmdiag0.B_codierpm "Q_elad 1. Takt vorbei " UBYTE Def_bit_ub_0 0 0 0.0 255.0 ECU_ADDRESS 0x7FDF36 /begin FUNCTION_LIST PMDIAG /end FUNCTION_LIST BIT_MASK 0x1 /end MEASUREMENT
/begin MEASUREMENT St_pmdiag0.B_pcoschg "IBS Histrogramm darf gelöscht werden." UBYTE Def_bit_ub_5 0 0 0.0 255.0 ECU_ADDRESS 0x7FDF36 /begin FUNCTION_LIST PMDIAG /end FUNCTION_LIST BIT_MASK 0x20 /end MEASUREMENT
/begin MEASUREMENT St_pmdiag0.B_tiefrset "CC Meldung : Batterie verschlissen" UBYTE Def_bit_ub_7 0 0 0.0 255.0 ECU_ADDRESS 0x7FDF36 /begin FUNCTION_LIST PMDIAG /end FUNCTION_LIST BIT_MASK 0x80 /end MEASUREMENT
/begin MEASUREMENT St_pmdiag1 "Statuswort" UBYTE Def_st_ub_q1 0 0 0.0 255.0000 ECU_ADDRESS 0x7FDF37 /begin FUNCTION_LIST PMDIAG /end FUNCTION_LIST /end MEASUREMENT
/begin MEASUREMENT St_pmdiag1.B_ccruhver "CC Meldung : Powermgm ausser Betrieb" UBYTE Def_bit_ub_0 0 0 0.0 255.0 ECU_ADDRESS 0x7FDF37 /begin FUNCTION_LIST PMDIAG /end FUNCTION_LIST BIT_MASK 0x1 /end MEASUREMENT
/begin MEASUREMENT St_pmdiag1.B_histrset "CC Meldung : Batteriekontakt pruefen" UBYTE Def_bit_ub_1 0 0 0.0 255.0 ECU_ADDRESS 0x7FDF37 /begin FUNCTION_LIST PMDIAG /end FUNCTION_LIST BIT_MASK 0x2 /end MEASUREMENT
/begin MEASUREMENT St_pmdiag1.B_qelad1step "Tiefentladungsbit, B_tiefset, im IBS löschen." UBYTE Def_bit_ub_5 0 0 0.0 255.0 ECU_ADDRESS 0x7FDF37 /begin FUNCTION_LIST PMDIAG /end FUNCTION_LIST BIT_MASK 0x20 /end MEASUREMENT
/begin MEASUREMENT St_pmdiag1.B_ruhverl7 "Dient zum Aufziehen des internen Delay Timers" UBYTE Def_bit_ub_4 0 0 0.0 255.0 ECU_ADDRESS 0x7FDF37 /begin FUNCTION_LIST PMDIAG /end FUNCTION_LIST BIT_MASK 0x10 /end MEASUREMENT
/begin MEASUREMENT St_pmdiag1.B_sv_ihka "CC Meldung : erhoehter Ruhestrom" UBYTE Def_bit_ub_6 0 0 0.0 255.0 ECU_ADDRESS 0x7FDF37 /begin FUNCTION_LIST PMDIAG /end FUNCTION_LIST BIT_MASK 0x40 /end MEASUREMENT
/begin MEASUREMENT St_pmdiag1.B_timer_rst "Bed. SVstatus darf geändert werden." UBYTE Def_bit_ub_2 0 0 0.0 255.0 ECU_ADDRESS 0x7FDF37 /begin FUNCTION_LIST PMDIAG /end FUNCTION_LIST BIT_MASK 0x4 /end MEASUREMENT
/begin MEASUREMENT St_pmdiagnv "Statuswort" UBYTE Def_st_ub_q1 0 0 0.0 255.0000 ECU_ADDRESS 0x7FDEB4 /begin FUNCTION_LIST PMDIAG /end FUNCTION_LIST /end MEASUREMENT
/begin MEASUREMENT St_pmdiagnv.B_ruhverl "ruhestromverletzung vorhanden" UBYTE Def_bit_ub_0 0 0 0.0 255.0 ECU_ADDRESS 0x7FDEB4 /begin FUNCTION_LIST PMDIAG /end FUNCTION_LIST BIT_MASK 0x1 /end MEASUREMENT
/begin MEASUREMENT St_pmprsv_nv "Statuswort" UBYTE Def_st_ub_q1 0 0 0.0 255.0000 ECU_ADDRESS 0x7FDF53 /begin FUNCTION_LIST PMPRSVCALC /end FUNCTION_LIST /end MEASUREMENT
/begin MEASUREMENT St_pmprsv_nv.B_enwake7 "Bedg. ob 3b4 versendet wird" UBYTE Def_bit_ub_0 0 0 0.0 255.0 ECU_ADDRESS 0x7FDF53 /begin FUNCTION_LIST PMPRSVCALC /end FUNCTION_LIST BIT_MASK 0x1 /end MEASUREMENT
/begin MEASUREMENT St_pmprsvcalc "Statuswort" UBYTE Def_st_ub_q1 0 0 0.0 255.0000 ECU_ADDRESS 0x7FDFBC /begin FUNCTION_LIST PMPRSVCALC /end FUNCTION_LIST /end MEASUREMENT
/begin MEASUREMENT St_pmprsvcalc.B_gendef "IPM Massnahmen bzgl. Prios aktiviert" UBYTE Def_bit_ub_5 0 0 0.0 255.0 ECU_ADDRESS 0x7FDFBC /begin FUNCTION_LIST PMPRSVCALC /end FUNCTION_LIST BIT_MASK 0x20 /end MEASUREMENT
/begin MEASUREMENT St_pmprsvcalc.B_ipmaktiv "Bedingung für PI-Reset" UBYTE Def_bit_ub_3 0 0 0.0 255.0 ECU_ADDRESS 0x7FDFBC /begin FUNCTION_LIST PMPRSVCALC /end FUNCTION_LIST BIT_MASK 0x8 /end MEASUREMENT
/begin MEASUREMENT St_pmprsvcalc.B_ipmtimer "Bedingung Generator defekt während Motorbetrieb" UBYTE Def_bit_ub_2 0 0 0.0 255.0 ECU_ADDRESS 0x7FDFBC /begin FUNCTION_LIST PMPRSVCALC /end FUNCTION_LIST BIT_MASK 0x4 /end MEASUREMENT
/begin MEASUREMENT St_pmprsvcalc.B_kwdr_old "IPM Timer für Prios aktiv" UBYTE Def_bit_ub_4 0 0 0.0 255.0 ECU_ADDRESS 0x7FDFBC /begin FUNCTION_LIST PMPRSVCALC /end FUNCTION_LIST BIT_MASK 0x10 /end MEASUREMENT
/begin MEASUREMENT St_pmprsvcalc.B_nkwptcio "PTC Koordinator Maßnahmen Aktiv" UBYTE Def_bit_ub_6 0 0 0.0 255.0 ECU_ADDRESS 0x7FDFBC /begin FUNCTION_LIST PMPRSVCALC /end FUNCTION_LIST BIT_MASK 0x40 /end MEASUREMENT
/begin MEASUREMENT St_pmprsvcalc.B_ptckoor "Bedingung Batterie in Unterspannungszustand" UBYTE Def_bit_ub_7 0 0 0.0 255.0 ECU_ADDRESS 0x7FDFBC /begin FUNCTION_LIST PMPRSVCALC /end FUNCTION_LIST BIT_MASK 0x80 /end MEASUREMENT
/begin MEASUREMENT St_pmprsvcalc.B_ubtlow "Bedg., ob 3b3 versendet wird" UBYTE Def_bit_ub_0 0 0 0.0 255.0 ECU_ADDRESS 0x7FDFBC /begin FUNCTION_LIST PMPRSVCALC /end FUNCTION_LIST BIT_MASK 0x1 /end MEASUREMENT
/begin MEASUREMENT St_pmprsvcalc.B_uloreset "NKW status für PTC i.o." UBYTE Def_bit_ub_1 0 0 0.0 255.0 ECU_ADDRESS 0x7FDFBC /begin FUNCTION_LIST PMPRSVCALC /end FUNCTION_LIST BIT_MASK 0x2 /end MEASUREMENT
/begin MEASUREMENT St_pmprsvcalc1 "Statuswort" UBYTE Def_st_ub_q1 0 0 0.0 255.0000 ECU_ADDRESS 0x7FDFBD /begin FUNCTION_LIST PMPRSVCALC /end FUNCTION_LIST /end MEASUREMENT
/begin MEASUREMENT St_pmprsvcalc1.B_dubt "Bit, ob IBS Bus wecken darf oder nicht." UBYTE Def_bit_ub_1 0 0 0.0 255.0 ECU_ADDRESS 0x7FDFBD /begin FUNCTION_LIST PMPRSVCALC /end FUNCTION_LIST BIT_MASK 0x2 /end MEASUREMENT
/begin MEASUREMENT St_pmprsvcalc1.B_enwakeup "Bedingung Batterie nicht mehr in Unterspannungszustand" UBYTE Def_bit_ub_0 0 0 0.0 255.0 ECU_ADDRESS 0x7FDFBD /begin FUNCTION_LIST PMPRSVCALC /end FUNCTION_LIST BIT_MASK 0x1 /end MEASUREMENT
/begin MEASUREMENT St_pmprsvcalc1.B_limcalc "Dient zur Erkennung einer steigender Flanke B_kl15" UBYTE Def_bit_ub_5 0 0 0.0 255.0 ECU_ADDRESS 0x7FDFBD /begin FUNCTION_LIST PMPRSVCALC /end FUNCTION_LIST BIT_MASK 0x20 /end MEASUREMENT
/begin MEASUREMENT St_pmprsvcalc1.B_notprsv "Bed.Notlauf aufg.Batt-Unterspg, Generatorstat und B_kl15 in PMPRSVCALC" UBYTE Def_bit_ub_6 0 0 0.0 255.0 ECU_ADDRESS 0x7FDFBD /begin FUNCTION_LIST PMPRSVCALC /end FUNCTION_LIST BIT_MASK 0x40 /end MEASUREMENT
/begin MEASUREMENT St_pmprsvcalc1.B_pireset "lokales B_enwake" UBYTE Def_bit_ub_7 0 0 0.0 255.0 ECU_ADDRESS 0x7FDFBD /begin FUNCTION_LIST PMPRSVCALC /end FUNCTION_LIST BIT_MASK 0x80 /end MEASUREMENT
/begin MEASUREMENT St_pmprsvcalc1.B_pmbsdanf "Bedg. begrenzte Berechnung" UBYTE Def_bit_ub_4 0 0 0.0 255.0 ECU_ADDRESS 0x7FDFBD /begin FUNCTION_LIST PMPRSVCALC /end FUNCTION_LIST BIT_MASK 0x10 /end MEASUREMENT
/begin MEASUREMENT St_pmprsvcalc1.B_pmvsdanf "Bedg., ob dubt > 100mV" UBYTE Def_bit_ub_2 0 0 0.0 255.0 ECU_ADDRESS 0x7FDFBD /begin FUNCTION_LIST PMPRSVCALC /end FUNCTION_LIST BIT_MASK 0x4 /end MEASUREMENT
/begin MEASUREMENT St_pmsocalc1 "Statuswort" UBYTE Def_st_ub_q1 0 0 0.0 255.0000 ECU_ADDRESS 0x7FDFE4 /begin FUNCTION_LIST PMSOCCALC /end FUNCTION_LIST /end MEASUREMENT
/begin MEASUREMENT St_pmsocalc1.B_ibspwf_e "Uo Kalibrierung durchgeführt" UBYTE Def_bit_ub_0 0 0 0.0 255.0 ECU_ADDRESS 0x7FDFE4 /begin FUNCTION_LIST PMSOCCALC /end FUNCTION_LIST BIT_MASK 0x1 /end MEASUREMENT
/begin MEASUREMENT St_pmsoccalc "Statuswort" UBYTE Def_st_ub_q1 0 0 0.0 255.0000 ECU_ADDRESS 0x7FC78C /begin FUNCTION_LIST PMSOCCALC /end FUNCTION_LIST /end MEASUREMENT
/begin MEASUREMENT St_pmsoccalc.B_soc_pwf "Uo Kalibrierung durchgeführt" UBYTE Def_bit_ub_1 0 0 0.0 255.0 ECU_ADDRESS 0x7FC78C /begin FUNCTION_LIST PMSOCCALC /end FUNCTION_LIST BIT_MASK 0x2 /end MEASUREMENT
/begin MEASUREMENT St_pmsoccalc.B_soccalc "Bedingung Powerfail IBS erkannt" UBYTE Def_bit_ub_2 0 0 0.0 255.0 ECU_ADDRESS 0x7FC78C /begin FUNCTION_LIST PMSOCCALC /end FUNCTION_LIST BIT_MASK 0x4 /end MEASUREMENT
/begin MEASUREMENT St_pmsockor0 "Statuswort" UBYTE Def_st_ub_q1 0 0 0.0 255.0000 ECU_ADDRESS 0x7FC7AC /begin FUNCTION_LIST PMSOCKOR /end FUNCTION_LIST /end MEASUREMENT
/begin MEASUREMENT St_pmsockor0.B_abschfit "Bedingung Hilfsvariable Fit 3" UBYTE Def_bit_ub_5 0 0 0.0 255.0 ECU_ADDRESS 0x7FC7AC /begin FUNCTION_LIST PMSOCKOR /end FUNCTION_LIST BIT_MASK 0x20 /end MEASUREMENT
/begin MEASUREMENT St_pmsockor0.B_pm_fit2 "Bedingung Hilfsvariable Fit 2" UBYTE Def_bit_ub_1 0 0 0.0 255.0 ECU_ADDRESS 0x7FC7AC /begin FUNCTION_LIST PMSOCKOR /end FUNCTION_LIST BIT_MASK 0x2 /end MEASUREMENT
/begin MEASUREMENT St_pmsockor0.B_pm_fit3 "Bedingung Startqualität vollständig berechnet" UBYTE Def_bit_ub_2 0 0 0.0 255.0 ECU_ADDRESS 0x7FC7AC /begin FUNCTION_LIST PMSOCKOR /end FUNCTION_LIST BIT_MASK 0x4 /end MEASUREMENT
/begin MEASUREMENT St_pmsockor0.B_pmsocini "wird beim INIT wahr um den Timer zurückzusetzen" UBYTE Def_bit_ub_3 0 0 0.0 255.0 ECU_ADDRESS 0x7FC7AC /begin FUNCTION_LIST PMSOCKOR /end FUNCTION_LIST BIT_MASK 0x8 /end MEASUREMENT
/begin MEASUREMENT St_pmsockor0.B_q_start "Bedingung Korrektur Startfähigkeitsgrenze durchgeführt" UBYTE Def_bit_ub_4 0 0 0.0 255.0 ECU_ADDRESS 0x7FC7AC /begin FUNCTION_LIST PMSOCKOR /end FUNCTION_LIST BIT_MASK 0x10 /end MEASUREMENT
/begin MEASUREMENT St_pmsockor0.B_soc_npl "Bedingung SoC-Wert nicht plausibel" UBYTE Def_bit_ub_0 0 0 0.0 255.0 ECU_ADDRESS 0x7FC7AC /begin FUNCTION_LIST PMSOCKOR /end FUNCTION_LIST BIT_MASK 0x1 /end MEASUREMENT
/begin MEASUREMENT St_pmsocstart0 "Statuswort" UBYTE Def_st_ub_q1 0 0 0.0 255.0000 ECU_ADDRESS 0x7FE012 /begin FUNCTION_LIST PMSOCSTART /end FUNCTION_LIST /end MEASUREMENT
/begin MEASUREMENT St_pmsocstart0.B_pmstart7 "Bed. Motorstart für Startauswertung PM" UBYTE Def_bit_ub_0 0 0 0.0 255.0 ECU_ADDRESS 0x7FE012 /begin FUNCTION_LIST PMSOCSTART /end FUNCTION_LIST BIT_MASK 0x1 /end MEASUREMENT
/begin MEASUREMENT St_pmsocstart0.B_resetsta "Motor aus erkannt, Startwerte im IBS bereit zum löschen." UBYTE Def_bit_ub_1 0 0 0.0 255.0 ECU_ADDRESS 0x7FE012 /begin FUNCTION_LIST PMSOCSTART /end FUNCTION_LIST BIT_MASK 0x2 /end MEASUREMENT
/begin MEASUREMENT St_pmsocstart0.B_rstdatardy "Bedingung Reset Startauswertung" UBYTE Def_bit_ub_2 0 0 0.0 255.0 ECU_ADDRESS 0x7FE012 /begin FUNCTION_LIST PMSOCSTART /end FUNCTION_LIST BIT_MASK 0x4 /end MEASUREMENT
/begin MEASUREMENT St_pmsocstart_nv0 "Statuswort" UBYTE Def_st_ub_q1 0 0 0.0 255.0000 ECU_ADDRESS 0x7FE007 /begin FUNCTION_LIST PMSOCSTART /end FUNCTION_LIST /end MEASUREMENT
/begin MEASUREMENT St_pmsocstart_nv0.B_pmsqrdy "kt_ibs.dat" UBYTE Def_bit_ub_1 0 0 0.0 255.0 ECU_ADDRESS 0x7FE007 /begin FUNCTION_LIST PMSOCSTART /end FUNCTION_LIST BIT_MASK 0x2 /end MEASUREMENT
/begin MEASUREMENT St_pmsocstart_nv0.B_pmstartq "Bedingung Startqualität" UBYTE Def_bit_ub_0 0 0 0.0 255.0 ECU_ADDRESS 0x7FE007 /begin FUNCTION_LIST PMSOCSTART /end FUNCTION_LIST BIT_MASK 0x1 /end MEASUREMENT
/begin MEASUREMENT St_pmugencalc "Statuswort" UBYTE Def_st_ub_q1 0 0 0.0 255.0000 ECU_ADDRESS 0x7FC7CA /begin FUNCTION_LIST PMUGENCALC /end FUNCTION_LIST /end MEASUREMENT
/begin MEASUREMENT St_pmugencalc.B_genclcon "Wird auf true gesetzt wenn Motor und Generator bereits T_B_NMOT-Sekunden laufen." UBYTE Def_bit_ub_0 0 0 0.0 255.0 ECU_ADDRESS 0x7FC7CA /begin FUNCTION_LIST PMUGENCALC /end FUNCTION_LIST BIT_MASK 0x1 /end MEASUREMENT
/begin MEASUREMENT St_ugenkor0 "Statuswort" UBYTE Def_st_ub_q1 0 0 0.0 255.0000 ECU_ADDRESS 0x7FE030 /begin FUNCTION_LIST UGENKOR /end FUNCTION_LIST /end MEASUREMENT
/begin MEASUREMENT St_ugenkor0.B_1stugen "Bedingung ctrgenutar noch nicht gueltig" UBYTE Def_bit_ub_0 0 0 0.0 255.0 ECU_ADDRESS 0x7FE030 /begin FUNCTION_LIST UGENKOR /end FUNCTION_LIST BIT_MASK 0x1 /end MEASUREMENT
/begin MEASUREMENT St_ugenkor0.B_genoff "Bedingung Generator ausgeschaltet" UBYTE Def_bit_ub_3 0 0 0.0 255.0 ECU_ADDRESS 0x7FE030 /begin FUNCTION_LIST UGENKOR /end FUNCTION_LIST BIT_MASK 0x8 /end MEASUREMENT
/begin MEASUREMENT St_ugenkor0.B_genoff2 "Bedingung Generator2 ausgeschaltet" UBYTE Def_bit_ub_4 0 0 0.0 255.0 ECU_ADDRESS 0x7FE030 /begin FUNCTION_LIST UGENKOR /end FUNCTION_LIST BIT_MASK 0x10 /end MEASUREMENT
/begin MEASUREMENT St_ugenkor0.B_genoffok "Bedingung Generatorabschaltfreigabe Sicherheitstimer" UBYTE Def_bit_ub_5 0 0 0.0 255.0 ECU_ADDRESS 0x7FE030 /begin FUNCTION_LIST UGENKOR /end FUNCTION_LIST BIT_MASK 0x20 /end MEASUREMENT
/begin MEASUREMENT St_ugenkor0.B_genoffout "" UBYTE Def_bit_ub_1 0 0 0.0 255.0 ECU_ADDRESS 0x7FE030 /begin FUNCTION_LIST UGENKOR /end FUNCTION_LIST BIT_MASK 0x2 /end MEASUREMENT
/begin MEASUREMENT St_ugenkor0.B_noctrgen "Bedingung Ladespannungvorgabe ignoriert" UBYTE Def_bit_ub_6 0 0 0.0 255.0 ECU_ADDRESS 0x7FE030 /begin FUNCTION_LIST UGENKOR /end FUNCTION_LIST BIT_MASK 0x40 /end MEASUREMENT
/begin MEASUREMENT St_ugenkor0.B_ugenini "" UBYTE Def_bit_ub_2 0 0 0.0 255.0 ECU_ADDRESS 0x7FE030 /begin FUNCTION_LIST UGENKOR /end FUNCTION_LIST BIT_MASK 0x4 /end MEASUREMENT
/begin MEASUREMENT St_ugenkor0.B_verb_off "Bedingung elektr. Verbraucher AUS" UBYTE Def_bit_ub_7 0 0 0.0 255.0 ECU_ADDRESS 0x7FE030 /begin FUNCTION_LIST UGENKOR /end FUNCTION_LIST BIT_MASK 0x80 /end MEASUREMENT
/begin MEASUREMENT St_ugenkor1 "Statuswort" UBYTE Def_st_ub_q1 0 0 0.0 255.0000 ECU_ADDRESS 0x7FE01C /begin FUNCTION_LIST UGENKOR /end FUNCTION_LIST /end MEASUREMENT
/begin MEASUREMENT St_ugenkor1.B_gentoggl "Bedindung Toggel Generatorauswahl" UBYTE Def_bit_ub_0 0 0 0.0 255.0 ECU_ADDRESS 0x7FE01C /begin FUNCTION_LIST UGENKOR /end FUNCTION_LIST BIT_MASK 0x1 /end MEASUREMENT
/begin MEASUREMENT Stat_sv_reg "Status Standverbraucher registriert" UWORD Def_dez_uw_q1 0 0 0.0 65535.0000 ECU_ADDRESS 0x7FDF2C /begin FUNCTION_LIST PMDIAG /end FUNCTION_LIST /end MEASUREMENT
/begin MEASUREMENT Stat_sv_reg1 "LoByte Stat_sv_reg für Umweltbedingungen" UBYTE Def_dez_ub_q1 0 0 0.0 255.0000 ECU_ADDRESS 0x7FDF43 /begin FUNCTION_LIST PMDIAG /end FUNCTION_LIST /end MEASUREMENT
/begin MEASUREMENT Stat_sv_reg2 "HiByte Stat_sv_reg für Umweltbedinung" UBYTE Def_dez_ub_q1 0 0 0.0 255.0000 ECU_ADDRESS 0x7FDF44 /begin FUNCTION_LIST PMDIAG /end FUNCTION_LIST /end MEASUREMENT
/begin MEASUREMENT Stpcos "Status_Standverbraucher" UBYTE Def_dez_ub_q1 0 0 0.0 3.0000 ECU_ADDRESS 0x7FDFDB /begin FUNCTION_LIST PMPRSVCALC /end FUNCTION_LIST /end MEASUREMENT
/begin MEASUREMENT Stpcos7 "lokales stpcos" UBYTE Def_dez_ub_q1 0 0 0.0 3.0000 ECU_ADDRESS 0x7FDF55 /begin FUNCTION_LIST PMPRSVCALC /end FUNCTION_LIST /end MEASUREMENT
/begin MEASUREMENT Stpcosmem "altes stpcos" UBYTE Def_dez_ub_q1 0 0 0.0 3.0000 ECU_ADDRESS 0x7FDFDC /begin FUNCTION_LIST PMPRSVCALC /end FUNCTION_LIST /end MEASUREMENT
/begin MEASUREMENT Svaus "Status Standverbraucher sind aus " UBYTE Identity 0 0 0.0 1.0000 ECU_ADDRESS 0x7FDF45 /begin FUNCTION_LIST PMDIAG /end FUNCTION_LIST /end MEASUREMENT
/begin MEASUREMENT T1histshort "T1 Histogramm in 14.9333 MIn. Quantisiert" UBYTE Def_td_ub_q14p9333 0 0 0.0 3808.0000 ECU_ADDRESS 0x7FDF46 /begin FUNCTION_LIST PMDIAG /end FUNCTION_LIST /end MEASUREMENT
/begin MEASUREMENT T1pmcntr "T1PMINFO countdowncounter" UBYTE Def_td_ub_q0p1 0 0 0.0 25.5000 ECU_ADDRESS 0x7FDF47 /begin FUNCTION_LIST PMDIAG /end FUNCTION_LIST /end MEASUREMENT
/begin MEASUREMENT T2histshort "T2 Histogramm als Umweltbed. bei Ruhestromverletzung" UBYTE Def_td_ub_q14p9333 0 0 0.0 3808.0000 ECU_ADDRESS 0x7FDF48 /begin FUNCTION_LIST PMDIAG /end FUNCTION_LIST /end MEASUREMENT
/begin MEASUREMENT T2pmcntr "T2PMINFO countdowncounter" UWORD Def_td_uw_q0p1 0 0 0.0 6553.5000 ECU_ADDRESS 0x7FDF2E /begin FUNCTION_LIST PMDIAG /end FUNCTION_LIST /end MEASUREMENT
/begin MEASUREMENT T2rel "T2 / T_histsum" UBYTE Def_f_ub_b1 0 0 0.0 0.9960 ECU_ADDRESS 0x7FDF49 /begin FUNCTION_LIST PMDIAG /end FUNCTION_LIST /end MEASUREMENT
/begin MEASUREMENT T3histshort "T3 Histogramm als Umweltbed. bei Ruhestromverletzung" UBYTE Def_td_ub_q14p9333 0 0 0.0 3808.0000 ECU_ADDRESS 0x7FDF4A /begin FUNCTION_LIST PMDIAG /end FUNCTION_LIST /end MEASUREMENT
/begin MEASUREMENT T3pmcntr "T1PMINFO countdowncounter" UWORD Def_td_uw_q0p1 0 0 0.0 6553.5000 ECU_ADDRESS 0x7FDF30 /begin FUNCTION_LIST PMDIAG /end FUNCTION_LIST /end MEASUREMENT
/begin MEASUREMENT T3rel "T2 / T_histsum" UBYTE Def_f_ub_b1 0 0 0.0 0.9960 ECU_ADDRESS 0x7FDF4B /begin FUNCTION_LIST PMDIAG /end FUNCTION_LIST /end MEASUREMENT
/begin MEASUREMENT T4histshort "T4 Histogramm als Umweltbed. bei Ruhestromverletzung" UBYTE Def_td_ub_q14p9333 0 0 0.0 3808.0000 ECU_ADDRESS 0x7FDF4C /begin FUNCTION_LIST PMDIAG /end FUNCTION_LIST /end MEASUREMENT
/begin MEASUREMENT T4rel "T2 / T_histsum" UBYTE Def_f_ub_b1 0 0 0.0 0.9960 ECU_ADDRESS 0x7FDF4D /begin FUNCTION_LIST PMDIAG /end FUNCTION_LIST /end MEASUREMENT
/begin MEASUREMENT T_batt "Batterietemperatur" SWORD Def_t_sw_q0p1 0 0 -3276.8000 3276.7000 ECU_ADDRESS 0x7FE02C /begin FUNCTION_LIST UGENKOR /end FUNCTION_LIST /end MEASUREMENT
/begin MEASUREMENT T_bnmotakt "Zeit nachdem der Motor laeuft, hoert nach T_B_NMOT Sekunden auf." UBYTE Def_td_ub_q1 0 0 0.0 255.0000 ECU_ADDRESS 0x7FC7D6 /begin FUNCTION_LIST PMUGENCALC /end FUNCTION_LIST /end MEASUREMENT
/begin MEASUREMENT T_delta "Zeit, die seit letzem Prozessaufruf verstrichen ist. Dient zur Taskkompatibilitaet." UBYTE Def_td_ub_q1 0 0 0.0 255.0000 ECU_ADDRESS 0x7FC7D7 /begin FUNCTION_LIST PMUGENCALC /end FUNCTION_LIST /end MEASUREMENT
/begin MEASUREMENT T_histsum "Txhistiruh Summe" UWORD Def_td_uw_q56 0 0 0.0 3669960.0000 ECU_ADDRESS 0x7FDF32 /begin FUNCTION_LIST PMDIAG /end FUNCTION_LIST /end MEASUREMENT
/begin MEASUREMENT T_histsummin "Summe der Txhistiruh in Minuten" UWORD Def_td_uw_q0p933 0 0 0.0 61166.0000 ECU_ADDRESS 0x7FDF34 /begin FUNCTION_LIST PMDIAG /end FUNCTION_LIST /end MEASUREMENT
/begin MEASUREMENT T_saismem "T Saison zw. speicher" UBYTE Def_dez_ub_q1 0 0 0.0 255.0000 ECU_ADDRESS 0x7FDF4E /begin FUNCTION_LIST PMDIAG /end FUNCTION_LIST /end MEASUREMENT
/begin MEASUREMENT T_saison "Saison -Temperatur" SWORD Def_t_sw_q0p1 0 0 -3276.8000 3276.7000 ECU_ADDRESS 0x7FDFFC /begin FUNCTION_LIST PMSOCKOR /end FUNCTION_LIST /end MEASUREMENT
/begin MEASUREMENT T_saisonalt "letzter Wert Saisontemperatur" SWORD Def_t_sw_q0p1 0 0 -3276.8000 3276.7000 ECU_ADDRESS 0x7FC7B0 /begin FUNCTION_LIST PMSOCKOR /end FUNCTION_LIST /end MEASUREMENT
/begin MEASUREMENT Tsocloc "Batterietemperatur zum Zeitpunkt der Ruhespannungsmessung (lokal)" SWORD Def_t_sw_q0p1 0 0 -3276.8000 3276.7000 ECU_ADDRESS 0x7FC79E /begin FUNCTION_LIST PMSOCCALC /end FUNCTION_LIST /end MEASUREMENT
/begin MEASUREMENT U_gen "Sollwert Generatorspannung" UWORD Def_u_uw_q0p1 0 0 0.0 6553.5000 ECU_ADDRESS 0x7FE01E /begin FUNCTION_LIST UGENKOR /end FUNCTION_LIST /end MEASUREMENT
/begin MEASUREMENT U_gen2 "Generatosspannungssollwert für Generator2" UWORD Def_u_uw_q0p1 0 0 0.0 16.0000 ECU_ADDRESS 0x7FE020 /begin FUNCTION_LIST UGENKOR /end FUNCTION_LIST /end MEASUREMENT
/begin MEASUREMENT U_grenz "Grenzwert Spannung" UWORD Def_u_uw_q0p25em3_o6 0 0 6.0000 22.3837 ECU_ADDRESS 0x7FE00E /begin FUNCTION_LIST PMSOCSTART /end FUNCTION_LIST /end MEASUREMENT
/begin MEASUREMENT U_gsoll "Generatorsollspannung Basis" UWORD Def_u_uw_q0p1 0 0 0.0 6553.5000 ECU_ADDRESS 0x7FE022 /begin FUNCTION_LIST UGENKOR /end FUNCTION_LIST /end MEASUREMENT
/begin MEASUREMENT U_gsoll_tp "Generatorsollspannung Basis" UWORD Def_u_uw_q0p1 0 0 0.0 6553.5000 ECU_ADDRESS 0x7FE024 /begin FUNCTION_LIST UGENKOR /end FUNCTION_LIST /end MEASUREMENT
/begin MEASUREMENT U_gsoll_tp2 "Generatorsollspannung Basis" UWORD Def_u_uw_q0p1 0 0 0.0 6553.5000 ECU_ADDRESS 0x7FE026 /begin FUNCTION_LIST UGENKOR /end FUNCTION_LIST /end MEASUREMENT
/begin MEASUREMENT U_gsollred "reduzierte Generatorsollspannung" UWORD Def_u_uw_q0p1 0 0 0.0 6553.5000 ECU_ADDRESS 0x7FE028 /begin FUNCTION_LIST UGENKOR /end FUNCTION_LIST /end MEASUREMENT
/begin MEASUREMENT U_gsolltmp "reduzierte Zwischengeneratorsollspannung" UWORD Def_u_uw_q0p1 0 0 0.0 6553.5000 ECU_ADDRESS 0x7FE02E /begin FUNCTION_LIST UGENKOR /end FUNCTION_LIST /end MEASUREMENT
/begin MEASUREMENT U_ibs "Generatorspannungsvorgabe von IBS" SWORD Def_u_sw_b128 0 0 -128.0000 127.9960 ECU_ADDRESS 0x7FC7CC /begin FUNCTION_LIST PMUGENCALC /end FUNCTION_LIST /end MEASUREMENT
/begin MEASUREMENT U_startausw "U_tnstart - ugrenz" SWORD Def_u_sw_q0p00025 0 0 -8.1920 8.1917 ECU_ADDRESS 0x7FE00A /begin FUNCTION_LIST PMSOCSTART /end FUNCTION_LIST /end MEASUREMENT
/begin MEASUREMENT Ub_old "letzter Wert Batteriespannung" UWORD Def_u_uw_q0p0942 0 0 0.0 6173.3970 ECU_ADDRESS 0x7FE010 /begin FUNCTION_LIST PMSOCSTART /end FUNCTION_LIST /end MEASUREMENT
/begin MEASUREMENT Ubatt0 "Aus Wertetripel ausgewählter Ruhespannungswert" UWORD Def_u_uw_q0p25em3_o6 0 0 6.0000 22.3837 ECU_ADDRESS 0x7FC796 /begin FUNCTION_LIST PMSOCCALC /end FUNCTION_LIST /end MEASUREMENT
/begin MEASUREMENT Ubatts2 "Hilfswert2 Spannung aus Fitberechnung" UWORD Def_u_uw_q0p25em3_o6 0 0 6.0000 16.0000 ECU_ADDRESS 0x7FC7A6 /begin FUNCTION_LIST PMSOCFIT /end FUNCTION_LIST /end MEASUREMENT
/begin MEASUREMENT Ubattsoll "Batteriesollspannung aufgrund Batterietemperatur und Batt.-ladezustand. Weitere Nutzung in PMPRSVCALC." UWORD Def_u_uw_q0p25em3_o6 0 0 6.0000 22.3837 ECU_ADDRESS 0x7FC7D2 /begin FUNCTION_LIST PMUGENCALC /end FUNCTION_LIST /end MEASUREMENT
/begin MEASUREMENT Ubattsoll7 "lokales ubattsoll" UWORD Def_u_uw_q0p25em3_o6 0 0 6.0000 22.3837 ECU_ADDRESS 0x7FC7D4 /begin FUNCTION_LIST PMUGENCALC /end FUNCTION_LIST /end MEASUREMENT
/begin MEASUREMENT Ubdiff "ubattsoll - ubatt_w" SWORD Def_f_sw_b32 0 0 -32.0000 31.9990 ECU_ADDRESS 0x7FDF6C /begin FUNCTION_LIST PMPRSVCALC /end FUNCTION_LIST /end MEASUREMENT
/begin MEASUREMENT Ubdiff2pi "Ubatt-Differenz-Gewichtung auf Prios" SWORD Def_f_sw_p0q25 0 0 -100.0000 100.0000 ECU_ADDRESS 0x7FDF6E /begin FUNCTION_LIST PMPRSVCALC /end FUNCTION_LIST /end MEASUREMENT
/begin MEASUREMENT Ubdiffilt "Wert nach Ubdiff-Tiefpass Prio" SWORD Def_f_sw_b32 0 0 -32.0000 31.9990 ECU_ADDRESS 0x7FDF70 /begin FUNCTION_LIST PMPRSVCALC /end FUNCTION_LIST /end MEASUREMENT
/begin MEASUREMENT Ubdiffptc "Delta Usoll-Ubatt PTC" SWORD Def_f_sw_b32 0 0 -32.0000 31.9990 ECU_ADDRESS 0x7FDF72 /begin FUNCTION_LIST PMPRSVCALC /end FUNCTION_LIST /end MEASUREMENT
/begin MEASUREMENT Ubold7 "PTC dudt : alter Ub Wert zur Differenzbildung" UWORD Def_u_uw_q0p0942 0 0 0.0 6173.3970 ECU_ADDRESS 0x7FDFA2 /begin FUNCTION_LIST PMPRSVCALC /end FUNCTION_LIST /end MEASUREMENT
/begin MEASUREMENT Ubt "Batteriespannung" UWORD Def_u_uw_q0p015 0 0 0.0 983.0250 ECU_ADDRESS 0x7FDFA4 /begin FUNCTION_LIST PMPRSVCALC /end FUNCTION_LIST /end MEASUREMENT
/begin MEASUREMENT Ubt7 "Lokale Batteriespannung" UWORD Def_u_uw_q0p015 0 0 0.0 61.4250 ECU_ADDRESS 0x7FDFA6 /begin FUNCTION_LIST PMPRSVCALC /end FUNCTION_LIST /end MEASUREMENT
/begin MEASUREMENT Ubt7mem "resultierendes ubt" SWORD Def_u_sw_b128 0 0 -128.0000 127.9960 ECU_ADDRESS 0x7FDF74 /begin FUNCTION_LIST PMPRSVCALC /end FUNCTION_LIST /end MEASUREMENT
/begin MEASUREMENT Ubt7old "altes ubt" UWORD Def_u_uw_q0p015 0 0 0.0 61.4250 ECU_ADDRESS 0x7FDFA8 /begin FUNCTION_LIST PMPRSVCALC /end FUNCTION_LIST /end MEASUREMENT
/begin MEASUREMENT Ubtpt12ptc "Ubatt Gewichtung für PTC Ansteuerung" SWORD Def_f_sw_p0q25 0 0 -100.0000 100.0000 ECU_ADDRESS 0x7FDF76 /begin FUNCTION_LIST PMPRSVCALC /end FUNCTION_LIST /end MEASUREMENT
/begin MEASUREMENT Ubtpt1ptc "Ubdiffptc gefiltert" SWORD Def_f_sw_b32 0 0 -32.0000 31.9990 ECU_ADDRESS 0x7FDF78 /begin FUNCTION_LIST PMPRSVCALC /end FUNCTION_LIST /end MEASUREMENT
/begin MEASUREMENT Udelta "Delta zw. Battsollspg und Battspg" SWORD Def_u_sw_q0p00025 0 0 -8.1920 8.1917 ECU_ADDRESS 0x7FC7CE /begin FUNCTION_LIST PMUGENCALC /end FUNCTION_LIST /end MEASUREMENT
/begin MEASUREMENT Udeltaabs "Absolutwert von udelta" SWORD Def_u_sw_q0p00025 0 0 0.0 8.1917 ECU_ADDRESS 0x7FC7D0 /begin FUNCTION_LIST PMUGENCALC /end FUNCTION_LIST /end MEASUREMENT
/begin MEASUREMENT Udeltaabsc "absoluter Wert von udelta" UWORD Def_u_uw_q0p015 0 0 0.0 61.4250 ECU_ADDRESS 0x7FDFAA /begin FUNCTION_LIST PMPRSVCALC /end FUNCTION_LIST /end MEASUREMENT
/begin MEASUREMENT Udeltac "inkrementierte Differenz zwischen altem und neuem ubt" SWORD Def_u_sw_b128 0 0 -128.0000 127.9960 ECU_ADDRESS 0x7FDF7A /begin FUNCTION_LIST PMPRSVCALC /end FUNCTION_LIST /end MEASUREMENT
/begin MEASUREMENT Uibs7 "lokales uibs" SWORD Def_u_sw_b128 0 0 -128.0000 127.9960 ECU_ADDRESS 0x7FC7D8 /begin FUNCTION_LIST PMUGENCALC /end FUNCTION_LIST /end MEASUREMENT
/begin MEASUREMENT Ulev "Spannungsebene" UBYTE Def_dez_ub_q1 0 0 0.0 15.0000 ECU_ADDRESS 0x7FDFDD /begin FUNCTION_LIST PMPRSVCALC /end FUNCTION_LIST /end MEASUREMENT
/begin MEASUREMENT Ulevmem "altes ulev" UBYTE Def_dez_ub_q1 0 0 0.0 15.0000 ECU_ADDRESS 0x7FDFDE /begin FUNCTION_LIST PMPRSVCALC /end FUNCTION_LIST /end MEASUREMENT
/begin MEASUREMENT Ulow "Unterspannungsstatus : 0=i.O, 1=in between, 2=unterspannung" UBYTE Def_dez_ub_q1 0 0 0.0 255.0000 ECU_ADDRESS 0x7FDFDF /begin FUNCTION_LIST PMPRSVCALC /end FUNCTION_LIST /end MEASUREMENT
/begin MEASUREMENT Ulowtimer "Zeit zur Unterspannungserkennung * Taskzeit (50*100ms = 5sec)" UBYTE Def_td_ub_q0p1 0 0 0.0 25.5000 ECU_ADDRESS 0x7FDFE0 /begin FUNCTION_LIST PMPRSVCALC /end FUNCTION_LIST /end MEASUREMENT
/begin MEASUREMENT Uspgcnt "FS_Unterspannungscounter" UBYTE Def_td_ub_q0p1 0 0 0.0 25.5000 ECU_ADDRESS 0x7FDF4F /begin FUNCTION_LIST PMDIAG /end FUNCTION_LIST /end MEASUREMENT
/begin MEASUREMENT Uspgprell "Anzahl der entprellten FS_Unterspannungserkennung." UBYTE Def_dez_ub_q1 0 0 0.0 255.0000 ECU_ADDRESS 0x7FDF50 /begin FUNCTION_LIST PMDIAG /end FUNCTION_LIST /end MEASUREMENT
/begin MEASUREMENT Uspgstat "FS_Unterspannungsstatus" UBYTE Def_dez_ub_q1 0 0 0.0 255.0000 ECU_ADDRESS 0x7FDF51 /begin FUNCTION_LIST PMDIAG /end FUNCTION_LIST /end MEASUREMENT
/begin MEASUREMENT Ztagedelta "verstrichene Tage" UBYTE Def_dez_ub_q1 0 0 0.0 10.0000 ECU_ADDRESS 0x7FDF52 /begin FUNCTION_LIST PMDIAG /end FUNCTION_LIST /end MEASUREMENT
/begin MEASUREMENT Ztageold "letzter Wert von ztageabs_w" UWORD Def_dez_uw_q1 0 0 0.0 65535.0000 ECU_ADDRESS 0x7FDF04 /begin FUNCTION_LIST PMDIAG /end FUNCTION_LIST /end MEASUREMENT
/begin MEASUREMENT kbmcount "Counter, gesetzt von KBMCNT_APP" UBYTE Def_td_ub_q0p1 0 0 0.0 25.5000 ECU_ADDRESS 0x7FDFE1 /begin FUNCTION_LIST PMPRSVCALC /end FUNCTION_LIST /end MEASUREMENT
/begin FUNCTION OZRESTKM "OZRESTKM" /end FUNCTION
/begin FUNCTION OZTEMP "OZTEMP" /end FUNCTION
/begin FUNCTION PMBNSTAB "PMBNSTAB" /end FUNCTION
/begin FUNCTION PMDIAG "PMDIAG" /end FUNCTION
/begin FUNCTION PMPRSVCALC "PMPRSVCALC" /end FUNCTION
/begin FUNCTION PMSOCCALC "PMSOCCALC" /end FUNCTION
/begin FUNCTION PMSOCFIT "PMSOCFIT" /end FUNCTION
/begin FUNCTION PMSOCKOR "PMSOCKOR" /end FUNCTION
/begin FUNCTION PMSOCSTART "PMSOCSTART" /end FUNCTION
/begin FUNCTION PMUGENCALC "PMUGENCALC" /end FUNCTION
/begin FUNCTION UGENKOR "UGENKOR" /end FUNCTION
/begin COMPU_METHOD Def_bit_ub_0 "Def_bit_ub_0" TAB_VERB "%5.2" "-" COMPU_TAB_REF Def_bit_ub_0_VTAB /end COMPU_METHOD
/begin COMPU_METHOD Def_bit_ub_1 "Def_bit_ub_1" TAB_VERB "%5.2" "-" COMPU_TAB_REF Def_bit_ub_1_VTAB /end COMPU_METHOD
/begin COMPU_METHOD Def_bit_ub_2 "Def_bit_ub_2" TAB_VERB "%5.2" "-" COMPU_TAB_REF Def_bit_ub_2_VTAB /end COMPU_METHOD
/begin COMPU_METHOD Def_bit_ub_3 "Def_bit_ub_3" TAB_VERB "%5.2" "-" COMPU_TAB_REF Def_bit_ub_3_VTAB /end COMPU_METHOD
/begin COMPU_METHOD Def_bit_ub_4 "Def_bit_ub_4" TAB_VERB "%5.2" "-" COMPU_TAB_REF Def_bit_ub_4_VTAB /end COMPU_METHOD
/begin COMPU_METHOD Def_bit_ub_5 "Def_bit_ub_5" TAB_VERB "%5.2" "-" COMPU_TAB_REF Def_bit_ub_5_VTAB /end COMPU_METHOD
/begin COMPU_METHOD Def_bit_ub_6 "Def_bit_ub_6" TAB_VERB "%5.2" "-" COMPU_TAB_REF Def_bit_ub_6_VTAB /end COMPU_METHOD
/begin COMPU_METHOD Def_bit_ub_7 "Def_bit_ub_7" TAB_VERB "%5.2" "-" COMPU_TAB_REF Def_bit_ub_7_VTAB /end COMPU_METHOD
/begin COMPU_METHOD Def_dez_sw_q1 "Def_dez_sw_q1" RAT_FUNC "%5.0" "-" COEFFS 0 1 0 0 0 1 /end COMPU_METHOD
/begin COMPU_METHOD Def_dez_ub_q1 "Def_dez_ub_q1" RAT_FUNC "%3.0" "-" COEFFS 0 1 0 0 0 1 /end COMPU_METHOD
/begin COMPU_METHOD Def_dez_ul_q1 "Def_dez_ul_q1" RAT_FUNC "%7.0" "-" COEFFS 0 1 0 0 0 1 /end COMPU_METHOD
/begin COMPU_METHOD Def_dez_uw_q1 "Def_dez_uw_q1" RAT_FUNC "%5.0" "-" COEFFS 0 1 0 0 0 1 /end COMPU_METHOD
/begin COMPU_METHOD Def_f_sl_q0p007 "Def_f_sl_q0p007" RAT_FUNC "%10.3" "" COEFFS 0 65536 0 0 0 512 /end COMPU_METHOD
/begin COMPU_METHOD Def_f_sw_b100 "Def_f_sw_b100" RAT_FUNC "%8.3" "-" COEFFS 0 32768 0 0 0 100 /end COMPU_METHOD
/begin COMPU_METHOD Def_f_sw_b32 "Def_f_sw_b32" RAT_FUNC "%9.4" "-" COEFFS 0 32768 0 0 0 32 /end COMPU_METHOD
/begin COMPU_METHOD Def_f_sw_p0q25 "Def_f_sw_p0q25" RAT_FUNC "%7.2" "" COEFFS 0 4 0 0 0 1 /end COMPU_METHOD
/begin COMPU_METHOD Def_f_sw_q0p000147 "Def_f_sw_q0p000147" RAT_FUNC "%9.4" "-" COEFFS 0 64 0 0 0 0.0942 /end COMPU_METHOD
/begin COMPU_METHOD Def_f_sw_q0p00153 "Def_f_sw_q0p00153" RAT_FUNC "%8.3" "-" COEFFS 0 32768 0 0 0 50 /end COMPU_METHOD
/begin COMPU_METHOD Def_f_ub_b1 "Def_f_ub_b1" RAT_FUNC "%6.3" "-" COEFFS 0 256 0 0 0 1 /end COMPU_METHOD
/begin COMPU_METHOD Def_f_ub_b100 "Def_f_ub_b100" RAT_FUNC "%5.2" "%" COEFFS 0 256 0 0 0 100 /end COMPU_METHOD
/begin COMPU_METHOD Def_f_ub_b127p5 "Def_f_ub_b127p5" RAT_FUNC "%5.2" "%" COEFFS 0 2 0 0 0 1 /end COMPU_METHOD
/begin COMPU_METHOD Def_f_ub_b2 "Def_f_ub_b2" RAT_FUNC "%6.3" "-" COEFFS 0 256 0 0 0 2 /end COMPU_METHOD
/begin COMPU_METHOD Def_f_ub_b32 "Def_f_ub_b32" RAT_FUNC "%5.2" "-" COEFFS 0 256 0 0 0 32 /end COMPU_METHOD
/begin COMPU_METHOD Def_f_ub_b4 "Def_f_ub_b4" RAT_FUNC "%5.2" "-" COEFFS 0 256 0 0 0 4 /end COMPU_METHOD
/begin COMPU_METHOD Def_f_ub_b8 "Def_f_ub_b8" RAT_FUNC "%5.2" "-" COEFFS 0 256 0 0 0 8 /end COMPU_METHOD
/begin COMPU_METHOD Def_f_ub_q0p001 "Def_f_ub_q0p001" RAT_FUNC "%6.3" "" COEFFS 0 1000 0 0 0 1 /end COMPU_METHOD
/begin COMPU_METHOD Def_f_uw_b1 "Def_f_uw_b1" RAT_FUNC "%14.5" "-" COEFFS 0 65536 0 0 0 1 /end COMPU_METHOD
/begin COMPU_METHOD Def_f_uw_b100 "Def_f_uw_b100" RAT_FUNC "%8.3" "%" COEFFS 0 65536 0 0 0 100 /end COMPU_METHOD
/begin COMPU_METHOD Def_f_uw_b512 "Def_f_uw_b512" RAT_FUNC "%8.3" "-" COEFFS 0 65536 0 0 0 512 /end COMPU_METHOD
/begin COMPU_METHOD Def_f_uw_b64 "Def_f_uw_b64" RAT_FUNC "%9.4" "-" COEFFS 0 65536 0 0 0 64 /end COMPU_METHOD
/begin COMPU_METHOD Def_f_uw_q0p25 "Def_f_uw_q0p25" RAT_FUNC "%8.3" "" COEFFS 0 4 0 0 0 1 /end COMPU_METHOD
/begin COMPU_METHOD Def_fuel_ul_q0p000122 "Def_fuel_ul_q0p000122" RAT_FUNC "%11.4" "" COEFFS 0 8192 0 0 0 1 /end COMPU_METHOD
/begin COMPU_METHOD Def_i_sw_q0p02 "Def_i_sw_q0p02" RAT_FUNC "%8.3" "A" COEFFS 0 50 0 0 0 1 /end COMPU_METHOD
/begin COMPU_METHOD Def_i_ub_b1000 "Def_i_ub_b1000" RAT_FUNC "%6.3" "A" COEFFS 0 256 0 0 0 1000 /end COMPU_METHOD
/begin COMPU_METHOD Def_i_ub_q0p00125 "Def_i_ub_q0p00125" RAT_FUNC "%6.3" "" COEFFS 0 800 0 0 0 1 /end COMPU_METHOD
/begin COMPU_METHOD Def_i_ub_q1 "Def_i_ub_q1" RAT_FUNC "%6.3" "" COEFFS 0 1 0 0 0 1 /end COMPU_METHOD
/begin COMPU_METHOD Def_i_ub_q10 "Def_i_ub_q10" RAT_FUNC "%5.2" "A" COEFFS 0 1 0 0 0 10 /end COMPU_METHOD
/begin COMPU_METHOD Def_i_ub_q5p12 "Def_i_ub_q5p12" RAT_FUNC "%5.2" "" COEFFS 0 25 0 0 0 128 /end COMPU_METHOD
/begin COMPU_METHOD Def_i_uw_q0p02 "Def_i_uw_q0p02" RAT_FUNC "%8.3" "A" COEFFS 0 1 0 0 0 0.02 /end COMPU_METHOD
/begin COMPU_METHOD Def_i_uw_q0p08_o200 "Def_i_uw_q0p08_o200" RAT_FUNC "%8.3" "" COEFFS 0 25 5000 0 0 2 /end COMPU_METHOD
/begin COMPU_METHOD Def_km_sw_q10 "Def_km_sw_q10" RAT_FUNC "%6.1" "km" COEFFS 0 1 0 0 0 10 /end COMPU_METHOD
/begin COMPU_METHOD Def_km_uw_q10 "Def_km_uw_q10" RAT_FUNC "%5.0" "km" COEFFS 0 1 0 0 0 10 /end COMPU_METHOD
/begin COMPU_METHOD Def_kw_ub_q0p0234 "Def_kw_ub_q0p0234" RAT_FUNC "%6.3" "°KW" COEFFS 0 256 0 0 0 6 /end COMPU_METHOD
/begin COMPU_METHOD Def_lf_ub_q0p01 "Def_lf_ub_q0p01" RAT_FUNC "%5.2" "-" COEFFS 0 100 0 0 0 1 /end COMPU_METHOD
/begin COMPU_METHOD Def_n_sw_q1p0 "Def_n_sw_q1p0" RAT_FUNC "%5.0" "Upm" COEFFS 0 1 0 0 0 1 /end COMPU_METHOD
/begin COMPU_METHOD Def_perm_uw_b6 "Def_perm_uw_b6" RAT_FUNC "%14.5" "-" COEFFS 0 65536 0 0 0 6 /end COMPU_METHOD
/begin COMPU_METHOD Def_ql_ub_q1 "Def_ql_ub_q1" RAT_FUNC "%4.1" "" COEFFS 0 1 0 0 0 1 /end COMPU_METHOD
/begin COMPU_METHOD Def_ql_ul_q2p7Em7 "Def_ql_ul_q2p7Em7" RAT_FUNC "%11.4" "Ah" COEFFS 0 3600000 0 0 0 1 /end COMPU_METHOD
/begin COMPU_METHOD Def_ql_uw_q0p0182 "Def_ql_uw_q0p0182" RAT_FUNC "%8.3" "Ah" COEFFS 0 989 0 0 0 18 /end COMPU_METHOD
/begin COMPU_METHOD Def_ql_uw_q0p29127 "Def_ql_uw_q0p29127" RAT_FUNC "%7.2" "" COEFFS 0 103 0 0 0 30 /end COMPU_METHOD
/begin COMPU_METHOD Def_st_ub_q1 "Def_st_ub_q1" RAT_FUNC "%3.0" "-" COEFFS 0 1 0 0 0 1 /end COMPU_METHOD
/begin COMPU_METHOD Def_st_uw_q1 "Def_st_uw_q1" RAT_FUNC "%5.0" "-" COEFFS 0 1 0 0 0 1 /end COMPU_METHOD
/begin COMPU_METHOD Def_t_sw_q0p1 "Def_t_sw_q0p1" RAT_FUNC "%6.1" "°C" COEFFS 0 10 0 0 0 1 /end COMPU_METHOD
/begin COMPU_METHOD Def_td_ub_q0p1 "Def_td_ub_q0p1" RAT_FUNC "%4.1" "s" COEFFS 0 10 0 0 0 1 /end COMPU_METHOD
/begin COMPU_METHOD Def_td_ub_q1 "Def_td_ub_q1" RAT_FUNC "%5.2" "s" COEFFS 0 1 0 0 0 1 /end COMPU_METHOD
/begin COMPU_METHOD Def_td_ub_q14336 "Def_td_ub_q14336" RAT_FUNC "%5.2" "s" COEFFS 0 1 0 0 0 14336 /end COMPU_METHOD
/begin COMPU_METHOD Def_td_ub_q14p9333 "Def_td_ub_q14p9333" RAT_FUNC "%5.2" "min" COEFFS 0 15 0 0 0 224 /end COMPU_METHOD
/begin COMPU_METHOD Def_td_uw_q0p01 "Def_td_uw_q0p01" RAT_FUNC "%7.2" "s" COEFFS 0 100 0 0 0 1 /end COMPU_METHOD
/begin COMPU_METHOD Def_td_uw_q0p1 "Def_td_uw_q0p1" RAT_FUNC "%6.1" "s" COEFFS 0 10 0 0 0 1 /end COMPU_METHOD
/begin COMPU_METHOD Def_td_uw_q0p933 "Def_td_uw_q0p933" RAT_FUNC "%7.2" "min" COEFFS 0 15 0 0 0 14 /end COMPU_METHOD
/begin COMPU_METHOD Def_td_uw_q1 "Def_td_uw_q1" RAT_FUNC "%5.0" "s" COEFFS 0 1 0 0 0 1 /end COMPU_METHOD
/begin COMPU_METHOD Def_td_uw_q56 "Def_td_uw_q56" RAT_FUNC "%7.2" "s" COEFFS 0 1 0 0 0 56 /end COMPU_METHOD
/begin COMPU_METHOD Def_u_sb_q0p0942 "Def_u_sb_q0p0942" RAT_FUNC "%7.4" "V" COEFFS 0 1 0 0 0 0.0942 /end COMPU_METHOD
/begin COMPU_METHOD Def_u_sw_b128 "Def_u_sw_b128" RAT_FUNC "%8.3" "V" COEFFS 0 256 0 0 0 1 /end COMPU_METHOD
/begin COMPU_METHOD Def_u_sw_q0p00025 "Def_u_sw_q0p00025" RAT_FUNC "%9.4" "" COEFFS 0 4000 0 0 0 1 /end COMPU_METHOD
/begin COMPU_METHOD Def_u_ub_q0p0942 "Def_u_ub_q0p0942" RAT_FUNC "%7.4" "V" COEFFS 0 1 0 0 0 0.0942 /end COMPU_METHOD
/begin COMPU_METHOD Def_u_uw_q0p015 "Def_u_uw_q0p015" RAT_FUNC "%8.3" "V" COEFFS 0 200 0 0 0 3 /end COMPU_METHOD
/begin COMPU_METHOD Def_u_uw_q0p0942 "Def_u_uw_q0p0942" RAT_FUNC "%6.1" "V" COEFFS 0 1 0 0 0 0.0942 /end COMPU_METHOD
/begin COMPU_METHOD Def_u_uw_q0p1 "Def_u_uw_q0p1" RAT_FUNC "%8.3" "V" COEFFS 0 10 0 0 0 1 /end COMPU_METHOD
/begin COMPU_METHOD Def_u_uw_q0p25em3_o6 "Def_u_uw_q0p25em3_o6" RAT_FUNC "%9.4" "" COEFFS 0 -4000 24000 0 0 -1 /end COMPU_METHOD
/begin COMPU_METHOD Def_v_uw_q1p0 "Def_v_uw_q1p0" RAT_FUNC "%5.0" "km/h" COEFFS 0 1 0 0 0 1 /end COMPU_METHOD
/begin COMPU_METHOD Identity "Identity" RAT_FUNC "%4.1" "-" COEFFS 0 1 0 0 0 1 /end COMPU_METHOD
/begin COMPU_VTAB Def_bit_ub_0_VTAB "Def_bit_ub_0_VTAB" TAB_VERB 2 0 "FALSE" 1 "TRUE" /end COMPU_VTAB
/begin COMPU_VTAB Def_bit_ub_1_VTAB "Def_bit_ub_1_VTAB" TAB_VERB 2 0 "FALSE" 1 "TRUE" /end COMPU_VTAB
/begin COMPU_VTAB Def_bit_ub_2_VTAB "Def_bit_ub_2_VTAB" TAB_VERB 2 0 "FALSE" 1 "TRUE" /end COMPU_VTAB
/begin COMPU_VTAB Def_bit_ub_3_VTAB "Def_bit_ub_3_VTAB" TAB_VERB 2 0 "FALSE" 1 "TRUE" /end COMPU_VTAB
/begin COMPU_VTAB Def_bit_ub_4_VTAB "Def_bit_ub_4_VTAB" TAB_VERB 2 0 "FALSE" 1 "TRUE" /end COMPU_VTAB
/begin COMPU_VTAB Def_bit_ub_5_VTAB "Def_bit_ub_5_VTAB" TAB_VERB 2 0 "FALSE" 1 "TRUE" /end COMPU_VTAB
/begin COMPU_VTAB Def_bit_ub_6_VTAB "Def_bit_ub_6_VTAB" TAB_VERB 2 0 "FALSE" 1 "TRUE" /end COMPU_VTAB
/begin COMPU_VTAB Def_bit_ub_7_VTAB "Def_bit_ub_7_VTAB" TAB_VERB 2 0 "FALSE" 1 "TRUE" /end COMPU_VTAB
/begin COMPU_METHOD volAdd_ml_fine "feinere Auflösung des Additivvolumen [ml]" RAT_FUNC "%6.5" "ml" COEFFS 0 1000 0 0 0 1 /end COMPU_METHOD
/begin RECORD_LAYOUT TKF_SW_SW_UW NO_AXIS_PTS_X 1 UBYTE NO_AXIS_PTS_Y 2 UBYTE AXIS_PTS_X 3 SWORD INDEX_INCR DIRECT AXIS_PTS_Y 4 SWORD INDEX_INCR DIRECT FNC_VALUES 5 UWORD COLUMN_DIR DIRECT /end RECORD_LAYOUT
/begin RECORD_LAYOUT TKF_SW_UW_UW NO_AXIS_PTS_X 1 UBYTE NO_AXIS_PTS_Y 2 UBYTE AXIS_PTS_X 3 UWORD INDEX_INCR DIRECT AXIS_PTS_Y 4 SWORD INDEX_INCR DIRECT FNC_VALUES 5 UWORD COLUMN_DIR DIRECT /end RECORD_LAYOUT
/begin RECORD_LAYOUT TKF_UW_SW_UB NO_AXIS_PTS_X 1 UBYTE NO_AXIS_PTS_Y 2 UBYTE AXIS_PTS_X 3 SWORD INDEX_INCR DIRECT AXIS_PTS_Y 4 UWORD INDEX_INCR DIRECT FNC_VALUES 5 UBYTE COLUMN_DIR DIRECT /end RECORD_LAYOUT
/begin RECORD_LAYOUT TKF_UW_SW_UW NO_AXIS_PTS_X 1 UBYTE NO_AXIS_PTS_Y 2 UBYTE AXIS_PTS_X 3 SWORD INDEX_INCR DIRECT AXIS_PTS_Y 4 UWORD INDEX_INCR DIRECT FNC_VALUES 5 UWORD COLUMN_DIR DIRECT /end RECORD_LAYOUT
/begin RECORD_LAYOUT TKL_SW_VV_SW NO_AXIS_PTS_X 1 UBYTE RESERVED 2 BYTE AXIS_PTS_X 3 SWORD INDEX_INCR DIRECT FNC_VALUES 4 SWORD COLUMN_DIR DIRECT /end RECORD_LAYOUT
/begin RECORD_LAYOUT TKL_SW_VV_UB NO_AXIS_PTS_X 1 UBYTE RESERVED 2 BYTE AXIS_PTS_X 3 SWORD INDEX_INCR DIRECT FNC_VALUES 4 UBYTE COLUMN_DIR DIRECT /end RECORD_LAYOUT
/begin RECORD_LAYOUT TKL_SW_VV_UW NO_AXIS_PTS_X 1 UBYTE RESERVED 2 BYTE AXIS_PTS_X 3 SWORD INDEX_INCR DIRECT FNC_VALUES 4 UWORD COLUMN_DIR DIRECT /end RECORD_LAYOUT
/begin RECORD_LAYOUT TKL_UB_VV_SW NO_AXIS_PTS_X 1 UBYTE RESERVED 2 BYTE AXIS_PTS_X 3 UBYTE INDEX_INCR DIRECT FNC_VALUES 4 SWORD COLUMN_DIR DIRECT /end RECORD_LAYOUT
/begin RECORD_LAYOUT TKL_UB_VV_UB NO_AXIS_PTS_X 1 UBYTE RESERVED 2 BYTE AXIS_PTS_X 3 UBYTE INDEX_INCR DIRECT FNC_VALUES 4 UBYTE COLUMN_DIR DIRECT /end RECORD_LAYOUT
/begin RECORD_LAYOUT TKL_UB_VV_UW NO_AXIS_PTS_X 1 UBYTE RESERVED 2 BYTE AXIS_PTS_X 3 UBYTE INDEX_INCR DIRECT FNC_VALUES 4 UWORD COLUMN_DIR DIRECT /end RECORD_LAYOUT
/begin RECORD_LAYOUT TKL_UW_VV_SW NO_AXIS_PTS_X 1 UBYTE RESERVED 2 BYTE AXIS_PTS_X 3 UWORD INDEX_INCR DIRECT FNC_VALUES 4 SWORD COLUMN_DIR DIRECT /end RECORD_LAYOUT
/begin RECORD_LAYOUT TKL_UW_VV_UB NO_AXIS_PTS_X 1 UBYTE RESERVED 2 BYTE AXIS_PTS_X 3 UWORD INDEX_INCR DIRECT FNC_VALUES 4 UBYTE COLUMN_DIR DIRECT /end RECORD_LAYOUT
/begin RECORD_LAYOUT TKL_UW_VV_UW NO_AXIS_PTS_X 1 UBYTE RESERVED 2 BYTE AXIS_PTS_X 3 UWORD INDEX_INCR DIRECT FNC_VALUES 4 UWORD COLUMN_DIR DIRECT /end RECORD_LAYOUT
/begin RECORD_LAYOUT TKW_VV_VV_SW FNC_VALUES 1 SWORD COLUMN_DIR DIRECT /end RECORD_LAYOUT
/begin RECORD_LAYOUT TKW_VV_VV_UB FNC_VALUES 1 UBYTE COLUMN_DIR DIRECT /end RECORD_LAYOUT
/begin RECORD_LAYOUT TKW_VV_VV_UW FNC_VALUES 1 UWORD COLUMN_DIR DIRECT /end RECORD_LAYOUT
/end MODULE
/end PROJECT
