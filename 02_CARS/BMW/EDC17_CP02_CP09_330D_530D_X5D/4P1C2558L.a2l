ASAP2_VERSION 1 4
/begin PROJECT P_558 "EDC17_CP02"
/begin HEADER "" VERSION "V1C1" PROJECT_NO P_558 /end HEADER
/begin MODULE DIM ""
/begin MOD_COMMON "" BYTE_ORDER MSB_LAST ALIGNMENT_BYTE 1 ALIGNMENT_WORD 2 ALIGNMENT_LONG 4 ALIGNMENT_FLOAT32_IEEE 4 /end MOD_COMMON
/begin CHARACTERISTIC DFES_DbLv.DFC_AirCtlGovDvtEOMMax_C "/" VALUE 0x80073CD2 Val_Wu8 255.0 DFES_OneToOne 0.00 255.0 FORMAT "%5.1" /end CHARACTERISTIC
/begin CHARACTERISTIC DFES_DbLv.DFC_AirCtlGovDvtEOMMin_C "/" VALUE 0x80073CD3 Val_Wu8 255.0 DFES_OneToOne 0.00 255.0 FORMAT "%5.1" /end CHARACTERISTIC
/begin CHARACTERISTIC DFES_DbLv.DFC_AirCtlGovDvtMax_C "/" VALUE 0x80073CD4 Val_Wu8 255.0 DFES_OneToOne 0.00 255.0 FORMAT "%5.1" /end CHARACTERISTIC
/begin CHARACTERISTIC DFES_DbLv.DFC_AirCtlGovDvtMin_C "/" VALUE 0x80073CD5 Val_Wu8 255.0 DFES_OneToOne 0.00 255.0 FORMAT "%5.1" /end CHARACTERISTIC
/begin CHARACTERISTIC DFES_DbLv.DFC_Cj945SpiCom1_C "/" VALUE 0x80073CD6 Val_Wu8 255.0 DFES_OneToOne 0.00 255.0 FORMAT "%5.1" /end CHARACTERISTIC
/begin CHARACTERISTIC DFES_DbLv.DFC_ComButtonMSASig_C "/" VALUE 0x80073CD7 Val_Wu8 255.0 DFES_OneToOne 0.00 255.0 FORMAT "%5.1" /end CHARACTERISTIC
/begin CHARACTERISTIC DFES_DbLv.DFC_ComButtonMSATo_C "/" VALUE 0x80073CD8 Val_Wu8 255.0 DFES_OneToOne 0.00 255.0 FORMAT "%5.1" /end CHARACTERISTIC
/begin CHARACTERISTIC DFES_DbLv.DFC_ComGearboxData2Sig_C "/" VALUE 0x80073CD9 Val_Wu8 255.0 DFES_OneToOne 0.00 255.0 FORMAT "%5.1" /end CHARACTERISTIC
/begin CHARACTERISTIC DFES_DbLv.DFC_ComGearboxData2To_C "/" VALUE 0x80073CDA Val_Wu8 255.0 DFES_OneToOne 0.00 255.0 FORMAT "%5.1" /end CHARACTERISTIC
/begin CHARACTERISTIC DFES_DbLv.DFC_ComGearboxDataSig_C "/" VALUE 0x80073CDB Val_Wu8 255.0 DFES_OneToOne 0.00 255.0 FORMAT "%5.1" /end CHARACTERISTIC
/begin CHARACTERISTIC DFES_DbLv.DFC_ComGearboxDataTo_C "/" VALUE 0x80073CDC Val_Wu8 255.0 DFES_OneToOne 0.00 255.0 FORMAT "%5.1" /end CHARACTERISTIC
/begin CHARACTERISTIC DFES_DbLv.DFC_ComHeatACSig_C "/" VALUE 0x80073CDD Val_Wu8 255.0 DFES_OneToOne 0.00 255.0 FORMAT "%5.1" /end CHARACTERISTIC
/begin CHARACTERISTIC DFES_DbLv.DFC_ComHeatACTo_C "/" VALUE 0x80073CDE Val_Wu8 255.0 DFES_OneToOne 0.00 255.0 FORMAT "%5.1" /end CHARACTERISTIC
/begin CHARACTERISTIC DFES_DbLv.DFC_ComLenkradwinkelSig_C "/" VALUE 0x80073CDF Val_Wu8 255.0 DFES_OneToOne 0.00 255.0 FORMAT "%5.1" /end CHARACTERISTIC
/begin CHARACTERISTIC DFES_DbLv.DFC_ComLenkradwinkelTo_C "/" VALUE 0x80073CE0 Val_Wu8 255.0 DFES_OneToOne 0.00 255.0 FORMAT "%5.1" /end CHARACTERISTIC
/begin CHARACTERISTIC DFES_DbLv.DFC_ComMileageRangeSig_C "/" VALUE 0x80073CE1 Val_Wu8 255.0 DFES_OneToOne 0.00 255.0 FORMAT "%5.1" /end CHARACTERISTIC
/begin CHARACTERISTIC DFES_DbLv.DFC_ComMileageRangeTo_C "/" VALUE 0x80073CE2 Val_Wu8 255.0 DFES_OneToOne 0.00 255.0 FORMAT "%5.1" /end CHARACTERISTIC
/begin CHARACTERISTIC DFES_DbLv.DFC_ComPspSig_C "/" VALUE 0x80073CE3 Val_Wu8 255.0 DFES_OneToOne 0.00 255.0 FORMAT "%5.1" /end CHARACTERISTIC
/begin CHARACTERISTIC DFES_DbLv.DFC_ComPspTo_C "/" VALUE 0x80073CE4 Val_Wu8 255.0 DFES_OneToOne 0.00 255.0 FORMAT "%5.1" /end CHARACTERISTIC
/begin CHARACTERISTIC DFES_DbLv.DFC_ComShutOffPSPSig_C "/" VALUE 0x80073CE5 Val_Wu8 255.0 DFES_OneToOne 0.00 255.0 FORMAT "%5.1" /end CHARACTERISTIC
/begin CHARACTERISTIC DFES_DbLv.DFC_ComShutOffPSPTo_C "/" VALUE 0x80073CE6 Val_Wu8 255.0 DFES_OneToOne 0.00 255.0 FORMAT "%5.1" /end CHARACTERISTIC
/begin CHARACTERISTIC DFES_DbLv.DFC_ComStKombiCtr_C "/" VALUE 0x80073CE7 Val_Wu8 255.0 DFES_OneToOne 0.00 255.0 FORMAT "%5.1" /end CHARACTERISTIC
/begin CHARACTERISTIC DFES_DbLv.DFC_ComStKombiSig_C "/" VALUE 0x80073CE8 Val_Wu8 255.0 DFES_OneToOne 0.00 255.0 FORMAT "%5.1" /end CHARACTERISTIC
/begin CHARACTERISTIC DFES_DbLv.DFC_ComStKombiTo_C "/" VALUE 0x80073CE9 Val_Wu8 255.0 DFES_OneToOne 0.00 255.0 FORMAT "%5.1" /end CHARACTERISTIC
/begin CHARACTERISTIC DFES_DbLv.DFC_ComStateARSCtr_C "/" VALUE 0x80073CEA Val_Wu8 255.0 DFES_OneToOne 0.00 255.0 FORMAT "%5.1" /end CHARACTERISTIC
/begin CHARACTERISTIC DFES_DbLv.DFC_ComStateARSSig_C "/" VALUE 0x80073CEB Val_Wu8 255.0 DFES_OneToOne 0.00 255.0 FORMAT "%5.1" /end CHARACTERISTIC
/begin CHARACTERISTIC DFES_DbLv.DFC_ComStateARSTo_C "/" VALUE 0x80073CEC Val_Wu8 255.0 DFES_OneToOne 0.00 255.0 FORMAT "%5.1" /end CHARACTERISTIC
/begin CHARACTERISTIC DFES_DbLv.DFC_ComStateDscSig_C "/" VALUE 0x80073CED Val_Wu8 255.0 DFES_OneToOne 0.00 255.0 FORMAT "%5.1" /end CHARACTERISTIC
/begin CHARACTERISTIC DFES_DbLv.DFC_ComStateDscTo_C "/" VALUE 0x80073CEE Val_Wu8 255.0 DFES_OneToOne 0.00 255.0 FORMAT "%5.1" /end CHARACTERISTIC
/begin CHARACTERISTIC DFES_DbLv.DFC_ComStateSeatSig_C "/" VALUE 0x80073CEF Val_Wu8 255.0 DFES_OneToOne 0.00 255.0 FORMAT "%5.1" /end CHARACTERISTIC
/begin CHARACTERISTIC DFES_DbLv.DFC_ComStateSeatTo_C "/" VALUE 0x80073CF0 Val_Wu8 255.0 DFES_OneToOne 0.00 255.0 FORMAT "%5.1" /end CHARACTERISTIC
/begin CHARACTERISTIC DFES_DbLv.DFC_ComTempRelTimeSig_C "/" VALUE 0x80073CF1 Val_Wu8 255.0 DFES_OneToOne 0.00 255.0 FORMAT "%5.1" /end CHARACTERISTIC
/begin CHARACTERISTIC DFES_DbLv.DFC_ComTempRelTimeTo_C "/" VALUE 0x80073CF2 Val_Wu8 255.0 DFES_OneToOne 0.00 255.0 FORMAT "%5.1" /end CHARACTERISTIC
/begin CHARACTERISTIC DFES_DbLv.DFC_ComTerminalChk_C "/" VALUE 0x80073CF3 Val_Wu8 255.0 DFES_OneToOne 0.00 255.0 FORMAT "%5.1" /end CHARACTERISTIC
/begin CHARACTERISTIC DFES_DbLv.DFC_ComTerminalCtr_C "/" VALUE 0x80073CF4 Val_Wu8 255.0 DFES_OneToOne 0.00 255.0 FORMAT "%5.1" /end CHARACTERISTIC
/begin CHARACTERISTIC DFES_DbLv.DFC_ComTerminalSig_C "/" VALUE 0x80073CF5 Val_Wu8 255.0 DFES_OneToOne 0.00 255.0 FORMAT "%5.1" /end CHARACTERISTIC
/begin CHARACTERISTIC DFES_DbLv.DFC_ComTerminalTo_C "/" VALUE 0x80073CF6 Val_Wu8 255.0 DFES_OneToOne 0.00 255.0 FORMAT "%5.1" /end CHARACTERISTIC
/begin CHARACTERISTIC DFES_DbLv.DFC_ComTimeDateSig_C "/" VALUE 0x80073CF7 Val_Wu8 255.0 DFES_OneToOne 0.00 255.0 FORMAT "%5.1" /end CHARACTERISTIC
/begin CHARACTERISTIC DFES_DbLv.DFC_ComTimeDateTo_C "/" VALUE 0x80073CF8 Val_Wu8 255.0 DFES_OneToOne 0.00 255.0 FORMAT "%5.1" /end CHARACTERISTIC
/begin CHARACTERISTIC DFES_DbLv.DFC_ComTrailerSig_C "/" VALUE 0x80073CF9 Val_Wu8 255.0 DFES_OneToOne 0.00 255.0 FORMAT "%5.1" /end CHARACTERISTIC
/begin CHARACTERISTIC DFES_DbLv.DFC_ComTrailerTo_C "/" VALUE 0x80073CFA Val_Wu8 255.0 DFES_OneToOne 0.00 255.0 FORMAT "%5.1" /end CHARACTERISTIC
/begin CHARACTERISTIC DFES_DbLv.DFC_ComTrqDemandAfsChk_C "/" VALUE 0x80073CFB Val_Wu8 255.0 DFES_OneToOne 0.00 255.0 FORMAT "%5.1" /end CHARACTERISTIC
/begin CHARACTERISTIC DFES_DbLv.DFC_ComTrqDemandAfsCtr_C "/" VALUE 0x80073CFC Val_Wu8 255.0 DFES_OneToOne 0.00 255.0 FORMAT "%5.1" /end CHARACTERISTIC
/begin CHARACTERISTIC DFES_DbLv.DFC_ComTrqDemandAfsSig_C "/" VALUE 0x80073CFD Val_Wu8 255.0 DFES_OneToOne 0.00 255.0 FORMAT "%5.1" /end CHARACTERISTIC
/begin CHARACTERISTIC DFES_DbLv.DFC_ComTrqDemandAfsTo_C "/" VALUE 0x80073CFE Val_Wu8 255.0 DFES_OneToOne 0.00 255.0 FORMAT "%5.1" /end CHARACTERISTIC
/begin CHARACTERISTIC DFES_DbLv.DFC_ComTrqDemandDscChk_C "/" VALUE 0x80073CFF Val_Wu8 255.0 DFES_OneToOne 0.00 255.0 FORMAT "%5.1" /end CHARACTERISTIC
/begin CHARACTERISTIC DFES_DbLv.DFC_ComTrqDemandDscCtr_C "/" VALUE 0x80073D00 Val_Wu8 255.0 DFES_OneToOne 0.00 255.0 FORMAT "%5.1" /end CHARACTERISTIC
/begin CHARACTERISTIC DFES_DbLv.DFC_ComTrqDemandDscSig_C "/" VALUE 0x80073D01 Val_Wu8 255.0 DFES_OneToOne 0.00 255.0 FORMAT "%5.1" /end CHARACTERISTIC
/begin CHARACTERISTIC DFES_DbLv.DFC_ComTrqDemandDscTo_C "/" VALUE 0x80073D02 Val_Wu8 255.0 DFES_OneToOne 0.00 255.0 FORMAT "%5.1" /end CHARACTERISTIC
/begin CHARACTERISTIC DFES_DbLv.DFC_ComTrqDemandGbxChk_C "/" VALUE 0x80073D03 Val_Wu8 255.0 DFES_OneToOne 0.00 255.0 FORMAT "%5.1" /end CHARACTERISTIC
/begin CHARACTERISTIC DFES_DbLv.DFC_ComTrqDemandGbxCtr_C "/" VALUE 0x80073D04 Val_Wu8 255.0 DFES_OneToOne 0.00 255.0 FORMAT "%5.1" /end CHARACTERISTIC
/begin CHARACTERISTIC DFES_DbLv.DFC_ComTrqDemandGbxSig_C "/" VALUE 0x80073D05 Val_Wu8 255.0 DFES_OneToOne 0.00 255.0 FORMAT "%5.1" /end CHARACTERISTIC
/begin CHARACTERISTIC DFES_DbLv.DFC_ComTrqDemandGbxTo_C "/" VALUE 0x80073D06 Val_Wu8 255.0 DFES_OneToOne 0.00 255.0 FORMAT "%5.1" /end CHARACTERISTIC
/begin CHARACTERISTIC DFES_DbLv.DFC_ComVelocitySig_C "/" VALUE 0x80073D07 Val_Wu8 255.0 DFES_OneToOne 0.00 255.0 FORMAT "%5.1" /end CHARACTERISTIC
/begin CHARACTERISTIC DFES_DbLv.DFC_ComVelocityTo_C "/" VALUE 0x80073D08 Val_Wu8 255.0 DFES_OneToOne 0.00 255.0 FORMAT "%5.1" /end CHARACTERISTIC
/begin CHARACTERISTIC DFES_DbLv.DFC_ComWheelSpeedSig_C "/" VALUE 0x80073D09 Val_Wu8 255.0 DFES_OneToOne 0.00 255.0 FORMAT "%5.1" /end CHARACTERISTIC
/begin CHARACTERISTIC DFES_DbLv.DFC_ComWheelSpeedTo_C "/" VALUE 0x80073D0A Val_Wu8 255.0 DFES_OneToOne 0.00 255.0 FORMAT "%5.1" /end CHARACTERISTIC
/begin CHARACTERISTIC DFES_DbLv.DFC_ComZvKlappenSig_C "/" VALUE 0x80073D0B Val_Wu8 255.0 DFES_OneToOne 0.00 255.0 FORMAT "%5.1" /end CHARACTERISTIC
/begin CHARACTERISTIC DFES_DbLv.DFC_ComZvKlappenTo_C "/" VALUE 0x80073D0C Val_Wu8 255.0 DFES_OneToOne 0.00 255.0 FORMAT "%5.1" /end CHARACTERISTIC
/begin CHARACTERISTIC DFES_DbLv.DFC_Cy150SpiCom_C "/" VALUE 0x80073D0D Val_Wu8 255.0 DFES_OneToOne 0.00 255.0 FORMAT "%5.1" /end CHARACTERISTIC
/begin CHARACTERISTIC DFES_DbLv.DFC_Cy320SpiCom_C "/" VALUE 0x80073D0E Val_Wu8 255.0 DFES_OneToOne 0.00 255.0 FORMAT "%5.1" /end CHARACTERISTIC
/begin CHARACTERISTIC DFES_DbLv.DFC_ETCtlDvtInrMax_C "/" VALUE 0x80073D0F Val_Wu8 255.0 DFES_OneToOne 0.00 255.0 FORMAT "%5.1" /end CHARACTERISTIC
/begin CHARACTERISTIC DFES_DbLv.DFC_ETCtlDvtInrMin_C "/" VALUE 0x80073D10 Val_Wu8 255.0 DFES_OneToOne 0.00 255.0 FORMAT "%5.1" /end CHARACTERISTIC
/begin CHARACTERISTIC DFES_DbLv.DFC_ETCtlDvtOutrMax_C "/" VALUE 0x80073D11 Val_Wu8 255.0 DFES_OneToOne 0.00 255.0 FORMAT "%5.1" /end CHARACTERISTIC
/begin CHARACTERISTIC DFES_DbLv.DFC_ETCtlDvtOutrMin_C "/" VALUE 0x80073D12 Val_Wu8 255.0 DFES_OneToOne 0.00 255.0 FORMAT "%5.1" /end CHARACTERISTIC
/begin CHARACTERISTIC DFES_DbLv.DFC_Fan4WinErr1_C "/" VALUE 0x80073D13 Val_Wu8 255.0 DFES_OneToOne 0.00 255.0 FORMAT "%5.1" /end CHARACTERISTIC
/begin CHARACTERISTIC DFES_DbLv.DFC_Fan4WinErr2_C "/" VALUE 0x80073D14 Val_Wu8 255.0 DFES_OneToOne 0.00 255.0 FORMAT "%5.1" /end CHARACTERISTIC
/begin CHARACTERISTIC DFES_DbLv.DFC_Fan4WinErr3_C "/" VALUE 0x80073D15 Val_Wu8 255.0 DFES_OneToOne 0.00 255.0 FORMAT "%5.1" /end CHARACTERISTIC
/begin CHARACTERISTIC DFES_DbLv.DFC_Fan4WinErr4_C "/" VALUE 0x80073D16 Val_Wu8 255.0 DFES_OneToOne 0.00 255.0 FORMAT "%5.1" /end CHARACTERISTIC
/begin CHARACTERISTIC DFES_DbLv.DFC_FanSCG_C "/" VALUE 0x80073D17 Val_Wu8 255.0 DFES_OneToOne 0.00 255.0 FORMAT "%5.1" /end CHARACTERISTIC
/begin CHARACTERISTIC DFES_DbLv.DFC_PCRGovDvtLPMax_C "/" VALUE 0x80073D18 Val_Wu8 255.0 DFES_OneToOne 0.00 255.0 FORMAT "%5.1" /end CHARACTERISTIC
/begin CHARACTERISTIC DFES_DbLv.DFC_PCRGovDvtLPMin_C "/" VALUE 0x80073D19 Val_Wu8 255.0 DFES_OneToOne 0.00 255.0 FORMAT "%5.1" /end CHARACTERISTIC
/begin CHARACTERISTIC DFES_DbLv.DFC_PCRGovDvtMax_C "/" VALUE 0x80073D1A Val_Wu8 255.0 DFES_OneToOne 0.00 255.0 FORMAT "%5.1" /end CHARACTERISTIC
/begin CHARACTERISTIC DFES_DbLv.DFC_PCRGovDvtMin_C "/" VALUE 0x80073D1B Val_Wu8 255.0 DFES_OneToOne 0.00 255.0 FORMAT "%5.1" /end CHARACTERISTIC
/begin CHARACTERISTIC DFES_DbLv.DFC_RailCPC1_C "/" VALUE 0x80073D1C Val_Wu8 255.0 DFES_OneToOne 0.00 255.0 FORMAT "%5.1" /end CHARACTERISTIC
/begin CHARACTERISTIC DFES_DbLv.DFC_RailCPC3_C "/" VALUE 0x80073D1D Val_Wu8 255.0 DFES_OneToOne 0.00 255.0 FORMAT "%5.1" /end CHARACTERISTIC
/begin CHARACTERISTIC DFES_DbLv.DFC_RailCPC4_C "/" VALUE 0x80073D1E Val_Wu8 255.0 DFES_OneToOne 0.00 255.0 FORMAT "%5.1" /end CHARACTERISTIC
/begin CHARACTERISTIC DFES_DbLv.DFC_RailMeUn0_C "/" VALUE 0x80073D1F Val_Wu8 255.0 DFES_OneToOne 0.00 255.0 FORMAT "%5.1" /end CHARACTERISTIC
/begin CHARACTERISTIC DFES_DbLv.DFC_RailMeUn1_C "/" VALUE 0x80073D20 Val_Wu8 255.0 DFES_OneToOne 0.00 255.0 FORMAT "%5.1" /end CHARACTERISTIC
/begin CHARACTERISTIC DFES_DbLv.DFC_RailMeUn2_C "/" VALUE 0x80073D21 Val_Wu8 255.0 DFES_OneToOne 0.00 255.0 FORMAT "%5.1" /end CHARACTERISTIC
/begin CHARACTERISTIC DFES_DbLv.DFC_RailMeUn3_C "/" VALUE 0x80073D22 Val_Wu8 255.0 DFES_OneToOne 0.00 255.0 FORMAT "%5.1" /end CHARACTERISTIC
/begin CHARACTERISTIC DFES_DbLv.DFC_RailMeUn4_C "/" VALUE 0x80073D23 Val_Wu8 255.0 DFES_OneToOne 0.00 255.0 FORMAT "%5.1" /end CHARACTERISTIC
/begin CHARACTERISTIC DFES_DbLv.DFC_RailPCV0_C "/" VALUE 0x80073D24 Val_Wu8 255.0 DFES_OneToOne 0.00 255.0 FORMAT "%5.1" /end CHARACTERISTIC
/begin CHARACTERISTIC DFES_DbLv.DFC_RailPCV1_C "/" VALUE 0x80073D25 Val_Wu8 255.0 DFES_OneToOne 0.00 255.0 FORMAT "%5.1" /end CHARACTERISTIC
/begin CHARACTERISTIC DFES_DbLv.DFC_RailPCV2_C "/" VALUE 0x80073D26 Val_Wu8 255.0 DFES_OneToOne 0.00 255.0 FORMAT "%5.1" /end CHARACTERISTIC
/begin CHARACTERISTIC DFES_DbLv.DFC_RailPCV3_C "/" VALUE 0x80073D27 Val_Wu8 255.0 DFES_OneToOne 0.00 255.0 FORMAT "%5.1" /end CHARACTERISTIC
/begin CHARACTERISTIC DFES_DbLv.DFC_RailPCV4_C "/" VALUE 0x80073D28 Val_Wu8 255.0 DFES_OneToOne 0.00 255.0 FORMAT "%5.1" /end CHARACTERISTIC
/begin CHARACTERISTIC DFES_DbLv.DFC_RailPMonStrt_C "/" VALUE 0x80073D29 Val_Wu8 255.0 DFES_OneToOne 0.00 255.0 FORMAT "%5.1" /end CHARACTERISTIC
/begin CHARACTERISTIC DFES_DbLv.DFC_SSpMon1_C "/" VALUE 0x80073D2A Val_Wu8 255.0 DFES_OneToOne 0.00 255.0 FORMAT "%5.1" /end CHARACTERISTIC
/begin CHARACTERISTIC DFES_DbLv.DFC_SSpMon2_C "/" VALUE 0x80073D2B Val_Wu8 255.0 DFES_OneToOne 0.00 255.0 FORMAT "%5.1" /end CHARACTERISTIC
/begin CHARACTERISTIC DFES_DbLv.DFC_SSpMon3_C "/" VALUE 0x80073D2C Val_Wu8 255.0 DFES_OneToOne 0.00 255.0 FORMAT "%5.1" /end CHARACTERISTIC
/begin CHARACTERISTIC DFES_DbLv.DFC_Sia_E1_C "/" VALUE 0x80073D2D Val_Wu8 255.0 DFES_OneToOne 0.00 255.0 FORMAT "%5.1" /end CHARACTERISTIC
/begin CHARACTERISTIC DFES_DbLv.DFC_Sia_E10_C "/" VALUE 0x80073D2E Val_Wu8 255.0 DFES_OneToOne 0.00 255.0 FORMAT "%5.1" /end CHARACTERISTIC
/begin CHARACTERISTIC DFES_DbLv.DFC_Sia_E11_C "/" VALUE 0x80073D2F Val_Wu8 255.0 DFES_OneToOne 0.00 255.0 FORMAT "%5.1" /end CHARACTERISTIC
/begin CHARACTERISTIC DFES_DbLv.DFC_Sia_E12_C "/" VALUE 0x80073D30 Val_Wu8 255.0 DFES_OneToOne 0.00 255.0 FORMAT "%5.1" /end CHARACTERISTIC
/begin CHARACTERISTIC DFES_DbLv.DFC_Sia_E13_C "/" VALUE 0x80073D31 Val_Wu8 255.0 DFES_OneToOne 0.00 255.0 FORMAT "%5.1" /end CHARACTERISTIC
/begin CHARACTERISTIC DFES_DbLv.DFC_Sia_E14_C "/" VALUE 0x80073D32 Val_Wu8 255.0 DFES_OneToOne 0.00 255.0 FORMAT "%5.1" /end CHARACTERISTIC
/begin CHARACTERISTIC DFES_DbLv.DFC_Sia_E15_C "/" VALUE 0x80073D33 Val_Wu8 255.0 DFES_OneToOne 0.00 255.0 FORMAT "%5.1" /end CHARACTERISTIC
/begin CHARACTERISTIC DFES_DbLv.DFC_Sia_E2_C "/" VALUE 0x80073D34 Val_Wu8 255.0 DFES_OneToOne 0.00 255.0 FORMAT "%5.1" /end CHARACTERISTIC
/begin CHARACTERISTIC DFES_DbLv.DFC_Sia_E3_C "/" VALUE 0x80073D35 Val_Wu8 255.0 DFES_OneToOne 0.00 255.0 FORMAT "%5.1" /end CHARACTERISTIC
/begin CHARACTERISTIC DFES_DbLv.DFC_Sia_E4_C "/" VALUE 0x80073D36 Val_Wu8 255.0 DFES_OneToOne 0.00 255.0 FORMAT "%5.1" /end CHARACTERISTIC
/begin CHARACTERISTIC DFES_DbLv.DFC_Sia_E5_C "/" VALUE 0x80073D37 Val_Wu8 255.0 DFES_OneToOne 0.00 255.0 FORMAT "%5.1" /end CHARACTERISTIC
/begin CHARACTERISTIC DFES_DbLv.DFC_Sia_E6_C "/" VALUE 0x80073D38 Val_Wu8 255.0 DFES_OneToOne 0.00 255.0 FORMAT "%5.1" /end CHARACTERISTIC
/begin CHARACTERISTIC DFES_DbLv.DFC_Sia_E7_C "/" VALUE 0x80073D39 Val_Wu8 255.0 DFES_OneToOne 0.00 255.0 FORMAT "%5.1" /end CHARACTERISTIC
/begin CHARACTERISTIC DFES_DbLv.DFC_Sia_E8_C "/" VALUE 0x80073D3A Val_Wu8 255.0 DFES_OneToOne 0.00 255.0 FORMAT "%5.1" /end CHARACTERISTIC
/begin CHARACTERISTIC DFES_DbLv.DFC_Sia_E9_C "/" VALUE 0x80073D3B Val_Wu8 255.0 DFES_OneToOne 0.00 255.0 FORMAT "%5.1" /end CHARACTERISTIC
/begin CHARACTERISTIC DFES_DbLv.DFC_ThrVlv4WinErr1_C "/" VALUE 0x80073D3C Val_Wu8 255.0 DFES_OneToOne 0.00 255.0 FORMAT "%5.1" /end CHARACTERISTIC
/begin CHARACTERISTIC DFES_DbLv.DFC_ThrVlv4WinErr2_C "/" VALUE 0x80073D3D Val_Wu8 255.0 DFES_OneToOne 0.00 255.0 FORMAT "%5.1" /end CHARACTERISTIC
/begin CHARACTERISTIC DFES_DbLv.DFC_ThrVlv4WinErr3_C "/" VALUE 0x80073D3E Val_Wu8 255.0 DFES_OneToOne 0.00 255.0 FORMAT "%5.1" /end CHARACTERISTIC
/begin CHARACTERISTIC DFES_DbLv.DFC_ThrVlv4WinErr4_C "/" VALUE 0x80073D3F Val_Wu8 255.0 DFES_OneToOne 0.00 255.0 FORMAT "%5.1" /end CHARACTERISTIC
/begin CHARACTERISTIC DFES_DbLv.DFC_ThrVlvSCG_C "/" VALUE 0x80073D40 Val_Wu8 255.0 DFES_OneToOne 0.00 255.0 FORMAT "%5.1" /end CHARACTERISTIC
/begin CHARACTERISTIC DFES_DbLv.DFC_TrbCh4WinErr1_C "/" VALUE 0x80073D41 Val_Wu8 255.0 DFES_OneToOne 0.00 255.0 FORMAT "%5.1" /end CHARACTERISTIC
/begin CHARACTERISTIC DFES_DbLv.DFC_TrbCh4WinErr2_C "/" VALUE 0x80073D42 Val_Wu8 255.0 DFES_OneToOne 0.00 255.0 FORMAT "%5.1" /end CHARACTERISTIC
/begin CHARACTERISTIC DFES_DbLv.DFC_TrbCh4WinErr3_C "/" VALUE 0x80073D43 Val_Wu8 255.0 DFES_OneToOne 0.00 255.0 FORMAT "%5.1" /end CHARACTERISTIC
/begin CHARACTERISTIC DFES_DbLv.DFC_TrbCh4WinErr4_C "/" VALUE 0x80073D44 Val_Wu8 255.0 DFES_OneToOne 0.00 255.0 FORMAT "%5.1" /end CHARACTERISTIC
/begin CHARACTERISTIC DFES_DbLv.DFC_TrbChSCG_C "/" VALUE 0x80073D45 Val_Wu8 255.0 DFES_OneToOne 0.00 255.0 FORMAT "%5.1" /end CHARACTERISTIC
/begin CHARACTERISTIC DFES_DbLv.DFC_TrbChSRCMax_C "/" VALUE 0x80073D46 Val_Wu8 255.0 DFES_OneToOne 0.00 255.0 FORMAT "%5.1" /end CHARACTERISTIC
/begin CHARACTERISTIC DFES_DbLv.DFC_TrbChSRCMin_C "/" VALUE 0x80073D47 Val_Wu8 255.0 DFES_OneToOne 0.00 255.0 FORMAT "%5.1" /end CHARACTERISTIC
/begin CHARACTERISTIC DFES_DbLv.DFC_WaHtEl4WinErr1_C "/" VALUE 0x80073D48 Val_Wu8 255.0 DFES_OneToOne 0.00 255.0 FORMAT "%5.1" /end CHARACTERISTIC
/begin CHARACTERISTIC DFES_DbLv.DFC_WaHtEl4WinErr2_C "/" VALUE 0x80073D49 Val_Wu8 255.0 DFES_OneToOne 0.00 255.0 FORMAT "%5.1" /end CHARACTERISTIC
/begin CHARACTERISTIC DFES_DbLv.DFC_WaHtEl4WinErr3_C "/" VALUE 0x80073D4A Val_Wu8 255.0 DFES_OneToOne 0.00 255.0 FORMAT "%5.1" /end CHARACTERISTIC
/begin CHARACTERISTIC DFES_DbLv.DFC_WaHtEl4WinErr4_C "/" VALUE 0x80073D4B Val_Wu8 255.0 DFES_OneToOne 0.00 255.0 FORMAT "%5.1" /end CHARACTERISTIC
/begin CHARACTERISTIC DFES_DbLv.DFC_WaHtElSCG_C "/" VALUE 0x80073D4C Val_Wu8 255.0 DFES_OneToOne 0.00 255.0 FORMAT "%5.1" /end CHARACTERISTIC
/begin CHARACTERISTIC DFES_DbLv.DFC_ETClbETFltMax_C "/" VALUE 0x80073D4D Val_Wu8 255.0 DFES_OneToOne 0.00 255.0 FORMAT "%5.1" /end CHARACTERISTIC
/begin CHARACTERISTIC DFES_DbLv.DFC_ETClbETFltMin_C "/" VALUE 0x80073D4E Val_Wu8 255.0 DFES_OneToOne 0.00 255.0 FORMAT "%5.1" /end CHARACTERISTIC
/begin CHARACTERISTIC DFES_DbLv.DFC_InjCrvInjLimChrgBal_C "/" VALUE 0x80073D4F Val_Wu8 255.0 DFES_OneToOne 0.00 255.0 FORMAT "%5.1" /end CHARACTERISTIC
/begin CHARACTERISTIC DFES_DbLv.DFC_InjCrvInjLimQntBal_C "/" VALUE 0x80073D50 Val_Wu8 255.0 DFES_OneToOne 0.00 255.0 FORMAT "%5.1" /end CHARACTERISTIC
/begin CHARACTERISTIC DFES_DbLv.DFC_InjCrvInjLimSys_C "/" VALUE 0x80073D51 Val_Wu8 255.0 DFES_OneToOne 0.00 255.0 FORMAT "%5.1" /end CHARACTERISTIC
/begin CHARACTERISTIC DFES_DbLv.DFC_InjCrvNumInjRtmLim_C "/" VALUE 0x80073D52 Val_Wu8 255.0 DFES_OneToOne 0.00 255.0 FORMAT "%5.1" /end CHARACTERISTIC
/begin CHARACTERISTIC DFES_DbLv.DFC_LSUHtCoupSig_0_C "/" VALUE 0x80073D53 Val_Wu8 255.0 DFES_OneToOne 0.00 255.0 FORMAT "%5.1" /end CHARACTERISTIC
/begin CHARACTERISTIC DFES_DbLv.DFC_LSUHtCoupSig_1_C "/" VALUE 0x80073D54 Val_Wu8 255.0 DFES_OneToOne 0.00 255.0 FORMAT "%5.1" /end CHARACTERISTIC
/begin CHARACTERISTIC DFES_DbLv.DFC_LSUHtCoupSig_2_C "/" VALUE 0x80073D55 Val_Wu8 255.0 DFES_OneToOne 0.00 255.0 FORMAT "%5.1" /end CHARACTERISTIC
/begin CHARACTERISTIC DFES_DbLv.DFC_LSUHtCoupSig_3_C "/" VALUE 0x80073D56 Val_Wu8 255.0 DFES_OneToOne 0.00 255.0 FORMAT "%5.1" /end CHARACTERISTIC
/begin CHARACTERISTIC DFES_DbLv.DFC_CtT_C "/" VALUE 0x80073D57 Val_Wu8 255.0 DFES_OneToOne 0.00 255.0 FORMAT "%5.1" /end CHARACTERISTIC
/begin CHARACTERISTIC DFES_DbLv.DFC_DSMDummy_C "/" VALUE 0x80073D58 Val_Wu8 255.0 DFES_OneToOne 0.00 255.0 FORMAT "%5.1" /end CHARACTERISTIC
/begin CHARACTERISTIC DFES_DbLv.DFC_MeUnOL_C "/" VALUE 0x80073D59 Val_Wu8 255.0 DFES_OneToOne 0.00 255.0 FORMAT "%5.1" /end CHARACTERISTIC
/begin CHARACTERISTIC DFES_DbLv.DFC_MeUnSCB_C "/" VALUE 0x80073D5A Val_Wu8 255.0 DFES_OneToOne 0.00 255.0 FORMAT "%5.1" /end CHARACTERISTIC
/begin CHARACTERISTIC DFES_DbLv.DFC_MeUnSRCMax_C "/" VALUE 0x80073D5B Val_Wu8 255.0 DFES_OneToOne 0.00 255.0 FORMAT "%5.1" /end CHARACTERISTIC
/begin CHARACTERISTIC DFES_DbLv.DFC_MeUnSRCMin_C "/" VALUE 0x80073D5C Val_Wu8 255.0 DFES_OneToOne 0.00 255.0 FORMAT "%5.1" /end CHARACTERISTIC
/begin CHARACTERISTIC DFES_DbLv.DFC_PCVOL_C "/" VALUE 0x80073D5D Val_Wu8 255.0 DFES_OneToOne 0.00 255.0 FORMAT "%5.1" /end CHARACTERISTIC
/begin CHARACTERISTIC DFES_DbLv.DFC_PCVSCB_C "/" VALUE 0x80073D5E Val_Wu8 255.0 DFES_OneToOne 0.00 255.0 FORMAT "%5.1" /end CHARACTERISTIC
/begin CHARACTERISTIC DFES_DbLv.DFC_PCVSRCMax_C "/" VALUE 0x80073D5F Val_Wu8 255.0 DFES_OneToOne 0.00 255.0 FORMAT "%5.1" /end CHARACTERISTIC
/begin CHARACTERISTIC DFES_DbLv.DFC_PCVSRCMin_C "/" VALUE 0x80073D60 Val_Wu8 255.0 DFES_OneToOne 0.00 255.0 FORMAT "%5.1" /end CHARACTERISTIC
/begin CHARACTERISTIC DFES_DbLv.DFC_RailPSRCMax_C "/" VALUE 0x80073D61 Val_Wu8 255.0 DFES_OneToOne 0.00 255.0 FORMAT "%5.1" /end CHARACTERISTIC
/begin CHARACTERISTIC DFES_DbLv.DFC_RailPSRCMin_C "/" VALUE 0x80073D62 Val_Wu8 255.0 DFES_OneToOne 0.00 255.0 FORMAT "%5.1" /end CHARACTERISTIC
/begin CHARACTERISTIC DFES_DbLv.DFC_IVActrVltgSRCMax_C "/" VALUE 0x80073D63 Val_Wu8 255.0 DFES_OneToOne 0.00 255.0 FORMAT "%5.1" /end CHARACTERISTIC
/begin CHARACTERISTIC DFES_DbLv.DFC_IVActrVltgSRCMin_C "/" VALUE 0x80073D64 Val_Wu8 255.0 DFES_OneToOne 0.00 255.0 FORMAT "%5.1" /end CHARACTERISTIC
/begin CHARACTERISTIC DFES_DbLv.DFC_IVPSplyDCDC_C "/" VALUE 0x80073D65 Val_Wu8 255.0 DFES_OneToOne 0.00 255.0 FORMAT "%5.1" /end CHARACTERISTIC
/begin CHARACTERISTIC DFES_DbLv.DFC_IVPSplyVltgSRCMax_C "/" VALUE 0x80073D66 Val_Wu8 255.0 DFES_OneToOne 0.00 255.0 FORMAT "%5.1" /end CHARACTERISTIC
/begin CHARACTERISTIC DFES_DbLv.DFC_IVPSplyVltgSRCMin_C "/" VALUE 0x80073D67 Val_Wu8 255.0 DFES_OneToOne 0.00 255.0 FORMAT "%5.1" /end CHARACTERISTIC
/begin CHARACTERISTIC DFES_DbLv.DFC_AFSOffsDrftMax_C "/" VALUE 0x80073D68 Val_Wu8 255.0 DFES_OneToOne 0.00 255.0 FORMAT "%5.1" /end CHARACTERISTIC
/begin CHARACTERISTIC DFES_DbLv.DFC_AFSOffsDrftMin_C "/" VALUE 0x80073D69 Val_Wu8 255.0 DFES_OneToOne 0.00 255.0 FORMAT "%5.1" /end CHARACTERISTIC
/begin CHARACTERISTIC DFES_DbLv.DFC_AFSSRCCorMax_C "/" VALUE 0x80073D6A Val_Wu8 255.0 DFES_OneToOne 0.00 255.0 FORMAT "%5.1" /end CHARACTERISTIC
/begin CHARACTERISTIC DFES_DbLv.DFC_AFSSRCCorMin_C "/" VALUE 0x80073D6B Val_Wu8 255.0 DFES_OneToOne 0.00 255.0 FORMAT "%5.1" /end CHARACTERISTIC
/begin CHARACTERISTIC DFES_DbLv.DFC_AFSSRCRawMax_C "/" VALUE 0x80073D6C Val_Wu8 255.0 DFES_OneToOne 0.00 255.0 FORMAT "%5.1" /end CHARACTERISTIC
/begin CHARACTERISTIC DFES_DbLv.DFC_AFSSRCRawMin_C "/" VALUE 0x80073D6D Val_Wu8 255.0 DFES_OneToOne 0.00 255.0 FORMAT "%5.1" /end CHARACTERISTIC
/begin CHARACTERISTIC DFES_DbLv.DFC_AFSSetyDrftMax_C "/" VALUE 0x80073D6E Val_Wu8 255.0 DFES_OneToOne 0.00 255.0 FORMAT "%5.1" /end CHARACTERISTIC
/begin CHARACTERISTIC DFES_DbLv.DFC_AFSSetyDrftMin_C "/" VALUE 0x80073D6F Val_Wu8 255.0 DFES_OneToOne 0.00 255.0 FORMAT "%5.1" /end CHARACTERISTIC
/begin CHARACTERISTIC DFES_DbLv.DFC_AirCClntPAnaSRCMax_C "/" VALUE 0x80073D70 Val_Wu8 255.0 DFES_OneToOne 0.00 255.0 FORMAT "%5.1" /end CHARACTERISTIC
/begin CHARACTERISTIC DFES_DbLv.DFC_AirCClntPAnaSRCMin_C "/" VALUE 0x80073D71 Val_Wu8 255.0 DFES_OneToOne 0.00 255.0 FORMAT "%5.1" /end CHARACTERISTIC
/begin CHARACTERISTIC DFES_DbLv.DFC_AirCClntPPerSRCMax_C "/" VALUE 0x80073D72 Val_Wu8 255.0 DFES_OneToOne 0.00 255.0 FORMAT "%5.1" /end CHARACTERISTIC
/begin CHARACTERISTIC DFES_DbLv.DFC_AirCClntPPerSRCMin_C "/" VALUE 0x80073D73 Val_Wu8 255.0 DFES_OneToOne 0.00 255.0 FORMAT "%5.1" /end CHARACTERISTIC
/begin CHARACTERISTIC DFES_DbLv.DFC_AirCClntPdcycSRCMax_C "/" VALUE 0x80073D74 Val_Wu8 255.0 DFES_OneToOne 0.00 255.0 FORMAT "%5.1" /end CHARACTERISTIC
/begin CHARACTERISTIC DFES_DbLv.DFC_AirCClntPdcycSRCMin_C "/" VALUE 0x80073D75 Val_Wu8 255.0 DFES_OneToOne 0.00 255.0 FORMAT "%5.1" /end CHARACTERISTIC
/begin CHARACTERISTIC DFES_DbLv.DFC_AirCCmprOL_C "/" VALUE 0x80073D76 Val_Wu8 255.0 DFES_OneToOne 0.00 255.0 FORMAT "%5.1" /end CHARACTERISTIC
/begin CHARACTERISTIC DFES_DbLv.DFC_AirCCmprRedTrqOL_C "/" VALUE 0x80073D77 Val_Wu8 255.0 DFES_OneToOne 0.00 255.0 FORMAT "%5.1" /end CHARACTERISTIC
/begin CHARACTERISTIC DFES_DbLv.DFC_AirCCmprRedTrqSCB_C "/" VALUE 0x80073D78 Val_Wu8 255.0 DFES_OneToOne 0.00 255.0 FORMAT "%5.1" /end CHARACTERISTIC
/begin CHARACTERISTIC DFES_DbLv.DFC_AirCCmprRedTrqSCG_C "/" VALUE 0x80073D79 Val_Wu8 255.0 DFES_OneToOne 0.00 255.0 FORMAT "%5.1" /end CHARACTERISTIC
/begin CHARACTERISTIC DFES_DbLv.DFC_AirCCmprSCB_C "/" VALUE 0x80073D7A Val_Wu8 255.0 DFES_OneToOne 0.00 255.0 FORMAT "%5.1" /end CHARACTERISTIC
/begin CHARACTERISTIC DFES_DbLv.DFC_AirCCmprSCG_C "/" VALUE 0x80073D7B Val_Wu8 255.0 DFES_OneToOne 0.00 255.0 FORMAT "%5.1" /end CHARACTERISTIC
/begin CHARACTERISTIC DFES_DbLv.DFC_AirCSwtNpl_C "/" VALUE 0x80073D7C Val_Wu8 255.0 DFES_OneToOne 0.00 255.0 FORMAT "%5.1" /end CHARACTERISTIC
/begin CHARACTERISTIC DFES_DbLv.DFC_AirCSwtSig_C "/" VALUE 0x80073D7D Val_Wu8 255.0 DFES_OneToOne 0.00 255.0 FORMAT "%5.1" /end CHARACTERISTIC
/begin CHARACTERISTIC DFES_DbLv.DFC_BattUSRCMax_C "/" VALUE 0x80073D7E Val_Wu8 255.0 DFES_OneToOne 0.00 255.0 FORMAT "%5.1" /end CHARACTERISTIC
/begin CHARACTERISTIC DFES_DbLv.DFC_BattUSRCMin_C "/" VALUE 0x80073D7F Val_Wu8 255.0 DFES_OneToOne 0.00 255.0 FORMAT "%5.1" /end CHARACTERISTIC
/begin CHARACTERISTIC DFES_DbLv.DFC_BrkNpl_C "/" VALUE 0x80073D80 Val_Wu8 255.0 DFES_OneToOne 0.00 255.0 FORMAT "%5.1" /end CHARACTERISTIC
/begin CHARACTERISTIC DFES_DbLv.DFC_BrkPSRCMax_C "/" VALUE 0x80073D81 Val_Wu8 255.0 DFES_OneToOne 0.00 255.0 FORMAT "%5.1" /end CHARACTERISTIC
/begin CHARACTERISTIC DFES_DbLv.DFC_BrkPSRCMin_C "/" VALUE 0x80073D82 Val_Wu8 255.0 DFES_OneToOne 0.00 255.0 FORMAT "%5.1" /end CHARACTERISTIC
/begin CHARACTERISTIC DFES_DbLv.DFC_BrkSig_C "/" VALUE 0x80073D83 Val_Wu8 255.0 DFES_OneToOne 0.00 255.0 FORMAT "%5.1" /end CHARACTERISTIC
/begin CHARACTERISTIC DFES_DbLv.DFC_CByVlvOL_C "/" VALUE 0x80073D84 Val_Wu8 255.0 DFES_OneToOne 0.00 255.0 FORMAT "%5.1" /end CHARACTERISTIC
/begin CHARACTERISTIC DFES_DbLv.DFC_CByVlvSCB_C "/" VALUE 0x80073D85 Val_Wu8 255.0 DFES_OneToOne 0.00 255.0 FORMAT "%5.1" /end CHARACTERISTIC
/begin CHARACTERISTIC DFES_DbLv.DFC_CByVlvSCG_C "/" VALUE 0x80073D86 Val_Wu8 255.0 DFES_OneToOne 0.00 255.0 FORMAT "%5.1" /end CHARACTERISTIC
/begin CHARACTERISTIC DFES_DbLv.DFC_CEngDsTSRCMax_C "/" VALUE 0x80073D87 Val_Wu8 255.0 DFES_OneToOne 0.00 255.0 FORMAT "%5.1" /end CHARACTERISTIC
/begin CHARACTERISTIC DFES_DbLv.DFC_CEngDsTSRCMin_C "/" VALUE 0x80073D88 Val_Wu8 255.0 DFES_OneToOne 0.00 255.0 FORMAT "%5.1" /end CHARACTERISTIC
/begin CHARACTERISTIC DFES_DbLv.DFC_CEngDsTSig_C "/" VALUE 0x80073D89 Val_Wu8 255.0 DFES_OneToOne 0.00 255.0 FORMAT "%5.1" /end CHARACTERISTIC
/begin CHARACTERISTIC DFES_DbLv.DFC_CEngUsTSRCMax_C "/" VALUE 0x80073D8A Val_Wu8 255.0 DFES_OneToOne 0.00 255.0 FORMAT "%5.1" /end CHARACTERISTIC
/begin CHARACTERISTIC DFES_DbLv.DFC_CEngUsTSRCMin_C "/" VALUE 0x80073D8B Val_Wu8 255.0 DFES_OneToOne 0.00 255.0 FORMAT "%5.1" /end CHARACTERISTIC
/begin CHARACTERISTIC DFES_DbLv.DFC_CThmstOL_C "/" VALUE 0x80073D8C Val_Wu8 255.0 DFES_OneToOne 0.00 255.0 FORMAT "%5.1" /end CHARACTERISTIC
/begin CHARACTERISTIC DFES_DbLv.DFC_CThmstSCB_C "/" VALUE 0x80073D8D Val_Wu8 255.0 DFES_OneToOne 0.00 255.0 FORMAT "%5.1" /end CHARACTERISTIC
/begin CHARACTERISTIC DFES_DbLv.DFC_CThmstSCG_C "/" VALUE 0x80073D8E Val_Wu8 255.0 DFES_OneToOne 0.00 255.0 FORMAT "%5.1" /end CHARACTERISTIC
/begin CHARACTERISTIC DFES_DbLv.DFC_ClthSig_C "/" VALUE 0x80073D8F Val_Wu8 255.0 DFES_OneToOne 0.00 255.0 FORMAT "%5.1" /end CHARACTERISTIC
/begin CHARACTERISTIC DFES_DbLv.DFC_ECBVlvOL_C "/" VALUE 0x80073D90 Val_Wu8 255.0 DFES_OneToOne 0.00 255.0 FORMAT "%5.1" /end CHARACTERISTIC
/begin CHARACTERISTIC DFES_DbLv.DFC_ECBVlvSCB_C "/" VALUE 0x80073D91 Val_Wu8 255.0 DFES_OneToOne 0.00 255.0 FORMAT "%5.1" /end CHARACTERISTIC
/begin CHARACTERISTIC DFES_DbLv.DFC_ECBVlvSCG_C "/" VALUE 0x80073D92 Val_Wu8 255.0 DFES_OneToOne 0.00 255.0 FORMAT "%5.1" /end CHARACTERISTIC
/begin CHARACTERISTIC DFES_DbLv.DFC_ECBVlvSRCMax_C "/" VALUE 0x80073D93 Val_Wu8 255.0 DFES_OneToOne 0.00 255.0 FORMAT "%5.1" /end CHARACTERISTIC
/begin CHARACTERISTIC DFES_DbLv.DFC_ECBVlvSRCMin_C "/" VALUE 0x80073D94 Val_Wu8 255.0 DFES_OneToOne 0.00 255.0 FORMAT "%5.1" /end CHARACTERISTIC
/begin CHARACTERISTIC DFES_DbLv.DFC_EGRVlvGovDvtMax_C "/" VALUE 0x80073D95 Val_Wu8 255.0 DFES_OneToOne 0.00 255.0 FORMAT "%5.1" /end CHARACTERISTIC
/begin CHARACTERISTIC DFES_DbLv.DFC_EGRVlvGovDvtMin_C "/" VALUE 0x80073D96 Val_Wu8 255.0 DFES_OneToOne 0.00 255.0 FORMAT "%5.1" /end CHARACTERISTIC
/begin CHARACTERISTIC DFES_DbLv.DFC_EGRVlvOL_C "/" VALUE 0x80073D97 Val_Wu8 255.0 DFES_OneToOne 0.00 255.0 FORMAT "%5.1" /end CHARACTERISTIC
/begin CHARACTERISTIC DFES_DbLv.DFC_EGRVlvSCB_C "/" VALUE 0x80073D98 Val_Wu8 255.0 DFES_OneToOne 0.00 255.0 FORMAT "%5.1" /end CHARACTERISTIC
/begin CHARACTERISTIC DFES_DbLv.DFC_EGRVlvSCG_C "/" VALUE 0x80073D99 Val_Wu8 255.0 DFES_OneToOne 0.00 255.0 FORMAT "%5.1" /end CHARACTERISTIC
/begin CHARACTERISTIC DFES_DbLv.DFC_EGRVlvSRCMax_C "/" VALUE 0x80073D9A Val_Wu8 255.0 DFES_OneToOne 0.00 255.0 FORMAT "%5.1" /end CHARACTERISTIC
/begin CHARACTERISTIC DFES_DbLv.DFC_EGRVlvSRCMin_C "/" VALUE 0x80073D9B Val_Wu8 255.0 DFES_OneToOne 0.00 255.0 FORMAT "%5.1" /end CHARACTERISTIC
/begin CHARACTERISTIC DFES_DbLv.DFC_EMDmpOL_0_C "/" VALUE 0x80073D9C Val_Wu8 255.0 DFES_OneToOne 0.00 255.0 FORMAT "%5.1" /end CHARACTERISTIC
/begin CHARACTERISTIC DFES_DbLv.DFC_EMDmpOL_1_C "/" VALUE 0x80073D9D Val_Wu8 255.0 DFES_OneToOne 0.00 255.0 FORMAT "%5.1" /end CHARACTERISTIC
/begin CHARACTERISTIC DFES_DbLv.DFC_EMDmpSCB_0_C "/" VALUE 0x80073D9E Val_Wu8 255.0 DFES_OneToOne 0.00 255.0 FORMAT "%5.1" /end CHARACTERISTIC
/begin CHARACTERISTIC DFES_DbLv.DFC_EMDmpSCB_1_C "/" VALUE 0x80073D9F Val_Wu8 255.0 DFES_OneToOne 0.00 255.0 FORMAT "%5.1" /end CHARACTERISTIC
/begin CHARACTERISTIC DFES_DbLv.DFC_EMDmpSCG_0_C "/" VALUE 0x80073DA0 Val_Wu8 255.0 DFES_OneToOne 0.00 255.0 FORMAT "%5.1" /end CHARACTERISTIC
/begin CHARACTERISTIC DFES_DbLv.DFC_EMDmpSCG_1_C "/" VALUE 0x80073DA1 Val_Wu8 255.0 DFES_OneToOne 0.00 255.0 FORMAT "%5.1" /end CHARACTERISTIC
/begin CHARACTERISTIC DFES_DbLv.DFC_EngStAOL_C "/" VALUE 0x80073DA2 Val_Wu8 255.0 DFES_OneToOne 0.00 255.0 FORMAT "%5.1" /end CHARACTERISTIC
/begin CHARACTERISTIC DFES_DbLv.DFC_EngStASCB_C "/" VALUE 0x80073DA3 Val_Wu8 255.0 DFES_OneToOne 0.00 255.0 FORMAT "%5.1" /end CHARACTERISTIC
/begin CHARACTERISTIC DFES_DbLv.DFC_EngStASCG_C "/" VALUE 0x80073DA4 Val_Wu8 255.0 DFES_OneToOne 0.00 255.0 FORMAT "%5.1" /end CHARACTERISTIC
/begin CHARACTERISTIC DFES_DbLv.DFC_EnvPSRCMax_C "/" VALUE 0x80073DA5 Val_Wu8 255.0 DFES_OneToOne 0.00 255.0 FORMAT "%5.1" /end CHARACTERISTIC
/begin CHARACTERISTIC DFES_DbLv.DFC_EnvPSRCMin_C "/" VALUE 0x80073DA6 Val_Wu8 255.0 DFES_OneToOne 0.00 255.0 FORMAT "%5.1" /end CHARACTERISTIC
/begin CHARACTERISTIC DFES_DbLv.DFC_EnvPSig_C "/" VALUE 0x80073DA7 Val_Wu8 255.0 DFES_OneToOne 0.00 255.0 FORMAT "%5.1" /end CHARACTERISTIC
/begin CHARACTERISTIC DFES_DbLv.DFC_EnvTSRCMax_C "/" VALUE 0x80073DA8 Val_Wu8 255.0 DFES_OneToOne 0.00 255.0 FORMAT "%5.1" /end CHARACTERISTIC
/begin CHARACTERISTIC DFES_DbLv.DFC_EnvTSRCMin_C "/" VALUE 0x80073DA9 Val_Wu8 255.0 DFES_OneToOne 0.00 255.0 FORMAT "%5.1" /end CHARACTERISTIC
/begin CHARACTERISTIC DFES_DbLv.DFC_FanOL_C "/" VALUE 0x80073DAA Val_Wu8 255.0 DFES_OneToOne 0.00 255.0 FORMAT "%5.1" /end CHARACTERISTIC
/begin CHARACTERISTIC DFES_DbLv.DFC_FanSCB_C "/" VALUE 0x80073DAB Val_Wu8 255.0 DFES_OneToOne 0.00 255.0 FORMAT "%5.1" /end CHARACTERISTIC
/begin CHARACTERISTIC DFES_DbLv.DFC_FlFltSig_C "/" VALUE 0x80073DAC Val_Wu8 255.0 DFES_OneToOne 0.00 255.0 FORMAT "%5.1" /end CHARACTERISTIC
/begin CHARACTERISTIC DFES_DbLv.DFC_FuelTSRCMax_C "/" VALUE 0x80073DAD Val_Wu8 255.0 DFES_OneToOne 0.00 255.0 FORMAT "%5.1" /end CHARACTERISTIC
/begin CHARACTERISTIC DFES_DbLv.DFC_FuelTSRCMin_C "/" VALUE 0x80073DAE Val_Wu8 255.0 DFES_OneToOne 0.00 255.0 FORMAT "%5.1" /end CHARACTERISTIC
/begin CHARACTERISTIC DFES_DbLv.DFC_GbxNPosPPerSRCMax_C "/" VALUE 0x80073DAF Val_Wu8 255.0 DFES_OneToOne 0.00 255.0 FORMAT "%5.1" /end CHARACTERISTIC
/begin CHARACTERISTIC DFES_DbLv.DFC_GbxNPosPPerSRCMin_C "/" VALUE 0x80073DB0 Val_Wu8 255.0 DFES_OneToOne 0.00 255.0 FORMAT "%5.1" /end CHARACTERISTIC
/begin CHARACTERISTIC DFES_DbLv.DFC_GbxNPosPdcycSRCMax_C "/" VALUE 0x80073DB1 Val_Wu8 255.0 DFES_OneToOne 0.00 255.0 FORMAT "%5.1" /end CHARACTERISTIC
/begin CHARACTERISTIC DFES_DbLv.DFC_GbxNPosPdcycSRCMin_C "/" VALUE 0x80073DB2 Val_Wu8 255.0 DFES_OneToOne 0.00 255.0 FORMAT "%5.1" /end CHARACTERISTIC
/begin CHARACTERISTIC DFES_DbLv.DFC_GbxNPosSig_C "/" VALUE 0x80073DB3 Val_Wu8 255.0 DFES_OneToOne 0.00 255.0 FORMAT "%5.1" /end CHARACTERISTIC
/begin CHARACTERISTIC DFES_DbLv.DFC_GlwPlgBSDOL_0_C "/" VALUE 0x80073DB4 Val_Wu8 255.0 DFES_OneToOne 0.00 255.0 FORMAT "%5.1" /end CHARACTERISTIC
/begin CHARACTERISTIC DFES_DbLv.DFC_GlwPlgBSDOL_1_C "/" VALUE 0x80073DB5 Val_Wu8 255.0 DFES_OneToOne 0.00 255.0 FORMAT "%5.1" /end CHARACTERISTIC
/begin CHARACTERISTIC DFES_DbLv.DFC_GlwPlgBSDOL_2_C "/" VALUE 0x80073DB6 Val_Wu8 255.0 DFES_OneToOne 0.00 255.0 FORMAT "%5.1" /end CHARACTERISTIC
/begin CHARACTERISTIC DFES_DbLv.DFC_GlwPlgBSDOL_3_C "/" VALUE 0x80073DB7 Val_Wu8 255.0 DFES_OneToOne 0.00 255.0 FORMAT "%5.1" /end CHARACTERISTIC
/begin CHARACTERISTIC DFES_DbLv.DFC_GlwPlgBSDOL_4_C "/" VALUE 0x80073DB8 Val_Wu8 255.0 DFES_OneToOne 0.00 255.0 FORMAT "%5.1" /end CHARACTERISTIC
/begin CHARACTERISTIC DFES_DbLv.DFC_GlwPlgBSDOL_5_C "/" VALUE 0x80073DB9 Val_Wu8 255.0 DFES_OneToOne 0.00 255.0 FORMAT "%5.1" /end CHARACTERISTIC
/begin CHARACTERISTIC DFES_DbLv.DFC_GlwPlgBSDOL_6_C "/" VALUE 0x80073DBA Val_Wu8 255.0 DFES_OneToOne 0.00 255.0 FORMAT "%5.1" /end CHARACTERISTIC
/begin CHARACTERISTIC DFES_DbLv.DFC_GlwPlgBSDOL_7_C "/" VALUE 0x80073DBB Val_Wu8 255.0 DFES_OneToOne 0.00 255.0 FORMAT "%5.1" /end CHARACTERISTIC
/begin CHARACTERISTIC DFES_DbLv.DFC_GlwPlgBSDOT_0_C "/" VALUE 0x80073DBC Val_Wu8 255.0 DFES_OneToOne 0.00 255.0 FORMAT "%5.1" /end CHARACTERISTIC
/begin CHARACTERISTIC DFES_DbLv.DFC_GlwPlgBSDOT_1_C "/" VALUE 0x80073DBD Val_Wu8 255.0 DFES_OneToOne 0.00 255.0 FORMAT "%5.1" /end CHARACTERISTIC
/begin CHARACTERISTIC DFES_DbLv.DFC_GlwPlgBSDOT_2_C "/" VALUE 0x80073DBE Val_Wu8 255.0 DFES_OneToOne 0.00 255.0 FORMAT "%5.1" /end CHARACTERISTIC
/begin CHARACTERISTIC DFES_DbLv.DFC_GlwPlgBSDOT_3_C "/" VALUE 0x80073DBF Val_Wu8 255.0 DFES_OneToOne 0.00 255.0 FORMAT "%5.1" /end CHARACTERISTIC
/begin CHARACTERISTIC DFES_DbLv.DFC_GlwPlgBSDOT_4_C "/" VALUE 0x80073DC0 Val_Wu8 255.0 DFES_OneToOne 0.00 255.0 FORMAT "%5.1" /end CHARACTERISTIC
/begin CHARACTERISTIC DFES_DbLv.DFC_GlwPlgBSDOT_5_C "/" VALUE 0x80073DC1 Val_Wu8 255.0 DFES_OneToOne 0.00 255.0 FORMAT "%5.1" /end CHARACTERISTIC
/begin CHARACTERISTIC DFES_DbLv.DFC_GlwPlgBSDOT_6_C "/" VALUE 0x80073DC2 Val_Wu8 255.0 DFES_OneToOne 0.00 255.0 FORMAT "%5.1" /end CHARACTERISTIC
/begin CHARACTERISTIC DFES_DbLv.DFC_GlwPlgBSDOT_7_C "/" VALUE 0x80073DC3 Val_Wu8 255.0 DFES_OneToOne 0.00 255.0 FORMAT "%5.1" /end CHARACTERISTIC
/begin CHARACTERISTIC DFES_DbLv.DFC_GlwPlgBSDSC_0_C "/" VALUE 0x80073DC4 Val_Wu8 255.0 DFES_OneToOne 0.00 255.0 FORMAT "%5.1" /end CHARACTERISTIC
/begin CHARACTERISTIC DFES_DbLv.DFC_GlwPlgBSDSC_1_C "/" VALUE 0x80073DC5 Val_Wu8 255.0 DFES_OneToOne 0.00 255.0 FORMAT "%5.1" /end CHARACTERISTIC
/begin CHARACTERISTIC DFES_DbLv.DFC_GlwPlgBSDSC_2_C "/" VALUE 0x80073DC6 Val_Wu8 255.0 DFES_OneToOne 0.00 255.0 FORMAT "%5.1" /end CHARACTERISTIC
/begin CHARACTERISTIC DFES_DbLv.DFC_GlwPlgBSDSC_3_C "/" VALUE 0x80073DC7 Val_Wu8 255.0 DFES_OneToOne 0.00 255.0 FORMAT "%5.1" /end CHARACTERISTIC
/begin CHARACTERISTIC DFES_DbLv.DFC_GlwPlgBSDSC_4_C "/" VALUE 0x80073DC8 Val_Wu8 255.0 DFES_OneToOne 0.00 255.0 FORMAT "%5.1" /end CHARACTERISTIC
/begin CHARACTERISTIC DFES_DbLv.DFC_GlwPlgBSDSC_5_C "/" VALUE 0x80073DC9 Val_Wu8 255.0 DFES_OneToOne 0.00 255.0 FORMAT "%5.1" /end CHARACTERISTIC
/begin CHARACTERISTIC DFES_DbLv.DFC_GlwPlgBSDSC_6_C "/" VALUE 0x80073DCA Val_Wu8 255.0 DFES_OneToOne 0.00 255.0 FORMAT "%5.1" /end CHARACTERISTIC
/begin CHARACTERISTIC DFES_DbLv.DFC_GlwPlgBSDSC_7_C "/" VALUE 0x80073DCB Val_Wu8 255.0 DFES_OneToOne 0.00 255.0 FORMAT "%5.1" /end CHARACTERISTIC
/begin CHARACTERISTIC DFES_DbLv.DFC_GlwPlgComErr_C "/" VALUE 0x80073DCC Val_Wu8 255.0 DFES_OneToOne 0.00 255.0 FORMAT "%5.1" /end CHARACTERISTIC
/begin CHARACTERISTIC DFES_DbLv.DFC_InjVlvPresMin_C "/" VALUE 0x80073DCD Val_Wu8 255.0 DFES_OneToOne 0.00 255.0 FORMAT "%5.1" /end CHARACTERISTIC
/begin CHARACTERISTIC DFES_DbLv.DFC_LSUCircNernstMax_0_C "/" VALUE 0x80073DCE Val_Wu8 255.0 DFES_OneToOne 0.00 255.0 FORMAT "%5.1" /end CHARACTERISTIC
/begin CHARACTERISTIC DFES_DbLv.DFC_LSUCircNernstMax_1_C "/" VALUE 0x80073DCF Val_Wu8 255.0 DFES_OneToOne 0.00 255.0 FORMAT "%5.1" /end CHARACTERISTIC
/begin CHARACTERISTIC DFES_DbLv.DFC_LSUCircNernstMax_2_C "/" VALUE 0x80073DD0 Val_Wu8 255.0 DFES_OneToOne 0.00 255.0 FORMAT "%5.1" /end CHARACTERISTIC
/begin CHARACTERISTIC DFES_DbLv.DFC_LSUCircNernstMax_3_C "/" VALUE 0x80073DD1 Val_Wu8 255.0 DFES_OneToOne 0.00 255.0 FORMAT "%5.1" /end CHARACTERISTIC
/begin CHARACTERISTIC DFES_DbLv.DFC_LSUCircNernstMin_0_C "/" VALUE 0x80073DD2 Val_Wu8 255.0 DFES_OneToOne 0.00 255.0 FORMAT "%5.1" /end CHARACTERISTIC
/begin CHARACTERISTIC DFES_DbLv.DFC_LSUCircNernstMin_1_C "/" VALUE 0x80073DD3 Val_Wu8 255.0 DFES_OneToOne 0.00 255.0 FORMAT "%5.1" /end CHARACTERISTIC
/begin CHARACTERISTIC DFES_DbLv.DFC_LSUCircNernstMin_2_C "/" VALUE 0x80073DD4 Val_Wu8 255.0 DFES_OneToOne 0.00 255.0 FORMAT "%5.1" /end CHARACTERISTIC
/begin CHARACTERISTIC DFES_DbLv.DFC_LSUCircNernstMin_3_C "/" VALUE 0x80073DD5 Val_Wu8 255.0 DFES_OneToOne 0.00 255.0 FORMAT "%5.1" /end CHARACTERISTIC
/begin CHARACTERISTIC DFES_DbLv.DFC_LSUCircNernstSig_0_C "/" VALUE 0x80073DD6 Val_Wu8 255.0 DFES_OneToOne 0.00 255.0 FORMAT "%5.1" /end CHARACTERISTIC
/begin CHARACTERISTIC DFES_DbLv.DFC_LSUCircNernstSig_1_C "/" VALUE 0x80073DD7 Val_Wu8 255.0 DFES_OneToOne 0.00 255.0 FORMAT "%5.1" /end CHARACTERISTIC
/begin CHARACTERISTIC DFES_DbLv.DFC_LSUCircNernstSig_2_C "/" VALUE 0x80073DD8 Val_Wu8 255.0 DFES_OneToOne 0.00 255.0 FORMAT "%5.1" /end CHARACTERISTIC
/begin CHARACTERISTIC DFES_DbLv.DFC_LSUCircNernstSig_3_C "/" VALUE 0x80073DD9 Val_Wu8 255.0 DFES_OneToOne 0.00 255.0 FORMAT "%5.1" /end CHARACTERISTIC
/begin CHARACTERISTIC DFES_DbLv.DFC_LSUCircPmpCurMax_0_C "/" VALUE 0x80073DDA Val_Wu8 255.0 DFES_OneToOne 0.00 255.0 FORMAT "%5.1" /end CHARACTERISTIC
/begin CHARACTERISTIC DFES_DbLv.DFC_LSUCircPmpCurMax_1_C "/" VALUE 0x80073DDB Val_Wu8 255.0 DFES_OneToOne 0.00 255.0 FORMAT "%5.1" /end CHARACTERISTIC
/begin CHARACTERISTIC DFES_DbLv.DFC_LSUCircPmpCurMax_2_C "/" VALUE 0x80073DDC Val_Wu8 255.0 DFES_OneToOne 0.00 255.0 FORMAT "%5.1" /end CHARACTERISTIC
/begin CHARACTERISTIC DFES_DbLv.DFC_LSUCircPmpCurMax_3_C "/" VALUE 0x80073DDD Val_Wu8 255.0 DFES_OneToOne 0.00 255.0 FORMAT "%5.1" /end CHARACTERISTIC
/begin CHARACTERISTIC DFES_DbLv.DFC_LSUCircPmpCurMin_0_C "/" VALUE 0x80073DDE Val_Wu8 255.0 DFES_OneToOne 0.00 255.0 FORMAT "%5.1" /end CHARACTERISTIC
/begin CHARACTERISTIC DFES_DbLv.DFC_LSUCircPmpCurMin_1_C "/" VALUE 0x80073DDF Val_Wu8 255.0 DFES_OneToOne 0.00 255.0 FORMAT "%5.1" /end CHARACTERISTIC
/begin CHARACTERISTIC DFES_DbLv.DFC_LSUCircPmpCurMin_2_C "/" VALUE 0x80073DE0 Val_Wu8 255.0 DFES_OneToOne 0.00 255.0 FORMAT "%5.1" /end CHARACTERISTIC
/begin CHARACTERISTIC DFES_DbLv.DFC_LSUCircPmpCurMin_3_C "/" VALUE 0x80073DE1 Val_Wu8 255.0 DFES_OneToOne 0.00 255.0 FORMAT "%5.1" /end CHARACTERISTIC
/begin CHARACTERISTIC DFES_DbLv.DFC_LSUCircPmpCurSig_0_C "/" VALUE 0x80073DE2 Val_Wu8 255.0 DFES_OneToOne 0.00 255.0 FORMAT "%5.1" /end CHARACTERISTIC
/begin CHARACTERISTIC DFES_DbLv.DFC_LSUCircPmpCurSig_1_C "/" VALUE 0x80073DE3 Val_Wu8 255.0 DFES_OneToOne 0.00 255.0 FORMAT "%5.1" /end CHARACTERISTIC
/begin CHARACTERISTIC DFES_DbLv.DFC_LSUCircPmpCurSig_2_C "/" VALUE 0x80073DE4 Val_Wu8 255.0 DFES_OneToOne 0.00 255.0 FORMAT "%5.1" /end CHARACTERISTIC
/begin CHARACTERISTIC DFES_DbLv.DFC_LSUCircPmpCurSig_3_C "/" VALUE 0x80073DE5 Val_Wu8 255.0 DFES_OneToOne 0.00 255.0 FORMAT "%5.1" /end CHARACTERISTIC
/begin CHARACTERISTIC DFES_DbLv.DFC_LSUCircVirtGndMax_0_C "/" VALUE 0x80073DE6 Val_Wu8 255.0 DFES_OneToOne 0.00 255.0 FORMAT "%5.1" /end CHARACTERISTIC
/begin CHARACTERISTIC DFES_DbLv.DFC_LSUCircVirtGndMax_1_C "/" VALUE 0x80073DE7 Val_Wu8 255.0 DFES_OneToOne 0.00 255.0 FORMAT "%5.1" /end CHARACTERISTIC
/begin CHARACTERISTIC DFES_DbLv.DFC_LSUCircVirtGndMax_2_C "/" VALUE 0x80073DE8 Val_Wu8 255.0 DFES_OneToOne 0.00 255.0 FORMAT "%5.1" /end CHARACTERISTIC
/begin CHARACTERISTIC DFES_DbLv.DFC_LSUCircVirtGndMax_3_C "/" VALUE 0x80073DE9 Val_Wu8 255.0 DFES_OneToOne 0.00 255.0 FORMAT "%5.1" /end CHARACTERISTIC
/begin CHARACTERISTIC DFES_DbLv.DFC_LSUCircVirtGndMin_0_C "/" VALUE 0x80073DEA Val_Wu8 255.0 DFES_OneToOne 0.00 255.0 FORMAT "%5.1" /end CHARACTERISTIC
/begin CHARACTERISTIC DFES_DbLv.DFC_LSUCircVirtGndMin_1_C "/" VALUE 0x80073DEB Val_Wu8 255.0 DFES_OneToOne 0.00 255.0 FORMAT "%5.1" /end CHARACTERISTIC
/begin CHARACTERISTIC DFES_DbLv.DFC_LSUCircVirtGndMin_2_C "/" VALUE 0x80073DEC Val_Wu8 255.0 DFES_OneToOne 0.00 255.0 FORMAT "%5.1" /end CHARACTERISTIC
/begin CHARACTERISTIC DFES_DbLv.DFC_LSUCircVirtGndMin_3_C "/" VALUE 0x80073DED Val_Wu8 255.0 DFES_OneToOne 0.00 255.0 FORMAT "%5.1" /end CHARACTERISTIC
/begin CHARACTERISTIC DFES_DbLv.DFC_LSUCircVirtGndSig_0_C "/" VALUE 0x80073DEE Val_Wu8 255.0 DFES_OneToOne 0.00 255.0 FORMAT "%5.1" /end CHARACTERISTIC
/begin CHARACTERISTIC DFES_DbLv.DFC_LSUCircVirtGndSig_1_C "/" VALUE 0x80073DEF Val_Wu8 255.0 DFES_OneToOne 0.00 255.0 FORMAT "%5.1" /end CHARACTERISTIC
/begin CHARACTERISTIC DFES_DbLv.DFC_LSUCircVirtGndSig_2_C "/" VALUE 0x80073DF0 Val_Wu8 255.0 DFES_OneToOne 0.00 255.0 FORMAT "%5.1" /end CHARACTERISTIC
/begin CHARACTERISTIC DFES_DbLv.DFC_LSUCircVirtGndSig_3_C "/" VALUE 0x80073DF1 Val_Wu8 255.0 DFES_OneToOne 0.00 255.0 FORMAT "%5.1" /end CHARACTERISTIC
/begin CHARACTERISTIC DFES_DbLv.DFC_LSUHtrMax_0_C "/" VALUE 0x80073DF2 Val_Wu8 255.0 DFES_OneToOne 0.00 255.0 FORMAT "%5.1" /end CHARACTERISTIC
/begin CHARACTERISTIC DFES_DbLv.DFC_LSUHtrMax_1_C "/" VALUE 0x80073DF3 Val_Wu8 255.0 DFES_OneToOne 0.00 255.0 FORMAT "%5.1" /end CHARACTERISTIC
/begin CHARACTERISTIC DFES_DbLv.DFC_LSUHtrMax_2_C "/" VALUE 0x80073DF4 Val_Wu8 255.0 DFES_OneToOne 0.00 255.0 FORMAT "%5.1" /end CHARACTERISTIC
/begin CHARACTERISTIC DFES_DbLv.DFC_LSUHtrMax_3_C "/" VALUE 0x80073DF5 Val_Wu8 255.0 DFES_OneToOne 0.00 255.0 FORMAT "%5.1" /end CHARACTERISTIC
/begin CHARACTERISTIC DFES_DbLv.DFC_LSUHtrMin_0_C "/" VALUE 0x80073DF6 Val_Wu8 255.0 DFES_OneToOne 0.00 255.0 FORMAT "%5.1" /end CHARACTERISTIC
/begin CHARACTERISTIC DFES_DbLv.DFC_LSUHtrMin_1_C "/" VALUE 0x80073DF7 Val_Wu8 255.0 DFES_OneToOne 0.00 255.0 FORMAT "%5.1" /end CHARACTERISTIC
/begin CHARACTERISTIC DFES_DbLv.DFC_LSUHtrMin_2_C "/" VALUE 0x80073DF8 Val_Wu8 255.0 DFES_OneToOne 0.00 255.0 FORMAT "%5.1" /end CHARACTERISTIC
/begin CHARACTERISTIC DFES_DbLv.DFC_LSUHtrMin_3_C "/" VALUE 0x80073DF9 Val_Wu8 255.0 DFES_OneToOne 0.00 255.0 FORMAT "%5.1" /end CHARACTERISTIC
/begin CHARACTERISTIC DFES_DbLv.DFC_LSUHtrSig_0_C "/" VALUE 0x80073DFA Val_Wu8 255.0 DFES_OneToOne 0.00 255.0 FORMAT "%5.1" /end CHARACTERISTIC
/begin CHARACTERISTIC DFES_DbLv.DFC_LSUHtrSig_1_C "/" VALUE 0x80073DFB Val_Wu8 255.0 DFES_OneToOne 0.00 255.0 FORMAT "%5.1" /end CHARACTERISTIC
/begin CHARACTERISTIC DFES_DbLv.DFC_LSUHtrSig_2_C "/" VALUE 0x80073DFC Val_Wu8 255.0 DFES_OneToOne 0.00 255.0 FORMAT "%5.1" /end CHARACTERISTIC
/begin CHARACTERISTIC DFES_DbLv.DFC_LSUHtrSig_3_C "/" VALUE 0x80073DFD Val_Wu8 255.0 DFES_OneToOne 0.00 255.0 FORMAT "%5.1" /end CHARACTERISTIC
/begin CHARACTERISTIC DFES_DbLv.DFC_LSUO2Max_0_C "/" VALUE 0x80073DFE Val_Wu8 255.0 DFES_OneToOne 0.00 255.0 FORMAT "%5.1" /end CHARACTERISTIC
/begin CHARACTERISTIC DFES_DbLv.DFC_LSUO2Max_1_C "/" VALUE 0x80073DFF Val_Wu8 255.0 DFES_OneToOne 0.00 255.0 FORMAT "%5.1" /end CHARACTERISTIC
/begin CHARACTERISTIC DFES_DbLv.DFC_LSUO2Max_2_C "/" VALUE 0x80073E00 Val_Wu8 255.0 DFES_OneToOne 0.00 255.0 FORMAT "%5.1" /end CHARACTERISTIC
/begin CHARACTERISTIC DFES_DbLv.DFC_LSUO2Max_3_C "/" VALUE 0x80073E01 Val_Wu8 255.0 DFES_OneToOne 0.00 255.0 FORMAT "%5.1" /end CHARACTERISTIC
/begin CHARACTERISTIC DFES_DbLv.DFC_LSUO2Min_0_C "/" VALUE 0x80073E02 Val_Wu8 255.0 DFES_OneToOne 0.00 255.0 FORMAT "%5.1" /end CHARACTERISTIC
/begin CHARACTERISTIC DFES_DbLv.DFC_LSUO2Min_1_C "/" VALUE 0x80073E03 Val_Wu8 255.0 DFES_OneToOne 0.00 255.0 FORMAT "%5.1" /end CHARACTERISTIC
/begin CHARACTERISTIC DFES_DbLv.DFC_LSUO2Min_2_C "/" VALUE 0x80073E04 Val_Wu8 255.0 DFES_OneToOne 0.00 255.0 FORMAT "%5.1" /end CHARACTERISTIC
/begin CHARACTERISTIC DFES_DbLv.DFC_LSUO2Min_3_C "/" VALUE 0x80073E05 Val_Wu8 255.0 DFES_OneToOne 0.00 255.0 FORMAT "%5.1" /end CHARACTERISTIC
/begin CHARACTERISTIC DFES_DbLv.DFC_LSUSPIBattLowMin_0_C "/" VALUE 0x80073E06 Val_Wu8 255.0 DFES_OneToOne 0.00 255.0 FORMAT "%5.1" /end CHARACTERISTIC
/begin CHARACTERISTIC DFES_DbLv.DFC_LSUSPIBattLowMin_1_C "/" VALUE 0x80073E07 Val_Wu8 255.0 DFES_OneToOne 0.00 255.0 FORMAT "%5.1" /end CHARACTERISTIC
/begin CHARACTERISTIC DFES_DbLv.DFC_LSUSPIBattLowMin_2_C "/" VALUE 0x80073E08 Val_Wu8 255.0 DFES_OneToOne 0.00 255.0 FORMAT "%5.1" /end CHARACTERISTIC
/begin CHARACTERISTIC DFES_DbLv.DFC_LSUSPIBattLowMin_3_C "/" VALUE 0x80073E09 Val_Wu8 255.0 DFES_OneToOne 0.00 255.0 FORMAT "%5.1" /end CHARACTERISTIC
/begin CHARACTERISTIC DFES_DbLv.DFC_LSUSPISig_0_C "/" VALUE 0x80073E0A Val_Wu8 255.0 DFES_OneToOne 0.00 255.0 FORMAT "%5.1" /end CHARACTERISTIC
/begin CHARACTERISTIC DFES_DbLv.DFC_LSUSPISig_1_C "/" VALUE 0x80073E0B Val_Wu8 255.0 DFES_OneToOne 0.00 255.0 FORMAT "%5.1" /end CHARACTERISTIC
/begin CHARACTERISTIC DFES_DbLv.DFC_LSUSPISig_2_C "/" VALUE 0x80073E0C Val_Wu8 255.0 DFES_OneToOne 0.00 255.0 FORMAT "%5.1" /end CHARACTERISTIC
/begin CHARACTERISTIC DFES_DbLv.DFC_LSUSPISig_3_C "/" VALUE 0x80073E0D Val_Wu8 255.0 DFES_OneToOne 0.00 255.0 FORMAT "%5.1" /end CHARACTERISTIC
/begin CHARACTERISTIC DFES_DbLv.DFC_LSUtExcMax_0_C "/" VALUE 0x80073E0E Val_Wu8 255.0 DFES_OneToOne 0.00 255.0 FORMAT "%5.1" /end CHARACTERISTIC
/begin CHARACTERISTIC DFES_DbLv.DFC_LSUtExcMax_1_C "/" VALUE 0x80073E0F Val_Wu8 255.0 DFES_OneToOne 0.00 255.0 FORMAT "%5.1" /end CHARACTERISTIC
/begin CHARACTERISTIC DFES_DbLv.DFC_LSUtExcMax_2_C "/" VALUE 0x80073E10 Val_Wu8 255.0 DFES_OneToOne 0.00 255.0 FORMAT "%5.1" /end CHARACTERISTIC
/begin CHARACTERISTIC DFES_DbLv.DFC_LSUtExcMax_3_C "/" VALUE 0x80073E11 Val_Wu8 255.0 DFES_OneToOne 0.00 255.0 FORMAT "%5.1" /end CHARACTERISTIC
/begin CHARACTERISTIC DFES_DbLv.DFC_LSUtExcMin_0_C "/" VALUE 0x80073E12 Val_Wu8 255.0 DFES_OneToOne 0.00 255.0 FORMAT "%5.1" /end CHARACTERISTIC
/begin CHARACTERISTIC DFES_DbLv.DFC_LSUtExcMin_1_C "/" VALUE 0x80073E13 Val_Wu8 255.0 DFES_OneToOne 0.00 255.0 FORMAT "%5.1" /end CHARACTERISTIC
/begin CHARACTERISTIC DFES_DbLv.DFC_LSUtExcMin_2_C "/" VALUE 0x80073E14 Val_Wu8 255.0 DFES_OneToOne 0.00 255.0 FORMAT "%5.1" /end CHARACTERISTIC
/begin CHARACTERISTIC DFES_DbLv.DFC_LSUtExcMin_3_C "/" VALUE 0x80073E15 Val_Wu8 255.0 DFES_OneToOne 0.00 255.0 FORMAT "%5.1" /end CHARACTERISTIC
/begin CHARACTERISTIC DFES_DbLv.DFC_MILOL_C "/" VALUE 0x80073E16 Val_Wu8 255.0 DFES_OneToOne 0.00 255.0 FORMAT "%5.1" /end CHARACTERISTIC
/begin CHARACTERISTIC DFES_DbLv.DFC_MILSCB_C "/" VALUE 0x80073E17 Val_Wu8 255.0 DFES_OneToOne 0.00 255.0 FORMAT "%5.1" /end CHARACTERISTIC
/begin CHARACTERISTIC DFES_DbLv.DFC_MILSCG_C "/" VALUE 0x80073E18 Val_Wu8 255.0 DFES_OneToOne 0.00 255.0 FORMAT "%5.1" /end CHARACTERISTIC
/begin CHARACTERISTIC DFES_DbLv.DFC_MeUnSCG_C "/" VALUE 0x80073E19 Val_Wu8 255.0 DFES_OneToOne 0.00 255.0 FORMAT "%5.1" /end CHARACTERISTIC
/begin CHARACTERISTIC DFES_DbLv.DFC_NplHsChngPPFltDiff_C "/" VALUE 0x80073E1A Val_Wu8 255.0 DFES_OneToOne 0.00 255.0 FORMAT "%5.1" /end CHARACTERISTIC
/begin CHARACTERISTIC DFES_DbLv.DFC_NplPAirFltDs_C "/" VALUE 0x80073E1B Val_Wu8 255.0 DFES_OneToOne 0.00 255.0 FORMAT "%5.1" /end CHARACTERISTIC
/begin CHARACTERISTIC DFES_DbLv.DFC_NplTPFltUs_C "/" VALUE 0x80073E1C Val_Wu8 255.0 DFES_OneToOne 0.00 255.0 FORMAT "%5.1" /end CHARACTERISTIC
/begin CHARACTERISTIC DFES_DbLv.DFC_OilComErr_C "/" VALUE 0x80073E1D Val_Wu8 255.0 DFES_OneToOne 0.00 255.0 FORMAT "%5.1" /end CHARACTERISTIC
/begin CHARACTERISTIC DFES_DbLv.DFC_OilPLmpOL_C "/" VALUE 0x80073E1E Val_Wu8 255.0 DFES_OneToOne 0.00 255.0 FORMAT "%5.1" /end CHARACTERISTIC
/begin CHARACTERISTIC DFES_DbLv.DFC_OilPLmpSCB_C "/" VALUE 0x80073E1F Val_Wu8 255.0 DFES_OneToOne 0.00 255.0 FORMAT "%5.1" /end CHARACTERISTIC
/begin CHARACTERISTIC DFES_DbLv.DFC_OilPLmpSCG_C "/" VALUE 0x80073E20 Val_Wu8 255.0 DFES_OneToOne 0.00 255.0 FORMAT "%5.1" /end CHARACTERISTIC
/begin CHARACTERISTIC DFES_DbLv.DFC_OilPNpl_C "/" VALUE 0x80073E21 Val_Wu8 255.0 DFES_OneToOne 0.00 255.0 FORMAT "%5.1" /end CHARACTERISTIC
/begin CHARACTERISTIC DFES_DbLv.DFC_OilTNpl_C "/" VALUE 0x80073E22 Val_Wu8 255.0 DFES_OneToOne 0.00 255.0 FORMAT "%5.1" /end CHARACTERISTIC
/begin CHARACTERISTIC DFES_DbLv.DFC_OilTSRCMax_C "/" VALUE 0x80073E23 Val_Wu8 255.0 DFES_OneToOne 0.00 255.0 FORMAT "%5.1" /end CHARACTERISTIC
/begin CHARACTERISTIC DFES_DbLv.DFC_OilTSRCMin_C "/" VALUE 0x80073E24 Val_Wu8 255.0 DFES_OneToOne 0.00 255.0 FORMAT "%5.1" /end CHARACTERISTIC
/begin CHARACTERISTIC DFES_DbLv.DFC_PCACDsEnvPPls_C "/" VALUE 0x80073E25 Val_Wu8 255.0 DFES_OneToOne 0.00 255.0 FORMAT "%5.1" /end CHARACTERISTIC
/begin CHARACTERISTIC DFES_DbLv.DFC_PCACDsSRCMax_C "/" VALUE 0x80073E26 Val_Wu8 255.0 DFES_OneToOne 0.00 255.0 FORMAT "%5.1" /end CHARACTERISTIC
/begin CHARACTERISTIC DFES_DbLv.DFC_PCACDsSRCMin_C "/" VALUE 0x80073E27 Val_Wu8 255.0 DFES_OneToOne 0.00 255.0 FORMAT "%5.1" /end CHARACTERISTIC
/begin CHARACTERISTIC DFES_DbLv.DFC_PCVSCG_C "/" VALUE 0x80073E28 Val_Wu8 255.0 DFES_OneToOne 0.00 255.0 FORMAT "%5.1" /end CHARACTERISTIC
/begin CHARACTERISTIC DFES_DbLv.DFC_PFltCharPDiffMin_C "/" VALUE 0x80073E29 Val_Wu8 255.0 DFES_OneToOne 0.00 255.0 FORMAT "%5.1" /end CHARACTERISTIC
/begin CHARACTERISTIC DFES_DbLv.DFC_PFltDstrMin_C "/" VALUE 0x80073E2A Val_Wu8 255.0 DFES_OneToOne 0.00 255.0 FORMAT "%5.1" /end CHARACTERISTIC
/begin CHARACTERISTIC DFES_DbLv.DFC_PFltEngPrt_C "/" VALUE 0x80073E2B Val_Wu8 255.0 DFES_OneToOne 0.00 255.0 FORMAT "%5.1" /end CHARACTERISTIC
/begin CHARACTERISTIC DFES_DbLv.DFC_PFltLmpOL_C "/" VALUE 0x80073E2C Val_Wu8 255.0 DFES_OneToOne 0.00 255.0 FORMAT "%5.1" /end CHARACTERISTIC
/begin CHARACTERISTIC DFES_DbLv.DFC_PFltLmpSCB_C "/" VALUE 0x80073E2D Val_Wu8 255.0 DFES_OneToOne 0.00 255.0 FORMAT "%5.1" /end CHARACTERISTIC
/begin CHARACTERISTIC DFES_DbLv.DFC_PFltLmpSCG_C "/" VALUE 0x80073E2E Val_Wu8 255.0 DFES_OneToOne 0.00 255.0 FORMAT "%5.1" /end CHARACTERISTIC
/begin CHARACTERISTIC DFES_DbLv.DFC_PFltRgnPerm_C "/" VALUE 0x80073E2F Val_Wu8 255.0 DFES_OneToOne 0.00 255.0 FORMAT "%5.1" /end CHARACTERISTIC
/begin CHARACTERISTIC DFES_DbLv.DFC_PFltSRCMaxFlwRstn_C "/" VALUE 0x80073E30 Val_Wu8 255.0 DFES_OneToOne 0.00 255.0 FORMAT "%5.1" /end CHARACTERISTIC
/begin CHARACTERISTIC DFES_DbLv.DFC_PFltSRCMinFlwRstn_C "/" VALUE 0x80073E31 Val_Wu8 255.0 DFES_OneToOne 0.00 255.0 FORMAT "%5.1" /end CHARACTERISTIC
/begin CHARACTERISTIC DFES_DbLv.DFC_PFltSotMsDvtMax_C "/" VALUE 0x80073E32 Val_Wu8 255.0 DFES_OneToOne 0.00 255.0 FORMAT "%5.1" /end CHARACTERISTIC
/begin CHARACTERISTIC DFES_DbLv.DFC_PFltSotMsDvtMin_C "/" VALUE 0x80073E33 Val_Wu8 255.0 DFES_OneToOne 0.00 255.0 FORMAT "%5.1" /end CHARACTERISTIC
/begin CHARACTERISTIC DFES_DbLv.DFC_PFltSotMsMax_C "/" VALUE 0x80073E34 Val_Wu8 255.0 DFES_OneToOne 0.00 255.0 FORMAT "%5.1" /end CHARACTERISTIC
/begin CHARACTERISTIC DFES_DbLv.DFC_PSPOL_C "/" VALUE 0x80073E35 Val_Wu8 255.0 DFES_OneToOne 0.00 255.0 FORMAT "%5.1" /end CHARACTERISTIC
/begin CHARACTERISTIC DFES_DbLv.DFC_PSPSCB_C "/" VALUE 0x80073E36 Val_Wu8 255.0 DFES_OneToOne 0.00 255.0 FORMAT "%5.1" /end CHARACTERISTIC
/begin CHARACTERISTIC DFES_DbLv.DFC_PSPSCG_C "/" VALUE 0x80073E37 Val_Wu8 255.0 DFES_OneToOne 0.00 255.0 FORMAT "%5.1" /end CHARACTERISTIC
/begin CHARACTERISTIC DFES_DbLv.DFC_SRCHighAPP1_C "/" VALUE 0x80073E38 Val_Wu8 255.0 DFES_OneToOne 0.00 255.0 FORMAT "%5.1" /end CHARACTERISTIC
/begin CHARACTERISTIC DFES_DbLv.DFC_SRCHighAPP2_C "/" VALUE 0x80073E39 Val_Wu8 255.0 DFES_OneToOne 0.00 255.0 FORMAT "%5.1" /end CHARACTERISTIC
/begin CHARACTERISTIC DFES_DbLv.DFC_SRCLowAPP1_C "/" VALUE 0x80073E3A Val_Wu8 255.0 DFES_OneToOne 0.00 255.0 FORMAT "%5.1" /end CHARACTERISTIC
/begin CHARACTERISTIC DFES_DbLv.DFC_SRCLowAPP2_C "/" VALUE 0x80073E3B Val_Wu8 255.0 DFES_OneToOne 0.00 255.0 FORMAT "%5.1" /end CHARACTERISTIC
/begin CHARACTERISTIC DFES_DbLv.DFC_SRCMaxPAirFltDs_C "/" VALUE 0x80073E3C Val_Wu8 255.0 DFES_OneToOne 0.00 255.0 FORMAT "%5.1" /end CHARACTERISTIC
/begin CHARACTERISTIC DFES_DbLv.DFC_SRCMaxPPFltUs_C "/" VALUE 0x80073E3D Val_Wu8 255.0 DFES_OneToOne 0.00 255.0 FORMAT "%5.1" /end CHARACTERISTIC
/begin CHARACTERISTIC DFES_DbLv.DFC_SRCMaxTECU_C "/" VALUE 0x80073E3E Val_Wu8 255.0 DFES_OneToOne 0.00 255.0 FORMAT "%5.1" /end CHARACTERISTIC
/begin CHARACTERISTIC DFES_DbLv.DFC_SRCMaxTOxiCatUs_C "/" VALUE 0x80073E3F Val_Wu8 255.0 DFES_OneToOne 0.00 255.0 FORMAT "%5.1" /end CHARACTERISTIC
/begin CHARACTERISTIC DFES_DbLv.DFC_SRCMaxTPFltUs_C "/" VALUE 0x80073E40 Val_Wu8 255.0 DFES_OneToOne 0.00 255.0 FORMAT "%5.1" /end CHARACTERISTIC
/begin CHARACTERISTIC DFES_DbLv.DFC_SRCMinPAirFltDs_C "/" VALUE 0x80073E41 Val_Wu8 255.0 DFES_OneToOne 0.00 255.0 FORMAT "%5.1" /end CHARACTERISTIC
/begin CHARACTERISTIC DFES_DbLv.DFC_SRCMinPPFltUs_C "/" VALUE 0x80073E42 Val_Wu8 255.0 DFES_OneToOne 0.00 255.0 FORMAT "%5.1" /end CHARACTERISTIC
/begin CHARACTERISTIC DFES_DbLv.DFC_SRCMinTECU_C "/" VALUE 0x80073E43 Val_Wu8 255.0 DFES_OneToOne 0.00 255.0 FORMAT "%5.1" /end CHARACTERISTIC
/begin CHARACTERISTIC DFES_DbLv.DFC_SRCMinTOxiCatUs_C "/" VALUE 0x80073E44 Val_Wu8 255.0 DFES_OneToOne 0.00 255.0 FORMAT "%5.1" /end CHARACTERISTIC
/begin CHARACTERISTIC DFES_DbLv.DFC_SRCMinTPFltUs_C "/" VALUE 0x80073E45 Val_Wu8 255.0 DFES_OneToOne 0.00 255.0 FORMAT "%5.1" /end CHARACTERISTIC
/begin CHARACTERISTIC DFES_DbLv.DFC_SVSOL_C "/" VALUE 0x80073E46 Val_Wu8 255.0 DFES_OneToOne 0.00 255.0 FORMAT "%5.1" /end CHARACTERISTIC
/begin CHARACTERISTIC DFES_DbLv.DFC_SVSSCB_C "/" VALUE 0x80073E47 Val_Wu8 255.0 DFES_OneToOne 0.00 255.0 FORMAT "%5.1" /end CHARACTERISTIC
/begin CHARACTERISTIC DFES_DbLv.DFC_SVSSCG_C "/" VALUE 0x80073E48 Val_Wu8 255.0 DFES_OneToOne 0.00 255.0 FORMAT "%5.1" /end CHARACTERISTIC
/begin CHARACTERISTIC DFES_DbLv.DFC_StrtOL_C "/" VALUE 0x80073E49 Val_Wu8 255.0 DFES_OneToOne 0.00 255.0 FORMAT "%5.1" /end CHARACTERISTIC
/begin CHARACTERISTIC DFES_DbLv.DFC_StrtSCB_C "/" VALUE 0x80073E4A Val_Wu8 255.0 DFES_OneToOne 0.00 255.0 FORMAT "%5.1" /end CHARACTERISTIC
/begin CHARACTERISTIC DFES_DbLv.DFC_StrtSCG_C "/" VALUE 0x80073E4B Val_Wu8 255.0 DFES_OneToOne 0.00 255.0 FORMAT "%5.1" /end CHARACTERISTIC
/begin CHARACTERISTIC DFES_DbLv.DFC_SyncAPP_C "/" VALUE 0x80073E4C Val_Wu8 255.0 DFES_OneToOne 0.00 255.0 FORMAT "%5.1" /end CHARACTERISTIC
/begin CHARACTERISTIC DFES_DbLv.DFC_T15Npl_C "/" VALUE 0x80073E4D Val_Wu8 255.0 DFES_OneToOne 0.00 255.0 FORMAT "%5.1" /end CHARACTERISTIC
/begin CHARACTERISTIC DFES_DbLv.DFC_TAFSDtyCycHi_C "/" VALUE 0x80073E4E Val_Wu8 255.0 DFES_OneToOne 0.00 255.0 FORMAT "%5.1" /end CHARACTERISTIC
/begin CHARACTERISTIC DFES_DbLv.DFC_TAFSDtyCycLo_C "/" VALUE 0x80073E4F Val_Wu8 255.0 DFES_OneToOne 0.00 255.0 FORMAT "%5.1" /end CHARACTERISTIC
/begin CHARACTERISTIC DFES_DbLv.DFC_TAFSPerHi_C "/" VALUE 0x80073E50 Val_Wu8 255.0 DFES_OneToOne 0.00 255.0 FORMAT "%5.1" /end CHARACTERISTIC
/begin CHARACTERISTIC DFES_DbLv.DFC_TAFSPerLo_C "/" VALUE 0x80073E51 Val_Wu8 255.0 DFES_OneToOne 0.00 255.0 FORMAT "%5.1" /end CHARACTERISTIC
/begin CHARACTERISTIC DFES_DbLv.DFC_TCACDsSRCMax_C "/" VALUE 0x80073E52 Val_Wu8 255.0 DFES_OneToOne 0.00 255.0 FORMAT "%5.1" /end CHARACTERISTIC
/begin CHARACTERISTIC DFES_DbLv.DFC_TCACDsSRCMin_C "/" VALUE 0x80073E53 Val_Wu8 255.0 DFES_OneToOne 0.00 255.0 FORMAT "%5.1" /end CHARACTERISTIC
/begin CHARACTERISTIC DFES_DbLv.DFC_ThrVlvOL_C "/" VALUE 0x80073E54 Val_Wu8 255.0 DFES_OneToOne 0.00 255.0 FORMAT "%5.1" /end CHARACTERISTIC
/begin CHARACTERISTIC DFES_DbLv.DFC_ThrVlvSCB_C "/" VALUE 0x80073E55 Val_Wu8 255.0 DFES_OneToOne 0.00 255.0 FORMAT "%5.1" /end CHARACTERISTIC
/begin CHARACTERISTIC DFES_DbLv.DFC_ThrVlvSRCMax_C "/" VALUE 0x80073E56 Val_Wu8 255.0 DFES_OneToOne 0.00 255.0 FORMAT "%5.1" /end CHARACTERISTIC
/begin CHARACTERISTIC DFES_DbLv.DFC_ThrVlvSRCMin_C "/" VALUE 0x80073E57 Val_Wu8 255.0 DFES_OneToOne 0.00 255.0 FORMAT "%5.1" /end CHARACTERISTIC
/begin CHARACTERISTIC DFES_DbLv.DFC_TrbChLPOL_C "/" VALUE 0x80073E58 Val_Wu8 255.0 DFES_OneToOne 0.00 255.0 FORMAT "%5.1" /end CHARACTERISTIC
/begin CHARACTERISTIC DFES_DbLv.DFC_TrbChLPSCB_C "/" VALUE 0x80073E59 Val_Wu8 255.0 DFES_OneToOne 0.00 255.0 FORMAT "%5.1" /end CHARACTERISTIC
/begin CHARACTERISTIC DFES_DbLv.DFC_TrbChLPSCG_C "/" VALUE 0x80073E5A Val_Wu8 255.0 DFES_OneToOne 0.00 255.0 FORMAT "%5.1" /end CHARACTERISTIC
/begin CHARACTERISTIC DFES_DbLv.DFC_TrbChOL_C "/" VALUE 0x80073E5B Val_Wu8 255.0 DFES_OneToOne 0.00 255.0 FORMAT "%5.1" /end CHARACTERISTIC
/begin CHARACTERISTIC DFES_DbLv.DFC_TrbChSCB_C "/" VALUE 0x80073E5C Val_Wu8 255.0 DFES_OneToOne 0.00 255.0 FORMAT "%5.1" /end CHARACTERISTIC
/begin CHARACTERISTIC DFES_DbLv.DFC_VSwVlvGovDvtMax_C "/" VALUE 0x80073E5D Val_Wu8 255.0 DFES_OneToOne 0.00 255.0 FORMAT "%5.1" /end CHARACTERISTIC
/begin CHARACTERISTIC DFES_DbLv.DFC_VSwVlvGovDvtMin_C "/" VALUE 0x80073E5E Val_Wu8 255.0 DFES_OneToOne 0.00 255.0 FORMAT "%5.1" /end CHARACTERISTIC
/begin CHARACTERISTIC DFES_DbLv.DFC_VSwVlvOL_C "/" VALUE 0x80073E5F Val_Wu8 255.0 DFES_OneToOne 0.00 255.0 FORMAT "%5.1" /end CHARACTERISTIC
/begin CHARACTERISTIC DFES_DbLv.DFC_VSwVlvSCB_C "/" VALUE 0x80073E60 Val_Wu8 255.0 DFES_OneToOne 0.00 255.0 FORMAT "%5.1" /end CHARACTERISTIC
/begin CHARACTERISTIC DFES_DbLv.DFC_VSwVlvSCG_C "/" VALUE 0x80073E61 Val_Wu8 255.0 DFES_OneToOne 0.00 255.0 FORMAT "%5.1" /end CHARACTERISTIC
/begin CHARACTERISTIC DFES_DbLv.DFC_VSwVlvSRCMax_C "/" VALUE 0x80073E62 Val_Wu8 255.0 DFES_OneToOne 0.00 255.0 FORMAT "%5.1" /end CHARACTERISTIC
/begin CHARACTERISTIC DFES_DbLv.DFC_VSwVlvSRCMin_C "/" VALUE 0x80073E63 Val_Wu8 255.0 DFES_OneToOne 0.00 255.0 FORMAT "%5.1" /end CHARACTERISTIC
/begin CHARACTERISTIC DFES_DbLv.DFC_VehVHW_C "/" VALUE 0x80073E64 Val_Wu8 255.0 DFES_OneToOne 0.00 255.0 FORMAT "%5.1" /end CHARACTERISTIC
/begin CHARACTERISTIC DFES_DbLv.DFC_VehVMax_C "/" VALUE 0x80073E65 Val_Wu8 255.0 DFES_OneToOne 0.00 255.0 FORMAT "%5.1" /end CHARACTERISTIC
/begin CHARACTERISTIC DFES_DbLv.DFC_VehVPlaus_C "/" VALUE 0x80073E66 Val_Wu8 255.0 DFES_OneToOne 0.00 255.0 FORMAT "%5.1" /end CHARACTERISTIC
/begin CHARACTERISTIC DFES_DbLv.DFC_VehVSig_C "/" VALUE 0x80073E67 Val_Wu8 255.0 DFES_OneToOne 0.00 255.0 FORMAT "%5.1" /end CHARACTERISTIC
/begin CHARACTERISTIC DFES_DbLv.DFC_WaHtElOL_C "/" VALUE 0x80073E68 Val_Wu8 255.0 DFES_OneToOne 0.00 255.0 FORMAT "%5.1" /end CHARACTERISTIC
/begin CHARACTERISTIC DFES_DbLv.DFC_WaHtElSCB_C "/" VALUE 0x80073E69 Val_Wu8 255.0 DFES_OneToOne 0.00 255.0 FORMAT "%5.1" /end CHARACTERISTIC
/begin CHARACTERISTIC DFES_DbLv.DFC_ClthNpl_C "/" VALUE 0x80073E6A Val_Wu8 255.0 DFES_OneToOne 0.00 255.0 FORMAT "%5.1" /end CHARACTERISTIC
/begin CHARACTERISTIC DFES_DbLv.DFC_ETClbETMax_0_C "/" VALUE 0x80073E6B Val_Wu8 255.0 DFES_OneToOne 0.00 255.0 FORMAT "%5.1" /end CHARACTERISTIC
/begin CHARACTERISTIC DFES_DbLv.DFC_ETClbETMax_1_C "/" VALUE 0x80073E6C Val_Wu8 255.0 DFES_OneToOne 0.00 255.0 FORMAT "%5.1" /end CHARACTERISTIC
/begin CHARACTERISTIC DFES_DbLv.DFC_ETClbETMax_2_C "/" VALUE 0x80073E6D Val_Wu8 255.0 DFES_OneToOne 0.00 255.0 FORMAT "%5.1" /end CHARACTERISTIC
/begin CHARACTERISTIC DFES_DbLv.DFC_ETClbETMax_3_C "/" VALUE 0x80073E6E Val_Wu8 255.0 DFES_OneToOne 0.00 255.0 FORMAT "%5.1" /end CHARACTERISTIC
/begin CHARACTERISTIC DFES_DbLv.DFC_ETClbETMax_4_C "/" VALUE 0x80073E6F Val_Wu8 255.0 DFES_OneToOne 0.00 255.0 FORMAT "%5.1" /end CHARACTERISTIC
/begin CHARACTERISTIC DFES_DbLv.DFC_ETClbETMax_5_C "/" VALUE 0x80073E70 Val_Wu8 255.0 DFES_OneToOne 0.00 255.0 FORMAT "%5.1" /end CHARACTERISTIC
/begin CHARACTERISTIC DFES_DbLv.DFC_ETClbETMin_0_C "/" VALUE 0x80073E71 Val_Wu8 255.0 DFES_OneToOne 0.00 255.0 FORMAT "%5.1" /end CHARACTERISTIC
/begin CHARACTERISTIC DFES_DbLv.DFC_ETClbETMin_1_C "/" VALUE 0x80073E72 Val_Wu8 255.0 DFES_OneToOne 0.00 255.0 FORMAT "%5.1" /end CHARACTERISTIC
/begin CHARACTERISTIC DFES_DbLv.DFC_ETClbETMin_2_C "/" VALUE 0x80073E73 Val_Wu8 255.0 DFES_OneToOne 0.00 255.0 FORMAT "%5.1" /end CHARACTERISTIC
/begin CHARACTERISTIC DFES_DbLv.DFC_ETClbETMin_3_C "/" VALUE 0x80073E74 Val_Wu8 255.0 DFES_OneToOne 0.00 255.0 FORMAT "%5.1" /end CHARACTERISTIC
/begin CHARACTERISTIC DFES_DbLv.DFC_ETClbETMin_4_C "/" VALUE 0x80073E75 Val_Wu8 255.0 DFES_OneToOne 0.00 255.0 FORMAT "%5.1" /end CHARACTERISTIC
/begin CHARACTERISTIC DFES_DbLv.DFC_ETClbETMin_5_C "/" VALUE 0x80073E76 Val_Wu8 255.0 DFES_OneToOne 0.00 255.0 FORMAT "%5.1" /end CHARACTERISTIC
/begin CHARACTERISTIC DFES_DbLv.DFC_IVDiaBnkShCirBSH_0_C "/" VALUE 0x80073E77 Val_Wu8 255.0 DFES_OneToOne 0.00 255.0 FORMAT "%5.1" /end CHARACTERISTIC
/begin CHARACTERISTIC DFES_DbLv.DFC_IVDiaBnkShCirBSH_1_C "/" VALUE 0x80073E78 Val_Wu8 255.0 DFES_OneToOne 0.00 255.0 FORMAT "%5.1" /end CHARACTERISTIC
/begin CHARACTERISTIC DFES_DbLv.DFC_IVDiaBnkShCirChSwt_0_C "/" VALUE 0x80073E79 Val_Wu8 255.0 DFES_OneToOne 0.00 255.0 FORMAT "%5.1" /end CHARACTERISTIC
/begin CHARACTERISTIC DFES_DbLv.DFC_IVDiaBnkShCirChSwt_1_C "/" VALUE 0x80073E7A Val_Wu8 255.0 DFES_OneToOne 0.00 255.0 FORMAT "%5.1" /end CHARACTERISTIC
/begin CHARACTERISTIC DFES_DbLv.DFC_IVDiaBnkShCirHSBatt_0_C "/" VALUE 0x80073E7B Val_Wu8 255.0 DFES_OneToOne 0.00 255.0 FORMAT "%5.1" /end CHARACTERISTIC
/begin CHARACTERISTIC DFES_DbLv.DFC_IVDiaBnkShCirHSBatt_1_C "/" VALUE 0x80073E7C Val_Wu8 255.0 DFES_OneToOne 0.00 255.0 FORMAT "%5.1" /end CHARACTERISTIC
/begin CHARACTERISTIC DFES_DbLv.DFC_IVDiaBnkShCirHiRstnc_0_C "/" VALUE 0x80073E7D Val_Wu8 255.0 DFES_OneToOne 0.00 255.0 FORMAT "%5.1" /end CHARACTERISTIC
/begin CHARACTERISTIC DFES_DbLv.DFC_IVDiaBnkShCirHiRstnc_1_C "/" VALUE 0x80073E7E Val_Wu8 255.0 DFES_OneToOne 0.00 255.0 FORMAT "%5.1" /end CHARACTERISTIC
/begin CHARACTERISTIC DFES_DbLv.DFC_IVDiaBnkShCirLSHSGnd_0_C "/" VALUE 0x80073E7F Val_Wu8 255.0 DFES_OneToOne 0.00 255.0 FORMAT "%5.1" /end CHARACTERISTIC
/begin CHARACTERISTIC DFES_DbLv.DFC_IVDiaBnkShCirLSHSGnd_1_C "/" VALUE 0x80073E80 Val_Wu8 255.0 DFES_OneToOne 0.00 255.0 FORMAT "%5.1" /end CHARACTERISTIC
/begin CHARACTERISTIC DFES_DbLv.DFC_IVDiaBnkShCirTransfer_0_C "/" VALUE 0x80073E81 Val_Wu8 255.0 DFES_OneToOne 0.00 255.0 FORMAT "%5.1" /end CHARACTERISTIC
/begin CHARACTERISTIC DFES_DbLv.DFC_IVDiaBnkShCirTransfer_1_C "/" VALUE 0x80073E82 Val_Wu8 255.0 DFES_OneToOne 0.00 255.0 FORMAT "%5.1" /end CHARACTERISTIC
/begin CHARACTERISTIC DFES_DbLv.DFC_IVDiaCylNoCls_0_C "/" VALUE 0x80073E83 Val_Wu8 255.0 DFES_OneToOne 0.00 255.0 FORMAT "%5.1" /end CHARACTERISTIC
/begin CHARACTERISTIC DFES_DbLv.DFC_IVDiaCylNoCls_1_C "/" VALUE 0x80073E84 Val_Wu8 255.0 DFES_OneToOne 0.00 255.0 FORMAT "%5.1" /end CHARACTERISTIC
/begin CHARACTERISTIC DFES_DbLv.DFC_IVDiaCylNoCls_2_C "/" VALUE 0x80073E85 Val_Wu8 255.0 DFES_OneToOne 0.00 255.0 FORMAT "%5.1" /end CHARACTERISTIC
/begin CHARACTERISTIC DFES_DbLv.DFC_IVDiaCylNoCls_3_C "/" VALUE 0x80073E86 Val_Wu8 255.0 DFES_OneToOne 0.00 255.0 FORMAT "%5.1" /end CHARACTERISTIC
/begin CHARACTERISTIC DFES_DbLv.DFC_IVDiaCylNoCls_4_C "/" VALUE 0x80073E87 Val_Wu8 255.0 DFES_OneToOne 0.00 255.0 FORMAT "%5.1" /end CHARACTERISTIC
/begin CHARACTERISTIC DFES_DbLv.DFC_IVDiaCylNoCls_5_C "/" VALUE 0x80073E88 Val_Wu8 255.0 DFES_OneToOne 0.00 255.0 FORMAT "%5.1" /end CHARACTERISTIC
/begin CHARACTERISTIC DFES_DbLv.DFC_IVDiaCylNoLd_0_C "/" VALUE 0x80073E89 Val_Wu8 255.0 DFES_OneToOne 0.00 255.0 FORMAT "%5.1" /end CHARACTERISTIC
/begin CHARACTERISTIC DFES_DbLv.DFC_IVDiaCylNoLd_1_C "/" VALUE 0x80073E8A Val_Wu8 255.0 DFES_OneToOne 0.00 255.0 FORMAT "%5.1" /end CHARACTERISTIC
/begin CHARACTERISTIC DFES_DbLv.DFC_IVDiaCylNoLd_2_C "/" VALUE 0x80073E8B Val_Wu8 255.0 DFES_OneToOne 0.00 255.0 FORMAT "%5.1" /end CHARACTERISTIC
/begin CHARACTERISTIC DFES_DbLv.DFC_IVDiaCylNoLd_3_C "/" VALUE 0x80073E8C Val_Wu8 255.0 DFES_OneToOne 0.00 255.0 FORMAT "%5.1" /end CHARACTERISTIC
/begin CHARACTERISTIC DFES_DbLv.DFC_IVDiaCylNoLd_4_C "/" VALUE 0x80073E8D Val_Wu8 255.0 DFES_OneToOne 0.00 255.0 FORMAT "%5.1" /end CHARACTERISTIC
/begin CHARACTERISTIC DFES_DbLv.DFC_IVDiaCylNoLd_5_C "/" VALUE 0x80073E8E Val_Wu8 255.0 DFES_OneToOne 0.00 255.0 FORMAT "%5.1" /end CHARACTERISTIC
/begin CHARACTERISTIC DFES_DbLv.DFC_IVDiaCylShCirHiRstnc_0_C "/" VALUE 0x80073E8F Val_Wu8 255.0 DFES_OneToOne 0.00 255.0 FORMAT "%5.1" /end CHARACTERISTIC
/begin CHARACTERISTIC DFES_DbLv.DFC_IVDiaCylShCirHiRstnc_1_C "/" VALUE 0x80073E90 Val_Wu8 255.0 DFES_OneToOne 0.00 255.0 FORMAT "%5.1" /end CHARACTERISTIC
/begin CHARACTERISTIC DFES_DbLv.DFC_IVDiaCylShCirHiRstnc_2_C "/" VALUE 0x80073E91 Val_Wu8 255.0 DFES_OneToOne 0.00 255.0 FORMAT "%5.1" /end CHARACTERISTIC
/begin CHARACTERISTIC DFES_DbLv.DFC_IVDiaCylShCirHiRstnc_3_C "/" VALUE 0x80073E92 Val_Wu8 255.0 DFES_OneToOne 0.00 255.0 FORMAT "%5.1" /end CHARACTERISTIC
/begin CHARACTERISTIC DFES_DbLv.DFC_IVDiaCylShCirHiRstnc_4_C "/" VALUE 0x80073E93 Val_Wu8 255.0 DFES_OneToOne 0.00 255.0 FORMAT "%5.1" /end CHARACTERISTIC
/begin CHARACTERISTIC DFES_DbLv.DFC_IVDiaCylShCirHiRstnc_5_C "/" VALUE 0x80073E94 Val_Wu8 255.0 DFES_OneToOne 0.00 255.0 FORMAT "%5.1" /end CHARACTERISTIC
/begin CHARACTERISTIC DFES_DbLv.DFC_IVDiaCylShCirLSBatt_0_C "/" VALUE 0x80073E95 Val_Wu8 255.0 DFES_OneToOne 0.00 255.0 FORMAT "%5.1" /end CHARACTERISTIC
/begin CHARACTERISTIC DFES_DbLv.DFC_IVDiaCylShCirLSBatt_1_C "/" VALUE 0x80073E96 Val_Wu8 255.0 DFES_OneToOne 0.00 255.0 FORMAT "%5.1" /end CHARACTERISTIC
/begin CHARACTERISTIC DFES_DbLv.DFC_IVDiaCylShCirLSBatt_2_C "/" VALUE 0x80073E97 Val_Wu8 255.0 DFES_OneToOne 0.00 255.0 FORMAT "%5.1" /end CHARACTERISTIC
/begin CHARACTERISTIC DFES_DbLv.DFC_IVDiaCylShCirLSBatt_3_C "/" VALUE 0x80073E98 Val_Wu8 255.0 DFES_OneToOne 0.00 255.0 FORMAT "%5.1" /end CHARACTERISTIC
/begin CHARACTERISTIC DFES_DbLv.DFC_IVDiaCylShCirLSBatt_4_C "/" VALUE 0x80073E99 Val_Wu8 255.0 DFES_OneToOne 0.00 255.0 FORMAT "%5.1" /end CHARACTERISTIC
/begin CHARACTERISTIC DFES_DbLv.DFC_IVDiaCylShCirLSBatt_5_C "/" VALUE 0x80073E9A Val_Wu8 255.0 DFES_OneToOne 0.00 255.0 FORMAT "%5.1" /end CHARACTERISTIC
/begin CHARACTERISTIC DFES_DbLv.DFC_IVDiaCylShCirLSHS_0_C "/" VALUE 0x80073E9B Val_Wu8 255.0 DFES_OneToOne 0.00 255.0 FORMAT "%5.1" /end CHARACTERISTIC
/begin CHARACTERISTIC DFES_DbLv.DFC_IVDiaCylShCirLSHS_1_C "/" VALUE 0x80073E9C Val_Wu8 255.0 DFES_OneToOne 0.00 255.0 FORMAT "%5.1" /end CHARACTERISTIC
/begin CHARACTERISTIC DFES_DbLv.DFC_IVDiaCylShCirLSHS_2_C "/" VALUE 0x80073E9D Val_Wu8 255.0 DFES_OneToOne 0.00 255.0 FORMAT "%5.1" /end CHARACTERISTIC
/begin CHARACTERISTIC DFES_DbLv.DFC_IVDiaCylShCirLSHS_3_C "/" VALUE 0x80073E9E Val_Wu8 255.0 DFES_OneToOne 0.00 255.0 FORMAT "%5.1" /end CHARACTERISTIC
/begin CHARACTERISTIC DFES_DbLv.DFC_IVDiaCylShCirLSHS_4_C "/" VALUE 0x80073E9F Val_Wu8 255.0 DFES_OneToOne 0.00 255.0 FORMAT "%5.1" /end CHARACTERISTIC
/begin CHARACTERISTIC DFES_DbLv.DFC_IVDiaCylShCirLSHS_5_C "/" VALUE 0x80073EA0 Val_Wu8 255.0 DFES_OneToOne 0.00 255.0 FORMAT "%5.1" /end CHARACTERISTIC
/begin CHARACTERISTIC DFES_DbLv.DFC_IVDiaCylShCirLsLs_0_C "/" VALUE 0x80073EA1 Val_Wu8 255.0 DFES_OneToOne 0.00 255.0 FORMAT "%5.1" /end CHARACTERISTIC
/begin CHARACTERISTIC DFES_DbLv.DFC_IVDiaCylShCirLsLs_1_C "/" VALUE 0x80073EA2 Val_Wu8 255.0 DFES_OneToOne 0.00 255.0 FORMAT "%5.1" /end CHARACTERISTIC
/begin CHARACTERISTIC DFES_DbLv.DFC_IVDiaCylShCirLsLs_2_C "/" VALUE 0x80073EA3 Val_Wu8 255.0 DFES_OneToOne 0.00 255.0 FORMAT "%5.1" /end CHARACTERISTIC
/begin CHARACTERISTIC DFES_DbLv.DFC_IVDiaCylShCirLsLs_3_C "/" VALUE 0x80073EA4 Val_Wu8 255.0 DFES_OneToOne 0.00 255.0 FORMAT "%5.1" /end CHARACTERISTIC
/begin CHARACTERISTIC DFES_DbLv.DFC_IVDiaCylShCirLsLs_4_C "/" VALUE 0x80073EA5 Val_Wu8 255.0 DFES_OneToOne 0.00 255.0 FORMAT "%5.1" /end CHARACTERISTIC
/begin CHARACTERISTIC DFES_DbLv.DFC_IVDiaCylShCirLsLs_5_C "/" VALUE 0x80073EA6 Val_Wu8 255.0 DFES_OneToOne 0.00 255.0 FORMAT "%5.1" /end CHARACTERISTIC
/begin CHARACTERISTIC DFES_DbLv.DFC_IVDiaSPICfg_C "/" VALUE 0x80073EA7 Val_Wu8 255.0 DFES_OneToOne 0.00 255.0 FORMAT "%5.1" /end CHARACTERISTIC
/begin CHARACTERISTIC DFES_DbLv.DFC_IVDiaSPIColl_C "/" VALUE 0x80073EA8 Val_Wu8 255.0 DFES_OneToOne 0.00 255.0 FORMAT "%5.1" /end CHARACTERISTIC
/begin CHARACTERISTIC DFES_DbLv.DFC_IVDiaSPICtrl_C "/" VALUE 0x80073EA9 Val_Wu8 255.0 DFES_OneToOne 0.00 255.0 FORMAT "%5.1" /end CHARACTERISTIC
/begin CHARACTERISTIC DFES_DbLv.DFC_IVDiaSPIRam_C "/" VALUE 0x80073EAA Val_Wu8 255.0 DFES_OneToOne 0.00 255.0 FORMAT "%5.1" /end CHARACTERISTIC
/begin CHARACTERISTIC DFES_DbLv.DFC_IVDiaSPITrans_C "/" VALUE 0x80073EAB Val_Wu8 255.0 DFES_OneToOne 0.00 255.0 FORMAT "%5.1" /end CHARACTERISTIC
/begin CHARACTERISTIC DFES_DbLv.DFC_LSUCmpChk_0_C "/" VALUE 0x80073EAC Val_Wu8 255.0 DFES_OneToOne 0.00 255.0 FORMAT "%5.1" /end CHARACTERISTIC
/begin CHARACTERISTIC DFES_DbLv.DFC_LSUCmpChk_1_C "/" VALUE 0x80073EAD Val_Wu8 255.0 DFES_OneToOne 0.00 255.0 FORMAT "%5.1" /end CHARACTERISTIC
/begin CHARACTERISTIC DFES_DbLv.DFC_LSUCmpChk_2_C "/" VALUE 0x80073EAE Val_Wu8 255.0 DFES_OneToOne 0.00 255.0 FORMAT "%5.1" /end CHARACTERISTIC
/begin CHARACTERISTIC DFES_DbLv.DFC_LSUCmpChk_3_C "/" VALUE 0x80073EAF Val_Wu8 255.0 DFES_OneToOne 0.00 255.0 FORMAT "%5.1" /end CHARACTERISTIC
/begin CHARACTERISTIC DFES_DbLv.DFC_LSUCmpChk_4_C "/" VALUE 0x80073EB0 Val_Wu8 255.0 DFES_OneToOne 0.00 255.0 FORMAT "%5.1" /end CHARACTERISTIC
/begin CHARACTERISTIC DFES_DbLv.DFC_LSUCmpChk_5_C "/" VALUE 0x80073EB1 Val_Wu8 255.0 DFES_OneToOne 0.00 255.0 FORMAT "%5.1" /end CHARACTERISTIC
/begin CHARACTERISTIC DFES_DbLv.DFC_LSUDynChk_0_C "/" VALUE 0x80073EB2 Val_Wu8 255.0 DFES_OneToOne 0.00 255.0 FORMAT "%5.1" /end CHARACTERISTIC
/begin CHARACTERISTIC DFES_DbLv.DFC_LSUDynChk_1_C "/" VALUE 0x80073EB3 Val_Wu8 255.0 DFES_OneToOne 0.00 255.0 FORMAT "%5.1" /end CHARACTERISTIC
/begin CHARACTERISTIC DFES_DbLv.DFC_LSUDynChk_2_C "/" VALUE 0x80073EB4 Val_Wu8 255.0 DFES_OneToOne 0.00 255.0 FORMAT "%5.1" /end CHARACTERISTIC
/begin CHARACTERISTIC DFES_DbLv.DFC_LSUDynChk_3_C "/" VALUE 0x80073EB5 Val_Wu8 255.0 DFES_OneToOne 0.00 255.0 FORMAT "%5.1" /end CHARACTERISTIC
/begin CHARACTERISTIC DFES_DbLv.DFC_LSUO2ClbMax_0_C "/" VALUE 0x80073EB6 Val_Wu8 255.0 DFES_OneToOne 0.00 255.0 FORMAT "%5.1" /end CHARACTERISTIC
/begin CHARACTERISTIC DFES_DbLv.DFC_LSUO2ClbMax_1_C "/" VALUE 0x80073EB7 Val_Wu8 255.0 DFES_OneToOne 0.00 255.0 FORMAT "%5.1" /end CHARACTERISTIC
/begin CHARACTERISTIC DFES_DbLv.DFC_LSUO2ClbMax_2_C "/" VALUE 0x80073EB8 Val_Wu8 255.0 DFES_OneToOne 0.00 255.0 FORMAT "%5.1" /end CHARACTERISTIC
/begin CHARACTERISTIC DFES_DbLv.DFC_LSUO2ClbMax_3_C "/" VALUE 0x80073EB9 Val_Wu8 255.0 DFES_OneToOne 0.00 255.0 FORMAT "%5.1" /end CHARACTERISTIC
/begin CHARACTERISTIC DFES_DbLv.DFC_LSUO2ClbMin_0_C "/" VALUE 0x80073EBA Val_Wu8 255.0 DFES_OneToOne 0.00 255.0 FORMAT "%5.1" /end CHARACTERISTIC
/begin CHARACTERISTIC DFES_DbLv.DFC_LSUO2ClbMin_1_C "/" VALUE 0x80073EBB Val_Wu8 255.0 DFES_OneToOne 0.00 255.0 FORMAT "%5.1" /end CHARACTERISTIC
/begin CHARACTERISTIC DFES_DbLv.DFC_LSUO2ClbMin_2_C "/" VALUE 0x80073EBC Val_Wu8 255.0 DFES_OneToOne 0.00 255.0 FORMAT "%5.1" /end CHARACTERISTIC
/begin CHARACTERISTIC DFES_DbLv.DFC_LSUO2ClbMin_3_C "/" VALUE 0x80073EBD Val_Wu8 255.0 DFES_OneToOne 0.00 255.0 FORMAT "%5.1" /end CHARACTERISTIC
/begin CHARACTERISTIC DFES_DbLv.DFC_LSUO2PlausMax_0_C "/" VALUE 0x80073EBE Val_Wu8 255.0 DFES_OneToOne 0.00 255.0 FORMAT "%5.1" /end CHARACTERISTIC
/begin CHARACTERISTIC DFES_DbLv.DFC_LSUO2PlausMax_1_C "/" VALUE 0x80073EBF Val_Wu8 255.0 DFES_OneToOne 0.00 255.0 FORMAT "%5.1" /end CHARACTERISTIC
/begin CHARACTERISTIC DFES_DbLv.DFC_LSUO2PlausMax_2_C "/" VALUE 0x80073EC0 Val_Wu8 255.0 DFES_OneToOne 0.00 255.0 FORMAT "%5.1" /end CHARACTERISTIC
/begin CHARACTERISTIC DFES_DbLv.DFC_LSUO2PlausMax_3_C "/" VALUE 0x80073EC1 Val_Wu8 255.0 DFES_OneToOne 0.00 255.0 FORMAT "%5.1" /end CHARACTERISTIC
/begin CHARACTERISTIC DFES_DbLv.DFC_LSUO2PlausMin_0_C "/" VALUE 0x80073EC2 Val_Wu8 255.0 DFES_OneToOne 0.00 255.0 FORMAT "%5.1" /end CHARACTERISTIC
/begin CHARACTERISTIC DFES_DbLv.DFC_LSUO2PlausMin_1_C "/" VALUE 0x80073EC3 Val_Wu8 255.0 DFES_OneToOne 0.00 255.0 FORMAT "%5.1" /end CHARACTERISTIC
/begin CHARACTERISTIC DFES_DbLv.DFC_LSUO2PlausMin_2_C "/" VALUE 0x80073EC4 Val_Wu8 255.0 DFES_OneToOne 0.00 255.0 FORMAT "%5.1" /end CHARACTERISTIC
/begin CHARACTERISTIC DFES_DbLv.DFC_LSUO2PlausMin_3_C "/" VALUE 0x80073EC5 Val_Wu8 255.0 DFES_OneToOne 0.00 255.0 FORMAT "%5.1" /end CHARACTERISTIC
/begin CHARACTERISTIC DFES_DbLv.DFC_LSURiClbMax_0_C "/" VALUE 0x80073EC6 Val_Wu8 255.0 DFES_OneToOne 0.00 255.0 FORMAT "%5.1" /end CHARACTERISTIC
/begin CHARACTERISTIC DFES_DbLv.DFC_LSURiClbMax_1_C "/" VALUE 0x80073EC7 Val_Wu8 255.0 DFES_OneToOne 0.00 255.0 FORMAT "%5.1" /end CHARACTERISTIC
/begin CHARACTERISTIC DFES_DbLv.DFC_LSURiClbMax_2_C "/" VALUE 0x80073EC8 Val_Wu8 255.0 DFES_OneToOne 0.00 255.0 FORMAT "%5.1" /end CHARACTERISTIC
/begin CHARACTERISTIC DFES_DbLv.DFC_LSURiClbMax_3_C "/" VALUE 0x80073EC9 Val_Wu8 255.0 DFES_OneToOne 0.00 255.0 FORMAT "%5.1" /end CHARACTERISTIC
/begin CHARACTERISTIC DFES_DbLv.DFC_LSURiClbMin_0_C "/" VALUE 0x80073ECA Val_Wu8 255.0 DFES_OneToOne 0.00 255.0 FORMAT "%5.1" /end CHARACTERISTIC
/begin CHARACTERISTIC DFES_DbLv.DFC_LSURiClbMin_1_C "/" VALUE 0x80073ECB Val_Wu8 255.0 DFES_OneToOne 0.00 255.0 FORMAT "%5.1" /end CHARACTERISTIC
/begin CHARACTERISTIC DFES_DbLv.DFC_LSURiClbMin_2_C "/" VALUE 0x80073ECC Val_Wu8 255.0 DFES_OneToOne 0.00 255.0 FORMAT "%5.1" /end CHARACTERISTIC
/begin CHARACTERISTIC DFES_DbLv.DFC_LSURiClbMin_3_C "/" VALUE 0x80073ECD Val_Wu8 255.0 DFES_OneToOne 0.00 255.0 FORMAT "%5.1" /end CHARACTERISTIC
/begin CHARACTERISTIC DFES_DbLv.DFC_LSUWireIPSig_0_C "/" VALUE 0x80073ECE Val_Wu8 255.0 DFES_OneToOne 0.00 255.0 FORMAT "%5.1" /end CHARACTERISTIC
/begin CHARACTERISTIC DFES_DbLv.DFC_LSUWireIPSig_1_C "/" VALUE 0x80073ECF Val_Wu8 255.0 DFES_OneToOne 0.00 255.0 FORMAT "%5.1" /end CHARACTERISTIC
/begin CHARACTERISTIC DFES_DbLv.DFC_LSUWireIPSig_2_C "/" VALUE 0x80073ED0 Val_Wu8 255.0 DFES_OneToOne 0.00 255.0 FORMAT "%5.1" /end CHARACTERISTIC
/begin CHARACTERISTIC DFES_DbLv.DFC_LSUWireIPSig_3_C "/" VALUE 0x80073ED1 Val_Wu8 255.0 DFES_OneToOne 0.00 255.0 FORMAT "%5.1" /end CHARACTERISTIC
/begin CHARACTERISTIC DFES_DbLv.DFC_AFSDrftIdlAdjVal_C "/" VALUE 0x80073ED2 Val_Wu8 255.0 DFES_OneToOne 0.00 255.0 FORMAT "%5.1" /end CHARACTERISTIC
/begin CHARACTERISTIC DFES_DbLv.DFC_AFSDrftLdAdjVal_C "/" VALUE 0x80073ED3 Val_Wu8 255.0 DFES_OneToOne 0.00 255.0 FORMAT "%5.1" /end CHARACTERISTIC
/begin CHARACTERISTIC DFES_DbLv.DFC_AdcI_ADC0_Cal_C "/" VALUE 0x80073ED4 Val_Wu8 255.0 DFES_OneToOne 0.00 255.0 FORMAT "%5.1" /end CHARACTERISTIC
/begin CHARACTERISTIC DFES_DbLv.DFC_AdcI_ADC0_Conv_C "/" VALUE 0x80073ED5 Val_Wu8 255.0 DFES_OneToOne 0.00 255.0 FORMAT "%5.1" /end CHARACTERISTIC
/begin CHARACTERISTIC DFES_DbLv.DFC_CmbChbMisfireMax_0_C "/" VALUE 0x80073ED6 Val_Wu8 255.0 DFES_OneToOne 0.00 255.0 FORMAT "%5.1" /end CHARACTERISTIC
/begin CHARACTERISTIC DFES_DbLv.DFC_CmbChbMisfireMax_1_C "/" VALUE 0x80073ED7 Val_Wu8 255.0 DFES_OneToOne 0.00 255.0 FORMAT "%5.1" /end CHARACTERISTIC
/begin CHARACTERISTIC DFES_DbLv.DFC_CmbChbMisfireMax_2_C "/" VALUE 0x80073ED8 Val_Wu8 255.0 DFES_OneToOne 0.00 255.0 FORMAT "%5.1" /end CHARACTERISTIC
/begin CHARACTERISTIC DFES_DbLv.DFC_CmbChbMisfireMax_3_C "/" VALUE 0x80073ED9 Val_Wu8 255.0 DFES_OneToOne 0.00 255.0 FORMAT "%5.1" /end CHARACTERISTIC
/begin CHARACTERISTIC DFES_DbLv.DFC_CmbChbMisfireMax_4_C "/" VALUE 0x80073EDA Val_Wu8 255.0 DFES_OneToOne 0.00 255.0 FORMAT "%5.1" /end CHARACTERISTIC
/begin CHARACTERISTIC DFES_DbLv.DFC_CmbChbMisfireMax_5_C "/" VALUE 0x80073EDB Val_Wu8 255.0 DFES_OneToOne 0.00 255.0 FORMAT "%5.1" /end CHARACTERISTIC
/begin CHARACTERISTIC DFES_DbLv.DFC_CmbChbMisfireMul_C "/" VALUE 0x80073EDC Val_Wu8 255.0 DFES_OneToOne 0.00 255.0 FORMAT "%5.1" /end CHARACTERISTIC
/begin CHARACTERISTIC DFES_DbLv.DFC_INJVLVBUSY_C "/" VALUE 0x80073EDD Val_Wu8 255.0 DFES_OneToOne 0.00 255.0 FORMAT "%5.1" /end CHARACTERISTIC
/begin CHARACTERISTIC DFES_DbLv.DFC_IVAdjIVA_0_C "/" VALUE 0x80073EDE Val_Wu8 255.0 DFES_OneToOne 0.00 255.0 FORMAT "%5.1" /end CHARACTERISTIC
/begin CHARACTERISTIC DFES_DbLv.DFC_IVAdjIVA_1_C "/" VALUE 0x80073EDF Val_Wu8 255.0 DFES_OneToOne 0.00 255.0 FORMAT "%5.1" /end CHARACTERISTIC
/begin CHARACTERISTIC DFES_DbLv.DFC_IVAdjIVA_2_C "/" VALUE 0x80073EE0 Val_Wu8 255.0 DFES_OneToOne 0.00 255.0 FORMAT "%5.1" /end CHARACTERISTIC
/begin CHARACTERISTIC DFES_DbLv.DFC_IVAdjIVA_3_C "/" VALUE 0x80073EE1 Val_Wu8 255.0 DFES_OneToOne 0.00 255.0 FORMAT "%5.1" /end CHARACTERISTIC
/begin CHARACTERISTIC DFES_DbLv.DFC_IVAdjIVA_4_C "/" VALUE 0x80073EE2 Val_Wu8 255.0 DFES_OneToOne 0.00 255.0 FORMAT "%5.1" /end CHARACTERISTIC
/begin CHARACTERISTIC DFES_DbLv.DFC_IVAdjIVA_5_C "/" VALUE 0x80073EE3 Val_Wu8 255.0 DFES_OneToOne 0.00 255.0 FORMAT "%5.1" /end CHARACTERISTIC
/begin CHARACTERISTIC DFES_DbLv.DFC_InjCtlAdjQntEEPCS_C "/" VALUE 0x80073EE4 Val_Wu8 255.0 DFES_OneToOne 0.00 255.0 FORMAT "%5.1" /end CHARACTERISTIC
/begin CHARACTERISTIC DFES_DbLv.DFC_InjCtlDriftEEPCS_C "/" VALUE 0x80073EE5 Val_Wu8 255.0 DFES_OneToOne 0.00 255.0 FORMAT "%5.1" /end CHARACTERISTIC
/begin CHARACTERISTIC DFES_DbLv.DFC_MRlyErlyOpng_C "/" VALUE 0x80073EE6 Val_Wu8 255.0 DFES_OneToOne 0.00 255.0 FORMAT "%5.1" /end CHARACTERISTIC
/begin CHARACTERISTIC DFES_DbLv.DFC_MRlyStk_C "/" VALUE 0x80073EE7 Val_Wu8 255.0 DFES_OneToOne 0.00 255.0 FORMAT "%5.1" /end CHARACTERISTIC
/begin CHARACTERISTIC DFES_DbLv.DFC_SensFrzPPFltUs_C "/" VALUE 0x80073EE8 Val_Wu8 255.0 DFES_OneToOne 0.00 255.0 FORMAT "%5.1" /end CHARACTERISTIC
/begin CHARACTERISTIC DFES_DbLv.DFC_T15Sig_C "/" VALUE 0x80073EE9 Val_Wu8 255.0 DFES_OneToOne 0.00 255.0 FORMAT "%5.1" /end CHARACTERISTIC
/begin CHARACTERISTIC DFES_DbLv.DFC_AirCtlRmpTOut_C "/" VALUE 0x80073EEA Val_Wu8 255.0 DFES_OneToOne 0.00 255.0 FORMAT "%5.1" /end CHARACTERISTIC
/begin CHARACTERISTIC DFES_DbLv.DFC_CEngDsTDynTst_C "/" VALUE 0x80073EEB Val_Wu8 255.0 DFES_OneToOne 0.00 255.0 FORMAT "%5.1" /end CHARACTERISTIC
/begin CHARACTERISTIC DFES_DbLv.DFC_EGRVlvJamVlvClsd_C "/" VALUE 0x80073EEC Val_Wu8 255.0 DFES_OneToOne 0.00 255.0 FORMAT "%5.1" /end CHARACTERISTIC
/begin CHARACTERISTIC DFES_DbLv.DFC_EGRVlvJamVlvOpn_C "/" VALUE 0x80073EED Val_Wu8 255.0 DFES_OneToOne 0.00 255.0 FORMAT "%5.1" /end CHARACTERISTIC
/begin CHARACTERISTIC DFES_DbLv.DFC_EGRVlvLgTDrft_C "/" VALUE 0x80073EEE Val_Wu8 255.0 DFES_OneToOne 0.00 255.0 FORMAT "%5.1" /end CHARACTERISTIC
/begin CHARACTERISTIC DFES_DbLv.DFC_EGRVlvOfsLrnJamVlv_C "/" VALUE 0x80073EEF Val_Wu8 255.0 DFES_OneToOne 0.00 255.0 FORMAT "%5.1" /end CHARACTERISTIC
/begin CHARACTERISTIC DFES_DbLv.DFC_EGRVlvShTDrft_C "/" VALUE 0x80073EF0 Val_Wu8 255.0 DFES_OneToOne 0.00 255.0 FORMAT "%5.1" /end CHARACTERISTIC
/begin CHARACTERISTIC DFES_DbLv.DFC_EGTRgnOilDilMax_C "/" VALUE 0x80073EF1 Val_Wu8 255.0 DFES_OneToOne 0.00 255.0 FORMAT "%5.1" /end CHARACTERISTIC
/begin CHARACTERISTIC DFES_DbLv.DFC_EngICO_C "/" VALUE 0x80073EF2 Val_Wu8 255.0 DFES_OneToOne 0.00 255.0 FORMAT "%5.1" /end CHARACTERISTIC
/begin CHARACTERISTIC DFES_DbLv.DFC_EpmCaSI1ErrSig_C "/" VALUE 0x80073EF3 Val_Wu8 255.0 DFES_OneToOne 0.00 255.0 FORMAT "%5.1" /end CHARACTERISTIC
/begin CHARACTERISTIC DFES_DbLv.DFC_EpmCaSI1NoSig_C "/" VALUE 0x80073EF4 Val_Wu8 255.0 DFES_OneToOne 0.00 255.0 FORMAT "%5.1" /end CHARACTERISTIC
/begin CHARACTERISTIC DFES_DbLv.DFC_EpmCaSI1OfsErr_C "/" VALUE 0x80073EF5 Val_Wu8 255.0 DFES_OneToOne 0.00 255.0 FORMAT "%5.1" /end CHARACTERISTIC
/begin CHARACTERISTIC DFES_DbLv.DFC_EpmCrSErrSig_C "/" VALUE 0x80073EF6 Val_Wu8 255.0 DFES_OneToOne 0.00 255.0 FORMAT "%5.1" /end CHARACTERISTIC
/begin CHARACTERISTIC DFES_DbLv.DFC_EpmCrSNoSig_C "/" VALUE 0x80073EF7 Val_Wu8 255.0 DFES_OneToOne 0.00 255.0 FORMAT "%5.1" /end CHARACTERISTIC
/begin CHARACTERISTIC DFES_DbLv.DFC_MoCADCCmp_C "/" VALUE 0x80073EF8 Val_Wu8 255.0 DFES_OneToOne 0.00 255.0 FORMAT "%5.1" /end CHARACTERISTIC
/begin CHARACTERISTIC DFES_DbLv.DFC_MoCADCTst_C "/" VALUE 0x80073EF9 Val_Wu8 255.0 DFES_OneToOne 0.00 255.0 FORMAT "%5.1" /end CHARACTERISTIC
/begin CHARACTERISTIC DFES_DbLv.DFC_MoCADCVltgRatio_C "/" VALUE 0x80073EFA Val_Wu8 255.0 DFES_OneToOne 0.00 255.0 FORMAT "%5.1" /end CHARACTERISTIC
/begin CHARACTERISTIC DFES_DbLv.DFC_MoCSOPLoLi_C "/" VALUE 0x80073EFB Val_Wu8 255.0 DFES_OneToOne 0.00 255.0 FORMAT "%5.1" /end CHARACTERISTIC
/begin CHARACTERISTIC DFES_DbLv.DFC_MoCSOPMM_C "/" VALUE 0x80073EFC Val_Wu8 255.0 DFES_OneToOne 0.00 255.0 FORMAT "%5.1" /end CHARACTERISTIC
/begin CHARACTERISTIC DFES_DbLv.DFC_MoCSOPTimeOut_C "/" VALUE 0x80073EFD Val_Wu8 255.0 DFES_OneToOne 0.00 255.0 FORMAT "%5.1" /end CHARACTERISTIC
/begin CHARACTERISTIC DFES_DbLv.DFC_MoCSOPUpLi_C "/" VALUE 0x80073EFE Val_Wu8 255.0 DFES_OneToOne 0.00 255.0 FORMAT "%5.1" /end CHARACTERISTIC
/begin CHARACTERISTIC DFES_DbLv.DFC_MoFAPP_C "/" VALUE 0x80073EFF Val_Wu8 255.0 DFES_OneToOne 0.00 255.0 FORMAT "%5.1" /end CHARACTERISTIC
/begin CHARACTERISTIC DFES_DbLv.DFC_MoFESpd_C "/" VALUE 0x80073F00 Val_Wu8 255.0 DFES_OneToOne 0.00 255.0 FORMAT "%5.1" /end CHARACTERISTIC
/begin CHARACTERISTIC DFES_DbLv.DFC_MoFInjDatPhi_C "/" VALUE 0x80073F01 Val_Wu8 255.0 DFES_OneToOne 0.00 255.0 FORMAT "%5.1" /end CHARACTERISTIC
/begin CHARACTERISTIC DFES_DbLv.DFC_MoFInjDatQnt_C "/" VALUE 0x80073F02 Val_Wu8 255.0 DFES_OneToOne 0.00 255.0 FORMAT "%5.1" /end CHARACTERISTIC
/begin CHARACTERISTIC DFES_DbLv.DFC_MoFInjQnt_C "/" VALUE 0x80073F03 Val_Wu8 255.0 DFES_OneToOne 0.00 255.0 FORMAT "%5.1" /end CHARACTERISTIC
/begin CHARACTERISTIC DFES_DbLv.DFC_MoFOvR_C "/" VALUE 0x80073F04 Val_Wu8 255.0 DFES_OneToOne 0.00 255.0 FORMAT "%5.1" /end CHARACTERISTIC
/begin CHARACTERISTIC DFES_DbLv.DFC_MoFQntCor_C "/" VALUE 0x80073F05 Val_Wu8 255.0 DFES_OneToOne 0.00 255.0 FORMAT "%5.1" /end CHARACTERISTIC
/begin CHARACTERISTIC DFES_DbLv.DFC_MoFTrqCmp_C "/" VALUE 0x80073F06 Val_Wu8 255.0 DFES_OneToOne 0.00 255.0 FORMAT "%5.1" /end CHARACTERISTIC
/begin CHARACTERISTIC DFES_DbLv.DFC_NplTOxiCatUs_C "/" VALUE 0x80073F07 Val_Wu8 255.0 DFES_OneToOne 0.00 255.0 FORMAT "%5.1" /end CHARACTERISTIC
/begin CHARACTERISTIC DFES_DbLv.DFC_PhyModNonMonMapNpl_C "/" VALUE 0x80073F08 Val_Wu8 255.0 DFES_OneToOne 0.00 255.0 FORMAT "%5.1" /end CHARACTERISTIC
/begin CHARACTERISTIC DFES_DbLv.DFC_RailPOfsTstMax_C "/" VALUE 0x80073F09 Val_Wu8 255.0 DFES_OneToOne 0.00 255.0 FORMAT "%5.1" /end CHARACTERISTIC
/begin CHARACTERISTIC DFES_DbLv.DFC_RailPOfsTstMin_C "/" VALUE 0x80073F0A Val_Wu8 255.0 DFES_OneToOne 0.00 255.0 FORMAT "%5.1" /end CHARACTERISTIC
/begin CHARACTERISTIC DFES_DbLv.DFC_SWReset_0_C "/" VALUE 0x80073F0B Val_Wu8 255.0 DFES_OneToOne 0.00 255.0 FORMAT "%5.1" /end CHARACTERISTIC
/begin CHARACTERISTIC DFES_DbLv.DFC_SWReset_1_C "/" VALUE 0x80073F0C Val_Wu8 255.0 DFES_OneToOne 0.00 255.0 FORMAT "%5.1" /end CHARACTERISTIC
/begin CHARACTERISTIC DFES_DbLv.DFC_SWReset_2_C "/" VALUE 0x80073F0D Val_Wu8 255.0 DFES_OneToOne 0.00 255.0 FORMAT "%5.1" /end CHARACTERISTIC
/begin CHARACTERISTIC DFES_DbLv.DFC_VSwVlvJamVlv_C "/" VALUE 0x80073F0E Val_Wu8 255.0 DFES_OneToOne 0.00 255.0 FORMAT "%5.1" /end CHARACTERISTIC
/begin CHARACTERISTIC DFES_DbLv.DFC_VSwVlvLgTDrft_C "/" VALUE 0x80073F0F Val_Wu8 255.0 DFES_OneToOne 0.00 255.0 FORMAT "%5.1" /end CHARACTERISTIC
/begin CHARACTERISTIC DFES_DbLv.DFC_VSwVlvOfsLrnJamVlv_C "/" VALUE 0x80073F10 Val_Wu8 255.0 DFES_OneToOne 0.00 255.0 FORMAT "%5.1" /end CHARACTERISTIC
/begin CHARACTERISTIC DFES_DbLv.DFC_VSwVlvShTDrft_C "/" VALUE 0x80073F11 Val_Wu8 255.0 DFES_OneToOne 0.00 255.0 FORMAT "%5.1" /end CHARACTERISTIC
/begin FUNCTION dfes_deblvl_auto ""
 /begin DEF_CHARACTERISTIC DFES_DbLv.DFC_AirCtlGovDvtEOMMax_C DFES_DbLv.DFC_AirCtlGovDvtEOMMin_C DFES_DbLv.DFC_AirCtlGovDvtMax_C DFES_DbLv.DFC_AirCtlGovDvtMin_C DFES_DbLv.DFC_Cj945SpiCom1_C DFES_DbLv.DFC_ComButtonMSASig_C DFES_DbLv.DFC_ComButtonMSATo_C DFES_DbLv.DFC_ComGearboxData2Sig_C DFES_DbLv.DFC_ComGearboxData2To_C DFES_DbLv.DFC_ComGearboxDataSig_C DFES_DbLv.DFC_ComGearboxDataTo_C DFES_DbLv.DFC_ComHeatACSig_C DFES_DbLv.DFC_ComHeatACTo_C DFES_DbLv.DFC_ComLenkradwinkelSig_C DFES_DbLv.DFC_ComLenkradwinkelTo_C DFES_DbLv.DFC_ComMileageRangeSig_C DFES_DbLv.DFC_ComMileageRangeTo_C DFES_DbLv.DFC_ComPspSig_C DFES_DbLv.DFC_ComPspTo_C DFES_DbLv.DFC_ComShutOffPSPSig_C DFES_DbLv.DFC_ComShutOffPSPTo_C DFES_DbLv.DFC_ComStKombiCtr_C DFES_DbLv.DFC_ComStKombiSig_C DFES_DbLv.DFC_ComStKombiTo_C DFES_DbLv.DFC_ComStateARSCtr_C DFES_DbLv.DFC_ComStateARSSig_C DFES_DbLv.DFC_ComStateARSTo_C DFES_DbLv.DFC_ComStateDscSig_C DFES_DbLv.DFC_ComStateDscTo_C DFES_DbLv.DFC_ComStateSeatSig_C DFES_DbLv.DFC_ComStateSeatTo_C DFES_DbLv.DFC_ComTempRelTimeSig_C DFES_DbLv.DFC_ComTempRelTimeTo_C DFES_DbLv.DFC_ComTerminalChk_C DFES_DbLv.DFC_ComTerminalCtr_C DFES_DbLv.DFC_ComTerminalSig_C DFES_DbLv.DFC_ComTerminalTo_C DFES_DbLv.DFC_ComTimeDateSig_C DFES_DbLv.DFC_ComTimeDateTo_C DFES_DbLv.DFC_ComTrailerSig_C DFES_DbLv.DFC_ComTrailerTo_C DFES_DbLv.DFC_ComTrqDemandAfsChk_C DFES_DbLv.DFC_ComTrqDemandAfsCtr_C DFES_DbLv.DFC_ComTrqDemandAfsSig_C DFES_DbLv.DFC_ComTrqDemandAfsTo_C DFES_DbLv.DFC_ComTrqDemandDscChk_C DFES_DbLv.DFC_ComTrqDemandDscCtr_C DFES_DbLv.DFC_ComTrqDemandDscSig_C DFES_DbLv.DFC_ComTrqDemandDscTo_C DFES_DbLv.DFC_ComTrqDemandGbxChk_C DFES_DbLv.DFC_ComTrqDemandGbxCtr_C DFES_DbLv.DFC_ComTrqDemandGbxSig_C DFES_DbLv.DFC_ComTrqDemandGbxTo_C DFES_DbLv.DFC_ComVelocitySig_C DFES_DbLv.DFC_ComVelocityTo_C DFES_DbLv.DFC_ComWheelSpeedSig_C DFES_DbLv.DFC_ComWheelSpeedTo_C DFES_DbLv.DFC_ComZvKlappenSig_C DFES_DbLv.DFC_ComZvKlappenTo_C DFES_DbLv.DFC_Cy150SpiCom_C DFES_DbLv.DFC_Cy320SpiCom_C DFES_DbLv.DFC_ETCtlDvtInrMax_C DFES_DbLv.DFC_ETCtlDvtInrMin_C DFES_DbLv.DFC_ETCtlDvtOutrMax_C DFES_DbLv.DFC_ETCtlDvtOutrMin_C DFES_DbLv.DFC_Fan4WinErr1_C DFES_DbLv.DFC_Fan4WinErr2_C DFES_DbLv.DFC_Fan4WinErr3_C DFES_DbLv.DFC_Fan4WinErr4_C DFES_DbLv.DFC_FanSCG_C DFES_DbLv.DFC_PCRGovDvtLPMax_C DFES_DbLv.DFC_PCRGovDvtLPMin_C DFES_DbLv.DFC_PCRGovDvtMax_C DFES_DbLv.DFC_PCRGovDvtMin_C DFES_DbLv.DFC_RailCPC1_C DFES_DbLv.DFC_RailCPC3_C DFES_DbLv.DFC_RailCPC4_C DFES_DbLv.DFC_RailMeUn0_C DFES_DbLv.DFC_RailMeUn1_C DFES_DbLv.DFC_RailMeUn2_C DFES_DbLv.DFC_RailMeUn3_C DFES_DbLv.DFC_RailMeUn4_C DFES_DbLv.DFC_RailPCV0_C DFES_DbLv.DFC_RailPCV1_C DFES_DbLv.DFC_RailPCV2_C DFES_DbLv.DFC_RailPCV3_C DFES_DbLv.DFC_RailPCV4_C DFES_DbLv.DFC_RailPMonStrt_C DFES_DbLv.DFC_SSpMon1_C DFES_DbLv.DFC_SSpMon2_C DFES_DbLv.DFC_SSpMon3_C DFES_DbLv.DFC_Sia_E1_C DFES_DbLv.DFC_Sia_E10_C DFES_DbLv.DFC_Sia_E11_C DFES_DbLv.DFC_Sia_E12_C DFES_DbLv.DFC_Sia_E13_C DFES_DbLv.DFC_Sia_E14_C DFES_DbLv.DFC_Sia_E15_C DFES_DbLv.DFC_Sia_E2_C DFES_DbLv.DFC_Sia_E3_C DFES_DbLv.DFC_Sia_E4_C DFES_DbLv.DFC_Sia_E5_C DFES_DbLv.DFC_Sia_E6_C DFES_DbLv.DFC_Sia_E7_C DFES_DbLv.DFC_Sia_E8_C DFES_DbLv.DFC_Sia_E9_C DFES_DbLv.DFC_ThrVlv4WinErr1_C DFES_DbLv.DFC_ThrVlv4WinErr2_C DFES_DbLv.DFC_ThrVlv4WinErr3_C DFES_DbLv.DFC_ThrVlv4WinErr4_C DFES_DbLv.DFC_ThrVlvSCG_C DFES_DbLv.DFC_TrbCh4WinErr1_C DFES_DbLv.DFC_TrbCh4WinErr2_C DFES_DbLv.DFC_TrbCh4WinErr3_C DFES_DbLv.DFC_TrbCh4WinErr4_C DFES_DbLv.DFC_TrbChSCG_C DFES_DbLv.DFC_TrbChSRCMax_C DFES_DbLv.DFC_TrbChSRCMin_C DFES_DbLv.DFC_WaHtEl4WinErr1_C DFES_DbLv.DFC_WaHtEl4WinErr2_C DFES_DbLv.DFC_WaHtEl4WinErr3_C DFES_DbLv.DFC_WaHtEl4WinErr4_C DFES_DbLv.DFC_WaHtElSCG_C DFES_DbLv.DFC_ETClbETFltMax_C DFES_DbLv.DFC_ETClbETFltMin_C DFES_DbLv.DFC_InjCrvInjLimChrgBal_C DFES_DbLv.DFC_InjCrvInjLimQntBal_C DFES_DbLv.DFC_InjCrvInjLimSys_C DFES_DbLv.DFC_InjCrvNumInjRtmLim_C DFES_DbLv.DFC_LSUHtCoupSig_0_C DFES_DbLv.DFC_LSUHtCoupSig_1_C DFES_DbLv.DFC_LSUHtCoupSig_2_C DFES_DbLv.DFC_LSUHtCoupSig_3_C DFES_DbLv.DFC_CtT_C DFES_DbLv.DFC_DSMDummy_C DFES_DbLv.DFC_MeUnOL_C DFES_DbLv.DFC_MeUnSCB_C DFES_DbLv.DFC_MeUnSRCMax_C DFES_DbLv.DFC_MeUnSRCMin_C DFES_DbLv.DFC_PCVOL_C DFES_DbLv.DFC_PCVSCB_C DFES_DbLv.DFC_PCVSRCMax_C DFES_DbLv.DFC_PCVSRCMin_C DFES_DbLv.DFC_RailPSRCMax_C DFES_DbLv.DFC_RailPSRCMin_C DFES_DbLv.DFC_IVActrVltgSRCMax_C DFES_DbLv.DFC_IVActrVltgSRCMin_C DFES_DbLv.DFC_IVPSplyDCDC_C DFES_DbLv.DFC_IVPSplyVltgSRCMax_C DFES_DbLv.DFC_IVPSplyVltgSRCMin_C DFES_DbLv.DFC_AFSOffsDrftMax_C DFES_DbLv.DFC_AFSOffsDrftMin_C DFES_DbLv.DFC_AFSSRCCorMax_C DFES_DbLv.DFC_AFSSRCCorMin_C DFES_DbLv.DFC_AFSSRCRawMax_C DFES_DbLv.DFC_AFSSRCRawMin_C DFES_DbLv.DFC_AFSSetyDrftMax_C DFES_DbLv.DFC_AFSSetyDrftMin_C DFES_DbLv.DFC_AirCClntPAnaSRCMax_C DFES_DbLv.DFC_AirCClntPAnaSRCMin_C DFES_DbLv.DFC_AirCClntPPerSRCMax_C DFES_DbLv.DFC_AirCClntPPerSRCMin_C DFES_DbLv.DFC_AirCClntPdcycSRCMax_C DFES_DbLv.DFC_AirCClntPdcycSRCMin_C DFES_DbLv.DFC_AirCCmprOL_C DFES_DbLv.DFC_AirCCmprRedTrqOL_C DFES_DbLv.DFC_AirCCmprRedTrqSCB_C DFES_DbLv.DFC_AirCCmprRedTrqSCG_C DFES_DbLv.DFC_AirCCmprSCB_C DFES_DbLv.DFC_AirCCmprSCG_C DFES_DbLv.DFC_AirCSwtNpl_C DFES_DbLv.DFC_AirCSwtSig_C DFES_DbLv.DFC_BattUSRCMax_C DFES_DbLv.DFC_BattUSRCMin_C DFES_DbLv.DFC_BrkNpl_C DFES_DbLv.DFC_BrkPSRCMax_C DFES_DbLv.DFC_BrkPSRCMin_C DFES_DbLv.DFC_BrkSig_C DFES_DbLv.DFC_CByVlvOL_C DFES_DbLv.DFC_CByVlvSCB_C DFES_DbLv.DFC_CByVlvSCG_C DFES_DbLv.DFC_CEngDsTSRCMax_C DFES_DbLv.DFC_CEngDsTSRCMin_C DFES_DbLv.DFC_CEngDsTSig_C DFES_DbLv.DFC_CEngUsTSRCMax_C DFES_DbLv.DFC_CEngUsTSRCMin_C DFES_DbLv.DFC_CThmstOL_C DFES_DbLv.DFC_CThmstSCB_C DFES_DbLv.DFC_CThmstSCG_C DFES_DbLv.DFC_ClthSig_C DFES_DbLv.DFC_ECBVlvOL_C DFES_DbLv.DFC_ECBVlvSCB_C DFES_DbLv.DFC_ECBVlvSCG_C DFES_DbLv.DFC_ECBVlvSRCMax_C DFES_DbLv.DFC_ECBVlvSRCMin_C DFES_DbLv.DFC_EGRVlvGovDvtMax_C DFES_DbLv.DFC_EGRVlvGovDvtMin_C DFES_DbLv.DFC_EGRVlvOL_C DFES_DbLv.DFC_EGRVlvSCB_C DFES_DbLv.DFC_EGRVlvSCG_C DFES_DbLv.DFC_EGRVlvSRCMax_C DFES_DbLv.DFC_EGRVlvSRCMin_C DFES_DbLv.DFC_EMDmpOL_0_C DFES_DbLv.DFC_EMDmpOL_1_C DFES_DbLv.DFC_EMDmpSCB_0_C DFES_DbLv.DFC_EMDmpSCB_1_C DFES_DbLv.DFC_EMDmpSCG_0_C DFES_DbLv.DFC_EMDmpSCG_1_C DFES_DbLv.DFC_EngStAOL_C DFES_DbLv.DFC_EngStASCB_C DFES_DbLv.DFC_EngStASCG_C DFES_DbLv.DFC_EnvPSRCMax_C DFES_DbLv.DFC_EnvPSRCMin_C DFES_DbLv.DFC_EnvPSig_C DFES_DbLv.DFC_EnvTSRCMax_C DFES_DbLv.DFC_EnvTSRCMin_C DFES_DbLv.DFC_FanOL_C DFES_DbLv.DFC_FanSCB_C DFES_DbLv.DFC_FlFltSig_C DFES_DbLv.DFC_FuelTSRCMax_C DFES_DbLv.DFC_FuelTSRCMin_C DFES_DbLv.DFC_GbxNPosPPerSRCMax_C DFES_DbLv.DFC_GbxNPosPPerSRCMin_C DFES_DbLv.DFC_GbxNPosPdcycSRCMax_C DFES_DbLv.DFC_GbxNPosPdcycSRCMin_C DFES_DbLv.DFC_GbxNPosSig_C DFES_DbLv.DFC_GlwPlgBSDOL_0_C DFES_DbLv.DFC_GlwPlgBSDOL_1_C DFES_DbLv.DFC_GlwPlgBSDOL_2_C DFES_DbLv.DFC_GlwPlgBSDOL_3_C DFES_DbLv.DFC_GlwPlgBSDOL_4_C DFES_DbLv.DFC_GlwPlgBSDOL_5_C DFES_DbLv.DFC_GlwPlgBSDOL_6_C DFES_DbLv.DFC_GlwPlgBSDOL_7_C DFES_DbLv.DFC_GlwPlgBSDOT_0_C DFES_DbLv.DFC_GlwPlgBSDOT_1_C DFES_DbLv.DFC_GlwPlgBSDOT_2_C DFES_DbLv.DFC_GlwPlgBSDOT_3_C DFES_DbLv.DFC_GlwPlgBSDOT_4_C DFES_DbLv.DFC_GlwPlgBSDOT_5_C DFES_DbLv.DFC_GlwPlgBSDOT_6_C DFES_DbLv.DFC_GlwPlgBSDOT_7_C DFES_DbLv.DFC_GlwPlgBSDSC_0_C DFES_DbLv.DFC_GlwPlgBSDSC_1_C DFES_DbLv.DFC_GlwPlgBSDSC_2_C DFES_DbLv.DFC_GlwPlgBSDSC_3_C DFES_DbLv.DFC_GlwPlgBSDSC_4_C DFES_DbLv.DFC_GlwPlgBSDSC_5_C DFES_DbLv.DFC_GlwPlgBSDSC_6_C DFES_DbLv.DFC_GlwPlgBSDSC_7_C DFES_DbLv.DFC_GlwPlgComErr_C DFES_DbLv.DFC_InjVlvPresMin_C DFES_DbLv.DFC_LSUCircNernstMax_0_C DFES_DbLv.DFC_LSUCircNernstMax_1_C DFES_DbLv.DFC_LSUCircNernstMax_2_C DFES_DbLv.DFC_LSUCircNernstMax_3_C DFES_DbLv.DFC_LSUCircNernstMin_0_C DFES_DbLv.DFC_LSUCircNernstMin_1_C DFES_DbLv.DFC_LSUCircNernstMin_2_C DFES_DbLv.DFC_LSUCircNernstMin_3_C DFES_DbLv.DFC_LSUCircNernstSig_0_C DFES_DbLv.DFC_LSUCircNernstSig_1_C DFES_DbLv.DFC_LSUCircNernstSig_2_C DFES_DbLv.DFC_LSUCircNernstSig_3_C DFES_DbLv.DFC_LSUCircPmpCurMax_0_C DFES_DbLv.DFC_LSUCircPmpCurMax_1_C DFES_DbLv.DFC_LSUCircPmpCurMax_2_C DFES_DbLv.DFC_LSUCircPmpCurMax_3_C DFES_DbLv.DFC_LSUCircPmpCurMin_0_C DFES_DbLv.DFC_LSUCircPmpCurMin_1_C DFES_DbLv.DFC_LSUCircPmpCurMin_2_C DFES_DbLv.DFC_LSUCircPmpCurMin_3_C DFES_DbLv.DFC_LSUCircPmpCurSig_0_C DFES_DbLv.DFC_LSUCircPmpCurSig_1_C DFES_DbLv.DFC_LSUCircPmpCurSig_2_C DFES_DbLv.DFC_LSUCircPmpCurSig_3_C DFES_DbLv.DFC_LSUCircVirtGndMax_0_C DFES_DbLv.DFC_LSUCircVirtGndMax_1_C DFES_DbLv.DFC_LSUCircVirtGndMax_2_C DFES_DbLv.DFC_LSUCircVirtGndMax_3_C DFES_DbLv.DFC_LSUCircVirtGndMin_0_C DFES_DbLv.DFC_LSUCircVirtGndMin_1_C DFES_DbLv.DFC_LSUCircVirtGndMin_2_C DFES_DbLv.DFC_LSUCircVirtGndMin_3_C DFES_DbLv.DFC_LSUCircVirtGndSig_0_C DFES_DbLv.DFC_LSUCircVirtGndSig_1_C DFES_DbLv.DFC_LSUCircVirtGndSig_2_C DFES_DbLv.DFC_LSUCircVirtGndSig_3_C DFES_DbLv.DFC_LSUHtrMax_0_C DFES_DbLv.DFC_LSUHtrMax_1_C DFES_DbLv.DFC_LSUHtrMax_2_C DFES_DbLv.DFC_LSUHtrMax_3_C DFES_DbLv.DFC_LSUHtrMin_0_C DFES_DbLv.DFC_LSUHtrMin_1_C DFES_DbLv.DFC_LSUHtrMin_2_C DFES_DbLv.DFC_LSUHtrMin_3_C DFES_DbLv.DFC_LSUHtrSig_0_C DFES_DbLv.DFC_LSUHtrSig_1_C DFES_DbLv.DFC_LSUHtrSig_2_C DFES_DbLv.DFC_LSUHtrSig_3_C DFES_DbLv.DFC_LSUO2Max_0_C DFES_DbLv.DFC_LSUO2Max_1_C DFES_DbLv.DFC_LSUO2Max_2_C DFES_DbLv.DFC_LSUO2Max_3_C DFES_DbLv.DFC_LSUO2Min_0_C DFES_DbLv.DFC_LSUO2Min_1_C DFES_DbLv.DFC_LSUO2Min_2_C DFES_DbLv.DFC_LSUO2Min_3_C DFES_DbLv.DFC_LSUSPIBattLowMin_0_C DFES_DbLv.DFC_LSUSPIBattLowMin_1_C DFES_DbLv.DFC_LSUSPIBattLowMin_2_C DFES_DbLv.DFC_LSUSPIBattLowMin_3_C DFES_DbLv.DFC_LSUSPISig_0_C DFES_DbLv.DFC_LSUSPISig_1_C DFES_DbLv.DFC_LSUSPISig_2_C DFES_DbLv.DFC_LSUSPISig_3_C DFES_DbLv.DFC_LSUtExcMax_0_C DFES_DbLv.DFC_LSUtExcMax_1_C DFES_DbLv.DFC_LSUtExcMax_2_C DFES_DbLv.DFC_LSUtExcMax_3_C DFES_DbLv.DFC_LSUtExcMin_0_C DFES_DbLv.DFC_LSUtExcMin_1_C DFES_DbLv.DFC_LSUtExcMin_2_C DFES_DbLv.DFC_LSUtExcMin_3_C DFES_DbLv.DFC_MILOL_C DFES_DbLv.DFC_MILSCB_C DFES_DbLv.DFC_MILSCG_C DFES_DbLv.DFC_MeUnSCG_C DFES_DbLv.DFC_NplHsChngPPFltDiff_C DFES_DbLv.DFC_NplPAirFltDs_C DFES_DbLv.DFC_NplTPFltUs_C DFES_DbLv.DFC_OilComErr_C DFES_DbLv.DFC_OilPLmpOL_C DFES_DbLv.DFC_OilPLmpSCB_C DFES_DbLv.DFC_OilPLmpSCG_C DFES_DbLv.DFC_OilPNpl_C DFES_DbLv.DFC_OilTNpl_C DFES_DbLv.DFC_OilTSRCMax_C DFES_DbLv.DFC_OilTSRCMin_C DFES_DbLv.DFC_PCACDsEnvPPls_C DFES_DbLv.DFC_PCACDsSRCMax_C DFES_DbLv.DFC_PCACDsSRCMin_C DFES_DbLv.DFC_PCVSCG_C DFES_DbLv.DFC_PFltCharPDiffMin_C DFES_DbLv.DFC_PFltDstrMin_C DFES_DbLv.DFC_PFltEngPrt_C DFES_DbLv.DFC_PFltLmpOL_C DFES_DbLv.DFC_PFltLmpSCB_C DFES_DbLv.DFC_PFltLmpSCG_C DFES_DbLv.DFC_PFltRgnPerm_C DFES_DbLv.DFC_PFltSRCMaxFlwRstn_C DFES_DbLv.DFC_PFltSRCMinFlwRstn_C DFES_DbLv.DFC_PFltSotMsDvtMax_C DFES_DbLv.DFC_PFltSotMsDvtMin_C DFES_DbLv.DFC_PFltSotMsMax_C DFES_DbLv.DFC_PSPOL_C DFES_DbLv.DFC_PSPSCB_C DFES_DbLv.DFC_PSPSCG_C DFES_DbLv.DFC_SRCHighAPP1_C DFES_DbLv.DFC_SRCHighAPP2_C DFES_DbLv.DFC_SRCLowAPP1_C DFES_DbLv.DFC_SRCLowAPP2_C DFES_DbLv.DFC_SRCMaxPAirFltDs_C DFES_DbLv.DFC_SRCMaxPPFltUs_C DFES_DbLv.DFC_SRCMaxTECU_C DFES_DbLv.DFC_SRCMaxTOxiCatUs_C DFES_DbLv.DFC_SRCMaxTPFltUs_C DFES_DbLv.DFC_SRCMinPAirFltDs_C DFES_DbLv.DFC_SRCMinPPFltUs_C DFES_DbLv.DFC_SRCMinTECU_C DFES_DbLv.DFC_SRCMinTOxiCatUs_C DFES_DbLv.DFC_SRCMinTPFltUs_C DFES_DbLv.DFC_SVSOL_C DFES_DbLv.DFC_SVSSCB_C DFES_DbLv.DFC_SVSSCG_C DFES_DbLv.DFC_StrtOL_C DFES_DbLv.DFC_StrtSCB_C DFES_DbLv.DFC_StrtSCG_C DFES_DbLv.DFC_SyncAPP_C DFES_DbLv.DFC_T15Npl_C DFES_DbLv.DFC_TAFSDtyCycHi_C DFES_DbLv.DFC_TAFSDtyCycLo_C DFES_DbLv.DFC_TAFSPerHi_C DFES_DbLv.DFC_TAFSPerLo_C DFES_DbLv.DFC_TCACDsSRCMax_C DFES_DbLv.DFC_TCACDsSRCMin_C DFES_DbLv.DFC_ThrVlvOL_C DFES_DbLv.DFC_ThrVlvSCB_C DFES_DbLv.DFC_ThrVlvSRCMax_C DFES_DbLv.DFC_ThrVlvSRCMin_C DFES_DbLv.DFC_TrbChLPOL_C DFES_DbLv.DFC_TrbChLPSCB_C DFES_DbLv.DFC_TrbChLPSCG_C DFES_DbLv.DFC_TrbChOL_C DFES_DbLv.DFC_TrbChSCB_C DFES_DbLv.DFC_VSwVlvGovDvtMax_C DFES_DbLv.DFC_VSwVlvGovDvtMin_C DFES_DbLv.DFC_VSwVlvOL_C DFES_DbLv.DFC_VSwVlvSCB_C DFES_DbLv.DFC_VSwVlvSCG_C DFES_DbLv.DFC_VSwVlvSRCMax_C DFES_DbLv.DFC_VSwVlvSRCMin_C DFES_DbLv.DFC_VehVHW_C DFES_DbLv.DFC_VehVMax_C DFES_DbLv.DFC_VehVPlaus_C DFES_DbLv.DFC_VehVSig_C DFES_DbLv.DFC_WaHtElOL_C DFES_DbLv.DFC_WaHtElSCB_C DFES_DbLv.DFC_ClthNpl_C DFES_DbLv.DFC_ETClbETMax_0_C DFES_DbLv.DFC_ETClbETMax_1_C DFES_DbLv.DFC_ETClbETMax_2_C DFES_DbLv.DFC_ETClbETMax_3_C DFES_DbLv.DFC_ETClbETMax_4_C DFES_DbLv.DFC_ETClbETMax_5_C DFES_DbLv.DFC_ETClbETMin_0_C DFES_DbLv.DFC_ETClbETMin_1_C DFES_DbLv.DFC_ETClbETMin_2_C DFES_DbLv.DFC_ETClbETMin_3_C DFES_DbLv.DFC_ETClbETMin_4_C DFES_DbLv.DFC_ETClbETMin_5_C DFES_DbLv.DFC_IVDiaBnkShCirBSH_0_C DFES_DbLv.DFC_IVDiaBnkShCirBSH_1_C DFES_DbLv.DFC_IVDiaBnkShCirChSwt_0_C DFES_DbLv.DFC_IVDiaBnkShCirChSwt_1_C DFES_DbLv.DFC_IVDiaBnkShCirHSBatt_0_C DFES_DbLv.DFC_IVDiaBnkShCirHSBatt_1_C DFES_DbLv.DFC_IVDiaBnkShCirHiRstnc_0_C DFES_DbLv.DFC_IVDiaBnkShCirHiRstnc_1_C DFES_DbLv.DFC_IVDiaBnkShCirLSHSGnd_0_C DFES_DbLv.DFC_IVDiaBnkShCirLSHSGnd_1_C DFES_DbLv.DFC_IVDiaBnkShCirTransfer_0_C DFES_DbLv.DFC_IVDiaBnkShCirTransfer_1_C DFES_DbLv.DFC_IVDiaCylNoCls_0_C DFES_DbLv.DFC_IVDiaCylNoCls_1_C DFES_DbLv.DFC_IVDiaCylNoCls_2_C DFES_DbLv.DFC_IVDiaCylNoCls_3_C DFES_DbLv.DFC_IVDiaCylNoCls_4_C DFES_DbLv.DFC_IVDiaCylNoCls_5_C DFES_DbLv.DFC_IVDiaCylNoLd_0_C DFES_DbLv.DFC_IVDiaCylNoLd_1_C DFES_DbLv.DFC_IVDiaCylNoLd_2_C DFES_DbLv.DFC_IVDiaCylNoLd_3_C DFES_DbLv.DFC_IVDiaCylNoLd_4_C DFES_DbLv.DFC_IVDiaCylNoLd_5_C DFES_DbLv.DFC_IVDiaCylShCirHiRstnc_0_C DFES_DbLv.DFC_IVDiaCylShCirHiRstnc_1_C DFES_DbLv.DFC_IVDiaCylShCirHiRstnc_2_C DFES_DbLv.DFC_IVDiaCylShCirHiRstnc_3_C DFES_DbLv.DFC_IVDiaCylShCirHiRstnc_4_C DFES_DbLv.DFC_IVDiaCylShCirHiRstnc_5_C DFES_DbLv.DFC_IVDiaCylShCirLSBatt_0_C DFES_DbLv.DFC_IVDiaCylShCirLSBatt_1_C DFES_DbLv.DFC_IVDiaCylShCirLSBatt_2_C DFES_DbLv.DFC_IVDiaCylShCirLSBatt_3_C DFES_DbLv.DFC_IVDiaCylShCirLSBatt_4_C DFES_DbLv.DFC_IVDiaCylShCirLSBatt_5_C DFES_DbLv.DFC_IVDiaCylShCirLSHS_0_C DFES_DbLv.DFC_IVDiaCylShCirLSHS_1_C DFES_DbLv.DFC_IVDiaCylShCirLSHS_2_C DFES_DbLv.DFC_IVDiaCylShCirLSHS_3_C DFES_DbLv.DFC_IVDiaCylShCirLSHS_4_C DFES_DbLv.DFC_IVDiaCylShCirLSHS_5_C DFES_DbLv.DFC_IVDiaCylShCirLsLs_0_C DFES_DbLv.DFC_IVDiaCylShCirLsLs_1_C DFES_DbLv.DFC_IVDiaCylShCirLsLs_2_C DFES_DbLv.DFC_IVDiaCylShCirLsLs_3_C DFES_DbLv.DFC_IVDiaCylShCirLsLs_4_C DFES_DbLv.DFC_IVDiaCylShCirLsLs_5_C DFES_DbLv.DFC_IVDiaSPICfg_C DFES_DbLv.DFC_IVDiaSPIColl_C DFES_DbLv.DFC_IVDiaSPICtrl_C DFES_DbLv.DFC_IVDiaSPIRam_C DFES_DbLv.DFC_IVDiaSPITrans_C DFES_DbLv.DFC_LSUCmpChk_0_C DFES_DbLv.DFC_LSUCmpChk_1_C DFES_DbLv.DFC_LSUCmpChk_2_C DFES_DbLv.DFC_LSUCmpChk_3_C DFES_DbLv.DFC_LSUCmpChk_4_C DFES_DbLv.DFC_LSUCmpChk_5_C DFES_DbLv.DFC_LSUDynChk_0_C DFES_DbLv.DFC_LSUDynChk_1_C DFES_DbLv.DFC_LSUDynChk_2_C DFES_DbLv.DFC_LSUDynChk_3_C DFES_DbLv.DFC_LSUO2ClbMax_0_C DFES_DbLv.DFC_LSUO2ClbMax_1_C DFES_DbLv.DFC_LSUO2ClbMax_2_C DFES_DbLv.DFC_LSUO2ClbMax_3_C DFES_DbLv.DFC_LSUO2ClbMin_0_C DFES_DbLv.DFC_LSUO2ClbMin_1_C DFES_DbLv.DFC_LSUO2ClbMin_2_C DFES_DbLv.DFC_LSUO2ClbMin_3_C DFES_DbLv.DFC_LSUO2PlausMax_0_C DFES_DbLv.DFC_LSUO2PlausMax_1_C DFES_DbLv.DFC_LSUO2PlausMax_2_C DFES_DbLv.DFC_LSUO2PlausMax_3_C DFES_DbLv.DFC_LSUO2PlausMin_0_C DFES_DbLv.DFC_LSUO2PlausMin_1_C DFES_DbLv.DFC_LSUO2PlausMin_2_C DFES_DbLv.DFC_LSUO2PlausMin_3_C DFES_DbLv.DFC_LSURiClbMax_0_C DFES_DbLv.DFC_LSURiClbMax_1_C DFES_DbLv.DFC_LSURiClbMax_2_C DFES_DbLv.DFC_LSURiClbMax_3_C DFES_DbLv.DFC_LSURiClbMin_0_C DFES_DbLv.DFC_LSURiClbMin_1_C DFES_DbLv.DFC_LSURiClbMin_2_C DFES_DbLv.DFC_LSURiClbMin_3_C DFES_DbLv.DFC_LSUWireIPSig_0_C DFES_DbLv.DFC_LSUWireIPSig_1_C DFES_DbLv.DFC_LSUWireIPSig_2_C DFES_DbLv.DFC_LSUWireIPSig_3_C DFES_DbLv.DFC_AFSDrftIdlAdjVal_C DFES_DbLv.DFC_AFSDrftLdAdjVal_C DFES_DbLv.DFC_AdcI_ADC0_Cal_C DFES_DbLv.DFC_AdcI_ADC0_Conv_C DFES_DbLv.DFC_CmbChbMisfireMax_0_C DFES_DbLv.DFC_CmbChbMisfireMax_1_C DFES_DbLv.DFC_CmbChbMisfireMax_2_C DFES_DbLv.DFC_CmbChbMisfireMax_3_C DFES_DbLv.DFC_CmbChbMisfireMax_4_C DFES_DbLv.DFC_CmbChbMisfireMax_5_C DFES_DbLv.DFC_CmbChbMisfireMul_C DFES_DbLv.DFC_INJVLVBUSY_C DFES_DbLv.DFC_IVAdjIVA_0_C DFES_DbLv.DFC_IVAdjIVA_1_C DFES_DbLv.DFC_IVAdjIVA_2_C DFES_DbLv.DFC_IVAdjIVA_3_C DFES_DbLv.DFC_IVAdjIVA_4_C DFES_DbLv.DFC_IVAdjIVA_5_C DFES_DbLv.DFC_InjCtlAdjQntEEPCS_C DFES_DbLv.DFC_InjCtlDriftEEPCS_C DFES_DbLv.DFC_MRlyErlyOpng_C DFES_DbLv.DFC_MRlyStk_C DFES_DbLv.DFC_SensFrzPPFltUs_C DFES_DbLv.DFC_T15Sig_C DFES_DbLv.DFC_AirCtlRmpTOut_C DFES_DbLv.DFC_CEngDsTDynTst_C DFES_DbLv.DFC_EGRVlvJamVlvClsd_C DFES_DbLv.DFC_EGRVlvJamVlvOpn_C DFES_DbLv.DFC_EGRVlvLgTDrft_C DFES_DbLv.DFC_EGRVlvOfsLrnJamVlv_C DFES_DbLv.DFC_EGRVlvShTDrft_C DFES_DbLv.DFC_EGTRgnOilDilMax_C DFES_DbLv.DFC_EngICO_C DFES_DbLv.DFC_EpmCaSI1ErrSig_C DFES_DbLv.DFC_EpmCaSI1NoSig_C DFES_DbLv.DFC_EpmCaSI1OfsErr_C DFES_DbLv.DFC_EpmCrSErrSig_C DFES_DbLv.DFC_EpmCrSNoSig_C DFES_DbLv.DFC_MoCADCCmp_C DFES_DbLv.DFC_MoCADCTst_C DFES_DbLv.DFC_MoCADCVltgRatio_C DFES_DbLv.DFC_MoCSOPLoLi_C DFES_DbLv.DFC_MoCSOPMM_C DFES_DbLv.DFC_MoCSOPTimeOut_C DFES_DbLv.DFC_MoCSOPUpLi_C DFES_DbLv.DFC_MoFAPP_C DFES_DbLv.DFC_MoFESpd_C DFES_DbLv.DFC_MoFInjDatPhi_C DFES_DbLv.DFC_MoFInjDatQnt_C DFES_DbLv.DFC_MoFInjQnt_C DFES_DbLv.DFC_MoFOvR_C DFES_DbLv.DFC_MoFQntCor_C DFES_DbLv.DFC_MoFTrqCmp_C DFES_DbLv.DFC_NplTOxiCatUs_C DFES_DbLv.DFC_PhyModNonMonMapNpl_C DFES_DbLv.DFC_RailPOfsTstMax_C DFES_DbLv.DFC_RailPOfsTstMin_C DFES_DbLv.DFC_SWReset_0_C DFES_DbLv.DFC_SWReset_1_C DFES_DbLv.DFC_SWReset_2_C DFES_DbLv.DFC_VSwVlvJamVlv_C DFES_DbLv.DFC_VSwVlvLgTDrft_C DFES_DbLv.DFC_VSwVlvOfsLrnJamVlv_C DFES_DbLv.DFC_VSwVlvShTDrft_C /end DEF_CHARACTERISTIC
/end FUNCTION
/begin COMPU_METHOD DFES_OneToOne "" RAT_FUNC "%6.2" "-" COEFFS 0 1 0 0 0 1 /end COMPU_METHOD
/begin RECORD_LAYOUT Val_Wu8 FNC_VALUES 1 UBYTE COLUMN_DIR DIRECT /end RECORD_LAYOUT
/end MODULE
/end PROJECT
