ASAP2_VERSION 1 31
/begin PROJECT MS45 "BMW Motorsteuerung R6"
/begin HEADER "_default_HeaderComment" PROJECT_NO _57 /end HEADER
/begin MODULE _default_ModuleName "_default_ModuleLongIdentifier"
/begin MOD_COMMON "_default_ModCommonComment" DEPOSIT ABSOLUTE BYTE_ORDER MSB_FIRST ALIGNMENT_BYTE 1 ALIGNMENT_WORD 2 ALIGNMENT_LONG 4 ALIGNMENT_FLOAT32_IEEE 4 ALIGNMENT_FLOAT64_IEEE 8 /end MOD_COMMON
/begin AXIS_PTS ldp_n_32__lamb_iga_afl "" 0xffe4804b n_32 _REC_AXS_20_u1 8160. _CNV_A_R_LINEAR_____15_CM 16 0. 8160. DISPLAY_IDENTIFIER LDP_N_32__LAMB_IGA_AFL FORMAT "%4.0" /end AXIS_PTS
/begin AXIS_PTS ldp_maf_hb__lamb_iga_afl "" 0xffe47fbd maf _REC_AXS_20_u1 1389. _CNV_A_R_LINEAR_____27_CM 12 0. 1389. DISPLAY_IDENTIFIER LDP_MAF_HB__LAMB_IGA_AFL FORMAT "%4.0" /end AXIS_PTS
/begin AXIS_PTS ldp_tco_ip_lamb_scc "" 0xffe4822e tco _REC_AXS_20_u1 190.5 _CNV_A_R_LINEAR_____11_CM 8 -48. 142.5 DISPLAY_IDENTIFIER LDP_TCO_IP_LAMB_SCC FORMAT "%5.1" /end AXIS_PTS
/begin AXIS_PTS ldpm_n_32__maf_delta_lamb_i "" 0xffe413bf n_32 _REC_AXS_20_u1 8160. _CNV_A_R_LINEAR_____15_CM 6 0. 8160. DISPLAY_IDENTIFIER LDPM_N_32__MAF_DELTA_LAMB_I FORMAT "%4.0" /end AXIS_PTS
/begin AXIS_PTS ldpm_maf_cyl__crlc_delta_lamb "" 0xffe51928 maf_cyl _REC_AXS_20_u2 2047.96875 _CNV_A_R_LINEAR_____115_CM 6 0. 2047.96875 DISPLAY_IDENTIFIER LDPM_MAF_CYL__CRLC_DELTA_LAMB FORMAT "%7.2" /end AXIS_PTS
/begin AXIS_PTS ldpm_cat_diag_1_laco "" 0xffe48350 online_dummy _REC_AXS_20_u1 1.984375 _CNV_A_R_LINEAR_____248_CM 8 0. 1.984375 DISPLAY_IDENTIFIER LDPM_CAT_DIAG_1_LACO FORMAT "%4.2" /end AXIS_PTS
/begin AXIS_PTS ldpm_vls_dif_dly__delta_lamb "" 0xffe51e94 online_dummy _REC_AXS_20_u2 9.99511719 _CNV_A_R_LINEAR_____355_CM 16 -5. 4.99511719 DISPLAY_IDENTIFIER LDPM_VLS_DIF_DLY__DELTA_LAMB FORMAT "%5.3" /end AXIS_PTS
/begin AXIS_PTS ldp_maf__vls_sp_dly_1 "" 0xffe50cf8 maf _REC_AXS_20_u2 1389. _CNV_A_R_LINEAR_____108_CM 8 0. 1389. DISPLAY_IDENTIFIER LDP_MAF__VLS_SP_DLY_1 FORMAT "%7.2" /end AXIS_PTS
/begin AXIS_PTS ldp_n_32__vls_sp_dly_1 "" 0xffe480ac n_32 _REC_AXS_20_u1 8160. _CNV_A_R_LINEAR_____15_CM 8 0. 8160. DISPLAY_IDENTIFIER LDP_N_32__VLS_SP_DLY_1 FORMAT "%4.0" /end AXIS_PTS
/begin AXIS_PTS ldp_maf__vls_sp_dly_2 "" 0xffe50d0a maf _REC_AXS_20_u2 1389. _CNV_A_R_LINEAR_____108_CM 8 0. 1389. DISPLAY_IDENTIFIER LDP_MAF__VLS_SP_DLY_2 FORMAT "%7.2" /end AXIS_PTS
/begin AXIS_PTS ldp_n_32__vls_sp_dly_2 "" 0xffe480b5 n_32 _REC_AXS_20_u1 8160. _CNV_A_R_LINEAR_____15_CM 8 0. 8160. DISPLAY_IDENTIFIER LDP_N_32__VLS_SP_DLY_2 FORMAT "%4.0" /end AXIS_PTS
/begin AXIS_PTS ldp_tco__ti_wf_max_lam "" 0xffe411fe tco _REC_AXS_20_u1 190.5 _CNV_A_R_LINEAR_____11_CM 6 -48. 142.5 DISPLAY_IDENTIFIER LDP_TCO__TI_WF_MAX_LAM FORMAT "%5.1" /end AXIS_PTS
/begin AXIS_PTS ldp_tco__t_lam_stop "" 0xffe411de tco _REC_AXS_20_u1 190.5 _CNV_A_R_LINEAR_____11_CM 6 -48. 142.5 DISPLAY_IDENTIFIER LDP_TCO__T_LAM_STOP FORMAT "%5.1" /end AXIS_PTS
/begin AXIS_PTS ldp_maf_int_puc "" 0xffe50d9a maf_int_puc _REC_AXS_20_u2 1820.398 _CNV_A_R_LINEAR_____287_CM 6 0. 1820.398 DISPLAY_IDENTIFIER LDP_MAF_INT_PUC FORMAT "%7.2" /end AXIS_PTS
/begin AXIS_PTS ldp_temp_main_cat "" 0xffe51348 online_dummy _REC_AXS_20_u2 1023.984375 _CNV_A_R_LINEAR_____343_CM 6 -33. 990.984375 DISPLAY_IDENTIFIER LDP_TEMP_MAIN_CAT FORMAT "%6.2" /end AXIS_PTS
/begin AXIS_PTS ldp_maf_cyl "" 0xffe50d1c maf_cyl _REC_AXS_20_u2 2047.96875 _CNV_A_R_LINEAR_____115_CM 6 0. 2047.96875 DISPLAY_IDENTIFIER LDP_MAF_CYL FORMAT "%7.2" /end AXIS_PTS
/begin AXIS_PTS ldp_quo_maf_int_purge "" 0xffe48179 lam_bank_1.lam_puc.quo_maf_int_purge _REC_AXS_20_u1 0.9960940000000002 _CNV_A_R_LINEAR_____50_CM 8 0. 0.996094 DISPLAY_IDENTIFIER LDP_QUO_MAF_INT_PURGE FORMAT "%5.3" /end AXIS_PTS
/begin AXIS_PTS ldpm_cat_diag "" 0xffe4133b online_dummy _REC_AXS_20_u1 1.984375 _CNV_A_R_LINEAR_____248_CM 6 0. 1.984375 DISPLAY_IDENTIFIER LDPM_CAT_DIAG FORMAT "%4.2" /end AXIS_PTS
/begin AXIS_PTS ldp_temp_pcat "" 0xffe51356 online_dummy _REC_AXS_20_u2 1023.984375 _CNV_A_R_LINEAR_____343_CM 6 -33. 990.984375 DISPLAY_IDENTIFIER LDP_TEMP_PCAT FORMAT "%6.2" /end AXIS_PTS
/begin AXIS_PTS ldpm_maf_hb_2_egtr "" 0xffe483f9 maf _REC_AXS_20_u1 1389. _CNV_A_R_LINEAR_____27_CM 8 0. 1389. DISPLAY_IDENTIFIER LDPM_MAF_HB_2_EGTR FORMAT "%4.0" /end AXIS_PTS
/begin AXIS_PTS ldpm_n_32_2_egtr "" 0xffe4848f n_32 _REC_AXS_20_u1 8160. _CNV_A_R_LINEAR_____15_CM 8 0. 8160. DISPLAY_IDENTIFIER LDPM_N_32_2_EGTR FORMAT "%4.0" /end AXIS_PTS
/begin AXIS_PTS ldp_t_ast_fac_2_sp_lamb_de "" 0xffe512b2 t_ast _REC_AXS_20_u2 6553.5 _CNV_A_R_LINEAR_____24_CM 4 0. 6553.5 DISPLAY_IDENTIFIER LDP_T_AST_FAC_2_SP_LAMB_DE FORMAT "%6.1" /end AXIS_PTS
/begin AXIS_PTS ldp_temp_cat_fac_2_sp_lamb_de "" 0xffe5133e temp_cat _REC_AXS_20_u2 1023.984375 _CNV_A_R_LINEAR_____343_CM 4 -33. 990.984375 DISPLAY_IDENTIFIER LDP_TEMP_CAT_FAC_2_SP_LAMB_DE FORMAT "%6.2" /end AXIS_PTS
/begin AXIS_PTS ldp_cat_diag_fac_1_sp_lamb_de "" 0xffe4100b online_dummy _REC_AXS_20_u1 1.984375 _CNV_A_R_LINEAR_____248_CM 4 0. 1.984375 DISPLAY_IDENTIFIER LDP_CAT_DIAG_FAC_1_SP_LAMB_DE FORMAT "%4.2" /end AXIS_PTS
/begin AXIS_PTS ldpm_t_vls_cyc_afl_hld "" 0xffe485e4 online_dummy _REC_AXS_20_u1 2.55 _CNV_A_R_LINEAR_____4_CM 8 0. 2.55 DISPLAY_IDENTIFIER LDPM_T_VLS_CYC_AFL_HLD FORMAT "%4.2" /end AXIS_PTS
/begin AXIS_PTS ldp_r_down_ls_ip_ttip_ls_down "" 0xffe51248 lam_bank_1.ls_down_cur.r_down_ls _REC_AXS_20_u2 65535. _CNV_A_R_LINEAR_____309_CM 8 0. 65535. DISPLAY_IDENTIFIER LDP_R_DOWN_LS_IP_TTIP_LS_DOWN FORMAT "%5.0" /end AXIS_PTS
/begin AXIS_PTS ldp_maf_kgh_crlc_ttip_ref_ls "" 0xffe50e60 maf_kgh _REC_AXS_20_u2 2047.96875 _CNV_A_R_LINEAR_____115_CM 8 0. 2047.96875 DISPLAY_IDENTIFIER LDP_MAF_KGH_CRLC_TTIP_REF_LS FORMAT "%7.2" /end AXIS_PTS
/begin AXIS_PTS ldp_pow_lsh_down_mmv_r_down_ls "" 0xffe511b0 lam_bank_1.ls_down_cur.pow_lsh_down_mmv _REC_AXS_20_u2 65.535 _CNV_A_R_LINEAR_____310_CM 8 0. 65.535 DISPLAY_IDENTIFIER LDP_POW_LSH_DOWN_MMV_R_DOWN_LS /end AXIS_PTS
/begin AXIS_PTS ldp_ttip_ref_ls_down_mdl_r_down "" 0xffe51572 lam_bank_1.ls_down_cur.ttip_ref_ls_down_mdl_mmv _REC_AXS_20_u2 2047.938 _CNV_A_R_LINEAR_____311_CM 8 0. 2047.938 DISPLAY_IDENTIFIER LDP_TTIP_REF_LS_DOWN_MDL_R_DOWN FORMAT "%7.3" /end AXIS_PTS
/begin AXIS_PTS ldpm_temp_ls_ini_1_egcp "" 0xffe51e1e online_dummy _REC_AXS_20_u2 4095.938 _CNV_A_R_LINEAR_____368_CM 6 -2048. 2047.938 DISPLAY_IDENTIFIER LDPM_TEMP_LS_INI_1_EGCP FORMAT "%8.2" /end AXIS_PTS
/begin AXIS_PTS ldp_vs_fac_v_efc_teg "" 0xffe4131b vs _REC_AXS_20_u1 255. _CNV_A_R_LINEAR_____23_CM 6 0. 255. DISPLAY_IDENTIFIER LDP_VS_FAC_V_EFC_TEG FORMAT "%3.0" /end AXIS_PTS
/begin AXIS_PTS ldpm_n_32_1_egcp "" 0xffe41382 n_32 _REC_AXS_20_u1 8160. _CNV_A_R_LINEAR_____15_CM 6 0. 8160. DISPLAY_IDENTIFIER LDPM_N_32_1_EGCP FORMAT "%4.0" /end AXIS_PTS
/begin AXIS_PTS ldpm_teg_cat_up_mdl_1_egcp "" 0xffe51d68 teg_cat_up_mdl_max _REC_AXS_20_u2 2047. _CNV_A_R_LINEAR_____6_CM 6 0. 2047. DISPLAY_IDENTIFIER LDPM_TEG_CAT_UP_MDL_1_EGCP FORMAT "%7.2" /end AXIS_PTS
/begin AXIS_PTS ldpm_teg_cat_down_mdl_1_egcp "" 0xffe51d5a online_dummy _REC_AXS_20_u2 2047. _CNV_A_R_LINEAR_____6_CM 6 0. 2047. DISPLAY_IDENTIFIER LDPM_TEG_CAT_DOWN_MDL_1_EGCP FORMAT "%7.2" /end AXIS_PTS
/begin AXIS_PTS ldpm_temp_ls_down_ini_1_egcp "" 0xffe51e10 online_dummy _REC_AXS_20_u2 4095.938 _CNV_A_R_LINEAR_____368_CM 6 -2048. 2047.938 DISPLAY_IDENTIFIER LDPM_TEMP_LS_DOWN_INI_1_EGCP FORMAT "%8.2" /end AXIS_PTS
/begin AXIS_PTS ldp_n_32_ip_v_efc_lsh_down_ctl "" 0xffe41114 n_32 _REC_AXS_20_u1 8160. _CNV_A_R_LINEAR_____15_CM 6 0. 8160. DISPLAY_IDENTIFIER LDP_N_32_IP_V_EFC_LSH_DOWN_CTL FORMAT "%4.0" /end AXIS_PTS
/begin AXIS_PTS ldp_vs_ip_fac_v_efc_down_teg "" 0xffe41322 vs _REC_AXS_20_u1 255. _CNV_A_R_LINEAR_____23_CM 6 0. 255. DISPLAY_IDENTIFIER LDP_VS_IP_FAC_V_EFC_DOWN_TEG FORMAT "%3.0" /end AXIS_PTS
/begin AXIS_PTS ldp_amp__fac_cor "" 0xffe5095a amp _REC_AXS_20_u2 5434. _CNV_A_R_LINEAR_____49_CM 16 0. 5434. DISPLAY_IDENTIFIER LDP_AMP__FAC_COR FORMAT "%7.2" /end AXIS_PTS
/begin AXIS_PTS ldp_n_32__fac_cor "" 0xffe47ffb n_32 _REC_AXS_20_u1 8160. _CNV_A_R_LINEAR_____15_CM 16 0. 8160. DISPLAY_IDENTIFIER LDP_N_32__FAC_COR FORMAT "%4.0" /end AXIS_PTS
/begin AXIS_PTS ldp_ttip_ls_up_mes__fac_cor "" 0xffe5153e online_dummy _REC_AXS_20_u2 4095.938 _CNV_A_R_LINEAR_____368_CM 16 -2048. 2047.938 DISPLAY_IDENTIFIER LDP_TTIP_LS_UP_MES__FAC_COR FORMAT "%8.2" /end AXIS_PTS
/begin AXIS_PTS ldp_iplsl_cor_chg_purge "" 0xffe50bec online_dummy _REC_AXS_20_u2 25.192 _CNV_A_R_LINEAR_____373_CM 4 -12.596 12.596 DISPLAY_IDENTIFIER LDP_IPLSL_COR_CHG_PURGE FORMAT "%7.4" /end AXIS_PTS
/begin AXIS_PTS ldp_maf_kgh__fac_cor "" 0xffe50e0a maf_kgh _REC_AXS_20_u2 2047.96875 _CNV_A_R_LINEAR_____115_CM 16 0. 2047.96875 DISPLAY_IDENTIFIER LDP_MAF_KGH__FAC_COR FORMAT "%7.2" /end AXIS_PTS
/begin AXIS_PTS ldp_tco_st__t_dly_ls_ready "" 0xffe48266 tco_st _REC_AXS_20_u1 190.5 _CNV_A_R_LINEAR_____11_CM 8 -48. 142.5 DISPLAY_IDENTIFIER LDP_TCO_ST__T_DLY_LS_READY FORMAT "%5.1" /end AXIS_PTS
/begin AXIS_PTS ldp_tco_st__t_deac_ls_ready "" 0xffe4825d tco_st _REC_AXS_20_u1 190.5 _CNV_A_R_LINEAR_____11_CM 8 -48. 142.5 DISPLAY_IDENTIFIER LDP_TCO_ST__T_DEAC_LS_READY FORMAT "%5.1" /end AXIS_PTS
/begin AXIS_PTS ldp_prs_ex_iplsl_fac "" 0xffe51224 prs_ex _REC_AXS_20_u2 5434. _CNV_A_R_LINEAR_____49_CM 8 0. 5434. DISPLAY_IDENTIFIER LDP_PRS_EX_IPLSL_FAC FORMAT "%7.2" /end AXIS_PTS
/begin AXIS_PTS ldp_id_maf_tab_1 "" 0xffe47f40 online_dummy _REC_AXS_20_u1 255. _CNV_A_R_LINEAR_____0_CM 16 0. 255. DISPLAY_IDENTIFIER LDP_ID_MAF_TAB_1 FORMAT "%3.0" /end AXIS_PTS
/begin AXIS_PTS ldp_id_maf_tab_2 "" 0xffe47f51 online_dummy _REC_AXS_20_u1 255. _CNV_A_R_LINEAR_____0_CM 16 0. 255. DISPLAY_IDENTIFIER LDP_ID_MAF_TAB_2 FORMAT "%3.0" /end AXIS_PTS
/begin AXIS_PTS ldp_n__pq_sp_puls "" 0xffe51004 n _REC_AXS_20_u2 816. _CNV_A_R_LINEAR_____10_CM 6 0. 8160. DISPLAY_IDENTIFIER LDP_N__PQ_SP_PULS FORMAT "%4.0" /end AXIS_PTS
/begin AXIS_PTS ldpm_tia_maf_mdl_con_1 "" 0xffe486bf tia _REC_AXS_20_u1 190.5 _CNV_A_R_LINEAR_____11_CM 8 -48. 142.5 DISPLAY_IDENTIFIER LDPM_TIA_MAF_MDL_CON_1 FORMAT "%5.1" /end AXIS_PTS
/begin AXIS_PTS ldp_teg_egr_maf_egr_con_1 "" 0xffe5131e teg_egr _REC_AXS_20_u2 2047. _CNV_A_R_LINEAR_____6_CM 8 0. 2047. DISPLAY_IDENTIFIER LDP_TEG_EGR_MAF_EGR_CON_1 FORMAT "%7.2" /end AXIS_PTS
/begin AXIS_PTS ldpm_n_32_ar_red "" 0xffe413d1 n_32 _REC_AXS_20_u1 816. _CNV_A_R_LINEAR_____15_CM 6 0. 8160. DISPLAY_IDENTIFIER LDPM_N_32_AR_RED FORMAT "%4.0" /end AXIS_PTS
/begin AXIS_PTS ldpm_maf_mes__vol_im "" 0xffe519cc maf_mes _REC_AXS_20_u2 1389. _CNV_A_R_LINEAR_____108_CM 6 0. 1389. DISPLAY_IDENTIFIER LDPM_MAF_MES__VOL_IM FORMAT "%7.2" /end AXIS_PTS
/begin AXIS_PTS ldpm_n_32__vol_im "" 0xffe48514 n_32 _REC_AXS_20_u1 8160. _CNV_A_R_LINEAR_____15_CM 8 0. 8160. DISPLAY_IDENTIFIER LDPM_N_32__VOL_IM FORMAT "%4.0" /end AXIS_PTS
/begin AXIS_PTS ldpm_n_32__vol_im_is "" 0xffe413ca n_32 _REC_AXS_20_u1 8160. _CNV_A_R_LINEAR_____15_CM 6 0. 8160. DISPLAY_IDENTIFIER LDPM_N_32__VOL_IM_IS FORMAT "%4.0" /end AXIS_PTS
/begin AXIS_PTS ldp_pq__ip_pq_isa "" 0xffe511c2 online_dummy _REC_AXS_20_u2 0.99998474 _CNV_A_R_LINEAR_____37_CM 16 0. 0.99998474 DISPLAY_IDENTIFIER LDP_PQ__IP_PQ_ISA FORMAT "%7.5" /end AXIS_PTS
/begin AXIS_PTS ldp_ar_red__ip_pq_isa "" 0xffe50a1e online_dummy _REC_AXS_20_u2 58.592855 _CNV_A_R_LINEAR_____382_CM 8 0. 58.592855 DISPLAY_IDENTIFIER LDP_AR_RED__IP_PQ_ISA FORMAT "%7.4" /end AXIS_PTS
/begin AXIS_PTS ldpm_pq_ar_red "" 0xffe51c56 pq _REC_AXS_20_u2 0.99998474 _CNV_A_R_LINEAR_____37_CM 4 0. 0.99998474 DISPLAY_IDENTIFIER LDPM_PQ_AR_RED FORMAT "%7.5" /end AXIS_PTS
/begin AXIS_PTS ldpm_maf_kgh_t_1_hfm "" 0xffe519c2 maf_kgh _REC_AXS_20_u2 204.796875 _CNV_A_R_LINEAR_____115_CM 4 0. 2047.96875 DISPLAY_IDENTIFIER LDPM_MAF_KGH_T_1_HFM FORMAT "%7.2" /end AXIS_PTS
/begin AXIS_PTS ldpm_n_ar_red "" 0xffe413f6 n_32 _REC_AXS_20_u1 8160. _CNV_A_R_LINEAR_____15_CM 6 0. 8160. DISPLAY_IDENTIFIER LDPM_N_AR_RED FORMAT "%4.0" /end AXIS_PTS
/begin AXIS_PTS ldpm_pq__fac_ar_red_cor "" 0xffe51c44 pq _REC_AXS_20_u2 0.99998474 _CNV_A_R_LINEAR_____37_CM 8 0. 0.99998474 DISPLAY_IDENTIFIER LDPM_PQ__FAC_AR_RED_COR FORMAT "%7.5" /end AXIS_PTS
/begin AXIS_PTS ldp_t_seg_t_1_ratio_crlc_hfm "" 0xffe512ee online_dummy _REC_AXS_20_u2 7.99987793 _CNV_A_R_LINEAR_____394_CM 6 0. 7.99987793 DISPLAY_IDENTIFIER LDP_T_SEG_T_1_RATIO_CRLC_HFM FORMAT "%6.4" /end AXIS_PTS
/begin AXIS_PTS ldp_ar_red_ad_add_dif "" 0xffe50a30 ar_red_ad_add_dif _REC_AXS_20_u2 58.592855 _CNV_A_R_LINEAR_____382_CM 4 0. 58.592855 DISPLAY_IDENTIFIER LDP_AR_RED_AD_ADD_DIF FORMAT "%7.4" /end AXIS_PTS
/begin AXIS_PTS ldp_n_32_ar_red_egr "" 0xffe410df n_32 _REC_AXS_20_u1 816. _CNV_A_R_LINEAR_____15_CM 6 0. 8160. DISPLAY_IDENTIFIER LDP_N_32_AR_RED_EGR FORMAT "%4.0" /end AXIS_PTS
/begin AXIS_PTS ldp_stk_av_egr_ar_red_egr "" 0xffe4818c stk_av_egr _REC_AXS_20_u1 99.609375 _CNV_A_R_LINEAR_____9_CM 8 0. 99.609375 DISPLAY_IDENTIFIER LDP_STK_AV_EGR_AR_RED_EGR FORMAT "%5.2" /end AXIS_PTS
/begin AXIS_PTS ldpm_maf_cyl_ex "" 0xffe51936 maf_cyl _REC_AXS_20_u2 2047.96875 _CNV_A_R_LINEAR_____115_CM 8 0. 2047.96875 DISPLAY_IDENTIFIER LDPM_MAF_CYL_EX FORMAT "%6.2" /end AXIS_PTS
/begin AXIS_PTS ldp_n_32__ip_t_vim_eff_vol "" 0xffe4109c n_32 _REC_AXS_20_u1 8160. _CNV_A_R_LINEAR_____15_CM 2 0. 8160. DISPLAY_IDENTIFIER LDP_N_32__IP_T_VIM_EFF_VOL FORMAT "%4.0" /end AXIS_PTS
/begin AXIS_PTS ldp_maf_cyl_amp_dec "" 0xffe50d3c maf_cyl _REC_AXS_20_u2 2047.96875 _CNV_A_R_LINEAR_____115_CM 4 0. 2047.96875 DISPLAY_IDENTIFIER LDP_MAF_CYL_AMP_DEC FORMAT "%6.2" /end AXIS_PTS
/begin AXIS_PTS ldp_maf_kgh_mes_bas "" 0xffe50e72 maf_kgh_mes_bas _REC_AXS_20_u2 2047.96875 _CNV_A_R_LINEAR_____115_CM 16 0. 2047.96875 DISPLAY_IDENTIFIER LDP_MAF_KGH_MES_BAS FORMAT "%7.2" /end AXIS_PTS
/begin AXIS_PTS ldpm_vo__eff_vol "" 0xffe4871c vo _REC_AXS_20_u1 95.625 _CNV_A_R_LINEAR_____82_CM 12 0. 95.625 DISPLAY_IDENTIFIER LDPM_VO__EFF_VOL FORMAT "%5.2" /end AXIS_PTS
/begin AXIS_PTS ldp_n_32_ip_crlc_eff_vol_temp "" 0xffe410e6 n_32 _REC_AXS_20_u1 8160. _CNV_A_R_LINEAR_____15_CM 6 0. 8160. DISPLAY_IDENTIFIER LDP_N_32_IP_CRLC_EFF_VOL_TEMP FORMAT "%4.0" /end AXIS_PTS
/begin AXIS_PTS ldpm_amp__eff_vol_amp "" 0xffe51736 amp _REC_AXS_20_u2 5434. _CNV_A_R_LINEAR_____49_CM 6 0. 5434. DISPLAY_IDENTIFIER LDPM_AMP__EFF_VOL_AMP FORMAT "%7.2" /end AXIS_PTS
/begin AXIS_PTS ldpm_n_32__eff_vol_cor "" 0xffe484c4 n_32 _REC_AXS_20_u1 8160. _CNV_A_R_LINEAR_____15_CM 8 0. 8160. DISPLAY_IDENTIFIER LDPM_N_32__EFF_VOL_COR FORMAT "%4.0" /end AXIS_PTS
/begin AXIS_PTS ldpm_maf__eff_vol_cor "" 0xffe51916 maf _REC_AXS_20_u2 1389. _CNV_A_R_LINEAR_____108_CM 8 0. 1389. DISPLAY_IDENTIFIER LDPM_MAF__EFF_VOL_COR FORMAT "%7.2" /end AXIS_PTS
/begin AXIS_PTS ldpm_n__eff_vol "" 0xffe51afa n _REC_AXS_20_u2 8160. _CNV_A_R_LINEAR_____10_CM 18 0. 8160. DISPLAY_IDENTIFIER LDPM_N__EFF_VOL FORMAT "%4.0" /end AXIS_PTS
/begin AXIS_PTS ldpm_cam_av_mv_in__eff_vol "" 0xffe51752 cam_av_mv_in _REC_AXS_20_u2 1535.9765625 _CNV_A_R_LINEAR_____396_CM 12 -768. 767.9765625 DISPLAY_IDENTIFIER LDPM_CAM_AV_MV_IN__EFF_VOL FORMAT "%7.2" /end AXIS_PTS
/begin AXIS_PTS ldp_tps_seg_ar_red_thr "" 0xffe51416 tps_seg _REC_AXS_20_u2 119.5 _CNV_A_R_LINEAR_____53_CM 16 0. 119.5 DISPLAY_IDENTIFIER LDP_TPS_SEG_AR_RED_THR /end AXIS_PTS
/begin AXIS_PTS ldp_isapwm_mmv "" 0xffe50c12 isapwm_mmv _REC_AXS_20_u2 99.99847412 _CNV_A_R_LINEAR_____8_CM 16 0. 99.99847412 DISPLAY_IDENTIFIER LDP_ISAPWM_MMV /end AXIS_PTS
/begin AXIS_PTS ldp_n_32__pq_egr_sp "" 0xffe48088 n_32 _REC_AXS_20_u1 816. _CNV_A_R_LINEAR_____15_CM 8 0. 8160. DISPLAY_IDENTIFIER LDP_N_32__PQ_EGR_SP FORMAT "%4.0" /end AXIS_PTS
/begin AXIS_PTS ldp_n_32__fac_maf_max_s "" 0xffe4800c n_32 _REC_AXS_20_u1 816. _CNV_A_R_LINEAR_____15_CM 8 0. 8160. DISPLAY_IDENTIFIER LDP_N_32__FAC_MAF_MAX_S FORMAT "%4.0" /end AXIS_PTS
/begin AXIS_PTS ldp_mff_sp_s__fac_maf_max_s "" 0xffe50f60 mff_sp_s _REC_AXS_20_u2 1389. _CNV_A_R_LINEAR_____108_CM 6 0. 1389. DISPLAY_IDENTIFIER LDP_MFF_SP_S__FAC_MAF_MAX_S FORMAT "%7.2" /end AXIS_PTS
/begin AXIS_PTS ldp_maf_dif_s__eff_maf_s "" 0xffe50d66 maf_dif_s _REC_AXS_20_u2 1389. _CNV_A_R_LINEAR_____399_CM 16 -694.5 694.5 DISPLAY_IDENTIFIER LDP_MAF_DIF_S__EFF_MAF_S FORMAT "%7.2" /end AXIS_PTS
/begin AXIS_PTS ldp_mff_sp_s__pq_egr_sp "" 0xffe50f6e mff_sp_s _REC_AXS_20_u2 1389. _CNV_A_R_LINEAR_____108_CM 6 0. 1389. DISPLAY_IDENTIFIER LDP_MFF_SP_S__PQ_EGR_SP FORMAT "%7.2" /end AXIS_PTS
/begin AXIS_PTS ldp_maf_turb_ratio__maf_sp_isa "" 0xffe47fdc maf_turb_ratio_max _REC_AXS_20_u1 3.984375 _CNV_A_R_LINEAR_____129_CM 8 0. 3.984375 DISPLAY_IDENTIFIER LDP_MAF_TURB_RATIO__MAF_SP_ISA FORMAT "%4.2" /end AXIS_PTS
/begin AXIS_PTS ldp_n__maf_sp_isa "" 0xffe50fb2 n _REC_AXS_20_u2 816. _CNV_A_R_LINEAR_____10_CM 6 0. 8160. DISPLAY_IDENTIFIER LDP_N__MAF_SP_ISA FORMAT "%4.0" /end AXIS_PTS
/begin AXIS_PTS ldp_n_32__crlc_maf_diag "" 0xffe4107f n_32 _REC_AXS_20_u1 8160. _CNV_A_R_LINEAR_____15_CM 4 0. 8160. DISPLAY_IDENTIFIER LDP_N_32__CRLC_MAF_DIAG FORMAT "%4.0" /end AXIS_PTS
/begin AXIS_PTS ldpm_pq_turb_sys "" 0xffe41407 n_32 _REC_AXS_20_u1 0.99610001 _CNV_A_R_LINEAR_____29_CM 6 0. 0.99610001 DISPLAY_IDENTIFIER LDPM_PQ_TURB_SYS FORMAT "%5.3" /end AXIS_PTS
/begin AXIS_PTS ldp_isapwm__fac_pq_isa "" 0xffe50bf6 isapwm _REC_AXS_20_u2 99.99847412 _CNV_A_R_LINEAR_____8_CM 4 0. 99.99847412 DISPLAY_IDENTIFIER LDP_ISAPWM__FAC_PQ_ISA /end AXIS_PTS
/begin AXIS_PTS ldp_n_32_mon__maf_sub_mon "" 0xffe52228 n_32_mon _REC_AXS_20_u1 8160. _CNV_A_R_LINEAR_____15_CM 8 0. 8160. DISPLAY_IDENTIFIER LDP_N_32_MON__MAF_SUB_MON FORMAT "%4.0" /end AXIS_PTS
/begin AXIS_PTS ldp_pq_turb_sys_mon__fac_pq_isa "" 0xffe52264 pq_turb_sys_mon _REC_AXS_20_u1 0.9960940000000002 _CNV_A_R_LINEAR_____403_CM 6 0. 0.996094 DISPLAY_IDENTIFIER LDP_PQ_TURB_SYS_MON__FAC_PQ_ISA FORMAT "%5.3" /end AXIS_PTS
/begin AXIS_PTS ldp_tps_av_mon__fac_tps_isa_mon "" 0xffe522a0 tps_av_mon _REC_AXS_20_u1 11.95 _CNV_A_R_LINEAR_____402_CM 6 0. 119.5 DISPLAY_IDENTIFIER LDP_TPS_AV_MON__FAC_TPS_ISA_MON FORMAT "%5.1" /end AXIS_PTS
/begin AXIS_PTS ldp_tps_av_mon__maf_sub_mon "" 0xffe522a7 tps_av_mon _REC_AXS_20_u1 11.95 _CNV_A_R_LINEAR_____402_CM 8 0. 119.5 DISPLAY_IDENTIFIER LDP_TPS_AV_MON__MAF_SUB_MON FORMAT "%5.1" /end AXIS_PTS
/begin AXIS_PTS ldp_amp__fac_maf_sub_cor_mon "" 0xffe523da amp _REC_AXS_20_u2 5434. _CNV_A_R_LINEAR_____49_CM 6 0. 5434. DISPLAY_IDENTIFIER LDP_AMP__FAC_MAF_SUB_COR_MON FORMAT "%7.2" /end AXIS_PTS
/begin AXIS_PTS ldp_n_32_mon__pq_mon "" 0xffe52231 n_32_mon _REC_AXS_20_u1 816. _CNV_A_R_LINEAR_____15_CM 8 0. 8160. DISPLAY_IDENTIFIER LDP_N_32_MON__PQ_MON FORMAT "%4.0" /end AXIS_PTS
/begin AXIS_PTS ldp_tps_sum_av_mon__pq_mon "" 0xffe522b0 tps_sum_av_mon _REC_AXS_20_u1 119.5 _CNV_A_R_LINEAR_____402_CM 8 0. 119.5 DISPLAY_IDENTIFIER LDP_TPS_SUM_AV_MON__PQ_MON FORMAT "%5.1" /end AXIS_PTS
/begin AXIS_PTS ldp_tia__fac_maf_sub_cor_mon "Correction factor for MAF_SUB_COR_MON calculation" 0xffe52299 tia _REC_AXS_20_u1 190.5 _CNV_A_R_LINEAR_____11_CM 6 -48. 142.5 DISPLAY_IDENTIFIER LDP_TIA__FAC_MAF_SUB_COR_MON FORMAT "%5.1" /end AXIS_PTS
/begin AXIS_PTS ldp_isapwm__fac_pq_isa_mon "" 0xffe523f4 isapwm _REC_AXS_20_u2 14.999771118 _CNV_A_R_LINEAR_____8_CM 4 0. 99.99847412 DISPLAY_IDENTIFIER LDP_ISAPWM__FAC_PQ_ISA_MON /end AXIS_PTS
/begin AXIS_PTS ldp_v_map_map_mes_bas "" 0xffe41d16 v_map _REC_AXS_20_u2 4.5 _CNV_A_R_LINEAR_____269_CM 2 0. 5. DISPLAY_IDENTIFIER LDP_V_MAP_MAP_MES_BAS FORMAT "%5.3" /end AXIS_PTS
/begin AXIS_PTS ldp_maf__mff_cor_1 "" 0xffe50cc4 maf _REC_AXS_20_u2 138.9 _CNV_A_R_LINEAR_____108_CM 12 0. 1389. DISPLAY_IDENTIFIER LDP_MAF__MFF_COR_1 FORMAT "%7.2" /end AXIS_PTS
/begin AXIS_PTS ldp_maf__mff_cor_2 "" 0xffe50cde maf _REC_AXS_20_u2 138.9 _CNV_A_R_LINEAR_____108_CM 12 0. 1389. DISPLAY_IDENTIFIER LDP_MAF__MFF_COR_2 FORMAT "%7.2" /end AXIS_PTS
/begin AXIS_PTS ldp_n__mff_cor_1 "" 0xffe50fc0 n _REC_AXS_20_u2 816. _CNV_A_R_LINEAR_____10_CM 16 0. 8160. DISPLAY_IDENTIFIER LDP_N__MFF_COR_1 FORMAT "%4.0" /end AXIS_PTS
/begin AXIS_PTS ldp_n__mff_cor_2 "" 0xffe50fe2 n _REC_AXS_20_u2 816. _CNV_A_R_LINEAR_____10_CM 16 0. 8160. DISPLAY_IDENTIFIER LDP_N__MFF_COR_2 FORMAT "%4.0" /end AXIS_PTS
/begin AXIS_PTS ldpm_tqi_sp_mff_s "" 0xffe51e68 tqi_sp_mff _REC_AXS_20_u2 1023.96875 _CNV_A_R_LINEAR_____55_CM 12 0. 1023.96875 DISPLAY_IDENTIFIER LDPM_TQI_SP_MFF_S FORMAT "%7.2" /end AXIS_PTS
/begin AXIS_PTS ldp_tps_dif__mtcpwm_p "" 0xffe513d8 tps_dif _REC_AXS_20_u2 239. _CNV_A_R_LINEAR_____407_CM 8 -119.5 119.5 DISPLAY_IDENTIFIER LDP_TPS_DIF__MTCPWM_P FORMAT "%8.3" /end AXIS_PTS
/begin AXIS_PTS ldp_tps_dif__mtcpwm_i "" 0xffe513c6 tps_dif _REC_AXS_20_u2 239. _CNV_A_R_LINEAR_____407_CM 8 -119.5 119.5 DISPLAY_IDENTIFIER LDP_TPS_DIF__MTCPWM_I FORMAT "%8.3" /end AXIS_PTS
/begin AXIS_PTS ldp_tps_av_lih_dif_mtcpwm_i "" 0xffe513b4 tps_av_lih_dif _REC_AXS_20_u2 239. _CNV_A_R_LINEAR_____407_CM 8 -119.5 119.5 DISPLAY_IDENTIFIER LDP_TPS_AV_LIH_DIF_MTCPWM_I FORMAT "%8.3" /end AXIS_PTS
/begin AXIS_PTS ldp_tps_dif_grd__mtcpwm_d "" 0xffe513ea tps_dif_grd _REC_AXS_20_u2 239. _CNV_A_R_LINEAR_____407_CM 8 -119.5 119.5 DISPLAY_IDENTIFIER LDP_TPS_DIF_GRD__MTCPWM_D FORMAT "%8.3" /end AXIS_PTS
/begin AXIS_PTS ldp_tps_sp_lih_dif__mtcpwm_add "" 0xffe51438 tps_sp_lih_dif _REC_AXS_20_u2 239. _CNV_A_R_LINEAR_____407_CM 8 -119.5 119.5 DISPLAY_IDENTIFIER LDP_TPS_SP_LIH_DIF__MTCPWM_ADD FORMAT "%8.3" /end AXIS_PTS
/begin AXIS_PTS ldp_vb__mtcpwm_vb_fac "" 0xffe48308 vb _REC_AXS_20_u1 25.8984 _CNV_A_R_LINEAR_____34_CM 8 0. 25.8984 DISPLAY_IDENTIFIER LDP_VB__MTCPWM_VB_FAC FORMAT "%3.1" /end AXIS_PTS
/begin AXIS_PTS ldpm_n_tooth__eoi_st "" 0xffe51c3a n_tooth _REC_AXS_20_u2 816. _CNV_A_R_LINEAR_____10_CM 4 0. 8160. DISPLAY_IDENTIFIER LDPM_N_TOOTH__EOI_ST FORMAT "%4.0" /end AXIS_PTS
/begin AXIS_PTS ldpm_tco__eoi_tco "" 0xffe48624 tco _REC_AXS_20_u1 19.05 _CNV_A_R_LINEAR_____11_CM 8 -48. 142.5 DISPLAY_IDENTIFIER LDPM_TCO__EOI_TCO FORMAT "%5.1" /end AXIS_PTS
/begin AXIS_PTS ldpm_tco_n_sp_2 "" 0xffe48689 tco _REC_AXS_20_u1 190.5 _CNV_A_R_LINEAR_____11_CM 8 -48. 142.5 DISPLAY_IDENTIFIER LDPM_TCO_N_SP_2 FORMAT "%5.1" /end AXIS_PTS
/begin AXIS_PTS ldpm_tco_n_sp_1 "" 0xffe48680 tco _REC_AXS_20_u1 190.5 _CNV_A_R_LINEAR_____11_CM 8 -48. 142.5 DISPLAY_IDENTIFIER LDPM_TCO_N_SP_1 FORMAT "%5.1" /end AXIS_PTS
/begin AXIS_PTS ldpm_t_ast_n_sp_1 "" 0xffe51d16 t_ast _REC_AXS_20_u2 6553.5 _CNV_A_R_LINEAR_____24_CM 8 0. 6553.5 DISPLAY_IDENTIFIER LDPM_T_AST_N_SP_1 FORMAT "%6.1" /end AXIS_PTS
/begin AXIS_PTS ldpm_ctr_km_can_n_sp_1 "" 0xffe517b8 ctr_km_can _REC_AXS_20_u2 655350. _CNV_A_R_LINEAR_____88_CM 4 0. 655350. DISPLAY_IDENTIFIER LDPM_CTR_KM_CAN_N_SP_1 FORMAT "%7.0" /end AXIS_PTS
/begin AXIS_PTS ldpm_toil_ip_n_sp_is_cs "" 0xffe486de toil _REC_AXS_20_u1 200. _CNV_A_R_LINEAR_____14_CM 8 -40. 160. DISPLAY_IDENTIFIER LDPM_TOIL_IP_N_SP_IS_CS FORMAT "%3.0" /end AXIS_PTS
/begin AXIS_PTS ldp_n_32_n_grd_thd "" 0xffe480eb n_32 _REC_AXS_20_u1 8160. _CNV_A_R_LINEAR_____15_CM 8 0. 8160. DISPLAY_IDENTIFIER LDP_N_32_N_GRD_THD FORMAT "%4.0" /end AXIS_PTS
/begin AXIS_PTS ldpm_gear "" 0xffe4836a gear _REC_AXS_20_u1 255. _CNV_A_R_LINEAR_____0_CM 9 0. 255. DISPLAY_IDENTIFIER LDPM_GEAR FORMAT "%3.0" /end AXIS_PTS
/begin AXIS_PTS ldp_pv_av__n_max_mtc_cur_off "" 0xffe41152 pv_av _REC_AXS_20_u1 99.609375 _CNV_A_R_LINEAR_____9_CM 4 0. 99.609375 DISPLAY_IDENTIFIER LDP_PV_AV__N_MAX_MTC_CUR_OFF FORMAT "%5.2" /end AXIS_PTS
/begin AXIS_PTS ldp_toil__n_max_2 "" 0xffe412b7 toil _REC_AXS_20_u1 200. _CNV_A_R_LINEAR_____14_CM 4 -40. 160. DISPLAY_IDENTIFIER LDP_TOIL__N_MAX_2 FORMAT "%3.0" /end AXIS_PTS
/begin AXIS_PTS ldp_toil__n_max_1 "" 0xffe412b2 toil _REC_AXS_20_u1 200. _CNV_A_R_LINEAR_____14_CM 4 -40. 160. DISPLAY_IDENTIFIER LDP_TOIL__N_MAX_1 FORMAT "%3.0" /end AXIS_PTS
/begin AXIS_PTS ldp_v_o3_x_ip_o3 "" 0xffe515a8 o3_conc_up _REC_AXS_20_u2 0.2497558595 _CNV_A_R_LINEAR_____3_CM 16 0. 4.99511719 DISPLAY_IDENTIFIER LDP_V_O3_X_IP_O3 FORMAT "%5.3" /end AXIS_PTS
/begin AXIS_PTS ldpm_o3_conc_up "" 0xffe485c5 o3_conc_up _REC_AXS_20_u1 51. _CNV_A_R_LINEAR_____431_CM 8 0. 1020. DISPLAY_IDENTIFIER LDPM_O3_CONC_UP FORMAT "%4.0" /end AXIS_PTS
/begin AXIS_PTS ldpm_n_32__lam_cat "" 0xffe413b8 n_32 _REC_AXS_20_u1 8160. _CNV_A_R_LINEAR_____15_CM 6 0. 8160. DISPLAY_IDENTIFIER LDPM_N_32__LAM_CAT FORMAT "%4.0" /end AXIS_PTS
/begin AXIS_PTS ldp_vls_down_ip_o2_cat "" 0xffe516b4 online_dummy _REC_AXS_20_u2 4.99511719 _CNV_A_R_LINEAR_____3_CM 12 0. 4.99511719 DISPLAY_IDENTIFIER LDP_VLS_DOWN_IP_O2_CAT FORMAT "%5.3" /end AXIS_PTS
/begin AXIS_PTS ldpm_n_32_1_egtr "" 0xffe41389 n_32 _REC_AXS_20_u1 8160. _CNV_A_R_LINEAR_____15_CM 6 0. 8160. DISPLAY_IDENTIFIER LDPM_N_32_1_EGTR FORMAT "%4.0" /end AXIS_PTS
/begin AXIS_PTS ldpm_maf_1_egtr "" 0xffe41364 maf _REC_AXS_20_u1 1389. _CNV_A_R_LINEAR_____27_CM 6 0. 1389. DISPLAY_IDENTIFIER LDPM_MAF_1_EGTR FORMAT "%4.0" /end AXIS_PTS
/begin AXIS_PTS ldp_toil_max__stop_dec_fsd "" 0xffe412ca toil_max _REC_AXS_20_u1 200. _CNV_A_R_LINEAR_____14_CM 4 -40. 160. DISPLAY_IDENTIFIER LDP_TOIL_MAX__STOP_DEC_FSD FORMAT "%3.0" /end AXIS_PTS
/begin AXIS_PTS ldp_tco_st__stop_inc_fsd "" 0xffe41219 tco_st _REC_AXS_20_u1 190.5 _CNV_A_R_LINEAR_____11_CM 4 -48. 142.5 DISPLAY_IDENTIFIER LDP_TCO_ST__STOP_INC_FSD FORMAT "%5.1" /end AXIS_PTS
/begin AXIS_PTS ldp_tco_st__t_st_eng_max "" 0xffe4121e tco_st _REC_AXS_20_u1 190.5 _CNV_A_R_LINEAR_____11_CM 4 -48. 142.5 DISPLAY_IDENTIFIER LDP_TCO_ST__T_ST_ENG_MAX FORMAT "%5.1" /end AXIS_PTS
/begin AXIS_PTS ldp_maf_kgh__t_plaus_ls_up "" 0xffe50e3a maf_kgh _REC_AXS_20_u2 2047.96875 _CNV_A_R_LINEAR_____115_CM 4 0. 2047.96875 DISPLAY_IDENTIFIER LDP_MAF_KGH__T_PLAUS_LS_UP FORMAT "%7.2" /end AXIS_PTS
/begin AXIS_PTS ldpm_n_32_ls_up_dyn "" 0xffe48552 n_32 _REC_AXS_20_u1 8160. _CNV_A_R_LINEAR_____15_CM 8 0. 8160. DISPLAY_IDENTIFIER LDPM_N_32_LS_UP_DYN FORMAT "%4.0" /end AXIS_PTS
/begin AXIS_PTS ldpm_maf_hb_ls_up_dyn "" 0xffe4840b maf _REC_AXS_20_u1 1389. _CNV_A_R_LINEAR_____27_CM 8 0. 1389. DISPLAY_IDENTIFIER LDPM_MAF_HB_LS_UP_DYN FORMAT "%4.0" /end AXIS_PTS
/begin AXIS_PTS ldp_maf_kgh__vls_down_max_cycnr "" 0xffe50e4e maf_kgh _REC_AXS_20_u2 2047.96875 _CNV_A_R_LINEAR_____115_CM 8 0. 2047.96875 DISPLAY_IDENTIFIER LDP_MAF_KGH__VLS_DOWN_MAX_CYCNR FORMAT "%7.2" /end AXIS_PTS
/begin AXIS_PTS ldp_maf_kgh__fac_maf_lsh_down "" 0xffe50e2c maf_kgh _REC_AXS_20_u2 2047.96875 _CNV_A_R_LINEAR_____115_CM 6 0. 2047.96875 DISPLAY_IDENTIFIER LDP_MAF_KGH__FAC_MAF_LSH_DOWN FORMAT "%7.2" /end AXIS_PTS
/begin AXIS_PTS ldp_ttip_ref_ls_down_ip_fac_teg "" 0xffe51560 online_dummy _REC_AXS_20_u2 2047. _CNV_A_R_LINEAR_____6_CM 8 0. 2047. DISPLAY_IDENTIFIER LDP_TTIP_REF_LS_DOWN_IP_FAC_TEG FORMAT "%7.2" /end AXIS_PTS
/begin AXIS_PTS ldpm_ar_red_tot_bas "" 0xffe51744 ar_red_tot_bas _REC_AXS_20_u2 58.592855 _CNV_A_R_LINEAR_____382_CM 6 0. 58.592855 DISPLAY_IDENTIFIER LDPM_AR_RED_TOT_BAS FORMAT "%7.4" /end AXIS_PTS
/begin AXIS_PTS ldp_opg_rel_st_ip_opg_sp_st_isa "" 0xffe51176 opg_rel_st _REC_AXS_20_u2 99.99847412 _CNV_A_R_LINEAR_____8_CM 12 0. 99.99847412 DISPLAY_IDENTIFIER LDP_OPG_REL_ST_IP_OPG_SP_ST_ISA /end AXIS_PTS
/begin AXIS_PTS ldp_amp_ip_fac_amp_opg_st_isa "" 0xffe509a6 amp _REC_AXS_20_u2 5434. _CNV_A_R_LINEAR_____49_CM 6 0. 5434. DISPLAY_IDENTIFIER LDP_AMP_IP_FAC_AMP_OPG_ST_ISA FORMAT "%7.2" /end AXIS_PTS
/begin AXIS_PTS ldp_tia_ip_fac_tia_opg_st_isa "" 0xffe41293 tia _REC_AXS_20_u1 190.5 _CNV_A_R_LINEAR_____11_CM 6 -48. 142.5 DISPLAY_IDENTIFIER LDP_TIA_IP_FAC_TIA_OPG_ST_ISA FORMAT "%5.1" /end AXIS_PTS
/begin AXIS_PTS ldp_pv_av_ip_opg_rel_st_isa_pv "" 0xffe4115e pv_av _REC_AXS_20_u1 99.609375 _CNV_A_R_LINEAR_____9_CM 6 0. 99.609375 DISPLAY_IDENTIFIER LDP_PV_AV_IP_OPG_REL_ST_ISA_PV FORMAT "%4.1" /end AXIS_PTS
/begin AXIS_PTS ldp_n_32__pv_lih_max "" 0xffe410a4 n_32 _REC_AXS_20_u1 816. _CNV_A_R_LINEAR_____15_CM 6 0. 8160. DISPLAY_IDENTIFIER LDP_N_32__PV_LIH_MAX FORMAT "%4.0" /end AXIS_PTS
/begin AXIS_PTS ldpm_vs_fil__pv_fac_cor "" 0xffe51ed6 vs_fil _REC_AXS_20_u2 51.199218 _CNV_A_R_LINEAR_____450_CM 8 0. 511.99218 DISPLAY_IDENTIFIER LDPM_VS_FIL__PV_FAC_COR FORMAT "%7.3" /end AXIS_PTS
/begin AXIS_PTS ldpm_n_dif__pv_fac_cor "" 0xffe51b2e n_dif _REC_AXS_20_u2 6553.5 _CNV_A_R_LINEAR_____207_CM 6 -32768. 32767. DISPLAY_IDENTIFIER LDPM_N_DIF__PV_FAC_COR FORMAT "%6.0" /end AXIS_PTS
/begin AXIS_PTS ldpm_n__pv_fac_cor "" 0xffe51b20 n _REC_AXS_20_u2 815.9 _CNV_A_R_LINEAR_____10_CM 6 1. 8160. DISPLAY_IDENTIFIER LDPM_N__PV_FAC_COR FORMAT "%4.0" /end AXIS_PTS
/begin AXIS_PTS ldpm_pv_av_raw__pv_fac_cor "" 0xffe4140e pv_av_raw _REC_AXS_20_u1 9.9609375 _CNV_A_R_LINEAR_____9_CM 6 0. 99.609375 DISPLAY_IDENTIFIER LDPM_PV_AV_RAW__PV_FAC_COR FORMAT "%4.1" /end AXIS_PTS
/begin AXIS_PTS ldpm_n_32__fac_tq_req_driv "" 0xffe484cd n_32 _REC_AXS_20_u1 8160. _CNV_A_R_LINEAR_____15_CM 8 0. 8160. DISPLAY_IDENTIFIER LDPM_N_32__FAC_TQ_REQ_DRIV FORMAT "%4.0" /end AXIS_PTS
/begin AXIS_PTS ldpm_fac_tq_cru_dcc "" 0xffe5185c fac_tq_req_cru _REC_AXS_20_u2 1.99996948 _CNV_A_R_LINEAR_____20_CM 8 0. 1.99996948 DISPLAY_IDENTIFIER LDPM_FAC_TQ_CRU_DCC FORMAT "%7.5" /end AXIS_PTS
/begin AXIS_PTS ldp_v_pvs_min "" 0xffe41d1c online_dummy _REC_AXS_20_u2 4.99511719 _CNV_A_R_LINEAR_____3_CM 2 0. 4.99511719 DISPLAY_IDENTIFIER LDP_V_PVS_MIN FORMAT "%5.3" /end AXIS_PTS
/begin AXIS_PTS ldp_pv_av_min_mon_ip_pv_mon "" 0xffe52274 pv_av_mon _REC_AXS_20_u1 99.609375 _CNV_A_R_LINEAR_____9_CM 6 0. 99.609375 DISPLAY_IDENTIFIER LDP_PV_AV_MIN_MON_IP_PV_MON FORMAT "%4.1" /end AXIS_PTS
/begin AXIS_PTS ldpm_tco_st_1_sair "" 0xffe486a4 tco_st _REC_AXS_20_u1 190.5 _CNV_A_R_LINEAR_____11_CM 8 -48. 142.5 DISPLAY_IDENTIFIER LDPM_TCO_ST_1_SAIR FORMAT "%5.1" /end AXIS_PTS
/begin AXIS_PTS ldpm_n_32_maf_sa_deac "" 0xffe48564 n_32 _REC_AXS_20_u1 8160. _CNV_A_R_LINEAR_____15_CM 8 0. 8160. DISPLAY_IDENTIFIER LDPM_N_32_MAF_SA_DEAC FORMAT "%4.0" /end AXIS_PTS
/begin AXIS_PTS ldpm_n_32_maf_sa_act "" 0xffe4855b n_32 _REC_AXS_20_u1 8160. _CNV_A_R_LINEAR_____15_CM 8 0. 8160. DISPLAY_IDENTIFIER LDPM_N_32_MAF_SA_ACT FORMAT "%4.0" /end AXIS_PTS
/begin AXIS_PTS ldp_ctr_km_can "" 0xffe50ad4 ctr_km_can _REC_AXS_20_u2 655350. _CNV_A_R_LINEAR_____88_CM 8 0. 655350. DISPLAY_IDENTIFIER LDP_CTR_KM_CAN FORMAT "%7.0" /end AXIS_PTS
/begin AXIS_PTS ldp_tco_st_id_t_dly_diag_sa "" 0xffe48278 tco_st _REC_AXS_20_u1 190.5 _CNV_A_R_LINEAR_____11_CM 8 -48. 142.5 DISPLAY_IDENTIFIER LDP_TCO_ST_ID_T_DLY_DIAG_SA FORMAT "%5.1" /end AXIS_PTS
/begin AXIS_PTS ldp_tia_id_tco_min_diag_sa "" 0xffe41285 tia _REC_AXS_20_u1 190.5 _CNV_A_R_LINEAR_____11_CM 6 -48. 142.5 DISPLAY_IDENTIFIER LDP_TIA_ID_TCO_MIN_DIAG_SA FORMAT "%5.1" /end AXIS_PTS
/begin AXIS_PTS ldpm_fac_amp "" 0xffe5182c fac_amp _REC_AXS_20_u2 1.99996948 _CNV_A_R_LINEAR_____20_CM 6 0. 1.99996948 DISPLAY_IDENTIFIER LDPM_FAC_AMP FORMAT "%7.5" /end AXIS_PTS
/begin AXIS_PTS ldp_n_32__maf_max_diag_sa "" 0xffe4806e n_32 _REC_AXS_20_u1 816. _CNV_A_R_LINEAR_____15_CM 8 0. 8160. DISPLAY_IDENTIFIER LDP_N_32__MAF_MAX_DIAG_SA FORMAT "%4.0" /end AXIS_PTS
/begin AXIS_PTS ldpm_n_32_id_saf_kgh_diag_min "" 0xffe4852f n_32 _REC_AXS_20_u1 8160. _CNV_A_R_LINEAR_____15_CM 8 0. 8160. DISPLAY_IDENTIFIER LDPM_N_32_ID_SAF_KGH_DIAG_MIN FORMAT "%4.0" /end AXIS_PTS
/begin AXIS_PTS ldpm_n_32_id_saf_kgh_diag_max "" 0xffe48526 n_32 _REC_AXS_20_u1 8160. _CNV_A_R_LINEAR_____15_CM 8 0. 8160. DISPLAY_IDENTIFIER LDPM_N_32_ID_SAF_KGH_DIAG_MAX FORMAT "%4.0" /end AXIS_PTS
/begin AXIS_PTS ldpm_maf_id_saf_kgh_diag_min "" 0xffe4841d maf _REC_AXS_20_u1 1389. _CNV_A_R_LINEAR_____27_CM 8 0. 1389. DISPLAY_IDENTIFIER LDPM_MAF_ID_SAF_KGH_DIAG_MIN FORMAT "%4.0" /end AXIS_PTS
/begin AXIS_PTS ldpm_maf_id_saf_kgh_diag_max "" 0xffe48414 maf _REC_AXS_20_u1 1389. _CNV_A_R_LINEAR_____27_CM 8 0. 1389. DISPLAY_IDENTIFIER LDPM_MAF_ID_SAF_KGH_DIAG_MAX FORMAT "%4.0" /end AXIS_PTS
/begin AXIS_PTS ldp_tco_st_id_sum_safm_diag "" 0xffe4826f tco_st _REC_AXS_20_u1 190.5 _CNV_A_R_LINEAR_____11_CM 8 -48. 142.5 DISPLAY_IDENTIFIER LDP_TCO_ST_ID_SUM_SAFM_DIAG FORMAT "%5.1" /end AXIS_PTS
/begin AXIS_PTS ldp_maf_cyl__saf_mdl "secondary air mass flow depending of MAF_CYL" 0xffe50d2a maf_cyl _REC_AXS_20_u2 2047.96875 _CNV_A_R_LINEAR_____115_CM 8 0. 2047.96875 DISPLAY_IDENTIFIER LDP_MAF_CYL__SAF_MDL FORMAT "%7.2" /end AXIS_PTS
/begin AXIS_PTS ldp_amp__saf_cor_amp "correction of secondary air mass flow depending of ambient pressure" 0xffe5097c amp _REC_AXS_20_u2 5434. _CNV_A_R_LINEAR_____49_CM 8 0. 5434. DISPLAY_IDENTIFIER LDP_AMP__SAF_COR_AMP FORMAT "%7.2" /end AXIS_PTS
/begin AXIS_PTS ldp_vb__saf_cor_vb "correction of secondary air mass flow depending of battery voltage" 0xffe48311 vb _REC_AXS_20_u1 26. _CNV_A_R_LINEAR_____60_CM 8 0. 26. DISPLAY_IDENTIFIER LDP_VB__SAF_COR_VB FORMAT "%4.1" /end AXIS_PTS
/begin AXIS_PTS ldp_tam_ip_saf_cor_tam "correction of secondary air mass flow depending of ambient temperature" 0xffe481a7 tia _REC_AXS_20_u1 190.5 _CNV_A_R_LINEAR_____11_CM 8 -48. 142.5 DISPLAY_IDENTIFIER LDP_TAM_IP_SAF_COR_TAM FORMAT "%5.1" /end AXIS_PTS
/begin AXIS_PTS ldp_maf_kgh__tco_sub_inc "" 0xffe50e44 maf_kgh _REC_AXS_20_u2 2047.96875 _CNV_A_R_LINEAR_____115_CM 4 0. 2047.96875 DISPLAY_IDENTIFIER LDP_MAF_KGH__TCO_SUB_INC FORMAT "%7.2" /end AXIS_PTS
/begin AXIS_PTS ldp_v_tco__tco "" 0xffe515ca online_dummy _REC_AXS_20_u2 4.425292971 _CNV_A_R_LINEAR_____466_CM 16 7.8125e-002 4.99511719 DISPLAY_IDENTIFIER LDP_V_TCO__TCO FORMAT "%5.3" /end AXIS_PTS
/begin AXIS_PTS ldpm_tco_st__tco_dif_diag "" 0xffe4145e tco_st _REC_AXS_20_u1 190.5 _CNV_A_R_LINEAR_____11_CM 6 -48. 142.5 DISPLAY_IDENTIFIER LDPM_TCO_ST__TCO_DIF_DIAG FORMAT "%5.1" /end AXIS_PTS
/begin AXIS_PTS ldp_tco_st_id_t_tco_min "Locking time after start for lambda activation monitoring" 0xffe41231 tco_st _REC_AXS_20_u1 190.5 _CNV_A_R_LINEAR_____11_CM 6 -48. 142.5 DISPLAY_IDENTIFIER LDP_TCO_ST_ID_T_TCO_MIN FORMAT "%5.1" /end AXIS_PTS
/begin AXIS_PTS ldpm_tia_1 "" 0xffe41473 tia _REC_AXS_20_u1 190.5 _CNV_A_R_LINEAR_____11_CM 6 -48. 142.5 DISPLAY_IDENTIFIER LDPM_TIA_1 FORMAT "%5.1" /end AXIS_PTS
/begin AXIS_PTS ldp_vs_fil__tq_gs_inc "" 0xffe51708 vs_fil _REC_AXS_20_u2 511.99218 _CNV_A_R_LINEAR_____85_CM 6 0. 511.99218 DISPLAY_IDENTIFIER LDP_VS_FIL__TQ_GS_INC FORMAT "%7.3" /end AXIS_PTS
/begin AXIS_PTS ldp_n_32__tq_gs_inc "" 0xffe410c5 n_32 _REC_AXS_20_u1 8160. _CNV_A_R_LINEAR_____15_CM 6 0. 8160. DISPLAY_IDENTIFIER LDP_N_32__TQ_GS_INC FORMAT "%4.0" /end AXIS_PTS
/begin AXIS_PTS ldp_v_tecu__tecu "" 0xffe515ec v_tecu _REC_AXS_20_u2 4.495605471 _CNV_A_R_LINEAR_____3_CM 16 0. 4.99511719 DISPLAY_IDENTIFIER LDP_V_TECU__TECU FORMAT "%5.3" /end AXIS_PTS
/begin AXIS_PTS ldp_v_teg__teg "" 0xffe5160e online_dummy _REC_AXS_20_u2 4.99511719 _CNV_A_R_LINEAR_____3_CM 16 0. 4.99511719 DISPLAY_IDENTIFIER LDP_V_TEG__TEG FORMAT "%5.3" /end AXIS_PTS
/begin AXIS_PTS ldpm_teg_stat_eng_pre "" 0xffe51daa online_dummy _REC_AXS_20_u2 1507.3 _CNV_A_R_LINEAR_____280_CM 6 -48. 1459.3 DISPLAY_IDENTIFIER LDPM_TEG_STAT_ENG_PRE FORMAT "%7.2" /end AXIS_PTS
/begin AXIS_PTS ldpm_egr_ratio__teg "" 0xffe5181e egr_ratio _REC_AXS_20_u2 99.99847412 _CNV_A_R_LINEAR_____8_CM 6 0. 99.99847412 DISPLAY_IDENTIFIER LDPM_EGR_RATIO__TEG /end AXIS_PTS
/begin AXIS_PTS ldpm_temp_toil_dif__fac_temp "" 0xffe51e50 temp_toil_dif _REC_AXS_20_u2 404. _CNV_A_R_LINEAR_____476_CM 6 -202. 202. DISPLAY_IDENTIFIER LDPM_TEMP_TOIL_DIF__FAC_TEMP FORMAT "%6.1" /end AXIS_PTS
/begin AXIS_PTS ldpm_lamb_sp_teg__fac_cor "" 0xffe5188a teg_1.appl_inc_struct.lamb_sp_teg _REC_AXS_20_u2 31.99902344 _CNV_A_R_LINEAR_____206_CM 16 0. 31.99902344 DISPLAY_IDENTIFIER LDPM_LAMB_SP_TEG__FAC_COR FORMAT "%7.4" /end AXIS_PTS
/begin AXIS_PTS ldpm_nr_cyl_scc_teg__fac_scc "" 0xffe485b6 teg_1.appl_inc_struct.nr_cyl_scc_teg _REC_AXS_20_u1 13. _CNV_A_R_LINEAR_____441_CM 14 0. 13. DISPLAY_IDENTIFIER LDPM_NR_CYL_SCC_TEG__FAC_SCC FORMAT "%4.1" /end AXIS_PTS
/begin AXIS_PTS ldpm_ecfpwm_ecf__fac_cor "" 0xffe41349 ecfpwm_ecf _REC_AXS_20_u1 99.609375 _CNV_A_R_LINEAR_____9_CM 6 0. 99.609375 DISPLAY_IDENTIFIER LDPM_ECFPWM_ECF__FAC_COR FORMAT "%4.1" /end AXIS_PTS
/begin AXIS_PTS ldp_teg_stat__fac_tam "" 0xffe51330 online_dummy _REC_AXS_20_u2 1507.3 _CNV_A_R_LINEAR_____280_CM 6 -48. 1459.3 DISPLAY_IDENTIFIER LDP_TEG_STAT__FAC_TAM FORMAT "%7.2" /end AXIS_PTS
/begin AXIS_PTS ldpm_tam_dew__fac_teg "" 0xffe4141b tam_dew _REC_AXS_20_u1 190.5 _CNV_A_R_LINEAR_____11_CM 6 -48. 142.5 DISPLAY_IDENTIFIER LDPM_TAM_DEW__FAC_TEG FORMAT "%5.1" /end AXIS_PTS
/begin AXIS_PTS ldpm_t_es_dew__fac_teg "" 0xffe51d28 t_es_dew _REC_AXS_20_u2 65535. _CNV_A_R_LINEAR_____97_CM 8 0. 65535. DISPLAY_IDENTIFIER LDPM_T_ES_DEW__FAC_TEG FORMAT "%5.0" /end AXIS_PTS
/begin AXIS_PTS ldpm_temp_toil_dif__crlc_teg "" 0xffe51e3e temp_toil_dif _REC_AXS_20_u2 404. _CNV_A_R_LINEAR_____476_CM 8 -202. 202. DISPLAY_IDENTIFIER LDPM_TEMP_TOIL_DIF__CRLC_TEG FORMAT "%6.1" /end AXIS_PTS
/begin AXIS_PTS ldpm_temp_tco_dif__crlc_teg "" 0xffe51e2c temp_tco_dif _REC_AXS_20_u2 404. _CNV_A_R_LINEAR_____477_CM 8 -202. 202. DISPLAY_IDENTIFIER LDPM_TEMP_TCO_DIF__CRLC_TEG FORMAT "%6.1" /end AXIS_PTS
/begin AXIS_PTS ldpm_maf_int_puc__crlc_teg "" 0xffe51964 online_dummy _REC_AXS_20_u2 1820.398 _CNV_A_R_LINEAR_____287_CM 8 0. 1820.398 DISPLAY_IDENTIFIER LDPM_MAF_INT_PUC__CRLC_TEG FORMAT "%7.2" /end AXIS_PTS
/begin AXIS_PTS ldpm_n_teg__vs_teg "" 0xffe51c28 n_teg _REC_AXS_20_u2 8160. _CNV_A_R_LINEAR_____10_CM 8 0. 8160. DISPLAY_IDENTIFIER LDPM_N_TEG__VS_TEG FORMAT "%4.0" /end AXIS_PTS
/begin AXIS_PTS ldpm_tco_st__dew "" 0xffe486b6 tco_st _REC_AXS_20_u1 190.5 _CNV_A_R_LINEAR_____11_CM 8 -48. 142.5 DISPLAY_IDENTIFIER LDPM_TCO_ST__DEW FORMAT "%5.1" /end AXIS_PTS
/begin AXIS_PTS ldpm_teg_wall_cat_up_mdl_1 "" 0xffe51dca online_dummy _REC_AXS_20_u2 1507.3 _CNV_A_R_LINEAR_____280_CM 8 -48. 1459.3 DISPLAY_IDENTIFIER LDPM_TEG_WALL_CAT_UP_MDL_1 FORMAT "%7.2" /end AXIS_PTS
/begin AXIS_PTS ldpm_teg_wall_cat_down_mdl_1 "" 0xffe51db8 online_dummy _REC_AXS_20_u2 1507.3 _CNV_A_R_LINEAR_____280_CM 8 -48. 1459.3 DISPLAY_IDENTIFIER LDPM_TEG_WALL_CAT_DOWN_MDL_1 FORMAT "%7.2" /end AXIS_PTS
/begin AXIS_PTS ldp_vs__fac_vs_teg "" 0xffe412f9 vs _REC_AXS_20_u1 255. _CNV_A_R_LINEAR_____23_CM 6 0. 255. DISPLAY_IDENTIFIER LDP_VS__FAC_VS_TEG FORMAT "%3.0" /end AXIS_PTS
/begin AXIS_PTS ldp_pow_dif_max__add_teg_iga "" 0xffe511a2 pow_dif_max _REC_AXS_20_u2 434.0555000000001 _CNV_A_R_LINEAR_____479_CM 6 0. 434.0555 DISPLAY_IDENTIFIER LDP_POW_DIF_MAX__ADD_TEG_IGA FORMAT "%7.3" /end AXIS_PTS
/begin AXIS_PTS ldpm_vo_dif_teg__teg_stat "" 0xffe51eb6 vo_dif_teg _REC_AXS_20_u2 191.25 _CNV_A_R_LINEAR_____480_CM 6 -95.625 95.625 DISPLAY_IDENTIFIER LDPM_VO_DIF_TEG__TEG_STAT FORMAT "%5.1" /end AXIS_PTS
/begin AXIS_PTS ldpm_eff_iga_av_teg_cor "" 0xffe51802 online_dummy _REC_AXS_20_u2 1.99996948 _CNV_A_R_LINEAR_____20_CM 8 0. 1.99996948 DISPLAY_IDENTIFIER LDPM_EFF_IGA_AV_TEG_COR FORMAT "%7.5" /end AXIS_PTS
/begin AXIS_PTS ldpm_teg_stat__crlc_dec "" 0xffe51d76 online_dummy _REC_AXS_20_u2 1507.3 _CNV_A_R_LINEAR_____280_CM 12 -48. 1459.3 DISPLAY_IDENTIFIER LDPM_TEG_STAT__CRLC_DEC FORMAT "%7.2" /end AXIS_PTS
/begin AXIS_PTS ldpm_teg_wall_stat__crlc_dec "" 0xffe51ddc online_dummy _REC_AXS_20_u2 1507.3 _CNV_A_R_LINEAR_____280_CM 12 -48. 1459.3 DISPLAY_IDENTIFIER LDPM_TEG_WALL_STAT__CRLC_DEC FORMAT "%7.2" /end AXIS_PTS
/begin AXIS_PTS ldpm_teg_stat__crlc_inc "" 0xffe51d90 online_dummy _REC_AXS_20_u2 1507.3 _CNV_A_R_LINEAR_____280_CM 12 -48. 1459.3 DISPLAY_IDENTIFIER LDPM_TEG_STAT__CRLC_INC FORMAT "%7.2" /end AXIS_PTS
/begin AXIS_PTS ldpm_teg_wall_stat__crlc_inc "" 0xffe51df6 online_dummy _REC_AXS_20_u2 1507.3 _CNV_A_R_LINEAR_____280_CM 12 -48. 1459.3 DISPLAY_IDENTIFIER LDPM_TEG_WALL_STAT__CRLC_INC FORMAT "%7.2" /end AXIS_PTS
/begin AXIS_PTS ldpm_maf_teg__vs_teg "" 0xffe519ec maf_teg _REC_AXS_20_u2 1389. _CNV_A_R_LINEAR_____108_CM 8 0. 1389. DISPLAY_IDENTIFIER LDPM_MAF_TEG__VS_TEG FORMAT "%7.2" /end AXIS_PTS
/begin AXIS_PTS ldpm_vs__fac_cor_vs_teg_ecf "" 0xffe4148f vs _REC_AXS_20_u1 255. _CNV_A_R_LINEAR_____23_CM 6 0. 255. DISPLAY_IDENTIFIER LDPM_VS__FAC_COR_VS_TEG_ECF FORMAT "%3.0" /end AXIS_PTS
/begin AXIS_PTS ldpm_vs_cor_teg__fac_cor "" 0xffe41496 online_dummy _REC_AXS_20_u1 255. _CNV_A_R_LINEAR_____23_CM 6 0. 255. DISPLAY_IDENTIFIER LDPM_VS_COR_TEG__FAC_COR FORMAT "%3.0" /end AXIS_PTS
/begin AXIS_PTS ldp_vs_cor_teg_up_1__fac_cor "" 0xffe41306 teg_1.gas_up_struct.vs_cor_teg_up _REC_AXS_20_u1 255. _CNV_A_R_LINEAR_____23_CM 6 0. 255. DISPLAY_IDENTIFIER LDP_VS_COR_TEG_UP_1__FAC_COR FORMAT "%3.0" /end AXIS_PTS
/begin AXIS_PTS ldpm_vs__fac_cor_vs_teg "" 0xffe41488 vs _REC_AXS_20_u1 255. _CNV_A_R_LINEAR_____23_CM 6 0. 255. DISPLAY_IDENTIFIER LDPM_VS__FAC_COR_VS_TEG FORMAT "%3.0" /end AXIS_PTS
/begin AXIS_PTS ldpm_maf_teg__teg_stat "" 0xffe519da maf_teg _REC_AXS_20_u2 1389. _CNV_A_R_LINEAR_____108_CM 8 0. 1389. DISPLAY_IDENTIFIER LDPM_MAF_TEG__TEG_STAT FORMAT "%7.2" /end AXIS_PTS
/begin AXIS_PTS ldpm_n_teg__teg_stat "" 0xffe51c16 n_teg _REC_AXS_20_u2 8160. _CNV_A_R_LINEAR_____10_CM 8 0. 8160. DISPLAY_IDENTIFIER LDPM_N_TEG__TEG_STAT FORMAT "%4.0" /end AXIS_PTS
/begin AXIS_PTS ldpm_saf_kgh__fac_cor_saf "" 0xffe51cb6 saf_kgh _REC_AXS_20_u2 1023.984375 _CNV_A_R_LINEAR_____47_CM 6 0. 1023.984375 DISPLAY_IDENTIFIER LDPM_SAF_KGH__FAC_COR_SAF FORMAT "%7.2" /end AXIS_PTS
/begin AXIS_PTS ldpm_tco__fac_cor_tco_teg "" 0xffe41433 tco _REC_AXS_20_u1 190.5 _CNV_A_R_LINEAR_____11_CM 6 -48. 142.5 DISPLAY_IDENTIFIER LDPM_TCO__FAC_COR_TCO_TEG FORMAT "%5.1" /end AXIS_PTS
/begin AXIS_PTS ldpm_tco__tco_eff_iga_teg "" 0xffe41446 tco _REC_AXS_20_u1 190.5 _CNV_A_R_LINEAR_____11_CM 6 -48. 142.5 DISPLAY_IDENTIFIER LDPM_TCO__TCO_EFF_IGA_TEG FORMAT "%5.1" /end AXIS_PTS
/begin AXIS_PTS ldpm_n_teg__crlc_teg "" 0xffe51c04 n_teg _REC_AXS_20_u2 8160. _CNV_A_R_LINEAR_____10_CM 8 0. 8160. DISPLAY_IDENTIFIER LDPM_N_TEG__CRLC_TEG FORMAT "%4.0" /end AXIS_PTS
/begin AXIS_PTS ldp_r_up_ls_ip_ttip_ls_up "" 0xffe51264 online_dummy _REC_AXS_20_u2 16383.75 _CNV_A_R_LINEAR_____304_CM 8 0. 16383.75 DISPLAY_IDENTIFIER LDP_R_UP_LS_IP_TTIP_LS_UP FORMAT "%8.1" /end AXIS_PTS
/begin AXIS_PTS ldp_maf_kgh_sp__amp_dec "" 0xffe50e94 maf_kgh_sp _REC_AXS_20_u2 2047.96875 _CNV_A_R_LINEAR_____115_CM 4 0. 2047.96875 DISPLAY_IDENTIFIER LDP_MAF_KGH_SP__AMP_DEC FORMAT "%6.2" /end AXIS_PTS
/begin AXIS_PTS ldp_maf_sp__tps_sp_mdl_max "" 0xffe50eba maf_sp _REC_AXS_20_u2 1389. _CNV_A_R_LINEAR_____108_CM 4 0. 1389. DISPLAY_IDENTIFIER LDP_MAF_SP__TPS_SP_MDL_MAX FORMAT "%7.2" /end AXIS_PTS
/begin AXIS_PTS ldp_n_32__tps_sp_mdl_max "" 0xffe4809a n_32 _REC_AXS_20_u1 816. _CNV_A_R_LINEAR_____15_CM 8 0. 8160. DISPLAY_IDENTIFIER LDP_N_32__TPS_SP_MDL_MAX FORMAT "%4.0" /end AXIS_PTS
/begin AXIS_PTS ldp_pq_sp__crlc_ar_red_sp "" 0xffe511ee pq_sp _REC_AXS_20_u2 0.99998474 _CNV_A_R_LINEAR_____37_CM 8 0. 0.99998474 DISPLAY_IDENTIFIER LDP_PQ_SP__CRLC_AR_RED_SP FORMAT "%7.5" /end AXIS_PTS
/begin AXIS_PTS ldp_pq_sp_isa "" 0xffe51200 pq_sp_isa _REC_AXS_20_u2 0.99998474 _CNV_A_R_LINEAR_____37_CM 8 0. 0.99998474 DISPLAY_IDENTIFIER LDP_PQ_SP_ISA FORMAT "%7.5" /end AXIS_PTS
/begin AXIS_PTS ldp_ar_red_isa_sp_mmv "" 0xffe50a3a ar_red_isa_sp_mmv _REC_AXS_20_u2 58.592855 _CNV_A_R_LINEAR_____382_CM 16 0. 58.592855 DISPLAY_IDENTIFIER LDP_AR_RED_ISA_SP_MMV FORMAT "%7.4" /end AXIS_PTS
/begin AXIS_PTS ldp_maf_turb_ratio "" 0xffe47fd3 maf_turb_ratio _REC_AXS_20_u1 0.99610001 _CNV_A_R_LINEAR_____29_CM 8 0. 0.99610001 DISPLAY_IDENTIFIER LDP_MAF_TURB_RATIO FORMAT "%5.3" /end AXIS_PTS
/begin AXIS_PTS ldpm_vb_1 "" 0xffe48701 vb _REC_AXS_20_u1 25.8984 _CNV_A_R_LINEAR_____34_CM 8 0. 25.8984 DISPLAY_IDENTIFIER LDPM_VB_1 FORMAT "%3.1" /end AXIS_PTS
/begin AXIS_PTS ldp_n_32__isapwm_isa_pwl "" 0xffe4109f n_32 _REC_AXS_20_u1 8160. _CNV_A_R_LINEAR_____15_CM 4 0. 8160. DISPLAY_IDENTIFIER LDP_N_32__ISAPWM_ISA_PWL FORMAT "%4.0" /end AXIS_PTS
/begin AXIS_PTS ldp_isapwm_cor_isa__isapwm_isa "" 0xffe50c00 isapwm_cor_isa _REC_AXS_20_u2 99.99847412 _CNV_A_R_LINEAR_____8_CM 8 0. 99.99847412 DISPLAY_IDENTIFIER LDP_ISAPWM_COR_ISA__ISAPWM_ISA /end AXIS_PTS
/begin AXIS_PTS ldp_ar_red_sp_mmv "" 0xffe50a5c ar_red_sp_mmv _REC_AXS_20_u2 58.592855 _CNV_A_R_LINEAR_____382_CM 16 0. 58.592855 DISPLAY_IDENTIFIER LDP_AR_RED_SP_MMV FORMAT "%7.4" /end AXIS_PTS
/begin AXIS_PTS ldp_n_ip_fac_maf_dif_sp "" 0xffe51094 n _REC_AXS_20_u2 8160. _CNV_A_R_LINEAR_____10_CM 8 0. 8160. DISPLAY_IDENTIFIER LDP_N_IP_FAC_MAF_DIF_SP FORMAT "%4.0" /end AXIS_PTS
/begin AXIS_PTS ldp_maf_dif_sp_cor_ip_maf_add "" 0xffe50d88 online_dummy _REC_AXS_20_u2 16383.75 _CNV_A_R_LINEAR_____489_CM 8 -8192. 8191.75 DISPLAY_IDENTIFIER LDP_MAF_DIF_SP_COR_IP_MAF_ADD FORMAT "%8.2" /end AXIS_PTS
/begin AXIS_PTS ldp_pq_sp_wout_maf_add_ip_fac "" 0xffe51212 pq_sp_wout_maf_add _REC_AXS_20_u2 0.99998474 _CNV_A_R_LINEAR_____37_CM 8 0. 0.99998474 DISPLAY_IDENTIFIER LDP_PQ_SP_WOUT_MAF_ADD_IP_FAC FORMAT "%7.6" /end AXIS_PTS
/begin AXIS_PTS ldp_eoi__prs_inc_cmp "" 0xffe50b70 online_dummy _REC_AXS_20_u2 36. _CNV_A_R_LINEAR_____82_CM 12 0. 720. DISPLAY_IDENTIFIER LDP_EOI__PRS_INC_CMP FORMAT "%6.2" /end AXIS_PTS
/begin AXIS_PTS ldp_crk_inj__prs_inc_cmp "" 0xffe50ab2 online_dummy _REC_AXS_20_u2 30. _CNV_A_R_LINEAR_____82_CM 16 0. 600. DISPLAY_IDENTIFIER LDP_CRK_INJ__PRS_INC_CMP FORMAT "%5.1" /end AXIS_PTS
/begin AXIS_PTS ldpm_prs_dec_inj__fac_ti_prs "" 0xffe51c9c fup _REC_AXS_20_u2 173888. _CNV_A_R_LINEAR_____199_CM 12 0. 173888. DISPLAY_IDENTIFIER LDPM_PRS_DEC_INJ__FAC_TI_PRS FORMAT "%6.0" /end AXIS_PTS
/begin AXIS_PTS ldp_amp_mes_ti_st_amp_fac "" 0xffe509ec amp_mes _REC_AXS_20_u2 5434. _CNV_A_R_LINEAR_____49_CM 6 0. 5434. DISPLAY_IDENTIFIER LDP_AMP_MES_TI_ST_AMP_FAC FORMAT "%7.2" /end AXIS_PTS
/begin AXIS_PTS ldp_tco__mff_lgrd_ast "" 0xffe481dd tco _REC_AXS_20_u1 190.5 _CNV_A_R_LINEAR_____11_CM 8 -48. 142.5 DISPLAY_IDENTIFIER LDP_TCO__MFF_LGRD_AST FORMAT "%5.1" /end AXIS_PTS
/begin AXIS_PTS ldp_cyc__mff_cst "" 0xffe41010 NO_INPUT_QUANTITY _REC_AXS_20_u1 255. _CNV_A_R_LINEAR_____0_CM 4 0. 255. DISPLAY_IDENTIFIER LDP_CYC__MFF_CST FORMAT "%3.0" /end AXIS_PTS
/begin AXIS_PTS ldp_cyc_cast_ip_ti_deac_cast "" 0xffe50ae6 cyc_cast _REC_AXS_20_u2 65535. _CNV_A_R_LINEAR_____0_CM 8 0. 65535. DISPLAY_IDENTIFIER LDP_CYC_CAST_IP_TI_DEAC_CAST FORMAT "%5.0" /end AXIS_PTS
/begin AXIS_PTS ldp_n_tooth__mff_cst "" 0xffe41d0e n_tooth _REC_AXS_20_u2 816. _CNV_A_R_LINEAR_____10_CM 3 0. 8160. DISPLAY_IDENTIFIER LDP_N_TOOTH__MFF_CST FORMAT "%4.0" /end AXIS_PTS
/begin AXIS_PTS ldp_tia_ip_ti_cast "" 0xffe412a1 tia _REC_AXS_20_u1 28.575 _CNV_A_R_LINEAR_____11_CM 2 -48. 142.5 DISPLAY_IDENTIFIER LDP_TIA_IP_TI_CAST FORMAT "%5.1" /end AXIS_PTS
/begin AXIS_PTS ldp_fac_cor_ti_cast "" 0xffe41023 online_dummy _REC_AXS_20_u1 0.298830003 _CNV_A_R_LINEAR_____39_CM 4 0. 1.99220002 DISPLAY_IDENTIFIER LDP_FAC_COR_TI_CAST FORMAT "%5.3" /end AXIS_PTS
/begin AXIS_PTS ldp_map__ti_cast_fac_map "" 0xffe50ee0 map _REC_AXS_20_u2 815.1 _CNV_A_R_LINEAR_____49_CM 6 0. 5434. DISPLAY_IDENTIFIER LDP_MAP__TI_CAST_FAC_MAP FORMAT "%7.2" /end AXIS_PTS
/begin AXIS_PTS ldpm_tco__mff_cst "" 0xffe4863f tco _REC_AXS_20_u1 19.05 _CNV_A_R_LINEAR_____11_CM 8 -48. 142.5 DISPLAY_IDENTIFIER LDPM_TCO__MFF_CST FORMAT "%5.1" /end AXIS_PTS
/begin AXIS_PTS ldpm_tco__mff_deac_cst "" 0xffe48648 tco _REC_AXS_20_u1 19.05 _CNV_A_R_LINEAR_____11_CM 10 -48. 142.5 DISPLAY_IDENTIFIER LDPM_TCO__MFF_DEAC_CST FORMAT "%5.1" /end AXIS_PTS
/begin AXIS_PTS ldp_vb__ti_add_dly "" 0xffe4831a vb _REC_AXS_20_u1 3.107808 _CNV_A_R_LINEAR_____34_CM 8 0. 25.8984 DISPLAY_IDENTIFIER LDP_VB__TI_ADD_DLY FORMAT "%3.1" /end AXIS_PTS
/begin AXIS_PTS ldp_fup_map_dif__ti_add_dly "Injector dead time correction" 0xffe50bde fup _REC_AXS_20_u2 17388.8 _CNV_A_R_LINEAR_____199_CM 6 0. 173888. DISPLAY_IDENTIFIER LDP_FUP_MAP_DIF__TI_ADD_DLY FORMAT "%6.0" /end AXIS_PTS
/begin AXIS_PTS ldp_vlft_av__cam_op_in_vvl "" 0xffe51650 online_dummy _REC_AXS_20_u2 65.535 _CNV_A_R_LINEAR_____494_CM 6 0. 65.535 DISPLAY_IDENTIFIER LDP_VLFT_AV__CAM_OP_IN_VVL /end AXIS_PTS
/begin AXIS_PTS ldp_n_32__eoi_bas "" 0xffe47fee n_32 _REC_AXS_20_u1 816. _CNV_A_R_LINEAR_____15_CM 12 0. 8160. DISPLAY_IDENTIFIER LDP_N_32__EOI_BAS FORMAT "%4.0" /end AXIS_PTS
/begin AXIS_PTS ldp_n_32__eoi_bas_is "" 0xffe4108b n_32 _REC_AXS_20_u1 816. _CNV_A_R_LINEAR_____15_CM 6 0. 8160. DISPLAY_IDENTIFIER LDP_N_32__EOI_BAS_IS FORMAT "%4.0" /end AXIS_PTS
/begin AXIS_PTS ldp_ti_hom__eoi_bas "" 0xffe51364 ti_hom_1 _REC_AXS_20_u2 26.214 _CNV_A_R_LINEAR_____165_CM 10 0. 262.14 DISPLAY_IDENTIFIER LDP_TI_HOM__EOI_BAS FORMAT "%7.3" /end AXIS_PTS
/begin AXIS_PTS ldp_ti_hom__eoi_bas_is "" 0xffe5137a ti_hom_1 _REC_AXS_20_u2 26.214 _CNV_A_R_LINEAR_____165_CM 6 0. 262.14 DISPLAY_IDENTIFIER LDP_TI_HOM__EOI_BAS_IS FORMAT "%7.3" /end AXIS_PTS
/begin AXIS_PTS ldp_tco__eoi_min_tipr "" 0xffe481b0 tco _REC_AXS_20_u1 190.5 _CNV_A_R_LINEAR_____11_CM 8 -48. 142.5 DISPLAY_IDENTIFIER LDP_TCO__EOI_MIN_TIPR FORMAT "%5.1" /end AXIS_PTS
/begin AXIS_PTS ldp_cycnr_cst__fac_tipr_deac "" 0xffe4101c cycnr_cst _REC_AXS_20_u1 7. _CNV_A_R_LINEAR_____0_CM 6 0. 7. DISPLAY_IDENTIFIER LDP_CYCNR_CST__FAC_TIPR_DEAC FORMAT "%2.0" /end AXIS_PTS
/begin AXIS_PTS ldp_tco__mffpr_cst "" 0xffe481e6 tco _REC_AXS_20_u1 190.5 _CNV_A_R_LINEAR_____11_CM 8 -48. 142.5 DISPLAY_IDENTIFIER LDP_TCO__MFFPR_CST FORMAT "%5.1" /end AXIS_PTS
/begin AXIS_PTS ldp_tco__mffpr_fac_st_es "" 0xffe481ef tco _REC_AXS_20_u1 190.5 _CNV_A_R_LINEAR_____11_CM 8 -48. 142.5 DISPLAY_IDENTIFIER LDP_TCO__MFFPR_FAC_ST_ES FORMAT "%5.1" /end AXIS_PTS
/begin AXIS_PTS ldpm_tco__ti_st_rest "" 0xffe4865c tco _REC_AXS_20_u1 28.575 _CNV_A_R_LINEAR_____11_CM 8 -48. 142.5 DISPLAY_IDENTIFIER LDPM_TCO__TI_ST_REST FORMAT "%5.1" /end AXIS_PTS
/begin AXIS_PTS ldp_tco_stop__fac_rest "" 0xffe4828a tco_stop _REC_AXS_20_u1 28.575 _CNV_A_R_LINEAR_____11_CM 8 -48. 142.5 DISPLAY_IDENTIFIER LDP_TCO_STOP__FAC_REST FORMAT "%5.1" /end AXIS_PTS
/begin AXIS_PTS ldpm_tco__fac_stall "" 0xffe48636 tco _REC_AXS_20_u1 28.575 _CNV_A_R_LINEAR_____11_CM 8 -48. 142.5 DISPLAY_IDENTIFIER LDPM_TCO__FAC_STALL FORMAT "%5.1" /end AXIS_PTS
/begin AXIS_PTS ldp_t_es__rest "" 0xffe512dc t_es _REC_AXS_20_u2 9830.25 _CNV_A_R_LINEAR_____97_CM 8 0. 65535. DISPLAY_IDENTIFIER LDP_T_ES__REST FORMAT "%5.0" /end AXIS_PTS
/begin AXIS_PTS ldp_t_ast_rest "" 0xffe512bc t_ast_rest _REC_AXS_20_u2 983.025 _CNV_A_R_LINEAR_____24_CM 8 0. 6553.5 DISPLAY_IDENTIFIER LDP_T_AST_REST FORMAT "%6.1" /end AXIS_PTS
/begin AXIS_PTS ldpm_maf_hb__ti_wup "" 0xffe48402 maf _REC_AXS_20_u1 1389. _CNV_A_R_LINEAR_____27_CM 8 0. 1389. DISPLAY_IDENTIFIER LDPM_MAF_HB__TI_WUP FORMAT "%4.0" /end AXIS_PTS
/begin AXIS_PTS ldpm_tco__ti_wup "" 0xffe48665 tco _REC_AXS_20_u1 190.5 _CNV_A_R_LINEAR_____11_CM 8 -48. 142.5 DISPLAY_IDENTIFIER LDPM_TCO__TI_WUP FORMAT "%5.1" /end AXIS_PTS
/begin AXIS_PTS ldp_tco_st__ti_tco_wup "" 0xffe41223 tco_st _REC_AXS_20_u1 190.5 _CNV_A_R_LINEAR_____11_CM 3 -48. 142.5 DISPLAY_IDENTIFIER LDP_TCO_ST__TI_TCO_WUP FORMAT "%5.1" /end AXIS_PTS
/begin AXIS_PTS ldp_vo__ti_vo_wup "" 0xffe4832c vo _REC_AXS_20_u1 95.625 _CNV_A_R_LINEAR_____82_CM 8 0. 95.625 DISPLAY_IDENTIFIER LDP_VO__TI_VO_WUP FORMAT "%5.2" /end AXIS_PTS
/begin AXIS_PTS ldpm_n_32__ti_wup "" 0xffe484f5 n_32 _REC_AXS_20_u1 8160. _CNV_A_R_LINEAR_____15_CM 8 0. 8160. DISPLAY_IDENTIFIER LDPM_N_32__TI_WUP FORMAT "%4.0" /end AXIS_PTS
/begin AXIS_PTS ldp_map_dif__fac_ti_vo_wup "" 0xffe50f00 online_dummy _REC_AXS_20_u2 5434. _CNV_A_R_LINEAR_____49_CM 8 0. 5434. DISPLAY_IDENTIFIER LDP_MAP_DIF__FAC_TI_VO_WUP FORMAT "%7.2" /end AXIS_PTS
/begin AXIS_PTS ldp_map__ti_fac_n_map "" 0xffe50eee map _REC_AXS_20_u2 5434. _CNV_A_R_LINEAR_____49_CM 8 0. 5434. DISPLAY_IDENTIFIER LDP_MAP__TI_FAC_N_MAP FORMAT "%7.2" /end AXIS_PTS
/begin AXIS_PTS ldp_n_32__ti_fac_n_map "" 0xffe48091 n_32 _REC_AXS_20_u1 8160. _CNV_A_R_LINEAR_____15_CM 8 0. 8160. DISPLAY_IDENTIFIER LDP_N_32__TI_FAC_N_MAP FORMAT "%4.0" /end AXIS_PTS
/begin AXIS_PTS ldp_toil_ti_fac_tia_toil "" 0xffe412cf toil _REC_AXS_20_u1 200. _CNV_A_R_LINEAR_____14_CM 6 -40. 160. DISPLAY_IDENTIFIER LDP_TOIL_TI_FAC_TIA_TOIL FORMAT "%3.0" /end AXIS_PTS
/begin AXIS_PTS ldp_tia_ti_fac_tia_toil "" 0xffe412ab tia _REC_AXS_20_u1 190.5 _CNV_A_R_LINEAR_____11_CM 6 -48. 142.5 DISPLAY_IDENTIFIER LDP_TIA_TI_FAC_TIA_TOIL FORMAT "%5.1" /end AXIS_PTS
/begin AXIS_PTS ldp_tco__ti_fac_tco "" 0xffe411fa tco _REC_AXS_20_u1 190.5 _CNV_A_R_LINEAR_____11_CM 3 -48. 142.5 DISPLAY_IDENTIFIER LDP_TCO__TI_FAC_TCO FORMAT "%5.1" /end AXIS_PTS
/begin AXIS_PTS ldp_v_tia_tia "" 0xffe482e6 v_tia _REC_AXS_20_u1 4.447265625 _CNV_A_R_LINEAR_____496_CM 16 3.90625e-002 4.98046875 DISPLAY_IDENTIFIER LDP_V_TIA_TIA FORMAT "%5.3" /end AXIS_PTS
/begin AXIS_PTS ldpm_tco__reac "" 0xffe48653 tco _REC_AXS_20_u1 190.5 _CNV_A_R_LINEAR_____11_CM 8 -48. 142.5 DISPLAY_IDENTIFIER LDPM_TCO__REAC FORMAT "%5.1" /end AXIS_PTS
/begin AXIS_PTS ldp_map__fac_mff_map_wf "" 0xffe50ed6 map _REC_AXS_20_u2 5434. _CNV_A_R_LINEAR_____49_CM 4 0. 5434. DISPLAY_IDENTIFIER LDP_MAP__FAC_MFF_MAP_WF FORMAT "%7.2" /end AXIS_PTS
/begin AXIS_PTS ldpm_n_32__reac "" 0xffe484ec n_32 _REC_AXS_20_u1 8160. _CNV_A_R_LINEAR_____15_CM 8 0. 8160. DISPLAY_IDENTIFIER LDPM_N_32__REAC FORMAT "%4.0" /end AXIS_PTS
/begin AXIS_PTS ldpm_cycnr_reac__reac "" 0xffe48359 online_dummy _REC_AXS_20_u1 15. _CNV_A_R_LINEAR_____0_CM 16 1. 16. DISPLAY_IDENTIFIER LDPM_CYCNR_REAC__REAC FORMAT "%2.0" /end AXIS_PTS
/begin AXIS_PTS ldp_tco_ip_tmag_ivvt "" 0xffe48237 tco _REC_AXS_20_u1 190.5 _CNV_A_R_LINEAR_____11_CM 10 -48. 142.5 DISPLAY_IDENTIFIER LDP_TCO_IP_TMAG_IVVT FORMAT "%6.2" /end AXIS_PTS
/begin AXIS_PTS ldp_toil_ip_tmag_ivvt "" 0xffe482ae toil _REC_AXS_20_u1 200. _CNV_A_R_LINEAR_____14_CM 10 -40. 160. DISPLAY_IDENTIFIER LDP_TOIL_IP_TMAG_IVVT FORMAT "%3.0" /end AXIS_PTS
/begin AXIS_PTS ldp_pv_av_ip_tps_sp_st_pv "" 0xffe41165 pv_av _REC_AXS_20_u1 99.609375 _CNV_A_R_LINEAR_____9_CM 6 0. 99.609375 DISPLAY_IDENTIFIER LDP_PV_AV_IP_TPS_SP_ST_PV FORMAT "%4.1" /end AXIS_PTS
/begin AXIS_PTS ldp_tia_ip_fac_tia_tps_sp_st "" 0xffe4129a tia _REC_AXS_20_u1 190.5 _CNV_A_R_LINEAR_____11_CM 6 -48. 142.5 DISPLAY_IDENTIFIER LDP_TIA_IP_FAC_TIA_TPS_SP_ST FORMAT "%5.1" /end AXIS_PTS
/begin AXIS_PTS ldp_amp_ip_tps_sp_st_amp "" 0xffe509de amp _REC_AXS_20_u2 5434. _CNV_A_R_LINEAR_____49_CM 6 0. 5434. DISPLAY_IDENTIFIER LDP_AMP_IP_TPS_SP_ST_AMP FORMAT "%7.2" /end AXIS_PTS
/begin AXIS_PTS ldp_tps_rel_st_ip_tps_sp_st "" 0xffe513fc tps_rel_st _REC_AXS_20_u2 99.99847412 _CNV_A_R_LINEAR_____8_CM 12 0. 99.99847412 DISPLAY_IDENTIFIER LDP_TPS_REL_ST_IP_TPS_SP_ST /end AXIS_PTS
/begin AXIS_PTS ldpm_tco__fac_tco_tqi "" 0xffe4143a tco _REC_AXS_20_u1 190.5 _CNV_A_R_LINEAR_____11_CM 6 -48. 142.5 DISPLAY_IDENTIFIER LDPM_TCO__FAC_TCO_TQI FORMAT "%5.1" /end AXIS_PTS
/begin AXIS_PTS ldpm_n_32_6 "" 0xffe484b3 n_32 _REC_AXS_20_u1 8160. _CNV_A_R_LINEAR_____15_CM 16 0. 8160. DISPLAY_IDENTIFIER LDPM_N_32_6 FORMAT "%4.0" /end AXIS_PTS
/begin AXIS_PTS ldp_tps_av__maf_1_diag "" 0xffe51388 tps_av _REC_AXS_20_u2 119.5 _CNV_A_R_LINEAR_____500_CM 16 0. 119.5 DISPLAY_IDENTIFIER LDP_TPS_AV__MAF_1_DIAG FORMAT "%7.3" /end AXIS_PTS
/begin AXIS_PTS ldp_n_32__tps_max_ratio_diag "" 0xffe410ab n_32 _REC_AXS_20_u1 8160. _CNV_A_R_LINEAR_____15_CM 4 0. 8160. DISPLAY_IDENTIFIER LDP_N_32__TPS_MAX_RATIO_DIAG FORMAT "%4.0" /end AXIS_PTS
/begin AXIS_PTS ldp_n_32_tps_sp_pwl "" 0xffe41122 n_32 _REC_AXS_20_u1 816. _CNV_A_R_LINEAR_____15_CM 4 0. 8160. DISPLAY_IDENTIFIER LDP_N_32_TPS_SP_PWL FORMAT "%4.0" /end AXIS_PTS
/begin AXIS_PTS ldp_pv_av__tps_sp_ext "" 0xffe41157 pv_av _REC_AXS_20_u1 99.609375 _CNV_A_R_LINEAR_____9_CM 6 0. 99.609375 DISPLAY_IDENTIFIER LDP_PV_AV__TPS_SP_EXT FORMAT "%4.1" /end AXIS_PTS
/begin AXIS_PTS ldpm_tco_1_thro "" 0xffe48608 tco _REC_AXS_20_u1 190.5 _CNV_A_R_LINEAR_____11_CM 8 -48. 142.5 DISPLAY_IDENTIFIER LDPM_TCO_1_THRO FORMAT "%5.1" /end AXIS_PTS
/begin AXIS_PTS ldp_n_ip_tps_sp_lgrd_st "" 0xffe510b4 n _REC_AXS_20_u2 8160. _CNV_A_R_LINEAR_____10_CM 8 0. 8160. DISPLAY_IDENTIFIER LDP_N_IP_TPS_SP_LGRD_ST FORMAT "%4.0" /end AXIS_PTS
/begin AXIS_PTS ldp_tco_ip_tps_sp_lgrd_st "" 0xffe48242 tco _REC_AXS_20_u1 190.5 _CNV_A_R_LINEAR_____11_CM 8 -48. 142.5 DISPLAY_IDENTIFIER LDP_TCO_IP_TPS_SP_LGRD_ST FORMAT "%5.1" /end AXIS_PTS
/begin AXIS_PTS ldp_t_acc_ip_fac_tq_loss_acc_on "" 0xffe4819e t_acc _REC_AXS_20_u1 2.55 _CNV_A_R_LINEAR_____4_CM 8 0. 2.55 DISPLAY_IDENTIFIER LDP_T_ACC_IP_FAC_TQ_LOSS_ACC_ON FORMAT "%4.2" /end AXIS_PTS
/begin AXIS_PTS ldp_n_32_ip_fac_tq_loss_acc_on "" 0xffe480be n_32 _REC_AXS_20_u1 8160. _CNV_A_R_LINEAR_____15_CM 8 0. 8160. DISPLAY_IDENTIFIER LDP_N_32_IP_FAC_TQ_LOSS_ACC_ON FORMAT "%4.0" /end AXIS_PTS
/begin AXIS_PTS ldp_n_32__tq_add_acc "" 0xffe410b0 n_32 _REC_AXS_20_u1 8160. _CNV_A_R_LINEAR_____15_CM 6 0. 8160. DISPLAY_IDENTIFIER LDP_N_32__TQ_ADD_ACC FORMAT "%4.0" /end AXIS_PTS
/begin AXIS_PTS ldp_t_acc_fac_tq_loss_acc "" 0xffe48195 t_acc _REC_AXS_20_u1 2.55 _CNV_A_R_LINEAR_____4_CM 8 0. 2.55 DISPLAY_IDENTIFIER LDP_T_ACC_FAC_TQ_LOSS_ACC FORMAT "%4.2" /end AXIS_PTS
/begin AXIS_PTS ldp_n_32__tq_add_heat_acc "" 0xffe410b7 n_32 _REC_AXS_20_u1 8160. _CNV_A_R_LINEAR_____15_CM 6 0. 8160. DISPLAY_IDENTIFIER LDP_N_32__TQ_ADD_HEAT_ACC FORMAT "%4.0" /end AXIS_PTS
/begin AXIS_PTS ldp_n_32__tq_loss_acc "" 0xffe410cc n_32 _REC_AXS_20_u1 8160. _CNV_A_R_LINEAR_____15_CM 6 0. 8160. DISPLAY_IDENTIFIER LDP_N_32__TQ_LOSS_ACC FORMAT "%4.0" /end AXIS_PTS
/begin AXIS_PTS ldp_tq_accin_can__tq_loss_acc "" 0xffe412d6 tq_accin_can _REC_AXS_20_u1 31. _CNV_A_R_LINEAR_____95_CM 6 0. 31. DISPLAY_IDENTIFIER LDP_TQ_ACCIN_CAN__TQ_LOSS_ACC FORMAT "%3.0" /end AXIS_PTS
/begin AXIS_PTS ldp_tq_loss_acc_inp__tq_add_acc "" 0xffe5145c tq_loss_acc_inp _REC_AXS_20_u2 2047.96875 _CNV_A_R_LINEAR_____187_CM 6 -1024. 1023.96875 DISPLAY_IDENTIFIER LDP_TQ_LOSS_ACC_INP__TQ_ADD_ACC FORMAT "%6.2" /end AXIS_PTS
/begin AXIS_PTS ldpm_gr_at_100 "" 0xffe4839d gr_at _REC_AXS_20_u1 255. _CNV_A_R_LINEAR_____0_CM 13 0. 255. DISPLAY_IDENTIFIER LDPM_GR_AT_100 FORMAT "%3.0" /end AXIS_PTS
/begin AXIS_PTS ldpm_gr_mt_100 "" 0xffe483b9 gr_mt _REC_AXS_20_u1 255. _CNV_A_R_LINEAR_____0_CM 13 0. 255. DISPLAY_IDENTIFIER LDPM_GR_MT_100 FORMAT "%3.0" /end AXIS_PTS
/begin AXIS_PTS ldp_n_32__fac_tq_aj "" 0xffe48015 n_32 _REC_AXS_20_u1 8160. _CNV_A_R_LINEAR_____15_CM 8 0. 8160. DISPLAY_IDENTIFIER LDP_N_32__FAC_TQ_AJ FORMAT "%4.0" /end AXIS_PTS
/begin AXIS_PTS ldp_gear__fac_tq_aj "" 0xffe4104b gear _REC_AXS_20_u1 6. _CNV_A_R_LINEAR_____0_CM 6 0. 6. DISPLAY_IDENTIFIER LDP_GEAR__FAC_TQ_AJ FORMAT "%1.0" /end AXIS_PTS
/begin AXIS_PTS ldpm_ac_veh_trv_tcs "" 0xffe51724 ac_veh_trv_tcs _REC_AXS_20_u2 102.35 _CNV_A_R_LINEAR_____103_CM 8 -51.175 51.175 DISPLAY_IDENTIFIER LDPM_AC_VEH_TRV_TCS FORMAT "%7.4" /end AXIS_PTS
/begin AXIS_PTS ldpm_vs_fil "" 0xffe51ec4 vs_fil _REC_AXS_20_u2 511.99218 _CNV_A_R_LINEAR_____85_CM 8 0. 511.99218 DISPLAY_IDENTIFIER LDPM_VS_FIL FORMAT "%7.3" /end AXIS_PTS
/begin AXIS_PTS ldpm_n_32__tq_loss_ars "" 0xffe484fe n_32 _REC_AXS_20_u1 8160. _CNV_A_R_LINEAR_____15_CM 8 0. 8160. DISPLAY_IDENTIFIER LDPM_N_32__TQ_LOSS_ARS FORMAT "%4.0" /end AXIS_PTS
/begin AXIS_PTS ldp_tq_loss_ars_sp_can_max "" 0xffe51498 tq_loss_ars_sp_can _REC_AXS_20_u2 2047.96875 _CNV_A_R_LINEAR_____187_CM 8 -1024. 1023.96875 DISPLAY_IDENTIFIER LDP_TQ_LOSS_ARS_SP_CAN_MAX FORMAT "%6.2" /end AXIS_PTS
/begin AXIS_PTS ldp_tq_loss_ars_av_can_max "" 0xffe51478 tq_loss_ars_av_can _REC_AXS_20_u2 2047.96875 _CNV_A_R_LINEAR_____187_CM 8 -1024. 1023.96875 DISPLAY_IDENTIFIER LDP_TQ_LOSS_ARS_AV_CAN_MAX FORMAT "%6.2" /end AXIS_PTS
/begin AXIS_PTS ldp_tco__tq_clu_amt "" 0xffe41205 tco _REC_AXS_20_u1 190.5 _CNV_A_R_LINEAR_____11_CM 6 -48. 142.5 DISPLAY_IDENTIFIER LDP_TCO__TQ_CLU_AMT FORMAT "%5.1" /end AXIS_PTS
/begin AXIS_PTS ldp_n_dif__tq_clu_amt "" 0xffe5102e n_dif _REC_AXS_20_u2 65535. _CNV_A_R_LINEAR_____207_CM 6 -32768. 32767. DISPLAY_IDENTIFIER LDP_N_DIF__TQ_CLU_AMT FORMAT "%6.0" /end AXIS_PTS
/begin AXIS_PTS ldp_n_32_ip_tq_add_conv "" 0xffe4110d n_32 _REC_AXS_20_u1 8160. _CNV_A_R_LINEAR_____15_CM 6 0. 8160. DISPLAY_IDENTIFIER LDP_N_32_IP_TQ_ADD_CONV FORMAT "%4.0" /end AXIS_PTS
/begin AXIS_PTS ldp_n_32_ip_tq_add_amt "" 0xffe41106 n_32 _REC_AXS_20_u1 8160. _CNV_A_R_LINEAR_____15_CM 6 0. 8160. DISPLAY_IDENTIFIER LDP_N_32_IP_TQ_ADD_AMT FORMAT "%4.0" /end AXIS_PTS
/begin AXIS_PTS ldp_vs_fil__tq_clu_amt "" 0xffe516fa vs_fil _REC_AXS_20_u2 511.99218 _CNV_A_R_LINEAR_____85_CM 6 0. 511.99218 DISPLAY_IDENTIFIER LDP_VS_FIL__TQ_CLU_AMT FORMAT "%7.3" /end AXIS_PTS
/begin AXIS_PTS ldp_n_ratio_conv_fac_tq_conv "" 0xffe48150 n_ratio_conv _REC_AXS_20_u1 0.9960940000000002 _CNV_A_R_LINEAR_____50_CM 8 0. 0.996094 DISPLAY_IDENTIFIER LDP_N_RATIO_CONV_FAC_TQ_CONV FORMAT "%5.3" /end AXIS_PTS
/begin AXIS_PTS ldp_toil_t_dly_n_sp_is "" 0xffe482c2 toil _REC_AXS_20_u1 200. _CNV_A_R_LINEAR_____14_CM 8 -40. 160. DISPLAY_IDENTIFIER LDP_TOIL_T_DLY_N_SP_IS FORMAT "%3.0" /end AXIS_PTS
/begin AXIS_PTS ldp_toil_t_dly_conv "" 0xffe482b9 toil _REC_AXS_20_u1 200. _CNV_A_R_LINEAR_____14_CM 8 -40. 160. DISPLAY_IDENTIFIER LDP_TOIL_T_DLY_CONV FORMAT "%3.0" /end AXIS_PTS
/begin AXIS_PTS ldp_toil_fac_conv "" 0xffe482a5 toil _REC_AXS_20_u1 200. _CNV_A_R_LINEAR_____14_CM 8 -40. 160. DISPLAY_IDENTIFIER LDP_TOIL_FAC_CONV FORMAT "%3.0" /end AXIS_PTS
/begin AXIS_PTS ldp_gr_at_n_tur "" 0xffe47f32 gr_at _REC_AXS_20_u1 8. _CNV_A_R_LINEAR_____0_CM 13 0. 8. DISPLAY_IDENTIFIER LDP_GR_AT_N_TUR FORMAT "%1.0" /end AXIS_PTS
/begin AXIS_PTS ldp_n_32__tq_conv "" 0xffe480a3 n_32 _REC_AXS_20_u1 8160. _CNV_A_R_LINEAR_____15_CM 8 0. 8160. DISPLAY_IDENTIFIER LDP_N_32__TQ_CONV FORMAT "%4.0" /end AXIS_PTS
/begin AXIS_PTS ldp_vs_n_tur "" 0xffe41329 vs _REC_AXS_20_u1 255. _CNV_A_R_LINEAR_____23_CM 2 0. 255. DISPLAY_IDENTIFIER LDP_VS_N_TUR FORMAT "%3.0" /end AXIS_PTS
/begin AXIS_PTS ldp_tq_conv_can__tq_conv "" 0xffe5144a tq_conv_can _REC_AXS_20_u2 2047.96875 _CNV_A_R_LINEAR_____187_CM 8 -1024. 1023.96875 DISPLAY_IDENTIFIER LDP_TQ_CONV_CAN__TQ_CONV FORMAT "%6.2" /end AXIS_PTS
/begin AXIS_PTS ldpm_toil_tq_add_conv "" 0xffe41481 toil _REC_AXS_20_u1 200. _CNV_A_R_LINEAR_____14_CM 6 -40. 160. DISPLAY_IDENTIFIER LDPM_TOIL_TQ_ADD_CONV FORMAT "%3.0" /end AXIS_PTS
/begin AXIS_PTS ldpm_vs_tq_add_conv "" 0xffe4149d vs _REC_AXS_20_u1 255. _CNV_A_R_LINEAR_____23_CM 6 0. 255. DISPLAY_IDENTIFIER LDPM_VS_TQ_ADD_CONV FORMAT "%3.0" /end AXIS_PTS
/begin AXIS_PTS ldp_n_grd_tq_add_conv "" 0xffe41143 n_grd _REC_AXS_20_u1 8160. _CNV_A_R_LINEAR_____54_CM 6 -4096. 4064. DISPLAY_IDENTIFIER LDP_N_GRD_TQ_ADD_CONV FORMAT "%5.0" /end AXIS_PTS
/begin AXIS_PTS ldp_ac_cru_tq_add_conv "" 0xffe5094c ac_cru _REC_AXS_20_u2 31.43952 _CNV_A_R_LINEAR_____513_CM 6 -15.72 15.71952 DISPLAY_IDENTIFIER LDP_AC_CRU_TQ_ADD_CONV FORMAT "%8.4" /end AXIS_PTS
/begin AXIS_PTS ldp_cl_mmv "" 0xffe50a8c online_dummy _REC_AXS_20_u2 7.99987793 _CNV_A_R_LINEAR_____394_CM 6 0. 7.99987793 DISPLAY_IDENTIFIER LDP_CL_MMV FORMAT "%6.4" /end AXIS_PTS
/begin AXIS_PTS ldpm_n_100 "" 0xffe51a0c n _REC_AXS_20_u2 8160. _CNV_A_R_LINEAR_____10_CM 16 0. 8160. DISPLAY_IDENTIFIER LDPM_N_100 FORMAT "%4.0" /end AXIS_PTS
/begin AXIS_PTS ldp_maf_cyl_stk__tqfr "" 0xffe50d54 maf _REC_AXS_20_u2 1389. _CNV_A_R_LINEAR_____108_CM 8 0. 1389. DISPLAY_IDENTIFIER LDP_MAF_CYL_STK__TQFR FORMAT "%7.2" /end AXIS_PTS
/begin AXIS_PTS ldp_tco__tqfr_add "" 0xffe4820a tco _REC_AXS_20_u1 190.5 _CNV_A_R_LINEAR_____11_CM 8 -48. 142.5 DISPLAY_IDENTIFIER LDP_TCO__TQFR_ADD FORMAT "%5.1" /end AXIS_PTS
/begin AXIS_PTS ldp_toil_tqfr_add "" 0xffe482dd toil _REC_AXS_20_u1 200. _CNV_A_R_LINEAR_____14_CM 8 -40. 160. DISPLAY_IDENTIFIER LDP_TOIL_TQFR_ADD FORMAT "%3.0" /end AXIS_PTS
/begin AXIS_PTS ldp_n_tq_loss_lim "" 0xffe51156 n _REC_AXS_20_u2 8160. _CNV_A_R_LINEAR_____10_CM 6 0. 8160. DISPLAY_IDENTIFIER LDP_N_TQ_LOSS_LIM FORMAT "%4.0" /end AXIS_PTS
/begin AXIS_PTS ldp_tco_tq_loss_lim "" 0xffe41255 tco _REC_AXS_20_u1 190.5 _CNV_A_R_LINEAR_____11_CM 6 -48. 142.5 DISPLAY_IDENTIFIER LDP_TCO_TQ_LOSS_LIM FORMAT "%5.1" /end AXIS_PTS
/begin AXIS_PTS ldp_tco_st__tqfr_st "" 0xffe4122c tco_st _REC_AXS_20_u1 190.5 _CNV_A_R_LINEAR_____11_CM 4 -48. 142.5 DISPLAY_IDENTIFIER LDP_TCO_ST__TQFR_ST FORMAT "%5.1" /end AXIS_PTS
/begin AXIS_PTS ldp_tco_st__tqfr_dec_st "" 0xffe41227 tco_st _REC_AXS_20_u1 190.5 _CNV_A_R_LINEAR_____11_CM 4 -48. 142.5 DISPLAY_IDENTIFIER LDP_TCO_ST__TQFR_DEC_ST FORMAT "%5.1" /end AXIS_PTS
/begin AXIS_PTS ldp_amp_dif__tqfr_amp "AMP correction of friction  torque" 0xffe5098e online_dummy _REC_AXS_20_u2 5434. _CNV_A_R_LINEAR_____116_CM 4 -2717. 2717. DISPLAY_IDENTIFIER LDP_AMP_DIF__TQFR_AMP FORMAT "%7.2" /end AXIS_PTS
/begin AXIS_PTS ldp_pq__tqfr_amp "AMP correction of friction  torque" 0xffe511e4 online_dummy _REC_AXS_20_u2 0.99998474 _CNV_A_R_LINEAR_____37_CM 4 0. 0.99998474 DISPLAY_IDENTIFIER LDP_PQ__TQFR_AMP FORMAT "%7.5" /end AXIS_PTS
/begin AXIS_PTS ldp_eff_scc_sp__nr_pat_scc "" 0xffe50b46 eff_scc_sp _REC_AXS_20_u2 1.99996948 _CNV_A_R_LINEAR_____20_CM 13 0. 1.99996948 DISPLAY_IDENTIFIER LDP_EFF_SCC_SP__NR_PAT_SCC FORMAT "%7.5" /end AXIS_PTS
/begin AXIS_PTS ldpm_tco_ip_tq_st "" 0xffe4866e tco _REC_AXS_20_u1 190.5 _CNV_A_R_LINEAR_____11_CM 8 -48. 142.5 DISPLAY_IDENTIFIER LDPM_TCO_IP_TQ_ST FORMAT "%5.1" /end AXIS_PTS
/begin AXIS_PTS ldpm_n_dif_ip_tq_st "" 0xffe51b8c n_dif _REC_AXS_20_u2 65535. _CNV_A_R_LINEAR_____207_CM 8 -32768. 32767. DISPLAY_IDENTIFIER LDPM_N_DIF_IP_TQ_ST FORMAT "%6.0" /end AXIS_PTS
/begin AXIS_PTS ldp_n_32_mon__tqi_ref_mon "" 0xffe5224c n_32_mon _REC_AXS_20_u1 8160. _CNV_A_R_LINEAR_____15_CM 6 0. 8160. DISPLAY_IDENTIFIER LDP_N_32_MON__TQI_REF_MON FORMAT "%4.0" /end AXIS_PTS
/begin AXIS_PTS ldp_maf_mon__tqi_ref_mon "" 0xffe521fe maf_mon _REC_AXS_20_u1 1389. _CNV_A_R_LINEAR_____27_CM 8 0. 1389. DISPLAY_IDENTIFIER LDP_MAF_MON__TQI_REF_MON FORMAT "%4.0" /end AXIS_PTS
/begin AXIS_PTS ldp_n_32_mon__iga_ref_mon "" 0xffe5221f n_32_mon _REC_AXS_20_u1 8160. _CNV_A_R_LINEAR_____15_CM 8 0. 8160. DISPLAY_IDENTIFIER LDP_N_32_MON__IGA_REF_MON FORMAT "%4.0" /end AXIS_PTS
/begin AXIS_PTS ldp_maf_mon__iga_ref_mon "" 0xffe521ef maf_mon _REC_AXS_20_u1 1389. _CNV_A_R_LINEAR_____27_CM 8 0. 1389. DISPLAY_IDENTIFIER LDP_MAF_MON__IGA_REF_MON FORMAT "%4.0" /end AXIS_PTS
/begin AXIS_PTS ldp_iga_dif_av_mon__eff_iga_mon "" 0xffe521e6 iga_dif_av _REC_AXS_20_u1 -95.625 _CNV_A_R_LINEAR_____204_CM 8 0. -95.625 DISPLAY_IDENTIFIER LDP_IGA_DIF_AV_MON__EFF_IGA_MON FORMAT "%6.2" /end AXIS_PTS
/begin AXIS_PTS ldpm_n_fac_tq_req_driv "" 0xffe51bb0 n _REC_AXS_20_u2 8160. _CNV_A_R_LINEAR_____10_CM 12 0. 8160. DISPLAY_IDENTIFIER LDPM_N_FAC_TQ_REQ_DRIV FORMAT "%4.0" /end AXIS_PTS
/begin AXIS_PTS ldpm_pv_av_fac_tq_req_driv "" 0xffe485ce pv_av _REC_AXS_20_u1 99.609375 _CNV_A_R_LINEAR_____9_CM 12 0. 99.609375 DISPLAY_IDENTIFIER LDPM_PV_AV_FAC_TQ_REQ_DRIV FORMAT "%4.1" /end AXIS_PTS
/begin AXIS_PTS ldpm_n_32_100 "" 0xffe4845f n_32 _REC_AXS_20_u1 8160. _CNV_A_R_LINEAR_____15_CM 16 0. 8160. DISPLAY_IDENTIFIER LDPM_N_32_100 FORMAT "%4.0" /end AXIS_PTS
/begin AXIS_PTS ldpm_maf_100 "" 0xffe518ac maf _REC_AXS_20_u2 1389. _CNV_A_R_LINEAR_____108_CM 12 0. 1389. DISPLAY_IDENTIFIER LDPM_MAF_100 FORMAT "%7.2" /end AXIS_PTS
/begin AXIS_PTS ldp_n_sp_is_ratio "" 0xffe51136 n_sp_is_ratio _REC_AXS_20_u2 7.99987793 _CNV_A_R_LINEAR_____394_CM 8 0. 7.99987793 DISPLAY_IDENTIFIER LDP_N_SP_IS_RATIO FORMAT "%6.4" /end AXIS_PTS
/begin AXIS_PTS ldp_ecfpwm_ecf__pow_loss_ecf "" 0xffe47f20 ecfpwm_ecf _REC_AXS_20_u1 99.609375 _CNV_A_R_LINEAR_____9_CM 8 0. 99.609375 DISPLAY_IDENTIFIER LDP_ECFPWM_ECF__POW_LOSS_ECF FORMAT "%4.1" /end AXIS_PTS
/begin AXIS_PTS ldpm_n_32__maf_min_pu "" 0xffe484d6 n_32 _REC_AXS_20_u1 8160. _CNV_A_R_LINEAR_____15_CM 12 0. 8160. DISPLAY_IDENTIFIER LDPM_N_32__MAF_MIN_PU FORMAT "%4.0" /end AXIS_PTS
/begin AXIS_PTS ldpm_tco__maf_min_pu "" 0xffe41441 tco _REC_AXS_20_u1 190.5 _CNV_A_R_LINEAR_____11_CM 4 -48. 142.5 DISPLAY_IDENTIFIER LDPM_TCO__MAF_MIN_PU FORMAT "%5.1" /end AXIS_PTS
/begin AXIS_PTS ldp_mff_sp_s__tqi_ref_s "" 0xffe50f7c mff_sp_s _REC_AXS_20_u2 1389. _CNV_A_R_LINEAR_____108_CM 12 0. 1389. DISPLAY_IDENTIFIER LDP_MFF_SP_S__TQI_REF_S FORMAT "%7.2" /end AXIS_PTS
/begin AXIS_PTS ldp_tqi_sp_maf__maf_sp "" 0xffe51524 tqi_sp_maf _REC_AXS_20_u2 1023.96875 _CNV_A_R_LINEAR_____55_CM 12 0. 1023.96875 DISPLAY_IDENTIFIER LDP_TQI_SP_MAF__MAF_SP FORMAT "%7.2" /end AXIS_PTS
/begin AXIS_PTS ldp_n_32__tqi_dif_lim "" 0xffe5221a n_32 _REC_AXS_20_u1 8160. _CNV_A_R_LINEAR_____15_CM 4 0. 8160. DISPLAY_IDENTIFIER LDP_N_32__TQI_DIF_LIM FORMAT "%4.0" /end AXIS_PTS
/begin AXIS_PTS ldp_tqi_sp_mon__tqi_dif_lim "" 0xffe522b9 tqi_sp_mon _REC_AXS_20_u1 510. _CNV_A_R_LINEAR_____101_CM 4 0. 510. DISPLAY_IDENTIFIER LDP_TQI_SP_MON__TQI_DIF_LIM FORMAT "%3.0" /end AXIS_PTS
/begin AXIS_PTS ldp_tqi_sp_mon__tqi_dif_max_mon "" 0xffe522be tqi_sp_mon _REC_AXS_20_u1 510. _CNV_A_R_LINEAR_____101_CM 4 0. 510. DISPLAY_IDENTIFIER LDP_TQI_SP_MON__TQI_DIF_MAX_MON FORMAT "%3.0" /end AXIS_PTS
/begin AXIS_PTS ldp_n_32_mon__tqi_dif_max_mon "" 0xffe52247 n_32_mon _REC_AXS_20_u1 8160. _CNV_A_R_LINEAR_____15_CM 4 0. 8160. DISPLAY_IDENTIFIER LDP_N_32_MON__TQI_DIF_MAX_MON FORMAT "%4.0" /end AXIS_PTS
/begin AXIS_PTS ldp_n_dif_cor_mon_ip_tq_mon "maximum PD-part depending on speed deviation to idle speed setpoint" 0xffe5225a n_dif_cor_mon _REC_AXS_20_u1 8160. _CNV_A_R_LINEAR_____216_CM 4 -4096. 4064. DISPLAY_IDENTIFIER LDP_N_DIF_COR_MON_IP_TQ_MON FORMAT "%5.0" /end AXIS_PTS
/begin AXIS_PTS ldp_tco_mon_ip_fac_tq_p_d_mon "" 0xffe52288 tco_mon _REC_AXS_20_u1 190.5 _CNV_A_R_LINEAR_____11_CM 5 -48. 142.5 DISPLAY_IDENTIFIER LDP_TCO_MON_IP_FAC_TQ_P_D_MON FORMAT "%4.0" /end AXIS_PTS
/begin AXIS_PTS ldp_tco_mon_ip_n_sp_is_mon "" 0xffe5228e tco_mon _REC_AXS_20_u1 190.5 _CNV_A_R_LINEAR_____11_CM 5 -48. 142.5 DISPLAY_IDENTIFIER LDP_TCO_MON_IP_N_SP_IS_MON FORMAT "%5.1" /end AXIS_PTS
/begin AXIS_PTS ldp_n_tq_add_st "" 0xffe48159 n_32 _REC_AXS_20_u1 8160. _CNV_A_R_LINEAR_____15_CM 8 0. 8160. DISPLAY_IDENTIFIER LDP_N_TQ_ADD_ST FORMAT "%4.0" /end AXIS_PTS
/begin AXIS_PTS ldp_tco_tq_add_st "" 0xffe41250 tco _REC_AXS_20_u1 190.5 _CNV_A_R_LINEAR_____11_CM 4 -48. 142.5 DISPLAY_IDENTIFIER LDP_TCO_TQ_ADD_ST FORMAT "%5.1" /end AXIS_PTS
/begin AXIS_PTS ldp_n_32_tq_add_tra "" 0xffe480f4 n_32 _REC_AXS_20_u1 8160. _CNV_A_R_LINEAR_____15_CM 8 0. 8160. DISPLAY_IDENTIFIER LDP_N_32_TQ_ADD_TRA FORMAT "%4.0" /end AXIS_PTS
/begin AXIS_PTS ldp_tq_req_dif_tra_fac_tq_tra "" 0xffe514aa tq_req_dif_tra _REC_AXS_20_u2 1023.96875 _CNV_A_R_LINEAR_____55_CM 6 0. 1023.96875 DISPLAY_IDENTIFIER LDP_TQ_REQ_DIF_TRA_FAC_TQ_TRA FORMAT "%7.2" /end AXIS_PTS
/begin AXIS_PTS ldp_maf_mon__tq_loss_mon "" 0xffe521f8 maf_mon _REC_AXS_20_u1 1389. _CNV_A_R_LINEAR_____27_CM 5 0. 1389. DISPLAY_IDENTIFIER LDP_MAF_MON__TQ_LOSS_MON FORMAT "%4.0" /end AXIS_PTS
/begin AXIS_PTS ldp_n_32_mon__tq_loss_mon "" 0xffe5223a n_32_mon _REC_AXS_20_u1 8160. _CNV_A_R_LINEAR_____15_CM 5 0. 8160. DISPLAY_IDENTIFIER LDP_N_32_MON__TQ_LOSS_MON FORMAT "%4.0" /end AXIS_PTS
/begin AXIS_PTS ldp_tco_mon__tq_loss_mon "" 0xffe5227b tco_mon _REC_AXS_20_u1 190.5 _CNV_A_R_LINEAR_____11_CM 5 -48. 142.5 DISPLAY_IDENTIFIER LDP_TCO_MON__TQ_LOSS_MON FORMAT "%5.1" /end AXIS_PTS
/begin AXIS_PTS ldp_ctr_km_can__tq_loss_mon "" 0xffe523e8 ctr_km_can _REC_AXS_20_u2 655350. _CNV_A_R_LINEAR_____88_CM 5 0. 655350. DISPLAY_IDENTIFIER LDP_CTR_KM_CAN__TQ_LOSS_MON FORMAT "%7.0" /end AXIS_PTS
/begin AXIS_PTS ldp_n_32_mon__tq_max_clu_max_mon "" 0xffe52240 n_32_mon _REC_AXS_20_u1 8160. _CNV_A_R_LINEAR_____15_CM 6 0. 8160. DISPLAY_IDENTIFIER LDP_N_32_MON__TQ_MAX_CLU_MAX_MON FORMAT "%4.0" /end AXIS_PTS
/begin AXIS_PTS ldp_n_dif_mon_ip_tq_min_mon "" 0xffe5225f n_dif_sp_is_mon _REC_AXS_20_u1 8160. _CNV_A_R_LINEAR_____216_CM 4 -4096. 4064. DISPLAY_IDENTIFIER LDP_N_DIF_MON_IP_TQ_MIN_MON FORMAT "%5.0" /end AXIS_PTS
/begin AXIS_PTS ldp_n_32_mon_ip_tqi_min_pu_mon "" 0xffe52253 n_32_mon _REC_AXS_20_u1 8160. _CNV_A_R_LINEAR_____15_CM 6 0. 8160. DISPLAY_IDENTIFIER LDP_N_32_MON_IP_TQI_MIN_PU_MON FORMAT "%4.0" /end AXIS_PTS
/begin AXIS_PTS ldp_tco_mon_ip_fac_conv_mon "" 0xffe52281 tco_mon _REC_AXS_20_u1 190.5 _CNV_A_R_LINEAR_____11_CM 6 -48. 142.5 DISPLAY_IDENTIFIER LDP_TCO_MON_IP_FAC_CONV_MON FORMAT "%5.1" /end AXIS_PTS
/begin AXIS_PTS ldp_tco_mon_ip_tqi_min_pu_mon "" 0xffe52294 tco_mon _REC_AXS_20_u1 190.5 _CNV_A_R_LINEAR_____11_CM 4 -48. 142.5 DISPLAY_IDENTIFIER LDP_TCO_MON_IP_TQI_MIN_PU_MON FORMAT "%5.1" /end AXIS_PTS
/begin AXIS_PTS ldpm_gear__tq_p_max "" 0xffe48381 gear _REC_AXS_20_u1 12. _CNV_A_R_LINEAR_____22_CM 13 0. 12. DISPLAY_IDENTIFIER LDPM_GEAR__TQ_P_MAX FORMAT "%3.0" /end AXIS_PTS
/begin AXIS_PTS ldpm_vs_fil__tq_p_max "" 0xffe51ee8 vs_fil _REC_AXS_20_u2 511.99218 _CNV_A_R_LINEAR_____85_CM 6 0. 511.99218 DISPLAY_IDENTIFIER LDPM_VS_FIL__TQ_P_MAX FORMAT "%7.3" /end AXIS_PTS
/begin AXIS_PTS ldp_ang_pste__tq_loss_pste "" 0xffe50a0c ang_pste _REC_AXS_20_u2 2879.935575 _CNV_A_R_LINEAR_____528_CM 8 -1439.98976 1439.945815 DISPLAY_IDENTIFIER LDP_ANG_PSTE__TQ_LOSS_PSTE FORMAT "%8.2" /end AXIS_PTS
/begin AXIS_PTS ldp_vel_ang_pste__tq_loss_pste "" 0xffe5163e vel_ang_pste _REC_AXS_20_u2 2879.935575 _CNV_A_R_LINEAR_____529_CM 8 -1439.98976 1439.945815 DISPLAY_IDENTIFIER LDP_VEL_ANG_PSTE__TQ_LOSS_PSTE FORMAT "%8.2" /end AXIS_PTS
/begin AXIS_PTS ldp_ang_pste__tq_add_pste "" 0xffe509fa ang_pste _REC_AXS_20_u2 2879.935575 _CNV_A_R_LINEAR_____528_CM 8 -1439.98976 1439.945815 DISPLAY_IDENTIFIER LDP_ANG_PSTE__TQ_ADD_PSTE FORMAT "%8.2" /end AXIS_PTS
/begin AXIS_PTS ldp_n__fac_tq_add_pste "" 0xffe50fa0 n _REC_AXS_20_u2 8160. _CNV_A_R_LINEAR_____10_CM 8 0. 8160. DISPLAY_IDENTIFIER LDP_N__FAC_TQ_ADD_PSTE FORMAT "%4.0" /end AXIS_PTS
/begin AXIS_PTS ldp_n_32__fac_tq_req_driv_mon "" 0xffe5220a n_32_mon _REC_AXS_20_u1 8160. _CNV_A_R_LINEAR_____15_CM 8 0. 8160. DISPLAY_IDENTIFIER LDP_N_32__FAC_TQ_REQ_DRIV_MON FORMAT "%4.0" /end AXIS_PTS
/begin AXIS_PTS ldp_pv_av__fac_tq_req_driv_mon "" 0xffe5226b pv_av_mon _REC_AXS_20_u1 99.609375 _CNV_A_R_LINEAR_____9_CM 8 0. 99.609375 DISPLAY_IDENTIFIER LDP_PV_AV__FAC_TQ_REQ_DRIV_MON FORMAT "%5.2" /end AXIS_PTS
/begin AXIS_PTS ldp_tia_fac_n_vim "" 0xffe48293 tia _REC_AXS_20_u1 190.5 _CNV_A_R_LINEAR_____11_CM 8 -48. 142.5 DISPLAY_IDENTIFIER LDP_TIA_FAC_N_VIM FORMAT "%5.1" /end AXIS_PTS
/begin AXIS_PTS ldp_seg_ctr_fac_wf "" 0xffe51276 seg_ctr_wf _REC_AXS_20_u2 65535. _CNV_A_R_LINEAR_____185_CM 4 0. 65535. DISPLAY_IDENTIFIER LDP_SEG_CTR_FAC_WF FORMAT "%5.0" /end AXIS_PTS
/begin AXIS_PTS ldp_tco_st_ti_fac_wf "" 0xffe41238 tco_st _REC_AXS_20_u1 190.5 _CNV_A_R_LINEAR_____11_CM 4 -48. 142.5 DISPLAY_IDENTIFIER LDP_TCO_ST_TI_FAC_WF FORMAT "%5.1" /end AXIS_PTS
/begin AXIS_PTS ldp_tco_ti_wf_thd "" 0xffe41244 tco _REC_AXS_20_u1 28.575 _CNV_A_R_LINEAR_____11_CM 4 -48. 142.5 DISPLAY_IDENTIFIER LDP_TCO_TI_WF_THD FORMAT "%5.1" /end AXIS_PTS
/begin AXIS_PTS ldpm_maf_6 "" 0xffe483e7 maf _REC_AXS_20_u1 1389. _CNV_A_R_LINEAR_____27_CM 8 0. 1389. DISPLAY_IDENTIFIER LDPM_MAF_6 FORMAT "%4.0" /end AXIS_PTS
/begin AXIS_PTS ldpm_n_29 "" 0xffe48445 n_32 _REC_AXS_20_u1 8160. _CNV_A_R_LINEAR_____15_CM 8 0. 8160. DISPLAY_IDENTIFIER LDPM_N_29 FORMAT "%4.0" /end AXIS_PTS
/begin AXIS_PTS ldpm_tib_ti_wf_thd "" 0xffe51e5e tib _REC_AXS_20_u2 262.14 _CNV_A_R_LINEAR_____165_CM 4 0. 262.14 DISPLAY_IDENTIFIER LDPM_TIB_TI_WF_THD FORMAT "%7.3" /end AXIS_PTS
/begin AXIS_PTS ldpm_vo_1 "" 0xffe48713 vo _REC_AXS_20_u1 95.625 _CNV_A_R_LINEAR_____82_CM 8 0. 95.625 DISPLAY_IDENTIFIER LDPM_VO_1 FORMAT "%4.1" /end AXIS_PTS
/begin AXIS_PTS ldp_maf_sp_tqi "" 0xffe50ec4 maf_sp_tqi _REC_AXS_20_u2 1389. _CNV_A_R_LINEAR_____108_CM 8 0. 1389. DISPLAY_IDENTIFIER LDP_MAF_SP_TQI FORMAT "%7.2" /end AXIS_PTS
/begin AXIS_PTS ldp_tia__fac_ti_wf "" 0xffe41268 tia _REC_AXS_20_u1 190.5 _CNV_A_R_LINEAR_____11_CM 4 -48. 142.5 DISPLAY_IDENTIFIER LDP_TIA__FAC_TI_WF FORMAT "%5.1" /end AXIS_PTS
/begin AXIS_PTS ldp_tco__fac_ti_wf "" 0xffe411b3 tco _REC_AXS_20_u1 190.5 _CNV_A_R_LINEAR_____11_CM 4 -48. 142.5 DISPLAY_IDENTIFIER LDP_TCO__FAC_TI_WF FORMAT "%5.1" /end AXIS_PTS
/begin AXIS_PTS ldpm_tco_15 "" 0xffe485ed tco _REC_AXS_20_u1 190.5 _CNV_A_R_LINEAR_____11_CM 8 -48. 142.5 DISPLAY_IDENTIFIER LDPM_TCO_15 FORMAT "%5.1" /end AXIS_PTS
/begin AXIS_PTS ldpm_tco_16 "" 0xffe41422 tco _REC_AXS_20_u1 190.5 _CNV_A_R_LINEAR_____11_CM 3 -48. 142.5 DISPLAY_IDENTIFIER LDPM_TCO_16 FORMAT "%5.1" /end AXIS_PTS
/begin AXIS_PTS ldpm_n_32__seg_ad_cor "" 0xffe402ad n_32 _REC_AXS_20_u1 8160. _CNV_A_R_LINEAR_____15_CM 6 0. 8160. DISPLAY_IDENTIFIER LDPM_N_32__SEG_AD_COR FORMAT "%4.0" /end AXIS_PTS
/begin AXIS_PTS ldp_maf__maf_dif_max_er_ad "" 0xffe4355a maf _REC_AXS_20_u2 1389. _CNV_A_R_LINEAR_____108_CM 6 0. 1389. DISPLAY_IDENTIFIER LDP_MAF__MAF_DIF_MAX_ER_AD FORMAT "%7.2" /end AXIS_PTS
/begin AXIS_PTS ldp_tps_av__tps_grd_max_er_ad "" 0xffe43568 tps_av _REC_AXS_20_u2 119.5 _CNV_A_R_LINEAR_____53_CM 6 0. 119.5 DISPLAY_IDENTIFIER LDP_TPS_AV__TPS_GRD_MAX_ER_AD FORMAT "%7.3" /end AXIS_PTS
/begin AXIS_PTS ldp_load_mis__load_mis_dif_max "" 0xffe4354c load_mis _REC_AXS_20_u2 100. _CNV_A_R_LINEAR_____415_CM 6 0. 100. DISPLAY_IDENTIFIER LDP_LOAD_MIS__LOAD_MIS_DIF_MAX FORMAT "%7.3" /end AXIS_PTS
/begin AXIS_PTS ldp_load_mis__fac_add_er_0_at "" 0xffe434a4 load_mis _REC_AXS_20_u2 99.99694824000001 _CNV_A_R_LINEAR_____571_CM 6 0. 99.99694824 DISPLAY_IDENTIFIER LDP_LOAD_MIS__FAC_ADD_ER_0_AT /end AXIS_PTS
/begin AXIS_PTS ldp_load_mis__fac_add_er_0_mt "" 0xffe434b2 load_mis _REC_AXS_20_u2 99.99694824000001 _CNV_A_R_LINEAR_____571_CM 6 0. 99.99694824 DISPLAY_IDENTIFIER LDP_LOAD_MIS__FAC_ADD_ER_0_MT /end AXIS_PTS
/begin AXIS_PTS ldp_load_mis__fac_add_er_1_at "" 0xffe434c0 load_mis _REC_AXS_20_u2 99.99694824000001 _CNV_A_R_LINEAR_____571_CM 6 0. 99.99694824 DISPLAY_IDENTIFIER LDP_LOAD_MIS__FAC_ADD_ER_1_AT /end AXIS_PTS
/begin AXIS_PTS ldp_load_mis__fac_add_er_1_mt "" 0xffe434ce load_mis _REC_AXS_20_u2 99.99694824000001 _CNV_A_R_LINEAR_____571_CM 6 0. 99.99694824 DISPLAY_IDENTIFIER LDP_LOAD_MIS__FAC_ADD_ER_1_MT /end AXIS_PTS
/begin AXIS_PTS ldp_load_mis__fac_add_er_2_at "" 0xffe434dc load_mis _REC_AXS_20_u2 99.99694824000001 _CNV_A_R_LINEAR_____571_CM 6 0. 99.99694824 DISPLAY_IDENTIFIER LDP_LOAD_MIS__FAC_ADD_ER_2_AT /end AXIS_PTS
/begin AXIS_PTS ldp_load_mis__fac_add_er_2_mt "" 0xffe434ea load_mis _REC_AXS_20_u2 99.99694824000001 _CNV_A_R_LINEAR_____571_CM 6 0. 99.99694824 DISPLAY_IDENTIFIER LDP_LOAD_MIS__FAC_ADD_ER_2_MT /end AXIS_PTS
/begin AXIS_PTS ldp_load_mis__fac_add_er_3_at "" 0xffe434f8 load_mis _REC_AXS_20_u2 99.99694824000001 _CNV_A_R_LINEAR_____571_CM 6 0. 99.99694824 DISPLAY_IDENTIFIER LDP_LOAD_MIS__FAC_ADD_ER_3_AT /end AXIS_PTS
/begin AXIS_PTS ldp_load_mis__fac_add_er_3_mt "" 0xffe43506 load_mis _REC_AXS_20_u2 99.99694824000001 _CNV_A_R_LINEAR_____571_CM 6 0. 99.99694824 DISPLAY_IDENTIFIER LDP_LOAD_MIS__FAC_ADD_ER_3_MT /end AXIS_PTS
/begin AXIS_PTS ldp_load_mis__fac_add_er_4_at "" 0xffe43514 load_mis _REC_AXS_20_u2 99.99694824000001 _CNV_A_R_LINEAR_____571_CM 6 0. 99.99694824 DISPLAY_IDENTIFIER LDP_LOAD_MIS__FAC_ADD_ER_4_AT /end AXIS_PTS
/begin AXIS_PTS ldp_load_mis__fac_add_er_4_mt "" 0xffe43522 load_mis _REC_AXS_20_u2 99.99694824000001 _CNV_A_R_LINEAR_____571_CM 6 0. 99.99694824 DISPLAY_IDENTIFIER LDP_LOAD_MIS__FAC_ADD_ER_4_MT /end AXIS_PTS
/begin AXIS_PTS ldp_load_mis__fac_add_er_5_at "" 0xffe43530 load_mis _REC_AXS_20_u2 99.99694824000001 _CNV_A_R_LINEAR_____571_CM 6 0. 99.99694824 DISPLAY_IDENTIFIER LDP_LOAD_MIS__FAC_ADD_ER_5_AT /end AXIS_PTS
/begin AXIS_PTS ldp_load_mis__fac_add_er_5_mt "" 0xffe4353e load_mis _REC_AXS_20_u2 99.99694824000001 _CNV_A_R_LINEAR_____571_CM 6 0. 99.99694824 DISPLAY_IDENTIFIER LDP_LOAD_MIS__FAC_ADD_ER_5_MT /end AXIS_PTS
/begin AXIS_PTS ldp_load_ip_fac_load_drv2_er_at "" 0xffe43470 load_mis _REC_AXS_20_u2 99.99694824000001 _CNV_A_R_LINEAR_____571_CM 12 0. 99.99694824 DISPLAY_IDENTIFIER LDP_LOAD_IP_FAC_LOAD_DRV2_ER_AT /end AXIS_PTS
/begin AXIS_PTS ldp_load_ip_fac_load_drv2_er_mt "" 0xffe4348a load_mis _REC_AXS_20_u2 99.99694824000001 _CNV_A_R_LINEAR_____571_CM 12 0. 99.99694824 DISPLAY_IDENTIFIER LDP_LOAD_IP_FAC_LOAD_DRV2_ER_MT /end AXIS_PTS
/begin AXIS_PTS ldp_n_32_ip_fac_n_drv2_er_at "" 0xffe43036 n_32 _REC_AXS_20_u1 8160. _CNV_A_R_LINEAR_____15_CM 12 0. 8160. DISPLAY_IDENTIFIER LDP_N_32_IP_FAC_N_DRV2_ER_AT FORMAT "%4.0" /end AXIS_PTS
/begin AXIS_PTS ldp_n_32_ip_fac_n_drv2_er_mt "" 0xffe43043 n_32 _REC_AXS_20_u1 8160. _CNV_A_R_LINEAR_____15_CM 12 0. 8160. DISPLAY_IDENTIFIER LDP_N_32_IP_FAC_N_DRV2_ER_MT FORMAT "%4.0" /end AXIS_PTS
/begin AXIS_PTS ldp_n_32_ip_crlc_drv2_er_at "" 0xffe4301c n_32 _REC_AXS_20_u1 8160. _CNV_A_R_LINEAR_____15_CM 12 0. 8160. DISPLAY_IDENTIFIER LDP_N_32_IP_CRLC_DRV2_ER_AT FORMAT "%4.0" /end AXIS_PTS
/begin AXIS_PTS ldp_n_32_ip_crlc_drv2_er_mt "" 0xffe43029 n_32 _REC_AXS_20_u1 8160. _CNV_A_R_LINEAR_____15_CM 12 0. 8160. DISPLAY_IDENTIFIER LDP_N_32_IP_CRLC_DRV2_ER_MT FORMAT "%4.0" /end AXIS_PTS
/begin AXIS_PTS ldpm_n_32__fac_er_0_at "" 0xffe40259 n_32 _REC_AXS_20_u1 8160. _CNV_A_R_LINEAR_____15_CM 6 0. 8160. DISPLAY_IDENTIFIER LDPM_N_32__FAC_ER_0_AT FORMAT "%4.0" /end AXIS_PTS
/begin AXIS_PTS ldpm_n_32__fac_er_0_mt "" 0xffe40260 n_32 _REC_AXS_20_u1 8160. _CNV_A_R_LINEAR_____15_CM 6 0. 8160. DISPLAY_IDENTIFIER LDPM_N_32__FAC_ER_0_MT FORMAT "%4.0" /end AXIS_PTS
/begin AXIS_PTS ldpm_n_32__fac_er_1_at "" 0xffe40267 n_32 _REC_AXS_20_u1 8160. _CNV_A_R_LINEAR_____15_CM 6 0. 8160. DISPLAY_IDENTIFIER LDPM_N_32__FAC_ER_1_AT FORMAT "%4.0" /end AXIS_PTS
/begin AXIS_PTS ldpm_n_32__fac_er_1_mt "" 0xffe4026e n_32 _REC_AXS_20_u1 8160. _CNV_A_R_LINEAR_____15_CM 6 0. 8160. DISPLAY_IDENTIFIER LDPM_N_32__FAC_ER_1_MT FORMAT "%4.0" /end AXIS_PTS
/begin AXIS_PTS ldpm_n_32__fac_er_2_at "" 0xffe40275 n_32 _REC_AXS_20_u1 8160. _CNV_A_R_LINEAR_____15_CM 6 0. 8160. DISPLAY_IDENTIFIER LDPM_N_32__FAC_ER_2_AT FORMAT "%4.0" /end AXIS_PTS
/begin AXIS_PTS ldpm_n_32__fac_er_2_mt "" 0xffe4027c n_32 _REC_AXS_20_u1 8160. _CNV_A_R_LINEAR_____15_CM 6 0. 8160. DISPLAY_IDENTIFIER LDPM_N_32__FAC_ER_2_MT FORMAT "%4.0" /end AXIS_PTS
/begin AXIS_PTS ldpm_n_32__fac_er_3_at "" 0xffe40283 n_32 _REC_AXS_20_u1 8160. _CNV_A_R_LINEAR_____15_CM 6 0. 8160. DISPLAY_IDENTIFIER LDPM_N_32__FAC_ER_3_AT FORMAT "%4.0" /end AXIS_PTS
/begin AXIS_PTS ldpm_n_32__fac_er_3_mt "" 0xffe4028a n_32 _REC_AXS_20_u1 8160. _CNV_A_R_LINEAR_____15_CM 6 0. 8160. DISPLAY_IDENTIFIER LDPM_N_32__FAC_ER_3_MT FORMAT "%4.0" /end AXIS_PTS
/begin AXIS_PTS ldpm_n_32__fac_er_4_at "" 0xffe40291 n_32 _REC_AXS_20_u1 8160. _CNV_A_R_LINEAR_____15_CM 6 0. 8160. DISPLAY_IDENTIFIER LDPM_N_32__FAC_ER_4_AT FORMAT "%4.0" /end AXIS_PTS
/begin AXIS_PTS ldpm_n_32__fac_er_4_mt "" 0xffe40298 n_32 _REC_AXS_20_u1 8160. _CNV_A_R_LINEAR_____15_CM 6 0. 8160. DISPLAY_IDENTIFIER LDPM_N_32__FAC_ER_4_MT FORMAT "%4.0" /end AXIS_PTS
/begin AXIS_PTS ldpm_n_32__fac_er_5_at "" 0xffe4029f n_32 _REC_AXS_20_u1 8160. _CNV_A_R_LINEAR_____15_CM 6 0. 8160. DISPLAY_IDENTIFIER LDPM_N_32__FAC_ER_5_AT FORMAT "%4.0" /end AXIS_PTS
/begin AXIS_PTS ldpm_n_32__fac_er_5_mt "" 0xffe402a6 n_32 _REC_AXS_20_u1 8160. _CNV_A_R_LINEAR_____15_CM 6 0. 8160. DISPLAY_IDENTIFIER LDPM_N_32__FAC_ER_5_MT FORMAT "%4.0" /end AXIS_PTS
/begin AXIS_PTS ldp_tq_loss_alter_1__tq_alter "" 0xffe5146a tq_loss_alter_1 _REC_AXS_20_u2 2047.96875 _CNV_A_R_LINEAR_____187_CM 6 -1024. 1023.96875 DISPLAY_IDENTIFIER LDP_TQ_LOSS_ALTER_1__TQ_ALTER FORMAT "%6.2" /end AXIS_PTS
/begin AXIS_PTS ldp_n_32__tq_alter "" 0xffe410be n_32 _REC_AXS_20_u1 816. _CNV_A_R_LINEAR_____15_CM 6 0. 8160. DISPLAY_IDENTIFIER LDP_N_32__TQ_ALTER FORMAT "%4.0" /end AXIS_PTS
/begin AXIS_PTS ldp_iga_dif_av__eff_iga_mon2 "" 0xffe47f84 iga_dif_av _REC_AXS_20_u1 -95.625 _CNV_A_R_LINEAR_____204_CM 8 0. -95.625 DISPLAY_IDENTIFIER LDP_IGA_DIF_AV__EFF_IGA_MON2 FORMAT "%6.2" /end AXIS_PTS
/begin AXIS_PTS ldp_maf__iga_ref_mon2 "" 0xffe47f9e maf_mon2 _REC_AXS_20_u1 1389. _CNV_A_R_LINEAR_____27_CM 8 0. 1389. DISPLAY_IDENTIFIER LDP_MAF__IGA_REF_MON2 FORMAT "%4.0" /end AXIS_PTS
/begin AXIS_PTS ldp_maf__tqi_ref_mon2 "" 0xffe47fb4 maf_mon2 _REC_AXS_20_u1 1389. _CNV_A_R_LINEAR_____27_CM 8 0. 1389. DISPLAY_IDENTIFIER LDP_MAF__TQI_REF_MON2 FORMAT "%4.0" /end AXIS_PTS
/begin AXIS_PTS ldp_n_32__iga_ref_mon2 "" 0xffe48030 n_32_mon2 _REC_AXS_20_u1 8160. _CNV_A_R_LINEAR_____15_CM 8 0. 8160. DISPLAY_IDENTIFIER LDP_N_32__IGA_REF_MON2 FORMAT "%4.0" /end AXIS_PTS
/begin AXIS_PTS ldp_n_32__tqi_dif_max_mon2 "" 0xffe410d3 n_32_mon2 _REC_AXS_20_u1 8160. _CNV_A_R_LINEAR_____15_CM 4 0. 8160. DISPLAY_IDENTIFIER LDP_N_32__TQI_DIF_MAX_MON2 FORMAT "%4.0" /end AXIS_PTS
/begin AXIS_PTS ldp_n_32__tqi_ref_mon2 "" 0xffe410d8 n_32_mon2 _REC_AXS_20_u1 8160. _CNV_A_R_LINEAR_____15_CM 6 0. 8160. DISPLAY_IDENTIFIER LDP_N_32__TQI_REF_MON2 FORMAT "%4.0" /end AXIS_PTS
/begin AXIS_PTS ldp_tqi_sp__tqi_dif_max_mon2 "" 0xffe412dd tqi_sp_mon2 _REC_AXS_20_u1 510. _CNV_A_R_LINEAR_____101_CM 4 0. 510. DISPLAY_IDENTIFIER LDP_TQI_SP__TQI_DIF_MAX_MON2 FORMAT "%3.0" /end AXIS_PTS
/begin AXIS_PTS ldp_n_32__fac_tq_req_driv_mon2 "" 0xffe4801e n_32_mon2 _REC_AXS_20_u1 8160. _CNV_A_R_LINEAR_____15_CM 8 0. 8160. DISPLAY_IDENTIFIER LDP_N_32__FAC_TQ_REQ_DRIV_MON2 FORMAT "%4.0" /end AXIS_PTS
/begin AXIS_PTS ldp_pv_av__fac_tq_req_driv_mon2 "" 0xffe48170 pv_av_mon2 _REC_AXS_20_u1 99.609375 _CNV_A_R_LINEAR_____9_CM 8 0. 99.609375 DISPLAY_IDENTIFIER LDP_PV_AV__FAC_TQ_REQ_DRIV_MON2 FORMAT "%5.2" /end AXIS_PTS
/begin AXIS_PTS ldpm_val_mo3_tst_rec_idx_mo2 "" 0xffe486f4 val_mo3_tst_rec_idx_mo2 _REC_AXS_20_u1 11. _CNV_A_R_LINEAR_____0_CM 12 0. 11. DISPLAY_IDENTIFIER LDPM_VAL_MO3_TST_REC_IDX_MO2 FORMAT "%2.0" /end AXIS_PTS
/begin AXIS_PTS ldpm_tst_rec "" 0xffe486e7 val_mo3_tst_rec_idx_mo2 _REC_AXS_20_u1 12. _CNV_A_R_LINEAR_____0_CM 12 0. 12. DISPLAY_IDENTIFIER LDPM_TST_REC FORMAT "%3.0" /end AXIS_PTS
/begin AXIS_PTS ldp_2_id_err_dtc_mis "" 0xffe5093a online_dummy _REC_AXS_20_u2 65535. _CNV_A_R_LINEAR_____0_CM 8 0. 65535. DISPLAY_IDENTIFIER LDP_2_ID_ERR_DTC_MIS FORMAT "%5.0" /end AXIS_PTS
/begin AXIS_PTS ldp_1_id_err_dtc_mis "" 0xffe41d08 online_dummy _REC_AXS_20_u2 65535. _CNV_A_R_LINEAR_____0_CM 2 0. 65535. DISPLAY_IDENTIFIER LDP_1_ID_ERR_DTC_MIS FORMAT "%5.0" /end AXIS_PTS
/begin AXIS_PTS ldpm_n_32_ip_egr_ratio "" 0xffe48538 n_32 _REC_AXS_20_u1 8160. _CNV_A_R_LINEAR_____15_CM 12 0. 8160. DISPLAY_IDENTIFIER LDPM_N_32_IP_EGR_RATIO FORMAT "%4.0" /end AXIS_PTS
/begin AXIS_PTS ldpm_maf_ip_egr_ratio "" 0xffe51976 maf _REC_AXS_20_u2 1389. _CNV_A_R_LINEAR_____108_CM 12 0. 1389. DISPLAY_IDENTIFIER LDPM_MAF_IP_EGR_RATIO FORMAT "%7.2" /end AXIS_PTS
/begin AXIS_PTS ldpm_n_32__tqi_min_pu "" 0xffe48507 n_32 _REC_AXS_20_u1 8160. _CNV_A_R_LINEAR_____15_CM 12 0. 8160. DISPLAY_IDENTIFIER LDPM_N_32__TQI_MIN_PU FORMAT "%4.0" /end AXIS_PTS
/begin AXIS_PTS ldpm_tco__tqi_min_pu "" 0xffe41452 tco _REC_AXS_20_u1 190.5 _CNV_A_R_LINEAR_____11_CM 4 -48. 142.5 DISPLAY_IDENTIFIER LDPM_TCO__TQI_MIN_PU FORMAT "%5.1" /end AXIS_PTS
/begin AXIS_PTS ldpm_maf_cyl_ip_rel_flow_inc_cp "" 0xffe51948 maf_cyl _REC_AXS_20_u2 2047.96875 _CNV_A_R_LINEAR_____115_CM 6 0. 2047.96875 DISPLAY_IDENTIFIER LDPM_MAF_CYL_IP_REL_FLOW_INC_CP FORMAT "%6.2" /end AXIS_PTS
/begin AXIS_PTS ldpm_n_32_ip_rel_flow_max_cps "" 0xffe48545 n_32 _REC_AXS_20_u1 8160. _CNV_A_R_LINEAR_____15_CM 12 0. 8160. DISPLAY_IDENTIFIER LDPM_N_32_IP_REL_FLOW_MAX_CPS FORMAT "%4.0" /end AXIS_PTS
/begin AXIS_PTS ldpm_n_32_ip_fuel_dly_cps "" 0xffe413d8 n_32 _REC_AXS_20_u1 8160. _CNV_A_R_LINEAR_____15_CM 6 0. 8160. DISPLAY_IDENTIFIER LDPM_N_32_IP_FUEL_DLY_CPS FORMAT "%4.0" /end AXIS_PTS
/begin AXIS_PTS ldpm_n_32_s "" 0xffe4856d n_32 _REC_AXS_20_u1 8160. _CNV_A_R_LINEAR_____15_CM 16 0. 8160. DISPLAY_IDENTIFIER LDPM_N_32_S FORMAT "%4.0" /end AXIS_PTS
/begin AXIS_PTS ldpm_pq_estim_id_maf_fac_ofs "" 0xffe51c60 pq_estim _REC_AXS_20_u2 0.99998474 _CNV_A_R_LINEAR_____37_CM 16 0. 0.99998474 DISPLAY_IDENTIFIER LDPM_PQ_ESTIM_ID_MAF_FAC_OFS FORMAT "%7.5" /end AXIS_PTS
/begin AXIS_PTS ldpm_n_1_thro "" 0xffe51a9a n _REC_AXS_20_u2 8160. _CNV_A_R_LINEAR_____10_CM 8 0. 8160. DISPLAY_IDENTIFIER LDPM_N_1_THRO FORMAT "%4.0" /end AXIS_PTS
/begin AXIS_PTS ldpm_tco_st_tco_lam_min "" 0xffe41465 tco_st _REC_AXS_20_u1 190.5 _CNV_A_R_LINEAR_____11_CM 6 -48. 142.5 DISPLAY_IDENTIFIER LDPM_TCO_ST_TCO_LAM_MIN FORMAT "%5.1" /end AXIS_PTS
/begin AXIS_PTS ldp_vls_lsl_cor_mv_ip_lamb "" 0xffe516ce lam_bank_1.ls_up.vls_lsl_cor _REC_AXS_20_u2 4.99511719 _CNV_A_R_LINEAR_____3_CM 16 0. 4.99511719 DISPLAY_IDENTIFIER LDP_VLS_LSL_COR_MV_IP_LAMB FORMAT "%5.3" /end AXIS_PTS
/begin AXIS_PTS ldp_maf_sub__maf_sub_thd_mon "" 0xffe52207 maf_sub_1 _REC_AXS_20_u1 1389. _CNV_A_R_LINEAR_____27_CM 2 0. 1389. DISPLAY_IDENTIFIER LDP_MAF_SUB__MAF_SUB_THD_MON FORMAT "%4.0" /end AXIS_PTS
/begin AXIS_PTS ldp_id_saf_tab_1 "" 0xffe47f62 online_dummy _REC_AXS_20_u1 255. _CNV_A_R_LINEAR_____0_CM 16 0. 255. DISPLAY_IDENTIFIER LDP_ID_SAF_TAB_1 FORMAT "%3.0" /end AXIS_PTS
/begin AXIS_PTS ldp_id_saf_tab_2 "" 0xffe47f73 online_dummy _REC_AXS_20_u1 255. _CNV_A_R_LINEAR_____0_CM 16 0. 255. DISPLAY_IDENTIFIER LDP_ID_SAF_TAB_2 FORMAT "%3.0" /end AXIS_PTS
/begin AXIS_PTS ldpm_n_id_crk_acq "" 0xffe51be4 n _REC_AXS_20_u2 8160. _CNV_A_R_LINEAR_____10_CM 6 0. 8160. DISPLAY_IDENTIFIER LDPM_N_ID_CRK_ACQ FORMAT "%4.0" /end AXIS_PTS
/begin AXIS_PTS ldpm_n_id_cam_acq "" 0xffe51bca n _REC_AXS_20_u2 8160. _CNV_A_R_LINEAR_____10_CM 12 0. 8160. DISPLAY_IDENTIFIER LDPM_N_ID_CAM_ACQ FORMAT "%4.0" /end AXIS_PTS
/begin AXIS_PTS ldpm_clas_a_id_clas_fmy "" 0xffe51778 online_dummy _REC_AXS_20_u2 65535. _CNV_A_R_LINEAR_____0_CM 16 0. 65535. DISPLAY_IDENTIFIER LDPM_CLAS_A_ID_CLAS_FMY FORMAT "%5.0" /end AXIS_PTS
/begin AXIS_PTS ldp_clas_b_id_clas_fmy "" 0xffe50aa8 online_dummy _REC_AXS_20_u2 65535. _CNV_A_R_LINEAR_____0_CM 4 0. 65535. DISPLAY_IDENTIFIER LDP_CLAS_B_ID_CLAS_FMY FORMAT "%5.0" /end AXIS_PTS
/begin AXIS_PTS ldp_fmy_dtc "" 0xffe50bd0 online_dummy _REC_AXS_20_u2 5. _CNV_A_R_LINEAR_____22_CM 6 0. 5. DISPLAY_IDENTIFIER LDP_FMY_DTC FORMAT "%2.0" /end AXIS_PTS
/begin AXIS_PTS ldp_fmy_envd "" 0xffe4102c online_dummy _REC_AXS_20_u1 3. _CNV_A_R_LINEAR_____22_CM 4 0. 3. DISPLAY_IDENTIFIER LDP_FMY_ENVD FORMAT "%2.0" /end AXIS_PTS
/begin AXIS_PTS ldpm_n_110 "" 0xffe4843c n_32 _REC_AXS_20_u1 8160. _CNV_A_R_LINEAR_____15_CM 8 0. 8160. DISPLAY_IDENTIFIER LDPM_N_110 FORMAT "%4.0" /end AXIS_PTS
/begin AXIS_PTS ldpm_gr_tra_at_2 "" 0xffe41357 gr_at _REC_AXS_20_u1 255. _CNV_A_R_LINEAR_____0_CM 7 0. 255. DISPLAY_IDENTIFIER LDPM_GR_TRA_AT_2 FORMAT "%3.0" /end AXIS_PTS
/begin AXIS_PTS ldpm_gr_tra_mt_2 "" 0xffe483de gr_mt _REC_AXS_20_u1 255. _CNV_A_R_LINEAR_____0_CM 8 0. 255. DISPLAY_IDENTIFIER LDPM_GR_TRA_MT_2 FORMAT "%3.0" /end AXIS_PTS
/begin AXIS_PTS ldp_toil_t_ramp_conv_pos "" 0xffe482d4 toil _REC_AXS_20_u1 200. _CNV_A_R_LINEAR_____14_CM 8 -40. 160. DISPLAY_IDENTIFIER LDP_TOIL_T_RAMP_CONV_POS FORMAT "%3.0" /end AXIS_PTS
/begin AXIS_PTS ldp_toil_t_ramp_conv_neg "" 0xffe482cb toil _REC_AXS_20_u1 200. _CNV_A_R_LINEAR_____14_CM 8 -40. 160. DISPLAY_IDENTIFIER LDP_TOIL_T_RAMP_CONV_NEG FORMAT "%3.0" /end AXIS_PTS
/begin AXIS_PTS ldp_v_toil__toil "" 0xffe482f7 v_toil _REC_AXS_20_u1 4.998 _CNV_A_R_LINEAR_____44_CM 16 0. 4.998 DISPLAY_IDENTIFIER LDP_V_TOIL__TOIL FORMAT "%6.4" /end AXIS_PTS
/begin AXIS_PTS ldp_quo_maf_int_efc_o2l_mdl "" 0xffe51236 online_dummy _REC_AXS_20_u2 99.99847412 _CNV_A_R_LINEAR_____8_CM 8 0. 99.99847412 DISPLAY_IDENTIFIER LDP_QUO_MAF_INT_EFC_O2L_MDL /end AXIS_PTS
/begin AXIS_PTS ldpm_n_dif_pred_fac_tq_add_is "" 0xffe51b9e n_dif_pred_pl_drof _REC_AXS_20_u2 65535. _CNV_A_R_LINEAR_____207_CM 8 -32768. 32767. DISPLAY_IDENTIFIER LDPM_N_DIF_PRED_FAC_TQ_ADD_IS FORMAT "%6.0" /end AXIS_PTS
/begin AXIS_PTS ldpm_n_t_n_dif_ofs_pred "" 0xffe51bf2 n _REC_AXS_20_u2 8160. _CNV_A_R_LINEAR_____10_CM 8 0. 8160. DISPLAY_IDENTIFIER LDPM_N_T_N_DIF_OFS_PRED FORMAT "%4.0" /end AXIS_PTS
/begin AXIS_PTS ldpm_fac_tq_req_drof "" 0xffe5186e fac_tq_req _REC_AXS_20_u2 1.99996948 _CNV_A_R_LINEAR_____20_CM 6 0. 1.99996948 DISPLAY_IDENTIFIER LDPM_FAC_TQ_REQ_DROF FORMAT "%7.5" /end AXIS_PTS
/begin COMPU_METHOD _CNV_A_R_LINEAR_____0_CM "" RAT_FUNC "%6.3" "-" COEFFS 0 1. 0. 0 0 1 /end COMPU_METHOD
/begin COMPU_METHOD _CNV_A_R_LINEAR_____3_CM "" RAT_FUNC "%6.3" "V" COEFFS 0 204.7999998974999 0. 0 0 1 /end COMPU_METHOD
/begin COMPU_METHOD _CNV_A_R_LINEAR_____4_CM "" RAT_FUNC "%6.3" "s" COEFFS 0 100. 0. 0 0 1 /end COMPU_METHOD
/begin COMPU_METHOD _CNV_A_R_LINEAR_____6_CM "" RAT_FUNC "%6.3" "°C" COEFFS 0 16. 0. 0 0 1 /end COMPU_METHOD
/begin COMPU_METHOD _CNV_A_R_LINEAR_____8_CM "" RAT_FUNC "%6.3" "%" COEFFS 0 655.3600000071681 0. 0 0 1 /end COMPU_METHOD
/begin COMPU_METHOD _CNV_A_R_LINEAR_____9_CM "" RAT_FUNC "%6.3" "%" COEFFS 0 2.56 0. 0 0 1 /end COMPU_METHOD
/begin COMPU_METHOD _CNV_A_R_LINEAR_____10_CM "" RAT_FUNC "%6.3" "rpm" COEFFS 0 1. 0. 0 0 1 /end COMPU_METHOD
/begin COMPU_METHOD _CNV_A_R_LINEAR_____11_CM "" RAT_FUNC "%6.3" "°C" COEFFS 0 1.333333333333333 64. 0 0 1 /end COMPU_METHOD
/begin COMPU_METHOD _CNV_A_R_LINEAR_____14_CM "" RAT_FUNC "%6.3" "°C" COEFFS 0 1. 40. 0 0 1 /end COMPU_METHOD
/begin COMPU_METHOD _CNV_A_R_LINEAR_____15_CM "" RAT_FUNC "%6.3" "rpm" COEFFS 0 3.125e-002 0. 0 0 1 /end COMPU_METHOD
/begin COMPU_METHOD _CNV_A_R_LINEAR_____20_CM "" RAT_FUNC "%6.3" "-" COEFFS 0 32768.00003968061 0. 0 0 1 /end COMPU_METHOD
/begin COMPU_METHOD _CNV_A_R_LINEAR_____22_CM "" RAT_FUNC "%6.3" "[-]" COEFFS 0 1. 0. 0 0 1 /end COMPU_METHOD
/begin COMPU_METHOD _CNV_A_R_LINEAR_____23_CM "" RAT_FUNC "%6.3" "km/h" COEFFS 0 1. 0. 0 0 1 /end COMPU_METHOD
/begin COMPU_METHOD _CNV_A_R_LINEAR_____24_CM "" RAT_FUNC "%6.3" "s" COEFFS 0 10. 0. 0 0 1 /end COMPU_METHOD
/begin COMPU_METHOD _CNV_A_R_LINEAR_____27_CM "" RAT_FUNC "%6.3" "mg/stk" COEFFS 0 0.183585313174946 0. 0 0 1 /end COMPU_METHOD
/begin COMPU_METHOD _CNV_A_R_LINEAR_____29_CM "" RAT_FUNC "%6.3" "-" COEFFS 0 255.9983911655618 0. 0 0 1 /end COMPU_METHOD
/begin COMPU_METHOD _CNV_A_R_LINEAR_____34_CM "" RAT_FUNC "%6.3" "V" COEFFS 0 9.846168103048838 0. 0 0 1 /end COMPU_METHOD
/begin COMPU_METHOD _CNV_A_R_LINEAR_____37_CM "" RAT_FUNC "%6.3" "-" COEFFS 0 65536.00007936121 0. 0 0 1 /end COMPU_METHOD
/begin COMPU_METHOD _CNV_A_R_LINEAR_____39_CM "" RAT_FUNC "%6.3" "-" COEFFS 0 127.9991955827809 0. 0 0 1 /end COMPU_METHOD
/begin COMPU_METHOD _CNV_A_R_LINEAR_____44_CM "" RAT_FUNC "%6.3" "V" COEFFS 0 51.0204081632653 0. 0 0 1 /end COMPU_METHOD
/begin COMPU_METHOD _CNV_A_R_LINEAR_____47_CM "" RAT_FUNC "%6.3" "kg/h" COEFFS 0 64. 0. 0 0 1 /end COMPU_METHOD
/begin COMPU_METHOD _CNV_A_R_LINEAR_____49_CM "" RAT_FUNC "%6.3" "hPa" COEFFS 0 12.06017666543982 0. 0 0 1 /end COMPU_METHOD
/begin COMPU_METHOD _CNV_A_R_LINEAR_____50_CM "" RAT_FUNC "%6.3" "[-]" COEFFS 0 255.9999357490357 0. 0 0 1 /end COMPU_METHOD
/begin COMPU_METHOD _CNV_A_R_LINEAR_____53_CM "" RAT_FUNC "%6.3" "°TPS" COEFFS 0 137.0962343096234 0. 0 0 1 /end COMPU_METHOD
/begin COMPU_METHOD _CNV_A_R_LINEAR_____54_CM "" RAT_FUNC "%6.3" "rpm/s" COEFFS 0 3.125e-002 128. 0 0 1 /end COMPU_METHOD
/begin COMPU_METHOD _CNV_A_R_LINEAR_____55_CM "" RAT_FUNC "%6.3" "Nm" COEFFS 0 32. 0. 0 0 1 /end COMPU_METHOD
/begin COMPU_METHOD _CNV_A_R_LINEAR_____60_CM "" RAT_FUNC "%6.3" "V" COEFFS 0 9.807692307692308 0. 0 0 1 /end COMPU_METHOD
/begin COMPU_METHOD _CNV_A_R_LINEAR_____82_CM "" RAT_FUNC "%6.3" "°CRK" COEFFS 0 2.666666666666667 0. 0 0 1 /end COMPU_METHOD
/begin COMPU_METHOD _CNV_A_R_LINEAR_____85_CM "" RAT_FUNC "%6.3" "km/h" COEFFS 0 128.0000018750286 0. 0 0 1 /end COMPU_METHOD
/begin COMPU_METHOD _CNV_A_R_LINEAR_____88_CM "" RAT_FUNC "%6.3" "km" COEFFS 0 0.1 0. 0 0 1 /end COMPU_METHOD
/begin COMPU_METHOD _CNV_A_R_LINEAR_____95_CM "" RAT_FUNC "%6.3" "Nm" COEFFS 0 1. 0. 0 0 1 /end COMPU_METHOD
/begin COMPU_METHOD _CNV_A_R_LINEAR_____97_CM "" RAT_FUNC "%6.3" "min" COEFFS 0 1. 0. 0 0 1 /end COMPU_METHOD
/begin COMPU_METHOD _CNV_A_R_LINEAR_____101_CM "" RAT_FUNC "%6.3" "Nm" COEFFS 0 0.5 0. 0 0 1 /end COMPU_METHOD
/begin COMPU_METHOD _CNV_A_R_LINEAR_____103_CM "" RAT_FUNC "%6.3" "m/s²" COEFFS 0 640. 32768. 0 0 1 /end COMPU_METHOD
/begin COMPU_METHOD _CNV_A_R_LINEAR_____108_CM "" RAT_FUNC "%6.3" "mg/stk" COEFFS 0 47.18142548596112 0. 0 0 1 /end COMPU_METHOD
/begin COMPU_METHOD _CNV_A_R_LINEAR_____115_CM "" RAT_FUNC "%6.3" "kg/h" COEFFS 0 32. 0. 0 0 1 /end COMPU_METHOD
/begin COMPU_METHOD _CNV_A_R_LINEAR_____116_CM "" RAT_FUNC "%6.3" "hPa" COEFFS 0 12.06017666543982 32767.5 0 0 1 /end COMPU_METHOD
/begin COMPU_METHOD _CNV_A_R_LINEAR_____129_CM "" RAT_FUNC "%6.3" "[-]" COEFFS 0 64. 0. 0 0 1 /end COMPU_METHOD
/begin COMPU_METHOD _CNV_A_R_LINEAR_____165_CM "" RAT_FUNC "%6.3" "ms" COEFFS 0 250. 0. 0 0 1 /end COMPU_METHOD
/begin COMPU_METHOD _CNV_A_R_LINEAR_____185_CM "" RAT_FUNC "%6.3" "Seg" COEFFS 0 1. 0. 0 0 1 /end COMPU_METHOD
/begin COMPU_METHOD _CNV_A_R_LINEAR_____187_CM "" RAT_FUNC "%6.3" "Nm" COEFFS 0 32. 32768. 0 0 1 /end COMPU_METHOD
/begin COMPU_METHOD _CNV_A_R_LINEAR_____199_CM "" RAT_FUNC "%6.3" "hPa" COEFFS 0 0.3768805207949945 0. 0 0 1 /end COMPU_METHOD
/begin COMPU_METHOD _CNV_A_R_LINEAR_____204_CM "" RAT_FUNC "%6.3" "°CRK" COEFFS 0 -2.666666666666667 0. 0 0 1 /end COMPU_METHOD
/begin COMPU_METHOD _CNV_A_R_LINEAR_____206_CM "" RAT_FUNC "%6.3" "-" COEFFS 0 1023.999999919998 0. 0 0 1 /end COMPU_METHOD
/begin COMPU_METHOD _CNV_A_R_LINEAR_____207_CM "" RAT_FUNC "%6.3" "rpm" COEFFS 0 1. 32768. 0 0 1 /end COMPU_METHOD
/begin COMPU_METHOD _CNV_A_R_LINEAR_____216_CM "" RAT_FUNC "%6.3" "rpm" COEFFS 0 3.125e-002 128. 0 0 1 /end COMPU_METHOD
/begin COMPU_METHOD _CNV_A_R_LINEAR_____248_CM "" RAT_FUNC "%6.3" "-" COEFFS 0 64. 0. 0 0 1 /end COMPU_METHOD
/begin COMPU_METHOD _CNV_A_R_LINEAR_____269_CM "" RAT_FUNC "%6.3" "V" COEFFS 0 204.8 0. 0 0 1 /end COMPU_METHOD
/begin COMPU_METHOD _CNV_A_R_LINEAR_____280_CM "" RAT_FUNC "%6.3" "°C" COEFFS 0 43.47840509520334 2086.96344456976 0 0 1 /end COMPU_METHOD
/begin COMPU_METHOD _CNV_A_R_LINEAR_____287_CM "" RAT_FUNC "%6.3" "g" COEFFS 0 36.00036915004301 0. 0 0 1 /end COMPU_METHOD
/begin COMPU_METHOD _CNV_A_R_LINEAR_____304_CM "" RAT_FUNC "%6.3" "ohm" COEFFS 0 4. 0. 0 0 1 /end COMPU_METHOD
/begin COMPU_METHOD _CNV_A_R_LINEAR_____309_CM "" RAT_FUNC "%6.3" "ohm" COEFFS 0 1. 0. 0 0 1 /end COMPU_METHOD
/begin COMPU_METHOD _CNV_A_R_LINEAR_____310_CM "" RAT_FUNC "%6.3" "W" COEFFS 0 1000. 0. 0 0 1 /end COMPU_METHOD
/begin COMPU_METHOD _CNV_A_R_LINEAR_____311_CM "" RAT_FUNC "%6.3" "°C" COEFFS 0 15.99999609363174 0. 0 0 1 /end COMPU_METHOD
/begin COMPU_METHOD _CNV_A_R_LINEAR_____343_CM "" RAT_FUNC "%6.3" "°C" COEFFS 0 64. 2112. 0 0 1 /end COMPU_METHOD
/begin COMPU_METHOD _CNV_A_R_LINEAR_____355_CM "" RAT_FUNC "%6.3" "V" COEFFS 0 204.799999948775 1023.999999743875 0 0 1 /end COMPU_METHOD
/begin COMPU_METHOD _CNV_A_R_LINEAR_____368_CM "" RAT_FUNC "%6.3" "°C" COEFFS 0 15.99999804684544 32767.99599993945 0 0 1 /end COMPU_METHOD
/begin COMPU_METHOD _CNV_A_R_LINEAR_____373_CM "" RAT_FUNC "%6.3" "mA" COEFFS 0 2601.421086059067 32767.5 0 0 1 /end COMPU_METHOD
/begin COMPU_METHOD _CNV_A_R_LINEAR_____382_CM "" RAT_FUNC "%6.3" "cm²" COEFFS 0 1118.481084425738 0. 0 0 1 /end COMPU_METHOD
/begin COMPU_METHOD _CNV_A_R_LINEAR_____394_CM "" RAT_FUNC "%6.3" "-" COEFFS 0 8191.999999679995 0. 0 0 1 /end COMPU_METHOD
/begin COMPU_METHOD _CNV_A_R_LINEAR_____396_CM "" RAT_FUNC "%6.3" "°CRK" COEFFS 0 42.66666666666666 32768. 0 0 1 /end COMPU_METHOD
/begin COMPU_METHOD _CNV_A_R_LINEAR_____399_CM "" RAT_FUNC "%6.3" "mg/stk" COEFFS 0 47.18142548596112 32767.5 0 0 1 /end COMPU_METHOD
/begin COMPU_METHOD _CNV_A_R_LINEAR_____402_CM "" RAT_FUNC "%6.3" "°TPS" COEFFS 0 2.133891213389121 0. 0 0 1 /end COMPU_METHOD
/begin COMPU_METHOD _CNV_A_R_LINEAR_____403_CM "" RAT_FUNC "%6.3" "-" COEFFS 0 255.9999357490357 0. 0 0 1 /end COMPU_METHOD
/begin COMPU_METHOD _CNV_A_R_LINEAR_____407_CM "" RAT_FUNC "%6.3" "°TPS" COEFFS 0 137.0962343096234 16383. 0 0 1 /end COMPU_METHOD
/begin COMPU_METHOD _CNV_A_R_LINEAR_____415_CM "" RAT_FUNC "%6.3" "%" COEFFS 0 327.67 0. 0 0 1 /end COMPU_METHOD
/begin COMPU_METHOD _CNV_A_R_LINEAR_____431_CM "" RAT_FUNC "%6.3" "ppm" COEFFS 0 0.25 0. 0 0 1 /end COMPU_METHOD
/begin COMPU_METHOD _CNV_A_R_LINEAR_____441_CM "" RAT_FUNC "%6.3" "-" COEFFS 0 2. 0. 0 0 1 /end COMPU_METHOD
/begin COMPU_METHOD _CNV_A_R_LINEAR_____450_CM "" RAT_FUNC "%6.3" "kg/h" COEFFS 0 128.0000018750286 0. 0 0 1 /end COMPU_METHOD
/begin COMPU_METHOD _CNV_A_R_LINEAR_____466_CM "" RAT_FUNC "%6.3" "V" COEFFS 0 204.7999998958713 8.135057072422569e-009 0 0 1 /end COMPU_METHOD
/begin COMPU_METHOD _CNV_A_R_LINEAR_____476_CM "" RAT_FUNC "%6.3" "°C" COEFFS 0 1.262376237623762 255. 0 0 1 /end COMPU_METHOD
/begin COMPU_METHOD _CNV_A_R_LINEAR_____477_CM "" RAT_FUNC "%6.3" "°C" COEFFS 0 1.331683168316832 269. 0 0 1 /end COMPU_METHOD
/begin COMPU_METHOD _CNV_A_R_LINEAR_____479_CM "" RAT_FUNC "%6.3" "KW" COEFFS 0 149.2228528379436 0. 0 0 1 /end COMPU_METHOD
/begin COMPU_METHOD _CNV_A_R_LINEAR_____480_CM "" RAT_FUNC "%6.3" "°CRK" COEFFS 0 2.666666666666667 255. 0 0 1 /end COMPU_METHOD
/begin COMPU_METHOD _CNV_A_R_LINEAR_____489_CM "" RAT_FUNC "%6.3" "mg" COEFFS 0 4. 32768. 0 0 1 /end COMPU_METHOD
/begin COMPU_METHOD _CNV_A_R_LINEAR_____494_CM "" RAT_FUNC "%6.3" "mm" COEFFS 0 1000. 0. 0 0 1 /end COMPU_METHOD
/begin COMPU_METHOD _CNV_A_R_LINEAR_____496_CM "" RAT_FUNC "%6.3" "V" COEFFS 0 51.2 0. 0 0 1 /end COMPU_METHOD
/begin COMPU_METHOD _CNV_A_R_LINEAR_____500_CM "" RAT_FUNC "%6.3" "°TPS" COEFFS 0 548.4100418410042 0. 0 0 1 /end COMPU_METHOD
/begin COMPU_METHOD _CNV_A_R_LINEAR_____513_CM "" RAT_FUNC "%6.3" "m/s²" COEFFS 0 2084.478388983038 32768.00027481336 0 0 1 /end COMPU_METHOD
/begin COMPU_METHOD _CNV_A_R_LINEAR_____528_CM "" RAT_FUNC "%6.3" "°STW" COEFFS 0 22.75571737399022 32768. 0 0 1 /end COMPU_METHOD
/begin COMPU_METHOD _CNV_A_R_LINEAR_____529_CM "" RAT_FUNC "%6.3" "°STW/s" COEFFS 0 22.75571737399022 32768. 0 0 1 /end COMPU_METHOD
/begin COMPU_METHOD _CNV_A_R_LINEAR_____571_CM "" RAT_FUNC "%6.3" "%" COEFFS 0 327.6800000071683 0. 0 0 1 /end COMPU_METHOD
/begin RECORD_LAYOUT _REC_AXS_20_u1 NO_AXIS_PTS_X 1 UBYTE AXIS_PTS_X 2 UBYTE INDEX_INCR DIRECT /end RECORD_LAYOUT
/begin RECORD_LAYOUT _REC_AXS_20_u2 NO_AXIS_PTS_X 1 UWORD AXIS_PTS_X 2 UWORD INDEX_INCR DIRECT /end RECORD_LAYOUT
/begin FUNCTION X__DDS_EXPA2_DEFAULT_FUNC__ "X__DDS_EXPA2_DEFAULT_FUNC__"
 /begin DEF_CHARACTERISTIC ldp_n_32__lamb_iga_afl ldp_maf_hb__lamb_iga_afl ldp_tco_ip_lamb_scc ldpm_n_32__maf_delta_lamb_i ldpm_maf_cyl__crlc_delta_lamb ldpm_cat_diag_1_laco ldpm_vls_dif_dly__delta_lamb ldp_maf__vls_sp_dly_1 ldp_n_32__vls_sp_dly_1 ldp_maf__vls_sp_dly_2 ldp_n_32__vls_sp_dly_2 ldp_tco__ti_wf_max_lam ldp_tco__t_lam_stop ldp_maf_int_puc ldp_temp_main_cat ldp_maf_cyl ldp_quo_maf_int_purge ldpm_cat_diag ldp_temp_pcat ldpm_maf_hb_2_egtr ldpm_n_32_2_egtr ldp_t_ast_fac_2_sp_lamb_de ldp_temp_cat_fac_2_sp_lamb_de ldp_cat_diag_fac_1_sp_lamb_de ldpm_t_vls_cyc_afl_hld ldp_r_down_ls_ip_ttip_ls_down ldp_maf_kgh_crlc_ttip_ref_ls ldp_pow_lsh_down_mmv_r_down_ls ldp_ttip_ref_ls_down_mdl_r_down ldpm_temp_ls_ini_1_egcp ldp_vs_fac_v_efc_teg ldpm_n_32_1_egcp ldpm_teg_cat_up_mdl_1_egcp ldpm_teg_cat_down_mdl_1_egcp ldpm_temp_ls_down_ini_1_egcp ldp_n_32_ip_v_efc_lsh_down_ctl ldp_vs_ip_fac_v_efc_down_teg ldp_amp__fac_cor ldp_n_32__fac_cor ldp_ttip_ls_up_mes__fac_cor ldp_iplsl_cor_chg_purge ldp_maf_kgh__fac_cor ldp_tco_st__t_dly_ls_ready ldp_tco_st__t_deac_ls_ready ldp_prs_ex_iplsl_fac ldp_id_maf_tab_1 ldp_id_maf_tab_2 ldp_n__pq_sp_puls ldpm_tia_maf_mdl_con_1 ldp_teg_egr_maf_egr_con_1 ldpm_n_32_ar_red ldpm_maf_mes__vol_im ldpm_n_32__vol_im ldpm_n_32__vol_im_is ldp_pq__ip_pq_isa ldp_ar_red__ip_pq_isa ldpm_pq_ar_red ldpm_maf_kgh_t_1_hfm ldpm_n_ar_red ldpm_pq__fac_ar_red_cor ldp_t_seg_t_1_ratio_crlc_hfm ldp_ar_red_ad_add_dif ldp_n_32_ar_red_egr ldp_stk_av_egr_ar_red_egr ldpm_maf_cyl_ex ldp_n_32__ip_t_vim_eff_vol ldp_maf_cyl_amp_dec ldp_maf_kgh_mes_bas ldpm_vo__eff_vol ldp_n_32_ip_crlc_eff_vol_temp ldpm_amp__eff_vol_amp ldpm_n_32__eff_vol_cor ldpm_maf__eff_vol_cor ldpm_n__eff_vol ldpm_cam_av_mv_in__eff_vol ldp_tps_seg_ar_red_thr ldp_isapwm_mmv ldp_n_32__pq_egr_sp ldp_n_32__fac_maf_max_s ldp_mff_sp_s__fac_maf_max_s ldp_maf_dif_s__eff_maf_s ldp_mff_sp_s__pq_egr_sp ldp_maf_turb_ratio__maf_sp_isa ldp_n__maf_sp_isa ldp_n_32__crlc_maf_diag ldpm_pq_turb_sys ldp_isapwm__fac_pq_isa ldp_n_32_mon__maf_sub_mon ldp_pq_turb_sys_mon__fac_pq_isa ldp_tps_av_mon__fac_tps_isa_mon ldp_tps_av_mon__maf_sub_mon ldp_amp__fac_maf_sub_cor_mon ldp_n_32_mon__pq_mon ldp_tps_sum_av_mon__pq_mon ldp_tia__fac_maf_sub_cor_mon ldp_isapwm__fac_pq_isa_mon ldp_v_map_map_mes_bas ldp_maf__mff_cor_1 ldp_maf__mff_cor_2 ldp_n__mff_cor_1 ldp_n__mff_cor_2 ldpm_tqi_sp_mff_s ldp_tps_dif__mtcpwm_p ldp_tps_dif__mtcpwm_i ldp_tps_av_lih_dif_mtcpwm_i ldp_tps_dif_grd__mtcpwm_d ldp_tps_sp_lih_dif__mtcpwm_add ldp_vb__mtcpwm_vb_fac ldpm_n_tooth__eoi_st ldpm_tco__eoi_tco ldpm_tco_n_sp_2 ldpm_tco_n_sp_1 ldpm_t_ast_n_sp_1 ldpm_ctr_km_can_n_sp_1 ldpm_toil_ip_n_sp_is_cs ldp_n_32_n_grd_thd ldpm_gear ldp_pv_av__n_max_mtc_cur_off ldp_toil__n_max_2 ldp_toil__n_max_1 ldp_v_o3_x_ip_o3 ldpm_o3_conc_up ldpm_n_32__lam_cat ldp_vls_down_ip_o2_cat ldpm_n_32_1_egtr ldpm_maf_1_egtr ldp_toil_max__stop_dec_fsd ldp_tco_st__stop_inc_fsd ldp_tco_st__t_st_eng_max ldp_maf_kgh__t_plaus_ls_up ldpm_n_32_ls_up_dyn ldpm_maf_hb_ls_up_dyn ldp_maf_kgh__vls_down_max_cycnr ldp_maf_kgh__fac_maf_lsh_down ldp_ttip_ref_ls_down_ip_fac_teg ldpm_ar_red_tot_bas ldp_opg_rel_st_ip_opg_sp_st_isa ldp_amp_ip_fac_amp_opg_st_isa ldp_tia_ip_fac_tia_opg_st_isa ldp_pv_av_ip_opg_rel_st_isa_pv ldp_n_32__pv_lih_max ldpm_vs_fil__pv_fac_cor ldpm_n_dif__pv_fac_cor ldpm_n__pv_fac_cor ldpm_pv_av_raw__pv_fac_cor ldpm_n_32__fac_tq_req_driv ldpm_fac_tq_cru_dcc ldp_v_pvs_min ldp_pv_av_min_mon_ip_pv_mon ldpm_tco_st_1_sair ldpm_n_32_maf_sa_deac ldpm_n_32_maf_sa_act ldp_ctr_km_can ldp_tco_st_id_t_dly_diag_sa ldp_tia_id_tco_min_diag_sa ldpm_fac_amp ldp_n_32__maf_max_diag_sa ldpm_n_32_id_saf_kgh_diag_min ldpm_n_32_id_saf_kgh_diag_max ldpm_maf_id_saf_kgh_diag_min ldpm_maf_id_saf_kgh_diag_max ldp_tco_st_id_sum_safm_diag ldp_maf_cyl__saf_mdl ldp_amp__saf_cor_amp ldp_vb__saf_cor_vb ldp_tam_ip_saf_cor_tam ldp_maf_kgh__tco_sub_inc ldp_v_tco__tco ldpm_tco_st__tco_dif_diag ldp_tco_st_id_t_tco_min ldpm_tia_1 ldp_vs_fil__tq_gs_inc ldp_n_32__tq_gs_inc ldp_v_tecu__tecu ldp_v_teg__teg ldpm_teg_stat_eng_pre ldpm_egr_ratio__teg ldpm_temp_toil_dif__fac_temp ldpm_lamb_sp_teg__fac_cor ldpm_nr_cyl_scc_teg__fac_scc ldpm_ecfpwm_ecf__fac_cor ldp_teg_stat__fac_tam ldpm_tam_dew__fac_teg ldpm_t_es_dew__fac_teg ldpm_temp_toil_dif__crlc_teg ldpm_temp_tco_dif__crlc_teg ldpm_maf_int_puc__crlc_teg ldpm_n_teg__vs_teg ldpm_tco_st__dew ldpm_teg_wall_cat_up_mdl_1 ldpm_teg_wall_cat_down_mdl_1 ldp_vs__fac_vs_teg ldp_pow_dif_max__add_teg_iga ldpm_vo_dif_teg__teg_stat ldpm_eff_iga_av_teg_cor ldpm_teg_stat__crlc_dec ldpm_teg_wall_stat__crlc_dec ldpm_teg_stat__crlc_inc ldpm_teg_wall_stat__crlc_inc ldpm_maf_teg__vs_teg ldpm_vs__fac_cor_vs_teg_ecf ldpm_vs_cor_teg__fac_cor ldp_vs_cor_teg_up_1__fac_cor ldpm_vs__fac_cor_vs_teg ldpm_maf_teg__teg_stat ldpm_n_teg__teg_stat ldpm_saf_kgh__fac_cor_saf ldpm_tco__fac_cor_tco_teg ldpm_tco__tco_eff_iga_teg ldpm_n_teg__crlc_teg ldp_r_up_ls_ip_ttip_ls_up ldp_maf_kgh_sp__amp_dec ldp_maf_sp__tps_sp_mdl_max ldp_n_32__tps_sp_mdl_max ldp_pq_sp__crlc_ar_red_sp ldp_pq_sp_isa ldp_ar_red_isa_sp_mmv ldp_maf_turb_ratio ldpm_vb_1 ldp_n_32__isapwm_isa_pwl ldp_isapwm_cor_isa__isapwm_isa ldp_ar_red_sp_mmv ldp_n_ip_fac_maf_dif_sp ldp_maf_dif_sp_cor_ip_maf_add ldp_pq_sp_wout_maf_add_ip_fac ldp_eoi__prs_inc_cmp ldp_crk_inj__prs_inc_cmp ldpm_prs_dec_inj__fac_ti_prs ldp_amp_mes_ti_st_amp_fac ldp_tco__mff_lgrd_ast ldp_cyc__mff_cst ldp_cyc_cast_ip_ti_deac_cast ldp_n_tooth__mff_cst ldp_tia_ip_ti_cast ldp_fac_cor_ti_cast ldp_map__ti_cast_fac_map ldpm_tco__mff_cst ldpm_tco__mff_deac_cst ldp_vb__ti_add_dly ldp_fup_map_dif__ti_add_dly ldp_vlft_av__cam_op_in_vvl ldp_n_32__eoi_bas ldp_n_32__eoi_bas_is ldp_ti_hom__eoi_bas ldp_ti_hom__eoi_bas_is ldp_tco__eoi_min_tipr ldp_cycnr_cst__fac_tipr_deac ldp_tco__mffpr_cst ldp_tco__mffpr_fac_st_es ldpm_tco__ti_st_rest ldp_tco_stop__fac_rest ldpm_tco__fac_stall ldp_t_es__rest ldp_t_ast_rest ldpm_maf_hb__ti_wup ldpm_tco__ti_wup ldp_tco_st__ti_tco_wup ldp_vo__ti_vo_wup ldpm_n_32__ti_wup ldp_map_dif__fac_ti_vo_wup ldp_map__ti_fac_n_map ldp_n_32__ti_fac_n_map ldp_toil_ti_fac_tia_toil ldp_tia_ti_fac_tia_toil ldp_tco__ti_fac_tco ldp_v_tia_tia ldpm_tco__reac ldp_map__fac_mff_map_wf ldpm_n_32__reac ldpm_cycnr_reac__reac ldp_tco_ip_tmag_ivvt ldp_toil_ip_tmag_ivvt ldp_pv_av_ip_tps_sp_st_pv ldp_tia_ip_fac_tia_tps_sp_st ldp_amp_ip_tps_sp_st_amp ldp_tps_rel_st_ip_tps_sp_st ldpm_tco__fac_tco_tqi ldpm_n_32_6 ldp_tps_av__maf_1_diag ldp_n_32__tps_max_ratio_diag ldp_n_32_tps_sp_pwl ldp_pv_av__tps_sp_ext ldpm_tco_1_thro ldp_n_ip_tps_sp_lgrd_st ldp_tco_ip_tps_sp_lgrd_st ldp_t_acc_ip_fac_tq_loss_acc_on ldp_n_32_ip_fac_tq_loss_acc_on ldp_n_32__tq_add_acc ldp_t_acc_fac_tq_loss_acc ldp_n_32__tq_add_heat_acc ldp_n_32__tq_loss_acc ldp_tq_accin_can__tq_loss_acc ldp_tq_loss_acc_inp__tq_add_acc ldpm_gr_at_100 ldpm_gr_mt_100 ldp_n_32__fac_tq_aj ldp_gear__fac_tq_aj ldpm_ac_veh_trv_tcs ldpm_vs_fil ldpm_n_32__tq_loss_ars ldp_tq_loss_ars_sp_can_max ldp_tq_loss_ars_av_can_max ldp_tco__tq_clu_amt ldp_n_dif__tq_clu_amt ldp_n_32_ip_tq_add_conv ldp_n_32_ip_tq_add_amt ldp_vs_fil__tq_clu_amt ldp_n_ratio_conv_fac_tq_conv ldp_toil_t_dly_n_sp_is ldp_toil_t_dly_conv ldp_toil_fac_conv ldp_gr_at_n_tur ldp_n_32__tq_conv ldp_vs_n_tur ldp_tq_conv_can__tq_conv ldpm_toil_tq_add_conv ldpm_vs_tq_add_conv ldp_n_grd_tq_add_conv ldp_ac_cru_tq_add_conv ldp_cl_mmv ldpm_n_100 ldp_maf_cyl_stk__tqfr ldp_tco__tqfr_add ldp_toil_tqfr_add ldp_n_tq_loss_lim ldp_tco_tq_loss_lim ldp_tco_st__tqfr_st ldp_tco_st__tqfr_dec_st ldp_amp_dif__tqfr_amp ldp_pq__tqfr_amp ldp_eff_scc_sp__nr_pat_scc ldpm_tco_ip_tq_st ldpm_n_dif_ip_tq_st ldp_n_32_mon__tqi_ref_mon ldp_maf_mon__tqi_ref_mon ldp_n_32_mon__iga_ref_mon ldp_maf_mon__iga_ref_mon ldp_iga_dif_av_mon__eff_iga_mon ldpm_n_fac_tq_req_driv ldpm_pv_av_fac_tq_req_driv ldpm_n_32_100 ldpm_maf_100 ldp_n_sp_is_ratio ldp_ecfpwm_ecf__pow_loss_ecf ldpm_n_32__maf_min_pu ldpm_tco__maf_min_pu ldp_mff_sp_s__tqi_ref_s ldp_tqi_sp_maf__maf_sp ldp_n_32__tqi_dif_lim ldp_tqi_sp_mon__tqi_dif_lim ldp_tqi_sp_mon__tqi_dif_max_mon ldp_n_32_mon__tqi_dif_max_mon ldp_n_dif_cor_mon_ip_tq_mon ldp_tco_mon_ip_fac_tq_p_d_mon ldp_tco_mon_ip_n_sp_is_mon ldp_n_tq_add_st ldp_tco_tq_add_st ldp_n_32_tq_add_tra ldp_tq_req_dif_tra_fac_tq_tra ldp_maf_mon__tq_loss_mon ldp_n_32_mon__tq_loss_mon ldp_tco_mon__tq_loss_mon ldp_ctr_km_can__tq_loss_mon ldp_n_32_mon__tq_max_clu_max_mon ldp_n_dif_mon_ip_tq_min_mon ldp_n_32_mon_ip_tqi_min_pu_mon ldp_tco_mon_ip_fac_conv_mon ldp_tco_mon_ip_tqi_min_pu_mon ldpm_gear__tq_p_max ldpm_vs_fil__tq_p_max ldp_ang_pste__tq_loss_pste ldp_vel_ang_pste__tq_loss_pste ldp_ang_pste__tq_add_pste ldp_n__fac_tq_add_pste ldp_n_32__fac_tq_req_driv_mon ldp_pv_av__fac_tq_req_driv_mon ldp_tia_fac_n_vim ldp_seg_ctr_fac_wf ldp_tco_st_ti_fac_wf ldp_tco_ti_wf_thd ldpm_maf_6 ldpm_n_29 ldpm_tib_ti_wf_thd ldpm_vo_1 ldp_maf_sp_tqi ldp_tia__fac_ti_wf ldp_tco__fac_ti_wf ldpm_tco_15 ldpm_tco_16 ldpm_n_32__seg_ad_cor ldp_maf__maf_dif_max_er_ad ldp_tps_av__tps_grd_max_er_ad ldp_load_mis__load_mis_dif_max ldp_load_mis__fac_add_er_0_at ldp_load_mis__fac_add_er_0_mt ldp_load_mis__fac_add_er_1_at ldp_load_mis__fac_add_er_1_mt ldp_load_mis__fac_add_er_2_at ldp_load_mis__fac_add_er_2_mt ldp_load_mis__fac_add_er_3_at ldp_load_mis__fac_add_er_3_mt ldp_load_mis__fac_add_er_4_at ldp_load_mis__fac_add_er_4_mt ldp_load_mis__fac_add_er_5_at ldp_load_mis__fac_add_er_5_mt ldp_load_ip_fac_load_drv2_er_at ldp_load_ip_fac_load_drv2_er_mt ldp_n_32_ip_fac_n_drv2_er_at ldp_n_32_ip_fac_n_drv2_er_mt ldp_n_32_ip_crlc_drv2_er_at ldp_n_32_ip_crlc_drv2_er_mt ldpm_n_32__fac_er_0_at ldpm_n_32__fac_er_0_mt ldpm_n_32__fac_er_1_at ldpm_n_32__fac_er_1_mt ldpm_n_32__fac_er_2_at ldpm_n_32__fac_er_2_mt ldpm_n_32__fac_er_3_at ldpm_n_32__fac_er_3_mt ldpm_n_32__fac_er_4_at ldpm_n_32__fac_er_4_mt ldpm_n_32__fac_er_5_at ldpm_n_32__fac_er_5_mt ldp_tq_loss_alter_1__tq_alter ldp_n_32__tq_alter ldp_iga_dif_av__eff_iga_mon2 ldp_maf__iga_ref_mon2 ldp_maf__tqi_ref_mon2 ldp_n_32__iga_ref_mon2 ldp_n_32__tqi_dif_max_mon2 ldp_n_32__tqi_ref_mon2 ldp_tqi_sp__tqi_dif_max_mon2 ldp_n_32__fac_tq_req_driv_mon2 ldp_pv_av__fac_tq_req_driv_mon2 ldpm_val_mo3_tst_rec_idx_mo2 ldpm_tst_rec ldp_2_id_err_dtc_mis ldp_1_id_err_dtc_mis ldpm_n_32_ip_egr_ratio ldpm_maf_ip_egr_ratio ldpm_n_32__tqi_min_pu ldpm_tco__tqi_min_pu ldpm_maf_cyl_ip_rel_flow_inc_cp ldpm_n_32_ip_rel_flow_max_cps ldpm_n_32_ip_fuel_dly_cps ldpm_n_32_s ldpm_pq_estim_id_maf_fac_ofs ldpm_n_1_thro ldpm_tco_st_tco_lam_min ldp_vls_lsl_cor_mv_ip_lamb ldp_maf_sub__maf_sub_thd_mon ldp_id_saf_tab_1 ldp_id_saf_tab_2 ldpm_n_id_crk_acq ldpm_n_id_cam_acq ldpm_clas_a_id_clas_fmy ldp_clas_b_id_clas_fmy ldp_fmy_dtc ldp_fmy_envd ldpm_n_110 ldpm_gr_tra_at_2 ldpm_gr_tra_mt_2 ldp_toil_t_ramp_conv_pos ldp_toil_t_ramp_conv_neg ldp_v_toil__toil ldp_quo_maf_int_efc_o2l_mdl ldpm_n_dif_pred_fac_tq_add_is ldpm_n_t_n_dif_ofs_pred ldpm_fac_tq_req_drof /end DEF_CHARACTERISTIC
/end FUNCTION
/end MODULE
/end PROJECT
