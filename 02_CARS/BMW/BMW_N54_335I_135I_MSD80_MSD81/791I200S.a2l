ASAP2_VERSION 1 41
/begin PROJECT MSD85 "Spray Guided DI-System with Piezo Injectors for 8-Cylinder"
/begin HEADER "_default_HeaderComment" PROJECT_NO _91 /end HEADER
/begin MODULE _default_ModuleName "_default_ModuleLongIdentifier"
/begin MOD_COMMON "_default_ModCommonComment" DEPOSIT ABSOLUTE BYTE_ORDER MSB_LAST ALIGNMENT_BYTE 1 ALIGNMENT_WORD 2 ALIGNMENT_LONG 2 ALIGNMENT_FLOAT32_IEEE 2 ALIGNMENT_FLOAT64_IEEE 4 /end MOD_COMMON
/begin AXIS_PTS ldpm_n_32_4_laco "" 0xa080679e n_32 _REC_AXS_20_u1 8160. _CNV_A_R_LINEAR_____10_CM 6 0. 8160. FORMAT "%4.0" /end AXIS_PTS
/begin AXIS_PTS ldpm_n_32_2_laco "" 0xa0806796 n_32 _REC_AXS_20_u1 8160. _CNV_A_R_LINEAR_____10_CM 6 0. 8160. FORMAT "%4.0" /end AXIS_PTS
/begin AXIS_PTS ldpm_maf_cyl_1_laco "" 0xa0806768 maf_cyl _REC_AXS_20_u2 2047.96875 _CNV_A_R_LINEAR_____215_CM 6 0. 2047.96875 FORMAT "%10.5" /end AXIS_PTS
/begin AXIS_PTS ldpm_eff_cat_diag_1_laco "" 0xa0806728 online_dummy _REC_AXS_20_u1 1.9921875 _CNV_A_R_LINEAR_____103_CM 8 0. 1.9921875 FORMAT "%8.6" /end AXIS_PTS
/begin AXIS_PTS ldpm_n_1_laco "" 0xa0806784 n _REC_AXS_20_u2 8160. _CNV_A_R_LINEAR_____14_CM 8 0. 8160. FORMAT "%4.0" /end AXIS_PTS
/begin AXIS_PTS ldpm_t1_lsl_up_1_laco "" 0xa08067b4 online_dummy _REC_AXS_20_u2 1.99996948242188 _CNV_A_R_LINEAR_____117_CM 8 0. 1.99996948242188 FORMAT "%7.5" /end AXIS_PTS
/begin AXIS_PTS ldpm_t1_lsl_up_2_laco "" 0xa08067c8 online_dummy _REC_AXS_20_u2 1.99996948242188 _CNV_A_R_LINEAR_____117_CM 4 0. 1.99996948242188 FORMAT "%7.5" /end AXIS_PTS
/begin AXIS_PTS ldpm_tco_st_1_laco "" 0xa0806808 tco_st _REC_AXS_20_u1 190.5 _CNV_A_R_LINEAR_____17_CM 6 -48. 142.5 FORMAT "%6.2" /end AXIS_PTS
/begin AXIS_PTS ldpm_t_dly_soi_lsl_pos_1_laco "" 0xa08067d4 online_dummy _REC_AXS_20_u2 1.023984 _CNV_A_R_LINEAR_____361_CM 8 0. 1.023984 FORMAT "%7.5" /end AXIS_PTS
/begin AXIS_PTS ldpm_t_dly_soi_lsl_pos_2_laco "" 0xa08067e8 online_dummy _REC_AXS_20_u2 1.023984 _CNV_A_R_LINEAR_____361_CM 4 0. 1.023984 FORMAT "%7.5" /end AXIS_PTS
/begin AXIS_PTS ldpm_vls_dif_lam_adj_1_laco "" 0xa0806810 online_dummy _REC_AXS_20_u2 9.99511719 _CNV_A_R_LACO_LINEA_362_CM 16 -5. 4.99511719 /end AXIS_PTS
/begin AXIS_PTS ldpm_vls_dif_lam_adj_2_laco "" 0xa0806834 online_dummy _REC_AXS_20_u2 9.99511719 _CNV_A_R_LACO_LINEA_362_CM 16 -5. 4.99511719 /end AXIS_PTS
/begin AXIS_PTS ldpm_maf_1_laco "" 0xa0806754 maf _REC_AXS_20_u2 1389. _CNV_A_R_LINEAR_____111_CM 8 0. 1389. FORMAT "%7.2" /end AXIS_PTS
/begin AXIS_PTS ldpm_tco_2_laco "" 0xa08067fa tco _REC_AXS_20_u1 190.5 _CNV_A_R_LINEAR_____17_CM 5 -48. 142.5 FORMAT "%6.2" /end AXIS_PTS
/begin AXIS_PTS ldpm_n_32_5_laco "" 0xa08067a8 n_32 _REC_AXS_20_u1 8160. _CNV_A_R_LINEAR_____10_CM 8 0. 8160. FORMAT "%4.0" /end AXIS_PTS
/begin AXIS_PTS ldpm_fac_lam_mv_1_laco "" 0xa0806740 online_dummy _REC_AXS_20_u2 99.99847412 _CNV_A_R_LINEAR_____178_CM 8 -50. 49.99847412 FORMAT "%7.3" /end AXIS_PTS
/begin MEASUREMENT lv_lam_ad_cdn "flag for time scheduler indicating good conditions for lambda adaptation" UBYTE _CNV_S_2_RANGE__0___1_CM 1 100. 0. 1. DISPLAY_IDENTIFIER LV_LAM_AD_CDN ECU_ADDRESS 0xd000768b BIT_MASK 0x1 /end MEASUREMENT
/begin AXIS_PTS ldp_mff_delta_add_lam_ad_t_pri "" 0xa0806660 online_dummy _REC_AXS_20_u2 1389. _CNV_A_R_LACO_LINEA_363_CM 8 -694.510597 694.489403 FORMAT "%7.2" /end AXIS_PTS
/begin AXIS_PTS ldp_fac_delta_l_rng_lam_ad_pri "" 0xa0806608 online_dummy _REC_AXS_20_u2 99.99847412 _CNV_A_R_LINEAR_____178_CM 8 -50. 49.99847412 FORMAT "%7.3" /end AXIS_PTS
/begin AXIS_PTS ldp_fac_delta_h_rng_lam_ad_pri "" 0xa08065f4 online_dummy _REC_AXS_20_u2 99.99847412 _CNV_A_R_LINEAR_____178_CM 8 -50. 49.99847412 FORMAT "%7.3" /end AXIS_PTS
/begin CHARACTERISTIC c_t_pri_max_lam_ad "maximum priority time to set temporary end of adaptation flag" VALUE 0xa0806cc4 _REC_VAL_20_u2 6553.5 _CNV_A_R_LINEAR_____4_CM 0. 6553.5 DISPLAY_IDENTIFIER C_T_PRI_MAX_LAM_AD FORMAT "%6.1" /end CHARACTERISTIC
/begin CHARACTERISTIC c_n_tol_add_rng_lam_ad "maximum engine speed for offset lambda adaptation" VALUE 0xa0806cb2 _REC_VAL_20_u1 8160. _CNV_A_R_LINEAR_____10_CM 0. 8160. DISPLAY_IDENTIFIER C_N_TOL_ADD_RNG_LAM_AD FORMAT "%4.0" /end CHARACTERISTIC
/begin CHARACTERISTIC c_n_tol_fac_l_rng_lam_ad "maximum engine speed for lower area factor lambda adaptation" VALUE 0xa0806cb4 _REC_VAL_20_u1 8160. _CNV_A_R_LINEAR_____10_CM 0. 8160. DISPLAY_IDENTIFIER C_N_TOL_FAC_L_RNG_LAM_AD FORMAT "%4.0" /end CHARACTERISTIC
/begin CHARACTERISTIC c_n_bol_fac_l_rng_lam_ad "minimum engine speed for lower area factor lambda adaptation" VALUE 0xa0806ca3 _REC_VAL_20_u1 8160. _CNV_A_R_LINEAR_____10_CM 0. 8160. DISPLAY_IDENTIFIER C_N_BOL_FAC_L_RNG_LAM_AD FORMAT "%4.0" /end CHARACTERISTIC
/begin CHARACTERISTIC c_n_bol_fac_h_rng_lam_ad "minimum engine speed for upper area factor lambda adaptation" VALUE 0xa0806ca2 _REC_VAL_20_u1 8160. _CNV_A_R_LINEAR_____10_CM 0. 8160. DISPLAY_IDENTIFIER C_N_BOL_FAC_H_RNG_LAM_AD FORMAT "%4.0" /end CHARACTERISTIC
/begin CHARACTERISTIC c_n_tol_fac_h_rng_lam_ad "maximum engine speed for upper area factor lambda adaptation" VALUE 0xa0806cb3 _REC_VAL_20_u1 8160. _CNV_A_R_LINEAR_____10_CM 0. 8160. DISPLAY_IDENTIFIER C_N_TOL_FAC_H_RNG_LAM_AD FORMAT "%4.0" /end CHARACTERISTIC
/begin CHARACTERISTIC id_t_pri_fac_l_rng_lam_ad "priority time for next requested lambda adaptation according to factor difference or lower area" CURVE 0xa0806910 _REC_CUR_20_u2_u2 6553.5 _CNV_A_R_LINEAR_____4_CM 0. 6553.5 DISPLAY_IDENTIFIER ID_T_PRI_FAC_L_RNG_LAM_AD FORMAT "%6.1"
 /begin AXIS_DESCR COM_AXIS online_dummy _CNV_A_R_LINEAR_____178_CM 8 -50. 49.99847412 FORMAT "%7.3" AXIS_PTS_REF ldp_fac_delta_l_rng_lam_ad_pri /end AXIS_DESCR
/end CHARACTERISTIC
/begin CHARACTERISTIC id_t_pri_mff_add_rng_lam_ad "priority time for next requested lambda adaptation according to offset difference" CURVE 0xa0806920 _REC_CUR_20_u2_u2 6553.5 _CNV_A_R_LINEAR_____4_CM 0. 6553.5 DISPLAY_IDENTIFIER ID_T_PRI_MFF_ADD_RNG_LAM_AD FORMAT "%6.1"
 /begin AXIS_DESCR COM_AXIS online_dummy _CNV_A_R_LACO_LINEA_363_CM 8 -694.510597 694.489403 FORMAT "%7.2" AXIS_PTS_REF ldp_mff_delta_add_lam_ad_t_pri /end AXIS_DESCR
/end CHARACTERISTIC
/begin CHARACTERISTIC ip_fac_n_mff_add_lam_ad "factor on lambda adaptation offset depending on engine speed" CURVE 0xa0806a62 _REC_CUR_20_u1_u1 1. _CNV_A_R_LINEAR_____103_CM 0. 1. DISPLAY_IDENTIFIER IP_FAC_N_MFF_ADD_LAM_AD FORMAT "%8.6"
 /begin AXIS_DESCR COM_AXIS n_32 _CNV_A_R_LINEAR_____10_CM 6 0. 8160. FORMAT "%4.0" AXIS_PTS_REF ldpm_n_32_4_laco /end AXIS_DESCR
/end CHARACTERISTIC
/begin CHARACTERISTIC ip_fac_n_fac_lam_ad "factor on lambda adaptation factor depending on engine speed" CURVE 0xa0806a5c _REC_CUR_20_u1_u1 1. _CNV_A_R_LINEAR_____103_CM 0. 1. DISPLAY_IDENTIFIER IP_FAC_N_FAC_LAM_AD FORMAT "%8.6"
 /begin AXIS_DESCR COM_AXIS n_32 _CNV_A_R_LINEAR_____10_CM 6 0. 8160. FORMAT "%4.0" AXIS_PTS_REF ldpm_n_32_4_laco /end AXIS_DESCR
/end CHARACTERISTIC
/begin CHARACTERISTIC ip_fac_wup_fac_lam_ad "factor on lambda adaptation offset during warm up" MAP 0xa0806a80 _REC_MAP_20_u1_u1_u2 1. _CNV_A_R_LINEAR_____103_CM 0. 1. DISPLAY_IDENTIFIER IP_FAC_WUP_FAC_LAM_AD FORMAT "%8.6"
 /begin AXIS_DESCR COM_AXIS tco _CNV_A_R_LINEAR_____17_CM 5 -48. 142.5 FORMAT "%6.2" AXIS_PTS_REF ldpm_tco_2_laco /end AXIS_DESCR
 /begin AXIS_DESCR COM_AXIS online_dummy _CNV_A_R_LINEAR_____178_CM 5 -50. 49.99847412 FORMAT "%7.3" AXIS_PTS_REF ldp_fac_lam_ad_ip_fac_wup_fac /end AXIS_DESCR
/end CHARACTERISTIC
/begin CHARACTERISTIC c_mff_sp_tol_add_rng_lam_ad "maximum fuel mass set point for offset lambda adaptation" VALUE 0xa0806c9e _REC_VAL_20_u2 1389. _CNV_A_R_LINEAR_____111_CM 0. 1389. DISPLAY_IDENTIFIER C_MFF_SP_TOL_ADD_RNG_LAM_AD FORMAT "%7.2" /end CHARACTERISTIC
/begin CHARACTERISTIC c_fac_min_l_rng_lam_ad "maximum value of lower area lambda adaptation factor" VALUE 0xa0806c22 _REC_VAL_20_s2 99.99847412109381 _CNV_A_R_LINEAR_____113_CM -50. 49.9984741210938 DISPLAY_IDENTIFIER C_FAC_MIN_L_RNG_LAM_AD FORMAT "%7.3" /end CHARACTERISTIC
/begin CHARACTERISTIC c_fac_max_l_rng_lam_ad "minimum value of lower area lambda adaptation factor" VALUE 0xa0806c1e _REC_VAL_20_s2 99.99847412109381 _CNV_A_R_LINEAR_____113_CM -50. 49.9984741210938 DISPLAY_IDENTIFIER C_FAC_MAX_L_RNG_LAM_AD FORMAT "%7.3" /end CHARACTERISTIC
/begin CHARACTERISTIC c_fac_max_h_rng_lam_ad "maximum value of upper area lambda adaptation factor" VALUE 0xa0806c1c _REC_VAL_20_s2 99.99847412109381 _CNV_A_R_LINEAR_____113_CM -50. 49.9984741210938 DISPLAY_IDENTIFIER C_FAC_MAX_H_RNG_LAM_AD FORMAT "%7.3" /end CHARACTERISTIC
/begin CHARACTERISTIC c_mff_min_add_rng_lam_ad "minimum value of lambda adaptation offset" VALUE 0xa0806c9c _REC_VAL_20_s2 1389. _CNV_A_R_LINEAR_____128_CM -694.510597390707 694.4894026092931 DISPLAY_IDENTIFIER C_MFF_MIN_ADD_RNG_LAM_AD FORMAT "%7.2" /end CHARACTERISTIC
/begin CHARACTERISTIC c_mff_max_add_rng_lam_ad "maximum value of lambda adaptation offset" VALUE 0xa0806c9a _REC_VAL_20_s2 1389. _CNV_A_R_LINEAR_____128_CM -694.510597390707 694.4894026092931 DISPLAY_IDENTIFIER C_MFF_MAX_ADD_RNG_LAM_AD FORMAT "%7.2" /end CHARACTERISTIC
/begin CHARACTERISTIC lc_fac_l_rng_afs_req_lam_ad "logical calibration to allow forced lambda eq. 1 conditions for factor adaptation at upper area" VALUE 0xa0806cf7 _REC_VAL_20_u1 1. _CNV_A_R_LINEAR_____0_CM 0. 1. DISPLAY_IDENTIFIER LC_FAC_L_RNG_AFS_REQ_LAM_AD FORMAT "%1.0" /end CHARACTERISTIC
/begin CHARACTERISTIC lc_fac_h_rng_afs_req_lam_ad "logical calibration to allow forced lambda eq. 1 conditions for factor adaptation at upper area" VALUE 0xa0806cf6 _REC_VAL_20_u1 1. _CNV_A_R_LINEAR_____0_CM 0. 1. DISPLAY_IDENTIFIER LC_FAC_H_RNG_AFS_REQ_LAM_AD FORMAT "%1.0" /end CHARACTERISTIC
/begin CHARACTERISTIC lc_mff_add_rng_afs_req_lam_ad "logical calibration to allow forced lambda eq. 1 conditions for offset adaptation" VALUE 0xa0806d0a _REC_VAL_20_u1 1. _CNV_A_R_LINEAR_____0_CM 0. 1. DISPLAY_IDENTIFIER LC_MFF_ADD_RNG_AFS_REQ_LAM_AD FORMAT "%1.0" /end CHARACTERISTIC
/begin CHARACTERISTIC c_fac_min_h_rng_lam_ad "minimum value of upper area lambda adaptation factor" VALUE 0xa0806c20 _REC_VAL_20_s2 99.99847412109381 _CNV_A_R_LINEAR_____113_CM -50. 49.9984741210938 DISPLAY_IDENTIFIER C_FAC_MIN_H_RNG_LAM_AD FORMAT "%7.3" /end CHARACTERISTIC
/begin CHARACTERISTIC ip_fac_wup_mff_add_lam_ad "factor on lambda adaptation factor during warm up" MAP 0xa0806ab8 _REC_MAP_20_u1_u1_u2 1. _CNV_A_R_LINEAR_____103_CM 0. 1. DISPLAY_IDENTIFIER IP_FAC_WUP_MFF_ADD_LAM_AD FORMAT "%8.6"
 /begin AXIS_DESCR COM_AXIS tco _CNV_A_R_LINEAR_____17_CM 5 -48. 142.5 FORMAT "%6.2" AXIS_PTS_REF ldpm_tco_2_laco /end AXIS_DESCR
 /begin AXIS_DESCR COM_AXIS online_dummy _CNV_A_R_LACO_LINEA_363_CM 5 -694.510597 694.489403 FORMAT "%7.2" AXIS_PTS_REF ldp_mff_add_lam_ad_ip_fac_wup /end AXIS_DESCR
/end CHARACTERISTIC
/begin AXIS_PTS ldp_mff_add_lam_ad_ip_fac_wup "" 0xa0806654 online_dummy _REC_AXS_20_u2 1389. _CNV_A_R_LACO_LINEA_363_CM 5 -694.510597 694.489403 FORMAT "%7.2" /end AXIS_PTS
/begin CHARACTERISTIC id_t_pri_fac_h_rng_lam_ad "priority time for next requested lambda adaptation according to factor difference or upper area" CURVE 0xa0806900 _REC_CUR_20_u2_u2 6553.5 _CNV_A_R_LINEAR_____4_CM 0. 6553.5 DISPLAY_IDENTIFIER ID_T_PRI_FAC_H_RNG_LAM_AD FORMAT "%6.1"
 /begin AXIS_DESCR COM_AXIS online_dummy _CNV_A_R_LINEAR_____178_CM 8 -50. 49.99847412 FORMAT "%7.3" AXIS_PTS_REF ldp_fac_delta_h_rng_lam_ad_pri /end AXIS_DESCR
/end CHARACTERISTIC
/begin MEASUREMENT lv_lam_ad_end "logical value indicating temporary end of lambda adaptation" UBYTE _CNV_S_2_RANGE__0___1_CM 1 100. 0. 1. DISPLAY_IDENTIFIER LV_LAM_AD_END ECU_ADDRESS 0xd000768c BIT_MASK 0x1 /end MEASUREMENT
/begin MEASUREMENT lv_lam_ad_afs_req "request flag for combustion manager to force lambda eq. 1 conditions for lambda adaptation" UBYTE _CNV_S_2_RANGE__0___1_CM 1 100. 0. 1. DISPLAY_IDENTIFIER LV_LAM_AD_AFS_REQ ECU_ADDRESS 0xd000768a BIT_MASK 0x1 /end MEASUREMENT
/begin MEASUREMENT lv_lam_ad_stop_cbk_ex "logical variable indicating stop of at least one bank of the lambda adaptation cycle" UBYTE _CNV_S_2_RANGE__0___1_CM 1 100. 0. 1. DISPLAY_IDENTIFIER LV_LAM_AD_STOP_CBK_EX ECU_ADDRESS 0xd0003502 BIT_MASK 0x1 /end MEASUREMENT
/begin CHARACTERISTIC ip_mff_sp_max_fac_l_rng_lam_ad "fuel mass set point threshold for consideration of only lower field lambda adaptation factor" CURVE 0xa0806b74 _REC_CUR_20_u2_u1 1389. _CNV_A_R_LINEAR_____111_CM 0. 1389. DISPLAY_IDENTIFIER IP_MFF_SP_MAX_FAC_L_RNG_LAM_AD FORMAT "%7.2"
 /begin AXIS_DESCR COM_AXIS n_32 _CNV_A_R_LINEAR_____10_CM 8 0. 8160. FORMAT "%4.0" AXIS_PTS_REF ldpm_n_32_5_laco /end AXIS_DESCR
/end CHARACTERISTIC
/begin CHARACTERISTIC ip_mff_sp_min_fac_h_rng_lam_ad "fuel mass set point threshold for consideration of only upper field lambda adaptation factor" CURVE 0xa0806b84 _REC_CUR_20_u2_u1 1389. _CNV_A_R_LINEAR_____111_CM 0. 1389. DISPLAY_IDENTIFIER IP_MFF_SP_MIN_FAC_H_RNG_LAM_AD FORMAT "%7.2"
 /begin AXIS_DESCR COM_AXIS n_32 _CNV_A_R_LINEAR_____10_CM 8 0. 8160. FORMAT "%4.0" AXIS_PTS_REF ldpm_n_32_5_laco /end AXIS_DESCR
/end CHARACTERISTIC
/begin AXIS_PTS ldp_n_32_id_mff_sp_bol_h_rng "" 0xa0806678 n_32 _REC_AXS_20_u1 8160. _CNV_A_R_LINEAR_____10_CM 8 0. 8160. FORMAT "%4.0" /end AXIS_PTS
/begin AXIS_PTS ldp_n_32_id_mff_sp_bol_l_rng "" 0xa0806684 n_32 _REC_AXS_20_u1 8160. _CNV_A_R_LINEAR_____10_CM 8 0. 8160. FORMAT "%4.0" /end AXIS_PTS
/begin AXIS_PTS ldp_n_32_id_mff_sp_tol_l_rng "" 0xa080669c n_32 _REC_AXS_20_u1 8160. _CNV_A_R_LINEAR_____10_CM 8 0. 8160. FORMAT "%4.0" /end AXIS_PTS
/begin AXIS_PTS ldp_n_32_id_mff_sp_tol_h_rng "" 0xa0806690 n_32 _REC_AXS_20_u1 8160. _CNV_A_R_LINEAR_____10_CM 8 0. 8160. FORMAT "%4.0" /end AXIS_PTS
/begin CHARACTERISTIC id_mff_sp_bol_fac_h_rng_lam_ad "minimum fuel mass set point for upper area factor lambda adaptation" CURVE 0xa0806888 _REC_CUR_20_u2_u1 1389. _CNV_A_R_LINEAR_____111_CM 0. 1389. DISPLAY_IDENTIFIER ID_MFF_SP_BOL_FAC_H_RNG_LAM_AD FORMAT "%7.2"
 /begin AXIS_DESCR COM_AXIS n_32 _CNV_A_R_LINEAR_____10_CM 8 0. 8160. FORMAT "%4.0" AXIS_PTS_REF ldp_n_32_id_mff_sp_bol_h_rng /end AXIS_DESCR
/end CHARACTERISTIC
/begin CHARACTERISTIC id_mff_sp_bol_fac_l_rng_lam_ad "minimum fuel mass set point for lower area factor lambda adaptation" CURVE 0xa0806898 _REC_CUR_20_u2_u1 1389. _CNV_A_R_LINEAR_____111_CM 0. 1389. DISPLAY_IDENTIFIER ID_MFF_SP_BOL_FAC_L_RNG_LAM_AD FORMAT "%7.2"
 /begin AXIS_DESCR COM_AXIS n_32 _CNV_A_R_LINEAR_____10_CM 8 0. 8160. FORMAT "%4.0" AXIS_PTS_REF ldp_n_32_id_mff_sp_bol_l_rng /end AXIS_DESCR
/end CHARACTERISTIC
/begin CHARACTERISTIC id_mff_sp_tol_fac_l_rng_lam_ad "maximum fuel mass set point for lower area factor lambda adaptation" CURVE 0xa08068c0 _REC_CUR_20_u2_u1 1389. _CNV_A_R_LINEAR_____111_CM 0. 1389. DISPLAY_IDENTIFIER ID_MFF_SP_TOL_FAC_L_RNG_LAM_AD FORMAT "%7.2"
 /begin AXIS_DESCR COM_AXIS n_32 _CNV_A_R_LINEAR_____10_CM 8 0. 8160. FORMAT "%4.0" AXIS_PTS_REF ldp_n_32_id_mff_sp_tol_l_rng /end AXIS_DESCR
/end CHARACTERISTIC
/begin CHARACTERISTIC id_mff_sp_tol_fac_h_rng_lam_ad "maximum fuel mass set point for upper area factor lambda adaptation" CURVE 0xa08068b0 _REC_CUR_20_u2_u1 1389. _CNV_A_R_LINEAR_____111_CM 0. 1389. DISPLAY_IDENTIFIER ID_MFF_SP_TOL_FAC_H_RNG_LAM_AD FORMAT "%7.2"
 /begin AXIS_DESCR COM_AXIS n_32 _CNV_A_R_LINEAR_____10_CM 8 0. 8160. FORMAT "%4.0" AXIS_PTS_REF ldp_n_32_id_mff_sp_tol_h_rng /end AXIS_DESCR
/end CHARACTERISTIC
/begin MEASUREMENT t_pri_tot_lam_ad "min. priority time of all exhaust cylinder banks for next requested lambda adaptation" UWORD _CNV_A_R_LINEAR_____4_CM 1 100. 0. 6553.5 DISPLAY_IDENTIFIER T_PRI_TOT_LAM_AD ECU_ADDRESS 0xd00070ae FORMAT "%6.1" /end MEASUREMENT
/begin AXIS_PTS ldp_fac_lam_ad_ip_fac_wup_fac "" 0xa080661c online_dummy _REC_AXS_20_u2 99.99847412 _CNV_A_R_LINEAR_____178_CM 5 -50. 49.99847412 FORMAT "%7.3" /end AXIS_PTS
/begin CHARACTERISTIC c_tco_min_lam_ad "minimum coolant temperature for adaptive learning" VALUE 0xa0806ce1 _REC_VAL_20_u1 190.5 _CNV_A_R_LINEAR_____17_CM -48. 142.5 DISPLAY_IDENTIFIER C_TCO_MIN_LAM_AD FORMAT "%6.2" /end CHARACTERISTIC
/begin CHARACTERISTIC c_tia_max_lam_ad "maximum air temperature for adaptive learning" VALUE 0xa0806cec _REC_VAL_20_u1 190.5 _CNV_A_R_LINEAR_____17_CM -48. 142.5 DISPLAY_IDENTIFIER C_TIA_MAX_LAM_AD FORMAT "%6.2" /end CHARACTERISTIC
/begin CHARACTERISTIC c_crlc_lam_ad_l "correlation constant for lambda adaptation at low area" VALUE 0xa0806bd5 _REC_VAL_20_u1 0.99609375 _CNV_A_R_LINEAR_____28_CM 0. 0.99609375 DISPLAY_IDENTIFIER C_CRLC_LAM_AD_L FORMAT "%5.3" /end CHARACTERISTIC
/begin CHARACTERISTIC c_crlc_lam_ad_h "correlation constant for lambda adaptation at high area" VALUE 0xa0806bd3 _REC_VAL_20_u1 0.99609375 _CNV_A_R_LINEAR_____28_CM 0. 0.99609375 DISPLAY_IDENTIFIER C_CRLC_LAM_AD_H FORMAT "%5.3" /end CHARACTERISTIC
/begin CHARACTERISTIC c_n_dyw_ldc_lam_ad "engine speed window for limited dynamic conditions trim control" VALUE 0xa0806ca8 _REC_VAL_20_u2 8160. _CNV_A_R_LINEAR_____14_CM 0. 8160. DISPLAY_IDENTIFIER C_N_DYW_LDC_LAM_AD FORMAT "%4.0" /end CHARACTERISTIC
/begin CHARACTERISTIC c_maf_dyw_ldc_lam_ad "air mass flow window for limited dynamic conditions lambda adaptation" VALUE 0xa0806c62 _REC_VAL_20_u2 1389. _CNV_A_R_LINEAR_____111_CM 0. 1389. DISPLAY_IDENTIFIER C_MAF_DYW_LDC_LAM_AD FORMAT "%7.2" /end CHARACTERISTIC
/begin CHARACTERISTIC c_fac_lam_mv_dyw_ldc_lam_ad "lambda control output window for limited dynamic conditions lambda adaptation" VALUE 0xa0806c02 _REC_VAL_20_u2 49.99847412 _CNV_A_R_LINEAR_____125_CM 0. 49.99847412 DISPLAY_IDENTIFIER C_FAC_LAM_MV_DYW_LDC_LAM_AD /end CHARACTERISTIC
/begin CHARACTERISTIC c_maf_int_ldc_lam_ad "air mass flow integral for duration of violation of limited dynamic conditions lambda adaptation" VALUE 0xa0806c84 _REC_VAL_20_u2 1820.42 _CNV_A_R_LINEAR_____364_CM 0. 1820.42 DISPLAY_IDENTIFIER C_MAF_INT_LDC_LAM_AD FORMAT "%7.2" /end CHARACTERISTIC
/begin CHARACTERISTIC c_lamb_sp_ad_min_h "minimum lambda setpoint to allow lambda adaptation at high range operating point" VALUE 0xa0806c4e _REC_VAL_20_u2 1.99993896484375 _CNV_A_R_LINEAR_____24_CM 0. 1.99993896484375 DISPLAY_IDENTIFIER C_LAMB_SP_AD_MIN_H FORMAT "%7.5" /end CHARACTERISTIC
/begin CHARACTERISTIC c_lamb_sp_ad_max_h "air mass flow integral for duration of violation of limited dynamic conditions lambda adaptation" VALUE 0xa0806c48 _REC_VAL_20_u2 1.99993896484375 _CNV_A_R_LINEAR_____24_CM 0. 1.99993896484375 DISPLAY_IDENTIFIER C_LAMB_SP_AD_MAX_H FORMAT "%7.5" /end CHARACTERISTIC
/begin CHARACTERISTIC c_lamb_sp_ad_min_l "minimum lambda setpoint to allow lambda adaptation at low range operating point" VALUE 0xa0806c50 _REC_VAL_20_u2 1.99993896484375 _CNV_A_R_LINEAR_____24_CM 0. 1.99993896484375 DISPLAY_IDENTIFIER C_LAMB_SP_AD_MIN_L FORMAT "%7.5" /end CHARACTERISTIC
/begin CHARACTERISTIC c_lamb_sp_ad_max_l "maximum lambda setpoint to allow lambda adaptation at low range operating point" VALUE 0xa0806c4a _REC_VAL_20_u2 1.99993896484375 _CNV_A_R_LINEAR_____24_CM 0. 1.99993896484375 DISPLAY_IDENTIFIER C_LAMB_SP_AD_MAX_L FORMAT "%7.5" /end CHARACTERISTIC
/begin CHARACTERISTIC c_lamb_sp_ad_min_add "minimum lambda setpoint to allow lambda adaptation at offset learning area" VALUE 0xa0806c4c _REC_VAL_20_u2 1.99993896484375 _CNV_A_R_LINEAR_____24_CM 0. 1.99993896484375 DISPLAY_IDENTIFIER C_LAMB_SP_AD_MIN_ADD FORMAT "%7.5" /end CHARACTERISTIC
/begin CHARACTERISTIC c_tco_min_lam_ad_wup "minimum coolant temperature for adaptive learning during warm-up phase" VALUE 0xa0806ce2 _REC_VAL_20_u1 190.5 _CNV_A_R_LINEAR_____17_CM -48. 142.5 DISPLAY_IDENTIFIER C_TCO_MIN_LAM_AD_WUP FORMAT "%6.2" /end CHARACTERISTIC
/begin CHARACTERISTIC c_tco_max_lam_ad_wup "maximum coolant temperature for adaptive learning during warm-up phase" VALUE 0xa0806cdf _REC_VAL_20_u1 190.5 _CNV_A_R_LINEAR_____17_CM -48. 142.5 DISPLAY_IDENTIFIER C_TCO_MAX_LAM_AD_WUP FORMAT "%6.2" /end CHARACTERISTIC
/begin CHARACTERISTIC c_maf_kgh_max_lam_ad "maximum mass air flow for adaptive learning" VALUE 0xa0806c8c _REC_VAL_20_u2 1023.984375 _CNV_A_R_LINEAR_____302_CM 0. 1023.984375 DISPLAY_IDENTIFIER C_MAF_KGH_MAX_LAM_AD FORMAT "%7.2" /end CHARACTERISTIC
/begin CHARACTERISTIC c_maf_kgh_min_lam_ad_wup "minimum mass air flow for adaptive learning during warm-up phase" VALUE 0xa0806c90 _REC_VAL_20_u2 1023.984375 _CNV_A_R_LINEAR_____302_CM 0. 1023.984375 DISPLAY_IDENTIFIER C_MAF_KGH_MIN_LAM_AD_WUP FORMAT "%7.2" /end CHARACTERISTIC
/begin CHARACTERISTIC c_maf_kgh_max_lam_ad_wup "maximum mass air flow for adaptive learning during warm-up phase" VALUE 0xa0806c8e _REC_VAL_20_u2 1023.984375 _CNV_A_R_LINEAR_____302_CM 0. 1023.984375 DISPLAY_IDENTIFIER C_MAF_KGH_MAX_LAM_AD_WUP FORMAT "%7.2" /end CHARACTERISTIC
/begin CHARACTERISTIC c_lamb_sp_ad_max_add "maximum lambda setpoint to allow lambda adaptation at offset learning area" VALUE 0xa0806c46 _REC_VAL_20_u2 1.99993896484375 _CNV_A_R_LINEAR_____24_CM 0. 1.99993896484375 DISPLAY_IDENTIFIER C_LAMB_SP_AD_MAX_ADD FORMAT "%7.5" /end CHARACTERISTIC
/begin CHARACTERISTIC lc_lam_ad_wup_deac "Logical switch to disable lambda adaptation activation during warm-up phase" VALUE 0xa0806cfe _REC_VAL_20_u1 1. _CNV_A_R_LINEAR_____0_CM 0. 1. DISPLAY_IDENTIFIER LC_LAM_AD_WUP_DEAC FORMAT "%1.0" /end CHARACTERISTIC
/begin CHARACTERISTIC c_crlc_lam_ad_add "correlation constant for lambda adaptation at offset learning area" VALUE 0xa0806bd1 _REC_VAL_20_u1 0.99609375 _CNV_A_R_LINEAR_____28_CM 0. 0.99609375 DISPLAY_IDENTIFIER C_CRLC_LAM_AD_ADD FORMAT "%5.3" /end CHARACTERISTIC
/begin CHARACTERISTIC c_tam_min_lam_ad "minimum ambient temperature for activation of lambda adaptation" VALUE 0xa0806cd5 _REC_VAL_20_u1 190.5 _CNV_A_R_LINEAR_____17_CM -48. 142.5 DISPLAY_IDENTIFIER C_TAM_MIN_LAM_AD FORMAT "%6.2" /end CHARACTERISTIC
/begin CHARACTERISTIC c_amp_min_lam_ad "minimum ambient pressure to activate lambda adaptation" VALUE 0xa0806bc2 _REC_VAL_20_u2 5434. _CNV_A_R_LINEAR_____27_CM 0. 5434. DISPLAY_IDENTIFIER C_AMP_MIN_LAM_AD FORMAT "%7.2" /end CHARACTERISTIC
/begin CHARACTERISTIC c_fup_min_lam_ad "minimum fuel pressure mean value to activate lambda adaptation" VALUE 0xa0806c28 _REC_VAL_20_u2 347776. _CNV_A_R_LINEAR_____171_CM 0. 347776. DISPLAY_IDENTIFIER C_FUP_MIN_LAM_AD FORMAT "%6.0" /end CHARACTERISTIC
/begin CHARACTERISTIC c_fup_max_lam_ad "maximum fuel pressure mean value to activate lambda adaptation" VALUE 0xa0806c26 _REC_VAL_20_u2 347776. _CNV_A_R_LINEAR_____171_CM 0. 347776. DISPLAY_IDENTIFIER C_FUP_MAX_LAM_AD FORMAT "%6.0" /end CHARACTERISTIC
/begin CHARACTERISTIC lc_lam_ad_wup_add_rng_cdn "Logical switch to require previous adaptation in ADD range" VALUE 0xa0806cfc _REC_VAL_20_u1 1. _CNV_A_R_LINEAR_____0_CM 0. 1. DISPLAY_IDENTIFIER LC_LAM_AD_WUP_ADD_RNG_CDN FORMAT "%1.0" /end CHARACTERISTIC
/begin CHARACTERISTIC lc_lam_ad_wup_l_rng_cdn "Logical switch to require previous adaptation in FAC_L range" VALUE 0xa0806cff _REC_VAL_20_u1 1. _CNV_A_R_LINEAR_____0_CM 0. 1. DISPLAY_IDENTIFIER LC_LAM_AD_WUP_L_RNG_CDN FORMAT "%1.0" /end CHARACTERISTIC
/begin CHARACTERISTIC c_crlc_lam_ad_add_lam_lim "correlation constant for lambda adaptation at offset learning area when forced modus is required" VALUE 0xa0806bd2 _REC_VAL_20_u1 0.99609375 _CNV_A_R_LINEAR_____28_CM 0. 0.99609375 DISPLAY_IDENTIFIER C_CRLC_LAM_AD_ADD_LAM_LIM FORMAT "%5.3" /end CHARACTERISTIC
/begin CHARACTERISTIC c_crlc_lam_ad_l_lam_lim "correlation constant for lambda adaptation at low area when forced modus is required" VALUE 0xa0806bd6 _REC_VAL_20_u1 0.99609375 _CNV_A_R_LINEAR_____28_CM 0. 0.99609375 DISPLAY_IDENTIFIER C_CRLC_LAM_AD_L_LAM_LIM FORMAT "%5.3" /end CHARACTERISTIC
/begin CHARACTERISTIC c_crlc_lam_ad_h_lam_lim "correlation constant for lambda adaptation at high area when forced modus is required" VALUE 0xa0806bd4 _REC_VAL_20_u1 0.99609375 _CNV_A_R_LINEAR_____28_CM 0. 0.99609375 DISPLAY_IDENTIFIER C_CRLC_LAM_AD_H_LAM_LIM FORMAT "%5.3" /end CHARACTERISTIC
/begin CHARACTERISTIC c_t_wait_max_lam_ad "threshold of waiting time between two adaptations" VALUE 0xa0806cd0 _REC_VAL_20_u1 5.1 _CNV_A_R_LINEAR_____110_CM 0. 5.1 DISPLAY_IDENTIFIER C_T_WAIT_MAX_LAM_AD FORMAT "%4.2" /end CHARACTERISTIC
/begin CHARACTERISTIC c_t_wait_max_lam_ad_h_rng "threshold of waiting time between two adaptations in high adaptation range" VALUE 0xa0806cd2 _REC_VAL_20_u1 5.1 _CNV_A_R_LINEAR_____110_CM 0. 5.1 DISPLAY_IDENTIFIER C_T_WAIT_MAX_LAM_AD_H_RNG FORMAT "%4.2" /end CHARACTERISTIC
/begin CHARACTERISTIC c_t_wait_max_lam_ad_l_rng "threshold of waiting time between two adaptations in low adaptation range" VALUE 0xa0806cd3 _REC_VAL_20_u1 5.1 _CNV_A_R_LINEAR_____110_CM 0. 5.1 DISPLAY_IDENTIFIER C_T_WAIT_MAX_LAM_AD_L_RNG FORMAT "%4.2" /end CHARACTERISTIC
/begin CHARACTERISTIC c_t_wait_max_lam_ad_add "threshold of waiting time between two adaptations at offset learning area" VALUE 0xa0806cd1 _REC_VAL_20_u1 5.1 _CNV_A_R_LINEAR_____110_CM 0. 5.1 DISPLAY_IDENTIFIER C_T_WAIT_MAX_LAM_AD_ADD FORMAT "%4.2" /end CHARACTERISTIC
/begin CHARACTERISTIC c_wgpwm_min_lam_ad "Minimum waste gate signal for lambda adaptation at active driving cycle" VALUE 0xa0806cf4 _REC_VAL_20_u2 99.99847412109381 _CNV_A_R_LINEAR_____8_CM 0. 99.99847412109381 DISPLAY_IDENTIFIER C_WGPWM_MIN_LAM_AD /end CHARACTERISTIC
/begin CHARACTERISTIC lc_wgpwm_inh_lam_ad_ena "Logical constant to enable inhibition of the lambda adaptation below a wastegate PWM value" VALUE 0xa0806d0c _REC_VAL_20_u1 1. _CNV_A_R_LINEAR_____0_CM 0. 1. DISPLAY_IDENTIFIER LC_WGPWM_INH_LAM_AD_ENA FORMAT "%1.0" /end CHARACTERISTIC
/begin MEASUREMENT n_delta_ldc "difference between N and moving mean value of N for limited dynamics detection" SWORD _CNV_A_R_LINEAR_____14_CM 1 100. -8160. 8160. DISPLAY_IDENTIFIER N_DELTA_LDC ECU_ADDRESS 0xd00070ac FORMAT "%5.0" /end MEASUREMENT
/begin MEASUREMENT maf_delta_ldc "difference between MAF and moving mean value of MAF for limited dynamics detection" SWORD _CNV_A_R_LINEAR_____128_CM 1 100. -694.510597390707 694.4894026092931 DISPLAY_IDENTIFIER MAF_DELTA_LDC ECU_ADDRESS 0xd00070a8 FORMAT "%7.2" /end MEASUREMENT
/begin MEASUREMENT maf_mmv_ldc "moving mean value of MAF for limited dynamics detection" UWORD _CNV_A_R_LINEAR_____111_CM 1 100. 0. 1389. DISPLAY_IDENTIFIER MAF_MMV_LDC ECU_ADDRESS 0xd00034f6 FORMAT "%7.2" /end MEASUREMENT
/begin CHARACTERISTIC c_crlc_n_mmv_ldc "correlation constant for moving mean value calculation of N for limited dynamics" VALUE 0xa0806bde _REC_VAL_20_u2 0.9999847412109381 _CNV_A_R_LINEAR_____89_CM 0. 0.9999847412109381 DISPLAY_IDENTIFIER C_CRLC_N_MMV_LDC FORMAT "%7.5" /end CHARACTERISTIC
/begin CHARACTERISTIC c_crlc_maf_mmv_ldc "correlation constant for moving mean value calculation of MAF for limited dynamics" VALUE 0xa0806bdc _REC_VAL_20_u2 0.9999847412109381 _CNV_A_R_LINEAR_____89_CM 0. 0.9999847412109381 DISPLAY_IDENTIFIER C_CRLC_MAF_MMV_LDC FORMAT "%7.5" /end CHARACTERISTIC
/begin MEASUREMENT n_mmv_ldc "moving mean value of N for limited dynamics detection" UWORD _CNV_A_R_LINEAR_____14_CM 1 100. 0. 8160. DISPLAY_IDENTIFIER N_MMV_LDC ECU_ADDRESS 0xd00034fa FORMAT "%4.0" /end MEASUREMENT
/begin MEASUREMENT fac_tq_req_delta_ldc "difference between torque scaling factor and moving mean value thereof for limited dynamics calculation" SWORD _CNV_A_R_LINEAR_____259_CM 1 100. -1. 0.999969482421875 DISPLAY_IDENTIFIER FAC_TQ_REQ_DELTA_LDC ECU_ADDRESS 0xd00070a6 FORMAT "%8.5" /end MEASUREMENT
/begin MEASUREMENT fac_tq_req_mmv_ldc "moving mean value of torque scaling factor for limited dynamics detection" UWORD _CNV_A_R_LINEAR_____9_CM 1 100. 0. 1.99996948242188 DISPLAY_IDENTIFIER FAC_TQ_REQ_MMV_LDC ECU_ADDRESS 0xd00034f0 FORMAT "%7.5" /end MEASUREMENT
/begin CHARACTERISTIC c_crlc_fac_tq_req_mmv_ldc "correlation constant for moving mean value calculation of torque scaling factor for limited dynamics" VALUE 0xa0806bce _REC_VAL_20_u2 0.9999847412109381 _CNV_A_R_LINEAR_____89_CM 0. 0.9999847412109381 DISPLAY_IDENTIFIER C_CRLC_FAC_TQ_REQ_MMV_LDC FORMAT "%7.5" /end CHARACTERISTIC
/begin MEASUREMENT laco[0].laco_struct_ispclada0.mff_lam_add_lam_ad_out "fuel mass set point offset, output from lambda adaptation, input into lamda controller" SWORD _CNV_A_R_LINEAR_____128_CM 1 100. -694.510597390707 694.4894026092931 DISPLAY_IDENTIFIER MFF_LAM_ADD_LAM_AD_OUT[1] ECU_ADDRESS 0xd0005fe8 FORMAT "%7.2" /end MEASUREMENT
/begin MEASUREMENT laco[0].laco_struct_ispclada0.fac_lam_ad_lam_out "fuel mass set point factor, output from lambda adaptation, input into lamda controller" SWORD _CNV_A_R_LINEAR_____113_CM 1 100. -50. 49.9984741210938 DISPLAY_IDENTIFIER FAC_LAM_AD_LAM_OUT[1] ECU_ADDRESS 0xd0005fea FORMAT "%7.3" /end MEASUREMENT
/begin MEASUREMENT laco[0].laco_struct_ispclada0.fac_mff_add_lam_ad_out "relative lambda adaptation offset quotient" SWORD _CNV_A_R_LINEAR_____212_CM 1 100. -100. 99.9969482421875 DISPLAY_IDENTIFIER FAC_MFF_ADD_LAM_AD_OUT[1] ECU_ADDRESS 0xd0005fec FORMAT "%8.3" /end MEASUREMENT
/begin MEASUREMENT laco[0].laco_struct_ispclada0.mff_add_lam_ad "fuel mass set point offset, stored value of lambda adaptation" SWORD _CNV_A_R_LINEAR_____128_CM 1 100. -694.510597390707 694.4894026092931 DISPLAY_IDENTIFIER MFF_ADD_LAM_AD[1] ECU_ADDRESS 0xd0005fee FORMAT "%7.2" /end MEASUREMENT
/begin MEASUREMENT laco[0].laco_struct_ispclada0.mff_delta_add_lam_ad "difference of lambda adaptation offset to previous adaptation" SWORD _CNV_A_R_LINEAR_____128_CM 1 100. -694.510597390707 694.4894026092931 DISPLAY_IDENTIFIER MFF_DELTA_ADD_LAM_AD[1] ECU_ADDRESS 0xd0005ff0 FORMAT "%7.2" /end MEASUREMENT
/begin MEASUREMENT laco[0].laco_struct_ispclada0.mff_delta_add_lam_ad_h_res "difference integral with high resolution of lambda adaptation offset" SWORD _CNV_A_R_LACO_LINEA_365_CM 1 100. -10.851728 10.851397 DISPLAY_IDENTIFIER MFF_DELTA_ADD_LAM_AD_H_RES[1] ECU_ADDRESS 0xd0005ff2 FORMAT "%8.4" /end MEASUREMENT
/begin MEASUREMENT laco[0].laco_struct_ispclada0.fac_lam_ad "fuel mass set point factor of lambda adaptation, interpolation of both factor areas (high and low field)" SWORD _CNV_A_R_LINEAR_____113_CM 1 100. -50. 49.9984741210938 DISPLAY_IDENTIFIER FAC_LAM_AD[1] ECU_ADDRESS 0xd0005ff4 FORMAT "%7.3" /end MEASUREMENT
/begin MEASUREMENT laco[0].laco_struct_ispclada0.fac_l_rng_lam_ad "fuel mass set point factor of low field, stored value of lambda adaptation" SWORD _CNV_A_R_LINEAR_____113_CM 1 100. -50. 49.9984741210938 DISPLAY_IDENTIFIER FAC_L_RNG_LAM_AD[1] ECU_ADDRESS 0xd0005ff6 FORMAT "%7.3" /end MEASUREMENT
/begin MEASUREMENT laco[0].laco_struct_ispclada0.fac_h_rng_lam_ad "fuel mass set point factor of high field, stored value of lambda adaptation" SWORD _CNV_A_R_LINEAR_____113_CM 1 100. -50. 49.9984741210938 DISPLAY_IDENTIFIER FAC_H_RNG_LAM_AD[1] ECU_ADDRESS 0xd0005ff8 FORMAT "%7.3" /end MEASUREMENT
/begin MEASUREMENT laco[0].laco_struct_ispclada0.fac_delta_l_rng_lam_ad "difference of lambda adaptation factor of low field to previous adaptation" SWORD _CNV_A_R_LINEAR_____113_CM 1 100. -50. 49.9984741210938 DISPLAY_IDENTIFIER FAC_DELTA_L_RNG_LAM_AD[1] ECU_ADDRESS 0xd0005ffa FORMAT "%7.3" /end MEASUREMENT
/begin MEASUREMENT laco[0].laco_struct_ispclada0.fac_delta_h_rng_lam_ad "difference of lambda adaptation factor of high field to previous adaptation" SWORD _CNV_A_R_LINEAR_____113_CM 1 100. -50. 49.9984741210938 DISPLAY_IDENTIFIER FAC_DELTA_H_RNG_LAM_AD[1] ECU_ADDRESS 0xd0005ffc FORMAT "%7.3" /end MEASUREMENT
/begin MEASUREMENT laco[0].laco_struct_ispclada0.fac_lam_adj_lam_ad "output value from lambda adaptation for the lambda controller shift" SWORD _CNV_A_R_LINEAR_____113_CM 1 100. -50. 49.9984741210938 DISPLAY_IDENTIFIER FAC_LAM_ADJ_LAM_AD[1] ECU_ADDRESS 0xd0005ffe FORMAT "%7.3" /end MEASUREMENT
/begin MEASUREMENT laco[0].laco_struct_ispclada0.fac_mff_add_fac_lam_ad "lambda adaptation correction for scan tool (factor and relative offset)" SWORD _CNV_A_R_LINEAR_____212_CM 1 100. -100. 99.9969482421875 DISPLAY_IDENTIFIER FAC_MFF_ADD_FAC_LAM_AD[1] ECU_ADDRESS 0xd0006000 FORMAT "%8.3" /end MEASUREMENT
/begin MEASUREMENT laco[0].laco_struct_ispclada0.t_pri_lam_ad "priority time for next requested lambda adaptation" UWORD _CNV_A_R_LINEAR_____4_CM 1 100. 0. 6553.5 DISPLAY_IDENTIFIER T_PRI_LAM_AD[1] ECU_ADDRESS 0xd0006002 FORMAT "%6.1" /end MEASUREMENT
/begin MEASUREMENT laco[0].laco_struct_ispclada0.state_lam_ad "state of lambda adaptation" UBYTE _CNV_S_8_LACO_RANGE_366_CM 1 100. 0. 7. DISPLAY_IDENTIFIER STATE_LAM_AD[1] ECU_ADDRESS 0xd0006004 /end MEASUREMENT
/begin MEASUREMENT laco[0].laco_struct_ispclada0.lv_fac_lam_adj_lam_ad "flag to request lambda controller shift" UBYTE _CNV_S_2_RANGE__0___1_CM 1 100. 0. 1. DISPLAY_IDENTIFIER LV_FAC_LAM_ADJ_LAM_AD[1] ECU_ADDRESS 0xd0006005 BIT_MASK 0x1 /end MEASUREMENT
/begin MEASUREMENT laco[0].laco_struct_ispclada0.lv_lam_ad_stop "logical varialble indicating stop of the lambda adaptation cycle" UBYTE _CNV_S_2_RANGE__0___1_CM 1 100. 0. 1. DISPLAY_IDENTIFIER LV_LAM_AD_STOP[1] ECU_ADDRESS 0xd0006006 BIT_MASK 0x1 /end MEASUREMENT
/begin MEASUREMENT laco[0].laco_struct_ispclada0.lv_fac_l_rng_lim_max_lam_ad "flag indicating top limitation of lambda adaptation factor of lower area" UBYTE _CNV_S_2_RANGE__0___1_CM 1 100. 0. 1. DISPLAY_IDENTIFIER LV_FAC_L_RNG_LIM_MAX_LAM_AD[1] ECU_ADDRESS 0xd0006007 BIT_MASK 0x1 /end MEASUREMENT
/begin MEASUREMENT laco[0].laco_struct_ispclada0.lv_fac_l_rng_lim_min_lam_ad "flag indicating bottom limitation of lambda adaptation factor of lower area" UBYTE _CNV_S_2_RANGE__0___1_CM 1 100. 0. 1. DISPLAY_IDENTIFIER LV_FAC_L_RNG_LIM_MIN_LAM_AD[1] ECU_ADDRESS 0xd0006008 BIT_MASK 0x1 /end MEASUREMENT
/begin MEASUREMENT laco[0].laco_struct_ispclada0.lv_fac_h_rng_lim_max_lam_ad "flag indicating top limitation of lambda adaptation factor of upper area" UBYTE _CNV_S_2_RANGE__0___1_CM 1 100. 0. 1. DISPLAY_IDENTIFIER LV_FAC_H_RNG_LIM_MAX_LAM_AD[1] ECU_ADDRESS 0xd0006009 BIT_MASK 0x1 /end MEASUREMENT
/begin MEASUREMENT laco[0].laco_struct_ispclada0.lv_fac_h_rng_lim_min_lam_ad "flag indicating bottom limitation of lambda adaptation factor of upper area" UBYTE _CNV_S_2_RANGE__0___1_CM 1 100. 0. 1. DISPLAY_IDENTIFIER LV_FAC_H_RNG_LIM_MIN_LAM_AD[1] ECU_ADDRESS 0xd000600a BIT_MASK 0x1 /end MEASUREMENT
/begin MEASUREMENT laco[0].laco_struct_ispclada0.lv_mff_add_lim_max_lam_ad "flag indicating top limitation of lambda adaptation offset" UBYTE _CNV_S_2_RANGE__0___1_CM 1 100. 0. 1. DISPLAY_IDENTIFIER LV_MFF_ADD_LIM_MAX_LAM_AD[1] ECU_ADDRESS 0xd000600b BIT_MASK 0x1 /end MEASUREMENT
/begin MEASUREMENT laco[0].laco_struct_ispclada0.lv_mff_add_lim_min_lam_ad "flag indicating bottom limitation of lambda adaptation offset" UBYTE _CNV_S_2_RANGE__0___1_CM 1 100. 0. 1. DISPLAY_IDENTIFIER LV_MFF_ADD_LIM_MIN_LAM_AD[1] ECU_ADDRESS 0xd000600c BIT_MASK 0x1 /end MEASUREMENT
/begin MEASUREMENT laco[0].laco_struct_ispclada0.lv_fac_h_rng_lam_ad "flag indicating that lambda adaptation in factor learning upper field is active" UBYTE _CNV_S_2_RANGE__0___1_CM 1 100. 0. 1. DISPLAY_IDENTIFIER LV_FAC_H_RNG_LAM_AD[1] ECU_ADDRESS 0xd000600d BIT_MASK 0x1 /end MEASUREMENT
/begin MEASUREMENT laco[0].laco_struct_ispclada0.lv_fac_l_rng_lam_ad "flag indicating that lambda adaptation in factor learning lower field is active" UBYTE _CNV_S_2_RANGE__0___1_CM 1 100. 0. 1. DISPLAY_IDENTIFIER LV_FAC_L_RNG_LAM_AD[1] ECU_ADDRESS 0xd000600e BIT_MASK 0x1 /end MEASUREMENT
/begin MEASUREMENT laco[0].laco_struct_ispclada0.lv_mff_add_rng_lam_ad "flag indicating that lambda adaptation in offset learning field is active" UBYTE _CNV_S_2_RANGE__0___1_CM 1 100. 0. 1. DISPLAY_IDENTIFIER LV_MFF_ADD_RNG_LAM_AD[1] ECU_ADDRESS 0xd000600f BIT_MASK 0x1 /end MEASUREMENT
/begin MEASUREMENT laco[0].laco_struct_ispclada0.t_wait_lam_ad "waiting time between two adaptations" UBYTE _CNV_A_R_LINEAR_____110_CM 1 100. 0. 5.1 DISPLAY_IDENTIFIER T_WAIT_LAM_AD[1] ECU_ADDRESS 0xd0006010 FORMAT "%4.2" /end MEASUREMENT
/begin MEASUREMENT laco[0].laco_struct_ispcladapi0.maf_ofs_ldc_lam_ad "air mass flow offset for limited dynamics calculation" SWORD _CNV_A_R_LINEAR_____128_CM 1 100. -694.510597390707 694.4894026092931 DISPLAY_IDENTIFIER MAF_OFS_LDC_LAM_AD ECU_ADDRESS 0xd0006014 FORMAT "%7.2" /end MEASUREMENT
/begin MEASUREMENT laco[0].laco_struct_ispcladapi0.fac_lam_mv_ofs_ldc_lam_ad "filtered lambda controller output offset for limited dynamics calculation" SWORD _CNV_A_R_LINEAR_____113_CM 1 100. -50. 49.9984741210938 DISPLAY_IDENTIFIER FAC_LAM_MV_OFS_LDC_LAM_AD ECU_ADDRESS 0xd0006016 FORMAT "%7.3" /end MEASUREMENT
/begin MEASUREMENT laco[0].laco_struct_ispcladapi0.n_ofs_ldc_lam_ad "engine speed offset for limited dynamics calculation" SWORD _CNV_A_R_LINEAR_____14_CM 1 100. -8160. 8160. DISPLAY_IDENTIFIER N_OFS_LDC_LAM_AD ECU_ADDRESS 0xd0006018 FORMAT "%5.0" /end MEASUREMENT
/begin MEASUREMENT laco[0].laco_struct_ispcladapi0.maf_int_ldc_lam_ad "air mass flow integral during limited dynamics not fulfilled" UWORD _CNV_A_R_LINEAR_____364_CM 1 100. 0. 1820.42 DISPLAY_IDENTIFIER MAF_INT_LDC_LAM_AD ECU_ADDRESS 0xd000601a FORMAT "%7.2" /end MEASUREMENT
/begin MEASUREMENT laco[0].laco_struct_ispcladapi0.crlc_lam_ad "correlation constant for calculation of adaptive values" UBYTE _CNV_A_R_LINEAR_____28_CM 1 100. 0. 0.99609375 DISPLAY_IDENTIFIER CRLC_LAM_AD[1] ECU_ADDRESS 0xd000601c FORMAT "%5.3" /end MEASUREMENT
/begin MEASUREMENT laco[0].laco_struct_ispcladapi0.t_wait_max_lam_ad "threshold of waiting time between two adaptations" UBYTE _CNV_A_R_LINEAR_____110_CM 1 100. 0. 5.1 DISPLAY_IDENTIFIER T_WAIT_MAX_LAM_AD[1] ECU_ADDRESS 0xd000601d FORMAT "%4.2" /end MEASUREMENT
/begin MEASUREMENT laco[0].laco_struct_ispcladapi0.lv_lam_ad_act "flag indicating that lambda adaptation can be activated" UBYTE _CNV_S_2_RANGE__0___1_CM 1 100. 0. 1. DISPLAY_IDENTIFIER LV_LAM_AD_ACT[1] ECU_ADDRESS 0xd000601e BIT_MASK 0x1 /end MEASUREMENT
/begin MEASUREMENT laco[0].laco_struct_ispcladapi0.lv_ldc_lam_ad "limited dynamic conditions for lambda adaptation" UBYTE _CNV_S_2_RANGE__0___1_CM 1 100. 0. 1. DISPLAY_IDENTIFIER LV_LDC_LAM_AD[1] ECU_ADDRESS 0xd000601f BIT_MASK 0x1 /end MEASUREMENT
/begin MEASUREMENT laco[0].laco_struct_ispcladapi0.lv_lam_ad_act_err "flag indicating that lambda adaptation can be activated because of no error detected" UBYTE _CNV_S_2_RANGE__0___1_CM 1 100. 0. 1. DISPLAY_IDENTIFIER LV_LAM_AD_ACT_ERR[1] ECU_ADDRESS 0xd0006020 BIT_MASK 0x1 /end MEASUREMENT
/begin MEASUREMENT laco[0].laco_struct_ispcladapi0.lv_lam_ad_deac_err "flag indicating that lambda adaptation is deactivated due to an error" UBYTE _CNV_S_2_RANGE__0___1_CM 1 100. 0. 1. DISPLAY_IDENTIFIER LV_LAM_AD_DEAC_ERR[1] ECU_ADDRESS 0xd0006021 BIT_MASK 0x1 /end MEASUREMENT
/begin MEASUREMENT laco[0].laco_struct_ispcladapi0.pv_av_ofs_ldc_lam_ad "actual pedal value offset for limited dynamics calculation" SBYTE _CNV_A_R_LINEAR_____5_CM 1 100. -50. 49.609375 DISPLAY_IDENTIFIER PV_AV_OFS_LDC_LAM_AD ECU_ADDRESS 0xd0006022 FORMAT "%6.2" /end MEASUREMENT
/begin MEASUREMENT laco[0].laco_struct_ispcladapi0.lv_lam_ad_wup_act "flag indicating that lambda adaptation in warm-up phase can be activated" UBYTE _CNV_S_2_RANGE__0___1_CM 1 100. 0. 1. DISPLAY_IDENTIFIER LV_LAM_AD_WUP_ACT[1] ECU_ADDRESS 0xd0006023 BIT_MASK 0x1 /end MEASUREMENT
/begin MEASUREMENT laco[0].laco_struct_ispcladapi0.lv_lam_ad_cdn_h_rng "condition bit for activation of lambda adaptation ADAPT_FAC_H" UBYTE _CNV_S_2_RANGE__0___1_CM 1 100. 0. 1. DISPLAY_IDENTIFIER LV_LAM_AD_CDN_H_RNG[1] ECU_ADDRESS 0xd0006024 BIT_MASK 0x1 /end MEASUREMENT
/begin MEASUREMENT laco[0].laco_struct_ispcladapi0.lv_lam_ad_cdn_l_rng "condition bit for activation of lambda adaptation ADAPT_FAC_L" UBYTE _CNV_S_2_RANGE__0___1_CM 1 100. 0. 1. DISPLAY_IDENTIFIER LV_LAM_AD_CDN_L_RNG[2] ECU_ADDRESS 0xd0006025 BIT_MASK 0x1 /end MEASUREMENT
/begin MEASUREMENT laco[0].laco_struct_ispcladapi0.lv_lam_ad_cdn_add "condition bit for activation of lambda adaptation ADAPT_ADD" UBYTE _CNV_S_2_RANGE__0___1_CM 1 100. 0. 1. DISPLAY_IDENTIFIER LV_LAM_AD_CDN_ADD[1] ECU_ADDRESS 0xd0006026 BIT_MASK 0x1 /end MEASUREMENT
/begin MEASUREMENT laco[0].laco_struct_ispcladapi0.mff_sp_ad "Mass fuel flow setpoint for lambda adaptation - bank selective" UWORD _CNV_A_R_LINEAR_____111_CM 1 100. 0. 1389. DISPLAY_IDENTIFIER MFF_SP_AD[1] ECU_ADDRESS 0xd0006028 FORMAT "%7.2" /end MEASUREMENT
/begin MEASUREMENT laco[0].laco_struct_ispclmvldc0.fac_lam_mv_delta_ldc "difference between FAC_LAM_MV[i] and moving mean value of FAC_LAM_MV[i] for limited dynamics detection" SWORD _CNV_A_R_LINEAR_____113_CM 1 100. -50. 49.9984741210938 DISPLAY_IDENTIFIER FAC_LAM_MV_DELTA_LDC[1] ECU_ADDRESS 0xd000602c FORMAT "%7.3" /end MEASUREMENT
/begin MEASUREMENT laco[0].laco_struct_reqgnlaco0.fac_dif_sum_lam_in "unlimited summation of controller difference" SLONG _CNV_A_R_LACO_LINEA_367_CM 1 100. -65536. 65535.9999694824 DISPLAY_IDENTIFIER FAC_DIF_SUM_LAM_IN[1] ECU_ADDRESS 0xd0006030 FORMAT "%12.5" /end MEASUREMENT
/begin MEASUREMENT laco[0].laco_struct_reqgnlaco0.fac_lam_i_it_lim "limited internal I share used for PID control only" SLONG _CNV_A_R_LACO_LINEA_368_CM 1 100. -50. 49.9999999767169 DISPLAY_IDENTIFIER FAC_LAM_I_IT_LIM[1] ECU_ADDRESS 0xd0006034 FORMAT "%10.6" /end MEASUREMENT
/begin MEASUREMENT laco[0].laco_struct_reqgnlaco0.fac_dif_sum_lim_lam_in "limited summation of controller difference" SLONG _CNV_A_R_LACO_LINEA_367_CM 1 100. -65536. 65535.9999694824 DISPLAY_IDENTIFIER FAC_DIF_SUM_LIM_LAM_IN[1] ECU_ADDRESS 0xd0006038 FORMAT "%12.5" /end MEASUREMENT
/begin MEASUREMENT laco[0].laco_struct_reqgnlaco0.fac_dif_sum_lam_in_save "stored value of controller difference summation" SLONG _CNV_A_R_LACO_LINEA_367_CM 1 100. -65536. 65535.9999694824 DISPLAY_IDENTIFIER FAC_DIF_SUM_LAM_IN_SAVE[1] ECU_ADDRESS 0xd000603c FORMAT "%12.5" /end MEASUREMENT
/begin MEASUREMENT laco[0].laco_struct_reqgnlaco0.fac_dif_lam_in_mmv "controller difference (richness) moving mean value" SLONG _CNV_A_R_LACO_LINEA_369_CM 1 100. -1. 0.9999999995343391 DISPLAY_IDENTIFIER FAC_DIF_LAM_IN_MMV[1] ECU_ADDRESS 0xd0006040 FORMAT "%9.6" /end MEASUREMENT
/begin MEASUREMENT laco[0].laco_struct_reqgnlaco0.fac_lam_i_it "unlimited internal I share used for PID control only" SLONG _CNV_A_R_LACO_LINEA_368_CM 1 100. -50. 49.9999999767169 DISPLAY_IDENTIFIER FAC_LAM_I_IT[1] ECU_ADDRESS 0xd0006044 FORMAT "%10.6" /end MEASUREMENT
/begin MEASUREMENT laco[0].laco_struct_reqgnlaco0.fac_lam_pctl "pre control path correction" SWORD _CNV_A_R_LINEAR_____113_CM 1 100. -50. 49.9984741210938 DISPLAY_IDENTIFIER FAC_LAM_PCTL[1] ECU_ADDRESS 0xd000606c FORMAT "%7.3" /end MEASUREMENT
/begin MEASUREMENT laco[0].laco_struct_reqgnlaco0.fac_lam_out "Lambda controller output" SWORD _CNV_A_R_LINEAR_____113_CM 1 100. -50. 49.9984741210938 DISPLAY_IDENTIFIER FAC_LAM_OUT[1] ECU_ADDRESS 0xd0006070 FORMAT "%7.3" /end MEASUREMENT
/begin MEASUREMENT laco[0].laco_struct_reqgnlaco0.fac_dif_lam_in "controller difference (richness)" SWORD _CNV_A_R_LINEAR_____259_CM 1 100. -1. 0.999969482421875 DISPLAY_IDENTIFIER FAC_DIF_LAM_IN[1] ECU_ADDRESS 0xd0006072 FORMAT "%8.5" /end MEASUREMENT
/begin MEASUREMENT laco[0].laco_struct_reqgnlaco0.fac_lam_i "unlimited I share output signal" SWORD _CNV_A_R_LINEAR_____113_CM 1 100. -50. 49.9984741210938 DISPLAY_IDENTIFIER FAC_LAM_I[1] ECU_ADDRESS 0xd0006076 FORMAT "%7.3" /end MEASUREMENT
/begin MEASUREMENT laco[0].laco_struct_reqgnlaco0.fac_lam_i2 "unlimited I^2 share output signal" SWORD _CNV_A_R_LINEAR_____113_CM 1 100. -50. 49.9984741210938 DISPLAY_IDENTIFIER FAC_LAM_I2[1] ECU_ADDRESS 0xd0006078 FORMAT "%7.3" /end MEASUREMENT
/begin MEASUREMENT laco[0].laco_struct_reqgnlaco0.fac_lam_i2_lim "limited I^2 share output signal" SWORD _CNV_A_R_LINEAR_____113_CM 1 100. -50. 49.9984741210938 DISPLAY_IDENTIFIER FAC_LAM_I2_LIM[1] ECU_ADDRESS 0xd000607a FORMAT "%7.3" /end MEASUREMENT
/begin MEASUREMENT laco[0].laco_struct_reqgnlaco0.fac_lam_i_i2_sum_lim "limited I share + I^2 share output signal" SWORD _CNV_A_R_LINEAR_____113_CM 1 100. -50. 49.9984741210938 DISPLAY_IDENTIFIER FAC_LAM_I_I2_SUM_LIM[1] ECU_ADDRESS 0xd000607e FORMAT "%7.3" /end MEASUREMENT
/begin MEASUREMENT laco[0].laco_struct_reqgnlaco0.fac_lam_p_lim "limited P share output signal" SWORD _CNV_A_R_LINEAR_____113_CM 1 100. -50. 49.9984741210938 DISPLAY_IDENTIFIER FAC_LAM_P_LIM[1] ECU_ADDRESS 0xd0006082 FORMAT "%7.3" /end MEASUREMENT
/begin MEASUREMENT laco[0].laco_struct_reqgnlaco0.fac_lam_d_lim "limited D share output signal" SWORD _CNV_A_R_LINEAR_____113_CM 1 100. -50. 49.9984741210938 DISPLAY_IDENTIFIER FAC_LAM_D_LIM[1] ECU_ADDRESS 0xd0006086 FORMAT "%7.3" /end MEASUREMENT
/begin MEASUREMENT laco[0].laco_struct_reqgnlaco0.fac_lam_mv "Mean value of lambda controller output" SWORD _CNV_A_R_LINEAR_____113_CM 1 100. -50. 49.9984741210938 DISPLAY_IDENTIFIER FAC_LAM_MV[1] ECU_ADDRESS 0xd000608c FORMAT "%7.3" /end MEASUREMENT
/begin MEASUREMENT laco[0].laco_struct_reqgnlaco0.fac_lam_mv_mmv "FAC_LAM_MV[i] average value" SWORD _CNV_A_R_LINEAR_____113_CM 1 100. -50. 49.9984741210938 DISPLAY_IDENTIFIER FAC_LAM_MV_MMV[1] ECU_ADDRESS 0xd000608e FORMAT "%7.3" /end MEASUREMENT
/begin MEASUREMENT laco[0].laco_struct_reqgnlaco0.fac_lam_mv_mmv_cp "Mean value of lambda controller output, used by canister purge" SWORD _CNV_A_R_LINEAR_____113_CM 1 100. -50. 49.9984741210938 DISPLAY_IDENTIFIER FAC_LAM_MV_MMV_CP[1] ECU_ADDRESS 0xd0006090 FORMAT "%7.3" /end MEASUREMENT
/begin MEASUREMENT laco[0].laco_struct_reqgnlaco0.fac_lam_mv_mmv_ldc "moving mean value of the controller output, used for limited dynamics calculation" SWORD _CNV_A_R_LINEAR_____113_CM 1 100. -50. 49.9984741210938 DISPLAY_IDENTIFIER FAC_LAM_MV_MMV_LDC[1] ECU_ADDRESS 0xd0006092 FORMAT "%7.3" /end MEASUREMENT
/begin MEASUREMENT laco[0].laco_struct_reqgnlaco0.fac_lam_mv_mmv_ldc_diag "Mean value of the controller output, used by limited dynamics for cat efficiency diagnosis" SWORD _CNV_A_R_LINEAR_____113_CM 1 100. -50. 49.9984741210938 DISPLAY_IDENTIFIER FAC_LAM_MV_MMV_LDC_DIAG[1] ECU_ADDRESS 0xd0006094 FORMAT "%7.3" /end MEASUREMENT
/begin MEASUREMENT laco[0].laco_struct_reqgnlaco0.fac_lam_max_not_stat_cdn "upper limit in case of limitation under non stationary conditions" SWORD _CNV_A_R_LINEAR_____113_CM 1 100. -50. 49.9984741210938 DISPLAY_IDENTIFIER FAC_LAM_MAX_NOT_STAT_CDN[1] ECU_ADDRESS 0xd0006096 FORMAT "%7.3" /end MEASUREMENT
/begin MEASUREMENT laco[0].laco_struct_reqgnlaco0.fac_lam_min_not_stat_cdn "bottom limit in case of limitation under non stationary conditions" SWORD _CNV_A_R_LINEAR_____113_CM 1 100. -50. 49.9984741210938 DISPLAY_IDENTIFIER FAC_LAM_MIN_NOT_STAT_CDN[1] ECU_ADDRESS 0xd0006098 FORMAT "%7.3" /end MEASUREMENT
/begin MEASUREMENT laco[0].laco_struct_reqgnlaco0.fac_lam_cor "Limited lambda controller output plus pre-control correction" SWORD _CNV_A_R_LINEAR_____113_CM 1 100. -50. 49.9984741210938 DISPLAY_IDENTIFIER FAC_LAM_COR[1] ECU_ADDRESS 0xd000609a FORMAT "%7.3" /end MEASUREMENT
/begin MEASUREMENT laco[0].laco_struct_reqgnlaco0.fac_lam_delta_i_i2_shift "I and I^2 share shift based on downstream signal evaluation" SWORD _CNV_A_R_LINEAR_____113_CM 1 100. -50. 49.9984741210938 DISPLAY_IDENTIFIER FAC_LAM_DELTA_I_I2_SHIFT[1] ECU_ADDRESS 0xd000609c FORMAT "%7.3" /end MEASUREMENT
/begin MEASUREMENT laco[0].laco_struct_reqgnlaco0.fac_lam_lim "Limited value of lambda controller output" SWORD _CNV_A_R_LINEAR_____113_CM 1 100. -50. 49.9984741210938 DISPLAY_IDENTIFIER FAC_LAM_LIM[1] ECU_ADDRESS 0xd000609e FORMAT "%7.3" /end MEASUREMENT
/begin MEASUREMENT laco[0].laco_struct_reqgnlaco0.crlc_lsl_mdl "correlation constant for lambda sensor model" UWORD _CNV_A_R_LINEAR_____89_CM 1 100. 0. 0.9999847412109381 DISPLAY_IDENTIFIER CRLC_LSL_MDL[1] ECU_ADDRESS 0xd00060a4 FORMAT "%7.5" /end MEASUREMENT
/begin MEASUREMENT laco[0].laco_struct_reqgnlaco0.fac_gain_p_lam "gain of lambda controller P share" UWORD _CNV_A_R_LINEAR_____119_CM 1 100. 0. 15.999755859375 DISPLAY_IDENTIFIER FAC_GAIN_P_LAM[1] ECU_ADDRESS 0xd00060aa FORMAT "%7.4" /end MEASUREMENT
/begin MEASUREMENT laco[0].laco_struct_reqgnlaco0.fac_gain_i_lam "gain of lambda controller I share" UWORD _CNV_A_R_LACO_LINEA_370_CM 1 100. 0. 49.999237 DISPLAY_IDENTIFIER FAC_GAIN_I_LAM[1] ECU_ADDRESS 0xd00060ac FORMAT "%7.4" /end MEASUREMENT
/begin MEASUREMENT laco[0].laco_struct_reqgnlaco0.fac_gain_i2_lam "gain of lambda controller I^2 share" UWORD _CNV_A_R_LACO_LINEA_371_CM 1 100. 0. 24.999619 DISPLAY_IDENTIFIER FAC_GAIN_I2_LAM[1] ECU_ADDRESS 0xd00060ae FORMAT "%7.4" /end MEASUREMENT
/begin MEASUREMENT laco[0].laco_struct_reqgnlaco0.fac_gain_d_lam "gain of lambda controller D share" UWORD _CNV_A_R_LACO_LINEA_372_CM 1 100. 0. 3.9999e-002 DISPLAY_IDENTIFIER FAC_GAIN_D_LAM[1] ECU_ADDRESS 0xd00060b0 FORMAT "%8.6" /end MEASUREMENT
/begin MEASUREMENT laco[0].laco_struct_reqgnlaco0.lamb_sp_fil_hom "output signal of the WRAF sensor model for homogeneous mode" UWORD _CNV_A_R_LINEAR_____24_CM 1 100. 0. 1.99993896484375 DISPLAY_IDENTIFIER LAMB_SP_FIL_HOM[1] ECU_ADDRESS 0xd00060b2 FORMAT "%7.5" /end MEASUREMENT
/begin MEASUREMENT laco[0].laco_struct_reqgnlaco0.lamb_sp_pctl "pre control lambda set point" UWORD _CNV_A_R_LINEAR_____24_CM 1 100. 0. 1.99993896484375 DISPLAY_IDENTIFIER LAMB_SP_PCTL[1] ECU_ADDRESS 0xd00060b4 FORMAT "%7.5" /end MEASUREMENT
/begin MEASUREMENT laco[0].laco_struct_reqgnlaco0.lamb_sp_fil_s "output signal of the WRAF sensor model for stratified mode" UWORD _CNV_A_R_LINEAR_____129_CM 1 100. 0. 31.9990234375 DISPLAY_IDENTIFIER LAMB_SP_FIL_S[1] ECU_ADDRESS 0xd00060b6 FORMAT "%7.4" /end MEASUREMENT
/begin MEASUREMENT laco[0].laco_struct_reqgnlaco0.lamb_sp_lsl_mdl_in_hom "lambda controller set point including forced stimulation and the influence of secondary air" UWORD _CNV_A_R_LINEAR_____24_CM 1 100. 0. 3.99993896484375 DISPLAY_IDENTIFIER LAMB_SP_LSL_MDL_IN_HOM[1] ECU_ADDRESS 0xd00060b8 FORMAT "%7.5" /end MEASUREMENT
/begin MEASUREMENT laco[0].laco_struct_reqgnlaco0.lamb_sp_lsl_mdl_out_hom "output signal of the WRAF sensor model in homogeneous mode" UWORD _CNV_A_R_LINEAR_____24_CM 1 100. 0. 3.99993896484375 DISPLAY_IDENTIFIER LAMB_SP_LSL_MDL_OUT_HOM[1] ECU_ADDRESS 0xd00060ba FORMAT "%7.5" /end MEASUREMENT
/begin MEASUREMENT laco[0].laco_struct_reqgnlaco0.lamb_sp_lsl_mdl_out_s "output signal of the WRAF sensor model in stratified mode" UWORD _CNV_A_R_LINEAR_____129_CM 1 100. 0. 31.9990234375 DISPLAY_IDENTIFIER LAMB_SP_LSL_MDL_OUT_S[1] ECU_ADDRESS 0xd00060bc FORMAT "%7.4" /end MEASUREMENT
/begin MEASUREMENT laco[0].laco_struct_reqgnlaco0.lamb_cor_av_lam "corrected signal of WRAF sensor; actual value for lambda controller " UWORD _CNV_A_R_LINEAR_____24_CM 1 100. 0. 1.99993896484375 DISPLAY_IDENTIFIER LAMB_COR_AV_LAM[1] ECU_ADDRESS 0xd00060c6 FORMAT "%7.5" /end MEASUREMENT
/begin MEASUREMENT laco[0].laco_struct_reqgnlaco0.t1_lsl_up "first order time lag of the WRAF sensor model" UWORD _CNV_A_R_LINEAR_____117_CM 1 100. 0. 1.99996948242188 DISPLAY_IDENTIFIER T1_LSL_UP[1] ECU_ADDRESS 0xd00060ca FORMAT "%7.5" /end MEASUREMENT
/begin MEASUREMENT laco[0].laco_struct_reqgnlaco0.t_dly_soi_lsl_pos "delay between start of injection and WRAF sensor signal location" UWORD _CNV_A_R_LINEAR_____361_CM 1 100. 0. 1.023984 DISPLAY_IDENTIFIER T_DLY_SOI_LSL_POS[1] ECU_ADDRESS 0xd00060cc FORMAT "%7.5" /end MEASUREMENT
/begin MEASUREMENT laco[0].laco_struct_reqgnlaco0.tout_i_i2_shift_vld_afl "time out for I and I^2 share shift based on lean downstream signal" UWORD _CNV_A_R_LINEAR_____110_CM 1 100. 0. 1310.7 DISPLAY_IDENTIFIER TOUT_I_I2_SHIFT_VLD_AFL[1] ECU_ADDRESS 0xd00060ce FORMAT "%7.2" /end MEASUREMENT
/begin MEASUREMENT laco[0].laco_struct_reqgnlaco0.tout_i_i2_shift_vld_afr "time out for I and I^2 share shift based on rich downstream signal" UWORD _CNV_A_R_LINEAR_____110_CM 1 100. 0. 1310.7 DISPLAY_IDENTIFIER TOUT_I_I2_SHIFT_VLD_AFR[1] ECU_ADDRESS 0xd00060d0 FORMAT "%7.2" /end MEASUREMENT
/begin MEASUREMENT laco[0].laco_struct_reqgnlaco0.vls_down_mmv_lam "moving mean value of downstream sensor voltage" UWORD _CNV_A_R_LINEAR_____201_CM 1 100. 0. 4.99992371 DISPLAY_IDENTIFIER VLS_DOWN_MMV_LAM[1] ECU_ADDRESS 0xd00060d2 FORMAT "%7.5" /end MEASUREMENT
/begin MEASUREMENT laco[0].laco_struct_reqgnlaco0.mff_add_lam_ad_out "fuel mass set point offset, output from lambda adaptation" SWORD _CNV_A_R_LINEAR_____128_CM 1 100. -694.510597390707 694.4894026092931 DISPLAY_IDENTIFIER MFF_ADD_LAM_AD_OUT[1] ECU_ADDRESS 0xd00060d4 FORMAT "%7.2" /end MEASUREMENT
/begin MEASUREMENT laco[0].laco_struct_reqgnlaco0.fac_lam_ad_out "fuel mass set point factor, output from lambda adaptation" SWORD _CNV_A_R_LINEAR_____113_CM 1 100. -50. 49.9984741210938 DISPLAY_IDENTIFIER FAC_LAM_AD_OUT[1] ECU_ADDRESS 0xd00060d6 FORMAT "%7.3" /end MEASUREMENT
/begin MEASUREMENT laco[0].laco_struct_reqgnlaco0.ctr_raf_chg "Counter of air fuel ratio changes" UBYTE _CNV_A_R_LINEAR_____0_CM 1 100. 0. 255. DISPLAY_IDENTIFIER CTR_RAF_CHG[1] ECU_ADDRESS 0xd00060d8 FORMAT "%3.0" /end MEASUREMENT
/begin MEASUREMENT laco[0].laco_struct_reqgnlaco0.state_lam "lambda controller state" UBYTE _CNV_S_4_LACO_RANGE_373_CM 1 100. 0. 3. DISPLAY_IDENTIFIER STATE_LAM[1] ECU_ADDRESS 0xd00060d9 /end MEASUREMENT
/begin MEASUREMENT laco[0].laco_struct_reqgnlaco0.fac_eg_dly "Weighting factor for the calculation of the exhaust gas delay" UBYTE _CNV_A_R_EGCP_LINEA_355_CM 1 100. 0. 31.875 DISPLAY_IDENTIFIER FAC_EG_DLY[1] ECU_ADDRESS 0xd00060da FORMAT "%4.1" /end MEASUREMENT
/begin MEASUREMENT laco[0].laco_struct_reqgnlaco0.lv_lam_lscl "activation flag of lambda control" UBYTE _CNV_S_2_RANGE__0___1_CM 1 100. 0. 1. DISPLAY_IDENTIFIER LV_LAM_LSCL[1] ECU_ADDRESS 0xd00060db BIT_MASK 0x1 /end MEASUREMENT
/begin MEASUREMENT laco[0].laco_struct_reqgnlaco0.lv_fac_lam_lim_not_stat_cdn "limitation under non stationary operating conditions (threshold exceeded)" UBYTE _CNV_S_2_RANGE__0___1_CM 1 100. 0. 1. DISPLAY_IDENTIFIER LV_FAC_LAM_LIM_NOT_STAT_CDN[1] ECU_ADDRESS 0xd00060dc BIT_MASK 0x1 /end MEASUREMENT
/begin MEASUREMENT laco[0].laco_struct_reqgnlaco0.lv_t_max_lscl_act_tco "lambda controller activation by timer condition instead of TCO condition" UBYTE _CNV_S_2_RANGE__0___1_CM 1 100. 0. 1. DISPLAY_IDENTIFIER LV_T_MAX_LSCL_ACT_TCO[1] ECU_ADDRESS 0xd00060dd BIT_MASK 0x1 /end MEASUREMENT
/begin MEASUREMENT laco[0].laco_struct_reqgnlaco0.lv_fac_lam_adj_lam_ad_end "Controller shift caused by lambda adaptation was carried out" UBYTE _CNV_S_2_RANGE__0___1_CM 1 100. 0. 1. DISPLAY_IDENTIFIER LV_FAC_LAM_ADJ_LAM_AD_END[1] ECU_ADDRESS 0xd00060de BIT_MASK 0x1 /end MEASUREMENT
/begin MEASUREMENT laco[0].laco_struct_reqgnlaco0.lv_fac_lam_shift_cp_end "Controller shift caused by canister purge was carried out" UBYTE _CNV_S_2_RANGE__0___1_CM 1 100. 0. 1. DISPLAY_IDENTIFIER LV_FAC_LAM_SHIFT_CP_END[1] ECU_ADDRESS 0xd00060df BIT_MASK 0x1 /end MEASUREMENT
/begin MEASUREMENT laco[0].laco_struct_reqgnlaco0.lv_fac_lam_diagcp_end "Controller shift caused by EVAP diagnosis was carried out" UBYTE _CNV_S_2_RANGE__0___1_CM 1 100. 0. 1. DISPLAY_IDENTIFIER LV_FAC_LAM_DIAGCP_END[1] ECU_ADDRESS 0xd00060e0 BIT_MASK 0x1 /end MEASUREMENT
/begin MEASUREMENT laco[0].laco_struct_reqgnlaco0.lv_fac_lam_lim_max "Upper limit of lambda controller output reached" UBYTE _CNV_S_2_RANGE__0___1_CM 1 100. 0. 1. DISPLAY_IDENTIFIER LV_FAC_LAM_LIM_MAX[1] ECU_ADDRESS 0xd00060e2 BIT_MASK 0x1 /end MEASUREMENT
/begin MEASUREMENT laco[0].laco_struct_reqgnlaco0.lv_fac_lam_lim_min "Lower limit of lambda controller output reached" UBYTE _CNV_S_2_RANGE__0___1_CM 1 100. 0. 1. DISPLAY_IDENTIFIER LV_FAC_LAM_LIM_MIN[1] ECU_ADDRESS 0xd00060e3 BIT_MASK 0x1 /end MEASUREMENT
/begin MEASUREMENT laco[0].laco_struct_reqgnlaco0.lv_vls_down_thd_afl_lam "flag indicating that downstream sensor signal is below calibration threshold (used for lambda control)" UBYTE _CNV_S_2_RANGE__0___1_CM 1 100. 0. 1. DISPLAY_IDENTIFIER LV_VLS_DOWN_THD_AFL_LAM[1] ECU_ADDRESS 0xd00060e4 BIT_MASK 0x1 /end MEASUREMENT
/begin MEASUREMENT laco[0].laco_struct_reqgnlaco0.lv_vls_down_thd_afr_lam "flag indicating that downstream sensor signal is above calibration threshold (used for lambda control)" UBYTE _CNV_S_2_RANGE__0___1_CM 1 100. 0. 1. DISPLAY_IDENTIFIER LV_VLS_DOWN_THD_AFR_LAM[1] ECU_ADDRESS 0xd00060e5 BIT_MASK 0x1 /end MEASUREMENT
/begin MEASUREMENT laco[0].laco_struct_reqgnlaco0.lv_vls_down_thd_afr_lam_old "auxiliary flag used for downstream sensor signal evaluation" UBYTE _CNV_S_2_RANGE__0___1_CM 1 100. 0. 1. DISPLAY_IDENTIFIER LV_VLS_DOWN_THD_AFR_LAM_OLD[1] ECU_ADDRESS 0xd00060e6 BIT_MASK 0x1 /end MEASUREMENT
/begin MEASUREMENT laco[0].laco_struct_reqgnlaco0.lv_vls_down_thd_afl_lam_old "auxiliary flag used for downstream sensor signal evaluation" UBYTE _CNV_S_2_RANGE__0___1_CM 1 100. 0. 1. DISPLAY_IDENTIFIER LV_VLS_DOWN_THD_AFL_LAM_OLD[1] ECU_ADDRESS 0xd00060e7 BIT_MASK 0x1 /end MEASUREMENT
/begin MEASUREMENT laco[0].laco_struct_reqgnlacoi0.lamb_sp_delta_lam "lambda shift applied on lambda set point" SWORD _CNV_A_R_LINEAR_____24_CM 1 100. -0.125 0.125 DISPLAY_IDENTIFIER LAMB_SP_DELTA_LAM[1] ECU_ADDRESS 0xd00060e8 FORMAT "%8.5" /end MEASUREMENT
/begin MEASUREMENT laco[0].laco_struct_reqgnlacoi0.lamb_av_delta_lam "lambda shift applied on measured lambda signal" SWORD _CNV_A_R_LINEAR_____24_CM 1 100. -0.125 0.125 DISPLAY_IDENTIFIER LAMB_AV_DELTA_LAM[1] ECU_ADDRESS 0xd00060ea FORMAT "%8.5" /end MEASUREMENT
/begin MEASUREMENT laco[0].laco_struct_reqgnlacoi0.lv_inh_lscl "inhibit signal for the controller deactivation" UBYTE _CNV_S_2_RANGE__0___1_CM 1 100. 0. 1. DISPLAY_IDENTIFIER LV_INH_LSCL[1] ECU_ADDRESS 0xd00060ec BIT_MASK 0x1 /end MEASUREMENT
/begin MEASUREMENT laco[0].laco_struct_reqgnlacoi0.lv_lam_stop_req "request to stop the lambda controller" UBYTE _CNV_S_2_RANGE__0___1_CM 1 100. 0. 1. DISPLAY_IDENTIFIER LV_LAM_STOP_REQ[1] ECU_ADDRESS 0xd00060ed BIT_MASK 0x1 /end MEASUREMENT
/begin MEASUREMENT laco[0].laco_struct_reqgnlacoi0.lv_state_ls_opl_err "flag summarising errors that leads to open loop control" UBYTE _CNV_S_2_RANGE__0___1_CM 1 100. 0. 1. DISPLAY_IDENTIFIER LV_STATE_LS_OPL_ERR[1] ECU_ADDRESS 0xd00060ee BIT_MASK 0x1 /end MEASUREMENT
/begin MEASUREMENT laco[0].laco_struct_reqgnlacoi0.lv_lam_stop_sho_per_req "Request to trigger the short period stop mode of the Lambda controller" UBYTE _CNV_S_2_RANGE__0___1_CM 1 100. 0. 1. DISPLAY_IDENTIFIER LV_LAM_STOP_SHO_PER_REQ[1] ECU_ADDRESS 0xd00060ef BIT_MASK 0x1 /end MEASUREMENT
/begin MEASUREMENT laco[0].laco_struct_reqgnlacoi0.fac_ipt_sens_mdl "Interpolation factor for gas delay and sensor behavior model" UWORD _CNV_A_R_LINEAR_____129_CM 1 100. 0. 1. DISPLAY_IDENTIFIER FAC_IPT_SENS_MDL[1] ECU_ADDRESS 0xd00060f0 FORMAT "%6.4" /end MEASUREMENT
/begin MEASUREMENT laco[0].laco_struct_reqgntrim0.lamb_delta_i_mmv_lam_adj "I share moving mean value from trim control" SWORD _CNV_A_R_LACO_LINEA_374_CM 1 100. -0.125 0.124996185302734 DISPLAY_IDENTIFIER LAMB_DELTA_I_MMV_LAM_ADJ[1] ECU_ADDRESS 0xd00060f8 FORMAT "%9.6" /end MEASUREMENT
/begin MEASUREMENT laco[0].laco_struct_reqgntrim0.lamb_delta_lam_adj "total output (P share + I share) from trim control" SWORD _CNV_A_R_LINEAR_____24_CM 1 100. -0.125 0.125 DISPLAY_IDENTIFIER LAMB_DELTA_LAM_ADJ[1] ECU_ADDRESS 0xd00060fa FORMAT "%8.5" /end MEASUREMENT
/begin MEASUREMENT laco[0].laco_struct_reqgntrim0.lamb_delta_p_lam_adj "P share of from trim control" SWORD _CNV_A_R_LINEAR_____24_CM 1 100. -0.125 0.125 DISPLAY_IDENTIFIER LAMB_DELTA_P_LAM_ADJ[1] ECU_ADDRESS 0xd00060fc FORMAT "%8.5" /end MEASUREMENT
/begin MEASUREMENT laco[0].laco_struct_reqgntrim0.lamb_delta_i_lam_adj "I share from trim control" SWORD _CNV_A_R_LINEAR_____24_CM 1 100. -0.125 0.125 DISPLAY_IDENTIFIER LAMB_DELTA_I_LAM_ADJ[1] ECU_ADDRESS 0xd00060fe FORMAT "%8.5" /end MEASUREMENT
/begin MEASUREMENT laco[0].laco_struct_reqgntrim0.lamb_delta_i_save_lam_adj "saved I share from trim control (saved in case that catalyst diagnosis switched on)" SWORD _CNV_A_R_LACO_LINEA_374_CM 1 100. -0.125 0.124996185302734 DISPLAY_IDENTIFIER LAMB_DELTA_I_SAVE_LAM_ADJ[1] ECU_ADDRESS 0xd0006100 FORMAT "%9.6" /end MEASUREMENT
/begin MEASUREMENT laco[0].laco_struct_reqgntrim0.vls_dif_lam_adj "difference between setpoint and actual downstream LS signal" SWORD _CNV_A_R_LINEAR_____315_CM 1 100. -5.00000000000182 4.99511718999747 DISPLAY_IDENTIFIER VLS_DIF_LAM_ADJ[1] ECU_ADDRESS 0xd0006102 /end MEASUREMENT
/begin MEASUREMENT laco[0].laco_struct_reqgntrim0.vls_dif_mmv_lam_adj "moving mean value of difference between set point and actual downstream LS signal" SWORD _CNV_A_R_EGCP_LINEA_309_CM 1 100. -5. 4.999847 DISPLAY_IDENTIFIER VLS_DIF_MMV_LAM_ADJ[1] ECU_ADDRESS 0xd0006104 FORMAT "%7.4" /end MEASUREMENT
/begin MEASUREMENT laco[0].laco_struct_reqgntrim0.vls_dif_delta_lam_adj "difference between downstream LS signal and moving mean value" SWORD _CNV_A_R_EGCP_LINEA_309_CM 1 100. -5. 4.999847 DISPLAY_IDENTIFIER VLS_DIF_DELTA_LAM_ADJ[1] ECU_ADDRESS 0xd0006106 FORMAT "%7.4" /end MEASUREMENT
/begin MEASUREMENT laco[0].laco_struct_reqgntrim0.lamb_delta_d_lam_adj "D share from trim control" SWORD _CNV_A_R_LINEAR_____24_CM 1 100. -0.125 0.125 DISPLAY_IDENTIFIER LAMB_DELTA_D_LAM_ADJ[1] ECU_ADDRESS 0xd0006108 FORMAT "%8.5" /end MEASUREMENT
/begin MEASUREMENT laco[0].laco_struct_reqgntrim0.maf_int_lam_adj_act "integral of air mass flow since LAM activation" UWORD _CNV_A_R_CYBL_LINEA_135_CM 1 100. 0. 1456.33 DISPLAY_IDENTIFIER MAF_INT_LAM_ADJ_ACT[1] ECU_ADDRESS 0xd000610a FORMAT "%7.2" /end MEASUREMENT
/begin MEASUREMENT laco[0].laco_struct_reqgntrim0.vls_sp_lam_adj "trim control setpoint" UWORD _CNV_A_R_LINEAR_____2_CM 1 100. 0. 4.9951171875 DISPLAY_IDENTIFIER VLS_SP_LAM_ADJ[1] ECU_ADDRESS 0xd000610c FORMAT "%5.3" /end MEASUREMENT
/begin MEASUREMENT laco[0].laco_struct_reqgntrim0.maf_int_min_lam_adj_p_act "minimum air mass flow  integral for trim control P share activation" UWORD _CNV_A_R_CYBL_LINEA_135_CM 1 100. 0. 1456.33 DISPLAY_IDENTIFIER MAF_INT_MIN_LAM_ADJ_P_ACT[1] ECU_ADDRESS 0xd000610e FORMAT "%7.2" /end MEASUREMENT
/begin MEASUREMENT laco[0].laco_struct_reqgntrim0.maf_int_min_lam_adj_i_act "minimum air mass flow  integral for trim control I share activation" UWORD _CNV_A_R_CYBL_LINEA_135_CM 1 100. 0. 1456.33 DISPLAY_IDENTIFIER MAF_INT_MIN_LAM_ADJ_I_ACT[1] ECU_ADDRESS 0xd0006110 FORMAT "%7.2" /end MEASUREMENT
/begin MEASUREMENT laco[0].laco_struct_reqgntrim0.maf_int_min_lam_adj_d_act "minimum air mass flow integral for trim control D share activation" UWORD _CNV_A_R_CYBL_LINEA_135_CM 1 100. 0. 1456.33 DISPLAY_IDENTIFIER MAF_INT_MIN_LAM_ADJ_D_ACT[1] ECU_ADDRESS 0xd0006112 FORMAT "%7.2" /end MEASUREMENT
/begin MEASUREMENT laco[0].laco_struct_reqgntrim0.lv_lam_adj_act "Activation flag of dynamic fuel trim " UBYTE _CNV_S_2_RANGE__0___1_CM 1 100. 0. 1. DISPLAY_IDENTIFIER LV_LAM_ADJ_ACT[1] ECU_ADDRESS 0xd0006114 BIT_MASK 0x1 /end MEASUREMENT
/begin MEASUREMENT laco[0].laco_struct_reqgntrim0.lv_lam_adj_i_act "Activation flag for calculation of the trim-controller I-share" UBYTE _CNV_S_2_RANGE__0___1_CM 1 100. 0. 1. DISPLAY_IDENTIFIER LV_LAM_ADJ_I_ACT[1] ECU_ADDRESS 0xd0006115 BIT_MASK 0x1 /end MEASUREMENT
/begin MEASUREMENT laco[0].laco_struct_reqgntrim0.lv_lam_adj_p_act "activation flag for calculation of trim controller P share" UBYTE _CNV_S_2_RANGE__0___1_CM 1 100. 0. 1. DISPLAY_IDENTIFIER LV_LAM_ADJ_P_ACT[1] ECU_ADDRESS 0xd0006116 BIT_MASK 0x1 /end MEASUREMENT
/begin MEASUREMENT laco[0].laco_struct_reqgntrim0.lv_lam_adj_ad_end "flag indicating that trim control I share shift was executed" UBYTE _CNV_S_2_RANGE__0___1_CM 1 100. 0. 1. DISPLAY_IDENTIFIER LV_LAM_ADJ_AD_END[1] ECU_ADDRESS 0xd0006118 BIT_MASK 0x1 /end MEASUREMENT
/begin MEASUREMENT laco[0].laco_struct_reqgntrim0.lv_lam_adj_d_act "activation flag for calculation of trim controller D share" UBYTE _CNV_S_2_RANGE__0___1_CM 1 100. 0. 1. DISPLAY_IDENTIFIER LV_LAM_ADJ_D_ACT[1] ECU_ADDRESS 0xd0006119 BIT_MASK 0x1 /end MEASUREMENT
/begin MEASUREMENT laco[0].laco_struct_reqgntrimi0.fac_lam_mv_ofs_ldc_lam_adj "filtered lambda controller output offset for limited dynamics calculation" SWORD _CNV_A_R_LINEAR_____113_CM 1 100. -50. 49.9984741210938 DISPLAY_IDENTIFIER FAC_LAM_MV_OFS_LDC_LAM_ADJ ECU_ADDRESS 0xd000611c FORMAT "%7.3" /end MEASUREMENT
/begin MEASUREMENT laco[0].laco_struct_reqgntrimi0.maf_ofs_ldc_lam_adj "air mass flow offset for limited dynamics calculation" SWORD _CNV_A_R_LINEAR_____128_CM 1 100. -694.510597390707 694.4894026092931 DISPLAY_IDENTIFIER MAF_OFS_LDC_LAM_ADJ ECU_ADDRESS 0xd000611e FORMAT "%7.2" /end MEASUREMENT
/begin MEASUREMENT laco[0].laco_struct_reqgntrimi0.n_ofs_ldc_lam_adj "engine speed offset for limited dynamics calculation" SWORD _CNV_A_R_LINEAR_____14_CM 1 100. -8160. 8160. DISPLAY_IDENTIFIER N_OFS_LDC_LAM_ADJ ECU_ADDRESS 0xd0006120 FORMAT "%5.0" /end MEASUREMENT
/begin MEASUREMENT laco[0].laco_struct_reqgntrimi0.vls_av_lam_adj "sensor voltage actual value for trim control" UWORD _CNV_A_R_LINEAR_____2_CM 1 100. 0. 4.9951171875 DISPLAY_IDENTIFIER VLS_AV_LAM_ADJ[1] ECU_ADDRESS 0xd0006122 FORMAT "%5.3" /end MEASUREMENT
/begin MEASUREMENT laco[0].laco_struct_reqgntrimi0.vls_delta_lam_adj_cat_diag "Sensor voltage set point shift in case of active cat efficiency diagnosis" UWORD _CNV_A_R_LINEAR_____2_CM 1 100. 0. 4.9951171875 DISPLAY_IDENTIFIER VLS_DELTA_LAM_ADJ_CAT_DIAG[1] ECU_ADDRESS 0xd0006124 FORMAT "%5.3" /end MEASUREMENT
/begin MEASUREMENT laco[0].laco_struct_reqgntrimi0.maf_int_ldc_lam_adj "MAF integral during limited dynamics not fulfilled" UWORD _CNV_A_R_LINEAR_____364_CM 1 100. 0. 1820.42 DISPLAY_IDENTIFIER MAF_INT_LDC_LAM_ADJ ECU_ADDRESS 0xd0006126 FORMAT "%7.2" /end MEASUREMENT
/begin MEASUREMENT laco[0].laco_struct_reqgntrimi0.vls_av_tmp_lam_adj "auxiliary sensor voltage actual value for filter calculation" UWORD _CNV_A_R_LINEAR_____201_CM 1 100. 0. 4.99992371 DISPLAY_IDENTIFIER VLS_AV_TMP_LAM_ADJ ECU_ADDRESS 0xd0006128 FORMAT "%7.5" /end MEASUREMENT
/begin MEASUREMENT laco[0].laco_struct_reqgntrimi0.pv_av_ofs_ldc_lam_adj "actual pedal value offset for limited dynamics calculation" SBYTE _CNV_A_R_LINEAR_____5_CM 1 100. -50. 49.609375 DISPLAY_IDENTIFIER PV_AV_OFS_LDC_LAM_ADJ ECU_ADDRESS 0xd000612a FORMAT "%5.1" /end MEASUREMENT
/begin MEASUREMENT laco[0].laco_struct_reqgntrimi0.lv_ldc_lam_adj "limited dynamic conditions for trim control" UBYTE _CNV_S_2_RANGE__0___1_CM 1 100. 0. 1. DISPLAY_IDENTIFIER LV_LDC_LAM_ADJ[1] ECU_ADDRESS 0xd000612b BIT_MASK 0x1 /end MEASUREMENT
/begin MEASUREMENT laco[0].laco_struct_reqgntrimi0.lv_inh_lam_adj "inhibition flag for trim control" UBYTE _CNV_S_2_RANGE__0___1_CM 1 100. 0. 1. DISPLAY_IDENTIFIER LV_INH_LAM_ADJ[1] ECU_ADDRESS 0xd000612c BIT_MASK 0x1 /end MEASUREMENT
/begin MEASUREMENT laco[0].laco_struct_reqgntrimi0.lv_inh_lam_adj_err "inhibition flag for trim control based on error flag evaluation" UBYTE _CNV_S_2_RANGE__0___1_CM 1 100. 0. 1. DISPLAY_IDENTIFIER LV_INH_LAM_ADJ_ERR ECU_ADDRESS 0xd000612d BIT_MASK 0x1 /end MEASUREMENT
/begin MEASUREMENT laco[0].laco_struct_reqgntrimi0.lv_lamb_delta_i_lam_adj_deac "flag indicating that I share is fixed when deactivating lambda controller" UBYTE _CNV_S_2_RANGE__0___1_CM 1 100. 0. 1. DISPLAY_IDENTIFIER LV_LAMB_DELTA_I_LAM_ADJ_DEAC[1] ECU_ADDRESS 0xd000612e BIT_MASK 0x1 /end MEASUREMENT
/begin MEASUREMENT laco[0].laco_struct_reqgntrimi0.lv_lamb_delta_ad_lam_adj_clc "flag indicating that adaptation value is calculated at start of power latch phase" UBYTE _CNV_S_2_RANGE__0___1_CM 1 100. 0. 1. DISPLAY_IDENTIFIER LV_LAMB_DELTA_AD_LAM_ADJ_CLC[1] ECU_ADDRESS 0xd000612f BIT_MASK 0x1 /end MEASUREMENT
/begin MEASUREMENT laco[0].laco_struct_reqgntrimi0.lv_lam_adj_act_fast_lam_lscl "flag indicating that adaptation value is calculated at start of power latch phase" UBYTE _CNV_S_2_RANGE__0___1_CM 1 100. 0. 1. DISPLAY_IDENTIFIER LV_LAM_ADJ_ACT_FAST_LAM_LSCL[1] ECU_ADDRESS 0xd000612f BIT_MASK 0x1 /end MEASUREMENT
/begin MEASUREMENT laco[1].laco_struct_ispclada0.mff_lam_add_lam_ad_out "fuel mass set point offset, output from lambda adaptation, input into lamda controller" SWORD _CNV_A_R_LINEAR_____128_CM 1 100. -694.510597390707 694.4894026092931 DISPLAY_IDENTIFIER MFF_LAM_ADD_LAM_AD_OUT[2] ECU_ADDRESS 0xd00061b4 FORMAT "%7.2" /end MEASUREMENT
/begin MEASUREMENT laco[1].laco_struct_ispclada0.fac_lam_ad_lam_out "fuel mass set point factor, output from lambda adaptation, input into lamda controller" SWORD _CNV_A_R_LINEAR_____113_CM 1 100. -50. 49.9984741210938 DISPLAY_IDENTIFIER FAC_LAM_AD_LAM_OUT[2] ECU_ADDRESS 0xd00061b6 FORMAT "%7.3" /end MEASUREMENT
/begin MEASUREMENT laco[1].laco_struct_ispclada0.fac_mff_add_lam_ad_out "relative lambda adaptation offset quotient" SWORD _CNV_A_R_LINEAR_____212_CM 1 100. -100. 99.9969482421875 DISPLAY_IDENTIFIER FAC_MFF_ADD_LAM_AD_OUT[2] ECU_ADDRESS 0xd00061b8 FORMAT "%8.3" /end MEASUREMENT
/begin MEASUREMENT laco[1].laco_struct_ispclada0.mff_add_lam_ad "fuel mass set point offset, stored value of lambda adaptation" SWORD _CNV_A_R_LINEAR_____128_CM 1 100. -694.510597390707 694.4894026092931 DISPLAY_IDENTIFIER MFF_ADD_LAM_AD[2] ECU_ADDRESS 0xd00061ba FORMAT "%7.2" /end MEASUREMENT
/begin MEASUREMENT laco[1].laco_struct_ispclada0.mff_delta_add_lam_ad "difference of lambda adaptation offset to previous adaptation" SWORD _CNV_A_R_LINEAR_____128_CM 1 100. -694.510597390707 694.4894026092931 DISPLAY_IDENTIFIER MFF_DELTA_ADD_LAM_AD[2] ECU_ADDRESS 0xd00061bc FORMAT "%7.2" /end MEASUREMENT
/begin MEASUREMENT laco[1].laco_struct_ispclada0.mff_delta_add_lam_ad_h_res "difference integral with high resolution of lambda adaptation offset" SWORD _CNV_A_R_LACO_LINEA_365_CM 1 100. -10.851728 10.851397 DISPLAY_IDENTIFIER MFF_DELTA_ADD_LAM_AD_H_RES[2] ECU_ADDRESS 0xd00061be FORMAT "%8.4" /end MEASUREMENT
/begin MEASUREMENT laco[1].laco_struct_ispclada0.fac_lam_ad "fuel mass set point factor of lambda adaptation, interpolation of both factor areas (high and low field)" SWORD _CNV_A_R_LINEAR_____113_CM 1 100. -50. 49.9984741210938 DISPLAY_IDENTIFIER FAC_LAM_AD[2] ECU_ADDRESS 0xd00061c0 FORMAT "%7.3" /end MEASUREMENT
/begin MEASUREMENT laco[1].laco_struct_ispclada0.fac_l_rng_lam_ad "fuel mass set point factor of low field, stored value of lambda adaptation" SWORD _CNV_A_R_LINEAR_____113_CM 1 100. -50. 49.9984741210938 DISPLAY_IDENTIFIER FAC_L_RNG_LAM_AD[2] ECU_ADDRESS 0xd00061c2 FORMAT "%7.3" /end MEASUREMENT
/begin MEASUREMENT laco[1].laco_struct_ispclada0.fac_h_rng_lam_ad "fuel mass set point factor of high field, stored value of lambda adaptation" SWORD _CNV_A_R_LINEAR_____113_CM 1 100. -50. 49.9984741210938 DISPLAY_IDENTIFIER FAC_H_RNG_LAM_AD[2] ECU_ADDRESS 0xd00061c4 FORMAT "%7.3" /end MEASUREMENT
/begin MEASUREMENT laco[1].laco_struct_ispclada0.fac_delta_l_rng_lam_ad "difference of lambda adaptation factor of low field to previous adaptation" SWORD _CNV_A_R_LINEAR_____113_CM 1 100. -50. 49.9984741210938 DISPLAY_IDENTIFIER FAC_DELTA_L_RNG_LAM_AD[2] ECU_ADDRESS 0xd00061c6 FORMAT "%7.3" /end MEASUREMENT
/begin MEASUREMENT laco[1].laco_struct_ispclada0.fac_delta_h_rng_lam_ad "difference of lambda adaptation factor of high field to previous adaptation" SWORD _CNV_A_R_LINEAR_____113_CM 1 100. -50. 49.9984741210938 DISPLAY_IDENTIFIER FAC_DELTA_H_RNG_LAM_AD[2] ECU_ADDRESS 0xd00061c8 FORMAT "%7.3" /end MEASUREMENT
/begin MEASUREMENT laco[1].laco_struct_ispclada0.fac_lam_adj_lam_ad "output value from lambda adaptation for the lambda controller shift" SWORD _CNV_A_R_LINEAR_____113_CM 1 100. -50. 49.9984741210938 DISPLAY_IDENTIFIER FAC_LAM_ADJ_LAM_AD[2] ECU_ADDRESS 0xd00061ca FORMAT "%7.3" /end MEASUREMENT
/begin MEASUREMENT laco[1].laco_struct_ispclada0.fac_mff_add_fac_lam_ad "lambda adaptation correction for scan tool (factor and relative offset)" SWORD _CNV_A_R_LINEAR_____212_CM 1 100. -100. 99.9969482421875 DISPLAY_IDENTIFIER FAC_MFF_ADD_FAC_LAM_AD[2] ECU_ADDRESS 0xd00061cc FORMAT "%8.3" /end MEASUREMENT
/begin MEASUREMENT laco[1].laco_struct_ispclada0.t_pri_lam_ad "priority time for next requested lambda adaptation" UWORD _CNV_A_R_LINEAR_____4_CM 1 100. 0. 6553.5 DISPLAY_IDENTIFIER T_PRI_LAM_AD[2] ECU_ADDRESS 0xd00061ce FORMAT "%6.1" /end MEASUREMENT
/begin MEASUREMENT laco[1].laco_struct_ispclada0.state_lam_ad "state of lambda adaptation" UBYTE _CNV_S_8_LACO_RANGE_366_CM 1 100. 0. 7. DISPLAY_IDENTIFIER STATE_LAM_AD[2] ECU_ADDRESS 0xd00061d0 /end MEASUREMENT
/begin MEASUREMENT laco[1].laco_struct_ispclada0.lv_fac_lam_adj_lam_ad "flag to request lambda controller shift" UBYTE _CNV_S_2_RANGE__0___1_CM 1 100. 0. 1. DISPLAY_IDENTIFIER LV_FAC_LAM_ADJ_LAM_AD[2] ECU_ADDRESS 0xd00061d1 BIT_MASK 0x1 /end MEASUREMENT
/begin MEASUREMENT laco[1].laco_struct_ispclada0.lv_lam_ad_stop "logical varialble indicating stop of the lambda adaptation cycle" UBYTE _CNV_S_2_RANGE__0___1_CM 1 100. 0. 1. DISPLAY_IDENTIFIER LV_LAM_AD_STOP[2] ECU_ADDRESS 0xd00061d2 BIT_MASK 0x1 /end MEASUREMENT
/begin MEASUREMENT laco[1].laco_struct_ispclada0.lv_fac_l_rng_lim_max_lam_ad "flag indicating top limitation of lambda adaptation factor of lower area" UBYTE _CNV_S_2_RANGE__0___1_CM 1 100. 0. 1. DISPLAY_IDENTIFIER LV_FAC_L_RNG_LIM_MAX_LAM_AD[2] ECU_ADDRESS 0xd00061d3 BIT_MASK 0x1 /end MEASUREMENT
/begin MEASUREMENT laco[1].laco_struct_ispclada0.lv_fac_l_rng_lim_min_lam_ad "flag indicating bottom limitation of lambda adaptation factor of lower area" UBYTE _CNV_S_2_RANGE__0___1_CM 1 100. 0. 1. DISPLAY_IDENTIFIER LV_FAC_L_RNG_LIM_MIN_LAM_AD[2] ECU_ADDRESS 0xd00061d4 BIT_MASK 0x1 /end MEASUREMENT
/begin MEASUREMENT laco[1].laco_struct_ispclada0.lv_fac_h_rng_lim_max_lam_ad "flag indicating top limitation of lambda adaptation factor of upper area" UBYTE _CNV_S_2_RANGE__0___1_CM 1 100. 0. 1. DISPLAY_IDENTIFIER LV_FAC_H_RNG_LIM_MAX_LAM_AD[2] ECU_ADDRESS 0xd00061d5 BIT_MASK 0x1 /end MEASUREMENT
/begin MEASUREMENT laco[1].laco_struct_ispclada0.lv_fac_h_rng_lim_min_lam_ad "flag indicating bottom limitation of lambda adaptation factor of upper area" UBYTE _CNV_S_2_RANGE__0___1_CM 1 100. 0. 1. DISPLAY_IDENTIFIER LV_FAC_H_RNG_LIM_MIN_LAM_AD[2] ECU_ADDRESS 0xd00061d6 BIT_MASK 0x1 /end MEASUREMENT
/begin MEASUREMENT laco[1].laco_struct_ispclada0.lv_mff_add_lim_max_lam_ad "flag indicating top limitation of lambda adaptation offset" UBYTE _CNV_S_2_RANGE__0___1_CM 1 100. 0. 1. DISPLAY_IDENTIFIER LV_MFF_ADD_LIM_MAX_LAM_AD[2] ECU_ADDRESS 0xd00061d7 BIT_MASK 0x1 /end MEASUREMENT
/begin MEASUREMENT laco[1].laco_struct_ispclada0.lv_mff_add_lim_min_lam_ad "flag indicating bottom limitation of lambda adaptation offset" UBYTE _CNV_S_2_RANGE__0___1_CM 1 100. 0. 1. DISPLAY_IDENTIFIER LV_MFF_ADD_LIM_MIN_LAM_AD[2] ECU_ADDRESS 0xd00061d8 BIT_MASK 0x1 /end MEASUREMENT
/begin MEASUREMENT laco[1].laco_struct_ispclada0.lv_fac_h_rng_lam_ad "flag indicating that lambda adaptation in factor learning upper field is active" UBYTE _CNV_S_2_RANGE__0___1_CM 1 100. 0. 1. DISPLAY_IDENTIFIER LV_FAC_H_RNG_LAM_AD[2] ECU_ADDRESS 0xd00061d9 BIT_MASK 0x1 /end MEASUREMENT
/begin MEASUREMENT laco[1].laco_struct_ispclada0.lv_fac_l_rng_lam_ad "flag indicating that lambda adaptation in factor learning lower field is active" UBYTE _CNV_S_2_RANGE__0___1_CM 1 100. 0. 1. DISPLAY_IDENTIFIER LV_FAC_L_RNG_LAM_AD[2] ECU_ADDRESS 0xd00061da BIT_MASK 0x1 /end MEASUREMENT
/begin MEASUREMENT laco[1].laco_struct_ispclada0.lv_mff_add_rng_lam_ad "flag indicating that lambda adaptation in offset learning field is active" UBYTE _CNV_S_2_RANGE__0___1_CM 1 100. 0. 1. DISPLAY_IDENTIFIER LV_MFF_ADD_RNG_LAM_AD[2] ECU_ADDRESS 0xd00061db BIT_MASK 0x1 /end MEASUREMENT
/begin MEASUREMENT laco[1].laco_struct_ispclada0.t_wait_lam_ad "waiting time between two adaptations" UBYTE _CNV_A_R_LINEAR_____110_CM 1 100. 0. 5.1 DISPLAY_IDENTIFIER T_WAIT_LAM_AD[2] ECU_ADDRESS 0xd00061dc FORMAT "%4.2" /end MEASUREMENT
/begin MEASUREMENT laco[1].laco_struct_ispcladapi0.maf_ofs_ldc_lam_ad "air mass flow offset for limited dynamics calculation" SWORD _CNV_A_R_LINEAR_____128_CM 1 100. -694.510597390707 694.4894026092931 DISPLAY_IDENTIFIER MAF_OFS_LDC_LAM_AD ECU_ADDRESS 0xd00061e0 FORMAT "%7.2" /end MEASUREMENT
/begin MEASUREMENT laco[1].laco_struct_ispcladapi0.fac_lam_mv_ofs_ldc_lam_ad "filtered lambda controller output offset for limited dynamics calculation" SWORD _CNV_A_R_LINEAR_____113_CM 1 100. -50. 49.9984741210938 DISPLAY_IDENTIFIER FAC_LAM_MV_OFS_LDC_LAM_AD ECU_ADDRESS 0xd00061e2 FORMAT "%7.3" /end MEASUREMENT
/begin MEASUREMENT laco[1].laco_struct_ispcladapi0.n_ofs_ldc_lam_ad "engine speed offset for limited dynamics calculation" SWORD _CNV_A_R_LINEAR_____14_CM 1 100. -8160. 8160. DISPLAY_IDENTIFIER N_OFS_LDC_LAM_AD ECU_ADDRESS 0xd00061e4 FORMAT "%5.0" /end MEASUREMENT
/begin MEASUREMENT laco[1].laco_struct_ispcladapi0.maf_int_ldc_lam_ad "air mass flow integral during limited dynamics not fulfilled" UWORD _CNV_A_R_LINEAR_____364_CM 1 100. 0. 1820.42 DISPLAY_IDENTIFIER MAF_INT_LDC_LAM_AD ECU_ADDRESS 0xd00061e6 FORMAT "%7.2" /end MEASUREMENT
/begin MEASUREMENT laco[1].laco_struct_ispcladapi0.crlc_lam_ad "correlation constant for calculation of adaptive values" UBYTE _CNV_A_R_LINEAR_____28_CM 1 100. 0. 0.99609375 DISPLAY_IDENTIFIER CRLC_LAM_AD[2] ECU_ADDRESS 0xd00061e8 FORMAT "%5.3" /end MEASUREMENT
/begin MEASUREMENT laco[1].laco_struct_ispcladapi0.t_wait_max_lam_ad "threshold of waiting time between two adaptations" UBYTE _CNV_A_R_LINEAR_____110_CM 1 100. 0. 5.1 DISPLAY_IDENTIFIER T_WAIT_MAX_LAM_AD[2] ECU_ADDRESS 0xd00061e9 FORMAT "%4.2" /end MEASUREMENT
/begin MEASUREMENT laco[1].laco_struct_ispcladapi0.lv_lam_ad_act "flag indicating that lambda adaptation can be activated" UBYTE _CNV_S_2_RANGE__0___1_CM 1 100. 0. 1. DISPLAY_IDENTIFIER LV_LAM_AD_ACT[2] ECU_ADDRESS 0xd00061ea BIT_MASK 0x1 /end MEASUREMENT
/begin MEASUREMENT laco[1].laco_struct_ispcladapi0.lv_ldc_lam_ad "limited dynamic conditions for lambda adaptation" UBYTE _CNV_S_2_RANGE__0___1_CM 1 100. 0. 1. DISPLAY_IDENTIFIER LV_LDC_LAM_AD[2] ECU_ADDRESS 0xd00061eb BIT_MASK 0x1 /end MEASUREMENT
/begin MEASUREMENT laco[1].laco_struct_ispcladapi0.lv_lam_ad_act_err "flag indicating that lambda adaptation can be activated because of no error detected" UBYTE _CNV_S_2_RANGE__0___1_CM 1 100. 0. 1. DISPLAY_IDENTIFIER LV_LAM_AD_ACT_ERR[2] ECU_ADDRESS 0xd00061ec BIT_MASK 0x1 /end MEASUREMENT
/begin MEASUREMENT laco[1].laco_struct_ispcladapi0.lv_lam_ad_deac_err "flag indicating that lambda adaptation is deactivated due to an error" UBYTE _CNV_S_2_RANGE__0___1_CM 1 100. 0. 1. DISPLAY_IDENTIFIER LV_LAM_AD_DEAC_ERR[2] ECU_ADDRESS 0xd00061ed BIT_MASK 0x1 /end MEASUREMENT
/begin MEASUREMENT laco[1].laco_struct_ispcladapi0.pv_av_ofs_ldc_lam_ad "actual pedal value offset for limited dynamics calculation" SBYTE _CNV_A_R_LINEAR_____5_CM 1 100. -50. 49.609375 DISPLAY_IDENTIFIER PV_AV_OFS_LDC_LAM_AD ECU_ADDRESS 0xd00061ee FORMAT "%6.2" /end MEASUREMENT
/begin MEASUREMENT laco[1].laco_struct_ispcladapi0.lv_lam_ad_wup_act "flag indicating that lambda adaptation in warm-up phase can be activated" UBYTE _CNV_S_2_RANGE__0___1_CM 1 100. 0. 1. DISPLAY_IDENTIFIER LV_LAM_AD_WUP_ACT[2] ECU_ADDRESS 0xd00061ef BIT_MASK 0x1 /end MEASUREMENT
/begin MEASUREMENT laco[1].laco_struct_ispcladapi0.lv_lam_ad_cdn_h_rng "condition bit for activation of lambda adaptation ADAPT_FAC_H" UBYTE _CNV_S_2_RANGE__0___1_CM 1 100. 0. 1. DISPLAY_IDENTIFIER LV_LAM_AD_CDN_H_RNG[2] ECU_ADDRESS 0xd00061f0 BIT_MASK 0x1 /end MEASUREMENT
/begin MEASUREMENT laco[1].laco_struct_ispcladapi0.lv_lam_ad_cdn_l_rng "condition bit for activation of lambda adaptation ADAPT_FAC_L" UBYTE _CNV_S_2_RANGE__0___1_CM 1 100. 0. 1. DISPLAY_IDENTIFIER LV_LAM_AD_CDN_L_RNG[2] ECU_ADDRESS 0xd00061f1 BIT_MASK 0x1 /end MEASUREMENT
/begin MEASUREMENT laco[1].laco_struct_ispcladapi0.lv_lam_ad_cdn_add "condition bit for activation of lambda adaptation ADAPT_ADD" UBYTE _CNV_S_2_RANGE__0___1_CM 1 100. 0. 1. DISPLAY_IDENTIFIER LV_LAM_AD_CDN_ADD[2] ECU_ADDRESS 0xd00061f2 BIT_MASK 0x1 /end MEASUREMENT
/begin MEASUREMENT laco[1].laco_struct_ispcladapi0.mff_sp_ad "Mass fuel flow setpoint for lambda adaptation - bank selective" UWORD _CNV_A_R_LINEAR_____111_CM 1 100. 0. 1389. DISPLAY_IDENTIFIER MFF_SP_AD[2] ECU_ADDRESS 0xd00061f4 FORMAT "%7.2" /end MEASUREMENT
/begin MEASUREMENT laco[1].laco_struct_ispclmvldc0.fac_lam_mv_delta_ldc "difference between FAC_LAM_MV[i] and moving mean value of FAC_LAM_MV[i] for limited dynamics detection" SWORD _CNV_A_R_LINEAR_____113_CM 1 100. -50. 49.9984741210938 DISPLAY_IDENTIFIER FAC_LAM_MV_DELTA_LDC[2] ECU_ADDRESS 0xd00061f8 FORMAT "%7.3" /end MEASUREMENT
/begin MEASUREMENT laco[1].laco_struct_reqgnlaco0.fac_dif_sum_lam_in "unlimited summation of controller difference" SLONG _CNV_A_R_LACO_LINEA_367_CM 1 100. -65536. 65535.9999694824 DISPLAY_IDENTIFIER FAC_DIF_SUM_LAM_IN[2] ECU_ADDRESS 0xd00061fc FORMAT "%12.5" /end MEASUREMENT
/begin MEASUREMENT laco[1].laco_struct_reqgnlaco0.fac_lam_i_it_lim "limited internal I share used for PID control only" SLONG _CNV_A_R_LACO_LINEA_368_CM 1 100. -50. 49.9999999767169 DISPLAY_IDENTIFIER FAC_LAM_I_IT_LIM[2] ECU_ADDRESS 0xd0006200 FORMAT "%10.6" /end MEASUREMENT
/begin MEASUREMENT laco[1].laco_struct_reqgnlaco0.fac_dif_sum_lim_lam_in "limited summation of controller difference" SLONG _CNV_A_R_LACO_LINEA_367_CM 1 100. -65536. 65535.9999694824 DISPLAY_IDENTIFIER FAC_DIF_SUM_LIM_LAM_IN[2] ECU_ADDRESS 0xd0006204 FORMAT "%12.5" /end MEASUREMENT
/begin MEASUREMENT laco[1].laco_struct_reqgnlaco0.fac_dif_sum_lam_in_save "stored value of controller difference summation" SLONG _CNV_A_R_LACO_LINEA_367_CM 1 100. -65536. 65535.9999694824 DISPLAY_IDENTIFIER FAC_DIF_SUM_LAM_IN_SAVE[2] ECU_ADDRESS 0xd0006208 FORMAT "%12.5" /end MEASUREMENT
/begin MEASUREMENT laco[1].laco_struct_reqgnlaco0.fac_dif_lam_in_mmv "controller difference (richness) moving mean value" SLONG _CNV_A_R_LACO_LINEA_369_CM 1 100. -1. 0.9999999995343391 DISPLAY_IDENTIFIER FAC_DIF_LAM_IN_MMV[2] ECU_ADDRESS 0xd000620c FORMAT "%9.6" /end MEASUREMENT
/begin MEASUREMENT laco[1].laco_struct_reqgnlaco0.fac_lam_i_it "unlimited internal I share used for PID control only" SLONG _CNV_A_R_LACO_LINEA_368_CM 1 100. -50. 49.9999999767169 DISPLAY_IDENTIFIER FAC_LAM_I_IT[2] ECU_ADDRESS 0xd0006210 FORMAT "%10.6" /end MEASUREMENT
/begin MEASUREMENT laco[1].laco_struct_reqgnlaco0.fac_lam_pctl "pre control path correction" SWORD _CNV_A_R_LINEAR_____113_CM 1 100. -50. 49.9984741210938 DISPLAY_IDENTIFIER FAC_LAM_PCTL[2] ECU_ADDRESS 0xd0006238 FORMAT "%7.3" /end MEASUREMENT
/begin MEASUREMENT laco[1].laco_struct_reqgnlaco0.fac_lam_out "Lambda controller output" SWORD _CNV_A_R_LINEAR_____113_CM 1 100. -50. 49.9984741210938 DISPLAY_IDENTIFIER FAC_LAM_OUT[2] ECU_ADDRESS 0xd000623c FORMAT "%7.3" /end MEASUREMENT
/begin MEASUREMENT laco[1].laco_struct_reqgnlaco0.fac_dif_lam_in "controller difference (richness)" SWORD _CNV_A_R_LINEAR_____259_CM 1 100. -1. 0.999969482421875 DISPLAY_IDENTIFIER FAC_DIF_LAM_IN[2] ECU_ADDRESS 0xd000623e FORMAT "%8.5" /end MEASUREMENT
/begin MEASUREMENT laco[1].laco_struct_reqgnlaco0.fac_lam_i "unlimited I share output signal" SWORD _CNV_A_R_LINEAR_____113_CM 1 100. -50. 49.9984741210938 DISPLAY_IDENTIFIER FAC_LAM_I[2] ECU_ADDRESS 0xd0006242 FORMAT "%7.3" /end MEASUREMENT
/begin MEASUREMENT laco[1].laco_struct_reqgnlaco0.fac_lam_i2 "unlimited I^2 share output signal" SWORD _CNV_A_R_LINEAR_____113_CM 1 100. -50. 49.9984741210938 DISPLAY_IDENTIFIER FAC_LAM_I2[2] ECU_ADDRESS 0xd0006244 FORMAT "%7.3" /end MEASUREMENT
/begin MEASUREMENT laco[1].laco_struct_reqgnlaco0.fac_lam_i2_lim "limited I^2 share output signal" SWORD _CNV_A_R_LINEAR_____113_CM 1 100. -50. 49.9984741210938 DISPLAY_IDENTIFIER FAC_LAM_I2_LIM[2] ECU_ADDRESS 0xd0006246 FORMAT "%7.3" /end MEASUREMENT
/begin MEASUREMENT laco[1].laco_struct_reqgnlaco0.fac_lam_i_i2_sum_lim "limited I share + I^2 share output signal" SWORD _CNV_A_R_LINEAR_____113_CM 1 100. -50. 49.9984741210938 DISPLAY_IDENTIFIER FAC_LAM_I_I2_SUM_LIM[2] ECU_ADDRESS 0xd000624a FORMAT "%7.3" /end MEASUREMENT
/begin MEASUREMENT laco[1].laco_struct_reqgnlaco0.fac_lam_p_lim "limited P share output signal" SWORD _CNV_A_R_LINEAR_____113_CM 1 100. -50. 49.9984741210938 DISPLAY_IDENTIFIER FAC_LAM_P_LIM[2] ECU_ADDRESS 0xd000624e FORMAT "%7.3" /end MEASUREMENT
/begin MEASUREMENT laco[1].laco_struct_reqgnlaco0.fac_lam_d_lim "limited D share output signal" SWORD _CNV_A_R_LINEAR_____113_CM 1 100. -50. 49.9984741210938 DISPLAY_IDENTIFIER FAC_LAM_D_LIM[2] ECU_ADDRESS 0xd0006252 FORMAT "%7.3" /end MEASUREMENT
/begin MEASUREMENT laco[1].laco_struct_reqgnlaco0.fac_lam_mv "Mean value of lambda controller output" SWORD _CNV_A_R_LINEAR_____113_CM 1 100. -50. 49.9984741210938 DISPLAY_IDENTIFIER FAC_LAM_MV[2] ECU_ADDRESS 0xd0006258 FORMAT "%7.3" /end MEASUREMENT
/begin MEASUREMENT laco[1].laco_struct_reqgnlaco0.fac_lam_mv_mmv "FAC_LAM_MV[i] average value" SWORD _CNV_A_R_LINEAR_____113_CM 1 100. -50. 49.9984741210938 DISPLAY_IDENTIFIER FAC_LAM_MV_MMV[2] ECU_ADDRESS 0xd000625a FORMAT "%7.3" /end MEASUREMENT
/begin MEASUREMENT laco[1].laco_struct_reqgnlaco0.fac_lam_mv_mmv_cp "Mean value of lambda controller output, used by canister purge" SWORD _CNV_A_R_LINEAR_____113_CM 1 100. -50. 49.9984741210938 DISPLAY_IDENTIFIER FAC_LAM_MV_MMV_CP[2] ECU_ADDRESS 0xd000625c FORMAT "%7.3" /end MEASUREMENT
/begin MEASUREMENT laco[1].laco_struct_reqgnlaco0.fac_lam_mv_mmv_ldc "moving mean value of the controller output, used for limited dynamics calculation" SWORD _CNV_A_R_LINEAR_____113_CM 1 100. -50. 49.9984741210938 DISPLAY_IDENTIFIER FAC_LAM_MV_MMV_LDC[2] ECU_ADDRESS 0xd000625e FORMAT "%7.3" /end MEASUREMENT
/begin MEASUREMENT laco[1].laco_struct_reqgnlaco0.fac_lam_mv_mmv_ldc_diag "Mean value of the controller output, used by limited dynamics for cat efficiency diagnosis" SWORD _CNV_A_R_LINEAR_____113_CM 1 100. -50. 49.9984741210938 DISPLAY_IDENTIFIER FAC_LAM_MV_MMV_LDC_DIAG[2] ECU_ADDRESS 0xd0006260 FORMAT "%7.3" /end MEASUREMENT
/begin MEASUREMENT laco[1].laco_struct_reqgnlaco0.fac_lam_max_not_stat_cdn "upper limit in case of limitation under non stationary conditions" SWORD _CNV_A_R_LINEAR_____113_CM 1 100. -50. 49.9984741210938 DISPLAY_IDENTIFIER FAC_LAM_MAX_NOT_STAT_CDN[2] ECU_ADDRESS 0xd0006262 FORMAT "%7.3" /end MEASUREMENT
/begin MEASUREMENT laco[1].laco_struct_reqgnlaco0.fac_lam_min_not_stat_cdn "bottom limit in case of limitation under non stationary conditions" SWORD _CNV_A_R_LINEAR_____113_CM 1 100. -50. 49.9984741210938 DISPLAY_IDENTIFIER FAC_LAM_MIN_NOT_STAT_CDN[2] ECU_ADDRESS 0xd0006264 FORMAT "%7.3" /end MEASUREMENT
/begin MEASUREMENT laco[1].laco_struct_reqgnlaco0.fac_lam_cor "Limited lambda controller output plus pre-control correction" SWORD _CNV_A_R_LINEAR_____113_CM 1 100. -50. 49.9984741210938 DISPLAY_IDENTIFIER FAC_LAM_COR[2] ECU_ADDRESS 0xd0006266 FORMAT "%7.3" /end MEASUREMENT
/begin MEASUREMENT laco[1].laco_struct_reqgnlaco0.fac_lam_delta_i_i2_shift "I and I^2 share shift based on downstream signal evaluation" SWORD _CNV_A_R_LINEAR_____113_CM 1 100. -50. 49.9984741210938 DISPLAY_IDENTIFIER FAC_LAM_DELTA_I_I2_SHIFT[2] ECU_ADDRESS 0xd0006268 FORMAT "%7.3" /end MEASUREMENT
/begin MEASUREMENT laco[1].laco_struct_reqgnlaco0.fac_lam_lim "Limited value of lambda controller output" SWORD _CNV_A_R_LINEAR_____113_CM 1 100. -50. 49.9984741210938 DISPLAY_IDENTIFIER FAC_LAM_LIM[2] ECU_ADDRESS 0xd000626a FORMAT "%7.3" /end MEASUREMENT
/begin MEASUREMENT laco[1].laco_struct_reqgnlaco0.crlc_lsl_mdl "correlation constant for lambda sensor model" UWORD _CNV_A_R_LINEAR_____89_CM 1 100. 0. 0.9999847412109381 DISPLAY_IDENTIFIER CRLC_LSL_MDL[2] ECU_ADDRESS 0xd0006270 FORMAT "%7.5" /end MEASUREMENT
/begin MEASUREMENT laco[1].laco_struct_reqgnlaco0.fac_gain_p_lam "gain of lambda controller P share" UWORD _CNV_A_R_LINEAR_____119_CM 1 100. 0. 15.999755859375 DISPLAY_IDENTIFIER FAC_GAIN_P_LAM[2] ECU_ADDRESS 0xd0006276 FORMAT "%7.4" /end MEASUREMENT
/begin MEASUREMENT laco[1].laco_struct_reqgnlaco0.fac_gain_i_lam "gain of lambda controller I share" UWORD _CNV_A_R_LACO_LINEA_370_CM 1 100. 0. 49.999237 DISPLAY_IDENTIFIER FAC_GAIN_I_LAM[2] ECU_ADDRESS 0xd0006278 FORMAT "%7.4" /end MEASUREMENT
/begin MEASUREMENT laco[1].laco_struct_reqgnlaco0.fac_gain_i2_lam "gain of lambda controller I^2 share" UWORD _CNV_A_R_LACO_LINEA_371_CM 1 100. 0. 24.999619 DISPLAY_IDENTIFIER FAC_GAIN_I2_LAM[2] ECU_ADDRESS 0xd000627a FORMAT "%7.4" /end MEASUREMENT
/begin MEASUREMENT laco[1].laco_struct_reqgnlaco0.fac_gain_d_lam "gain of lambda controller D share" UWORD _CNV_A_R_LACO_LINEA_372_CM 1 100. 0. 3.9999e-002 DISPLAY_IDENTIFIER FAC_GAIN_D_LAM[2] ECU_ADDRESS 0xd000627c FORMAT "%8.6" /end MEASUREMENT
/begin MEASUREMENT laco[1].laco_struct_reqgnlaco0.lamb_sp_fil_hom "output signal of the WRAF sensor model for homogeneous mode" UWORD _CNV_A_R_LINEAR_____24_CM 1 100. 0. 1.99993896484375 DISPLAY_IDENTIFIER LAMB_SP_FIL_HOM[2] ECU_ADDRESS 0xd000627e FORMAT "%7.5" /end MEASUREMENT
/begin MEASUREMENT laco[1].laco_struct_reqgnlaco0.lamb_sp_pctl "pre control lambda set point" UWORD _CNV_A_R_LINEAR_____24_CM 1 100. 0. 1.99993896484375 DISPLAY_IDENTIFIER LAMB_SP_PCTL[2] ECU_ADDRESS 0xd0006280 FORMAT "%7.5" /end MEASUREMENT
/begin MEASUREMENT laco[1].laco_struct_reqgnlaco0.lamb_sp_fil_s "output signal of the WRAF sensor model for stratified mode" UWORD _CNV_A_R_LINEAR_____129_CM 1 100. 0. 31.9990234375 DISPLAY_IDENTIFIER LAMB_SP_FIL_S[2] ECU_ADDRESS 0xd0006282 FORMAT "%7.4" /end MEASUREMENT
/begin MEASUREMENT laco[1].laco_struct_reqgnlaco0.lamb_sp_lsl_mdl_in_hom "lambda controller set point including forced stimulation and the influence of secondary air" UWORD _CNV_A_R_LINEAR_____24_CM 1 100. 0. 3.99993896484375 DISPLAY_IDENTIFIER LAMB_SP_LSL_MDL_IN_HOM[2] ECU_ADDRESS 0xd0006284 FORMAT "%7.5" /end MEASUREMENT
/begin MEASUREMENT laco[1].laco_struct_reqgnlaco0.lamb_sp_lsl_mdl_out_hom "output signal of the WRAF sensor model in homogeneous mode" UWORD _CNV_A_R_LINEAR_____24_CM 1 100. 0. 3.99993896484375 DISPLAY_IDENTIFIER LAMB_SP_LSL_MDL_OUT_HOM[2] ECU_ADDRESS 0xd0006286 FORMAT "%7.5" /end MEASUREMENT
/begin MEASUREMENT laco[1].laco_struct_reqgnlaco0.lamb_sp_lsl_mdl_out_s "output signal of the WRAF sensor model in stratified mode" UWORD _CNV_A_R_LINEAR_____129_CM 1 100. 0. 31.9990234375 DISPLAY_IDENTIFIER LAMB_SP_LSL_MDL_OUT_S[2] ECU_ADDRESS 0xd0006288 FORMAT "%7.4" /end MEASUREMENT
/begin MEASUREMENT laco[1].laco_struct_reqgnlaco0.lamb_cor_av_lam "corrected signal of WRAF sensor; actual value for lambda controller " UWORD _CNV_A_R_LINEAR_____24_CM 1 100. 0. 1.99993896484375 DISPLAY_IDENTIFIER LAMB_COR_AV_LAM[2] ECU_ADDRESS 0xd0006292 FORMAT "%7.5" /end MEASUREMENT
/begin MEASUREMENT laco[1].laco_struct_reqgnlaco0.t1_lsl_up "first order time lag of the WRAF sensor model" UWORD _CNV_A_R_LINEAR_____117_CM 1 100. 0. 1.99996948242188 DISPLAY_IDENTIFIER T1_LSL_UP[2] ECU_ADDRESS 0xd0006296 FORMAT "%7.5" /end MEASUREMENT
/begin MEASUREMENT laco[1].laco_struct_reqgnlaco0.t_dly_soi_lsl_pos "delay between start of injection and WRAF sensor signal location" UWORD _CNV_A_R_LINEAR_____361_CM 1 100. 0. 1.023984 DISPLAY_IDENTIFIER T_DLY_SOI_LSL_POS[2] ECU_ADDRESS 0xd0006298 FORMAT "%7.5" /end MEASUREMENT
/begin MEASUREMENT laco[1].laco_struct_reqgnlaco0.tout_i_i2_shift_vld_afl "time out for I and I^2 share shift based on lean downstream signal" UWORD _CNV_A_R_LINEAR_____110_CM 1 100. 0. 1310.7 DISPLAY_IDENTIFIER TOUT_I_I2_SHIFT_VLD_AFL[2] ECU_ADDRESS 0xd000629a FORMAT "%7.2" /end MEASUREMENT
/begin MEASUREMENT laco[1].laco_struct_reqgnlaco0.tout_i_i2_shift_vld_afr "time out for I and I^2 share shift based on rich downstream signal" UWORD _CNV_A_R_LINEAR_____110_CM 1 100. 0. 1310.7 DISPLAY_IDENTIFIER TOUT_I_I2_SHIFT_VLD_AFR[2] ECU_ADDRESS 0xd000629c FORMAT "%7.2" /end MEASUREMENT
/begin MEASUREMENT laco[1].laco_struct_reqgnlaco0.vls_down_mmv_lam "moving mean value of downstream sensor voltage" UWORD _CNV_A_R_LINEAR_____201_CM 1 100. 0. 4.99992371 DISPLAY_IDENTIFIER VLS_DOWN_MMV_LAM[2] ECU_ADDRESS 0xd000629e FORMAT "%7.5" /end MEASUREMENT
/begin MEASUREMENT laco[1].laco_struct_reqgnlaco0.mff_add_lam_ad_out "fuel mass set point offset, output from lambda adaptation" SWORD _CNV_A_R_LINEAR_____128_CM 1 100. -694.510597390707 694.4894026092931 DISPLAY_IDENTIFIER MFF_ADD_LAM_AD_OUT[2] ECU_ADDRESS 0xd00062a0 FORMAT "%7.2" /end MEASUREMENT
/begin MEASUREMENT laco[1].laco_struct_reqgnlaco0.fac_lam_ad_out "fuel mass set point factor, output from lambda adaptation" SWORD _CNV_A_R_LINEAR_____113_CM 1 100. -50. 49.9984741210938 DISPLAY_IDENTIFIER FAC_LAM_AD_OUT[2] ECU_ADDRESS 0xd00062a2 FORMAT "%7.3" /end MEASUREMENT
/begin MEASUREMENT laco[1].laco_struct_reqgnlaco0.ctr_raf_chg "Counter of air fuel ratio changes" UBYTE _CNV_A_R_LINEAR_____0_CM 1 100. 0. 255. DISPLAY_IDENTIFIER CTR_RAF_CHG[2] ECU_ADDRESS 0xd00062a4 FORMAT "%3.0" /end MEASUREMENT
/begin MEASUREMENT laco[1].laco_struct_reqgnlaco0.state_lam "lambda controller state" UBYTE _CNV_S_4_LACO_RANGE_373_CM 1 100. 0. 3. DISPLAY_IDENTIFIER STATE_LAM[2] ECU_ADDRESS 0xd00062a5 /end MEASUREMENT
/begin MEASUREMENT laco[1].laco_struct_reqgnlaco0.fac_eg_dly "Weighting factor for the calculation of the exhaust gas delay" UBYTE _CNV_A_R_EGCP_LINEA_355_CM 1 100. 0. 31.875 DISPLAY_IDENTIFIER FAC_EG_DLY[2] ECU_ADDRESS 0xd00062a6 FORMAT "%4.1" /end MEASUREMENT
/begin MEASUREMENT laco[1].laco_struct_reqgnlaco0.lv_lam_lscl "activation flag of lambda control" UBYTE _CNV_S_2_RANGE__0___1_CM 1 100. 0. 1. DISPLAY_IDENTIFIER LV_LAM_LSCL[2] ECU_ADDRESS 0xd00062a7 BIT_MASK 0x1 /end MEASUREMENT
/begin MEASUREMENT laco[1].laco_struct_reqgnlaco0.lv_fac_lam_lim_not_stat_cdn "limitation under non stationary operating conditions (threshold exceeded)" UBYTE _CNV_S_2_RANGE__0___1_CM 1 100. 0. 1. DISPLAY_IDENTIFIER LV_FAC_LAM_LIM_NOT_STAT_CDN[2] ECU_ADDRESS 0xd00062a8 BIT_MASK 0x1 /end MEASUREMENT
/begin MEASUREMENT laco[1].laco_struct_reqgnlaco0.lv_t_max_lscl_act_tco "lambda controller activation by timer condition instead of TCO condition" UBYTE _CNV_S_2_RANGE__0___1_CM 1 100. 0. 1. DISPLAY_IDENTIFIER LV_T_MAX_LSCL_ACT_TCO[2] ECU_ADDRESS 0xd00062a9 BIT_MASK 0x1 /end MEASUREMENT
/begin MEASUREMENT laco[1].laco_struct_reqgnlaco0.lv_fac_lam_adj_lam_ad_end "Controller shift caused by lambda adaptation was carried out" UBYTE _CNV_S_2_RANGE__0___1_CM 1 100. 0. 1. DISPLAY_IDENTIFIER LV_FAC_LAM_ADJ_LAM_AD_END[2] ECU_ADDRESS 0xd00062aa BIT_MASK 0x1 /end MEASUREMENT
/begin MEASUREMENT laco[1].laco_struct_reqgnlaco0.lv_fac_lam_shift_cp_end "Controller shift caused by canister purge was carried out" UBYTE _CNV_S_2_RANGE__0___1_CM 1 100. 0. 1. DISPLAY_IDENTIFIER LV_FAC_LAM_SHIFT_CP_END[2] ECU_ADDRESS 0xd00062ab BIT_MASK 0x1 /end MEASUREMENT
/begin MEASUREMENT laco[1].laco_struct_reqgnlaco0.lv_fac_lam_diagcp_end "Controller shift caused by EVAP diagnosis was carried out" UBYTE _CNV_S_2_RANGE__0___1_CM 1 100. 0. 1. DISPLAY_IDENTIFIER LV_FAC_LAM_DIAGCP_END[2] ECU_ADDRESS 0xd00062ac BIT_MASK 0x1 /end MEASUREMENT
/begin MEASUREMENT laco[1].laco_struct_reqgnlaco0.lv_fac_lam_lim_max "Upper limit of lambda controller output reached" UBYTE _CNV_S_2_RANGE__0___1_CM 1 100. 0. 1. DISPLAY_IDENTIFIER LV_FAC_LAM_LIM_MAX[2] ECU_ADDRESS 0xd00062ae BIT_MASK 0x1 /end MEASUREMENT
/begin MEASUREMENT laco[1].laco_struct_reqgnlaco0.lv_fac_lam_lim_min "Lower limit of lambda controller output reached" UBYTE _CNV_S_2_RANGE__0___1_CM 1 100. 0. 1. DISPLAY_IDENTIFIER LV_FAC_LAM_LIM_MIN[2] ECU_ADDRESS 0xd00062af BIT_MASK 0x1 /end MEASUREMENT
/begin MEASUREMENT laco[1].laco_struct_reqgnlaco0.lv_vls_down_thd_afl_lam "flag indicating that downstream sensor signal is below calibration threshold (used for lambda control)" UBYTE _CNV_S_2_RANGE__0___1_CM 1 100. 0. 1. DISPLAY_IDENTIFIER LV_VLS_DOWN_THD_AFL_LAM[2] ECU_ADDRESS 0xd00062b0 BIT_MASK 0x1 /end MEASUREMENT
/begin MEASUREMENT laco[1].laco_struct_reqgnlaco0.lv_vls_down_thd_afr_lam "flag indicating that downstream sensor signal is above calibration threshold (used for lambda control)" UBYTE _CNV_S_2_RANGE__0___1_CM 1 100. 0. 1. DISPLAY_IDENTIFIER LV_VLS_DOWN_THD_AFR_LAM[2] ECU_ADDRESS 0xd00062b1 BIT_MASK 0x1 /end MEASUREMENT
/begin MEASUREMENT laco[1].laco_struct_reqgnlaco0.lv_vls_down_thd_afr_lam_old "auxiliary flag used for downstream sensor signal evaluation" UBYTE _CNV_S_2_RANGE__0___1_CM 1 100. 0. 1. DISPLAY_IDENTIFIER LV_VLS_DOWN_THD_AFR_LAM_OLD[2] ECU_ADDRESS 0xd00062b2 BIT_MASK 0x1 /end MEASUREMENT
/begin MEASUREMENT laco[1].laco_struct_reqgnlaco0.lv_vls_down_thd_afl_lam_old "auxiliary flag used for downstream sensor signal evaluation" UBYTE _CNV_S_2_RANGE__0___1_CM 1 100. 0. 1. DISPLAY_IDENTIFIER LV_VLS_DOWN_THD_AFL_LAM_OLD[2] ECU_ADDRESS 0xd00062b3 BIT_MASK 0x1 /end MEASUREMENT
/begin MEASUREMENT laco[1].laco_struct_reqgnlacoi0.lamb_sp_delta_lam "lambda shift applied on lambda set point" SWORD _CNV_A_R_LINEAR_____24_CM 1 100. -0.125 0.125 DISPLAY_IDENTIFIER LAMB_SP_DELTA_LAM[2] ECU_ADDRESS 0xd00062b4 FORMAT "%8.5" /end MEASUREMENT
/begin MEASUREMENT laco[1].laco_struct_reqgnlacoi0.lamb_av_delta_lam "lambda shift applied on measured lambda signal" SWORD _CNV_A_R_LINEAR_____24_CM 1 100. -0.125 0.125 DISPLAY_IDENTIFIER LAMB_AV_DELTA_LAM[2] ECU_ADDRESS 0xd00062b6 FORMAT "%8.5" /end MEASUREMENT
/begin MEASUREMENT laco[1].laco_struct_reqgnlacoi0.lv_inh_lscl "inhibit signal for the controller deactivation" UBYTE _CNV_S_2_RANGE__0___1_CM 1 100. 0. 1. DISPLAY_IDENTIFIER LV_INH_LSCL[2] ECU_ADDRESS 0xd00062b8 BIT_MASK 0x1 /end MEASUREMENT
/begin MEASUREMENT laco[1].laco_struct_reqgnlacoi0.lv_lam_stop_req "request to stop the lambda controller" UBYTE _CNV_S_2_RANGE__0___1_CM 1 100. 0. 1. DISPLAY_IDENTIFIER LV_LAM_STOP_REQ[2] ECU_ADDRESS 0xd00062b9 BIT_MASK 0x1 /end MEASUREMENT
/begin MEASUREMENT laco[1].laco_struct_reqgnlacoi0.lv_state_ls_opl_err "flag summarising errors that leads to open loop control" UBYTE _CNV_S_2_RANGE__0___1_CM 1 100. 0. 1. DISPLAY_IDENTIFIER LV_STATE_LS_OPL_ERR[2] ECU_ADDRESS 0xd00062ba BIT_MASK 0x1 /end MEASUREMENT
/begin MEASUREMENT laco[1].laco_struct_reqgnlacoi0.lv_lam_stop_sho_per_req "Request to trigger the short period stop mode of the Lambda controller" UBYTE _CNV_S_2_RANGE__0___1_CM 1 100. 0. 1. DISPLAY_IDENTIFIER LV_LAM_STOP_SHO_PER_REQ[2] ECU_ADDRESS 0xd00062bb BIT_MASK 0x1 /end MEASUREMENT
/begin MEASUREMENT laco[1].laco_struct_reqgnlacoi0.fac_ipt_sens_mdl "Interpolation factor for gas delay and sensor behavior model" UWORD _CNV_A_R_LINEAR_____129_CM 1 100. 0. 1. DISPLAY_IDENTIFIER FAC_IPT_SENS_MDL[2] ECU_ADDRESS 0xd00062bc FORMAT "%6.4" /end MEASUREMENT
/begin MEASUREMENT laco[1].laco_struct_reqgntrim0.lamb_delta_i_mmv_lam_adj "I share moving mean value from trim control" SWORD _CNV_A_R_LACO_LINEA_374_CM 1 100. -0.125 0.124996185302734 DISPLAY_IDENTIFIER LAMB_DELTA_I_MMV_LAM_ADJ[2] ECU_ADDRESS 0xd00062c4 FORMAT "%9.6" /end MEASUREMENT
/begin MEASUREMENT laco[1].laco_struct_reqgntrim0.lamb_delta_lam_adj "total output (P share + I share) from trim control" SWORD _CNV_A_R_LINEAR_____24_CM 1 100. -0.125 0.125 DISPLAY_IDENTIFIER LAMB_DELTA_LAM_ADJ[2] ECU_ADDRESS 0xd00062c6 FORMAT "%8.5" /end MEASUREMENT
/begin MEASUREMENT laco[1].laco_struct_reqgntrim0.lamb_delta_p_lam_adj "P share of from trim control" SWORD _CNV_A_R_LINEAR_____24_CM 1 100. -0.125 0.125 DISPLAY_IDENTIFIER LAMB_DELTA_P_LAM_ADJ[2] ECU_ADDRESS 0xd00062c8 FORMAT "%8.5" /end MEASUREMENT
/begin MEASUREMENT laco[1].laco_struct_reqgntrim0.lamb_delta_i_lam_adj "I share from trim control" SWORD _CNV_A_R_LINEAR_____24_CM 1 100. -0.125 0.125 DISPLAY_IDENTIFIER LAMB_DELTA_I_LAM_ADJ[2] ECU_ADDRESS 0xd00062ca FORMAT "%8.5" /end MEASUREMENT
/begin MEASUREMENT laco[1].laco_struct_reqgntrim0.lamb_delta_i_save_lam_adj "saved I share from trim control (saved in case that catalyst diagnosis switched on)" SWORD _CNV_A_R_LACO_LINEA_374_CM 1 100. -0.125 0.124996185302734 DISPLAY_IDENTIFIER LAMB_DELTA_I_SAVE_LAM_ADJ[2] ECU_ADDRESS 0xd00062cc FORMAT "%9.6" /end MEASUREMENT
/begin MEASUREMENT laco[1].laco_struct_reqgntrim0.vls_dif_lam_adj "difference between setpoint and actual downstream LS signal" SWORD _CNV_A_R_LINEAR_____315_CM 1 100. -5.00000000000182 4.99511718999747 DISPLAY_IDENTIFIER VLS_DIF_LAM_ADJ[2] ECU_ADDRESS 0xd00062ce /end MEASUREMENT
/begin MEASUREMENT laco[1].laco_struct_reqgntrim0.vls_dif_mmv_lam_adj "moving mean value of difference between set point and actual downstream LS signal" SWORD _CNV_A_R_EGCP_LINEA_309_CM 1 100. -5. 4.999847 DISPLAY_IDENTIFIER VLS_DIF_MMV_LAM_ADJ[2] ECU_ADDRESS 0xd00062d0 FORMAT "%7.4" /end MEASUREMENT
/begin MEASUREMENT laco[1].laco_struct_reqgntrim0.vls_dif_delta_lam_adj "difference between downstream LS signal and moving mean value" SWORD _CNV_A_R_EGCP_LINEA_309_CM 1 100. -5. 4.999847 DISPLAY_IDENTIFIER VLS_DIF_DELTA_LAM_ADJ[2] ECU_ADDRESS 0xd00062d2 FORMAT "%7.4" /end MEASUREMENT
/begin MEASUREMENT laco[1].laco_struct_reqgntrim0.lamb_delta_d_lam_adj "D share from trim control" SWORD _CNV_A_R_LINEAR_____24_CM 1 100. -0.125 0.125 DISPLAY_IDENTIFIER LAMB_DELTA_D_LAM_ADJ[2] ECU_ADDRESS 0xd00062d4 FORMAT "%8.5" /end MEASUREMENT
/begin MEASUREMENT laco[1].laco_struct_reqgntrim0.maf_int_lam_adj_act "integral of air mass flow since LAM activation" UWORD _CNV_A_R_CYBL_LINEA_135_CM 1 100. 0. 1456.33 DISPLAY_IDENTIFIER MAF_INT_LAM_ADJ_ACT[2] ECU_ADDRESS 0xd00062d6 FORMAT "%7.2" /end MEASUREMENT
/begin MEASUREMENT laco[1].laco_struct_reqgntrim0.vls_sp_lam_adj "trim control setpoint" UWORD _CNV_A_R_LINEAR_____2_CM 1 100. 0. 4.9951171875 DISPLAY_IDENTIFIER VLS_SP_LAM_ADJ[2] ECU_ADDRESS 0xd00062d8 FORMAT "%5.3" /end MEASUREMENT
/begin MEASUREMENT laco[1].laco_struct_reqgntrim0.maf_int_min_lam_adj_p_act "minimum air mass flow  integral for trim control P share activation" UWORD _CNV_A_R_CYBL_LINEA_135_CM 1 100. 0. 1456.33 DISPLAY_IDENTIFIER MAF_INT_MIN_LAM_ADJ_P_ACT[2] ECU_ADDRESS 0xd00062da FORMAT "%7.2" /end MEASUREMENT
/begin MEASUREMENT laco[1].laco_struct_reqgntrim0.maf_int_min_lam_adj_i_act "minimum air mass flow  integral for trim control I share activation" UWORD _CNV_A_R_CYBL_LINEA_135_CM 1 100. 0. 1456.33 DISPLAY_IDENTIFIER MAF_INT_MIN_LAM_ADJ_I_ACT[2] ECU_ADDRESS 0xd00062dc FORMAT "%7.2" /end MEASUREMENT
/begin MEASUREMENT laco[1].laco_struct_reqgntrim0.maf_int_min_lam_adj_d_act "minimum air mass flow integral for trim control D share activation" UWORD _CNV_A_R_CYBL_LINEA_135_CM 1 100. 0. 1456.33 DISPLAY_IDENTIFIER MAF_INT_MIN_LAM_ADJ_D_ACT[2] ECU_ADDRESS 0xd00062de FORMAT "%7.2" /end MEASUREMENT
/begin MEASUREMENT laco[1].laco_struct_reqgntrim0.lv_lam_adj_act "Activation flag of dynamic fuel trim " UBYTE _CNV_S_2_RANGE__0___1_CM 1 100. 0. 1. DISPLAY_IDENTIFIER LV_LAM_ADJ_ACT[2] ECU_ADDRESS 0xd00062e0 BIT_MASK 0x1 /end MEASUREMENT
/begin MEASUREMENT laco[1].laco_struct_reqgntrim0.lv_lam_adj_i_act "Activation flag for calculation of the trim-controller I-share" UBYTE _CNV_S_2_RANGE__0___1_CM 1 100. 0. 1. DISPLAY_IDENTIFIER LV_LAM_ADJ_I_ACT[2] ECU_ADDRESS 0xd00062e1 BIT_MASK 0x1 /end MEASUREMENT
/begin MEASUREMENT laco[1].laco_struct_reqgntrim0.lv_lam_adj_p_act "activation flag for calculation of trim controller P share" UBYTE _CNV_S_2_RANGE__0___1_CM 1 100. 0. 1. DISPLAY_IDENTIFIER LV_LAM_ADJ_P_ACT[2] ECU_ADDRESS 0xd00062e2 BIT_MASK 0x1 /end MEASUREMENT
/begin MEASUREMENT laco[1].laco_struct_reqgntrim0.lv_lam_adj_ad_end "flag indicating that trim control I share shift was executed" UBYTE _CNV_S_2_RANGE__0___1_CM 1 100. 0. 1. DISPLAY_IDENTIFIER LV_LAM_ADJ_AD_END[2] ECU_ADDRESS 0xd00062e4 BIT_MASK 0x1 /end MEASUREMENT
/begin MEASUREMENT laco[1].laco_struct_reqgntrim0.lv_lam_adj_d_act "activation flag for calculation of trim controller D share" UBYTE _CNV_S_2_RANGE__0___1_CM 1 100. 0. 1. DISPLAY_IDENTIFIER LV_LAM_ADJ_D_ACT[2] ECU_ADDRESS 0xd00062e5 BIT_MASK 0x1 /end MEASUREMENT
/begin MEASUREMENT laco[1].laco_struct_reqgntrimi0.fac_lam_mv_ofs_ldc_lam_adj "filtered lambda controller output offset for limited dynamics calculation" SWORD _CNV_A_R_LINEAR_____113_CM 1 100. -50. 49.9984741210938 DISPLAY_IDENTIFIER FAC_LAM_MV_OFS_LDC_LAM_ADJ ECU_ADDRESS 0xd00062e8 FORMAT "%7.3" /end MEASUREMENT
/begin MEASUREMENT laco[1].laco_struct_reqgntrimi0.maf_ofs_ldc_lam_adj "air mass flow offset for limited dynamics calculation" SWORD _CNV_A_R_LINEAR_____128_CM 1 100. -694.510597390707 694.4894026092931 DISPLAY_IDENTIFIER MAF_OFS_LDC_LAM_ADJ ECU_ADDRESS 0xd00062ea FORMAT "%7.2" /end MEASUREMENT
/begin MEASUREMENT laco[1].laco_struct_reqgntrimi0.n_ofs_ldc_lam_adj "engine speed offset for limited dynamics calculation" SWORD _CNV_A_R_LINEAR_____14_CM 1 100. -8160. 8160. DISPLAY_IDENTIFIER N_OFS_LDC_LAM_ADJ ECU_ADDRESS 0xd00062ec FORMAT "%5.0" /end MEASUREMENT
/begin MEASUREMENT laco[1].laco_struct_reqgntrimi0.vls_av_lam_adj "sensor voltage actual value for trim control" UWORD _CNV_A_R_LINEAR_____2_CM 1 100. 0. 4.9951171875 DISPLAY_IDENTIFIER VLS_AV_LAM_ADJ[2] ECU_ADDRESS 0xd00062ee FORMAT "%5.3" /end MEASUREMENT
/begin MEASUREMENT laco[1].laco_struct_reqgntrimi0.vls_delta_lam_adj_cat_diag "Sensor voltage set point shift in case of active cat efficiency diagnosis" UWORD _CNV_A_R_LINEAR_____2_CM 1 100. 0. 4.9951171875 DISPLAY_IDENTIFIER VLS_DELTA_LAM_ADJ_CAT_DIAG[2] ECU_ADDRESS 0xd00062f0 FORMAT "%5.3" /end MEASUREMENT
/begin MEASUREMENT laco[1].laco_struct_reqgntrimi0.maf_int_ldc_lam_adj "MAF integral during limited dynamics not fulfilled" UWORD _CNV_A_R_LINEAR_____364_CM 1 100. 0. 1820.42 DISPLAY_IDENTIFIER MAF_INT_LDC_LAM_ADJ ECU_ADDRESS 0xd00062f2 FORMAT "%7.2" /end MEASUREMENT
/begin MEASUREMENT laco[1].laco_struct_reqgntrimi0.vls_av_tmp_lam_adj "auxiliary sensor voltage actual value for filter calculation" UWORD _CNV_A_R_LINEAR_____201_CM 1 100. 0. 4.99992371 DISPLAY_IDENTIFIER VLS_AV_TMP_LAM_ADJ ECU_ADDRESS 0xd00062f4 FORMAT "%7.5" /end MEASUREMENT
/begin MEASUREMENT laco[1].laco_struct_reqgntrimi0.pv_av_ofs_ldc_lam_adj "actual pedal value offset for limited dynamics calculation" SBYTE _CNV_A_R_LINEAR_____5_CM 1 100. -50. 49.609375 DISPLAY_IDENTIFIER PV_AV_OFS_LDC_LAM_ADJ ECU_ADDRESS 0xd00062f6 FORMAT "%5.1" /end MEASUREMENT
/begin MEASUREMENT laco[1].laco_struct_reqgntrimi0.lv_ldc_lam_adj "limited dynamic conditions for trim control" UBYTE _CNV_S_2_RANGE__0___1_CM 1 100. 0. 1. DISPLAY_IDENTIFIER LV_LDC_LAM_ADJ[2] ECU_ADDRESS 0xd00062f7 BIT_MASK 0x1 /end MEASUREMENT
/begin MEASUREMENT laco[1].laco_struct_reqgntrimi0.lv_inh_lam_adj "inhibition flag for trim control" UBYTE _CNV_S_2_RANGE__0___1_CM 1 100. 0. 1. DISPLAY_IDENTIFIER LV_INH_LAM_ADJ[2] ECU_ADDRESS 0xd00062f8 BIT_MASK 0x1 /end MEASUREMENT
/begin MEASUREMENT laco[1].laco_struct_reqgntrimi0.lv_inh_lam_adj_err "inhibition flag for trim control based on error flag evaluation" UBYTE _CNV_S_2_RANGE__0___1_CM 1 100. 0. 1. DISPLAY_IDENTIFIER LV_INH_LAM_ADJ_ERR ECU_ADDRESS 0xd00062f9 BIT_MASK 0x1 /end MEASUREMENT
/begin MEASUREMENT laco[1].laco_struct_reqgntrimi0.lv_lamb_delta_i_lam_adj_deac "flag indicating that I share is fixed when deactivating lambda controller" UBYTE _CNV_S_2_RANGE__0___1_CM 1 100. 0. 1. DISPLAY_IDENTIFIER LV_LAMB_DELTA_I_LAM_ADJ_DEAC[2] ECU_ADDRESS 0xd00062fa BIT_MASK 0x1 /end MEASUREMENT
/begin MEASUREMENT laco[1].laco_struct_reqgntrimi0.lv_lamb_delta_ad_lam_adj_clc "flag indicating that adaptation value is calculated at start of power latch phase" UBYTE _CNV_S_2_RANGE__0___1_CM 1 100. 0. 1. DISPLAY_IDENTIFIER LV_LAMB_DELTA_AD_LAM_ADJ_CLC[2] ECU_ADDRESS 0xd00062fb BIT_MASK 0x1 /end MEASUREMENT
/begin MEASUREMENT laco[1].laco_struct_reqgntrimi0.lv_lam_adj_act_fast_lam_lscl "flag indicating that adaptation value is calculated at start of power latch phase" UBYTE _CNV_S_2_RANGE__0___1_CM 1 100. 0. 1. DISPLAY_IDENTIFIER LV_LAM_ADJ_ACT_FAST_LAM_LSCL[2] ECU_ADDRESS 0xd00062fb BIT_MASK 0x1 /end MEASUREMENT
/begin CHARACTERISTIC ip_fac_gain_p_lam "gain of lambda controller P share" MAP 0xa0811db4 _REC_MAP_20_u2_u2_u2 15.999755859375 _CNV_A_R_LINEAR_____119_CM 0. 15.999755859375 DISPLAY_IDENTIFIER IP_FAC_GAIN_P_LAM FORMAT "%7.4"
 /begin AXIS_DESCR COM_AXIS online_dummy _CNV_A_R_LINEAR_____361_CM 8 0. 1.023984 FORMAT "%7.5" AXIS_PTS_REF ldpm_t_dly_soi_lsl_pos_1_laco /end AXIS_DESCR
 /begin AXIS_DESCR COM_AXIS online_dummy _CNV_A_R_LINEAR_____117_CM 8 0. 1.99996948242188 FORMAT "%7.5" AXIS_PTS_REF ldpm_t1_lsl_up_1_laco /end AXIS_DESCR
/end CHARACTERISTIC
/begin CHARACTERISTIC ip_fac_gain_i_lam "gain of lambda controller I share" MAP 0xa0811d34 _REC_MAP_20_u2_u2_u2 49.98931900000001 _CNV_A_R_LACO_LINEA_377_CM 9.918e-003 49.999237 DISPLAY_IDENTIFIER IP_FAC_GAIN_I_LAM FORMAT "%7.4"
 /begin AXIS_DESCR COM_AXIS online_dummy _CNV_A_R_LINEAR_____361_CM 8 0. 1.023984 FORMAT "%7.5" AXIS_PTS_REF ldpm_t_dly_soi_lsl_pos_1_laco /end AXIS_DESCR
 /begin AXIS_DESCR COM_AXIS online_dummy _CNV_A_R_LINEAR_____117_CM 8 0. 1.99996948242188 FORMAT "%7.5" AXIS_PTS_REF ldpm_t1_lsl_up_1_laco /end AXIS_DESCR
/end CHARACTERISTIC
/begin CHARACTERISTIC ip_fac_gain_i2_lam "gain of lambda controller I^2 share" MAP 0xa0811cb4 _REC_MAP_20_u2_u2_u2 24.999619 _CNV_A_R_LACO_LINEA_371_CM 0. 24.999619 DISPLAY_IDENTIFIER IP_FAC_GAIN_I2_LAM FORMAT "%7.4"
 /begin AXIS_DESCR COM_AXIS online_dummy _CNV_A_R_LINEAR_____361_CM 8 0. 1.023984 FORMAT "%7.5" AXIS_PTS_REF ldpm_t_dly_soi_lsl_pos_1_laco /end AXIS_DESCR
 /begin AXIS_DESCR COM_AXIS online_dummy _CNV_A_R_LINEAR_____117_CM 8 0. 1.99996948242188 FORMAT "%7.5" AXIS_PTS_REF ldpm_t1_lsl_up_1_laco /end AXIS_DESCR
/end CHARACTERISTIC
/begin CHARACTERISTIC ip_fac_gain_d_lam "gain of lambda controller D share" MAP 0xa0811c34 _REC_MAP_20_u2_u2_u2 3.9999e-002 _CNV_A_R_LACO_LINEA_372_CM 0. 3.9999e-002 DISPLAY_IDENTIFIER IP_FAC_GAIN_D_LAM FORMAT "%8.6"
 /begin AXIS_DESCR COM_AXIS online_dummy _CNV_A_R_LINEAR_____361_CM 8 0. 1.023984 FORMAT "%7.5" AXIS_PTS_REF ldpm_t_dly_soi_lsl_pos_1_laco /end AXIS_DESCR
 /begin AXIS_DESCR COM_AXIS online_dummy _CNV_A_R_LINEAR_____117_CM 8 0. 1.99996948242188 FORMAT "%7.5" AXIS_PTS_REF ldpm_t1_lsl_up_1_laco /end AXIS_DESCR
/end CHARACTERISTIC
/begin CHARACTERISTIC ip_fac_gain_p_lam_gain_swi "gain of lambda controller P share in case of LV_LAM_GAIN_SWI is set " MAP 0xa08069d4 _REC_MAP_20_u2_u2_u2 15.999755859375 _CNV_A_R_LINEAR_____119_CM 0. 15.999755859375 DISPLAY_IDENTIFIER IP_FAC_GAIN_P_LAM_GAIN_SWI FORMAT "%7.4"
 /begin AXIS_DESCR COM_AXIS online_dummy _CNV_A_R_LINEAR_____361_CM 4 0. 1.023984 FORMAT "%7.5" AXIS_PTS_REF ldpm_t_dly_soi_lsl_pos_2_laco /end AXIS_DESCR
 /begin AXIS_DESCR COM_AXIS online_dummy _CNV_A_R_LINEAR_____117_CM 4 0. 1.99996948242188 FORMAT "%7.5" AXIS_PTS_REF ldpm_t1_lsl_up_2_laco /end AXIS_DESCR
/end CHARACTERISTIC
/begin CHARACTERISTIC ip_fac_gain_i_lam_gain_swi "gain of lambda controller I share in case of LV_LAM_GAIN_SWI is set " MAP 0xa08069b4 _REC_MAP_20_u2_u2_u2 49.98931900000001 _CNV_A_R_LACO_LINEA_377_CM 9.918e-003 49.999237 DISPLAY_IDENTIFIER IP_FAC_GAIN_I_LAM_GAIN_SWI FORMAT "%7.4"
 /begin AXIS_DESCR COM_AXIS online_dummy _CNV_A_R_LINEAR_____361_CM 4 0. 1.023984 FORMAT "%7.5" AXIS_PTS_REF ldpm_t_dly_soi_lsl_pos_2_laco /end AXIS_DESCR
 /begin AXIS_DESCR COM_AXIS online_dummy _CNV_A_R_LINEAR_____117_CM 4 0. 1.99996948242188 FORMAT "%7.5" AXIS_PTS_REF ldpm_t1_lsl_up_2_laco /end AXIS_DESCR
/end CHARACTERISTIC
/begin CHARACTERISTIC ip_fac_gain_i2_lam_gain_swi "gain of lambda controller I^2 share in case of LV_LAM_GAIN_SWI is set " MAP 0xa0806994 _REC_MAP_20_u2_u2_u2 24.999619 _CNV_A_R_LACO_LINEA_371_CM 0. 24.999619 DISPLAY_IDENTIFIER IP_FAC_GAIN_I2_LAM_GAIN_SWI FORMAT "%7.4"
 /begin AXIS_DESCR COM_AXIS online_dummy _CNV_A_R_LINEAR_____361_CM 4 0. 1.023984 FORMAT "%7.5" AXIS_PTS_REF ldpm_t_dly_soi_lsl_pos_2_laco /end AXIS_DESCR
 /begin AXIS_DESCR COM_AXIS online_dummy _CNV_A_R_LINEAR_____117_CM 4 0. 1.99996948242188 FORMAT "%7.5" AXIS_PTS_REF ldpm_t1_lsl_up_2_laco /end AXIS_DESCR
/end CHARACTERISTIC
/begin CHARACTERISTIC ip_fac_gain_d_lam_gain_swi "gain of lambda controller D share in case of LV_LAM_GAIN_SWI is set " MAP 0xa0806974 _REC_MAP_20_u2_u2_u2 3.9999e-002 _CNV_A_R_LACO_LINEA_372_CM 0. 3.9999e-002 DISPLAY_IDENTIFIER IP_FAC_GAIN_D_LAM_GAIN_SWI FORMAT "%8.6"
 /begin AXIS_DESCR COM_AXIS online_dummy _CNV_A_R_LINEAR_____361_CM 4 0. 1.023984 FORMAT "%7.5" AXIS_PTS_REF ldpm_t_dly_soi_lsl_pos_2_laco /end AXIS_DESCR
 /begin AXIS_DESCR COM_AXIS online_dummy _CNV_A_R_LINEAR_____117_CM 4 0. 1.99996948242188 FORMAT "%7.5" AXIS_PTS_REF ldpm_t1_lsl_up_2_laco /end AXIS_DESCR
/end CHARACTERISTIC
/begin CHARACTERISTIC id_tco_min_lam_lscl_is "minimum TCO for lambda controller activation at idle speed" CURVE 0xa0806936 _REC_CUR_20_u1_u1 190.5 _CNV_A_R_LINEAR_____17_CM -48. 142.5 DISPLAY_IDENTIFIER ID_TCO_MIN_LAM_LSCL_IS FORMAT "%6.2"
 /begin AXIS_DESCR COM_AXIS tco_st _CNV_A_R_LINEAR_____17_CM 6 -48. 142.5 FORMAT "%6.2" AXIS_PTS_REF ldpm_tco_st_1_laco /end AXIS_DESCR
/end CHARACTERISTIC
/begin CHARACTERISTIC c_crlc_fac_lam_mv_mmv "correlation constant for the calculation of the filtered controller output mean value FAC_LAM_MV_MMV[i]" VALUE 0xa0806bc9 _REC_VAL_20_u1 0.99609375 _CNV_A_R_LINEAR_____28_CM 0. 0.99609375 DISPLAY_IDENTIFIER C_CRLC_FAC_LAM_MV_MMV FORMAT "%5.3" /end CHARACTERISTIC
/begin CHARACTERISTIC id_t_max_lscl_act_tco "maximum time value up to that the controller can be activated by TCO condition" CURVE 0xa08068f4 _REC_CUR_20_u2_u1 65534. _CNV_A_R_LINEAR_____36_CM 1. 65535. DISPLAY_IDENTIFIER ID_T_MAX_LSCL_ACT_TCO FORMAT "%5.0"
 /begin AXIS_DESCR COM_AXIS tco_st _CNV_A_R_LINEAR_____17_CM 6 -48. 142.5 FORMAT "%6.2" AXIS_PTS_REF ldpm_tco_st_1_laco /end AXIS_DESCR
/end CHARACTERISTIC
/begin CHARACTERISTIC c_fac_lam_p_max_lam "upper limitation of lambda controller P share" VALUE 0xa0806c14 _REC_VAL_20_s2 99.99847412109381 _CNV_A_R_LINEAR_____113_CM -50. 49.9984741210938 DISPLAY_IDENTIFIER C_FAC_LAM_P_MAX_LAM FORMAT "%7.3" /end CHARACTERISTIC
/begin CHARACTERISTIC c_fac_lam_p_min_lam "bottom limitation of lambda controller P share" VALUE 0xa0806c18 _REC_VAL_20_s2 99.99847412109381 _CNV_A_R_LINEAR_____113_CM -50. 49.9984741210938 DISPLAY_IDENTIFIER C_FAC_LAM_P_MIN_LAM FORMAT "%7.3" /end CHARACTERISTIC
/begin CHARACTERISTIC c_fac_lam_p_max_lam_cp "upper limitation of lambda controller P share during active canister purge" VALUE 0xa0806c16 _REC_VAL_20_s2 99.99847412109381 _CNV_A_R_LINEAR_____113_CM -50. 49.9984741210938 DISPLAY_IDENTIFIER C_FAC_LAM_P_MAX_LAM_CP FORMAT "%7.3" /end CHARACTERISTIC
/begin CHARACTERISTIC c_fac_lam_i_i2_sum_min_lam "bottom limitation of lambda controller I share + I^2 share" VALUE 0xa0806bfe _REC_VAL_20_s2 99.99847412109381 _CNV_A_R_LINEAR_____113_CM -50. 49.9984741210938 DISPLAY_IDENTIFIER C_FAC_LAM_I_I2_SUM_MIN_LAM FORMAT "%7.3" /end CHARACTERISTIC
/begin CHARACTERISTIC c_fac_lam_i_i2_sum_max_lam "upper limitation of lambda controller I share + I^2 share" VALUE 0xa0806bfa _REC_VAL_20_s2 99.99847412109381 _CNV_A_R_LINEAR_____113_CM -50. 49.9984741210938 DISPLAY_IDENTIFIER C_FAC_LAM_I_I2_SUM_MAX_LAM FORMAT "%7.3" /end CHARACTERISTIC
/begin CHARACTERISTIC c_fac_lam_i_i2_sum_min_lam_cp "bottom limitation of lambda controller I share + I^2 share during active canister purge" VALUE 0xa0806c00 _REC_VAL_20_s2 99.99847412109381 _CNV_A_R_LINEAR_____113_CM -50. 49.9984741210938 DISPLAY_IDENTIFIER C_FAC_LAM_I_I2_SUM_MIN_LAM_CP FORMAT "%7.3" /end CHARACTERISTIC
/begin CHARACTERISTIC c_fac_lam_i_i2_sum_max_lam_cp "upper limitation of lambda controller I share + I^2 share during active canister purge" VALUE 0xa0806bfc _REC_VAL_20_s2 99.99847412109381 _CNV_A_R_LINEAR_____113_CM -50. 49.9984741210938 DISPLAY_IDENTIFIER C_FAC_LAM_I_I2_SUM_MAX_LAM_CP FORMAT "%7.3" /end CHARACTERISTIC
/begin CHARACTERISTIC c_fac_lam_d_min_lam "bottom limitation of the lambda controller D share" VALUE 0xa0806bf6 _REC_VAL_20_s2 99.99847412109381 _CNV_A_R_LINEAR_____113_CM -50. 49.9984741210938 DISPLAY_IDENTIFIER C_FAC_LAM_D_MIN_LAM FORMAT "%7.3" /end CHARACTERISTIC
/begin CHARACTERISTIC c_n_min_lam_lscl "minimum engine speed for lambda controller activation" VALUE 0xa0806cb1 _REC_VAL_20_u1 8160. _CNV_A_R_LINEAR_____10_CM 0. 8160. DISPLAY_IDENTIFIER C_N_MIN_LAM_LSCL FORMAT "%4.0" /end CHARACTERISTIC
/begin CHARACTERISTIC c_fac_lam_delta_lscl_off "output signal delta to ramp the output signal to zero in case of deactivated lambda controller" VALUE 0xa0806bf8 _REC_VAL_20_u2 49.9984741210938 _CNV_A_R_LINEAR_____8_CM 0. 49.9984741210938 DISPLAY_IDENTIFIER C_FAC_LAM_DELTA_LSCL_OFF /end CHARACTERISTIC
/begin CHARACTERISTIC lc_lam_i2_act "calibration flag to switch between PII^2D and PID lambda controller" VALUE 0xa0806d05 _REC_VAL_20_u1 1. _CNV_A_R_LINEAR_____0_CM 0. 1. DISPLAY_IDENTIFIER LC_LAM_I2_ACT FORMAT "%1.0" /end CHARACTERISTIC
/begin CHARACTERISTIC id_tco_min_lam_lscl "minimum TCO for lambda controller activation" CURVE 0xa0806930 _REC_CUR_20_u1_u1 190.5 _CNV_A_R_LINEAR_____17_CM -48. 142.5 DISPLAY_IDENTIFIER ID_TCO_MIN_LAM_LSCL FORMAT "%6.2"
 /begin AXIS_DESCR COM_AXIS tco_st _CNV_A_R_LINEAR_____17_CM 6 -48. 142.5 FORMAT "%6.2" AXIS_PTS_REF ldpm_tco_st_1_laco /end AXIS_DESCR
/end CHARACTERISTIC
/begin CHARACTERISTIC c_fac_lam_p_min_lam_cp "bottom limitation of lambda controller P share during active canister purge" VALUE 0xa0806c1a _REC_VAL_20_s2 99.99847412109381 _CNV_A_R_LINEAR_____113_CM -50. 49.9984741210938 DISPLAY_IDENTIFIER C_FAC_LAM_P_MIN_LAM_CP FORMAT "%7.3" /end CHARACTERISTIC
/begin CHARACTERISTIC c_fac_lam_out_min "bottom limitation of the lambda controller output" VALUE 0xa0806c0c _REC_VAL_20_s2 99.99847412109381 _CNV_A_R_LINEAR_____113_CM -50. 49.9984741210938 DISPLAY_IDENTIFIER C_FAC_LAM_OUT_MIN FORMAT "%7.3" /end CHARACTERISTIC
/begin CHARACTERISTIC c_fac_lam_out_min_cp "bottom limitation of the lambda controller output during canister purge ramp open phase" VALUE 0xa0806c0e _REC_VAL_20_s2 99.99847412109381 _CNV_A_R_LINEAR_____113_CM -50. 49.9984741210938 DISPLAY_IDENTIFIER C_FAC_LAM_OUT_MIN_CP FORMAT "%7.3" /end CHARACTERISTIC
/begin CHARACTERISTIC c_fac_lam_out_max "upper limitation of the lambda controller output" VALUE 0xa0806c04 _REC_VAL_20_s2 99.99847412109381 _CNV_A_R_LINEAR_____113_CM -50. 49.9984741210938 DISPLAY_IDENTIFIER C_FAC_LAM_OUT_MAX FORMAT "%7.3" /end CHARACTERISTIC
/begin CHARACTERISTIC c_fac_lam_out_max_cp "upper limitation of the lambda controller output during canister purge ramp open phase" VALUE 0xa0806c06 _REC_VAL_20_s2 99.99847412109381 _CNV_A_R_LINEAR_____113_CM -50. 49.9984741210938 DISPLAY_IDENTIFIER C_FAC_LAM_OUT_MAX_CP FORMAT "%7.3" /end CHARACTERISTIC
/begin CHARACTERISTIC c_crlc_fac_lam_mv "correlation constant for calculation of the controller output mean value FAC_LAM_MV[i]" VALUE 0xa0806bc8 _REC_VAL_20_u1 0.99609375 _CNV_A_R_LINEAR_____28_CM 0. 0.99609375 DISPLAY_IDENTIFIER C_CRLC_FAC_LAM_MV FORMAT "%5.3" /end CHARACTERISTIC
/begin CHARACTERISTIC ip_fac_lam_max_not_stat_cdn "upper limit of lambda controller output under non stationary operating conditions" CURVE 0xa0806a0c _REC_CUR_20_u2_u2 99.99847412 _CNV_A_R_LINEAR_____178_CM -50. 49.99847412 DISPLAY_IDENTIFIER IP_FAC_LAM_MAX_NOT_STAT_CDN FORMAT "%7.3"
 /begin AXIS_DESCR COM_AXIS online_dummy _CNV_A_R_LINEAR_____178_CM 8 -50. 49.99847412 FORMAT "%7.3" AXIS_PTS_REF ldpm_fac_lam_mv_1_laco /end AXIS_DESCR
/end CHARACTERISTIC
/begin CHARACTERISTIC ip_fac_lam_min_not_stat_cdn "bottom limit of lambda controller output under non stationary operating conditions" CURVE 0xa0806a1c _REC_CUR_20_u2_u2 99.99847412 _CNV_A_R_LINEAR_____178_CM -50. 49.99847412 DISPLAY_IDENTIFIER IP_FAC_LAM_MIN_NOT_STAT_CDN FORMAT "%7.3"
 /begin AXIS_DESCR COM_AXIS online_dummy _CNV_A_R_LINEAR_____178_CM 8 -50. 49.99847412 FORMAT "%7.3" AXIS_PTS_REF ldpm_fac_lam_mv_1_laco /end AXIS_DESCR
/end CHARACTERISTIC
/begin AXIS_PTS ldp_maf_int_puc_ip_lamb_sp_the "" 0xa0806634 maf_int_puc_act _REC_AXS_20_u2 2912.666666666671 _CNV_A_R_LINEAR_____314_CM 4 0. 2912.66666666667 FORMAT "%7.2" /end AXIS_PTS
/begin CHARACTERISTIC ip_lamb_sp_the_puc "theoretical lambda setpoint during PUC" CURVE 0xa0806b60 _REC_CUR_20_u2_u2 3.99993896484375 _CNV_A_R_LINEAR_____24_CM 0. 3.99993896484375 DISPLAY_IDENTIFIER IP_LAMB_SP_THE_PUC FORMAT "%7.5"
 /begin AXIS_DESCR COM_AXIS maf_int_puc_act _CNV_A_R_LINEAR_____314_CM 4 0. 2912.66666666667 FORMAT "%7.2" AXIS_PTS_REF ldp_maf_int_puc_ip_lamb_sp_the /end AXIS_DESCR
/end CHARACTERISTIC
/begin CHARACTERISTIC id_t_ast_min_lscl_act "minimum time after start that must be elapsed before activating lambda controller" CURVE 0xa08068d0 _REC_CUR_20_u2_u1 6553.5 _CNV_A_R_LINEAR_____4_CM 0. 6553.5 DISPLAY_IDENTIFIER ID_T_AST_MIN_LSCL_ACT FORMAT "%6.1"
 /begin AXIS_DESCR COM_AXIS tco_st _CNV_A_R_LINEAR_____17_CM 6 -48. 142.5 FORMAT "%6.2" AXIS_PTS_REF ldpm_tco_st_1_laco /end AXIS_DESCR
/end CHARACTERISTIC
/begin CHARACTERISTIC c_crlc_vls_down_mmv_lam "correlation constant for the calculation of VLS_DOWN_MMV_LAM[i]" VALUE 0xa0806be1 _REC_VAL_20_u1 0.99609375 _CNV_A_R_LINEAR_____28_CM 0. 0.99609375 DISPLAY_IDENTIFIER C_CRLC_VLS_DOWN_MMV_LAM FORMAT "%5.3" /end CHARACTERISTIC
/begin CHARACTERISTIC c_vls_down_thd_afl_lam "lean threshold of downstream sensor signal for I and I^2 share correction" VALUE 0xa0806cf0 _REC_VAL_20_u2 4.99992371 _CNV_A_R_LINEAR_____201_CM 0. 4.99992371 DISPLAY_IDENTIFIER C_VLS_DOWN_THD_AFL_LAM FORMAT "%7.5" /end CHARACTERISTIC
/begin CHARACTERISTIC c_vls_down_thd_afr_lam "rich threshold of downstream sensor signal for I and I^2 share correction" VALUE 0xa0806cf2 _REC_VAL_20_u2 4.99992371 _CNV_A_R_LINEAR_____201_CM 0. 4.99992371 DISPLAY_IDENTIFIER C_VLS_DOWN_THD_AFR_LAM FORMAT "%7.5" /end CHARACTERISTIC
/begin CHARACTERISTIC c_tout_i_i2_shift_vld "time out for I and I^2 share shift based on downstream signal evaluation" VALUE 0xa0806cee _REC_VAL_20_u2 1310.7 _CNV_A_R_LINEAR_____110_CM 0. 1310.7 DISPLAY_IDENTIFIER C_TOUT_I_I2_SHIFT_VLD FORMAT "%7.2" /end CHARACTERISTIC
/begin CHARACTERISTIC c_crlc_fac_dif_lam_in_mmv "correlation constant for the calculation of FAC_DIF_LAM_IN_MMV[i]" VALUE 0xa0806bc7 _REC_VAL_20_u1 0.99609375 _CNV_A_R_LINEAR_____28_CM 0. 0.99609375 DISPLAY_IDENTIFIER C_CRLC_FAC_DIF_LAM_IN_MMV FORMAT "%5.3" /end CHARACTERISTIC
/begin CHARACTERISTIC c_crlc_fac_lam_mv_mmv_ldc "correlation constant for the calculation of moving mean value for limited dynamics detection" VALUE 0xa0806bca _REC_VAL_20_u1 0.99609375 _CNV_A_R_LINEAR_____28_CM 0. 0.99609375 DISPLAY_IDENTIFIER C_CRLC_FAC_LAM_MV_MMV_LDC FORMAT "%5.3" /end CHARACTERISTIC
/begin CHARACTERISTIC c_crlc_fac_lam_mv_mmv_ldc_diag "correlation constant for mean value calculation of lambda controller output, used by limited dynamics for cat efficiency diagnosis" VALUE 0xa0806bcb _REC_VAL_20_u1 0.99609375 _CNV_A_R_LINEAR_____28_CM 0. 0.99609375 DISPLAY_IDENTIFIER C_CRLC_FAC_LAM_MV_MMV_LDC_DIAG FORMAT "%5.3" /end CHARACTERISTIC
/begin MEASUREMENT lv_lam_i2_act "flag to switch between PII^2D and PID lambda controller" UBYTE _CNV_S_2_RANGE__0___1_CM 1 100. 0. 1. DISPLAY_IDENTIFIER LV_LAM_I2_ACT ECU_ADDRESS 0xd0003503 BIT_MASK 0x1 /end MEASUREMENT
/begin MEASUREMENT mff_add_cp "Canister Purge Fuel Mass correction corresponding to Lambda Factor Shift" UWORD _CNV_A_R_LINEAR_____111_CM 1 100. 0. 1389. DISPLAY_IDENTIFIER MFF_ADD_CP ECU_ADDRESS 0xd00070aa FORMAT "%7.2" /end MEASUREMENT
/begin CHARACTERISTIC ip_fac_eg_dly[0] "weighting factor for the calculation of the exhaust gas delay" MAP 0xa0811b34 _REC_MAP_20_u1_u2_u2 31.875 _CNV_A_R_EGCP_LINEA_355_CM 0. 31.875 DISPLAY_IDENTIFIER IP_FAC_EG_DLY[1] FORMAT "%4.1"
 /begin AXIS_DESCR COM_AXIS n _CNV_A_R_LINEAR_____14_CM 8 0. 8160. FORMAT "%4.0" AXIS_PTS_REF ldpm_n_1_laco /end AXIS_DESCR
 /begin AXIS_DESCR COM_AXIS maf _CNV_A_R_LINEAR_____111_CM 8 0. 1389. FORMAT "%7.2" AXIS_PTS_REF ldpm_maf_1_laco /end AXIS_DESCR
/end CHARACTERISTIC
/begin CHARACTERISTIC ip_fac_eg_dly[1] "weighting factor for the calculation of the exhaust gas delay" MAP 0xa0811b74 _REC_MAP_20_u1_u2_u2 31.875 _CNV_A_R_EGCP_LINEA_355_CM 0. 31.875 DISPLAY_IDENTIFIER IP_FAC_EG_DLY[2] FORMAT "%4.1"
 /begin AXIS_DESCR COM_AXIS n _CNV_A_R_LINEAR_____14_CM 8 0. 8160. FORMAT "%4.0" AXIS_PTS_REF ldpm_n_1_laco /end AXIS_DESCR
 /begin AXIS_DESCR COM_AXIS maf _CNV_A_R_LINEAR_____111_CM 8 0. 1389. FORMAT "%7.2" AXIS_PTS_REF ldpm_maf_1_laco /end AXIS_DESCR
/end CHARACTERISTIC
/begin CHARACTERISTIC ip_t1_lsl_up[0] "first order time lag of the  WRAF sensor model" MAP 0xa0812034 _REC_MAP_20_u2_u2_u2 1.99996948242188 _CNV_A_R_LINEAR_____117_CM 0. 1.99996948242188 DISPLAY_IDENTIFIER IP_T1_LSL_UP[1] FORMAT "%7.5"
 /begin AXIS_DESCR COM_AXIS n _CNV_A_R_LINEAR_____14_CM 8 0. 8160. FORMAT "%4.0" AXIS_PTS_REF ldpm_n_1_laco /end AXIS_DESCR
 /begin AXIS_DESCR COM_AXIS maf _CNV_A_R_LINEAR_____111_CM 8 0. 1389. FORMAT "%7.2" AXIS_PTS_REF ldpm_maf_1_laco /end AXIS_DESCR
/end CHARACTERISTIC
/begin CHARACTERISTIC ip_t1_lsl_up[1] "first order time lag of the  WRAF sensor model" MAP 0xa08120b4 _REC_MAP_20_u2_u2_u2 1.99996948242188 _CNV_A_R_LINEAR_____117_CM 0. 1.99996948242188 DISPLAY_IDENTIFIER IP_T1_LSL_UP[2] FORMAT "%7.5"
 /begin AXIS_DESCR COM_AXIS n _CNV_A_R_LINEAR_____14_CM 8 0. 8160. FORMAT "%4.0" AXIS_PTS_REF ldpm_n_1_laco /end AXIS_DESCR
 /begin AXIS_DESCR COM_AXIS maf _CNV_A_R_LINEAR_____111_CM 8 0. 1389. FORMAT "%7.2" AXIS_PTS_REF ldpm_maf_1_laco /end AXIS_DESCR
/end CHARACTERISTIC
/begin CHARACTERISTIC c_fac_lam_d_max_lam "upper limitation of the lambda controller D share" VALUE 0xa0806bf4 _REC_VAL_20_s2 99.99847412109381 _CNV_A_R_LINEAR_____113_CM -50. 49.9984741210938 DISPLAY_IDENTIFIER C_FAC_LAM_D_MAX_LAM FORMAT "%7.3" /end CHARACTERISTIC
/begin CHARACTERISTIC c_fac_lam_out_max_err_susp "upper limitation of the lambda controller output during oxygen sensor error suspicion" VALUE 0xa0806c08 _REC_VAL_20_s2 99.99847412109381 _CNV_A_R_LINEAR_____113_CM -50. 49.9984741210938 DISPLAY_IDENTIFIER C_FAC_LAM_OUT_MAX_ERR_SUSP FORMAT "%7.3" /end CHARACTERISTIC
/begin CHARACTERISTIC c_fac_lam_out_min_err_susp "bottom limitation of the lambda controller output during oxygen sensor error suspicion" VALUE 0xa0806c10 _REC_VAL_20_s2 99.99847412109381 _CNV_A_R_LINEAR_____113_CM -50. 49.9984741210938 DISPLAY_IDENTIFIER C_FAC_LAM_OUT_MIN_ERR_SUSP FORMAT "%7.3" /end CHARACTERISTIC
/begin CHARACTERISTIC ip_t1_lsl_up_fac_ipt[0] "first order time lag of the WRAF sensor model for interpolation with FAC_IPT_SENS_MDL" MAP 0xa0812134 _REC_MAP_20_u2_u2_u2 1.99996948242188 _CNV_A_R_LINEAR_____117_CM 0. 1.99996948242188 DISPLAY_IDENTIFIER IP_T1_LSL_UP_FAC_IPT[1] FORMAT "%7.5"
 /begin AXIS_DESCR COM_AXIS n _CNV_A_R_LINEAR_____14_CM 8 0. 8160. FORMAT "%4.0" AXIS_PTS_REF ldpm_n_1_laco /end AXIS_DESCR
 /begin AXIS_DESCR COM_AXIS maf _CNV_A_R_LINEAR_____111_CM 8 0. 1389. FORMAT "%7.2" AXIS_PTS_REF ldpm_maf_1_laco /end AXIS_DESCR
/end CHARACTERISTIC
/begin CHARACTERISTIC ip_t1_lsl_up_fac_ipt[1] "first order time lag of the WRAF sensor model for interpolation with FAC_IPT_SENS_MDL" MAP 0xa08121b4 _REC_MAP_20_u2_u2_u2 1.99996948242188 _CNV_A_R_LINEAR_____117_CM 0. 1.99996948242188 DISPLAY_IDENTIFIER IP_T1_LSL_UP_FAC_IPT[2] FORMAT "%7.5"
 /begin AXIS_DESCR COM_AXIS n _CNV_A_R_LINEAR_____14_CM 8 0. 8160. FORMAT "%4.0" AXIS_PTS_REF ldpm_n_1_laco /end AXIS_DESCR
 /begin AXIS_DESCR COM_AXIS maf _CNV_A_R_LINEAR_____111_CM 8 0. 1389. FORMAT "%7.2" AXIS_PTS_REF ldpm_maf_1_laco /end AXIS_DESCR
/end CHARACTERISTIC
/begin CHARACTERISTIC ip_fac_eg_dly_fac_ipt[0] "weighting factor for the calculation of the exhaust gas delay for interpolation with FAC_IPT_SENS_MDL" MAP 0xa0811bb4 _REC_MAP_20_u1_u2_u2 31.875 _CNV_A_R_EGCP_LINEA_355_CM 0. 31.875 DISPLAY_IDENTIFIER IP_FAC_EG_DLY_FAC_IPT[1] FORMAT "%4.1"
 /begin AXIS_DESCR COM_AXIS n _CNV_A_R_LINEAR_____14_CM 8 0. 8160. FORMAT "%4.0" AXIS_PTS_REF ldpm_n_1_laco /end AXIS_DESCR
 /begin AXIS_DESCR COM_AXIS maf _CNV_A_R_LINEAR_____111_CM 8 0. 1389. FORMAT "%7.2" AXIS_PTS_REF ldpm_maf_1_laco /end AXIS_DESCR
/end CHARACTERISTIC
/begin CHARACTERISTIC ip_fac_eg_dly_fac_ipt[1] "weighting factor for the calculation of the exhaust gas delay for interpolation with FAC_IPT_SENS_MDL" MAP 0xa0811bf4 _REC_MAP_20_u1_u2_u2 31.875 _CNV_A_R_EGCP_LINEA_355_CM 0. 31.875 DISPLAY_IDENTIFIER IP_FAC_EG_DLY_FAC_IPT[2] FORMAT "%4.1"
 /begin AXIS_DESCR COM_AXIS n _CNV_A_R_LINEAR_____14_CM 8 0. 8160. FORMAT "%4.0" AXIS_PTS_REF ldpm_n_1_laco /end AXIS_DESCR
 /begin AXIS_DESCR COM_AXIS maf _CNV_A_R_LINEAR_____111_CM 8 0. 1389. FORMAT "%7.2" AXIS_PTS_REF ldpm_maf_1_laco /end AXIS_DESCR
/end CHARACTERISTIC
/begin MEASUREMENT lv_lam_gain_swi " lambda controller gain switch for idle speed" UBYTE _CNV_S_2_RANGE__0___1_CM 1 100. 0. 1. DISPLAY_IDENTIFIER LV_LAM_GAIN_SWI ECU_ADDRESS 0xd000768d BIT_MASK 0x1 /end MEASUREMENT
/begin CHARACTERISTIC c_lam_maf_min_hys "Hysteresis for minimum MAF - threshold for lambda control" VALUE 0xa0806c2a _REC_VAL_20_u2 1389. _CNV_A_R_LINEAR_____111_CM 0. 1389. DISPLAY_IDENTIFIER C_LAM_MAF_MIN_HYS FORMAT "%7.2" /end CHARACTERISTIC
/begin CHARACTERISTIC lc_lam_gain_swi "flag indicating whether lambda controller parameter switch is allowed" VALUE 0xa0806d04 _REC_VAL_20_u1 1. _CNV_S_2_RANGE__0___1_CM 0. 1. DISPLAY_IDENTIFIER LC_LAM_GAIN_SWI /end CHARACTERISTIC
/begin CHARACTERISTIC lc_hom_act_comp "switching variable for the open loop/closed loop operation in stratified mode" VALUE 0xa0806cfa _REC_VAL_20_u1 1. _CNV_S_2_RANGE__0___1_CM 0. 1. DISPLAY_IDENTIFIER LC_HOM_ACT_COMP /end CHARACTERISTIC
/begin CHARACTERISTIC lc_lam_off_sawup "switching variable for the open loop/closed loop operation at secondary air" VALUE 0xa0806d06 _REC_VAL_20_u1 1. _CNV_S_2_RANGE__0___1_CM 0. 1. DISPLAY_IDENTIFIER LC_LAM_OFF_SAWUP /end CHARACTERISTIC
/begin CHARACTERISTIC lc_lamb_cop_off "switch to disable the cat-heating-lambda control deactivation condition" VALUE 0xa0806d07 _REC_VAL_20_u1 1. _CNV_S_2_RANGE__0___1_CM 0. 1. DISPLAY_IDENTIFIER LC_LAMB_COP_OFF /end CHARACTERISTIC
/begin CHARACTERISTIC ip_lam_maf_min "Minimum MAF - threshold for lambda control" CURVE 0xa0806ad4 _REC_CUR_20_u2_u2 1389. _CNV_A_R_LINEAR_____111_CM 0. 1389. DISPLAY_IDENTIFIER IP_LAM_MAF_MIN FORMAT "%7.2"
 /begin AXIS_DESCR COM_AXIS n _CNV_A_R_LINEAR_____14_CM 6 0. 8160. FORMAT "%4.0" AXIS_PTS_REF ldp_n_lam_maf_min /end AXIS_DESCR
/end CHARACTERISTIC
/begin AXIS_PTS ldp_n_lam_maf_min "" 0xa08066c0 n _REC_AXS_20_u2 8160. _CNV_A_R_LINEAR_____14_CM 6 0. 8160. FORMAT "%4.0" /end AXIS_PTS
/begin CHARACTERISTIC c_n_dyw_lam_not_stat "engine speed window for detection of non stationary condition" VALUE 0xa0806ca6 _REC_VAL_20_u2 8160. _CNV_A_R_LINEAR_____14_CM 0. 8160. DISPLAY_IDENTIFIER C_N_DYW_LAM_NOT_STAT FORMAT "%4.0" /end CHARACTERISTIC
/begin CHARACTERISTIC c_maf_dyw_lam_not_stat "air mass flow window for detection of non stationary condition" VALUE 0xa0806c60 _REC_VAL_20_u2 1389. _CNV_A_R_LINEAR_____111_CM 0. 1389. DISPLAY_IDENTIFIER C_MAF_DYW_LAM_NOT_STAT FORMAT "%7.2" /end CHARACTERISTIC
/begin CHARACTERISTIC c_maf_int_lam_not_stat "air mass flow integral for detection of non stationary condition" VALUE 0xa0806c82 _REC_VAL_20_u2 1820.42 _CNV_A_R_LINEAR_____364_CM 0. 1820.42 DISPLAY_IDENTIFIER C_MAF_INT_LAM_NOT_STAT FORMAT "%7.2" /end CHARACTERISTIC
/begin MEASUREMENT n_ofs_lam_not_stat "engine speed offset for detection of non stationary condition" SWORD _CNV_A_R_LINEAR_____14_CM 1 100. -8160. 8160. DISPLAY_IDENTIFIER N_OFS_LAM_NOT_STAT ECU_ADDRESS 0xd00034fc FORMAT "%5.0" /end MEASUREMENT
/begin MEASUREMENT maf_ofs_lam_not_stat "air mass flow offset for detection of non stationary condition" SWORD _CNV_A_R_LINEAR_____128_CM 1 100. -694.510597390707 694.4894026092931 DISPLAY_IDENTIFIER MAF_OFS_LAM_NOT_STAT ECU_ADDRESS 0xd00034f8 FORMAT "%7.2" /end MEASUREMENT
/begin MEASUREMENT maf_int_lam_not_stat "air mass flow integral for detection of non stationary condition" UWORD _CNV_A_R_LINEAR_____223_CM 1 100. 0. 1820.4167 DISPLAY_IDENTIFIER MAF_INT_LAM_NOT_STAT ECU_ADDRESS 0xd00034f4 FORMAT "%9.4" /end MEASUREMENT
/begin MEASUREMENT fac_neut_not_stat_cdn "detection of non stationary condition" SWORD _CNV_A_R_LINEAR_____259_CM 1 100. -1. 0.999969482421875 DISPLAY_IDENTIFIER FAC_NEUT_NOT_STAT_CDN ECU_ADDRESS 0xd00070a4 FORMAT "%8.5" /end MEASUREMENT
/begin CHARACTERISTIC c_lamb_sp_afr_thd "rich air-fuel mixture setpoint threshold" VALUE 0xa0806c56 _REC_VAL_20_u2 1. _CNV_A_R_LINEAR_____129_CM 0. 1. DISPLAY_IDENTIFIER C_LAMB_SP_AFR_THD FORMAT "%6.4" /end CHARACTERISTIC
/begin CHARACTERISTIC c_lamb_sp_afl_thd "lean air-fuel mixture setpoint threshold" VALUE 0xa0806c52 _REC_VAL_20_u2 3. _CNV_A_R_LINEAR_____129_CM 1. 4. DISPLAY_IDENTIFIER C_LAMB_SP_AFL_THD FORMAT "%5.3" /end CHARACTERISTIC
/begin CHARACTERISTIC c_lamb_sp_afr_thd_hys "rich air-fuel mixture setpoint threshold hysteresis" VALUE 0xa0806c58 _REC_VAL_20_u2 1. _CNV_A_R_LINEAR_____129_CM 0. 1. DISPLAY_IDENTIFIER C_LAMB_SP_AFR_THD_HYS FORMAT "%6.4" /end CHARACTERISTIC
/begin CHARACTERISTIC c_lamb_sp_afl_thd_hys "lean air-fuel mixture setpoint threshold hysteresis" VALUE 0xa0806c54 _REC_VAL_20_u2 1. _CNV_A_R_LINEAR_____129_CM 0. 1. DISPLAY_IDENTIFIER C_LAMB_SP_AFL_THD_HYS FORMAT "%6.4" /end CHARACTERISTIC
/begin CHARACTERISTIC c_lamb_dif_av_ctl_st_max "max. allowable lambda deviation at initialisation of lambda difference for the lambda controller" VALUE 0xa0806c3e _REC_VAL_20_s2 0.25 _CNV_A_R_LINEAR_____24_CM -0.125 0.125 DISPLAY_IDENTIFIER C_LAMB_DIF_AV_CTL_ST_MAX FORMAT "%8.5" /end CHARACTERISTIC
/begin CHARACTERISTIC c_lamb_dif_av_ctl_st_max_is "max. allowable lambda deviation at initialisation of lambda difference for the lambda controller in IS" VALUE 0xa0806c40 _REC_VAL_20_s2 0.25 _CNV_A_R_LINEAR_____24_CM -0.125 0.125 DISPLAY_IDENTIFIER C_LAMB_DIF_AV_CTL_ST_MAX_IS FORMAT "%8.5" /end CHARACTERISTIC
/begin CHARACTERISTIC c_lamb_dif_av_ctl_st_min "min. allowable lambda deviation at initialisation of lambda difference for the lambda controller" VALUE 0xa0806c42 _REC_VAL_20_s2 0.25 _CNV_A_R_LINEAR_____24_CM -0.125 0.125 DISPLAY_IDENTIFIER C_LAMB_DIF_AV_CTL_ST_MIN FORMAT "%8.5" /end CHARACTERISTIC
/begin CHARACTERISTIC c_lamb_dif_av_ctl_st_min_is "min. allowable lambda deviation at initialisation of lambda difference for the lambda controller in IS" VALUE 0xa0806c44 _REC_VAL_20_s2 0.25 _CNV_A_R_LINEAR_____24_CM -0.125 0.125 DISPLAY_IDENTIFIER C_LAMB_DIF_AV_CTL_ST_MIN_IS FORMAT "%8.5" /end CHARACTERISTIC
/begin CHARACTERISTIC c_lgrd_lamb_dif_av_ctl_st "limitation gradient of lambda deviation at initialisation of lambda difference for the lambda controller" VALUE 0xa0806c5e _REC_VAL_20_s2 0.25 _CNV_A_R_LINEAR_____24_CM -0.125 0.125 DISPLAY_IDENTIFIER C_LGRD_LAMB_DIF_AV_CTL_ST FORMAT "%8.5" /end CHARACTERISTIC
/begin MEASUREMENT lv_lamb_sp_afr_thd[0] "flag indicating that lambda setpoint is too rich and therefore the lambda controller is inhibited" UBYTE _CNV_S_2_RANGE__0___1_CM 1 100. 0. 1. DISPLAY_IDENTIFIER LV_LAMB_SP_AFR_THD[1] ECU_ADDRESS 0xd0003594 /end MEASUREMENT
/begin MEASUREMENT lv_lamb_sp_afr_thd[1] "flag indicating that lambda setpoint is too rich and therefore the lambda controller is inhibited" UBYTE _CNV_S_2_RANGE__0___1_CM 1 100. 0. 1. DISPLAY_IDENTIFIER LV_LAMB_SP_AFR_THD[2] ECU_ADDRESS 0xd0003595 /end MEASUREMENT
/begin MEASUREMENT lv_lamb_sp_afl_thd[0] "flag indicating that lambda setpoint is too lean and therefore the lambda controller is inhibited" UBYTE _CNV_S_2_RANGE__0___1_CM 1 100. 0. 1. DISPLAY_IDENTIFIER LV_LAMB_SP_AFL_THD[1] ECU_ADDRESS 0xd0003596 /end MEASUREMENT
/begin MEASUREMENT lv_lamb_sp_afl_thd[1] "flag indicating that lambda setpoint is too lean and therefore the lambda controller is inhibited" UBYTE _CNV_S_2_RANGE__0___1_CM 1 100. 0. 1. DISPLAY_IDENTIFIER LV_LAMB_SP_AFL_THD[2] ECU_ADDRESS 0xd0003597 /end MEASUREMENT
/begin MEASUREMENT lgrd_lamb_dif_av_ctl_st_in "only for test use" SWORD _CNV_A_R_LINEAR_____24_CM 1 100. -0.125 0.125 DISPLAY_IDENTIFIER LGRD_LAMB_DIF_AV_CTL_ST_IN ECU_ADDRESS 0xd0003590 FORMAT "%8.5" /end MEASUREMENT
/begin MEASUREMENT lamb_dif_av_ctl_st_in[0] "Start lambda difference for lambda ctl" SWORD _CNV_A_R_LINEAR_____24_CM 1 100. -0.125 0.125 DISPLAY_IDENTIFIER LAMB_DIF_AV_CTL_ST_IN[1] ECU_ADDRESS 0xd0003588 FORMAT "%8.5" /end MEASUREMENT
/begin MEASUREMENT lamb_dif_av_ctl_st_in[1] "Start lambda difference for lambda ctl" SWORD _CNV_A_R_LINEAR_____24_CM 1 100. -0.125 0.125 DISPLAY_IDENTIFIER LAMB_DIF_AV_CTL_ST_IN[2] ECU_ADDRESS 0xd000358a FORMAT "%8.5" /end MEASUREMENT
/begin MEASUREMENT lamb_dif_av_ctl_st_out[0] "Lambda offset in case of first lambda ctl start in DC" SWORD _CNV_A_R_LINEAR_____24_CM 1 100. -0.125 0.125 DISPLAY_IDENTIFIER LAMB_DIF_AV_CTL_ST_OUT[1] ECU_ADDRESS 0xd000358c FORMAT "%8.5" /end MEASUREMENT
/begin MEASUREMENT lamb_dif_av_ctl_st_out[1] "Lambda offset in case of first lambda ctl start in DC" SWORD _CNV_A_R_LINEAR_____24_CM 1 100. -0.125 0.125 DISPLAY_IDENTIFIER LAMB_DIF_AV_CTL_ST_OUT[2] ECU_ADDRESS 0xd000358e FORMAT "%8.5" /end MEASUREMENT
/begin MEASUREMENT lv_clc_lamb_dif_av_st " lambda controller gain switch for idle speed" UBYTE _CNV_S_2_RANGE__0___1_CM 1 100. 0. 1. DISPLAY_IDENTIFIER LV_CLC_LAMB_DIF_AV_ST ECU_ADDRESS 0xd0003599 BIT_MASK 0x1 /end MEASUREMENT
/begin MEASUREMENT lv_maf_int_min_lam_reac_swi "Booelan flag to switch limit of MAF_int_min_lam_reac" UBYTE _CNV_S_2_RANGE__0___1_CM 1 100. 0. 1. DISPLAY_IDENTIFIER LV_MAF_INT_MIN_LAM_REAC_SWI ECU_ADDRESS 0xd0007690 BIT_MASK 0x1 /end MEASUREMENT
/begin MEASUREMENT fac_tq_req_ofs_lam_not_stat "actual torque value offset for detection of non-stationary condition" SWORD _CNV_A_R_LINEAR_____259_CM 1 100. -1. 0.999969482421875 DISPLAY_IDENTIFIER FAC_TQ_REQ_OFS_LAM_NOT_STAT ECU_ADDRESS 0xd00034f2 FORMAT "%8.5" /end MEASUREMENT
/begin CHARACTERISTIC c_fac_tq_req_dyw_lam_not_stat "torque scaling factor window for detection for non stationary condition" VALUE 0xa0806c24 _REC_VAL_20_u2 1.99996948242188 _CNV_A_R_LINEAR_____9_CM 0. 1.99996948242188 DISPLAY_IDENTIFIER C_FAC_TQ_REQ_DYW_LAM_NOT_STAT FORMAT "%7.5" /end CHARACTERISTIC
/begin AXIS_PTS ldp_wgpwm_id_fac_ipt_sens_mdl "" 0xa0806718 wgpwm[0] _REC_AXS_20_u2 99.99847412109381 _CNV_A_R_LINEAR_____8_CM 6 0. 99.99847412109381 /end AXIS_PTS
/begin CHARACTERISTIC id_fac_ipt_sens_mdl_1 "Interpolation factor for waste gate position" CURVE 0xa0806864 _REC_CUR_20_u2_u2 1. _CNV_A_R_LINEAR_____129_CM 0. 1. DISPLAY_IDENTIFIER ID_FAC_IPT_SENS_MDL[1] FORMAT "%6.4"
 /begin AXIS_DESCR COM_AXIS wgpwm[0] _CNV_A_R_LINEAR_____8_CM 6 0. 99.99847412109381 AXIS_PTS_REF ldp_wgpwm_id_fac_ipt_sens_mdl /end AXIS_DESCR
/end CHARACTERISTIC
/begin CHARACTERISTIC id_fac_ipt_sens_mdl_2 "Interpolation factor for waste gate position" CURVE 0xa0806870 _REC_CUR_20_u2_u2 1. _CNV_A_R_LINEAR_____129_CM 0. 1. DISPLAY_IDENTIFIER ID_FAC_IPT_SENS_MDL[2] FORMAT "%6.4"
 /begin AXIS_DESCR COM_AXIS wgpwm[0] _CNV_A_R_LINEAR_____8_CM 6 0. 99.99847412109381 AXIS_PTS_REF ldp_wgpwm_id_fac_ipt_sens_mdl /end AXIS_DESCR
/end CHARACTERISTIC
/begin CHARACTERISTIC c_temp_cat_min_lam_adj_act "minimum cat temperature threshold for trim control activation" VALUE 0xa0806ce6 _REC_VAL_20_u2 2047.9375 _CNV_A_R_LINEAR_____214_CM -273.15 1774.7875 DISPLAY_IDENTIFIER C_TEMP_CAT_MIN_LAM_ADJ_ACT FORMAT "%9.4" /end CHARACTERISTIC
/begin CHARACTERISTIC ip_maf_min_lam_adj_i_act "Min MAF threshold for activation I-share" CURVE 0xa0806b6e _REC_CUR_20_u1_u1 1389. _CNV_A_R_LINEAR_____15_CM 0. 1389. DISPLAY_IDENTIFIER IP_MAF_MIN_LAM_ADJ_I_ACT FORMAT "%4.0"
 /begin AXIS_DESCR COM_AXIS n_32 _CNV_A_R_LINEAR_____10_CM 6 0. 8160. FORMAT "%4.0" AXIS_PTS_REF ldpm_n_32_2_laco /end AXIS_DESCR
/end CHARACTERISTIC
/begin CHARACTERISTIC ip_maf_max_lam_adj_i_act "Max MAF threshold for activation I-share" CURVE 0xa0806b68 _REC_CUR_20_u1_u1 1389. _CNV_A_R_LINEAR_____15_CM 0. 1389. DISPLAY_IDENTIFIER IP_MAF_MAX_LAM_ADJ_I_ACT FORMAT "%4.0"
 /begin AXIS_DESCR COM_AXIS n_32 _CNV_A_R_LINEAR_____10_CM 6 0. 8160. FORMAT "%4.0" AXIS_PTS_REF ldpm_n_32_2_laco /end AXIS_DESCR
/end CHARACTERISTIC
/begin AXIS_PTS ldp_maf_hb_ip_vls_sp_lam_adj "" 0xa0806628 maf_hb _REC_AXS_20_u1 1389. _CNV_A_R_LINEAR_____15_CM 8 0. 1389. FORMAT "%4.0" /end AXIS_PTS
/begin AXIS_PTS ldp_n_32_ip_vls_sp_lam_adj "" 0xa08066b4 n_32 _REC_AXS_20_u1 8160. _CNV_A_R_LINEAR_____10_CM 8 0. 8160. FORMAT "%4.0" /end AXIS_PTS
/begin CHARACTERISTIC ip_lamb_delta_p_lam_adj "characteristic line of trim control P share" CURVE 0xa0806b20 _REC_CUR_20_u2_u2 0.25 _CNV_A_R_LACO_LINEA_378_CM -0.125 0.125 DISPLAY_IDENTIFIER IP_LAMB_DELTA_P_LAM_ADJ FORMAT "%8.5"
 /begin AXIS_DESCR COM_AXIS online_dummy _CNV_A_R_LACO_LINEA_362_CM 16 -5. 4.99511719 AXIS_PTS_REF ldpm_vls_dif_lam_adj_1_laco /end AXIS_DESCR
/end CHARACTERISTIC
/begin CHARACTERISTIC ip_lamb_delta_i_lam_adj "characteristic line of trim control I share" CURVE 0xa0806b00 _REC_CUR_20_u2_u2 0.249996185302734 _CNV_A_R_LACO_LINEA_379_CM -0.125 0.124996185302734 DISPLAY_IDENTIFIER IP_LAMB_DELTA_I_LAM_ADJ FORMAT "%8.6"
 /begin AXIS_DESCR COM_AXIS online_dummy _CNV_A_R_LACO_LINEA_362_CM 16 -5. 4.99511719 AXIS_PTS_REF ldpm_vls_dif_lam_adj_1_laco /end AXIS_DESCR
/end CHARACTERISTIC
/begin CHARACTERISTIC c_lamb_delta_i_min_lam_adj "bottom limit of trim control I share" VALUE 0xa0806c34 _REC_VAL_20_s2 0.25 _CNV_A_R_LINEAR_____24_CM -0.125 0.125 DISPLAY_IDENTIFIER C_LAMB_DELTA_I_MIN_LAM_ADJ FORMAT "%8.5" /end CHARACTERISTIC
/begin CHARACTERISTIC c_lamb_delta_i_max_lam_adj "upper limit of trim control I share" VALUE 0xa0806c32 _REC_VAL_20_s2 0.25 _CNV_A_R_LINEAR_____24_CM -0.125 0.125 DISPLAY_IDENTIFIER C_LAMB_DELTA_I_MAX_LAM_ADJ FORMAT "%8.5" /end CHARACTERISTIC
/begin CHARACTERISTIC c_crlc_lamb_delta_i_mmv_lam_adj "correlation constant for trim control I share moving mean value calculation for adaptation value" VALUE 0xa0806bda _REC_VAL_20_u2 0.9999847412109381 _CNV_A_R_LINEAR_____89_CM 0. 0.9999847412109381 DISPLAY_IDENTIFIER C_CRLC_LAMB_DELTA_I_MMV_LAM_ADJ FORMAT "%7.5" /end CHARACTERISTIC
/begin CHARACTERISTIC c_eff_cat_diag_max_lam_adj_act "catalyst diagnosis value threshold for trim control activation" VALUE 0xa0806be6 _REC_VAL_20_u1 1.9921875 _CNV_A_R_LINEAR_____103_CM 0. 1.9921875 DISPLAY_IDENTIFIER C_EFF_CAT_DIAG_MAX_LAM_ADJ_ACT FORMAT "%8.6" /end CHARACTERISTIC
/begin CHARACTERISTIC c_maf_int_lam_adj_i_act_slow "air mass flow integral threshold for slow trim control I share reactivation" VALUE 0xa0806c76 _REC_VAL_20_u2 1456.33 _CNV_A_R_CYBL_LINEA_135_CM 0. 1456.33 DISPLAY_IDENTIFIER C_MAF_INT_LAM_ADJ_I_ACT_SLOW FORMAT "%7.2" /end CHARACTERISTIC
/begin CHARACTERISTIC c_maf_int_lam_adj_p_act_slow "air mass flow integral threshold for slow trim control P share reactivation" VALUE 0xa0806c80 _REC_VAL_20_u2 1456.33 _CNV_A_R_CYBL_LINEA_135_CM 0. 1456.33 DISPLAY_IDENTIFIER C_MAF_INT_LAM_ADJ_P_ACT_SLOW FORMAT "%7.2" /end CHARACTERISTIC
/begin CHARACTERISTIC c_maf_int_lam_adj_i_act_fast[0] "air mass flow integral threshold for fast trim control I share reactivation" VALUE 0xa0806c6e _REC_VAL_20_u2 1456.33 _CNV_A_R_CYBL_LINEA_135_CM 0. 1456.33 DISPLAY_IDENTIFIER C_MAF_INT_LAM_ADJ_I_ACT_FAST[1] FORMAT "%7.2" /end CHARACTERISTIC
/begin CHARACTERISTIC c_maf_int_lam_adj_i_act_fast[1] "air mass flow integral threshold for fast trim control I share reactivation" VALUE 0xa0806c70 _REC_VAL_20_u2 1456.33 _CNV_A_R_CYBL_LINEA_135_CM 0. 1456.33 DISPLAY_IDENTIFIER C_MAF_INT_LAM_ADJ_I_ACT_FAST[2] FORMAT "%7.2" /end CHARACTERISTIC
/begin CHARACTERISTIC c_maf_int_lam_adj_i_act_purge[0] "air mass flow integral threshold for trim control I share reactivation after cat purge" VALUE 0xa0806c72 _REC_VAL_20_u2 1456.33 _CNV_A_R_CYBL_LINEA_135_CM 0. 1456.33 DISPLAY_IDENTIFIER C_MAF_INT_LAM_ADJ_I_ACT_PURGE[1] FORMAT "%7.2" /end CHARACTERISTIC
/begin CHARACTERISTIC c_maf_int_lam_adj_i_act_purge[1] "air mass flow integral threshold for trim control I share reactivation after cat purge" VALUE 0xa0806c74 _REC_VAL_20_u2 1456.33 _CNV_A_R_CYBL_LINEA_135_CM 0. 1456.33 DISPLAY_IDENTIFIER C_MAF_INT_LAM_ADJ_I_ACT_PURGE[2] FORMAT "%7.2" /end CHARACTERISTIC
/begin CHARACTERISTIC c_maf_int_lam_adj_p_act_fast[0] "air mass flow integral threshold for fast trim control P share reactivation" VALUE 0xa0806c78 _REC_VAL_20_u2 1456.33 _CNV_A_R_CYBL_LINEA_135_CM 0. 1456.33 DISPLAY_IDENTIFIER C_MAF_INT_LAM_ADJ_P_ACT_FAST[1] FORMAT "%7.2" /end CHARACTERISTIC
/begin CHARACTERISTIC c_maf_int_lam_adj_p_act_fast[1] "air mass flow integral threshold for fast trim control P share reactivation" VALUE 0xa0806c7a _REC_VAL_20_u2 1456.33 _CNV_A_R_CYBL_LINEA_135_CM 0. 1456.33 DISPLAY_IDENTIFIER C_MAF_INT_LAM_ADJ_P_ACT_FAST[2] FORMAT "%7.2" /end CHARACTERISTIC
/begin CHARACTERISTIC c_maf_int_lam_adj_p_act_purge[0] "air mass flow integral threshold for trim control P share reactivation after cat purge" VALUE 0xa0806c7c _REC_VAL_20_u2 1456.33 _CNV_A_R_CYBL_LINEA_135_CM 0. 1456.33 DISPLAY_IDENTIFIER C_MAF_INT_LAM_ADJ_P_ACT_PURGE[1] FORMAT "%7.2" /end CHARACTERISTIC
/begin CHARACTERISTIC c_maf_int_lam_adj_p_act_purge[1] "air mass flow integral threshold for trim control P share reactivation after cat purge" VALUE 0xa0806c7e _REC_VAL_20_u2 1456.33 _CNV_A_R_CYBL_LINEA_135_CM 0. 1456.33 DISPLAY_IDENTIFIER C_MAF_INT_LAM_ADJ_P_ACT_PURGE[2] FORMAT "%7.2" /end CHARACTERISTIC
/begin CHARACTERISTIC lc_lam_adj_i_save_cat_diag "flag indicating that I share after cat diagnosis is set to the value before cat diagnosis" VALUE 0xa0806d02 _REC_VAL_20_u1 1. _CNV_A_R_LINEAR_____0_CM 0. 1. DISPLAY_IDENTIFIER LC_LAM_ADJ_I_SAVE_CAT_DIAG FORMAT "%1.0" /end CHARACTERISTIC
/begin CHARACTERISTIC c_tco_lam_adj_p_act_hst "TCO threshold for hot start detection to immediately active trim control P share" VALUE 0xa0806cde _REC_VAL_20_u1 190.5 _CNV_A_R_LINEAR_____17_CM -48. 142.5 DISPLAY_IDENTIFIER C_TCO_LAM_ADJ_P_ACT_HST FORMAT "%6.2" /end CHARACTERISTIC
/begin CHARACTERISTIC c_t_ast_lam_adj_p_act_hst "T_AST threshold for hot start detection to immediately active trim control P share " VALUE 0xa0806cb8 _REC_VAL_20_u2 6553.5 _CNV_A_R_LINEAR_____4_CM 0. 6553.5 DISPLAY_IDENTIFIER C_T_AST_LAM_ADJ_P_ACT_HST FORMAT "%6.1" /end CHARACTERISTIC
/begin CHARACTERISTIC c_lamb_sp_min_lam_adj_act "minimum lambda set point for trim control activation" VALUE 0xa0806c5c _REC_VAL_20_u2 1.99993896484375 _CNV_A_R_LINEAR_____24_CM 0. 1.99993896484375 DISPLAY_IDENTIFIER C_LAMB_SP_MIN_LAM_ADJ_ACT FORMAT "%7.5" /end CHARACTERISTIC
/begin CHARACTERISTIC c_lamb_sp_max_lam_adj_act "maximun lambda set point for trim control activation" VALUE 0xa0806c5a _REC_VAL_20_u2 1.99993896484375 _CNV_A_R_LINEAR_____24_CM 0. 1.99993896484375 DISPLAY_IDENTIFIER C_LAMB_SP_MAX_LAM_ADJ_ACT FORMAT "%7.5" /end CHARACTERISTIC
/begin CHARACTERISTIC c_maf_int_lam_adj_d_act_fast[0] "air mass flow integral threshold for fast trim control D share reactivation" VALUE 0xa0806c64 _REC_VAL_20_u2 1456.33 _CNV_A_R_CYBL_LINEA_135_CM 0. 1456.33 DISPLAY_IDENTIFIER C_MAF_INT_LAM_ADJ_D_ACT_FAST[1] FORMAT "%7.2" /end CHARACTERISTIC
/begin CHARACTERISTIC c_maf_int_lam_adj_d_act_fast[1] "air mass flow integral threshold for fast trim control D share reactivation" VALUE 0xa0806c66 _REC_VAL_20_u2 1456.33 _CNV_A_R_CYBL_LINEA_135_CM 0. 1456.33 DISPLAY_IDENTIFIER C_MAF_INT_LAM_ADJ_D_ACT_FAST[2] FORMAT "%7.2" /end CHARACTERISTIC
/begin CHARACTERISTIC c_maf_int_lam_adj_d_act_purge[0] "air mass flow integral threshold for trim control D share reactivation after cat purge" VALUE 0xa0806c68 _REC_VAL_20_u2 1456.33 _CNV_A_R_CYBL_LINEA_135_CM 0. 1456.33 DISPLAY_IDENTIFIER C_MAF_INT_LAM_ADJ_D_ACT_PURGE[1] FORMAT "%7.2" /end CHARACTERISTIC
/begin CHARACTERISTIC c_maf_int_lam_adj_d_act_purge[1] "air mass flow integral threshold for trim control D share reactivation after cat purge" VALUE 0xa0806c6a _REC_VAL_20_u2 1456.33 _CNV_A_R_CYBL_LINEA_135_CM 0. 1456.33 DISPLAY_IDENTIFIER C_MAF_INT_LAM_ADJ_D_ACT_PURGE[2] FORMAT "%7.2" /end CHARACTERISTIC
/begin CHARACTERISTIC c_maf_int_lam_adj_d_act_slow "air mass flow integral threshold for slow trim control D share reactivation" VALUE 0xa0806c6c _REC_VAL_20_u2 1456.33 _CNV_A_R_CYBL_LINEA_135_CM 0. 1456.33 DISPLAY_IDENTIFIER C_MAF_INT_LAM_ADJ_D_ACT_SLOW FORMAT "%7.2" /end CHARACTERISTIC
/begin CHARACTERISTIC c_maf_max_lam_adj_p_act "maximum air mass flow threshold for trim control P share calculation" VALUE 0xa0806c94 _REC_VAL_20_u1 1389. _CNV_A_R_LINEAR_____15_CM 0. 1389. DISPLAY_IDENTIFIER C_MAF_MAX_LAM_ADJ_P_ACT FORMAT "%4.0" /end CHARACTERISTIC
/begin CHARACTERISTIC c_maf_max_lam_adj_d_act "maximum air mass flow threshold for trim control D share calculation" VALUE 0xa0806c93 _REC_VAL_20_u1 1389. _CNV_A_R_LINEAR_____15_CM 0. 1389. DISPLAY_IDENTIFIER C_MAF_MAX_LAM_ADJ_D_ACT FORMAT "%4.0" /end CHARACTERISTIC
/begin CHARACTERISTIC c_maf_min_lam_adj_p_act "minimum air mass flow threshold for trim control P share calculation" VALUE 0xa0806c98 _REC_VAL_20_u1 1389. _CNV_A_R_LINEAR_____15_CM 0. 1389. DISPLAY_IDENTIFIER C_MAF_MIN_LAM_ADJ_P_ACT FORMAT "%4.0" /end CHARACTERISTIC
/begin CHARACTERISTIC c_maf_min_lam_adj_d_act "minimum air mass flow threshold for trim control D share calculation" VALUE 0xa0806c97 _REC_VAL_20_u1 1389. _CNV_A_R_LINEAR_____15_CM 0. 1389. DISPLAY_IDENTIFIER C_MAF_MIN_LAM_ADJ_D_ACT FORMAT "%4.0" /end CHARACTERISTIC
/begin CHARACTERISTIC c_n_max_lam_adj_p_act "maximum engine speed threshold for trim control P share calculation" VALUE 0xa0806cac _REC_VAL_20_u1 8160. _CNV_A_R_LINEAR_____10_CM 0. 8160. DISPLAY_IDENTIFIER C_N_MAX_LAM_ADJ_P_ACT FORMAT "%4.0" /end CHARACTERISTIC
/begin CHARACTERISTIC c_n_max_lam_adj_d_act "maximum engine speed threshold for trim control D share calculation" VALUE 0xa0806cab _REC_VAL_20_u1 8160. _CNV_A_R_LINEAR_____10_CM 0. 8160. DISPLAY_IDENTIFIER C_N_MAX_LAM_ADJ_D_ACT FORMAT "%4.0" /end CHARACTERISTIC
/begin CHARACTERISTIC c_n_min_lam_adj_p_act "minimum engine speed threshold for trim control P share calculation" VALUE 0xa0806cb0 _REC_VAL_20_u1 8160. _CNV_A_R_LINEAR_____10_CM 0. 8160. DISPLAY_IDENTIFIER C_N_MIN_LAM_ADJ_P_ACT FORMAT "%4.0" /end CHARACTERISTIC
/begin CHARACTERISTIC c_n_min_lam_adj_d_act "minimum engine speed threshold for trim control D share calculation" VALUE 0xa0806caf _REC_VAL_20_u1 8160. _CNV_A_R_LINEAR_____10_CM 0. 8160. DISPLAY_IDENTIFIER C_N_MIN_LAM_ADJ_D_ACT FORMAT "%4.0" /end CHARACTERISTIC
/begin CHARACTERISTIC lc_lamb_pls_not_chk_lam_adj "calibration flag to choose whether I share is calculated when forced lambda stimulation is not active" VALUE 0xa0806d09 _REC_VAL_20_u1 1. _CNV_A_R_LINEAR_____0_CM 0. 1. DISPLAY_IDENTIFIER LC_LAMB_PLS_NOT_CHK_LAM_ADJ FORMAT "%1.0" /end CHARACTERISTIC
/begin CHARACTERISTIC lc_lam_adj_ldc_not_chk "calibration flag to choose whether I share is calculated when limited dynamics are not fulfilled" VALUE 0xa0806d03 _REC_VAL_20_u1 1. _CNV_A_R_LINEAR_____0_CM 0. 1. DISPLAY_IDENTIFIER LC_LAM_ADJ_LDC_NOT_CHK FORMAT "%1.0" /end CHARACTERISTIC
/begin CHARACTERISTIC ip_fac_add_lamb_delta_d "additional weighting coefficient for trim control D share calculation" CURVE 0xa080695c _REC_CUR_20_u1_u1 0.99609375 _CNV_A_R_LINEAR_____28_CM 0. 0.99609375 DISPLAY_IDENTIFIER IP_FAC_ADD_LAMB_DELTA_D FORMAT "%5.3"
 /begin AXIS_DESCR COM_AXIS online_dummy _CNV_A_R_LINEAR_____103_CM 8 0. 1.9921875 FORMAT "%8.6" AXIS_PTS_REF ldpm_eff_cat_diag_1_laco /end AXIS_DESCR
/end CHARACTERISTIC
/begin CHARACTERISTIC ip_fac_add_lamb_delta_p "additional weighting coefficient for trim control P share calculation" CURVE 0xa0806964 _REC_CUR_20_u1_u1 0.99609375 _CNV_A_R_LINEAR_____28_CM 0. 0.99609375 DISPLAY_IDENTIFIER IP_FAC_ADD_LAMB_DELTA_P FORMAT "%5.3"
 /begin AXIS_DESCR COM_AXIS online_dummy _CNV_A_R_LINEAR_____103_CM 8 0. 1.9921875 FORMAT "%8.6" AXIS_PTS_REF ldpm_eff_cat_diag_1_laco /end AXIS_DESCR
/end CHARACTERISTIC
/begin AXIS_PTS ldp_vls_dif_delta_ip_lamb_d "" 0xa08066f4 online_dummy _REC_AXS_20_u2 9.99511719 _CNV_A_R_LACO_LINEA_362_CM 16 -5. 4.99511719 /end AXIS_PTS
/begin CHARACTERISTIC ip_lamb_delta_d_lam_adj "characteristic line of trim control D share" CURVE 0xa0806ae0 _REC_CUR_20_u2_u2 0.25 _CNV_A_R_LACO_LINEA_378_CM -0.125 0.125 DISPLAY_IDENTIFIER IP_LAMB_DELTA_D_LAM_ADJ FORMAT "%8.5"
 /begin AXIS_DESCR COM_AXIS online_dummy _CNV_A_R_LACO_LINEA_362_CM 16 -5. 4.99511719 AXIS_PTS_REF ldp_vls_dif_delta_ip_lamb_d /end AXIS_DESCR
/end CHARACTERISTIC
/begin CHARACTERISTIC ip_lamb_delta_i_lam_adj_diag "characteristic line of trim control I share in case of active diagnosis function" MAP 0xa0811f34 _REC_MAP_20_u2_u2_u1 0.249996185302734 _CNV_A_R_LACO_LINEA_379_CM -0.125 0.124996185302734 DISPLAY_IDENTIFIER IP_LAMB_DELTA_I_LAM_ADJ_DIAG FORMAT "%8.6"
 /begin AXIS_DESCR COM_AXIS online_dummy _CNV_A_R_LACO_LINEA_362_CM 16 -5. 4.99511719 AXIS_PTS_REF ldpm_vls_dif_lam_adj_2_laco /end AXIS_DESCR
 /begin AXIS_DESCR COM_AXIS online_dummy _CNV_A_R_LINEAR_____103_CM 8 0. 1.9921875 FORMAT "%8.6" AXIS_PTS_REF ldpm_eff_cat_diag_1_laco /end AXIS_DESCR
/end CHARACTERISTIC
/begin CHARACTERISTIC ip_lamb_delta_p_lam_adj_diag "characteristic line of trim control P share in case of active cat diagnosis" CURVE 0xa0806b40 _REC_CUR_20_u2_u2 0.25 _CNV_A_R_LACO_LINEA_378_CM -0.125 0.125 DISPLAY_IDENTIFIER IP_LAMB_DELTA_P_LAM_ADJ_DIAG FORMAT "%8.5"
 /begin AXIS_DESCR COM_AXIS online_dummy _CNV_A_R_LACO_LINEA_362_CM 16 -5. 4.99511719 AXIS_PTS_REF ldpm_vls_dif_lam_adj_2_laco /end AXIS_DESCR
/end CHARACTERISTIC
/begin CHARACTERISTIC ip_vls_sp_delta_lam_adj "Additional offset of setpoint for trim control at not active catalyst diagnosis to take into account the catalyst aging" CURVE 0xa0806bb0 _REC_CUR_20_u2_u1 9.99511719 _CNV_A_R_LACO_LINEA_362_CM -5. 4.99511719 DISPLAY_IDENTIFIER IP_VLS_SP_DELTA_LAM_ADJ
 /begin AXIS_DESCR COM_AXIS online_dummy _CNV_A_R_LINEAR_____103_CM 8 0. 1.9921875 FORMAT "%8.6" AXIS_PTS_REF ldpm_eff_cat_diag_1_laco /end AXIS_DESCR
/end CHARACTERISTIC
/begin CHARACTERISTIC ip_crlc_vls_dif_mmv_lam_adj "correlation constant to calculate moving mean value of trim controller difference" MAP 0xa0811ad4 _REC_MAP_20_u2_u2_u1 0.9999847412109381 _CNV_A_R_LINEAR_____89_CM 0. 0.9999847412109381 DISPLAY_IDENTIFIER IP_CRLC_VLS_DIF_MMV_LAM_ADJ FORMAT "%7.5"
 /begin AXIS_DESCR COM_AXIS maf_cyl _CNV_A_R_LINEAR_____215_CM 6 0. 2047.96875 FORMAT "%10.5" AXIS_PTS_REF ldpm_maf_cyl_1_laco /end AXIS_DESCR
 /begin AXIS_DESCR COM_AXIS online_dummy _CNV_A_R_LINEAR_____103_CM 8 0. 1.9921875 FORMAT "%8.6" AXIS_PTS_REF ldpm_eff_cat_diag_1_laco /end AXIS_DESCR
/end CHARACTERISTIC
/begin CHARACTERISTIC ip_crlc_lamb_delta_i_lam_adj[0] "air mass flow dependent weighting coefficient for trim control I share calculation" CURVE 0xa080693c _REC_CUR_20_u2_u2 0.9999847412109381 _CNV_A_R_LINEAR_____89_CM 0. 0.9999847412109381 DISPLAY_IDENTIFIER IP_CRLC_LAMB_DELTA_I_LAM_ADJ[1] FORMAT "%7.5"
 /begin AXIS_DESCR COM_AXIS maf_cyl _CNV_A_R_LINEAR_____215_CM 6 0. 2047.96875 FORMAT "%10.5" AXIS_PTS_REF ldpm_maf_cyl_1_laco /end AXIS_DESCR
/end CHARACTERISTIC
/begin CHARACTERISTIC ip_crlc_lamb_delta_i_lam_adj[1] "air mass flow dependent weighting coefficient for trim control I share calculation" CURVE 0xa0806948 _REC_CUR_20_u2_u2 0.9999847412109381 _CNV_A_R_LINEAR_____89_CM 0. 0.9999847412109381 DISPLAY_IDENTIFIER IP_CRLC_LAMB_DELTA_I_LAM_ADJ[2] FORMAT "%7.5"
 /begin AXIS_DESCR COM_AXIS maf_cyl _CNV_A_R_LINEAR_____215_CM 6 0. 2047.96875 FORMAT "%10.5" AXIS_PTS_REF ldpm_maf_cyl_1_laco /end AXIS_DESCR
/end CHARACTERISTIC
/begin CHARACTERISTIC ip_fac_lamb_delta_d_lam_adj[0] "air mass flow dependent weighting coefficient for trim control D share calculation" CURVE 0xa0806a2c _REC_CUR_20_u2_u2 0.9999847412109381 _CNV_A_R_LINEAR_____89_CM 0. 0.9999847412109381 DISPLAY_IDENTIFIER IP_FAC_LAMB_DELTA_D_LAM_ADJ[1] FORMAT "%7.5"
 /begin AXIS_DESCR COM_AXIS maf_cyl _CNV_A_R_LINEAR_____215_CM 6 0. 2047.96875 FORMAT "%10.5" AXIS_PTS_REF ldpm_maf_cyl_1_laco /end AXIS_DESCR
/end CHARACTERISTIC
/begin CHARACTERISTIC ip_fac_lamb_delta_d_lam_adj[1] "air mass flow dependent weighting coefficient for trim control D share calculation" CURVE 0xa0806a38 _REC_CUR_20_u2_u2 0.9999847412109381 _CNV_A_R_LINEAR_____89_CM 0. 0.9999847412109381 DISPLAY_IDENTIFIER IP_FAC_LAMB_DELTA_D_LAM_ADJ[2] FORMAT "%7.5"
 /begin AXIS_DESCR COM_AXIS maf_cyl _CNV_A_R_LINEAR_____215_CM 6 0. 2047.96875 FORMAT "%10.5" AXIS_PTS_REF ldpm_maf_cyl_1_laco /end AXIS_DESCR
/end CHARACTERISTIC
/begin CHARACTERISTIC ip_fac_lamb_delta_p_lam_adj[0] "air mass flow dependent weighting coefficient for trim control P share calculation" CURVE 0xa0806a44 _REC_CUR_20_u2_u2 0.9999847412109381 _CNV_A_R_LINEAR_____89_CM 0. 0.9999847412109381 DISPLAY_IDENTIFIER IP_FAC_LAMB_DELTA_P_LAM_ADJ[1] FORMAT "%7.5"
 /begin AXIS_DESCR COM_AXIS maf_cyl _CNV_A_R_LINEAR_____215_CM 6 0. 2047.96875 FORMAT "%10.5" AXIS_PTS_REF ldpm_maf_cyl_1_laco /end AXIS_DESCR
/end CHARACTERISTIC
/begin CHARACTERISTIC ip_fac_lamb_delta_p_lam_adj[1] "air mass flow dependent weighting coefficient for trim control P share calculation" CURVE 0xa0806a50 _REC_CUR_20_u2_u2 0.9999847412109381 _CNV_A_R_LINEAR_____89_CM 0. 0.9999847412109381 DISPLAY_IDENTIFIER IP_FAC_LAMB_DELTA_P_LAM_ADJ[2] FORMAT "%7.5"
 /begin AXIS_DESCR COM_AXIS maf_cyl _CNV_A_R_LINEAR_____215_CM 6 0. 2047.96875 FORMAT "%10.5" AXIS_PTS_REF ldpm_maf_cyl_1_laco /end AXIS_DESCR
/end CHARACTERISTIC
/begin CHARACTERISTIC ip_vls_sp_lam_adj[0] "sensor voltage set point for trim control" MAP 0xa0812234 _REC_MAP_20_u2_u1_u1 4.9951171875 _CNV_A_R_LINEAR_____2_CM 0. 4.9951171875 DISPLAY_IDENTIFIER IP_VLS_SP_LAM_ADJ[1] FORMAT "%5.3"
 /begin AXIS_DESCR COM_AXIS maf_hb _CNV_A_R_LINEAR_____15_CM 8 0. 1389. FORMAT "%4.0" AXIS_PTS_REF ldp_maf_hb_ip_vls_sp_lam_adj /end AXIS_DESCR
 /begin AXIS_DESCR COM_AXIS n_32 _CNV_A_R_LINEAR_____10_CM 8 0. 8160. FORMAT "%4.0" AXIS_PTS_REF ldp_n_32_ip_vls_sp_lam_adj /end AXIS_DESCR
/end CHARACTERISTIC
/begin CHARACTERISTIC ip_vls_sp_lam_adj[1] "sensor voltage set point for trim control" MAP 0xa08122b4 _REC_MAP_20_u2_u1_u1 4.9951171875 _CNV_A_R_LINEAR_____2_CM 0. 4.9951171875 DISPLAY_IDENTIFIER IP_VLS_SP_LAM_ADJ[2] FORMAT "%5.3"
 /begin AXIS_DESCR COM_AXIS maf_hb _CNV_A_R_LINEAR_____15_CM 8 0. 1389. FORMAT "%4.0" AXIS_PTS_REF ldp_maf_hb_ip_vls_sp_lam_adj /end AXIS_DESCR
 /begin AXIS_DESCR COM_AXIS n_32 _CNV_A_R_LINEAR_____10_CM 8 0. 8160. FORMAT "%4.0" AXIS_PTS_REF ldp_n_32_ip_vls_sp_lam_adj /end AXIS_DESCR
/end CHARACTERISTIC
/begin MEASUREMENT lv_lamb_delta_ad_lam_adj_ext "flag to set trim control adaptation value to calibration value (external adjustment)" UBYTE _CNV_S_2_RANGE__0___1_CM 1 100. 0. 1. DISPLAY_IDENTIFIER LV_LAMB_DELTA_AD_LAM_ADJ_EXT ECU_ADDRESS 0xd000768f BIT_MASK 0x1 /end MEASUREMENT
/begin AXIS_PTS ldpm_maf_kgh__crlc_vls_down "" 0xa0806778 maf_kgh _REC_AXS_20_u2 2047.96875 _CNV_A_R_LINEAR_____215_CM 4 0. 2047.96875 FORMAT "%7.2" /end AXIS_PTS
/begin CHARACTERISTIC id_crlc_vls_down_t_dly "correlation constant downstream signal" CURVE 0xa0806856 _REC_CUR_20_u1_u2 0.99609375 _CNV_A_R_LINEAR_____185_CM 0. 0.99609375 DISPLAY_IDENTIFIER ID_CRLC_VLS_DOWN_T_DLY FORMAT "%5.3"
 /begin AXIS_DESCR COM_AXIS maf_kgh _CNV_A_R_LINEAR_____215_CM 4 0. 2047.96875 FORMAT "%7.2" AXIS_PTS_REF ldpm_maf_kgh__crlc_vls_down /end AXIS_DESCR
/end CHARACTERISTIC
/begin CHARACTERISTIC lc_lamb_delta_ad_lam_adj_ext "LC for external adjustment of adaptation value for the lambda-shift" VALUE 0xa0806d08 _REC_VAL_20_u1 1. _CNV_A_R_LINEAR_____0_CM 0. 1. DISPLAY_IDENTIFIER LC_LAMB_DELTA_AD_LAM_ADJ_EXT FORMAT "%2.0" /end CHARACTERISTIC
/begin CHARACTERISTIC ip_vls_delta_lam_adj_cat_diag "sensor voltage set point shift in case of active cat efficiency diagnosis" CURVE 0xa0806ba0 _REC_CUR_20_u2_u1 4.9951171875 _CNV_A_R_LINEAR_____2_CM 0. 4.9951171875 DISPLAY_IDENTIFIER IP_VLS_DELTA_LAM_ADJ_CAT_DIAG FORMAT "%5.3"
 /begin AXIS_DESCR COM_AXIS online_dummy _CNV_A_R_LINEAR_____103_CM 8 0. 1.9921875 FORMAT "%8.6" AXIS_PTS_REF ldpm_eff_cat_diag_1_laco /end AXIS_DESCR
/end CHARACTERISTIC
/begin AXIS_PTS ldp_t_sum_afl_afr_ip_crlc_vls "" 0xa08066d0 egcp[0].egcp_struct_ispclls0.t_sum_afl_afr_cyc _REC_AXS_20_u2 655.35 _CNV_A_R_LINEAR_____3_CM 6 0. 655.35 FORMAT "%6.2" /end AXIS_PTS
/begin CHARACTERISTIC ip_crlc_vls_lam_adj_cat_diag "correlation constant for filtering downstream signal for catalyst efficiency diagnosis" CURVE 0xa0806954 _REC_CUR_20_u1_u2 0.99609375 _CNV_A_R_LINEAR_____185_CM 0. 0.99609375 DISPLAY_IDENTIFIER IP_CRLC_VLS_LAM_ADJ_CAT_DIAG FORMAT "%5.3"
 /begin AXIS_DESCR COM_AXIS egcp[0].egcp_struct_ispclls0.t_sum_afl_afr_cyc _CNV_A_R_LINEAR_____3_CM 6 0. 655.35 FORMAT "%6.2" AXIS_PTS_REF ldp_t_sum_afl_afr_ip_crlc_vls /end AXIS_DESCR
/end CHARACTERISTIC
/begin AXIS_PTS ldp_tco_st_1_egcp "" 0xa08066de tco_st _REC_AXS_20_u1 190.5 _CNV_A_R_LINEAR_____17_CM 6 -48. 142.5 FORMAT "%6.2" /end AXIS_PTS
/begin CHARACTERISTIC id_t_dly_lam_ad_1 "activation of trim controller after calibratable time" CURVE 0xa08068dc _REC_CUR_20_u2_u1 6553.5 _CNV_A_R_LINEAR_____4_CM 0. 6553.5 DISPLAY_IDENTIFIER ID_T_DLY_LAM_AD_1 FORMAT "%6.1"
 /begin AXIS_DESCR COM_AXIS tco_st _CNV_A_R_LINEAR_____17_CM 6 -48. 142.5 FORMAT "%6.2" AXIS_PTS_REF ldp_tco_st_1_egcp /end AXIS_DESCR
/end CHARACTERISTIC
/begin CHARACTERISTIC id_t_dly_lam_ad_2 "activation of trim controller after calibratable time" CURVE 0xa08068e8 _REC_CUR_20_u2_u1 6553.5 _CNV_A_R_LINEAR_____4_CM 0. 6553.5 DISPLAY_IDENTIFIER ID_T_DLY_LAM_AD_2 FORMAT "%6.1"
 /begin AXIS_DESCR COM_AXIS tco_st _CNV_A_R_LINEAR_____17_CM 6 -48. 142.5 FORMAT "%6.2" AXIS_PTS_REF ldp_tco_st_1_egcp /end AXIS_DESCR
/end CHARACTERISTIC
/begin CHARACTERISTIC lc_var_ex_cus "Switch to an exhaust gas configuration with 2 linear and 1 binary O2 sensor (LC… = 1)" VALUE 0xa0806d0b _REC_VAL_20_u1 1. _CNV_A_R_LINEAR_____0_CM 0. 1. DISPLAY_IDENTIFIER LC_VAR_EX_CUS FORMAT "%1.0" /end CHARACTERISTIC
/begin CHARACTERISTIC lc_lam_adj_act_fast_lam_lscl "Switch to activate fast activation of dynamic fuel trim" VALUE 0xa0806d01 _REC_VAL_20_u1 1. _CNV_A_R_LINEAR_____0_CM 0. 1. DISPLAY_IDENTIFIER LC_LAM_ADJ_ACT_FAST_LAM_LSCL FORMAT "%2.0" /end CHARACTERISTIC
/begin COMPU_METHOD _CNV_A_R_LINEAR_____0_CM "" RAT_FUNC "%6.3" "-" COEFFS 0 1. 0. 0 0 1 /end COMPU_METHOD
/begin COMPU_METHOD _CNV_S_2_RANGE__0___1_CM "" TAB_VERB "%6.3" "-" COMPU_TAB_REF _CNV_S_2_RANGE__0___1 /end COMPU_METHOD
/begin COMPU_VTAB _CNV_S_2_RANGE__0___1 "" TAB_VERB 2 0 "0" 1 "1" /end COMPU_VTAB
/begin COMPU_METHOD _CNV_A_R_LINEAR_____2_CM "" RAT_FUNC "%6.3" "V" COEFFS 0 204.8 0. 0 0 1 /end COMPU_METHOD
/begin COMPU_METHOD _CNV_A_R_LINEAR_____3_CM "" RAT_FUNC "%6.3" "s" COEFFS 0 100. 0. 0 0 1 /end COMPU_METHOD
/begin COMPU_METHOD _CNV_A_R_LINEAR_____4_CM "" RAT_FUNC "%6.3" "s" COEFFS 0 10. 0. 0 0 1 /end COMPU_METHOD
/begin COMPU_METHOD _CNV_A_R_LINEAR_____5_CM "" RAT_FUNC "%6.3" "%" COEFFS 0 2.56 0. 0 0 1 /end COMPU_METHOD
/begin COMPU_METHOD _CNV_A_R_LINEAR_____8_CM "" RAT_FUNC "%6.3" "%" COEFFS 0 655.3599999999997 0. 0 0 1 /end COMPU_METHOD
/begin COMPU_METHOD _CNV_A_R_LINEAR_____9_CM "" RAT_FUNC "%6.3" "-" COEFFS 0 32767.99999999992 0. 0 0 1 /end COMPU_METHOD
/begin COMPU_METHOD _CNV_A_R_LINEAR_____10_CM "" RAT_FUNC "%6.3" "rpm" COEFFS 0 3.125e-002 0. 0 0 1 /end COMPU_METHOD
/begin COMPU_METHOD _CNV_A_R_LINEAR_____14_CM "" RAT_FUNC "%6.3" "rpm" COEFFS 0 1. 0. 0 0 1 /end COMPU_METHOD
/begin COMPU_METHOD _CNV_A_R_LINEAR_____15_CM "" RAT_FUNC "%6.3" "mg/stk" COEFFS 0 0.183585313174946 0. 0 0 1 /end COMPU_METHOD
/begin COMPU_METHOD _CNV_A_R_LINEAR_____17_CM "" RAT_FUNC "%6.3" "°C" COEFFS 0 1.333333333333333 64. 0 0 1 /end COMPU_METHOD
/begin COMPU_METHOD _CNV_A_R_LINEAR_____24_CM "" RAT_FUNC "%6.3" "-" COEFFS 0 16384. 0. 0 0 1 /end COMPU_METHOD
/begin COMPU_METHOD _CNV_A_R_LINEAR_____27_CM "" RAT_FUNC "%6.3" "hPa" COEFFS 0 12.06017666543982 0. 0 0 1 /end COMPU_METHOD
/begin COMPU_METHOD _CNV_A_R_LINEAR_____28_CM "" RAT_FUNC "%6.3" "-" COEFFS 0 256. 0. 0 0 1 /end COMPU_METHOD
/begin COMPU_METHOD _CNV_A_R_LINEAR_____36_CM "" RAT_FUNC "%6.3" "s" COEFFS 0 1. 0. 0 0 1 /end COMPU_METHOD
/begin COMPU_METHOD _CNV_A_R_LINEAR_____89_CM "" RAT_FUNC "%6.3" "-" COEFFS 0 65535.99999999996 0. 0 0 1 /end COMPU_METHOD
/begin COMPU_METHOD _CNV_A_R_LINEAR_____103_CM "" RAT_FUNC "%6.3" "-" COEFFS 0 128. 0. 0 0 1 /end COMPU_METHOD
/begin COMPU_METHOD _CNV_A_R_LINEAR_____110_CM "" RAT_FUNC "%6.3" "s" COEFFS 0 50. 0. 0 0 1 /end COMPU_METHOD
/begin COMPU_METHOD _CNV_A_R_LINEAR_____111_CM "" RAT_FUNC "%6.3" "mg/stk" COEFFS 0 47.18142548596112 0. 0 0 1 /end COMPU_METHOD
/begin COMPU_METHOD _CNV_A_R_LINEAR_____113_CM "" RAT_FUNC "%6.3" "%" COEFFS 0 655.3599999999997 -1.455191522836685e-011 0 0 1 /end COMPU_METHOD
/begin COMPU_METHOD _CNV_A_R_LINEAR_____117_CM "" RAT_FUNC "%6.3" "s" COEFFS 0 32767.99999999992 0. 0 0 1 /end COMPU_METHOD
/begin COMPU_METHOD _CNV_A_R_LINEAR_____119_CM "" RAT_FUNC "%6.3" "-" COEFFS 0 4096. 0. 0 0 1 /end COMPU_METHOD
/begin COMPU_METHOD _CNV_A_R_LINEAR_____125_CM "" RAT_FUNC "%6.3" "%" COEFFS 0 655.3600000143365 0. 0 0 1 /end COMPU_METHOD
/begin COMPU_METHOD _CNV_A_R_LINEAR_____128_CM "" RAT_FUNC "%6.3" "mg/stk" COEFFS 0 47.18142548596112 -1.455191522836685e-011 0 0 1 /end COMPU_METHOD
/begin COMPU_METHOD _CNV_A_R_LINEAR_____129_CM "" RAT_FUNC "%6.3" "-" COEFFS 0 1024. 0. 0 0 1 /end COMPU_METHOD
/begin COMPU_METHOD _CNV_A_R_CYBL_LINEA_135_CM "" RAT_FUNC "%6.3" "g" COEFFS 0 45.00010299863355 0. 0 0 1 /end COMPU_METHOD
/begin COMPU_METHOD _CNV_A_R_LINEAR_____171_CM "" RAT_FUNC "%6.3" "hPa" COEFFS 0 0.1884402603974972 0. 0 0 1 /end COMPU_METHOD
/begin COMPU_METHOD _CNV_A_R_LINEAR_____178_CM "" RAT_FUNC "%6.3" "%" COEFFS 0 655.3600000071681 32768.00000035841 0 0 1 /end COMPU_METHOD
/begin COMPU_METHOD _CNV_A_R_LINEAR_____185_CM "" RAT_FUNC "%6.3" "" COEFFS 0 256. 0. 0 0 1 /end COMPU_METHOD
/begin COMPU_METHOD _CNV_A_R_LINEAR_____201_CM "" RAT_FUNC "%6.3" "V" COEFFS 0 13107.19998965744 0. 0 0 1 /end COMPU_METHOD
/begin COMPU_METHOD _CNV_A_R_LINEAR_____212_CM "" RAT_FUNC "%6.3" "%" COEFFS 0 327.68 0. 0 0 1 /end COMPU_METHOD
/begin COMPU_METHOD _CNV_A_R_LINEAR_____214_CM "" RAT_FUNC "%6.3" "°C" COEFFS 0 16. 4370.4 0 0 1 /end COMPU_METHOD
/begin COMPU_METHOD _CNV_A_R_LINEAR_____215_CM "" RAT_FUNC "%6.3" "kg/h" COEFFS 0 32. 0. 0 0 1 /end COMPU_METHOD
/begin COMPU_METHOD _CNV_A_R_LINEAR_____223_CM "" RAT_FUNC "%6.3" "g" COEFFS 0 35.99999934081027 0. 0 0 1 /end COMPU_METHOD
/begin COMPU_METHOD _CNV_A_R_LINEAR_____259_CM "" RAT_FUNC "%6.3" "-" COEFFS 0 32768. 0. 0 0 1 /end COMPU_METHOD
/begin COMPU_METHOD _CNV_A_R_LINEAR_____302_CM "" RAT_FUNC "%6.3" "kg/h" COEFFS 0 64. 0. 0 0 1 /end COMPU_METHOD
/begin COMPU_METHOD _CNV_A_R_EGCP_LINEA_309_CM "Battery voltage" RAT_FUNC "%6.3" "V" COEFFS 0 6553.600270084133 1.350420665403362e-003 0 0 1 /end COMPU_METHOD
/begin COMPU_METHOD _CNV_A_R_LINEAR_____314_CM "" RAT_FUNC "%6.3" "g" COEFFS 0 22.49999999999997 0. 0 0 1 /end COMPU_METHOD
/begin COMPU_METHOD _CNV_A_R_LINEAR_____315_CM "" RAT_FUNC "%6.3" "V" COEFFS 0 204.7999999487896 -2.556795379859977e-007 0 0 1 /end COMPU_METHOD
/begin COMPU_METHOD _CNV_A_R_EGCP_LINEA_355_CM "" RAT_FUNC "%6.3" "-" COEFFS 0 8. 0. 0 0 1 /end COMPU_METHOD
/begin COMPU_METHOD _CNV_A_R_LINEAR_____361_CM "" RAT_FUNC "%6.3" "s" COEFFS 0 64000.02343786621 0. 0 0 1 /end COMPU_METHOD
/begin COMPU_METHOD _CNV_A_R_LACO_LINEA_362_CM "" RAT_FUNC "%6.3" "V" COEFFS 0 204.799999948775 1023.999999743875 0 0 1 /end COMPU_METHOD
/begin COMPU_METHOD _CNV_A_R_LACO_LINEA_363_CM "" RAT_FUNC "%6.3" "mg/stk" COEFFS 0 47.18142548596112 32767.99998156587 0 0 1 /end COMPU_METHOD
/begin COMPU_METHOD _CNV_A_R_LINEAR_____364_CM "" RAT_FUNC "%6.3" "g" COEFFS 0 35.99993408114611 0. 0 0 1 /end COMPU_METHOD
/begin COMPU_METHOD _CNV_A_R_LACO_LINEA_365_CM "" RAT_FUNC "%6.3" "mg/stk" COEFFS 0 3019.611231101512 -2.543412556406111e-004 0 0 1 /end COMPU_METHOD
/begin COMPU_METHOD _CNV_S_8_LACO_RANGE_366_CM "" TAB_VERB "%6.3" "-" COMPU_TAB_REF _CNV_S_8_LACO_RANGE_366 /end COMPU_METHOD
/begin COMPU_VTAB _CNV_S_8_LACO_RANGE_366 "" TAB_VERB 8 0 "INIT" 1 "WAIT" 2 "CDN_FAC_L" 3 "CDN_FAC_H" 4 "CDN_ADD" 5 "ADAPT_FAC_L" 6 "ADAPT_FAC_H" 7 "ADAPT_ADD" /end COMPU_VTAB
/begin COMPU_METHOD _CNV_A_R_LACO_LINEA_367_CM "" RAT_FUNC "%6.3" "-" COEFFS 0 32768.00000000001 4.76837158203125e-007 0 0 1 /end COMPU_METHOD
/begin COMPU_METHOD _CNV_A_R_LACO_LINEA_368_CM "" RAT_FUNC "%6.3" "%" COEFFS 0 42949672.96000002 9.5367431640625e-007 0 0 1 /end COMPU_METHOD
/begin COMPU_METHOD _CNV_A_R_LACO_LINEA_369_CM "" RAT_FUNC "%6.3" "-" COEFFS 0 2147483648. -4.76837158203125e-007 0 0 1 /end COMPU_METHOD
/begin COMPU_METHOD _CNV_A_R_LACO_LINEA_370_CM "" RAT_FUNC "%6.3" "1/s" COEFFS 0 1310.720001587224 0. 0 0 1 /end COMPU_METHOD
/begin COMPU_METHOD _CNV_A_R_LACO_LINEA_371_CM "" RAT_FUNC "%6.3" "1/s²" COEFFS 0 2621.439950744849 0. 0 0 1 /end COMPU_METHOD
/begin COMPU_METHOD _CNV_A_R_LACO_LINEA_372_CM "" RAT_FUNC "%6.3" "s" COEFFS 0 819195.4798869971 0. 0 0 1 /end COMPU_METHOD
/begin COMPU_METHOD _CNV_S_4_LACO_RANGE_373_CM "" TAB_VERB "%6.3" "-" COMPU_TAB_REF _CNV_S_4_LACO_RANGE_373 /end COMPU_METHOD
/begin COMPU_VTAB _CNV_S_4_LACO_RANGE_373 "" TAB_VERB 4 0 "0:OFF" 1 "1:ON" 2 "2:STOP_SHO_PER" 3 "3:STOP" /end COMPU_VTAB
/begin COMPU_METHOD _CNV_A_R_LACO_LINEA_374_CM "" RAT_FUNC "%6.3" "-" COEFFS 0 262144.0000000004 5.093170329928398e-011 0 0 1 /end COMPU_METHOD
/begin COMPU_METHOD _CNV_A_R_LACO_LINEA_377_CM "" RAT_FUNC "%6.3" "1/s" COEFFS 0 1310.719996005547 2.790796169893639e-004 0 0 1 /end COMPU_METHOD
/begin COMPU_METHOD _CNV_A_R_LACO_LINEA_378_CM "" RAT_FUNC "%6.3" "-" COEFFS 0 16384. 2048. 0 0 1 /end COMPU_METHOD
/begin COMPU_METHOD _CNV_A_R_LACO_LINEA_379_CM "" RAT_FUNC "%6.3" "-" COEFFS 0 262144.0000000004 32768.00000000005 0 0 1 /end COMPU_METHOD
/begin RECORD_LAYOUT _REC_VAL_20_u1 FNC_VALUES 1 UBYTE COLUMN_DIR DIRECT /end RECORD_LAYOUT
/begin RECORD_LAYOUT _REC_VAL_20_u2 FNC_VALUES 1 UWORD COLUMN_DIR DIRECT /end RECORD_LAYOUT
/begin RECORD_LAYOUT _REC_AXS_20_u1 NO_AXIS_PTS_X 1 UBYTE AXIS_PTS_X 2 UBYTE INDEX_INCR DIRECT /end RECORD_LAYOUT
/begin RECORD_LAYOUT _REC_MAP_20_u2_u1_u1 FNC_VALUES 1 UWORD COLUMN_DIR DIRECT /end RECORD_LAYOUT
/begin RECORD_LAYOUT _REC_CUR_20_u1_u1 FNC_VALUES 1 UBYTE COLUMN_DIR DIRECT /end RECORD_LAYOUT
/begin RECORD_LAYOUT _REC_VAL_20_s2 FNC_VALUES 1 SWORD COLUMN_DIR DIRECT /end RECORD_LAYOUT
/begin RECORD_LAYOUT _REC_MAP_20_u2_u2_u1 FNC_VALUES 1 UWORD COLUMN_DIR DIRECT /end RECORD_LAYOUT
/begin RECORD_LAYOUT _REC_AXS_20_u2 NO_AXIS_PTS_X 1 UWORD AXIS_PTS_X 2 UWORD INDEX_INCR DIRECT /end RECORD_LAYOUT
/begin RECORD_LAYOUT _REC_CUR_20_u2_u1 FNC_VALUES 1 UWORD COLUMN_DIR DIRECT /end RECORD_LAYOUT
/begin RECORD_LAYOUT _REC_CUR_20_u2_u2 FNC_VALUES 1 UWORD COLUMN_DIR DIRECT /end RECORD_LAYOUT
/begin RECORD_LAYOUT _REC_CUR_20_u1_u2 FNC_VALUES 1 UBYTE COLUMN_DIR DIRECT /end RECORD_LAYOUT
/begin RECORD_LAYOUT _REC_MAP_20_u2_u2_u2 FNC_VALUES 1 UWORD COLUMN_DIR DIRECT /end RECORD_LAYOUT
/begin RECORD_LAYOUT _REC_MAP_20_u1_u2_u2 FNC_VALUES 1 UBYTE COLUMN_DIR DIRECT /end RECORD_LAYOUT
/begin RECORD_LAYOUT _REC_MAP_20_u1_u1_u2 FNC_VALUES 1 UBYTE COLUMN_DIR DIRECT /end RECORD_LAYOUT
/begin FUNCTION LACO_Lambda_adaptation "Lambda_adaptation"
 /begin DEF_CHARACTERISTIC ldp_mff_delta_add_lam_ad_t_pri ldp_fac_delta_l_rng_lam_ad_pri ldp_fac_delta_h_rng_lam_ad_pri c_t_pri_max_lam_ad c_n_tol_add_rng_lam_ad c_n_tol_fac_l_rng_lam_ad c_n_bol_fac_l_rng_lam_ad c_n_bol_fac_h_rng_lam_ad c_n_tol_fac_h_rng_lam_ad id_t_pri_fac_l_rng_lam_ad id_t_pri_mff_add_rng_lam_ad ip_fac_n_mff_add_lam_ad ip_fac_n_fac_lam_ad ip_fac_wup_fac_lam_ad c_mff_sp_tol_add_rng_lam_ad c_fac_min_l_rng_lam_ad c_fac_max_l_rng_lam_ad c_fac_max_h_rng_lam_ad c_mff_min_add_rng_lam_ad c_mff_max_add_rng_lam_ad lc_fac_l_rng_afs_req_lam_ad lc_fac_h_rng_afs_req_lam_ad lc_mff_add_rng_afs_req_lam_ad c_fac_min_h_rng_lam_ad ip_fac_wup_mff_add_lam_ad ldp_mff_add_lam_ad_ip_fac_wup id_t_pri_fac_h_rng_lam_ad ip_mff_sp_max_fac_l_rng_lam_ad ip_mff_sp_min_fac_h_rng_lam_ad ldp_n_32_id_mff_sp_bol_h_rng ldp_n_32_id_mff_sp_bol_l_rng ldp_n_32_id_mff_sp_tol_l_rng ldp_n_32_id_mff_sp_tol_h_rng id_mff_sp_bol_fac_h_rng_lam_ad id_mff_sp_bol_fac_l_rng_lam_ad id_mff_sp_tol_fac_l_rng_lam_ad id_mff_sp_tol_fac_h_rng_lam_ad ldp_fac_lam_ad_ip_fac_wup_fac /end DEF_CHARACTERISTIC
 /begin OUT_MEASUREMENT lv_lam_ad_cdn lv_lam_ad_end lv_lam_ad_afs_req lv_lam_ad_stop_cbk_ex t_pri_tot_lam_ad laco[0].laco_struct_ispclada0.mff_lam_add_lam_ad_out laco[0].laco_struct_ispclada0.fac_lam_ad_lam_out laco[0].laco_struct_ispclada0.fac_mff_add_lam_ad_out laco[0].laco_struct_ispclada0.mff_add_lam_ad laco[0].laco_struct_ispclada0.mff_delta_add_lam_ad laco[0].laco_struct_ispclada0.mff_delta_add_lam_ad_h_res laco[0].laco_struct_ispclada0.fac_lam_ad laco[0].laco_struct_ispclada0.fac_l_rng_lam_ad laco[0].laco_struct_ispclada0.fac_h_rng_lam_ad laco[0].laco_struct_ispclada0.fac_delta_l_rng_lam_ad laco[0].laco_struct_ispclada0.fac_delta_h_rng_lam_ad laco[0].laco_struct_ispclada0.fac_lam_adj_lam_ad laco[0].laco_struct_ispclada0.fac_mff_add_fac_lam_ad laco[0].laco_struct_ispclada0.t_pri_lam_ad laco[0].laco_struct_ispclada0.state_lam_ad laco[0].laco_struct_ispclada0.lv_fac_lam_adj_lam_ad laco[0].laco_struct_ispclada0.lv_lam_ad_stop laco[0].laco_struct_ispclada0.lv_fac_l_rng_lim_max_lam_ad laco[0].laco_struct_ispclada0.lv_fac_l_rng_lim_min_lam_ad laco[0].laco_struct_ispclada0.lv_fac_h_rng_lim_max_lam_ad laco[0].laco_struct_ispclada0.lv_fac_h_rng_lim_min_lam_ad laco[0].laco_struct_ispclada0.lv_mff_add_lim_max_lam_ad laco[0].laco_struct_ispclada0.lv_mff_add_lim_min_lam_ad laco[0].laco_struct_ispclada0.lv_fac_h_rng_lam_ad laco[0].laco_struct_ispclada0.lv_fac_l_rng_lam_ad laco[0].laco_struct_ispclada0.lv_mff_add_rng_lam_ad laco[0].laco_struct_ispclada0.t_wait_lam_ad laco[1].laco_struct_ispclada0.mff_lam_add_lam_ad_out laco[1].laco_struct_ispclada0.fac_lam_ad_lam_out laco[1].laco_struct_ispclada0.fac_mff_add_lam_ad_out laco[1].laco_struct_ispclada0.mff_add_lam_ad laco[1].laco_struct_ispclada0.mff_delta_add_lam_ad laco[1].laco_struct_ispclada0.mff_delta_add_lam_ad_h_res laco[1].laco_struct_ispclada0.fac_lam_ad laco[1].laco_struct_ispclada0.fac_l_rng_lam_ad laco[1].laco_struct_ispclada0.fac_h_rng_lam_ad laco[1].laco_struct_ispclada0.fac_delta_l_rng_lam_ad laco[1].laco_struct_ispclada0.fac_delta_h_rng_lam_ad laco[1].laco_struct_ispclada0.fac_lam_adj_lam_ad laco[1].laco_struct_ispclada0.fac_mff_add_fac_lam_ad laco[1].laco_struct_ispclada0.t_pri_lam_ad laco[1].laco_struct_ispclada0.state_lam_ad laco[1].laco_struct_ispclada0.lv_fac_lam_adj_lam_ad laco[1].laco_struct_ispclada0.lv_lam_ad_stop laco[1].laco_struct_ispclada0.lv_fac_l_rng_lim_max_lam_ad laco[1].laco_struct_ispclada0.lv_fac_l_rng_lim_min_lam_ad laco[1].laco_struct_ispclada0.lv_fac_h_rng_lim_max_lam_ad laco[1].laco_struct_ispclada0.lv_fac_h_rng_lim_min_lam_ad laco[1].laco_struct_ispclada0.lv_mff_add_lim_max_lam_ad laco[1].laco_struct_ispclada0.lv_mff_add_lim_min_lam_ad laco[1].laco_struct_ispclada0.lv_fac_h_rng_lam_ad laco[1].laco_struct_ispclada0.lv_fac_l_rng_lam_ad laco[1].laco_struct_ispclada0.lv_mff_add_rng_lam_ad laco[1].laco_struct_ispclada0.t_wait_lam_ad /end OUT_MEASUREMENT
/end FUNCTION
/begin FUNCTION LACO_MV_CLC_limited_dynamics "MV_CLC_limited_dynamics"
 /begin DEF_CHARACTERISTIC c_crlc_n_mmv_ldc c_crlc_maf_mmv_ldc c_crlc_fac_tq_req_mmv_ldc /end DEF_CHARACTERISTIC
 /begin OUT_MEASUREMENT n_delta_ldc maf_delta_ldc maf_mmv_ldc n_mmv_ldc fac_tq_req_delta_ldc fac_tq_req_mmv_ldc laco[0].laco_struct_ispclmvldc0.fac_lam_mv_delta_ldc laco[1].laco_struct_ispclmvldc0.fac_lam_mv_delta_ldc /end OUT_MEASUREMENT
/end FUNCTION
/begin FUNCTION LACO_Lambda_CTL_WRAF_SENS "Lambda_CTL_WRAF_SENS"
 /begin DEF_CHARACTERISTIC ip_fac_gain_p_lam ip_fac_gain_i_lam ip_fac_gain_i2_lam ip_fac_gain_d_lam ip_fac_gain_p_lam_gain_swi ip_fac_gain_i_lam_gain_swi ip_fac_gain_i2_lam_gain_swi ip_fac_gain_d_lam_gain_swi id_tco_min_lam_lscl_is c_crlc_fac_lam_mv_mmv id_t_max_lscl_act_tco c_fac_lam_p_max_lam c_fac_lam_p_min_lam c_fac_lam_p_max_lam_cp c_fac_lam_i_i2_sum_min_lam c_fac_lam_i_i2_sum_max_lam c_fac_lam_i_i2_sum_min_lam_cp c_fac_lam_i_i2_sum_max_lam_cp c_fac_lam_d_min_lam c_n_min_lam_lscl c_fac_lam_delta_lscl_off lc_lam_i2_act id_tco_min_lam_lscl c_fac_lam_p_min_lam_cp c_fac_lam_out_min c_fac_lam_out_min_cp c_fac_lam_out_max c_fac_lam_out_max_cp c_crlc_fac_lam_mv ip_fac_lam_max_not_stat_cdn ip_fac_lam_min_not_stat_cdn ldp_maf_int_puc_ip_lamb_sp_the ip_lamb_sp_the_puc id_t_ast_min_lscl_act c_crlc_vls_down_mmv_lam c_vls_down_thd_afl_lam c_vls_down_thd_afr_lam c_tout_i_i2_shift_vld c_crlc_fac_dif_lam_in_mmv c_crlc_fac_lam_mv_mmv_ldc c_crlc_fac_lam_mv_mmv_ldc_diag ip_fac_eg_dly[0] ip_fac_eg_dly[1] ip_t1_lsl_up[0] ip_t1_lsl_up[1] c_fac_lam_d_max_lam c_fac_lam_out_max_err_susp c_fac_lam_out_min_err_susp ip_t1_lsl_up_fac_ipt[0] ip_t1_lsl_up_fac_ipt[1] ip_fac_eg_dly_fac_ipt[0] ip_fac_eg_dly_fac_ipt[1] /end DEF_CHARACTERISTIC
 /begin OUT_MEASUREMENT laco[0].laco_struct_reqgnlaco0.fac_dif_sum_lam_in laco[0].laco_struct_reqgnlaco0.fac_lam_i_it_lim laco[0].laco_struct_reqgnlaco0.fac_dif_sum_lim_lam_in laco[0].laco_struct_reqgnlaco0.fac_dif_sum_lam_in_save laco[0].laco_struct_reqgnlaco0.fac_dif_lam_in_mmv laco[0].laco_struct_reqgnlaco0.fac_lam_i_it laco[0].laco_struct_reqgnlaco0.fac_lam_pctl laco[0].laco_struct_reqgnlaco0.fac_lam_out laco[0].laco_struct_reqgnlaco0.fac_dif_lam_in laco[0].laco_struct_reqgnlaco0.fac_lam_i laco[0].laco_struct_reqgnlaco0.fac_lam_i2 laco[0].laco_struct_reqgnlaco0.fac_lam_i2_lim laco[0].laco_struct_reqgnlaco0.fac_lam_i_i2_sum_lim laco[0].laco_struct_reqgnlaco0.fac_lam_p_lim laco[0].laco_struct_reqgnlaco0.fac_lam_d_lim laco[0].laco_struct_reqgnlaco0.fac_lam_mv laco[0].laco_struct_reqgnlaco0.fac_lam_mv_mmv laco[0].laco_struct_reqgnlaco0.fac_lam_mv_mmv_cp laco[0].laco_struct_reqgnlaco0.fac_lam_mv_mmv_ldc laco[0].laco_struct_reqgnlaco0.fac_lam_mv_mmv_ldc_diag laco[0].laco_struct_reqgnlaco0.fac_lam_max_not_stat_cdn laco[0].laco_struct_reqgnlaco0.fac_lam_min_not_stat_cdn laco[0].laco_struct_reqgnlaco0.fac_lam_cor laco[0].laco_struct_reqgnlaco0.fac_lam_delta_i_i2_shift laco[0].laco_struct_reqgnlaco0.fac_lam_lim laco[0].laco_struct_reqgnlaco0.crlc_lsl_mdl laco[0].laco_struct_reqgnlaco0.fac_gain_p_lam laco[0].laco_struct_reqgnlaco0.fac_gain_i_lam laco[0].laco_struct_reqgnlaco0.fac_gain_i2_lam laco[0].laco_struct_reqgnlaco0.fac_gain_d_lam laco[0].laco_struct_reqgnlaco0.lamb_sp_fil_hom laco[0].laco_struct_reqgnlaco0.lamb_sp_pctl laco[0].laco_struct_reqgnlaco0.lamb_sp_fil_s laco[0].laco_struct_reqgnlaco0.lamb_sp_lsl_mdl_in_hom laco[0].laco_struct_reqgnlaco0.lamb_sp_lsl_mdl_out_hom laco[0].laco_struct_reqgnlaco0.lamb_sp_lsl_mdl_out_s laco[0].laco_struct_reqgnlaco0.lamb_cor_av_lam laco[0].laco_struct_reqgnlaco0.t1_lsl_up laco[0].laco_struct_reqgnlaco0.t_dly_soi_lsl_pos laco[0].laco_struct_reqgnlaco0.tout_i_i2_shift_vld_afl laco[0].laco_struct_reqgnlaco0.tout_i_i2_shift_vld_afr laco[0].laco_struct_reqgnlaco0.vls_down_mmv_lam laco[0].laco_struct_reqgnlaco0.mff_add_lam_ad_out laco[0].laco_struct_reqgnlaco0.fac_lam_ad_out laco[0].laco_struct_reqgnlaco0.ctr_raf_chg laco[0].laco_struct_reqgnlaco0.state_lam laco[0].laco_struct_reqgnlaco0.fac_eg_dly laco[0].laco_struct_reqgnlaco0.lv_lam_lscl laco[0].laco_struct_reqgnlaco0.lv_fac_lam_lim_not_stat_cdn laco[0].laco_struct_reqgnlaco0.lv_t_max_lscl_act_tco laco[0].laco_struct_reqgnlaco0.lv_fac_lam_adj_lam_ad_end laco[0].laco_struct_reqgnlaco0.lv_fac_lam_shift_cp_end laco[0].laco_struct_reqgnlaco0.lv_fac_lam_diagcp_end laco[0].laco_struct_reqgnlaco0.lv_fac_lam_lim_max laco[0].laco_struct_reqgnlaco0.lv_fac_lam_lim_min laco[0].laco_struct_reqgnlaco0.lv_vls_down_thd_afl_lam laco[0].laco_struct_reqgnlaco0.lv_vls_down_thd_afr_lam laco[0].laco_struct_reqgnlaco0.lv_vls_down_thd_afr_lam_old laco[0].laco_struct_reqgnlaco0.lv_vls_down_thd_afl_lam_old laco[1].laco_struct_reqgnlaco0.fac_dif_sum_lam_in laco[1].laco_struct_reqgnlaco0.fac_lam_i_it_lim laco[1].laco_struct_reqgnlaco0.fac_dif_sum_lim_lam_in laco[1].laco_struct_reqgnlaco0.fac_dif_sum_lam_in_save laco[1].laco_struct_reqgnlaco0.fac_dif_lam_in_mmv laco[1].laco_struct_reqgnlaco0.fac_lam_i_it laco[1].laco_struct_reqgnlaco0.fac_lam_pctl laco[1].laco_struct_reqgnlaco0.fac_lam_out laco[1].laco_struct_reqgnlaco0.fac_dif_lam_in laco[1].laco_struct_reqgnlaco0.fac_lam_i laco[1].laco_struct_reqgnlaco0.fac_lam_i2 laco[1].laco_struct_reqgnlaco0.fac_lam_i2_lim laco[1].laco_struct_reqgnlaco0.fac_lam_i_i2_sum_lim laco[1].laco_struct_reqgnlaco0.fac_lam_p_lim laco[1].laco_struct_reqgnlaco0.fac_lam_d_lim laco[1].laco_struct_reqgnlaco0.fac_lam_mv laco[1].laco_struct_reqgnlaco0.fac_lam_mv_mmv laco[1].laco_struct_reqgnlaco0.fac_lam_mv_mmv_cp laco[1].laco_struct_reqgnlaco0.fac_lam_mv_mmv_ldc laco[1].laco_struct_reqgnlaco0.fac_lam_mv_mmv_ldc_diag laco[1].laco_struct_reqgnlaco0.fac_lam_max_not_stat_cdn laco[1].laco_struct_reqgnlaco0.fac_lam_min_not_stat_cdn laco[1].laco_struct_reqgnlaco0.fac_lam_cor laco[1].laco_struct_reqgnlaco0.fac_lam_delta_i_i2_shift laco[1].laco_struct_reqgnlaco0.fac_lam_lim laco[1].laco_struct_reqgnlaco0.crlc_lsl_mdl laco[1].laco_struct_reqgnlaco0.fac_gain_p_lam laco[1].laco_struct_reqgnlaco0.fac_gain_i_lam laco[1].laco_struct_reqgnlaco0.fac_gain_i2_lam laco[1].laco_struct_reqgnlaco0.fac_gain_d_lam laco[1].laco_struct_reqgnlaco0.lamb_sp_fil_hom laco[1].laco_struct_reqgnlaco0.lamb_sp_pctl laco[1].laco_struct_reqgnlaco0.lamb_sp_fil_s laco[1].laco_struct_reqgnlaco0.lamb_sp_lsl_mdl_in_hom laco[1].laco_struct_reqgnlaco0.lamb_sp_lsl_mdl_out_hom laco[1].laco_struct_reqgnlaco0.lamb_sp_lsl_mdl_out_s laco[1].laco_struct_reqgnlaco0.lamb_cor_av_lam laco[1].laco_struct_reqgnlaco0.t1_lsl_up laco[1].laco_struct_reqgnlaco0.t_dly_soi_lsl_pos laco[1].laco_struct_reqgnlaco0.tout_i_i2_shift_vld_afl laco[1].laco_struct_reqgnlaco0.tout_i_i2_shift_vld_afr laco[1].laco_struct_reqgnlaco0.vls_down_mmv_lam laco[1].laco_struct_reqgnlaco0.mff_add_lam_ad_out laco[1].laco_struct_reqgnlaco0.fac_lam_ad_out laco[1].laco_struct_reqgnlaco0.ctr_raf_chg laco[1].laco_struct_reqgnlaco0.state_lam laco[1].laco_struct_reqgnlaco0.fac_eg_dly laco[1].laco_struct_reqgnlaco0.lv_lam_lscl laco[1].laco_struct_reqgnlaco0.lv_fac_lam_lim_not_stat_cdn laco[1].laco_struct_reqgnlaco0.lv_t_max_lscl_act_tco laco[1].laco_struct_reqgnlaco0.lv_fac_lam_adj_lam_ad_end laco[1].laco_struct_reqgnlaco0.lv_fac_lam_shift_cp_end laco[1].laco_struct_reqgnlaco0.lv_fac_lam_diagcp_end laco[1].laco_struct_reqgnlaco0.lv_fac_lam_lim_max laco[1].laco_struct_reqgnlaco0.lv_fac_lam_lim_min laco[1].laco_struct_reqgnlaco0.lv_vls_down_thd_afl_lam laco[1].laco_struct_reqgnlaco0.lv_vls_down_thd_afr_lam laco[1].laco_struct_reqgnlaco0.lv_vls_down_thd_afr_lam_old laco[1].laco_struct_reqgnlaco0.lv_vls_down_thd_afl_lam_old lv_lam_i2_act mff_add_cp /end OUT_MEASUREMENT
/end FUNCTION
/begin FUNCTION LACO_Trim_CTL_lin_lambda_CTL "Trim_CTL_lin_lambda_CTL"
 /begin DEF_CHARACTERISTIC c_temp_cat_min_lam_adj_act ip_maf_min_lam_adj_i_act ip_maf_max_lam_adj_i_act ldp_maf_hb_ip_vls_sp_lam_adj ldp_n_32_ip_vls_sp_lam_adj ip_lamb_delta_p_lam_adj ip_lamb_delta_i_lam_adj c_lamb_delta_i_min_lam_adj c_lamb_delta_i_max_lam_adj c_crlc_lamb_delta_i_mmv_lam_adj c_eff_cat_diag_max_lam_adj_act c_maf_int_lam_adj_i_act_slow c_maf_int_lam_adj_p_act_slow c_maf_int_lam_adj_i_act_fast[0] c_maf_int_lam_adj_i_act_fast[1] c_maf_int_lam_adj_i_act_purge[0] c_maf_int_lam_adj_i_act_purge[1] c_maf_int_lam_adj_p_act_fast[0] c_maf_int_lam_adj_p_act_fast[1] c_maf_int_lam_adj_p_act_purge[0] c_maf_int_lam_adj_p_act_purge[1] lc_lam_adj_i_save_cat_diag c_tco_lam_adj_p_act_hst c_t_ast_lam_adj_p_act_hst c_lamb_sp_min_lam_adj_act c_lamb_sp_max_lam_adj_act c_maf_int_lam_adj_d_act_fast[0] c_maf_int_lam_adj_d_act_fast[1] c_maf_int_lam_adj_d_act_purge[0] c_maf_int_lam_adj_d_act_purge[1] c_maf_int_lam_adj_d_act_slow c_maf_max_lam_adj_p_act c_maf_max_lam_adj_d_act c_maf_min_lam_adj_p_act c_maf_min_lam_adj_d_act c_n_max_lam_adj_p_act c_n_max_lam_adj_d_act c_n_min_lam_adj_p_act c_n_min_lam_adj_d_act lc_lamb_pls_not_chk_lam_adj lc_lam_adj_ldc_not_chk ip_fac_add_lamb_delta_d ip_fac_add_lamb_delta_p ldp_vls_dif_delta_ip_lamb_d ip_lamb_delta_d_lam_adj ip_lamb_delta_i_lam_adj_diag ip_lamb_delta_p_lam_adj_diag ip_vls_sp_delta_lam_adj ip_crlc_vls_dif_mmv_lam_adj ip_crlc_lamb_delta_i_lam_adj[0] ip_crlc_lamb_delta_i_lam_adj[1] ip_fac_lamb_delta_d_lam_adj[0] ip_fac_lamb_delta_d_lam_adj[1] ip_fac_lamb_delta_p_lam_adj[0] ip_fac_lamb_delta_p_lam_adj[1] ip_vls_sp_lam_adj[0] ip_vls_sp_lam_adj[1] ldp_tco_st_1_egcp lc_var_ex_cus /end DEF_CHARACTERISTIC
 /begin OUT_MEASUREMENT laco[0].laco_struct_reqgntrim0.lamb_delta_i_mmv_lam_adj laco[0].laco_struct_reqgntrim0.lamb_delta_lam_adj laco[0].laco_struct_reqgntrim0.lamb_delta_p_lam_adj laco[0].laco_struct_reqgntrim0.lamb_delta_i_lam_adj laco[0].laco_struct_reqgntrim0.lamb_delta_i_save_lam_adj laco[0].laco_struct_reqgntrim0.vls_dif_lam_adj laco[0].laco_struct_reqgntrim0.vls_dif_mmv_lam_adj laco[0].laco_struct_reqgntrim0.vls_dif_delta_lam_adj laco[0].laco_struct_reqgntrim0.lamb_delta_d_lam_adj laco[0].laco_struct_reqgntrim0.maf_int_lam_adj_act laco[0].laco_struct_reqgntrim0.vls_sp_lam_adj laco[0].laco_struct_reqgntrim0.maf_int_min_lam_adj_p_act laco[0].laco_struct_reqgntrim0.maf_int_min_lam_adj_i_act laco[0].laco_struct_reqgntrim0.maf_int_min_lam_adj_d_act laco[0].laco_struct_reqgntrim0.lv_lam_adj_act laco[0].laco_struct_reqgntrim0.lv_lam_adj_i_act laco[0].laco_struct_reqgntrim0.lv_lam_adj_p_act laco[0].laco_struct_reqgntrim0.lv_lam_adj_ad_end laco[0].laco_struct_reqgntrim0.lv_lam_adj_d_act laco[1].laco_struct_reqgntrim0.lamb_delta_i_mmv_lam_adj laco[1].laco_struct_reqgntrim0.lamb_delta_lam_adj laco[1].laco_struct_reqgntrim0.lamb_delta_p_lam_adj laco[1].laco_struct_reqgntrim0.lamb_delta_i_lam_adj laco[1].laco_struct_reqgntrim0.lamb_delta_i_save_lam_adj laco[1].laco_struct_reqgntrim0.vls_dif_lam_adj laco[1].laco_struct_reqgntrim0.vls_dif_mmv_lam_adj laco[1].laco_struct_reqgntrim0.vls_dif_delta_lam_adj laco[1].laco_struct_reqgntrim0.lamb_delta_d_lam_adj laco[1].laco_struct_reqgntrim0.maf_int_lam_adj_act laco[1].laco_struct_reqgntrim0.vls_sp_lam_adj laco[1].laco_struct_reqgntrim0.maf_int_min_lam_adj_p_act laco[1].laco_struct_reqgntrim0.maf_int_min_lam_adj_i_act laco[1].laco_struct_reqgntrim0.maf_int_min_lam_adj_d_act laco[1].laco_struct_reqgntrim0.lv_lam_adj_act laco[1].laco_struct_reqgntrim0.lv_lam_adj_i_act laco[1].laco_struct_reqgntrim0.lv_lam_adj_p_act laco[1].laco_struct_reqgntrim0.lv_lam_adj_ad_end laco[1].laco_struct_reqgntrim0.lv_lam_adj_d_act /end OUT_MEASUREMENT
/end FUNCTION
/begin FUNCTION LACO_Linear_lambda_CTL__AI "Linear_lambda_CTL__AI"
 /begin DEF_CHARACTERISTIC c_lam_maf_min_hys lc_lam_gain_swi lc_hom_act_comp lc_lam_off_sawup lc_lamb_cop_off ip_lam_maf_min ldp_n_lam_maf_min c_n_dyw_lam_not_stat c_maf_dyw_lam_not_stat c_maf_int_lam_not_stat c_lamb_sp_afr_thd c_lamb_sp_afl_thd c_lamb_sp_afr_thd_hys c_lamb_sp_afl_thd_hys c_lamb_dif_av_ctl_st_max c_lamb_dif_av_ctl_st_max_is c_lamb_dif_av_ctl_st_min c_lamb_dif_av_ctl_st_min_is c_lgrd_lamb_dif_av_ctl_st c_fac_tq_req_dyw_lam_not_stat ldp_wgpwm_id_fac_ipt_sens_mdl id_fac_ipt_sens_mdl_1 id_fac_ipt_sens_mdl_2 /end DEF_CHARACTERISTIC
 /begin OUT_MEASUREMENT laco[0].laco_struct_reqgnlacoi0.lamb_sp_delta_lam laco[0].laco_struct_reqgnlacoi0.lamb_av_delta_lam laco[0].laco_struct_reqgnlacoi0.lv_inh_lscl laco[0].laco_struct_reqgnlacoi0.lv_lam_stop_req laco[0].laco_struct_reqgnlacoi0.lv_state_ls_opl_err laco[0].laco_struct_reqgnlacoi0.lv_lam_stop_sho_per_req laco[0].laco_struct_reqgnlacoi0.fac_ipt_sens_mdl laco[1].laco_struct_reqgnlacoi0.lamb_sp_delta_lam laco[1].laco_struct_reqgnlacoi0.lamb_av_delta_lam laco[1].laco_struct_reqgnlacoi0.lv_inh_lscl laco[1].laco_struct_reqgnlacoi0.lv_lam_stop_req laco[1].laco_struct_reqgnlacoi0.lv_state_ls_opl_err laco[1].laco_struct_reqgnlacoi0.lv_lam_stop_sho_per_req laco[1].laco_struct_reqgnlacoi0.fac_ipt_sens_mdl lv_lam_gain_swi n_ofs_lam_not_stat maf_ofs_lam_not_stat maf_int_lam_not_stat fac_neut_not_stat_cdn lv_lamb_sp_afr_thd[0] lv_lamb_sp_afr_thd[1] lv_lamb_sp_afl_thd[0] lv_lamb_sp_afl_thd[1] lgrd_lamb_dif_av_ctl_st_in lamb_dif_av_ctl_st_in[0] lamb_dif_av_ctl_st_in[1] lamb_dif_av_ctl_st_out[0] lamb_dif_av_ctl_st_out[1] lv_clc_lamb_dif_av_st lv_maf_int_min_lam_reac_swi fac_tq_req_ofs_lam_not_stat /end OUT_MEASUREMENT
/end FUNCTION
/begin FUNCTION LACO_Trim_CTL_lin_lambda_CTL__AI "Trim_CTL_lin_lambda_CTL__AI"
 /begin DEF_CHARACTERISTIC id_crlc_vls_down_t_dly lc_lamb_delta_ad_lam_adj_ext ip_vls_delta_lam_adj_cat_diag ldp_t_sum_afl_afr_ip_crlc_vls ip_crlc_vls_lam_adj_cat_diag id_t_dly_lam_ad_1 id_t_dly_lam_ad_2 lc_lam_adj_act_fast_lam_lscl /end DEF_CHARACTERISTIC
 /begin OUT_MEASUREMENT laco[0].laco_struct_reqgntrimi0.fac_lam_mv_ofs_ldc_lam_adj laco[0].laco_struct_reqgntrimi0.maf_ofs_ldc_lam_adj laco[0].laco_struct_reqgntrimi0.n_ofs_ldc_lam_adj laco[0].laco_struct_reqgntrimi0.vls_av_lam_adj laco[0].laco_struct_reqgntrimi0.vls_delta_lam_adj_cat_diag laco[0].laco_struct_reqgntrimi0.maf_int_ldc_lam_adj laco[0].laco_struct_reqgntrimi0.vls_av_tmp_lam_adj laco[0].laco_struct_reqgntrimi0.pv_av_ofs_ldc_lam_adj laco[0].laco_struct_reqgntrimi0.lv_ldc_lam_adj laco[0].laco_struct_reqgntrimi0.lv_inh_lam_adj laco[0].laco_struct_reqgntrimi0.lv_inh_lam_adj_err laco[0].laco_struct_reqgntrimi0.lv_lamb_delta_i_lam_adj_deac laco[0].laco_struct_reqgntrimi0.lv_lamb_delta_ad_lam_adj_clc laco[0].laco_struct_reqgntrimi0.lv_lam_adj_act_fast_lam_lscl laco[1].laco_struct_reqgntrimi0.fac_lam_mv_ofs_ldc_lam_adj laco[1].laco_struct_reqgntrimi0.maf_ofs_ldc_lam_adj laco[1].laco_struct_reqgntrimi0.n_ofs_ldc_lam_adj laco[1].laco_struct_reqgntrimi0.vls_av_lam_adj laco[1].laco_struct_reqgntrimi0.vls_delta_lam_adj_cat_diag laco[1].laco_struct_reqgntrimi0.maf_int_ldc_lam_adj laco[1].laco_struct_reqgntrimi0.vls_av_tmp_lam_adj laco[1].laco_struct_reqgntrimi0.pv_av_ofs_ldc_lam_adj laco[1].laco_struct_reqgntrimi0.lv_ldc_lam_adj laco[1].laco_struct_reqgntrimi0.lv_inh_lam_adj laco[1].laco_struct_reqgntrimi0.lv_inh_lam_adj_err laco[1].laco_struct_reqgntrimi0.lv_lamb_delta_i_lam_adj_deac laco[1].laco_struct_reqgntrimi0.lv_lamb_delta_ad_lam_adj_clc laco[1].laco_struct_reqgntrimi0.lv_lam_adj_act_fast_lam_lscl lv_lamb_delta_ad_lam_adj_ext /end OUT_MEASUREMENT
/end FUNCTION
/begin FUNCTION LACO_Lambda_adaptation__AI "Lambda_adaptation__AI"
 /begin DEF_CHARACTERISTIC c_tco_min_lam_ad c_tia_max_lam_ad c_crlc_lam_ad_l c_crlc_lam_ad_h c_n_dyw_ldc_lam_ad c_maf_dyw_ldc_lam_ad c_fac_lam_mv_dyw_ldc_lam_ad c_maf_int_ldc_lam_ad c_lamb_sp_ad_min_h c_lamb_sp_ad_max_h c_lamb_sp_ad_min_l c_lamb_sp_ad_max_l c_lamb_sp_ad_min_add c_tco_min_lam_ad_wup c_tco_max_lam_ad_wup c_maf_kgh_max_lam_ad c_maf_kgh_min_lam_ad_wup c_maf_kgh_max_lam_ad_wup c_lamb_sp_ad_max_add lc_lam_ad_wup_deac c_crlc_lam_ad_add c_tam_min_lam_ad c_amp_min_lam_ad c_fup_min_lam_ad c_fup_max_lam_ad lc_lam_ad_wup_add_rng_cdn lc_lam_ad_wup_l_rng_cdn c_crlc_lam_ad_add_lam_lim c_crlc_lam_ad_l_lam_lim c_crlc_lam_ad_h_lam_lim c_t_wait_max_lam_ad c_t_wait_max_lam_ad_h_rng c_t_wait_max_lam_ad_l_rng c_t_wait_max_lam_ad_add c_wgpwm_min_lam_ad lc_wgpwm_inh_lam_ad_ena /end DEF_CHARACTERISTIC
 /begin OUT_MEASUREMENT laco[0].laco_struct_ispcladapi0.maf_ofs_ldc_lam_ad laco[0].laco_struct_ispcladapi0.fac_lam_mv_ofs_ldc_lam_ad laco[0].laco_struct_ispcladapi0.n_ofs_ldc_lam_ad laco[0].laco_struct_ispcladapi0.maf_int_ldc_lam_ad laco[0].laco_struct_ispcladapi0.crlc_lam_ad laco[0].laco_struct_ispcladapi0.t_wait_max_lam_ad laco[0].laco_struct_ispcladapi0.lv_lam_ad_act laco[0].laco_struct_ispcladapi0.lv_ldc_lam_ad laco[0].laco_struct_ispcladapi0.lv_lam_ad_act_err laco[0].laco_struct_ispcladapi0.lv_lam_ad_deac_err laco[0].laco_struct_ispcladapi0.pv_av_ofs_ldc_lam_ad laco[0].laco_struct_ispcladapi0.lv_lam_ad_wup_act laco[0].laco_struct_ispcladapi0.lv_lam_ad_cdn_h_rng laco[0].laco_struct_ispcladapi0.lv_lam_ad_cdn_l_rng laco[0].laco_struct_ispcladapi0.lv_lam_ad_cdn_add laco[0].laco_struct_ispcladapi0.mff_sp_ad laco[1].laco_struct_ispcladapi0.maf_ofs_ldc_lam_ad laco[1].laco_struct_ispcladapi0.fac_lam_mv_ofs_ldc_lam_ad laco[1].laco_struct_ispcladapi0.n_ofs_ldc_lam_ad laco[1].laco_struct_ispcladapi0.maf_int_ldc_lam_ad laco[1].laco_struct_ispcladapi0.crlc_lam_ad laco[1].laco_struct_ispcladapi0.t_wait_max_lam_ad laco[1].laco_struct_ispcladapi0.lv_lam_ad_act laco[1].laco_struct_ispcladapi0.lv_ldc_lam_ad laco[1].laco_struct_ispcladapi0.lv_lam_ad_act_err laco[1].laco_struct_ispcladapi0.lv_lam_ad_deac_err laco[1].laco_struct_ispcladapi0.pv_av_ofs_ldc_lam_ad laco[1].laco_struct_ispcladapi0.lv_lam_ad_wup_act laco[1].laco_struct_ispcladapi0.lv_lam_ad_cdn_h_rng laco[1].laco_struct_ispcladapi0.lv_lam_ad_cdn_l_rng laco[1].laco_struct_ispcladapi0.lv_lam_ad_cdn_add laco[1].laco_struct_ispcladapi0.mff_sp_ad /end OUT_MEASUREMENT
/end FUNCTION
/end MODULE
/end PROJECT
