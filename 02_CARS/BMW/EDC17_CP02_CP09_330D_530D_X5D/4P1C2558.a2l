ASAP2_VERSION 1 4
/begin PROJECT P_558 "EDC17_CP02"
/begin HEADER "" VERSION "V1C1" PROJECT_NO P_558 /end HEADER
/begin MODULE DIM ""
/begin MOD_COMMON "" BYTE_ORDER MSB_LAST ALIGNMENT_BYTE 1 ALIGNMENT_WORD 2 ALIGNMENT_LONG 4 ALIGNMENT_FLOAT32_IEEE 4 /end MOD_COMMON
/begin CHARACTERISTIC ActMod_trqClthWoDstC_C "" VALUE 0x8007DC9A Val_Ws16 6553.500 Trq -3276.800 3276.700 FORMAT "%8.3" /end CHARACTERISTIC
/begin CHARACTERISTIC Eng_stStopEna_C "" VALUE 0x8007DC9C Val_Wu8 255.0 OneToOne 0.00 255.0 FORMAT "%5.1" /end CHARACTERISTIC
/begin CHARACTERISTIC Eng_stStrtEna_C "" VALUE 0x8007DC9D Val_Wu8 255.0 OneToOne 0.00 255.0 FORMAT "%5.1" /end CHARACTERISTIC
/begin CHARACTERISTIC Exh_numCntBckPPFltUs_C "" VALUE 0x800683AC Val_Ws16 65535.00 OneToOne -32768.00 32767.00 FORMAT "%8.2" /end CHARACTERISTIC
/begin CHARACTERISTIC Exh_numCntMaxPPFltUs_C "" VALUE 0x800683AE Val_Ws16 65535.00 OneToOne -32768.00 32767.00 FORMAT "%8.2" /end CHARACTERISTIC
/begin CHARACTERISTIC Exh_numFldPPFltUs_C "" VALUE 0x800683B0 Val_Ws16 65535.00 OneToOne -32768.00 32767.00 FORMAT "%8.2" /end CHARACTERISTIC
/begin CHARACTERISTIC Exh_pTransfPPFltUs_CUR "" CURVE 0x8006839E Cur_Xs16Ws16 3500.000 Pres_hPa 0.00 3500.000 FORMAT "%8.3" EXTENDED_LIMITS -32768.00 32767.00
 /begin AXIS_DESCR STD_AXIS Exh_uRawPPFltUs Volt 2 0.00 5200.000 FORMAT "%8.3" EXTENDED_LIMITS -6553.600 6553.400 DEPOSIT ABSOLUTE /end AXIS_DESCR
/end CHARACTERISTIC
/begin CHARACTERISTIC Exh_RmpSlpPPFltUs.Pos_C "/" VALUE 0x800683B4 Kw_Ws32 32767999.9847 RmpPres_hPa 0.00 32767999.9847 FORMAT "%13.4" EXTENDED_LIMITS -32768000.0000 32767999.9847 /end CHARACTERISTIC
/begin CHARACTERISTIC Exh_RmpSlpPPFltUs.Neg_C "/" VALUE 0x800683B8 Kw_Ws32 32767999.9847 RmpPres_hPa 0.00 32767999.9847 FORMAT "%13.4" EXTENDED_LIMITS -32768000.0000 32767999.9847 /end CHARACTERISTIC
/begin CHARACTERISTIC Exh_SRCPPFltUs.uMin_C "/" VALUE 0x800683A8 Val_Ws16 5200.000 Volt 0.00 5200.000 FORMAT "%8.3" EXTENDED_LIMITS -6553.600 6553.400 /end CHARACTERISTIC
/begin CHARACTERISTIC Exh_SRCPPFltUs.uMax_C "/" VALUE 0x800683AA Val_Ws16 13107.00 Volt -6553.600 6553.400 FORMAT "%8.3" /end CHARACTERISTIC
/begin CHARACTERISTIC Exh_swtDflPPFltUs_C "" VALUE 0x800683BC Val_Wu8 255.0 OneToOne 0.00 255.0 FORMAT "%5.1" /end CHARACTERISTIC
/begin CHARACTERISTIC Exh_swtEnvTPPFltUs_C "" VALUE 0x800683BD Val_Wu8 1.000 OneToOne 0.00 1.000 FORMAT "%5.3" EXTENDED_LIMITS 0.00 255.0 /end CHARACTERISTIC
/begin CHARACTERISTIC Exh_swtSensCfgPPFlt_C "" VALUE 0x800683BE Val_Wu8 255.0 OneToOne 0.00 255.0 FORMAT "%5.1" /end CHARACTERISTIC
/begin CHARACTERISTIC Exh_tFrzMinPPFltUs_C "" VALUE 0x800683C0 Val_Ws16 250.2000 Temp_Cels -50.14000 200.0600 FORMAT "%8.4" EXTENDED_LIMITS -3549.940 3003.560 /end CHARACTERISTIC
/begin CHARACTERISTIC Exh_tiPT1PPFltUs_C "" VALUE 0x800683C4 Val_Ws32 4294.9672940 TimeDelay_s 0.000002000000001 4294.9672960 FORMAT "%12.7" /end CHARACTERISTIC
/begin CHARACTERISTIC Exh_TrStgParPPFltUs.Dfl_C "/" VALUE 0x800683C8 Kw_Ws16 3500.0000 Pres_hPa 0.00 3500.0000 FORMAT "%8.4" EXTENDED_LIMITS -32768.00 32767.00 /end CHARACTERISTIC
/begin CHARACTERISTIC Exh_TrStgParPPFltUs.stSensId_C "/" VALUE 0x800683CA Kw_Wu8 255.0 OneToOne 0.00 255.0 FORMAT "%5.1" /end CHARACTERISTIC
/begin CHARACTERISTIC GbxNPos_st_C "" VALUE 0x8007DC9E Val_Wu8 255.0 OneToOne 0.00 255.0 FORMAT "%5.1" /end CHARACTERISTIC
/begin CHARACTERISTIC Gbx_bASTIntv_C "" VALUE 0x8007DC9F Val_Wu8 255.0 OneToOne 0.00 255.0 FORMAT "%5.1" /end CHARACTERISTIC
/begin CHARACTERISTIC Gbx_bASTNeutr_C "" VALUE 0x8007DCA0 Val_Wu8 255.0 OneToOne 0.00 255.0 FORMAT "%5.1" /end CHARACTERISTIC
/begin CHARACTERISTIC MeUn_dvolSet_C "Fernsteuerwert der Durchflussmenge der Zumesseinheit" VALUE 0x80069838 Val_Ws16 150000.0 Qp_mm3_sec 0.00 150000.0 FORMAT "%8.1" EXTENDED_LIMITS -327680.0 327670.0 /end CHARACTERISTIC
/begin CHARACTERISTIC MeUn_swtDvolSet_C "Schalter zur Fernsteuerung der Durchflussmenge der Zumesseinheit" VALUE 0x8006983A Val_Wu8 1.000 OneToOne 0.00 1.000 FORMAT "%5.3" EXTENDED_LIMITS 0.00 255.0 /end CHARACTERISTIC
/begin CHARACTERISTIC PCV_pSet_C "Fernsteuerwert des Drucks des Druckregelventils" VALUE 0x8006983C Val_Ws16 2000.000 Pres_Rail 0.00 2000.000 FORMAT "%5.3" EXTENDED_LIMITS -3276.800 3276.700 /end CHARACTERISTIC
/begin CHARACTERISTIC PCV_swtPSet_C "Schalter zur Fernsteuerung des Drucks des Druckregelventils" VALUE 0x8006983E Val_Wu8 1.000 OneToOne 0.00 1.000 FORMAT "%5.3" EXTENDED_LIMITS 0.00 255.0 /end CHARACTERISTIC
/begin CHARACTERISTIC PSPCtl_dvolBase_CUR "" CURVE 0x800683CC Cur_Xs16Ws16 300.0000 FlConsum_l_h 0.00 300.0000 FORMAT "%8.4" EXTENDED_LIMITS -327.6800 327.6700
 /begin AXIS_DESCR STD_AXIS Epm_nEng EngN 8 40.00000 6000.000 FORMAT "%8.3" EXTENDED_LIMITS -16384.00 16383.50 DEPOSIT ABSOLUTE /end AXIS_DESCR
/end CHARACTERISTIC
/begin CHARACTERISTIC PSPCtl_dvolMax_C "" VALUE 0x800683EE Val_Ws16 100.0000 FlConsum_l_h 0.00 100.0000 FORMAT "%8.4" EXTENDED_LIMITS -327.6800 327.6700 /end CHARACTERISTIC
/begin CHARACTERISTIC PSPCtl_dvolMin_C "" VALUE 0x800683F0 Val_Ws16 100.0000 FlConsum_l_h 0.00 100.0000 FORMAT "%8.4" EXTENDED_LIMITS -327.6800 327.6700 /end CHARACTERISTIC
/begin CHARACTERISTIC PSPCtl_dvolT15Delay_C "" VALUE 0x800683F2 Val_Ws16 100.0000 FlConsum_l_h 0.00 100.0000 FORMAT "%8.4" EXTENDED_LIMITS -327.6800 327.6700 /end CHARACTERISTIC
/begin CHARACTERISTIC PSPCtl_dvolTempLim_MAP "" MAP 0x800683F4 Map_Xs16Ys16Ws16 300.0000 FlConsum_l_h 0.00 300.0000 FORMAT "%8.4" EXTENDED_LIMITS -327.6800 327.6700
 /begin AXIS_DESCR STD_AXIS Epm_nEng EngN 6 40.00000 6000.000 FORMAT "%8.3" EXTENDED_LIMITS -16384.00 16383.50 DEPOSIT ABSOLUTE /end AXIS_DESCR
 /begin AXIS_DESCR STD_AXIS FuelT_t Temp_Cels 6 -50.14000 149.8600 FORMAT "%8.4" EXTENDED_LIMITS -3549.940 3003.560 DEPOSIT ABSOLUTE /end AXIS_DESCR
/end CHARACTERISTIC
/begin CHARACTERISTIC PSPCtl_facFuelTCor_CUR "" CURVE 0x80068458 Cur_Xs16Ws16 50.00000 Fact1 0.00 50.00000 FORMAT "%8.5" EXTENDED_LIMITS -256.0000 255.9922
 /begin AXIS_DESCR STD_AXIS FuelT_t Temp_Cels 2 -50.14000 149.8600 FORMAT "%8.4" EXTENDED_LIMITS -3549.940 3003.560 DEPOSIT ABSOLUTE /end AXIS_DESCR
/end CHARACTERISTIC
/begin CHARACTERISTIC PSPCtl_nLim_C "" VALUE 0x80068462 Val_Ws16 5960.000 EngN 40.00000 6000.000 FORMAT "%8.3" EXTENDED_LIMITS -16384.00 16383.50 /end CHARACTERISTIC
/begin CHARACTERISTIC PSPCtl_tiT15Delay_CUR "" CURVE 0x80068464 Cur_Xs16Ws16 655350.0 Time_ms -327680.0 327670.0 FORMAT "%8.1"
 /begin AXIS_DESCR STD_AXIS EngDa_tEng Temp_Cels 8 -50.14000 149.8600 FORMAT "%8.4" EXTENDED_LIMITS -3549.940 3003.560 DEPOSIT ABSOLUTE /end AXIS_DESCR
/end CHARACTERISTIC
/begin CHARACTERISTIC PSP_DigOut.tiBtwTstSCB_C "/" VALUE 0x80068486 Kw_Ws16 1000.000 Time_ms 0.00 1000.000 FORMAT "%8.3" EXTENDED_LIMITS -327680.0 327670.0 /end CHARACTERISTIC
/begin CHARACTERISTIC PSP_DigOut.tiBtwTstOT_C "/" VALUE 0x80068488 Kw_Ws16 1000.000 Time_s 0.00 1000.000 FORMAT "%8.3" EXTENDED_LIMITS -327.6800 327.6700 /end CHARACTERISTIC
/begin CHARACTERISTIC PSP_DigOut.numTstMax_C "/" VALUE 0x8006848A Kw_Wu16 65535.00 OneToOne 0.00 65535.00 FORMAT "%8.2" /end CHARACTERISTIC
/begin CHARACTERISTIC PSP_stPsDiaDisbl_C "Schalter zum Abschalten der Endstufendiagnose für die Vorförderpumpe" VALUE 0x8006848C Val_Wu8 255.0 OneToOne 0.00 255.0 FORMAT "%5.1" /end CHARACTERISTIC
/begin CHARACTERISTIC PSP_stPsDisbl_C "Schalter zum Abschalten der Endstufe für die Vorförderpumpe" VALUE 0x8006848D Val_Wu8 255.0 OneToOne 0.00 255.0 FORMAT "%5.1" /end CHARACTERISTIC
/begin CHARACTERISTIC PthSet_dtrqRmpDwnDfl_C "Rampensteigung bei Schubabschaltung" VALUE 0x8006879C Val_Ws32 3276784.99908 RmpTrq 14.9993896484 3276799.99847 FORMAT "%13.5" EXTENDED_LIMITS -3276800.00000 3276799.99847 /end CHARACTERISTIC
/begin CHARACTERISTIC PthSet_dtrqRmpDwn_CUR "Rampensteigung bei Schubabschaltung bei Kraftschluß" CURVE 0x800687A0 Cur_Xs16Ws16 3261.700 dTrq 15.00000 3276.700 FORMAT "%8.3" EXTENDED_LIMITS -3276.800 3276.700
 /begin AXIS_DESCR STD_AXIS PT_rTrq TransR 6 0.00 327.6700 FORMAT "%8.4" EXTENDED_LIMITS -327.6800 327.6700 DEPOSIT ABSOLUTE /end AXIS_DESCR
/end CHARACTERISTIC
/begin CHARACTERISTIC PthSet_tiOvrRunCoordDebPos_C "Entprellzeit für den Übergang ""Kein Schub -> Schub"" im Schubkoordinator" VALUE 0x80068798 Val_Ws16 655350.0 Time_ms -327680.0 327670.0 FORMAT "%8.1" /end CHARACTERISTIC
/begin CHARACTERISTIC PthSet_tiRmpStrtDfl_C "Default Wartezeit nach Schuberkennung bis die Rampe startet" VALUE 0x800687BA Val_Ws16 655350.0 Time_ms -327680.0 327670.0 FORMAT "%8.1" /end CHARACTERISTIC
/begin CHARACTERISTIC PthSet_tiRmpStrt_CUR "Wartezeit nach Schuberkennung bei Kraftschluß bis die Rampe startet" CURVE 0x800687BC Cur_Xs16Ws16 327670.0 Time_ms 0.00 327670.0 FORMAT "%8.1" EXTENDED_LIMITS -327680.0 327670.0
 /begin AXIS_DESCR STD_AXIS PT_rTrq TransR 6 0.00 327.6700 FORMAT "%8.4" EXTENDED_LIMITS -327.6800 327.6700 DEPOSIT ABSOLUTE /end AXIS_DESCR
/end CHARACTERISTIC
/begin CHARACTERISTIC PthSet_tiSwtOffDfl_C "Default Wartezeit nach Schuberkennung bis hart abgeschaltet wird" VALUE 0x800687D6 Val_Ws16 655350.0 Time_ms -327680.0 327670.0 FORMAT "%8.1" /end CHARACTERISTIC
/begin CHARACTERISTIC PthSet_tiSwtOff_CUR "Wartezeit nach Schuberkennung bei Kraftschluß bis hart abgeschaltet wird" CURVE 0x800687D8 Cur_Xs16Ws16 327670.0 Time_ms 0.00 327670.0 FORMAT "%8.1" EXTENDED_LIMITS -327680.0 327670.0
 /begin AXIS_DESCR STD_AXIS PT_rTrq TransR 6 0.00 327.6700 FORMAT "%8.4" EXTENDED_LIMITS -327.6800 327.6700 DEPOSIT ABSOLUTE /end AXIS_DESCR
/end CHARACTERISTIC
/begin CHARACTERISTIC PthSet_trqOffs_C "Offseterweiterung für das Begrenzungsmoment, damit der Ruckeldämpfer-Störregler laufen kann" VALUE 0x800687F2 Val_Ws16 100.0000 Trq 0.00 100.0000 FORMAT "%8.4" EXTENDED_LIMITS -3276.800 3276.700 /end CHARACTERISTIC
/begin CHARACTERISTIC PthSet_trqOvrRunThres_C "Momentschwelle für die Schuberkennung" VALUE 0x8006879A Val_Ws16 10.00000 Trq 0.00 10.00000 FORMAT "%8.5" EXTENDED_LIMITS -3276.800 3276.700 /end CHARACTERISTIC
/begin CHARACTERISTIC PTODi_nEngMin_C "minimum enginge speed for torque limitation" VALUE 0x8007DCD4 Val_Ws16 32767.50 EngN -16384.00 16383.50 FORMAT "%8.2" /end CHARACTERISTIC
/begin CHARACTERISTIC PTODi_tiDebTrqComp_C "debounce time for compensated torque limitation" VALUE 0x8007DCA8 Val_Wu32 4294967295.00 TimeDT 0.00 4294967295.00 FORMAT "%13.2" /end CHARACTERISTIC
/begin CHARACTERISTIC PTODi_tiDebTrqDes_C "debounce time for desired torque limitation" VALUE 0x8007DCD8 Val_Wu32 4294967295.00 TimeDT 0.00 4294967295.00 FORMAT "%13.2" /end CHARACTERISTIC
/begin CHARACTERISTIC PTODi_trqCompOfs_MAP "offset torque level 1" MAP 0x8007DCAC Kf_Xs16_Ys16_Ws16 6553.500 Trq -3276.800 3276.700 FORMAT "%8.3"
 /begin AXIS_DESCR STD_AXIS Epm_nEng EngN 3 -16384.00 16383.50 FORMAT "%8.2" DEPOSIT ABSOLUTE /end AXIS_DESCR
 /begin AXIS_DESCR STD_AXIS MoFCoVeh_trqVehPtdMsg Mo_trq_nm_q0p1 3 -3276.800 3276.700 FORMAT "%8.3" DEPOSIT ABSOLUTE /end AXIS_DESCR
/end CHARACTERISTIC
/begin CHARACTERISTIC PTODi_trqCompPtdOfs_C "" VALUE 0x8007DCA6 Kw_Ws16 6553.500 Trq -3276.800 3276.700 FORMAT "%8.3" /end CHARACTERISTIC
/begin CHARACTERISTIC PTODi_trqDesOfs_MAP "offset torque level 1" MAP 0x8007DCDC Kf_Xs16_Ys16_Ws16 6553.500 Trq -3276.800 3276.700 FORMAT "%8.3"
 /begin AXIS_DESCR STD_AXIS Epm_nEng EngN 8 -16384.00 16383.50 FORMAT "%8.2" DEPOSIT ABSOLUTE /end AXIS_DESCR
 /begin AXIS_DESCR STD_AXIS MoFCoVeh_trqVehPtdMsg Mo_trq_nm_q0p1 8 -3276.800 3276.700 FORMAT "%8.3" DEPOSIT ABSOLUTE /end AXIS_DESCR
/end CHARACTERISTIC
/begin CHARACTERISTIC PTODi_trqPtdOfs_C "" VALUE 0x8007DCD0 Kw_Ws16 6553.500 Trq -3276.800 3276.700 FORMAT "%8.3" /end CHARACTERISTIC
/begin CHARACTERISTIC PT_dChkGrpDT1Kd_C "" VALUE 0x80068490 Val_Ws32 1000.00000000 Kd 0.00 1000.00000000 FORMAT "%13.8" EXTENDED_LIMITS -32768.0000000 32767.9999847 /end CHARACTERISTIC
/begin CHARACTERISTIC PT_dOfsGripDet_C "" VALUE 0x80068494 Val_Ws16 100.0000 dn_dZfine 0.00 100.0000 FORMAT "%8.4" EXTENDED_LIMITS -16384.00 16383.50 /end CHARACTERISTIC
/begin CHARACTERISTIC PT_dOfsNoGripDet_C "" VALUE 0x80068496 Val_Ws16 5000.000 dn_dZfine 0.00 5000.000 FORMAT "%8.3" EXTENDED_LIMITS -16384.00 16383.50 /end CHARACTERISTIC
/begin CHARACTERISTIC PT_dThetaGripDet_C "" VALUE 0x80068498 Val_Ws16 5000.000 Moment_Inertia 0.00 5000.000 FORMAT "%8.3" EXTENDED_LIMITS -327.6800 327.6700 /end CHARACTERISTIC
/begin CHARACTERISTIC PT_dThetaNoGripDet_C "" VALUE 0x8006849A Val_Ws16 5000.000 Moment_Inertia 0.00 5000.000 FORMAT "%8.3" EXTENDED_LIMITS -327.6800 327.6700 /end CHARACTERISTIC
/begin CHARACTERISTIC PT_rTrqDfl_C "Defaultwert für Momentenübersetzung" VALUE 0x8007DC94 Val_Ws16 655.3500 TransR -327.6800 327.6700 FORMAT "%8.4" /end CHARACTERISTIC
/begin CHARACTERISTIC PT_swtDetTypeCAN_C "Festlegen ob Wert vom CAN gelesen wird oder nicht" VALUE 0x8007DC96 Val_Ws8 255.0 OneToOne -128.0 127.0 FORMAT "%5.1" /end CHARACTERISTIC
/begin CHARACTERISTIC PT_swtMstShft_C "" VALUE 0x8007DC88 Kw_Wu8 255.0 OneToOne 0.00 255.0 FORMAT "%5.1" /end CHARACTERISTIC
/begin CHARACTERISTIC PT_swtNoGripDet_C "" VALUE 0x8006849C Val_Wu8 255.0 OneToOne 0.00 255.0 FORMAT "%5.1" /end CHARACTERISTIC
/begin CHARACTERISTIC PT_tiChkGrpDT1_C "" VALUE 0x800684A0 Val_Ws32 48.941487800 TimeDelay_s 0.99999238556 49.941480186 FORMAT "%12.9" EXTENDED_LIMITS 0.000002000000001 4294.9672960 /end CHARACTERISTIC
/begin CHARACTERISTIC PT_tiChkGrpPT1_C "" VALUE 0x800684A4 Val_Ws32 48.941487800 TimeDelay_s 0.99999238556 49.941480186 FORMAT "%12.9" EXTENDED_LIMITS 0.000002000000001 4294.9672960 /end CHARACTERISTIC
/begin CHARACTERISTIC PT_tiDebGearUnVal_C "" VALUE 0x800684A8 Val_Wu16 3000.000 Time_ms 0.00 3000.000 FORMAT "%8.3" EXTENDED_LIMITS 0.00 655350.0 /end CHARACTERISTIC
/begin CHARACTERISTIC PT_tiDebGrip_C "Applikationsparameter für Entprellzeit" VALUE 0x8007DC8C Kw_Ws32 4294967295.00 TimeDT -2147483648.00 2147483647.00 FORMAT "%13.2" /end CHARACTERISTIC
/begin CHARACTERISTIC PT_tiDebNoClthHiLo_C "" VALUE 0x800684AA Val_Wu16 3000.000 Time_ms 0.00 3000.000 FORMAT "%8.3" EXTENDED_LIMITS 0.00 655350.0 /end CHARACTERISTIC
/begin CHARACTERISTIC PT_tiDebNoClthLoHi_C "" VALUE 0x800684AC Val_Wu16 3000.000 Time_ms 0.00 3000.000 FORMAT "%8.3" EXTENDED_LIMITS 0.00 655350.0 /end CHARACTERISTIC
/begin CHARACTERISTIC PT_tiDebNoGrip_C "" VALUE 0x800684AE Val_Wu16 3000.000 Time_ms 0.00 3000.000 FORMAT "%8.3" EXTENDED_LIMITS 0.00 655350.0 /end CHARACTERISTIC
/begin CHARACTERISTIC PT_vMinGrip_C "minmale Fahrzeuggeschwindigkeit" VALUE 0x8007DC90 Kw_Wu16 655.3500 Vel 0.00 655.3500 FORMAT "%8.4" /end CHARACTERISTIC
/begin CHARACTERISTIC PT_vMinTrqRat_C "minimale Fahrzeuggeschwindigkeit" VALUE 0x8007DC98 Val_Ws16 655.3500 Vel -327.6800 327.6700 FORMAT "%8.4" /end CHARACTERISTIC
/begin CHARACTERISTIC QWC_facCor1_MAP "KF 1 für Gewichtungsfaktor der Druckwellenkorrektur" MAP 0x80068BC4 Map_Xs16Ys16Ws16 10.00000 Fact1 0.00 10.00000 FORMAT "%8.5" EXTENDED_LIMITS -256.0000 255.9922
 /begin AXIS_DESCR STD_AXIS InjCrv_qMI1Des InjMass 8 0.00 327.6700 FORMAT "%8.4" EXTENDED_LIMITS -327.6800 327.6700 DEPOSIT ABSOLUTE /end AXIS_DESCR
 /begin AXIS_DESCR STD_AXIS RailP_pCurr_mp Pres_Rail 16 0.00 2000.000 FORMAT "%5.3" EXTENDED_LIMITS -3276.800 3276.700 DEPOSIT ABSOLUTE /end AXIS_DESCR
/end CHARACTERISTIC
/begin CHARACTERISTIC QWC_facCor2_MAP "KF 2 für Gewichtungsfaktor der Druckwellenkorrektur" MAP 0x80068CF8 Map_Xs16Ys16Ws16 10.00000 Fact1 0.00 10.00000 FORMAT "%8.5" EXTENDED_LIMITS -256.0000 255.9922
 /begin AXIS_DESCR STD_AXIS InjCrv_qPoI2Des_mp InjMass 8 0.00 327.6700 FORMAT "%8.4" EXTENDED_LIMITS -327.6800 327.6700 DEPOSIT ABSOLUTE /end AXIS_DESCR
 /begin AXIS_DESCR STD_AXIS RailP_pCurr_mp Pres_Rail 16 0.00 2000.000 FORMAT "%5.3" EXTENDED_LIMITS -3276.800 3276.700 DEPOSIT ABSOLUTE /end AXIS_DESCR
/end CHARACTERISTIC
/begin CHARACTERISTIC QWC_facFTS_MAP "KF für die Berechnung des kraftstofftemperaturabhängigen Druckwellenkorrekturfaktors" MAP 0x800687F4 Map_Xs16Ys16Ws16 2.000000 Fact 0.00 2.000000 FORMAT "%8.6" EXTENDED_LIMITS -4.000000 3.999878
 /begin AXIS_DESCR STD_AXIS RailP_pFlt Pres_Rail 16 0.00 2000.000 FORMAT "%5.3" EXTENDED_LIMITS -3276.800 3276.700 DEPOSIT ABSOLUTE /end AXIS_DESCR
 /begin AXIS_DESCR STD_AXIS QWC_tCor Temp_Cels 8 -40.04000 139.9600 FORMAT "%8.4" EXTENDED_LIMITS -3549.940 3003.560 DEPOSIT ABSOLUTE /end AXIS_DESCR
/end CHARACTERISTIC
/begin CHARACTERISTIC QWC_facPiI2PiI1WvCor_C "Gewichtungsfaktor zur Aktivierung/Deaktivierung der Druckwellenmengenänderung von PiI1 durch PiI2" VALUE 0x80068E2C Val_Ws16 1.000000 Fact 0.00 1.000000 FORMAT "%8.6" EXTENDED_LIMITS -4.000000 3.999878 /end CHARACTERISTIC
/begin CHARACTERISTIC QWC_facPiI2_C "Gewichtungsfaktor der Druckwellenkorrekturmenge der MI1 abhängig von PiI2" VALUE 0x80068E2E Val_Ws16 1.000000 Fact 0.00 1.000000 FORMAT "%8.6" EXTENDED_LIMITS -4.000000 3.999878 /end CHARACTERISTIC
/begin CHARACTERISTIC QWC_qCor1_MAP "Grundwerte-KF 1 der Druckwellenkorrekturmenge" MAP 0x80068E30 Map_Xs16Ys16Ws16 655.3400 InjMass -327.6700 327.6700 FORMAT "%8.4" EXTENDED_LIMITS -327.6800 327.6700
 /begin AXIS_DESCR STD_AXIS QWC_tiPiI1MI1Cor_mp InjTime_us 32 0.00 5000.00 FORMAT "%8.2" EXTENDED_LIMITS -13107.20 13106.80 DEPOSIT ABSOLUTE /end AXIS_DESCR
 /begin AXIS_DESCR STD_AXIS InjCrv_qPiI1Des_mp InjMass 10 0.00 24.00000 FORMAT "%8.5" EXTENDED_LIMITS -327.6800 327.6700 DEPOSIT ABSOLUTE /end AXIS_DESCR
/end CHARACTERISTIC
/begin CHARACTERISTIC QWC_qCor2_MAP "Grundwerte-KF 2 der Druckwellenkorrekturmenge" MAP 0x80069108 Map_Xs16Ys16Ws16 655.3400 InjMass -327.6700 327.6700 FORMAT "%8.4" EXTENDED_LIMITS -327.6800 327.6700
 /begin AXIS_DESCR STD_AXIS QWC_tiMI1PoI2Cor_mp InjTime_us 32 0.00 5000.00 FORMAT "%8.2" EXTENDED_LIMITS -13107.20 13106.80 DEPOSIT ABSOLUTE /end AXIS_DESCR
 /begin AXIS_DESCR STD_AXIS QWC_rMI1Norm_mp QntR 10 0.0009765625 24.00000 FORMAT "%8.5" EXTENDED_LIMITS -32.00000 31.99902 DEPOSIT ABSOLUTE /end AXIS_DESCR
/end CHARACTERISTIC
/begin CHARACTERISTIC QWC_qMax_C "maximale Begrenzungsmenge der Druckwellenkorrektur" VALUE 0x800693E0 Val_Ws16 20.00000 InjMass -10.00000 10.00000 FORMAT "%8.5" EXTENDED_LIMITS -327.6800 327.6700 /end CHARACTERISTIC
/begin CHARACTERISTIC QWC_qMin_C "minimale Begrenzungsmenge der Druckwellenkorrektur" VALUE 0x800693E2 Val_Ws16 20.00000 InjMass -10.00000 10.00000 FORMAT "%8.5" EXTENDED_LIMITS -327.6800 327.6700 /end CHARACTERISTIC
/begin CHARACTERISTIC QWC_qNorm_CUR "Kennlinie für die raildruckabhängige Einspritznormierungsmenge" CURVE 0x80068928 Cur_Xs16Ws16 327.6700 InjMass 0.00 327.6700 FORMAT "%8.4" EXTENDED_LIMITS -327.6800 327.6700
 /begin AXIS_DESCR STD_AXIS RailP_pFlt Pres_Rail 20 0.00 2000.000 FORMAT "%5.3" EXTENDED_LIMITS -3276.800 3276.700 DEPOSIT ABSOLUTE /end AXIS_DESCR
/end CHARACTERISTIC
/begin CHARACTERISTIC QWC_stActv_C "Freigabe der Druckwellenkorrektur" VALUE 0x8006897A Val_Wu8 1.000 OneToOne 0.00 1.000 FORMAT "%5.3" EXTENDED_LIMITS 0.00 255.0 /end CHARACTERISTIC
/begin CHARACTERISTIC QWC_swtDiffHydInSel_C "Auswahl für Darstellung des Betriebspunktes im Kennfeld QWC_tiDiffHyd_MAP (1,2,3: Darstellung, sonst: keine Darstellung)" VALUE 0x800693E4 Val_Wu8 2.000 OneToOne 0.00 2.000 FORMAT "%5.3" EXTENDED_LIMITS 0.00 255.0 /end CHARACTERISTIC
/begin CHARACTERISTIC QWC_tCor_MAP "KF für die Eingangstemperatur der Druckwellenkorrektur" MAP 0x8006897C Map_Xs16Ys16Ws16 180.0000 Temp_Cels -40.04000 139.9600 FORMAT "%8.4" EXTENDED_LIMITS -3549.940 3003.560
 /begin AXIS_DESCR STD_AXIS QWC_FuelT_mp Temp_Cels 16 -50.14000 149.8600 FORMAT "%8.4" EXTENDED_LIMITS -3549.940 3003.560 DEPOSIT ABSOLUTE /end AXIS_DESCR
 /begin AXIS_DESCR STD_AXIS QWC_CEngDsT_mp Temp_Cels 16 -50.14000 149.8600 FORMAT "%8.4" EXTENDED_LIMITS -3549.940 3003.560 DEPOSIT ABSOLUTE /end AXIS_DESCR
/end CHARACTERISTIC
/begin CHARACTERISTIC QWC_tDflCEngDsT_C "" VALUE 0x80068BC0 Val_Ws16 200.0000 Temp_Cels -50.14000 149.8600 FORMAT "%8.4" EXTENDED_LIMITS -3549.940 3003.560 /end CHARACTERISTIC
/begin CHARACTERISTIC QWC_tDflFuelT_C "" VALUE 0x80068BC2 Val_Ws16 200.0000 Temp_Cels -50.14000 149.8600 FORMAT "%8.4" EXTENDED_LIMITS -3549.940 3003.560 /end CHARACTERISTIC
/begin CHARACTERISTIC QWC_tiDiffHyd_MAP "Kennfeld mit Differenzzeiten zwischen hydraulischem Nadelschliessende und elektrischem Ansteuerende" MAP 0x800693E6 Map_Xs16Ys16Ws16 10000.00 InjTime_us -5000.000 5000.000 FORMAT "%8.3" EXTENDED_LIMITS -13107.20 13106.80
 /begin AXIS_DESCR STD_AXIS QWC_pCurrInDiffHyd_mp Pres_Rail 16 0.00 2000.000 FORMAT "%5.3" EXTENDED_LIMITS -3276.800 3276.700 DEPOSIT ABSOLUTE /end AXIS_DESCR
 /begin AXIS_DESCR STD_AXIS QWC_qDesInDiffHyd_mp InjMassInj 16 0.00 327.6700 FORMAT "%8.4" EXTENDED_LIMITS -327.6800 327.6700 DEPOSIT ABSOLUTE /end AXIS_DESCR
/end CHARACTERISTIC
/begin CHARACTERISTIC RadSht_nFanXHi_C "" VALUE 0x8006962A Val_Ws16 3000.000 FanSpd 0.00 3000.000 FORMAT "%8.3" EXTENDED_LIMITS -3000.092 3000.000 /end CHARACTERISTIC
/begin CHARACTERISTIC RadSht_nFanXLo_C "" VALUE 0x8006962C Val_Ws16 3000.000 FanSpd 0.00 3000.000 FORMAT "%8.3" EXTENDED_LIMITS -3000.092 3000.000 /end CHARACTERISTIC
/begin CHARACTERISTIC RadSht_rLogicOutHigh_C "" VALUE 0x8006962E Val_Ws16 100.0000 Prc 0.00 100.0000 FORMAT "%8.4" EXTENDED_LIMITS -400.0000 399.9878 /end CHARACTERISTIC
/begin CHARACTERISTIC RadSht_rLogicOutLow_C "" VALUE 0x80069630 Val_Ws16 100.0000 Prc 0.00 100.0000 FORMAT "%8.4" EXTENDED_LIMITS -400.0000 399.9878 /end CHARACTERISTIC
/begin CHARACTERISTIC RadSht_stInvOut_C "" VALUE 0x80069632 Val_Wu8 255.0 OneToOne 0.00 255.0 FORMAT "%5.1" /end CHARACTERISTIC
/begin CHARACTERISTIC RadSht_tEngXHi_C "" VALUE 0x80069634 Val_Ws16 250.0000 Temp_Cels -50.14000 199.8600 FORMAT "%8.4" EXTENDED_LIMITS -3549.940 3003.560 /end CHARACTERISTIC
/begin CHARACTERISTIC RadSht_tEngXLo_C "" VALUE 0x80069636 Val_Ws16 250.0000 Temp_Cels -50.14000 199.8600 FORMAT "%8.4" EXTENDED_LIMITS -3549.940 3003.560 /end CHARACTERISTIC
/begin CHARACTERISTIC RadSht_tiDebOff_C "" VALUE 0x80069638 Val_Ws16 655350.0 Time_ms -327680.0 327670.0 FORMAT "%8.1" /end CHARACTERISTIC
/begin CHARACTERISTIC RadSht_tiDebOn_C "" VALUE 0x8006963A Val_Ws16 655350.0 Time_ms -327680.0 327670.0 FORMAT "%8.1" /end CHARACTERISTIC
/begin CHARACTERISTIC RadSht_tTraOilXHi_C "" VALUE 0x8006963C Val_Ws16 250.0000 Temp_Cels -50.14000 199.8600 FORMAT "%8.4" EXTENDED_LIMITS -3549.940 3003.560 /end CHARACTERISTIC
/begin CHARACTERISTIC RadSht_tTraOilXLo_C "" VALUE 0x8006963E Val_Ws16 250.0000 Temp_Cels -50.14000 199.8600 FORMAT "%8.4" EXTENDED_LIMITS -3549.940 3003.560 /end CHARACTERISTIC
/begin CHARACTERISTIC RadSht_vXHi_C "" VALUE 0x80069640 Val_Ws16 200.0000 Vel 0.00 200.0000 FORMAT "%8.4" EXTENDED_LIMITS -327.6800 327.6700 /end CHARACTERISTIC
/begin CHARACTERISTIC RadSht_vXLo_C "" VALUE 0x80069642 Val_Ws16 200.0000 Vel 0.00 200.0000 FORMAT "%8.4" EXTENDED_LIMITS -327.6800 327.6700 /end CHARACTERISTIC
/begin CHARACTERISTIC RailP_pFltWinNeg_CUR "Raildruckabfall, ab welchem auf Großsignalparameter umgeschaltet wird" CURVE 0x8006965C Cur_Xs16Ws16 5276.800 Pres_Rail -3276.800 2000.000 FORMAT "%5.3" EXTENDED_LIMITS -3276.800 3276.700
 /begin AXIS_DESCR STD_AXIS InjCtl_qSetUnBal InjMass 10 -327.6800 327.6700 FORMAT "%8.4" DEPOSIT ABSOLUTE /end AXIS_DESCR
/end CHARACTERISTIC
/begin CHARACTERISTIC RailP_pLin_CUR "Linearisierungskennlinie für Kraftstoffdrucksensor" CURVE 0x80069644 Cur_Xs16Ws16 2000.000 Pres_Rail 0.00 2000.000 FORMAT "%5.3" EXTENDED_LIMITS -3276.800 3276.700
 /begin AXIS_DESCR STD_AXIS RailP_uRaw Volt 4 0.00 5200.000 FORMAT "%8.3" EXTENDED_LIMITS -6553.600 6553.400 DEPOSIT ABSOLUTE /end AXIS_DESCR
/end CHARACTERISTIC
/begin CHARACTERISTIC RailP_SRC.uMin_C "Klasse für Vorgabewerte Analogeingang Signal Range Check/" VALUE 0x80069656 Kw_Ws16 5200.000 Volt 0.00 5200.000 FORMAT "%8.3" EXTENDED_LIMITS -6553.600 6553.400 /end CHARACTERISTIC
/begin CHARACTERISTIC RailP_SRC.uMax_C "Klasse für Vorgabewerte Analogeingang Signal Range Check/" VALUE 0x80069658 Kw_Ws16 5200.000 Volt 0.00 5200.000 FORMAT "%8.3" EXTENDED_LIMITS -6553.600 6553.400 /end CHARACTERISTIC
/begin CHARACTERISTIC RailP_swtFlt_C "Funktionsweise der Raildruck-Spitzenwertermittlung im 10ms Raster" VALUE 0x80069686 Val_Wu8 1.000 OneToOne 0.00 1.000 FORMAT "%5.3" EXTENDED_LIMITS 0.00 255.0 /end CHARACTERISTIC
/begin CHARACTERISTIC RailP_swtOfsTst_C "Schalter für Freigabe des Offset-Tests für den Raildrucksensor im Start oder Nachlauf (0: Start, 1: Nachlauf)" VALUE 0x80069694 Val_Wu8 3.000 OneToOne 0.00 3.000 FORMAT "%5.3" EXTENDED_LIMITS 0.00 255.0 /end CHARACTERISTIC
/begin CHARACTERISTIC RailP_swtSSpMon_C "" VALUE 0x80069695 Val_Wu8 2.000 OneToOne 1.000 3.000 FORMAT "%5.3" EXTENDED_LIMITS 0.00 255.0 /end CHARACTERISTIC
/begin CHARACTERISTIC RailP_tiEvalDel_C "Verzögerungszeit zur Auswertung des Überwachungsergebnisses beim Offset-Tests für den Raildrucksensor" VALUE 0x80069696 Val_Ws16 327670.0 Time_ms 0.00 327670.0 FORMAT "%8.1" EXTENDED_LIMITS -327680.0 327670.0 /end CHARACTERISTIC
/begin CHARACTERISTIC RailP_tiFlt1PT1_C "PT1 Filterparameter für steigenden Raildruck" VALUE 0x80069688 Val_Ws32 4294.9672940 TimeDelay_s 0.000002000000001 4294.9672960 FORMAT "%12.7" /end CHARACTERISTIC
/begin CHARACTERISTIC RailP_tiFlt2PT1_C "PT1 Filterparameter für fallenden Raildruck (Kleinsignalverhalten)" VALUE 0x8006968C Val_Ws32 4294.9672940 TimeDelay_s 0.000002000000001 4294.9672960 FORMAT "%12.7" /end CHARACTERISTIC
/begin CHARACTERISTIC RailP_tiFlt3PT1_C "PT1 Filterparameter für stark fallenden Raildruck (Großsignalverhalten)" VALUE 0x80069690 Val_Ws32 4294.9672940 TimeDelay_s 0.000002000000001 4294.9672960 FORMAT "%12.7" /end CHARACTERISTIC
/begin CHARACTERISTIC RailP_tiOfsTstAftRun_C "Überwachungszeitraum des Offset-Tests für den Raildrucksensor im Nachlauf" VALUE 0x80069698 Val_Ws16 327670.0 Time_ms 0.00 327670.0 FORMAT "%8.1" EXTENDED_LIMITS -327680.0 327670.0 /end CHARACTERISTIC
/begin CHARACTERISTIC RailP_tiOfsTstDel_CUR "Verzögerungszeit für Offset-Überwachung des Raildrucksensors" CURVE 0x8006969A Cur_Xs16Ws16 5242.720 TimeRed 0.00 5242.720 FORMAT "%8.3" EXTENDED_LIMITS -5242.880 5242.720
 /begin AXIS_DESCR STD_AXIS RailP_pFlt Pres_Rail 6 0.00 2000.000 FORMAT "%5.3" EXTENDED_LIMITS -3276.800 3276.700 DEPOSIT ABSOLUTE /end AXIS_DESCR
/end CHARACTERISTIC
/begin CHARACTERISTIC RailP_tiOfsTstStrt_C "Überwachungszeitraum des Offset-Tests für den Raildrucksensor im Start" VALUE 0x800696B4 Val_Ws16 327670.0 Time_ms 0.00 327670.0 FORMAT "%8.1" EXTENDED_LIMITS -327680.0 327670.0 /end CHARACTERISTIC
/begin CHARACTERISTIC RailP_tiStrErrDel_C "Timeout zur Speicherung des Überwachungsergebnisses beim Offset-Tests für den Raildrucksensor" VALUE 0x800696B6 Val_Ws16 327670.0 Time_ms 0.00 327670.0 FORMAT "%8.1" EXTENDED_LIMITS -327680.0 327670.0 /end CHARACTERISTIC
/begin CHARACTERISTIC RailP_tOfsTstAftRun_C "Systemtemperaturschwelle zur Freigabe der Offset-Überwachung des Raildrucksensors im Nachlauf" VALUE 0x800696B8 Val_Ws16 200.0000 Temp_Cels -50.14000 149.8600 FORMAT "%8.4" EXTENDED_LIMITS -3549.940 3003.560 /end CHARACTERISTIC
/begin CHARACTERISTIC RailP_tOfsTstDec_C "Wassertemperaturdifferenz 'Abkühlung' zur Freigabe der Offset-Überwachung des Raildrucksensors im Start" VALUE 0x800696BA Val_Ws16 100.0000 TempDiff_Kelv 0.00 100.0000 FORMAT "%8.4" EXTENDED_LIMITS -3276.800 3276.700 /end CHARACTERISTIC
/begin CHARACTERISTIC RailP_tOfsTstInc_C "Wassertemperaturdifferenz 'Erwärmung' zur Freigabe der Offset-Überwachung des Raildrucksensors im Start" VALUE 0x800696BC Val_Ws16 100.0000 TempDiff_Kelv -100.0000 0.00 FORMAT "%8.4" EXTENDED_LIMITS -3276.800 3276.700 /end CHARACTERISTIC
/begin CHARACTERISTIC RailP_tOfsTstStrt_C "Systemtemperaturschwelle zur Freigabe der Offset-Überwachung des Raildrucksensors im Start" VALUE 0x800696BE Val_Ws16 200.0000 Temp_Cels -50.14000 149.8600 FORMAT "%8.4" EXTENDED_LIMITS -3549.940 3003.560 /end CHARACTERISTIC
/begin CHARACTERISTIC RailP_uOfsAftRunMax_C "obere Offsetschwelle der Offset-Überwachung des Raildrucksensors im Nachlauf" VALUE 0x800696C0 Val_Ws16 5200.000 Volt 0.00 5200.000 FORMAT "%8.3" EXTENDED_LIMITS -6553.600 6553.400 /end CHARACTERISTIC
/begin CHARACTERISTIC RailP_uOfsAftRunMin_C "untere Offsetschwelle der Offset-Überwachung des Raildrucksensors im Nachlauf" VALUE 0x800696C2 Val_Ws16 5200.000 Volt 0.00 5200.000 FORMAT "%8.3" EXTENDED_LIMITS -6553.600 6553.400 /end CHARACTERISTIC
/begin CHARACTERISTIC RailP_uOfsStrtMax_C "obere Offsetschwelle der Offset-Überwachung des Raildrucksensors im Start" VALUE 0x800696C4 Val_Ws16 5200.000 Volt 0.00 5200.000 FORMAT "%8.3" EXTENDED_LIMITS -6553.600 6553.400 /end CHARACTERISTIC
/begin CHARACTERISTIC RailP_uOfsStrtMin_C "untere Offsetschwelle der Offset-Überwachung des Raildrucksensors im Start" VALUE 0x800696C6 Val_Ws16 5200.000 Volt 0.00 5200.000 FORMAT "%8.3" EXTENDED_LIMITS -6553.600 6553.400 /end CHARACTERISTIC
/begin CHARACTERISTIC RailP_uRawMaxRes "" VALUE 0x8007F6A0 Val_Ws8 255.0 OneToOne -128.0 127.0 FORMAT "%5.1" READ_ONLY /end CHARACTERISTIC
/begin CHARACTERISTIC Rail_CtlSel.xVal_C "Umschaltung zwischen Steuern und Regeln anhand Absolut- / Differenzwert des Raildrucks (0: abs., 1: diff.)/" VALUE 0x80069E56 Kw_Wu8 1.000 OneToOne 0.00 1.000 FORMAT "%5.3" EXTENDED_LIMITS 0.00 255.0 /end CHARACTERISTIC
/begin CHARACTERISTIC Rail_CtlSel.xTyp_C "Umschaltung zwischen Steuern und Regeln anhand Absolut- / Differenzwert des Raildrucks (0: abs., 1: diff.)/" VALUE 0x80069E57 Kw_Wu8 0.00 OneToOne 2.000 2.000 FORMAT "%5.3" EXTENDED_LIMITS 0.00 255.0 /end CHARACTERISTIC
/begin CHARACTERISTIC Rail_dpPCVSetShOffDec_C "" VALUE 0x80069840 Val_Ws16 13000.000 PresRail_sec 0.00 13000.000 FORMAT "%5.3" EXTENDED_LIMITS -13107.200 13106.800 /end CHARACTERISTIC
/begin CHARACTERISTIC Rail_dpSetPointDec_C "maximaler Raildruck-Sollwertabfall pro Sekunde" VALUE 0x8006A834 Val_Ws16 26214.000 PresRail_sec -13107.200 13106.800 FORMAT "%5.3" /end CHARACTERISTIC
/begin CHARACTERISTIC Rail_dpSetPointInc_MAP "maximaler Raildruck-Sollwertanstieg pro Sekunde, abhängig von der Motordrehzahl und der Einspritzmenge" MAP 0x8006A836 Map_Xs16Ys16Ws16 13000.000 PresRail_sec 0.00 13000.000 FORMAT "%5.3" EXTENDED_LIMITS -13107.200 13106.800
 /begin AXIS_DESCR STD_AXIS Epm_nEng EngN 12 0.00 6000.000 FORMAT "%8.3" EXTENDED_LIMITS -16384.00 16383.50 DEPOSIT ABSOLUTE /end AXIS_DESCR
 /begin AXIS_DESCR STD_AXIS InjCtl_qSetUnBal InjMass 8 0.00 327.6700 FORMAT "%8.4" EXTENDED_LIMITS -327.6800 327.6700 DEPOSIT ABSOLUTE /end AXIS_DESCR
/end CHARACTERISTIC
/begin CHARACTERISTIC Rail_dvolDvtLim_C "Volumenstromabweichung für die Umschaltung aus dem Zustand Rail_stCPC == CPC_MEUN_CLOSE" VALUE 0x800696C8 Val_Ws16 655350.0 Qp_mm3_sec -327680.0 327670.0 FORMAT "%8.1" /end CHARACTERISTIC
/begin CHARACTERISTIC Rail_dvolLeak_MAP "Leckage-Kennfeld für Druckregelung über Zumesseinheit" MAP 0x80069E64 Map_Xs16Ys16Ws16 150000.0 Qp_mm3_sec 0.00 150000.0 FORMAT "%8.1" EXTENDED_LIMITS -327680.0 327670.0
 /begin AXIS_DESCR STD_AXIS Rail_pSetPoint Pres_Rail 10 0.00 2000.000 FORMAT "%5.3" EXTENDED_LIMITS -3276.800 3276.700 DEPOSIT ABSOLUTE /end AXIS_DESCR
 /begin AXIS_DESCR STD_AXIS FuelT_tFlSys Temp_Cels 10 -50.14000 149.8600 FORMAT "%8.4" EXTENDED_LIMITS -3549.940 3003.560 DEPOSIT ABSOLUTE /end AXIS_DESCR
/end CHARACTERISTIC
/begin CHARACTERISTIC Rail_dvolMeUnClose_CUR "Regelabweichung zum Schließen der ZME" CURVE 0x800696CA Cur_Xs16Ws16 60000.00 Qp_mm3_sec -50000.00 10000.00 FORMAT "%8.2" EXTENDED_LIMITS -327680.0 327670.0
 /begin AXIS_DESCR STD_AXIS Epm_nEng EngN 12 0.00 6000.000 FORMAT "%8.3" EXTENDED_LIMITS -16384.00 16383.50 DEPOSIT ABSOLUTE /end AXIS_DESCR
/end CHARACTERISTIC
/begin CHARACTERISTIC Rail_dvolMeUnCtlInitI_CUR "Kennlinie zur Initialisierung des I-Anteils als Funktion der Systemtemperatur" CURVE 0x80069BD4 Cur_Xs16Ws16 150000.0 Qp_mm3_sec 0.00 150000.0 FORMAT "%8.1" EXTENDED_LIMITS -327680.0 327670.0
 /begin AXIS_DESCR STD_AXIS FuelT_tFlSys Temp_Cels 3 -50.14000 149.8600 FORMAT "%8.4" EXTENDED_LIMITS -3549.940 3003.560 DEPOSIT ABSOLUTE /end AXIS_DESCR
/end CHARACTERISTIC
/begin CHARACTERISTIC Rail_dvolMeUnCtlLoLim_C "untere Stellwertbegrenzung" VALUE 0x8006988E Val_Ws16 655350.0 Qp_mm3_sec -327680.0 327670.0 FORMAT "%8.1" /end CHARACTERISTIC
/begin CHARACTERISTIC Rail_dvolMeUnCtlUpLim_CUR "obere Stellwertbegrenzung" CURVE 0x80069890 Cur_Xs16Ws16 655350.0 Qp_mm3_sec -327680.0 327670.0 FORMAT "%8.1"
 /begin AXIS_DESCR STD_AXIS Epm_nEng EngN 11 0.00 6000.000 FORMAT "%8.3" EXTENDED_LIMITS -16384.00 16383.50 DEPOSIT ABSOLUTE /end AXIS_DESCR
/end CHARACTERISTIC
/begin CHARACTERISTIC Rail_dvolMeUnOpn_CUR "Regelabweichung zum Öffnen der ZME" CURVE 0x800696FC Cur_Xs16Ws16 60000.00 Qp_mm3_sec -10000.00 50000.00 FORMAT "%8.2" EXTENDED_LIMITS -327680.0 327670.0
 /begin AXIS_DESCR STD_AXIS Epm_nEng EngN 12 0.00 6000.000 FORMAT "%8.3" EXTENDED_LIMITS -16384.00 16383.50 DEPOSIT ABSOLUTE /end AXIS_DESCR
/end CHARACTERISTIC
/begin CHARACTERISTIC Rail_dvolOff_C "Volumenstrom beim Abstellen des Systems (Nullförderung)" VALUE 0x80069842 Val_Ws16 655350.0 Qp_mm3_sec -327680.0 327670.0 FORMAT "%8.1" /end CHARACTERISTIC
/begin CHARACTERISTIC Rail_dvolPCVClose_CUR "Regelabweichung zum Schließen der DRV" CURVE 0x8006972E Cur_Xs16Ws16 50000.00 Qp_mm3_sec -50000.00 0.00 FORMAT "%8.2" EXTENDED_LIMITS -327680.0 327670.0
 /begin AXIS_DESCR STD_AXIS Epm_nEng EngN 12 0.00 6000.000 FORMAT "%8.3" EXTENDED_LIMITS -16384.00 16383.50 DEPOSIT ABSOLUTE /end AXIS_DESCR
/end CHARACTERISTIC
/begin CHARACTERISTIC Rail_dvolPCVOpn_CUR "Regelabweichung zum Öffnen des DRV" CURVE 0x80069760 Cur_Xs16Ws16 50000.00 Qp_mm3_sec 0.00 50000.00 FORMAT "%8.2" EXTENDED_LIMITS -327680.0 327670.0
 /begin AXIS_DESCR STD_AXIS Epm_nEng EngN 12 0.00 6000.000 FORMAT "%8.3" EXTENDED_LIMITS -16384.00 16383.50 DEPOSIT ABSOLUTE /end AXIS_DESCR
/end CHARACTERISTIC
/begin CHARACTERISTIC Rail_dvolPreCtlBas_MAP "Basisvorsteuerkennfeld für Druckregelung über Zumesseinheit" MAP 0x80069F58 Map_Xs16Ys16Ws16 150000.0 Qp_mm3_sec 0.00 150000.0 FORMAT "%8.1" EXTENDED_LIMITS -327680.0 327670.0
 /begin AXIS_DESCR STD_AXIS Epm_nEng EngN 16 0.00 6000.000 FORMAT "%8.3" EXTENDED_LIMITS -16384.00 16383.50 DEPOSIT ABSOLUTE /end AXIS_DESCR
 /begin AXIS_DESCR STD_AXIS Rail_qPreCtlBas_mp InjMass 16 0.00 327.6700 FORMAT "%8.4" EXTENDED_LIMITS -327.6800 327.6700 DEPOSIT ABSOLUTE /end AXIS_DESCR
/end CHARACTERISTIC
/begin CHARACTERISTIC Rail_dvolPreCtlOfs_MAP "Offset Kennlinie des Vorsteuerwerts (Regelung über Zumesseinheit)" MAP 0x8006A19C Map_Xs16Ys16Ws16 150000.0 Qp_mm3_sec 0.00 150000.0 FORMAT "%8.1" EXTENDED_LIMITS -327680.0 327670.0
 /begin AXIS_DESCR STD_AXIS Epm_nEng EngN 8 0.00 6000.000 FORMAT "%8.3" EXTENDED_LIMITS -16384.00 16383.50 DEPOSIT ABSOLUTE /end AXIS_DESCR
 /begin AXIS_DESCR STD_AXIS InjCtl_qSetUnBal InjMass 8 0.00 327.6700 FORMAT "%8.4" EXTENDED_LIMITS -327.6800 327.6700 DEPOSIT ABSOLUTE /end AXIS_DESCR
/end CHARACTERISTIC
/begin CHARACTERISTIC Rail_dvolPreCtlPoI1_MAP "Vorsteuerkennfeld abhängig von der Nacheinspritzmenge 1 für die Druckregelung über Zumesseinheit" MAP 0x8006A240 Map_Xs16Ys16Ws16 150000.0 Qp_mm3_sec 0.00 150000.0 FORMAT "%8.1" EXTENDED_LIMITS -327680.0 327670.0
 /begin AXIS_DESCR STD_AXIS Epm_nEng EngN 2 0.00 6000.000 FORMAT "%8.3" EXTENDED_LIMITS -16384.00 16383.50 DEPOSIT ABSOLUTE /end AXIS_DESCR
 /begin AXIS_DESCR STD_AXIS InjCrv_qPoI1Des_mp InjMass 4 0.00 327.6700 FORMAT "%8.4" EXTENDED_LIMITS -327.6800 327.6700 DEPOSIT ABSOLUTE /end AXIS_DESCR
/end CHARACTERISTIC
/begin CHARACTERISTIC Rail_dvolPreCtlPoI2_MAP "Vorsteuerkennfeld abhängig von der Nacheinspritzmenge 2 für die Druckregelung über Zumesseinheit" MAP 0x8006A260 Map_Xs16Ys16Ws16 150000.0 Qp_mm3_sec 0.00 150000.0 FORMAT "%8.1" EXTENDED_LIMITS -327680.0 327670.0
 /begin AXIS_DESCR STD_AXIS Epm_nEng EngN 2 0.00 6000.000 FORMAT "%8.3" EXTENDED_LIMITS -16384.00 16383.50 DEPOSIT ABSOLUTE /end AXIS_DESCR
 /begin AXIS_DESCR STD_AXIS InjCrv_qPoI2Des_mp InjMass 4 0.00 327.6700 FORMAT "%8.4" EXTENDED_LIMITS -327.6800 327.6700 DEPOSIT ABSOLUTE /end AXIS_DESCR
/end CHARACTERISTIC
/begin CHARACTERISTIC Rail_dvolPreCtl_C "Fernsteuerwert für Vorsteuerwert für die Druckregelung über Zumesseinheit" VALUE 0x8006A280 Val_Ws16 150000.0 Qp_mm3_sec 0.00 150000.0 FORMAT "%8.1" EXTENDED_LIMITS -327680.0 327670.0 /end CHARACTERISTIC
/begin CHARACTERISTIC Rail_dvolRedOfsLimHi_C "Obere Volumenstrom Hystereseschwelle für Raildruck Offset Reduzierung" VALUE 0x8006A288 Val_Ws16 655350.0 Qp_mm3_sec -327680.0 327670.0 FORMAT "%8.1" /end CHARACTERISTIC
/begin CHARACTERISTIC Rail_dvolRedOfsLimLo_C "Untere Volumenstrom Hystereseschwelle für Raildruck Offset Reduzierung" VALUE 0x8006A28A Val_Ws16 655350.0 Qp_mm3_sec -327680.0 327670.0 FORMAT "%8.1" /end CHARACTERISTIC
/begin CHARACTERISTIC Rail_dvolStrt_C "Volumenstrom während der Startphase (2-Stellerkonzept)" VALUE 0x80069844 Val_Ws16 655350.0 Qp_mm3_sec -327680.0 327670.0 FORMAT "%8.1" /end CHARACTERISTIC
/begin CHARACTERISTIC Rail_facAPSetPDynCor_CUR "Gewichtungsfaktor für den Raildrucksollwert in Abhängigkeit vom Umgebungsdruck" CURVE 0x8006AB88 Cur_Xs16Ws16 1.000000 Fact 0.00 1.000000 FORMAT "%8.6" EXTENDED_LIMITS -4.000000 3.999878
 /begin AXIS_DESCR STD_AXIS EnvP_p Pres_hPa 6 0.00 3500.000 FORMAT "%8.3" EXTENDED_LIMITS -32768.00 32767.00 DEPOSIT ABSOLUTE /end AXIS_DESCR
/end CHARACTERISTIC
/begin CHARACTERISTIC Rail_facDQSetPDynCor_CUR "Gewichtungsfaktor für die Raildrucksollwertkorrektur in Abhängigkeit von der Änderung der Einspritzmenge" CURVE 0x8006ABA2 Cur_Xs16Ws16 1.000000 Fact 0.00 1.000000 FORMAT "%8.6" EXTENDED_LIMITS -4.000000 3.999878
 /begin AXIS_DESCR STD_AXIS InjCrv_dqSetUnBalFltLim InjMassPerSec_20ms 6 -16384.00 16383.50 FORMAT "%8.2" DEPOSIT ABSOLUTE /end AXIS_DESCR
/end CHARACTERISTIC
/begin CHARACTERISTIC Rail_facETSetPDynCor_CUR "Gewichtungsfaktor für die Raildrucksollwertkorrektur in Abhängigkeit von der Motortemperatur" CURVE 0x8006ABBC Cur_Xs16Ws16 1.000000 Fact 0.00 1.000000 FORMAT "%8.6" EXTENDED_LIMITS -4.000000 3.999878
 /begin AXIS_DESCR STD_AXIS InjSys_tEng Temp_Cels 6 -50.14000 199.8600 FORMAT "%8.4" EXTENDED_LIMITS -3549.940 3003.560 DEPOSIT ABSOLUTE /end AXIS_DESCR
/end CHARACTERISTIC
/begin CHARACTERISTIC Rail_facIASetPDynCor_CUR "Gewichtungsfaktor für die Raildrucksollwertkorrektur in Abhängigkeit von der Ansauglufttemperatur" CURVE 0x8006ABD6 Cur_Xs16Ws16 1.000000 Fact 0.00 1.000000 FORMAT "%8.6" EXTENDED_LIMITS -4.000000 3.999878
 /begin AXIS_DESCR STD_AXIS Rail_tAir Temp_Cels 6 -50.14000 199.8600 FORMAT "%8.4" EXTENDED_LIMITS -3549.940 3003.560 DEPOSIT ABSOLUTE /end AXIS_DESCR
/end CHARACTERISTIC
/begin CHARACTERISTIC Rail_facLeakAged_C "Faktor zur Bestimmung des maximal möglichen Volumenstroms bei einem gealterten System" VALUE 0x8006A282 Val_Ws16 1.000000 Fact 0.00 1.000000 FORMAT "%8.6" EXTENDED_LIMITS -4.000000 3.999878 /end CHARACTERISTIC
/begin CHARACTERISTIC Rail_facMeUnDvt_CUR "Gewichtungsfaktor für die Regelabweichung der ZME" CURVE 0x80069792 Cur_Xs16Ws16 100.0000 Fact100 0.00 100.0000 FORMAT "%8.4" EXTENDED_LIMITS -327.6800 327.6700
 /begin AXIS_DESCR STD_AXIS Epm_nEng EngN 12 0.00 6000.000 FORMAT "%8.3" EXTENDED_LIMITS -16384.00 16383.50 DEPOSIT ABSOLUTE /end AXIS_DESCR
/end CHARACTERISTIC
/begin CHARACTERISTIC Rail_facMeUnSetPoint_CUR "Faktor für die Mindestfördermenge der Hochdruckpumpe" CURVE 0x800697C4 Cur_Xs16Ws16 1.000000 Fact 0.00 1.000000 FORMAT "%8.6" EXTENDED_LIMITS -4.000000 3.999878
 /begin AXIS_DESCR STD_AXIS Epm_nEng EngN 12 0.00 6000.000 FORMAT "%8.3" EXTENDED_LIMITS -16384.00 16383.50 DEPOSIT ABSOLUTE /end AXIS_DESCR
/end CHARACTERISTIC
/begin CHARACTERISTIC Rail_facOvrMeUnNegIncr_C "Multiplikativer Faktor zur Erhöhung der I-Verstärkung für negative Großsignale bei Überdruck (Druckregelung über MeUn)" VALUE 0x800698C6 Val_Ws16 255.9922 Fact1 0.00 255.9922 FORMAT "%8.4" EXTENDED_LIMITS -256.0000 255.9922 /end CHARACTERISTIC
/begin CHARACTERISTIC Rail_facOvrPCVNegIncr_C "Multiplikativer Faktor zur Erhöhung der I-Verstärkung für negative Großsignale bei Überdruck (Druckregelung über PCV)" VALUE 0x80069A5E Val_Ws16 255.9922 Fact1 0.00 255.9922 FORMAT "%8.4" EXTENDED_LIMITS -256.0000 255.9922 /end CHARACTERISTIC
/begin CHARACTERISTIC Rail_facPCVDvt_CUR "Gewichtungsfaktor für die Regelabweichung des DRV" CURVE 0x800697F6 Cur_Xs16Ws16 100.0000 Fact100 -100.0000 0.00 FORMAT "%8.4" EXTENDED_LIMITS -327.6800 327.6700
 /begin AXIS_DESCR STD_AXIS Epm_nEng EngN 12 0.00 6000.000 FORMAT "%8.3" EXTENDED_LIMITS -16384.00 16383.50 DEPOSIT ABSOLUTE /end AXIS_DESCR
/end CHARACTERISTIC
/begin CHARACTERISTIC Rail_facPCVFast_C "Faktor zum Beschleunigen des Stellverhaltens des DRV über die Regelabweichung" VALUE 0x80069828 Val_Ws16 655.3500 Fact100 -327.6800 327.6700 FORMAT "%8.4" /end CHARACTERISTIC
/begin CHARACTERISTIC Rail_facSetPointAPSCStrt_CUR "Gewichtungsfaktor für die Raildrucksollwertkorrektur beim Start abhängig vom Luftdruck" CURVE 0x8006ABF0 Cur_Xs16Ws16 1.000000 Fact 0.00 1.000000 FORMAT "%8.6" EXTENDED_LIMITS -4.000000 3.999878
 /begin AXIS_DESCR STD_AXIS EnvP_p Pres_hPa 8 0.00 3500.000 FORMAT "%8.3" EXTENDED_LIMITS -32768.00 32767.00 DEPOSIT ABSOLUTE /end AXIS_DESCR
/end CHARACTERISTIC
/begin CHARACTERISTIC Rail_facSetPointATSCStrt_CUR "Gewichtungsfaktor für die Raildrucksollwertkorrektur beim Start abhängig von der Ansauglufttemperatur" CURVE 0x8006AC12 Cur_Xs16Ws16 1.000000 Fact 0.00 1.000000 FORMAT "%8.6" EXTENDED_LIMITS -4.000000 3.999878
 /begin AXIS_DESCR STD_AXIS Rail_tAir Temp_Cels 8 -50.14000 199.8600 FORMAT "%8.4" EXTENDED_LIMITS -3549.940 3003.560 DEPOSIT ABSOLUTE /end AXIS_DESCR
/end CHARACTERISTIC
/begin CHARACTERISTIC Rail_facSetPointETSCor1_CUR "Gewichtungsfaktor für die Raildrucksollwertkorrektur in Abhängigkeit von der Motortemperatur" CURVE 0x8006AC34 Cur_Xs16Ws16 1.000000 Fact 0.00 1.000000 FORMAT "%8.6" EXTENDED_LIMITS -4.000000 3.999878
 /begin AXIS_DESCR STD_AXIS InjSys_tEng Temp_Cels 8 -50.14000 199.8600 FORMAT "%8.4" EXTENDED_LIMITS -3549.940 3003.560 DEPOSIT ABSOLUTE /end AXIS_DESCR
/end CHARACTERISTIC
/begin CHARACTERISTIC Rail_facSetPointETSCStrt_CUR "Gewichtungsfaktor für die Raildrucksollwertkorrektur beim Start abhängig von der Ansauglufttemperatur" CURVE 0x8006AC56 Cur_Xs16Ws16 1.000000 Fact 0.00 1.000000 FORMAT "%8.6" EXTENDED_LIMITS -4.000000 3.999878
 /begin AXIS_DESCR STD_AXIS InjSys_tEng Temp_Cels 8 -50.14000 199.8600 FORMAT "%8.4" EXTENDED_LIMITS -3549.940 3003.560 DEPOSIT ABSOLUTE /end AXIS_DESCR
/end CHARACTERISTIC
/begin CHARACTERISTIC Rail_facSetPointFTSCor_CUR "Gewichtungsfaktor, abhängig von der Kraftstofftemperatur für Raildruck-Sollwertkorrektur" CURVE 0x8006AC78 Cur_Xs16Ws16 1.000000 Fact 0.00 1.000000 FORMAT "%8.6" EXTENDED_LIMITS -4.000000 3.999878
 /begin AXIS_DESCR STD_AXIS FuelT_t Temp_Cels 6 -50.14000 149.8600 FORMAT "%8.4" EXTENDED_LIMITS -3549.940 3003.560 DEPOSIT ABSOLUTE /end AXIS_DESCR
/end CHARACTERISTIC
/begin CHARACTERISTIC Rail_facSetPointRmpVal_CUR "Interpolationsfaktor für die Funktion Rail_RgnSwt" CURVE 0x8006A820 Cur_Xs16Ws16 3.999939 EGTSwt_S16 -2.000000 1.999939 FORMAT "%8.6"
 /begin AXIS_DESCR STD_AXIS CoEOM_facRmpVal CoEOMSwt_S16 2 -2.000000 1.999939 FORMAT "%8.6" DEPOSIT ABSOLUTE /end AXIS_DESCR
/end CHARACTERISTIC
/begin CHARACTERISTIC Rail_MeUnCtlDKd_CUR "D-Verstärkung der Druckregelung über Zumesseinheit" CURVE 0x800698C8 Cur_Xs16Ws16 500.0000 Kd_pRail2Q_1 0.00 500.0000 FORMAT "%12.4" EXTENDED_LIMITS -800.0000 799.9756
 /begin AXIS_DESCR STD_AXIS Epm_nEng EngN 3 0.00 6000.000 FORMAT "%8.3" EXTENDED_LIMITS -16384.00 16383.50 DEPOSIT ABSOLUTE /end AXIS_DESCR
/end CHARACTERISTIC
/begin CHARACTERISTIC Rail_MeUnCtlIKiNeg_CUR "I-Verstärkung für negative Großsignale für die Druckregelung über Zumesseinheit" CURVE 0x800698D6 Cur_Xs16Ws16 2000.015 Ki_pRail2Q_1 0.00 2000.015 FORMAT "%11.3" EXTENDED_LIMITS -3051.758 3051.665
 /begin AXIS_DESCR STD_AXIS Epm_nEng EngN 13 0.00 6000.000 FORMAT "%8.3" EXTENDED_LIMITS -16384.00 16383.50 DEPOSIT ABSOLUTE /end AXIS_DESCR
/end CHARACTERISTIC
/begin CHARACTERISTIC Rail_MeUnCtlIKiPos_CUR "I-Verstärkung für positive Großsignale für die Druckregelung über Zumesseinheit" CURVE 0x8006990C Cur_Xs16Ws16 2000.015 Ki_pRail2Q_1 0.00 2000.015 FORMAT "%11.3" EXTENDED_LIMITS -3051.758 3051.665
 /begin AXIS_DESCR STD_AXIS Epm_nEng EngN 13 0.00 6000.000 FORMAT "%8.3" EXTENDED_LIMITS -16384.00 16383.50 DEPOSIT ABSOLUTE /end AXIS_DESCR
/end CHARACTERISTIC
/begin CHARACTERISTIC Rail_MeUnCtlIKi_CUR "I-Verstärkung für Kleinsignale für die Druckregelung über Zumesseinheit" CURVE 0x80069942 Cur_Xs16Ws16 2000.015 Ki_pRail2Q_1 0.00 2000.015 FORMAT "%11.3" EXTENDED_LIMITS -3051.758 3051.665
 /begin AXIS_DESCR STD_AXIS Epm_nEng EngN 13 0.00 6000.000 FORMAT "%8.3" EXTENDED_LIMITS -16384.00 16383.50 DEPOSIT ABSOLUTE /end AXIS_DESCR
/end CHARACTERISTIC
/begin CHARACTERISTIC Rail_MeUnCtlPKpNeg_CUR "P-Verstärkung für negative Großsignale für die Druckregelung über Zumesseinheit" CURVE 0x80069978 Cur_Xs16Ws16 200.0000 Kp_pRail2Q_1 0.00 200.0000 FORMAT "%12.4" EXTENDED_LIMITS -400.0000 399.9878
 /begin AXIS_DESCR STD_AXIS Epm_nEng EngN 13 0.00 6000.000 FORMAT "%8.3" EXTENDED_LIMITS -16384.00 16383.50 DEPOSIT ABSOLUTE /end AXIS_DESCR
/end CHARACTERISTIC
/begin CHARACTERISTIC Rail_MeUnCtlPKpPos_CUR "P-Verstärkung für positive Großsignale für die Druckregelung über Zumesseinheit" CURVE 0x800699AE Cur_Xs16Ws16 200.0000 Kp_pRail2Q_1 0.00 200.0000 FORMAT "%12.4" EXTENDED_LIMITS -400.0000 399.9878
 /begin AXIS_DESCR STD_AXIS Epm_nEng EngN 13 0.00 6000.000 FORMAT "%8.3" EXTENDED_LIMITS -16384.00 16383.50 DEPOSIT ABSOLUTE /end AXIS_DESCR
/end CHARACTERISTIC
/begin CHARACTERISTIC Rail_MeUnCtlPKp_CUR "P-Verstärkung für Kleinsignale für die Druckregelung über Zumesseinheit" CURVE 0x800699E4 Cur_Xs16Ws16 200.0000 Kp_pRail2Q_1 0.00 200.0000 FORMAT "%12.4" EXTENDED_LIMITS -400.0000 399.9878
 /begin AXIS_DESCR STD_AXIS Epm_nEng EngN 13 0.00 6000.000 FORMAT "%8.3" EXTENDED_LIMITS -16384.00 16383.50 DEPOSIT ABSOLUTE /end AXIS_DESCR
/end CHARACTERISTIC
/begin CHARACTERISTIC Rail_MeUnMon.dvolSetMin_C "Maximal zulässige Förderrate für Überwachung der Stellgröße im Schub/" VALUE 0x80069D74 Val_Ws16 50000.00 Qp_mm3_sec 0.00 50000.00 FORMAT "%8.2" EXTENDED_LIMITS -327680.0 327670.0 /end CHARACTERISTIC
/begin CHARACTERISTIC Rail_MeUnMon.pFltMax_C "Maximal zulässige Förderrate für Überwachung der Stellgröße im Schub/" VALUE 0x80069D76 Val_Ws16 2000.000 Pres_Rail 0.00 2000.000 FORMAT "%5.3" EXTENDED_LIMITS -3276.800 3276.700 /end CHARACTERISTIC
/begin CHARACTERISTIC Rail_MeUnMon.pDvtMax_C "Maximal zulässige Förderrate für Überwachung der Stellgröße im Schub/" VALUE 0x80069D78 Val_Ws16 2000.000 Pres_Rail 0.00 2000.000 FORMAT "%5.3" EXTENDED_LIMITS -3276.800 3276.700 /end CHARACTERISTIC
/begin CHARACTERISTIC Rail_MeUnMon.qLoIdl_C "Maximal zulässige Förderrate für Überwachung der Stellgröße im Schub/" VALUE 0x80069D7A Val_Ws16 327.6700 InjMass 0.00 327.6700 FORMAT "%8.4" EXTENDED_LIMITS -327.6800 327.6700 /end CHARACTERISTIC
/begin CHARACTERISTIC Rail_MeUnMon.tLoIdl_C "Maximal zulässige Förderrate für Überwachung der Stellgröße im Schub/" VALUE 0x80069D7C Val_Ws16 200.0000 Temp_Cels -50.14000 149.8600 FORMAT "%8.4" EXTENDED_LIMITS -3549.940 3003.560 /end CHARACTERISTIC
/begin CHARACTERISTIC Rail_MeUnMon.stRls_C "Maximal zulässige Förderrate für Überwachung der Stellgröße im Schub/" VALUE 0x80069D7E Val_Wu16 65535.00 OneToOne 0.00 65535.00 FORMAT "%8.2" /end CHARACTERISTIC
/begin CHARACTERISTIC Rail_nCloseCtl_C "Drehzahlschwelle für Wechsel zwischen gesteuertem und geregeltem Betrieb" VALUE 0x80069846 Val_Ws16 32767.50 EngN -16384.00 16383.50 FORMAT "%8.2" /end CHARACTERISTIC
/begin CHARACTERISTIC Rail_nMeUnFrzI_C "Drehzahlschwelle zum Einfrieren des I-Anteils für den Druckregler über Zumesseinheit" VALUE 0x80069BE2 Val_Ws16 32767.50 EngN -16384.00 16383.50 FORMAT "%8.2" /end CHARACTERISTIC
/begin CHARACTERISTIC Rail_nRedOfsLimHi_C "Obere Drehzahl Hystereseschwelle für Raildruck Offset Reduzierung" VALUE 0x8006A28C Val_Ws16 32767.50 EngN -16384.00 16383.50 FORMAT "%8.2" /end CHARACTERISTIC
/begin CHARACTERISTIC Rail_nRedOfsLimLo_C "Untere Drehzahl Hystereseschwelle für die Raildruck Offset Reduzierung" VALUE 0x8006A28E Val_Ws16 3000.000 EngN 0.00 3000.000 FORMAT "%8.3" EXTENDED_LIMITS -16384.00 16383.50 /end CHARACTERISTIC
/begin CHARACTERISTIC Rail_nStrtLim_C "Motordrehzahl Limit für die Raildrucküberwachung beim Start" VALUE 0x80069E5E Val_Ws16 6000.000 EngN 0.00 6000.000 FORMAT "%8.3" EXTENDED_LIMITS -16384.00 16383.50 /end CHARACTERISTIC
/begin CHARACTERISTIC Rail_nThresStrt_C "Drehzahlschwelle zum Verlassen des Startzustandes der Zustandssteuerung" VALUE 0x80069848 Val_Ws16 32767.50 EngN -16384.00 16383.50 FORMAT "%8.2" /end CHARACTERISTIC
/begin CHARACTERISTIC Rail_numRevDel_C "Anzahl von Motorumdrehungen um von Steuern auf Regeln umzuschalten" VALUE 0x8006984A Val_Wu16 65535.00 OneToOne 0.00 65535.00 FORMAT "%8.2" /end CHARACTERISTIC
/begin CHARACTERISTIC Rail_numRevPlaus_C "Anzahl der Nockenwellenumdrehungen um von Vorregelung auf Regelung umzuschalten." VALUE 0x8006984C Val_Wu16 65535.00 OneToOne 0.00 65535.00 FORMAT "%8.2" /end CHARACTERISTIC
/begin CHARACTERISTIC Rail_pCloseCtl_C "Absolutdruckschwelle zum Umschaltung in den Regelbetrieb" VALUE 0x8006984E Val_Ws16 5276.800 Pres_Rail -3276.800 2000.000 FORMAT "%5.3" EXTENDED_LIMITS -3276.800 3276.700 /end CHARACTERISTIC
/begin CHARACTERISTIC Rail_pCPCFltMax_C "maximal zulässiger Raildruck für CPC monitoring" VALUE 0x80069D30 Val_Ws16 2000.000 Pres_Rail 0.00 2000.000 FORMAT "%5.3" EXTENDED_LIMITS -3276.800 3276.700 /end CHARACTERISTIC
/begin CHARACTERISTIC Rail_pCPCFltMin_CUR "minimal zulässiger Raildruck als Funktion der Motordrehzahl während CPC-Regelung im Eingriff ist" CURVE 0x80069D32 Cur_Xs16Ws16 2000.000 Pres_Rail 0.00 2000.000 FORMAT "%5.3" EXTENDED_LIMITS -3276.800 3276.700
 /begin AXIS_DESCR STD_AXIS Epm_nEng EngN 16 0.00 6000.000 FORMAT "%8.3" EXTENDED_LIMITS -16384.00 16383.50 DEPOSIT ABSOLUTE /end AXIS_DESCR
/end CHARACTERISTIC
/begin CHARACTERISTIC Rail_PCVCtlDKd_CUR "D-Verstärkung der Druckregelung über Druckregelventil" CURVE 0x80069A60 Cur_Xs16Ws16 50.00000 Kd_1 0.00 50.00000 FORMAT "%8.5" EXTENDED_LIMITS -64.00000 63.99805
 /begin AXIS_DESCR STD_AXIS Epm_nEng EngN 3 0.00 6000.000 FORMAT "%8.3" EXTENDED_LIMITS -16384.00 16383.50 DEPOSIT ABSOLUTE /end AXIS_DESCR
/end CHARACTERISTIC
/begin CHARACTERISTIC Rail_PCVCtlIKiNeg_CUR "I-Verstärkung für negative Großsignale für die Druckregelung über Druckregelventil" CURVE 0x80069A6E Cur_Xs16Ws16 249.9968 Ki_1 0.00 249.9968 FORMAT "%8.4" EXTENDED_LIMITS -488.2813 488.2663
 /begin AXIS_DESCR STD_AXIS Epm_nEng EngN 13 0.00 6000.000 FORMAT "%8.3" EXTENDED_LIMITS -16384.00 16383.50 DEPOSIT ABSOLUTE /end AXIS_DESCR
/end CHARACTERISTIC
/begin CHARACTERISTIC Rail_PCVCtlIKiPos_CUR "I-Verstärkung für positive Großsignale für die Druckregelung über Druckregelventil" CURVE 0x80069AA4 Cur_Xs16Ws16 249.9968 Ki_1 0.00 249.9968 FORMAT "%8.4" EXTENDED_LIMITS -488.2813 488.2663
 /begin AXIS_DESCR STD_AXIS Epm_nEng EngN 13 0.00 6000.000 FORMAT "%8.3" EXTENDED_LIMITS -16384.00 16383.50 DEPOSIT ABSOLUTE /end AXIS_DESCR
/end CHARACTERISTIC
/begin CHARACTERISTIC Rail_PCVCtlIKi_CUR "I-Verstärkung für Kleinsignale für die Druckregelung über Druckregelventil" CURVE 0x80069ADA Cur_Xs16Ws16 249.9968 Ki_1 0.00 249.9968 FORMAT "%8.4" EXTENDED_LIMITS -488.2813 488.2663
 /begin AXIS_DESCR STD_AXIS Epm_nEng EngN 13 0.00 6000.000 FORMAT "%8.3" EXTENDED_LIMITS -16384.00 16383.50 DEPOSIT ABSOLUTE /end AXIS_DESCR
/end CHARACTERISTIC
/begin CHARACTERISTIC Rail_PCVCtlPKpNeg_CUR "P-Verstärkung für negative Großsignale für die Druckregelung über Druckregelventil" CURVE 0x80069B10 Cur_Xs16Ws16 300.0000 Kp_1 0.00 300.0000 FORMAT "%8.4" EXTENDED_LIMITS -512.0000 511.9844
 /begin AXIS_DESCR STD_AXIS Epm_nEng EngN 13 0.00 6000.000 FORMAT "%8.3" EXTENDED_LIMITS -16384.00 16383.50 DEPOSIT ABSOLUTE /end AXIS_DESCR
/end CHARACTERISTIC
/begin CHARACTERISTIC Rail_PCVCtlPKpPos_CUR "P-Verstärkung für positive Großsignale für die Druckregelung über Druckregelventil" CURVE 0x80069B46 Cur_Xs16Ws16 300.0000 Kp_1 0.00 300.0000 FORMAT "%8.4" EXTENDED_LIMITS -512.0000 511.9844
 /begin AXIS_DESCR STD_AXIS Epm_nEng EngN 13 0.00 6000.000 FORMAT "%8.3" EXTENDED_LIMITS -16384.00 16383.50 DEPOSIT ABSOLUTE /end AXIS_DESCR
/end CHARACTERISTIC
/begin CHARACTERISTIC Rail_PCVCtlPKp_CUR "P-Verstärkung für Kleinsignale für die Druckregelung über Druckregelventil" CURVE 0x80069B7C Cur_Xs16Ws16 300.0000 Kp_1 0.00 300.0000 FORMAT "%8.4" EXTENDED_LIMITS -512.0000 511.9844
 /begin AXIS_DESCR STD_AXIS Epm_nEng EngN 13 0.00 6000.000 FORMAT "%8.3" EXTENDED_LIMITS -16384.00 16383.50 DEPOSIT ABSOLUTE /end AXIS_DESCR
/end CHARACTERISTIC
/begin CHARACTERISTIC Rail_PCVMon.pDvtMax_C "Klasse für Schwellwerte der Überwachung PCV/" VALUE 0x80069DE6 Val_Ws16 3800.000 Pres_Rail -1800.000 2000.000 FORMAT "%5.3" EXTENDED_LIMITS -3276.800 3276.700 /end CHARACTERISTIC
/begin CHARACTERISTIC Rail_PCVMon.pDvtMin_C "Klasse für Schwellwerte der Überwachung PCV/" VALUE 0x80069DE8 Val_Ws16 3800.000 Pres_Rail -1800.000 2000.000 FORMAT "%5.3" EXTENDED_LIMITS -3276.800 3276.700 /end CHARACTERISTIC
/begin CHARACTERISTIC Rail_PCVMon.pSetMin_C "Klasse für Schwellwerte der Überwachung PCV/" VALUE 0x80069DEA Val_Ws16 2000.000 Pres_Rail 0.00 2000.000 FORMAT "%5.3" EXTENDED_LIMITS -3276.800 3276.700 /end CHARACTERISTIC
/begin CHARACTERISTIC Rail_PCVMon.pFltMax_C "Klasse für Schwellwerte der Überwachung PCV/" VALUE 0x80069DEC Val_Ws16 2000.000 Pres_Rail 0.00 2000.000 FORMAT "%5.3" EXTENDED_LIMITS -3276.800 3276.700 /end CHARACTERISTIC
/begin CHARACTERISTIC Rail_PCVMon.stRls_C "Klasse für Schwellwerte der Überwachung PCV/" VALUE 0x80069DEE Val_Wu16 65535.00 OneToOne 0.00 65535.00 FORMAT "%8.2" /end CHARACTERISTIC
/begin CHARACTERISTIC Rail_pDiffCloseCtl_C "Differenzdruckschwelle zum Umschalten in den Regelbetrieb" VALUE 0x80069850 Val_Ws16 5276.800 Pres_Rail -3276.800 2000.000 FORMAT "%5.3" EXTENDED_LIMITS -3276.800 3276.700 /end CHARACTERISTIC
/begin CHARACTERISTIC Rail_pDvtFltMin_C "minimale absolute Regelabweichung als Eingangssignal des DT1-Gliedes" VALUE 0x80069BE4 Val_Ws16 5276.800 Pres_Rail -3276.800 2000.000 FORMAT "%5.3" EXTENDED_LIMITS -3276.800 3276.700 /end CHARACTERISTIC
/begin CHARACTERISTIC Rail_pDvtRedOfsLimHi_C "Obere Regeabweichung Hystereseschwelle für Raildruck Offset Reduzierung" VALUE 0x8006A290 Val_Ws16 5276.800 Pres_Rail -3276.800 2000.000 FORMAT "%5.3" EXTENDED_LIMITS -3276.800 3276.700 /end CHARACTERISTIC
/begin CHARACTERISTIC Rail_pDvtRedOfsLimLo_C "untere Regelabweichung Hystereseschwelle für Raildruck Offset Reduzierung" VALUE 0x8006A292 Val_Ws16 5276.800 Pres_Rail -3276.800 2000.000 FORMAT "%5.3" EXTENDED_LIMITS -3276.800 3276.700 /end CHARACTERISTIC
/begin CHARACTERISTIC Rail_pMeUnCtlIWinNeg_C "untere Kleinsignalgrenze für den I-Anteil des Druckreglers über Zumesseinheit" VALUE 0x80069A1A Val_Ws16 5276.800 Pres_Rail -3276.800 2000.000 FORMAT "%5.3" EXTENDED_LIMITS -3276.800 3276.700 /end CHARACTERISTIC
/begin CHARACTERISTIC Rail_pMeUnCtlIWinPos_C "obere Kleinsignalgrenze für den I-Anteil des Druckreglers über Zumesseinheit" VALUE 0x80069A1C Val_Ws16 5276.800 Pres_Rail -3276.800 2000.000 FORMAT "%5.3" EXTENDED_LIMITS -3276.800 3276.700 /end CHARACTERISTIC
/begin CHARACTERISTIC Rail_pMeUnCtlPWinNeg_C "untere Kleinsignalgrenze für den P-Anteil des Druckreglers über Zumesseinheit" VALUE 0x80069A1E Val_Ws16 5276.800 Pres_Rail -3276.800 2000.000 FORMAT "%5.3" EXTENDED_LIMITS -3276.800 3276.700 /end CHARACTERISTIC
/begin CHARACTERISTIC Rail_pMeUnCtlPWinPos_C "obere Kleinsignalgrenze für den P-Anteil des Druckreglers über Zumesseinheit" VALUE 0x80069A20 Val_Ws16 5276.800 Pres_Rail -3276.800 2000.000 FORMAT "%5.3" EXTENDED_LIMITS -3276.800 3276.700 /end CHARACTERISTIC
/begin CHARACTERISTIC Rail_pMeUnCtlTypeHi_C "obere Solldruckhystereseschwelle für die Verriegelung der PCV-Regelung" VALUE 0x80069CD8 Val_Ws16 2000.000 Pres_Rail 0.00 2000.000 FORMAT "%5.3" EXTENDED_LIMITS -3276.800 3276.700 /end CHARACTERISTIC
/begin CHARACTERISTIC Rail_pMeUnCtlTypeLo_C "untere Solldruckhystereseschwelle für die Verriegelung der PCV Regelung" VALUE 0x80069CDA Val_Ws16 2000.000 Pres_Rail 0.00 2000.000 FORMAT "%5.3" EXTENDED_LIMITS -3276.800 3276.700 /end CHARACTERISTIC
/begin CHARACTERISTIC Rail_pMeUnDvtMax_CUR "Maximal zulässige Regelabweichung für Raildrucküberwachung als Funktion der Drehzahl" CURVE 0x80069D80 Cur_Xs16Ws16 3800.000 Pres_Rail -1800.000 2000.000 FORMAT "%5.3" EXTENDED_LIMITS -3276.800 3276.700
 /begin AXIS_DESCR STD_AXIS Epm_nEng EngN 4 0.00 6000.000 FORMAT "%8.3" EXTENDED_LIMITS -16384.00 16383.50 DEPOSIT ABSOLUTE /end AXIS_DESCR
/end CHARACTERISTIC
/begin CHARACTERISTIC Rail_pMeUnDvtMin_CUR "Minimal zulässige Regelabweichung für Raildrucküberwachung als Funktion der Drehzahl" CURVE 0x80069D92 Cur_Xs16Ws16 3800.000 Pres_Rail -1800.000 2000.000 FORMAT "%5.3" EXTENDED_LIMITS -3276.800 3276.700
 /begin AXIS_DESCR STD_AXIS Epm_nEng EngN 4 0.00 6000.000 FORMAT "%8.3" EXTENDED_LIMITS -16384.00 16383.50 DEPOSIT ABSOLUTE /end AXIS_DESCR
/end CHARACTERISTIC
/begin CHARACTERISTIC Rail_pMeUnFltMin_CUR "Minimal zulässiger Raildruck als Funktion der Motordrehzahl" CURVE 0x80069DA4 Cur_Xs16Ws16 2000.000 Pres_Rail 0.00 2000.000 FORMAT "%5.3" EXTENDED_LIMITS -3276.800 3276.700
 /begin AXIS_DESCR STD_AXIS Epm_nEng EngN 16 0.00 6000.000 FORMAT "%8.3" EXTENDED_LIMITS -16384.00 16383.50 DEPOSIT ABSOLUTE /end AXIS_DESCR
/end CHARACTERISTIC
/begin CHARACTERISTIC Rail_pMeUnPreCtlOff_C "Druckschwelle für die Umschaltung aus dem Zustand Rail_stCPC == CPC_MEUN_CLOSE" VALUE 0x8006982A Val_Ws16 5276.800 Pres_Rail -3276.800 2000.000 FORMAT "%5.3" EXTENDED_LIMITS -3276.800 3276.700 /end CHARACTERISTIC
/begin CHARACTERISTIC Rail_pMeUnPreCtlOn_C "Druckschwelle für die Umschaltung aus dem Zustand Rail_stCPC == CPC_MEUN_CLOSE" VALUE 0x8006982C Val_Ws16 5276.800 Pres_Rail -3276.800 2000.000 FORMAT "%5.3" EXTENDED_LIMITS -3276.800 3276.700 /end CHARACTERISTIC
/begin CHARACTERISTIC Rail_pOpnCtl_C "Absolutdruckschwelle zum Umschaltung in den Steuerbetrieb" VALUE 0x80069852 Val_Ws16 5276.800 Pres_Rail -3276.800 2000.000 FORMAT "%5.3" EXTENDED_LIMITS -3276.800 3276.700 /end CHARACTERISTIC
/begin CHARACTERISTIC Rail_pOvrMeUnThresHigh_C "Obere Hystereseschwelle für Überdruckerkennung MeUn" VALUE 0x80069A22 Val_Ws16 2000.000 Pres_Rail 0.00 2000.000 FORMAT "%5.3" EXTENDED_LIMITS -3276.800 3276.700 /end CHARACTERISTIC
/begin CHARACTERISTIC Rail_pOvrMeUnThresLow_C "Untere Hystereseschwelle für Überdruckerkennung MeUn" VALUE 0x80069A24 Val_Ws16 2000.000 Pres_Rail 0.00 2000.000 FORMAT "%5.3" EXTENDED_LIMITS -3276.800 3276.700 /end CHARACTERISTIC
/begin CHARACTERISTIC Rail_pOvrPCVThresHigh_C "Obere Hystereseschwelle für Überdruckerkennung PCV" VALUE 0x80069BB2 Val_Ws16 2000.000 Pres_Rail 0.00 2000.000 FORMAT "%5.3" EXTENDED_LIMITS -3276.800 3276.700 /end CHARACTERISTIC
/begin CHARACTERISTIC Rail_pOvrPCVThresLow_C "Untere Hystereseschwelle für Überdruckerkennung PCV" VALUE 0x80069BB4 Val_Ws16 2000.000 Pres_Rail 0.00 2000.000 FORMAT "%5.3" EXTENDED_LIMITS -3276.800 3276.700 /end CHARACTERISTIC
/begin CHARACTERISTIC Rail_pPCVCloseOfs_CUR "Vorsteuer Offset um das Druckregelventil geschlossen zu halten" CURVE 0x8006A294 Cur_Xs16Ws16 5276.800 Pres_Rail -3276.800 2000.000 FORMAT "%5.3" EXTENDED_LIMITS -3276.800 3276.700
 /begin AXIS_DESCR STD_AXIS Rail_pSetPoint Pres_Rail 4 0.00 2000.000 FORMAT "%5.3" EXTENDED_LIMITS -3276.800 3276.700 DEPOSIT ABSOLUTE /end AXIS_DESCR
/end CHARACTERISTIC
/begin CHARACTERISTIC Rail_pPCVCtlIWinNeg_C "untere Kleinsignalgrenze für den I-Anteil des Druckreglers über Druckregelventil" VALUE 0x80069BB6 Val_Ws16 5276.800 Pres_Rail -3276.800 2000.000 FORMAT "%5.3" EXTENDED_LIMITS -3276.800 3276.700 /end CHARACTERISTIC
/begin CHARACTERISTIC Rail_pPCVCtlIWinPos_C "obere Kleinsignalgrenze für den I-Anteil des Druckreglers über Druckregelventil" VALUE 0x80069BB8 Val_Ws16 5276.800 Pres_Rail -3276.800 2000.000 FORMAT "%5.3" EXTENDED_LIMITS -3276.800 3276.700 /end CHARACTERISTIC
/begin CHARACTERISTIC Rail_pPCVCtlLoLimStrt_C "untere Stellwertbegrenzung des Raildruckreglers über Druckregelventil während der Startphase" VALUE 0x800698BE Val_Ws16 5276.800 Pres_Rail -3276.800 2000.000 FORMAT "%5.3" EXTENDED_LIMITS -3276.800 3276.700 /end CHARACTERISTIC
/begin CHARACTERISTIC Rail_pPCVCtlLoLim_C "untere Stellwertbegrenzung des Raildruckreglers über Druckregelventil" VALUE 0x800698C0 Val_Ws16 5276.800 Pres_Rail -3276.800 2000.000 FORMAT "%5.3" EXTENDED_LIMITS -3276.800 3276.700 /end CHARACTERISTIC
/begin CHARACTERISTIC Rail_pPCVCtlPWinNeg_C "untere Kleinsignalgrenze für den P-Anteil des Druckreglers über Druckregelventil" VALUE 0x80069BBA Val_Ws16 5276.800 Pres_Rail -3276.800 2000.000 FORMAT "%5.3" EXTENDED_LIMITS -3276.800 3276.700 /end CHARACTERISTIC
/begin CHARACTERISTIC Rail_pPCVCtlPWinPos_C "obere Kleinsignalgrenze für den P-Anteil des Druckreglers über Druckregelventil" VALUE 0x80069BBC Val_Ws16 5276.800 Pres_Rail -3276.800 2000.000 FORMAT "%5.3" EXTENDED_LIMITS -3276.800 3276.700 /end CHARACTERISTIC
/begin CHARACTERISTIC Rail_pPCVCtlUpLimStrt_C "obere Stellwertbegrenzung des Raildruckreglers über Druckregelventil während der Startphase" VALUE 0x800698C2 Val_Ws16 5276.800 Pres_Rail -3276.800 2000.000 FORMAT "%5.3" EXTENDED_LIMITS -3276.800 3276.700 /end CHARACTERISTIC
/begin CHARACTERISTIC Rail_pPCVCtlUpLim_C "obere Stellwertbegrenzung des Raildruckreglers über Druckregelventil" VALUE 0x800698C4 Val_Ws16 5276.800 Pres_Rail -3276.800 2000.000 FORMAT "%5.3" EXTENDED_LIMITS -3276.800 3276.700 /end CHARACTERISTIC
/begin CHARACTERISTIC Rail_pPCVDvtMax_CUR "maximale Regelabweichung als Funktion der Drehzahl für die Raildrucküberwachung" CURVE 0x80069DF0 Cur_Xs16Ws16 3800.000 Pres_Rail -1800.000 2000.000 FORMAT "%5.3" EXTENDED_LIMITS -3276.800 3276.700
 /begin AXIS_DESCR STD_AXIS Epm_nEng EngN 4 0.00 6000.000 FORMAT "%8.3" EXTENDED_LIMITS -16384.00 16383.50 DEPOSIT ABSOLUTE /end AXIS_DESCR
/end CHARACTERISTIC
/begin CHARACTERISTIC Rail_pPCVFltMin_CUR "Minimal zulässiger Raildruck als Funktion der Motordrehzahl" CURVE 0x80069E02 Cur_Xs16Ws16 2000.000 Pres_Rail 0.00 2000.000 FORMAT "%5.3" EXTENDED_LIMITS -3276.800 3276.700
 /begin AXIS_DESCR STD_AXIS Epm_nEng EngN 16 0.00 6000.000 FORMAT "%8.3" EXTENDED_LIMITS -16384.00 16383.50 DEPOSIT ABSOLUTE /end AXIS_DESCR
/end CHARACTERISTIC
/begin CHARACTERISTIC Rail_pPCVInitI_MAP "Kennfeld für Initialisierungswert I-Anteil des PCV-Druckreglers, beim Umschalten von Zumesseinheit auf Druckregelventil" MAP 0x80069BEA Map_Xs16Ys16Ws16 2000.000 Pres_Rail 0.00 2000.000 FORMAT "%5.3" EXTENDED_LIMITS -3276.800 3276.700
 /begin AXIS_DESCR STD_AXIS Epm_nEng EngN 8 0.00 6000.000 FORMAT "%8.3" EXTENDED_LIMITS -16384.00 16383.50 DEPOSIT ABSOLUTE /end AXIS_DESCR
 /begin AXIS_DESCR STD_AXIS Rail_pSetPoint Pres_Rail 12 0.00 2000.000 FORMAT "%5.3" EXTENDED_LIMITS -3276.800 3276.700 DEPOSIT ABSOLUTE /end AXIS_DESCR
/end CHARACTERISTIC
/begin CHARACTERISTIC Rail_pPCVRedOfs_CUR "Vorsteuerreduzierung für schnelleren Druckabbau über das Druckregelventil" CURVE 0x8006A2A6 Cur_Xs16Ws16 5276.800 Pres_Rail -3276.800 2000.000 FORMAT "%5.3" EXTENDED_LIMITS -3276.800 3276.700
 /begin AXIS_DESCR STD_AXIS Rail_pSetPoint Pres_Rail 4 0.00 2000.000 FORMAT "%5.3" EXTENDED_LIMITS -3276.800 3276.700 DEPOSIT ABSOLUTE /end AXIS_DESCR
/end CHARACTERISTIC
/begin CHARACTERISTIC Rail_pPCVSetMax_CUR "maximal zulässiger Solldruck für die Raildrucküberwachung" CURVE 0x80069E44 Cur_Xs16Ws16 2000.000 Pres_Rail 0.00 2000.000 FORMAT "%5.3" EXTENDED_LIMITS -3276.800 3276.700
 /begin AXIS_DESCR STD_AXIS Rail_pSetPoint Pres_Rail 4 0.00 2000.000 FORMAT "%5.3" EXTENDED_LIMITS -3276.800 3276.700 DEPOSIT ABSOLUTE /end AXIS_DESCR
/end CHARACTERISTIC
/begin CHARACTERISTIC Rail_pPreCtl_C "Fernsteuerwert für Vorsteuerwert für die Druckregelung über Druckregelventil" VALUE 0x8006A2B8 Val_Ws16 2000.000 Pres_Rail 0.00 2000.000 FORMAT "%5.3" EXTENDED_LIMITS -3276.800 3276.700 /end CHARACTERISTIC
/begin CHARACTERISTIC Rail_pPreCtl_MAP "Vorsteuerkennfeld für die Druckregelung über Druckregelventil" MAP 0x8006A2BA Map_Xs16Ys16Ws16 2000.000 Pres_Rail 0.00 2000.000 FORMAT "%5.3" EXTENDED_LIMITS -3276.800 3276.700
 /begin AXIS_DESCR STD_AXIS Epm_nEng EngN 8 0.00 6000.000 FORMAT "%8.3" EXTENDED_LIMITS -16384.00 16383.50 DEPOSIT ABSOLUTE /end AXIS_DESCR
 /begin AXIS_DESCR STD_AXIS Rail_pSetPoint Pres_Rail 12 0.00 2000.000 FORMAT "%5.3" EXTENDED_LIMITS -3276.800 3276.700 DEPOSIT ABSOLUTE /end AXIS_DESCR
/end CHARACTERISTIC
/begin CHARACTERISTIC Rail_PreCtl.xVal_C "Auswahl Schalterwert für die Einstellung des Stellerkonzeptes/" VALUE 0x80069E58 Kw_Wu8 1.000 OneToOne 0.00 1.000 FORMAT "%5.3" EXTENDED_LIMITS 0.00 255.0 /end CHARACTERISTIC
/begin CHARACTERISTIC Rail_PreCtl.xTyp_C "Auswahl Schalterwert für die Einstellung des Stellerkonzeptes/" VALUE 0x80069E59 Kw_Wu8 0.00 OneToOne 2.000 2.000 FORMAT "%5.3" EXTENDED_LIMITS 0.00 255.0 /end CHARACTERISTIC
/begin CHARACTERISTIC Rail_pRedOfsLim_C "Raildruckschwelle zur Reduzierung des Vorsteueroffsets des Druckregelventils" VALUE 0x8006A3A6 Val_Ws16 5276.800 Pres_Rail -3276.800 2000.000 FORMAT "%5.3" EXTENDED_LIMITS -3276.800 3276.700 /end CHARACTERISTIC
/begin CHARACTERISTIC Rail_Press.xVal_C "Klasse für Schalterparameter zur Druckauswahl/" VALUE 0x80069E5A Kw_Wu8 1.000 OneToOne 0.00 1.000 FORMAT "%5.3" EXTENDED_LIMITS 0.00 255.0 /end CHARACTERISTIC
/begin CHARACTERISTIC Rail_Press.xTyp_C "Klasse für Schalterparameter zur Druckauswahl/" VALUE 0x80069E5B Kw_Wu8 0.00 OneToOne 2.000 2.000 FORMAT "%5.3" EXTENDED_LIMITS 0.00 255.0 /end CHARACTERISTIC
/begin CHARACTERISTIC Rail_pSetMin_CUR "Kennlinie für den minimalen Raildruck als Stellwertvorgabe für PCV" CURVE 0x80069854 Cur_Xs16Ws16 2000.000 Pres_Rail 0.00 2000.000 FORMAT "%5.3" EXTENDED_LIMITS -3276.800 3276.700
 /begin AXIS_DESCR STD_AXIS Epm_nEng EngN 4 0.00 1800000. FORMAT "%8.0" EXTENDED_LIMITS -16384.00 16383.50 DEPOSIT ABSOLUTE /end AXIS_DESCR
/end CHARACTERISTIC
/begin CHARACTERISTIC Rail_pSetPDynCor_MAP "Basiskorrekturkennfeld für die Raildrucksollwertkorrektur" MAP 0x8006AC92 Map_Xs16Ys16Ws16 2000.000 Pres_Rail 0.00 2000.000 FORMAT "%5.3" EXTENDED_LIMITS -3276.800 3276.700
 /begin AXIS_DESCR STD_AXIS Epm_nEng EngN 12 0.00 6000.000 FORMAT "%8.3" EXTENDED_LIMITS -16384.00 16383.50 DEPOSIT ABSOLUTE /end AXIS_DESCR
 /begin AXIS_DESCR STD_AXIS InjCtl_qSetUnBal InjMass 8 0.00 327.6700 FORMAT "%8.4" EXTENDED_LIMITS -327.6800 327.6700 DEPOSIT ABSOLUTE /end AXIS_DESCR
/end CHARACTERISTIC
/begin CHARACTERISTIC Rail_pSetPointAPSCor_MAP "atmosphärendruckabhängiger Sollwertkorrektur des Raildrucks" MAP 0x8006B228 Map_Xs16Ys16Ws16 2000.000 Pres_Rail 0.00 2000.000 FORMAT "%5.3" EXTENDED_LIMITS -3276.800 3276.700
 /begin AXIS_DESCR STD_AXIS Epm_nEng EngN 12 0.00 6000.000 FORMAT "%8.3" EXTENDED_LIMITS -16384.00 16383.50 DEPOSIT ABSOLUTE /end AXIS_DESCR
 /begin AXIS_DESCR STD_AXIS InjCtl_qCurr InjMass 8 0.00 327.6700 FORMAT "%8.4" EXTENDED_LIMITS -327.6800 327.6700 DEPOSIT ABSOLUTE /end AXIS_DESCR
/end CHARACTERISTIC
/begin CHARACTERISTIC Rail_pSetPointAPSCStrt_MAP "Luftdruck - Basiskorrekturkennfeld für die Raildrucksollwertkorrektur in Abhängigkeit von Motordrehzahl und Einspritzmenge" MAP 0x8006AD7E Map_Xs16Ys16Ws16 2000.000 Pres_Rail 0.00 2000.000 FORMAT "%5.3" EXTENDED_LIMITS -3276.800 3276.700
 /begin AXIS_DESCR STD_AXIS Epm_nEng EngN 8 0.00 6000.000 FORMAT "%8.3" EXTENDED_LIMITS -16384.00 16383.50 DEPOSIT ABSOLUTE /end AXIS_DESCR
 /begin AXIS_DESCR STD_AXIS InjCtl_qCurr InjMass 8 0.00 327.6700 FORMAT "%8.4" EXTENDED_LIMITS -327.6800 327.6700 DEPOSIT ABSOLUTE /end AXIS_DESCR
/end CHARACTERISTIC
/begin CHARACTERISTIC Rail_pSetPointATSCor_MAP "ansauglufttemperaturabhängige Sollwertkorrektur des Raildrucks" MAP 0x8006B314 Map_Xs16Ys16Ws16 2000.000 Pres_Rail 0.00 2000.000 FORMAT "%5.3" EXTENDED_LIMITS -3276.800 3276.700
 /begin AXIS_DESCR STD_AXIS Epm_nEng EngN 12 0.00 6000.000 FORMAT "%8.3" EXTENDED_LIMITS -16384.00 16383.50 DEPOSIT ABSOLUTE /end AXIS_DESCR
 /begin AXIS_DESCR STD_AXIS InjCtl_qCurr InjMass 8 0.00 327.6700 FORMAT "%8.4" EXTENDED_LIMITS -327.6800 327.6700 DEPOSIT ABSOLUTE /end AXIS_DESCR
/end CHARACTERISTIC
/begin CHARACTERISTIC Rail_pSetPointATSCStrt_MAP "Atmosphärentemperatur Basiskennfeld der Raildrucksollwertkorrektur abhängig von Motordrehzahl und Einspritzmenge" MAP 0x8006AE22 Map_Xs16Ys16Ws16 2000.000 Pres_Rail 0.00 2000.000 FORMAT "%5.3" EXTENDED_LIMITS -3276.800 3276.700
 /begin AXIS_DESCR STD_AXIS Epm_nEng EngN 8 0.00 6000.000 FORMAT "%8.3" EXTENDED_LIMITS -16384.00 16383.50 DEPOSIT ABSOLUTE /end AXIS_DESCR
 /begin AXIS_DESCR STD_AXIS InjCtl_qCurr InjMass 8 0.00 327.6700 FORMAT "%8.4" EXTENDED_LIMITS -327.6800 327.6700 DEPOSIT ABSOLUTE /end AXIS_DESCR
/end CHARACTERISTIC
/begin CHARACTERISTIC Rail_pSetPointBas0Rgn_GMAP "Basiswert für die Raildrucksollwertbildung für die Regenerationsstufe 1" MAP 0x8006A3DC MapG_Ws16 2000.000 Pres_Rail 0.00 2000.000 FORMAT "%5.3" EXTENDED_LIMITS -3276.800 3276.700
 /begin AXIS_DESCR COM_AXIS Epm_nEng EngN 16 0.00 6000.000 FORMAT "%8.3" EXTENDED_LIMITS -16384.00 16383.50 AXIS_PTS_REF Rail_pSetPointBasRgnX_AXIS /end AXIS_DESCR
 /begin AXIS_DESCR COM_AXIS InjCtl_qSetUnBal InjMass 16 0.00 327.6700 FORMAT "%8.4" EXTENDED_LIMITS -327.6800 327.6700 AXIS_PTS_REF Rail_pSetPointBasRgnY_AXIS /end AXIS_DESCR
/end CHARACTERISTIC
/begin CHARACTERISTIC Rail_pSetPointBas1Rgn_GMAP "Basiswert für die Raildrucksollwertbildung für die Regenerationsstufe 2" MAP 0x8006A5DC MapG_Ws16 2000.000 Pres_Rail 0.00 2000.000 FORMAT "%5.3" EXTENDED_LIMITS -3276.800 3276.700
 /begin AXIS_DESCR COM_AXIS Epm_nEng EngN 16 0.00 6000.000 FORMAT "%8.3" EXTENDED_LIMITS -16384.00 16383.50 AXIS_PTS_REF Rail_pSetPointBasRgnX_AXIS /end AXIS_DESCR
 /begin AXIS_DESCR COM_AXIS InjCtl_qSetUnBal InjMass 16 0.00 327.6700 FORMAT "%8.4" EXTENDED_LIMITS -327.6800 327.6700 AXIS_PTS_REF Rail_pSetPointBasRgnY_AXIS /end AXIS_DESCR
/end CHARACTERISTIC
/begin CHARACTERISTIC Rail_pSetPointBase_MAP "Basiskennfeld für den Raildruck-Sollwert" MAP 0x8006A922 Map_Xs16Ys16Ws16 2000.000 Pres_Rail 0.00 2000.000 FORMAT "%5.3" EXTENDED_LIMITS -3276.800 3276.700
 /begin AXIS_DESCR STD_AXIS Epm_nEng EngN 16 0.00 6000.000 FORMAT "%8.3" EXTENDED_LIMITS -16384.00 16383.50 DEPOSIT ABSOLUTE /end AXIS_DESCR
 /begin AXIS_DESCR STD_AXIS InjCtl_qCurr InjMass 16 0.00 327.6700 FORMAT "%8.4" EXTENDED_LIMITS -327.6800 327.6700 DEPOSIT ABSOLUTE /end AXIS_DESCR
/end CHARACTERISTIC
/begin AXIS_PTS Rail_pSetPointBasRgnX_AXIS "Stützstellenverteilung für die Gruppenkorrekturfelder Rail_pSetPointBas%Rgn_GMAP für die Eingangsgröße Epm_nEng" 0x8006A7DC Epm_nEng Axis_Xs16 6000.000 EngN 16 0.00 6000.000 FORMAT "%8.3" EXTENDED_LIMITS -16384.00 16383.50 DEPOSIT ABSOLUTE /end AXIS_PTS
/begin AXIS_PTS Rail_pSetPointBasRgnY_AXIS "Stützstellenverteilung für die Gruppenkorrekturfelder Rail_pSetPointBas%Rgn_GMAP für die Eingangsgröße InjCtl_qSetUnBal" 0x8006A7FE InjCtl_qSetUnBal Axis_Xs16 327.6700 InjMass 16 0.00 327.6700 FORMAT "%8.4" EXTENDED_LIMITS -327.6800 327.6700 DEPOSIT ABSOLUTE /end AXIS_PTS
/begin CHARACTERISTIC Rail_pSetPointBattMin_CUR "batteriespannungsabhängige Kennlinie für den Raildruck-Sollwert" CURVE 0x8006AB66 Cur_Xs16Ws16 2000.000 Pres_Rail 0.00 2000.000 FORMAT "%5.3" EXTENDED_LIMITS -3276.800 3276.700
 /begin AXIS_DESCR STD_AXIS BattU_u Volt_Batt 4 0.00 24000.00 FORMAT "%8.2" EXTENDED_LIMITS -655360.0 655340.0 DEPOSIT ABSOLUTE /end AXIS_DESCR
/end CHARACTERISTIC
/begin CHARACTERISTIC Rail_pSetPointETSCor1_MAP "Umgebungstemperaturkorrekturkennfeld in Abhängigkeit von Motordrehzahl und Einspritzmenge" MAP 0x8006AEC6 Map_Xs16Ys16Ws16 2000.000 Pres_Rail 0.00 2000.000 FORMAT "%5.3" EXTENDED_LIMITS -3276.800 3276.700
 /begin AXIS_DESCR STD_AXIS Epm_nEng EngN 12 0.00 6000.000 FORMAT "%8.3" EXTENDED_LIMITS -16384.00 16383.50 DEPOSIT ABSOLUTE /end AXIS_DESCR
 /begin AXIS_DESCR STD_AXIS InjCtl_qCurr InjMass 8 0.00 327.6700 FORMAT "%8.4" EXTENDED_LIMITS -327.6800 327.6700 DEPOSIT ABSOLUTE /end AXIS_DESCR
/end CHARACTERISTIC
/begin CHARACTERISTIC Rail_pSetPointETSCor_MAP "motortemperaturabhängige Sollwertkorrektur des Raildrucks" MAP 0x8006B400 Map_Xs16Ys16Ws16 2000.000 Pres_Rail 0.00 2000.000 FORMAT "%5.3" EXTENDED_LIMITS -3276.800 3276.700
 /begin AXIS_DESCR STD_AXIS Epm_nEng EngN 12 0.00 6000.000 FORMAT "%8.3" EXTENDED_LIMITS -16384.00 16383.50 DEPOSIT ABSOLUTE /end AXIS_DESCR
 /begin AXIS_DESCR STD_AXIS InjCtl_qCurr InjMass 8 0.00 327.6700 FORMAT "%8.4" EXTENDED_LIMITS -327.6800 327.6700 DEPOSIT ABSOLUTE /end AXIS_DESCR
/end CHARACTERISTIC
/begin CHARACTERISTIC Rail_pSetPointETSCStrt_MAP "Umgebungstemperatur Basiskennfeld für die Raildrucksollwert Korrektur abhängig von Motordrehzahl und Einspritzmenge" MAP 0x8006AFB2 Map_Xs16Ys16Ws16 2000.000 Pres_Rail 0.00 2000.000 FORMAT "%5.3" EXTENDED_LIMITS -3276.800 3276.700
 /begin AXIS_DESCR STD_AXIS Epm_nEng EngN 8 0.00 6000.000 FORMAT "%8.3" EXTENDED_LIMITS -16384.00 16383.50 DEPOSIT ABSOLUTE /end AXIS_DESCR
 /begin AXIS_DESCR STD_AXIS InjCtl_qCurr InjMass 8 0.00 327.6700 FORMAT "%8.4" EXTENDED_LIMITS -327.6800 327.6700 DEPOSIT ABSOLUTE /end AXIS_DESCR
/end CHARACTERISTIC
/begin CHARACTERISTIC Rail_pSetPointFTSCor_MAP "Basiswert der kraftstofftemperaturabhängigen Raildruck-Sollwertkorrektur" MAP 0x8006B056 Map_Xs16Ys16Ws16 2000.000 Pres_Rail 0.00 2000.000 FORMAT "%5.3" EXTENDED_LIMITS -3276.800 3276.700
 /begin AXIS_DESCR STD_AXIS Epm_nEng EngN 8 0.00 6000.000 FORMAT "%8.3" EXTENDED_LIMITS -16384.00 16383.50 DEPOSIT ABSOLUTE /end AXIS_DESCR
 /begin AXIS_DESCR STD_AXIS InjCtl_qCurr InjMass 8 0.00 327.6700 FORMAT "%8.4" EXTENDED_LIMITS -327.6800 327.6700 DEPOSIT ABSOLUTE /end AXIS_DESCR
/end CHARACTERISTIC
/begin CHARACTERISTIC Rail_pSetPointInit_C "Initialwert des Raildrucksollwert" VALUE 0x8006AB78 Val_Ws16 5276.800 Pres_Rail -3276.800 2000.000 FORMAT "%5.3" EXTENDED_LIMITS -3276.800 3276.700 /end CHARACTERISTIC
/begin CHARACTERISTIC Rail_pSetPointLimNFlTemp_C "maximaler Raildrucksollwert, abhängig von der Motordrehzahl und der Kraftstofftemperatur" VALUE 0x8006B0FA Val_Ws16 2000.000 Pres_Rail 0.00 2000.000 FORMAT "%5.3" EXTENDED_LIMITS -3276.800 3276.700 /end CHARACTERISTIC
/begin CHARACTERISTIC Rail_pSetPointLimNFlTemp_MAP "Minimalwert Korrekturkennfeld der Raildrucksollwertkorrektur in Abhängigkeit von der Motordrehzahl und der Kraftstofftemperatur" MAP 0x8006B0FC Map_Xs16Ys16Ws16 2000.000 Pres_Rail 0.00 2000.000 FORMAT "%5.3" EXTENDED_LIMITS -3276.800 3276.700
 /begin AXIS_DESCR STD_AXIS Epm_nEng EngN 8 0.00 6000.000 FORMAT "%8.3" EXTENDED_LIMITS -16384.00 16383.50 DEPOSIT ABSOLUTE /end AXIS_DESCR
 /begin AXIS_DESCR STD_AXIS FuelT_t Temp_Cels 8 -50.14000 149.8600 FORMAT "%8.4" EXTENDED_LIMITS -3549.940 3003.560 DEPOSIT ABSOLUTE /end AXIS_DESCR
/end CHARACTERISTIC
/begin CHARACTERISTIC Rail_pSetPointMaxDef_C "maximaler Raildruck-Sollwert im Fehlerfall" VALUE 0x8006B1A0 Val_Ws16 2000.000 Pres_Rail 0.00 2000.000 FORMAT "%5.3" EXTENDED_LIMITS -3276.800 3276.700 /end CHARACTERISTIC
/begin CHARACTERISTIC Rail_pSetPointMaxDef_CUR "Maximaler Raildrucksollwert im Fehlerfall" CURVE 0x8006B1A2 Cur_Xs16Ws16 2000.000 Pres_Rail 0.00 2000.000 FORMAT "%5.3" EXTENDED_LIMITS -3276.800 3276.700
 /begin AXIS_DESCR STD_AXIS Epm_nEng EngN 6 0.00 6000.000 FORMAT "%8.3" EXTENDED_LIMITS -16384.00 16383.50 DEPOSIT ABSOLUTE /end AXIS_DESCR
/end CHARACTERISTIC
/begin CHARACTERISTIC Rail_pSetPointMaxDef_MAP "Maximaler Raildrucksollwert im Fehlerfall" MAP 0x8007F618 Map_Xs16Ys16Ws16 2000.000 Pres_Rail 0.00 2000.000 FORMAT "%5.3" EXTENDED_LIMITS -3276.800 3276.700
 /begin AXIS_DESCR STD_AXIS Epm_nEng EngN 6 0.00 6000.000 FORMAT "%8.3" EXTENDED_LIMITS -16384.00 16383.50 DEPOSIT ABSOLUTE /end AXIS_DESCR
 /begin AXIS_DESCR STD_AXIS FuelT_t Temp_Cels 5 -50.14000 149.8600 FORMAT "%8.4" EXTENDED_LIMITS -3549.940 3003.560 DEPOSIT ABSOLUTE /end AXIS_DESCR
/end CHARACTERISTIC
/begin CHARACTERISTIC Rail_pSetPointMax_MAP "maximaler Raildruck-Sollwert, abhängig von der Motordrehzahl und der Einspritzmenge" MAP 0x8006B1BC Map_Xs16Ys16Ws16 2000.000 Pres_Rail 0.00 2000.000 FORMAT "%5.3" EXTENDED_LIMITS -3276.800 3276.700
 /begin AXIS_DESCR STD_AXIS Epm_nEng EngN 5 0.00 6000.000 FORMAT "%8.3" EXTENDED_LIMITS -16384.00 16383.50 DEPOSIT ABSOLUTE /end AXIS_DESCR
 /begin AXIS_DESCR STD_AXIS InjSys_qTot InjMass 6 0.00 327.6700 FORMAT "%8.4" EXTENDED_LIMITS -327.6800 327.6700 DEPOSIT ABSOLUTE /end AXIS_DESCR
/end CHARACTERISTIC
/begin CHARACTERISTIC Rail_pSetPointMinDef_C "minimaler Raildruck-Sollwert im Fehlerfall" VALUE 0x8006B212 Val_Ws16 2000.000 Pres_Rail 0.00 2000.000 FORMAT "%5.3" EXTENDED_LIMITS -3276.800 3276.700 /end CHARACTERISTIC
/begin CHARACTERISTIC Rail_pSetPointMin_MAP "minimaler Raildruck-Sollwert, abhängig von der Motordrehzahl und der Einspritzmenge" MAP 0x8006B214 Map_Xs16Ys16Ws16 2000.000 Pres_Rail 0.00 2000.000 FORMAT "%5.3" EXTENDED_LIMITS -3276.800 3276.700
 /begin AXIS_DESCR STD_AXIS Epm_nEng EngN 2 0.00 6000.000 FORMAT "%8.3" EXTENDED_LIMITS -16384.00 16383.50 DEPOSIT ABSOLUTE /end AXIS_DESCR
 /begin AXIS_DESCR STD_AXIS InjSys_qTot InjMass 2 0.00 327.6700 FORMAT "%8.4" EXTENDED_LIMITS -327.6800 327.6700 DEPOSIT ABSOLUTE /end AXIS_DESCR
/end CHARACTERISTIC
/begin CHARACTERISTIC Rail_pSetPointRed_C "Offset zur Absenkung des Raildrucksollwert im Systemfehlerfall" VALUE 0x8006AB7A Val_Ws16 5276.800 Pres_Rail -3276.800 2000.000 FORMAT "%5.3" EXTENDED_LIMITS -3276.800 3276.700 /end CHARACTERISTIC
/begin CHARACTERISTIC Rail_pSetPoint_C "Fernsteuerwert des Raildrucksollwert" VALUE 0x8006AB7C Val_Ws16 2000.000 Pres_Rail 0.00 2000.000 FORMAT "%5.3" EXTENDED_LIMITS -3276.800 3276.700 /end CHARACTERISTIC
/begin CHARACTERISTIC Rail_pStrtLim_C "Raildruckgrenze für die Raildrucküberwachung beim Start" VALUE 0x80069E60 Val_Ws16 2000.000 Pres_Rail 0.00 2000.000 FORMAT "%5.3" EXTENDED_LIMITS -3276.800 3276.700 /end CHARACTERISTIC
/begin CHARACTERISTIC Rail_qCPCtlTypeHys_C "Hysterese für die Umschaltung auf CPC-Regelung" VALUE 0x80069CDC Val_Ws16 327.6700 InjMass 0.00 327.6700 FORMAT "%8.4" EXTENDED_LIMITS -327.6800 327.6700 /end CHARACTERISTIC
/begin CHARACTERISTIC Rail_qCPCtlType_CUR "Mengengrenze für die Umschaltung auf CPC-Regelung" CURVE 0x80069CDE Cur_Xs16Ws16 327.6700 InjMass 0.00 327.6700 FORMAT "%8.4" EXTENDED_LIMITS -327.6800 327.6700
 /begin AXIS_DESCR STD_AXIS Epm_nEng EngN 8 0.00 6000.000 FORMAT "%8.3" EXTENDED_LIMITS -16384.00 16383.50 DEPOSIT ABSOLUTE /end AXIS_DESCR
/end CHARACTERISTIC
/begin CHARACTERISTIC Rail_qMeUnCtlTypeHys_C "Hysterese für die Umschaltung auf MeUn-Regelung" VALUE 0x80069D00 Val_Ws16 327.6700 InjMass 0.00 327.6700 FORMAT "%8.4" EXTENDED_LIMITS -327.6800 327.6700 /end CHARACTERISTIC
/begin CHARACTERISTIC Rail_qMeUnCtlType_CUR "Mengengrenze für die Umschaltung auf MeUn-Regelung" CURVE 0x80069D02 Cur_Xs16Ws16 327.6700 InjMass 0.00 327.6700 FORMAT "%8.4" EXTENDED_LIMITS -327.6800 327.6700
 /begin AXIS_DESCR STD_AXIS Epm_nEng EngN 8 0.00 6000.000 FORMAT "%8.3" EXTENDED_LIMITS -16384.00 16383.50 DEPOSIT ABSOLUTE /end AXIS_DESCR
/end CHARACTERISTIC
/begin CHARACTERISTIC Rail_qRedOfsLimHi_C "Obere Mengen Hystereseschwelle für die Raildruck Offset Reduzierung" VALUE 0x8006A3A8 Val_Ws16 655.3500 InjMass -327.6800 327.6700 FORMAT "%8.4" /end CHARACTERISTIC
/begin CHARACTERISTIC Rail_qRedOfsLimLo_C "Untere Mengen Hystereseschwelle für die Raildruck Offset Reduzierung" VALUE 0x8006A3AA Val_Ws16 655.3500 InjMass -327.6800 327.6700 FORMAT "%8.4" /end CHARACTERISTIC
/begin CHARACTERISTIC Rail_stCtlLoopSel_C "Schalterauswahl für die Raildruckregelung" VALUE 0x80069866 Val_Wu8 255.0 OneToOne 0.00 255.0 FORMAT "%5.1" /end CHARACTERISTIC
/begin CHARACTERISTIC Rail_stPreCtlMeUnSel_C "Schalter-Auswahl für die Vorsteuerung der Zumesseinheit" VALUE 0x8006A284 Val_Wu8 255.0 OneToOne 0.00 255.0 FORMAT "%5.1" /end CHARACTERISTIC
/begin CHARACTERISTIC Rail_stRgnDelMsk_C "Maske für die Deaktivierung der Raildrucksollwerteberechnung im Regenerationsbetrieb" VALUE 0x8006AB80 Val_Wu32 4294967295.00 OneToOne 0.00 4294967295.00 FORMAT "%13.2" /end CHARACTERISTIC
/begin CHARACTERISTIC Rail_stSetPointRgnMsk_CA "Maske für die Festlegung freizugebender Regenerationsstufen" VAL_BLK 0x8006A82C ValA_Wu32 4294967295.00 OneToOne 0.00 4294967295.00 FORMAT "%13.2" NUMBER 2 /end CHARACTERISTIC
/begin CHARACTERISTIC Rail_stSetPointSel_C "Schalterauswahl für die Raildruck-Sollwertberechnung" VALUE 0x8006AB84 Val_Wu8 255.0 OneToOne 0.00 255.0 FORMAT "%5.1" /end CHARACTERISTIC
/begin CHARACTERISTIC Rail_swtCtlType_C "Schalter für die manuelle Vorgabe des Regelmodus" VALUE 0x80069D24 Val_Wu8 255.0 OneToOne 0.00 255.0 FORMAT "%5.1" /end CHARACTERISTIC
/begin CHARACTERISTIC Rail_swtDvolPreCtl_C "Schalter zur Fernsteuerung des Vorsteuerwerts für die Zumesseinheit" VALUE 0x8006A285 Val_Wu8 1.000 OneToOne 0.00 1.000 FORMAT "%5.3" EXTENDED_LIMITS 0.00 255.0 /end CHARACTERISTIC
/begin CHARACTERISTIC Rail_swtMeUnCtlIInit_C "Freigabe der Initialisierung von Rail_dvolMeUnCtlI in Abhängigkeit der Zustandswechsel von Rail_stCPC" VALUE 0x80069BE6 Val_Ws16 3.000000 OneToOne 0.00 3.000000 FORMAT "%8.6" EXTENDED_LIMITS -32768.00 32767.00 /end CHARACTERISTIC
/begin CHARACTERISTIC Rail_swtPCVInitI_C "Auswahl, PCV-Reglerinitialisierung mit Vorsteuerwert oder mit Sollwert" VALUE 0x80069CD6 Val_Wu8 255.0 OneToOne 0.00 255.0 FORMAT "%5.1" /end CHARACTERISTIC
/begin CHARACTERISTIC Rail_swtPPreCtl_C "Schalter zur Fernsteuerung des Vorsteuerwerts für Druckregelventil" VALUE 0x8006A3AC Val_Wu8 1.000 OneToOne 0.00 1.000 FORMAT "%5.3" EXTENDED_LIMITS 0.00 255.0 /end CHARACTERISTIC
/begin CHARACTERISTIC Rail_swtPSetPoint_C "Schalter zur Fernsteuerung des Raildrucksollwerts" VALUE 0x8006AB85 Val_Wu8 1.000 OneToOne 0.00 1.000 FORMAT "%5.3" EXTENDED_LIMITS 0.00 255.0 /end CHARACTERISTIC
/begin CHARACTERISTIC Rail_tiDeflate_C "Maximale Zeit für die Entlüftung des Niederdruckkreises" VALUE 0x80069868 Val_Ws16 327670.0 Time_ms 0.00 327670.0 FORMAT "%8.1" EXTENDED_LIMITS -327680.0 327670.0 /end CHARACTERISTIC
/begin CHARACTERISTIC Rail_tiDvtPressRedOfsPT1_C "PT1 time constant to switchover reduced offset value dependend on devation value" VALUE 0x8006A3B0 Val_Ws32 69.999327293 TimeDelay_ms 29.999911264 99.999238556 FORMAT "%12.8" EXTENDED_LIMITS 0.0020000000009 4294967.2960 /end CHARACTERISTIC
/begin CHARACTERISTIC Rail_tiFrzIDel_C "Verzögerungszeit zum Einfrieren des I-Anteils für den Druckregler über Zumesseinheit" VALUE 0x80069BE8 Val_Ws16 1000.000 Time_ms 0.00 1000.000 FORMAT "%8.3" EXTENDED_LIMITS -327680.0 327670.0 /end CHARACTERISTIC
/begin CHARACTERISTIC Rail_tiMeUnCtlDT1_CUR "Zeitkonstante des DT1-Gliedes (Druckregelung über Zumesseinheit)" CURVE 0x80069A26 Cur_Xs16Ws16 16.776216 TimeDelay_s_2 0.0010000129 16.777216 FORMAT "%9.6" EXTENDED_LIMITS 0.00051201563 16.777216
 /begin AXIS_DESCR STD_AXIS Epm_nEng EngN 5 0.00 6000.000 FORMAT "%8.3" EXTENDED_LIMITS -16384.00 16383.50 DEPOSIT ABSOLUTE /end AXIS_DESCR
/end CHARACTERISTIC
/begin CHARACTERISTIC Rail_tiMeUnCtlPT1_CUR "Zeitkonstante des PT1-Filters (Druckregelung über Zumesseinheit)" CURVE 0x80069A3C Cur_Xs16Ws16 16.776216 TimeDelay_s_2 0.0010000129 16.777216 FORMAT "%9.6" EXTENDED_LIMITS 0.00051201563 16.777216
 /begin AXIS_DESCR STD_AXIS Epm_nEng EngN 8 0.00 6000.000 FORMAT "%8.3" EXTENDED_LIMITS -16384.00 16383.50 DEPOSIT ABSOLUTE /end AXIS_DESCR
/end CHARACTERISTIC
/begin CHARACTERISTIC Rail_tiMeUnRmpDur_CUR "Laufzeit der Rampe um das Fördervolumen der Zumesseinheit vom aktuellen Sollwert auf die Maximalförderung zu rampen" CURVE 0x8006986A Cur_Xs16Ws16 655350.0 Time_ms -327680.0 327670.0 FORMAT "%8.1"
 /begin AXIS_DESCR STD_AXIS Epm_nEng EngN 8 0.00 6000.000 FORMAT "%8.3" EXTENDED_LIMITS -16384.00 16383.50 DEPOSIT ABSOLUTE /end AXIS_DESCR
/end CHARACTERISTIC
/begin CHARACTERISTIC Rail_tiPCVCtlDT1_CUR "Zeitkonstante des DT1-Gliedes für die Druckregelung über Druckregelventil" CURVE 0x80069BBE Cur_Xs16Ws16 16.776216 TimeDelay_s_2 0.0010000129 16.777216 FORMAT "%9.6" EXTENDED_LIMITS 0.00051201563 16.777216
 /begin AXIS_DESCR STD_AXIS Epm_nEng EngN 5 0.00 6000.000 FORMAT "%8.3" EXTENDED_LIMITS -16384.00 16383.50 DEPOSIT ABSOLUTE /end AXIS_DESCR
/end CHARACTERISTIC
/begin CHARACTERISTIC Rail_tiPCVRmpDur_CUR "Laufzeit der Rampe um vom aktuellen Sollwert auf den neuen PCVClose-Wert zu rampen" CURVE 0x8006A3B4 Cur_Xs16Ws16 655350.0 Time_ms -327680.0 327670.0 FORMAT "%8.1"
 /begin AXIS_DESCR STD_AXIS Epm_nEng EngN 8 0.00 6000.000 FORMAT "%8.3" EXTENDED_LIMITS -16384.00 16383.50 DEPOSIT ABSOLUTE /end AXIS_DESCR
/end CHARACTERISTIC
/begin CHARACTERISTIC Rail_tiPCVRmpToOfs_C "Laufzeit der Rampe um vom reduzierten Offsetwert auf den Offsetwert zu rampen" VALUE 0x8006A3D6 Val_Ws16 300.0000 Time_ms 0.00 300.0000 FORMAT "%8.4" EXTENDED_LIMITS -327680.0 327670.0 /end CHARACTERISTIC
/begin CHARACTERISTIC Rail_tiPCVRmpToRedOfs_C "Laufzeit der Rampe um vom Offsetwert auf den reduzierten Offsetwert zu rampen" VALUE 0x8006A3D8 Val_Ws16 300.0000 Time_ms 0.00 300.0000 FORMAT "%8.4" EXTENDED_LIMITS -327680.0 327670.0 /end CHARACTERISTIC
/begin CHARACTERISTIC Rail_tiPMonStrtLim_C "Zeitgrenze für die Raildrucküberwachung beim Start" VALUE 0x80069E62 Val_Ws16 655350.0 Time_ms -327680.0 327670.0 FORMAT "%8.1" /end CHARACTERISTIC
/begin CHARACTERISTIC Rail_tiPT1CPCDvt_C "Verzögerungszeitkonstante für die Regelabweichung des Volumenstroms" VALUE 0x80069830 Val_Ws32 1073.7408240 TimeDelay_s 0.0010000000689 1073.7418240 FORMAT "%12.7" EXTENDED_LIMITS 0.000002000000001 4294.9672960 /end CHARACTERISTIC
/begin CHARACTERISTIC Rail_tiSwtCPCMax_C "maximale Verweildauer eines Zustandes für die CPC-Regelung" VALUE 0x80069834 Val_Ws16 655350.0 Time_ms -327680.0 327670.0 FORMAT "%8.1" /end CHARACTERISTIC
/begin CHARACTERISTIC Rail_tiSwtCtlTypeDel_C "Verzögerungszeit bis zur Freigabe der Umschaltung des Regelprinzips" VALUE 0x80069D26 Val_Ws16 327670.0 Time_ms 0.00 327670.0 FORMAT "%8.1" EXTENDED_LIMITS -327680.0 327670.0 /end CHARACTERISTIC
/begin CHARACTERISTIC Rail_tiSwtToMeUnCtl_C "Verzögerungszeit bis zum Umschalten auf Druckregelung über Zumesseinheit" VALUE 0x8006988C Val_Ws16 327670.0 Time_ms 0.00 327670.0 FORMAT "%8.1" EXTENDED_LIMITS -327680.0 327670.0 /end CHARACTERISTIC
/begin CHARACTERISTIC Rail_tMeUnCtlTypeHi_C "obere Temperaturhystereseschwelle zur Verriegelung der PCV-Regelung" VALUE 0x80069D28 Val_Ws16 200.0000 Temp_Cels -50.14000 149.8600 FORMAT "%8.4" EXTENDED_LIMITS -3549.940 3003.560 /end CHARACTERISTIC
/begin CHARACTERISTIC Rail_tMeUnCtlTypeLo_C "untere Temperaturhystereseschwelle für die Verriegelung der PCV-Regelung" VALUE 0x80069D2A Val_Ws16 200.0000 Temp_Cels -50.14000 149.8600 FORMAT "%8.4" EXTENDED_LIMITS -3549.940 3003.560 /end CHARACTERISTIC
/begin CHARACTERISTIC Rail_tSwtCPCHi_C "obere Temperaturhystereseschwelle zur Verriegelung der PCV-Regelung" VALUE 0x80069D2C Val_Ws16 200.0000 Temp_Cels -50.14000 149.8600 FORMAT "%8.4" EXTENDED_LIMITS -3549.940 3003.560 /end CHARACTERISTIC
/begin CHARACTERISTIC Rail_tSwtCPCLo_C "untere Temperaturhystereseschwelle zur Verriegelung der PCV-Regelung" VALUE 0x80069D2E Val_Ws16 200.0000 Temp_Cels -50.14000 149.8600 FORMAT "%8.4" EXTENDED_LIMITS -3549.940 3003.560 /end CHARACTERISTIC
/begin CHARACTERISTIC Rail_volInjVlvCtl_C "Steuervolumen der Injektoren" VALUE 0x8006A286 Val_Ws16 10.00000 InjQntInj 0.00 10.00000 FORMAT "%8.5" EXTENDED_LIMITS -327.6800 327.6700 /end CHARACTERISTIC
/begin CHARACTERISTIC Rail_WindUp.xVal_C "Auswahl, Schalterwert aus Datensatz oder EEPROM/" VALUE 0x80069E5C Kw_Wu8 1.000 OneToOne 0.00 1.000 FORMAT "%5.3" EXTENDED_LIMITS 0.00 255.0 /end CHARACTERISTIC
/begin CHARACTERISTIC Rail_WindUp.xTyp_C "Auswahl, Schalterwert aus Datensatz oder EEPROM/" VALUE 0x80069E5D Kw_Wu8 0.00 OneToOne 2.000 2.000 FORMAT "%5.3" EXTENDED_LIMITS 0.00 255.0 /end CHARACTERISTIC
/begin CHARACTERISTIC RngMod_trqClthBs_C "" VALUE 0x8007DCA2 Val_Ws16 6553.500 Trq -3276.800 3276.700 FORMAT "%8.3" /end CHARACTERISTIC
/begin CHARACTERISTIC RngMod_trqClthMinWoCtOff_C "" VALUE 0x8007DCA4 Val_Ws16 6553.500 Trq -3276.800 3276.700 FORMAT "%8.3" /end CHARACTERISTIC
/begin CHARACTERISTIC VehMot_rvSlipThres_C "" VALUE 0x8007DC86 Val_Ws16 655.3500 Fact100 -327.6800 327.6700 FORMAT "%8.4" /end CHARACTERISTIC
/begin MEASUREMENT ActMod_trqClthWoDstC "" SWORD Trq 1 100 -3276.800 3276.700 FORMAT "%8.3" ECU_ADDRESS 0xD0006B34 /end MEASUREMENT
/begin MEASUREMENT CoPT_facDesDyn "Dynamikfaktor der fahrzeugseitigen Anforderer" SWORD Fact 1 100 -4.000000 3.999878 FORMAT "%8.6" ECU_ADDRESS 0xD0006C80 /end MEASUREMENT
/begin MEASUREMENT CoPT_nASTDes "Getriebe Synchronisationsdrehzahl" SWORD EngN 1 100 -16384.00 16383.50 FORMAT "%8.2" ECU_ADDRESS 0xD0006C82 /end MEASUREMENT
/begin MEASUREMENT CoPT_nMaxAcs "Maximaldrehzahlbegrenzung der Nebenaggregate" SWORD EngN 1 100 -16384.00 16383.50 FORMAT "%8.2" ECU_ADDRESS 0xD0006C84 /end MEASUREMENT
/begin MEASUREMENT CoPT_nMaxSysErr "Maximaldrehzahlbegrenzung bei Systemfehler" SWORD EngN 1 100 -16384.00 16383.50 FORMAT "%8.2" ECU_ADDRESS 0xD0006C88 /end MEASUREMENT
/begin MEASUREMENT CoPT_nMaxTra "Maximaldrehzahlbegrenzung des Getriebes" SWORD EngN 1 100 -16384.00 16383.50 FORMAT "%8.2" ECU_ADDRESS 0xD0006C8A /end MEASUREMENT
/begin MEASUREMENT CoPT_nMinAcs "Leerlaufdrehzahlanforderung der Nebenaggregate" SWORD EngN 1 100 -16384.00 16383.50 FORMAT "%8.2" ECU_ADDRESS 0xD0006C8C /end MEASUREMENT
/begin MEASUREMENT CoPT_nMinSysErr "Leerlaufdrehzahlanforderung bei Systemfehler" SWORD EngN 1 100 -16384.00 16383.50 FORMAT "%8.2" ECU_ADDRESS 0xD0006C90 /end MEASUREMENT
/begin MEASUREMENT CoPT_nMinTra "Leerlaufdrehzahlanforderung des Getriebes" SWORD EngN 1 100 -16384.00 16383.50 FORMAT "%8.2" ECU_ADDRESS 0xD0006C92 /end MEASUREMENT
/begin MEASUREMENT CoPT_stAST "Status Getriebe-Synchronisationsdrehzahleingriff" UBYTE OneToOne 1 100 0.00 255.0 FORMAT "%5.1" ECU_ADDRESS 0xD0008F59 /end MEASUREMENT
/begin MEASUREMENT CoPT_stNSetPAcs "Statuswort das Umsetzung der Nebenaggregatsdrehzahlanforderungen definiert" UBYTE OneToOne 1 100 0.00 255.0 FORMAT "%5.1" ECU_ADDRESS 0xD0008F5B /end MEASUREMENT
/begin MEASUREMENT CoPT_stNSetPSysErr "Statuswort das Umsetzung der Systemfehlerdrehzahlanforderungen definiert" UBYTE OneToOne 1 100 0.00 255.0 FORMAT "%5.1" ECU_ADDRESS 0xD0008F5C /end MEASUREMENT
/begin MEASUREMENT CoPT_stNSetPTra "Statuswort das Umsetzung der Getriebedrehzahlanforderungen definiert" UBYTE OneToOne 1 100 0.00 255.0 FORMAT "%5.1" ECU_ADDRESS 0xD0008F5D /end MEASUREMENT
/begin MEASUREMENT CoPT_tiASTDes "Getriebe Synchronisationszeit" SWORD Time_s 1 100 -327.6800 327.6700 FORMAT "%8.4" ECU_ADDRESS 0xD0006C98 /end MEASUREMENT
/begin MEASUREMENT CoPT_trqCurrEng "Verbrennungsmotorvorhaltmoment (Kupplungsmoment)" SWORD Trq 1 100 -3276.800 3276.700 FORMAT "%8.3" ECU_ADDRESS 0xD0006C9C /end MEASUREMENT
/begin MEASUREMENT CoPT_trqDesCompEng "Verbrennungsmotorkompensationsmoment" SWORD Trq 1 100 -3276.800 3276.700 FORMAT "%8.3" ECU_ADDRESS 0xD0006CA2 /end MEASUREMENT
/begin MEASUREMENT CoPT_trqDesEng "Verbrennungsmotorsollmoment (Kupplungsmoment)" SWORD Trq 1 100 -3276.800 3276.700 FORMAT "%8.3" ECU_ADDRESS 0xD0006CA4 /end MEASUREMENT
/begin MEASUREMENT CoPT_trqLeadEng "Verbrennungsmotor(Curr)vorhaltmoment (Kupplungsmoment)" SWORD Trq 1 100 -3276.800 3276.700 FORMAT "%8.3" ECU_ADDRESS 0xD0006CAA /end MEASUREMENT
/begin MEASUREMENT CoPT_trqLeadPOpEng "Vorhaltmoment zur BDE-Betriebsartenauswahl" SWORD Trq 1 100 -3276.800 3276.700 FORMAT "%8.3" ECU_ADDRESS 0xD0006CAE /end MEASUREMENT
/begin MEASUREMENT CoPT_trqResvCnstEng "Konstante Verbrennungsmotormomentenreserve" SWORD Trq 1 100 -3276.800 3276.700 FORMAT "%8.3" ECU_ADDRESS 0xD0006CB4 /end MEASUREMENT
/begin MEASUREMENT CoPT_trqResvRelEng "Relative Verbrennungsmotormomentenreserve" SWORD Trq 1 100 -3276.800 3276.700 FORMAT "%8.3" ECU_ADDRESS 0xD0006CB6 /end MEASUREMENT
/begin MEASUREMENT Dfftl_bLowRng "" UBYTE OneToOne 1 100 0.00 255.0 FORMAT "%5.1" ECU_ADDRESS 0xD0008FCF /end MEASUREMENT
/begin MEASUREMENT Eng_stStopEna "" UBYTE OneToOne 1 100 0.00 255.0 FORMAT "%5.1" ECU_ADDRESS 0xD0008FF4 /end MEASUREMENT
/begin MEASUREMENT Eng_stStrtEna "" UBYTE OneToOne 1 100 0.00 255.0 FORMAT "%5.1" ECU_ADDRESS 0xD0008FF5 /end MEASUREMENT
/begin MEASUREMENT Exh_pAdapPPFltUs "" SWORD Pres_hPa 1 100 -32768.00 3500.00 FORMAT "%8.2" ECU_ADDRESS 0xD0006E94 /end MEASUREMENT
/begin MEASUREMENT Exh_pFltPPFltUs "" SWORD Pres_hPa 1 100 -32768.00 3500.00 FORMAT "%8.2" ECU_ADDRESS 0xD0006EB0 /end MEASUREMENT
/begin MEASUREMENT Exh_pPFltUs "" SWORD Pres_hPa 1 100 -32768.00 3500.00 FORMAT "%8.2" ECU_ADDRESS 0xD0006EB6 /end MEASUREMENT
/begin MEASUREMENT Exh_pSensPPFltUs "" SWORD Pres_hPa 1 100 -32768.00 3500.00 FORMAT "%8.2" ECU_ADDRESS 0xD0006EBE /end MEASUREMENT
/begin MEASUREMENT Exh_uRawPPFltUs "" SWORD Volt 1 100 -6553.600 6553.400 FORMAT "%8.3" ECU_ADDRESS 0xD0006EE4 /end MEASUREMENT
/begin MEASUREMENT GbxNPos_st "" UBYTE OneToOne 1 100 0.00 255.0 FORMAT "%5.1" ECU_ADDRESS 0xD000901E /end MEASUREMENT
/begin MEASUREMENT Gbx_bASTIntv "" UBYTE OneToOne 1 100 0.00 255.0 FORMAT "%5.1" ECU_ADDRESS 0xD0006F52 /end MEASUREMENT
/begin MEASUREMENT Gbx_bASTNeutr "" UBYTE OneToOne 1 100 0.00 255.0 FORMAT "%5.1" ECU_ADDRESS 0xD0006F54 /end MEASUREMENT
/begin MEASUREMENT Gbx_bRevGear "" UBYTE OneToOne 1 100 0.00 255.0 FORMAT "%5.1" ECU_ADDRESS 0xD000901F /end MEASUREMENT
/begin MEASUREMENT Gbx_nASTDes "" SWORD EngN 1 100 -16384.00 16383.50 FORMAT "%8.2" ECU_ADDRESS 0xD0006F58 /end MEASUREMENT
/begin MEASUREMENT Gbx_nIdlDes "" SWORD EngN 1 100 -16384.00 16383.50 FORMAT "%8.2" ECU_ADDRESS 0xD0006F5A /end MEASUREMENT
/begin MEASUREMENT Gbx_nTrbn "" SWORD EngN 1 100 -16384.00 16383.50 FORMAT "%8.2" ECU_ADDRESS 0xD0006F5C /end MEASUREMENT
/begin MEASUREMENT Gbx_rFanClgDem "" SWORD Prc 1 100 -400.0000 399.9878 FORMAT "%8.4" ECU_ADDRESS 0xD0006F5E /end MEASUREMENT
/begin MEASUREMENT Gbx_rTrq "" SWORD TransR 1 100 -327.6800 327.6700 FORMAT "%8.4" ECU_ADDRESS 0xD0006F60 /end MEASUREMENT
/begin MEASUREMENT Gbx_rTrqTra "" SWORD TransR 1 100 -327.6800 327.6700 FORMAT "%8.4" ECU_ADDRESS 0xD0006F62 /end MEASUREMENT
/begin MEASUREMENT Gbx_stConvClth "Wandlerkupplung" UBYTE OneToOne 1 100 0.00 255.0 FORMAT "%5.1" ECU_ADDRESS 0xD0009020 /end MEASUREMENT
/begin MEASUREMENT Gbx_stGear "" UBYTE OneToOne 1 100 0.00 255.0 FORMAT "%5.1" ECU_ADDRESS 0xD0009021 /end MEASUREMENT
/begin MEASUREMENT Gbx_stGearLvr "" UBYTE OneToOne 1 100 0.00 255.0 FORMAT "%5.1" ECU_ADDRESS 0xD0009022 /end MEASUREMENT
/begin MEASUREMENT Gbx_stGearTrgt "" UBYTE OneToOne 1 100 0.00 255.0 FORMAT "%5.1" ECU_ADDRESS 0xD0009023 /end MEASUREMENT
/begin MEASUREMENT Gbx_tClntDes "" SWORD Temp_Cels 1 100 -3549.940 3003.560 FORMAT "%8.3" ECU_ADDRESS 0xD0006F64 /end MEASUREMENT
/begin MEASUREMENT Gbx_tiASTDes "" SWORD Time_s 1 100 -327.6800 327.6700 FORMAT "%8.4" ECU_ADDRESS 0xD0006F68 /end MEASUREMENT
/begin MEASUREMENT Gbx_tOilConv "" SWORD Temp_Cels 1 100 -3549.940 3003.560 FORMAT "%8.3" ECU_ADDRESS 0xD0006F66 /end MEASUREMENT
/begin MEASUREMENT Gbx_trqConvLos "" SWORD Trq 1 100 -3276.800 3276.700 FORMAT "%8.3" ECU_ADDRESS 0xD0006F6A /end MEASUREMENT
/begin MEASUREMENT Prp_stIARls "" UBYTE OneToOne 1 100 0.00 255.0 FORMAT "%5.1" ECU_ADDRESS 0xD0009141 /end MEASUREMENT
/begin MEASUREMENT Prp_trqDCS_mp "" SLONG TrqPrpHigh 1 100 -214748364.800 214748364.700 FORMAT "%13.3" ECU_ADDRESS 0xC0001794 /end MEASUREMENT
/begin MEASUREMENT Prp_trqIntv_mp "" SLONG TrqPrpHigh 1 100 -214748364.800 214748364.700 FORMAT "%13.3" ECU_ADDRESS 0xC0001798 /end MEASUREMENT
/begin MEASUREMENT Prp_trqLeadIntv_mp "" SLONG TrqPrpHigh 1 100 -214748364.800 214748364.700 FORMAT "%13.3" ECU_ADDRESS 0xC000179C /end MEASUREMENT
/begin MEASUREMENT PSPCtl_dvolBaseLim_mp "" SWORD FlConsum_l_h 1 100 -327.6800 327.6700 FORMAT "%8.4" ECU_ADDRESS 0xC00017A0 /end MEASUREMENT
/begin MEASUREMENT PSPCtl_dvolBase_mp "" SWORD FlConsum_l_h 1 100 -327.6800 327.6700 FORMAT "%8.4" ECU_ADDRESS 0xC00017A2 /end MEASUREMENT
/begin MEASUREMENT PSPCtl_dvolCalc_mp "" SWORD FlConsum_l_h 1 100 -327.6800 327.6700 FORMAT "%8.4" ECU_ADDRESS 0xC00017A4 /end MEASUREMENT
/begin MEASUREMENT PSPCtl_dvolLim_mp "" SWORD FlConsum_l_h 1 100 -327.6800 327.6700 FORMAT "%8.4" ECU_ADDRESS 0xC00017A6 /end MEASUREMENT
/begin MEASUREMENT PSPCtl_dvolT15Delay_mp "" SWORD FlConsum_l_h 1 100 -327.6800 327.6700 FORMAT "%8.4" ECU_ADDRESS 0xC00017A8 /end MEASUREMENT
/begin MEASUREMENT PSPCtl_stLogic_mp "" SWORD OneToOne 1 100 -32768.00 32767.00 FORMAT "%8.2" ECU_ADDRESS 0xC00017AA /end MEASUREMENT
/begin MEASUREMENT PSPCtl_tiT15Delay_mp "" SWORD Time_ms 1 100 -327680.0 327670.0 FORMAT "%8.1" ECU_ADDRESS 0xC00017AC /end MEASUREMENT
/begin MEASUREMENT PSP_dvolOut "" SWORD FlConsum_l_h 1 100 -327.6800 327.6700 FORMAT "%8.4" ECU_ADDRESS 0xD000745E /end MEASUREMENT
/begin MEASUREMENT PSP_st "" UBYTE OneToOne 1 100 0.00 255.0 FORMAT "%5.1" ECU_ADDRESS 0xD000912E /end MEASUREMENT
/begin MEASUREMENT PSP_stPs_mp "Ansteuersignal der Endstufe für die Vorförderpumpe (1=Ein/0=Aus)" UBYTE OneToOne 1 100 0.00 255.0 FORMAT "%5.1" ECU_ADDRESS 0xC00017AE /end MEASUREMENT
/begin MEASUREMENT PthLead_stActvMonLim "Status der Momentebegrenzung durch die Überwachung" UBYTE OneToOne 1 100 0.00 255.0 FORMAT "%5.1" ECU_ADDRESS 0xD0009142 /end MEASUREMENT
/begin MEASUREMENT PthLead_trqInrCurr "Inneres Moment für den Curr-Pfad" SWORD Trq 1 100 -3276.800 3276.700 FORMAT "%8.3" ECU_ADDRESS 0xD0007474 /end MEASUREMENT
/begin MEASUREMENT PthLead_trqInrCurrNoMo_mp "Inneres Moment vor der Überwachungsbegrenzung für den Curr-Pfad" SWORD Trq 1 100 -3276.800 3276.700 FORMAT "%8.3" ECU_ADDRESS 0xC00017B0 /end MEASUREMENT
/begin MEASUREMENT PthLead_trqInrLead "Inneres Moment für den Lead-Pfad" SWORD Trq 1 100 -3276.800 3276.700 FORMAT "%8.3" ECU_ADDRESS 0xD0007476 /end MEASUREMENT
/begin MEASUREMENT PthLead_trqInrLeadNoMo_mp "Inneres Moment vor der Überwachungsbegrenzung für den Lead-Pfad" SWORD Trq 1 100 -3276.800 3276.700 FORMAT "%8.3" ECU_ADDRESS 0xC00017B2 /end MEASUREMENT
/begin MEASUREMENT PthSet_ctProcSet "Anzahl der addierten Momente in PthSet_trqInrSetSum" UBYTE OneToOne 1 100 0.00 255.0 FORMAT "%5.1" ECU_ADDRESS 0xD0009143 /end MEASUREMENT
/begin MEASUREMENT PthSet_dtrqRmpDwn_mp "Rampensteigung bei Schubabschaltung" SLONG RmpTrq 1 100 -3276800.00000 3276799.99847 FORMAT "%13.5" ECU_ADDRESS 0xC00017B4 /end MEASUREMENT
/begin MEASUREMENT PthSet_stActvMonLim "Status der Momentbegrenzung durch die Überwachung" UBYTE OneToOne 1 100 0.00 255.0 FORMAT "%5.1" ECU_ADDRESS 0xD0009144 /end MEASUREMENT
/begin MEASUREMENT PthSet_stDisable "Status der Schubabschaltung (0: nicht abgeschaltet; 1: abgeschaltet" UBYTE OneToOne 1 100 0.00 255.0 FORMAT "%5.1" ECU_ADDRESS 0xD0009145 /end MEASUREMENT
/begin MEASUREMENT PthSet_stOvrRun "Status der Schuberkennung (0: kein Schub erkannt; 1:Schub erkannt)" UBYTE OneToOne 1 100 0.00 255.0 FORMAT "%5.1" ECU_ADDRESS 0xD0009146 /end MEASUREMENT
/begin MEASUREMENT PthSet_stOvrRunCoord "Status der Schuberkennung im Schubkoordinator (0: kein Schub; 1: Schub)" UBYTE OneToOne 1 100 0.00 255.0 FORMAT "%5.1" ECU_ADDRESS 0xD0009147 /end MEASUREMENT
/begin MEASUREMENT PthSet_stRmp_mp "Status der Rampe für die Schubabschaltung (0: inaktiv; 1: aktiv)" UBYTE OneToOne 1 100 0.00 255.0 FORMAT "%5.1" ECU_ADDRESS 0xC00017B8 /end MEASUREMENT
/begin MEASUREMENT PthSet_tiRmpStrt_mp "Aktuelle Zeit für Rampenstart nach Schuberkennung" SWORD Time_ms 1 100 -327680.0 327670.0 FORMAT "%8.1" ECU_ADDRESS 0xC00017BA /end MEASUREMENT
/begin MEASUREMENT PthSet_tiSwtOff_mp "Aktuelle Zeit für Schubabschaltung nach Schuberkennung" SWORD Time_ms 1 100 -327680.0 327670.0 FORMAT "%8.1" ECU_ADDRESS 0xC00017BC /end MEASUREMENT
/begin MEASUREMENT PthSet_trqASDdcInit "Initialisierungswert für den Ausgang vom Ruckeldämpfer während aktiver Schubabschaltung" SWORD Trq 1 100 -3276.800 3276.700 FORMAT "%8.3" ECU_ADDRESS 0xD0007478 /end MEASUREMENT
/begin MEASUREMENT PthSet_trqASDrfInit "Initialisierungswert für den Ausgang vom Führungsformer während aktiver Schubabschaltung" SWORD Trq 1 100 -3276.800 3276.700 FORMAT "%8.3" ECU_ADDRESS 0xD000747A /end MEASUREMENT
/begin MEASUREMENT PthSet_trqBefRmp_mp "inneres Moment für den Set-Pfad nach der zweiten Begrenzung vor der Schubabschaltung" SWORD Trq 1 100 -3276.800 3276.700 FORMAT "%8.3" ECU_ADDRESS 0xC00017BE /end MEASUREMENT
/begin MEASUREMENT PthSet_trqInrSet "inneres Moment für den Set-Pfad nach der Überwachungsbegrenzung" SWORD Trq 1 100 -3276.800 3276.700 FORMAT "%8.3" ECU_ADDRESS 0xD000747C /end MEASUREMENT
/begin MEASUREMENT PthSet_trqInrSetNoMo "" SWORD Trq 1 100 -3276.800 3276.700 FORMAT "%8.3" ECU_ADDRESS 0xD000747E /end MEASUREMENT
/begin MEASUREMENT PthSet_trqInrSetSum "" SWORD Trq 1 100 -3276.800 3276.700 FORMAT "%8.3" ECU_ADDRESS 0xD000768C /end MEASUREMENT
/begin MEASUREMENT PthSet_trqLimOffs_mp "Begrenzungsmoment mit Offset" SWORD Trq 1 100 -3276.800 3276.700 FORMAT "%8.3" ECU_ADDRESS 0xC00017C0 /end MEASUREMENT
/begin MEASUREMENT PthSet_trqRmp_mp "Ausgangsmoment der Schubabschlatungsrampe" SWORD Trq 1 100 -3276.800 3276.700 FORMAT "%8.3" ECU_ADDRESS 0xC00017C2 /end MEASUREMENT
/begin MEASUREMENT PthSet_trqSetASDdc "inneres Moment für den Set-Pfad nach der Rückeldampfer Subtraktion" SWORD Trq 1 100 -3276.800 3276.700 FORMAT "%8.3" ECU_ADDRESS 0xD0007480 /end MEASUREMENT
/begin MEASUREMENT PthSet_trqSetLim "inneres Moment für den Set-Pfad nach der ersten Begrenzung" SWORD Trq 1 100 -3276.800 3276.700 FORMAT "%8.3" ECU_ADDRESS 0xD0007482 /end MEASUREMENT
/begin MEASUREMENT PTODi_ctProcComp "process counter of TrqDesCoord" UBYTE OneToOne 1 100 0.00 255.0 FORMAT "%5.1" ECU_ADDRESS 0xD0009380 /end MEASUREMENT
/begin MEASUREMENT PTODi_ctProcDes "process counter of TrqDesCoord" UBYTE OneToOne 1 100 0.00 255.0 FORMAT "%5.1" ECU_ADDRESS 0xD0009382 /end MEASUREMENT
/begin MEASUREMENT PTODi_stCompLimDeb_mp "debounced status of compensated torque limitation" UBYTE OneToOne 1 100 0.00 255.0 FORMAT "%5.1" ECU_ADDRESS 0xC00017C4 /end MEASUREMENT
/begin MEASUREMENT PTODi_stCompLimUnDeb_mp "undebounced status of compensated torque limitation" UBYTE OneToOne 1 100 0.00 255.0 FORMAT "%5.1" ECU_ADDRESS 0xC00017C5 /end MEASUREMENT
/begin MEASUREMENT PTODi_stDesLimDeb_mp "debounced status of desired torque limitation" UBYTE OneToOne 1 100 0.00 255.0 FORMAT "%5.1" ECU_ADDRESS 0xC00017CC /end MEASUREMENT
/begin MEASUREMENT PTODi_stDesLimUnDeb_mp "undebounced status of desired torque limitation" UBYTE OneToOne 1 100 0.00 255.0 FORMAT "%5.1" ECU_ADDRESS 0xC00017CD /end MEASUREMENT
/begin MEASUREMENT PTODi_stLimCompAct "status limitation of compensated torque activ" UBYTE OneToOne 1 100 0.00 255.0 FORMAT "%5.1" ECU_ADDRESS 0xD000912F /end MEASUREMENT
/begin MEASUREMENT PTODi_stLimDesAct "status limitation of desired torque activ" UBYTE OneToOne 1 100 0.00 255.0 FORMAT "%5.1" ECU_ADDRESS 0xD0009130 /end MEASUREMENT
/begin MEASUREMENT PTODi_trqCompAvrg_mp "average torque compensated" SWORD Trq 1 100 -3276.800 3276.700 FORMAT "%8.3" ECU_ADDRESS 0xC00017C6 /end MEASUREMENT
/begin MEASUREMENT PTODi_trqCompOfs_mp "torque offset compensated torque" SWORD Trq 1 100 -3276.800 3276.700 FORMAT "%8.3" ECU_ADDRESS 0xC00017C8 /end MEASUREMENT
/begin MEASUREMENT PTODi_trqCompSum "sum of torque desired" SLONG Trq 1 100 -214748364.800 214748364.700 FORMAT "%13.3" ECU_ADDRESS 0xD0004A60 /end MEASUREMENT
/begin MEASUREMENT PTODi_trqDesAvrg_mp "average torque desired" SWORD Trq 1 100 -3276.800 3276.700 FORMAT "%8.3" ECU_ADDRESS 0xC00017CE /end MEASUREMENT
/begin MEASUREMENT PTODi_trqDesOfs_mp "torque offset desired torque" SWORD Trq 1 100 -3276.800 3276.700 FORMAT "%8.3" ECU_ADDRESS 0xC00017D0 /end MEASUREMENT
/begin MEASUREMENT PTODi_trqDesSum "sum of torque desired" SLONG Trq 1 100 -214748364.800 214748364.700 FORMAT "%13.3" ECU_ADDRESS 0xD0004A68 /end MEASUREMENT
/begin MEASUREMENT PTODi_trqMoComp_mp "torque monitoring permitted compensation" SWORD Trq 1 100 -3276.800 3276.700 FORMAT "%8.3" ECU_ADDRESS 0xC00017CA /end MEASUREMENT
/begin MEASUREMENT PTODi_trqMoPtd_mp "torque monitoring permitted" SWORD Trq 1 100 -3276.800 3276.700 FORMAT "%8.3" ECU_ADDRESS 0xC00017D2 /end MEASUREMENT
/begin MEASUREMENT PT_dnAbsEng_mp "" SWORD dn_dZfine 1 100 -16384.00 16383.50 FORMAT "%8.2" ECU_ADDRESS 0xC00017D6 /end MEASUREMENT
/begin MEASUREMENT PT_dnEng_mp "" SWORD dn_dZfine 1 100 -16384.00 16383.50 FORMAT "%8.2" ECU_ADDRESS 0xC00017D8 /end MEASUREMENT
/begin MEASUREMENT PT_dnGrip_mp "" SWORD dn_dZfine 1 100 -16384.00 16383.50 FORMAT "%8.2" ECU_ADDRESS 0xC00017DA /end MEASUREMENT
/begin MEASUREMENT PT_dnNoGrip_mp "" SWORD dn_dZfine 1 100 -16384.00 16383.50 FORMAT "%8.2" ECU_ADDRESS 0xC00017DC /end MEASUREMENT
/begin MEASUREMENT PT_rTrq "Antriebsstrang Momentenübersetzung" SWORD TransR 1 100 -327.6800 327.6700 FORMAT "%8.4" ECU_ADDRESS 0xD0007466 /end MEASUREMENT
/begin MEASUREMENT PT_rTrqTmp1_mp "Meßpunkt Ergebnis 1 für PT_rTrq" SWORD TransR 1 100 -327.6800 327.6700 FORMAT "%8.4" ECU_ADDRESS 0xC00017E4 /end MEASUREMENT
/begin MEASUREMENT PT_rTrqTmp2_mp "Meßpunkt Ergebnis 2 für PT_rTrq" SWORD TransR 1 100 -327.6800 327.6700 FORMAT "%8.4" ECU_ADDRESS 0xC00017E6 /end MEASUREMENT
/begin MEASUREMENT PT_stEngStopEna "" UBYTE OneToOne 1 100 0.00 255.0 FORMAT "%5.1" ECU_ADDRESS 0xD0009135 /end MEASUREMENT
/begin MEASUREMENT PT_stEngStrtEna "" UBYTE OneToOne 1 100 0.00 255.0 FORMAT "%5.1" ECU_ADDRESS 0xD0009136 /end MEASUREMENT
/begin MEASUREMENT PT_stGrip "Kraftschlusszustand Antriebsstrang" UBYTE OneToOne 1 100 0.00 255.0 FORMAT "%5.1" ECU_ADDRESS 0xD0009137 /end MEASUREMENT
/begin MEASUREMENT PT_stNoGripDet_mp "" UBYTE OneToOne 1 100 0.00 255.0 FORMAT "%5.1" ECU_ADDRESS 0xC00017DE /end MEASUREMENT
/begin MEASUREMENT PT_stPTGrip_mp "Messpunkt für Kraftschlusszustand Antriebsstrang" UBYTE OneToOne 1 100 0.00 255.0 FORMAT "%5.1" ECU_ADDRESS 0xC00017D4 /end MEASUREMENT
/begin MEASUREMENT PT_swtMstShft "" UBYTE OneToOne 1 100 0.00 255.0 FORMAT "%5.1" ECU_ADDRESS 0xD000913F /end MEASUREMENT
/begin MEASUREMENT PT_trqAbsGbxPT1_mp "" SWORD Trq 1 100 -3276.800 3276.700 FORMAT "%8.3" ECU_ADDRESS 0xC00017E0 /end MEASUREMENT
/begin MEASUREMENT PT_trqGbxPT1_mp "" SWORD Trq 1 100 -3276.800 3276.700 FORMAT "%8.3" ECU_ADDRESS 0xC00017E2 /end MEASUREMENT
/begin MEASUREMENT PT_trqLos "Verlustmoment des Antriebsstrangs" SWORD Trq 1 100 -3276.800 3276.700 FORMAT "%8.3" ECU_ADDRESS 0xD0007468 /end MEASUREMENT
/begin MEASUREMENT PT_trqLosComp "Verlustmoment des Antriebsstrangs" SWORD Trq 1 100 -3276.800 3276.700 FORMAT "%8.3" ECU_ADDRESS 0xD000746A /end MEASUREMENT
/begin MEASUREMENT PT_trqResv "Reservemomentanforderung des Antriebsstrangs" SWORD Trq 1 100 -3276.800 3276.700 FORMAT "%8.3" ECU_ADDRESS 0xD000746C /end MEASUREMENT
/begin MEASUREMENT PT_trqSpdGovLtd "Begrenztes Leerlaufreglermoment (Radmoment)" SLONG TrqPrpHigh 1 100 -214748364.800 214748364.700 FORMAT "%13.3" ECU_ADDRESS 0xD000437C /end MEASUREMENT
/begin MEASUREMENT PT_trqTraOut "Kupplungsistmoment" SLONG TrqPrpHigh 1 100 -214748364.800 214748364.700 FORMAT "%13.3" ECU_ADDRESS 0xD0004380 /end MEASUREMENT
/begin MEASUREMENT PT_trqTraOutBs "Basismoment (Getriebeausgangsmoment)" SLONG TrqPrpHigh 1 100 -214748364.800 214748364.700 FORMAT "%13.3" ECU_ADDRESS 0xD0004384 /end MEASUREMENT
/begin MEASUREMENT PT_trqTraOutWoDstC "Getriebeausgangsistmoment ohne Antiruckeleingriff" SLONG TrqPrpHigh 1 100 -214748364.800 214748364.700 FORMAT "%13.3" ECU_ADDRESS 0xD0004388 /end MEASUREMENT
/begin MEASUREMENT PT_trqWhl "Radistmoment" SLONG TrqPrpHigh 1 100 -214748364.800 214748364.700 FORMAT "%13.3" ECU_ADDRESS 0xD000438C /end MEASUREMENT
/begin MEASUREMENT PT_trqWhlBs "Basismoment (Radmoment)" SLONG TrqPrpHigh 1 100 -214748364.800 214748364.700 FORMAT "%13.3" ECU_ADDRESS 0xD0004390 /end MEASUREMENT
/begin MEASUREMENT PT_trqWhlMaxEng "Maximales Radmoment vom Verbrennungsmotor" SLONG TrqPrpHigh 1 100 -214748364.800 214748364.700 FORMAT "%13.3" ECU_ADDRESS 0xD0004394 /end MEASUREMENT
/begin MEASUREMENT PT_trqWhlMinEng "Minimales Radmoment vom Verbrennungsmotor" SLONG TrqPrpHigh 1 100 -214748364.800 214748364.700 FORMAT "%13.3" ECU_ADDRESS 0xD0004398 /end MEASUREMENT
/begin MEASUREMENT PT_trqWhlMinWoCtOff "Minimales Radmoment mit Befeuerung vom Verbrennungsmotor" SLONG TrqPrpHigh 1 100 -214748364.800 214748364.700 FORMAT "%13.3" ECU_ADDRESS 0xD000439C /end MEASUREMENT
/begin MEASUREMENT PT_trqWhlWoDstC "Radsistmoment ohne Antiruckeleingriff" SLONG TrqPrpHigh 1 100 -214748364.800 214748364.700 FORMAT "%13.3" ECU_ADDRESS 0xD00043A0 /end MEASUREMENT
/begin MEASUREMENT QWC_CEngDsT_mp "" SWORD Temp_Cels 1 100 -3549.940 3003.560 FORMAT "%8.3" ECU_ADDRESS 0xC00017E8 /end MEASUREMENT
/begin MEASUREMENT QWC_facFTS "Faktor der Druckwellenkorrektur abhängig von der Kraftstofftemperatur" SWORD Fact 1 100 -4.000000 3.999878 FORMAT "%8.6" ECU_ADDRESS 0xD0007486 /end MEASUREMENT
/begin MEASUREMENT QWC_facMI1PoI2_mp "Gewichtungsfaktor zur Aktivierung/Deaktivierung der Druckwellenmengenänderung von MI1 durch PoI2" SWORD Fact1 1 100 -256.0000 255.9922 FORMAT "%8.4" ECU_ADDRESS 0xC00017EC /end MEASUREMENT
/begin MEASUREMENT QWC_facPiI2PiI1_mp "Gewichtungsfaktor zur Aktivierung/Deaktivierung der Druckwellenmengenänderung von PiI2 durch PiI1" SWORD Fact1 1 100 -256.0000 255.9922 FORMAT "%8.4" ECU_ADDRESS 0xC00017EE /end MEASUREMENT
/begin MEASUREMENT QWC_facPiIMI1_mp "Gewichtungsfaktor zur Aktivierung/Deaktivierung der Druckwellenmengenänderung von PiI1 durch MI1" SWORD Fact1 1 100 -256.0000 255.9922 FORMAT "%8.4" ECU_ADDRESS 0xC00017F0 /end MEASUREMENT
/begin MEASUREMENT QWC_FuelT_mp "" SWORD Temp_Cels 1 100 -3549.940 3003.560 FORMAT "%8.3" ECU_ADDRESS 0xC00017EA /end MEASUREMENT
/begin MEASUREMENT QWC_pCurrInDiffHyd_mp "Aktueller Raildruck als Eingangswert für das Kennfeld QWC_tiDiffHyd_MAP" SWORD Pres_Rail 1 100 -3276.800 2000.000 FORMAT "%5.3" ECU_ADDRESS 0xC000180C /end MEASUREMENT
/begin MEASUREMENT QWC_qDesInDiffHyd_mp "Gewünschte Einspritzmenge als Eingangswert für das Kennfeld QWC_tiDiffHyd_MAP" SWORD InjMassInj 1 100 -327.6800 327.6700 FORMAT "%8.4" ECU_ADDRESS 0xC000180E /end MEASUREMENT
/begin MEASUREMENT QWC_qMI1 "Druckwellenkorrekturmenge der MI1" SWORD InjMass 1 100 -327.6800 327.6700 FORMAT "%8.4" ECU_ADDRESS 0xD0007488 /end MEASUREMENT
/begin MEASUREMENT QWC_qMI1PoI2_mp "Grundwert der Druckwellenkorrekturmenge der MI1 abhängig von PoI2" SWORD InjMass 1 100 -327.6800 327.6700 FORMAT "%8.4" ECU_ADDRESS 0xC00017F2 /end MEASUREMENT
/begin MEASUREMENT QWC_qNorm "Einspritznormierungsmenge" SWORD InjMass 1 100 -327.6800 327.6700 FORMAT "%8.4" ECU_ADDRESS 0xD000748A /end MEASUREMENT
/begin MEASUREMENT QWC_qPiI1 "Druckwellenkorrekturmenge der PiI1" SWORD InjMass 1 100 -327.6800 327.6700 FORMAT "%8.4" ECU_ADDRESS 0xD000748C /end MEASUREMENT
/begin MEASUREMENT QWC_qPiI1MI1_mp "Grundwert der Druckwellenkorrekturmenge der PiI1 abhängig von MI1" SWORD InjMass 1 100 -327.6800 327.6700 FORMAT "%8.4" ECU_ADDRESS 0xC00017F4 /end MEASUREMENT
/begin MEASUREMENT QWC_qPiI2MI1_mp "Grundwert der Druckwellenkorrekturmenge der PiI2 abhängig von MI1" SWORD InjMass 1 100 -327.6800 327.6700 FORMAT "%8.4" ECU_ADDRESS 0xC00017F6 /end MEASUREMENT
/begin MEASUREMENT QWC_qPiI2PiI1_mp "Grundwert der Druckwellenkorrekturmenge der PiI2 abhängig von PiI1" SWORD InjMass 1 100 -327.6800 327.6700 FORMAT "%8.4" ECU_ADDRESS 0xC00017F8 /end MEASUREMENT
/begin MEASUREMENT QWC_qPoI2 "Druckwellenkorrekturmenge der PoI2" SWORD InjMass 1 100 -327.6800 327.6700 FORMAT "%8.4" ECU_ADDRESS 0xD000748E /end MEASUREMENT
/begin MEASUREMENT QWC_rMI1Norm_mp "Raildruckabhängiges normiertes MiI1 Einspritzverhältnis für Druckwellenkorrektur" SWORD QntR 1 100 -32.00000 31.99902 FORMAT "%8.5" ECU_ADDRESS 0xC00017FA /end MEASUREMENT
/begin MEASUREMENT QWC_st "Status der Druckwellenkorrektur" UBYTE OneToOne 1 100 0.00 255.0 FORMAT "%5.1" ECU_ADDRESS 0xD0009148 /end MEASUREMENT
/begin MEASUREMENT QWC_tCor "Eingangstemperatur für die Druckwellenkorrektur" SWORD Temp_Cels 1 100 -3549.940 3003.560 FORMAT "%8.3" ECU_ADDRESS 0xD0007490 /end MEASUREMENT
/begin MEASUREMENT QWC_tiMI1DiffHydCor_mp "Differenz zwischen hydraulischem Nadelschliessende und elektrischem Ansteuerende des Injektors für die MI1" SWORD InjTime_us 1 100 -13107.20 5000.00 FORMAT "%8.2" ECU_ADDRESS 0xC0001810 /end MEASUREMENT
/begin MEASUREMENT QWC_tiMI1PoI2Cor_mp "Korrigierter Zeitabstand zwischen MI1 und PoI1" SWORD InjTime_us 1 100 -13107.20 5000.00 FORMAT "%8.2" ECU_ADDRESS 0xC00017FC /end MEASUREMENT
/begin MEASUREMENT QWC_tiMI1PoI2_mp "Zeitabstand Ende MI1 bis Beginn PoI2" SWORD InjTime_us 1 100 -13107.20 5000.00 FORMAT "%8.2" ECU_ADDRESS 0xC00017FE /end MEASUREMENT
/begin MEASUREMENT QWC_tiPiI1DiffHydCor_mp "Differenz zwischen hydraulischem Nadelschliessende und elektrischem Ansteuerende des Injektors für die PiI1" SWORD InjTime_us 1 100 -13107.20 5000.00 FORMAT "%8.2" ECU_ADDRESS 0xC0001812 /end MEASUREMENT
/begin MEASUREMENT QWC_tiPiI1MI1Cor_mp "Korrigierter Zeitabstand zwischen PiI1 und MI1" SWORD InjTime_us 1 100 -13107.20 5000.00 FORMAT "%8.2" ECU_ADDRESS 0xC0001800 /end MEASUREMENT
/begin MEASUREMENT QWC_tiPiI1MI1_mp "Zeitabstand Ende PiI1 bis Beginn MI1" UWORD InjTime_us 1 100 0.00 5000.00 FORMAT "%8.2" ECU_ADDRESS 0xC0001802 /end MEASUREMENT
/begin MEASUREMENT QWC_tiPiI2DiffHydCor_mp "Differenz zwischen hydraulischem Nadelschliessende und elektrischem Ansteuerende des Injektors für die PiI2" SWORD InjTime_us 1 100 -13107.20 5000.00 FORMAT "%8.2" ECU_ADDRESS 0xC0001814 /end MEASUREMENT
/begin MEASUREMENT QWC_tiPiI2MI1Cor_mp "Korrigierter Zeitabstand zwischen PiI2 und MI1" SWORD InjTime_us 1 100 -13107.20 5000.00 FORMAT "%8.2" ECU_ADDRESS 0xC0001804 /end MEASUREMENT
/begin MEASUREMENT QWC_tiPiI2MI1_mp "Zeitabstand Ende PiI2 bis Beginn MI1" UWORD InjTime_us 1 100 0.00 5000.00 FORMAT "%8.2" ECU_ADDRESS 0xC0001806 /end MEASUREMENT
/begin MEASUREMENT QWC_tiPiI2PiI1Cor_mp "Korrigierter Zeitabstand zwischen PiI2 und PiI1" SWORD InjTime_us 1 100 -13107.20 5000.00 FORMAT "%8.2" ECU_ADDRESS 0xC0001808 /end MEASUREMENT
/begin MEASUREMENT QWC_tiPiI2PiI1_mp "Zeitabstand Ende PiI2 bis Beginn PiI1" UWORD InjTime_us 1 100 0.00 5000.00 FORMAT "%8.2" ECU_ADDRESS 0xC000180A /end MEASUREMENT
/begin MEASUREMENT RadSht_stLogic_mp "" UBYTE OneToOne 1 100 0.00 255.0 FORMAT "%5.1" ECU_ADDRESS 0xC0001816 /end MEASUREMENT
/begin MEASUREMENT RailP_pCurr_mp "aktueller Kraftstoffdruck" SWORD Pres_Rail 1 100 -3276.800 2000.000 FORMAT "%5.3" ECU_ADDRESS 0xC000181E /end MEASUREMENT
/begin MEASUREMENT RailP_pFlt "maximaler Raildruck der letzten 10ms" SWORD Pres_Rail 1 100 -3276.800 2000.000 FORMAT "%5.3" ECU_ADDRESS 0xD0007492 /end MEASUREMENT
/begin MEASUREMENT RailP_pFltWinNeg_mp "Raildruckabfall, ab welchem auf Großsignalparameter umgeschaltet wird" SWORD Pres_Rail 1 100 -3276.800 2000.000 FORMAT "%5.3" ECU_ADDRESS 0xC0001820 /end MEASUREMENT
/begin MEASUREMENT RailP_pLin "linearisierter Wert des Kraftstoffdrucksensors" SWORD Pres_Rail 1 100 -3276.800 2000.000 FORMAT "%5.3" ECU_ADDRESS 0xD0007494 /end MEASUREMENT
/begin MEASUREMENT RailP_pLinCurr_mp "SRC-Maximum Vorgabewert" SWORD Pres_Rail 1 100 -3276.800 2000.000 FORMAT "%5.3" ECU_ADDRESS 0xC0001818 /end MEASUREMENT
/begin MEASUREMENT RailP_stEngStrtMov_mp "Motorbewegung bei Offset-Überwachung des Raildrucksensors festgestellt" UBYTE OneToOne 1 100 0.00 255.0 FORMAT "%5.1" ECU_ADDRESS 0xC0001828 /end MEASUREMENT
/begin MEASUREMENT RailP_stMon_mp "Überwachungsstatus des Spannungsoffsets des Raildrucksensors" UBYTE OneToOne 1 100 0.00 255.0 FORMAT "%5.1" ECU_ADDRESS 0xC0001829 /end MEASUREMENT
/begin MEASUREMENT RailP_stOfsTstMon "aktueller Zustand der Offset-Überwachung für den Raildrucksensor" UBYTE OneToOne 1 100 0.00 255.0 FORMAT "%5.1" ECU_ADDRESS 0xD0009149 /end MEASUREMENT
/begin MEASUREMENT RailP_stSRCCurr_mp "SRC-Maximum Vorgabewert" UBYTE OneToOne 1 100 0.00 255.0 FORMAT "%5.1" ECU_ADDRESS 0xC000181A /end MEASUREMENT
/begin MEASUREMENT RailP_stSubsVal "" UBYTE OneToOne 1 100 0.00 255.0 FORMAT "%5.1" ECU_ADDRESS 0xD000914A /end MEASUREMENT
/begin MEASUREMENT RailP_tClntLstCyc_mp "Wassertemperatur vom letzten Fahrzyklus für die Offset-Überwachung des Raildrucksensors" SWORD Temp_Cels 1 100 -3549.940 3003.560 FORMAT "%8.3" ECU_ADDRESS 0xC000182A /end MEASUREMENT
/begin MEASUREMENT RailP_tiFltPT1_mp "momentane Filterzeit für PT1 Filter" ULONG TimeDelay_s 1 100 0.000001000000000 4294.9672960 FORMAT "%12.7" ECU_ADDRESS 0xC0001824 /end MEASUREMENT
/begin MEASUREMENT RailP_tiOfsTstDel_mp "Verzögerungszeit = f(RailP_pFlt) für Offset-Test des Raildrucksensors" SWORD TimeRed 1 100 -5242.880 5242.720 FORMAT "%8.3" ECU_ADDRESS 0xC000182C /end MEASUREMENT
/begin MEASUREMENT RailP_uOfsAftRun "Spannungswert des Raildrucksensors während aktiver Überwachung im Nachlauf" SWORD Volt 1 100 -6553.600 6553.400 FORMAT "%8.3" ECU_ADDRESS 0xD0007496 /end MEASUREMENT
/begin MEASUREMENT RailP_uOfsStrt "Spannungswert des Raildrucksensors während aktiver Überwachung in der Startphase" SWORD Volt 1 100 -6553.600 6553.400 FORMAT "%8.3" ECU_ADDRESS 0xD000749C /end MEASUREMENT
/begin MEASUREMENT RailP_uRaw "Rohwert des Raildrucks" SWORD Volt 1 100 -6553.600 6553.400 FORMAT "%8.3" ECU_ADDRESS 0xD00074A2 /end MEASUREMENT
/begin MEASUREMENT Rail_ctPMonStrt_mp "Counter für die Raildrucküberwachung beim Start" SWORD Time_ms 1 100 -327680.0 327670.0 FORMAT "%8.1" ECU_ADDRESS 0xC00018F0 /end MEASUREMENT
/begin MEASUREMENT Rail_dpSetPointInc "maximaler Raildruck-Sollwertanstieg pro Sekunde" SWORD PresRail_sec 1 100 -13107.200 13106.800 FORMAT "%5.3" ECU_ADDRESS 0xD00074A4 /end MEASUREMENT
/begin MEASUREMENT Rail_dvolCPCDvtFlt_mp "gefilterte Volumenstromabweichung" SWORD Qp_mm3_sec 1 100 -327680.0 327670.0 FORMAT "%8.1" ECU_ADDRESS 0xC000182E /end MEASUREMENT
/begin MEASUREMENT Rail_dvolCPCDvt_mp "selektierte Volumenstromabweichung" SWORD Qp_mm3_sec 1 100 -327680.0 327670.0 FORMAT "%8.1" ECU_ADDRESS 0xC0001830 /end MEASUREMENT
/begin MEASUREMENT Rail_dvolEstAged "geschätzter Volumenstrom eines gealterten Systems" SWORD Qp_mm3_sec 1 100 -327680.0 327670.0 FORMAT "%8.1" ECU_ADDRESS 0xD00074A6 /end MEASUREMENT
/begin MEASUREMENT Rail_dvolInjVlvCtl_mp "Korrekturwert der Vorsteuerung unter Berücksichtigung der Steuermengen für die Injektoren" SWORD Qp_mm3_sec 1 100 -327680.0 327670.0 FORMAT "%8.1" ECU_ADDRESS 0xC00018F2 /end MEASUREMENT
/begin MEASUREMENT Rail_dvolLeak_mp "Leckage des Hochdrucksystems" SWORD Qp_mm3_sec 1 100 -327680.0 327670.0 FORMAT "%8.1" ECU_ADDRESS 0xC00018F4 /end MEASUREMENT
/begin MEASUREMENT Rail_dvolMeUnCtlDT1_mp "DT1-Anteil des Druckreglers über Zumesseinheit" SWORD Qp_mm3_sec 1 100 -327680.0 327670.0 FORMAT "%8.1" ECU_ADDRESS 0xC000188C /end MEASUREMENT
/begin MEASUREMENT Rail_dvolMeUnCtlI "I-Anteil des Druckreglers der Zumesseinheit" SWORD Qp_mm3_sec 1 100 -327680.0 327670.0 FORMAT "%8.1" ECU_ADDRESS 0xD00074A8 /end MEASUREMENT
/begin MEASUREMENT Rail_dvolMeUnCtlP_mp "P-Anteil des Druckreglers über Zumesseinheit" SWORD Qp_mm3_sec 1 100 -327680.0 327670.0 FORMAT "%8.1" ECU_ADDRESS 0xC000188E /end MEASUREMENT
/begin MEASUREMENT Rail_dvolMeUnCtlUpLim "obere Stellwertbegrenzung für Druckregelung über Zumesseinheit" SWORD Qp_mm3_sec 1 100 -327680.0 327670.0 FORMAT "%8.1" ECU_ADDRESS 0xD00074AA /end MEASUREMENT
/begin MEASUREMENT Rail_dvolMeUnDvt "Regelabweichung des Volumenstroms" SWORD Qp_mm3_sec 1 100 -327680.0 327670.0 FORMAT "%8.1" ECU_ADDRESS 0xD00074AC /end MEASUREMENT
/begin MEASUREMENT Rail_dvolPreCtl "Vorsteuerwert für die Druckregelung über Zumesseinheit" SWORD Qp_mm3_sec 1 100 -327680.0 327670.0 FORMAT "%8.1" ECU_ADDRESS 0xD00074AE /end MEASUREMENT
/begin MEASUREMENT Rail_dvolPreCtlBas_mp "Basisvorsteuerwert aus Kennfeld für die Druckregelung über Zumesseinheit" SWORD Qp_mm3_sec 1 100 -327680.0 327670.0 FORMAT "%8.1" ECU_ADDRESS 0xC00018F6 /end MEASUREMENT
/begin MEASUREMENT Rail_dvolPreCtlInit_mp "Initialisierungswert der Vorsteuerung für die Druckregelung über Zumesseinheit" SWORD Qp_mm3_sec 1 100 -327680.0 327670.0 FORMAT "%8.1" ECU_ADDRESS 0xC00018F8 /end MEASUREMENT
/begin MEASUREMENT Rail_dvolPreCtlOfs_mp "Offset aus Kennfeld für die Vorsteuerung der Druckregelung über Zumesseinheit" SWORD Qp_mm3_sec 1 100 -327680.0 327670.0 FORMAT "%8.1" ECU_ADDRESS 0xC00018FA /end MEASUREMENT
/begin MEASUREMENT Rail_dvolPreCtlPoI1_mp "Vorsteuerwert abhängig von der Nacheinspritzmenge 1 für die Druckregelung über Zumesseinheit" SWORD Qp_mm3_sec 1 100 -327680.0 327670.0 FORMAT "%8.1" ECU_ADDRESS 0xC00018FC /end MEASUREMENT
/begin MEASUREMENT Rail_dvolPreCtlPoI2_mp "Vorsteuerwert abhängig von der Nacheinspritzmenge 2 für die Druckregelung über Zumesseinheit" SWORD Qp_mm3_sec 1 100 -327680.0 327670.0 FORMAT "%8.1" ECU_ADDRESS 0xC00018FE /end MEASUREMENT
/begin MEASUREMENT Rail_dvolSetPoint_mp "Raildrucksollwert abhängig vom Volumenstrom" SWORD Qp_mm3_sec 1 100 -327680.0 327670.0 FORMAT "%8.1" ECU_ADDRESS 0xC0001832 /end MEASUREMENT
/begin MEASUREMENT Rail_facAPSetPDynCor_mp "Messpunkt für den Gewichtungsfaktor des Raildrucksollwerts in Abhängigkeit vom Umgebungsdruck" SWORD Fact 1 100 -4.000000 3.999878 FORMAT "%8.6" ECU_ADDRESS 0xC000192E /end MEASUREMENT
/begin MEASUREMENT Rail_facDQSetPDynCor_mp "Messpunkt für den Gewichtungsfaktor der Raildrucksollwertkorrektur in Abhängigkeit von der Einspritzmengenänderung" SWORD Fact 1 100 -4.000000 3.999878 FORMAT "%8.6" ECU_ADDRESS 0xC0001930 /end MEASUREMENT
/begin MEASUREMENT Rail_facETSetPDynCor_mp "Messpunkt für den Gewichtungsfaktor der Raildrucksollwertkorrektur in Abhängigkeit von der Motortemperatur" SWORD Fact 1 100 -4.000000 3.999878 FORMAT "%8.6" ECU_ADDRESS 0xC0001932 /end MEASUREMENT
/begin MEASUREMENT Rail_facIASetPDynCor_mp "Messpunkt für den Gewichtungsfaktor der Raildrucksollwertkorrektur in Abhängigkeit von der Ansaugluft Temperatur" SWORD Fact 1 100 -4.000000 3.999878 FORMAT "%8.6" ECU_ADDRESS 0xC0001934 /end MEASUREMENT
/begin MEASUREMENT Rail_facMeUnTiRmpVal_mp "aktueller Rampenwert der Rampe bei Umschaltung von Regelung über Zumesseinheit auf Regelung über Druckregelventil" SWORD Fact 1 100 -4.000000 3.999878 FORMAT "%8.6" ECU_ADDRESS 0xC000183C /end MEASUREMENT
/begin MEASUREMENT Rail_facPCVTiRmpVal_mp "aktueller Rampenwert der Rampe bei Umschaltung von Regelung über Druckregelventil auf Regelung über Zumesseinheit" SWORD Fact 1 100 -4.000000 3.999878 FORMAT "%8.6" ECU_ADDRESS 0xC0001902 /end MEASUREMENT
/begin MEASUREMENT Rail_facSetPointAPSCStrt_mp "Messpunkt für den Gewichtungsfaktor der Raildrucksollwertkorrektur beim Start abhängig von der Umgebungsluftemperatur" SWORD Fact 1 100 -4.000000 3.999878 FORMAT "%8.6" ECU_ADDRESS 0xC0001936 /end MEASUREMENT
/begin MEASUREMENT Rail_facSetPointATSCStrt_mp "Messpunkt des Gewichtungsfaktors der Raildrucksollwertkorrektur beim Start abhängig von der Ansauglaufttemperatur" SWORD Fact 1 100 -4.000000 3.999878 FORMAT "%8.6" ECU_ADDRESS 0xC0001938 /end MEASUREMENT
/begin MEASUREMENT Rail_facSetPointETSCor1_mp "Messpunkt für den Gewichtungsfaktor der Raildrucksollwertkorrektur in Abhängigkeit von der Motortemperatur" SWORD Fact 1 100 -4.000000 3.999878 FORMAT "%8.6" ECU_ADDRESS 0xC000193A /end MEASUREMENT
/begin MEASUREMENT Rail_facSetPointETSCStrt_mp "Messpunkt für den Gewichtungsfaktor der Raildrucksollwertkorrektur beim Start abhängig von der Ansauglufttemperatur" SWORD Fact 1 100 -4.000000 3.999878 FORMAT "%8.6" ECU_ADDRESS 0xC000193A /end MEASUREMENT
/begin MEASUREMENT Rail_facSetPointFTSCor_mp "Gewichtungsfaktor für kraftstofftemperaturabhängige Sollwertkorrektur des Raildruckreglers" SWORD Fact 1 100 -4.000000 3.999878 FORMAT "%8.6" ECU_ADDRESS 0xC000193C /end MEASUREMENT
/begin MEASUREMENT Rail_facSetPointRmpVal_mp "Interpolationsfaktor für die Funktion Rail_RgnSwt" SWORD EGTSwt_S16 1 100 -2.000000 1.999939 FORMAT "%8.6" ECU_ADDRESS 0xC0001918 /end MEASUREMENT
/begin MEASUREMENT Rail_facTiRmpVal_mp "aktueller Rampenwert wenn von Offset-Kennlinie auf reduzierte Offset-Kennlinie und andersherum gerampt wird" SWORD Fact 1 100 -4.000000 3.999878 FORMAT "%8.6" ECU_ADDRESS 0xC0001904 /end MEASUREMENT
/begin MEASUREMENT Rail_MeUnCtlDKd_mp "D-Verstärkung der Druckregelung über Zumesseinheit" SLONG Kd_pRail2Q 1 100 -3276800.00000 3276799.99847 FORMAT "%16.5" ECU_ADDRESS 0xC0001848 /end MEASUREMENT
/begin MEASUREMENT Rail_MeUnCtlIKiNeg_mp "I-Verstärkung für negative Großsignale für die Druckregelung über Zumesseinheit" SLONG Ki_pRail2Q 1 100 -100000000.000 99999999.953 FORMAT "%16.3" ECU_ADDRESS 0xC000184C /end MEASUREMENT
/begin MEASUREMENT Rail_MeUnCtlIKiPos_mp "I-Verstärkung für positive Großsignale für die Druckregelung über Zumesseinheit" SLONG Ki_pRail2Q 1 100 -100000000.000 99999999.953 FORMAT "%16.3" ECU_ADDRESS 0xC0001850 /end MEASUREMENT
/begin MEASUREMENT Rail_MeUnCtlIKi_mp "I-Verstärkung für Kleinsignale für die Druckregelung über Zumesseinheit" SLONG Ki_pRail2Q 1 100 -100000000.000 99999999.953 FORMAT "%16.3" ECU_ADDRESS 0xC0001854 /end MEASUREMENT
/begin MEASUREMENT Rail_MeUnCtlPKpNeg_mp "P-Verstärkung für negative Großsignale für die Druckregelung über Zumesseinheit" SLONG Kp_pRail2Q 1 100 -6553600.00000 6553599.99695 FORMAT "%16.5" ECU_ADDRESS 0xC0001858 /end MEASUREMENT
/begin MEASUREMENT Rail_MeUnCtlPKpPos_mp "P-Verstärkung für positive Großsignale für die Druckregelung über Zumesseinheit" SLONG Kp_pRail2Q 1 100 -6553600.00000 6553599.99695 FORMAT "%16.5" ECU_ADDRESS 0xC000185C /end MEASUREMENT
/begin MEASUREMENT Rail_MeUnCtlPKp_mp "P-Verstärkung für Kleinsignale für die Druckregelung über Zumesseinheit" SLONG Kp_pRail2Q 1 100 -6553600.00000 6553599.99695 FORMAT "%16.5" ECU_ADDRESS 0xC0001860 /end MEASUREMENT
/begin MEASUREMENT Rail_pCPCFltMin_mp "Ausgang der Kennlinie Rail_pCPCFltMin_CUR" SWORD Pres_Rail 1 100 -3276.800 2000.000 FORMAT "%5.3" ECU_ADDRESS 0xC00018AA /end MEASUREMENT
/begin MEASUREMENT Rail_PCVCtlDKd_mp "D-Verstärkung der Druckregelung über Druckregelventil" SLONG Kd 1 100 -32768.0000000 32767.9999847 FORMAT "%13.7" ECU_ADDRESS 0xC000186C /end MEASUREMENT
/begin MEASUREMENT Rail_PCVCtlIKiNeg_mp "I-Verstärkung für negative Großsignale für die Druckregelung über Druckregelventil" SLONG Ki 1 100 -1000000.00000 999999.999534 FORMAT "%13.5" ECU_ADDRESS 0xC0001870 /end MEASUREMENT
/begin MEASUREMENT Rail_PCVCtlIKiPos_mp "I-Verstärkung für positive Großsignale für die Druckregelung über Druckregelventil" SLONG Ki 1 100 -1000000.00000 999999.999534 FORMAT "%13.5" ECU_ADDRESS 0xC0001874 /end MEASUREMENT
/begin MEASUREMENT Rail_PCVCtlIKi_mp "I-Verstärkung für Kleinsignale für die Druckregelung über Druckregelventil" SLONG Ki 1 100 -1000000.00000 999999.999534 FORMAT "%13.5" ECU_ADDRESS 0xC0001878 /end MEASUREMENT
/begin MEASUREMENT Rail_PCVCtlPKpNeg_mp "P-Verstärkung für negative Großsignale für die Druckregelung über Druckregelventil" SLONG Kp 1 100 -65536.0000000 65535.9999695 FORMAT "%13.7" ECU_ADDRESS 0xC000187C /end MEASUREMENT
/begin MEASUREMENT Rail_PCVCtlPKpPos_mp "P-Verstärkung für positive Großsignale für die Druckregelung über Druckregelventil" SLONG Kp 1 100 -65536.0000000 65535.9999695 FORMAT "%13.7" ECU_ADDRESS 0xC0001880 /end MEASUREMENT
/begin MEASUREMENT Rail_PCVCtlPKp_mp "P-Verstärkung für Kleinsignale für die Druckregelung über Druckregelventil" SLONG Kp 1 100 -65536.0000000 65535.9999695 FORMAT "%13.7" ECU_ADDRESS 0xC0001884 /end MEASUREMENT
/begin MEASUREMENT Rail_pDvt "Raildruckregler-Regelabweichung" SWORD Pres_Rail 1 100 -3276.800 2000.000 FORMAT "%5.3" ECU_ADDRESS 0xD00074C2 /end MEASUREMENT
/begin MEASUREMENT Rail_pDvtFltLim_mp "gefilterte Regelabweichung des Raildrucks" SWORD Pres_Rail 1 100 -3276.800 2000.000 FORMAT "%5.3" ECU_ADDRESS 0xC0001890 /end MEASUREMENT
/begin MEASUREMENT Rail_pMeUnDvt "Regelabweichung für den ZME-Regler" SWORD Pres_Rail 1 100 -3276.800 2000.000 FORMAT "%5.3" ECU_ADDRESS 0xD00074C4 /end MEASUREMENT
/begin MEASUREMENT Rail_pMeUnDvtMax_mp "Ausgang der Kennlinie Rail_pMeUnDvtMax_CUR" SWORD Pres_Rail 1 100 -3276.800 2000.000 FORMAT "%5.3" ECU_ADDRESS 0xC00018B0 /end MEASUREMENT
/begin MEASUREMENT Rail_pMeUnDvtMin_mp "Ausgang der Kennlinie Rail_pMeUnDvtMin_CUR" SWORD Pres_Rail 1 100 -3276.800 2000.000 FORMAT "%5.3" ECU_ADDRESS 0xC00018B2 /end MEASUREMENT
/begin MEASUREMENT Rail_pMeUnDvtPre_mp "aus CPC-Regelung ermittelte Regelabweichung für die Zumesseinheit" SWORD Pres_Rail 1 100 -3276.800 2000.000 FORMAT "%5.3" ECU_ADDRESS 0xC0001834 /end MEASUREMENT
/begin MEASUREMENT Rail_pMeUnFltMin_mp "Ausgang der Kennlinie Rail_pMeUnFltMin_CUR" SWORD Pres_Rail 1 100 -3276.800 2000.000 FORMAT "%5.3" ECU_ADDRESS 0xC00018B4 /end MEASUREMENT
/begin MEASUREMENT Rail_pPCVClose_mp "Steuergröße um das Druckregelventil geschlossen zu halten" SWORD Pres_Rail 1 100 -3276.800 2000.000 FORMAT "%5.3" ECU_ADDRESS 0xC0001906 /end MEASUREMENT
/begin MEASUREMENT Rail_pPCVCPCOfs_mp "rückgerechneter Offsetwert der CPC für die Steuergröße zum geschlossen Halten des DRV" SWORD Pres_Rail 1 100 -3276.800 2000.000 FORMAT "%5.3" ECU_ADDRESS 0xC0001836 /end MEASUREMENT
/begin MEASUREMENT Rail_pPCVCtlDT1_mp "DT1-Anteil des Druckreglers über Druckregelventil" SWORD Pres_Rail 1 100 -3276.800 2000.000 FORMAT "%5.3" ECU_ADDRESS 0xC0001896 /end MEASUREMENT
/begin MEASUREMENT Rail_pPCVCtlI_mp "I-Anteil des Druckreglers über Druckregelventil" SWORD Pres_Rail 1 100 -3276.800 2000.000 FORMAT "%5.3" ECU_ADDRESS 0xC0001898 /end MEASUREMENT
/begin MEASUREMENT Rail_pPCVCtlLoLim_mp "untere Stellwertbegrenzung des Raildruckreglers über Druckregelventil" SWORD Pres_Rail 1 100 -3276.800 2000.000 FORMAT "%5.3" ECU_ADDRESS 0xC0001842 /end MEASUREMENT
/begin MEASUREMENT Rail_pPCVCtlPILim_mp "DT1-Anteil des Druckreglers über Druckregelventil (begrenzt)" SWORD Pres_Rail 1 100 -3276.800 2000.000 FORMAT "%5.3" ECU_ADDRESS 0xC000189A /end MEASUREMENT
/begin MEASUREMENT Rail_pPCVCtlP_mp "P-Anteil des Druckreglers über Druckregelventil" SWORD Pres_Rail 1 100 -3276.800 2000.000 FORMAT "%5.3" ECU_ADDRESS 0xC000189C /end MEASUREMENT
/begin MEASUREMENT Rail_pPCVCtlUpLim_mp "obere Stellwertbegrenzung des Raildruckreglers über Druckregelventil" SWORD Pres_Rail 1 100 -3276.800 2000.000 FORMAT "%5.3" ECU_ADDRESS 0xC0001844 /end MEASUREMENT
/begin MEASUREMENT Rail_pPCVDvt "Regelabweichung für den DRV Regler" SWORD Pres_Rail 1 100 -3276.800 2000.000 FORMAT "%5.3" ECU_ADDRESS 0xD00074C6 /end MEASUREMENT
/begin MEASUREMENT Rail_pPCVDvtMax_mp "Ausgang der Kennlinie Rail_pPCVDvtMax_CUR" SWORD Pres_Rail 1 100 -3276.800 2000.000 FORMAT "%5.3" ECU_ADDRESS 0xC00018D0 /end MEASUREMENT
/begin MEASUREMENT Rail_pPCVDvtPre_mp "aus CPC-Regelung ermittelte Regelabweichung für das Druckregelventil" SWORD Pres_Rail 1 100 -3276.800 2000.000 FORMAT "%5.3" ECU_ADDRESS 0xC0001838 /end MEASUREMENT
/begin MEASUREMENT Rail_pPCVFltMin_mp "Ausgang der Kennlinie Rail_pPCVFltMin_CUR" SWORD Pres_Rail 1 100 -3276.800 2000.000 FORMAT "%5.3" ECU_ADDRESS 0xC00018D2 /end MEASUREMENT
/begin MEASUREMENT Rail_pPCVInitI_mp "Initialisierung I-Anteil des Druckreglers über Druckregelventil, beim Umschalten von Zumesseinheit auf Druckregelventil" SWORD Pres_Rail 1 100 -3276.800 2000.000 FORMAT "%5.3" ECU_ADDRESS 0xC000189E /end MEASUREMENT
/begin MEASUREMENT Rail_pPCVOfs_mp "Rampenschalterausgang für die Steuergröße um das Druckregelventil geschlossen zu halten" SWORD Pres_Rail 1 100 -3276.800 2000.000 FORMAT "%5.3" ECU_ADDRESS 0xC0001908 /end MEASUREMENT
/begin MEASUREMENT Rail_pPCVRedOfs_mp "Messpunkt für Vorsteuerreduzierung für schnelleren Druckabbau über das Druckregelventil" SWORD Pres_Rail 1 100 -3276.800 2000.000 FORMAT "%5.3" ECU_ADDRESS 0xC000190A /end MEASUREMENT
/begin MEASUREMENT Rail_pPCVSetMax_mp "maximal zulässiger Solldruck für die Raildrucküberwachung" SWORD Pres_Rail 1 100 -3276.800 2000.000 FORMAT "%5.3" ECU_ADDRESS 0xC00018D4 /end MEASUREMENT
/begin MEASUREMENT Rail_pPreCtl_mp "Vorsteuerwert für die Druckregelung über Druckregelventil" SWORD Pres_Rail 1 100 -3276.800 2000.000 FORMAT "%5.3" ECU_ADDRESS 0xC000190C /end MEASUREMENT
/begin MEASUREMENT Rail_pPT1Flt_mp "PT1-gefilterter Raildruck für die Druckregelung über Zumesseinheit" SWORD Pres_Rail 1 100 -3276.800 2000.000 FORMAT "%5.3" ECU_ADDRESS 0xC0001892 /end MEASUREMENT
/begin MEASUREMENT Rail_pSetMin_mp "Kennlinienwert für den minimalen Raildruck als Stellwert" SWORD Pres_Rail 1 100 -3276.800 2000.000 FORMAT "%5.3" ECU_ADDRESS 0xC000183E /end MEASUREMENT
/begin MEASUREMENT Rail_pSetPDynCor_mp "Messpunkt für das Basiskorrekturkennfeld für die Raildrucksollwertkorrektur" SWORD Pres_Rail 1 100 -3276.800 2000.000 FORMAT "%5.3" ECU_ADDRESS 0xC000193E /end MEASUREMENT
/begin MEASUREMENT Rail_pSetPoint "Raildruck-sollwert" SWORD Pres_Rail 1 100 -3276.800 2000.000 FORMAT "%5.3" ECU_ADDRESS 0xD00074C8 /end MEASUREMENT
/begin MEASUREMENT Rail_pSetPointAddCor "Schnittstelle für Erweiterungen der Korrekturen für den Raildrucksollwert" SWORD Pres_Rail 1 100 -3276.800 2000.000 FORMAT "%5.3" ECU_ADDRESS 0xD00074CA /end MEASUREMENT
/begin MEASUREMENT Rail_pSetPointAddCorRgn "benutzerspezifische Korrekturen für den Raildruck im Regenerationsfall" SWORD Pres_Rail 1 100 -3276.800 2000.000 FORMAT "%5.3" ECU_ADDRESS 0xD00074CC /end MEASUREMENT
/begin MEASUREMENT Rail_pSetPointAPSCor_mp "Raildruck-Korrekturwert, abhängig vom Atmosphärendruck" SWORD Pres_Rail 1 100 -3276.800 2000.000 FORMAT "%5.3" ECU_ADDRESS 0xC0001942 /end MEASUREMENT
/begin MEASUREMENT Rail_pSetPointATSCor_mp "Raildruck-Korrekturwert, abhängig von der Ansauglufttemperatur" SWORD Pres_Rail 1 100 -3276.800 2000.000 FORMAT "%5.3" ECU_ADDRESS 0xC0001944 /end MEASUREMENT
/begin MEASUREMENT Rail_pSetPointBase_mp "Basissollwert des Raildrucks" SWORD Pres_Rail 1 100 -3276.800 2000.000 FORMAT "%5.3" ECU_ADDRESS 0xC000191A /end MEASUREMENT
/begin MEASUREMENT Rail_pSetPointBasRgn_mp "Basiswert des Raildrucksollwerts im Regenerationsbetrieb" SWORD Pres_Rail 1 100 -3276.800 2000.000 FORMAT "%5.3" ARRAY_SIZE 2 ECU_ADDRESS 0xC0001914 /end MEASUREMENT
/begin MEASUREMENT Rail_pSetPointBattMin_mp "batteriespannungsabhängig korrigierter Raildruck-Sollwert" SWORD Pres_Rail 1 100 -3276.800 2000.000 FORMAT "%5.3" ECU_ADDRESS 0xC000191C /end MEASUREMENT
/begin MEASUREMENT Rail_pSetPointCor_mp "korrigierter Raildruck-Sollwert, abhängig vom projektspezifischen Eingriff und von Umgebungsbedingungen" SWORD Pres_Rail 1 100 -3276.800 2000.000 FORMAT "%5.3" ECU_ADDRESS 0xC000191E /end MEASUREMENT
/begin MEASUREMENT Rail_pSetPointDec_mp "maximaler Raildruck-Sollwertabfall pro Schedulesequenz" SWORD Pres_Rail 1 100 -3276.800 2000.000 FORMAT "%5.3" ECU_ADDRESS 0xC0001920 /end MEASUREMENT
/begin MEASUREMENT Rail_pSetPointEnvCor "Raildruck-Korrekturwert, abhängig von den Umgebungsbedingungen" SWORD Pres_Rail 1 100 -3276.800 2000.000 FORMAT "%5.3" ECU_ADDRESS 0xD00074CE /end MEASUREMENT
/begin MEASUREMENT Rail_pSetPointEnvCorStrt "Raildrucksollwertkorrektur in Abhängigkeit der Umgebungsvariablen während des Starts" SWORD Pres_Rail 1 100 -3276.800 2000.000 FORMAT "%5.3" ECU_ADDRESS 0xD00074D4 /end MEASUREMENT
/begin MEASUREMENT Rail_pSetPointETSCor1_mp "Messpunkt für das Umgebungstemperaturkennfeld der Raildrucksollwertkorrektur in Abhängigkeit von Motordrehzahl und Einspritzmenge" SWORD Pres_Rail 1 100 -3276.800 2000.000 FORMAT "%5.3" ECU_ADDRESS 0xC0001940 /end MEASUREMENT
/begin MEASUREMENT Rail_pSetPointETSCor_mp "Raildruck-Korrekturwert, abhängig von der Motortemperatur" SWORD Pres_Rail 1 100 -3276.800 2000.000 FORMAT "%5.3" ECU_ADDRESS 0xC0001946 /end MEASUREMENT
/begin MEASUREMENT Rail_pSetPointFlTempCor "Raildruck-Korrekturwert, abhängig von der Kraftstofftemperatur" SWORD Pres_Rail 1 100 -3276.800 2000.000 FORMAT "%5.3" ECU_ADDRESS 0xD00074D6 /end MEASUREMENT
/begin MEASUREMENT Rail_pSetPointFlTempLim_mp "Begrenzter Raildruck-Sollwert unter Berücksichtigung der Kraftstofftemperatur-Korrektur" SWORD Pres_Rail 1 100 -3276.800 2000.000 FORMAT "%5.3" ECU_ADDRESS 0xC0001922 /end MEASUREMENT
/begin MEASUREMENT Rail_pSetPointFlTempRedLim "begrenzter Raildruck-Sollwert unter Berücksichtigung der Kraftstofftemperatur-Korrektur abzüglich des reduzierten Sollwertes" SWORD Pres_Rail 1 100 -3276.800 2000.000 FORMAT "%5.3" ECU_ADDRESS 0xD00074D8 /end MEASUREMENT
/begin MEASUREMENT Rail_pSetPointFlTempUnLim "unbegrenzter Raildruck-Sollwert unter Berücksichtigung der Kraftstofftemperatur-Korrektur" SWORD Pres_Rail 1 100 -3276.800 2000.000 FORMAT "%5.3" ECU_ADDRESS 0xD00074DA /end MEASUREMENT
/begin MEASUREMENT Rail_pSetPointInc_mp "maximaler Raildruck-Sollwertanstieg pro Schedulesequenz" SWORD Pres_Rail 1 100 -3276.800 2000.000 FORMAT "%5.3" ECU_ADDRESS 0xC0001924 /end MEASUREMENT
/begin MEASUREMENT Rail_pSetPointLimNFlTemp "maximaler Raildrucksollwert, abhängig von der Kraftstofftemperatur und der Motordrehzahl" SWORD Pres_Rail 1 100 -3276.800 2000.000 FORMAT "%5.3" ECU_ADDRESS 0xD00074DC /end MEASUREMENT
/begin MEASUREMENT Rail_pSetPointLim_mp "Raildrucksollwert nach Bereichsbegrenzung im Normalbetrieb" SWORD Pres_Rail 1 100 -3276.800 2000.000 FORMAT "%5.3" ECU_ADDRESS 0xC0001926 /end MEASUREMENT
/begin MEASUREMENT Rail_pSetPointMax "maximaler Raildrucksollwert" SWORD Pres_Rail 1 100 -3276.800 2000.000 FORMAT "%5.3" ECU_ADDRESS 0xD00074DE /end MEASUREMENT
/begin MEASUREMENT Rail_pSetPointMin "minimaler Raildrucksollwert" SWORD Pres_Rail 1 100 -3276.800 2000.000 FORMAT "%5.3" ECU_ADDRESS 0xD00074E0 /end MEASUREMENT
/begin MEASUREMENT Rail_pSetPointOut_mp "Raildruck-Sollwert nach Eingriff der Regeneration" SWORD Pres_Rail 1 100 -3276.800 2000.000 FORMAT "%5.3" ECU_ADDRESS 0xC0001928 /end MEASUREMENT
/begin MEASUREMENT Rail_pSetPointRgn "Raildruck-Sollwert im Regenerationsbetrieb" SWORD Pres_Rail 1 100 -3276.800 2000.000 FORMAT "%5.3" ARRAY_SIZE 2 ECU_ADDRESS 0xD00074E2 /end MEASUREMENT
/begin MEASUREMENT Rail_pSetPointZFCLim_mp "Raildrucksollwert mit Begrenzung durch die ZFC" SWORD Pres_Rail 1 100 -3276.800 2000.000 FORMAT "%5.3" ECU_ADDRESS 0xC000192A /end MEASUREMENT
/begin MEASUREMENT Rail_pSetPointZFC_mp "Raildrucksollwert nach Eingriff der Nullmengenkalibrierung" SWORD Pres_Rail 1 100 -3276.800 2000.000 FORMAT "%5.3" ECU_ADDRESS 0xC000192C /end MEASUREMENT
/begin MEASUREMENT Rail_pWindUp_mp "rückgerechneter I-Anteil wenn Stellerbegrenzung erreicht ist" SWORD Pres_Rail 1 100 -3276.800 2000.000 FORMAT "%5.3" ECU_ADDRESS 0xC00018A0 /end MEASUREMENT
/begin MEASUREMENT Rail_qCPCtlType_mp "Mengengrenze für die Umschaltung auf CPC-Regelung" SWORD InjMass 1 100 -327.6800 327.6700 FORMAT "%8.4" ECU_ADDRESS 0xC00018A2 /end MEASUREMENT
/begin MEASUREMENT Rail_qMeUnCtlType_mp "mengenabhängige Hystereseschwelle zur Umschaltung auf Druckregelung über Zumesseinheit" SWORD InjMass 1 100 -327.6800 327.6700 FORMAT "%8.4" ECU_ADDRESS 0xC00018A4 /end MEASUREMENT
/begin MEASUREMENT Rail_qPreCtlBas_mp "ausgewählte Einspritzmenge für die Vorsteuerung" SWORD InjMass 1 100 -327.6800 327.6700 FORMAT "%8.4" ECU_ADDRESS 0xC0001900 /end MEASUREMENT
/begin MEASUREMENT Rail_stCPC "Status des Zustandsautomaten für die Umschaltung der Raildruckregelung" UBYTE OneToOne 1 100 0.00 255.0 FORMAT "%5.1" ECU_ADDRESS 0xD000914B /end MEASUREMENT
/begin MEASUREMENT Rail_stCPCMon1_mp "Zustandsbits für die Überwachung der Stellgröße des DRV" UBYTE OneToOne 1 100 0.00 255.0 FORMAT "%5.1" ECU_ADDRESS 0xC00018AC /end MEASUREMENT
/begin MEASUREMENT Rail_stCPCMon3_mp "Zustandsbits für Überwachung auf minimalen Raildruck während der Umschaltung nach CPC" UBYTE OneToOne 1 100 0.00 255.0 FORMAT "%5.1" ECU_ADDRESS 0xC00018AD /end MEASUREMENT
/begin MEASUREMENT Rail_stCPCMon4_mp "Fehlerpfad für Überwachung auf maximalen Raildruck während Umschaltung nach CPC" UBYTE OneToOne 1 100 0.00 255.0 FORMAT "%5.1" ECU_ADDRESS 0xC00018AE /end MEASUREMENT
/begin MEASUREMENT Rail_stCtlLoop "Zustand der Steuerung Raildruckregler" UBYTE OneToOne 1 100 0.00 255.0 FORMAT "%5.1" ECU_ADDRESS 0xD000914C /end MEASUREMENT
/begin MEASUREMENT Rail_stCtlType "Status Regelkonzept und verwendetes Regelprinzip" UBYTE OneToOne 1 100 0.00 255.0 FORMAT "%5.1" ECU_ADDRESS 0xD000914D /end MEASUREMENT
/begin MEASUREMENT Rail_stEnvCorRgn "Statusbotschaft für die Freigabe der einzelnen Regenerationsstufen für die Sollwertbildung des Raildrucks" ULONG OneToOne 1 100 0.00 4294967295.00 FORMAT "%13.2" ECU_ADDRESS 0xD00045D8 /end MEASUREMENT
/begin MEASUREMENT Rail_stMeUnFrzI_mp "Status des rückgerechneten I-Anteils für die Stellwertbegrenzung für die Regelung der Zumesseinheit" UBYTE OneToOne 1 100 0.00 255.0 FORMAT "%5.1" ECU_ADDRESS 0xC0001894 /end MEASUREMENT
/begin MEASUREMENT Rail_stMeUnMon0_mp "Zustandsbits für Überwachung auf positive Regelabweichung" UBYTE OneToOne 1 100 0.00 255.0 FORMAT "%5.1" ECU_ADDRESS 0xC00018B6 /end MEASUREMENT
/begin MEASUREMENT Rail_stMeUnMon1_mp "Zustandsbits für Überwachung auf positive Regelabweichung und Sollwert des Volumenstroms durch die Zumesseinheit" UBYTE OneToOne 1 100 0.00 255.0 FORMAT "%5.1" ECU_ADDRESS 0xC00018B7 /end MEASUREMENT
/begin MEASUREMENT Rail_stMeUnMon2_mp "Zustandsbits für Überwachung auf negative Regelabweichung bei Nullförderung" UBYTE OneToOne 1 100 0.00 255.0 FORMAT "%5.1" ECU_ADDRESS 0xC00018B8 /end MEASUREMENT
/begin MEASUREMENT Rail_stMeUnMon3_mp "Zustandsbits für Überwachung auf minimalen Raildruck" UBYTE OneToOne 1 100 0.00 255.0 FORMAT "%5.1" ECU_ADDRESS 0xC00018B9 /end MEASUREMENT
/begin MEASUREMENT Rail_stMeUnMon4_mp "Zustandsbits für Überwachung auf maximalen Raildruck" UBYTE OneToOne 1 100 0.00 255.0 FORMAT "%5.1" ECU_ADDRESS 0xC00018BA /end MEASUREMENT
/begin MEASUREMENT Rail_stPCVMon0_mp "Zustandsbits für Überwachung auf positive Regelabweichung" UBYTE OneToOne 1 100 0.00 255.0 FORMAT "%5.1" ECU_ADDRESS 0xC00018D6 /end MEASUREMENT
/begin MEASUREMENT Rail_stPCVMon1_mp "Zustandsbits für Überwachung auf positive Regelabweichung kombiniert mit Stellgröße des Druckregelventils" UBYTE OneToOne 1 100 0.00 255.0 FORMAT "%5.1" ECU_ADDRESS 0xC00018D7 /end MEASUREMENT
/begin MEASUREMENT Rail_stPCVMon2_mp "Zustandsbits für Überwachung auf negative Regelabweichung kombiniert mit Stellgröße des Druckregelventils" UBYTE OneToOne 1 100 0.00 255.0 FORMAT "%5.1" ECU_ADDRESS 0xC00018D8 /end MEASUREMENT
/begin MEASUREMENT Rail_stPCVMon3_mp "Zustandsbits für Überwachung auf minimalen Raildruck" UBYTE OneToOne 1 100 0.00 255.0 FORMAT "%5.1" ECU_ADDRESS 0xC00018D9 /end MEASUREMENT
/begin MEASUREMENT Rail_stPCVMon4_mp "Zustandsbits für Überwachung auf maximalen Raildruck" UBYTE OneToOne 1 100 0.00 255.0 FORMAT "%5.1" ECU_ADDRESS 0xC00018DA /end MEASUREMENT
/begin MEASUREMENT Rail_stPCVRedOfs_mp "Statusanzeige für die Umschaltung auf den reduzierten Offsetwert DRV" UWORD OneToOne 1 100 0.00 65535.00 FORMAT "%8.2" ECU_ADDRESS 0xC000190E /end MEASUREMENT
/begin MEASUREMENT Rail_stPCVWindUp "Status des rückgerechneten I-Anteils für die Stellwertbegrenzung für die Regelung des Druckregelventils" UBYTE OneToOne 1 100 0.00 255.0 FORMAT "%5.1" ECU_ADDRESS 0xD000914E /end MEASUREMENT
/begin MEASUREMENT Rail_stSetPointRgn "Status der Freigabestruktur für den Regenerationsbetrieb für die Bestimmung des Raildrucksollwertes" ULONG OneToOne 1 100 0.00 4294967295.00 FORMAT "%13.2" ECU_ADDRESS 0xD00045DC /end MEASUREMENT
/begin MEASUREMENT Rail_stSwtCon_mp "Status der Umschaltbedingungen für das Regelprinzip" UBYTE OneToOne 1 100 0.00 255.0 FORMAT "%5.1" ECU_ADDRESS 0xC00018A6 /end MEASUREMENT
/begin MEASUREMENT Rail_stSwtCPCCon_mp "Status für Umschaltbedingung für den CPC-Zustandsautomaten" UWORD OneToOne 1 100 0.00 65535.00 FORMAT "%8.2" ECU_ADDRESS 0xC00018A8 /end MEASUREMENT
/begin MEASUREMENT Rail_stZFCDem_mp "Status für geschlossenes Druckregelventil bei aktiver Lernphase der ZFC" UBYTE OneToOne 1 100 0.00 255.0 FORMAT "%5.1" ECU_ADDRESS 0xC0001910 /end MEASUREMENT
/begin MEASUREMENT Rail_swtCtlSel "Status für verwendetes Reglerkonzept (CPC oder 2 Steller)" UBYTE OneToOne 1 100 0.00 255.0 FORMAT "%5.1" ECU_ADDRESS 0xD000914F /end MEASUREMENT
/begin MEASUREMENT Rail_swtPreCtl "Raildruckregler mit / ohne Vorsteuerung" UBYTE OneToOne 1 100 0.00 255.0 FORMAT "%5.1" ECU_ADDRESS 0xD0009150 /end MEASUREMENT
/begin MEASUREMENT Rail_swtPress "Umschaltung zwischen Steuern und Regeln anhand Absolut-/Differenzwert des Raildrucks" UBYTE OneToOne 1 100 0.00 255.0 FORMAT "%5.1" ECU_ADDRESS 0xD0009151 /end MEASUREMENT
/begin MEASUREMENT Rail_swtWindUp "Raildruckregler mit eingefrorenem oder rückgerechnetem I-Anteil" UBYTE OneToOne 1 100 0.00 255.0 FORMAT "%5.1" ECU_ADDRESS 0xD0009152 /end MEASUREMENT
/begin MEASUREMENT Rail_tiMeUn0Deb_mp "MeUn0: Messpunkt für laufende Entprellzähler" ULONG InjTime_us 1 100 0.00 5000.00 FORMAT "%13.2" ECU_ADDRESS 0xC00018BC /end MEASUREMENT
/begin MEASUREMENT Rail_tiMeUn1Deb_mp "MeUn1: Messpunkt für laufende Entprellzähler" ULONG InjTime_us 1 100 0.00 5000.00 FORMAT "%13.2" ECU_ADDRESS 0xC00018C0 /end MEASUREMENT
/begin MEASUREMENT Rail_tiMeUn2Deb_mp "MeUn2: Messpunkt für laufende Entprellzähler" ULONG InjTime_us 1 100 0.00 5000.00 FORMAT "%13.2" ECU_ADDRESS 0xC00018C4 /end MEASUREMENT
/begin MEASUREMENT Rail_tiMeUn3Deb_mp "MeUn3: Messpunkt für laufende Entprellzähler" ULONG InjTime_us 1 100 0.00 5000.00 FORMAT "%13.2" ECU_ADDRESS 0xC00018C8 /end MEASUREMENT
/begin MEASUREMENT Rail_tiMeUn4Deb_mp "MeUn4: Messpunkt für laufende Entprellzähler" ULONG InjTime_us 1 100 0.00 5000.00 FORMAT "%13.2" ECU_ADDRESS 0xC00018CC /end MEASUREMENT
/begin MEASUREMENT Rail_tiMeUnCtlDT1_mp "Zeitkonstante des DT1-Gliedes für die Druckregelung über Zumesseinheit" SLONG TimeDelay_s 1 100 0.000002000000001 4294.9672960 FORMAT "%12.7" ECU_ADDRESS 0xC0001864 /end MEASUREMENT
/begin MEASUREMENT Rail_tiMeUnCtlPT1_mp "Zeitkonstante des PT1-Filters für die Druckregelung über Zumesseinheit" SLONG TimeDelay_s 1 100 0.000002000000001 4294.9672960 FORMAT "%12.7" ECU_ADDRESS 0xC0001868 /end MEASUREMENT
/begin MEASUREMENT Rail_tiMeUnRmpDur_mp "Laufzeit der Rampe um das Fördervolumen der Zumesseinheit vom aktuellen Sollwert auf die Maximalförderung zu rampen" SWORD InjTime_us 1 100 -13107.20 5000.00 FORMAT "%8.2" ECU_ADDRESS 0xC0001840 /end MEASUREMENT
/begin MEASUREMENT Rail_tiPCV0Deb_mp "PCV0: Messpunkt für laufende Entprellzaehler" ULONG InjTime_us 1 100 0.00 5000.00 FORMAT "%13.2" ECU_ADDRESS 0xC00018DC /end MEASUREMENT
/begin MEASUREMENT Rail_tiPCV1Deb_mp "PCV1: Messpunkt für laufende Entprellzaehler" ULONG InjTime_us 1 100 0.00 5000.00 FORMAT "%13.2" ECU_ADDRESS 0xC00018E0 /end MEASUREMENT
/begin MEASUREMENT Rail_tiPCV2Deb_mp "PCV2: Messpunkt für laufende Entprellzaehler" ULONG InjTime_us 1 100 0.00 5000.00 FORMAT "%13.2" ECU_ADDRESS 0xC00018E4 /end MEASUREMENT
/begin MEASUREMENT Rail_tiPCV3Deb_mp "PCV3: Messpunkt für laufende Entprellzaehler" ULONG InjTime_us 1 100 0.00 5000.00 FORMAT "%13.2" ECU_ADDRESS 0xC00018E8 /end MEASUREMENT
/begin MEASUREMENT Rail_tiPCV4Deb_mp "PCV4: Messpunkt für laufende Entprellzaehler" ULONG InjTime_us 1 100 0.00 5000.00 FORMAT "%13.2" ECU_ADDRESS 0xC00018EC /end MEASUREMENT
/begin MEASUREMENT Rail_tiPCVCtlDT1_mp "Zeitkonstante des DT1-Gliedes für die Druckregelung über Druckregelventil" SLONG TimeDelay_s 1 100 0.000002000000001 4294.9672960 FORMAT "%12.7" ECU_ADDRESS 0xC0001888 /end MEASUREMENT
/begin MEASUREMENT Rail_tiPCVRmpDur_mp "Laufzeit der Rampe um vom aktuellen Sollwert auf den neuen PCVClose-Wert zu rampen" SWORD Time_ms 1 100 -327680.0 327670.0 FORMAT "%8.1" ECU_ADDRESS 0xC0001912 /end MEASUREMENT
/begin MEASUREMENT Rail_tiSwtCPC_mp "aktuelle Verweildauer in einem Übergangszustand des CPC-Zustandsautomaten" UWORD Time_ms 1 100 0.00 655350.0 FORMAT "%8.1" ECU_ADDRESS 0xC000183A /end MEASUREMENT
/begin MEASUREMENT RngMod_trqClthBs "" SWORD Trq 1 100 -3276.800 3276.700 FORMAT "%8.3" ECU_ADDRESS 0xD00074EC /end MEASUREMENT
/begin MEASUREMENT RngMod_trqClthMinWoCtOff "" SWORD Trq 1 100 -3276.800 3276.700 FORMAT "%8.3" ECU_ADDRESS 0xD00074F2 /end MEASUREMENT
/begin MEASUREMENT Shtr_r "" SWORD Prc 1 100 -400.0000 399.9878 FORMAT "%8.4" ECU_ADDRESS 0xD0007504 /end MEASUREMENT
/begin MEASUREMENT Shtr_st "" UBYTE OneToOne 1 100 0.00 255.0 FORMAT "%5.1" ECU_ADDRESS 0xD0009158 /end MEASUREMENT
/begin MEASUREMENT Shtr_swtMnt "" SWORD OneToOne 1 100 -32768.00 32767.00 FORMAT "%8.2" ECU_ADDRESS 0xD0007506 /end MEASUREMENT
/begin MEASUREMENT VehMot_rvActSlip_mp "" SWORD Fact100 1 100 -327.6800 327.6700 FORMAT "%8.4" ECU_ADDRESS 0xC0001790 /end MEASUREMENT
/begin MEASUREMENT VehMot_stLimDfftl "" UBYTE OneToOne 1 100 0.00 255.0 FORMAT "%5.1" ECU_ADDRESS 0xD0009199 /end MEASUREMENT
/begin MEASUREMENT VehMot_stSlip "" UBYTE OneToOne 1 100 0.00 255.0 FORMAT "%5.1" ECU_ADDRESS 0xD000919E /end MEASUREMENT
/begin MEASUREMENT VehMot_trqDCS "" SLONG TrqPrpHigh 1 100 -214748364.800 214748364.700 FORMAT "%13.3" ECU_ADDRESS 0xD00043E0 /end MEASUREMENT
/begin MEASUREMENT VehMot_trqDes "" SLONG TrqPrpHigh 1 100 -214748364.800 214748364.700 FORMAT "%13.3" ECU_ADDRESS 0xD00043E4 /end MEASUREMENT
/begin MEASUREMENT VehMot_trqDesTCS "" SLONG TrqPrpHigh 1 100 -214748364.800 214748364.700 FORMAT "%13.3" ECU_ADDRESS 0xD00043E8 /end MEASUREMENT
/begin MEASUREMENT VehMot_trqLead "" SLONG TrqPrpHigh 1 100 -214748364.800 214748364.700 FORMAT "%13.3" ECU_ADDRESS 0xD00043F0 /end MEASUREMENT
/begin MEASUREMENT VehMot_trqLeadPOp "" SLONG TrqPrpHigh 1 100 -214748364.800 214748364.700 FORMAT "%13.3" ECU_ADDRESS 0xD00043F4 /end MEASUREMENT
/begin MEASUREMENT VehMot_trqLeadTCS "" SLONG TrqPrpHigh 1 100 -214748364.800 214748364.700 FORMAT "%13.3" ECU_ADDRESS 0xD00043F8 /end MEASUREMENT
/begin MEASUREMENT VehMot_vDvtWheel_mp "" SWORD Vel 1 100 -327.6800 327.6700 FORMAT "%8.4" ECU_ADDRESS 0xC0001792 /end MEASUREMENT
/begin FUNCTION PPFltUs_DD ""
 /begin DEF_CHARACTERISTIC Exh_pTransfPPFltUs_CUR Exh_SRCPPFltUs.uMin_C Exh_SRCPPFltUs.uMax_C /end DEF_CHARACTERISTIC
 /begin OUT_MEASUREMENT Exh_pSensPPFltUs Exh_uRawPPFltUs /end OUT_MEASUREMENT
/end FUNCTION
/begin FUNCTION PPFltUs_VD ""
 /begin DEF_CHARACTERISTIC Exh_numCntBckPPFltUs_C Exh_numCntMaxPPFltUs_C Exh_numFldPPFltUs_C Exh_RmpSlpPPFltUs.Pos_C Exh_RmpSlpPPFltUs.Neg_C Exh_swtDflPPFltUs_C Exh_swtEnvTPPFltUs_C Exh_swtSensCfgPPFlt_C Exh_tFrzMinPPFltUs_C Exh_tiPT1PPFltUs_C Exh_TrStgParPPFltUs.Dfl_C Exh_TrStgParPPFltUs.stSensId_C /end DEF_CHARACTERISTIC
 /begin IN_MEASUREMENT Air_tCACDs ASMod_pPFltSimDs EnvP_p EnvT_t Exh_pFld Exh_pSensPPFltUs /end IN_MEASUREMENT
 /begin OUT_MEASUREMENT Exh_pAdapPPFltUs Exh_pFltPPFltUs Exh_pPFltUs /end OUT_MEASUREMENT
/end FUNCTION
/begin FUNCTION prp_slipdet "" /begin DEF_CHARACTERISTIC VehMot_rvSlipThres_C /end DEF_CHARACTERISTIC /begin IN_MEASUREMENT Com_vBd Com_vWheelRL Com_vWheelRR /end IN_MEASUREMENT /begin OUT_MEASUREMENT VehMot_stSlip /end OUT_MEASUREMENT /begin LOC_MEASUREMENT VehMot_rvActSlip_mp VehMot_vDvtWheel_mp /end LOC_MEASUREMENT /end FUNCTION
/begin FUNCTION prp_trqdescoord ""
 /begin IN_MEASUREMENT CoVM_trqDes PT_trqTraOutBs PT_trqTraOutWoDstC VehMot_rTrqDfftl VehMot_trqPrtDfftl VMSI_trqDesMax VMSI_trqMin /end IN_MEASUREMENT
 /begin OUT_MEASUREMENT Prp_stIARls VehMot_stLimDfftl VehMot_trqDCS VehMot_trqDes VehMot_trqDesTCS /end OUT_MEASUREMENT
 /begin LOC_MEASUREMENT Prp_trqDCS_mp Prp_trqIntv_mp /end LOC_MEASUREMENT
/end FUNCTION
/begin FUNCTION prp_trqleadcoord ""
 /begin IN_MEASUREMENT CoVM_trqLead CoVM_trqLeadPOp VehMot_rTrqDfftl VehMot_trqPrtDfftl VMSI_trqLeadMax VMSI_trqMin /end IN_MEASUREMENT
 /begin OUT_MEASUREMENT VehMot_trqLead VehMot_trqLeadPOp VehMot_trqLeadTCS /end OUT_MEASUREMENT
 /begin LOC_MEASUREMENT Prp_trqLeadIntv_mp /end LOC_MEASUREMENT
/end FUNCTION
/begin FUNCTION PSPCtl_Co ""
 /begin DEF_CHARACTERISTIC PSPCtl_dvolBase_CUR PSPCtl_dvolMax_C PSPCtl_dvolMin_C PSPCtl_dvolT15Delay_C PSPCtl_dvolTempLim_MAP PSPCtl_facFuelTCor_CUR PSPCtl_nLim_C PSPCtl_tiT15Delay_CUR /end DEF_CHARACTERISTIC
 /begin IN_MEASUREMENT CoEng_st CoEng_stShutOffPath EngDa_tEng Epm_nEng FuelT_t PSP_dvolOut T15_st /end IN_MEASUREMENT
 /begin LOC_MEASUREMENT PSPCtl_dvolBaseLim_mp PSPCtl_dvolBase_mp PSPCtl_dvolCalc_mp PSPCtl_dvolLim_mp PSPCtl_dvolT15Delay_mp PSPCtl_stLogic_mp PSPCtl_tiT15Delay_mp /end LOC_MEASUREMENT
/end FUNCTION
/begin FUNCTION PSP_DDCo ""
 /begin DEF_CHARACTERISTIC PSP_DigOut.tiBtwTstSCB_C PSP_DigOut.tiBtwTstOT_C PSP_DigOut.numTstMax_C PSP_stPsDiaDisbl_C PSP_stPsDisbl_C /end DEF_CHARACTERISTIC
 /begin IN_MEASUREMENT DevLib_stPwrStgEnaCond /end IN_MEASUREMENT
 /begin LOC_MEASUREMENT PSP_stPs_mp /end LOC_MEASUREMENT
/end FUNCTION
/begin FUNCTION PSP_VDCo "" /begin OUT_MEASUREMENT PSP_dvolOut PSP_st /end OUT_MEASUREMENT /end FUNCTION
/begin FUNCTION ptadapt_adapt ""
 /begin DEF_CHARACTERISTIC ActMod_trqClthWoDstC_C Eng_stStopEna_C Eng_stStrtEna_C GbxNPos_st_C Gbx_bASTIntv_C Gbx_bASTNeutr_C RngMod_trqClthBs_C RngMod_trqClthMinWoCtOff_C /end DEF_CHARACTERISTIC
 /begin IN_MEASUREMENT Clth_st FrmMng_nTrbn FrmMng_nTSCInc FrmMng_nTSCTrgt FrmMng_numGear FrmMng_numGearLever FrmMng_numGearTrgt FrmMng_rClgDem FrmMng_rTraConv FrmMng_rTraTSC FrmMng_stLowRng FrmMng_stRevGear FrmMng_tClntDes FrmMng_tiTSCInc FrmMng_tOilConv FrmMng_trqClthTSCDec FrmMng_trqClthTSCInc FrmMng_trqClthTSCPrt FrmMng_trqConvLoss /end IN_MEASUREMENT
 /begin OUT_MEASUREMENT ActMod_trqClthWoDstC Dfftl_bLowRng Eng_stStopEna Eng_stStrtEna GbxNPos_st Gbx_bASTIntv Gbx_bASTNeutr Gbx_bRevGear Gbx_nASTDes Gbx_nIdlDes Gbx_nTrbn Gbx_rFanClgDem Gbx_rTrq Gbx_rTrqTra Gbx_stConvClth Gbx_stGear Gbx_stGearLvr Gbx_stGearTrgt Gbx_tClntDes Gbx_tiASTDes Gbx_tOilConv Gbx_trqConvLos RngMod_trqClthBs RngMod_trqClthMinWoCtOff /end OUT_MEASUREMENT
/end FUNCTION
/begin FUNCTION ptcop_trqcnv ""
 /begin IN_MEASUREMENT ActMod_trqClth ActMod_trqClthWoDstC PT_rTrq PT_trqLos RngMod_trqClthBs RngMod_trqClthMax RngMod_trqClthMin RngMod_trqClthMinWoCtOff SpdGov_trqSet VehMot_rTrqDfftl /end IN_MEASUREMENT
 /begin OUT_MEASUREMENT PT_trqSpdGovLtd PT_trqTraOut PT_trqTraOutBs PT_trqTraOutWoDstC PT_trqWhl PT_trqWhlBs PT_trqWhlMaxEng PT_trqWhlMinEng PT_trqWhlMinWoCtOff PT_trqWhlWoDstC /end OUT_MEASUREMENT
/end FUNCTION
/begin FUNCTION PthLead_TrqCalc ""
 /begin IN_MEASUREMENT CoETS_trqInrCurr CoETS_trqInrLead EngTrqPtd_stPthLim EngTrqPtd_trqLim PthSet_stOvrRun /end IN_MEASUREMENT
 /begin OUT_MEASUREMENT PthLead_stActvMonLim PthLead_trqInrCurr PthLead_trqInrLead /end OUT_MEASUREMENT
 /begin LOC_MEASUREMENT PthLead_trqInrCurrNoMo_mp PthLead_trqInrLeadNoMo_mp /end LOC_MEASUREMENT
/end FUNCTION
/begin FUNCTION PthSet_OvrRunCoord "" /begin DEF_CHARACTERISTIC PthSet_tiOvrRunCoordDebPos_C PthSet_trqOvrRunThres_C /end DEF_CHARACTERISTIC
 /begin IN_MEASUREMENT CoEng_st CoETS_trqInrLtd CoETS_trqUnFltLtd InjCrv_stInjCharActVal InjCtl_qSetUnBal PthSet_stDisable /end IN_MEASUREMENT
 /begin OUT_MEASUREMENT PthSet_stOvrRun PthSet_stOvrRunCoord /end OUT_MEASUREMENT
/end FUNCTION
/begin FUNCTION PthSet_trqCalc ""
 /begin DEF_CHARACTERISTIC PthSet_dtrqRmpDwnDfl_C PthSet_dtrqRmpDwn_CUR PthSet_tiRmpStrtDfl_C PthSet_tiRmpStrt_CUR PthSet_tiSwtOffDfl_C PthSet_tiSwtOff_CUR PthSet_trqOffs_C /end DEF_CHARACTERISTIC
 /begin IN_MEASUREMENT ASDdc_trq ASDrf_trqInrSet CoETS_trqInrLimSet CoETS_trqUnFltLtd EngTrqPtd_stPthLim EngTrqPtd_trqLim PthSet_stOvrRun PT_rTrq PT_stGrip /end IN_MEASUREMENT
 /begin OUT_MEASUREMENT PthSet_ctProcSet PthSet_dtrqRmpDwn_mp PthSet_stActvMonLim PthSet_stDisable PthSet_stRmp_mp PthSet_tiRmpStrt_mp PthSet_tiSwtOff_mp PthSet_trqASDdcInit PthSet_trqASDrfInit PthSet_trqBefRmp_mp PthSet_trqInrSet PthSet_trqInrSetNoMo PthSet_trqInrSetSum PthSet_trqLimOffs_mp PthSet_trqRmp_mp PthSet_trqSetASDdc PthSet_trqSetLim /end OUT_MEASUREMENT
/end FUNCTION
/begin FUNCTION ptlo_loscalc "" /begin IN_MEASUREMENT Conv_trqLd Conv_trqResv RngMod_trqComp Tra_trqLos /end IN_MEASUREMENT /begin OUT_MEASUREMENT PT_trqLos PT_trqLosComp PT_trqResv /end OUT_MEASUREMENT /end FUNCTION
/begin FUNCTION ptodi_spdcoord ""
 /begin IN_MEASUREMENT CoME_nMax CoME_nMin CoME_stNSetP CoVeh_nMaxSysErr CoVeh_nMinSysErr CoVeh_stNSetPSysErr Tra_nMax Tra_nMin Tra_stNSetP /end IN_MEASUREMENT
 /begin OUT_MEASUREMENT CoPT_nASTDes CoPT_nMaxAcs CoPT_nMaxSysErr CoPT_nMaxTra CoPT_nMinAcs CoPT_nMinSysErr CoPT_nMinTra CoPT_stAST CoPT_stNSetPAcs CoPT_stNSetPSysErr CoPT_stNSetPTra CoPT_tiASTDes /end OUT_MEASUREMENT
/end FUNCTION
/begin FUNCTION ptodi_trqcomp "" /begin DEF_CHARACTERISTIC PTODi_trqCompPtdOfs_C /end DEF_CHARACTERISTIC
 /begin IN_MEASUREMENT CoVeh_trqDesComp CoVeh_trqResv Epm_nEng MoFCoVeh_trqCompMsg PTODi_ctProcComp PTODi_stLimCompAct PTODi_trqCompSum /end IN_MEASUREMENT
 /begin OUT_MEASUREMENT CoPT_trqDesCompEng CoPT_trqResvCnstEng CoPT_trqResvRelEng /end OUT_MEASUREMENT
/end FUNCTION
/begin FUNCTION ptodi_trqcomp_10ms "" /begin DEF_CHARACTERISTIC PTODi_tiDebTrqComp_C PTODi_trqCompOfs_MAP /end DEF_CHARACTERISTIC
 /begin IN_MEASUREMENT CoVeh_trqDesComp Epm_nEng MoFCoVeh_trqCompMsg MoFCoVeh_trqVehPtdMsg /end IN_MEASUREMENT
 /begin OUT_MEASUREMENT PTODi_ctProcComp PTODi_stCompLimDeb_mp PTODi_stCompLimUnDeb_mp PTODi_stLimCompAct PTODi_trqCompAvrg_mp PTODi_trqCompOfs_mp PTODi_trqCompSum PTODi_trqMoComp_mp /end OUT_MEASUREMENT
/end FUNCTION
/begin FUNCTION ptodi_trqdescoord "" /begin DEF_CHARACTERISTIC PTODi_trqPtdOfs_C /end DEF_CHARACTERISTIC
 /begin IN_MEASUREMENT CoPT_trqDes Epm_nEng MoFCoVeh_trqVehPtdMsg PTODi_ctProcDes PTODi_stLimDesAct PTODi_trqDesSum VehMot_facDesDyn /end IN_MEASUREMENT
 /begin OUT_MEASUREMENT CoPT_facDesDyn CoPT_trqDesEng /end OUT_MEASUREMENT
/end FUNCTION
/begin FUNCTION ptodi_trqdescoord_10ms "" /begin DEF_CHARACTERISTIC PTODi_nEngMin_C PTODi_tiDebTrqDes_C PTODi_trqDesOfs_MAP /end DEF_CHARACTERISTIC /begin IN_MEASUREMENT CoPT_trqDes Epm_nEng MoFCoVeh_trqVehPtdMsg /end IN_MEASUREMENT
 /begin OUT_MEASUREMENT PTODi_ctProcDes PTODi_stDesLimDeb_mp PTODi_stDesLimUnDeb_mp PTODi_stLimDesAct PTODi_trqDesAvrg_mp PTODi_trqDesOfs_mp PTODi_trqDesSum PTODi_trqMoPtd_mp /end OUT_MEASUREMENT
/end FUNCTION
/begin FUNCTION ptodi_trqleadcoord "" /begin IN_MEASUREMENT CoPT_trqCurr CoPT_trqLead CoPT_trqLeadPOp /end IN_MEASUREMENT /begin OUT_MEASUREMENT CoPT_trqCurrEng CoPT_trqLeadEng CoPT_trqLeadPOpEng /end OUT_MEASUREMENT /end FUNCTION
/begin FUNCTION ptsse_setdata ""
 /begin IN_MEASUREMENT Eng_stStopEna Eng_stStrtEna PT_stTraType Tra_stStopEna Tra_stStrtEna /end IN_MEASUREMENT
 /begin OUT_MEASUREMENT PT_stEngStopEna PT_stEngStrtEna /end OUT_MEASUREMENT
/end FUNCTION
/begin FUNCTION pt_grip "" /begin DEF_CHARACTERISTIC PT_swtMstShft_C PT_tiDebGrip_C PT_vMinGrip_C /end DEF_CHARACTERISTIC /begin IN_MEASUREMENT GlbDa_vX PT_stConvGrip PT_stTraGrip /end IN_MEASUREMENT /begin OUT_MEASUREMENT PT_stGrip PT_stPTGrip_mp PT_swtMstShft /end OUT_MEASUREMENT /end FUNCTION
/begin FUNCTION PT_Grip_Inl ""
 /begin DEF_CHARACTERISTIC PT_dChkGrpDT1Kd_C PT_dOfsGripDet_C PT_dOfsNoGripDet_C PT_dThetaGripDet_C PT_dThetaNoGripDet_C PT_swtNoGripDet_C PT_tiChkGrpDT1_C PT_tiChkGrpPT1_C PT_tiDebGearUnVal_C PT_tiDebNoClthHiLo_C PT_tiDebNoClthLoHi_C PT_tiDebNoGrip_C /end DEF_CHARACTERISTIC
 /begin IN_MEASUREMENT ActMod_trqClth Clth_st Epm_nEng PT_numTraGear PT_stTraType /end IN_MEASUREMENT
 /begin LOC_MEASUREMENT PT_dnAbsEng_mp PT_dnEng_mp PT_dnGrip_mp PT_dnNoGrip_mp PT_stNoGripDet_mp PT_trqAbsGbxPT1_mp PT_trqGbxPT1_mp /end LOC_MEASUREMENT
/end FUNCTION
/begin FUNCTION pt_trqrat "" /begin DEF_CHARACTERISTIC PT_rTrqDfl_C PT_swtDetTypeCAN_C PT_vMinTrqRat_C /end DEF_CHARACTERISTIC /begin IN_MEASUREMENT Conv_rTrq Gbx_rTrq GlbDa_vX PT_rTraGear PT_stGrip /end IN_MEASUREMENT /begin OUT_MEASUREMENT PT_rTrq /end OUT_MEASUREMENT /begin LOC_MEASUREMENT PT_rTrqTmp1_mp PT_rTrqTmp2_mp /end LOC_MEASUREMENT /end FUNCTION
/begin FUNCTION Pwm "" /begin SUB_FUNCTION PwmIn PwmOut /end SUB_FUNCTION /end FUNCTION
/begin FUNCTION PwmIn "" /end FUNCTION
/begin FUNCTION PwmOut "" /end FUNCTION
/begin FUNCTION Pwr "" /end FUNCTION
/begin FUNCTION QWC_Co ""
 /begin DEF_CHARACTERISTIC QWC_facFTS_MAP QWC_qNorm_CUR QWC_stActv_C QWC_tCor_MAP QWC_tDflCEngDsT_C QWC_tDflFuelT_C /end DEF_CHARACTERISTIC
 /begin IN_MEASUREMENT CEngDsT_t FuelT_t RailP_pFlt /end IN_MEASUREMENT
 /begin OUT_MEASUREMENT QWC_facFTS QWC_qNorm QWC_st QWC_tCor /end OUT_MEASUREMENT
 /begin LOC_MEASUREMENT QWC_CEngDsT_mp QWC_FuelT_mp /end LOC_MEASUREMENT
/end FUNCTION
/begin FUNCTION QWC_Lib ""
 /begin DEF_CHARACTERISTIC QWC_facCor1_MAP QWC_facCor2_MAP QWC_facPiI2PiI1WvCor_C QWC_facPiI2_C QWC_qCor1_MAP QWC_qCor2_MAP QWC_qMax_C QWC_qMin_C /end DEF_CHARACTERISTIC
 /begin IN_MEASUREMENT InjCrv_qMI1Des InjCrv_qPiI1Des_mp InjCrv_qPoI2Des_mp RailP_pCurr_mp /end IN_MEASUREMENT
 /begin OUT_MEASUREMENT QWC_qMI1 QWC_qPiI1 QWC_qPoI2 /end OUT_MEASUREMENT
 /begin LOC_MEASUREMENT QWC_facMI1PoI2_mp QWC_facPiI2PiI1_mp QWC_facPiIMI1_mp QWC_qMI1PoI2_mp QWC_qPiI1MI1_mp QWC_qPiI2MI1_mp QWC_qPiI2PiI1_mp QWC_rMI1Norm_mp QWC_tiMI1PoI2Cor_mp QWC_tiMI1PoI2_mp QWC_tiPiI1MI1Cor_mp QWC_tiPiI1MI1_mp QWC_tiPiI2MI1Cor_mp QWC_tiPiI2MI1_mp QWC_tiPiI2PiI1Cor_mp QWC_tiPiI2PiI1_mp /end LOC_MEASUREMENT
/end FUNCTION
/begin FUNCTION QWC_TDiffHyd "" /begin DEF_CHARACTERISTIC QWC_swtDiffHydInSel_C QWC_tiDiffHyd_MAP /end DEF_CHARACTERISTIC
 /begin LOC_MEASUREMENT QWC_pCurrInDiffHyd_mp QWC_qDesInDiffHyd_mp QWC_tiMI1DiffHydCor_mp QWC_tiPiI1DiffHydCor_mp QWC_tiPiI2DiffHydCor_mp /end LOC_MEASUREMENT
/end FUNCTION
/begin FUNCTION RadSht_Logic ""
 /begin DEF_CHARACTERISTIC RadSht_nFanXHi_C RadSht_nFanXLo_C RadSht_rLogicOutHigh_C RadSht_rLogicOutLow_C RadSht_stInvOut_C RadSht_tEngXHi_C RadSht_tEngXLo_C RadSht_tiDebOff_C RadSht_tiDebOn_C RadSht_tTraOilXHi_C RadSht_tTraOilXLo_C RadSht_vXHi_C RadSht_vXLo_C /end DEF_CHARACTERISTIC
 /begin IN_MEASUREMENT EngDa_tEng PT_stTraType T15_st Tra_tOil VehV_v /end IN_MEASUREMENT
 /begin OUT_MEASUREMENT Shtr_r Shtr_st Shtr_swtMnt /end OUT_MEASUREMENT
 /begin LOC_MEASUREMENT RadSht_stLogic_mp /end LOC_MEASUREMENT
/end FUNCTION
/begin FUNCTION RailP_DDCo ""
 /begin DEF_CHARACTERISTIC RailP_pLin_CUR RailP_SRC.uMin_C RailP_SRC.uMax_C RailP_uRawMaxRes /end DEF_CHARACTERISTIC
 /begin OUT_MEASUREMENT RailP_pLin RailP_uRaw /end OUT_MEASUREMENT
 /begin LOC_MEASUREMENT RailP_pLinCurr_mp RailP_stSRCCurr_mp /end LOC_MEASUREMENT
/end FUNCTION
/begin FUNCTION RailP_VDCo ""
 /begin DEF_CHARACTERISTIC RailP_pFltWinNeg_CUR RailP_swtFlt_C RailP_tiFlt1PT1_C RailP_tiFlt2PT1_C RailP_tiFlt3PT1_C /end DEF_CHARACTERISTIC
 /begin IN_MEASUREMENT InjCtl_qSetUnBal RailP_pLin Rail_pSetPoint /end IN_MEASUREMENT
 /begin OUT_MEASUREMENT RailP_pFlt /end OUT_MEASUREMENT
 /begin LOC_MEASUREMENT RailP_pCurr_mp RailP_pFltWinNeg_mp RailP_stSubsVal RailP_tiFltPT1_mp /end LOC_MEASUREMENT
/end FUNCTION
/begin FUNCTION RailP_VDOfsTst ""
 /begin DEF_CHARACTERISTIC RailP_swtOfsTst_C RailP_swtSSpMon_C RailP_tiEvalDel_C RailP_tiOfsTstAftRun_C RailP_tiOfsTstDel_CUR RailP_tiOfsTstStrt_C RailP_tiStrErrDel_C RailP_tOfsTstAftRun_C RailP_tOfsTstDec_C RailP_tOfsTstInc_C RailP_tOfsTstStrt_C RailP_uOfsAftRunMax_C RailP_uOfsAftRunMin_C RailP_uOfsStrtMax_C RailP_uOfsStrtMin_C /end DEF_CHARACTERISTIC
 /begin IN_MEASUREMENT CEngDsT_t CoEng_st CoEng_stOld EpmHCrS_stSigMode Epm_nEng FuelT_tFlSys RailP_pFlt RailP_uRaw SyC_stSub /end IN_MEASUREMENT
 /begin OUT_MEASUREMENT RailP_uOfsStrt /end OUT_MEASUREMENT
 /begin LOC_MEASUREMENT RailP_stEngStrtMov_mp RailP_stMon_mp RailP_stOfsTstMon RailP_tClntLstCyc_mp RailP_tiOfsTstDel_mp RailP_uOfsAftRun /end LOC_MEASUREMENT
/end FUNCTION
/begin FUNCTION Rail_CPCtlLoop ""
 /begin DEF_CHARACTERISTIC Rail_dvolDvtLim_C Rail_dvolMeUnClose_CUR Rail_dvolMeUnOpn_CUR Rail_dvolPCVClose_CUR Rail_dvolPCVOpn_CUR Rail_facMeUnDvt_CUR Rail_facMeUnSetPoint_CUR Rail_facPCVDvt_CUR Rail_facPCVFast_C Rail_pMeUnPreCtlOff_C Rail_pMeUnPreCtlOn_C Rail_tiPT1CPCDvt_C Rail_tiSwtCPCMax_C /end DEF_CHARACTERISTIC
 /begin IN_MEASUREMENT Epm_nEng /end IN_MEASUREMENT
 /begin OUT_MEASUREMENT Rail_dvolMeUnDvt Rail_stCPC /end OUT_MEASUREMENT
 /begin LOC_MEASUREMENT Rail_dvolCPCDvtFlt_mp Rail_dvolCPCDvt_mp Rail_dvolSetPoint_mp Rail_pMeUnDvtPre_mp Rail_pPCVCPCOfs_mp Rail_pPCVDvtPre_mp Rail_tiSwtCPC_mp /end LOC_MEASUREMENT
/end FUNCTION
/begin FUNCTION Rail_CtlLoop "" /begin DEF_CHARACTERISTIC MeUn_dvolSet_C MeUn_swtDvolSet_C PCV_pSet_C PCV_swtPSet_C /end DEF_CHARACTERISTIC
 /begin IN_MEASUREMENT CoEng_st CoEng_stShutOffPath CoEng_stTst Epm_ctCyl Epm_nEng Epm_numCyl FlSys_rhoFl FuelT_tFlSys InjCrv_qPoI1Des InjCrv_qPoI2Des InjCrv_stInjCharActVal InjCtl_qCurr InjCtl_qSetUnBal InjSys_tEng MeUn_dvolSet PCV_pSet RailP_pFlt Rail_dvolMeUnDvt Rail_pSetPoint Rail_stCPC Rail_stCtlType Rail_swtCtlSel Rail_swtPreCtl Rail_swtPress Rail_swtWindUp /end IN_MEASUREMENT
 /begin OUT_MEASUREMENT Rail_dvolEstAged Rail_dvolMeUnCtlI Rail_dvolMeUnCtlUpLim Rail_dvolPreCtl Rail_pDvt Rail_stCtlLoop Rail_stPCVWindUp /end OUT_MEASUREMENT
 /begin LOC_MEASUREMENT Rail_pMeUnDvt Rail_pPCVDvt /end LOC_MEASUREMENT
/end FUNCTION
/begin FUNCTION Rail_CtlLoopLib ""
 /begin DEF_CHARACTERISTIC Rail_dpPCVSetShOffDec_C Rail_dvolOff_C Rail_dvolStrt_C Rail_nCloseCtl_C Rail_nThresStrt_C Rail_numRevDel_C Rail_numRevPlaus_C Rail_pCloseCtl_C Rail_pDiffCloseCtl_C Rail_pOpnCtl_C Rail_pSetMin_CUR Rail_stCtlLoopSel_C Rail_tiDeflate_C Rail_tiMeUnRmpDur_CUR Rail_tiSwtToMeUnCtl_C /end DEF_CHARACTERISTIC
 /begin IN_MEASUREMENT Epm_nEng /end IN_MEASUREMENT
 /begin LOC_MEASUREMENT Rail_facMeUnTiRmpVal_mp Rail_pSetMin_mp Rail_tiMeUnRmpDur_mp /end LOC_MEASUREMENT
/end FUNCTION
/begin FUNCTION Rail_CtlLoopLimMeUn "" /begin DEF_CHARACTERISTIC Rail_dvolMeUnCtlLoLim_C Rail_dvolMeUnCtlUpLim_CUR /end DEF_CHARACTERISTIC /begin IN_MEASUREMENT Epm_nEng /end IN_MEASUREMENT /end FUNCTION
/begin FUNCTION Rail_CtlLoopLimPCV ""
 /begin DEF_CHARACTERISTIC Rail_pPCVCtlLoLimStrt_C Rail_pPCVCtlLoLim_C Rail_pPCVCtlUpLimStrt_C Rail_pPCVCtlUpLim_C /end DEF_CHARACTERISTIC
 /begin LOC_MEASUREMENT Rail_pPCVCtlLoLim_mp Rail_pPCVCtlUpLim_mp /end LOC_MEASUREMENT
/end FUNCTION
/begin FUNCTION Rail_CtlLoopParaMeUn ""
 /begin DEF_CHARACTERISTIC Rail_facOvrMeUnNegIncr_C Rail_MeUnCtlDKd_CUR Rail_MeUnCtlIKiNeg_CUR Rail_MeUnCtlIKiPos_CUR Rail_MeUnCtlIKi_CUR Rail_MeUnCtlPKpNeg_CUR Rail_MeUnCtlPKpPos_CUR Rail_MeUnCtlPKp_CUR Rail_pMeUnCtlIWinNeg_C Rail_pMeUnCtlIWinPos_C Rail_pMeUnCtlPWinNeg_C Rail_pMeUnCtlPWinPos_C Rail_pOvrMeUnThresHigh_C Rail_pOvrMeUnThresLow_C Rail_tiMeUnCtlDT1_CUR Rail_tiMeUnCtlPT1_CUR /end DEF_CHARACTERISTIC
 /begin IN_MEASUREMENT Epm_nEng /end IN_MEASUREMENT
 /begin LOC_MEASUREMENT Rail_MeUnCtlDKd_mp Rail_MeUnCtlIKiNeg_mp Rail_MeUnCtlIKiPos_mp Rail_MeUnCtlIKi_mp Rail_MeUnCtlPKpNeg_mp Rail_MeUnCtlPKpPos_mp Rail_MeUnCtlPKp_mp Rail_tiMeUnCtlDT1_mp Rail_tiMeUnCtlPT1_mp /end LOC_MEASUREMENT
/end FUNCTION
/begin FUNCTION Rail_CtlLoopParaPCV ""
 /begin DEF_CHARACTERISTIC Rail_facOvrPCVNegIncr_C Rail_PCVCtlDKd_CUR Rail_PCVCtlIKiNeg_CUR Rail_PCVCtlIKiPos_CUR Rail_PCVCtlIKi_CUR Rail_PCVCtlPKpNeg_CUR Rail_PCVCtlPKpPos_CUR Rail_PCVCtlPKp_CUR Rail_pOvrPCVThresHigh_C Rail_pOvrPCVThresLow_C Rail_pPCVCtlIWinNeg_C Rail_pPCVCtlIWinPos_C Rail_pPCVCtlPWinNeg_C Rail_pPCVCtlPWinPos_C Rail_tiPCVCtlDT1_CUR /end DEF_CHARACTERISTIC
 /begin IN_MEASUREMENT Epm_nEng /end IN_MEASUREMENT
 /begin LOC_MEASUREMENT Rail_PCVCtlDKd_mp Rail_PCVCtlIKiNeg_mp Rail_PCVCtlIKiPos_mp Rail_PCVCtlIKi_mp Rail_PCVCtlPKpNeg_mp Rail_PCVCtlPKpPos_mp Rail_PCVCtlPKp_mp Rail_tiPCVCtlDT1_mp /end LOC_MEASUREMENT
/end FUNCTION
/begin FUNCTION Rail_CtlMeUn ""
 /begin DEF_CHARACTERISTIC Rail_dvolMeUnCtlInitI_CUR Rail_nMeUnFrzI_C Rail_pDvtFltMin_C Rail_swtMeUnCtlIInit_C Rail_tiFrzIDel_C /end DEF_CHARACTERISTIC
 /begin IN_MEASUREMENT FuelT_tFlSys Rail_dvolMeUnCtlI /end IN_MEASUREMENT
 /begin LOC_MEASUREMENT Rail_dvolMeUnCtlDT1_mp Rail_dvolMeUnCtlP_mp Rail_pDvtFltLim_mp Rail_pPT1Flt_mp Rail_stMeUnFrzI_mp /end LOC_MEASUREMENT
/end FUNCTION
/begin FUNCTION Rail_CtlPCV "" /begin DEF_CHARACTERISTIC Rail_pPCVInitI_MAP Rail_swtPCVInitI_C /end DEF_CHARACTERISTIC /begin IN_MEASUREMENT Epm_nEng Rail_pSetPoint /end IN_MEASUREMENT
 /begin LOC_MEASUREMENT Rail_pPCVCtlDT1_mp Rail_pPCVCtlI_mp Rail_pPCVCtlPILim_mp Rail_pPCVCtlP_mp Rail_pPCVInitI_mp Rail_pWindUp_mp /end LOC_MEASUREMENT
/end FUNCTION
/begin FUNCTION Rail_CtlTypeSwt ""
 /begin DEF_CHARACTERISTIC Rail_pMeUnCtlTypeHi_C Rail_pMeUnCtlTypeLo_C Rail_qCPCtlTypeHys_C Rail_qCPCtlType_CUR Rail_qMeUnCtlTypeHys_C Rail_qMeUnCtlType_CUR Rail_swtCtlType_C Rail_tiSwtCtlTypeDel_C Rail_tMeUnCtlTypeHi_C Rail_tMeUnCtlTypeLo_C Rail_tSwtCPCHi_C Rail_tSwtCPCLo_C /end DEF_CHARACTERISTIC
 /begin IN_MEASUREMENT Epm_nEng PCV_stAdaptMeUn /end IN_MEASUREMENT
 /begin LOC_MEASUREMENT Rail_qCPCtlType_mp Rail_qMeUnCtlType_mp Rail_stSwtCon_mp Rail_stSwtCPCCon_mp /end LOC_MEASUREMENT
/end FUNCTION
/begin FUNCTION Rail_ErrDet "" /end FUNCTION
/begin FUNCTION Rail_MonCPC "" /begin DEF_CHARACTERISTIC Rail_pCPCFltMax_C Rail_pCPCFltMin_CUR /end DEF_CHARACTERISTIC /begin REF_CHARACTERISTIC Rail_dpSetPointDec_C /end REF_CHARACTERISTIC
 /begin IN_MEASUREMENT Epm_nEng RailP_pFlt Rail_dpSetPointInc Rail_stCPC Rail_stCtlLoop Rail_stPCVWindUp Rail_swtCtlSel /end IN_MEASUREMENT
 /begin LOC_MEASUREMENT Rail_pCPCFltMin_mp Rail_stCPCMon1_mp Rail_stCPCMon3_mp Rail_stCPCMon4_mp /end LOC_MEASUREMENT
/end FUNCTION
/begin FUNCTION Rail_MonLib "" /end FUNCTION
/begin FUNCTION Rail_MonMeUn ""
 /begin DEF_CHARACTERISTIC Rail_MeUnMon.dvolSetMin_C Rail_MeUnMon.pFltMax_C Rail_MeUnMon.pDvtMax_C Rail_MeUnMon.qLoIdl_C Rail_MeUnMon.tLoIdl_C Rail_MeUnMon.stRls_C Rail_pMeUnDvtMax_CUR Rail_pMeUnDvtMin_CUR Rail_pMeUnFltMin_CUR /end DEF_CHARACTERISTIC
 /begin REF_CHARACTERISTIC Rail_dpSetPointDec_C /end REF_CHARACTERISTIC
 /begin IN_MEASUREMENT Epm_nEng FuelT_tFlSys InjCtl_qSetUnBal MeUn_dvolSet RailP_pFlt Rail_dpSetPointInc Rail_dvolMeUnCtlUpLim Rail_pDvt Rail_stCtlLoop /end IN_MEASUREMENT
 /begin LOC_MEASUREMENT Rail_pMeUnDvtMax_mp Rail_pMeUnDvtMin_mp Rail_pMeUnFltMin_mp Rail_stMeUnMon0_mp Rail_stMeUnMon1_mp Rail_stMeUnMon2_mp Rail_stMeUnMon3_mp Rail_stMeUnMon4_mp Rail_tiMeUn0Deb_mp Rail_tiMeUn1Deb_mp Rail_tiMeUn2Deb_mp Rail_tiMeUn3Deb_mp Rail_tiMeUn4Deb_mp /end LOC_MEASUREMENT
/end FUNCTION
/begin FUNCTION Rail_MonPCV ""
 /begin DEF_CHARACTERISTIC Rail_PCVMon.pDvtMax_C Rail_PCVMon.pDvtMin_C Rail_PCVMon.pSetMin_C Rail_PCVMon.pFltMax_C Rail_PCVMon.stRls_C Rail_pPCVDvtMax_CUR Rail_pPCVFltMin_CUR Rail_pPCVSetMax_CUR /end DEF_CHARACTERISTIC
 /begin REF_CHARACTERISTIC Rail_dpSetPointDec_C /end REF_CHARACTERISTIC
 /begin IN_MEASUREMENT Epm_nEng PCV_pSet RailP_pFlt Rail_dpSetPointInc Rail_pDvt Rail_pSetPoint Rail_stCtlLoop /end IN_MEASUREMENT
 /begin LOC_MEASUREMENT Rail_pPCVDvtMax_mp Rail_pPCVFltMin_mp Rail_pPCVSetMax_mp Rail_stPCVMon0_mp Rail_stPCVMon1_mp Rail_stPCVMon2_mp Rail_stPCVMon3_mp Rail_stPCVMon4_mp Rail_tiPCV0Deb_mp Rail_tiPCV1Deb_mp Rail_tiPCV2Deb_mp Rail_tiPCV3Deb_mp Rail_tiPCV4Deb_mp /end LOC_MEASUREMENT
/end FUNCTION
/begin FUNCTION Rail_PGovSetup ""
 /begin DEF_CHARACTERISTIC Rail_CtlSel.xVal_C Rail_CtlSel.xTyp_C Rail_PreCtl.xVal_C Rail_PreCtl.xTyp_C Rail_Press.xVal_C Rail_Press.xTyp_C Rail_WindUp.xVal_C Rail_WindUp.xTyp_C /end DEF_CHARACTERISTIC
 /begin IN_MEASUREMENT CoEng_st CoEng_stTst Epm_nEng FuelT_tFlSys InjCtl_qCurr Rail_pSetPoint /end IN_MEASUREMENT
 /begin OUT_MEASUREMENT Rail_stCtlType Rail_swtCtlSel Rail_swtPreCtl Rail_swtPress Rail_swtWindUp /end OUT_MEASUREMENT
/end FUNCTION
/begin FUNCTION Rail_PMonStrt "" /begin DEF_CHARACTERISTIC Rail_nStrtLim_C Rail_pStrtLim_C Rail_tiPMonStrtLim_C /end DEF_CHARACTERISTIC /begin IN_MEASUREMENT Epm_nEng RailP_pFlt StSys_stStrt /end IN_MEASUREMENT /begin LOC_MEASUREMENT Rail_ctPMonStrt_mp /end LOC_MEASUREMENT /end FUNCTION
/begin FUNCTION Rail_PreCtlMeUn ""
 /begin DEF_CHARACTERISTIC Rail_dvolLeak_MAP Rail_dvolPreCtlBas_MAP Rail_dvolPreCtlOfs_MAP Rail_dvolPreCtlPoI1_MAP Rail_dvolPreCtlPoI2_MAP Rail_dvolPreCtl_C Rail_facLeakAged_C Rail_stPreCtlMeUnSel_C Rail_swtDvolPreCtl_C Rail_volInjVlvCtl_C /end DEF_CHARACTERISTIC
 /begin IN_MEASUREMENT Epm_nEng FuelT_tFlSys InjCrv_qPoI1Des_mp InjCrv_qPoI2Des_mp InjCtl_qSetUnBal Rail_pSetPoint /end IN_MEASUREMENT
 /begin LOC_MEASUREMENT Rail_dvolInjVlvCtl_mp Rail_dvolLeak_mp Rail_dvolPreCtlBas_mp Rail_dvolPreCtlInit_mp Rail_dvolPreCtlOfs_mp Rail_dvolPreCtlPoI1_mp Rail_dvolPreCtlPoI2_mp Rail_qPreCtlBas_mp /end LOC_MEASUREMENT
/end FUNCTION
/begin FUNCTION Rail_PreCtlPCV ""
 /begin DEF_CHARACTERISTIC Rail_dvolRedOfsLimHi_C Rail_dvolRedOfsLimLo_C Rail_nRedOfsLimHi_C Rail_nRedOfsLimLo_C Rail_pDvtRedOfsLimHi_C Rail_pDvtRedOfsLimLo_C Rail_pPCVCloseOfs_CUR Rail_pPCVRedOfs_CUR Rail_pPreCtl_C Rail_pPreCtl_MAP Rail_pRedOfsLim_C Rail_qRedOfsLimHi_C Rail_qRedOfsLimLo_C Rail_swtPPreCtl_C Rail_tiDvtPressRedOfsPT1_C Rail_tiPCVRmpDur_CUR Rail_tiPCVRmpToOfs_C Rail_tiPCVRmpToRedOfs_C /end DEF_CHARACTERISTIC
 /begin IN_MEASUREMENT Epm_nEng HLSDem_nSetPLo InjCtl_qCurr PthSet_stOvrRun Rail_pSetPoint /end IN_MEASUREMENT
 /begin LOC_MEASUREMENT Rail_facPCVTiRmpVal_mp Rail_facTiRmpVal_mp Rail_pPCVClose_mp Rail_pPCVOfs_mp Rail_pPCVRedOfs_mp Rail_pPreCtl_mp Rail_stPCVRedOfs_mp Rail_stZFCDem_mp Rail_tiPCVRmpDur_mp /end LOC_MEASUREMENT
/end FUNCTION
/begin FUNCTION Rail_Rgn ""
 /begin DEF_CHARACTERISTIC Rail_pSetPointBas0Rgn_GMAP Rail_pSetPointBas1Rgn_GMAP Rail_pSetPointBasRgnX_AXIS Rail_pSetPointBasRgnY_AXIS /end DEF_CHARACTERISTIC
 /begin IN_MEASUREMENT Epm_nEng InjCtl_qSetUnBal Rail_pSetPointAddCorRgn Rail_pSetPointEnvCorRgn Rail_stSetPointRgn /end IN_MEASUREMENT
 /begin OUT_MEASUREMENT Rail_pSetPointRgn /end OUT_MEASUREMENT
 /begin LOC_MEASUREMENT Rail_pSetPointBasRgn_mp /end LOC_MEASUREMENT
/end FUNCTION
/begin FUNCTION Rail_RgnLib "" /begin DEF_CHARACTERISTIC Rail_facSetPointRmpVal_CUR /end DEF_CHARACTERISTIC /begin IN_MEASUREMENT CoEOM_facRmpVal /end IN_MEASUREMENT /begin LOC_MEASUREMENT Rail_facSetPointRmpVal_mp /end LOC_MEASUREMENT /end FUNCTION
/begin FUNCTION Rail_RgnRls "" /begin DEF_CHARACTERISTIC Rail_stSetPointRgnMsk_CA /end DEF_CHARACTERISTIC /begin IN_MEASUREMENT CoEOM_facRmpVal CoEOM_stOpModeAct CoEOM_stOpModeActTSync /end IN_MEASUREMENT /begin OUT_MEASUREMENT Rail_stEnvCorRgn Rail_stSetPointRgn /end OUT_MEASUREMENT /end FUNCTION
/begin FUNCTION Rail_SetPoint ""
 /begin DEF_CHARACTERISTIC Rail_dpSetPointDec_C Rail_dpSetPointInc_MAP Rail_pSetPointBase_MAP Rail_pSetPointBattMin_CUR Rail_pSetPointInit_C Rail_pSetPointRed_C Rail_pSetPoint_C Rail_stRgnDelMsk_C Rail_stSetPointSel_C Rail_swtPSetPoint_C /end DEF_CHARACTERISTIC
 /begin IN_MEASUREMENT BattU_u EngDem_stTrqLimErr Epm_nEng InjCtl_qCurr InjCtl_qSetUnBal RailP_pFlt Rail_pSetPointAddCor Rail_pSetPointEnvCor Rail_pSetPointFlTempCor Rail_pSetPointLimNFlTemp Rail_pSetPointMax Rail_pSetPointMin Rail_pSetPointSubst Rail_stCtlLoop Rail_stCtlType Rail_stSetPointRgn /end IN_MEASUREMENT
 /begin OUT_MEASUREMENT Rail_dpSetPointInc Rail_pSetPoint Rail_pSetPointFlTempRedLim Rail_pSetPointFlTempUnLim /end OUT_MEASUREMENT
 /begin LOC_MEASUREMENT Rail_pSetPointBase_mp Rail_pSetPointBattMin_mp Rail_pSetPointCor_mp Rail_pSetPointDec_mp Rail_pSetPointFlTempLim_mp Rail_pSetPointInc_mp Rail_pSetPointLim_mp Rail_pSetPointOut_mp Rail_pSetPointZFCLim_mp Rail_pSetPointZFC_mp /end LOC_MEASUREMENT
/end FUNCTION
/begin FUNCTION Rail_SetPointAddCor ""
 /begin DEF_CHARACTERISTIC Rail_facAPSetPDynCor_CUR Rail_facDQSetPDynCor_CUR Rail_facETSetPDynCor_CUR Rail_facIASetPDynCor_CUR Rail_facSetPointAPSCStrt_CUR Rail_facSetPointATSCStrt_CUR Rail_facSetPointETSCor1_CUR Rail_facSetPointETSCStrt_CUR Rail_facSetPointFTSCor_CUR Rail_pSetPDynCor_MAP Rail_pSetPointAPSCStrt_MAP Rail_pSetPointATSCStrt_MAP Rail_pSetPointETSCor1_MAP Rail_pSetPointETSCStrt_MAP Rail_pSetPointFTSCor_MAP Rail_pSetPointLimNFlTemp_C Rail_pSetPointLimNFlTemp_MAP Rail_pSetPointMaxDef_C Rail_pSetPointMaxDef_CUR Rail_pSetPointMaxDef_MAP Rail_pSetPointMax_MAP Rail_pSetPointMinDef_C Rail_pSetPointMin_MAP /end DEF_CHARACTERISTIC
 /begin IN_MEASUREMENT CoEng_stTst EnvP_p Epm_nEng FuelT_t InjCrv_dqSetUnBalFltLim InjCtl_qCurr InjCtl_qSetUnBal InjSys_qTot InjSys_tEng Rail_stEnvCorRgn Rail_tAir /end IN_MEASUREMENT
 /begin OUT_MEASUREMENT Rail_pSetPointAddCor Rail_pSetPointFlTempCor Rail_pSetPointLimNFlTemp Rail_pSetPointMax Rail_pSetPointMin /end OUT_MEASUREMENT
 /begin LOC_MEASUREMENT Rail_facAPSetPDynCor_mp Rail_facDQSetPDynCor_mp Rail_facETSetPDynCor_mp Rail_facIASetPDynCor_mp Rail_facSetPointAPSCStrt_mp Rail_facSetPointATSCStrt_mp Rail_facSetPointETSCor1_mp Rail_facSetPointETSCStrt_mp Rail_facSetPointFTSCor_mp Rail_pSetPDynCor_mp Rail_pSetPointEnvCorStrt Rail_pSetPointETSCor1_mp /end LOC_MEASUREMENT
/end FUNCTION
/begin FUNCTION Rail_SetPointAddCorRgn "" /begin OUT_MEASUREMENT Rail_pSetPointAddCorRgn /end OUT_MEASUREMENT /end FUNCTION
/begin FUNCTION Rail_SetPointEnvCor ""
 /begin DEF_CHARACTERISTIC Rail_pSetPointAPSCor_MAP Rail_pSetPointATSCor_MAP Rail_pSetPointETSCor_MAP /end DEF_CHARACTERISTIC
 /begin IN_MEASUREMENT Epm_nEng InjCtl_qCurr Rail_facSetPointAPSCor Rail_facSetPointATSCor Rail_facSetPointETSCor Rail_stEnvCorRgn /end IN_MEASUREMENT
 /begin OUT_MEASUREMENT Rail_pSetPointEnvCor /end OUT_MEASUREMENT
 /begin LOC_MEASUREMENT Rail_pSetPointAPSCor_mp Rail_pSetPointATSCor_mp Rail_pSetPointETSCor_mp /end LOC_MEASUREMENT
/end FUNCTION
/begin COMPU_METHOD CoEOMSwt_S16 "" RAT_FUNC "%7.6" "-" COEFFS 0 16384 0 0 0 1 /end COMPU_METHOD
/begin COMPU_METHOD dn_dZfine "" RAT_FUNC "%6.3" "rpm/s" COEFFS 0 2 0 0 0 1 /end COMPU_METHOD
/begin COMPU_METHOD dTrq "" RAT_FUNC "%6.3" "Nm/s" COEFFS 0 10 0 0 0 1 /end COMPU_METHOD
/begin COMPU_METHOD EGTSwt_S16 "" RAT_FUNC "%7.6" "-" COEFFS 0 16384 0 0 0 1 /end COMPU_METHOD
/begin COMPU_METHOD EngN "" RAT_FUNC "%6.3" "rpm" COEFFS 0 2 0 0 0 1 /end COMPU_METHOD
/begin COMPU_METHOD Fact "" RAT_FUNC "%6.5" "-" COEFFS 0 8192 0 0 0 1 /end COMPU_METHOD
/begin COMPU_METHOD Fact1 "" RAT_FUNC "%6.4" "-" COEFFS 0 128 0 0 0 1 /end COMPU_METHOD
/begin COMPU_METHOD Fact100 "" RAT_FUNC "%6.4" "-" COEFFS 0 100 0 0 0 1 /end COMPU_METHOD
/begin COMPU_METHOD FanSpd "" RAT_FUNC "%6.3" "rpm" COEFFS 0 10.9223333333333 0 0 0 1 /end COMPU_METHOD
/begin COMPU_METHOD FlConsum_l_h "" RAT_FUNC "%6.4" "l/h" COEFFS 0 100 0 0 0 1 /end COMPU_METHOD
/begin COMPU_METHOD InjMass "" RAT_FUNC "%6.4" "mg/hub" COEFFS 0 100 0 0 0 1 /end COMPU_METHOD
/begin COMPU_METHOD InjMassInj "" RAT_FUNC "%6.4" "mg/inj" COEFFS 0 100 0 0 0 1 /end COMPU_METHOD
/begin COMPU_METHOD InjMassPerSec_20ms "" RAT_FUNC "%6.3" "mg/hub/s" COEFFS 0 2 0 0 0 1 /end COMPU_METHOD
/begin COMPU_METHOD InjQntInj "" RAT_FUNC "%6.4" "mm^3/inj" COEFFS 0 100 0 0 0 1 /end COMPU_METHOD
/begin COMPU_METHOD InjTime_us "" RAT_FUNC "%6.3" "us" COEFFS 0 2.5 0 0 0 1 /end COMPU_METHOD
/begin COMPU_METHOD Kd "" RAT_FUNC "%7.6" "1/1" COEFFS 0 65536 0 0 0 1 /end COMPU_METHOD
/begin COMPU_METHOD Kd_1 "" RAT_FUNC "%6.4" "1/1" COEFFS 0 512 0 0 0 1 /end COMPU_METHOD
/begin COMPU_METHOD Kd_pRail2Q "" RAT_FUNC "%11.4" "mm^3/s/bar" COEFFS 0 655.360000 0 0 0 1 /end COMPU_METHOD
/begin COMPU_METHOD Kd_pRail2Q_1 "" RAT_FUNC "%10.3" "mm^3/s/bar" COEFFS 0 40.960000 0 0 0 1 /end COMPU_METHOD
/begin COMPU_METHOD Ki "" RAT_FUNC "%6.5" "1/s" COEFFS 0 2147.483648 0 0 0 1 /end COMPU_METHOD
/begin COMPU_METHOD Ki_1 "" RAT_FUNC "%6.4" "1/s" COEFFS 0 67.108864 0 0 0 1 /end COMPU_METHOD
/begin COMPU_METHOD Ki_pRail2Q "" RAT_FUNC "%10.3" "mm^3/s^2/bar" COEFFS 0 21.474836 0 0 0 1 /end COMPU_METHOD
/begin COMPU_METHOD Ki_pRail2Q_1 "" RAT_FUNC "%10.3" "mm^3/s^2/bar" COEFFS 0 10.737418 0 0 0 1 /end COMPU_METHOD
/begin COMPU_METHOD Kp "" RAT_FUNC "%7.6" "1/1" COEFFS 0 32768 0 0 0 1 /end COMPU_METHOD
/begin COMPU_METHOD Kp_1 "" RAT_FUNC "%6.4" "1/1" COEFFS 0 64 0 0 0 1 /end COMPU_METHOD
/begin COMPU_METHOD Kp_pRail2Q "" RAT_FUNC "%11.4" "mm^3/s/bar" COEFFS 0 327.680000 0 0 0 1 /end COMPU_METHOD
/begin COMPU_METHOD Kp_pRail2Q_1 "" RAT_FUNC "%10.3" "mm^3/s/bar" COEFFS 0 81.920000 0 0 0 1 /end COMPU_METHOD
/begin COMPU_METHOD Moment_Inertia "" RAT_FUNC "%6.4" "-" COEFFS 0 100 0 0 0 1 /end COMPU_METHOD
/begin COMPU_METHOD Mo_trq_nm_q0p1 "" RAT_FUNC "%6.3" "Nm" COEFFS 0 10 0 0 0 1 /end COMPU_METHOD
/begin COMPU_METHOD OneToOne "" RAT_FUNC "%6.2" "-" COEFFS 0 1 0 0 0 1 /end COMPU_METHOD
/begin COMPU_METHOD Prc "" RAT_FUNC "%6.4" "%" COEFFS 0 81.92 0 0 0 1 /end COMPU_METHOD
/begin COMPU_METHOD PresRail_sec "" RAT_FUNC "%4.3" "bar/s" COEFFS 0 2.500000 0 0 0 1 /end COMPU_METHOD
/begin COMPU_METHOD Pres_hPa "" RAT_FUNC "%6.2" "hPa" COEFFS 0 1 0 0 0 1 /end COMPU_METHOD
/begin COMPU_METHOD Pres_Rail "" RAT_FUNC "%4.3" "bar" COEFFS 0 10.000000 0 0 0 1 /end COMPU_METHOD
/begin COMPU_METHOD QntR "" RAT_FUNC "%6.5" "-" COEFFS 0 1024 0 0 0 1 /end COMPU_METHOD
/begin COMPU_METHOD Qp_mm3_sec "" RAT_FUNC "%6.1" "mm3/s" COEFFS 0 0.1 0 0 0 1 /end COMPU_METHOD
/begin COMPU_METHOD RmpPres_hPa "" RAT_FUNC "%6.4" "hPa/s" COEFFS 0 65.536 0 0 0 1 /end COMPU_METHOD
/begin COMPU_METHOD RmpTrq "" RAT_FUNC "%6.4" "Nm/s" COEFFS 0 655.36 0 0 0 1 /end COMPU_METHOD
/begin COMPU_METHOD Signals_OneToOne "" RAT_FUNC "%6.2" "-" COEFFS 0 1 0 0 0 1 /end COMPU_METHOD
/begin COMPU_METHOD SqrVltg_s "" RAT_FUNC "%6.3" "V^2s" COEFFS 0 10 0 0 0 1 /end COMPU_METHOD
/begin COMPU_METHOD stroke_pml "" RAT_FUNC "%6.3" "1/ml" COEFFS 0 10 0 0 0 1 /end COMPU_METHOD
/begin COMPU_METHOD TempDiff_Kelv "" RAT_FUNC "%6.3" "K" COEFFS 0 10 0 0 0 1 /end COMPU_METHOD
/begin COMPU_METHOD Temp_Cels "" RAT_FUNC "%6.1" "deg C" COEFFS 0 10 2731.4 0 0 1 /end COMPU_METHOD
/begin COMPU_METHOD Temp_Fahr "" RAT_FUNC "%6.1" "deg F" COEFFS 0 5.55555555555556 2553.62222222222 0 0 1 /end COMPU_METHOD
/begin COMPU_METHOD TimeDelay_ms "" RAT_FUNC "%12.1" "ms" COEFFS 0 0 1 0 2.3283064365387e-007 0 /end COMPU_METHOD
/begin COMPU_METHOD TimeDelay_s "" RAT_FUNC "%12.4" "s" COEFFS 0 0 1 0 0.00023283064365387 0 /end COMPU_METHOD
/begin COMPU_METHOD TimeDelay_s_2 "" RAT_FUNC "%9.4" "s" COEFFS 0 0 1 0 0.0596046447753906 0 /end COMPU_METHOD
/begin COMPU_METHOD TimeDT "" RAT_FUNC "%6.2" "us" COEFFS 0 1 0 0 0 1 /end COMPU_METHOD
/begin COMPU_METHOD TimeRed "" RAT_FUNC "%6.3" "s" COEFFS 0 6.25 0 0 0 1 /end COMPU_METHOD
/begin COMPU_METHOD Time_Dt "" RAT_FUNC "%9.8" "s" COEFFS 0 1000000 0 0 0 1 /end COMPU_METHOD
/begin COMPU_METHOD Time_ms "" RAT_FUNC "%6.1" "ms" COEFFS 0 0.1 0 0 0 1 /end COMPU_METHOD
/begin COMPU_METHOD Time_s "" RAT_FUNC "%6.4" "s" COEFFS 0 100 0 0 0 1 /end COMPU_METHOD
/begin COMPU_METHOD TransR "" RAT_FUNC "%6.4" "-" COEFFS 0 100 0 0 0 1 /end COMPU_METHOD
/begin COMPU_METHOD Trq "" RAT_FUNC "%6.3" "Nm" COEFFS 0 10 0 0 0 1 /end COMPU_METHOD
/begin COMPU_METHOD TrqPrpHigh "" RAT_FUNC "%6.3" "Nm" COEFFS 0 10 0 0 0 1 /end COMPU_METHOD
/begin COMPU_METHOD Vel "" RAT_FUNC "%6.4" "km/h" COEFFS 0 100 0 0 0 1 /end COMPU_METHOD
/begin COMPU_METHOD Volt "" RAT_FUNC "%6.3" "mV" COEFFS 0 5 0 0 0 1 /end COMPU_METHOD
/begin COMPU_METHOD Volt_Batt "" RAT_FUNC "%6.1" "mV" COEFFS 0 0.05 0 0 0 1 /end COMPU_METHOD
/begin RECORD_LAYOUT Axis_Xs16 NO_AXIS_PTS_X 1 SWORD AXIS_PTS_X 2 SWORD INDEX_INCR DIRECT /end RECORD_LAYOUT
/begin RECORD_LAYOUT Cur_Xs16Ws16 NO_AXIS_PTS_X 1 SWORD AXIS_PTS_X 2 SWORD INDEX_INCR DIRECT FNC_VALUES 3 SWORD COLUMN_DIR DIRECT /end RECORD_LAYOUT
/begin RECORD_LAYOUT Kf_Xs16_Ys16_Ws16 NO_AXIS_PTS_X 1 SWORD NO_AXIS_PTS_Y 2 SWORD AXIS_PTS_X 3 SWORD INDEX_INCR DIRECT AXIS_PTS_Y 4 SWORD INDEX_INCR DIRECT FNC_VALUES 5 SWORD COLUMN_DIR DIRECT /end RECORD_LAYOUT
/begin RECORD_LAYOUT Kw_Ws16 FNC_VALUES 1 SWORD COLUMN_DIR DIRECT /end RECORD_LAYOUT
/begin RECORD_LAYOUT Kw_Ws32 FNC_VALUES 1 SLONG COLUMN_DIR DIRECT /end RECORD_LAYOUT
/begin RECORD_LAYOUT Kw_Wu16 FNC_VALUES 1 UWORD COLUMN_DIR DIRECT /end RECORD_LAYOUT
/begin RECORD_LAYOUT Kw_Wu8 FNC_VALUES 1 UBYTE COLUMN_DIR DIRECT /end RECORD_LAYOUT
/begin RECORD_LAYOUT MapG_Ws16 FNC_VALUES 1 SWORD COLUMN_DIR DIRECT /end RECORD_LAYOUT
/begin RECORD_LAYOUT Map_Xs16Ys16Ws16 NO_AXIS_PTS_X 1 SWORD NO_AXIS_PTS_Y 2 SWORD AXIS_PTS_X 3 SWORD INDEX_INCR DIRECT AXIS_PTS_Y 4 SWORD INDEX_INCR DIRECT FNC_VALUES 5 SWORD COLUMN_DIR DIRECT /end RECORD_LAYOUT
/begin RECORD_LAYOUT ValA_Wu32 FNC_VALUES 1 ULONG COLUMN_DIR DIRECT /end RECORD_LAYOUT
/begin RECORD_LAYOUT Val_Ws16 FNC_VALUES 1 SWORD COLUMN_DIR DIRECT /end RECORD_LAYOUT
/begin RECORD_LAYOUT Val_Ws32 FNC_VALUES 1 SLONG COLUMN_DIR DIRECT /end RECORD_LAYOUT
/begin RECORD_LAYOUT Val_Ws8 FNC_VALUES 1 SBYTE COLUMN_DIR DIRECT /end RECORD_LAYOUT
/begin RECORD_LAYOUT Val_Wu16 FNC_VALUES 1 UWORD COLUMN_DIR DIRECT /end RECORD_LAYOUT
/begin RECORD_LAYOUT Val_Wu32 FNC_VALUES 1 ULONG COLUMN_DIR DIRECT /end RECORD_LAYOUT
/begin RECORD_LAYOUT Val_Wu8 FNC_VALUES 1 UBYTE COLUMN_DIR DIRECT /end RECORD_LAYOUT
/end MODULE
/end PROJECT
