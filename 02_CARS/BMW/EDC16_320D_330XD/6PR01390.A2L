ASAP2_VERSION 1 3
/begin PROJECT P390 "BMW DDE6.2 6-Zylinder VR0.1 15.03.2004 CAN11/12H"
/begin HEADER "" VERSION "VR0.1_6Z_CAN11/12H" PROJECT_NO P390 /end HEADER
/begin MODULE DIM ""
/begin MOD_COMMON "" BYTE_ORDER MSB_FIRST ALIGNMENT_BYTE 1 ALIGNMENT_WORD 2 ALIGNMENT_LONG 4 ALIGNMENT_FLOAT32_IEEE 4 /end MOD_COMMON
/begin CHARACTERISTIC Dmd_gen_C "" VALUE 0xE5AF8 Kw_Ws16 65535.00 OneToOne -32768.00 32767.00 FORMAT "%8.2" /end CHARACTERISTIC
/begin CHARACTERISTIC InjVCD_ctThresShOffDCDCEv_C "#SSD Zälerschwelle zu detektieren endlose ""single-event"" -Aufrufen" VALUE 0xE3D2C Kw_Wu8 255.0 OneToOne 0.00 255.0 FORMAT "%5.1" READ_ONLY /end CHARACTERISTIC
/begin CHARACTERISTIC InjVCD_ctThres_C "#SSD Zähler-Schweller zur Detektion einer Verklemmung (nicht applizierbar)" VALUE 0xE3CD0 Kw_Wu32 4294967295.00 OneToOne 0.00 4294967295.00 FORMAT "%13.2" READ_ONLY /end CHARACTERISTIC
/begin CHARACTERISTIC InjVCD_uCY370ThrSRCLo_C "#SSD untere Spannungsschwelle für Integratorabgleich" VALUE 0xE370C Kw_Ws16 5000.000 Volt 0.00 5000.000 FORMAT "%8.3" EXTENDED_LIMITS -160156.4 160151.5 /end CHARACTERISTIC
/begin CHARACTERISTIC InjVCD_uCY370ThrSRCHi_C "#SSD obere Spannungsschwelle für Integratorabgleich" VALUE 0xE370E Kw_Ws16 5000.000 Volt 0.00 5000.000 FORMAT "%8.3" EXTENDED_LIMITS -160156.4 160151.5 /end CHARACTERISTIC
/begin CHARACTERISTIC InjVCD_uCY370Lin_CUR "#SSD Linearisierungskurve für Spannung vom Integratorabgleich" CURVE 0xE3710 Kl_Xs16_Ws16 320307.9 Volt -160156.4 160151.5 FORMAT "%8.1"
 /begin AXIS_DESCR STD_AXIS InjVCD_uRawCY370Int0_mp Volt 2 0.00 5200.391 FORMAT "%8.3" EXTENDED_LIMITS -160156.4 160151.5 DEPOSIT ABSOLUTE /end AXIS_DESCR
/end CHARACTERISTIC
/begin CHARACTERISTIC InjVCD_DebDCDCLowDef_C "#SSD Fehlerentprellung Zustandsdauerfehler DC_LOW" VALUE 0xE371C Kw_Ws16 327670.0 Time_ms 0.00 327670.0 FORMAT "%8.1" EXTENDED_LIMITS -327680.0 327670.0 /end CHARACTERISTIC
/begin CHARACTERISTIC InjVCD_DebDCDCStartDef_C "#SSD Fehlerentprellung Zustandsdauerfehler DC_STARTED" VALUE 0xE371E Kw_Ws16 327670.0 Time_ms 0.00 327670.0 FORMAT "%8.1" EXTENDED_LIMITS -327680.0 327670.0 /end CHARACTERISTIC
/begin CHARACTERISTIC InjVCD_DebUBufSRCHighDef_C "#SSD Defektentprellung für SRC-High-Fehler" VALUE 0xE3C98 Kw_Wu16 65535.00 OneToOne 0.00 65535.00 FORMAT "%8.2" /end CHARACTERISTIC
/begin CHARACTERISTIC InjVCD_DebUBufSRCHighOk_C "#SSD Heilungsentprellung für SRC-High-Fehler" VALUE 0xE3C9A Kw_Wu16 65535.00 OneToOne 0.00 65535.00 FORMAT "%8.2" /end CHARACTERISTIC
/begin CHARACTERISTIC InjVCD_DebUBufSRCLowDef_C "#SSD Defektentprellung für SRC-Low-Fehler" VALUE 0xE3C9C Kw_Wu16 65535.00 OneToOne 0.00 65535.00 FORMAT "%8.2" /end CHARACTERISTIC
/begin CHARACTERISTIC InjVCD_DebUBufSRCLowOk_C "#SSD Heilungsentprellung für SRC-Low-Fehler" VALUE 0xE3C9E Kw_Wu16 65535.00 OneToOne 0.00 65535.00 FORMAT "%8.2" /end CHARACTERISTIC
/begin CHARACTERISTIC InjVCD_facMonUThresHiPl_CA "#SSD Faktor fuer Schwelle fuer Spannungsplausibilisierung, Verletzung oben (index : 0=BOTT, 1=UP)" VAL_BLK 0xE3CB0 Kwb_Ws16 10.00000 Fact1 0.00 10.00000 FORMAT "%8.5" EXTENDED_LIMITS -256.0000 255.9922 NUMBER 2 /end CHARACTERISTIC
/begin CHARACTERISTIC InjVCD_facMonUThresLoPl_CA "#SSD Faktor fuer Schwelle fuer Spannungsplausibilisierung, Verletzung unten (index : 0=BOTT, 1=UP)" VAL_BLK 0xE3CB4 Kwb_Ws16 20.00000 Fact1 -10.00000 10.00000 FORMAT "%8.5" EXTENDED_LIMITS -256.0000 255.9922 NUMBER 2 /end CHARACTERISTIC
/begin CHARACTERISTIC InjVCD_iPolarUp_CUR "Kennlinie für die Ladestromgrenze des Piezo-Aktors" CURVE 0xE3CD4 Kl_Xs16_Ws16 30000.00 Curr 0.00 30000.00 FORMAT "%8.2" EXTENDED_LIMITS -32768.00 32767.00
 /begin AXIS_DESCR STD_AXIS InjVCD_tPolar_mp Temp_Cels 4 -50.14000 199.8600 FORMAT "%8.4" EXTENDED_LIMITS -3549.940 3003.560 DEPOSIT ABSOLUTE /end AXIS_DESCR
/end CHARACTERISTIC
/begin CHARACTERISTIC InjVCD_rCapUpTolc_C "#SSD Toleranzband für Kapazitätsverhältnis zur Erkennung von Kurzschlüssen der select-Schalter" VALUE 0xE3CB8 Kw_Ws16 7.999878 Fact -4.000000 3.999878 FORMAT "%8.6" /end CHARACTERISTIC
/begin CHARACTERISTIC InjVCD_rTiChrgUpTolc_C "#SSD Toleranzband fuer Aktorladezeitverhaeltnis zum Erkennen eines Lowside Schalter Kurzschlusses" VALUE 0xE3CBA Kw_Ws16 7.999878 Fact -4.000000 3.999878 FORMAT "%8.6" /end CHARACTERISTIC
/begin CHARACTERISTIC InjVCD_nEngMonShCir_C "#SSD Virtuelle Drehzahl für die Ansteuerung im Nachlauf für Kurzschlussunterscheidung" VALUE 0xE3CC4 Kw_Ws16 5000.000 EngN 0.00 5000.000 FORMAT "%8.3" EXTENDED_LIMITS -32768.00 32767.00 /end CHARACTERISTIC
/begin CHARACTERISTIC InjVCD_nPolar_C "Virtuelle Drehzahl für die Polarisierung" VALUE 0xE3CE6 Kw_Ws16 5960.000 EngN 40.00000 6000.000 FORMAT "%8.3" EXTENDED_LIMITS -32768.00 32767.00 /end CHARACTERISTIC
/begin CHARACTERISTIC InjVCD_numCollTyp_C "#SSD Nummer des Kollisionstyps" VALUE 0xC0626 Kw_Wu8 10.00 OneToOne 0.00 10.00 FORMAT "%5.2" EXTENDED_LIMITS 0.00 255.0 /end CHARACTERISTIC
/begin CHARACTERISTIC InjVCD_numPolar_C "#SSD Anzahl der Polarisierungen pro Piezo-Aktor" VALUE 0xE3CE8 Kw_Wu8 10.00 OneToOne 0.00 10.00 FORMAT "%5.2" EXTENDED_LIMITS 0.00 255.0 /end CHARACTERISTIC
/begin CHARACTERISTIC InjVCD_pPolarMax_C "Maximal zulässiger Raildruck für Polarisierung" VALUE 0xE3CEA Kw_Ws16 2000.000 Pres_Rail 0.00 2000.000 FORMAT "%5.3" EXTENDED_LIMITS -3276.800 3276.700 /end CHARACTERISTIC
/begin CHARACTERISTIC InjVCD_pRailMonShCirMax_C "#SSD Maximale zulässiger Raildruck für die Ansteuerung im Nachlauf für Kurzschlussunterscheidung" VALUE 0xE3CC6 Kw_Ws16 2000.000 Pres_Rail 0.00 2000.000 FORMAT "%5.3" EXTENDED_LIMITS -3276.800 3276.700 /end CHARACTERISTIC
/begin AXIS_PTS InjVCD_pRailZFCETCor_AXIS "gemeinsame Raildruck-Achse fuer ZFC Ansteuerdauerkorrektur-Kennfelder" 0xE3D30 RailCD_pAct_mp GSst_Xs16 600000.0 Pres_Rail 6 200000.0 800000.0 FORMAT "%8.1" EXTENDED_LIMITS -3276800. 3276700. DEPOSIT ABSOLUTE /end AXIS_PTS
/begin AXIS_PTS InjVCD_qZFCETCor_AXIS "Stuetzstellen der Menge fuer Korrekturfaktor-Gruppenkennfelder der Ansteuerdauerkorrektur der Nullmengenkalibrierung" 0xE3D3E InjVCD_qInZFCETGMap_mp GSst_Xs16 3.000000 InjMassInj 6 0.00 3.000000 FORMAT "%8.6" EXTENDED_LIMITS -327.6800 327.6700 DEPOSIT ABSOLUTE /end AXIS_PTS
/begin CHARACTERISTIC InjVCD_rMonShCirTiChrgUpTolc_C "#SSD Toleranzfenster für das Ladezeitverhältnis" VALUE 0xE3CC8 Kw_Ws16 7.999878 Fact -4.000000 3.999878 FORMAT "%8.6" /end CHARACTERISTIC
/begin CHARACTERISTIC InjVCD_rZFCETDif0_GMAP "Gruppenkennfeld Bewertungsfaktor fuer Ansteuerdauerkorrektur durch Nullmengenkalibrierung am Raildruck-Kalibrierpunkt 0" MAP 0xE3D4C Gkf_Ws16 100.0000 Prc 0.00 100.0000 FORMAT "%8.4" EXTENDED_LIMITS -400.0000 399.9878
 /begin AXIS_DESCR COM_AXIS RailCD_pAct_mp Pres_Rail 6 200.0000 2000.0000 FORMAT "%5.4" EXTENDED_LIMITS -3276.8000 3276.7000 AXIS_PTS_REF InjVCD_pRailZFCETCor_AXIS /end AXIS_DESCR
 /begin AXIS_DESCR COM_AXIS InjVCD_qInZFCETGMap_mp InjMassInj 6 0.00 3.000000 FORMAT "%8.6" EXTENDED_LIMITS -327.6800 327.6700 AXIS_PTS_REF InjVCD_qZFCETCor_AXIS /end AXIS_DESCR
/end CHARACTERISTIC
/begin CHARACTERISTIC InjVCD_rZFCETDif1_GMAP "Gruppenkennfeld Bewertungsfaktor fuer Ansteuerdauerkorrektur durch Nullmengenkalibrierung am Raildruck-Kalibrierpunkt 1" MAP 0xE3D94 Gkf_Ws16 100.0000 Prc 0.00 100.0000 FORMAT "%8.4" EXTENDED_LIMITS -400.0000 399.9878
 /begin AXIS_DESCR COM_AXIS RailCD_pAct_mp Pres_Rail 6 200.0000 2000.0000 FORMAT "%5.4" EXTENDED_LIMITS -3276.8000 3276.7000 AXIS_PTS_REF InjVCD_pRailZFCETCor_AXIS /end AXIS_DESCR
 /begin AXIS_DESCR COM_AXIS InjVCD_qInZFCETGMap_mp InjMassInj 6 0.00 3.000000 FORMAT "%8.6" EXTENDED_LIMITS -327.6800 327.6700 AXIS_PTS_REF InjVCD_qZFCETCor_AXIS /end AXIS_DESCR
/end CHARACTERISTIC
/begin CHARACTERISTIC InjVCD_rZFCETDif2_GMAP "#SSD Gruppenkennfeld Bewertungsfaktor fuer Ansteuerdauerkorrektur durch Nullmengenkalibrierung am Raildruck-Kalibrierpunkt 2" MAP 0xE3DDC Gkf_Ws16 100.0000 Prc 0.00 100.0000 FORMAT "%8.4" EXTENDED_LIMITS -400.0000 399.9878
 /begin AXIS_DESCR COM_AXIS RailCD_pAct_mp Pres_Rail 6 200.0000 2000.0000 FORMAT "%5.4" EXTENDED_LIMITS -3276.8000 3276.7000 AXIS_PTS_REF InjVCD_pRailZFCETCor_AXIS /end AXIS_DESCR
 /begin AXIS_DESCR COM_AXIS InjVCD_qInZFCETGMap_mp InjMassInj 6 0.00 3.000000 FORMAT "%8.6" EXTENDED_LIMITS -327.6800 327.6700 AXIS_PTS_REF InjVCD_qZFCETCor_AXIS /end AXIS_DESCR
/end CHARACTERISTIC
/begin CHARACTERISTIC InjVCD_rZFCETMsk_GMAP "Gruppenkennfeld Gesamtbewertungsfaktor der Ansteuerdauerkorrektur durch Nullmengenkalibrierung" MAP 0xE3E24 Gkf_Ws16 100.0000 Prc 0.00 100.0000 FORMAT "%8.4" EXTENDED_LIMITS -400.0000 399.9878
 /begin AXIS_DESCR COM_AXIS RailCD_pAct_mp Pres_Rail 6 200.0000 2000.0000 FORMAT "%5.4" EXTENDED_LIMITS -3276.8000 3276.7000 AXIS_PTS_REF InjVCD_pRailZFCETCor_AXIS /end AXIS_DESCR
 /begin AXIS_DESCR COM_AXIS InjVCD_qInZFCETGMap_mp InjMassInj 6 0.00 3.000000 FORMAT "%8.6" EXTENDED_LIMITS -327.6800 327.6700 AXIS_PTS_REF InjVCD_qZFCETCor_AXIS /end AXIS_DESCR
/end CHARACTERISTIC
/begin CHARACTERISTIC InjVCD_stCY370RcyTst_C "#SSD Testlabel zum Testen der Recoveries im InjVCD_CY370-Prozess" VALUE 0xE371A Kw_Wu8 255.0 OneToOne 0.00 255.0 FORMAT "%5.1" /end CHARACTERISTIC
/begin CHARACTERISTIC InjVCD_stInputZFCETGMap_C "Auswahl der Menge fuer Anzeige der Gruppenkennfelder InjVCD_rZFCETDif0_GMAP, ...Dif1_GMAP, ...Msk_GMAP" VALUE 0xE3E6C Kw_Wu8 255.0 OneToOne 0.00 255.0 FORMAT "%5.1" /end CHARACTERISTIC
/begin CHARACTERISTIC InjVCD_stZFCETCorActv_C "Aktivierungsstatus der ZFC Ansteuerdauerkorrektur (0 = keine Korrektur)" VALUE 0xE3E6D Kw_Wu8 0.00 OneToOne 0.00 0.00 FORMAT "%5.2" EXTENDED_LIMITS 0.00 255.0 /end CHARACTERISTIC
/begin CHARACTERISTIC InjVCD_swtEvMgmt_C "#SSD Freigabeschalter des Flankenmanagements" VALUE 0xC0628 Kw_Ws16 1000.000 OneToOne 0.00 1000.000 FORMAT "%8.3" EXTENDED_LIMITS -32768.00 32767.00 /end CHARACTERISTIC
/begin CHARACTERISTIC InjVCD_swtInputETMAP_C "Auswahl der Eingangsgrössen zur Darstellung von InjVCD_tiET_MAP auf dem Applikationstool." VALUE 0xE3722 Kw_Wu8 15.00 OneToOne 0.00 15.00 FORMAT "%5.2" EXTENDED_LIMITS 0.00 255.0 /end CHARACTERISTIC
/begin CHARACTERISTIC InjVCD_swtPolarOvrlap_C "Polarisierungsmodus: Ansteuerungen auf verschiedenen Bänken können einander überlappen" VALUE 0xE3CEC Kw_Wu8 1.000 OneToOne 0.00 1.000 FORMAT "%5.3" EXTENDED_LIMITS 0.00 255.0 /end CHARACTERISTIC
/begin CHARACTERISTIC InjVCD_swtShOffDCDCTst_C "#SSD Testschalter zum Test des Ladeschalterkurzschlusses" VALUE 0xE3D2D Kw_Wu8 255.0 OneToOne 0.00 255.0 FORMAT "%5.1" /end CHARACTERISTIC
/begin CHARACTERISTIC InjVCD_swtZFCCorOvrRunOn_C "Schalter zum Einschalten der ZFC-Korrektur bei aktiver Schubüberwachung (1= Korrektur auch bei aktiver Schubüberwachung)" VALUE 0xE3E6E Kw_Wu8 0.00 OneToOne 0.00 0.00 FORMAT "%5.2" EXTENDED_LIMITS 0.00 255.0 /end CHARACTERISTIC
/begin CHARACTERISTIC InjVCD_tiET_MAP "#SSD Kennfeld zur Umrechnung von Einspritzmengen in Ansteuerdauer. Gilt für alle Einspritzungen." MAP 0xE3724 Kf_Xs16_Ys16_Ws16 5000.000 InjTime_us 0.00 5000.000 FORMAT "%8.3" EXTENDED_LIMITS -32768.00 32767.00
 /begin AXIS_DESCR STD_AXIS InjVCD_pInET_mp Pres_Rail 16 0.00 2000.000 FORMAT "%5.3" EXTENDED_LIMITS -3276.800 3276.700 DEPOSIT ABSOLUTE /end AXIS_DESCR
 /begin AXIS_DESCR STD_AXIS InjVCD_volInET_mp InjQntInj 40 0.00 327.6700 FORMAT "%8.4" EXTENDED_LIMITS -327.6800 327.6700 DEPOSIT ABSOLUTE /end AXIS_DESCR
/end CHARACTERISTIC
/begin CHARACTERISTIC InjVCD_tiLeadJit_C "#SSD Dynamischer Vorhalt" VALUE 0xC062C Kw_Wu32 5000.00000000 InjTime_us 0.00 5000.00000000 FORMAT "%13.8" EXTENDED_LIMITS 0.00 4294967295.00 /end CHARACTERISTIC
/begin CHARACTERISTIC InjVCD_tiLeadPost1_C "#SSD Strategischer Vorhalt" VALUE 0xC0630 Kw_Wu32 5000.00000000 InjTime_us 0.00 5000.00000000 FORMAT "%13.8" EXTENDED_LIMITS 0.00 4294967295.00 /end CHARACTERISTIC
/begin CHARACTERISTIC InjVCD_tiLeadPost2_C "#SSD Strategischer Vorhalt" VALUE 0xC0634 Kw_Wu32 5000.00000000 InjTime_us 0.00 5000.00000000 FORMAT "%13.8" EXTENDED_LIMITS 0.00 4294967295.00 /end CHARACTERISTIC
/begin CHARACTERISTIC InjVCD_tiLeadPost3_C "#SSD Strategischer Vorhalt" VALUE 0xC0638 Kw_Wu32 5000.00000000 InjTime_us 0.00 5000.00000000 FORMAT "%13.8" EXTENDED_LIMITS 0.00 4294967295.00 /end CHARACTERISTIC
/begin CHARACTERISTIC InjVCD_tiLeadPost4_C "#SSD Strategischer Vorhalt" VALUE 0xC063C Kw_Wu32 5000.00000000 InjTime_us 0.00 5000.00000000 FORMAT "%13.8" EXTENDED_LIMITS 0.00 4294967295.00 /end CHARACTERISTIC
/begin CHARACTERISTIC InjVCD_tiLeadPre1_C "#SSD Strategischer Vorhalt" VALUE 0xC0640 Kw_Wu32 5000.00000000 InjTime_us 0.00 5000.00000000 FORMAT "%13.8" EXTENDED_LIMITS 0.00 4294967295.00 /end CHARACTERISTIC
/begin CHARACTERISTIC InjVCD_tiLeadPre2_C "#SSD Strategischer Vorhalt" VALUE 0xC0644 Kw_Wu32 5000.00000000 InjTime_us 0.00 5000.00000000 FORMAT "%13.8" EXTENDED_LIMITS 0.00 4294967295.00 /end CHARACTERISTIC
/begin CHARACTERISTIC InjVCD_tiLeadPre3_C "#SSD Strategischer Vorhalt" VALUE 0xC0648 Kw_Wu32 5000.00000000 InjTime_us 0.00 5000.00000000 FORMAT "%13.8" EXTENDED_LIMITS 0.00 4294967295.00 /end CHARACTERISTIC
/begin CHARACTERISTIC InjVCD_tiLeadPre4_C "#SSD Strategischer Vorhalt" VALUE 0xC064C Kw_Wu32 5000.00000000 InjTime_us 0.00 5000.00000000 FORMAT "%13.8" EXTENDED_LIMITS 0.00 4294967295.00 /end CHARACTERISTIC
/begin CHARACTERISTIC InjVCD_tiMi1ThresLo_C "#SSD Schwelle zur Prüfung des Meßzeitpunkts der Aktorspannung" VALUE 0xE3CBC Kw_Ws32 2147483647.00 InjTime_us 0.00 2147483647.00 FORMAT "%13.2" EXTENDED_LIMITS -2147483648.00 2147483647.00 /end CHARACTERISTIC
/begin CHARACTERISTIC InjVCD_tiMonET_C "#SSD Ansteuerdauer für Kurzschlussunterscheidung" VALUE 0xE3CCA Kw_Ws16 7700.000 InjTime_us 200.0000 7900.000 FORMAT "%8.3" EXTENDED_LIMITS -32768.00 32767.00 /end CHARACTERISTIC
/begin CHARACTERISTIC InjVCD_tiMonLead_C "#SSD Abstand zwischen Entlade- Ladezeit" VALUE 0xE3CCC Kw_Ws16 4950.000 InjTime_us 50.00000 5000.000 FORMAT "%8.3" EXTENDED_LIMITS -32768.00 32767.00 /end CHARACTERISTIC
/begin CHARACTERISTIC InjVCD_tiMonThresHiPlaus_C "#SSD Maximalschwelle der Ladezeit" VALUE 0xE3CC0 Kw_Ws16 3276.700 Time_Busy 0.00 3276.700 FORMAT "%8.3" EXTENDED_LIMITS -3276.800 3276.700 /end CHARACTERISTIC
/begin CHARACTERISTIC InjVCD_tiMonThresLoPlaus_C "#SSD Minimalschwelle für Ladezeit" VALUE 0xE3CC2 Kw_Ws16 3276.700 Time_Busy 0.00 3276.700 FORMAT "%8.3" EXTENDED_LIMITS -3276.800 3276.700 /end CHARACTERISTIC
/begin CHARACTERISTIC InjVCD_tiPolarET_CUR "Ansteuerdauer der Polarisierung als Funktion der Kühlmitteltemperatur" CURVE 0xE3CEE Kl_Xs16_Ws16 7900.000 InjTime_us 0.00 7900.000 FORMAT "%8.3" EXTENDED_LIMITS -32768.00 32767.00
 /begin AXIS_DESCR STD_AXIS InjVCD_tPolar_mp Temp_Cels 4 -50.14000 199.8600 FORMAT "%8.4" EXTENDED_LIMITS -3549.940 3003.560 DEPOSIT ABSOLUTE /end AXIS_DESCR
/end CHARACTERISTIC
/begin CHARACTERISTIC InjVCD_tiPolarLead_C "#SSD Minimaler Abstand zwischen zwei Ansteuerungen (Polarisierung)" VALUE 0xE3D00 Kw_Ws16 4950.000 InjTime_us 50.00000 5000.000 FORMAT "%8.3" EXTENDED_LIMITS -32768.00 32767.00 /end CHARACTERISTIC
/begin CHARACTERISTIC InjVCD_tiPolarOvrlap_C "Minimale Ansteuerdauer für die überlappende Aktoransteuerung während der Polarisierung" VALUE 0xE3D02 Kw_Ws16 7700.000 InjTime_us 200.0000 7900.000 FORMAT "%8.3" EXTENDED_LIMITS -32768.00 32767.00 /end CHARACTERISTIC
/begin CHARACTERISTIC InjVCD_tiPolarPse_C "Maximale Lade- / Entladezeit des Aktors" VALUE 0xE3D04 Kw_Ws16 5000.000 InjTime_us 0.00 5000.000 FORMAT "%8.3" EXTENDED_LIMITS -32768.00 32767.00 /end CHARACTERISTIC
/begin CHARACTERISTIC InjVCD_tiPolarPse_CUR "Pausezeit der Polarisierung als Funktion der Ansteuerdauer" CURVE 0xE3D06 Kl_Xs16_Ws16 7900.000 InjTime_us 0.00 7900.000 FORMAT "%8.3" EXTENDED_LIMITS -32768.00 32767.00
 /begin AXIS_DESCR STD_AXIS InjVCD_tiPolarET_mp InjTime_us 4 200.0000 7900.000 FORMAT "%8.3" EXTENDED_LIMITS -32768.00 32767.00 DEPOSIT ABSOLUTE /end AXIS_DESCR
/end CHARACTERISTIC
/begin CHARACTERISTIC InjVCD_tiZFCETCorMax_C "maximale ZFC Ansteuerdauerkorrektur" VALUE 0xE3E70 Kw_Ws16 5300.0000 InjTime_us -300.0000 5000.0000 FORMAT "%8.4" EXTENDED_LIMITS -32768.00 32767.00 /end CHARACTERISTIC
/begin CHARACTERISTIC InjVCD_tiZFCETCorMin_C "minimale ZFC Ansteuerdauerkorrektur" VALUE 0xE3E72 Kw_Ws16 5300.0000 InjTime_us -300.0000 5000.0000 FORMAT "%8.4" EXTENDED_LIMITS -32768.00 32767.00 /end CHARACTERISTIC
/begin CHARACTERISTIC InjVCD_tPolarMax_C "Maximal zulässige Temperatur für die Polarisierung" VALUE 0xE3D18 Kw_Ws16 250.0000 Temp_Cels -50.14000 199.8600 FORMAT "%8.4" EXTENDED_LIMITS -3549.940 3003.560 /end CHARACTERISTIC
/begin CHARACTERISTIC InjVCD_uBufCLoLim_C "#SSD Untergrenze der Pufferspannung des DC/DC-Wandlers im Normalzustand" VALUE 0xE3720 Kw_Ws16 45.00000 Volt_BUFC 215.0000 260.0000 FORMAT "%8.4" EXTENDED_LIMITS -327.6800 327.6700 /end CHARACTERISTIC
/begin CHARACTERISTIC InjVCD_uBufSRCMin_C "#SSD SRC-low-Wert der Buffer-Spannung" VALUE 0xE3CA0 Kw_Ws16 5200.391 Volt 0.00 5200.391 FORMAT "%8.3" EXTENDED_LIMITS -160156.4 160151.5 /end CHARACTERISTIC
/begin CHARACTERISTIC InjVCD_uBufSRCMax_C "#SSD SRC-high-Wert der Buffer-Spannung" VALUE 0xE3CA2 Kw_Ws16 5200.391 Volt 0.00 5200.391 FORMAT "%8.3" EXTENDED_LIMITS -160156.4 160151.5 /end CHARACTERISTIC
/begin CHARACTERISTIC InjVCD_uBufLin_CUR "#SSD Kennlinie zur Linearisierung der Bufferspannung" CURVE 0xE3CA4 Kl_Xs16_Ws16 320.0000 Volt_BUFC 0.00 320.0000 FORMAT "%8.4" EXTENDED_LIMITS -327.6800 327.6700
 /begin AXIS_DESCR STD_AXIS InjVCD_uBufRaw_mp Volt 2 0.00 5200.391 FORMAT "%8.3" EXTENDED_LIMITS -160156.4 160151.5 DEPOSIT ABSOLUTE /end AXIS_DESCR
/end CHARACTERISTIC
/begin CHARACTERISTIC InjVCD_uPolarUp_CUR "Aktor Up-Niveau der Polarisierung als Funktion der Kühlmitteltemperatur" CURVE 0xE3D1A Kl_Xs16_Ws16 500.0000 Volt_PA -250.0000 250.0000 FORMAT "%8.4" EXTENDED_LIMITS -327.6800 327.6700
 /begin AXIS_DESCR STD_AXIS InjVCD_tPolar_mp Temp_Cels 4 -50.14000 199.8600 FORMAT "%8.4" EXTENDED_LIMITS -3549.940 3003.560 DEPOSIT ABSOLUTE /end AXIS_DESCR
/end CHARACTERISTIC
/begin CHARACTERISTIC InjVCD_uShOffBufThres_C "#SSD Spannungsschwelle für Schutzsbschaltung des DC/DC-Wandlers bei Ladeschalterkurzschluss" VALUE 0xE3D2E Kw_Ws16 60.00000 Volt_PA 210.0000 270.0000 FORMAT "%8.4" EXTENDED_LIMITS -327.6800 327.6700 /end CHARACTERISTIC
/begin CHARACTERISTIC InjVlv_ctMonQckThresLo_C "#SSD Zählerschwelle für Schnell-Erkennung der Kurzschlüsse nach Batterie und Masse bei niedrigen Motordrehzahlen" VALUE 0xE43F0 Kw_Wu8 255.0 OneToOne 0.00 255.0 FORMAT "%5.1" /end CHARACTERISTIC
/begin CHARACTERISTIC InjVlv_ctMonQckThres_C "#SSD Zählerschwelle für Schnell-Erkennung der Kurzschlüsse nach Batterie und Masse" VALUE 0xE43F1 Kw_Wu8 255.0 OneToOne 0.00 255.0 FORMAT "%5.1" /end CHARACTERISTIC
/begin CHARACTERISTIC InjVlv_DebBnkA0Def_C "#SSD Defektentprellung für A Bankfehlerpfade Bit 0" VALUE 0xE43F2 Kw_Wu16 65535.00 OneToOne 0.00 65535.00 FORMAT "%8.2" /end CHARACTERISTIC
/begin CHARACTERISTIC InjVlv_DebBnkA0Ok_C "#SSD Heilungsentprellung für A Bankfehlerpfade Bit 0" VALUE 0xE43F4 Kw_Wu16 65535.00 OneToOne 0.00 65535.00 FORMAT "%8.2" /end CHARACTERISTIC
/begin CHARACTERISTIC InjVlv_DebBnkA1Def_C "#SSD Defektentprellung für A Bankfehlerpfade Bit 1" VALUE 0xE43F6 Kw_Wu16 65535.00 OneToOne 0.00 65535.00 FORMAT "%8.2" /end CHARACTERISTIC
/begin CHARACTERISTIC InjVlv_DebBnkA1Ok_C "#SSD Heilungsentprellung für A Bankfehlerpfade Bit 1" VALUE 0xE43F8 Kw_Wu16 65535.00 OneToOne 0.00 65535.00 FORMAT "%8.2" /end CHARACTERISTIC
/begin CHARACTERISTIC InjVlv_DebBnkA2Def_C "#SSD Defektentprellung für A Bankfehlerpfade Bit 2" VALUE 0xE43FA Kw_Wu16 65535.00 OneToOne 0.00 65535.00 FORMAT "%8.2" /end CHARACTERISTIC
/begin CHARACTERISTIC InjVlv_DebBnkA2Ok_C "#SSD Heilungsentprellung für A Bankfehlerpfade Bit 2" VALUE 0xE43FC Kw_Wu16 65535.00 OneToOne 0.00 65535.00 FORMAT "%8.2" /end CHARACTERISTIC
/begin CHARACTERISTIC InjVlv_DebBnkA3Def_C "#SSD Defektentprellung für A Bankfehlerpfade Bit 3" VALUE 0xE43FE Kw_Wu16 65535.00 OneToOne 0.00 65535.00 FORMAT "%8.2" /end CHARACTERISTIC
/begin CHARACTERISTIC InjVlv_DebBnkA3Ok_C "#SSD Heilungsentprellung für A Bankfehlerpfade Bit 3" VALUE 0xE4400 Kw_Wu16 65535.00 OneToOne 0.00 65535.00 FORMAT "%8.2" /end CHARACTERISTIC
/begin CHARACTERISTIC InjVlv_DebBnkB0Def_C "#SSD Defektentprellung für B Bankfehlerpfade Bit 0" VALUE 0xE4402 Kw_Wu16 65535.00 OneToOne 0.00 65535.00 FORMAT "%8.2" /end CHARACTERISTIC
/begin CHARACTERISTIC InjVlv_DebBnkB0Ok_C "#SSD Heilungsentprellung für B Bankfehlerpfade Bit 0" VALUE 0xE4404 Kw_Wu16 65535.00 OneToOne 0.00 65535.00 FORMAT "%8.2" /end CHARACTERISTIC
/begin CHARACTERISTIC InjVlv_DebBnkB1Def_C "#SSD Defektentprellung für B Bankfehlerpfade Bit 1" VALUE 0xE4406 Kw_Wu16 65535.00 OneToOne 0.00 65535.00 FORMAT "%8.2" /end CHARACTERISTIC
/begin CHARACTERISTIC InjVlv_DebBnkB1Ok_C "#SSD Heilungsentprellung für B Bankfehlerpfade Bit 1" VALUE 0xE4408 Kw_Wu16 65535.00 OneToOne 0.00 65535.00 FORMAT "%8.2" /end CHARACTERISTIC
/begin CHARACTERISTIC InjVlv_DebBnkB2Def_C "#SSD Defektentprellung für B Bankfehlerpfade Bit 2" VALUE 0xE440A Kw_Wu16 65535.00 OneToOne 0.00 65535.00 FORMAT "%8.2" /end CHARACTERISTIC
/begin CHARACTERISTIC InjVlv_DebBnkB2Ok_C "#SSD Heilungsentprellung für B Bankfehlerpfade Bit 2" VALUE 0xE440C Kw_Wu16 65535.00 OneToOne 0.00 65535.00 FORMAT "%8.2" /end CHARACTERISTIC
/begin CHARACTERISTIC InjVlv_DebBnkB3Def_C "#SSD Defektentprellung für B Bankfehlerpfade Bit 3" VALUE 0xE440E Kw_Wu16 65535.00 OneToOne 0.00 65535.00 FORMAT "%8.2" /end CHARACTERISTIC
/begin CHARACTERISTIC InjVlv_DebBnkB3Ok_C "#SSD Heilungsentprellung für B Bankfehlerpfade Bit 3" VALUE 0xE4410 Kw_Wu16 65535.00 OneToOne 0.00 65535.00 FORMAT "%8.2" /end CHARACTERISTIC
/begin CHARACTERISTIC InjVlv_DebChipA0Def_C "#SSD Defektentprellung für  A Bausteinfehlerpfade Bit 0" VALUE 0xE4412 Kw_Wu16 65535.00 OneToOne 0.00 65535.00 FORMAT "%8.2" /end CHARACTERISTIC
/begin CHARACTERISTIC InjVlv_DebChipA0Ok_C "#SSD Heilungsentprellung für  A Bausteinfehlerpfade Bit 0" VALUE 0xE4414 Kw_Wu16 65535.00 OneToOne 0.00 65535.00 FORMAT "%8.2" /end CHARACTERISTIC
/begin CHARACTERISTIC InjVlv_DebChipA1Def_C "#SSD Defektentprellung für  A Bausteinfehlerpfade Bit 1" VALUE 0xE4416 Kw_Wu16 65535.00 OneToOne 0.00 65535.00 FORMAT "%8.2" /end CHARACTERISTIC
/begin CHARACTERISTIC InjVlv_DebChipA1Ok_C "#SSD Heilungsentprellung für  A Bausteinfehlerpfade Bit 1" VALUE 0xE4418 Kw_Wu16 65535.00 OneToOne 0.00 65535.00 FORMAT "%8.2" /end CHARACTERISTIC
/begin CHARACTERISTIC InjVlv_DebChipA2Def_C "#SSD Defektentprellung für  A Bausteinfehlerpfade Bit 2" VALUE 0xE441A Kw_Wu16 65535.00 OneToOne 0.00 65535.00 FORMAT "%8.2" /end CHARACTERISTIC
/begin CHARACTERISTIC InjVlv_DebChipA2Ok_C "#SSD Heilungsentprellung für  A Bausteinfehlerpfade Bit 2" VALUE 0xE441C Kw_Wu16 65535.00 OneToOne 0.00 65535.00 FORMAT "%8.2" /end CHARACTERISTIC
/begin CHARACTERISTIC InjVlv_DebChipA3Def_C "#SSD Defektentprellung für  A Bausteinfehlerpfade Bit 3" VALUE 0xE441E Kw_Wu16 65535.00 OneToOne 0.00 65535.00 FORMAT "%8.2" /end CHARACTERISTIC
/begin CHARACTERISTIC InjVlv_DebChipA3Ok_C "#SSD Heilungsentprellung für  A Bausteinfehlerpfade Bit 3" VALUE 0xE4420 Kw_Wu16 65535.00 OneToOne 0.00 65535.00 FORMAT "%8.2" /end CHARACTERISTIC
/begin CHARACTERISTIC InjVlv_DebChipB0Def_C "#SSD Defektentprellung für  B Bausteinfehlerpfade Bit 0" VALUE 0xE4422 Kw_Wu16 65535.00 OneToOne 0.00 65535.00 FORMAT "%8.2" /end CHARACTERISTIC
/begin CHARACTERISTIC InjVlv_DebChipB0Ok_C "#SSD Heilungsentprellung für  B Bausteinfehlerpfade Bit 0" VALUE 0xE4424 Kw_Wu16 65535.00 OneToOne 0.00 65535.00 FORMAT "%8.2" /end CHARACTERISTIC
/begin CHARACTERISTIC InjVlv_DebChipB1Def_C "#SSD Defektentprellung für  B Bausteinfehlerpfade Bit 1" VALUE 0xE4426 Kw_Wu16 65535.00 OneToOne 0.00 65535.00 FORMAT "%8.2" /end CHARACTERISTIC
/begin CHARACTERISTIC InjVlv_DebChipB1Ok_C "#SSD Heilungsentprellung für  B Bausteinfehlerpfade Bit 1" VALUE 0xE4428 Kw_Wu16 65535.00 OneToOne 0.00 65535.00 FORMAT "%8.2" /end CHARACTERISTIC
/begin CHARACTERISTIC InjVlv_DebChipB2Def_C "#SSD Defektentprellung für  B Bausteinfehlerpfade Bit 2" VALUE 0xE442A Kw_Wu16 65535.00 OneToOne 0.00 65535.00 FORMAT "%8.2" /end CHARACTERISTIC
/begin CHARACTERISTIC InjVlv_DebChipB2Ok_C "#SSD Heilungsentprellung für  B Bausteinfehlerpfade Bit 2" VALUE 0xE442C Kw_Wu16 65535.00 OneToOne 0.00 65535.00 FORMAT "%8.2" /end CHARACTERISTIC
/begin CHARACTERISTIC InjVlv_DebChipB3Def_C "#SSD Defektentprellung für  B Bausteinfehlerpfade Bit 3" VALUE 0xE442E Kw_Wu16 65535.00 OneToOne 0.00 65535.00 FORMAT "%8.2" /end CHARACTERISTIC
/begin CHARACTERISTIC InjVlv_DebChipB3Ok_C "#SSD Heilungsentprellung für  B Bausteinfehlerpfade Bit 3" VALUE 0xE4430 Kw_Wu16 65535.00 OneToOne 0.00 65535.00 FORMAT "%8.2" /end CHARACTERISTIC
/begin CHARACTERISTIC InjVlv_DebCylA0Def_C "#SSD Defektentprellung für A Zylinderfehlerpfade Bit 0" VALUE 0xE4432 Kw_Wu16 65535.00 OneToOne 0.00 65535.00 FORMAT "%8.2" /end CHARACTERISTIC
/begin CHARACTERISTIC InjVlv_DebCylA0Ok_C "#SSD Heilungsentprellung für A Zylinderfehlerpfade Bit 0" VALUE 0xE4434 Kw_Wu16 65535.00 OneToOne 0.00 65535.00 FORMAT "%8.2" /end CHARACTERISTIC
/begin CHARACTERISTIC InjVlv_DebCylA1Def_C "#SSD Defektentprellung für A Zylinderfehlerpfade Bit 1" VALUE 0xE4436 Kw_Wu16 65535.00 OneToOne 0.00 65535.00 FORMAT "%8.2" /end CHARACTERISTIC
/begin CHARACTERISTIC InjVlv_DebCylA1Ok_C "#SSD Heilungsentprellung für A Zylinderfehlerpfade Bit 1" VALUE 0xE4438 Kw_Wu16 65535.00 OneToOne 0.00 65535.00 FORMAT "%8.2" /end CHARACTERISTIC
/begin CHARACTERISTIC InjVlv_DebCylA2Def_C "#SSD Defektentprellung für A Zylinderfehlerpfade Bit 2" VALUE 0xE443A Kw_Wu16 65535.00 OneToOne 0.00 65535.00 FORMAT "%8.2" /end CHARACTERISTIC
/begin CHARACTERISTIC InjVlv_DebCylA2Ok_C "#SSD Heilungsentprellung für A Zylinderfehlerpfade Bit 2" VALUE 0xE443C Kw_Wu16 65535.00 OneToOne 0.00 65535.00 FORMAT "%8.2" /end CHARACTERISTIC
/begin CHARACTERISTIC InjVlv_DebCylA3Def_C "#SSD Defektentprellung für A Zylinderfehlerpfade Bit 3" VALUE 0xE443E Kw_Wu16 65535.00 OneToOne 0.00 65535.00 FORMAT "%8.2" /end CHARACTERISTIC
/begin CHARACTERISTIC InjVlv_DebCylA3Ok_C "#SSD Heilungsentprellung für A Zylinderfehlerpfade Bit 3" VALUE 0xE4440 Kw_Wu16 65535.00 OneToOne 0.00 65535.00 FORMAT "%8.2" /end CHARACTERISTIC
/begin CHARACTERISTIC InjVlv_DebCylB0Def_C "#SSD Defektentprellung für B Zylinderfehlerpfade Bit 0" VALUE 0xE4442 Kw_Wu16 65535.00 OneToOne 0.00 65535.00 FORMAT "%8.2" /end CHARACTERISTIC
/begin CHARACTERISTIC InjVlv_DebCylB0Ok_C "#SSD Heilungsentprellung für B Zylinderfehlerpfade Bit 0" VALUE 0xE4444 Kw_Wu16 65535.00 OneToOne 0.00 65535.00 FORMAT "%8.2" /end CHARACTERISTIC
/begin CHARACTERISTIC InjVlv_DebCylB1Def_C "#SSD Defektentprellung für B Zylinderfehlerpfade Bit 1" VALUE 0xE4446 Kw_Wu16 65535.00 OneToOne 0.00 65535.00 FORMAT "%8.2" /end CHARACTERISTIC
/begin CHARACTERISTIC InjVlv_DebCylB1Ok_C "#SSD Heilungsentprellung für B Zylinderfehlerpfade Bit 1" VALUE 0xE4448 Kw_Wu16 65535.00 OneToOne 0.00 65535.00 FORMAT "%8.2" /end CHARACTERISTIC
/begin CHARACTERISTIC InjVlv_DebCylB2Def_C "#SSD Defektentprellung für B Zylinderfehlerpfade Bit 2" VALUE 0xE444A Kw_Wu16 65535.00 OneToOne 0.00 65535.00 FORMAT "%8.2" /end CHARACTERISTIC
/begin CHARACTERISTIC InjVlv_DebCylB2Ok_C "#SSD Heilungsentprellung für B Zylinderfehlerpfade Bit 2" VALUE 0xE444C Kw_Wu16 65535.00 OneToOne 0.00 65535.00 FORMAT "%8.2" /end CHARACTERISTIC
/begin CHARACTERISTIC InjVlv_DebCylB3Def_C "#SSD Defektentprellung für B Zylinderfehlerpfade Bit 3" VALUE 0xE444E Kw_Wu16 65535.00 OneToOne 0.00 65535.00 FORMAT "%8.2" /end CHARACTERISTIC
/begin CHARACTERISTIC InjVlv_DebCylB3Ok_C "#SSD Heilungsentprellung für B Zylinderfehlerpfade Bit 3" VALUE 0xE4450 Kw_Wu16 65535.00 OneToOne 0.00 65535.00 FORMAT "%8.2" /end CHARACTERISTIC
/begin CHARACTERISTIC InjVlv_DebCylC0Def_C "#SSD Defekt-Entprellung von Bit 0 in C-Fehlerpfade der Zylinder" VALUE 0xE4452 Kw_Wu16 65535.00 OneToOne 0.00 65535.00 FORMAT "%8.2" /end CHARACTERISTIC
/begin CHARACTERISTIC InjVlv_DebCylC0Ok_C "#SSD Heilungs-Entprellung von Bit 0 in C-Fehlerpfade der Zylinder" VALUE 0xE4454 Kw_Wu16 65535.00 OneToOne 0.00 65535.00 FORMAT "%8.2" /end CHARACTERISTIC
/begin CHARACTERISTIC InjVlv_DebCylC1Def_C "#SSD Defekt-Entprellung von Bit 1 in C-Fehlerpfade der Zylinder" VALUE 0xE4456 Kw_Wu16 65535.00 OneToOne 0.00 65535.00 FORMAT "%8.2" /end CHARACTERISTIC
/begin CHARACTERISTIC InjVlv_DebCylC1Ok_C "#SSD Heilungs-Entprellung von Bit 1 in C-Fehlerpfade der Zylinder" VALUE 0xE4458 Kw_Wu16 65535.00 OneToOne 0.00 65535.00 FORMAT "%8.2" /end CHARACTERISTIC
/begin CHARACTERISTIC InjVlv_DebCylC2Def_C "#SSD Defekt-Entprellung von Bit 2 in C-Fehlerpfade der Zylinder" VALUE 0xE445A Kw_Wu16 65535.00 OneToOne 0.00 65535.00 FORMAT "%8.2" /end CHARACTERISTIC
/begin CHARACTERISTIC InjVlv_DebCylC2Ok_C "#SSD Heilungs-Entprellung von Bit 2 in C-Fehlerpfade der Zylinder" VALUE 0xE445C Kw_Wu16 65535.00 OneToOne 0.00 65535.00 FORMAT "%8.2" /end CHARACTERISTIC
/begin CHARACTERISTIC InjVlv_DebCylC3Def_C "#SSD Defekt-Entprellung von Bit 3 in C-Fehlerpfade der Zylinder" VALUE 0xE445E Kw_Wu16 65535.00 OneToOne 0.00 65535.00 FORMAT "%8.2" /end CHARACTERISTIC
/begin CHARACTERISTIC InjVlv_DebCylC3Ok_C "#SSD Heilungs-Entprellung von Bit 3 in C-Fehlerpfade der Zylinder" VALUE 0xE4460 Kw_Wu16 65535.00 OneToOne 0.00 65535.00 FORMAT "%8.2" /end CHARACTERISTIC
/begin CHARACTERISTIC InjVlv_DebNVCDef_C "Entprellparemeter für die Defekterkennung der NVC" VALUE 0xE456C Kw_Wu16 65535.00 OneToOne 0.00 65535.00 FORMAT "%8.2" /end CHARACTERISTIC
/begin CHARACTERISTIC InjVlv_DebNVCOK_C "Entprellparameter für Heilung der NVC" VALUE 0xE456E Kw_Wu16 65535.00 OneToOne 0.00 65535.00 FORMAT "%8.2" /end CHARACTERISTIC
/begin CHARACTERISTIC InjVlv_facAddBalRls_MAP "Freigabekennfeld zur Aufrechnung der Mengenkorrektur" MAP 0xE3E74 Kf_Xs16_Ys16_Ws16 1.000000 Fact 0.00 1.000000 FORMAT "%8.6" EXTENDED_LIMITS -4.000000 3.999878
 /begin AXIS_DESCR STD_AXIS RailCD_pPeak Pres_Rail 3 0.00 2000.000 FORMAT "%5.3" EXTENDED_LIMITS -3276.800 3276.700 DEPOSIT ABSOLUTE /end AXIS_DESCR
 /begin AXIS_DESCR STD_AXIS InjCtl_qSetUnBal InjMassCyc 2 0.00 327.6700 FORMAT "%8.4" EXTENDED_LIMITS -327.6800 327.6700 DEPOSIT ABSOLUTE /end AXIS_DESCR
/end CHARACTERISTIC
/begin CHARACTERISTIC InjVlv_facFTSWvCor_MAP "KF für die Berechnung des kraftstofftemperaturabhängigen Druckwellenkorrekturfaktors" MAP 0xE49DA Kf_Xs16_Ys16_Ws16 2.000000 Fact 0.00 2.000000 FORMAT "%8.6" EXTENDED_LIMITS -4.000000 3.999878
 /begin AXIS_DESCR STD_AXIS RailCD_pPeak Pres_Rail 16 0.00 2000.000 FORMAT "%5.3" EXTENDED_LIMITS -3276.800 3276.700 DEPOSIT ABSOLUTE /end AXIS_DESCR
 /begin AXIS_DESCR STD_AXIS InjVlv_tWvCor_mp Temp_Cels 8 -50.1400 199.8600 FORMAT "%8.4" EXTENDED_LIMITS -3549.940 3003.560 DEPOSIT ABSOLUTE /end AXIS_DESCR
/end CHARACTERISTIC
/begin CHARACTERISTIC InjVlv_facNVCDflI_C "Defaultwert des NVC-Faktors" VALUE 0xE4570 Kw_Ws16 1.000000 Fact -0.5000000 0.5000000 FORMAT "%9.7" EXTENDED_LIMITS -4.000000 3.999878 /end CHARACTERISTIC
/begin CHARACTERISTIC InjVlv_facNVCDfpMax_C "Oberer Grenzwert von InjVlv_facNVCActr[x] ab dem der Fehlerfpad der NVC gesetzt wird" VALUE 0xE4572 Kw_Ws16 3.900024 Fact 0.00 3.900024 FORMAT "%8.6" EXTENDED_LIMITS -4.000000 3.999878 /end CHARACTERISTIC
/begin CHARACTERISTIC InjVlv_facNVCDfpMin_C "Unterer Grenzwert von InjVlv_facNVCActr[x] ab dem der Fehlerfpad der NVC gesetzt wird" VALUE 0xE4574 Kw_Ws16 3.900024 Fact 0.00 3.900024 FORMAT "%8.6" EXTENDED_LIMITS -4.000000 3.999878 /end CHARACTERISTIC
/begin CHARACTERISTIC InjVlv_facNVCInPI_C "#SSD Korrekturfaktor für den NVC-Reglereingang" VALUE 0xE4576 Kw_Ws16 2.000000 Fact -1.000000 1.000000 FORMAT "%8.6" EXTENDED_LIMITS -4.000000 3.999878 /end CHARACTERISTIC
/begin CHARACTERISTIC InjVlv_facNVCMax_C "#SSD Obere Grenze für den NVC-Reglerausgang" VALUE 0xE4578 Kw_Ws16 3.900024 Fact 0.00 3.900024 FORMAT "%8.6" EXTENDED_LIMITS -4.000000 3.999878 /end CHARACTERISTIC
/begin CHARACTERISTIC InjVlv_facNVCMin_C "#SSD Untere Grenze  für den NVC-Reglerausgang" VALUE 0xE457A Kw_Ws16 3.900024 Fact 0.00 3.900024 FORMAT "%8.6" EXTENDED_LIMITS -4.000000 3.999878 /end CHARACTERISTIC
/begin CHARACTERISTIC InjVlv_facPCorQ_CUR "#SSD mengenabhängige Korrekturfaktor-Kennlinie für Druckwellenkorrektur" CURVE 0xE3E90 Kl_Xs16_Ws16 20.00000 Fact -10.00000 10.00000 FORMAT "%8.5" EXTENDED_LIMITS -4.000000 3.999878
 /begin AXIS_DESCR STD_AXIS InjVlv_qDes_mp InjMassInj 8 -327.6800 327.6700 FORMAT "%8.4" DEPOSIT ABSOLUTE /end AXIS_DESCR
/end CHARACTERISTIC
/begin CHARACTERISTIC InjVlv_facPCorTi_CUR "#SSD einspritzabstandsabhängige Korrekturfaktor-Kennlinie für Druckwellenkorrektur" CURVE 0xE3EB2 Kl_Xs16_Ws16 20.00000 Fact -10.00000 10.00000 FORMAT "%8.5" EXTENDED_LIMITS -4.000000 3.999878
 /begin AXIS_DESCR STD_AXIS InjVlv_tiMI1PoI2Cor_mp InjTime_us 16 -32768.00 32767.00 FORMAT "%8.2" DEPOSIT ABSOLUTE /end AXIS_DESCR
/end CHARACTERISTIC
/begin CHARACTERISTIC InjVlv_facPiI2WvCor_C "Gewichtungsfaktor der Druckwellenkorrekturmenge der MI1 abhängig von PiI2" VALUE 0xE4DA6 Kw_Ws16 1.000000 Fact 0.00 1.000000 FORMAT "%8.6" EXTENDED_LIMITS -4.000000 3.999878 /end CHARACTERISTIC
/begin CHARACTERISTIC InjVlv_facVoltCorUp_MAP "#SSD temperaturabhängige Hubkorrektur für up-Niveau" MAP 0xE3EF4 Kf_Xs16_Ys16_Ws16 7.999878 Fact -4.000000 3.999878 FORMAT "%8.6"
 /begin AXIS_DESCR STD_AXIS InjVlv_pCalcVolt Pres_Rail 16 -3276.800 3276.700 FORMAT "%5.3" DEPOSIT ABSOLUTE /end AXIS_DESCR
 /begin AXIS_DESCR STD_AXIS InjVlv_tActr_mp Temp_Cels 10 -50.140 899.860 FORMAT "%8.3" EXTENDED_LIMITS -3549.940 3003.560 DEPOSIT ABSOLUTE /end AXIS_DESCR
/end CHARACTERISTIC
/begin CHARACTERISTIC InjVlv_facWvCor1_MAP "KF 1 für Gewichtungsfaktor der Druckwellenkorrektur" MAP 0xE4DA8 Kf_Xs16_Ys16_Ws16 10.00000 Fact1 0.00 10.00000 FORMAT "%8.5" EXTENDED_LIMITS -256.0000 255.9922
 /begin AXIS_DESCR STD_AXIS InjCrv_qMI1Des InjMassInj 8 0.00 327.6700 FORMAT "%8.4" EXTENDED_LIMITS -327.6800 327.6700 DEPOSIT ABSOLUTE /end AXIS_DESCR
 /begin AXIS_DESCR STD_AXIS RailCD_pAct_mp Pres_Rail 16 0.00 2000.000 FORMAT "%5.3" EXTENDED_LIMITS -3276.800 3276.700 DEPOSIT ABSOLUTE /end AXIS_DESCR
/end CHARACTERISTIC
/begin CHARACTERISTIC InjVlv_facWvCor2_MAP "KF 2 für Gewichtungsfaktor der Druckwellenkorrektur" MAP 0xE4EDC Kf_Xs16_Ys16_Ws16 10.00000 Fact1 0.00 10.00000 FORMAT "%8.5" EXTENDED_LIMITS -256.0000 255.9922
 /begin AXIS_DESCR STD_AXIS InjCrv_qPoI2Des_mp InjMassInj 8 0.00 327.6700 FORMAT "%8.4" EXTENDED_LIMITS -327.6800 327.6700 DEPOSIT ABSOLUTE /end AXIS_DESCR
 /begin AXIS_DESCR STD_AXIS RailCD_pAct_mp Pres_Rail 16 0.00 2000.000 FORMAT "%5.3" EXTENDED_LIMITS -3276.800 3276.700 DEPOSIT ABSOLUTE /end AXIS_DESCR
/end CHARACTERISTIC
/begin CHARACTERISTIC InjVlv_iDCDC_CUR "#SSD DCDC Strom-Kennlinie" CURVE 0xE43CA Kl_Xs16_Ws16 11800.00 Curr 200.0000 12000.00 FORMAT "%8.2" EXTENDED_LIMITS -32768.00 32767.00
 /begin AXIS_DESCR STD_AXIS BattCD_u Volt_Batt 8 0.00 30009.78 FORMAT "%8.2" EXTENDED_LIMITS -640625.6 640606.1 DEPOSIT ABSOLUTE /end AXIS_DESCR
/end CHARACTERISTIC
/begin CHARACTERISTIC InjVlv_iMonDisChDwn_C "#SSD Schwelle des Entladestroms für Überwachung des bsh_err vom CY370" VALUE 0xE4462 Kw_Ws16 30000.00 Curr -30000.00 0.00 FORMAT "%8.2" EXTENDED_LIMITS -32768.00 32767.00 /end CHARACTERISTIC
/begin CHARACTERISTIC InjVlv_NVCIKi_C "#SSD I-Parameter des Reglers, wenn der Eingang sich innerhalb des Kleinsignalfensters befindet" VALUE 0xE457C Kw_Wu32 12207.0312472 Ki_VOLTPA2FACT 0.00 12207.0312472 FORMAT "%13.7" /end CHARACTERISTIC
/begin CHARACTERISTIC InjVlv_NVCIKiPos_C "#SSD I-Parameter des Reglers, wenn sich der Wert des Eingangs oberhalb der Kleinsignalfensters befindet" VALUE 0xE4580 Kw_Wu32 12207.0312472 Ki_VOLTPA2FACT 0.00 12207.0312472 FORMAT "%13.7" /end CHARACTERISTIC
/begin CHARACTERISTIC InjVlv_NVCIKiNeg_C "#SSD I-Parameter der Reglers, wenn sich der Wert des Eingangs unterhalb des Kleinsignalfensters befindet" VALUE 0xE4584 Kw_Wu32 12207.0312472 Ki_VOLTPA2FACT 0.00 12207.0312472 FORMAT "%13.7" /end CHARACTERISTIC
/begin CHARACTERISTIC InjVlv_uNVCIWinPos_C "#SSD obere Grenze des Kleinsignalfensters für den I-Anteil" VALUE 0xE4588 Kw_Ws16 655.3500 Volt_PA -327.6800 327.6700 FORMAT "%8.4" /end CHARACTERISTIC
/begin CHARACTERISTIC InjVlv_uNVCIWinNeg_C "#SSD untere Grenze des Kleinsignalfensters für den I-Anteil" VALUE 0xE458A Kw_Ws16 655.3500 Volt_PA -327.6800 327.6700 FORMAT "%8.4" /end CHARACTERISTIC
/begin CHARACTERISTIC InjVlv_nMonQckThresLo_C "#SSD Motordrehzahl-Schwelle zur Auswahl von InjVlv_ctMonQckThres_C bzw. InjVlv_ctMonQckThresLo_C für Schnellerkennung" VALUE 0xE4464 Kw_Ws16 65535.00 EngN -32768.00 32767.00 FORMAT "%8.2" /end CHARACTERISTIC
/begin CHARACTERISTIC InjVlv_numClsVltgAdjMax_C "#SSD Maximale Klasse für den Injektor Spannungsabgleich" VALUE 0xE4628 Kw_Wu8 15.00 OneToOne 0.00 15.00 FORMAT "%5.2" EXTENDED_LIMITS 0.00 255.0 /end CHARACTERISTIC
/begin CHARACTERISTIC InjVlv_numClsVltgAdjMin_C "#SSD Minimale Klasse für den Injektor Spannungsabgleich" VALUE 0xE4629 Kw_Wu8 15.00 OneToOne 0.00 15.00 FORMAT "%5.2" EXTENDED_LIMITS 0.00 255.0 /end CHARACTERISTIC
/begin CHARACTERISTIC InjVlv_numInjChrgBal_MAP "#SSD max. Anzahl an Einspritzungen aufgrund Ladungsbilanz Boosterkondensators" MAP 0xE4170 Kf_Xs16_Ys16_Ws16 6.000000 OneToOne 0.00 6.000000 FORMAT "%8.6" EXTENDED_LIMITS -32768.00 32767.00
 /begin AXIS_DESCR STD_AXIS InjVlv_pwrInjAvrg_mp Pwr_PA 16 0.00 32000.00 FORMAT "%8.2" EXTENDED_LIMITS -32768.00 32767.00 DEPOSIT ABSOLUTE /end AXIS_DESCR
 /begin AXIS_DESCR STD_AXIS BattCD_u Volt_Batt 16 0.00 28602.15 FORMAT "%8.2" EXTENDED_LIMITS -640625.6 640606.1 DEPOSIT ABSOLUTE /end AXIS_DESCR
/end CHARACTERISTIC
/begin CHARACTERISTIC InjVlv_numNoLoadCylMax_C "#SSD maximale zulässige Anzahl von Zylindern mit Lastabfall" VALUE 0xE4466 Kw_Wu8 6.000 OneToOne 0.00 6.000 FORMAT "%5.3" EXTENDED_LIMITS 0.00 255.0 /end CHARACTERISTIC
/begin CHARACTERISTIC InjVlv_numSegOfs1_C "Semgentoffset für die Bestimmung der zylinderselektiven Drehzahlen für Testmodus a" VALUE 0xE43EC Kw_Wu8 11.00 OneToOne 0.00 11.00 FORMAT "%5.2" EXTENDED_LIMITS 0.00 255.0 /end CHARACTERISTIC
/begin CHARACTERISTIC InjVlv_numSegOfs2_C "Semgentoffset für die Bestimmung der zylinderselektiven Drehzahlen für Testmodus b und c" VALUE 0xE43ED Kw_Wu8 11.00 OneToOne 0.00 11.00 FORMAT "%5.2" EXTENDED_LIMITS 0.00 255.0 /end CHARACTERISTIC
/begin CHARACTERISTIC InjVlv_pCorBase_CUR "#SSD Raildruck-Korrekturgrundwert-Kennlinie für Druckwellenkorrektur" CURVE 0xE406C Kl_Xs16_Ws16 2000.000 Pres_Rail 0.00 2000.000 FORMAT "%5.3" EXTENDED_LIMITS -3276.800 3276.700
 /begin AXIS_DESCR STD_AXIS InjVlv_pAct_mp Pres_Rail 6 -3276.800 3276.700 FORMAT "%5.3" DEPOSIT ABSOLUTE /end AXIS_DESCR
/end CHARACTERISTIC
/begin CHARACTERISTIC InjVlv_pMin_C "#SSD Injektorabhängige Druckschwelle zur Freigabe/Sperrung der Einspritzung" VALUE 0xE4604 Kw_Ws16 2000.000 Pres_Rail 0.00 2000.000 FORMAT "%5.3" EXTENDED_LIMITS -3276.800 3276.700 /end CHARACTERISTIC
/begin CHARACTERISTIC InjVlv_pMin_CUR "#SSD Kühlmitteltemperaturabhängige Druckschwelle zur Freigabe der Einspritzungen" CURVE 0xE4606 Kl_Xs16_Ws16 2000.000 Pres_Rail 0.00 2000.000 FORMAT "%5.3" EXTENDED_LIMITS -3276.800 3276.700
 /begin AXIS_DESCR STD_AXIS Eng_tEng Temp_Cels 8 -50.14000 199.8600 FORMAT "%8.4" EXTENDED_LIMITS -3549.940 3003.560 DEPOSIT ABSOLUTE /end AXIS_DESCR
/end CHARACTERISTIC
/begin CHARACTERISTIC InjVlv_pNVCMax_C "#SSD Obere Grenze des Raildrucks für die Freigabe der NVC" VALUE 0xE458C Kw_Ws16 2000.000 Pres_Rail 0.00 2000.000 FORMAT "%5.3" EXTENDED_LIMITS -3276.800 3276.700 /end CHARACTERISTIC
/begin CHARACTERISTIC InjVlv_pNVCMin_C "#SSD untere Grenze des Raildrucks für die Freigabe der NVC" VALUE 0xE458E Kw_Ws16 2000.000 Pres_Rail 0.00 2000.000 FORMAT "%5.3" EXTENDED_LIMITS -3276.800 3276.700 /end CHARACTERISTIC
/begin CHARACTERISTIC InjVlv_pRailDfl_C "#SSD Raildruck-Ersatzwert für Sollspannungsberechnung" VALUE 0xE4086 Kw_Ws16 6553.500 Pres_Rail -3276.800 3276.700 FORMAT "%5.3" /end CHARACTERISTIC
/begin CHARACTERISTIC InjVlv_NVCPKp_C "#SSD P-Parameter des Reglers, wenn sich der Wert des Eingangs innerhalb der Kleinsignalfensters befindet" VALUE 0xE4590 Kw_Wu32 799.999999814 Kp_VOLTPA2FACT 0.00 799.999999814 FORMAT "%13.9" /end CHARACTERISTIC
/begin CHARACTERISTIC InjVlv_NVCPKpPos_C "#SSD P-Parameter des Reglers, wenn sich der Wert des Eingangs oberhalb des Kleinsignalfensters befindet" VALUE 0xE4594 Kw_Wu32 799.999999814 Kp_VOLTPA2FACT 0.00 799.999999814 FORMAT "%13.9" /end CHARACTERISTIC
/begin CHARACTERISTIC InjVlv_NVCPKpNeg_C "#SSD P-Parameter des Reglers, wenn sich der Wert des Eingangs unterhalb der Kleinsignalfensters befindet" VALUE 0xE4598 Kw_Wu32 799.999999814 Kp_VOLTPA2FACT 0.00 799.999999814 FORMAT "%13.9" /end CHARACTERISTIC
/begin CHARACTERISTIC InjVlv_uNVCPWinPos_C "#SSD obere Grenze des Kleinsignalfensters für den P-Anteil" VALUE 0xE459C Kw_Ws16 655.3500 Volt_PA -327.6800 327.6700 FORMAT "%8.4" /end CHARACTERISTIC
/begin CHARACTERISTIC InjVlv_uNVCPWinNeg_C "#SSD untere Grenze der Kleinsignalfensters für den P-Anteil" VALUE 0xE459E Kw_Ws16 655.3500 Volt_PA -327.6800 327.6700 FORMAT "%8.4" /end CHARACTERISTIC
/begin CHARACTERISTIC InjVlv_qWvCor1_MAP "Grundwerte-KF 1 der Druckwellenkorrekturmenge" MAP 0xE5010 Kf_Xs16_Ys16_Ws16 655.3400 InjMassInj -327.6700 327.6700 FORMAT "%8.4" EXTENDED_LIMITS -327.6800 327.6700
 /begin AXIS_DESCR STD_AXIS InjVlv_tiPiI1MI1Cor_mp InjTime_us 32 0.00 13000.00 FORMAT "%8.2" EXTENDED_LIMITS -32768.00 32767.00 DEPOSIT ABSOLUTE /end AXIS_DESCR
 /begin AXIS_DESCR STD_AXIS InjCrv_qPiI1Des InjMassInj 16 0.00 327.6700 FORMAT "%8.4" EXTENDED_LIMITS -327.6800 327.6700 DEPOSIT ABSOLUTE /end AXIS_DESCR
/end CHARACTERISTIC
/begin CHARACTERISTIC InjVlv_qWvCor2_MAP "Grundwerte-KF 2 der Druckwellenkorrekturmenge" MAP 0xE5474 Kf_Xs16_Ys16_Ws16 655.3400 InjMassInj -327.6700 327.6700 FORMAT "%8.4" EXTENDED_LIMITS -327.6800 327.6700
 /begin AXIS_DESCR STD_AXIS InjVlv_tiMI1PoI2HydCor_mp InjTime_us 32 0.00 13000.00 FORMAT "%8.2" EXTENDED_LIMITS 0.00 65535.00 DEPOSIT ABSOLUTE /end AXIS_DESCR
 /begin AXIS_DESCR STD_AXIS InjVlv_rMI1WvCorNorm_mp QntR 16 0.0009765625 24.00000 FORMAT "%8.5" EXTENDED_LIMITS -32.00000 31.99902 DEPOSIT ABSOLUTE /end AXIS_DESCR
/end CHARACTERISTIC
/begin CHARACTERISTIC InjVlv_qWvCorMax_C "#SSD maximale Begrenzungsmenge der Druckwellenkorrektur" VALUE 0xE58D8 Kw_Ws16 20.00000 InjMassInj -10.00000 10.00000 FORMAT "%8.5" EXTENDED_LIMITS -327.6800 327.6700 /end CHARACTERISTIC
/begin CHARACTERISTIC InjVlv_qWvCorMin_C "#SSD minimale Begrenzungsmenge der Druckwellenkorrektur" VALUE 0xE58DA Kw_Ws16 20.00000 InjMassInj -10.00000 10.00000 FORMAT "%8.5" EXTENDED_LIMITS -327.6800 327.6700 /end CHARACTERISTIC
/begin CHARACTERISTIC InjVlv_qWvCorNorm_CUR "Kennlinie für die raildruckabhängige Einspritznormierungsmenge" CURVE 0xE4B0E Kl_Xs16_Ws16 327.6600 InjMassInj 0.01000000 327.6700 FORMAT "%8.4" EXTENDED_LIMITS -327.6800 327.6700
 /begin AXIS_DESCR STD_AXIS RailCD_pPeak Pres_Rail 20 0.00 2000.000 FORMAT "%5.3" EXTENDED_LIMITS -3276.800 3276.700 DEPOSIT ABSOLUTE /end AXIS_DESCR
/end CHARACTERISTIC
/begin CHARACTERISTIC InjVlv_rChrgBalPwrHys_C "#SSD Leistungs-Hystereseschwelle für max. Anzahl an Einspritzungen über Ladungsbilanz des Buffer-Kondensators" VALUE 0xE43B4 Kw_Wu16 100.0000 Prc 0.00 100.0000 FORMAT "%8.4" EXTENDED_LIMITS 0.00 799.9878 /end CHARACTERISTIC
/begin CHARACTERISTIC InjVlv_rChrgBalVltgHys_C "#SSD Batteriespannungs Hystereseschwelle für Auswahl der max. Anzahl an Einspritzungen aufgrund Ladungsbilanz Boosterkondensators" VALUE 0xE43B6 Kw_Wu16 100.0000 Prc 0.00 100.0000 FORMAT "%8.4" EXTENDED_LIMITS 0.00 799.9878 /end CHARACTERISTIC
/begin CHARACTERISTIC InjVlv_stErrDet_C "Status der Injektorfehlererkennung" VALUE 0xE43EE Kw_Wu8 1.000 OneToOne 0.00 1.000 FORMAT "%5.3" EXTENDED_LIMITS 0.00 255.0 /end CHARACTERISTIC
/begin CHARACTERISTIC InjVlv_stErrMskPattern_C "#SSD Pattern-Matrix zur Mustererkennung" VAL_BLK 0xE4468 Kwb_Wu32 4294967295.00 OneToOne 0.00 4294967295.00 FORMAT "%13.2" NUMBER 32 /end CHARACTERISTIC
/begin CHARACTERISTIC InjVlv_stErrMskSelect_C "#SSD Select-Matrix zur Mustererkennung" VAL_BLK 0xE44E8 Kwb_Wu32 4294967295.00 OneToOne 0.00 4294967295.00 FORMAT "%13.2" NUMBER 32 /end CHARACTERISTIC
/begin CHARACTERISTIC InjVlv_stInputAddBalMap_C "y-Eingang des Kennfelds InjVCD_facAddBalRls_MAP auf dem Applikationswerkzeug" VALUE 0xE3E8E Kw_Wu8 255.0 OneToOne 0.00 255.0 FORMAT "%5.1" /end CHARACTERISTIC
/begin CHARACTERISTIC InjVlv_stMonQckEna_C "#SSD Schalter zur Freigabe der Schnell-Erkennung der Kurzschlüsse nach Batterie und Masse (0: gesperrt, 1: freigegeben)" VALUE 0xE4568 Kw_Wu8 1.000 OneToOne 0.00 1.000 FORMAT "%5.3" EXTENDED_LIMITS 0.00 255.0 /end CHARACTERISTIC
/begin CHARACTERISTIC InjVlv_stPWvCorMsk_C "#SSD Freigabemaske für Druckwellenkorrekur des Raildrucks" VALUE 0xE4088 Kw_Wu8 255.0 OneToOne 0.00 255.0 FORMAT "%5.1" /end CHARACTERISTIC
/begin CHARACTERISTIC InjVlv_stQntAdjRepl_C "Ersatzwerte für Injektormengenabgleich" VAL_BLK 0xE4760 Kwb_Wu32 4294967295.00 OneToOne 0.00 4294967295.00 FORMAT "%13.2" NUMBER 12 /end CHARACTERISTIC
/begin CHARACTERISTIC InjVlv_stQntAdj_MAP "#SSD Statuskennfeld (Index und Gewichtungsfaktor) für den Injektor-Mengenabgleich" MAP 0xE462A Kf_Xs16_Ys16_Ws16 32767.00 OneToOne 0.00 32767.00 FORMAT "%8.2" EXTENDED_LIMITS -32768.00 32767.00
 /begin AXIS_DESCR STD_AXIS RailCD_pPeak Pres_Rail 10 0.00 2000.000 FORMAT "%5.3" EXTENDED_LIMITS -3276.800 3276.700 DEPOSIT ABSOLUTE /end AXIS_DESCR
 /begin AXIS_DESCR STD_AXIS InjUn_volMI1Cor_mp InjQntInj 10 0.00 100.0000 FORMAT "%8.4" EXTENDED_LIMITS -327.6800 327.6700 DEPOSIT ABSOLUTE /end AXIS_DESCR
/end CHARACTERISTIC
/begin CHARACTERISTIC InjVlv_stWvCorActv_C "Freigabe der Druckwellenkorrektur" VALUE 0xE4B60 Kw_Wu8 1.000 OneToOne 0.00 1.000 FORMAT "%5.3" EXTENDED_LIMITS 0.00 255.0 /end CHARACTERISTIC
/begin CHARACTERISTIC InjVlv_swtAvrgEnaTiNVC_C "Aktivierung des Pfades InjVCD_stAvrgEnaTiWarn zur Freigabe des Lernens der NVC" VALUE 0xE45A0 Kw_Wu8 255.0 OneToOne 0.00 255.0 FORMAT "%5.1" /end CHARACTERISTIC
/begin CHARACTERISTIC InjVlv_swtDiffHydInSel_C "Auswahl für Darstellung des Betriebspunktes im Kennfeld InjVlv_tiDiffHyd_MAP (1,2,3: Darstellung, sonst: keine Darstellung)" VALUE 0xE4794 Kw_Wu8 2.000 OneToOne 0.00 2.000 FORMAT "%5.3" EXTENDED_LIMITS 0.00 255.0 /end CHARACTERISTIC
/begin CHARACTERISTIC InjVlv_swtNVCStInjChar_C "Maske für die einspritztypabhängige Freigabe des Lernen der NVC" VALUE 0xE45A1 Kw_Wu8 255.0 OneToOne 0.00 255.0 FORMAT "%5.1" /end CHARACTERISTIC
/begin CHARACTERISTIC InjVlv_swtNVCWrDflVal_C "Software-Schalter zum Setzen Defaultwerte für Testzwecke" VALUE 0xE45A2 Kw_Wu8 1.000 OneToOne 0.00 1.000 FORMAT "%5.3" EXTENDED_LIMITS 0.00 255.0 /end CHARACTERISTIC
/begin CHARACTERISTIC InjVlv_swtQntAdj_C "Schalter zum Ersetzen der Mengenabgleichwerte (0...EEPROM, 1...Ersatzwerte)" VALUE 0xE4790 Kw_Wu8 1.000 OneToOne 0.00 1.000 FORMAT "%5.3" EXTENDED_LIMITS 0.00 255.0 /end CHARACTERISTIC
/begin CHARACTERISTIC InjVlv_tActrDfl_C "#SSD Ersatzwert Aktortemperatur für Sollwertspannungsberechnung" VALUE 0xE408A Kw_Ws16 950.000 Temp_Cels -50.140 899.860 FORMAT "%8.3" EXTENDED_LIMITS -3549.940 3003.560 /end CHARACTERISTIC
/begin CHARACTERISTIC InjVlv_tiDiffHyd_MAP "Kennfeld mit Differenzzeiten zwischen hydraulischem Nadelschliessende und elektrischem Ansteuerende" MAP 0xE4796 Kf_Xs16_Ys16_Ws16 10000.00 InjTime_us -5000.000 5000.000 FORMAT "%8.3" EXTENDED_LIMITS -32768.00 32767.00
 /begin AXIS_DESCR STD_AXIS InjVlv_pActInDiffHyd_mp Pres_Rail 16 0.00 2000.000 FORMAT "%5.3" EXTENDED_LIMITS -3276.800 3276.700 DEPOSIT ABSOLUTE /end AXIS_DESCR
 /begin AXIS_DESCR STD_AXIS InjVlv_qDesInDiffHyd_mp InjMassInj 16 0.00 327.6700 FORMAT "%8.4" EXTENDED_LIMITS -327.6800 327.6700 DEPOSIT ABSOLUTE /end AXIS_DESCR
/end CHARACTERISTIC
/begin CHARACTERISTIC InjVlv_tiNVCDwnThres_C "#SSD Obere Grenze der Regelabweichung des Entladezeit-Reglers um die NVC freizugeben" VALUE 0xE45A4 Kw_Ws16 50.00000 Time_Busy 0.00 50.00000 FORMAT "%8.5" EXTENDED_LIMITS -3276.800 3276.700 /end CHARACTERISTIC
/begin CHARACTERISTIC InjVlv_tiNVCUpThres_C "#SSD Obere Grenze der Regelabweichung des Ladezeitreglers, um die NVC freizugeben" VALUE 0xE45A6 Kw_Ws16 50.00000 Time_Busy 0.00 50.00000 FORMAT "%8.5" EXTENDED_LIMITS -3276.800 3276.700 /end CHARACTERISTIC
/begin CHARACTERISTIC InjVlv_tNVCEngMax_C "#SSD Obere Grenze der Motortemperatur zur Freigebe der NVC" VALUE 0xE45A8 Kw_Ws16 250.0000 Temp_Cels -50.14000 199.8600 FORMAT "%8.4" EXTENDED_LIMITS -3549.940 3003.560 /end CHARACTERISTIC
/begin CHARACTERISTIC InjVlv_tNVCEngMin_C "#SSD untere Grenze der Motortemperatur zur Freigabe der NVC" VALUE 0xE45AA Kw_Ws16 250.0000 Temp_Cels -50.14000 199.8600 FORMAT "%8.4" EXTENDED_LIMITS -3549.940 3003.560 /end CHARACTERISTIC
/begin CHARACTERISTIC InjVlv_tWvCor_MAP "KF fuer die Eingangstemperatur der Druckwellenkorrektur" MAP 0xE4B62 Kf_Xs16_Ys16_Ws16 250.0000 Temp_Cels -50.1400 199.8600 FORMAT "%8.4" EXTENDED_LIMITS -3549.940 3003.560
 /begin AXIS_DESCR STD_AXIS FTSCD_tFuel Temp_Cels 16 -50.14000 199.8600 FORMAT "%8.4" EXTENDED_LIMITS -3549.940 3003.560 DEPOSIT ABSOLUTE /end AXIS_DESCR
 /begin AXIS_DESCR STD_AXIS CTSCD_tClnt Temp_Cels 16 -50.14000 199.8600 FORMAT "%8.4" EXTENDED_LIMITS -3549.940 3003.560 DEPOSIT ABSOLUTE /end AXIS_DESCR
/end CHARACTERISTIC
/begin CHARACTERISTIC InjVlv_uBufCInjLimXLow_C "#SSD Untere Hystereseschwelle für Bufferspannung" VALUE 0xE43B8 Kw_Ws16 260.0000 Volt_BUFC 0.00 260.0000 FORMAT "%8.4" EXTENDED_LIMITS -327.6800 327.6700 /end CHARACTERISTIC
/begin CHARACTERISTIC InjVlv_uBufCInjLimXHigh_C "#SSD Obere Hystereseschwelle für Bufferspannung" VALUE 0xE43BA Kw_Ws16 260.0000 Volt_BUFC 0.00 260.0000 FORMAT "%8.4" EXTENDED_LIMITS -327.6800 327.6700 /end CHARACTERISTIC
/begin CHARACTERISTIC InjVlv_stBufCInjLimYLow_C "#SSD Konstante für Bufferspannung kleiner Hystereseschwelle" VALUE 0xE43BC Kw_Ws16 65535.00 OneToOne -32768.00 32767.00 FORMAT "%8.2" READ_ONLY /end CHARACTERISTIC
/begin CHARACTERISTIC InjVlv_stBufCInjLimYHigh_C "#SSD Konstante für Bufferspannung größer Hystereseschwelle" VALUE 0xE43BE Kw_Ws16 65535.00 OneToOne -32768.00 32767.00 FORMAT "%8.2" READ_ONLY /end CHARACTERISTIC
/begin CHARACTERISTIC InjVlv_uDiffNVCSet_CUR "#SSD Kennlinie für die Spannungsdifferenz" CURVE 0xE45AC Kl_Xs16_Ws16 250.0000 Volt_PA 0.00 250.0000 FORMAT "%8.4" EXTENDED_LIMITS -327.6800 327.6700
 /begin AXIS_DESCR STD_AXIS InjVCD_pActInj Pres_Rail 20 -3276.800 3276.700 FORMAT "%5.3" DEPOSIT ABSOLUTE /end AXIS_DESCR
/end CHARACTERISTIC
/begin CHARACTERISTIC InjVlv_uMonBattThres_C "#SSD Schwelle zur Überwachung des DC_err von CY370" VALUE 0xE456A Kw_Ws16 24007.82 Volt_Batt 0.00 24007.82 FORMAT "%8.2" EXTENDED_LIMITS -640625.6 640606.1 /end CHARACTERISTIC
/begin CHARACTERISTIC InjVlv_uNVCThres_C "#SSD Obere Grenze des Wertes des Spannungsreglereingangs für die Freigabe der NVC" VALUE 0xE45FE Kw_Ws16 50.00000 Volt_PA 0.00 50.00000 FORMAT "%8.5" EXTENDED_LIMITS -327.6800 327.6700 /end CHARACTERISTIC
/begin CHARACTERISTIC InjVlv_uOfs_C "#SSD Spannungsoffset" VALUE 0xE416E Kw_Ws16 15.00000 Volt_PA 0.00 15.00000 FORMAT "%8.5" EXTENDED_LIMITS -327.6800 327.6700 /end CHARACTERISTIC
/begin CHARACTERISTIC InjVlv_uSetBott_C "#SSD Vorgabewert für Piezo-Aktor bottom-level" VALUE 0xE408C Kw_Ws16 250.0000 Volt_PA 0.00 250.0000 FORMAT "%8.4" EXTENDED_LIMITS -327.6800 327.6700 /end CHARACTERISTIC
/begin CHARACTERISTIC InjVlv_uSetUpNVCActrMax_C "#SSD obere Grenze der Stellspannung nach der NVC" VALUE 0xE4600 Kw_Ws16 250.0000 Volt_PA 0.00 250.0000 FORMAT "%8.4" EXTENDED_LIMITS -327.6800 327.6700 /end CHARACTERISTIC
/begin CHARACTERISTIC InjVlv_uSetUpNVCActrMin_C "#SSD untere Grenze der Stellspannung nach der NVC" VALUE 0xE4602 Kw_Ws16 250.0000 Volt_PA 0.00 250.0000 FORMAT "%8.4" EXTENDED_LIMITS -327.6800 327.6700 /end CHARACTERISTIC
/begin CHARACTERISTIC InjVlv_uSetUpPress0_CUR "#SSD Kennlinie zur raildruckabh. Sollspannungsbestimmung für ISA-Klasse 0" CURVE 0xE408E Kl_Xs16_Ws16 250.0000 Volt_PA 0.00 250.0000 FORMAT "%8.4" EXTENDED_LIMITS -327.6800 327.6700
 /begin AXIS_DESCR STD_AXIS InjVlv_pCalcVolt Pres_Rail 3 -3276.800 3276.700 FORMAT "%5.3" DEPOSIT ABSOLUTE /end AXIS_DESCR
/end CHARACTERISTIC
/begin CHARACTERISTIC InjVlv_uSetUpPress10_CUR "#SSD Kennlinie zur raildruckabh. Sollspannungsbestimmung für ISA-Klasse 10" CURVE 0xE409C Kl_Xs16_Ws16 250.0000 Volt_PA 0.00 250.0000 FORMAT "%8.4" EXTENDED_LIMITS -327.6800 327.6700
 /begin AXIS_DESCR STD_AXIS InjVlv_pCalcVolt Pres_Rail 3 -3276.800 3276.700 FORMAT "%5.3" DEPOSIT ABSOLUTE /end AXIS_DESCR
/end CHARACTERISTIC
/begin CHARACTERISTIC InjVlv_uSetUpPress11_CUR "#SSD Kennlinie zur raildruckabh. Sollspannungsbestimmung für ISA-Klasse 11" CURVE 0xE40AA Kl_Xs16_Ws16 250.0000 Volt_PA 0.00 250.0000 FORMAT "%8.4" EXTENDED_LIMITS -327.6800 327.6700
 /begin AXIS_DESCR STD_AXIS InjVlv_pCalcVolt Pres_Rail 3 -3276.800 3276.700 FORMAT "%5.3" DEPOSIT ABSOLUTE /end AXIS_DESCR
/end CHARACTERISTIC
/begin CHARACTERISTIC InjVlv_uSetUpPress12_CUR "#SSD Kennlinie zur raildruckabh. Sollspannungsbestimmung für ISA-Klasse 12" CURVE 0xE40B8 Kl_Xs16_Ws16 250.0000 Volt_PA 0.00 250.0000 FORMAT "%8.4" EXTENDED_LIMITS -327.6800 327.6700
 /begin AXIS_DESCR STD_AXIS InjVlv_pCalcVolt Pres_Rail 3 -3276.800 3276.700 FORMAT "%5.3" DEPOSIT ABSOLUTE /end AXIS_DESCR
/end CHARACTERISTIC
/begin CHARACTERISTIC InjVlv_uSetUpPress13_CUR "#SSD Kennlinie zur raildruckabh. Sollspannungsbestimmung für ISA-Klasse 13" CURVE 0xE40C6 Kl_Xs16_Ws16 250.0000 Volt_PA 0.00 250.0000 FORMAT "%8.4" EXTENDED_LIMITS -327.6800 327.6700
 /begin AXIS_DESCR STD_AXIS InjVlv_pCalcVolt Pres_Rail 3 -3276.800 3276.700 FORMAT "%5.3" DEPOSIT ABSOLUTE /end AXIS_DESCR
/end CHARACTERISTIC
/begin CHARACTERISTIC InjVlv_uSetUpPress14_CUR "#SSD Kennlinie zur raildruckabh. Sollspannungsbestimmung für ISA-Klasse 14" CURVE 0xE40D4 Kl_Xs16_Ws16 250.0000 Volt_PA 0.00 250.0000 FORMAT "%8.4" EXTENDED_LIMITS -327.6800 327.6700
 /begin AXIS_DESCR STD_AXIS InjVlv_pCalcVolt Pres_Rail 3 -3276.800 3276.700 FORMAT "%5.3" DEPOSIT ABSOLUTE /end AXIS_DESCR
/end CHARACTERISTIC
/begin CHARACTERISTIC InjVlv_uSetUpPress15_CUR "#SSD Kennlinie zur raildruckabh. Sollspannungsbestimmung für ISA-Klasse 15" CURVE 0xE40E2 Kl_Xs16_Ws16 250.0000 Volt_PA 0.00 250.0000 FORMAT "%8.4" EXTENDED_LIMITS -327.6800 327.6700
 /begin AXIS_DESCR STD_AXIS InjVlv_pCalcVolt Pres_Rail 3 -3276.800 3276.700 FORMAT "%5.3" DEPOSIT ABSOLUTE /end AXIS_DESCR
/end CHARACTERISTIC
/begin CHARACTERISTIC InjVlv_uSetUpPress1_CUR "#SSD Kennlinie zur raildruckabh. Sollspannungsbestimmung für ISA-Klasse 1" CURVE 0xE40F0 Kl_Xs16_Ws16 250.0000 Volt_PA 0.00 250.0000 FORMAT "%8.4" EXTENDED_LIMITS -327.6800 327.6700
 /begin AXIS_DESCR STD_AXIS InjVlv_pCalcVolt Pres_Rail 3 -3276.800 3276.700 FORMAT "%5.3" DEPOSIT ABSOLUTE /end AXIS_DESCR
/end CHARACTERISTIC
/begin CHARACTERISTIC InjVlv_uSetUpPress2_CUR "#SSD Kennlinie zur raildruckabh. Sollspannungsbestimmung für ISA-Klasse 2" CURVE 0xE40FE Kl_Xs16_Ws16 250.0000 Volt_PA 0.00 250.0000 FORMAT "%8.4" EXTENDED_LIMITS -327.6800 327.6700
 /begin AXIS_DESCR STD_AXIS InjVlv_pCalcVolt Pres_Rail 3 -3276.800 3276.700 FORMAT "%5.3" DEPOSIT ABSOLUTE /end AXIS_DESCR
/end CHARACTERISTIC
/begin CHARACTERISTIC InjVlv_uSetUpPress3_CUR "#SSD Kennlinie zur raildruckabh. Sollspannungsbestimmung für ISA-Klasse 3" CURVE 0xE410C Kl_Xs16_Ws16 250.0000 Volt_PA 0.00 250.0000 FORMAT "%8.4" EXTENDED_LIMITS -327.6800 327.6700
 /begin AXIS_DESCR STD_AXIS InjVlv_pCalcVolt Pres_Rail 3 -3276.800 3276.700 FORMAT "%5.3" DEPOSIT ABSOLUTE /end AXIS_DESCR
/end CHARACTERISTIC
/begin CHARACTERISTIC InjVlv_uSetUpPress4_CUR "#SSD Kennlinie zur raildruckabh. Sollspannungsbestimmung für ISA-Klasse 4" CURVE 0xE411A Kl_Xs16_Ws16 250.0000 Volt_PA 0.00 250.0000 FORMAT "%8.4" EXTENDED_LIMITS -327.6800 327.6700
 /begin AXIS_DESCR STD_AXIS InjVlv_pCalcVolt Pres_Rail 3 -3276.800 3276.700 FORMAT "%5.3" DEPOSIT ABSOLUTE /end AXIS_DESCR
/end CHARACTERISTIC
/begin CHARACTERISTIC InjVlv_uSetUpPress5_CUR "#SSD Kennlinie zur raildruckabh. Sollspannungsbestimmung für ISA-Klasse 5" CURVE 0xE4128 Kl_Xs16_Ws16 250.0000 Volt_PA 0.00 250.0000 FORMAT "%8.4" EXTENDED_LIMITS -327.6800 327.6700
 /begin AXIS_DESCR STD_AXIS InjVlv_pCalcVolt Pres_Rail 3 -3276.800 3276.700 FORMAT "%5.3" DEPOSIT ABSOLUTE /end AXIS_DESCR
/end CHARACTERISTIC
/begin CHARACTERISTIC InjVlv_uSetUpPress6_CUR "#SSD Kennlinie zur raildruckabh. Sollspannungsbestimmung für ISA-Klasse 6" CURVE 0xE4136 Kl_Xs16_Ws16 250.0000 Volt_PA 0.00 250.0000 FORMAT "%8.4" EXTENDED_LIMITS -327.6800 327.6700
 /begin AXIS_DESCR STD_AXIS InjVlv_pCalcVolt Pres_Rail 3 -3276.800 3276.700 FORMAT "%5.3" DEPOSIT ABSOLUTE /end AXIS_DESCR
/end CHARACTERISTIC
/begin CHARACTERISTIC InjVlv_uSetUpPress7_CUR "#SSD Kennlinie zur raildruckabh. Sollspannungsbestimmung für ISA-Klasse 7" CURVE 0xE4144 Kl_Xs16_Ws16 250.0000 Volt_PA 0.00 250.0000 FORMAT "%8.4" EXTENDED_LIMITS -327.6800 327.6700
 /begin AXIS_DESCR STD_AXIS InjVlv_pCalcVolt Pres_Rail 3 -3276.800 3276.700 FORMAT "%5.3" DEPOSIT ABSOLUTE /end AXIS_DESCR
/end CHARACTERISTIC
/begin CHARACTERISTIC InjVlv_uSetUpPress8_CUR "#SSD Kennlinie zur raildruckabh. Sollspannungsbestimmung für ISA-Klasse 8" CURVE 0xE4152 Kl_Xs16_Ws16 250.0000 Volt_PA 0.00 250.0000 FORMAT "%8.4" EXTENDED_LIMITS -327.6800 327.6700
 /begin AXIS_DESCR STD_AXIS InjVlv_pCalcVolt Pres_Rail 3 -3276.800 3276.700 FORMAT "%5.3" DEPOSIT ABSOLUTE /end AXIS_DESCR
/end CHARACTERISTIC
/begin CHARACTERISTIC InjVlv_uSetUpPress9_CUR "#SSD Kennlinie zur raildruckabh. Sollspannungsbestimmung für ISA-Klasse 9" CURVE 0xE4160 Kl_Xs16_Ws16 250.0000 Volt_PA 0.00 250.0000 FORMAT "%8.4" EXTENDED_LIMITS -327.6800 327.6700
 /begin AXIS_DESCR STD_AXIS InjVlv_pCalcVolt Pres_Rail 3 -3276.800 3276.700 FORMAT "%5.3" DEPOSIT ABSOLUTE /end AXIS_DESCR
/end CHARACTERISTIC
/begin CHARACTERISTIC InjVlv_volQntAdjLim_C "#SSD symmetrische Begrenzung des Mengen-Abgleichwertes" VALUE 0xE471E Kw_Ws16 128.0000 InjQntInj 0.00 128.0000 FORMAT "%8.4" EXTENDED_LIMITS -327.6800 327.6700 /end CHARACTERISTIC
/begin CHARACTERISTIC InjVlv_volQntAdjMax0_C "obere Grenzwerte der Mengen-Abgleichwerte für die ""0""-Quantisierungsschrittweite (0d=00b)" VAL_BLK 0xE4720 Kwb_Ws16 6.300000 InjQntInj 0.00 6.300000 FORMAT "%8.6" EXTENDED_LIMITS -327.6800 327.6700 NUMBER 4 /end CHARACTERISTIC
/begin CHARACTERISTIC InjVlv_volQntAdjMax1_C "obere Grenzwerte der Mengen-Abgleichwerte für die ""1""-Quantisierungsschrittweite (1d=01b)" VAL_BLK 0xE4728 Kwb_Ws16 9.450000 InjQntInj 0.00 9.450000 FORMAT "%8.6" EXTENDED_LIMITS -327.6800 327.6700 NUMBER 4 /end CHARACTERISTIC
/begin CHARACTERISTIC InjVlv_volQntAdjMax2_C "obere Grenzwerte der Mengen-Abgleichwerte für die ""2""-Quantisierungsschrittweite (2d=10b)" VAL_BLK 0xE4730 Kwb_Ws16 15.75000 InjQntInj 0.00 15.75000 FORMAT "%8.5" EXTENDED_LIMITS -327.6800 327.6700 NUMBER 4 /end CHARACTERISTIC
/begin CHARACTERISTIC InjVlv_volQntAdjMax3_C "obere Grenzwerte der Mengen-Abgleichwerte für die ""3""-Quantisierungsschrittweite (3d=11b)" VAL_BLK 0xE4738 Kwb_Ws16 31.50000 InjQntInj 0.00 31.50000 FORMAT "%8.5" EXTENDED_LIMITS -327.6800 327.6700 NUMBER 4 /end CHARACTERISTIC
/begin CHARACTERISTIC InjVlv_volQntAdjMin0_C "untere Grenzwerte der Mengen-Abgleichwerte für die ""0""-Quantisierungsschrittweite (0d=00b)" VAL_BLK 0xE4740 Kwb_Ws16 6.400000 InjQntInj -6.400000 0.00 FORMAT "%8.6" EXTENDED_LIMITS -327.6800 327.6700 NUMBER 4 /end CHARACTERISTIC
/begin CHARACTERISTIC InjVlv_volQntAdjMin1_C "untere Grenzwerte der Mengen-Abgleichwerte für die ""1""-Quantisierungsschrittweite (1d=01b)" VAL_BLK 0xE4748 Kwb_Ws16 9.600000 InjQntInj -9.600000 0.00 FORMAT "%8.6" EXTENDED_LIMITS -327.6800 327.6700 NUMBER 4 /end CHARACTERISTIC
/begin CHARACTERISTIC InjVlv_volQntAdjMin2_C "untere Grenzwerte der Mengen-Abgleichwerte für die ""2""-Quantisierungsschrittweite (2d=10b)" VAL_BLK 0xE4750 Kwb_Ws16 16.00000 InjQntInj -16.00000 0.00 FORMAT "%8.5" EXTENDED_LIMITS -327.6800 327.6700 NUMBER 4 /end CHARACTERISTIC
/begin CHARACTERISTIC InjVlv_volQntAdjMin3_C "untere Grenzwerte der Mengen-Abgleichwerte für die ""3""-Quantisierungsschrittweite (3d=11b)" VAL_BLK 0xE4758 Kwb_Ws16 32.00000 InjQntInj -32.00000 0.00 FORMAT "%8.5" EXTENDED_LIMITS -327.6800 327.6700 NUMBER 4 /end CHARACTERISTIC
/begin CHARACTERISTIC InjVlv_wInj_CUR "#SSD Kennlinie für Energieverbrauch einer Piezo-Aktor-Ansteuerung" CURVE 0xE43C0 Kl_Xs16_Ws16 100.0000 W_PA 0.00 100.0000 FORMAT "%8.4" EXTENDED_LIMITS -32768.00 32767.00
 /begin AXIS_DESCR STD_AXIS InjVlv_uSetUpAvrg_mp Volt_PA 2 -327.6800 327.6700 FORMAT "%8.4" DEPOSIT ABSOLUTE /end AXIS_DESCR
/end CHARACTERISTIC
/begin CHARACTERISTIC IVCtl_ChrgUpIKi_C "#SSD Kleinsignalverstärkung für I-Glied (Laden)" VALUE 0xE58DC Kw_Wu32 9999999.99767 Ki_us2mA 0.00 9999999.99767 FORMAT "%13.5" /end CHARACTERISTIC
/begin CHARACTERISTIC IVCtl_ChrgUpIKiPos_C "#SSD Positive Großsignalverstärkung für I-Glied (Laden)" VALUE 0xE58E0 Kw_Wu32 9999999.99767 Ki_us2mA 0.00 9999999.99767 FORMAT "%13.5" /end CHARACTERISTIC
/begin CHARACTERISTIC IVCtl_ChrgUpIKiNeg_C "#SSD Negative Großsignalverstärkung für I-Glied (Laden)" VALUE 0xE58E4 Kw_Wu32 9999999.99767 Ki_us2mA 0.00 9999999.99767 FORMAT "%13.5" /end CHARACTERISTIC
/begin CHARACTERISTIC IVCtl_tiChrgUpIWinPos_C "#SSD Positives Kleinsignalfenster für I-Glied (Laden)" VALUE 0xE58E8 Kw_Ws16 200.0000 Time_Busy -100.0000 100.0000 FORMAT "%8.4" EXTENDED_LIMITS -3276.800 3276.700 /end CHARACTERISTIC
/begin CHARACTERISTIC IVCtl_tiChrgUpIWinNeg_C "#SSD Negatives Kleinsignalfenster für I-Glied (Laden)" VALUE 0xE58EA Kw_Ws16 200.0000 Time_Busy -100.0000 100.0000 FORMAT "%8.4" EXTENDED_LIMITS -3276.800 3276.700 /end CHARACTERISTIC
/begin CHARACTERISTIC IVCtl_ChrgUpPKp_C "#SSD Kleinsignalverstärkung für P-Glied (Laden)" VALUE 0xE58EC Kw_Wu32 655359.999847 Kp_us2mA 0.00 655359.999847 FORMAT "%13.6" /end CHARACTERISTIC
/begin CHARACTERISTIC IVCtl_ChrgUpPKpPos_C "#SSD Positive Großsignalverstärkung für P-Glied (Laden)" VALUE 0xE58F0 Kw_Wu32 655359.999847 Kp_us2mA 0.00 655359.999847 FORMAT "%13.6" /end CHARACTERISTIC
/begin CHARACTERISTIC IVCtl_ChrgUpPKpNeg_C "#SSD Negative Großsignalverstärkung für P-Glied (Laden)" VALUE 0xE58F4 Kw_Wu32 655359.999847 Kp_us2mA 0.00 655359.999847 FORMAT "%13.6" /end CHARACTERISTIC
/begin CHARACTERISTIC IVCtl_tiChrgUpPWinPos_C "#SSD Positives Kleinsignalfenster für P-Glied (Laden)" VALUE 0xE58F8 Kw_Ws16 200.0000 Time_Busy -100.0000 100.0000 FORMAT "%8.4" EXTENDED_LIMITS -3276.800 3276.700 /end CHARACTERISTIC
/begin CHARACTERISTIC IVCtl_tiChrgUpPWinNeg_C "#SSD Negatives Kleinsignalfenster für P-Glied (Laden)" VALUE 0xE58FA Kw_Ws16 200.0000 Time_Busy -100.0000 100.0000 FORMAT "%8.4" EXTENDED_LIMITS -3276.800 3276.700 /end CHARACTERISTIC
/begin CHARACTERISTIC IVCtl_DisChDwnIKi_C "#SSD Kleinsignalverstärkung für I-Glied (Entladen)" VALUE 0xE58FC Kw_Wu32 9999999.99767 Ki_us2mA 0.00 9999999.99767 FORMAT "%13.5" /end CHARACTERISTIC
/begin CHARACTERISTIC IVCtl_DisChDwnIKiPos_C "#SSD Positive Großsignalverstärkung für I-Glied (Entladen)" VALUE 0xE5900 Kw_Wu32 9999999.99767 Ki_us2mA 0.00 9999999.99767 FORMAT "%13.5" /end CHARACTERISTIC
/begin CHARACTERISTIC IVCtl_DisChDwnIKiNeg_C "#SSD Negative Großsignalverstärkung für I-Glied (Entladen)" VALUE 0xE5904 Kw_Wu32 9999999.99767 Ki_us2mA 0.00 9999999.99767 FORMAT "%13.5" /end CHARACTERISTIC
/begin CHARACTERISTIC IVCtl_tiDisChDwnIWinPos_C "#SSD Positives Kleinsignalfenster für I-Glied (Entladen)" VALUE 0xE5908 Kw_Ws16 200.0000 Time_Busy -100.0000 100.0000 FORMAT "%8.4" EXTENDED_LIMITS -3276.800 3276.700 /end CHARACTERISTIC
/begin CHARACTERISTIC IVCtl_tiDisChDwnIWinNeg_C "#SSD Negatives Kleinsignalfenster für I-Glied (Entladen)" VALUE 0xE590A Kw_Ws16 200.0000 Time_Busy -100.0000 100.0000 FORMAT "%8.4" EXTENDED_LIMITS -3276.800 3276.700 /end CHARACTERISTIC
/begin CHARACTERISTIC IVCtl_DisChDwnPKp_C "#SSD Kleinsignalverstärkung für P-Glied (Entladen)" VALUE 0xE590C Kw_Wu32 655359.999847 Kp_us2mA 0.00 655359.999847 FORMAT "%13.6" /end CHARACTERISTIC
/begin CHARACTERISTIC IVCtl_DisChDwnPKpPos_C "#SSD Positive Großsignalverstärkung für P-Glied (Entladen)" VALUE 0xE5910 Kw_Wu32 655359.999847 Kp_us2mA 0.00 655359.999847 FORMAT "%13.6" /end CHARACTERISTIC
/begin CHARACTERISTIC IVCtl_DisChDwnPKpNeg_C "#SSD Negative Großsignalverstärkung für P-Glied (Entladen)" VALUE 0xE5914 Kw_Wu32 655359.999847 Kp_us2mA 0.00 655359.999847 FORMAT "%13.6" /end CHARACTERISTIC
/begin CHARACTERISTIC IVCtl_tiDisChDwnPWinPos_C "#SSD Positives Kleinsignalfenster für P-Glied (Entladen)" VALUE 0xE5918 Kw_Ws16 200.0000 Time_Busy -100.0000 100.0000 FORMAT "%8.4" EXTENDED_LIMITS -3276.800 3276.700 /end CHARACTERISTIC
/begin CHARACTERISTIC IVCtl_tiDisChDwnPWinNeg_C "#SSD Negatives Kleinsignalfenster für P-Glied (Entladen)" VALUE 0xE591A Kw_Ws16 200.0000 Time_Busy -100.0000 100.0000 FORMAT "%8.4" EXTENDED_LIMITS -3276.800 3276.700 /end CHARACTERISTIC
/begin CHARACTERISTIC IVCtl_iChrgUpCls_C "#SSD Vorgabewert für obere Stromgrenze (Klassifizierung)" VALUE 0xE591C Kw_Ws16 30000.00 Curr 0.00 30000.00 FORMAT "%8.2" EXTENDED_LIMITS -32768.00 32767.00 /end CHARACTERISTIC
/begin CHARACTERISTIC IVCtl_iChrgUpGovMax_C "#SSD Maximaler Strom für Ausgang Ladezeitregler" VALUE 0xE591E Kw_Ws16 6000.000 Curr -3000.000 3000.000 FORMAT "%8.3" EXTENDED_LIMITS -32768.00 32767.00 /end CHARACTERISTIC
/begin CHARACTERISTIC IVCtl_iChrgUpGovMin_C "#SSD Minimaler Strom für Ausgang Ladezeitregler" VALUE 0xE5920 Kw_Ws16 6000.000 Curr -3000.000 3000.000 FORMAT "%8.3" EXTENDED_LIMITS -32768.00 32767.00 /end CHARACTERISTIC
/begin CHARACTERISTIC IVCtl_iChrgUpInitI_C "#SSD Initialisierungswert für Ladezeitregler" VALUE 0xE5922 Kw_Ws16 6000.000 Curr -3000.000 3000.000 FORMAT "%8.3" EXTENDED_LIMITS -32768.00 32767.00 /end CHARACTERISTIC
/begin CHARACTERISTIC IVCtl_iChrgUpMax_C "#SSD Maximaler Ladestrom für Aktor" VALUE 0xE5924 Kw_Ws16 30000.00 Curr 0.00 30000.00 FORMAT "%8.2" EXTENDED_LIMITS -32768.00 32767.00 /end CHARACTERISTIC
/begin CHARACTERISTIC IVCtl_iChrgUpMin_C "#SSD Minimaler Ladestrom für Aktor" VALUE 0xE5926 Kw_Ws16 30000.00 Curr 0.00 30000.00 FORMAT "%8.2" EXTENDED_LIMITS -32768.00 32767.00 /end CHARACTERISTIC
/begin CHARACTERISTIC IVCtl_iChrgUp_MAP "Kennfeld zur spannungs- und raildruckabhängigen Sollwertvorgabe der Ladezeit" MAP 0xE5928 Kf_Xs16_Ys16_Ws16 30000.00 Curr 0.00 30000.00 FORMAT "%8.2" EXTENDED_LIMITS -32768.00 32767.00
 /begin AXIS_DESCR STD_AXIS IVCtl_uSetUpAvrg_mp Volt_PA 25 0.00 250.0000 FORMAT "%8.4" EXTENDED_LIMITS -327.6800 327.6700 DEPOSIT ABSOLUTE /end AXIS_DESCR
 /begin AXIS_DESCR STD_AXIS RailCD_pPeak Pres_Rail 2 -3276.800 3276.700 FORMAT "%5.3" DEPOSIT ABSOLUTE /end AXIS_DESCR
/end CHARACTERISTIC
/begin CHARACTERISTIC IVCtl_iDisChDwnCls_C "#SSD Vorgabewert für untere Stromgrenze (Klassifizierung)" VALUE 0xE59C6 Kw_Ws16 30000.00 Curr -30000.00 0.00 FORMAT "%8.2" EXTENDED_LIMITS -32768.00 32767.00 /end CHARACTERISTIC
/begin CHARACTERISTIC IVCtl_iDisChDwnGovMax_C "#SSD Maximaler Strom für Ausgang Entladezeitregler" VALUE 0xE59C8 Kw_Ws16 6000.000 Curr -3000.000 3000.000 FORMAT "%8.3" EXTENDED_LIMITS -32768.00 32767.00 /end CHARACTERISTIC
/begin CHARACTERISTIC IVCtl_iDisChDwnGovMin_C "#SSD Minimaler Strom für Ausgang Entladezeitregler" VALUE 0xE59CA Kw_Ws16 6000.000 Curr -3000.000 3000.000 FORMAT "%8.3" EXTENDED_LIMITS -32768.00 32767.00 /end CHARACTERISTIC
/begin CHARACTERISTIC IVCtl_iDisChDwnInitI_C "#SSD Initialisierungswert für Entladezeitregler" VALUE 0xE59CC Kw_Ws16 6000.000 Curr -3000.000 3000.000 FORMAT "%8.3" EXTENDED_LIMITS -32768.00 32767.00 /end CHARACTERISTIC
/begin CHARACTERISTIC IVCtl_iDisChDwnMax_C "#SSD Maximaler Entladestrom" VALUE 0xE59CE Kw_Ws16 30000.00 Curr -30000.00 0.00 FORMAT "%8.2" EXTENDED_LIMITS -32768.00 32767.00 /end CHARACTERISTIC
/begin CHARACTERISTIC IVCtl_iDisChDwnMin_C "#SSD Minimaler Entladestrom" VALUE 0xE59D0 Kw_Ws16 30000.00 Curr -30000.00 0.00 FORMAT "%8.2" EXTENDED_LIMITS -32768.00 32767.00 /end CHARACTERISTIC
/begin CHARACTERISTIC IVCtl_iDisChDwn_CUR "#SSD KL für Entladestromgrenze" CURVE 0xE59D2 Kl_Xs16_Ws16 30000.00 Curr -30000.00 0.00 FORMAT "%8.2" EXTENDED_LIMITS -32768.00 32767.00
 /begin AXIS_DESCR STD_AXIS IVCtl_uSetUpAvrg_mp Volt_PA 25 0.00 250.0000 FORMAT "%8.4" EXTENDED_LIMITS -327.6800 327.6700 DEPOSIT ABSOLUTE /end AXIS_DESCR
/end CHARACTERISTIC
/begin CHARACTERISTIC IVCtl_IKi_C "#SSD Integrationsbeiwert Ki für Kleinsignale" VALUE 0xE5A74 Kw_Wu32 999999.999767 Ki 0.00 999999.999767 FORMAT "%13.6" /end CHARACTERISTIC
/begin CHARACTERISTIC IVCtl_IKiPos_C "#SSD Integrationsbeiwert für positive Großsignale" VALUE 0xE5A78 Kw_Wu32 999999.999767 Ki 0.00 999999.999767 FORMAT "%13.6" /end CHARACTERISTIC
/begin CHARACTERISTIC IVCtl_IKiNeg_C "#SSD Integrationsbeiwert für negative Großsignale" VALUE 0xE5A7C Kw_Wu32 999999.999767 Ki 0.00 999999.999767 FORMAT "%13.6" /end CHARACTERISTIC
/begin CHARACTERISTIC IVCtl_uIWinPos_C "#SSD Obere Grenze Kleinsignal zu Großsignal I-Regler" VALUE 0xE5A80 Kw_Ws16 655.3500 Volt_PA -327.6800 327.6700 FORMAT "%8.4" /end CHARACTERISTIC
/begin CHARACTERISTIC IVCtl_uIWinNeg_C "#SSD Untere Grenze Kleinsignal zu Großsignal I-Regler" VALUE 0xE5A82 Kw_Ws16 655.3500 Volt_PA -327.6800 327.6700 FORMAT "%8.4" /end CHARACTERISTIC
/begin CHARACTERISTIC IVCtl_PKp_C "#SSD Verstärkung Kleinsignal" VALUE 0xE5A84 Kw_Wu32 65535.9999847 Kp 0.00 65535.9999847 FORMAT "%13.7" /end CHARACTERISTIC
/begin CHARACTERISTIC IVCtl_PKpPos_C "#SSD Verstärkung positives Großsignal" VALUE 0xE5A88 Kw_Wu32 65535.9999847 Kp 0.00 65535.9999847 FORMAT "%13.7" /end CHARACTERISTIC
/begin CHARACTERISTIC IVCtl_PKpNeg_C "#SSD Verstärkung negatives Großsignal" VALUE 0xE5A8C Kw_Wu32 65535.9999847 Kp 0.00 65535.9999847 FORMAT "%13.7" /end CHARACTERISTIC
/begin CHARACTERISTIC IVCtl_uPWinPos_C "#SSD Obere Grenze Kleinsignal zu Großsignal P-Regler" VALUE 0xE5A90 Kw_Ws16 655.3500 Volt_PA -327.6800 327.6700 FORMAT "%8.4" /end CHARACTERISTIC
/begin CHARACTERISTIC IVCtl_uPWinNeg_C "#SSD Untere Grenze Kleinsignal zu Großsignal P-Regler" VALUE 0xE5A92 Kw_Ws16 655.3500 Volt_PA -327.6800 327.6700 FORMAT "%8.4" /end CHARACTERISTIC
/begin CHARACTERISTIC IVCtl_swtAvrgEnaTiWarnVolt_C "zylinderspezifischer Schalter, um die Message InjVCD_stAvrgEnaTiWarn für dien Voltregler als Freigabekriterium zu aktivieren" VALUE 0xE5A94 Kw_Wu8 255.0 OneToOne 0.00 255.0 FORMAT "%5.1" /end CHARACTERISTIC
/begin CHARACTERISTIC IVCtl_swtTiChrgMinMaxActr_C "Schalter zur Aktivierung der Berechnung der Min.-/Max.-Regelabweichung der Lade-/Entladezeit (aktorspezifisch)" VALUE 0xE5A38 Kw_Wu8 1.000 OneToOne 0.00 1.000 FORMAT "%5.3" EXTENDED_LIMITS 0.00 255.0 /end CHARACTERISTIC
/begin CHARACTERISTIC IVCtl_swtTiChrgMinMaxRst_C "Schalter zum Rücksetzen der Berechnung Min.-/Max.-Regelabweichung von Lade-/Entladezeit" VALUE 0xE5A39 Kw_Wu8 1.000 OneToOne 0.00 1.000 FORMAT "%5.3" EXTENDED_LIMITS 0.00 255.0 /end CHARACTERISTIC
/begin CHARACTERISTIC IVCtl_swtTiChrgMinMax_C "Schalter zur Aktivierung der Berechnung der Min.-/Max.-Regelabweichung der Lade-/Entladezeit (gemittelt)" VALUE 0xE5A3A Kw_Wu8 1.000 OneToOne 0.00 1.000 FORMAT "%5.3" EXTENDED_LIMITS 0.00 255.0 /end CHARACTERISTIC
/begin CHARACTERISTIC IVCtl_swtUUpMinMaxActr_C "Schalter zur Aktivierung der Berechnung von Min.-/Max.-Regelabweichung der Spannung  (aktorspezifisch)" VALUE 0xE5A95 Kw_Wu8 1.000 OneToOne 0.00 1.000 FORMAT "%5.3" EXTENDED_LIMITS 0.00 255.0 /end CHARACTERISTIC
/begin CHARACTERISTIC IVCtl_swtUUpMinMaxRst_C "Schalter zum Rücksetzen der Berechnung Min.-/Max.-Regelabweichung der Spannung" VALUE 0xE5A96 Kw_Wu8 1.000 OneToOne 0.00 1.000 FORMAT "%5.3" EXTENDED_LIMITS 0.00 255.0 /end CHARACTERISTIC
/begin CHARACTERISTIC IVCtl_swtUUpMinMax_C "Schalter zur Aktivierung der Berechnung von Min.-/Max.-Regelabweichung der Spannung  (gemittelt)" VALUE 0xE5A97 Kw_Wu8 1.000 OneToOne 0.00 1.000 FORMAT "%5.3" EXTENDED_LIMITS 0.00 255.0 /end CHARACTERISTIC
/begin CHARACTERISTIC IVCtl_tiChrgSetUp_MAP "Kennfeld zur spannungs- und raildruckabhängigen Sollwertvorgabe des Aktor-Ladestroms" MAP 0xE5A3C Kf_Xs16_Ys16_Ws16 400.0000 Time_Busy 0.00 400.0000 FORMAT "%8.4" EXTENDED_LIMITS -3276.800 3276.700
 /begin AXIS_DESCR STD_AXIS IVCtl_uSetUpAvrg_mp Volt_PA 4 0.00 250.0000 FORMAT "%8.4" EXTENDED_LIMITS -327.6800 327.6700 DEPOSIT ABSOLUTE /end AXIS_DESCR
 /begin AXIS_DESCR STD_AXIS RailCD_pPeak Pres_Rail 2 -3276.800 3276.700 FORMAT "%5.3" DEPOSIT ABSOLUTE /end AXIS_DESCR
/end CHARACTERISTIC
/begin CHARACTERISTIC IVCtl_tiChrgUpPse_C "#SSD Vorgabewert der Pausezeit für Ladezeitregelung" VALUE 0xE5A5C Kw_Ws16 400.0000 Time_Busy 0.00 400.0000 FORMAT "%8.4" EXTENDED_LIMITS -3276.800 3276.700 /end CHARACTERISTIC
/begin CHARACTERISTIC IVCtl_tiDisChDwnPse_C "#SSD Vorgabewert der Pausezeit für Entladezeitregelung" VALUE 0xE5A5E Kw_Ws16 400.0000 Time_Busy 0.00 400.0000 FORMAT "%8.4" EXTENDED_LIMITS -3276.800 3276.700 /end CHARACTERISTIC
/begin CHARACTERISTIC IVCtl_tiDisChSetDwn_CUR "#SSD Kennlinie zur spannungsabhängigen Sollwertvorgabe der Entladezeit" CURVE 0xE5A60 Kl_Xs16_Ws16 400.0000 Time_Busy 0.00 400.0000 FORMAT "%8.4" EXTENDED_LIMITS -3276.800 3276.700
 /begin AXIS_DESCR STD_AXIS IVCtl_uSetUpAvrg_mp Volt_PA 4 -250.0000 250.0000 FORMAT "%8.4" EXTENDED_LIMITS -327.6800 327.6700 DEPOSIT ABSOLUTE /end AXIS_DESCR
/end CHARACTERISTIC
/begin CHARACTERISTIC IVCtl_uClsActrUp_C "#SSD Sollspannung für den Piezoaktor während der Klassifizierung im Steuergerätenachlauf" VALUE 0xE5A98 Kw_Ws16 500.0000 Volt_PA -250.0000 250.0000 FORMAT "%8.4" EXTENDED_LIMITS -327.6800 327.6700 /end CHARACTERISTIC
/begin CHARACTERISTIC IVCtl_uMaxSetUp_C "#SSD Obere Begrenzung  des korrigierten Spannungssollwertes (up-level)" VALUE 0xE5A9A Kw_Ws16 250.0000 Volt_PA 0.00 250.0000 FORMAT "%8.4" EXTENDED_LIMITS -327.6800 327.6700 /end CHARACTERISTIC
/begin CHARACTERISTIC IVCtl_uMinSetUp_C "#SSD Untere Begrenzung  des korrigierten Spannungssollwertes (up-level)" VALUE 0xE5A9C Kw_Ws16 250.0000 Volt_PA 0.00 250.0000 FORMAT "%8.4" EXTENDED_LIMITS -327.6800 327.6700 /end CHARACTERISTIC
/begin CHARACTERISTIC IVCtl_uPIMax_C "#SSD Maximaler Reglerausgang Spannungssollwert" VALUE 0xE5A9E Kw_Ws16 500.0000 Volt_PA -250.0000 250.0000 FORMAT "%8.4" EXTENDED_LIMITS -327.6800 327.6700 /end CHARACTERISTIC
/begin CHARACTERISTIC IVCtl_uPIMin_C "#SSD Minimaler Reglerausgang Spannungssollwert" VALUE 0xE5AA0 Kw_Ws16 500.0000 Volt_PA -250.0000 250.0000 FORMAT "%8.4" EXTENDED_LIMITS -327.6800 327.6700 /end CHARACTERISTIC
/begin CHARACTERISTIC IVCtl_uSetUpPreCtl_CUR "#SSD Vorsteuerkennlinie für Spannungssollwertberechnung" CURVE 0xE5AA2 Kl_Xs16_Ws16 250.0000 Volt_PA 0.00 250.0000 FORMAT "%8.4" EXTENDED_LIMITS -327.6800 327.6700
 /begin AXIS_DESCR STD_AXIS InjVlv_pCalcVolt Pres_Rail 20 -3276.800 3276.700 FORMAT "%5.3" DEPOSIT ABSOLUTE /end AXIS_DESCR
/end CHARACTERISTIC
/begin CHARACTERISTIC IVCtl_uUpInitI_C "#SSD Initialisierungswert für PI-Regler (up-Niveau)" VALUE 0xE5AF4 Kw_Ws16 500.0000 Volt_PA -250.0000 250.0000 FORMAT "%8.4" EXTENDED_LIMITS -327.6800 327.6700 /end CHARACTERISTIC
/begin CHARACTERISTIC K2RDLI_dDataSetVer_C "Array für Datensatzversion" ASCII 0xC0650 Kwb_Wu8 255.0 defaultAscii 0.00 255.0 NUMBER 10 /end CHARACTERISTIC
/begin CHARACTERISTIC Layer_ctDebBSDStep_C "" VALUE 0xE5B34 Kw_Wu8 255.0 OneToOne 0.00 255.0 FORMAT "%5.1" /end CHARACTERISTIC
/begin CHARACTERISTIC Layer_ctDebGENStep_C "" VALUE 0xE5B35 Kw_Wu8 255.0 OneToOne 0.00 255.0 FORMAT "%5.1" /end CHARACTERISTIC
/begin CHARACTERISTIC Layer_ctDebIBS1Step_C "" VALUE 0xE5B36 Kw_Wu8 255.0 OneToOne 0.00 255.0 FORMAT "%5.1" /end CHARACTERISTIC
/begin CHARACTERISTIC Layer_ctDebIBS2Step_C "" VALUE 0xE5B37 Kw_Wu8 255.0 OneToOne 0.00 255.0 FORMAT "%5.1" /end CHARACTERISTIC
/begin CHARACTERISTIC Layer_ctDebIBS3Step_C "" VALUE 0xE5B38 Kw_Wu8 255.0 OneToOne 0.00 255.0 FORMAT "%5.1" /end CHARACTERISTIC
/begin CHARACTERISTIC Layer_ctDebMANHYDRStep_C "" VALUE 0xE5B39 Kw_Wu8 255.0 OneToOne 0.00 255.0 FORMAT "%5.1" /end CHARACTERISTIC
/begin CHARACTERISTIC Layer_ctDebMANLUFTStep_C "" VALUE 0xE5B3A Kw_Wu8 255.0 OneToOne 0.00 255.0 FORMAT "%5.1" /end CHARACTERISTIC
/begin CHARACTERISTIC Layer_ctDebPMBATTStep_C "" VALUE 0xE5B3B Kw_Wu8 255.0 OneToOne 0.00 255.0 FORMAT "%5.1" /end CHARACTERISTIC
/begin CHARACTERISTIC Layer_ctDebPMBNStep_C "" VALUE 0xE5B3C Kw_Wu8 255.0 OneToOne 0.00 255.0 FORMAT "%5.1" /end CHARACTERISTIC
/begin CHARACTERISTIC Layer_ctDebPMRUHVERLStep_C "" VALUE 0xE5B3D Kw_Wu8 255.0 OneToOne 0.00 255.0 FORMAT "%5.1" /end CHARACTERISTIC
/begin CHARACTERISTIC Layer_ctDebQLTStep_C "" VALUE 0xE5B3E Kw_Wu8 255.0 OneToOne 0.00 255.0 FORMAT "%5.1" /end CHARACTERISTIC
/begin CHARACTERISTIC Layer_ctDebTANSStep_C "" VALUE 0xE5B3F Kw_Wu8 255.0 OneToOne 0.00 255.0 FORMAT "%5.1" /end CHARACTERISTIC
/begin CHARACTERISTIC Layer_ctDebTOENSStep_C "" VALUE 0xE5B40 Kw_Wu8 255.0 OneToOne 0.00 255.0 FORMAT "%5.1" /end CHARACTERISTIC
/begin CHARACTERISTIC Layer_ctDebTUMGStep_C "" VALUE 0xE5B41 Kw_Wu8 255.0 OneToOne 0.00 255.0 FORMAT "%5.1" /end CHARACTERISTIC
/begin CHARACTERISTIC Layer_ctDebBSDDef_C "" VALUE 0xE5B42 Kw_Wu16 65535.00 OneToOne 0.00 65535.00 FORMAT "%8.2" /end CHARACTERISTIC
/begin CHARACTERISTIC Layer_ctDebBSDOk_C "" VALUE 0xE5B44 Kw_Wu16 65535.00 OneToOne 0.00 65535.00 FORMAT "%8.2" /end CHARACTERISTIC
/begin CHARACTERISTIC Layer_ctDebGENDef_C "" VALUE 0xE5B46 Kw_Wu16 65535.00 OneToOne 0.00 65535.00 FORMAT "%8.2" /end CHARACTERISTIC
/begin CHARACTERISTIC Layer_ctDebGENOk_C "" VALUE 0xE5B48 Kw_Wu16 65535.00 OneToOne 0.00 65535.00 FORMAT "%8.2" /end CHARACTERISTIC
/begin CHARACTERISTIC Layer_ctDebIBS1Def_C "" VALUE 0xE5B4A Kw_Wu16 65535.00 OneToOne 0.00 65535.00 FORMAT "%8.2" /end CHARACTERISTIC
/begin CHARACTERISTIC Layer_ctDebIBS1Ok_C "" VALUE 0xE5B4C Kw_Wu16 65535.00 OneToOne 0.00 65535.00 FORMAT "%8.2" /end CHARACTERISTIC
/begin CHARACTERISTIC Layer_ctDebIBS2Def_C "" VALUE 0xE5B4E Kw_Wu16 65535.00 OneToOne 0.00 65535.00 FORMAT "%8.2" /end CHARACTERISTIC
/begin CHARACTERISTIC Layer_ctDebIBS2Ok_C "" VALUE 0xE5B50 Kw_Wu16 65535.00 OneToOne 0.00 65535.00 FORMAT "%8.2" /end CHARACTERISTIC
/begin CHARACTERISTIC Layer_ctDebIBS3Def_C "" VALUE 0xE5B52 Kw_Wu16 65535.00 OneToOne 0.00 65535.00 FORMAT "%8.2" /end CHARACTERISTIC
/begin CHARACTERISTIC Layer_ctDebIBS3Ok_C "" VALUE 0xE5B54 Kw_Wu16 65535.00 OneToOne 0.00 65535.00 FORMAT "%8.2" /end CHARACTERISTIC
/begin CHARACTERISTIC Layer_ctDebMANHYDRDef_C "" VALUE 0xE5B56 Kw_Wu16 65535.00 OneToOne 0.00 65535.00 FORMAT "%8.2" /end CHARACTERISTIC
/begin CHARACTERISTIC Layer_ctDebMANHYDROk_C "" VALUE 0xE5B58 Kw_Wu16 65535.00 OneToOne 0.00 65535.00 FORMAT "%8.2" /end CHARACTERISTIC
/begin CHARACTERISTIC Layer_ctDebMANLUFTDef_C "" VALUE 0xE5B5A Kw_Wu16 65535.00 OneToOne 0.00 65535.00 FORMAT "%8.2" /end CHARACTERISTIC
/begin CHARACTERISTIC Layer_ctDebMANLUFTOk_C "" VALUE 0xE5B5C Kw_Wu16 65535.00 OneToOne 0.00 65535.00 FORMAT "%8.2" /end CHARACTERISTIC
/begin CHARACTERISTIC Layer_ctDebPMBATTDef_C "" VALUE 0xE5B5E Kw_Wu16 65535.00 OneToOne 0.00 65535.00 FORMAT "%8.2" /end CHARACTERISTIC
/begin CHARACTERISTIC Layer_ctDebPMBATTOk_C "" VALUE 0xE5B60 Kw_Wu16 65535.00 OneToOne 0.00 65535.00 FORMAT "%8.2" /end CHARACTERISTIC
/begin CHARACTERISTIC Layer_ctDebPMBNDef_C "" VALUE 0xE5B62 Kw_Wu16 65535.00 OneToOne 0.00 65535.00 FORMAT "%8.2" /end CHARACTERISTIC
/begin CHARACTERISTIC Layer_ctDebPMBNOk_C "" VALUE 0xE5B64 Kw_Wu16 65535.00 OneToOne 0.00 65535.00 FORMAT "%8.2" /end CHARACTERISTIC
/begin CHARACTERISTIC Layer_ctDebPMRUHVERLDef_C "" VALUE 0xE5B66 Kw_Wu16 65535.00 OneToOne 0.00 65535.00 FORMAT "%8.2" /end CHARACTERISTIC
/begin CHARACTERISTIC Layer_ctDebPMRUHVERLOk_C "" VALUE 0xE5B68 Kw_Wu16 65535.00 OneToOne 0.00 65535.00 FORMAT "%8.2" /end CHARACTERISTIC
/begin CHARACTERISTIC Layer_ctDebQLTDef_C "" VALUE 0xE5B6A Kw_Wu16 65535.00 OneToOne 0.00 65535.00 FORMAT "%8.2" /end CHARACTERISTIC
/begin CHARACTERISTIC Layer_ctDebQLTOk_C "" VALUE 0xE5B6C Kw_Wu16 65535.00 OneToOne 0.00 65535.00 FORMAT "%8.2" /end CHARACTERISTIC
/begin CHARACTERISTIC Layer_ctDebTANSDef_C "" VALUE 0xE5B6E Kw_Wu16 65535.00 OneToOne 0.00 65535.00 FORMAT "%8.2" /end CHARACTERISTIC
/begin CHARACTERISTIC Layer_ctDebTANSOk_C "" VALUE 0xE5B70 Kw_Wu16 65535.00 OneToOne 0.00 65535.00 FORMAT "%8.2" /end CHARACTERISTIC
/begin CHARACTERISTIC Layer_ctDebTOENSDef_C "" VALUE 0xE5B72 Kw_Wu16 65535.00 OneToOne 0.00 65535.00 FORMAT "%8.2" /end CHARACTERISTIC
/begin CHARACTERISTIC Layer_ctDebTOENSOk_C "" VALUE 0xE5B74 Kw_Wu16 65535.00 OneToOne 0.00 65535.00 FORMAT "%8.2" /end CHARACTERISTIC
/begin CHARACTERISTIC Layer_ctDebTUMGDef_C "" VALUE 0xE5B76 Kw_Wu16 65535.00 OneToOne 0.00 65535.00 FORMAT "%8.2" /end CHARACTERISTIC
/begin CHARACTERISTIC Layer_ctDebTUMGOk_C "" VALUE 0xE5B78 Kw_Wu16 65535.00 OneToOne 0.00 65535.00 FORMAT "%8.2" /end CHARACTERISTIC
/begin CHARACTERISTIC Layer_stAirCtlBits_C "" VALUE 0xE5AFC Kw_Wu32 4294967295.00 OneToOne 0.00 4294967295.00 FORMAT "%13.2" /end CHARACTERISTIC
/begin CHARACTERISTIC Layer_stPCR_C "" VALUE 0xE5B00 Kw_Wu16 65535.00 OneToOne 0.00 65535.00 FORMAT "%8.2" /end CHARACTERISTIC
/begin CHARACTERISTIC Layer_swtB_bsdprot "" VALUE 0xE5B02 Kw_Wu8 255.0 OneToOne 0.00 255.0 FORMAT "%5.1" /end CHARACTERISTIC
/begin CHARACTERISTIC Layer_swtTunProt_C "" VALUE 0xE5B03 Kw_Wu8 1.000 OneToOne 0.00 1.000 FORMAT "%5.3" EXTENDED_LIMITS 0.00 255.0 /end CHARACTERISTIC
/begin CHARACTERISTIC Layer_tiDefWrEep_C "" VALUE 0xE5B04 Kw_Wu16 10000.00 Time_ms 0.00 10000.00 FORMAT "%8.2" EXTENDED_LIMITS 0.00 655350.0 /end CHARACTERISTIC
/begin CHARACTERISTIC PwrMng_B_ulcp_C "Applikationslabel fuer Powermanagement" VALUE 0xE5B06 Kw_Wu8 255.0 OneToOne 0.00 255.0 FORMAT "%5.1" /end CHARACTERISTIC
/begin CHARACTERISTIC PwrMng_dmAirPerTimeCor_C "correction factor for air mass per time" VALUE 0xE5B08 Kw_Ws16 1500.000 SlopeRes10000 0.00 1500.000 FORMAT "%8.3" EXTENDED_LIMITS -3.276800 3.276700 /end CHARACTERISTIC
/begin CHARACTERISTIC PwrMng_dmAirPerTimeIMax_C "Maximum integrated air mass" VALUE 0xE5B0A Kw_Wu8 1500. AirMassPerTime 0.00 1500. FORMAT "%5.0" EXTENDED_LIMITS 0.00 25.50 /end CHARACTERISTIC
/begin CHARACTERISTIC PwrMng_dmAirPerTimeIMin_C "Integrated air mass minimum value" VALUE 0xE5B0B Kw_Wu8 1500. AirMassPerTime 0.00 1500. FORMAT "%5.0" EXTENDED_LIMITS 0.00 25.50 /end CHARACTERISTIC
/begin CHARACTERISTIC PwrMng_dmAirPerTimeIKi_C "I-governor gain, deviation is within small signal bounds" VALUE 0xE5B0C Kw_Wu32 5.00003807247 Ki 0.00 5.00003807247 FORMAT "%13.11" EXTENDED_LIMITS 0.00 999999.999767 /end CHARACTERISTIC
/begin CHARACTERISTIC PwrMng_dmAirPerTimeIKiPos_C "I-governor gain, deviation is greater than small signal bound" VALUE 0xE5B10 Kw_Wu32 5.00003807247 Ki 0.00 5.00003807247 FORMAT "%13.11" EXTENDED_LIMITS 0.00 999999.999767 /end CHARACTERISTIC
/begin CHARACTERISTIC PwrMng_dmAirPerTimeIKiNeg_C "I-governor gain, deviation is less than small signal bound" VALUE 0xE5B14 Kw_Wu32 5.00003807247 Ki 0.00 5.00003807247 FORMAT "%13.11" EXTENDED_LIMITS 0.00 999999.999767 /end CHARACTERISTIC
/begin CHARACTERISTIC PwrMng_dmAirPerTimeIWinPos_C "I-governor positive window border" VALUE 0xE5B18 Kw_Ws16 1500.000 AirMassPerTime 0.00 1500.000 FORMAT "%8.3" EXTENDED_LIMITS -3276.800 3276.700 /end CHARACTERISTIC
/begin CHARACTERISTIC PwrMng_dmAirPerTimeIWinNeg_C "I-governor negative window border" VALUE 0xE5B1A Kw_Ws16 1500.000 AirMassPerTime 0.00 1500.000 FORMAT "%8.3" EXTENDED_LIMITS -3276.800 3276.700 /end CHARACTERISTIC
/begin CHARACTERISTIC PwrMng_nB_kwdrehtHi_C "" VALUE 0xE5B1C Kw_Ws16 6000.000 EngN 0.00 6000.000 FORMAT "%8.3" EXTENDED_LIMITS -32768.00 32767.00 /end CHARACTERISTIC
/begin CHARACTERISTIC PwrMng_nB_kwdrehtLo_C "" VALUE 0xE5B1E Kw_Ws16 6000.000 EngN 0.00 6000.000 FORMAT "%8.3" EXTENDED_LIMITS -32768.00 32767.00 /end CHARACTERISTIC
/begin CHARACTERISTIC PwrMng_nB_llHigh_C "High threshold for condition low idle" VALUE 0xE5B20 Kw_Ws16 6000.000 EngN 0.00 6000.000 FORMAT "%8.3" EXTENDED_LIMITS -32768.00 32767.00 /end CHARACTERISTIC
/begin CHARACTERISTIC PwrMng_nB_llLow_C "Low threshold for condition low idle" VALUE 0xE5B22 Kw_Ws16 6000.000 EngN 0.00 6000.000 FORMAT "%8.3" EXTENDED_LIMITS -32768.00 32767.00 /end CHARACTERISTIC
/begin CHARACTERISTIC PwrMng_rLoadMax_C "Threshold for condition maximum load" VALUE 0xE5B24 Kw_Ws16 100.0000 Prc 0.00 100.0000 FORMAT "%8.4" EXTENDED_LIMITS -400.0000 399.9878 /end CHARACTERISTIC
/begin CHARACTERISTIC PwrMng_stIdlingDefVal_C "defect value for n_idlms" VALUE 0xE5B26 Kw_Wu8 255.0 OneToOne 0.00 255.0 FORMAT "%5.1" /end CHARACTERISTIC
/begin CHARACTERISTIC PwrMng_swtnmot_w_C "switch for nmot_w (Eng_nAvrg/CrSCD_nCurr)" VALUE 0xE5B27 Kw_Wu8 1.000 OneToOne 0.00 1.000 FORMAT "%5.3" EXTENDED_LIMITS 0.00 255.0 /end CHARACTERISTIC
/begin CHARACTERISTIC PwrMng_swtPmsvActiv_C "Applikationslabel fuer Powermanagement" VALUE 0xE5B28 Kw_Wu8 1.000 OneToOne 0.00 1.000 FORMAT "%5.3" EXTENDED_LIMITS 0.00 255.0 /end CHARACTERISTIC
/begin CHARACTERISTIC PwrMng_swttumg_C "switch for tumg (IATSCD_tAir/EATSCD_tAir)" VALUE 0xE5B29 Kw_Wu8 1.000 OneToOne 0.00 1.000 FORMAT "%5.3" EXTENDED_LIMITS 0.00 255.0 /end CHARACTERISTIC
/begin CHARACTERISTIC PwrMng_tiChgBatt_C "Applikationslabel fuer Powermanagement" VALUE 0xE5B2A Kw_Wu16 10000.00 Time_ms 0.00 10000.00 FORMAT "%8.2" EXTENDED_LIMITS 0.00 655350.0 /end CHARACTERISTIC
/begin CHARACTERISTIC PwrMng_tiHisRst_C "Applikationslabel fuer Powermanagement" VALUE 0xE5B2C Kw_Wu16 10000.00 Time_ms 0.00 10000.00 FORMAT "%8.2" EXTENDED_LIMITS 0.00 655350.0 /end CHARACTERISTIC
/begin CHARACTERISTIC PwrMng_Tkat_mod_C "" VALUE 0xE5B2E Kw_Ws16 327675.0 temp_ub_q5_o50 -163890.0 163785.0 FORMAT "%8.1" /end CHARACTERISTIC
/begin CHARACTERISTIC PwrMng_uAltTargetDefVal_C "defect value for ctrgnms" VALUE 0xE5B30 Kw_Ws16 65535.00 OneToOne -32768.00 32767.00 FORMAT "%8.2" /end CHARACTERISTIC
/begin MEASUREMENT BD_BSD "" UBYTE OneToOne 1 100 0.00 255.0 FORMAT "%5.1" ECU_ADDRESS 0x8FF8A0 /end MEASUREMENT
/begin MEASUREMENT BD_GEN "" UBYTE OneToOne 1 100 0.00 255.0 FORMAT "%5.1" ECU_ADDRESS 0x8FF8A1 /end MEASUREMENT
/begin MEASUREMENT BD_IBS1 "" UBYTE OneToOne 1 100 0.00 255.0 FORMAT "%5.1" ECU_ADDRESS 0x8FF8A2 /end MEASUREMENT
/begin MEASUREMENT BD_IBS2 "" UBYTE OneToOne 1 100 0.00 255.0 FORMAT "%5.1" ECU_ADDRESS 0x8FF8A3 /end MEASUREMENT
/begin MEASUREMENT BD_IBS3 "" UBYTE OneToOne 1 100 0.00 255.0 FORMAT "%5.1" ECU_ADDRESS 0x8FF8A4 /end MEASUREMENT
/begin MEASUREMENT BD_MANHYDR "" UBYTE OneToOne 1 100 0.00 255.0 FORMAT "%5.1" ECU_ADDRESS 0x8FF8A5 /end MEASUREMENT
/begin MEASUREMENT BD_MANLUFT "" UBYTE OneToOne 1 100 0.00 255.0 FORMAT "%5.1" ECU_ADDRESS 0x8FF8A6 /end MEASUREMENT
/begin MEASUREMENT BD_PMBATT "" UBYTE OneToOne 1 100 0.00 255.0 FORMAT "%5.1" ECU_ADDRESS 0x8FF8A7 /end MEASUREMENT
/begin MEASUREMENT BD_PMBN "" UBYTE OneToOne 1 100 0.00 255.0 FORMAT "%5.1" ECU_ADDRESS 0x8FF8A8 /end MEASUREMENT
/begin MEASUREMENT BD_PMRUHVERL "" UBYTE OneToOne 1 100 0.00 255.0 FORMAT "%5.1" ECU_ADDRESS 0x8FF8A9 /end MEASUREMENT
/begin MEASUREMENT BD_QLT "" UBYTE OneToOne 1 100 0.00 255.0 FORMAT "%5.1" ECU_ADDRESS 0x8FF8AA /end MEASUREMENT
/begin MEASUREMENT BD_TANS "" UBYTE OneToOne 1 100 0.00 255.0 FORMAT "%5.1" ECU_ADDRESS 0x8FF8AB /end MEASUREMENT
/begin MEASUREMENT BD_TOENS "" UBYTE OneToOne 1 100 0.00 255.0 FORMAT "%5.1" ECU_ADDRESS 0x8FF8AC /end MEASUREMENT
/begin MEASUREMENT BD_TUMG "" UBYTE OneToOne 1 100 0.00 255.0 FORMAT "%5.1" ECU_ADDRESS 0x8FF8AD /end MEASUREMENT
/begin MEASUREMENT Counter_Layer_fp1000_mp "" UBYTE OneToOne 1 100 0.00 255.0 FORMAT "%5.1" ECU_ADDRESS 0x8FF8D8 /end MEASUREMENT
/begin MEASUREMENT Counter_Layer_fp100_mp "" UBYTE OneToOne 1 100 0.00 255.0 FORMAT "%5.1" ECU_ADDRESS 0x8FF8D9 /end MEASUREMENT
/begin MEASUREMENT Counter_Layer_fp10_mp "" UBYTE OneToOne 1 100 0.00 255.0 FORMAT "%5.1" ECU_ADDRESS 0x8FF8DA /end MEASUREMENT
/begin MEASUREMENT Counter_Layer_fp200_mp "" UBYTE OneToOne 1 100 0.00 255.0 FORMAT "%5.1" ECU_ADDRESS 0x8FF8DB /end MEASUREMENT
/begin MEASUREMENT Counter_Layer_ini_mp "" UBYTE OneToOne 1 100 0.00 255.0 FORMAT "%5.1" ECU_ADDRESS 0x8FF8DC /end MEASUREMENT
/begin MEASUREMENT Counter_Layer_nl1000_mp "" UBYTE OneToOne 1 100 0.00 255.0 FORMAT "%5.1" ECU_ADDRESS 0x8FF8DD /end MEASUREMENT
/begin MEASUREMENT Counter_Layer_nl100_mp "" UBYTE OneToOne 1 100 0.00 255.0 FORMAT "%5.1" ECU_ADDRESS 0x8FF8DE /end MEASUREMENT
/begin MEASUREMENT Counter_Layer_nl10_mp "" UBYTE OneToOne 1 100 0.00 255.0 FORMAT "%5.1" ECU_ADDRESS 0x8FF8DF /end MEASUREMENT
/begin MEASUREMENT Counter_Layer_nl200_mp "" UBYTE OneToOne 1 100 0.00 255.0 FORMAT "%5.1" ECU_ADDRESS 0x8FF8E0 /end MEASUREMENT
/begin MEASUREMENT Counter_Layer_wakeup1000_mp "" UBYTE OneToOne 1 100 0.00 255.0 FORMAT "%5.1" ECU_ADDRESS 0x8FF8E1 /end MEASUREMENT
/begin MEASUREMENT Counter_Layer_wakeup100_mp "" UBYTE OneToOne 1 100 0.00 255.0 FORMAT "%5.1" ECU_ADDRESS 0x8FF8E2 /end MEASUREMENT
/begin MEASUREMENT Counter_Layer_wakeup10_mp "" UBYTE OneToOne 1 100 0.00 255.0 FORMAT "%5.1" ECU_ADDRESS 0x8FF8E3 /end MEASUREMENT
/begin MEASUREMENT Counter_Layer_wakeup200_mp "" UBYTE OneToOne 1 100 0.00 255.0 FORMAT "%5.1" ECU_ADDRESS 0x8FF8E4 /end MEASUREMENT
/begin MEASUREMENT E_BSD "" UBYTE OneToOne 1 100 0.00 255.0 FORMAT "%5.1" ECU_ADDRESS 0x8FF8AE /end MEASUREMENT
/begin MEASUREMENT E_GEN "" UBYTE OneToOne 1 100 0.00 255.0 FORMAT "%5.1" ECU_ADDRESS 0x8FF8AF /end MEASUREMENT
/begin MEASUREMENT E_IBS1 "" UBYTE OneToOne 1 100 0.00 255.0 FORMAT "%5.1" ECU_ADDRESS 0x8FF8B0 /end MEASUREMENT
/begin MEASUREMENT E_IBS2 "" UBYTE OneToOne 1 100 0.00 255.0 FORMAT "%5.1" ECU_ADDRESS 0x8FF8B1 /end MEASUREMENT
/begin MEASUREMENT E_IBS3 "" UBYTE OneToOne 1 100 0.00 255.0 FORMAT "%5.1" ECU_ADDRESS 0x8FF8B2 /end MEASUREMENT
/begin MEASUREMENT E_MANHYDR "" UBYTE OneToOne 1 100 0.00 255.0 FORMAT "%5.1" ECU_ADDRESS 0x8FF8B3 /end MEASUREMENT
/begin MEASUREMENT E_MANLUFT "" UBYTE OneToOne 1 100 0.00 255.0 FORMAT "%5.1" ECU_ADDRESS 0x8FF8B4 /end MEASUREMENT
/begin MEASUREMENT E_PMBATT "" UBYTE OneToOne 1 100 0.00 255.0 FORMAT "%5.1" ECU_ADDRESS 0x8FF8B5 /end MEASUREMENT
/begin MEASUREMENT E_PMBN "" UBYTE OneToOne 1 100 0.00 255.0 FORMAT "%5.1" ECU_ADDRESS 0x8FF8B6 /end MEASUREMENT
/begin MEASUREMENT E_PMRUHVERL "" UBYTE OneToOne 1 100 0.00 255.0 FORMAT "%5.1" ECU_ADDRESS 0x8FF8B7 /end MEASUREMENT
/begin MEASUREMENT E_QLT "" UBYTE OneToOne 1 100 0.00 255.0 FORMAT "%5.1" ECU_ADDRESS 0x8FF8B8 /end MEASUREMENT
/begin MEASUREMENT E_TANS "" UBYTE OneToOne 1 100 0.00 255.0 FORMAT "%5.1" ECU_ADDRESS 0x8FF8B9 /end MEASUREMENT
/begin MEASUREMENT E_TOENS "" UBYTE OneToOne 1 100 0.00 255.0 FORMAT "%5.1" ECU_ADDRESS 0x8FF8BA /end MEASUREMENT
/begin MEASUREMENT E_TUMG "" UBYTE OneToOne 1 100 0.00 255.0 FORMAT "%5.1" ECU_ADDRESS 0x8FF8BB /end MEASUREMENT
/begin MEASUREMENT InjVCD_ctMI1AgDiff_mp "Zähler für Winkelverletzungen bei Programmierung des Ansteuerbeginns der MI1" UWORD OneToOne 1 100 0.00 65535.00 FORMAT "%8.2" ECU_ADDRESS 0x8FF6CE /end MEASUREMENT
/begin MEASUREMENT InjVCD_ctPiI1AgDiff_mp "Zähler für Winkelverletzungen bei Programmierung des Ansteuerbeginns der PiI1" UWORD OneToOne 1 100 0.00 65535.00 FORMAT "%8.2" ECU_ADDRESS 0x8FF6D4 /end MEASUREMENT
/begin MEASUREMENT InjVCD_ctPiI2AgDiff_mp "Zähler für Winkelverletzungen bei Programmierung des Ansteuerbeginns der PiI2" UWORD OneToOne 1 100 0.00 65535.00 FORMAT "%8.2" ECU_ADDRESS 0x8FF6DA /end MEASUREMENT
/begin MEASUREMENT InjVCD_ctPolarOvrRun_mp "Überlaufzähler für Polarisierung" ULONG OneToOne 1 100 0.00 4294967295.00 FORMAT "%13.2" ARRAY_SIZE 6 ECU_ADDRESS 0x8FF698 /end MEASUREMENT
/begin MEASUREMENT InjVCD_ctUBufTrig_mp "Zähler für Anzahl der QADC-Trigger" UBYTE OneToOne 1 100 0.00 255.0 FORMAT "%5.1" ECU_ADDRESS 0x8FF64C /end MEASUREMENT
/begin MEASUREMENT InjVCD_iPolarChrg_mp "Ladestrom während der Polarisierung" SWORD Curr 1 100 -32768.00 32767.00 FORMAT "%8.2" ECU_ADDRESS 0x8FF6B0 /end MEASUREMENT
/begin MEASUREMENT InjVCD_iPolarDisCh_mp "Entladestrom während der Polarisierung" SWORD Curr 1 100 -32768.00 32767.00 FORMAT "%8.2" ECU_ADDRESS 0x8FF6B2 /end MEASUREMENT
/begin MEASUREMENT InjVCD_numCollPrim_mp "Beschreibung der Primärkollision" UBYTE OneToOne 1 100 0.00 255.0 FORMAT "%5.1" ECU_ADDRESS 0x8FF606 /end MEASUREMENT
/begin MEASUREMENT InjVCD_numCollScnd_mp "Beschreibung der Sekundärkollision" UBYTE OneToOne 1 100 0.00 255.0 FORMAT "%5.1" ECU_ADDRESS 0x8FF607 /end MEASUREMENT
/begin MEASUREMENT InjVCD_numCollThrd_mp "Beschreibung der Tertiärkollision" UBYTE OneToOne 1 100 0.00 255.0 FORMAT "%5.1" ECU_ADDRESS 0x8FF608 /end MEASUREMENT
/begin MEASUREMENT InjVCD_numCrntLvl_mp "ausgewähltes Stromband" SBYTE OneToOne 1 100 -128.0 127.0 FORMAT "%5.1" ECU_ADDRESS 0x8FF6E4 /end MEASUREMENT
/begin MEASUREMENT InjVCD_numEvMgmtStat_mp "Statusinformation des Flankenmanagement" ULONG OneToOne 1 100 0.00 4294967295.00 FORMAT "%13.2" ARRAY_SIZE 8 ECU_ADDRESS 0x8FF60C /end MEASUREMENT
/begin MEASUREMENT InjVCD_numOfsSelect "ausgewählter Spannungsoffset" SWORD OneToOne 1 100 -32768.00 32767.00 FORMAT "%8.2" ECU_ADDRESS 0x7F8F28 /end MEASUREMENT
/begin MEASUREMENT InjVCD_numReacPrim_mp "Beschreibung der Primärreaktion" UBYTE OneToOne 1 100 0.00 255.0 FORMAT "%5.1" ECU_ADDRESS 0x8FF62C /end MEASUREMENT
/begin MEASUREMENT InjVCD_numReacScnd_mp "Beschreibung der Sekundärreaktion" UBYTE OneToOne 1 100 0.00 255.0 FORMAT "%5.1" ECU_ADDRESS 0x8FF62D /end MEASUREMENT
/begin MEASUREMENT InjVCD_phiMI1Diff_mp "Winkeldifferenz zwischen dem gewünschten Ansteuerbeginn und dem systembed. frühesten Ansteuerbeginn der MI1" SWORD AngleCrS 1 100 -768.0000 767.9766 FORMAT "%8.4" ECU_ADDRESS 0x8FF6D0 /end MEASUREMENT
/begin MEASUREMENT InjVCD_phiPiI1Diff_mp "Winkeldifferenz zwischen dem gewünschten Ansteuerbeginn und dem systembed. frühesten Ansteuerbeginn der PiI1" SWORD AngleCrS 1 100 -768.0000 767.9766 FORMAT "%8.4" ECU_ADDRESS 0x8FF6D6 /end MEASUREMENT
/begin MEASUREMENT InjVCD_phiPiI2Diff_mp "Winkeldifferenz zwischen dem gewünschten Ansteuerbeginn und dem systembed. frühesten Ansteuerbeginn der PiI2" SWORD AngleCrS 1 100 -768.0000 767.9766 FORMAT "%8.4" ECU_ADDRESS 0x8FF6DC /end MEASUREMENT
/begin MEASUREMENT InjVCD_pInET_mp "X-Eingang des Kennfeldes InjVCD_tiET_MAP auf dem Appplikationswerkzeug" SWORD Pres_Rail 1 100 -3276.800 3276.700 FORMAT "%5.3" ECU_ADDRESS 0x8FF648 /end MEASUREMENT
/begin MEASUREMENT InjVCD_pPolar_mp "Raildruck zum Zeitpunkt der Polarisierung" SWORD Pres_Rail 1 100 -3276.800 3276.700 FORMAT "%5.3" ECU_ADDRESS 0x8FF6B4 /end MEASUREMENT
/begin MEASUREMENT InjVCD_PZOSWType "SW-Identifikation" ULONG OneToOne 1 100 0.00 4294967295.00 FORMAT "%13.2" ECU_ADDRESS 0x7F9220 /end MEASUREMENT
/begin MEASUREMENT InjVCD_qInZFCETGMap_mp "Menge fuer Eingangsanzeige der Gruppenkennfelder InjVCD_rZFCETMsk_GMAP, ...Dif0_GMAP, ...Dif1_GMAP" SWORD InjMassInj 1 100 -327.6800 327.6700 FORMAT "%8.4" ECU_ADDRESS 0x8FF6EE /end MEASUREMENT
/begin MEASUREMENT InjVCD_rCapThresHigh_mp "berechnetes Kapazitätsverhältnis der überwachten Aktoren (Schwelle high)" SWORD Fact 1 100 -4.000000 3.999878 FORMAT "%8.6" ECU_ADDRESS 0x8FF670 /end MEASUREMENT
/begin MEASUREMENT InjVCD_rCapThresLow_mp "berechnetes Kapazitätsverhältnis der überwachten Aktoren (Schwelle low)" SWORD Fact 1 100 -4.000000 3.999878 FORMAT "%8.6" ECU_ADDRESS 0x8FF672 /end MEASUREMENT
/begin MEASUREMENT InjVCD_rCapUpCurrToKx_mp "berechnetes Verhältnis der Aktorkapazitäten (aktuell zu alt)" SWORD Fact 1 100 -4.000000 3.999878 FORMAT "%8.6" ECU_ADDRESS 0x8FF674 /end MEASUREMENT
/begin MEASUREMENT InjVCD_rCapUpKxToCurr_mp "berechnetes Verhältnis der Aktorkapazitäten (alt zu aktuell)" SWORD Fact 1 100 -4.000000 3.999878 FORMAT "%8.6" ECU_ADDRESS 0x8FF676 /end MEASUREMENT
/begin MEASUREMENT InjVCD_regCY370Bank "Bank-selektives Register des CY370" UBYTE OneToOne 1 100 0.00 255.0 FORMAT "%5.1" ECU_ADDRESS 0x7F8915 /end MEASUREMENT
/begin MEASUREMENT InjVCD_regCY370CylISel "Zylinder-selektives Register des CY370 (ISel)" UBYTE OneToOne 1 100 0.00 255.0 FORMAT "%5.1" ECU_ADDRESS 0x7F8916 /end MEASUREMENT
/begin MEASUREMENT InjVCD_regCY370Global "Globales Register des CY370" UBYTE OneToOne 1 100 0.00 255.0 FORMAT "%5.1" ECU_ADDRESS 0x7F8917 /end MEASUREMENT
/begin MEASUREMENT InjVCD_regCY370ID_mp "Chip-ID des CY370" UBYTE OneToOne 1 100 0.00 255.0 FORMAT "%5.1" ECU_ADDRESS 0x8FF5F6 /end MEASUREMENT
/begin MEASUREMENT InjVCD_regCY370Status "Status-Register des CY370" UBYTE OneToOne 1 100 0.00 255.0 FORMAT "%5.1" ECU_ADDRESS 0x7F8918 /end MEASUREMENT
/begin MEASUREMENT InjVCD_rTiChrgUpCurrToKx_mp "Verhaeltnis vo aktueller Ladezeit zu vorletzter Ladezeit" SWORD Fact 1 100 -4.000000 3.999878 FORMAT "%8.6" ECU_ADDRESS 0x8FF678 /end MEASUREMENT
/begin MEASUREMENT InjVCD_rTiChrgUpKxToCurr_mp "Verhaeltnis von vorletzter Aktorladezeit zu aktueller Aktorladezeit" SWORD Fact 1 100 -4.000000 3.999878 FORMAT "%8.6" ECU_ADDRESS 0x8FF67A /end MEASUREMENT
/begin MEASUREMENT InjVCD_rTiChrgUpThresHigh_mp "Oberes Verhaeltnis der Aktorladezeit aktuell/alt zur Erkennung eines Lowside Schalter Kurzschlusses" SWORD Fact 1 100 -4.000000 3.999878 FORMAT "%8.6" ECU_ADDRESS 0x8FF67C /end MEASUREMENT
/begin MEASUREMENT InjVCD_rTiChrgUpThresLow_mp "Unteres Verhaeltnis der Aktorladezeit aktuell/alt zur Erkennung eines Lowside Schalter Kurzschlusses" SWORD Fact 1 100 -4.000000 3.999878 FORMAT "%8.6" ECU_ADDRESS 0x8FF67E /end MEASUREMENT
/begin MEASUREMENT InjVCD_rZFCETCoeffDif_mp "Bewertungsfaktoren fuer Ansteuerdauerkorrektur durch Nullmengenkalibrierung" SWORD Prc 1 100 -400.0000 399.9878 FORMAT "%8.4" ARRAY_SIZE 3 ECU_ADDRESS 0x8FF6E6 /end MEASUREMENT
/begin MEASUREMENT InjVCD_rZFCETCoeffMsk_mp "Gesamtbewertungsfaktor der Ansteuerdauerkorrektur durch Nullmengenkalibrierung" SWORD Prc 1 100 -400.0000 399.9878 FORMAT "%8.4" ECU_ADDRESS 0x8FF6EC /end MEASUREMENT
/begin MEASUREMENT InjVCD_stBufC "Status des DC/DC-Wandler Komponententreibers" UBYTE OneToOne 1 100 0.00 255.0 FORMAT "%5.1" ECU_ADDRESS 0x7F891B /end MEASUREMENT
/begin MEASUREMENT InjVCD_stClsActr "Status der Piezoaktor-Klassifizierung" UBYTE Actr_Cls_State 1 100 0.00 4.00000000000 FORMAT "%13.11" ECU_ADDRESS 0x7F891E /end MEASUREMENT
/begin MEASUREMENT InjVCD_stCY370Buf "Buffer(kondensator)status" UBYTE OneToOne 1 100 0.00 255.0 FORMAT "%5.1" ECU_ADDRESS 0x7F891C /end MEASUREMENT
/begin MEASUREMENT InjVCD_stCY370Event_mp "Rueckgabewert des single event (0 = kein Fehler)" UBYTE OneToOne 1 100 0.00 255.0 FORMAT "%5.1" ECU_ADDRESS 0x8FF5F7 /end MEASUREMENT
/begin MEASUREMENT InjVCD_stInjBegMI1_mp "Status der Beginnprogrammierung der Haupteinspritzung" UBYTE OneToOne 1 100 0.00 255.0 FORMAT "%5.1" ECU_ADDRESS 0x8FF6CC /end MEASUREMENT
/begin MEASUREMENT InjVCD_stInjBegPiI1_mp "Status der Förderbeginnprogrammierung für die Voreinspritzung" UBYTE OneToOne 1 100 0.00 255.0 FORMAT "%5.1" ECU_ADDRESS 0x8FF6D2 /end MEASUREMENT
/begin MEASUREMENT InjVCD_stInjBegPiI2_mp "Status der Einspritzbeginnprogrammierung für PiI2" UBYTE OneToOne 1 100 0.00 255.0 FORMAT "%5.1" ECU_ADDRESS 0x8FF6D8 /end MEASUREMENT
/begin MEASUREMENT InjVCD_stInjBegPiI3_mp "Status der Einspritzbeginnprogrammierung PiI3" UBYTE OneToOne 1 100 0.00 255.0 FORMAT "%5.1" ECU_ADDRESS 0x8FF6DE /end MEASUREMENT
/begin MEASUREMENT InjVCD_stInjBegPoI1_mp "Status der Einspritzbeginnprogrammierung PoI1" UBYTE OneToOne 1 100 0.00 255.0 FORMAT "%5.1" ECU_ADDRESS 0x8FF6E2 /end MEASUREMENT
/begin MEASUREMENT InjVCD_stInjBegPoI2_mp "Status der Förderbeginnprogrammierung der Nacheinspritzung" UBYTE OneToOne 1 100 0.00 255.0 FORMAT "%5.1" ECU_ADDRESS 0x8FF6E3 /end MEASUREMENT
/begin MEASUREMENT InjVCD_stInjMI1_mp "Status der Haupteinspritzung-1-Programmierung" UBYTE OneToOne 1 100 0.00 255.0 FORMAT "%5.1" ECU_ADDRESS 0x8FF6C4 /end MEASUREMENT
/begin MEASUREMENT InjVCD_stInjMI2_mp "Status der Haupteinspritzung-2-Programmierung" UBYTE OneToOne 1 100 0.00 255.0 FORMAT "%5.1" ECU_ADDRESS 0x8FF6C5 /end MEASUREMENT
/begin MEASUREMENT InjVCD_stInjPiI1_mp "Status der Voreinspritzung-1-Programmierung" UBYTE OneToOne 1 100 0.00 255.0 FORMAT "%5.1" ECU_ADDRESS 0x8FF6C6 /end MEASUREMENT
/begin MEASUREMENT InjVCD_stInjPiI2_mp "Status der Voreinspritzung-2-Programmierung" UBYTE OneToOne 1 100 0.00 255.0 FORMAT "%5.1" ECU_ADDRESS 0x8FF6C7 /end MEASUREMENT
/begin MEASUREMENT InjVCD_stInjPiI3_mp "Status der Voreinspritzung-3-Programmierung" UBYTE OneToOne 1 100 0.00 255.0 FORMAT "%5.1" ECU_ADDRESS 0x8FF6C8 /end MEASUREMENT
/begin MEASUREMENT InjVCD_stInjPoI1_mp "Status der Nacheinspritzung-1-Programmierung" UBYTE OneToOne 1 100 0.00 255.0 FORMAT "%5.1" ECU_ADDRESS 0x8FF6C9 /end MEASUREMENT
/begin MEASUREMENT InjVCD_stInjPoI2_mp "Status der Nacheinspritzung-2-Programmierung" UBYTE OneToOne 1 100 0.00 255.0 FORMAT "%5.1" ECU_ADDRESS 0x8FF6CA /end MEASUREMENT
/begin MEASUREMENT InjVCD_stInjTPUCM_mp "Kollisionsmanagerstatus" UBYTE OneToOne 1 100 0.00 255.0 FORMAT "%5.1" ECU_ADDRESS 0x8FF6DF /end MEASUREMENT
/begin MEASUREMENT InjVCD_stInjTPUErr_mp "TPU Fehlerstatus" UBYTE OneToOne 1 100 0.00 255.0 FORMAT "%5.1" ECU_ADDRESS 0x8FF6E0 /end MEASUREMENT
/begin MEASUREMENT InjVCD_stInjTPUShortDur_mp "Status zu kurze Ansteuerdauer programmiert" UBYTE OneToOne 1 100 0.00 255.0 FORMAT "%5.1" ECU_ADDRESS 0x8FF6E1 /end MEASUREMENT
/begin MEASUREMENT InjVCD_stInjZFC_mp "Status der ZFC Programmierung" UBYTE OneToOne 1 100 0.00 255.0 FORMAT "%5.1" ECU_ADDRESS 0x8FF6CB /end MEASUREMENT
/begin MEASUREMENT InjVCD_stMon "Status Injektordiangose in der Steuergeräteinitialisierung" UBYTE OneToOne 1 100 0.00 255.0 FORMAT "%5.1" ECU_ADDRESS 0x7F8923 /end MEASUREMENT
/begin MEASUREMENT InjVCD_stMonShCir "Status der Kurzschlussunterscheidung im Nachlauf" UBYTE stMonShCir 1 100 0.00 4.00000000000 FORMAT "%13.11" ECU_ADDRESS 0x7F8924 /end MEASUREMENT
/begin MEASUREMENT InjVCD_stPolar "Status der Polarisierung der Piezo-Aktoren" UBYTE OneToOne 1 100 0.00 255.0 FORMAT "%5.1" ECU_ADDRESS 0x7F8925 /end MEASUREMENT
/begin MEASUREMENT InjVCD_stPolarOvrlap_mp "Zustand=1: Polarisierung läuft im überlappenden Modus" SWORD OneToOne 1 100 -32768.00 32767.00 FORMAT "%8.2" ECU_ADDRESS 0x8FF6B6 /end MEASUREMENT
/begin MEASUREMENT InjVCD_stPolarPreCond_mp "Status: Vorbedingungen für Polarisierung erfüllt" UBYTE OneToOne 1 100 0.00 255.0 FORMAT "%5.1" ECU_ADDRESS 0x8FF6B8 /end MEASUREMENT
/begin MEASUREMENT InjVCD_stShOffDCDC "Status der Schutzabschaltung des DC/DC-Wandlers" UBYTE OneToOne 1 100 0.00 255.0 FORMAT "%5.1" ECU_ADDRESS 0x7F8927 /end MEASUREMENT
/begin MEASUREMENT InjVCD_stUBuf "Status der Bufferspannungsmessung" UBYTE OneToOne 1 100 0.00 255.0 FORMAT "%5.1" ECU_ADDRESS 0x7F8928 /end MEASUREMENT
/begin MEASUREMENT InjVCD_swtClsActr "Schalter zur Bestimmung der Aktorspannung für Piezoaktor-Klassifizierung" UBYTE Actr_Calc 1 100 0.00 1.00000000000 FORMAT "%13.11" ECU_ADDRESS 0x7F8929 /end MEASUREMENT
/begin MEASUREMENT InjVCD_tiCutAll_mp "Verkürzungszeit aller Kollisionen" SLONG InjTime_us 1 100 -2147483648.00 2147483647.00 FORMAT "%13.2" ECU_ADDRESS 0x8FF630 /end MEASUREMENT
/begin MEASUREMENT InjVCD_tiCutPrim_mp "Verkürzungszeit der Primärkollision" SLONG InjTime_us 1 100 -2147483648.00 2147483647.00 FORMAT "%13.2" ECU_ADDRESS 0x8FF634 /end MEASUREMENT
/begin MEASUREMENT InjVCD_tiCutScnd_mp "Verkürzungszeit der Sekundärkollision" SLONG InjTime_us 1 100 -2147483648.00 2147483647.00 FORMAT "%13.2" ECU_ADDRESS 0x8FF638 /end MEASUREMENT
/begin MEASUREMENT InjVCD_tiCY370ChrgRC "RC-Zeitkonstante vom CY370-Integrator für Ladungsberechnung" SWORD Time_Busy 1 100 -3276.800 3276.700 FORMAT "%8.3" ECU_ADDRESS 0x7F8F32 /end MEASUREMENT
/begin MEASUREMENT InjVCD_tiMonActrThresLo_mp "Zeitdifferenz zwischen Ladevorgang und Meßzeitpunkt" SLONG InjTime_us 1 100 -2147483648.00 2147483647.00 FORMAT "%13.2" ARRAY_SIZE 6 ECU_ADDRESS 0x8FF650 /end MEASUREMENT
/begin MEASUREMENT InjVCD_tiMonChrgUp_mp "Aktorladezeit im Nachlauf für Kurzschlussunterscheidung" SWORD Time_Busy 1 100 -3276.800 3276.700 FORMAT "%8.3" ARRAY_SIZE 6 ECU_ADDRESS 0x8FF680 /end MEASUREMENT
/begin MEASUREMENT InjVCD_tiMonShCirSort_mp "sortierte Aktorladezeiten" SWORD Time_Busy 1 100 -3276.800 3276.700 FORMAT "%8.3" ARRAY_SIZE 6 ECU_ADDRESS 0x8FF68C /end MEASUREMENT
/begin MEASUREMENT InjVCD_tiPiI1ZFCETCor_mp "Ansteuerdauerkorrektur der ZFC für Voreinspritzung 1 und jeden Zylinder" SWORD InjTime_us 1 100 -32768.00 32767.00 FORMAT "%8.2" ARRAY_SIZE 6 ECU_ADDRESS 0x6F8210 /end MEASUREMENT
/begin MEASUREMENT InjVCD_tiPiI2ZFCETCor_mp "Ansteuerdauerkorrektur der ZFC für Voreinspritzung 2 und jeden Zylinder" SWORD InjTime_us 1 100 -32768.00 32767.00 FORMAT "%8.2" ARRAY_SIZE 6 ECU_ADDRESS 0x6F821C /end MEASUREMENT
/begin MEASUREMENT InjVCD_tiPiI3ZFCETCor_mp "Ansteuerdauerkorrektur der ZFC für Voreinspritzung 3 und jeden Zylinder" SWORD InjTime_us 1 100 -32768.00 32767.00 FORMAT "%8.2" ARRAY_SIZE 6 ECU_ADDRESS 0x6F8228 /end MEASUREMENT
/begin MEASUREMENT InjVCD_tiPolarET_mp "Ansteuerdauer der Polarisierung" SWORD InjTime_us 1 100 -32768.00 32767.00 FORMAT "%8.2" ECU_ADDRESS 0x8FF6BA /end MEASUREMENT
/begin MEASUREMENT InjVCD_tiPolarPse_mp "Maximale Lade- / Entladezeit während der Polarisierung" SWORD InjTime_us 1 100 -32768.00 32767.00 FORMAT "%8.2" ECU_ADDRESS 0x8FF6BC /end MEASUREMENT
/begin MEASUREMENT InjVCD_tiShiftAll_mp "Verschiebezeit aller Kollisionen" SLONG InjTime_us 1 100 -2147483648.00 2147483647.00 FORMAT "%13.2" ECU_ADDRESS 0x8FF63C /end MEASUREMENT
/begin MEASUREMENT InjVCD_tiShiftPrim_mp "Verschiebezeit der Primärkollision" SLONG InjTime_us 1 100 -2147483648.00 2147483647.00 FORMAT "%13.2" ECU_ADDRESS 0x8FF640 /end MEASUREMENT
/begin MEASUREMENT InjVCD_tiShiftScnd_mp "Verschiebezeit der Sekundärkollision" SLONG InjTime_us 1 100 -2147483648.00 2147483647.00 FORMAT "%13.2" ECU_ADDRESS 0x8FF644 /end MEASUREMENT
/begin MEASUREMENT InjVCD_tPolar_mp "Kühlmitteltemperatur zum Zeitpunkt der Polarisierung" SWORD Temp_Cels 1 100 -50.140 899.860 FORMAT "%8.3" ECU_ADDRESS 0x8FF6BE /end MEASUREMENT
/begin MEASUREMENT InjVCD_uBuf "Wert der Bufferspannung" SWORD Volt_BUFC 1 100 -327.6800 327.6700 FORMAT "%8.4" ECU_ADDRESS 0x7F8F34 /end MEASUREMENT
/begin MEASUREMENT InjVCD_uBufRaw_mp "Rohwert der Bufferspannung" SWORD Volt 1 100 -160156.4 160151.5 FORMAT "%8.1" ECU_ADDRESS 0x8FF64E /end MEASUREMENT
/begin MEASUREMENT InjVCD_uCY370ChrgIntWp "Spannungs-Arbeitspunkt vom CY370-Integrator zur Ladungsberechnung" SWORD Volt 1 100 -160156.4 160151.5 FORMAT "%8.1" ECU_ADDRESS 0x7F8F36 /end MEASUREMENT
/begin MEASUREMENT InjVCD_uCY370ChrgOff "Spannungsoffset vom CY370-Integrator zur Ladungsberechnung" SWORD VoltInt 1 100 -160.1564 160.1515 FORMAT "%8.4" ECU_ADDRESS 0x7F8F38 /end MEASUREMENT
/begin MEASUREMENT InjVCD_uMonThresHi_mp "Schwelle fuer Spannungsplausibilisierung, Verletzung oben (index : 0=BOTT, 1=UP)" SWORD Volt_PA 1 100 -327.6800 327.6700 FORMAT "%8.4" ARRAY_SIZE 2 ECU_ADDRESS 0x8FF668 /end MEASUREMENT
/begin MEASUREMENT InjVCD_uMonThresLo_mp "Schwelle fuer Spannungsplausibilisierung, Verletzung unten (index : 0=BOTT, 1=UP)" SWORD Volt_PA 1 100 -327.6800 327.6700 FORMAT "%8.4" ARRAY_SIZE 2 ECU_ADDRESS 0x8FF66C /end MEASUREMENT
/begin MEASUREMENT InjVCD_uPolarBott_mp "Bottom-Niveau der Aktorspannung für die Polarisierung" SWORD Volt_PA 1 100 -327.6800 327.6700 FORMAT "%8.4" ECU_ADDRESS 0x8FF6C0 /end MEASUREMENT
/begin MEASUREMENT InjVCD_uPolarUp_mp "Bottom-Niveau der Aktorspannung für die Polarisierung" SWORD Volt_PA 1 100 -327.6800 327.6700 FORMAT "%8.4" ECU_ADDRESS 0x8FF6C2 /end MEASUREMENT
/begin MEASUREMENT InjVCD_uRawCY370Int0_mp "gemessene Roh-Spannung von Integratorabgleich (für INCA)" SWORD Volt 1 100 -160156.4 160151.5 FORMAT "%8.1" ECU_ADDRESS 0x8FF5F8 /end MEASUREMENT
/begin MEASUREMENT InjVCD_uRawCY370Int_mp "gemessene Roh-Spannungen vom Integratorabgleich" SWORD Volt 1 100 -160156.4 160151.5 FORMAT "%8.1" ARRAY_SIZE 3 ECU_ADDRESS 0x8FF5FA /end MEASUREMENT
/begin MEASUREMENT InjVCD_uValCY370Int_mp "linearisierte Spannungen von Integratorabgleich" SWORD Volt 1 100 -160156.4 160151.5 FORMAT "%8.1" ARRAY_SIZE 3 ECU_ADDRESS 0x8FF600 /end MEASUREMENT
/begin MEASUREMENT InjVCD_volInET_mp "Y-Eingang des Kennfeldes InjVCD_tiET_MAP auf dem Applikationswerkzeug" SWORD InjQntInj 1 100 -327.6800 327.6700 FORMAT "%8.4" ECU_ADDRESS 0x8FF64A /end MEASUREMENT
/begin MEASUREMENT InjVlv_ctMonActrMeas "Zaehler für gemessene Aktoren" UBYTE OneToOne 1 100 0.00 255.0 FORMAT "%5.1" ECU_ADDRESS 0x7F892B /end MEASUREMENT
/begin MEASUREMENT InjVlv_ctMonQckIDiff_mp "Anzahl der IDiff-Fehler zur Schnell-Erkennung der Kurzschlüsse nach Batterie und Masse" UBYTE OneToOne 1 100 0.00 255.0 FORMAT "%5.1" ECU_ADDRESS 0x8FF73C /end MEASUREMENT
/begin MEASUREMENT InjVlv_ctMonQckISel_mp "Anzahl der ISel-Fehler zur Schnell-Erkennung der Kurzschlüsse nach Batterie und Masse" UBYTE OneToOne 1 100 0.00 255.0 FORMAT "%5.1" ECU_ADDRESS 0x8FF73D /end MEASUREMENT
/begin MEASUREMENT InjVlv_facAddBalRls "Ergebniss aus Freigabekennfeld zur Aufrechnung der Mengenkorrektur als Array (zylinderspezifisch)" SWORD Fact 1 100 -4.000000 3.999878 FORMAT "%8.6" ARRAY_SIZE 6 ECU_ADDRESS 0x7F9414 /end MEASUREMENT
/begin MEASUREMENT InjVlv_facFTSWvCor "Faktor der Druckwellenkorrektur abhängig von der Kraftstofftemperatur" SWORD Fact 1 100 -4.000000 3.999878 FORMAT "%8.6" ECU_ADDRESS 0x7F8F3A /end MEASUREMENT
/begin MEASUREMENT InjVlv_facMI1PoI2WvCor_mp "Druckwellenkorrekturfaktor für PoI2" SWORD Fact1 1 100 -256.0000 255.9922 FORMAT "%8.4" ECU_ADDRESS 0x8FF7C8 /end MEASUREMENT
/begin MEASUREMENT InjVlv_facNVCActr "NVC-Faktor" SWORD Fact 1 100 -4.000000 3.999878 FORMAT "%8.6" ARRAY_SIZE 6 ECU_ADDRESS 0x7F9420 /end MEASUREMENT
/begin MEASUREMENT InjVlv_facNVCEepWrI_mp "Die I-Anteile der NVC-Regler, die im EEPROM-Spiegel geschrieben werden" SWORD Fact 1 100 -4.000000 3.999878 FORMAT "%8.6" ARRAY_SIZE 6 ECU_ADDRESS 0x8FF764 /end MEASUREMENT
/begin MEASUREMENT InjVlv_facNVCInitI_mp "Initialisierungswerte der I-Anteilen der NVC-Regler" SWORD Fact 1 100 -4.000000 3.999878 FORMAT "%8.6" ARRAY_SIZE 6 ECU_ADDRESS 0x8FF770 /end MEASUREMENT
/begin MEASUREMENT InjVlv_facPCorQ_mp "mengenabhängiger Korrekturfaktor für Druckwellenkorrektur" SWORD Fact 1 100 -4.000000 3.999878 FORMAT "%8.6" ECU_ADDRESS 0x8FF6FE /end MEASUREMENT
/begin MEASUREMENT InjVlv_facPCorTi_mp "einspritzabstandsabhängiger Korrekturfaktor für Druckwellenkorrektur" SWORD Fact 1 100 -4.000000 3.999878 FORMAT "%8.6" ECU_ADDRESS 0x8FF700 /end MEASUREMENT
/begin MEASUREMENT InjVlv_facPCor_mp "Korrekturfaktor für Druckwellenkorrektur" SWORD Fact 1 100 -4.000000 3.999878 FORMAT "%8.6" ECU_ADDRESS 0x8FF702 /end MEASUREMENT
/begin MEASUREMENT InjVlv_facPiI2PiI1WvCor_mp "Druckwellenkorrekturfaktor der PiI1" SWORD Fact1 1 100 -256.0000 255.9922 FORMAT "%8.4" ECU_ADDRESS 0x8FF7CA /end MEASUREMENT
/begin MEASUREMENT InjVlv_facPiIMI1WvCor_mp "Druckwellenkorrekturfaktor der MI1" SWORD Fact1 1 100 -256.0000 255.9922 FORMAT "%8.4" ECU_ADDRESS 0x8FF7CC /end MEASUREMENT
/begin MEASUREMENT InjVlv_facVoltCorUp "temperaturabhängiger Korrekturfaktor für Spannungssollwert" SWORD Fact 1 100 -4.000000 3.999878 FORMAT "%8.6" ECU_ADDRESS 0x7F8F3C /end MEASUREMENT
/begin MEASUREMENT InjVlv_iDCDC_mp "DCDC Strom" SWORD Curr 1 100 -32768.00 32767.00 FORMAT "%8.2" ECU_ADDRESS 0x8FF73A /end MEASUREMENT
/begin MEASUREMENT InjVlv_nCyl "Zylinderspezifische Drehzahl für alle Zylinder" SWORD EngN 1 100 -32768.00 32767.00 FORMAT "%8.2" ARRAY_SIZE 6 ECU_ADDRESS 0x7F942C /end MEASUREMENT
/begin MEASUREMENT InjVlv_numClsVltgAdjActr "zylinderspezifische ISA-Klasse" SWORD OneToOne 1 100 -32768.00 32767.00 FORMAT "%8.2" ARRAY_SIZE 6 ECU_ADDRESS 0x7F9438 /end MEASUREMENT
/begin MEASUREMENT InjVlv_numCodeVltgAdj_mp "Injektorspannungsabgleich Codes" UBYTE ISA_Code 1 100 0.00 31.0000000000 FORMAT "%13.10" ARRAY_SIZE 6 ECU_ADDRESS 0x8FF7A4 /end MEASUREMENT
/begin MEASUREMENT InjVlv_numIdxErrCyl1_mp "Indizes erkannter Muster für Zylinder 1" ULONG OneToOne 1 100 0.00 4294967295.00 FORMAT "%13.2" ECU_ADDRESS 0x8FF740 /end MEASUREMENT
/begin MEASUREMENT InjVlv_numIdxErrCyl2_mp "Indizes erkannter Muster für Zylinder 2" ULONG OneToOne 1 100 0.00 4294967295.00 FORMAT "%13.2" ECU_ADDRESS 0x8FF744 /end MEASUREMENT
/begin MEASUREMENT InjVlv_numIdxErrCyl3_mp "Indizes erkannter Muster für Zylinder 3" ULONG OneToOne 1 100 0.00 4294967295.00 FORMAT "%13.2" ECU_ADDRESS 0x8FF748 /end MEASUREMENT
/begin MEASUREMENT InjVlv_numIdxErrCyl4_mp "Indizes erkannter Muster für Zylinder 4" ULONG OneToOne 1 100 0.00 4294967295.00 FORMAT "%13.2" ECU_ADDRESS 0x8FF74C /end MEASUREMENT
/begin MEASUREMENT InjVlv_numIdxErrCyl5_mp "Indizes erkannter Muster für Zylinder 5" ULONG OneToOne 1 100 0.00 4294967295.00 FORMAT "%13.2" ECU_ADDRESS 0x8FF750 /end MEASUREMENT
/begin MEASUREMENT InjVlv_numIdxErrCyl6_mp "Indizes erkannter Muster für Zylinder 6" ULONG OneToOne 1 100 0.00 4294967295.00 FORMAT "%13.2" ECU_ADDRESS 0x8FF754 /end MEASUREMENT
/begin MEASUREMENT InjVlv_numIdxErrCyl7_mp "Indizes erkannter Muster für Zylinder 7" ULONG OneToOne 1 100 0.00 4294967295.00 FORMAT "%13.2" ECU_ADDRESS 0x8FF758 /end MEASUREMENT
/begin MEASUREMENT InjVlv_numIdxErrCyl8_mp "Indizes erkannter Muster für Zylinder 8" ULONG OneToOne 1 100 0.00 4294967295.00 FORMAT "%13.2" ECU_ADDRESS 0x8FF75C /end MEASUREMENT
/begin MEASUREMENT InjVlv_numInjChrgBal_mp "Maximale Anzahl an Einspritzungen aufgrund der Ladungsbilanz des Boosterkondensators" UBYTE OneToOne 1 100 0.00 255.0 FORMAT "%5.1" ECU_ADDRESS 0x8FF738 /end MEASUREMENT
/begin MEASUREMENT InjVlv_pActInDiffHyd_mp "Aktueller Raildruck als Eingangswert für das Kennfeld InjVlv_tiDiffHydMAP" SWORD Pres_Rail 1 100 -3276.800 3276.700 FORMAT "%5.3" ECU_ADDRESS 0x8FF7BA /end MEASUREMENT
/begin MEASUREMENT InjVlv_pAct_mp "aktueller Raildruck ermittelt in InjVlv" SWORD Pres_Rail 1 100 -3276.800 3276.700 FORMAT "%5.3" ECU_ADDRESS 0x8FF7C6 /end MEASUREMENT
/begin MEASUREMENT InjVlv_pCalcVolt "für die Aktorspannungsberechnung relevanter Raildruck" SWORD Pres_Rail 1 100 -3276.800 3276.700 FORMAT "%5.3" ECU_ADDRESS 0x7F8F3E /end MEASUREMENT
/begin MEASUREMENT InjVlv_pCorBase_mp "Raildruck-Korrekturgrundwert für Druckwellenkorrektur" SWORD Pres_Rail 1 100 -3276.800 3276.700 FORMAT "%5.3" ECU_ADDRESS 0x8FF704 /end MEASUREMENT
/begin MEASUREMENT InjVlv_pPoI2WvCorOfsActr_mp "zyl. spezifischer Raildruck-Offset für Druckwellenkorrektur von PoI2" SWORD Pres_Rail 1 100 -3276.800 3276.700 FORMAT "%5.3" ARRAY_SIZE 6 ECU_ADDRESS 0x8FF706 /end MEASUREMENT
/begin MEASUREMENT InjVlv_pRailCorPoI2Actr_mp "zyl. spezifischer druckwellenkorrigierter Raildruck für PoI2" SWORD Pres_Rail 1 100 -3276.800 3276.700 FORMAT "%5.3" ARRAY_SIZE 6 ECU_ADDRESS 0x8FF712 /end MEASUREMENT
/begin MEASUREMENT InjVlv_pwrInjAvrg_mp "durchschnittliche Ansteuer-Verlustleistung bei einer Ansteuerung pro Zylinder und Arbeitshub" SWORD Pwr_PA 1 100 -32768.00 32767.00 FORMAT "%8.2" ECU_ADDRESS 0x8FF730 /end MEASUREMENT
/begin MEASUREMENT InjVlv_qDesInDiffHyd_mp "Gewünschte Einspritzmenge als Eingangswert für das Kennfeld InjVlv_tiDiffHydMAP" SWORD InjMassInj 1 100 -327.6800 327.6700 FORMAT "%8.4" ECU_ADDRESS 0x8FF7BC /end MEASUREMENT
/begin MEASUREMENT InjVlv_qDes_mp "Einspritzmenge für Druckwellenkorrektur" SWORD InjMassInj 1 100 -327.6800 327.6700 FORMAT "%8.4" ECU_ADDRESS 0x8FF71E /end MEASUREMENT
/begin MEASUREMENT InjVlv_qFBCCyl "Zylinderselektive FBC-Mengenkorrektur für alle Zylinder" SWORD InjMass 1 100 -327.6800 327.6700 FORMAT "%8.4" ARRAY_SIZE 6 ECU_ADDRESS 0x7F9444 /end MEASUREMENT
/begin MEASUREMENT InjVlv_qMI1Bal_mp "Korrekturmenge Haupteinspritzung 1" SWORD InjMassInj 1 100 -327.6800 327.6700 FORMAT "%8.4" ECU_ADDRESS 0x8FF6F0 /end MEASUREMENT
/begin MEASUREMENT InjVlv_qMI1PoI2WvCor_mp "Grundwert der Druckwellenkorrekturmenge der PoI2" SWORD InjMassInj 1 100 -327.6800 327.6700 FORMAT "%8.4" ECU_ADDRESS 0x8FF7CE /end MEASUREMENT
/begin MEASUREMENT InjVlv_qMI1WvCor_mp "Druckwellenkorrekturmenge der MI1" SWORD InjMassInj 1 100 -327.6800 327.6700 FORMAT "%8.4" ECU_ADDRESS 0x8FF7D0 /end MEASUREMENT
/begin MEASUREMENT InjVlv_qPiI1Bal_mp "Korrekturmenge Voreinspritzung 1" SWORD InjMassInj 1 100 -327.6800 327.6700 FORMAT "%8.4" ECU_ADDRESS 0x8FF6F2 /end MEASUREMENT
/begin MEASUREMENT InjVlv_qPiI1MI1WvCor_mp "Grundwert der Druckwellenkorrekturmenge der MI1 abhängig von PiI1" SWORD InjMassInj 1 100 -327.6800 327.6700 FORMAT "%8.4" ECU_ADDRESS 0x8FF7D2 /end MEASUREMENT
/begin MEASUREMENT InjVlv_qPiI1WvCor_mp "Druckwellenkorrekturmenge der PiI1" SWORD InjMassInj 1 100 -327.6800 327.6700 FORMAT "%8.4" ECU_ADDRESS 0x8FF7D4 /end MEASUREMENT
/begin MEASUREMENT InjVlv_qPiI2Bal_mp "Korrekturmenge Voreinspritzung 2" SWORD InjMassInj 1 100 -327.6800 327.6700 FORMAT "%8.4" ECU_ADDRESS 0x8FF6F4 /end MEASUREMENT
/begin MEASUREMENT InjVlv_qPiI2MI1WvCor_mp "Grundwert der Druckwellenkorrekturmenge der MI1 abhängig von PiI2" SWORD InjMassInj 1 100 -327.6800 327.6700 FORMAT "%8.4" ECU_ADDRESS 0x8FF7D6 /end MEASUREMENT
/begin MEASUREMENT InjVlv_qPiI2PiI1WvCor_mp "Grundwert der Druckwellenkorrekturmenge der PiI1" SWORD InjMassInj 1 100 -327.6800 327.6700 FORMAT "%8.4" ECU_ADDRESS 0x8FF7D8 /end MEASUREMENT
/begin MEASUREMENT InjVlv_qPiI3Bal_mp "Korrekturmenge Voreinspritzung 3" SWORD InjMassInj 1 100 -327.6800 327.6700 FORMAT "%8.4" ECU_ADDRESS 0x8FF6F6 /end MEASUREMENT
/begin MEASUREMENT InjVlv_qPoI1Bal_mp "Korrekturmenge Nacheinspritzung 1" SWORD InjMassInj 1 100 -327.6800 327.6700 FORMAT "%8.4" ECU_ADDRESS 0x8FF6F8 /end MEASUREMENT
/begin MEASUREMENT InjVlv_qPoI2BalEff_mp "Korrekturmenge für Nacheinspritzung 2, Moment bildender Teil" SWORD InjMassInj 1 100 -327.6800 327.6700 FORMAT "%8.4" ECU_ADDRESS 0x8FF6FA /end MEASUREMENT
/begin MEASUREMENT InjVlv_qPoI2Bal_mp "Korrekturmenge Nacheinspritzung 2" SWORD InjMassInj 1 100 -327.6800 327.6700 FORMAT "%8.4" ECU_ADDRESS 0x8FF6FC /end MEASUREMENT
/begin MEASUREMENT InjVlv_qPoI2WvCor_mp "Druckwellenkorrekturmenge der PoI2" SWORD InjMassInj 1 100 -327.6800 327.6700 FORMAT "%8.4" ECU_ADDRESS 0x8FF7DA /end MEASUREMENT
/begin MEASUREMENT InjVlv_qWvCorNorm "Einspritznormierungsmenge" SWORD InjMassInj 1 100 -327.6800 327.6700 FORMAT "%8.4" ECU_ADDRESS 0x7F8F40 /end MEASUREMENT
/begin MEASUREMENT InjVlv_rMI1WvCorNorm_mp "Raildruckabhängiges normiertes MI1 Einspritzverhältnis für Druckwellenkorrektur" SWORD QntR 1 100 -32.00000 31.99902 FORMAT "%8.5" ECU_ADDRESS 0x8FF7DC /end MEASUREMENT
/begin MEASUREMENT InjVlv_stAdj_mp "Zustand der Codes für den Injektorspannungsabgleich" UBYTE VltgAdj 1 100 0.00 8.00000000000 FORMAT "%13.11" ECU_ADDRESS 0x8FF7AA /end MEASUREMENT
/begin MEASUREMENT InjVlv_stCheckSumErrVltgAdj_mp "Ckecksummenfehler der Abgleichwerte" UBYTE OneToOne 1 100 0.00 255.0 FORMAT "%5.1" ECU_ADDRESS 0x8FF7AB /end MEASUREMENT
/begin MEASUREMENT InjVlv_stErrClctCyl1 "gesammelte Fehlermeldungen für Zylinder 1" ULONG OneToOne 1 100 0.00 4294967295.00 FORMAT "%13.2" ECU_ADDRESS 0x7F9228 /end MEASUREMENT
/begin MEASUREMENT InjVlv_stErrClctCyl2 "gesammelte Fehlermeldungen für Zylinder 2" ULONG OneToOne 1 100 0.00 4294967295.00 FORMAT "%13.2" ECU_ADDRESS 0x7F922C /end MEASUREMENT
/begin MEASUREMENT InjVlv_stErrClctCyl3 "gesammelte Fehlermeldungen für Zylinder 3" ULONG OneToOne 1 100 0.00 4294967295.00 FORMAT "%13.2" ECU_ADDRESS 0x7F9230 /end MEASUREMENT
/begin MEASUREMENT InjVlv_stErrClctCyl4 "gesammelte Fehlermeldungen für Zylinder 4" ULONG OneToOne 1 100 0.00 4294967295.00 FORMAT "%13.2" ECU_ADDRESS 0x7F9234 /end MEASUREMENT
/begin MEASUREMENT InjVlv_stErrClctCyl5 "gesammelte Fehlermeldungen für Zylinder 5" ULONG OneToOne 1 100 0.00 4294967295.00 FORMAT "%13.2" ECU_ADDRESS 0x7F9238 /end MEASUREMENT
/begin MEASUREMENT InjVlv_stErrClctCyl6 "gesammelte Fehlermeldungen für Zylinder 6" ULONG OneToOne 1 100 0.00 4294967295.00 FORMAT "%13.2" ECU_ADDRESS 0x7F923C /end MEASUREMENT
/begin MEASUREMENT InjVlv_stErrClctCyl7 "gesammelte Fehlermeldungen für Zylinder 7" ULONG OneToOne 1 100 0.00 4294967295.00 FORMAT "%13.2" ECU_ADDRESS 0x7F9240 /end MEASUREMENT
/begin MEASUREMENT InjVlv_stErrClctCyl8 "gesammelte Fehlermeldungen für Zylinder 8" ULONG OneToOne 1 100 0.00 4294967295.00 FORMAT "%13.2" ECU_ADDRESS 0x7F9244 /end MEASUREMENT
/begin MEASUREMENT InjVlv_stErrUnknown_mp "Fehlermuster des letzten nicht klassifizierbaren Fehlers" ULONG OneToOne 1 100 0.00 4294967295.00 FORMAT "%13.2" ECU_ADDRESS 0x8FF760 /end MEASUREMENT
/begin MEASUREMENT InjVlv_stInjValve "Zustand des Einspritzventils" UBYTE OneToOne 1 100 0.00 255.0 FORMAT "%5.1" ECU_ADDRESS 0x7F892C /end MEASUREMENT
/begin MEASUREMENT InjVlv_stMaxErrVltgAdj_mp "Aktorspezifischer Maximum Fehler im Code für den Injektorspannungsabgleich" UBYTE OneToOne 1 100 0.00 255.0 FORMAT "%5.1" ECU_ADDRESS 0x8FF7AC /end MEASUREMENT
/begin MEASUREMENT InjVlv_stMonDiag "Zustand Diagnose (0 : gesperrt, 1 : freigegeben)" UBYTE OneToOne 1 100 0.00 255.0 FORMAT "%5.1" ECU_ADDRESS 0x7F892D /end MEASUREMENT
/begin MEASUREMENT InjVlv_stMonQckErr_mp "Status der Schnell-Erkennung der Kurzschlüsse nach Batterie und Masse" UBYTE OneToOne 1 100 0.00 255.0 FORMAT "%5.1" ECU_ADDRESS 0x8FF73E /end MEASUREMENT
/begin MEASUREMENT InjVlv_stNVCCrit_mp "Statusanzeige der Kriterien für die Freigabe der NVC" UBYTE OneToOne 1 100 0.00 255.0 FORMAT "%5.1" ECU_ADDRESS 0x8FF77C /end MEASUREMENT
/begin MEASUREMENT InjVlv_stNVCEna "zylinderspezifische Anzeige, ob die NVC aktiv ist" UBYTE OneToOne 1 100 0.00 255.0 FORMAT "%5.1" ECU_ADDRESS 0x7F892E /end MEASUREMENT
/begin MEASUREMENT InjVlv_stNVCPI "Statusanzeige des NVC-Reglers" UBYTE OneToOne 1 100 0.00 255.0 FORMAT "%5.1" ARRAY_SIZE 6 ECU_ADDRESS 0x7F92D0 /end MEASUREMENT
/begin MEASUREMENT InjVlv_stWvCor "Status der Druckwellenkorrektur" UBYTE OneToOne 1 100 0.00 255.0 FORMAT "%5.1" ECU_ADDRESS 0x7F892F /end MEASUREMENT
/begin MEASUREMENT InjVlv_tActr_mp "Temperatur des Piezo-Aktors" SWORD Temp_Cels 1 100 -50.140 899.860 FORMAT "%8.3" ECU_ADDRESS 0x8FF720 /end MEASUREMENT
/begin MEASUREMENT InjVlv_tiMI1DiffHydCor_mp "Differenz zwischen hydraulischem Nadelschliessende und elektrischem Ansteuerende des Injektors für die MI1" SWORD InjTime_us 1 100 -32768.00 32767.00 FORMAT "%8.2" ECU_ADDRESS 0x8FF7BE /end MEASUREMENT
/begin MEASUREMENT InjVlv_tiMI1PoI2Cor_mp "korrigierter Zeitabstand Ende MI1 bis Beginn PoI2" SWORD InjTime_us 1 100 -32768.00 32767.00 FORMAT "%8.2" ECU_ADDRESS 0x8FF7DE /end MEASUREMENT
/begin MEASUREMENT InjVlv_tiMI1PoI2HydCor_mp "hyd. korrigierter Zeitabstand Ende MI1 bis Beginn PoI2" UWORD InjTime_us 1 100 0.00 65535.00 FORMAT "%8.2" ECU_ADDRESS 0x8FF7E0 /end MEASUREMENT
/begin MEASUREMENT InjVlv_tiMI1PoI2_mp "Zeitabstand ende MI1 bis Beginn PoI2" UWORD InjTime_us 1 100 0.00 65535.00 FORMAT "%8.2" ECU_ADDRESS 0x8FF7E2 /end MEASUREMENT
/begin MEASUREMENT InjVlv_tiPiI1DiffHydCor_mp "Differenz zwischen hydraulischem Nadelschliessende und elektrischem Ansteuerende des Injektors für die PiI1" SWORD InjTime_us 1 100 -32768.00 32767.00 FORMAT "%8.2" ECU_ADDRESS 0x8FF7C0 /end MEASUREMENT
/begin MEASUREMENT InjVlv_tiPiI1MI1Cor_mp "korrigierter Zeitabstand Ende PiI1 bis Beginn MI1" SWORD InjTime_us 1 100 -32768.00 32767.00 FORMAT "%8.2" ECU_ADDRESS 0x8FF7E4 /end MEASUREMENT
/begin MEASUREMENT InjVlv_tiPiI1MI1_mp "korrigierter Zeitabstand Ende PiI1 bis Beginn MI1" UWORD InjTime_us 1 100 0.00 65535.00 FORMAT "%8.2" ECU_ADDRESS 0x8FF7E6 /end MEASUREMENT
/begin MEASUREMENT InjVlv_tiPiI2DiffHydCor_mp "Differenz zwischen hydraulischem Nadelschliessende und elektrischem Ansteuerende des Injektors für die PiI2" SWORD InjTime_us 1 100 -32768.00 32767.00 FORMAT "%8.2" ECU_ADDRESS 0x8FF7C2 /end MEASUREMENT
/begin MEASUREMENT InjVlv_tiPiI2MI1Cor_mp "korrigierter Zeitabstand Ende PiI2 bis Beginn MI1" SWORD InjTime_us 1 100 -32768.00 32767.00 FORMAT "%8.2" ECU_ADDRESS 0x8FF7E8 /end MEASUREMENT
/begin MEASUREMENT InjVlv_tiPiI2MI1_mp "Zeitabstand Ende PiI2 bis Beginn MI1" UWORD InjTime_us 1 100 0.00 65535.00 FORMAT "%8.2" ECU_ADDRESS 0x8FF7EA /end MEASUREMENT
/begin MEASUREMENT InjVlv_tiPiI2PiI1Cor_mp "korrigierter Zeitabstand Ende PiI2 bis Beginn PiI1" SWORD InjTime_us 1 100 -32768.00 32767.00 FORMAT "%8.2" ECU_ADDRESS 0x8FF7EC /end MEASUREMENT
/begin MEASUREMENT InjVlv_tiPiI2PiI1_mp "Zeitabstand Ende PiI2 bis Beginn PiI1" UWORD InjTime_us 1 100 0.00 65535.00 FORMAT "%8.2" ECU_ADDRESS 0x8FF7EE /end MEASUREMENT
/begin MEASUREMENT InjVlv_tWvCor_mp "Eingangstemperatur fuer die Druckwellenkorrektur" SWORD Temp_Cels 1 100 -50.140 899.860 FORMAT "%8.3" ECU_ADDRESS 0x8FF7C4 /end MEASUREMENT
/begin MEASUREMENT InjVlv_uDiffNVCActrInPI_mp "Eingangswert der NVC-Reglers" SWORD Volt_PA 1 100 -327.6800 327.6700 FORMAT "%8.4" ARRAY_SIZE 6 ECU_ADDRESS 0x8FF77E /end MEASUREMENT
/begin MEASUREMENT InjVlv_uDiffNVCActr_mp "aktuelle Spannungsdifferenz" SWORD Volt_PA 1 100 -327.6800 327.6700 FORMAT "%8.4" ARRAY_SIZE 6 ECU_ADDRESS 0x8FF78A /end MEASUREMENT
/begin MEASUREMENT InjVlv_uDiffNVCSet_mp "Spannungssolldifferenz" SWORD Volt_PA 1 100 -327.6800 327.6700 FORMAT "%8.4" ECU_ADDRESS 0x8FF796 /end MEASUREMENT
/begin MEASUREMENT InjVlv_uOfsBand "Band aus Sollspannungswerten" SWORD Volt_PA 1 100 -327.6800 327.6700 FORMAT "%8.4" ARRAY_SIZE 11 ECU_ADDRESS 0x7F94A0 /end MEASUREMENT
/begin MEASUREMENT InjVlv_uSetBase_mp "Basiswert zur Ermittlung der Spannungsbänder" SWORD Volt_PA 1 100 -327.6800 327.6700 FORMAT "%8.4" ECU_ADDRESS 0x8FF72E /end MEASUREMENT
/begin MEASUREMENT InjVlv_uSetBott "Minimaler Spannungssollwert für Piezo-Aktor bottom-level" SWORD Volt_PA 1 100 -327.6800 327.6700 FORMAT "%8.4" ECU_ADDRESS 0x7F8F42 /end MEASUREMENT
/begin MEASUREMENT InjVlv_uSetUpActr "Mittlerer zylinderspezifischer Spannungssollwert für Piezo-Aktor (up-level)" SWORD Volt_PA 1 100 -327.6800 327.6700 FORMAT "%8.4" ARRAY_SIZE 6 ECU_ADDRESS 0x7F9450 /end MEASUREMENT
/begin MEASUREMENT InjVlv_uSetUpActrPoI2_mp "zyl. spezifischer Piezoaktor-Spannungssollwert für PoI2 (Up-Niveau)" SWORD Volt_PA 1 100 -327.6800 327.6700 FORMAT "%8.4" ARRAY_SIZE 6 ECU_ADDRESS 0x8FF722 /end MEASUREMENT
/begin MEASUREMENT InjVlv_uSetUpAvrg_mp "Gemittelter Spannungssollwert" SWORD Volt_PA 1 100 -327.6800 327.6700 FORMAT "%8.4" ECU_ADDRESS 0x8FF732 /end MEASUREMENT
/begin MEASUREMENT InjVlv_uSetUpNVCActr "Stellspannung nach der NVC" SWORD Volt_PA 1 100 -327.6800 327.6700 FORMAT "%8.4" ARRAY_SIZE 6 ECU_ADDRESS 0x7F945C /end MEASUREMENT
/begin MEASUREMENT InjVlv_uSetUpNVCActrUnLim_mp "unbegrenzte Stellspannung nach der NVC" SWORD Volt_PA 1 100 -327.6800 327.6700 FORMAT "%8.4" ARRAY_SIZE 6 ECU_ADDRESS 0x8FF798 /end MEASUREMENT
/begin MEASUREMENT InjVlv_uSetUpTiChrgActr "Spannungssollwert für Ladezeitberechnung" SWORD Volt_PA 1 100 -327.6800 327.6700 FORMAT "%8.4" ARRAY_SIZE 6 ECU_ADDRESS 0x7F9468 /end MEASUREMENT
/begin MEASUREMENT InjVlv_volMI1QntAdj_mp "Injektor-Abgleichmenge der Haupteinspritzung 1" SWORD InjQntInj 1 100 -327.6800 327.6700 FORMAT "%8.4" ECU_ADDRESS 0x8FF7AE /end MEASUREMENT
/begin MEASUREMENT InjVlv_volPiI1QntAdj_mp "Injektor-Abgleichmenge der Voreinspritzung 1" SWORD InjQntInj 1 100 -327.6800 327.6700 FORMAT "%8.4" ECU_ADDRESS 0x8FF7B0 /end MEASUREMENT
/begin MEASUREMENT InjVlv_volPiI2QntAdj_mp "Injektor-Abgleichmenge der Voreinspritzung 2" SWORD InjQntInj 1 100 -327.6800 327.6700 FORMAT "%8.4" ECU_ADDRESS 0x8FF7B2 /end MEASUREMENT
/begin MEASUREMENT InjVlv_volPiI3QntAdj_mp "Injektor-Abgleichmenge der Voreinspritzung 3" SWORD InjQntInj 1 100 -327.6800 327.6700 FORMAT "%8.4" ECU_ADDRESS 0x8FF7B4 /end MEASUREMENT
/begin MEASUREMENT InjVlv_volPoI1QntAdj_mp "Injektor-Abgleichmenge der Nacheinspritzung 1" SWORD InjQntInj 1 100 -327.6800 327.6700 FORMAT "%8.4" ECU_ADDRESS 0x8FF7B6 /end MEASUREMENT
/begin MEASUREMENT InjVlv_volPoI2QntAdj_mp "Injektor-Abgleichmenge der Nacheinspritzung 2" SWORD InjQntInj 1 100 -327.6800 327.6700 FORMAT "%8.4" ECU_ADDRESS 0x8FF7B8 /end MEASUREMENT
/begin MEASUREMENT InjVlv_wInjCorr_mp "Korrigierter, bufferseitiger Energieverbrauch einer Piezo-Aktor-Ansteuerung" SWORD W_PA 1 100 -32768.00 32767.00 FORMAT "%8.2" ECU_ADDRESS 0x8FF734 /end MEASUREMENT
/begin MEASUREMENT InjVlv_wInjNom_mp "Nominaler, bufferseitiger Energieverbrauch einer Piezo-Aktor-Ansteuerung" SWORD W_PA 1 100 -32768.00 32767.00 FORMAT "%8.2" ECU_ADDRESS 0x8FF736 /end MEASUREMENT
/begin MEASUREMENT IVCtl_iChrgUp2_mp "zweite Stromgrenze für Piezoaktor Laden" SWORD Curr 1 100 -32768.00 32767.00 FORMAT "%8.2" ECU_ADDRESS 0x8FF7F0 /end MEASUREMENT
/begin MEASUREMENT IVCtl_iChrgUpPI_mp "Reglerausgang Ladezeitregler" SWORD Curr 1 100 -32768.00 32767.00 FORMAT "%8.2" ECU_ADDRESS 0x8FF7F2 /end MEASUREMENT
/begin MEASUREMENT IVCtl_iChrgUp_mp "Ladestrom für Aktor" SWORD Curr 1 100 -32768.00 32767.00 FORMAT "%8.2" ECU_ADDRESS 0x8FF7F4 /end MEASUREMENT
/begin MEASUREMENT IVCtl_iDisChDwn "Entladestrom für Piezoaktor" SWORD Curr 1 100 -32768.00 32767.00 FORMAT "%8.2" ECU_ADDRESS 0x7F8DEA /end MEASUREMENT
/begin MEASUREMENT IVCtl_iDisChDwn2 "zweite Stromgrenze für Piezoaktor entladen" SWORD Curr 1 100 -32768.00 32767.00 FORMAT "%8.2" ECU_ADDRESS 0x7F8DEC /end MEASUREMENT
/begin MEASUREMENT IVCtl_iDisChDwnPI_mp "Ausgang Entladezeitregler" SWORD Curr 1 100 -32768.00 32767.00 FORMAT "%8.2" ECU_ADDRESS 0x8FF7F6 /end MEASUREMENT
/begin MEASUREMENT IVCtl_stAvrgEnaTiWarnVolt_mp "zylinderspezifische Statusanzeige: Voltregler wird durch die Message InjVCD_stAvrgEnaTiWarn freigegeben" UBYTE OneToOne 1 100 0.00 255.0 FORMAT "%5.1" ECU_ADDRESS 0x8FF858 /end MEASUREMENT
/begin MEASUREMENT IVCtl_stTiChrgPI "Status der Ladezeitregler (geregelt = FALSE, eingefroren = 1)" UBYTE OneToOne 1 100 0.00 255.0 FORMAT "%5.1" ECU_ADDRESS 0x7F88F9 /end MEASUREMENT
/begin MEASUREMENT IVCtl_stVoltPI "Status des PI-Reglers (bit 0-2:obere Grenze, bit 3-5:untere Grenze - 0:top, 1:up, 2:dwn, 3:top, 4:up, 5:dwn)" UBYTE OneToOne 1 100 0.00 255.0 FORMAT "%5.1" ECU_ADDRESS 0x7F88FA /end MEASUREMENT
/begin MEASUREMENT IVCtl_tiChrgSetUp_mp "Ausgang von IVCtl_tiChrgSetUp_CUR" SWORD Time_Busy 1 100 -3276.800 3276.700 FORMAT "%8.3" ECU_ADDRESS 0x8FF7F8 /end MEASUREMENT
/begin MEASUREMENT IVCtl_tiChrgUpAvrg_mp "Mittelwert der gemessenen Ladezeiten" SWORD Time_Busy 1 100 -3276.800 3276.700 FORMAT "%8.3" ECU_ADDRESS 0x8FF7FA /end MEASUREMENT
/begin MEASUREMENT IVCtl_tiChrgUpInPI "Eingangsgröße für den Ladezeitregler" SWORD Time_Busy 1 100 -3276.800 3276.700 FORMAT "%8.3" ECU_ADDRESS 0x7F8DEE /end MEASUREMENT
/begin MEASUREMENT IVCtl_tiChrgUpInPIActr_mp "Regelabweichung der Ladezeit (aktorspezifisch)" SWORD Time_Busy 1 100 -3276.800 3276.700 FORMAT "%8.3" ARRAY_SIZE 6 ECU_ADDRESS 0x8FF7FC /end MEASUREMENT
/begin MEASUREMENT IVCtl_tiChrgUpMaxActr_mp "Maximale Regelabweichung der Ladezeit (aktorspezifisch)" SWORD Time_Busy 1 100 -3276.800 3276.700 FORMAT "%8.3" ARRAY_SIZE 6 ECU_ADDRESS 0x8FF808 /end MEASUREMENT
/begin MEASUREMENT IVCtl_tiChrgUpMax_mp "Maximale Regelabweichung der Ladezeit (gemittelt)" SWORD Time_Busy 1 100 -3276.800 3276.700 FORMAT "%8.3" ECU_ADDRESS 0x8FF814 /end MEASUREMENT
/begin MEASUREMENT IVCtl_tiChrgUpMinActr_mp "Minimale Regelabweichung der Ladezeit (aktorspezifisch)" SWORD Time_Busy 1 100 -3276.800 3276.700 FORMAT "%8.3" ARRAY_SIZE 6 ECU_ADDRESS 0x8FF816 /end MEASUREMENT
/begin MEASUREMENT IVCtl_tiChrgUpMin_mp "Minimale Regelabweichung der Ladezeit (gemittelt)" SWORD Time_Busy 1 100 -3276.800 3276.700 FORMAT "%8.3" ECU_ADDRESS 0x8FF822 /end MEASUREMENT
/begin MEASUREMENT IVCtl_tiChrgUpPse_mp "Pausezeit für Ladezeitregler" SWORD Time_Busy 1 100 -3276.800 3276.700 FORMAT "%8.3" ECU_ADDRESS 0x8FF824 /end MEASUREMENT
/begin MEASUREMENT IVCtl_tiDisChBottAvrg_mp "Mittelwert der gemessenen Entladezeiten" SWORD Time_Busy 1 100 -3276.800 3276.700 FORMAT "%8.3" ECU_ADDRESS 0x8FF826 /end MEASUREMENT
/begin MEASUREMENT IVCtl_tiDisChDwnInPI "Eingangsgröße des Entladezeitreglers" SWORD Time_Busy 1 100 -3276.800 3276.700 FORMAT "%8.3" ECU_ADDRESS 0x7F8DF0 /end MEASUREMENT
/begin MEASUREMENT IVCtl_tiDisChDwnInPIActr_mp "Regelabweichung der Entladezeit (zylinderspezifisch)" SWORD Time_Busy 1 100 -3276.800 3276.700 FORMAT "%8.3" ARRAY_SIZE 6 ECU_ADDRESS 0x8FF828 /end MEASUREMENT
/begin MEASUREMENT IVCtl_tiDisChDwnMaxActr_mp "Maximale Regelabweichung der Entladezeit (aktorspezifisch)" SWORD Time_Busy 1 100 -3276.800 3276.700 FORMAT "%8.3" ARRAY_SIZE 6 ECU_ADDRESS 0x8FF834 /end MEASUREMENT
/begin MEASUREMENT IVCtl_tiDisChDwnMax_mp "Maximale Regelabweichung der Entladezeit (gemittelt)" SWORD Time_Busy 1 100 -3276.800 3276.700 FORMAT "%8.3" ECU_ADDRESS 0x8FF840 /end MEASUREMENT
/begin MEASUREMENT IVCtl_tiDisChDwnMinActr_mp "Minimale Regelabweichung der Entladezeit (aktorspezifisch)" SWORD Time_Busy 1 100 -3276.800 3276.700 FORMAT "%8.3" ARRAY_SIZE 6 ECU_ADDRESS 0x8FF842 /end MEASUREMENT
/begin MEASUREMENT IVCtl_tiDisChDwnMin_mp "Minimale Regelabweichung der Entlladezeit (gemittelt)" SWORD Time_Busy 1 100 -3276.800 3276.700 FORMAT "%8.3" ECU_ADDRESS 0x8FF84E /end MEASUREMENT
/begin MEASUREMENT IVCtl_tiDisChDwnPse_mp "Pausezeit für Entladezeitregler" SWORD Time_Busy 1 100 -3276.800 3276.700 FORMAT "%8.3" ECU_ADDRESS 0x8FF850 /end MEASUREMENT
/begin MEASUREMENT IVCtl_tiDisChSetDwn_mp "Ausgang von IVCtl_tiDisChSetDwn_CUR" SWORD Time_Busy 1 100 -3276.800 3276.700 FORMAT "%8.3" ECU_ADDRESS 0x8FF852 /end MEASUREMENT
/begin MEASUREMENT IVCtl_uClsActrUp "Spannungssollwert für Aktorklassifizierung" SWORD Volt_PA 1 100 -327.6800 327.6700 FORMAT "%8.4" ECU_ADDRESS 0x7F8DF2 /end MEASUREMENT
/begin MEASUREMENT IVCtl_uCorrUp "Reglerausgang zur Korrektur der Aktorspannung" SWORD Volt_PA 1 100 -327.6800 327.6700 FORMAT "%8.4" ECU_ADDRESS 0x7F8DF4 /end MEASUREMENT
/begin MEASUREMENT IVCtl_uSetBott "Spannungssollwert für Bottom-Level" SWORD Volt_PA 1 100 -327.6800 327.6700 FORMAT "%8.4" ECU_ADDRESS 0x7F8DF6 /end MEASUREMENT
/begin MEASUREMENT IVCtl_uSetOfsActr "Spannungssollwert fuer Spannungsoffsetberechnung" SWORD Volt_PA 1 100 -327.6800 327.6700 FORMAT "%8.4" ARRAY_SIZE 6 ECU_ADDRESS 0x7F9318 /end MEASUREMENT
/begin MEASUREMENT IVCtl_uSetUp2Avrg_mp "Piezoaktorspannung gemittelt (Differenz Bottom zu Up Niveau minus Offset)" SWORD Volt_PA 1 100 -327.6800 327.6700 FORMAT "%8.4" ECU_ADDRESS 0x8FF854 /end MEASUREMENT
/begin MEASUREMENT IVCtl_uSetUpActr "Mittlerer aktorspezifischer Spannungssollwert für Piezo-Aktor (up-level)" SWORD Volt_PA 1 100 -327.6800 327.6700 FORMAT "%8.4" ARRAY_SIZE 6 ECU_ADDRESS 0x7F9324 /end MEASUREMENT
/begin MEASUREMENT IVCtl_uSetUpActrUnCorr_mp "unkorrigierter Spannungssollwert (Up-Niveau)" SWORD Volt_PA 1 100 -327.6800 327.6700 FORMAT "%8.4" ARRAY_SIZE 6 ECU_ADDRESS 0x8FF85A /end MEASUREMENT
/begin MEASUREMENT IVCtl_uSetUpActrUnLim_mp "Nicht begrenzter, korrigierter, mittlerer, aktorspezifischer Spannungssollwert für Piezo-Aktor (up-level)" SWORD Volt_PA 1 100 -327.6800 327.6700 FORMAT "%8.4" ARRAY_SIZE 6 ECU_ADDRESS 0x8FF866 /end MEASUREMENT
/begin MEASUREMENT IVCtl_uSetUpAvrg_mp "Gemittelter Spannungswert" SWORD Volt_PA 1 100 -327.6800 327.6700 FORMAT "%8.4" ECU_ADDRESS 0x8FF856 /end MEASUREMENT
/begin MEASUREMENT IVCtl_uSetUpPreCtl_mp "Vorsteuerwert für Spannungssollwertberechnung" SWORD Volt_PA 1 100 -327.6800 327.6700 FORMAT "%8.4" ECU_ADDRESS 0x8FF872 /end MEASUREMENT
/begin MEASUREMENT IVCtl_uSetUpTmp_mp "Temporärer gemittelter und gefilterter Spannungssollwert des Piezo-Aktors (up-level)" SWORD Volt_PA 1 100 -327.6800 327.6700 FORMAT "%8.4" ECU_ADDRESS 0x8FF874 /end MEASUREMENT
/begin MEASUREMENT IVCtl_uUpInPI "Eingangsgröße der Spannungsreglers" SWORD Volt_PA 1 100 -327.6800 327.6700 FORMAT "%8.4" ECU_ADDRESS 0x7F8DF8 /end MEASUREMENT
/begin MEASUREMENT IVCtl_uUpInPIActr_mp "Regelabweichung des Spannungsreglers (aktorspezifisch)" SWORD Volt_PA 1 100 -327.6800 327.6700 FORMAT "%8.4" ARRAY_SIZE 6 ECU_ADDRESS 0x8FF876 /end MEASUREMENT
/begin MEASUREMENT IVCtl_uUpInPIMaxActr_mp "Maximale Regelabweichung des Spannungsreglers (aktorspezifisch)" SWORD Volt_PA 1 100 -327.6800 327.6700 FORMAT "%8.4" ARRAY_SIZE 6 ECU_ADDRESS 0x8FF882 /end MEASUREMENT
/begin MEASUREMENT IVCtl_uUpInPIMax_mp "Maximale Regelabweichung des Spannungsreglers (gemittelt)" SWORD Volt_PA 1 100 -327.6800 327.6700 FORMAT "%8.4" ECU_ADDRESS 0x8FF88E /end MEASUREMENT
/begin MEASUREMENT IVCtl_uUpInPIMinActr_mp "Minimale Regelabweichung des Spannungsreglers (aktorspezifisch)" SWORD Volt_PA 1 100 -327.6800 327.6700 FORMAT "%8.4" ARRAY_SIZE 6 ECU_ADDRESS 0x8FF890 /end MEASUREMENT
/begin MEASUREMENT IVCtl_uUpInPIMin_mp "Minimale Regelabweichung des Spannungsreglers (gemittelt)" SWORD Volt_PA 1 100 -327.6800 327.6700 FORMAT "%8.4" ECU_ADDRESS 0x8FF89C /end MEASUREMENT
/begin MEASUREMENT IVCtl_uUpTmp_mp "Gemittelte Spannungsistwerte des Piezoaktors (Up-Niveau)" SWORD Volt_PA 1 100 -327.6800 327.6700 FORMAT "%8.4" ECU_ADDRESS 0x8FF89E /end MEASUREMENT
/begin MEASUREMENT Layer_bos01_w "" SWORD km_sw_q10 1 100 -327680.0 327670.0 FORMAT "%8.1" ECU_ADDRESS 0x7F8FBA /end MEASUREMENT
/begin MEASUREMENT Layer_bosbtvfbk "" UBYTE rel_ub_q1 1 100 0.00 255.0 FORMAT "%5.1" ECU_ADDRESS 0x7F895E /end MEASUREMENT
/begin MEASUREMENT Layer_bosstate "" UBYTE DEZ 1 100 0.00 255.0 FORMAT "%5.1" ECU_ADDRESS 0x7F895F /end MEASUREMENT
/begin MEASUREMENT Layer_bosvalue_DIAG "" UBYTE OneToOne 1 100 0.00 255.0 FORMAT "%5.1" ARRAY_SIZE 6 ECU_ADDRESS 0x7F92D6 /end MEASUREMENT
/begin MEASUREMENT Layer_FRC_INTM_T_BOS2 "" UBYTE DEZ 1 100 0.00 255.0 FORMAT "%5.1" ECU_ADDRESS 0x7F8959 /end MEASUREMENT
/begin MEASUREMENT Layer_FRC_INTM_WAY_BOS2 "" UBYTE DEZ 1 100 0.00 255.0 FORMAT "%5.1" ECU_ADDRESS 0x7F895A /end MEASUREMENT
/begin MEASUREMENT Layer_ID2_BOS2 "" UBYTE DEZ 1 100 0.00 255.0 FORMAT "%5.1" ECU_ADDRESS 0x7F895B /end MEASUREMENT
/begin MEASUREMENT Layer_idbosmsg "" UBYTE DEZ 1 100 0.00 255.0 FORMAT "%5.1" ECU_ADDRESS 0x7F8960 /end MEASUREMENT
/begin MEASUREMENT Layer_idfbosmg_w "" UWORD DEZ 1 100 0.00 65535.00 FORMAT "%8.2" ECU_ADDRESS 0x7F8FBC /end MEASUREMENT
/begin MEASUREMENT Layer_ID_FN_BOS2 "" SWORD DEZ 1 100 -32768.00 32767.00 FORMAT "%8.2" ECU_ADDRESS 0x7F8FB8 /end MEASUREMENT
/begin MEASUREMENT Layer_stExtWaitRdy "" UBYTE DEZ 1 100 0.00 255.0 FORMAT "%5.1" ECU_ADDRESS 0x7F8961 /end MEASUREMENT
/begin MEASUREMENT Layer_stLayer "" UWORD OneToOne 1 100 0.00 65535.00 FORMAT "%8.2" ECU_ADDRESS 0x7F8FBE /end MEASUREMENT
/begin MEASUREMENT Layer_stOelTog "" UBYTE DEZ 1 100 0.00 255.0 FORMAT "%5.1" ECU_ADDRESS 0x7F8962 /end MEASUREMENT
/begin MEASUREMENT Layer_stOelVerb "" UBYTE DEZ 1 100 0.00 255.0 FORMAT "%5.1" ECU_ADDRESS 0x7F8963 /end MEASUREMENT
/begin MEASUREMENT Layer_stOelVerl "" UBYTE DEZ 1 100 0.00 255.0 FORMAT "%5.1" ECU_ADDRESS 0x7F8964 /end MEASUREMENT
/begin MEASUREMENT Layer_stProcess_u8_CBS_mp "" UBYTE OneToOne 1 100 0.00 255.0 FORMAT "%5.1" ECU_ADDRESS 0x8FF8E5 /end MEASUREMENT
/begin MEASUREMENT Layer_stProcess_u8_mp "" UBYTE OneToOne 1 100 0.00 255.0 FORMAT "%5.1" ECU_ADDRESS 0x8FF8E6 /end MEASUREMENT
/begin MEASUREMENT Layer_stProcess_u8_Tuning2_mp "" UBYTE OneToOne 1 100 0.00 255.0 FORMAT "%5.1" ECU_ADDRESS 0x8FF8E7 /end MEASUREMENT
/begin MEASUREMENT Layer_stProcess_u8_Tuning3_mp "" UBYTE OneToOne 1 100 0.00 255.0 FORMAT "%5.1" ECU_ADDRESS 0x8FF8E8 /end MEASUREMENT
/begin MEASUREMENT Layer_stProcess_u8_Tuning4_mp "" UBYTE OneToOne 1 100 0.00 255.0 FORMAT "%5.1" ECU_ADDRESS 0x8FF8E9 /end MEASUREMENT
/begin MEASUREMENT Layer_stProcess_u8_Tuning5_mp "" UBYTE OneToOne 1 100 0.00 255.0 FORMAT "%5.1" ECU_ADDRESS 0x8FF8EA /end MEASUREMENT
/begin MEASUREMENT Layer_stProcess_u8_Tuning6_mp "" UBYTE OneToOne 1 100 0.00 255.0 FORMAT "%5.1" ECU_ADDRESS 0x8FF8EB /end MEASUREMENT
/begin MEASUREMENT Layer_stProcess_u8_Tuning7_mp "" UBYTE OneToOne 1 100 0.00 255.0 FORMAT "%5.1" ECU_ADDRESS 0x8FF8EC /end MEASUREMENT
/begin MEASUREMENT Layer_stProcess_u8_Tuning8_mp "" UBYTE OneToOne 1 100 0.00 255.0 FORMAT "%5.1" ECU_ADDRESS 0x8FF8ED /end MEASUREMENT
/begin MEASUREMENT Layer_stProcess_u8_Tuning_mp "" UBYTE OneToOne 1 100 0.00 255.0 FORMAT "%5.1" ECU_ADDRESS 0x8FF8EE /end MEASUREMENT
/begin MEASUREMENT Layer_TARD_MON_BOS2 "" UBYTE DEZ 1 100 0.00 255.0 FORMAT "%5.1" ECU_ADDRESS 0x7F895C /end MEASUREMENT
/begin MEASUREMENT Layer_TARD_YR_BOS2 "" UBYTE DEZ 1 100 0.00 255.0 FORMAT "%5.1" ECU_ADDRESS 0x7F895D /end MEASUREMENT
/begin MEASUREMENT Layer_volOil "" UBYTE DEZ 1 100 0.00 255.0 FORMAT "%5.1" ECU_ADDRESS 0x7F8966 /end MEASUREMENT
/begin MEASUREMENT Layer_volOilRefill "" UBYTE DEZ 1 100 0.00 255.0 FORMAT "%5.1" ECU_ADDRESS 0x7F8967 /end MEASUREMENT
/begin MEASUREMENT Layer_zrbosmld "" UBYTE DEZ 1 100 0.00 255.0 FORMAT "%5.1" ECU_ADDRESS 0x7F8968 /end MEASUREMENT
/begin MEASUREMENT PwrMng_absch_korr "correction value shut off" UWORD OneToOne 1 100 0.00 65535.00 FORMAT "%8.2" ECU_ADDRESS 0x7F9094 /end MEASUREMENT
/begin MEASUREMENT PwrMng_dmAirPerTimeI_mp "integrated air mass" SWORD AirMassPerTime 1 100 -3276.800 3276.700 FORMAT "%8.3" ECU_ADDRESS 0x8FF8F0 /end MEASUREMENT
/begin MEASUREMENT PwrMng_d_soc "battery load state" UWORD OneToOne 1 100 0.00 65535.00 FORMAT "%8.2" ECU_ADDRESS 0x7F9096 /end MEASUREMENT
/begin MEASUREMENT PwrMng_iEngine "engine current" SWORD igen_ub_q1 1 100 -32768.00 32767.00 FORMAT "%8.2" ECU_ADDRESS 0x7F9098 /end MEASUREMENT
/begin MEASUREMENT PwrMng_iGen "Alternator current" UBYTE igen_ub_q1 1 100 0.00 255.0 FORMAT "%5.1" ECU_ADDRESS 0x7F89AB /end MEASUREMENT
/begin MEASUREMENT PwrMng_nMin "low idle demand from PwrMng" SWORD EngN 1 100 -32768.00 32767.00 FORMAT "%8.2" ECU_ADDRESS 0x7F909A /end MEASUREMENT
/begin MEASUREMENT PwrMng_nnnstart "start rpm engine" SWORD OneToOne 1 100 -32768.00 32767.00 FORMAT "%8.2" ECU_ADDRESS 0x7F909C /end MEASUREMENT
/begin MEASUREMENT PwrMng_pwrDes "alternator power" SWORD Pwr 1 100 -308831.1 308821.7 FORMAT "%8.1" ECU_ADDRESS 0x7F909E /end MEASUREMENT
/begin MEASUREMENT PwrMng_pwrPTC "dummy power management message" SWORD DtyCyc 1 100 -327.6800 327.6700 FORMAT "%8.4" ECU_ADDRESS 0x7F90A0 /end MEASUREMENT
/begin MEASUREMENT PwrMng_rCtrPwrSpCos "controlling power extra-consumers" UBYTE fak_q0p5 1 100 0.00 127.5 FORMAT "%5.1" ECU_ADDRESS 0x7F89AC /end MEASUREMENT
/begin MEASUREMENT PwrMng_rdffgen "DF-signal in GS-resolution for CAN" UBYTE PCENT 1 100 0.00 99.61 FORMAT "%5.2" ECU_ADDRESS 0x7F89AD /end MEASUREMENT
/begin MEASUREMENT PwrMng_stB_ccbtnach "Powermanagement value" UBYTE OneToOne 1 100 0.00 255.0 FORMAT "%5.1" ECU_ADDRESS 0x7F89AE /end MEASUREMENT
/begin MEASUREMENT PwrMng_stB_ccbttdfk "Powermanagement value" UBYTE OneToOne 1 100 0.00 255.0 FORMAT "%5.1" ECU_ADDRESS 0x7F89AF /end MEASUREMENT
/begin MEASUREMENT PwrMng_stB_ccbttknt "Powermanagement value" UBYTE OneToOne 1 100 0.00 255.0 FORMAT "%5.1" ECU_ADDRESS 0x7F89B0 /end MEASUREMENT
/begin MEASUREMENT PwrMng_stB_ccpmerr "Powermanagement value" UBYTE OneToOne 1 100 0.00 255.0 FORMAT "%5.1" ECU_ADDRESS 0x7F89B1 /end MEASUREMENT
/begin MEASUREMENT PwrMng_stB_ccprio "Powermanagement value" UBYTE OneToOne 1 100 0.00 255.0 FORMAT "%5.1" ECU_ADDRESS 0x7F89B2 /end MEASUREMENT
/begin MEASUREMENT PwrMng_stB_ccruhver "Powermanagement value" UBYTE OneToOne 1 100 0.00 255.0 FORMAT "%5.1" ECU_ADDRESS 0x7F89B3 /end MEASUREMENT
/begin MEASUREMENT PwrMng_stB_codierpm "Powermanagement value" UBYTE OneToOne 1 100 0.00 255.0 FORMAT "%5.1" ECU_ADDRESS 0x7F89B4 /end MEASUREMENT
/begin MEASUREMENT PwrMng_stCtrCbr "controlling current branch" UBYTE DEZ 1 100 0.00 255.0 FORMAT "%5.1" ECU_ADDRESS 0x7F89B5 /end MEASUREMENT
/begin MEASUREMENT PwrMng_stCtrPCos "controlling stand-consumers" UBYTE DEZ 1 100 0.00 255.0 FORMAT "%5.1" ECU_ADDRESS 0x7F89B6 /end MEASUREMENT
/begin MEASUREMENT PwrMng_stCtrPrio "controlling priority peak decreasing" UBYTE DEZ 1 100 0.00 255.0 FORMAT "%5.1" ECU_ADDRESS 0x7F89B7 /end MEASUREMENT
/begin MEASUREMENT PwrMng_stCtrPrioCf "controlling priority peak decreasing" UBYTE DEZ 1 100 0.00 255.0 FORMAT "%5.1" ECU_ADDRESS 0x7F89B8 /end MEASUREMENT
/begin MEASUREMENT PwrMng_stCtrPwrCos "controlling power consumers bit-coded" UWORD DEZ 1 100 0.00 65535.00 FORMAT "%8.2" ECU_ADDRESS 0x7F90A2 /end MEASUREMENT
/begin MEASUREMENT PwrMng_stGen "State alternator" UBYTE OneToOne 1 100 0.00 255.0 FORMAT "%5.1" ECU_ADDRESS 0x7F89B9 /end MEASUREMENT
/begin MEASUREMENT PwrMng_stLdstGen "alternator load state" UBYTE OneToOne 1 100 0.00 255.0 FORMAT "%5.1" ECU_ADDRESS 0x7F89BB /end MEASUREMENT
/begin MEASUREMENT PwrMng_stLIGov "State of low idle governor" UWORD OneToOne 1 100 0.00 65535.00 FORMAT "%8.2" ECU_ADDRESS 0x7F89BA /end MEASUREMENT
/begin MEASUREMENT PwrMng_stPCos "state stand-consumers" UBYTE DEZ 1 100 0.00 255.0 FORMAT "%5.1" ECU_ADDRESS 0x7F89BC /end MEASUREMENT
/begin MEASUREMENT PwrMng_stRqPCos "Demand stand-consumers" UBYTE DEZ 1 100 0.00 255.0 FORMAT "%5.1" ECU_ADDRESS 0x7F89BD /end MEASUREMENT
/begin MEASUREMENT PwrMng_stSelSpCos "status extra-consumers detection" UBYTE DEZ 1 100 0.00 255.0 FORMAT "%5.1" ECU_ADDRESS 0x7F89BE /end MEASUREMENT
/begin MEASUREMENT PwrMng_stTerminal61 "Status Klemme 61" UBYTE OneToOne 1 100 0.00 255.0 FORMAT "%5.1" ECU_ADDRESS 0x7F89BF /end MEASUREMENT
/begin MEASUREMENT PwrMng_stULev "voltage level" UBYTE DEZ 1 100 0.00 255.0 FORMAT "%5.1" ECU_ADDRESS 0x7F89C0 /end MEASUREMENT
/begin MEASUREMENT PwrMng_tiLRGen "Load-Response Zeit" UWORD Time_s 1 100 0.00 655.3500 FORMAT "%8.4" ECU_ADDRESS 0x7F90A4 /end MEASUREMENT
/begin MEASUREMENT PwrMng_ubt "Battery voltage" UWORD spg_uw_q0p015 1 100 0.00 983.02500 ECU_ADDRESS 0x7F90AA /end MEASUREMENT
/begin MEASUREMENT PwrMng_uGen "Sollwert Generatorspannung" UWORD Volt_Batt 1 100 0.00 1281232. FORMAT "%8.0" ECU_ADDRESS 0x7F90A6 /end MEASUREMENT
/begin MEASUREMENT PwrMng_uGen2 "" UWORD Volt_Batt 1 100 0.00 1281232. FORMAT "%8.0" ECU_ADDRESS 0x7F90A8 /end MEASUREMENT
/begin MEASUREMENT RF_BSD "" UBYTE OneToOne 1 100 0.00 255.0 FORMAT "%5.1" ECU_ADDRESS 0x8FF8BC /end MEASUREMENT
/begin MEASUREMENT RF_GEN "" UBYTE OneToOne 1 100 0.00 255.0 FORMAT "%5.1" ECU_ADDRESS 0x8FF8BD /end MEASUREMENT
/begin MEASUREMENT RF_IBS1 "" UBYTE OneToOne 1 100 0.00 255.0 FORMAT "%5.1" ECU_ADDRESS 0x8FF8BE /end MEASUREMENT
/begin MEASUREMENT RF_IBS2 "" UBYTE OneToOne 1 100 0.00 255.0 FORMAT "%5.1" ECU_ADDRESS 0x8FF8BF /end MEASUREMENT
/begin MEASUREMENT RF_IBS3 "" UBYTE OneToOne 1 100 0.00 255.0 FORMAT "%5.1" ECU_ADDRESS 0x8FF8C0 /end MEASUREMENT
/begin MEASUREMENT RF_MANHYDR "" UBYTE OneToOne 1 100 0.00 255.0 FORMAT "%5.1" ECU_ADDRESS 0x8FF8C1 /end MEASUREMENT
/begin MEASUREMENT RF_MANLUFT "" UBYTE OneToOne 1 100 0.00 255.0 FORMAT "%5.1" ECU_ADDRESS 0x8FF8C2 /end MEASUREMENT
/begin MEASUREMENT RF_PMBATT "" UBYTE OneToOne 1 100 0.00 255.0 FORMAT "%5.1" ECU_ADDRESS 0x8FF8C3 /end MEASUREMENT
/begin MEASUREMENT RF_PMBN "" UBYTE OneToOne 1 100 0.00 255.0 FORMAT "%5.1" ECU_ADDRESS 0x8FF8C4 /end MEASUREMENT
/begin MEASUREMENT RF_PMRUHVERL "" UBYTE OneToOne 1 100 0.00 255.0 FORMAT "%5.1" ECU_ADDRESS 0x8FF8C5 /end MEASUREMENT
/begin MEASUREMENT RF_QLT "" UBYTE OneToOne 1 100 0.00 255.0 FORMAT "%5.1" ECU_ADDRESS 0x8FF8C6 /end MEASUREMENT
/begin MEASUREMENT RF_TANS "" UBYTE OneToOne 1 100 0.00 255.0 FORMAT "%5.1" ECU_ADDRESS 0x8FF8C7 /end MEASUREMENT
/begin MEASUREMENT RF_TOENS "" UBYTE OneToOne 1 100 0.00 255.0 FORMAT "%5.1" ECU_ADDRESS 0x8FF8C8 /end MEASUREMENT
/begin MEASUREMENT RF_TUMG "" UBYTE OneToOne 1 100 0.00 255.0 FORMAT "%5.1" ECU_ADDRESS 0x8FF8C9 /end MEASUREMENT
/begin MEASUREMENT ZF_BSD "" UBYTE OneToOne 1 100 0.00 255.0 FORMAT "%5.1" ECU_ADDRESS 0x8FF8CA /end MEASUREMENT
/begin MEASUREMENT ZF_GEN "" UBYTE OneToOne 1 100 0.00 255.0 FORMAT "%5.1" ECU_ADDRESS 0x8FF8CB /end MEASUREMENT
/begin MEASUREMENT ZF_IBS1 "" UBYTE OneToOne 1 100 0.00 255.0 FORMAT "%5.1" ECU_ADDRESS 0x8FF8CC /end MEASUREMENT
/begin MEASUREMENT ZF_IBS2 "" UBYTE OneToOne 1 100 0.00 255.0 FORMAT "%5.1" ECU_ADDRESS 0x8FF8CD /end MEASUREMENT
/begin MEASUREMENT ZF_IBS3 "" UBYTE OneToOne 1 100 0.00 255.0 FORMAT "%5.1" ECU_ADDRESS 0x8FF8CE /end MEASUREMENT
/begin MEASUREMENT ZF_MANHYDR "" UBYTE OneToOne 1 100 0.00 255.0 FORMAT "%5.1" ECU_ADDRESS 0x8FF8CF /end MEASUREMENT
/begin MEASUREMENT ZF_MANLUFT "" UBYTE OneToOne 1 100 0.00 255.0 FORMAT "%5.1" ECU_ADDRESS 0x8FF8D0 /end MEASUREMENT
/begin MEASUREMENT ZF_PMBATT "" UBYTE OneToOne 1 100 0.00 255.0 FORMAT "%5.1" ECU_ADDRESS 0x8FF8D1 /end MEASUREMENT
/begin MEASUREMENT ZF_PMBN "" UBYTE OneToOne 1 100 0.00 255.0 FORMAT "%5.1" ECU_ADDRESS 0x8FF8D2 /end MEASUREMENT
/begin MEASUREMENT ZF_PMRUHVERL "" UBYTE OneToOne 1 100 0.00 255.0 FORMAT "%5.1" ECU_ADDRESS 0x8FF8D3 /end MEASUREMENT
/begin MEASUREMENT ZF_QLT "" UBYTE OneToOne 1 100 0.00 255.0 FORMAT "%5.1" ECU_ADDRESS 0x8FF8D4 /end MEASUREMENT
/begin MEASUREMENT ZF_TANS "" UBYTE OneToOne 1 100 0.00 255.0 FORMAT "%5.1" ECU_ADDRESS 0x8FF8D5 /end MEASUREMENT
/begin MEASUREMENT ZF_TOENS "" UBYTE OneToOne 1 100 0.00 255.0 FORMAT "%5.1" ECU_ADDRESS 0x8FF8D6 /end MEASUREMENT
/begin MEASUREMENT ZF_TUMG "" UBYTE OneToOne 1 100 0.00 255.0 FORMAT "%5.1" ECU_ADDRESS 0x8FF8D7 /end MEASUREMENT
/begin FUNCTION injvcd_cls_msg "" /begin OUT_MEASUREMENT InjVCD_stClsActr InjVCD_swtClsActr /end OUT_MEASUREMENT /end FUNCTION
/begin FUNCTION injvcd_cls_uic "" /end FUNCTION
/begin FUNCTION injvcd_cy370 "spezielle Funktionen fuer CY370"
 /begin DEF_CHARACTERISTIC InjVCD_uCY370ThrSRCLo_C InjVCD_uCY370ThrSRCHi_C InjVCD_uCY370Lin_CUR InjVCD_stCY370RcyTst_C /end DEF_CHARACTERISTIC
 /begin OUT_MEASUREMENT InjVCD_regCY370ID_mp InjVCD_stCY370Event_mp InjVCD_uRawCY370Int0_mp InjVCD_uRawCY370Int_mp InjVCD_uValCY370Int_mp /end OUT_MEASUREMENT
/end FUNCTION
/begin FUNCTION injvcd_cy370_msg ""
 /begin OUT_MEASUREMENT InjVCD_PZOSWType InjVCD_regCY370Bank InjVCD_regCY370CylISel InjVCD_regCY370Global InjVCD_regCY370Status InjVCD_stCY370Buf InjVCD_tiCY370ChrgRC InjVCD_uCY370ChrgIntWp InjVCD_uCY370ChrgOff /end OUT_MEASUREMENT
/end FUNCTION
/begin FUNCTION injvcd_cy370_uic "" /end FUNCTION
/begin FUNCTION injvcd_dcdc "Komponententreiber für DCDC-Wandler"
 /begin DEF_CHARACTERISTIC InjVCD_DebDCDCLowDef_C InjVCD_DebDCDCStartDef_C InjVCD_uBufCLoLim_C /end DEF_CHARACTERISTIC
/end FUNCTION
/begin FUNCTION injvcd_dcdc_msg "" /begin OUT_MEASUREMENT InjVCD_stBufC /end OUT_MEASUREMENT /end FUNCTION
/begin FUNCTION injvcd_dcdc_uic "" /end FUNCTION
/begin FUNCTION injvcd_estet "" /end FUNCTION
/begin FUNCTION injvcd_estet_uic "" /end FUNCTION
/begin FUNCTION injvcd_evmgmt ""
 /begin DEF_CHARACTERISTIC InjVCD_numCollTyp_C InjVCD_swtEvMgmt_C InjVCD_tiLeadJit_C InjVCD_tiLeadPost1_C InjVCD_tiLeadPost2_C InjVCD_tiLeadPost3_C InjVCD_tiLeadPost4_C InjVCD_tiLeadPre1_C InjVCD_tiLeadPre2_C InjVCD_tiLeadPre3_C InjVCD_tiLeadPre4_C /end DEF_CHARACTERISTIC
 /begin OUT_MEASUREMENT InjVCD_numCollPrim_mp InjVCD_numCollScnd_mp InjVCD_numCollThrd_mp InjVCD_numEvMgmtStat_mp InjVCD_numReacPrim_mp InjVCD_numReacScnd_mp InjVCD_tiCutAll_mp InjVCD_tiCutPrim_mp InjVCD_tiCutScnd_mp InjVCD_tiShiftAll_mp InjVCD_tiShiftPrim_mp InjVCD_tiShiftScnd_mp /end OUT_MEASUREMENT
/end FUNCTION
/begin FUNCTION injvcd_getet "Ansteuerdauerberechnung" /begin DEF_CHARACTERISTIC InjVCD_swtInputETMAP_C InjVCD_tiET_MAP /end DEF_CHARACTERISTIC /begin IN_MEASUREMENT InjVCD_pInET_mp InjVCD_volInET_mp /end IN_MEASUREMENT /end FUNCTION
/begin FUNCTION injvcd_getet_uic "" /begin OUT_MEASUREMENT InjVCD_pInET_mp InjVCD_volInET_mp /end OUT_MEASUREMENT /end FUNCTION
/begin FUNCTION injvcd_measubuf "Messung der Bufferspannung"
 /begin DEF_CHARACTERISTIC InjVCD_DebUBufSRCHighDef_C InjVCD_DebUBufSRCHighOk_C InjVCD_DebUBufSRCLowDef_C InjVCD_DebUBufSRCLowOk_C InjVCD_uBufSRCMin_C InjVCD_uBufSRCMax_C InjVCD_uBufLin_CUR /end DEF_CHARACTERISTIC
 /begin OUT_MEASUREMENT InjVCD_ctUBufTrig_mp InjVCD_uBufRaw_mp /end OUT_MEASUREMENT
/end FUNCTION
/begin FUNCTION injvcd_measubuf_msg "" /begin OUT_MEASUREMENT InjVCD_stUBuf InjVCD_uBuf /end OUT_MEASUREMENT /end FUNCTION
/begin FUNCTION injvcd_measubuf_uic "" /end FUNCTION
/begin FUNCTION injvcd_mirmtctl_uic "" /end FUNCTION
/begin FUNCTION injvcd_mon "Überwachung des Einspritzventils im Komponententreibers"
 /begin DEF_CHARACTERISTIC InjVCD_facMonUThresHiPl_CA InjVCD_facMonUThresLoPl_CA InjVCD_rCapUpTolc_C InjVCD_rTiChrgUpTolc_C InjVCD_tiMi1ThresLo_C InjVCD_tiMonThresHiPlaus_C InjVCD_tiMonThresLoPlaus_C /end DEF_CHARACTERISTIC
 /begin OUT_MEASUREMENT InjVCD_tiMonActrThresLo_mp InjVCD_uMonThresHi_mp InjVCD_uMonThresLo_mp /end OUT_MEASUREMENT
/end FUNCTION
/begin FUNCTION injvcd_monshcir "Kurzschlussunterscheidung"
 /begin DEF_CHARACTERISTIC InjVCD_nEngMonShCir_C InjVCD_pRailMonShCirMax_C InjVCD_rMonShCirTiChrgUpTolc_C InjVCD_tiMonET_C InjVCD_tiMonLead_C /end DEF_CHARACTERISTIC
 /begin OUT_MEASUREMENT InjVCD_tiMonChrgUp_mp InjVCD_tiMonShCirSort_mp /end OUT_MEASUREMENT
/end FUNCTION
/begin FUNCTION injvcd_monshcir_msg "" /begin OUT_MEASUREMENT InjVCD_stMonShCir /end OUT_MEASUREMENT /end FUNCTION
/begin FUNCTION injvcd_monshcir_uic "" /end FUNCTION
/begin FUNCTION injvcd_mon_uic ""
 /begin OUT_MEASUREMENT InjVCD_rCapThresHigh_mp InjVCD_rCapThresLow_mp InjVCD_rCapUpCurrToKx_mp InjVCD_rCapUpKxToCurr_mp InjVCD_rTiChrgUpCurrToKx_mp InjVCD_rTiChrgUpKxToCurr_mp InjVCD_rTiChrgUpThresHigh_mp InjVCD_rTiChrgUpThresLow_mp /end OUT_MEASUREMENT
/end FUNCTION
/begin FUNCTION injvcd_pii1rmtctl_uic "" /end FUNCTION
/begin FUNCTION injvcd_pii2rmtctl_uic "" /end FUNCTION
/begin FUNCTION injvcd_pii3rmtctl_uic "" /end FUNCTION
/begin FUNCTION injvcd_poi1rmtctl_uic "" /end FUNCTION
/begin FUNCTION injvcd_poi2rmtctl_uic "" /end FUNCTION
/begin FUNCTION injvcd_polar "Polarisation des Piezo-Aktors während des Systemhochlaufs"
 /begin DEF_CHARACTERISTIC InjVCD_ctThres_C InjVCD_iPolarUp_CUR InjVCD_nPolar_C InjVCD_numPolar_C InjVCD_pPolarMax_C InjVCD_swtPolarOvrlap_C InjVCD_tiPolarET_CUR InjVCD_tiPolarLead_C InjVCD_tiPolarOvrlap_C InjVCD_tiPolarPse_C InjVCD_tiPolarPse_CUR InjVCD_tPolarMax_C InjVCD_uPolarUp_CUR /end DEF_CHARACTERISTIC
 /begin OUT_MEASUREMENT InjVCD_ctPolarOvrRun_mp InjVCD_iPolarChrg_mp InjVCD_iPolarDisCh_mp InjVCD_pPolar_mp InjVCD_stPolarOvrlap_mp InjVCD_stPolarPreCond_mp InjVCD_tiPolarET_mp InjVCD_tiPolarPse_mp InjVCD_tPolar_mp InjVCD_uPolarBott_mp InjVCD_uPolarUp_mp /end OUT_MEASUREMENT
/end FUNCTION
/begin FUNCTION injvcd_polar_msg "" /begin OUT_MEASUREMENT InjVCD_stPolar /end OUT_MEASUREMENT /end FUNCTION
/begin FUNCTION injvcd_polar_uic "" /end FUNCTION
/begin FUNCTION injvcd_progetlib "" /end FUNCTION
/begin FUNCTION injvcd_progetlib_uic ""
 /begin OUT_MEASUREMENT InjVCD_stInjMI1_mp InjVCD_stInjMI2_mp InjVCD_stInjPiI1_mp InjVCD_stInjPiI2_mp InjVCD_stInjPiI3_mp InjVCD_stInjPoI1_mp InjVCD_stInjPoI2_mp /end OUT_MEASUREMENT
/end FUNCTION
/begin FUNCTION injvcd_progetzfc "" /end FUNCTION
/begin FUNCTION injvcd_progetzfc_uic "" /begin OUT_MEASUREMENT InjVCD_stInjZFC_mp /end OUT_MEASUREMENT /end FUNCTION
/begin FUNCTION injvcd_progmi "Programmierung der MI1, Initialisierung von Schnelllöschung und Haltestrom" /begin OUT_MEASUREMENT InjVCD_stInjBegMI1_mp /end OUT_MEASUREMENT /end FUNCTION
/begin FUNCTION injvcd_progmi_uic "" /begin OUT_MEASUREMENT InjVCD_ctMI1AgDiff_mp InjVCD_phiMI1Diff_mp /end OUT_MEASUREMENT /end FUNCTION
/begin FUNCTION injvcd_progpii "Programmierung der Voreinspritzung"
 /begin OUT_MEASUREMENT InjVCD_stInjTPUCM_mp InjVCD_stInjTPUErr_mp InjVCD_stInjTPUShortDur_mp /end OUT_MEASUREMENT
/end FUNCTION
/begin FUNCTION injvcd_progpii1 "" /begin OUT_MEASUREMENT InjVCD_stInjBegPiI1_mp /end OUT_MEASUREMENT /end FUNCTION
/begin FUNCTION injvcd_progpii1_uic "" /begin OUT_MEASUREMENT InjVCD_ctPiI1AgDiff_mp InjVCD_phiPiI1Diff_mp /end OUT_MEASUREMENT /end FUNCTION
/begin FUNCTION injvcd_progpii2 "" /begin OUT_MEASUREMENT InjVCD_stInjBegPiI2_mp /end OUT_MEASUREMENT /end FUNCTION
/begin FUNCTION injvcd_progpii2_uic "" /begin OUT_MEASUREMENT InjVCD_ctPiI2AgDiff_mp InjVCD_phiPiI2Diff_mp /end OUT_MEASUREMENT /end FUNCTION
/begin FUNCTION injvcd_progpii3 "" /begin OUT_MEASUREMENT InjVCD_stInjBegPiI3_mp /end OUT_MEASUREMENT /end FUNCTION
/begin FUNCTION injvcd_progpii3_uic "" /end FUNCTION
/begin FUNCTION injvcd_progpii_uic "" /end FUNCTION
/begin FUNCTION injvcd_progpoi1 "" /begin OUT_MEASUREMENT InjVCD_stInjBegPoI1_mp /end OUT_MEASUREMENT /end FUNCTION
/begin FUNCTION injvcd_progpoi1_uic "" /end FUNCTION
/begin FUNCTION injvcd_progpoi2 "" /begin OUT_MEASUREMENT InjVCD_stInjBegPoI2_mp /end OUT_MEASUREMENT /end FUNCTION
/begin FUNCTION injvcd_progpoi2_uic "" /end FUNCTION
/begin FUNCTION injvcd_progzfc "" /end FUNCTION
/begin FUNCTION injvcd_progzfc_uic "" /end FUNCTION
/begin FUNCTION injvcd_selcrnt "" /begin OUT_MEASUREMENT InjVCD_numCrntLvl_mp /end OUT_MEASUREMENT /end FUNCTION
/begin FUNCTION injvcd_selvoltoffs "" /end FUNCTION
/begin FUNCTION injvcd_selvoltoffs_msg "" /begin OUT_MEASUREMENT InjVCD_numOfsSelect /end OUT_MEASUREMENT /end FUNCTION
/begin FUNCTION injvcd_shoffdcdc "Schutzabschaltung DC/DC-Wandler bei festgestelltem Ladeschalterkurzschluss"
 /begin DEF_CHARACTERISTIC InjVCD_ctThresShOffDCDCEv_C InjVCD_swtShOffDCDCTst_C InjVCD_uShOffBufThres_C /end DEF_CHARACTERISTIC
/end FUNCTION
/begin FUNCTION injvcd_shoffdcdc_msg "" /begin OUT_MEASUREMENT InjVCD_stMon InjVCD_stShOffDCDC /end OUT_MEASUREMENT /end FUNCTION
/begin FUNCTION injvcd_shoffdcdc_uic "" /end FUNCTION
/begin FUNCTION injvcd_zfcetcor "Ansteuerdauerkorrektur durch Nullmengenkalibrierung"
 /begin DEF_CHARACTERISTIC InjVCD_pRailZFCETCor_AXIS InjVCD_qZFCETCor_AXIS InjVCD_rZFCETDif0_GMAP InjVCD_rZFCETDif1_GMAP InjVCD_rZFCETDif2_GMAP InjVCD_rZFCETMsk_GMAP InjVCD_stInputZFCETGMap_C InjVCD_stZFCETCorActv_C InjVCD_swtZFCCorOvrRunOn_C InjVCD_tiZFCETCorMax_C InjVCD_tiZFCETCorMin_C /end DEF_CHARACTERISTIC
 /begin IN_MEASUREMENT InjVCD_qInZFCETGMap_mp RailCD_pAct_mp /end IN_MEASUREMENT
 /begin OUT_MEASUREMENT InjVCD_rZFCETCoeffDif_mp InjVCD_rZFCETCoeffMsk_mp InjVCD_tiPiI1ZFCETCor_mp InjVCD_tiPiI2ZFCETCor_mp InjVCD_tiPiI3ZFCETCor_mp /end OUT_MEASUREMENT
/end FUNCTION
/begin FUNCTION injvcd_zfcetcor_uic "" /begin OUT_MEASUREMENT InjVCD_qInZFCETGMap_mp /end OUT_MEASUREMENT /end FUNCTION
/begin FUNCTION injvlv_addbal "Korrektur Einspritzmenge aus Laufruheregler" /begin DEF_CHARACTERISTIC InjVlv_facAddBalRls_MAP /end DEF_CHARACTERISTIC /begin IN_MEASUREMENT InjCtl_qSetUnBal RailCD_pPeak /end IN_MEASUREMENT /end FUNCTION
/begin FUNCTION injvlv_addballib "" /begin DEF_CHARACTERISTIC InjVlv_stInputAddBalMap_C /end DEF_CHARACTERISTIC /end FUNCTION
/begin FUNCTION injvlv_addballib_uic ""
 /begin OUT_MEASUREMENT InjVlv_qMI1Bal_mp InjVlv_qPiI1Bal_mp InjVlv_qPiI2Bal_mp InjVlv_qPiI3Bal_mp InjVlv_qPoI1Bal_mp InjVlv_qPoI2BalEff_mp InjVlv_qPoI2Bal_mp /end OUT_MEASUREMENT
/end FUNCTION
/begin FUNCTION injvlv_addbalzfc "" /end FUNCTION
/begin FUNCTION injvlv_addbalzfc_uic "" /end FUNCTION
/begin FUNCTION injvlv_addbal_msg "" /begin OUT_MEASUREMENT InjVlv_facAddBalRls /end OUT_MEASUREMENT /end FUNCTION
/begin FUNCTION injvlv_addbal_uic "" /end FUNCTION
/begin FUNCTION injvlv_calcvolt "Spannungsberechnung für Piezo-Aktuator"
 /begin DEF_CHARACTERISTIC InjVlv_facPCorQ_CUR InjVlv_facPCorTi_CUR InjVlv_facVoltCorUp_MAP InjVlv_pCorBase_CUR InjVlv_pRailDfl_C InjVlv_stPWvCorMsk_C InjVlv_tActrDfl_C InjVlv_uSetBott_C InjVlv_uSetUpPress0_CUR InjVlv_uSetUpPress10_CUR InjVlv_uSetUpPress11_CUR InjVlv_uSetUpPress12_CUR InjVlv_uSetUpPress13_CUR InjVlv_uSetUpPress14_CUR InjVlv_uSetUpPress15_CUR InjVlv_uSetUpPress1_CUR InjVlv_uSetUpPress2_CUR InjVlv_uSetUpPress3_CUR InjVlv_uSetUpPress4_CUR InjVlv_uSetUpPress5_CUR InjVlv_uSetUpPress6_CUR InjVlv_uSetUpPress7_CUR InjVlv_uSetUpPress8_CUR InjVlv_uSetUpPress9_CUR /end DEF_CHARACTERISTIC
 /begin IN_MEASUREMENT InjVlv_pAct_mp InjVlv_pCalcVolt InjVlv_tiMI1PoI2Cor_mp /end IN_MEASUREMENT
 /begin OUT_MEASUREMENT InjVlv_facPCorQ_mp InjVlv_facPCorTi_mp InjVlv_facPCor_mp InjVlv_pCorBase_mp InjVlv_pPoI2WvCorOfsActr_mp InjVlv_pRailCorPoI2Actr_mp InjVlv_qDes_mp InjVlv_tActr_mp InjVlv_uSetUpActrPoI2_mp /end OUT_MEASUREMENT
/end FUNCTION
/begin FUNCTION injvlv_calcvoltoffs "Berechnung des Spannungsoffsets" /begin DEF_CHARACTERISTIC InjVlv_uOfs_C /end DEF_CHARACTERISTIC /begin OUT_MEASUREMENT InjVlv_uSetBase_mp /end OUT_MEASUREMENT /end FUNCTION
/begin FUNCTION injvlv_calcvoltoffs_msg "" /begin OUT_MEASUREMENT InjVlv_uOfsBand /end OUT_MEASUREMENT /end FUNCTION
/begin FUNCTION injvlv_calcvolt_msg ""
 /begin OUT_MEASUREMENT InjVlv_facVoltCorUp InjVlv_numClsVltgAdjActr InjVlv_pCalcVolt InjVlv_uSetBott InjVlv_uSetUpActr /end OUT_MEASUREMENT
/end FUNCTION
/begin FUNCTION injvlv_calcvolt_uic "" /end FUNCTION
/begin FUNCTION injvlv_chrgbalinjlim "maximale Anzahl an Einspritzungen aufgrund der Ladungsbilanz des Boosterkondensators"
 /begin DEF_CHARACTERISTIC InjVlv_numInjChrgBal_MAP InjVlv_rChrgBalPwrHys_C InjVlv_rChrgBalVltgHys_C InjVlv_uBufCInjLimXLow_C InjVlv_uBufCInjLimXHigh_C InjVlv_stBufCInjLimYLow_C InjVlv_stBufCInjLimYHigh_C InjVlv_wInj_CUR /end DEF_CHARACTERISTIC
 /begin IN_MEASUREMENT BattCD_u /end IN_MEASUREMENT
 /begin OUT_MEASUREMENT InjVlv_pwrInjAvrg_mp InjVlv_uSetUpAvrg_mp InjVlv_wInjCorr_mp InjVlv_wInjNom_mp /end OUT_MEASUREMENT
/end FUNCTION
/begin FUNCTION injvlv_chrgbalinjlim_uic "" /begin OUT_MEASUREMENT InjVlv_numInjChrgBal_mp /end OUT_MEASUREMENT /end FUNCTION
/begin FUNCTION injvlv_currdcdc "Berechnung des aktuellen DCDC-Werts" /begin DEF_CHARACTERISTIC InjVlv_iDCDC_CUR /end DEF_CHARACTERISTIC /begin IN_MEASUREMENT BattCD_u /end IN_MEASUREMENT /begin OUT_MEASUREMENT InjVlv_iDCDC_mp /end OUT_MEASUREMENT /end FUNCTION
/begin FUNCTION injvlv_currdcdc_uic "" /end FUNCTION
/begin FUNCTION injvlv_errdet "Injektorfehlererkennung" /begin DEF_CHARACTERISTIC InjVlv_numSegOfs1_C InjVlv_numSegOfs2_C InjVlv_stErrDet_C /end DEF_CHARACTERISTIC /end FUNCTION
/begin FUNCTION injvlv_errdet_msg "" /begin OUT_MEASUREMENT InjVlv_nCyl InjVlv_qFBCCyl /end OUT_MEASUREMENT /end FUNCTION
/begin FUNCTION injvlv_errdet_uic "" /end FUNCTION
/begin FUNCTION injvlv_mon "Injektordiagnose"
 /begin DEF_CHARACTERISTIC InjVlv_ctMonQckThresLo_C InjVlv_ctMonQckThres_C InjVlv_DebBnkA0Def_C InjVlv_DebBnkA0Ok_C InjVlv_DebBnkA1Def_C InjVlv_DebBnkA1Ok_C InjVlv_DebBnkA2Def_C InjVlv_DebBnkA2Ok_C InjVlv_DebBnkA3Def_C InjVlv_DebBnkA3Ok_C InjVlv_DebBnkB0Def_C InjVlv_DebBnkB0Ok_C InjVlv_DebBnkB1Def_C InjVlv_DebBnkB1Ok_C InjVlv_DebBnkB2Def_C InjVlv_DebBnkB2Ok_C InjVlv_DebBnkB3Def_C InjVlv_DebBnkB3Ok_C InjVlv_DebChipA0Def_C InjVlv_DebChipA0Ok_C InjVlv_DebChipA1Def_C InjVlv_DebChipA1Ok_C InjVlv_DebChipA2Def_C InjVlv_DebChipA2Ok_C InjVlv_DebChipA3Def_C InjVlv_DebChipA3Ok_C InjVlv_DebChipB0Def_C InjVlv_DebChipB0Ok_C InjVlv_DebChipB1Def_C InjVlv_DebChipB1Ok_C InjVlv_DebChipB2Def_C InjVlv_DebChipB2Ok_C InjVlv_DebChipB3Def_C InjVlv_DebChipB3Ok_C InjVlv_DebCylA0Def_C InjVlv_DebCylA0Ok_C InjVlv_DebCylA1Def_C InjVlv_DebCylA1Ok_C InjVlv_DebCylA2Def_C InjVlv_DebCylA2Ok_C InjVlv_DebCylA3Def_C InjVlv_DebCylA3Ok_C InjVlv_DebCylB0Def_C InjVlv_DebCylB0Ok_C InjVlv_DebCylB1Def_C InjVlv_DebCylB1Ok_C InjVlv_DebCylB2Def_C InjVlv_DebCylB2Ok_C InjVlv_DebCylB3Def_C InjVlv_DebCylB3Ok_C InjVlv_DebCylC0Def_C InjVlv_DebCylC0Ok_C InjVlv_DebCylC1Def_C InjVlv_DebCylC1Ok_C InjVlv_DebCylC2Def_C InjVlv_DebCylC2Ok_C InjVlv_DebCylC3Def_C InjVlv_DebCylC3Ok_C InjVlv_iMonDisChDwn_C InjVlv_nMonQckThresLo_C InjVlv_numNoLoadCylMax_C InjVlv_stErrMskPattern_C InjVlv_stErrMskSelect_C InjVlv_stMonQckEna_C InjVlv_uMonBattThres_C /end DEF_CHARACTERISTIC
 /begin OUT_MEASUREMENT InjVlv_ctMonQckIDiff_mp InjVlv_ctMonQckISel_mp InjVlv_stMonQckErr_mp /end OUT_MEASUREMENT
/end FUNCTION
/begin FUNCTION injvlv_mon_msg ""
 /begin OUT_MEASUREMENT InjVlv_ctMonActrMeas InjVlv_stErrClctCyl1 InjVlv_stErrClctCyl2 InjVlv_stErrClctCyl3 InjVlv_stErrClctCyl4 InjVlv_stErrClctCyl5 InjVlv_stErrClctCyl6 InjVlv_stErrClctCyl7 InjVlv_stErrClctCyl8 InjVlv_stInjValve InjVlv_stMonDiag /end OUT_MEASUREMENT
/end FUNCTION
/begin FUNCTION injvlv_mon_uic ""
 /begin OUT_MEASUREMENT InjVlv_numIdxErrCyl1_mp InjVlv_numIdxErrCyl2_mp InjVlv_numIdxErrCyl3_mp InjVlv_numIdxErrCyl4_mp InjVlv_numIdxErrCyl5_mp InjVlv_numIdxErrCyl6_mp InjVlv_numIdxErrCyl7_mp InjVlv_numIdxErrCyl8_mp InjVlv_stErrUnknown_mp /end OUT_MEASUREMENT
/end FUNCTION
/begin FUNCTION injvlv_nvc "Nominal Voltage Calibration (Spannungsadaption)"
 /begin DEF_CHARACTERISTIC InjVlv_DebNVCDef_C InjVlv_DebNVCOK_C InjVlv_facNVCDflI_C InjVlv_facNVCDfpMax_C InjVlv_facNVCDfpMin_C InjVlv_facNVCInPI_C InjVlv_facNVCMax_C InjVlv_facNVCMin_C InjVlv_NVCIKi_C InjVlv_NVCIKiPos_C InjVlv_NVCIKiNeg_C InjVlv_uNVCIWinPos_C InjVlv_uNVCIWinNeg_C InjVlv_pNVCMax_C InjVlv_pNVCMin_C InjVlv_NVCPKp_C InjVlv_NVCPKpPos_C InjVlv_NVCPKpNeg_C InjVlv_uNVCPWinPos_C InjVlv_uNVCPWinNeg_C InjVlv_swtAvrgEnaTiNVC_C InjVlv_swtNVCStInjChar_C InjVlv_swtNVCWrDflVal_C InjVlv_tiNVCDwnThres_C InjVlv_tiNVCUpThres_C InjVlv_tNVCEngMax_C InjVlv_tNVCEngMin_C InjVlv_uDiffNVCSet_CUR InjVlv_uNVCThres_C InjVlv_uSetUpNVCActrMax_C InjVlv_uSetUpNVCActrMin_C /end DEF_CHARACTERISTIC
 /begin IN_MEASUREMENT InjVCD_pActInj /end IN_MEASUREMENT
 /begin OUT_MEASUREMENT InjVlv_facNVCEepWrI_mp InjVlv_facNVCInitI_mp InjVlv_stNVCCrit_mp InjVlv_uDiffNVCActrInPI_mp InjVlv_uDiffNVCActr_mp InjVlv_uDiffNVCSet_mp InjVlv_uSetUpNVCActrUnLim_mp /end OUT_MEASUREMENT
/end FUNCTION
/begin FUNCTION injvlv_nvc_msg ""
 /begin OUT_MEASUREMENT InjVlv_facNVCActr InjVlv_stNVCEna InjVlv_stNVCPI InjVlv_uSetUpNVCActr InjVlv_uSetUpTiChrgActr /end OUT_MEASUREMENT
/end FUNCTION
/begin FUNCTION injvlv_nvc_uic "" /end FUNCTION
/begin FUNCTION injvlv_presmin "Abschaltanforderung aufgrund Mindestdruck" /begin DEF_CHARACTERISTIC InjVlv_pMin_C InjVlv_pMin_CUR /end DEF_CHARACTERISTIC /begin IN_MEASUREMENT Eng_tEng /end IN_MEASUREMENT /end FUNCTION
/begin FUNCTION injvlv_qntadj "Injektor-Mengenabgleich"
 /begin DEF_CHARACTERISTIC InjVlv_numClsVltgAdjMax_C InjVlv_numClsVltgAdjMin_C InjVlv_stQntAdj_MAP InjVlv_volQntAdjLim_C InjVlv_volQntAdjMax0_C InjVlv_volQntAdjMax1_C InjVlv_volQntAdjMax2_C InjVlv_volQntAdjMax3_C InjVlv_volQntAdjMin0_C InjVlv_volQntAdjMin1_C InjVlv_volQntAdjMin2_C InjVlv_volQntAdjMin3_C /end DEF_CHARACTERISTIC
 /begin IN_MEASUREMENT InjUn_volMI1Cor_mp RailCD_pPeak /end IN_MEASUREMENT
 /begin OUT_MEASUREMENT InjVlv_numCodeVltgAdj_mp InjVlv_stAdj_mp InjVlv_stCheckSumErrVltgAdj_mp InjVlv_stMaxErrVltgAdj_mp /end OUT_MEASUREMENT
/end FUNCTION
/begin FUNCTION injvlv_qntadjrepl "" /begin DEF_CHARACTERISTIC InjVlv_stQntAdjRepl_C InjVlv_swtQntAdj_C /end DEF_CHARACTERISTIC /end FUNCTION
/begin FUNCTION injvlv_qntadj_uic ""
 /begin OUT_MEASUREMENT InjVlv_volMI1QntAdj_mp InjVlv_volPiI1QntAdj_mp InjVlv_volPiI2QntAdj_mp InjVlv_volPiI3QntAdj_mp InjVlv_volPoI1QntAdj_mp InjVlv_volPoI2QntAdj_mp /end OUT_MEASUREMENT
/end FUNCTION
/begin FUNCTION injvlv_tdiffhyd "" /begin DEF_CHARACTERISTIC InjVlv_swtDiffHydInSel_C InjVlv_tiDiffHyd_MAP /end DEF_CHARACTERISTIC /begin IN_MEASUREMENT InjVlv_pActInDiffHyd_mp InjVlv_qDesInDiffHyd_mp /end IN_MEASUREMENT /end FUNCTION
/begin FUNCTION injvlv_tdiffhyd_uic ""
 /begin OUT_MEASUREMENT InjVlv_pActInDiffHyd_mp InjVlv_qDesInDiffHyd_mp InjVlv_tiMI1DiffHydCor_mp InjVlv_tiPiI1DiffHydCor_mp InjVlv_tiPiI2DiffHydCor_mp /end OUT_MEASUREMENT
/end FUNCTION
/begin FUNCTION injvlv_wvcor "Druckwellenkorrektur"
 /begin DEF_CHARACTERISTIC InjVlv_facFTSWvCor_MAP InjVlv_qWvCorNorm_CUR InjVlv_stWvCorActv_C InjVlv_tWvCor_MAP /end DEF_CHARACTERISTIC
 /begin IN_MEASUREMENT CTSCD_tClnt FTSCD_tFuel InjVlv_tWvCor_mp RailCD_pPeak /end IN_MEASUREMENT
/end FUNCTION
/begin FUNCTION injvlv_wvcorlib "Druckwellenkorrektur Funktionsbibliothek"
 /begin DEF_CHARACTERISTIC InjVlv_facPiI2WvCor_C InjVlv_facWvCor1_MAP InjVlv_facWvCor2_MAP InjVlv_qWvCor1_MAP InjVlv_qWvCor2_MAP InjVlv_qWvCorMax_C InjVlv_qWvCorMin_C /end DEF_CHARACTERISTIC
 /begin IN_MEASUREMENT InjCrv_qMI1Des InjCrv_qPiI1Des InjCrv_qPoI2Des_mp InjVlv_rMI1WvCorNorm_mp InjVlv_tiMI1PoI2HydCor_mp InjVlv_tiPiI1MI1Cor_mp RailCD_pAct_mp /end IN_MEASUREMENT
 /begin OUT_MEASUREMENT InjVlv_pAct_mp /end OUT_MEASUREMENT
/end FUNCTION
/begin FUNCTION injvlv_wvcorlib_uic ""
 /begin OUT_MEASUREMENT InjVlv_facMI1PoI2WvCor_mp InjVlv_facPiI2PiI1WvCor_mp InjVlv_facPiIMI1WvCor_mp InjVlv_qMI1PoI2WvCor_mp InjVlv_qMI1WvCor_mp InjVlv_qPiI1MI1WvCor_mp InjVlv_qPiI1WvCor_mp InjVlv_qPiI2MI1WvCor_mp InjVlv_qPiI2PiI1WvCor_mp InjVlv_qPoI2WvCor_mp InjVlv_rMI1WvCorNorm_mp InjVlv_tiMI1PoI2Cor_mp InjVlv_tiMI1PoI2HydCor_mp InjVlv_tiMI1PoI2_mp InjVlv_tiPiI1MI1Cor_mp InjVlv_tiPiI1MI1_mp InjVlv_tiPiI2MI1Cor_mp InjVlv_tiPiI2MI1_mp InjVlv_tiPiI2PiI1Cor_mp InjVlv_tiPiI2PiI1_mp /end OUT_MEASUREMENT
/end FUNCTION
/begin FUNCTION injvlv_wvcor_msg "" /begin OUT_MEASUREMENT InjVlv_facFTSWvCor InjVlv_qWvCorNorm InjVlv_stWvCor /end OUT_MEASUREMENT /end FUNCTION
/begin FUNCTION injvlv_wvcor_uic "" /begin OUT_MEASUREMENT InjVlv_tWvCor_mp /end OUT_MEASUREMENT /end FUNCTION
/begin FUNCTION ivctl_tichrg "Ladezeitregelung des Piezoaktors"
 /begin DEF_CHARACTERISTIC IVCtl_ChrgUpIKi_C IVCtl_ChrgUpIKiPos_C IVCtl_ChrgUpIKiNeg_C IVCtl_tiChrgUpIWinPos_C IVCtl_tiChrgUpIWinNeg_C IVCtl_ChrgUpPKp_C IVCtl_ChrgUpPKpPos_C IVCtl_ChrgUpPKpNeg_C IVCtl_tiChrgUpPWinPos_C IVCtl_tiChrgUpPWinNeg_C IVCtl_DisChDwnIKi_C IVCtl_DisChDwnIKiPos_C IVCtl_DisChDwnIKiNeg_C IVCtl_tiDisChDwnIWinPos_C IVCtl_tiDisChDwnIWinNeg_C IVCtl_DisChDwnPKp_C IVCtl_DisChDwnPKpPos_C IVCtl_DisChDwnPKpNeg_C IVCtl_tiDisChDwnPWinPos_C IVCtl_tiDisChDwnPWinNeg_C IVCtl_iChrgUpCls_C IVCtl_iChrgUpGovMax_C IVCtl_iChrgUpGovMin_C IVCtl_iChrgUpInitI_C IVCtl_iChrgUpMax_C IVCtl_iChrgUpMin_C IVCtl_iChrgUp_MAP IVCtl_iDisChDwnCls_C IVCtl_iDisChDwnGovMax_C IVCtl_iDisChDwnGovMin_C IVCtl_iDisChDwnInitI_C IVCtl_iDisChDwnMax_C IVCtl_iDisChDwnMin_C IVCtl_iDisChDwn_CUR IVCtl_swtTiChrgMinMaxActr_C IVCtl_swtTiChrgMinMaxRst_C IVCtl_swtTiChrgMinMax_C IVCtl_tiChrgSetUp_MAP IVCtl_tiChrgUpPse_C IVCtl_tiDisChDwnPse_C IVCtl_tiDisChSetDwn_CUR /end DEF_CHARACTERISTIC
 /begin IN_MEASUREMENT RailCD_pPeak /end IN_MEASUREMENT
 /begin OUT_MEASUREMENT IVCtl_iChrgUp2_mp IVCtl_iChrgUpPI_mp IVCtl_iChrgUp_mp IVCtl_iDisChDwnPI_mp IVCtl_tiChrgSetUp_mp IVCtl_tiChrgUpAvrg_mp IVCtl_tiChrgUpInPIActr_mp IVCtl_tiChrgUpMaxActr_mp IVCtl_tiChrgUpMax_mp IVCtl_tiChrgUpMinActr_mp IVCtl_tiChrgUpMin_mp IVCtl_tiChrgUpPse_mp IVCtl_tiDisChBottAvrg_mp IVCtl_tiDisChDwnInPIActr_mp IVCtl_tiDisChDwnMaxActr_mp IVCtl_tiDisChDwnMax_mp IVCtl_tiDisChDwnMinActr_mp IVCtl_tiDisChDwnMin_mp IVCtl_tiDisChDwnPse_mp IVCtl_tiDisChSetDwn_mp IVCtl_uSetUp2Avrg_mp IVCtl_uSetUpAvrg_mp /end OUT_MEASUREMENT
/end FUNCTION
/begin FUNCTION ivctl_tichrg_msg ""
 /begin OUT_MEASUREMENT IVCtl_iDisChDwn IVCtl_iDisChDwn2 IVCtl_stTiChrgPI IVCtl_tiChrgUpInPI IVCtl_tiDisChDwnInPI /end OUT_MEASUREMENT
/end FUNCTION
/begin FUNCTION ivctl_volt "Spannungsregelung"
 /begin DEF_CHARACTERISTIC IVCtl_IKi_C IVCtl_IKiPos_C IVCtl_IKiNeg_C IVCtl_uIWinPos_C IVCtl_uIWinNeg_C IVCtl_PKp_C IVCtl_PKpPos_C IVCtl_PKpNeg_C IVCtl_uPWinPos_C IVCtl_uPWinNeg_C IVCtl_swtAvrgEnaTiWarnVolt_C IVCtl_swtUUpMinMaxActr_C IVCtl_swtUUpMinMaxRst_C IVCtl_swtUUpMinMax_C IVCtl_uClsActrUp_C IVCtl_uMaxSetUp_C IVCtl_uMinSetUp_C IVCtl_uPIMax_C IVCtl_uPIMin_C IVCtl_uSetUpPreCtl_CUR IVCtl_uUpInitI_C /end DEF_CHARACTERISTIC
 /begin IN_MEASUREMENT InjVlv_pCalcVolt /end IN_MEASUREMENT
 /begin OUT_MEASUREMENT IVCtl_stAvrgEnaTiWarnVolt_mp IVCtl_uSetUpActrUnCorr_mp IVCtl_uSetUpActrUnLim_mp IVCtl_uSetUpPreCtl_mp IVCtl_uSetUpTmp_mp IVCtl_uUpInPIActr_mp IVCtl_uUpInPIMaxActr_mp IVCtl_uUpInPIMax_mp IVCtl_uUpInPIMinActr_mp IVCtl_uUpInPIMin_mp IVCtl_uUpTmp_mp /end OUT_MEASUREMENT
/end FUNCTION
/begin FUNCTION ivctl_volt_msg ""
 /begin OUT_MEASUREMENT IVCtl_stVoltPI IVCtl_uClsActrUp IVCtl_uCorrUp IVCtl_uSetBott IVCtl_uSetOfsActr IVCtl_uSetUpActr IVCtl_uUpInPI /end OUT_MEASUREMENT
/end FUNCTION
/begin FUNCTION ivctl_volt_uic "" /end FUNCTION
/begin FUNCTION k2rdli "" /begin DEF_CHARACTERISTIC K2RDLI_dDataSetVer_C /end DEF_CHARACTERISTIC /end FUNCTION
/begin FUNCTION layer "Interface function to customer code"
 /begin DEF_CHARACTERISTIC Dmd_gen_C Layer_stAirCtlBits_C Layer_stPCR_C Layer_swtB_bsdprot Layer_swtTunProt_C Layer_tiDefWrEep_C PwrMng_B_ulcp_C PwrMng_dmAirPerTimeCor_C PwrMng_dmAirPerTimeIMax_C PwrMng_dmAirPerTimeIMin_C PwrMng_dmAirPerTimeIKi_C PwrMng_dmAirPerTimeIKiPos_C PwrMng_dmAirPerTimeIKiNeg_C PwrMng_dmAirPerTimeIWinPos_C PwrMng_dmAirPerTimeIWinNeg_C PwrMng_nB_kwdrehtHi_C PwrMng_nB_kwdrehtLo_C PwrMng_nB_llHigh_C PwrMng_nB_llLow_C PwrMng_rLoadMax_C PwrMng_stIdlingDefVal_C PwrMng_swtnmot_w_C PwrMng_swtPmsvActiv_C PwrMng_swttumg_C PwrMng_tiChgBatt_C PwrMng_tiHisRst_C PwrMng_Tkat_mod_C PwrMng_uAltTargetDefVal_C /end DEF_CHARACTERISTIC
/end FUNCTION
/begin FUNCTION layer_fltmng ""
 /begin DEF_CHARACTERISTIC Layer_ctDebBSDStep_C Layer_ctDebGENStep_C Layer_ctDebIBS1Step_C Layer_ctDebIBS2Step_C Layer_ctDebIBS3Step_C Layer_ctDebMANHYDRStep_C Layer_ctDebMANLUFTStep_C Layer_ctDebPMBATTStep_C Layer_ctDebPMBNStep_C Layer_ctDebPMRUHVERLStep_C Layer_ctDebQLTStep_C Layer_ctDebTANSStep_C Layer_ctDebTOENSStep_C Layer_ctDebTUMGStep_C Layer_ctDebBSDDef_C Layer_ctDebBSDOk_C Layer_ctDebGENDef_C Layer_ctDebGENOk_C Layer_ctDebIBS1Def_C Layer_ctDebIBS1Ok_C Layer_ctDebIBS2Def_C Layer_ctDebIBS2Ok_C Layer_ctDebIBS3Def_C Layer_ctDebIBS3Ok_C Layer_ctDebMANHYDRDef_C Layer_ctDebMANHYDROk_C Layer_ctDebMANLUFTDef_C Layer_ctDebMANLUFTOk_C Layer_ctDebPMBATTDef_C Layer_ctDebPMBATTOk_C Layer_ctDebPMBNDef_C Layer_ctDebPMBNOk_C Layer_ctDebPMRUHVERLDef_C Layer_ctDebPMRUHVERLOk_C Layer_ctDebQLTDef_C Layer_ctDebQLTOk_C Layer_ctDebTANSDef_C Layer_ctDebTANSOk_C Layer_ctDebTOENSDef_C Layer_ctDebTOENSOk_C Layer_ctDebTUMGDef_C Layer_ctDebTUMGOk_C /end DEF_CHARACTERISTIC
/end FUNCTION
/begin FUNCTION layer_fltmng_uic ""
 /begin OUT_MEASUREMENT BD_BSD BD_GEN BD_IBS1 BD_IBS2 BD_IBS3 BD_MANHYDR BD_MANLUFT BD_PMBATT BD_PMBN BD_PMRUHVERL BD_QLT BD_TANS BD_TOENS BD_TUMG E_BSD E_GEN E_IBS1 E_IBS2 E_IBS3 E_MANHYDR E_MANLUFT E_PMBATT E_PMBN E_PMRUHVERL E_QLT E_TANS E_TOENS E_TUMG RF_BSD RF_GEN RF_IBS1 RF_IBS2 RF_IBS3 RF_MANHYDR RF_MANLUFT RF_PMBATT RF_PMBN RF_PMRUHVERL RF_QLT RF_TANS RF_TOENS RF_TUMG ZF_BSD ZF_GEN ZF_IBS1 ZF_IBS2 ZF_IBS3 ZF_MANHYDR ZF_MANLUFT ZF_PMBATT ZF_PMBN ZF_PMRUHVERL ZF_QLT ZF_TANS ZF_TOENS ZF_TUMG /end OUT_MEASUREMENT
/end FUNCTION
/begin FUNCTION layer_msg ""
 /begin OUT_MEASUREMENT Layer_bos01_w Layer_bosbtvfbk Layer_bosstate Layer_bosvalue_DIAG Layer_FRC_INTM_T_BOS2 Layer_FRC_INTM_WAY_BOS2 Layer_ID2_BOS2 Layer_idbosmsg Layer_idfbosmg_w Layer_ID_FN_BOS2 Layer_stExtWaitRdy Layer_stLayer Layer_stOelTog Layer_stOelVerb Layer_stOelVerl Layer_TARD_MON_BOS2 Layer_TARD_YR_BOS2 Layer_volOil Layer_volOilRefill Layer_zrbosmld PwrMng_absch_korr PwrMng_d_soc PwrMng_iEngine PwrMng_iGen PwrMng_nMin PwrMng_nnnstart PwrMng_pwrDes PwrMng_pwrPTC PwrMng_rCtrPwrSpCos PwrMng_rdffgen PwrMng_stB_ccbtnach PwrMng_stB_ccbttdfk PwrMng_stB_ccbttknt PwrMng_stB_ccpmerr PwrMng_stB_ccprio PwrMng_stB_ccruhver PwrMng_stB_codierpm PwrMng_stCtrCbr PwrMng_stCtrPCos PwrMng_stCtrPrio PwrMng_stCtrPrioCf PwrMng_stCtrPwrCos PwrMng_stGen PwrMng_stLdstGen PwrMng_stLIGov PwrMng_stPCos PwrMng_stRqPCos PwrMng_stSelSpCos PwrMng_stTerminal61 PwrMng_stULev PwrMng_tiLRGen PwrMng_ubt PwrMng_uGen PwrMng_uGen2 /end OUT_MEASUREMENT
/end FUNCTION
/begin FUNCTION layer_uic ""
 /begin OUT_MEASUREMENT Counter_Layer_fp1000_mp Counter_Layer_fp100_mp Counter_Layer_fp10_mp Counter_Layer_fp200_mp Counter_Layer_ini_mp Counter_Layer_nl1000_mp Counter_Layer_nl100_mp Counter_Layer_nl10_mp Counter_Layer_nl200_mp Counter_Layer_wakeup1000_mp Counter_Layer_wakeup100_mp Counter_Layer_wakeup10_mp Counter_Layer_wakeup200_mp Layer_stProcess_u8_CBS_mp Layer_stProcess_u8_mp Layer_stProcess_u8_Tuning2_mp Layer_stProcess_u8_Tuning3_mp Layer_stProcess_u8_Tuning4_mp Layer_stProcess_u8_Tuning5_mp Layer_stProcess_u8_Tuning6_mp Layer_stProcess_u8_Tuning7_mp Layer_stProcess_u8_Tuning8_mp Layer_stProcess_u8_Tuning_mp PwrMng_dmAirPerTimeI_mp /end OUT_MEASUREMENT
/end FUNCTION
/begin COMPU_METHOD Actr_Calc "Zustände für Aktiv und Inaktiv" TAB_VERB "%6.3" "-" COMPU_TAB_REF Actr_Calc /end COMPU_METHOD
/begin COMPU_VTAB Actr_Calc "Zustände für Aktiv und Inaktiv" TAB_VERB 2 0 "Inactive" 1 "Active" /end COMPU_VTAB
/begin COMPU_METHOD Actr_Cls_State "Zustände für die Piezoaktor Klassifizierung" TAB_VERB "%6.3" "-" COMPU_TAB_REF Actr_Cls_State /end COMPU_METHOD
/begin COMPU_VTAB Actr_Cls_State "Zustände für die Piezoaktor Klassifizierung" TAB_VERB 4 0 "Wait" 1 "Energise" 2 "Measure" 4 "Done" /end COMPU_VTAB
/begin COMPU_METHOD AirMassPerTime "Luftmasse pro Zeit" RAT_FUNC "%6.3" "Kg/h" COEFFS 0 10 0 0 0 1 /end COMPU_METHOD
/begin COMPU_METHOD AngleCrS "Winkel Kurbelwelle" RAT_FUNC "%6.4" "deg CrS" COEFFS 0 42.6666666666667 0 0 0 1 /end COMPU_METHOD
/begin COMPU_METHOD Curr "Strom" RAT_FUNC "%6.2" "mA" COEFFS 0 1 0 0 0 1 /end COMPU_METHOD
/begin COMPU_METHOD DEZ "K3 Umwandlungen" RAT_FUNC "%6.2" "-" COEFFS 0 1 0 0 0 1 /end COMPU_METHOD
/begin COMPU_METHOD DtyCyc "Tastverhaeltnis" RAT_FUNC "%6.4" "%" COEFFS 0 100 0 0 0 1 /end COMPU_METHOD
/begin COMPU_METHOD EngN "Motordrehzahl" RAT_FUNC "%6.2" "rpm" COEFFS 0 1 0 0 0 1 /end COMPU_METHOD
/begin COMPU_METHOD Fact "Faktor mit Auflösung 1 / 8192, hauptsächlich für einen Faktorenbereich 0...1 verwendet" RAT_FUNC "%6.5" "-" COEFFS 0 8192 0 0 0 1 /end COMPU_METHOD
/begin COMPU_METHOD Fact1 "Faktor mit Auflösung 0,01 (100 mal höherer Bereich als Fact)" RAT_FUNC "%6.4" "-" COEFFS 0 128 0 0 0 1 /end COMPU_METHOD
/begin COMPU_METHOD fak_q0p5 "K3 Umwandlungen" RAT_FUNC "%6.3" "-" COEFFS 0 1 0 0 0 0.5 /end COMPU_METHOD
/begin COMPU_METHOD igen_ub_q1 "K3 Umwandlungen" RAT_FUNC "%6.2" "-" COEFFS 0 1 0 0 0 1 /end COMPU_METHOD
/begin COMPU_METHOD InjMass "Einspritzmenge" RAT_FUNC "%6.4" "mg/hub" COEFFS 0 100 0 0 0 1 /end COMPU_METHOD
/begin COMPU_METHOD InjMassCyc "Einspritzmenge pro Zyklus (mg/Zyklus)" RAT_FUNC "%6.4" "mg/cyc" COEFFS 0 100 0 0 0 1 /end COMPU_METHOD
/begin COMPU_METHOD InjMassInj "Einspritzmenge pro Einspritzung (mg/Einspritzung)" RAT_FUNC "%6.4" "mg/inj" COEFFS 0 100 0 0 0 1 /end COMPU_METHOD
/begin COMPU_METHOD InjQntInj "Einspritzmenge der einzelnen Einspritzung" RAT_FUNC "%6.4" "mm^3/inj" COEFFS 0 100 0 0 0 1 /end COMPU_METHOD
/begin COMPU_METHOD InjTime_us "Zeit in Microsekunden für das Einspritztiming" RAT_FUNC "%6.2" "us" COEFFS 0 1 0 0 0 1 /end COMPU_METHOD
/begin COMPU_METHOD ISA_Code "ISA-Code für den Injektorspannungsabgleich" TAB_VERB "%6.3" "-" COMPU_TAB_REF ISA_Code /end COMPU_METHOD
/begin COMPU_VTAB ISA_Code "ISA-Code für den Injektorspannungsabgleich" TAB_VERB 32 0 "A" 1 "B" 2 "C" 3 "D" 4 "E" 5 "F" 6 "G" 7 "H" 8 "I" 9 "K" 10 "L" 11 "M" 12 "N" 13 "O" 14 "P" 15 "R" 16 "S" 17 "T" 18 "U" 19 "V" 20 "W" 21 "X" 22 "Y" 23 "Z" 24 "1" 25 "2" 26 "3" 27 "4" 28 "5" 29 "6" 30 "7" 31 "8" /end COMPU_VTAB
/begin COMPU_METHOD Ki "Integrale Verstärkung Ki (gleiche Einheit/Umrechnungsregel an Ein- und Ausgang)" RAT_FUNC "%6.5" "1/s" COEFFS 0 4294.967296 0 0 0 1 /end COMPU_METHOD
/begin COMPU_METHOD Ki_us2mA "Umrechnung für PI-(Ent)ladezeitregler" RAT_FUNC "%6.4" "mA/(us*s)" COEFFS 0 429.4967296 0 0 0 1 /end COMPU_METHOD
/begin COMPU_METHOD Ki_VOLTPA2FACT "Integrale Verstärkung (Umrechnung von der Aktorspannung auf Faktor)" RAT_FUNC "%8.7" "1/(V*s)" COEFFS 0 351843.72088832 0 0 0 1 /end COMPU_METHOD
/begin COMPU_METHOD km_sw_q10 "K3 Umwandlungen" RAT_FUNC "%6.1" "-" COEFFS 0 0.1 0 0 0 1 /end COMPU_METHOD
/begin COMPU_METHOD Kp "proportionale Verstärkung Kp (gleiche Einheit/Umrechnungsregel an Ein- und Ausgang)" RAT_FUNC "%7.6" "1/1" COEFFS 0 65536 0 0 0 1 /end COMPU_METHOD
/begin COMPU_METHOD Kp_us2mA "Umrechnung für PI-(Ent)ladezeitregler" RAT_FUNC "%6.5" "mA/us" COEFFS 0 6553.6 0 0 0 1 /end COMPU_METHOD
/begin COMPU_METHOD Kp_VOLTPA2FACT "Proportionale Verstärkung (Umrechnung von der Aktorspannung auf den Faktor)" RAT_FUNC "%9.8" "1/V" COEFFS 0 5368709.12 0 0 0 1 /end COMPU_METHOD
/begin COMPU_METHOD OneToOne "eins zu eins (physikalischer Wert ist gleich dem internen Wert)" RAT_FUNC "%6.2" "-" COEFFS 0 1 0 0 0 1 /end COMPU_METHOD
/begin COMPU_METHOD PCENT "K3 Umwandlungen" RAT_FUNC "%6.3" "%" COEFFS 0 256 0 0 0 100 /end COMPU_METHOD
/begin COMPU_METHOD Prc "Prozent, gleiche interne Auflösung wie Fact, aber Darstellung in Prozent (0...100%)" RAT_FUNC "%6.4" "%" COEFFS 0 81.92 0 0 0 1 /end COMPU_METHOD
/begin COMPU_METHOD Pres_AC "Druck (Klimatisierung)" RAT_FUNC "%7.2" "hPa" COEFFS 0 0.500000 0 0 0 1 /end COMPU_METHOD
/begin COMPU_METHOD Pres_Rail "Raildruck in hPa" RAT_FUNC "%4.3" "bar" COEFFS 0 10.000000 0 0 0 1 /end COMPU_METHOD
/begin COMPU_METHOD Pres_SI "Druck (angezeigt in [Pa])" RAT_FUNC "%6.0" "Pa" COEFFS 0 0.01 0 0 0 1 /end COMPU_METHOD
/begin COMPU_METHOD Pwr "Leistung" RAT_FUNC "%6.2" "W" COEFFS 0 0.10610329539459 0 0 0 1 /end COMPU_METHOD
/begin COMPU_METHOD Pwr_kW "Leistung in kW" RAT_FUNC "%6.4" "kW" COEFFS 0 100 0 0 0 1 /end COMPU_METHOD
/begin COMPU_METHOD Pwr_PA "Leistung für Piezo-Aktor" RAT_FUNC "%6.2" "mW" COEFFS 0 1 0 0 0 1 /end COMPU_METHOD
/begin COMPU_METHOD QntR "Normierungsverhältnis Einspritzmenge / Normierungsmenge" RAT_FUNC "%6.5" "-" COEFFS 0 1024 0 0 0 1 /end COMPU_METHOD
/begin COMPU_METHOD rel_ub_q1 "K3 Umwandlungen" RAT_FUNC "%6.2" "%" COEFFS 0 1 0 0 0 1 /end COMPU_METHOD
/begin COMPU_METHOD SlopeRes10000 "Umrechnung für Slope: Slopewert mit Verhältnis 0,0001" RAT_FUNC "%7.6" "-" COEFFS 0 10000 0 0 0 1 /end COMPU_METHOD
/begin COMPU_METHOD spg_uw_q0p015 "K3 Umwandlungen" RAT_FUNC "%9.5" "V" COEFFS 0 1 0 0 0 0.015 /end COMPU_METHOD
/begin COMPU_METHOD stMonShCir "Status des Ansteuerung im nachlauf für Kurzschlussunterscheidung" TAB_VERB "%6.3" "-" COMPU_TAB_REF stMonShCir /end COMPU_METHOD
/begin COMPU_VTAB stMonShCir "Status des Ansteuerung im nachlauf für Kurzschlussunterscheidung" TAB_VERB 4 0 "Wait" 1 "Energise" 2 "Gettime" 4 "Done" /end COMPU_VTAB
/begin COMPU_METHOD Temp_Cels "Temperatur dargestellt in °C (gleiche interne Darstellung wie Temp_Kelv)" RAT_FUNC "%6.1" "deg C" COEFFS 0 10 2731.4 0 0 1 /end COMPU_METHOD
/begin COMPU_METHOD temp_ub_q5_o50 "K3 Umwandlungen" RAT_FUNC "%6.2" "Grad C" COEFFS 0 1 50 0 0 5 /end COMPU_METHOD
/begin COMPU_METHOD Time_Busy "Lade-/Entladezeit der Piezosteller (us)" RAT_FUNC "%6.3" "us" COEFFS 0 10 0 0 0 1 /end COMPU_METHOD
/begin COMPU_METHOD Time_ms "Zeit in ms für Fehlerentprellung (DSM) und SW-Timer" RAT_FUNC "%6.1" "ms" COEFFS 0 0.1 0 0 0 1 /end COMPU_METHOD
/begin COMPU_METHOD Time_s "Zeit in s für Fehlerentprellung (DSM) und SW-Timer" RAT_FUNC "%6.4" "s" COEFFS 0 100 0 0 0 1 /end COMPU_METHOD
/begin COMPU_METHOD VltgAdj "Zustand des Injektor Spannungsabgleichs" TAB_VERB "%6.3" "-" COMPU_TAB_REF VltgAdj /end COMPU_METHOD
/begin COMPU_VTAB VltgAdj "Zustand des Injektor Spannungsabgleichs" TAB_VERB 3 0 "EEPROM" 1 "replace values" 8 "external access" /end COMPU_VTAB
/begin COMPU_METHOD Volt "Spannung in V (von ADC)" RAT_FUNC "%6.2" "mV" COEFFS 0 0.2046 0 0 0 1 /end COMPU_METHOD
/begin COMPU_METHOD VoltInt "Spannung vom ADC zum Integratorabgleich" RAT_FUNC "%6.4" "mV" COEFFS 0 204.6 0 0 0 1 /end COMPU_METHOD
/begin COMPU_METHOD Volt_Batt "Batteriespannung" RAT_FUNC "%6.1" "mV" COEFFS 0 0.05115 0 0 0 1 /end COMPU_METHOD
/begin COMPU_METHOD Volt_BUFC "zur Berechnung der DC/DC-Wandler Pufferspannung" RAT_FUNC "%6.4" "V" COEFFS 0 100 0 0 0 1 /end COMPU_METHOD
/begin COMPU_METHOD Volt_PA "Spannung des Piezo-Aktors" RAT_FUNC "%6.4" "V" COEFFS 0 100 0 0 0 1 /end COMPU_METHOD
/begin COMPU_METHOD W_PA "Energieverbrauch des Piezo-Aktors" RAT_FUNC "%6.2" "mWs" COEFFS 0 1 0 0 0 1 /end COMPU_METHOD
/begin COMPU_METHOD defaultAscii "" RAT_FUNC "%6.2" "-" COEFFS 0 1 0 0 0 1 /end COMPU_METHOD
/begin RECORD_LAYOUT Gkf_Ws16 FNC_VALUES 1 SWORD COLUMN_DIR DIRECT /end RECORD_LAYOUT
/begin RECORD_LAYOUT GSst_Xs16 NO_AXIS_PTS_X 1 SWORD AXIS_PTS_X 2 SWORD INDEX_INCR DIRECT /end RECORD_LAYOUT
/begin RECORD_LAYOUT Kf_Xs16_Ys16_Ws16 NO_AXIS_PTS_X 1 SWORD NO_AXIS_PTS_Y 2 SWORD AXIS_PTS_X 3 SWORD INDEX_INCR DIRECT AXIS_PTS_Y 4 SWORD INDEX_INCR DIRECT FNC_VALUES 5 SWORD COLUMN_DIR DIRECT /end RECORD_LAYOUT
/begin RECORD_LAYOUT Kl_Xs16_Ws16 NO_AXIS_PTS_X 1 SWORD AXIS_PTS_X 2 SWORD INDEX_INCR DIRECT FNC_VALUES 3 SWORD COLUMN_DIR DIRECT /end RECORD_LAYOUT
/begin RECORD_LAYOUT Kwb_Ws16 FNC_VALUES 1 SWORD COLUMN_DIR DIRECT /end RECORD_LAYOUT
/begin RECORD_LAYOUT Kwb_Wu32 FNC_VALUES 1 ULONG COLUMN_DIR DIRECT /end RECORD_LAYOUT
/begin RECORD_LAYOUT Kwb_Wu8 FNC_VALUES 1 UBYTE COLUMN_DIR DIRECT /end RECORD_LAYOUT
/begin RECORD_LAYOUT Kw_Ws16 FNC_VALUES 1 SWORD COLUMN_DIR DIRECT /end RECORD_LAYOUT
/begin RECORD_LAYOUT Kw_Ws32 FNC_VALUES 1 SLONG COLUMN_DIR DIRECT /end RECORD_LAYOUT
/begin RECORD_LAYOUT Kw_Wu16 FNC_VALUES 1 UWORD COLUMN_DIR DIRECT /end RECORD_LAYOUT
/begin RECORD_LAYOUT Kw_Wu32 FNC_VALUES 1 ULONG COLUMN_DIR DIRECT /end RECORD_LAYOUT
/begin RECORD_LAYOUT Kw_Wu8 FNC_VALUES 1 UBYTE COLUMN_DIR DIRECT /end RECORD_LAYOUT
/end MODULE
/end PROJECT
