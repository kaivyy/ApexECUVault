ASAP2_VERSION 1 3
/begin PROJECT P390 "BMW DDE6.2 6-Zylinder VR0.1 15.03.2004 CAN11/12H"
/begin HEADER "" VERSION "VR0.1_6Z_CAN11/12H" PROJECT_NO P390 /end HEADER
/begin MODULE DIM ""
/begin MOD_COMMON "" BYTE_ORDER MSB_FIRST ALIGNMENT_BYTE 1 ALIGNMENT_WORD 2 ALIGNMENT_LONG 4 ALIGNMENT_FLOAT32_IEEE 4 /end MOD_COMMON
/begin CHARACTERISTIC PCR_ctAirPerTimeFrq_C "Anzahl der Abtastungen der erfassten Frischluftmasse für die diskrete Fouriertransformation" VALUE 0xEB0EC Kw_Wu8 9.000 OneToOne 1.000 10.00 FORMAT "%5.2" EXTENDED_LIMITS 0.00 255.0 /end CHARACTERISTIC
/begin CHARACTERISTIC PCR_DebLPDvtNegDef_C "Vorentprellzeit für Erkennung negativer bleibender Regelabw." VALUE 0xEAB68 Kw_Wu16 655350.0 Time_ms 0.00 655350.0 FORMAT "%8.1" /end CHARACTERISTIC
/begin CHARACTERISTIC PCR_DebLPDvtNegOk_C "Vorentprellzeit für Heilung bei negativer bleibender Regelabw." VALUE 0xEAB6A Kw_Wu16 655350.0 Time_ms 0.00 655350.0 FORMAT "%8.1" /end CHARACTERISTIC
/begin CHARACTERISTIC PCR_DebLPDvtPosDef_C "Vorentprellzeit für Erkennung positiver bleibender Regelabw." VALUE 0xEAB6C Kw_Wu16 655350.0 Time_ms 0.00 655350.0 FORMAT "%8.1" /end CHARACTERISTIC
/begin CHARACTERISTIC PCR_DebLPDvtPosOk_C "Vorentprellzeit für Heilung bei positiver bleibender Regelabw." VALUE 0xEAB6E Kw_Wu16 655350.0 Time_ms 0.00 655350.0 FORMAT "%8.1" /end CHARACTERISTIC
/begin CHARACTERISTIC PCR_DebSRCHighDef_C "Defektzeit SRC-high" VALUE 0xEAC90 Kw_Wu16 655350.0 Time_ms 0.00 655350.0 FORMAT "%8.1" /end CHARACTERISTIC
/begin CHARACTERISTIC PCR_DebSRCHighOk_C "Heilungszeit SRC-high" VALUE 0xEAC92 Kw_Wu16 655350.0 Time_ms 0.00 655350.0 FORMAT "%8.1" /end CHARACTERISTIC
/begin CHARACTERISTIC PCR_DebSRCLowDef_C "Defektzeit SRC-low" VALUE 0xEAC94 Kw_Wu16 655350.0 Time_ms 0.00 655350.0 FORMAT "%8.1" /end CHARACTERISTIC
/begin CHARACTERISTIC PCR_DebSRCLowOk_C "Heilungszeit SRC-low" VALUE 0xEAC96 Kw_Wu16 655350.0 Time_ms 0.00 655350.0 FORMAT "%8.1" /end CHARACTERISTIC
/begin CHARACTERISTIC PCR_dnSurgeCtlRel_C "Max. Limit für Drehzahlbeschl. bei Erkennung gleicher Status" VALUE 0xEAEAC Kw_Ws16 655350.0 dn_dZ20 -327680.0 327670.0 FORMAT "%8.1" /end CHARACTERISTIC
/begin CHARACTERISTIC PCR_dpSurgeCtlRmpUp_C "Anti Surge Rampensteigung AUF" VALUE 0xEAEB0 Kw_Wu32 65535999.9847 RmpPres_hPa 0.00 65535999.9847 FORMAT "%13.4" /end CHARACTERISTIC
/begin CHARACTERISTIC PCR_dpSurgeCtlRmpDwn_C "Anti Surge Rampensteigung AB" VALUE 0xEAEB4 Kw_Wu32 65535999.9847 RmpPres_hPa 0.00 65535999.9847 FORMAT "%13.4" /end CHARACTERISTIC
/begin CHARACTERISTIC PCR_dqSurgeCtlRel_C "Max. Limit für Einspritzmengengradienten bei Erkennung gleicher Status" VALUE 0xEAEB8 Kw_Ws16 32767.50 InjMassPerSec_20ms -16384.00 16383.50 FORMAT "%8.2" /end CHARACTERISTIC
/begin CHARACTERISTIC PCR_drSurgeCtlRmpUp_C "Anti Surge Rampensteigung AUF" VALUE 0xEAEBC Kw_Wu32 799999.999814 RmpPrc 0.00 799999.999814 FORMAT "%13.6" /end CHARACTERISTIC
/begin CHARACTERISTIC PCR_drSurgeCtlRmpDwn_C "Anti Surge Rampensteigung AB" VALUE 0xEAEC0 Kw_Wu32 799999.999814 RmpPrc 0.00 799999.999814 FORMAT "%13.6" /end CHARACTERISTIC
/begin CHARACTERISTIC PCR_facAirPerTimeAmplMax_C "Obere Grenzwert für die Turboladerpumpgrenzerkennung" VALUE 0xEB0EE Kw_Ws16 2047.938 FactM 0.00 2047.938 FORMAT "%8.3" EXTENDED_LIMITS -2048.000 2047.938 /end CHARACTERISTIC
/begin CHARACTERISTIC PCR_facAirPerTimeAmplMin_C "Untere Grenzwert für die Turboladerpumpgrenzerkennung" VALUE 0xEB0F0 Kw_Ws16 2047.938 FactM 0.00 2047.938 FORMAT "%8.3" EXTENDED_LIMITS -2048.000 2047.938 /end CHARACTERISTIC
/begin CHARACTERISTIC PCR_facCnv_CUR "Kennlinie zur Amplitudenhöhe der oszillierenden Frischluftmasse beim Laderpumpen" CURVE 0xEB0F2 Kl_Xs16_Ws16 1.000000 FactM 0.00 1.000000 FORMAT "%8.6" EXTENDED_LIMITS -2048.000 2047.938
 /begin AXIS_DESCR STD_AXIS PCR_facAirPerTimeAmplFlt_mp FactM 10 -2048.000 2047.938 FORMAT "%8.3" DEPOSIT ABSOLUTE /end AXIS_DESCR
/end CHARACTERISTIC
/begin CHARACTERISTIC PCR_facSin_CUR "Sinusfunktion als Kennlinie" CURVE 0xEB11C Kl_Xs16_Ws16 1.000000 Fact 0.00 1.000000 FORMAT "%8.6" EXTENDED_LIMITS -4.000000 3.999878 READ_ONLY
 /begin AXIS_DESCR STD_AXIS PCR_facSinIn_mp Fact1 11 -256.0000 255.9922 FORMAT "%8.4" DEPOSIT ABSOLUTE /end AXIS_DESCR
/end CHARACTERISTIC
/begin CHARACTERISTIC PCR_facSqr_CUR "Quadratwurzelfunktion als Kennlinie" CURVE 0xEB14A Kl_Xs16_Ws16 2047.938 FactM 0.00 2047.938 FORMAT "%8.3" EXTENDED_LIMITS -2048.000 2047.938 READ_ONLY
 /begin AXIS_DESCR STD_AXIS PCR_facSqrIn_mp FactM 19 0.00 2047.938 FORMAT "%8.3" EXTENDED_LIMITS -2048.000 2047.938 DEPOSIT ABSOLUTE /end AXIS_DESCR
/end CHARACTERISTIC
/begin CHARACTERISTIC PCR_facSurgeDes_CUR "Kennlinie für Sollwert Luftmassenschwingung" CURVE 0xEAEC4 Kl_Xs16_Ws16 4095.938 FactM -2048.000 2047.938 FORMAT "%8.3"
 /begin AXIS_DESCR STD_AXIS Eng_nAvrg EngN 6 0.00 6000.000 FORMAT "%8.3" EXTENDED_LIMITS -32768.00 32767.00 DEPOSIT ABSOLUTE /end AXIS_DESCR
/end CHARACTERISTIC
/begin CHARACTERISTIC PCR_facSurgeI_MAP "Kennfeld für Adaptionsfaktor der I-Verstärkung" MAP 0xEAEDE Kf_Xs16_Ys16_Ws16 50.00000 Fact1 0.00 50.00000 FORMAT "%8.5" EXTENDED_LIMITS -256.0000 255.9922
 /begin AXIS_DESCR STD_AXIS Eng_nAvrg EngN 6 0.00 6000.000 FORMAT "%8.3" EXTENDED_LIMITS -32768.00 32767.00 DEPOSIT ABSOLUTE /end AXIS_DESCR
 /begin AXIS_DESCR STD_AXIS InjCtl_qCurr InjMassCyc 4 0.00 327.6700 FORMAT "%8.4" EXTENDED_LIMITS -327.6800 327.6700 DEPOSIT ABSOLUTE /end AXIS_DESCR
/end CHARACTERISTIC
/begin CHARACTERISTIC PCR_facSurgeP_MAP "Kennfeld für Adaptionsfaktor der P-Verstärkung" MAP 0xEAF26 Kf_Xs16_Ys16_Ws16 50.00000 Fact1 0.00 50.00000 FORMAT "%8.5" EXTENDED_LIMITS -256.0000 255.9922
 /begin AXIS_DESCR STD_AXIS Eng_nAvrg EngN 6 0.00 6000.000 FORMAT "%8.3" EXTENDED_LIMITS -32768.00 32767.00 DEPOSIT ABSOLUTE /end AXIS_DESCR
 /begin AXIS_DESCR STD_AXIS InjCtl_qCurr InjMassCyc 4 0.00 327.6700 FORMAT "%8.4" EXTENDED_LIMITS -327.6800 327.6700 DEPOSIT ABSOLUTE /end AXIS_DESCR
/end CHARACTERISTIC
/begin CHARACTERISTIC PCR_ISurgeKi_C "Grundwert der I-Verstärkung des PI-Reglers bei Kleinsignalen" VALUE 0xEAF70 Kw_Wu32 15999999.9963 Ki_Pres_fac2hPa 0.00 15999999.9963 FORMAT "%13.4" /end CHARACTERISTIC
/begin CHARACTERISTIC PCR_ISurgeKiPos_C "Grundwert der I-Verstärkung des PI-Reglers bei pos.Großsignalen" VALUE 0xEAF74 Kw_Wu32 15999999.9963 Ki_Pres_fac2hPa 0.00 15999999.9963 FORMAT "%13.4" /end CHARACTERISTIC
/begin CHARACTERISTIC PCR_ISurgeKiNeg_C "Grundwert der I-Verstärkung des PI-Reglers bei neg.Großsignalen" VALUE 0xEAF78 Kw_Wu32 15999999.9963 Ki_Pres_fac2hPa 0.00 15999999.9963 FORMAT "%13.4" /end CHARACTERISTIC
/begin CHARACTERISTIC PCR_facSurgeIWinPos_C "Obere Kleinsignalgrenze für das P-Glied des AntiSurge-Reglers" VALUE 0xEAF7C Kw_Ws16 4095.938 FactM -2048.000 2047.938 FORMAT "%8.3" /end CHARACTERISTIC
/begin CHARACTERISTIC PCR_facSurgeIWinNeg_C "Untere Kleinsignalgrenze für das P-Glied des AntiSurge-Reglers" VALUE 0xEAF7E Kw_Ws16 4095.938 FactM -2048.000 2047.938 FORMAT "%8.3" /end CHARACTERISTIC
/begin CHARACTERISTIC PCR_nCoStart_C "#SSD untere Drehzahlgrenze für Kaltstarterkennung-Vorgabewert" VALUE 0xEAC98 Kw_Ws16 65535.00 EngN -32768.00 32767.00 FORMAT "%8.2" /end CHARACTERISTIC
/begin CHARACTERISTIC PCR_nCoStrtHigh_C "#SSD obere Drehzahlgrenze für Kaltstarterkennung-Vorgabewert" VALUE 0xEAC9A Kw_Ws16 5960.000 EngN 40.00000 6000.000 FORMAT "%8.3" EXTENDED_LIMITS -32768.00 32767.00 /end CHARACTERISTIC
/begin CHARACTERISTIC PCR_nLPWrkSph2_C "obere Drehzahlgrenze des Arbeitsbereichs 2" VALUE 0xEAB70 Kw_Ws16 5960.000 EngN 40.00000 6000.000 FORMAT "%8.3" EXTENDED_LIMITS -32768.00 32767.00 /end CHARACTERISTIC
/begin CHARACTERISTIC PCR_nLPWrkSph3_C "obere Drehzahlgrenze des Arbeitsbereichs 3" VALUE 0xEAB72 Kw_Ws16 5960.000 EngN 40.00000 6000.000 FORMAT "%8.3" EXTENDED_LIMITS -32768.00 32767.00 /end CHARACTERISTIC
/begin CHARACTERISTIC PCR_nWrkSph1_C "obere Drehzahlgrenze des Arbeitsbereiches 1" VALUE 0xEAC9C Kw_Ws16 8000.000 EngN 0.00 8000.000 FORMAT "%8.3" EXTENDED_LIMITS -32768.00 32767.00 /end CHARACTERISTIC
/begin CHARACTERISTIC PCR_nWrkSph2_C "Drehzahlgrenze zwischen den Arbeitsbereichen 2 und 3" VALUE 0xEAC9E Kw_Ws16 8000.000 EngN 0.00 8000.000 FORMAT "%8.3" EXTENDED_LIMITS -32768.00 32767.00 /end CHARACTERISTIC
/begin CHARACTERISTIC PCR_nWrkSph3_C "Drehzahlgrenze zwischen den Arbeitsbereichen 3 und 4" VALUE 0xEACA0 Kw_Ws16 8000.000 EngN 0.00 8000.000 FORMAT "%8.3" EXTENDED_LIMITS -32768.00 32767.00 /end CHARACTERISTIC
/begin CHARACTERISTIC PCR_pBGDevMaxOffset_C "#SSD Max. Regelabweichung PCR - Offset während DSC-Eingriff (eingefrorener Leadpfad)" VALUE 0xEACA2 Kw_Ws16 65535.00 Pres_hPa -32768.00 32767.00 FORMAT "%8.2" /end CHARACTERISTIC
/begin CHARACTERISTIC PCR_pBGDevMax_MAP "Kennfeld der Obergrenze für Erkennung einer bleibenden Regelabweichung" MAP 0xEACA4 Kf_Xs16_Ys16_Ws16 4000.000 Pres_hPa 0.00 4000.000 FORMAT "%8.3" EXTENDED_LIMITS -32768.00 32767.00
 /begin AXIS_DESCR STD_AXIS Eng_nAvrg EngN 4 0.00 6000.000 FORMAT "%8.3" EXTENDED_LIMITS -32768.00 32767.00 DEPOSIT ABSOLUTE /end AXIS_DESCR
 /begin AXIS_DESCR STD_AXIS InjCtl_qCurr InjMassCyc 4 0.00 327.6700 FORMAT "%8.4" EXTENDED_LIMITS -327.6800 327.6700 DEPOSIT ABSOLUTE /end AXIS_DESCR
/end CHARACTERISTIC
/begin CHARACTERISTIC PCR_pBGDevMinOffset_C "#SSD neg. Regelabweichung PCR - Offset während DSC-Eingriff (eingefrorener Leadpfad)" VALUE 0xEACD8 Kw_Ws16 65535.00 Pres_hPa -32768.00 32767.00 FORMAT "%8.2" /end CHARACTERISTIC
/begin CHARACTERISTIC PCR_pBGDevMin_MAP "Untergrenze für Erkennung einer bleibenden Regelabweichung" MAP 0xEACDA Kf_Xs16_Ys16_Ws16 4300.000 Pres_hPa -300.0000 4000.000 FORMAT "%8.3" EXTENDED_LIMITS -32768.00 32767.00
 /begin AXIS_DESCR STD_AXIS Eng_nAvrg EngN 4 0.00 6000.000 FORMAT "%8.3" EXTENDED_LIMITS -32768.00 32767.00 DEPOSIT ABSOLUTE /end AXIS_DESCR
 /begin AXIS_DESCR STD_AXIS InjCtl_qCurr InjMassCyc 4 0.00 327.6700 FORMAT "%8.4" EXTENDED_LIMITS -327.6800 327.6700 DEPOSIT ABSOLUTE /end AXIS_DESCR
/end CHARACTERISTIC
/begin CHARACTERISTIC PCR_pBSurgeDesMax_MAP "Kennfeld zur Bestimmung der max. zulässigen Stellgröße" MAP 0xEAF80 Kf_Xs16_Ys16_Ws16 65535.00 Pres_hPa -32768.00 32767.00 FORMAT "%8.2"
 /begin AXIS_DESCR STD_AXIS Eng_nAvrg EngN 5 0.00 6000.000 FORMAT "%8.3" EXTENDED_LIMITS -32768.00 32767.00 DEPOSIT ABSOLUTE /end AXIS_DESCR
 /begin AXIS_DESCR STD_AXIS InjCtl_qCurr InjMassCyc 5 0.00 327.6700 FORMAT "%8.4" EXTENDED_LIMITS -327.6800 327.6700 DEPOSIT ABSOLUTE /end AXIS_DESCR
/end CHARACTERISTIC
/begin CHARACTERISTIC PCR_pBSurgeDesMin_MAP "Kennfeld zur Bestimmung der min. zulässigen Stellgröße" MAP 0xEAFCA Kf_Xs16_Ys16_Ws16 65535.00 Pres_hPa -32768.00 32767.00 FORMAT "%8.2"
 /begin AXIS_DESCR STD_AXIS Eng_nAvrg EngN 5 0.00 6000.000 FORMAT "%8.3" EXTENDED_LIMITS -32768.00 32767.00 DEPOSIT ABSOLUTE /end AXIS_DESCR
 /begin AXIS_DESCR STD_AXIS InjCtl_qCurr InjMassCyc 5 0.00 327.6700 FORMAT "%8.4" EXTENDED_LIMITS -327.6800 327.6700 DEPOSIT ABSOLUTE /end AXIS_DESCR
/end CHARACTERISTIC
/begin CHARACTERISTIC PCR_pBSurgeDes_CUR "Kennlinie für Sollwert Ladedruck zur Reduktion Laderpumpen" CURVE 0xEB014 Kl_Xs16_Ws16 65535.00 Pres_hPa -32768.00 32767.00 FORMAT "%8.2"
 /begin AXIS_DESCR STD_AXIS PCR_pBSurgePICtlLim_mp Pres_hPa 2 -32768.00 32767.00 FORMAT "%8.2" DEPOSIT ABSOLUTE /end AXIS_DESCR
/end CHARACTERISTIC
/begin CHARACTERISTIC PCR_pDvtSurgeCtlRel_C "Max. Limit für Stellerabweichung bei Erkennung gleicher Status" VALUE 0xEB01E Kw_Ws16 65535.00 Pres_hPa -32768.00 32767.00 FORMAT "%8.2" /end CHARACTERISTIC
/begin CHARACTERISTIC PCR_pLPDvtMaxOffset_C "Offset für Obergrenze für Erkennung einer bleibenden Regelabweichung" VALUE 0xEAB74 Kw_Ws16 65535.00 Pres_hPa -32768.00 32767.00 FORMAT "%8.2" /end CHARACTERISTIC
/begin CHARACTERISTIC PCR_pLPDvtMax_MAP "Obergrenze für Erkennung einer bleibenden Regelabweichung" MAP 0xEAB76 Kf_Xs16_Ys16_Ws16 4000.000 Pres_hPa 0.00 4000.000 FORMAT "%8.3" EXTENDED_LIMITS -32768.00 32767.00
 /begin AXIS_DESCR STD_AXIS Eng_nAvrg EngN 4 0.00 6000.000 FORMAT "%8.3" EXTENDED_LIMITS -32768.00 32767.00 DEPOSIT ABSOLUTE /end AXIS_DESCR
 /begin AXIS_DESCR STD_AXIS InjCtl_qCurr InjMassCyc 4 0.00 327.6700 FORMAT "%8.4" EXTENDED_LIMITS -327.6800 327.6700 DEPOSIT ABSOLUTE /end AXIS_DESCR
/end CHARACTERISTIC
/begin CHARACTERISTIC PCR_pLPDvtMinOffset_C "Offset für Untergrenze für Erkennung einer bleibenden Regelabweichung" VALUE 0xEABAA Kw_Ws16 65535.00 Pres_hPa -32768.00 32767.00 FORMAT "%8.2" /end CHARACTERISTIC
/begin CHARACTERISTIC PCR_pLPDvtMin_MAP "Untergrenze für Erkennung einer bleibenden Regelabweichung Niederdruckstufe" MAP 0xEABAC Kf_Xs16_Ys16_Ws16 4300.000 Pres_hPa -300.0000 4000.000 FORMAT "%8.3" EXTENDED_LIMITS -32768.00 32767.00
 /begin AXIS_DESCR STD_AXIS Eng_nAvrg EngN 4 0.00 6000.000 FORMAT "%8.3" EXTENDED_LIMITS -32768.00 32767.00 DEPOSIT ABSOLUTE /end AXIS_DESCR
 /begin AXIS_DESCR STD_AXIS InjCtl_qCurr InjMassCyc 4 0.00 327.6700 FORMAT "%8.4" EXTENDED_LIMITS -327.6800 327.6700 DEPOSIT ABSOLUTE /end AXIS_DESCR
/end CHARACTERISTIC
/begin CHARACTERISTIC PCR_pSurgeARWIMin_C "minimal zulässige ARW ant-surge regler" VALUE 0xEB020 Kw_Ws16 7000.000 Pres_hPa -3500.000 3500.000 FORMAT "%8.3" EXTENDED_LIMITS -32768.00 32767.00 /end CHARACTERISTIC
/begin CHARACTERISTIC PCR_PSurgeKp_C "Grundwert der P-Verstärkung des PI-Reglers bei Kleinsigna-len" VALUE 0xEB024 Kw_Wu32 1048575.99976 Kp_Pres_fac2hPa 0.00 1048575.99976 FORMAT "%13.5" /end CHARACTERISTIC
/begin CHARACTERISTIC PCR_PSurgeKpPos_C "Grundwert der P-Verstärkung des PI-Reglers bei pos.Großsignalen" VALUE 0xEB028 Kw_Wu32 1048575.99976 Kp_Pres_fac2hPa 0.00 1048575.99976 FORMAT "%13.5" /end CHARACTERISTIC
/begin CHARACTERISTIC PCR_PSurgeKpNeg_C "Grundwert der P-Verstärkung des PI-Reglers bei neg.Großsignalen" VALUE 0xEB02C Kw_Wu32 1048575.99976 Kp_Pres_fac2hPa 0.00 1048575.99976 FORMAT "%13.5" /end CHARACTERISTIC
/begin CHARACTERISTIC PCR_facSurgePWinPos_C "Obere Kleinsignalgrenze für das P-Glied des AntiSurge-Reglers" VALUE 0xEB030 Kw_Ws16 4095.938 FactM -2048.000 2047.938 FORMAT "%8.3" /end CHARACTERISTIC
/begin CHARACTERISTIC PCR_facSurgePWinNeg_C "Untere Kleinsignalgrenze für das P-Glied des AntiSurge-Reglers" VALUE 0xEB032 Kw_Ws16 4095.938 FactM -2048.000 2047.938 FORMAT "%8.3" /end CHARACTERISTIC
/begin CHARACTERISTIC PCR_qClutchThres_C "Mengenschwellwert für Kupplungserkennung" VALUE 0xEAD0E Kw_Ws16 200.0000 InjMass 0.00 200.0000 FORMAT "%8.4" EXTENDED_LIMITS -327.6800 327.6700 /end CHARACTERISTIC
/begin CHARACTERISTIC PCR_qClutchThres_CUR "Drehzahlabhängige Mengenschwelle zur Kupplungserkennung" CURVE 0xEAD10 Kl_Xs16_Ws16 327.6700 InjMassCyc 0.00 327.6700 FORMAT "%8.4" EXTENDED_LIMITS -327.6800 327.6700
 /begin AXIS_DESCR STD_AXIS Eng_nAvrg EngN 4 40.00000 6000.000 FORMAT "%8.3" EXTENDED_LIMITS -32768.00 32767.00 DEPOSIT ABSOLUTE /end AXIS_DESCR
/end CHARACTERISTIC
/begin CHARACTERISTIC PCR_qLPClutchThres_CUR "Drehzahlabhängige Mengenschwelle zur Kupplungserkennung(Niederdruckstufe)" CURVE 0xEABE0 Kl_Xs16_Ws16 327.6700 InjMassCyc 0.00 327.6700 FORMAT "%8.4" EXTENDED_LIMITS -327.6800 327.6700
 /begin AXIS_DESCR STD_AXIS Eng_nAvrg EngN 4 40.00000 6000.000 FORMAT "%8.3" EXTENDED_LIMITS -32768.00 32767.00 DEPOSIT ABSOLUTE /end AXIS_DESCR
/end CHARACTERISTIC
/begin CHARACTERISTIC PCR_qLPGvnrOffRgn_CUR "Mengenkennlinie für Reglerabschaltschwelle in Abhängigkeit von der Drehzahl bei Regenerationsbetrieb(Niederdruckstufe)" CURVE 0xEABF2 Kl_Xs16_Ws16 200.0000 InjMass 0.00 200.0000 FORMAT "%8.4" EXTENDED_LIMITS -327.6800 327.6700
 /begin AXIS_DESCR STD_AXIS Eng_nAvrg EngN 8 0.00 8000.000 FORMAT "%8.3" EXTENDED_LIMITS -32768.00 32767.00 DEPOSIT ABSOLUTE /end AXIS_DESCR
/end CHARACTERISTIC
/begin CHARACTERISTIC PCR_qLPGvnrOff_CUR "Einspritzmengenkennlinie für Abschaltschwelle im Normalmodus(Niederdruckstufe)" CURVE 0xEAC14 Kl_Xs16_Ws16 200.0000 InjMass 0.00 200.0000 FORMAT "%8.4" EXTENDED_LIMITS -327.6800 327.6700
 /begin AXIS_DESCR STD_AXIS Eng_nAvrg EngN 8 0.00 8000.000 FORMAT "%8.3" EXTENDED_LIMITS -32768.00 32767.00 DEPOSIT ABSOLUTE /end AXIS_DESCR
/end CHARACTERISTIC
/begin CHARACTERISTIC PCR_qLPGvnrOnRgn_CUR "Mengenkennlinie für Reglereinschaltschwelle in Abhängigkeit von der Drehzahl bei Regenerationsbetrieb(Niederdruckstufe)" CURVE 0xEAC36 Kl_Xs16_Ws16 200.0000 InjMass 0.00 200.0000 FORMAT "%8.4" EXTENDED_LIMITS -327.6800 327.6700
 /begin AXIS_DESCR STD_AXIS Eng_nAvrg EngN 8 0.00 8000.000 FORMAT "%8.3" EXTENDED_LIMITS -32768.00 32767.00 DEPOSIT ABSOLUTE /end AXIS_DESCR
/end CHARACTERISTIC
/begin CHARACTERISTIC PCR_qLPGvnrOn_CUR "Einspritzmengenkennlinie für Einschaltschwelle im Normalmodus(Niederdruckstufe)" CURVE 0xEAC58 Kl_Xs16_Ws16 200.0000 InjMass 0.00 200.0000 FORMAT "%8.4" EXTENDED_LIMITS -327.6800 327.6700
 /begin AXIS_DESCR STD_AXIS Eng_nAvrg EngN 8 0.00 8000.000 FORMAT "%8.3" EXTENDED_LIMITS -32768.00 32767.00 DEPOSIT ABSOLUTE /end AXIS_DESCR
/end CHARACTERISTIC
/begin CHARACTERISTIC PCR_qLPWrkSph2_C "obere Mengengrenze des Arbeitsbereichs 2" VALUE 0xEAC7A Kw_Ws16 200.0000 InjMass 0.00 200.0000 FORMAT "%8.4" EXTENDED_LIMITS -327.6800 327.6700 /end CHARACTERISTIC
/begin CHARACTERISTIC PCR_qLPWrkSph3_C "obere Mengengrenze des Arbeitsbereichs 3" VALUE 0xEAC7C Kw_Ws16 200.0000 InjMass 0.00 200.0000 FORMAT "%8.4" EXTENDED_LIMITS -327.6800 327.6700 /end CHARACTERISTIC
/begin CHARACTERISTIC PCR_qRgtOffRgn_CUR "Mengenkennlinie für Reglerabschaltschwelle in Abhängigkeit von der Drehzahl für Partikelfilter Regeneration" CURVE 0xEAD22 Kl_Xs16_Ws16 200.0000 InjMass 0.00 200.0000 FORMAT "%8.4" EXTENDED_LIMITS -327.6800 327.6700
 /begin AXIS_DESCR STD_AXIS Eng_nAvrg EngN 8 0.00 8000.000 FORMAT "%8.3" EXTENDED_LIMITS -32768.00 32767.00 DEPOSIT ABSOLUTE /end AXIS_DESCR
/end CHARACTERISTIC
/begin CHARACTERISTIC PCR_qRgtOff_CUR "Mengenkennlinie für Reglerabschaltschwelle in Abhängigkeit von der Drehzahl" CURVE 0xEAD44 Kl_Xs16_Ws16 200.0000 InjMass 0.00 200.0000 FORMAT "%8.4" EXTENDED_LIMITS -327.6800 327.6700
 /begin AXIS_DESCR STD_AXIS Eng_nAvrg EngN 9 0.00 8000.000 FORMAT "%8.3" EXTENDED_LIMITS -32768.00 32767.00 DEPOSIT ABSOLUTE /end AXIS_DESCR
/end CHARACTERISTIC
/begin CHARACTERISTIC PCR_qRgtOnRgn_CUR "Mengenkennlinie für Reglereinschaltschwelle in Abhängigkeit von der Drehzahl für Partikelfilter Regeneration" CURVE 0xEAD6A Kl_Xs16_Ws16 200.0000 InjMass 0.00 200.0000 FORMAT "%8.4" EXTENDED_LIMITS -327.6800 327.6700
 /begin AXIS_DESCR STD_AXIS Eng_nAvrg EngN 8 0.00 8000.000 FORMAT "%8.3" EXTENDED_LIMITS -32768.00 32767.00 DEPOSIT ABSOLUTE /end AXIS_DESCR
/end CHARACTERISTIC
/begin CHARACTERISTIC PCR_qRgtOn_CUR "Mengenkennlinie für Reglereinschaltschwelle in Abhängigkeit von der Drehzahl" CURVE 0xEAD8C Kl_Xs16_Ws16 200.0000 InjMass 0.00 200.0000 FORMAT "%8.4" EXTENDED_LIMITS -327.6800 327.6700
 /begin AXIS_DESCR STD_AXIS Eng_nAvrg EngN 9 0.00 8000.000 FORMAT "%8.3" EXTENDED_LIMITS -32768.00 32767.00 DEPOSIT ABSOLUTE /end AXIS_DESCR
/end CHARACTERISTIC
/begin CHARACTERISTIC PCR_qWrkSph2_C "obere Mengengrenze des Arbeitsbereichs 2" VALUE 0xEADB2 Kw_Ws16 200.0000 InjMass 0.00 200.0000 FORMAT "%8.4" EXTENDED_LIMITS -327.6800 327.6700 /end CHARACTERISTIC
/begin CHARACTERISTIC PCR_qWrkSph3_C "Einspritzmengengrenze zwischen den Arbeitsbereichen 2 und 3" VALUE 0xEADB4 Kw_Ws16 200.0000 InjMass 0.00 200.0000 FORMAT "%8.4" EXTENDED_LIMITS -327.6800 327.6700 /end CHARACTERISTIC
/begin CHARACTERISTIC PCR_rBPACDAdd_Vector "#SSD Bypass-Label für additiven Bypass von PCR_rBPACD (Nicht verstellen!)" VALUE 0xC3144 Kw_Wu8 255.0 OneToOne 0.00 255.0 FORMAT "%5.1" /end CHARACTERISTIC
/begin CHARACTERISTIC PCR_rBPACDAdd_Channel "#SSD Bypass-Label für additiven Bypass von PCR_rBPACD (Nicht verstellen!)" VALUE 0xC3145 Kw_Wu8 255.0 OneToOne 0.00 255.0 FORMAT "%5.1" /end CHARACTERISTIC
/begin CHARACTERISTIC PCR_rBPACD_Vector "#SSD Bypass-Label für PCR_rBPACD (Nicht verstellen!)" VALUE 0xC3146 Kw_Wu8 255.0 OneToOne 0.00 255.0 FORMAT "%5.1" /end CHARACTERISTIC
/begin CHARACTERISTIC PCR_rBPACD_Channel "#SSD Bypass-Label für PCR_rBPACD (Nicht verstellen!)" VALUE 0xC3147 Kw_Wu8 255.0 OneToOne 0.00 255.0 FORMAT "%5.1" /end CHARACTERISTIC
/begin CHARACTERISTIC PCR_rCBOpn_C "Stellgroesze fuer den Ladedrucksteller bei geoeffnetem Verdichterbypass" VALUE 0xEADB6 Kw_Ws16 799.9878 Prc -400.0000 399.9878 FORMAT "%8.4" /end CHARACTERISTIC
/begin CHARACTERISTIC PCR_rDflVal04_C "Default Verhältnis für 'Default Schalter' prio 4" VALUE 0xEADB8 Kw_Ws16 799.9878 Prc -400.0000 399.9878 FORMAT "%8.4" /end CHARACTERISTIC
/begin CHARACTERISTIC PCR_rDflVal05_C "Default Verhältnis für 'Default Schalter' prio 5" VALUE 0xEADBA Kw_Ws16 799.9878 Prc -400.0000 399.9878 FORMAT "%8.4" /end CHARACTERISTIC
/begin CHARACTERISTIC PCR_rDflVal06_C "Defaultwert 6 für relative Stellung des Ladedruckstellers" VALUE 0xEADBC Kw_Ws16 799.9878 Prc -400.0000 399.9878 FORMAT "%8.4" /end CHARACTERISTIC
/begin CHARACTERISTIC PCR_rDflVal12_C "Defaultwert 12 für relative Stellung des Ladedruckstellers" VALUE 0xEADBE Kw_Ws16 799.9878 Prc -400.0000 399.9878 FORMAT "%8.4" /end CHARACTERISTIC
/begin CHARACTERISTIC PCR_rDflVal15_MAP "Default value map for the output of the two actuators" MAP 0xEADC0 Kf_Xs16_Ys16_Ws16 300.0000 Prc -100.0000 200.0000 FORMAT "%8.4" EXTENDED_LIMITS -400.0000 399.9878
 /begin AXIS_DESCR STD_AXIS Eng_nAvrg EngN 8 0.00 6000.000 FORMAT "%8.3" EXTENDED_LIMITS -32768.00 32767.00 DEPOSIT ABSOLUTE /end AXIS_DESCR
 /begin AXIS_DESCR STD_AXIS PCR_qReal InjMassCyc 8 0.00 327.6700 FORMAT "%8.4" EXTENDED_LIMITS -327.6800 327.6700 DEPOSIT ABSOLUTE /end AXIS_DESCR
/end CHARACTERISTIC
/begin CHARACTERISTIC PCR_rDflVal18_C "Defaultwert 18 für relative Stellung des Ladedruckstellers" VALUE 0xEAE64 Kw_Ws16 799.9878 Prc -400.0000 399.9878 FORMAT "%8.4" /end CHARACTERISTIC
/begin CHARACTERISTIC PCR_rDflVal24_C "Defaultwert 24 für relative Stellung des Ladedruckstellers" VALUE 0xEAE66 Kw_Ws16 799.9878 Prc -400.0000 399.9878 FORMAT "%8.4" /end CHARACTERISTIC
/begin CHARACTERISTIC PCR_rLPDflVal09_C "Vorgabewert 9 für Regelungsausgang" VALUE 0xEAC7E Kw_Ws16 799.9878 Prc -400.0000 399.9878 FORMAT "%8.4" /end CHARACTERISTIC
/begin CHARACTERISTIC PCR_rLPDflVal12_C "Vorgabewert 12 für Regelungsausgang" VALUE 0xEAC80 Kw_Ws16 799.9878 Prc -400.0000 399.9878 FORMAT "%8.4" /end CHARACTERISTIC
/begin CHARACTERISTIC PCR_rLPDflVal18_C "Vorgabewert 18 für Regelungsausgang" VALUE 0xEAC82 Kw_Ws16 799.9878 Prc -400.0000 399.9878 FORMAT "%8.4" /end CHARACTERISTIC
/begin CHARACTERISTIC PCR_rSurgeGvnrOff_CUR "Wert" CURVE 0xEB034 Kl_Xs16_Ws16 799.9878 Prc -400.0000 399.9878 FORMAT "%8.4"
 /begin AXIS_DESCR STD_AXIS Eng_nAvrg EngN 5 0.00 6000.000 FORMAT "%8.3" EXTENDED_LIMITS -32768.00 32767.00 DEPOSIT ABSOLUTE /end AXIS_DESCR
/end CHARACTERISTIC
/begin CHARACTERISTIC PCR_rSurgeGvnrOn_MAP "Kennfeld" MAP 0xEB04A Kf_Xs16_Ys16_Ws16 100.0000 Prc 0.00 100.0000 FORMAT "%8.4" EXTENDED_LIMITS -400.0000 399.9878
 /begin AXIS_DESCR STD_AXIS Eng_nAvrg EngN 6 0.00 6000.000 FORMAT "%8.3" EXTENDED_LIMITS -32768.00 32767.00 DEPOSIT ABSOLUTE /end AXIS_DESCR
 /begin AXIS_DESCR STD_AXIS APSCD_pLinVal Pres_hPa 4 -32768.00 32767.00 FORMAT "%8.2" DEPOSIT ABSOLUTE /end AXIS_DESCR
/end CHARACTERISTIC
/begin CHARACTERISTIC PCR_rSurgeGvnr_MAP "kennlinie für Ladedrucksteuersignal aus AntiSurge-Regler Eingangsgrößen" MAP 0xEB092 Kf_Xs16_Ys16_Ws16 100.0000 Prc 0.00 100.0000 FORMAT "%8.4" EXTENDED_LIMITS -400.0000 399.9878
 /begin AXIS_DESCR STD_AXIS PCR_pBSurgePICtlLim_mp Pres_hPa 5 -32768.00 32767.00 FORMAT "%8.2" DEPOSIT ABSOLUTE /end AXIS_DESCR
 /begin AXIS_DESCR STD_AXIS Eng_nAvrg EngN 5 0.00 6000.000 FORMAT "%8.3" EXTENDED_LIMITS -32768.00 32767.00 DEPOSIT ABSOLUTE /end AXIS_DESCR
/end CHARACTERISTIC
/begin CHARACTERISTIC PCR_stLPMonCur_C "Schalter für EGT" VALUE 0xEAC84 Kw_Wu32 4294967295.00 OneToOne 0.00 4294967295.00 FORMAT "%13.2" /end CHARACTERISTIC
/begin CHARACTERISTIC PCR_stMonCur_C "Bit Mask for EGT_st" VALUE 0xEAE68 Kw_Wu32 4294967295.00 OneToOne 0.00 4294967295.00 FORMAT "%13.2" /end CHARACTERISTIC
/begin CHARACTERISTIC PCR_tiDebSurge1_C "Parameter 1 für die Entprellung der Erkennung oszillierende Luftmasse mit großer Amplitude" VALUE 0xEB198 Kw_Wu16 655140.0 TimeDeb 0.00 655140.0 FORMAT "%8.1" EXTENDED_LIMITS 0.00 655350.0 /end CHARACTERISTIC
/begin CHARACTERISTIC PCR_tiDebSurge2_C "Parameter 2 für die Entprellung der Erkennung oszillierende Luftmasse mit großer Amplitude" VALUE 0xEB19A Kw_Wu16 655140.0 TimeDeb 0.00 655140.0 FORMAT "%8.1" EXTENDED_LIMITS 0.00 655350.0 /end CHARACTERISTIC
/begin CHARACTERISTIC PCR_tiSurgeGvnrPT1_C "Parameter für PT1-Glied für Tiefpassfilterung der Regelabwei-chung für I Anteil" VALUE 0xEB0DC Kw_Wu32 4294.9663 TimeDelay_s 0.0010000001 4294.9673 FORMAT "%9.4" EXTENDED_LIMITS 0.0000010000000 4294.9673 /end CHARACTERISTIC
/begin CHARACTERISTIC PCR_swtAirPerTimeDet_C "Schalter zur Auswahl der Erfassung der Luftmassenschwingung mittels DFT oder PT1" VALUE 0xEB19C Kw_Wu8 1.000 OneToOne 0.00 1.000 FORMAT "%5.3" EXTENDED_LIMITS 0.00 255.0 /end CHARACTERISTIC
/begin CHARACTERISTIC PCR_swtFacCnv_C "Schalter zur Umschaltung des Faktors mit Konversion" VALUE 0xEB19D Kw_Wu8 1.000 OneToOne 0.00 1.000 FORMAT "%5.3" EXTENDED_LIMITS 0.00 255.0 /end CHARACTERISTIC
/begin CHARACTERISTIC PCR_swtLPV8_C "Schalter zur Erkennung des Defaultwertes aufgrund der Prioritätsbasis" VALUE 0xEAC88 Kw_Wu8 255.0 OneToOne 0.00 255.0 FORMAT "%5.1" /end CHARACTERISTIC
/begin CHARACTERISTIC PCR_swtSurgeARWMode_C "Schalter für ""Anti-Reset-Windup""- Massnahme (0: einfrieren, 1: rückrechnen)" VALUE 0xEB0E0 Kw_Wu8 1.000 OneToOne 0.00 1.000 FORMAT "%5.3" EXTENDED_LIMITS 0.00 255.0 /end CHARACTERISTIC
/begin CHARACTERISTIC PCR_swtSurgeGvnrSel_C "Shalter zum AntiSurge-Regler (Bit0 - PCR_stPreSurge: 1: on, 0: off Bit1: PCR_stSurge: 1: on, 0: off)" VALUE 0xEB0E1 Kw_Wu8 255.0 OneToOne 0.00 255.0 FORMAT "%5.1" /end CHARACTERISTIC
/begin CHARACTERISTIC PCR_swtV8_C "Schalter für Vorgabewert DflVal24 bei 8 Zyl. (1: verwende Vorgabewert, 0: verwende Standardwert)" VALUE 0xEAE6C Kw_Wu8 255.0 OneToOne 0.00 255.0 FORMAT "%5.1" /end CHARACTERISTIC
/begin CHARACTERISTIC PCR_tiAirPerTimeAmplFlt_C "Parameter für PT1-Glied für Tiefpassfilterung der Amplitude der oszillierenden Frischluftmasse nach der DFT" VALUE 0xEB1A0 Kw_Wu32 4294967.3 TimeDelay_ms 0.0010000000 4294967.3 FORMAT "%9.1" /end CHARACTERISTIC
/begin CHARACTERISTIC PCR_tiAirPTCtlFlt1_C "Parameter für PT1-Glied für Tiefpassfilterung der Amplitude der oszillierenden FrischluftmasseCtl-Flt1" VALUE 0xEB1A4 Kw_Wu32 4294967.3 TimeDelay_ms 0.0010000000 4294967.3 FORMAT "%9.1" /end CHARACTERISTIC
/begin CHARACTERISTIC PCR_tiAirPTCtlFlt2_C "Parameter für PT1-Glied für Tiefpassfilterung der Amplitude der oszillierenden FrischluftmasseCtl-Flt2" VALUE 0xEB1A8 Kw_Wu32 4294967.3 TimeDelay_ms 0.0010000000 4294967.3 FORMAT "%9.1" /end CHARACTERISTIC
/begin CHARACTERISTIC PCR_tiClutchDebHighLow_C "Entprellzeit für Kupplungssignalüberwachung von High/Low-Wechsel" VALUE 0xEAE6E Kw_Wu16 655350.0 TimeDeb 0.00 655350.0 FORMAT "%8.1" /end CHARACTERISTIC
/begin CHARACTERISTIC PCR_tiClutchDebLowHigh_C "Entprellzeit für Kupplungssignalüberwachung von Low/High-Wechsel" VALUE 0xEAE70 Kw_Wu16 655350.0 TimeDeb 0.00 655350.0 FORMAT "%8.1" /end CHARACTERISTIC
/begin CHARACTERISTIC PCR_tiCoStrt_CUR "#SSD Kennlinie für die Zeit, die die Regelung nach Startabwurf abgeschaltet bleibt" CURVE 0xEAE72 Kl_Xs16_Ws16 33000.00 Time_ms 0.00 33000.00 FORMAT "%8.2" EXTENDED_LIMITS -327680.0 327670.0
 /begin AXIS_DESCR STD_AXIS CTSCD_tClnt Temp_Cels 6 -50.1400 199.8600 FORMAT "%8.4" EXTENDED_LIMITS -3549.940 3003.560 DEPOSIT ABSOLUTE /end AXIS_DESCR
/end CHARACTERISTIC
/begin CHARACTERISTIC PCR_tiDelPreSurgeDet_C "Verzögerungszeit für die Erkennung oszillierende Luftmasse mit kleiner Amplitude" VALUE 0xEB1AC Kw_Wu16 655350.0 Time_ms 0.00 655350.0 FORMAT "%8.1" /end CHARACTERISTIC
/begin CHARACTERISTIC PCR_tiGvnrOffDel_CUR "Abschaltungsverzögerungszeit im Normalmodus" CURVE 0xEAE8C Kl_Xs16_Ws16 20.00000 Time_s 0.00 20.00000 FORMAT "%8.5" EXTENDED_LIMITS -327.6800 327.6700
 /begin AXIS_DESCR STD_AXIS Eng_nAvrg EngN 6 0.00 8000.000 FORMAT "%8.3" EXTENDED_LIMITS -32768.00 32767.00 DEPOSIT ABSOLUTE /end AXIS_DESCR
/end CHARACTERISTIC
/begin CHARACTERISTIC PCR_tiLPClutchDebHighLow_C "Deaktivierungszeit für Kupplungserkennung" VALUE 0xEAC8A Kw_Wu16 655350.0 TimeDeb 0.00 655350.0 FORMAT "%8.1" /end CHARACTERISTIC
/begin CHARACTERISTIC PCR_tiLPClutchDebLowHigh_C "Aktivierungs-(Verzögerungss-)zeit für Kupplungserkennung" VALUE 0xEAC8C Kw_Wu16 655350.0 TimeDeb 0.00 655350.0 FORMAT "%8.1" /end CHARACTERISTIC
/begin CHARACTERISTIC PCR_tiStrtDelayInit_C "#SSD Inititalisierungswert der Zeit, die der PCR nach dem Startabfall abgeschaltet bleibt" VALUE 0xEAEA6 Kw_Wu16 655350.0 Time_ms 0.00 655350.0 FORMAT "%8.1" /end CHARACTERISTIC
/begin CHARACTERISTIC PCR_tiSurgeCtlHiLoRel3_C "Zeit für Statuswechsel niedrig" VALUE 0xEB0E2 Kw_Wu16 655350.0 TimeDeb 0.00 655350.0 FORMAT "%8.1" /end CHARACTERISTIC
/begin CHARACTERISTIC PCR_tiSurgeCtlLoHiRel3_C "Zeit für Statuswechsel hoch" VALUE 0xEB0E4 Kw_Wu16 655350.0 TimeDeb 0.00 655350.0 FORMAT "%8.1" /end CHARACTERISTIC
/begin CHARACTERISTIC PCR_tiSurgeCtlHiLoRelAll_C "Zeit für Statuswechsel niedrig" VALUE 0xEB0E6 Kw_Wu16 655350.0 TimeDeb 0.00 655350.0 FORMAT "%8.1" /end CHARACTERISTIC
/begin CHARACTERISTIC PCR_tiSurgeCtlLoHiRelAll_C "Zeit für Statuswechsel hoch" VALUE 0xEB0E8 Kw_Wu16 655350.0 TimeDeb 0.00 655350.0 FORMAT "%8.1" /end CHARACTERISTIC
/begin CHARACTERISTIC PCR_vClutch_C "Geschwindigkeitsgrenze für Kuplungsüberwachung" VALUE 0xEAEA8 Kw_Ws16 300.0000 Vel 0.00 300.0000 FORMAT "%8.4" EXTENDED_LIMITS -327.6800 327.6700 /end CHARACTERISTIC
/begin CHARACTERISTIC PCR_vLPClutch_C "Geschwindigkeitsschwelle für Kupplungssignal überwachung" VALUE 0xEAC8E Kw_Ws16 300.0000 Vel 0.00 300.0000 FORMAT "%8.4" EXTENDED_LIMITS -327.6800 327.6700 /end CHARACTERISTIC
/begin CHARACTERISTIC PCVCD_uSRCMin_C "#SSD Signal Range Check Min-Wert" VALUE 0xEB1F8 Kw_Ws16 5200.391 Volt 0.00 5200.391 FORMAT "%8.3" EXTENDED_LIMITS -160156.4 160151.5 /end CHARACTERISTIC
/begin CHARACTERISTIC PCVCD_uSRCMax_C "#SSD Signal Range Check Max-Wert" VALUE 0xEB1FA Kw_Ws16 5200.391 Volt 0.00 5200.391 FORMAT "%8.3" EXTENDED_LIMITS -160156.4 160151.5 /end CHARACTERISTIC
/begin CHARACTERISTIC PCVCD_iLin_CUR "#SSD Analogeingang, Linearisierungskennlinie" CURVE 0xEB1FC Kl_Xs16_Ws16 5000.000 Curr 0.00 5000.000 FORMAT "%8.3" EXTENDED_LIMITS -32768.00 32767.00
 /begin AXIS_DESCR STD_AXIS PCVCD_uRawVal_mp Volt 2 0.00 5200.391 FORMAT "%8.3" EXTENDED_LIMITS -160156.4 160151.5 DEPOSIT ABSOLUTE /end AXIS_DESCR
/end CHARACTERISTIC
/begin CHARACTERISTIC PCVCD_ctPwrStgOnMax_C "maximale Anzahl von Endstufen-Einschaltungen pro Fahrzyklus bei SCB oder Übertemperatur" VALUE 0xEB206 Kw_Wu16 65535.00 OneToOne 0.00 65535.00 FORMAT "%8.2" /end CHARACTERISTIC
/begin CHARACTERISTIC PCVCD_dcycMax_C "#SSD Max-Wert, Ausgangstastverhältnis" VALUE 0xEB208 Kw_Ws16 100.0000 DtyCyc 0.00 100.0000 FORMAT "%8.4" EXTENDED_LIMITS -327.6800 327.6700 /end CHARACTERISTIC
/begin CHARACTERISTIC PCVCD_dcycMin_C "#SSD Min-Wert, Ausgangstastverhältnis" VALUE 0xEB20A Kw_Ws16 100.0000 DtyCyc 0.00 100.0000 FORMAT "%8.4" EXTENDED_LIMITS -327.6800 327.6700 /end CHARACTERISTIC
/begin CHARACTERISTIC PCVCD_DebExcTempDef_C "#SSD Fehlerentprellzeit Uebertemperatur" VALUE 0xEB20C Kw_Wu16 655350.0 Time_ms 0.00 655350.0 FORMAT "%8.1" /end CHARACTERISTIC
/begin CHARACTERISTIC PCVCD_DebExcTempOk_C "#SSD Heilungsentprellzeit Uebertemperatur" VALUE 0xEB20E Kw_Wu16 655350.0 Time_ms 0.00 655350.0 FORMAT "%8.1" /end CHARACTERISTIC
/begin CHARACTERISTIC PCVCD_DebNoLoadDef_C "#SSD Fehlerentprellzeit Leerlauf" VALUE 0xEB210 Kw_Wu16 655350.0 Time_ms 0.00 655350.0 FORMAT "%8.1" /end CHARACTERISTIC
/begin CHARACTERISTIC PCVCD_DebNoLoadOk_C "#SSD Heilungszeit Leerlauf" VALUE 0xEB212 Kw_Wu16 655350.0 Time_ms 0.00 655350.0 FORMAT "%8.1" /end CHARACTERISTIC
/begin CHARACTERISTIC PCVCD_DebShortCircBatDef_C "#SSD Fehlerentprellzeit Kurzschluss Batterie" VALUE 0xEB214 Kw_Wu16 655350.0 Time_ms 0.00 655350.0 FORMAT "%8.1" /end CHARACTERISTIC
/begin CHARACTERISTIC PCVCD_DebShortCircBatOk_C "#SSD Heilungsentprellzeit Kurzschluss Batterie" VALUE 0xEB216 Kw_Wu16 655350.0 Time_ms 0.00 655350.0 FORMAT "%8.1" /end CHARACTERISTIC
/begin CHARACTERISTIC PCVCD_DebShortCircGndDef_C "#SSD Fehlerentprellzeit Kurzschluss Masse" VALUE 0xEB218 Kw_Wu16 655350.0 Time_ms 0.00 655350.0 FORMAT "%8.1" /end CHARACTERISTIC
/begin CHARACTERISTIC PCVCD_DebShortCircGndOk_C "#SSD Heilungsentprellzeit Kurzschluss Masse" VALUE 0xEB21A Kw_Wu16 655350.0 Time_ms 0.00 655350.0 FORMAT "%8.1" /end CHARACTERISTIC
/begin CHARACTERISTIC PCVCD_DebSRCHighDef_C "#SSD Fehlerentprellzeit für Analogeingang SRC-High Fehler" VALUE 0xEB21C Kw_Wu16 655350.0 Time_ms 0.00 655350.0 FORMAT "%8.1" /end CHARACTERISTIC
/begin CHARACTERISTIC PCVCD_DebSRCHighOk_C "#SSD Heilungsentprellzeit für Analogeingang SRC-High Fehler" VALUE 0xEB21E Kw_Wu16 655350.0 Time_ms 0.00 655350.0 FORMAT "%8.1" /end CHARACTERISTIC
/begin CHARACTERISTIC PCVCD_DebSRCLowDef_C "#SSD Fehlerentprellzeit Analogeingang SRC-Low Fehler" VALUE 0xEB220 Kw_Wu16 655350.0 Time_ms 0.00 655350.0 FORMAT "%8.1" /end CHARACTERISTIC
/begin CHARACTERISTIC PCVCD_DebSRCLowOk_C "#SSD Heilungsentprellzeit für Analogeingang SRC-Low Fehler" VALUE 0xEB222 Kw_Wu16 655350.0 Time_ms 0.00 655350.0 FORMAT "%8.1" /end CHARACTERISTIC
/begin CHARACTERISTIC PCVCD_facIGovInit_CUR "#SSD Initialisierungsfaktor für I-Anteil des Stromreglers als Funktion der Systemtemperatur" CURVE 0xEB224 Kl_Xs16_Ws16 2.000000 Fact 0.00 2.000000 FORMAT "%8.6" EXTENDED_LIMITS -4.000000 3.999878
 /begin AXIS_DESCR STD_AXIS FlSys_t Temp_Cels 4 -50.14000 199.8600 FORMAT "%8.4" EXTENDED_LIMITS -3549.940 3003.560 DEPOSIT ABSOLUTE /end AXIS_DESCR
/end CHARACTERISTIC
/begin CHARACTERISTIC PCVCD_facIGovMax_C "#SSD maximaler I-Anteil" VALUE 0xEB236 Kw_Ws16 1.000000 Fact 1.000000 2.000000 FORMAT "%8.6" EXTENDED_LIMITS -4.000000 3.999878 /end CHARACTERISTIC
/begin CHARACTERISTIC PCVCD_facIGovMin_C "#SSD minimaler I-Anteil" VALUE 0xEB238 Kw_Ws16 0.5000000 Fact 0.5000000 1.000000 FORMAT "%8.6" EXTENDED_LIMITS -4.000000 3.999878 /end CHARACTERISTIC
/begin CHARACTERISTIC PCVCD_tiFlt1PT1_C "#SSD PT1 Filterzeitkonstante für Strom-Istwert" VALUE 0xEB23C Kw_Wu32 4294.9673 TimeDelay_s 0.0000010000000 4294.9673 FORMAT "%9.4" /end CHARACTERISTIC
/begin CHARACTERISTIC PCVCD_tiFlt2PT1_C "#SSD PT1 Filterzeitkonstante für Strom-Sollwert" VALUE 0xEB240 Kw_Wu32 4294.9673 TimeDelay_s 0.0000010000000 4294.9673 FORMAT "%9.4" /end CHARACTERISTIC
/begin CHARACTERISTIC PCVCD_tiIGovDT1_C "#SSD DT1 Zeitkonstante" VALUE 0xEB244 Kw_Wu32 4294.9673 TimeDelay_s 0.0000010000000 4294.9673 FORMAT "%9.4" /end CHARACTERISTIC
/begin CHARACTERISTIC PCVCD_IGovDKd_C "#SSD DT1 Differenziationsfaktor" VALUE 0xEB248 Kw_Ws32 65535.9999847 Kd -32768.0000000 32767.9999847 FORMAT "%13.7" /end CHARACTERISTIC
/begin CHARACTERISTIC PCVCD_IGovIKi_C "#SSD I-Glied, Kleinsignalverstärkung" VALUE 0xEB24C Kw_Wu32 122.070312472 Ki_curr2fact 0.00 122.070312472 FORMAT "%13.9" /end CHARACTERISTIC
/begin CHARACTERISTIC PCVCD_IGovIKiPos_C "#SSD I-Glied, Verstärkung für positive Großsignale" VALUE 0xEB250 Kw_Wu32 122.070312472 Ki_curr2fact 0.00 122.070312472 FORMAT "%13.9" /end CHARACTERISTIC
/begin CHARACTERISTIC PCVCD_IGovIKiNeg_C "#SSD I_Glied, Verstärkung für negative Großsignale" VALUE 0xEB254 Kw_Wu32 122.070312472 Ki_curr2fact 0.00 122.070312472 FORMAT "%13.9" /end CHARACTERISTIC
/begin CHARACTERISTIC PCVCD_iIGovIWinPos_C "#SSD I-Glied, Kleinsignalfenster positiv" VALUE 0xEB258 Kw_Ws16 65535.00 Curr -32768.00 32767.00 FORMAT "%8.2" /end CHARACTERISTIC
/begin CHARACTERISTIC PCVCD_iIGovIWinNeg_C "#SSD I_Glied, Kleinsignalfenster negativ" VALUE 0xEB25A Kw_Ws16 65535.00 Curr -32768.00 32767.00 FORMAT "%8.2" /end CHARACTERISTIC
/begin CHARACTERISTIC PCVCD_tiFltPT1Init_C "#SSD PT1 Filterzeitkonstante während Initialisierungsphase des Stromreglers" VALUE 0xEB25C Kw_Wu32 4294.9673 TimeDelay_s 0.0000010000000 4294.9673 FORMAT "%9.4" /end CHARACTERISTIC
/begin CHARACTERISTIC PCVCD_numAdc_C "#SSD Parameter für die Auswahl des Analogkanals für das Druckregelventil" VALUE 0xEB260 Kw_Wu8 46.0000000000 NumPinAdc 0.00 46.0000000000 FORMAT "%13.10" /end CHARACTERISTIC
/begin CHARACTERISTIC PCVCD_numDia1_C "#SSD Parameter für Zuordnung der Diagnose zur 1. Endstufe des Druckregelventils" VALUE 0xEB261 Kw_Wu8 35.0000000000 NumPinDia 0.00 35.0000000000 FORMAT "%13.10" /end CHARACTERISTIC
/begin CHARACTERISTIC PCVCD_numDia2_C "#SSD Parameter für Zuordnung der Diagnose zur 2. Endstufe des Druckregelventils" VALUE 0xEB262 Kw_Wu8 35.0000000000 NumPinDia 0.00 35.0000000000 FORMAT "%13.10" /end CHARACTERISTIC
/begin CHARACTERISTIC PCVCD_numPwmOut_C "#SSD Parameter für die Auswahl des Hardware-Pins für das Druckregelventil" VALUE 0xEB263 Kw_Wu8 13.0000000000 NumPinPwmOut 0.00 13.0000000000 FORMAT "%13.10" /end CHARACTERISTIC
/begin CHARACTERISTIC PCVCD_stInvOut_C "#SSD Invertierungsparameter der PWM Endstufe" VALUE 0xEB264 Kw_Wu8 1.000 OneToOne 0.00 1.000 FORMAT "%5.3" EXTENDED_LIMITS 0.00 255.0 /end CHARACTERISTIC
/begin CHARACTERISTIC PCVCD_tiPer_C "#SSD Periodendauer der PWM-Endstufe" VALUE 0xEB266 Kw_Ws16 9.900000 Period 0.1000000 10.00000 FORMAT "%8.5" EXTENDED_LIMITS -3276.800 3276.700 /end CHARACTERISTIC
/begin CHARACTERISTIC PCVCD_resCoil_C "#SSD Widerstandswert der DRV-Spule" VALUE 0xEB268 Kw_Ws16 5000.000 Resist_1 0.00 5000.000 FORMAT "%8.3" EXTENDED_LIMITS -32768.00 32767.00 /end CHARACTERISTIC
/begin CHARACTERISTIC PCVCD_stPwrStgDia_C "#SSD Statuswort zur Spezifikation des Abschaltverhaltens der Endstufenfehlerdiagnose Druckregelventil" VALUE 0xEB26A Kw_Wu8 255.0 OneToOne 0.00 255.0 FORMAT "%5.1" /end CHARACTERISTIC
/begin CHARACTERISTIC PCVCD_stSPICtl_C "Parameter zur Anzeige der verwendeten Endstufenart ( 1 =SPI fähige Endstufe, 0 = nicht SPI fähige Endstufe )" VALUE 0xEB26B Kw_Wu8 1.000 OneToOne 0.00 1.000 FORMAT "%5.3" EXTENDED_LIMITS 0.00 255.0 /end CHARACTERISTIC
/begin CHARACTERISTIC PCVCD_swtCtlStateVal_C "#SSD CP1: 0: konstant Stromregelung, 1: nur wenn Raildruckregler im gesteuerten Betrieb ist" VALUE 0xEB26C Kw_Wu8 0.00 OneToOne 0.00 0.00 FORMAT "%5.2" EXTENDED_LIMITS 0.00 255.0 /end CHARACTERISTIC
/begin CHARACTERISTIC PCVCD_swtCtlStateType_C "#SSD CP1: Auswahl, Schalterwert aus Datensatz oder EEPROM" VALUE 0xEB26D Kw_Wu8 1.000 OneToOne 1.000 2.000 FORMAT "%5.3" EXTENDED_LIMITS 0.00 255.0 /end CHARACTERISTIC
/begin CHARACTERISTIC PCVCD_swt_C "#SSD allgemeine Schalterfunktionen der Endstufe Druckregelventil (bit0: 0...Batteriespannungskorrektur aus, 1...ein; bit1-7: Reserve)" VALUE 0xEB26E Kw_Wu8 255.0 OneToOne 0.00 255.0 FORMAT "%5.1" /end CHARACTERISTIC
/begin CHARACTERISTIC PCVCD_tiBtwTst_C "#SSD Zeitabstand, in dem im Fehlerfall die Endstufe getestet wird" VALUE 0xEB270 Kw_Wu16 29990.00 Time_ms 10.00000 30000.00 FORMAT "%8.2" EXTENDED_LIMITS 0.00 655350.0 /end CHARACTERISTIC
/begin CHARACTERISTIC PCVCD_tiIGovInit_C "#SSD maximale Zeitdauer der Initialisierungsphase für den Stromregler" VALUE 0xEB272 Kw_Wu16 655350.0 Time_ms 0.00 655350.0 FORMAT "%8.1" /end CHARACTERISTIC
/begin CHARACTERISTIC PCVCD_tiPwrStgOn_C "Zeit, für welche die Endstufe beim Fall der nicht SPI fähige Endstufe eingeschaltet wird." VALUE 0xEB274 Kw_Wu16 655140.0 Time_ms 0.00 655140.0 FORMAT "%8.1" EXTENDED_LIMITS 0.00 655350.0 /end CHARACTERISTIC
/begin CHARACTERISTIC PCVCD_tiDebSigDefSigTst_C "Fehlerentprellzeit fuer Fehlerpfad Dfp_PCVCD_SigTst" VALUE 0xEB276 Kw_Wu16 655350.0 Time_ms 0.00 655350.0 FORMAT "%8.1" /end CHARACTERISTIC
/begin CHARACTERISTIC PCVCD_tiDebSigOkSigTst_C "Heliungsentprellzeit fuer Fehlerpfad Dfp_PCVCD_SigTst" VALUE 0xEB278 Kw_Wu16 655350.0 Time_ms 0.00 655350.0 FORMAT "%8.1" /end CHARACTERISTIC
/begin CHARACTERISTIC PCV_dvolLeak_CUR "#SSD Leckage des Druckregelventils" CURVE 0xEB1B0 Kl_Xs16_Ws16 150000.0 Qp_mm3_sec 0.00 150000.0 FORMAT "%8.1" EXTENDED_LIMITS -327680.0 327670.0
 /begin AXIS_DESCR STD_AXIS Rail_pSetPoint Pres_Rail 6 0.00 2000.000 FORMAT "%5.3" EXTENDED_LIMITS -3276.800 3276.700 DEPOSIT ABSOLUTE /end AXIS_DESCR
/end CHARACTERISTIC
/begin CHARACTERISTIC PCV_iCnvPress_CUR "#SSD Kennlinie zur Umrechnung von Raildruck in elektrischen Strom" CURVE 0xEB1CA Kl_Xs16_Ws16 5000.000 Curr 0.00 5000.000 FORMAT "%8.3" EXTENDED_LIMITS -32768.00 32767.00
 /begin AXIS_DESCR STD_AXIS Rail_pPCVSet Pres_Rail 10 0.00 2000.000 FORMAT "%5.3" EXTENDED_LIMITS -3276.800 3276.700 DEPOSIT ABSOLUTE /end AXIS_DESCR
/end CHARACTERISTIC
/begin CHARACTERISTIC PCV_iSetMin_C "#SSD Sollstrom bei elektrischer Abschaltung des Druckregelventils" VALUE 0xEB1F4 Kw_Ws16 65535.00 Curr -32768.00 32767.00 FORMAT "%8.2" /end CHARACTERISTIC
/begin CHARACTERISTIC PCV_iSet_Vector "#SSD Bypass-Label für PCV_iSet (Nicht verstellen!)" VALUE 0xC3148 Kw_Wu8 255.0 OneToOne 0.00 255.0 FORMAT "%5.1" /end CHARACTERISTIC
/begin CHARACTERISTIC PCV_iSet_Channel "#SSD Bypass-Label für PCV_iSet, nicht editieren!" VALUE 0xC3149 Kw_Wu8 255.0 OneToOne 0.00 255.0 FORMAT "%5.1" /end CHARACTERISTIC
/begin CHARACTERISTIC PFltCD_uSRCMinPPre_C "Spannungsrohwert SRC-Min des Abgasdrucks vor dem Partikelfilter" VALUE 0xECD84 Kw_Ws16 5200.391 Volt 0.00 5200.391 FORMAT "%8.3" EXTENDED_LIMITS -160156.4 160151.5 /end CHARACTERISTIC
/begin CHARACTERISTIC PFltCD_uSRCMaxPPre_C "Spannungsrohwert SRC-Max des Abgasdrucks vor dem Partikelfilter" VALUE 0xECD86 Kw_Ws16 5200.391 Volt 0.00 5200.391 FORMAT "%8.3" EXTENDED_LIMITS -160156.4 160151.5 /end CHARACTERISTIC
/begin CHARACTERISTIC PFltCD_pLinPre_CUR "Linearisierungskennlinie des Abgasdrucks vor dem Partikelfilter" CURVE 0xECD88 Kl_Xs16_Ws16 50000.00 Pres 0.00 50000.00 FORMAT "%9.2" EXTENDED_LIMITS -32768.00 32767.00
 /begin AXIS_DESCR STD_AXIS PFltCD_uRawPresPre_mp Volt 8 0.00 5200.391 FORMAT "%8.3" EXTENDED_LIMITS -160156.4 160151.5 DEPOSIT ABSOLUTE /end AXIS_DESCR
/end CHARACTERISTIC
/begin CHARACTERISTIC PFltCD_uSRCMinTempPre_C "Spannungsrohwert SRC-Min der Abgastemperatur vor dem Partikelfilter" VALUE 0xECE08 Kw_Ws16 5200.391 Volt 0.00 5200.391 FORMAT "%8.3" EXTENDED_LIMITS -160156.4 160151.5 /end CHARACTERISTIC
/begin CHARACTERISTIC PFltCD_uSRCMaxTempPre_C "Spannungsrohwert SRC-Max der Abgastemperatur vor dem Partikelfilter" VALUE 0xECE0A Kw_Ws16 5200.391 Volt 0.00 5200.391 FORMAT "%8.3" EXTENDED_LIMITS -160156.4 160151.5 /end CHARACTERISTIC
/begin CHARACTERISTIC PFltCD_tLinPre_CUR "Linearisierungskennlinie der Abgastemperatur vor dem Partikelfilter" CURVE 0xECE0C Kl_Xs16_Ws16 950.000 Temp_Cels -50.14000 899.860 FORMAT "%8.3" EXTENDED_LIMITS -3549.940 3003.560
 /begin AXIS_DESCR STD_AXIS PFltCD_uRawTempPre Volt 16 0.00 5200.391 FORMAT "%8.3" EXTENDED_LIMITS -160156.4 160151.5 DEPOSIT ABSOLUTE /end AXIS_DESCR
/end CHARACTERISTIC
/begin CHARACTERISTIC PFltCD_DebSRCHighDefTPre_C "Fehlerentprellzeit SRC-High-Fehler für die Abgastemperatur vor dem Partikelfilter" VALUE 0xECE4E Kw_Wu16 655350.0 Time_ms 0.00 655350.0 FORMAT "%8.1" /end CHARACTERISTIC
/begin CHARACTERISTIC PFltCD_DebSRCHighOkTPre_C "Heilungsentprellzeit SRC-High für die Abgastemperatur vor dem Partikelfilter" VALUE 0xECE50 Kw_Wu16 655350.0 Time_ms 0.00 655350.0 FORMAT "%8.1" /end CHARACTERISTIC
/begin CHARACTERISTIC PFltCD_DebSRCHiDefPPre_C "Entprellzeit: obere SRC Grenze überschritten" VALUE 0xECDAA Kw_Wu16 655350.0 Time_ms 0.00 655350.0 FORMAT "%8.1" /end CHARACTERISTIC
/begin CHARACTERISTIC PFltCD_DebSRCHiOkPPre_C "Entprellzeit: obere Grenzwertverletzung geheilt" VALUE 0xECDAC Kw_Wu16 655350.0 Time_ms 0.00 655350.0 FORMAT "%8.1" /end CHARACTERISTIC
/begin CHARACTERISTIC PFltCD_DebSRCLoDefPPre_C "Entprellzeit: untere SRC Grenze überschritten" VALUE 0xECDAE Kw_Wu16 655350.0 Time_ms 0.00 655350.0 FORMAT "%8.1" /end CHARACTERISTIC
/begin CHARACTERISTIC PFltCD_DebSRCLoOkPPre_C "Entprellzeit: untere Grenzwertverletzung geheilt" VALUE 0xECDB0 Kw_Wu16 655350.0 Time_ms 0.00 655350.0 FORMAT "%8.1" /end CHARACTERISTIC
/begin CHARACTERISTIC PFltCD_DebSRCLowDefTPre_C "Fehlerentprellzeit SRC-Low-Fehler für die Abgastemperatur vor dem Partikelfilter" VALUE 0xECE52 Kw_Wu16 655350.0 Time_ms 0.00 655350.0 FORMAT "%8.1" /end CHARACTERISTIC
/begin CHARACTERISTIC PFltCD_DebSRCLowOkTPre_C "Heilungsentprellzeit SRC-Low für die Abgastemperatur vor dem Partikelfilter" VALUE 0xECE54 Kw_Wu16 655350.0 Time_ms 0.00 655350.0 FORMAT "%8.1" /end CHARACTERISTIC
/begin CHARACTERISTIC PFltCD_dtRmpSlpUpPPre_C "Rampensteigung bei Heilung/Vorgabewert für Absolutdrucksensor vor dem Partikelfilter" VALUE 0xECDB4 Kw_Wu32 65535999.9847 RmpPres 0.00 65535999.9847 FORMAT "%14.4" /end CHARACTERISTIC
/begin CHARACTERISTIC PFltCD_dtRmpSlpDwnPPre_C "Rampensteigung bei Heilung/Vorgabewert für Abolutdrucksensor vor dem Partikelfilter" VALUE 0xECDB8 Kw_Wu32 65535999.9847 RmpPres 0.00 65535999.9847 FORMAT "%14.4" /end CHARACTERISTIC
/begin CHARACTERISTIC PFltCD_dtRmpSlpUpPre_C "Aufw.-Schritt für Rampe der Abgastemperatur vor dem Partikelfilter" VALUE 0xECE58 Kw_Wu32 6553599.99847 RmpTemp 0.00 6553599.99847 FORMAT "%13.5" /end CHARACTERISTIC
/begin CHARACTERISTIC PFltCD_dtRmpSlpDwnPre_C "Abw.-Schritt für Rampe der Abgastemperatur vor dem Partikelfilter" VALUE 0xECE5C Kw_Wu32 6553599.99847 RmpTemp 0.00 6553599.99847 FORMAT "%13.5" /end CHARACTERISTIC
/begin CHARACTERISTIC PFLTCD_numAdc2_C "#SSD application parameter for Exhaust Temperature sensor 1" VALUE 0xECDBC Kw_Wu8 46.0000000000 NumPinAdc 0.00 46.0000000000 FORMAT "%13.10" /end CHARACTERISTIC
/begin CHARACTERISTIC PFLTCD_numAdc_C "#SSD application parameter for Exhaust Temperature Sensor 1" VALUE 0xECE60 Kw_Wu8 46.0000000000 NumPinAdc 0.00 46.0000000000 FORMAT "%13.10" /end CHARACTERISTIC
/begin CHARACTERISTIC PFltCD_pPreCor_CUR "" CURVE 0xECDBE Kl_Xs16_Ws16 50000.00 Pres 0.00 50000.00 FORMAT "%9.2" EXTENDED_LIMITS -32768.00 32767.00
 /begin AXIS_DESCR STD_AXIS PFlt_dvol CubMtrPerHr 16 -3276.800 3276.700 FORMAT "%8.3" DEPOSIT ABSOLUTE /end AXIS_DESCR
/end CHARACTERISTIC
/begin CHARACTERISTIC PFltCD_tiPPrePT1_C "Zeitkonstante des PT1 Filters" VALUE 0xECE00 Kw_Wu32 4294.9673 TimeDelay_s 0.0000010000000 4294.9673 FORMAT "%9.4" /end CHARACTERISTIC
/begin CHARACTERISTIC PFltCD_tPreCor_CUR "" CURVE 0xECE62 Kl_Xs16_Ws16 400.2000 TempDiff_Cels -200.1000 200.1000 FORMAT "%8.4" EXTENDED_LIMITS -3276.800 3276.700
 /begin AXIS_DESCR STD_AXIS PFlt_dmEG AirMassPerTime 16 -3276.800 3276.700 FORMAT "%8.3" DEPOSIT ABSOLUTE /end AXIS_DESCR
/end CHARACTERISTIC
/begin CHARACTERISTIC PFltCD_stSensIDWordPPre_C "Geberkennwort für Abgasdruck vor dem Partikelfilter" VALUE 0xECE04 Kw_Wu16 65535.00 OneToOne 0.00 65535.00 FORMAT "%8.2" /end CHARACTERISTIC
/begin CHARACTERISTIC PFltCD_pDflPre_C "Vorgabewert für Absolutdruck vor dem Partikelfilter" VALUE 0xECE06 Kw_Ws16 50000.00 Pres 0.00 50000.00 FORMAT "%9.2" EXTENDED_LIMITS -32768.00 32767.00 /end CHARACTERISTIC
/begin CHARACTERISTIC PFltCD_stSensIDWordTPre_C "Geberkennwort für Abgastemperatur vor dem Partikelfilter" VALUE 0xECEA4 Kw_Wu16 65535.00 OneToOne 0.00 65535.00 FORMAT "%8.2" /end CHARACTERISTIC
/begin CHARACTERISTIC PFltCD_tDflPre_C "Vorgabewert für die Abgastemperatur vor dem Partikelfilter" VALUE 0xECEA6 Kw_Ws16 950.000 Temp_Cels -50.14000 899.860 FORMAT "%8.3" EXTENDED_LIMITS -3549.940 3003.560 /end CHARACTERISTIC
/begin CHARACTERISTIC PFlt_aVehFltAshCorMax_C "maximal zulässiger Wert Fahrzeugbeschleunigung" VALUE 0xEB27C Kw_Ws16 10.00000 Acc 0.00 10.00000 FORMAT "%8.5" EXTENDED_LIMITS -32.76800 32.76700 /end CHARACTERISTIC
/begin CHARACTERISTIC PFlt_aVehFltAshCorMin_C "minimal zulässiger Wert Fahrzeugbeschleunigung" VALUE 0xEB27E Kw_Ws16 20.00000 Acc -10.00000 10.00000 FORMAT "%8.5" EXTENDED_LIMITS -32.76800 32.76700 /end CHARACTERISTIC
/begin CHARACTERISTIC PFlt_ctAshCorRgnMax_C "Counteranzahl für Maximumzähler der AshCor Regeneration" VALUE 0xEB280 Kw_Wu16 65535.00 OneToOne 0.00 65535.00 FORMAT "%8.2" /end CHARACTERISTIC
/begin CHARACTERISTIC PFlt_ctAshCorRgn_C "Counterzahl für gültige AshCor Regeneration" VALUE 0xEB282 Kw_Wu16 65535.00 OneToOne 0.00 65535.00 FORMAT "%8.2" /end CHARACTERISTIC
/begin CHARACTERISTIC PFlt_dvol_Vector "#SSD Konfigurationslabel für Bypass" VALUE 0xC314E Kw_Wu8 255.0 OneToOne 0.00 255.0 FORMAT "%5.1" /end CHARACTERISTIC
/begin CHARACTERISTIC PFlt_dvol_Channel "#SSD Konfigurationslabels für Bypass" VALUE 0xC314F Kw_Wu8 255.0 OneToOne 0.00 255.0 FORMAT "%5.1" /end CHARACTERISTIC
/begin CHARACTERISTIC PFlt_facAshCorOld_C "Faktor für den alten Aschekorrekturwert" VALUE 0xEB284 Kw_Ws16 65535.00 OneToOne -32768.00 32767.00 FORMAT "%8.2" /end CHARACTERISTIC
/begin CHARACTERISTIC PFlt_facAshOil_C "Faktor für Aschenöl" VALUE 0xEB286 Kw_Ws16 65535.00 OneToOne -32768.00 32767.00 FORMAT "%8.2" /end CHARACTERISTIC
/begin CHARACTERISTIC PFlt_facFlTotCor_C "Gesamtmenge Kraftstoffkorrekturfaktor" VALUE 0xEB288 Kw_Ws16 1.000000 Fact 0.00 1.000000 FORMAT "%8.6" EXTENDED_LIMITS -4.000000 3.999878 /end CHARACTERISTIC
/begin CHARACTERISTIC PFlt_faclAshCor_C "Aschenkorrekturfaktor." VALUE 0xEB28A Kw_Wu16 65535.00 OneToOne 0.00 65535.00 FORMAT "%8.2" /end CHARACTERISTIC
/begin CHARACTERISTIC PFlt_lAshCorMax_C "Maximaler Kilometerstand" VALUE 0xEB28C Kw_Ws16 32767.00 LengthKm 0.00 32767.00 FORMAT "%8.2" EXTENDED_LIMITS -32768.00 32767.00 /end CHARACTERISTIC
/begin CHARACTERISTIC PFlt_lAshCorNextDef_C "Lesen des Wertes aus dem Eeprom nicht erfolgreich; diesen Wert verwenden" VALUE 0xEB290 Kw_Wu32 4294967295.00 LengthKm 0.00 4294967295.00 FORMAT "%13.2" /end CHARACTERISTIC
/begin CHARACTERISTIC PFlt_lAshCorNplAbsRel_C "Kilometerzahl, welche bei erkanntem relativen und absoluten Fehler addiert wird" VALUE 0xEB294 Kw_Ws16 32767.00 LengthKm 0.00 32767.00 FORMAT "%8.2" EXTENDED_LIMITS -32768.00 32767.00 /end CHARACTERISTIC
/begin CHARACTERISTIC PFlt_lAshCorNplAbs_C "plausibler Wert für den absoluten Kilometerstand" VALUE 0xEB296 Kw_Ws16 32767.00 LengthKm 0.00 32767.00 FORMAT "%8.2" EXTENDED_LIMITS -32768.00 32767.00 /end CHARACTERISTIC
/begin CHARACTERISTIC PFlt_lAshCorNplRel_C "plausibler Wert für den relativen Kilometerstand" VALUE 0xEB298 Kw_Ws16 32767.00 LengthKm 0.00 32767.00 FORMAT "%8.2" EXTENDED_LIMITS -32768.00 32767.00 /end CHARACTERISTIC
/begin CHARACTERISTIC PFlt_lAshCorRegIntr_C "Regenerationsunterbrechung Kilometerstand" VALUE 0xEB29A Kw_Ws16 32767.00 LengthKm 0.00 32767.00 FORMAT "%8.2" EXTENDED_LIMITS -32768.00 32767.00 /end CHARACTERISTIC
/begin CHARACTERISTIC PFlt_lMinSnceRgn_C "Minimaler Abstand seit letzter Regeneration." VALUE 0xEB29C Kw_Wu32 2147483647.00 Length 0.00 2147483647.00 FORMAT "%13.2" EXTENDED_LIMITS 0.00 4294967295.00 /end CHARACTERISTIC
/begin CHARACTERISTIC PFlt_lSnceRgnIntr_CA "" VAL_BLK 0xEB3A4 Kwb_Wu32 4294967295.00 Length 0.00 4294967295.00 FORMAT "%13.2" NUMBER 9 /end CHARACTERISTIC
/begin CHARACTERISTIC PFlt_lSumMaxDef_C "gefahrene Strecke Schwelle für Regeneration im Fehlerfall" VALUE 0xEB3C8 Kw_Wu32 4294967295.00 Length 0.00 4294967295.00 FORMAT "%13.2" /end CHARACTERISTIC
/begin CHARACTERISTIC PFlt_lSumMax_C "gefahrene Strecke Schwelle für Regeneration" VALUE 0xEB3CC Kw_Wu32 4294967295.00 Length 0.00 4294967295.00 FORMAT "%13.2" /end CHARACTERISTIC
/begin CHARACTERISTIC PFlt_lSumSubs_C "Ersatzwert für gefahrene Strecke im Fall eines Eeprom lese Fehlers" VALUE 0xEB3D0 Kw_Wu32 4294967295.00 Length 0.00 4294967295.00 FORMAT "%13.2" /end CHARACTERISTIC
/begin CHARACTERISTIC PFlt_mAshCor_MAP "Map für Ascheabweichung vom Sollwert" MAP 0xEB2A0 Kf_Xs16_Ys16_Ws16 400.0000 mSoot_g -100.0000 300.0000 FORMAT "%8.4" EXTENDED_LIMITS -327.6800 327.6700
 /begin AXIS_DESCR STD_AXIS PFlt_dVolFltAshCor_mp CubMtrPerHr 8 0.00 3000.000 FORMAT "%8.3" EXTENDED_LIMITS -3276.800 3276.700 DEPOSIT ABSOLUTE /end AXIS_DESCR
 /begin AXIS_DESCR STD_AXIS PFlt_resFlowFltAshCor_mp Res_hPaHrPerCM 8 0.00 25.00000 FORMAT "%8.5" EXTENDED_LIMITS -32.76800 32.76700 DEPOSIT ABSOLUTE /end AXIS_DESCR
/end CHARACTERISTIC
/begin CHARACTERISTIC PFlt_mAshTolcAbs_C "" VALUE 0xEB344 Kw_Ws16 300.0000 mSoot_g 0.00 300.0000 FORMAT "%8.4" EXTENDED_LIMITS -327.6800 327.6700 /end CHARACTERISTIC
/begin CHARACTERISTIC PFlt_mAshTolcMaxAbs_C "maximal erlaubte absolute Abweichung des neu berechneten Aschewertes" VALUE 0xEB346 Kw_Ws16 300.0000 mSoot_g 0.00 300.0000 FORMAT "%8.4" EXTENDED_LIMITS -327.6800 327.6700 /end CHARACTERISTIC
/begin CHARACTERISTIC PFlt_mAshTolcMaxRel_C "maximal erlaubte relative Abweichung der neu berechneten Aschemenge" VALUE 0xEB348 Kw_Ws16 300.0000 mSoot_g 0.00 300.0000 FORMAT "%8.4" EXTENDED_LIMITS -327.6800 327.6700 /end CHARACTERISTIC
/begin CHARACTERISTIC PFlt_mDiagAFSMax_C "obere Grenze des gemittelten Wertes der Luftmasse pro Zylinder" VALUE 0xEB760 Kw_Ws16 3200.000 AirMassPerCyl 0.00 3200.000 FORMAT "%8.3" EXTENDED_LIMITS -3276.800 3276.700 /end CHARACTERISTIC
/begin CHARACTERISTIC PFlt_mDiagAFSMin_C "untere Grenze des gemittelten Wertes der Luftmasse pro Zylinder" VALUE 0xEB762 Kw_Ws16 3200.000 AirMassPerCyl 0.00 3200.000 FORMAT "%8.3" EXTENDED_LIMITS -3276.800 3276.700 /end CHARACTERISTIC
/begin CHARACTERISTIC PFlt_mDiagSotMax_C "obere Grenze der Partikelmasse im Partikelfilter" VALUE 0xEB764 Kw_Ws16 300.0000 mSoot_g 0.00 300.0000 FORMAT "%8.4" EXTENDED_LIMITS -327.6800 327.6700 /end CHARACTERISTIC
/begin CHARACTERISTIC PFlt_mDiagSotMin_C "untere Grenze der Partikelmasse im Partikelfilter" VALUE 0xEB766 Kw_Ws16 300.0000 mSoot_g 0.00 300.0000 FORMAT "%8.4" EXTENDED_LIMITS -327.6800 327.6700 /end CHARACTERISTIC
/begin CHARACTERISTIC PFlt_mSotMeas_CUR "Umrechnung Strömungswiderstand Partikelmasse" CURVE 0xEB3D4 Kl_Xs16_Ws16 300.0000 mSoot_g 0.00 300.0000 FORMAT "%8.4" EXTENDED_LIMITS -327.6800 327.6700
 /begin AXIS_DESCR STD_AXIS PFlt_resFlowOfs Res_hPaHrPerCM 8 0.00 25.00000 FORMAT "%8.5" EXTENDED_LIMITS -32.76800 32.76700 DEPOSIT ABSOLUTE /end AXIS_DESCR
/end CHARACTERISTIC
/begin CHARACTERISTIC PFlt_mSotNewRng1_C "Schwelle Regeneriert -> Regenerationsstate 1" VALUE 0xEB3F6 Kw_Ws16 300.0000 mSoot_g 0.00 300.0000 FORMAT "%8.4" EXTENDED_LIMITS -327.6800 327.6700 /end CHARACTERISTIC
/begin CHARACTERISTIC PFlt_mSotRng1New_C "Schwelle Regenerationsstate 1 -> regeneriert" VALUE 0xEB3F8 Kw_Ws16 300.0000 mSoot_g 0.00 300.0000 FORMAT "%8.4" EXTENDED_LIMITS -327.6800 327.6700 /end CHARACTERISTIC
/begin CHARACTERISTIC PFlt_mSotRng1Rng2_C "Schwelle Regenerationsstate 1 -> Regenerationsstate 2" VALUE 0xEB3FA Kw_Ws16 300.0000 mSoot_g 0.00 300.0000 FORMAT "%8.4" EXTENDED_LIMITS -327.6800 327.6700 /end CHARACTERISTIC
/begin CHARACTERISTIC PFlt_mSotRng2Rng1_C "Schwelle Regenerationsstate 2 -> Regenerationsstate 1" VALUE 0xEB3FC Kw_Ws16 300.0000 mSoot_g 0.00 300.0000 FORMAT "%8.4" EXTENDED_LIMITS -327.6800 327.6700 /end CHARACTERISTIC
/begin CHARACTERISTIC PFlt_mSotRng2Rng3_C "Schwelle Regenerationstate 2 -> 3" VALUE 0xEB3FE Kw_Ws16 300.0000 mSoot_g 0.00 300.0000 FORMAT "%8.4" EXTENDED_LIMITS -327.6800 327.6700 /end CHARACTERISTIC
/begin CHARACTERISTIC PFlt_mSotRng3Rng2_C "Schwelle Regenerationsstate 3 -> 2" VALUE 0xEB400 Kw_Ws16 300.0000 mSoot_g 0.00 300.0000 FORMAT "%8.4" EXTENDED_LIMITS -327.6800 327.6700 /end CHARACTERISTIC
/begin CHARACTERISTIC PFlt_mSotRng3Rng4_C "Schwelle Regeneratiosstate 3 -> 4" VALUE 0xEB402 Kw_Ws16 300.0000 mSoot_g 0.00 300.0000 FORMAT "%8.4" EXTENDED_LIMITS -327.6800 327.6700 /end CHARACTERISTIC
/begin CHARACTERISTIC PFlt_mSotRng4Rng3_C "Schwelle Regenerationsstate 4 -> 3" VALUE 0xEB404 Kw_Ws16 300.0000 mSoot_g 0.00 300.0000 FORMAT "%8.4" EXTENDED_LIMITS -327.6800 327.6700 /end CHARACTERISTIC
/begin CHARACTERISTIC PFlt_mSotRng4Rng5_C "Schwelle Regenerationsstate 4 -> 5" VALUE 0xEB406 Kw_Ws16 300.0000 mSoot_g 0.00 300.0000 FORMAT "%8.4" EXTENDED_LIMITS -327.6800 327.6700 /end CHARACTERISTIC
/begin CHARACTERISTIC PFlt_mSotRng5Rng4_C "Schwelle Regeneratiosstate 5 -> 4" VALUE 0xEB408 Kw_Ws16 300.0000 mSoot_g 0.00 300.0000 FORMAT "%8.4" EXTENDED_LIMITS -327.6800 327.6700 /end CHARACTERISTIC
/begin CHARACTERISTIC PFlt_nAvrgFltAshCorMax_C "maximal zulässiger Wert Drehzahl" VALUE 0xEB34A Kw_Ws16 6000.000 EngN 0.00 6000.000 FORMAT "%8.3" EXTENDED_LIMITS -32768.00 32767.00 /end CHARACTERISTIC
/begin CHARACTERISTIC PFlt_nAvrgFltAshCorMin_C "minimal zulässiger Wert Drehzahl" VALUE 0xEB34C Kw_Ws16 6000.000 EngN 0.00 6000.000 FORMAT "%8.3" EXTENDED_LIMITS -32768.00 32767.00 /end CHARACTERISTIC
/begin CHARACTERISTIC PFlt_nAvrgMinMax_CA "Matrix zur Bestimmung der Bereichsgrenzen für die gefilterte mittlere Drehzahl" MAP 0xEB85C Kf_Xs16_Ys16_Ws16 5960.000 EngN 40.00000 6000.000 FORMAT "%8.3" EXTENDED_LIMITS -32768.00 32767.00
 /begin AXIS_DESCR STD_AXIS PFlt_RngIdx_X_mp OneToOne 11 0.00 10.00 FORMAT "%5.2" EXTENDED_LIMITS 0.00 255.0 DEPOSIT ABSOLUTE /end AXIS_DESCR
 /begin AXIS_DESCR STD_AXIS PFlt_RngIdx_Y_mp OneToOne 2 0.00 1.000 FORMAT "%5.3" EXTENDED_LIMITS 0.00 255.0 DEPOSIT ABSOLUTE /end AXIS_DESCR
/end CHARACTERISTIC
/begin CHARACTERISTIC PFlt_nDiagLowIdle1_C "Leerlaufdrehzahl im Regenerationszustand" VALUE 0xEB768 Kw_Ws16 5000.000 EngN 0.00 5000.000 FORMAT "%8.3" EXTENDED_LIMITS -32768.00 32767.00 /end CHARACTERISTIC
/begin CHARACTERISTIC PFlt_nDiagLowIdle2_C "Leerlaufdrehzahl in der Abkühlphase" VALUE 0xEB76A Kw_Ws16 5000.000 EngN 0.00 5000.000 FORMAT "%8.3" EXTENDED_LIMITS -32768.00 32767.00 /end CHARACTERISTIC
/begin CHARACTERISTIC PFlt_nDiagLowIdle_C "Leerlaufdrehzahl im Heizzustand" VALUE 0xEB76C Kw_Ws16 5000.000 EngN 0.00 5000.000 FORMAT "%8.3" EXTENDED_LIMITS -32768.00 32767.00 /end CHARACTERISTIC
/begin CHARACTERISTIC PFlt_nDiagMax_C "obere Motordrehzahlgrenze" VALUE 0xEB76E Kw_Ws16 5000.000 EngN 0.00 5000.000 FORMAT "%8.3" EXTENDED_LIMITS -32768.00 32767.00 /end CHARACTERISTIC
/begin CHARACTERISTIC PFlt_nDiagMin_C "untere Motordrehzahlgrenze" VALUE 0xEB770 Kw_Ws16 5000.000 EngN 0.00 5000.000 FORMAT "%8.3" EXTENDED_LIMITS -32768.00 32767.00 /end CHARACTERISTIC
/begin CHARACTERISTIC PFlt_nDiagRgnMax_C "obere Motordrehzahlgrenze" VALUE 0xEB772 Kw_Ws16 5000.000 EngN 0.00 5000.000 FORMAT "%8.3" EXTENDED_LIMITS -32768.00 32767.00 /end CHARACTERISTIC
/begin CHARACTERISTIC PFlt_nDiagRgnMin_C "untere Motordrehzahlgrenze" VALUE 0xEB774 Kw_Ws16 5000.000 EngN 0.00 5000.000 FORMAT "%8.3" EXTENDED_LIMITS -32768.00 32767.00 /end CHARACTERISTIC
/begin CHARACTERISTIC PFlt_numAshCorMsk_C "Maske für gültige AshCor Regeneration, Eingang ist der Status PFlt_stEngPOp" VALUE 0xEB34E Kw_Wu16 65535.00 OneToOne 0.00 65535.00 FORMAT "%8.2" /end CHARACTERISTIC
/begin CHARACTERISTIC PFlt_numAshCor_C "AshCor-Schalterwert" VALUE 0xEB350 Kw_Wu8 11.00 OneToOne 0.00 11.00 FORMAT "%5.2" EXTENDED_LIMITS 0.00 255.0 /end CHARACTERISTIC
/begin CHARACTERISTIC PFlt_numEngPOpDel_CA "verzögert wirksame Matrix zur Berücksichtigung des Motorbetriebszustandes bei der Regeneration" MAP 0xEB40A Kf_Xu8_Yu8_Wu8 6.000 OneToOne 0.00 6.000 FORMAT "%5.3" EXTENDED_LIMITS 0.00 255.0
 /begin AXIS_DESCR STD_AXIS PFlt_stEngPOp OneToOne 12 0.00 11.00 FORMAT "%5.2" EXTENDED_LIMITS 0.00 255.0 DEPOSIT ABSOLUTE /end AXIS_DESCR
 /begin AXIS_DESCR STD_AXIS PFlt_numRgn_mp OneToOne 9 0.00 8.000 FORMAT "%5.3" EXTENDED_LIMITS 0.00 255.0 DEPOSIT ABSOLUTE /end AXIS_DESCR
/end CHARACTERISTIC
/begin CHARACTERISTIC PFlt_numEngPOp_CA "Partikelfilterstatus vs. Motorstatus Matrix" MAP 0xEB48D Kf_Xu8_Yu8_Wu8 6.000 OneToOne 0.00 6.000 FORMAT "%5.3" EXTENDED_LIMITS 0.00 255.0
 /begin AXIS_DESCR STD_AXIS PFlt_stEngPOp OneToOne 12 0.00 11.00 FORMAT "%5.2" EXTENDED_LIMITS 0.00 255.0 DEPOSIT ABSOLUTE /end AXIS_DESCR
 /begin AXIS_DESCR STD_AXIS PFlt_numRgn_mp OneToOne 9 0.00 8.000 FORMAT "%5.3" EXTENDED_LIMITS 0.00 255.0 DEPOSIT ABSOLUTE /end AXIS_DESCR
/end CHARACTERISTIC
/begin CHARACTERISTIC PFlt_numLst_C "Regenerationsanforderung aufgrund von gefahrener Strecke, Betriebszeit oder Verbrauch" VALUE 0xEB510 Kw_Wu8 255.0 OneToOne 0.00 255.0 FORMAT "%5.1" /end CHARACTERISTIC
/begin CHARACTERISTIC PFlt_numLSU_C "Array - Index für die Lambdasensor Konfiguration" VALUE 0xEBD8E Kw_Wu8 16.00 OneToOne 0.00 16.00 FORMAT "%5.2" EXTENDED_LIMITS 0.00 255.0 /end CHARACTERISTIC
/begin CHARACTERISTIC PFlt_numPFltErrRgnIntr_C "" VALUE 0xEB351 Kw_Wu8 8.000 OneToOne 0.00 8.000 FORMAT "%5.3" EXTENDED_LIMITS 0.00 255.0 /end CHARACTERISTIC
/begin CHARACTERISTIC PFlt_numPFltErr_C "Constant for CSF Limp - Home" VALUE 0xEB352 Kw_Wu8 8.000 OneToOne 0.00 8.000 FORMAT "%5.3" EXTENDED_LIMITS 0.00 255.0 /end CHARACTERISTIC
/begin CHARACTERISTIC PFlt_numPOpAir_C "Zeiger auf das Motortemperaturfeld" VALUE 0xEB8A6 Kw_Wu8 2.00000000000 IndSysTempFldSel 0.00 2.00000000000 FORMAT "%13.11" /end CHARACTERISTIC
/begin CHARACTERISTIC PFlt_numPOpClnt_C "Zeiger auf das Temperaturfeld des Ansaugsystems" VALUE 0xEB8A7 Kw_Wu8 2.00000000000 EngTempFldSel 0.00 2.00000000000 FORMAT "%13.11" /end CHARACTERISTIC
/begin CHARACTERISTIC PFlt_numPrioRgnStg1_C "Priorität für Regenerationstate 1" VALUE 0xEB512 Kw_Wu16 65535.00 OneToOne 0.00 65535.00 FORMAT "%8.2" /end CHARACTERISTIC
/begin CHARACTERISTIC PFlt_numPrioRgnStg2_C "Priorität für Regenerationstate 2" VALUE 0xEB514 Kw_Wu16 65535.00 OneToOne 0.00 65535.00 FORMAT "%8.2" /end CHARACTERISTIC
/begin CHARACTERISTIC PFlt_numPrioRgnStg3_C "Priorität für Regenerationstate 3" VALUE 0xEB516 Kw_Wu16 65535.00 OneToOne 0.00 65535.00 FORMAT "%8.2" /end CHARACTERISTIC
/begin CHARACTERISTIC PFlt_numPrioRgnStg4_C "Priorität für Regenerationstate 4" VALUE 0xEB518 Kw_Wu16 65535.00 OneToOne 0.00 65535.00 FORMAT "%8.2" /end CHARACTERISTIC
/begin CHARACTERISTIC PFlt_numPrioRgnStg5_C "Priorität für Regenerationstate 5" VALUE 0xEB51A Kw_Wu16 65535.00 OneToOne 0.00 65535.00 FORMAT "%8.2" /end CHARACTERISTIC
/begin CHARACTERISTIC PFlt_numPrioRgnStg6_C "Prioritätszahl für Regenerationsstufe 6" VALUE 0xEB51C Kw_Wu16 65535.00 OneToOne 0.00 65535.00 FORMAT "%8.2" /end CHARACTERISTIC
/begin CHARACTERISTIC PFlt_numPrioRgnStgDiag_C "Regeneration priority of requested state when PFlt tester demand is active" VALUE 0xEB51E Kw_Wu16 65535.00 OneToOne 0.00 65535.00 FORMAT "%8.2" /end CHARACTERISTIC
/begin CHARACTERISTIC PFlt_numPrt_C "Regenerationsanforderung aufgrund v. Motorschutz" VALUE 0xEB520 Kw_Wu8 255.0 OneToOne 0.00 255.0 FORMAT "%5.1" /end CHARACTERISTIC
/begin CHARACTERISTIC PFlt_numRgnSuc_C "größte Regenerationsanforderungszahl ab der eine erfolgreiche Regeneration detektiert wird" VALUE 0xEB521 Kw_Wu8 100.0 OneToOne 0.00 100.0 FORMAT "%5.1" EXTENDED_LIMITS 0.00 255.0 /end CHARACTERISTIC
/begin CHARACTERISTIC PFlt_pAPSDiag_C "Atmosphärendruckgrenze" VALUE 0xEB776 Kw_Ws16 3850.000 Pres_hPa -350.0000 3500.000 FORMAT "%8.3" EXTENDED_LIMITS -32768.00 32767.00 /end CHARACTERISTIC
/begin CHARACTERISTIC PFlt_pDiagBPSMax_C "obere Grenze des linearisierten Wertes vom Ladedruck" VALUE 0xEB778 Kw_Ws16 3500.000 Pres_hPa 0.00 3500.000 FORMAT "%8.3" EXTENDED_LIMITS -32768.00 32767.00 /end CHARACTERISTIC
/begin CHARACTERISTIC PFlt_pDiagBPSMin_C "untere Grenze des linearisierten Wertes vom Ladedruck" VALUE 0xEB77A Kw_Ws16 3500.000 Pres_hPa 0.00 3500.000 FORMAT "%8.3" EXTENDED_LIMITS -32768.00 32767.00 /end CHARACTERISTIC
/begin CHARACTERISTIC PFlt_pEngPrtMaxInit_C "Inititialisierungswert des PT1-Filters für den Maximalwert im Motorschutz" VALUE 0xEB522 Kw_Ws16 32767.00 Pres_hPa 0.00 32767.00 FORMAT "%8.2" EXTENDED_LIMITS -32768.00 32767.00 /end CHARACTERISTIC
/begin CHARACTERISTIC PFlt_pEngPrtMax_MAP "Kennfeld obere Druckschwelle Motorschutz" MAP 0xEB524 Kf_Xs16_Ys16_Ws16 3500.000 Pres_hPa 0.00 3500.000 FORMAT "%8.3" EXTENDED_LIMITS -32768.00 32767.00
 /begin AXIS_DESCR STD_AXIS Eng_nAvrg EngN 8 40.00000 6000.000 FORMAT "%8.3" EXTENDED_LIMITS -32768.00 32767.00 DEPOSIT ABSOLUTE /end AXIS_DESCR
 /begin AXIS_DESCR STD_AXIS InjCtl_qSetUnBal InjMassCyc 8 0.00 327.6700 FORMAT "%8.4" EXTENDED_LIMITS -327.6800 327.6700 DEPOSIT ABSOLUTE /end AXIS_DESCR
/end CHARACTERISTIC
/begin CHARACTERISTIC PFlt_pEngPrtMin_MAP "untere Druckschwelle Motorschutz" MAP 0xEB5C8 Kf_Xs16_Ys16_Ws16 3500.000 Pres_hPa 0.00 3500.000 FORMAT "%8.3" EXTENDED_LIMITS -32768.00 32767.00
 /begin AXIS_DESCR STD_AXIS Eng_nAvrg EngN 8 40.00000 6000.000 FORMAT "%8.3" EXTENDED_LIMITS -32768.00 32767.00 DEPOSIT ABSOLUTE /end AXIS_DESCR
 /begin AXIS_DESCR STD_AXIS InjCtl_qSetUnBal InjMassCyc 8 0.00 327.6700 FORMAT "%8.4" EXTENDED_LIMITS -327.6800 327.6700 DEPOSIT ABSOLUTE /end AXIS_DESCR
/end CHARACTERISTIC
/begin CHARACTERISTIC PFlt_qDiagPOpMax_CUR "Kennlinie zur Überprüfung der Maximalgrenze von InjCtl_qSetUnbal" CURVE 0xEB77C Kl_Xs16_Ws16 327.6700 InjMassCyc 0.00 327.6700 FORMAT "%8.4" EXTENDED_LIMITS -327.6800 327.6700
 /begin AXIS_DESCR STD_AXIS Eng_nAvrg EngN 8 40.00000 6000.000 FORMAT "%8.3" EXTENDED_LIMITS -32768.00 32767.00 DEPOSIT ABSOLUTE /end AXIS_DESCR
/end CHARACTERISTIC
/begin CHARACTERISTIC PFlt_qDiagPOpMin_CUR "Kennlinie zur Überprüfung der Minimalgrenze von InjCtl_qSetUnbal" CURVE 0xEB79E Kl_Xs16_Ws16 327.6700 InjMassCyc 0.00 327.6700 FORMAT "%8.4" EXTENDED_LIMITS -327.6800 327.6700
 /begin AXIS_DESCR STD_AXIS Eng_nAvrg EngN 8 40.00000 6000.000 FORMAT "%8.3" EXTENDED_LIMITS -32768.00 32767.00 DEPOSIT ABSOLUTE /end AXIS_DESCR
/end CHARACTERISTIC
/begin CHARACTERISTIC PFlt_qFlMaxDef_C "Regenerationsschwelle für Treibstoffverbrauch im Fehlerfall" VALUE 0xEB66C Kw_Ws16 320.0000 Fl_L 0.00 320.0000 FORMAT "%8.4" EXTENDED_LIMITS -327.6800 327.6700 /end CHARACTERISTIC
/begin CHARACTERISTIC PFlt_qFlMax_CUR "" CURVE 0xEB66E Kl_Xs16_Ws16 320.0000 Fl_L 0.00 320.0000 FORMAT "%8.4" EXTENDED_LIMITS -327.6800 327.6700
 /begin AXIS_DESCR STD_AXIS PFlt_mAshOil mSoot_g 8 -327.6800 327.6700 FORMAT "%8.4" DEPOSIT ABSOLUTE /end AXIS_DESCR
/end CHARACTERISTIC
/begin CHARACTERISTIC PFlt_qFlSubs_C "Treibstoffverbrauch Ersatzwert für den Fall eines Eeprom lese Fehlers" VALUE 0xEB690 Kw_Ws16 320.0000 Fl_L 0.00 320.0000 FORMAT "%8.4" EXTENDED_LIMITS -327.6800 327.6700 /end CHARACTERISTIC
/begin CHARACTERISTIC PFlt_qFlTotAdjMax_C "Maximalwert des gesamten Kraftstoffverbrauchs" VALUE 0xEB694 Kw_Ws32 42949672.9500 Fl_L -21474836.4800 21474836.4700 FORMAT "%13.4" /end CHARACTERISTIC
/begin CHARACTERISTIC PFlt_qFlTotMin_C "Unterere Grenze für Gesamtmenge Kraftstoffquantität" VALUE 0xEB354 Kw_Ws16 320.0000 Fl_2 0.00 320.0000 FORMAT "%8.4" EXTENDED_LIMITS -327680.0 327670.0 /end CHARACTERISTIC
/begin CHARACTERISTIC PFlt_qSetUnBalFltAshCorMax_C "maximal zulässiger Wert aktuelle Einspritzmenge" VALUE 0xEB356 Kw_Ws16 327.6700 InjMassCyc 0.00 327.6700 FORMAT "%8.4" EXTENDED_LIMITS -327.6800 327.6700 /end CHARACTERISTIC
/begin CHARACTERISTIC PFlt_qSetUnBalFltAshCorMin_C "minimal zulässiger Wert aktuelle Einspritzmenge" VALUE 0xEB358 Kw_Ws16 327.6700 InjMassCyc 0.00 327.6700 FORMAT "%8.4" EXTENDED_LIMITS -327.6800 327.6700 /end CHARACTERISTIC
/begin CHARACTERISTIC PFlt_qSetUnBalRng10Max_GCUR "Maximalwert Einspritzmassensollwert Bereich 10" CURVE 0xEB8A8 Gkl_Ws16 327.6700 InjMass 0.00 327.6700 FORMAT "%8.4" EXTENDED_LIMITS -327.6800 327.6700
 /begin AXIS_DESCR COM_AXIS PFlt_nAvrgFlt_mp EngN 8 40.00000 6000.000 FORMAT "%8.3" EXTENDED_LIMITS -32768.00 32767.00 AXIS_PTS_REF PFlt_qSetUnBal_AXIS /end AXIS_DESCR
/end CHARACTERISTIC
/begin CHARACTERISTIC PFlt_qSetUnBalRng10Min_GCUR "Minimalwert Einspritzmassensollwert Bereich 10" CURVE 0xEB8B8 Gkl_Ws16 327.6700 InjMass 0.00 327.6700 FORMAT "%8.4" EXTENDED_LIMITS -327.6800 327.6700
 /begin AXIS_DESCR COM_AXIS PFlt_nAvrgFlt_mp EngN 8 40.00000 6000.000 FORMAT "%8.3" EXTENDED_LIMITS -32768.00 32767.00 AXIS_PTS_REF PFlt_qSetUnBal_AXIS /end AXIS_DESCR
/end CHARACTERISTIC
/begin CHARACTERISTIC PFlt_qSetUnBalRng1Max_GCUR "Maximalwert Einspritzmassensollwert Bereich 1" CURVE 0xEB8C8 Gkl_Ws16 327.6700 InjMass 0.00 327.6700 FORMAT "%8.4" EXTENDED_LIMITS -327.6800 327.6700
 /begin AXIS_DESCR COM_AXIS PFlt_nAvrgFlt_mp EngN 8 40.00000 6000.000 FORMAT "%8.3" EXTENDED_LIMITS -32768.00 32767.00 AXIS_PTS_REF PFlt_qSetUnBal_AXIS /end AXIS_DESCR
/end CHARACTERISTIC
/begin CHARACTERISTIC PFlt_qSetUnBalRng1Min_GCUR "Minimalwert Einspritzmassensollwert Bereich 1" CURVE 0xEB8D8 Gkl_Ws16 327.6700 InjMass 0.00 327.6700 FORMAT "%8.4" EXTENDED_LIMITS -327.6800 327.6700
 /begin AXIS_DESCR COM_AXIS PFlt_nAvrgFlt_mp EngN 8 40.00000 6000.000 FORMAT "%8.3" EXTENDED_LIMITS -32768.00 32767.00 AXIS_PTS_REF PFlt_qSetUnBal_AXIS /end AXIS_DESCR
/end CHARACTERISTIC
/begin CHARACTERISTIC PFlt_qSetUnBalRng2Max_GCUR "Maximalwert Einspritzmassensollwert Bereich 2" CURVE 0xEB8E8 Gkl_Ws16 327.6700 InjMass 0.00 327.6700 FORMAT "%8.4" EXTENDED_LIMITS -327.6800 327.6700
 /begin AXIS_DESCR COM_AXIS PFlt_nAvrgFlt_mp EngN 8 40.00000 6000.000 FORMAT "%8.3" EXTENDED_LIMITS -32768.00 32767.00 AXIS_PTS_REF PFlt_qSetUnBal_AXIS /end AXIS_DESCR
/end CHARACTERISTIC
/begin CHARACTERISTIC PFlt_qSetUnBalRng2Min_GCUR "Minimalwert Einspritzmassensollwert Bereich 2" CURVE 0xEB8F8 Gkl_Ws16 327.6700 InjMass 0.00 327.6700 FORMAT "%8.4" EXTENDED_LIMITS -327.6800 327.6700
 /begin AXIS_DESCR COM_AXIS PFlt_nAvrgFlt_mp EngN 8 40.00000 6000.000 FORMAT "%8.3" EXTENDED_LIMITS -32768.00 32767.00 AXIS_PTS_REF PFlt_qSetUnBal_AXIS /end AXIS_DESCR
/end CHARACTERISTIC
/begin CHARACTERISTIC PFlt_qSetUnBalRng3Max_GCUR "Maximalwert Einspritzmassensollwert Bereich 3" CURVE 0xEB908 Gkl_Ws16 327.6700 InjMass 0.00 327.6700 FORMAT "%8.4" EXTENDED_LIMITS -327.6800 327.6700
 /begin AXIS_DESCR COM_AXIS PFlt_nAvrgFlt_mp EngN 8 40.00000 6000.000 FORMAT "%8.3" EXTENDED_LIMITS -32768.00 32767.00 AXIS_PTS_REF PFlt_qSetUnBal_AXIS /end AXIS_DESCR
/end CHARACTERISTIC
/begin CHARACTERISTIC PFlt_qSetUnBalRng3Min_GCUR "Minimalwert Einspritzmassensollwert Bereich 3" CURVE 0xEB918 Gkl_Ws16 327.6700 InjMass 0.00 327.6700 FORMAT "%8.4" EXTENDED_LIMITS -327.6800 327.6700
 /begin AXIS_DESCR COM_AXIS PFlt_nAvrgFlt_mp EngN 8 40.00000 6000.000 FORMAT "%8.3" EXTENDED_LIMITS -32768.00 32767.00 AXIS_PTS_REF PFlt_qSetUnBal_AXIS /end AXIS_DESCR
/end CHARACTERISTIC
/begin CHARACTERISTIC PFlt_qSetUnBalRng4Max_GCUR "Maximalwert Einspritzmassensollwert Bereich 4" CURVE 0xEB928 Gkl_Ws16 327.6700 InjMass 0.00 327.6700 FORMAT "%8.4" EXTENDED_LIMITS -327.6800 327.6700
 /begin AXIS_DESCR COM_AXIS PFlt_nAvrgFlt_mp EngN 8 40.00000 6000.000 FORMAT "%8.3" EXTENDED_LIMITS -32768.00 32767.00 AXIS_PTS_REF PFlt_qSetUnBal_AXIS /end AXIS_DESCR
/end CHARACTERISTIC
/begin CHARACTERISTIC PFlt_qSetUnBalRng4Min_GCUR "Minimalwert Einspritzmassensollwert Bereich 4" CURVE 0xEB938 Gkl_Ws16 327.6700 InjMass 0.00 327.6700 FORMAT "%8.4" EXTENDED_LIMITS -327.6800 327.6700
 /begin AXIS_DESCR COM_AXIS PFlt_nAvrgFlt_mp EngN 8 40.00000 6000.000 FORMAT "%8.3" EXTENDED_LIMITS -32768.00 32767.00 AXIS_PTS_REF PFlt_qSetUnBal_AXIS /end AXIS_DESCR
/end CHARACTERISTIC
/begin CHARACTERISTIC PFlt_qSetUnBalRng5Max_GCUR "Maximalwert Einspritzmassensollwert Bereich 5" CURVE 0xEB948 Gkl_Ws16 327.6700 InjMass 0.00 327.6700 FORMAT "%8.4" EXTENDED_LIMITS -327.6800 327.6700
 /begin AXIS_DESCR COM_AXIS PFlt_nAvrgFlt_mp EngN 8 40.00000 6000.000 FORMAT "%8.3" EXTENDED_LIMITS -32768.00 32767.00 AXIS_PTS_REF PFlt_qSetUnBal_AXIS /end AXIS_DESCR
/end CHARACTERISTIC
/begin CHARACTERISTIC PFlt_qSetUnBalRng5Min_GCUR "Minimalwert Einspritzmassensollwert Bereich 5" CURVE 0xEB958 Gkl_Ws16 327.6700 InjMass 0.00 327.6700 FORMAT "%8.4" EXTENDED_LIMITS -327.6800 327.6700
 /begin AXIS_DESCR COM_AXIS PFlt_nAvrgFlt_mp EngN 8 40.00000 6000.000 FORMAT "%8.3" EXTENDED_LIMITS -32768.00 32767.00 AXIS_PTS_REF PFlt_qSetUnBal_AXIS /end AXIS_DESCR
/end CHARACTERISTIC
/begin CHARACTERISTIC PFlt_qSetUnBalRng6Max_GCUR "Maximalwert Einspritzmassensollwert Bereich 6" CURVE 0xEB968 Gkl_Ws16 327.6700 InjMass 0.00 327.6700 FORMAT "%8.4" EXTENDED_LIMITS -327.6800 327.6700
 /begin AXIS_DESCR COM_AXIS PFlt_nAvrgFlt_mp EngN 8 40.00000 6000.000 FORMAT "%8.3" EXTENDED_LIMITS -32768.00 32767.00 AXIS_PTS_REF PFlt_qSetUnBal_AXIS /end AXIS_DESCR
/end CHARACTERISTIC
/begin CHARACTERISTIC PFlt_qSetUnBalRng6Min_GCUR "Minimalwert Einspritzmassensollwert Bereich 6" CURVE 0xEB978 Gkl_Ws16 327.6700 InjMass 0.00 327.6700 FORMAT "%8.4" EXTENDED_LIMITS -327.6800 327.6700
 /begin AXIS_DESCR COM_AXIS PFlt_nAvrgFlt_mp EngN 8 40.00000 6000.000 FORMAT "%8.3" EXTENDED_LIMITS -32768.00 32767.00 AXIS_PTS_REF PFlt_qSetUnBal_AXIS /end AXIS_DESCR
/end CHARACTERISTIC
/begin CHARACTERISTIC PFlt_qSetUnBalRng7Max_GCUR "Maximalwert Einspritzmassensollwert Bereich 7" CURVE 0xEB988 Gkl_Ws16 327.6700 InjMass 0.00 327.6700 FORMAT "%8.4" EXTENDED_LIMITS -327.6800 327.6700
 /begin AXIS_DESCR COM_AXIS PFlt_nAvrgFlt_mp EngN 8 40.00000 6000.000 FORMAT "%8.3" EXTENDED_LIMITS -32768.00 32767.00 AXIS_PTS_REF PFlt_qSetUnBal_AXIS /end AXIS_DESCR
/end CHARACTERISTIC
/begin CHARACTERISTIC PFlt_qSetUnBalRng7Min_GCUR "Minimalwert Einspritzmassensollwert Bereich 7" CURVE 0xEB998 Gkl_Ws16 327.6700 InjMass 0.00 327.6700 FORMAT "%8.4" EXTENDED_LIMITS -327.6800 327.6700
 /begin AXIS_DESCR COM_AXIS PFlt_nAvrgFlt_mp EngN 8 40.00000 6000.000 FORMAT "%8.3" EXTENDED_LIMITS -32768.00 32767.00 AXIS_PTS_REF PFlt_qSetUnBal_AXIS /end AXIS_DESCR
/end CHARACTERISTIC
/begin CHARACTERISTIC PFlt_qSetUnBalRng8Max_GCUR "Maximalwert Einspritzmassensollwert Bereich 8" CURVE 0xEB9A8 Gkl_Ws16 327.6700 InjMass 0.00 327.6700 FORMAT "%8.4" EXTENDED_LIMITS -327.6800 327.6700
 /begin AXIS_DESCR COM_AXIS PFlt_nAvrgFlt_mp EngN 8 40.00000 6000.000 FORMAT "%8.3" EXTENDED_LIMITS -32768.00 32767.00 AXIS_PTS_REF PFlt_qSetUnBal_AXIS /end AXIS_DESCR
/end CHARACTERISTIC
/begin CHARACTERISTIC PFlt_qSetUnBalRng8Min_GCUR "Minimalwert Einspritzmassensollwert Bereich 8" CURVE 0xEB9B8 Gkl_Ws16 327.6700 InjMass 0.00 327.6700 FORMAT "%8.4" EXTENDED_LIMITS -327.6800 327.6700
 /begin AXIS_DESCR COM_AXIS PFlt_nAvrgFlt_mp EngN 8 40.00000 6000.000 FORMAT "%8.3" EXTENDED_LIMITS -32768.00 32767.00 AXIS_PTS_REF PFlt_qSetUnBal_AXIS /end AXIS_DESCR
/end CHARACTERISTIC
/begin CHARACTERISTIC PFlt_qSetUnBalRng9Max_GCUR "Maximalwert Einspritzmassensollwert Bereich 9" CURVE 0xEB9C8 Gkl_Ws16 327.6700 InjMass 0.00 327.6700 FORMAT "%8.4" EXTENDED_LIMITS -327.6800 327.6700
 /begin AXIS_DESCR COM_AXIS PFlt_nAvrgFlt_mp EngN 8 40.00000 6000.000 FORMAT "%8.3" EXTENDED_LIMITS -32768.00 32767.00 AXIS_PTS_REF PFlt_qSetUnBal_AXIS /end AXIS_DESCR
/end CHARACTERISTIC
/begin CHARACTERISTIC PFlt_qSetUnBalRng9Min_GCUR "Minimalwert Einspritzmassensollwert Bereich 9" CURVE 0xEB9D8 Gkl_Ws16 327.6700 InjMass 0.00 327.6700 FORMAT "%8.4" EXTENDED_LIMITS -327.6800 327.6700
 /begin AXIS_DESCR COM_AXIS PFlt_nAvrgFlt_mp EngN 8 40.00000 6000.000 FORMAT "%8.3" EXTENDED_LIMITS -32768.00 32767.00 AXIS_PTS_REF PFlt_qSetUnBal_AXIS /end AXIS_DESCR
/end CHARACTERISTIC
/begin CHARACTERISTIC PFlt_qSetUnBalRngSpoMax_GCUR "Maximalwert Einspritzmassensollwert Bereich Spontane Regeneration" CURVE 0xEB9E8 Gkl_Ws16 327.6700 InjMass 0.00 327.6700 FORMAT "%8.4" EXTENDED_LIMITS -327.6800 327.6700
 /begin AXIS_DESCR COM_AXIS PFlt_nAvrgFlt_mp EngN 8 40.00000 6000.000 FORMAT "%8.3" EXTENDED_LIMITS -32768.00 32767.00 AXIS_PTS_REF PFlt_qSetUnBal_AXIS /end AXIS_DESCR
/end CHARACTERISTIC
/begin CHARACTERISTIC PFlt_qSetUnBalRngSpoMin_GCUR "Minimalwert Einspritzmassensollwert Bereich Spontane Regeneration" CURVE 0xEB9F8 Gkl_Ws16 327.6700 InjMass 0.00 327.6700 FORMAT "%8.4" EXTENDED_LIMITS -327.6800 327.6700
 /begin AXIS_DESCR COM_AXIS PFlt_nAvrgFlt_mp EngN 8 40.00000 6000.000 FORMAT "%8.3" EXTENDED_LIMITS -32768.00 32767.00 AXIS_PTS_REF PFlt_qSetUnBal_AXIS /end AXIS_DESCR
/end CHARACTERISTIC
/begin AXIS_PTS PFlt_qSetUnBal_AXIS "Breakpoints for the group curves which calculate the unbalanced fuel quantity thresholds" 0xEBA08 PFlt_nAvrgFlt_mp GSst_Xs16 5960.000 EngN 8 40.00000 6000.000 FORMAT "%8.3" EXTENDED_LIMITS -32768.00 32767.00 DEPOSIT ABSOLUTE /end AXIS_PTS
/begin CHARACTERISTIC PFlt_rAccPedMinMax_CA "Matrix zur Bestimmung der Bereichsgrenzen für das gefilterte Pedalwertgebersignal" MAP 0xEBA1A Kf_Xs16_Ys16_Ws16 100.0000 Prc 0.00 100.0000 FORMAT "%8.4" EXTENDED_LIMITS -400.0000 399.9878
 /begin AXIS_DESCR STD_AXIS PFlt_RngIdx_X_mp OneToOne 11 0.00 10.00 FORMAT "%5.2" EXTENDED_LIMITS 0.00 255.0 DEPOSIT ABSOLUTE /end AXIS_DESCR
 /begin AXIS_DESCR STD_AXIS PFlt_RngIdx_Y_mp OneToOne 2 0.00 1.000 FORMAT "%5.3" EXTENDED_LIMITS 0.00 255.0 DEPOSIT ABSOLUTE /end AXIS_DESCR
/end CHARACTERISTIC
/begin CHARACTERISTIC PFlt_rDiagAccPedMax_C "obere Grenze Fahrpedalstellung" VALUE 0xEB7C0 Kw_Ws16 100.0000 Prc 0.00 100.0000 FORMAT "%8.4" EXTENDED_LIMITS -400.0000 399.9878 /end CHARACTERISTIC
/begin CHARACTERISTIC PFlt_rDiagTVAMax_C "obere Grenze des durch die Batteriespannung korrigierten Endstufenausgangs" VALUE 0xEB7C2 Kw_Ws16 100.0000 DtyCyc 0.00 100.0000 FORMAT "%8.4" EXTENDED_LIMITS -327.6800 327.6700 /end CHARACTERISTIC
/begin CHARACTERISTIC PFlt_rDiagTVAMin_C "untere Grenze des durch die Batteriespannung korrigierten Endstufenausgangs" VALUE 0xEB7C4 Kw_Ws16 100.0000 DtyCyc 0.00 100.0000 FORMAT "%8.4" EXTENDED_LIMITS -327.6800 327.6700 /end CHARACTERISTIC
/begin CHARACTERISTIC PFlt_stDiagAbortMsk_C "Abbruchsmaske" VALUE 0xEB7C8 Kw_Wu32 4294967295.00 OneToOne 0.00 4294967295.00 FORMAT "%13.2" /end CHARACTERISTIC
/begin CHARACTERISTIC PFlt_stDiagMskRgnAbort_C "Abbruchsmaske für Freigabebedingungen" VALUE 0xEB7CC Kw_Wu32 4294967295.00 OneToOne 0.00 4294967295.00 FORMAT "%13.2" /end CHARACTERISTIC
/begin CHARACTERISTIC PFlt_stDiagMskTst10_C "Abkühltrigger" VALUE 0xEB7D0 Kw_Wu32 4294967295.00 OneToOne 0.00 4294967295.00 FORMAT "%13.2" /end CHARACTERISTIC
/begin CHARACTERISTIC PFlt_stDiagMskTst1_C "Maske zur Ermittlung der Zustandsinformation" VALUE 0xEB7D4 Kw_Wu32 4294967295.00 OneToOne 0.00 4294967295.00 FORMAT "%13.2" /end CHARACTERISTIC
/begin CHARACTERISTIC PFlt_stDiagMskTst2_C "Maske zur Ermittlung der Zustandsinformation" VALUE 0xEB7D8 Kw_Wu32 4294967295.00 OneToOne 0.00 4294967295.00 FORMAT "%13.2" /end CHARACTERISTIC
/begin CHARACTERISTIC PFlt_stDiagMskTst3_C "Maske zur Ermittlung der Zustandsinformation" VALUE 0xEB7DC Kw_Wu32 4294967295.00 OneToOne 0.00 4294967295.00 FORMAT "%13.2" /end CHARACTERISTIC
/begin CHARACTERISTIC PFlt_stDiagMskTst4_C "Maske zur Ermittlung der Zustandsinformation" VALUE 0xEB7E0 Kw_Wu32 4294967295.00 OneToOne 0.00 4294967295.00 FORMAT "%13.2" /end CHARACTERISTIC
/begin CHARACTERISTIC PFlt_stDiagMskTst5_C "Maske zur Ermittlung der Zustandsinformation" VALUE 0xEB7E4 Kw_Wu32 4294967295.00 OneToOne 0.00 4294967295.00 FORMAT "%13.2" /end CHARACTERISTIC
/begin CHARACTERISTIC PFlt_stDiagMskTst6_C "Maske zur Ermittlung der Zustandsinformation" VALUE 0xEB7E8 Kw_Wu32 4294967295.00 OneToOne 0.00 4294967295.00 FORMAT "%13.2" /end CHARACTERISTIC
/begin CHARACTERISTIC PFlt_stDiagMskTst7_C "Maske zur Ermittlung der Zustandsinformation" VALUE 0xEB7EC Kw_Wu32 4294967295.00 OneToOne 0.00 4294967295.00 FORMAT "%13.2" /end CHARACTERISTIC
/begin CHARACTERISTIC PFlt_stDiagMskTst8_C "Maske zur Ermittlung der Zustandsinformation" VALUE 0xEB7F0 Kw_Wu32 4294967295.00 OneToOne 0.00 4294967295.00 FORMAT "%13.2" /end CHARACTERISTIC
/begin CHARACTERISTIC PFlt_stDiagMskTst9_C "Maske zur Ermittlung der Zustandsinformation" VALUE 0xEB7F4 Kw_Wu32 4294967295.00 OneToOne 0.00 4294967295.00 FORMAT "%13.2" /end CHARACTERISTIC
/begin CHARACTERISTIC PFlt_stDiagMsk_C "Maske für Freigabebedingungen" VALUE 0xEB7F8 Kw_Wu32 4294967295.00 OneToOne 0.00 4294967295.00 FORMAT "%13.2" /end CHARACTERISTIC
/begin CHARACTERISTIC PFlt_stDiagOn_C "Applikation konstant Regeneration manuell beginnen" VALUE 0xEB698 Kw_Wu8 255.0 OneToOne 0.00 255.0 FORMAT "%5.1" /end CHARACTERISTIC
/begin CHARACTERISTIC PFlt_stDiagRgnMsk_C "Regenerationsmaske zum Abschalten der Diagnose" VALUE 0xEB7FC Kw_Wu32 4294967295.00 OneToOne 0.00 4294967295.00 FORMAT "%13.2" /end CHARACTERISTIC
/begin CHARACTERISTIC PFlt_stEngPOp_Vector "#SSD Konfigurationslabel für Bypass" VALUE 0xC314C Kw_Wu8 255.0 OneToOne 0.00 255.0 FORMAT "%5.1" /end CHARACTERISTIC
/begin CHARACTERISTIC PFlt_stEngPOp_Channel "#SSD Konfigurationslabel für Bypass" VALUE 0xC314D Kw_Wu8 255.0 OneToOne 0.00 255.0 FORMAT "%5.1" /end CHARACTERISTIC
/begin CHARACTERISTIC PFlt_stGearDebValMax_C "Maximaler Gang für Entprellfunktion" VALUE 0xEBA64 Kw_Ws8 7.000 OneToOne -1.000 6.000 FORMAT "%5.3" EXTENDED_LIMITS -128.0 127.0 /end CHARACTERISTIC
/begin CHARACTERISTIC PFlt_stGearDebValMin_C "Minimaler Gang der Entprellfunktion" VALUE 0xEBA65 Kw_Ws8 7.000 OneToOne -1.000 6.000 FORMAT "%5.3" EXTENDED_LIMITS -128.0 127.0 /end CHARACTERISTIC
/begin CHARACTERISTIC PFlt_stGearMinMax_CA "Matrix zur Bestimmung der Bereichsgrenzen für den eingelegten Gang" MAP 0xEBA66 Kf_Xs16_Ys16_Ws16 7.000000 OneToOne -1.000000 6.000000 FORMAT "%8.6" EXTENDED_LIMITS -32768.00 32767.00
 /begin AXIS_DESCR STD_AXIS PFlt_RngIdx_X_mp OneToOne 11 0.00 10.00 FORMAT "%5.2" EXTENDED_LIMITS 0.00 255.0 DEPOSIT ABSOLUTE /end AXIS_DESCR
 /begin AXIS_DESCR STD_AXIS PFlt_RngIdx_Y_mp OneToOne 2 0.00 1.000 FORMAT "%5.3" EXTENDED_LIMITS 0.00 255.0 DEPOSIT ABSOLUTE /end AXIS_DESCR
/end CHARACTERISTIC
/begin CHARACTERISTIC PFlt_stLckFuelMsk_C "Maske Für EGT_st" VALUE 0xEB69A Kw_Wu16 65535.00 OneToOne 0.00 65535.00 FORMAT "%8.2" /end CHARACTERISTIC
/begin CHARACTERISTIC PFlt_stLckRgnMsk_C "Maske für Blockierung und Freigabe der Regeneration" VALUE 0xEB69C Kw_Wu32 4294967295.00 OneToOne 0.00 4294967295.00 FORMAT "%13.2" /end CHARACTERISTIC
/begin CHARACTERISTIC PFlt_stMinDistRgn_C "" VALUE 0xEB6A0 Kw_Wu16 65535.00 OneToOne 0.00 65535.00 FORMAT "%8.2" /end CHARACTERISTIC
/begin CHARACTERISTIC PFlt_stRgnActvMsk_C "Maske für DPF-Regenerationszeit-relevante Abgasnachbehandlungszustände" VALUE 0xEB6A4 Kw_Wu32 4294967295.00 OneToOne 0.00 4294967295.00 FORMAT "%13.2" /end CHARACTERISTIC
/begin CHARACTERISTIC PFlt_stRgnDiagStg1_C "Aufheizzustand" VALUE 0xEB800 Kw_Wu32 4294967295.00 OneToOne 0.00 4294967295.00 FORMAT "%13.2" /end CHARACTERISTIC
/begin CHARACTERISTIC PFlt_stRgnDiagStg2_C "Regenerationszustand" VALUE 0xEB804 Kw_Wu32 4294967295.00 OneToOne 0.00 4294967295.00 FORMAT "%13.2" /end CHARACTERISTIC
/begin CHARACTERISTIC PFlt_stRgnDiagStg3_C "Abkühlphase" VALUE 0xEB808 Kw_Wu32 4294967295.00 OneToOne 0.00 4294967295.00 FORMAT "%13.2" /end CHARACTERISTIC
/begin CHARACTERISTIC PFlt_stRgnStg1_C "PFlt_st im Fall Regenerationsstate 1" VALUE 0xEB6A8 Kw_Wu32 4294967295.00 OneToOne 0.00 4294967295.00 FORMAT "%13.2" /end CHARACTERISTIC
/begin CHARACTERISTIC PFlt_stRgnStg2_C "PFlt_st im Fall Regenerationsstate 2" VALUE 0xEB6AC Kw_Wu32 4294967295.00 OneToOne 0.00 4294967295.00 FORMAT "%13.2" /end CHARACTERISTIC
/begin CHARACTERISTIC PFlt_stRgnStg3_C "PFlt_st im Fall Regenerationsstate 3" VALUE 0xEB6B0 Kw_Wu32 4294967295.00 OneToOne 0.00 4294967295.00 FORMAT "%13.2" /end CHARACTERISTIC
/begin CHARACTERISTIC PFlt_stRgnStg4_C "PFlt_st im Fall Regenerationsstate 4" VALUE 0xEB6B4 Kw_Wu32 4294967295.00 OneToOne 0.00 4294967295.00 FORMAT "%13.2" /end CHARACTERISTIC
/begin CHARACTERISTIC PFlt_stRgnStg5_C "PFlt_st im Fall Regenerationsstate 5" VALUE 0xEB6B8 Kw_Wu32 4294967295.00 OneToOne 0.00 4294967295.00 FORMAT "%13.2" /end CHARACTERISTIC
/begin CHARACTERISTIC PFlt_stRgnStg6_C "Maßnahmenbitwort Regenerationsstufe 6" VALUE 0xEB6BC Kw_Wu32 4294967295.00 OneToOne 0.00 4294967295.00 FORMAT "%13.2" /end CHARACTERISTIC
/begin CHARACTERISTIC PFlt_stRgnSucMsk_C "" VALUE 0xEB6C0 Kw_Wu16 65535.00 OneToOne 0.00 65535.00 FORMAT "%8.2" /end CHARACTERISTIC
/begin CHARACTERISTIC PFlt_st_Vector "#SSD Konfigurationslabel für Bypass" VALUE 0xC314A Kw_Wu8 255.0 OneToOne 0.00 255.0 FORMAT "%5.1" /end CHARACTERISTIC
/begin CHARACTERISTIC PFlt_st_Channel "#SSD Konfigurationslabels für Bypass" VALUE 0xC314B Kw_Wu8 255.0 OneToOne 0.00 255.0 FORMAT "%5.1" /end CHARACTERISTIC
/begin CHARACTERISTIC PFlt_swtAshCorActive_C "generelle Aktivierung der Ascheabgleich-Funktion (1=Funktion aktiv, 0=Inaktiev)" VALUE 0xEB35A Kw_Wu8 1.000 OneToOne 0.00 1.000 FORMAT "%5.3" EXTENDED_LIMITS 0.00 255.0 /end CHARACTERISTIC
/begin CHARACTERISTIC PFlt_swtAshCorOn_C "Statusschwelle Aschekorrektur (1: Regneration erkannt, Ascheabgleichtimer gestrted; 0: keine Regeneration erkannt)" VALUE 0xEB35B Kw_Wu8 4.000 OneToOne 0.00 4.000 FORMAT "%5.3" EXTENDED_LIMITS 0.00 255.0 /end CHARACTERISTIC
/begin CHARACTERISTIC PFlt_swtASModOn_C "Schalter für Luftmassenstromsignal (0: HFM oder 1: ASMod)" VALUE 0xEBD8F Kw_Wu8 1.000 OneToOne 0.00 1.000 FORMAT "%5.3" EXTENDED_LIMITS 0.00 255.0 /end CHARACTERISTIC
/begin CHARACTERISTIC PFlt_swtBrkRng_CA "Zur Bestimmung der Bereichswerte für das entprellte Bremssignal (0: normales, 1: invertiertes Signal, 2: Signal nicht verwendet)" VAL_BLK 0xEBAB0 Kwb_Wu8 2.000 OneToOne 0.00 2.000 FORMAT "%5.3" EXTENDED_LIMITS 0.00 255.0 NUMBER 11 /end CHARACTERISTIC
/begin CHARACTERISTIC PFlt_swtClthRng_CA "Zur Bestimmung der Bereichswerte für das entprellte Kupplungssignal (0: normales, 1: invertiertes, 2: kein Signal verwendet)" VAL_BLK 0xEBABB Kwb_Wu8 2.000 OneToOne 0.00 2.000 FORMAT "%5.3" EXTENDED_LIMITS 0.00 255.0 NUMBER 11 /end CHARACTERISTIC
/begin CHARACTERISTIC PFlt_swtDiagOn_C "Schalten Regeneration manuell beginnen (1: manuell gestarted, 0: nicht manuell gestarted)" VALUE 0xEB6C2 Kw_Wu8 255.0 OneToOne 0.00 255.0 FORMAT "%5.1" /end CHARACTERISTIC
/begin CHARACTERISTIC PFlt_swtLmbdAprx_C "Mess- oder Simulationssignal für Lambda-Messung (1: Simulation, 0: Messsignal)" VALUE 0xEBD90 Kw_Wu8 1.000 OneToOne 0.00 1.000 FORMAT "%5.3" EXTENDED_LIMITS 0.00 255.0 /end CHARACTERISTIC
/begin CHARACTERISTIC PFlt_swtOfsCor_C "Schalter zur Abschaltung der Offsetkorrektur im Zustandautomat (1: aus, 0: ein)" VALUE 0xEB6C3 Kw_Wu8 1.000 OneToOne 0.00 1.000 FORMAT "%5.3" EXTENDED_LIMITS 0.00 255.0 /end CHARACTERISTIC
/begin CHARACTERISTIC PFlt_swtServiceVal_C "Serviceschalter zum Zurücksetzen nach Partikelfilteraustausch (1: Reset, 0: liest Werte aus EEPROM)" VALUE 0xEB6C4 Kw_Wu8 255.0 OneToOne 0.00 255.0 FORMAT "%5.1" /end CHARACTERISTIC
/begin CHARACTERISTIC Pflt_swtShOffSuc_C "" VALUE 0xEB6C5 Kw_Wu8 255.0 OneToOne 0.00 255.0 FORMAT "%5.1" /end CHARACTERISTIC
/begin CHARACTERISTIC PFlt_swtTmrLckRst_C "Schalter zum Rücksetzen des EEPROM Wertes der Sperrzeit (1: Reset, 0: kein Reset)" VALUE 0xEB6C6 Kw_Wu8 255.0 OneToOne 0.00 255.0 FORMAT "%5.1" /end CHARACTERISTIC
/begin CHARACTERISTIC PFlt_tAirFltAshCorMax_C "maximal zulässiger Wert Lufttemperatur" VALUE 0xEB35C Kw_Ws16 250.0000 Temp_Cels -50.14000 199.8600 FORMAT "%8.4" EXTENDED_LIMITS -3549.940 3003.560 /end CHARACTERISTIC
/begin CHARACTERISTIC PFlt_tAirFltAshCorMin_C "minimal zulässiger Wert Lufttemperatur" VALUE 0xEB35E Kw_Ws16 250.0000 Temp_Cels -50.14000 199.8600 FORMAT "%8.4" EXTENDED_LIMITS -3549.940 3003.560 /end CHARACTERISTIC
/begin CHARACTERISTIC PFlt_tAirMinMax_CA "Matrix zur Bestimmung der Bereichsgrenzen für die Ansauglufttemperatur" MAP 0xEBAC6 Kf_Xs16_Ys16_Ws16 250.0000 Temp_Cels -50.14000 199.8600 FORMAT "%8.4" EXTENDED_LIMITS -3549.940 3003.560
 /begin AXIS_DESCR STD_AXIS PFlt_RngIdx_X_mp OneToOne 11 0.00 10.00 FORMAT "%5.2" EXTENDED_LIMITS 0.00 255.0 DEPOSIT ABSOLUTE /end AXIS_DESCR
 /begin AXIS_DESCR STD_AXIS PFlt_RngIdx_Y_mp OneToOne 2 0.00 1.000 FORMAT "%5.3" EXTENDED_LIMITS 0.00 255.0 DEPOSIT ABSOLUTE /end AXIS_DESCR
/end CHARACTERISTIC
/begin CHARACTERISTIC PFlt_tCIntAshCorMax_C "maximal zulässiger Wert Kühlmitteltemperatur" VALUE 0xEB360 Kw_Ws16 250.0000 Temp_Cels -50.14000 199.8600 FORMAT "%8.4" EXTENDED_LIMITS -3549.940 3003.560 /end CHARACTERISTIC
/begin CHARACTERISTIC PFlt_tCIntAshCorMin_C "minimal zulässiger Wert Kühlmitteltemperatur" VALUE 0xEB362 Kw_Ws16 250.0000 Temp_Cels -50.14000 199.8600 FORMAT "%8.4" EXTENDED_LIMITS -3549.940 3003.560 /end CHARACTERISTIC
/begin CHARACTERISTIC PFlt_tClntMinMax_CA "Matrix zur Bestimmung der Bereichsgrenzen für die gefilterte Temperatur der Kühlflüssigkeit" MAP 0xEBB10 Kf_Xs16_Ys16_Ws16 250.0000 Temp_Cels -50.14000 199.8600 FORMAT "%8.4" EXTENDED_LIMITS -3549.940 3003.560
 /begin AXIS_DESCR STD_AXIS PFlt_RngIdx_X_mp OneToOne 11 0.00 10.00 FORMAT "%5.2" EXTENDED_LIMITS 0.00 255.0 DEPOSIT ABSOLUTE /end AXIS_DESCR
 /begin AXIS_DESCR STD_AXIS PFlt_RngIdx_Y_mp OneToOne 2 0.00 1.000 FORMAT "%5.3" EXTENDED_LIMITS 0.00 255.0 DEPOSIT ABSOLUTE /end AXIS_DESCR
/end CHARACTERISTIC
/begin CHARACTERISTIC PFlt_tDiagDpfAbrtMax_C "Grenze PFltCD_tPre" VALUE 0xEB80C Kw_Ws16 950.0000 Temp_Cels -50.1400 899.8600 FORMAT "%8.4" EXTENDED_LIMITS -3549.940 3003.560 /end CHARACTERISTIC
/begin CHARACTERISTIC PFlt_tDiagDpfCoolDwn_C "Grenze PFltCD_tPre" VALUE 0xEB80E Kw_Ws16 950.0000 Temp_Cels -50.1400 899.8600 FORMAT "%8.4" EXTENDED_LIMITS -3549.940 3003.560 /end CHARACTERISTIC
/begin CHARACTERISTIC PFlt_tDiagDpfHeatup_C "Grenze PFltCD_tPre" VALUE 0xEB810 Kw_Ws16 950.0000 Temp_Cels -50.1400 899.8600 FORMAT "%8.4" EXTENDED_LIMITS -3549.940 3003.560 /end CHARACTERISTIC
/begin CHARACTERISTIC PFlt_tDiagDpfMax_C "Grenze PFltCD_tPre" VALUE 0xEB812 Kw_Ws16 950.0000 Temp_Cels -50.1400 899.8600 FORMAT "%8.4" EXTENDED_LIMITS -3549.940 3003.560 /end CHARACTERISTIC
/begin CHARACTERISTIC PFlt_tDiagDpfPreRgnMin_C "Grenze PFltCD_tPre" VALUE 0xEB814 Kw_Ws16 950.0000 Temp_Cels -50.1400 899.8600 FORMAT "%8.4" EXTENDED_LIMITS -3549.940 3003.560 /end CHARACTERISTIC
/begin CHARACTERISTIC PFlt_tDiagOxiAbrtMax_C "Grenze OxiCCD_tPre" VALUE 0xEB816 Kw_Ws16 950.0000 Temp_Cels -50.1400 899.8600 FORMAT "%8.4" EXTENDED_LIMITS -3549.940 3003.560 /end CHARACTERISTIC
/begin CHARACTERISTIC PFlt_tDiagOxiCoolDwn_C "Grenze OxiCCD_tPre" VALUE 0xEB818 Kw_Ws16 950.0000 Temp_Cels -50.1400 899.8600 FORMAT "%8.4" EXTENDED_LIMITS -3549.940 3003.560 /end CHARACTERISTIC
/begin CHARACTERISTIC PFlt_tDiagOxiHeatup_C "Grenze OxiCCD_tPre" VALUE 0xEB81A Kw_Ws16 950.0000 Temp_Cels -50.1400 899.8600 FORMAT "%8.4" EXTENDED_LIMITS -3549.940 3003.560 /end CHARACTERISTIC
/begin CHARACTERISTIC PFlt_tDiagOxiMax_C "obere Abgastemperaturgrenze vor dem Oxidationskatalysator) - aktueller Wert" VALUE 0xEB81C Kw_Ws16 950.0000 Temp_Cels -50.1400 899.8600 FORMAT "%8.4" EXTENDED_LIMITS -3549.940 3003.560 /end CHARACTERISTIC
/begin CHARACTERISTIC PFlt_tDiagOxiMin_C "untere Abgastemperaturgrenze vor dem Oxidationskatalysator) - aktueller Wert" VALUE 0xEB81E Kw_Ws16 950.0000 Temp_Cels -50.1400 899.8600 FORMAT "%8.4" EXTENDED_LIMITS -3549.940 3003.560 /end CHARACTERISTIC
/begin CHARACTERISTIC PFlt_tDiagOxiPreMax_C "Grenze OxiCCD_tPre" VALUE 0xEB820 Kw_Ws16 950.0000 Temp_Cels -50.1400 899.8600 FORMAT "%8.4" EXTENDED_LIMITS -3549.940 3003.560 /end CHARACTERISTIC
/begin CHARACTERISTIC PFlt_tDiagOxiPreRgnMin_C "Grenze OxiCCD_tPre" VALUE 0xEB822 Kw_Ws16 950.0000 Temp_Cels -50.1400 899.8600 FORMAT "%8.4" EXTENDED_LIMITS -3549.940 3003.560 /end CHARACTERISTIC
/begin CHARACTERISTIC PFlt_tDiagPFltMax_C "obere Grenze des aktuellen Wertes der Partikelfiltervortemperatur" VALUE 0xEB824 Kw_Ws16 950.0000 Temp_Cels -50.1400 899.8600 FORMAT "%8.4" EXTENDED_LIMITS -3549.940 3003.560 /end CHARACTERISTIC
/begin CHARACTERISTIC PFlt_tDiagPFltMin_C "untere Grenze des aktuellen Wertes der Partikelfiltervortemperatur" VALUE 0xEB826 Kw_Ws16 950.0000 Temp_Cels -50.1400 899.8600 FORMAT "%8.4" EXTENDED_LIMITS -3549.940 3003.560 /end CHARACTERISTIC
/begin CHARACTERISTIC PFlt_tEngDiagMinH_C "obere Motortemperaturgrenze" VALUE 0xEB828 Kw_Ws16 950.0000 Temp_Cels -50.1400 899.8600 FORMAT "%8.4" EXTENDED_LIMITS -3549.940 3003.560 /end CHARACTERISTIC
/begin CHARACTERISTIC PFlt_tEngDiagMinL_C "untere Motortemperaturgrenze" VALUE 0xEB82A Kw_Ws16 950.0000 Temp_Cels -50.1400 899.8600 FORMAT "%8.4" EXTENDED_LIMITS -3549.940 3003.560 /end CHARACTERISTIC
/begin CHARACTERISTIC PFlt_tFltDiagMax_C "Grenze der Kraftstoffsystemtemperatur" VALUE 0xEB82C Kw_Ws16 250.0000 Temp_Cels -50.14000 199.8600 FORMAT "%8.4" EXTENDED_LIMITS -3549.940 3003.560 /end CHARACTERISTIC
/begin CHARACTERISTIC PFlt_tiAccPedPT1_C "Filterzeitkonst. für Pedalwertgeber PT1 Filter" VALUE 0xEBB5C Kw_Wu32 4294.9673 TimeDelay_s 0.0000010000000 4294.9673 FORMAT "%9.4" /end CHARACTERISTIC
/begin CHARACTERISTIC PFlt_tiAshCorAirTempPT1_C "Zeitkonstante Lufttemperatur" VALUE 0xEB364 Kw_Wu32 4294.8273 TimeDelay_s 0.14000154 4294.9673 FORMAT "%9.4" EXTENDED_LIMITS 0.0000010000000 4294.9673 /end CHARACTERISTIC
/begin CHARACTERISTIC PFlt_tiAshCorCIntTempPT1_C "Zeitkonstante Kühlmitteltemperatur" VALUE 0xEB368 Kw_Wu32 4294.8273 TimeDelay_s 0.14000154 4294.9673 FORMAT "%9.4" EXTENDED_LIMITS 0.0000010000000 4294.9673 /end CHARACTERISTIC
/begin CHARACTERISTIC PFlt_tiAshCorDVolPT1_C "Zeitkonstante Abgasvolumenstrom vor PFlt" VALUE 0xEB36C Kw_Wu32 4294.8273 TimeDelay_s 0.14000154 4294.9673 FORMAT "%9.4" EXTENDED_LIMITS 0.0000010000000 4294.9673 /end CHARACTERISTIC
/begin CHARACTERISTIC PFlt_tiAshCorEngSpdPT1_C "Zeitkonstante Drehzahl" VALUE 0xEB370 Kw_Wu32 4294.8273 TimeDelay_s 0.14000154 4294.9673 FORMAT "%9.4" EXTENDED_LIMITS 0.0000010000000 4294.9673 /end CHARACTERISTIC
/begin CHARACTERISTIC PFlt_tiAshCorInjMsPT1_C "Zeitkonstante aktuelle Einspritzmasse" VALUE 0xEB374 Kw_Wu32 4294.8273 TimeDelay_s 0.14000154 4294.9673 FORMAT "%9.4" EXTENDED_LIMITS 0.0000010000000 4294.9673 /end CHARACTERISTIC
/begin CHARACTERISTIC PFlt_tiAshCorOxiTempPT1_C "Zeitkonstante OxiKat-Temperatur" VALUE 0xEB378 Kw_Wu32 4294.8273 TimeDelay_s 0.14000154 4294.9673 FORMAT "%9.4" EXTENDED_LIMITS 0.0000010000000 4294.9673 /end CHARACTERISTIC
/begin CHARACTERISTIC PFlt_tiAshCorPreTempPT1_C "Zeitkonstante Vortemperatur Partikelfilter" VALUE 0xEB37C Kw_Wu32 4294.8273 TimeDelay_s 0.14000154 4294.9673 FORMAT "%9.4" EXTENDED_LIMITS 0.0000010000000 4294.9673 /end CHARACTERISTIC
/begin CHARACTERISTIC PFlt_tiAshCorResFlowPT1_C "Zeitkonstante gefilterter Stromwiderstand" VALUE 0xEB380 Kw_Wu32 4294.8273 TimeDelay_s 0.14000154 4294.9673 FORMAT "%9.4" EXTENDED_LIMITS 0.0000010000000 4294.9673 /end CHARACTERISTIC
/begin CHARACTERISTIC PFlt_tiAshCorRlsOn_C "Entprellzeit Simulation EIN" VALUE 0xEB384 Kw_Wu16 655140.0 Time_ms 0.00 655140.0 FORMAT "%8.1" EXTENDED_LIMITS 0.00 655350.0 /end CHARACTERISTIC
/begin CHARACTERISTIC PFlt_tiAshCorVehAccPT1_C "Zeitkonstante Fahrzeugbeschleunigung" VALUE 0xEB388 Kw_Wu32 4294.8273 TimeDelay_s 0.14000154 4294.9673 FORMAT "%9.4" EXTENDED_LIMITS 0.0000010000000 4294.9673 /end CHARACTERISTIC
/begin CHARACTERISTIC PFlt_tiAshCorVehSpdPT1_C "Zeitkonstante Fahrzeuggeschwindigkeit" VALUE 0xEB38C Kw_Wu32 4294.8273 TimeDelay_s 0.14000154 4294.9673 FORMAT "%9.4" EXTENDED_LIMITS 0.0000010000000 4294.9673 /end CHARACTERISTIC
/begin CHARACTERISTIC PFlt_tiAshCorWaitMax_C "Regenerationsdauer" VALUE 0xEB390 Kw_Wu32 655140.000000 Time_s 0.00 655140.000000 FORMAT "%13.6" EXTENDED_LIMITS 0.00 42949672.9500 /end CHARACTERISTIC
/begin CHARACTERISTIC PFlt_tiBattCDPT1_C "Zeitkonstante für Batteriespannung" VALUE 0xEBB60 Kw_Wu32 4294.9673 TimeDelay_s 0.0000010000000 4294.9673 FORMAT "%9.4" /end CHARACTERISTIC
/begin CHARACTERISTIC PFlt_tiDebBrkOff_C "Entprellzeit Bremse aus" VALUE 0xEBB64 Kw_Wu16 3000.000 TimeDeb 0.00 3000.000 FORMAT "%8.3" EXTENDED_LIMITS 0.00 655350.0 /end CHARACTERISTIC
/begin CHARACTERISTIC PFlt_tiDebBrkOn_C "Entprellzeit Bremse an" VALUE 0xEBB66 Kw_Wu16 3000.000 TimeDeb 0.00 3000.000 FORMAT "%8.3" EXTENDED_LIMITS 0.00 655350.0 /end CHARACTERISTIC
/begin CHARACTERISTIC PFlt_tiDebConvOff_C "Entprellzeit Kupplung aus" VALUE 0xEBB68 Kw_Wu16 3000.000 TimeDeb 0.00 3000.000 FORMAT "%8.3" EXTENDED_LIMITS 0.00 655350.0 /end CHARACTERISTIC
/begin CHARACTERISTIC PFlt_tiDebConvOn_C "Entprellzeit Kupplung an" VALUE 0xEBB6A Kw_Wu16 3000.000 TimeDeb 0.00 3000.000 FORMAT "%8.3" EXTENDED_LIMITS 0.00 655350.0 /end CHARACTERISTIC
/begin CHARACTERISTIC PFlt_tiDebGearOff_C "Entprellungszeit für die Freigabe des Gangsignales" VALUE 0xEBB6C Kw_Wu16 3000.000 TimeDeb 0.00 3000.000 FORMAT "%8.3" EXTENDED_LIMITS 0.00 655350.0 /end CHARACTERISTIC
/begin CHARACTERISTIC PFlt_tiDebGearOn_C "Entprellungszeit für Setzen des Gangsignals" VALUE 0xEBB6E Kw_Wu16 3000.000 TimeDeb 0.00 3000.000 FORMAT "%8.3" EXTENDED_LIMITS 0.00 655350.0 /end CHARACTERISTIC
/begin CHARACTERISTIC PFlt_tiDebLck_C "Entprellzeit für Timer der maximalen Regenerationszeit" VALUE 0xEB6C8 Kw_Wu16 120.0000 TimeDeb 0.00 120.0000 FORMAT "%8.4" EXTENDED_LIMITS 0.00 655350.0 /end CHARACTERISTIC
/begin CHARACTERISTIC PFlt_tiDebQLimErrIntr_C "Entprellzeit für Regenerationsunterbrechung wegen Mengenbegrenzung" VALUE 0xEB6CA Kw_Wu16 655350.0 TimeDeb 0.00 655350.0 FORMAT "%8.1" /end CHARACTERISTIC
/begin CHARACTERISTIC PFlt_tiDebTrqOvhtIntr_C "Entprellzeit für Regenerationsunterbrechung wegen Überhitzungsschutz" VALUE 0xEB6CC Kw_Wu16 655350.0 TimeDeb 0.00 655350.0 FORMAT "%8.1" /end CHARACTERISTIC
/begin CHARACTERISTIC PFlt_tiDiagCoolDwnMax_C "Abkühl-Timergrenze" VALUE 0xEB830 Kw_Wu32 655140.000000 Time_s 0.00 655140.000000 FORMAT "%13.6" EXTENDED_LIMITS 0.00 42949672.9500 /end CHARACTERISTIC
/begin CHARACTERISTIC PFlt_tiDiagDpfMax_C "Grenze PFltCD_tPre" VALUE 0xEB834 Kw_Wu32 655140.000000 Time_s 0.00 655140.000000 FORMAT "%13.6" EXTENDED_LIMITS 0.00 42949672.9500 /end CHARACTERISTIC
/begin CHARACTERISTIC PFlt_tiDiagNormal_C "Motordauer normal" VALUE 0xEB838 Kw_Wu32 655140.000000 Time_s 0.00 655140.000000 FORMAT "%13.6" EXTENDED_LIMITS 0.00 42949672.9500 /end CHARACTERISTIC
/begin CHARACTERISTIC PFlt_tiDiagOxiMax_C "Grenze OxiCCD_tPre" VALUE 0xEB83C Kw_Wu32 655140.000000 Time_s 0.00 655140.000000 FORMAT "%13.6" EXTENDED_LIMITS 0.00 42949672.9500 /end CHARACTERISTIC
/begin CHARACTERISTIC PFlt_tiDiagRgnEnd_C "Regenerationsdauer" VALUE 0xEB840 Kw_Wu32 655140.000000 Time_s 0.00 655140.000000 FORMAT "%13.6" EXTENDED_LIMITS 0.00 42949672.9500 /end CHARACTERISTIC
/begin CHARACTERISTIC PFlt_tiDiagRgnHeatup_C "Grenze des Zählers für die Abbruchbedingung" VALUE 0xEB844 Kw_Wu32 655140.000000 Time_s 0.00 655140.000000 FORMAT "%13.6" EXTENDED_LIMITS 0.00 42949672.9500 /end CHARACTERISTIC
/begin CHARACTERISTIC PFlt_tiDiagRgnLidIMin_C "Dauer der Motordrehzahl innerhalb eines bestimmten Bereichs" VALUE 0xEB848 Kw_Wu32 655140.000000 Time_s 0.00 655140.000000 FORMAT "%13.6" EXTENDED_LIMITS 0.00 42949672.9500 /end CHARACTERISTIC
/begin CHARACTERISTIC PFlt_tiEngOnMaxDef_C "maximale Motorbetriebszeit für Regeneration im Fehlerfall" VALUE 0xEB6D0 Kw_Wu32 4294967295.00 TimeEngOn 0.00 4294967295.00 FORMAT "%13.2" /end CHARACTERISTIC
/begin CHARACTERISTIC PFlt_tiEngOnMax_C "maximale Motorbetriebszeit für Regeneration" VALUE 0xEB6D4 Kw_Wu32 4294967295.00 TimeEngOn 0.00 4294967295.00 FORMAT "%13.2" /end CHARACTERISTIC
/begin CHARACTERISTIC PFlt_tiEngPrtPT1_C "Zeitkonstante des PT1-Gliedes für den Motorschutz" VALUE 0xEB6D8 Kw_Wu32 4294.9673 TimeDelay_s 0.0000010000000 4294.9673 FORMAT "%9.4" /end CHARACTERISTIC
/begin CHARACTERISTIC PFlt_tiEngPrt_C "Regenerationsdauer aufgrund von Motorschutz" VALUE 0xEB6DC Kw_Wu32 21474836.4700 Time_s 0.00 21474836.4700 FORMAT "%13.4" EXTENDED_LIMITS 0.00 42949672.9500 /end CHARACTERISTIC
/begin CHARACTERISTIC PFlt_tiEngSpdPT1_C "Filterzeitkonst. für Eng_nAvrg PT1 filter" VALUE 0xEBB70 Kw_Wu32 4294.9673 TimeDelay_s 0.0000010000000 4294.9673 FORMAT "%9.4" /end CHARACTERISTIC
/begin CHARACTERISTIC PFlt_tiGetRgnSt_C "Timergrenze zur Erfassung des Regenerationszustands" VALUE 0xEB84C Kw_Wu32 655140.000000 Time_s 0.00 655140.000000 FORMAT "%13.6" EXTENDED_LIMITS 0.00 42949672.9500 /end CHARACTERISTIC
/begin CHARACTERISTIC PFlt_tiInjMsPT1_C "Filterzeitkonst. für InjCtl_qSet PT1 filter" VALUE 0xEBB74 Kw_Wu32 4294.9673 TimeDelay_s 0.0000010000000 4294.9673 FORMAT "%9.4" /end CHARACTERISTIC
/begin CHARACTERISTIC PFlt_tiLckRgnErr_CA "Sperrzeit  im Fehlerfall nach der maximalen Regenerationdauer erreicht wurden" VAL_BLK 0xEB6E0 Kwb_Wu32 42949672.9500 Time_s 0.00 42949672.9500 FORMAT "%13.4" NUMBER 9 /end CHARACTERISTIC
/begin CHARACTERISTIC PFlt_tiLckRgn_CA "Sperrzeit  nach der maximalen Regenerationdauer erreicht wurden" VAL_BLK 0xEB704 Kwb_Wu32 42949672.9500 Time_s 0.00 42949672.9500 FORMAT "%13.4" NUMBER 9 /end CHARACTERISTIC
/begin CHARACTERISTIC PFlt_tiLckSubs_C "Ersatzwert für Sperrzeit" VALUE 0xEB728 Kw_Wu32 42949672.9500 Time_s 0.00 42949672.9500 FORMAT "%13.4" /end CHARACTERISTIC
/begin CHARACTERISTIC PFlt_tiLstRgn_C "Dauer der Regeneration aufgrund von gefahrener Strecke, Betriebszeit oder Treibstoffverbrauch" VALUE 0xEB72C Kw_Wu32 21474836.4700 Time_s 0.00 21474836.4700 FORMAT "%13.4" EXTENDED_LIMITS 0.00 42949672.9500 /end CHARACTERISTIC
/begin CHARACTERISTIC PFlt_tiOpSubs_C "Ersatzwert für Motorbetriebszeit im Fall Eeprom lese Fehler" VALUE 0xEB730 Kw_Wu32 4294967295.00 TimeEngOn 0.00 4294967295.00 FORMAT "%13.2" /end CHARACTERISTIC
/begin CHARACTERISTIC PFlt_tiPFltErrPer_C "" VALUE 0xEB394 Kw_Wu16 655350.0 TimePFltLimpHome 0.00 655350.0 FORMAT "%8.1" /end CHARACTERISTIC
/begin CHARACTERISTIC PFlt_tiPFltErrRgn_C "" VALUE 0xEB396 Kw_Wu16 655350.0 TimePFltLimpHome 0.00 655350.0 FORMAT "%8.1" /end CHARACTERISTIC
/begin CHARACTERISTIC PFlt_tiRgnMax_CA "Array für Maximalwert Regenerationsdauer" VAL_BLK 0xEB734 Kwb_Wu32 42949672.9500 Time_s 0.00 42949672.9500 FORMAT "%13.4" NUMBER 7 /end CHARACTERISTIC
/begin CHARACTERISTIC PFlt_tiRgnSpo_C "Regenerationszeit zur Detektierung einer spontanen Regeneration" VALUE 0xEB750 Kw_Wu16 655.3500 Time_s 0.00 655.3500 FORMAT "%8.4" /end CHARACTERISTIC
/begin CHARACTERISTIC PFlt_tiSpdVehPT1_C "Filterzeitkonst. für VSSCD_v PT1 filter" VALUE 0xEBB78 Kw_Wu32 4294.9673 TimeDelay_s 0.0000010000000 4294.9673 FORMAT "%9.4" /end CHARACTERISTIC
/begin CHARACTERISTIC PFlt_tiStpRgn_C "Timergrenze zur Beendigung der Regeneration" VALUE 0xEB850 Kw_Wu32 655140.000000 Time_s 0.00 655140.000000 FORMAT "%13.6" EXTENDED_LIMITS 0.00 42949672.9500 /end CHARACTERISTIC
/begin CHARACTERISTIC PFlt_tiTempClntPT1_C "Filterzeitkonst. für CTSCD_tClntPT1 filter" VALUE 0xEBB7C Kw_Wu32 4294.9673 TimeDelay_s 0.0000010000000 4294.9673 FORMAT "%9.4" /end CHARACTERISTIC
/begin CHARACTERISTIC PFlt_tiTempOxiPrePT1_C "Filterzeitkonst. für OxiCCD_tPre  PT1 filter" VALUE 0xEBB80 Kw_Wu32 4294.9673 TimeDelay_s 0.0000010000000 4294.9673 FORMAT "%9.4" /end CHARACTERISTIC
/begin CHARACTERISTIC PFlt_tiTempPrePT1_C "Filterzeitkonst. für PFlt_tPre PT1 filter" VALUE 0xEBB84 Kw_Wu32 4294.9673 TimeDelay_s 0.0000010000000 4294.9673 FORMAT "%9.4" /end CHARACTERISTIC
/begin CHARACTERISTIC PFlt_tOilDiagMinH_C "obere Öltemperaturgrenze" VALUE 0xEB854 Kw_Ws16 950.0000 Temp_Cels -50.1400 899.8600 FORMAT "%8.4" EXTENDED_LIMITS -3549.940 3003.560 /end CHARACTERISTIC
/begin CHARACTERISTIC PFlt_tOilDiagMinL_C "untere Öltemperaturgrenze" VALUE 0xEB856 Kw_Ws16 950.0000 Temp_Cels -50.1400 899.8600 FORMAT "%8.4" EXTENDED_LIMITS -3549.940 3003.560 /end CHARACTERISTIC
/begin CHARACTERISTIC PFlt_tOxiPreFltAshCorMax_C "maximal zulässiger Wert Temperatur vor dem OxiKat" VALUE 0xEB398 Kw_Ws16 950.000 Temp_Cels -50.140 899.860 FORMAT "%8.3" EXTENDED_LIMITS -3549.940 3003.560 /end CHARACTERISTIC
/begin CHARACTERISTIC PFlt_tOxiPreFltAshCorMin_C "minimal zulässiger Wert Temperatur vor dem OxiKat" VALUE 0xEB39A Kw_Ws16 950.000 Temp_Cels -50.140 899.860 FORMAT "%8.3" EXTENDED_LIMITS -3549.940 3003.560 /end CHARACTERISTIC
/begin CHARACTERISTIC PFlt_tOxiPreMaxHi_C "maximal erlaubter Wert für Temperatur vor Oxidationskatalysator (oberer Schwellenwert)" VALUE 0xEB752 Kw_Ws16 950.0000 Temp_Cels -50.1400 899.8600 FORMAT "%8.4" EXTENDED_LIMITS -3549.940 3003.560 /end CHARACTERISTIC
/begin CHARACTERISTIC PFlt_tOxiPreMaxLo_C "maximal erlaubter Wert für Temperatur vor Oxidationskatalysator (unterer Schwellenwert)" VALUE 0xEB754 Kw_Ws16 950.0000 Temp_Cels -50.1400 899.8600 FORMAT "%8.4" EXTENDED_LIMITS -3549.940 3003.560 /end CHARACTERISTIC
/begin CHARACTERISTIC PFlt_tOxiPreOffMinMax_CA "Matrix zur Bestimmung der Bereichsgrenzen für die gefilterte Abgastemperatur vor Oxidationskatalysator bei inaktivem Bereich" MAP 0xEBB88 Kf_Xs16_Ys16_Ws16 950.000 Temp_Cels -50.140 899.860 FORMAT "%8.3" EXTENDED_LIMITS -3549.940 3003.560
 /begin AXIS_DESCR STD_AXIS PFlt_RngIdx_X_mp OneToOne 11 0.00 10.00 FORMAT "%5.2" EXTENDED_LIMITS 0.00 255.0 DEPOSIT ABSOLUTE /end AXIS_DESCR
 /begin AXIS_DESCR STD_AXIS PFlt_RngIdx_Y_mp OneToOne 2 0.00 1.000 FORMAT "%5.3" EXTENDED_LIMITS 0.00 255.0 DEPOSIT ABSOLUTE /end AXIS_DESCR
/end CHARACTERISTIC
/begin CHARACTERISTIC PFlt_tOxiPreOnMinMax_CA "Matrix zur Bestimmung der Bereichsgrenzen für die gefilterte Abgastemperatur vor Oxidationskatalysator bei aktivem Bereich" MAP 0xEBBD2 Kf_Xs16_Ys16_Ws16 950.000 Temp_Cels -50.140 899.860 FORMAT "%8.3" EXTENDED_LIMITS -3549.940 3003.560
 /begin AXIS_DESCR STD_AXIS PFlt_RngIdx_X_mp OneToOne 11 0.00 10.00 FORMAT "%5.2" EXTENDED_LIMITS 0.00 255.0 DEPOSIT ABSOLUTE /end AXIS_DESCR
 /begin AXIS_DESCR STD_AXIS PFlt_RngIdx_Y_mp OneToOne 2 0.00 1.000 FORMAT "%5.3" EXTENDED_LIMITS 0.00 255.0 DEPOSIT ABSOLUTE /end AXIS_DESCR
/end CHARACTERISTIC
/begin CHARACTERISTIC PFlt_tPreFltAshCorMax_C "maximal zulässiger Wert Vortemperatur Partikelfilter" VALUE 0xEB39C Kw_Ws16 950.000 Temp_Cels -50.140 899.860 FORMAT "%8.3" EXTENDED_LIMITS -3549.940 3003.560 /end CHARACTERISTIC
/begin CHARACTERISTIC PFlt_tPreFltAshCorMin_C "minimal zulässiger Wert Vortemperatur Partikelfilter" VALUE 0xEB39E Kw_Ws16 950.000 Temp_Cels -50.140 899.860 FORMAT "%8.3" EXTENDED_LIMITS -3549.940 3003.560 /end CHARACTERISTIC
/begin CHARACTERISTIC PFlt_tPreMaxHi_C "maximal erlaubter Wert für Temperatur vor Partikelfilter (oberer Schwellenwert)" VALUE 0xEB756 Kw_Ws16 950.0000 Temp_Cels -50.1400 899.8600 FORMAT "%8.4" EXTENDED_LIMITS -3549.940 3003.560 /end CHARACTERISTIC
/begin CHARACTERISTIC PFlt_tPreMaxLo_C "maximal erlaubter Wert für Temperatur vor Partikelfilter (unterer Schwellenwert)" VALUE 0xEB758 Kw_Ws16 950.0000 Temp_Cels -50.1400 899.8600 FORMAT "%8.4" EXTENDED_LIMITS -3549.940 3003.560 /end CHARACTERISTIC
/begin CHARACTERISTIC PFlt_tPreOffMinMax_CA "Matrix zur Bestimmung der Bereichsgrenzen für die gefilterte Abgastemperatur vor Partikelfilter bei inaktivem Bereich" MAP 0xEBC1C Kf_Xs16_Ys16_Ws16 950.000 Temp_Cels -50.140 899.860 FORMAT "%8.3" EXTENDED_LIMITS -3549.940 3003.560
 /begin AXIS_DESCR STD_AXIS PFlt_RngIdx_X_mp OneToOne 11 0.00 10.00 FORMAT "%5.2" EXTENDED_LIMITS 0.00 255.0 DEPOSIT ABSOLUTE /end AXIS_DESCR
 /begin AXIS_DESCR STD_AXIS PFlt_RngIdx_Y_mp OneToOne 2 0.00 1.000 FORMAT "%5.3" EXTENDED_LIMITS 0.00 255.0 DEPOSIT ABSOLUTE /end AXIS_DESCR
/end CHARACTERISTIC
/begin CHARACTERISTIC PFlt_tPreOnMinMax_CA "Matrix zur Bestimmung der Bereichsgrenzen für die gefilterte Abgastemperatur vor Partikelfilter bei aktivem Bereich" MAP 0xEBC66 Kf_Xs16_Ys16_Ws16 950.000 Temp_Cels -50.140 899.860 FORMAT "%8.3" EXTENDED_LIMITS -3549.940 3003.560
 /begin AXIS_DESCR STD_AXIS PFlt_RngIdx_X_mp OneToOne 11 0.00 10.00 FORMAT "%5.2" EXTENDED_LIMITS 0.00 255.0 DEPOSIT ABSOLUTE /end AXIS_DESCR
 /begin AXIS_DESCR STD_AXIS PFlt_RngIdx_Y_mp OneToOne 2 0.00 1.000 FORMAT "%5.3" EXTENDED_LIMITS 0.00 255.0 DEPOSIT ABSOLUTE /end AXIS_DESCR
/end CHARACTERISTIC
/begin CHARACTERISTIC PFlt_uBattMinMax_CA "Matrix zur Bestimmung der Bereichsgrenzen für das gefilterte Batteriespannungssignal" MAP 0xEBCB0 Kf_Xs16_Ys16_Ws16 28602.15 Volt_Batt 0.00 28602.15 FORMAT "%8.2" EXTENDED_LIMITS -640625.6 640606.1
 /begin AXIS_DESCR STD_AXIS PFlt_RngIdx_X_mp OneToOne 11 0.00 10.00 FORMAT "%5.2" EXTENDED_LIMITS 0.00 255.0 DEPOSIT ABSOLUTE /end AXIS_DESCR
 /begin AXIS_DESCR STD_AXIS PFlt_RngIdx_Y_mp OneToOne 2 0.00 1.000 FORMAT "%5.3" EXTENDED_LIMITS 0.00 255.0 DEPOSIT ABSOLUTE /end AXIS_DESCR
/end CHARACTERISTIC
/begin CHARACTERISTIC PFlt_uDiagMin_C "Batteriespannungsgrenze" VALUE 0xEB858 Kw_Ws16 28602.15 Volt_Batt 0.00 28602.15 FORMAT "%8.2" EXTENDED_LIMITS -640625.6 640606.1 /end CHARACTERISTIC
/begin CHARACTERISTIC PFlt_volFlConsumSubs_C "Ersatzwert für insgesamt verbrauchten Kraftstoff" VALUE 0xEB75A Kw_Wu16 65.50000 Fl_Vol 0.00 65.50000 FORMAT "%8.5" EXTENDED_LIMITS 0.00 65.53500 /end CHARACTERISTIC
/begin CHARACTERISTIC PFlt_volFuelFilMinHi_C "Obere Hystereseschwelle für Aufhebung der Sperre" VALUE 0xEB75C Kw_Wu16 300.0000 Fl_Half_L 0.00 300.0000 FORMAT "%8.4" EXTENDED_LIMITS 0.00 3276.750 /end CHARACTERISTIC
/begin CHARACTERISTIC PFlt_volFuelFilMinLo_C "Untere Hystereseschwelle für Sperre der Regen." VALUE 0xEB75E Kw_Wu16 300.0000 Fl_Half_L 0.00 300.0000 FORMAT "%8.4" EXTENDED_LIMITS 0.00 3276.750 /end CHARACTERISTIC
/begin CHARACTERISTIC PFlt_vVehFltAshCorMax_C "maximal zulässiger Wert Fahrzeuggeschwindigkeit" VALUE 0xEB3A0 Kw_Ws16 300.0000 Vel 0.00 300.0000 FORMAT "%8.4" EXTENDED_LIMITS -327.6800 327.6700 /end CHARACTERISTIC
/begin CHARACTERISTIC PFlt_vVehFltAshCorMin_C "minimal zulässiger Wert Fahrzeuggeschwindigkeit" VALUE 0xEB3A2 Kw_Ws16 300.0000 Vel 0.00 300.0000 FORMAT "%8.4" EXTENDED_LIMITS -327.6800 327.6700 /end CHARACTERISTIC
/begin CHARACTERISTIC PFlt_vVehMinMax_CA "Matrix zur Bestimmung der Bereichsgrenzen für die gefilterte Fahrgeschwindigkeit" MAP 0xEBCFA Kf_Xs16_Ys16_Ws16 300.0000 Vel 0.00 300.0000 FORMAT "%8.4" EXTENDED_LIMITS -327.6800 327.6700
 /begin AXIS_DESCR STD_AXIS PFlt_RngIdx_X_mp OneToOne 11 0.00 10.00 FORMAT "%5.2" EXTENDED_LIMITS 0.00 255.0 DEPOSIT ABSOLUTE /end AXIS_DESCR
 /begin AXIS_DESCR STD_AXIS PFlt_RngIdx_Y_mp OneToOne 2 0.00 1.000 FORMAT "%5.3" EXTENDED_LIMITS 0.00 255.0 DEPOSIT ABSOLUTE /end AXIS_DESCR
/end CHARACTERISTIC
/begin CHARACTERISTIC PFlt_vVehUnFltMinMax_CA "Matrix (min/max Grenzen)für ungefilterte Fahrgeschwindigkeit" MAP 0xEBD44 Kf_Xs16_Ys16_Ws16 300.0000 Vel 0.00 300.0000 FORMAT "%8.4" EXTENDED_LIMITS -327.6800 327.6700
 /begin AXIS_DESCR STD_AXIS PFlt_RngIdxPrj_X_mp OneToOne 11 0.00 10.00 FORMAT "%5.2" EXTENDED_LIMITS 0.00 255.0 DEPOSIT ABSOLUTE /end AXIS_DESCR
 /begin AXIS_DESCR STD_AXIS PFlt_RngIdxPrj_Y_mp OneToOne 2 0.00 1.000 FORMAT "%5.3" EXTENDED_LIMITS 0.00 255.0 DEPOSIT ABSOLUTE /end AXIS_DESCR
/end CHARACTERISTIC
/begin MEASUREMENT PCR_facAirAmplFlt_mp "Amplitudenhöhe der oszillierenden Frischluftmasse beim Laderpumpen" SWORD FactM 1 100 -2048.000 2047.938 FORMAT "%8.3" ECU_ADDRESS 0x8FFB70 /end MEASUREMENT
/begin MEASUREMENT PCR_facAirPerTimeAmplFlt "Amplitudenhöhe der oszillierenden Frischluftmasse beim La-derpumpen tiefpassgefiltert" SWORD FactM 1 100 -2048.000 2047.938 FORMAT "%8.3" ECU_ADDRESS 0x7F8FF0 /end MEASUREMENT
/begin MEASUREMENT PCR_facAirPerTimeAmplFlt_mp "Amplitudenhöhe der oszillierenden Frischluftmasse beim Laderpumpen nach DFT tiefpassgefilter (PT1)" SWORD FactM 1 100 -2048.000 2047.938 FORMAT "%8.3" ECU_ADDRESS 0x8FFB72 /end MEASUREMENT
/begin MEASUREMENT PCR_facAirPerTimeAmpl_mp "Amplitudenhöhe der oszillierenden Frischluftmasse beim Laderpumpen nach DFT" SWORD FactM 1 100 -2048.000 2047.938 FORMAT "%8.3" ECU_ADDRESS 0x8FFB74 /end MEASUREMENT
/begin MEASUREMENT PCR_facAirPTAmpl1_mp "Amplitudenhöhe der oszillierenden Frischluftmasse beim Laderpumpen (nach PT1-Ctl1)" SWORD FactM 1 100 -2048.000 2047.938 FORMAT "%8.3" ECU_ADDRESS 0x8FFB76 /end MEASUREMENT
/begin MEASUREMENT PCR_facAirPTAmpl2Flt_mp "Amplitudenhöhe der oszillierenden Frischluftmasse beim Laderpumpen (nach PT1-Ctl2)" SWORD FactM 1 100 -2048.000 2047.938 FORMAT "%8.3" ECU_ADDRESS 0x8FFB78 /end MEASUREMENT
/begin MEASUREMENT PCR_facAirPTAmpl2_mp "Amplitudenhöhe der oszillierenden Frischluftmasse beim Laderpumpen (früher PT1-Ctl2)" SWORD FactM 1 100 -2048.000 2047.938 FORMAT "%8.3" ECU_ADDRESS 0x8FFB7A /end MEASUREMENT
/begin MEASUREMENT PCR_facCosCoeffDFT_mp "Kosinuskoeffizient der Fouriertransformation" SLONG FactM 1 100 -134217728.000 134217727.938 FORMAT "%13.3" ECU_ADDRESS 0x8FFB7C /end MEASUREMENT
/begin MEASUREMENT PCR_facSGDevI_mp "I Regelabweichung AntiSurge-Regler" SWORD FactM 1 100 -2048.000 2047.938 FORMAT "%8.3" ECU_ADDRESS 0x8FFB54 /end MEASUREMENT
/begin MEASUREMENT PCR_facSinCoeffDFT_mp "Sinuskoeffizient der Fouriertransformation" SLONG FactM 1 100 -134217728.000 134217727.938 FORMAT "%13.3" ECU_ADDRESS 0x8FFB80 /end MEASUREMENT
/begin MEASUREMENT PCR_facSinIn_mp "Kennlinieeingangsgröße für den Ersatz der Sinusfunktion durch die Kennlinie" SWORD Fact1 1 100 -256.0000 255.9922 FORMAT "%8.4" ECU_ADDRESS 0x8FFB84 /end MEASUREMENT
/begin MEASUREMENT PCR_facSinOut_mp "Kennlinieausgangsgröße für den Ersatz der Sinusfunktion durch Kennlinie" SWORD Fact 1 100 -4.000000 3.999878 FORMAT "%8.6" ECU_ADDRESS 0x8FFB86 /end MEASUREMENT
/begin MEASUREMENT PCR_facSqrIn_mp "Kennlinieeingangsgröße für den Ersatz der Quadratwurzelfunktion durch die Kennlinie" SWORD FactM 1 100 -2048.000 2047.938 FORMAT "%8.3" ECU_ADDRESS 0x8FFB88 /end MEASUREMENT
/begin MEASUREMENT PCR_facSurgeDes_mp "Sollwert Luftmassenschwingung(AntiSurge-Regler)" SWORD FactM 1 100 -2048.000 2047.938 FORMAT "%8.3" ECU_ADDRESS 0x8FFB56 /end MEASUREMENT
/begin MEASUREMENT PCR_facSurgeGvnrDev_mp "Regelabweichung AntiSurge-Regler" SWORD FactM 1 100 -2048.000 2047.938 FORMAT "%8.3" ECU_ADDRESS 0x8FFB58 /end MEASUREMENT
/begin MEASUREMENT PCR_facSurgeI_mp "Adaptionsfaktor für I-Reglerverstärkung" SWORD Fact1 1 100 -256.0000 255.9922 FORMAT "%8.4" ECU_ADDRESS 0x8FFB5A /end MEASUREMENT
/begin MEASUREMENT PCR_facSurgeP_mp "Adaptionsfaktor für P-Reglerverstärkung" SWORD Fact1 1 100 -256.0000 255.9922 FORMAT "%8.4" ECU_ADDRESS 0x8FFB5C /end MEASUREMENT
/begin MEASUREMENT PCR_pBGDevMaxRaw_mp "messpunkt für Erkennung einer bleibenden Regelabweichung" SWORD Pres_hPa 1 100 -32768.00 32767.00 FORMAT "%8.2" ECU_ADDRESS 0x8FFB44 /end MEASUREMENT
/begin MEASUREMENT PCR_pBGDevMax_mp "Maximale Reglerabweichung" SWORD Pres_hPa 1 100 -32768.00 32767.00 FORMAT "%8.2" ECU_ADDRESS 0x8FFB46 /end MEASUREMENT
/begin MEASUREMENT PCR_pBGDevMinRaw_mp "messpunkt für Erkennung einer bleibenden Regelabweichung" SWORD Pres_hPa 1 100 -32768.00 32767.00 FORMAT "%8.2" ECU_ADDRESS 0x8FFB48 /end MEASUREMENT
/begin MEASUREMENT PCR_pBGDevMin_mp "negative deviation threshold with offset" SWORD Pres_hPa 1 100 -32768.00 32767.00 FORMAT "%8.2" ECU_ADDRESS 0x8FFB4A /end MEASUREMENT
/begin MEASUREMENT PCR_pBSurgeDes "Sollwert Ladedruck zur Reduktion Laderpumpen" SWORD Pres_hPa 1 100 -32768.00 32767.00 FORMAT "%8.2" ECU_ADDRESS 0x7F8FF8 /end MEASUREMENT
/begin MEASUREMENT PCR_pBSurgeDesMax_mp "maximal zulässige Reglerstellgröße AntiSurge-Regler" SWORD Pres_hPa 1 100 -32768.00 32767.00 FORMAT "%8.2" ECU_ADDRESS 0x8FFB5E /end MEASUREMENT
/begin MEASUREMENT PCR_pBSurgeDesMin_mp "minimal zulässige Reglerstellgröße AntiSurge-Regler" SWORD Pres_hPa 1 100 -32768.00 32767.00 FORMAT "%8.2" ECU_ADDRESS 0x8FFB60 /end MEASUREMENT
/begin MEASUREMENT PCR_pBSurgeDesRaw_mp "" SWORD Pres_hPa 1 100 -32768.00 32767.00 FORMAT "%8.2" ECU_ADDRESS 0x8FFB62 /end MEASUREMENT
/begin MEASUREMENT PCR_pBSurgePICtlLim_mp "PI-Anteil des PI-Regler" SWORD Pres_hPa 1 100 -32768.00 32767.00 FORMAT "%8.2" ECU_ADDRESS 0x8FFB64 /end MEASUREMENT
/begin MEASUREMENT PCR_pBSurgePICtl_mp "PI-Anteil des PI-Regler" SWORD Pres_hPa 1 100 -32768.00 32767.00 FORMAT "%8.2" ECU_ADDRESS 0x8FFB66 /end MEASUREMENT
/begin MEASUREMENT PCR_pLPDvtMaxRaw_mp "Max. Schwelle für Regelabweichung Niederdruckstufe (vor Offset)" SWORD Pres_hPa 1 100 -32768.00 32767.00 FORMAT "%8.2" ECU_ADDRESS 0x8FFB34 /end MEASUREMENT
/begin MEASUREMENT PCR_pLPDvtMax_mp "Maximale Schwelle für Regelabweichung Niederdruckstufe" SWORD Pres_hPa 1 100 -32768.00 32767.00 FORMAT "%8.2" ECU_ADDRESS 0x8FFB36 /end MEASUREMENT
/begin MEASUREMENT PCR_pLPDvtMinRaw_mp " Min. Schwelle für Regelabweichung Niederdruckstufe(vor Offset)" SWORD Pres_hPa 1 100 -32768.00 32767.00 FORMAT "%8.2" ECU_ADDRESS 0x8FFB38 /end MEASUREMENT
/begin MEASUREMENT PCR_pLPDvtMin_mp "Minimale Schwelle für Regelabweichung Niederdruckstufe" SWORD Pres_hPa 1 100 -32768.00 32767.00 FORMAT "%8.2" ECU_ADDRESS 0x8FFB3A /end MEASUREMENT
/begin MEASUREMENT PCR_pSOutI_mp "I-Anteil des PI-Regler" SWORD Pres_hPa 1 100 -32768.00 32767.00 FORMAT "%8.2" ECU_ADDRESS 0x8FFB68 /end MEASUREMENT
/begin MEASUREMENT PCR_pSOutP_mp "P-Anteil des PI-Regler" SWORD Pres_hPa 1 100 -32768.00 32767.00 FORMAT "%8.2" ECU_ADDRESS 0x8FFB6A /end MEASUREMENT
/begin MEASUREMENT PCR_pSurgestI_mp "I-Anteil des PI-Regler" SWORD Pres_hPa 1 100 -32768.00 32767.00 FORMAT "%8.2" ECU_ADDRESS 0x8FFB6C /end MEASUREMENT
/begin MEASUREMENT PCR_qLPGvnrOff_mp "Einspritzmenge für Reglerabschaltschwelle(Niederdruckstufe)" SWORD InjMass 1 100 -327.6800 327.6700 FORMAT "%8.4" ECU_ADDRESS 0x8FFB3C /end MEASUREMENT
/begin MEASUREMENT PCR_qLPGvnrOn_mp "Einspritzmenge für Reglereinschaltschwelle(Niederdruckstufe)" SWORD InjMass 1 100 -327.6800 327.6700 FORMAT "%8.4" ECU_ADDRESS 0x8FFB3E /end MEASUREMENT
/begin MEASUREMENT PCR_rBPA "Stellgröße für den Ladedrucksteller" SWORD Prc 1 100 -400.0000 399.9878 FORMAT "%8.4" ECU_ADDRESS 0x7F9000 /end MEASUREMENT
/begin MEASUREMENT PCR_rBPA2 "Ratio2 of valve lift for boost pressure actuator" SWORD Prc 1 100 -400.0000 399.9878 FORMAT "%8.4" ECU_ADDRESS 0x7F9002 /end MEASUREMENT
/begin MEASUREMENT PCR_rBPACDByp_mp "Bypass-Label, Kopie von PCR_rBPACD" SWORD Prc 1 100 -400.0000 399.9878 FORMAT "%8.4" ECU_ADDRESS 0x8FFB4C /end MEASUREMENT
/begin MEASUREMENT PCR_rBPALP "TV Rohwert an Niederdruckstufensteller" SWORD Prc 1 100 -400.0000 399.9878 FORMAT "%8.4" ECU_ADDRESS 0x7F9004 /end MEASUREMENT
/begin MEASUREMENT PCR_rBPALP2 "Stellgröße für den 2. Ladedrucksteller" SWORD Prc 1 100 -400.0000 399.9878 FORMAT "%8.4" ECU_ADDRESS 0x7F9006 /end MEASUREMENT
/begin MEASUREMENT PCR_rGvnrSurge "for Anti-Surge LIGov Boost Pressure" SWORD Prc 1 100 -400.0000 399.9878 FORMAT "%8.4" ECU_ADDRESS 0x7F901A /end MEASUREMENT
/begin MEASUREMENT PCR_rGvnrSurgeRaw_mp "" SWORD Prc 1 100 -400.0000 399.9878 FORMAT "%8.4" ECU_ADDRESS 0x6F824E /end MEASUREMENT
/begin MEASUREMENT PCR_rSurgeGvnrHysOff_mp "" SWORD Prc 1 100 -400.0000 399.9878 FORMAT "%8.4" ECU_ADDRESS 0x6F8250 /end MEASUREMENT
/begin MEASUREMENT PCR_rSurgeGvnrOff_mp "" SWORD Prc 1 100 -400.0000 399.9878 FORMAT "%8.4" ECU_ADDRESS 0x6F8252 /end MEASUREMENT
/begin MEASUREMENT PCR_rSurgeGvnrOn_mp "" SWORD Prc 1 100 -400.0000 399.9878 FORMAT "%8.4" ECU_ADDRESS 0x6F8254 /end MEASUREMENT
/begin MEASUREMENT PCR_stClutch_mp "" UBYTE OneToOne 1 100 0.00 255.0 FORMAT "%5.1" ECU_ADDRESS 0x8FFB4E /end MEASUREMENT
/begin MEASUREMENT PCR_stCpBVlv_mp "Status des Vorgabewertes bei offener Verdichterbypassklappe" UBYTE OneToOne 1 100 0.00 255.0 FORMAT "%5.1" ECU_ADDRESS 0x8FFB4F /end MEASUREMENT
/begin MEASUREMENT PCR_stLPClutch_mp "Geschwindigkeitsschwelle für Kupplungssignal überwachung" UBYTE OneToOne 1 100 0.00 255.0 FORMAT "%5.1" ECU_ADDRESS 0x8FFB40 /end MEASUREMENT
/begin MEASUREMENT PCR_stLPMonitor "Schalter: Regler Niederdruckstufe (PCR_LP) ein/aus" UBYTE OneToOne 1 100 0.00 255.0 FORMAT "%5.1" ECU_ADDRESS 0x7F8986 /end MEASUREMENT
/begin MEASUREMENT PCR_stLPPCR "Status der Ladedruckregelung Niederdruckstufe" UWORD OneToOne 1 100 0.00 65535.00 FORMAT "%8.2" ECU_ADDRESS 0x7F901E /end MEASUREMENT
/begin MEASUREMENT PCR_stLPRgn_mp "Statuswert für die Bestimmung der Quantität am Regler Ein-Aus" UBYTE OneToOne 1 100 0.00 255.0 FORMAT "%5.1" ECU_ADDRESS 0x8FFB41 /end MEASUREMENT
/begin MEASUREMENT PCR_stLPWorkSph "aktueller Arbeitsbereich" UBYTE OneToOne 1 100 0.00 255.0 FORMAT "%5.1" ECU_ADDRESS 0x7F8987 /end MEASUREMENT
/begin MEASUREMENT PCR_stMonitor "Statusangabe bei Abschaltung der Regelung" UBYTE OneToOne 1 100 0.00 255.0 FORMAT "%5.1" ECU_ADDRESS 0x7F8988 /end MEASUREMENT
/begin MEASUREMENT PCR_stPCR "Status der Ladedruckregelung" UWORD OneToOne 1 100 0.00 65535.00 FORMAT "%8.2" ECU_ADDRESS 0x7F9020 /end MEASUREMENT
/begin MEASUREMENT PCR_stPCR_mp "Status der Ladedruckregelung" UWORD OneToOne 1 100 0.00 65535.00 FORMAT "%8.2" ECU_ADDRESS 0x8FFB50 /end MEASUREMENT
/begin MEASUREMENT PCR_stPreSurge "Status der Erkennung für Laderpumpen Zustand 1 (oszillierende Frischluftmasse mit kleiner Amplitude)" UBYTE OneToOne 1 100 0.00 255.0 FORMAT "%5.1" ECU_ADDRESS 0x7F8989 /end MEASUREMENT
/begin MEASUREMENT PCR_stSurge "Status der Erkennung für Laderpumpen Zustand 2 (oszillierende Frischluftmasse mit großer Amplitude)" UBYTE OneToOne 1 100 0.00 255.0 FORMAT "%5.1" ECU_ADDRESS 0x7F898A /end MEASUREMENT
/begin MEASUREMENT PCR_stWorkSph "present working sphere" UBYTE OneToOne 1 100 0.00 255.0 FORMAT "%5.1" ECU_ADDRESS 0x7F898D /end MEASUREMENT
/begin MEASUREMENT PCR_swtGvnr "Schalter: Regler ein/aus" UBYTE OneToOne 1 100 0.00 255.0 FORMAT "%5.1" ECU_ADDRESS 0x7F898E /end MEASUREMENT
/begin MEASUREMENT PCR_swtLPGvnr "Schalter: Regler Niederdruckstufe (PCR_LP) ein/aus" UBYTE OneToOne 1 100 0.00 255.0 FORMAT "%5.1" ECU_ADDRESS 0x7F898F /end MEASUREMENT
/begin MEASUREMENT PCR_swtLPGvnrV1_mp "" UBYTE OneToOne 1 100 0.00 255.0 FORMAT "%5.1" ECU_ADDRESS 0x8FFB42 /end MEASUREMENT
/begin MEASUREMENT PCR_swtSurgeGvnr "Zustand einzelnen Statis für AntiSurge-Regler" UBYTE OneToOne 1 100 0.00 255.0 FORMAT "%5.1" ECU_ADDRESS 0x7F8994 /end MEASUREMENT
/begin MEASUREMENT PCR_swtSurgeGvnrRel_mp "" UBYTE OneToOne 1 100 0.00 255.0 FORMAT "%5.1" ECU_ADDRESS 0x8FFB6E /end MEASUREMENT
/begin MEASUREMENT PCR_swtSurgeGvnrSel_mp "Zustand einzelnen Statis für AntiSurge-Regler" UBYTE OneToOne 1 100 0.00 255.0 FORMAT "%5.1" ECU_ADDRESS 0x8FFB6F /end MEASUREMENT
/begin MEASUREMENT PCR_tiStrtDelay_mp "Zeit, in der die Regelung nach Startabwurf abgeschaltet bleibt" UWORD Time_ms 1 100 0.00 655350.0 FORMAT "%8.1" ECU_ADDRESS 0x8FFB52 /end MEASUREMENT
/begin MEASUREMENT PCVCD_dcycDT1_mp "Sollwert Tastverhältnis mit DT1-Anteil" SWORD DtyCyc 1 100 -327.6800 327.6700 FORMAT "%8.4" ECU_ADDRESS 0x8FFB90 /end MEASUREMENT
/begin MEASUREMENT PCVCD_dcycOut_mp "Ausgangstastverhältnis" SWORD DtyCyc 1 100 -327.6800 327.6700 FORMAT "%8.4" ECU_ADDRESS 0x6F8256 /end MEASUREMENT
/begin MEASUREMENT PCVCD_dcycSetVal_mp "Sollwert Tastverhältnis für Druckregelventil" SWORD DtyCyc 1 100 -327.6800 327.6700 FORMAT "%8.4" ECU_ADDRESS 0x8FFB92 /end MEASUREMENT
/begin MEASUREMENT PCVCD_facIGov_mp "Stromregler I-Anteil" SWORD Fact 1 100 -4.000000 3.999878 FORMAT "%8.6" ECU_ADDRESS 0x8FFB94 /end MEASUREMENT
/begin MEASUREMENT PCVCD_iActFlt_mp "PT1 gefilterter Strom Istwert" SWORD Curr 1 100 -32768.00 32767.00 FORMAT "%8.2" ECU_ADDRESS 0x8FFB96 /end MEASUREMENT
/begin MEASUREMENT PCVCD_iActVal "Analogeingang Strom-Istwert" SWORD Curr 1 100 -32768.00 32767.00 FORMAT "%8.2" ECU_ADDRESS 0x7F9022 /end MEASUREMENT
/begin MEASUREMENT PCVCD_iDvt_mp "Stromregler Regelabweichung" SWORD Curr 1 100 -32768.00 32767.00 FORMAT "%8.2" ECU_ADDRESS 0x8FFB98 /end MEASUREMENT
/begin MEASUREMENT PCVCD_iGovActVal_mp "Isttrom nach Eingriff des Raildruckreglers" SWORD Curr 1 100 -32768.00 32767.00 FORMAT "%8.2" ECU_ADDRESS 0x8FFB9A /end MEASUREMENT
/begin MEASUREMENT PCVCD_iSetFlt_mp "PT1 gefilterter Stromistwert" SWORD Curr 1 100 -32768.00 32767.00 FORMAT "%8.2" ECU_ADDRESS 0x8FFB9C /end MEASUREMENT
/begin MEASUREMENT PCVCD_swtCtlState "geschlossener Regelkreis für Stromregler konstant oder in Abhängigkeit vom Raildruckregler" UBYTE OneToOne 1 100 0.00 255.0 FORMAT "%5.1" ECU_ADDRESS 0x7F8995 /end MEASUREMENT
/begin MEASUREMENT PCVCD_uRawVal_mp "Analogeingang Spannungsrohwert" SWORD Volt 1 100 -160156.4 160151.5 FORMAT "%8.1" ECU_ADDRESS 0x8FFB9E /end MEASUREMENT
/begin MEASUREMENT PCV_dvolLeak_mp "Leckage des Druckregelventils" SWORD Qp_mm3_sec 1 100 -327680.0 327670.0 FORMAT "%8.1" ECU_ADDRESS 0x8FFB8A /end MEASUREMENT
/begin MEASUREMENT PCV_iSet_mp "Sollstrom fuer das Druckregelventil" SWORD Curr 1 100 -32768.00 32767.00 FORMAT "%8.2" ECU_ADDRESS 0x8FFB8C /end MEASUREMENT
/begin MEASUREMENT PCV_stActrCtl_mp "Zustand der Stellwertsteuerung fuer das Druckregelventil" UBYTE OneToOne 1 100 0.00 255.0 FORMAT "%5.1" ECU_ADDRESS 0x8FFB8E /end MEASUREMENT
/begin MEASUREMENT PFltCD_pLinPre "linearisierter Analogwert, Absolutdrucksensor vor dem Partikelfilter" SWORD Pres 1 100 -32768.00 32767.00 FORMAT "%9.2" ECU_ADDRESS 0x7F9026 /end MEASUREMENT
/begin MEASUREMENT PFltCD_pPre "Abgastemp. vor Partikelfilter" SWORD Pres 1 100 -32768.00 32767.00 FORMAT "%9.2" ECU_ADDRESS 0x7F9028 /end MEASUREMENT
/begin MEASUREMENT PFltCD_tLinPre "Linearisierter Wert der Abgastemperatur vor dem Partikelfilter" SWORD Temp_Cels 1 100 -50.140 899.860 FORMAT "%8.3" ECU_ADDRESS 0x7F902A /end MEASUREMENT
/begin MEASUREMENT PFltCD_tPre "Abgastemp. vor Partikelfilter erster Sensor" SWORD Temp_Cels 1 100 -50.140 899.860 FORMAT "%8.3" ECU_ADDRESS 0x7F902C /end MEASUREMENT
/begin MEASUREMENT PFltCD_uRawPresPre_mp "Spannungsrohwert vom Absolutdrucksensor vor dem Partikelfilter" SWORD Volt 1 100 -160156.4 160151.5 FORMAT "%8.1" ECU_ADDRESS 0x6F8292 /end MEASUREMENT
/begin MEASUREMENT PFltCD_uRawTempPre "Spannungsrohwert der Abgastemperatur vor dem Partikelfilter" SWORD Volt 1 100 -160156.4 160151.5 FORMAT "%8.1" ECU_ADDRESS 0x7F9030 /end MEASUREMENT
/begin MEASUREMENT PFlt_aVehFltAshCor_mp "gefilterter Wert Fahrzeugbeschleunigung" SWORD Acc 1 100 -32.76800 32.76700 FORMAT "%8.5" ECU_ADDRESS 0x8FFBA0 /end MEASUREMENT
/begin MEASUREMENT PFlt_ctNumAshCorMax_mp "aktueller Zählerwert des Maximumzählers für AshCor Regeneration" UWORD OneToOne 1 100 0.00 65535.00 FORMAT "%8.2" ECU_ADDRESS 0x6F8258 /end MEASUREMENT
/begin MEASUREMENT PFlt_ctNumAshCor_mp "aktueller Zählerwert für erfolgreiche Regeneration" UWORD OneToOne 1 100 0.00 65535.00 FORMAT "%8.2" ECU_ADDRESS 0x6F825A /end MEASUREMENT
/begin MEASUREMENT PFlt_dmEG "Abgasmassenstrom" SWORD AirMassPerTime 1 100 -3276.800 3276.700 FORMAT "%8.3" ECU_ADDRESS 0x7F9032 /end MEASUREMENT
/begin MEASUREMENT PFlt_dmO2Aprx "geschätzter Sauerstoffmassenstrom vor dem Partikelfilter" SWORD AirMassPerTime 1 100 -3276.800 3276.700 FORMAT "%8.3" ECU_ADDRESS 0x7F9034 /end MEASUREMENT
/begin MEASUREMENT PFlt_dqFlTotAct_mp "" SWORD Fl_2 1 100 -327680.0 327670.0 FORMAT "%8.1" ECU_ADDRESS 0x8FFBA2 /end MEASUREMENT
/begin MEASUREMENT PFlt_dqFlTotEnd_mp "" SWORD Fl_2 1 100 -327680.0 327670.0 FORMAT "%8.1" ECU_ADDRESS 0x8FFBA4 /end MEASUREMENT
/begin MEASUREMENT PFlt_dvol "berechneter Abgasvolumenstrom im Partikelfilter" SWORD CubMtrPerHr 1 100 -3276.800 3276.700 FORMAT "%8.3" ECU_ADDRESS 0x7F9036 /end MEASUREMENT
/begin MEASUREMENT PFlt_dVolFltAshCorRaw_mp "dVol-Rohwert" SWORD CubMtrPerHr 1 100 -3276.800 3276.700 FORMAT "%8.3" ECU_ADDRESS 0x8FFBA6 /end MEASUREMENT
/begin MEASUREMENT PFlt_dVolFltAshCor_mp "PT1-gefilterter Wert für PFlt_dvol" SWORD CubMtrPerHr 1 100 -3276.800 3276.700 FORMAT "%8.3" ECU_ADDRESS 0x8FFBA8 /end MEASUREMENT
/begin MEASUREMENT PFlt_facAshCorDiff_mp "" SWORD Fact 1 100 -4.000000 3.999878 FORMAT "%8.6" ECU_ADDRESS 0x8FFBAA /end MEASUREMENT
/begin MEASUREMENT PFlt_lAshCorAct_mp "Zwischenwert Kilometerstand" UWORD LengthKm 1 100 0.00 65535.00 FORMAT "%8.2" ECU_ADDRESS 0x8FFBAC /end MEASUREMENT
/begin MEASUREMENT PFlt_lAshCorNext "Kilometer für die nächste(folgende) Abgleichung" ULONG LengthKm 1 100 0.00 4294967295.00 FORMAT "%13.2" ECU_ADDRESS 0x7F9268 /end MEASUREMENT
/begin MEASUREMENT PFlt_lAshCorNextEEProm_mp "nächster Kilometerstand für Ascheabgelichregeneration, gelesen vom EEPROM bei Motorstart" ULONG LengthKm 1 100 0.00 4294967295.00 FORMAT "%13.2" ECU_ADDRESS 0x8FFBB0 /end MEASUREMENT
/begin MEASUREMENT PFlt_lAshCorNextMax_mp "Messender Punkt für folgende maximale Aschenkorrektur" ULONG LengthKm 1 100 0.00 4294967295.00 FORMAT "%13.2" ECU_ADDRESS 0x8FFBB4 /end MEASUREMENT
/begin MEASUREMENT PFlt_lAshCorNextOilCor_mp "Messender Punkt für folgendes maximales Aschen ölen Korrektur." ULONG LengthKm 1 100 0.00 4294967295.00 FORMAT "%13.2" ECU_ADDRESS 0x8FFBB8 /end MEASUREMENT
/begin MEASUREMENT PFlt_lAshCorOldCalc_mp "Messender Punkt für alten Aschenkorrekturwert." ULONG LengthKm 1 100 0.00 4294967295.00 FORMAT "%13.2" ECU_ADDRESS 0x8FFBBC /end MEASUREMENT
/begin MEASUREMENT PFlt_lAshCorStep_mp "Schrittgröße für Aschenkorrektur." UWORD LengthKm 1 100 0.00 65535.00 FORMAT "%8.2" ECU_ADDRESS 0x8FFBC0 /end MEASUREMENT
/begin MEASUREMENT PFlt_lSnceRgn "driven distance after regeneration" ULONG Length 1 100 0.00 4294967295.00 FORMAT "%13.2" ECU_ADDRESS 0x7F926C /end MEASUREMENT
/begin MEASUREMENT PFlt_lSnceRgnu16_mp "Driven distance since last successful regeneration with reduced resolution" UWORD lSnceRgnRes 1 100 0.00 8388480. FORMAT "%8.0" ECU_ADDRESS 0x6F8260 /end MEASUREMENT
/begin MEASUREMENT PFlt_lSnceRgn_mp "gefahrene Strecke seit letzter erfolgreicher Regeneration" ULONG Length 1 100 0.00 4294967295.00 FORMAT "%13.2" ECU_ADDRESS 0x8FFBE4 /end MEASUREMENT
/begin MEASUREMENT PFlt_lSumu16_mp "Total driven distance with reduced resolution" UWORD lSumRes 1 100 0.00 1073725440. ECU_ADDRESS 0x6F8262 /end MEASUREMENT
/begin MEASUREMENT PFlt_lSum_mp "ges. gefahrene Strecke bei der letzten erfolgr. Regeneration" ULONG Length 1 100 0.00 4294967295.00 FORMAT "%13.2" ECU_ADDRESS 0x6F8264 /end MEASUREMENT
/begin MEASUREMENT PFlt_mAshCorAct "tatsächliche Aschenmenge" SWORD mSoot_g 1 100 -327.6800 327.6700 FORMAT "%8.4" ECU_ADDRESS 0x7F9038 /end MEASUREMENT
/begin MEASUREMENT PFlt_mAshCorActRel_mp "aktuell relative Abweichung der neu berechneten Aschemenge" SWORD mSoot_g 1 100 -327.6800 327.6700 FORMAT "%8.4" ECU_ADDRESS 0x8FFBC2 /end MEASUREMENT
/begin MEASUREMENT PFlt_mAshCorDiff1_mp "Absolutbetrag von PFlt_mAshCorDiff_mp, relative Aschemengeabweichung" SWORD mSoot_g 1 100 -327.6800 327.6700 FORMAT "%8.4" ECU_ADDRESS 0x8FFBC4 /end MEASUREMENT
/begin MEASUREMENT PFlt_mAshCorDiff2_mp "" SWORD mSoot_g 1 100 -327.6800 327.6700 FORMAT "%8.4" ECU_ADDRESS 0x8FFBC6 /end MEASUREMENT
/begin MEASUREMENT PFlt_mAshCorDiff_mp "output of PFlt_mAshCor_MAP, Abweichung vom Aschemengesollwert" SWORD mSoot_g 1 100 -327.6800 327.6700 FORMAT "%8.4" ECU_ADDRESS 0x6F825C /end MEASUREMENT
/begin MEASUREMENT PFlt_mAshCorNew "Wird nur berechnet, wenn PFlt_mAshCorAct einen plausiblen Wert besitzt" SWORD mSoot_g 1 100 -327.6800 327.6700 FORMAT "%8.4" ECU_ADDRESS 0x7F903A /end MEASUREMENT
/begin MEASUREMENT PFlt_mAshCorOld "Aschekorrekturwert vom vorherigen Zyklus" SWORD mSoot_g 1 100 -327.6800 327.6700 FORMAT "%8.4" ECU_ADDRESS 0x7F903C /end MEASUREMENT
/begin MEASUREMENT PFlt_mSotOfs_mp "Korrekturwert äquivalenter Massenoffset" SWORD mSoot_g 1 100 -327.6800 327.6700 FORMAT "%8.4" ECU_ADDRESS 0x8FFBE8 /end MEASUREMENT
/begin MEASUREMENT PFlt_nAvrgFltAshCor_mp "gefilterter Wert Drehzahl" SWORD EngN 1 100 -32768.00 32767.00 FORMAT "%8.2" ECU_ADDRESS 0x8FFBC8 /end MEASUREMENT
/begin MEASUREMENT PFlt_nAvrgFlt_mp "Eng_nAvrg PT1 gefiltert" SWORD EngN 1 100 -32768.00 32767.00 FORMAT "%8.2" ECU_ADDRESS 0x8FFC0E /end MEASUREMENT
/begin MEASUREMENT PFlt_nDiagLowIdle "Leerlaufdrehzahl im Regenerationszustand" SWORD EngN 1 100 -32768.00 32767.00 FORMAT "%8.2" ECU_ADDRESS 0x7F904A /end MEASUREMENT
/begin MEASUREMENT PFlt_numEngPOp "Regeneration number after consideration of the engine operating state" UBYTE OneToOne 1 100 0.00 255.0 FORMAT "%5.1" ECU_ADDRESS 0x7F8996 /end MEASUREMENT
/begin MEASUREMENT PFlt_numLst_mp "Regenerationsanforderung aufgrund verbr. Treibstoff, Betriebszeit oder Strecke" UBYTE OneToOne 1 100 0.00 255.0 FORMAT "%5.1" ECU_ADDRESS 0x8FFBEA /end MEASUREMENT
/begin MEASUREMENT PFlt_numPrio "Priorität für angeforderten Regenerationszustand" UWORD OneToOne 1 100 0.00 65535.00 FORMAT "%8.2" ECU_ADDRESS 0x7F904C /end MEASUREMENT
/begin MEASUREMENT PFlt_numPrj "Regeneration demand number" UBYTE OneToOne 1 100 0.00 255.0 FORMAT "%5.1" ECU_ADDRESS 0x7F8997 /end MEASUREMENT
/begin MEASUREMENT PFlt_numPrt_mp "Regenerationsanforderung aufgrund Motorschutz" UBYTE OneToOne 1 100 0.00 255.0 FORMAT "%5.1" ECU_ADDRESS 0x8FFBEB /end MEASUREMENT
/begin MEASUREMENT PFlt_numRgn "Regeneration demand number" UBYTE OneToOne 1 100 0.00 255.0 FORMAT "%5.1" ECU_ADDRESS 0x7F8998 /end MEASUREMENT
/begin MEASUREMENT PFlt_numRgn_mp "gesamte Regenerationsanforderung" UBYTE OneToOne 1 100 0.00 255.0 FORMAT "%5.1" ECU_ADDRESS 0x6F8268 /end MEASUREMENT
/begin MEASUREMENT PFlt_numSot_mp "Beladungszustand des DPF" UBYTE OneToOne 1 100 0.00 255.0 FORMAT "%5.1" ECU_ADDRESS 0x8FFBEC /end MEASUREMENT
/begin MEASUREMENT PFlt_numTot "" UBYTE OneToOne 1 100 0.00 255.0 FORMAT "%5.1" ECU_ADDRESS 0x7F8999 /end MEASUREMENT
/begin MEASUREMENT PFlt_numTot_mp "Regeneationsmaßnahme nach Berücksichtigung des Motorbetriebspunktes" UBYTE OneToOne 1 100 0.00 255.0 FORMAT "%5.1" ECU_ADDRESS 0x8FFBED /end MEASUREMENT
/begin MEASUREMENT PFlt_pEngPrtMax_mp "Maximaldruck Motorschutz" SWORD Pres_hPa 1 100 -32768.00 32767.00 FORMAT "%8.2" ECU_ADDRESS 0x6F826A /end MEASUREMENT
/begin MEASUREMENT PFlt_pEngPrtMin_mp "Minimaldruck Motorschutz" SWORD Pres_hPa 1 100 -32768.00 32767.00 FORMAT "%8.2" ECU_ADDRESS 0x8FFBEE /end MEASUREMENT
/begin MEASUREMENT PFlt_qFlTot "nach der letzten Filterreinigung verbrauchte gesamte Krafstoffmenge" SWORD Fl_2 1 100 -327680.0 327670.0 FORMAT "%8.1" ECU_ADDRESS 0x7F9058 /end MEASUREMENT
/begin MEASUREMENT PFlt_qFlTotCor "Gesamtmenge Kraftstoffquantitätskorrektur" SWORD Fl_2 1 100 -327680.0 327670.0 FORMAT "%8.1" ECU_ADDRESS 0x7F905A /end MEASUREMENT
/begin MEASUREMENT PFlt_qFlTotEEPROM_mp "in EEPROM abgespeicherter Wert des Gesamtkraftstoffverbrauches für das DPF" SLONG Fl_L 1 100 -21474836.4800 21474836.4700 FORMAT "%13.4" ECU_ADDRESS 0x8FFBF0 /end MEASUREMENT
/begin MEASUREMENT PFlt_qFl_mp "verbrauchter Treibstoff seit der letzten erfolgreichen Regeneration" SWORD Fl_L 1 100 -327.6800 327.6700 FORMAT "%8.4" ECU_ADDRESS 0x6F826C /end MEASUREMENT
/begin MEASUREMENT PFlt_qPoI2NonEff "Nicht effektive PoI2-Einspritzmenge mg/zycl" SWORD InjMassCyc 1 100 -327.6800 327.6700 FORMAT "%8.4" ECU_ADDRESS 0x7F905C /end MEASUREMENT
/begin MEASUREMENT PFlt_qSetUnBalFltAshCor_mp "gefilterter Wert Einspritzmasse" SWORD InjMassCyc 1 100 -327.6800 327.6700 FORMAT "%8.4" ECU_ADDRESS 0x8FFBCA /end MEASUREMENT
/begin MEASUREMENT PFlt_qSetUnBalFlt_mp "gefilterter Wert der Einspritzmenge" SWORD InjMass 1 100 -327.6800 327.6700 FORMAT "%8.4" ECU_ADDRESS 0x8FFC10 /end MEASUREMENT
/begin MEASUREMENT PFlt_rAccPedFlt_mp "gefiltertes Pedalwertgebersignal" SWORD Prc 1 100 -400.0000 399.9878 FORMAT "%8.4" ECU_ADDRESS 0x8FFC12 /end MEASUREMENT
/begin MEASUREMENT PFlt_resFlowFltAshCorRaw_mp "Resflow-Rohwert" SWORD Res_hPaHrPerCM 1 100 -32.76800 32.76700 FORMAT "%8.5" ECU_ADDRESS 0x8FFBCC /end MEASUREMENT
/begin MEASUREMENT PFlt_resFlowFltAshCor_mp "PT1-gefilterter Wert für for PFlt_resFlow" SWORD Res_hPaHrPerCM 1 100 -32.76800 32.76700 FORMAT "%8.5" ECU_ADDRESS 0x8FFBCE /end MEASUREMENT
/begin MEASUREMENT PFlt_resSotMeasCrv_mp "versteckter Messpunkt, nur für aus Codierungsgründen" SWORD Res_hPaHrPerCM 1 100 -32.76800 32.76700 FORMAT "%8.5" ECU_ADDRESS 0x8FFBF4 /end MEASUREMENT
/begin MEASUREMENT PFlt_rLmbd "Lambdawert" SWORD lambda 1 100 -32.76800 32.76700 FORMAT "%8.5" ECU_ADDRESS 0x7F905E /end MEASUREMENT
/begin MEASUREMENT PFlt_rLmbdAprx_mp "Lambda berechnet aus q_inj und dm_air" SWORD lambda 1 100 -32.76800 32.76700 FORMAT "%8.5" ECU_ADDRESS 0x8FFC4A /end MEASUREMENT
/begin MEASUREMENT PFlt_RngIdxPrj_X_mp "Input to matrix to determine range limits for the filtered vehicle speed" UBYTE OneToOne 1 100 0.00 255.0 FORMAT "%5.1" ECU_ADDRESS 0x8FFC44 /end MEASUREMENT
/begin MEASUREMENT PFlt_RngIdxPrj_Y_mp "Input to matrix to determine range limits for the filtered vehicle speed" UBYTE OneToOne 1 100 0.00 255.0 FORMAT "%5.1" ECU_ADDRESS 0x8FFC45 /end MEASUREMENT
/begin MEASUREMENT PFlt_RngIdx_X_mp "Range Index for coloumn nos of matrices" UBYTE OneToOne 1 100 0.00 255.0 FORMAT "%5.1" ECU_ADDRESS 0x8FFC14 /end MEASUREMENT
/begin MEASUREMENT PFlt_RngIdx_Y_mp "Range Index for row nos of matrices" UBYTE OneToOne 1 100 0.00 255.0 FORMAT "%5.1" ECU_ADDRESS 0x8FFC15 /end MEASUREMENT
/begin MEASUREMENT PFlt_st "von Partikelfilter angeforderter Regenerationsstatus" ULONG OneToOne 1 100 0.00 4294967295.00 FORMAT "%13.2" ECU_ADDRESS 0x7F9270 /end MEASUREMENT
/begin MEASUREMENT PFlt_st1_mp "Status des Partikelfilters  LowByte (->Signals)" UWORD OneToOne 1 100 0.00 65535.00 FORMAT "%8.2" ECU_ADDRESS 0x6F826E /end MEASUREMENT
/begin MEASUREMENT PFlt_st2_mp "Status des Partikelfilters  HighByte (->Signals)" UWORD OneToOne 1 100 0.00 65535.00 FORMAT "%8.2" ECU_ADDRESS 0x6F8270 /end MEASUREMENT
/begin MEASUREMENT PFlt_stAshCorCalc_mp "Berechnungsstatus Aschekorrektur" UBYTE OneToOne 1 100 0.00 255.0 FORMAT "%5.1" ECU_ADDRESS 0x8FFBD0 /end MEASUREMENT
/begin MEASUREMENT PFlt_stAshCorDist_mp "Status Ashekorrekturdistanz" UBYTE OneToOne 1 100 0.00 255.0 FORMAT "%5.1" ECU_ADDRESS 0x8FFBD1 /end MEASUREMENT
/begin MEASUREMENT PFlt_stAshCorRgnMax "Maximumzähler für AshCor Regeneration abgelaufen, keine gültige Regeneration stattgefunden" UBYTE OneToOne 1 100 0.00 255.0 FORMAT "%5.1" ECU_ADDRESS 0x7F899B /end MEASUREMENT
/begin MEASUREMENT PFlt_stAshCorRgn_mp "bitweise Aufschlüsselung der aktuellen Regenerationsanforderung" UBYTE OneToOne 1 100 0.00 255.0 FORMAT "%5.1" ECU_ADDRESS 0x8FFBD2 /end MEASUREMENT
/begin MEASUREMENT PFlt_stAshCorRlsOn_mp "Status Aschekorrektur-Freigabe am" UBYTE OneToOne 1 100 0.00 255.0 FORMAT "%5.1" ECU_ADDRESS 0x8FFBD3 /end MEASUREMENT
/begin MEASUREMENT PFlt_stAshCorRls_mp "Status Aschekorrektur-Freigabe" UBYTE OneToOne 1 100 0.00 255.0 FORMAT "%5.1" ECU_ADDRESS 0x8FFBD4 /end MEASUREMENT
/begin MEASUREMENT PFlt_stAshCor_mp "Status Aschekorrektur" UBYTE OneToOne 1 100 0.00 255.0 FORMAT "%5.1" ECU_ADDRESS 0x8FFBD5 /end MEASUREMENT
/begin MEASUREMENT PFlt_stBrkDeb_mp "Entprelltes Bremssignal" UBYTE OneToOne 1 100 0.00 255.0 FORMAT "%5.1" ECU_ADDRESS 0x8FFC16 /end MEASUREMENT
/begin MEASUREMENT PFlt_stClthDeb_mp "Entprelltes Kupplungssignal" UBYTE OneToOne 1 100 0.00 255.0 FORMAT "%5.1" ECU_ADDRESS 0x8FFC17 /end MEASUREMENT
/begin MEASUREMENT PFlt_stCnt_mp "Statuswort für  Regnerationsanf. nach Kraftstoffverbrauch, Betriebsstunden oder gefahrener Strecke" UBYTE OneToOne 1 100 0.00 255.0 FORMAT "%5.1" ECU_ADDRESS 0x8FFBF6 /end MEASUREMENT
/begin MEASUREMENT PFlt_stDiag "status of particulate filter" ULONG OneToOne 1 100 0.00 4294967295.00 FORMAT "%13.2" ECU_ADDRESS 0x7F9274 /end MEASUREMENT
/begin MEASUREMENT PFlt_stDiagAbort "Bit-Information für Abbruchbedingungen" ULONG OneToOne 1 100 0.00 4294967295.00 FORMAT "%13.2" ECU_ADDRESS 0x7F9278 /end MEASUREMENT
/begin MEASUREMENT PFlt_stDiagAbortMsk "gewünschte Bit-Information für Abbruchbedingungen" ULONG OneToOne 1 100 0.00 4294967295.00 FORMAT "%13.2" ECU_ADDRESS 0x7F927C /end MEASUREMENT
/begin MEASUREMENT PFlt_stDiagAbrt1_mp "Trigger Abbruch 1" UBYTE OneToOne 1 100 0.00 255.0 FORMAT "%5.1" ECU_ADDRESS 0x8FFC08 /end MEASUREMENT
/begin MEASUREMENT PFlt_stDiagAbrt2_mp "Trigger Abbruch 2" UBYTE OneToOne 1 100 0.00 255.0 FORMAT "%5.1" ECU_ADDRESS 0x8FFC09 /end MEASUREMENT
/begin MEASUREMENT PFlt_stDiagCoolDwn_mp "Abkühltrigger" UBYTE OneToOne 1 100 0.00 255.0 FORMAT "%5.1" ECU_ADDRESS 0x8FFC0A /end MEASUREMENT
/begin MEASUREMENT PFlt_stDiagDemOn "Testeranforderung auf Diagnose" UBYTE OneToOne 1 100 0.00 255.0 FORMAT "%5.1" ECU_ADDRESS 0x7F899C /end MEASUREMENT
/begin MEASUREMENT PFlt_stDiagEnd_mp "Trigger Regenerationsende" UBYTE OneToOne 1 100 0.00 255.0 FORMAT "%5.1" ECU_ADDRESS 0x8FFC0B /end MEASUREMENT
/begin MEASUREMENT PFlt_stDiagMsk "gewünschter Zustand der Freigabebedingungen" ULONG OneToOne 1 100 0.00 4294967295.00 FORMAT "%13.2" ECU_ADDRESS 0x7F9280 /end MEASUREMENT
/begin MEASUREMENT PFlt_stDiagOn "Diagnosezustand EIN" UBYTE OneToOne 1 100 0.00 255.0 FORMAT "%5.1" ECU_ADDRESS 0x7F899D /end MEASUREMENT
/begin MEASUREMENT PFlt_stDiagRgn "Zustand der Regenerationsbedingungen" ULONG OneToOne 1 100 0.00 4294967295.00 FORMAT "%13.2" ECU_ADDRESS 0x7F9284 /end MEASUREMENT
/begin MEASUREMENT PFlt_stDiagRgnMsk "gewünschter Zustand der Regenerationsbedingungen" ULONG OneToOne 1 100 0.00 4294967295.00 FORMAT "%13.2" ECU_ADDRESS 0x7F9288 /end MEASUREMENT
/begin MEASUREMENT PFlt_stDiagRgn_mp "Regenerationsstart-Trigger" UBYTE OneToOne 1 100 0.00 255.0 FORMAT "%5.1" ECU_ADDRESS 0x8FFC0C /end MEASUREMENT
/begin MEASUREMENT PFlt_stDiagRls "Zustand der Freigabebedingungen" ULONG OneToOne 1 100 0.00 4294967295.00 FORMAT "%13.2" ECU_ADDRESS 0x7F928C /end MEASUREMENT
/begin MEASUREMENT PFlt_stDiagRls_mp "Freigabe der Diagnose" UBYTE OneToOne 1 100 0.00 255.0 FORMAT "%5.1" ECU_ADDRESS 0x8FFC0D /end MEASUREMENT
/begin MEASUREMENT PFlt_stDiagState "Diagnosezustand" UWORD OneToOne 1 100 0.00 65535.00 FORMAT "%8.2" ECU_ADDRESS 0x7F9068 /end MEASUREMENT
/begin MEASUREMENT PFlt_stDiagSuc "Zustand des Diagnoseerfolgs" UBYTE OneToOne 1 100 0.00 255.0 FORMAT "%5.1" ECU_ADDRESS 0x7F899E /end MEASUREMENT
/begin MEASUREMENT PFlt_stEngPOp "Motorbetriebspunkt" UBYTE OneToOne 1 100 0.00 255.0 FORMAT "%5.1" ECU_ADDRESS 0x7F899F /end MEASUREMENT
/begin MEASUREMENT PFlt_stEngPOp10_mp "Motorbetriebspunkt berechnet in Check Range 10" UBYTE OneToOne 1 100 0.00 255.0 FORMAT "%5.1" ECU_ADDRESS 0x8FFC18 /end MEASUREMENT
/begin MEASUREMENT PFlt_stEngPOp1_mp "Motorbetriebspunkt berechnet in Check Range 1" UBYTE OneToOne 1 100 0.00 255.0 FORMAT "%5.1" ECU_ADDRESS 0x8FFC19 /end MEASUREMENT
/begin MEASUREMENT PFlt_stEngPOp2_mp "Motorbetriebspunkt berechnet in Check Range 2" UBYTE OneToOne 1 100 0.00 255.0 FORMAT "%5.1" ECU_ADDRESS 0x8FFC1A /end MEASUREMENT
/begin MEASUREMENT PFlt_stEngPOp3_mp "Motorbetriebspunkt berechnet in Check Range 3" UBYTE OneToOne 1 100 0.00 255.0 FORMAT "%5.1" ECU_ADDRESS 0x8FFC1B /end MEASUREMENT
/begin MEASUREMENT PFlt_stEngPOp4_mp "Motorbetriebspunkt berechnet in Check Range 4" UBYTE OneToOne 1 100 0.00 255.0 FORMAT "%5.1" ECU_ADDRESS 0x8FFC1C /end MEASUREMENT
/begin MEASUREMENT PFlt_stEngPOp5_mp "Motorbetriebspunkt berechnet in Check Range 5" UBYTE OneToOne 1 100 0.00 255.0 FORMAT "%5.1" ECU_ADDRESS 0x8FFC1D /end MEASUREMENT
/begin MEASUREMENT PFlt_stEngPOp6_mp "Motorbetriebspunkt berechnet in Check Range 6" UBYTE OneToOne 1 100 0.00 255.0 FORMAT "%5.1" ECU_ADDRESS 0x8FFC1E /end MEASUREMENT
/begin MEASUREMENT PFlt_stEngPOp7_mp "Motorbetriebspunkt berechnet in Check Range 7" UBYTE OneToOne 1 100 0.00 255.0 FORMAT "%5.1" ECU_ADDRESS 0x8FFC1F /end MEASUREMENT
/begin MEASUREMENT PFlt_stEngPOp8_mp "Motorbetriebspunkt berechnet in Check Range 8" UBYTE OneToOne 1 100 0.00 255.0 FORMAT "%5.1" ECU_ADDRESS 0x8FFC20 /end MEASUREMENT
/begin MEASUREMENT PFlt_stEngPOp9_mp "Motorbetriebspunkt berechnet in Check Range 9" UBYTE OneToOne 1 100 0.00 255.0 FORMAT "%5.1" ECU_ADDRESS 0x8FFC21 /end MEASUREMENT
/begin MEASUREMENT PFlt_stEngPOpPrj "Projektspezifischer Ausgabewert für Betriebszustandsberechnung" UWORD OneToOne 1 100 0.00 65535.00 FORMAT "%8.2" ECU_ADDRESS 0x7F906A /end MEASUREMENT
/begin MEASUREMENT PFlt_stEngPOpSpo_mp "Statuswert Betriebspunkt ""Spontante Regeneration""" UBYTE OneToOne 1 100 0.00 255.0 FORMAT "%5.1" ECU_ADDRESS 0x8FFC22 /end MEASUREMENT
/begin MEASUREMENT PFlt_stEngPrtActv "Status Motorschutz aktiv" UBYTE OneToOne 1 100 0.00 255.0 FORMAT "%5.1" ECU_ADDRESS 0x7F89A0 /end MEASUREMENT
/begin MEASUREMENT PFlt_stFlTotCorOn_mp "Status für Gesamtmenge Kraftstoffkorrektur ON." UBYTE OneToOne 1 100 0.00 255.0 FORMAT "%5.1" ECU_ADDRESS 0x8FFBD6 /end MEASUREMENT
/begin MEASUREMENT PFlt_stFlTotCor_mp "Status für Gesamtmenge Kraftstoffkorrektur" UBYTE OneToOne 1 100 0.00 255.0 FORMAT "%5.1" ECU_ADDRESS 0x8FFBD7 /end MEASUREMENT
/begin MEASUREMENT PFlt_stGearDeb_mp "Entprelltes Gangsignal" SBYTE OneToOne 1 100 -128.0 127.0 FORMAT "%5.1" ECU_ADDRESS 0x8FFC23 /end MEASUREMENT
/begin MEASUREMENT PFlt_stIntr_mp "Statuswort Regeneration unterbrochen" UBYTE OneToOne 1 100 0.00 255.0 FORMAT "%5.1" ECU_ADDRESS 0x6F8272 /end MEASUREMENT
/begin MEASUREMENT PFlt_stLck "Statusbit Lock Partikelfilterregeneration" UBYTE OneToOne 1 100 0.00 255.0 FORMAT "%5.1" ECU_ADDRESS 0x7F89A1 /end MEASUREMENT
/begin MEASUREMENT PFlt_stLckFuel_mp "Messender Punkt für Status der Kraftstoffverriegelung" UBYTE OneToOne 1 100 0.00 255.0 FORMAT "%5.1" ECU_ADDRESS 0x8FFBF7 /end MEASUREMENT
/begin MEASUREMENT PFlt_stLck_mp "Regeneration Blockierung und Freigabe" UBYTE OneToOne 1 100 0.00 255.0 FORMAT "%5.1" ECU_ADDRESS 0x6F8273 /end MEASUREMENT
/begin MEASUREMENT PFlt_stLstRgnEnd_mp "Status detektiert Ende des Timers für Regeneration aus Zählerblöcken" UBYTE OneToOne 1 100 0.00 255.0 FORMAT "%5.1" ECU_ADDRESS 0x8FFBF8 /end MEASUREMENT
/begin MEASUREMENT PFlt_stLstRgn_mp "Status Timer für Regeneration aus Zählerblöcken" UBYTE OneToOne 1 100 0.00 255.0 FORMAT "%5.1" ECU_ADDRESS 0x8FFBF9 /end MEASUREMENT
/begin MEASUREMENT PFlt_stNumEngPOpDelOn_mp "Statusbit verzögert wirksame Matrix zur Berücksichtigung des Motorbetriebszustandes bei der Regeneration" UBYTE OneToOne 1 100 0.00 255.0 FORMAT "%5.1" ECU_ADDRESS 0x8FFBFA /end MEASUREMENT
/begin MEASUREMENT PFlt_stPFltErr_mp "" UBYTE OneToOne 1 100 0.00 255.0 FORMAT "%5.1" ECU_ADDRESS 0x8FFBD8 /end MEASUREMENT
/begin MEASUREMENT PFlt_stRng10_mp "Statuswort Bereich 10" UWORD OneToOne 1 100 0.00 65535.00 FORMAT "%8.2" ECU_ADDRESS 0x8FFC24 /end MEASUREMENT
/begin MEASUREMENT PFlt_stRng1_mp "Statuswort Bereich 1" UWORD OneToOne 1 100 0.00 65535.00 FORMAT "%8.2" ECU_ADDRESS 0x8FFC26 /end MEASUREMENT
/begin MEASUREMENT PFlt_stRng2_mp "Statuswort Bereich 2" UWORD OneToOne 1 100 0.00 65535.00 FORMAT "%8.2" ECU_ADDRESS 0x8FFC28 /end MEASUREMENT
/begin MEASUREMENT PFlt_stRng3_mp "Statuswort Bereich 3" UWORD OneToOne 1 100 0.00 65535.00 FORMAT "%8.2" ECU_ADDRESS 0x8FFC2A /end MEASUREMENT
/begin MEASUREMENT PFlt_stRng4_mp "Statuswort Bereich 4" UWORD OneToOne 1 100 0.00 65535.00 FORMAT "%8.2" ECU_ADDRESS 0x8FFC2C /end MEASUREMENT
/begin MEASUREMENT PFlt_stRng5_mp "Statuswort Bereich 5" UWORD OneToOne 1 100 0.00 65535.00 FORMAT "%8.2" ECU_ADDRESS 0x8FFC2E /end MEASUREMENT
/begin MEASUREMENT PFlt_stRng6_mp "Statuswort Bereich 6" UWORD OneToOne 1 100 0.00 65535.00 FORMAT "%8.2" ECU_ADDRESS 0x8FFC30 /end MEASUREMENT
/begin MEASUREMENT PFlt_stRng7_mp "Statuswort Bereich 7" UWORD OneToOne 1 100 0.00 65535.00 FORMAT "%8.2" ECU_ADDRESS 0x8FFC32 /end MEASUREMENT
/begin MEASUREMENT PFlt_stRng8_mp "Statuswort Bereich 8" UWORD OneToOne 1 100 0.00 65535.00 FORMAT "%8.2" ECU_ADDRESS 0x8FFC34 /end MEASUREMENT
/begin MEASUREMENT PFlt_stRng9_mp "Statuswort Bereich 9" UWORD OneToOne 1 100 0.00 65535.00 FORMAT "%8.2" ECU_ADDRESS 0x8FFC36 /end MEASUREMENT
/begin MEASUREMENT PFlt_stRngSpo_mp "Statuswort Bereich ""Spontane Regeneration""" UWORD OneToOne 1 100 0.00 65535.00 FORMAT "%8.2" ECU_ADDRESS 0x8FFC38 /end MEASUREMENT
/begin MEASUREMENT PFlt_stSuc "Statuswort erfolgreiche Regeneration" UBYTE OneToOne 1 100 0.00 255.0 FORMAT "%5.1" ECU_ADDRESS 0x7F89A4 /end MEASUREMENT
/begin MEASUREMENT PFlt_stSuc_mp "erfolgreiche Regeneration" UBYTE OneToOne 1 100 0.00 255.0 FORMAT "%5.1" ECU_ADDRESS 0x8FFBFB /end MEASUREMENT
/begin MEASUREMENT PFlt_tAirFltAshCor_mp "gefilterter Wert Ansauglufttemperatur" SWORD Temp_Cels 1 100 -50.140 899.860 FORMAT "%8.3" ECU_ADDRESS 0x8FFBDA /end MEASUREMENT
/begin MEASUREMENT PFlt_tCIntFltAshCor_mp "gefilterter Wert Kühlmitteltemperatur" SWORD Temp_Cels 1 100 -50.140 899.860 FORMAT "%8.3" ECU_ADDRESS 0x8FFBDC /end MEASUREMENT
/begin MEASUREMENT PFlt_tClntFlt_mp "CTSCD_tClnt PT1 gefiltert" SWORD Temp_Cels 1 100 -50.140 899.860 FORMAT "%8.3" ECU_ADDRESS 0x8FFC3A /end MEASUREMENT
/begin MEASUREMENT PFlt_tiLckRls_mp " In EEPROM abgespeicherte Zeit für Sperren die Regeneration" ULONG Time_s 1 100 0.00 42949672.9500 FORMAT "%13.4" ECU_ADDRESS 0x8FFBFC /end MEASUREMENT
/begin MEASUREMENT PFlt_tiOpu16_mp "Engine operation time with reduced resolution" UWORD tiOpRes 1 100 0.00 4194240. FORMAT "%8.0" ECU_ADDRESS 0x6F8274 /end MEASUREMENT
/begin MEASUREMENT PFlt_tiOp_mp "Motorbetriebszeit bei der letzten erfolgr. Regeneration" ULONG TimeEngOn 1 100 0.00 4294967295.00 FORMAT "%13.2" ECU_ADDRESS 0x8FFC00 /end MEASUREMENT
/begin MEASUREMENT PFlt_tiPFltErr_mp "" UWORD TimePFltLimpHome 1 100 0.00 655350.0 FORMAT "%8.1" ECU_ADDRESS 0x6F825E /end MEASUREMENT
/begin MEASUREMENT PFlt_tiRgnMax_mp "Wert für die maximale Regenerierungsdauer" ULONG Time_s 1 100 0.00 42949672.9500 FORMAT "%13.4" ECU_ADDRESS 0x8FFC04 /end MEASUREMENT
/begin MEASUREMENT PFlt_tiSnceRgn "" ULONG TimeEngOn 1 100 0.00 4294967295.00 FORMAT "%13.2" ECU_ADDRESS 0x7F9290 /end MEASUREMENT
/begin MEASUREMENT PFlt_tiSnceRgnu16_mp "Engine operation time since last successful regeneration with reduced resolution" UWORD tiSncergnRes 1 100 0.00 16776960. FORMAT "%8.0" ECU_ADDRESS 0x6F8276 /end MEASUREMENT
/begin MEASUREMENT PFlt_tOxiPreFltAshCor_mp "gefilterter Wert OxiKat-Temperatur" SWORD Temp_Cels 1 100 -50.140 899.860 FORMAT "%8.3" ECU_ADDRESS 0x8FFBDE /end MEASUREMENT
/begin MEASUREMENT PFlt_tOxiPreFlt_mp "OxiCCD_tPre PT1 gefiltert" SWORD Temp_Cels 1 100 -50.140 899.860 FORMAT "%8.3" ECU_ADDRESS 0x8FFC3C /end MEASUREMENT
/begin MEASUREMENT PFlt_tPOpAir_mp "Ansauglufttemperatur aus Kennfeld" SWORD Temp_Cels 1 100 -50.140 899.860 FORMAT "%8.3" ECU_ADDRESS 0x8FFC3E /end MEASUREMENT
/begin MEASUREMENT PFlt_tPOpClnt_mp "Kühlflüssigkeitstemperatur aus Kennfeld" SWORD Temp_Cels 1 100 -50.140 899.860 FORMAT "%8.3" ECU_ADDRESS 0x8FFC40 /end MEASUREMENT
/begin MEASUREMENT PFlt_tPreFltAshCor_mp "gefilterter Wert Aufwärtstemperatur Partikelfilter" SWORD Temp_Cels 1 100 -50.140 899.860 FORMAT "%8.3" ECU_ADDRESS 0x8FFBE0 /end MEASUREMENT
/begin MEASUREMENT PFlt_tPreFlt_mp "PFlt_tPre PT1 gefiltert" SWORD Temp_Cels 1 100 -50.140 899.860 FORMAT "%8.3" ECU_ADDRESS 0x6F8278 /end MEASUREMENT
/begin MEASUREMENT PFlt_uBattCDFlt_mp "gefilterte Batteriespannung" SWORD Volt_Batt 1 100 -640625.6 640606.1 FORMAT "%8.1" ECU_ADDRESS 0x8FFC42 /end MEASUREMENT
/begin MEASUREMENT PFlt_vVehFltAshCor_mp "gefilterter Wert Fahrzeuggeschwindigkeit" SWORD Vel 1 100 -327.6800 327.6700 FORMAT "%8.4" ECU_ADDRESS 0x8FFBE2 /end MEASUREMENT
/begin MEASUREMENT PFlt_vVehFlt_mp "VSSCD_v PT1 gefiltert" SWORD Vel 1 100 -327.6800 327.6700 FORMAT "%8.4" ECU_ADDRESS 0x6F827A /end MEASUREMENT
/begin MEASUREMENT PFlt_vVehUnFltMax_mp "Maximum value of unfiltered vehicle speed" SWORD Vel 1 100 -327.6800 327.6700 FORMAT "%8.4" ECU_ADDRESS 0x8FFC46 /end MEASUREMENT
/begin MEASUREMENT PFlt_vVehUnFltMin_mp "Minimum Grenzen für ungefilterte Fahrgeschwindigkeit" SWORD Vel 1 100 -327.6800 327.6700 FORMAT "%8.4" ECU_ADDRESS 0x8FFC48 /end MEASUREMENT
/begin FUNCTION pcr_lpmonitor "PCR Monitoring  at Low Pressure"
 /begin DEF_CHARACTERISTIC PCR_DebLPDvtNegDef_C PCR_DebLPDvtNegOk_C PCR_DebLPDvtPosDef_C PCR_DebLPDvtPosOk_C PCR_nLPWrkSph2_C PCR_nLPWrkSph3_C PCR_pLPDvtMaxOffset_C PCR_pLPDvtMax_MAP PCR_pLPDvtMinOffset_C PCR_pLPDvtMin_MAP PCR_qLPClutchThres_CUR PCR_qLPGvnrOffRgn_CUR PCR_qLPGvnrOff_CUR PCR_qLPGvnrOnRgn_CUR PCR_qLPGvnrOn_CUR PCR_qLPWrkSph2_C PCR_qLPWrkSph3_C PCR_rLPDflVal09_C PCR_rLPDflVal12_C PCR_rLPDflVal18_C PCR_stLPMonCur_C PCR_swtLPV8_C PCR_tiLPClutchDebHighLow_C PCR_tiLPClutchDebLowHigh_C PCR_vLPClutch_C /end DEF_CHARACTERISTIC
 /begin IN_MEASUREMENT Eng_nAvrg InjCtl_qCurr /end IN_MEASUREMENT
/end FUNCTION
/begin FUNCTION pcr_lpmonitor_msg ""
 /begin OUT_MEASUREMENT PCR_rBPALP PCR_rBPALP2 PCR_stLPMonitor PCR_stLPPCR PCR_stLPWorkSph PCR_swtLPGvnr /end OUT_MEASUREMENT
/end FUNCTION
/begin FUNCTION pcr_lpmonitor_uic ""
 /begin OUT_MEASUREMENT PCR_pLPDvtMaxRaw_mp PCR_pLPDvtMax_mp PCR_pLPDvtMinRaw_mp PCR_pLPDvtMin_mp PCR_qLPGvnrOff_mp PCR_qLPGvnrOn_mp PCR_stLPClutch_mp PCR_stLPRgn_mp PCR_swtLPGvnrV1_mp /end OUT_MEASUREMENT
/end FUNCTION
/begin FUNCTION pcr_monitor "Ladedruckregelung - Überwachung und Abschaltung"
 /begin DEF_CHARACTERISTIC PCR_DebSRCHighDef_C PCR_DebSRCHighOk_C PCR_DebSRCLowDef_C PCR_DebSRCLowOk_C PCR_nCoStart_C PCR_nCoStrtHigh_C PCR_nWrkSph1_C PCR_nWrkSph2_C PCR_nWrkSph3_C PCR_pBGDevMaxOffset_C PCR_pBGDevMax_MAP PCR_pBGDevMinOffset_C PCR_pBGDevMin_MAP PCR_qClutchThres_C PCR_qClutchThres_CUR PCR_qRgtOffRgn_CUR PCR_qRgtOff_CUR PCR_qRgtOnRgn_CUR PCR_qRgtOn_CUR PCR_qWrkSph2_C PCR_qWrkSph3_C PCR_rCBOpn_C PCR_rDflVal04_C PCR_rDflVal05_C PCR_rDflVal06_C PCR_rDflVal12_C PCR_rDflVal15_MAP PCR_rDflVal18_C PCR_rDflVal24_C PCR_stMonCur_C PCR_swtV8_C PCR_tiClutchDebHighLow_C PCR_tiClutchDebLowHigh_C PCR_tiCoStrt_CUR PCR_tiGvnrOffDel_CUR PCR_tiStrtDelayInit_C PCR_vClutch_C /end DEF_CHARACTERISTIC
 /begin IN_MEASUREMENT CTSCD_tClnt Eng_nAvrg InjCtl_qCurr PCR_qReal /end IN_MEASUREMENT
/end FUNCTION
/begin FUNCTION pcr_monitor_msg ""
 /begin OUT_MEASUREMENT PCR_rBPA PCR_rBPA2 PCR_stMonitor PCR_stPCR PCR_stWorkSph PCR_swtGvnr /end OUT_MEASUREMENT
/end FUNCTION
/begin FUNCTION pcr_monitor_uic ""
 /begin DEF_CHARACTERISTIC PCR_rBPACDAdd_Vector PCR_rBPACDAdd_Channel PCR_rBPACD_Vector PCR_rBPACD_Channel /end DEF_CHARACTERISTIC
 /begin OUT_MEASUREMENT PCR_pBGDevMaxRaw_mp PCR_pBGDevMax_mp PCR_pBGDevMinRaw_mp PCR_pBGDevMin_mp PCR_rBPACDByp_mp PCR_stClutch_mp PCR_stCpBVlv_mp PCR_stPCR_mp PCR_tiStrtDelay_mp /end OUT_MEASUREMENT
/end FUNCTION
/begin FUNCTION pcr_monitor_var "" /end FUNCTION
/begin FUNCTION pcr_monitor_var_msg "" /end FUNCTION
/begin FUNCTION pcr_monitor_var_uic "" /end FUNCTION
/begin FUNCTION pcr_surgectl "LDR-AntiSurge Regler"
 /begin DEF_CHARACTERISTIC PCR_dnSurgeCtlRel_C PCR_dpSurgeCtlRmpUp_C PCR_dpSurgeCtlRmpDwn_C PCR_dqSurgeCtlRel_C PCR_drSurgeCtlRmpUp_C PCR_drSurgeCtlRmpDwn_C PCR_facSurgeDes_CUR PCR_facSurgeI_MAP PCR_facSurgeP_MAP PCR_ISurgeKi_C PCR_ISurgeKiPos_C PCR_ISurgeKiNeg_C PCR_facSurgeIWinPos_C PCR_facSurgeIWinNeg_C PCR_pBSurgeDesMax_MAP PCR_pBSurgeDesMin_MAP PCR_pBSurgeDes_CUR PCR_pDvtSurgeCtlRel_C PCR_pSurgeARWIMin_C PCR_PSurgeKp_C PCR_PSurgeKpPos_C PCR_PSurgeKpNeg_C PCR_facSurgePWinPos_C PCR_facSurgePWinNeg_C PCR_rSurgeGvnrOff_CUR PCR_rSurgeGvnrOn_MAP PCR_rSurgeGvnr_MAP PCR_tiSurgeGvnrPT1_C PCR_swtSurgeARWMode_C PCR_swtSurgeGvnrSel_C PCR_tiSurgeCtlHiLoRel3_C PCR_tiSurgeCtlLoHiRel3_C PCR_tiSurgeCtlHiLoRelAll_C PCR_tiSurgeCtlLoHiRelAll_C /end DEF_CHARACTERISTIC
 /begin IN_MEASUREMENT APSCD_pLinVal Eng_nAvrg InjCtl_qCurr PCR_pBSurgePICtlLim_mp /end IN_MEASUREMENT
/end FUNCTION
/begin FUNCTION pcr_surgectl_msg "" /begin OUT_MEASUREMENT PCR_pBSurgeDes PCR_rGvnrSurge PCR_swtSurgeGvnr /end OUT_MEASUREMENT /end FUNCTION
/begin FUNCTION pcr_surgectl_uic ""
 /begin OUT_MEASUREMENT PCR_facSGDevI_mp PCR_facSurgeDes_mp PCR_facSurgeGvnrDev_mp PCR_facSurgeI_mp PCR_facSurgeP_mp PCR_pBSurgeDesMax_mp PCR_pBSurgeDesMin_mp PCR_pBSurgeDesRaw_mp PCR_pBSurgePICtlLim_mp PCR_pBSurgePICtl_mp PCR_pSOutI_mp PCR_pSOutP_mp PCR_pSurgestI_mp PCR_rGvnrSurgeRaw_mp PCR_rSurgeGvnrHysOff_mp PCR_rSurgeGvnrOff_mp PCR_rSurgeGvnrOn_mp PCR_swtSurgeGvnrRel_mp PCR_swtSurgeGvnrSel_mp /end OUT_MEASUREMENT
/end FUNCTION
/begin FUNCTION pcr_surgedet "Turboladerpumpgrenzerkennung"
 /begin DEF_CHARACTERISTIC PCR_ctAirPerTimeFrq_C PCR_facAirPerTimeAmplMax_C PCR_facAirPerTimeAmplMin_C PCR_facCnv_CUR PCR_facSin_CUR PCR_facSqr_CUR PCR_tiDebSurge1_C PCR_tiDebSurge2_C PCR_swtAirPerTimeDet_C PCR_swtFacCnv_C PCR_tiAirPerTimeAmplFlt_C PCR_tiAirPTCtlFlt1_C PCR_tiAirPTCtlFlt2_C PCR_tiDelPreSurgeDet_C /end DEF_CHARACTERISTIC
 /begin IN_MEASUREMENT PCR_facAirPerTimeAmplFlt_mp PCR_facSinIn_mp PCR_facSqrIn_mp /end IN_MEASUREMENT
/end FUNCTION
/begin FUNCTION pcr_surgedet_msg "" /begin OUT_MEASUREMENT PCR_facAirPerTimeAmplFlt PCR_stPreSurge PCR_stSurge /end OUT_MEASUREMENT /end FUNCTION
/begin FUNCTION pcr_surgedet_uic ""
 /begin OUT_MEASUREMENT PCR_facAirAmplFlt_mp PCR_facAirPerTimeAmplFlt_mp PCR_facAirPerTimeAmpl_mp PCR_facAirPTAmpl1_mp PCR_facAirPTAmpl2Flt_mp PCR_facAirPTAmpl2_mp PCR_facCosCoeffDFT_mp PCR_facSinCoeffDFT_mp PCR_facSinIn_mp PCR_facSinOut_mp PCR_facSqrIn_mp /end OUT_MEASUREMENT
/end FUNCTION
/begin FUNCTION pcvcd_co "Druckregelventil Komponententreiber"
 /begin DEF_CHARACTERISTIC PCVCD_uSRCMin_C PCVCD_uSRCMax_C PCVCD_iLin_CUR PCVCD_ctPwrStgOnMax_C PCVCD_dcycMax_C PCVCD_dcycMin_C PCVCD_DebExcTempDef_C PCVCD_DebExcTempOk_C PCVCD_DebNoLoadDef_C PCVCD_DebNoLoadOk_C PCVCD_DebShortCircBatDef_C PCVCD_DebShortCircBatOk_C PCVCD_DebShortCircGndDef_C PCVCD_DebShortCircGndOk_C PCVCD_DebSRCHighDef_C PCVCD_DebSRCHighOk_C PCVCD_DebSRCLowDef_C PCVCD_DebSRCLowOk_C PCVCD_facIGovInit_CUR PCVCD_facIGovMax_C PCVCD_facIGovMin_C PCVCD_tiFlt1PT1_C PCVCD_tiFlt2PT1_C PCVCD_tiIGovDT1_C PCVCD_IGovDKd_C PCVCD_IGovIKi_C PCVCD_IGovIKiPos_C PCVCD_IGovIKiNeg_C PCVCD_iIGovIWinPos_C PCVCD_iIGovIWinNeg_C PCVCD_tiFltPT1Init_C PCVCD_numAdc_C PCVCD_numDia1_C PCVCD_numDia2_C PCVCD_numPwmOut_C PCVCD_stInvOut_C PCVCD_tiPer_C PCVCD_resCoil_C PCVCD_stPwrStgDia_C PCVCD_stSPICtl_C PCVCD_swtCtlStateVal_C PCVCD_swtCtlStateType_C PCVCD_swt_C PCVCD_tiBtwTst_C PCVCD_tiIGovInit_C PCVCD_tiPwrStgOn_C PCVCD_tiDebSigDefSigTst_C PCVCD_tiDebSigOkSigTst_C /end DEF_CHARACTERISTIC
 /begin IN_MEASUREMENT FlSys_t PCVCD_uRawVal_mp /end IN_MEASUREMENT
/end FUNCTION
/begin FUNCTION pcvcd_co_msg "" /begin OUT_MEASUREMENT PCVCD_iActVal PCVCD_swtCtlState /end OUT_MEASUREMENT /end FUNCTION
/begin FUNCTION pcvcd_co_uic ""
 /begin OUT_MEASUREMENT PCVCD_dcycDT1_mp PCVCD_dcycOut_mp PCVCD_dcycSetVal_mp PCVCD_facIGov_mp PCVCD_iActFlt_mp PCVCD_iDvt_mp PCVCD_iGovActVal_mp PCVCD_iSetFlt_mp PCVCD_uRawVal_mp /end OUT_MEASUREMENT
/end FUNCTION
/begin FUNCTION pcv_leak "Leckage des Druckregelventils" /begin DEF_CHARACTERISTIC PCV_dvolLeak_CUR /end DEF_CHARACTERISTIC /begin IN_MEASUREMENT Rail_pSetPoint /end IN_MEASUREMENT /end FUNCTION
/begin FUNCTION pcv_leak_uic "" /begin OUT_MEASUREMENT PCV_dvolLeak_mp /end OUT_MEASUREMENT /end FUNCTION
/begin FUNCTION pcv_msg "" /end FUNCTION
/begin FUNCTION pcv_setcurr "Berechnung elektrischer Sollstrom für das Druckregelventil" /begin DEF_CHARACTERISTIC PCV_iCnvPress_CUR PCV_iSetMin_C /end DEF_CHARACTERISTIC /begin IN_MEASUREMENT Rail_pPCVSet /end IN_MEASUREMENT /end FUNCTION
/begin FUNCTION pcv_setcurr_uic "" /begin DEF_CHARACTERISTIC PCV_iSet_Vector PCV_iSet_Channel /end DEF_CHARACTERISTIC /begin OUT_MEASUREMENT PCV_iSet_mp PCV_stActrCtl_mp /end OUT_MEASUREMENT /end FUNCTION
/begin FUNCTION pfltcd_getppre "Absolutdruck vor dem Partikelfilter"
 /begin DEF_CHARACTERISTIC PFltCD_uSRCMinPPre_C PFltCD_uSRCMaxPPre_C PFltCD_pLinPre_CUR PFltCD_DebSRCHiDefPPre_C PFltCD_DebSRCHiOkPPre_C PFltCD_DebSRCLoDefPPre_C PFltCD_DebSRCLoOkPPre_C PFltCD_dtRmpSlpUpPPre_C PFltCD_dtRmpSlpDwnPPre_C PFLTCD_numAdc2_C PFltCD_pPreCor_CUR PFltCD_tiPPrePT1_C PFltCD_stSensIDWordPPre_C PFltCD_pDflPre_C /end DEF_CHARACTERISTIC
 /begin IN_MEASUREMENT PFltCD_uRawPresPre_mp PFlt_dvol /end IN_MEASUREMENT
/end FUNCTION
/begin FUNCTION pfltcd_getppre_msg "" /begin OUT_MEASUREMENT PFltCD_pLinPre PFltCD_pPre /end OUT_MEASUREMENT /end FUNCTION
/begin FUNCTION pfltcd_getppre_uic "" /begin OUT_MEASUREMENT PFltCD_uRawPresPre_mp /end OUT_MEASUREMENT /end FUNCTION
/begin FUNCTION pfltcd_gettpre "Abgastemperatur vor dem Partikelfilter"
 /begin DEF_CHARACTERISTIC PFltCD_uSRCMinTempPre_C PFltCD_uSRCMaxTempPre_C PFltCD_tLinPre_CUR PFltCD_DebSRCHighDefTPre_C PFltCD_DebSRCHighOkTPre_C PFltCD_DebSRCLowDefTPre_C PFltCD_DebSRCLowOkTPre_C PFltCD_dtRmpSlpUpPre_C PFltCD_dtRmpSlpDwnPre_C PFLTCD_numAdc_C PFltCD_tPreCor_CUR PFltCD_stSensIDWordTPre_C PFltCD_tDflPre_C /end DEF_CHARACTERISTIC
 /begin IN_MEASUREMENT PFltCD_uRawTempPre PFlt_dmEG /end IN_MEASUREMENT
/end FUNCTION
/begin FUNCTION pfltcd_gettpre_msg "" /begin OUT_MEASUREMENT PFltCD_tLinPre PFltCD_tPre PFltCD_uRawTempPre /end OUT_MEASUREMENT /end FUNCTION
/begin FUNCTION pflt_ashcor ""
 /begin DEF_CHARACTERISTIC PFlt_aVehFltAshCorMax_C PFlt_aVehFltAshCorMin_C PFlt_ctAshCorRgnMax_C PFlt_ctAshCorRgn_C PFlt_facAshCorOld_C PFlt_facAshOil_C PFlt_facFlTotCor_C PFlt_faclAshCor_C PFlt_lAshCorMax_C PFlt_lAshCorNextDef_C PFlt_lAshCorNplAbsRel_C PFlt_lAshCorNplAbs_C PFlt_lAshCorNplRel_C PFlt_lAshCorRegIntr_C PFlt_lMinSnceRgn_C PFlt_mAshCor_MAP PFlt_mAshTolcAbs_C PFlt_mAshTolcMaxAbs_C PFlt_mAshTolcMaxRel_C PFlt_nAvrgFltAshCorMax_C PFlt_nAvrgFltAshCorMin_C PFlt_numAshCorMsk_C PFlt_numAshCor_C PFlt_numPFltErrRgnIntr_C PFlt_numPFltErr_C PFlt_qFlTotMin_C PFlt_qSetUnBalFltAshCorMax_C PFlt_qSetUnBalFltAshCorMin_C PFlt_swtAshCorActive_C PFlt_swtAshCorOn_C PFlt_tAirFltAshCorMax_C PFlt_tAirFltAshCorMin_C PFlt_tCIntAshCorMax_C PFlt_tCIntAshCorMin_C PFlt_tiAshCorAirTempPT1_C PFlt_tiAshCorCIntTempPT1_C PFlt_tiAshCorDVolPT1_C PFlt_tiAshCorEngSpdPT1_C PFlt_tiAshCorInjMsPT1_C PFlt_tiAshCorOxiTempPT1_C PFlt_tiAshCorPreTempPT1_C PFlt_tiAshCorResFlowPT1_C PFlt_tiAshCorRlsOn_C PFlt_tiAshCorVehAccPT1_C PFlt_tiAshCorVehSpdPT1_C PFlt_tiAshCorWaitMax_C PFlt_tiPFltErrPer_C PFlt_tiPFltErrRgn_C PFlt_tOxiPreFltAshCorMax_C PFlt_tOxiPreFltAshCorMin_C PFlt_tPreFltAshCorMax_C PFlt_tPreFltAshCorMin_C PFlt_vVehFltAshCorMax_C PFlt_vVehFltAshCorMin_C /end DEF_CHARACTERISTIC
 /begin IN_MEASUREMENT PFlt_dVolFltAshCor_mp PFlt_resFlowFltAshCor_mp /end IN_MEASUREMENT
/end FUNCTION
/begin FUNCTION pflt_ashcor_msg ""
 /begin OUT_MEASUREMENT PFlt_lAshCorNext PFlt_mAshCorAct PFlt_mAshCorNew PFlt_mAshCorOld PFlt_numPrj PFlt_qFlTotCor PFlt_stAshCorRgnMax /end OUT_MEASUREMENT
/end FUNCTION
/begin FUNCTION pflt_ashcor_uic ""
 /begin OUT_MEASUREMENT PFlt_aVehFltAshCor_mp PFlt_ctNumAshCorMax_mp PFlt_ctNumAshCor_mp PFlt_dqFlTotAct_mp PFlt_dqFlTotEnd_mp PFlt_dVolFltAshCorRaw_mp PFlt_dVolFltAshCor_mp PFlt_facAshCorDiff_mp PFlt_lAshCorAct_mp PFlt_lAshCorNextEEProm_mp PFlt_lAshCorNextMax_mp PFlt_lAshCorNextOilCor_mp PFlt_lAshCorOldCalc_mp PFlt_lAshCorStep_mp PFlt_mAshCorActRel_mp PFlt_mAshCorDiff1_mp PFlt_mAshCorDiff2_mp PFlt_mAshCorDiff_mp PFlt_nAvrgFltAshCor_mp PFlt_qSetUnBalFltAshCor_mp PFlt_resFlowFltAshCorRaw_mp PFlt_resFlowFltAshCor_mp PFlt_stAshCorCalc_mp PFlt_stAshCorDist_mp PFlt_stAshCorRgn_mp PFlt_stAshCorRlsOn_mp PFlt_stAshCorRls_mp PFlt_stAshCor_mp PFlt_stFlTotCorOn_mp PFlt_stFlTotCor_mp PFlt_stPFltErr_mp PFlt_tAirFltAshCor_mp PFlt_tCIntFltAshCor_mp PFlt_tiPFltErr_mp PFlt_tOxiPreFltAshCor_mp PFlt_tPreFltAshCor_mp PFlt_vVehFltAshCor_mp /end OUT_MEASUREMENT
/end FUNCTION
/begin FUNCTION pflt_corgn "Partikelfilterregenerationskoordinator"
 /begin DEF_CHARACTERISTIC PFlt_lSnceRgnIntr_CA PFlt_lSumMaxDef_C PFlt_lSumMax_C PFlt_lSumSubs_C PFlt_mSotMeas_CUR PFlt_mSotNewRng1_C PFlt_mSotRng1New_C PFlt_mSotRng1Rng2_C PFlt_mSotRng2Rng1_C PFlt_mSotRng2Rng3_C PFlt_mSotRng3Rng2_C PFlt_mSotRng3Rng4_C PFlt_mSotRng4Rng3_C PFlt_mSotRng4Rng5_C PFlt_mSotRng5Rng4_C PFlt_numEngPOpDel_CA PFlt_numEngPOp_CA PFlt_numLst_C PFlt_numPrioRgnStg1_C PFlt_numPrioRgnStg2_C PFlt_numPrioRgnStg3_C PFlt_numPrioRgnStg4_C PFlt_numPrioRgnStg5_C PFlt_numPrioRgnStg6_C PFlt_numPrioRgnStgDiag_C PFlt_numPrt_C PFlt_numRgnSuc_C PFlt_pEngPrtMaxInit_C PFlt_pEngPrtMax_MAP PFlt_pEngPrtMin_MAP PFlt_qFlMaxDef_C PFlt_qFlMax_CUR PFlt_qFlSubs_C PFlt_qFlTotAdjMax_C PFlt_stDiagOn_C PFlt_stLckFuelMsk_C PFlt_stLckRgnMsk_C PFlt_stMinDistRgn_C PFlt_stRgnActvMsk_C PFlt_stRgnStg1_C PFlt_stRgnStg2_C PFlt_stRgnStg3_C PFlt_stRgnStg4_C PFlt_stRgnStg5_C PFlt_stRgnStg6_C PFlt_stRgnSucMsk_C PFlt_swtDiagOn_C PFlt_swtOfsCor_C PFlt_swtServiceVal_C Pflt_swtShOffSuc_C PFlt_swtTmrLckRst_C PFlt_tiDebLck_C PFlt_tiDebQLimErrIntr_C PFlt_tiDebTrqOvhtIntr_C PFlt_tiEngOnMaxDef_C PFlt_tiEngOnMax_C PFlt_tiEngPrtPT1_C PFlt_tiEngPrt_C PFlt_tiLckRgnErr_CA PFlt_tiLckRgn_CA PFlt_tiLckSubs_C PFlt_tiLstRgn_C PFlt_tiOpSubs_C PFlt_tiRgnMax_CA PFlt_tiRgnSpo_C PFlt_tOxiPreMaxHi_C PFlt_tOxiPreMaxLo_C PFlt_tPreMaxHi_C PFlt_tPreMaxLo_C PFlt_volFlConsumSubs_C PFlt_volFuelFilMinHi_C PFlt_volFuelFilMinLo_C /end DEF_CHARACTERISTIC
 /begin IN_MEASUREMENT Eng_nAvrg InjCtl_qSetUnBal PFlt_mAshOil PFlt_numRgn_mp PFlt_resFlowOfs PFlt_stEngPOp /end IN_MEASUREMENT
/end FUNCTION
/begin FUNCTION pflt_corgn_msg ""
 /begin OUT_MEASUREMENT PFlt_lSnceRgn PFlt_numEngPOp PFlt_numPrio PFlt_numRgn PFlt_numTot PFlt_qFlTot PFlt_st PFlt_stDiagOn PFlt_stEngPrtActv PFlt_stLck PFlt_stSuc PFlt_tiSnceRgn /end OUT_MEASUREMENT
/end FUNCTION
/begin FUNCTION pflt_corgn_uic "" /begin DEF_CHARACTERISTIC PFlt_st_Vector PFlt_st_Channel /end DEF_CHARACTERISTIC
 /begin OUT_MEASUREMENT PFlt_lSnceRgnu16_mp PFlt_lSnceRgn_mp PFlt_lSumu16_mp PFlt_lSum_mp PFlt_mSotOfs_mp PFlt_numLst_mp PFlt_numPrt_mp PFlt_numRgn_mp PFlt_numSot_mp PFlt_numTot_mp PFlt_pEngPrtMax_mp PFlt_pEngPrtMin_mp PFlt_qFlTotEEPROM_mp PFlt_qFl_mp PFlt_resSotMeasCrv_mp PFlt_st1_mp PFlt_st2_mp PFlt_stCnt_mp PFlt_stIntr_mp PFlt_stLckFuel_mp PFlt_stLck_mp PFlt_stLstRgnEnd_mp PFlt_stLstRgn_mp PFlt_stNumEngPOpDelOn_mp PFlt_stSuc_mp PFlt_tiLckRls_mp PFlt_tiOpu16_mp PFlt_tiOp_mp PFlt_tiRgnMax_mp PFlt_tiSnceRgnu16_mp /end OUT_MEASUREMENT
/end FUNCTION
/begin FUNCTION pflt_diag "Diagnose für den Partikelfilter"
 /begin DEF_CHARACTERISTIC PFlt_mDiagAFSMax_C PFlt_mDiagAFSMin_C PFlt_mDiagSotMax_C PFlt_mDiagSotMin_C PFlt_nDiagLowIdle1_C PFlt_nDiagLowIdle2_C PFlt_nDiagLowIdle_C PFlt_nDiagMax_C PFlt_nDiagMin_C PFlt_nDiagRgnMax_C PFlt_nDiagRgnMin_C PFlt_pAPSDiag_C PFlt_pDiagBPSMax_C PFlt_pDiagBPSMin_C PFlt_qDiagPOpMax_CUR PFlt_qDiagPOpMin_CUR PFlt_rDiagAccPedMax_C PFlt_rDiagTVAMax_C PFlt_rDiagTVAMin_C PFlt_stDiagAbortMsk_C PFlt_stDiagMskRgnAbort_C PFlt_stDiagMskTst10_C PFlt_stDiagMskTst1_C PFlt_stDiagMskTst2_C PFlt_stDiagMskTst3_C PFlt_stDiagMskTst4_C PFlt_stDiagMskTst5_C PFlt_stDiagMskTst6_C PFlt_stDiagMskTst7_C PFlt_stDiagMskTst8_C PFlt_stDiagMskTst9_C PFlt_stDiagMsk_C PFlt_stDiagRgnMsk_C PFlt_stRgnDiagStg1_C PFlt_stRgnDiagStg2_C PFlt_stRgnDiagStg3_C PFlt_tDiagDpfAbrtMax_C PFlt_tDiagDpfCoolDwn_C PFlt_tDiagDpfHeatup_C PFlt_tDiagDpfMax_C PFlt_tDiagDpfPreRgnMin_C PFlt_tDiagOxiAbrtMax_C PFlt_tDiagOxiCoolDwn_C PFlt_tDiagOxiHeatup_C PFlt_tDiagOxiMax_C PFlt_tDiagOxiMin_C PFlt_tDiagOxiPreMax_C PFlt_tDiagOxiPreRgnMin_C PFlt_tDiagPFltMax_C PFlt_tDiagPFltMin_C PFlt_tEngDiagMinH_C PFlt_tEngDiagMinL_C PFlt_tFltDiagMax_C PFlt_tiDiagCoolDwnMax_C PFlt_tiDiagDpfMax_C PFlt_tiDiagNormal_C PFlt_tiDiagOxiMax_C PFlt_tiDiagRgnEnd_C PFlt_tiDiagRgnHeatup_C PFlt_tiDiagRgnLidIMin_C PFlt_tiGetRgnSt_C PFlt_tiStpRgn_C PFlt_tOilDiagMinH_C PFlt_tOilDiagMinL_C PFlt_uDiagMin_C /end DEF_CHARACTERISTIC
 /begin IN_MEASUREMENT Eng_nAvrg /end IN_MEASUREMENT
/end FUNCTION
/begin FUNCTION pflt_diag_msg ""
 /begin OUT_MEASUREMENT PFlt_nDiagLowIdle PFlt_stDiag PFlt_stDiagAbort PFlt_stDiagAbortMsk PFlt_stDiagDemOn PFlt_stDiagMsk PFlt_stDiagRgn PFlt_stDiagRgnMsk PFlt_stDiagRls PFlt_stDiagState PFlt_stDiagSuc /end OUT_MEASUREMENT
/end FUNCTION
/begin FUNCTION pflt_diag_uic ""
 /begin OUT_MEASUREMENT PFlt_stDiagAbrt1_mp PFlt_stDiagAbrt2_mp PFlt_stDiagCoolDwn_mp PFlt_stDiagEnd_mp PFlt_stDiagRgn_mp PFlt_stDiagRls_mp /end OUT_MEASUREMENT
/end FUNCTION
/begin FUNCTION pflt_engpopcalc "Betriebszustandsberechnung für Partikelfilter"
 /begin DEF_CHARACTERISTIC PFlt_nAvrgMinMax_CA PFlt_numPOpAir_C PFlt_numPOpClnt_C PFlt_qSetUnBalRng10Max_GCUR PFlt_qSetUnBalRng10Min_GCUR PFlt_qSetUnBalRng1Max_GCUR PFlt_qSetUnBalRng1Min_GCUR PFlt_qSetUnBalRng2Max_GCUR PFlt_qSetUnBalRng2Min_GCUR PFlt_qSetUnBalRng3Max_GCUR PFlt_qSetUnBalRng3Min_GCUR PFlt_qSetUnBalRng4Max_GCUR PFlt_qSetUnBalRng4Min_GCUR PFlt_qSetUnBalRng5Max_GCUR PFlt_qSetUnBalRng5Min_GCUR PFlt_qSetUnBalRng6Max_GCUR PFlt_qSetUnBalRng6Min_GCUR PFlt_qSetUnBalRng7Max_GCUR PFlt_qSetUnBalRng7Min_GCUR PFlt_qSetUnBalRng8Max_GCUR PFlt_qSetUnBalRng8Min_GCUR PFlt_qSetUnBalRng9Max_GCUR PFlt_qSetUnBalRng9Min_GCUR PFlt_qSetUnBalRngSpoMax_GCUR PFlt_qSetUnBalRngSpoMin_GCUR PFlt_qSetUnBal_AXIS PFlt_rAccPedMinMax_CA PFlt_stGearDebValMax_C PFlt_stGearDebValMin_C PFlt_stGearMinMax_CA PFlt_swtBrkRng_CA PFlt_swtClthRng_CA PFlt_tAirMinMax_CA PFlt_tClntMinMax_CA PFlt_tiAccPedPT1_C PFlt_tiBattCDPT1_C PFlt_tiDebBrkOff_C PFlt_tiDebBrkOn_C PFlt_tiDebConvOff_C PFlt_tiDebConvOn_C PFlt_tiDebGearOff_C PFlt_tiDebGearOn_C PFlt_tiEngSpdPT1_C PFlt_tiInjMsPT1_C PFlt_tiSpdVehPT1_C PFlt_tiTempClntPT1_C PFlt_tiTempOxiPrePT1_C PFlt_tiTempPrePT1_C PFlt_tOxiPreOffMinMax_CA PFlt_tOxiPreOnMinMax_CA PFlt_tPreOffMinMax_CA PFlt_tPreOnMinMax_CA PFlt_uBattMinMax_CA PFlt_vVehMinMax_CA /end DEF_CHARACTERISTIC
 /begin IN_MEASUREMENT PFlt_nAvrgFlt_mp PFlt_RngIdx_X_mp PFlt_RngIdx_Y_mp /end IN_MEASUREMENT
/end FUNCTION
/begin FUNCTION pflt_engpopcalc_msg "" /begin OUT_MEASUREMENT PFlt_stEngPOp /end OUT_MEASUREMENT /end FUNCTION
/begin FUNCTION pflt_engpopcalc_uic "" /begin DEF_CHARACTERISTIC PFlt_stEngPOp_Vector PFlt_stEngPOp_Channel /end DEF_CHARACTERISTIC
 /begin OUT_MEASUREMENT PFlt_nAvrgFlt_mp PFlt_qSetUnBalFlt_mp PFlt_rAccPedFlt_mp PFlt_RngIdx_X_mp PFlt_RngIdx_Y_mp PFlt_stBrkDeb_mp PFlt_stClthDeb_mp PFlt_stEngPOp10_mp PFlt_stEngPOp1_mp PFlt_stEngPOp2_mp PFlt_stEngPOp3_mp PFlt_stEngPOp4_mp PFlt_stEngPOp5_mp PFlt_stEngPOp6_mp PFlt_stEngPOp7_mp PFlt_stEngPOp8_mp PFlt_stEngPOp9_mp PFlt_stEngPOpSpo_mp PFlt_stGearDeb_mp PFlt_stRng10_mp PFlt_stRng1_mp PFlt_stRng2_mp PFlt_stRng3_mp PFlt_stRng4_mp PFlt_stRng5_mp PFlt_stRng6_mp PFlt_stRng7_mp PFlt_stRng8_mp PFlt_stRng9_mp PFlt_stRngSpo_mp PFlt_tClntFlt_mp PFlt_tOxiPreFlt_mp PFlt_tPOpAir_mp PFlt_tPOpClnt_mp PFlt_tPreFlt_mp PFlt_uBattCDFlt_mp PFlt_vVehFlt_mp /end OUT_MEASUREMENT
/end FUNCTION
/begin FUNCTION pflt_engpopprj "Erweiterung für Betriebszustandsberechnung" /begin DEF_CHARACTERISTIC PFlt_vVehUnFltMinMax_CA /end DEF_CHARACTERISTIC /begin IN_MEASUREMENT PFlt_RngIdxPrj_X_mp PFlt_RngIdxPrj_Y_mp /end IN_MEASUREMENT /end FUNCTION
/begin FUNCTION pflt_engpopprj_msg "" /begin OUT_MEASUREMENT PFlt_stEngPOpPrj /end OUT_MEASUREMENT /end FUNCTION
/begin FUNCTION pflt_engpopprj_uic ""
 /begin OUT_MEASUREMENT PFlt_RngIdxPrj_X_mp PFlt_RngIdxPrj_Y_mp PFlt_vVehUnFltMax_mp PFlt_vVehUnFltMin_mp /end OUT_MEASUREMENT
/end FUNCTION
/begin FUNCTION pflt_exhgsppty "dvol + Lambda" /begin DEF_CHARACTERISTIC PFlt_numLSU_C PFlt_swtASModOn_C PFlt_swtLmbdAprx_C /end DEF_CHARACTERISTIC /end FUNCTION
/begin FUNCTION pflt_exhgsppty_msg ""
 /begin OUT_MEASUREMENT PFlt_dmEG PFlt_dmO2Aprx PFlt_dvol PFlt_qPoI2NonEff PFlt_rLmbd /end OUT_MEASUREMENT
/end FUNCTION
/begin FUNCTION pflt_exhgsppty_uic "" /begin DEF_CHARACTERISTIC PFlt_dvol_Vector PFlt_dvol_Channel /end DEF_CHARACTERISTIC /begin OUT_MEASUREMENT PFlt_rLmbdAprx_mp /end OUT_MEASUREMENT /end FUNCTION
/begin COMPU_METHOD Acc "Fahrzeugbeschleunigung" RAT_FUNC "%6.5" "m/s^2" COEFFS 0 1000 0 0 0 1 /end COMPU_METHOD
/begin COMPU_METHOD AirMassPerCyl "Luftmasse pro Zylinder" RAT_FUNC "%6.3" "mg/Hub" COEFFS 0 10 0 0 0 1 /end COMPU_METHOD
/begin COMPU_METHOD AirMassPerTime "Luftmasse pro Zeit" RAT_FUNC "%6.3" "Kg/h" COEFFS 0 10 0 0 0 1 /end COMPU_METHOD
/begin COMPU_METHOD CubMtrPerHr "Volumsstrom in m^3/h" RAT_FUNC "%6.3" "m^3/h" COEFFS 0 10 0 0 0 1 /end COMPU_METHOD
/begin COMPU_METHOD Curr "Strom" RAT_FUNC "%6.2" "mA" COEFFS 0 1 0 0 0 1 /end COMPU_METHOD
/begin COMPU_METHOD dn_dZ20 "Motorbeschleunigung pro Zeit (dn/dt) (im 20 ms Raster)" RAT_FUNC "%6.1" "rmp/s" COEFFS 0 0.1 0 0 0 1 /end COMPU_METHOD
/begin COMPU_METHOD DtyCyc "Tastverhaeltnis" RAT_FUNC "%6.4" "%" COEFFS 0 100 0 0 0 1 /end COMPU_METHOD
/begin COMPU_METHOD EngN "Motordrehzahl" RAT_FUNC "%6.2" "rpm" COEFFS 0 1 0 0 0 1 /end COMPU_METHOD
/begin COMPU_METHOD EngTempFldSel "Verbale Umrechnung für Auswahl aus dem Motortemperatur-Feld Eng_tFld" TAB_VERB "%6.3" "-" COMPU_TAB_REF EngTempFldSel /end COMPU_METHOD
/begin COMPU_VTAB EngTempFldSel "Verbale Umrechnung für Auswahl aus dem Motortemperatur-Feld Eng_tFld" TAB_VERB 3 0 "Coolant_Temperature" 1 "Oil_Temperature" 2 "Eng_tEng" /end COMPU_VTAB
/begin COMPU_METHOD Fact "Faktor mit Auflösung 1 / 8192, hauptsächlich für einen Faktorenbereich 0...1 verwendet" RAT_FUNC "%6.5" "-" COEFFS 0 8192 0 0 0 1 /end COMPU_METHOD
/begin COMPU_METHOD Fact1 "Faktor mit Auflösung 0,01 (100 mal höherer Bereich als Fact)" RAT_FUNC "%6.4" "-" COEFFS 0 128 0 0 0 1 /end COMPU_METHOD
/begin COMPU_METHOD FactM "Low resolution factor for airmass" RAT_FUNC "%6.4" "-" COEFFS 0 16 0 0 0 1 /end COMPU_METHOD
/begin COMPU_METHOD Fl_2 "Umrechnung for getting 16 bit  total fuel consumption" RAT_FUNC "%6.1" "l" COEFFS 0 0.1 0 0 0 1 /end COMPU_METHOD
/begin COMPU_METHOD Fl_Half_L "Kraftstoffverbrauchsintegral" RAT_FUNC "%6.4" "l" COEFFS 0 20 0 0 0 1 /end COMPU_METHOD
/begin COMPU_METHOD Fl_L "Treibstoffmenge [l]" RAT_FUNC "%6.4" "l" COEFFS 0 100 0 0 0 1 /end COMPU_METHOD
/begin COMPU_METHOD Fl_Vol "Kraftstoffverbrauch pro 100 km" RAT_FUNC "%6.5" "l/100km" COEFFS 0 1000 0 0 0 1 /end COMPU_METHOD
/begin COMPU_METHOD IndSysTempFldSel "Auswahl für Lufttemperaturfeld" TAB_VERB "%6.3" "-" COMPU_TAB_REF IndSysTempFldSel /end COMPU_METHOD
/begin COMPU_VTAB IndSysTempFldSel "Auswahl für Lufttemperaturfeld" TAB_VERB 3 0 "IATSCD_tAir" 1 "AFSCD_tAir" 2 "EATSCD_tAir" /end COMPU_VTAB
/begin COMPU_METHOD InjMass "Einspritzmenge" RAT_FUNC "%6.4" "mg/hub" COEFFS 0 100 0 0 0 1 /end COMPU_METHOD
/begin COMPU_METHOD InjMassCyc "Einspritzmenge pro Zyklus (mg/Zyklus)" RAT_FUNC "%6.4" "mg/cyc" COEFFS 0 100 0 0 0 1 /end COMPU_METHOD
/begin COMPU_METHOD InjMassPerSec_20ms "Einspritzmengenänderung pro Sekunde für 20ms-Tasks" RAT_FUNC "%6.3" "mg/hub/s" COEFFS 0 2 0 0 0 1 /end COMPU_METHOD
/begin COMPU_METHOD Kd "Differentialverstärkung Kd (gleiche Einheit/Umrechnungsformel an Ein- und Ausgang)" RAT_FUNC "%7.6" "1/1" COEFFS 0 65536 0 0 0 1 /end COMPU_METHOD
/begin COMPU_METHOD Ki_curr2fact "Integralverstärkung (Strom Curr zu Faktor Fact)" RAT_FUNC "%10.9" "1/mA*s" COEFFS 0 35184372.088832 0 0 0 1 /end COMPU_METHOD
/begin COMPU_METHOD Ki_Pres_fac2hPa "Gain Conversion from Factor to Hpa" RAT_FUNC "%6.4" "hPa/s" COEFFS 0 268.435456 0 0 0 1 /end COMPU_METHOD
/begin COMPU_METHOD Kp_Pres_fac2hPa "Gain Conversion from Factor to Hpa" RAT_FUNC "%6.5" "hPa" COEFFS 0 4096 0 0 0 1 /end COMPU_METHOD
/begin COMPU_METHOD lambda "Lambda" RAT_FUNC "%6.5" "-" COEFFS 0 1000 0 0 0 1 /end COMPU_METHOD
/begin COMPU_METHOD Length "Länge in Meter" RAT_FUNC "%6.2" "m" COEFFS 0 1 0 0 0 1 /end COMPU_METHOD
/begin COMPU_METHOD LengthKm "Länge in Kilometer" RAT_FUNC "%6.2" "km" COEFFS 0 1 0 0 0 1 /end COMPU_METHOD
/begin COMPU_METHOD lSnceRgnRes "Driven distance since last successful regeneration" RAT_FUNC "%6.0" "m" COEFFS 0 0.0078125 0 0 0 1 /end COMPU_METHOD
/begin COMPU_METHOD lSumRes "Total driven distance" RAT_FUNC "%8.0" "m" COEFFS 0 6.103515625e-05 0 0 0 1 /end COMPU_METHOD
/begin COMPU_METHOD mSoot_g "Rußmasse [g]" RAT_FUNC "%6.4" "g" COEFFS 0 100 0 0 0 1 /end COMPU_METHOD
/begin COMPU_METHOD NumPinAdc "verbale Umrechnung für ADC Signale" TAB_VERB "%6.3" "-" COMPU_TAB_REF NumPinAdc /end COMPU_METHOD
/begin COMPU_VTAB NumPinAdc "verbale Umrechnung für ADC Signale" TAB_VERB 47 0 "Water_Temperature_Sensor_182" 1 "Intake_Air_Temperature_Sensor_157" 2 "Charge_Air_Temperature_Sensor_183" 3 "Exhaust_Temperature_Sensor_2_134" 4 "Exhaust_Temperature_Sensor_1_158" 5 "1st_APP_Sensor_252" 6 "2nd_APP_Sensor_239" 7 "ADC_REF" 8 "Boost_Pressure_Sensor_154" 9 "Atmospheric_Pressure_Sensor" 10 "Battery_Voltage_Sensor" 11 "Rail_Pressure_Sensor_156" 12 "Rail_Pressure_Peak_Value_156" 13 "Booster_Voltage_Sensor" 14 "Current_MeUn_Sensor" 15 "Current_PCV_Sensor" 16 "Voltage_Bank_1" 17 "Voltage_Bank_2" 18 "Pressure_Upstream_Particle_Filter_159" 19 "Engine_Oil_Pressure_110" 20 "Temperature_ECU_PCB" 21 "Voltage_Lambda_Ua" 22 "Voltage_Lambda_Ri" 23 "EMCCD_Current_Governor1_124" 24 "EMCCD_Current_Governor2_121" 25 "ADC_DUMMY_A_NOT_USED" 26 "ADC_DUMMY_NOT_USED" 27 "Charge_Actuator_Event_0" 28 "Voltage_Piezo_Actuator_Bank_2_Event_0" 29 "Voltage_Piezo_Actuator_Bank_1_Event_0" 30 "Charge_Actuator_Event_1" 31 "Voltage_Piezo_Actuator_Bank_2_Event_1" 32 "Voltage_Piezo_Actuator_Bank_1_Event_1" 33 "Charge_Actuator_Event_2" 34 "Voltage_Piezo_Actuator_Bank_2_Event_2" 35 "Voltage_Piezo_Actuator_Bank_1_Event_2" 36 "Charge_Actuator_Event_3" 37 "Voltage_Piezo_Actuator_Bank_2_Event_3" 38 "Voltage_Piezo_Actuator_Bank_1_Event_3" 39 "Charge_Actuator_Event_4" 40 "Voltage_Piezo_Actuator_Bank_2_Event_4" 41 "Voltage_Piezo_Actuator_Bank_1_Event_4" 42 "Charge_Actuator_Event_5" 43 "Voltage_Piezo_Actuator_Bank_2_Event_5" 44 "Voltage_Piezo_Actuator_Bank_1_Event_5" 45 "Booster_Voltage_Piezo" 46 "Piezo_Voltage" /end COMPU_VTAB
/begin COMPU_METHOD NumPinDia "Verbale Umrechnung für Diagnose Signale" TAB_VERB "%6.3" "-" COMPU_TAB_REF NumPinDia /end COMPU_METHOD
/begin COMPU_VTAB NumPinDia "Verbale Umrechnung für Diagnose Signale" TAB_VERB 36 0 "CJ945_Diagnostic_Signal" 1 "AC_Compressor_DiaSig" 2 "Fuel_Pump_DiaSig" 3 "Starter_234" 4 "Oil_Pressure_Lamp_Switch_245" 5 "Engine_Bay_Air_Flaps_123" 6 "Glow_Relay_Diagnostic_Signal1" 7 "reserved Glow_Relay_Diagnostic_Signal2" 8 "Ebox_Fan_Actuator_Diagnostic_Signal_219" 9 "Dummy_Actuator_Diagnostic_Signal" 10 "Twostage_TurboLoading_SW_DiaSig" 11 "DIO_OUT_DIAGNOSTIC_DUMMY_NOT_USED" 12 "1st_Pressure_Control_Valve_Diagnostic_Signal_172" 13 "2nd_Pressure_Control_Valve_Diagnostic_Signal_172" 14 "1st_Metering_Unit_Diagnostic_Signal_171" 15 "2nd_Metering_Unit_Diagnostic_Signal_171" 16 "Boost_Pressure_Actuator_Diagnostic_Signal_193" 17 "Boost_Pressure_Actuator_Diagnostic_Signal_193_2" 18 "EGR_Actuator_Diagnostic_Signal_194" 19 "EGR_Actuator_Diagnostic_Signal2" 20 "Variable_Swirl_Actuator_Diagnostic_Signal_195" 21 "Throttle_Valve_Diagnostic_Signal_196" 22 "Throttle_Valve2_Diagnostic_Signal_196" 23 "FAN_240" 24 "Add_On_Heater_244" 25 "EngM_Bearing_Actuator_Diagnostic_Signal_124" 26 "EngM_Bearing_Actuator_Diagnostic_Signal_121" 27 "Low pressure stage BPA_Diagnostic_Signal_117" 28 "Shuttr_Actuator_Diagnostic_Signal_231" 29 "PWM_DIAGNOSTIC_DUMMY_NOT_USED" 30 "1st_Sensor_Supply_Voltage_DiaSig" 31 "2nd_Sensor_Supply_Voltage_DiaSig" 32 "3rd_Sensor_Supply_Voltage_DiaSig" 33 "4th_Sensor_Supply_Voltage_DiaSig" 34 "5th_Sensor_Supply_Voltage_DiaSig" 35 "6th_Sensor_Supply_Voltage_DiaSig" /end COMPU_VTAB
/begin COMPU_METHOD NumPinPwmOut "Verbale Umrechnung für PWM-Ausgang Signale" TAB_VERB "%6.3" "-" COMPU_TAB_REF NumPinPwmOut /end COMPU_METHOD
/begin COMPU_VTAB NumPinPwmOut "Verbale Umrechnung für PWM-Ausgang Signale" TAB_VERB 14 0 "Boost_Pressure_Actuator_193" 1 "EGR_Actuator_194" 2 "PCV_Actuator_172" 3 "MeUn_Actuator_171" 4 "Variable_Swirl_Actuator_195" 5 "Fan_Actuator_240" 6 "Add_On_Heater_244" 7 "EngM_Bearing_Actuator_124" 8 "EngM_Bearing_Actuator_121" 9 "Throttle_Valve_196" 10 "LSU_Heater_PWMOutput" 11 "Low pressure stage BPA_117" 12 "Shuttr_Actuator_PWM_231" 13 "PWM_DUMMY_NOT_USED" /end COMPU_VTAB
/begin COMPU_METHOD OneToOne "eins zu eins (physikalischer Wert ist gleich dem internen Wert)" RAT_FUNC "%6.2" "-" COEFFS 0 1 0 0 0 1 /end COMPU_METHOD
/begin COMPU_METHOD Period "Periodendauer" RAT_FUNC "%6.3" "ms" COEFFS 0 10 0 0 0 1 /end COMPU_METHOD
/begin COMPU_METHOD Prc "Prozent, gleiche interne Auflösung wie Fact, aber Darstellung in Prozent (0...100%)" RAT_FUNC "%6.4" "%" COEFFS 0 81.92 0 0 0 1 /end COMPU_METHOD
/begin COMPU_METHOD Pres "Druck (angezeigt in [kPa])" RAT_FUNC "%7.2" "hPa" COEFFS 0 1.000000 0 0 0 1 /end COMPU_METHOD
/begin COMPU_METHOD Pres_hPa "Druck (angezeigt in [hPa])" RAT_FUNC "%6.2" "hPa" COEFFS 0 1 0 0 0 1 /end COMPU_METHOD
/begin COMPU_METHOD Pres_Rail "Raildruck in hPa" RAT_FUNC "%4.3" "bar" COEFFS 0 10.000000 0 0 0 1 /end COMPU_METHOD
/begin COMPU_METHOD Qp_mm3_sec "Umrechnung für Volumenstrom" RAT_FUNC "%6.1" "mm3/s" COEFFS 0 0.1 0 0 0 1 /end COMPU_METHOD
/begin COMPU_METHOD Resist_1 "1. Widerstandsvariante" RAT_FUNC "%6.2" "mOhm" COEFFS 0 1 0 0 0 1 /end COMPU_METHOD
/begin COMPU_METHOD Res_hPaHrPerCM "Strömungswiderstand [hPa h/m3]" RAT_FUNC "%6.5" "hPa/(m^3/h)" COEFFS 0 1000 0 0 0 1 /end COMPU_METHOD
/begin COMPU_METHOD RmpPrc "Prozent Rampengradient" RAT_FUNC "%6.5" "%/s" COEFFS 0 5368.70912 0 0 0 1 /end COMPU_METHOD
/begin COMPU_METHOD RmpPres "Rampengradient für Druck" RAT_FUNC "%7.3" "hPa/s" COEFFS 0 65.536000 0 0 0 1 /end COMPU_METHOD
/begin COMPU_METHOD RmpPres_hPa "Rampengradient für Druck angezeigt in [hPa/s]" RAT_FUNC "%6.4" "hPa/s" COEFFS 0 65.536 0 0 0 1 /end COMPU_METHOD
/begin COMPU_METHOD RmpTemp "Rampengradient für Temperatur" RAT_FUNC "%6.4" "deg C/s" COEFFS 0 655.36 0 0 0 1 /end COMPU_METHOD
/begin COMPU_METHOD TempDiff_Cels "difference/offset temperature displayed in degree celcius" RAT_FUNC "%6.3" "deg C" COEFFS 0 10 0 0 0 1 /end COMPU_METHOD
/begin COMPU_METHOD Temp_Cels "Temperatur dargestellt in °C (gleiche interne Darstellung wie Temp_Kelv)" RAT_FUNC "%6.1" "deg C" COEFFS 0 10 2731.4 0 0 1 /end COMPU_METHOD
/begin COMPU_METHOD Temp_Kelv "Temperatur dargestellt in Kelvin" RAT_FUNC "%6.3" "deg C" COEFFS 0 10 0 0 0 1 /end COMPU_METHOD
/begin COMPU_METHOD TimeDeb "Entprellzeit in Millisekunden für Libraryfunktion Debounce" RAT_FUNC "%6.1" "ms" COEFFS 0 0.1 0 0 0 1 /end COMPU_METHOD
/begin COMPU_METHOD TimeDelay_ms "Zeitkonstante T1 fuer die Bibliotheksfunktionen PT1, DT1, etc.,  in ms angegeben" RAT_FUNC "%9.0" "ms" COEFFS 0 0 1 0 2.3283064365387e-07 0 /end COMPU_METHOD
/begin COMPU_METHOD TimeDelay_s "Zeitkonstante T1 (in s) für PT1, DT1, etc." RAT_FUNC "%9.3" "s" COEFFS 0 0 1 0 0.00023283064365387 0 /end COMPU_METHOD
/begin COMPU_METHOD TimeEngOn "Motorbetriebszeit in Sekunden" RAT_FUNC "%6.2" "s" COEFFS 0 1 0 0 0 1 /end COMPU_METHOD
/begin COMPU_METHOD TimePFltLimpHome "" RAT_FUNC "%6.1" "s" COEFFS 0 0.1 0 0 0 1 /end COMPU_METHOD
/begin COMPU_METHOD Time_ms "Zeit in ms für Fehlerentprellung (DSM) und SW-Timer" RAT_FUNC "%6.1" "ms" COEFFS 0 0.1 0 0 0 1 /end COMPU_METHOD
/begin COMPU_METHOD Time_s "Zeit in s für Fehlerentprellung (DSM) und SW-Timer" RAT_FUNC "%6.4" "s" COEFFS 0 100 0 0 0 1 /end COMPU_METHOD
/begin COMPU_METHOD tiOpRes "Engine operation time" RAT_FUNC "%6.1" "s" COEFFS 0 0.015625 0 0 0 1 /end COMPU_METHOD
/begin COMPU_METHOD tiSncergnRes "Engine operation time since last successful regeneration" RAT_FUNC "%6.0" "s" COEFFS 0 0.00390625 0 0 0 1 /end COMPU_METHOD
/begin COMPU_METHOD Vel "Fahrzeuggeschwindigkeit, gleiche interne Auflösung wie Vel_SI" RAT_FUNC "%6.4" "km/h" COEFFS 0 100 0 0 0 1 /end COMPU_METHOD
/begin COMPU_METHOD Volt "Spannung in V (von ADC)" RAT_FUNC "%6.2" "mV" COEFFS 0 0.2046 0 0 0 1 /end COMPU_METHOD
/begin COMPU_METHOD Volt_Batt "Batteriespannung" RAT_FUNC "%6.1" "mV" COEFFS 0 0.05115 0 0 0 1 /end COMPU_METHOD
/begin RECORD_LAYOUT Gkl_Ws16 FNC_VALUES 1 SWORD COLUMN_DIR DIRECT /end RECORD_LAYOUT
/begin RECORD_LAYOUT GSst_Xs16 NO_AXIS_PTS_X 1 SWORD AXIS_PTS_X 2 SWORD INDEX_INCR DIRECT /end RECORD_LAYOUT
/begin RECORD_LAYOUT Kf_Xs16_Ys16_Ws16 NO_AXIS_PTS_X 1 SWORD NO_AXIS_PTS_Y 2 SWORD AXIS_PTS_X 3 SWORD INDEX_INCR DIRECT AXIS_PTS_Y 4 SWORD INDEX_INCR DIRECT FNC_VALUES 5 SWORD COLUMN_DIR DIRECT /end RECORD_LAYOUT
/begin RECORD_LAYOUT Kf_Xu8_Yu8_Wu8 NO_AXIS_PTS_X 1 UBYTE NO_AXIS_PTS_Y 2 UBYTE AXIS_PTS_X 3 UBYTE INDEX_INCR DIRECT AXIS_PTS_Y 4 UBYTE INDEX_INCR DIRECT FNC_VALUES 5 UBYTE COLUMN_DIR DIRECT /end RECORD_LAYOUT
/begin RECORD_LAYOUT Kl_Xs16_Ws16 NO_AXIS_PTS_X 1 SWORD AXIS_PTS_X 2 SWORD INDEX_INCR DIRECT FNC_VALUES 3 SWORD COLUMN_DIR DIRECT /end RECORD_LAYOUT
/begin RECORD_LAYOUT Kwb_Wu32 FNC_VALUES 1 ULONG COLUMN_DIR DIRECT /end RECORD_LAYOUT
/begin RECORD_LAYOUT Kwb_Wu8 FNC_VALUES 1 UBYTE COLUMN_DIR DIRECT /end RECORD_LAYOUT
/begin RECORD_LAYOUT Kw_Ws16 FNC_VALUES 1 SWORD COLUMN_DIR DIRECT /end RECORD_LAYOUT
/begin RECORD_LAYOUT Kw_Ws32 FNC_VALUES 1 SLONG COLUMN_DIR DIRECT /end RECORD_LAYOUT
/begin RECORD_LAYOUT Kw_Ws8 FNC_VALUES 1 SBYTE COLUMN_DIR DIRECT /end RECORD_LAYOUT
/begin RECORD_LAYOUT Kw_Wu16 FNC_VALUES 1 UWORD COLUMN_DIR DIRECT /end RECORD_LAYOUT
/begin RECORD_LAYOUT Kw_Wu32 FNC_VALUES 1 ULONG COLUMN_DIR DIRECT /end RECORD_LAYOUT
/begin RECORD_LAYOUT Kw_Wu8 FNC_VALUES 1 UBYTE COLUMN_DIR DIRECT /end RECORD_LAYOUT
/end MODULE
/end PROJECT
