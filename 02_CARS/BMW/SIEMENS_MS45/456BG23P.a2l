ASAP2_VERSION 1 31
/begin PROJECT MS45 "BMW Motorsteuerung R6"
/begin HEADER "_default_HeaderComment" PROJECT_NO _56 /end HEADER
/begin MODULE _default_ModuleName "_default_ModuleLongIdentifier"
/begin MOD_COMMON "_default_ModCommonComment" DEPOSIT ABSOLUTE BYTE_ORDER MSB_FIRST ALIGNMENT_BYTE 1 ALIGNMENT_WORD 2 ALIGNMENT_LONG 4 ALIGNMENT_FLOAT32_IEEE 4 ALIGNMENT_FLOAT64_IEEE 8 /end MOD_COMMON
/begin CHARACTERISTIC c_det_max_dmtlh "Maximum value of the anti - bounce counter" VALUE 0x00695 _REC_VAL_20_u1 254. _CNV_A_R_LINEAR_____1_CM 1. 255. DISPLAY_IDENTIFIER C_DET_MAX_DMTLH FORMAT "%3.0" /end CHARACTERISTIC
/begin CHARACTERISTIC c_det_inc_dmtlh "Anti - bounce counter increment" VALUE 0x00682 _REC_VAL_20_u1 255. _CNV_A_R_LINEAR_____1_CM 0. 255. DISPLAY_IDENTIFIER C_DET_INC_DMTLH FORMAT "%3.0" /end CHARACTERISTIC
/begin CHARACTERISTIC c_det_inc_dmtl_pump "Anti - bounce counter increment" VALUE 0x00681 _REC_VAL_20_u1 255. _CNV_A_R_LINEAR_____1_CM 0. 255. DISPLAY_IDENTIFIER C_DET_INC_DMTL_PUMP FORMAT "%3.0" /end CHARACTERISTIC
/begin CHARACTERISTIC c_det_max_dmtl_pump "Debounce counter maximum value" VALUE 0x00694 _REC_VAL_20_u1 254. _CNV_A_R_LINEAR_____1_CM 1. 255. DISPLAY_IDENTIFIER C_DET_MAX_DMTL_PUMP FORMAT "%3.0" /end CHARACTERISTIC
/begin CHARACTERISTIC c_det_inc_dmtls "Anti - bounce counter increment" VALUE 0x00683 _REC_VAL_20_u1 255. _CNV_A_R_LINEAR_____1_CM 0. 255. DISPLAY_IDENTIFIER C_DET_INC_DMTLS FORMAT "%3.0" /end CHARACTERISTIC
/begin CHARACTERISTIC c_det_max_dmtls "Debounce counter maximum value" VALUE 0x00696 _REC_VAL_20_u1 254. _CNV_A_R_LINEAR_____1_CM 1. 255. DISPLAY_IDENTIFIER C_DET_MAX_DMTLS FORMAT "%3.0" /end CHARACTERISTIC
/begin CHARACTERISTIC c_det_inc_rly_accout "Debounce counter increment- RLY_ACCOUT diagnosis" VALUE 0x0068d _REC_VAL_20_u1 255. _CNV_A_R_LINEAR_____1_CM 0. 255. DISPLAY_IDENTIFIER C_DET_INC_RLY_ACCOUT FORMAT "%3.0" /end CHARACTERISTIC
/begin CHARACTERISTIC c_det_max_rly_accout "Debounce counter maximum value - RLY_ACCOUT diagnosis" VALUE 0x006a0 _REC_VAL_20_u1 254. _CNV_A_R_LINEAR_____1_CM 1. 255. DISPLAY_IDENTIFIER C_DET_MAX_RLY_ACCOUT FORMAT "%3.0" /end CHARACTERISTIC
/begin CHARACTERISTIC c_det_max_ebox_cfa "Debounce counter maximum value" VALUE 0x00697 _REC_VAL_20_u1 254. _CNV_A_R_LINEAR_____1_CM 1. 255. DISPLAY_IDENTIFIER C_DET_MAX_EBOX_CFA FORMAT "%3.0" /end CHARACTERISTIC
/begin CHARACTERISTIC c_det_inc_ebox_cfa "Debounce counter increment" VALUE 0x00684 _REC_VAL_20_u1 255. _CNV_A_R_LINEAR_____1_CM 0. 255. DISPLAY_IDENTIFIER C_DET_INC_EBOX_CFA FORMAT "%3.0" /end CHARACTERISTIC
/begin MEASUREMENT lv_err_ebox_cfa "Logical value for EBOX CFA error" UBYTE _CNV_S_2_RANGE______2_R_CM 1 100. 0. 255. DISPLAY_IDENTIFIER LV_ERR_EBOX_CFA ECU_ADDRESS 0x3fba64 /end MEASUREMENT
/begin CHARACTERISTIC c_det_max_ef "Debounce counter maximum value" VALUE 0x0069b _REC_VAL_20_u1 254. _CNV_A_R_LINEAR_____1_CM 1. 255. DISPLAY_IDENTIFIER C_DET_MAX_EF FORMAT "%3.0" /end CHARACTERISTIC
/begin CHARACTERISTIC c_det_inc_ef "Debounce counter increment" VALUE 0x00688 _REC_VAL_20_u1 255. _CNV_A_R_LINEAR_____1_CM 0. 255. DISPLAY_IDENTIFIER C_DET_INC_EF FORMAT "%3.0" /end CHARACTERISTIC
/begin CHARACTERISTIC c_det_inc_ecras "Anti - bounce counter increment ECRAS diagnosis" VALUE 0x00686 _REC_VAL_20_u1 255. _CNV_A_R_LINEAR_____1_CM 0. 255. DISPLAY_IDENTIFIER C_DET_INC_ECRAS FORMAT "%3.0" /end CHARACTERISTIC
/begin CHARACTERISTIC c_det_max_ecras "Maximum value of the anti - bounce counter ECRAS diagnosis" VALUE 0x00699 _REC_VAL_20_u1 254. _CNV_A_R_LINEAR_____1_CM 1. 255. DISPLAY_IDENTIFIER C_DET_MAX_ECRAS FORMAT "%3.0" /end CHARACTERISTIC
/begin CHARACTERISTIC c_det_inc_sav "Debounce counter increment- SAV diagnosis" VALUE 0x00690 _REC_VAL_20_u1 255. _CNV_A_R_LINEAR_____1_CM 0. 255. DISPLAY_IDENTIFIER C_DET_INC_SAV FORMAT "%3.0" /end CHARACTERISTIC
/begin CHARACTERISTIC c_det_max_sav "Debounce counter maximum value - SAV diagnosis" VALUE 0x006a3 _REC_VAL_20_u1 254. _CNV_A_R_LINEAR_____1_CM 1. 255. DISPLAY_IDENTIFIER C_DET_MAX_SAV FORMAT "%3.0" /end CHARACTERISTIC
/begin CHARACTERISTIC c_det_max_vim "Maximum value of anti - Debounce counter increment for VIM driver diagnosis" VALUE 0x006a5 _REC_VAL_20_u1 254. _CNV_A_R_LINEAR_____1_CM 1. 255. DISPLAY_IDENTIFIER C_DET_MAX_VIM FORMAT "%3.0" /end CHARACTERISTIC
/begin CHARACTERISTIC c_det_inc_vim "Anti - Debounce counter increment for VIM driver diagnosis" VALUE 0x00692 _REC_VAL_20_u1 255. _CNV_A_R_LINEAR_____1_CM 0. 255. DISPLAY_IDENTIFIER C_DET_INC_VIM FORMAT "%3.0" /end CHARACTERISTIC
/begin CHARACTERISTIC c_det_inc_rly_st "anti-bounce increment value" VALUE 0x0068e _REC_VAL_20_u1 255. _CNV_A_R_LINEAR_____1_CM 0. 255. DISPLAY_IDENTIFIER C_DET_INC_RLY_ST FORMAT "%3.0" /end CHARACTERISTIC
/begin CHARACTERISTIC c_det_max_rly_st "anti-bounce maximum value" VALUE 0x006a1 _REC_VAL_20_u1 254. _CNV_A_R_LINEAR_____1_CM 1. 255. DISPLAY_IDENTIFIER C_DET_MAX_RLY_ST FORMAT "%3.0" /end CHARACTERISTIC
/begin CHARACTERISTIC c_det_inc_lsh_down "Anti-bounce increment value for lsh down" VALUE 0x0068b _REC_VAL_20_u1 255. _CNV_A_R_LINEAR_____1_CM 0. 255. DISPLAY_IDENTIFIER C_DET_INC_LSH_DOWN FORMAT "%3.0" /end CHARACTERISTIC
/begin CHARACTERISTIC c_det_max_lsh_down "Anti-bounce maximum value for lsh down" VALUE 0x0069e _REC_VAL_20_u1 254. _CNV_A_R_LINEAR_____1_CM 1. 255. DISPLAY_IDENTIFIER C_DET_MAX_LSH_DOWN FORMAT "%3.0" /end CHARACTERISTIC
/begin CHARACTERISTIC c_det_max_lsh_up "Anti-bounce increment value for LSH_UP" VALUE 0x0069f _REC_VAL_20_u1 254. _CNV_A_R_LINEAR_____1_CM 1. 255. DISPLAY_IDENTIFIER C_DET_MAX_LSH_UP FORMAT "%3.0" /end CHARACTERISTIC
/begin CHARACTERISTIC c_det_inc_lsh_up "Anti-bounce maximum value for LSH_UP" VALUE 0x0068c _REC_VAL_20_u1 255. _CNV_A_R_LINEAR_____1_CM 0. 255. DISPLAY_IDENTIFIER C_DET_INC_LSH_UP FORMAT "%3.0" /end CHARACTERISTIC
/begin CHARACTERISTIC c_det_max_isa_1 "Anti-bounce increment value for ISA_1" VALUE 0x0069c _REC_VAL_20_u1 254. _CNV_A_R_LINEAR_____1_CM 1. 255. DISPLAY_IDENTIFIER C_DET_MAX_ISA_1 FORMAT "%3.0" /end CHARACTERISTIC
/begin CHARACTERISTIC c_det_max_isa_2 "Anti-bounce increment value for ISA_2" VALUE 0x0069d _REC_VAL_20_u1 254. _CNV_A_R_LINEAR_____1_CM 1. 255. DISPLAY_IDENTIFIER C_DET_MAX_ISA_2 FORMAT "%3.0" /end CHARACTERISTIC
/begin CHARACTERISTIC c_det_inc_isa_1 "Anti-bounce maximum value for ISA_1" VALUE 0x00689 _REC_VAL_20_u1 255. _CNV_A_R_LINEAR_____1_CM 0. 255. DISPLAY_IDENTIFIER C_DET_INC_ISA_1 FORMAT "%3.0" /end CHARACTERISTIC
/begin CHARACTERISTIC c_det_inc_isa_2 "Anti-bounce maximum value for ISA_2" VALUE 0x0068a _REC_VAL_20_u1 255. _CNV_A_R_LINEAR_____1_CM 0. 255. DISPLAY_IDENTIFIER C_DET_INC_ISA_2 FORMAT "%3.0" /end CHARACTERISTIC
/begin CHARACTERISTIC c_det_max_slv_ivvt "Debounce counter maximum value - VANOS diagnosis magnetic valves" VALUE 0x006a4 _REC_VAL_20_u1 254. _CNV_A_R_LINEAR_____1_CM 1. 255. DISPLAY_IDENTIFIER C_DET_MAX_SLV_IVVT FORMAT "%3.0" /end CHARACTERISTIC
/begin CHARACTERISTIC c_det_inc_slv_ivvt "Debounce counter increment - VANOS diagnosis magnetic valve CAM_IN" VALUE 0x00691 _REC_VAL_20_u1 255. _CNV_A_R_LINEAR_____1_CM 0. 255. DISPLAY_IDENTIFIER C_DET_INC_SLV_IVVT FORMAT "%3.0" /end CHARACTERISTIC
/begin CHARACTERISTIC c_det_inc_sap "Debounce counter increment- SAP diagnosis" VALUE 0x0068f _REC_VAL_20_u1 255. _CNV_A_R_LINEAR_____1_CM 0. 255. DISPLAY_IDENTIFIER C_DET_INC_SAP FORMAT "%3.0" /end CHARACTERISTIC
/begin CHARACTERISTIC c_det_max_sap "Debounce counter maximum value - SAP diagnosis" VALUE 0x006a2 _REC_VAL_20_u1 254. _CNV_A_R_LINEAR_____1_CM 1. 255. DISPLAY_IDENTIFIER C_DET_MAX_SAP FORMAT "%3.0" /end CHARACTERISTIC
/begin CHARACTERISTIC c_abc_inc_rly_efp "Debounce counter increment RLY_EFP" VALUE 0x0054b _REC_VAL_20_u1 255. _CNV_A_R_LINEAR_____1_CM 0. 255. DISPLAY_IDENTIFIER C_ABC_INC_RLY_EFP FORMAT "%3.0" /end CHARACTERISTIC
/begin CHARACTERISTIC c_abc_max_rly_efp "Debounce counter maximum value RLY_EFP" VALUE 0x005b4 _REC_VAL_20_u1 254. _CNV_A_R_LINEAR_____1_CM 1. 255. DISPLAY_IDENTIFIER C_ABC_MAX_RLY_EFP FORMAT "%3.0" /end CHARACTERISTIC
/begin CHARACTERISTIC c_det_max_cps "Debounce counter maximum value - CPS diagnosis" VALUE 0x00693 _REC_VAL_20_u1 254. _CNV_A_R_LINEAR_____1_CM 1. 255. DISPLAY_IDENTIFIER C_DET_MAX_CPS FORMAT "%3.0" /end CHARACTERISTIC
/begin CHARACTERISTIC c_det_inc_cps "Debounce counter increment - CPS diagnosis" VALUE 0x00680 _REC_VAL_20_u1 255. _CNV_A_R_LINEAR_____1_CM 0. 255. DISPLAY_IDENTIFIER C_DET_INC_CPS FORMAT "%3.0" /end CHARACTERISTIC
/begin CHARACTERISTIC c_det_max_ect_el "Debounce counter maximum value - Thermostat heating diagnosis" VALUE 0x0069a _REC_VAL_20_u1 254. _CNV_A_R_LINEAR_____1_CM 1. 255. DISPLAY_IDENTIFIER C_DET_MAX_ECT_EL FORMAT "%3.0" /end CHARACTERISTIC
/begin CHARACTERISTIC c_det_inc_ect_el "Debounce counter increment - Thermostat heating diagnosis" VALUE 0x00687 _REC_VAL_20_u1 255. _CNV_A_R_LINEAR_____1_CM 0. 255. DISPLAY_IDENTIFIER C_DET_INC_ECT_EL FORMAT "%3.0" /end CHARACTERISTIC
/begin CHARACTERISTIC c_det_max_ecf "Debounce counter maximum value -  ECF diagnosis" VALUE 0x00698 _REC_VAL_20_u1 254. _CNV_A_R_LINEAR_____1_CM 1. 255. DISPLAY_IDENTIFIER C_DET_MAX_ECF FORMAT "%3.0" /end CHARACTERISTIC
/begin CHARACTERISTIC c_det_inc_ecf "Debounce counter increment - ECF diagnosis" VALUE 0x00685 _REC_VAL_20_u1 255. _CNV_A_R_LINEAR_____1_CM 0. 255. DISPLAY_IDENTIFIER C_DET_INC_ECF FORMAT "%3.0" /end CHARACTERISTIC
/begin CHARACTERISTIC c_abc_inc_iv "Debounce counter increment" VALUE 0x0053a _REC_VAL_20_u1 255. _CNV_A_R_LINEAR_____1_CM 0. 255. DISPLAY_IDENTIFIER C_ABC_INC_IV FORMAT "%3.0" /end CHARACTERISTIC
/begin CHARACTERISTIC c_abc_max_iv "Debounce counter maximum value" VALUE 0x005a4 _REC_VAL_20_u1 254. _CNV_A_R_LINEAR_____1_CM 1. 255. DISPLAY_IDENTIFIER C_ABC_MAX_IV FORMAT "%3.0" /end CHARACTERISTIC
/begin CHARACTERISTIC c_abc_inc_imob_2 "" VALUE 0x00538 _REC_VAL_20_u1 254. _CNV_A_R_LINEAR_____1_CM 1. 255. DISPLAY_IDENTIFIER C_ABC_INC_IMOB_2 FORMAT "%3.0" /end CHARACTERISTIC
/begin CHARACTERISTIC c_abc_inc_imob_1 "" VALUE 0x00537 _REC_VAL_20_u1 254. _CNV_A_R_LINEAR_____1_CM 1. 255. DISPLAY_IDENTIFIER C_ABC_INC_IMOB_1 FORMAT "%3.0" /end CHARACTERISTIC
/begin CHARACTERISTIC c_abc_max_imob_2 "" VALUE 0x005a2 _REC_VAL_20_u1 254. _CNV_A_R_LINEAR_____1_CM 1. 255. DISPLAY_IDENTIFIER C_ABC_MAX_IMOB_2 FORMAT "%3.0" /end CHARACTERISTIC
/begin CHARACTERISTIC c_abc_max_imob_1 "" VALUE 0x005a1 _REC_VAL_20_u1 254. _CNV_A_R_LINEAR_____1_CM 1. 255. DISPLAY_IDENTIFIER C_ABC_MAX_IMOB_1 FORMAT "%3.0" /end CHARACTERISTIC
/begin CHARACTERISTIC c_abc_inc_sof_inh_mon "Anti - bounce counter increment" VALUE 0x11d51 _REC_VAL_20_u1 255. _CNV_A_R_LINEAR_____1_CM 0. 255. DISPLAY_IDENTIFIER C_ABC_INC_SOF_INH_MON FORMAT "%3.0" /end CHARACTERISTIC
/begin CHARACTERISTIC c_abc_max_sof_inh_mon "Debounce counter maximum value" VALUE 0x11d66 _REC_VAL_20_u1 254. _CNV_A_R_LINEAR_____1_CM 1. 255. DISPLAY_IDENTIFIER C_ABC_MAX_SOF_INH_MON FORMAT "%3.0" /end CHARACTERISTIC
/begin CHARACTERISTIC c_abc_inc_amp "Anti - bounce counter increment" VALUE 0x0050d _REC_VAL_20_u1 255. _CNV_A_R_LINEAR_____1_CM 0. 255. DISPLAY_IDENTIFIER C_ABC_INC_AMP FORMAT "%3.0" /end CHARACTERISTIC
/begin CHARACTERISTIC c_abc_max_amp "Maximum value of the anti - bounce counter" VALUE 0x00579 _REC_VAL_20_u1 254. _CNV_A_R_LINEAR_____1_CM 1. 255. DISPLAY_IDENTIFIER C_ABC_MAX_AMP FORMAT "%3.0" /end CHARACTERISTIC
/begin CHARACTERISTIC c_abc_inc_im_bts_plaus "BTS debounce counter increment  " VALUE 0x00536 _REC_VAL_20_u1 255. _CNV_A_R_LINEAR_____1_CM 0. 255. DISPLAY_IDENTIFIER C_ABC_INC_IM_BTS_PLAUS FORMAT "%3.0" /end CHARACTERISTIC
/begin CHARACTERISTIC c_abc_inc_im_bls_plaus "BLS debounce counter increment  " VALUE 0x00535 _REC_VAL_20_u1 255. _CNV_A_R_LINEAR_____1_CM 0. 255. DISPLAY_IDENTIFIER C_ABC_INC_IM_BLS_PLAUS FORMAT "%3.0" /end CHARACTERISTIC
/begin CHARACTERISTIC c_abc_max_im_bts_plaus "BTS debounce counter maximum value, error debounce" VALUE 0x005a0 _REC_VAL_20_u1 254. _CNV_A_R_LINEAR_____1_CM 1. 255. DISPLAY_IDENTIFIER C_ABC_MAX_IM_BTS_PLAUS FORMAT "%3.0" /end CHARACTERISTIC
/begin CHARACTERISTIC c_abc_max_im_bls_plaus "BLS debounce counter maximum value" VALUE 0x0059f _REC_VAL_20_u1 254. _CNV_A_R_LINEAR_____1_CM 1. 255. DISPLAY_IDENTIFIER C_ABC_MAX_IM_BLS_PLAUS FORMAT "%3.0" /end CHARACTERISTIC
/begin CHARACTERISTIC c_abc_inc_bn_tq_dcc "Anti - bounce counter increment BN2000 Diagnosis" VALUE 0x0051f _REC_VAL_20_u1 255. _CNV_A_R_LINEAR_____1_CM 0. 255. DISPLAY_IDENTIFIER C_ABC_INC_BN_TQ_DCC FORMAT "%3.0" /end CHARACTERISTIC
/begin CHARACTERISTIC c_abc_inc_bn_tq_tcs "Anti - bounce counter increment BN2000 Diagnosis" VALUE 0x00522 _REC_VAL_20_u1 255. _CNV_A_R_LINEAR_____1_CM 0. 255. DISPLAY_IDENTIFIER C_ABC_INC_BN_TQ_TCS FORMAT "%3.0" /end CHARACTERISTIC
/begin CHARACTERISTIC c_abc_inc_bn_vs_tcs "Anti - bounce counter increment BN2000 Diagnosis" VALUE 0x00524 _REC_VAL_20_u1 255. _CNV_A_R_LINEAR_____1_CM 0. 255. DISPLAY_IDENTIFIER C_ABC_INC_BN_VS_TCS FORMAT "%3.0" /end CHARACTERISTIC
/begin CHARACTERISTIC c_abc_inc_bn_tcs "Anti - bounce counter increment BN2000 Diagnosis" VALUE 0x0051d _REC_VAL_20_u1 255. _CNV_A_R_LINEAR_____1_CM 0. 255. DISPLAY_IDENTIFIER C_ABC_INC_BN_TCS FORMAT "%3.0" /end CHARACTERISTIC
/begin CHARACTERISTIC c_abc_inc_bn_tq_etcu "Anti - bounce counter increment BN2000 Diagnosis" VALUE 0x00520 _REC_VAL_20_u1 255. _CNV_A_R_LINEAR_____1_CM 0. 255. DISPLAY_IDENTIFIER C_ABC_INC_BN_TQ_ETCU FORMAT "%3.0" /end CHARACTERISTIC
/begin CHARACTERISTIC c_abc_inc_bn_cas "Anti - bounce counter increment BN2000 Diagnosis" VALUE 0x00514 _REC_VAL_20_u1 255. _CNV_A_R_LINEAR_____1_CM 0. 255. DISPLAY_IDENTIFIER C_ABC_INC_BN_CAS FORMAT "%3.0" /end CHARACTERISTIC
/begin CHARACTERISTIC c_abc_inc_bn_etcu "Anti - bounce counter increment BN2000 Diagnosis" VALUE 0x00516 _REC_VAL_20_u1 255. _CNV_A_R_LINEAR_____1_CM 0. 255. DISPLAY_IDENTIFIER C_ABC_INC_BN_ETCU FORMAT "%3.0" /end CHARACTERISTIC
/begin CHARACTERISTIC c_abc_inc_bn_tq_amt "Anti - bounce counter increment BN2000 Diagnosis" VALUE 0x0051e _REC_VAL_20_u1 255. _CNV_A_R_LINEAR_____1_CM 0. 255. DISPLAY_IDENTIFIER C_ABC_INC_BN_TQ_AMT FORMAT "%3.0" /end CHARACTERISTIC
/begin CHARACTERISTIC c_abc_inc_bn_acc "Anti - bounce counter increment BN2000 Diagnosis" VALUE 0x00511 _REC_VAL_20_u1 255. _CNV_A_R_LINEAR_____1_CM 0. 255. DISPLAY_IDENTIFIER C_ABC_INC_BN_ACC FORMAT "%3.0" /end CHARACTERISTIC
/begin CHARACTERISTIC c_abc_inc_bn_icl "Anti - bounce counter increment BN2000 Diagnosis" VALUE 0x00517 _REC_VAL_20_u1 255. _CNV_A_R_LINEAR_____1_CM 0. 255. DISPLAY_IDENTIFIER C_ABC_INC_BN_ICL FORMAT "%3.0" /end CHARACTERISTIC
/begin CHARACTERISTIC c_abc_inc_bn_km_icl "Anti - bounce counter increment BN2000 Diagnosis" VALUE 0x00518 _REC_VAL_20_u1 255. _CNV_A_R_LINEAR_____1_CM 0. 255. DISPLAY_IDENTIFIER C_ABC_INC_BN_KM_ICL FORMAT "%3.0" /end CHARACTERISTIC
/begin CHARACTERISTIC c_abc_inc_bn_veh_mod "Anti - bounce counter increment BN2000 Diagnosis" VALUE 0x00523 _REC_VAL_20_u1 255. _CNV_A_R_LINEAR_____1_CM 0. 255. DISPLAY_IDENTIFIER C_ABC_INC_BN_VEH_MOD FORMAT "%3.0" /end CHARACTERISTIC
/begin CHARACTERISTIC c_abc_inc_bn_t_icl "Anti - bounce counter increment BN2000 Diagnosis" VALUE 0x0051c _REC_VAL_20_u1 255. _CNV_A_R_LINEAR_____1_CM 0. 255. DISPLAY_IDENTIFIER C_ABC_INC_BN_T_ICL FORMAT "%3.0" /end CHARACTERISTIC
/begin CHARACTERISTIC c_abc_inc_bn_pow_vb "Anti - bounce counter increment BN2000 Diagnosis" VALUE 0x0051b _REC_VAL_20_u1 255. _CNV_A_R_LINEAR_____1_CM 0. 255. DISPLAY_IDENTIFIER C_ABC_INC_BN_POW_VB FORMAT "%3.0" /end CHARACTERISTIC
/begin CHARACTERISTIC c_abc_inc_bn_pow_gen "Anti - bounce counter increment BN2000 Diagnosis" VALUE 0x0051a _REC_VAL_20_u1 255. _CNV_A_R_LINEAR_____1_CM 0. 255. DISPLAY_IDENTIFIER C_ABC_INC_BN_POW_GEN FORMAT "%3.0" /end CHARACTERISTIC
/begin CHARACTERISTIC c_abc_inc_bn_msw "Anti - bounce counter increment BN2000 Diagnosis" VALUE 0x00519 _REC_VAL_20_u1 255. _CNV_A_R_LINEAR_____1_CM 0. 255. DISPLAY_IDENTIFIER C_ABC_INC_BN_MSW FORMAT "%3.0" /end CHARACTERISTIC
/begin CHARACTERISTIC c_abc_inc_bn_ang_pste "Anti - bounce counter increment BN2000 Diagnosis" VALUE 0x00512 _REC_VAL_20_u1 255. _CNV_A_R_LINEAR_____1_CM 0. 255. DISPLAY_IDENTIFIER C_ABC_INC_BN_ANG_PSTE FORMAT "%3.0" /end CHARACTERISTIC
/begin CHARACTERISTIC c_abc_max_bn_cas "Maximum value of the anti - bounce counter BN2000 diagnosis" VALUE 0x00580 _REC_VAL_20_u1 254. _CNV_A_R_LINEAR_____1_CM 1. 255. DISPLAY_IDENTIFIER C_ABC_MAX_BN_CAS FORMAT "%3.0" /end CHARACTERISTIC
/begin CHARACTERISTIC c_abc_max_bn_tq_tcs "Maximum value of the anti - bounce counter BN2000 diagnosis" VALUE 0x0058e _REC_VAL_20_u1 254. _CNV_A_R_LINEAR_____1_CM 1. 255. DISPLAY_IDENTIFIER C_ABC_MAX_BN_TQ_TCS FORMAT "%3.0" /end CHARACTERISTIC
/begin CHARACTERISTIC c_abc_max_bn_vs_tcs "Maximum value of the anti - bounce counter BN2000 diagnosis" VALUE 0x00590 _REC_VAL_20_u1 254. _CNV_A_R_LINEAR_____1_CM 1. 255. DISPLAY_IDENTIFIER C_ABC_MAX_BN_VS_TCS FORMAT "%3.0" /end CHARACTERISTIC
/begin CHARACTERISTIC c_abc_max_bn_tcs "Maximum value of the anti - bounce counter BN2000 diagnosis" VALUE 0x00589 _REC_VAL_20_u1 254. _CNV_A_R_LINEAR_____1_CM 1. 255. DISPLAY_IDENTIFIER C_ABC_MAX_BN_TCS FORMAT "%3.0" /end CHARACTERISTIC
/begin CHARACTERISTIC c_abc_max_bn_tq_etcu "Maximum value of the anti - bounce counter BN2000 diagnosis" VALUE 0x0058c _REC_VAL_20_u1 254. _CNV_A_R_LINEAR_____1_CM 1. 255. DISPLAY_IDENTIFIER C_ABC_MAX_BN_TQ_ETCU FORMAT "%3.0" /end CHARACTERISTIC
/begin CHARACTERISTIC c_abc_max_bn_etcu "Maximum value of the anti - bounce counter BN2000 diagnosis" VALUE 0x00582 _REC_VAL_20_u1 254. _CNV_A_R_LINEAR_____1_CM 1. 255. DISPLAY_IDENTIFIER C_ABC_MAX_BN_ETCU FORMAT "%3.0" /end CHARACTERISTIC
/begin CHARACTERISTIC c_abc_max_bn_tq_amt "Maximum value of the anti - bounce counter BN2000 diagnosis" VALUE 0x0058a _REC_VAL_20_u1 254. _CNV_A_R_LINEAR_____1_CM 1. 255. DISPLAY_IDENTIFIER C_ABC_MAX_BN_TQ_AMT FORMAT "%3.0" /end CHARACTERISTIC
/begin CHARACTERISTIC c_abc_max_bn_acc "Maximum value of the anti - bounce counter BN2000 diagnosis" VALUE 0x0057d _REC_VAL_20_u1 254. _CNV_A_R_LINEAR_____1_CM 1. 255. DISPLAY_IDENTIFIER C_ABC_MAX_BN_ACC FORMAT "%3.0" /end CHARACTERISTIC
/begin CHARACTERISTIC c_abc_max_bn_t_icl "Maximum value of the anti - bounce counter BN2000 diagnosis" VALUE 0x00588 _REC_VAL_20_u1 254. _CNV_A_R_LINEAR_____1_CM 1. 255. DISPLAY_IDENTIFIER C_ABC_MAX_BN_T_ICL FORMAT "%3.0" /end CHARACTERISTIC
/begin CHARACTERISTIC c_abc_max_bn_km_icl "Maximum value of the anti - bounce counter BN2000 diagnosis" VALUE 0x00584 _REC_VAL_20_u1 254. _CNV_A_R_LINEAR_____1_CM 1. 255. DISPLAY_IDENTIFIER C_ABC_MAX_BN_KM_ICL FORMAT "%3.0" /end CHARACTERISTIC
/begin CHARACTERISTIC c_abc_max_bn_veh_mod "Maximum value of the anti - bounce counter BN2000 diagnosis" VALUE 0x0058f _REC_VAL_20_u1 254. _CNV_A_R_LINEAR_____1_CM 1. 255. DISPLAY_IDENTIFIER C_ABC_MAX_BN_VEH_MOD FORMAT "%3.0" /end CHARACTERISTIC
/begin CHARACTERISTIC c_abc_max_bn_icl "Maximum value of the anti - bounce counter BN2000 diagnosis" VALUE 0x00583 _REC_VAL_20_u1 254. _CNV_A_R_LINEAR_____1_CM 1. 255. DISPLAY_IDENTIFIER C_ABC_MAX_BN_ICL FORMAT "%3.0" /end CHARACTERISTIC
/begin CHARACTERISTIC c_abc_max_bn_pow_vb "Maximum value of the anti - bounce counter BN2000 diagnosis" VALUE 0x00587 _REC_VAL_20_u1 254. _CNV_A_R_LINEAR_____1_CM 1. 255. DISPLAY_IDENTIFIER C_ABC_MAX_BN_POW_VB FORMAT "%3.0" /end CHARACTERISTIC
/begin CHARACTERISTIC c_abc_max_bn_pow_gen "Maximum value of the anti - bounce counter BN2000 diagnosis" VALUE 0x00586 _REC_VAL_20_u1 254. _CNV_A_R_LINEAR_____1_CM 1. 255. DISPLAY_IDENTIFIER C_ABC_MAX_BN_POW_GEN FORMAT "%3.0" /end CHARACTERISTIC
/begin CHARACTERISTIC c_abc_max_bn_msw "Maximum value of the anti - bounce counter BN2000 diagnosis" VALUE 0x00585 _REC_VAL_20_u1 254. _CNV_A_R_LINEAR_____1_CM 1. 255. DISPLAY_IDENTIFIER C_ABC_MAX_BN_MSW FORMAT "%3.0" /end CHARACTERISTIC
/begin CHARACTERISTIC c_abc_max_bn_tq_dcc "Maximum value of the anti - bounce counter BN2000 diagnosis" VALUE 0x0058b _REC_VAL_20_u1 254. _CNV_A_R_LINEAR_____1_CM 1. 255. DISPLAY_IDENTIFIER C_ABC_MAX_BN_TQ_DCC FORMAT "%3.0" /end CHARACTERISTIC
/begin CHARACTERISTIC c_abc_max_bn_ang_pste "Maximum value of the anti - bounce counter BN2000 diagnosis" VALUE 0x0057e _REC_VAL_20_u1 254. _CNV_A_R_LINEAR_____1_CM 1. 255. DISPLAY_IDENTIFIER C_ABC_MAX_BN_ANG_PSTE FORMAT "%3.0" /end CHARACTERISTIC
/begin CHARACTERISTIC c_ctr_diag_tcc_can_max_ars "Maximum number of wrong ATCC_CAN count events before error detection of BN2000 message" VALUE 0x00650 _REC_VAL_20_u1 255. _CNV_A_R_LINEAR_____1_CM 0. 255. DISPLAY_IDENTIFIER C_CTR_DIAG_TCC_CAN_MAX_ARS FORMAT "%3.0" /end CHARACTERISTIC
/begin CHARACTERISTIC c_ctr_diag_tcc_can_max_cas "Maximum number of wrong ATCC_CAN count events before error detection of BN2000 message" VALUE 0x00651 _REC_VAL_20_u1 255. _CNV_A_R_LINEAR_____1_CM 0. 255. DISPLAY_IDENTIFIER C_CTR_DIAG_TCC_CAN_MAX_CAS FORMAT "%3.0" /end CHARACTERISTIC
/begin CHARACTERISTIC c_ctr_diag_tcc_can_max_tq_tcs "Maximum number of wrong ATCC_CAN count events before error detection of BN2000 message" VALUE 0x00658 _REC_VAL_20_u1 255. _CNV_A_R_LINEAR_____1_CM 0. 255. DISPLAY_IDENTIFIER C_CTR_DIAG_TCC_CAN_MAX_TQ_TCS FORMAT "%3.0" /end CHARACTERISTIC
/begin CHARACTERISTIC c_ctr_diag_tcc_can_max_tq_etcu "Maximum number of wrong ATCC_CAN count events before error detection of BN2000 message" VALUE 0x00656 _REC_VAL_20_u1 255. _CNV_A_R_LINEAR_____1_CM 0. 255. DISPLAY_IDENTIFIER C_CTR_DIAG_TCC_CAN_MAX_TQ_ETCU FORMAT "%3.0" /end CHARACTERISTIC
/begin CHARACTERISTIC c_ctr_diag_tcc_can_max_tq_amt "Maximum number of wrong ATCC_CAN count events before error detection of BN2000 message" VALUE 0x00654 _REC_VAL_20_u1 255. _CNV_A_R_LINEAR_____1_CM 0. 255. DISPLAY_IDENTIFIER C_CTR_DIAG_TCC_CAN_MAX_TQ_AMT FORMAT "%3.0" /end CHARACTERISTIC
/begin CHARACTERISTIC c_ctr_diag_tcc_can_max_veh_mod "Maximum number of wrong ATCC_CAN count events before error detection of BN2000 message" VALUE 0x00659 _REC_VAL_20_u1 255. _CNV_A_R_LINEAR_____1_CM 0. 255. DISPLAY_IDENTIFIER C_CTR_DIAG_TCC_CAN_MAX_VEH_MOD FORMAT "%3.0" /end CHARACTERISTIC
/begin CHARACTERISTIC c_ctr_diag_tcc_can_max_icl "Maximum number of wrong ATCC_CAN count events before error detection of BN2000 message" VALUE 0x00652 _REC_VAL_20_u1 255. _CNV_A_R_LINEAR_____1_CM 0. 255. DISPLAY_IDENTIFIER C_CTR_DIAG_TCC_CAN_MAX_ICL FORMAT "%3.0" /end CHARACTERISTIC
/begin CHARACTERISTIC c_ctr_diag_tcc_can_max_msw "Maximum number of wrong ATCC_CAN count events before error detection of BN2000 message" VALUE 0x00653 _REC_VAL_20_u1 255. _CNV_A_R_LINEAR_____1_CM 0. 255. DISPLAY_IDENTIFIER C_CTR_DIAG_TCC_CAN_MAX_MSW FORMAT "%3.0" /end CHARACTERISTIC
/begin CHARACTERISTIC c_ctr_diag_tcc_can_max_tq_dcc "Maximum number of wrong ATCC_CAN count events before error detection of BN2000 message" VALUE 0x00655 _REC_VAL_20_u1 255. _CNV_A_R_LINEAR_____1_CM 0. 255. DISPLAY_IDENTIFIER C_CTR_DIAG_TCC_CAN_MAX_TQ_DCC FORMAT "%3.0" /end CHARACTERISTIC
/begin CHARACTERISTIC c_ctr_diag_cks_max_cas "Maximum number of wrong checksum calculation events before error detection of BN2000 message" VALUE 0x00646 _REC_VAL_20_u1 255. _CNV_A_R_LINEAR_____1_CM 0. 255. DISPLAY_IDENTIFIER C_CTR_DIAG_CKS_MAX_CAS FORMAT "%3.0" /end CHARACTERISTIC
/begin CHARACTERISTIC c_ctr_diag_cks_max_tq_tcs "Maximum number of wrong checksum calculation events before error detection of BN2000 message" VALUE 0x0064c _REC_VAL_20_u1 255. _CNV_A_R_LINEAR_____1_CM 0. 255. DISPLAY_IDENTIFIER C_CTR_DIAG_CKS_MAX_TQ_TCS FORMAT "%3.0" /end CHARACTERISTIC
/begin CHARACTERISTIC c_ctr_diag_cks_max_tq_etcu "Maximum number of wrong checksum calculation events before error detection of BN2000 message" VALUE 0x0064a _REC_VAL_20_u1 255. _CNV_A_R_LINEAR_____1_CM 0. 255. DISPLAY_IDENTIFIER C_CTR_DIAG_CKS_MAX_TQ_ETCU FORMAT "%3.0" /end CHARACTERISTIC
/begin CHARACTERISTIC c_ctr_diag_cks_max_tq_amt "Maximum number of wrong checksum calculation events before error detection of BN2000 message" VALUE 0x00648 _REC_VAL_20_u1 255. _CNV_A_R_LINEAR_____1_CM 0. 255. DISPLAY_IDENTIFIER C_CTR_DIAG_CKS_MAX_TQ_AMT FORMAT "%3.0" /end CHARACTERISTIC
/begin CHARACTERISTIC c_ctr_diag_cks_max_veh_mod "Maximum number of wrong checksum calculation events before error detection of BN2000 message" VALUE 0x0064d _REC_VAL_20_u1 255. _CNV_A_R_LINEAR_____1_CM 0. 255. DISPLAY_IDENTIFIER C_CTR_DIAG_CKS_MAX_VEH_MOD FORMAT "%3.0" /end CHARACTERISTIC
/begin CHARACTERISTIC c_ctr_diag_cks_max_msw "Maximum number of wrong checksum calculation events before error detection of BN2000 message" VALUE 0x00647 _REC_VAL_20_u1 255. _CNV_A_R_LINEAR_____1_CM 0. 255. DISPLAY_IDENTIFIER C_CTR_DIAG_CKS_MAX_MSW FORMAT "%3.0" /end CHARACTERISTIC
/begin CHARACTERISTIC c_ctr_diag_cks_max_tq_dcc "Maximum number of wrong checksum calculation events before error detection of BN2000 message" VALUE 0x00649 _REC_VAL_20_u1 255. _CNV_A_R_LINEAR_____1_CM 0. 255. DISPLAY_IDENTIFIER C_CTR_DIAG_CKS_MAX_TQ_DCC FORMAT "%3.0" /end CHARACTERISTIC
/begin CHARACTERISTIC c_ctr_diag_tout_max_ars "Maximum number of missing message events before error detection of BN2000 message" VALUE 0x0065c _REC_VAL_20_u1 255. _CNV_A_R_LINEAR_____1_CM 0. 255. DISPLAY_IDENTIFIER C_CTR_DIAG_TOUT_MAX_ARS FORMAT "%3.0" /end CHARACTERISTIC
/begin CHARACTERISTIC c_ctr_diag_tout_max_cas "Maximum number of missing message events before error detection of BN2000 message" VALUE 0x0065d _REC_VAL_20_u1 255. _CNV_A_R_LINEAR_____1_CM 0. 255. DISPLAY_IDENTIFIER C_CTR_DIAG_TOUT_MAX_CAS FORMAT "%3.0" /end CHARACTERISTIC
/begin CHARACTERISTIC c_ctr_diag_tout_max_tq_tcs "Maximum number of missing message events before error detection of BN2000 message" VALUE 0x0066b _REC_VAL_20_u1 255. _CNV_A_R_LINEAR_____1_CM 0. 255. DISPLAY_IDENTIFIER C_CTR_DIAG_TOUT_MAX_TQ_TCS FORMAT "%3.0" /end CHARACTERISTIC
/begin CHARACTERISTIC c_ctr_diag_tout_max_vs_tcs "Maximum number of missing message events before error detection of BN2000 message" VALUE 0x0066d _REC_VAL_20_u1 255. _CNV_A_R_LINEAR_____1_CM 0. 255. DISPLAY_IDENTIFIER C_CTR_DIAG_TOUT_MAX_VS_TCS FORMAT "%3.0" /end CHARACTERISTIC
/begin CHARACTERISTIC c_ctr_diag_tout_max_tcs "Maximum number of missing message events before error detection of BN2000 message" VALUE 0x00666 _REC_VAL_20_u1 255. _CNV_A_R_LINEAR_____1_CM 0. 255. DISPLAY_IDENTIFIER C_CTR_DIAG_TOUT_MAX_TCS FORMAT "%3.0" /end CHARACTERISTIC
/begin CHARACTERISTIC c_ctr_diag_tout_max_tq_etcu "Maximum number of missing message events before error detection of BN2000 message" VALUE 0x00669 _REC_VAL_20_u1 255. _CNV_A_R_LINEAR_____1_CM 0. 255. DISPLAY_IDENTIFIER C_CTR_DIAG_TOUT_MAX_TQ_ETCU FORMAT "%3.0" /end CHARACTERISTIC
/begin CHARACTERISTIC c_ctr_diag_tout_max_tq_dcc "Maximum number of missing message events before error detection of BN2000 message" VALUE 0x00668 _REC_VAL_20_u1 255. _CNV_A_R_LINEAR_____1_CM 0. 255. DISPLAY_IDENTIFIER C_CTR_DIAG_TOUT_MAX_TQ_DCC FORMAT "%3.0" /end CHARACTERISTIC
/begin CHARACTERISTIC c_ctr_diag_tout_max_tq_amt "Maximum number of missing message events before error detection of BN2000 message" VALUE 0x00667 _REC_VAL_20_u1 255. _CNV_A_R_LINEAR_____1_CM 0. 255. DISPLAY_IDENTIFIER C_CTR_DIAG_TOUT_MAX_TQ_AMT FORMAT "%3.0" /end CHARACTERISTIC
/begin CHARACTERISTIC c_ctr_diag_tout_max_acc "Maximum number of missing message events before error detection of BN2000 message" VALUE 0x0065a _REC_VAL_20_u1 255. _CNV_A_R_LINEAR_____1_CM 0. 255. DISPLAY_IDENTIFIER C_CTR_DIAG_TOUT_MAX_ACC FORMAT "%3.0" /end CHARACTERISTIC
/begin CHARACTERISTIC c_ctr_diag_tout_max_t_icl "Maximum number of missing message events before error detection of BN2000 message" VALUE 0x00665 _REC_VAL_20_u1 255. _CNV_A_R_LINEAR_____1_CM 0. 255. DISPLAY_IDENTIFIER C_CTR_DIAG_TOUT_MAX_T_ICL FORMAT "%3.0" /end CHARACTERISTIC
/begin CHARACTERISTIC c_ctr_diag_tout_max_veh_mod "Maximum number of missing message events before error detection of BN2000 message" VALUE 0x0066c _REC_VAL_20_u1 255. _CNV_A_R_LINEAR_____1_CM 0. 255. DISPLAY_IDENTIFIER C_CTR_DIAG_TOUT_MAX_VEH_MOD FORMAT "%3.0" /end CHARACTERISTIC
/begin CHARACTERISTIC c_ctr_diag_tout_max_km_icl "Maximum number of missing message events before error detection of BN2000 message" VALUE 0x00661 _REC_VAL_20_u1 255. _CNV_A_R_LINEAR_____1_CM 0. 255. DISPLAY_IDENTIFIER C_CTR_DIAG_TOUT_MAX_KM_ICL FORMAT "%3.0" /end CHARACTERISTIC
/begin CHARACTERISTIC c_ctr_diag_tout_max_icl "Maximum number of missing message events before error detection of BN2000 message" VALUE 0x00660 _REC_VAL_20_u1 255. _CNV_A_R_LINEAR_____1_CM 0. 255. DISPLAY_IDENTIFIER C_CTR_DIAG_TOUT_MAX_ICL FORMAT "%3.0" /end CHARACTERISTIC
/begin CHARACTERISTIC c_ctr_diag_tout_max_pow_vb "Maximum number of missing message events before error detection of BN2000 message" VALUE 0x00664 _REC_VAL_20_u1 255. _CNV_A_R_LINEAR_____1_CM 0. 255. DISPLAY_IDENTIFIER C_CTR_DIAG_TOUT_MAX_POW_VB FORMAT "%3.0" /end CHARACTERISTIC
/begin CHARACTERISTIC c_ctr_diag_tout_max_pow_gen "Maximum number of missing message events before error detection of BN2000 message" VALUE 0x00663 _REC_VAL_20_u1 255. _CNV_A_R_LINEAR_____1_CM 0. 255. DISPLAY_IDENTIFIER C_CTR_DIAG_TOUT_MAX_POW_GEN FORMAT "%3.0" /end CHARACTERISTIC
/begin CHARACTERISTIC c_ctr_diag_tout_max_msw "Maximum number of missing message events before error detection of BN2000 message" VALUE 0x00662 _REC_VAL_20_u1 255. _CNV_A_R_LINEAR_____1_CM 0. 255. DISPLAY_IDENTIFIER C_CTR_DIAG_TOUT_MAX_MSW FORMAT "%3.0" /end CHARACTERISTIC
/begin CHARACTERISTIC c_ctr_diag_tout_max_etcu "Maximum number of missing message events before error detection of BN2000 message" VALUE 0x0065f _REC_VAL_20_u1 255. _CNV_A_R_LINEAR_____1_CM 0. 255. DISPLAY_IDENTIFIER C_CTR_DIAG_TOUT_MAX_ETCU FORMAT "%3.0" /end CHARACTERISTIC
/begin CHARACTERISTIC c_ctr_diag_tout_max_ang_pste "Maximum number of missing message events before error detection of BN2000 message" VALUE 0x0065b _REC_VAL_20_u1 255. _CNV_A_R_LINEAR_____1_CM 0. 255. DISPLAY_IDENTIFIER C_CTR_DIAG_TOUT_MAX_ANG_PSTE FORMAT "%3.0" /end CHARACTERISTIC
/begin CHARACTERISTIC c_abc_max_bn_ars "Maximum value of the anti - bounce counter BN2000 diagnosis" VALUE 0x0057f _REC_VAL_20_u1 254. _CNV_A_R_LINEAR_____1_CM 1. 255. DISPLAY_IDENTIFIER C_ABC_MAX_BN_ARS FORMAT "%3.0" /end CHARACTERISTIC
/begin CHARACTERISTIC c_abc_inc_bn_ars "Anti - bounce counter increment BN2000 Diagnosis" VALUE 0x00513 _REC_VAL_20_u1 255. _CNV_A_R_LINEAR_____1_CM 0. 255. DISPLAY_IDENTIFIER C_ABC_INC_BN_ARS FORMAT "%3.0" /end CHARACTERISTIC
/begin CHARACTERISTIC c_abc_dec_bn_tq_dcc "Anti - bounce counter increment BN2000 Diagnosis" VALUE 0x00506 _REC_VAL_20_u1 255. _CNV_A_R_LINEAR_____1_CM 0. 255. DISPLAY_IDENTIFIER C_ABC_DEC_BN_TQ_DCC FORMAT "%3.0" /end CHARACTERISTIC
/begin CHARACTERISTIC c_abc_dec_bn_ars "Anti - bounce counter increment BN2000 Diagnosis" VALUE 0x004fa _REC_VAL_20_u1 255. _CNV_A_R_LINEAR_____1_CM 0. 255. DISPLAY_IDENTIFIER C_ABC_DEC_BN_ARS FORMAT "%3.0" /end CHARACTERISTIC
/begin CHARACTERISTIC c_abc_dec_bn_cas "Anti - bounce counter increment BN2000 Diagnosis" VALUE 0x004fb _REC_VAL_20_u1 255. _CNV_A_R_LINEAR_____1_CM 0. 255. DISPLAY_IDENTIFIER C_ABC_DEC_BN_CAS FORMAT "%3.0" /end CHARACTERISTIC
/begin CHARACTERISTIC c_abc_dec_bn_tq_tcs "Anti - bounce counter increment BN2000 Diagnosis" VALUE 0x00509 _REC_VAL_20_u1 255. _CNV_A_R_LINEAR_____1_CM 0. 255. DISPLAY_IDENTIFIER C_ABC_DEC_BN_TQ_TCS FORMAT "%3.0" /end CHARACTERISTIC
/begin CHARACTERISTIC c_abc_dec_bn_vs_tcs "Anti - bounce counter increment BN2000 Diagnosis" VALUE 0x0050b _REC_VAL_20_u1 255. _CNV_A_R_LINEAR_____1_CM 0. 255. DISPLAY_IDENTIFIER C_ABC_DEC_BN_VS_TCS FORMAT "%3.0" /end CHARACTERISTIC
/begin CHARACTERISTIC c_abc_dec_bn_tcs "Anti - bounce counter increment BN2000 Diagnosis" VALUE 0x00504 _REC_VAL_20_u1 255. _CNV_A_R_LINEAR_____1_CM 0. 255. DISPLAY_IDENTIFIER C_ABC_DEC_BN_TCS FORMAT "%3.0" /end CHARACTERISTIC
/begin CHARACTERISTIC c_abc_dec_bn_tq_etcu "Anti - bounce counter increment BN2000 Diagnosis" VALUE 0x00507 _REC_VAL_20_u1 255. _CNV_A_R_LINEAR_____1_CM 0. 255. DISPLAY_IDENTIFIER C_ABC_DEC_BN_TQ_ETCU FORMAT "%3.0" /end CHARACTERISTIC
/begin CHARACTERISTIC c_abc_dec_bn_etcu "Anti - bounce counter increment BN2000 Diagnosis" VALUE 0x004fd _REC_VAL_20_u1 255. _CNV_A_R_LINEAR_____1_CM 0. 255. DISPLAY_IDENTIFIER C_ABC_DEC_BN_ETCU FORMAT "%3.0" /end CHARACTERISTIC
/begin CHARACTERISTIC c_abc_dec_bn_tq_amt "Anti - bounce counter increment BN2000 Diagnosis" VALUE 0x00505 _REC_VAL_20_u1 255. _CNV_A_R_LINEAR_____1_CM 0. 255. DISPLAY_IDENTIFIER C_ABC_DEC_BN_TQ_AMT FORMAT "%3.0" /end CHARACTERISTIC
/begin CHARACTERISTIC c_abc_dec_bn_acc "Anti - bounce counter increment BN2000 Diagnosis" VALUE 0x004f8 _REC_VAL_20_u1 255. _CNV_A_R_LINEAR_____1_CM 0. 255. DISPLAY_IDENTIFIER C_ABC_DEC_BN_ACC FORMAT "%3.0" /end CHARACTERISTIC
/begin CHARACTERISTIC c_abc_dec_bn_icl "Anti - bounce counter increment BN2000 Diagnosis" VALUE 0x004fe _REC_VAL_20_u1 255. _CNV_A_R_LINEAR_____1_CM 0. 255. DISPLAY_IDENTIFIER C_ABC_DEC_BN_ICL FORMAT "%3.0" /end CHARACTERISTIC
/begin CHARACTERISTIC c_abc_dec_bn_km_icl "Anti - bounce counter increment BN2000 Diagnosis" VALUE 0x004ff _REC_VAL_20_u1 255. _CNV_A_R_LINEAR_____1_CM 0. 255. DISPLAY_IDENTIFIER C_ABC_DEC_BN_KM_ICL FORMAT "%3.0" /end CHARACTERISTIC
/begin CHARACTERISTIC c_abc_dec_bn_t_icl "Anti - bounce counter increment BN2000 Diagnosis" VALUE 0x00503 _REC_VAL_20_u1 255. _CNV_A_R_LINEAR_____1_CM 0. 255. DISPLAY_IDENTIFIER C_ABC_DEC_BN_T_ICL FORMAT "%3.0" /end CHARACTERISTIC
/begin CHARACTERISTIC c_abc_dec_bn_pow_vb "Anti - bounce counter increment BN2000 Diagnosis" VALUE 0x00502 _REC_VAL_20_u1 255. _CNV_A_R_LINEAR_____1_CM 0. 255. DISPLAY_IDENTIFIER C_ABC_DEC_BN_POW_VB FORMAT "%3.0" /end CHARACTERISTIC
/begin CHARACTERISTIC c_abc_dec_bn_pow_gen "Anti - bounce counter increment BN2000 Diagnosis" VALUE 0x00501 _REC_VAL_20_u1 255. _CNV_A_R_LINEAR_____1_CM 0. 255. DISPLAY_IDENTIFIER C_ABC_DEC_BN_POW_GEN FORMAT "%3.0" /end CHARACTERISTIC
/begin CHARACTERISTIC c_abc_dec_bn_msw "Anti - bounce counter increment BN2000 Diagnosis" VALUE 0x00500 _REC_VAL_20_u1 255. _CNV_A_R_LINEAR_____1_CM 0. 255. DISPLAY_IDENTIFIER C_ABC_DEC_BN_MSW FORMAT "%3.0" /end CHARACTERISTIC
/begin CHARACTERISTIC c_abc_dec_bn_ang_pste "Anti - bounce counter increment BN2000 Diagnosis" VALUE 0x004f9 _REC_VAL_20_u1 255. _CNV_A_R_LINEAR_____1_CM 0. 255. DISPLAY_IDENTIFIER C_ABC_DEC_BN_ANG_PSTE FORMAT "%3.0" /end CHARACTERISTIC
/begin CHARACTERISTIC c_abc_dec_bn_veh_mod "Anti - bounce counter increment BN2000 Diagnosis" VALUE 0x0050a _REC_VAL_20_u1 255. _CNV_A_R_LINEAR_____1_CM 0. 255. DISPLAY_IDENTIFIER C_ABC_DEC_BN_VEH_MOD FORMAT "%3.0" /end CHARACTERISTIC
/begin CHARACTERISTIC c_abc_inc_bn_tq_pste_2 "Anti - bounce counter increment BN2000 Diagnosis" VALUE 0x00521 _REC_VAL_20_u1 255. _CNV_A_R_LINEAR_____1_CM 0. 255. DISPLAY_IDENTIFIER C_ABC_INC_BN_TQ_PSTE_2 FORMAT "%3.0" /end CHARACTERISTIC
/begin CHARACTERISTIC c_abc_max_bn_tq_pste_2 "Maximum value of the anti - bounce counter BN2000 diagnosis" VALUE 0x0058d _REC_VAL_20_u1 254. _CNV_A_R_LINEAR_____1_CM 1. 255. DISPLAY_IDENTIFIER C_ABC_MAX_BN_TQ_PSTE_2 FORMAT "%3.0" /end CHARACTERISTIC
/begin CHARACTERISTIC c_abc_dec_bn_tq_pste_2 "Anti - bounce counter increment BN2000 Diagnosis" VALUE 0x00508 _REC_VAL_20_u1 255. _CNV_A_R_LINEAR_____1_CM 0. 255. DISPLAY_IDENTIFIER C_ABC_DEC_BN_TQ_PSTE_2 FORMAT "%3.0" /end CHARACTERISTIC
/begin CHARACTERISTIC c_ctr_diag_tcc_can_max_tq_pste_2 "Maximum number of wrong ATCC_CAN count events before error detection of BN2000 message" VALUE 0x00657 _REC_VAL_20_u1 255. _CNV_A_R_LINEAR_____1_CM 0. 255. DISPLAY_IDENTIFIER C_CTR_DIAG_TCC_CAN_MAX_TQ_PSTE_2 FORMAT "%3.0" /end CHARACTERISTIC
/begin CHARACTERISTIC c_ctr_diag_cks_max_tq_pste_2 "Maximum number of wrong checksum calculation events before error detection of BN2000 message" VALUE 0x0064b _REC_VAL_20_u1 255. _CNV_A_R_LINEAR_____1_CM 0. 255. DISPLAY_IDENTIFIER C_CTR_DIAG_CKS_MAX_TQ_PSTE_2 FORMAT "%3.0" /end CHARACTERISTIC
/begin CHARACTERISTIC c_ctr_diag_tout_max_tq_pste_2 "Maximum number of missing message events before error detection of BN2000 message" VALUE 0x0066a _REC_VAL_20_u1 255. _CNV_A_R_LINEAR_____1_CM 0. 255. DISPLAY_IDENTIFIER C_CTR_DIAG_TOUT_MAX_TQ_PSTE_2 FORMAT "%3.0" /end CHARACTERISTIC
/begin CHARACTERISTIC c_abc_inc_bn_efp "Anti - bounce counter increment BN2000 Diagnosis" VALUE 0x00515 _REC_VAL_20_u1 255. _CNV_A_R_LINEAR_____1_CM 0. 255. DISPLAY_IDENTIFIER C_ABC_INC_BN_EFP FORMAT "%3.0" /end CHARACTERISTIC
/begin CHARACTERISTIC c_abc_max_bn_efp "Maximum value of the anti - bounce counter BN2000 diagnosis" VALUE 0x00581 _REC_VAL_20_u1 254. _CNV_A_R_LINEAR_____1_CM 1. 255. DISPLAY_IDENTIFIER C_ABC_MAX_BN_EFP FORMAT "%3.0" /end CHARACTERISTIC
/begin CHARACTERISTIC c_abc_dec_bn_efp "Anti - bounce counter increment BN2000 Diagnosis" VALUE 0x004fc _REC_VAL_20_u1 255. _CNV_A_R_LINEAR_____1_CM 0. 255. DISPLAY_IDENTIFIER C_ABC_DEC_BN_EFP FORMAT "%3.0" /end CHARACTERISTIC
/begin CHARACTERISTIC c_ctr_diag_tout_max_efp "Maximum number of missing message events before error detection of BN2000 message" VALUE 0x0065e _REC_VAL_20_u1 255. _CNV_A_R_LINEAR_____1_CM 0. 255. DISPLAY_IDENTIFIER C_CTR_DIAG_TOUT_MAX_EFP FORMAT "%3.0" /end CHARACTERISTIC
/begin CHARACTERISTIC c_abc_inc_bsd "Anti - bounce counter increment" VALUE 0x00525 _REC_VAL_20_u1 255. _CNV_A_R_LINEAR_____1_CM 0. 255. DISPLAY_IDENTIFIER C_ABC_INC_BSD FORMAT "%3.0" /end CHARACTERISTIC
/begin CHARACTERISTIC c_abc_max_bsd "Debounce counter maximum value" VALUE 0x00591 _REC_VAL_20_u1 254. _CNV_A_R_LINEAR_____1_CM 1. 255. DISPLAY_IDENTIFIER C_ABC_MAX_BSD FORMAT "%3.0" /end CHARACTERISTIC
/begin CHARACTERISTIC c_abc_inc_cam_per_0 "anti-bounce counter increment for CAM_0 camshaft period error diagnosis" VALUE 0x00526 _REC_VAL_20_u1 255. _CNV_A_R_LINEAR_____1_CM 0. 255. DISPLAY_IDENTIFIER C_ABC_INC_CAM_PER_0 FORMAT "%3.0" /end CHARACTERISTIC
/begin CHARACTERISTIC c_abc_inc_cam_per_1 "anti-bounce counter increment for CAM_1 camshaft period error diagnosis" VALUE 0x00527 _REC_VAL_20_u1 255. _CNV_A_R_LINEAR_____1_CM 0. 255. DISPLAY_IDENTIFIER C_ABC_INC_CAM_PER_1 FORMAT "%3.0" /end CHARACTERISTIC
/begin CHARACTERISTIC c_abc_max_cam_per_1 "maximum value of the anti-bounce counter for CAM_1 camshaft period error diagnosis" VALUE 0x00593 _REC_VAL_20_u1 254. _CNV_A_R_LINEAR_____1_CM 1. 255. DISPLAY_IDENTIFIER C_ABC_MAX_CAM_PER_1 FORMAT "%3.0" /end CHARACTERISTIC
/begin CHARACTERISTIC c_abc_max_cam_per_0 "maximum value of the anti-bounce counter for CAM_0 camshaft period error diagnosis" VALUE 0x00592 _REC_VAL_20_u1 254. _CNV_A_R_LINEAR_____1_CM 1. 255. DISPLAY_IDENTIFIER C_ABC_MAX_CAM_PER_0 FORMAT "%3.0" /end CHARACTERISTIC
/begin CHARACTERISTIC c_abc_inc_cam_psn_1 "anti-bounce counter increment for CAM_1 camshaft position diagnosis" VALUE 0x00529 _REC_VAL_20_u1 255. _CNV_A_R_LINEAR_____1_CM 0. 255. DISPLAY_IDENTIFIER C_ABC_INC_CAM_PSN_1 FORMAT "%3.0" /end CHARACTERISTIC
/begin CHARACTERISTIC c_abc_max_cam_psn_0 "maximum value of the anti-bounce counter for CAM_0 camshaft position diagnosis" VALUE 0x00594 _REC_VAL_20_u1 254. _CNV_A_R_LINEAR_____1_CM 1. 255. DISPLAY_IDENTIFIER C_ABC_MAX_CAM_PSN_0 FORMAT "%3.0" /end CHARACTERISTIC
/begin CHARACTERISTIC c_abc_max_cam_psn_1 "maximum value of the anti-bounce counter for CAM_1 camshaft position diagnosis" VALUE 0x00595 _REC_VAL_20_u1 254. _CNV_A_R_LINEAR_____1_CM 1. 255. DISPLAY_IDENTIFIER C_ABC_MAX_CAM_PSN_1 FORMAT "%3.0" /end CHARACTERISTIC
/begin CHARACTERISTIC c_abc_inc_cam_psn_0 "anti-bounce counter increment for CAM_0 camshaft position diagnosis" VALUE 0x00528 _REC_VAL_20_u1 255. _CNV_A_R_LINEAR_____1_CM 0. 255. DISPLAY_IDENTIFIER C_ABC_INC_CAM_PSN_0 FORMAT "%3.0" /end CHARACTERISTIC
/begin CHARACTERISTIC c_abc_inc_tout_asr_3 "anti bounce counter increment  - diagnosis of timeout CAN message ASC3" VALUE 0x0055d _REC_VAL_20_u1 255. _CNV_A_R_LINEAR_____1_CM 0. 255. DISPLAY_IDENTIFIER C_ABC_INC_TOUT_ASR_3 FORMAT "%3.0" /end CHARACTERISTIC
/begin CHARACTERISTIC c_abc_max_tout_asr_3 "anti bounce counter maximum value  - diagnosis of timeout CAN message ASC3 " VALUE 0x005c4 _REC_VAL_20_u1 254. _CNV_A_R_LINEAR_____1_CM 1. 255. DISPLAY_IDENTIFIER C_ABC_MAX_TOUT_ASR_3 FORMAT "%3.0" /end CHARACTERISTIC
/begin CHARACTERISTIC c_abc_inc_can_boff "anti bounce counter increment  - diagnosis of CAN bus on / off" VALUE 0x0052a _REC_VAL_20_u1 255. _CNV_A_R_LINEAR_____1_CM 0. 255. DISPLAY_IDENTIFIER C_ABC_INC_CAN_BOFF FORMAT "%3.0" /end CHARACTERISTIC
/begin CHARACTERISTIC c_abc_max_can_boff "anti bounce counter maximum value  - diagnosis of CAN bus on / off" VALUE 0x00596 _REC_VAL_20_u1 254. _CNV_A_R_LINEAR_____1_CM 1. 255. DISPLAY_IDENTIFIER C_ABC_MAX_CAN_BOFF FORMAT "%3.0" /end CHARACTERISTIC
/begin CHARACTERISTIC c_abc_inc_tout_asr_1 "anti bounce counter increment  - diagnosis of timeout CAN message ASC1" VALUE 0x0055c _REC_VAL_20_u1 255. _CNV_A_R_LINEAR_____1_CM 0. 255. DISPLAY_IDENTIFIER C_ABC_INC_TOUT_ASR_1 FORMAT "%3.0" /end CHARACTERISTIC
/begin CHARACTERISTIC c_abc_max_tout_asr_1 "anti bounce counter maximum value  - diagnosis of timeout CAN message ASC1 " VALUE 0x005c3 _REC_VAL_20_u1 254. _CNV_A_R_LINEAR_____1_CM 1. 255. DISPLAY_IDENTIFIER C_ABC_MAX_TOUT_ASR_1 FORMAT "%3.0" /end CHARACTERISTIC
/begin CHARACTERISTIC c_abc_inc_tout_asr_4 "anti bounce counter increment  - diagnosis of timeout CAN message ASC4" VALUE 0x0055e _REC_VAL_20_u1 255. _CNV_A_R_LINEAR_____1_CM 0. 255. DISPLAY_IDENTIFIER C_ABC_INC_TOUT_ASR_4 FORMAT "%3.0" /end CHARACTERISTIC
/begin CHARACTERISTIC c_abc_max_tout_asr_4 "anti bounce counter maximum value  - diagnosis of timeout CAN message ASC4 " VALUE 0x005c5 _REC_VAL_20_u1 254. _CNV_A_R_LINEAR_____1_CM 1. 255. DISPLAY_IDENTIFIER C_ABC_MAX_TOUT_ASR_4 FORMAT "%3.0" /end CHARACTERISTIC
/begin CHARACTERISTIC c_abc_inc_tout_efp "anti bounce counter increment  - diagnosis of timeout CAN message EFP" VALUE 0x0055f _REC_VAL_20_u1 255. _CNV_A_R_LINEAR_____1_CM 0. 255. DISPLAY_IDENTIFIER C_ABC_INC_TOUT_EFP FORMAT "%3.0" /end CHARACTERISTIC
/begin CHARACTERISTIC c_abc_max_tout_efp "anti bounce counter maximum value  - diagnosis of timeout CAN message EFP" VALUE 0x005c6 _REC_VAL_20_u1 254. _CNV_A_R_LINEAR_____1_CM 1. 255. DISPLAY_IDENTIFIER C_ABC_MAX_TOUT_EFP FORMAT "%3.0" /end CHARACTERISTIC
/begin CHARACTERISTIC c_abc_inc_locan_boff "Debounce counter increment - diagnosis of LOCAN bus on / off" VALUE 0x0053e _REC_VAL_20_u1 255. _CNV_A_R_LINEAR_____1_CM 0. 255. DISPLAY_IDENTIFIER C_ABC_INC_LOCAN_BOFF FORMAT "%3.0" /end CHARACTERISTIC
/begin CHARACTERISTIC c_abc_max_locan_boff "debounce counter maximum value - diagnosis of LOCAN bus on / off" VALUE 0x005a8 _REC_VAL_20_u1 254. _CNV_A_R_LINEAR_____1_CM 1. 255. DISPLAY_IDENTIFIER C_ABC_MAX_LOCAN_BOFF FORMAT "%3.0" /end CHARACTERISTIC
/begin CHARACTERISTIC c_abc_inc_tout_etcu_1 "anti bounce counter increment  - diagnosis of timeout CAN message EGS1" VALUE 0x00560 _REC_VAL_20_u1 255. _CNV_A_R_LINEAR_____1_CM 0. 255. DISPLAY_IDENTIFIER C_ABC_INC_TOUT_ETCU_1 FORMAT "%3.0" /end CHARACTERISTIC
/begin CHARACTERISTIC c_abc_inc_tout_etcu_2 "anti bounce counter increment  - diagnosis of timeout CAN message EGS2" VALUE 0x00561 _REC_VAL_20_u1 255. _CNV_A_R_LINEAR_____1_CM 0. 255. DISPLAY_IDENTIFIER C_ABC_INC_TOUT_ETCU_2 FORMAT "%3.0" /end CHARACTERISTIC
/begin CHARACTERISTIC c_abc_max_tout_etcu_1 "anti bounce counter maximum value  - diagnosis of timeout CAN message EGS1 " VALUE 0x005c7 _REC_VAL_20_u1 254. _CNV_A_R_LINEAR_____1_CM 1. 255. DISPLAY_IDENTIFIER C_ABC_MAX_TOUT_ETCU_1 FORMAT "%3.0" /end CHARACTERISTIC
/begin CHARACTERISTIC c_abc_max_tout_etcu_2 "anti bounce counter maximum value  - diagnosis of timeout CAN message EGS2" VALUE 0x005c8 _REC_VAL_20_u1 254. _CNV_A_R_LINEAR_____1_CM 1. 255. DISPLAY_IDENTIFIER C_ABC_MAX_TOUT_ETCU_2 FORMAT "%3.0" /end CHARACTERISTIC
/begin CHARACTERISTIC c_abc_inc_tout_icl_2 "anti bounce counter increment  - diagnosis of timeout CAN message INSTR2" VALUE 0x00562 _REC_VAL_20_u1 255. _CNV_A_R_LINEAR_____1_CM 0. 255. DISPLAY_IDENTIFIER C_ABC_INC_TOUT_ICL_2_ FORMAT "%3.0" /end CHARACTERISTIC
/begin CHARACTERISTIC c_abc_max_tout_icl_2 "anti bounce counter maximum value  - diagnosis of timeout CAN message INSTR2" VALUE 0x005c9 _REC_VAL_20_u1 254. _CNV_A_R_LINEAR_____1_CM 1. 255. DISPLAY_IDENTIFIER C_ABC_MAX_TOUT_ICL_2 FORMAT "%3.0" /end CHARACTERISTIC
/begin CHARACTERISTIC c_abc_inc_tout_icl_3 "anti bounce counter increment  - diagnosis of timeout CAN message INSTR3" VALUE 0x00563 _REC_VAL_20_u1 255. _CNV_A_R_LINEAR_____1_CM 0. 255. DISPLAY_IDENTIFIER C_ABC_INC_TOUT_ICL_3_ FORMAT "%3.0" /end CHARACTERISTIC
/begin CHARACTERISTIC c_abc_max_tout_icl_3 "anti bounce counter maximum value  - diagnosis of timeout CAN message INSTR3" VALUE 0x005ca _REC_VAL_20_u1 254. _CNV_A_R_LINEAR_____1_CM 1. 255. DISPLAY_IDENTIFIER C_ABC_MAX_TOUT_ICL_3 FORMAT "%3.0" /end CHARACTERISTIC
/begin CHARACTERISTIC c_abc_inc_tout_pste_1 "anti bounce counter increment  - diagnosis of timeout CAN message EGS2" VALUE 0x00564 _REC_VAL_20_u1 255. _CNV_A_R_LINEAR_____1_CM 0. 255. DISPLAY_IDENTIFIER C_ABC_INC_TOUT_PSTE_1 FORMAT "%3.0" /end CHARACTERISTIC
/begin CHARACTERISTIC c_abc_max_tout_pste_1 "anti bounce counter maximum value  - diagnosis of timeout CAN message LWS1" VALUE 0x005cb _REC_VAL_20_u1 254. _CNV_A_R_LINEAR_____1_CM 1. 255. DISPLAY_IDENTIFIER C_ABC_MAX_TOUT_PSTE_1 FORMAT "%3.0" /end CHARACTERISTIC
/begin CHARACTERISTIC c_abc_inc_dcc_inh_mon "Anti bounce counter increment" VALUE 0x11d49 _REC_VAL_20_u1 255. _CNV_A_R_LINEAR_____1_CM 0. 255. DISPLAY_IDENTIFIER C_ABC_INC_DCC_INH_MON FORMAT "%3.0" /end CHARACTERISTIC
/begin CHARACTERISTIC c_abc_max_dcc_inh_mon "Maximum value of anti-bounce counter" VALUE 0x11d5e _REC_VAL_20_u1 254. _CNV_A_R_LINEAR_____1_CM 1. 255. DISPLAY_IDENTIFIER C_ABC_MAX_DCC_INH_MON FORMAT "%3.0" /end CHARACTERISTIC
/begin CHARACTERISTIC c_abc_inc_dcc_rev_mon "Increment counter" VALUE 0x11d4b _REC_VAL_20_u1 255. _CNV_A_R_LINEAR_____1_CM 0. 255. DISPLAY_IDENTIFIER C_ABC_INC_DCC_REV_MON FORMAT "%3.0" /end CHARACTERISTIC
/begin CHARACTERISTIC c_abc_max_dcc_rev_mon "Maximum counter" VALUE 0x11d60 _REC_VAL_20_u1 254. _CNV_A_R_LINEAR_____1_CM 1. 255. DISPLAY_IDENTIFIER C_ABC_MAX_DCC_REV_MON FORMAT "%3.0" /end CHARACTERISTIC
/begin CHARACTERISTIC c_abc_inc_dcc_irrev_mon "Increment counter" VALUE 0x11d4a _REC_VAL_20_u1 255. _CNV_A_R_LINEAR_____1_CM 0. 255. DISPLAY_IDENTIFIER C_ABC_INC_DCC_IRREV_MON FORMAT "%3.0" /end CHARACTERISTIC
/begin CHARACTERISTIC c_abc_max_dcc_irrev_mon "Maximum counter" VALUE 0x11d5f _REC_VAL_20_u1 254. _CNV_A_R_LINEAR_____1_CM 1. 255. DISPLAY_IDENTIFIER C_ABC_MAX_DCC_IRREV_MON FORMAT "%3.0" /end CHARACTERISTIC
/begin CHARACTERISTIC c_abc_inc_amt_inh_mon "Anti bounce counter increment" VALUE 0x11d46 _REC_VAL_20_u1 255. _CNV_A_R_LINEAR_____1_CM 0. 255. DISPLAY_IDENTIFIER C_ABC_INC_AMT_INH_MON FORMAT "%3.0" /end CHARACTERISTIC
/begin CHARACTERISTIC c_abc_max_amt_inh_mon "Maximum value of anti-bounce counter" VALUE 0x11d5b _REC_VAL_20_u1 254. _CNV_A_R_LINEAR_____1_CM 1. 255. DISPLAY_IDENTIFIER C_ABC_MAX_AMT_INH_MON FORMAT "%3.0" /end CHARACTERISTIC
/begin CHARACTERISTIC c_abc_inc_gs_inh_mon "Anti bounce counter increment" VALUE 0x11d4c _REC_VAL_20_u1 255. _CNV_A_R_LINEAR_____1_CM 0. 255. DISPLAY_IDENTIFIER C_ABC_INC_GS_INH_MON FORMAT "%3.0" /end CHARACTERISTIC
/begin CHARACTERISTIC c_abc_inc_tq_gs_inc_plaus_mon "Debounce counter increment - TQ_GS_INC Diagnosis" VALUE 0x11d55 _REC_VAL_20_u1 255. _CNV_A_R_LINEAR_____1_CM 0. 255. DISPLAY_IDENTIFIER C_ABC_INC_TQ_GS_INC_PLAUS_MON FORMAT "%3.0" /end CHARACTERISTIC
/begin CHARACTERISTIC c_abc_max_gs_inh_mon "Maximum value of anti-bounce counter" VALUE 0x11d61 _REC_VAL_20_u1 254. _CNV_A_R_LINEAR_____1_CM 1. 255. DISPLAY_IDENTIFIER C_ABC_MAX_GS_INH_MON FORMAT "%3.0" /end CHARACTERISTIC
/begin CHARACTERISTIC c_abc_max_tq_gs_inc_plaus_mon "Debounce counter maximum - TQ_GS_INC Diagnosis" VALUE 0x11d6a _REC_VAL_20_u1 254. _CNV_A_R_LINEAR_____1_CM 1. 255. DISPLAY_IDENTIFIER C_ABC_MAX_TQ_GS_INC_PLAUS_MON FORMAT "%3.0" /end CHARACTERISTIC
/begin CHARACTERISTIC c_abc_inc_tout_amt_1 "anti bounce counter increment  - diagnosis of timeout CAN message SSG1" VALUE 0x0055b _REC_VAL_20_u1 255. _CNV_A_R_LINEAR_____1_CM 0. 255. DISPLAY_IDENTIFIER C_ABC_INC_TOUT_AMT_1 FORMAT "%3.0" /end CHARACTERISTIC
/begin CHARACTERISTIC c_abc_max_tout_amt_1 "anti bounce counter maximum value  - diagnosis of timeout CAN message SSG1 " VALUE 0x005c2 _REC_VAL_20_u1 254. _CNV_A_R_LINEAR_____1_CM 1. 255. DISPLAY_IDENTIFIER C_ABC_MAX_TOUT_AMT_1 FORMAT "%3.0" /end CHARACTERISTIC
/begin CHARACTERISTIC c_abc_inc_tout_txu_1 "anti bounce counter increment  - diagnosis of timeout CAN message TXU1" VALUE 0x00565 _REC_VAL_20_u1 255. _CNV_A_R_LINEAR_____1_CM 0. 255. DISPLAY_IDENTIFIER C_ABC_INC_TOUT_TXU_1 FORMAT "%3.0" /end CHARACTERISTIC
/begin CHARACTERISTIC c_abc_max_tout_txu_1 "anti bounce counter maximum value  - diagnosis of timeout CAN message TXU1" VALUE 0x005cc _REC_VAL_20_u1 254. _CNV_A_R_LINEAR_____1_CM 1. 255. DISPLAY_IDENTIFIER C_ABC_MAX_TOUT_TXU_1 FORMAT "%3.0" /end CHARACTERISTIC
/begin CHARACTERISTIC c_abc_inc_eng_psn_prev_syn "anti-bounce counter increment engine position error previous engine synchronization" VALUE 0x00531 _REC_VAL_20_u1 255. _CNV_A_R_LINEAR_____1_CM 0. 255. DISPLAY_IDENTIFIER C_ABC_INC_ENG_PSN_PREV_SYN FORMAT "%3.0" /end CHARACTERISTIC
/begin CHARACTERISTIC c_abc_inc_eng_psn_dur_st "anti-bounce counter increment engine position error during start" VALUE 0x00530 _REC_VAL_20_u1 255. _CNV_A_R_LINEAR_____1_CM 0. 255. DISPLAY_IDENTIFIER C_ABC_INC_ENG_PSN_DUR_ST FORMAT "%3.0" /end CHARACTERISTIC
/begin CHARACTERISTIC c_abc_max_eng_psn "maximum value of the anti-bounce counter for engine position error" VALUE 0x0059b _REC_VAL_20_u1 254. _CNV_A_R_LINEAR_____1_CM 1. 255. DISPLAY_IDENTIFIER C_ABC_MAX_ENG_PSN FORMAT "%3.0" /end CHARACTERISTIC
/begin CHARACTERISTIC c_abc_inc_eng_psn_ast "anti-bounce counter increment engine position error after start" VALUE 0x0052f _REC_VAL_20_u1 255. _CNV_A_R_LINEAR_____1_CM 0. 255. DISPLAY_IDENTIFIER C_ABC_INC_ENG_PSN_AST FORMAT "%3.0" /end CHARACTERISTIC
/begin CHARACTERISTIC c_abc_inc_tooth_per_prev_syn "anti-bounce counter increment tooth period error previous engine synchronization" VALUE 0x0055a _REC_VAL_20_u1 255. _CNV_A_R_LINEAR_____1_CM 0. 255. DISPLAY_IDENTIFIER C_ABC_INC_TOOTH_PER_PREV_SYN FORMAT "%3.0" /end CHARACTERISTIC
/begin CHARACTERISTIC c_abc_inc_tooth_per_ast "anti-bounce counter increment tooth period error after start" VALUE 0x00558 _REC_VAL_20_u1 255. _CNV_A_R_LINEAR_____1_CM 0. 255. DISPLAY_IDENTIFIER C_ABC_INC_TOOTH_PER_AST FORMAT "%3.0" /end CHARACTERISTIC
/begin CHARACTERISTIC c_abc_max_tooth_per "maximum value of the anti-bounce counter for tooth period error" VALUE 0x005c1 _REC_VAL_20_u1 254. _CNV_A_R_LINEAR_____1_CM 1. 255. DISPLAY_IDENTIFIER C_ABC_MAX_TOOTH_PER FORMAT "%3.0" /end CHARACTERISTIC
/begin CHARACTERISTIC c_abc_inc_tooth_per_dur_st "anti-bounce counter increment tooth period error during start" VALUE 0x00559 _REC_VAL_20_u1 255. _CNV_A_R_LINEAR_____1_CM 0. 255. DISPLAY_IDENTIFIER C_ABC_INC_TOOTH_PER_DUR_ST FORMAT "%3.0" /end CHARACTERISTIC
/begin CHARACTERISTIC c_abc_inc_tpu_syn_prev_syn "anti-bounce counter increment TPU synchronization error previous engine synchronization" VALUE 0x0056b _REC_VAL_20_u1 255. _CNV_A_R_LINEAR_____1_CM 0. 255. DISPLAY_IDENTIFIER C_ABC_INC_TPU_SYN_PREV_SYN FORMAT "%3.0" /end CHARACTERISTIC
/begin CHARACTERISTIC c_abc_inc_tpu_syn_dur_st "anti-bounce counter increment TPU synchronization error during start" VALUE 0x0056a _REC_VAL_20_u1 255. _CNV_A_R_LINEAR_____1_CM 0. 255. DISPLAY_IDENTIFIER C_ABC_INC_TPU_SYN_DUR_ST FORMAT "%3.0" /end CHARACTERISTIC
/begin CHARACTERISTIC c_abc_max_tpu_syn "maximum value of the anti-bounce counter for TPU synchronization error" VALUE 0x005d0 _REC_VAL_20_u1 254. _CNV_A_R_LINEAR_____1_CM 1. 255. DISPLAY_IDENTIFIER C_ABC_MAX_TPU_SYN FORMAT "%3.0" /end CHARACTERISTIC
/begin CHARACTERISTIC c_abc_inc_tpu_syn_ast "anti-bounce counter increment TPU synchronization error after start" VALUE 0x00569 _REC_VAL_20_u1 255. _CNV_A_R_LINEAR_____1_CM 0. 255. DISPLAY_IDENTIFIER C_ABC_INC_TPU_SYN_AST FORMAT "%3.0" /end CHARACTERISTIC
/begin CHARACTERISTIC c_abc_inc_crk_not_plaus "Anti bounce counter increment crankshaft sensor signal not plausible" VALUE 0x0052b _REC_VAL_20_u1 255. _CNV_A_R_LINEAR_____1_CM 0. 255. DISPLAY_IDENTIFIER C_ABC_INC_CRK_NOT_PLAUS FORMAT "%3.0" /end CHARACTERISTIC
/begin CHARACTERISTIC c_abc_max_crk_not_plaus "Maximum of anti bounce counter sensor signal not plausible" VALUE 0x00597 _REC_VAL_20_u1 254. _CNV_A_R_LINEAR_____1_CM 1. 255. DISPLAY_IDENTIFIER C_ABC_MAX_CRK_NOT_PLAUS FORMAT "%3.0" /end CHARACTERISTIC
/begin CHARACTERISTIC c_abc_inc_dcc "Increment counter" VALUE 0x0052d _REC_VAL_20_u1 255. _CNV_A_R_LINEAR_____1_CM 0. 255. DISPLAY_IDENTIFIER C_ABC_INC_DCC FORMAT "%3.0" /end CHARACTERISTIC
/begin CHARACTERISTIC c_abc_max_dcc "Maximum counter" VALUE 0x00599 _REC_VAL_20_u1 254. _CNV_A_R_LINEAR_____1_CM 1. 255. DISPLAY_IDENTIFIER C_ABC_MAX_DCC FORMAT "%3.0" /end CHARACTERISTIC
/begin CHARACTERISTIC c_abc_inc_cs "Anti bounce increment CS diagnosis" VALUE 0x0052c _REC_VAL_20_u1 255. _CNV_A_R_LINEAR_____1_CM 0. 255. DISPLAY_IDENTIFIER C_ABC_INC_CS FORMAT "%3.0" /end CHARACTERISTIC
/begin CHARACTERISTIC c_abc_max_cs "Anti bounce maximum CS diagnosis" VALUE 0x00598 _REC_VAL_20_u1 254. _CNV_A_R_LINEAR_____1_CM 1. 255. DISPLAY_IDENTIFIER C_ABC_MAX_CS FORMAT "%3.0" /end CHARACTERISTIC
/begin CHARACTERISTIC c_abc_inc_ect_mec "Debounce counter increment - Thermostat heating diagnosis" VALUE 0x0052e _REC_VAL_20_u1 255. _CNV_A_R_LINEAR_____1_CM 0. 255. DISPLAY_IDENTIFIER C_ABC_INC_ECT_MEC FORMAT "%3.0" /end CHARACTERISTIC
/begin CHARACTERISTIC c_abc_max_ect_mec "Debounce counter maximum value - Thermostat heating diagnosis" VALUE 0x0059a _REC_VAL_20_u1 254. _CNV_A_R_LINEAR_____1_CM 1. 255. DISPLAY_IDENTIFIER C_ABC_MAX_ECT_MEC FORMAT "%3.0" /end CHARACTERISTIC
/begin CHARACTERISTIC lc_abc_bench "logical constant to manage the anti-bounce bench mode" VALUE 0x00ee0 _REC_VAL_20_u1 1. _CNV_A_R_LINEAR_____1_CM 0. 1. DISPLAY_IDENTIFIER LC_ABC_BENCH FORMAT "%2.0" /end CHARACTERISTIC
/begin CHARACTERISTIC lc_err_det_upd "logical constant to manage some functionality as the visualisation of the sporadic error" VALUE 0x00f23 _REC_VAL_20_u1 1. _CNV_A_R_LINEAR_____1_CM 0. 1. DISPLAY_IDENTIFIER LC_ERR_DET_UPD FORMAT "%2.0" /end CHARACTERISTIC
/begin MEASUREMENT fmy_stat_bn_vs_tcs.err_info_stat.lv_ready "" UBYTE _CNV_S_2_RANGE______5_CM 1 100. 0. 1. DISPLAY_IDENTIFIER LV_READY_BN_VS_TCS ECU_ADDRESS 0x3fbad1 BIT_MASK 0x40 /end MEASUREMENT
/begin MEASUREMENT fmy_stat_bn_vs_tcs.err_info_stat.lv_end_diag "" UBYTE _CNV_S_2_RANGE______5_CM 1 100. 0. 1. DISPLAY_IDENTIFIER LV_END_DIAG_BN_VS_TCS ECU_ADDRESS 0x3fbad1 BIT_MASK 0x20 /end MEASUREMENT
/begin MEASUREMENT fmy_stat_bn_vs_tcs.err_info_stat.lv_cdn_diag "" UBYTE _CNV_S_2_RANGE______5_CM 1 100. 0. 1. DISPLAY_IDENTIFIER LV_CDN_DIAG_BN_VS_TCS ECU_ADDRESS 0x3fbad1 BIT_MASK 0x10 /end MEASUREMENT
/begin MEASUREMENT fmy_stat_bn_vs_tcs.err_info_stat.err_sym "" UBYTE _CNV_S_6_RANGE_ERR__192_CM 1 100. 0. 15. DISPLAY_IDENTIFIER ERR_SYM_BN_VS_TCS ECU_ADDRESS 0x3fbad1 BIT_MASK 0xF /end MEASUREMENT
/begin MEASUREMENT fmy_stat_bn_tcs.ctr_abc "" UBYTE _CNV_A_R_LINEAR_____1_CM 1 100. 0. 255. DISPLAY_IDENTIFIER CTR_ABC_BN_TCS ECU_ADDRESS 0x3fbad7 FORMAT "%3.0" /end MEASUREMENT
/begin MEASUREMENT fmy_stat_bn_tcs.ctr_end_diag "" UBYTE _CNV_A_R_LINEAR_____1_CM 1 100. 0. 255. DISPLAY_IDENTIFIER CTR_ABC_END_DIAG_BN_TCS ECU_ADDRESS 0x3fbad6 FORMAT "%3.0" /end MEASUREMENT
/begin MEASUREMENT fmy_stat_bn_tcs.err_info_stat.lv_err_mem "" UBYTE _CNV_S_2_RANGE______5_CM 1 100. 0. 1. DISPLAY_IDENTIFIER LV_ERR_MEM_BN_TCS ECU_ADDRESS 0x3fbad5 BIT_MASK 0x80 /end MEASUREMENT
/begin MEASUREMENT fmy_stat_bn_tcs.err_info_stat.lv_ready "" UBYTE _CNV_S_2_RANGE______5_CM 1 100. 0. 1. DISPLAY_IDENTIFIER LV_READY_BN_TCS ECU_ADDRESS 0x3fbad5 BIT_MASK 0x40 /end MEASUREMENT
/begin MEASUREMENT fmy_stat_bn_tcs.err_info_stat.lv_end_diag "" UBYTE _CNV_S_2_RANGE______5_CM 1 100. 0. 1. DISPLAY_IDENTIFIER LV_END_DIAG_BN_TCS ECU_ADDRESS 0x3fbad5 BIT_MASK 0x20 /end MEASUREMENT
/begin MEASUREMENT fmy_stat_bn_tcs.err_info_stat.lv_cdn_diag "" UBYTE _CNV_S_2_RANGE______5_CM 1 100. 0. 1. DISPLAY_IDENTIFIER LV_CDN_DIAG_BN_TCS ECU_ADDRESS 0x3fbad5 BIT_MASK 0x10 /end MEASUREMENT
/begin MEASUREMENT fmy_stat_bn_tcs.err_info_stat.err_sym "" UBYTE _CNV_S_6_RANGE_ERR__192_CM 1 100. 0. 15. DISPLAY_IDENTIFIER ERR_SYM_BN_TCS ECU_ADDRESS 0x3fbad5 BIT_MASK 0xF /end MEASUREMENT
/begin MEASUREMENT fmy_stat_bn_tq_etcu.ctr_abc "" UBYTE _CNV_A_R_LINEAR_____1_CM 1 100. 0. 255. DISPLAY_IDENTIFIER CTR_ABC_BN_TQ_ETCU ECU_ADDRESS 0x3fbadb FORMAT "%3.0" /end MEASUREMENT
/begin MEASUREMENT fmy_stat_bn_tq_etcu.ctr_end_diag "" UBYTE _CNV_A_R_LINEAR_____1_CM 1 100. 0. 255. DISPLAY_IDENTIFIER CTR_ABC_END_DIAG_BN_TQ_ETCU ECU_ADDRESS 0x3fbada FORMAT "%3.0" /end MEASUREMENT
/begin MEASUREMENT fmy_stat_bn_tq_etcu.err_info_stat.lv_err_mem "" UBYTE _CNV_S_2_RANGE______5_CM 1 100. 0. 1. DISPLAY_IDENTIFIER LV_ERR_MEM_BN_TQ_ETCU ECU_ADDRESS 0x3fbad9 BIT_MASK 0x80 /end MEASUREMENT
/begin MEASUREMENT fmy_stat_bn_tq_etcu.err_info_stat.lv_ready "" UBYTE _CNV_S_2_RANGE______5_CM 1 100. 0. 1. DISPLAY_IDENTIFIER LV_READY_BN_TQ_ETCU ECU_ADDRESS 0x3fbad9 BIT_MASK 0x40 /end MEASUREMENT
/begin MEASUREMENT fmy_stat_bn_tq_etcu.err_info_stat.lv_end_diag "" UBYTE _CNV_S_2_RANGE______5_CM 1 100. 0. 1. DISPLAY_IDENTIFIER LV_END_DIAG_BN_TQ_ETCU ECU_ADDRESS 0x3fbad9 BIT_MASK 0x20 /end MEASUREMENT
/begin MEASUREMENT fmy_stat_bn_tq_etcu.err_info_stat.lv_cdn_diag "" UBYTE _CNV_S_2_RANGE______5_CM 1 100. 0. 1. DISPLAY_IDENTIFIER LV_CDN_DIAG_BN_TQ_ETCU ECU_ADDRESS 0x3fbad9 BIT_MASK 0x10 /end MEASUREMENT
/begin MEASUREMENT fmy_stat_bn_tq_etcu.err_info_stat.err_sym "" UBYTE _CNV_S_6_RANGE_ERR__192_CM 1 100. 0. 15. DISPLAY_IDENTIFIER ERR_SYM_BN_TQ_ETCU ECU_ADDRESS 0x3fbad9 BIT_MASK 0xF /end MEASUREMENT
/begin MEASUREMENT fmy_stat_bn_etcu.ctr_abc "" UBYTE _CNV_A_R_LINEAR_____1_CM 1 100. 0. 255. DISPLAY_IDENTIFIER CTR_ABC_BN_ETCU ECU_ADDRESS 0x3fbadf FORMAT "%3.0" /end MEASUREMENT
/begin MEASUREMENT fmy_stat_bn_etcu.ctr_end_diag "" UBYTE _CNV_A_R_LINEAR_____1_CM 1 100. 0. 255. DISPLAY_IDENTIFIER CTR_ABC_END_DIAG_BN_ETCU ECU_ADDRESS 0x3fbade FORMAT "%3.0" /end MEASUREMENT
/begin MEASUREMENT fmy_stat_bn_etcu.err_info_stat.lv_err_mem "" UBYTE _CNV_S_2_RANGE______5_CM 1 100. 0. 1. DISPLAY_IDENTIFIER LV_ERR_MEM_BN_ETCU ECU_ADDRESS 0x3fbadd BIT_MASK 0x80 /end MEASUREMENT
/begin MEASUREMENT fmy_stat_bn_etcu.err_info_stat.lv_ready "" UBYTE _CNV_S_2_RANGE______5_CM 1 100. 0. 1. DISPLAY_IDENTIFIER LV_READY_BN_ETCU ECU_ADDRESS 0x3fbadd BIT_MASK 0x40 /end MEASUREMENT
/begin MEASUREMENT fmy_stat_bn_etcu.err_info_stat.lv_end_diag "" UBYTE _CNV_S_2_RANGE______5_CM 1 100. 0. 1. DISPLAY_IDENTIFIER LV_END_DIAG_BN_ETCU ECU_ADDRESS 0x3fbadd BIT_MASK 0x20 /end MEASUREMENT
/begin MEASUREMENT fmy_stat_bn_etcu.err_info_stat.lv_cdn_diag "" UBYTE _CNV_S_2_RANGE______5_CM 1 100. 0. 1. DISPLAY_IDENTIFIER LV_CDN_DIAG_BN_ETCU ECU_ADDRESS 0x3fbadd BIT_MASK 0x10 /end MEASUREMENT
/begin MEASUREMENT fmy_stat_bn_etcu.err_info_stat.err_sym "" UBYTE _CNV_S_6_RANGE_ERR__192_CM 1 100. 0. 15. DISPLAY_IDENTIFIER ERR_SYM_BN_ETCU ECU_ADDRESS 0x3fbadd BIT_MASK 0xF /end MEASUREMENT
/begin MEASUREMENT fmy_stat_bn_tq_amt.ctr_abc "" UBYTE _CNV_A_R_LINEAR_____1_CM 1 100. 0. 255. DISPLAY_IDENTIFIER CTR_ABC_BN_TQ_AMT ECU_ADDRESS 0x3fbae3 FORMAT "%3.0" /end MEASUREMENT
/begin MEASUREMENT fmy_stat_bn_tq_amt.ctr_end_diag "" UBYTE _CNV_A_R_LINEAR_____1_CM 1 100. 0. 255. DISPLAY_IDENTIFIER CTR_ABC_END_DIAG_BN_TQ_AMT ECU_ADDRESS 0x3fbae2 FORMAT "%3.0" /end MEASUREMENT
/begin MEASUREMENT fmy_stat_bn_tq_amt.err_info_stat.lv_err_mem "" UBYTE _CNV_S_2_RANGE______5_CM 1 100. 0. 1. DISPLAY_IDENTIFIER LV_ERR_MEM_BN_TQ_AMT ECU_ADDRESS 0x3fbae1 BIT_MASK 0x80 /end MEASUREMENT
/begin MEASUREMENT fmy_stat_bn_tq_amt.err_info_stat.lv_ready "" UBYTE _CNV_S_2_RANGE______5_CM 1 100. 0. 1. DISPLAY_IDENTIFIER LV_READY_BN_TQ_AMT ECU_ADDRESS 0x3fbae1 BIT_MASK 0x40 /end MEASUREMENT
/begin MEASUREMENT fmy_stat_bn_tq_amt.err_info_stat.lv_end_diag "" UBYTE _CNV_S_2_RANGE______5_CM 1 100. 0. 1. DISPLAY_IDENTIFIER LV_END_DIAG_BN_TQ_AMT ECU_ADDRESS 0x3fbae1 BIT_MASK 0x20 /end MEASUREMENT
/begin MEASUREMENT fmy_stat_bn_tq_amt.err_info_stat.lv_cdn_diag "" UBYTE _CNV_S_2_RANGE______5_CM 1 100. 0. 1. DISPLAY_IDENTIFIER LV_CDN_DIAG_BN_TQ_AMT ECU_ADDRESS 0x3fbae1 BIT_MASK 0x10 /end MEASUREMENT
/begin MEASUREMENT fmy_stat_bn_tq_amt.err_info_stat.err_sym "" UBYTE _CNV_S_6_RANGE_ERR__192_CM 1 100. 0. 15. DISPLAY_IDENTIFIER ERR_SYM_BN_TQ_AMT ECU_ADDRESS 0x3fbae1 BIT_MASK 0xF /end MEASUREMENT
/begin MEASUREMENT fmy_stat_bn_acc.ctr_abc "" UBYTE _CNV_A_R_LINEAR_____1_CM 1 100. 0. 255. DISPLAY_IDENTIFIER CTR_ABC_BN_ACC ECU_ADDRESS 0x3fbae7 FORMAT "%3.0" /end MEASUREMENT
/begin MEASUREMENT fmy_stat_bn_acc.ctr_end_diag "" UBYTE _CNV_A_R_LINEAR_____1_CM 1 100. 0. 255. DISPLAY_IDENTIFIER CTR_ABC_END_DIAG_BN_ACC ECU_ADDRESS 0x3fbae6 FORMAT "%3.0" /end MEASUREMENT
/begin MEASUREMENT fmy_stat_bn_acc.err_info_stat.lv_err_mem "" UBYTE _CNV_S_2_RANGE______5_CM 1 100. 0. 1. DISPLAY_IDENTIFIER LV_ERR_MEM_BN_ACC ECU_ADDRESS 0x3fbae5 BIT_MASK 0x80 /end MEASUREMENT
/begin MEASUREMENT fmy_stat_bn_acc.err_info_stat.lv_ready "" UBYTE _CNV_S_2_RANGE______5_CM 1 100. 0. 1. DISPLAY_IDENTIFIER LV_READY_BN_ACC ECU_ADDRESS 0x3fbae5 BIT_MASK 0x40 /end MEASUREMENT
/begin MEASUREMENT fmy_stat_bn_acc.err_info_stat.lv_end_diag "" UBYTE _CNV_S_2_RANGE______5_CM 1 100. 0. 1. DISPLAY_IDENTIFIER LV_END_DIAG_BN_ACC ECU_ADDRESS 0x3fbae5 BIT_MASK 0x20 /end MEASUREMENT
/begin MEASUREMENT fmy_stat_bn_acc.err_info_stat.lv_cdn_diag "" UBYTE _CNV_S_2_RANGE______5_CM 1 100. 0. 1. DISPLAY_IDENTIFIER LV_CDN_DIAG_BN_ACC ECU_ADDRESS 0x3fbae5 BIT_MASK 0x10 /end MEASUREMENT
/begin MEASUREMENT fmy_stat_bn_acc.err_info_stat.err_sym "" UBYTE _CNV_S_6_RANGE_ERR__192_CM 1 100. 0. 15. DISPLAY_IDENTIFIER ERR_SYM_BN_ACC ECU_ADDRESS 0x3fbae5 BIT_MASK 0xF /end MEASUREMENT
/begin MEASUREMENT fmy_stat_bn_t_icl.ctr_abc "" UBYTE _CNV_A_R_LINEAR_____1_CM 1 100. 0. 255. DISPLAY_IDENTIFIER CTR_ABC_BN_T_ICL ECU_ADDRESS 0x3fbaeb FORMAT "%3.0" /end MEASUREMENT
/begin MEASUREMENT fmy_stat_bn_t_icl.ctr_end_diag "" UBYTE _CNV_A_R_LINEAR_____1_CM 1 100. 0. 255. DISPLAY_IDENTIFIER CTR_ABC_END_DIAG_BN_T_ICL ECU_ADDRESS 0x3fbaea FORMAT "%3.0" /end MEASUREMENT
/begin MEASUREMENT fmy_stat_bn_t_icl.err_info_stat.lv_err_mem "" UBYTE _CNV_S_2_RANGE______5_CM 1 100. 0. 1. DISPLAY_IDENTIFIER LV_ERR_MEM_BN_T_ICL ECU_ADDRESS 0x3fbae9 BIT_MASK 0x80 /end MEASUREMENT
/begin MEASUREMENT fmy_stat_bn_t_icl.err_info_stat.lv_ready "" UBYTE _CNV_S_2_RANGE______5_CM 1 100. 0. 1. DISPLAY_IDENTIFIER LV_READY_BN_T_ICL ECU_ADDRESS 0x3fbae9 BIT_MASK 0x40 /end MEASUREMENT
/begin MEASUREMENT fmy_stat_bn_t_icl.err_info_stat.lv_end_diag "" UBYTE _CNV_S_2_RANGE______5_CM 1 100. 0. 1. DISPLAY_IDENTIFIER LV_END_DIAG_BN_T_ICL ECU_ADDRESS 0x3fbae9 BIT_MASK 0x20 /end MEASUREMENT
/begin MEASUREMENT fmy_stat_bn_t_icl.err_info_stat.lv_cdn_diag "" UBYTE _CNV_S_2_RANGE______5_CM 1 100. 0. 1. DISPLAY_IDENTIFIER LV_CDN_DIAG_BN_T_ICL ECU_ADDRESS 0x3fbae9 BIT_MASK 0x10 /end MEASUREMENT
/begin MEASUREMENT fmy_stat_bn_t_icl.err_info_stat.err_sym "" UBYTE _CNV_S_6_RANGE_ERR__192_CM 1 100. 0. 15. DISPLAY_IDENTIFIER ERR_SYM_BN_T_ICL ECU_ADDRESS 0x3fbae9 BIT_MASK 0xF /end MEASUREMENT
/begin MEASUREMENT fmy_stat_bn_veh_mod.ctr_abc "" UBYTE _CNV_A_R_LINEAR_____1_CM 1 100. 0. 255. DISPLAY_IDENTIFIER CTR_ABC_BN_VEH_MOD ECU_ADDRESS 0x3fbaef FORMAT "%3.0" /end MEASUREMENT
/begin MEASUREMENT fmy_stat_bn_veh_mod.ctr_end_diag "" UBYTE _CNV_A_R_LINEAR_____1_CM 1 100. 0. 255. DISPLAY_IDENTIFIER CTR_ABC_END_DIAG_BN_VEH_MOD ECU_ADDRESS 0x3fbaee FORMAT "%3.0" /end MEASUREMENT
/begin MEASUREMENT fmy_stat_bn_veh_mod.err_info_stat.lv_err_mem "" UBYTE _CNV_S_2_RANGE______5_CM 1 100. 0. 1. DISPLAY_IDENTIFIER LV_ERR_MEM_BN_VEH_MOD ECU_ADDRESS 0x3fbaed BIT_MASK 0x80 /end MEASUREMENT
/begin MEASUREMENT fmy_stat_bn_veh_mod.err_info_stat.lv_ready "" UBYTE _CNV_S_2_RANGE______5_CM 1 100. 0. 1. DISPLAY_IDENTIFIER LV_READY_BN_VEH_MOD ECU_ADDRESS 0x3fbaed BIT_MASK 0x40 /end MEASUREMENT
/begin MEASUREMENT fmy_stat_bn_veh_mod.err_info_stat.lv_end_diag "" UBYTE _CNV_S_2_RANGE______5_CM 1 100. 0. 1. DISPLAY_IDENTIFIER LV_END_DIAG_BN_VEH_MOD ECU_ADDRESS 0x3fbaed BIT_MASK 0x20 /end MEASUREMENT
/begin MEASUREMENT fmy_stat_bn_veh_mod.err_info_stat.lv_cdn_diag "" UBYTE _CNV_S_2_RANGE______5_CM 1 100. 0. 1. DISPLAY_IDENTIFIER LV_CDN_DIAG_BN_VEH_MOD ECU_ADDRESS 0x3fbaed BIT_MASK 0x10 /end MEASUREMENT
/begin MEASUREMENT fmy_stat_bn_veh_mod.err_info_stat.err_sym "" UBYTE _CNV_S_6_RANGE_ERR__192_CM 1 100. 0. 15. DISPLAY_IDENTIFIER ERR_SYM_BN_VEH_MOD ECU_ADDRESS 0x3fbaed BIT_MASK 0xF /end MEASUREMENT
/begin MEASUREMENT fmy_stat_bn_km_icl.ctr_abc "" UBYTE _CNV_A_R_LINEAR_____1_CM 1 100. 0. 255. DISPLAY_IDENTIFIER CTR_ABC_BN_KM_ICL ECU_ADDRESS 0x3fbaf3 FORMAT "%3.0" /end MEASUREMENT
/begin MEASUREMENT fmy_stat_bn_km_icl.ctr_end_diag "" UBYTE _CNV_A_R_LINEAR_____1_CM 1 100. 0. 255. DISPLAY_IDENTIFIER CTR_ABC_END_DIAG_BN_KM_ICL ECU_ADDRESS 0x3fbaf2 FORMAT "%3.0" /end MEASUREMENT
/begin MEASUREMENT fmy_stat_bn_km_icl.err_info_stat.lv_err_mem "" UBYTE _CNV_S_2_RANGE______5_CM 1 100. 0. 1. DISPLAY_IDENTIFIER LV_ERR_MEM_BN_KM_ICL ECU_ADDRESS 0x3fbaf1 BIT_MASK 0x80 /end MEASUREMENT
/begin MEASUREMENT fmy_stat_bn_km_icl.err_info_stat.lv_ready "" UBYTE _CNV_S_2_RANGE______5_CM 1 100. 0. 1. DISPLAY_IDENTIFIER LV_READY_BN_KM_ICL ECU_ADDRESS 0x3fbaf1 BIT_MASK 0x40 /end MEASUREMENT
/begin MEASUREMENT fmy_stat_bn_km_icl.err_info_stat.lv_end_diag "" UBYTE _CNV_S_2_RANGE______5_CM 1 100. 0. 1. DISPLAY_IDENTIFIER LV_END_DIAG_BN_KM_ICL ECU_ADDRESS 0x3fbaf1 BIT_MASK 0x20 /end MEASUREMENT
/begin MEASUREMENT fmy_stat_bn_km_icl.err_info_stat.lv_cdn_diag "" UBYTE _CNV_S_2_RANGE______5_CM 1 100. 0. 1. DISPLAY_IDENTIFIER LV_CDN_DIAG_BN_KM_ICL ECU_ADDRESS 0x3fbaf1 BIT_MASK 0x10 /end MEASUREMENT
/begin MEASUREMENT fmy_stat_bn_km_icl.err_info_stat.err_sym "" UBYTE _CNV_S_6_RANGE_ERR__192_CM 1 100. 0. 15. DISPLAY_IDENTIFIER ERR_SYM_BN_KM_ICL ECU_ADDRESS 0x3fbaf1 BIT_MASK 0xF /end MEASUREMENT
/begin MEASUREMENT fmy_stat_bn_icl.ctr_abc "" UBYTE _CNV_A_R_LINEAR_____1_CM 1 100. 0. 255. DISPLAY_IDENTIFIER CTR_ABC_BN_ICL ECU_ADDRESS 0x3fbaf7 FORMAT "%3.0" /end MEASUREMENT
/begin MEASUREMENT fmy_stat_bn_icl.ctr_end_diag "" UBYTE _CNV_A_R_LINEAR_____1_CM 1 100. 0. 255. DISPLAY_IDENTIFIER CTR_ABC_END_DIAG_BN_ICL ECU_ADDRESS 0x3fbaf6 FORMAT "%3.0" /end MEASUREMENT
/begin MEASUREMENT fmy_stat_bn_icl.err_info_stat.lv_err_mem "" UBYTE _CNV_S_2_RANGE______5_CM 1 100. 0. 1. DISPLAY_IDENTIFIER LV_ERR_MEM_BN_ICL ECU_ADDRESS 0x3fbaf5 BIT_MASK 0x80 /end MEASUREMENT
/begin MEASUREMENT fmy_stat_bn_icl.err_info_stat.lv_ready "" UBYTE _CNV_S_2_RANGE______5_CM 1 100. 0. 1. DISPLAY_IDENTIFIER LV_READY_BN_ICL ECU_ADDRESS 0x3fbaf5 BIT_MASK 0x40 /end MEASUREMENT
/begin MEASUREMENT fmy_stat_bn_icl.err_info_stat.lv_end_diag "" UBYTE _CNV_S_2_RANGE______5_CM 1 100. 0. 1. DISPLAY_IDENTIFIER LV_END_DIAG_BN_ICL ECU_ADDRESS 0x3fbaf5 BIT_MASK 0x20 /end MEASUREMENT
/begin MEASUREMENT fmy_stat_bn_icl.err_info_stat.lv_cdn_diag "" UBYTE _CNV_S_2_RANGE______5_CM 1 100. 0. 1. DISPLAY_IDENTIFIER LV_CDN_DIAG_BN_ICL ECU_ADDRESS 0x3fbaf5 BIT_MASK 0x10 /end MEASUREMENT
/begin MEASUREMENT fmy_stat_bn_icl.err_info_stat.err_sym "" UBYTE _CNV_S_6_RANGE_ERR__192_CM 1 100. 0. 15. DISPLAY_IDENTIFIER ERR_SYM_BN_ICL ECU_ADDRESS 0x3fbaf5 BIT_MASK 0xF /end MEASUREMENT
/begin MEASUREMENT fmy_stat_bn_pow_vb.ctr_abc "" UBYTE _CNV_A_R_LINEAR_____1_CM 1 100. 0. 255. DISPLAY_IDENTIFIER CTR_ABC_BN_POW_VB ECU_ADDRESS 0x3fbafb FORMAT "%3.0" /end MEASUREMENT
/begin MEASUREMENT fmy_stat_bn_pow_vb.ctr_end_diag "" UBYTE _CNV_A_R_LINEAR_____1_CM 1 100. 0. 255. DISPLAY_IDENTIFIER CTR_ABC_END_DIAG_BN_POW_VB ECU_ADDRESS 0x3fbafa FORMAT "%3.0" /end MEASUREMENT
/begin MEASUREMENT fmy_stat_bn_pow_vb.err_info_stat.lv_err_mem "" UBYTE _CNV_S_2_RANGE______5_CM 1 100. 0. 1. DISPLAY_IDENTIFIER LV_ERR_MEM_BN_POW_VB ECU_ADDRESS 0x3fbaf9 BIT_MASK 0x80 /end MEASUREMENT
/begin MEASUREMENT fmy_stat_bn_pow_vb.err_info_stat.lv_ready "" UBYTE _CNV_S_2_RANGE______5_CM 1 100. 0. 1. DISPLAY_IDENTIFIER LV_READY_BN_POW_VB ECU_ADDRESS 0x3fbaf9 BIT_MASK 0x40 /end MEASUREMENT
/begin MEASUREMENT fmy_stat_bn_pow_vb.err_info_stat.lv_end_diag "" UBYTE _CNV_S_2_RANGE______5_CM 1 100. 0. 1. DISPLAY_IDENTIFIER LV_END_DIAG_BN_POW_VB ECU_ADDRESS 0x3fbaf9 BIT_MASK 0x20 /end MEASUREMENT
/begin MEASUREMENT fmy_stat_bn_pow_vb.err_info_stat.lv_cdn_diag "" UBYTE _CNV_S_2_RANGE______5_CM 1 100. 0. 1. DISPLAY_IDENTIFIER LV_CDN_DIAG_BN_POW_VB ECU_ADDRESS 0x3fbaf9 BIT_MASK 0x10 /end MEASUREMENT
/begin MEASUREMENT fmy_stat_bn_pow_vb.err_info_stat.err_sym "" UBYTE _CNV_S_6_RANGE_ERR__192_CM 1 100. 0. 15. DISPLAY_IDENTIFIER ERR_SYM_BN_POW_VB ECU_ADDRESS 0x3fbaf9 BIT_MASK 0xF /end MEASUREMENT
/begin MEASUREMENT fmy_stat_bn_pow_gen.ctr_abc "" UBYTE _CNV_A_R_LINEAR_____1_CM 1 100. 0. 255. DISPLAY_IDENTIFIER CTR_ABC_BN_POW_GEN ECU_ADDRESS 0x3fbaff FORMAT "%3.0" /end MEASUREMENT
/begin MEASUREMENT fmy_stat_bn_pow_gen.ctr_end_diag "" UBYTE _CNV_A_R_LINEAR_____1_CM 1 100. 0. 255. DISPLAY_IDENTIFIER CTR_ABC_END_DIAG_BN_POW_GEN ECU_ADDRESS 0x3fbafe FORMAT "%3.0" /end MEASUREMENT
/begin MEASUREMENT fmy_stat_bn_pow_gen.err_info_stat.lv_err_mem "" UBYTE _CNV_S_2_RANGE______5_CM 1 100. 0. 1. DISPLAY_IDENTIFIER LV_ERR_MEM_BN_POW_GEN ECU_ADDRESS 0x3fbafd BIT_MASK 0x80 /end MEASUREMENT
/begin MEASUREMENT fmy_stat_bn_pow_gen.err_info_stat.lv_ready "" UBYTE _CNV_S_2_RANGE______5_CM 1 100. 0. 1. DISPLAY_IDENTIFIER LV_READY_BN_POW_GEN ECU_ADDRESS 0x3fbafd BIT_MASK 0x40 /end MEASUREMENT
/begin MEASUREMENT fmy_stat_bn_pow_gen.err_info_stat.lv_end_diag "" UBYTE _CNV_S_2_RANGE______5_CM 1 100. 0. 1. DISPLAY_IDENTIFIER LV_END_DIAG_BN_POW_GEN ECU_ADDRESS 0x3fbafd BIT_MASK 0x20 /end MEASUREMENT
/begin MEASUREMENT fmy_stat_bn_pow_gen.err_info_stat.lv_cdn_diag "" UBYTE _CNV_S_2_RANGE______5_CM 1 100. 0. 1. DISPLAY_IDENTIFIER LV_CDN_DIAG_BN_POW_GEN ECU_ADDRESS 0x3fbafd BIT_MASK 0x10 /end MEASUREMENT
/begin MEASUREMENT fmy_stat_bn_pow_gen.err_info_stat.err_sym "" UBYTE _CNV_S_6_RANGE_ERR__192_CM 1 100. 0. 15. DISPLAY_IDENTIFIER ERR_SYM_BN_POW_GEN ECU_ADDRESS 0x3fbafd BIT_MASK 0xF /end MEASUREMENT
/begin MEASUREMENT fmy_stat_bn_msw.ctr_abc "" UBYTE _CNV_A_R_LINEAR_____1_CM 1 100. 0. 255. DISPLAY_IDENTIFIER CTR_ABC_BN_MSW ECU_ADDRESS 0x3fbb03 FORMAT "%3.0" /end MEASUREMENT
/begin MEASUREMENT fmy_stat_bn_msw.ctr_end_diag "" UBYTE _CNV_A_R_LINEAR_____1_CM 1 100. 0. 255. DISPLAY_IDENTIFIER CTR_ABC_END_DIAG_BN_MSW ECU_ADDRESS 0x3fbb02 FORMAT "%3.0" /end MEASUREMENT
/begin MEASUREMENT fmy_stat_bn_msw.err_info_stat.lv_err_mem "" UBYTE _CNV_S_2_RANGE______5_CM 1 100. 0. 1. DISPLAY_IDENTIFIER LV_ERR_MEM_BN_MSW ECU_ADDRESS 0x3fbb01 BIT_MASK 0x80 /end MEASUREMENT
/begin MEASUREMENT fmy_stat_bn_msw.err_info_stat.lv_ready "" UBYTE _CNV_S_2_RANGE______5_CM 1 100. 0. 1. DISPLAY_IDENTIFIER LV_READY_BN_MSW ECU_ADDRESS 0x3fbb01 BIT_MASK 0x40 /end MEASUREMENT
/begin MEASUREMENT fmy_stat_bn_msw.err_info_stat.lv_end_diag "" UBYTE _CNV_S_2_RANGE______5_CM 1 100. 0. 1. DISPLAY_IDENTIFIER LV_END_DIAG_BN_MSW ECU_ADDRESS 0x3fbb01 BIT_MASK 0x20 /end MEASUREMENT
/begin MEASUREMENT fmy_stat_bn_msw.err_info_stat.lv_cdn_diag "" UBYTE _CNV_S_2_RANGE______5_CM 1 100. 0. 1. DISPLAY_IDENTIFIER LV_CDN_DIAG_BN_MSW ECU_ADDRESS 0x3fbb01 BIT_MASK 0x10 /end MEASUREMENT
/begin MEASUREMENT fmy_stat_bn_msw.err_info_stat.err_sym "" UBYTE _CNV_S_6_RANGE_ERR__192_CM 1 100. 0. 15. DISPLAY_IDENTIFIER ERR_SYM_BN_MSW ECU_ADDRESS 0x3fbb01 BIT_MASK 0xF /end MEASUREMENT
/begin MEASUREMENT fmy_stat_bn_ang_pste.ctr_abc "" UBYTE _CNV_A_R_LINEAR_____1_CM 1 100. 0. 255. DISPLAY_IDENTIFIER CTR_ABC_BN_ANG_PSTE ECU_ADDRESS 0x3fbb07 FORMAT "%3.0" /end MEASUREMENT
/begin MEASUREMENT fmy_stat_bn_ang_pste.ctr_end_diag "" UBYTE _CNV_A_R_LINEAR_____1_CM 1 100. 0. 255. DISPLAY_IDENTIFIER CTR_ABC_END_DIAG_BN_ANG_PSTE ECU_ADDRESS 0x3fbb06 FORMAT "%3.0" /end MEASUREMENT
/begin MEASUREMENT fmy_stat_bn_ang_pste.err_info_stat.lv_err_mem "" UBYTE _CNV_S_2_RANGE______5_CM 1 100. 0. 1. DISPLAY_IDENTIFIER LV_ERR_MEM_BN_ANG_PSTE ECU_ADDRESS 0x3fbb05 BIT_MASK 0x80 /end MEASUREMENT
/begin MEASUREMENT fmy_stat_bn_ang_pste.err_info_stat.lv_ready "" UBYTE _CNV_S_2_RANGE______5_CM 1 100. 0. 1. DISPLAY_IDENTIFIER LV_READY_BN_ANG_PSTE ECU_ADDRESS 0x3fbb05 BIT_MASK 0x40 /end MEASUREMENT
/begin MEASUREMENT fmy_stat_bn_ang_pste.err_info_stat.lv_end_diag "" UBYTE _CNV_S_2_RANGE______5_CM 1 100. 0. 1. DISPLAY_IDENTIFIER LV_END_DIAG_BN_ANG_PSTE ECU_ADDRESS 0x3fbb05 BIT_MASK 0x20 /end MEASUREMENT
/begin MEASUREMENT fmy_stat_bn_ang_pste.err_info_stat.lv_cdn_diag "" UBYTE _CNV_S_2_RANGE______5_CM 1 100. 0. 1. DISPLAY_IDENTIFIER LV_CDN_DIAG_BN_ANG_PSTE ECU_ADDRESS 0x3fbb05 BIT_MASK 0x10 /end MEASUREMENT
/begin MEASUREMENT fmy_stat_bn_ang_pste.err_info_stat.err_sym "" UBYTE _CNV_S_6_RANGE_ERR__192_CM 1 100. 0. 15. DISPLAY_IDENTIFIER ERR_SYM_BN_ANG_PSTE ECU_ADDRESS 0x3fbb05 BIT_MASK 0xF /end MEASUREMENT
/begin MEASUREMENT fmy_stat_bn_efp.ctr_abc "" UBYTE _CNV_A_R_LINEAR_____1_CM 1 100. 0. 255. DISPLAY_IDENTIFIER CTR_ABC_BN_EFP ECU_ADDRESS 0x3fbb0b FORMAT "%3.0" /end MEASUREMENT
/begin MEASUREMENT fmy_stat_bn_efp.ctr_end_diag "" UBYTE _CNV_A_R_LINEAR_____1_CM 1 100. 0. 255. DISPLAY_IDENTIFIER CTR_ABC_END_DIAG_BN_EFP ECU_ADDRESS 0x3fbb0a FORMAT "%3.0" /end MEASUREMENT
/begin MEASUREMENT fmy_stat_bn_efp.err_info_stat.lv_err_mem "" UBYTE _CNV_S_2_RANGE______5_CM 1 100. 0. 1. DISPLAY_IDENTIFIER LV_ERR_MEM_BN_EFP ECU_ADDRESS 0x3fbb09 BIT_MASK 0x80 /end MEASUREMENT
/begin MEASUREMENT fmy_stat_bn_efp.err_info_stat.lv_ready "" UBYTE _CNV_S_2_RANGE______5_CM 1 100. 0. 1. DISPLAY_IDENTIFIER LV_READY_BN_EFP ECU_ADDRESS 0x3fbb09 BIT_MASK 0x40 /end MEASUREMENT
/begin MEASUREMENT fmy_stat_bn_efp.err_info_stat.lv_end_diag "" UBYTE _CNV_S_2_RANGE______5_CM 1 100. 0. 1. DISPLAY_IDENTIFIER LV_END_DIAG_BN_EFP ECU_ADDRESS 0x3fbb09 BIT_MASK 0x20 /end MEASUREMENT
/begin MEASUREMENT fmy_stat_bn_efp.err_info_stat.lv_cdn_diag "" UBYTE _CNV_S_2_RANGE______5_CM 1 100. 0. 1. DISPLAY_IDENTIFIER LV_CDN_DIAG_BN_EFP ECU_ADDRESS 0x3fbb09 BIT_MASK 0x10 /end MEASUREMENT
/begin MEASUREMENT fmy_stat_bn_efp.err_info_stat.err_sym "" UBYTE _CNV_S_6_RANGE_ERR__192_CM 1 100. 0. 15. DISPLAY_IDENTIFIER ERR_SYM_BN_EFP ECU_ADDRESS 0x3fbb09 BIT_MASK 0xF /end MEASUREMENT
/begin MEASUREMENT fmy_stat_load_tps_plaus.ctr_abc "" UBYTE _CNV_A_R_LINEAR_____1_CM 1 100. 0. 255. DISPLAY_IDENTIFIER CTR_ABC_LOAD_TPS_PLAUS ECU_ADDRESS 0x3fbb0f FORMAT "%3.0" /end MEASUREMENT
/begin MEASUREMENT fmy_stat_load_tps_plaus.ctr_end_diag "" UBYTE _CNV_A_R_LINEAR_____1_CM 1 100. 0. 255. DISPLAY_IDENTIFIER CTR_ABC_END_DIAG_LOAD_TPS_PLAUS ECU_ADDRESS 0x3fbb0e FORMAT "%3.0" /end MEASUREMENT
/begin MEASUREMENT fmy_stat_load_tps_plaus.err_info_stat.lv_err_mem "" UBYTE _CNV_S_2_RANGE______5_CM 1 100. 0. 1. DISPLAY_IDENTIFIER LV_ERR_MEM_LOAD_TPS_PLAUS ECU_ADDRESS 0x3fbb0d BIT_MASK 0x80 /end MEASUREMENT
/begin MEASUREMENT fmy_stat_load_tps_plaus.err_info_stat.lv_ready "" UBYTE _CNV_S_2_RANGE______5_CM 1 100. 0. 1. DISPLAY_IDENTIFIER LV_READY_LOAD_TPS_PLAUS ECU_ADDRESS 0x3fbb0d BIT_MASK 0x40 /end MEASUREMENT
/begin MEASUREMENT fmy_stat_load_tps_plaus.err_info_stat.lv_end_diag "" UBYTE _CNV_S_2_RANGE______5_CM 1 100. 0. 1. DISPLAY_IDENTIFIER LV_END_DIAG_LOAD_TPS_PLAUS ECU_ADDRESS 0x3fbb0d BIT_MASK 0x20 /end MEASUREMENT
/begin MEASUREMENT fmy_stat_load_tps_plaus.err_info_stat.lv_cdn_diag "" UBYTE _CNV_S_2_RANGE______5_CM 1 100. 0. 1. DISPLAY_IDENTIFIER LV_CDN_DIAG_LOAD_TPS_PLAUS ECU_ADDRESS 0x3fbb0d BIT_MASK 0x10 /end MEASUREMENT
/begin MEASUREMENT fmy_stat_load_tps_plaus.err_info_stat.err_sym "" UBYTE _CNV_S_6_RANGE_ERR__192_CM 1 100. 0. 15. DISPLAY_IDENTIFIER ERR_SYM_LOAD_TPS_PLAUS ECU_ADDRESS 0x3fbb0d BIT_MASK 0xF /end MEASUREMENT
/begin MEASUREMENT fmy_stat_efp_crash.ctr_abc "" UBYTE _CNV_A_R_LINEAR_____1_CM 1 100. 0. 255. DISPLAY_IDENTIFIER CTR_ABC_EFP_CRASH ECU_ADDRESS 0x3fbb13 FORMAT "%3.0" /end MEASUREMENT
/begin MEASUREMENT fmy_stat_efp_crash.ctr_end_diag "" UBYTE _CNV_A_R_LINEAR_____1_CM 1 100. 0. 255. DISPLAY_IDENTIFIER CTR_ABC_END_DIAG_EFP_CRASH ECU_ADDRESS 0x3fbb12 FORMAT "%3.0" /end MEASUREMENT
/begin MEASUREMENT fmy_stat_efp_crash.err_info_stat.lv_err_mem "" UBYTE _CNV_S_2_RANGE______5_CM 1 100. 0. 1. DISPLAY_IDENTIFIER LV_ERR_MEM_EFP_CRASH ECU_ADDRESS 0x3fbb11 BIT_MASK 0x80 /end MEASUREMENT
/begin MEASUREMENT fmy_stat_efp_crash.err_info_stat.lv_ready "" UBYTE _CNV_S_2_RANGE______5_CM 1 100. 0. 1. DISPLAY_IDENTIFIER LV_READY_EFP_CRASH ECU_ADDRESS 0x3fbb11 BIT_MASK 0x40 /end MEASUREMENT
/begin MEASUREMENT fmy_stat_efp_crash.err_info_stat.lv_end_diag "" UBYTE _CNV_S_2_RANGE______5_CM 1 100. 0. 1. DISPLAY_IDENTIFIER LV_END_DIAG_EFP_CRASH ECU_ADDRESS 0x3fbb11 BIT_MASK 0x20 /end MEASUREMENT
/begin MEASUREMENT fmy_stat_efp_crash.err_info_stat.lv_cdn_diag "" UBYTE _CNV_S_2_RANGE______5_CM 1 100. 0. 1. DISPLAY_IDENTIFIER LV_CDN_DIAG_EFP_CRASH ECU_ADDRESS 0x3fbb11 BIT_MASK 0x10 /end MEASUREMENT
/begin MEASUREMENT fmy_stat_efp_crash.err_info_stat.err_sym "" UBYTE _CNV_S_6_RANGE_ERR__192_CM 1 100. 0. 15. DISPLAY_IDENTIFIER ERR_SYM_EFP_CRASH ECU_ADDRESS 0x3fbb11 BIT_MASK 0xF /end MEASUREMENT
/begin MEASUREMENT fmy_stat_efp.ctr_abc "" UBYTE _CNV_A_R_LINEAR_____1_CM 1 100. 0. 255. DISPLAY_IDENTIFIER CTR_ABC_EFP ECU_ADDRESS 0x3fbb17 FORMAT "%3.0" /end MEASUREMENT
/begin MEASUREMENT fmy_stat_efp.ctr_end_diag "" UBYTE _CNV_A_R_LINEAR_____1_CM 1 100. 0. 255. DISPLAY_IDENTIFIER CTR_ABC_END_DIAG_EFP ECU_ADDRESS 0x3fbb16 FORMAT "%3.0" /end MEASUREMENT
/begin MEASUREMENT fmy_stat_efp.err_info_stat.lv_err_mem "" UBYTE _CNV_S_2_RANGE______5_CM 1 100. 0. 1. DISPLAY_IDENTIFIER LV_ERR_MEM_EFP ECU_ADDRESS 0x3fbb15 BIT_MASK 0x80 /end MEASUREMENT
/begin MEASUREMENT fmy_stat_efp.err_info_stat.lv_ready "" UBYTE _CNV_S_2_RANGE______5_CM 1 100. 0. 1. DISPLAY_IDENTIFIER LV_READY_EFP ECU_ADDRESS 0x3fbb15 BIT_MASK 0x40 /end MEASUREMENT
/begin MEASUREMENT fmy_stat_efp.err_info_stat.lv_end_diag "" UBYTE _CNV_S_2_RANGE______5_CM 1 100. 0. 1. DISPLAY_IDENTIFIER LV_END_DIAG_EFP ECU_ADDRESS 0x3fbb15 BIT_MASK 0x20 /end MEASUREMENT
/begin MEASUREMENT fmy_stat_efp.err_info_stat.lv_cdn_diag "" UBYTE _CNV_S_2_RANGE______5_CM 1 100. 0. 1. DISPLAY_IDENTIFIER LV_CDN_DIAG_EFP ECU_ADDRESS 0x3fbb15 BIT_MASK 0x10 /end MEASUREMENT
/begin MEASUREMENT fmy_stat_efp.err_info_stat.err_sym "" UBYTE _CNV_S_6_RANGE_ERR__192_CM 1 100. 0. 15. DISPLAY_IDENTIFIER ERR_SYM_EFP ECU_ADDRESS 0x3fbb15 BIT_MASK 0xF /end MEASUREMENT
/begin MEASUREMENT fmy_stat_locan_boff.ctr_abc "" UBYTE _CNV_A_R_LINEAR_____1_CM 1 100. 0. 255. DISPLAY_IDENTIFIER CTR_ABC_LOCAN_BOFF ECU_ADDRESS 0x3fbb1b FORMAT "%3.0" /end MEASUREMENT
/begin MEASUREMENT fmy_stat_locan_boff.ctr_end_diag "" UBYTE _CNV_A_R_LINEAR_____1_CM 1 100. 0. 255. DISPLAY_IDENTIFIER CTR_ABC_END_DIAG_LOCAN_BOFF ECU_ADDRESS 0x3fbb1a FORMAT "%3.0" /end MEASUREMENT
/begin MEASUREMENT fmy_stat_locan_boff.err_info_stat.lv_err_mem "" UBYTE _CNV_S_2_RANGE______5_CM 1 100. 0. 1. DISPLAY_IDENTIFIER LV_ERR_MEM_LOCAN_BOFF ECU_ADDRESS 0x3fbb19 BIT_MASK 0x80 /end MEASUREMENT
/begin MEASUREMENT fmy_stat_locan_boff.err_info_stat.lv_ready "" UBYTE _CNV_S_2_RANGE______5_CM 1 100. 0. 1. DISPLAY_IDENTIFIER LV_READY_LOCAN_BOFF ECU_ADDRESS 0x3fbb19 BIT_MASK 0x40 /end MEASUREMENT
/begin MEASUREMENT fmy_stat_locan_boff.err_info_stat.lv_end_diag "" UBYTE _CNV_S_2_RANGE______5_CM 1 100. 0. 1. DISPLAY_IDENTIFIER LV_END_DIAG_LOCAN_BOFF ECU_ADDRESS 0x3fbb19 BIT_MASK 0x20 /end MEASUREMENT
/begin MEASUREMENT fmy_stat_locan_boff.err_info_stat.lv_cdn_diag "" UBYTE _CNV_S_2_RANGE______5_CM 1 100. 0. 1. DISPLAY_IDENTIFIER LV_CDN_DIAG_LOCAN_BOFF ECU_ADDRESS 0x3fbb19 BIT_MASK 0x10 /end MEASUREMENT
/begin MEASUREMENT fmy_stat_locan_boff.err_info_stat.err_sym "" UBYTE _CNV_S_6_RANGE_ERR__192_CM 1 100. 0. 15. DISPLAY_IDENTIFIER ERR_SYM_LOCAN_BOFF ECU_ADDRESS 0x3fbb19 BIT_MASK 0xF /end MEASUREMENT
/begin MEASUREMENT fmy_stat_chg_ls_up.ctr_abc "" UBYTE _CNV_A_R_LINEAR_____1_CM 1 100. 0. 255. DISPLAY_IDENTIFIER CTR_ABC_CHG_LS_UP ECU_ADDRESS 0x3fbb1f FORMAT "%3.0" /end MEASUREMENT
/begin MEASUREMENT fmy_stat_chg_ls_up.ctr_end_diag "" UBYTE _CNV_A_R_LINEAR_____1_CM 1 100. 0. 255. DISPLAY_IDENTIFIER CTR_ABC_END_DIAG_CHG_LS_UP ECU_ADDRESS 0x3fbb1e FORMAT "%3.0" /end MEASUREMENT
/begin MEASUREMENT fmy_stat_chg_ls_up.err_info_stat.lv_err_mem "" UBYTE _CNV_S_2_RANGE______5_CM 1 100. 0. 1. DISPLAY_IDENTIFIER LV_ERR_MEM_CHG_LS_UP ECU_ADDRESS 0x3fbb1d BIT_MASK 0x80 /end MEASUREMENT
/begin MEASUREMENT fmy_stat_chg_ls_up.err_info_stat.lv_ready "" UBYTE _CNV_S_2_RANGE______5_CM 1 100. 0. 1. DISPLAY_IDENTIFIER LV_READY_CHG_LS_UP ECU_ADDRESS 0x3fbb1d BIT_MASK 0x40 /end MEASUREMENT
/begin MEASUREMENT fmy_stat_chg_ls_up.err_info_stat.lv_end_diag "" UBYTE _CNV_S_2_RANGE______5_CM 1 100. 0. 1. DISPLAY_IDENTIFIER LV_END_DIAG_CHG_LS_UP ECU_ADDRESS 0x3fbb1d BIT_MASK 0x20 /end MEASUREMENT
/begin MEASUREMENT fmy_stat_chg_ls_up.err_info_stat.lv_cdn_diag "" UBYTE _CNV_S_2_RANGE______5_CM 1 100. 0. 1. DISPLAY_IDENTIFIER LV_CDN_DIAG_CHG_LS_UP ECU_ADDRESS 0x3fbb1d BIT_MASK 0x10 /end MEASUREMENT
/begin MEASUREMENT fmy_stat_chg_ls_up.err_info_stat.err_sym "" UBYTE _CNV_S_6_RANGE_ERR__192_CM 1 100. 0. 15. DISPLAY_IDENTIFIER ERR_SYM_CHG_LS_UP ECU_ADDRESS 0x3fbb1d BIT_MASK 0xF /end MEASUREMENT
/begin MEASUREMENT fmy_stat_chg_ls_down.ctr_abc "" UBYTE _CNV_A_R_LINEAR_____1_CM 1 100. 0. 255. DISPLAY_IDENTIFIER CTR_ABC_CHG_LS_DOWN ECU_ADDRESS 0x3fbb23 FORMAT "%3.0" /end MEASUREMENT
/begin MEASUREMENT fmy_stat_chg_ls_down.ctr_end_diag "" UBYTE _CNV_A_R_LINEAR_____1_CM 1 100. 0. 255. DISPLAY_IDENTIFIER CTR_ABC_END_DIAG_CHG_LS_DOWN ECU_ADDRESS 0x3fbb22 FORMAT "%3.0" /end MEASUREMENT
/begin MEASUREMENT fmy_stat_chg_ls_down.err_info_stat.lv_err_mem "" UBYTE _CNV_S_2_RANGE______5_CM 1 100. 0. 1. DISPLAY_IDENTIFIER LV_ERR_MEM_CHG_LS_DOWN ECU_ADDRESS 0x3fbb21 BIT_MASK 0x80 /end MEASUREMENT
/begin MEASUREMENT fmy_stat_chg_ls_down.err_info_stat.lv_ready "" UBYTE _CNV_S_2_RANGE______5_CM 1 100. 0. 1. DISPLAY_IDENTIFIER LV_READY_CHG_LS_DOWN ECU_ADDRESS 0x3fbb21 BIT_MASK 0x40 /end MEASUREMENT
/begin MEASUREMENT fmy_stat_chg_ls_down.err_info_stat.lv_end_diag "" UBYTE _CNV_S_2_RANGE______5_CM 1 100. 0. 1. DISPLAY_IDENTIFIER LV_END_DIAG_CHG_LS_DOWN ECU_ADDRESS 0x3fbb21 BIT_MASK 0x20 /end MEASUREMENT
/begin MEASUREMENT fmy_stat_chg_ls_down.err_info_stat.lv_cdn_diag "" UBYTE _CNV_S_2_RANGE______5_CM 1 100. 0. 1. DISPLAY_IDENTIFIER LV_CDN_DIAG_CHG_LS_DOWN ECU_ADDRESS 0x3fbb21 BIT_MASK 0x10 /end MEASUREMENT
/begin MEASUREMENT fmy_stat_chg_ls_down.err_info_stat.err_sym "" UBYTE _CNV_S_6_RANGE_ERR__192_CM 1 100. 0. 15. DISPLAY_IDENTIFIER ERR_SYM_CHG_LS_DOWN ECU_ADDRESS 0x3fbb21 BIT_MASK 0xF /end MEASUREMENT
/begin MEASUREMENT fmy_stat_qoil_sens.ctr_abc "" UBYTE _CNV_A_R_LINEAR_____1_CM 1 100. 0. 255. DISPLAY_IDENTIFIER CTR_ABC_QOIL_SENS ECU_ADDRESS 0x3fbb27 FORMAT "%3.0" /end MEASUREMENT
/begin MEASUREMENT fmy_stat_qoil_sens.ctr_end_diag "" UBYTE _CNV_A_R_LINEAR_____1_CM 1 100. 0. 255. DISPLAY_IDENTIFIER CTR_ABC_END_DIAG_QOIL_SENS ECU_ADDRESS 0x3fbb26 FORMAT "%3.0" /end MEASUREMENT
/begin MEASUREMENT fmy_stat_qoil_sens.err_info_stat.lv_err_mem "" UBYTE _CNV_S_2_RANGE______5_CM 1 100. 0. 1. DISPLAY_IDENTIFIER LV_ERR_MEM_QOIL_SENS ECU_ADDRESS 0x3fbb25 BIT_MASK 0x80 /end MEASUREMENT
/begin MEASUREMENT fmy_stat_qoil_sens.err_info_stat.lv_ready "" UBYTE _CNV_S_2_RANGE______5_CM 1 100. 0. 1. DISPLAY_IDENTIFIER LV_READY_QOIL_SENS ECU_ADDRESS 0x3fbb25 BIT_MASK 0x40 /end MEASUREMENT
/begin MEASUREMENT fmy_stat_qoil_sens.err_info_stat.lv_end_diag "" UBYTE _CNV_S_2_RANGE______5_CM 1 100. 0. 1. DISPLAY_IDENTIFIER LV_END_DIAG_QOIL_SENS ECU_ADDRESS 0x3fbb25 BIT_MASK 0x20 /end MEASUREMENT
/begin MEASUREMENT fmy_stat_qoil_sens.err_info_stat.lv_cdn_diag "" UBYTE _CNV_S_2_RANGE______5_CM 1 100. 0. 1. DISPLAY_IDENTIFIER LV_CDN_DIAG_QOIL_SENS ECU_ADDRESS 0x3fbb25 BIT_MASK 0x10 /end MEASUREMENT
/begin MEASUREMENT fmy_stat_qoil_sens.err_info_stat.err_sym "" UBYTE _CNV_S_6_RANGE_ERR__192_CM 1 100. 0. 15. DISPLAY_IDENTIFIER ERR_SYM_QOIL_SENS ECU_ADDRESS 0x3fbb25 BIT_MASK 0xF /end MEASUREMENT
/begin MEASUREMENT fmy_stat_bat_sens.ctr_abc "" UBYTE _CNV_A_R_LINEAR_____1_CM 1 100. 0. 255. DISPLAY_IDENTIFIER CTR_ABC_BAT_SENS ECU_ADDRESS 0x3fbb2b FORMAT "%3.0" /end MEASUREMENT
/begin MEASUREMENT fmy_stat_bat_sens.ctr_end_diag "" UBYTE _CNV_A_R_LINEAR_____1_CM 1 100. 0. 255. DISPLAY_IDENTIFIER CTR_ABC_END_DIAG_BAT_SENS ECU_ADDRESS 0x3fbb2a FORMAT "%3.0" /end MEASUREMENT
/begin MEASUREMENT fmy_stat_bat_sens.err_info_stat.lv_err_mem "" UBYTE _CNV_S_2_RANGE______5_CM 1 100. 0. 1. DISPLAY_IDENTIFIER LV_ERR_MEM_BAT_SENS ECU_ADDRESS 0x3fbb29 BIT_MASK 0x80 /end MEASUREMENT
/begin MEASUREMENT fmy_stat_bat_sens.err_info_stat.lv_ready "" UBYTE _CNV_S_2_RANGE______5_CM 1 100. 0. 1. DISPLAY_IDENTIFIER LV_READY_BAT_SENS ECU_ADDRESS 0x3fbb29 BIT_MASK 0x40 /end MEASUREMENT
/begin MEASUREMENT fmy_stat_bat_sens.err_info_stat.lv_end_diag "" UBYTE _CNV_S_2_RANGE______5_CM 1 100. 0. 1. DISPLAY_IDENTIFIER LV_END_DIAG_BAT_SENS ECU_ADDRESS 0x3fbb29 BIT_MASK 0x20 /end MEASUREMENT
/begin MEASUREMENT fmy_stat_bat_sens.err_info_stat.lv_cdn_diag "" UBYTE _CNV_S_2_RANGE______5_CM 1 100. 0. 1. DISPLAY_IDENTIFIER LV_CDN_DIAG_BAT_SENS ECU_ADDRESS 0x3fbb29 BIT_MASK 0x10 /end MEASUREMENT
/begin MEASUREMENT fmy_stat_bat_sens.err_info_stat.err_sym "" UBYTE _CNV_S_6_RANGE_ERR__192_CM 1 100. 0. 15. DISPLAY_IDENTIFIER ERR_SYM_BAT_SENS ECU_ADDRESS 0x3fbb29 BIT_MASK 0xF /end MEASUREMENT
/begin MEASUREMENT fmy_stat_bat_sens_it.ctr_abc "" UBYTE _CNV_A_R_LINEAR_____1_CM 1 100. 0. 255. DISPLAY_IDENTIFIER CTR_ABC_BAT_SENS_IT ECU_ADDRESS 0x3fbb2f FORMAT "%3.0" /end MEASUREMENT
/begin MEASUREMENT fmy_stat_bat_sens_it.ctr_end_diag "" UBYTE _CNV_A_R_LINEAR_____1_CM 1 100. 0. 255. DISPLAY_IDENTIFIER CTR_ABC_END_DIAG_BAT_SENS_IT ECU_ADDRESS 0x3fbb2e FORMAT "%3.0" /end MEASUREMENT
/begin MEASUREMENT fmy_stat_bat_sens_it.err_info_stat.lv_err_mem "" UBYTE _CNV_S_2_RANGE______5_CM 1 100. 0. 1. DISPLAY_IDENTIFIER LV_ERR_MEM_BAT_SENS_IT ECU_ADDRESS 0x3fbb2d BIT_MASK 0x80 /end MEASUREMENT
/begin MEASUREMENT fmy_stat_bat_sens_it.err_info_stat.lv_ready "" UBYTE _CNV_S_2_RANGE______5_CM 1 100. 0. 1. DISPLAY_IDENTIFIER LV_READY_BAT_SENS_IT ECU_ADDRESS 0x3fbb2d BIT_MASK 0x40 /end MEASUREMENT
/begin MEASUREMENT fmy_stat_bat_sens_it.err_info_stat.lv_end_diag "" UBYTE _CNV_S_2_RANGE______5_CM 1 100. 0. 1. DISPLAY_IDENTIFIER LV_END_DIAG_BAT_SENS_IT ECU_ADDRESS 0x3fbb2d BIT_MASK 0x20 /end MEASUREMENT
/begin MEASUREMENT fmy_stat_bat_sens_it.err_info_stat.lv_cdn_diag "" UBYTE _CNV_S_2_RANGE______5_CM 1 100. 0. 1. DISPLAY_IDENTIFIER LV_CDN_DIAG_BAT_SENS_IT ECU_ADDRESS 0x3fbb2d BIT_MASK 0x10 /end MEASUREMENT
/begin MEASUREMENT fmy_stat_bat_sens_it.err_info_stat.err_sym "" UBYTE _CNV_S_6_RANGE_ERR__192_CM 1 100. 0. 15. DISPLAY_IDENTIFIER ERR_SYM_BAT_SENS_IT ECU_ADDRESS 0x3fbb2d BIT_MASK 0xF /end MEASUREMENT
/begin MEASUREMENT fmy_stat_bat_sens_it_el.ctr_abc "" UBYTE _CNV_A_R_LINEAR_____1_CM 1 100. 0. 255. DISPLAY_IDENTIFIER CTR_ABC_BAT_SENS_IT_EL ECU_ADDRESS 0x3fbb33 FORMAT "%3.0" /end MEASUREMENT
/begin MEASUREMENT fmy_stat_bat_sens_it_el.ctr_end_diag "" UBYTE _CNV_A_R_LINEAR_____1_CM 1 100. 0. 255. DISPLAY_IDENTIFIER CTR_ABC_END_DIAG_BAT_SENS_IT_EL ECU_ADDRESS 0x3fbb32 FORMAT "%3.0" /end MEASUREMENT
/begin MEASUREMENT fmy_stat_bat_sens_it_el.err_info_stat.lv_err_mem "" UBYTE _CNV_S_2_RANGE______5_CM 1 100. 0. 1. DISPLAY_IDENTIFIER LV_ERR_MEM_BAT_SENS_IT_EL ECU_ADDRESS 0x3fbb31 BIT_MASK 0x80 /end MEASUREMENT
/begin MEASUREMENT fmy_stat_bat_sens_it_el.err_info_stat.lv_ready "" UBYTE _CNV_S_2_RANGE______5_CM 1 100. 0. 1. DISPLAY_IDENTIFIER LV_READY_BAT_SENS_IT_EL ECU_ADDRESS 0x3fbb31 BIT_MASK 0x40 /end MEASUREMENT
/begin MEASUREMENT fmy_stat_bat_sens_it_el.err_info_stat.lv_end_diag "" UBYTE _CNV_S_2_RANGE______5_CM 1 100. 0. 1. DISPLAY_IDENTIFIER LV_END_DIAG_BAT_SENS_IT_EL ECU_ADDRESS 0x3fbb31 BIT_MASK 0x20 /end MEASUREMENT
/begin MEASUREMENT fmy_stat_bat_sens_it_el.err_info_stat.lv_cdn_diag "" UBYTE _CNV_S_2_RANGE______5_CM 1 100. 0. 1. DISPLAY_IDENTIFIER LV_CDN_DIAG_BAT_SENS_IT_EL ECU_ADDRESS 0x3fbb31 BIT_MASK 0x10 /end MEASUREMENT
/begin MEASUREMENT fmy_stat_bat_sens_it_el.err_info_stat.err_sym "" UBYTE _CNV_S_6_RANGE_ERR__192_CM 1 100. 0. 15. DISPLAY_IDENTIFIER ERR_SYM_BAT_SENS_IT_EL ECU_ADDRESS 0x3fbb31 BIT_MASK 0xF /end MEASUREMENT
/begin MEASUREMENT fmy_stat_ecu_nvmy.ctr_abc "" UBYTE _CNV_A_R_LINEAR_____1_CM 1 100. 0. 255. DISPLAY_IDENTIFIER CTR_ABC_ECU_NVMY ECU_ADDRESS 0x3fbb37 FORMAT "%3.0" /end MEASUREMENT
/begin MEASUREMENT fmy_stat_ecu_nvmy.ctr_end_diag "" UBYTE _CNV_A_R_LINEAR_____1_CM 1 100. 0. 255. DISPLAY_IDENTIFIER CTR_ABC_END_DIAG_ECU_NVMY ECU_ADDRESS 0x3fbb36 FORMAT "%3.0" /end MEASUREMENT
/begin MEASUREMENT fmy_stat_ecu_nvmy.err_info_stat.lv_err_mem "" UBYTE _CNV_S_2_RANGE______5_CM 1 100. 0. 1. DISPLAY_IDENTIFIER LV_ERR_MEM_ECU_NVMY ECU_ADDRESS 0x3fbb35 BIT_MASK 0x80 /end MEASUREMENT
/begin MEASUREMENT fmy_stat_ecu_nvmy.err_info_stat.lv_ready "" UBYTE _CNV_S_2_RANGE______5_CM 1 100. 0. 1. DISPLAY_IDENTIFIER LV_READY_ECU_NVMY ECU_ADDRESS 0x3fbb35 BIT_MASK 0x40 /end MEASUREMENT
/begin MEASUREMENT fmy_stat_ecu_nvmy.err_info_stat.lv_end_diag "" UBYTE _CNV_S_2_RANGE______5_CM 1 100. 0. 1. DISPLAY_IDENTIFIER LV_END_DIAG_ECU_NVMY ECU_ADDRESS 0x3fbb35 BIT_MASK 0x20 /end MEASUREMENT
/begin MEASUREMENT fmy_stat_ecu_nvmy.err_info_stat.lv_cdn_diag "" UBYTE _CNV_S_2_RANGE______5_CM 1 100. 0. 1. DISPLAY_IDENTIFIER LV_CDN_DIAG_ECU_NVMY ECU_ADDRESS 0x3fbb35 BIT_MASK 0x10 /end MEASUREMENT
/begin MEASUREMENT fmy_stat_ecu_nvmy.err_info_stat.err_sym "" UBYTE _CNV_S_6_RANGE_ERR__192_CM 1 100. 0. 15. DISPLAY_IDENTIFIER ERR_SYM_ECU_NVMY ECU_ADDRESS 0x3fbb35 BIT_MASK 0xF /end MEASUREMENT
/begin MEASUREMENT fmy_stat_gs.ctr_abc "" UBYTE _CNV_A_R_LINEAR_____1_CM 1 100. 0. 255. DISPLAY_IDENTIFIER CTR_ABC_GS ECU_ADDRESS 0x3fbb3b FORMAT "%3.0" /end MEASUREMENT
/begin MEASUREMENT fmy_stat_gs.ctr_end_diag "" UBYTE _CNV_A_R_LINEAR_____1_CM 1 100. 0. 255. DISPLAY_IDENTIFIER CTR_ABC_END_DIAG_GS ECU_ADDRESS 0x3fbb3a FORMAT "%3.0" /end MEASUREMENT
/begin MEASUREMENT fmy_stat_gs.err_info_stat.lv_err_mem "" UBYTE _CNV_S_2_RANGE______5_CM 1 100. 0. 1. DISPLAY_IDENTIFIER LV_ERR_MEM_GS ECU_ADDRESS 0x3fbb39 BIT_MASK 0x80 /end MEASUREMENT
/begin MEASUREMENT fmy_stat_gs.err_info_stat.lv_ready "" UBYTE _CNV_S_2_RANGE______5_CM 1 100. 0. 1. DISPLAY_IDENTIFIER LV_READY_GS ECU_ADDRESS 0x3fbb39 BIT_MASK 0x40 /end MEASUREMENT
/begin MEASUREMENT fmy_stat_gs.err_info_stat.lv_end_diag "" UBYTE _CNV_S_2_RANGE______5_CM 1 100. 0. 1. DISPLAY_IDENTIFIER LV_END_DIAG_GS ECU_ADDRESS 0x3fbb39 BIT_MASK 0x20 /end MEASUREMENT
/begin MEASUREMENT fmy_stat_gs.err_info_stat.lv_cdn_diag "" UBYTE _CNV_S_2_RANGE______5_CM 1 100. 0. 1. DISPLAY_IDENTIFIER LV_CDN_DIAG_GS ECU_ADDRESS 0x3fbb39 BIT_MASK 0x10 /end MEASUREMENT
/begin MEASUREMENT fmy_stat_gs.err_info_stat.err_sym "" UBYTE _CNV_S_6_RANGE_ERR__192_CM 1 100. 0. 15. DISPLAY_IDENTIFIER ERR_SYM_GS ECU_ADDRESS 0x3fbb39 BIT_MASK 0xF /end MEASUREMENT
/begin MEASUREMENT fmy_stat_obd2_lsh_up_1.ctr_abc "" UBYTE _CNV_A_R_LINEAR_____1_CM 1 100. 0. 255. DISPLAY_IDENTIFIER CTR_ABC_OBD2_LSH_UP_1 ECU_ADDRESS 0x3fbb43 FORMAT "%3.0" /end MEASUREMENT
/begin MEASUREMENT fmy_stat_obd2_lsh_up_1.ctr_end_diag "" UBYTE _CNV_A_R_LINEAR_____1_CM 1 100. 0. 255. DISPLAY_IDENTIFIER CTR_ABC_END_DIAG_OBD2_LSH_UP_1 ECU_ADDRESS 0x3fbb42 FORMAT "%3.0" /end MEASUREMENT
/begin MEASUREMENT fmy_stat_obd2_lsh_up_1.err_info_stat.lv_err_mem "" UBYTE _CNV_S_2_RANGE______5_CM 1 100. 0. 1. DISPLAY_IDENTIFIER LV_ERR_MEM_OBD2_LSH_UP_1 ECU_ADDRESS 0x3fbb41 BIT_MASK 0x80 /end MEASUREMENT
/begin MEASUREMENT fmy_stat_obd2_lsh_up_1.err_info_stat.lv_ready "" UBYTE _CNV_S_2_RANGE______5_CM 1 100. 0. 1. DISPLAY_IDENTIFIER LV_READY_OBD2_LSH_UP_1 ECU_ADDRESS 0x3fbb41 BIT_MASK 0x40 /end MEASUREMENT
/begin MEASUREMENT fmy_stat_obd2_lsh_up_1.err_info_stat.lv_end_diag "" UBYTE _CNV_S_2_RANGE______5_CM 1 100. 0. 1. DISPLAY_IDENTIFIER LV_END_DIAG_OBD2_LSH_UP_1 ECU_ADDRESS 0x3fbb41 BIT_MASK 0x20 /end MEASUREMENT
/begin MEASUREMENT fmy_stat_obd2_lsh_up_1.err_info_stat.lv_cdn_diag "" UBYTE _CNV_S_2_RANGE______5_CM 1 100. 0. 1. DISPLAY_IDENTIFIER LV_CDN_DIAG_OBD2_LSH_UP_1 ECU_ADDRESS 0x3fbb41 BIT_MASK 0x10 /end MEASUREMENT
/begin MEASUREMENT fmy_stat_obd2_lsh_up_1.err_info_stat.err_sym "" UBYTE _CNV_S_6_RANGE_ERR__192_CM 1 100. 0. 15. DISPLAY_IDENTIFIER ERR_SYM_OBD2_LSH_UP_1 ECU_ADDRESS 0x3fbb41 BIT_MASK 0xF /end MEASUREMENT
/begin MEASUREMENT fmy_stat_obd2_lsh_up_2.ctr_abc "" UBYTE _CNV_A_R_LINEAR_____1_CM 1 100. 0. 255. DISPLAY_IDENTIFIER CTR_ABC_OBD2_LSH_UP_2 ECU_ADDRESS 0x3fbb47 FORMAT "%3.0" /end MEASUREMENT
/begin MEASUREMENT fmy_stat_obd2_lsh_up_2.ctr_end_diag "" UBYTE _CNV_A_R_LINEAR_____1_CM 1 100. 0. 255. DISPLAY_IDENTIFIER CTR_ABC_END_DIAG_OBD2_LSH_UP_2 ECU_ADDRESS 0x3fbb46 FORMAT "%3.0" /end MEASUREMENT
/begin MEASUREMENT fmy_stat_obd2_lsh_up_2.err_info_stat.lv_err_mem "" UBYTE _CNV_S_2_RANGE______5_CM 1 100. 0. 1. DISPLAY_IDENTIFIER LV_ERR_MEM_OBD2_LSH_UP_2 ECU_ADDRESS 0x3fbb45 BIT_MASK 0x80 /end MEASUREMENT
/begin MEASUREMENT fmy_stat_obd2_lsh_up_2.err_info_stat.lv_ready "" UBYTE _CNV_S_2_RANGE______5_CM 1 100. 0. 1. DISPLAY_IDENTIFIER LV_READY_OBD2_LSH_UP_2 ECU_ADDRESS 0x3fbb45 BIT_MASK 0x40 /end MEASUREMENT
/begin MEASUREMENT fmy_stat_obd2_lsh_up_2.err_info_stat.lv_end_diag "" UBYTE _CNV_S_2_RANGE______5_CM 1 100. 0. 1. DISPLAY_IDENTIFIER LV_END_DIAG_OBD2_LSH_UP_2 ECU_ADDRESS 0x3fbb45 BIT_MASK 0x20 /end MEASUREMENT
/begin MEASUREMENT fmy_stat_obd2_lsh_up_2.err_info_stat.lv_cdn_diag "" UBYTE _CNV_S_2_RANGE______5_CM 1 100. 0. 1. DISPLAY_IDENTIFIER LV_CDN_DIAG_OBD2_LSH_UP_2 ECU_ADDRESS 0x3fbb45 BIT_MASK 0x10 /end MEASUREMENT
/begin MEASUREMENT fmy_stat_obd2_lsh_up_2.err_info_stat.err_sym "" UBYTE _CNV_S_6_RANGE_ERR__192_CM 1 100. 0. 15. DISPLAY_IDENTIFIER ERR_SYM_OBD2_LSH_UP_2 ECU_ADDRESS 0x3fbb45 BIT_MASK 0xF /end MEASUREMENT
/begin MEASUREMENT fmy_stat_cat_diag_1.ctr_abc "" UBYTE _CNV_A_R_LINEAR_____1_CM 1 100. 0. 255. DISPLAY_IDENTIFIER CTR_ABC_CAT_DIAG_1 ECU_ADDRESS 0x3fbb4b FORMAT "%3.0" /end MEASUREMENT
/begin MEASUREMENT fmy_stat_cat_diag_1.ctr_end_diag "" UBYTE _CNV_A_R_LINEAR_____1_CM 1 100. 0. 255. DISPLAY_IDENTIFIER CTR_ABC_END_DIAG_CAT_DIAG_1 ECU_ADDRESS 0x3fbb4a FORMAT "%3.0" /end MEASUREMENT
/begin MEASUREMENT fmy_stat_cat_diag_1.err_info_stat.lv_err_mem "" UBYTE _CNV_S_2_RANGE______5_CM 1 100. 0. 1. DISPLAY_IDENTIFIER LV_ERR_MEM_CAT_DIAG_1 ECU_ADDRESS 0x3fbb49 BIT_MASK 0x80 /end MEASUREMENT
/begin MEASUREMENT fmy_stat_cat_diag_1.err_info_stat.lv_ready "" UBYTE _CNV_S_2_RANGE______5_CM 1 100. 0. 1. DISPLAY_IDENTIFIER LV_READY_CAT_DIAG_1 ECU_ADDRESS 0x3fbb49 BIT_MASK 0x40 /end MEASUREMENT
/begin MEASUREMENT fmy_stat_cat_diag_1.err_info_stat.lv_end_diag "" UBYTE _CNV_S_2_RANGE______5_CM 1 100. 0. 1. DISPLAY_IDENTIFIER LV_END_DIAG_CAT_DIAG_1 ECU_ADDRESS 0x3fbb49 BIT_MASK 0x20 /end MEASUREMENT
/begin MEASUREMENT fmy_stat_cat_diag_1.err_info_stat.lv_cdn_diag "" UBYTE _CNV_S_2_RANGE______5_CM 1 100. 0. 1. DISPLAY_IDENTIFIER LV_CDN_DIAG_CAT_DIAG_1 ECU_ADDRESS 0x3fbb49 BIT_MASK 0x10 /end MEASUREMENT
/begin MEASUREMENT fmy_stat_cat_diag_1.err_info_stat.err_sym "" UBYTE _CNV_S_6_RANGE_ERR__192_CM 1 100. 0. 15. DISPLAY_IDENTIFIER ERR_SYM_CAT_DIAG_1 ECU_ADDRESS 0x3fbb49 BIT_MASK 0xF /end MEASUREMENT
/begin MEASUREMENT fmy_stat_cat_diag_2.ctr_abc "" UBYTE _CNV_A_R_LINEAR_____1_CM 1 100. 0. 255. DISPLAY_IDENTIFIER CTR_ABC_CAT_DIAG_2 ECU_ADDRESS 0x3fbb4f FORMAT "%3.0" /end MEASUREMENT
/begin MEASUREMENT fmy_stat_cat_diag_2.ctr_end_diag "" UBYTE _CNV_A_R_LINEAR_____1_CM 1 100. 0. 255. DISPLAY_IDENTIFIER CTR_ABC_END_DIAG_CAT_DIAG_2 ECU_ADDRESS 0x3fbb4e FORMAT "%3.0" /end MEASUREMENT
/begin MEASUREMENT fmy_stat_cat_diag_2.err_info_stat.lv_err_mem "" UBYTE _CNV_S_2_RANGE______5_CM 1 100. 0. 1. DISPLAY_IDENTIFIER LV_ERR_MEM_CAT_DIAG_2 ECU_ADDRESS 0x3fbb4d BIT_MASK 0x80 /end MEASUREMENT
/begin MEASUREMENT fmy_stat_cat_diag_2.err_info_stat.lv_ready "" UBYTE _CNV_S_2_RANGE______5_CM 1 100. 0. 1. DISPLAY_IDENTIFIER LV_READY_CAT_DIAG_2 ECU_ADDRESS 0x3fbb4d BIT_MASK 0x40 /end MEASUREMENT
/begin MEASUREMENT fmy_stat_cat_diag_2.err_info_stat.lv_end_diag "" UBYTE _CNV_S_2_RANGE______5_CM 1 100. 0. 1. DISPLAY_IDENTIFIER LV_END_DIAG_CAT_DIAG_2 ECU_ADDRESS 0x3fbb4d BIT_MASK 0x20 /end MEASUREMENT
/begin MEASUREMENT fmy_stat_cat_diag_2.err_info_stat.lv_cdn_diag "" UBYTE _CNV_S_2_RANGE______5_CM 1 100. 0. 1. DISPLAY_IDENTIFIER LV_CDN_DIAG_CAT_DIAG_2 ECU_ADDRESS 0x3fbb4d BIT_MASK 0x10 /end MEASUREMENT
/begin MEASUREMENT fmy_stat_cat_diag_2.err_info_stat.err_sym "" UBYTE _CNV_S_6_RANGE_ERR__192_CM 1 100. 0. 15. DISPLAY_IDENTIFIER ERR_SYM_CAT_DIAG_2 ECU_ADDRESS 0x3fbb4d BIT_MASK 0xF /end MEASUREMENT
/begin MEASUREMENT fmy_stat_chk_ls_down_1.ctr_abc "" UBYTE _CNV_A_R_LINEAR_____1_CM 1 100. 0. 255. DISPLAY_IDENTIFIER CTR_ABC_CHK_LS_DOWN_1 ECU_ADDRESS 0x3fbb53 FORMAT "%3.0" /end MEASUREMENT
/begin MEASUREMENT fmy_stat_chk_ls_down_1.ctr_end_diag "" UBYTE _CNV_A_R_LINEAR_____1_CM 1 100. 0. 255. DISPLAY_IDENTIFIER CTR_ABC_END_DIAG_CHK_LS_DOWN_1 ECU_ADDRESS 0x3fbb52 FORMAT "%3.0" /end MEASUREMENT
/begin MEASUREMENT fmy_stat_chk_ls_down_1.err_info_stat.lv_err_mem "" UBYTE _CNV_S_2_RANGE______5_CM 1 100. 0. 1. DISPLAY_IDENTIFIER LV_ERR_MEM_CHK_LS_DOWN_1 ECU_ADDRESS 0x3fbb51 BIT_MASK 0x80 /end MEASUREMENT
/begin MEASUREMENT fmy_stat_chk_ls_down_1.err_info_stat.lv_ready "" UBYTE _CNV_S_2_RANGE______5_CM 1 100. 0. 1. DISPLAY_IDENTIFIER LV_READY_CHK_LS_DOWN_1 ECU_ADDRESS 0x3fbb51 BIT_MASK 0x40 /end MEASUREMENT
/begin MEASUREMENT fmy_stat_chk_ls_down_1.err_info_stat.lv_end_diag "" UBYTE _CNV_S_2_RANGE______5_CM 1 100. 0. 1. DISPLAY_IDENTIFIER LV_END_DIAG_CHK_LS_DOWN_1 ECU_ADDRESS 0x3fbb51 BIT_MASK 0x20 /end MEASUREMENT
/begin MEASUREMENT fmy_stat_chk_ls_down_1.err_info_stat.lv_cdn_diag "" UBYTE _CNV_S_2_RANGE______5_CM 1 100. 0. 1. DISPLAY_IDENTIFIER LV_CDN_DIAG_CHK_LS_DOWN_1 ECU_ADDRESS 0x3fbb51 BIT_MASK 0x10 /end MEASUREMENT
/begin MEASUREMENT fmy_stat_chk_ls_down_1.err_info_stat.err_sym "" UBYTE _CNV_S_6_RANGE_ERR__192_CM 1 100. 0. 15. DISPLAY_IDENTIFIER ERR_SYM_CHK_LS_DOWN_1 ECU_ADDRESS 0x3fbb51 BIT_MASK 0xF /end MEASUREMENT
/begin MEASUREMENT fmy_stat_chk_ls_down_2.ctr_abc "" UBYTE _CNV_A_R_LINEAR_____1_CM 1 100. 0. 255. DISPLAY_IDENTIFIER CTR_ABC_CHK_LS_DOWN_2 ECU_ADDRESS 0x3fbb57 FORMAT "%3.0" /end MEASUREMENT
/begin MEASUREMENT fmy_stat_chk_ls_down_2.ctr_end_diag "" UBYTE _CNV_A_R_LINEAR_____1_CM 1 100. 0. 255. DISPLAY_IDENTIFIER CTR_ABC_END_DIAG_CHK_LS_DOWN_2 ECU_ADDRESS 0x3fbb56 FORMAT "%3.0" /end MEASUREMENT
/begin MEASUREMENT fmy_stat_chk_ls_down_2.err_info_stat.lv_err_mem "" UBYTE _CNV_S_2_RANGE______5_CM 1 100. 0. 1. DISPLAY_IDENTIFIER LV_ERR_MEM_CHK_LS_DOWN_2 ECU_ADDRESS 0x3fbb55 BIT_MASK 0x80 /end MEASUREMENT
/begin MEASUREMENT fmy_stat_chk_ls_down_2.err_info_stat.lv_ready "" UBYTE _CNV_S_2_RANGE______5_CM 1 100. 0. 1. DISPLAY_IDENTIFIER LV_READY_CHK_LS_DOWN_2 ECU_ADDRESS 0x3fbb55 BIT_MASK 0x40 /end MEASUREMENT
/begin MEASUREMENT fmy_stat_chk_ls_down_2.err_info_stat.lv_end_diag "" UBYTE _CNV_S_2_RANGE______5_CM 1 100. 0. 1. DISPLAY_IDENTIFIER LV_END_DIAG_CHK_LS_DOWN_2 ECU_ADDRESS 0x3fbb55 BIT_MASK 0x20 /end MEASUREMENT
/begin MEASUREMENT fmy_stat_chk_ls_down_2.err_info_stat.lv_cdn_diag "" UBYTE _CNV_S_2_RANGE______5_CM 1 100. 0. 1. DISPLAY_IDENTIFIER LV_CDN_DIAG_CHK_LS_DOWN_2 ECU_ADDRESS 0x3fbb55 BIT_MASK 0x10 /end MEASUREMENT
/begin MEASUREMENT fmy_stat_chk_ls_down_2.err_info_stat.err_sym "" UBYTE _CNV_S_6_RANGE_ERR__192_CM 1 100. 0. 15. DISPLAY_IDENTIFIER ERR_SYM_CHK_LS_DOWN_2 ECU_ADDRESS 0x3fbb55 BIT_MASK 0xF /end MEASUREMENT
/begin MEASUREMENT fmy_stat_vls_up_min_cold_1.ctr_abc "" UBYTE _CNV_A_R_LINEAR_____1_CM 1 100. 0. 255. DISPLAY_IDENTIFIER CTR_ABC_VLS_UP_MIN_COLD_1 ECU_ADDRESS 0x3fbb5b FORMAT "%3.0" /end MEASUREMENT
/begin MEASUREMENT fmy_stat_vls_up_min_cold_1.ctr_end_diag "" UBYTE _CNV_A_R_LINEAR_____1_CM 1 100. 0. 255. DISPLAY_IDENTIFIER CTR_ABC_END_DIAG_VLS_UP_MIN_COLD ECU_ADDRESS 0x3fbb5a FORMAT "%3.0" /end MEASUREMENT
/begin MEASUREMENT fmy_stat_vls_up_min_cold_1.err_info_stat.lv_err_mem "" UBYTE _CNV_S_2_RANGE______5_CM 1 100. 0. 1. DISPLAY_IDENTIFIER LV_ERR_MEM_VLS_UP_MIN_COLD_1 ECU_ADDRESS 0x3fbb59 BIT_MASK 0x80 /end MEASUREMENT
/begin MEASUREMENT fmy_stat_vls_up_min_cold_1.err_info_stat.lv_ready "" UBYTE _CNV_S_2_RANGE______5_CM 1 100. 0. 1. DISPLAY_IDENTIFIER LV_READY_VLS_UP_MIN_COLD_1 ECU_ADDRESS 0x3fbb59 BIT_MASK 0x40 /end MEASUREMENT
/begin MEASUREMENT fmy_stat_vls_up_min_cold_1.err_info_stat.lv_end_diag "" UBYTE _CNV_S_2_RANGE______5_CM 1 100. 0. 1. DISPLAY_IDENTIFIER LV_END_DIAG_VLS_UP_MIN_COLD_1 ECU_ADDRESS 0x3fbb59 BIT_MASK 0x20 /end MEASUREMENT
/begin MEASUREMENT fmy_stat_vls_up_min_cold_1.err_info_stat.lv_cdn_diag "" UBYTE _CNV_S_2_RANGE______5_CM 1 100. 0. 1. DISPLAY_IDENTIFIER LV_CDN_DIAG_VLS_UP_MIN_COLD_1 ECU_ADDRESS 0x3fbb59 BIT_MASK 0x10 /end MEASUREMENT
/begin MEASUREMENT fmy_stat_vls_up_min_cold_1.err_info_stat.err_sym "" UBYTE _CNV_S_6_RANGE_ERR__192_CM 1 100. 0. 15. DISPLAY_IDENTIFIER ERR_SYM_VLS_UP_MIN_COLD_1 ECU_ADDRESS 0x3fbb59 BIT_MASK 0xF /end MEASUREMENT
/begin MEASUREMENT fmy_stat_vls_up_min_cold_2.ctr_abc "" UBYTE _CNV_A_R_LINEAR_____1_CM 1 100. 0. 255. DISPLAY_IDENTIFIER CTR_ABC_VLS_UP_MIN_COLD_2 ECU_ADDRESS 0x3fbb5f FORMAT "%3.0" /end MEASUREMENT
/begin MEASUREMENT fmy_stat_vls_up_min_cold_2.ctr_end_diag "" UBYTE _CNV_A_R_LINEAR_____1_CM 1 100. 0. 255. DISPLAY_IDENTIFIER CTR_ABC_END_DIAG_VLS_UP_MIN_COLD ECU_ADDRESS 0x3fbb5e FORMAT "%3.0" /end MEASUREMENT
/begin MEASUREMENT fmy_stat_vls_up_min_cold_2.err_info_stat.lv_err_mem "" UBYTE _CNV_S_2_RANGE______5_CM 1 100. 0. 1. DISPLAY_IDENTIFIER LV_ERR_MEM_VLS_UP_MIN_COLD_2 ECU_ADDRESS 0x3fbb5d BIT_MASK 0x80 /end MEASUREMENT
/begin MEASUREMENT fmy_stat_vls_up_min_cold_2.err_info_stat.lv_ready "" UBYTE _CNV_S_2_RANGE______5_CM 1 100. 0. 1. DISPLAY_IDENTIFIER LV_READY_VLS_UP_MIN_COLD_2 ECU_ADDRESS 0x3fbb5d BIT_MASK 0x40 /end MEASUREMENT
/begin MEASUREMENT fmy_stat_vls_up_min_cold_2.err_info_stat.lv_end_diag "" UBYTE _CNV_S_2_RANGE______5_CM 1 100. 0. 1. DISPLAY_IDENTIFIER LV_END_DIAG_VLS_UP_MIN_COLD_2 ECU_ADDRESS 0x3fbb5d BIT_MASK 0x20 /end MEASUREMENT
/begin MEASUREMENT fmy_stat_vls_up_min_cold_2.err_info_stat.lv_cdn_diag "" UBYTE _CNV_S_2_RANGE______5_CM 1 100. 0. 1. DISPLAY_IDENTIFIER LV_CDN_DIAG_VLS_UP_MIN_COLD_2 ECU_ADDRESS 0x3fbb5d BIT_MASK 0x10 /end MEASUREMENT
/begin MEASUREMENT fmy_stat_vls_up_min_cold_2.err_info_stat.err_sym "" UBYTE _CNV_S_6_RANGE_ERR__192_CM 1 100. 0. 15. DISPLAY_IDENTIFIER ERR_SYM_VLS_UP_MIN_COLD_2 ECU_ADDRESS 0x3fbb5d BIT_MASK 0xF /end MEASUREMENT
/begin MEASUREMENT fmy_stat_vls_up_min_1.ctr_abc "" UBYTE _CNV_A_R_LINEAR_____1_CM 1 100. 0. 255. DISPLAY_IDENTIFIER CTR_ABC_VLS_UP_MIN_1 ECU_ADDRESS 0x3fbb63 FORMAT "%3.0" /end MEASUREMENT
/begin MEASUREMENT fmy_stat_vls_up_min_1.ctr_end_diag "" UBYTE _CNV_A_R_LINEAR_____1_CM 1 100. 0. 255. DISPLAY_IDENTIFIER CTR_ABC_END_DIAG_VLS_UP_MIN_1 ECU_ADDRESS 0x3fbb62 FORMAT "%3.0" /end MEASUREMENT
/begin MEASUREMENT fmy_stat_vls_up_min_1.err_info_stat.lv_err_mem "" UBYTE _CNV_S_2_RANGE______5_CM 1 100. 0. 1. DISPLAY_IDENTIFIER LV_ERR_MEM_VLS_UP_MIN_1 ECU_ADDRESS 0x3fbb61 BIT_MASK 0x80 /end MEASUREMENT
/begin MEASUREMENT fmy_stat_vls_up_min_1.err_info_stat.lv_ready "" UBYTE _CNV_S_2_RANGE______5_CM 1 100. 0. 1. DISPLAY_IDENTIFIER LV_READY_VLS_UP_MIN_1 ECU_ADDRESS 0x3fbb61 BIT_MASK 0x40 /end MEASUREMENT
/begin MEASUREMENT fmy_stat_vls_up_min_1.err_info_stat.lv_end_diag "" UBYTE _CNV_S_2_RANGE______5_CM 1 100. 0. 1. DISPLAY_IDENTIFIER LV_END_DIAG_VLS_UP_MIN_1 ECU_ADDRESS 0x3fbb61 BIT_MASK 0x20 /end MEASUREMENT
/begin MEASUREMENT fmy_stat_vls_up_min_1.err_info_stat.lv_cdn_diag "" UBYTE _CNV_S_2_RANGE______5_CM 1 100. 0. 1. DISPLAY_IDENTIFIER LV_CDN_DIAG_VLS_UP_MIN_1 ECU_ADDRESS 0x3fbb61 BIT_MASK 0x10 /end MEASUREMENT
/begin MEASUREMENT fmy_stat_vls_up_min_1.err_info_stat.err_sym "" UBYTE _CNV_S_6_RANGE_ERR__192_CM 1 100. 0. 15. DISPLAY_IDENTIFIER ERR_SYM_VLS_UP_MIN_1 ECU_ADDRESS 0x3fbb61 BIT_MASK 0xF /end MEASUREMENT
/begin MEASUREMENT fmy_stat_vls_up_min_2.ctr_abc "" UBYTE _CNV_A_R_LINEAR_____1_CM 1 100. 0. 255. DISPLAY_IDENTIFIER CTR_ABC_VLS_UP_MIN_2 ECU_ADDRESS 0x3fbb67 FORMAT "%3.0" /end MEASUREMENT
/begin MEASUREMENT fmy_stat_vls_up_min_2.ctr_end_diag "" UBYTE _CNV_A_R_LINEAR_____1_CM 1 100. 0. 255. DISPLAY_IDENTIFIER CTR_ABC_END_DIAG_VLS_UP_MIN_2 ECU_ADDRESS 0x3fbb66 FORMAT "%3.0" /end MEASUREMENT
/begin MEASUREMENT fmy_stat_vls_up_min_2.err_info_stat.lv_err_mem "" UBYTE _CNV_S_2_RANGE______5_CM 1 100. 0. 1. DISPLAY_IDENTIFIER LV_ERR_MEM_VLS_UP_MIN_2 ECU_ADDRESS 0x3fbb65 BIT_MASK 0x80 /end MEASUREMENT
/begin MEASUREMENT fmy_stat_vls_up_min_2.err_info_stat.lv_ready "" UBYTE _CNV_S_2_RANGE______5_CM 1 100. 0. 1. DISPLAY_IDENTIFIER LV_READY_VLS_UP_MIN_2 ECU_ADDRESS 0x3fbb65 BIT_MASK 0x40 /end MEASUREMENT
/begin MEASUREMENT fmy_stat_vls_up_min_2.err_info_stat.lv_end_diag "" UBYTE _CNV_S_2_RANGE______5_CM 1 100. 0. 1. DISPLAY_IDENTIFIER LV_END_DIAG_VLS_UP_MIN_2 ECU_ADDRESS 0x3fbb65 BIT_MASK 0x20 /end MEASUREMENT
/begin MEASUREMENT fmy_stat_vls_up_min_2.err_info_stat.lv_cdn_diag "" UBYTE _CNV_S_2_RANGE______5_CM 1 100. 0. 1. DISPLAY_IDENTIFIER LV_CDN_DIAG_VLS_UP_MIN_2 ECU_ADDRESS 0x3fbb65 BIT_MASK 0x10 /end MEASUREMENT
/begin MEASUREMENT fmy_stat_vls_up_min_2.err_info_stat.err_sym "" UBYTE _CNV_S_6_RANGE_ERR__192_CM 1 100. 0. 15. DISPLAY_IDENTIFIER ERR_SYM_VLS_UP_MIN_2 ECU_ADDRESS 0x3fbb65 BIT_MASK 0xF /end MEASUREMENT
/begin MEASUREMENT fmy_stat_vls_up_max_1.ctr_abc "" UBYTE _CNV_A_R_LINEAR_____1_CM 1 100. 0. 255. DISPLAY_IDENTIFIER CTR_ABC_VLS_UP_MAX_1 ECU_ADDRESS 0x3fbb6b FORMAT "%3.0" /end MEASUREMENT
/begin MEASUREMENT fmy_stat_vls_up_max_1.ctr_end_diag "" UBYTE _CNV_A_R_LINEAR_____1_CM 1 100. 0. 255. DISPLAY_IDENTIFIER CTR_ABC_END_DIAG_VLS_UP_MAX_1 ECU_ADDRESS 0x3fbb6a FORMAT "%3.0" /end MEASUREMENT
/begin MEASUREMENT fmy_stat_vls_up_max_1.err_info_stat.lv_err_mem "" UBYTE _CNV_S_2_RANGE______5_CM 1 100. 0. 1. DISPLAY_IDENTIFIER LV_ERR_MEM_VLS_UP_MAX_1 ECU_ADDRESS 0x3fbb69 BIT_MASK 0x80 /end MEASUREMENT
/begin MEASUREMENT fmy_stat_vls_up_max_1.err_info_stat.lv_ready "" UBYTE _CNV_S_2_RANGE______5_CM 1 100. 0. 1. DISPLAY_IDENTIFIER LV_READY_VLS_UP_MAX_1 ECU_ADDRESS 0x3fbb69 BIT_MASK 0x40 /end MEASUREMENT
/begin MEASUREMENT fmy_stat_vls_up_max_1.err_info_stat.lv_end_diag "" UBYTE _CNV_S_2_RANGE______5_CM 1 100. 0. 1. DISPLAY_IDENTIFIER LV_END_DIAG_VLS_UP_MAX_1 ECU_ADDRESS 0x3fbb69 BIT_MASK 0x20 /end MEASUREMENT
/begin MEASUREMENT fmy_stat_vls_up_max_1.err_info_stat.lv_cdn_diag "" UBYTE _CNV_S_2_RANGE______5_CM 1 100. 0. 1. DISPLAY_IDENTIFIER LV_CDN_DIAG_VLS_UP_MAX_1 ECU_ADDRESS 0x3fbb69 BIT_MASK 0x10 /end MEASUREMENT
/begin MEASUREMENT fmy_stat_vls_up_max_1.err_info_stat.err_sym "" UBYTE _CNV_S_6_RANGE_ERR__192_CM 1 100. 0. 15. DISPLAY_IDENTIFIER ERR_SYM_VLS_UP_MAX_1 ECU_ADDRESS 0x3fbb69 BIT_MASK 0xF /end MEASUREMENT
/begin MEASUREMENT fmy_stat_vls_up_max_2.ctr_abc "" UBYTE _CNV_A_R_LINEAR_____1_CM 1 100. 0. 255. DISPLAY_IDENTIFIER CTR_ABC_VLS_UP_MAX_2 ECU_ADDRESS 0x3fbb6f FORMAT "%3.0" /end MEASUREMENT
/begin MEASUREMENT fmy_stat_vls_up_max_2.ctr_end_diag "" UBYTE _CNV_A_R_LINEAR_____1_CM 1 100. 0. 255. DISPLAY_IDENTIFIER CTR_ABC_END_DIAG_VLS_UP_MAX_2 ECU_ADDRESS 0x3fbb6e FORMAT "%3.0" /end MEASUREMENT
/begin MEASUREMENT fmy_stat_vls_up_max_2.err_info_stat.lv_err_mem "" UBYTE _CNV_S_2_RANGE______5_CM 1 100. 0. 1. DISPLAY_IDENTIFIER LV_ERR_MEM_VLS_UP_MAX_2 ECU_ADDRESS 0x3fbb6d BIT_MASK 0x80 /end MEASUREMENT
/begin MEASUREMENT fmy_stat_vls_up_max_2.err_info_stat.lv_ready "" UBYTE _CNV_S_2_RANGE______5_CM 1 100. 0. 1. DISPLAY_IDENTIFIER LV_READY_VLS_UP_MAX_2 ECU_ADDRESS 0x3fbb6d BIT_MASK 0x40 /end MEASUREMENT
/begin MEASUREMENT fmy_stat_vls_up_max_2.err_info_stat.lv_end_diag "" UBYTE _CNV_S_2_RANGE______5_CM 1 100. 0. 1. DISPLAY_IDENTIFIER LV_END_DIAG_VLS_UP_MAX_2 ECU_ADDRESS 0x3fbb6d BIT_MASK 0x20 /end MEASUREMENT
/begin MEASUREMENT fmy_stat_vls_up_max_2.err_info_stat.lv_cdn_diag "" UBYTE _CNV_S_2_RANGE______5_CM 1 100. 0. 1. DISPLAY_IDENTIFIER LV_CDN_DIAG_VLS_UP_MAX_2 ECU_ADDRESS 0x3fbb6d BIT_MASK 0x10 /end MEASUREMENT
/begin MEASUREMENT fmy_stat_vls_up_max_2.err_info_stat.err_sym "" UBYTE _CNV_S_6_RANGE_ERR__192_CM 1 100. 0. 15. DISPLAY_IDENTIFIER ERR_SYM_VLS_UP_MAX_2 ECU_ADDRESS 0x3fbb6d BIT_MASK 0xF /end MEASUREMENT
/begin MEASUREMENT fmy_stat_vls_up_oc_1.ctr_abc "" UBYTE _CNV_A_R_LINEAR_____1_CM 1 100. 0. 255. DISPLAY_IDENTIFIER CTR_ABC_VLS_UP_OC_1 ECU_ADDRESS 0x3fbb73 FORMAT "%3.0" /end MEASUREMENT
/begin MEASUREMENT fmy_stat_vls_up_oc_1.ctr_end_diag "" UBYTE _CNV_A_R_LINEAR_____1_CM 1 100. 0. 255. DISPLAY_IDENTIFIER CTR_ABC_END_DIAG_VLS_UP_OC_1 ECU_ADDRESS 0x3fbb72 FORMAT "%3.0" /end MEASUREMENT
/begin MEASUREMENT fmy_stat_vls_up_oc_1.err_info_stat.lv_err_mem "" UBYTE _CNV_S_2_RANGE______5_CM 1 100. 0. 1. DISPLAY_IDENTIFIER LV_ERR_MEM_VLS_UP_OC_1 ECU_ADDRESS 0x3fbb71 BIT_MASK 0x80 /end MEASUREMENT
/begin MEASUREMENT fmy_stat_vls_up_oc_1.err_info_stat.lv_ready "" UBYTE _CNV_S_2_RANGE______5_CM 1 100. 0. 1. DISPLAY_IDENTIFIER LV_READY_VLS_UP_OC_1 ECU_ADDRESS 0x3fbb71 BIT_MASK 0x40 /end MEASUREMENT
/begin MEASUREMENT fmy_stat_vls_up_oc_1.err_info_stat.lv_end_diag "" UBYTE _CNV_S_2_RANGE______5_CM 1 100. 0. 1. DISPLAY_IDENTIFIER LV_END_DIAG_VLS_UP_OC_1 ECU_ADDRESS 0x3fbb71 BIT_MASK 0x20 /end MEASUREMENT
/begin MEASUREMENT fmy_stat_vls_up_oc_1.err_info_stat.lv_cdn_diag "" UBYTE _CNV_S_2_RANGE______5_CM 1 100. 0. 1. DISPLAY_IDENTIFIER LV_CDN_DIAG_VLS_UP_OC_1 ECU_ADDRESS 0x3fbb71 BIT_MASK 0x10 /end MEASUREMENT
/begin MEASUREMENT fmy_stat_vls_up_oc_1.err_info_stat.err_sym "" UBYTE _CNV_S_6_RANGE_ERR__192_CM 1 100. 0. 15. DISPLAY_IDENTIFIER ERR_SYM_VLS_UP_OC_1 ECU_ADDRESS 0x3fbb71 BIT_MASK 0xF /end MEASUREMENT
/begin MEASUREMENT fmy_stat_vls_up_oc_2.ctr_abc "" UBYTE _CNV_A_R_LINEAR_____1_CM 1 100. 0. 255. DISPLAY_IDENTIFIER CTR_ABC_VLS_UP_OC_2 ECU_ADDRESS 0x3fbb77 FORMAT "%3.0" /end MEASUREMENT
/begin MEASUREMENT fmy_stat_vls_up_oc_2.ctr_end_diag "" UBYTE _CNV_A_R_LINEAR_____1_CM 1 100. 0. 255. DISPLAY_IDENTIFIER CTR_ABC_END_DIAG_VLS_UP_OC_2 ECU_ADDRESS 0x3fbb76 FORMAT "%3.0" /end MEASUREMENT
/begin MEASUREMENT fmy_stat_vls_up_oc_2.err_info_stat.lv_err_mem "" UBYTE _CNV_S_2_RANGE______5_CM 1 100. 0. 1. DISPLAY_IDENTIFIER LV_ERR_MEM_VLS_UP_OC_2 ECU_ADDRESS 0x3fbb75 BIT_MASK 0x80 /end MEASUREMENT
/begin MEASUREMENT fmy_stat_vls_up_oc_2.err_info_stat.lv_ready "" UBYTE _CNV_S_2_RANGE______5_CM 1 100. 0. 1. DISPLAY_IDENTIFIER LV_READY_VLS_UP_OC_2 ECU_ADDRESS 0x3fbb75 BIT_MASK 0x40 /end MEASUREMENT
/begin MEASUREMENT fmy_stat_vls_up_oc_2.err_info_stat.lv_end_diag "" UBYTE _CNV_S_2_RANGE______5_CM 1 100. 0. 1. DISPLAY_IDENTIFIER LV_END_DIAG_VLS_UP_OC_2 ECU_ADDRESS 0x3fbb75 BIT_MASK 0x20 /end MEASUREMENT
/begin MEASUREMENT fmy_stat_vls_up_oc_2.err_info_stat.lv_cdn_diag "" UBYTE _CNV_S_2_RANGE______5_CM 1 100. 0. 1. DISPLAY_IDENTIFIER LV_CDN_DIAG_VLS_UP_OC_2 ECU_ADDRESS 0x3fbb75 BIT_MASK 0x10 /end MEASUREMENT
/begin MEASUREMENT fmy_stat_vls_up_oc_2.err_info_stat.err_sym "" UBYTE _CNV_S_6_RANGE_ERR__192_CM 1 100. 0. 15. DISPLAY_IDENTIFIER ERR_SYM_VLS_UP_OC_2 ECU_ADDRESS 0x3fbb75 BIT_MASK 0xF /end MEASUREMENT
/begin MEASUREMENT fmy_stat_vls_up_puc_1.ctr_abc "" UBYTE _CNV_A_R_LINEAR_____1_CM 1 100. 0. 255. DISPLAY_IDENTIFIER CTR_ABC_VLS_UP_PUC_1 ECU_ADDRESS 0x3fbb7b FORMAT "%3.0" /end MEASUREMENT
/begin MEASUREMENT fmy_stat_vls_up_puc_1.ctr_end_diag "" UBYTE _CNV_A_R_LINEAR_____1_CM 1 100. 0. 255. DISPLAY_IDENTIFIER CTR_ABC_END_DIAG_VLS_UP_PUC_1 ECU_ADDRESS 0x3fbb7a FORMAT "%3.0" /end MEASUREMENT
/begin MEASUREMENT fmy_stat_vls_up_puc_1.err_info_stat.lv_err_mem "" UBYTE _CNV_S_2_RANGE______5_CM 1 100. 0. 1. DISPLAY_IDENTIFIER LV_ERR_MEM_VLS_UP_PUC_1 ECU_ADDRESS 0x3fbb79 BIT_MASK 0x80 /end MEASUREMENT
/begin MEASUREMENT fmy_stat_vls_up_puc_1.err_info_stat.lv_ready "" UBYTE _CNV_S_2_RANGE______5_CM 1 100. 0. 1. DISPLAY_IDENTIFIER LV_READY_VLS_UP_PUC_1 ECU_ADDRESS 0x3fbb79 BIT_MASK 0x40 /end MEASUREMENT
/begin MEASUREMENT fmy_stat_vls_up_puc_1.err_info_stat.lv_end_diag "" UBYTE _CNV_S_2_RANGE______5_CM 1 100. 0. 1. DISPLAY_IDENTIFIER LV_END_DIAG_VLS_UP_PUC_1 ECU_ADDRESS 0x3fbb79 BIT_MASK 0x20 /end MEASUREMENT
/begin MEASUREMENT fmy_stat_vls_up_puc_1.err_info_stat.lv_cdn_diag "" UBYTE _CNV_S_2_RANGE______5_CM 1 100. 0. 1. DISPLAY_IDENTIFIER LV_CDN_DIAG_VLS_UP_PUC_1 ECU_ADDRESS 0x3fbb79 BIT_MASK 0x10 /end MEASUREMENT
/begin MEASUREMENT fmy_stat_vls_up_puc_1.err_info_stat.err_sym "" UBYTE _CNV_S_6_RANGE_ERR__192_CM 1 100. 0. 15. DISPLAY_IDENTIFIER ERR_SYM_VLS_UP_PUC_1 ECU_ADDRESS 0x3fbb79 BIT_MASK 0xF /end MEASUREMENT
/begin MEASUREMENT fmy_stat_vls_up_puc_2.ctr_abc "" UBYTE _CNV_A_R_LINEAR_____1_CM 1 100. 0. 255. DISPLAY_IDENTIFIER CTR_ABC_VLS_UP_PUC_2 ECU_ADDRESS 0x3fbb7f FORMAT "%3.0" /end MEASUREMENT
/begin MEASUREMENT fmy_stat_vls_up_puc_2.ctr_end_diag "" UBYTE _CNV_A_R_LINEAR_____1_CM 1 100. 0. 255. DISPLAY_IDENTIFIER CTR_ABC_END_DIAG_VLS_UP_PUC_2 ECU_ADDRESS 0x3fbb7e FORMAT "%3.0" /end MEASUREMENT
/begin MEASUREMENT fmy_stat_vls_up_puc_2.err_info_stat.lv_err_mem "" UBYTE _CNV_S_2_RANGE______5_CM 1 100. 0. 1. DISPLAY_IDENTIFIER LV_ERR_MEM_VLS_UP_PUC_2 ECU_ADDRESS 0x3fbb7d BIT_MASK 0x80 /end MEASUREMENT
/begin MEASUREMENT fmy_stat_vls_up_puc_2.err_info_stat.lv_ready "" UBYTE _CNV_S_2_RANGE______5_CM 1 100. 0. 1. DISPLAY_IDENTIFIER LV_READY_VLS_UP_PUC_2 ECU_ADDRESS 0x3fbb7d BIT_MASK 0x40 /end MEASUREMENT
/begin MEASUREMENT fmy_stat_vls_up_puc_2.err_info_stat.lv_end_diag "" UBYTE _CNV_S_2_RANGE______5_CM 1 100. 0. 1. DISPLAY_IDENTIFIER LV_END_DIAG_VLS_UP_PUC_2 ECU_ADDRESS 0x3fbb7d BIT_MASK 0x20 /end MEASUREMENT
/begin MEASUREMENT fmy_stat_vls_up_puc_2.err_info_stat.lv_cdn_diag "" UBYTE _CNV_S_2_RANGE______5_CM 1 100. 0. 1. DISPLAY_IDENTIFIER LV_CDN_DIAG_VLS_UP_PUC_2 ECU_ADDRESS 0x3fbb7d BIT_MASK 0x10 /end MEASUREMENT
/begin MEASUREMENT fmy_stat_vls_up_puc_2.err_info_stat.err_sym "" UBYTE _CNV_S_6_RANGE_ERR__192_CM 1 100. 0. 15. DISPLAY_IDENTIFIER ERR_SYM_VLS_UP_PUC_2 ECU_ADDRESS 0x3fbb7d BIT_MASK 0xF /end MEASUREMENT
/begin MEASUREMENT fmy_stat_vls_up_stk_1.ctr_abc "" UBYTE _CNV_A_R_LINEAR_____1_CM 1 100. 0. 255. DISPLAY_IDENTIFIER CTR_ABC_VLS_UP_STK_1 ECU_ADDRESS 0x3fbb83 FORMAT "%3.0" /end MEASUREMENT
/begin MEASUREMENT fmy_stat_vls_up_stk_1.ctr_end_diag "" UBYTE _CNV_A_R_LINEAR_____1_CM 1 100. 0. 255. DISPLAY_IDENTIFIER CTR_ABC_END_DIAG_VLS_UP_STK_1 ECU_ADDRESS 0x3fbb82 FORMAT "%3.0" /end MEASUREMENT
/begin MEASUREMENT fmy_stat_vls_up_stk_1.err_info_stat.lv_err_mem "" UBYTE _CNV_S_2_RANGE______5_CM 1 100. 0. 1. DISPLAY_IDENTIFIER LV_ERR_MEM_VLS_UP_STK_1 ECU_ADDRESS 0x3fbb81 BIT_MASK 0x80 /end MEASUREMENT
/begin MEASUREMENT fmy_stat_vls_up_stk_1.err_info_stat.lv_ready "" UBYTE _CNV_S_2_RANGE______5_CM 1 100. 0. 1. DISPLAY_IDENTIFIER LV_READY_VLS_UP_STK_1 ECU_ADDRESS 0x3fbb81 BIT_MASK 0x40 /end MEASUREMENT
/begin MEASUREMENT fmy_stat_vls_up_stk_1.err_info_stat.lv_end_diag "" UBYTE _CNV_S_2_RANGE______5_CM 1 100. 0. 1. DISPLAY_IDENTIFIER LV_END_DIAG_VLS_UP_STK_1 ECU_ADDRESS 0x3fbb81 BIT_MASK 0x20 /end MEASUREMENT
/begin MEASUREMENT fmy_stat_vls_up_stk_1.err_info_stat.lv_cdn_diag "" UBYTE _CNV_S_2_RANGE______5_CM 1 100. 0. 1. DISPLAY_IDENTIFIER LV_CDN_DIAG_VLS_UP_STK_1 ECU_ADDRESS 0x3fbb81 BIT_MASK 0x10 /end MEASUREMENT
/begin MEASUREMENT fmy_stat_vls_up_stk_1.err_info_stat.err_sym "" UBYTE _CNV_S_6_RANGE_ERR__192_CM 1 100. 0. 15. DISPLAY_IDENTIFIER ERR_SYM_VLS_UP_STK_1 ECU_ADDRESS 0x3fbb81 BIT_MASK 0xF /end MEASUREMENT
/begin MEASUREMENT fmy_stat_vls_up_stk_2.ctr_abc "" UBYTE _CNV_A_R_LINEAR_____1_CM 1 100. 0. 255. DISPLAY_IDENTIFIER CTR_ABC_VLS_UP_STK_2 ECU_ADDRESS 0x3fbb87 FORMAT "%3.0" /end MEASUREMENT
/begin MEASUREMENT fmy_stat_vls_up_stk_2.ctr_end_diag "" UBYTE _CNV_A_R_LINEAR_____1_CM 1 100. 0. 255. DISPLAY_IDENTIFIER CTR_ABC_END_DIAG_VLS_UP_STK_2 ECU_ADDRESS 0x3fbb86 FORMAT "%3.0" /end MEASUREMENT
/begin MEASUREMENT fmy_stat_vls_up_stk_2.err_info_stat.lv_err_mem "" UBYTE _CNV_S_2_RANGE______5_CM 1 100. 0. 1. DISPLAY_IDENTIFIER LV_ERR_MEM_VLS_UP_STK_2 ECU_ADDRESS 0x3fbb85 BIT_MASK 0x80 /end MEASUREMENT
/begin MEASUREMENT fmy_stat_vls_up_stk_2.err_info_stat.lv_ready "" UBYTE _CNV_S_2_RANGE______5_CM 1 100. 0. 1. DISPLAY_IDENTIFIER LV_READY_VLS_UP_STK_2 ECU_ADDRESS 0x3fbb85 BIT_MASK 0x40 /end MEASUREMENT
/begin MEASUREMENT fmy_stat_vls_up_stk_2.err_info_stat.lv_end_diag "" UBYTE _CNV_S_2_RANGE______5_CM 1 100. 0. 1. DISPLAY_IDENTIFIER LV_END_DIAG_VLS_UP_STK_2 ECU_ADDRESS 0x3fbb85 BIT_MASK 0x20 /end MEASUREMENT
/begin MEASUREMENT fmy_stat_vls_up_stk_2.err_info_stat.lv_cdn_diag "" UBYTE _CNV_S_2_RANGE______5_CM 1 100. 0. 1. DISPLAY_IDENTIFIER LV_CDN_DIAG_VLS_UP_STK_2 ECU_ADDRESS 0x3fbb85 BIT_MASK 0x10 /end MEASUREMENT
/begin MEASUREMENT fmy_stat_vls_up_stk_2.err_info_stat.err_sym "" UBYTE _CNV_S_6_RANGE_ERR__192_CM 1 100. 0. 15. DISPLAY_IDENTIFIER ERR_SYM_VLS_UP_STK_2 ECU_ADDRESS 0x3fbb85 BIT_MASK 0xF /end MEASUREMENT
/begin MEASUREMENT fmy_stat_lam_dly_1.ctr_abc "" UBYTE _CNV_A_R_LINEAR_____1_CM 1 100. 0. 255. DISPLAY_IDENTIFIER CTR_ABC_LAM_DLY_1 ECU_ADDRESS 0x3fbb8b FORMAT "%3.0" /end MEASUREMENT
/begin MEASUREMENT fmy_stat_lam_dly_1.ctr_end_diag "" UBYTE _CNV_A_R_LINEAR_____1_CM 1 100. 0. 255. DISPLAY_IDENTIFIER CTR_ABC_END_DIAG_LAM_DLY_1 ECU_ADDRESS 0x3fbb8a FORMAT "%3.0" /end MEASUREMENT
/begin MEASUREMENT fmy_stat_lam_dly_1.err_info_stat.lv_err_mem "" UBYTE _CNV_S_2_RANGE______5_CM 1 100. 0. 1. DISPLAY_IDENTIFIER LV_ERR_MEM_LAM_DLY_1 ECU_ADDRESS 0x3fbb89 BIT_MASK 0x80 /end MEASUREMENT
/begin MEASUREMENT fmy_stat_lam_dly_1.err_info_stat.lv_ready "" UBYTE _CNV_S_2_RANGE______5_CM 1 100. 0. 1. DISPLAY_IDENTIFIER LV_READY_LAM_DLY_1 ECU_ADDRESS 0x3fbb89 BIT_MASK 0x40 /end MEASUREMENT
/begin MEASUREMENT fmy_stat_lam_dly_1.err_info_stat.lv_end_diag "" UBYTE _CNV_S_2_RANGE______5_CM 1 100. 0. 1. DISPLAY_IDENTIFIER LV_END_DIAG_LAM_DLY_1 ECU_ADDRESS 0x3fbb89 BIT_MASK 0x20 /end MEASUREMENT
/begin MEASUREMENT fmy_stat_lam_dly_1.err_info_stat.lv_cdn_diag "" UBYTE _CNV_S_2_RANGE______5_CM 1 100. 0. 1. DISPLAY_IDENTIFIER LV_CDN_DIAG_LAM_DLY_1 ECU_ADDRESS 0x3fbb89 BIT_MASK 0x10 /end MEASUREMENT
/begin MEASUREMENT fmy_stat_lam_dly_1.err_info_stat.err_sym "" UBYTE _CNV_S_6_RANGE_ERR__192_CM 1 100. 0. 15. DISPLAY_IDENTIFIER ERR_SYM_LAM_DLY_1 ECU_ADDRESS 0x3fbb89 BIT_MASK 0xF /end MEASUREMENT
/begin MEASUREMENT fmy_stat_lam_dly_2.ctr_abc "" UBYTE _CNV_A_R_LINEAR_____1_CM 1 100. 0. 255. DISPLAY_IDENTIFIER CTR_ABC_LAM_DLY_2 ECU_ADDRESS 0x3fbb8f FORMAT "%3.0" /end MEASUREMENT
/begin MEASUREMENT fmy_stat_lam_dly_2.ctr_end_diag "" UBYTE _CNV_A_R_LINEAR_____1_CM 1 100. 0. 255. DISPLAY_IDENTIFIER CTR_ABC_END_DIAG_LAM_DLY_2 ECU_ADDRESS 0x3fbb8e FORMAT "%3.0" /end MEASUREMENT
/begin MEASUREMENT fmy_stat_lam_dly_2.err_info_stat.lv_err_mem "" UBYTE _CNV_S_2_RANGE______5_CM 1 100. 0. 1. DISPLAY_IDENTIFIER LV_ERR_MEM_LAM_DLY_2 ECU_ADDRESS 0x3fbb8d BIT_MASK 0x80 /end MEASUREMENT
/begin MEASUREMENT fmy_stat_lam_dly_2.err_info_stat.lv_ready "" UBYTE _CNV_S_2_RANGE______5_CM 1 100. 0. 1. DISPLAY_IDENTIFIER LV_READY_LAM_DLY_2 ECU_ADDRESS 0x3fbb8d BIT_MASK 0x40 /end MEASUREMENT
/begin MEASUREMENT fmy_stat_lam_dly_2.err_info_stat.lv_end_diag "" UBYTE _CNV_S_2_RANGE______5_CM 1 100. 0. 1. DISPLAY_IDENTIFIER LV_END_DIAG_LAM_DLY_2 ECU_ADDRESS 0x3fbb8d BIT_MASK 0x20 /end MEASUREMENT
/begin MEASUREMENT fmy_stat_lam_dly_2.err_info_stat.lv_cdn_diag "" UBYTE _CNV_S_2_RANGE______5_CM 1 100. 0. 1. DISPLAY_IDENTIFIER LV_CDN_DIAG_LAM_DLY_2 ECU_ADDRESS 0x3fbb8d BIT_MASK 0x10 /end MEASUREMENT
/begin MEASUREMENT fmy_stat_lam_dly_2.err_info_stat.err_sym "" UBYTE _CNV_S_6_RANGE_ERR__192_CM 1 100. 0. 15. DISPLAY_IDENTIFIER ERR_SYM_LAM_DLY_2 ECU_ADDRESS 0x3fbb8d BIT_MASK 0xF /end MEASUREMENT
/begin MEASUREMENT fmy_stat_ls_up_swt_1.ctr_abc "" UBYTE _CNV_A_R_LINEAR_____1_CM 1 100. 0. 255. DISPLAY_IDENTIFIER CTR_ABC_LS_UP_SWT_1 ECU_ADDRESS 0x3fbb93 FORMAT "%3.0" /end MEASUREMENT
/begin MEASUREMENT fmy_stat_ls_up_swt_1.ctr_end_diag "" UBYTE _CNV_A_R_LINEAR_____1_CM 1 100. 0. 255. DISPLAY_IDENTIFIER CTR_ABC_END_DIAG_LS_UP_SWT_1 ECU_ADDRESS 0x3fbb92 FORMAT "%3.0" /end MEASUREMENT
/begin MEASUREMENT fmy_stat_ls_up_swt_1.err_info_stat.lv_err_mem "" UBYTE _CNV_S_2_RANGE______5_CM 1 100. 0. 1. DISPLAY_IDENTIFIER LV_ERR_MEM_LS_UP_SWT_1 ECU_ADDRESS 0x3fbb91 BIT_MASK 0x80 /end MEASUREMENT
/begin MEASUREMENT fmy_stat_ls_up_swt_1.err_info_stat.lv_ready "" UBYTE _CNV_S_2_RANGE______5_CM 1 100. 0. 1. DISPLAY_IDENTIFIER LV_READY_LS_UP_SWT_1 ECU_ADDRESS 0x3fbb91 BIT_MASK 0x40 /end MEASUREMENT
/begin MEASUREMENT fmy_stat_ls_up_swt_1.err_info_stat.lv_end_diag "" UBYTE _CNV_S_2_RANGE______5_CM 1 100. 0. 1. DISPLAY_IDENTIFIER LV_END_DIAG_LS_UP_SWT_1 ECU_ADDRESS 0x3fbb91 BIT_MASK 0x20 /end MEASUREMENT
/begin MEASUREMENT fmy_stat_ls_up_swt_1.err_info_stat.lv_cdn_diag "" UBYTE _CNV_S_2_RANGE______5_CM 1 100. 0. 1. DISPLAY_IDENTIFIER LV_CDN_DIAG_LS_UP_SWT_1 ECU_ADDRESS 0x3fbb91 BIT_MASK 0x10 /end MEASUREMENT
/begin MEASUREMENT fmy_stat_ls_up_swt_1.err_info_stat.err_sym "" UBYTE _CNV_S_6_RANGE_ERR__192_CM 1 100. 0. 15. DISPLAY_IDENTIFIER ERR_SYM_LS_UP_SWT_1 ECU_ADDRESS 0x3fbb91 BIT_MASK 0xF /end MEASUREMENT
/begin MEASUREMENT fmy_stat_ls_up_swt_2.ctr_abc "" UBYTE _CNV_A_R_LINEAR_____1_CM 1 100. 0. 255. DISPLAY_IDENTIFIER CTR_ABC_LS_UP_SWT_2 ECU_ADDRESS 0x3fbb97 FORMAT "%3.0" /end MEASUREMENT
/begin MEASUREMENT fmy_stat_ls_up_swt_2.ctr_end_diag "" UBYTE _CNV_A_R_LINEAR_____1_CM 1 100. 0. 255. DISPLAY_IDENTIFIER CTR_ABC_END_DIAG_LS_UP_SWT_2 ECU_ADDRESS 0x3fbb96 FORMAT "%3.0" /end MEASUREMENT
/begin MEASUREMENT fmy_stat_ls_up_swt_2.err_info_stat.lv_err_mem "" UBYTE _CNV_S_2_RANGE______5_CM 1 100. 0. 1. DISPLAY_IDENTIFIER LV_ERR_MEM_LS_UP_SWT_2 ECU_ADDRESS 0x3fbb95 BIT_MASK 0x80 /end MEASUREMENT
/begin MEASUREMENT fmy_stat_ls_up_swt_2.err_info_stat.lv_ready "" UBYTE _CNV_S_2_RANGE______5_CM 1 100. 0. 1. DISPLAY_IDENTIFIER LV_READY_LS_UP_SWT_2 ECU_ADDRESS 0x3fbb95 BIT_MASK 0x40 /end MEASUREMENT
/begin MEASUREMENT fmy_stat_ls_up_swt_2.err_info_stat.lv_end_diag "" UBYTE _CNV_S_2_RANGE______5_CM 1 100. 0. 1. DISPLAY_IDENTIFIER LV_END_DIAG_LS_UP_SWT_2 ECU_ADDRESS 0x3fbb95 BIT_MASK 0x20 /end MEASUREMENT
/begin MEASUREMENT fmy_stat_ls_up_swt_2.err_info_stat.lv_cdn_diag "" UBYTE _CNV_S_2_RANGE______5_CM 1 100. 0. 1. DISPLAY_IDENTIFIER LV_CDN_DIAG_LS_UP_SWT_2 ECU_ADDRESS 0x3fbb95 BIT_MASK 0x10 /end MEASUREMENT
/begin MEASUREMENT fmy_stat_ls_up_swt_2.err_info_stat.err_sym "" UBYTE _CNV_S_6_RANGE_ERR__192_CM 1 100. 0. 15. DISPLAY_IDENTIFIER ERR_SYM_LS_UP_SWT_2 ECU_ADDRESS 0x3fbb95 BIT_MASK 0xF /end MEASUREMENT
/begin MEASUREMENT fmy_stat_ls_up_frq_1.ctr_abc "" UBYTE _CNV_A_R_LINEAR_____1_CM 1 100. 0. 255. DISPLAY_IDENTIFIER CTR_ABC_LS_UP_FRQ_1 ECU_ADDRESS 0x3fbb9b FORMAT "%3.0" /end MEASUREMENT
/begin MEASUREMENT fmy_stat_ls_up_frq_1.ctr_end_diag "" UBYTE _CNV_A_R_LINEAR_____1_CM 1 100. 0. 255. DISPLAY_IDENTIFIER CTR_ABC_END_DIAG_LS_UP_FRQ_1 ECU_ADDRESS 0x3fbb9a FORMAT "%3.0" /end MEASUREMENT
/begin MEASUREMENT fmy_stat_ls_up_frq_1.err_info_stat.lv_err_mem "" UBYTE _CNV_S_2_RANGE______5_CM 1 100. 0. 1. DISPLAY_IDENTIFIER LV_ERR_MEM_LS_UP_FRQ_1 ECU_ADDRESS 0x3fbb99 BIT_MASK 0x80 /end MEASUREMENT
/begin MEASUREMENT fmy_stat_ls_up_frq_1.err_info_stat.lv_ready "" UBYTE _CNV_S_2_RANGE______5_CM 1 100. 0. 1. DISPLAY_IDENTIFIER LV_READY_LS_UP_FRQ_1 ECU_ADDRESS 0x3fbb99 BIT_MASK 0x40 /end MEASUREMENT
/begin MEASUREMENT fmy_stat_ls_up_frq_1.err_info_stat.lv_end_diag "" UBYTE _CNV_S_2_RANGE______5_CM 1 100. 0. 1. DISPLAY_IDENTIFIER LV_END_DIAG_LS_UP_FRQ_1 ECU_ADDRESS 0x3fbb99 BIT_MASK 0x20 /end MEASUREMENT
/begin MEASUREMENT fmy_stat_ls_up_frq_1.err_info_stat.lv_cdn_diag "" UBYTE _CNV_S_2_RANGE______5_CM 1 100. 0. 1. DISPLAY_IDENTIFIER LV_CDN_DIAG_LS_UP_FRQ_1 ECU_ADDRESS 0x3fbb99 BIT_MASK 0x10 /end MEASUREMENT
/begin MEASUREMENT fmy_stat_ls_up_frq_1.err_info_stat.err_sym "" UBYTE _CNV_S_6_RANGE_ERR__192_CM 1 100. 0. 15. DISPLAY_IDENTIFIER ERR_SYM_LS_UP_FRQ_1 ECU_ADDRESS 0x3fbb99 BIT_MASK 0xF /end MEASUREMENT
/begin MEASUREMENT fmy_stat_ls_up_frq_2.ctr_abc "" UBYTE _CNV_A_R_LINEAR_____1_CM 1 100. 0. 255. DISPLAY_IDENTIFIER CTR_ABC_LS_UP_FRQ_2 ECU_ADDRESS 0x3fbb9f FORMAT "%3.0" /end MEASUREMENT
/begin MEASUREMENT fmy_stat_ls_up_frq_2.ctr_end_diag "" UBYTE _CNV_A_R_LINEAR_____1_CM 1 100. 0. 255. DISPLAY_IDENTIFIER CTR_ABC_END_DIAG_LS_UP_FRQ_2 ECU_ADDRESS 0x3fbb9e FORMAT "%3.0" /end MEASUREMENT
/begin MEASUREMENT fmy_stat_ls_up_frq_2.err_info_stat.lv_err_mem "" UBYTE _CNV_S_2_RANGE______5_CM 1 100. 0. 1. DISPLAY_IDENTIFIER LV_ERR_MEM_LS_UP_FRQ_2 ECU_ADDRESS 0x3fbb9d BIT_MASK 0x80 /end MEASUREMENT
/begin MEASUREMENT fmy_stat_ls_up_frq_2.err_info_stat.lv_ready "" UBYTE _CNV_S_2_RANGE______5_CM 1 100. 0. 1. DISPLAY_IDENTIFIER LV_READY_LS_UP_FRQ_2 ECU_ADDRESS 0x3fbb9d BIT_MASK 0x40 /end MEASUREMENT
/begin MEASUREMENT fmy_stat_ls_up_frq_2.err_info_stat.lv_end_diag "" UBYTE _CNV_S_2_RANGE______5_CM 1 100. 0. 1. DISPLAY_IDENTIFIER LV_END_DIAG_LS_UP_FRQ_2 ECU_ADDRESS 0x3fbb9d BIT_MASK 0x20 /end MEASUREMENT
/begin MEASUREMENT fmy_stat_ls_up_frq_2.err_info_stat.lv_cdn_diag "" UBYTE _CNV_S_2_RANGE______5_CM 1 100. 0. 1. DISPLAY_IDENTIFIER LV_CDN_DIAG_LS_UP_FRQ_2 ECU_ADDRESS 0x3fbb9d BIT_MASK 0x10 /end MEASUREMENT
/begin MEASUREMENT fmy_stat_ls_up_frq_2.err_info_stat.err_sym "" UBYTE _CNV_S_6_RANGE_ERR__192_CM 1 100. 0. 15. DISPLAY_IDENTIFIER ERR_SYM_LS_UP_FRQ_2 ECU_ADDRESS 0x3fbb9d BIT_MASK 0xF /end MEASUREMENT
/begin CHARACTERISTIC c_abc_max_td_igc_cut "Maximum value of anti-bounce counter for the ignition system diagnosis to switch off the coil" VALUE 0x005bc _REC_VAL_20_u1 254. _CNV_A_R_LINEAR_____1_CM 1. 255. DISPLAY_IDENTIFIER C_ABC_MAX_TD_IGC_CUT FORMAT "%3.0" /end CHARACTERISTIC
/begin CHARACTERISTIC c_abc_inc_v_dur_igc "Debounce counter increment" VALUE 0x00570 _REC_VAL_20_u1 255. _CNV_A_R_LINEAR_____1_CM 0. 255. DISPLAY_IDENTIFIER C_ABC_INC_V_DUR_IGC FORMAT "%3.0" /end CHARACTERISTIC
/begin CHARACTERISTIC c_abc_max_v_dur_igc "Debounce counter maximum" VALUE 0x005d5 _REC_VAL_20_u1 254. _CNV_A_R_LINEAR_____1_CM 1. 255. DISPLAY_IDENTIFIER C_ABC_MAX_V_DUR_IGC FORMAT "%3.0" /end CHARACTERISTIC
/begin CHARACTERISTIC c_abc_inc_td_igc_cut "Anti-bounce counter increment for the ignition system diagnosis 1/720°CRK" VALUE 0x00553 _REC_VAL_20_u1 255. _CNV_A_R_LINEAR_____1_CM 0. 255. DISPLAY_IDENTIFIER C_ABC_INC_TD_IGC_CUT FORMAT "%3.0" /end CHARACTERISTIC
/begin CHARACTERISTIC c_abc_max_ref_ivvt "Debounce counter maximum value - VANOS diagnosis magnetic valves" VALUE 0x005b3 _REC_VAL_20_u1 254. _CNV_A_R_LINEAR_____1_CM 1. 255. DISPLAY_IDENTIFIER C_ABC_MAX_REF_IVVT FORMAT "%3.0" /end CHARACTERISTIC
/begin CHARACTERISTIC c_abc_inc_ref_ivvt "Debounce counter increment - VANOS diagnosis magnetic valve CAM_IN" VALUE 0x0054a _REC_VAL_20_u1 255. _CNV_A_R_LINEAR_____1_CM 0. 255. DISPLAY_IDENTIFIER C_ABC_INC_REF_IVVT FORMAT "%3.0" /end CHARACTERISTIC
/begin CHARACTERISTIC c_abc_inc_knks_diag "Debounce counter increment - knock sensor diagnosis" VALUE 0x0053b _REC_VAL_20_u1 255. _CNV_A_R_LINEAR_____1_CM 0. 255. DISPLAY_IDENTIFIER C_ABC_INC_KNKS_DIAG FORMAT "%3.0" /end CHARACTERISTIC
/begin CHARACTERISTIC c_abc_max_knks_diag "Debounce counter maximum value - knock sensor diagnosis" VALUE 0x005a5 _REC_VAL_20_u1 254. _CNV_A_R_LINEAR_____1_CM 1. 255. DISPLAY_IDENTIFIER C_ABC_MAX_KNKS_DIAG FORMAT "%3.0" /end CHARACTERISTIC
/begin CHARACTERISTIC c_abc_max_vls_down_max "Debounce counter maximum for short to plus electrical check" VALUE 0x005d8 _REC_VAL_20_u1 254. _CNV_A_R_LINEAR_____1_CM 1. 255. DISPLAY_IDENTIFIER C_ABC_MAX_VLS_DOWN_MAX FORMAT "%3.0" /end CHARACTERISTIC
/begin CHARACTERISTIC c_abc_inc_vls_down_max "Debounce counter increment for short to plus electrical check" VALUE 0x00573 _REC_VAL_20_u1 255. _CNV_A_R_LINEAR_____1_CM 0. 255. DISPLAY_IDENTIFIER C_ABC_INC_VLS_DOWN_MAX FORMAT "%3.0" /end CHARACTERISTIC
/begin CHARACTERISTIC c_abc_inc_vls_down_min_cold "Debounce counter increment for short to ground electrical check" VALUE 0x00574 _REC_VAL_20_u1 255. _CNV_A_R_LINEAR_____1_CM 0. 255. DISPLAY_IDENTIFIER C_ABC_INC_VLS_DOWN_MIN_COLD FORMAT "%3.0" /end CHARACTERISTIC
/begin CHARACTERISTIC c_abc_max_vls_down_min_cold "Debounce counter maximum for short to ground electrical check" VALUE 0x005d9 _REC_VAL_20_u1 254. _CNV_A_R_LINEAR_____1_CM 1. 255. DISPLAY_IDENTIFIER C_ABC_MAX_VLS_DOWN_MIN_COLD FORMAT "%3.0" /end CHARACTERISTIC
/begin CHARACTERISTIC c_abc_max_vls_up_max "Debounce counter maximum for electrical check short to plus" VALUE 0x005da _REC_VAL_20_u1 254. _CNV_A_R_LINEAR_____1_CM 1. 255. DISPLAY_IDENTIFIER C_ABC_MAX_VLS_UP_MAX FORMAT "%3.0" /end CHARACTERISTIC
/begin CHARACTERISTIC c_abc_max_vls_up_puc "Debounce counter maximum for PUC plausibility" VALUE 0x005dc _REC_VAL_20_u1 254. _CNV_A_R_LINEAR_____1_CM 1. 255. DISPLAY_IDENTIFIER C_ABC_MAX_VLS_UP_PUC FORMAT "%3.0" /end CHARACTERISTIC
/begin CHARACTERISTIC c_abc_inc_vls_up_max "Debounce counter increment for electrical check short to plus" VALUE 0x00575 _REC_VAL_20_u1 255. _CNV_A_R_LINEAR_____1_CM 0. 255. DISPLAY_IDENTIFIER C_ABC_INC_VLS_UP_MAX FORMAT "%3.0" /end CHARACTERISTIC
/begin CHARACTERISTIC c_abc_inc_vls_up_puc "Debounce counter increment for PUC plausibility" VALUE 0x00577 _REC_VAL_20_u1 255. _CNV_A_R_LINEAR_____1_CM 0. 255. DISPLAY_IDENTIFIER C_ABC_INC_VLS_UP_PUC FORMAT "%3.0" /end CHARACTERISTIC
/begin CHARACTERISTIC c_abc_inc_vls_up_stk "Debounce counter increment for voltage excursion plausibility" VALUE 0x00578 _REC_VAL_20_u1 255. _CNV_A_R_LINEAR_____1_CM 0. 255. DISPLAY_IDENTIFIER C_ABC_INC_VLS_UP_STK FORMAT "%3.0" /end CHARACTERISTIC
/begin CHARACTERISTIC c_abc_max_vls_up_stk "Debounce counter maximum for voltage excursion plausibility" VALUE 0x005dd _REC_VAL_20_u1 254. _CNV_A_R_LINEAR_____1_CM 1. 255. DISPLAY_IDENTIFIER C_ABC_MAX_VLS_UP_STK FORMAT "%3.0" /end CHARACTERISTIC
/begin CHARACTERISTIC c_abc_inc_vls_up_min_cold "Debounce counter increment for electrical check short to ground" VALUE 0x00576 _REC_VAL_20_u1 255. _CNV_A_R_LINEAR_____1_CM 0. 255. DISPLAY_IDENTIFIER C_ABC_INC_VLS_UP_MIN_COLD FORMAT "%3.0" /end CHARACTERISTIC
/begin CHARACTERISTIC c_abc_max_vls_up_min_cold "Debounce counter maximum for electrical check short to ground" VALUE 0x005db _REC_VAL_20_u1 254. _CNV_A_R_LINEAR_____1_CM 1. 255. DISPLAY_IDENTIFIER C_ABC_MAX_VLS_UP_MIN_COLD FORMAT "%3.0" /end CHARACTERISTIC
/begin CHARACTERISTIC c_abc_inc_maf "Debounce counter increment, mass air flow meter diagnosis" VALUE 0x0053f _REC_VAL_20_u1 255. _CNV_A_R_LINEAR_____1_CM 0. 255. DISPLAY_IDENTIFIER C_ABC_INC_MAF FORMAT "%3.0" /end CHARACTERISTIC
/begin CHARACTERISTIC c_abc_max_maf "Debounce counter maximum value, mass air flow meter diagnosis" VALUE 0x005a9 _REC_VAL_20_u1 254. _CNV_A_R_LINEAR_____1_CM 1. 255. DISPLAY_IDENTIFIER C_ABC_MAX_MAF FORMAT "%3.0" /end CHARACTERISTIC
/begin CHARACTERISTIC c_abc_inc_mis_low_fuel "Increment value of the anti - bounce counter for Bench mode" VALUE 0x00540 _REC_VAL_20_u1 255. _CNV_A_R_LINEAR_____1_CM 0. 255. DISPLAY_IDENTIFIER C_ABC_INC_MIS_LOW_FUEL FORMAT "%3.0" /end CHARACTERISTIC
/begin CHARACTERISTIC c_abc_max_msw_2 "Debounce counter maximum value - MSW diagnosis" VALUE 0x005aa _REC_VAL_20_u1 254. _CNV_A_R_LINEAR_____1_CM 1. 255. DISPLAY_IDENTIFIER C_ABC_MAX_MSW_2 FORMAT "%3.0" /end CHARACTERISTIC
/begin CHARACTERISTIC c_abc_inc_msw_2 "Debounce counter increment - MSW diagnosis" VALUE 0x00541 _REC_VAL_20_u1 255. _CNV_A_R_LINEAR_____1_CM 0. 255. DISPLAY_IDENTIFIER C_ABC_INC_MSW_2 FORMAT "%3.0" /end CHARACTERISTIC
/begin CHARACTERISTIC c_abc_inc_msw_tog "Debounce counter increment - Toggle bit monitoring" VALUE 0x00543 _REC_VAL_20_u1 255. _CNV_A_R_LINEAR_____1_CM 0. 255. DISPLAY_IDENTIFIER C_ABC_INC_MSW_TOG FORMAT "%3.0" /end CHARACTERISTIC
/begin CHARACTERISTIC c_abc_max_msw_tog "Debounce counter maximum value - Toggle bit monitoring" VALUE 0x005ac _REC_VAL_20_u1 254. _CNV_A_R_LINEAR_____1_CM 1. 255. DISPLAY_IDENTIFIER C_ABC_MAX_MSW_TOG FORMAT "%3.0" /end CHARACTERISTIC
/begin CHARACTERISTIC c_abc_inc_msw_3 "Debounce counter increment - MSW diagnosis" VALUE 0x00542 _REC_VAL_20_u1 255. _CNV_A_R_LINEAR_____1_CM 0. 255. DISPLAY_IDENTIFIER C_ABC_INC_MSW_3 FORMAT "%3.0" /end CHARACTERISTIC
/begin CHARACTERISTIC c_abc_max_msw_3 "Debounce counter maximum value - MSW diagnosis" VALUE 0x005ab _REC_VAL_20_u1 254. _CNV_A_R_LINEAR_____1_CM 1. 255. DISPLAY_IDENTIFIER C_ABC_MAX_MSW_3 FORMAT "%3.0" /end CHARACTERISTIC
/begin CHARACTERISTIC c_abc_inc_mtc_dr "Debounce counter increment,MTC driver diagnosis" VALUE 0x00544 _REC_VAL_20_u1 255. _CNV_A_R_LINEAR_____1_CM 0. 255. DISPLAY_IDENTIFIER C_ABC_INC_MTC_DR FORMAT "%3.0" /end CHARACTERISTIC
/begin CHARACTERISTIC c_abc_max_mtc_dr "Debounce counter maximum value, MTC driver diagnosis" VALUE 0x005ad _REC_VAL_20_u1 254. _CNV_A_R_LINEAR_____1_CM 1. 255. DISPLAY_IDENTIFIER C_ABC_MAX_MTC_DR FORMAT "%3.0" /end CHARACTERISTIC
/begin CHARACTERISTIC c_abc_max_lam_dly "Maximum value of the anti - bounce counter" VALUE 0x005a6 _REC_VAL_20_u1 254. _CNV_A_R_LINEAR_____1_CM 1. 255. DISPLAY_IDENTIFIER C_ABC_MAX_LAM_DLY FORMAT "%3.0" /end CHARACTERISTIC
/begin CHARACTERISTIC c_abc_inc_lam_dly "Anti - bounce counter increment" VALUE 0x0053c _REC_VAL_20_u1 255. _CNV_A_R_LINEAR_____1_CM 0. 255. DISPLAY_IDENTIFIER C_ABC_INC_LAM_DLY FORMAT "%3.0" /end CHARACTERISTIC
/begin CHARACTERISTIC c_abc_inc_load_tps_plaus "ABC increment value" VALUE 0x0053d _REC_VAL_20_u1 255. _CNV_A_R_LINEAR_____1_CM 0. 255. DISPLAY_IDENTIFIER C_ABC_INC_LOAD_TPS_PLAUS FORMAT "%3.0" /end CHARACTERISTIC
/begin CHARACTERISTIC c_abc_max_load_tps_plaus "ABC Maximum value" VALUE 0x005a7 _REC_VAL_20_u1 254. _CNV_A_R_LINEAR_____1_CM 1. 255. DISPLAY_IDENTIFIER C_ABC_MAX_LOAD_TPS_PLAUS FORMAT "%3.0" /end CHARACTERISTIC
/begin CHARACTERISTIC c_abc_inc_poil_swi "Anti bounce increment value, POIL_SWI" VALUE 0x00545 _REC_VAL_20_u1 255. _CNV_A_R_LINEAR_____1_CM 0. 255. DISPLAY_IDENTIFIER C_ABC_INC_POIL_SWI FORMAT "%3.0" /end CHARACTERISTIC
/begin CHARACTERISTIC c_abc_max_poil_swi "Anti-bounce max. value, POIL_SWI" VALUE 0x005ae _REC_VAL_20_u1 254. _CNV_A_R_LINEAR_____1_CM 1. 255. DISPLAY_IDENTIFIER C_ABC_MAX_POIL_SWI FORMAT "%3.0" /end CHARACTERISTIC
/begin CHARACTERISTIC c_abc_inc_pvs_ratio "Increment debounce counter" VALUE 0x00549 _REC_VAL_20_u1 255. _CNV_A_R_LINEAR_____1_CM 0. 255. DISPLAY_IDENTIFIER C_ABC_INC_PVS_RATIO FORMAT "%3.0" /end CHARACTERISTIC
/begin CHARACTERISTIC c_abc_max_pvs_ratio "Maximum value debounce counter " VALUE 0x005b2 _REC_VAL_20_u1 254. _CNV_A_R_LINEAR_____1_CM 1. 255. DISPLAY_IDENTIFIER C_ABC_MAX_PVS_RATIO FORMAT "%3.0" /end CHARACTERISTIC
/begin CHARACTERISTIC c_abc_max_pvs_bls_not_plaus "" VALUE 0x005b1 _REC_VAL_20_u1 254. _CNV_A_R_LINEAR_____1_CM 1. 255. DISPLAY_IDENTIFIER C_ABC_MAX_PVS_BLS_NOT_PLAUS FORMAT "%3.0" /end CHARACTERISTIC
/begin CHARACTERISTIC c_abc_inc_pvs_bls_not_plaus "" VALUE 0x00548 _REC_VAL_20_u1 255. _CNV_A_R_LINEAR_____1_CM 0. 255. DISPLAY_IDENTIFIER C_ABC_INC_PVS_BLS_NOT_PLAUS FORMAT "%3.0" /end CHARACTERISTIC
/begin CHARACTERISTIC c_abc_inc_v_ref_1 "Anti bounce increment value for V_REF_1" VALUE 0x00571 _REC_VAL_20_u1 255. _CNV_A_R_LINEAR_____1_CM 0. 255. DISPLAY_IDENTIFIER C_ABC_INC_V_REF_1 FORMAT "%3.0" /end CHARACTERISTIC
/begin CHARACTERISTIC c_abc_inc_v_ref_2 "Anti bounce increment value for V_REF_2" VALUE 0x00572 _REC_VAL_20_u1 255. _CNV_A_R_LINEAR_____1_CM 0. 255. DISPLAY_IDENTIFIER C_ABC_INC_V_REF_2 FORMAT "%3.0" /end CHARACTERISTIC
/begin CHARACTERISTIC c_abc_max_v_ref_1 "Anti-bounce maximum value (x=1,2)" VALUE 0x005d6 _REC_VAL_20_u1 254. _CNV_A_R_LINEAR_____1_CM 1. 255. DISPLAY_IDENTIFIER C_ABC_MAX_V_REF_1 FORMAT "%3.0" /end CHARACTERISTIC
/begin CHARACTERISTIC c_abc_max_v_ref_2 "Anti-bounce maximum value (x=1,2)" VALUE 0x005d7 _REC_VAL_20_u1 254. _CNV_A_R_LINEAR_____1_CM 1. 255. DISPLAY_IDENTIFIER C_ABC_MAX_V_REF_2 FORMAT "%3.0" /end CHARACTERISTIC
/begin CHARACTERISTIC c_abc_inc_pvs_1 "Anti-bounce increment value, PVS 1" VALUE 0x00546 _REC_VAL_20_u1 255. _CNV_A_R_LINEAR_____1_CM 0. 255. DISPLAY_IDENTIFIER C_ABC_INC_PVS_1 FORMAT "%3.0" /end CHARACTERISTIC
/begin CHARACTERISTIC c_abc_inc_pvs_2 "Anti-bounce increment value, PVS 2" VALUE 0x00547 _REC_VAL_20_u1 255. _CNV_A_R_LINEAR_____1_CM 0. 255. DISPLAY_IDENTIFIER C_ABC_INC_PVS_2 FORMAT "%3.0" /end CHARACTERISTIC
/begin CHARACTERISTIC c_abc_max_pvs_1 "Anti-bounce maximum value, PVS 1" VALUE 0x005af _REC_VAL_20_u1 254. _CNV_A_R_LINEAR_____1_CM 1. 255. DISPLAY_IDENTIFIER C_ABC_MAX_PVS_1 FORMAT "%3.0" /end CHARACTERISTIC
/begin CHARACTERISTIC c_abc_max_pvs_2 "Anti-bounce maximum value, PVS 2" VALUE 0x005b0 _REC_VAL_20_u1 254. _CNV_A_R_LINEAR_____1_CM 1. 255. DISPLAY_IDENTIFIER C_ABC_MAX_PVS_2 FORMAT "%3.0" /end CHARACTERISTIC
/begin CHARACTERISTIC c_abc_inc_rly_main "Debounce counter increment - RLY_MAIN diagnosis" VALUE 0x0054c _REC_VAL_20_u1 255. _CNV_A_R_LINEAR_____1_CM 0. 255. DISPLAY_IDENTIFIER C_ABC_INC_RLY_MAIN FORMAT "%3.0" /end CHARACTERISTIC
/begin CHARACTERISTIC c_abc_max_rly_main "Debounce counter maximum value - RLY_MAIN diagnosis" VALUE 0x005b5 _REC_VAL_20_u1 254. _CNV_A_R_LINEAR_____1_CM 1. 255. DISPLAY_IDENTIFIER C_ABC_MAX_RLY_MAIN FORMAT "%3.0" /end CHARACTERISTIC
/begin CHARACTERISTIC c_abc_inc_sof_req "Anti - bounce counter increment" VALUE 0x0054d _REC_VAL_20_u1 255. _CNV_A_R_LINEAR_____1_CM 0. 255. DISPLAY_IDENTIFIER C_ABC_INC_SOF_REQ FORMAT "%3.0" /end CHARACTERISTIC
/begin CHARACTERISTIC c_abc_max_sof_req "Debounce counter maximum value" VALUE 0x005b6 _REC_VAL_20_u1 254. _CNV_A_R_LINEAR_____1_CM 1. 255. DISPLAY_IDENTIFIER C_ABC_MAX_SOF_REQ FORMAT "%3.0" /end CHARACTERISTIC
/begin CHARACTERISTIC c_abc_inc_tco_grd_diag "Debounce counter increment - TCO Signal gradient diagnosis" VALUE 0x00552 _REC_VAL_20_u1 255. _CNV_A_R_LINEAR_____1_CM 0. 255. DISPLAY_IDENTIFIER C_ABC_INC_TCO_GRD_DIAG FORMAT "%3.0" /end CHARACTERISTIC
/begin CHARACTERISTIC c_abc_max_tco_grd_diag "Debounce counter maximum value - TCO Signal gradient diagnosis" VALUE 0x005bb _REC_VAL_20_u1 254. _CNV_A_R_LINEAR_____1_CM 1. 255. DISPLAY_IDENTIFIER C_ABC_MAX_TCO_GRD_DIAG FORMAT "%3.0" /end CHARACTERISTIC
/begin CHARACTERISTIC c_abc_max_tco_el "Debounce counter maximum value - TCO diagnosis" VALUE 0x005b9 _REC_VAL_20_u1 254. _CNV_A_R_LINEAR_____1_CM 1. 255. DISPLAY_IDENTIFIER C_ABC_MAX_TCO_EL FORMAT "%3.0" /end CHARACTERISTIC
/begin CHARACTERISTIC c_abc_inc_tco_el "Debounce counter increment- TCO diagnosis" VALUE 0x00550 _REC_VAL_20_u1 255. _CNV_A_R_LINEAR_____1_CM 0. 255. DISPLAY_IDENTIFIER C_ABC_INC_TCO_EL FORMAT "%3.0" /end CHARACTERISTIC
/begin CHARACTERISTIC c_abc_inc_tco_ex "Debounce counter increment - TCO_EX diagnosis" VALUE 0x00551 _REC_VAL_20_u1 255. _CNV_A_R_LINEAR_____1_CM 0. 255. DISPLAY_IDENTIFIER C_ABC_INC_TCO_EX FORMAT "%3.0" /end CHARACTERISTIC
/begin CHARACTERISTIC c_abc_max_tco_ex "Debounce counter maximum value- TCO_EX diagnosis" VALUE 0x005ba _REC_VAL_20_u1 254. _CNV_A_R_LINEAR_____1_CM 1. 255. DISPLAY_IDENTIFIER C_ABC_MAX_TCO_EX FORMAT "%3.0" /end CHARACTERISTIC
/begin CHARACTERISTIC c_abc_inc_tq_gs_inc_plaus "Debounce counter increment - TQ_GS_INC Diagnosis" VALUE 0x0056c _REC_VAL_20_u1 255. _CNV_A_R_LINEAR_____1_CM 0. 255. DISPLAY_IDENTIFIER C_ABC_INC_TQ_GS_INC_PLAUS FORMAT "%3.0" /end CHARACTERISTIC
/begin CHARACTERISTIC c_abc_max_tq_gs_inc_plaus "Debounce counter maximum - TQ_GS_INC Diagnosis" VALUE 0x005d1 _REC_VAL_20_u1 254. _CNV_A_R_LINEAR_____1_CM 1. 255. DISPLAY_IDENTIFIER C_ABC_MAX_TQ_GS_INC_PLAUS FORMAT "%3.0" /end CHARACTERISTIC
/begin MEASUREMENT lv_err_tecu "TECU error flag" UBYTE _CNV_S_2_RANGE______2_R_CM 1 100. 0. 255. DISPLAY_IDENTIFIER LV_ERR_TECU ECU_ADDRESS 0x3fba60 /end MEASUREMENT
/begin CHARACTERISTIC c_tia_max_tecu_diag "TIA threshold - TECU diagnosis" VALUE 0x008d1 _REC_VAL_20_u1 190.5 _CNV_A_R_LINEAR_____12_CM -48. 142.5 DISPLAY_IDENTIFIER C_TIA_MAX_TECU_DIAG FORMAT "%5.1" /end CHARACTERISTIC
/begin CHARACTERISTIC c_abc_max_tecu "Maximum value of the anti - bounce counter" VALUE 0x005bd _REC_VAL_20_u1 254. _CNV_A_R_LINEAR_____1_CM 1. 255. DISPLAY_IDENTIFIER C_ABC_MAX_TECU FORMAT "%3.0" /end CHARACTERISTIC
/begin CHARACTERISTIC c_abc_inc_tecu "Anti - bounce counter increment" VALUE 0x00554 _REC_VAL_20_u1 255. _CNV_A_R_LINEAR_____1_CM 0. 255. DISPLAY_IDENTIFIER C_ABC_INC_TECU FORMAT "%3.0" /end CHARACTERISTIC
/begin CHARACTERISTIC c_v_tecu_min_diag "V_TECU threshold for short to VB or line break - TECU diagnosis" VALUE 0x019b8 _REC_VAL_20_u2 4.99511719 _CNV_A_R_LINEAR_____3_CM 0. 4.99511719 DISPLAY_IDENTIFIER C_V_TECU_MIN_DIAG FORMAT "%5.3" /end CHARACTERISTIC
/begin CHARACTERISTIC c_v_tecu_max_diag "V_TECU threshold for short to ground - TECU diagnosis" VALUE 0x019b6 _REC_VAL_20_u2 4.99511719 _CNV_A_R_LINEAR_____3_CM 0. 4.99511719 DISPLAY_IDENTIFIER C_V_TECU_MAX_DIAG FORMAT "%5.3" /end CHARACTERISTIC
/begin CHARACTERISTIC c_abc_inc_tia "Debounce counter increment - TIA diagnosis" VALUE 0x00555 _REC_VAL_20_u1 255. _CNV_A_R_LINEAR_____1_CM 0. 255. DISPLAY_IDENTIFIER C_ABC_INC_TIA FORMAT "%3.0" /end CHARACTERISTIC
/begin CHARACTERISTIC c_abc_max_tia "Debounce counter maximum value - TIA diagnosis" VALUE 0x005be _REC_VAL_20_u1 254. _CNV_A_R_LINEAR_____1_CM 1. 255. DISPLAY_IDENTIFIER C_ABC_MAX_TIA FORMAT "%3.0" /end CHARACTERISTIC
/begin CHARACTERISTIC c_abc_inc_tps_ad_bol "Anti - bounce counter increment" VALUE 0x00568 _REC_VAL_20_u1 255. _CNV_A_R_LINEAR_____1_CM 0. 255. DISPLAY_IDENTIFIER C_ABC_INC_TPS_AD_BOL FORMAT "%3.0" /end CHARACTERISTIC
/begin CHARACTERISTIC c_abc_max_tps_ad_bol "Maximum value of the anti - bounce counter" VALUE 0x005cf _REC_VAL_20_u1 254. _CNV_A_R_LINEAR_____1_CM 1. 255. DISPLAY_IDENTIFIER C_ABC_MAX_TPS_AD_BOL FORMAT "%3.0" /end CHARACTERISTIC
/begin CHARACTERISTIC c_abc_inc_tps_1 "Debounce counter Increment, TPS diagnosis, Channel 1" VALUE 0x00566 _REC_VAL_20_u1 255. _CNV_A_R_LINEAR_____1_CM 0. 255. DISPLAY_IDENTIFIER C_ABC_INC_TPS_1 FORMAT "%3.0" /end CHARACTERISTIC
/begin CHARACTERISTIC c_abc_inc_tps_2 "Debounce counter Increment, TPS diagnosis, Channel 2" VALUE 0x00567 _REC_VAL_20_u1 255. _CNV_A_R_LINEAR_____1_CM 0. 255. DISPLAY_IDENTIFIER C_ABC_INC_TPS_2 FORMAT "%3.0" /end CHARACTERISTIC
/begin CHARACTERISTIC c_abc_max_tps_2 "Debounce counter maximum value, TPS diagnosis, Channel 2" VALUE 0x005ce _REC_VAL_20_u1 254. _CNV_A_R_LINEAR_____1_CM 1. 255. DISPLAY_IDENTIFIER C_ABC_MAX_TPS_2 FORMAT "%3.0" /end CHARACTERISTIC
/begin CHARACTERISTIC c_abc_max_tps_1 "Debounce counter maximum value, TPS diagnosis, Channel 1" VALUE 0x005cd _REC_VAL_20_u1 254. _CNV_A_R_LINEAR_____1_CM 1. 255. DISPLAY_IDENTIFIER C_ABC_MAX_TPS_1 FORMAT "%3.0" /end CHARACTERISTIC
/begin CHARACTERISTIC c_abc_inc_tqi_lim "Increment counter for torque request for safety" VALUE 0x0056e _REC_VAL_20_u1 255. _CNV_A_R_LINEAR_____1_CM 0. 255. DISPLAY_IDENTIFIER C_ABC_INC_TQI_LIM FORMAT "%3.0" /end CHARACTERISTIC
/begin CHARACTERISTIC c_abc_max_tqi_lim "Maximum counter for torque request for safety" VALUE 0x005d3 _REC_VAL_20_u1 254. _CNV_A_R_LINEAR_____1_CM 1. 255. DISPLAY_IDENTIFIER C_ABC_MAX_TQI_LIM FORMAT "%3.0" /end CHARACTERISTIC
/begin MEASUREMENT lv_err_tqi_lim "Error flag torque request for safety is active" UBYTE _CNV_S_2_RANGE______0_CM 1 100. 0. 1. DISPLAY_IDENTIFIER LV_ERR_TQI_LIM ECU_ADDRESS 0x3fba6c BIT_MASK 0x1 /end MEASUREMENT
/begin CHARACTERISTIC c_abc_inc_tq_loss_mon "anti bounce counter increment" VALUE 0x11d56 _REC_VAL_20_u1 255. _CNV_A_R_LINEAR_____1_CM 0. 255. DISPLAY_IDENTIFIER C_ABC_INC_TQ_LOSS_MON FORMAT "%3.0" /end CHARACTERISTIC
/begin CHARACTERISTIC c_abc_max_tq_loss_mon "maximum of anti bounce counter" VALUE 0x11d6b _REC_VAL_20_u1 254. _CNV_A_R_LINEAR_____1_CM 1. 255. DISPLAY_IDENTIFIER C_ABC_MAX_TQ_LOSS_MON FORMAT "%3.0" /end CHARACTERISTIC
/begin CHARACTERISTIC c_abc_inc_seg_t_ad "Increment value of the anti - bounce counter for segment period measurement diagnosis." VALUE 0x00241 _REC_VAL_20_u1 255. _CNV_A_R_LINEAR_____1_CM 0. 255. DISPLAY_IDENTIFIER C_ABC_INC_SEG_T_AD FORMAT "%3.0" /end CHARACTERISTIC
/begin CHARACTERISTIC c_abc_inc_seg_t "Increment value of the anti - bounce counter for segment period measurement diagnosis." VALUE 0x00240 _REC_VAL_20_u1 255. _CNV_A_R_LINEAR_____1_CM 0. 255. DISPLAY_IDENTIFIER C_ABC_INC_SEG_T FORMAT "%3.0" /end CHARACTERISTIC
/begin CHARACTERISTIC c_abc_max_seg_t_ad "Maximum value of the anti - bounce counter for segment period measurement diagnosis." VALUE 0x00243 _REC_VAL_20_u1 254. _CNV_A_R_LINEAR_____1_CM 1. 255. DISPLAY_IDENTIFIER C_ABC_MAX_SEG_T_AD FORMAT "%3.0" /end CHARACTERISTIC
/begin CHARACTERISTIC c_abc_max_seg_t "Maximum value of the anti - bounce counter for segment period measurement diagnosis." VALUE 0x00242 _REC_VAL_20_u1 254. _CNV_A_R_LINEAR_____1_CM 1. 255. DISPLAY_IDENTIFIER C_ABC_MAX_SEG_T FORMAT "%3.0" /end CHARACTERISTIC
/begin CHARACTERISTIC c_abc_inc_gen "Increment debounce counter - Generator error" VALUE 0x00532 _REC_VAL_20_u1 255. _CNV_A_R_LINEAR_____1_CM 0. 255. DISPLAY_IDENTIFIER C_ABC_INC_GEN FORMAT "%3.0" /end CHARACTERISTIC
/begin CHARACTERISTIC c_abc_inc_gen_if "Increment debounce counter - Generator error" VALUE 0x00534 _REC_VAL_20_u1 255. _CNV_A_R_LINEAR_____1_CM 0. 255. DISPLAY_IDENTIFIER C_ABC_INC_GEN_IF FORMAT "%3.0" /end CHARACTERISTIC
/begin CHARACTERISTIC c_abc_max_gen "Maximum value debounce counter - Generator error" VALUE 0x0059c _REC_VAL_20_u1 254. _CNV_A_R_LINEAR_____1_CM 1. 255. DISPLAY_IDENTIFIER C_ABC_MAX_GEN FORMAT "%3.0" /end CHARACTERISTIC
/begin CHARACTERISTIC c_abc_max_gen_if "Maximum value debounce counter - Generator error" VALUE 0x0059e _REC_VAL_20_u1 254. _CNV_A_R_LINEAR_____1_CM 1. 255. DISPLAY_IDENTIFIER C_ABC_MAX_GEN_IF FORMAT "%3.0" /end CHARACTERISTIC
/begin CHARACTERISTIC c_abc_max_gen_diag "Maximum value debounce counter - Generator switch off diagnosis" VALUE 0x0059d _REC_VAL_20_u1 254. _CNV_A_R_LINEAR_____1_CM 1. 255. DISPLAY_IDENTIFIER C_ABC_MAX_GEN_DIAG FORMAT "%3.0" /end CHARACTERISTIC
/begin CHARACTERISTIC c_abc_inc_gen_diag "Increment debounce counter - Generator switch off " VALUE 0x00533 _REC_VAL_20_u1 255. _CNV_A_R_LINEAR_____1_CM 0. 255. DISPLAY_IDENTIFIER C_ABC_INC_GEN_DIAG FORMAT "%3.0" /end CHARACTERISTIC
/begin CHARACTERISTIC c_abc_inc_toil_level "Anti bounce increment" VALUE 0x00557 _REC_VAL_20_u1 255. _CNV_A_R_LINEAR_____1_CM 0. 255. DISPLAY_IDENTIFIER C_ABC_INC_TOIL_LEVEL FORMAT "%3.0" /end CHARACTERISTIC
/begin CHARACTERISTIC c_abc_inc_bat_sens "Anti bounce increment" VALUE 0x0050e _REC_VAL_20_u1 255. _CNV_A_R_LINEAR_____1_CM 0. 255. DISPLAY_IDENTIFIER C_ABC_INC_BAT_SENS FORMAT "%3.0" /end CHARACTERISTIC
/begin CHARACTERISTIC c_abc_inc_bat_sens_it "Anti bounce increment" VALUE 0x0050f _REC_VAL_20_u1 255. _CNV_A_R_LINEAR_____1_CM 0. 255. DISPLAY_IDENTIFIER C_ABC_INC_BAT_SENS_IT FORMAT "%3.0" /end CHARACTERISTIC
/begin CHARACTERISTIC c_abc_inc_bat_sens_it_el "Anti bounce increment" VALUE 0x00510 _REC_VAL_20_u1 255. _CNV_A_R_LINEAR_____1_CM 0. 255. DISPLAY_IDENTIFIER C_ABC_INC_BAT_SENS_IT_EL FORMAT "%3.0" /end CHARACTERISTIC
/begin CHARACTERISTIC c_abc_max_toil_level "Anti boune maximum" VALUE 0x005c0 _REC_VAL_20_u1 254. _CNV_A_R_LINEAR_____1_CM 1. 255. DISPLAY_IDENTIFIER C_ABC_MAX_TOIL_LEVEL FORMAT "%3.0" /end CHARACTERISTIC
/begin CHARACTERISTIC c_abc_max_bat_sens "Anti boune maximum" VALUE 0x0057a _REC_VAL_20_u1 254. _CNV_A_R_LINEAR_____1_CM 1. 255. DISPLAY_IDENTIFIER C_ABC_MAX_BAT_SENS FORMAT "%3.0" /end CHARACTERISTIC
/begin CHARACTERISTIC c_abc_max_bat_sens_it "Anti boune maximum" VALUE 0x0057b _REC_VAL_20_u1 254. _CNV_A_R_LINEAR_____1_CM 1. 255. DISPLAY_IDENTIFIER C_ABC_MAX_BAT_SENS_IT FORMAT "%3.0" /end CHARACTERISTIC
/begin CHARACTERISTIC c_abc_max_bat_sens_it_el "Anti boune maximum" VALUE 0x0057c _REC_VAL_20_u1 254. _CNV_A_R_LINEAR_____1_CM 1. 255. DISPLAY_IDENTIFIER C_ABC_MAX_BAT_SENS_IT_EL FORMAT "%3.0" /end CHARACTERISTIC
/begin CHARACTERISTIC c_abc_inc_toil "Debounce counter increment - TOIL diagnosis" VALUE 0x00556 _REC_VAL_20_u1 255. _CNV_A_R_LINEAR_____1_CM 0. 255. DISPLAY_IDENTIFIER C_ABC_INC_TOIL FORMAT "%3.0" /end CHARACTERISTIC
/begin CHARACTERISTIC c_abc_max_toil "Debounce counter maximum value - TOIL diagnosis" VALUE 0x005bf _REC_VAL_20_u1 254. _CNV_A_R_LINEAR_____1_CM 1. 255. DISPLAY_IDENTIFIER C_ABC_MAX_TOIL FORMAT "%3.0" /end CHARACTERISTIC
/begin CHARACTERISTIC c_abc_inc_conv_mon "Anti bounce counter increment (additive value in case of ADC error)" VALUE 0x11d47 _REC_VAL_20_u1 255. _CNV_A_R_LINEAR_____1_CM 0. 255. DISPLAY_IDENTIFIER C_ABC_INC_CONV_MON FORMAT "%3.0" /end CHARACTERISTIC
/begin CHARACTERISTIC c_abc_inc_maf_mon "Anti bounce counter increment (additive value in case of MAF diagnosis error)" VALUE 0x11d4d _REC_VAL_20_u1 255. _CNV_A_R_LINEAR_____1_CM 0. 255. DISPLAY_IDENTIFIER C_ABC_INC_MAF_MON FORMAT "%3.0" /end CHARACTERISTIC
/begin CHARACTERISTIC c_abc_inc_n_32_mon "Anti bounce counter increment (additive value in case of N_32 ratio error)" VALUE 0x11d4f _REC_VAL_20_u1 255. _CNV_A_R_LINEAR_____1_CM 0. 255. DISPLAY_IDENTIFIER C_ABC_INC_N_32_MON FORMAT "%3.0" /end CHARACTERISTIC
/begin CHARACTERISTIC c_abc_inc_pvs_ratio_mon "Anti bounce counter increment (additive value in case of error)" VALUE 0x11d50 _REC_VAL_20_u1 255. _CNV_A_R_LINEAR_____1_CM 0. 255. DISPLAY_IDENTIFIER C_ABC_INC_PVS_RATIO_MON FORMAT "%3.0" /end CHARACTERISTIC
/begin CHARACTERISTIC c_abc_inc_tps_ratio_mon "Anti bounce counter increment (additive value in case of ratio error)" VALUE 0x11d52 _REC_VAL_20_u1 255. _CNV_A_R_LINEAR_____1_CM 0. 255. DISPLAY_IDENTIFIER C_ABC_INC_TPS_RATIO_MON FORMAT "%3.0" /end CHARACTERISTIC
/begin CHARACTERISTIC c_abc_max_conv_mon "Value at which ADC error is recognized, when reached" VALUE 0x11d5c _REC_VAL_20_u1 254. _CNV_A_R_LINEAR_____1_CM 1. 255. DISPLAY_IDENTIFIER C_ABC_MAX_CONV_MON FORMAT "%3.0" /end CHARACTERISTIC
/begin CHARACTERISTIC c_abc_max_maf_mon "Value at which MAF diagnosis error is recognized, when reached" VALUE 0x11d62 _REC_VAL_20_u1 254. _CNV_A_R_LINEAR_____1_CM 1. 255. DISPLAY_IDENTIFIER C_ABC_MAX_MAF_MON FORMAT "%3.0" /end CHARACTERISTIC
/begin CHARACTERISTIC c_abc_max_n_32_mon "Value at which N_32 ratio error is recognized, when reached" VALUE 0x11d64 _REC_VAL_20_u1 254. _CNV_A_R_LINEAR_____1_CM 1. 255. DISPLAY_IDENTIFIER C_ABC_MAX_N_32_MON FORMAT "%3.0" /end CHARACTERISTIC
/begin CHARACTERISTIC c_abc_max_pvs_ratio_mon "Value at which ratio error is recognized. when reached" VALUE 0x11d65 _REC_VAL_20_u1 254. _CNV_A_R_LINEAR_____1_CM 1. 255. DISPLAY_IDENTIFIER C_ABC_MAX_PVS_RATIO_MON FORMAT "%3.0" /end CHARACTERISTIC
/begin CHARACTERISTIC c_abc_max_tps_ratio_mon "Value at which ratio error is recognized, when reached" VALUE 0x11d67 _REC_VAL_20_u1 254. _CNV_A_R_LINEAR_____1_CM 1. 255. DISPLAY_IDENTIFIER C_ABC_MAX_TPS_RATIO_MON FORMAT "%3.0" /end CHARACTERISTIC
/begin CHARACTERISTIC c_abc_max_tqi_n_max_mon "Maximum value of anti-bounce counter" VALUE 0x11d6f _REC_VAL_20_u1 254. _CNV_A_R_LINEAR_____1_CM 1. 255. DISPLAY_IDENTIFIER C_ABC_MAX_TQI_N_MAX_MON FORMAT "%3.0" /end CHARACTERISTIC
/begin CHARACTERISTIC c_abc_inc_tqi_n_max_mon "Anti bounce counter increment" VALUE 0x11d5a _REC_VAL_20_u1 255. _CNV_A_R_LINEAR_____1_CM 0. 255. DISPLAY_IDENTIFIER C_ABC_INC_TQI_N_MAX_MON FORMAT "%3.0" /end CHARACTERISTIC
/begin CHARACTERISTIC c_abc_inc_tq_dif_p_d_is_mon "Anti bounce counter increment" VALUE 0x11d54 _REC_VAL_20_u1 255. _CNV_A_R_LINEAR_____1_CM 0. 255. DISPLAY_IDENTIFIER C_ABC_INC_TQ_DIF_P_D_IS_MON FORMAT "%3.0" /end CHARACTERISTIC
/begin CHARACTERISTIC c_abc_inc_tq_dif_i_is_mon "Anti bounce counter increment" VALUE 0x11d53 _REC_VAL_20_u1 255. _CNV_A_R_LINEAR_____1_CM 0. 255. DISPLAY_IDENTIFIER C_ABC_INC_TQ_DIF_I_IS_MON FORMAT "%3.0" /end CHARACTERISTIC
/begin CHARACTERISTIC c_abc_max_tq_dif_p_d_is_mon "Maximum of anti bounce counter" VALUE 0x11d69 _REC_VAL_20_u1 254. _CNV_A_R_LINEAR_____1_CM 1. 255. DISPLAY_IDENTIFIER C_ABC_MAX_TQ_DIF_P_D_IS_MON FORMAT "%3.0" /end CHARACTERISTIC
/begin CHARACTERISTIC c_abc_max_tq_dif_i_is_mon "Maximum of anti bounce counter" VALUE 0x11d68 _REC_VAL_20_u1 254. _CNV_A_R_LINEAR_____1_CM 1. 255. DISPLAY_IDENTIFIER C_ABC_MAX_TQ_DIF_I_IS_MON FORMAT "%3.0" /end CHARACTERISTIC
/begin CHARACTERISTIC c_abc_inc_tqi_av_mon "Anti bounce counter increment" VALUE 0x11d59 _REC_VAL_20_u1 255. _CNV_A_R_LINEAR_____1_CM 0. 255. DISPLAY_IDENTIFIER C_ABC_INC_TQI_AV_MON FORMAT "%3.0" /end CHARACTERISTIC
/begin CHARACTERISTIC c_abc_max_tqi_av_mon "Maximum value of anti-bounce counter" VALUE 0x11d6e _REC_VAL_20_u1 254. _CNV_A_R_LINEAR_____1_CM 1. 255. DISPLAY_IDENTIFIER C_ABC_MAX_TQI_AV_MON FORMAT "%3.0" /end CHARACTERISTIC
/begin CHARACTERISTIC c_abc_inc_tq_min_clu_mon "Anti bounce counter increment" VALUE 0x11d58 _REC_VAL_20_u1 255. _CNV_A_R_LINEAR_____1_CM 0. 255. DISPLAY_IDENTIFIER C_ABC_INC_TQ_MIN_CLU_MON FORMAT "%3.0" /end CHARACTERISTIC
/begin CHARACTERISTIC c_abc_max_tq_min_clu_mon "Maximum of anti bounce counter" VALUE 0x11d6d _REC_VAL_20_u1 254. _CNV_A_R_LINEAR_____1_CM 1. 255. DISPLAY_IDENTIFIER C_ABC_MAX_TQ_MIN_CLU_MON FORMAT "%3.0" /end CHARACTERISTIC
/begin CHARACTERISTIC c_abc_inc_msr_inh_mon "Anti bounce counter increment" VALUE 0x11d4e _REC_VAL_20_u1 255. _CNV_A_R_LINEAR_____1_CM 0. 255. DISPLAY_IDENTIFIER C_ABC_INC_MSR_INH_MON FORMAT "%3.0" /end CHARACTERISTIC
/begin CHARACTERISTIC c_abc_max_msr_inh_mon "Maximum value of anti - bounce counter" VALUE 0x11d63 _REC_VAL_20_u1 254. _CNV_A_R_LINEAR_____1_CM 1. 255. DISPLAY_IDENTIFIER C_ABC_MAX_MSR_INH_MON FORMAT "%3.0" /end CHARACTERISTIC
/begin CHARACTERISTIC c_abc_inc_cru_inh_mon "Anti bouncecounter increment" VALUE 0x11d48 _REC_VAL_20_u1 255. _CNV_A_R_LINEAR_____1_CM 0. 255. DISPLAY_IDENTIFIER C_ABC_INC_CRU_INH_MON FORMAT "%3.0" /end CHARACTERISTIC
/begin CHARACTERISTIC c_abc_max_cru_inh_mon "Maximum value of anti-bounce counter" VALUE 0x11d5d _REC_VAL_20_u1 254. _CNV_A_R_LINEAR_____1_CM 1. 255. DISPLAY_IDENTIFIER C_ABC_MAX_CRU_INH_MON FORMAT "%3.0" /end CHARACTERISTIC
/begin CHARACTERISTIC c_abc_inc_tq_max_clu_mon "Anti bounce counter increment" VALUE 0x11d57 _REC_VAL_20_u1 255. _CNV_A_R_LINEAR_____1_CM 0. 255. DISPLAY_IDENTIFIER C_ABC_INC_TQ_MAX_CLU_MON FORMAT "%3.0" /end CHARACTERISTIC
/begin CHARACTERISTIC c_abc_max_tq_max_clu_mon "Maximum of anti bounce counter" VALUE 0x11d6c _REC_VAL_20_u1 254. _CNV_A_R_LINEAR_____1_CM 1. 255. DISPLAY_IDENTIFIER C_ABC_MAX_TQ_MAX_CLU_MON FORMAT "%3.0" /end CHARACTERISTIC
/begin CHARACTERISTIC c_abc_max_tqi_n_max_mon2 "" VALUE 0x005d4 _REC_VAL_20_u1 254. _CNV_A_R_LINEAR_____1_CM 1. 255. DISPLAY_IDENTIFIER C_ABC_MAX_TQI_N_MAX_MON2 FORMAT "%3.0" /end CHARACTERISTIC
/begin CHARACTERISTIC c_abc_max_tqi_av_mon2 "" VALUE 0x005d2 _REC_VAL_20_u1 254. _CNV_A_R_LINEAR_____1_CM 1. 255. DISPLAY_IDENTIFIER C_ABC_MAX_TQI_AV_MON2 FORMAT "%3.0" /end CHARACTERISTIC
/begin CHARACTERISTIC c_abc_inc_tqi_n_max_mon2 "" VALUE 0x0056f _REC_VAL_20_u1 255. _CNV_A_R_LINEAR_____1_CM 0. 255. DISPLAY_IDENTIFIER C_ABC_INC_TQI_N_MAX_MON2 FORMAT "%3.0" /end CHARACTERISTIC
/begin CHARACTERISTIC c_abc_inc_tqi_av_mon2 "" VALUE 0x0056d _REC_VAL_20_u1 255. _CNV_A_R_LINEAR_____1_CM 0. 255. DISPLAY_IDENTIFIER C_ABC_INC_TQI_AV_MON2 FORMAT "%3.0" /end CHARACTERISTIC
/begin CHARACTERISTIC c_abc_max_spi_mps "Anti bounce maxi,um SPI_MPS diagnosis" VALUE 0x005b8 _REC_VAL_20_u1 254. _CNV_A_R_LINEAR_____1_CM 1. 255. DISPLAY_IDENTIFIER C_ABC_MAX_SPI_MPS FORMAT "%3.0" /end CHARACTERISTIC
/begin CHARACTERISTIC c_abc_max_spi_knk "Anti bounce maxi,um SPI_KNK diagnosis" VALUE 0x005b7 _REC_VAL_20_u1 254. _CNV_A_R_LINEAR_____1_CM 1. 255. DISPLAY_IDENTIFIER C_ABC_MAX_SPI_KNK FORMAT "%3.0" /end CHARACTERISTIC
/begin CHARACTERISTIC c_abc_inc_spi_mps "Antibounce increment SPI_MPS diagnosis" VALUE 0x0054f _REC_VAL_20_u1 255. _CNV_A_R_LINEAR_____1_CM 0. 255. DISPLAY_IDENTIFIER C_ABC_INC_SPI_MPS FORMAT "%3.0" /end CHARACTERISTIC
/begin CHARACTERISTIC c_abc_inc_spi_knk "Antibounce increment SPI_KNK diagnosis" VALUE 0x0054e _REC_VAL_20_u1 255. _CNV_A_R_LINEAR_____1_CM 0. 255. DISPLAY_IDENTIFIER C_ABC_INC_SPI_KNK FORMAT "%3.0" /end CHARACTERISTIC
/begin COMPU_METHOD _CNV_S_2_RANGE______0_CM "" TAB_VERB "%6.3" "[-]" COMPU_TAB_REF _CNV_S_2_RANGE______0 /end COMPU_METHOD
/begin COMPU_VTAB _CNV_S_2_RANGE______0 "" TAB_VERB 2 0 "0" 1 "1" /end COMPU_VTAB
/begin COMPU_METHOD _CNV_A_R_LINEAR_____1_CM "" RAT_FUNC "%6.3" "-" COEFFS 0 1. 0. 0 0 1 /end COMPU_METHOD
/begin COMPU_METHOD _CNV_S_2_RANGE______2_R_CM "" TAB_VERB "%6.3" "[-]" COMPU_TAB_REF _CNV_S_2_RANGE______2_R /end COMPU_METHOD
/begin COMPU_VTAB_RANGE _CNV_S_2_RANGE______2_R "" 2 0 0 "0" 1 255 "1" /end COMPU_VTAB_RANGE
/begin COMPU_METHOD _CNV_A_R_LINEAR_____3_CM "" RAT_FUNC "%6.3" "V" COEFFS 0 204.7999998974999 0. 0 0 1 /end COMPU_METHOD
/begin COMPU_METHOD _CNV_S_2_RANGE______5_CM "" TAB_VERB "%6.3" "-" COMPU_TAB_REF _CNV_S_2_RANGE______5 /end COMPU_METHOD
/begin COMPU_VTAB _CNV_S_2_RANGE______5 "" TAB_VERB 2 0 "0" 1 "1" /end COMPU_VTAB
/begin COMPU_METHOD _CNV_A_R_LINEAR_____12_CM "" RAT_FUNC "%6.3" "°C" COEFFS 0 1.333333333333333 64. 0 0 1 /end COMPU_METHOD
/begin COMPU_METHOD _CNV_S_6_RANGE_ERR__192_CM "" TAB_VERB "%6.3" "-" COMPU_TAB_REF _CNV_S_6_RANGE_ERR__192 /end COMPU_METHOD
/begin COMPU_VTAB _CNV_S_6_RANGE_ERR__192 "" TAB_VERB 6 0 "NO_SYM" 1 "SYM_0" 2 "SYM_1" 4 "SYM_2" 8 "SYM_3" 15 "BENCH_MODE" /end COMPU_VTAB
/begin RECORD_LAYOUT _REC_VAL_20_u1 FNC_VALUES 1 UBYTE COLUMN_DIR DIRECT /end RECORD_LAYOUT
/begin RECORD_LAYOUT _REC_VAL_20_u2 FNC_VALUES 1 UWORD COLUMN_DIR DIRECT /end RECORD_LAYOUT
/begin FUNCTION DIA_Anti_bounce_algorithm "_Anti-bounce-algorithm"
 /begin DEF_CHARACTERISTIC c_det_max_dmtlh c_det_inc_dmtlh c_det_inc_dmtl_pump c_det_max_dmtl_pump c_det_inc_dmtls c_det_max_dmtls c_det_inc_rly_accout c_det_max_rly_accout c_det_max_ebox_cfa c_det_inc_ebox_cfa c_det_max_ef c_det_inc_ef c_det_inc_ecras c_det_max_ecras c_det_inc_sav c_det_max_sav c_det_max_vim c_det_inc_vim c_det_inc_rly_st c_det_max_rly_st c_det_inc_lsh_down c_det_max_lsh_down c_det_max_lsh_up c_det_inc_lsh_up c_det_max_isa_1 c_det_max_isa_2 c_det_inc_isa_1 c_det_inc_isa_2 c_det_max_slv_ivvt c_det_inc_slv_ivvt c_det_inc_sap c_det_max_sap c_abc_inc_rly_efp c_abc_max_rly_efp c_det_max_cps c_det_inc_cps c_det_max_ect_el c_det_inc_ect_el c_det_max_ecf c_det_inc_ecf c_abc_inc_iv c_abc_max_iv c_abc_inc_imob_2 c_abc_inc_imob_1 c_abc_max_imob_2 c_abc_max_imob_1 c_abc_inc_sof_inh_mon c_abc_max_sof_inh_mon c_abc_inc_amp c_abc_max_amp c_abc_inc_im_bts_plaus c_abc_inc_im_bls_plaus c_abc_max_im_bts_plaus c_abc_max_im_bls_plaus c_abc_inc_bn_tq_dcc c_abc_inc_bn_tq_tcs c_abc_inc_bn_vs_tcs c_abc_inc_bn_tcs c_abc_inc_bn_tq_etcu c_abc_inc_bn_cas c_abc_inc_bn_etcu c_abc_inc_bn_tq_amt c_abc_inc_bn_acc c_abc_inc_bn_icl c_abc_inc_bn_km_icl c_abc_inc_bn_veh_mod c_abc_inc_bn_t_icl c_abc_inc_bn_pow_vb c_abc_inc_bn_pow_gen c_abc_inc_bn_msw c_abc_inc_bn_ang_pste c_abc_max_bn_cas c_abc_max_bn_tq_tcs c_abc_max_bn_vs_tcs c_abc_max_bn_tcs c_abc_max_bn_tq_etcu c_abc_max_bn_etcu c_abc_max_bn_tq_amt c_abc_max_bn_acc c_abc_max_bn_t_icl c_abc_max_bn_km_icl c_abc_max_bn_veh_mod c_abc_max_bn_icl c_abc_max_bn_pow_vb c_abc_max_bn_pow_gen c_abc_max_bn_msw c_abc_max_bn_tq_dcc c_abc_max_bn_ang_pste c_ctr_diag_tcc_can_max_ars c_ctr_diag_tcc_can_max_cas c_ctr_diag_tcc_can_max_tq_tcs c_ctr_diag_tcc_can_max_tq_etcu c_ctr_diag_tcc_can_max_tq_amt c_ctr_diag_tcc_can_max_veh_mod c_ctr_diag_tcc_can_max_icl c_ctr_diag_tcc_can_max_msw c_ctr_diag_tcc_can_max_tq_dcc c_ctr_diag_cks_max_cas c_ctr_diag_cks_max_tq_tcs c_ctr_diag_cks_max_tq_etcu c_ctr_diag_cks_max_tq_amt c_ctr_diag_cks_max_veh_mod c_ctr_diag_cks_max_msw c_ctr_diag_cks_max_tq_dcc c_ctr_diag_tout_max_ars c_ctr_diag_tout_max_cas c_ctr_diag_tout_max_tq_tcs c_ctr_diag_tout_max_vs_tcs c_ctr_diag_tout_max_tcs c_ctr_diag_tout_max_tq_etcu c_ctr_diag_tout_max_tq_dcc c_ctr_diag_tout_max_tq_amt c_ctr_diag_tout_max_acc c_ctr_diag_tout_max_t_icl c_ctr_diag_tout_max_veh_mod c_ctr_diag_tout_max_km_icl c_ctr_diag_tout_max_icl c_ctr_diag_tout_max_pow_vb c_ctr_diag_tout_max_pow_gen c_ctr_diag_tout_max_msw c_ctr_diag_tout_max_etcu c_ctr_diag_tout_max_ang_pste c_abc_max_bn_ars c_abc_inc_bn_ars c_abc_dec_bn_tq_dcc c_abc_dec_bn_ars c_abc_dec_bn_cas c_abc_dec_bn_tq_tcs c_abc_dec_bn_vs_tcs c_abc_dec_bn_tcs c_abc_dec_bn_tq_etcu c_abc_dec_bn_etcu c_abc_dec_bn_tq_amt c_abc_dec_bn_acc c_abc_dec_bn_icl c_abc_dec_bn_km_icl c_abc_dec_bn_t_icl c_abc_dec_bn_pow_vb c_abc_dec_bn_pow_gen c_abc_dec_bn_msw c_abc_dec_bn_ang_pste c_abc_dec_bn_veh_mod c_abc_inc_bn_tq_pste_2 c_abc_max_bn_tq_pste_2 c_abc_dec_bn_tq_pste_2 c_ctr_diag_tcc_can_max_tq_pste_2 c_ctr_diag_cks_max_tq_pste_2 c_ctr_diag_tout_max_tq_pste_2 c_abc_inc_bn_efp c_abc_max_bn_efp c_abc_dec_bn_efp c_ctr_diag_tout_max_efp c_abc_inc_bsd c_abc_max_bsd c_abc_inc_cam_per_0 c_abc_inc_cam_per_1 c_abc_max_cam_per_1 c_abc_max_cam_per_0 c_abc_inc_cam_psn_1 c_abc_max_cam_psn_0 c_abc_max_cam_psn_1 c_abc_inc_cam_psn_0 c_abc_inc_tout_asr_3 c_abc_max_tout_asr_3 c_abc_inc_can_boff c_abc_max_can_boff c_abc_inc_tout_asr_1 c_abc_max_tout_asr_1 c_abc_inc_tout_asr_4 c_abc_max_tout_asr_4 c_abc_inc_tout_efp c_abc_max_tout_efp c_abc_inc_locan_boff c_abc_max_locan_boff c_abc_inc_tout_etcu_1 c_abc_inc_tout_etcu_2 c_abc_max_tout_etcu_1 c_abc_max_tout_etcu_2 c_abc_inc_tout_icl_2 c_abc_max_tout_icl_2 c_abc_inc_tout_icl_3 c_abc_max_tout_icl_3 c_abc_inc_tout_pste_1 c_abc_max_tout_pste_1 c_abc_inc_dcc_inh_mon c_abc_max_dcc_inh_mon c_abc_inc_dcc_rev_mon c_abc_max_dcc_rev_mon c_abc_inc_dcc_irrev_mon c_abc_max_dcc_irrev_mon c_abc_inc_amt_inh_mon c_abc_max_amt_inh_mon c_abc_inc_gs_inh_mon c_abc_inc_tq_gs_inc_plaus_mon c_abc_max_gs_inh_mon c_abc_max_tq_gs_inc_plaus_mon c_abc_inc_tout_amt_1 c_abc_max_tout_amt_1 c_abc_inc_tout_txu_1 c_abc_max_tout_txu_1 c_abc_inc_eng_psn_prev_syn c_abc_inc_eng_psn_dur_st c_abc_max_eng_psn c_abc_inc_eng_psn_ast c_abc_inc_tooth_per_prev_syn c_abc_inc_tooth_per_ast c_abc_max_tooth_per c_abc_inc_tooth_per_dur_st c_abc_inc_tpu_syn_prev_syn c_abc_inc_tpu_syn_dur_st c_abc_max_tpu_syn c_abc_inc_tpu_syn_ast c_abc_inc_crk_not_plaus c_abc_max_crk_not_plaus c_abc_inc_dcc c_abc_max_dcc c_abc_inc_cs c_abc_max_cs c_abc_inc_ect_mec c_abc_max_ect_mec lc_abc_bench lc_err_det_upd c_abc_max_td_igc_cut c_abc_inc_v_dur_igc c_abc_max_v_dur_igc c_abc_inc_td_igc_cut c_abc_max_ref_ivvt c_abc_inc_ref_ivvt c_abc_inc_knks_diag c_abc_max_knks_diag c_abc_max_vls_down_max c_abc_inc_vls_down_max c_abc_inc_vls_down_min_cold c_abc_max_vls_down_min_cold c_abc_max_vls_up_max c_abc_max_vls_up_puc c_abc_inc_vls_up_max c_abc_inc_vls_up_puc c_abc_inc_vls_up_stk c_abc_max_vls_up_stk c_abc_inc_vls_up_min_cold c_abc_max_vls_up_min_cold c_abc_inc_maf c_abc_max_maf c_abc_inc_mis_low_fuel c_abc_max_msw_2 c_abc_inc_msw_2 c_abc_inc_msw_tog c_abc_max_msw_tog c_abc_inc_msw_3 c_abc_max_msw_3 c_abc_inc_mtc_dr c_abc_max_mtc_dr c_abc_max_lam_dly c_abc_inc_lam_dly c_abc_inc_load_tps_plaus c_abc_max_load_tps_plaus c_abc_inc_poil_swi c_abc_max_poil_swi c_abc_inc_pvs_ratio c_abc_max_pvs_ratio c_abc_max_pvs_bls_not_plaus c_abc_inc_pvs_bls_not_plaus c_abc_inc_v_ref_1 c_abc_inc_v_ref_2 c_abc_max_v_ref_1 c_abc_max_v_ref_2 c_abc_inc_pvs_1 c_abc_inc_pvs_2 c_abc_max_pvs_1 c_abc_max_pvs_2 c_abc_inc_rly_main c_abc_max_rly_main c_abc_inc_sof_req c_abc_max_sof_req c_abc_inc_tco_grd_diag c_abc_max_tco_grd_diag c_abc_max_tco_el c_abc_inc_tco_el c_abc_inc_tco_ex c_abc_max_tco_ex c_abc_inc_tq_gs_inc_plaus c_abc_max_tq_gs_inc_plaus c_abc_max_tecu c_abc_inc_tecu c_abc_inc_tia c_abc_max_tia c_abc_inc_tps_ad_bol c_abc_max_tps_ad_bol c_abc_inc_tps_1 c_abc_inc_tps_2 c_abc_max_tps_2 c_abc_max_tps_1 c_abc_inc_tqi_lim c_abc_max_tqi_lim c_abc_inc_tq_loss_mon c_abc_max_tq_loss_mon c_abc_inc_seg_t_ad c_abc_inc_seg_t c_abc_max_seg_t_ad c_abc_max_seg_t c_abc_inc_gen c_abc_inc_gen_if c_abc_max_gen c_abc_max_gen_if c_abc_max_gen_diag c_abc_inc_gen_diag c_abc_inc_toil_level c_abc_inc_bat_sens c_abc_inc_bat_sens_it c_abc_inc_bat_sens_it_el c_abc_max_toil_level c_abc_max_bat_sens c_abc_max_bat_sens_it c_abc_max_bat_sens_it_el c_abc_inc_toil c_abc_max_toil c_abc_inc_conv_mon c_abc_inc_maf_mon c_abc_inc_n_32_mon c_abc_inc_pvs_ratio_mon c_abc_inc_tps_ratio_mon c_abc_max_conv_mon c_abc_max_maf_mon c_abc_max_n_32_mon c_abc_max_pvs_ratio_mon c_abc_max_tps_ratio_mon c_abc_max_tqi_n_max_mon c_abc_inc_tqi_n_max_mon c_abc_inc_tq_dif_p_d_is_mon c_abc_inc_tq_dif_i_is_mon c_abc_max_tq_dif_p_d_is_mon c_abc_max_tq_dif_i_is_mon c_abc_inc_tqi_av_mon c_abc_max_tqi_av_mon c_abc_inc_tq_min_clu_mon c_abc_max_tq_min_clu_mon c_abc_inc_msr_inh_mon c_abc_max_msr_inh_mon c_abc_inc_cru_inh_mon c_abc_max_cru_inh_mon c_abc_inc_tq_max_clu_mon c_abc_max_tq_max_clu_mon c_abc_max_tqi_n_max_mon2 c_abc_max_tqi_av_mon2 c_abc_inc_tqi_n_max_mon2 c_abc_inc_tqi_av_mon2 c_abc_max_spi_mps c_abc_max_spi_knk c_abc_inc_spi_mps c_abc_inc_spi_knk /end DEF_CHARACTERISTIC
 /begin OUT_MEASUREMENT fmy_stat_bn_vs_tcs.err_info_stat.lv_ready fmy_stat_bn_vs_tcs.err_info_stat.lv_end_diag fmy_stat_bn_vs_tcs.err_info_stat.lv_cdn_diag fmy_stat_bn_vs_tcs.err_info_stat.err_sym fmy_stat_bn_tcs.ctr_abc fmy_stat_bn_tcs.ctr_end_diag fmy_stat_bn_tcs.err_info_stat.lv_err_mem fmy_stat_bn_tcs.err_info_stat.lv_ready fmy_stat_bn_tcs.err_info_stat.lv_end_diag fmy_stat_bn_tcs.err_info_stat.lv_cdn_diag fmy_stat_bn_tcs.err_info_stat.err_sym fmy_stat_bn_tq_etcu.ctr_abc fmy_stat_bn_tq_etcu.ctr_end_diag fmy_stat_bn_tq_etcu.err_info_stat.lv_err_mem fmy_stat_bn_tq_etcu.err_info_stat.lv_ready fmy_stat_bn_tq_etcu.err_info_stat.lv_end_diag fmy_stat_bn_tq_etcu.err_info_stat.lv_cdn_diag fmy_stat_bn_tq_etcu.err_info_stat.err_sym fmy_stat_bn_etcu.ctr_abc fmy_stat_bn_etcu.ctr_end_diag fmy_stat_bn_etcu.err_info_stat.lv_err_mem fmy_stat_bn_etcu.err_info_stat.lv_ready fmy_stat_bn_etcu.err_info_stat.lv_end_diag fmy_stat_bn_etcu.err_info_stat.lv_cdn_diag fmy_stat_bn_etcu.err_info_stat.err_sym fmy_stat_bn_tq_amt.ctr_abc fmy_stat_bn_tq_amt.ctr_end_diag fmy_stat_bn_tq_amt.err_info_stat.lv_err_mem fmy_stat_bn_tq_amt.err_info_stat.lv_ready fmy_stat_bn_tq_amt.err_info_stat.lv_end_diag fmy_stat_bn_tq_amt.err_info_stat.lv_cdn_diag fmy_stat_bn_tq_amt.err_info_stat.err_sym fmy_stat_bn_acc.ctr_abc fmy_stat_bn_acc.ctr_end_diag fmy_stat_bn_acc.err_info_stat.lv_err_mem fmy_stat_bn_acc.err_info_stat.lv_ready fmy_stat_bn_acc.err_info_stat.lv_end_diag fmy_stat_bn_acc.err_info_stat.lv_cdn_diag fmy_stat_bn_acc.err_info_stat.err_sym fmy_stat_bn_t_icl.ctr_abc fmy_stat_bn_t_icl.ctr_end_diag fmy_stat_bn_t_icl.err_info_stat.lv_err_mem fmy_stat_bn_t_icl.err_info_stat.lv_ready fmy_stat_bn_t_icl.err_info_stat.lv_end_diag fmy_stat_bn_t_icl.err_info_stat.lv_cdn_diag fmy_stat_bn_t_icl.err_info_stat.err_sym fmy_stat_bn_veh_mod.ctr_abc fmy_stat_bn_veh_mod.ctr_end_diag fmy_stat_bn_veh_mod.err_info_stat.lv_err_mem fmy_stat_bn_veh_mod.err_info_stat.lv_ready fmy_stat_bn_veh_mod.err_info_stat.lv_end_diag fmy_stat_bn_veh_mod.err_info_stat.lv_cdn_diag fmy_stat_bn_veh_mod.err_info_stat.err_sym fmy_stat_bn_km_icl.ctr_abc fmy_stat_bn_km_icl.ctr_end_diag fmy_stat_bn_km_icl.err_info_stat.lv_err_mem fmy_stat_bn_km_icl.err_info_stat.lv_ready fmy_stat_bn_km_icl.err_info_stat.lv_end_diag fmy_stat_bn_km_icl.err_info_stat.lv_cdn_diag fmy_stat_bn_km_icl.err_info_stat.err_sym fmy_stat_bn_icl.ctr_abc fmy_stat_bn_icl.ctr_end_diag fmy_stat_bn_icl.err_info_stat.lv_err_mem fmy_stat_bn_icl.err_info_stat.lv_ready fmy_stat_bn_icl.err_info_stat.lv_end_diag fmy_stat_bn_icl.err_info_stat.lv_cdn_diag fmy_stat_bn_icl.err_info_stat.err_sym fmy_stat_bn_pow_vb.ctr_abc fmy_stat_bn_pow_vb.ctr_end_diag fmy_stat_bn_pow_vb.err_info_stat.lv_err_mem fmy_stat_bn_pow_vb.err_info_stat.lv_ready fmy_stat_bn_pow_vb.err_info_stat.lv_end_diag fmy_stat_bn_pow_vb.err_info_stat.lv_cdn_diag fmy_stat_bn_pow_vb.err_info_stat.err_sym fmy_stat_bn_pow_gen.ctr_abc fmy_stat_bn_pow_gen.ctr_end_diag fmy_stat_bn_pow_gen.err_info_stat.lv_err_mem fmy_stat_bn_pow_gen.err_info_stat.lv_ready fmy_stat_bn_pow_gen.err_info_stat.lv_end_diag fmy_stat_bn_pow_gen.err_info_stat.lv_cdn_diag fmy_stat_bn_pow_gen.err_info_stat.err_sym fmy_stat_bn_msw.ctr_abc fmy_stat_bn_msw.ctr_end_diag fmy_stat_bn_msw.err_info_stat.lv_err_mem fmy_stat_bn_msw.err_info_stat.lv_ready fmy_stat_bn_msw.err_info_stat.lv_end_diag fmy_stat_bn_msw.err_info_stat.lv_cdn_diag fmy_stat_bn_msw.err_info_stat.err_sym fmy_stat_bn_ang_pste.ctr_abc fmy_stat_bn_ang_pste.ctr_end_diag fmy_stat_bn_ang_pste.err_info_stat.lv_err_mem fmy_stat_bn_ang_pste.err_info_stat.lv_ready fmy_stat_bn_ang_pste.err_info_stat.lv_end_diag fmy_stat_bn_ang_pste.err_info_stat.lv_cdn_diag fmy_stat_bn_ang_pste.err_info_stat.err_sym fmy_stat_bn_efp.ctr_abc fmy_stat_bn_efp.ctr_end_diag fmy_stat_bn_efp.err_info_stat.lv_err_mem fmy_stat_bn_efp.err_info_stat.lv_ready fmy_stat_bn_efp.err_info_stat.lv_end_diag fmy_stat_bn_efp.err_info_stat.lv_cdn_diag fmy_stat_bn_efp.err_info_stat.err_sym fmy_stat_load_tps_plaus.ctr_abc fmy_stat_load_tps_plaus.ctr_end_diag fmy_stat_load_tps_plaus.err_info_stat.lv_err_mem fmy_stat_load_tps_plaus.err_info_stat.lv_ready fmy_stat_load_tps_plaus.err_info_stat.lv_end_diag fmy_stat_load_tps_plaus.err_info_stat.lv_cdn_diag fmy_stat_load_tps_plaus.err_info_stat.err_sym fmy_stat_efp_crash.ctr_abc fmy_stat_efp_crash.ctr_end_diag fmy_stat_efp_crash.err_info_stat.lv_err_mem fmy_stat_efp_crash.err_info_stat.lv_ready fmy_stat_efp_crash.err_info_stat.lv_end_diag fmy_stat_efp_crash.err_info_stat.lv_cdn_diag fmy_stat_efp_crash.err_info_stat.err_sym fmy_stat_efp.ctr_abc fmy_stat_efp.ctr_end_diag fmy_stat_efp.err_info_stat.lv_err_mem fmy_stat_efp.err_info_stat.lv_ready fmy_stat_efp.err_info_stat.lv_end_diag fmy_stat_efp.err_info_stat.lv_cdn_diag fmy_stat_efp.err_info_stat.err_sym fmy_stat_locan_boff.ctr_abc fmy_stat_locan_boff.ctr_end_diag fmy_stat_locan_boff.err_info_stat.lv_err_mem fmy_stat_locan_boff.err_info_stat.lv_ready fmy_stat_locan_boff.err_info_stat.lv_end_diag fmy_stat_locan_boff.err_info_stat.lv_cdn_diag fmy_stat_locan_boff.err_info_stat.err_sym fmy_stat_chg_ls_up.ctr_abc fmy_stat_chg_ls_up.ctr_end_diag fmy_stat_chg_ls_up.err_info_stat.lv_err_mem fmy_stat_chg_ls_up.err_info_stat.lv_ready fmy_stat_chg_ls_up.err_info_stat.lv_end_diag fmy_stat_chg_ls_up.err_info_stat.lv_cdn_diag fmy_stat_chg_ls_up.err_info_stat.err_sym fmy_stat_chg_ls_down.ctr_abc fmy_stat_chg_ls_down.ctr_end_diag fmy_stat_chg_ls_down.err_info_stat.lv_err_mem fmy_stat_chg_ls_down.err_info_stat.lv_ready fmy_stat_chg_ls_down.err_info_stat.lv_end_diag fmy_stat_chg_ls_down.err_info_stat.lv_cdn_diag fmy_stat_chg_ls_down.err_info_stat.err_sym fmy_stat_qoil_sens.ctr_abc fmy_stat_qoil_sens.ctr_end_diag fmy_stat_qoil_sens.err_info_stat.lv_err_mem fmy_stat_qoil_sens.err_info_stat.lv_ready fmy_stat_qoil_sens.err_info_stat.lv_end_diag fmy_stat_qoil_sens.err_info_stat.lv_cdn_diag fmy_stat_qoil_sens.err_info_stat.err_sym fmy_stat_bat_sens.ctr_abc fmy_stat_bat_sens.ctr_end_diag fmy_stat_bat_sens.err_info_stat.lv_err_mem fmy_stat_bat_sens.err_info_stat.lv_ready fmy_stat_bat_sens.err_info_stat.lv_end_diag fmy_stat_bat_sens.err_info_stat.lv_cdn_diag fmy_stat_bat_sens.err_info_stat.err_sym fmy_stat_bat_sens_it.ctr_abc fmy_stat_bat_sens_it.ctr_end_diag fmy_stat_bat_sens_it.err_info_stat.lv_err_mem fmy_stat_bat_sens_it.err_info_stat.lv_ready fmy_stat_bat_sens_it.err_info_stat.lv_end_diag fmy_stat_bat_sens_it.err_info_stat.lv_cdn_diag fmy_stat_bat_sens_it.err_info_stat.err_sym fmy_stat_bat_sens_it_el.ctr_abc fmy_stat_bat_sens_it_el.ctr_end_diag fmy_stat_bat_sens_it_el.err_info_stat.lv_err_mem fmy_stat_bat_sens_it_el.err_info_stat.lv_ready fmy_stat_bat_sens_it_el.err_info_stat.lv_end_diag fmy_stat_bat_sens_it_el.err_info_stat.lv_cdn_diag fmy_stat_bat_sens_it_el.err_info_stat.err_sym fmy_stat_ecu_nvmy.ctr_abc fmy_stat_ecu_nvmy.ctr_end_diag fmy_stat_ecu_nvmy.err_info_stat.lv_err_mem fmy_stat_ecu_nvmy.err_info_stat.lv_ready fmy_stat_ecu_nvmy.err_info_stat.lv_end_diag fmy_stat_ecu_nvmy.err_info_stat.lv_cdn_diag fmy_stat_ecu_nvmy.err_info_stat.err_sym fmy_stat_gs.ctr_abc fmy_stat_gs.ctr_end_diag fmy_stat_gs.err_info_stat.lv_err_mem fmy_stat_gs.err_info_stat.lv_ready fmy_stat_gs.err_info_stat.lv_end_diag fmy_stat_gs.err_info_stat.lv_cdn_diag fmy_stat_gs.err_info_stat.err_sym fmy_stat_obd2_lsh_up_1.ctr_abc fmy_stat_obd2_lsh_up_1.ctr_end_diag fmy_stat_obd2_lsh_up_1.err_info_stat.lv_err_mem fmy_stat_obd2_lsh_up_1.err_info_stat.lv_ready fmy_stat_obd2_lsh_up_1.err_info_stat.lv_end_diag fmy_stat_obd2_lsh_up_1.err_info_stat.lv_cdn_diag fmy_stat_obd2_lsh_up_1.err_info_stat.err_sym fmy_stat_obd2_lsh_up_2.ctr_abc fmy_stat_obd2_lsh_up_2.ctr_end_diag fmy_stat_obd2_lsh_up_2.err_info_stat.lv_err_mem fmy_stat_obd2_lsh_up_2.err_info_stat.lv_ready fmy_stat_obd2_lsh_up_2.err_info_stat.lv_end_diag fmy_stat_obd2_lsh_up_2.err_info_stat.lv_cdn_diag fmy_stat_obd2_lsh_up_2.err_info_stat.err_sym fmy_stat_cat_diag_1.ctr_abc fmy_stat_cat_diag_1.ctr_end_diag fmy_stat_cat_diag_1.err_info_stat.lv_err_mem fmy_stat_cat_diag_1.err_info_stat.lv_ready fmy_stat_cat_diag_1.err_info_stat.lv_end_diag fmy_stat_cat_diag_1.err_info_stat.lv_cdn_diag fmy_stat_cat_diag_1.err_info_stat.err_sym fmy_stat_cat_diag_2.ctr_abc fmy_stat_cat_diag_2.ctr_end_diag fmy_stat_cat_diag_2.err_info_stat.lv_err_mem fmy_stat_cat_diag_2.err_info_stat.lv_ready fmy_stat_cat_diag_2.err_info_stat.lv_end_diag fmy_stat_cat_diag_2.err_info_stat.lv_cdn_diag fmy_stat_cat_diag_2.err_info_stat.err_sym fmy_stat_chk_ls_down_1.ctr_abc fmy_stat_chk_ls_down_1.ctr_end_diag fmy_stat_chk_ls_down_1.err_info_stat.lv_err_mem fmy_stat_chk_ls_down_1.err_info_stat.lv_ready fmy_stat_chk_ls_down_1.err_info_stat.lv_end_diag fmy_stat_chk_ls_down_1.err_info_stat.lv_cdn_diag fmy_stat_chk_ls_down_1.err_info_stat.err_sym fmy_stat_chk_ls_down_2.ctr_abc fmy_stat_chk_ls_down_2.ctr_end_diag fmy_stat_chk_ls_down_2.err_info_stat.lv_err_mem fmy_stat_chk_ls_down_2.err_info_stat.lv_ready fmy_stat_chk_ls_down_2.err_info_stat.lv_end_diag fmy_stat_chk_ls_down_2.err_info_stat.lv_cdn_diag fmy_stat_chk_ls_down_2.err_info_stat.err_sym fmy_stat_vls_up_min_cold_1.ctr_abc fmy_stat_vls_up_min_cold_1.ctr_end_diag fmy_stat_vls_up_min_cold_1.err_info_stat.lv_err_mem fmy_stat_vls_up_min_cold_1.err_info_stat.lv_ready fmy_stat_vls_up_min_cold_1.err_info_stat.lv_end_diag fmy_stat_vls_up_min_cold_1.err_info_stat.lv_cdn_diag fmy_stat_vls_up_min_cold_1.err_info_stat.err_sym fmy_stat_vls_up_min_cold_2.ctr_abc fmy_stat_vls_up_min_cold_2.ctr_end_diag fmy_stat_vls_up_min_cold_2.err_info_stat.lv_err_mem fmy_stat_vls_up_min_cold_2.err_info_stat.lv_ready fmy_stat_vls_up_min_cold_2.err_info_stat.lv_end_diag fmy_stat_vls_up_min_cold_2.err_info_stat.lv_cdn_diag fmy_stat_vls_up_min_cold_2.err_info_stat.err_sym fmy_stat_vls_up_min_1.ctr_abc fmy_stat_vls_up_min_1.ctr_end_diag fmy_stat_vls_up_min_1.err_info_stat.lv_err_mem fmy_stat_vls_up_min_1.err_info_stat.lv_ready fmy_stat_vls_up_min_1.err_info_stat.lv_end_diag fmy_stat_vls_up_min_1.err_info_stat.lv_cdn_diag fmy_stat_vls_up_min_1.err_info_stat.err_sym fmy_stat_vls_up_min_2.ctr_abc fmy_stat_vls_up_min_2.ctr_end_diag fmy_stat_vls_up_min_2.err_info_stat.lv_err_mem fmy_stat_vls_up_min_2.err_info_stat.lv_ready fmy_stat_vls_up_min_2.err_info_stat.lv_end_diag fmy_stat_vls_up_min_2.err_info_stat.lv_cdn_diag fmy_stat_vls_up_min_2.err_info_stat.err_sym fmy_stat_vls_up_max_1.ctr_abc fmy_stat_vls_up_max_1.ctr_end_diag fmy_stat_vls_up_max_1.err_info_stat.lv_err_mem fmy_stat_vls_up_max_1.err_info_stat.lv_ready fmy_stat_vls_up_max_1.err_info_stat.lv_end_diag fmy_stat_vls_up_max_1.err_info_stat.lv_cdn_diag fmy_stat_vls_up_max_1.err_info_stat.err_sym fmy_stat_vls_up_max_2.ctr_abc fmy_stat_vls_up_max_2.ctr_end_diag fmy_stat_vls_up_max_2.err_info_stat.lv_err_mem fmy_stat_vls_up_max_2.err_info_stat.lv_ready fmy_stat_vls_up_max_2.err_info_stat.lv_end_diag fmy_stat_vls_up_max_2.err_info_stat.lv_cdn_diag fmy_stat_vls_up_max_2.err_info_stat.err_sym fmy_stat_vls_up_oc_1.ctr_abc fmy_stat_vls_up_oc_1.ctr_end_diag fmy_stat_vls_up_oc_1.err_info_stat.lv_err_mem fmy_stat_vls_up_oc_1.err_info_stat.lv_ready fmy_stat_vls_up_oc_1.err_info_stat.lv_end_diag fmy_stat_vls_up_oc_1.err_info_stat.lv_cdn_diag fmy_stat_vls_up_oc_1.err_info_stat.err_sym fmy_stat_vls_up_oc_2.ctr_abc fmy_stat_vls_up_oc_2.ctr_end_diag fmy_stat_vls_up_oc_2.err_info_stat.lv_err_mem fmy_stat_vls_up_oc_2.err_info_stat.lv_ready fmy_stat_vls_up_oc_2.err_info_stat.lv_end_diag fmy_stat_vls_up_oc_2.err_info_stat.lv_cdn_diag fmy_stat_vls_up_oc_2.err_info_stat.err_sym fmy_stat_vls_up_puc_1.ctr_abc fmy_stat_vls_up_puc_1.ctr_end_diag fmy_stat_vls_up_puc_1.err_info_stat.lv_err_mem fmy_stat_vls_up_puc_1.err_info_stat.lv_ready fmy_stat_vls_up_puc_1.err_info_stat.lv_end_diag fmy_stat_vls_up_puc_1.err_info_stat.lv_cdn_diag fmy_stat_vls_up_puc_1.err_info_stat.err_sym fmy_stat_vls_up_puc_2.ctr_abc fmy_stat_vls_up_puc_2.ctr_end_diag fmy_stat_vls_up_puc_2.err_info_stat.lv_err_mem fmy_stat_vls_up_puc_2.err_info_stat.lv_ready fmy_stat_vls_up_puc_2.err_info_stat.lv_end_diag fmy_stat_vls_up_puc_2.err_info_stat.lv_cdn_diag fmy_stat_vls_up_puc_2.err_info_stat.err_sym fmy_stat_vls_up_stk_1.ctr_abc fmy_stat_vls_up_stk_1.ctr_end_diag fmy_stat_vls_up_stk_1.err_info_stat.lv_err_mem fmy_stat_vls_up_stk_1.err_info_stat.lv_ready fmy_stat_vls_up_stk_1.err_info_stat.lv_end_diag fmy_stat_vls_up_stk_1.err_info_stat.lv_cdn_diag fmy_stat_vls_up_stk_1.err_info_stat.err_sym fmy_stat_vls_up_stk_2.ctr_abc fmy_stat_vls_up_stk_2.ctr_end_diag fmy_stat_vls_up_stk_2.err_info_stat.lv_err_mem fmy_stat_vls_up_stk_2.err_info_stat.lv_ready fmy_stat_vls_up_stk_2.err_info_stat.lv_end_diag fmy_stat_vls_up_stk_2.err_info_stat.lv_cdn_diag fmy_stat_vls_up_stk_2.err_info_stat.err_sym fmy_stat_lam_dly_1.ctr_abc fmy_stat_lam_dly_1.ctr_end_diag fmy_stat_lam_dly_1.err_info_stat.lv_err_mem fmy_stat_lam_dly_1.err_info_stat.lv_ready fmy_stat_lam_dly_1.err_info_stat.lv_end_diag fmy_stat_lam_dly_1.err_info_stat.lv_cdn_diag fmy_stat_lam_dly_1.err_info_stat.err_sym fmy_stat_lam_dly_2.ctr_abc fmy_stat_lam_dly_2.ctr_end_diag fmy_stat_lam_dly_2.err_info_stat.lv_err_mem fmy_stat_lam_dly_2.err_info_stat.lv_ready fmy_stat_lam_dly_2.err_info_stat.lv_end_diag fmy_stat_lam_dly_2.err_info_stat.lv_cdn_diag fmy_stat_lam_dly_2.err_info_stat.err_sym fmy_stat_ls_up_swt_1.ctr_abc fmy_stat_ls_up_swt_1.ctr_end_diag fmy_stat_ls_up_swt_1.err_info_stat.lv_err_mem fmy_stat_ls_up_swt_1.err_info_stat.lv_ready fmy_stat_ls_up_swt_1.err_info_stat.lv_end_diag fmy_stat_ls_up_swt_1.err_info_stat.lv_cdn_diag fmy_stat_ls_up_swt_1.err_info_stat.err_sym fmy_stat_ls_up_swt_2.ctr_abc fmy_stat_ls_up_swt_2.ctr_end_diag fmy_stat_ls_up_swt_2.err_info_stat.lv_err_mem fmy_stat_ls_up_swt_2.err_info_stat.lv_ready fmy_stat_ls_up_swt_2.err_info_stat.lv_end_diag fmy_stat_ls_up_swt_2.err_info_stat.lv_cdn_diag fmy_stat_ls_up_swt_2.err_info_stat.err_sym fmy_stat_ls_up_frq_1.ctr_abc fmy_stat_ls_up_frq_1.ctr_end_diag fmy_stat_ls_up_frq_1.err_info_stat.lv_err_mem fmy_stat_ls_up_frq_1.err_info_stat.lv_ready fmy_stat_ls_up_frq_1.err_info_stat.lv_end_diag fmy_stat_ls_up_frq_1.err_info_stat.lv_cdn_diag fmy_stat_ls_up_frq_1.err_info_stat.err_sym fmy_stat_ls_up_frq_2.ctr_abc fmy_stat_ls_up_frq_2.ctr_end_diag fmy_stat_ls_up_frq_2.err_info_stat.lv_err_mem fmy_stat_ls_up_frq_2.err_info_stat.lv_ready fmy_stat_ls_up_frq_2.err_info_stat.lv_end_diag fmy_stat_ls_up_frq_2.err_info_stat.lv_cdn_diag fmy_stat_ls_up_frq_2.err_info_stat.err_sym /end OUT_MEASUREMENT
/end FUNCTION
/begin FUNCTION DIA_Torque_Request_for_Safety_Di "_Torque Request for Safety Diagnosis" /begin OUT_MEASUREMENT lv_err_tqi_lim /end OUT_MEASUREMENT /end FUNCTION
/begin FUNCTION DIA_E_box_cooling_fan_diagnosis "_E-box cooling fan diagnosis" /begin OUT_MEASUREMENT lv_err_ebox_cfa /end OUT_MEASUREMENT /end FUNCTION
/begin FUNCTION DIA_ECU_temperature_sensor_diagn "_ECU temperature sensor diagnosis" /begin DEF_CHARACTERISTIC c_tia_max_tecu_diag c_v_tecu_min_diag c_v_tecu_max_diag /end DEF_CHARACTERISTIC /begin OUT_MEASUREMENT lv_err_tecu /end OUT_MEASUREMENT /end FUNCTION
/end MODULE
/end PROJECT
