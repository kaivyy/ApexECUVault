ASAP2_VERSION 1 41
/begin PROJECT MSD85 "Spray Guided DI-System with Piezo Injectors for 8-Cylinder"
/begin HEADER "_default_HeaderComment" PROJECT_NO _91 /end HEADER
/begin MODULE _default_ModuleName "_default_ModuleLongIdentifier"
/begin MOD_COMMON "_default_ModCommonComment" DEPOSIT ABSOLUTE BYTE_ORDER MSB_LAST ALIGNMENT_BYTE 1 ALIGNMENT_WORD 2 ALIGNMENT_LONG 2 ALIGNMENT_FLOAT32_IEEE 2 ALIGNMENT_FLOAT64_IEEE 4 /end MOD_COMMON
/begin AXIS_PTS ldpm_prs_dec_inj_1_injr "" 0xa08062c8 prs_dec_inj_1_hom _REC_AXS_20_u2 347776. _CNV_A_R_LINEAR_____171_CM 6 0. 347776. FORMAT "%8.1" /end AXIS_PTS
/begin MEASUREMENT inh_iv "Shut off pattern for static cylinder shut off (fixed cylinder allocation)" UBYTE _CNV_A_R_LINEAR_____0_CM 1 100. 0. 255. DISPLAY_IDENTIFIER INH_IV ECU_ADDRESS 0xd000762e FORMAT "%3.0" /end MEASUREMENT
/begin MEASUREMENT inh_swi_iv "Shut off pattern for dynamic cylinder shut off" UWORD _CNV_A_R_LINEAR_____0_CM 1 100. 0. 65535. DISPLAY_IDENTIFIER INH_SWI_IV ECU_ADDRESS 0xd000702e FORMAT "%5.0" /end MEASUREMENT
/begin MEASUREMENT inh_iv_igk "Shut off pattern of IGK" UBYTE _CNV_A_R_LINEAR_____0_CM 1 100. 0. 255. DISPLAY_IDENTIFIER INH_IV_IGK ECU_ADDRESS 0xd0003364 FORMAT "%3.0" /end MEASUREMENT
/begin MEASUREMENT inh_iv_puc "Shut off pattern of pull fuel shut off " UBYTE _CNV_A_R_LINEAR_____0_CM 1 100. 0. 255. DISPLAY_IDENTIFIER INH_IV_PUC ECU_ADDRESS 0xd0003368 FORMAT "%3.0" /end MEASUREMENT
/begin MEASUREMENT inh_iv_mon "Shut off pattern of shut off request by monitoring concept " UBYTE _CNV_A_R_LINEAR_____0_CM 1 100. 0. 255. DISPLAY_IDENTIFIER INH_IV_MON ECU_ADDRESS 0xd0003366 FORMAT "%3.0" /end MEASUREMENT
/begin MEASUREMENT nr_pat "Index corresponding to the highest shut off level (fuel shut off with pattern)" UBYTE _CNV_A_R_LINEAR_____0_CM 1 100. 0. 255. DISPLAY_IDENTIFIER NR_PAT ECU_ADDRESS 0xd0007639 FORMAT "%3.0" /end MEASUREMENT
/begin MEASUREMENT sum_inh_iv "Sum of INH_IV" UBYTE _CNV_A_R_LINEAR_____0_CM 1 100. 0. 8. DISPLAY_IDENTIFIER SUM_INH_IV ECU_ADDRESS 0xd0007650 FORMAT "%3.0" /end MEASUREMENT
/begin CHARACTERISTIC id_inh_swi_iv "Cylinder shut-off pattern for dynamic cylinder shut off" CURVE 0xa08062d8 _REC_CUR_20_u2_u1 65535. _CNV_A_R_LINEAR_____0_CM 0. 65535. DISPLAY_IDENTIFIER ID_INH_SWI_IV FORMAT "%5.0"
 /begin AXIS_DESCR COM_AXIS nr_pat _CNV_A_R_LINEAR_____0_CM 17 0. 255. READ_ONLY FORMAT "%3.0" AXIS_PTS_REF ldp_nr_pat_id_inh_swi_iv /end AXIS_DESCR
/end CHARACTERISTIC
/begin AXIS_PTS ldp_nr_pat_id_inh_swi_iv "" 0xa0806178 nr_pat _REC_AXS_20_u1 255. _CNV_A_R_LINEAR_____0_CM 17 0. 255. READ_ONLY FORMAT "%3.0" /end AXIS_PTS
/begin MEASUREMENT inh_inj "Sum pattern of cylinder shut off information (fixed cylinder allocation)" UBYTE _CNV_A_R_LINEAR_____0_CM 1 100. 0. 255. DISPLAY_IDENTIFIER INH_INJ ECU_ADDRESS 0xd000762d FORMAT "%3.0" /end MEASUREMENT
/begin MEASUREMENT sum_inh_inj "Sum of INH_INJ" UBYTE _CNV_A_R_LINEAR_____0_CM 1 100. 0. 8. DISPLAY_IDENTIFIER SUM_INH_INJ ECU_ADDRESS 0xd000764f FORMAT "%3.0" /end MEASUREMENT
/begin MEASUREMENT lv_inj_cut "All cylinders are shut off" UBYTE _CNV_S_2_RANGE__0___1_CM 1 100. 0. 1. DISPLAY_IDENTIFIER LV_INJ_CUT ECU_ADDRESS 0xd000767a BIT_MASK 0x1 /end MEASUREMENT
/begin MEASUREMENT lv_fcut_ind "At least one cylinder is shut off" UBYTE _CNV_S_2_RANGE__0___1_CM 1 100. 0. 1. DISPLAY_IDENTIFIER LV_FCUT_IND ECU_ADDRESS 0xd0007677 BIT_MASK 0x1 /end MEASUREMENT
/begin MEASUREMENT sum_inh_iv_dyn "Sum of INH_IV_DYN" UBYTE _CNV_A_R_LINEAR_____0_CM 1 100. 0. 8. DISPLAY_IDENTIFIER SUM_INH_IV_DYN ECU_ADDRESS 0xd0007651 FORMAT "%3.0" /end MEASUREMENT
/begin MEASUREMENT inh_iv_n_max_req_fcut "Shut off pattern of LV_N_MAX_REQ_FCUT (engine speed limitation)" UBYTE _CNV_A_R_LINEAR_____0_CM 1 100. 0. 255. DISPLAY_IDENTIFIER INH_IV_N_MAX_REQ_FCUT ECU_ADDRESS 0xd0003367 FORMAT "%3.0" /end MEASUREMENT
/begin CHARACTERISTIC lc_swi_mod_inh_iv_dyn "Mode switch between different dynamic fuel shut off algorithm" VALUE 0xa08065ea _REC_VAL_20_u1 1. _CNV_A_R_LINEAR_____0_CM 0. 1. DISPLAY_IDENTIFIER LC_SWI_MOD_INH_IV_DYN FORMAT "%1.0" /end CHARACTERISTIC
/begin MEASUREMENT state_inh_iv_dyn "State of the dynamic cylinder shut off request" ULONG _CNV_A_R_LINEAR_____0_CM 1 100. 0. 4294967295. DISPLAY_IDENTIFIER STATE_INH_IV_DYN ECU_ADDRESS 0xd0005fe4 FORMAT "%10.0" /end MEASUREMENT
/begin MEASUREMENT prev_state_iv "Bit coded byte which indicates whether a cylinder was deactivated or not" UBYTE _CNV_A_R_LINEAR_____0_CM 1 100. 0. 255. DISPLAY_IDENTIFIER PREV_STATE_IV ECU_ADDRESS 0xd000763a FORMAT "%3.0" /end MEASUREMENT
/begin MEASUREMENT lv_inj_upd_trm "Flag which indicates that at least one data set was sent to I/O-SW." UBYTE _CNV_S_2_RANGE__0___1_CM 1 100. 0. 1. DISPLAY_IDENTIFIER LV_INJ_UPD_TRM ECU_ADDRESS 0xd00033a9 BIT_MASK 0x1 /end MEASUREMENT
/begin MEASUREMENT lv_st_inj "Flag which indicates that the injection has started." UBYTE _CNV_S_2_RANGE__0___1_CM 1 100. 0. 1. DISPLAY_IDENTIFIER LV_ST_INJ ECU_ADDRESS 0xd000767f BIT_MASK 0x1 /end MEASUREMENT
/begin MEASUREMENT inh_iv_dyn "Shut off pattern for dynamic cylinder shut off (fixed cylinder allocation)" UBYTE _CNV_A_R_LINEAR_____0_CM 1 100. 0. 255. DISPLAY_IDENTIFIER INH_IV_DYN ECU_ADDRESS 0xd0007630 FORMAT "%3.0" /end MEASUREMENT
/begin MEASUREMENT crk_psn_eng_inj_upd "Engine position after injection data update" UWORD _CNV_A_R_LINEAR_____200_CM 1 100. 0. 720. DISPLAY_IDENTIFIER CRK_PSN_ENG_INJ_UPD ECU_ADDRESS 0xd0003298 FORMAT "%7.3" /end MEASUREMENT
/begin CHARACTERISTIC ip_fac_add_pulse "Weighting factor for additive pulses in case of injection time update at transient conditions" MAP 0xa08063b4 _REC_MAP_20_u1_u1_u1 1.9921875 _CNV_A_R_LINEAR_____103_CM 0. 1.9921875 DISPLAY_IDENTIFIER IP_FAC_ADD_PULSE FORMAT "%8.6"
 /begin AXIS_DESCR COM_AXIS n_32 _CNV_A_R_LINEAR_____10_CM 7 0. 8160. FORMAT "%4.0" AXIS_PTS_REF ldp_n_32_ip_fac_add_pulse /end AXIS_DESCR
 /begin AXIS_DESCR COM_AXIS tco _CNV_A_R_LINEAR_____17_CM 7 -48. 142.5 FORMAT "%6.2" AXIS_PTS_REF ldp_tco_ip_fac_add_pulse /end AXIS_DESCR
/end CHARACTERISTIC
/begin AXIS_PTS ldp_n_32_ip_fac_add_pulse "Weighting factor for additive pulses in case of injection time update at transient conditions" 0xa0806140 n_32 _REC_AXS_20_u1 8160. _CNV_A_R_LINEAR_____10_CM 7 0. 8160. FORMAT "%4.0" /end AXIS_PTS
/begin MEASUREMENT state_inj_typ_mem_iv "Bit coded status for active combustion mode over 720 °CRK " UBYTE _CNV_A_R_LINEAR_____0_CM 1 100. 0. 255. DISPLAY_IDENTIFIER STATE_INJ_TYP_MEM_IV ECU_ADDRESS 0xd000764d FORMAT "%3.0" /end MEASUREMENT
/begin MEASUREMENT nr_cyl_ofs_inh_iv_dyn "Cylinder offset for destination of current cylinder number for dynamic fuel shut off" UBYTE _CNV_A_R_LINEAR_____0_CM 1 100. 0. 7. DISPLAY_IDENTIFIER NR_CYL_OFS_INH_IV_DYN ECU_ADDRESS 0xd000336c FORMAT "%1.0" /end MEASUREMENT
/begin CHARACTERISTIC c_nr_cyl_ofs_inh_iv_dyn "Cylinder offset for destination of current cylinder number for dynamic fuel shut off" VALUE 0xa0806575 _REC_VAL_20_u1 7. _CNV_A_R_LINEAR_____0_CM 0. 7. DISPLAY_IDENTIFIER C_NR_CYL_OFS_INH_IV_DYN FORMAT "%1.0" /end CHARACTERISTIC
/begin MEASUREMENT nr_cyl_inj_bas "Number of the current cylinder, which has reached its CRK_INJ_BAS[x]-Event" UBYTE _CNV_A_R_LINEAR_____0_CM 1 100. 0. 7. DISPLAY_IDENTIFIER NR_CYL_INJ_BAS ECU_ADDRESS 0xd0007634 FORMAT "%1.0" /end MEASUREMENT
/begin MEASUREMENT nr_cyl_inj_bas_prev "Number of the previous cylinder, which had reached its CRK_INJ_BAS[x]-Event" UBYTE _CNV_A_R_LINEAR_____0_CM 1 100. 0. 7. DISPLAY_IDENTIFIER NR_CYL_INJ_BAS_PREV ECU_ADDRESS 0xd0007635 FORMAT "%1.0" /end MEASUREMENT
/begin CHARACTERISTIC c_soi_ext_adj "Start of injection for external adjustment (service tool intervention)  " VALUE 0xa0806584 _REC_VAL_20_u2 720. _CNV_A_R_LINEAR_____200_CM 0. 720. DISPLAY_IDENTIFIER C_SOI_EXT_ADJ FORMAT "%7.3" /end CHARACTERISTIC
/begin MEASUREMENT state_inj_mod_swi_act "State indicates a currently ongoing injection mode change, if not equal to zero" UBYTE _CNV_A_R_LINEAR_____0_CM 1 100. 0. 255. DISPLAY_IDENTIFIER STATE_INJ_MOD_SWI_ACT ECU_ADDRESS 0xd000764b FORMAT "%3.0" /end MEASUREMENT
/begin MEASUREMENT inh_iv_mis_gen_ack "Shut off pattern for shut off caused by misfire generator" UBYTE _CNV_A_R_LINEAR_____0_CM 1 100. 0. 255. DISPLAY_IDENTIFIER INH_IV_MIS_GEN_ACK ECU_ADDRESS 0xd0007632 FORMAT "%3.0" /end MEASUREMENT
/begin MEASUREMENT t_inj_crash_act "Injection valve opening time during vehicle crash" UWORD _CNV_A_R_LINEAR_____20_CM 1 100. 0. 655350. DISPLAY_IDENTIFIER T_INJ_CRASH_ACT ECU_ADDRESS 0xd0003346 FORMAT "%6.0" /end MEASUREMENT
/begin CHARACTERISTIC ip_ti_add_pulse_min "Minimum injection time for additive injection pulse, homogeneous mode" CURVE 0xa08064e8 _REC_CUR_20_u2_u2 65.535 _CNV_A_R_LINEAR_____228_CM 0. 65.535 DISPLAY_IDENTIFIER IP_TI_ADD_PULSE_MIN
 /begin AXIS_DESCR COM_AXIS prs_dec_inj_1_hom _CNV_A_R_LINEAR_____171_CM 6 0. 347776. FORMAT "%8.1" AXIS_PTS_REF ldpm_prs_dec_inj_1_injr /end AXIS_DESCR
/end CHARACTERISTIC
/begin MEASUREMENT state_inj_upd_mod_cyl_ack "Feedback from IO-software of successful data transfer" UBYTE _CNV_A_R_LINEAR_____0_CM 1 100. 0. 255. DISPLAY_IDENTIFIER STATE_INJ_UPD_MOD_CYL_ACK ECU_ADDRESS 0xd00033ad FORMAT "%3.0" /end MEASUREMENT
/begin CHARACTERISTIC lc_inj_pls_upd_mod "Logical constant for selection of injection pulse update mode" VALUE 0xa08065e6 _REC_VAL_20_u1 1. _CNV_S_2_INJR_RANGE_459_CM 0. 1. DISPLAY_IDENTIFIER LC_INJ_PLS_UPD_MOD /end CHARACTERISTIC
/begin CHARACTERISTIC ip_eoi_inj_upd_psn "End of injection position for autonomous generated update pulses" CURVE 0xa0806398 _REC_CUR_20_u2_u1 720. _CNV_A_R_LINEAR_____200_CM 0. 720. DISPLAY_IDENTIFIER IP_EOI_INJ_UPD_PSN FORMAT "%7.3"
 /begin AXIS_DESCR COM_AXIS n_32 _CNV_A_R_LINEAR_____10_CM 6 0. 8160. FORMAT "%4.0" AXIS_PTS_REF ldp_n_32_ip_eoi_inj_upd_psn /end AXIS_DESCR
/end CHARACTERISTIC
/begin AXIS_PTS ldp_n_32_ip_eoi_inj_upd_psn "End of injection position for autonomous generated update pulses" 0xa0806136 n_32 _REC_AXS_20_u1 8160. _CNV_A_R_LINEAR_____10_CM 6 0. 8160. FORMAT "%4.0" /end AXIS_PTS
/begin MEASUREMENT ctr_test_mod_iv[0] "Counter of number of injection valve actuator test cycles, cylinder individual" UBYTE _CNV_A_R_LINEAR_____0_CM 1 100. 0. 255. DISPLAY_IDENTIFIER CTR_TEST_MOD_IV[0] ECU_ADDRESS 0xd0007624 FORMAT "%3.0" /end MEASUREMENT
/begin MEASUREMENT ctr_test_mod_iv[1] "Counter of number of injection valve actuator test cycles, cylinder individual" UBYTE _CNV_A_R_LINEAR_____0_CM 1 100. 0. 255. DISPLAY_IDENTIFIER CTR_TEST_MOD_IV[1] ECU_ADDRESS 0xd0007625 FORMAT "%3.0" /end MEASUREMENT
/begin MEASUREMENT ctr_test_mod_iv[2] "Counter of number of injection valve actuator test cycles, cylinder individual" UBYTE _CNV_A_R_LINEAR_____0_CM 1 100. 0. 255. DISPLAY_IDENTIFIER CTR_TEST_MOD_IV[2] ECU_ADDRESS 0xd0007626 FORMAT "%3.0" /end MEASUREMENT
/begin MEASUREMENT ctr_test_mod_iv[3] "Counter of number of injection valve actuator test cycles, cylinder individual" UBYTE _CNV_A_R_LINEAR_____0_CM 1 100. 0. 255. DISPLAY_IDENTIFIER CTR_TEST_MOD_IV[3] ECU_ADDRESS 0xd0007627 FORMAT "%3.0" /end MEASUREMENT
/begin MEASUREMENT ctr_test_mod_iv[4] "Counter of number of injection valve actuator test cycles, cylinder individual" UBYTE _CNV_A_R_LINEAR_____0_CM 1 100. 0. 255. DISPLAY_IDENTIFIER CTR_TEST_MOD_IV[4] ECU_ADDRESS 0xd0007628 FORMAT "%3.0" /end MEASUREMENT
/begin MEASUREMENT ctr_test_mod_iv[5] "Counter of number of injection valve actuator test cycles, cylinder individual" UBYTE _CNV_A_R_LINEAR_____0_CM 1 100. 0. 255. DISPLAY_IDENTIFIER CTR_TEST_MOD_IV[5] ECU_ADDRESS 0xd0007629 FORMAT "%3.0" /end MEASUREMENT
/begin MEASUREMENT ctr_test_mod_iv[6] "Counter of number of injection valve actuator test cycles, cylinder individual" UBYTE _CNV_A_R_LINEAR_____0_CM 1 100. 0. 255. DISPLAY_IDENTIFIER CTR_TEST_MOD_IV[6] ECU_ADDRESS 0xd000762a FORMAT "%3.0" /end MEASUREMENT
/begin MEASUREMENT ctr_test_mod_iv[7] "Counter of number of injection valve actuator test cycles, cylinder individual" UBYTE _CNV_A_R_LINEAR_____0_CM 1 100. 0. 255. DISPLAY_IDENTIFIER CTR_TEST_MOD_IV[7] ECU_ADDRESS 0xd000762b FORMAT "%3.0" /end MEASUREMENT
/begin MEASUREMENT ctr_inh_iv_mis_gen[0] "Counter of number of cycles where shut off caused by misfire generator was active" UBYTE _CNV_A_R_LINEAR_____0_CM 1 100. 0. 255. DISPLAY_IDENTIFIER CTR_INH_IV_MIS_GEN[0] ECU_ADDRESS 0xd000761c FORMAT "%3.0" /end MEASUREMENT
/begin MEASUREMENT ctr_inh_iv_mis_gen[1] "Counter of number of cycles where shut off caused by misfire generator was active" UBYTE _CNV_A_R_LINEAR_____0_CM 1 100. 0. 255. DISPLAY_IDENTIFIER CTR_INH_IV_MIS_GEN[1] ECU_ADDRESS 0xd000761d FORMAT "%3.0" /end MEASUREMENT
/begin MEASUREMENT ctr_inh_iv_mis_gen[2] "Counter of number of cycles where shut off caused by misfire generator was active" UBYTE _CNV_A_R_LINEAR_____0_CM 1 100. 0. 255. DISPLAY_IDENTIFIER CTR_INH_IV_MIS_GEN[2] ECU_ADDRESS 0xd000761e FORMAT "%3.0" /end MEASUREMENT
/begin MEASUREMENT ctr_inh_iv_mis_gen[3] "Counter of number of cycles where shut off caused by misfire generator was active" UBYTE _CNV_A_R_LINEAR_____0_CM 1 100. 0. 255. DISPLAY_IDENTIFIER CTR_INH_IV_MIS_GEN[3] ECU_ADDRESS 0xd000761f FORMAT "%3.0" /end MEASUREMENT
/begin MEASUREMENT ctr_inh_iv_mis_gen[4] "Counter of number of cycles where shut off caused by misfire generator was active" UBYTE _CNV_A_R_LINEAR_____0_CM 1 100. 0. 255. DISPLAY_IDENTIFIER CTR_INH_IV_MIS_GEN[4] ECU_ADDRESS 0xd0007620 FORMAT "%3.0" /end MEASUREMENT
/begin MEASUREMENT ctr_inh_iv_mis_gen[5] "Counter of number of cycles where shut off caused by misfire generator was active" UBYTE _CNV_A_R_LINEAR_____0_CM 1 100. 0. 255. DISPLAY_IDENTIFIER CTR_INH_IV_MIS_GEN[5] ECU_ADDRESS 0xd0007621 FORMAT "%3.0" /end MEASUREMENT
/begin MEASUREMENT ctr_inh_iv_mis_gen[6] "Counter of number of cycles where shut off caused by misfire generator was active" UBYTE _CNV_A_R_LINEAR_____0_CM 1 100. 0. 255. DISPLAY_IDENTIFIER CTR_INH_IV_MIS_GEN[6] ECU_ADDRESS 0xd0007622 FORMAT "%3.0" /end MEASUREMENT
/begin MEASUREMENT ctr_inh_iv_mis_gen[7] "Counter of number of cycles where shut off caused by misfire generator was active" UBYTE _CNV_A_R_LINEAR_____0_CM 1 100. 0. 255. DISPLAY_IDENTIFIER CTR_INH_IV_MIS_GEN[7] ECU_ADDRESS 0xd0007623 FORMAT "%3.0" /end MEASUREMENT
/begin AXIS_PTS ldp_tco_ip_fac_add_pulse "Weighting factor for additive pulses in case of injection time update at transient conditions" 0xa08061d8 tco _REC_AXS_20_u1 190.5 _CNV_A_R_LINEAR_____17_CM 7 -48. 142.5 FORMAT "%6.2" /end AXIS_PTS
/begin AXIS_PTS ldp_nr_cyl_id_nr_pbk_iv_ptr "Pointer map from logical cylinder number to assigned power stage bank" 0xa080616c online_dummy _REC_AXS_20_u1 7. _CNV_A_R_LINEAR_____0_CM 8 0. 7. READ_ONLY FORMAT "%1.0" /end AXIS_PTS
/begin CHARACTERISTIC id_nr_pbk_iv_ptr "Pointer map from logical cylinder number to assigned power stage bank" CURVE 0xa08062fc _REC_CUR_20_u1_u1 7. _CNV_A_R_LINEAR_____0_CM 0. 7. DISPLAY_IDENTIFIER ID_NR_PBK_IV_PTR FORMAT "%1.0"
 /begin AXIS_DESCR COM_AXIS online_dummy _CNV_A_R_LINEAR_____0_CM 8 0. 7. READ_ONLY FORMAT "%1.0" AXIS_PTS_REF ldp_nr_cyl_id_nr_pbk_iv_ptr /end AXIS_DESCR
/end CHARACTERISTIC
/begin CHARACTERISTIC c_ducy_sp_boost_pbk_iv "Basic operating setpoint for the DCDC converter of the injection valve power stages" VALUE 0xa0806520 _REC_VAL_20_u2 100. _CNV_A_R_INJR_LINEA_460_CM 0. 100. DISPLAY_IDENTIFIER C_DUCY_SP_BOOST_PBK_IV FORMAT "%7.3" /end CHARACTERISTIC
/begin MEASUREMENT inj_mod_global "" UBYTE _CNV_S_13_INJR_RANGE_461_CM 1 100. 1. 131. DISPLAY_IDENTIFIER INJ_MOD_GLOBAL ECU_ADDRESS 0xd0007633 /end MEASUREMENT
/begin MEASUREMENT state_inj_crash_act "Injection driver state during vehicle crash request" UBYTE _CNV_A_R_LINEAR_____0_CM 1 100. 0. 255. DISPLAY_IDENTIFIER STATE_INJ_CRASH_ACT ECU_ADDRESS 0xd0003378 FORMAT "%3.0" /end MEASUREMENT
/begin MEASUREMENT state_pbk_iv_ini "State variable indicating the current status of initialization of injection vlave power stage banks" UBYTE _CNV_S_4_INJR_RANGE_462_CM 1 100. 0. 3. DISPLAY_IDENTIFIER STATE_PBK_IV_INI ECU_ADDRESS 0xd000764e /end MEASUREMENT
/begin MEASUREMENT lv_ti_3_hom_act "Logical value indicating active homogeneous injection for third pulse" UBYTE _CNV_S_2_RANGE__0___1_CM 1 100. 0. 1. DISPLAY_IDENTIFIER LV_TI_3_HOM_ACT ECU_ADDRESS 0xd00033ab /end MEASUREMENT
/begin MEASUREMENT ti_as "Global Injection Time Correction by the Application System - multiplicative" UWORD _CNV_A_R_LINEAR_____119_CM 1 100. 0. 15.999755859375 DISPLAY_IDENTIFIER TI_AS ECU_ADDRESS 0xd000709c FORMAT "%7.4" /end MEASUREMENT
/begin CHARACTERISTIC c_ti_as_global "Global injection time correction" VALUE 0xa08065cc _REC_VAL_20_u2 15.999755859375 _CNV_A_R_LINEAR_____119_CM 0. 15.999755859375 DISPLAY_IDENTIFIER C_TI_AS_GLOBAL FORMAT "%7.4" /end CHARACTERISTIC
/begin CHARACTERISTIC c_ti_add_as_global "Global Injection Time Correction - additive value" VALUE 0xa08065b4 _REC_VAL_20_s2 262.14 _CNV_A_R_LINEAR_____456_CM -131.072 131.068 DISPLAY_IDENTIFIER C_TI_ADD_AS_GLOBAL FORMAT "%8.3" /end CHARACTERISTIC
/begin CHARACTERISTIC c_ti_as[0] "Injection time factor (cylinder selective) to correct cylinder injection value" VALUE 0xa08065b8 _REC_VAL_20_u2 15.999755859375 _CNV_A_R_LINEAR_____119_CM 0. 15.999755859375 DISPLAY_IDENTIFIER C_TI_AS[0] FORMAT "%7.4" /end CHARACTERISTIC
/begin CHARACTERISTIC c_ti_as[1] "Injection time factor (cylinder selective) to correct cylinder injection value" VALUE 0xa08065ba _REC_VAL_20_u2 15.999755859375 _CNV_A_R_LINEAR_____119_CM 0. 15.999755859375 DISPLAY_IDENTIFIER C_TI_AS[1] FORMAT "%7.4" /end CHARACTERISTIC
/begin CHARACTERISTIC c_ti_as[2] "Injection time factor (cylinder selective) to correct cylinder injection value" VALUE 0xa08065bc _REC_VAL_20_u2 15.999755859375 _CNV_A_R_LINEAR_____119_CM 0. 15.999755859375 DISPLAY_IDENTIFIER C_TI_AS[2] FORMAT "%7.4" /end CHARACTERISTIC
/begin CHARACTERISTIC c_ti_as[3] "Injection time factor (cylinder selective) to correct cylinder injection value" VALUE 0xa08065be _REC_VAL_20_u2 15.999755859375 _CNV_A_R_LINEAR_____119_CM 0. 15.999755859375 DISPLAY_IDENTIFIER C_TI_AS[3] FORMAT "%7.4" /end CHARACTERISTIC
/begin CHARACTERISTIC c_ti_as[4] "Injection time factor (cylinder selective) to correct cylinder injection value" VALUE 0xa08065c0 _REC_VAL_20_u2 15.999755859375 _CNV_A_R_LINEAR_____119_CM 0. 15.999755859375 DISPLAY_IDENTIFIER C_TI_AS[4] FORMAT "%7.4" /end CHARACTERISTIC
/begin CHARACTERISTIC c_ti_as[5] "Injection time factor (cylinder selective) to correct cylinder injection value" VALUE 0xa08065c2 _REC_VAL_20_u2 15.999755859375 _CNV_A_R_LINEAR_____119_CM 0. 15.999755859375 DISPLAY_IDENTIFIER C_TI_AS[5] FORMAT "%7.4" /end CHARACTERISTIC
/begin CHARACTERISTIC c_ti_as[6] "Injection time factor (cylinder selective) to correct cylinder injection value" VALUE 0xa08065c4 _REC_VAL_20_u2 15.999755859375 _CNV_A_R_LINEAR_____119_CM 0. 15.999755859375 DISPLAY_IDENTIFIER C_TI_AS[6] FORMAT "%7.4" /end CHARACTERISTIC
/begin CHARACTERISTIC c_ti_as[7] "Injection time factor (cylinder selective) to correct cylinder injection value" VALUE 0xa08065c6 _REC_VAL_20_u2 15.999755859375 _CNV_A_R_LINEAR_____119_CM 0. 15.999755859375 DISPLAY_IDENTIFIER C_TI_AS[7] FORMAT "%7.4" /end CHARACTERISTIC
/begin CHARACTERISTIC c_ti_as_cbk_ex[0] "Injection time factor (exhaust bank selective) to correct cylinder injection value" VALUE 0xa08065c8 _REC_VAL_20_u2 15.999755859375 _CNV_A_R_LINEAR_____119_CM 0. 15.999755859375 DISPLAY_IDENTIFIER C_TI_AS_CBK_EX[0] FORMAT "%7.4" /end CHARACTERISTIC
/begin CHARACTERISTIC c_ti_as_cbk_ex[1] "Injection time factor (exhaust bank selective) to correct cylinder injection value" VALUE 0xa08065ca _REC_VAL_20_u2 15.999755859375 _CNV_A_R_LINEAR_____119_CM 0. 15.999755859375 DISPLAY_IDENTIFIER C_TI_AS_CBK_EX[1] FORMAT "%7.4" /end CHARACTERISTIC
/begin CHARACTERISTIC c_ti_add_as[0] "Cylinder selective Injection Time Correction - additive value" VALUE 0xa08065a0 _REC_VAL_20_s2 262.14 _CNV_A_R_LINEAR_____456_CM -131.072 131.068 DISPLAY_IDENTIFIER C_TI_ADD_AS[0] FORMAT "%8.3" /end CHARACTERISTIC
/begin CHARACTERISTIC c_ti_add_as[1] "Cylinder selective Injection Time Correction - additive value" VALUE 0xa08065a2 _REC_VAL_20_s2 262.14 _CNV_A_R_LINEAR_____456_CM -131.072 131.068 DISPLAY_IDENTIFIER C_TI_ADD_AS[1] FORMAT "%8.3" /end CHARACTERISTIC
/begin CHARACTERISTIC c_ti_add_as[2] "Cylinder selective Injection Time Correction - additive value" VALUE 0xa08065a4 _REC_VAL_20_s2 262.14 _CNV_A_R_LINEAR_____456_CM -131.072 131.068 DISPLAY_IDENTIFIER C_TI_ADD_AS[2] FORMAT "%8.3" /end CHARACTERISTIC
/begin CHARACTERISTIC c_ti_add_as[3] "Cylinder selective Injection Time Correction - additive value" VALUE 0xa08065a6 _REC_VAL_20_s2 262.14 _CNV_A_R_LINEAR_____456_CM -131.072 131.068 DISPLAY_IDENTIFIER C_TI_ADD_AS[3] FORMAT "%8.3" /end CHARACTERISTIC
/begin CHARACTERISTIC c_ti_add_as[4] "Cylinder selective Injection Time Correction - additive value" VALUE 0xa08065a8 _REC_VAL_20_s2 262.14 _CNV_A_R_LINEAR_____456_CM -131.072 131.068 DISPLAY_IDENTIFIER C_TI_ADD_AS[4] FORMAT "%8.3" /end CHARACTERISTIC
/begin CHARACTERISTIC c_ti_add_as[5] "Cylinder selective Injection Time Correction - additive value" VALUE 0xa08065aa _REC_VAL_20_s2 262.14 _CNV_A_R_LINEAR_____456_CM -131.072 131.068 DISPLAY_IDENTIFIER C_TI_ADD_AS[5] FORMAT "%8.3" /end CHARACTERISTIC
/begin CHARACTERISTIC c_ti_add_as[6] "Cylinder selective Injection Time Correction - additive value" VALUE 0xa08065ac _REC_VAL_20_s2 262.14 _CNV_A_R_LINEAR_____456_CM -131.072 131.068 DISPLAY_IDENTIFIER C_TI_ADD_AS[6] FORMAT "%8.3" /end CHARACTERISTIC
/begin CHARACTERISTIC c_ti_add_as[7] "Cylinder selective Injection Time Correction - additive value" VALUE 0xa08065ae _REC_VAL_20_s2 262.14 _CNV_A_R_LINEAR_____456_CM -131.072 131.068 DISPLAY_IDENTIFIER C_TI_ADD_AS[7] FORMAT "%8.3" /end CHARACTERISTIC
/begin CHARACTERISTIC c_ti_add_as_cbk_ex[0] "Exhaust bank selective Injection Time Correction - additive value" VALUE 0xa08065b0 _REC_VAL_20_s2 262.14 _CNV_A_R_LINEAR_____456_CM -131.072 131.068 DISPLAY_IDENTIFIER C_TI_ADD_AS_CBK_EX[0] FORMAT "%8.3" /end CHARACTERISTIC
/begin CHARACTERISTIC c_ti_add_as_cbk_ex[1] "Exhaust bank selective Injection Time Correction - additive value" VALUE 0xa08065b2 _REC_VAL_20_s2 262.14 _CNV_A_R_LINEAR_____456_CM -131.072 131.068 DISPLAY_IDENTIFIER C_TI_ADD_AS_CBK_EX[1] FORMAT "%8.3" /end CHARACTERISTIC
/begin CHARACTERISTIC lc_ti_as_cbk_upd_dis "Switch to disable TI_AS_CBK_EX and TI_ADD_AS_CBK_EX data update, for customer delivery it has to be 0" VALUE 0xa08065f3 _REC_VAL_20_u1 1. _CNV_A_R_LINEAR_____0_CM 0. 1. DISPLAY_IDENTIFIER LC_TI_AS_CBK_UPD_DIS FORMAT "%1.0" /end CHARACTERISTIC
/begin CHARACTERISTIC ip_fac_ti_temp_cor "factor for correction of fuel injection due to the fuel temperature" CURVE 0xa0806438 _REC_CUR_20_u2_u1 1.999755859375 _CNV_A_R_LINEAR_____119_CM 0. 1.999755859375 DISPLAY_IDENTIFIER IP_FAC_TI_TEMP_COR FORMAT "%7.4"
 /begin AXIS_DESCR COM_AXIS tfu_inj _CNV_A_R_LINEAR_____17_CM 12 -48. 142.5 FORMAT "%6.2" AXIS_PTS_REF ldp_tfu_ip_fac_ti_temp_cor /end AXIS_DESCR
/end CHARACTERISTIC
/begin MEASUREMENT fac_ti_tfu "factor for correction of fuel injection time due to a change of fuel temperature variation" UWORD _CNV_A_R_LINEAR_____119_CM 1 100. 0. 1.999755859375 DISPLAY_IDENTIFIER FAC_TI_TFU ECU_ADDRESS 0xd000702a FORMAT "%7.4" /end MEASUREMENT
/begin AXIS_PTS ldp_tfu_ip_fac_ti_temp_cor "" 0xa0806200 tfu_inj _REC_AXS_20_u1 190.5 _CNV_A_R_LINEAR_____17_CM 12 -48. 142.5 FORMAT "%6.2" /end AXIS_PTS
/begin MEASUREMENT injr.STR_INJR_IFINFTRANS0.str_injr_transfer_to_iosw.fac_add_pulse "Weighting factor for injection time update at transient conditions (additive pulse)" UBYTE _CNV_A_R_LINEAR_____103_CM 1 100. 0. 1.9921875 DISPLAY_IDENTIFIER FAC_ADD_PULSE ECU_ADDRESS 0xd0006b1c FORMAT "%8.6" /end MEASUREMENT
/begin MEASUREMENT injr.STR_INJR_IFINFTRANS0.str_injr_transfer_to_iosw.ti_add_pulse_min "Minimum injection time limitation for each injection pulse" UWORD _CNV_A_R_LINEAR_____228_CM 1 100. 0. 65.535 DISPLAY_IDENTIFIER TI_ADD_PULSE_MIN ECU_ADDRESS 0xd0006b1e /end MEASUREMENT
/begin MEASUREMENT injr.STR_INJR_IFINFTRANS0.str_injr_transfer_to_iosw.str_injr_transfer_to_iosw_cyl[0].lv_inh_inj "Flag that indicates  if cylinder shut off is active or not" UBYTE _CNV_S_2_RANGE__0___1_CM 1 100. 0. 1. DISPLAY_IDENTIFIER LV_INH_INJ[0] ECU_ADDRESS 0xd0006b20 BIT_MASK 0x1 /end MEASUREMENT
/begin MEASUREMENT injr.STR_INJR_IFINFTRANS0.str_injr_transfer_to_iosw.str_injr_transfer_to_iosw_cyl[0].lv_state_prev_iv "Cylinder individuel flag which indicates whether last injection was activated or deactivated" UBYTE _CNV_S_2_RANGE__0___1_CM 1 100. 0. 1. DISPLAY_IDENTIFIER LV_STATE_PREV_IV[0] ECU_ADDRESS 0xd0006b21 BIT_MASK 0x1 /end MEASUREMENT
/begin MEASUREMENT injr.STR_INJR_IFINFTRANS0.str_injr_transfer_to_iosw.str_injr_transfer_to_iosw_cyl[0].lv_add_pulse "Switch to enable additional injection pulse at homogeneous mode, single injection mode (injection update at transient operation)" UBYTE _CNV_S_2_RANGE__0___1_CM 1 100. 0. 1. DISPLAY_IDENTIFIER LV_ADD_PULSE[0] ECU_ADDRESS 0xd0006b22 BIT_MASK 0x1 /end MEASUREMENT
/begin MEASUREMENT injr.STR_INJR_IFINFTRANS0.str_injr_transfer_to_iosw.str_injr_transfer_to_iosw_cyl[0].inj_mod "Cylinder individual injection mode" UBYTE _CNV_S_13_INJR_RANGE_461_CM 1 100. 1. 131. DISPLAY_IDENTIFIER INJ_MOD[0] ECU_ADDRESS 0xd0006b23 /end MEASUREMENT
/begin MEASUREMENT injr.STR_INJR_IFINFTRANS0.str_injr_transfer_to_iosw.str_injr_transfer_to_iosw_cyl[0].lv_inj_mplp_cyl "Logical variable for enabling post injection, cylinder individual" UBYTE _CNV_S_2_RANGE__0___1_CM 1 100. 0. 1. DISPLAY_IDENTIFIER LV_INJ_MPLP_CYL[0] ECU_ADDRESS 0xd0006b24 /end MEASUREMENT
/begin MEASUREMENT injr.STR_INJR_IFINFTRANS0.str_injr_transfer_to_iosw.str_injr_transfer_to_iosw_cyl[0].inj_mod_sp "Injection mode set point, cylinder individual" UBYTE _CNV_S_13_INJR_RANGE_461_CM 1 100. 1. 131. DISPLAY_IDENTIFIER INJ_MOD_SP[0] ECU_ADDRESS 0xd0006b25 /end MEASUREMENT
/begin MEASUREMENT injr.STR_INJR_IFINFTRANS0.str_injr_transfer_to_iosw.str_injr_transfer_to_iosw_cyl[0].lv_inj_upd_ack "Cylinder individual flag, which indicates when a requested injection parameter update during mode switch was fulfilled. Flag switches from 0 to 1." UBYTE _CNV_S_2_RANGE__0___1_CM 1 100. 0. 1. DISPLAY_IDENTIFIER LV_INJ_UPD_ACK[0] ECU_ADDRESS 0xd0006b26 BIT_MASK 0x1 /end MEASUREMENT
/begin MEASUREMENT injr.STR_INJR_IFINFTRANS0.str_injr_transfer_to_iosw.str_injr_transfer_to_iosw_cyl[0].str_injr_transfer_to_iosw_pls[0].soi_mes "Actual performed SOI of the first injection pulse, estimated" UWORD _CNV_A_R_LINEAR_____200_CM 1 100. 0. 720. DISPLAY_IDENTIFIER SOI_1_MES[0] ECU_ADDRESS 0xd0006b28 FORMAT "%7.3" /end MEASUREMENT
/begin MEASUREMENT injr.STR_INJR_IFINFTRANS0.str_injr_transfer_to_iosw.str_injr_transfer_to_iosw_cyl[0].str_injr_transfer_to_iosw_pls[0].eoi_mes "Actual performed EOI of the first injection pulse, estimated" UWORD _CNV_A_R_LINEAR_____200_CM 1 100. 0. 720. DISPLAY_IDENTIFIER EOI_1_MES[0] ECU_ADDRESS 0xd0006b2a FORMAT "%7.3" /end MEASUREMENT
/begin MEASUREMENT injr.STR_INJR_IFINFTRANS0.str_injr_transfer_to_iosw.str_injr_transfer_to_iosw_cyl[0].str_injr_transfer_to_iosw_pls[0].cha_iv_mes "physical unit: uAs" UWORD _CNV_A_R_INJR_LINEA_463_CM 1 100. 0. 2272.6968 DISPLAY_IDENTIFIER CHA_IV_1_MES[0] ECU_ADDRESS 0xd0006b2c FORMAT "%4.0" /end MEASUREMENT
/begin MEASUREMENT injr.STR_INJR_IFINFTRANS0.str_injr_transfer_to_iosw.str_injr_transfer_to_iosw_cyl[0].str_injr_transfer_to_iosw_pls[0].v_iv_mes "Actual measured voltage of a carried out first pulse on the PIEZO injector, cylinder individual" UWORD _CNV_A_R_LINEAR_____207_CM 1 100. 0. 639.98046875 DISPLAY_IDENTIFIER V_IV_1_MES[0] ECU_ADDRESS 0xd0006b2e FORMAT "%6.2" /end MEASUREMENT
/begin MEASUREMENT injr.STR_INJR_IFINFTRANS0.str_injr_transfer_to_iosw.str_injr_transfer_to_iosw_cyl[0].str_injr_transfer_to_iosw_pls[0].ti_mes "Actual performed cylinder individual injection time, first pulse" UWORD _CNV_A_R_LINEAR_____228_CM 1 100. 0. 65.535 DISPLAY_IDENTIFIER TI_1_MES[0] ECU_ADDRESS 0xd0006b30 /end MEASUREMENT
/begin MEASUREMENT injr.STR_INJR_IFINFTRANS0.str_injr_transfer_to_iosw.str_injr_transfer_to_iosw_cyl[0].str_injr_transfer_to_iosw_pls[0].egy_iv_clc "energy inside injector calculated from measurement data, first pulse" UWORD _CNV_A_R_INJR_LINEA_432_CM 1 100. 0. 255. DISPLAY_IDENTIFIER EGY_IV_1_CLC[0] ECU_ADDRESS 0xd0006b32 FORMAT "%7.3" /end MEASUREMENT
/begin MEASUREMENT injr.STR_INJR_IFINFTRANS0.str_injr_transfer_to_iosw.str_injr_transfer_to_iosw_cyl[0].str_injr_transfer_to_iosw_pls[0].capa_iv_clc "Capacity of the piezo injector for the first pulse, calculated from measurement data" UWORD _CNV_A_R_INJR_LINEA_464_CM 1 100. 0. 27.96 DISPLAY_IDENTIFIER CAPA_IV_1_CLC[0] ECU_ADDRESS 0xd0006b34 FORMAT "%5.4" /end MEASUREMENT
/begin MEASUREMENT injr.STR_INJR_IFINFTRANS0.str_injr_transfer_to_iosw.str_injr_transfer_to_iosw_cyl[0].str_injr_transfer_to_iosw_pls[1].soi_mes "Actual performed SOI of the second injection pulse, estimated" UWORD _CNV_A_R_LINEAR_____200_CM 1 100. 0. 720. DISPLAY_IDENTIFIER SOI_2_MES[0] ECU_ADDRESS 0xd0006b38 FORMAT "%7.3" /end MEASUREMENT
/begin MEASUREMENT injr.STR_INJR_IFINFTRANS0.str_injr_transfer_to_iosw.str_injr_transfer_to_iosw_cyl[0].str_injr_transfer_to_iosw_pls[1].eoi_mes "Actual performed EOI of the second injection pulse, estimated" UWORD _CNV_A_R_LINEAR_____200_CM 1 100. 0. 720. DISPLAY_IDENTIFIER EOI_2_MES[0] ECU_ADDRESS 0xd0006b3a FORMAT "%7.3" /end MEASUREMENT
/begin MEASUREMENT injr.STR_INJR_IFINFTRANS0.str_injr_transfer_to_iosw.str_injr_transfer_to_iosw_cyl[0].str_injr_transfer_to_iosw_pls[1].cha_iv_mes "Actual measured charge value of a carried out second pulse on the piezo injector, cylinder individual" UWORD _CNV_A_R_INJR_LINEA_463_CM 1 100. 0. 2272.6968 DISPLAY_IDENTIFIER CHA_IV_2_MES[0] ECU_ADDRESS 0xd0006b3c FORMAT "%4.0" /end MEASUREMENT
/begin MEASUREMENT injr.STR_INJR_IFINFTRANS0.str_injr_transfer_to_iosw.str_injr_transfer_to_iosw_cyl[0].str_injr_transfer_to_iosw_pls[1].v_iv_mes "Actual measured voltage of a carried out second pulse on the piezo injector, cylinder individual" UWORD _CNV_A_R_LINEAR_____207_CM 1 100. 0. 639.98046875 DISPLAY_IDENTIFIER V_IV_2_MES[0] ECU_ADDRESS 0xd0006b3e FORMAT "%6.2" /end MEASUREMENT
/begin MEASUREMENT injr.STR_INJR_IFINFTRANS0.str_injr_transfer_to_iosw.str_injr_transfer_to_iosw_cyl[0].str_injr_transfer_to_iosw_pls[1].ti_mes "Actual performed cylinder individual injection time, second pulse or additional pulse" UWORD _CNV_A_R_LINEAR_____228_CM 1 100. 0. 65.535 DISPLAY_IDENTIFIER TI_2_MES[0] ECU_ADDRESS 0xd0006b40 /end MEASUREMENT
/begin MEASUREMENT injr.STR_INJR_IFINFTRANS0.str_injr_transfer_to_iosw.str_injr_transfer_to_iosw_cyl[0].str_injr_transfer_to_iosw_pls[1].egy_iv_clc "Energy inside injector calculated from measurement data for the second pulse" UWORD _CNV_A_R_INJR_LINEA_432_CM 1 100. 0. 255. DISPLAY_IDENTIFIER EGY_IV_2_CLC[0] ECU_ADDRESS 0xd0006b42 FORMAT "%7.3" /end MEASUREMENT
/begin MEASUREMENT injr.STR_INJR_IFINFTRANS0.str_injr_transfer_to_iosw.str_injr_transfer_to_iosw_cyl[0].str_injr_transfer_to_iosw_pls[1].capa_iv_clc "Capacity of the piezo injector for the second pulse, calculated from measurement data" UWORD _CNV_A_R_INJR_LINEA_464_CM 1 100. 0. 27.96 DISPLAY_IDENTIFIER CAPA_IV_2_CLC[0] ECU_ADDRESS 0xd0006b44 FORMAT "%5.4" /end MEASUREMENT
/begin MEASUREMENT injr.STR_INJR_IFINFTRANS0.str_injr_transfer_to_iosw.str_injr_transfer_to_iosw_cyl[0].str_injr_transfer_to_iosw_pls[3].soi_mes "Actual performed SOI of the post injection pulse, estimated" UWORD _CNV_A_R_LINEAR_____200_CM 1 100. 0. 720. DISPLAY_IDENTIFIER SOI_POST_MES[0] ECU_ADDRESS 0xd0006b58 FORMAT "%7.3" /end MEASUREMENT
/begin MEASUREMENT injr.STR_INJR_IFINFTRANS0.str_injr_transfer_to_iosw.str_injr_transfer_to_iosw_cyl[0].str_injr_transfer_to_iosw_pls[3].eoi_mes "Actual performed EOI of the post injection pulse, estimated" UWORD _CNV_A_R_LINEAR_____200_CM 1 100. 0. 720. DISPLAY_IDENTIFIER EOI_POST_MES[0] ECU_ADDRESS 0xd0006b5a FORMAT "%7.3" /end MEASUREMENT
/begin MEASUREMENT injr.STR_INJR_IFINFTRANS0.str_injr_transfer_to_iosw.str_injr_transfer_to_iosw_cyl[0].str_injr_transfer_to_iosw_pls[3].cha_iv_mes "Actual measured charge value of a carried out post injection pulse on the piezo injector, cylinder individual" UWORD _CNV_A_R_INJR_LINEA_463_CM 1 100. 0. 2272.6968 DISPLAY_IDENTIFIER CHA_IV_POST_MES[0] ECU_ADDRESS 0xd0006b5c FORMAT "%4.0" /end MEASUREMENT
/begin MEASUREMENT injr.STR_INJR_IFINFTRANS0.str_injr_transfer_to_iosw.str_injr_transfer_to_iosw_cyl[0].str_injr_transfer_to_iosw_pls[3].v_iv_mes "Actual measured voltage of a carried out post pulse on the piezo injector, cylinder individual" UWORD _CNV_A_R_LINEAR_____207_CM 1 100. 0. 639.98046875 DISPLAY_IDENTIFIER V_IV_POST_MES[0] ECU_ADDRESS 0xd0006b5e FORMAT "%6.2" /end MEASUREMENT
/begin MEASUREMENT injr.STR_INJR_IFINFTRANS0.str_injr_transfer_to_iosw.str_injr_transfer_to_iosw_cyl[0].str_injr_transfer_to_iosw_pls[3].ti_mes "Actual performed cylinder individual injection time, post injection pulse" UWORD _CNV_A_R_LINEAR_____228_CM 1 100. 0. 65.535 DISPLAY_IDENTIFIER TI_POST_MES[0] ECU_ADDRESS 0xd0006b60 /end MEASUREMENT
/begin MEASUREMENT injr.STR_INJR_IFINFTRANS0.str_injr_transfer_to_iosw.str_injr_transfer_to_iosw_cyl[0].str_injr_transfer_to_iosw_pls[3].egy_iv_clc "Energy inside injector calculated from measurement data for the post injection pulse" UWORD _CNV_A_R_INJR_LINEA_432_CM 1 100. 0. 255. DISPLAY_IDENTIFIER EGY_IV_POST_CLC[0] ECU_ADDRESS 0xd0006b62 FORMAT "%7.3" /end MEASUREMENT
/begin MEASUREMENT injr.STR_INJR_IFINFTRANS0.str_injr_transfer_to_iosw.str_injr_transfer_to_iosw_cyl[0].str_injr_transfer_to_iosw_pls[3].capa_iv_clc "Capacity of the piezo injector for the post injection pulse, calculated from measurement data" UWORD _CNV_A_R_INJR_LINEA_464_CM 1 100. 0. 27.96 DISPLAY_IDENTIFIER CAPA_IV_POST_CLC[0] ECU_ADDRESS 0xd0006b64 FORMAT "%5.4" /end MEASUREMENT
/begin MEASUREMENT injr.STR_INJR_IFINFTRANS0.str_injr_transfer_to_iosw.str_injr_transfer_to_iosw_cyl[0].state_err_iv_cyl_raw "Detailed error information of injection valve, cylinder individual I/O-SW raw value" UBYTE _CNV_A_R_LINEAR_____0_CM 1 100. 0. 255. DISPLAY_IDENTIFIER STATE_ERR_IV_CYL_RAW[0] ECU_ADDRESS 0xd0006b68 FORMAT "%3.0" /end MEASUREMENT
/begin MEASUREMENT injr.STR_INJR_IFINFTRANS0.str_injr_transfer_to_iosw.str_injr_transfer_to_iosw_cyl[0].cdn_diag_iv_raw "Diagnosis condition request to I/O-SW for each symptom of injector [x]" UBYTE _CNV_A_R_LINEAR_____0_CM 1 100. 0. 255. DISPLAY_IDENTIFIER CDN_DIAG_IV_RAW[0] ECU_ADDRESS 0xd0006b69 FORMAT "%3.0" /end MEASUREMENT
/begin MEASUREMENT injr.STR_INJR_IFINFTRANS0.str_injr_transfer_to_iosw.str_injr_transfer_to_iosw_cyl[1].lv_inh_inj "Flag that indicates  if cylinder shut off is active or not" UBYTE _CNV_S_2_RANGE__0___1_CM 1 100. 0. 1. DISPLAY_IDENTIFIER LV_INH_INJ[1] ECU_ADDRESS 0xd0006b6c BIT_MASK 0x1 /end MEASUREMENT
/begin MEASUREMENT injr.STR_INJR_IFINFTRANS0.str_injr_transfer_to_iosw.str_injr_transfer_to_iosw_cyl[1].lv_state_prev_iv "Cylinder individuel flag which indicates whether last injection was activated or deactivated" UBYTE _CNV_S_2_RANGE__0___1_CM 1 100. 0. 1. DISPLAY_IDENTIFIER LV_STATE_PREV_IV[1] ECU_ADDRESS 0xd0006b6d BIT_MASK 0x1 /end MEASUREMENT
/begin MEASUREMENT injr.STR_INJR_IFINFTRANS0.str_injr_transfer_to_iosw.str_injr_transfer_to_iosw_cyl[1].lv_add_pulse "Switch to enable additional injection pulse at homogeneous mode, single injection mode (injection update at transient operation)" UBYTE _CNV_S_2_RANGE__0___1_CM 1 100. 0. 1. DISPLAY_IDENTIFIER LV_ADD_PULSE[1] ECU_ADDRESS 0xd0006b6e BIT_MASK 0x1 /end MEASUREMENT
/begin MEASUREMENT injr.STR_INJR_IFINFTRANS0.str_injr_transfer_to_iosw.str_injr_transfer_to_iosw_cyl[1].inj_mod "Cylinder individual injection mode" UBYTE _CNV_S_13_INJR_RANGE_461_CM 1 100. 1. 131. DISPLAY_IDENTIFIER INJ_MOD[1] ECU_ADDRESS 0xd0006b6f /end MEASUREMENT
/begin MEASUREMENT injr.STR_INJR_IFINFTRANS0.str_injr_transfer_to_iosw.str_injr_transfer_to_iosw_cyl[1].lv_inj_mplp_cyl "Logical variable for enabling post injection, cylinder individual" UBYTE _CNV_S_2_RANGE__0___1_CM 1 100. 0. 1. DISPLAY_IDENTIFIER LV_INJ_MPLP_CYL[1] ECU_ADDRESS 0xd0006b70 /end MEASUREMENT
/begin MEASUREMENT injr.STR_INJR_IFINFTRANS0.str_injr_transfer_to_iosw.str_injr_transfer_to_iosw_cyl[1].inj_mod_sp "Injection mode set point, cylinder individual" UBYTE _CNV_S_13_INJR_RANGE_461_CM 1 100. 1. 131. DISPLAY_IDENTIFIER INJ_MOD_SP[1] ECU_ADDRESS 0xd0006b71 /end MEASUREMENT
/begin MEASUREMENT injr.STR_INJR_IFINFTRANS0.str_injr_transfer_to_iosw.str_injr_transfer_to_iosw_cyl[1].lv_inj_upd_ack "Cylinder individual flag, which indicates when a requested injection parameter update during mode switch was fulfilled. Flag switches from 0 to 1." UBYTE _CNV_S_2_RANGE__0___1_CM 1 100. 0. 1. DISPLAY_IDENTIFIER LV_INJ_UPD_ACK[1] ECU_ADDRESS 0xd0006b72 BIT_MASK 0x1 /end MEASUREMENT
/begin MEASUREMENT injr.STR_INJR_IFINFTRANS0.str_injr_transfer_to_iosw.str_injr_transfer_to_iosw_cyl[1].str_injr_transfer_to_iosw_pls[0].soi_mes "Actual performed SOI of the first injection pulse, estimated" UWORD _CNV_A_R_LINEAR_____200_CM 1 100. 0. 720. DISPLAY_IDENTIFIER SOI_1_MES[1] ECU_ADDRESS 0xd0006b74 FORMAT "%7.3" /end MEASUREMENT
/begin MEASUREMENT injr.STR_INJR_IFINFTRANS0.str_injr_transfer_to_iosw.str_injr_transfer_to_iosw_cyl[1].str_injr_transfer_to_iosw_pls[0].eoi_mes "Actual performed EOI of the first injection pulse, estimated" UWORD _CNV_A_R_LINEAR_____200_CM 1 100. 0. 720. DISPLAY_IDENTIFIER EOI_1_MES[1] ECU_ADDRESS 0xd0006b76 FORMAT "%7.3" /end MEASUREMENT
/begin MEASUREMENT injr.STR_INJR_IFINFTRANS0.str_injr_transfer_to_iosw.str_injr_transfer_to_iosw_cyl[1].str_injr_transfer_to_iosw_pls[0].cha_iv_mes "physical unit: uAs" UWORD _CNV_A_R_INJR_LINEA_463_CM 1 100. 0. 2272.6968 DISPLAY_IDENTIFIER CHA_IV_1_MES[1] ECU_ADDRESS 0xd0006b78 FORMAT "%4.0" /end MEASUREMENT
/begin MEASUREMENT injr.STR_INJR_IFINFTRANS0.str_injr_transfer_to_iosw.str_injr_transfer_to_iosw_cyl[1].str_injr_transfer_to_iosw_pls[0].v_iv_mes "Actual measured voltage of a carried out first pulse on the PIEZO injector, cylinder individual" UWORD _CNV_A_R_LINEAR_____207_CM 1 100. 0. 639.98046875 DISPLAY_IDENTIFIER V_IV_1_MES[1] ECU_ADDRESS 0xd0006b7a FORMAT "%6.2" /end MEASUREMENT
/begin MEASUREMENT injr.STR_INJR_IFINFTRANS0.str_injr_transfer_to_iosw.str_injr_transfer_to_iosw_cyl[1].str_injr_transfer_to_iosw_pls[0].ti_mes "Actual performed cylinder individual injection time, first pulse" UWORD _CNV_A_R_LINEAR_____228_CM 1 100. 0. 65.535 DISPLAY_IDENTIFIER TI_1_MES[1] ECU_ADDRESS 0xd0006b7c /end MEASUREMENT
/begin MEASUREMENT injr.STR_INJR_IFINFTRANS0.str_injr_transfer_to_iosw.str_injr_transfer_to_iosw_cyl[1].str_injr_transfer_to_iosw_pls[0].egy_iv_clc "energy inside injector calculated from measurement data, first pulse" UWORD _CNV_A_R_INJR_LINEA_432_CM 1 100. 0. 255. DISPLAY_IDENTIFIER EGY_IV_1_CLC[1] ECU_ADDRESS 0xd0006b7e FORMAT "%7.3" /end MEASUREMENT
/begin MEASUREMENT injr.STR_INJR_IFINFTRANS0.str_injr_transfer_to_iosw.str_injr_transfer_to_iosw_cyl[1].str_injr_transfer_to_iosw_pls[0].capa_iv_clc "Capacity of the piezo injector for the first pulse, calculated from measurement data" UWORD _CNV_A_R_INJR_LINEA_464_CM 1 100. 0. 27.96 DISPLAY_IDENTIFIER CAPA_IV_1_CLC[1] ECU_ADDRESS 0xd0006b80 FORMAT "%5.4" /end MEASUREMENT
/begin MEASUREMENT injr.STR_INJR_IFINFTRANS0.str_injr_transfer_to_iosw.str_injr_transfer_to_iosw_cyl[1].str_injr_transfer_to_iosw_pls[1].soi_mes "Actual performed SOI of the second injection pulse, estimated" UWORD _CNV_A_R_LINEAR_____200_CM 1 100. 0. 720. DISPLAY_IDENTIFIER SOI_2_MES[1] ECU_ADDRESS 0xd0006b84 FORMAT "%7.3" /end MEASUREMENT
/begin MEASUREMENT injr.STR_INJR_IFINFTRANS0.str_injr_transfer_to_iosw.str_injr_transfer_to_iosw_cyl[1].str_injr_transfer_to_iosw_pls[1].eoi_mes "Actual performed EOI of the second injection pulse, estimated" UWORD _CNV_A_R_LINEAR_____200_CM 1 100. 0. 720. DISPLAY_IDENTIFIER EOI_2_MES[1] ECU_ADDRESS 0xd0006b86 FORMAT "%7.3" /end MEASUREMENT
/begin MEASUREMENT injr.STR_INJR_IFINFTRANS0.str_injr_transfer_to_iosw.str_injr_transfer_to_iosw_cyl[1].str_injr_transfer_to_iosw_pls[1].cha_iv_mes "Actual measured charge value of a carried out second pulse on the piezo injector, cylinder individual" UWORD _CNV_A_R_INJR_LINEA_463_CM 1 100. 0. 2272.6968 DISPLAY_IDENTIFIER CHA_IV_2_MES[1] ECU_ADDRESS 0xd0006b88 FORMAT "%4.0" /end MEASUREMENT
/begin MEASUREMENT injr.STR_INJR_IFINFTRANS0.str_injr_transfer_to_iosw.str_injr_transfer_to_iosw_cyl[1].str_injr_transfer_to_iosw_pls[1].v_iv_mes "Actual measured voltage of a carried out second pulse on the piezo injector, cylinder individual" UWORD _CNV_A_R_LINEAR_____207_CM 1 100. 0. 639.98046875 DISPLAY_IDENTIFIER V_IV_2_MES[1] ECU_ADDRESS 0xd0006b8a FORMAT "%6.2" /end MEASUREMENT
/begin MEASUREMENT injr.STR_INJR_IFINFTRANS0.str_injr_transfer_to_iosw.str_injr_transfer_to_iosw_cyl[1].str_injr_transfer_to_iosw_pls[1].ti_mes "Actual performed cylinder individual injection time, second pulse or additional pulse" UWORD _CNV_A_R_LINEAR_____228_CM 1 100. 0. 65.535 DISPLAY_IDENTIFIER TI_2_MES[1] ECU_ADDRESS 0xd0006b8c /end MEASUREMENT
/begin MEASUREMENT injr.STR_INJR_IFINFTRANS0.str_injr_transfer_to_iosw.str_injr_transfer_to_iosw_cyl[1].str_injr_transfer_to_iosw_pls[1].egy_iv_clc "Energy inside injector calculated from measurement data for the second pulse" UWORD _CNV_A_R_INJR_LINEA_432_CM 1 100. 0. 255. DISPLAY_IDENTIFIER EGY_IV_2_CLC[1] ECU_ADDRESS 0xd0006b8e FORMAT "%7.3" /end MEASUREMENT
/begin MEASUREMENT injr.STR_INJR_IFINFTRANS0.str_injr_transfer_to_iosw.str_injr_transfer_to_iosw_cyl[1].str_injr_transfer_to_iosw_pls[1].capa_iv_clc "Capacity of the piezo injector for the second pulse, calculated from measurement data" UWORD _CNV_A_R_INJR_LINEA_464_CM 1 100. 0. 27.96 DISPLAY_IDENTIFIER CAPA_IV_2_CLC[1] ECU_ADDRESS 0xd0006b90 FORMAT "%5.4" /end MEASUREMENT
/begin MEASUREMENT injr.STR_INJR_IFINFTRANS0.str_injr_transfer_to_iosw.str_injr_transfer_to_iosw_cyl[1].str_injr_transfer_to_iosw_pls[3].soi_mes "Actual performed SOI of the post injection pulse, estimated" UWORD _CNV_A_R_LINEAR_____200_CM 1 100. 0. 720. DISPLAY_IDENTIFIER SOI_POST_MES[1] ECU_ADDRESS 0xd0006ba4 FORMAT "%7.3" /end MEASUREMENT
/begin MEASUREMENT injr.STR_INJR_IFINFTRANS0.str_injr_transfer_to_iosw.str_injr_transfer_to_iosw_cyl[1].str_injr_transfer_to_iosw_pls[3].eoi_mes "Actual performed EOI of the post injection pulse, estimated" UWORD _CNV_A_R_LINEAR_____200_CM 1 100. 0. 720. DISPLAY_IDENTIFIER EOI_POST_MES[1] ECU_ADDRESS 0xd0006ba6 FORMAT "%7.3" /end MEASUREMENT
/begin MEASUREMENT injr.STR_INJR_IFINFTRANS0.str_injr_transfer_to_iosw.str_injr_transfer_to_iosw_cyl[1].str_injr_transfer_to_iosw_pls[3].cha_iv_mes "Actual measured charge value of a carried out post injection pulse on the piezo injector, cylinder individual" UWORD _CNV_A_R_INJR_LINEA_463_CM 1 100. 0. 2272.6968 DISPLAY_IDENTIFIER CHA_IV_POST_MES[1] ECU_ADDRESS 0xd0006ba8 FORMAT "%4.0" /end MEASUREMENT
/begin MEASUREMENT injr.STR_INJR_IFINFTRANS0.str_injr_transfer_to_iosw.str_injr_transfer_to_iosw_cyl[1].str_injr_transfer_to_iosw_pls[3].v_iv_mes "Actual measured voltage of a carried out post pulse on the piezo injector, cylinder individual" UWORD _CNV_A_R_LINEAR_____207_CM 1 100. 0. 639.98046875 DISPLAY_IDENTIFIER V_IV_POST_MES[1] ECU_ADDRESS 0xd0006baa FORMAT "%6.2" /end MEASUREMENT
/begin MEASUREMENT injr.STR_INJR_IFINFTRANS0.str_injr_transfer_to_iosw.str_injr_transfer_to_iosw_cyl[1].str_injr_transfer_to_iosw_pls[3].ti_mes "Actual performed cylinder individual injection time, post injection pulse" UWORD _CNV_A_R_LINEAR_____228_CM 1 100. 0. 65.535 DISPLAY_IDENTIFIER TI_POST_MES[1] ECU_ADDRESS 0xd0006bac /end MEASUREMENT
/begin MEASUREMENT injr.STR_INJR_IFINFTRANS0.str_injr_transfer_to_iosw.str_injr_transfer_to_iosw_cyl[1].str_injr_transfer_to_iosw_pls[3].egy_iv_clc "Energy inside injector calculated from measurement data for the post injection pulse" UWORD _CNV_A_R_INJR_LINEA_432_CM 1 100. 0. 255. DISPLAY_IDENTIFIER EGY_IV_POST_CLC[1] ECU_ADDRESS 0xd0006bae FORMAT "%7.3" /end MEASUREMENT
/begin MEASUREMENT injr.STR_INJR_IFINFTRANS0.str_injr_transfer_to_iosw.str_injr_transfer_to_iosw_cyl[1].str_injr_transfer_to_iosw_pls[3].capa_iv_clc "Capacity of the piezo injector for the post injection pulse, calculated from measurement data" UWORD _CNV_A_R_INJR_LINEA_464_CM 1 100. 0. 27.96 DISPLAY_IDENTIFIER CAPA_IV_POST_CLC[1] ECU_ADDRESS 0xd0006bb0 FORMAT "%5.4" /end MEASUREMENT
/begin MEASUREMENT injr.STR_INJR_IFINFTRANS0.str_injr_transfer_to_iosw.str_injr_transfer_to_iosw_cyl[1].state_err_iv_cyl_raw "Detailed error information of injection valve, cylinder individual I/O-SW raw value" UBYTE _CNV_A_R_LINEAR_____0_CM 1 100. 0. 255. DISPLAY_IDENTIFIER STATE_ERR_IV_CYL_RAW[1] ECU_ADDRESS 0xd0006bb4 FORMAT "%3.0" /end MEASUREMENT
/begin MEASUREMENT injr.STR_INJR_IFINFTRANS0.str_injr_transfer_to_iosw.str_injr_transfer_to_iosw_cyl[1].cdn_diag_iv_raw "Diagnosis condition request to I/O-SW for each symptom of injector [x]" UBYTE _CNV_A_R_LINEAR_____0_CM 1 100. 0. 255. DISPLAY_IDENTIFIER CDN_DIAG_IV_RAW[1] ECU_ADDRESS 0xd0006bb5 FORMAT "%3.0" /end MEASUREMENT
/begin MEASUREMENT injr.STR_INJR_IFINFTRANS0.str_injr_transfer_to_iosw.str_injr_transfer_to_iosw_cyl[2].lv_inh_inj "Flag that indicates  if cylinder shut off is active or not" UBYTE _CNV_S_2_RANGE__0___1_CM 1 100. 0. 1. DISPLAY_IDENTIFIER LV_INH_INJ[2] ECU_ADDRESS 0xd0006bb8 BIT_MASK 0x1 /end MEASUREMENT
/begin MEASUREMENT injr.STR_INJR_IFINFTRANS0.str_injr_transfer_to_iosw.str_injr_transfer_to_iosw_cyl[2].lv_state_prev_iv "Cylinder individuel flag which indicates whether last injection was activated or deactivated" UBYTE _CNV_S_2_RANGE__0___1_CM 1 100. 0. 1. DISPLAY_IDENTIFIER LV_STATE_PREV_IV[2] ECU_ADDRESS 0xd0006bb9 BIT_MASK 0x1 /end MEASUREMENT
/begin MEASUREMENT injr.STR_INJR_IFINFTRANS0.str_injr_transfer_to_iosw.str_injr_transfer_to_iosw_cyl[2].lv_add_pulse "Switch to enable additional injection pulse at homogeneous mode, single injection mode (injection update at transient operation)" UBYTE _CNV_S_2_RANGE__0___1_CM 1 100. 0. 1. DISPLAY_IDENTIFIER LV_ADD_PULSE[2] ECU_ADDRESS 0xd0006bba BIT_MASK 0x1 /end MEASUREMENT
/begin MEASUREMENT injr.STR_INJR_IFINFTRANS0.str_injr_transfer_to_iosw.str_injr_transfer_to_iosw_cyl[2].inj_mod "Cylinder individual injection mode" UBYTE _CNV_S_13_INJR_RANGE_461_CM 1 100. 1. 131. DISPLAY_IDENTIFIER INJ_MOD[2] ECU_ADDRESS 0xd0006bbb /end MEASUREMENT
/begin MEASUREMENT injr.STR_INJR_IFINFTRANS0.str_injr_transfer_to_iosw.str_injr_transfer_to_iosw_cyl[2].lv_inj_mplp_cyl "Logical variable for enabling post injection, cylinder individual" UBYTE _CNV_S_2_RANGE__0___1_CM 1 100. 0. 1. DISPLAY_IDENTIFIER LV_INJ_MPLP_CYL[2] ECU_ADDRESS 0xd0006bbc /end MEASUREMENT
/begin MEASUREMENT injr.STR_INJR_IFINFTRANS0.str_injr_transfer_to_iosw.str_injr_transfer_to_iosw_cyl[2].inj_mod_sp "Injection mode set point, cylinder individual" UBYTE _CNV_S_13_INJR_RANGE_461_CM 1 100. 1. 131. DISPLAY_IDENTIFIER INJ_MOD_SP[2] ECU_ADDRESS 0xd0006bbd /end MEASUREMENT
/begin MEASUREMENT injr.STR_INJR_IFINFTRANS0.str_injr_transfer_to_iosw.str_injr_transfer_to_iosw_cyl[2].lv_inj_upd_ack "Cylinder individual flag, which indicates when a requested injection parameter update during mode switch was fulfilled. Flag switches from 0 to 1." UBYTE _CNV_S_2_RANGE__0___1_CM 1 100. 0. 1. DISPLAY_IDENTIFIER LV_INJ_UPD_ACK[2] ECU_ADDRESS 0xd0006bbe BIT_MASK 0x1 /end MEASUREMENT
/begin MEASUREMENT injr.STR_INJR_IFINFTRANS0.str_injr_transfer_to_iosw.str_injr_transfer_to_iosw_cyl[2].str_injr_transfer_to_iosw_pls[0].soi_mes "Actual performed SOI of the first injection pulse, estimated" UWORD _CNV_A_R_LINEAR_____200_CM 1 100. 0. 720. DISPLAY_IDENTIFIER SOI_1_MES[2] ECU_ADDRESS 0xd0006bc0 FORMAT "%7.3" /end MEASUREMENT
/begin MEASUREMENT injr.STR_INJR_IFINFTRANS0.str_injr_transfer_to_iosw.str_injr_transfer_to_iosw_cyl[2].str_injr_transfer_to_iosw_pls[0].eoi_mes "Actual performed EOI of the first injection pulse, estimated" UWORD _CNV_A_R_LINEAR_____200_CM 1 100. 0. 720. DISPLAY_IDENTIFIER EOI_1_MES[2] ECU_ADDRESS 0xd0006bc2 FORMAT "%7.3" /end MEASUREMENT
/begin MEASUREMENT injr.STR_INJR_IFINFTRANS0.str_injr_transfer_to_iosw.str_injr_transfer_to_iosw_cyl[2].str_injr_transfer_to_iosw_pls[0].cha_iv_mes "physical unit: uAs" UWORD _CNV_A_R_INJR_LINEA_463_CM 1 100. 0. 2272.6968 DISPLAY_IDENTIFIER CHA_IV_1_MES[2] ECU_ADDRESS 0xd0006bc4 FORMAT "%4.0" /end MEASUREMENT
/begin MEASUREMENT injr.STR_INJR_IFINFTRANS0.str_injr_transfer_to_iosw.str_injr_transfer_to_iosw_cyl[2].str_injr_transfer_to_iosw_pls[0].v_iv_mes "Actual measured voltage of a carried out first pulse on the PIEZO injector, cylinder individual" UWORD _CNV_A_R_LINEAR_____207_CM 1 100. 0. 639.98046875 DISPLAY_IDENTIFIER V_IV_1_MES[2] ECU_ADDRESS 0xd0006bc6 FORMAT "%6.2" /end MEASUREMENT
/begin MEASUREMENT injr.STR_INJR_IFINFTRANS0.str_injr_transfer_to_iosw.str_injr_transfer_to_iosw_cyl[2].str_injr_transfer_to_iosw_pls[0].ti_mes "Actual performed cylinder individual injection time, first pulse" UWORD _CNV_A_R_LINEAR_____228_CM 1 100. 0. 65.535 DISPLAY_IDENTIFIER TI_1_MES[2] ECU_ADDRESS 0xd0006bc8 /end MEASUREMENT
/begin MEASUREMENT injr.STR_INJR_IFINFTRANS0.str_injr_transfer_to_iosw.str_injr_transfer_to_iosw_cyl[2].str_injr_transfer_to_iosw_pls[0].egy_iv_clc "energy inside injector calculated from measurement data, first pulse" UWORD _CNV_A_R_INJR_LINEA_432_CM 1 100. 0. 255. DISPLAY_IDENTIFIER EGY_IV_1_CLC[2] ECU_ADDRESS 0xd0006bca FORMAT "%7.3" /end MEASUREMENT
/begin MEASUREMENT injr.STR_INJR_IFINFTRANS0.str_injr_transfer_to_iosw.str_injr_transfer_to_iosw_cyl[2].str_injr_transfer_to_iosw_pls[0].capa_iv_clc "Capacity of the piezo injector for the first pulse, calculated from measurement data" UWORD _CNV_A_R_INJR_LINEA_464_CM 1 100. 0. 27.96 DISPLAY_IDENTIFIER CAPA_IV_1_CLC[2] ECU_ADDRESS 0xd0006bcc FORMAT "%5.4" /end MEASUREMENT
/begin MEASUREMENT injr.STR_INJR_IFINFTRANS0.str_injr_transfer_to_iosw.str_injr_transfer_to_iosw_cyl[2].str_injr_transfer_to_iosw_pls[1].soi_mes "Actual performed SOI of the second injection pulse, estimated" UWORD _CNV_A_R_LINEAR_____200_CM 1 100. 0. 720. DISPLAY_IDENTIFIER SOI_2_MES[2] ECU_ADDRESS 0xd0006bd0 FORMAT "%7.3" /end MEASUREMENT
/begin MEASUREMENT injr.STR_INJR_IFINFTRANS0.str_injr_transfer_to_iosw.str_injr_transfer_to_iosw_cyl[2].str_injr_transfer_to_iosw_pls[1].eoi_mes "Actual performed EOI of the second injection pulse, estimated" UWORD _CNV_A_R_LINEAR_____200_CM 1 100. 0. 720. DISPLAY_IDENTIFIER EOI_2_MES[2] ECU_ADDRESS 0xd0006bd2 FORMAT "%7.3" /end MEASUREMENT
/begin MEASUREMENT injr.STR_INJR_IFINFTRANS0.str_injr_transfer_to_iosw.str_injr_transfer_to_iosw_cyl[2].str_injr_transfer_to_iosw_pls[1].cha_iv_mes "Actual measured charge value of a carried out second pulse on the piezo injector, cylinder individual" UWORD _CNV_A_R_INJR_LINEA_463_CM 1 100. 0. 2272.6968 DISPLAY_IDENTIFIER CHA_IV_2_MES[2] ECU_ADDRESS 0xd0006bd4 FORMAT "%4.0" /end MEASUREMENT
/begin MEASUREMENT injr.STR_INJR_IFINFTRANS0.str_injr_transfer_to_iosw.str_injr_transfer_to_iosw_cyl[2].str_injr_transfer_to_iosw_pls[1].v_iv_mes "Actual measured voltage of a carried out second pulse on the piezo injector, cylinder individual" UWORD _CNV_A_R_LINEAR_____207_CM 1 100. 0. 639.98046875 DISPLAY_IDENTIFIER V_IV_2_MES[2] ECU_ADDRESS 0xd0006bd6 FORMAT "%6.2" /end MEASUREMENT
/begin MEASUREMENT injr.STR_INJR_IFINFTRANS0.str_injr_transfer_to_iosw.str_injr_transfer_to_iosw_cyl[2].str_injr_transfer_to_iosw_pls[1].ti_mes "Actual performed cylinder individual injection time, second pulse or additional pulse" UWORD _CNV_A_R_LINEAR_____228_CM 1 100. 0. 65.535 DISPLAY_IDENTIFIER TI_2_MES[2] ECU_ADDRESS 0xd0006bd8 /end MEASUREMENT
/begin MEASUREMENT injr.STR_INJR_IFINFTRANS0.str_injr_transfer_to_iosw.str_injr_transfer_to_iosw_cyl[2].str_injr_transfer_to_iosw_pls[1].egy_iv_clc "Energy inside injector calculated from measurement data for the second pulse" UWORD _CNV_A_R_INJR_LINEA_432_CM 1 100. 0. 255. DISPLAY_IDENTIFIER EGY_IV_2_CLC[2] ECU_ADDRESS 0xd0006bda FORMAT "%7.3" /end MEASUREMENT
/begin MEASUREMENT injr.STR_INJR_IFINFTRANS0.str_injr_transfer_to_iosw.str_injr_transfer_to_iosw_cyl[2].str_injr_transfer_to_iosw_pls[1].capa_iv_clc "Capacity of the piezo injector for the second pulse, calculated from measurement data" UWORD _CNV_A_R_INJR_LINEA_464_CM 1 100. 0. 27.96 DISPLAY_IDENTIFIER CAPA_IV_2_CLC[2] ECU_ADDRESS 0xd0006bdc FORMAT "%5.4" /end MEASUREMENT
/begin MEASUREMENT injr.STR_INJR_IFINFTRANS0.str_injr_transfer_to_iosw.str_injr_transfer_to_iosw_cyl[2].str_injr_transfer_to_iosw_pls[3].soi_mes "Actual performed SOI of the post injection pulse, estimated" UWORD _CNV_A_R_LINEAR_____200_CM 1 100. 0. 720. DISPLAY_IDENTIFIER SOI_POST_MES[2] ECU_ADDRESS 0xd0006bf0 FORMAT "%7.3" /end MEASUREMENT
/begin MEASUREMENT injr.STR_INJR_IFINFTRANS0.str_injr_transfer_to_iosw.str_injr_transfer_to_iosw_cyl[2].str_injr_transfer_to_iosw_pls[3].eoi_mes "Actual performed EOI of the post injection pulse, estimated" UWORD _CNV_A_R_LINEAR_____200_CM 1 100. 0. 720. DISPLAY_IDENTIFIER EOI_POST_MES[2] ECU_ADDRESS 0xd0006bf2 FORMAT "%7.3" /end MEASUREMENT
/begin MEASUREMENT injr.STR_INJR_IFINFTRANS0.str_injr_transfer_to_iosw.str_injr_transfer_to_iosw_cyl[2].str_injr_transfer_to_iosw_pls[3].cha_iv_mes "Actual measured charge value of a carried out post injection pulse on the piezo injector, cylinder individual" UWORD _CNV_A_R_INJR_LINEA_463_CM 1 100. 0. 2272.6968 DISPLAY_IDENTIFIER CHA_IV_POST_MES[2] ECU_ADDRESS 0xd0006bf4 FORMAT "%4.0" /end MEASUREMENT
/begin MEASUREMENT injr.STR_INJR_IFINFTRANS0.str_injr_transfer_to_iosw.str_injr_transfer_to_iosw_cyl[2].str_injr_transfer_to_iosw_pls[3].v_iv_mes "Actual measured voltage of a carried out post pulse on the piezo injector, cylinder individual" UWORD _CNV_A_R_LINEAR_____207_CM 1 100. 0. 639.98046875 DISPLAY_IDENTIFIER V_IV_POST_MES[2] ECU_ADDRESS 0xd0006bf6 FORMAT "%6.2" /end MEASUREMENT
/begin MEASUREMENT injr.STR_INJR_IFINFTRANS0.str_injr_transfer_to_iosw.str_injr_transfer_to_iosw_cyl[2].str_injr_transfer_to_iosw_pls[3].ti_mes "Actual performed cylinder individual injection time, post injection pulse" UWORD _CNV_A_R_LINEAR_____228_CM 1 100. 0. 65.535 DISPLAY_IDENTIFIER TI_POST_MES[2] ECU_ADDRESS 0xd0006bf8 /end MEASUREMENT
/begin MEASUREMENT injr.STR_INJR_IFINFTRANS0.str_injr_transfer_to_iosw.str_injr_transfer_to_iosw_cyl[2].str_injr_transfer_to_iosw_pls[3].egy_iv_clc "Energy inside injector calculated from measurement data for the post injection pulse" UWORD _CNV_A_R_INJR_LINEA_432_CM 1 100. 0. 255. DISPLAY_IDENTIFIER EGY_IV_POST_CLC[2] ECU_ADDRESS 0xd0006bfa FORMAT "%7.3" /end MEASUREMENT
/begin MEASUREMENT injr.STR_INJR_IFINFTRANS0.str_injr_transfer_to_iosw.str_injr_transfer_to_iosw_cyl[2].str_injr_transfer_to_iosw_pls[3].capa_iv_clc "Capacity of the piezo injector for the post injection pulse, calculated from measurement data" UWORD _CNV_A_R_INJR_LINEA_464_CM 1 100. 0. 27.96 DISPLAY_IDENTIFIER CAPA_IV_POST_CLC[2] ECU_ADDRESS 0xd0006bfc FORMAT "%5.4" /end MEASUREMENT
/begin MEASUREMENT injr.STR_INJR_IFINFTRANS0.str_injr_transfer_to_iosw.str_injr_transfer_to_iosw_cyl[2].state_err_iv_cyl_raw "Detailed error information of injection valve, cylinder individual I/O-SW raw value" UBYTE _CNV_A_R_LINEAR_____0_CM 1 100. 0. 255. DISPLAY_IDENTIFIER STATE_ERR_IV_CYL_RAW[2] ECU_ADDRESS 0xd0006c00 FORMAT "%3.0" /end MEASUREMENT
/begin MEASUREMENT injr.STR_INJR_IFINFTRANS0.str_injr_transfer_to_iosw.str_injr_transfer_to_iosw_cyl[2].cdn_diag_iv_raw "Diagnosis condition request to I/O-SW for each symptom of injector [x]" UBYTE _CNV_A_R_LINEAR_____0_CM 1 100. 0. 255. DISPLAY_IDENTIFIER CDN_DIAG_IV_RAW[2] ECU_ADDRESS 0xd0006c01 FORMAT "%3.0" /end MEASUREMENT
/begin MEASUREMENT injr.STR_INJR_IFINFTRANS0.str_injr_transfer_to_iosw.str_injr_transfer_to_iosw_cyl[3].lv_inh_inj "Flag that indicates  if cylinder shut off is active or not" UBYTE _CNV_S_2_RANGE__0___1_CM 1 100. 0. 1. DISPLAY_IDENTIFIER LV_INH_INJ[3] ECU_ADDRESS 0xd0006c04 BIT_MASK 0x1 /end MEASUREMENT
/begin MEASUREMENT injr.STR_INJR_IFINFTRANS0.str_injr_transfer_to_iosw.str_injr_transfer_to_iosw_cyl[3].lv_state_prev_iv "Cylinder individuel flag which indicates whether last injection was activated or deactivated" UBYTE _CNV_S_2_RANGE__0___1_CM 1 100. 0. 1. DISPLAY_IDENTIFIER LV_STATE_PREV_IV[3] ECU_ADDRESS 0xd0006c05 BIT_MASK 0x1 /end MEASUREMENT
/begin MEASUREMENT injr.STR_INJR_IFINFTRANS0.str_injr_transfer_to_iosw.str_injr_transfer_to_iosw_cyl[3].lv_add_pulse "Switch to enable additional injection pulse at homogeneous mode, single injection mode (injection update at transient operation)" UBYTE _CNV_S_2_RANGE__0___1_CM 1 100. 0. 1. DISPLAY_IDENTIFIER LV_ADD_PULSE[3] ECU_ADDRESS 0xd0006c06 BIT_MASK 0x1 /end MEASUREMENT
/begin MEASUREMENT injr.STR_INJR_IFINFTRANS0.str_injr_transfer_to_iosw.str_injr_transfer_to_iosw_cyl[3].inj_mod "Cylinder individual injection mode" UBYTE _CNV_S_13_INJR_RANGE_461_CM 1 100. 1. 131. DISPLAY_IDENTIFIER INJ_MOD[3] ECU_ADDRESS 0xd0006c07 /end MEASUREMENT
/begin MEASUREMENT injr.STR_INJR_IFINFTRANS0.str_injr_transfer_to_iosw.str_injr_transfer_to_iosw_cyl[3].lv_inj_mplp_cyl "Logical variable for enabling post injection, cylinder individual" UBYTE _CNV_S_2_RANGE__0___1_CM 1 100. 0. 1. DISPLAY_IDENTIFIER LV_INJ_MPLP_CYL[3] ECU_ADDRESS 0xd0006c08 /end MEASUREMENT
/begin MEASUREMENT injr.STR_INJR_IFINFTRANS0.str_injr_transfer_to_iosw.str_injr_transfer_to_iosw_cyl[3].inj_mod_sp "Injection mode set point, cylinder individual" UBYTE _CNV_S_13_INJR_RANGE_461_CM 1 100. 1. 131. DISPLAY_IDENTIFIER INJ_MOD_SP[3] ECU_ADDRESS 0xd0006c09 /end MEASUREMENT
/begin MEASUREMENT injr.STR_INJR_IFINFTRANS0.str_injr_transfer_to_iosw.str_injr_transfer_to_iosw_cyl[3].lv_inj_upd_ack "Cylinder individual flag, which indicates when a requested injection parameter update during mode switch was fulfilled. Flag switches from 0 to 1." UBYTE _CNV_S_2_RANGE__0___1_CM 1 100. 0. 1. DISPLAY_IDENTIFIER LV_INJ_UPD_ACK[3] ECU_ADDRESS 0xd0006c0a BIT_MASK 0x1 /end MEASUREMENT
/begin MEASUREMENT injr.STR_INJR_IFINFTRANS0.str_injr_transfer_to_iosw.str_injr_transfer_to_iosw_cyl[3].str_injr_transfer_to_iosw_pls[0].soi_mes "Actual performed SOI of the first injection pulse, estimated" UWORD _CNV_A_R_LINEAR_____200_CM 1 100. 0. 720. DISPLAY_IDENTIFIER SOI_1_MES[3] ECU_ADDRESS 0xd0006c0c FORMAT "%7.3" /end MEASUREMENT
/begin MEASUREMENT injr.STR_INJR_IFINFTRANS0.str_injr_transfer_to_iosw.str_injr_transfer_to_iosw_cyl[3].str_injr_transfer_to_iosw_pls[0].eoi_mes "Actual performed EOI of the first injection pulse, estimated" UWORD _CNV_A_R_LINEAR_____200_CM 1 100. 0. 720. DISPLAY_IDENTIFIER EOI_1_MES[3] ECU_ADDRESS 0xd0006c0e FORMAT "%7.3" /end MEASUREMENT
/begin MEASUREMENT injr.STR_INJR_IFINFTRANS0.str_injr_transfer_to_iosw.str_injr_transfer_to_iosw_cyl[3].str_injr_transfer_to_iosw_pls[0].cha_iv_mes "physical unit: uAs" UWORD _CNV_A_R_INJR_LINEA_463_CM 1 100. 0. 2272.6968 DISPLAY_IDENTIFIER CHA_IV_1_MES[3] ECU_ADDRESS 0xd0006c10 FORMAT "%4.0" /end MEASUREMENT
/begin MEASUREMENT injr.STR_INJR_IFINFTRANS0.str_injr_transfer_to_iosw.str_injr_transfer_to_iosw_cyl[3].str_injr_transfer_to_iosw_pls[0].v_iv_mes "Actual measured voltage of a carried out first pulse on the PIEZO injector, cylinder individual" UWORD _CNV_A_R_LINEAR_____207_CM 1 100. 0. 639.98046875 DISPLAY_IDENTIFIER V_IV_1_MES[3] ECU_ADDRESS 0xd0006c12 FORMAT "%6.2" /end MEASUREMENT
/begin MEASUREMENT injr.STR_INJR_IFINFTRANS0.str_injr_transfer_to_iosw.str_injr_transfer_to_iosw_cyl[3].str_injr_transfer_to_iosw_pls[0].ti_mes "Actual performed cylinder individual injection time, first pulse" UWORD _CNV_A_R_LINEAR_____228_CM 1 100. 0. 65.535 DISPLAY_IDENTIFIER TI_1_MES[3] ECU_ADDRESS 0xd0006c14 /end MEASUREMENT
/begin MEASUREMENT injr.STR_INJR_IFINFTRANS0.str_injr_transfer_to_iosw.str_injr_transfer_to_iosw_cyl[3].str_injr_transfer_to_iosw_pls[0].egy_iv_clc "energy inside injector calculated from measurement data, first pulse" UWORD _CNV_A_R_INJR_LINEA_432_CM 1 100. 0. 255. DISPLAY_IDENTIFIER EGY_IV_1_CLC[3] ECU_ADDRESS 0xd0006c16 FORMAT "%7.3" /end MEASUREMENT
/begin MEASUREMENT injr.STR_INJR_IFINFTRANS0.str_injr_transfer_to_iosw.str_injr_transfer_to_iosw_cyl[3].str_injr_transfer_to_iosw_pls[0].capa_iv_clc "Capacity of the piezo injector for the first pulse, calculated from measurement data" UWORD _CNV_A_R_INJR_LINEA_464_CM 1 100. 0. 27.96 DISPLAY_IDENTIFIER CAPA_IV_1_CLC[3] ECU_ADDRESS 0xd0006c18 FORMAT "%5.4" /end MEASUREMENT
/begin MEASUREMENT injr.STR_INJR_IFINFTRANS0.str_injr_transfer_to_iosw.str_injr_transfer_to_iosw_cyl[3].str_injr_transfer_to_iosw_pls[1].soi_mes "Actual performed SOI of the second injection pulse, estimated" UWORD _CNV_A_R_LINEAR_____200_CM 1 100. 0. 720. DISPLAY_IDENTIFIER SOI_2_MES[3] ECU_ADDRESS 0xd0006c1c FORMAT "%7.3" /end MEASUREMENT
/begin MEASUREMENT injr.STR_INJR_IFINFTRANS0.str_injr_transfer_to_iosw.str_injr_transfer_to_iosw_cyl[3].str_injr_transfer_to_iosw_pls[1].eoi_mes "Actual performed EOI of the second injection pulse, estimated" UWORD _CNV_A_R_LINEAR_____200_CM 1 100. 0. 720. DISPLAY_IDENTIFIER EOI_2_MES[3] ECU_ADDRESS 0xd0006c1e FORMAT "%7.3" /end MEASUREMENT
/begin MEASUREMENT injr.STR_INJR_IFINFTRANS0.str_injr_transfer_to_iosw.str_injr_transfer_to_iosw_cyl[3].str_injr_transfer_to_iosw_pls[1].cha_iv_mes "Actual measured charge value of a carried out second pulse on the piezo injector, cylinder individual" UWORD _CNV_A_R_INJR_LINEA_463_CM 1 100. 0. 2272.6968 DISPLAY_IDENTIFIER CHA_IV_2_MES[3] ECU_ADDRESS 0xd0006c20 FORMAT "%4.0" /end MEASUREMENT
/begin MEASUREMENT injr.STR_INJR_IFINFTRANS0.str_injr_transfer_to_iosw.str_injr_transfer_to_iosw_cyl[3].str_injr_transfer_to_iosw_pls[1].v_iv_mes "Actual measured voltage of a carried out second pulse on the piezo injector, cylinder individual" UWORD _CNV_A_R_LINEAR_____207_CM 1 100. 0. 639.98046875 DISPLAY_IDENTIFIER V_IV_2_MES[3] ECU_ADDRESS 0xd0006c22 FORMAT "%6.2" /end MEASUREMENT
/begin MEASUREMENT injr.STR_INJR_IFINFTRANS0.str_injr_transfer_to_iosw.str_injr_transfer_to_iosw_cyl[3].str_injr_transfer_to_iosw_pls[1].ti_mes "Actual performed cylinder individual injection time, second pulse or additional pulse" UWORD _CNV_A_R_LINEAR_____228_CM 1 100. 0. 65.535 DISPLAY_IDENTIFIER TI_2_MES[3] ECU_ADDRESS 0xd0006c24 /end MEASUREMENT
/begin MEASUREMENT injr.STR_INJR_IFINFTRANS0.str_injr_transfer_to_iosw.str_injr_transfer_to_iosw_cyl[3].str_injr_transfer_to_iosw_pls[1].egy_iv_clc "Energy inside injector calculated from measurement data for the second pulse" UWORD _CNV_A_R_INJR_LINEA_432_CM 1 100. 0. 255. DISPLAY_IDENTIFIER EGY_IV_2_CLC[3] ECU_ADDRESS 0xd0006c26 FORMAT "%7.3" /end MEASUREMENT
/begin MEASUREMENT injr.STR_INJR_IFINFTRANS0.str_injr_transfer_to_iosw.str_injr_transfer_to_iosw_cyl[3].str_injr_transfer_to_iosw_pls[1].capa_iv_clc "Capacity of the piezo injector for the second pulse, calculated from measurement data" UWORD _CNV_A_R_INJR_LINEA_464_CM 1 100. 0. 27.96 DISPLAY_IDENTIFIER CAPA_IV_2_CLC[3] ECU_ADDRESS 0xd0006c28 FORMAT "%5.4" /end MEASUREMENT
/begin MEASUREMENT injr.STR_INJR_IFINFTRANS0.str_injr_transfer_to_iosw.str_injr_transfer_to_iosw_cyl[3].str_injr_transfer_to_iosw_pls[3].soi_mes "Actual performed SOI of the post injection pulse, estimated" UWORD _CNV_A_R_LINEAR_____200_CM 1 100. 0. 720. DISPLAY_IDENTIFIER SOI_POST_MES[3] ECU_ADDRESS 0xd0006c3c FORMAT "%7.3" /end MEASUREMENT
/begin MEASUREMENT injr.STR_INJR_IFINFTRANS0.str_injr_transfer_to_iosw.str_injr_transfer_to_iosw_cyl[3].str_injr_transfer_to_iosw_pls[3].eoi_mes "Actual performed EOI of the post injection pulse, estimated" UWORD _CNV_A_R_LINEAR_____200_CM 1 100. 0. 720. DISPLAY_IDENTIFIER EOI_POST_MES[3] ECU_ADDRESS 0xd0006c3e FORMAT "%7.3" /end MEASUREMENT
/begin MEASUREMENT injr.STR_INJR_IFINFTRANS0.str_injr_transfer_to_iosw.str_injr_transfer_to_iosw_cyl[3].str_injr_transfer_to_iosw_pls[3].cha_iv_mes "Actual measured charge value of a carried out post injection pulse on the piezo injector, cylinder individual" UWORD _CNV_A_R_INJR_LINEA_463_CM 1 100. 0. 2272.6968 DISPLAY_IDENTIFIER CHA_IV_POST_MES[3] ECU_ADDRESS 0xd0006c40 FORMAT "%4.0" /end MEASUREMENT
/begin MEASUREMENT injr.STR_INJR_IFINFTRANS0.str_injr_transfer_to_iosw.str_injr_transfer_to_iosw_cyl[3].str_injr_transfer_to_iosw_pls[3].v_iv_mes "Actual measured voltage of a carried out post pulse on the piezo injector, cylinder individual" UWORD _CNV_A_R_LINEAR_____207_CM 1 100. 0. 639.98046875 DISPLAY_IDENTIFIER V_IV_POST_MES[3] ECU_ADDRESS 0xd0006c42 FORMAT "%6.2" /end MEASUREMENT
/begin MEASUREMENT injr.STR_INJR_IFINFTRANS0.str_injr_transfer_to_iosw.str_injr_transfer_to_iosw_cyl[3].str_injr_transfer_to_iosw_pls[3].ti_mes "Actual performed cylinder individual injection time, post injection pulse" UWORD _CNV_A_R_LINEAR_____228_CM 1 100. 0. 65.535 DISPLAY_IDENTIFIER TI_POST_MES[3] ECU_ADDRESS 0xd0006c44 /end MEASUREMENT
/begin MEASUREMENT injr.STR_INJR_IFINFTRANS0.str_injr_transfer_to_iosw.str_injr_transfer_to_iosw_cyl[3].str_injr_transfer_to_iosw_pls[3].egy_iv_clc "Energy inside injector calculated from measurement data for the post injection pulse" UWORD _CNV_A_R_INJR_LINEA_432_CM 1 100. 0. 255. DISPLAY_IDENTIFIER EGY_IV_POST_CLC[3] ECU_ADDRESS 0xd0006c46 FORMAT "%7.3" /end MEASUREMENT
/begin MEASUREMENT injr.STR_INJR_IFINFTRANS0.str_injr_transfer_to_iosw.str_injr_transfer_to_iosw_cyl[3].str_injr_transfer_to_iosw_pls[3].capa_iv_clc "Capacity of the piezo injector for the post injection pulse, calculated from measurement data" UWORD _CNV_A_R_INJR_LINEA_464_CM 1 100. 0. 27.96 DISPLAY_IDENTIFIER CAPA_IV_POST_CLC[3] ECU_ADDRESS 0xd0006c48 FORMAT "%5.4" /end MEASUREMENT
/begin MEASUREMENT injr.STR_INJR_IFINFTRANS0.str_injr_transfer_to_iosw.str_injr_transfer_to_iosw_cyl[3].state_err_iv_cyl_raw "Detailed error information of injection valve, cylinder individual I/O-SW raw value" UBYTE _CNV_A_R_LINEAR_____0_CM 1 100. 0. 255. DISPLAY_IDENTIFIER STATE_ERR_IV_CYL_RAW[3] ECU_ADDRESS 0xd0006c4c FORMAT "%3.0" /end MEASUREMENT
/begin MEASUREMENT injr.STR_INJR_IFINFTRANS0.str_injr_transfer_to_iosw.str_injr_transfer_to_iosw_cyl[3].cdn_diag_iv_raw "Diagnosis condition request to I/O-SW for each symptom of injector [x]" UBYTE _CNV_A_R_LINEAR_____0_CM 1 100. 0. 255. DISPLAY_IDENTIFIER CDN_DIAG_IV_RAW[3] ECU_ADDRESS 0xd0006c4d FORMAT "%3.0" /end MEASUREMENT
/begin MEASUREMENT injr.STR_INJR_IFINFTRANS0.str_injr_transfer_to_iosw.str_injr_transfer_to_iosw_cyl[4].lv_inh_inj "Flag that indicates  if cylinder shut off is active or not" UBYTE _CNV_S_2_RANGE__0___1_CM 1 100. 0. 1. DISPLAY_IDENTIFIER LV_INH_INJ[4] ECU_ADDRESS 0xd0006c50 BIT_MASK 0x1 /end MEASUREMENT
/begin MEASUREMENT injr.STR_INJR_IFINFTRANS0.str_injr_transfer_to_iosw.str_injr_transfer_to_iosw_cyl[4].lv_state_prev_iv "Cylinder individuel flag which indicates whether last injection was activated or deactivated" UBYTE _CNV_S_2_RANGE__0___1_CM 1 100. 0. 1. DISPLAY_IDENTIFIER LV_STATE_PREV_IV[4] ECU_ADDRESS 0xd0006c51 BIT_MASK 0x1 /end MEASUREMENT
/begin MEASUREMENT injr.STR_INJR_IFINFTRANS0.str_injr_transfer_to_iosw.str_injr_transfer_to_iosw_cyl[4].lv_add_pulse "Switch to enable additional injection pulse at homogeneous mode, single injection mode (injection update at transient operation)" UBYTE _CNV_S_2_RANGE__0___1_CM 1 100. 0. 1. DISPLAY_IDENTIFIER LV_ADD_PULSE[4] ECU_ADDRESS 0xd0006c52 BIT_MASK 0x1 /end MEASUREMENT
/begin MEASUREMENT injr.STR_INJR_IFINFTRANS0.str_injr_transfer_to_iosw.str_injr_transfer_to_iosw_cyl[4].inj_mod "Cylinder individual injection mode" UBYTE _CNV_S_13_INJR_RANGE_461_CM 1 100. 1. 131. DISPLAY_IDENTIFIER INJ_MOD[4] ECU_ADDRESS 0xd0006c53 /end MEASUREMENT
/begin MEASUREMENT injr.STR_INJR_IFINFTRANS0.str_injr_transfer_to_iosw.str_injr_transfer_to_iosw_cyl[4].lv_inj_mplp_cyl "Logical variable for enabling post injection, cylinder individual" UBYTE _CNV_S_2_RANGE__0___1_CM 1 100. 0. 1. DISPLAY_IDENTIFIER LV_INJ_MPLP_CYL[4] ECU_ADDRESS 0xd0006c54 /end MEASUREMENT
/begin MEASUREMENT injr.STR_INJR_IFINFTRANS0.str_injr_transfer_to_iosw.str_injr_transfer_to_iosw_cyl[4].inj_mod_sp "Injection mode set point, cylinder individual" UBYTE _CNV_S_13_INJR_RANGE_461_CM 1 100. 1. 131. DISPLAY_IDENTIFIER INJ_MOD_SP[4] ECU_ADDRESS 0xd0006c55 /end MEASUREMENT
/begin MEASUREMENT injr.STR_INJR_IFINFTRANS0.str_injr_transfer_to_iosw.str_injr_transfer_to_iosw_cyl[4].lv_inj_upd_ack "Cylinder individual flag, which indicates when a requested injection parameter update during mode switch was fulfilled. Flag switches from 0 to 1." UBYTE _CNV_S_2_RANGE__0___1_CM 1 100. 0. 1. DISPLAY_IDENTIFIER LV_INJ_UPD_ACK[4] ECU_ADDRESS 0xd0006c56 BIT_MASK 0x1 /end MEASUREMENT
/begin MEASUREMENT injr.STR_INJR_IFINFTRANS0.str_injr_transfer_to_iosw.str_injr_transfer_to_iosw_cyl[4].str_injr_transfer_to_iosw_pls[0].soi_mes "Actual performed SOI of the first injection pulse, estimated" UWORD _CNV_A_R_LINEAR_____200_CM 1 100. 0. 720. DISPLAY_IDENTIFIER SOI_1_MES[4] ECU_ADDRESS 0xd0006c58 FORMAT "%7.3" /end MEASUREMENT
/begin MEASUREMENT injr.STR_INJR_IFINFTRANS0.str_injr_transfer_to_iosw.str_injr_transfer_to_iosw_cyl[4].str_injr_transfer_to_iosw_pls[0].eoi_mes "Actual performed EOI of the first injection pulse, estimated" UWORD _CNV_A_R_LINEAR_____200_CM 1 100. 0. 720. DISPLAY_IDENTIFIER EOI_1_MES[4] ECU_ADDRESS 0xd0006c5a FORMAT "%7.3" /end MEASUREMENT
/begin MEASUREMENT injr.STR_INJR_IFINFTRANS0.str_injr_transfer_to_iosw.str_injr_transfer_to_iosw_cyl[4].str_injr_transfer_to_iosw_pls[0].cha_iv_mes "physical unit: uAs" UWORD _CNV_A_R_INJR_LINEA_463_CM 1 100. 0. 2272.6968 DISPLAY_IDENTIFIER CHA_IV_1_MES[4] ECU_ADDRESS 0xd0006c5c FORMAT "%4.0" /end MEASUREMENT
/begin MEASUREMENT injr.STR_INJR_IFINFTRANS0.str_injr_transfer_to_iosw.str_injr_transfer_to_iosw_cyl[4].str_injr_transfer_to_iosw_pls[0].v_iv_mes "Actual measured voltage of a carried out first pulse on the PIEZO injector, cylinder individual" UWORD _CNV_A_R_LINEAR_____207_CM 1 100. 0. 639.98046875 DISPLAY_IDENTIFIER V_IV_1_MES[4] ECU_ADDRESS 0xd0006c5e FORMAT "%6.2" /end MEASUREMENT
/begin MEASUREMENT injr.STR_INJR_IFINFTRANS0.str_injr_transfer_to_iosw.str_injr_transfer_to_iosw_cyl[4].str_injr_transfer_to_iosw_pls[0].ti_mes "Actual performed cylinder individual injection time, first pulse" UWORD _CNV_A_R_LINEAR_____228_CM 1 100. 0. 65.535 DISPLAY_IDENTIFIER TI_1_MES[4] ECU_ADDRESS 0xd0006c60 /end MEASUREMENT
/begin MEASUREMENT injr.STR_INJR_IFINFTRANS0.str_injr_transfer_to_iosw.str_injr_transfer_to_iosw_cyl[4].str_injr_transfer_to_iosw_pls[0].egy_iv_clc "energy inside injector calculated from measurement data, first pulse" UWORD _CNV_A_R_INJR_LINEA_432_CM 1 100. 0. 255. DISPLAY_IDENTIFIER EGY_IV_1_CLC[4] ECU_ADDRESS 0xd0006c62 FORMAT "%7.3" /end MEASUREMENT
/begin MEASUREMENT injr.STR_INJR_IFINFTRANS0.str_injr_transfer_to_iosw.str_injr_transfer_to_iosw_cyl[4].str_injr_transfer_to_iosw_pls[0].capa_iv_clc "Capacity of the piezo injector for the first pulse, calculated from measurement data" UWORD _CNV_A_R_INJR_LINEA_464_CM 1 100. 0. 27.96 DISPLAY_IDENTIFIER CAPA_IV_1_CLC[4] ECU_ADDRESS 0xd0006c64 FORMAT "%5.4" /end MEASUREMENT
/begin MEASUREMENT injr.STR_INJR_IFINFTRANS0.str_injr_transfer_to_iosw.str_injr_transfer_to_iosw_cyl[4].str_injr_transfer_to_iosw_pls[1].soi_mes "Actual performed SOI of the second injection pulse, estimated" UWORD _CNV_A_R_LINEAR_____200_CM 1 100. 0. 720. DISPLAY_IDENTIFIER SOI_2_MES[4] ECU_ADDRESS 0xd0006c68 FORMAT "%7.3" /end MEASUREMENT
/begin MEASUREMENT injr.STR_INJR_IFINFTRANS0.str_injr_transfer_to_iosw.str_injr_transfer_to_iosw_cyl[4].str_injr_transfer_to_iosw_pls[1].eoi_mes "Actual performed EOI of the second injection pulse, estimated" UWORD _CNV_A_R_LINEAR_____200_CM 1 100. 0. 720. DISPLAY_IDENTIFIER EOI_2_MES[4] ECU_ADDRESS 0xd0006c6a FORMAT "%7.3" /end MEASUREMENT
/begin MEASUREMENT injr.STR_INJR_IFINFTRANS0.str_injr_transfer_to_iosw.str_injr_transfer_to_iosw_cyl[4].str_injr_transfer_to_iosw_pls[1].cha_iv_mes "Actual measured charge value of a carried out second pulse on the piezo injector, cylinder individual" UWORD _CNV_A_R_INJR_LINEA_463_CM 1 100. 0. 2272.6968 DISPLAY_IDENTIFIER CHA_IV_2_MES[4] ECU_ADDRESS 0xd0006c6c FORMAT "%4.0" /end MEASUREMENT
/begin MEASUREMENT injr.STR_INJR_IFINFTRANS0.str_injr_transfer_to_iosw.str_injr_transfer_to_iosw_cyl[4].str_injr_transfer_to_iosw_pls[1].v_iv_mes "Actual measured voltage of a carried out second pulse on the piezo injector, cylinder individual" UWORD _CNV_A_R_LINEAR_____207_CM 1 100. 0. 639.98046875 DISPLAY_IDENTIFIER V_IV_2_MES[4] ECU_ADDRESS 0xd0006c6e FORMAT "%6.2" /end MEASUREMENT
/begin MEASUREMENT injr.STR_INJR_IFINFTRANS0.str_injr_transfer_to_iosw.str_injr_transfer_to_iosw_cyl[4].str_injr_transfer_to_iosw_pls[1].ti_mes "Actual performed cylinder individual injection time, second pulse or additional pulse" UWORD _CNV_A_R_LINEAR_____228_CM 1 100. 0. 65.535 DISPLAY_IDENTIFIER TI_2_MES[4] ECU_ADDRESS 0xd0006c70 /end MEASUREMENT
/begin MEASUREMENT injr.STR_INJR_IFINFTRANS0.str_injr_transfer_to_iosw.str_injr_transfer_to_iosw_cyl[4].str_injr_transfer_to_iosw_pls[1].egy_iv_clc "Energy inside injector calculated from measurement data for the second pulse" UWORD _CNV_A_R_INJR_LINEA_432_CM 1 100. 0. 255. DISPLAY_IDENTIFIER EGY_IV_2_CLC[4] ECU_ADDRESS 0xd0006c72 FORMAT "%7.3" /end MEASUREMENT
/begin MEASUREMENT injr.STR_INJR_IFINFTRANS0.str_injr_transfer_to_iosw.str_injr_transfer_to_iosw_cyl[4].str_injr_transfer_to_iosw_pls[1].capa_iv_clc "Capacity of the piezo injector for the second pulse, calculated from measurement data" UWORD _CNV_A_R_INJR_LINEA_464_CM 1 100. 0. 27.96 DISPLAY_IDENTIFIER CAPA_IV_2_CLC[4] ECU_ADDRESS 0xd0006c74 FORMAT "%5.4" /end MEASUREMENT
/begin MEASUREMENT injr.STR_INJR_IFINFTRANS0.str_injr_transfer_to_iosw.str_injr_transfer_to_iosw_cyl[4].str_injr_transfer_to_iosw_pls[3].soi_mes "Actual performed SOI of the post injection pulse, estimated" UWORD _CNV_A_R_LINEAR_____200_CM 1 100. 0. 720. DISPLAY_IDENTIFIER SOI_POST_MES[4] ECU_ADDRESS 0xd0006c88 FORMAT "%7.3" /end MEASUREMENT
/begin MEASUREMENT injr.STR_INJR_IFINFTRANS0.str_injr_transfer_to_iosw.str_injr_transfer_to_iosw_cyl[4].str_injr_transfer_to_iosw_pls[3].eoi_mes "Actual performed EOI of the post injection pulse, estimated" UWORD _CNV_A_R_LINEAR_____200_CM 1 100. 0. 720. DISPLAY_IDENTIFIER EOI_POST_MES[4] ECU_ADDRESS 0xd0006c8a FORMAT "%7.3" /end MEASUREMENT
/begin MEASUREMENT injr.STR_INJR_IFINFTRANS0.str_injr_transfer_to_iosw.str_injr_transfer_to_iosw_cyl[4].str_injr_transfer_to_iosw_pls[3].cha_iv_mes "Actual measured charge value of a carried out post injection pulse on the piezo injector, cylinder individual" UWORD _CNV_A_R_INJR_LINEA_463_CM 1 100. 0. 2272.6968 DISPLAY_IDENTIFIER CHA_IV_POST_MES[4] ECU_ADDRESS 0xd0006c8c FORMAT "%4.0" /end MEASUREMENT
/begin MEASUREMENT injr.STR_INJR_IFINFTRANS0.str_injr_transfer_to_iosw.str_injr_transfer_to_iosw_cyl[4].str_injr_transfer_to_iosw_pls[3].v_iv_mes "Actual measured voltage of a carried out post pulse on the piezo injector, cylinder individual" UWORD _CNV_A_R_LINEAR_____207_CM 1 100. 0. 639.98046875 DISPLAY_IDENTIFIER V_IV_POST_MES[4] ECU_ADDRESS 0xd0006c8e FORMAT "%6.2" /end MEASUREMENT
/begin MEASUREMENT injr.STR_INJR_IFINFTRANS0.str_injr_transfer_to_iosw.str_injr_transfer_to_iosw_cyl[4].str_injr_transfer_to_iosw_pls[3].ti_mes "Actual performed cylinder individual injection time, post injection pulse" UWORD _CNV_A_R_LINEAR_____228_CM 1 100. 0. 65.535 DISPLAY_IDENTIFIER TI_POST_MES[4] ECU_ADDRESS 0xd0006c90 /end MEASUREMENT
/begin MEASUREMENT injr.STR_INJR_IFINFTRANS0.str_injr_transfer_to_iosw.str_injr_transfer_to_iosw_cyl[4].str_injr_transfer_to_iosw_pls[3].egy_iv_clc "Energy inside injector calculated from measurement data for the post injection pulse" UWORD _CNV_A_R_INJR_LINEA_432_CM 1 100. 0. 255. DISPLAY_IDENTIFIER EGY_IV_POST_CLC[4] ECU_ADDRESS 0xd0006c92 FORMAT "%7.3" /end MEASUREMENT
/begin MEASUREMENT injr.STR_INJR_IFINFTRANS0.str_injr_transfer_to_iosw.str_injr_transfer_to_iosw_cyl[4].str_injr_transfer_to_iosw_pls[3].capa_iv_clc "Capacity of the piezo injector for the post injection pulse, calculated from measurement data" UWORD _CNV_A_R_INJR_LINEA_464_CM 1 100. 0. 27.96 DISPLAY_IDENTIFIER CAPA_IV_POST_CLC[4] ECU_ADDRESS 0xd0006c94 FORMAT "%5.4" /end MEASUREMENT
/begin MEASUREMENT injr.STR_INJR_IFINFTRANS0.str_injr_transfer_to_iosw.str_injr_transfer_to_iosw_cyl[4].state_err_iv_cyl_raw "Detailed error information of injection valve, cylinder individual I/O-SW raw value" UBYTE _CNV_A_R_LINEAR_____0_CM 1 100. 0. 255. DISPLAY_IDENTIFIER STATE_ERR_IV_CYL_RAW[4] ECU_ADDRESS 0xd0006c98 FORMAT "%3.0" /end MEASUREMENT
/begin MEASUREMENT injr.STR_INJR_IFINFTRANS0.str_injr_transfer_to_iosw.str_injr_transfer_to_iosw_cyl[4].cdn_diag_iv_raw "Diagnosis condition request to I/O-SW for each symptom of injector [x]" UBYTE _CNV_A_R_LINEAR_____0_CM 1 100. 0. 255. DISPLAY_IDENTIFIER CDN_DIAG_IV_RAW[4] ECU_ADDRESS 0xd0006c99 FORMAT "%3.0" /end MEASUREMENT
/begin MEASUREMENT injr.STR_INJR_IFINFTRANS0.str_injr_transfer_to_iosw.str_injr_transfer_to_iosw_cyl[5].lv_inh_inj "Flag that indicates  if cylinder shut off is active or not" UBYTE _CNV_S_2_RANGE__0___1_CM 1 100. 0. 1. DISPLAY_IDENTIFIER LV_INH_INJ[5] ECU_ADDRESS 0xd0006c9c BIT_MASK 0x1 /end MEASUREMENT
/begin MEASUREMENT injr.STR_INJR_IFINFTRANS0.str_injr_transfer_to_iosw.str_injr_transfer_to_iosw_cyl[5].lv_state_prev_iv "Cylinder individuel flag which indicates whether last injection was activated or deactivated" UBYTE _CNV_S_2_RANGE__0___1_CM 1 100. 0. 1. DISPLAY_IDENTIFIER LV_STATE_PREV_IV[5] ECU_ADDRESS 0xd0006c9d BIT_MASK 0x1 /end MEASUREMENT
/begin MEASUREMENT injr.STR_INJR_IFINFTRANS0.str_injr_transfer_to_iosw.str_injr_transfer_to_iosw_cyl[5].lv_add_pulse "Switch to enable additional injection pulse at homogeneous mode, single injection mode (injection update at transient operation)" UBYTE _CNV_S_2_RANGE__0___1_CM 1 100. 0. 1. DISPLAY_IDENTIFIER LV_ADD_PULSE[5] ECU_ADDRESS 0xd0006c9e BIT_MASK 0x1 /end MEASUREMENT
/begin MEASUREMENT injr.STR_INJR_IFINFTRANS0.str_injr_transfer_to_iosw.str_injr_transfer_to_iosw_cyl[5].inj_mod "Cylinder individual injection mode" UBYTE _CNV_S_13_INJR_RANGE_461_CM 1 100. 1. 131. DISPLAY_IDENTIFIER INJ_MOD[5] ECU_ADDRESS 0xd0006c9f /end MEASUREMENT
/begin MEASUREMENT injr.STR_INJR_IFINFTRANS0.str_injr_transfer_to_iosw.str_injr_transfer_to_iosw_cyl[5].lv_inj_mplp_cyl "Logical variable for enabling post injection, cylinder individual" UBYTE _CNV_S_2_RANGE__0___1_CM 1 100. 0. 1. DISPLAY_IDENTIFIER LV_INJ_MPLP_CYL[5] ECU_ADDRESS 0xd0006ca0 /end MEASUREMENT
/begin MEASUREMENT injr.STR_INJR_IFINFTRANS0.str_injr_transfer_to_iosw.str_injr_transfer_to_iosw_cyl[5].inj_mod_sp "Injection mode set point, cylinder individual" UBYTE _CNV_S_13_INJR_RANGE_461_CM 1 100. 1. 131. DISPLAY_IDENTIFIER INJ_MOD_SP[5] ECU_ADDRESS 0xd0006ca1 /end MEASUREMENT
/begin MEASUREMENT injr.STR_INJR_IFINFTRANS0.str_injr_transfer_to_iosw.str_injr_transfer_to_iosw_cyl[5].lv_inj_upd_ack "Cylinder individual flag, which indicates when a requested injection parameter update during mode switch was fulfilled. Flag switches from 0 to 1." UBYTE _CNV_S_2_RANGE__0___1_CM 1 100. 0. 1. DISPLAY_IDENTIFIER LV_INJ_UPD_ACK[5] ECU_ADDRESS 0xd0006ca2 BIT_MASK 0x1 /end MEASUREMENT
/begin MEASUREMENT injr.STR_INJR_IFINFTRANS0.str_injr_transfer_to_iosw.str_injr_transfer_to_iosw_cyl[5].str_injr_transfer_to_iosw_pls[0].soi_mes "Actual performed SOI of the first injection pulse, estimated" UWORD _CNV_A_R_LINEAR_____200_CM 1 100. 0. 720. DISPLAY_IDENTIFIER SOI_1_MES[5] ECU_ADDRESS 0xd0006ca4 FORMAT "%7.3" /end MEASUREMENT
/begin MEASUREMENT injr.STR_INJR_IFINFTRANS0.str_injr_transfer_to_iosw.str_injr_transfer_to_iosw_cyl[5].str_injr_transfer_to_iosw_pls[0].eoi_mes "Actual performed EOI of the first injection pulse, estimated" UWORD _CNV_A_R_LINEAR_____200_CM 1 100. 0. 720. DISPLAY_IDENTIFIER EOI_1_MES[5] ECU_ADDRESS 0xd0006ca6 FORMAT "%7.3" /end MEASUREMENT
/begin MEASUREMENT injr.STR_INJR_IFINFTRANS0.str_injr_transfer_to_iosw.str_injr_transfer_to_iosw_cyl[5].str_injr_transfer_to_iosw_pls[0].cha_iv_mes "physical unit: uAs" UWORD _CNV_A_R_INJR_LINEA_463_CM 1 100. 0. 2272.6968 DISPLAY_IDENTIFIER CHA_IV_1_MES[5] ECU_ADDRESS 0xd0006ca8 FORMAT "%4.0" /end MEASUREMENT
/begin MEASUREMENT injr.STR_INJR_IFINFTRANS0.str_injr_transfer_to_iosw.str_injr_transfer_to_iosw_cyl[5].str_injr_transfer_to_iosw_pls[0].v_iv_mes "Actual measured voltage of a carried out first pulse on the PIEZO injector, cylinder individual" UWORD _CNV_A_R_LINEAR_____207_CM 1 100. 0. 639.98046875 DISPLAY_IDENTIFIER V_IV_1_MES[5] ECU_ADDRESS 0xd0006caa FORMAT "%6.2" /end MEASUREMENT
/begin MEASUREMENT injr.STR_INJR_IFINFTRANS0.str_injr_transfer_to_iosw.str_injr_transfer_to_iosw_cyl[5].str_injr_transfer_to_iosw_pls[0].ti_mes "Actual performed cylinder individual injection time, first pulse" UWORD _CNV_A_R_LINEAR_____228_CM 1 100. 0. 65.535 DISPLAY_IDENTIFIER TI_1_MES[5] ECU_ADDRESS 0xd0006cac /end MEASUREMENT
/begin MEASUREMENT injr.STR_INJR_IFINFTRANS0.str_injr_transfer_to_iosw.str_injr_transfer_to_iosw_cyl[5].str_injr_transfer_to_iosw_pls[0].egy_iv_clc "energy inside injector calculated from measurement data, first pulse" UWORD _CNV_A_R_INJR_LINEA_432_CM 1 100. 0. 255. DISPLAY_IDENTIFIER EGY_IV_1_CLC[5] ECU_ADDRESS 0xd0006cae FORMAT "%7.3" /end MEASUREMENT
/begin MEASUREMENT injr.STR_INJR_IFINFTRANS0.str_injr_transfer_to_iosw.str_injr_transfer_to_iosw_cyl[5].str_injr_transfer_to_iosw_pls[0].capa_iv_clc "Capacity of the piezo injector for the first pulse, calculated from measurement data" UWORD _CNV_A_R_INJR_LINEA_464_CM 1 100. 0. 27.96 DISPLAY_IDENTIFIER CAPA_IV_1_CLC[5] ECU_ADDRESS 0xd0006cb0 FORMAT "%5.4" /end MEASUREMENT
/begin MEASUREMENT injr.STR_INJR_IFINFTRANS0.str_injr_transfer_to_iosw.str_injr_transfer_to_iosw_cyl[5].str_injr_transfer_to_iosw_pls[1].soi_mes "Actual performed SOI of the second injection pulse, estimated" UWORD _CNV_A_R_LINEAR_____200_CM 1 100. 0. 720. DISPLAY_IDENTIFIER SOI_2_MES[5] ECU_ADDRESS 0xd0006cb4 FORMAT "%7.3" /end MEASUREMENT
/begin MEASUREMENT injr.STR_INJR_IFINFTRANS0.str_injr_transfer_to_iosw.str_injr_transfer_to_iosw_cyl[5].str_injr_transfer_to_iosw_pls[1].eoi_mes "Actual performed EOI of the second injection pulse, estimated" UWORD _CNV_A_R_LINEAR_____200_CM 1 100. 0. 720. DISPLAY_IDENTIFIER EOI_2_MES[5] ECU_ADDRESS 0xd0006cb6 FORMAT "%7.3" /end MEASUREMENT
/begin MEASUREMENT injr.STR_INJR_IFINFTRANS0.str_injr_transfer_to_iosw.str_injr_transfer_to_iosw_cyl[5].str_injr_transfer_to_iosw_pls[1].cha_iv_mes "Actual measured charge value of a carried out second pulse on the piezo injector, cylinder individual" UWORD _CNV_A_R_INJR_LINEA_463_CM 1 100. 0. 2272.6968 DISPLAY_IDENTIFIER CHA_IV_2_MES[5] ECU_ADDRESS 0xd0006cb8 FORMAT "%4.0" /end MEASUREMENT
/begin MEASUREMENT injr.STR_INJR_IFINFTRANS0.str_injr_transfer_to_iosw.str_injr_transfer_to_iosw_cyl[5].str_injr_transfer_to_iosw_pls[1].v_iv_mes "Actual measured voltage of a carried out second pulse on the piezo injector, cylinder individual" UWORD _CNV_A_R_LINEAR_____207_CM 1 100. 0. 639.98046875 DISPLAY_IDENTIFIER V_IV_2_MES[5] ECU_ADDRESS 0xd0006cba FORMAT "%6.2" /end MEASUREMENT
/begin MEASUREMENT injr.STR_INJR_IFINFTRANS0.str_injr_transfer_to_iosw.str_injr_transfer_to_iosw_cyl[5].str_injr_transfer_to_iosw_pls[1].ti_mes "Actual performed cylinder individual injection time, second pulse or additional pulse" UWORD _CNV_A_R_LINEAR_____228_CM 1 100. 0. 65.535 DISPLAY_IDENTIFIER TI_2_MES[5] ECU_ADDRESS 0xd0006cbc /end MEASUREMENT
/begin MEASUREMENT injr.STR_INJR_IFINFTRANS0.str_injr_transfer_to_iosw.str_injr_transfer_to_iosw_cyl[5].str_injr_transfer_to_iosw_pls[1].egy_iv_clc "Energy inside injector calculated from measurement data for the second pulse" UWORD _CNV_A_R_INJR_LINEA_432_CM 1 100. 0. 255. DISPLAY_IDENTIFIER EGY_IV_2_CLC[5] ECU_ADDRESS 0xd0006cbe FORMAT "%7.3" /end MEASUREMENT
/begin MEASUREMENT injr.STR_INJR_IFINFTRANS0.str_injr_transfer_to_iosw.str_injr_transfer_to_iosw_cyl[5].str_injr_transfer_to_iosw_pls[1].capa_iv_clc "Capacity of the piezo injector for the second pulse, calculated from measurement data" UWORD _CNV_A_R_INJR_LINEA_464_CM 1 100. 0. 27.96 DISPLAY_IDENTIFIER CAPA_IV_2_CLC[5] ECU_ADDRESS 0xd0006cc0 FORMAT "%5.4" /end MEASUREMENT
/begin MEASUREMENT injr.STR_INJR_IFINFTRANS0.str_injr_transfer_to_iosw.str_injr_transfer_to_iosw_cyl[5].str_injr_transfer_to_iosw_pls[3].soi_mes "Actual performed SOI of the post injection pulse, estimated" UWORD _CNV_A_R_LINEAR_____200_CM 1 100. 0. 720. DISPLAY_IDENTIFIER SOI_POST_MES[5] ECU_ADDRESS 0xd0006cd4 FORMAT "%7.3" /end MEASUREMENT
/begin MEASUREMENT injr.STR_INJR_IFINFTRANS0.str_injr_transfer_to_iosw.str_injr_transfer_to_iosw_cyl[5].str_injr_transfer_to_iosw_pls[3].eoi_mes "Actual performed EOI of the post injection pulse, estimated" UWORD _CNV_A_R_LINEAR_____200_CM 1 100. 0. 720. DISPLAY_IDENTIFIER EOI_POST_MES[5] ECU_ADDRESS 0xd0006cd6 FORMAT "%7.3" /end MEASUREMENT
/begin MEASUREMENT injr.STR_INJR_IFINFTRANS0.str_injr_transfer_to_iosw.str_injr_transfer_to_iosw_cyl[5].str_injr_transfer_to_iosw_pls[3].cha_iv_mes "Actual measured charge value of a carried out post injection pulse on the piezo injector, cylinder individual" UWORD _CNV_A_R_INJR_LINEA_463_CM 1 100. 0. 2272.6968 DISPLAY_IDENTIFIER CHA_IV_POST_MES[5] ECU_ADDRESS 0xd0006cd8 FORMAT "%4.0" /end MEASUREMENT
/begin MEASUREMENT injr.STR_INJR_IFINFTRANS0.str_injr_transfer_to_iosw.str_injr_transfer_to_iosw_cyl[5].str_injr_transfer_to_iosw_pls[3].v_iv_mes "Actual measured voltage of a carried out post pulse on the piezo injector, cylinder individual" UWORD _CNV_A_R_LINEAR_____207_CM 1 100. 0. 639.98046875 DISPLAY_IDENTIFIER V_IV_POST_MES[5] ECU_ADDRESS 0xd0006cda FORMAT "%6.2" /end MEASUREMENT
/begin MEASUREMENT injr.STR_INJR_IFINFTRANS0.str_injr_transfer_to_iosw.str_injr_transfer_to_iosw_cyl[5].str_injr_transfer_to_iosw_pls[3].ti_mes "Actual performed cylinder individual injection time, post injection pulse" UWORD _CNV_A_R_LINEAR_____228_CM 1 100. 0. 65.535 DISPLAY_IDENTIFIER TI_POST_MES[5] ECU_ADDRESS 0xd0006cdc /end MEASUREMENT
/begin MEASUREMENT injr.STR_INJR_IFINFTRANS0.str_injr_transfer_to_iosw.str_injr_transfer_to_iosw_cyl[5].str_injr_transfer_to_iosw_pls[3].egy_iv_clc "Energy inside injector calculated from measurement data for the post injection pulse" UWORD _CNV_A_R_INJR_LINEA_432_CM 1 100. 0. 255. DISPLAY_IDENTIFIER EGY_IV_POST_CLC[5] ECU_ADDRESS 0xd0006cde FORMAT "%7.3" /end MEASUREMENT
/begin MEASUREMENT injr.STR_INJR_IFINFTRANS0.str_injr_transfer_to_iosw.str_injr_transfer_to_iosw_cyl[5].str_injr_transfer_to_iosw_pls[3].capa_iv_clc "Capacity of the piezo injector for the post injection pulse, calculated from measurement data" UWORD _CNV_A_R_INJR_LINEA_464_CM 1 100. 0. 27.96 DISPLAY_IDENTIFIER CAPA_IV_POST_CLC[5] ECU_ADDRESS 0xd0006ce0 FORMAT "%5.4" /end MEASUREMENT
/begin MEASUREMENT injr.STR_INJR_IFINFTRANS0.str_injr_transfer_to_iosw.str_injr_transfer_to_iosw_cyl[5].state_err_iv_cyl_raw "Detailed error information of injection valve, cylinder individual I/O-SW raw value" UBYTE _CNV_A_R_LINEAR_____0_CM 1 100. 0. 255. DISPLAY_IDENTIFIER STATE_ERR_IV_CYL_RAW[5] ECU_ADDRESS 0xd0006ce4 FORMAT "%3.0" /end MEASUREMENT
/begin MEASUREMENT injr.STR_INJR_IFINFTRANS0.str_injr_transfer_to_iosw.str_injr_transfer_to_iosw_cyl[5].cdn_diag_iv_raw "Diagnosis condition request to I/O-SW for each symptom of injector [x]" UBYTE _CNV_A_R_LINEAR_____0_CM 1 100. 0. 255. DISPLAY_IDENTIFIER CDN_DIAG_IV_RAW[5] ECU_ADDRESS 0xd0006ce5 FORMAT "%3.0" /end MEASUREMENT
/begin MEASUREMENT injr.STR_INJR_IFINFTRANS0.str_injr_transfer_to_iosw.str_injr_transfer_to_iosw_cyl[6].lv_inh_inj "Flag that indicates  if cylinder shut off is active or not" UBYTE _CNV_S_2_RANGE__0___1_CM 1 100. 0. 1. DISPLAY_IDENTIFIER LV_INH_INJ[6] ECU_ADDRESS 0xd0006ce8 BIT_MASK 0x1 /end MEASUREMENT
/begin MEASUREMENT injr.STR_INJR_IFINFTRANS0.str_injr_transfer_to_iosw.str_injr_transfer_to_iosw_cyl[6].lv_state_prev_iv "Cylinder individuel flag which indicates whether last injection was activated or deactivated" UBYTE _CNV_S_2_RANGE__0___1_CM 1 100. 0. 1. DISPLAY_IDENTIFIER LV_STATE_PREV_IV[6] ECU_ADDRESS 0xd0006ce9 BIT_MASK 0x1 /end MEASUREMENT
/begin MEASUREMENT injr.STR_INJR_IFINFTRANS0.str_injr_transfer_to_iosw.str_injr_transfer_to_iosw_cyl[6].lv_add_pulse "Switch to enable additional injection pulse at homogeneous mode, single injection mode (injection update at transient operation)" UBYTE _CNV_S_2_RANGE__0___1_CM 1 100. 0. 1. DISPLAY_IDENTIFIER LV_ADD_PULSE[6] ECU_ADDRESS 0xd0006cea BIT_MASK 0x1 /end MEASUREMENT
/begin MEASUREMENT injr.STR_INJR_IFINFTRANS0.str_injr_transfer_to_iosw.str_injr_transfer_to_iosw_cyl[6].inj_mod "Cylinder individual injection mode" UBYTE _CNV_S_13_INJR_RANGE_461_CM 1 100. 1. 131. DISPLAY_IDENTIFIER INJ_MOD[6] ECU_ADDRESS 0xd0006ceb /end MEASUREMENT
/begin MEASUREMENT injr.STR_INJR_IFINFTRANS0.str_injr_transfer_to_iosw.str_injr_transfer_to_iosw_cyl[6].lv_inj_mplp_cyl "Logical variable for enabling post injection, cylinder individual" UBYTE _CNV_S_2_RANGE__0___1_CM 1 100. 0. 1. DISPLAY_IDENTIFIER LV_INJ_MPLP_CYL[6] ECU_ADDRESS 0xd0006cec /end MEASUREMENT
/begin MEASUREMENT injr.STR_INJR_IFINFTRANS0.str_injr_transfer_to_iosw.str_injr_transfer_to_iosw_cyl[6].inj_mod_sp "Injection mode set point, cylinder individual" UBYTE _CNV_S_13_INJR_RANGE_461_CM 1 100. 1. 131. DISPLAY_IDENTIFIER INJ_MOD_SP[6] ECU_ADDRESS 0xd0006ced /end MEASUREMENT
/begin MEASUREMENT injr.STR_INJR_IFINFTRANS0.str_injr_transfer_to_iosw.str_injr_transfer_to_iosw_cyl[6].lv_inj_upd_ack "Cylinder individual flag, which indicates when a requested injection parameter update during mode switch was fulfilled. Flag switches from 0 to 1." UBYTE _CNV_S_2_RANGE__0___1_CM 1 100. 0. 1. DISPLAY_IDENTIFIER LV_INJ_UPD_ACK[6] ECU_ADDRESS 0xd0006cee BIT_MASK 0x1 /end MEASUREMENT
/begin MEASUREMENT injr.STR_INJR_IFINFTRANS0.str_injr_transfer_to_iosw.str_injr_transfer_to_iosw_cyl[6].str_injr_transfer_to_iosw_pls[0].soi_mes "Actual performed SOI of the first injection pulse, estimated" UWORD _CNV_A_R_LINEAR_____200_CM 1 100. 0. 720. DISPLAY_IDENTIFIER SOI_1_MES[6] ECU_ADDRESS 0xd0006cf0 FORMAT "%7.3" /end MEASUREMENT
/begin MEASUREMENT injr.STR_INJR_IFINFTRANS0.str_injr_transfer_to_iosw.str_injr_transfer_to_iosw_cyl[6].str_injr_transfer_to_iosw_pls[0].eoi_mes "Actual performed EOI of the first injection pulse, estimated" UWORD _CNV_A_R_LINEAR_____200_CM 1 100. 0. 720. DISPLAY_IDENTIFIER EOI_1_MES[6] ECU_ADDRESS 0xd0006cf2 FORMAT "%7.3" /end MEASUREMENT
/begin MEASUREMENT injr.STR_INJR_IFINFTRANS0.str_injr_transfer_to_iosw.str_injr_transfer_to_iosw_cyl[6].str_injr_transfer_to_iosw_pls[0].cha_iv_mes "physical unit: uAs" UWORD _CNV_A_R_INJR_LINEA_463_CM 1 100. 0. 2272.6968 DISPLAY_IDENTIFIER CHA_IV_1_MES[6] ECU_ADDRESS 0xd0006cf4 FORMAT "%4.0" /end MEASUREMENT
/begin MEASUREMENT injr.STR_INJR_IFINFTRANS0.str_injr_transfer_to_iosw.str_injr_transfer_to_iosw_cyl[6].str_injr_transfer_to_iosw_pls[0].v_iv_mes "Actual measured voltage of a carried out first pulse on the PIEZO injector, cylinder individual" UWORD _CNV_A_R_LINEAR_____207_CM 1 100. 0. 639.98046875 DISPLAY_IDENTIFIER V_IV_1_MES[6] ECU_ADDRESS 0xd0006cf6 FORMAT "%6.2" /end MEASUREMENT
/begin MEASUREMENT injr.STR_INJR_IFINFTRANS0.str_injr_transfer_to_iosw.str_injr_transfer_to_iosw_cyl[6].str_injr_transfer_to_iosw_pls[0].ti_mes "Actual performed cylinder individual injection time, first pulse" UWORD _CNV_A_R_LINEAR_____228_CM 1 100. 0. 65.535 DISPLAY_IDENTIFIER TI_1_MES[6] ECU_ADDRESS 0xd0006cf8 /end MEASUREMENT
/begin MEASUREMENT injr.STR_INJR_IFINFTRANS0.str_injr_transfer_to_iosw.str_injr_transfer_to_iosw_cyl[6].str_injr_transfer_to_iosw_pls[0].egy_iv_clc "energy inside injector calculated from measurement data, first pulse" UWORD _CNV_A_R_INJR_LINEA_432_CM 1 100. 0. 255. DISPLAY_IDENTIFIER EGY_IV_1_CLC[6] ECU_ADDRESS 0xd0006cfa FORMAT "%7.3" /end MEASUREMENT
/begin MEASUREMENT injr.STR_INJR_IFINFTRANS0.str_injr_transfer_to_iosw.str_injr_transfer_to_iosw_cyl[6].str_injr_transfer_to_iosw_pls[0].capa_iv_clc "Capacity of the piezo injector for the first pulse, calculated from measurement data" UWORD _CNV_A_R_INJR_LINEA_464_CM 1 100. 0. 27.96 DISPLAY_IDENTIFIER CAPA_IV_1_CLC[6] ECU_ADDRESS 0xd0006cfc FORMAT "%5.4" /end MEASUREMENT
/begin MEASUREMENT injr.STR_INJR_IFINFTRANS0.str_injr_transfer_to_iosw.str_injr_transfer_to_iosw_cyl[6].str_injr_transfer_to_iosw_pls[1].soi_mes "Actual performed SOI of the second injection pulse, estimated" UWORD _CNV_A_R_LINEAR_____200_CM 1 100. 0. 720. DISPLAY_IDENTIFIER SOI_2_MES[6] ECU_ADDRESS 0xd0006d00 FORMAT "%7.3" /end MEASUREMENT
/begin MEASUREMENT injr.STR_INJR_IFINFTRANS0.str_injr_transfer_to_iosw.str_injr_transfer_to_iosw_cyl[6].str_injr_transfer_to_iosw_pls[1].eoi_mes "Actual performed EOI of the second injection pulse, estimated" UWORD _CNV_A_R_LINEAR_____200_CM 1 100. 0. 720. DISPLAY_IDENTIFIER EOI_2_MES[6] ECU_ADDRESS 0xd0006d02 FORMAT "%7.3" /end MEASUREMENT
/begin MEASUREMENT injr.STR_INJR_IFINFTRANS0.str_injr_transfer_to_iosw.str_injr_transfer_to_iosw_cyl[6].str_injr_transfer_to_iosw_pls[1].cha_iv_mes "Actual measured charge value of a carried out second pulse on the piezo injector, cylinder individual" UWORD _CNV_A_R_INJR_LINEA_463_CM 1 100. 0. 2272.6968 DISPLAY_IDENTIFIER CHA_IV_2_MES[6] ECU_ADDRESS 0xd0006d04 FORMAT "%4.0" /end MEASUREMENT
/begin MEASUREMENT injr.STR_INJR_IFINFTRANS0.str_injr_transfer_to_iosw.str_injr_transfer_to_iosw_cyl[6].str_injr_transfer_to_iosw_pls[1].v_iv_mes "Actual measured voltage of a carried out second pulse on the piezo injector, cylinder individual" UWORD _CNV_A_R_LINEAR_____207_CM 1 100. 0. 639.98046875 DISPLAY_IDENTIFIER V_IV_2_MES[6] ECU_ADDRESS 0xd0006d06 FORMAT "%6.2" /end MEASUREMENT
/begin MEASUREMENT injr.STR_INJR_IFINFTRANS0.str_injr_transfer_to_iosw.str_injr_transfer_to_iosw_cyl[6].str_injr_transfer_to_iosw_pls[1].ti_mes "Actual performed cylinder individual injection time, second pulse or additional pulse" UWORD _CNV_A_R_LINEAR_____228_CM 1 100. 0. 65.535 DISPLAY_IDENTIFIER TI_2_MES[6] ECU_ADDRESS 0xd0006d08 /end MEASUREMENT
/begin MEASUREMENT injr.STR_INJR_IFINFTRANS0.str_injr_transfer_to_iosw.str_injr_transfer_to_iosw_cyl[6].str_injr_transfer_to_iosw_pls[1].egy_iv_clc "Energy inside injector calculated from measurement data for the second pulse" UWORD _CNV_A_R_INJR_LINEA_432_CM 1 100. 0. 255. DISPLAY_IDENTIFIER EGY_IV_2_CLC[6] ECU_ADDRESS 0xd0006d0a FORMAT "%7.3" /end MEASUREMENT
/begin MEASUREMENT injr.STR_INJR_IFINFTRANS0.str_injr_transfer_to_iosw.str_injr_transfer_to_iosw_cyl[6].str_injr_transfer_to_iosw_pls[1].capa_iv_clc "Capacity of the piezo injector for the second pulse, calculated from measurement data" UWORD _CNV_A_R_INJR_LINEA_464_CM 1 100. 0. 27.96 DISPLAY_IDENTIFIER CAPA_IV_2_CLC[6] ECU_ADDRESS 0xd0006d0c FORMAT "%5.4" /end MEASUREMENT
/begin MEASUREMENT injr.STR_INJR_IFINFTRANS0.str_injr_transfer_to_iosw.str_injr_transfer_to_iosw_cyl[6].str_injr_transfer_to_iosw_pls[3].soi_mes "Actual performed SOI of the post injection pulse, estimated" UWORD _CNV_A_R_LINEAR_____200_CM 1 100. 0. 720. DISPLAY_IDENTIFIER SOI_POST_MES[6] ECU_ADDRESS 0xd0006d20 FORMAT "%7.3" /end MEASUREMENT
/begin MEASUREMENT injr.STR_INJR_IFINFTRANS0.str_injr_transfer_to_iosw.str_injr_transfer_to_iosw_cyl[6].str_injr_transfer_to_iosw_pls[3].eoi_mes "Actual performed EOI of the post injection pulse, estimated" UWORD _CNV_A_R_LINEAR_____200_CM 1 100. 0. 720. DISPLAY_IDENTIFIER EOI_POST_MES[6] ECU_ADDRESS 0xd0006d22 FORMAT "%7.3" /end MEASUREMENT
/begin MEASUREMENT injr.STR_INJR_IFINFTRANS0.str_injr_transfer_to_iosw.str_injr_transfer_to_iosw_cyl[6].str_injr_transfer_to_iosw_pls[3].cha_iv_mes "Actual measured charge value of a carried out post injection pulse on the piezo injector, cylinder individual" UWORD _CNV_A_R_INJR_LINEA_463_CM 1 100. 0. 2272.6968 DISPLAY_IDENTIFIER CHA_IV_POST_MES[6] ECU_ADDRESS 0xd0006d24 FORMAT "%4.0" /end MEASUREMENT
/begin MEASUREMENT injr.STR_INJR_IFINFTRANS0.str_injr_transfer_to_iosw.str_injr_transfer_to_iosw_cyl[6].str_injr_transfer_to_iosw_pls[3].v_iv_mes "Actual measured voltage of a carried out post pulse on the piezo injector, cylinder individual" UWORD _CNV_A_R_LINEAR_____207_CM 1 100. 0. 639.98046875 DISPLAY_IDENTIFIER V_IV_POST_MES[6] ECU_ADDRESS 0xd0006d26 FORMAT "%6.2" /end MEASUREMENT
/begin MEASUREMENT injr.STR_INJR_IFINFTRANS0.str_injr_transfer_to_iosw.str_injr_transfer_to_iosw_cyl[6].str_injr_transfer_to_iosw_pls[3].ti_mes "Actual performed cylinder individual injection time, post injection pulse" UWORD _CNV_A_R_LINEAR_____228_CM 1 100. 0. 65.535 DISPLAY_IDENTIFIER TI_POST_MES[6] ECU_ADDRESS 0xd0006d28 /end MEASUREMENT
/begin MEASUREMENT injr.STR_INJR_IFINFTRANS0.str_injr_transfer_to_iosw.str_injr_transfer_to_iosw_cyl[6].str_injr_transfer_to_iosw_pls[3].egy_iv_clc "Energy inside injector calculated from measurement data for the post injection pulse" UWORD _CNV_A_R_INJR_LINEA_432_CM 1 100. 0. 255. DISPLAY_IDENTIFIER EGY_IV_POST_CLC[6] ECU_ADDRESS 0xd0006d2a FORMAT "%7.3" /end MEASUREMENT
/begin MEASUREMENT injr.STR_INJR_IFINFTRANS0.str_injr_transfer_to_iosw.str_injr_transfer_to_iosw_cyl[6].str_injr_transfer_to_iosw_pls[3].capa_iv_clc "Capacity of the piezo injector for the post injection pulse, calculated from measurement data" UWORD _CNV_A_R_INJR_LINEA_464_CM 1 100. 0. 27.96 DISPLAY_IDENTIFIER CAPA_IV_POST_CLC[6] ECU_ADDRESS 0xd0006d2c FORMAT "%5.4" /end MEASUREMENT
/begin MEASUREMENT injr.STR_INJR_IFINFTRANS0.str_injr_transfer_to_iosw.str_injr_transfer_to_iosw_cyl[6].state_err_iv_cyl_raw "Detailed error information of injection valve, cylinder individual I/O-SW raw value" UBYTE _CNV_A_R_LINEAR_____0_CM 1 100. 0. 255. DISPLAY_IDENTIFIER STATE_ERR_IV_CYL_RAW[6] ECU_ADDRESS 0xd0006d30 FORMAT "%3.0" /end MEASUREMENT
/begin MEASUREMENT injr.STR_INJR_IFINFTRANS0.str_injr_transfer_to_iosw.str_injr_transfer_to_iosw_cyl[6].cdn_diag_iv_raw "Diagnosis condition request to I/O-SW for each symptom of injector [x]" UBYTE _CNV_A_R_LINEAR_____0_CM 1 100. 0. 255. DISPLAY_IDENTIFIER CDN_DIAG_IV_RAW[6] ECU_ADDRESS 0xd0006d31 FORMAT "%3.0" /end MEASUREMENT
/begin MEASUREMENT injr.STR_INJR_IFINFTRANS0.str_injr_transfer_to_iosw.str_injr_transfer_to_iosw_cyl[7].lv_inh_inj "Flag that indicates  if cylinder shut off is active or not" UBYTE _CNV_S_2_RANGE__0___1_CM 1 100. 0. 1. DISPLAY_IDENTIFIER LV_INH_INJ[7] ECU_ADDRESS 0xd0006d34 BIT_MASK 0x1 /end MEASUREMENT
/begin MEASUREMENT injr.STR_INJR_IFINFTRANS0.str_injr_transfer_to_iosw.str_injr_transfer_to_iosw_cyl[7].lv_state_prev_iv "Cylinder individuel flag which indicates whether last injection was activated or deactivated" UBYTE _CNV_S_2_RANGE__0___1_CM 1 100. 0. 1. DISPLAY_IDENTIFIER LV_STATE_PREV_IV[7] ECU_ADDRESS 0xd0006d35 BIT_MASK 0x1 /end MEASUREMENT
/begin MEASUREMENT injr.STR_INJR_IFINFTRANS0.str_injr_transfer_to_iosw.str_injr_transfer_to_iosw_cyl[7].lv_add_pulse "Switch to enable additional injection pulse at homogeneous mode, single injection mode (injection update at transient operation)" UBYTE _CNV_S_2_RANGE__0___1_CM 1 100. 0. 1. DISPLAY_IDENTIFIER LV_ADD_PULSE[7] ECU_ADDRESS 0xd0006d36 BIT_MASK 0x1 /end MEASUREMENT
/begin MEASUREMENT injr.STR_INJR_IFINFTRANS0.str_injr_transfer_to_iosw.str_injr_transfer_to_iosw_cyl[7].inj_mod "Cylinder individual injection mode" UBYTE _CNV_S_13_INJR_RANGE_461_CM 1 100. 1. 131. DISPLAY_IDENTIFIER INJ_MOD[7] ECU_ADDRESS 0xd0006d37 /end MEASUREMENT
/begin MEASUREMENT injr.STR_INJR_IFINFTRANS0.str_injr_transfer_to_iosw.str_injr_transfer_to_iosw_cyl[7].lv_inj_mplp_cyl "Logical variable for enabling post injection, cylinder individual" UBYTE _CNV_S_2_RANGE__0___1_CM 1 100. 0. 1. DISPLAY_IDENTIFIER LV_INJ_MPLP_CYL[7] ECU_ADDRESS 0xd0006d38 /end MEASUREMENT
/begin MEASUREMENT injr.STR_INJR_IFINFTRANS0.str_injr_transfer_to_iosw.str_injr_transfer_to_iosw_cyl[7].inj_mod_sp "Injection mode set point, cylinder individual" UBYTE _CNV_S_13_INJR_RANGE_461_CM 1 100. 1. 131. DISPLAY_IDENTIFIER INJ_MOD_SP[7] ECU_ADDRESS 0xd0006d39 /end MEASUREMENT
/begin MEASUREMENT injr.STR_INJR_IFINFTRANS0.str_injr_transfer_to_iosw.str_injr_transfer_to_iosw_cyl[7].lv_inj_upd_ack "Cylinder individual flag, which indicates when a requested injection parameter update during mode switch was fulfilled. Flag switches from 0 to 1." UBYTE _CNV_S_2_RANGE__0___1_CM 1 100. 0. 1. DISPLAY_IDENTIFIER LV_INJ_UPD_ACK[7] ECU_ADDRESS 0xd0006d3a BIT_MASK 0x1 /end MEASUREMENT
/begin MEASUREMENT injr.STR_INJR_IFINFTRANS0.str_injr_transfer_to_iosw.str_injr_transfer_to_iosw_cyl[7].str_injr_transfer_to_iosw_pls[0].soi_mes "Actual performed SOI of the first injection pulse, estimated" UWORD _CNV_A_R_LINEAR_____200_CM 1 100. 0. 720. DISPLAY_IDENTIFIER SOI_1_MES[7] ECU_ADDRESS 0xd0006d3c FORMAT "%7.3" /end MEASUREMENT
/begin MEASUREMENT injr.STR_INJR_IFINFTRANS0.str_injr_transfer_to_iosw.str_injr_transfer_to_iosw_cyl[7].str_injr_transfer_to_iosw_pls[0].eoi_mes "Actual performed EOI of the first injection pulse, estimated" UWORD _CNV_A_R_LINEAR_____200_CM 1 100. 0. 720. DISPLAY_IDENTIFIER EOI_1_MES[7] ECU_ADDRESS 0xd0006d3e FORMAT "%7.3" /end MEASUREMENT
/begin MEASUREMENT injr.STR_INJR_IFINFTRANS0.str_injr_transfer_to_iosw.str_injr_transfer_to_iosw_cyl[7].str_injr_transfer_to_iosw_pls[0].cha_iv_mes "physical unit: uAs" UWORD _CNV_A_R_INJR_LINEA_463_CM 1 100. 0. 2272.6968 DISPLAY_IDENTIFIER CHA_IV_1_MES[7] ECU_ADDRESS 0xd0006d40 FORMAT "%4.0" /end MEASUREMENT
/begin MEASUREMENT injr.STR_INJR_IFINFTRANS0.str_injr_transfer_to_iosw.str_injr_transfer_to_iosw_cyl[7].str_injr_transfer_to_iosw_pls[0].v_iv_mes "Actual measured voltage of a carried out first pulse on the PIEZO injector, cylinder individual" UWORD _CNV_A_R_LINEAR_____207_CM 1 100. 0. 639.98046875 DISPLAY_IDENTIFIER V_IV_1_MES[7] ECU_ADDRESS 0xd0006d42 FORMAT "%6.2" /end MEASUREMENT
/begin MEASUREMENT injr.STR_INJR_IFINFTRANS0.str_injr_transfer_to_iosw.str_injr_transfer_to_iosw_cyl[7].str_injr_transfer_to_iosw_pls[0].ti_mes "Actual performed cylinder individual injection time, first pulse" UWORD _CNV_A_R_LINEAR_____228_CM 1 100. 0. 65.535 DISPLAY_IDENTIFIER TI_1_MES[7] ECU_ADDRESS 0xd0006d44 /end MEASUREMENT
/begin MEASUREMENT injr.STR_INJR_IFINFTRANS0.str_injr_transfer_to_iosw.str_injr_transfer_to_iosw_cyl[7].str_injr_transfer_to_iosw_pls[0].egy_iv_clc "energy inside injector calculated from measurement data, first pulse" UWORD _CNV_A_R_INJR_LINEA_432_CM 1 100. 0. 255. DISPLAY_IDENTIFIER EGY_IV_1_CLC[7] ECU_ADDRESS 0xd0006d46 FORMAT "%7.3" /end MEASUREMENT
/begin MEASUREMENT injr.STR_INJR_IFINFTRANS0.str_injr_transfer_to_iosw.str_injr_transfer_to_iosw_cyl[7].str_injr_transfer_to_iosw_pls[0].capa_iv_clc "Capacity of the piezo injector for the first pulse, calculated from measurement data" UWORD _CNV_A_R_INJR_LINEA_464_CM 1 100. 0. 27.96 DISPLAY_IDENTIFIER CAPA_IV_1_CLC[7] ECU_ADDRESS 0xd0006d48 FORMAT "%5.4" /end MEASUREMENT
/begin MEASUREMENT injr.STR_INJR_IFINFTRANS0.str_injr_transfer_to_iosw.str_injr_transfer_to_iosw_cyl[7].str_injr_transfer_to_iosw_pls[1].soi_mes "Actual performed SOI of the second injection pulse, estimated" UWORD _CNV_A_R_LINEAR_____200_CM 1 100. 0. 720. DISPLAY_IDENTIFIER SOI_2_MES[7] ECU_ADDRESS 0xd0006d4c FORMAT "%7.3" /end MEASUREMENT
/begin MEASUREMENT injr.STR_INJR_IFINFTRANS0.str_injr_transfer_to_iosw.str_injr_transfer_to_iosw_cyl[7].str_injr_transfer_to_iosw_pls[1].eoi_mes "Actual performed EOI of the second injection pulse, estimated" UWORD _CNV_A_R_LINEAR_____200_CM 1 100. 0. 720. DISPLAY_IDENTIFIER EOI_2_MES[7] ECU_ADDRESS 0xd0006d4e FORMAT "%7.3" /end MEASUREMENT
/begin MEASUREMENT injr.STR_INJR_IFINFTRANS0.str_injr_transfer_to_iosw.str_injr_transfer_to_iosw_cyl[7].str_injr_transfer_to_iosw_pls[1].cha_iv_mes "Actual measured charge value of a carried out second pulse on the piezo injector, cylinder individual" UWORD _CNV_A_R_INJR_LINEA_463_CM 1 100. 0. 2272.6968 DISPLAY_IDENTIFIER CHA_IV_2_MES[7] ECU_ADDRESS 0xd0006d50 FORMAT "%4.0" /end MEASUREMENT
/begin MEASUREMENT injr.STR_INJR_IFINFTRANS0.str_injr_transfer_to_iosw.str_injr_transfer_to_iosw_cyl[7].str_injr_transfer_to_iosw_pls[1].v_iv_mes "Actual measured voltage of a carried out second pulse on the piezo injector, cylinder individual" UWORD _CNV_A_R_LINEAR_____207_CM 1 100. 0. 639.98046875 DISPLAY_IDENTIFIER V_IV_2_MES[7] ECU_ADDRESS 0xd0006d52 FORMAT "%6.2" /end MEASUREMENT
/begin MEASUREMENT injr.STR_INJR_IFINFTRANS0.str_injr_transfer_to_iosw.str_injr_transfer_to_iosw_cyl[7].str_injr_transfer_to_iosw_pls[1].ti_mes "Actual performed cylinder individual injection time, second pulse or additional pulse" UWORD _CNV_A_R_LINEAR_____228_CM 1 100. 0. 65.535 DISPLAY_IDENTIFIER TI_2_MES[7] ECU_ADDRESS 0xd0006d54 /end MEASUREMENT
/begin MEASUREMENT injr.STR_INJR_IFINFTRANS0.str_injr_transfer_to_iosw.str_injr_transfer_to_iosw_cyl[7].str_injr_transfer_to_iosw_pls[1].egy_iv_clc "Energy inside injector calculated from measurement data for the second pulse" UWORD _CNV_A_R_INJR_LINEA_432_CM 1 100. 0. 255. DISPLAY_IDENTIFIER EGY_IV_2_CLC[7] ECU_ADDRESS 0xd0006d56 FORMAT "%7.3" /end MEASUREMENT
/begin MEASUREMENT injr.STR_INJR_IFINFTRANS0.str_injr_transfer_to_iosw.str_injr_transfer_to_iosw_cyl[7].str_injr_transfer_to_iosw_pls[1].capa_iv_clc "Capacity of the piezo injector for the second pulse, calculated from measurement data" UWORD _CNV_A_R_INJR_LINEA_464_CM 1 100. 0. 27.96 DISPLAY_IDENTIFIER CAPA_IV_2_CLC[7] ECU_ADDRESS 0xd0006d58 FORMAT "%5.4" /end MEASUREMENT
/begin MEASUREMENT injr.STR_INJR_IFINFTRANS0.str_injr_transfer_to_iosw.str_injr_transfer_to_iosw_cyl[7].str_injr_transfer_to_iosw_pls[3].soi_mes "Actual performed SOI of the post injection pulse, estimated" UWORD _CNV_A_R_LINEAR_____200_CM 1 100. 0. 720. DISPLAY_IDENTIFIER SOI_POST_MES[7] ECU_ADDRESS 0xd0006d6c FORMAT "%7.3" /end MEASUREMENT
/begin MEASUREMENT injr.STR_INJR_IFINFTRANS0.str_injr_transfer_to_iosw.str_injr_transfer_to_iosw_cyl[7].str_injr_transfer_to_iosw_pls[3].eoi_mes "Actual performed EOI of the post injection pulse, estimated" UWORD _CNV_A_R_LINEAR_____200_CM 1 100. 0. 720. DISPLAY_IDENTIFIER EOI_POST_MES[7] ECU_ADDRESS 0xd0006d6e FORMAT "%7.3" /end MEASUREMENT
/begin MEASUREMENT injr.STR_INJR_IFINFTRANS0.str_injr_transfer_to_iosw.str_injr_transfer_to_iosw_cyl[7].str_injr_transfer_to_iosw_pls[3].cha_iv_mes "Actual measured charge value of a carried out post injection pulse on the piezo injector, cylinder individual" UWORD _CNV_A_R_INJR_LINEA_463_CM 1 100. 0. 2272.6968 DISPLAY_IDENTIFIER CHA_IV_POST_MES[7] ECU_ADDRESS 0xd0006d70 FORMAT "%4.0" /end MEASUREMENT
/begin MEASUREMENT injr.STR_INJR_IFINFTRANS0.str_injr_transfer_to_iosw.str_injr_transfer_to_iosw_cyl[7].str_injr_transfer_to_iosw_pls[3].v_iv_mes "Actual measured voltage of a carried out post pulse on the piezo injector, cylinder individual" UWORD _CNV_A_R_LINEAR_____207_CM 1 100. 0. 639.98046875 DISPLAY_IDENTIFIER V_IV_POST_MES[7] ECU_ADDRESS 0xd0006d72 FORMAT "%6.2" /end MEASUREMENT
/begin MEASUREMENT injr.STR_INJR_IFINFTRANS0.str_injr_transfer_to_iosw.str_injr_transfer_to_iosw_cyl[7].str_injr_transfer_to_iosw_pls[3].ti_mes "Actual performed cylinder individual injection time, post injection pulse" UWORD _CNV_A_R_LINEAR_____228_CM 1 100. 0. 65.535 DISPLAY_IDENTIFIER TI_POST_MES[7] ECU_ADDRESS 0xd0006d74 /end MEASUREMENT
/begin MEASUREMENT injr.STR_INJR_IFINFTRANS0.str_injr_transfer_to_iosw.str_injr_transfer_to_iosw_cyl[7].str_injr_transfer_to_iosw_pls[3].egy_iv_clc "Energy inside injector calculated from measurement data for the post injection pulse" UWORD _CNV_A_R_INJR_LINEA_432_CM 1 100. 0. 255. DISPLAY_IDENTIFIER EGY_IV_POST_CLC[7] ECU_ADDRESS 0xd0006d76 FORMAT "%7.3" /end MEASUREMENT
/begin MEASUREMENT injr.STR_INJR_IFINFTRANS0.str_injr_transfer_to_iosw.str_injr_transfer_to_iosw_cyl[7].str_injr_transfer_to_iosw_pls[3].capa_iv_clc "Capacity of the piezo injector for the post injection pulse, calculated from measurement data" UWORD _CNV_A_R_INJR_LINEA_464_CM 1 100. 0. 27.96 DISPLAY_IDENTIFIER CAPA_IV_POST_CLC[7] ECU_ADDRESS 0xd0006d78 FORMAT "%5.4" /end MEASUREMENT
/begin MEASUREMENT injr.STR_INJR_IFINFTRANS0.str_injr_transfer_to_iosw.str_injr_transfer_to_iosw_cyl[7].state_err_iv_cyl_raw "Detailed error information of injection valve, cylinder individual I/O-SW raw value" UBYTE _CNV_A_R_LINEAR_____0_CM 1 100. 0. 255. DISPLAY_IDENTIFIER STATE_ERR_IV_CYL_RAW[7] ECU_ADDRESS 0xd0006d7c FORMAT "%3.0" /end MEASUREMENT
/begin MEASUREMENT injr.STR_INJR_IFINFTRANS0.str_injr_transfer_to_iosw.str_injr_transfer_to_iosw_cyl[7].cdn_diag_iv_raw "Diagnosis condition request to I/O-SW for each symptom of injector [x]" UBYTE _CNV_A_R_LINEAR_____0_CM 1 100. 0. 255. DISPLAY_IDENTIFIER CDN_DIAG_IV_RAW[7] ECU_ADDRESS 0xd0006d7d FORMAT "%3.0" /end MEASUREMENT
/begin MEASUREMENT injr.STR_INJR_IFINFTRANS0.str_injr_transfer_to_iosw.lv_iv_mes_vld "The flag indicates if the measurements for charge and voltage of the piezo injector is valid" UBYTE _CNV_S_2_RANGE__0___1_CM 1 100. 0. 1. DISPLAY_IDENTIFIER LV_IV_MES_VLD ECU_ADDRESS 0xd0006d80 /end MEASUREMENT
/begin MEASUREMENT injr.STR_INJR_IFINFTRANS0.str_injr_transfer_to_iosw.str_injr_transfer_to_iosw_pbk[0].state_err_pbk_iv_raw "Detailed error information of injection valve power stages, ATIC bank individual I/O-SW raw value" UBYTE _CNV_A_R_LINEAR_____0_CM 1 100. 0. 255. DISPLAY_IDENTIFIER STATE_ERR_PBK_IV_RAW[1] ECU_ADDRESS 0xd0006d84 FORMAT "%3.0" /end MEASUREMENT
/begin MEASUREMENT injr.STR_INJR_IFINFTRANS0.str_injr_transfer_to_iosw.str_injr_transfer_to_iosw_pbk[0].cdn_diag_pbk_iv_raw "Detailed error condition information of injection valve power stages, ATIC bank individual I/O-SW returned raw value" UBYTE _CNV_A_R_LINEAR_____0_CM 1 100. 0. 255. DISPLAY_IDENTIFIER CDN_DIAG_PBK_IV_RAW[1] ECU_ADDRESS 0xd0006d85 FORMAT "%3.0" /end MEASUREMENT
/begin MEASUREMENT injr.STR_INJR_IFINFTRANS0.str_injr_transfer_to_iosw.str_injr_transfer_to_iosw_pbk[0].state_err_pbk_iv_st_raw "Detailed error information of injection valve power stages during startup phase, ATIC bank individual I/O-SW raw value" UBYTE _CNV_A_R_LINEAR_____0_CM 1 100. 0. 255. DISPLAY_IDENTIFIER STATE_ERR_PBK_IV_ST_RAW[1] ECU_ADDRESS 0xd0006d86 FORMAT "%3.0" /end MEASUREMENT
/begin MEASUREMENT injr.STR_INJR_IFINFTRANS0.str_injr_transfer_to_iosw.str_injr_transfer_to_iosw_pbk[0].lv_state_prev_pbk_iv "Injection valve power stage bank individual flag which indicates if the power stage bank was activated (=1) or deactivated during the last injection cycles" UBYTE _CNV_S_2_RANGE__0___1_CM 1 100. 0. 1. DISPLAY_IDENTIFIER LV_STATE_PREV_PBK_IV[1] ECU_ADDRESS 0xd0006d87 BIT_MASK 0x1 /end MEASUREMENT
/begin MEASUREMENT injr.STR_INJR_IFINFTRANS0.str_injr_transfer_to_iosw.str_injr_transfer_to_iosw_pbk[0].ctr_state_prev_pbk_iv "Number of activated IV on the selected power stage bank during last engine cycle (720°CRK)" UBYTE _CNV_A_R_LINEAR_____0_CM 1 100. 0. 8. DISPLAY_IDENTIFIER CTR_STATE_PREV_PBK_IV[1] ECU_ADDRESS 0xd0006d88 FORMAT "%3.0" /end MEASUREMENT
/begin MEASUREMENT injr.STR_INJR_IFINFTRANS0.str_injr_transfer_to_iosw.str_injr_transfer_to_iosw_pbk[1].state_err_pbk_iv_raw "Detailed error information of injection valve power stages, ATIC bank individual I/O-SW raw value" UBYTE _CNV_A_R_LINEAR_____0_CM 1 100. 0. 255. DISPLAY_IDENTIFIER STATE_ERR_PBK_IV_RAW[2] ECU_ADDRESS 0xd0006d8a FORMAT "%3.0" /end MEASUREMENT
/begin MEASUREMENT injr.STR_INJR_IFINFTRANS0.str_injr_transfer_to_iosw.str_injr_transfer_to_iosw_pbk[1].cdn_diag_pbk_iv_raw "Detailed error condition information of injection valve power stages, ATIC bank individual I/O-SW returned raw value" UBYTE _CNV_A_R_LINEAR_____0_CM 1 100. 0. 255. DISPLAY_IDENTIFIER CDN_DIAG_PBK_IV_RAW[2] ECU_ADDRESS 0xd0006d8b FORMAT "%3.0" /end MEASUREMENT
/begin MEASUREMENT injr.STR_INJR_IFINFTRANS0.str_injr_transfer_to_iosw.str_injr_transfer_to_iosw_pbk[1].state_err_pbk_iv_st_raw "Detailed error information of injection valve power stages during startup phase, ATIC bank individual I/O-SW raw value" UBYTE _CNV_A_R_LINEAR_____0_CM 1 100. 0. 255. DISPLAY_IDENTIFIER STATE_ERR_PBK_IV_ST_RAW[2] ECU_ADDRESS 0xd0006d8c FORMAT "%3.0" /end MEASUREMENT
/begin MEASUREMENT injr.STR_INJR_IFINFTRANS0.str_injr_transfer_to_iosw.str_injr_transfer_to_iosw_pbk[1].lv_state_prev_pbk_iv "Injection valve power stage bank individual flag which indicates if the power stage bank was activated (=1) or deactivated during the last injection cycles" UBYTE _CNV_S_2_RANGE__0___1_CM 1 100. 0. 1. DISPLAY_IDENTIFIER LV_STATE_PREV_PBK_IV[2] ECU_ADDRESS 0xd0006d8d BIT_MASK 0x1 /end MEASUREMENT
/begin MEASUREMENT injr.STR_INJR_IFINFTRANS0.str_injr_transfer_to_iosw.str_injr_transfer_to_iosw_pbk[1].ctr_state_prev_pbk_iv "Number of activated IV on the selected power stage bank during last engine cycle (720°CRK)" UBYTE _CNV_A_R_LINEAR_____0_CM 1 100. 0. 8. DISPLAY_IDENTIFIER CTR_STATE_PREV_PBK_IV[2] ECU_ADDRESS 0xd0006d8e FORMAT "%3.0" /end MEASUREMENT
/begin MEASUREMENT injr.STR_INJR_IFINFTRANS0.str_injr_transfer_to_iosw.str_injr_transfer_to_iosw_pbk[2].state_err_pbk_iv_raw "Detailed error information of injection valve power stages, ATIC bank individual I/O-SW raw value" UBYTE _CNV_A_R_LINEAR_____0_CM 1 100. 0. 255. DISPLAY_IDENTIFIER STATE_ERR_PBK_IV_RAW[3] ECU_ADDRESS 0xd0006d90 FORMAT "%3.0" /end MEASUREMENT
/begin MEASUREMENT injr.STR_INJR_IFINFTRANS0.str_injr_transfer_to_iosw.str_injr_transfer_to_iosw_pbk[2].cdn_diag_pbk_iv_raw "Detailed error condition information of injection valve power stages, ATIC bank individual I/O-SW returned raw value" UBYTE _CNV_A_R_LINEAR_____0_CM 1 100. 0. 255. DISPLAY_IDENTIFIER CDN_DIAG_PBK_IV_RAW[3] ECU_ADDRESS 0xd0006d91 FORMAT "%3.0" /end MEASUREMENT
/begin MEASUREMENT injr.STR_INJR_IFINFTRANS0.str_injr_transfer_to_iosw.str_injr_transfer_to_iosw_pbk[2].state_err_pbk_iv_st_raw "Detailed error information of injection valve power stages during startup phase, ATIC bank individual I/O-SW raw value" UBYTE _CNV_A_R_LINEAR_____0_CM 1 100. 0. 255. DISPLAY_IDENTIFIER STATE_ERR_PBK_IV_ST_RAW[3] ECU_ADDRESS 0xd0006d92 FORMAT "%3.0" /end MEASUREMENT
/begin MEASUREMENT injr.STR_INJR_IFINFTRANS0.str_injr_transfer_to_iosw.str_injr_transfer_to_iosw_pbk[2].lv_state_prev_pbk_iv "Injection valve power stage bank individual flag which indicates if the power stage bank was activated (=1) or deactivated during the last injection cycles" UBYTE _CNV_S_2_RANGE__0___1_CM 1 100. 0. 1. DISPLAY_IDENTIFIER LV_STATE_PREV_PBK_IV[3] ECU_ADDRESS 0xd0006d93 BIT_MASK 0x1 /end MEASUREMENT
/begin MEASUREMENT injr.STR_INJR_IFINFTRANS0.str_injr_transfer_to_iosw.str_injr_transfer_to_iosw_pbk[2].ctr_state_prev_pbk_iv "Number of activated IV on the selected power stage bank during last engine cycle (720°CRK)" UBYTE _CNV_A_R_LINEAR_____0_CM 1 100. 0. 8. DISPLAY_IDENTIFIER CTR_STATE_PREV_PBK_IV[3] ECU_ADDRESS 0xd0006d94 FORMAT "%3.0" /end MEASUREMENT
/begin MEASUREMENT injr.STR_INJR_IFINFTRANS0.str_injr_transfer_to_iosw.str_injr_transfer_to_iosw_pbk[3].state_err_pbk_iv_raw "Detailed error information of injection valve power stages, ATIC bank individual I/O-SW raw value" UBYTE _CNV_A_R_LINEAR_____0_CM 1 100. 0. 255. DISPLAY_IDENTIFIER STATE_ERR_PBK_IV_RAW[4] ECU_ADDRESS 0xd0006d96 FORMAT "%3.0" /end MEASUREMENT
/begin MEASUREMENT injr.STR_INJR_IFINFTRANS0.str_injr_transfer_to_iosw.str_injr_transfer_to_iosw_pbk[3].cdn_diag_pbk_iv_raw "Detailed error condition information of injection valve power stages, ATIC bank individual I/O-SW returned raw value" UBYTE _CNV_A_R_LINEAR_____0_CM 1 100. 0. 255. DISPLAY_IDENTIFIER CDN_DIAG_PBK_IV_RAW[4] ECU_ADDRESS 0xd0006d97 FORMAT "%3.0" /end MEASUREMENT
/begin MEASUREMENT injr.STR_INJR_IFINFTRANS0.str_injr_transfer_to_iosw.str_injr_transfer_to_iosw_pbk[3].state_err_pbk_iv_st_raw "Detailed error information of injection valve power stages during startup phase, ATIC bank individual I/O-SW raw value" UBYTE _CNV_A_R_LINEAR_____0_CM 1 100. 0. 255. DISPLAY_IDENTIFIER STATE_ERR_PBK_IV_ST_RAW[4] ECU_ADDRESS 0xd0006d98 FORMAT "%3.0" /end MEASUREMENT
/begin MEASUREMENT injr.STR_INJR_IFINFTRANS0.str_injr_transfer_to_iosw.str_injr_transfer_to_iosw_pbk[3].lv_state_prev_pbk_iv "Injection valve power stage bank individual flag which indicates if the power stage bank was activated (=1) or deactivated during the last injection cycles" UBYTE _CNV_S_2_RANGE__0___1_CM 1 100. 0. 1. DISPLAY_IDENTIFIER LV_STATE_PREV_PBK_IV[4] ECU_ADDRESS 0xd0006d99 BIT_MASK 0x1 /end MEASUREMENT
/begin MEASUREMENT injr.STR_INJR_IFINFTRANS0.str_injr_transfer_to_iosw.str_injr_transfer_to_iosw_pbk[3].ctr_state_prev_pbk_iv "Number of activated IV on the selected power stage bank during last engine cycle (720°CRK)" UBYTE _CNV_A_R_LINEAR_____0_CM 1 100. 0. 8. DISPLAY_IDENTIFIER CTR_STATE_PREV_PBK_IV[4] ECU_ADDRESS 0xd0006d9a FORMAT "%3.0" /end MEASUREMENT
/begin MEASUREMENT injr.STR_INJR_IFINFTRANS0.str_injr_transfer_to_iosw.vboost_pbk_iv_mes[0] "Actual measured voltage of the DCDC converter for the injection valve power stage banks" UWORD _CNV_A_R_LINEAR_____207_CM 1 100. 0. 639.98046875 DISPLAY_IDENTIFIER VBOOST_PBK_IV_MES[0] ECU_ADDRESS 0xd0006d9c FORMAT "%6.2" /end MEASUREMENT
/begin MEASUREMENT injr.STR_INJR_IFINFTRANS0.str_injr_transfer_to_iosw.vboost_pbk_iv_mes[1] "Actual measured voltage of the DCDC converter for the injection valve power stage banks" UWORD _CNV_A_R_LINEAR_____207_CM 1 100. 0. 639.98046875 DISPLAY_IDENTIFIER VBOOST_PBK_IV_MES[1] ECU_ADDRESS 0xd0006d9e FORMAT "%6.2" /end MEASUREMENT
/begin MEASUREMENT injr.STR_INJR_REQGNHOM1P0.soi_1_hom[0] "Start of injection for homogeneous mode, 1.pulse - cylinder individual HPDI-Version" UWORD _CNV_A_R_LINEAR_____200_CM 1 100. 0. 720. DISPLAY_IDENTIFIER SOI_1_HOM[0] ECU_ADDRESS 0xd0006da0 FORMAT "%7.3" /end MEASUREMENT
/begin MEASUREMENT injr.STR_INJR_REQGNHOM1P0.soi_1_hom[1] "Start of injection for homogeneous mode, 1.pulse - cylinder individual HPDI-Version" UWORD _CNV_A_R_LINEAR_____200_CM 1 100. 0. 720. DISPLAY_IDENTIFIER SOI_1_HOM[1] ECU_ADDRESS 0xd0006da2 FORMAT "%7.3" /end MEASUREMENT
/begin MEASUREMENT injr.STR_INJR_REQGNHOM1P0.soi_1_hom[2] "Start of injection for homogeneous mode, 1.pulse - cylinder individual HPDI-Version" UWORD _CNV_A_R_LINEAR_____200_CM 1 100. 0. 720. DISPLAY_IDENTIFIER SOI_1_HOM[2] ECU_ADDRESS 0xd0006da4 FORMAT "%7.3" /end MEASUREMENT
/begin MEASUREMENT injr.STR_INJR_REQGNHOM1P0.soi_1_hom[3] "Start of injection for homogeneous mode, 1.pulse - cylinder individual HPDI-Version" UWORD _CNV_A_R_LINEAR_____200_CM 1 100. 0. 720. DISPLAY_IDENTIFIER SOI_1_HOM[3] ECU_ADDRESS 0xd0006da6 FORMAT "%7.3" /end MEASUREMENT
/begin MEASUREMENT injr.STR_INJR_REQGNHOM1P0.soi_1_hom[4] "Start of injection for homogeneous mode, 1.pulse - cylinder individual HPDI-Version" UWORD _CNV_A_R_LINEAR_____200_CM 1 100. 0. 720. DISPLAY_IDENTIFIER SOI_1_HOM[4] ECU_ADDRESS 0xd0006da8 FORMAT "%7.3" /end MEASUREMENT
/begin MEASUREMENT injr.STR_INJR_REQGNHOM1P0.soi_1_hom[5] "Start of injection for homogeneous mode, 1.pulse - cylinder individual HPDI-Version" UWORD _CNV_A_R_LINEAR_____200_CM 1 100. 0. 720. DISPLAY_IDENTIFIER SOI_1_HOM[5] ECU_ADDRESS 0xd0006daa FORMAT "%7.3" /end MEASUREMENT
/begin MEASUREMENT injr.STR_INJR_REQGNHOM1P0.soi_1_hom[6] "Start of injection for homogeneous mode, 1.pulse - cylinder individual HPDI-Version" UWORD _CNV_A_R_LINEAR_____200_CM 1 100. 0. 720. DISPLAY_IDENTIFIER SOI_1_HOM[6] ECU_ADDRESS 0xd0006dac FORMAT "%7.3" /end MEASUREMENT
/begin MEASUREMENT injr.STR_INJR_REQGNHOM1P0.soi_1_hom[7] "Start of injection for homogeneous mode, 1.pulse - cylinder individual HPDI-Version" UWORD _CNV_A_R_LINEAR_____200_CM 1 100. 0. 720. DISPLAY_IDENTIFIER SOI_1_HOM[7] ECU_ADDRESS 0xd0006dae FORMAT "%7.3" /end MEASUREMENT
/begin MEASUREMENT injr.STR_INJR_REQGNHOM1P0.soi_1_hom_clc[0] "Calculated start of injection for homogeneous mode, 1.pulse - cylinder individual HPDI-Version" UWORD _CNV_A_R_LINEAR_____200_CM 1 100. 0. 720. DISPLAY_IDENTIFIER SOI_1_HOM_CLC[0] ECU_ADDRESS 0xd0006dc0 FORMAT "%7.3" /end MEASUREMENT
/begin MEASUREMENT injr.STR_INJR_REQGNHOM1P0.soi_1_hom_clc[1] "Calculated start of injection for homogeneous mode, 1.pulse - cylinder individual HPDI-Version" UWORD _CNV_A_R_LINEAR_____200_CM 1 100. 0. 720. DISPLAY_IDENTIFIER SOI_1_HOM_CLC[1] ECU_ADDRESS 0xd0006dc2 FORMAT "%7.3" /end MEASUREMENT
/begin MEASUREMENT injr.STR_INJR_REQGNHOM1P0.soi_1_hom_clc[2] "Calculated start of injection for homogeneous mode, 1.pulse - cylinder individual HPDI-Version" UWORD _CNV_A_R_LINEAR_____200_CM 1 100. 0. 720. DISPLAY_IDENTIFIER SOI_1_HOM_CLC[2] ECU_ADDRESS 0xd0006dc4 FORMAT "%7.3" /end MEASUREMENT
/begin MEASUREMENT injr.STR_INJR_REQGNHOM1P0.soi_1_hom_clc[3] "Calculated start of injection for homogeneous mode, 1.pulse - cylinder individual HPDI-Version" UWORD _CNV_A_R_LINEAR_____200_CM 1 100. 0. 720. DISPLAY_IDENTIFIER SOI_1_HOM_CLC[3] ECU_ADDRESS 0xd0006dc6 FORMAT "%7.3" /end MEASUREMENT
/begin MEASUREMENT injr.STR_INJR_REQGNHOM1P0.soi_1_hom_clc[4] "Calculated start of injection for homogeneous mode, 1.pulse - cylinder individual HPDI-Version" UWORD _CNV_A_R_LINEAR_____200_CM 1 100. 0. 720. DISPLAY_IDENTIFIER SOI_1_HOM_CLC[4] ECU_ADDRESS 0xd0006dc8 FORMAT "%7.3" /end MEASUREMENT
/begin MEASUREMENT injr.STR_INJR_REQGNHOM1P0.soi_1_hom_clc[5] "Calculated start of injection for homogeneous mode, 1.pulse - cylinder individual HPDI-Version" UWORD _CNV_A_R_LINEAR_____200_CM 1 100. 0. 720. DISPLAY_IDENTIFIER SOI_1_HOM_CLC[5] ECU_ADDRESS 0xd0006dca FORMAT "%7.3" /end MEASUREMENT
/begin MEASUREMENT injr.STR_INJR_REQGNHOM1P0.soi_1_hom_clc[6] "Calculated start of injection for homogeneous mode, 1.pulse - cylinder individual HPDI-Version" UWORD _CNV_A_R_LINEAR_____200_CM 1 100. 0. 720. DISPLAY_IDENTIFIER SOI_1_HOM_CLC[6] ECU_ADDRESS 0xd0006dcc FORMAT "%7.3" /end MEASUREMENT
/begin MEASUREMENT injr.STR_INJR_REQGNHOM1P0.soi_1_hom_clc[7] "Calculated start of injection for homogeneous mode, 1.pulse - cylinder individual HPDI-Version" UWORD _CNV_A_R_LINEAR_____200_CM 1 100. 0. 720. DISPLAY_IDENTIFIER SOI_1_HOM_CLC[7] ECU_ADDRESS 0xd0006dce FORMAT "%7.3" /end MEASUREMENT
/begin MEASUREMENT injr.STR_INJR_ISPCLAS0.ti_tun_iv[0] "Cylinder selective Injection Time Correction by the Application System - multiplicative value" UWORD _CNV_A_R_LINEAR_____119_CM 1 100. 0. 15.999755859375 DISPLAY_IDENTIFIER TI_TUN_IV[0] ECU_ADDRESS 0xd0006dd0 FORMAT "%7.4" /end MEASUREMENT
/begin MEASUREMENT injr.STR_INJR_ISPCLAS0.ti_tun_iv[1] "Cylinder selective Injection Time Correction by the Application System - multiplicative value" UWORD _CNV_A_R_LINEAR_____119_CM 1 100. 0. 15.999755859375 DISPLAY_IDENTIFIER TI_TUN_IV[1] ECU_ADDRESS 0xd0006dd2 FORMAT "%7.4" /end MEASUREMENT
/begin MEASUREMENT injr.STR_INJR_ISPCLAS0.ti_tun_iv[2] "Cylinder selective Injection Time Correction by the Application System - multiplicative value" UWORD _CNV_A_R_LINEAR_____119_CM 1 100. 0. 15.999755859375 DISPLAY_IDENTIFIER TI_TUN_IV[2] ECU_ADDRESS 0xd0006dd4 FORMAT "%7.4" /end MEASUREMENT
/begin MEASUREMENT injr.STR_INJR_ISPCLAS0.ti_tun_iv[3] "Cylinder selective Injection Time Correction by the Application System - multiplicative value" UWORD _CNV_A_R_LINEAR_____119_CM 1 100. 0. 15.999755859375 DISPLAY_IDENTIFIER TI_TUN_IV[3] ECU_ADDRESS 0xd0006dd6 FORMAT "%7.4" /end MEASUREMENT
/begin MEASUREMENT injr.STR_INJR_ISPCLAS0.ti_tun_iv[4] "Cylinder selective Injection Time Correction by the Application System - multiplicative value" UWORD _CNV_A_R_LINEAR_____119_CM 1 100. 0. 15.999755859375 DISPLAY_IDENTIFIER TI_TUN_IV[4] ECU_ADDRESS 0xd0006dd8 FORMAT "%7.4" /end MEASUREMENT
/begin MEASUREMENT injr.STR_INJR_ISPCLAS0.ti_tun_iv[5] "Cylinder selective Injection Time Correction by the Application System - multiplicative value" UWORD _CNV_A_R_LINEAR_____119_CM 1 100. 0. 15.999755859375 DISPLAY_IDENTIFIER TI_TUN_IV[5] ECU_ADDRESS 0xd0006dda FORMAT "%7.4" /end MEASUREMENT
/begin MEASUREMENT injr.STR_INJR_ISPCLAS0.ti_tun_iv[6] "Cylinder selective Injection Time Correction by the Application System - multiplicative value" UWORD _CNV_A_R_LINEAR_____119_CM 1 100. 0. 15.999755859375 DISPLAY_IDENTIFIER TI_TUN_IV[6] ECU_ADDRESS 0xd0006ddc FORMAT "%7.4" /end MEASUREMENT
/begin MEASUREMENT injr.STR_INJR_ISPCLAS0.ti_tun_iv[7] "Cylinder selective Injection Time Correction by the Application System - multiplicative value" UWORD _CNV_A_R_LINEAR_____119_CM 1 100. 0. 15.999755859375 DISPLAY_IDENTIFIER TI_TUN_IV[7] ECU_ADDRESS 0xd0006dde FORMAT "%7.4" /end MEASUREMENT
/begin MEASUREMENT injr.STR_INJR_ISPCLAS0.ti_tun_add_iv[0] "Cylinder selective Injection Time Correction by the Application System - additive value" SWORD _CNV_A_R_LINEAR_____456_CM 1 100. -131.072 131.068 DISPLAY_IDENTIFIER TI_TUN_ADD_IV[0] ECU_ADDRESS 0xd0006de0 FORMAT "%8.3" /end MEASUREMENT
/begin MEASUREMENT injr.STR_INJR_ISPCLAS0.ti_tun_add_iv[1] "Cylinder selective Injection Time Correction by the Application System - additive value" SWORD _CNV_A_R_LINEAR_____456_CM 1 100. -131.072 131.068 DISPLAY_IDENTIFIER TI_TUN_ADD_IV[1] ECU_ADDRESS 0xd0006de2 FORMAT "%8.3" /end MEASUREMENT
/begin MEASUREMENT injr.STR_INJR_ISPCLAS0.ti_tun_add_iv[2] "Cylinder selective Injection Time Correction by the Application System - additive value" SWORD _CNV_A_R_LINEAR_____456_CM 1 100. -131.072 131.068 DISPLAY_IDENTIFIER TI_TUN_ADD_IV[2] ECU_ADDRESS 0xd0006de4 FORMAT "%8.3" /end MEASUREMENT
/begin MEASUREMENT injr.STR_INJR_ISPCLAS0.ti_tun_add_iv[3] "Cylinder selective Injection Time Correction by the Application System - additive value" SWORD _CNV_A_R_LINEAR_____456_CM 1 100. -131.072 131.068 DISPLAY_IDENTIFIER TI_TUN_ADD_IV[3] ECU_ADDRESS 0xd0006de6 FORMAT "%8.3" /end MEASUREMENT
/begin MEASUREMENT injr.STR_INJR_ISPCLAS0.ti_tun_add_iv[4] "Cylinder selective Injection Time Correction by the Application System - additive value" SWORD _CNV_A_R_LINEAR_____456_CM 1 100. -131.072 131.068 DISPLAY_IDENTIFIER TI_TUN_ADD_IV[4] ECU_ADDRESS 0xd0006de8 FORMAT "%8.3" /end MEASUREMENT
/begin MEASUREMENT injr.STR_INJR_ISPCLAS0.ti_tun_add_iv[5] "Cylinder selective Injection Time Correction by the Application System - additive value" SWORD _CNV_A_R_LINEAR_____456_CM 1 100. -131.072 131.068 DISPLAY_IDENTIFIER TI_TUN_ADD_IV[5] ECU_ADDRESS 0xd0006dea FORMAT "%8.3" /end MEASUREMENT
/begin MEASUREMENT injr.STR_INJR_ISPCLAS0.ti_tun_add_iv[6] "Cylinder selective Injection Time Correction by the Application System - additive value" SWORD _CNV_A_R_LINEAR_____456_CM 1 100. -131.072 131.068 DISPLAY_IDENTIFIER TI_TUN_ADD_IV[6] ECU_ADDRESS 0xd0006dec FORMAT "%8.3" /end MEASUREMENT
/begin MEASUREMENT injr.STR_INJR_ISPCLAS0.ti_tun_add_iv[7] "Cylinder selective Injection Time Correction by the Application System - additive value" SWORD _CNV_A_R_LINEAR_____456_CM 1 100. -131.072 131.068 DISPLAY_IDENTIFIER TI_TUN_ADD_IV[7] ECU_ADDRESS 0xd0006dee FORMAT "%8.3" /end MEASUREMENT
/begin MEASUREMENT injr.STR_INJR_ACCTLCYL0.lv_scc[0] "Flag that indicates static single cylinder shut off, exhaust cylinder bank individual" UBYTE _CNV_S_2_RANGE__0___1_CM 1 100. 0. 1. DISPLAY_IDENTIFIER LV_SCC_1 ECU_ADDRESS 0xd0006df0 BIT_MASK 0x1 /end MEASUREMENT
/begin MEASUREMENT injr.STR_INJR_ACCTLCYL0.lv_scc[1] "Flag that indicates static single cylinder shut off, exhaust cylinder bank individual" UBYTE _CNV_S_2_RANGE__0___1_CM 1 100. 0. 1. DISPLAY_IDENTIFIER LV_SCC_2 ECU_ADDRESS 0xd0006df1 BIT_MASK 0x1 /end MEASUREMENT
/begin MEASUREMENT injr.STR_INJR_ACCTLCYL0.sum_inh_iv_cbk[0] "Sum of those bits within INH_IV which are allocated to exhaust cylinderbank k" UBYTE _CNV_A_R_LINEAR_____0_CM 1 100. 0. 8. DISPLAY_IDENTIFIER SUM_INH_IV_CBK_1 ECU_ADDRESS 0xd0006df2 FORMAT "%3.0" /end MEASUREMENT
/begin MEASUREMENT injr.STR_INJR_ACCTLCYL0.sum_inh_iv_cbk[1] "Sum of those bits within INH_IV which are allocated to exhaust cylinderbank k" UBYTE _CNV_A_R_LINEAR_____0_CM 1 100. 0. 8. DISPLAY_IDENTIFIER SUM_INH_IV_CBK_2 ECU_ADDRESS 0xd0006df3 FORMAT "%3.0" /end MEASUREMENT
/begin MEASUREMENT injr.STR_INJR_REQGNHOM2P0.eoi_2_hom[0] "end of injection of the second injection for hom. combustion mode (intermediate value)" UWORD _CNV_A_R_LINEAR_____200_CM 1 100. 0. 720. DISPLAY_IDENTIFIER EOI_2_HOM[0] ECU_ADDRESS 0xd0006df4 FORMAT "%7.3" /end MEASUREMENT
/begin MEASUREMENT injr.STR_INJR_REQGNHOM2P0.eoi_2_hom[1] "end of injection of the second injection for hom. combustion mode (intermediate value)" UWORD _CNV_A_R_LINEAR_____200_CM 1 100. 0. 720. DISPLAY_IDENTIFIER EOI_2_HOM[1] ECU_ADDRESS 0xd0006df6 FORMAT "%7.3" /end MEASUREMENT
/begin MEASUREMENT injr.STR_INJR_REQGNHOM2P0.eoi_2_hom[2] "end of injection of the second injection for hom. combustion mode (intermediate value)" UWORD _CNV_A_R_LINEAR_____200_CM 1 100. 0. 720. DISPLAY_IDENTIFIER EOI_2_HOM[2] ECU_ADDRESS 0xd0006df8 FORMAT "%7.3" /end MEASUREMENT
/begin MEASUREMENT injr.STR_INJR_REQGNHOM2P0.eoi_2_hom[3] "end of injection of the second injection for hom. combustion mode (intermediate value)" UWORD _CNV_A_R_LINEAR_____200_CM 1 100. 0. 720. DISPLAY_IDENTIFIER EOI_2_HOM[3] ECU_ADDRESS 0xd0006dfa FORMAT "%7.3" /end MEASUREMENT
/begin MEASUREMENT injr.STR_INJR_REQGNHOM2P0.eoi_2_hom[4] "end of injection of the second injection for hom. combustion mode (intermediate value)" UWORD _CNV_A_R_LINEAR_____200_CM 1 100. 0. 720. DISPLAY_IDENTIFIER EOI_2_HOM[4] ECU_ADDRESS 0xd0006dfc FORMAT "%7.3" /end MEASUREMENT
/begin MEASUREMENT injr.STR_INJR_REQGNHOM2P0.eoi_2_hom[5] "end of injection of the second injection for hom. combustion mode (intermediate value)" UWORD _CNV_A_R_LINEAR_____200_CM 1 100. 0. 720. DISPLAY_IDENTIFIER EOI_2_HOM[5] ECU_ADDRESS 0xd0006dfe FORMAT "%7.3" /end MEASUREMENT
/begin MEASUREMENT injr.STR_INJR_REQGNHOM2P0.eoi_2_hom[6] "end of injection of the second injection for hom. combustion mode (intermediate value)" UWORD _CNV_A_R_LINEAR_____200_CM 1 100. 0. 720. DISPLAY_IDENTIFIER EOI_2_HOM[6] ECU_ADDRESS 0xd0006e00 FORMAT "%7.3" /end MEASUREMENT
/begin MEASUREMENT injr.STR_INJR_REQGNHOM2P0.eoi_2_hom[7] "end of injection of the second injection for hom. combustion mode (intermediate value)" UWORD _CNV_A_R_LINEAR_____200_CM 1 100. 0. 720. DISPLAY_IDENTIFIER EOI_2_HOM[7] ECU_ADDRESS 0xd0006e02 FORMAT "%7.3" /end MEASUREMENT
/begin MEASUREMENT injr.STR_INJR_REQGNHOM3P0.eoi_3_hom[0] "end of injection of the third injection for hom. combustion mode" UWORD _CNV_A_R_LINEAR_____200_CM 1 100. 0. 720. DISPLAY_IDENTIFIER EOI_3_HOM[0] ECU_ADDRESS 0xd0006e04 FORMAT "%7.3" /end MEASUREMENT
/begin MEASUREMENT injr.STR_INJR_REQGNHOM3P0.eoi_3_hom[1] "end of injection of the third injection for hom. combustion mode" UWORD _CNV_A_R_LINEAR_____200_CM 1 100. 0. 720. DISPLAY_IDENTIFIER EOI_3_HOM[1] ECU_ADDRESS 0xd0006e06 FORMAT "%7.3" /end MEASUREMENT
/begin MEASUREMENT injr.STR_INJR_REQGNHOM3P0.eoi_3_hom[2] "end of injection of the third injection for hom. combustion mode" UWORD _CNV_A_R_LINEAR_____200_CM 1 100. 0. 720. DISPLAY_IDENTIFIER EOI_3_HOM[2] ECU_ADDRESS 0xd0006e08 FORMAT "%7.3" /end MEASUREMENT
/begin MEASUREMENT injr.STR_INJR_REQGNHOM3P0.eoi_3_hom[3] "end of injection of the third injection for hom. combustion mode" UWORD _CNV_A_R_LINEAR_____200_CM 1 100. 0. 720. DISPLAY_IDENTIFIER EOI_3_HOM[3] ECU_ADDRESS 0xd0006e0a FORMAT "%7.3" /end MEASUREMENT
/begin MEASUREMENT injr.STR_INJR_REQGNHOM3P0.eoi_3_hom[4] "end of injection of the third injection for hom. combustion mode" UWORD _CNV_A_R_LINEAR_____200_CM 1 100. 0. 720. DISPLAY_IDENTIFIER EOI_3_HOM[4] ECU_ADDRESS 0xd0006e0c FORMAT "%7.3" /end MEASUREMENT
/begin MEASUREMENT injr.STR_INJR_REQGNHOM3P0.eoi_3_hom[5] "end of injection of the third injection for hom. combustion mode" UWORD _CNV_A_R_LINEAR_____200_CM 1 100. 0. 720. DISPLAY_IDENTIFIER EOI_3_HOM[5] ECU_ADDRESS 0xd0006e0e FORMAT "%7.3" /end MEASUREMENT
/begin MEASUREMENT injr.STR_INJR_REQGNHOM3P0.eoi_3_hom[6] "end of injection of the third injection for hom. combustion mode" UWORD _CNV_A_R_LINEAR_____200_CM 1 100. 0. 720. DISPLAY_IDENTIFIER EOI_3_HOM[6] ECU_ADDRESS 0xd0006e10 FORMAT "%7.3" /end MEASUREMENT
/begin MEASUREMENT injr.STR_INJR_REQGNHOM3P0.eoi_3_hom[7] "end of injection of the third injection for hom. combustion mode" UWORD _CNV_A_R_LINEAR_____200_CM 1 100. 0. 720. DISPLAY_IDENTIFIER EOI_3_HOM[7] ECU_ADDRESS 0xd0006e12 FORMAT "%7.3" /end MEASUREMENT
/begin MEASUREMENT lv_crk_dif_soi_eoi_lim "Difference between SOI and EOI is beyond the maximum, the pulse will be limited" UBYTE _CNV_S_2_RANGE__0___1_CM 1 100. 0. 1. DISPLAY_IDENTIFIER LV_CRK_DIF_SOI_EOI_LIM ECU_ADDRESS 0xd000765a BIT_MASK 0x1 /end MEASUREMENT
/begin MEASUREMENT lv_eoi_lim_hom "At least one injection was repositioned to EOI_LIM_HOM" UBYTE _CNV_S_2_RANGE__0___1_CM 1 100. 0. 1. DISPLAY_IDENTIFIER LV_EOI_LIM_HOM ECU_ADDRESS 0xd0003388 BIT_MASK 0x1 /end MEASUREMENT
/begin MEASUREMENT soi_lim "Earliest possible SOI" UWORD _CNV_A_R_LINEAR_____200_CM 1 100. 0. 720. DISPLAY_IDENTIFIER SOI_LIM ECU_ADDRESS 0xd0007074 FORMAT "%7.3" /end MEASUREMENT
/begin CHARACTERISTIC c_eoi_lim_hom "Latest possible EOI" VALUE 0xa080654e _REC_VAL_20_u2 720. _CNV_A_R_LINEAR_____200_CM 0. 720. DISPLAY_IDENTIFIER C_EOI_LIM_HOM FORMAT "%7.3" /end CHARACTERISTIC
/begin CHARACTERISTIC c_eoi_lim_hom_st "Latest possible EOI at start" VALUE 0xa0806552 _REC_VAL_20_u2 720. _CNV_A_R_LINEAR_____200_CM 0. 720. DISPLAY_IDENTIFIER C_EOI_LIM_HOM_ST FORMAT "%7.3" /end CHARACTERISTIC
/begin CHARACTERISTIC c_soi_lim "Earlies possible SOI" VALUE 0xa0806586 _REC_VAL_20_u2 720. _CNV_A_R_LINEAR_____200_CM 0. 720. DISPLAY_IDENTIFIER C_SOI_LIM FORMAT "%7.3" /end CHARACTERISTIC
/begin CHARACTERISTIC ip_eoi_lim_hom_fup_cor "FUP correction of EOI_LIM_HOM" CURVE 0xa08063a4 _REC_CUR_20_u2_u2 720. _CNV_A_R_INJR_LINEA_468_CM -360. 360. DISPLAY_IDENTIFIER IP_EOI_LIM_HOM_FUP_COR FORMAT "%7.3"
 /begin AXIS_DESCR COM_AXIS online_dummy _CNV_A_R_LINEAR_____171_CM 8 0. 347776. FORMAT "%8.1" AXIS_PTS_REF ldpm_fup_h_1_injr /end AXIS_DESCR
/end CHARACTERISTIC
/begin MEASUREMENT eoi_lim_hom "Latest possible EOI at homogeneouse mode" UWORD _CNV_A_R_LINEAR_____200_CM 1 100. 0. 720. DISPLAY_IDENTIFIER EOI_LIM_HOM ECU_ADDRESS 0xd0007008 FORMAT "%7.3" /end MEASUREMENT
/begin MEASUREMENT eoi_1_hom "End of injection for homogeneous mode, 1.pulse - non cylinder individual HPDI-Version" UWORD _CNV_A_R_LINEAR_____200_CM 1 100. 0. 720. DISPLAY_IDENTIFIER EOI_1_HOM ECU_ADDRESS 0xd0006fb4 FORMAT "%7.3" /end MEASUREMENT
/begin AXIS_PTS ldpm_fup_h_1_injr "" 0xa0806268 online_dummy _REC_AXS_20_u2 347776. _CNV_A_R_LINEAR_____171_CM 8 0. 347776. FORMAT "%8.1" /end AXIS_PTS
/begin CHARACTERISTIC c_eoi_lim_hom_multi_cor "Correction value for calculation of the latest possible EOI, if multi injection is active" VALUE 0xa0806550 _REC_VAL_20_s2 720. _CNV_A_R_LINEAR_____200_CM -360. 360. DISPLAY_IDENTIFIER C_EOI_LIM_HOM_MULTI_COR FORMAT "%7.3" /end CHARACTERISTIC
/begin CHARACTERISTIC lc_soi_1_hom_man "Switch for the manual setpoit for EOI" VALUE 0xa08065e7 _REC_VAL_20_u1 1. _CNV_A_R_LINEAR_____0_CM 0. 1. DISPLAY_IDENTIFIER LC_SOI_1_HOM_MAN FORMAT "%1.0" /end CHARACTERISTIC
/begin CHARACTERISTIC lc_soi_1_hom_st_man "Switch to activate the manual setpoint for SOI during start" VALUE 0xa08065e8 _REC_VAL_20_u1 1. _CNV_A_R_LINEAR_____0_CM 0. 1. DISPLAY_IDENTIFIER LC_SOI_1_HOM_ST_MAN FORMAT "%1.0" /end CHARACTERISTIC
/begin CHARACTERISTIC c_soi_1_hom_man "Manual setpoit for EOI" VALUE 0xa080657e _REC_VAL_20_u2 720. _CNV_A_R_LINEAR_____200_CM 0. 720. DISPLAY_IDENTIFIER C_SOI_1_HOM_MAN FORMAT "%7.3" /end CHARACTERISTIC
/begin CHARACTERISTIC c_soi_1_hom_st_man "Manual setpoint for SOI during start" VALUE 0xa0806580 _REC_VAL_20_u2 720. _CNV_A_R_LINEAR_____200_CM 0. 720. DISPLAY_IDENTIFIER C_SOI_1_HOM_ST_MAN FORMAT "%7.3" /end CHARACTERISTIC
/begin CHARACTERISTIC c_eoi_3_hom_man "Manual setpoit for EOI of third pulse, homogeneous combustion mode" VALUE 0xa080654c _REC_VAL_20_u2 720. _CNV_A_R_LINEAR_____200_CM 0. 720. DISPLAY_IDENTIFIER C_EOI_3_HOM_MAN FORMAT "%7.3" /end CHARACTERISTIC
/begin CHARACTERISTIC lc_eoi_3_hom_man "switch for enabling the manual setpoint for EOI of third pulse, homogeneous combustion mode" VALUE 0xa08065e2 _REC_VAL_20_u1 1. _CNV_A_R_LINEAR_____0_CM 0. 1. DISPLAY_IDENTIFIER LC_EOI_3_HOM_MAN FORMAT "%1.0" /end CHARACTERISTIC
/begin MEASUREMENT soi_3_hom_max "Maximum start of injection angle of the third injection for homogeneous combustion mode" UWORD _CNV_A_R_LINEAR_____200_CM 1 100. 0. 720. DISPLAY_IDENTIFIER SOI_3_HOM_MAX ECU_ADDRESS 0xd0003342 FORMAT "%7.3" /end MEASUREMENT
/begin MEASUREMENT eoi_2_soi_3_gap_hom "Gap between the second and the third injection at cylinder 0" UWORD _CNV_A_R_LINEAR_____200_CM 1 100. 0. 720. DISPLAY_IDENTIFIER EOI_2_SOI_3_GAP_HOM ECU_ADDRESS 0xd0003300 FORMAT "%7.3" /end MEASUREMENT
/begin MEASUREMENT egy_add_temp "Additive piezo energy correction depending on the injector temperature" SWORD _CNV_A_R_INJR_LINEA_472_CM 1 100. -127.501945536512 127.498054485928 DISPLAY_IDENTIFIER EGY_ADD_TEMP ECU_ADDRESS 0xd0006f60 FORMAT "%8.3" /end MEASUREMENT
/begin AXIS_PTS ldp_tfu_inj_ip_egy_add_temp "" 0xa08061e0 tfu_inj _REC_AXS_20_u1 190.5 _CNV_A_R_LINEAR_____17_CM 8 -48. 142.5 FORMAT "%6.2" /end AXIS_PTS
/begin CHARACTERISTIC ip_egy_add_temp "Additive piezo energy correction depending on the injector temperature" CURVE 0xa0806358 _REC_CUR_20_u2_u1 255.00000002244 _CNV_A_R_INJR_LINEA_471_CM -127.501945536512 127.498054485928 DISPLAY_IDENTIFIER IP_EGY_ADD_TEMP FORMAT "%8.3"
 /begin AXIS_DESCR COM_AXIS tfu_inj _CNV_A_R_LINEAR_____17_CM 8 -48. 142.5 FORMAT "%6.2" AXIS_PTS_REF ldp_tfu_inj_ip_egy_add_temp /end AXIS_DESCR
/end CHARACTERISTIC
/begin CHARACTERISTIC lc_temp_capa_iv_ena "Switch to enable usage of piezo stack temperature" VALUE 0xa08065ec _REC_VAL_20_u1 1. _CNV_A_R_LINEAR_____0_CM 0. 1. DISPLAY_IDENTIFIER LC_TEMP_CAPA_IV_ENA FORMAT "%1.0" /end CHARACTERISTIC
/begin CHARACTERISTIC c_delta_t_min_dui "least time between two injections" VALUE 0xa080651e _REC_VAL_20_u2 65.535 _CNV_A_R_LINEAR_____228_CM 0. 65.535 DISPLAY_IDENTIFIER C_DELTA_T_MIN_DUI /end CHARACTERISTIC
/begin CHARACTERISTIC c_eoi_2_hom_man "Manual setpoit for EOI" VALUE 0xa0806546 _REC_VAL_20_u2 720. _CNV_A_R_LINEAR_____200_CM 0. 720. DISPLAY_IDENTIFIER C_EOI_2_HOM_MAN FORMAT "%7.3" /end CHARACTERISTIC
/begin CHARACTERISTIC lc_eoi_2_hom_man "switch for using the manual setpoit for EOI" VALUE 0xa08065df _REC_VAL_20_u1 1. _CNV_A_R_LINEAR_____0_CM 0. 1. DISPLAY_IDENTIFIER LC_EOI_2_HOM_MAN FORMAT "%1.0" /end CHARACTERISTIC
/begin MEASUREMENT soi_2_hom "Start of injection of the second injection for homogeneous combustion, cylinder 0" UWORD _CNV_A_R_LINEAR_____200_CM 1 100. 0. 720. DISPLAY_IDENTIFIER SOI_2_HOM ECU_ADDRESS 0xd0003340 FORMAT "%7.3" /end MEASUREMENT
/begin MEASUREMENT eoi_1_soi_2_gap_hom "Gap between the two latest calculated injections at cylinder 0" UWORD _CNV_A_R_LINEAR_____200_CM 1 100. 0. 720. DISPLAY_IDENTIFIER EOI_1_SOI_2_GAP_HOM ECU_ADDRESS 0xd00032fe FORMAT "%7.3" /end MEASUREMENT
/begin COMPU_METHOD _CNV_A_R_LINEAR_____0_CM "" RAT_FUNC "%6.3" "-" COEFFS 0 1. 0. 0 0 1 /end COMPU_METHOD
/begin COMPU_METHOD _CNV_S_2_RANGE__0___1_CM "" TAB_VERB "%6.3" "-" COMPU_TAB_REF _CNV_S_2_RANGE__0___1 /end COMPU_METHOD
/begin COMPU_VTAB _CNV_S_2_RANGE__0___1 "" TAB_VERB 2 0 "0" 1 "1" /end COMPU_VTAB
/begin COMPU_METHOD _CNV_A_R_LINEAR_____10_CM "" RAT_FUNC "%6.3" "rpm" COEFFS 0 3.125e-002 0. 0 0 1 /end COMPU_METHOD
/begin COMPU_METHOD _CNV_A_R_LINEAR_____17_CM "" RAT_FUNC "%6.3" "°C" COEFFS 0 1.333333333333333 64. 0 0 1 /end COMPU_METHOD
/begin COMPU_METHOD _CNV_A_R_LINEAR_____20_CM "" RAT_FUNC "%6.3" "ms" COEFFS 0 0.1 0. 0 0 1 /end COMPU_METHOD
/begin COMPU_METHOD _CNV_A_R_LINEAR_____103_CM "" RAT_FUNC "%6.3" "-" COEFFS 0 128. 0. 0 0 1 /end COMPU_METHOD
/begin COMPU_METHOD _CNV_A_R_LINEAR_____119_CM "" RAT_FUNC "%6.3" "-" COEFFS 0 4096. 0. 0 0 1 /end COMPU_METHOD
/begin COMPU_METHOD _CNV_A_R_LINEAR_____171_CM "" RAT_FUNC "%6.3" "hPa" COEFFS 0 0.1884402603974972 0. 0 0 1 /end COMPU_METHOD
/begin COMPU_METHOD _CNV_A_R_LINEAR_____200_CM "" RAT_FUNC "%6.3" "°CRK" COEFFS 0 2.666666666666667 0. 0 0 1 /end COMPU_METHOD
/begin COMPU_METHOD _CNV_A_R_LINEAR_____207_CM "" RAT_FUNC "%6.3" "V" COEFFS 0 51.2 0. 0 0 1 /end COMPU_METHOD
/begin COMPU_METHOD _CNV_A_R_LINEAR_____228_CM "" RAT_FUNC "%6.3" "ms" COEFFS 0 1000. 0. 0 0 1 /end COMPU_METHOD
/begin COMPU_METHOD _CNV_A_R_INJR_LINEA_432_CM "" RAT_FUNC "%6.3" "mJ" COEFFS 0 257. 0. 0 0 1 /end COMPU_METHOD
/begin COMPU_METHOD _CNV_A_R_LINEAR_____456_CM "" RAT_FUNC "%6.3" "ms" COEFFS 0 250. 0. 0 0 1 /end COMPU_METHOD
/begin COMPU_METHOD _CNV_S_2_INJR_RANGE_459_CM "" TAB_VERB "%6.3" "-" COMPU_TAB_REF _CNV_S_2_INJR_RANGE_459 /end COMPU_METHOD
/begin COMPU_VTAB _CNV_S_2_INJR_RANGE_459 "" TAB_VERB 2 0 "IMMEDIATE" 1 "AUTONOMOUS" /end COMPU_VTAB
/begin COMPU_METHOD _CNV_A_R_INJR_LINEA_460_CM "" RAT_FUNC "%6.3" "%" COEFFS 0 163.84 0. 0 0 1 /end COMPU_METHOD
/begin COMPU_METHOD _CNV_S_13_INJR_RANGE_461_CM "" TAB_VERB "%6.3" "-" COMPU_TAB_REF _CNV_S_13_INJR_RANGE_461 /end COMPU_METHOD
/begin COMPU_VTAB _CNV_S_13_INJR_RANGE_461 "" TAB_VERB 13 1 "SNGS" 2 "MPLS" 4 "PRE_INJ" 6 "CRASH" 7 "TEST_PULSE" 33 "SNGS+MPLP" 34 "MPLS+MPLP" 66 "HOMS" 98 "HOMS+MPLP" 128 "DISABLE" 129 "SNGH" 130 "MPLH" 131 "MPLH+PLS3" /end COMPU_VTAB
/begin COMPU_METHOD _CNV_S_4_INJR_RANGE_462_CM "" TAB_VERB "%6.3" "-" COMPU_TAB_REF _CNV_S_4_INJR_RANGE_462 /end COMPU_METHOD
/begin COMPU_VTAB _CNV_S_4_INJR_RANGE_462 "" TAB_VERB 4 0 "INIT_PENDING" 1 "REINIT_PENDING" 2 "INIT_ACTIVE" 3 "INIT_FINISHED" /end COMPU_VTAB
/begin COMPU_METHOD _CNV_A_R_INJR_LINEA_463_CM "" RAT_FUNC "%6.3" "uAs" COEFFS 0 0.4501260352898812 0. 0 0 1 /end COMPU_METHOD
/begin COMPU_METHOD _CNV_A_R_INJR_LINEA_464_CM "" RAT_FUNC "%6.3" "uF" COEFFS 0 2343.884120171674 0. 0 0 1 /end COMPU_METHOD
/begin COMPU_METHOD _CNV_A_R_INJR_LINEA_468_CM "" RAT_FUNC "%6.3" "°CRK" COEFFS 0 2.666666666666667 960. 0 0 1 /end COMPU_METHOD
/begin COMPU_METHOD _CNV_A_R_INJR_LINEA_471_CM "" RAT_FUNC "%6.3" "mJ" COEFFS 0 256.999999977384 32768. 0 0 1 /end COMPU_METHOD
/begin COMPU_METHOD _CNV_A_R_INJR_LINEA_472_CM "" RAT_FUNC "%6.3" "mJ" COEFFS 0 256.999999977384 0. 0 0 1 /end COMPU_METHOD
/begin RECORD_LAYOUT _REC_VAL_20_u1 FNC_VALUES 1 UBYTE COLUMN_DIR DIRECT /end RECORD_LAYOUT
/begin RECORD_LAYOUT _REC_VAL_20_u2 FNC_VALUES 1 UWORD COLUMN_DIR DIRECT /end RECORD_LAYOUT
/begin RECORD_LAYOUT _REC_AXS_20_u1 NO_AXIS_PTS_X 1 UBYTE AXIS_PTS_X 2 UBYTE INDEX_INCR DIRECT /end RECORD_LAYOUT
/begin RECORD_LAYOUT _REC_CUR_20_u1_u1 FNC_VALUES 1 UBYTE COLUMN_DIR DIRECT /end RECORD_LAYOUT
/begin RECORD_LAYOUT _REC_VAL_20_s2 FNC_VALUES 1 SWORD COLUMN_DIR DIRECT /end RECORD_LAYOUT
/begin RECORD_LAYOUT _REC_AXS_20_u2 NO_AXIS_PTS_X 1 UWORD AXIS_PTS_X 2 UWORD INDEX_INCR DIRECT /end RECORD_LAYOUT
/begin RECORD_LAYOUT _REC_CUR_20_u2_u1 FNC_VALUES 1 UWORD COLUMN_DIR DIRECT /end RECORD_LAYOUT
/begin RECORD_LAYOUT _REC_CUR_20_u2_u2 FNC_VALUES 1 UWORD COLUMN_DIR DIRECT /end RECORD_LAYOUT
/begin RECORD_LAYOUT _REC_MAP_20_u1_u1_u1 FNC_VALUES 1 UBYTE COLUMN_DIR DIRECT /end RECORD_LAYOUT
/begin FUNCTION INJR_Transfer_to_basic_sw ""
 /begin DEF_CHARACTERISTIC ip_fac_add_pulse ldp_n_32_ip_fac_add_pulse c_nr_cyl_ofs_inh_iv_dyn c_soi_ext_adj ip_ti_add_pulse_min lc_inj_pls_upd_mod ip_eoi_inj_upd_psn ldp_n_32_ip_eoi_inj_upd_psn ldp_tco_ip_fac_add_pulse ldp_nr_cyl_id_nr_pbk_iv_ptr id_nr_pbk_iv_ptr c_ducy_sp_boost_pbk_iv /end DEF_CHARACTERISTIC
 /begin OUT_MEASUREMENT prev_state_iv lv_inj_upd_trm lv_st_inj inh_iv_dyn crk_psn_eng_inj_upd state_inj_typ_mem_iv nr_cyl_ofs_inh_iv_dyn nr_cyl_inj_bas nr_cyl_inj_bas_prev state_inj_mod_swi_act inh_iv_mis_gen_ack t_inj_crash_act state_inj_upd_mod_cyl_ack ctr_test_mod_iv[0] ctr_test_mod_iv[1] ctr_test_mod_iv[2] ctr_test_mod_iv[3] ctr_test_mod_iv[4] ctr_test_mod_iv[5] ctr_test_mod_iv[6] ctr_test_mod_iv[7] ctr_inh_iv_mis_gen[0] ctr_inh_iv_mis_gen[1] ctr_inh_iv_mis_gen[2] ctr_inh_iv_mis_gen[3] ctr_inh_iv_mis_gen[4] ctr_inh_iv_mis_gen[5] ctr_inh_iv_mis_gen[6] ctr_inh_iv_mis_gen[7] inj_mod_global state_inj_crash_act state_pbk_iv_ini lv_ti_3_hom_act injr.STR_INJR_IFINFTRANS0.str_injr_transfer_to_iosw.fac_add_pulse injr.STR_INJR_IFINFTRANS0.str_injr_transfer_to_iosw.ti_add_pulse_min injr.STR_INJR_IFINFTRANS0.str_injr_transfer_to_iosw.str_injr_transfer_to_iosw_cyl[0].lv_inh_inj injr.STR_INJR_IFINFTRANS0.str_injr_transfer_to_iosw.str_injr_transfer_to_iosw_cyl[0].lv_state_prev_iv injr.STR_INJR_IFINFTRANS0.str_injr_transfer_to_iosw.str_injr_transfer_to_iosw_cyl[0].lv_add_pulse injr.STR_INJR_IFINFTRANS0.str_injr_transfer_to_iosw.str_injr_transfer_to_iosw_cyl[0].inj_mod injr.STR_INJR_IFINFTRANS0.str_injr_transfer_to_iosw.str_injr_transfer_to_iosw_cyl[0].lv_inj_mplp_cyl injr.STR_INJR_IFINFTRANS0.str_injr_transfer_to_iosw.str_injr_transfer_to_iosw_cyl[0].inj_mod_sp injr.STR_INJR_IFINFTRANS0.str_injr_transfer_to_iosw.str_injr_transfer_to_iosw_cyl[0].lv_inj_upd_ack injr.STR_INJR_IFINFTRANS0.str_injr_transfer_to_iosw.str_injr_transfer_to_iosw_cyl[0].str_injr_transfer_to_iosw_pls[0].soi_mes injr.STR_INJR_IFINFTRANS0.str_injr_transfer_to_iosw.str_injr_transfer_to_iosw_cyl[0].str_injr_transfer_to_iosw_pls[0].eoi_mes injr.STR_INJR_IFINFTRANS0.str_injr_transfer_to_iosw.str_injr_transfer_to_iosw_cyl[0].str_injr_transfer_to_iosw_pls[0].cha_iv_mes injr.STR_INJR_IFINFTRANS0.str_injr_transfer_to_iosw.str_injr_transfer_to_iosw_cyl[0].str_injr_transfer_to_iosw_pls[0].v_iv_mes injr.STR_INJR_IFINFTRANS0.str_injr_transfer_to_iosw.str_injr_transfer_to_iosw_cyl[0].str_injr_transfer_to_iosw_pls[0].ti_mes injr.STR_INJR_IFINFTRANS0.str_injr_transfer_to_iosw.str_injr_transfer_to_iosw_cyl[0].str_injr_transfer_to_iosw_pls[0].egy_iv_clc injr.STR_INJR_IFINFTRANS0.str_injr_transfer_to_iosw.str_injr_transfer_to_iosw_cyl[0].str_injr_transfer_to_iosw_pls[0].capa_iv_clc injr.STR_INJR_IFINFTRANS0.str_injr_transfer_to_iosw.str_injr_transfer_to_iosw_cyl[0].str_injr_transfer_to_iosw_pls[1].soi_mes injr.STR_INJR_IFINFTRANS0.str_injr_transfer_to_iosw.str_injr_transfer_to_iosw_cyl[0].str_injr_transfer_to_iosw_pls[1].eoi_mes injr.STR_INJR_IFINFTRANS0.str_injr_transfer_to_iosw.str_injr_transfer_to_iosw_cyl[0].str_injr_transfer_to_iosw_pls[1].cha_iv_mes injr.STR_INJR_IFINFTRANS0.str_injr_transfer_to_iosw.str_injr_transfer_to_iosw_cyl[0].str_injr_transfer_to_iosw_pls[1].v_iv_mes injr.STR_INJR_IFINFTRANS0.str_injr_transfer_to_iosw.str_injr_transfer_to_iosw_cyl[0].str_injr_transfer_to_iosw_pls[1].ti_mes injr.STR_INJR_IFINFTRANS0.str_injr_transfer_to_iosw.str_injr_transfer_to_iosw_cyl[0].str_injr_transfer_to_iosw_pls[1].egy_iv_clc injr.STR_INJR_IFINFTRANS0.str_injr_transfer_to_iosw.str_injr_transfer_to_iosw_cyl[0].str_injr_transfer_to_iosw_pls[1].capa_iv_clc injr.STR_INJR_IFINFTRANS0.str_injr_transfer_to_iosw.str_injr_transfer_to_iosw_cyl[0].str_injr_transfer_to_iosw_pls[3].soi_mes injr.STR_INJR_IFINFTRANS0.str_injr_transfer_to_iosw.str_injr_transfer_to_iosw_cyl[0].str_injr_transfer_to_iosw_pls[3].eoi_mes injr.STR_INJR_IFINFTRANS0.str_injr_transfer_to_iosw.str_injr_transfer_to_iosw_cyl[0].str_injr_transfer_to_iosw_pls[3].cha_iv_mes injr.STR_INJR_IFINFTRANS0.str_injr_transfer_to_iosw.str_injr_transfer_to_iosw_cyl[0].str_injr_transfer_to_iosw_pls[3].v_iv_mes injr.STR_INJR_IFINFTRANS0.str_injr_transfer_to_iosw.str_injr_transfer_to_iosw_cyl[0].str_injr_transfer_to_iosw_pls[3].ti_mes injr.STR_INJR_IFINFTRANS0.str_injr_transfer_to_iosw.str_injr_transfer_to_iosw_cyl[0].str_injr_transfer_to_iosw_pls[3].egy_iv_clc injr.STR_INJR_IFINFTRANS0.str_injr_transfer_to_iosw.str_injr_transfer_to_iosw_cyl[0].str_injr_transfer_to_iosw_pls[3].capa_iv_clc injr.STR_INJR_IFINFTRANS0.str_injr_transfer_to_iosw.str_injr_transfer_to_iosw_cyl[0].state_err_iv_cyl_raw injr.STR_INJR_IFINFTRANS0.str_injr_transfer_to_iosw.str_injr_transfer_to_iosw_cyl[0].cdn_diag_iv_raw injr.STR_INJR_IFINFTRANS0.str_injr_transfer_to_iosw.str_injr_transfer_to_iosw_cyl[1].lv_inh_inj injr.STR_INJR_IFINFTRANS0.str_injr_transfer_to_iosw.str_injr_transfer_to_iosw_cyl[1].lv_state_prev_iv injr.STR_INJR_IFINFTRANS0.str_injr_transfer_to_iosw.str_injr_transfer_to_iosw_cyl[1].lv_add_pulse injr.STR_INJR_IFINFTRANS0.str_injr_transfer_to_iosw.str_injr_transfer_to_iosw_cyl[1].inj_mod injr.STR_INJR_IFINFTRANS0.str_injr_transfer_to_iosw.str_injr_transfer_to_iosw_cyl[1].lv_inj_mplp_cyl injr.STR_INJR_IFINFTRANS0.str_injr_transfer_to_iosw.str_injr_transfer_to_iosw_cyl[1].inj_mod_sp injr.STR_INJR_IFINFTRANS0.str_injr_transfer_to_iosw.str_injr_transfer_to_iosw_cyl[1].lv_inj_upd_ack injr.STR_INJR_IFINFTRANS0.str_injr_transfer_to_iosw.str_injr_transfer_to_iosw_cyl[1].str_injr_transfer_to_iosw_pls[0].soi_mes injr.STR_INJR_IFINFTRANS0.str_injr_transfer_to_iosw.str_injr_transfer_to_iosw_cyl[1].str_injr_transfer_to_iosw_pls[0].eoi_mes injr.STR_INJR_IFINFTRANS0.str_injr_transfer_to_iosw.str_injr_transfer_to_iosw_cyl[1].str_injr_transfer_to_iosw_pls[0].cha_iv_mes injr.STR_INJR_IFINFTRANS0.str_injr_transfer_to_iosw.str_injr_transfer_to_iosw_cyl[1].str_injr_transfer_to_iosw_pls[0].v_iv_mes injr.STR_INJR_IFINFTRANS0.str_injr_transfer_to_iosw.str_injr_transfer_to_iosw_cyl[1].str_injr_transfer_to_iosw_pls[0].ti_mes injr.STR_INJR_IFINFTRANS0.str_injr_transfer_to_iosw.str_injr_transfer_to_iosw_cyl[1].str_injr_transfer_to_iosw_pls[0].egy_iv_clc injr.STR_INJR_IFINFTRANS0.str_injr_transfer_to_iosw.str_injr_transfer_to_iosw_cyl[1].str_injr_transfer_to_iosw_pls[0].capa_iv_clc injr.STR_INJR_IFINFTRANS0.str_injr_transfer_to_iosw.str_injr_transfer_to_iosw_cyl[1].str_injr_transfer_to_iosw_pls[1].soi_mes injr.STR_INJR_IFINFTRANS0.str_injr_transfer_to_iosw.str_injr_transfer_to_iosw_cyl[1].str_injr_transfer_to_iosw_pls[1].eoi_mes injr.STR_INJR_IFINFTRANS0.str_injr_transfer_to_iosw.str_injr_transfer_to_iosw_cyl[1].str_injr_transfer_to_iosw_pls[1].cha_iv_mes injr.STR_INJR_IFINFTRANS0.str_injr_transfer_to_iosw.str_injr_transfer_to_iosw_cyl[1].str_injr_transfer_to_iosw_pls[1].v_iv_mes injr.STR_INJR_IFINFTRANS0.str_injr_transfer_to_iosw.str_injr_transfer_to_iosw_cyl[1].str_injr_transfer_to_iosw_pls[1].ti_mes injr.STR_INJR_IFINFTRANS0.str_injr_transfer_to_iosw.str_injr_transfer_to_iosw_cyl[1].str_injr_transfer_to_iosw_pls[1].egy_iv_clc injr.STR_INJR_IFINFTRANS0.str_injr_transfer_to_iosw.str_injr_transfer_to_iosw_cyl[1].str_injr_transfer_to_iosw_pls[1].capa_iv_clc injr.STR_INJR_IFINFTRANS0.str_injr_transfer_to_iosw.str_injr_transfer_to_iosw_cyl[1].str_injr_transfer_to_iosw_pls[3].soi_mes injr.STR_INJR_IFINFTRANS0.str_injr_transfer_to_iosw.str_injr_transfer_to_iosw_cyl[1].str_injr_transfer_to_iosw_pls[3].eoi_mes injr.STR_INJR_IFINFTRANS0.str_injr_transfer_to_iosw.str_injr_transfer_to_iosw_cyl[1].str_injr_transfer_to_iosw_pls[3].cha_iv_mes injr.STR_INJR_IFINFTRANS0.str_injr_transfer_to_iosw.str_injr_transfer_to_iosw_cyl[1].str_injr_transfer_to_iosw_pls[3].v_iv_mes injr.STR_INJR_IFINFTRANS0.str_injr_transfer_to_iosw.str_injr_transfer_to_iosw_cyl[1].str_injr_transfer_to_iosw_pls[3].ti_mes injr.STR_INJR_IFINFTRANS0.str_injr_transfer_to_iosw.str_injr_transfer_to_iosw_cyl[1].str_injr_transfer_to_iosw_pls[3].egy_iv_clc injr.STR_INJR_IFINFTRANS0.str_injr_transfer_to_iosw.str_injr_transfer_to_iosw_cyl[1].str_injr_transfer_to_iosw_pls[3].capa_iv_clc injr.STR_INJR_IFINFTRANS0.str_injr_transfer_to_iosw.str_injr_transfer_to_iosw_cyl[1].state_err_iv_cyl_raw injr.STR_INJR_IFINFTRANS0.str_injr_transfer_to_iosw.str_injr_transfer_to_iosw_cyl[1].cdn_diag_iv_raw injr.STR_INJR_IFINFTRANS0.str_injr_transfer_to_iosw.str_injr_transfer_to_iosw_cyl[2].lv_inh_inj injr.STR_INJR_IFINFTRANS0.str_injr_transfer_to_iosw.str_injr_transfer_to_iosw_cyl[2].lv_state_prev_iv injr.STR_INJR_IFINFTRANS0.str_injr_transfer_to_iosw.str_injr_transfer_to_iosw_cyl[2].lv_add_pulse injr.STR_INJR_IFINFTRANS0.str_injr_transfer_to_iosw.str_injr_transfer_to_iosw_cyl[2].inj_mod injr.STR_INJR_IFINFTRANS0.str_injr_transfer_to_iosw.str_injr_transfer_to_iosw_cyl[2].lv_inj_mplp_cyl injr.STR_INJR_IFINFTRANS0.str_injr_transfer_to_iosw.str_injr_transfer_to_iosw_cyl[2].inj_mod_sp injr.STR_INJR_IFINFTRANS0.str_injr_transfer_to_iosw.str_injr_transfer_to_iosw_cyl[2].lv_inj_upd_ack injr.STR_INJR_IFINFTRANS0.str_injr_transfer_to_iosw.str_injr_transfer_to_iosw_cyl[2].str_injr_transfer_to_iosw_pls[0].soi_mes injr.STR_INJR_IFINFTRANS0.str_injr_transfer_to_iosw.str_injr_transfer_to_iosw_cyl[2].str_injr_transfer_to_iosw_pls[0].eoi_mes injr.STR_INJR_IFINFTRANS0.str_injr_transfer_to_iosw.str_injr_transfer_to_iosw_cyl[2].str_injr_transfer_to_iosw_pls[0].cha_iv_mes injr.STR_INJR_IFINFTRANS0.str_injr_transfer_to_iosw.str_injr_transfer_to_iosw_cyl[2].str_injr_transfer_to_iosw_pls[0].v_iv_mes injr.STR_INJR_IFINFTRANS0.str_injr_transfer_to_iosw.str_injr_transfer_to_iosw_cyl[2].str_injr_transfer_to_iosw_pls[0].ti_mes injr.STR_INJR_IFINFTRANS0.str_injr_transfer_to_iosw.str_injr_transfer_to_iosw_cyl[2].str_injr_transfer_to_iosw_pls[0].egy_iv_clc injr.STR_INJR_IFINFTRANS0.str_injr_transfer_to_iosw.str_injr_transfer_to_iosw_cyl[2].str_injr_transfer_to_iosw_pls[0].capa_iv_clc injr.STR_INJR_IFINFTRANS0.str_injr_transfer_to_iosw.str_injr_transfer_to_iosw_cyl[2].str_injr_transfer_to_iosw_pls[1].soi_mes injr.STR_INJR_IFINFTRANS0.str_injr_transfer_to_iosw.str_injr_transfer_to_iosw_cyl[2].str_injr_transfer_to_iosw_pls[1].eoi_mes injr.STR_INJR_IFINFTRANS0.str_injr_transfer_to_iosw.str_injr_transfer_to_iosw_cyl[2].str_injr_transfer_to_iosw_pls[1].cha_iv_mes injr.STR_INJR_IFINFTRANS0.str_injr_transfer_to_iosw.str_injr_transfer_to_iosw_cyl[2].str_injr_transfer_to_iosw_pls[1].v_iv_mes injr.STR_INJR_IFINFTRANS0.str_injr_transfer_to_iosw.str_injr_transfer_to_iosw_cyl[2].str_injr_transfer_to_iosw_pls[1].ti_mes injr.STR_INJR_IFINFTRANS0.str_injr_transfer_to_iosw.str_injr_transfer_to_iosw_cyl[2].str_injr_transfer_to_iosw_pls[1].egy_iv_clc injr.STR_INJR_IFINFTRANS0.str_injr_transfer_to_iosw.str_injr_transfer_to_iosw_cyl[2].str_injr_transfer_to_iosw_pls[1].capa_iv_clc injr.STR_INJR_IFINFTRANS0.str_injr_transfer_to_iosw.str_injr_transfer_to_iosw_cyl[2].str_injr_transfer_to_iosw_pls[3].soi_mes injr.STR_INJR_IFINFTRANS0.str_injr_transfer_to_iosw.str_injr_transfer_to_iosw_cyl[2].str_injr_transfer_to_iosw_pls[3].eoi_mes injr.STR_INJR_IFINFTRANS0.str_injr_transfer_to_iosw.str_injr_transfer_to_iosw_cyl[2].str_injr_transfer_to_iosw_pls[3].cha_iv_mes injr.STR_INJR_IFINFTRANS0.str_injr_transfer_to_iosw.str_injr_transfer_to_iosw_cyl[2].str_injr_transfer_to_iosw_pls[3].v_iv_mes injr.STR_INJR_IFINFTRANS0.str_injr_transfer_to_iosw.str_injr_transfer_to_iosw_cyl[2].str_injr_transfer_to_iosw_pls[3].ti_mes injr.STR_INJR_IFINFTRANS0.str_injr_transfer_to_iosw.str_injr_transfer_to_iosw_cyl[2].str_injr_transfer_to_iosw_pls[3].egy_iv_clc injr.STR_INJR_IFINFTRANS0.str_injr_transfer_to_iosw.str_injr_transfer_to_iosw_cyl[2].str_injr_transfer_to_iosw_pls[3].capa_iv_clc injr.STR_INJR_IFINFTRANS0.str_injr_transfer_to_iosw.str_injr_transfer_to_iosw_cyl[2].state_err_iv_cyl_raw injr.STR_INJR_IFINFTRANS0.str_injr_transfer_to_iosw.str_injr_transfer_to_iosw_cyl[2].cdn_diag_iv_raw injr.STR_INJR_IFINFTRANS0.str_injr_transfer_to_iosw.str_injr_transfer_to_iosw_cyl[3].lv_inh_inj injr.STR_INJR_IFINFTRANS0.str_injr_transfer_to_iosw.str_injr_transfer_to_iosw_cyl[3].lv_state_prev_iv injr.STR_INJR_IFINFTRANS0.str_injr_transfer_to_iosw.str_injr_transfer_to_iosw_cyl[3].lv_add_pulse injr.STR_INJR_IFINFTRANS0.str_injr_transfer_to_iosw.str_injr_transfer_to_iosw_cyl[3].inj_mod injr.STR_INJR_IFINFTRANS0.str_injr_transfer_to_iosw.str_injr_transfer_to_iosw_cyl[3].lv_inj_mplp_cyl injr.STR_INJR_IFINFTRANS0.str_injr_transfer_to_iosw.str_injr_transfer_to_iosw_cyl[3].inj_mod_sp injr.STR_INJR_IFINFTRANS0.str_injr_transfer_to_iosw.str_injr_transfer_to_iosw_cyl[3].lv_inj_upd_ack injr.STR_INJR_IFINFTRANS0.str_injr_transfer_to_iosw.str_injr_transfer_to_iosw_cyl[3].str_injr_transfer_to_iosw_pls[0].soi_mes injr.STR_INJR_IFINFTRANS0.str_injr_transfer_to_iosw.str_injr_transfer_to_iosw_cyl[3].str_injr_transfer_to_iosw_pls[0].eoi_mes injr.STR_INJR_IFINFTRANS0.str_injr_transfer_to_iosw.str_injr_transfer_to_iosw_cyl[3].str_injr_transfer_to_iosw_pls[0].cha_iv_mes injr.STR_INJR_IFINFTRANS0.str_injr_transfer_to_iosw.str_injr_transfer_to_iosw_cyl[3].str_injr_transfer_to_iosw_pls[0].v_iv_mes injr.STR_INJR_IFINFTRANS0.str_injr_transfer_to_iosw.str_injr_transfer_to_iosw_cyl[3].str_injr_transfer_to_iosw_pls[0].ti_mes injr.STR_INJR_IFINFTRANS0.str_injr_transfer_to_iosw.str_injr_transfer_to_iosw_cyl[3].str_injr_transfer_to_iosw_pls[0].egy_iv_clc injr.STR_INJR_IFINFTRANS0.str_injr_transfer_to_iosw.str_injr_transfer_to_iosw_cyl[3].str_injr_transfer_to_iosw_pls[0].capa_iv_clc injr.STR_INJR_IFINFTRANS0.str_injr_transfer_to_iosw.str_injr_transfer_to_iosw_cyl[3].str_injr_transfer_to_iosw_pls[1].soi_mes injr.STR_INJR_IFINFTRANS0.str_injr_transfer_to_iosw.str_injr_transfer_to_iosw_cyl[3].str_injr_transfer_to_iosw_pls[1].eoi_mes injr.STR_INJR_IFINFTRANS0.str_injr_transfer_to_iosw.str_injr_transfer_to_iosw_cyl[3].str_injr_transfer_to_iosw_pls[1].cha_iv_mes injr.STR_INJR_IFINFTRANS0.str_injr_transfer_to_iosw.str_injr_transfer_to_iosw_cyl[3].str_injr_transfer_to_iosw_pls[1].v_iv_mes injr.STR_INJR_IFINFTRANS0.str_injr_transfer_to_iosw.str_injr_transfer_to_iosw_cyl[3].str_injr_transfer_to_iosw_pls[1].ti_mes injr.STR_INJR_IFINFTRANS0.str_injr_transfer_to_iosw.str_injr_transfer_to_iosw_cyl[3].str_injr_transfer_to_iosw_pls[1].egy_iv_clc injr.STR_INJR_IFINFTRANS0.str_injr_transfer_to_iosw.str_injr_transfer_to_iosw_cyl[3].str_injr_transfer_to_iosw_pls[1].capa_iv_clc injr.STR_INJR_IFINFTRANS0.str_injr_transfer_to_iosw.str_injr_transfer_to_iosw_cyl[3].str_injr_transfer_to_iosw_pls[3].soi_mes injr.STR_INJR_IFINFTRANS0.str_injr_transfer_to_iosw.str_injr_transfer_to_iosw_cyl[3].str_injr_transfer_to_iosw_pls[3].eoi_mes injr.STR_INJR_IFINFTRANS0.str_injr_transfer_to_iosw.str_injr_transfer_to_iosw_cyl[3].str_injr_transfer_to_iosw_pls[3].cha_iv_mes injr.STR_INJR_IFINFTRANS0.str_injr_transfer_to_iosw.str_injr_transfer_to_iosw_cyl[3].str_injr_transfer_to_iosw_pls[3].v_iv_mes injr.STR_INJR_IFINFTRANS0.str_injr_transfer_to_iosw.str_injr_transfer_to_iosw_cyl[3].str_injr_transfer_to_iosw_pls[3].ti_mes injr.STR_INJR_IFINFTRANS0.str_injr_transfer_to_iosw.str_injr_transfer_to_iosw_cyl[3].str_injr_transfer_to_iosw_pls[3].egy_iv_clc injr.STR_INJR_IFINFTRANS0.str_injr_transfer_to_iosw.str_injr_transfer_to_iosw_cyl[3].str_injr_transfer_to_iosw_pls[3].capa_iv_clc injr.STR_INJR_IFINFTRANS0.str_injr_transfer_to_iosw.str_injr_transfer_to_iosw_cyl[3].state_err_iv_cyl_raw injr.STR_INJR_IFINFTRANS0.str_injr_transfer_to_iosw.str_injr_transfer_to_iosw_cyl[3].cdn_diag_iv_raw injr.STR_INJR_IFINFTRANS0.str_injr_transfer_to_iosw.str_injr_transfer_to_iosw_cyl[4].lv_inh_inj injr.STR_INJR_IFINFTRANS0.str_injr_transfer_to_iosw.str_injr_transfer_to_iosw_cyl[4].lv_state_prev_iv injr.STR_INJR_IFINFTRANS0.str_injr_transfer_to_iosw.str_injr_transfer_to_iosw_cyl[4].lv_add_pulse injr.STR_INJR_IFINFTRANS0.str_injr_transfer_to_iosw.str_injr_transfer_to_iosw_cyl[4].inj_mod injr.STR_INJR_IFINFTRANS0.str_injr_transfer_to_iosw.str_injr_transfer_to_iosw_cyl[4].lv_inj_mplp_cyl injr.STR_INJR_IFINFTRANS0.str_injr_transfer_to_iosw.str_injr_transfer_to_iosw_cyl[4].inj_mod_sp injr.STR_INJR_IFINFTRANS0.str_injr_transfer_to_iosw.str_injr_transfer_to_iosw_cyl[4].lv_inj_upd_ack injr.STR_INJR_IFINFTRANS0.str_injr_transfer_to_iosw.str_injr_transfer_to_iosw_cyl[4].str_injr_transfer_to_iosw_pls[0].soi_mes injr.STR_INJR_IFINFTRANS0.str_injr_transfer_to_iosw.str_injr_transfer_to_iosw_cyl[4].str_injr_transfer_to_iosw_pls[0].eoi_mes injr.STR_INJR_IFINFTRANS0.str_injr_transfer_to_iosw.str_injr_transfer_to_iosw_cyl[4].str_injr_transfer_to_iosw_pls[0].cha_iv_mes injr.STR_INJR_IFINFTRANS0.str_injr_transfer_to_iosw.str_injr_transfer_to_iosw_cyl[4].str_injr_transfer_to_iosw_pls[0].v_iv_mes injr.STR_INJR_IFINFTRANS0.str_injr_transfer_to_iosw.str_injr_transfer_to_iosw_cyl[4].str_injr_transfer_to_iosw_pls[0].ti_mes injr.STR_INJR_IFINFTRANS0.str_injr_transfer_to_iosw.str_injr_transfer_to_iosw_cyl[4].str_injr_transfer_to_iosw_pls[0].egy_iv_clc injr.STR_INJR_IFINFTRANS0.str_injr_transfer_to_iosw.str_injr_transfer_to_iosw_cyl[4].str_injr_transfer_to_iosw_pls[0].capa_iv_clc injr.STR_INJR_IFINFTRANS0.str_injr_transfer_to_iosw.str_injr_transfer_to_iosw_cyl[4].str_injr_transfer_to_iosw_pls[1].soi_mes injr.STR_INJR_IFINFTRANS0.str_injr_transfer_to_iosw.str_injr_transfer_to_iosw_cyl[4].str_injr_transfer_to_iosw_pls[1].eoi_mes injr.STR_INJR_IFINFTRANS0.str_injr_transfer_to_iosw.str_injr_transfer_to_iosw_cyl[4].str_injr_transfer_to_iosw_pls[1].cha_iv_mes injr.STR_INJR_IFINFTRANS0.str_injr_transfer_to_iosw.str_injr_transfer_to_iosw_cyl[4].str_injr_transfer_to_iosw_pls[1].v_iv_mes injr.STR_INJR_IFINFTRANS0.str_injr_transfer_to_iosw.str_injr_transfer_to_iosw_cyl[4].str_injr_transfer_to_iosw_pls[1].ti_mes injr.STR_INJR_IFINFTRANS0.str_injr_transfer_to_iosw.str_injr_transfer_to_iosw_cyl[4].str_injr_transfer_to_iosw_pls[1].egy_iv_clc injr.STR_INJR_IFINFTRANS0.str_injr_transfer_to_iosw.str_injr_transfer_to_iosw_cyl[4].str_injr_transfer_to_iosw_pls[1].capa_iv_clc injr.STR_INJR_IFINFTRANS0.str_injr_transfer_to_iosw.str_injr_transfer_to_iosw_cyl[4].str_injr_transfer_to_iosw_pls[3].soi_mes injr.STR_INJR_IFINFTRANS0.str_injr_transfer_to_iosw.str_injr_transfer_to_iosw_cyl[4].str_injr_transfer_to_iosw_pls[3].eoi_mes injr.STR_INJR_IFINFTRANS0.str_injr_transfer_to_iosw.str_injr_transfer_to_iosw_cyl[4].str_injr_transfer_to_iosw_pls[3].cha_iv_mes injr.STR_INJR_IFINFTRANS0.str_injr_transfer_to_iosw.str_injr_transfer_to_iosw_cyl[4].str_injr_transfer_to_iosw_pls[3].v_iv_mes injr.STR_INJR_IFINFTRANS0.str_injr_transfer_to_iosw.str_injr_transfer_to_iosw_cyl[4].str_injr_transfer_to_iosw_pls[3].ti_mes injr.STR_INJR_IFINFTRANS0.str_injr_transfer_to_iosw.str_injr_transfer_to_iosw_cyl[4].str_injr_transfer_to_iosw_pls[3].egy_iv_clc injr.STR_INJR_IFINFTRANS0.str_injr_transfer_to_iosw.str_injr_transfer_to_iosw_cyl[4].str_injr_transfer_to_iosw_pls[3].capa_iv_clc injr.STR_INJR_IFINFTRANS0.str_injr_transfer_to_iosw.str_injr_transfer_to_iosw_cyl[4].state_err_iv_cyl_raw injr.STR_INJR_IFINFTRANS0.str_injr_transfer_to_iosw.str_injr_transfer_to_iosw_cyl[4].cdn_diag_iv_raw injr.STR_INJR_IFINFTRANS0.str_injr_transfer_to_iosw.str_injr_transfer_to_iosw_cyl[5].lv_inh_inj injr.STR_INJR_IFINFTRANS0.str_injr_transfer_to_iosw.str_injr_transfer_to_iosw_cyl[5].lv_state_prev_iv injr.STR_INJR_IFINFTRANS0.str_injr_transfer_to_iosw.str_injr_transfer_to_iosw_cyl[5].lv_add_pulse injr.STR_INJR_IFINFTRANS0.str_injr_transfer_to_iosw.str_injr_transfer_to_iosw_cyl[5].inj_mod injr.STR_INJR_IFINFTRANS0.str_injr_transfer_to_iosw.str_injr_transfer_to_iosw_cyl[5].lv_inj_mplp_cyl injr.STR_INJR_IFINFTRANS0.str_injr_transfer_to_iosw.str_injr_transfer_to_iosw_cyl[5].inj_mod_sp injr.STR_INJR_IFINFTRANS0.str_injr_transfer_to_iosw.str_injr_transfer_to_iosw_cyl[5].lv_inj_upd_ack injr.STR_INJR_IFINFTRANS0.str_injr_transfer_to_iosw.str_injr_transfer_to_iosw_cyl[5].str_injr_transfer_to_iosw_pls[0].soi_mes injr.STR_INJR_IFINFTRANS0.str_injr_transfer_to_iosw.str_injr_transfer_to_iosw_cyl[5].str_injr_transfer_to_iosw_pls[0].eoi_mes injr.STR_INJR_IFINFTRANS0.str_injr_transfer_to_iosw.str_injr_transfer_to_iosw_cyl[5].str_injr_transfer_to_iosw_pls[0].cha_iv_mes injr.STR_INJR_IFINFTRANS0.str_injr_transfer_to_iosw.str_injr_transfer_to_iosw_cyl[5].str_injr_transfer_to_iosw_pls[0].v_iv_mes injr.STR_INJR_IFINFTRANS0.str_injr_transfer_to_iosw.str_injr_transfer_to_iosw_cyl[5].str_injr_transfer_to_iosw_pls[0].ti_mes injr.STR_INJR_IFINFTRANS0.str_injr_transfer_to_iosw.str_injr_transfer_to_iosw_cyl[5].str_injr_transfer_to_iosw_pls[0].egy_iv_clc injr.STR_INJR_IFINFTRANS0.str_injr_transfer_to_iosw.str_injr_transfer_to_iosw_cyl[5].str_injr_transfer_to_iosw_pls[0].capa_iv_clc injr.STR_INJR_IFINFTRANS0.str_injr_transfer_to_iosw.str_injr_transfer_to_iosw_cyl[5].str_injr_transfer_to_iosw_pls[1].soi_mes injr.STR_INJR_IFINFTRANS0.str_injr_transfer_to_iosw.str_injr_transfer_to_iosw_cyl[5].str_injr_transfer_to_iosw_pls[1].eoi_mes injr.STR_INJR_IFINFTRANS0.str_injr_transfer_to_iosw.str_injr_transfer_to_iosw_cyl[5].str_injr_transfer_to_iosw_pls[1].cha_iv_mes injr.STR_INJR_IFINFTRANS0.str_injr_transfer_to_iosw.str_injr_transfer_to_iosw_cyl[5].str_injr_transfer_to_iosw_pls[1].v_iv_mes injr.STR_INJR_IFINFTRANS0.str_injr_transfer_to_iosw.str_injr_transfer_to_iosw_cyl[5].str_injr_transfer_to_iosw_pls[1].ti_mes injr.STR_INJR_IFINFTRANS0.str_injr_transfer_to_iosw.str_injr_transfer_to_iosw_cyl[5].str_injr_transfer_to_iosw_pls[1].egy_iv_clc injr.STR_INJR_IFINFTRANS0.str_injr_transfer_to_iosw.str_injr_transfer_to_iosw_cyl[5].str_injr_transfer_to_iosw_pls[1].capa_iv_clc injr.STR_INJR_IFINFTRANS0.str_injr_transfer_to_iosw.str_injr_transfer_to_iosw_cyl[5].str_injr_transfer_to_iosw_pls[3].soi_mes injr.STR_INJR_IFINFTRANS0.str_injr_transfer_to_iosw.str_injr_transfer_to_iosw_cyl[5].str_injr_transfer_to_iosw_pls[3].eoi_mes injr.STR_INJR_IFINFTRANS0.str_injr_transfer_to_iosw.str_injr_transfer_to_iosw_cyl[5].str_injr_transfer_to_iosw_pls[3].cha_iv_mes injr.STR_INJR_IFINFTRANS0.str_injr_transfer_to_iosw.str_injr_transfer_to_iosw_cyl[5].str_injr_transfer_to_iosw_pls[3].v_iv_mes injr.STR_INJR_IFINFTRANS0.str_injr_transfer_to_iosw.str_injr_transfer_to_iosw_cyl[5].str_injr_transfer_to_iosw_pls[3].ti_mes injr.STR_INJR_IFINFTRANS0.str_injr_transfer_to_iosw.str_injr_transfer_to_iosw_cyl[5].str_injr_transfer_to_iosw_pls[3].egy_iv_clc injr.STR_INJR_IFINFTRANS0.str_injr_transfer_to_iosw.str_injr_transfer_to_iosw_cyl[5].str_injr_transfer_to_iosw_pls[3].capa_iv_clc injr.STR_INJR_IFINFTRANS0.str_injr_transfer_to_iosw.str_injr_transfer_to_iosw_cyl[5].state_err_iv_cyl_raw injr.STR_INJR_IFINFTRANS0.str_injr_transfer_to_iosw.str_injr_transfer_to_iosw_cyl[5].cdn_diag_iv_raw injr.STR_INJR_IFINFTRANS0.str_injr_transfer_to_iosw.str_injr_transfer_to_iosw_cyl[6].lv_inh_inj injr.STR_INJR_IFINFTRANS0.str_injr_transfer_to_iosw.str_injr_transfer_to_iosw_cyl[6].lv_state_prev_iv injr.STR_INJR_IFINFTRANS0.str_injr_transfer_to_iosw.str_injr_transfer_to_iosw_cyl[6].lv_add_pulse injr.STR_INJR_IFINFTRANS0.str_injr_transfer_to_iosw.str_injr_transfer_to_iosw_cyl[6].inj_mod injr.STR_INJR_IFINFTRANS0.str_injr_transfer_to_iosw.str_injr_transfer_to_iosw_cyl[6].lv_inj_mplp_cyl injr.STR_INJR_IFINFTRANS0.str_injr_transfer_to_iosw.str_injr_transfer_to_iosw_cyl[6].inj_mod_sp injr.STR_INJR_IFINFTRANS0.str_injr_transfer_to_iosw.str_injr_transfer_to_iosw_cyl[6].lv_inj_upd_ack injr.STR_INJR_IFINFTRANS0.str_injr_transfer_to_iosw.str_injr_transfer_to_iosw_cyl[6].str_injr_transfer_to_iosw_pls[0].soi_mes injr.STR_INJR_IFINFTRANS0.str_injr_transfer_to_iosw.str_injr_transfer_to_iosw_cyl[6].str_injr_transfer_to_iosw_pls[0].eoi_mes injr.STR_INJR_IFINFTRANS0.str_injr_transfer_to_iosw.str_injr_transfer_to_iosw_cyl[6].str_injr_transfer_to_iosw_pls[0].cha_iv_mes injr.STR_INJR_IFINFTRANS0.str_injr_transfer_to_iosw.str_injr_transfer_to_iosw_cyl[6].str_injr_transfer_to_iosw_pls[0].v_iv_mes injr.STR_INJR_IFINFTRANS0.str_injr_transfer_to_iosw.str_injr_transfer_to_iosw_cyl[6].str_injr_transfer_to_iosw_pls[0].ti_mes injr.STR_INJR_IFINFTRANS0.str_injr_transfer_to_iosw.str_injr_transfer_to_iosw_cyl[6].str_injr_transfer_to_iosw_pls[0].egy_iv_clc injr.STR_INJR_IFINFTRANS0.str_injr_transfer_to_iosw.str_injr_transfer_to_iosw_cyl[6].str_injr_transfer_to_iosw_pls[0].capa_iv_clc injr.STR_INJR_IFINFTRANS0.str_injr_transfer_to_iosw.str_injr_transfer_to_iosw_cyl[6].str_injr_transfer_to_iosw_pls[1].soi_mes injr.STR_INJR_IFINFTRANS0.str_injr_transfer_to_iosw.str_injr_transfer_to_iosw_cyl[6].str_injr_transfer_to_iosw_pls[1].eoi_mes injr.STR_INJR_IFINFTRANS0.str_injr_transfer_to_iosw.str_injr_transfer_to_iosw_cyl[6].str_injr_transfer_to_iosw_pls[1].cha_iv_mes injr.STR_INJR_IFINFTRANS0.str_injr_transfer_to_iosw.str_injr_transfer_to_iosw_cyl[6].str_injr_transfer_to_iosw_pls[1].v_iv_mes injr.STR_INJR_IFINFTRANS0.str_injr_transfer_to_iosw.str_injr_transfer_to_iosw_cyl[6].str_injr_transfer_to_iosw_pls[1].ti_mes injr.STR_INJR_IFINFTRANS0.str_injr_transfer_to_iosw.str_injr_transfer_to_iosw_cyl[6].str_injr_transfer_to_iosw_pls[1].egy_iv_clc injr.STR_INJR_IFINFTRANS0.str_injr_transfer_to_iosw.str_injr_transfer_to_iosw_cyl[6].str_injr_transfer_to_iosw_pls[1].capa_iv_clc injr.STR_INJR_IFINFTRANS0.str_injr_transfer_to_iosw.str_injr_transfer_to_iosw_cyl[6].str_injr_transfer_to_iosw_pls[3].soi_mes injr.STR_INJR_IFINFTRANS0.str_injr_transfer_to_iosw.str_injr_transfer_to_iosw_cyl[6].str_injr_transfer_to_iosw_pls[3].eoi_mes injr.STR_INJR_IFINFTRANS0.str_injr_transfer_to_iosw.str_injr_transfer_to_iosw_cyl[6].str_injr_transfer_to_iosw_pls[3].cha_iv_mes injr.STR_INJR_IFINFTRANS0.str_injr_transfer_to_iosw.str_injr_transfer_to_iosw_cyl[6].str_injr_transfer_to_iosw_pls[3].v_iv_mes injr.STR_INJR_IFINFTRANS0.str_injr_transfer_to_iosw.str_injr_transfer_to_iosw_cyl[6].str_injr_transfer_to_iosw_pls[3].ti_mes injr.STR_INJR_IFINFTRANS0.str_injr_transfer_to_iosw.str_injr_transfer_to_iosw_cyl[6].str_injr_transfer_to_iosw_pls[3].egy_iv_clc injr.STR_INJR_IFINFTRANS0.str_injr_transfer_to_iosw.str_injr_transfer_to_iosw_cyl[6].str_injr_transfer_to_iosw_pls[3].capa_iv_clc injr.STR_INJR_IFINFTRANS0.str_injr_transfer_to_iosw.str_injr_transfer_to_iosw_cyl[6].state_err_iv_cyl_raw injr.STR_INJR_IFINFTRANS0.str_injr_transfer_to_iosw.str_injr_transfer_to_iosw_cyl[6].cdn_diag_iv_raw injr.STR_INJR_IFINFTRANS0.str_injr_transfer_to_iosw.str_injr_transfer_to_iosw_cyl[7].lv_inh_inj injr.STR_INJR_IFINFTRANS0.str_injr_transfer_to_iosw.str_injr_transfer_to_iosw_cyl[7].lv_state_prev_iv injr.STR_INJR_IFINFTRANS0.str_injr_transfer_to_iosw.str_injr_transfer_to_iosw_cyl[7].lv_add_pulse injr.STR_INJR_IFINFTRANS0.str_injr_transfer_to_iosw.str_injr_transfer_to_iosw_cyl[7].inj_mod injr.STR_INJR_IFINFTRANS0.str_injr_transfer_to_iosw.str_injr_transfer_to_iosw_cyl[7].lv_inj_mplp_cyl injr.STR_INJR_IFINFTRANS0.str_injr_transfer_to_iosw.str_injr_transfer_to_iosw_cyl[7].inj_mod_sp injr.STR_INJR_IFINFTRANS0.str_injr_transfer_to_iosw.str_injr_transfer_to_iosw_cyl[7].lv_inj_upd_ack injr.STR_INJR_IFINFTRANS0.str_injr_transfer_to_iosw.str_injr_transfer_to_iosw_cyl[7].str_injr_transfer_to_iosw_pls[0].soi_mes injr.STR_INJR_IFINFTRANS0.str_injr_transfer_to_iosw.str_injr_transfer_to_iosw_cyl[7].str_injr_transfer_to_iosw_pls[0].eoi_mes injr.STR_INJR_IFINFTRANS0.str_injr_transfer_to_iosw.str_injr_transfer_to_iosw_cyl[7].str_injr_transfer_to_iosw_pls[0].cha_iv_mes injr.STR_INJR_IFINFTRANS0.str_injr_transfer_to_iosw.str_injr_transfer_to_iosw_cyl[7].str_injr_transfer_to_iosw_pls[0].v_iv_mes injr.STR_INJR_IFINFTRANS0.str_injr_transfer_to_iosw.str_injr_transfer_to_iosw_cyl[7].str_injr_transfer_to_iosw_pls[0].ti_mes injr.STR_INJR_IFINFTRANS0.str_injr_transfer_to_iosw.str_injr_transfer_to_iosw_cyl[7].str_injr_transfer_to_iosw_pls[0].egy_iv_clc injr.STR_INJR_IFINFTRANS0.str_injr_transfer_to_iosw.str_injr_transfer_to_iosw_cyl[7].str_injr_transfer_to_iosw_pls[0].capa_iv_clc injr.STR_INJR_IFINFTRANS0.str_injr_transfer_to_iosw.str_injr_transfer_to_iosw_cyl[7].str_injr_transfer_to_iosw_pls[1].soi_mes injr.STR_INJR_IFINFTRANS0.str_injr_transfer_to_iosw.str_injr_transfer_to_iosw_cyl[7].str_injr_transfer_to_iosw_pls[1].eoi_mes injr.STR_INJR_IFINFTRANS0.str_injr_transfer_to_iosw.str_injr_transfer_to_iosw_cyl[7].str_injr_transfer_to_iosw_pls[1].cha_iv_mes injr.STR_INJR_IFINFTRANS0.str_injr_transfer_to_iosw.str_injr_transfer_to_iosw_cyl[7].str_injr_transfer_to_iosw_pls[1].v_iv_mes injr.STR_INJR_IFINFTRANS0.str_injr_transfer_to_iosw.str_injr_transfer_to_iosw_cyl[7].str_injr_transfer_to_iosw_pls[1].ti_mes injr.STR_INJR_IFINFTRANS0.str_injr_transfer_to_iosw.str_injr_transfer_to_iosw_cyl[7].str_injr_transfer_to_iosw_pls[1].egy_iv_clc injr.STR_INJR_IFINFTRANS0.str_injr_transfer_to_iosw.str_injr_transfer_to_iosw_cyl[7].str_injr_transfer_to_iosw_pls[1].capa_iv_clc injr.STR_INJR_IFINFTRANS0.str_injr_transfer_to_iosw.str_injr_transfer_to_iosw_cyl[7].str_injr_transfer_to_iosw_pls[3].soi_mes injr.STR_INJR_IFINFTRANS0.str_injr_transfer_to_iosw.str_injr_transfer_to_iosw_cyl[7].str_injr_transfer_to_iosw_pls[3].eoi_mes injr.STR_INJR_IFINFTRANS0.str_injr_transfer_to_iosw.str_injr_transfer_to_iosw_cyl[7].str_injr_transfer_to_iosw_pls[3].cha_iv_mes injr.STR_INJR_IFINFTRANS0.str_injr_transfer_to_iosw.str_injr_transfer_to_iosw_cyl[7].str_injr_transfer_to_iosw_pls[3].v_iv_mes injr.STR_INJR_IFINFTRANS0.str_injr_transfer_to_iosw.str_injr_transfer_to_iosw_cyl[7].str_injr_transfer_to_iosw_pls[3].ti_mes injr.STR_INJR_IFINFTRANS0.str_injr_transfer_to_iosw.str_injr_transfer_to_iosw_cyl[7].str_injr_transfer_to_iosw_pls[3].egy_iv_clc injr.STR_INJR_IFINFTRANS0.str_injr_transfer_to_iosw.str_injr_transfer_to_iosw_cyl[7].str_injr_transfer_to_iosw_pls[3].capa_iv_clc injr.STR_INJR_IFINFTRANS0.str_injr_transfer_to_iosw.str_injr_transfer_to_iosw_cyl[7].state_err_iv_cyl_raw injr.STR_INJR_IFINFTRANS0.str_injr_transfer_to_iosw.str_injr_transfer_to_iosw_cyl[7].cdn_diag_iv_raw injr.STR_INJR_IFINFTRANS0.str_injr_transfer_to_iosw.lv_iv_mes_vld injr.STR_INJR_IFINFTRANS0.str_injr_transfer_to_iosw.str_injr_transfer_to_iosw_pbk[0].state_err_pbk_iv_raw injr.STR_INJR_IFINFTRANS0.str_injr_transfer_to_iosw.str_injr_transfer_to_iosw_pbk[0].cdn_diag_pbk_iv_raw injr.STR_INJR_IFINFTRANS0.str_injr_transfer_to_iosw.str_injr_transfer_to_iosw_pbk[0].state_err_pbk_iv_st_raw injr.STR_INJR_IFINFTRANS0.str_injr_transfer_to_iosw.str_injr_transfer_to_iosw_pbk[0].lv_state_prev_pbk_iv injr.STR_INJR_IFINFTRANS0.str_injr_transfer_to_iosw.str_injr_transfer_to_iosw_pbk[0].ctr_state_prev_pbk_iv injr.STR_INJR_IFINFTRANS0.str_injr_transfer_to_iosw.str_injr_transfer_to_iosw_pbk[1].state_err_pbk_iv_raw injr.STR_INJR_IFINFTRANS0.str_injr_transfer_to_iosw.str_injr_transfer_to_iosw_pbk[1].cdn_diag_pbk_iv_raw injr.STR_INJR_IFINFTRANS0.str_injr_transfer_to_iosw.str_injr_transfer_to_iosw_pbk[1].state_err_pbk_iv_st_raw injr.STR_INJR_IFINFTRANS0.str_injr_transfer_to_iosw.str_injr_transfer_to_iosw_pbk[1].lv_state_prev_pbk_iv injr.STR_INJR_IFINFTRANS0.str_injr_transfer_to_iosw.str_injr_transfer_to_iosw_pbk[1].ctr_state_prev_pbk_iv injr.STR_INJR_IFINFTRANS0.str_injr_transfer_to_iosw.str_injr_transfer_to_iosw_pbk[2].state_err_pbk_iv_raw injr.STR_INJR_IFINFTRANS0.str_injr_transfer_to_iosw.str_injr_transfer_to_iosw_pbk[2].cdn_diag_pbk_iv_raw injr.STR_INJR_IFINFTRANS0.str_injr_transfer_to_iosw.str_injr_transfer_to_iosw_pbk[2].state_err_pbk_iv_st_raw injr.STR_INJR_IFINFTRANS0.str_injr_transfer_to_iosw.str_injr_transfer_to_iosw_pbk[2].lv_state_prev_pbk_iv injr.STR_INJR_IFINFTRANS0.str_injr_transfer_to_iosw.str_injr_transfer_to_iosw_pbk[2].ctr_state_prev_pbk_iv injr.STR_INJR_IFINFTRANS0.str_injr_transfer_to_iosw.str_injr_transfer_to_iosw_pbk[3].state_err_pbk_iv_raw injr.STR_INJR_IFINFTRANS0.str_injr_transfer_to_iosw.str_injr_transfer_to_iosw_pbk[3].cdn_diag_pbk_iv_raw injr.STR_INJR_IFINFTRANS0.str_injr_transfer_to_iosw.str_injr_transfer_to_iosw_pbk[3].state_err_pbk_iv_st_raw injr.STR_INJR_IFINFTRANS0.str_injr_transfer_to_iosw.str_injr_transfer_to_iosw_pbk[3].lv_state_prev_pbk_iv injr.STR_INJR_IFINFTRANS0.str_injr_transfer_to_iosw.str_injr_transfer_to_iosw_pbk[3].ctr_state_prev_pbk_iv injr.STR_INJR_IFINFTRANS0.str_injr_transfer_to_iosw.vboost_pbk_iv_mes[0] injr.STR_INJR_IFINFTRANS0.str_injr_transfer_to_iosw.vboost_pbk_iv_mes[1] /end OUT_MEASUREMENT
/end FUNCTION
/begin FUNCTION INJR_Injection_phase_1st_pulse ""
 /begin DEF_CHARACTERISTIC c_eoi_lim_hom c_eoi_lim_hom_st c_soi_lim ip_eoi_lim_hom_fup_cor ldpm_fup_h_1_injr c_eoi_lim_hom_multi_cor lc_soi_1_hom_man lc_soi_1_hom_st_man c_soi_1_hom_man c_soi_1_hom_st_man /end DEF_CHARACTERISTIC
 /begin OUT_MEASUREMENT injr.STR_INJR_REQGNHOM1P0.soi_1_hom[0] injr.STR_INJR_REQGNHOM1P0.soi_1_hom[1] injr.STR_INJR_REQGNHOM1P0.soi_1_hom[2] injr.STR_INJR_REQGNHOM1P0.soi_1_hom[3] injr.STR_INJR_REQGNHOM1P0.soi_1_hom[4] injr.STR_INJR_REQGNHOM1P0.soi_1_hom[5] injr.STR_INJR_REQGNHOM1P0.soi_1_hom[6] injr.STR_INJR_REQGNHOM1P0.soi_1_hom[7] injr.STR_INJR_REQGNHOM1P0.soi_1_hom_clc[0] injr.STR_INJR_REQGNHOM1P0.soi_1_hom_clc[1] injr.STR_INJR_REQGNHOM1P0.soi_1_hom_clc[2] injr.STR_INJR_REQGNHOM1P0.soi_1_hom_clc[3] injr.STR_INJR_REQGNHOM1P0.soi_1_hom_clc[4] injr.STR_INJR_REQGNHOM1P0.soi_1_hom_clc[5] injr.STR_INJR_REQGNHOM1P0.soi_1_hom_clc[6] injr.STR_INJR_REQGNHOM1P0.soi_1_hom_clc[7] lv_crk_dif_soi_eoi_lim lv_eoi_lim_hom soi_lim eoi_lim_hom eoi_1_hom /end OUT_MEASUREMENT
/end FUNCTION
/begin FUNCTION INJR_Fuel_temperature_correction "" /begin DEF_CHARACTERISTIC ip_fac_ti_temp_cor ldp_tfu_ip_fac_ti_temp_cor /end DEF_CHARACTERISTIC /begin OUT_MEASUREMENT fac_ti_tfu /end OUT_MEASUREMENT /end FUNCTION
/begin FUNCTION INJR_Correction_via_Appl_System ""
 /begin DEF_CHARACTERISTIC c_ti_as_global c_ti_add_as_global c_ti_as[0] c_ti_as[1] c_ti_as[2] c_ti_as[3] c_ti_as[4] c_ti_as[5] c_ti_as[6] c_ti_as[7] c_ti_as_cbk_ex[0] c_ti_as_cbk_ex[1] c_ti_add_as[0] c_ti_add_as[1] c_ti_add_as[2] c_ti_add_as[3] c_ti_add_as[4] c_ti_add_as[5] c_ti_add_as[6] c_ti_add_as[7] c_ti_add_as_cbk_ex[0] c_ti_add_as_cbk_ex[1] lc_ti_as_cbk_upd_dis /end DEF_CHARACTERISTIC
 /begin OUT_MEASUREMENT ti_as injr.STR_INJR_ISPCLAS0.ti_tun_iv[0] injr.STR_INJR_ISPCLAS0.ti_tun_iv[1] injr.STR_INJR_ISPCLAS0.ti_tun_iv[2] injr.STR_INJR_ISPCLAS0.ti_tun_iv[3] injr.STR_INJR_ISPCLAS0.ti_tun_iv[4] injr.STR_INJR_ISPCLAS0.ti_tun_iv[5] injr.STR_INJR_ISPCLAS0.ti_tun_iv[6] injr.STR_INJR_ISPCLAS0.ti_tun_iv[7] injr.STR_INJR_ISPCLAS0.ti_tun_add_iv[0] injr.STR_INJR_ISPCLAS0.ti_tun_add_iv[1] injr.STR_INJR_ISPCLAS0.ti_tun_add_iv[2] injr.STR_INJR_ISPCLAS0.ti_tun_add_iv[3] injr.STR_INJR_ISPCLAS0.ti_tun_add_iv[4] injr.STR_INJR_ISPCLAS0.ti_tun_add_iv[5] injr.STR_INJR_ISPCLAS0.ti_tun_add_iv[6] injr.STR_INJR_ISPCLAS0.ti_tun_add_iv[7] /end OUT_MEASUREMENT
/end FUNCTION
/begin FUNCTION INJR_Cylinder_Shut_Off ""
 /begin DEF_CHARACTERISTIC id_inh_swi_iv ldp_nr_pat_id_inh_swi_iv lc_swi_mod_inh_iv_dyn /end DEF_CHARACTERISTIC
 /begin OUT_MEASUREMENT inh_iv inh_swi_iv inh_iv_igk inh_iv_puc inh_iv_mon nr_pat sum_inh_iv inh_inj sum_inh_inj lv_inj_cut lv_fcut_ind sum_inh_iv_dyn inh_iv_n_max_req_fcut state_inh_iv_dyn injr.STR_INJR_ACCTLCYL0.lv_scc[0] injr.STR_INJR_ACCTLCYL0.lv_scc[1] injr.STR_INJR_ACCTLCYL0.sum_inh_iv_cbk[0] injr.STR_INJR_ACCTLCYL0.sum_inh_iv_cbk[1] /end OUT_MEASUREMENT
/end FUNCTION
/begin FUNCTION INJR_Injection_phase_2nd_pulse "" /begin DEF_CHARACTERISTIC c_delta_t_min_dui c_eoi_2_hom_man lc_eoi_2_hom_man /end DEF_CHARACTERISTIC
 /begin OUT_MEASUREMENT injr.STR_INJR_REQGNHOM2P0.eoi_2_hom[0] injr.STR_INJR_REQGNHOM2P0.eoi_2_hom[1] injr.STR_INJR_REQGNHOM2P0.eoi_2_hom[2] injr.STR_INJR_REQGNHOM2P0.eoi_2_hom[3] injr.STR_INJR_REQGNHOM2P0.eoi_2_hom[4] injr.STR_INJR_REQGNHOM2P0.eoi_2_hom[5] injr.STR_INJR_REQGNHOM2P0.eoi_2_hom[6] injr.STR_INJR_REQGNHOM2P0.eoi_2_hom[7] soi_2_hom eoi_1_soi_2_gap_hom /end OUT_MEASUREMENT
/end FUNCTION
/begin FUNCTION INJR_Injection_phase_3d_pulse "" /begin DEF_CHARACTERISTIC c_eoi_3_hom_man lc_eoi_3_hom_man /end DEF_CHARACTERISTIC
 /begin OUT_MEASUREMENT injr.STR_INJR_REQGNHOM3P0.eoi_3_hom[0] injr.STR_INJR_REQGNHOM3P0.eoi_3_hom[1] injr.STR_INJR_REQGNHOM3P0.eoi_3_hom[2] injr.STR_INJR_REQGNHOM3P0.eoi_3_hom[3] injr.STR_INJR_REQGNHOM3P0.eoi_3_hom[4] injr.STR_INJR_REQGNHOM3P0.eoi_3_hom[5] injr.STR_INJR_REQGNHOM3P0.eoi_3_hom[6] injr.STR_INJR_REQGNHOM3P0.eoi_3_hom[7] soi_3_hom_max eoi_2_soi_3_gap_hom /end OUT_MEASUREMENT
/end FUNCTION
/begin FUNCTION INJR_Comp_of_temp_influence ""
 /begin DEF_CHARACTERISTIC ldp_tfu_inj_ip_egy_add_temp ip_egy_add_temp lc_temp_capa_iv_ena /end DEF_CHARACTERISTIC
 /begin OUT_MEASUREMENT egy_add_temp /end OUT_MEASUREMENT
/end FUNCTION
/end MODULE
/end PROJECT
