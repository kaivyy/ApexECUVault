ASAP2_VERSION 1 30
/begin PROJECT MSS65-ign "Generiert am 14.10.05 um 09:57:47"
/begin HEADER "" VERSION "R341" /end HEADER
/begin MODULE _MSS65-ign "Generiert am 14.10.05 um 09:57:47"
/begin MOD_COMMON "" BYTE_ORDER MSB_FIRST ALIGNMENT_BYTE 1 ALIGNMENT_WORD 2 ALIGNMENT_LONG 4 ALIGNMENT_FLOAT32_IEEE 4 ALIGNMENT_FLOAT64_IEEE 8 /end MOD_COMMON
/begin CHARACTERISTIC K_MD_ANFF_PWG_OFF "Anfahrfilter Pwg-Schwelle Off" VALUE 0x764D2 TKW_VV_VV_SW 100.0 FORMULA_0001 -10.0 120.0 FORMAT "%4.1" /end CHARACTERISTIC
/begin CHARACTERISTIC K_MD_ANFF_PWG_ON "Anfahrfilter Pwg-Schwelle On" VALUE 0x764D0 TKW_VV_VV_SW 100.0 FORMULA_0001 -10.0 120.0 FORMAT "%4.1" /end CHARACTERISTIC
/begin CHARACTERISTIC K_MD_ANFF_V_SCHW "Anfahrfilter v-Schwelle" VALUE 0x764CE TKW_VV_VV_SW 100.0 FORMULA_0076 -80.0 360.0 FORMAT "%4.1" /end CHARACTERISTIC
/begin CHARACTERISTIC K_MD_ASC_AUSBLEND_HYS "Hysterese über Schleppmoment" VALUE 0x7635A TKW_VV_VV_SW 100.0 FORMULA_0009 -100.0 1000.0 FORMAT "%4.1" /end CHARACTERISTIC
/begin CHARACTERISTIC K_MD_ASC_ENABLE "ASC-Freigabe" VALUE 0x76352 TKW_VV_VV_UB 100.0 FORMULA_0773 0.0 255.0 /end CHARACTERISTIC
/begin CHARACTERISTIC K_MD_ASC_M_AEBEGR "Aenderungsbegrenzung nach ASC-Eingr" VALUE 0x76360 TKW_VV_VV_SW 100.0 FORMULA_0562 -5000.0 20000.0 /end CHARACTERISTIC
/begin CHARACTERISTIC K_MD_ASC_M_RAMPE "Steigung ASC-Rampe" VALUE 0x7635E TKW_VV_VV_SW 100.0 FORMULA_0562 -5000.0 5000.0 /end CHARACTERISTIC
/begin CHARACTERISTIC K_MD_ASC_T_WAIT "Wartezeit vor ASC-Rampe" VALUE 0x7635C TKW_VV_VV_UW 100.0 FORMULA_0109 0.0 10.0 FORMAT "%5.2" /end CHARACTERISTIC
/begin CHARACTERISTIC K_MD_BEZUG_HYS "Abschaltung der Eta-Bezugsrampe" VALUE 0x7789A TKW_VV_VV_UB 100.0 FORMULA_0749 0.0 10.0 /end CHARACTERISTIC
/begin CHARACTERISTIC K_MD_BEZUG_RAMPE "Eta-Bezugsrampe" VALUE 0x7789B TKW_VV_VV_UB 100.0 FORMULA_0806 0.0 5100.0 /end CHARACTERISTIC
/begin CHARACTERISTIC K_MD_BLS_BRP "Schwelle Bremsdruck" VALUE 0x77872 TKW_VV_VV_UB 100.0 FORMULA_0129 0.0 255.0 /end CHARACTERISTIC
/begin CHARACTERISTIC K_MD_BLS_BRP_VMA "Schwelle Bremsdruck" VALUE 0x7787D TKW_VV_VV_UB 100.0 FORMULA_0129 0.0 255.0 /end CHARACTERISTIC
/begin CHARACTERISTIC K_MD_BLS_DN_VMA "Schwelle Drehzahlgradient" VALUE 0x7787A TKW_VV_VV_SW 100.0 FORMULA_0105 -10000.0 10000.0 /end CHARACTERISTIC
/begin CHARACTERISTIC K_MD_BLS_FW_REL "Schwelle Bremsdruck" VALUE 0x77876 TKW_VV_VV_SW 100.0 FORMULA_0001 0.0 100.0 FORMAT "%4.1" /end CHARACTERISTIC
/begin CHARACTERISTIC K_MD_BLS_GANG_VMA "Schwelle Gang" VALUE 0x7787C TKW_VV_VV_SB 100.0 FORMULA_0135 -1.0 10.0 /end CHARACTERISTIC
/begin CHARACTERISTIC K_MD_BLS_N "Schwelle Bremsdruck" VALUE 0x77874 TKW_VV_VV_SW 100.0 FORMULA_0006 0.0 10000.0 /end CHARACTERISTIC
/begin CHARACTERISTIC K_MD_BLS_N_VMA "Schwelle Drehzahl" VALUE 0x77878 TKW_VV_VV_SW 100.0 FORMULA_0006 0.0 10000.0 /end CHARACTERISTIC
/begin CHARACTERISTIC K_MD_CAN_BEGR_ST "MD-Begrenzungen default" VALUE 0x76364 TKW_VV_VV_UB 100.0 FORMULA_0252 0.0 255.0 /end CHARACTERISTIC
/begin CHARACTERISTIC K_MD_CAN_ETA_ZW_OFF "ASC-Freigabe" VALUE 0x76362 TKW_VV_VV_UW 100.0 FORMULA_0437 0.0 150.0 FORMAT "%4.1" /end CHARACTERISTIC
/begin CHARACTERISTIC K_MD_CFG_DYN_FIL "Filterkonfiguration" VALUE 0x764BC TKW_VV_VV_UB 100.0 FORMULA_0788 0.0 255.0 /end CHARACTERISTIC
/begin CHARACTERISTIC K_MD_CFG_FW_BLS "Einfluss Bremse auf Fahrerwunsch" VALUE 0x77871 TKW_VV_VV_UB 100.0 FORMULA_0805 0.0 255.0 /end CHARACTERISTIC
/begin CHARACTERISTIC K_MD_CFG_MCS "Vorgaben per MCS" VALUE 0x7786E TKW_VV_VV_UB 100.0 FORMULA_0803 0.0 255.0 /end CHARACTERISTIC
/begin CHARACTERISTIC K_MD_CFG_RG_KORR "Cfg fuer RG-Korrektur" VALUE 0x75531 TKW_VV_VV_UB 100.0 FORMULA_0762 0.0 255.0 /end CHARACTERISTIC
/begin CHARACTERISTIC K_MD_CFG_TZ_EINGR "Freigabe Zuendwinkeleingriff" VALUE 0x77870 TKW_VV_VV_UB 100.0 FORMULA_0804 0.0 255.0 /end CHARACTERISTIC
/begin CHARACTERISTIC K_MD_CFG_ZW_BEZUG "ZW-Bezug" VALUE 0x7786F TKW_VV_VV_UB 100.0 FORMULA_0798 0.0 255.0 /end CHARACTERISTIC
/begin CHARACTERISTIC K_MD_DYN_FIL_RES_TAU "Tau der Momentenreserve" VALUE 0x764CC TKW_VV_VV_UB 100.0 FORMULA_0470 5.100000184029341e-003 1.279999971389771 /end CHARACTERISTIC
/begin CHARACTERISTIC K_MD_E2_ERR_MAX "max. Zeit fuer Vergleichsfehler" VALUE 0x7B098 TKW_VV_VV_UB 100.0 FORMULA_0492 0.0 25.5 /end CHARACTERISTIC
/begin CHARACTERISTIC K_MD_E2_FW_REL_SCHW "max. Abweichung rel. Fahrerwunsch" VALUE 0x7B09A TKW_VV_VV_SW 100.0 FORMULA_0001 -10.0 120.0 FORMAT "%4.1" /end CHARACTERISTIC
/begin CHARACTERISTIC K_MD_E2_IST_SCHW "max. Abweichung Istmoment" VALUE 0x7B0A4 TKW_VV_VV_SW 100.0 FORMULA_0009 -100.0 1000.0 FORMAT "%4.1" /end CHARACTERISTIC
/begin CHARACTERISTIC K_MD_E2_MAX_SCHW "max. Abweichung Maxmoment" VALUE 0x7B0A2 TKW_VV_VV_SW 100.0 FORMULA_0009 -100.0 1000.0 FORMAT "%4.1" /end CHARACTERISTIC
/begin CHARACTERISTIC K_MD_E2_MIN_SCHW "max. Abweichung Minmoment" VALUE 0x7B0A0 TKW_VV_VV_SW 100.0 FORMULA_0009 -100.0 1000.0 FORMAT "%4.1" /end CHARACTERISTIC
/begin CHARACTERISTIC K_MD_E2_N_MIN "min. Drehzahlschwelle" VALUE 0x7B0BE TKW_VV_VV_SW 100.0 FORMULA_0006 0.0 10000.0 /end CHARACTERISTIC
/begin CHARACTERISTIC K_MD_E2_SCHLEPP_SCHW "max. Abweichung Schleppmoment" VALUE 0x7B0A6 TKW_VV_VV_SW 100.0 FORMULA_0009 -100.0 1000.0 FORMAT "%4.1" /end CHARACTERISTIC
/begin CHARACTERISTIC K_MD_E2_TAU_SOLL "Filter Sollmoment Ebene 2" VALUE 0x7B099 TKW_VV_VV_UB 100.0 FORMULA_0746 0.1004000008106232 25.60000038146973 /end CHARACTERISTIC
/begin CHARACTERISTIC K_MD_ETA_EINGRIFF "ETA-Grenze" VALUE 0x7787E TKW_VV_VV_UW 100.0 FORMULA_0437 0.0 150.0 FORMAT "%4.1" /end CHARACTERISTIC
/begin CHARACTERISTIC K_MD_ETA_KH_TAU "TAU KH-TZ" VALUE 0x7789D TKW_VV_VV_UB 100.0 FORMULA_0470 5.100000184029341e-003 1.279999971389771 /end CHARACTERISTIC
/begin CHARACTERISTIC K_MD_ETA_KH_TAU_LL "TAU KH-TZ" VALUE 0x7789E TKW_VV_VV_UB 100.0 FORMULA_0470 5.100000184029341e-003 1.279999971389771 /end CHARACTERISTIC
/begin CHARACTERISTIC K_MD_ETA_KR_KOMP "ETA-Kr mit/ohne KR" VALUE 0x75530 TKW_VV_VV_UB 100.0 FORMULA_0761 0.0 255.0 /end CHARACTERISTIC
/begin CHARACTERISTIC K_MD_ETA_LA_E2 "LA-Faktor" VALUE 0x7B0B0 TKW_VV_VV_UW 100.0 FORMULA_0073 0.0 4.0 FORMAT "%6.3" /end CHARACTERISTIC
/begin CHARACTERISTIC K_MD_ETA_LA_KOMP_MAX "ETA-Grenze" VALUE 0x77880 TKW_VV_VV_UW 100.0 FORMULA_0437 0.0 150.0 FORMAT "%4.1" /end CHARACTERISTIC
/begin CHARACTERISTIC K_MD_ETA_LA_TAU "TAU LA" VALUE 0x778A0 TKW_VV_VV_UB 100.0 FORMULA_0470 5.100000184029341e-003 1.279999971389771 /end CHARACTERISTIC
/begin CHARACTERISTIC K_MD_ETA_SK_MIN "minimales ETA bei SK-Ausblendern" VALUE 0x75536 TKW_VV_VV_UW 100.0 FORMULA_0437 0.0 150.0 FORMAT "%4.1" /end CHARACTERISTIC
/begin CHARACTERISTIC K_MD_ETA_STAT_TAU "TAU stat. TZ" VALUE 0x7789C TKW_VV_VV_UB 100.0 FORMULA_0470 5.100000184029341e-003 1.279999971389771 /end CHARACTERISTIC
/begin CHARACTERISTIC K_MD_ETA_STAT_TAU_LL "TAU md_tz_stat_mw" VALUE 0x7789F TKW_VV_VV_UB 100.0 FORMULA_0470 5.100000184029341e-003 1.279999971389771 /end CHARACTERISTIC
/begin CHARACTERISTIC K_MD_ETA_T_SPERR "Sperrzeit fuer TZ-Eingriff" VALUE 0x778C8 TKW_VV_VV_UW 100.0 FORMULA_0021 0.0 655.0 FORMAT "%5.2" /end CHARACTERISTIC
/begin CHARACTERISTIC K_MD_ETA_ZW_MIN "minimales ETA" VALUE 0x75534 TKW_VV_VV_UW 100.0 FORMULA_0437 0.0 150.0 FORMAT "%4.1" /end CHARACTERISTIC
/begin CHARACTERISTIC K_MD_ETA_ZW_MIN_E2 "minimales ETA Ebene 2" VALUE 0x7B0B8 TKW_VV_VV_UW 100.0 FORMULA_0437 0.0 150.0 FORMAT "%4.1" /end CHARACTERISTIC
/begin CHARACTERISTIC K_MD_GEN_FREISCHALT "Genarator-Freigabe" VALUE 0x76397 TKW_VV_VV_UB 100.0 FORMULA_0773 0.0 255.0 /end CHARACTERISTIC
/begin CHARACTERISTIC K_MD_GEN_MAX "max. Generatormoment" VALUE 0x7639C TKW_VV_VV_SW 100.0 FORMULA_0009 -100.0 1000.0 FORMAT "%4.1" /end CHARACTERISTIC
/begin CHARACTERISTIC K_MD_GRAD_DP_OKS "Gradient ohne Kraftschluss" VALUE 0x764CA TKW_VV_VV_SW 100.0 FORMULA_0786 -5000.0 0.0 /end CHARACTERISTIC
/begin CHARACTERISTIC K_MD_GRAD_LSD_OKS "Gradient ohne Kraftschluss" VALUE 0x764C8 TKW_VV_VV_SW 100.0 FORMULA_0786 0.0 5000.0 /end CHARACTERISTIC
/begin CHARACTERISTIC K_MD_GRAD_SA "SaWe-Schrittweite fuer TZmin erreicht" VALUE 0x764C2 TKW_VV_VV_SW 100.0 FORMULA_0562 -5000.0 5000.0 /end CHARACTERISTIC
/begin CHARACTERISTIC K_MD_GRAD_SA_CUF "SaWe-Schrittweite bei CUF" VALUE 0x764C4 TKW_VV_VV_SW 100.0 FORMULA_0562 -100000.0 -1.0 /end CHARACTERISTIC
/begin CHARACTERISTIC K_MD_GRAD_SA_VMA "SaWe-Schrittweite bei VMA" VALUE 0x764C6 TKW_VV_VV_SW 100.0 FORMULA_0562 1.0 100000.0 /end CHARACTERISTIC
/begin CHARACTERISTIC K_MD_HYP_DN_E2 "Offset auf Leerlaufdrehzahl" VALUE 0x7B0A8 TKW_VV_VV_SW 100.0 FORMULA_0006 0.0 10000.0 /end CHARACTERISTIC
/begin CHARACTERISTIC K_MD_HYP_VERH_E2 "Hyperbelfaktor" VALUE 0x7B0AA TKW_VV_VV_UB 100.0 FORMULA_0757 0.0 1.99210000038147 /end CHARACTERISTIC
/begin CHARACTERISTIC K_MD_HYP_VERH_NO_KRAFTS "Best. Schnittpunkt Brenngrenze mit Hyp.bei NO_Krafts." VALUE 0x7552F TKW_VV_VV_UB 100.0 FORMULA_0757 0.0 1.99210000038147 /end CHARACTERISTIC
/begin CHARACTERISTIC K_MD_HYP_VERH_START "Begrenzung Hyperbel ausserhalb Motor laeuft" VALUE 0x7552E TKW_VV_VV_UB 100.0 FORMULA_0757 0.0 1.99210000038147 /end CHARACTERISTIC
/begin CHARACTERISTIC K_MD_HYS_RICHTUNG "Hysterese fuer Richtungserkennung" VALUE 0x764BD TKW_VV_VV_UB 100.0 FORMULA_0748 0.0 255.0 /end CHARACTERISTIC
/begin CHARACTERISTIC K_MD_HYS_SA "Offset auf Schleppmoment inkl. EtaMin" VALUE 0x764BE TKW_VV_VV_SW 100.0 FORMULA_0009 -100.0 1000.0 FORMAT "%4.1" /end CHARACTERISTIC
/begin CHARACTERISTIC K_MD_HYS_SA_TZ "Offset auf tz_min" VALUE 0x764C0 TKW_VV_VV_SW 100.0 FORMULA_0102 -50.0 60.0 FORMAT "%4.1" /end CHARACTERISTIC
/begin CHARACTERISTIC K_MD_IND_REIB_ABREG_E2 "Abregelrampe fuer Reibmoment nach Start - Ebene 2" VALUE 0x7B0C0 TKW_VV_VV_SW 100.0 FORMULA_0755 -100.0 1000.0 FORMAT "%4.1" /end CHARACTERISTIC
/begin CHARACTERISTIC K_MD_IND_WUNSCH_TZ_MCS "TZ-Vorgabe per MCS" VALUE 0x77884 TKW_VV_VV_SW 100.0 FORMULA_0009 -100.0 1000.0 FORMAT "%4.1" /end CHARACTERISTIC
/begin CHARACTERISTIC K_MD_KKOS_CAN_MAX "KKOS-Begrenzung" VALUE 0x76392 TKW_VV_VV_SW 100.0 FORMULA_0009 -100.0 1000.0 FORMAT "%4.1" /end CHARACTERISTIC
/begin CHARACTERISTIC K_MD_KKOS_DYN_ST "Triggerschwelle fuer BA" VALUE 0x76365 TKW_VV_VV_UB 100.0 FORMULA_0003 0.0 255.0 /end CHARACTERISTIC
/begin CHARACTERISTIC K_MD_KKOS_ELU_TMOT_MAX "tmot fuer KKOS bei def. ELU" VALUE 0x7636A TKW_VV_VV_SW 100.0 FORMULA_0023 -50.0 170.0 FORMAT "%4.1" /end CHARACTERISTIC
/begin CHARACTERISTIC K_MD_KKOS_ELU_TMOT_MAX_HYS "tmot fuer KKOS bei def. ELU - Hys" VALUE 0x7636C TKW_VV_VV_SW 100.0 FORMULA_0074 -1000.0 1000.0 FORMAT "%4.1" /end CHARACTERISTIC
/begin CHARACTERISTIC K_MD_KKOS_MAX "KKOS-Begrenzung" VALUE 0x76386 TKW_VV_VV_SW 100.0 FORMULA_0009 -100.0 1000.0 FORMAT "%4.1" /end CHARACTERISTIC
/begin CHARACTERISTIC K_MD_KKOS_MIN "Einschaltschwelle" VALUE 0x76384 TKW_VV_VV_SW 100.0 FORMULA_0009 -100.0 1000.0 FORMAT "%4.1" /end CHARACTERISTIC
/begin CHARACTERISTIC K_MD_KKOS_N "Schwelle fuer BA-/VL" VALUE 0x76372 TKW_VV_VV_SW 100.0 FORMULA_0006 0.0 10000.0 /end CHARACTERISTIC
/begin CHARACTERISTIC K_MD_KKOS_N_MAX "nmax fuer KKOS" VALUE 0x7636E TKW_VV_VV_SW 100.0 FORMULA_0006 0.0 10000.0 /end CHARACTERISTIC
/begin CHARACTERISTIC K_MD_KKOS_N_MAX_HYS "nmax fuer KKOS - Hys" VALUE 0x76370 TKW_VV_VV_SW 100.0 FORMULA_0006 0.0 10000.0 /end CHARACTERISTIC
/begin CHARACTERISTIC K_MD_KKOS_RES_RAMPE_OFF "Steigung Res-Rampe aus" VALUE 0x76389 TKW_VV_VV_UB 100.0 FORMULA_0775 0.0 -2550.0 /end CHARACTERISTIC
/begin CHARACTERISTIC K_MD_KKOS_RES_RAMPE_ON "Steigung Res-Rampe an" VALUE 0x76388 TKW_VV_VV_UB 100.0 FORMULA_0774 0.0 2550.0 /end CHARACTERISTIC
/begin CHARACTERISTIC K_MD_KKOS_RES_T_MAX "Maxzeit fuer Reserve" VALUE 0x7638A TKW_VV_VV_UW 100.0 FORMULA_0021 0.0 655.0 FORMAT "%5.2" /end CHARACTERISTIC
/begin CHARACTERISTIC K_MD_KKOS_START "Faktor Startoffset" VALUE 0x76380 TKW_VV_VV_UW 100.0 FORMULA_0073 0.0 4.0 FORMAT "%6.3" /end CHARACTERISTIC
/begin CHARACTERISTIC K_MD_KKOS_TAU_OFF "TAU KKOS-Aufregel" VALUE 0x76383 TKW_VV_VV_UB 100.0 FORMULA_0470 5.100000184029341e-003 1.279999971389771 /end CHARACTERISTIC
/begin CHARACTERISTIC K_MD_KKOS_TAU_ON "TAU KKOS-Aufregel" VALUE 0x76382 TKW_VV_VV_UB 100.0 FORMULA_0470 5.100000184029341e-003 1.279999971389771 /end CHARACTERISTIC
/begin CHARACTERISTIC K_MD_KKOS_TIME_BA_VL "Schwelle BA-/VL-Freigabe" VALUE 0x7637C TKW_VV_VV_UW 100.0 FORMULA_0021 0.0 655.0 FORMAT "%5.2" /end CHARACTERISTIC
/begin CHARACTERISTIC K_MD_KKOS_TIME_START "Schwelle Startfreigabe" VALUE 0x7637A TKW_VV_VV_UW 100.0 FORMULA_0021 0.0 655.0 FORMAT "%5.2" /end CHARACTERISTIC
/begin CHARACTERISTIC K_MD_KKOS_TIME_WH "Schwelle WH-Freigabe" VALUE 0x7637E TKW_VV_VV_UW 100.0 FORMULA_0021 0.0 655.0 FORMAT "%5.2" /end CHARACTERISTIC
/begin CHARACTERISTIC K_MD_KKOS_TMOT_MAX "tmot fuer KKOS" VALUE 0x76366 TKW_VV_VV_SW 100.0 FORMULA_0023 -50.0 170.0 FORMAT "%4.1" /end CHARACTERISTIC
/begin CHARACTERISTIC K_MD_KKOS_TMOT_MAX_HYS "tmot fuer KKOS - Hys" VALUE 0x76368 TKW_VV_VV_SW 100.0 FORMULA_0074 -1000.0 1000.0 FORMAT "%4.1" /end CHARACTERISTIC
/begin CHARACTERISTIC K_MD_KKOS_V_BA "Schwelle fuer Beschl." VALUE 0x76378 TKW_VV_VV_SW 100.0 FORMULA_0076 -80.0 360.0 FORMAT "%4.1" /end CHARACTERISTIC
/begin CHARACTERISTIC K_MD_KKOS_V_VL "Schwelle fuer VL" VALUE 0x76374 TKW_VV_VV_SW 100.0 FORMULA_0076 -80.0 360.0 FORMAT "%4.1" /end CHARACTERISTIC
/begin CHARACTERISTIC K_MD_KKOS_V_VL_AUS "Schwelle fuer VL aus" VALUE 0x76376 TKW_VV_VV_SW 100.0 FORMULA_0076 -80.0 360.0 FORMAT "%4.1" /end CHARACTERISTIC
/begin CHARACTERISTIC K_MD_KKOS_ZH_RES_RAMPE "Steigung ZH-Reserve-Rampe" VALUE 0x76394 TKW_VV_VV_UB 100.0 FORMULA_0774 0.0 2550.0 /end CHARACTERISTIC
/begin CHARACTERISTIC K_MD_KKOS_ZH_RES_T_MAX "Maxzeit fuer ZH-Reserve" VALUE 0x76390 TKW_VV_VV_UW 100.0 FORMULA_0021 0.0 655.0 FORMAT "%5.2" /end CHARACTERISTIC
/begin CHARACTERISTIC K_MD_KKOS_ZH_TMOT "Motortemp. fuer ZH-Reserve" VALUE 0x7638C TKW_VV_VV_SW 100.0 FORMULA_0023 -50.0 170.0 FORMAT "%4.1" /end CHARACTERISTIC
/begin CHARACTERISTIC K_MD_KKOS_ZH_TUMG "Umgebungstemp. fuer ZH-Reserve" VALUE 0x7638E TKW_VV_VV_SW 100.0 FORMULA_0023 -50.0 170.0 FORMAT "%4.1" /end CHARACTERISTIC
/begin CHARACTERISTIC K_MD_KUPP_BEGR_MCS "Wochenendfzg-Momentenbegrenzung" VALUE 0x77898 TKW_VV_VV_SW 100.0 FORMULA_0009 -100.0 1000.0 FORMAT "%4.1" /end CHARACTERISTIC
/begin CHARACTERISTIC K_MD_LLR_AD_MAX_E2 "max. Leerlaufadaption" VALUE 0x7B09E TKW_VV_VV_SW 100.0 FORMULA_0009 -100.0 1000.0 FORMAT "%4.1" /end CHARACTERISTIC
/begin CHARACTERISTIC K_MD_LRW_RES_DELTA "LRW-Begrenzung" VALUE 0x76396 TKW_VV_VV_UB 100.0 FORMULA_0774 0.0 2550.0 /end CHARACTERISTIC
/begin CHARACTERISTIC K_MD_LRW_RES_V "LRW-v-Schwelle" VALUE 0x76398 TKW_VV_VV_SW 100.0 FORMULA_0076 -80.0 360.0 FORMAT "%4.1" /end CHARACTERISTIC
/begin CHARACTERISTIC K_MD_LRW_RES_V_HYS "LRW-v-Schwelle Hys" VALUE 0x7639A TKW_VV_VV_SW 100.0 FORMULA_0076 -80.0 360.0 FORMAT "%4.1" /end CHARACTERISTIC
/begin CHARACTERISTIC K_MD_LRW_TAU "TAU KKOS-Aufregel" VALUE 0x76395 TKW_VV_VV_UB 100.0 FORMULA_0455 1.009999960660934e-002 2.559999942779541 /end CHARACTERISTIC
/begin CHARACTERISTIC K_MD_MAX_FAK "VL-Korrektur von Rf_max" VALUE 0x75532 TKW_VV_VV_UW 100.0 FORMULA_0073 0.0 4.0 FORMAT "%6.3" /end CHARACTERISTIC
/begin CHARACTERISTIC K_MD_MAX_POWER_NEG "Begrenzung Powerfaktor" VALUE 0x75539 TKW_VV_VV_UB 100.0 FORMULA_0763 0.0 49.80459976196289 /end CHARACTERISTIC
/begin CHARACTERISTIC K_MD_MAX_POWER_POS "Begrenzung Powerfaktor" VALUE 0x75538 TKW_VV_VV_UB 100.0 FORMULA_0763 0.0 49.80459976196289 /end CHARACTERISTIC
/begin CHARACTERISTIC K_MD_MSR_ENABLE "MSR-Freigabe" VALUE 0x76353 TKW_VV_VV_UB 100.0 FORMULA_0773 0.0 255.0 /end CHARACTERISTIC
/begin CHARACTERISTIC K_MD_MSR_M_RAMPE "Steigung MSR-Rampe" VALUE 0x76358 TKW_VV_VV_SW 100.0 FORMULA_0562 -5000.0 5000.0 /end CHARACTERISTIC
/begin CHARACTERISTIC K_MD_MSR_MAX "max. MSR-Vorgabe" VALUE 0x76354 TKW_VV_VV_SW 100.0 FORMULA_0009 -100.0 1000.0 FORMAT "%4.1" /end CHARACTERISTIC
/begin CHARACTERISTIC K_MD_MSR_MAX_E2 "max. MSR-Moment Ebene 2" VALUE 0x7B0AE TKW_VV_VV_SW 100.0 FORMULA_0009 -100.0 1000.0 FORMAT "%4.1" /end CHARACTERISTIC
/begin CHARACTERISTIC K_MD_MSR_T_WAIT "Wartezeit vor MSR-Rampe" VALUE 0x76356 TKW_VV_VV_UW 100.0 FORMULA_0109 0.0 10.0 FORMAT "%5.2" /end CHARACTERISTIC
/begin CHARACTERISTIC K_MD_NBEGR_A1 "Reglerfaktor A1" VALUE 0x778C0 TKW_VV_VV_SW 100.0 FORMULA_0488 -10.0 10.0 FORMAT "%5.2" /end CHARACTERISTIC
/begin CHARACTERISTIC K_MD_NBEGR_AKTIV "Schwelle fuer Nmax-Reduktion" VALUE 0x778AA TKW_VV_VV_SW 100.0 FORMULA_0006 0.0 10000.0 /end CHARACTERISTIC
/begin CHARACTERISTIC K_MD_NBEGR_HYS_AUS "n-Hysteres fuer Deaktivierung N-Begrenzung" VALUE 0x778A6 TKW_VV_VV_SW 100.0 FORMULA_0006 0.0 2000.0 /end CHARACTERISTIC
/begin CHARACTERISTIC K_MD_NBEGR_MD_HYS "Aktivierhysterese" VALUE 0x778A8 TKW_VV_VV_SW 100.0 FORMULA_0009 -100.0 1000.0 FORMAT "%4.1" /end CHARACTERISTIC
/begin CHARACTERISTIC K_MD_NBEGR_N_DELTA "Begrenzung Abregelrampe" VALUE 0x778AC TKW_VV_VV_UB 100.0 FORMULA_0807 0.0 20000.0 /end CHARACTERISTIC
/begin CHARACTERISTIC K_MD_NOISE_CFG "Noise-Cfg" VALUE 0x778AD TKW_VV_VV_UB 100.0 FORMULA_0808 0.0 255.0 /end CHARACTERISTIC
/begin CHARACTERISTIC K_MD_NOISE_PWG_SOLL "Noiseschwelle PWG" VALUE 0x778BC TKW_VV_VV_SW 100.0 FORMULA_0001 -10.0 120.0 FORMAT "%4.1" /end CHARACTERISTIC
/begin CHARACTERISTIC K_MD_NOISE_RAMPE "Noiseschwelle PWG" VALUE 0x778BE TKW_VV_VV_SW 100.0 FORMULA_0786 -5000.0 5000.0 /end CHARACTERISTIC
/begin CHARACTERISTIC K_MD_NOISE_T "Noisezeit" VALUE 0x778AE TKW_VV_VV_UW 100.0 FORMULA_0071 0.0 6553.5 FORMAT "%4.1" /end CHARACTERISTIC
/begin CHARACTERISTIC K_MD_NOISE_V_MAX1 "Eintrittsbedingung" VALUE 0x778B2 TKW_VV_VV_SW 100.0 FORMULA_0076 -80.0 360.0 FORMAT "%4.1" /end CHARACTERISTIC
/begin CHARACTERISTIC K_MD_NOISE_V_MAX2 "Austrittsbedingung" VALUE 0x778B6 TKW_VV_VV_SW 100.0 FORMULA_0076 -80.0 360.0 FORMAT "%4.1" /end CHARACTERISTIC
/begin CHARACTERISTIC K_MD_NOISE_V_MAX3 "Profilerkennung" VALUE 0x778BA TKW_VV_VV_SW 100.0 FORMULA_0076 -80.0 360.0 FORMAT "%4.1" /end CHARACTERISTIC
/begin CHARACTERISTIC K_MD_NOISE_V_MIN1 "Eintrittsbedingung" VALUE 0x778B0 TKW_VV_VV_SW 100.0 FORMULA_0076 -80.0 360.0 FORMAT "%4.1" /end CHARACTERISTIC
/begin CHARACTERISTIC K_MD_NOISE_V_MIN2 "Austrittsbedingung" VALUE 0x778B4 TKW_VV_VV_SW 100.0 FORMULA_0076 -80.0 360.0 FORMAT "%4.1" /end CHARACTERISTIC
/begin CHARACTERISTIC K_MD_NOISE_V_MIN3 "Profilerkennung" VALUE 0x778B8 TKW_VV_VV_SW 100.0 FORMULA_0076 -80.0 360.0 FORMAT "%4.1" /end CHARACTERISTIC
/begin CHARACTERISTIC K_MD_POLYNOM_A_E2 "Polynom A Ebene 2" VALUE 0x7B0BA TKW_VV_VV_SW 100.0 FORMULA_0760 -320.0 320.0 FORMAT "%5.2" /end CHARACTERISTIC
/begin CHARACTERISTIC K_MD_POLYNOM_B_E2 "Polynom B Ebene 2" VALUE 0x7B0BC TKW_VV_VV_SW 100.0 FORMULA_0760 -320.0 320.0 FORMAT "%5.2" /end CHARACTERISTIC
/begin CHARACTERISTIC K_MD_PULS_AMP "Generator-Amplitude" VALUE 0x7553E TKW_VV_VV_SW 100.0 FORMULA_0009 -100.0 100.0 FORMAT "%4.1" /end CHARACTERISTIC
/begin CHARACTERISTIC K_MD_PULS_EIN "Generator-Schalter" VALUE 0x7553A TKW_VV_VV_UB 100.0 FORMULA_0764 0.0 255.0 /end CHARACTERISTIC
/begin CHARACTERISTIC K_MD_PULS_OFFS "Generator-Offset" VALUE 0x75540 TKW_VV_VV_SW 100.0 FORMULA_0009 -100.0 100.0 FORMAT "%4.1" /end CHARACTERISTIC
/begin CHARACTERISTIC K_MD_PULS_RAMPE "Generator-Rampe" VALUE 0x75542 TKW_VV_VV_SW 100.0 FORMULA_0562 -20000.0 20000.0 /end CHARACTERISTIC
/begin CHARACTERISTIC K_MD_PULS_T "Generator-Periodendauer" VALUE 0x7553C TKW_VV_VV_UW 100.0 FORMULA_0109 0.0 325.0 FORMAT "%5.2" /end CHARACTERISTIC
/begin CHARACTERISTIC K_MD_RES_KATH_FAK "Faktor Katheitzreserve" VALUE 0x77888 TKW_VV_VV_UW 100.0 FORMULA_0073 0.0 4.0 FORMAT "%6.3" /end CHARACTERISTIC
/begin CHARACTERISTIC K_MD_RES_KATH_TAU "TAU Katheitzreserve" VALUE 0x7788A TKW_VV_VV_UB 100.0 FORMULA_0470 5.100000184029341e-003 1.279999971389771 /end CHARACTERISTIC
/begin CHARACTERISTIC K_MD_RES_MIN "Reserveschwelle" VALUE 0x7788C TKW_VV_VV_UB 100.0 FORMULA_0749 0.0 25.0 /end CHARACTERISTIC
/begin CHARACTERISTIC K_MD_RES_MIN_HYS "Reserveschwelle Hystherse" VALUE 0x7788D TKW_VV_VV_UB 100.0 FORMULA_0749 0.0 25.0 /end CHARACTERISTIC
/begin CHARACTERISTIC K_MD_RES_T_SPERR "Sperrzeit Reserve" VALUE 0x7788E TKW_VV_VV_UW 100.0 FORMULA_0021 0.0 655.0 FORMAT "%5.2" /end CHARACTERISTIC
/begin CHARACTERISTIC K_MD_RES_ZW_RAMPE_NEG "KH-Rampe" VALUE 0x77892 TKW_VV_VV_SW 100.0 FORMULA_0562 -5000.0 5000.0 /end CHARACTERISTIC
/begin CHARACTERISTIC K_MD_RES_ZW_RAMPE_POS "KH-Rampe" VALUE 0x77890 TKW_VV_VV_SW 100.0 FORMULA_0562 -5000.0 5000.0 /end CHARACTERISTIC
/begin CHARACTERISTIC K_MD_RESERVE_TST "Test-Reserve" VALUE 0x77882 TKW_VV_VV_SW 100.0 FORMULA_0009 -0.1000000014901161 1000.0 FORMAT "%4.1" /end CHARACTERISTIC
/begin CHARACTERISTIC K_MD_RF_SOLL_BS_CFG "RF_SOLL Bankselektivitaets CFG" VALUE 0x778C6 TKW_VV_VV_UB 100.0 FORMULA_0810 0.0 255.0 /end CHARACTERISTIC
/begin CHARACTERISTIC K_MD_RF_SOLL_MCS "RF-Sollvorgabe" VALUE 0x77886 TKW_VV_VV_SW 100.0 FORMULA_0007 0.0 2.0 FORMAT "%6.3" /end CHARACTERISTIC
/begin CHARACTERISTIC K_MD_RF_SOLL_PT_TAU "Tau fuer md_rf_soll_pt_fil" VALUE 0x778C5 TKW_VV_VV_UB 100.0 FORMULA_0470 5.100000184029341e-003 1.279999971389771 /end CHARACTERISTIC
/begin CHARACTERISTIC K_MD_RF_SOLL_SEK_CFG "Konfig uber Einrechnung sek. Fuellungseinfluss" VALUE 0x778C4 TKW_VV_VV_UB 100.0 FORMULA_0809 0.0 255.0 /end CHARACTERISTIC
/begin CHARACTERISTIC K_MD_RG_RF_FAKTOR "Faktor fuer Rf-Rg-Korrektur" VALUE 0x77896 TKW_VV_VV_UW 100.0 FORMULA_0073 0.0 4.0 FORMAT "%6.3" /end CHARACTERISTIC
/begin CHARACTERISTIC K_MD_SK_BEGR_RAMPE "Rampenbegrentzer für MD-Begrentzung SK" VALUE 0x7779A TKW_VV_VV_SW 100.0 FORMULA_0755 0.0 3000.0 FORMAT "%4.1" /end CHARACTERISTIC
/begin CHARACTERISTIC K_MD_SK_CFG "SK-Cfg" VALUE 0x7777C TKW_VV_VV_UB 100.0 FORMULA_0368 0.0 255.0 /end CHARACTERISTIC
/begin CHARACTERISTIC K_MD_SK_ETA_MIN "minimales ETA zur Absicherung Momentenberechnung" VALUE 0x77790 TKW_VV_VV_UW 100.0 FORMULA_0437 0.0 150.0 FORMAT "%4.1" /end CHARACTERISTIC
/begin CHARACTERISTIC K_MD_SK_FWMAX "max. Moment bei pwg=0" VALUE 0x77784 TKW_VV_VV_SW 100.0 FORMULA_0009 -100.0 1000.0 FORMAT "%4.1" /end CHARACTERISTIC
/begin CHARACTERISTIC K_MD_SK_IND_MAX "max. indiziertes TZ-/DK-Moment" VALUE 0x77792 TKW_VV_VV_SW 100.0 FORMULA_0009 0.0 1000.0 FORMAT "%4.1" /end CHARACTERISTIC
/begin CHARACTERISTIC K_MD_SK_LLR_MAX "maximaler LLR-Anteil" VALUE 0x77794 TKW_VV_VV_SW 100.0 FORMULA_0009 -100.0 1000.0 FORMAT "%4.1" /end CHARACTERISTIC
/begin CHARACTERISTIC K_MD_SK_MAX_MDMIN "maximal zulaessiges MDmin" VALUE 0x7778C TKW_VV_VV_SW 100.0 FORMULA_0009 -100.0 1000.0 FORMAT "%4.1" /end CHARACTERISTIC
/begin CHARACTERISTIC K_MD_SK_N_MDMIN "Drehzahlschwelle fuer Momentenueberwachung MDmin" VALUE 0x7778A TKW_VV_VV_SW 100.0 FORMULA_0006 0.0 10000.0 /end CHARACTERISTIC
/begin CHARACTERISTIC K_MD_SK_N_MIN "Drehzahlschwelle fuer Momentenueberwachung" VALUE 0x77780 TKW_VV_VV_SW 100.0 FORMULA_0006 0.0 10000.0 /end CHARACTERISTIC
/begin CHARACTERISTIC K_MD_SK_NHYS "n_llr-Offset bei pwg=0" VALUE 0x77782 TKW_VV_VV_SW 100.0 FORMULA_0006 0.0 10000.0 /end CHARACTERISTIC
/begin CHARACTERISTIC K_MD_SK_PWGMIN "PWG-Schwelle fuer pwg=0" VALUE 0x7777F TKW_VV_VV_UB 100.0 FORMULA_0471 0.0 25.0 /end CHARACTERISTIC
/begin CHARACTERISTIC K_MD_SK_RF_MAX "max. rf zur Absicherung Momentenberechnung" VALUE 0x7778E TKW_VV_VV_SW 100.0 FORMULA_0007 0.0 2.0 FORMAT "%6.3" /end CHARACTERISTIC
/begin CHARACTERISTIC K_MD_SK_TAU_PWG "Filter Pwg0-Ueberwachung" VALUE 0x7777D TKW_VV_VV_UB 100.0 FORMULA_0455 1.009999960660934e-002 2.559999942779541 /end CHARACTERISTIC
/begin CHARACTERISTIC K_MD_SK_TAU_VERGL "Filter Vergleichsmoment" VALUE 0x7777E TKW_VV_VV_UB 100.0 FORMULA_0455 1.009999960660934e-002 2.559999942779541 /end CHARACTERISTIC
/begin CHARACTERISTIC K_MD_SK_TIMER_0 "max. Timer fuer pwg=0" VALUE 0x77786 TKW_VV_VV_UW 100.0 FORMULA_0021 0.0 655.0 FORMAT "%5.2" /end CHARACTERISTIC
/begin CHARACTERISTIC K_MD_SK_TIMER_1 "max. Timer fuer pwg>0" VALUE 0x77788 TKW_VV_VV_UW 100.0 FORMULA_0021 0.0 655.0 FORMAT "%5.2" /end CHARACTERISTIC
/begin CHARACTERISTIC K_MD_SK_TIRED_HYS "Hysterese fuer Hinzunahme eines Zylinders" VALUE 0x77798 TKW_VV_VV_UW 100.0 FORMULA_0073 0.0 4.0 FORMAT "%6.3" /end CHARACTERISTIC
/begin CHARACTERISTIC K_MD_SK_TIRED_MIN "Minimalwert fuer Einspritzausblendungen" VALUE 0x77796 TKW_VV_VV_UB 100.0 FORMULA_0003 0.0 8.0 /end CHARACTERISTIC
/begin CHARACTERISTIC K_MD_SK_TIRED_ZYL "Ausblendmasken" VAL_BLK 0x7779C TKW_VV_VV_UW 100.0 FORMULA_0010 0.0 65535.0 NUMBER 11 /end CHARACTERISTIC
/begin CHARACTERISTIC K_MD_SK_WDK_KH_OFFS "Offset auf KL_MD_SK_WDK im KH" VALUE 0x777B2 TKW_VV_VV_SW 100.0 FORMULA_0001 -10.0 120.0 FORMAT "%4.1" /end CHARACTERISTIC
/begin CHARACTERISTIC K_MD_SK_WDK_LLSFAIL_OFFS "Offset auf KL_MD_SK_WDK bei LLS-Off" VALUE 0x777B4 TKW_VV_VV_SW 100.0 FORMULA_0001 -10.0 120.0 FORMAT "%4.1" /end CHARACTERISTIC
/begin CHARACTERISTIC K_MD_START_OFF_E2 "Startoffset" VALUE 0x7B0AC TKW_VV_VV_SW 100.0 FORMULA_0009 -100.0 1000.0 FORMAT "%4.1" /end CHARACTERISTIC
/begin CHARACTERISTIC K_MD_TAU_FW_DPFIL "Filter fuer DP-Wichtung" VALUE 0x764CD TKW_VV_VV_UB 100.0 FORMULA_0470 5.100000184029341e-003 1.279999971389771 /end CHARACTERISTIC
/begin CHARACTERISTIC K_MD_TAU_FW_GRAD "Filter fuer Fahrerwunsch" VALUE 0x77894 TKW_VV_VV_UB 100.0 FORMULA_0470 5.100000184029341e-003 1.279999971389771 /end CHARACTERISTIC
/begin CHARACTERISTIC K_MD_TAU_IND_TZ_GRAD "TAU Sollmoment" VALUE 0x7788B TKW_VV_VV_UB 100.0 FORMULA_0470 5.100000184029341e-003 1.279999971389771 /end CHARACTERISTIC
/begin CHARACTERISTIC K_MD_TAU_START_OFF_E2 "Filter Startoffset" VALUE 0x7B0AB TKW_VV_VV_UB 100.0 FORMULA_0746 0.1004000008106232 25.60000038146973 /end CHARACTERISTIC
/begin CHARACTERISTIC K_MD_VBEGR_A1 "Reglerfaktor A1" VALUE 0x778C2 TKW_VV_VV_SW 100.0 FORMULA_0488 -10.0 10.0 FORMAT "%5.2" /end CHARACTERISTIC
/begin CHARACTERISTIC K_MD_VBEGR_HYS_AUS "n-Abschalthysterese" VALUE 0x778A2 TKW_VV_VV_SW 100.0 FORMULA_0076 -80.0 360.0 FORMAT "%4.1" /end CHARACTERISTIC
/begin CHARACTERISTIC K_MD_VBEGR_MD_HYS "Md-Abschalthysterese" VALUE 0x778A4 TKW_VV_VV_SW 100.0 FORMULA_0009 -100.0 1000.0 FORMAT "%4.1" /end CHARACTERISTIC
/begin CHARACTERISTIC K_MD_VERBR_MAX "max. Verbrauchermoment" VALUE 0x75544 TKW_VV_VV_SW 100.0 FORMULA_0009 0.0 200.0 FORMAT "%4.1" /end CHARACTERISTIC
/begin CHARACTERISTIC K_MD_VERBR_MAX_E2 "max. Verbrauchermoment" VALUE 0x7B09C TKW_VV_VV_SW 100.0 FORMULA_0009 -100.0 1000.0 FORMAT "%4.1" /end CHARACTERISTIC
/begin CHARACTERISTIC K_MD_ZYL_ANZ_E2 "Zylinderanzahl Ebene 2" VALUE 0x7B0B2 TKW_VV_VV_UB 100.0 FORMULA_0003 0.0 255.0 /end CHARACTERISTIC
/begin CHARACTERISTIC K_MD_ZYL_MASK_B1 "Zylindermaske Bank 1 - Ebene 2" VALUE 0x7B0B4 TKW_VV_VV_UW 100.0 FORMULA_0010 0.0 65535.0 /end CHARACTERISTIC
/begin CHARACTERISTIC K_MD_ZYL_MASK_B2 "Zylindermaske Bank 2 - Ebene 2" VALUE 0x7B0B6 TKW_VV_VV_UW 100.0 FORMULA_0010 0.0 65535.0 /end CHARACTERISTIC
/begin CHARACTERISTIC K_PCTRL_PROZ_ZYKL "Prozess-Ueberwachungszyklus" VALUE 0x7845E TKW_VV_VV_UB 100.0 FORMULA_0357 0.0 1.274999976158142 /end CHARACTERISTIC
/begin CHARACTERISTIC K_PCTRL_TASK_ZYKL "Task-Ueberwachungszyklus" VALUE 0x7845D TKW_VV_VV_UB 100.0 FORMULA_0357 0.0 1.274999976158142 /end CHARACTERISTIC
/begin CHARACTERISTIC K_PCTRL_TIMEOUT "Timeout der Prozessorueberwachung" VALUE 0x7845C TKW_VV_VV_UB 100.0 FORMULA_0358 0.0 2550.0 /end CHARACTERISTIC
/begin CHARACTERISTIC K_PKS_CAN_ALIVE_ERR_MAX "max. Alivefehler" VALUE 0x78464 TKW_VV_VV_UB 100.0 FORMULA_0003 0.0 255.0 /end CHARACTERISTIC
/begin CHARACTERISTIC K_PKS_CAN_ED_T_SPERR "Wartezeit fuer CAN-Diagnose" VALUE 0x78460 TKW_VV_VV_UW 100.0 FORMULA_0109 0.0 325.0 FORMAT "%5.2" /end CHARACTERISTIC
/begin CHARACTERISTIC K_PKS_CAN_ED_UB_MIN "min. Ub fuer CAN-Diagnose" VALUE 0x78462 TKW_VV_VV_SW 100.0 FORMULA_0008 0.0 28.0 FORMAT "%4.1" /end CHARACTERISTIC
/begin CHARACTERISTIC K_PWG_A0_MIN_E2 "Unter Adaptionschwelle Ebene 2" VALUE 0x7B4D6 TKW_VV_VV_SW 100.0 FORMULA_0250 0.0 5.0 FORMAT "%6.3" /end CHARACTERISTIC
/begin CHARACTERISTIC K_PWG_A0_TAU "Filterkonstante fuer die LL-Winkel Abwaertsadaption 1" VALUE 0x78484 TKW_VV_VV_UB 100.0 FORMULA_0746 0.1004000008106232 25.60000038146973 /end CHARACTERISTIC
/begin CHARACTERISTIC K_PWG_A0_ZAEHLER "Zaehler fuer die Aufwaertsadaption" VALUE 0x78488 TKW_VV_VV_UB 100.0 FORMULA_0003 1.0 255.0 /end CHARACTERISTIC
/begin CHARACTERISTIC K_PWG_AB_RAMPE "Dauer der Abregelrampe bei Leistungsbegrenzung" VALUE 0x7848C TKW_VV_VV_UW 100.0 FORMULA_0881 5.100000184029341e-003 327.6799926757813 FORMAT "%7.4" /end CHARACTERISTIC
/begin CHARACTERISTIC K_PWG_BLS_CFG "Einschalten der Diagnose" VALUE 0x78466 TKW_VV_VV_UB 100.0 FORMULA_0880 0.0 255.0 /end CHARACTERISTIC
/begin CHARACTERISTIC K_PWG_BLS_N_MAX_FSP "Drehzahlschwelle fuer Fehlerspeichereintrag bei Leistungsreduktion" VALUE 0x78474 TKW_VV_VV_SW 100.0 FORMULA_0006 0.0 10000.0 /end CHARACTERISTIC
/begin CHARACTERISTIC K_PWG_BLS_PWG_MAX "Pedalwertschwelle Berganfahrt ermoeglichen" VALUE 0x7846E TKW_VV_VV_UW 100.0 FORMULA_0630 0.0 100.0 FORMAT "%4.1" /end CHARACTERISTIC
/begin CHARACTERISTIC K_PWG_BLS_PWG_MIN "Pedalwertschwelle Berganfahrt sperren" VALUE 0x78472 TKW_VV_VV_UW 100.0 FORMULA_0630 0.0 100.0 FORMAT "%4.1" /end CHARACTERISTIC
/begin CHARACTERISTIC K_PWG_BLS_T_BRP_FEHLER "Begrenzungsverzoegerung-Bremsdruck" VALUE 0x78467 TKW_VV_VV_UB 100.0 FORMULA_0584 0.0 1275.0 /end CHARACTERISTIC
/begin CHARACTERISTIC K_PWG_BLS_T_V_FEHLER "Begrenzungsverzoegerung-Bremsdruck" VALUE 0x78468 TKW_VV_VV_UB 100.0 FORMULA_0584 0.0 1275.0 /end CHARACTERISTIC
/begin CHARACTERISTIC K_PWG_BLS_V_MAX "Geschwindigkeitsschwelle Berganfahrt sperren" VALUE 0x78470 TKW_VV_VV_SW 100.0 FORMULA_0076 -80.0 360.0 FORMAT "%4.1" /end CHARACTERISTIC
/begin CHARACTERISTIC K_PWG_BLS_V_MIN "Geschwindigkeitsschwelle Berganfahrt ermoeglichen" VALUE 0x7846C TKW_VV_VV_SW 100.0 FORMULA_0076 -80.0 360.0 FORMAT "%4.1" /end CHARACTERISTIC
/begin CHARACTERISTIC K_PWG_BLS_V_VORNE_MAX "Geschwindigkeitschwelle fuer Begrenzung" VALUE 0x7846A TKW_VV_VV_SW 100.0 FORMULA_0076 -80.0 360.0 FORMAT "%4.1" /end CHARACTERISTIC
/begin CHARACTERISTIC K_PWG_DELTA_E2 "Zulaessige Differenz zur Ebene 2" VALUE 0x7B4DC TKW_VV_VV_SW 100.0 FORMULA_0001 0.0 120.0 FORMAT "%4.1" /end CHARACTERISTIC
/begin CHARACTERISTIC K_PWG_ERR_MAX_E2 "max. Fehler fuer Vergleich" VALUE 0x7B4DE TKW_VV_VV_UB 100.0 FORMULA_0003 0.0 255.0 /end CHARACTERISTIC
/begin CHARACTERISTIC K_PWG_KD "Pedalwert fuer Kick Down" VALUE 0x78490 TKW_VV_VV_SW 100.0 FORMULA_0001 -10.0 150.0 FORMAT "%4.1" /end CHARACTERISTIC
/begin CHARACTERISTIC K_PWG_NORM_E2 "Normierung Potentiometerspannung Ebene 2" VALUE 0x7B4D8 TKW_VV_VV_SW 100.0 FORMULA_0865 0.0 100.0 FORMAT "%6.3" /end CHARACTERISTIC
/begin CHARACTERISTIC K_PWG_NORM_HS_E2 "Normierung Potentiometerspannung fuer Handschalter Ebene 2" VALUE 0x7B4DA TKW_VV_VV_SW 100.0 FORMULA_0865 0.0 100.0 FORMAT "%6.3" /end CHARACTERISTIC
/begin CHARACTERISTIC K_PWG_SK_NULLAGE "Diagnose Schwelle" VALUE 0x7848E TKW_VV_VV_SW 100.0 FORMULA_0001 -10.0 120.0 FORMAT "%4.1" /end CHARACTERISTIC
/begin CHARACTERISTIC K_PWG_SMG_ANFAHREN_FAK_E2 "max. Faktor fuer 2. Ganganfahrt Ebene 2" VALUE 0x7B4E0 TKW_VV_VV_UW 100.0 FORMULA_0073 0.0 2.0 FORMAT "%6.3" /end CHARACTERISTIC
/begin CHARACTERISTIC K_PWG_SOLL_2GANG_AUF "Schrittweite fuer 2. Ganganfahrt" VALUE 0x78498 TKW_VV_VV_UW 100.0 FORMULA_0882 0.0 12799.8046875 FORMAT "%5.2" /end CHARACTERISTIC
/begin CHARACTERISTIC K_PWG_SOLL_2GANG_FAK "max. Faktor fuer 2. Ganganfahrt" VALUE 0x78496 TKW_VV_VV_UW 100.0 FORMULA_0073 0.0 2.0 FORMAT "%6.3" /end CHARACTERISTIC
/begin CHARACTERISTIC K_PWG_SOLL_2GANG_MAX "max. Pedalwert 2. Ganganfahrt" VALUE 0x78492 TKW_VV_VV_SW 100.0 FORMULA_0001 -10.0 120.0 FORMAT "%4.1" /end CHARACTERISTIC
/begin CHARACTERISTIC K_PWG_SOLL_2GANG_VMAX "max. Gewschwindigkeit 2. Ganganfahrt" VALUE 0x78494 TKW_VV_VV_SW 100.0 FORMULA_0076 -80.0 360.0 FORMAT "%4.1" /end CHARACTERISTIC
/begin CHARACTERISTIC K_PWG_TAU "Filterkonstante fuer den absoluten Spannungswert" VALUE 0x7847E TKW_VV_VV_UB 100.0 FORMULA_0470 5.100000184029341e-003 1.279999971389771 /end CHARACTERISTIC
/begin CHARACTERISTIC K_PWG_TAU_FEHLER "Filterkonstante fuer den absoluten Spannungswert im Fehlerfall" VALUE 0x7847F TKW_VV_VV_UB 100.0 FORMULA_0470 5.100000184029341e-003 1.279999971389771 /end CHARACTERISTIC
/begin CHARACTERISTIC K_PWG1_A0_INITINC "Aufwertsadaption der LL-Potentiometerspannung beim Start" VALUE 0x7848A TKW_VV_VV_SW 100.0 FORMULA_0250 0.0 5.0 FORMAT "%6.3" /end CHARACTERISTIC
/begin CHARACTERISTIC K_PWG1_A0_MAX "Obere Adaptionschwelle Pedalwertgeber 1" VALUE 0x78482 TKW_VV_VV_SW 100.0 FORMULA_0250 0.0 5.0 FORMAT "%6.3" /end CHARACTERISTIC
/begin CHARACTERISTIC K_PWG1_A0_MIN "Unter Adaptionschwelle Pedalwertgeber 1" VALUE 0x78480 TKW_VV_VV_SW 100.0 FORMULA_0250 0.0 5.0 FORMAT "%6.3" /end CHARACTERISTIC
/begin CHARACTERISTIC K_PWG1_DIAG_MAX "Obere Diagnoseschwelle-Pedalwertgeber 1" VALUE 0x78478 TKW_VV_VV_SW 100.0 FORMULA_0250 0.0 5.0 FORMAT "%6.3" /end CHARACTERISTIC
/begin CHARACTERISTIC K_PWG1_DIAG_MIN "Unter Diagnoseschwelle-Pedalwertgeber 1" VALUE 0x78476 TKW_VV_VV_SW 100.0 FORMULA_0250 0.0 5.0 FORMAT "%6.3" /end CHARACTERISTIC
/begin CHARACTERISTIC K_PWG1_INC_A0_ADAPT "Freischalten der Aufwaertsadaption" VALUE 0x78486 TKW_VV_VV_SW 100.0 FORMULA_0250 0.0 5.0 FORMAT "%6.3" /end CHARACTERISTIC
/begin CHARACTERISTIC K_PWG1_NORM "Normierung Potentiometerspannung - %-Pedalwert 1" VALUE 0x7847A TKW_VV_VV_SW 100.0 FORMULA_0865 0.0 100.0 FORMAT "%6.3" /end CHARACTERISTIC
/begin CHARACTERISTIC K_PWG1_NORM_HS "Normierung Potentiometerspannung fuer Handschalter- %-Pedalwert 1" VALUE 0x7847C TKW_VV_VV_SW 100.0 FORMULA_0865 0.0 100.0 FORMAT "%6.3" /end CHARACTERISTIC
/begin CHARACTERISTIC K_RAM_CHK_CFG "Ramcheck Config" VALUE 0x78509 TKW_VV_VV_UB 100.0 FORMULA_0362 0.0 255.0 /end CHARACTERISTIC
/begin CHARACTERISTIC K_RAM_CHK_T "Zeit fuer den Ramcheck pro Aufruf" VALUE 0x78508 TKW_VV_VV_UB 100.0 FORMULA_0361 1.0 255.0 /end CHARACTERISTIC
/begin CHARACTERISTIC K_TIME_REL_OBD_CFG "Konfiguration Relativzeitdiagnose" VALUE 0x7A228 TKW_VV_VV_UB 100.0 FORMULA_0989 0.0 255.0 /end CHARACTERISTIC
/begin CHARACTERISTIC K_TIME_REL_OBD_MAX_FEHLER "Fehlerschwelle" VALUE 0x7A229 TKW_VV_VV_UB 100.0 FORMULA_0037 0.0 255.0 /end CHARACTERISTIC
/begin CHARACTERISTIC K_TIME_REL_OBD_T_MAX "Maximaler Fortschritt time_rel im lfd. Betrieb" VALUE 0x7A22A TKW_VV_VV_UW 100.0 FORMULA_0626 0.0 65535.0 /end CHARACTERISTIC
/begin CHARACTERISTIC K_TIME_REL_OBD_T_MIN "Minimaler Fortschritt time_rel im lfd. Betrieb" VALUE 0x7A22C TKW_VV_VV_UW 100.0 FORMULA_0626 0.0 65535.0 /end CHARACTERISTIC
/begin CHARACTERISTIC K_TIME_REL_OBD_T_ML "Min. Laufzeit Motor fuer Diagnose" VALUE 0x7A230 TKW_VV_VV_UL 100.0 FORMULA_0147 0.0 3600.0 FORMAT "%5.2" /end CHARACTERISTIC
/begin CHARACTERISTIC K_TIME_REL_OBD_TMOT_ABSTELL "Minimale Abstelltemp. d. Motors fuer Diagnose" VALUE 0x7A234 TKW_VV_VV_SW 100.0 FORMULA_0023 -50.0 170.0 FORMAT "%4.1" /end CHARACTERISTIC
/begin CHARACTERISTIC K_TIME_REL_OBD_TMOT_DELTA_MIN "tmot-Mindestabkuehlung bei MS" VALUE 0x7A23E TKW_VV_VV_SW 100.0 FORMULA_0074 -1000.0 1000.0 FORMAT "%4.1" /end CHARACTERISTIC
/begin CHARACTERISTIC K_TIME_REL_OBD_TMOT_START_FAST "minimales tmot fuer Standzeitdiagnose FAST" VALUE 0x7A238 TKW_VV_VV_SW 100.0 FORMULA_0023 -50.0 170.0 FORMAT "%4.1" /end CHARACTERISTIC
/begin CHARACTERISTIC K_TIME_REL_OBD_TMOT_START_SLOW "minimales tmot fuer Standzeitdiagnose SLOW" VALUE 0x7A236 TKW_VV_VV_SW 100.0 FORMULA_0023 -50.0 170.0 FORMAT "%4.1" /end CHARACTERISTIC
/begin CHARACTERISTIC K_TIME_REL_OBD_UB_MIN "Schwelle U-Batt. Diagnose" VALUE 0x7A23A TKW_VV_VV_SW 100.0 FORMULA_0008 0.0 28.0 FORMAT "%4.1" /end CHARACTERISTIC
/begin CHARACTERISTIC K_TIME_REL_OBD_ZERO_CNT_MAX "time_rel-Reset-Zaehler Maxwert" VALUE 0x7A23C TKW_VV_VV_UB 100.0 FORMULA_0003 0.0 255.0 /end CHARACTERISTIC
/begin CHARACTERISTIC K_TMOT_CC_HIGH_HYS "Hysterese fuer CC-Meldungen" VALUE 0x7A378 TKW_VV_VV_UB 100.0 FORMULA_1009 0.0 25.5 /end CHARACTERISTIC
/begin CHARACTERISTIC K_TMOT_CC_HIGH_TMOT_2 "CC-Meldung rot ueber Tmot" VALUE 0x7A372 TKW_VV_VV_SW 100.0 FORMULA_0023 -50.0 170.0 FORMAT "%4.1" /end CHARACTERISTIC
/begin CHARACTERISTIC K_TMOT_CC_HIGH_TOEL_1 "CC-Meldung gelb ueber Toel" VALUE 0x7A374 TKW_VV_VV_SW 100.0 FORMULA_0023 -50.0 180.0 FORMAT "%4.1" /end CHARACTERISTIC
/begin CHARACTERISTIC K_TMOT_CC_HIGH_TOEL_2 "CC-Meldung rot ueber Toel" VALUE 0x7A376 TKW_VV_VV_SW 100.0 FORMULA_0023 -50.0 180.0 FORMAT "%4.1" /end CHARACTERISTIC
/begin CHARACTERISTIC K_TMOT_CC_HIGH_ZWS_OFF "Offset fuer Zwangsschaltung" VALUE 0x7A379 TKW_VV_VV_UB 100.0 FORMULA_1009 0.0 25.5 /end CHARACTERISTIC
/begin CHARACTERISTIC K_TMOT_CFG_TOEL "CC-Toel Konfig" VALUE 0x7A36E TKW_VV_VV_UB 100.0 FORMULA_1008 0.0 255.0 /end CHARACTERISTIC
/begin CHARACTERISTIC K_TMOT_DIAG_GRAD_MAX "Max. Gradient ueber 100ms" VALUE 0x7A330 TKW_VV_VV_SW 100.0 FORMULA_1005 0.0 819.1749877929688 FORMAT "%5.2" /end CHARACTERISTIC
/begin CHARACTERISTIC K_TMOT_DIAG_GRAD_TAU "Filterkonstante fuer die Gradientenberechnung" VALUE 0x7A335 TKW_VV_VV_UB 100.0 FORMULA_0746 0.1004000008106232 25.60000038146973 /end CHARACTERISTIC
/begin CHARACTERISTIC K_TMOT_DIAG_MAX "Obere Grenze Motortemperatur" VALUE 0x7A326 TKW_VV_VV_SW 100.0 FORMULA_0975 -50.0 170.0 FORMAT "%6.3" /end CHARACTERISTIC
/begin CHARACTERISTIC K_TMOT_DIAG_MIN "Unter Grenze Motortemperatur" VALUE 0x7A324 TKW_VV_VV_SW 100.0 FORMULA_0975 -50.0 170.0 FORMAT "%6.3" /end CHARACTERISTIC
/begin CHARACTERISTIC K_TMOT_DIAG_TAN "TAN-Schwelle zur Plausibilitaetsueberpruefung" VALUE 0x7A328 TKW_VV_VV_SW 100.0 FORMULA_0023 -50.0 170.0 FORMAT "%4.1" /end CHARACTERISTIC
/begin CHARACTERISTIC K_TMOT_DIAG_TIME "Ansprechzeit der Plausibilitaet gegenueber Masse" VALUE 0x7A332 TKW_VV_VV_UW 100.0 FORMULA_0021 0.0 655.3499755859375 FORMAT "%5.2" /end CHARACTERISTIC
/begin CHARACTERISTIC K_TMOT_DIAG_TKA "TKA-Schwelle zur Plausibilitaetsueberpruefung" VALUE 0x7A32A TKW_VV_VV_SW 100.0 FORMULA_0023 -50.0 170.0 FORMAT "%4.1" /end CHARACTERISTIC
/begin CHARACTERISTIC K_TMOT_DK_TAU "Zeitkonstante fuer TMOT-Filterung" VALUE 0x7A37A TKW_VV_VV_UW 100.0 FORMULA_0681 0.1000000014901161 6553.5 FORMAT "%5.2" /end CHARACTERISTIC
/begin CHARACTERISTIC K_TMOT_ELU_ERR_CC_HIGH_TMOT_1 "CC-Meldung gelb ueber Tmot und Elu-Fehler" VALUE 0x7A370 TKW_VV_VV_SW 100.0 FORMULA_0023 -50.0 170.0 FORMAT "%4.1" /end CHARACTERISTIC
/begin CHARACTERISTIC K_TMOT_ERR_MAX_E2 "max. Fehler fuer Vergleich" VALUE 0x7B4F4 TKW_VV_VV_UB 100.0 FORMULA_0003 0.0 255.0 /end CHARACTERISTIC
/begin CHARACTERISTIC K_TMOT_MAX_E2 "max. Kuehlmitteltemperatur" VALUE 0x7B4F8 TKW_VV_VV_SW 100.0 FORMULA_0023 -50.0 170.0 FORMAT "%4.1" /end CHARACTERISTIC
/begin CHARACTERISTIC K_TMOT_MAX_NEG_GRAD_E2 "Gradientenschwelle Ebene 2" VALUE 0x7B4FA TKW_VV_VV_SW 100.0 FORMULA_0985 -32768.0 0.0 /end CHARACTERISTIC
/begin CHARACTERISTIC K_TMOT_MAX_NEG_GRADIENT "Gradientenschwelle bei laufendem Motor" VALUE 0x7A32E TKW_VV_VV_SW 100.0 FORMULA_1004 -8192.0 0.0 FORMAT "%5.2" /end CHARACTERISTIC
/begin CHARACTERISTIC K_TMOT_MAX_POS_GRAD_E2 "Gradientenschwelle Ebene 2" VALUE 0x7B4FC TKW_VV_VV_SW 100.0 FORMULA_0985 0.0 32767.0 /end CHARACTERISTIC
/begin CHARACTERISTIC K_TMOT_MIN_E2 "min. Kuehlmitteltemperatur" VALUE 0x7B4F6 TKW_VV_VV_SW 100.0 FORMULA_0023 -50.0 170.0 FORMAT "%4.1" /end CHARACTERISTIC
/begin CHARACTERISTIC K_TMOT_MODELL_C_MOTOR "Waermekapazitaet Motor" VALUE 0x7A340 TKW_VV_VV_UW 100.0 FORMULA_0073 1.000000047497451e-003 4.0 FORMAT "%6.3" /end CHARACTERISTIC
/begin CHARACTERISTIC K_TMOT_MODELL_ERSATZ "Obergrenze Ersatzwert" VALUE 0x7A36A TKW_VV_VV_SW 100.0 FORMULA_0023 -50.0 170.0 FORMAT "%4.1" /end CHARACTERISTIC
/begin CHARACTERISTIC K_TMOT_MODELL_F_KW "Faktor Kuehlwasserabwaerme" VALUE 0x7A342 TKW_VV_VV_UW 100.0 FORMULA_0073 0.0 4.0 FORMAT "%6.3" /end CHARACTERISTIC
/begin CHARACTERISTIC K_TMOT_MODELL_F_MOTOR "Faktor fuer Motorabwaerme" VALUE 0x7A33E TKW_VV_VV_UW 100.0 FORMULA_0073 0.0 1.0 FORMAT "%6.3" /end CHARACTERISTIC
/begin CHARACTERISTIC K_TMOT_MODELL_GAIN "Integratorkonstante" VALUE 0x7A344 TKW_VV_VV_UW 100.0 FORMULA_0073 0.0 1.0 FORMAT "%6.3" /end CHARACTERISTIC
/begin CHARACTERISTIC K_TMOT_MODELL_LAM_MAX "Max. Lambdabegrenzung" VALUE 0x7A348 TKW_VV_VV_UW 100.0 FORMULA_0025 0.5 1.5 FORMAT "%6.3" /end CHARACTERISTIC
/begin CHARACTERISTIC K_TMOT_MODELL_LAM_MIN "Min. Lambdabegrenzung" VALUE 0x7A346 TKW_VV_VV_UW 100.0 FORMULA_0025 0.5 1.5 FORMAT "%6.3" /end CHARACTERISTIC
/begin CHARACTERISTIC K_TMOT_MODELL_SA_ML_F "ML-Reduzierung bei SA" VALUE 0x7A33A TKW_VV_VV_UW 100.0 FORMULA_0073 0.0 1.0 FORMAT "%6.3" /end CHARACTERISTIC
/begin CHARACTERISTIC K_TMOT_MODELL_START_MIN "Kaltstarterkennung" VALUE 0x7A34E TKW_VV_VV_SW 100.0 FORMULA_0023 -50.0 170.0 FORMAT "%4.1" /end CHARACTERISTIC
/begin CHARACTERISTIC K_TMOT_MODELL_TAU_KRAFT "Filterkonstante Kraftstoffenergieeintrag" VALUE 0x7A336 TKW_VV_VV_UB 100.0 FORMULA_0746 0.1004000008106232 25.60000038146973 /end CHARACTERISTIC
/begin CHARACTERISTIC K_TMOT_MODELL_TAU_KUEHLER "Filterkonstante Kuehlerwaermeabfuhr" VALUE 0x7A338 TKW_VV_VV_UB 100.0 FORMULA_0746 0.1004000008106232 25.60000038146973 /end CHARACTERISTIC
/begin CHARACTERISTIC K_TMOT_MODELL_TAU_UMG "Filterkonstante Umgebungswaermeabfuhr" VALUE 0x7A337 TKW_VV_VV_UB 100.0 FORMULA_0746 0.1004000008106232 25.60000038146973 /end CHARACTERISTIC
/begin CHARACTERISTIC K_TMOT_MODELL_THERM_DELTA "Thermostatregelbereich" VALUE 0x7A34C TKW_VV_VV_SW 100.0 FORMULA_0970 5.000000074505806e-002 1000.0 FORMAT "%5.2" /end CHARACTERISTIC
/begin CHARACTERISTIC K_TMOT_MODELL_THERM_MIN "Thermostat oeffnet" VALUE 0x7A34A TKW_VV_VV_SW 100.0 FORMULA_0342 -50.0 170.0 FORMAT "%5.2" /end CHARACTERISTIC
/begin CHARACTERISTIC K_TMOT_MODELL_TI_F "Kraftstoffenergieeintragsfaktor" VALUE 0x7A33C TKW_VV_VV_UW 100.0 FORMULA_0073 1.000000047497451e-003 63.99900054931641 FORMAT "%6.3" /end CHARACTERISTIC
/begin CHARACTERISTIC K_TMOT_MODELL_TKA_ERSATZ_DELTA "Obergrenzendelta zum Kuehleraustritt bei heissem tka" VALUE 0x7A36C TKW_VV_VV_SW 100.0 FORMULA_0074 -1000.0 1000.0 FORMAT "%4.1" /end CHARACTERISTIC
/begin CHARACTERISTIC K_TMOT_MODELL_TMOT_MODELL_ML "Umschaltschwelle auf tmot" VALUE 0x7A350 TKW_VV_VV_SW 100.0 FORMULA_0023 -50.0 170.0 FORMAT "%4.1" /end CHARACTERISTIC
/begin CHARACTERISTIC K_TMOT_OBD_BLOCKHEATER_DIFF "Erkennung eines Blockheaters" VALUE 0x7A35C TKW_VV_VV_SW 100.0 FORMULA_0074 -1000.0 1000.0 FORMAT "%4.1" /end CHARACTERISTIC
/begin CHARACTERISTIC K_TMOT_OBD_CFG "Einschalten der Diagnose" VALUE 0x7A352 TKW_VV_VV_UB 100.0 FORMULA_1006 0.0 255.0 /end CHARACTERISTIC
/begin CHARACTERISTIC K_TMOT_OBD_DIFF_HIGH "Maximale zulaessige Differenz Messwert-Modell" VALUE 0x7A360 TKW_VV_VV_SW 100.0 FORMULA_0074 -1000.0 1000.0 FORMAT "%4.1" /end CHARACTERISTIC
/begin CHARACTERISTIC K_TMOT_OBD_DIFF_MAX "Maximale zulaessige Differenz Messwert-Modell" VALUE 0x7A35E TKW_VV_VV_SW 100.0 FORMULA_0074 -1000.0 1000.0 FORMAT "%4.1" /end CHARACTERISTIC
/begin CHARACTERISTIC K_TMOT_OBD_HIGH "Maximale Motortemperatur nach Standzeit" VALUE 0x7A37C TKW_VV_VV_SW 100.0 FORMULA_0975 -50.0 170.0 FORMAT "%6.3" /end CHARACTERISTIC
/begin CHARACTERISTIC K_TMOT_OBD_HIGH_TIME "Standzeit fuer high-Diagnose" VALUE 0x7A37E TKW_VV_VV_UW 100.0 FORMULA_0706 0.0 1092.25 FORMAT "%5.2" /end CHARACTERISTIC
/begin CHARACTERISTIC K_TMOT_OBD_T_ML_MIN "Der Motor muss fuer gewisse Zeit laufen" VALUE 0x7A358 TKW_VV_VV_UW 100.0 FORMULA_0021 0.0 655.3499755859375 FORMAT "%5.2" /end CHARACTERISTIC
/begin CHARACTERISTIC K_TMOT_OBD_T_SA_MAX "Maximale Zeit im Schub" VALUE 0x7A354 TKW_VV_VV_UW 100.0 FORMULA_1007 0.0 655.3499755859375 FORMAT "%4.1" /end CHARACTERISTIC
/begin CHARACTERISTIC K_TMOT_OBD_THERM_2 "Zu erreichende Motortemperatur bei Thermostatoeffnung" VALUE 0x7A368 TKW_VV_VV_SW 100.0 FORMULA_0023 -50.0 170.0 FORMAT "%4.1" /end CHARACTERISTIC
/begin CHARACTERISTIC K_TMOT_OBD_THERM_2_START "Max. Starttemperatur fuer Thermostatdiagnose" VALUE 0x7A364 TKW_VV_VV_SW 100.0 FORMULA_0023 -50.0 170.0 FORMAT "%4.1" /end CHARACTERISTIC
/begin CHARACTERISTIC K_TMOT_OBD_TKA_THERM_1_DELTA "Kuehlererwaermung seit Start bei Sensorfehler" VALUE 0x7A362 TKW_VV_VV_SW 100.0 FORMULA_0074 -1000.0 1000.0 FORMAT "%4.1" /end CHARACTERISTIC
/begin CHARACTERISTIC K_TMOT_OBD_TKA_THERM_2_DELTA "Kuehlererwaermung seit Start bei Thermostatoeffnung" VALUE 0x7A366 TKW_VV_VV_SW 100.0 FORMULA_0074 -1000.0 1000.0 FORMAT "%4.1" /end CHARACTERISTIC
/begin CHARACTERISTIC K_TMOT_OBD_TMOT_MIN "Min. Temperatur fuer OBD-Diagnose" VALUE 0x7A356 TKW_VV_VV_SW 100.0 FORMULA_0023 -50.0 170.0 FORMAT "%4.1" /end CHARACTERISTIC
/begin CHARACTERISTIC K_TMOT_OBD_TMOT_MODELL_MAX "Max. Modelltemperatur fuer OBD-Diagnose" VALUE 0x7A35A TKW_VV_VV_SW 100.0 FORMULA_0023 -50.0 170.0 FORMAT "%4.1" /end CHARACTERISTIC
/begin CHARACTERISTIC K_TMOT_SK_DELTA "Sicherheitskritische Differenz zu tka und toel" VALUE 0x7A32C TKW_VV_VV_SW 100.0 FORMULA_1003 -819.2000122070313 819.1749877929688 FORMAT "%5.2" /end CHARACTERISTIC
/begin CHARACTERISTIC K_TMOT_TAU "Filterkonstante fuer die Kuehlwassererfassung" VALUE 0x7A334 TKW_VV_VV_UB 100.0 FORMULA_0746 0.1004000008106232 25.60000038146973 /end CHARACTERISTIC
/begin CHARACTERISTIC K_TOEL_AEBEGR "Aenderungsbegrenzung fuer toel" VALUE 0x7A536 TKW_VV_VV_SW 100.0 FORMULA_0074 -1000.0 1000.0 FORMAT "%4.1" /end CHARACTERISTIC
/begin CHARACTERISTIC K_TOEL_BEGR_OFFS "Temperaturfenster Begrenzung" VALUE 0x7A538 TKW_VV_VV_SW 100.0 FORMULA_0074 -1000.0 1000.0 FORMAT "%4.1" /end CHARACTERISTIC
/begin CHARACTERISTIC K_TOEL_DELTA_E2 "Abweichung zur Motortemperatur" VALUE 0x7B504 TKW_VV_VV_SW 100.0 FORMULA_0023 -50.0 170.0 FORMAT "%4.1" /end CHARACTERISTIC
/begin CHARACTERISTIC K_TOEL_ERR_MAX_E2 "max. Fehler fuer Vergleich" VALUE 0x7B4FE TKW_VV_VV_UB 100.0 FORMULA_0003 0.0 255.0 /end CHARACTERISTIC
/begin CHARACTERISTIC K_TOEL_KOMBI_WSTATE "Wartezeit f. gueltige Zeit von Kombi" VALUE 0x7A53A TKW_VV_VV_UW 100.0 FORMULA_0021 0.0 655.0 FORMAT "%5.2" /end CHARACTERISTIC
/begin CHARACTERISTIC K_TOEL_MAX_E2 "max. Oeltemperatur" VALUE 0x7B502 TKW_VV_VV_SW 100.0 FORMULA_0023 -50.0 210.0 FORMAT "%4.1" /end CHARACTERISTIC
/begin CHARACTERISTIC K_TOEL_MAX_NEG_GRAD_E2 "Gradientenschwelle Ebene 2" VALUE 0x7B506 TKW_VV_VV_SW 100.0 FORMULA_0985 -32768.0 0.0 /end CHARACTERISTIC
/begin CHARACTERISTIC K_TOEL_MAX_POS_GRAD_E2 "Gradientenschwelle Ebene 2" VALUE 0x7B508 TKW_VV_VV_SW 100.0 FORMULA_0985 0.0 32767.0 /end CHARACTERISTIC
/begin CHARACTERISTIC K_TOEL_MIN_E2 "min. Oeltemperatur" VALUE 0x7B500 TKW_VV_VV_SW 100.0 FORMULA_0023 -50.0 170.0 FORMAT "%4.1" /end CHARACTERISTIC
/begin CHARACTERISTIC K_TOEL_N_T1 "PT1-Filterzeitkonstante fur toel_n_filt" VALUE 0x7A534 TKW_VV_VV_UB 100.0 FORMULA_0003 1.0 255.0 /end CHARACTERISTIC
/begin CHARACTERISTIC K_TOEL_T_MS "Motor steht-Schwelle" VALUE 0x7A53C TKW_VV_VV_UW 100.0 FORMULA_1012 1.0 65535.0 FORMAT "%5.2" /end CHARACTERISTIC
/begin CHARACTERISTIC K_TOEL_TMOT_GRD_F "toel-Gradient f(Kuehlwassertemp.)" VALUE 0x7A540 TKW_VV_VV_SW 100.0 FORMULA_0488 0.0 1.0 FORMAT "%5.2" /end CHARACTERISTIC
/begin CHARACTERISTIC K_TOEL_WANNE_GRD_F "toel-Gradient f(Wannentemp.)" VALUE 0x7A53E TKW_VV_VV_SW 100.0 FORMULA_0488 0.0 1.0 FORMAT "%5.2" /end CHARACTERISTIC
/begin CHARACTERISTIC KF_MD_DELTA_DP_ON "Aktivierungsschwelle" MAP 0x76942 TKF_SW_SW_SW 100.0 FORMULA_0009 -100.0 0.0 FORMAT "%4.1" /begin AXIS_DESCR STD_AXIS gang FORMULA_0479 7 -1.0 10.0 MAX_GRAD 0.0 /end AXIS_DESCR
 /begin AXIS_DESCR STD_AXIS md_kupp_wunsch FORMULA_0009 9 -100.0 1000.0 MAX_GRAD 0.0 FORMAT "%4.1" /end AXIS_DESCR
/end CHARACTERISTIC
/begin CHARACTERISTIC KF_MD_DYN_FIL_RES "Momentenreserve" MAP 0x76E38 TKF_SW_SW_SW 100.0 FORMULA_0009 0.0 1000.0 FORMAT "%4.1" /begin AXIS_DESCR STD_AXIS gang FORMULA_0479 7 -1.0 10.0 MAX_GRAD 0.0 /end AXIS_DESCR
 /begin AXIS_DESCR STD_AXIS md_kupp_wunsch_filter FORMULA_0009 9 -100.0 1000.0 MAX_GRAD 0.0 FORMAT "%4.1" /end AXIS_DESCR
/end CHARACTERISTIC
/begin CHARACTERISTIC KF_MD_DYN_FIL_RES_FAK "Momentenreserve" MAP 0x76ED8 TKF_SW_SW_UW 100.0 FORMULA_0073 0.0 4.0 FORMAT "%6.3"
 /begin AXIS_DESCR STD_AXIS pwg_soll FORMULA_0001 7 -10.0 120.0 MAX_GRAD 0.0 FORMAT "%4.1" /end AXIS_DESCR
 /begin AXIS_DESCR STD_AXIS md_kupp_wunsch_filter FORMULA_0009 7 -100.0 1000.0 MAX_GRAD 0.0 FORMAT "%4.1" /end AXIS_DESCR
/end CHARACTERISTIC
/begin CHARACTERISTIC KF_MD_ETA_LA "LA-Wirkungsgrad" MAP 0x762B0 TKF_SW_SW_UW 100.0 FORMULA_0437 0.0 150.0 FORMAT "%4.1"
 /begin AXIS_DESCR STD_AXIS tz_soll FORMULA_0102 8 -50.0 60.0 MAX_GRAD 0.0 FORMAT "%4.1" /end AXIS_DESCR
 /begin AXIS_DESCR STD_AXIS la_soll FORMULA_0025 8 0.0 1.999899983406067 MAX_GRAD 0.0 FORMAT "%6.3" /end AXIS_DESCR
/end CHARACTERISTIC
/begin CHARACTERISTIC KF_MD_FAHRER_KOMFORT "Fahrerwunsch - Komfort" MAP 0x77AE2 TKF_SW_SW_SW 100.0 FORMULA_0001 0.0 100.0 FORMAT "%4.1"
 /begin AXIS_DESCR STD_AXIS n_diff FORMULA_0006 12 -500.0 10000.0 MAX_GRAD 0.0 /end AXIS_DESCR
 /begin AXIS_DESCR STD_AXIS pwg_soll FORMULA_0001 12 -10.0 120.0 MAX_GRAD 0.0 FORMAT "%4.1" /end AXIS_DESCR
/end CHARACTERISTIC
/begin CHARACTERISTIC KF_MD_FAHRER_KOMFORT_E2 "Fahrerwunsch - Komfort Ebene 2" MAP 0x7B3AC TKF_SW_SW_SW 100.0 FORMULA_0001 0.0 100.0 FORMAT "%4.1" /begin AXIS_DESCR STD_AXIS n_e2 FORMULA_0006 6 0.0 10000.0 MAX_GRAD 0.0 /end AXIS_DESCR
 /begin AXIS_DESCR STD_AXIS pwg_soll_e2 FORMULA_0001 6 -10.0 120.0 MAX_GRAD 0.0 FORMAT "%4.1" /end AXIS_DESCR
/end CHARACTERISTIC
/begin CHARACTERISTIC KF_MD_FAHRER_NORMAL "Fahrerwunsch - Normal" MAP 0x77C34 TKF_SW_SW_SW 100.0 FORMULA_0001 0.0 100.0 FORMAT "%4.1"
 /begin AXIS_DESCR STD_AXIS n_diff FORMULA_0006 12 -500.0 10000.0 MAX_GRAD 0.0 /end AXIS_DESCR
 /begin AXIS_DESCR STD_AXIS pwg_soll FORMULA_0001 12 -10.0 120.0 MAX_GRAD 0.0 FORMAT "%4.1" /end AXIS_DESCR
/end CHARACTERISTIC
/begin CHARACTERISTIC KF_MD_FAHRER_NORMAL_E2 "Fahrerwunsch - Normal Ebene 2" MAP 0x7B40E TKF_SW_SW_SW 100.0 FORMULA_0001 0.0 100.0 FORMAT "%4.1" /begin AXIS_DESCR STD_AXIS n_e2 FORMULA_0006 6 0.0 10000.0 MAX_GRAD 0.0 /end AXIS_DESCR
 /begin AXIS_DESCR STD_AXIS pwg_soll_e2 FORMULA_0001 6 -10.0 120.0 MAX_GRAD 0.0 FORMAT "%4.1" /end AXIS_DESCR
/end CHARACTERISTIC
/begin CHARACTERISTIC KF_MD_FAHRER_PST "Fahrerwunsch - Pruefstand" MAP 0x77ED8 TKF_SW_SW_SW 100.0 FORMULA_0001 0.0 100.0 FORMAT "%4.1"
 /begin AXIS_DESCR STD_AXIS n_diff FORMULA_0006 12 -500.0 10000.0 MAX_GRAD 0.0 /end AXIS_DESCR
 /begin AXIS_DESCR STD_AXIS pwg_soll FORMULA_0001 12 -10.0 120.0 MAX_GRAD 0.0 FORMAT "%4.1" /end AXIS_DESCR
/end CHARACTERISTIC
/begin CHARACTERISTIC KF_MD_FAHRER_SPORT "Fahrerwunsch - Sport" MAP 0x77D86 TKF_SW_SW_SW 100.0 FORMULA_0001 0.0 100.0 FORMAT "%4.1"
 /begin AXIS_DESCR STD_AXIS n_diff FORMULA_0006 12 -500.0 10000.0 MAX_GRAD 0.0 /end AXIS_DESCR
 /begin AXIS_DESCR STD_AXIS pwg_soll FORMULA_0001 12 -10.0 120.0 MAX_GRAD 0.0 FORMAT "%4.1" /end AXIS_DESCR
/end CHARACTERISTIC
/begin CHARACTERISTIC KF_MD_FAHRER_SPORT_E2 "Fahrerwunsch - Sport Ebene 2" MAP 0x7B470 TKF_SW_SW_SW 100.0 FORMULA_0001 0.0 100.0 FORMAT "%4.1" /begin AXIS_DESCR STD_AXIS n_e2 FORMULA_0006 6 0.0 10000.0 MAX_GRAD 0.0 /end AXIS_DESCR
 /begin AXIS_DESCR STD_AXIS pwg_soll_e2 FORMULA_0001 6 -10.0 120.0 MAX_GRAD 0.0 FORMAT "%4.1" /end AXIS_DESCR
/end CHARACTERISTIC
/begin CHARACTERISTIC KF_MD_FAK_GRAD_DP_B1 "DP-Wichtung Bereich 1" MAP 0x76DA2 TKF_SW_SW_UW 100.0 FORMULA_0073 0.0 20.0 FORMAT "%6.3"
 /begin AXIS_DESCR STD_AXIS md_kupp_wunsch_grad_max FORMULA_0562 4 -5000.0 5000.0 MAX_GRAD 0.0 /end AXIS_DESCR
 /begin AXIS_DESCR STD_AXIS md_kupp_wunsch_fil_dp FORMULA_0009 4 -100.0 1000.0 MAX_GRAD 0.0 FORMAT "%4.1" /end AXIS_DESCR
/end CHARACTERISTIC
/begin CHARACTERISTIC KF_MD_FAK_GRAD_DP_B2 "DP-Wichtung Bereich 2" MAP 0x76DD4 TKF_SW_SW_UW 100.0 FORMULA_0073 0.0 20.0 FORMAT "%6.3"
 /begin AXIS_DESCR STD_AXIS md_kupp_wunsch_grad_max FORMULA_0562 4 -5000.0 5000.0 MAX_GRAD 0.0 /end AXIS_DESCR
 /begin AXIS_DESCR STD_AXIS md_kupp_wunsch_fil_dp FORMULA_0009 4 -100.0 1000.0 MAX_GRAD 0.0 FORMAT "%4.1" /end AXIS_DESCR
/end CHARACTERISTIC
/begin CHARACTERISTIC KF_MD_FAK_GRAD_DP_B3 "DP-Wichtung Bereich 3" MAP 0x76E06 TKF_SW_SW_UW 100.0 FORMULA_0073 0.0 20.0 FORMAT "%6.3"
 /begin AXIS_DESCR STD_AXIS md_kupp_wunsch_grad_max FORMULA_0562 4 -5000.0 5000.0 MAX_GRAD 0.0 /end AXIS_DESCR
 /begin AXIS_DESCR STD_AXIS md_kupp_wunsch_fil_dp FORMULA_0009 4 -100.0 1000.0 MAX_GRAD 0.0 FORMAT "%4.1" /end AXIS_DESCR
/end CHARACTERISTIC
/begin CHARACTERISTIC KF_MD_FR_WICHT "Wichtungs KF fuer FR und fra_out" MAP 0x782BE TKF_SW_SW_UW 100.0 FORMULA_0024 0.0 1.999899983406067 FORMAT "%7.4" /begin AXIS_DESCR STD_AXIS n FORMULA_0006 6 0.0 10000.0 MAX_GRAD 0.0 /end AXIS_DESCR
 /begin AXIS_DESCR STD_AXIS md_rf_soll_pt_roh FORMULA_0007 6 0.0 2.0 MAX_GRAD 0.0 FORMAT "%6.3" /end AXIS_DESCR
/end CHARACTERISTIC
/begin CHARACTERISTIC KF_MD_GRAD_DP_B1 "Gradient Bereich 1" MAP 0x76B22 TKF_SW_SW_SW 100.0 FORMULA_0786 -5000.0 0.0 /begin AXIS_DESCR STD_AXIS gang FORMULA_0479 7 -1.0 10.0 MAX_GRAD 0.0 /end AXIS_DESCR /begin AXIS_DESCR STD_AXIS n FORMULA_0006 9 0.0 10000.0 MAX_GRAD 0.0 /end AXIS_DESCR /end CHARACTERISTIC
/begin CHARACTERISTIC KF_MD_GRAD_DP_B2 "Gradient Bereich 2" MAP 0x76BC2 TKF_SW_SW_SW 100.0 FORMULA_0786 -5000.0 0.0 /begin AXIS_DESCR STD_AXIS gang FORMULA_0479 7 -1.0 10.0 MAX_GRAD 0.0 /end AXIS_DESCR /begin AXIS_DESCR STD_AXIS n FORMULA_0006 9 0.0 10000.0 MAX_GRAD 0.0 /end AXIS_DESCR /end CHARACTERISTIC
/begin CHARACTERISTIC KF_MD_GRAD_DP_B3 "Gradient Bereich 3" MAP 0x76C62 TKF_SW_SW_SW 100.0 FORMULA_0786 -5000.0 0.0 /begin AXIS_DESCR STD_AXIS gang FORMULA_0479 7 -1.0 10.0 MAX_GRAD 0.0 /end AXIS_DESCR /begin AXIS_DESCR STD_AXIS n FORMULA_0006 9 0.0 10000.0 MAX_GRAD 0.0 /end AXIS_DESCR /end CHARACTERISTIC
/begin CHARACTERISTIC KF_MD_GRAD_DP_LLMKS "Gradient bei LLMKS" MAP 0x76D02 TKF_SW_SW_SW 100.0 FORMULA_0786 -5000.0 0.0 /begin AXIS_DESCR STD_AXIS gang FORMULA_0479 7 -1.0 10.0 MAX_GRAD 0.0 /end AXIS_DESCR /begin AXIS_DESCR STD_AXIS n FORMULA_0006 9 0.0 10000.0 MAX_GRAD 0.0 /end AXIS_DESCR /end CHARACTERISTIC
/begin CHARACTERISTIC KF_MD_GRAD_LSD_B1 "Gradient Bereich 1" MAP 0x766C2 TKF_SW_SW_SW 100.0 FORMULA_0786 0.0 5000.0 /begin AXIS_DESCR STD_AXIS gang FORMULA_0479 7 -1.0 10.0 MAX_GRAD 0.0 /end AXIS_DESCR /begin AXIS_DESCR STD_AXIS n FORMULA_0006 9 0.0 10000.0 MAX_GRAD 0.0 /end AXIS_DESCR /end CHARACTERISTIC
/begin CHARACTERISTIC KF_MD_GRAD_LSD_B2 "Gradient Bereich 2" MAP 0x76762 TKF_SW_SW_SW 100.0 FORMULA_0786 0.0 5000.0 /begin AXIS_DESCR STD_AXIS gang FORMULA_0479 7 -1.0 10.0 MAX_GRAD 0.0 /end AXIS_DESCR /begin AXIS_DESCR STD_AXIS n FORMULA_0006 9 0.0 10000.0 MAX_GRAD 0.0 /end AXIS_DESCR /end CHARACTERISTIC
/begin CHARACTERISTIC KF_MD_GRAD_LSD_B3 "Gradient Bereich 3" MAP 0x76802 TKF_SW_SW_SW 100.0 FORMULA_0786 0.0 5000.0 /begin AXIS_DESCR STD_AXIS gang FORMULA_0479 7 -1.0 10.0 MAX_GRAD 0.0 /end AXIS_DESCR /begin AXIS_DESCR STD_AXIS n FORMULA_0006 9 0.0 10000.0 MAX_GRAD 0.0 /end AXIS_DESCR /end CHARACTERISTIC
/begin CHARACTERISTIC KF_MD_GRAD_LSD_LLMKS "Gradient bei LLMKS" MAP 0x768A2 TKF_SW_SW_SW 100.0 FORMULA_0786 0.0 5000.0 /begin AXIS_DESCR STD_AXIS gang FORMULA_0479 7 -1.0 10.0 MAX_GRAD 0.0 /end AXIS_DESCR /begin AXIS_DESCR STD_AXIS n FORMULA_0006 9 0.0 10000.0 MAX_GRAD 0.0 /end AXIS_DESCR /end CHARACTERISTIC
/begin CHARACTERISTIC KF_MD_IND_LW_VERLUSTE "Ladungswechselverluste" MAP 0x75A4E TKF_SW_SW_SW 100.0 FORMULA_0009 -100.0 1000.0 FORMAT "%4.1" /begin AXIS_DESCR STD_AXIS n FORMULA_0006 10 0.0 10000.0 MAX_GRAD 0.0 /end AXIS_DESCR
 /begin AXIS_DESCR STD_AXIS rf_m FORMULA_0007 8 0.0 2.0 MAX_GRAD 0.0 FORMAT "%6.3" /end AXIS_DESCR
/end CHARACTERISTIC
/begin CHARACTERISTIC KF_MD_IND_LW_VERLUSTE_E2 "Ladungswechselverluste" MAP 0x7B1FA TKF_SW_SW_SW 100.0 FORMULA_0009 -100.0 1000.0 FORMAT "%4.1" /begin AXIS_DESCR STD_AXIS n FORMULA_0006 4 0.0 10000.0 MAX_GRAD 0.0 /end AXIS_DESCR
 /begin AXIS_DESCR STD_AXIS rf_m FORMULA_0007 4 0.0 2.0 MAX_GRAD 0.0 FORMAT "%6.3" /end AXIS_DESCR
/end CHARACTERISTIC
/begin CHARACTERISTIC KF_MD_IND_MIN_SCHUB "min. Schubmoment" MAP 0x7592E TKF_SW_SW_SW 100.0 FORMULA_0009 -100.0 1000.0 FORMAT "%4.1" /begin AXIS_DESCR STD_AXIS n FORMULA_0006 8 0.0 10000.0 MAX_GRAD 0.0 /end AXIS_DESCR
 /begin AXIS_DESCR STD_AXIS tmot FORMULA_0023 6 -50.0 170.0 MAX_GRAD 0.0 FORMAT "%4.1" /end AXIS_DESCR
/end CHARACTERISTIC
/begin CHARACTERISTIC KF_MD_IND_MIN_SCHUB_E2 "min. Schubmoment" MAP 0x7B22C TKF_SW_SW_SW 100.0 FORMULA_0009 -100.0 1000.0 FORMAT "%4.1" /begin AXIS_DESCR STD_AXIS n_e2 FORMULA_0006 4 0.0 10000.0 MAX_GRAD 0.0 /end AXIS_DESCR
 /begin AXIS_DESCR STD_AXIS tmot_e2 FORMULA_0023 4 -50.0 170.0 MAX_GRAD 0.0 FORMAT "%4.1" /end AXIS_DESCR
/end CHARACTERISTIC
/begin CHARACTERISTIC KF_MD_IND_OPT "optimales Moment bei LA 1" MAP 0x75740 TKF_SW_SW_SW 100.0 FORMULA_0009 -100.0 1000.0 FORMAT "%4.1" /begin AXIS_DESCR STD_AXIS n FORMULA_0006 18 0.0 10000.0 MAX_GRAD 0.0 /end AXIS_DESCR
 /begin AXIS_DESCR STD_AXIS rf_m FORMULA_0007 12 0.0 2.0 MAX_GRAD 0.0 FORMAT "%6.3" /end AXIS_DESCR
/end CHARACTERISTIC
/begin CHARACTERISTIC KF_MD_IND_OPT_E2 "optimales Moment bei LA 1" MAP 0x7B108 TKF_SW_SW_SW 100.0 FORMULA_0009 -100.0 1000.0 FORMAT "%4.1" /begin AXIS_DESCR STD_AXIS n_e2 FORMULA_0006 10 0.0 10000.0 MAX_GRAD 0.0 /end AXIS_DESCR
 /begin AXIS_DESCR STD_AXIS rf_e2 FORMULA_0007 10 0.0 2.0 MAX_GRAD 0.0 FORMAT "%6.3" /end AXIS_DESCR
/end CHARACTERISTIC
/begin CHARACTERISTIC KF_MD_IND_REIB "Reibmoment" MAP 0x759AC TKF_SW_SW_SW 100.0 FORMULA_0009 -100.0 1000.0 FORMAT "%4.1"
 /begin AXIS_DESCR STD_AXIS tmot FORMULA_0023 8 -50.0 170.0 MAX_GRAD 0.0 FORMAT "%4.1" /end AXIS_DESCR
 /begin AXIS_DESCR STD_AXIS toel FORMULA_0023 8 -50.0 170.0 MAX_GRAD 0.0 FORMAT "%4.1" /end AXIS_DESCR
/end CHARACTERISTIC
/begin CHARACTERISTIC KF_MD_IND_REIB_E2 "Reibverluste Ebene 2" MAP 0x7B25E TKF_SW_SW_SW 100.0 FORMULA_0009 -100.0 1000.0 FORMAT "%4.1"
 /begin AXIS_DESCR STD_AXIS tmot_e2 FORMULA_0023 4 -50.0 170.0 MAX_GRAD 0.0 FORMAT "%4.1" /end AXIS_DESCR
 /begin AXIS_DESCR STD_AXIS toel_e2 FORMULA_0023 4 -50.0 170.0 MAX_GRAD 0.0 FORMAT "%4.1" /end AXIS_DESCR
/end CHARACTERISTIC
/begin CHARACTERISTIC KF_MD_KKOS_KORR "Korrigiertes KKOS-Moment" MAP 0x76412 TKF_SW_SW_SW 100.0 FORMULA_0009 -100.0 1000.0 FORMAT "%4.1" /begin AXIS_DESCR STD_AXIS n FORMULA_0006 5 0.0 10000.0 MAX_GRAD 0.0 /end AXIS_DESCR
 /begin AXIS_DESCR STD_AXIS kkos_in FORMULA_0009 5 -100.0 1000.0 MAX_GRAD 0.0 FORMAT "%4.1" /end AXIS_DESCR
/end CHARACTERISTIC
/begin CHARACTERISTIC KF_MD_KOMFORT_DP "Wichtungsfaktor Komfort" MAP 0x770B8 TKF_SW_SW_UW 100.0 FORMULA_0073 0.0 4.0 FORMAT "%6.3"
 /begin AXIS_DESCR STD_AXIS md_bereich FORMULA_0789 3 -32767.0 32768.0 MAX_GRAD 0.0 /end AXIS_DESCR
 /begin AXIS_DESCR STD_AXIS gang FORMULA_0479 7 -1.0 10.0 MAX_GRAD 0.0 /end AXIS_DESCR
/end CHARACTERISTIC
/begin CHARACTERISTIC KF_MD_KOMFORT_LSD "Wichtungsfaktor Komfort" MAP 0x77078 TKF_SW_SW_UW 100.0 FORMULA_0073 0.0 4.0 FORMAT "%6.3"
 /begin AXIS_DESCR STD_AXIS md_bereich FORMULA_0789 3 -32767.0 32768.0 MAX_GRAD 0.0 /end AXIS_DESCR
 /begin AXIS_DESCR STD_AXIS gang FORMULA_0479 7 -1.0 10.0 MAX_GRAD 0.0 /end AXIS_DESCR
/end CHARACTERISTIC
/begin CHARACTERISTIC KF_MD_KUPP_GRENZ_DP_O "Übergang Bereich 2 nach 3" MAP 0x76A82 TKF_SW_SW_SW 100.0 FORMULA_0009 0.0 1000.0 FORMAT "%4.1" /begin AXIS_DESCR STD_AXIS gang FORMULA_0479 7 -1.0 10.0 MAX_GRAD 0.0 /end AXIS_DESCR /begin AXIS_DESCR STD_AXIS n FORMULA_0006 9 0.0 10000.0 MAX_GRAD 0.0 /end AXIS_DESCR /end CHARACTERISTIC
/begin CHARACTERISTIC KF_MD_KUPP_GRENZ_DP_U_OFFS "Übergang Bereich 1 nach 2" MAP 0x769E2 TKF_SW_SW_SW 100.0 FORMULA_0009 -100.0 100.0 FORMAT "%4.1" /begin AXIS_DESCR STD_AXIS gang FORMULA_0479 7 -1.0 10.0 MAX_GRAD 0.0 /end AXIS_DESCR /begin AXIS_DESCR STD_AXIS n FORMULA_0006 9 0.0 10000.0 MAX_GRAD 0.0 /end AXIS_DESCR /end CHARACTERISTIC
/begin CHARACTERISTIC KF_MD_KUPP_GRENZ_LSD_O "Übergang Bereich 2 nach 3" MAP 0x76622 TKF_SW_SW_SW 100.0 FORMULA_0009 0.0 1000.0 FORMAT "%4.1" /begin AXIS_DESCR STD_AXIS gang FORMULA_0479 7 -1.0 10.0 MAX_GRAD 0.0 /end AXIS_DESCR /begin AXIS_DESCR STD_AXIS n FORMULA_0006 9 0.0 10000.0 MAX_GRAD 0.0 /end AXIS_DESCR /end CHARACTERISTIC
/begin CHARACTERISTIC KF_MD_KUPP_GRENZ_LSD_U_OFFS "Übergang Bereich 1 nach 2" MAP 0x76582 TKF_SW_SW_SW 100.0 FORMULA_0009 -100.0 100.0 FORMAT "%4.1" /begin AXIS_DESCR STD_AXIS gang FORMULA_0479 7 -1.0 10.0 MAX_GRAD 0.0 /end AXIS_DESCR /begin AXIS_DESCR STD_AXIS n FORMULA_0006 9 0.0 10000.0 MAX_GRAD 0.0 /end AXIS_DESCR /end CHARACTERISTIC
/begin CHARACTERISTIC KF_MD_KUPP_OFF_E2 "Abweichung Istmoment Ebene 2" MAP 0x7B32A TKF_SW_SW_SW 100.0 FORMULA_0009 -100.0 1000.0 FORMAT "%4.1" /begin AXIS_DESCR STD_AXIS n_e2 FORMULA_0006 6 0.0 10000.0 MAX_GRAD 0.0 /end AXIS_DESCR
 /begin AXIS_DESCR STD_AXIS md_kupp_wunsch_e2 FORMULA_0009 6 -100.0 1000.0 MAX_GRAD 0.0 FORMAT "%4.1" /end AXIS_DESCR
/end CHARACTERISTIC
/begin CHARACTERISTIC KF_MD_LRW "LRW-Moment" MAP 0x7645A TKF_SW_SW_SW 100.0 FORMULA_0009 -100.0 1000.0 FORMAT "%4.1"
 /begin AXIS_DESCR STD_AXIS can_lrw FORMULA_0132 6 -1440.153564453125 1440.109619140625 MAX_GRAD 0.0 FORMAT "%5.2" /end AXIS_DESCR
 /begin AXIS_DESCR STD_AXIS can_lrw_v FORMULA_0133 6 -1440.153564453125 1440.109619140625 MAX_GRAD 0.0 FORMAT "%5.2" /end AXIS_DESCR
/end CHARACTERISTIC
/begin CHARACTERISTIC KF_MD_NBEGR_KR "Regelparameter KR" MAP 0x78072 TKF_SW_SW_UW 100.0 FORMULA_0796 0.0 2.0 FORMAT "%5.2" /begin AXIS_DESCR STD_AXIS gang FORMULA_0479 8 -1.0 10.0 MAX_GRAD 0.0 /end AXIS_DESCR /begin AXIS_DESCR STD_AXIS n FORMULA_0006 6 0.0 10000.0 MAX_GRAD 0.0 /end AXIS_DESCR /end CHARACTERISTIC
/begin CHARACTERISTIC KF_MD_NBEGR_TN "Regelparameter TN" MAP 0x780F0 TKF_SW_SW_UW 100.0 FORMULA_0812 3.000000026077032e-003 60.0 FORMAT "%6.3" /begin AXIS_DESCR STD_AXIS gang FORMULA_0479 8 -1.0 10.0 MAX_GRAD 0.0 /end AXIS_DESCR /begin AXIS_DESCR STD_AXIS n FORMULA_0006 6 0.0 10000.0 MAX_GRAD 0.0 /end AXIS_DESCR /end CHARACTERISTIC
/begin CHARACTERISTIC KF_MD_NBEGR_TV "Regelparameter TV" MAP 0x7816E TKF_SW_SW_UW 100.0 FORMULA_0812 0.0 20.0 FORMAT "%6.3" /begin AXIS_DESCR STD_AXIS gang FORMULA_0479 8 -1.0 10.0 MAX_GRAD 0.0 /end AXIS_DESCR /begin AXIS_DESCR STD_AXIS n FORMULA_0006 6 0.0 10000.0 MAX_GRAD 0.0 /end AXIS_DESCR /end CHARACTERISTIC
/begin CHARACTERISTIC KF_MD_POLYNOM_A "A-Paramter Polynom für Zündhaken" MAP 0x75DBC TKF_SW_SW_SW 100.0 FORMULA_0760 -320.0 320.0 FORMAT "%5.2" /begin AXIS_DESCR STD_AXIS n FORMULA_0006 18 0.0 10000.0 MAX_GRAD 0.0 /end AXIS_DESCR
 /begin AXIS_DESCR STD_AXIS rf_m FORMULA_0007 12 0.0 2.0 MAX_GRAD 0.0 FORMAT "%6.3" /end AXIS_DESCR
/end CHARACTERISTIC
/begin CHARACTERISTIC KF_MD_POLYNOM_A_KH "A-Paramter Polynom für Zündhaken im KH" MAP 0x75FAA TKF_SW_SW_SW 100.0 FORMULA_0760 -320.0 320.0 FORMAT "%5.2" /begin AXIS_DESCR STD_AXIS n FORMULA_0006 18 0.0 10000.0 MAX_GRAD 0.0 /end AXIS_DESCR
 /begin AXIS_DESCR STD_AXIS rf_m FORMULA_0007 12 0.0 2.0 MAX_GRAD 0.0 FORMAT "%6.3" /end AXIS_DESCR
/end CHARACTERISTIC
/begin CHARACTERISTIC KF_MD_POLYNOM_B "B-Paramter Polynom für Zündhaken" MAP 0x76198 TKF_SW_SW_SW 100.0 FORMULA_0760 -320.0 320.0 FORMAT "%5.2" /begin AXIS_DESCR STD_AXIS n FORMULA_0006 6 0.0 10000.0 MAX_GRAD 0.0 /end AXIS_DESCR
 /begin AXIS_DESCR STD_AXIS rf_m FORMULA_0007 4 0.0 2.0 MAX_GRAD 0.0 FORMAT "%6.3" /end AXIS_DESCR
/end CHARACTERISTIC
/begin CHARACTERISTIC KF_MD_SK_DIFF_MAX "Abweichung Istmoment" MAP 0x7780C TKF_SW_SW_SW 100.0 FORMULA_0009 -100.0 1000.0 FORMAT "%4.1" /begin AXIS_DESCR STD_AXIS n FORMULA_0006 6 0.0 10000.0 MAX_GRAD 0.0 /end AXIS_DESCR
 /begin AXIS_DESCR STD_AXIS md_sk_vergl_soll FORMULA_0009 6 -100.0 1000.0 MAX_GRAD 0.0 FORMAT "%4.1" /end AXIS_DESCR
/end CHARACTERISTIC
/begin CHARACTERISTIC KF_MD_SMG_BEGR_OFF "max. Offset auf Fahrerwunsch" MAP 0x7802A TKF_SW_SW_SW 100.0 FORMULA_0778 0.0 1000.0
 /begin AXIS_DESCR STD_AXIS md_kupp_wunsch_ges FORMULA_0778 5 -100.0 1000.0 MAX_GRAD 0.0 /end AXIS_DESCR
 /begin AXIS_DESCR STD_AXIS n_diff FORMULA_0006 5 0.0 10000.0 MAX_GRAD 0.0 /end AXIS_DESCR
/end CHARACTERISTIC
/begin CHARACTERISTIC KF_MD_SMG_BEGR_OFF_E2 "max. Offset auf FW Ebene 2" MAP 0x7B38C TKF_SW_SW_SW 100.0 FORMULA_0778 -100.0 1000.0
 /begin AXIS_DESCR STD_AXIS md_kupp_wunsch_e2 FORMULA_0778 3 -100.0 1000.0 MAX_GRAD 0.0 /end AXIS_DESCR
 /begin AXIS_DESCR STD_AXIS n_diff FORMULA_0006 3 0.0 10000.0 MAX_GRAD 0.0 /end AXIS_DESCR
/end CHARACTERISTIC
/begin CHARACTERISTIC KF_MD_SPORT_DP "Wichtungsfaktor Sport" MAP 0x77038 TKF_SW_SW_UW 100.0 FORMULA_0073 0.0 4.0 FORMAT "%6.3"
 /begin AXIS_DESCR STD_AXIS md_bereich FORMULA_0789 3 -32767.0 32768.0 MAX_GRAD 0.0 /end AXIS_DESCR
 /begin AXIS_DESCR STD_AXIS gang FORMULA_0479 7 -1.0 10.0 MAX_GRAD 0.0 /end AXIS_DESCR
/end CHARACTERISTIC
/begin CHARACTERISTIC KF_MD_SPORT_LSD "Wichtungsfaktor Sport" MAP 0x76FF8 TKF_SW_SW_UW 100.0 FORMULA_0073 0.0 4.0 FORMAT "%6.3"
 /begin AXIS_DESCR STD_AXIS md_bereich FORMULA_0789 3 -32767.0 32768.0 MAX_GRAD 0.0 /end AXIS_DESCR
 /begin AXIS_DESCR STD_AXIS gang FORMULA_0479 7 -1.0 10.0 MAX_GRAD 0.0 /end AXIS_DESCR
/end CHARACTERISTIC
/begin CHARACTERISTIC KF_MD_START_OFFSET "Vorsteuerung für Start" MAP 0x761DE TKF_SW_SW_SW 100.0 FORMULA_0009 -100.0 1000.0 FORMAT "%4.1" /begin AXIS_DESCR STD_AXIS n FORMULA_0006 8 0.0 10000.0 MAX_GRAD 0.0 /end AXIS_DESCR
 /begin AXIS_DESCR STD_AXIS tmot FORMULA_0023 6 -50.0 170.0 MAX_GRAD 0.0 FORMAT "%4.1" /end AXIS_DESCR
/end CHARACTERISTIC
/begin CHARACTERISTIC KF_MD_TAU_LSD_B3 "LSD-Filter Bereich 3" MAP 0x76F58 TKF_SW_SW_UW 100.0 FORMULA_0073 0.0 4.0 FORMAT "%6.3" /begin AXIS_DESCR STD_AXIS gang FORMULA_0479 7 -1.0 10.0 MAX_GRAD 0.0 /end AXIS_DESCR
 /begin AXIS_DESCR STD_AXIS md_kupp_wunsch FORMULA_0009 9 -100.0 1000.0 MAX_GRAD 0.0 FORMAT "%4.1" /end AXIS_DESCR
/end CHARACTERISTIC
/begin CHARACTERISTIC KF_MD_VBEGR_KR "Regelparameter KR" MAP 0x781EC TKF_SW_SW_UW 100.0 FORMULA_0813 0.0 40.0 FORMAT "%5.2" /begin AXIS_DESCR STD_AXIS gang FORMULA_0479 4 -1.0 10.0 MAX_GRAD 0.0 /end AXIS_DESCR
 /begin AXIS_DESCR STD_AXIS v_vorne FORMULA_0076 6 -80.0 360.0 MAX_GRAD 0.0 FORMAT "%4.1" /end AXIS_DESCR
/end CHARACTERISTIC
/begin CHARACTERISTIC KF_MD_VBEGR_TN "Regelparameter TN" MAP 0x78232 TKF_SW_SW_UW 100.0 FORMULA_0812 3.000000026077032e-003 60.0 FORMAT "%6.3" /begin AXIS_DESCR STD_AXIS gang FORMULA_0479 4 -1.0 10.0 MAX_GRAD 0.0 /end AXIS_DESCR
 /begin AXIS_DESCR STD_AXIS v_vorne FORMULA_0076 6 -80.0 360.0 MAX_GRAD 0.0 FORMAT "%4.1" /end AXIS_DESCR
/end CHARACTERISTIC
/begin CHARACTERISTIC KF_MD_VBEGR_TV "Regelparameter TV" MAP 0x78278 TKF_SW_SW_UW 100.0 FORMULA_0812 0.0 20.0 FORMAT "%6.3" /begin AXIS_DESCR STD_AXIS gang FORMULA_0479 4 -1.0 10.0 MAX_GRAD 0.0 /end AXIS_DESCR
 /begin AXIS_DESCR STD_AXIS v_vorne FORMULA_0076 6 -80.0 360.0 MAX_GRAD 0.0 FORMAT "%4.1" /end AXIS_DESCR
/end CHARACTERISTIC
/begin CHARACTERISTIC KF_MD_VERBR_FZG "Verbraucheroffset Fzg" MAP 0x7625C TKF_SW_SW_SW 100.0 FORMULA_0009 -100.0 1000.0 FORMAT "%4.1" /begin AXIS_DESCR STD_AXIS n FORMULA_0006 6 0.0 10000.0 MAX_GRAD 0.0 /end AXIS_DESCR
 /begin AXIS_DESCR STD_AXIS tmot FORMULA_0023 5 -50.0 170.0 MAX_GRAD 0.0 FORMAT "%4.1" /end AXIS_DESCR
/end CHARACTERISTIC
/begin CHARACTERISTIC KF_MD_ZW_OFFSET "ZW-Offset ueber n und rf" MAP 0x75D80 TKF_SW_SW_SW 100.0 FORMULA_0102 -50.0 60.0 FORMAT "%4.1" /begin AXIS_DESCR STD_AXIS n FORMULA_0006 4 0.0 10000.0 MAX_GRAD 0.0 /end AXIS_DESCR
 /begin AXIS_DESCR STD_AXIS rf_m FORMULA_0007 5 0.0 2.0 MAX_GRAD 0.0 FORMAT "%6.3" /end AXIS_DESCR
/end CHARACTERISTIC
/begin CHARACTERISTIC KF_MD_ZW_OPT "Optimaler Zündhaken" MAP 0x75B14 TKF_SW_SW_SW 100.0 FORMULA_0102 -50.0 60.0 FORMAT "%4.1" /begin AXIS_DESCR STD_AXIS n FORMULA_0006 18 0.0 10000.0 MAX_GRAD 0.0 /end AXIS_DESCR
 /begin AXIS_DESCR STD_AXIS rf_m FORMULA_0007 12 0.0 2.0 MAX_GRAD 0.0 FORMAT "%6.3" /end AXIS_DESCR
/end CHARACTERISTIC
/begin CHARACTERISTIC KF_MD_ZW_OPT_E2 "Optimaler Zündhaken" MAP 0x7B290 TKF_SW_SW_SW 100.0 FORMULA_0102 -50.0 60.0 FORMAT "%4.1" /begin AXIS_DESCR STD_AXIS n FORMULA_0006 10 0.0 10000.0 MAX_GRAD 0.0 /end AXIS_DESCR
 /begin AXIS_DESCR STD_AXIS rf_m FORMULA_0007 6 0.0 2.0 MAX_GRAD 0.0 FORMAT "%6.3" /end AXIS_DESCR
/end CHARACTERISTIC
/begin CHARACTERISTIC KF_MD_ZW_RG "Restgaseinfluss auf opt. Zündwinkel" MAP 0x75D02 TKF_SW_SW_SW 100.0 FORMULA_0767 0.0 100.0 FORMAT "%4.1" /begin AXIS_DESCR STD_AXIS n FORMULA_0006 8 0.0 10000.0 MAX_GRAD 0.0 /end AXIS_DESCR
 /begin AXIS_DESCR STD_AXIS rf_m FORMULA_0007 6 0.0 2.0 MAX_GRAD 0.0 FORMAT "%6.3" /end AXIS_DESCR
/end CHARACTERISTIC
/begin CHARACTERISTIC KF_TIME_REL_OBD_MAX_STANDZEIT "Maximale Standzeit des Motors" MAP 0x7A2A2 TKF_SW_SW_UW 100.0 FORMULA_0990 0.0 65535.0
 /begin AXIS_DESCR STD_AXIS zust_tmot_start FORMULA_0023 4 -50.0 170.0 MAX_GRAD 0.0 FORMAT "%4.1" /end AXIS_DESCR
 /begin AXIS_DESCR STD_AXIS tmot_abstell_nv FORMULA_0023 4 -50.0 170.0 MAX_GRAD 0.0 FORMAT "%4.1" /end AXIS_DESCR
/end CHARACTERISTIC
/begin CHARACTERISTIC KF_TIME_REL_OBD_MIN_STANDZEIT "Minimale Standzeit des Motors" MAP 0x7A240 TKF_SW_SW_UW 100.0 FORMULA_0706 0.0 1092.25 FORMAT "%5.2"
 /begin AXIS_DESCR STD_AXIS zust_tmot_start FORMULA_0023 6 -50.0 170.0 MAX_GRAD 0.0 FORMAT "%4.1" /end AXIS_DESCR
 /begin AXIS_DESCR STD_AXIS tmot_abstell_nv FORMULA_0023 6 -50.0 170.0 MAX_GRAD 0.0 FORMAT "%4.1" /end AXIS_DESCR
/end CHARACTERISTIC
/begin CHARACTERISTIC KF_TMOT_MODELL_ML_WICHT "Luftmassenwichtung" MAP 0x7A4B4 TKF_SW_SW_SW 100.0 FORMULA_0103 -100.0 1400.0 FORMAT "%4.1"
 /begin AXIS_DESCR STD_AXIS tmot_or_tka FORMULA_0023 7 -50.0 170.0 MAX_GRAD 0.0 FORMAT "%4.1" /end AXIS_DESCR
 /begin AXIS_DESCR STD_AXIS ml_ges FORMULA_0103 7 -100.0 1400.0 MAX_GRAD 0.0 FORMAT "%4.1" /end AXIS_DESCR
/end CHARACTERISTIC
/begin CHARACTERISTIC KF_TMOT_OBD_ML_GES_MW "Mittelwertschwelle der Luftmasse" MAP 0x7A412 TKF_SW_SW_SW 100.0 FORMULA_0103 -100.0 1400.0 FORMAT "%4.1"
 /begin AXIS_DESCR STD_AXIS tmot_start FORMULA_0023 8 -50.0 170.0 MAX_GRAD 0.0 FORMAT "%4.1" /end AXIS_DESCR
 /begin AXIS_DESCR STD_AXIS toel FORMULA_0023 8 -50.0 170.0 MAX_GRAD 0.0 FORMAT "%4.1" /end AXIS_DESCR
/end CHARACTERISTIC
/begin CHARACTERISTIC KF_TOEL_V_TAN_MW "Oelkuehlungsoffset" MAP 0x7A580 TKF_SW_SW_SW 100.0 FORMULA_0074 -50.0 50.0 FORMAT "%4.1"
 /begin AXIS_DESCR STD_AXIS v_vorne FORMULA_0076 7 -80.0 360.0 MAX_GRAD 0.0 FORMAT "%4.1" /end AXIS_DESCR
 /begin AXIS_DESCR STD_AXIS tan_mw FORMULA_0023 7 -50.0 170.0 MAX_GRAD 0.0 FORMAT "%4.1" /end AXIS_DESCR
/end CHARACTERISTIC
/begin CHARACTERISTIC KL_MD_BEGR_NOISE "Maximalmoment" CURVE 0x77904 TKL_SW_VV_SW 100.0 FORMULA_0009 -100.0 1000.0 FORMAT "%4.1"
 /begin AXIS_DESCR STD_AXIS v_vorne FORMULA_0076 3 0.0 360.0 MAX_GRAD 0.0 FORMAT "%4.1" /end AXIS_DESCR
/end CHARACTERISTIC
/begin CHARACTERISTIC KL_MD_ETA_LA "LA-Wirkungsgrad" CURVE 0x7563E TKL_UW_VV_UW 100.0 FORMULA_0437 0.0 150.0 FORMAT "%4.1"
 /begin AXIS_DESCR STD_AXIS la FORMULA_0025 8 0.0 3.999000072479248 MAX_GRAD 0.0 FORMAT "%6.3" /end AXIS_DESCR
/end CHARACTERISTIC
/begin CHARACTERISTIC KL_MD_FAHRER_FAK_E2 "v-Progression - Ebene 2" CURVE 0x7B0F6 TKL_SW_VV_SW 100.0 FORMULA_0073 0.0 3.0 FORMAT "%6.3"
 /begin AXIS_DESCR STD_AXIS v_vorne FORMULA_0076 4 -80.0 360.0 MAX_GRAD 0.0 FORMAT "%4.1" /end AXIS_DESCR
/end CHARACTERISTIC
/begin CHARACTERISTIC KL_MD_FAHRER_FAK_KOMFORT "v-Progression - Komfort" CURVE 0x77A6A TKL_SW_VV_UW 100.0 FORMULA_0073 0.0 3.0 FORMAT "%6.3"
 /begin AXIS_DESCR STD_AXIS v_vorne FORMULA_0076 8 -80.0 360.0 MAX_GRAD 0.0 FORMAT "%4.1" /end AXIS_DESCR
/end CHARACTERISTIC
/begin CHARACTERISTIC KL_MD_FAHRER_FAK_NORMAL "v-Progression - Normal" CURVE 0x77A8C TKL_SW_VV_UW 100.0 FORMULA_0073 0.0 3.0 FORMAT "%6.3"
 /begin AXIS_DESCR STD_AXIS v_vorne FORMULA_0076 8 -80.0 360.0 MAX_GRAD 0.0 FORMAT "%4.1" /end AXIS_DESCR
/end CHARACTERISTIC
/begin CHARACTERISTIC KL_MD_FAHRER_FAK_SPORT "v-Progression - Sport" CURVE 0x77AAE TKL_SW_VV_UW 100.0 FORMULA_0073 0.0 3.0 FORMAT "%6.3"
 /begin AXIS_DESCR STD_AXIS v_vorne FORMULA_0076 8 -80.0 360.0 MAX_GRAD 0.0 FORMAT "%4.1" /end AXIS_DESCR
/end CHARACTERISTIC
/begin CHARACTERISTIC KL_MD_FAK_DP_B1 "DP-Faktor Bereich 1 und LLMKS" CURVE 0x76522 TKL_SW_VV_UW 100.0 FORMULA_0073 0.0 20.0 FORMAT "%6.3"
 /begin AXIS_DESCR STD_AXIS md_kupp_wunsch FORMULA_0009 6 -100.0 1000.0 MAX_GRAD 0.0 FORMAT "%4.1" /end AXIS_DESCR
/end CHARACTERISTIC
/begin CHARACTERISTIC KL_MD_FAK_DP_B2 "DP-Faktor Bereich 2" CURVE 0x7653C TKL_SW_VV_UW 100.0 FORMULA_0073 0.0 20.0 FORMAT "%6.3"
 /begin AXIS_DESCR STD_AXIS md_kupp_wunsch FORMULA_0009 6 -100.0 1000.0 MAX_GRAD 0.0 FORMAT "%4.1" /end AXIS_DESCR
/end CHARACTERISTIC
/begin CHARACTERISTIC KL_MD_FAK_DP_B3 "DP-Faktor Bereich 3" CURVE 0x76556 TKL_SW_VV_UW 100.0 FORMULA_0073 0.0 20.0 FORMAT "%6.3"
 /begin AXIS_DESCR STD_AXIS md_kupp_wunsch FORMULA_0009 6 -100.0 1000.0 MAX_GRAD 0.0 FORMAT "%4.1" /end AXIS_DESCR
/end CHARACTERISTIC
/begin CHARACTERISTIC KL_MD_FAK_LSD_ANFF "LSD-Faktor Anfahrfilter" CURVE 0x76570 TKL_SW_VV_UW 100.0 FORMULA_0073 0.0 20.0 FORMAT "%6.3" /begin AXIS_DESCR STD_AXIS gang FORMULA_0479 4 -1.0 10.0 MAX_GRAD 0.0 /end AXIS_DESCR /end CHARACTERISTIC
/begin CHARACTERISTIC KL_MD_FAK_LSD_B1 "LSD-Faktor Bereich 1 und LLMKS" CURVE 0x764D4 TKL_SW_VV_UW 100.0 FORMULA_0073 0.0 20.0 FORMAT "%6.3"
 /begin AXIS_DESCR STD_AXIS md_kupp_wunsch FORMULA_0009 6 -100.0 1000.0 MAX_GRAD 0.0 FORMAT "%4.1" /end AXIS_DESCR
/end CHARACTERISTIC
/begin CHARACTERISTIC KL_MD_FAK_LSD_B2 "LSD-Faktor Bereich 2" CURVE 0x764EE TKL_SW_VV_UW 100.0 FORMULA_0073 0.0 20.0 FORMAT "%6.3"
 /begin AXIS_DESCR STD_AXIS md_kupp_wunsch FORMULA_0009 6 -100.0 1000.0 MAX_GRAD 0.0 FORMAT "%4.1" /end AXIS_DESCR
/end CHARACTERISTIC
/begin CHARACTERISTIC KL_MD_FAK_LSD_B3 "LSD-Faktor Bereich 3" CURVE 0x76508 TKL_SW_VV_UW 100.0 FORMULA_0073 0.0 20.0 FORMAT "%6.3"
 /begin AXIS_DESCR STD_AXIS md_kupp_wunsch FORMULA_0009 6 -100.0 1000.0 MAX_GRAD 0.0 FORMAT "%4.1" /end AXIS_DESCR
/end CHARACTERISTIC
/begin CHARACTERISTIC KL_MD_HYP_DN "Drehzahloffset fuer MD_MIN-Hyperbelast" CURVE 0x75630 TKL_SW_VV_SW 100.0 FORMULA_0006 0.0 10000.0
 /begin AXIS_DESCR STD_AXIS tmot FORMULA_0023 3 -50.0 170.0 MAX_GRAD 0.0 FORMAT "%4.1" /end AXIS_DESCR
/end CHARACTERISTIC
/begin CHARACTERISTIC KL_MD_HYP_VERH_KRAFTS "Best. Schnittpunkt Brenngrenze mit Hyp.bei Krafts." CURVE 0x7572E TKL_UW_VV_UW 100.0 FORMULA_0766 0.0 1.99210000038147 FORMAT "%5.2"
 /begin AXIS_DESCR STD_AXIS t FORMULA_0021 4 0.0 655.0 MAX_GRAD 0.0 FORMAT "%5.2" /end AXIS_DESCR
/end CHARACTERISTIC
/begin CHARACTERISTIC KL_MD_IND_REIB_ABREG "Abregelrampe fuer Reibmoment nach Start" CURVE 0x756A6 TKL_SW_VV_SW 100.0 FORMULA_0759 -100.0 1000.0 FORMAT "%5.2"
 /begin AXIS_DESCR STD_AXIS tmot FORMULA_0023 4 -50.0 170.0 MAX_GRAD 0.0 FORMAT "%4.1" /end AXIS_DESCR
/end CHARACTERISTIC
/begin CHARACTERISTIC KL_MD_IND_REIB_OFFSET "Offset fuer Reibmoment nach Start" CURVE 0x75694 TKL_SW_VV_SW 100.0 FORMULA_0758 0.0 320.0 FORMAT "%4.1"
 /begin AXIS_DESCR STD_AXIS tmot FORMULA_0023 4 -50.0 170.0 MAX_GRAD 0.0 FORMAT "%4.1" /end AXIS_DESCR
/end CHARACTERISTIC
/begin CHARACTERISTIC KL_MD_IND_REIB_OFFSET_E2 "Offset fuer Reibmoment nach Start - Ebene 2" CURVE 0x7B0EC TKL_SW_VV_SW 100.0 FORMULA_0758 0.0 320.0 FORMAT "%4.1"
 /begin AXIS_DESCR STD_AXIS tmot_e2 FORMULA_0023 2 -50.0 170.0 MAX_GRAD 0.0 FORMAT "%4.1" /end AXIS_DESCR
/end CHARACTERISTIC
/begin CHARACTERISTIC KL_MD_IND_RF_MIN_OFFS "Rfmin-Offset" CURVE 0x756FA TKL_SW_VV_SW 100.0 FORMULA_0009 -100.0 1000.0 FORMAT "%4.1" /begin AXIS_DESCR STD_AXIS n FORMULA_0006 8 0.0 10000.0 MAX_GRAD 0.0 /end AXIS_DESCR /end CHARACTERISTIC
/begin CHARACTERISTIC KL_MD_KKOS_DELAY_OFF "KKOS-Delay beim Ausschalten" CURVE 0x763B0 TKL_SW_VV_SW 100.0 FORMULA_0021 0.0 10.0 FORMAT "%5.2" /begin AXIS_DESCR STD_AXIS n FORMULA_0006 4 0.0 10000.0 MAX_GRAD 0.0 /end AXIS_DESCR /end CHARACTERISTIC
/begin CHARACTERISTIC KL_MD_KKOS_DELAY_ON "KKOS-Delay beim Einschalten" CURVE 0x7639E TKL_SW_VV_SW 100.0 FORMULA_0021 0.0 10.0 FORMAT "%5.2" /begin AXIS_DESCR STD_AXIS n FORMULA_0006 4 0.0 10000.0 MAX_GRAD 0.0 /end AXIS_DESCR /end CHARACTERISTIC
/begin CHARACTERISTIC KL_MD_KKOS_RES_MAX "KKOS-Reserve" CURVE 0x763C2 TKL_SW_VV_SW 100.0 FORMULA_0009 -100.0 1000.0 FORMAT "%4.1" /begin AXIS_DESCR STD_AXIS n FORMULA_0006 4 0.0 10000.0 MAX_GRAD 0.0 /end AXIS_DESCR /end CHARACTERISTIC
/begin CHARACTERISTIC KL_MD_KKOS_ZH_RES_MAX "KKOS-Reserve" CURVE 0x763D4 TKL_SW_VV_SW 100.0 FORMULA_0009 -100.0 1000.0 FORMAT "%4.1" /begin AXIS_DESCR STD_AXIS n FORMULA_0006 4 0.0 10000.0 MAX_GRAD 0.0 /end AXIS_DESCR /end CHARACTERISTIC
/begin CHARACTERISTIC KL_MD_KR_DTZ_DOWN "KR-Begr down" CURVE 0x756E4 TKL_SW_VV_SW 100.0 FORMULA_0765 0.0 5000.0 /begin AXIS_DESCR STD_AXIS n FORMULA_0006 5 0.0 10000.0 MAX_GRAD 0.0 /end AXIS_DESCR /end CHARACTERISTIC
/begin CHARACTERISTIC KL_MD_KR_DTZ_UP "KR-Begr up" CURVE 0x756CE TKL_SW_VV_SW 100.0 FORMULA_0765 0.0 5000.0 /begin AXIS_DESCR STD_AXIS n FORMULA_0006 5 0.0 10000.0 MAX_GRAD 0.0 /end AXIS_DESCR /end CHARACTERISTIC
/begin CHARACTERISTIC KL_MD_KUPP_MAX_CAN "Popelfaktor fuer CAN-Ausgabe" CURVE 0x75616 TKL_SW_VV_UW 100.0 FORMULA_0073 0.0 2.0 FORMAT "%6.3" /begin AXIS_DESCR STD_AXIS n FORMULA_0006 6 0.0 10000.0 MAX_GRAD 0.0 /end AXIS_DESCR /end CHARACTERISTIC
/begin CHARACTERISTIC KL_MD_KUPP_MIN_ASC "min. Moment bei ASC-Eingriff" CURVE 0x778D8 TKL_SW_VV_SW 100.0 FORMULA_0009 -100.0 1000.0 FORMAT "%4.1" /begin AXIS_DESCR STD_AXIS n FORMULA_0006 6 0.0 10000.0 MAX_GRAD 0.0 /end AXIS_DESCR /end CHARACTERISTIC
/begin CHARACTERISTIC KL_MD_LRW_FAK "Faktor auf LRW-Moment" CURVE 0x763E6 TKL_SW_VV_UW 100.0 FORMULA_0073 0.0 4.0 FORMAT "%6.3" /begin AXIS_DESCR STD_AXIS n FORMULA_0006 6 0.0 10000.0 MAX_GRAD 0.0 /end AXIS_DESCR /end CHARACTERISTIC
/begin CHARACTERISTIC KL_MD_LRW_RES "LRW-Reserve" CURVE 0x76400 TKL_SW_VV_SW 100.0 FORMULA_0009 -100.0 1000.0 FORMAT "%4.1"
 /begin AXIS_DESCR STD_AXIS can_lrw FORMULA_0132 4 -1440.153564453125 1440.109619140625 MAX_GRAD 0.0 FORMAT "%5.2" /end AXIS_DESCR
/end CHARACTERISTIC
/begin CHARACTERISTIC KL_MD_MAX_FAK_POWER "maximale rel. Füllung" CURVE 0x755CC TKL_SW_VV_UW 100.0 FORMULA_0073 0.0 4.0 FORMAT "%6.3" /begin AXIS_DESCR STD_AXIS n FORMULA_0006 18 0.0 10000.0 MAX_GRAD 0.0 /end AXIS_DESCR /end CHARACTERISTIC
/begin CHARACTERISTIC KL_MD_MAX_N_OFFS "Drehzahloffset fuer rf_max" CURVE 0x75598 TKL_SW_VV_SW 100.0 FORMULA_0006 0.0 10000.0
 /begin AXIS_DESCR STD_AXIS tan FORMULA_0023 6 -50.0 170.0 MAX_GRAD 0.0 FORMAT "%4.1" /end AXIS_DESCR
/end CHARACTERISTIC
/begin CHARACTERISTIC KL_MD_MAX_TMOT "tmot-Korrektur fuer rf_max" CURVE 0x755B2 TKL_SW_VV_UW 100.0 FORMULA_0073 0.0 4.0 FORMAT "%6.3"
 /begin AXIS_DESCR STD_AXIS tmot FORMULA_0023 6 -50.0 170.0 MAX_GRAD 0.0 FORMAT "%4.1" /end AXIS_DESCR
/end CHARACTERISTIC
/begin CHARACTERISTIC KL_MD_NBEGR_ABSTAND "n-Differenz fuer Aktivierung N-Begrenzung" CURVE 0x77924 TKL_UB_VV_SW 100.0 FORMULA_0006 0.0 4000.0 /begin AXIS_DESCR STD_AXIS gang FORMULA_0135 8 0.0 10.0 MAX_GRAD 0.0 /end AXIS_DESCR /end CHARACTERISTIC
/begin CHARACTERISTIC KL_MD_NBEGR_GANG "Einfluss ueber Gradient" CURVE 0x77912 TKL_SW_VV_UB 100.0 FORMULA_0135 0.0 10.0 /begin AXIS_DESCR STD_AXIS dn FORMULA_0105 5 -10000.0 10000.0 MAX_GRAD 0.0 /end AXIS_DESCR /end CHARACTERISTIC
/begin CHARACTERISTIC KL_MD_NBEGR_KR_FAK "Faktor auf KR" CURVE 0x77972 TKL_SW_VV_UW 100.0 FORMULA_0073 0.0 10.0 FORMAT "%6.3"
 /begin AXIS_DESCR STD_AXIS md_nbegr_abstand FORMULA_0006 6 -4000.0 4000.0 MAX_GRAD 0.0 /end AXIS_DESCR
/end CHARACTERISTIC
/begin CHARACTERISTIC KL_MD_NBEGR_KR_FAK_SK "Faktor bei Ausblender" CURVE 0x77A4E TKL_UB_VV_SW 100.0 FORMULA_0073 0.0 20.0 FORMAT "%6.3"
 /begin AXIS_DESCR STD_AXIS sk_ti_zyl_off_cnt FORMULA_0003 4 0.0 12.0 MAX_GRAD 0.0 /end AXIS_DESCR
/end CHARACTERISTIC
/begin CHARACTERISTIC KL_MD_NBEGR_N_MAX "Begrenzung Abregeldrehzahl" CURVE 0x7793E TKL_UB_VV_SW 100.0 FORMULA_0811 0.0 20000.0 FORMAT "%5.2" /begin AXIS_DESCR STD_AXIS gang FORMULA_0135 8 0.0 10.0 MAX_GRAD 0.0 /end AXIS_DESCR /end CHARACTERISTIC
/begin CHARACTERISTIC KL_MD_NBEGR_N_OFFSET "Abregelung Begrenzerdrehzahl" CURVE 0x778F2 TKL_UW_VV_SW 100.0 FORMULA_0006 0.0 1000.0
 /begin AXIS_DESCR STD_AXIS md_nbegr_t FORMULA_0109 4 0.0 325.0 MAX_GRAD 0.0 FORMAT "%5.2" /end AXIS_DESCR
/end CHARACTERISTIC
/begin CHARACTERISTIC KL_MD_NBEGR_RAMPE "Aenderungsbegrenzung" CURVE 0x77958 TKL_UB_VV_SW 100.0 FORMULA_0562 -5000.0 10000.0 /begin AXIS_DESCR STD_AXIS gang FORMULA_0135 8 0.0 10.0 MAX_GRAD 0.0 /end AXIS_DESCR /end CHARACTERISTIC
/begin CHARACTERISTIC KL_MD_NBEGR_TN_FAK "Faktor auf TN" CURVE 0x7798C TKL_SW_VV_UW 100.0 FORMULA_0073 0.0 4.0 FORMAT "%6.3"
 /begin AXIS_DESCR STD_AXIS md_nbegr_abstand FORMULA_0006 6 -4000.0 4000.0 MAX_GRAD 0.0 /end AXIS_DESCR
/end CHARACTERISTIC
/begin CHARACTERISTIC KL_MD_NBEGR_TN_FAK_SK "Faktor bei Ausblender" CURVE 0x77A5C TKL_UB_VV_SW 100.0 FORMULA_0073 0.0 20.0 FORMAT "%6.3"
 /begin AXIS_DESCR STD_AXIS sk_ti_zyl_off_cnt FORMULA_0003 4 0.0 12.0 MAX_GRAD 0.0 /end AXIS_DESCR
/end CHARACTERISTIC
/begin CHARACTERISTIC KL_MD_NBEGR_TV_FAK "Faktor auf TV" CURVE 0x779A6 TKL_SW_VV_UW 100.0 FORMULA_0073 0.0 4.0 FORMAT "%6.3"
 /begin AXIS_DESCR STD_AXIS md_nbegr_abstand FORMULA_0006 6 -4000.0 4000.0 MAX_GRAD 0.0 /end AXIS_DESCR
/end CHARACTERISTIC
/begin CHARACTERISTIC KL_MD_RES_MIN "min. Momentenreserve fuer OBD" CURVE 0x77AD0 TKL_SW_VV_SW 100.0 FORMULA_0009 -100.0 1000.0 FORMAT "%4.1"
 /begin AXIS_DESCR STD_AXIS md_res_kath FORMULA_0009 4 -100.0 1000.0 MAX_GRAD 0.0 FORMAT "%4.1" /end AXIS_DESCR
/end CHARACTERISTIC
/begin CHARACTERISTIC KL_MD_RF_MAX_E2 "maximale rel. Füllung" CURVE 0x7B0C2 TKL_SW_VV_SW 100.0 FORMULA_0007 0.0 2.0 FORMAT "%6.3" /begin AXIS_DESCR STD_AXIS n FORMULA_0006 10 0.0 10000.0 MAX_GRAD 0.0 /end AXIS_DESCR /end CHARACTERISTIC
/begin CHARACTERISTIC KL_MD_RF_MAX_ROH "maximale rel. Füllung" CURVE 0x75546 TKL_SW_VV_SW 100.0 FORMULA_0007 0.0 2.0 FORMAT "%6.3" /begin AXIS_DESCR STD_AXIS n FORMULA_0006 20 0.0 10000.0 MAX_GRAD 0.0 /end AXIS_DESCR /end CHARACTERISTIC
/begin CHARACTERISTIC KL_MD_RG_TAU "Filterkonstante RG-Komp" CURVE 0x778CA TKL_SW_VV_UB 100.0 FORMULA_0470 5.100000184029341e-003 1.279999971389771 /begin AXIS_DESCR STD_AXIS n FORMULA_0006 4 0.0 10000.0 MAX_GRAD 0.0 /end AXIS_DESCR /end CHARACTERISTIC
/begin CHARACTERISTIC KL_MD_SCHW_TAU "Filterkonstante Md_Schw" CURVE 0x7571C TKL_UB_VV_UB 100.0 FORMULA_0470 5.100000184029341e-003 1.279999971389771 /begin AXIS_DESCR STD_AXIS gang FORMULA_0135 8 0.0 10.0 MAX_GRAD 0.0 /end AXIS_DESCR /end CHARACTERISTIC
/begin CHARACTERISTIC KL_MD_SK_GRAD_MAX "Momentenbegrenzung durch SK-Stufe" CURVE 0x777F8 TKL_UB_VV_SW 100.0 FORMULA_0562 -5000.0 5000.0 /begin AXIS_DESCR STD_AXIS Stufe FORMULA_0003 6 0.0 255.0 MAX_GRAD 0.0 /end AXIS_DESCR /end CHARACTERISTIC
/begin CHARACTERISTIC KL_MD_SK_MD_BEGR "Momentenbegrenzung durch SK-Stufe" CURVE 0x777E4 TKL_UB_VV_SW 100.0 FORMULA_0009 -100.0 1000.0 FORMAT "%4.1" /begin AXIS_DESCR STD_AXIS Stufe FORMULA_0003 6 0.0 255.0 MAX_GRAD 0.0 /end AXIS_DESCR /end CHARACTERISTIC
/begin CHARACTERISTIC KL_MD_SK_WDK "Max. WDK-Position bei PWG=0" CURVE 0x777B6 TKL_SW_VV_SW 100.0 FORMULA_0001 -10.0 120.0 FORMAT "%4.1" /begin AXIS_DESCR STD_AXIS n FORMULA_0006 3 0.0 10000.0 MAX_GRAD 0.0 /end AXIS_DESCR /end CHARACTERISTIC
/begin CHARACTERISTIC KL_MD_SK_WDK_TI_OFFS "Max. WDK-Position bei PWG=0 und TIoff" CURVE 0x777C4 TKL_UB_VV_SW 100.0 FORMULA_0001 -10.0 120.0 FORMAT "%4.1" /begin AXIS_DESCR STD_AXIS ti_off FORMULA_0003 10 0.0 255.0 MAX_GRAD 0.0 /end AXIS_DESCR /end CHARACTERISTIC
/begin CHARACTERISTIC KL_MD_TAU_START_OFF "Filter fuer Startoffset" CURVE 0x756B8 TKL_SW_VV_UW 100.0 FORMULA_0469 4.999999888241291e-003 327.6700134277344 FORMAT "%5.2"
 /begin AXIS_DESCR STD_AXIS tmot FORMULA_0023 5 -50.0 170.0 MAX_GRAD 0.0 FORMAT "%4.1" /end AXIS_DESCR
/end CHARACTERISTIC
/begin CHARACTERISTIC KL_MD_VBEGR_ABSTAND "Abstand" CURVE 0x77A02 TKL_SW_VV_SW 100.0 FORMULA_0076 -80.0 360.0 FORMAT "%4.1" /begin AXIS_DESCR STD_AXIS gang FORMULA_0479 4 0.0 10.0 MAX_GRAD 0.0 /end AXIS_DESCR /end CHARACTERISTIC
/begin CHARACTERISTIC KL_MD_VBEGR_KR_FAK "Faktor auf KR" CURVE 0x779C0 TKL_SW_VV_UW 100.0 FORMULA_0073 0.0 10.0 FORMAT "%6.3"
 /begin AXIS_DESCR STD_AXIS v_max_delta FORMULA_0076 5 -250.0 250.0 MAX_GRAD 0.0 FORMAT "%4.1" /end AXIS_DESCR
/end CHARACTERISTIC
/begin CHARACTERISTIC KL_MD_VBEGR_KR_FAK_SK "Faktor bei Ausblender" CURVE 0x77A32 TKL_UB_VV_SW 100.0 FORMULA_0073 0.0 20.0 FORMAT "%6.3"
 /begin AXIS_DESCR STD_AXIS sk_ti_zyl_off_cnt FORMULA_0003 4 0.0 12.0 MAX_GRAD 0.0 /end AXIS_DESCR
/end CHARACTERISTIC
/begin CHARACTERISTIC KL_MD_VBEGR_RAMPE "Aenderungsbegrenzung" CURVE 0x77A14 TKL_SW_VV_SW 100.0 FORMULA_0562 -5000.0 100000.0 /begin AXIS_DESCR STD_AXIS gang FORMULA_0479 4 0.0 10.0 MAX_GRAD 0.0 /end AXIS_DESCR /end CHARACTERISTIC
/begin CHARACTERISTIC KL_MD_VBEGR_TAU "Aenderungsbegrenzung" CURVE 0x77A26 TKL_SW_VV_UB 100.0 FORMULA_0470 5.100000184029341e-003 1.279999971389771
 /begin AXIS_DESCR STD_AXIS t FORMULA_0109 3 0.0 150.0 MAX_GRAD 0.0 FORMAT "%5.2" /end AXIS_DESCR
/end CHARACTERISTIC
/begin CHARACTERISTIC KL_MD_VBEGR_TN_FAK "Faktor auf TN" CURVE 0x779D6 TKL_SW_VV_UW 100.0 FORMULA_0073 0.0 10.0 FORMAT "%6.3"
 /begin AXIS_DESCR STD_AXIS v_max_delta FORMULA_0076 5 -250.0 250.0 MAX_GRAD 0.0 FORMAT "%4.1" /end AXIS_DESCR
/end CHARACTERISTIC
/begin CHARACTERISTIC KL_MD_VBEGR_TN_FAK_SK "Faktor bei Ausblender" CURVE 0x77A40 TKL_UB_VV_SW 100.0 FORMULA_0073 0.0 20.0 FORMAT "%6.3"
 /begin AXIS_DESCR STD_AXIS sk_ti_zyl_off_cnt FORMULA_0003 4 0.0 12.0 MAX_GRAD 0.0 /end AXIS_DESCR
/end CHARACTERISTIC
/begin CHARACTERISTIC KL_MD_VBEGR_TV_FAK "Faktor auf TV" CURVE 0x779EC TKL_SW_VV_UW 100.0 FORMULA_0073 0.0 10.0 FORMAT "%6.3"
 /begin AXIS_DESCR STD_AXIS v_max_delta FORMULA_0076 5 -250.0 250.0 MAX_GRAD 0.0 FORMAT "%4.1" /end AXIS_DESCR
/end CHARACTERISTIC
/begin CHARACTERISTIC KL_MD_ZW_LA "ZW-Einfluss durch Lambda" CURVE 0x75660 TKL_SW_VV_SW 100.0 FORMULA_0102 -50.0 60.0 FORMAT "%4.1"
 /begin AXIS_DESCR STD_AXIS Lambda FORMULA_0025 6 0.0 1.998999953269959 MAX_GRAD 0.0 FORMAT "%6.3" /end AXIS_DESCR
/end CHARACTERISTIC
/begin CHARACTERISTIC KL_MD_ZW_TMOT_FAK "ZW-Korrektur ueber Tmot" CURVE 0x7567A TKL_SW_VV_UW 100.0 FORMULA_0073 0.0 4.0 FORMAT "%6.3"
 /begin AXIS_DESCR STD_AXIS tmot FORMULA_0023 6 -50.0 170.0 MAX_GRAD 0.0 FORMAT "%4.1" /end AXIS_DESCR
/end CHARACTERISTIC
/begin CHARACTERISTIC KL_PWG_BLS_BRP "Begrenzung Bremsdruck" CURVE 0x784DC TKL_UW_VV_UW 100.0 FORMULA_0630 0.0 100.0 FORMAT "%4.1" /begin AXIS_DESCR STD_AXIS can_brp FORMULA_0883 5 0.0 255.0 MAX_GRAD 0.0 /end AXIS_DESCR /end CHARACTERISTIC
/begin CHARACTERISTIC KL_PWG_BLS_V "Begrenzung Geschwindigkeit" CURVE 0x784F2 TKL_SW_VV_UW 100.0 FORMULA_0630 0.0 100.0 FORMAT "%4.1"
 /begin AXIS_DESCR STD_AXIS v_vorne FORMULA_0076 5 -80.0 360.0 MAX_GRAD 0.0 FORMAT "%4.1" /end AXIS_DESCR
/end CHARACTERISTIC
/begin CHARACTERISTIC KL_PWG_MAX_DIFF "MAX PWG-Abweichung" CURVE 0x7849A TKL_SW_VV_SW 100.0 FORMULA_0001 0.0 120.0 FORMAT "%4.1"
 /begin AXIS_DESCR STD_AXIS pwg1_2 FORMULA_0001 3 0.0 120.0 MAX_GRAD 0.0 FORMAT "%4.1" /end AXIS_DESCR
/end CHARACTERISTIC
/begin CHARACTERISTIC KL_PWG_SOLL "Messwert in Pedalwert" CURVE 0x784D2 TKL_SW_VV_SW 100.0 FORMULA_0001 0.0 100.0 FORMAT "%4.1"
 /begin AXIS_DESCR STD_AXIS pwg FORMULA_0001 2 0.0 120.0 MAX_GRAD 0.0 FORMAT "%4.1" /end AXIS_DESCR
/end CHARACTERISTIC
/begin CHARACTERISTIC KL_PWG_SOLL_NOTLAUF "Pedalwert im Fehlerfall" CURVE 0x784A8 TKL_SW_VV_SW 100.0 FORMULA_0001 0.0 100.0 FORMAT "%4.1"
 /begin AXIS_DESCR STD_AXIS pwg FORMULA_0001 10 0.0 120.0 MAX_GRAD 0.0 FORMAT "%4.1" /end AXIS_DESCR
/end CHARACTERISTIC
/begin CHARACTERISTIC KL_TMOT_CC_HIGH_TMOT_1 "Schwelle fuer gelbe CC-Msg" CURVE 0x7A3EE TKL_UW_VV_SW 100.0 FORMULA_0023 -50.0 170.0 FORMAT "%4.1"
 /begin AXIS_DESCR STD_AXIS time_ml FORMULA_0021 4 0.0 655.0 MAX_GRAD 0.0 FORMAT "%5.2" /end AXIS_DESCR
/end CHARACTERISTIC
/begin CHARACTERISTIC KL_TMOT_NTC "Kennlinie Motortemperatur" CURVE 0x7A380 TKL_SW_VV_SW 100.0 FORMULA_0975 -50.0 170.0 FORMAT "%6.3" /begin AXIS_DESCR STD_AXIS tmot_ad FORMULA_0114 10 0.0 1023.0 MAX_GRAD 0.0 /end AXIS_DESCR /end CHARACTERISTIC
/begin CHARACTERISTIC KL_TMOT_OBD_DELTA "Schwankung der Motortemperatur" CURVE 0x7A3CC TKL_SW_VV_SW 100.0 FORMULA_0074 -1000.0 1000.0 FORMAT "%4.1"
 /begin AXIS_DESCR STD_AXIS zust_tmot_start FORMULA_0023 8 -50.0 170.0 MAX_GRAD 0.0 FORMAT "%4.1" /end AXIS_DESCR
/end CHARACTERISTIC
/begin CHARACTERISTIC KL_TMOT_OBD_DIFF_T_DELTA "Max. Zeit in der maximale Messwert-Modell-Differenz ueberschritten" CURVE 0x7A400 TKL_SW_VV_UW 100.0 FORMULA_0071 0.0 6553.5 FORMAT "%4.1"
 /begin AXIS_DESCR STD_AXIS zust_tmot_start FORMULA_0023 4 -50.0 170.0 MAX_GRAD 0.0 FORMAT "%4.1" /end AXIS_DESCR
/end CHARACTERISTIC
/begin CHARACTERISTIC KL_TMOT_OBD_MODELL_DELTA "Schwankung der Modelltemperatur" CURVE 0x7A3AA TKL_SW_VV_SW 100.0 FORMULA_0074 -1000.0 1000.0 FORMAT "%4.1"
 /begin AXIS_DESCR STD_AXIS zust_tmot_start FORMULA_0023 8 -50.0 170.0 MAX_GRAD 0.0 FORMAT "%4.1" /end AXIS_DESCR
/end CHARACTERISTIC
/begin CHARACTERISTIC KL_TOEL_DN "gefilterter n-Einfluss Motorreibung" CURVE 0x7A566 TKL_SW_VV_SW 100.0 FORMULA_1011 -3.999999910593033e-002 3.999999910593033e-002 FORMAT "%7.4" /begin AXIS_DESCR STD_AXIS n FORMULA_0006 6 -10000.0 10000.0 MAX_GRAD 0.0 /end AXIS_DESCR /end CHARACTERISTIC
/begin CHARACTERISTIC KL_TOEL_N "n-Einfluss Motorreibung" CURVE 0x7A54C TKL_SW_VV_SW 100.0 FORMULA_1011 0.0 5.999999865889549e-002 FORMAT "%7.4"
 /begin AXIS_DESCR STD_AXIS Motordrehzahl FORMULA_0006 6 0.0 10000.0 MAX_GRAD 0.0 /end AXIS_DESCR
/end CHARACTERISTIC
/begin CHARACTERISTIC KL_TOEL_WICHT "Oelwannentemp.-Einfluss" CURVE 0x7A542 TKL_SW_VV_SW 100.0 FORMULA_1013 0.0 1.0 FORMAT "%5.2"
 /begin AXIS_DESCR STD_AXIS toel_wanne FORMULA_0023 2 -50.0 170.0 MAX_GRAD 0.0 FORMAT "%4.1" /end AXIS_DESCR
/end CHARACTERISTIC
/begin MEASUREMENT md_bereich "Bereich" UBYTE FORMULA_0784 0 0.0 0.0 255.0 READ_WRITE ECU_ADDRESS 0x3FC0D0 /end MEASUREMENT
/begin MEASUREMENT md_dsc_freig_st_e2 "DSC-Freigabe Ebene 2" UBYTE FORMULA_0777 0 0.0 0.0 255.0 READ_WRITE ECU_ADDRESS 0x3FC8A0 /end MEASUREMENT
/begin MEASUREMENT md_dsc_t_wait "Wartezeit vor DSC-Rampe" UWORD FORMULA_0590 0 0.0 0.0 10.0 READ_WRITE ECU_ADDRESS 0x3FC09E /end MEASUREMENT
/begin MEASUREMENT md_dyn_fil_res "Momentenreserve Dynamikfilter" SWORD FORMULA_0009 0 0.0 -100.0 1000.0 READ_WRITE ECU_ADDRESS 0x3FC0F2 /end MEASUREMENT
/begin MEASUREMENT md_dyn_fil_res_roh "Momentenreserve Dynamikfilter ohne Begr" SWORD FORMULA_0009 0 0.0 -100.0 1000.0 READ_WRITE ECU_ADDRESS 0x3FC0F0 /end MEASUREMENT
/begin MEASUREMENT md_dyn_flags "diverse Flags" UBYTE FORMULA_0003 0 0.0 0.0 255.0 READ_WRITE ECU_ADDRESS 0x3FC0CE /end MEASUREMENT
/begin MEASUREMENT md_dyn_freigabe "Freigabestatus" UBYTE FORMULA_0782 0 0 0.0 255.0 READ_WRITE BIT_MASK 0x1 ECU_ADDRESS 0x3FC0CE /end MEASUREMENT
/begin MEASUREMENT md_dyn_smg_timer "SMG-Timer" UBYTE FORMULA_0357 0 0.0 0.0 5.000000074505806e-002 READ_WRITE ECU_ADDRESS 0x3FC0CC /end MEASUREMENT
/begin MEASUREMENT md_dyn_st "Filterstatus" UBYTE FORMULA_0779 0 0.0 0.0 255.0 READ_WRITE BIT_MASK 0xF ECU_ADDRESS 0x3FC0CD /end MEASUREMENT
/begin MEASUREMENT md_dyn_st_anff "Filterstatus Anfahrfilter" UBYTE FORMULA_0781 0 0 0.0 255.0 READ_WRITE BIT_MASK 0x20 ECU_ADDRESS 0x3FC0CD /end MEASUREMENT
/begin MEASUREMENT md_dyn_st_tz_min "Filterstatus tz_min" UBYTE FORMULA_0780 0 0 0.0 255.0 READ_WRITE BIT_MASK 0x10 ECU_ADDRESS 0x3FC0CD /end MEASUREMENT
/begin MEASUREMENT md_e2_fehler "Fehlerstatus Ebene 2" UBYTE FORMULA_0776 0 0.0 0.0 255.0 READ_WRITE ECU_ADDRESS 0x3FC866 /end MEASUREMENT
/begin MEASUREMENT md_e2_fw_rel_err "Fahrerwunsch fehlerhaft" UBYTE FORMULA_0492 0 0.0 0.0 25.5 READ_WRITE ECU_ADDRESS 0x3FC86C /end MEASUREMENT
/begin MEASUREMENT md_e2_ist_err "Istmoment fehlerhaft" UBYTE FORMULA_0492 0 0.0 0.0 25.5 READ_WRITE ECU_ADDRESS 0x3FC869 /end MEASUREMENT
/begin MEASUREMENT md_e2_istsoll_err "Fehler Soll-Istvergleich" UBYTE FORMULA_0492 0 0.0 0.0 25.5 READ_WRITE ECU_ADDRESS 0x3FC86B /end MEASUREMENT
/begin MEASUREMENT md_e2_max_err "Maximalmoment fehlerhaft" UBYTE FORMULA_0492 0 0.0 0.0 25.5 READ_WRITE ECU_ADDRESS 0x3FC868 /end MEASUREMENT
/begin MEASUREMENT md_e2_min_err "Minimalmoment fehlerhaft" UBYTE FORMULA_0492 0 0.0 0.0 25.5 READ_WRITE ECU_ADDRESS 0x3FC867 /end MEASUREMENT
/begin MEASUREMENT md_e2_schlepp_err "Schleppmoment fehlerhaft" UBYTE FORMULA_0492 0 0.0 0.0 25.5 READ_WRITE ECU_ADDRESS 0x3FC86A /end MEASUREMENT
/begin MEASUREMENT md_eta_ausbl_sk "ETA-Ausblend ueber SK" UWORD FORMULA_0437 0 0.0 0.0 150.0 READ_WRITE ECU_ADDRESS 0x3FC074 /end MEASUREMENT
/begin MEASUREMENT md_eta_ausblend "ETA-Ausblend" UWORD FORMULA_0437 0 0.0 0.0 150.0 READ_WRITE ECU_ADDRESS 0x3FC072 /end MEASUREMENT
/begin MEASUREMENT md_eta_ausblend_e2 "ETA-Ausblend Ebene 2" UWORD FORMULA_0437 0 0.0 0.0 150.0 READ_WRITE ECU_ADDRESS 0x3FC892 /end MEASUREMENT
/begin MEASUREMENT md_eta_bezug "Bezugsmoment Eta-Berechnung" SWORD FORMULA_0009 0 0.0 -100.0 1000.0 READ_WRITE ECU_ADDRESS 0x3FC1A4 /end MEASUREMENT
/begin MEASUREMENT md_eta_la_ist "ETA-Lambda-Ist" UWORD FORMULA_0437 0 0.0 0.0 150.0 READ_WRITE ECU_ADDRESS 0x3FC062 /end MEASUREMENT
/begin MEASUREMENT md_eta_la_sk "Eta-Kompensation LA+SK" UWORD FORMULA_0437 0 0.0 0.0 150.0 READ_WRITE ECU_ADDRESS 0x3FC18E /end MEASUREMENT
/begin MEASUREMENT md_eta_la_vl "ETA-Lambda-VL" UWORD FORMULA_0437 0 0.0 0.0 150.0 READ_WRITE ECU_ADDRESS 0x3FC060 /end MEASUREMENT
/begin MEASUREMENT md_eta_rg_brenn "ETA-Restgas-Verbrennung" UWORD FORMULA_0437 0 0.0 0.0 150.0 READ_WRITE ECU_ADDRESS 0x3FC068 /end MEASUREMENT
/begin MEASUREMENT md_eta_rg_lw "ETA-Restgas-Lastwechsel" UWORD FORMULA_0437 0 0.0 0.0 150.0 READ_WRITE ECU_ADDRESS 0x3FC066 /end MEASUREMENT
/begin MEASUREMENT md_eta_zw_komp "Eta-Kompensation ZW" UWORD FORMULA_0437 0 0.0 0.0 150.0 READ_WRITE ECU_ADDRESS 0x3FC18C /end MEASUREMENT
/begin MEASUREMENT md_eta_zw_min "Wirkungsgrad tz_min" UWORD FORMULA_0437 0 0.0 0.0 150.0 READ_WRITE ECU_ADDRESS 0x3FC06A /end MEASUREMENT
/begin MEASUREMENT md_eta_zw_ne "Wirkungsgrad nach Eingriff" UWORD FORMULA_0437 0 0.0 0.0 150.0 READ_WRITE ECU_ADDRESS 0x3FC070 /end MEASUREMENT
/begin MEASUREMENT md_eta_zw_ne_e2 "ETA nach Eingriff Ebene 2" UWORD FORMULA_0437 0 0.0 0.0 150.0 READ_WRITE ECU_ADDRESS 0x3FC894 /end MEASUREMENT
/begin MEASUREMENT md_eta_zw_soll "Sollwirkungsgrad" UWORD FORMULA_0437 0 0.0 0.0 150.0 READ_WRITE ECU_ADDRESS 0x3FC076 /end MEASUREMENT
/begin MEASUREMENT md_eta_zw_stat "Wirkungsgrad tz_stat" UWORD FORMULA_0437 0 0.0 0.0 150.0 READ_WRITE ECU_ADDRESS 0x3FC06C /end MEASUREMENT
/begin MEASUREMENT md_eta_zw_ve "Wirkungsgrad tz_ve" UWORD FORMULA_0437 0 0.0 0.0 150.0 READ_WRITE ECU_ADDRESS 0x3FC06E /end MEASUREMENT
/begin MEASUREMENT md_exd_kkos_max "ExdKKOS Maxwert" SWORD FORMULA_0009 0 0.0 -100.0 1000.0 READ_WRITE ECU_ADDRESS 0x3FC0C6 /end MEASUREMENT
/begin MEASUREMENT md_exd_kkos_timeout "ExdKKOS Timeout" UWORD FORMULA_0021 0 0.0 0.0 655.0 READ_WRITE ECU_ADDRESS 0x3FC0C8 /end MEASUREMENT
/begin MEASUREMENT md_fr_wicht_fak_b1 "Wichtungsfaktor aus KF_MD_FR_WICHT" UWORD FORMULA_0024 0 0.0 0.0 1.999899983406067 READ_WRITE ECU_ADDRESS 0x3FC908 /end MEASUREMENT
/begin MEASUREMENT md_fr_wicht_fak_b2 "Wichtungsfaktor aus KF_MD_FR_WICHT" UWORD FORMULA_0024 0 0.0 0.0 1.999899983406067 READ_WRITE ECU_ADDRESS 0x3FC90A /end MEASUREMENT
/begin MEASUREMENT md_fw_fgr "rel. Wunschmoment vom FGR" SWORD FORMULA_0001 0 0.0 0.0 100.0 READ_WRITE ECU_ADDRESS 0x3FC17C /end MEASUREMENT
/begin MEASUREMENT md_fw_fgr_ "Komplement rel. Wunschmoment vom FGR" SWORD FORMULA_0001 0 0.0 0.0 100.0 READ_WRITE ECU_ADDRESS 0x3FC8A4 /end MEASUREMENT
/begin MEASUREMENT md_fw_fgr_e2 "rel. Wunschmoment vom FGR Ebene 2" SWORD FORMULA_0001 0 0.0 0.0 100.0 READ_WRITE ECU_ADDRESS 0x3FC8A2 /end MEASUREMENT
/begin MEASUREMENT md_fw_rel_diff "Differenz rel. Fahrerwunsch" SWORD FORMULA_0001 0 0.0 -10.0 120.0 READ_WRITE ECU_ADDRESS 0x3FC870 /end MEASUREMENT
/begin MEASUREMENT md_fw_rel_e2 "rel. Fahrerwunsch Ebene 2" SWORD FORMULA_0001 0 0.0 -10.0 120.0 READ_WRITE ECU_ADDRESS 0x3FC86E /end MEASUREMENT
/begin MEASUREMENT md_gen "Generatormoment" SWORD FORMULA_0009 0 0.0 -100.0 1000.0 READ_WRITE ECU_ADDRESS 0x3FC0C4 /end MEASUREMENT
/begin MEASUREMENT md_gen_st "Generatorstatus" UBYTE FORMULA_0772 0 0.0 0.0 255.0 READ_WRITE ECU_ADDRESS 0x3FC0C2 /end MEASUREMENT
/begin MEASUREMENT md_grad "Istgradient" SWORD FORMULA_0786 0 0.0 -5000.0 5000.0 READ_WRITE ECU_ADDRESS 0x3FC0DE /end MEASUREMENT
/begin MEASUREMENT md_grad_anf "Fahrergradient" SLONG FORMULA_0785 0 0.0 -5000.0 5000.0 READ_WRITE ECU_ADDRESS 0x3FC0D4 /end MEASUREMENT
/begin MEASUREMENT md_grad_dp "DP-Maximalgradient" SWORD FORMULA_0786 0 0.0 -5000.0 5000.0 READ_WRITE ECU_ADDRESS 0x3FC0DA /end MEASUREMENT
/begin MEASUREMENT md_grad_lsd "LSD-Maximalgradient" SWORD FORMULA_0786 0 0.0 -5000.0 5000.0 READ_WRITE ECU_ADDRESS 0x3FC0D8 /end MEASUREMENT
/begin MEASUREMENT md_grad_max "Maximalgradient" SWORD FORMULA_0786 0 0.0 -5000.0 5000.0 READ_WRITE ECU_ADDRESS 0x3FC0DC /end MEASUREMENT
/begin MEASUREMENT md_hyp_faktor "Hyp-Faktor" UBYTE FORMULA_0757 0 0.0 0.0 1.99210000038147 READ_WRITE ECU_ADDRESS 0x3FC034 /end MEASUREMENT
/begin MEASUREMENT md_ind_ist_skmin "minimal erreichbares Istmoment bei tz_min" SWORD FORMULA_0009 0 0.0 -100.0 1000.0 READ_WRITE ECU_ADDRESS 0x3FC160 /end MEASUREMENT
/begin MEASUREMENT md_ind_lw_e2 "Ladungswechselverluste" SWORD FORMULA_0009 0 0.0 -100.0 1000.0 READ_WRITE ECU_ADDRESS 0x3FC882 /end MEASUREMENT
/begin MEASUREMENT md_ind_lw_ist "LW-Verluste" SWORD FORMULA_0009 0 0.0 -100.0 1000.0 READ_WRITE ECU_ADDRESS 0x3FC046 /end MEASUREMENT
/begin MEASUREMENT md_ind_lw_max "LW-Verluste bei MAX" SWORD FORMULA_0009 0 0.0 -100.0 1000.0 READ_WRITE ECU_ADDRESS 0x3FC044 /end MEASUREMENT
/begin MEASUREMENT md_ind_lw_min "LW-Verluste bei MIN" SWORD FORMULA_0009 0 0.0 -100.0 1000.0 READ_WRITE ECU_ADDRESS 0x3FC042 /end MEASUREMENT
/begin MEASUREMENT md_ind_max "ind. Maximalmoment mit LA-Korr" SWORD FORMULA_0009 0 0.0 -100.0 1000.0 READ_WRITE ECU_ADDRESS 0x3FC056 /end MEASUREMENT
/begin MEASUREMENT md_ind_max_e2 "Indiziertes Maxmoment" SWORD FORMULA_0009 0 0.0 -100.0 1000.0 READ_WRITE ECU_ADDRESS 0x3FC876 /end MEASUREMENT
/begin MEASUREMENT md_ind_max_roh "ind. Maximalmoment" SWORD FORMULA_0009 0 0.0 -100.0 1000.0 READ_WRITE ECU_ADDRESS 0x3FC054 /end MEASUREMENT
/begin MEASUREMENT md_ind_min "indiziertes Minimalmoment" SWORD FORMULA_0009 0 0.0 -100.0 1000.0 READ_WRITE ECU_ADDRESS 0x3FC052 /end MEASUREMENT
/begin MEASUREMENT md_ind_min_e2 "Indiziertes Minmoment" SWORD FORMULA_0009 0 0.0 -100.0 1000.0 READ_WRITE ECU_ADDRESS 0x3FC87C /end MEASUREMENT
/begin MEASUREMENT md_ind_min_roh "indiziertes Minimalmoment ohne Verbraucher" SWORD FORMULA_0009 0 0.0 -100.0 1000.0 READ_WRITE ECU_ADDRESS 0x3FC050 /end MEASUREMENT
/begin MEASUREMENT md_ind_min_schub "min. ind. Schubmoment" SWORD FORMULA_0009 0 0.0 -100.0 1000.0 READ_WRITE ECU_ADDRESS 0x3FC036 /end MEASUREMENT
/begin MEASUREMENT md_ind_opt "Indiziertes Istmoment" SWORD FORMULA_0009 0 0.0 -100.0 1000.0 READ_WRITE ECU_ADDRESS 0x3FC058 /end MEASUREMENT
/begin MEASUREMENT md_ind_opt_diff "Differenz zum ind. Istmoment" SWORD FORMULA_0009 0 0.0 -100.0 1000.0 READ_WRITE ECU_ADDRESS 0x3FC874 /end MEASUREMENT
/begin MEASUREMENT md_ind_opt_e2 "Indiziertes Istmoment" SWORD FORMULA_0009 0 0.0 -100.0 1000.0 READ_WRITE ECU_ADDRESS 0x3FC872 /end MEASUREMENT
/begin MEASUREMENT md_ind_opt_la "ind. Istmoment mit LA-Einfluss" SWORD FORMULA_0009 0 0.0 -100.0 1000.0 READ_WRITE ECU_ADDRESS 0x3FC05A /end MEASUREMENT
/begin MEASUREMENT md_ind_opt_la_rg "ind. Istmoment mit LA-/RG-Einfluss" SWORD FORMULA_0009 0 0.0 -100.0 1000.0 READ_WRITE ECU_ADDRESS 0x3FC05C /end MEASUREMENT
/begin MEASUREMENT md_ind_reib "Reibverluste (Summe)" SWORD FORMULA_0009 0 0.0 -100.0 1000.0 READ_WRITE ECU_ADDRESS 0x3FC040 /end MEASUREMENT
/begin MEASUREMENT md_ind_reib_abreg "Reibverluste (Abregelung nach Start)" SWORD FORMULA_0759 0 0.0 -100.0 1000.0 READ_WRITE ECU_ADDRESS 0x3FC03E /end MEASUREMENT
/begin MEASUREMENT md_ind_reib_e2 "Reibverluste" SWORD FORMULA_0009 0 0.0 -100.0 1000.0 READ_WRITE ECU_ADDRESS 0x3FC884 /end MEASUREMENT
/begin MEASUREMENT md_ind_reib_offset "Reibverluste (Offset)" SWORD FORMULA_0758 0 0.0 -100.0 200.0 READ_WRITE ECU_ADDRESS 0x3FC03C /end MEASUREMENT
/begin MEASUREMENT md_ind_reib_offset_e2 "Reibverluste (Offset) - Ebene 2" SWORD FORMULA_0758 0 0.0 -100.0 200.0 READ_WRITE ECU_ADDRESS 0x3FC886 /end MEASUREMENT
/begin MEASUREMENT md_ind_reib_roh "Reibverluste (Rohwert)" SWORD FORMULA_0009 0 0.0 -100.0 1000.0 READ_WRITE ECU_ADDRESS 0x3FC03A /end MEASUREMENT
/begin MEASUREMENT md_ind_rf_min "Moment bei Rfmin" SWORD FORMULA_0009 0 0.0 -100.0 1000.0 READ_WRITE ECU_ADDRESS 0x3FC038 /end MEASUREMENT
/begin MEASUREMENT md_ind_schlepp_diff "Differenz zum Schleppmoment" SWORD FORMULA_0009 0 0.0 -100.0 1000.0 READ_WRITE ECU_ADDRESS 0x3FC88A /end MEASUREMENT
/begin MEASUREMENT md_ind_schlepp_e2 "Schleppmoment" SWORD FORMULA_0009 0 0.0 -100.0 1000.0 READ_WRITE ECU_ADDRESS 0x3FC888 /end MEASUREMENT
/begin MEASUREMENT md_ind_schlepp_max "Schleppmoment bei MAX" SWORD FORMULA_0009 0 0.0 -100.0 1000.0 READ_WRITE ECU_ADDRESS 0x3FC048 /end MEASUREMENT
/begin MEASUREMENT md_ind_ve "ind. Moment vor Eingriff" SWORD FORMULA_0009 0 0.0 -100.0 1000.0 READ_WRITE ECU_ADDRESS 0x3FC05E /end MEASUREMENT
/begin MEASUREMENT md_ind_wunsch_ges "ind. Wunschmoment" SWORD FORMULA_0009 0 0.0 -100.0 1000.0 READ_WRITE ECU_ADDRESS 0x3FC19A /end MEASUREMENT
/begin MEASUREMENT md_ind_wunsch_ml "ind. Wunschmoment fuer den Luftpfad" SWORD FORMULA_0009 0 0.0 -100.0 1000.0 READ_WRITE ECU_ADDRESS 0x3FC19C /end MEASUREMENT
/begin MEASUREMENT md_ind_wunsch_ml_komp "Luft-Wunschmoment nach Kompensation" SWORD FORMULA_0009 0 0.0 -100.0 1000.0 READ_WRITE ECU_ADDRESS 0x3FC19E /end MEASUREMENT
/begin MEASUREMENT md_ind_wunsch_tz "ind. Wunschmoment fuer den Zuendwinkelpfad" SWORD FORMULA_0009 0 0.0 -100.0 1000.0 READ_WRITE ECU_ADDRESS 0x3FC1A0 /end MEASUREMENT
/begin MEASUREMENT md_ind_wunsch_tz_grad "Gradient Sollmoment" SWORD FORMULA_0562 0 0.0 -5000.0 5000.0 READ_WRITE ECU_ADDRESS 0x3FC1A2 /end MEASUREMENT
/begin MEASUREMENT md_kkos "MD-Anf KKOS aus KF+Adapt" SWORD FORMULA_0009 0 0.0 -100.0 1000.0 READ_WRITE ECU_ADDRESS 0x3FC0AC /end MEASUREMENT
/begin MEASUREMENT md_kkos_fil "MD-Anf KKOS nach Filter" SWORD FORMULA_0009 0 0.0 -100.0 1000.0 READ_WRITE ECU_ADDRESS 0x3FC0AE /end MEASUREMENT
/begin MEASUREMENT md_kkos_freig_st "KKOS-Freigabe" UBYTE FORMULA_0768 0 0.0 0.0 255.0 READ_WRITE ECU_ADDRESS 0x3FC0A0 /end MEASUREMENT
/begin MEASUREMENT md_kkos_res "KKOS-Reserve" SWORD FORMULA_0009 0 0.0 -100.0 1000.0 READ_WRITE ECU_ADDRESS 0x3FC0B2 /end MEASUREMENT
/begin MEASUREMENT md_kkos_res_max "Maxwert fuer KKOS-Reserve" SWORD FORMULA_0009 0 0.0 -100.0 1000.0 READ_WRITE ECU_ADDRESS 0x3FC0B0 /end MEASUREMENT
/begin MEASUREMENT md_kkos_s "KKOS-Schalter" UBYTE FORMULA_0770 0 0.0 0.0 255.0 READ_WRITE ECU_ADDRESS 0x3FC0A2 /end MEASUREMENT
/begin MEASUREMENT md_kkos_sperr_st "KKOS-Sperre" UBYTE FORMULA_0769 0 0.0 0.0 255.0 READ_WRITE ECU_ADDRESS 0x3FC0A1 /end MEASUREMENT
/begin MEASUREMENT md_kkos_time_ba "Zeit BA-Abschaltung" UWORD FORMULA_0021 0 0.0 0.0 10.0 READ_WRITE ECU_ADDRESS 0x3FC0A4 /end MEASUREMENT
/begin MEASUREMENT md_kkos_time_delay "Zeit Delay" UWORD FORMULA_0021 0 0.0 0.0 10.0 READ_WRITE ECU_ADDRESS 0x3FC0AA /end MEASUREMENT
/begin MEASUREMENT md_kkos_time_res "MaxZeit fuer KKOS-Reserve" UWORD FORMULA_0021 0 0.0 0.0 10.0 READ_WRITE ECU_ADDRESS 0x3FC0B4 /end MEASUREMENT
/begin MEASUREMENT md_kkos_time_vl "Zeit VL-Abschaltung" UWORD FORMULA_0021 0 0.0 0.0 10.0 READ_WRITE ECU_ADDRESS 0x3FC0A6 /end MEASUREMENT
/begin MEASUREMENT md_kkos_time_wh "Zeit WH-Abschaltung" UWORD FORMULA_0021 0 0.0 0.0 10.0 READ_WRITE ECU_ADDRESS 0x3FC0A8 /end MEASUREMENT
/begin MEASUREMENT md_kkos_zh_res "KKOS-Reserve" SWORD FORMULA_0009 0 0.0 -100.0 1000.0 READ_WRITE ECU_ADDRESS 0x3FC0B8 /end MEASUREMENT
/begin MEASUREMENT md_kkos_zh_res_max "Maxwert fuer KKOS-Reserve" SWORD FORMULA_0009 0 0.0 -100.0 1000.0 READ_WRITE ECU_ADDRESS 0x3FC0B6 /end MEASUREMENT
/begin MEASUREMENT md_kkos_zh_time_res "MaxZeit fuer KKOS-Reserve" UWORD FORMULA_0021 0 0.0 0.0 10.0 READ_WRITE ECU_ADDRESS 0x3FC0BA /end MEASUREMENT
/begin MEASUREMENT md_kkos_zust "KKOS-Zustand" UBYTE FORMULA_0771 0 0.0 0.0 255.0 READ_WRITE ECU_ADDRESS 0x3FC0A3 /end MEASUREMENT
/begin MEASUREMENT md_kupp_asc_ml "ASC-Sollmoment Luft" SWORD FORMULA_0009 0 0.0 -100.0 1000.0 READ_WRITE ECU_ADDRESS 0x3FC096 /end MEASUREMENT
/begin MEASUREMENT md_kupp_asc_tz "ASC-Sollmoment TZ" SWORD FORMULA_0009 0 0.0 -100.0 1000.0 READ_WRITE ECU_ADDRESS 0x3FC098 /end MEASUREMENT
/begin MEASUREMENT md_kupp_begrenzer "Wunschmomentbegrenzer" SWORD FORMULA_0009 0 0.0 -100.0 1000.0 READ_WRITE ECU_ADDRESS 0x3FC18A /end MEASUREMENT
/begin MEASUREMENT md_kupp_grenz_dp_o "obere Grenze fuer DP-Bereichsauswahl" SWORD FORMULA_0009 0 0.0 -100.0 1000.0 READ_WRITE ECU_ADDRESS 0x3FC0E6 /end MEASUREMENT
/begin MEASUREMENT md_kupp_grenz_dp_u "untere Grenze fuer DP-Bereichsauswahl" SWORD FORMULA_0009 0 0.0 -100.0 1000.0 READ_WRITE ECU_ADDRESS 0x3FC0E4 /end MEASUREMENT
/begin MEASUREMENT md_kupp_grenz_lsd_o "obere Grenze fuer LSD-Bereichsauswahl" SWORD FORMULA_0009 0 0.0 -100.0 1000.0 READ_WRITE ECU_ADDRESS 0x3FC0E2 /end MEASUREMENT
/begin MEASUREMENT md_kupp_grenz_lsd_u "untere Grenze fuer LSD-Bereichsauswahl" SWORD FORMULA_0009 0 0.0 -100.0 1000.0 READ_WRITE ECU_ADDRESS 0x3FC0E0 /end MEASUREMENT
/begin MEASUREMENT md_kupp_grenz_o "obere Grenze fuer Bereichsauswahl" SWORD FORMULA_0009 0 0.0 -100.0 1000.0 READ_WRITE ECU_ADDRESS 0x3FC0EA /end MEASUREMENT
/begin MEASUREMENT md_kupp_grenz_u "untere Grenze fuer Bereichsauswahl" SWORD FORMULA_0009 0 0.0 -100.0 1000.0 READ_WRITE ECU_ADDRESS 0x3FC0E8 /end MEASUREMENT
/begin MEASUREMENT md_kupp_ist_e2 "Istmoment Ebene 2" SWORD FORMULA_0009 0 0.0 -100.0 1000.0 READ_WRITE ECU_ADDRESS 0x3FC896 /end MEASUREMENT
/begin MEASUREMENT md_kupp_ist_schw "schwules Istmoment" SWORD FORMULA_0009 0 0.0 -100.0 1000.0 READ_WRITE ECU_ADDRESS 0x3FC090 /end MEASUREMENT
/begin MEASUREMENT md_kupp_ist_soll_e2 "IstSollabweichung Ebene 2" SWORD FORMULA_0009 0 0.0 -100.0 1000.0 READ_WRITE ECU_ADDRESS 0x3FC89C /end MEASUREMENT
/begin MEASUREMENT md_kupp_max_diff "Differenz zum Maxmoment" SWORD FORMULA_0009 0 0.0 -100.0 1000.0 READ_WRITE ECU_ADDRESS 0x3FC87A /end MEASUREMENT
/begin MEASUREMENT md_kupp_max_e2 "Maxmoment" SWORD FORMULA_0009 0 0.0 -100.0 1000.0 READ_WRITE ECU_ADDRESS 0x3FC878 /end MEASUREMENT
/begin MEASUREMENT md_kupp_max_mdrv "CAN-Maximalmoment bei MDrv" SWORD FORMULA_0009 0 0.0 -100.0 1000.0 READ_WRITE ECU_ADDRESS 0x3FC092 /end MEASUREMENT
/begin MEASUREMENT md_kupp_min_asc "min. Moment fuer ASC-Eingriff" SWORD FORMULA_0009 0 0.0 -100.0 1000.0 READ_WRITE ECU_ADDRESS 0x3FC17E /end MEASUREMENT
/begin MEASUREMENT md_kupp_min_diff "Differenz zum Minmoment" SWORD FORMULA_0009 0 0.0 -100.0 1000.0 READ_WRITE ECU_ADDRESS 0x3FC880 /end MEASUREMENT
/begin MEASUREMENT md_kupp_min_e2 "Minmoment" SWORD FORMULA_0009 0 0.0 -100.0 1000.0 READ_WRITE ECU_ADDRESS 0x3FC87E /end MEASUREMENT
/begin MEASUREMENT md_kupp_min_schub "min. Kupplungsschubmoment" SWORD FORMULA_0009 0 0.0 -100.0 1000.0 READ_WRITE ECU_ADDRESS 0x3FC094 /end MEASUREMENT
/begin MEASUREMENT md_kupp_msr_e2 "MSR-Sollvorgabe Ebene 2" SWORD FORMULA_0009 0 0.0 -100.0 1000.0 READ_WRITE ECU_ADDRESS 0x3FC89E /end MEASUREMENT
/begin MEASUREMENT md_kupp_msr_ml "MSR-Sollmoment Luft" SWORD FORMULA_0009 0 0.0 -100.0 1000.0 READ_WRITE ECU_ADDRESS 0x3FC09A /end MEASUREMENT
/begin MEASUREMENT md_kupp_msr_tz "MSR-Sollmoment TZ" SWORD FORMULA_0009 0 0.0 -100.0 1000.0 READ_WRITE ECU_ADDRESS 0x3FC09C /end MEASUREMENT
/begin MEASUREMENT md_kupp_nbegr "max. Moment bei Drehzahlbegrenzung" SWORD FORMULA_0009 0 0.0 -100.0 1000.0 READ_WRITE ECU_ADDRESS 0x3FC1D2 /end MEASUREMENT
/begin MEASUREMENT md_kupp_noise_max "max. Moment bei Noise" SWORD FORMULA_0009 0 0.0 -100.0 1000.0 READ_WRITE ECU_ADDRESS 0x3FC20A /end MEASUREMENT
/begin MEASUREMENT md_kupp_off_e2 "zulaessige Abweichung Ebene 2" SWORD FORMULA_0009 0 0.0 -100.0 1000.0 READ_WRITE ECU_ADDRESS 0x3FC898 /end MEASUREMENT
/begin MEASUREMENT md_kupp_smg_begr "max. Moment fuer SMG-Eingriff" SWORD FORMULA_0009 0 0.0 -100.0 1000.0 READ_WRITE ECU_ADDRESS 0x3FC20C /end MEASUREMENT
/begin MEASUREMENT md_kupp_soll_e2 "Sollmoment Ebene 2" SWORD FORMULA_0009 0 0.0 -100.0 1000.0 READ_WRITE ECU_ADDRESS 0x3FC89A /end MEASUREMENT
/begin MEASUREMENT md_kupp_ti_begr "max. Moment bei Einspritzproblemen" SWORD FORMULA_0009 0 0.0 -100.0 1000.0 READ_WRITE ECU_ADDRESS 0x3FC20E /end MEASUREMENT
/begin MEASUREMENT md_kupp_vbegr "Moment Geschwindigkeitsbegrenzung" SWORD FORMULA_0009 0 0.0 -100.0 1000.0 READ_WRITE ECU_ADDRESS 0x3FC1D8 /end MEASUREMENT
/begin MEASUREMENT md_kupp_wunsch_begr_eff "effektives Begrenzermoment" SWORD FORMULA_0009 0 0.0 -100.0 1000.0 READ_WRITE ECU_ADDRESS 0x3FC186 /end MEASUREMENT
/begin MEASUREMENT md_kupp_wunsch_e2 "Wunschmoment" SWORD FORMULA_0009 0 0.0 -100.0 1000.0 READ_WRITE ECU_ADDRESS 0x3FC88C /end MEASUREMENT
/begin MEASUREMENT md_kupp_wunsch_fil_dp "gefilt. Fahrerwunsch fuer DP-Wichtung" SWORD FORMULA_0009 0 0.0 -100.0 1000.0 READ_WRITE ECU_ADDRESS 0x3FC0F6 /end MEASUREMENT
/begin MEASUREMENT md_kupp_wunsch_fil_roh "Filterwert" SLONG FORMULA_0787 0 0.0 -100.0 1000.0 READ_WRITE ECU_ADDRESS 0x3FC0EC /end MEASUREMENT
/begin MEASUREMENT md_kupp_wunsch_filter "Wunschmoment nach Dynamikfilter" SWORD FORMULA_0009 0 0.0 -100.0 1000.0 READ_WRITE ECU_ADDRESS 0x3FC182 /end MEASUREMENT
/begin MEASUREMENT md_kupp_wunsch_ges "Wunschmoment nach Dynamikf./RPS" SWORD FORMULA_0009 0 0.0 -100.0 1000.0 READ_WRITE ECU_ADDRESS 0x3FC184 /end MEASUREMENT
/begin MEASUREMENT md_kupp_wunsch_grad "Gradient Fahrerwunsch" SWORD FORMULA_0562 0 0.0 -5000.0 5000.0 READ_WRITE ECU_ADDRESS 0x3FC180 /end MEASUREMENT
/begin MEASUREMENT md_kupp_wunsch_grad_max "Maximalgradient" SWORD FORMULA_0562 0 0.0 -5000.0 5000.0 READ_WRITE ECU_ADDRESS 0x3FC0F4 /end MEASUREMENT
/begin MEASUREMENT md_kupp_wunsch_ml_komp "komp. Wunschmoment fuer den Luftpfad" SWORD FORMULA_0009 0 0.0 -100.0 1000.0 READ_WRITE ECU_ADDRESS 0x3FC188 /end MEASUREMENT
/begin MEASUREMENT md_kupp_wunsch_puls "Stollis Pulsgenerator" SWORD FORMULA_0009 0 0.0 -100.0 1000.0 READ_WRITE ECU_ADDRESS 0x3FC08C /end MEASUREMENT
/begin MEASUREMENT md_lrw "MD-Anf LRW aus KF" SWORD FORMULA_0009 0 0.0 -100.0 1000.0 READ_WRITE ECU_ADDRESS 0x3FC0BC /end MEASUREMENT
/begin MEASUREMENT md_lrw_fil "MD-Anf LRW mit Filter" SWORD FORMULA_0009 0 0.0 -100.0 1000.0 READ_WRITE ECU_ADDRESS 0x3FC0BE /end MEASUREMENT
/begin MEASUREMENT md_lrw_res "LRW-Reserve" SWORD FORMULA_0009 0 0.0 -100.0 1000.0 READ_WRITE ECU_ADDRESS 0x3FC0C0 /end MEASUREMENT
/begin MEASUREMENT md_mzyl_soll_asp_b1 "Soll-Mzyl" SWORD FORMULA_0104 0 0.0 -500.0 1500.0 READ_WRITE ECU_ADDRESS 0x3FC1A6 /end MEASUREMENT
/begin MEASUREMENT md_mzyl_soll_asp_b2 "Soll-Mzyl" SWORD FORMULA_0104 0 0.0 -500.0 1500.0 READ_WRITE ECU_ADDRESS 0x3FC1A8 /end MEASUREMENT
/begin MEASUREMENT md_n_grad_fil "gef. Gradient" SWORD FORMULA_0105 0 0.0 -10000.0 10000.0 READ_WRITE ECU_ADDRESS 0x3FC08E /end MEASUREMENT
/begin MEASUREMENT md_nbegr_abstand "Abstand zur Begrenzerdrehzahl" SWORD FORMULA_0006 0 0.0 -1000.0 1000.0 READ_WRITE ECU_ADDRESS 0x3FC1EA /end MEASUREMENT
/begin MEASUREMENT md_nbegr_b0 "Reglerfaktor b0" ULONG FORMULA_0795 0 0.0 0.0 4294967.295 READ_WRITE ECU_ADDRESS 0x3FC1EC /end MEASUREMENT
/begin MEASUREMENT md_nbegr_b1 "Reglerfaktor b1" ULONG FORMULA_0799 0 0.0 0.0 -4294967.295 READ_WRITE ECU_ADDRESS 0x3FC1F0 /end MEASUREMENT
/begin MEASUREMENT md_nbegr_b2 "Reglerfaktor b2" ULONG FORMULA_0795 0 0.0 0.0 4294967.295 READ_WRITE ECU_ADDRESS 0x3FC1F4 /end MEASUREMENT
/begin MEASUREMENT md_nbegr_egas "Aenderungsbegrenztes n_begr_egas" SWORD FORMULA_0006 0 0.0 0.0 10000.0 READ_WRITE ECU_ADDRESS 0x3FC1E4 /end MEASUREMENT
/begin MEASUREMENT md_nbegr_gang "Ganginfo" UBYTE FORMULA_0135 0 0.0 0.0 10.0 READ_WRITE ECU_ADDRESS 0x3FC1E2 /end MEASUREMENT
/begin MEASUREMENT md_nbegr_n_offset "Abregelung Maxdrehzahl" SWORD FORMULA_0006 0 0.0 0.0 10000.0 READ_WRITE ECU_ADDRESS 0x3FC1E6 /end MEASUREMENT
/begin MEASUREMENT md_nbegr_soll "Solldrehzahl inkl. Abregelung" SWORD FORMULA_0006 0 0.0 0.0 10000.0 READ_WRITE ECU_ADDRESS 0x3FC1E8 /end MEASUREMENT
/begin MEASUREMENT md_noise_st "Noisestatus" UBYTE FORMULA_0802 0 0.0 0.0 255.0 READ_WRITE ECU_ADDRESS 0x3FC206 /end MEASUREMENT
/begin MEASUREMENT md_noise_t "Noisetime" UWORD FORMULA_0071 0 0.0 0.0 6553.5 READ_WRITE ECU_ADDRESS 0x3FC208 /end MEASUREMENT
/begin MEASUREMENT md_polynom_a "Polynom_a" SWORD FORMULA_0760 0 0.0 -320.0 320.0 READ_WRITE ECU_ADDRESS 0x3FC086 /end MEASUREMENT
/begin MEASUREMENT md_polynom_b "Polynom_b" SWORD FORMULA_0760 0 0.0 -320.0 320.0 READ_WRITE ECU_ADDRESS 0x3FC088 /end MEASUREMENT
/begin MEASUREMENT md_puls_timer "Generator-Timer" UWORD FORMULA_0109 0 0.0 0.0 325.0 READ_WRITE ECU_ADDRESS 0x3FC08A /end MEASUREMENT
/begin MEASUREMENT md_res "Momentenreserve" SWORD FORMULA_0009 0 0.0 -100.0 1000.0 READ_WRITE ECU_ADDRESS 0x3FC198 /end MEASUREMENT
/begin MEASUREMENT md_res_anf "angeforderte Momentenreserve" SWORD FORMULA_0009 0 0.0 -100.0 1000.0 READ_WRITE ECU_ADDRESS 0x3FC194 /end MEASUREMENT
/begin MEASUREMENT md_res_max "max. Momentenreserve" SWORD FORMULA_0009 0 0.0 -100.0 1000.0 READ_WRITE ECU_ADDRESS 0x3FC192 /end MEASUREMENT
/begin MEASUREMENT md_res_min "min. Momentenreserve fuer OBD" SWORD FORMULA_0009 0 0.0 -100.0 1000.0 READ_WRITE ECU_ADDRESS 0x3FC190 /end MEASUREMENT
/begin MEASUREMENT md_res_zw "Momentenreserve ZW-Kompensation" SWORD FORMULA_0009 0 0.0 -100.0 1000.0 READ_WRITE ECU_ADDRESS 0x3FC196 /end MEASUREMENT
/begin MEASUREMENT md_rf_min "rf_min" SWORD FORMULA_0007 0 0.0 0.0 2.0 READ_WRITE ECU_ADDRESS 0x3FC030 /end MEASUREMENT
/begin MEASUREMENT md_rf_rg_korr_b1 "Korrekturwert über RG" UWORD FORMULA_0073 0 0.0 0.0 4.0 READ_WRITE ECU_ADDRESS 0x3FC1B6 /end MEASUREMENT
/begin MEASUREMENT md_rf_rg_korr_b2 "Korrekturwert über RG" UWORD FORMULA_0073 0 0.0 0.0 4.0 READ_WRITE ECU_ADDRESS 0x3FC1B8 /end MEASUREMENT
/begin MEASUREMENT md_rf_soll_pt_fr_b1 "Soll-rf mit pt-,fr,fra-Korr" SWORD FORMULA_0007 0 0.0 0.0 2.0 READ_WRITE ECU_ADDRESS 0x3FC1B2 /end MEASUREMENT
/begin MEASUREMENT md_rf_soll_pt_fr_b2 "Soll-rf mit pt-,fr,fra-Korr" SWORD FORMULA_0007 0 0.0 0.0 2.0 READ_WRITE ECU_ADDRESS 0x3FC1B4 /end MEASUREMENT
/begin MEASUREMENT md_rf_soll_pt_fr_wicht_fil_b1 "Soll-rf mit pt-Korr+fr+wicht und gefiltert" SWORD FORMULA_0007 0 0.0 0.0 2.0 READ_WRITE ECU_ADDRESS 0x3FC210 /end MEASUREMENT
/begin MEASUREMENT md_rf_soll_pt_fr_wicht_fil_b2 "Soll-rf mit pt-Korr+fr+wicht und gefiltert" SWORD FORMULA_0007 0 0.0 0.0 2.0 READ_WRITE ECU_ADDRESS 0x3FC212 /end MEASUREMENT
/begin MEASUREMENT md_rf_soll_pt_rg_fr_b1 "Soll-rf mit pt-,rg-,fr-Korr" SWORD FORMULA_0007 0 0.0 0.0 2.0 READ_WRITE ECU_ADDRESS 0x3FC1AA /end MEASUREMENT
/begin MEASUREMENT md_rf_soll_pt_rg_fr_b2 "Soll-rf mit pt-,rg-,fr-Korr" SWORD FORMULA_0007 0 0.0 0.0 2.0 READ_WRITE ECU_ADDRESS 0x3FC1AC /end MEASUREMENT
/begin MEASUREMENT md_rf_soll_pt_rg_fr_wl_b1 "Soll-rf mit pt-,rg-,fr-Korr,wl-Korr" SWORD FORMULA_0007 0 0.0 0.0 2.0 READ_WRITE ECU_ADDRESS 0x3FC1AE /end MEASUREMENT
/begin MEASUREMENT md_rf_soll_pt_rg_fr_wl_b2 "Soll-rf mit pt-,rg-,fr-Korr,wl-Korr" SWORD FORMULA_0007 0 0.0 0.0 2.0 READ_WRITE ECU_ADDRESS 0x3FC1B0 /end MEASUREMENT
/begin MEASUREMENT md_rf_tl_vl "rf_max" SWORD FORMULA_0007 0 0.0 0.0 2.0 READ_WRITE ECU_ADDRESS 0x3FC032 /end MEASUREMENT
/begin MEASUREMENT md_richtung "Filterrichtung" SBYTE FORMULA_0783 0 0.0 -128.0 127.0 READ_WRITE ECU_ADDRESS 0x3FC0CF /end MEASUREMENT
/begin MEASUREMENT md_sk_diff_max "max. zulaessige Abweichung" SWORD FORMULA_0009 0 0.0 -100.0 1000.0 READ_WRITE ECU_ADDRESS 0x3FC156 /end MEASUREMENT
/begin MEASUREMENT md_sk_fehler "SK-Fehlerinfo" UBYTE FORMULA_0438 0 0.0 0.0 255.0 READ_WRITE ECU_ADDRESS 0x3FC14E /end MEASUREMENT
/begin MEASUREMENT md_sk_grad_max "Begrenzung Dynamikfilter" SWORD FORMULA_0562 0 0.0 0.0 20000.0 READ_WRITE ECU_ADDRESS 0x3FC15E /end MEASUREMENT
/begin MEASUREMENT md_sk_pwg "gefilteter Pedalwert" SWORD FORMULA_0001 0 0.0 -10.0 120.0 READ_WRITE ECU_ADDRESS 0x3FC148 /end MEASUREMENT
/begin MEASUREMENT md_sk_timer_0 "SK-Timer bei pwg=0" UWORD FORMULA_0021 0 0.0 0.0 655.0 READ_WRITE ECU_ADDRESS 0x3FC14A /end MEASUREMENT
/begin MEASUREMENT md_sk_timer_1 "SK-Timer bei pwg>0" UWORD FORMULA_0021 0 0.0 0.0 655.0 READ_WRITE ECU_ADDRESS 0x3FC14C /end MEASUREMENT
/begin MEASUREMENT md_sk_tired "Anzahl freigegebener Einspritzkanaele" UBYTE FORMULA_0003 0 0.0 0.0 10.0 READ_WRITE ECU_ADDRESS 0x3FC162 /end MEASUREMENT
/begin MEASUREMENT md_sk_vergl_diff "Soll-/Istabweichung" SWORD FORMULA_0009 0 0.0 -100.0 1000.0 READ_WRITE ECU_ADDRESS 0x3FC158 /end MEASUREMENT
/begin MEASUREMENT md_sk_vergl_soll "Vergleichssollmoment" SWORD FORMULA_0009 0 0.0 -100.0 1000.0 READ_WRITE ECU_ADDRESS 0x3FC154 /end MEASUREMENT
/begin MEASUREMENT md_sk_verh "Verhaeltnis Sollmoment zu min.Istmoment" UWORD FORMULA_0073 0 0.0 0.0 4.0 READ_WRITE ECU_ADDRESS 0x3FC164 /end MEASUREMENT
/begin MEASUREMENT md_sk_wdkmax "zulaesssiger DK-Winkel bei pwg=0" SWORD FORMULA_0001 0 0.0 -10.0 120.0 READ_WRITE ARRAY_SIZE 2 ECU_ADDRESS 0x3FC150 MATRIX_DIM 2 1 1 /end MEASUREMENT
/begin MEASUREMENT md_sk_wunsch_begr_ml "Begrenzung Luftmoment" SWORD FORMULA_0009 0 0.0 -100.0 1000.0 READ_WRITE ECU_ADDRESS 0x3FC15A /end MEASUREMENT
/begin MEASUREMENT md_sk_wunsch_begr_tz "Begrenzung Zündungsmoment" SWORD FORMULA_0009 0 0.0 -100.0 1000.0 READ_WRITE ECU_ADDRESS 0x3FC15C /end MEASUREMENT
/begin MEASUREMENT md_start_offset "Offset beim Start" SWORD FORMULA_0009 0 0.0 -100.0 1000.0 READ_WRITE ECU_ADDRESS 0x3FC04E /end MEASUREMENT
/begin MEASUREMENT md_start_offset_e2 "Startmoment" SWORD FORMULA_0009 0 0.0 -100.0 1000.0 READ_WRITE ECU_ADDRESS 0x3FC88E /end MEASUREMENT
/begin MEASUREMENT md_tz_eingr_aktiv "TZ-Eingriff" UBYTE FORMULA_0797 0 0 0.0 255.0 READ_WRITE BIT_MASK 0x1 ECU_ADDRESS 0x3FC1BA /end MEASUREMENT
/begin MEASUREMENT md_tz_eingr_bezug "TZ-Bezugsmoment" UBYTE FORMULA_0798 0 0.0 0.0 255.0 READ_WRITE ECU_ADDRESS 0x3FC1BB /end MEASUREMENT
/begin MEASUREMENT md_tz_soll_zyl1 "Soll-TZ" SWORD FORMULA_0102 0 0.0 -50.0 60.0 READ_WRITE ECU_ADDRESS 0x3FC1BE /end MEASUREMENT
/begin MEASUREMENT md_tz_soll_zyl10 "Soll-TZ" SWORD FORMULA_0102 0 0.0 -50.0 60.0 READ_WRITE ECU_ADDRESS 0x3FC1D0 /end MEASUREMENT
/begin MEASUREMENT md_tz_soll_zyl2 "Soll-TZ" SWORD FORMULA_0102 0 0.0 -50.0 60.0 READ_WRITE ECU_ADDRESS 0x3FC1C0 /end MEASUREMENT
/begin MEASUREMENT md_tz_soll_zyl3 "Soll-TZ" SWORD FORMULA_0102 0 0.0 -50.0 60.0 READ_WRITE ECU_ADDRESS 0x3FC1C2 /end MEASUREMENT
/begin MEASUREMENT md_tz_soll_zyl4 "Soll-TZ" SWORD FORMULA_0102 0 0.0 -50.0 60.0 READ_WRITE ECU_ADDRESS 0x3FC1C4 /end MEASUREMENT
/begin MEASUREMENT md_tz_soll_zyl5 "Soll-TZ" SWORD FORMULA_0102 0 0.0 -50.0 60.0 READ_WRITE ECU_ADDRESS 0x3FC1C6 /end MEASUREMENT
/begin MEASUREMENT md_tz_soll_zyl6 "Soll-TZ" SWORD FORMULA_0102 0 0.0 -50.0 60.0 READ_WRITE ECU_ADDRESS 0x3FC1C8 /end MEASUREMENT
/begin MEASUREMENT md_tz_soll_zyl7 "Soll-TZ" SWORD FORMULA_0102 0 0.0 -50.0 60.0 READ_WRITE ECU_ADDRESS 0x3FC1CA /end MEASUREMENT
/begin MEASUREMENT md_tz_soll_zyl8 "Soll-TZ" SWORD FORMULA_0102 0 0.0 -50.0 60.0 READ_WRITE ECU_ADDRESS 0x3FC1CC /end MEASUREMENT
/begin MEASUREMENT md_tz_soll_zyl9 "Soll-TZ" SWORD FORMULA_0102 0 0.0 -50.0 60.0 READ_WRITE ECU_ADDRESS 0x3FC1CE /end MEASUREMENT
/begin MEASUREMENT md_tz_st "TZ-Status" UWORD FORMULA_0010 0 0.0 0.0 65535.0 READ_WRITE ECU_ADDRESS 0x3FC1BC /end MEASUREMENT
/begin MEASUREMENT md_v_max_delta "Regeldifferenz gefiltert" SWORD FORMULA_0076 0 0.0 -80.0 360.0 READ_WRITE ECU_ADDRESS 0x3FC204 /end MEASUREMENT
/begin MEASUREMENT md_vbegr_b0 "Reglerfaktor b0" ULONG FORMULA_0800 0 0.0 0.0 4294967.295 READ_WRITE ECU_ADDRESS 0x3FC1F8 /end MEASUREMENT
/begin MEASUREMENT md_vbegr_b1 "Reglerfaktor b1" ULONG FORMULA_0801 0 0.0 0.0 -4294967.295 READ_WRITE ECU_ADDRESS 0x3FC1FC /end MEASUREMENT
/begin MEASUREMENT md_vbegr_b2 "Reglerfaktor b2" ULONG FORMULA_0800 0 0.0 0.0 4294967.295 READ_WRITE ECU_ADDRESS 0x3FC200 /end MEASUREMENT
/begin MEASUREMENT md_vbegr_t "Timer Geschwindigkeitsbegrenzung" UWORD FORMULA_0109 0 0.0 0.0 325.0 READ_WRITE ECU_ADDRESS 0x3FC1E0 /end MEASUREMENT
/begin MEASUREMENT md_verbr_fzg "Verbraucheroffset Fzg" SWORD FORMULA_0009 0 0.0 -100.0 1000.0 READ_WRITE ECU_ADDRESS 0x3FC04C /end MEASUREMENT
/begin MEASUREMENT md_verbraucher "Verbraucher" SWORD FORMULA_0009 0 0.0 -100.0 1000.0 READ_WRITE ECU_ADDRESS 0x3FC04A /end MEASUREMENT
/begin MEASUREMENT md_zw_la_ist_delta "Lambda-Delta" SWORD FORMULA_0102 0 0.0 -50.0 60.0 READ_WRITE ECU_ADDRESS 0x3FC082 /end MEASUREMENT
/begin MEASUREMENT md_zw_opt "opt. Zündwinkel" SWORD FORMULA_0102 0 0.0 -50.0 60.0 READ_WRITE ECU_ADDRESS 0x3FC078 /end MEASUREMENT
/begin MEASUREMENT md_zw_opt_e2 "Zuendwinkelbestwert Ebene 2" SWORD FORMULA_0102 0 0.0 -50.0 60.0 READ_WRITE ECU_ADDRESS 0x3FC890 /end MEASUREMENT
/begin MEASUREMENT md_zw_opt_rg "opt. ZW mit RG" SWORD FORMULA_0102 0 0.0 -50.0 60.0 READ_WRITE ECU_ADDRESS 0x3FC07C /end MEASUREMENT
/begin MEASUREMENT md_zw_opt_rg_tmot "opt. ZW mit RG Tmot" SWORD FORMULA_0102 0 0.0 -50.0 60.0 READ_WRITE ECU_ADDRESS 0x3FC080 /end MEASUREMENT
/begin MEASUREMENT md_zw_opt_rg_tmot_la "opt. ZW mit RG Tmot LA" SWORD FORMULA_0102 0 0.0 -50.0 60.0 READ_WRITE ECU_ADDRESS 0x3FC084 /end MEASUREMENT
/begin MEASUREMENT md_zw_rg_delta "RG-Delta" SWORD FORMULA_0102 0 0.0 -50.0 60.0 READ_WRITE ECU_ADDRESS 0x3FC07A /end MEASUREMENT
/begin MEASUREMENT md_zw_tmot_delta "Tmot-Delta" SWORD FORMULA_0102 0 0.0 -50.0 60.0 READ_WRITE ECU_ADDRESS 0x3FC07E /end MEASUREMENT
/begin MEASUREMENT pctrl_proz "Prozessueberwachung" UWORD FORMULA_0010 0 0.0 0.0 65535.0 READ_WRITE ECU_ADDRESS 0x3FC29E /end MEASUREMENT
/begin MEASUREMENT pctrl_proz_err "Fehler Prozessueberwachung" UWORD FORMULA_0010 0 0.0 0.0 65535.0 READ_WRITE ECU_ADDRESS 0x3FC2A0 /end MEASUREMENT
/begin MEASUREMENT pctrl_proz_tb "Timerwert Prozess-Ueberwachungszyklus" UBYTE FORMULA_0357 0 0.0 0.0 1.274999976158142 READ_WRITE ECU_ADDRESS 0x3FC299 /end MEASUREMENT
/begin MEASUREMENT pctrl_t_old_ipk "vorheriger Timer Wert aus der IPK" ULONG FORMULA_0000 0 0.0 0.0 4294967295.0 READ_WRITE ECU_ADDRESS 0x3FC294 /end MEASUREMENT
/begin MEASUREMENT pctrl_task "Taskueberwachung" UBYTE FORMULA_0003 0 0.0 0.0 255.0 READ_WRITE ECU_ADDRESS 0x3FC29B /end MEASUREMENT
/begin MEASUREMENT pctrl_task_err "Fehler Taskueberwachung" UBYTE FORMULA_0003 0 0.0 0.0 255.0 READ_WRITE ECU_ADDRESS 0x3FC29C /end MEASUREMENT
/begin MEASUREMENT pctrl_task_tb "Timerwert Task-Ueberwachungszyklus" UBYTE FORMULA_0357 0 0.0 0.0 1.274999976158142 READ_WRITE ECU_ADDRESS 0x3FC298 /end MEASUREMENT
/begin MEASUREMENT pctrl_tout "Timeout Zaehler" UBYTE FORMULA_0358 0 0.0 0.0 2550.0 READ_WRITE ECU_ADDRESS 0x3FC29A /end MEASUREMENT
/begin MEASUREMENT pks_can_alive "PKS-Alive" UBYTE FORMULA_0003 0 0.0 0.0 255.0 READ_WRITE ECU_ADDRESS 0x3FC2A6 /end MEASUREMENT
/begin MEASUREMENT pks_can_ed_tsperr "PKS-Diagosesperrzeit" UWORD FORMULA_0109 0 0.0 0.0 325.0 READ_WRITE ECU_ADDRESS 0x3FC2A4 /end MEASUREMENT
/begin MEASUREMENT pks_can_sw_vers "SW-Vers-PKS" UBYTE FORMULA_0003 0 0.0 0.0 255.0 READ_WRITE ECU_ADDRESS 0x3FC2A9 /end MEASUREMENT
/begin MEASUREMENT pks_can_timeout "PKS-Timeout" UWORD FORMULA_0109 0 0.0 0.0 325.0 READ_WRITE ECU_ADDRESS 0x3FC2A2 /end MEASUREMENT
/begin MEASUREMENT pwg "Erfasster gefilterter relativer Pedalwert" SWORD FORMULA_0001 0 0.0 -10.0 120.0 READ_WRITE ECU_ADDRESS 0x3FC2C4 /end MEASUREMENT
/begin MEASUREMENT pwg_ab_rampe "Abregelrampe im Fehlerfall" UWORD FORMULA_0878 0 0.0 0.0 0.9998999834060669 READ_WRITE ECU_ADDRESS 0x3FC2B4 /end MEASUREMENT
/begin MEASUREMENT pwg_abschalt "Im Fehlerfall Abschaltung durch die Bremse" UBYTE FORMULA_0003 0 0.0 0.0 255.0 READ_WRITE BIT_MASK 0x3 ECU_ADDRESS 0x3FC2B2 /end MEASUREMENT
/begin MEASUREMENT pwg_abschalt_bremse "Status der Sicherheitsabschaltung" UBYTE FORMULA_0876 0 0 0.0 255.0 READ_WRITE BIT_MASK 0x1 ECU_ADDRESS 0x3FC2B2 /end MEASUREMENT
/begin MEASUREMENT pwg_abschalt_sperre "Status der Sicherheitsabschaltung" UBYTE FORMULA_0877 0 0 0.0 255.0 READ_WRITE BIT_MASK 0x2 ECU_ADDRESS 0x3FC2B2 /end MEASUREMENT
/begin MEASUREMENT pwg_begrenz "Durch Bremse begrenzter PWG" UWORD FORMULA_0448 0 0.0 0.0 102.3983993530273 READ_WRITE ECU_ADDRESS 0x3FC2C2 /end MEASUREMENT
/begin MEASUREMENT pwg_bls_st "Bremsenbegrenzungstatus" UBYTE FORMULA_0037 0 0.0 0.0 255.0 READ_WRITE ECU_ADDRESS 0x3FC2AE /end MEASUREMENT
/begin MEASUREMENT pwg_bls_st_begrenzung "PWG_BLS-Status" UBYTE FORMULA_0869 0 0 0.0 255.0 READ_WRITE BIT_MASK 0x80 ECU_ADDRESS 0x3FC2AE /end MEASUREMENT
/begin MEASUREMENT pwg_bls_st_berganfahren "PWG_BLS-Status" UBYTE FORMULA_0867 0 0 0.0 255.0 READ_WRITE BIT_MASK 0x2 ECU_ADDRESS 0x3FC2AE /end MEASUREMENT
/begin MEASUREMENT pwg_bls_st_druckerfassung "PWG_BLS-Status" UBYTE FORMULA_0866 0 0 0.0 255.0 READ_WRITE BIT_MASK 0x1 ECU_ADDRESS 0x3FC2AE /end MEASUREMENT
/begin MEASUREMENT pwg_bls_st_v_begrenzung "PWG_BLS-Status" UBYTE FORMULA_0868 0 0 0.0 255.0 READ_WRITE BIT_MASK 0x4 ECU_ADDRESS 0x3FC2AE /end MEASUREMENT
/begin MEASUREMENT pwg_bls_t_brp "Begrenzungsverzoegerung-Bremsdruck" UBYTE FORMULA_0584 0 0.0 0.0 1275.0 READ_WRITE ECU_ADDRESS 0x3FC2AF /end MEASUREMENT
/begin MEASUREMENT pwg_bls_t_v "Begrenzungsverzoegerung-Geschwindigkeit" UBYTE FORMULA_0584 0 0.0 0.0 1275.0 READ_WRITE ECU_ADDRESS 0x3FC2B0 /end MEASUREMENT
/begin MEASUREMENT pwg_err_e2 "Anzahl der Vergleichs-Fehler" UBYTE FORMULA_0003 0 0.0 0.0 255.0 READ_WRITE ECU_ADDRESS 0x3FC8BA /end MEASUREMENT
/begin MEASUREMENT pwg_filter "Gefilterter Messwert der Pedalwerterfassung" UWORD FORMULA_0448 0 0.0 0.0 102.3983993530273 READ_WRITE ECU_ADDRESS 0x3FC2C0 /end MEASUREMENT
/begin MEASUREMENT pwg_max_diff "Maximal zulaessige Differenz der Pedalwertgeber" SWORD FORMULA_0001 0 0.0 0.0 120.0 READ_WRITE ECU_ADDRESS 0x3FC2B6 /end MEASUREMENT
/begin MEASUREMENT pwg_mode_ign "redundanter Ausgabezustand der Pedalwertgebererfassung" UBYTE FORMULA_0249 0 0.0 0.0 255.0 READ_WRITE ECU_ADDRESS 0x3FE75D /end MEASUREMENT
/begin MEASUREMENT pwg_soll_2gang_fak "Faktor 2. Ganganfahrt" UWORD FORMULA_0073 0 0.0 0.0 4.0 READ_WRITE ECU_ADDRESS 0x3FC2CA /end MEASUREMENT
/begin MEASUREMENT pwg_soll_2gang_st "Status 2. Ganganfahrt" UBYTE FORMULA_0879 0 0.0 0.0 255.0 READ_WRITE ECU_ADDRESS 0x3FC2C8 /end MEASUREMENT
/begin MEASUREMENT pwg_soll_e2 "Ausgegebener Pedalwert Ebene 2" SWORD FORMULA_0001 0 0.0 -10.0 120.0 READ_WRITE ECU_ADDRESS 0x3FC8B8 /end MEASUREMENT
/begin MEASUREMENT pwg_st_ed "Fehler-Status der PWG-Erfassung" UBYTE FORMULA_0003 0 0.0 0.0 255.0 READ_WRITE BIT_MASK 0x3F ECU_ADDRESS 0x3FC2B1 /end MEASUREMENT
/begin MEASUREMENT pwg_st_ed_kanal_fehler "Fehler-Status der PWG-Erfassung" UBYTE FORMULA_0871 0 0 0.0 255.0 READ_WRITE BIT_MASK 0x2 ECU_ADDRESS 0x3FC2B1 /end MEASUREMENT
/begin MEASUREMENT pwg_st_ed_kanal_filter "Fehler-Status der PWG-Erfassung" UBYTE FORMULA_0870 0 0 0.0 255.0 READ_WRITE BIT_MASK 0x1 ECU_ADDRESS 0x3FC2B1 /end MEASUREMENT
/begin MEASUREMENT pwg_st_ed_pwg1_fehler "Fehler-Status der PWG-Erfassung" UBYTE FORMULA_0873 0 0 0.0 255.0 READ_WRITE BIT_MASK 0x8 ECU_ADDRESS 0x3FC2B1 /end MEASUREMENT
/begin MEASUREMENT pwg_st_ed_pwg2_fehler "Fehler-Status der PWG-Erfassung" UBYTE FORMULA_0872 0 0 0.0 255.0 READ_WRITE BIT_MASK 0x4 ECU_ADDRESS 0x3FC2B1 /end MEASUREMENT
/begin MEASUREMENT pwg_st_ed_uext1_fehler "Fehler-Status der PWG-Erfassung" UBYTE FORMULA_0875 0 0 0.0 255.0 READ_WRITE BIT_MASK 0x20 ECU_ADDRESS 0x3FC2B1 /end MEASUREMENT
/begin MEASUREMENT pwg_st_ed_uext2_fehler "Fehler-Status der PWG-Erfassung" UBYTE FORMULA_0874 0 0 0.0 255.0 READ_WRITE BIT_MASK 0x10 ECU_ADDRESS 0x3FC2B1 /end MEASUREMENT
/begin MEASUREMENT pwg1_a0_zaehler "Zaehlervariable fuer die Aufwaertsadaption 1" UBYTE FORMULA_0003 0 0.0 0.0 255.0 READ_WRITE ECU_ADDRESS 0x3FC2C6 /end MEASUREMENT
/begin MEASUREMENT pwg1_ad "Eingelesener AD-Wert fuer Pedalwertgeber 1" SWORD FORMULA_0114 0 0.0 0.0 1023.0 READ_WRITE ECU_ADDRESS 0x3FC2B8 /end MEASUREMENT
/begin MEASUREMENT pwg1_roh "Relativer Rohwert PWG1" SWORD FORMULA_0001 0 0.0 -10.0 120.0 READ_WRITE ECU_ADDRESS 0x3FC2BC /end MEASUREMENT
/begin MEASUREMENT pwg2_a0_zaehler "Zaehlervariable fuer die Aufwaertsadaption 2" UBYTE FORMULA_0003 0 0.0 0.0 255.0 READ_WRITE ECU_ADDRESS 0x3FC2C7 /end MEASUREMENT
/begin MEASUREMENT pwg2_ad "Eingelesener AD-Wert fuer Pedalwertgeber 2" SWORD FORMULA_0114 0 0.0 0.0 1023.0 READ_WRITE ECU_ADDRESS 0x3FC2BA /end MEASUREMENT
/begin MEASUREMENT pwg2_roh "Relativer Rohwert PWG2" SWORD FORMULA_0001 0 0.0 -10.0 120.0 READ_WRITE ECU_ADDRESS 0x3FC2BE /end MEASUREMENT
/begin MEASUREMENT qadc_check_ccw_adr "CCW Check Adresse des Fehlers" UBYTE FORMULA_0037 0 0.0 0.0 255.0 READ_WRITE ECU_ADDRESS 0x3FC2CE /end MEASUREMENT
/begin MEASUREMENT qadc_check_ccw_st "CCW Check Status" UBYTE FORMULA_0359 0 0.0 0.0 255.0 READ_WRITE ECU_ADDRESS 0x3FC2CC /end MEASUREMENT
/begin MEASUREMENT qadc_err_cnt "CCW Check Fehlerzaehler" UBYTE FORMULA_0037 0 0.0 0.0 255.0 READ_WRITE ECU_ADDRESS 0x3FC2CD /end MEASUREMENT
/begin MEASUREMENT ram_chk_freq "Ueberprufeungsfreuquenz RAM" UWORD FORMULA_0360 0 0.0 0.0 655.3499755859375 READ_WRITE ECU_ADDRESS 0x3FC2D8 /end MEASUREMENT
/begin MEASUREMENT ram_chk_rptr "aktueller RAM_CHK Zeiger" ULONG FORMULA_0000 0 0.0 0.0 4294967295.0 READ_WRITE ECU_ADDRESS 0x3FC2D4 /end MEASUREMENT
/begin MEASUREMENT time_rel_delta "Delta time_rel seit Start" ULONG FORMULA_0988 0 0.0 0.0 4294967295.0 READ_WRITE ECU_ADDRESS 0x3FC558 /end MEASUREMENT
/begin MEASUREMENT time_rel_motor_start "Relativzeit bei Motorstart" ULONG FORMULA_0145 0 0.0 0.0 71582788.25 READ_WRITE ECU_ADDRESS 0x3FC55C /end MEASUREMENT
/begin MEASUREMENT time_rel_obd_st "Steuervariable fuer Diagnose" UBYTE FORMULA_0986 0 0.0 0.0 255.0 READ_WRITE ECU_ADDRESS 0x3FC554 /end MEASUREMENT
/begin MEASUREMENT time_rel_st "Statusvariable" UBYTE FORMULA_0987 0 0.0 0.0 255.0 READ_WRITE ECU_ADDRESS 0x3FC555 /end MEASUREMENT
/begin MEASUREMENT tmot_ad "Eingelesener Spannungswert fuer Kuehlwassertemperatur" SWORD FORMULA_0114 0 0.0 0.0 1023.0 READ_WRITE ECU_ADDRESS 0x3FC56C /end MEASUREMENT
/begin MEASUREMENT tmot_diag_grad_filter "Gradientenuberwachung ueber 100ms" SWORD FORMULA_0975 0 0.0 -50.0 170.0 READ_WRITE ECU_ADDRESS 0x3FC570 /end MEASUREMENT
/begin MEASUREMENT tmot_dk "Motortemperatur an der Drosselklappe" SWORD FORMULA_0023 0 0.0 -50.0 170.0 READ_WRITE ECU_ADDRESS 0x3FC5BA /end MEASUREMENT
/begin MEASUREMENT tmot_e2 "Motortemperatur-Kuehlwasser Ebene 2" SWORD FORMULA_0023 0 0.0 -50.0 170.0 READ_WRITE ECU_ADDRESS 0x3FC8F8 /end MEASUREMENT
/begin MEASUREMENT tmot_err_e2 "Anzahl der Vergleichs-Fehler" UBYTE FORMULA_0003 0 0.0 0.0 255.0 READ_WRITE ECU_ADDRESS 0x3FC8FC /end MEASUREMENT
/begin MEASUREMENT tmot_filter "Gefilterter Messwert der Kuehlwassertemperatur" SWORD FORMULA_0975 0 0.0 -50.0 170.0 READ_WRITE ECU_ADDRESS 0x3FC572 /end MEASUREMENT
/begin MEASUREMENT tmot_modell_delta "Abweichung Modell-Messwert" SWORD FORMULA_0074 0 0.0 -1000.0 1000.0 READ_WRITE ECU_ADDRESS 0x3FC586 /end MEASUREMENT
/begin MEASUREMENT tmot_modell_f_kw "Faktor Kuehlwassereinfluss" UWORD FORMULA_0073 0 0.0 0.0 4.0 READ_WRITE ECU_ADDRESS 0x3FC584 /end MEASUREMENT
/begin MEASUREMENT tmot_modell_f_therm "Faktor Thermostateinfluss" UWORD FORMULA_0073 0 0.0 0.0 4.0 READ_WRITE ECU_ADDRESS 0x3FC582 /end MEASUREMENT
/begin MEASUREMENT tmot_modell_lam_ist_mw "Begrenztes IST-Lambda" UWORD FORMULA_0025 0 0.0 0.0 3.999000072479248 READ_WRITE ECU_ADDRESS 0x3FC58A /end MEASUREMENT
/begin MEASUREMENT tmot_modell_ml_wicht "Gewichtete Gesamtluftmasse" SWORD FORMULA_0103 0 0.0 -100.0 1400.0 READ_WRITE ECU_ADDRESS 0x3FC588 /end MEASUREMENT
/begin MEASUREMENT tmot_modell_st "TMOT_MODELL-Status" UBYTE FORMULA_0037 0 0.0 0.0 255.0 READ_WRITE ECU_ADDRESS 0x3FC574 /end MEASUREMENT
/begin MEASUREMENT tmot_modell_st_ml_wicht "TMOT_MODELL-Status" UBYTE FORMULA_0992 0 0 0.0 255.0 READ_WRITE BIT_MASK 0x1 ECU_ADDRESS 0x3FC574 /end MEASUREMENT
/begin MEASUREMENT tmot_modell_temp_kraft "Gefilterter Kraftstoffenergieeintrag" SWORD FORMULA_0074 0 0.0 -1000.0 1000.0 READ_WRITE ECU_ADDRESS 0x3FC578 /end MEASUREMENT
/begin MEASUREMENT tmot_modell_temp_kraft_roh "Ungefilterter Kraftstoffenergieeintrag" SWORD FORMULA_0074 0 0.0 -1000.0 1000.0 READ_WRITE ECU_ADDRESS 0x3FC576 /end MEASUREMENT
/begin MEASUREMENT tmot_modell_temp_kuehler "Gefilterter Kuehlsystemenergieabtrag" SWORD FORMULA_0074 0 0.0 -1000.0 1000.0 READ_WRITE ECU_ADDRESS 0x3FC580 /end MEASUREMENT
/begin MEASUREMENT tmot_modell_temp_kuehler_roh "Ungefilterter Kuehlsystemenergieabtrag" SWORD FORMULA_0074 0 0.0 -1000.0 1000.0 READ_WRITE ECU_ADDRESS 0x3FC57E /end MEASUREMENT
/begin MEASUREMENT tmot_modell_tumg "Gefilterter Umgebungsenergieabtrag" SWORD FORMULA_0074 0 0.0 -1000.0 1000.0 READ_WRITE ECU_ADDRESS 0x3FC57C /end MEASUREMENT
/begin MEASUREMENT tmot_modell_tumg_roh "Ungefilterter Umgebungsenergieabtrag" SWORD FORMULA_0074 0 0.0 -1000.0 1000.0 READ_WRITE ECU_ADDRESS 0x3FC57A /end MEASUREMENT
/begin MEASUREMENT tmot_obd_delta "Delta OBD-Kuehlwassertemperatur" SWORD FORMULA_0074 0 0.0 -1000.0 1000.0 READ_WRITE ECU_ADDRESS 0x3FC5B8 /end MEASUREMENT
/begin MEASUREMENT tmot_obd_diff_t_delta "Max. Zeit in der maximale Messwert-Modell-Differenz ueberschritten" UWORD FORMULA_0071 0 0.0 0.0 6553.5 READ_WRITE ECU_ADDRESS 0x3FC5A0 /end MEASUREMENT
/begin MEASUREMENT tmot_obd_diff_t_delta_io "Zeit Messwert-Modell-Differenz o.k." UWORD FORMULA_0071 0 0.0 0.0 6553.5 READ_WRITE ECU_ADDRESS 0x3FC5A2 /end MEASUREMENT
/begin MEASUREMENT tmot_obd_diff_t_delta_nio "Zeit Messwert-Modell_Differenz nicht o.k." UWORD FORMULA_0071 0 0.0 0.0 6553.5 READ_WRITE ECU_ADDRESS 0x3FC5A4 /end MEASUREMENT
/begin MEASUREMENT tmot_obd_max "Max. OBD-Kuehlwassertemperatur" SWORD FORMULA_0023 0 0.0 -50.0 170.0 READ_WRITE ECU_ADDRESS 0x3FC5B6 /end MEASUREMENT
/begin MEASUREMENT tmot_obd_min "Max. OBD-Kuehlwassertemperatur" SWORD FORMULA_0023 0 0.0 -50.0 170.0 READ_WRITE ECU_ADDRESS 0x3FC5B4 /end MEASUREMENT
/begin MEASUREMENT tmot_obd_ml_ges_int "Integral der Luftmasse" ULONG FORMULA_1001 0 0.0 0.0 42949672.95 READ_WRITE ECU_ADDRESS 0x3FC590 /end MEASUREMENT
/begin MEASUREMENT tmot_obd_ml_ges_mw "Lastmittelwert seit Start" SWORD FORMULA_0103 0 0.0 -100.0 1400.0 READ_WRITE ECU_ADDRESS 0x3FC598 /end MEASUREMENT
/begin MEASUREMENT tmot_obd_ml_ges_time "Zeitdauer der Integration" ULONG FORMULA_0452 0 0.0 0.0 429496729.5 READ_WRITE ECU_ADDRESS 0x3FC594 /end MEASUREMENT
/begin MEASUREMENT tmot_obd_modell_abw "Differenz Messwert-Modell" SLONG FORMULA_1002 0 0.0 -1000.0 1000.0 READ_WRITE ECU_ADDRESS 0x3FC59C /end MEASUREMENT
/begin MEASUREMENT tmot_obd_modell_delta "Delta OBD-Modelltemperatur" SLONG FORMULA_1002 0 0.0 -1000.0 1000.0 READ_WRITE ECU_ADDRESS 0x3FC5B0 /end MEASUREMENT
/begin MEASUREMENT tmot_obd_modell_max "Max. OBD-Modelltemperatur" SLONG FORMULA_0343 0 0.0 -50.0 170.0 READ_WRITE ECU_ADDRESS 0x3FC5AC /end MEASUREMENT
/begin MEASUREMENT tmot_obd_modell_min "Max. OBD-Modelltemperatur" SLONG FORMULA_0343 0 0.0 -50.0 170.0 READ_WRITE ECU_ADDRESS 0x3FC5A8 /end MEASUREMENT
/begin MEASUREMENT tmot_obd_st "TMOT_OBD-Status" UBYTE FORMULA_0037 0 0.0 0.0 255.0 READ_WRITE ECU_ADDRESS 0x3FC58C /end MEASUREMENT
/begin MEASUREMENT tmot_obd_st_block_sperre "TMOT_OBD-Status" UBYTE FORMULA_0996 0 0 0.0 255.0 READ_WRITE BIT_MASK 0x8 ECU_ADDRESS 0x3FC58C /end MEASUREMENT
/begin MEASUREMENT tmot_obd_st_fehlerz_sperre "TMOT_OBD-Status" UBYTE FORMULA_0995 0 0 0.0 255.0 READ_WRITE BIT_MASK 0x4 ECU_ADDRESS 0x3FC58C /end MEASUREMENT
/begin MEASUREMENT tmot_obd_st_haengt_nicht "TMOT_OBD-Status" UBYTE FORMULA_0998 0 0 0.0 255.0 READ_WRITE BIT_MASK 0x20 ECU_ADDRESS 0x3FC58C /end MEASUREMENT
/begin MEASUREMENT tmot_obd_st_init "TMOT_OBD-Status" UBYTE FORMULA_1000 0 0 0.0 255.0 READ_WRITE BIT_MASK 0x80 ECU_ADDRESS 0x3FC58C /end MEASUREMENT
/begin MEASUREMENT tmot_obd_st_ml_sperre "TMOT_OBD-Status" UBYTE FORMULA_0993 0 0 0.0 255.0 READ_WRITE BIT_MASK 0x1 ECU_ADDRESS 0x3FC58C /end MEASUREMENT
/begin MEASUREMENT tmot_obd_st_plausibel "TMOT_OBD-Status" UBYTE FORMULA_0997 0 0 0.0 255.0 READ_WRITE BIT_MASK 0x10 ECU_ADDRESS 0x3FC58C /end MEASUREMENT
/begin MEASUREMENT tmot_obd_st_sa_sperre "TMOT_OBD-Status" UBYTE FORMULA_0994 0 0 0.0 255.0 READ_WRITE BIT_MASK 0x2 ECU_ADDRESS 0x3FC58C /end MEASUREMENT
/begin MEASUREMENT tmot_obd_st_thermo_ok "TMOT_OBD-Status" UBYTE FORMULA_0999 0 0 0.0 255.0 READ_WRITE BIT_MASK 0x40 ECU_ADDRESS 0x3FC58C /end MEASUREMENT
/begin MEASUREMENT tmot_roh "Ungefilterter Messwert der Kuehlwassertemperatur" SWORD FORMULA_0975 0 0.0 -50.0 170.0 READ_WRITE ECU_ADDRESS 0x3FC56E /end MEASUREMENT
/begin MEASUREMENT toel_aufwaerm "Neue Soll-Oeltemperatur (vor Begrenzung)" SWORD FORMULA_0023 0 0.0 -50.0 170.0 READ_WRITE ECU_ADDRESS 0x3FC5DA /end MEASUREMENT
/begin MEASUREMENT toel_dt "Summe Toel-Gradient" SWORD FORMULA_1011 0 0.0 -3.0 3.0 READ_WRITE ECU_ADDRESS 0x3FC5C4 /end MEASUREMENT
/begin MEASUREMENT toel_dt_dn "Toel-Gradient aus dn" SWORD FORMULA_1011 0 0.0 -3.0 3.0 READ_WRITE ECU_ADDRESS 0x3FC5C6 /end MEASUREMENT
/begin MEASUREMENT toel_dt_n "Toel-Gradient aus n" SWORD FORMULA_1011 0 0.0 -3.0 3.0 READ_WRITE ECU_ADDRESS 0x3FC5C8 /end MEASUREMENT
/begin MEASUREMENT toel_dt_tmot "Toel-Gradient aus tmot" SWORD FORMULA_1011 0 0.0 -3.0 3.0 READ_WRITE ECU_ADDRESS 0x3FC5CA /end MEASUREMENT
/begin MEASUREMENT toel_dt_wanne "Toel-Gradient aus toel_wanne" SWORD FORMULA_1011 0 0.0 -3.0 3.0 READ_WRITE ECU_ADDRESS 0x3FC5CC /end MEASUREMENT
/begin MEASUREMENT toel_e2 "Oeltemperatur Ebene 2" SWORD FORMULA_0023 0 0.0 -50.0 170.0 READ_WRITE ECU_ADDRESS 0x3FC900 /end MEASUREMENT
/begin MEASUREMENT toel_e2_err "Anzahl der Vergleichs-Fehler" UBYTE FORMULA_0003 0 0.0 0.0 255.0 READ_WRITE ECU_ADDRESS 0x3FC8FE /end MEASUREMENT
/begin MEASUREMENT toel_kalt "begrenzte Oeltemperatur aus Aufheizmodell" SLONG FORMULA_1010 0 0.0 -50.0 150.0 READ_WRITE ECU_ADDRESS 0x3FC5D0 /end MEASUREMENT
/begin MEASUREMENT toel_kalt_neu "Oeltemperatur aus Aufheizmodell mit Toel-Gradient" SLONG FORMULA_1010 0 0.0 -50.0 150.0 READ_WRITE ECU_ADDRESS 0x3FC5C0 /end MEASUREMENT
/begin MEASUREMENT toel_n_filt "PT1-gefilterte Motordrehzahl" SWORD FORMULA_0006 0 0.0 0.0 10000.0 READ_WRITE ECU_ADDRESS 0x3FC5CE /end MEASUREMENT
/begin MEASUREMENT toel_save_abst "Oeltemperatur speichern bei Abstellen" UBYTE FORMULA_0003 0 0.0 0.0 255.0 READ_WRITE ECU_ADDRESS 0x3FC5D4 /end MEASUREMENT
/begin MEASUREMENT toel_start "Oeltemperatur im Start" SWORD FORMULA_0023 0 0.0 -50.0 170.0 READ_WRITE ECU_ADDRESS 0x3FC5D6 /end MEASUREMENT
/begin MEASUREMENT toel_warm "Oeltemperatur aus Heissmodell" SWORD FORMULA_0023 0 0.0 -50.0 170.0 READ_WRITE ECU_ADDRESS 0x3FC5D8 /end MEASUREMENT
/begin COMPU_METHOD FORMULA_0000 "FORMULA_0000" RAT_FUNC "%7.0" "-" COEFFS 0 1 0 0 0 1 /end COMPU_METHOD
/begin COMPU_METHOD FORMULA_0001 "FORMULA_0001" RAT_FUNC "%6.1" "%" COEFFS 0 10.0 0.0 0 0.0 1.0 /end COMPU_METHOD
/begin COMPU_METHOD FORMULA_0003 "FORMULA_0003" RAT_FUNC "%3.0" "-" COEFFS 0 1 0 0 0 1 /end COMPU_METHOD
/begin COMPU_METHOD FORMULA_0006 "FORMULA_0006" RAT_FUNC "%5.0" "Upm" COEFFS 0 1 0 0 0 1 /end COMPU_METHOD
/begin COMPU_METHOD FORMULA_0007 "FORMULA_0007" RAT_FUNC "%8.3" "-" COEFFS 0 10000.0 0.0 0 0.0 1.0 /end COMPU_METHOD
/begin COMPU_METHOD FORMULA_0008 "FORMULA_0008" RAT_FUNC "%6.1" "V" COEFFS 0 10.0 0.0 0 0.0 1.0 /end COMPU_METHOD
/begin COMPU_METHOD FORMULA_0009 "FORMULA_0009" RAT_FUNC "%6.1" "Nm" COEFFS 0 10.0 0.0 0 0.0 1.0 /end COMPU_METHOD
/begin COMPU_METHOD FORMULA_0010 "FORMULA_0010" RAT_FUNC "%5.0" "-" COEFFS 0 1 0 0 0 1 /end COMPU_METHOD
/begin COMPU_METHOD FORMULA_0021 "FORMULA_0021" RAT_FUNC "%7.2" "s" COEFFS 0 100.0 0.0 0 0.0 1.0 /end COMPU_METHOD
/begin COMPU_METHOD FORMULA_0023 "FORMULA_0023" RAT_FUNC "%6.1" "°C" COEFFS 0 10.0 2732.0 0 0.0 1.0 /end COMPU_METHOD
/begin COMPU_METHOD FORMULA_0024 "FORMULA_0024" RAT_FUNC "%9.4" "-" COEFFS 0 32768.0 0.0 0 0.0 1.0 /end COMPU_METHOD
/begin COMPU_METHOD FORMULA_0025 "FORMULA_0025" RAT_FUNC "%8.3" "-" COEFFS 0 16384.0 0.0 0 0.0 1.0 /end COMPU_METHOD
/begin COMPU_METHOD FORMULA_0037 "FORMULA_0037" RAT_FUNC "%5.2" "-" COEFFS 0 1 0 0 0 1 /end COMPU_METHOD
/begin COMPU_METHOD FORMULA_0071 "FORMULA_0071" RAT_FUNC "%6.1" "s" COEFFS 0 10.0 0.0 0 0.0 1.0 /end COMPU_METHOD
/begin COMPU_METHOD FORMULA_0073 "FORMULA_0073" RAT_FUNC "%8.3" "-" COEFFS 0 1024.0 0.0 0 0.0 1.0 /end COMPU_METHOD
/begin COMPU_METHOD FORMULA_0074 "FORMULA_0074" RAT_FUNC "%6.1" "Kelvin" COEFFS 0 10.0 0.0 0 0.0 1.0 /end COMPU_METHOD
/begin COMPU_METHOD FORMULA_0076 "FORMULA_0076" RAT_FUNC "%6.1" "km/h" COEFFS 0 16.0 0.0 0 0.0 1.0 /end COMPU_METHOD
/begin COMPU_METHOD FORMULA_0102 "FORMULA_0102" RAT_FUNC "%6.1" "°KW" COEFFS 0 10.0 0.0 0 0.0 1.0 /end COMPU_METHOD
/begin COMPU_METHOD FORMULA_0103 "FORMULA_0103" RAT_FUNC "%6.1" "kg/h" COEFFS 0 10.0 0.0 0 0.0 1.0 /end COMPU_METHOD
/begin COMPU_METHOD FORMULA_0104 "FORMULA_0104" RAT_FUNC "%6.1" "mg/asp" COEFFS 0 10.0 0.0 0 0.0 1.0 /end COMPU_METHOD
/begin COMPU_METHOD FORMULA_0105 "FORMULA_0105" RAT_FUNC "%5.0" "Upm/s" COEFFS 0 1 0 0 0 1 /end COMPU_METHOD
/begin COMPU_METHOD FORMULA_0109 "FORMULA_0109" RAT_FUNC "%7.2" "s" COEFFS 0 200.0 0.0 0 0.0 1.0 /end COMPU_METHOD
/begin COMPU_METHOD FORMULA_0114 "FORMULA_0114" RAT_FUNC "%5.0" "digit" COEFFS 0 1 0 0 0 1 /end COMPU_METHOD
/begin COMPU_METHOD FORMULA_0129 "FORMULA_0129" RAT_FUNC "%3.0" "bar" COEFFS 0 1 0 0 0 1 /end COMPU_METHOD
/begin COMPU_METHOD FORMULA_0132 "FORMULA_0132" RAT_FUNC "%7.2" "Grad" COEFFS 0 22.75312855517634 0.0 0 0.0 1.0 /end COMPU_METHOD
/begin COMPU_METHOD FORMULA_0133 "FORMULA_0133" RAT_FUNC "%7.2" "Grad/s" COEFFS 0 22.75312855517634 0.0 0 0.0 1.0 /end COMPU_METHOD
/begin COMPU_METHOD FORMULA_0135 "FORMULA_0135" RAT_FUNC "%3.0" ".Gang" COEFFS 0 1 0 0 0 1 /end COMPU_METHOD
/begin COMPU_METHOD FORMULA_0145 "FORMULA_0145" RAT_FUNC "%9.2" "min" COEFFS 0 60.0 0.0 0 0.0 1.0 /end COMPU_METHOD
/begin COMPU_METHOD FORMULA_0147 "FORMULA_0147" RAT_FUNC "%9.2" "s" COEFFS 0 100.0 0.0 0 0.0 1.0 /end COMPU_METHOD
/begin COMPU_METHOD FORMULA_0249 "FORMULA_0249" TAB_VERB "%3.0" "-" COMPU_TAB_REF FORMULA_0249_VTAB /end COMPU_METHOD
/begin COMPU_METHOD FORMULA_0250 "FORMULA_0250" RAT_FUNC "%8.3" "V" COEFFS 0 204.8 0.0 0 0.0 1.0 /end COMPU_METHOD
/begin COMPU_METHOD FORMULA_0252 "FORMULA_0252" TAB_VERB "%3.0" "-" COMPU_TAB_REF FORMULA_0252_VTAB /end COMPU_METHOD
/begin COMPU_METHOD FORMULA_0342 "FORMULA_0342" RAT_FUNC "%7.2" "°C" COEFFS 0 20.0 5463.0 0 0.0 1.0 /end COMPU_METHOD
/begin COMPU_METHOD FORMULA_0343 "FORMULA_0343" RAT_FUNC "%11.4" "°C" COEFFS 0 10240.0 2797056.0 0 0.0 1.0 /end COMPU_METHOD
/begin COMPU_METHOD FORMULA_0357 "FORMULA_0357" RAT_FUNC "%5.2" "s" COEFFS 0 200.0 0.0 0 0.0 1.0 /end COMPU_METHOD
/begin COMPU_METHOD FORMULA_0358 "FORMULA_0358" RAT_FUNC "%3.0" "ms" COEFFS 0 0.1 0.0 0 0.0 1.0 /end COMPU_METHOD
/begin COMPU_METHOD FORMULA_0359 "FORMULA_0359" TAB_VERB "%5.2" "-" COMPU_TAB_REF FORMULA_0359_VTAB /end COMPU_METHOD
/begin COMPU_METHOD FORMULA_0360 "FORMULA_0360" RAT_FUNC "%7.2" "kHz" COEFFS 0 100.0 0.0 0 0.0 1.0 /end COMPU_METHOD
/begin COMPU_METHOD FORMULA_0361 "FORMULA_0361" RAT_FUNC "%3.0" "us" COEFFS 0 1 0 0 0 1 /end COMPU_METHOD
/begin COMPU_METHOD FORMULA_0362 "FORMULA_0362" TAB_VERB "%5.2" "-" COMPU_TAB_REF FORMULA_0362_VTAB /end COMPU_METHOD
/begin COMPU_METHOD FORMULA_0368 "FORMULA_0368" TAB_VERB "%5.2" "-" COMPU_TAB_REF FORMULA_0368_VTAB /end COMPU_METHOD
/begin COMPU_METHOD FORMULA_0437 "FORMULA_0437" RAT_FUNC "%6.1" "%" COEFFS 0 327.68 0.0 0 0.0 1.0 /end COMPU_METHOD
/begin COMPU_METHOD FORMULA_0438 "FORMULA_0438" TAB_VERB "%3.0" "-" COMPU_TAB_REF FORMULA_0438_VTAB /end COMPU_METHOD
/begin COMPU_METHOD FORMULA_0448 "FORMULA_0448" RAT_FUNC "%8.3" "%" COEFFS 0 640.0 0.0 0 0.0 1.0 /end COMPU_METHOD
/begin COMPU_METHOD FORMULA_0452 "FORMULA_0452" RAT_FUNC "%8.1" "s" COEFFS 0 10.0 0.0 0 0.0 1.0 /end COMPU_METHOD
/begin COMPU_METHOD FORMULA_0455 "FORMULA_0455" RAT_FUNC "%5.2" "s" COEFFS 0 0 2.56 0 1 0 /end COMPU_METHOD
/begin COMPU_METHOD FORMULA_0469 "FORMULA_0469" RAT_FUNC "%7.2" "s" COEFFS 0 0 327.67 0 1 0 /end COMPU_METHOD
/begin COMPU_METHOD FORMULA_0470 "FORMULA_0470" RAT_FUNC "%6.3" "s" COEFFS 0 0 1.28 0 1 0 /end COMPU_METHOD
/begin COMPU_METHOD FORMULA_0471 "FORMULA_0471" RAT_FUNC "%4.1" "%" COEFFS 0 10.0 0.0 0 0.0 1.0 /end COMPU_METHOD
/begin COMPU_METHOD FORMULA_0479 "FORMULA_0479" RAT_FUNC "%5.0" ".Gang" COEFFS 0 1 0 0 0 1 /end COMPU_METHOD
/begin COMPU_METHOD FORMULA_0488 "FORMULA_0488" RAT_FUNC "%7.2" "-" COEFFS 0 100.0 0.0 0 0.0 1.0 /end COMPU_METHOD
/begin COMPU_METHOD FORMULA_0492 "FORMULA_0492" RAT_FUNC "%4.1" "s" COEFFS 0 10.0 0.0 0 0.0 1.0 /end COMPU_METHOD
/begin COMPU_METHOD FORMULA_0562 "FORMULA_0562" RAT_FUNC "%5.0" "Nm/s" COEFFS 0 5.e-002 0.0 0 0.0 1.0 /end COMPU_METHOD
/begin COMPU_METHOD FORMULA_0584 "FORMULA_0584" RAT_FUNC "%3.0" "ms" COEFFS 0 0.2 0.0 0 0.0 1.0 /end COMPU_METHOD
/begin COMPU_METHOD FORMULA_0590 "FORMULA_0590" RAT_FUNC "%7.2" "sec" COEFFS 0 200.0 0.0 0 0.0 1.0 /end COMPU_METHOD
/begin COMPU_METHOD FORMULA_0626 "FORMULA_0626" RAT_FUNC "%5.0" "s" COEFFS 0 1 0 0 0 1 /end COMPU_METHOD
/begin COMPU_METHOD FORMULA_0630 "FORMULA_0630" RAT_FUNC "%6.1" "%" COEFFS 0 640.0 0.0 0 0.0 1.0 /end COMPU_METHOD
/begin COMPU_METHOD FORMULA_0681 "FORMULA_0681" RAT_FUNC "%7.2" "s" COEFFS 0 0 6553.5 0 1 0 /end COMPU_METHOD
/begin COMPU_METHOD FORMULA_0706 "FORMULA_0706" RAT_FUNC "%7.2" "min" COEFFS 0 60.0 0.0 0 0.0 1.0 /end COMPU_METHOD
/begin COMPU_METHOD FORMULA_0746 "FORMULA_0746" RAT_FUNC "%5.2" "s" COEFFS 0 0 25.6 0 1 0 /end COMPU_METHOD
/begin COMPU_METHOD FORMULA_0748 "FORMULA_0748" RAT_FUNC "%3.0" "Nm/s" COEFFS 0 1 0 0 0 1 /end COMPU_METHOD
/begin COMPU_METHOD FORMULA_0749 "FORMULA_0749" RAT_FUNC "%4.1" "Nm" COEFFS 0 10.0 0.0 0 0.0 1.0 /end COMPU_METHOD
/begin COMPU_METHOD FORMULA_0755 "FORMULA_0755" RAT_FUNC "%6.1" "Nm/s" COEFFS 0 10.0 0.0 0 0.0 1.0 /end COMPU_METHOD
/begin COMPU_METHOD FORMULA_0757 "FORMULA_0757" RAT_FUNC "%5.2" "-" COEFFS 0 128.0 0.0 0 0.0 1.0 /end COMPU_METHOD
/begin COMPU_METHOD FORMULA_0758 "FORMULA_0758" RAT_FUNC "%6.1" "Nm" COEFFS 0 100.0 0.0 0 0.0 1.0 /end COMPU_METHOD
/begin COMPU_METHOD FORMULA_0759 "FORMULA_0759" RAT_FUNC "%7.2" "Nm/s" COEFFS 0 10.0 0.0 0 0.0 1.0 /end COMPU_METHOD
/begin COMPU_METHOD FORMULA_0760 "FORMULA_0760" RAT_FUNC "%7.2" "10E-4" COEFFS 0 100.0 0.0 0 0.0 1.0 /end COMPU_METHOD
/begin COMPU_METHOD FORMULA_0761 "FORMULA_0761" TAB_VERB "%5.2" "-" COMPU_TAB_REF FORMULA_0761_VTAB /end COMPU_METHOD
/begin COMPU_METHOD FORMULA_0762 "FORMULA_0762" TAB_VERB "%3.0" "-" COMPU_TAB_REF FORMULA_0762_VTAB /end COMPU_METHOD
/begin COMPU_METHOD FORMULA_0763 "FORMULA_0763" RAT_FUNC "%5.2" "1/sec" COEFFS 0 5.12 0.0 0 0.0 1.0 /end COMPU_METHOD
/begin COMPU_METHOD FORMULA_0764 "FORMULA_0764" TAB_VERB "%3.0" "-" COMPU_TAB_REF FORMULA_0764_VTAB /end COMPU_METHOD
/begin COMPU_METHOD FORMULA_0765 "FORMULA_0765" RAT_FUNC "%5.0" "°/sec" COEFFS 0 5.e-002 0.0 0 0.0 1.0 /end COMPU_METHOD
/begin COMPU_METHOD FORMULA_0766 "FORMULA_0766" RAT_FUNC "%7.2" "-" COEFFS 0 128.0 0.0 0 0.0 1.0 /end COMPU_METHOD
/begin COMPU_METHOD FORMULA_0767 "FORMULA_0767" RAT_FUNC "%6.1" "ms" COEFFS 0 10.0 0.0 0 0.0 1.0 /end COMPU_METHOD
/begin COMPU_METHOD FORMULA_0768 "FORMULA_0768" TAB_VERB "%5.2" "-" COMPU_TAB_REF FORMULA_0768_VTAB /end COMPU_METHOD
/begin COMPU_METHOD FORMULA_0769 "FORMULA_0769" TAB_VERB "%5.2" "-" COMPU_TAB_REF FORMULA_0769_VTAB /end COMPU_METHOD
/begin COMPU_METHOD FORMULA_0770 "FORMULA_0770" TAB_VERB "%5.2" "-" COMPU_TAB_REF FORMULA_0770_VTAB /end COMPU_METHOD
/begin COMPU_METHOD FORMULA_0771 "FORMULA_0771" TAB_VERB "%5.2" "-" COMPU_TAB_REF FORMULA_0771_VTAB /end COMPU_METHOD
/begin COMPU_METHOD FORMULA_0772 "FORMULA_0772" TAB_VERB "%5.2" "-" COMPU_TAB_REF FORMULA_0772_VTAB /end COMPU_METHOD
/begin COMPU_METHOD FORMULA_0773 "FORMULA_0773" TAB_VERB "%3.0" "-" COMPU_TAB_REF FORMULA_0773_VTAB /end COMPU_METHOD
/begin COMPU_METHOD FORMULA_0774 "FORMULA_0774" RAT_FUNC "%3.0" "Nm/s" COEFFS 0 0.1 0.0 0 0.0 1.0 /end COMPU_METHOD
/begin COMPU_METHOD FORMULA_0775 "FORMULA_0775" RAT_FUNC "%3.0" "Nm/s" COEFFS 0 -0.1 0.0 0 0.0 1.0 /end COMPU_METHOD
/begin COMPU_METHOD FORMULA_0776 "FORMULA_0776" TAB_VERB "%5.2" "-" COMPU_TAB_REF FORMULA_0776_VTAB /end COMPU_METHOD
/begin COMPU_METHOD FORMULA_0777 "FORMULA_0777" TAB_VERB "%5.2" "-" COMPU_TAB_REF FORMULA_0777_VTAB /end COMPU_METHOD
/begin COMPU_METHOD FORMULA_0778 "FORMULA_0778" RAT_FUNC "%5.0" "Nm" COEFFS 0 10.0 0.0 0 0.0 1.0 /end COMPU_METHOD
/begin COMPU_METHOD FORMULA_0779 "FORMULA_0779" TAB_VERB "%3.0" "-" COMPU_TAB_REF FORMULA_0779_VTAB /end COMPU_METHOD
/begin COMPU_METHOD FORMULA_0780 "FORMULA_0780" TAB_VERB "%3.0" "-" COMPU_TAB_REF FORMULA_0780_VTAB /end COMPU_METHOD
/begin COMPU_METHOD FORMULA_0781 "FORMULA_0781" TAB_VERB "%3.0" "-" COMPU_TAB_REF FORMULA_0781_VTAB /end COMPU_METHOD
/begin COMPU_METHOD FORMULA_0782 "FORMULA_0782" TAB_VERB "%3.0" "-" COMPU_TAB_REF FORMULA_0782_VTAB /end COMPU_METHOD
/begin COMPU_METHOD FORMULA_0783 "FORMULA_0783" TAB_VERB "%3.0" "-" COMPU_TAB_REF FORMULA_0783_VTAB /end COMPU_METHOD
/begin COMPU_METHOD FORMULA_0784 "FORMULA_0784" TAB_VERB "%3.0" "-" COMPU_TAB_REF FORMULA_0784_VTAB /end COMPU_METHOD
/begin COMPU_METHOD FORMULA_0785 "FORMULA_0785" RAT_FUNC "%7.0" "Nm/s" COEFFS 0 1 0 0 0 1 /end COMPU_METHOD
/begin COMPU_METHOD FORMULA_0786 "FORMULA_0786" RAT_FUNC "%5.0" "Nm/s" COEFFS 0 1 0 0 0 1 /end COMPU_METHOD
/begin COMPU_METHOD FORMULA_0787 "FORMULA_0787" RAT_FUNC "%8.1" "Nm" COEFFS 0 200.0 0.0 0 0.0 1.0 /end COMPU_METHOD
/begin COMPU_METHOD FORMULA_0788 "FORMULA_0788" TAB_VERB "%3.0" "-" COMPU_TAB_REF FORMULA_0788_VTAB /end COMPU_METHOD
/begin COMPU_METHOD FORMULA_0789 "FORMULA_0789" RAT_FUNC "%5.0" "-" COEFFS 0 1.0 -1.0 0 0.0 1.0 /end COMPU_METHOD
/begin COMPU_METHOD FORMULA_0795 "FORMULA_0795" RAT_FUNC "%10.3" "Nm/Upm" COEFFS 0 1000.0 0.0 0 0.0 1.0 /end COMPU_METHOD
/begin COMPU_METHOD FORMULA_0796 "FORMULA_0796" RAT_FUNC "%7.2" "Nm/Upm" COEFFS 0 100.0 0.0 0 0.0 1.0 /end COMPU_METHOD
/begin COMPU_METHOD FORMULA_0797 "FORMULA_0797" TAB_VERB "%5.2" "-" COMPU_TAB_REF FORMULA_0797_VTAB /end COMPU_METHOD
/begin COMPU_METHOD FORMULA_0798 "FORMULA_0798" TAB_VERB "%5.2" "-" COMPU_TAB_REF FORMULA_0798_VTAB /end COMPU_METHOD
/begin COMPU_METHOD FORMULA_0799 "FORMULA_0799" RAT_FUNC "%10.3" "Nm/Upm" COEFFS 0 -1000.0 0.0 0 0.0 1.0 /end COMPU_METHOD
/begin COMPU_METHOD FORMULA_0800 "FORMULA_0800" RAT_FUNC "%10.3" "Nm/kmh" COEFFS 0 1000.0 0.0 0 0.0 1.0 /end COMPU_METHOD
/begin COMPU_METHOD FORMULA_0801 "FORMULA_0801" RAT_FUNC "%10.3" "Nm/kmh" COEFFS 0 -1000.0 0.0 0 0.0 1.0 /end COMPU_METHOD
/begin COMPU_METHOD FORMULA_0802 "FORMULA_0802" TAB_VERB "%5.2" "-" COMPU_TAB_REF FORMULA_0802_VTAB /end COMPU_METHOD
/begin COMPU_METHOD FORMULA_0803 "FORMULA_0803" TAB_VERB "%5.2" "-" COMPU_TAB_REF FORMULA_0803_VTAB /end COMPU_METHOD
/begin COMPU_METHOD FORMULA_0804 "FORMULA_0804" TAB_VERB "%5.2" "-" COMPU_TAB_REF FORMULA_0804_VTAB /end COMPU_METHOD
/begin COMPU_METHOD FORMULA_0805 "FORMULA_0805" TAB_VERB "%5.2" "-" COMPU_TAB_REF FORMULA_0805_VTAB /end COMPU_METHOD
/begin COMPU_METHOD FORMULA_0806 "FORMULA_0806" RAT_FUNC "%3.0" "Nm/s" COEFFS 0 5.e-002 0.0 0 0.0 1.0 /end COMPU_METHOD
/begin COMPU_METHOD FORMULA_0807 "FORMULA_0807" RAT_FUNC "%5.2" "Upm/s" COEFFS 0 5.e-003 0.0 0 0.0 1.0 /end COMPU_METHOD
/begin COMPU_METHOD FORMULA_0808 "FORMULA_0808" RAT_FUNC "%3.0" "Gang" COEFFS 0 1 0 0 0 1 /end COMPU_METHOD
/begin COMPU_METHOD FORMULA_0809 "FORMULA_0809" TAB_VERB "%5.2" "-" COMPU_TAB_REF FORMULA_0809_VTAB /end COMPU_METHOD
/begin COMPU_METHOD FORMULA_0810 "FORMULA_0810" TAB_VERB "%5.2" "-" COMPU_TAB_REF FORMULA_0810_VTAB /end COMPU_METHOD
/begin COMPU_METHOD FORMULA_0811 "FORMULA_0811" RAT_FUNC "%7.2" "Upm/s" COEFFS 0 8.e-002 0.0 0 0.0 1.0 /end COMPU_METHOD
/begin COMPU_METHOD FORMULA_0812 "FORMULA_0812" RAT_FUNC "%8.3" "sec" COEFFS 0 1000.0 0.0 0 0.0 1.0 /end COMPU_METHOD
/begin COMPU_METHOD FORMULA_0813 "FORMULA_0813" RAT_FUNC "%7.2" "Nm/kmh" COEFFS 0 100.0 0.0 0 0.0 1.0 /end COMPU_METHOD
/begin COMPU_METHOD FORMULA_0865 "FORMULA_0865" RAT_FUNC "%8.3" "%/V" COEFFS 0 100.0 0.0 0 0.0 1.0 /end COMPU_METHOD
/begin COMPU_METHOD FORMULA_0866 "FORMULA_0866" TAB_VERB "%5.2" "-" COMPU_TAB_REF FORMULA_0866_VTAB /end COMPU_METHOD
/begin COMPU_METHOD FORMULA_0867 "FORMULA_0867" TAB_VERB "%5.2" "-" COMPU_TAB_REF FORMULA_0867_VTAB /end COMPU_METHOD
/begin COMPU_METHOD FORMULA_0868 "FORMULA_0868" TAB_VERB "%5.2" "-" COMPU_TAB_REF FORMULA_0868_VTAB /end COMPU_METHOD
/begin COMPU_METHOD FORMULA_0869 "FORMULA_0869" TAB_VERB "%5.2" "-" COMPU_TAB_REF FORMULA_0869_VTAB /end COMPU_METHOD
/begin COMPU_METHOD FORMULA_0870 "FORMULA_0870" TAB_VERB "%5.2" "-" COMPU_TAB_REF FORMULA_0870_VTAB /end COMPU_METHOD
/begin COMPU_METHOD FORMULA_0871 "FORMULA_0871" TAB_VERB "%5.2" "-" COMPU_TAB_REF FORMULA_0871_VTAB /end COMPU_METHOD
/begin COMPU_METHOD FORMULA_0872 "FORMULA_0872" TAB_VERB "%5.2" "-" COMPU_TAB_REF FORMULA_0872_VTAB /end COMPU_METHOD
/begin COMPU_METHOD FORMULA_0873 "FORMULA_0873" TAB_VERB "%5.2" "-" COMPU_TAB_REF FORMULA_0873_VTAB /end COMPU_METHOD
/begin COMPU_METHOD FORMULA_0874 "FORMULA_0874" TAB_VERB "%5.2" "-" COMPU_TAB_REF FORMULA_0874_VTAB /end COMPU_METHOD
/begin COMPU_METHOD FORMULA_0875 "FORMULA_0875" TAB_VERB "%5.2" "-" COMPU_TAB_REF FORMULA_0875_VTAB /end COMPU_METHOD
/begin COMPU_METHOD FORMULA_0876 "FORMULA_0876" TAB_VERB "%5.2" "-" COMPU_TAB_REF FORMULA_0876_VTAB /end COMPU_METHOD
/begin COMPU_METHOD FORMULA_0877 "FORMULA_0877" TAB_VERB "%5.2" "-" COMPU_TAB_REF FORMULA_0877_VTAB /end COMPU_METHOD
/begin COMPU_METHOD FORMULA_0878 "FORMULA_0878" RAT_FUNC "%9.4" "-" COEFFS 0 65536.0 0.0 0 0.0 1.0 /end COMPU_METHOD
/begin COMPU_METHOD FORMULA_0879 "FORMULA_0879" TAB_VERB "%5.2" "-" COMPU_TAB_REF FORMULA_0879_VTAB /end COMPU_METHOD
/begin COMPU_METHOD FORMULA_0880 "FORMULA_0880" TAB_VERB "%3.0" "-" COMPU_TAB_REF FORMULA_0880_VTAB /end COMPU_METHOD
/begin COMPU_METHOD FORMULA_0881 "FORMULA_0881" RAT_FUNC "%9.4" "s" COEFFS 0 0 327.68 0 1 0 /end COMPU_METHOD
/begin COMPU_METHOD FORMULA_0882 "FORMULA_0882" RAT_FUNC "%7.2" "1/s" COEFFS 0 5.12 0.0 0 0.0 1.0 /end COMPU_METHOD
/begin COMPU_METHOD FORMULA_0883 "FORMULA_0883" RAT_FUNC "%5.0" "bar" COEFFS 0 1 0 0 0 1 /end COMPU_METHOD
/begin COMPU_METHOD FORMULA_0970 "FORMULA_0970" RAT_FUNC "%7.2" "Kelvin" COEFFS 0 20.0 0.0 0 0.0 1.0 /end COMPU_METHOD
/begin COMPU_METHOD FORMULA_0975 "FORMULA_0975" RAT_FUNC "%8.3" "°C" COEFFS 0 40.0 10926.0 0 0.0 1.0 /end COMPU_METHOD
/begin COMPU_METHOD FORMULA_0985 "FORMULA_0985" RAT_FUNC "%5.0" "Kelvin/s" COEFFS 0 1 0 0 0 1 /end COMPU_METHOD
/begin COMPU_METHOD FORMULA_0986 "FORMULA_0986" TAB_VERB "%5.2" "-" COMPU_TAB_REF FORMULA_0986_VTAB /end COMPU_METHOD
/begin COMPU_METHOD FORMULA_0987 "FORMULA_0987" TAB_VERB "%5.2" "-" COMPU_TAB_REF FORMULA_0987_VTAB /end COMPU_METHOD
/begin COMPU_METHOD FORMULA_0988 "FORMULA_0988" RAT_FUNC "%7.0" "s" COEFFS 0 1 0 0 0 1 /end COMPU_METHOD
/begin COMPU_METHOD FORMULA_0989 "FORMULA_0989" TAB_VERB "%5.2" "-" COMPU_TAB_REF FORMULA_0989_VTAB /end COMPU_METHOD
/begin COMPU_METHOD FORMULA_0990 "FORMULA_0990" RAT_FUNC "%5.0" "min" COEFFS 0 1 0 0 0 1 /end COMPU_METHOD
/begin COMPU_METHOD FORMULA_0992 "FORMULA_0992" TAB_VERB "%5.2" "-" COMPU_TAB_REF FORMULA_0992_VTAB /end COMPU_METHOD
/begin COMPU_METHOD FORMULA_0993 "FORMULA_0993" TAB_VERB "%5.2" "-" COMPU_TAB_REF FORMULA_0993_VTAB /end COMPU_METHOD
/begin COMPU_METHOD FORMULA_0994 "FORMULA_0994" TAB_VERB "%5.2" "-" COMPU_TAB_REF FORMULA_0994_VTAB /end COMPU_METHOD
/begin COMPU_METHOD FORMULA_0995 "FORMULA_0995" TAB_VERB "%5.2" "-" COMPU_TAB_REF FORMULA_0995_VTAB /end COMPU_METHOD
/begin COMPU_METHOD FORMULA_0996 "FORMULA_0996" TAB_VERB "%5.2" "-" COMPU_TAB_REF FORMULA_0996_VTAB /end COMPU_METHOD
/begin COMPU_METHOD FORMULA_0997 "FORMULA_0997" TAB_VERB "%5.2" "-" COMPU_TAB_REF FORMULA_0997_VTAB /end COMPU_METHOD
/begin COMPU_METHOD FORMULA_0998 "FORMULA_0998" TAB_VERB "%5.2" "-" COMPU_TAB_REF FORMULA_0998_VTAB /end COMPU_METHOD
/begin COMPU_METHOD FORMULA_0999 "FORMULA_0999" TAB_VERB "%5.2" "-" COMPU_TAB_REF FORMULA_0999_VTAB /end COMPU_METHOD
/begin COMPU_METHOD FORMULA_1000 "FORMULA_1000" TAB_VERB "%5.2" "-" COMPU_TAB_REF FORMULA_1000_VTAB /end COMPU_METHOD
/begin COMPU_METHOD FORMULA_1001 "FORMULA_1001" RAT_FUNC "%9.2" "kgs/h" COEFFS 0 100.0 0.0 0 0.0 1.0 /end COMPU_METHOD
/begin COMPU_METHOD FORMULA_1002 "FORMULA_1002" RAT_FUNC "%11.4" "Kelvin" COEFFS 0 10240.0 0.0 0 0.0 1.0 /end COMPU_METHOD
/begin COMPU_METHOD FORMULA_1003 "FORMULA_1003" RAT_FUNC "%7.2" "Kelvin" COEFFS 0 40.0 0.0 0 0.0 1.0 /end COMPU_METHOD
/begin COMPU_METHOD FORMULA_1004 "FORMULA_1004" RAT_FUNC "%7.2" "Kelvin/s" COEFFS 0 4.0 0.0 0 0.0 1.0 /end COMPU_METHOD
/begin COMPU_METHOD FORMULA_1005 "FORMULA_1005" RAT_FUNC "%7.2" "K/100ms" COEFFS 0 40.0 0.0 0 0.0 1.0 /end COMPU_METHOD
/begin COMPU_METHOD FORMULA_1006 "FORMULA_1006" TAB_VERB "%3.0" "-" COMPU_TAB_REF FORMULA_1006_VTAB /end COMPU_METHOD
/begin COMPU_METHOD FORMULA_1007 "FORMULA_1007" RAT_FUNC "%6.1" "s" COEFFS 0 100.0 0.0 0 0.0 1.0 /end COMPU_METHOD
/begin COMPU_METHOD FORMULA_1008 "FORMULA_1008" TAB_VERB "%5.2" "-" COMPU_TAB_REF FORMULA_1008_VTAB /end COMPU_METHOD
/begin COMPU_METHOD FORMULA_1009 "FORMULA_1009" RAT_FUNC "%4.1" "Kelvin" COEFFS 0 10.0 0.0 0 0.0 1.0 /end COMPU_METHOD
/begin COMPU_METHOD FORMULA_1010 "FORMULA_1010" RAT_FUNC "%11.4" "°C" COEFFS 0 10000.0 2732000.0 0 0.0 1.0 /end COMPU_METHOD
/begin COMPU_METHOD FORMULA_1011 "FORMULA_1011" RAT_FUNC "%9.4" "Kelvin" COEFFS 0 10000.0 0.0 0 0.0 1.0 /end COMPU_METHOD
/begin COMPU_METHOD FORMULA_1012 "FORMULA_1012" RAT_FUNC "%7.2" "min" COEFFS 0 1 0 0 0 1 /end COMPU_METHOD
/begin COMPU_METHOD FORMULA_1013 "FORMULA_1013" RAT_FUNC "%7.2" "Anteil [0..1]" COEFFS 0 100.0 0.0 0 0.0 1.0 /end COMPU_METHOD
/begin COMPU_VTAB FORMULA_0249_VTAB "FORMULA_0249_VTAB" TAB_VERB 6 0 "O.K." 1 "Kanalfilter" 2 "Kanalfehler" 3 "PWG2_Fehler" 4 "PWG1_Fehler" 5 "Totalausfall" DEFAULT_VALUE "undefiniert" /end COMPU_VTAB
/begin COMPU_VTAB FORMULA_0252_VTAB "FORMULA_0252_VTAB" TAB_VERB 5 0 "unbegrenzt" 1 "TZ-Begr" 2 "DK-Begr" 3 "TZ-DK-Begr" 15 "ungueltig" /end COMPU_VTAB
/begin COMPU_VTAB FORMULA_0359_VTAB "FORMULA_0359_VTAB" TAB_VERB 3 0 "OK" 1 "QADCA NIO" 2 "QADCB NIO" DEFAULT_VALUE "undef" /end COMPU_VTAB
/begin COMPU_VTAB FORMULA_0362_VTAB "FORMULA_0362_VTAB" TAB_VERB 2 0 "Aus" 1 "Ein" /end COMPU_VTAB
/begin COMPU_VTAB FORMULA_0368_VTAB "FORMULA_0368_VTAB" TAB_VERB 2 0 "SK aus" 1 "SK aktiv" /end COMPU_VTAB
/begin COMPU_VTAB FORMULA_0438_VTAB "FORMULA_0438_VTAB" TAB_VERB 7 0 "kein Fehler" 1 "Md-Chk0" 2 "Md-Chk" 4 "MDmin-Chk" 8 "Rf-Chk" 16 "Eta-Chk" 32 "LLR-Chk" DEFAULT_VALUE "Mehrfach" /end COMPU_VTAB
/begin COMPU_VTAB FORMULA_0761_VTAB "FORMULA_0761_VTAB" TAB_VERB 2 0 "ohne KR" 1 "mit KR" /end COMPU_VTAB
/begin COMPU_VTAB FORMULA_0762_VTAB "FORMULA_0762_VTAB" TAB_VERB 7 0 "ohne Korr" 1 "TZ bei KH" 2 "RF bei KH" 3 "bei KH" 4 "TZ immer" 8 "RF immer" 12 "immer" /end COMPU_VTAB
/begin COMPU_VTAB FORMULA_0764_VTAB "FORMULA_0764_VTAB" TAB_VERB 2 0 "aus" 1 "ein" /end COMPU_VTAB
/begin COMPU_VTAB FORMULA_0768_VTAB "FORMULA_0768_VTAB" TAB_VERB 9 0 "Freigabe" 1 "Fehler" 2 "Start" 4 "Beschl." 8 "VL" 16 "WH" 32 "Tmot" 64 "Nmax" 128 "TEFC" DEFAULT_VALUE "Mehrfach" /end COMPU_VTAB
/begin COMPU_VTAB FORMULA_0769_VTAB "FORMULA_0769_VTAB" TAB_VERB 7 0 "kein Fehler" 1 "CAN-Err" 2 "DME-Err" 4 "MD-Err" 8 "ELU-Err" 16 "Kuehl-Err" 32 "Bereit-Err" DEFAULT_VALUE "Mehrfach" /end COMPU_VTAB
/begin COMPU_VTAB FORMULA_0770_VTAB "FORMULA_0770_VTAB" TAB_VERB 9 0 "aus" 1 "nLL-Anhebung" 2 "Klima-Anf." 3 "nLL+Klima" 4 "Reserve" 6 "Klima+Res" 7 "nLL+Klima+Res" 8 "nLL-ZH" 24 "nLL-ZH+Res" /end COMPU_VTAB
/begin COMPU_VTAB FORMULA_0771_VTAB "FORMULA_0771_VTAB" TAB_VERB 5 0 "Inaktiv" 1 "Wait on" 2 "Filter on" 4 "Wait off" 8 "Filter off" DEFAULT_VALUE "undef" /end COMPU_VTAB
/begin COMPU_VTAB FORMULA_0772_VTAB "FORMULA_0772_VTAB" TAB_VERB 2 0 "Inaktiv" 1 "Aktiv" /end COMPU_VTAB
/begin COMPU_VTAB FORMULA_0773_VTAB "FORMULA_0773_VTAB" TAB_VERB 2 0 "gesperrt" 1 "frei" DEFAULT_VALUE "ungueltig" /end COMPU_VTAB
/begin COMPU_VTAB FORMULA_0776_VTAB "FORMULA_0776_VTAB" TAB_VERB 6 0 "kein Fehler" 1 "Minmoment" 2 "Maxmoment" 4 "ind.Istmoment" 8 "Schleppmoment" 16 "Soll/Istvgl." DEFAULT_VALUE "Mehrfach" /end COMPU_VTAB
/begin COMPU_VTAB FORMULA_0777_VTAB "FORMULA_0777_VTAB" TAB_VERB 3 0 "Inaktiv" 1 "MSR" 2 "ASC" DEFAULT_VALUE "undef" /end COMPU_VTAB
/begin COMPU_VTAB FORMULA_0779_VTAB "FORMULA_0779_VTAB" TAB_VERB 6 0 "Inaktiv" 1 "SA aktiv" 2 "LSD" 4 "Dash" 3 "LSD+SA" 5 "Dash+SA" /end COMPU_VTAB
/begin COMPU_VTAB FORMULA_0780_VTAB "FORMULA_0780_VTAB" TAB_VERB 1 0 "Inaktiv" DEFAULT_VALUE "Aktiv" /end COMPU_VTAB
/begin COMPU_VTAB FORMULA_0781_VTAB "FORMULA_0781_VTAB" TAB_VERB 1 0 "Inaktiv" DEFAULT_VALUE "Aktiv" /end COMPU_VTAB
/begin COMPU_VTAB FORMULA_0782_VTAB "FORMULA_0782_VTAB" TAB_VERB 2 0 "Filter aus" 1 "Filter ein" /end COMPU_VTAB
/begin COMPU_VTAB FORMULA_0783_VTAB "FORMULA_0783_VTAB" TAB_VERB 3 -1 "fallend" 0 "konstant" 1 "steigend" DEFAULT_VALUE "undef" /end COMPU_VTAB
/begin COMPU_VTAB FORMULA_0784_VTAB "FORMULA_0784_VTAB" TAB_VERB 3 0 "B1/unter 0Nm" 1 "B2/um 0Nm" 2 "B3/ueber 0Nm" DEFAULT_VALUE "undef" /end COMPU_VTAB
/begin COMPU_VTAB FORMULA_0788_VTAB "FORMULA_0788_VTAB" TAB_VERB 3 0 "aus" 1 "bei KS" 2 "immer" /end COMPU_VTAB
/begin COMPU_VTAB FORMULA_0797_VTAB "FORMULA_0797_VTAB" TAB_VERB 2 0 "Inaktiv" 1 "Aktiv" /end COMPU_VTAB
/begin COMPU_VTAB FORMULA_0798_VTAB "FORMULA_0798_VTAB" TAB_VERB 2 0 "Bezug=Sollmoment" 1 "Bezug=Istmoment" /end COMPU_VTAB
/begin COMPU_VTAB FORMULA_0802_VTAB "FORMULA_0802_VTAB" TAB_VERB 2 0 "Inaktiv" 128 "Erkannt" DEFAULT_VALUE "undef" /end COMPU_VTAB
/begin COMPU_VTAB FORMULA_0803_VTAB "FORMULA_0803_VTAB" TAB_VERB 4 0 "Inaktiv" 1 "md_rf_soll" 2 "md_tz_soll" 4 "md_ind_wunsch_tz" /end COMPU_VTAB
/begin COMPU_VTAB FORMULA_0804_VTAB "FORMULA_0804_VTAB" TAB_VERB 3 0 "immer aus" 1 "Eingr" 2 "immer ein" /end COMPU_VTAB
/begin COMPU_VTAB FORMULA_0805_VTAB "FORMULA_0805_VTAB" TAB_VERB 2 0 "Inaktiv" 1 "Aktiv" DEFAULT_VALUE "undef" /end COMPU_VTAB
/begin COMPU_VTAB FORMULA_0809_VTAB "FORMULA_0809_VTAB" TAB_VERB 4 0 "Inaktiv" 1 "mit TE" 2 "mit MVAC" 3 "mit TE+MVAC" /end COMPU_VTAB
/begin COMPU_VTAB FORMULA_0810_VTAB "FORMULA_0810_VTAB" TAB_VERB 4 0 "alle mw" 1 "md_rf_soll_pt_fr_wicht" 2 "md_rf_soll_pt_rg_fr" 3 "alle bs" DEFAULT_VALUE "ungueltig" /end COMPU_VTAB
/begin COMPU_VTAB FORMULA_0866_VTAB "FORMULA_0866_VTAB" TAB_VERB 1 0 "keine Erfassung" DEFAULT_VALUE "Druckerfassung" /end COMPU_VTAB
/begin COMPU_VTAB FORMULA_0867_VTAB "FORMULA_0867_VTAB" TAB_VERB 1 0 "kein Berganfahren" DEFAULT_VALUE "Berganfahren" /end COMPU_VTAB
/begin COMPU_VTAB FORMULA_0868_VTAB "FORMULA_0868_VTAB" TAB_VERB 1 0 "keine v-Begrenzung" DEFAULT_VALUE "v-Begrenzung" /end COMPU_VTAB
/begin COMPU_VTAB FORMULA_0869_VTAB "FORMULA_0869_VTAB" TAB_VERB 1 0 "keine Begrenzung" DEFAULT_VALUE "Begrenzung" /end COMPU_VTAB
/begin COMPU_VTAB FORMULA_0870_VTAB "FORMULA_0870_VTAB" TAB_VERB 1 0 "O.K." DEFAULT_VALUE "Filter" /end COMPU_VTAB
/begin COMPU_VTAB FORMULA_0871_VTAB "FORMULA_0871_VTAB" TAB_VERB 1 0 "O.K." DEFAULT_VALUE "Fehler" /end COMPU_VTAB
/begin COMPU_VTAB FORMULA_0872_VTAB "FORMULA_0872_VTAB" TAB_VERB 1 0 "O.K." DEFAULT_VALUE "Fehler" /end COMPU_VTAB
/begin COMPU_VTAB FORMULA_0873_VTAB "FORMULA_0873_VTAB" TAB_VERB 1 0 "O.K." DEFAULT_VALUE "Fehler" /end COMPU_VTAB
/begin COMPU_VTAB FORMULA_0874_VTAB "FORMULA_0874_VTAB" TAB_VERB 1 0 "O.K." DEFAULT_VALUE "Fehler" /end COMPU_VTAB
/begin COMPU_VTAB FORMULA_0875_VTAB "FORMULA_0875_VTAB" TAB_VERB 1 0 "O.K." DEFAULT_VALUE "Fehler" /end COMPU_VTAB
/begin COMPU_VTAB FORMULA_0876_VTAB "FORMULA_0876_VTAB" TAB_VERB 1 0 "O.K." DEFAULT_VALUE "Bremse" /end COMPU_VTAB
/begin COMPU_VTAB FORMULA_0877_VTAB "FORMULA_0877_VTAB" TAB_VERB 1 0 "O.K." DEFAULT_VALUE "Sperre" /end COMPU_VTAB
/begin COMPU_VTAB FORMULA_0879_VTAB "FORMULA_0879_VTAB" TAB_VERB 1 0 "Inaktiv" DEFAULT_VALUE "Aktiv" /end COMPU_VTAB
/begin COMPU_VTAB FORMULA_0880_VTAB "FORMULA_0880_VTAB" TAB_VERB 3 0 "Begr. ueber v" 1 "Begr. ueber Druck" 2 "keine Begrenzung" /end COMPU_VTAB
/begin COMPU_VTAB FORMULA_0986_VTAB "FORMULA_0986_VTAB" TAB_VERB 5 1 "Diag. Standzeit aktiv" 2 "Diag. lfd. Betrieb aktiv" 3 "Diag. Std.zt/lfd. Betrieb aktiv" 64 "Diag. abgelaufen" 128 "Diag gesp. Bedg. n. erf." DEFAULT_VALUE "undef." /end COMPU_VTAB
/begin COMPU_VTAB FORMULA_0987_VTAB "FORMULA_0987_VTAB" TAB_VERB 13 0 "Initialisierung" 1 "Error Slow MS" 2 "Error Fast MS" 3 "Error Slow-Fast MS" 4 "Error Slow ML" 5 "Error Slow MS/ Slow ML" 6 "Error Fast MS / Slow ML" 7 "Error Slow-Fast MS / Slow ML" 8 "Error Fast ML" 9 "Error Slow MS / Fast ML" 8 "Error Fast MS / Fast ML" 64 "time_rel_st i.O." 128 "Timeout CAN-Telegramm" DEFAULT_VALUE "undef." /end COMPU_VTAB
/begin COMPU_VTAB FORMULA_0989_VTAB "FORMULA_0989_VTAB" TAB_VERB 2 0 "Diag. aus" 1 "Diag. aktiv" DEFAULT_VALUE "undef" /end COMPU_VTAB
/begin COMPU_VTAB FORMULA_0992_VTAB "FORMULA_0992_VTAB" TAB_VERB 1 0 "tmot" DEFAULT_VALUE "tka" /end COMPU_VTAB
/begin COMPU_VTAB FORMULA_0993_VTAB "FORMULA_0993_VTAB" TAB_VERB 1 0 "keine Sperre" DEFAULT_VALUE "Sperre" /end COMPU_VTAB
/begin COMPU_VTAB FORMULA_0994_VTAB "FORMULA_0994_VTAB" TAB_VERB 1 0 "keine Sperre" DEFAULT_VALUE "Sperre" /end COMPU_VTAB
/begin COMPU_VTAB FORMULA_0995_VTAB "FORMULA_0995_VTAB" TAB_VERB 1 0 "keine Sperre" DEFAULT_VALUE "Sperre" /end COMPU_VTAB
/begin COMPU_VTAB FORMULA_0996_VTAB "FORMULA_0996_VTAB" TAB_VERB 1 0 "keine Sperre" DEFAULT_VALUE "Sperre" /end COMPU_VTAB
/begin COMPU_VTAB FORMULA_0997_VTAB "FORMULA_0997_VTAB" TAB_VERB 1 0 "keine Erkennung" DEFAULT_VALUE "OK-erkannt" /end COMPU_VTAB
/begin COMPU_VTAB FORMULA_0998_VTAB "FORMULA_0998_VTAB" TAB_VERB 1 0 "keine Erkennung" DEFAULT_VALUE "OK-erkannt" /end COMPU_VTAB
/begin COMPU_VTAB FORMULA_0999_VTAB "FORMULA_0999_VTAB" TAB_VERB 1 0 "keine Erkennung" DEFAULT_VALUE "OK-erkannt" /end COMPU_VTAB
/begin COMPU_VTAB FORMULA_1000_VTAB "FORMULA_1000_VTAB" TAB_VERB 1 0 "keine INIT" DEFAULT_VALUE "initialisiert" /end COMPU_VTAB
/begin COMPU_VTAB FORMULA_1006_VTAB "FORMULA_1006_VTAB" TAB_VERB 2 0 "OBD aus" 1 "OBD ein" /end COMPU_VTAB
/begin COMPU_VTAB FORMULA_1008_VTAB "FORMULA_1008_VTAB" TAB_VERB 2 0 "toel" 1 "Oz_tempr" /end COMPU_VTAB
/begin FUNCTION Momentenmanager ""
 /begin DEF_CHARACTERISTIC K_MD_ANFF_PWG_OFF K_MD_ANFF_PWG_ON K_MD_ANFF_V_SCHW K_MD_ASC_AUSBLEND_HYS K_MD_ASC_ENABLE K_MD_ASC_M_AEBEGR K_MD_ASC_M_RAMPE K_MD_ASC_T_WAIT K_MD_BEZUG_HYS K_MD_BEZUG_RAMPE K_MD_BLS_BRP K_MD_BLS_BRP_VMA K_MD_BLS_DN_VMA K_MD_BLS_FW_REL K_MD_BLS_GANG_VMA K_MD_BLS_N K_MD_BLS_N_VMA K_MD_CAN_BEGR_ST K_MD_CAN_ETA_ZW_OFF K_MD_CFG_DYN_FIL K_MD_CFG_FW_BLS K_MD_CFG_MCS K_MD_CFG_RG_KORR K_MD_CFG_TZ_EINGR K_MD_CFG_ZW_BEZUG K_MD_DYN_FIL_RES_TAU K_MD_ETA_EINGRIFF K_MD_ETA_KH_TAU K_MD_ETA_KH_TAU_LL K_MD_ETA_KR_KOMP K_MD_ETA_LA_KOMP_MAX K_MD_ETA_LA_TAU K_MD_ETA_SK_MIN K_MD_ETA_STAT_TAU K_MD_ETA_STAT_TAU_LL K_MD_ETA_T_SPERR K_MD_ETA_ZW_MIN K_MD_GEN_FREISCHALT K_MD_GEN_MAX K_MD_GRAD_DP_OKS K_MD_GRAD_LSD_OKS K_MD_GRAD_SA K_MD_GRAD_SA_CUF K_MD_GRAD_SA_VMA K_MD_HYP_VERH_NO_KRAFTS K_MD_HYP_VERH_START K_MD_HYS_RICHTUNG K_MD_HYS_SA K_MD_HYS_SA_TZ K_MD_IND_WUNSCH_TZ_MCS K_MD_KKOS_CAN_MAX K_MD_KKOS_DYN_ST K_MD_KKOS_ELU_TMOT_MAX K_MD_KKOS_ELU_TMOT_MAX_HYS K_MD_KKOS_MAX K_MD_KKOS_MIN K_MD_KKOS_N K_MD_KKOS_N_MAX K_MD_KKOS_N_MAX_HYS K_MD_KKOS_RES_RAMPE_OFF K_MD_KKOS_RES_RAMPE_ON K_MD_KKOS_RES_T_MAX K_MD_KKOS_START K_MD_KKOS_TAU_OFF K_MD_KKOS_TAU_ON K_MD_KKOS_TIME_BA_VL K_MD_KKOS_TIME_START K_MD_KKOS_TIME_WH K_MD_KKOS_TMOT_MAX K_MD_KKOS_TMOT_MAX_HYS K_MD_KKOS_V_BA K_MD_KKOS_V_VL K_MD_KKOS_V_VL_AUS K_MD_KKOS_ZH_RES_RAMPE K_MD_KKOS_ZH_RES_T_MAX K_MD_KKOS_ZH_TMOT K_MD_KKOS_ZH_TUMG K_MD_KUPP_BEGR_MCS K_MD_LRW_RES_DELTA K_MD_LRW_RES_V K_MD_LRW_RES_V_HYS K_MD_LRW_TAU K_MD_MAX_FAK K_MD_MAX_POWER_NEG K_MD_MAX_POWER_POS K_MD_MSR_ENABLE K_MD_MSR_M_RAMPE K_MD_MSR_MAX K_MD_MSR_T_WAIT K_MD_NBEGR_A1 K_MD_NBEGR_AKTIV K_MD_NBEGR_HYS_AUS K_MD_NBEGR_MD_HYS K_MD_NBEGR_N_DELTA K_MD_NOISE_CFG K_MD_NOISE_PWG_SOLL K_MD_NOISE_RAMPE K_MD_NOISE_T K_MD_NOISE_V_MAX1 K_MD_NOISE_V_MAX2 K_MD_NOISE_V_MAX3 K_MD_NOISE_V_MIN1 K_MD_NOISE_V_MIN2 K_MD_NOISE_V_MIN3 K_MD_PULS_AMP K_MD_PULS_EIN K_MD_PULS_OFFS K_MD_PULS_RAMPE K_MD_PULS_T K_MD_RES_KATH_FAK K_MD_RES_KATH_TAU K_MD_RES_MIN K_MD_RES_MIN_HYS K_MD_RES_T_SPERR K_MD_RES_ZW_RAMPE_NEG K_MD_RES_ZW_RAMPE_POS K_MD_RESERVE_TST K_MD_RF_SOLL_BS_CFG K_MD_RF_SOLL_MCS K_MD_RF_SOLL_PT_TAU K_MD_RF_SOLL_SEK_CFG K_MD_RG_RF_FAKTOR K_MD_SK_BEGR_RAMPE K_MD_SK_CFG K_MD_SK_ETA_MIN K_MD_SK_FWMAX K_MD_SK_IND_MAX K_MD_SK_LLR_MAX K_MD_SK_MAX_MDMIN K_MD_SK_N_MDMIN K_MD_SK_N_MIN K_MD_SK_NHYS K_MD_SK_PWGMIN K_MD_SK_RF_MAX K_MD_SK_TAU_PWG K_MD_SK_TAU_VERGL K_MD_SK_TIMER_0 K_MD_SK_TIMER_1 K_MD_SK_TIRED_HYS K_MD_SK_TIRED_MIN K_MD_SK_TIRED_ZYL K_MD_SK_WDK_KH_OFFS K_MD_SK_WDK_LLSFAIL_OFFS K_MD_TAU_FW_DPFIL K_MD_TAU_FW_GRAD K_MD_TAU_IND_TZ_GRAD K_MD_VBEGR_A1 K_MD_VBEGR_HYS_AUS K_MD_VBEGR_MD_HYS K_MD_VERBR_MAX KF_MD_DELTA_DP_ON KF_MD_DYN_FIL_RES KF_MD_DYN_FIL_RES_FAK KF_MD_ETA_LA KF_MD_FAHRER_KOMFORT KF_MD_FAHRER_NORMAL KF_MD_FAHRER_PST KF_MD_FAHRER_SPORT KF_MD_FAK_GRAD_DP_B1 KF_MD_FAK_GRAD_DP_B2 KF_MD_FAK_GRAD_DP_B3 KF_MD_FR_WICHT KF_MD_GRAD_DP_B1 KF_MD_GRAD_DP_B2 KF_MD_GRAD_DP_B3 KF_MD_GRAD_DP_LLMKS KF_MD_GRAD_LSD_B1 KF_MD_GRAD_LSD_B2 KF_MD_GRAD_LSD_B3 KF_MD_GRAD_LSD_LLMKS KF_MD_IND_LW_VERLUSTE KF_MD_IND_MIN_SCHUB KF_MD_IND_OPT KF_MD_IND_REIB KF_MD_KKOS_KORR KF_MD_KOMFORT_DP KF_MD_KOMFORT_LSD KF_MD_KUPP_GRENZ_DP_O KF_MD_KUPP_GRENZ_DP_U_OFFS KF_MD_KUPP_GRENZ_LSD_O KF_MD_KUPP_GRENZ_LSD_U_OFFS KF_MD_LRW KF_MD_NBEGR_KR KF_MD_NBEGR_TN KF_MD_NBEGR_TV KF_MD_POLYNOM_A KF_MD_POLYNOM_A_KH KF_MD_POLYNOM_B KF_MD_SK_DIFF_MAX KF_MD_SMG_BEGR_OFF KF_MD_SPORT_DP KF_MD_SPORT_LSD KF_MD_START_OFFSET KF_MD_TAU_LSD_B3 KF_MD_VBEGR_KR KF_MD_VBEGR_TN KF_MD_VBEGR_TV KF_MD_VERBR_FZG KF_MD_ZW_OFFSET KF_MD_ZW_OPT KF_MD_ZW_RG KL_MD_BEGR_NOISE KL_MD_ETA_LA KL_MD_FAHRER_FAK_KOMFORT KL_MD_FAHRER_FAK_NORMAL KL_MD_FAHRER_FAK_SPORT KL_MD_FAK_DP_B1 KL_MD_FAK_DP_B2 KL_MD_FAK_DP_B3 KL_MD_FAK_LSD_ANFF KL_MD_FAK_LSD_B1 KL_MD_FAK_LSD_B2 KL_MD_FAK_LSD_B3 KL_MD_HYP_DN KL_MD_HYP_VERH_KRAFTS KL_MD_IND_REIB_ABREG KL_MD_IND_REIB_OFFSET KL_MD_IND_RF_MIN_OFFS KL_MD_KKOS_DELAY_OFF KL_MD_KKOS_DELAY_ON KL_MD_KKOS_RES_MAX KL_MD_KKOS_ZH_RES_MAX KL_MD_KR_DTZ_DOWN KL_MD_KR_DTZ_UP KL_MD_KUPP_MAX_CAN KL_MD_KUPP_MIN_ASC KL_MD_LRW_FAK KL_MD_LRW_RES KL_MD_MAX_FAK_POWER KL_MD_MAX_N_OFFS KL_MD_MAX_TMOT KL_MD_NBEGR_ABSTAND KL_MD_NBEGR_GANG KL_MD_NBEGR_KR_FAK KL_MD_NBEGR_KR_FAK_SK KL_MD_NBEGR_N_MAX KL_MD_NBEGR_N_OFFSET KL_MD_NBEGR_RAMPE KL_MD_NBEGR_TN_FAK KL_MD_NBEGR_TN_FAK_SK KL_MD_NBEGR_TV_FAK KL_MD_RES_MIN KL_MD_RF_MAX_ROH KL_MD_RG_TAU KL_MD_SCHW_TAU KL_MD_SK_GRAD_MAX KL_MD_SK_MD_BEGR KL_MD_SK_WDK KL_MD_SK_WDK_TI_OFFS KL_MD_TAU_START_OFF KL_MD_VBEGR_ABSTAND KL_MD_VBEGR_KR_FAK KL_MD_VBEGR_KR_FAK_SK KL_MD_VBEGR_RAMPE KL_MD_VBEGR_TAU KL_MD_VBEGR_TN_FAK KL_MD_VBEGR_TN_FAK_SK KL_MD_VBEGR_TV_FAK KL_MD_ZW_LA KL_MD_ZW_TMOT_FAK /end DEF_CHARACTERISTIC
 /begin OUT_MEASUREMENT md_bereich md_dsc_t_wait md_dyn_fil_res md_dyn_fil_res_roh md_dyn_flags md_dyn_freigabe md_dyn_smg_timer md_dyn_st md_dyn_st_anff md_dyn_st_tz_min md_eta_ausbl_sk md_eta_ausblend md_eta_bezug md_eta_la_ist md_eta_la_sk md_eta_la_vl md_eta_rg_brenn md_eta_rg_lw md_eta_zw_komp md_eta_zw_min md_eta_zw_ne md_eta_zw_soll md_eta_zw_stat md_eta_zw_ve md_exd_kkos_max md_exd_kkos_timeout md_fr_wicht_fak_b1 md_fr_wicht_fak_b2 md_fw_fgr md_gen md_gen_st md_grad md_grad_anf md_grad_dp md_grad_lsd md_grad_max md_hyp_faktor md_ind_ist_skmin md_ind_lw_ist md_ind_lw_max md_ind_lw_min md_ind_max md_ind_max_roh md_ind_min md_ind_min_roh md_ind_min_schub md_ind_opt md_ind_opt_la md_ind_opt_la_rg md_ind_reib md_ind_reib_abreg md_ind_reib_offset md_ind_reib_roh md_ind_rf_min md_ind_schlepp_max md_ind_ve md_ind_wunsch_ges md_ind_wunsch_ml md_ind_wunsch_ml_komp md_ind_wunsch_tz md_ind_wunsch_tz_grad md_kkos md_kkos_fil md_kkos_freig_st md_kkos_res md_kkos_res_max md_kkos_s md_kkos_sperr_st md_kkos_time_ba md_kkos_time_delay md_kkos_time_res md_kkos_time_vl md_kkos_time_wh md_kkos_zh_res md_kkos_zh_res_max md_kkos_zh_time_res md_kkos_zust md_kupp_asc_ml md_kupp_asc_tz md_kupp_begrenzer md_kupp_grenz_dp_o md_kupp_grenz_dp_u md_kupp_grenz_lsd_o md_kupp_grenz_lsd_u md_kupp_grenz_o md_kupp_grenz_u md_kupp_ist_schw md_kupp_max_mdrv md_kupp_min_asc md_kupp_min_schub md_kupp_msr_ml md_kupp_msr_tz md_kupp_nbegr md_kupp_noise_max md_kupp_smg_begr md_kupp_ti_begr md_kupp_vbegr md_kupp_wunsch_begr_eff md_kupp_wunsch_fil_dp md_kupp_wunsch_fil_roh md_kupp_wunsch_filter md_kupp_wunsch_ges md_kupp_wunsch_grad md_kupp_wunsch_grad_max md_kupp_wunsch_ml_komp md_kupp_wunsch_puls md_lrw md_lrw_fil md_lrw_res md_mzyl_soll_asp_b1 md_mzyl_soll_asp_b2 md_n_grad_fil md_nbegr_abstand md_nbegr_b0 md_nbegr_b1 md_nbegr_b2 md_nbegr_egas md_nbegr_gang md_nbegr_n_offset md_nbegr_soll md_noise_st md_noise_t md_polynom_a md_polynom_b md_puls_timer md_res md_res_anf md_res_max md_res_min md_res_zw md_rf_min md_rf_rg_korr_b1 md_rf_rg_korr_b2 md_rf_soll_pt_fr_b1 md_rf_soll_pt_fr_b2 md_rf_soll_pt_fr_wicht_fil_b1 md_rf_soll_pt_fr_wicht_fil_b2 md_rf_soll_pt_rg_fr_b1 md_rf_soll_pt_rg_fr_b2 md_rf_soll_pt_rg_fr_wl_b1 md_rf_soll_pt_rg_fr_wl_b2 md_rf_tl_vl md_richtung md_sk_diff_max md_sk_fehler md_sk_grad_max md_sk_pwg md_sk_timer_0 md_sk_timer_1 md_sk_tired md_sk_vergl_diff md_sk_vergl_soll md_sk_verh md_sk_wdkmax md_sk_wunsch_begr_ml md_sk_wunsch_begr_tz md_start_offset md_tz_eingr_aktiv md_tz_eingr_bezug md_tz_soll_zyl1 md_tz_soll_zyl10 md_tz_soll_zyl2 md_tz_soll_zyl3 md_tz_soll_zyl4 md_tz_soll_zyl5 md_tz_soll_zyl6 md_tz_soll_zyl7 md_tz_soll_zyl8 md_tz_soll_zyl9 md_tz_st md_v_max_delta md_vbegr_b0 md_vbegr_b1 md_vbegr_b2 md_vbegr_t md_verbr_fzg md_verbraucher md_zw_la_ist_delta md_zw_opt md_zw_opt_rg md_zw_opt_rg_tmot md_zw_opt_rg_tmot_la md_zw_rg_delta md_zw_tmot_delta /end OUT_MEASUREMENT
/end FUNCTION
/begin FUNCTION Momentenmanager-Ebene_2 ""
 /begin DEF_CHARACTERISTIC K_MD_E2_ERR_MAX K_MD_E2_FW_REL_SCHW K_MD_E2_IST_SCHW K_MD_E2_MAX_SCHW K_MD_E2_MIN_SCHW K_MD_E2_N_MIN K_MD_E2_SCHLEPP_SCHW K_MD_E2_TAU_SOLL K_MD_ETA_LA_E2 K_MD_ETA_ZW_MIN_E2 K_MD_HYP_DN_E2 K_MD_HYP_VERH_E2 K_MD_IND_REIB_ABREG_E2 K_MD_LLR_AD_MAX_E2 K_MD_MSR_MAX_E2 K_MD_POLYNOM_A_E2 K_MD_POLYNOM_B_E2 K_MD_START_OFF_E2 K_MD_TAU_START_OFF_E2 K_MD_VERBR_MAX_E2 K_MD_ZYL_ANZ_E2 K_MD_ZYL_MASK_B1 K_MD_ZYL_MASK_B2 KF_MD_FAHRER_KOMFORT_E2 KF_MD_FAHRER_NORMAL_E2 KF_MD_FAHRER_SPORT_E2 KF_MD_IND_LW_VERLUSTE_E2 KF_MD_IND_MIN_SCHUB_E2 KF_MD_IND_OPT_E2 KF_MD_IND_REIB_E2 KF_MD_KUPP_OFF_E2 KF_MD_SMG_BEGR_OFF_E2 KF_MD_ZW_OPT_E2 KL_MD_FAHRER_FAK_E2 KL_MD_IND_REIB_OFFSET_E2 KL_MD_RF_MAX_E2 /end DEF_CHARACTERISTIC
 /begin OUT_MEASUREMENT md_dsc_freig_st_e2 md_e2_fehler md_e2_fw_rel_err md_e2_ist_err md_e2_istsoll_err md_e2_max_err md_e2_min_err md_e2_schlepp_err md_eta_ausblend_e2 md_eta_zw_ne_e2 md_fw_fgr_ md_fw_fgr_e2 md_fw_rel_diff md_fw_rel_e2 md_ind_lw_e2 md_ind_max_e2 md_ind_min_e2 md_ind_opt_diff md_ind_opt_e2 md_ind_reib_e2 md_ind_reib_offset_e2 md_ind_schlepp_diff md_ind_schlepp_e2 md_kupp_ist_e2 md_kupp_ist_soll_e2 md_kupp_max_diff md_kupp_max_e2 md_kupp_min_diff md_kupp_min_e2 md_kupp_msr_e2 md_kupp_off_e2 md_kupp_soll_e2 md_kupp_wunsch_e2 md_start_offset_e2 md_zw_opt_e2 /end OUT_MEASUREMENT
/end FUNCTION
/begin FUNCTION Motoroeltemperatur ""
 /begin DEF_CHARACTERISTIC K_TOEL_AEBEGR K_TOEL_BEGR_OFFS K_TOEL_DELTA_E2 K_TOEL_ERR_MAX_E2 K_TOEL_KOMBI_WSTATE K_TOEL_MAX_E2 K_TOEL_MAX_NEG_GRAD_E2 K_TOEL_MAX_POS_GRAD_E2 K_TOEL_MIN_E2 K_TOEL_N_T1 K_TOEL_T_MS K_TOEL_TMOT_GRD_F K_TOEL_WANNE_GRD_F KF_TOEL_V_TAN_MW KL_TOEL_DN KL_TOEL_N KL_TOEL_WICHT /end DEF_CHARACTERISTIC
 /begin OUT_MEASUREMENT toel_aufwaerm toel_dt toel_dt_dn toel_dt_n toel_dt_tmot toel_dt_wanne toel_e2 toel_e2_err toel_kalt toel_kalt_neu toel_n_filt toel_save_abst toel_start toel_warm /end OUT_MEASUREMENT
/end FUNCTION
/begin FUNCTION Motortemperatur ""
 /begin DEF_CHARACTERISTIC K_TMOT_CC_HIGH_HYS K_TMOT_CC_HIGH_TMOT_2 K_TMOT_CC_HIGH_TOEL_1 K_TMOT_CC_HIGH_TOEL_2 K_TMOT_CC_HIGH_ZWS_OFF K_TMOT_CFG_TOEL K_TMOT_DIAG_GRAD_MAX K_TMOT_DIAG_GRAD_TAU K_TMOT_DIAG_MAX K_TMOT_DIAG_MIN K_TMOT_DIAG_TAN K_TMOT_DIAG_TIME K_TMOT_DIAG_TKA K_TMOT_DK_TAU K_TMOT_ELU_ERR_CC_HIGH_TMOT_1 K_TMOT_ERR_MAX_E2 K_TMOT_MAX_E2 K_TMOT_MAX_NEG_GRAD_E2 K_TMOT_MAX_NEG_GRADIENT K_TMOT_MAX_POS_GRAD_E2 K_TMOT_MIN_E2 K_TMOT_MODELL_C_MOTOR K_TMOT_MODELL_ERSATZ K_TMOT_MODELL_F_KW K_TMOT_MODELL_F_MOTOR K_TMOT_MODELL_GAIN K_TMOT_MODELL_LAM_MAX K_TMOT_MODELL_LAM_MIN K_TMOT_MODELL_SA_ML_F K_TMOT_MODELL_START_MIN K_TMOT_MODELL_TAU_KRAFT K_TMOT_MODELL_TAU_KUEHLER K_TMOT_MODELL_TAU_UMG K_TMOT_MODELL_THERM_DELTA K_TMOT_MODELL_THERM_MIN K_TMOT_MODELL_TI_F K_TMOT_MODELL_TKA_ERSATZ_DELTA K_TMOT_MODELL_TMOT_MODELL_ML K_TMOT_OBD_BLOCKHEATER_DIFF K_TMOT_OBD_CFG K_TMOT_OBD_DIFF_HIGH K_TMOT_OBD_DIFF_MAX K_TMOT_OBD_HIGH K_TMOT_OBD_HIGH_TIME K_TMOT_OBD_T_ML_MIN K_TMOT_OBD_T_SA_MAX K_TMOT_OBD_THERM_2 K_TMOT_OBD_THERM_2_START K_TMOT_OBD_TKA_THERM_1_DELTA K_TMOT_OBD_TKA_THERM_2_DELTA K_TMOT_OBD_TMOT_MIN K_TMOT_OBD_TMOT_MODELL_MAX K_TMOT_SK_DELTA K_TMOT_TAU KF_TMOT_MODELL_ML_WICHT KF_TMOT_OBD_ML_GES_MW KL_TMOT_CC_HIGH_TMOT_1 KL_TMOT_NTC KL_TMOT_OBD_DELTA KL_TMOT_OBD_DIFF_T_DELTA KL_TMOT_OBD_MODELL_DELTA /end DEF_CHARACTERISTIC
 /begin OUT_MEASUREMENT tmot_ad tmot_diag_grad_filter tmot_dk tmot_e2 tmot_err_e2 tmot_filter tmot_modell_delta tmot_modell_f_kw tmot_modell_f_therm tmot_modell_lam_ist_mw tmot_modell_ml_wicht tmot_modell_st tmot_modell_st_ml_wicht tmot_modell_temp_kraft tmot_modell_temp_kraft_roh tmot_modell_temp_kuehler tmot_modell_temp_kuehler_roh tmot_modell_tumg tmot_modell_tumg_roh tmot_obd_delta tmot_obd_diff_t_delta tmot_obd_diff_t_delta_io tmot_obd_diff_t_delta_nio tmot_obd_max tmot_obd_min tmot_obd_ml_ges_int tmot_obd_ml_ges_mw tmot_obd_ml_ges_time tmot_obd_modell_abw tmot_obd_modell_delta tmot_obd_modell_max tmot_obd_modell_min tmot_obd_st tmot_obd_st_block_sperre tmot_obd_st_fehlerz_sperre tmot_obd_st_haengt_nicht tmot_obd_st_init tmot_obd_st_ml_sperre tmot_obd_st_plausibel tmot_obd_st_sa_sperre tmot_obd_st_thermo_ok tmot_roh /end OUT_MEASUREMENT
/end FUNCTION
/begin FUNCTION PCTRL "" /begin DEF_CHARACTERISTIC K_PCTRL_PROZ_ZYKL K_PCTRL_TASK_ZYKL K_PCTRL_TIMEOUT /end DEF_CHARACTERISTIC
 /begin OUT_MEASUREMENT pctrl_proz pctrl_proz_err pctrl_proz_tb pctrl_t_old_ipk pctrl_task pctrl_task_err pctrl_task_tb pctrl_tout /end OUT_MEASUREMENT
/end FUNCTION
/begin FUNCTION Pedalwertgeber ""
 /begin DEF_CHARACTERISTIC K_PWG_A0_MIN_E2 K_PWG_A0_TAU K_PWG_A0_ZAEHLER K_PWG_AB_RAMPE K_PWG_BLS_CFG K_PWG_BLS_N_MAX_FSP K_PWG_BLS_PWG_MAX K_PWG_BLS_PWG_MIN K_PWG_BLS_T_BRP_FEHLER K_PWG_BLS_T_V_FEHLER K_PWG_BLS_V_MAX K_PWG_BLS_V_MIN K_PWG_BLS_V_VORNE_MAX K_PWG_DELTA_E2 K_PWG_ERR_MAX_E2 K_PWG_KD K_PWG_NORM_E2 K_PWG_NORM_HS_E2 K_PWG_SK_NULLAGE K_PWG_SMG_ANFAHREN_FAK_E2 K_PWG_SOLL_2GANG_AUF K_PWG_SOLL_2GANG_FAK K_PWG_SOLL_2GANG_MAX K_PWG_SOLL_2GANG_VMAX K_PWG_TAU K_PWG_TAU_FEHLER K_PWG1_A0_INITINC K_PWG1_A0_MAX K_PWG1_A0_MIN K_PWG1_DIAG_MAX K_PWG1_DIAG_MIN K_PWG1_INC_A0_ADAPT K_PWG1_NORM K_PWG1_NORM_HS KL_PWG_BLS_BRP KL_PWG_BLS_V KL_PWG_MAX_DIFF KL_PWG_SOLL KL_PWG_SOLL_NOTLAUF /end DEF_CHARACTERISTIC
 /begin OUT_MEASUREMENT pwg pwg_ab_rampe pwg_abschalt pwg_abschalt_bremse pwg_abschalt_sperre pwg_begrenz pwg_bls_st pwg_bls_st_begrenzung pwg_bls_st_berganfahren pwg_bls_st_druckerfassung pwg_bls_st_v_begrenzung pwg_bls_t_brp pwg_bls_t_v pwg_err_e2 pwg_filter pwg_max_diff pwg_mode_ign pwg_soll_2gang_fak pwg_soll_2gang_st pwg_soll_e2 pwg_st_ed pwg_st_ed_kanal_fehler pwg_st_ed_kanal_filter pwg_st_ed_pwg1_fehler pwg_st_ed_pwg2_fehler pwg_st_ed_uext1_fehler pwg_st_ed_uext2_fehler pwg1_a0_zaehler pwg1_ad pwg1_roh pwg2_a0_zaehler pwg2_ad pwg2_roh /end OUT_MEASUREMENT
/end FUNCTION
/begin FUNCTION PKS ""
 /begin DEF_CHARACTERISTIC K_PKS_CAN_ALIVE_ERR_MAX K_PKS_CAN_ED_T_SPERR K_PKS_CAN_ED_UB_MIN /end DEF_CHARACTERISTIC
 /begin OUT_MEASUREMENT pks_can_alive pks_can_ed_tsperr pks_can_sw_vers pks_can_timeout /end OUT_MEASUREMENT
/end FUNCTION
/begin FUNCTION qadc_conf "" /begin OUT_MEASUREMENT qadc_check_ccw_adr qadc_check_ccw_st qadc_err_cnt /end OUT_MEASUREMENT /end FUNCTION
/begin FUNCTION RamCheck "" /begin DEF_CHARACTERISTIC K_RAM_CHK_CFG K_RAM_CHK_T /end DEF_CHARACTERISTIC /begin OUT_MEASUREMENT ram_chk_freq ram_chk_rptr /end OUT_MEASUREMENT /end FUNCTION
/begin FUNCTION Relativzeitdiagnose ""
 /begin DEF_CHARACTERISTIC K_TIME_REL_OBD_CFG K_TIME_REL_OBD_MAX_FEHLER K_TIME_REL_OBD_T_MAX K_TIME_REL_OBD_T_MIN K_TIME_REL_OBD_T_ML K_TIME_REL_OBD_TMOT_ABSTELL K_TIME_REL_OBD_TMOT_DELTA_MIN K_TIME_REL_OBD_TMOT_START_FAST K_TIME_REL_OBD_TMOT_START_SLOW K_TIME_REL_OBD_UB_MIN K_TIME_REL_OBD_ZERO_CNT_MAX KF_TIME_REL_OBD_MAX_STANDZEIT KF_TIME_REL_OBD_MIN_STANDZEIT /end DEF_CHARACTERISTIC
 /begin OUT_MEASUREMENT time_rel_delta time_rel_motor_start time_rel_obd_st time_rel_st /end OUT_MEASUREMENT
/end FUNCTION
/begin RECORD_LAYOUT TKF_SW_SW_SW FNC_VALUES 5 SWORD COLUMN_DIR DIRECT AXIS_PTS_X 3 SWORD INDEX_INCR DIRECT AXIS_PTS_Y 4 SWORD INDEX_INCR DIRECT NO_AXIS_PTS_X 1 UBYTE NO_AXIS_PTS_Y 2 UBYTE /end RECORD_LAYOUT
/begin RECORD_LAYOUT TKF_SW_SW_UW FNC_VALUES 5 UWORD COLUMN_DIR DIRECT AXIS_PTS_X 3 SWORD INDEX_INCR DIRECT AXIS_PTS_Y 4 SWORD INDEX_INCR DIRECT NO_AXIS_PTS_X 1 UBYTE NO_AXIS_PTS_Y 2 UBYTE /end RECORD_LAYOUT
/begin RECORD_LAYOUT TKL_SW_VV_SW FNC_VALUES 4 SWORD COLUMN_DIR DIRECT AXIS_PTS_X 3 SWORD INDEX_INCR DIRECT NO_AXIS_PTS_X 1 UBYTE RESERVED 2 BYTE /end RECORD_LAYOUT
/begin RECORD_LAYOUT TKL_SW_VV_UB FNC_VALUES 4 UBYTE COLUMN_DIR DIRECT AXIS_PTS_X 3 SWORD INDEX_INCR DIRECT NO_AXIS_PTS_X 1 UBYTE RESERVED 2 BYTE /end RECORD_LAYOUT
/begin RECORD_LAYOUT TKL_SW_VV_UW FNC_VALUES 4 UWORD COLUMN_DIR DIRECT AXIS_PTS_X 3 SWORD INDEX_INCR DIRECT NO_AXIS_PTS_X 1 UBYTE RESERVED 2 BYTE /end RECORD_LAYOUT
/begin RECORD_LAYOUT TKL_UB_VV_SW FNC_VALUES 4 SWORD COLUMN_DIR DIRECT AXIS_PTS_X 3 UBYTE INDEX_INCR DIRECT NO_AXIS_PTS_X 1 UBYTE RESERVED 2 BYTE /end RECORD_LAYOUT
/begin RECORD_LAYOUT TKL_UB_VV_UB FNC_VALUES 4 UBYTE COLUMN_DIR DIRECT AXIS_PTS_X 3 UBYTE INDEX_INCR DIRECT NO_AXIS_PTS_X 1 UBYTE RESERVED 2 BYTE /end RECORD_LAYOUT
/begin RECORD_LAYOUT TKL_UW_VV_SW FNC_VALUES 4 SWORD COLUMN_DIR DIRECT AXIS_PTS_X 3 UWORD INDEX_INCR DIRECT NO_AXIS_PTS_X 1 UBYTE RESERVED 2 BYTE /end RECORD_LAYOUT
/begin RECORD_LAYOUT TKL_UW_VV_UW FNC_VALUES 4 UWORD COLUMN_DIR DIRECT AXIS_PTS_X 3 UWORD INDEX_INCR DIRECT NO_AXIS_PTS_X 1 UBYTE RESERVED 2 BYTE /end RECORD_LAYOUT
/begin RECORD_LAYOUT TKW_VV_VV_SB FNC_VALUES 1 SBYTE COLUMN_DIR DIRECT /end RECORD_LAYOUT
/begin RECORD_LAYOUT TKW_VV_VV_SW FNC_VALUES 1 SWORD COLUMN_DIR DIRECT /end RECORD_LAYOUT
/begin RECORD_LAYOUT TKW_VV_VV_UB FNC_VALUES 1 UBYTE COLUMN_DIR DIRECT /end RECORD_LAYOUT
/begin RECORD_LAYOUT TKW_VV_VV_UL FNC_VALUES 1 ULONG COLUMN_DIR DIRECT /end RECORD_LAYOUT
/begin RECORD_LAYOUT TKW_VV_VV_UW FNC_VALUES 1 UWORD COLUMN_DIR DIRECT /end RECORD_LAYOUT
/end MODULE
/end PROJECT
