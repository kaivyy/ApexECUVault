ASAP2_VERSION 1 3
/begin PROJECT P390 "BMW DDE6.2 6-Zylinder VP0.1 11.11.2003 CAN12H"
/begin HEADER "" VERSION "VP01_6Z_CAN12H" PROJECT_NO P390 /end HEADER
/begin MODULE DIM ""
/begin MOD_COMMON "" BYTE_ORDER MSB_FIRST ALIGNMENT_BYTE 1 ALIGNMENT_WORD 2 ALIGNMENT_LONG 4 ALIGNMENT_FLOAT32_IEEE 4 /end MOD_COMMON
/begin CHARACTERISTIC DSM_CDKDfp_Layer_TANS_C "Kundenspezifischer Fehlercode fuer Fehlerpfad Dfp_Layer_TANS" VAL_BLK 0xC9660 Kwb_Wu16 65535.00 OneToOne 0.00 65535.00 FORMAT "%8.2" NUMBER 4 /end CHARACTERISTIC
/begin CHARACTERISTIC DSM_CDKDfp_ACCDSwtin_C "Kundenspezifischer Fehlercode fuer Fehlerpfad Dfp_ACCDSwtin" VAL_BLK 0xC9668 Kwb_Wu16 65535.00 OneToOne 0.00 65535.00 FORMAT "%8.2" NUMBER 4 /end CHARACTERISTIC
/begin CHARACTERISTIC DSM_CDKDfp_ACC_PlausTrqDes_C "Kundenspezifischer Fehlercode fuer Fehlerpfad Dfp_ACC_PlausTrqDes" VAL_BLK 0xC9670 Kwb_Wu16 65535.00 OneToOne 0.00 65535.00 FORMAT "%8.2" NUMBER 4 /end CHARACTERISTIC
/begin CHARACTERISTIC DSM_CDKDfp_ACC_trqInr_C "Kundenspezifischer Fehlercode fuer Fehlerpfad Dfp_ACC_trqInr" VAL_BLK 0xC9678 Kwb_Wu16 65535.00 OneToOne 0.00 65535.00 FORMAT "%8.2" NUMBER 4 /end CHARACTERISTIC
/begin CHARACTERISTIC DSM_CDKDfp_ACTrq_C "Kundenspezifischer Fehlercode fuer Fehlerpfad Dfp_ACTrq" VAL_BLK 0xC9680 Kwb_Wu16 65535.00 OneToOne 0.00 65535.00 FORMAT "%8.2" NUMBER 4 /end CHARACTERISTIC
/begin CHARACTERISTIC DSM_CDKDfp_ADCMon_C "Kundenspezifischer Fehlercode fuer Fehlerpfad Dfp_ADCMon" VAL_BLK 0xC9688 Kwb_Wu16 65535.00 OneToOne 0.00 65535.00 FORMAT "%8.2" NUMBER 4 /end CHARACTERISTIC
/begin CHARACTERISTIC DSM_CDKDfp_AFSCDIdlAdjVal_C "Kundenspezifischer Fehlercode fuer Fehlerpfad Dfp_AFSCDIdlAdjVal" VAL_BLK 0xC9690 Kwb_Wu16 65535.00 OneToOne 0.00 65535.00 FORMAT "%8.2" NUMBER 4 /end CHARACTERISTIC
/begin CHARACTERISTIC DSM_CDKDfp_AFSCDLdAdjVal_C "Kundenspezifischer Fehlercode fuer Fehlerpfad Dfp_AFSCDLdAdjVal" VAL_BLK 0xC9698 Kwb_Wu16 65535.00 OneToOne 0.00 65535.00 FORMAT "%8.2" NUMBER 4 /end CHARACTERISTIC
/begin CHARACTERISTIC DSM_CDKDfp_AFSCD_AirTempDcyc_C "Kundenspezifischer Fehlercode fuer Fehlerpfad Dfp_AFSCD_AirTempDcyc" VAL_BLK 0xC96A0 Kwb_Wu16 65535.00 OneToOne 0.00 65535.00 FORMAT "%8.2" NUMBER 4 /end CHARACTERISTIC
/begin CHARACTERISTIC DSM_CDKDfp_AFSCD_PlOffsDrft_C "Kundenspezifischer Fehlercode fuer Fehlerpfad Dfp_AFSCD_PlOffsDrft" VAL_BLK 0xC96A8 Kwb_Wu16 65535.00 OneToOne 0.00 65535.00 FORMAT "%8.2" NUMBER 4 /end CHARACTERISTIC
/begin CHARACTERISTIC DSM_CDKDfp_AFSCD_PlSetyDrft_C "Kundenspezifischer Fehlercode fuer Fehlerpfad Dfp_AFSCD_PlSetyDrft" VAL_BLK 0xC96B0 Kwb_Wu16 65535.00 OneToOne 0.00 65535.00 FORMAT "%8.2" NUMBER 4 /end CHARACTERISTIC
/begin CHARACTERISTIC DSM_CDKDfp_AFSCD_SRCAirTemp_C "Kundenspezifischer Fehlercode fuer Fehlerpfad Dfp_AFSCD_SRCAirTemp" VAL_BLK 0xC96B8 Kwb_Wu16 65535.00 OneToOne 0.00 65535.00 FORMAT "%8.2" NUMBER 4 /end CHARACTERISTIC
/begin CHARACTERISTIC DSM_CDKDfp_AFSCD_SRCBatt_C "Kundenspezifischer Fehlercode fuer Fehlerpfad Dfp_AFSCD_SRCBatt" VAL_BLK 0xC96C0 Kwb_Wu16 65535.00 OneToOne 0.00 65535.00 FORMAT "%8.2" NUMBER 4 /end CHARACTERISTIC
/begin CHARACTERISTIC DSM_CDKDfp_AFSCD_SRCCorrAirm_C "Kundenspezifischer Fehlercode fuer Fehlerpfad Dfp_AFSCD_SRCCorrAirm" VAL_BLK 0xC96C8 Kwb_Wu16 65535.00 OneToOne 0.00 65535.00 FORMAT "%8.2" NUMBER 4 /end CHARACTERISTIC
/begin CHARACTERISTIC DSM_CDKDfp_AFSCD_SRCRawAirm_C "Kundenspezifischer Fehlercode fuer Fehlerpfad Dfp_AFSCD_SRCRawAirm" VAL_BLK 0xC96D0 Kwb_Wu16 65535.00 OneToOne 0.00 65535.00 FORMAT "%8.2" NUMBER 4 /end CHARACTERISTIC
/begin CHARACTERISTIC DSM_CDKDfp_AFSCD_SRCRefSigPer_C "Kundenspezifischer Fehlercode fuer Fehlerpfad Dfp_AFSCD_SRCRefSigPer" VAL_BLK 0xC96D8 Kwb_Wu16 65535.00 OneToOne 0.00 65535.00 FORMAT "%8.2" NUMBER 4 /end CHARACTERISTIC
/begin CHARACTERISTIC DSM_CDKDfp_AOHtCD_C "Kundenspezifischer Fehlercode fuer Fehlerpfad Dfp_AOHtCD" VAL_BLK 0xC96E0 Kwb_Wu16 65535.00 OneToOne 0.00 65535.00 FORMAT "%8.2" NUMBER 4 /end CHARACTERISTIC
/begin CHARACTERISTIC DSM_CDKDfp_AOHtCD_AOHtDia1_C "Kundenspezifischer Fehlercode fuer Fehlerpfad Dfp_AOHtCD_AOHtDia1" VAL_BLK 0xC96E8 Kwb_Wu16 65535.00 OneToOne 0.00 65535.00 FORMAT "%8.2" NUMBER 4 /end CHARACTERISTIC
/begin CHARACTERISTIC DSM_CDKDfp_AOHtCD_AOHtDia2_C "Kundenspezifischer Fehlercode fuer Fehlerpfad Dfp_AOHtCD_AOHtDia2" VAL_BLK 0xC96F0 Kwb_Wu16 65535.00 OneToOne 0.00 65535.00 FORMAT "%8.2" NUMBER 4 /end CHARACTERISTIC
/begin CHARACTERISTIC DSM_CDKDfp_Layer_TUMG_C "Kundenspezifischer Fehlercode fuer Fehlerpfad Dfp_Layer_TUMG" VAL_BLK 0xC96F8 Kwb_Wu16 65535.00 OneToOne 0.00 65535.00 FORMAT "%8.2" NUMBER 4 /end CHARACTERISTIC
/begin CHARACTERISTIC DSM_CDKDfp_AOHtCD_AOHtDia3_C "Kundenspezifischer Fehlercode fuer Fehlerpfad Dfp_AOHtCD_AOHtDia3" VAL_BLK 0xC9700 Kwb_Wu16 65535.00 OneToOne 0.00 65535.00 FORMAT "%8.2" NUMBER 4 /end CHARACTERISTIC
/begin CHARACTERISTIC DSM_CDKDfp_APP1_C "Kundenspezifischer Fehlercode fuer Fehlerpfad Dfp_APP1" VAL_BLK 0xC9708 Kwb_Wu16 65535.00 OneToOne 0.00 65535.00 FORMAT "%8.2" NUMBER 4 /end CHARACTERISTIC
/begin CHARACTERISTIC DSM_CDKDfp_Layer_GEN_C "Kundenspezifischer Fehlercode fuer Fehlerpfad Dfp_Layer_GEN" VAL_BLK 0xC9710 Kwb_Wu16 65535.00 OneToOne 0.00 65535.00 FORMAT "%8.2" NUMBER 4 /end CHARACTERISTIC
/begin CHARACTERISTIC DSM_CDKDfp_Layer_BSD_C "Kundenspezifischer Fehlercode fuer Fehlerpfad Dfp_Layer_BSD" VAL_BLK 0xC9718 Kwb_Wu16 65535.00 OneToOne 0.00 65535.00 FORMAT "%8.2" NUMBER 4 /end CHARACTERISTIC
/begin CHARACTERISTIC DSM_CDKDfp_APP2_C "Kundenspezifischer Fehlercode fuer Fehlerpfad Dfp_APP2" VAL_BLK 0xC9720 Kwb_Wu16 65535.00 OneToOne 0.00 65535.00 FORMAT "%8.2" NUMBER 4 /end CHARACTERISTIC
/begin CHARACTERISTIC DSM_CDKDfp_APSCD_C "Kundenspezifischer Fehlercode fuer Fehlerpfad Dfp_APSCD" VAL_BLK 0xC9728 Kwb_Wu16 65535.00 OneToOne 0.00 65535.00 FORMAT "%8.2" NUMBER 4 /end CHARACTERISTIC
/begin CHARACTERISTIC DSM_CDKDfp_ARS_C "Kundenspezifischer Fehlercode fuer Fehlerpfad Dfp_ARS" VAL_BLK 0xC9730 Kwb_Wu16 65535.00 OneToOne 0.00 65535.00 FORMAT "%8.2" NUMBER 4 /end CHARACTERISTIC
/begin CHARACTERISTIC DSM_CDKDfp_AccPedPlausBrk_C "Kundenspezifischer Fehlercode fuer Fehlerpfad Dfp_AccPedPlausBrk" VAL_BLK 0xC9738 Kwb_Wu16 65535.00 OneToOne 0.00 65535.00 FORMAT "%8.2" NUMBER 4 /end CHARACTERISTIC
/begin CHARACTERISTIC DSM_CDKDfp_AirCtlPlateBreak_C "DSM variable for Dfp_AirCtlPlateBreak_mp" VAL_BLK 0xC9740 Kwb_Wu16 65535.00 OneToOne 0.00 65535.00 FORMAT "%8.2" NUMBER 4 /end CHARACTERISTIC
/begin CHARACTERISTIC DSM_CDKDfp_AirCtl_GovNegDev_C "Kundenspezifischer Fehlercode fuer Fehlerpfad Dfp_AirCtl_GovNegDev" VAL_BLK 0xC9748 Kwb_Wu16 65535.00 OneToOne 0.00 65535.00 FORMAT "%8.2" NUMBER 4 /end CHARACTERISTIC
/begin CHARACTERISTIC DSM_CDKDfp_AirCtl_GovNegDev2_C "Kundenspezifischer Fehlercode fuer Fehlerpfad Dfp_AirCtl_GovNegDev2" VAL_BLK 0xC9750 Kwb_Wu16 65535.00 OneToOne 0.00 65535.00 FORMAT "%8.2" NUMBER 4 /end CHARACTERISTIC
/begin CHARACTERISTIC DSM_CDKDfp_AirCtl_GovPosDev_C "Kundenspezifischer Fehlercode fuer Fehlerpfad Dfp_AirCtl_GovPosDev" VAL_BLK 0xC9758 Kwb_Wu16 65535.00 OneToOne 0.00 65535.00 FORMAT "%8.2" NUMBER 4 /end CHARACTERISTIC
/begin CHARACTERISTIC DSM_CDKDfp_AirCtl_GovPosDev2_C "Kundenspezifischer Fehlercode fuer Fehlerpfad Dfp_AirCtl_GovPosDev2" VAL_BLK 0xC9760 Kwb_Wu16 65535.00 OneToOne 0.00 65535.00 FORMAT "%8.2" NUMBER 4 /end CHARACTERISTIC
/begin CHARACTERISTIC DSM_CDKDfp_AltCD_C "Kundenspezifischer Fehlercode fuer Fehlerpfad Dfp_AltCD" VAL_BLK 0xC9768 Kwb_Wu16 65535.00 OneToOne 0.00 65535.00 FORMAT "%8.2" NUMBER 4 /end CHARACTERISTIC
/begin CHARACTERISTIC DSM_CDKDfp_Layer_QLT_C "Kundenspezifischer Fehlercode fuer Fehlerpfad Dfp_Layer_QLT" VAL_BLK 0xC9770 Kwb_Wu16 65535.00 OneToOne 0.00 65535.00 FORMAT "%8.2" NUMBER 4 /end CHARACTERISTIC
/begin CHARACTERISTIC DSM_CDKDfp_BPACD_BPADia1_C "Kundenspezifischer Fehlercode fuer Fehlerpfad Dfp_BPACD_BPADia1" VAL_BLK 0xC9778 Kwb_Wu16 65535.00 OneToOne 0.00 65535.00 FORMAT "%8.2" NUMBER 4 /end CHARACTERISTIC
/begin CHARACTERISTIC DSM_CDKDfp_Layer_IBS1_C "Kundenspezifischer Fehlercode fuer Fehlerpfad Dfp_Layer_IBS1" VAL_BLK 0xC9780 Kwb_Wu16 65535.00 OneToOne 0.00 65535.00 FORMAT "%8.2" NUMBER 4 /end CHARACTERISTIC
/begin CHARACTERISTIC DSM_CDKDfp_Layer_IBS2_C "Kundenspezifischer Fehlercode fuer Fehlerpfad Dfp_Layer_IBS2" VAL_BLK 0xC9788 Kwb_Wu16 65535.00 OneToOne 0.00 65535.00 FORMAT "%8.2" NUMBER 4 /end CHARACTERISTIC
/begin CHARACTERISTIC DSM_CDKDfp_Layer_IBS3_C "Kundenspezifischer Fehlercode fuer Fehlerpfad Dfp_Layer_IBS3" VAL_BLK 0xC9790 Kwb_Wu16 65535.00 OneToOne 0.00 65535.00 FORMAT "%8.2" NUMBER 4 /end CHARACTERISTIC
/begin CHARACTERISTIC DSM_CDKDfp_Layer_PMBN_C "Kundenspezifischer Fehlercode fuer Fehlerpfad Dfp_Layer_PMBN" VAL_BLK 0xC9798 Kwb_Wu16 65535.00 OneToOne 0.00 65535.00 FORMAT "%8.2" NUMBER 4 /end CHARACTERISTIC
/begin CHARACTERISTIC DSM_CDKDfp_Layer_PMBATT_C "Kundenspezifischer Fehlercode fuer Fehlerpfad Dfp_Layer_PMBATT" VAL_BLK 0xC97A0 Kwb_Wu16 65535.00 OneToOne 0.00 65535.00 FORMAT "%8.2" NUMBER 4 /end CHARACTERISTIC
/begin CHARACTERISTIC DSM_CDKDfp_BPACD_BPADia2_C "Kundenspezifischer Fehlercode fuer Fehlerpfad Dfp_BPACD_BPADia2" VAL_BLK 0xC97A8 Kwb_Wu16 65535.00 OneToOne 0.00 65535.00 FORMAT "%8.2" NUMBER 4 /end CHARACTERISTIC
/begin CHARACTERISTIC DSM_CDKDfp_BPACD_BPADia3_C "Kundenspezifischer Fehlercode fuer Fehlerpfad Dfp_BPACD_BPADia3" VAL_BLK 0xC97B0 Kwb_Wu16 65535.00 OneToOne 0.00 65535.00 FORMAT "%8.2" NUMBER 4 /end CHARACTERISTIC
/begin CHARACTERISTIC DSM_CDKDfp_BPACD_Max_C "Kundenspezifischer Fehlercode fuer Fehlerpfad Dfp_BPACD_Max" VAL_BLK 0xC97B8 Kwb_Wu16 65535.00 OneToOne 0.00 65535.00 FORMAT "%8.2" NUMBER 4 /end CHARACTERISTIC
/begin CHARACTERISTIC DSM_CDKDfp_BPACD_Min_C "Kundenspezifischer Fehlercode fuer Fehlerpfad Dfp_BPACD_Min" VAL_BLK 0xC97C0 Kwb_Wu16 65535.00 OneToOne 0.00 65535.00 FORMAT "%8.2" NUMBER 4 /end CHARACTERISTIC
/begin CHARACTERISTIC DSM_CDKDfp_BPACD_SigNpl_C "Kundenspezifischer Fehlercode fuer Fehlerpfad Dfp_BPACD_SigNpl" VAL_BLK 0xC97C8 Kwb_Wu16 65535.00 OneToOne 0.00 65535.00 FORMAT "%8.2" NUMBER 4 /end CHARACTERISTIC
/begin CHARACTERISTIC DSM_CDKDfp_BPSCD_C "Kundenspezifischer Fehlercode fuer Fehlerpfad Dfp_BPSCD" VAL_BLK 0xC97D0 Kwb_Wu16 65535.00 OneToOne 0.00 65535.00 FORMAT "%8.2" NUMBER 4 /end CHARACTERISTIC
/begin CHARACTERISTIC DSM_CDKDfp_BattCD_C "Kundenspezifischer Fehlercode fuer Fehlerpfad Dfp_BattCD" VAL_BLK 0xC97D8 Kwb_Wu16 65535.00 OneToOne 0.00 65535.00 FORMAT "%8.2" NUMBER 4 /end CHARACTERISTIC
/begin CHARACTERISTIC DSM_CDKDfp_BrkCD_C "Kundenspezifischer Fehlercode fuer Fehlerpfad Dfp_BrkCD" VAL_BLK 0xC97E0 Kwb_Wu16 65535.00 OneToOne 0.00 65535.00 FORMAT "%8.2" NUMBER 4 /end CHARACTERISTIC
/begin CHARACTERISTIC DSM_CDKDfp_Bss_C "Kundenspezifischer Fehlercode fuer Fehlerpfad Dfp_Bss" VAL_BLK 0xC97E8 Kwb_Wu16 65535.00 OneToOne 0.00 65535.00 FORMAT "%8.2" NUMBER 4 /end CHARACTERISTIC
/begin CHARACTERISTIC DSM_CDKDfp_CBACD_C "Kundenspezifischer Fehlercode fuer Fehlerpfad Dfp_CBACD" VAL_BLK 0xC97F0 Kwb_Wu16 65535.00 OneToOne 0.00 65535.00 FORMAT "%8.2" NUMBER 4 /end CHARACTERISTIC
/begin CHARACTERISTIC DSM_CDKDfp_CTSCD_C "Kundenspezifischer Fehlercode fuer Fehlerpfad Dfp_CTSCD" VAL_BLK 0xC97F8 Kwb_Wu16 65535.00 OneToOne 0.00 65535.00 FORMAT "%8.2" NUMBER 4 /end CHARACTERISTIC
/begin CHARACTERISTIC DSM_CDKDfp_Clg_DynTst_C "Kundenspezifischer Fehlercode fuer Fehlerpfad Dfp_Clg_DynTst" VAL_BLK 0xC9800 Kwb_Wu16 65535.00 OneToOne 0.00 65535.00 FORMAT "%8.2" NUMBER 4 /end CHARACTERISTIC
/begin CHARACTERISTIC DSM_CDKDfp_CmbChbMisfire1_C "Kundenspezifischer Fehlercode fuer Fehlerpfad Dfp_CmbChbMisfire1" VAL_BLK 0xC9808 Kwb_Wu16 65535.00 OneToOne 0.00 65535.00 FORMAT "%8.2" NUMBER 4 /end CHARACTERISTIC
/begin CHARACTERISTIC DSM_CDKDfp_CmbChbMisfire2_C "Kundenspezifischer Fehlercode fuer Fehlerpfad Dfp_CmbChbMisfire2" VAL_BLK 0xC9810 Kwb_Wu16 65535.00 OneToOne 0.00 65535.00 FORMAT "%8.2" NUMBER 4 /end CHARACTERISTIC
/begin CHARACTERISTIC DSM_CDKDfp_CmbChbMisfire3_C "Kundenspezifischer Fehlercode fuer Fehlerpfad Dfp_CmbChbMisfire3" VAL_BLK 0xC9818 Kwb_Wu16 65535.00 OneToOne 0.00 65535.00 FORMAT "%8.2" NUMBER 4 /end CHARACTERISTIC
/begin CHARACTERISTIC DSM_CDKDfp_CmbChbMisfire4_C "Kundenspezifischer Fehlercode fuer Fehlerpfad Dfp_CmbChbMisfire4" VAL_BLK 0xC9820 Kwb_Wu16 65535.00 OneToOne 0.00 65535.00 FORMAT "%8.2" NUMBER 4 /end CHARACTERISTIC
/begin CHARACTERISTIC DSM_CDKDfp_CmbChbMisfire5_C "Kundenspezifischer Fehlercode fuer Fehlerpfad Dfp_CmbChbMisfire5" VAL_BLK 0xC9828 Kwb_Wu16 65535.00 OneToOne 0.00 65535.00 FORMAT "%8.2" NUMBER 4 /end CHARACTERISTIC
/begin CHARACTERISTIC DSM_CDKDfp_CmbChbMisfire6_C "Kundenspezifischer Fehlercode fuer Fehlerpfad Dfp_CmbChbMisfire6" VAL_BLK 0xC9830 Kwb_Wu16 65535.00 OneToOne 0.00 65535.00 FORMAT "%8.2" NUMBER 4 /end CHARACTERISTIC
/begin CHARACTERISTIC DSM_CDKDfp_CmbChbMisfireMul_C "Kundenspezifischer Fehlercode fuer Fehlerpfad Dfp_CmbChbMisfireMul" VAL_BLK 0xC9838 Kwb_Wu16 65535.00 OneToOne 0.00 65535.00 FORMAT "%8.2" NUMBER 4 /end CHARACTERISTIC
/begin CHARACTERISTIC DSM_CDKDfp_CoVMDCSh_C "Kundenspezifischer Fehlercode fuer Fehlerpfad Dfp_CoVMDCSh" VAL_BLK 0xC9840 Kwb_Wu16 65535.00 OneToOne 0.00 65535.00 FORMAT "%8.2" NUMBER 4 /end CHARACTERISTIC
/begin CHARACTERISTIC DSM_CDKDfp_ConvCD_C "Kundenspezifischer Fehlercode fuer Fehlerpfad Dfp_ConvCD" VAL_BLK 0xC9848 Kwb_Wu16 65535.00 OneToOne 0.00 65535.00 FORMAT "%8.2" NUMBER 4 /end CHARACTERISTIC
/begin CHARACTERISTIC DSM_CDKDfp_CrCCDMFL_C "Kundenspezifischer Fehlercode fuer Fehlerpfad Dfp_CrCCDMFL" VAL_BLK 0xC9850 Kwb_Wu16 65535.00 OneToOne 0.00 65535.00 FORMAT "%8.2" NUMBER 4 /end CHARACTERISTIC
/begin CHARACTERISTIC DSM_CDKDfp_CrCtl_vCrCtl_C "Kundenspezifischer Fehlercode fuer Fehlerpfad Dfp_CrCtl_vCrCtl" VAL_BLK 0xC9858 Kwb_Wu16 65535.00 OneToOne 0.00 65535.00 FORMAT "%8.2" NUMBER 4 /end CHARACTERISTIC
/begin CHARACTERISTIC DSM_CDKDfp_Dummy1_C "Kundenspezifischer Fehlercode fuer Fehlerpfad Dfp_Dummy1" VAL_BLK 0xC9860 Kwb_Wu16 65535.00 OneToOne 0.00 65535.00 FORMAT "%8.2" NUMBER 4 /end CHARACTERISTIC
/begin CHARACTERISTIC DSM_CDKDfp_EATSCD_C "Kundenspezifischer Fehlercode fuer Fehlerpfad Dfp_EATSCD" VAL_BLK 0xC9868 Kwb_Wu16 65535.00 OneToOne 0.00 65535.00 FORMAT "%8.2" NUMBER 4 /end CHARACTERISTIC
/begin CHARACTERISTIC DSM_CDKDfp_EBAFCD_C "Kundenspezifischer Fehlercode fuer Fehlerpfad Dfp_EBAFCD" VAL_BLK 0xC9870 Kwb_Wu16 65535.00 OneToOne 0.00 65535.00 FORMAT "%8.2" NUMBER 4 /end CHARACTERISTIC
/begin CHARACTERISTIC DSM_CDKDfp_EBFCD_C "Kundenspezifischer Fehlercode fuer Fehlerpfad Dfp_EBFCD" VAL_BLK 0xC9878 Kwb_Wu16 65535.00 OneToOne 0.00 65535.00 FORMAT "%8.2" NUMBER 4 /end CHARACTERISTIC
/begin CHARACTERISTIC DSM_CDKDfp_EBTSCD_C "Kundenspezifischer Fehlercode fuer Fehlerpfad Dfp_EBTSCD" VAL_BLK 0xC9880 Kwb_Wu16 65535.00 OneToOne 0.00 65535.00 FORMAT "%8.2" NUMBER 4 /end CHARACTERISTIC
/begin CHARACTERISTIC DSM_CDKDfp_EBTSCD_OvrTemp_C "Kundenspezifischer Fehlercode fuer Fehlerpfad Dfp_EBTSCD_OvrTemp" VAL_BLK 0xC9888 Kwb_Wu16 65535.00 OneToOne 0.00 65535.00 FORMAT "%8.2" NUMBER 4 /end CHARACTERISTIC
/begin CHARACTERISTIC DSM_CDKDfp_EEPCDVarMng_C "Kundenspezifischer Fehlercode fuer Fehlerpfad Dfp_EEPCD_VarMng" VAL_BLK 0xC9890 Kwb_Wu16 65535.00 OneToOne 0.00 65535.00 FORMAT "%8.2" NUMBER 4 /end CHARACTERISTIC
/begin CHARACTERISTIC DSM_CDKDfp_EGPpCD_C "Kundenspezifischer Fehlercode fuer Fehlerpfad Dfp_EGPpCD" VAL_BLK 0xC9898 Kwb_Wu16 65535.00 OneToOne 0.00 65535.00 FORMAT "%8.2" NUMBER 4 /end CHARACTERISTIC
/begin CHARACTERISTIC DSM_CDKDfp_EGPpCDTPreTrbn_C "Kundenspezifischer Fehlercode fuer Fehlerpfad Dfp_EgPpCDTPreTrbn" VAL_BLK 0xC98A0 Kwb_Wu16 65535.00 OneToOne 0.00 65535.00 FORMAT "%8.2" NUMBER 4 /end CHARACTERISTIC
/begin CHARACTERISTIC DSM_CDKDfp_Layer_PMRUHVERL_C "" VAL_BLK 0xC98A8 Kwb_Wu16 65535.00 OneToOne 0.00 65535.00 FORMAT "%8.2" NUMBER 4 /end CHARACTERISTIC
/begin CHARACTERISTIC DSM_CDKDfp_EGRCD_Max_C "Kundenspezifischer Fehlercode fuer Fehlerpfad Dfp_EGRCD_Max" VAL_BLK 0xC98B0 Kwb_Wu16 65535.00 OneToOne 0.00 65535.00 FORMAT "%8.2" NUMBER 4 /end CHARACTERISTIC
/begin CHARACTERISTIC DSM_CDKDfp_EGRCD_Min_C "Kundenspezifischer Fehlercode fuer Fehlerpfad Dfp_EGRCD_Min" VAL_BLK 0xC98B8 Kwb_Wu16 65535.00 OneToOne 0.00 65535.00 FORMAT "%8.2" NUMBER 4 /end CHARACTERISTIC
/begin CHARACTERISTIC DSM_CDKDfp_EGRCD_SigNpl_C "Kundenspezifischer Fehlercode fuer Fehlerpfad Dfp_EGRCD_SigNpl" VAL_BLK 0xC98C0 Kwb_Wu16 65535.00 OneToOne 0.00 65535.00 FORMAT "%8.2" NUMBER 4 /end CHARACTERISTIC
/begin CHARACTERISTIC DSM_CDKDfp_EGTRgnOilDil_C "Kundenspezifischer Fehlercode fuer Fehlerpfad Dfp_EGTRgnOilDil" VAL_BLK 0xC98C8 Kwb_Wu16 65535.00 OneToOne 0.00 65535.00 FORMAT "%8.2" NUMBER 4 /end CHARACTERISTIC
/begin CHARACTERISTIC DSM_CDKDfp_Layer_TOENS_C "" VAL_BLK 0xC98D0 Kwb_Wu16 65535.00 OneToOne 0.00 65535.00 FORMAT "%8.2" NUMBER 4 /end CHARACTERISTIC
/begin CHARACTERISTIC DSM_CDKDfp_Layer_MANHYDR_C "" VAL_BLK 0xC98D8 Kwb_Wu16 65535.00 OneToOne 0.00 65535.00 FORMAT "%8.2" NUMBER 4 /end CHARACTERISTIC
/begin CHARACTERISTIC DSM_CDKDfp_Layer_MANLUFT_C "" VAL_BLK 0xC98E0 Kwb_Wu16 65535.00 OneToOne 0.00 65535.00 FORMAT "%8.2" NUMBER 4 /end CHARACTERISTIC
/begin CHARACTERISTIC DSM_CDKDfp_ETClbETFltInj1_C "Kundenspezifischer Fehlercode fuer Fehlerpfad Dfp_ETClbETFltInj1" VAL_BLK 0xC98E8 Kwb_Wu16 65535.00 OneToOne 0.00 65535.00 FORMAT "%8.2" NUMBER 4 /end CHARACTERISTIC
/begin CHARACTERISTIC DSM_CDKDfp_ETClbETFltInj2_C "Kundenspezifischer Fehlercode fuer Fehlerpfad Dfp_ETClbETFltInj2" VAL_BLK 0xC98F0 Kwb_Wu16 65535.00 OneToOne 0.00 65535.00 FORMAT "%8.2" NUMBER 4 /end CHARACTERISTIC
/begin CHARACTERISTIC DSM_CDKDfp_ETClbETFltInj3_C "Kundenspezifischer Fehlercode fuer Fehlerpfad Dfp_ETClbETFltInj3" VAL_BLK 0xC98F8 Kwb_Wu16 65535.00 OneToOne 0.00 65535.00 FORMAT "%8.2" NUMBER 4 /end CHARACTERISTIC
/begin CHARACTERISTIC DSM_CDKDfp_ETClbETFltInj4_C "Kundenspezifischer Fehlercode fuer Fehlerpfad Dfp_ETClbETFltInj4" VAL_BLK 0xC9900 Kwb_Wu16 65535.00 OneToOne 0.00 65535.00 FORMAT "%8.2" NUMBER 4 /end CHARACTERISTIC
/begin CHARACTERISTIC DSM_CDKDfp_ETClbETFltInj5_C "Kundenspezifischer Fehlercode fuer Fehlerpfad Dfp_ETClbETFltInj5" VAL_BLK 0xC9908 Kwb_Wu16 65535.00 OneToOne 0.00 65535.00 FORMAT "%8.2" NUMBER 4 /end CHARACTERISTIC
/begin CHARACTERISTIC DSM_CDKDfp_ETClbETFltInj6_C "Kundenspezifischer Fehlercode fuer Fehlerpfad Dfp_ETClbETFltInj6" VAL_BLK 0xC9910 Kwb_Wu16 65535.00 OneToOne 0.00 65535.00 FORMAT "%8.2" NUMBER 4 /end CHARACTERISTIC
/begin CHARACTERISTIC DSM_CDKDfp_ETClbInj1_C "Kundenspezifischer Fehlercode fuer Fehlerpfad Dfp_ETClbInj1" VAL_BLK 0xC9918 Kwb_Wu16 65535.00 OneToOne 0.00 65535.00 FORMAT "%8.2" NUMBER 4 /end CHARACTERISTIC
/begin CHARACTERISTIC DSM_CDKDfp_ETClbInj2_C "Kundenspezifischer Fehlercode fuer Fehlerpfad Dfp_ETClbInj2" VAL_BLK 0xC9920 Kwb_Wu16 65535.00 OneToOne 0.00 65535.00 FORMAT "%8.2" NUMBER 4 /end CHARACTERISTIC
/begin CHARACTERISTIC DSM_CDKDfp_ETClbInj3_C "Kundenspezifischer Fehlercode fuer Fehlerpfad Dfp_ETClbInj3" VAL_BLK 0xC9928 Kwb_Wu16 65535.00 OneToOne 0.00 65535.00 FORMAT "%8.2" NUMBER 4 /end CHARACTERISTIC
/begin CHARACTERISTIC DSM_CDKDfp_ETClbInj4_C "Kundenspezifischer Fehlercode fuer Fehlerpfad Dfp_ETClbInj4" VAL_BLK 0xC9930 Kwb_Wu16 65535.00 OneToOne 0.00 65535.00 FORMAT "%8.2" NUMBER 4 /end CHARACTERISTIC
/begin CHARACTERISTIC DSM_CDKDfp_ETClbInj5_C "Kundenspezifischer Fehlercode fuer Fehlerpfad Dfp_ETClbInj5" VAL_BLK 0xC9938 Kwb_Wu16 65535.00 OneToOne 0.00 65535.00 FORMAT "%8.2" NUMBER 4 /end CHARACTERISTIC
/begin CHARACTERISTIC DSM_CDKDfp_ETClbInj6_C "Kundenspezifischer Fehlercode fuer Fehlerpfad Dfp_ETClbInj6" VAL_BLK 0xC9940 Kwb_Wu16 65535.00 OneToOne 0.00 65535.00 FORMAT "%8.2" NUMBER 4 /end CHARACTERISTIC
/begin CHARACTERISTIC DSM_CDKDfp_EngMCaS1_C "Kundenspezifischer Fehlercode fuer Fehlerpfad Dfp_EngMCaS1" VAL_BLK 0xC9948 Kwb_Wu16 65535.00 OneToOne 0.00 65535.00 FORMAT "%8.2" NUMBER 4 /end CHARACTERISTIC
/begin CHARACTERISTIC DSM_CDKDfp_EngMCrS1_C "Kundenspezifischer Fehlercode fuer Fehlerpfad Dfp_EngMCrS1" VAL_BLK 0xC9950 Kwb_Wu16 65535.00 OneToOne 0.00 65535.00 FORMAT "%8.2" NUMBER 4 /end CHARACTERISTIC
/begin CHARACTERISTIC DSM_CDKDfp_EngMOfsCaSCrS_C "Kundenspezifischer Fehlercode fuer Fehlerpfad Dfp_EngMOfsCaSCrS" VAL_BLK 0xC9958 Kwb_Wu16 65535.00 OneToOne 0.00 65535.00 FORMAT "%8.2" NUMBER 4 /end CHARACTERISTIC
/begin CHARACTERISTIC DSM_CDKDfp_EngMntCtl1_Dia1_C "" VAL_BLK 0xC9960 Kwb_Wu16 65535.00 OneToOne 0.00 65535.00 FORMAT "%8.2" NUMBER 4 /end CHARACTERISTIC
/begin CHARACTERISTIC DSM_CDKDfp_EngMntCtl1_Dia2_C "" VAL_BLK 0xC9968 Kwb_Wu16 65535.00 OneToOne 0.00 65535.00 FORMAT "%8.2" NUMBER 4 /end CHARACTERISTIC
/begin CHARACTERISTIC DSM_CDKDfp_EngMntCtl1_Dia3_C "" VAL_BLK 0xC9970 Kwb_Wu16 65535.00 OneToOne 0.00 65535.00 FORMAT "%8.2" NUMBER 4 /end CHARACTERISTIC
/begin CHARACTERISTIC DSM_CDKDfp_EngMntCtl1_Max_C "" VAL_BLK 0xC9978 Kwb_Wu16 65535.00 OneToOne 0.00 65535.00 FORMAT "%8.2" NUMBER 4 /end CHARACTERISTIC
/begin CHARACTERISTIC DSM_CDKDfp_EngMntCtl1_Min_C "" VAL_BLK 0xC9980 Kwb_Wu16 65535.00 OneToOne 0.00 65535.00 FORMAT "%8.2" NUMBER 4 /end CHARACTERISTIC
/begin CHARACTERISTIC DSM_CDKDfp_EngMntCtl1_SigNpl_C "" VAL_BLK 0xC9988 Kwb_Wu16 65535.00 OneToOne 0.00 65535.00 FORMAT "%8.2" NUMBER 4 /end CHARACTERISTIC
/begin CHARACTERISTIC DSM_CDKDfp_EngMntCtlCD_C "Kundenspezifischer Fehlercode fuer Fehlerpfad Dfp_EngMntCtlCD" VAL_BLK 0xC9990 Kwb_Wu16 65535.00 OneToOne 0.00 65535.00 FORMAT "%8.2" NUMBER 4 /end CHARACTERISTIC
/begin CHARACTERISTIC DSM_CDKDfp_EngMntCtl_Dia1_C "" VAL_BLK 0xC9998 Kwb_Wu16 65535.00 OneToOne 0.00 65535.00 FORMAT "%8.2" NUMBER 4 /end CHARACTERISTIC
/begin CHARACTERISTIC DSM_CDKDfp_EngMntCtl_Dia2_C "" VAL_BLK 0xC99A0 Kwb_Wu16 65535.00 OneToOne 0.00 65535.00 FORMAT "%8.2" NUMBER 4 /end CHARACTERISTIC
/begin CHARACTERISTIC DSM_CDKDfp_EngMntCtl_Dia3_C "" VAL_BLK 0xC99A8 Kwb_Wu16 65535.00 OneToOne 0.00 65535.00 FORMAT "%8.2" NUMBER 4 /end CHARACTERISTIC
/begin CHARACTERISTIC DSM_CDKDfp_EngMntCtl_Max_C "" VAL_BLK 0xC99B0 Kwb_Wu16 65535.00 OneToOne 0.00 65535.00 FORMAT "%8.2" NUMBER 4 /end CHARACTERISTIC
/begin CHARACTERISTIC DSM_CDKDfp_EngMntCtl_Min_C "" VAL_BLK 0xC99B8 Kwb_Wu16 65535.00 OneToOne 0.00 65535.00 FORMAT "%8.2" NUMBER 4 /end CHARACTERISTIC
/begin CHARACTERISTIC DSM_CDKDfp_EngMntCtl_SigNpl_C "" VAL_BLK 0xC99C0 Kwb_Wu16 65535.00 OneToOne 0.00 65535.00 FORMAT "%8.2" NUMBER 4 /end CHARACTERISTIC
/begin CHARACTERISTIC DSM_CDKDfp_EngPrtFWODet_C "Kundenspezifischer Fehlercode fuer Fehlerpfad Dfp_EngPrtFWODet" VAL_BLK 0xC99C8 Kwb_Wu16 65535.00 OneToOne 0.00 65535.00 FORMAT "%8.2" NUMBER 4 /end CHARACTERISTIC
/begin CHARACTERISTIC DSM_CDKDfp_FBCqDvt_C "Kundenspezifischer Fehlercode fuer Fehlerpfad Dfp_FBCqDvt" VAL_BLK 0xC99D0 Kwb_Wu16 65535.00 OneToOne 0.00 65535.00 FORMAT "%8.2" NUMBER 4 /end CHARACTERISTIC
/begin CHARACTERISTIC DSM_CDKDfp_FMTC_NonMonotonMap_C "Kundenspezifischer Fehlercode fuer Fehlerpfad Dfp_FMTC_NonMonotonMap" VAL_BLK 0xC99D8 Kwb_Wu16 65535.00 OneToOne 0.00 65535.00 FORMAT "%8.2" NUMBER 4 /end CHARACTERISTIC
/begin CHARACTERISTIC DSM_CDKDfp_FTSCD_C "Kundenspezifischer Fehlercode fuer Fehlerpfad Dfp_FTSCD" VAL_BLK 0xC99E0 Kwb_Wu16 65535.00 OneToOne 0.00 65535.00 FORMAT "%8.2" NUMBER 4 /end CHARACTERISTIC
/begin CHARACTERISTIC DSM_CDKDfp_FanCD_C "Kundenspezifischer Fehlercode fuer Fehlerpfad Dfp_FanCD" VAL_BLK 0xC99E8 Kwb_Wu16 65535.00 OneToOne 0.00 65535.00 FORMAT "%8.2" NUMBER 4 /end CHARACTERISTIC
/begin CHARACTERISTIC DSM_CDKDfp_FanCD_FanCtlr1_C "Kundenspezifischer Fehlercode fuer Fehlerpfad Dfp_FanCD_FanCtlr1" VAL_BLK 0xC99F0 Kwb_Wu16 65535.00 OneToOne 0.00 65535.00 FORMAT "%8.2" NUMBER 4 /end CHARACTERISTIC
/begin CHARACTERISTIC DSM_CDKDfp_FanCD_FanCtlr2_C "Kundenspezifischer Fehlercode fuer Fehlerpfad Dfp_FanCD_FanCtlr2" VAL_BLK 0xC99F8 Kwb_Wu16 65535.00 OneToOne 0.00 65535.00 FORMAT "%8.2" NUMBER 4 /end CHARACTERISTIC
/begin CHARACTERISTIC DSM_CDKDfp_FanCD_FanCtlr3_C "Kundenspezifischer Fehlercode fuer Fehlerpfad Dfp_FanCD_FanCtlr3" VAL_BLK 0xC9A00 Kwb_Wu16 65535.00 OneToOne 0.00 65535.00 FORMAT "%8.2" NUMBER 4 /end CHARACTERISTIC
/begin CHARACTERISTIC DSM_CDKDfp_FlFCD_C "Kundenspezifischer Fehlercode fuer Fehlerpfad Dfp_FlFCD" VAL_BLK 0xC9A08 Kwb_Wu16 65535.00 OneToOne 0.00 65535.00 FORMAT "%8.2" NUMBER 4 /end CHARACTERISTIC
/begin CHARACTERISTIC DSM_CDKDfp_FlMngSmkDefect_C "Kundenspezifischer Fehlercode fuer Fehlerpfad Dfp_FlMngSmkDefect" VAL_BLK 0xC9A10 Kwb_Wu16 65535.00 OneToOne 0.00 65535.00 FORMAT "%8.2" NUMBER 4 /end CHARACTERISTIC
/begin CHARACTERISTIC DSM_CDKDfp_FrmMngBOS_RESET_C "Kundenspezifischer Fehlercode fuer Fehlerpfad Dfp_FrmMngBOS_RESET" VAL_BLK 0xC9A18 Kwb_Wu16 65535.00 OneToOne 0.00 65535.00 FORMAT "%8.2" NUMBER 4 /end CHARACTERISTIC
/begin CHARACTERISTIC DSM_CDKDfp_FrmMngBOS_RESET_2_C "" VAL_BLK 0xC9A20 Kwb_Wu16 65535.00 OneToOne 0.00 65535.00 FORMAT "%8.2" NUMBER 4 /end CHARACTERISTIC
/begin CHARACTERISTIC DSM_CDKDfp_FrmMngDMANFAFS_C "Kundenspezifischer Fehlercode fuer Fehlerpfad Dfp_FrmMngDMANFAFS" VAL_BLK 0xC9A28 Kwb_Wu16 65535.00 OneToOne 0.00 65535.00 FORMAT "%8.2" NUMBER 4 /end CHARACTERISTIC
/begin CHARACTERISTIC DSM_CDKDfp_FrmMngDRMANFSSG_C "Kundenspezifischer Fehlercode fuer Fehlerpfad Dfp_FrmMngDRMANFSSG" VAL_BLK 0xC9A30 Kwb_Wu16 65535.00 OneToOne 0.00 65535.00 FORMAT "%8.2" NUMBER 4 /end CHARACTERISTIC
/begin CHARACTERISTIC DSM_CDKDfp_FrmMngGEARBX_DATA_C "defect-code (customer-specific) for path" VAL_BLK 0xC9A38 Kwb_Wu16 65535.00 OneToOne 0.00 65535.00 FORMAT "%8.2" NUMBER 4 /end CHARACTERISTIC
/begin CHARACTERISTIC DSM_CDKDfp_FrmMngGEARBX_DATA2_C "Kundenspezifischer Fehlercode fuer Fehlerpfad Dfp_FrmMngGEARBX_DATA2" VAL_BLK 0xC9A40 Kwb_Wu16 65535.00 OneToOne 0.00 65535.00 FORMAT "%8.2" NUMBER 4 /end CHARACTERISTIC
/begin CHARACTERISTIC DSM_CDKDfp_FrmMngHEAT_AC_C "defect-code (customer-specific) for path" VAL_BLK 0xC9A48 Kwb_Wu16 65535.00 OneToOne 0.00 65535.00 FORMAT "%8.2" NUMBER 4 /end CHARACTERISTIC
/begin CHARACTERISTIC DSM_CDKDfp_FrmMngLENKRADWINKEL_C "Kundenspezifischer Fehlercode fuer Fehlerpfad Dfp_FrmMngLENKRADWINKEL" VAL_BLK 0xC9A50 Kwb_Wu16 65535.00 OneToOne 0.00 65535.00 FORMAT "%8.2" NUMBER 4 /end CHARACTERISTIC
/begin CHARACTERISTIC DSM_CDKDfp_FrmMngMILEAGE_RANGE_C "Kundenspezifischer Fehlercode fuer Fehlerpfad Dfp_FrmMngMILEAGE_RANGE" VAL_BLK 0xC9A58 Kwb_Wu16 65535.00 OneToOne 0.00 65535.00 FORMAT "%8.2" NUMBER 4 /end CHARACTERISTIC
/begin CHARACTERISTIC DSM_CDKDfp_FrmMngOPCRCTLACC_C "Kundenspezifischer Fehlercode fuer Fehlerpfad Dfp_FrmMngOPCRCTLACC" VAL_BLK 0xC9A60 Kwb_Wu16 65535.00 OneToOne 0.00 65535.00 FORMAT "%8.2" NUMBER 4 /end CHARACTERISTIC
/begin CHARACTERISTIC DSM_CDKDfp_FrmMngPRGG_CCTR_C "Kundenspezifischer Fehlercode fuer Fehlerpfad Dfp_FrmMngPRGG_CCTR" VAL_BLK 0xC9A68 Kwb_Wu16 65535.00 OneToOne 0.00 65535.00 FORMAT "%8.2" NUMBER 4 /end CHARACTERISTIC
/begin CHARACTERISTIC DSM_CDKDfp_FrmMngPWRMNG_LOADV_C "Kundenspezifischer Fehlercode fuer Fehlerpfad Dfp_FrmMngPWRMNG_LOADV" VAL_BLK 0xC9A70 Kwb_Wu16 65535.00 OneToOne 0.00 65535.00 FORMAT "%8.2" NUMBER 4 /end CHARACTERISTIC
/begin CHARACTERISTIC DSM_CDKDfp_FrmMngParkConsumer_C "Kundenspezifischer Fehlercode fuer Fehlerpfad Dfp_FrmMngParkConsumer" VAL_BLK 0xC9A78 Kwb_Wu16 65535.00 OneToOne 0.00 65535.00 FORMAT "%8.2" NUMBER 4 /end CHARACTERISTIC
/begin CHARACTERISTIC DSM_CDKDfp_FrmMngRQSTGEFAN_C "RQ_STG_EFAN - CAN-message related errors" VAL_BLK 0xC9A80 Kwb_Wu16 65535.00 OneToOne 0.00 65535.00 FORMAT "%8.2" NUMBER 4 /end CHARACTERISTIC
/begin CHARACTERISTIC DSM_CDKDfp_FrmMngSSGErr_C "Kundenspezifischer Fehlercode fuer Fehlerpfad Dfp_FrmMngSSGErr" VAL_BLK 0xC9A88 Kwb_Wu16 65535.00 OneToOne 0.00 65535.00 FORMAT "%8.2" NUMBER 4 /end CHARACTERISTIC
/begin CHARACTERISTIC DSM_CDKDfp_FrmMngSSGShOff_C "Kundenspezifischer Fehlercode fuer Fehlerpfad Dfp_FrmMngSSGShOff" VAL_BLK 0xC9A90 Kwb_Wu16 65535.00 OneToOne 0.00 65535.00 FORMAT "%8.2" NUMBER 4 /end CHARACTERISTIC
/begin CHARACTERISTIC DSM_CDKDfp_FrmMngSTAT_ANH_C "Kundenspezifischer Fehlercode fuer Fehlerpfad Dfp_FrmMngSTAT_ANH" VAL_BLK 0xC9A98 Kwb_Wu16 65535.00 OneToOne 0.00 65535.00 FORMAT "%8.2" NUMBER 4 /end CHARACTERISTIC
/begin CHARACTERISTIC DSM_CDKDfp_FrmMngSTAT_ARS_C "defect-code (customer-specific) for path" VAL_BLK 0xC9AA0 Kwb_Wu16 65535.00 OneToOne 0.00 65535.00 FORMAT "%8.2" NUMBER 4 /end CHARACTERISTIC
/begin CHARACTERISTIC DSM_CDKDfp_FrmMngSTAT_DSC_C "defect-code (customer-specific) for path" VAL_BLK 0xC9AA8 Kwb_Wu16 65535.00 OneToOne 0.00 65535.00 FORMAT "%8.2" NUMBER 4 /end CHARACTERISTIC
/begin CHARACTERISTIC DSM_CDKDfp_FrmMngSTAT_EKP_C "Kundenspezifischer Fehlercode fuer Fehlerpfad Dfp_FrmMngSTAT_EKP" VAL_BLK 0xC9AB0 Kwb_Wu16 65535.00 OneToOne 0.00 65535.00 FORMAT "%8.2" NUMBER 4 /end CHARACTERISTIC
/begin CHARACTERISTIC DSM_CDKDfp_FrmMngSTAT_KOMBI_C "Kundenspezifischer Fehlercode fuer Fehlerpfad Dfp_FrmMngSTAT_KOMBI" VAL_BLK 0xC9AB8 Kwb_Wu16 65535.00 OneToOne 0.00 65535.00 FORMAT "%8.2" NUMBER 4 /end CHARACTERISTIC
/begin CHARACTERISTIC DSM_CDKDfp_FrmMngSTAT_SITZ_C "Kundenspezifischer Fehlercode fuer Fehlerpfad Dfp_FrmMngSTAT_SITZ" VAL_BLK 0xC9AC0 Kwb_Wu16 65535.00 OneToOne 0.00 65535.00 FORMAT "%8.2" NUMBER 4 /end CHARACTERISTIC
/begin CHARACTERISTIC DSM_CDKDfp_FrmMngStOBDGbxMilOf_C "Kundenspezifischer Fehlercode fuer Fehlerpfad Dfp_FrmMngStOBDGbxMilOf" VAL_BLK 0xC9AC8 Kwb_Wu16 65535.00 OneToOne 0.00 65535.00 FORMAT "%8.2" NUMBER 4 /end CHARACTERISTIC
/begin CHARACTERISTIC DSM_CDKDfp_FrmMngStOBDGbxMilOn_C "Kundenspezifischer Fehlercode fuer Fehlerpfad Dfp_FrmMngStOBDGbxMilOn" VAL_BLK 0xC9AD0 Kwb_Wu16 65535.00 OneToOne 0.00 65535.00 FORMAT "%8.2" NUMBER 4 /end CHARACTERISTIC
/begin CHARACTERISTIC DSM_CDKDfp_FrmMngTEMPRELTIME_C "Kundenspezifischer Fehlercode fuer Fehlerpfad Dfp_FrmMngTEMPRELTIME" VAL_BLK 0xC9AD8 Kwb_Wu16 65535.00 OneToOne 0.00 65535.00 FORMAT "%8.2" NUMBER 4 /end CHARACTERISTIC
/begin CHARACTERISTIC DSM_CDKDfp_FrmMngTERMINAL_C "defect-code (customer-specific) for path" VAL_BLK 0xC9AE0 Kwb_Wu16 65535.00 OneToOne 0.00 65535.00 FORMAT "%8.2" NUMBER 4 /end CHARACTERISTIC
/begin CHARACTERISTIC DSM_CDKDfp_FrmMngTIME_DATE_C "Kundenspezifischer Fehlercode fuer Fehlerpfad Dfp_FrmMngTIME_DATE" VAL_BLK 0xC9AE8 Kwb_Wu16 65535.00 OneToOne 0.00 65535.00 FORMAT "%8.2" NUMBER 4 /end CHARACTERISTIC
/begin CHARACTERISTIC DSM_CDKDfp_FrmMngTORQUE_DSC_C "defect-code (customer-specific) for path" VAL_BLK 0xC9AF0 Kwb_Wu16 65535.00 OneToOne 0.00 65535.00 FORMAT "%8.2" NUMBER 4 /end CHARACTERISTIC
/begin CHARACTERISTIC DSM_CDKDfp_FrmMngTORQUE_GEARBX_C "defect-code (customer-specific) for path" VAL_BLK 0xC9AF8 Kwb_Wu16 65535.00 OneToOne 0.00 65535.00 FORMAT "%8.2" NUMBER 4 /end CHARACTERISTIC
/begin CHARACTERISTIC DSM_CDKDfp_FrmMngTrq_ReqACC_C "Kundenspezifischer Fehlercode fuer Fehlerpfad Dfp_FrmMngTrq_ReqACC" VAL_BLK 0xC9B00 Kwb_Wu16 65535.00 OneToOne 0.00 65535.00 FORMAT "%8.2" NUMBER 4 /end CHARACTERISTIC
/begin CHARACTERISTIC DSM_CDKDfp_FrmMngVEH_MOD_C "VEH_MOD - CAN-message related errors" VAL_BLK 0xC9B08 Kwb_Wu16 65535.00 OneToOne 0.00 65535.00 FORMAT "%8.2" NUMBER 4 /end CHARACTERISTIC
/begin CHARACTERISTIC DSM_CDKDfp_FrmMngVELOCITY_C "defect-code (customer-specific) for path" VAL_BLK 0xC9B10 Kwb_Wu16 65535.00 OneToOne 0.00 65535.00 FORMAT "%8.2" NUMBER 4 /end CHARACTERISTIC
/begin CHARACTERISTIC DSM_CDKDfp_FrmMngWHEEL_SPEED_C "Kundenspezifischer Fehlercode fuer Fehlerpfad Dfp_FrmMngWHEEL_SPEED" VAL_BLK 0xC9B18 Kwb_Wu16 65535.00 OneToOne 0.00 65535.00 FORMAT "%8.2" NUMBER 4 /end CHARACTERISTIC
/begin CHARACTERISTIC DSM_CDKDfp_FrmMngstCurr_C "Fehlercode für Dfp_FrmMngstCurr" VAL_BLK 0xC9B20 Kwb_Wu16 65535.00 OneToOne 0.00 65535.00 FORMAT "%8.2" NUMBER 4 /end CHARACTERISTIC
/begin CHARACTERISTIC DSM_CDKDfp_FrmMngswtPSPOff_C "Fehlercode Feld für Dfp_FrmMngswtPSP" VAL_BLK 0xC9B28 Kwb_Wu16 65535.00 OneToOne 0.00 65535.00 FORMAT "%8.2" NUMBER 4 /end CHARACTERISTIC
/begin CHARACTERISTIC DSM_CDKDfp_GearbxIncMax_C "Kundenspezifischer Fehlercode fuer Fehlerpfad Dfp_GearbxIncMax" VAL_BLK 0xC9B30 Kwb_Wu16 65535.00 OneToOne 0.00 65535.00 FORMAT "%8.2" NUMBER 4 /end CHARACTERISTIC
/begin CHARACTERISTIC DSM_CDKDfp_GlwCD_C "Kundenspezifischer Fehlercode fuer Fehlerpfad Dfp_GlwCD" VAL_BLK 0xC9B38 Kwb_Wu16 65535.00 OneToOne 0.00 65535.00 FORMAT "%8.2" NUMBER 4 /end CHARACTERISTIC
/begin CHARACTERISTIC DSM_CDKDfp_GlwCDGlwCirc1_C "Kundenspezifischer Fehlercode fuer Fehlerpfad Dfp_GlwCDGlwCirc1" VAL_BLK 0xC9B40 Kwb_Wu16 65535.00 OneToOne 0.00 65535.00 FORMAT "%8.2" NUMBER 4 /end CHARACTERISTIC
/begin CHARACTERISTIC DSM_CDKDfp_GlwCDGlwCirc2_C "Kundenspezifischer Fehlercode fuer Fehlerpfad Dfp_GlwCDGlwCirc2" VAL_BLK 0xC9B48 Kwb_Wu16 65535.00 OneToOne 0.00 65535.00 FORMAT "%8.2" NUMBER 4 /end CHARACTERISTIC
/begin CHARACTERISTIC DSM_CDKDfp_GlwCDGlwCirc3_C "Kundenspezifischer Fehlercode fuer Fehlerpfad Dfp_GlwCDGlwCirc3" VAL_BLK 0xC9B50 Kwb_Wu16 65535.00 OneToOne 0.00 65535.00 FORMAT "%8.2" NUMBER 4 /end CHARACTERISTIC
/begin CHARACTERISTIC DSM_CDKDfp_GlwCDGlwCirc4_C "Kundenspezifischer Fehlercode fuer Fehlerpfad Dfp_GlwCDGlwCirc4" VAL_BLK 0xC9B58 Kwb_Wu16 65535.00 OneToOne 0.00 65535.00 FORMAT "%8.2" NUMBER 4 /end CHARACTERISTIC
/begin CHARACTERISTIC DSM_CDKDfp_GlwCDGlwCirc5_C "Kundenspezifischer Fehlercode fuer Fehlerpfad Dfp_GlwCDGlwCirc5" VAL_BLK 0xC9B60 Kwb_Wu16 65535.00 OneToOne 0.00 65535.00 FORMAT "%8.2" NUMBER 4 /end CHARACTERISTIC
/begin CHARACTERISTIC DSM_CDKDfp_GlwCDGlwCirc6_C "Kundenspezifischer Fehlercode fuer Fehlerpfad Dfp_GlwCDGlwCirc6" VAL_BLK 0xC9B68 Kwb_Wu16 65535.00 OneToOne 0.00 65535.00 FORMAT "%8.2" NUMBER 4 /end CHARACTERISTIC
/begin CHARACTERISTIC DSM_CDKDfp_GlwCDGlwCirc7_C "Kundenspezifischer Fehlercode fuer Fehlerpfad Dfp_GlwCDGlwCirc7" VAL_BLK 0xC9B70 Kwb_Wu16 65535.00 OneToOne 0.00 65535.00 FORMAT "%8.2" NUMBER 4 /end CHARACTERISTIC
/begin CHARACTERISTIC DSM_CDKDfp_GlwCDGlwCirc8_C "Kundenspezifischer Fehlercode fuer Fehlerpfad Dfp_GlwCDGlwCirc8" VAL_BLK 0xC9B78 Kwb_Wu16 65535.00 OneToOne 0.00 65535.00 FORMAT "%8.2" NUMBER 4 /end CHARACTERISTIC
/begin CHARACTERISTIC DSM_CDKDfp_GlwCtl_C "Kundenspezifischer Fehlercode fuer Fehlerpfad Dfp_GlwCtl" VAL_BLK 0xC9B80 Kwb_Wu16 65535.00 OneToOne 0.00 65535.00 FORMAT "%8.2" NUMBER 4 /end CHARACTERISTIC
/begin CHARACTERISTIC DSM_CDKDfp_HWEMonCom_C "Kundenspezifischer Fehlercode fuer Fehlerpfad Dfp_HWEMonCom" VAL_BLK 0xC9B88 Kwb_Wu16 65535.00 OneToOne 0.00 65535.00 FORMAT "%8.2" NUMBER 4 /end CHARACTERISTIC
/begin CHARACTERISTIC DSM_CDKDfp_HWEMonEEPROM_C "Kundenspezifischer Fehlercode fuer Fehlerpfad Dfp_HWEMonEEPROM" VAL_BLK 0xC9B90 Kwb_Wu16 65535.00 OneToOne 0.00 65535.00 FORMAT "%8.2" NUMBER 4 /end CHARACTERISTIC
/begin CHARACTERISTIC DSM_CDKDfp_HWEMonRcyLocked_C "Kundenspezifischer Fehlercode fuer Fehlerpfad Dfp_HWEMonRcyLocked" VAL_BLK 0xC9B98 Kwb_Wu16 65535.00 OneToOne 0.00 65535.00 FORMAT "%8.2" NUMBER 4 /end CHARACTERISTIC
/begin CHARACTERISTIC DSM_CDKDfp_HWEMonRcySuppressed_C "Kundenspezifischer Fehlercode fuer Fehlerpfad Dfp_HWEMonRcySuppressed" VAL_BLK 0xC9BA0 Kwb_Wu16 65535.00 OneToOne 0.00 65535.00 FORMAT "%8.2" NUMBER 4 /end CHARACTERISTIC
/begin CHARACTERISTIC DSM_CDKDfp_HWEMonRcyVisible_C "Kundenspezifischer Fehlercode fuer Fehlerpfad Dfp_HWEMonRcyVisible" VAL_BLK 0xC9BA8 Kwb_Wu16 65535.00 OneToOne 0.00 65535.00 FORMAT "%8.2" NUMBER 4 /end CHARACTERISTIC
/begin CHARACTERISTIC DSM_CDKDfp_HWEMonUMaxSupply_C "Kundenspezifischer Fehlercode fuer Fehlerpfad Dfp_HWEMonUMaxSupply" VAL_BLK 0xC9BB0 Kwb_Wu16 65535.00 OneToOne 0.00 65535.00 FORMAT "%8.2" NUMBER 4 /end CHARACTERISTIC
/begin CHARACTERISTIC DSM_CDKDfp_HWEMonUMinSupply_C "Kundenspezifischer Fehlercode fuer Fehlerpfad Dfp_HWEMonUMinSupply" VAL_BLK 0xC9BB8 Kwb_Wu16 65535.00 OneToOne 0.00 65535.00 FORMAT "%8.2" NUMBER 4 /end CHARACTERISTIC
/begin CHARACTERISTIC DSM_CDKDfp_IATSCD_C "Kundenspezifischer Fehlercode fuer Fehlerpfad Dfp_IATSCD" VAL_BLK 0xC9BC0 Kwb_Wu16 65535.00 OneToOne 0.00 65535.00 FORMAT "%8.2" NUMBER 4 /end CHARACTERISTIC
/begin CHARACTERISTIC DSM_CDKDfp_IATSCD_CATS_C "Kundenspezifischer Fehlercode fuer Fehlerpfad Dfp_IATSCD_CATS" VAL_BLK 0xC9BC8 Kwb_Wu16 65535.00 OneToOne 0.00 65535.00 FORMAT "%8.2" NUMBER 4 /end CHARACTERISTIC
/begin CHARACTERISTIC DSM_CDKDfp_ImmCtlImmCD_C "Kundenspezifischer Fehlercode fuer Fehlerpfad Dfp_ImmCtlImmCD" VAL_BLK 0xC9BD0 Kwb_Wu16 65535.00 OneToOne 0.00 65535.00 FORMAT "%8.2" NUMBER 4 /end CHARACTERISTIC
/begin CHARACTERISTIC DSM_CDKDfp_ImmCtlImmEep_C "Kundenspezifischer Fehlercode fuer Fehlerpfad Dfp_ImmCtlImmEep" VAL_BLK 0xC9BD8 Kwb_Wu16 65535.00 OneToOne 0.00 65535.00 FORMAT "%8.2" NUMBER 4 /end CHARACTERISTIC
/begin CHARACTERISTIC DSM_CDKDfp_ImmCtlMpl_C "Kundenspezifischer Fehlercode fuer Fehlerpfad Dfp_ImmCtlMpl" VAL_BLK 0xC9BE0 Kwb_Wu16 65535.00 OneToOne 0.00 65535.00 FORMAT "%8.2" NUMBER 4 /end CHARACTERISTIC
/begin CHARACTERISTIC DSM_CDKDfp_IndSys1_C "Kundenspezifischer Fehlercode fuer Fehlerpfad Dfp_IndSys1" VAL_BLK 0xC9BE8 Kwb_Wu16 65535.00 OneToOne 0.00 65535.00 FORMAT "%8.2" NUMBER 4 /end CHARACTERISTIC
/begin CHARACTERISTIC DSM_CDKDfp_IndSys2_C "Kundenspezifischer Fehlercode fuer Fehlerpfad Dfp_IndSys2" VAL_BLK 0xC9BF0 Kwb_Wu16 65535.00 OneToOne 0.00 65535.00 FORMAT "%8.2" NUMBER 4 /end CHARACTERISTIC
/begin CHARACTERISTIC DSM_CDKDfp_InjCrv_InjLim_C "Kundenspezifischer Fehlercode fuer Fehlerpfad Dfp_InjCrv_InjLim" VAL_BLK 0xC9BF8 Kwb_Wu16 65535.00 OneToOne 0.00 65535.00 FORMAT "%8.2" NUMBER 4 /end CHARACTERISTIC
/begin CHARACTERISTIC DSM_CDKDfp_InjCtlAdjQnt_C "Kundenspezifischer Fehlercode fuer Fehlerpfad Dfp_InjCtlAdjQnt" VAL_BLK 0xC9C00 Kwb_Wu16 65535.00 OneToOne 0.00 65535.00 FORMAT "%8.2" NUMBER 4 /end CHARACTERISTIC
/begin CHARACTERISTIC DSM_CDKDfp_InjCtlDrift_C "Kundenspezifischer Fehlercode fuer Fehlerpfad Dfp_InjCtlDrift" VAL_BLK 0xC9C08 Kwb_Wu16 65535.00 OneToOne 0.00 65535.00 FORMAT "%8.2" NUMBER 4 /end CHARACTERISTIC
/begin CHARACTERISTIC DSM_CDKDfp_InjVCDActrChrg_C "Kundenspezifischer Fehlercode fuer Fehlerpfad Dfp_InjVCDActrChrg" VAL_BLK 0xC9C10 Kwb_Wu16 65535.00 OneToOne 0.00 65535.00 FORMAT "%8.2" NUMBER 4 /end CHARACTERISTIC
/begin CHARACTERISTIC DSM_CDKDfp_InjVCDActrEnrg1_C "Kundenspezifischer Fehlercode fuer Fehlerpfad Dfp_InjVCDActrEnrg1" VAL_BLK 0xC9C18 Kwb_Wu16 65535.00 OneToOne 0.00 65535.00 FORMAT "%8.2" NUMBER 4 /end CHARACTERISTIC
/begin CHARACTERISTIC DSM_CDKDfp_InjVCDActrEnrg2_C "Kundenspezifischer Fehlercode fuer Fehlerpfad Dfp_InjVCDActrEnrg2" VAL_BLK 0xC9C20 Kwb_Wu16 65535.00 OneToOne 0.00 65535.00 FORMAT "%8.2" NUMBER 4 /end CHARACTERISTIC
/begin CHARACTERISTIC DSM_CDKDfp_InjVCDActrEnrg3_C "Kundenspezifischer Fehlercode fuer Fehlerpfad Dfp_InjVCDActrEnrg3" VAL_BLK 0xC9C28 Kwb_Wu16 65535.00 OneToOne 0.00 65535.00 FORMAT "%8.2" NUMBER 4 /end CHARACTERISTIC
/begin CHARACTERISTIC DSM_CDKDfp_InjVCDActrEnrg4_C "Kundenspezifischer Fehlercode fuer Fehlerpfad Dfp_InjVCDActrEnrg4" VAL_BLK 0xC9C30 Kwb_Wu16 65535.00 OneToOne 0.00 65535.00 FORMAT "%8.2" NUMBER 4 /end CHARACTERISTIC
/begin CHARACTERISTIC DSM_CDKDfp_InjVCDActrEnrg5_C "Kundenspezifischer Fehlercode fuer Fehlerpfad Dfp_InjVCDActrEnrg5" VAL_BLK 0xC9C38 Kwb_Wu16 65535.00 OneToOne 0.00 65535.00 FORMAT "%8.2" NUMBER 4 /end CHARACTERISTIC
/begin CHARACTERISTIC DSM_CDKDfp_InjVCDActrEnrg6_C "Kundenspezifischer Fehlercode fuer Fehlerpfad Dfp_InjVCDActrEnrg6" VAL_BLK 0xC9C40 Kwb_Wu16 65535.00 OneToOne 0.00 65535.00 FORMAT "%8.2" NUMBER 4 /end CHARACTERISTIC
/begin CHARACTERISTIC DSM_CDKDfp_InjVCDActrEnrg7_C "Kundenspezifischer Fehlercode fuer Fehlerpfad Dfp_InjVCDActrEnrg7" VAL_BLK 0xC9C48 Kwb_Wu16 65535.00 OneToOne 0.00 65535.00 FORMAT "%8.2" NUMBER 4 /end CHARACTERISTIC
/begin CHARACTERISTIC DSM_CDKDfp_InjVCDActrEnrg8_C "Kundenspezifischer Fehlercode fuer Fehlerpfad Dfp_InjVCDActrEnrg8" VAL_BLK 0xC9C50 Kwb_Wu16 65535.00 OneToOne 0.00 65535.00 FORMAT "%8.2" NUMBER 4 /end CHARACTERISTIC
/begin CHARACTERISTIC DSM_CDKDfp_InjVCDActrVolt_C "Kundenspezifischer Fehlercode fuer Fehlerpfad Dfp_InjVCDActrVolt" VAL_BLK 0xC9C58 Kwb_Wu16 65535.00 OneToOne 0.00 65535.00 FORMAT "%8.2" NUMBER 4 /end CHARACTERISTIC
/begin CHARACTERISTIC DSM_CDKDfp_InjVCDClsBank1_C "Kundenspezifischer Fehlercode fuer Fehlerpfad Dfp_InjVCDClsBank1" VAL_BLK 0xC9C60 Kwb_Wu16 65535.00 OneToOne 0.00 65535.00 FORMAT "%8.2" NUMBER 4 /end CHARACTERISTIC
/begin CHARACTERISTIC DSM_CDKDfp_InjVCDClsBank2_C "Kundenspezifischer Fehlercode fuer Fehlerpfad Dfp_InjVCDClsBank2" VAL_BLK 0xC9C68 Kwb_Wu16 65535.00 OneToOne 0.00 65535.00 FORMAT "%8.2" NUMBER 4 /end CHARACTERISTIC
/begin CHARACTERISTIC DSM_CDKDfp_InjVCDMonCab_C "Kundenspezifischer Fehlercode fuer Fehlerpfad Dfp_InjVCDMonCab" VAL_BLK 0xC9C70 Kwb_Wu16 65535.00 OneToOne 0.00 65535.00 FORMAT "%8.2" NUMBER 4 /end CHARACTERISTIC
/begin CHARACTERISTIC DSM_CDKDfp_InjVCDMonSwt_C "Kundenspezifischer Fehlercode fuer Fehlerpfad Dfp_InjVCDMonSwt" VAL_BLK 0xC9C78 Kwb_Wu16 65535.00 OneToOne 0.00 65535.00 FORMAT "%8.2" NUMBER 4 /end CHARACTERISTIC
/begin CHARACTERISTIC DSM_CDKDfp_InjVCDShOffDCDC_C "Kundenspezifischer Fehlercode fuer Fehlerpfad Dfp_InjVCDShOffDCDC" VAL_BLK 0xC9C80 Kwb_Wu16 65535.00 OneToOne 0.00 65535.00 FORMAT "%8.2" NUMBER 4 /end CHARACTERISTIC
/begin CHARACTERISTIC DSM_CDKDfp_InjVCDUBuf_C "Kundenspezifischer Fehlercode fuer Fehlerpfad Dfp_InjVCDUBuf" VAL_BLK 0xC9C88 Kwb_Wu16 65535.00 OneToOne 0.00 65535.00 FORMAT "%8.2" NUMBER 4 /end CHARACTERISTIC
/begin CHARACTERISTIC DSM_CDKDfp_InjVCD_CY370Ampl_C "Kundenspezifischer Fehlercode fuer Fehlerpfad Dfp_InjVCD_CY370Ampl" VAL_BLK 0xC9C90 Kwb_Wu16 65535.00 OneToOne 0.00 65535.00 FORMAT "%8.2" NUMBER 4 /end CHARACTERISTIC
/begin CHARACTERISTIC DSM_CDKDfp_InjVlvBnk1A_C "Kundenspezifischer Fehlercode fuer Fehlerpfad Dfp_InjVlvBnk1A" VAL_BLK 0xC9C98 Kwb_Wu16 65535.00 OneToOne 0.00 65535.00 FORMAT "%8.2" NUMBER 4 /end CHARACTERISTIC
/begin CHARACTERISTIC DSM_CDKDfp_InjVlvBnk1B_C "Kundenspezifischer Fehlercode fuer Fehlerpfad Dfp_InjVlvBnk1B" VAL_BLK 0xC9CA0 Kwb_Wu16 65535.00 OneToOne 0.00 65535.00 FORMAT "%8.2" NUMBER 4 /end CHARACTERISTIC
/begin CHARACTERISTIC DSM_CDKDfp_InjVlvBnk2A_C "Kundenspezifischer Fehlercode fuer Fehlerpfad Dfp_InjVlvBnk2A" VAL_BLK 0xC9CA8 Kwb_Wu16 65535.00 OneToOne 0.00 65535.00 FORMAT "%8.2" NUMBER 4 /end CHARACTERISTIC
/begin CHARACTERISTIC DSM_CDKDfp_InjVlvBnk2B_C "Kundenspezifischer Fehlercode fuer Fehlerpfad Dfp_InjVlvBnk2B" VAL_BLK 0xC9CB0 Kwb_Wu16 65535.00 OneToOne 0.00 65535.00 FORMAT "%8.2" NUMBER 4 /end CHARACTERISTIC
/begin CHARACTERISTIC DSM_CDKDfp_InjVlvChipA_C "Kundenspezifischer Fehlercode fuer Fehlerpfad Dfp_InjVlvChipA" VAL_BLK 0xC9CB8 Kwb_Wu16 65535.00 OneToOne 0.00 65535.00 FORMAT "%8.2" NUMBER 4 /end CHARACTERISTIC
/begin CHARACTERISTIC DSM_CDKDfp_InjVlvChipB_C "Kundenspezifischer Fehlercode fuer Fehlerpfad Dfp_InjVlvChipB" VAL_BLK 0xC9CC0 Kwb_Wu16 65535.00 OneToOne 0.00 65535.00 FORMAT "%8.2" NUMBER 4 /end CHARACTERISTIC
/begin CHARACTERISTIC DSM_CDKDfp_InjVlvCyl1A_C "Kundenspezifischer Fehlercode fuer Fehlerpfad Dfp_InjVlvCyl1A" VAL_BLK 0xC9CC8 Kwb_Wu16 65535.00 OneToOne 0.00 65535.00 FORMAT "%8.2" NUMBER 4 /end CHARACTERISTIC
/begin CHARACTERISTIC DSM_CDKDfp_InjVlvCyl1B_C "Kundenspezifischer Fehlercode fuer Fehlerpfad Dfp_InjVlvCyl1B" VAL_BLK 0xC9CD0 Kwb_Wu16 65535.00 OneToOne 0.00 65535.00 FORMAT "%8.2" NUMBER 4 /end CHARACTERISTIC
/begin CHARACTERISTIC DSM_CDKDfp_InjVlvCyl1C_C "Kundenspezifischer Fehlercode fuer Fehlerpfad Dfp_InjVlvCyl1C" VAL_BLK 0xC9CD8 Kwb_Wu16 65535.00 OneToOne 0.00 65535.00 FORMAT "%8.2" NUMBER 4 /end CHARACTERISTIC
/begin CHARACTERISTIC DSM_CDKDfp_InjVlvCyl2A_C "Kundenspezifischer Fehlercode fuer Fehlerpfad Dfp_InjVlvCyl2A" VAL_BLK 0xC9CE0 Kwb_Wu16 65535.00 OneToOne 0.00 65535.00 FORMAT "%8.2" NUMBER 4 /end CHARACTERISTIC
/begin CHARACTERISTIC DSM_CDKDfp_InjVlvCyl2B_C "Kundenspezifischer Fehlercode fuer Fehlerpfad Dfp_InjVlvCyl2B" VAL_BLK 0xC9CE8 Kwb_Wu16 65535.00 OneToOne 0.00 65535.00 FORMAT "%8.2" NUMBER 4 /end CHARACTERISTIC
/begin CHARACTERISTIC DSM_CDKDfp_InjVlvCyl2C_C "Kundenspezifischer Fehlercode fuer Fehlerpfad Dfp_InjVlvCyl2C" VAL_BLK 0xC9CF0 Kwb_Wu16 65535.00 OneToOne 0.00 65535.00 FORMAT "%8.2" NUMBER 4 /end CHARACTERISTIC
/begin CHARACTERISTIC DSM_CDKDfp_InjVlvCyl3A_C "Kundenspezifischer Fehlercode fuer Fehlerpfad Dfp_InjVlvCyl3A" VAL_BLK 0xC9CF8 Kwb_Wu16 65535.00 OneToOne 0.00 65535.00 FORMAT "%8.2" NUMBER 4 /end CHARACTERISTIC
/begin CHARACTERISTIC DSM_CDKDfp_InjVlvCyl3B_C "Kundenspezifischer Fehlercode fuer Fehlerpfad Dfp_InjVlvCyl3B" VAL_BLK 0xC9D00 Kwb_Wu16 65535.00 OneToOne 0.00 65535.00 FORMAT "%8.2" NUMBER 4 /end CHARACTERISTIC
/begin CHARACTERISTIC DSM_CDKDfp_InjVlvCyl3C_C "Kundenspezifischer Fehlercode fuer Fehlerpfad Dfp_InjVlvCyl3C" VAL_BLK 0xC9D08 Kwb_Wu16 65535.00 OneToOne 0.00 65535.00 FORMAT "%8.2" NUMBER 4 /end CHARACTERISTIC
/begin CHARACTERISTIC DSM_CDKDfp_InjVlvCyl4A_C "Kundenspezifischer Fehlercode fuer Fehlerpfad Dfp_InjVlvCyl4A" VAL_BLK 0xC9D10 Kwb_Wu16 65535.00 OneToOne 0.00 65535.00 FORMAT "%8.2" NUMBER 4 /end CHARACTERISTIC
/begin CHARACTERISTIC DSM_CDKDfp_InjVlvCyl4B_C "Kundenspezifischer Fehlercode fuer Fehlerpfad Dfp_InjVlvCyl4B" VAL_BLK 0xC9D18 Kwb_Wu16 65535.00 OneToOne 0.00 65535.00 FORMAT "%8.2" NUMBER 4 /end CHARACTERISTIC
/begin CHARACTERISTIC DSM_CDKDfp_InjVlvCyl4C_C "Kundenspezifischer Fehlercode fuer Fehlerpfad Dfp_InjVlvCyl4C" VAL_BLK 0xC9D20 Kwb_Wu16 65535.00 OneToOne 0.00 65535.00 FORMAT "%8.2" NUMBER 4 /end CHARACTERISTIC
/begin CHARACTERISTIC DSM_CDKDfp_InjVlvCyl5A_C "Kundenspezifischer Fehlercode fuer Fehlerpfad Dfp_InjVlvCyl5A" VAL_BLK 0xC9D28 Kwb_Wu16 65535.00 OneToOne 0.00 65535.00 FORMAT "%8.2" NUMBER 4 /end CHARACTERISTIC
/begin CHARACTERISTIC DSM_CDKDfp_InjVlvCyl5B_C "Kundenspezifischer Fehlercode fuer Fehlerpfad Dfp_InjVlvCyl5B" VAL_BLK 0xC9D30 Kwb_Wu16 65535.00 OneToOne 0.00 65535.00 FORMAT "%8.2" NUMBER 4 /end CHARACTERISTIC
/begin CHARACTERISTIC DSM_CDKDfp_InjVlvCyl5C_C "Kundenspezifischer Fehlercode fuer Fehlerpfad Dfp_InjVlvCyl5C" VAL_BLK 0xC9D38 Kwb_Wu16 65535.00 OneToOne 0.00 65535.00 FORMAT "%8.2" NUMBER 4 /end CHARACTERISTIC
/begin CHARACTERISTIC DSM_CDKDfp_InjVlvCyl6A_C "Kundenspezifischer Fehlercode fuer Fehlerpfad Dfp_InjVlvCyl6A" VAL_BLK 0xC9D40 Kwb_Wu16 65535.00 OneToOne 0.00 65535.00 FORMAT "%8.2" NUMBER 4 /end CHARACTERISTIC
/begin CHARACTERISTIC DSM_CDKDfp_InjVlvCyl6B_C "Kundenspezifischer Fehlercode fuer Fehlerpfad Dfp_InjVlvCyl6B" VAL_BLK 0xC9D48 Kwb_Wu16 65535.00 OneToOne 0.00 65535.00 FORMAT "%8.2" NUMBER 4 /end CHARACTERISTIC
/begin CHARACTERISTIC DSM_CDKDfp_InjVlvCyl6C_C "Kundenspezifischer Fehlercode fuer Fehlerpfad Dfp_InjVlvCyl6C" VAL_BLK 0xC9D50 Kwb_Wu16 65535.00 OneToOne 0.00 65535.00 FORMAT "%8.2" NUMBER 4 /end CHARACTERISTIC
/begin CHARACTERISTIC DSM_CDKDfp_InjVlvCyl7A_C "Kundenspezifischer Fehlercode fuer Fehlerpfad Dfp_InjVlvCyl7A" VAL_BLK 0xC9D58 Kwb_Wu16 65535.00 OneToOne 0.00 65535.00 FORMAT "%8.2" NUMBER 4 /end CHARACTERISTIC
/begin CHARACTERISTIC DSM_CDKDfp_InjVlvCyl7B_C "Kundenspezifischer Fehlercode fuer Fehlerpfad Dfp_InjVlvCyl7B" VAL_BLK 0xC9D60 Kwb_Wu16 65535.00 OneToOne 0.00 65535.00 FORMAT "%8.2" NUMBER 4 /end CHARACTERISTIC
/begin CHARACTERISTIC DSM_CDKDfp_InjVlvCyl7C_C "Kundenspezifischer Fehlercode fuer Fehlerpfad Dfp_InjVlvCyl7C" VAL_BLK 0xC9D68 Kwb_Wu16 65535.00 OneToOne 0.00 65535.00 FORMAT "%8.2" NUMBER 4 /end CHARACTERISTIC
/begin CHARACTERISTIC DSM_CDKDfp_InjVlvCyl8A_C "Kundenspezifischer Fehlercode fuer Fehlerpfad Dfp_InjVlvCyl8A" VAL_BLK 0xC9D70 Kwb_Wu16 65535.00 OneToOne 0.00 65535.00 FORMAT "%8.2" NUMBER 4 /end CHARACTERISTIC
/begin CHARACTERISTIC DSM_CDKDfp_InjVlvCyl8B_C "Kundenspezifischer Fehlercode fuer Fehlerpfad Dfp_InjVlvCyl8B" VAL_BLK 0xC9D78 Kwb_Wu16 65535.00 OneToOne 0.00 65535.00 FORMAT "%8.2" NUMBER 4 /end CHARACTERISTIC
/begin CHARACTERISTIC DSM_CDKDfp_InjVlvCyl8C_C "Kundenspezifischer Fehlercode fuer Fehlerpfad Dfp_InjVlvCyl8C" VAL_BLK 0xC9D80 Kwb_Wu16 65535.00 OneToOne 0.00 65535.00 FORMAT "%8.2" NUMBER 4 /end CHARACTERISTIC
/begin CHARACTERISTIC DSM_CDKDfp_InjVlvNVC1_C "Kundenspezifischer Fehlercode fuer Fehlerpfad Dfp_InjVlvNVC1" VAL_BLK 0xC9D88 Kwb_Wu16 65535.00 OneToOne 0.00 65535.00 FORMAT "%8.2" NUMBER 4 /end CHARACTERISTIC
/begin CHARACTERISTIC DSM_CDKDfp_InjVlvNVC2_C "Kundenspezifischer Fehlercode fuer Fehlerpfad Dfp_InjVlvNVC2" VAL_BLK 0xC9D90 Kwb_Wu16 65535.00 OneToOne 0.00 65535.00 FORMAT "%8.2" NUMBER 4 /end CHARACTERISTIC
/begin CHARACTERISTIC DSM_CDKDfp_InjVlvNVC3_C "Kundenspezifischer Fehlercode fuer Fehlerpfad Dfp_InjVlvNVC3" VAL_BLK 0xC9D98 Kwb_Wu16 65535.00 OneToOne 0.00 65535.00 FORMAT "%8.2" NUMBER 4 /end CHARACTERISTIC
/begin CHARACTERISTIC DSM_CDKDfp_InjVlvNVC4_C "Kundenspezifischer Fehlercode fuer Fehlerpfad Dfp_InjVlvNVC4" VAL_BLK 0xC9DA0 Kwb_Wu16 65535.00 OneToOne 0.00 65535.00 FORMAT "%8.2" NUMBER 4 /end CHARACTERISTIC
/begin CHARACTERISTIC DSM_CDKDfp_InjVlvNVC5_C "Kundenspezifischer Fehlercode fuer Fehlerpfad Dfp_InjVlvNVC5" VAL_BLK 0xC9DA8 Kwb_Wu16 65535.00 OneToOne 0.00 65535.00 FORMAT "%8.2" NUMBER 4 /end CHARACTERISTIC
/begin CHARACTERISTIC DSM_CDKDfp_InjVlvNVC6_C "Kundenspezifischer Fehlercode fuer Fehlerpfad Dfp_InjVlvNVC6" VAL_BLK 0xC9DB0 Kwb_Wu16 65535.00 OneToOne 0.00 65535.00 FORMAT "%8.2" NUMBER 4 /end CHARACTERISTIC
/begin CHARACTERISTIC DSM_CDKDfp_InjVlvNVC7_C "Kundenspezifischer Fehlercode fuer Fehlerpfad Dfp_InjVlvNVC7" VAL_BLK 0xC9DB8 Kwb_Wu16 65535.00 OneToOne 0.00 65535.00 FORMAT "%8.2" NUMBER 4 /end CHARACTERISTIC
/begin CHARACTERISTIC DSM_CDKDfp_InjVlvNVC8_C "Kundenspezifischer Fehlercode fuer Fehlerpfad Dfp_InjVlvNVC8" VAL_BLK 0xC9DC0 Kwb_Wu16 65535.00 OneToOne 0.00 65535.00 FORMAT "%8.2" NUMBER 4 /end CHARACTERISTIC
/begin CHARACTERISTIC DSM_CDKDfp_LPACD_Max_C "Kundenspezifischer Fehlercode fuer Fehlerpfad Dfp_LPACD_Max" VAL_BLK 0xC9DC8 Kwb_Wu16 65535.00 OneToOne 0.00 65535.00 FORMAT "%8.2" NUMBER 4 /end CHARACTERISTIC
/begin CHARACTERISTIC DSM_CDKDfp_LPACD_Min_C "Kundenspezifischer Fehlercode fuer Fehlerpfad Dfp_LPACD_Min" VAL_BLK 0xC9DD0 Kwb_Wu16 65535.00 OneToOne 0.00 65535.00 FORMAT "%8.2" NUMBER 4 /end CHARACTERISTIC
/begin CHARACTERISTIC DSM_CDKDfp_LPACD_SigNpl_C "Kundenspezifischer Fehlercode fuer Fehlerpfad Dfp_LPACD_SigNpl" VAL_BLK 0xC9DD8 Kwb_Wu16 65535.00 OneToOne 0.00 65535.00 FORMAT "%8.2" NUMBER 4 /end CHARACTERISTIC
/begin CHARACTERISTIC DSM_CDKDfp_LSUCDCircNernst0_C "Kundenspezifischer Fehlercode fuer Fehlerpfad Dfp_LSUCDCircNernst0" VAL_BLK 0xC9DE0 Kwb_Wu16 65535.00 OneToOne 0.00 65535.00 FORMAT "%8.2" NUMBER 4 /end CHARACTERISTIC
/begin CHARACTERISTIC DSM_CDKDfp_LSUCDCircPumpCur0_C "Kundenspezifischer Fehlercode fuer Fehlerpfad Dfp_LSUCDCircPumpCur0" VAL_BLK 0xC9DE8 Kwb_Wu16 65535.00 OneToOne 0.00 65535.00 FORMAT "%8.2" NUMBER 4 /end CHARACTERISTIC
/begin CHARACTERISTIC DSM_CDKDfp_LSUCDCircVirtGnd0_C "Kundenspezifischer Fehlercode fuer Fehlerpfad Dfp_LSUCDCircVirtGnd0" VAL_BLK 0xC9DF0 Kwb_Wu16 65535.00 OneToOne 0.00 65535.00 FORMAT "%8.2" NUMBER 4 /end CHARACTERISTIC
/begin CHARACTERISTIC DSM_CDKDfp_LSUCDHeater0_C "Kundenspezifischer Fehlercode fuer Fehlerpfad Dfp_LSUCDHeater0" VAL_BLK 0xC9DF8 Kwb_Wu16 65535.00 OneToOne 0.00 65535.00 FORMAT "%8.2" NUMBER 4 /end CHARACTERISTIC
/begin CHARACTERISTIC DSM_CDKDfp_LSUCDHtCoup0_C "Kundenspezifischer Fehlercode fuer Fehlerpfad Dfp_LSUCDHtCoup0" VAL_BLK 0xC9E00 Kwb_Wu16 65535.00 OneToOne 0.00 65535.00 FORMAT "%8.2" NUMBER 4 /end CHARACTERISTIC
/begin CHARACTERISTIC DSM_CDKDfp_LSUCDO20_C "Kundenspezifischer Fehlercode fuer Fehlerpfad Dfp_LSUCDO20" VAL_BLK 0xC9E08 Kwb_Wu16 65535.00 OneToOne 0.00 65535.00 FORMAT "%8.2" NUMBER 4 /end CHARACTERISTIC
/begin CHARACTERISTIC DSM_CDKDfp_LSUCDO2Clb0_C "Kundenspezifischer Fehlercode fuer Fehlerpfad Dfp_LSUCDO2Clb0" VAL_BLK 0xC9E10 Kwb_Wu16 65535.00 OneToOne 0.00 65535.00 FORMAT "%8.2" NUMBER 4 /end CHARACTERISTIC
/begin CHARACTERISTIC DSM_CDKDfp_LSUCDRiClb0_C "Kundenspezifischer Fehlercode fuer Fehlerpfad Dfp_LSUCDRiClb0" VAL_BLK 0xC9E18 Kwb_Wu16 65535.00 OneToOne 0.00 65535.00 FORMAT "%8.2" NUMBER 4 /end CHARACTERISTIC
/begin CHARACTERISTIC DSM_CDKDfp_LSUCDSPI0_C "Kundenspezifischer Fehlercode fuer Fehlerpfad Dfp_LSUCDSPI0" VAL_BLK 0xC9E20 Kwb_Wu16 65535.00 OneToOne 0.00 65535.00 FORMAT "%8.2" NUMBER 4 /end CHARACTERISTIC
/begin CHARACTERISTIC DSM_CDKDfp_LSUCDSPIBattLow0_C "Kundenspezifischer Fehlercode fuer Fehlerpfad Dfp_LSUCDSPIBattLow0" VAL_BLK 0xC9E28 Kwb_Wu16 65535.00 OneToOne 0.00 65535.00 FORMAT "%8.2" NUMBER 4 /end CHARACTERISTIC
/begin CHARACTERISTIC DSM_CDKDfp_LSUCDWireIP0_C "Kundenspezifischer Fehlercode fuer Fehlerpfad Dfp_LSUCDWireIP0" VAL_BLK 0xC9E30 Kwb_Wu16 65535.00 OneToOne 0.00 65535.00 FORMAT "%8.2" NUMBER 4 /end CHARACTERISTIC
/begin CHARACTERISTIC DSM_CDKDfp_LSUCtlRiExc0_C "Kundenspezifischer Fehlercode fuer Fehlerpfad Dfp_LSUCtlRiExc0" VAL_BLK 0xC9E38 Kwb_Wu16 65535.00 OneToOne 0.00 65535.00 FORMAT "%8.2" NUMBER 4 /end CHARACTERISTIC
/begin CHARACTERISTIC DSM_CDKDfp_LSUMon1Sens_C "Kundenspezifischer Fehlercode fuer Fehlerpfad Dfp_LSUMon1Sens" VAL_BLK 0xC9E40 Kwb_Wu16 65535.00 OneToOne 0.00 65535.00 FORMAT "%8.2" NUMBER 4 /end CHARACTERISTIC
/begin CHARACTERISTIC DSM_CDKDfp_LSUMon2Sens_C "Kundenspezifischer Fehlercode fuer Fehlerpfad Dfp_LSUMon2Sens" VAL_BLK 0xC9E48 Kwb_Wu16 65535.00 OneToOne 0.00 65535.00 FORMAT "%8.2" NUMBER 4 /end CHARACTERISTIC
/begin CHARACTERISTIC DSM_CDKDfp_LubCD_C "Kundenspezifischer Fehlercode fuer Fehlerpfad Dfp_LubCD" VAL_BLK 0xC9E50 Kwb_Wu16 65535.00 OneToOne 0.00 65535.00 FORMAT "%8.2" NUMBER 4 /end CHARACTERISTIC
/begin CHARACTERISTIC DSM_CDKDfp_MIL_C "Kundenspezifischer Fehlercode fuer Fehlerpfad Dfp_MIL" VAL_BLK 0xC9E58 Kwb_Wu16 65535.00 OneToOne 0.00 65535.00 FORMAT "%8.2" NUMBER 4 /end CHARACTERISTIC
/begin CHARACTERISTIC DSM_CDKDfp_MRlyCD_C "Kundenspezifischer Fehlercode fuer Fehlerpfad Dfp_MRlyCD" VAL_BLK 0xC9E60 Kwb_Wu16 65535.00 OneToOne 0.00 65535.00 FORMAT "%8.2" NUMBER 4 /end CHARACTERISTIC
/begin CHARACTERISTIC DSM_CDKDfp_MSidCD_Comm_C "Kundenspezifischer Fehlercode fuer Fehlerpfad Dfp_MSidCD_Comm" VAL_BLK 0xC9E68 Kwb_Wu16 65535.00 OneToOne 0.00 65535.00 FORMAT "%8.2" NUMBER 4 /end CHARACTERISTIC
/begin CHARACTERISTIC DSM_CDKDfp_MSidCD_Pin_C "Kundenspezifischer Fehlercode fuer Fehlerpfad Dfp_MSidCD_Pin" VAL_BLK 0xC9E70 Kwb_Wu16 65535.00 OneToOne 0.00 65535.00 FORMAT "%8.2" NUMBER 4 /end CHARACTERISTIC
/begin CHARACTERISTIC DSM_CDKDfp_MSidCD_Sel_INI_C "Kundenspezifischer Fehlercode fuer Fehlerpfad Dfp_MSidCD_Sel_INI" VAL_BLK 0xC9E78 Kwb_Wu16 65535.00 OneToOne 0.00 65535.00 FORMAT "%8.2" NUMBER 4 /end CHARACTERISTIC
/begin CHARACTERISTIC DSM_CDKDfp_MSidCD_Select_C "Kundenspezifischer Fehlercode fuer Fehlerpfad Dfp_MSidCD_Select" VAL_BLK 0xC9E80 Kwb_Wu16 65535.00 OneToOne 0.00 65535.00 FORMAT "%8.2" NUMBER 4 /end CHARACTERISTIC
/begin CHARACTERISTIC DSM_CDKDfp_MeUnCDNoLoad_C "Kundenspezifischer Fehlercode fuer Fehlerpfad Dfp_MeUnCDNoLoad" VAL_BLK 0xC9E88 Kwb_Wu16 65535.00 OneToOne 0.00 65535.00 FORMAT "%8.2" NUMBER 4 /end CHARACTERISTIC
/begin CHARACTERISTIC DSM_CDKDfp_MeUnCDSCBat_C "Kundenspezifischer Fehlercode fuer Fehlerpfad Dfp_MeUnCDSCBat" VAL_BLK 0xC9E90 Kwb_Wu16 65535.00 OneToOne 0.00 65535.00 FORMAT "%8.2" NUMBER 4 /end CHARACTERISTIC
/begin CHARACTERISTIC DSM_CDKDfp_MeUnCDSCGnd_C "Kundenspezifischer Fehlercode fuer Fehlerpfad Dfp_MeUnCDSCGnd" VAL_BLK 0xC9E98 Kwb_Wu16 65535.00 OneToOne 0.00 65535.00 FORMAT "%8.2" NUMBER 4 /end CHARACTERISTIC
/begin CHARACTERISTIC DSM_CDKDfp_MeUnCD_ADC_C "Kundenspezifischer Fehlercode fuer Fehlerpfad Dfp_MeUnCD_ADC" VAL_BLK 0xC9EA0 Kwb_Wu16 65535.00 OneToOne 0.00 65535.00 FORMAT "%8.2" NUMBER 4 /end CHARACTERISTIC
/begin CHARACTERISTIC DSM_CDKDfp_MeUnCD_SigTst_C "Kundenspezifischer Fehlercode fuer Fehlerpfad Dfp_MeUnCD_SigTst" VAL_BLK 0xC9EA8 Kwb_Wu16 65535.00 OneToOne 0.00 65535.00 FORMAT "%8.2" NUMBER 4 /end CHARACTERISTIC
/begin CHARACTERISTIC DSM_CDKDfp_Montr_C "Kundenspezifischer Fehlercode fuer Fehlerpfad Dfp_Montr" VAL_BLK 0xC9EB0 Kwb_Wu16 65535.00 OneToOne 0.00 65535.00 FORMAT "%8.2" NUMBER 4 /end CHARACTERISTIC
/begin CHARACTERISTIC DSM_CDKDfp_NetMngDeviceA_C "Kundenspezifischer Fehlercode fuer Fehlerpfad Dfp_NetMngDeviceB" VAL_BLK 0xC9EB8 Kwb_Wu16 65535.00 OneToOne 0.00 65535.00 FORMAT "%8.2" NUMBER 4 /end CHARACTERISTIC
/begin CHARACTERISTIC DSM_CDKDfp_NetMngDeviceB_C "Kundenspezifischer Fehlercode fuer Fehlerpfad Dfp_NetMngDeviceB" VAL_BLK 0xC9EC0 Kwb_Wu16 65535.00 OneToOne 0.00 65535.00 FORMAT "%8.2" NUMBER 4 /end CHARACTERISTIC
/begin CHARACTERISTIC DSM_CDKDfp_NetMngDeviceC_C "Kundenspezifischer Fehlercode fuer Fehlerpfad Dfp_NetMngDeviceC" VAL_BLK 0xC9EC8 Kwb_Wu16 65535.00 OneToOne 0.00 65535.00 FORMAT "%8.2" NUMBER 4 /end CHARACTERISTIC
/begin CHARACTERISTIC DSM_CDKDfp_OPSCD_Lamp_C "Kundenspezifischer Fehlercode fuer Fehlerpfad Dfp_OPSCD_Lamp" VAL_BLK 0xC9ED0 Kwb_Wu16 65535.00 OneToOne 0.00 65535.00 FORMAT "%8.2" NUMBER 4 /end CHARACTERISTIC
/begin CHARACTERISTIC DSM_CDKDfp_OPSCD_anain_C "Kundenspezifischer Fehlercode fuer Fehlerpfad Dfp_OPSCD_anain" VAL_BLK 0xC9ED8 Kwb_Wu16 65535.00 OneToOne 0.00 65535.00 FORMAT "%8.2" NUMBER 4 /end CHARACTERISTIC
/begin CHARACTERISTIC DSM_CDKDfp_OTSCD_C "Kundenspezifischer Fehlercode fuer Fehlerpfad Dfp_OTSCD" VAL_BLK 0xC9EE0 Kwb_Wu16 65535.00 OneToOne 0.00 65535.00 FORMAT "%8.2" NUMBER 4 /end CHARACTERISTIC
/begin CHARACTERISTIC DSM_CDKDfp_OvRMon_C "Kundenspezifischer Fehlercode fuer Fehlerpfad Dfp_OvRMon" VAL_BLK 0xC9EE8 Kwb_Wu16 65535.00 OneToOne 0.00 65535.00 FORMAT "%8.2" NUMBER 4 /end CHARACTERISTIC
/begin CHARACTERISTIC DSM_CDKDfp_OvRMonBrk_C "Kundenspezifischer Fehlercode fuer Fehlerpfad Dfp_OvRMonBrk" VAL_BLK 0xC9EF0 Kwb_Wu16 65535.00 OneToOne 0.00 65535.00 FORMAT "%8.2" NUMBER 4 /end CHARACTERISTIC
/begin CHARACTERISTIC DSM_CDKDfp_OvRMonSigA_C "Kundenspezifischer Fehlercode fuer Fehlerpfad Dfp_OvRMonSigA" VAL_BLK 0xC9EF8 Kwb_Wu16 65535.00 OneToOne 0.00 65535.00 FORMAT "%8.2" NUMBER 4 /end CHARACTERISTIC
/begin CHARACTERISTIC DSM_CDKDfp_OxiCCDTPre_C "Kundenspezifischer Fehlercode fuer Fehlerpfad Dfp_OxiCCDTPre" VAL_BLK 0xC9F00 Kwb_Wu16 65535.00 OneToOne 0.00 65535.00 FORMAT "%8.2" NUMBER 4 /end CHARACTERISTIC
/begin CHARACTERISTIC DSM_CDKDfp_PCR_GovDevNeg_C "Kundenspezifischer Fehlercode fuer Fehlerpfad Dfp_PCR_GovDevNeg" VAL_BLK 0xC9F08 Kwb_Wu16 65535.00 OneToOne 0.00 65535.00 FORMAT "%8.2" NUMBER 4 /end CHARACTERISTIC
/begin CHARACTERISTIC DSM_CDKDfp_PCR_GovDevPos_C "Kundenspezifischer Fehlercode fuer Fehlerpfad Dfp_PCR_GovDevPos" VAL_BLK 0xC9F10 Kwb_Wu16 65535.00 OneToOne 0.00 65535.00 FORMAT "%8.2" NUMBER 4 /end CHARACTERISTIC
/begin CHARACTERISTIC DSM_CDKDfp_PCVCDNoLoad_C "Kundenspezifischer Fehlercode fuer Fehlerpfad Dfp_PCVCDNoLoad" VAL_BLK 0xC9F18 Kwb_Wu16 65535.00 OneToOne 0.00 65535.00 FORMAT "%8.2" NUMBER 4 /end CHARACTERISTIC
/begin CHARACTERISTIC DSM_CDKDfp_PCVCDSCBat_C "Kundenspezifischer Fehlercode fuer Fehlerpfad Dfp_PCVCDSCBat" VAL_BLK 0xC9F20 Kwb_Wu16 65535.00 OneToOne 0.00 65535.00 FORMAT "%8.2" NUMBER 4 /end CHARACTERISTIC
/begin CHARACTERISTIC DSM_CDKDfp_PCVCDSCGnd_C "Kundenspezifischer Fehlercode fuer Fehlerpfad Dfp_PCVCDSCGnd" VAL_BLK 0xC9F28 Kwb_Wu16 65535.00 OneToOne 0.00 65535.00 FORMAT "%8.2" NUMBER 4 /end CHARACTERISTIC
/begin CHARACTERISTIC DSM_CDKDfp_PCVCD_ADC_C "Kundenspezifischer Fehlercode fuer Fehlerpfad Dfp_PCVCD_ADC" VAL_BLK 0xC9F30 Kwb_Wu16 65535.00 OneToOne 0.00 65535.00 FORMAT "%8.2" NUMBER 4 /end CHARACTERISTIC
/begin CHARACTERISTIC DSM_CDKDfp_PCVCD_SigTst_C "Kundenspezifischer Fehlercode fuer Fehlerpfad Dfp_PCVCD_SigTst" VAL_BLK 0xC9F38 Kwb_Wu16 65535.00 OneToOne 0.00 65535.00 FORMAT "%8.2" NUMBER 4 /end CHARACTERISTIC
/begin CHARACTERISTIC DSM_CDKDfp_PFltAPSens_C "Kundenspezifischer Fehlercode fuer Fehlerpfad Dfp_PFltAPSens" VAL_BLK 0xC9F40 Kwb_Wu16 65535.00 OneToOne 0.00 65535.00 FORMAT "%8.2" NUMBER 4 /end CHARACTERISTIC
/begin CHARACTERISTIC DSM_CDKDfp_PFltCDPPre_C "Kundenspezifischer Fehlercode fuer Fehlerpfad Dfp_PFltCDPPre" VAL_BLK 0xC9F48 Kwb_Wu16 65535.00 OneToOne 0.00 65535.00 FORMAT "%8.2" NUMBER 4 /end CHARACTERISTIC
/begin CHARACTERISTIC DSM_CDKDfp_PFltCDTempPre_C "Kundenspezifischer Fehlercode fuer Fehlerpfad Dfp_PFltCDTempPre" VAL_BLK 0xC9F50 Kwb_Wu16 65535.00 OneToOne 0.00 65535.00 FORMAT "%8.2" NUMBER 4 /end CHARACTERISTIC
/begin CHARACTERISTIC DSM_CDKDfp_PFltChar_C "Kundenspezifischer Fehlercode fuer Fehlerpfad Dfp_PFltChar" VAL_BLK 0xC9F58 Kwb_Wu16 65535.00 OneToOne 0.00 65535.00 FORMAT "%8.2" NUMBER 4 /end CHARACTERISTIC
/begin CHARACTERISTIC DSM_CDKDfp_PFltEngPrt_C "Kundenspezifischer Fehlercode fuer Fehlerpfad Dfp_PFltEngPrt" VAL_BLK 0xC9F60 Kwb_Wu16 65535.00 OneToOne 0.00 65535.00 FORMAT "%8.2" NUMBER 4 /end CHARACTERISTIC
/begin CHARACTERISTIC DSM_CDKDfp_PFltPresDynPlaus_C "Kundenspezifischer Fehlercode fuer Fehlerpfad Dfp_PFltPresDynPlaus" VAL_BLK 0xC9F68 Kwb_Wu16 65535.00 OneToOne 0.00 65535.00 FORMAT "%8.2" NUMBER 4 /end CHARACTERISTIC
/begin CHARACTERISTIC DSM_CDKDfp_PFltPresSens_C "Kundenspezifischer Fehlercode fuer Fehlerpfad Dfp_PFltPresSens" VAL_BLK 0xC9F70 Kwb_Wu16 65535.00 OneToOne 0.00 65535.00 FORMAT "%8.2" NUMBER 4 /end CHARACTERISTIC
/begin CHARACTERISTIC DSM_CDKDfp_PFltPresSensFrz_C "Kundenspezifischer Fehlercode fuer Fehlerpfad Dfp_PFltPresSensFrz" VAL_BLK 0xC9F78 Kwb_Wu16 65535.00 OneToOne 0.00 65535.00 FORMAT "%8.2" NUMBER 4 /end CHARACTERISTIC
/begin CHARACTERISTIC DSM_CDKDfp_PFltPresSensHsLn_C "Kundenspezifischer Fehlercode fuer Fehlerpfad Dfp_PFltPresSensHsLn" VAL_BLK 0xC9F80 Kwb_Wu16 65535.00 OneToOne 0.00 65535.00 FORMAT "%8.2" NUMBER 4 /end CHARACTERISTIC
/begin CHARACTERISTIC DSM_CDKDfp_PFltPresSensSot_C "Kundenspezifischer Fehlercode fuer Fehlerpfad Dfp_PFltPresSensSot" VAL_BLK 0xC9F88 Kwb_Wu16 65535.00 OneToOne 0.00 65535.00 FORMAT "%8.2" NUMBER 4 /end CHARACTERISTIC
/begin CHARACTERISTIC DSM_CDKDfp_PFltRgnPerm_C "Kundenspezifischer Fehlercode fuer Fehlerpfad Dfp_PFltRgnPerm" VAL_BLK 0xC9F90 Kwb_Wu16 65535.00 OneToOne 0.00 65535.00 FORMAT "%8.2" NUMBER 4 /end CHARACTERISTIC
/begin CHARACTERISTIC DSM_CDKDfp_PFltTempDwnStrm_C "Kundenspezifischer Fehlercode fuer Fehlerpfad Dfp_PFltTempDwnStrm" VAL_BLK 0xC9F98 Kwb_Wu16 65535.00 OneToOne 0.00 65535.00 FORMAT "%8.2" NUMBER 4 /end CHARACTERISTIC
/begin CHARACTERISTIC DSM_CDKDfp_PFltTempSens_C "Kundenspezifischer Fehlercode fuer Fehlerpfad Dfp_PFltTempSens" VAL_BLK 0xC9FA0 Kwb_Wu16 65535.00 OneToOne 0.00 65535.00 FORMAT "%8.2" NUMBER 4 /end CHARACTERISTIC
/begin CHARACTERISTIC DSM_CDKDfp_PFltTempUpStrm_C "Kundenspezifischer Fehlercode fuer Fehlerpfad Dfp_PFltTempUpStrm" VAL_BLK 0xC9FA8 Kwb_Wu16 65535.00 OneToOne 0.00 65535.00 FORMAT "%8.2" NUMBER 4 /end CHARACTERISTIC
/begin CHARACTERISTIC DSM_CDKDfp_PFltmSotDiffMax_C "Kundenspezifischer Fehlercode fuer Fehlerpfad Dfp_PFltmSotDiffMax" VAL_BLK 0xC9FB0 Kwb_Wu16 65535.00 OneToOne 0.00 65535.00 FORMAT "%8.2" NUMBER 4 /end CHARACTERISTIC
/begin CHARACTERISTIC DSM_CDKDfp_QLTCD_C "Kundenspezifischer Fehlercode fuer Fehlerpfad Dfp_QLTCD" VAL_BLK 0xC9FB8 Kwb_Wu16 65535.00 OneToOne 0.00 65535.00 FORMAT "%8.2" NUMBER 4 /end CHARACTERISTIC
/begin CHARACTERISTIC DSM_CDKDfp_RTMMon_C "Kundenspezifischer Fehlercode fuer Fehlerpfad Dfp_RTMMon" VAL_BLK 0xC9FC0 Kwb_Wu16 65535.00 OneToOne 0.00 65535.00 FORMAT "%8.2" NUMBER 4 /end CHARACTERISTIC
/begin CHARACTERISTIC DSM_CDKDfp_RailCD_C "Kundenspezifischer Fehlercode fuer Fehlerpfad Dfp_RailCD" VAL_BLK 0xC9FC8 Kwb_Wu16 65535.00 OneToOne 0.00 65535.00 FORMAT "%8.2" NUMBER 4 /end CHARACTERISTIC
/begin CHARACTERISTIC DSM_CDKDfp_RailCDOfsTst_C "Kundenspezifischer Fehlercode fuer Fehlerpfad Dfp_RailCDOfsTst" VAL_BLK 0xC9FD0 Kwb_Wu16 65535.00 OneToOne 0.00 65535.00 FORMAT "%8.2" NUMBER 4 /end CHARACTERISTIC
/begin CHARACTERISTIC DSM_CDKDfp_RailCD_PMonStrt_C "Kundenspezifischer Fehlercode fuer Fehlerpfad Dfp_RailCD_PMonStrt" VAL_BLK 0xC9FD8 Kwb_Wu16 65535.00 OneToOne 0.00 65535.00 FORMAT "%8.2" NUMBER 4 /end CHARACTERISTIC
/begin CHARACTERISTIC DSM_CDKDfp_RailCtlModeMeUnDiag_C "Kundenspezifischer Fehlercode fuer Fehlerpfad Dfp_RailCtlModeMeUnDiag" VAL_BLK 0xC9FE0 Kwb_Wu16 65535.00 OneToOne 0.00 65535.00 FORMAT "%8.2" NUMBER 4 /end CHARACTERISTIC
/begin CHARACTERISTIC DSM_CDKDfp_RailCtlModePCVDiag_C "Kundenspezifischer Fehlercode fuer Fehlerpfad Dfp_RailCtlModePCVDiag" VAL_BLK 0xC9FE8 Kwb_Wu16 65535.00 OneToOne 0.00 65535.00 FORMAT "%8.2" NUMBER 4 /end CHARACTERISTIC
/begin CHARACTERISTIC DSM_CDKDfp_RailMeUn0_C "Kundenspezifischer Fehlercode fuer Fehlerpfad Dfp_RailMeUn0" VAL_BLK 0xC9FF0 Kwb_Wu16 65535.00 OneToOne 0.00 65535.00 FORMAT "%8.2" NUMBER 4 /end CHARACTERISTIC
/begin CHARACTERISTIC DSM_CDKDfp_RailMeUn1_C "Kundenspezifischer Fehlercode fuer Fehlerpfad Dfp_RailMeUn1" VAL_BLK 0xC9FF8 Kwb_Wu16 65535.00 OneToOne 0.00 65535.00 FORMAT "%8.2" NUMBER 4 /end CHARACTERISTIC
/begin CHARACTERISTIC DSM_CDKDfp_RailMeUn2_C "Kundenspezifischer Fehlercode fuer Fehlerpfad Dfp_RailMeUn2" VAL_BLK 0xCA000 Kwb_Wu16 65535.00 OneToOne 0.00 65535.00 FORMAT "%8.2" NUMBER 4 /end CHARACTERISTIC
/begin CHARACTERISTIC DSM_CDKDfp_RailMeUn3_C "Kundenspezifischer Fehlercode fuer Fehlerpfad Dfp_RailMeUn3" VAL_BLK 0xCA008 Kwb_Wu16 65535.00 OneToOne 0.00 65535.00 FORMAT "%8.2" NUMBER 4 /end CHARACTERISTIC
/begin CHARACTERISTIC DSM_CDKDfp_RailMeUn4_C "Kundenspezifischer Fehlercode fuer Fehlerpfad Dfp_RailMeUn4" VAL_BLK 0xCA010 Kwb_Wu16 65535.00 OneToOne 0.00 65535.00 FORMAT "%8.2" NUMBER 4 /end CHARACTERISTIC
/begin CHARACTERISTIC DSM_CDKDfp_RailPCV0_C "Kundenspezifischer Fehlercode fuer Fehlerpfad Dfp_RailPCV0" VAL_BLK 0xCA018 Kwb_Wu16 65535.00 OneToOne 0.00 65535.00 FORMAT "%8.2" NUMBER 4 /end CHARACTERISTIC
/begin CHARACTERISTIC DSM_CDKDfp_RailPCV1_C "Kundenspezifischer Fehlercode fuer Fehlerpfad Dfp_RailPCV1" VAL_BLK 0xCA020 Kwb_Wu16 65535.00 OneToOne 0.00 65535.00 FORMAT "%8.2" NUMBER 4 /end CHARACTERISTIC
/begin CHARACTERISTIC DSM_CDKDfp_RailPCV2_C "Kundenspezifischer Fehlercode fuer Fehlerpfad Dfp_RailPCV2" VAL_BLK 0xCA028 Kwb_Wu16 65535.00 OneToOne 0.00 65535.00 FORMAT "%8.2" NUMBER 4 /end CHARACTERISTIC
/begin CHARACTERISTIC DSM_CDKDfp_RailPCV3_C "Kundenspezifischer Fehlercode fuer Fehlerpfad Dfp_RailPCV3" VAL_BLK 0xCA030 Kwb_Wu16 65535.00 OneToOne 0.00 65535.00 FORMAT "%8.2" NUMBER 4 /end CHARACTERISTIC
/begin CHARACTERISTIC DSM_CDKDfp_RailPCV4_C "Kundenspezifischer Fehlercode fuer Fehlerpfad Dfp_RailPCV4" VAL_BLK 0xCA038 Kwb_Wu16 65535.00 OneToOne 0.00 65535.00 FORMAT "%8.2" NUMBER 4 /end CHARACTERISTIC
/begin CHARACTERISTIC DSM_CDKDfp_RailPCV5_C "Kundenspezifischer Fehlercode fuer Fehlerpfad Dfp_RailPCV5" VAL_BLK 0xCA040 Kwb_Wu16 65535.00 OneToOne 0.00 65535.00 FORMAT "%8.2" NUMBER 4 /end CHARACTERISTIC
/begin CHARACTERISTIC DSM_CDKDfp_SOPTst_C "Kundenspezifischer Fehlercode fuer Fehlerpfad Dfp_SOPTst" VAL_BLK 0xCA048 Kwb_Wu16 65535.00 OneToOne 0.00 65535.00 FORMAT "%8.2" NUMBER 4 /end CHARACTERISTIC
/begin CHARACTERISTIC DSM_CDKDfp_SSpMon1_C "Kundenspezifischer Fehlercode fuer Fehlerpfad Dfp_SSpMon1" VAL_BLK 0xCA050 Kwb_Wu16 65535.00 OneToOne 0.00 65535.00 FORMAT "%8.2" NUMBER 4 /end CHARACTERISTIC
/begin CHARACTERISTIC DSM_CDKDfp_SSpMon2_C "Kundenspezifischer Fehlercode fuer Fehlerpfad Dfp_SSpMon2" VAL_BLK 0xCA058 Kwb_Wu16 65535.00 OneToOne 0.00 65535.00 FORMAT "%8.2" NUMBER 4 /end CHARACTERISTIC
/begin CHARACTERISTIC DSM_CDKDfp_SSpMon3_C "Kundenspezifischer Fehlercode fuer Fehlerpfad Dfp_SSpMon3" VAL_BLK 0xCA060 Kwb_Wu16 65535.00 OneToOne 0.00 65535.00 FORMAT "%8.2" NUMBER 4 /end CHARACTERISTIC
/begin CHARACTERISTIC DSM_CDKDfp_ShutCD_C "Kundenspezifischer Fehlercode fuer Fehlerpfad Dfp_ShutCD" VAL_BLK 0xCA068 Kwb_Wu16 65535.00 OneToOne 0.00 65535.00 FORMAT "%8.2" NUMBER 4 /end CHARACTERISTIC
/begin CHARACTERISTIC DSM_CDKDfp_StSysTrqShutOff_C "Kundenspezifischer Fehlercode fuer Fehlerpfad Dfp_StSysTrqShutOff" VAL_BLK 0xCA070 Kwb_Wu16 65535.00 OneToOne 0.00 65535.00 FORMAT "%8.2" NUMBER 4 /end CHARACTERISTIC
/begin CHARACTERISTIC DSM_CDKDfp_StrtCD_Actr_C "Kundenspezifischer Fehlercode fuer Fehlerpfad Dfp_StrtCD_Actr" VAL_BLK 0xCA078 Kwb_Wu16 65535.00 OneToOne 0.00 65535.00 FORMAT "%8.2" NUMBER 4 /end CHARACTERISTIC
/begin CHARACTERISTIC DSM_CDKDfp_SysLamp_C "Kundenspezifischer Fehlercode fuer Fehlerpfad Dfp_SysLamp" VAL_BLK 0xCA080 Kwb_Wu16 65535.00 OneToOne 0.00 65535.00 FORMAT "%8.2" NUMBER 4 /end CHARACTERISTIC
/begin CHARACTERISTIC DSM_CDKDfp_T15CD_C "Kundenspezifischer Fehlercode fuer Fehlerpfad Dfp_T15CD" VAL_BLK 0xCA088 Kwb_Wu16 65535.00 OneToOne 0.00 65535.00 FORMAT "%8.2" NUMBER 4 /end CHARACTERISTIC
/begin CHARACTERISTIC DSM_CDKDfp_TGearbx_C "Kundenspezifischer Fehlercode fuer Fehlerpfad Dfp_TGearbx" VAL_BLK 0xCA090 Kwb_Wu16 65535.00 OneToOne 0.00 65535.00 FORMAT "%8.2" NUMBER 4 /end CHARACTERISTIC
/begin CHARACTERISTIC DSM_CDKDfp_TPUMon_C "Kundenspezifischer Fehlercode fuer Fehlerpfad Dfp_TPUMon" VAL_BLK 0xCA098 Kwb_Wu16 65535.00 OneToOne 0.00 65535.00 FORMAT "%8.2" NUMBER 4 /end CHARACTERISTIC
/begin CHARACTERISTIC DSM_CDKDfp_TVACD_Max_C "Kundenspezifischer Fehlercode fuer Fehlerpfad Dfp_TVACD_Max" VAL_BLK 0xCA0A0 Kwb_Wu16 65535.00 OneToOne 0.00 65535.00 FORMAT "%8.2" NUMBER 4 /end CHARACTERISTIC
/begin CHARACTERISTIC DSM_CDKDfp_TVACD_Min_C "Kundenspezifischer Fehlercode fuer Fehlerpfad Dfp_TVACD_Min" VAL_BLK 0xCA0A8 Kwb_Wu16 65535.00 OneToOne 0.00 65535.00 FORMAT "%8.2" NUMBER 4 /end CHARACTERISTIC
/begin CHARACTERISTIC DSM_CDKDfp_TVACD_SigNpl_C "Kundenspezifischer Fehlercode fuer Fehlerpfad Dfp_TVACD_SigNpl" VAL_BLK 0xCA0B0 Kwb_Wu16 65535.00 OneToOne 0.00 65535.00 FORMAT "%8.2" NUMBER 4 /end CHARACTERISTIC
/begin CHARACTERISTIC DSM_CDKDfp_TVACD_TVADia1_C "Kundenspezifischer Fehlercode fuer Fehlerpfad Dfp_TVACD_TVADia1" VAL_BLK 0xCA0B8 Kwb_Wu16 65535.00 OneToOne 0.00 65535.00 FORMAT "%8.2" NUMBER 4 /end CHARACTERISTIC
/begin CHARACTERISTIC DSM_CDKDfp_TVACD_TVADia2_C "Kundenspezifischer Fehlercode fuer Fehlerpfad Dfp_TVACD_TVADia2" VAL_BLK 0xCA0C0 Kwb_Wu16 65535.00 OneToOne 0.00 65535.00 FORMAT "%8.2" NUMBER 4 /end CHARACTERISTIC
/begin CHARACTERISTIC DSM_CDKDfp_TVACD_TVADia3_C "Kundenspezifischer Fehlercode fuer Fehlerpfad Dfp_TVACD_TVADia3" VAL_BLK 0xCA0C8 Kwb_Wu16 65535.00 OneToOne 0.00 65535.00 FORMAT "%8.2" NUMBER 4 /end CHARACTERISTIC
/begin CHARACTERISTIC DSM_CDKDfp_VSACD_Max_C "Kundenspezifischer Fehlercode fuer Fehlerpfad Dfp_VSACD_Max" VAL_BLK 0xCA0D0 Kwb_Wu16 65535.00 OneToOne 0.00 65535.00 FORMAT "%8.2" NUMBER 4 /end CHARACTERISTIC
/begin CHARACTERISTIC DSM_CDKDfp_VSACD_Min_C "Kundenspezifischer Fehlercode fuer Fehlerpfad Dfp_VSACD_Min" VAL_BLK 0xCA0D8 Kwb_Wu16 65535.00 OneToOne 0.00 65535.00 FORMAT "%8.2" NUMBER 4 /end CHARACTERISTIC
/begin CHARACTERISTIC DSM_CDKDfp_VSACD_SigNpl_C "Kundenspezifischer Fehlercode fuer Fehlerpfad Dfp_VSACD_SigNpl" VAL_BLK 0xCA0E0 Kwb_Wu16 65535.00 OneToOne 0.00 65535.00 FORMAT "%8.2" NUMBER 4 /end CHARACTERISTIC
/begin CHARACTERISTIC DSM_CDKDfp_VSACD_VSADia1_C "Kundenspezifischer Fehlercode fuer Fehlerpfad Dfp_VSACD_VSADia1" VAL_BLK 0xCA0E8 Kwb_Wu16 65535.00 OneToOne 0.00 65535.00 FORMAT "%8.2" NUMBER 4 /end CHARACTERISTIC
/begin CHARACTERISTIC DSM_CDKDfp_VSACD_VSADia2_C "Kundenspezifischer Fehlercode fuer Fehlerpfad Dfp_VSACD_VSADia2" VAL_BLK 0xCA0F0 Kwb_Wu16 65535.00 OneToOne 0.00 65535.00 FORMAT "%8.2" NUMBER 4 /end CHARACTERISTIC
/begin CHARACTERISTIC DSM_CDKDfp_VSACD_VSADia3_C "Kundenspezifischer Fehlercode fuer Fehlerpfad Dfp_VSACD_VSADia3" VAL_BLK 0xCA0F8 Kwb_Wu16 65535.00 OneToOne 0.00 65535.00 FORMAT "%8.2" NUMBER 4 /end CHARACTERISTIC
/begin CHARACTERISTIC DSM_CDKDfp_VSACD_VSADia4_C "Kundenspezifischer Fehlercode fuer Fehlerpfad Dfp_VSACD_VSADia4" VAL_BLK 0xCA100 Kwb_Wu16 65535.00 OneToOne 0.00 65535.00 FORMAT "%8.2" NUMBER 4 /end CHARACTERISTIC
/begin CHARACTERISTIC DSM_CDKDfp_VSSCD1_C "Kundenspezifischer Fehlercode fuer Fehlerpfad Dfp_VSSCD1" VAL_BLK 0xCA108 Kwb_Wu16 65535.00 OneToOne 0.00 65535.00 FORMAT "%8.2" NUMBER 4 /end CHARACTERISTIC
/begin CHARACTERISTIC DSM_CDKDfp_VSSCD2_C "Kundenspezifischer Fehlercode fuer Fehlerpfad Dfp_VSSCD2" VAL_BLK 0xCA110 Kwb_Wu16 65535.00 OneToOne 0.00 65535.00 FORMAT "%8.2" NUMBER 4 /end CHARACTERISTIC
/begin CHARACTERISTIC DSM_CDKDfp_WdCom_C "Kundenspezifischer Fehlercode fuer Fehlerpfad Dfp_WdCom" VAL_BLK 0xCA118 Kwb_Wu16 65535.00 OneToOne 0.00 65535.00 FORMAT "%8.2" NUMBER 4 /end CHARACTERISTIC
/begin CHARACTERISTIC DSM_ClaDfp_Layer_TANS_C "Fehlerklasse fuer Fehlerpfad Dfp_Layer_TANS" VALUE 0xCA120 Kw_Wu8 20.00 OneToOne 0.00 20.00 FORMAT "%5.2" EXTENDED_LIMITS 0.00 255.0 /end CHARACTERISTIC
/begin CHARACTERISTIC DSM_ClaDfp_ACCDSwtin_C "Fehlerklasse fuer Fehlerpfad Dfp_ACCDSwtin" VALUE 0xCA121 Kw_Wu8 20.00 OneToOne 0.00 20.00 FORMAT "%5.2" EXTENDED_LIMITS 0.00 255.0 /end CHARACTERISTIC
/begin CHARACTERISTIC DSM_ClaDfp_ACC_PlausTrqDes_C "Fehlerklasse fuer Fehlerpfad Dfp_ACC_PlausTrqDes" VALUE 0xCA122 Kw_Wu8 20.00 OneToOne 0.00 20.00 FORMAT "%5.2" EXTENDED_LIMITS 0.00 255.0 /end CHARACTERISTIC
/begin CHARACTERISTIC DSM_ClaDfp_ACC_trqInr_C "Fehlerklasse fuer Fehlerpfad Dfp_ACC_trqInr" VALUE 0xCA123 Kw_Wu8 20.00 OneToOne 0.00 20.00 FORMAT "%5.2" EXTENDED_LIMITS 0.00 255.0 /end CHARACTERISTIC
/begin CHARACTERISTIC DSM_ClaDfp_ACTrq_C "Fehlerklasse fuer Fehlerpfad Dfp_ACTrq" VALUE 0xCA124 Kw_Wu8 20.00 OneToOne 0.00 20.00 FORMAT "%5.2" EXTENDED_LIMITS 0.00 255.0 /end CHARACTERISTIC
/begin CHARACTERISTIC DSM_ClaDfp_ADCMon_C "Fehlerklasse fuer Fehlerpfad Dfp_ADCMon" VALUE 0xCA125 Kw_Wu8 20.00 OneToOne 0.00 20.00 FORMAT "%5.2" EXTENDED_LIMITS 0.00 255.0 /end CHARACTERISTIC
/begin CHARACTERISTIC DSM_ClaDfp_AFSCDIdlAdjVal_C "Fehlerklasse fuer Fehlerpfad Dfp_AFSCDIdlAdjVal" VALUE 0xCA126 Kw_Wu8 20.00 OneToOne 0.00 20.00 FORMAT "%5.2" EXTENDED_LIMITS 0.00 255.0 /end CHARACTERISTIC
/begin CHARACTERISTIC DSM_ClaDfp_AFSCDLdAdjVal_C "Fehlerklasse fuer Fehlerpfad Dfp_AFSCDLdAdjVal" VALUE 0xCA127 Kw_Wu8 20.00 OneToOne 0.00 20.00 FORMAT "%5.2" EXTENDED_LIMITS 0.00 255.0 /end CHARACTERISTIC
/begin CHARACTERISTIC DSM_ClaDfp_AFSCD_AirTempDcyc_C "Fehlerklasse fuer Fehlerpfad Dfp_AFSCD_AirTempDcyc" VALUE 0xCA128 Kw_Wu8 20.00 OneToOne 0.00 20.00 FORMAT "%5.2" EXTENDED_LIMITS 0.00 255.0 /end CHARACTERISTIC
/begin CHARACTERISTIC DSM_ClaDfp_AFSCD_PlOffsDrft_C "Fehlerklasse fuer Fehlerpfad Dfp_AFSCD_PlOffsDrft" VALUE 0xCA129 Kw_Wu8 20.00 OneToOne 0.00 20.00 FORMAT "%5.2" EXTENDED_LIMITS 0.00 255.0 /end CHARACTERISTIC
/begin CHARACTERISTIC DSM_ClaDfp_AFSCD_PlSetyDrft_C "Fehlerklasse fuer Fehlerpfad Dfp_AFSCD_PlSetyDrft" VALUE 0xCA12A Kw_Wu8 20.00 OneToOne 0.00 20.00 FORMAT "%5.2" EXTENDED_LIMITS 0.00 255.0 /end CHARACTERISTIC
/begin CHARACTERISTIC DSM_ClaDfp_AFSCD_SRCAirTemp_C "Fehlerklasse fuer Fehlerpfad Dfp_AFSCD_SRCAirTemp" VALUE 0xCA12B Kw_Wu8 20.00 OneToOne 0.00 20.00 FORMAT "%5.2" EXTENDED_LIMITS 0.00 255.0 /end CHARACTERISTIC
/begin CHARACTERISTIC DSM_ClaDfp_AFSCD_SRCBatt_C "Fehlerklasse fuer Fehlerpfad Dfp_AFSCD_SRCBatt" VALUE 0xCA12C Kw_Wu8 20.00 OneToOne 0.00 20.00 FORMAT "%5.2" EXTENDED_LIMITS 0.00 255.0 /end CHARACTERISTIC
/begin CHARACTERISTIC DSM_ClaDfp_AFSCD_SRCCorrAirm_C "Fehlerklasse fuer Fehlerpfad Dfp_AFSCD_SRCCorrAirm" VALUE 0xCA12D Kw_Wu8 20.00 OneToOne 0.00 20.00 FORMAT "%5.2" EXTENDED_LIMITS 0.00 255.0 /end CHARACTERISTIC
/begin CHARACTERISTIC DSM_ClaDfp_AFSCD_SRCRawAirm_C "Fehlerklasse fuer Fehlerpfad Dfp_AFSCD_SRCRawAirm" VALUE 0xCA12E Kw_Wu8 20.00 OneToOne 0.00 20.00 FORMAT "%5.2" EXTENDED_LIMITS 0.00 255.0 /end CHARACTERISTIC
/begin CHARACTERISTIC DSM_ClaDfp_AFSCD_SRCRefSigPer_C "Fehlerklasse fuer Fehlerpfad Dfp_AFSCD_SRCRefSigPer" VALUE 0xCA12F Kw_Wu8 20.00 OneToOne 0.00 20.00 FORMAT "%5.2" EXTENDED_LIMITS 0.00 255.0 /end CHARACTERISTIC
/begin CHARACTERISTIC DSM_ClaDfp_AOHtCD_C "Fehlerklasse fuer Fehlerpfad Dfp_AOHtCD" VALUE 0xCA130 Kw_Wu8 20.00 OneToOne 0.00 20.00 FORMAT "%5.2" EXTENDED_LIMITS 0.00 255.0 /end CHARACTERISTIC
/begin CHARACTERISTIC DSM_ClaDfp_AOHtCD_AOHtDia1_C "Fehlerklasse fuer Fehlerpfad Dfp_AOHtCD_AOHtDia1" VALUE 0xCA131 Kw_Wu8 20.00 OneToOne 0.00 20.00 FORMAT "%5.2" EXTENDED_LIMITS 0.00 255.0 /end CHARACTERISTIC
/begin CHARACTERISTIC DSM_ClaDfp_AOHtCD_AOHtDia2_C "Fehlerklasse fuer Fehlerpfad Dfp_AOHtCD_AOHtDia2" VALUE 0xCA132 Kw_Wu8 20.00 OneToOne 0.00 20.00 FORMAT "%5.2" EXTENDED_LIMITS 0.00 255.0 /end CHARACTERISTIC
/begin CHARACTERISTIC DSM_ClaDfp_Layer_TUMG_C "Fehlerklasse fuer Fehlerpfad Dfp_Layer_TUMG" VALUE 0xCA133 Kw_Wu8 20.00 OneToOne 0.00 20.00 FORMAT "%5.2" EXTENDED_LIMITS 0.00 255.0 /end CHARACTERISTIC
/begin CHARACTERISTIC DSM_ClaDfp_AOHtCD_AOHtDia3_C "Fehlerklasse fuer Fehlerpfad Dfp_AOHtCD_AOHtDia3" VALUE 0xCA134 Kw_Wu8 20.00 OneToOne 0.00 20.00 FORMAT "%5.2" EXTENDED_LIMITS 0.00 255.0 /end CHARACTERISTIC
/begin CHARACTERISTIC DSM_ClaDfp_APP1_C "Fehlerklasse fuer Fehlerpfad Dfp_APP1" VALUE 0xCA135 Kw_Wu8 20.00 OneToOne 0.00 20.00 FORMAT "%5.2" EXTENDED_LIMITS 0.00 255.0 /end CHARACTERISTIC
/begin CHARACTERISTIC DSM_ClaDfp_Layer_GEN_C "Fehlerklasse fuer Fehlerpfad Dfp_Layer_GEN" VALUE 0xCA136 Kw_Wu8 20.00 OneToOne 0.00 20.00 FORMAT "%5.2" EXTENDED_LIMITS 0.00 255.0 /end CHARACTERISTIC
/begin CHARACTERISTIC DSM_ClaDfp_Layer_BSD_C "Fehlerklasse fuer Fehlerpfad Dfp_Layer_BSD" VALUE 0xCA137 Kw_Wu8 20.00 OneToOne 0.00 20.00 FORMAT "%5.2" EXTENDED_LIMITS 0.00 255.0 /end CHARACTERISTIC
/begin CHARACTERISTIC DSM_ClaDfp_APP2_C "Fehlerklasse fuer Fehlerpfad Dfp_APP2" VALUE 0xCA138 Kw_Wu8 20.00 OneToOne 0.00 20.00 FORMAT "%5.2" EXTENDED_LIMITS 0.00 255.0 /end CHARACTERISTIC
/begin CHARACTERISTIC DSM_ClaDfp_APSCD_C "Fehlerklasse fuer Fehlerpfad Dfp_APSCD" VALUE 0xCA139 Kw_Wu8 20.00 OneToOne 0.00 20.00 FORMAT "%5.2" EXTENDED_LIMITS 0.00 255.0 /end CHARACTERISTIC
/begin CHARACTERISTIC DSM_ClaDfp_ARS_C "Fehlerklasse fuer Fehlerpfad Dfp_ARS" VALUE 0xCA13A Kw_Wu8 20.00 OneToOne 0.00 20.00 FORMAT "%5.2" EXTENDED_LIMITS 0.00 255.0 /end CHARACTERISTIC
/begin CHARACTERISTIC DSM_ClaDfp_AccPedPlausBrk_C "Fehlerklasse fuer Fehlerpfad Dfp_AccPedPlausBrk" VALUE 0xCA13B Kw_Wu8 20.00 OneToOne 0.00 20.00 FORMAT "%5.2" EXTENDED_LIMITS 0.00 255.0 /end CHARACTERISTIC
/begin CHARACTERISTIC DSM_ClaDfp_AirCtlPlateBreak_C "DSM variable for Dfp_AirCtlPlateBreak_mp" VALUE 0xCA13C Kw_Wu8 20.00 OneToOne 0.00 20.00 FORMAT "%5.2" EXTENDED_LIMITS 0.00 255.0 /end CHARACTERISTIC
/begin CHARACTERISTIC DSM_ClaDfp_AirCtl_GovNegDev_C "Fehlerklasse fuer Fehlerpfad Dfp_AirCtl_GovNegDev" VALUE 0xCA13D Kw_Wu8 20.00 OneToOne 0.00 20.00 FORMAT "%5.2" EXTENDED_LIMITS 0.00 255.0 /end CHARACTERISTIC
/begin CHARACTERISTIC DSM_ClaDfp_AirCtl_GovNegDev2_C "Fehlerklasse fuer Fehlerpfad Dfp_AirCtl_GovNegDev2" VALUE 0xCA13E Kw_Wu8 20.00 OneToOne 0.00 20.00 FORMAT "%5.2" EXTENDED_LIMITS 0.00 255.0 /end CHARACTERISTIC
/begin CHARACTERISTIC DSM_ClaDfp_AirCtl_GovPosDev_C "Fehlerklasse fuer Fehlerpfad Dfp_AirCtl_GovPosDev" VALUE 0xCA13F Kw_Wu8 20.00 OneToOne 0.00 20.00 FORMAT "%5.2" EXTENDED_LIMITS 0.00 255.0 /end CHARACTERISTIC
/begin CHARACTERISTIC DSM_ClaDfp_AirCtl_GovPosDev2_C "Fehlerklasse fuer Fehlerpfad Dfp_AirCtl_GovPosDev2" VALUE 0xCA140 Kw_Wu8 20.00 OneToOne 0.00 20.00 FORMAT "%5.2" EXTENDED_LIMITS 0.00 255.0 /end CHARACTERISTIC
/begin CHARACTERISTIC DSM_ClaDfp_AltCD_C "Fehlerklasse fuer Fehlerpfad Dfp_AltCD" VALUE 0xCA141 Kw_Wu8 20.00 OneToOne 0.00 20.00 FORMAT "%5.2" EXTENDED_LIMITS 0.00 255.0 /end CHARACTERISTIC
/begin CHARACTERISTIC DSM_ClaDfp_Layer_QLT_C "Fehlerklasse fuer Fehlerpfad Dfp_Layer_QLT" VALUE 0xCA142 Kw_Wu8 20.00 OneToOne 0.00 20.00 FORMAT "%5.2" EXTENDED_LIMITS 0.00 255.0 /end CHARACTERISTIC
/begin CHARACTERISTIC DSM_ClaDfp_BPACD_BPADia1_C "Fehlerklasse fuer Fehlerpfad Dfp_BPACD_BPADia1" VALUE 0xCA143 Kw_Wu8 20.00 OneToOne 0.00 20.00 FORMAT "%5.2" EXTENDED_LIMITS 0.00 255.0 /end CHARACTERISTIC
/begin CHARACTERISTIC DSM_ClaDfp_Layer_IBS1_C "Fehlerklasse fuer Fehlerpfad Dfp_Layer_IBS1" VALUE 0xCA144 Kw_Wu8 20.00 OneToOne 0.00 20.00 FORMAT "%5.2" EXTENDED_LIMITS 0.00 255.0 /end CHARACTERISTIC
/begin CHARACTERISTIC DSM_ClaDfp_Layer_IBS2_C "Fehlerklasse fuer Fehlerpfad Dfp_Layer_IBS2" VALUE 0xCA145 Kw_Wu8 20.00 OneToOne 0.00 20.00 FORMAT "%5.2" EXTENDED_LIMITS 0.00 255.0 /end CHARACTERISTIC
/begin CHARACTERISTIC DSM_ClaDfp_Layer_IBS3_C "Fehlerklasse fuer Fehlerpfad Dfp_Layer_IBS3" VALUE 0xCA146 Kw_Wu8 20.00 OneToOne 0.00 20.00 FORMAT "%5.2" EXTENDED_LIMITS 0.00 255.0 /end CHARACTERISTIC
/begin CHARACTERISTIC DSM_ClaDfp_Layer_PMBN_C "Fehlerklasse fuer Fehlerpfad Dfp_Layer_PMBN" VALUE 0xCA147 Kw_Wu8 20.00 OneToOne 0.00 20.00 FORMAT "%5.2" EXTENDED_LIMITS 0.00 255.0 /end CHARACTERISTIC
/begin CHARACTERISTIC DSM_ClaDfp_Layer_PMBATT_C "Fehlerklasse fuer Fehlerpfad Dfp_Layer_PMBATT" VALUE 0xCA148 Kw_Wu8 20.00 OneToOne 0.00 20.00 FORMAT "%5.2" EXTENDED_LIMITS 0.00 255.0 /end CHARACTERISTIC
/begin CHARACTERISTIC DSM_ClaDfp_BPACD_BPADia2_C "Fehlerklasse fuer Fehlerpfad Dfp_BPACD_BPADia2" VALUE 0xCA149 Kw_Wu8 20.00 OneToOne 0.00 20.00 FORMAT "%5.2" EXTENDED_LIMITS 0.00 255.0 /end CHARACTERISTIC
/begin CHARACTERISTIC DSM_ClaDfp_BPACD_BPADia3_C "Fehlerklasse fuer Fehlerpfad Dfp_BPACD_BPADia3" VALUE 0xCA14A Kw_Wu8 20.00 OneToOne 0.00 20.00 FORMAT "%5.2" EXTENDED_LIMITS 0.00 255.0 /end CHARACTERISTIC
/begin CHARACTERISTIC DSM_ClaDfp_BPACD_Max_C "Fehlerklasse fuer Fehlerpfad Dfp_BPACD_Max" VALUE 0xCA14B Kw_Wu8 20.00 OneToOne 0.00 20.00 FORMAT "%5.2" EXTENDED_LIMITS 0.00 255.0 /end CHARACTERISTIC
/begin CHARACTERISTIC DSM_ClaDfp_BPACD_Min_C "Fehlerklasse fuer Fehlerpfad Dfp_BPACD_Min" VALUE 0xCA14C Kw_Wu8 20.00 OneToOne 0.00 20.00 FORMAT "%5.2" EXTENDED_LIMITS 0.00 255.0 /end CHARACTERISTIC
/begin CHARACTERISTIC DSM_ClaDfp_BPACD_SigNpl_C "Fehlerklasse fuer Fehlerpfad Dfp_BPACD_SigNpl" VALUE 0xCA14D Kw_Wu8 20.00 OneToOne 0.00 20.00 FORMAT "%5.2" EXTENDED_LIMITS 0.00 255.0 /end CHARACTERISTIC
/begin CHARACTERISTIC DSM_ClaDfp_BPSCD_C "Fehlerklasse fuer Fehlerpfad Dfp_BPSCD" VALUE 0xCA14E Kw_Wu8 20.00 OneToOne 0.00 20.00 FORMAT "%5.2" EXTENDED_LIMITS 0.00 255.0 /end CHARACTERISTIC
/begin CHARACTERISTIC DSM_ClaDfp_BattCD_C "Fehlerklasse fuer Fehlerpfad Dfp_BattCD" VALUE 0xCA14F Kw_Wu8 20.00 OneToOne 0.00 20.00 FORMAT "%5.2" EXTENDED_LIMITS 0.00 255.0 /end CHARACTERISTIC
/begin CHARACTERISTIC DSM_ClaDfp_BrkCD_C "Fehlerklasse fuer Fehlerpfad Dfp_BrkCD" VALUE 0xCA150 Kw_Wu8 20.00 OneToOne 0.00 20.00 FORMAT "%5.2" EXTENDED_LIMITS 0.00 255.0 /end CHARACTERISTIC
/begin CHARACTERISTIC DSM_ClaDfp_Bss_C "Fehlerklasse fuer Fehlerpfad Dfp_Bss" VALUE 0xCA151 Kw_Wu8 20.00 OneToOne 0.00 20.00 FORMAT "%5.2" EXTENDED_LIMITS 0.00 255.0 /end CHARACTERISTIC
/begin CHARACTERISTIC DSM_ClaDfp_CBACD_C "Fehlerklasse fuer Fehlerpfad Dfp_CBACD" VALUE 0xCA152 Kw_Wu8 20.00 OneToOne 0.00 20.00 FORMAT "%5.2" EXTENDED_LIMITS 0.00 255.0 /end CHARACTERISTIC
/begin CHARACTERISTIC DSM_ClaDfp_CTSCD_C "Fehlerklasse fuer Fehlerpfad Dfp_CTSCD" VALUE 0xCA153 Kw_Wu8 20.00 OneToOne 0.00 20.00 FORMAT "%5.2" EXTENDED_LIMITS 0.00 255.0 /end CHARACTERISTIC
/begin CHARACTERISTIC DSM_ClaDfp_Clg_DynTst_C "Fehlerklasse fuer Fehlerpfad Dfp_Clg_DynTst" VALUE 0xCA154 Kw_Wu8 20.00 OneToOne 0.00 20.00 FORMAT "%5.2" EXTENDED_LIMITS 0.00 255.0 /end CHARACTERISTIC
/begin CHARACTERISTIC DSM_ClaDfp_CmbChbMisfire1_C "Fehlerklasse fuer Fehlerpfad Dfp_CmbChbMisfire1" VALUE 0xCA155 Kw_Wu8 20.00 OneToOne 0.00 20.00 FORMAT "%5.2" EXTENDED_LIMITS 0.00 255.0 /end CHARACTERISTIC
/begin CHARACTERISTIC DSM_ClaDfp_CmbChbMisfire2_C "Fehlerklasse fuer Fehlerpfad Dfp_CmbChbMisfire2" VALUE 0xCA156 Kw_Wu8 20.00 OneToOne 0.00 20.00 FORMAT "%5.2" EXTENDED_LIMITS 0.00 255.0 /end CHARACTERISTIC
/begin CHARACTERISTIC DSM_ClaDfp_CmbChbMisfire3_C "Fehlerklasse fuer Fehlerpfad Dfp_CmbChbMisfire3" VALUE 0xCA157 Kw_Wu8 20.00 OneToOne 0.00 20.00 FORMAT "%5.2" EXTENDED_LIMITS 0.00 255.0 /end CHARACTERISTIC
/begin CHARACTERISTIC DSM_ClaDfp_CmbChbMisfire4_C "Fehlerklasse fuer Fehlerpfad Dfp_CmbChbMisfire4" VALUE 0xCA158 Kw_Wu8 20.00 OneToOne 0.00 20.00 FORMAT "%5.2" EXTENDED_LIMITS 0.00 255.0 /end CHARACTERISTIC
/begin CHARACTERISTIC DSM_ClaDfp_CmbChbMisfire5_C "Fehlerklasse fuer Fehlerpfad Dfp_CmbChbMisfire5" VALUE 0xCA159 Kw_Wu8 20.00 OneToOne 0.00 20.00 FORMAT "%5.2" EXTENDED_LIMITS 0.00 255.0 /end CHARACTERISTIC
/begin CHARACTERISTIC DSM_ClaDfp_CmbChbMisfire6_C "Fehlerklasse fuer Fehlerpfad Dfp_CmbChbMisfire6" VALUE 0xCA15A Kw_Wu8 20.00 OneToOne 0.00 20.00 FORMAT "%5.2" EXTENDED_LIMITS 0.00 255.0 /end CHARACTERISTIC
/begin CHARACTERISTIC DSM_ClaDfp_CmbChbMisfireMul_C "Fehlerklasse fuer Fehlerpfad Dfp_CmbChb_MisfireMul" VALUE 0xCA15B Kw_Wu8 20.00 OneToOne 0.00 20.00 FORMAT "%5.2" EXTENDED_LIMITS 0.00 255.0 /end CHARACTERISTIC
/begin CHARACTERISTIC DSM_ClaDfp_CoVMDCSh_C "Fehlerklasse fuer Fehlerpfad Dfp_CoVMDCSh" VALUE 0xCA15C Kw_Wu8 20.00 OneToOne 0.00 20.00 FORMAT "%5.2" EXTENDED_LIMITS 0.00 255.0 /end CHARACTERISTIC
/begin CHARACTERISTIC DSM_ClaDfp_ConvCD_C "Fehlerklasse fuer Fehlerpfad Dfp_ConvCD" VALUE 0xCA15D Kw_Wu8 20.00 OneToOne 0.00 20.00 FORMAT "%5.2" EXTENDED_LIMITS 0.00 255.0 /end CHARACTERISTIC
/begin CHARACTERISTIC DSM_ClaDfp_CrCCDMFL_C "Fehlerklasse fuer Fehlerpfad Dfp_CrCCDMFL" VALUE 0xCA15E Kw_Wu8 20.00 OneToOne 0.00 20.00 FORMAT "%5.2" EXTENDED_LIMITS 0.00 255.0 /end CHARACTERISTIC
/begin CHARACTERISTIC DSM_ClaDfp_CrCtl_vCrCtl_C "Fehlerklasse fuer Fehlerpfad Dfp_CrCtl_vCrCtl" VALUE 0xCA15F Kw_Wu8 20.00 OneToOne 0.00 20.00 FORMAT "%5.2" EXTENDED_LIMITS 0.00 255.0 /end CHARACTERISTIC
/begin CHARACTERISTIC DSM_ClaDfp_Dummy1_C "Fehlerklasse fuer Fehlerpfad Dfp_Dummy1" VALUE 0xCA160 Kw_Wu8 20.00 OneToOne 0.00 20.00 FORMAT "%5.2" EXTENDED_LIMITS 0.00 255.0 /end CHARACTERISTIC
/begin CHARACTERISTIC DSM_ClaDfp_EATSCD_C "Fehlerklasse fuer Fehlerpfad Dfp_EATSCD" VALUE 0xCA161 Kw_Wu8 20.00 OneToOne 0.00 20.00 FORMAT "%5.2" EXTENDED_LIMITS 0.00 255.0 /end CHARACTERISTIC
/begin CHARACTERISTIC DSM_ClaDfp_EBAFCD_C "Fehlerklasse fuer Fehlerpfad Dfp_EBAFCD" VALUE 0xCA162 Kw_Wu8 20.00 OneToOne 0.00 20.00 FORMAT "%5.2" EXTENDED_LIMITS 0.00 255.0 /end CHARACTERISTIC
/begin CHARACTERISTIC DSM_ClaDfp_EBFCD_C "Fehlerklasse fuer Fehlerpfad Dfp_EBFCD" VALUE 0xCA163 Kw_Wu8 20.00 OneToOne 0.00 20.00 FORMAT "%5.2" EXTENDED_LIMITS 0.00 255.0 /end CHARACTERISTIC
/begin CHARACTERISTIC DSM_ClaDfp_EBTSCD_C "Fehlerklasse fuer Fehlerpfad Dfp_EBTSCD" VALUE 0xCA164 Kw_Wu8 20.00 OneToOne 0.00 20.00 FORMAT "%5.2" EXTENDED_LIMITS 0.00 255.0 /end CHARACTERISTIC
/begin CHARACTERISTIC DSM_ClaDfp_EBTSCD_OvrTemp_C "Fehlerklasse fuer Fehlerpfad Dfp_EBTSCD_OvrTemp" VALUE 0xCA165 Kw_Wu8 20.00 OneToOne 0.00 20.00 FORMAT "%5.2" EXTENDED_LIMITS 0.00 255.0 /end CHARACTERISTIC
/begin CHARACTERISTIC DSM_ClaDfp_EEPCDVarMng_C "Fehlerklasse fuer Fehlerpfad Dfp_EEPCDVarMng" VALUE 0xCA166 Kw_Wu8 20.00 OneToOne 0.00 20.00 FORMAT "%5.2" EXTENDED_LIMITS 0.00 255.0 /end CHARACTERISTIC
/begin CHARACTERISTIC DSM_ClaDfp_EGPpCD_C "Fehlerklassen fuer Fehlerpfad Dfp_EGPpCD" VALUE 0xCA167 Kw_Wu8 20.00 OneToOne 0.00 20.00 FORMAT "%5.2" EXTENDED_LIMITS 0.00 255.0 /end CHARACTERISTIC
/begin CHARACTERISTIC DSM_ClaDfp_EGPpCDTPreTrbn_C "Fehlerklasse fuer Fehlerpfad Dfp_EgPpCDTPreTrbn" VALUE 0xCA168 Kw_Wu8 20.00 OneToOne 0.00 20.00 FORMAT "%5.2" EXTENDED_LIMITS 0.00 255.0 /end CHARACTERISTIC
/begin CHARACTERISTIC DSM_ClaDfp_Layer_PMRUHVERL_C "" VALUE 0xCA169 Kw_Wu8 20.00 OneToOne 0.00 20.00 FORMAT "%5.2" EXTENDED_LIMITS 0.00 255.0 /end CHARACTERISTIC
/begin CHARACTERISTIC DSM_ClaDfp_EGRCD_Max_C "Fehlerklasse fuer Fehlerpfad Dfp_EGRCD_Max" VALUE 0xCA16A Kw_Wu8 20.00 OneToOne 0.00 20.00 FORMAT "%5.2" EXTENDED_LIMITS 0.00 255.0 /end CHARACTERISTIC
/begin CHARACTERISTIC DSM_ClaDfp_EGRCD_Min_C "Fehlerklasse fuer Fehlerpfad Dfp_EGRCD_Min" VALUE 0xCA16B Kw_Wu8 20.00 OneToOne 0.00 20.00 FORMAT "%5.2" EXTENDED_LIMITS 0.00 255.0 /end CHARACTERISTIC
/begin CHARACTERISTIC DSM_ClaDfp_EGRCD_SigNpl_C "Fehlerklasse fuer Fehlerpfad Dfp_EGRCD_SigNpl" VALUE 0xCA16C Kw_Wu8 20.00 OneToOne 0.00 20.00 FORMAT "%5.2" EXTENDED_LIMITS 0.00 255.0 /end CHARACTERISTIC
/begin CHARACTERISTIC DSM_ClaDfp_EGTRgnOilDil_C "Fehlerklasse fuer Fehlerpfad Dfp_EGTRgnOilDil" VALUE 0xCA16D Kw_Wu8 20.00 OneToOne 0.00 20.00 FORMAT "%5.2" EXTENDED_LIMITS 0.00 255.0 /end CHARACTERISTIC
/begin CHARACTERISTIC DSM_ClaDfp_Layer_TOENS_C "" VALUE 0xCA16E Kw_Wu8 20.00 OneToOne 0.00 20.00 FORMAT "%5.2" EXTENDED_LIMITS 0.00 255.0 /end CHARACTERISTIC
/begin CHARACTERISTIC DSM_ClaDfp_Layer_MANHYDR_C "" VALUE 0xCA16F Kw_Wu8 20.00 OneToOne 0.00 20.00 FORMAT "%5.2" EXTENDED_LIMITS 0.00 255.0 /end CHARACTERISTIC
/begin CHARACTERISTIC DSM_ClaDfp_Layer_MANLUFT_C "" VALUE 0xCA170 Kw_Wu8 20.00 OneToOne 0.00 20.00 FORMAT "%5.2" EXTENDED_LIMITS 0.00 255.0 /end CHARACTERISTIC
/begin CHARACTERISTIC DSM_ClaDfp_ETClbETFltInj1_C "Fehlerklasse fuer Fehlerpfad Dfp_ETClbETFltInj1" VALUE 0xCA171 Kw_Wu8 20.00 OneToOne 0.00 20.00 FORMAT "%5.2" EXTENDED_LIMITS 0.00 255.0 /end CHARACTERISTIC
/begin CHARACTERISTIC DSM_ClaDfp_ETClbETFltInj2_C "Fehlerklasse fuer Fehlerpfad Dfp_ETClbETFltInj2" VALUE 0xCA172 Kw_Wu8 20.00 OneToOne 0.00 20.00 FORMAT "%5.2" EXTENDED_LIMITS 0.00 255.0 /end CHARACTERISTIC
/begin CHARACTERISTIC DSM_ClaDfp_ETClbETFltInj3_C "Fehlerklasse fuer Fehlerpfad Dfp_ETClbETFltInj3" VALUE 0xCA173 Kw_Wu8 20.00 OneToOne 0.00 20.00 FORMAT "%5.2" EXTENDED_LIMITS 0.00 255.0 /end CHARACTERISTIC
/begin CHARACTERISTIC DSM_ClaDfp_ETClbETFltInj4_C "Fehlerklasse fuer Fehlerpfad Dfp_ETClbETFltInj4" VALUE 0xCA174 Kw_Wu8 20.00 OneToOne 0.00 20.00 FORMAT "%5.2" EXTENDED_LIMITS 0.00 255.0 /end CHARACTERISTIC
/begin CHARACTERISTIC DSM_ClaDfp_ETClbETFltInj5_C "Fehlerklasse fuer Fehlerpfad Dfp_ETClbETFltInj5" VALUE 0xCA175 Kw_Wu8 20.00 OneToOne 0.00 20.00 FORMAT "%5.2" EXTENDED_LIMITS 0.00 255.0 /end CHARACTERISTIC
/begin CHARACTERISTIC DSM_ClaDfp_ETClbETFltInj6_C "Fehlerklasse fuer Fehlerpfad Dfp_ETClbETFltInj6" VALUE 0xCA176 Kw_Wu8 20.00 OneToOne 0.00 20.00 FORMAT "%5.2" EXTENDED_LIMITS 0.00 255.0 /end CHARACTERISTIC
/begin CHARACTERISTIC DSM_ClaDfp_ETClbInj1_C "Fehlerklasse fuer Fehlerpfad Dfp_ETClbInj1" VALUE 0xCA177 Kw_Wu8 20.00 OneToOne 0.00 20.00 FORMAT "%5.2" EXTENDED_LIMITS 0.00 255.0 /end CHARACTERISTIC
/begin CHARACTERISTIC DSM_ClaDfp_ETClbInj2_C "Fehlerklasse fuer Fehlerpfad Dfp_ETClbInj2" VALUE 0xCA178 Kw_Wu8 20.00 OneToOne 0.00 20.00 FORMAT "%5.2" EXTENDED_LIMITS 0.00 255.0 /end CHARACTERISTIC
/begin CHARACTERISTIC DSM_ClaDfp_ETClbInj3_C "Fehlerklasse fuer Fehlerpfad Dfp_ETClbInj3" VALUE 0xCA179 Kw_Wu8 20.00 OneToOne 0.00 20.00 FORMAT "%5.2" EXTENDED_LIMITS 0.00 255.0 /end CHARACTERISTIC
/begin CHARACTERISTIC DSM_ClaDfp_ETClbInj4_C "Fehlerklasse fuer Fehlerpfad Dfp_ETClbInj4" VALUE 0xCA17A Kw_Wu8 20.00 OneToOne 0.00 20.00 FORMAT "%5.2" EXTENDED_LIMITS 0.00 255.0 /end CHARACTERISTIC
/begin CHARACTERISTIC DSM_ClaDfp_ETClbInj5_C "Fehlerklasse fuer Fehlerpfad Dfp_ETClbInj5" VALUE 0xCA17B Kw_Wu8 20.00 OneToOne 0.00 20.00 FORMAT "%5.2" EXTENDED_LIMITS 0.00 255.0 /end CHARACTERISTIC
/begin CHARACTERISTIC DSM_ClaDfp_ETClbInj6_C "Fehlerklasse fuer Fehlerpfad Dfp_ETClbInj6" VALUE 0xCA17C Kw_Wu8 20.00 OneToOne 0.00 20.00 FORMAT "%5.2" EXTENDED_LIMITS 0.00 255.0 /end CHARACTERISTIC
/begin CHARACTERISTIC DSM_ClaDfp_EngMCaS1_C "Fehlerklasse fuer Fehlerpfad Dfp_EngMCaS1" VALUE 0xCA17D Kw_Wu8 20.00 OneToOne 0.00 20.00 FORMAT "%5.2" EXTENDED_LIMITS 0.00 255.0 /end CHARACTERISTIC
/begin CHARACTERISTIC DSM_ClaDfp_EngMCrS1_C "Fehlerklasse fuer Fehlerpfad Dfp_EngMCrS1" VALUE 0xCA17E Kw_Wu8 20.00 OneToOne 0.00 20.00 FORMAT "%5.2" EXTENDED_LIMITS 0.00 255.0 /end CHARACTERISTIC
/begin CHARACTERISTIC DSM_ClaDfp_EngMOfsCaSCrS_C "Fehlerklasse fuer Fehlerpfad Dfp_EngMOfsCaSCrS" VALUE 0xCA17F Kw_Wu8 20.00 OneToOne 0.00 20.00 FORMAT "%5.2" EXTENDED_LIMITS 0.00 255.0 /end CHARACTERISTIC
/begin CHARACTERISTIC DSM_ClaDfp_EngMntCtl1_Dia1_C "" VALUE 0xCA180 Kw_Wu8 20.00 OneToOne 0.00 20.00 FORMAT "%5.2" EXTENDED_LIMITS 0.00 255.0 /end CHARACTERISTIC
/begin CHARACTERISTIC DSM_ClaDfp_EngMntCtl1_Dia2_C "" VALUE 0xCA181 Kw_Wu8 20.00 OneToOne 0.00 20.00 FORMAT "%5.2" EXTENDED_LIMITS 0.00 255.0 /end CHARACTERISTIC
/begin CHARACTERISTIC DSM_ClaDfp_EngMntCtl1_Dia3_C "" VALUE 0xCA182 Kw_Wu8 20.00 OneToOne 0.00 20.00 FORMAT "%5.2" EXTENDED_LIMITS 0.00 255.0 /end CHARACTERISTIC
/begin CHARACTERISTIC DSM_ClaDfp_EngMntCtl1_Max_C "" VALUE 0xCA183 Kw_Wu8 20.00 OneToOne 0.00 20.00 FORMAT "%5.2" EXTENDED_LIMITS 0.00 255.0 /end CHARACTERISTIC
/begin CHARACTERISTIC DSM_ClaDfp_EngMntCtl1_Min_C "" VALUE 0xCA184 Kw_Wu8 20.00 OneToOne 0.00 20.00 FORMAT "%5.2" EXTENDED_LIMITS 0.00 255.0 /end CHARACTERISTIC
/begin CHARACTERISTIC DSM_ClaDfp_EngMntCtl1_SigNpl_C "" VALUE 0xCA185 Kw_Wu8 20.00 OneToOne 0.00 20.00 FORMAT "%5.2" EXTENDED_LIMITS 0.00 255.0 /end CHARACTERISTIC
/begin CHARACTERISTIC DSM_ClaDfp_EngMntCtlCD_C "Fehlerklasse fuer Fehlerpfad Dfp_EngMntCtlCD" VALUE 0xCA186 Kw_Wu8 20.00 OneToOne 0.00 20.00 FORMAT "%5.2" EXTENDED_LIMITS 0.00 255.0 /end CHARACTERISTIC
/begin CHARACTERISTIC DSM_ClaDfp_EngMntCtl_Dia1_C "" VALUE 0xCA187 Kw_Wu8 20.00 OneToOne 0.00 20.00 FORMAT "%5.2" EXTENDED_LIMITS 0.00 255.0 /end CHARACTERISTIC
/begin CHARACTERISTIC DSM_ClaDfp_EngMntCtl_Dia2_C "" VALUE 0xCA188 Kw_Wu8 20.00 OneToOne 0.00 20.00 FORMAT "%5.2" EXTENDED_LIMITS 0.00 255.0 /end CHARACTERISTIC
/begin CHARACTERISTIC DSM_ClaDfp_EngMntCtl_Dia3_C "" VALUE 0xCA189 Kw_Wu8 20.00 OneToOne 0.00 20.00 FORMAT "%5.2" EXTENDED_LIMITS 0.00 255.0 /end CHARACTERISTIC
/begin CHARACTERISTIC DSM_ClaDfp_EngMntCtl_Max_C "" VALUE 0xCA18A Kw_Wu8 20.00 OneToOne 0.00 20.00 FORMAT "%5.2" EXTENDED_LIMITS 0.00 255.0 /end CHARACTERISTIC
/begin CHARACTERISTIC DSM_ClaDfp_EngMntCtl_Min_C "" VALUE 0xCA18B Kw_Wu8 20.00 OneToOne 0.00 20.00 FORMAT "%5.2" EXTENDED_LIMITS 0.00 255.0 /end CHARACTERISTIC
/begin CHARACTERISTIC DSM_ClaDfp_EngMntCtl_SigNpl_C "" VALUE 0xCA18C Kw_Wu8 20.00 OneToOne 0.00 20.00 FORMAT "%5.2" EXTENDED_LIMITS 0.00 255.0 /end CHARACTERISTIC
/begin CHARACTERISTIC DSM_ClaDfp_EngPrtFWODet_C "Fehlerklasse fuer Fehlerpfad Dfp_EngPrtFWODet" VALUE 0xCA18D Kw_Wu8 20.00 OneToOne 0.00 20.00 FORMAT "%5.2" EXTENDED_LIMITS 0.00 255.0 /end CHARACTERISTIC
/begin CHARACTERISTIC DSM_ClaDfp_FBCqDvt_C "Fehlerklasse fuer Fehlerpfad Dfp_FBCqDvt" VALUE 0xCA18E Kw_Wu8 20.00 OneToOne 0.00 20.00 FORMAT "%5.2" EXTENDED_LIMITS 0.00 255.0 /end CHARACTERISTIC
/begin CHARACTERISTIC DSM_ClaDfp_FMTC_NonMonotonMap_C "Fehlerklasse fuer Fehlerpfad Dfp_FMTC_NonMonotonMap" VALUE 0xCA18F Kw_Wu8 20.00 OneToOne 0.00 20.00 FORMAT "%5.2" EXTENDED_LIMITS 0.00 255.0 /end CHARACTERISTIC
/begin CHARACTERISTIC DSM_ClaDfp_FTSCD_C "Fehlerklasse fuer Fehlerpfad Dfp_FTSCD" VALUE 0xCA190 Kw_Wu8 20.00 OneToOne 0.00 20.00 FORMAT "%5.2" EXTENDED_LIMITS 0.00 255.0 /end CHARACTERISTIC
/begin CHARACTERISTIC DSM_ClaDfp_FanCD_C "Fehlerklasse fuer Fehlerpfad Dfp_FanCD" VALUE 0xCA191 Kw_Wu8 20.00 OneToOne 0.00 20.00 FORMAT "%5.2" EXTENDED_LIMITS 0.00 255.0 /end CHARACTERISTIC
/begin CHARACTERISTIC DSM_ClaDfp_FanCD_FanCtlr1_C "Fehlerklasse fuer Fehlerpfad Dfp_FanCD_FanCtlr1" VALUE 0xCA192 Kw_Wu8 20.00 OneToOne 0.00 20.00 FORMAT "%5.2" EXTENDED_LIMITS 0.00 255.0 /end CHARACTERISTIC
/begin CHARACTERISTIC DSM_ClaDfp_FanCD_FanCtlr2_C "Fehlerklasse fuer Fehlerpfad Dfp_FanCD_FanCtlr2" VALUE 0xCA193 Kw_Wu8 20.00 OneToOne 0.00 20.00 FORMAT "%5.2" EXTENDED_LIMITS 0.00 255.0 /end CHARACTERISTIC
/begin CHARACTERISTIC DSM_ClaDfp_FanCD_FanCtlr3_C "Fehlerklasse fuer Fehlerpfad Dfp_FanCD_FanCtlr3" VALUE 0xCA194 Kw_Wu8 20.00 OneToOne 0.00 20.00 FORMAT "%5.2" EXTENDED_LIMITS 0.00 255.0 /end CHARACTERISTIC
/begin CHARACTERISTIC DSM_ClaDfp_FlFCD_C "Fehlerklasse fuer Fehlerpfad Dfp_FlFCD" VALUE 0xCA195 Kw_Wu8 20.00 OneToOne 0.00 20.00 FORMAT "%5.2" EXTENDED_LIMITS 0.00 255.0 /end CHARACTERISTIC
/begin CHARACTERISTIC DSM_ClaDfp_FlMngSmkDefect_C "Fehlerklasse fuer Fehlerpfad Dfp_FlMngSmkDefect" VALUE 0xCA196 Kw_Wu8 20.00 OneToOne 0.00 20.00 FORMAT "%5.2" EXTENDED_LIMITS 0.00 255.0 /end CHARACTERISTIC
/begin CHARACTERISTIC DSM_ClaDfp_FrmMngBOS_RESET_C "Fehlerklasse fuer Fehlerpfad Dfp_FrmMngBOS_RESET" VALUE 0xCA197 Kw_Wu8 20.00 OneToOne 0.00 20.00 FORMAT "%5.2" EXTENDED_LIMITS 0.00 255.0 /end CHARACTERISTIC
/begin CHARACTERISTIC DSM_ClaDfp_FrmMngBOS_RESET_2_C "" VALUE 0xCA198 Kw_Wu8 20.00 OneToOne 0.00 20.00 FORMAT "%5.2" EXTENDED_LIMITS 0.00 255.0 /end CHARACTERISTIC
/begin CHARACTERISTIC DSM_ClaDfp_FrmMngDMANFAFS_C "Fehlerklasse fuer Fehlerpfad Dfp_FrmMngDMANFAFS" VALUE 0xCA199 Kw_Wu8 20.00 OneToOne 0.00 20.00 FORMAT "%5.2" EXTENDED_LIMITS 0.00 255.0 /end CHARACTERISTIC
/begin CHARACTERISTIC DSM_ClaDfp_FrmMngDRMANFSSG_C "Fehlerklasse fuer Fehlerpfad Dfp_FrmMngDRMANFSSG" VALUE 0xCA19A Kw_Wu8 20.00 OneToOne 0.00 20.00 FORMAT "%5.2" EXTENDED_LIMITS 0.00 255.0 /end CHARACTERISTIC
/begin CHARACTERISTIC DSM_ClaDfp_FrmMngGEARBX_DATA_C "class for path" VALUE 0xCA19B Kw_Wu8 20.00 OneToOne 0.00 20.00 FORMAT "%5.2" EXTENDED_LIMITS 0.00 255.0 /end CHARACTERISTIC
/begin CHARACTERISTIC DSM_ClaDfp_FrmMngGEARBX_DATA2_C "Fehlerklasse fuer Fehlerpfad Dfp_FrmMngGEARBX_DATA2" VALUE 0xCA19C Kw_Wu8 20.00 OneToOne 0.00 20.00 FORMAT "%5.2" EXTENDED_LIMITS 0.00 255.0 /end CHARACTERISTIC
/begin CHARACTERISTIC DSM_ClaDfp_FrmMngHEAT_AC_C "class for path" VALUE 0xCA19D Kw_Wu8 20.00 OneToOne 0.00 20.00 FORMAT "%5.2" EXTENDED_LIMITS 0.00 255.0 /end CHARACTERISTIC
/begin CHARACTERISTIC DSM_ClaDfp_FrmMngLENKRADWINKEL_C "Fehlerklasse fuer Fehlerpfad Dfp_FrmMngLENKRADWINKEL" VALUE 0xCA19E Kw_Wu8 20.00 OneToOne 0.00 20.00 FORMAT "%5.2" EXTENDED_LIMITS 0.00 255.0 /end CHARACTERISTIC
/begin CHARACTERISTIC DSM_ClaDfp_FrmMngMILEAGE_RANGE_C "Fehlerklasse fuer Fehlerpfad Dfp_FrmMngMILEAGE_RANGE" VALUE 0xCA19F Kw_Wu8 20.00 OneToOne 0.00 20.00 FORMAT "%5.2" EXTENDED_LIMITS 0.00 255.0 /end CHARACTERISTIC
/begin CHARACTERISTIC DSM_ClaDfp_FrmMngOPCRCTLACC_C "Fehlerklasse fuer Fehlerpfad Dfp_FrmMngOPCRCTLACC" VALUE 0xCA1A0 Kw_Wu8 20.00 OneToOne 0.00 20.00 FORMAT "%5.2" EXTENDED_LIMITS 0.00 255.0 /end CHARACTERISTIC
/begin CHARACTERISTIC DSM_ClaDfp_FrmMngPRGG_CCTR_C "Fehlerklasse fuer Fehlerpfad Dfp_FrmMngPRGG_CCTR" VALUE 0xCA1A1 Kw_Wu8 20.00 OneToOne 0.00 20.00 FORMAT "%5.2" EXTENDED_LIMITS 0.00 255.0 /end CHARACTERISTIC
/begin CHARACTERISTIC DSM_ClaDfp_FrmMngPWRMNG_LOADV_C "Fehlerklasse fuer Fehlerpfad Dfp_FrmMngPWRMNG_LOADV" VALUE 0xCA1A2 Kw_Wu8 20.00 OneToOne 0.00 20.00 FORMAT "%5.2" EXTENDED_LIMITS 0.00 255.0 /end CHARACTERISTIC
/begin CHARACTERISTIC DSM_ClaDfp_FrmMngParkConsumer_C "Fehlerklasse fuer Fehlerpfad Dfp_FrmMngParkConsumer" VALUE 0xCA1A3 Kw_Wu8 20.00 OneToOne 0.00 20.00 FORMAT "%5.2" EXTENDED_LIMITS 0.00 255.0 /end CHARACTERISTIC
/begin CHARACTERISTIC DSM_ClaDfp_FrmMngRQSTGEFAN_C "RQ_STG_EFAN - CAN-message related errors" VALUE 0xCA1A4 Kw_Wu8 20.00 OneToOne 0.00 20.00 FORMAT "%5.2" EXTENDED_LIMITS 0.00 255.0 /end CHARACTERISTIC
/begin CHARACTERISTIC DSM_ClaDfp_FrmMngSSGErr_C "Fehlerklasse fuer Fehlerpfad Dfp_FrmMngSSGErr" VALUE 0xCA1A5 Kw_Wu8 20.00 OneToOne 0.00 20.00 FORMAT "%5.2" EXTENDED_LIMITS 0.00 255.0 /end CHARACTERISTIC
/begin CHARACTERISTIC DSM_ClaDfp_FrmMngSSGShOff_C "Fehlerklasse fuer Fehlerpfad Dfp_FrmMngSSGShOff" VALUE 0xCA1A6 Kw_Wu8 20.00 OneToOne 0.00 20.00 FORMAT "%5.2" EXTENDED_LIMITS 0.00 255.0 /end CHARACTERISTIC
/begin CHARACTERISTIC DSM_ClaDfp_FrmMngSTAT_ANH_C "Fehlerklasse fuer Fehlerpfad Dfp_FrmMngSTAT_ANH" VALUE 0xCA1A7 Kw_Wu8 20.00 OneToOne 0.00 20.00 FORMAT "%5.2" EXTENDED_LIMITS 0.00 255.0 /end CHARACTERISTIC
/begin CHARACTERISTIC DSM_ClaDfp_FrmMngSTAT_ARS_C "class for path" VALUE 0xCA1A8 Kw_Wu8 20.00 OneToOne 0.00 20.00 FORMAT "%5.2" EXTENDED_LIMITS 0.00 255.0 /end CHARACTERISTIC
/begin CHARACTERISTIC DSM_ClaDfp_FrmMngSTAT_DSC_C "class for path" VALUE 0xCA1A9 Kw_Wu8 20.00 OneToOne 0.00 20.00 FORMAT "%5.2" EXTENDED_LIMITS 0.00 255.0 /end CHARACTERISTIC
/begin CHARACTERISTIC DSM_ClaDfp_FrmMngSTAT_EKP_C "Fehlerklasse fuer Fehlerpfad Dfp_FrmMngSTAT_EKP" VALUE 0xCA1AA Kw_Wu8 20.00 OneToOne 0.00 20.00 FORMAT "%5.2" EXTENDED_LIMITS 0.00 255.0 /end CHARACTERISTIC
/begin CHARACTERISTIC DSM_ClaDfp_FrmMngSTAT_KOMBI_C "Fehlerklasse fuer Fehlerpfad Dfp_FrmMngSTAT_KOMBI" VALUE 0xCA1AB Kw_Wu8 20.00 OneToOne 0.00 20.00 FORMAT "%5.2" EXTENDED_LIMITS 0.00 255.0 /end CHARACTERISTIC
/begin CHARACTERISTIC DSM_ClaDfp_FrmMngSTAT_SITZ_C "Fehlerklasse fuer Fehlerpfad Dfp_FrmMngSTAT_SITZ" VALUE 0xCA1AC Kw_Wu8 20.00 OneToOne 0.00 20.00 FORMAT "%5.2" EXTENDED_LIMITS 0.00 255.0 /end CHARACTERISTIC
/begin CHARACTERISTIC DSM_ClaDfp_FrmMngStOBDGbxMilOf_C "Fehlerklasse fuer Fehlerpfad Dfp_FrmMngStOBDGbxMilOf" VALUE 0xCA1AD Kw_Wu8 20.00 OneToOne 0.00 20.00 FORMAT "%5.2" EXTENDED_LIMITS 0.00 255.0 /end CHARACTERISTIC
/begin CHARACTERISTIC DSM_ClaDfp_FrmMngStOBDGbxMilOn_C "Fehlerklasse fuer Fehlerpfad Dfp_FrmMngStOBDGbxMilOn" VALUE 0xCA1AE Kw_Wu8 20.00 OneToOne 0.00 20.00 FORMAT "%5.2" EXTENDED_LIMITS 0.00 255.0 /end CHARACTERISTIC
/begin CHARACTERISTIC DSM_ClaDfp_FrmMngTEMPRELTIME_C "Fehlerklasse fuer Fehlerpfad Dfp_FrmMngTEMPRELTIME" VALUE 0xCA1AF Kw_Wu8 20.00 OneToOne 0.00 20.00 FORMAT "%5.2" EXTENDED_LIMITS 0.00 255.0 /end CHARACTERISTIC
/begin CHARACTERISTIC DSM_ClaDfp_FrmMngTERMINAL_C "class for path" VALUE 0xCA1B0 Kw_Wu8 20.00 OneToOne 0.00 20.00 FORMAT "%5.2" EXTENDED_LIMITS 0.00 255.0 /end CHARACTERISTIC
/begin CHARACTERISTIC DSM_ClaDfp_FrmMngTIME_DATE_C "Fehlerklasse fuer Fehlerpfad Dfp_FrmMngTIME_DATE" VALUE 0xCA1B1 Kw_Wu8 20.00 OneToOne 0.00 20.00 FORMAT "%5.2" EXTENDED_LIMITS 0.00 255.0 /end CHARACTERISTIC
/begin CHARACTERISTIC DSM_ClaDfp_FrmMngTORQUE_DSC_C "class for path" VALUE 0xCA1B2 Kw_Wu8 20.00 OneToOne 0.00 20.00 FORMAT "%5.2" EXTENDED_LIMITS 0.00 255.0 /end CHARACTERISTIC
/begin CHARACTERISTIC DSM_ClaDfp_FrmMngTORQUE_GEARBX_C "class for path" VALUE 0xCA1B3 Kw_Wu8 20.00 OneToOne 0.00 20.00 FORMAT "%5.2" EXTENDED_LIMITS 0.00 255.0 /end CHARACTERISTIC
/begin CHARACTERISTIC DSM_ClaDfp_FrmMngTrq_ReqACC_C "Fehlerklasse fuer Fehlerpfad Dfp_FrmMngTrq_ReqACC" VALUE 0xCA1B4 Kw_Wu8 20.00 OneToOne 0.00 20.00 FORMAT "%5.2" EXTENDED_LIMITS 0.00 255.0 /end CHARACTERISTIC
/begin CHARACTERISTIC DSM_ClaDfp_FrmMngVEH_MOD_C "VEH_MOD - CAN-message related errors" VALUE 0xCA1B5 Kw_Wu8 20.00 OneToOne 0.00 20.00 FORMAT "%5.2" EXTENDED_LIMITS 0.00 255.0 /end CHARACTERISTIC
/begin CHARACTERISTIC DSM_ClaDfp_FrmMngVELOCITY_C "class for path" VALUE 0xCA1B6 Kw_Wu8 20.00 OneToOne 0.00 20.00 FORMAT "%5.2" EXTENDED_LIMITS 0.00 255.0 /end CHARACTERISTIC
/begin CHARACTERISTIC DSM_ClaDfp_FrmMngWHEEL_SPEED_C "Fehlerklasse fuer Fehlerpfad Dfp_FrmMngWHEEL_SPEED" VALUE 0xCA1B7 Kw_Wu8 20.00 OneToOne 0.00 20.00 FORMAT "%5.2" EXTENDED_LIMITS 0.00 255.0 /end CHARACTERISTIC
/begin CHARACTERISTIC DSM_ClaDfp_FrmMngstCurr_C "Fehlerklasse für Dfp_FrmMngstCurr" VALUE 0xCA1B8 Kw_Wu8 20.00 OneToOne 0.00 20.00 FORMAT "%5.2" EXTENDED_LIMITS 0.00 255.0 /end CHARACTERISTIC
/begin CHARACTERISTIC DSM_ClaDfp_FrmMngswtPSPOff_C "Fehlerklasse für Dfp_FrmMngswtPSPOff" VALUE 0xCA1B9 Kw_Wu8 20.00 OneToOne 0.00 20.00 FORMAT "%5.2" EXTENDED_LIMITS 0.00 255.0 /end CHARACTERISTIC
/begin CHARACTERISTIC DSM_ClaDfp_GearbxIncMax_C "Fehlerklasse fuer Fehlerpfad Dfp_GearbxIncMax" VALUE 0xCA1BA Kw_Wu8 20.00 OneToOne 0.00 20.00 FORMAT "%5.2" EXTENDED_LIMITS 0.00 255.0 /end CHARACTERISTIC
/begin CHARACTERISTIC DSM_ClaDfp_GlwCD_C "Fehlerklasse fuer Fehlerpfad Dfp_GlwCD" VALUE 0xCA1BB Kw_Wu8 20.00 OneToOne 0.00 20.00 FORMAT "%5.2" EXTENDED_LIMITS 0.00 255.0 /end CHARACTERISTIC
/begin CHARACTERISTIC DSM_ClaDfp_GlwCDGlwCirc1_C "Fehlerklasse fuer Fehlerpfad Dfp_GlwCDGlwCirc1" VALUE 0xCA1BC Kw_Wu8 20.00 OneToOne 0.00 20.00 FORMAT "%5.2" EXTENDED_LIMITS 0.00 255.0 /end CHARACTERISTIC
/begin CHARACTERISTIC DSM_ClaDfp_GlwCDGlwCirc2_C "Fehlerklasse fuer Fehlerpfad Dfp_GlwCDGlwCirc2" VALUE 0xCA1BD Kw_Wu8 20.00 OneToOne 0.00 20.00 FORMAT "%5.2" EXTENDED_LIMITS 0.00 255.0 /end CHARACTERISTIC
/begin CHARACTERISTIC DSM_ClaDfp_GlwCDGlwCirc3_C "Fehlerklasse fuer Fehlerpfad Dfp_GlwCDGlwCirc3" VALUE 0xCA1BE Kw_Wu8 20.00 OneToOne 0.00 20.00 FORMAT "%5.2" EXTENDED_LIMITS 0.00 255.0 /end CHARACTERISTIC
/begin CHARACTERISTIC DSM_ClaDfp_GlwCDGlwCirc4_C "Fehlerklasse fuer Fehlerpfad Dfp_GlwCDGlwCirc4" VALUE 0xCA1BF Kw_Wu8 20.00 OneToOne 0.00 20.00 FORMAT "%5.2" EXTENDED_LIMITS 0.00 255.0 /end CHARACTERISTIC
/begin CHARACTERISTIC DSM_ClaDfp_GlwCDGlwCirc5_C "Fehlerklasse fuer Fehlerpfad Dfp_GlwCDGlwCirc5" VALUE 0xCA1C0 Kw_Wu8 20.00 OneToOne 0.00 20.00 FORMAT "%5.2" EXTENDED_LIMITS 0.00 255.0 /end CHARACTERISTIC
/begin CHARACTERISTIC DSM_ClaDfp_GlwCDGlwCirc6_C "Fehlerklasse fuer Fehlerpfad Dfp_GlwCDGlwCirc6" VALUE 0xCA1C1 Kw_Wu8 20.00 OneToOne 0.00 20.00 FORMAT "%5.2" EXTENDED_LIMITS 0.00 255.0 /end CHARACTERISTIC
/begin CHARACTERISTIC DSM_ClaDfp_GlwCDGlwCirc7_C "Fehlerklasse fuer Fehlerpfad Dfp_GlwCDGlwCirc7" VALUE 0xCA1C2 Kw_Wu8 20.00 OneToOne 0.00 20.00 FORMAT "%5.2" EXTENDED_LIMITS 0.00 255.0 /end CHARACTERISTIC
/begin CHARACTERISTIC DSM_ClaDfp_GlwCDGlwCirc8_C "Fehlerklasse fuer Fehlerpfad Dfp_GlwCDGlwCirc8" VALUE 0xCA1C3 Kw_Wu8 20.00 OneToOne 0.00 20.00 FORMAT "%5.2" EXTENDED_LIMITS 0.00 255.0 /end CHARACTERISTIC
/begin CHARACTERISTIC DSM_ClaDfp_GlwCtl_C "Fehlerklasse fuer Fehlerpfad Dfp_GlwCtl" VALUE 0xCA1C4 Kw_Wu8 20.00 OneToOne 0.00 20.00 FORMAT "%5.2" EXTENDED_LIMITS 0.00 255.0 /end CHARACTERISTIC
/begin CHARACTERISTIC DSM_ClaDfp_HWEMonCom_C "Fehlerklasse fuer Fehlerpfad Dfp_HWEMonCom" VALUE 0xCA1C5 Kw_Wu8 20.00 OneToOne 0.00 20.00 FORMAT "%5.2" EXTENDED_LIMITS 0.00 255.0 /end CHARACTERISTIC
/begin CHARACTERISTIC DSM_ClaDfp_HWEMonEEPROM_C "Fehlerklasse fuer Fehlerpfad Dfp_HWEMonEEPROM" VALUE 0xCA1C6 Kw_Wu8 20.00 OneToOne 0.00 20.00 FORMAT "%5.2" EXTENDED_LIMITS 0.00 255.0 /end CHARACTERISTIC
/begin CHARACTERISTIC DSM_ClaDfp_HWEMonRcyLocked_C "Fehlerklasse fuer Fehlerpfad Dfp_HWEMonRcyLocked" VALUE 0xCA1C7 Kw_Wu8 20.00 OneToOne 0.00 20.00 FORMAT "%5.2" EXTENDED_LIMITS 0.00 255.0 /end CHARACTERISTIC
/begin CHARACTERISTIC DSM_ClaDfp_HWEMonRcySuppressed_C "Fehlerklasse fuer Fehlerpfad Dfp_HWEMonRcySuppressed" VALUE 0xCA1C8 Kw_Wu8 20.00 OneToOne 0.00 20.00 FORMAT "%5.2" EXTENDED_LIMITS 0.00 255.0 /end CHARACTERISTIC
/begin CHARACTERISTIC DSM_ClaDfp_HWEMonRcyVisible_C "Fehlerklasse fuer Fehlerpfad Dfp_HWEMonRcyVisible" VALUE 0xCA1C9 Kw_Wu8 20.00 OneToOne 0.00 20.00 FORMAT "%5.2" EXTENDED_LIMITS 0.00 255.0 /end CHARACTERISTIC
/begin CHARACTERISTIC DSM_ClaDfp_HWEMonUMaxSupply_C "Fehlerklasse fuer Fehlerpfad Dfp_HWEMonUMaxSupply" VALUE 0xCA1CA Kw_Wu8 20.00 OneToOne 0.00 20.00 FORMAT "%5.2" EXTENDED_LIMITS 0.00 255.0 /end CHARACTERISTIC
/begin CHARACTERISTIC DSM_ClaDfp_HWEMonUMinSupply_C "Fehlerklasse fuer Fehlerpfad Dfp_HWEMonUMinSupply" VALUE 0xCA1CB Kw_Wu8 20.00 OneToOne 0.00 20.00 FORMAT "%5.2" EXTENDED_LIMITS 0.00 255.0 /end CHARACTERISTIC
/begin CHARACTERISTIC DSM_ClaDfp_IATSCD_C "Fehlerklasse fuer Fehlerpfad Dfp_IATSCD" VALUE 0xCA1CC Kw_Wu8 20.00 OneToOne 0.00 20.00 FORMAT "%5.2" EXTENDED_LIMITS 0.00 255.0 /end CHARACTERISTIC
/begin CHARACTERISTIC DSM_ClaDfp_IATSCD_CATS_C "Fehlerklasse fuer Fehlerpfad Dfp_IATSCD_CATS" VALUE 0xCA1CD Kw_Wu8 20.00 OneToOne 0.00 20.00 FORMAT "%5.2" EXTENDED_LIMITS 0.00 255.0 /end CHARACTERISTIC
/begin CHARACTERISTIC DSM_ClaDfp_ImmCtlImmCD_C "Fehlerklasse fuer Fehlerpfad Dfp_ImmCtlImmCD" VALUE 0xCA1CE Kw_Wu8 20.00 OneToOne 0.00 20.00 FORMAT "%5.2" EXTENDED_LIMITS 0.00 255.0 /end CHARACTERISTIC
/begin CHARACTERISTIC DSM_ClaDfp_ImmCtlImmEep_C "Fehlerklasse fuer Fehlerpfad Dfp_ImmCtlImmEep" VALUE 0xCA1CF Kw_Wu8 20.00 OneToOne 0.00 20.00 FORMAT "%5.2" EXTENDED_LIMITS 0.00 255.0 /end CHARACTERISTIC
/begin CHARACTERISTIC DSM_ClaDfp_ImmCtlMpl_C "Fehlerklasse fuer Fehlerpfad Dfp_ImmCtlMpl" VALUE 0xCA1D0 Kw_Wu8 20.00 OneToOne 0.00 20.00 FORMAT "%5.2" EXTENDED_LIMITS 0.00 255.0 /end CHARACTERISTIC
/begin CHARACTERISTIC DSM_ClaDfp_IndSys1_C "Fehlerklasse fuer Fehlerpfad Dfp_IndSys1" VALUE 0xCA1D1 Kw_Wu8 20.00 OneToOne 0.00 20.00 FORMAT "%5.2" EXTENDED_LIMITS 0.00 255.0 /end CHARACTERISTIC
/begin CHARACTERISTIC DSM_ClaDfp_IndSys2_C "Fehlerklasse fuer Fehlerpfad Dfp_IndSys2" VALUE 0xCA1D2 Kw_Wu8 20.00 OneToOne 0.00 20.00 FORMAT "%5.2" EXTENDED_LIMITS 0.00 255.0 /end CHARACTERISTIC
/begin CHARACTERISTIC DSM_ClaDfp_InjCrv_InjLim_C "Fehlerklasse fuer Fehlerpfad Dfp_InjCrv_injLim" VALUE 0xCA1D3 Kw_Wu8 20.00 OneToOne 0.00 20.00 FORMAT "%5.2" EXTENDED_LIMITS 0.00 255.0 /end CHARACTERISTIC
/begin CHARACTERISTIC DSM_ClaDfp_InjCtlAdjQnt_C "Fehlerklasse fuer Fehlerpfad Dfp_InjCtlAdjQnt" VALUE 0xCA1D4 Kw_Wu8 20.00 OneToOne 0.00 20.00 FORMAT "%5.2" EXTENDED_LIMITS 0.00 255.0 /end CHARACTERISTIC
/begin CHARACTERISTIC DSM_ClaDfp_InjCtlDrift_C "Fehlerklasse fuer Fehlerpfad Dfp_InjCtlDrift" VALUE 0xCA1D5 Kw_Wu8 20.00 OneToOne 0.00 20.00 FORMAT "%5.2" EXTENDED_LIMITS 0.00 255.0 /end CHARACTERISTIC
/begin CHARACTERISTIC DSM_ClaDfp_InjVCDActrChrg_C "Fehlerklasse fuer Fehlerpfad Dfp_InjVCDActrChrg" VALUE 0xCA1D6 Kw_Wu8 20.00 OneToOne 0.00 20.00 FORMAT "%5.2" EXTENDED_LIMITS 0.00 255.0 /end CHARACTERISTIC
/begin CHARACTERISTIC DSM_ClaDfp_InjVCDActrEnrg1_C "Fehlerklasse fuer Fehlerpfad Dfp_InjVCDActrEnrg1" VALUE 0xCA1D7 Kw_Wu8 20.00 OneToOne 0.00 20.00 FORMAT "%5.2" EXTENDED_LIMITS 0.00 255.0 /end CHARACTERISTIC
/begin CHARACTERISTIC DSM_ClaDfp_InjVCDActrEnrg2_C "Fehlerklasse fuer Fehlerpfad Dfp_InjVCDActrEnrg2" VALUE 0xCA1D8 Kw_Wu8 20.00 OneToOne 0.00 20.00 FORMAT "%5.2" EXTENDED_LIMITS 0.00 255.0 /end CHARACTERISTIC
/begin CHARACTERISTIC DSM_ClaDfp_InjVCDActrEnrg3_C "Fehlerklasse fuer Fehlerpfad Dfp_InjVCDActrEnrg3" VALUE 0xCA1D9 Kw_Wu8 20.00 OneToOne 0.00 20.00 FORMAT "%5.2" EXTENDED_LIMITS 0.00 255.0 /end CHARACTERISTIC
/begin CHARACTERISTIC DSM_ClaDfp_InjVCDActrEnrg4_C "Fehlerklasse fuer Fehlerpfad Dfp_InjVCDActrEnrg4" VALUE 0xCA1DA Kw_Wu8 20.00 OneToOne 0.00 20.00 FORMAT "%5.2" EXTENDED_LIMITS 0.00 255.0 /end CHARACTERISTIC
/begin CHARACTERISTIC DSM_ClaDfp_InjVCDActrEnrg5_C "Fehlerklasse fuer Fehlerpfad Dfp_InjVCDActrEnrg5" VALUE 0xCA1DB Kw_Wu8 20.00 OneToOne 0.00 20.00 FORMAT "%5.2" EXTENDED_LIMITS 0.00 255.0 /end CHARACTERISTIC
/begin CHARACTERISTIC DSM_ClaDfp_InjVCDActrEnrg6_C "Fehlerklasse fuer Fehlerpfad Dfp_InjVCDActrEnrg6" VALUE 0xCA1DC Kw_Wu8 20.00 OneToOne 0.00 20.00 FORMAT "%5.2" EXTENDED_LIMITS 0.00 255.0 /end CHARACTERISTIC
/begin CHARACTERISTIC DSM_ClaDfp_InjVCDActrEnrg7_C "Fehlerklasse fuer Fehlerpfad Dfp_InjVCDActrEnrg7" VALUE 0xCA1DD Kw_Wu8 20.00 OneToOne 0.00 20.00 FORMAT "%5.2" EXTENDED_LIMITS 0.00 255.0 /end CHARACTERISTIC
/begin CHARACTERISTIC DSM_ClaDfp_InjVCDActrEnrg8_C "Fehlerklasse fuer Fehlerpfad Dfp_InjVCDActrEnrg8" VALUE 0xCA1DE Kw_Wu8 20.00 OneToOne 0.00 20.00 FORMAT "%5.2" EXTENDED_LIMITS 0.00 255.0 /end CHARACTERISTIC
/begin CHARACTERISTIC DSM_ClaDfp_InjVCDActrVolt_C "Fehlerklasse fuer Fehlerpfad Dfp_InjVCDActrVolt" VALUE 0xCA1DF Kw_Wu8 20.00 OneToOne 0.00 20.00 FORMAT "%5.2" EXTENDED_LIMITS 0.00 255.0 /end CHARACTERISTIC
/begin CHARACTERISTIC DSM_ClaDfp_InjVCDClsBank1_C "Fehlerklasse fuer Fehlerpfad Dfp_InjVCDClsBank1" VALUE 0xCA1E0 Kw_Wu8 20.00 OneToOne 0.00 20.00 FORMAT "%5.2" EXTENDED_LIMITS 0.00 255.0 /end CHARACTERISTIC
/begin CHARACTERISTIC DSM_ClaDfp_InjVCDClsBank2_C "Fehlerklasse fuer Fehlerpfad Dfp_InjVCDClsBank2" VALUE 0xCA1E1 Kw_Wu8 20.00 OneToOne 0.00 20.00 FORMAT "%5.2" EXTENDED_LIMITS 0.00 255.0 /end CHARACTERISTIC
/begin CHARACTERISTIC DSM_ClaDfp_InjVCDMonCab_C "Fehlerklasse fuer Fehlerpfad Dfp_InjVCDMonCab" VALUE 0xCA1E2 Kw_Wu8 20.00 OneToOne 0.00 20.00 FORMAT "%5.2" EXTENDED_LIMITS 0.00 255.0 /end CHARACTERISTIC
/begin CHARACTERISTIC DSM_ClaDfp_InjVCDMonSwt_C "Fehlerklasse fuer Fehlerpfad Dfp_InjVCDMonSwt" VALUE 0xCA1E3 Kw_Wu8 20.00 OneToOne 0.00 20.00 FORMAT "%5.2" EXTENDED_LIMITS 0.00 255.0 /end CHARACTERISTIC
/begin CHARACTERISTIC DSM_ClaDfp_InjVCDShOffDCDC_C "Fehlerklasse fuer Fehlerpfad Dfp_InjVCDShOffDCDC" VALUE 0xCA1E4 Kw_Wu8 20.00 OneToOne 0.00 20.00 FORMAT "%5.2" EXTENDED_LIMITS 0.00 255.0 /end CHARACTERISTIC
/begin CHARACTERISTIC DSM_ClaDfp_InjVCDUBuf_C "Fehlerklasse fuer Fehlerpfad Dfp_InjVCDUBuf" VALUE 0xCA1E5 Kw_Wu8 20.00 OneToOne 0.00 20.00 FORMAT "%5.2" EXTENDED_LIMITS 0.00 255.0 /end CHARACTERISTIC
/begin CHARACTERISTIC DSM_ClaDfp_InjVCD_CY370Ampl_C "Fehlerklasse fuer Fehlerpfad Dfp_InjVCD_CY370Ampl" VALUE 0xCA1E6 Kw_Wu8 20.00 OneToOne 0.00 20.00 FORMAT "%5.2" EXTENDED_LIMITS 0.00 255.0 /end CHARACTERISTIC
/begin CHARACTERISTIC DSM_ClaDfp_InjVlvBnk1A_C "Fehlerklasse fuer Fehlerpfad Dfp_InjVlvBnk1A" VALUE 0xCA1E7 Kw_Wu8 20.00 OneToOne 0.00 20.00 FORMAT "%5.2" EXTENDED_LIMITS 0.00 255.0 /end CHARACTERISTIC
/begin CHARACTERISTIC DSM_ClaDfp_InjVlvBnk1B_C "Fehlerklasse fuer Fehlerpfad Dfp_InjVlvBnk1B" VALUE 0xCA1E8 Kw_Wu8 20.00 OneToOne 0.00 20.00 FORMAT "%5.2" EXTENDED_LIMITS 0.00 255.0 /end CHARACTERISTIC
/begin CHARACTERISTIC DSM_ClaDfp_InjVlvBnk2A_C "Fehlerklasse fuer Fehlerpfad Dfp_InjVlvBnk2A" VALUE 0xCA1E9 Kw_Wu8 20.00 OneToOne 0.00 20.00 FORMAT "%5.2" EXTENDED_LIMITS 0.00 255.0 /end CHARACTERISTIC
/begin CHARACTERISTIC DSM_ClaDfp_InjVlvBnk2B_C "Fehlerklasse fuer Fehlerpfad Dfp_InjVlvBnk2B" VALUE 0xCA1EA Kw_Wu8 20.00 OneToOne 0.00 20.00 FORMAT "%5.2" EXTENDED_LIMITS 0.00 255.0 /end CHARACTERISTIC
/begin CHARACTERISTIC DSM_ClaDfp_InjVlvChipA_C "Fehlerklasse fuer Fehlerpfad Dfp_InjVlvChipA" VALUE 0xCA1EB Kw_Wu8 20.00 OneToOne 0.00 20.00 FORMAT "%5.2" EXTENDED_LIMITS 0.00 255.0 /end CHARACTERISTIC
/begin CHARACTERISTIC DSM_ClaDfp_InjVlvChipB_C "Fehlerklasse fuer Fehlerpfad Dfp_InjVlvChipB" VALUE 0xCA1EC Kw_Wu8 20.00 OneToOne 0.00 20.00 FORMAT "%5.2" EXTENDED_LIMITS 0.00 255.0 /end CHARACTERISTIC
/begin CHARACTERISTIC DSM_ClaDfp_InjVlvCyl1A_C "Fehlerklasse fuer Fehlerpfad Dfp_InjVlvCyl1A" VALUE 0xCA1ED Kw_Wu8 20.00 OneToOne 0.00 20.00 FORMAT "%5.2" EXTENDED_LIMITS 0.00 255.0 /end CHARACTERISTIC
/begin CHARACTERISTIC DSM_ClaDfp_InjVlvCyl1B_C "Fehlerklasse fuer Fehlerpfad Dfp_InjVlvCyl1B" VALUE 0xCA1EE Kw_Wu8 20.00 OneToOne 0.00 20.00 FORMAT "%5.2" EXTENDED_LIMITS 0.00 255.0 /end CHARACTERISTIC
/begin CHARACTERISTIC DSM_ClaDfp_InjVlvCyl1C_C "Fehlerklasse fuer Fehlerpfad Dfp_InjVlvCyl1C" VALUE 0xCA1EF Kw_Wu8 20.00 OneToOne 0.00 20.00 FORMAT "%5.2" EXTENDED_LIMITS 0.00 255.0 /end CHARACTERISTIC
/begin CHARACTERISTIC DSM_ClaDfp_InjVlvCyl2A_C "Fehlerklasse fuer Fehlerpfad Dfp_InjVlvCyl2A" VALUE 0xCA1F0 Kw_Wu8 20.00 OneToOne 0.00 20.00 FORMAT "%5.2" EXTENDED_LIMITS 0.00 255.0 /end CHARACTERISTIC
/begin CHARACTERISTIC DSM_ClaDfp_InjVlvCyl2B_C "Fehlerklasse fuer Fehlerpfad Dfp_InjVlvCyl2B" VALUE 0xCA1F1 Kw_Wu8 20.00 OneToOne 0.00 20.00 FORMAT "%5.2" EXTENDED_LIMITS 0.00 255.0 /end CHARACTERISTIC
/begin CHARACTERISTIC DSM_ClaDfp_InjVlvCyl2C_C "Fehlerklasse fuer Fehlerpfad Dfp_InjVlvCyl2C" VALUE 0xCA1F2 Kw_Wu8 20.00 OneToOne 0.00 20.00 FORMAT "%5.2" EXTENDED_LIMITS 0.00 255.0 /end CHARACTERISTIC
/begin CHARACTERISTIC DSM_ClaDfp_InjVlvCyl3A_C "Fehlerklasse fuer Fehlerpfad Dfp_InjVlvCyl3A" VALUE 0xCA1F3 Kw_Wu8 20.00 OneToOne 0.00 20.00 FORMAT "%5.2" EXTENDED_LIMITS 0.00 255.0 /end CHARACTERISTIC
/begin CHARACTERISTIC DSM_ClaDfp_InjVlvCyl3B_C "Fehlerklasse fuer Fehlerpfad Dfp_InjVlvCyl3B" VALUE 0xCA1F4 Kw_Wu8 20.00 OneToOne 0.00 20.00 FORMAT "%5.2" EXTENDED_LIMITS 0.00 255.0 /end CHARACTERISTIC
/begin CHARACTERISTIC DSM_ClaDfp_InjVlvCyl3C_C "Fehlerklasse fuer Fehlerpfad Dfp_InjVlvCyl3C" VALUE 0xCA1F5 Kw_Wu8 20.00 OneToOne 0.00 20.00 FORMAT "%5.2" EXTENDED_LIMITS 0.00 255.0 /end CHARACTERISTIC
/begin CHARACTERISTIC DSM_ClaDfp_InjVlvCyl4A_C "Fehlerklasse fuer Fehlerpfad Dfp_InjVlvCyl4A" VALUE 0xCA1F6 Kw_Wu8 20.00 OneToOne 0.00 20.00 FORMAT "%5.2" EXTENDED_LIMITS 0.00 255.0 /end CHARACTERISTIC
/begin CHARACTERISTIC DSM_ClaDfp_InjVlvCyl4B_C "Fehlerklasse fuer Fehlerpfad Dfp_InjVlvCyl4B" VALUE 0xCA1F7 Kw_Wu8 20.00 OneToOne 0.00 20.00 FORMAT "%5.2" EXTENDED_LIMITS 0.00 255.0 /end CHARACTERISTIC
/begin CHARACTERISTIC DSM_ClaDfp_InjVlvCyl4C_C "Fehlerklasse fuer Fehlerpfad Dfp_InjVlvCyl4C" VALUE 0xCA1F8 Kw_Wu8 20.00 OneToOne 0.00 20.00 FORMAT "%5.2" EXTENDED_LIMITS 0.00 255.0 /end CHARACTERISTIC
/begin CHARACTERISTIC DSM_ClaDfp_InjVlvCyl5A_C "Fehlerklasse fuer Fehlerpfad Dfp_InjVlvCyl5A" VALUE 0xCA1F9 Kw_Wu8 20.00 OneToOne 0.00 20.00 FORMAT "%5.2" EXTENDED_LIMITS 0.00 255.0 /end CHARACTERISTIC
/begin CHARACTERISTIC DSM_ClaDfp_InjVlvCyl5B_C "Fehlerklasse fuer Fehlerpfad Dfp_InjVlvCyl5B" VALUE 0xCA1FA Kw_Wu8 20.00 OneToOne 0.00 20.00 FORMAT "%5.2" EXTENDED_LIMITS 0.00 255.0 /end CHARACTERISTIC
/begin CHARACTERISTIC DSM_ClaDfp_InjVlvCyl5C_C "Fehlerklasse fuer Fehlerpfad Dfp_InjVlvCyl5C" VALUE 0xCA1FB Kw_Wu8 20.00 OneToOne 0.00 20.00 FORMAT "%5.2" EXTENDED_LIMITS 0.00 255.0 /end CHARACTERISTIC
/begin CHARACTERISTIC DSM_ClaDfp_InjVlvCyl6A_C "Fehlerklasse fuer Fehlerpfad Dfp_InjVlvCyl6A" VALUE 0xCA1FC Kw_Wu8 20.00 OneToOne 0.00 20.00 FORMAT "%5.2" EXTENDED_LIMITS 0.00 255.0 /end CHARACTERISTIC
/begin CHARACTERISTIC DSM_ClaDfp_InjVlvCyl6B_C "Fehlerklasse fuer Fehlerpfad Dfp_InjVlvCyl6B" VALUE 0xCA1FD Kw_Wu8 20.00 OneToOne 0.00 20.00 FORMAT "%5.2" EXTENDED_LIMITS 0.00 255.0 /end CHARACTERISTIC
/begin CHARACTERISTIC DSM_ClaDfp_InjVlvCyl6C_C "Fehlerklasse fuer Fehlerpfad Dfp_InjVlvCyl6C" VALUE 0xCA1FE Kw_Wu8 20.00 OneToOne 0.00 20.00 FORMAT "%5.2" EXTENDED_LIMITS 0.00 255.0 /end CHARACTERISTIC
/begin CHARACTERISTIC DSM_ClaDfp_InjVlvCyl7A_C "Fehlerklasse fuer Fehlerpfad Dfp_InjVlvCyl7A" VALUE 0xCA1FF Kw_Wu8 20.00 OneToOne 0.00 20.00 FORMAT "%5.2" EXTENDED_LIMITS 0.00 255.0 /end CHARACTERISTIC
/begin CHARACTERISTIC DSM_ClaDfp_InjVlvCyl7B_C "Fehlerklasse fuer Fehlerpfad Dfp_InjVlvCyl7B" VALUE 0xCA200 Kw_Wu8 20.00 OneToOne 0.00 20.00 FORMAT "%5.2" EXTENDED_LIMITS 0.00 255.0 /end CHARACTERISTIC
/begin CHARACTERISTIC DSM_ClaDfp_InjVlvCyl7C_C "Fehlerklasse fuer Fehlerpfad Dfp_InjVlvCyl7C" VALUE 0xCA201 Kw_Wu8 20.00 OneToOne 0.00 20.00 FORMAT "%5.2" EXTENDED_LIMITS 0.00 255.0 /end CHARACTERISTIC
/begin CHARACTERISTIC DSM_ClaDfp_InjVlvCyl8A_C "Fehlerklasse fuer Fehlerpfad Dfp_InjVlvCyl8A" VALUE 0xCA202 Kw_Wu8 20.00 OneToOne 0.00 20.00 FORMAT "%5.2" EXTENDED_LIMITS 0.00 255.0 /end CHARACTERISTIC
/begin CHARACTERISTIC DSM_ClaDfp_InjVlvCyl8B_C "Fehlerklasse fuer Fehlerpfad Dfp_InjVlvCyl8B" VALUE 0xCA203 Kw_Wu8 20.00 OneToOne 0.00 20.00 FORMAT "%5.2" EXTENDED_LIMITS 0.00 255.0 /end CHARACTERISTIC
/begin CHARACTERISTIC DSM_ClaDfp_InjVlvCyl8C_C "Fehlerklasse fuer Fehlerpfad Dfp_InjVlvCyl8C" VALUE 0xCA204 Kw_Wu8 20.00 OneToOne 0.00 20.00 FORMAT "%5.2" EXTENDED_LIMITS 0.00 255.0 /end CHARACTERISTIC
/begin CHARACTERISTIC DSM_ClaDfp_InjVlvNVC1_C "Fehlerklasse fuer Fehlerpfad Dfp_InjVlvNVC1" VALUE 0xCA205 Kw_Wu8 20.00 OneToOne 0.00 20.00 FORMAT "%5.2" EXTENDED_LIMITS 0.00 255.0 /end CHARACTERISTIC
/begin CHARACTERISTIC DSM_ClaDfp_InjVlvNVC2_C "Fehlerklasse fuer Fehlerpfad Dfp_InjVlvNVC2" VALUE 0xCA206 Kw_Wu8 20.00 OneToOne 0.00 20.00 FORMAT "%5.2" EXTENDED_LIMITS 0.00 255.0 /end CHARACTERISTIC
/begin CHARACTERISTIC DSM_ClaDfp_InjVlvNVC3_C "Fehlerklasse fuer Fehlerpfad Dfp_InjVlvNVC3" VALUE 0xCA207 Kw_Wu8 20.00 OneToOne 0.00 20.00 FORMAT "%5.2" EXTENDED_LIMITS 0.00 255.0 /end CHARACTERISTIC
/begin CHARACTERISTIC DSM_ClaDfp_InjVlvNVC4_C "Fehlerklasse fuer Fehlerpfad Dfp_InjVlvNVC4" VALUE 0xCA208 Kw_Wu8 20.00 OneToOne 0.00 20.00 FORMAT "%5.2" EXTENDED_LIMITS 0.00 255.0 /end CHARACTERISTIC
/begin CHARACTERISTIC DSM_ClaDfp_InjVlvNVC5_C "Fehlerklasse fuer Fehlerpfad Dfp_InjVlvNVC5" VALUE 0xCA209 Kw_Wu8 20.00 OneToOne 0.00 20.00 FORMAT "%5.2" EXTENDED_LIMITS 0.00 255.0 /end CHARACTERISTIC
/begin CHARACTERISTIC DSM_ClaDfp_InjVlvNVC6_C "Fehlerklasse fuer Fehlerpfad Dfp_InjVlvNVC6" VALUE 0xCA20A Kw_Wu8 20.00 OneToOne 0.00 20.00 FORMAT "%5.2" EXTENDED_LIMITS 0.00 255.0 /end CHARACTERISTIC
/begin CHARACTERISTIC DSM_ClaDfp_InjVlvNVC7_C "Fehlerklasse fuer Fehlerpfad Dfp_InjVlvNVC7" VALUE 0xCA20B Kw_Wu8 20.00 OneToOne 0.00 20.00 FORMAT "%5.2" EXTENDED_LIMITS 0.00 255.0 /end CHARACTERISTIC
/begin CHARACTERISTIC DSM_ClaDfp_InjVlvNVC8_C "Fehlerklasse fuer Fehlerpfad Dfp_InjVlvNVC8" VALUE 0xCA20C Kw_Wu8 20.00 OneToOne 0.00 20.00 FORMAT "%5.2" EXTENDED_LIMITS 0.00 255.0 /end CHARACTERISTIC
/begin CHARACTERISTIC DSM_ClaDfp_LPACD_Max_C "Fehlerklasse fuer Fehlerpfad Dfp_LPACD_Max" VALUE 0xCA20D Kw_Wu8 20.00 OneToOne 0.00 20.00 FORMAT "%5.2" EXTENDED_LIMITS 0.00 255.0 /end CHARACTERISTIC
/begin CHARACTERISTIC DSM_ClaDfp_LPACD_Min_C "Fehlerklasse fuer Fehlerpfad Dfp_LPACD_Min" VALUE 0xCA20E Kw_Wu8 20.00 OneToOne 0.00 20.00 FORMAT "%5.2" EXTENDED_LIMITS 0.00 255.0 /end CHARACTERISTIC
/begin CHARACTERISTIC DSM_ClaDfp_LPACD_SigNpl_C "Fehlerklasse fuer Fehlerpfad Dfp_LPACD_SigNpl" VALUE 0xCA20F Kw_Wu8 20.00 OneToOne 0.00 20.00 FORMAT "%5.2" EXTENDED_LIMITS 0.00 255.0 /end CHARACTERISTIC
/begin CHARACTERISTIC DSM_ClaDfp_LSUCDCircNernst0_C "Fehlerklasse fuer Fehlerpfad Dfp_LSUCDCircNernst0" VALUE 0xCA210 Kw_Wu8 20.00 OneToOne 0.00 20.00 FORMAT "%5.2" EXTENDED_LIMITS 0.00 255.0 /end CHARACTERISTIC
/begin CHARACTERISTIC DSM_ClaDfp_LSUCDCircPumpCur0_C "Fehlerklasse fuer Fehlerpfad Dfp_LSUCDCircPumpCur0" VALUE 0xCA211 Kw_Wu8 20.00 OneToOne 0.00 20.00 FORMAT "%5.2" EXTENDED_LIMITS 0.00 255.0 /end CHARACTERISTIC
/begin CHARACTERISTIC DSM_ClaDfp_LSUCDCircVirtGnd0_C "Fehlerklasse fuer Fehlerpfad Dfp_LSUCDCircVirtGnd0" VALUE 0xCA212 Kw_Wu8 20.00 OneToOne 0.00 20.00 FORMAT "%5.2" EXTENDED_LIMITS 0.00 255.0 /end CHARACTERISTIC
/begin CHARACTERISTIC DSM_ClaDfp_LSUCDHeater0_C "Fehlerklasse fuer Fehlerpfad Dfp_LSUCDHeater0" VALUE 0xCA213 Kw_Wu8 20.00 OneToOne 0.00 20.00 FORMAT "%5.2" EXTENDED_LIMITS 0.00 255.0 /end CHARACTERISTIC
/begin CHARACTERISTIC DSM_ClaDfp_LSUCDHtCoup0_C "Fehlerklasse fuer Fehlerpfad Dfp_LSUCDHtCoup0" VALUE 0xCA214 Kw_Wu8 20.00 OneToOne 0.00 20.00 FORMAT "%5.2" EXTENDED_LIMITS 0.00 255.0 /end CHARACTERISTIC
/begin CHARACTERISTIC DSM_ClaDfp_LSUCDO20_C "Fehlerklasse fuer Fehlerpfad Dfp_LSUCDO20" VALUE 0xCA215 Kw_Wu8 20.00 OneToOne 0.00 20.00 FORMAT "%5.2" EXTENDED_LIMITS 0.00 255.0 /end CHARACTERISTIC
/begin CHARACTERISTIC DSM_ClaDfp_LSUCDO2Clb0_C "Fehlerklasse fuer Fehlerpfad Dfp_LSUCDO2Clb0" VALUE 0xCA216 Kw_Wu8 20.00 OneToOne 0.00 20.00 FORMAT "%5.2" EXTENDED_LIMITS 0.00 255.0 /end CHARACTERISTIC
/begin CHARACTERISTIC DSM_ClaDfp_LSUCDRiClb0_C "Fehlerklasse fuer Fehlerpfad Dfp_LSUCDRiClb0" VALUE 0xCA217 Kw_Wu8 20.00 OneToOne 0.00 20.00 FORMAT "%5.2" EXTENDED_LIMITS 0.00 255.0 /end CHARACTERISTIC
/begin CHARACTERISTIC DSM_ClaDfp_LSUCDSPI0_C "Fehlerklasse fuer Fehlerpfad Dfp_LSUCDSPI0" VALUE 0xCA218 Kw_Wu8 20.00 OneToOne 0.00 20.00 FORMAT "%5.2" EXTENDED_LIMITS 0.00 255.0 /end CHARACTERISTIC
/begin CHARACTERISTIC DSM_ClaDfp_LSUCDSPIBattLow0_C "Fehlerklasse fuer Fehlerpfad Dfp_LSUCDSPIBattLow0" VALUE 0xCA219 Kw_Wu8 20.00 OneToOne 0.00 20.00 FORMAT "%5.2" EXTENDED_LIMITS 0.00 255.0 /end CHARACTERISTIC
/begin CHARACTERISTIC DSM_ClaDfp_LSUCDWireIP0_C "Fehlerklasse fuer Fehlerpfad Dfp_LSUCDWireIP0" VALUE 0xCA21A Kw_Wu8 20.00 OneToOne 0.00 20.00 FORMAT "%5.2" EXTENDED_LIMITS 0.00 255.0 /end CHARACTERISTIC
/begin CHARACTERISTIC DSM_ClaDfp_LSUCtlRiExc0_C "Fehlerklasse fuer Fehlerpfad Dfp_LSUCtlRiExc0" VALUE 0xCA21B Kw_Wu8 20.00 OneToOne 0.00 20.00 FORMAT "%5.2" EXTENDED_LIMITS 0.00 255.0 /end CHARACTERISTIC
/begin CHARACTERISTIC DSM_ClaDfp_LSUMon1Sens_C "Fehlerklasse fuer Fehlerpfad Dfp_LSUMon1Sens" VALUE 0xCA21C Kw_Wu8 20.00 OneToOne 0.00 20.00 FORMAT "%5.2" EXTENDED_LIMITS 0.00 255.0 /end CHARACTERISTIC
/begin CHARACTERISTIC DSM_ClaDfp_LSUMon2Sens_C "Fehlerklasse fuer Fehlerpfad Dfp_LSUMon2Sens" VALUE 0xCA21D Kw_Wu8 20.00 OneToOne 0.00 20.00 FORMAT "%5.2" EXTENDED_LIMITS 0.00 255.0 /end CHARACTERISTIC
/begin CHARACTERISTIC DSM_ClaDfp_LubCD_C "Fehlerklasse fuer Fehlerpfad Dfp_LubCD" VALUE 0xCA21E Kw_Wu8 20.00 OneToOne 0.00 20.00 FORMAT "%5.2" EXTENDED_LIMITS 0.00 255.0 /end CHARACTERISTIC
/begin CHARACTERISTIC DSM_ClaDfp_MIL_C "Fehlerklasse fuer Fehlerpfad Dfp_MIL" VALUE 0xCA21F Kw_Wu8 20.00 OneToOne 0.00 20.00 FORMAT "%5.2" EXTENDED_LIMITS 0.00 255.0 /end CHARACTERISTIC
/begin CHARACTERISTIC DSM_ClaDfp_MRlyCD_C "Fehlerklasse fuer Fehlerpfad Dfp_MRlyCD" VALUE 0xCA220 Kw_Wu8 20.00 OneToOne 0.00 20.00 FORMAT "%5.2" EXTENDED_LIMITS 0.00 255.0 /end CHARACTERISTIC
/begin CHARACTERISTIC DSM_ClaDfp_MSidCD_Comm_C "Fehlerklasse fuer Fehlerpfad Dfp_MSidCD_Comm" VALUE 0xCA221 Kw_Wu8 20.00 OneToOne 0.00 20.00 FORMAT "%5.2" EXTENDED_LIMITS 0.00 255.0 /end CHARACTERISTIC
/begin CHARACTERISTIC DSM_ClaDfp_MSidCD_Pin_C "Fehlerklasse fuer Fehlerpfad Dfp_MSidCD_Pin" VALUE 0xCA222 Kw_Wu8 20.00 OneToOne 0.00 20.00 FORMAT "%5.2" EXTENDED_LIMITS 0.00 255.0 /end CHARACTERISTIC
/begin CHARACTERISTIC DSM_ClaDfp_MSidCD_Sel_INI_C "Fehlerklasse fuer Fehlerpfad Dfp_MSidCD_Sel_INI" VALUE 0xCA223 Kw_Wu8 20.00 OneToOne 0.00 20.00 FORMAT "%5.2" EXTENDED_LIMITS 0.00 255.0 /end CHARACTERISTIC
/begin CHARACTERISTIC DSM_ClaDfp_MSidCD_Select_C "Fehlerklasse fuer Fehlerpfad Dfp_MSidCD_Select" VALUE 0xCA224 Kw_Wu8 20.00 OneToOne 0.00 20.00 FORMAT "%5.2" EXTENDED_LIMITS 0.00 255.0 /end CHARACTERISTIC
/begin CHARACTERISTIC DSM_ClaDfp_MeUnCDNoLoad_C "Fehlerklasse fuer Fehlerpfad Dfp_MeUnCDNoLoad" VALUE 0xCA225 Kw_Wu8 20.00 OneToOne 0.00 20.00 FORMAT "%5.2" EXTENDED_LIMITS 0.00 255.0 /end CHARACTERISTIC
/begin CHARACTERISTIC DSM_ClaDfp_MeUnCDSCBat_C "Fehlerklasse fuer Fehlerpfad Dfp_MeUnCDSCBat" VALUE 0xCA226 Kw_Wu8 20.00 OneToOne 0.00 20.00 FORMAT "%5.2" EXTENDED_LIMITS 0.00 255.0 /end CHARACTERISTIC
/begin CHARACTERISTIC DSM_ClaDfp_MeUnCDSCGnd_C "Fehlerklasse fuer Fehlerpfad Dfp_MeUnCDSCGnd" VALUE 0xCA227 Kw_Wu8 20.00 OneToOne 0.00 20.00 FORMAT "%5.2" EXTENDED_LIMITS 0.00 255.0 /end CHARACTERISTIC
/begin CHARACTERISTIC DSM_ClaDfp_MeUnCD_ADC_C "Fehlerklasse fuer Fehlerpfad Dfp_MeUnCD_ADC" VALUE 0xCA228 Kw_Wu8 20.00 OneToOne 0.00 20.00 FORMAT "%5.2" EXTENDED_LIMITS 0.00 255.0 /end CHARACTERISTIC
/begin CHARACTERISTIC DSM_ClaDfp_MeUnCD_SigTst_C "Fehlerklasse fuer Fehlerpfad Dfp_MeUnCD_SigTst" VALUE 0xCA229 Kw_Wu8 20.00 OneToOne 0.00 20.00 FORMAT "%5.2" EXTENDED_LIMITS 0.00 255.0 /end CHARACTERISTIC
/begin CHARACTERISTIC DSM_ClaDfp_Montr_C "Fehlerklasse fuer Fehlerpfad Dfp_Montr" VALUE 0xCA22A Kw_Wu8 20.00 OneToOne 0.00 20.00 FORMAT "%5.2" EXTENDED_LIMITS 0.00 255.0 /end CHARACTERISTIC
/begin CHARACTERISTIC DSM_ClaDfp_NetMngDeviceA_C "Fehlerklasse fuer Fehlerpfad Dfp_NetMngDeviceA" VALUE 0xCA22B Kw_Wu8 20.00 OneToOne 0.00 20.00 FORMAT "%5.2" EXTENDED_LIMITS 0.00 255.0 /end CHARACTERISTIC
/begin CHARACTERISTIC DSM_ClaDfp_NetMngDeviceB_C "Fehlerklasse fuer Fehlerpfad Dfp_NetMngDeviceB" VALUE 0xCA22C Kw_Wu8 20.00 OneToOne 0.00 20.00 FORMAT "%5.2" EXTENDED_LIMITS 0.00 255.0 /end CHARACTERISTIC
/begin CHARACTERISTIC DSM_ClaDfp_NetMngDeviceC_C "Fehlerklasse fuer Fehlerpfad Dfp_NetMngDeviceC" VALUE 0xCA22D Kw_Wu8 20.00 OneToOne 0.00 20.00 FORMAT "%5.2" EXTENDED_LIMITS 0.00 255.0 /end CHARACTERISTIC
/begin CHARACTERISTIC DSM_ClaDfp_OPSCD_Lamp_C "Fehlerklasse fuer Fehlerpfad Dfp_OPSCD_Lamp" VALUE 0xCA22E Kw_Wu8 20.00 OneToOne 0.00 20.00 FORMAT "%5.2" EXTENDED_LIMITS 0.00 255.0 /end CHARACTERISTIC
/begin CHARACTERISTIC DSM_ClaDfp_OPSCD_anain_C "Fehlerklasse fuer Fehlerpfad Dfp_OPSCD_anain" VALUE 0xCA22F Kw_Wu8 20.00 OneToOne 0.00 20.00 FORMAT "%5.2" EXTENDED_LIMITS 0.00 255.0 /end CHARACTERISTIC
/begin CHARACTERISTIC DSM_ClaDfp_OTSCD_C "Fehlerklasse fuer Fehlerpfad Dfp_OTSCD" VALUE 0xCA230 Kw_Wu8 20.00 OneToOne 0.00 20.00 FORMAT "%5.2" EXTENDED_LIMITS 0.00 255.0 /end CHARACTERISTIC
/begin CHARACTERISTIC DSM_ClaDfp_OvRMon_C "Fehlerklasse fuer Fehlerpfad Dfp_OvRMon" VALUE 0xCA231 Kw_Wu8 20.00 OneToOne 0.00 20.00 FORMAT "%5.2" EXTENDED_LIMITS 0.00 255.0 /end CHARACTERISTIC
/begin CHARACTERISTIC DSM_ClaDfp_OvRMonBrk_C "Fehlerklasse fuer Fehlerpfad Dfp_OvRMonBrk" VALUE 0xCA232 Kw_Wu8 20.00 OneToOne 0.00 20.00 FORMAT "%5.2" EXTENDED_LIMITS 0.00 255.0 /end CHARACTERISTIC
/begin CHARACTERISTIC DSM_ClaDfp_OvRMonSigA_C "Fehlerklasse fuer Fehlerpfad Dfp_OvRMonSigA" VALUE 0xCA233 Kw_Wu8 20.00 OneToOne 0.00 20.00 FORMAT "%5.2" EXTENDED_LIMITS 0.00 255.0 /end CHARACTERISTIC
/begin CHARACTERISTIC DSM_ClaDfp_OxiCCDTPre_C "Fehlerklasse fuer Fehlerpfad Dfp_OxiCCDTPre" VALUE 0xCA234 Kw_Wu8 20.00 OneToOne 0.00 20.00 FORMAT "%5.2" EXTENDED_LIMITS 0.00 255.0 /end CHARACTERISTIC
/begin CHARACTERISTIC DSM_ClaDfp_PCR_GovDevNeg_C "Fehlerklasse fuer Fehlerpfad Dfp_PCR_GovDevNeg" VALUE 0xCA235 Kw_Wu8 20.00 OneToOne 0.00 20.00 FORMAT "%5.2" EXTENDED_LIMITS 0.00 255.0 /end CHARACTERISTIC
/begin CHARACTERISTIC DSM_ClaDfp_PCR_GovDevPos_C "Fehlerklasse fuer Fehlerpfad Dfp_PCR_GovDevPos" VALUE 0xCA236 Kw_Wu8 20.00 OneToOne 0.00 20.00 FORMAT "%5.2" EXTENDED_LIMITS 0.00 255.0 /end CHARACTERISTIC
/begin CHARACTERISTIC DSM_ClaDfp_PCVCDNoLoad_C "Fehlerklasse fuer Fehlerpfad Dfp_PCVCDNoLoad" VALUE 0xCA237 Kw_Wu8 20.00 OneToOne 0.00 20.00 FORMAT "%5.2" EXTENDED_LIMITS 0.00 255.0 /end CHARACTERISTIC
/begin CHARACTERISTIC DSM_ClaDfp_PCVCDSCBat_C "Fehlerklasse fuer Fehlerpfad Dfp_PCVCDSCBat" VALUE 0xCA238 Kw_Wu8 20.00 OneToOne 0.00 20.00 FORMAT "%5.2" EXTENDED_LIMITS 0.00 255.0 /end CHARACTERISTIC
/begin CHARACTERISTIC DSM_ClaDfp_PCVCDSCGnd_C "Fehlerklasse fuer Fehlerpfad Dfp_PCVCDSCGnd" VALUE 0xCA239 Kw_Wu8 20.00 OneToOne 0.00 20.00 FORMAT "%5.2" EXTENDED_LIMITS 0.00 255.0 /end CHARACTERISTIC
/begin CHARACTERISTIC DSM_ClaDfp_PCVCD_ADC_C "Fehlerklasse fuer Fehlerpfad Dfp_PCVCD_ADC" VALUE 0xCA23A Kw_Wu8 20.00 OneToOne 0.00 20.00 FORMAT "%5.2" EXTENDED_LIMITS 0.00 255.0 /end CHARACTERISTIC
/begin CHARACTERISTIC DSM_ClaDfp_PCVCD_SigTst_C "Fehlerklasse fuer Fehlerpfad Dfp_PCVCD_SigTst" VALUE 0xCA23B Kw_Wu8 20.00 OneToOne 0.00 20.00 FORMAT "%5.2" EXTENDED_LIMITS 0.00 255.0 /end CHARACTERISTIC
/begin CHARACTERISTIC DSM_ClaDfp_PFltAPSens_C "Fehlerklasse fuer Fehlerpfad Dfp_PFltAPSens" VALUE 0xCA23C Kw_Wu8 20.00 OneToOne 0.00 20.00 FORMAT "%5.2" EXTENDED_LIMITS 0.00 255.0 /end CHARACTERISTIC
/begin CHARACTERISTIC DSM_ClaDfp_PFltCDPPre_C "Fehlerklasse fuer Fehlerpfad Dfp_PFltCDPPre" VALUE 0xCA23D Kw_Wu8 20.00 OneToOne 0.00 20.00 FORMAT "%5.2" EXTENDED_LIMITS 0.00 255.0 /end CHARACTERISTIC
/begin CHARACTERISTIC DSM_ClaDfp_PFltCDTempPre_C "Fehlerklasse fuer Fehlerpfad Dfp_PFltCDTempPre" VALUE 0xCA23E Kw_Wu8 20.00 OneToOne 0.00 20.00 FORMAT "%5.2" EXTENDED_LIMITS 0.00 255.0 /end CHARACTERISTIC
/begin CHARACTERISTIC DSM_ClaDfp_PFltChar_C "Fehlerklasse fuer Fehlerpfad Dfp_PFltChar" VALUE 0xCA23F Kw_Wu8 20.00 OneToOne 0.00 20.00 FORMAT "%5.2" EXTENDED_LIMITS 0.00 255.0 /end CHARACTERISTIC
/begin CHARACTERISTIC DSM_ClaDfp_PFltEngPrt_C "Fehlerklasse fuer Fehlerpfad Dfp_PFltEngPrt" VALUE 0xCA240 Kw_Wu8 20.00 OneToOne 0.00 20.00 FORMAT "%5.2" EXTENDED_LIMITS 0.00 255.0 /end CHARACTERISTIC
/begin CHARACTERISTIC DSM_ClaDfp_PFltPresDynPlaus_C "Fehlerklasse fuer Fehlerpfad Dfp_PFltPresDynPlaus" VALUE 0xCA241 Kw_Wu8 20.00 OneToOne 0.00 20.00 FORMAT "%5.2" EXTENDED_LIMITS 0.00 255.0 /end CHARACTERISTIC
/begin CHARACTERISTIC DSM_ClaDfp_PFltPresSens_C "Fehlerklasse fuer Fehlerpfad Dfp_PFltPresSens" VALUE 0xCA242 Kw_Wu8 20.00 OneToOne 0.00 20.00 FORMAT "%5.2" EXTENDED_LIMITS 0.00 255.0 /end CHARACTERISTIC
/begin CHARACTERISTIC DSM_ClaDfp_PFltPresSensFrz_C "Fehlerklasse fuer Fehlerpfad Dfp_PFltPresSensFrz" VALUE 0xCA243 Kw_Wu8 20.00 OneToOne 0.00 20.00 FORMAT "%5.2" EXTENDED_LIMITS 0.00 255.0 /end CHARACTERISTIC
/begin CHARACTERISTIC DSM_ClaDfp_PFltPresSensHsLn_C "Fehlerklasse fuer Fehlerpfad Dfp_PFltPresSensHsLn" VALUE 0xCA244 Kw_Wu8 20.00 OneToOne 0.00 20.00 FORMAT "%5.2" EXTENDED_LIMITS 0.00 255.0 /end CHARACTERISTIC
/begin CHARACTERISTIC DSM_ClaDfp_PFltPresSensSot_C "Fehlerklasse fuer Fehlerpfad Dfp_PFltPresSensSot" VALUE 0xCA245 Kw_Wu8 20.00 OneToOne 0.00 20.00 FORMAT "%5.2" EXTENDED_LIMITS 0.00 255.0 /end CHARACTERISTIC
/begin CHARACTERISTIC DSM_ClaDfp_PFltRgnPerm_C "Fehlerklasse fuer Fehlerpfad Dfp_PFltRgnPerm" VALUE 0xCA246 Kw_Wu8 20.00 OneToOne 0.00 20.00 FORMAT "%5.2" EXTENDED_LIMITS 0.00 255.0 /end CHARACTERISTIC
/begin CHARACTERISTIC DSM_ClaDfp_PFltTempDwnStrm_C "Fehlerklasse fuer Fehlerpfad Dfp_PFltTempDwnStrm" VALUE 0xCA247 Kw_Wu8 20.00 OneToOne 0.00 20.00 FORMAT "%5.2" EXTENDED_LIMITS 0.00 255.0 /end CHARACTERISTIC
/begin CHARACTERISTIC DSM_ClaDfp_PFltTempSens_C "Fehlerklasse fuer Fehlerpfad Dfp_PFltTempSens" VALUE 0xCA248 Kw_Wu8 20.00 OneToOne 0.00 20.00 FORMAT "%5.2" EXTENDED_LIMITS 0.00 255.0 /end CHARACTERISTIC
/begin CHARACTERISTIC DSM_ClaDfp_PFltTempUpStrm_C "Fehlerklasse fuer Fehlerpfad Dfp_PFltTempUpStrm" VALUE 0xCA249 Kw_Wu8 20.00 OneToOne 0.00 20.00 FORMAT "%5.2" EXTENDED_LIMITS 0.00 255.0 /end CHARACTERISTIC
/begin CHARACTERISTIC DSM_ClaDfp_PFltmSotDiffMax_C "Fehlerklasse fuer Fehlerpfad Dfp_PFltmSotDiffMax" VALUE 0xCA24A Kw_Wu8 20.00 OneToOne 0.00 20.00 FORMAT "%5.2" EXTENDED_LIMITS 0.00 255.0 /end CHARACTERISTIC
/begin CHARACTERISTIC DSM_ClaDfp_QLTCD_C "Fehlerklasse fuer Fehlerpfad Dfp_QLTCD" VALUE 0xCA24B Kw_Wu8 20.00 OneToOne 0.00 20.00 FORMAT "%5.2" EXTENDED_LIMITS 0.00 255.0 /end CHARACTERISTIC
/begin CHARACTERISTIC DSM_ClaDfp_RTMMon_C "Fehlerklasse fuer Fehlerpfad Dfp_RTMMon" VALUE 0xCA24C Kw_Wu8 20.00 OneToOne 0.00 20.00 FORMAT "%5.2" EXTENDED_LIMITS 0.00 255.0 /end CHARACTERISTIC
/begin CHARACTERISTIC DSM_ClaDfp_RailCD_C "Fehlerklasse fuer Fehlerpfad Dfp_RailCD" VALUE 0xCA24D Kw_Wu8 20.00 OneToOne 0.00 20.00 FORMAT "%5.2" EXTENDED_LIMITS 0.00 255.0 /end CHARACTERISTIC
/begin CHARACTERISTIC DSM_ClaDfp_RailCDOfsTst_C "Fehlerklasse fuer Fehlerpfad Dfp_RailCDOfsTst" VALUE 0xCA24E Kw_Wu8 20.00 OneToOne 0.00 20.00 FORMAT "%5.2" EXTENDED_LIMITS 0.00 255.0 /end CHARACTERISTIC
/begin CHARACTERISTIC DSM_ClaDfp_RailCD_PMonStrt_C "Fehlerklasse fuer Fehlerpfad Dfp_RailCD_PMonStrt" VALUE 0xCA24F Kw_Wu8 20.00 OneToOne 0.00 20.00 FORMAT "%5.2" EXTENDED_LIMITS 0.00 255.0 /end CHARACTERISTIC
/begin CHARACTERISTIC DSM_ClaDfp_RailCtlModeMeUnDiag_C "Fehlerklasse fuer Fehlerpfad Dfp_RailCtlModeMeUnDiag" VALUE 0xCA250 Kw_Wu8 20.00 OneToOne 0.00 20.00 FORMAT "%5.2" EXTENDED_LIMITS 0.00 255.0 /end CHARACTERISTIC
/begin CHARACTERISTIC DSM_ClaDfp_RailCtlModePCVDiag_C "Fehlerklasse fuer Fehlerpfad Dfp_RailCtlModePCVDiag" VALUE 0xCA251 Kw_Wu8 20.00 OneToOne 0.00 20.00 FORMAT "%5.2" EXTENDED_LIMITS 0.00 255.0 /end CHARACTERISTIC
/begin CHARACTERISTIC DSM_ClaDfp_RailMeUn0_C "Fehlerklasse fuer Fehlerpfad Dfp_RailMeUn0" VALUE 0xCA252 Kw_Wu8 20.00 OneToOne 0.00 20.00 FORMAT "%5.2" EXTENDED_LIMITS 0.00 255.0 /end CHARACTERISTIC
/begin CHARACTERISTIC DSM_ClaDfp_RailMeUn1_C "Fehlerklasse fuer Fehlerpfad Dfp_RailMeUn1" VALUE 0xCA253 Kw_Wu8 20.00 OneToOne 0.00 20.00 FORMAT "%5.2" EXTENDED_LIMITS 0.00 255.0 /end CHARACTERISTIC
/begin CHARACTERISTIC DSM_ClaDfp_RailMeUn2_C "Fehlerklasse fuer Fehlerpfad Dfp_RailMeUn2" VALUE 0xCA254 Kw_Wu8 20.00 OneToOne 0.00 20.00 FORMAT "%5.2" EXTENDED_LIMITS 0.00 255.0 /end CHARACTERISTIC
/begin CHARACTERISTIC DSM_ClaDfp_RailMeUn3_C "Fehlerklasse fuer Fehlerpfad Dfp_RailMeUn3" VALUE 0xCA255 Kw_Wu8 20.00 OneToOne 0.00 20.00 FORMAT "%5.2" EXTENDED_LIMITS 0.00 255.0 /end CHARACTERISTIC
/begin CHARACTERISTIC DSM_ClaDfp_RailMeUn4_C "Fehlerklasse fuer Fehlerpfad Dfp_RailMeUn4" VALUE 0xCA256 Kw_Wu8 20.00 OneToOne 0.00 20.00 FORMAT "%5.2" EXTENDED_LIMITS 0.00 255.0 /end CHARACTERISTIC
/begin CHARACTERISTIC DSM_ClaDfp_RailPCV0_C "Fehlerklasse fuer Fehlerpfad Dfp_RailPCV0" VALUE 0xCA257 Kw_Wu8 20.00 OneToOne 0.00 20.00 FORMAT "%5.2" EXTENDED_LIMITS 0.00 255.0 /end CHARACTERISTIC
/begin CHARACTERISTIC DSM_ClaDfp_RailPCV1_C "Fehlerklasse fuer Fehlerpfad Dfp_RailPCV1" VALUE 0xCA258 Kw_Wu8 20.00 OneToOne 0.00 20.00 FORMAT "%5.2" EXTENDED_LIMITS 0.00 255.0 /end CHARACTERISTIC
/begin CHARACTERISTIC DSM_ClaDfp_RailPCV2_C "Fehlerklasse fuer Fehlerpfad Dfp_RailPCV2" VALUE 0xCA259 Kw_Wu8 20.00 OneToOne 0.00 20.00 FORMAT "%5.2" EXTENDED_LIMITS 0.00 255.0 /end CHARACTERISTIC
/begin CHARACTERISTIC DSM_ClaDfp_RailPCV3_C "Fehlerklasse fuer Fehlerpfad Dfp_RailPCV3" VALUE 0xCA25A Kw_Wu8 20.00 OneToOne 0.00 20.00 FORMAT "%5.2" EXTENDED_LIMITS 0.00 255.0 /end CHARACTERISTIC
/begin CHARACTERISTIC DSM_ClaDfp_RailPCV4_C "Fehlerklasse fuer Fehlerpfad Dfp_RailPCV4" VALUE 0xCA25B Kw_Wu8 20.00 OneToOne 0.00 20.00 FORMAT "%5.2" EXTENDED_LIMITS 0.00 255.0 /end CHARACTERISTIC
/begin CHARACTERISTIC DSM_ClaDfp_RailPCV5_C "Fehlerklasse fuer Fehlerpfad Dfp_RailPCV5" VALUE 0xCA25C Kw_Wu8 20.00 OneToOne 0.00 20.00 FORMAT "%5.2" EXTENDED_LIMITS 0.00 255.0 /end CHARACTERISTIC
/begin CHARACTERISTIC DSM_ClaDfp_SOPTst_C "Fehlerklasse fuer Fehlerpfad Dfp_SOPTst" VALUE 0xCA25D Kw_Wu8 20.00 OneToOne 0.00 20.00 FORMAT "%5.2" EXTENDED_LIMITS 0.00 255.0 /end CHARACTERISTIC
/begin CHARACTERISTIC DSM_ClaDfp_SSpMon1_C "Fehlerklasse fuer Fehlerpfad Dfp_SSpMon1" VALUE 0xCA25E Kw_Wu8 20.00 OneToOne 0.00 20.00 FORMAT "%5.2" EXTENDED_LIMITS 0.00 255.0 /end CHARACTERISTIC
/begin CHARACTERISTIC DSM_ClaDfp_SSpMon2_C "Fehlerklasse fuer Fehlerpfad Dfp_SSpMon2" VALUE 0xCA25F Kw_Wu8 20.00 OneToOne 0.00 20.00 FORMAT "%5.2" EXTENDED_LIMITS 0.00 255.0 /end CHARACTERISTIC
/begin CHARACTERISTIC DSM_ClaDfp_SSpMon3_C "Fehlerklasse fuer Fehlerpfad Dfp_SSpMon3" VALUE 0xCA260 Kw_Wu8 20.00 OneToOne 0.00 20.00 FORMAT "%5.2" EXTENDED_LIMITS 0.00 255.0 /end CHARACTERISTIC
/begin CHARACTERISTIC DSM_ClaDfp_ShutCD_C "Fehlerklasse fuer Fehlerpfad Dfp_ShutCD" VALUE 0xCA261 Kw_Wu8 20.00 OneToOne 0.00 20.00 FORMAT "%5.2" EXTENDED_LIMITS 0.00 255.0 /end CHARACTERISTIC
/begin CHARACTERISTIC DSM_ClaDfp_StSysTrqShutOff_C "Fehlerklasse fuer Fehlerpfad Dfp_StSysTrqShutOff" VALUE 0xCA262 Kw_Wu8 20.00 OneToOne 0.00 20.00 FORMAT "%5.2" EXTENDED_LIMITS 0.00 255.0 /end CHARACTERISTIC
/begin CHARACTERISTIC DSM_ClaDfp_StrtCD_Actr_C "Fehlerklasse fuer Fehlerpfad Dfp_StrtCD_Actr" VALUE 0xCA263 Kw_Wu8 20.00 OneToOne 0.00 20.00 FORMAT "%5.2" EXTENDED_LIMITS 0.00 255.0 /end CHARACTERISTIC
/begin CHARACTERISTIC DSM_ClaDfp_SysLamp_C "Fehlerklasse fuer Fehlerpfad Dfp_SysLamp" VALUE 0xCA264 Kw_Wu8 20.00 OneToOne 0.00 20.00 FORMAT "%5.2" EXTENDED_LIMITS 0.00 255.0 /end CHARACTERISTIC
/begin CHARACTERISTIC DSM_ClaDfp_T15CD_C "Fehlerklasse fuer Fehlerpfad Dfp_T15CD" VALUE 0xCA265 Kw_Wu8 20.00 OneToOne 0.00 20.00 FORMAT "%5.2" EXTENDED_LIMITS 0.00 255.0 /end CHARACTERISTIC
/begin CHARACTERISTIC DSM_ClaDfp_TGearbx_C "Fehlerklasse fuer Fehlerpfad Dfp_TGearbx" VALUE 0xCA266 Kw_Wu8 20.00 OneToOne 0.00 20.00 FORMAT "%5.2" EXTENDED_LIMITS 0.00 255.0 /end CHARACTERISTIC
/begin CHARACTERISTIC DSM_ClaDfp_TPUMon_C "Fehlerklasse fuer Fehlerpfad Dfp_TPUMon" VALUE 0xCA267 Kw_Wu8 20.00 OneToOne 0.00 20.00 FORMAT "%5.2" EXTENDED_LIMITS 0.00 255.0 /end CHARACTERISTIC
/begin CHARACTERISTIC DSM_ClaDfp_TVACD_Max_C "Fehlerklasse fuer Fehlerpfad Dfp_TVACD_Max" VALUE 0xCA268 Kw_Wu8 20.00 OneToOne 0.00 20.00 FORMAT "%5.2" EXTENDED_LIMITS 0.00 255.0 /end CHARACTERISTIC
/begin CHARACTERISTIC DSM_ClaDfp_TVACD_Min_C "Fehlerklasse fuer Fehlerpfad Dfp_TVACD_Min" VALUE 0xCA269 Kw_Wu8 20.00 OneToOne 0.00 20.00 FORMAT "%5.2" EXTENDED_LIMITS 0.00 255.0 /end CHARACTERISTIC
/begin CHARACTERISTIC DSM_ClaDfp_TVACD_SigNpl_C "Fehlerklasse fuer Fehlerpfad Dfp_TVACD_SigNpl" VALUE 0xCA26A Kw_Wu8 20.00 OneToOne 0.00 20.00 FORMAT "%5.2" EXTENDED_LIMITS 0.00 255.0 /end CHARACTERISTIC
/begin CHARACTERISTIC DSM_ClaDfp_TVACD_TVADia1_C "Fehlerklasse fuer Fehlerpfad Dfp_TVACD_TVADia1" VALUE 0xCA26B Kw_Wu8 20.00 OneToOne 0.00 20.00 FORMAT "%5.2" EXTENDED_LIMITS 0.00 255.0 /end CHARACTERISTIC
/begin CHARACTERISTIC DSM_ClaDfp_TVACD_TVADia2_C "Fehlerklasse fuer Fehlerpfad Dfp_TVACD_TVADia2" VALUE 0xCA26C Kw_Wu8 20.00 OneToOne 0.00 20.00 FORMAT "%5.2" EXTENDED_LIMITS 0.00 255.0 /end CHARACTERISTIC
/begin CHARACTERISTIC DSM_ClaDfp_TVACD_TVADia3_C "Fehlerklasse fuer Fehlerpfad Dfp_TVACD_TVADia3" VALUE 0xCA26D Kw_Wu8 20.00 OneToOne 0.00 20.00 FORMAT "%5.2" EXTENDED_LIMITS 0.00 255.0 /end CHARACTERISTIC
/begin CHARACTERISTIC DSM_ClaDfp_VSACD_Max_C "Fehlerklasse fuer Fehlerpfad Dfp_VSACD_Max" VALUE 0xCA26E Kw_Wu8 20.00 OneToOne 0.00 20.00 FORMAT "%5.2" EXTENDED_LIMITS 0.00 255.0 /end CHARACTERISTIC
/begin CHARACTERISTIC DSM_ClaDfp_VSACD_Min_C "Fehlerklasse fuer Fehlerpfad Dfp_VSACD_Min" VALUE 0xCA26F Kw_Wu8 20.00 OneToOne 0.00 20.00 FORMAT "%5.2" EXTENDED_LIMITS 0.00 255.0 /end CHARACTERISTIC
/begin CHARACTERISTIC DSM_ClaDfp_VSACD_SigNpl_C "Fehlerklasse fuer Fehlerpfad Dfp_VSACD_SigNpl" VALUE 0xCA270 Kw_Wu8 20.00 OneToOne 0.00 20.00 FORMAT "%5.2" EXTENDED_LIMITS 0.00 255.0 /end CHARACTERISTIC
/begin CHARACTERISTIC DSM_ClaDfp_VSACD_VSADia1_C "Fehlerklasse fuer Fehlerpfad Dfp_VSACD_VSADia1" VALUE 0xCA271 Kw_Wu8 20.00 OneToOne 0.00 20.00 FORMAT "%5.2" EXTENDED_LIMITS 0.00 255.0 /end CHARACTERISTIC
/begin CHARACTERISTIC DSM_ClaDfp_VSACD_VSADia2_C "Fehlerklasse fuer Fehlerpfad Dfp_VSACD_VSADia2" VALUE 0xCA272 Kw_Wu8 20.00 OneToOne 0.00 20.00 FORMAT "%5.2" EXTENDED_LIMITS 0.00 255.0 /end CHARACTERISTIC
/begin CHARACTERISTIC DSM_ClaDfp_VSACD_VSADia3_C "Fehlerklasse fuer Fehlerpfad Dfp_VSACD_VSADia3" VALUE 0xCA273 Kw_Wu8 20.00 OneToOne 0.00 20.00 FORMAT "%5.2" EXTENDED_LIMITS 0.00 255.0 /end CHARACTERISTIC
/begin CHARACTERISTIC DSM_ClaDfp_VSACD_VSADia4_C "Fehlerklasse fuer Fehlerpfad Dfp_VSACD_VSADia4" VALUE 0xCA274 Kw_Wu8 20.00 OneToOne 0.00 20.00 FORMAT "%5.2" EXTENDED_LIMITS 0.00 255.0 /end CHARACTERISTIC
/begin CHARACTERISTIC DSM_ClaDfp_VSSCD1_C "Fehlerklasse fuer Fehlerpfad Dfp_VSSCD1" VALUE 0xCA275 Kw_Wu8 20.00 OneToOne 0.00 20.00 FORMAT "%5.2" EXTENDED_LIMITS 0.00 255.0 /end CHARACTERISTIC
/begin CHARACTERISTIC DSM_ClaDfp_VSSCD2_C "Fehlerklasse fuer Fehlerpfad Dfp_VSSCD2" VALUE 0xCA276 Kw_Wu8 20.00 OneToOne 0.00 20.00 FORMAT "%5.2" EXTENDED_LIMITS 0.00 255.0 /end CHARACTERISTIC
/begin CHARACTERISTIC DSM_ClaDfp_WdCom_C "Fehlerklasse fuer Fehlerpfad Dfp_WdCom" VALUE 0xCA277 Kw_Wu8 20.00 OneToOne 0.00 20.00 FORMAT "%5.2" EXTENDED_LIMITS 0.00 255.0 /end CHARACTERISTIC
/begin FUNCTION dsm_auto_cdk ""
 /begin DEF_CHARACTERISTIC DSM_CDKDfp_Layer_TANS_C DSM_CDKDfp_ACCDSwtin_C DSM_CDKDfp_ACC_PlausTrqDes_C DSM_CDKDfp_ACC_trqInr_C DSM_CDKDfp_ACTrq_C DSM_CDKDfp_ADCMon_C DSM_CDKDfp_AFSCDIdlAdjVal_C DSM_CDKDfp_AFSCDLdAdjVal_C DSM_CDKDfp_AFSCD_AirTempDcyc_C DSM_CDKDfp_AFSCD_PlOffsDrft_C DSM_CDKDfp_AFSCD_PlSetyDrft_C DSM_CDKDfp_AFSCD_SRCAirTemp_C DSM_CDKDfp_AFSCD_SRCBatt_C DSM_CDKDfp_AFSCD_SRCCorrAirm_C DSM_CDKDfp_AFSCD_SRCRawAirm_C DSM_CDKDfp_AFSCD_SRCRefSigPer_C DSM_CDKDfp_AOHtCD_C DSM_CDKDfp_AOHtCD_AOHtDia1_C DSM_CDKDfp_AOHtCD_AOHtDia2_C DSM_CDKDfp_Layer_TUMG_C DSM_CDKDfp_AOHtCD_AOHtDia3_C DSM_CDKDfp_APP1_C DSM_CDKDfp_Layer_GEN_C DSM_CDKDfp_Layer_BSD_C DSM_CDKDfp_APP2_C DSM_CDKDfp_APSCD_C DSM_CDKDfp_ARS_C DSM_CDKDfp_AccPedPlausBrk_C DSM_CDKDfp_AirCtlPlateBreak_C DSM_CDKDfp_AirCtl_GovNegDev_C DSM_CDKDfp_AirCtl_GovNegDev2_C DSM_CDKDfp_AirCtl_GovPosDev_C DSM_CDKDfp_AirCtl_GovPosDev2_C DSM_CDKDfp_AltCD_C DSM_CDKDfp_Layer_QLT_C DSM_CDKDfp_BPACD_BPADia1_C DSM_CDKDfp_Layer_IBS1_C DSM_CDKDfp_Layer_IBS2_C DSM_CDKDfp_Layer_IBS3_C DSM_CDKDfp_Layer_PMBN_C DSM_CDKDfp_Layer_PMBATT_C DSM_CDKDfp_BPACD_BPADia2_C DSM_CDKDfp_BPACD_BPADia3_C DSM_CDKDfp_BPACD_Max_C DSM_CDKDfp_BPACD_Min_C DSM_CDKDfp_BPACD_SigNpl_C DSM_CDKDfp_BPSCD_C DSM_CDKDfp_BattCD_C DSM_CDKDfp_BrkCD_C DSM_CDKDfp_Bss_C DSM_CDKDfp_CBACD_C DSM_CDKDfp_CTSCD_C DSM_CDKDfp_Clg_DynTst_C DSM_CDKDfp_CmbChbMisfire1_C DSM_CDKDfp_CmbChbMisfire2_C DSM_CDKDfp_CmbChbMisfire3_C DSM_CDKDfp_CmbChbMisfire4_C DSM_CDKDfp_CmbChbMisfire5_C DSM_CDKDfp_CmbChbMisfire6_C DSM_CDKDfp_CmbChbMisfireMul_C DSM_CDKDfp_CoVMDCSh_C DSM_CDKDfp_ConvCD_C DSM_CDKDfp_CrCCDMFL_C DSM_CDKDfp_CrCtl_vCrCtl_C DSM_CDKDfp_Dummy1_C DSM_CDKDfp_EATSCD_C DSM_CDKDfp_EBAFCD_C DSM_CDKDfp_EBFCD_C DSM_CDKDfp_EBTSCD_C DSM_CDKDfp_EBTSCD_OvrTemp_C DSM_CDKDfp_EEPCDVarMng_C DSM_CDKDfp_EGPpCD_C DSM_CDKDfp_EGPpCDTPreTrbn_C DSM_CDKDfp_Layer_PMRUHVERL_C DSM_CDKDfp_EGRCD_Max_C DSM_CDKDfp_EGRCD_Min_C DSM_CDKDfp_EGRCD_SigNpl_C DSM_CDKDfp_EGTRgnOilDil_C DSM_CDKDfp_Layer_TOENS_C DSM_CDKDfp_Layer_MANHYDR_C DSM_CDKDfp_Layer_MANLUFT_C DSM_CDKDfp_ETClbETFltInj1_C DSM_CDKDfp_ETClbETFltInj2_C DSM_CDKDfp_ETClbETFltInj3_C DSM_CDKDfp_ETClbETFltInj4_C DSM_CDKDfp_ETClbETFltInj5_C DSM_CDKDfp_ETClbETFltInj6_C DSM_CDKDfp_ETClbInj1_C DSM_CDKDfp_ETClbInj2_C DSM_CDKDfp_ETClbInj3_C DSM_CDKDfp_ETClbInj4_C DSM_CDKDfp_ETClbInj5_C DSM_CDKDfp_ETClbInj6_C DSM_CDKDfp_EngMCaS1_C DSM_CDKDfp_EngMCrS1_C DSM_CDKDfp_EngMOfsCaSCrS_C DSM_CDKDfp_EngMntCtl1_Dia1_C DSM_CDKDfp_EngMntCtl1_Dia2_C DSM_CDKDfp_EngMntCtl1_Dia3_C DSM_CDKDfp_EngMntCtl1_Max_C DSM_CDKDfp_EngMntCtl1_Min_C DSM_CDKDfp_EngMntCtl1_SigNpl_C DSM_CDKDfp_EngMntCtlCD_C DSM_CDKDfp_EngMntCtl_Dia1_C DSM_CDKDfp_EngMntCtl_Dia2_C DSM_CDKDfp_EngMntCtl_Dia3_C DSM_CDKDfp_EngMntCtl_Max_C DSM_CDKDfp_EngMntCtl_Min_C DSM_CDKDfp_EngMntCtl_SigNpl_C DSM_CDKDfp_EngPrtFWODet_C DSM_CDKDfp_FBCqDvt_C DSM_CDKDfp_FMTC_NonMonotonMap_C DSM_CDKDfp_FTSCD_C DSM_CDKDfp_FanCD_C DSM_CDKDfp_FanCD_FanCtlr1_C DSM_CDKDfp_FanCD_FanCtlr2_C DSM_CDKDfp_FanCD_FanCtlr3_C DSM_CDKDfp_FlFCD_C DSM_CDKDfp_FlMngSmkDefect_C DSM_CDKDfp_FrmMngBOS_RESET_C DSM_CDKDfp_FrmMngBOS_RESET_2_C DSM_CDKDfp_FrmMngDMANFAFS_C DSM_CDKDfp_FrmMngDRMANFSSG_C DSM_CDKDfp_FrmMngGEARBX_DATA_C DSM_CDKDfp_FrmMngGEARBX_DATA2_C DSM_CDKDfp_FrmMngHEAT_AC_C DSM_CDKDfp_FrmMngLENKRADWINKEL_C DSM_CDKDfp_FrmMngMILEAGE_RANGE_C DSM_CDKDfp_FrmMngOPCRCTLACC_C DSM_CDKDfp_FrmMngPRGG_CCTR_C DSM_CDKDfp_FrmMngPWRMNG_LOADV_C DSM_CDKDfp_FrmMngParkConsumer_C DSM_CDKDfp_FrmMngRQSTGEFAN_C DSM_CDKDfp_FrmMngSSGErr_C DSM_CDKDfp_FrmMngSSGShOff_C DSM_CDKDfp_FrmMngSTAT_ANH_C DSM_CDKDfp_FrmMngSTAT_ARS_C DSM_CDKDfp_FrmMngSTAT_DSC_C DSM_CDKDfp_FrmMngSTAT_EKP_C DSM_CDKDfp_FrmMngSTAT_KOMBI_C DSM_CDKDfp_FrmMngSTAT_SITZ_C DSM_CDKDfp_FrmMngStOBDGbxMilOf_C DSM_CDKDfp_FrmMngStOBDGbxMilOn_C DSM_CDKDfp_FrmMngTEMPRELTIME_C DSM_CDKDfp_FrmMngTERMINAL_C DSM_CDKDfp_FrmMngTIME_DATE_C DSM_CDKDfp_FrmMngTORQUE_DSC_C DSM_CDKDfp_FrmMngTORQUE_GEARBX_C DSM_CDKDfp_FrmMngTrq_ReqACC_C DSM_CDKDfp_FrmMngVEH_MOD_C DSM_CDKDfp_FrmMngVELOCITY_C DSM_CDKDfp_FrmMngWHEEL_SPEED_C DSM_CDKDfp_FrmMngstCurr_C DSM_CDKDfp_FrmMngswtPSPOff_C DSM_CDKDfp_GearbxIncMax_C DSM_CDKDfp_GlwCD_C DSM_CDKDfp_GlwCDGlwCirc1_C DSM_CDKDfp_GlwCDGlwCirc2_C DSM_CDKDfp_GlwCDGlwCirc3_C DSM_CDKDfp_GlwCDGlwCirc4_C DSM_CDKDfp_GlwCDGlwCirc5_C DSM_CDKDfp_GlwCDGlwCirc6_C DSM_CDKDfp_GlwCDGlwCirc7_C DSM_CDKDfp_GlwCDGlwCirc8_C DSM_CDKDfp_GlwCtl_C DSM_CDKDfp_HWEMonCom_C DSM_CDKDfp_HWEMonEEPROM_C DSM_CDKDfp_HWEMonRcyLocked_C DSM_CDKDfp_HWEMonRcySuppressed_C DSM_CDKDfp_HWEMonRcyVisible_C DSM_CDKDfp_HWEMonUMaxSupply_C DSM_CDKDfp_HWEMonUMinSupply_C DSM_CDKDfp_IATSCD_C DSM_CDKDfp_IATSCD_CATS_C DSM_CDKDfp_ImmCtlImmCD_C DSM_CDKDfp_ImmCtlImmEep_C DSM_CDKDfp_ImmCtlMpl_C DSM_CDKDfp_IndSys1_C DSM_CDKDfp_IndSys2_C DSM_CDKDfp_InjCrv_InjLim_C DSM_CDKDfp_InjCtlAdjQnt_C DSM_CDKDfp_InjCtlDrift_C DSM_CDKDfp_InjVCDActrChrg_C DSM_CDKDfp_InjVCDActrEnrg1_C DSM_CDKDfp_InjVCDActrEnrg2_C DSM_CDKDfp_InjVCDActrEnrg3_C DSM_CDKDfp_InjVCDActrEnrg4_C DSM_CDKDfp_InjVCDActrEnrg5_C DSM_CDKDfp_InjVCDActrEnrg6_C DSM_CDKDfp_InjVCDActrEnrg7_C DSM_CDKDfp_InjVCDActrEnrg8_C DSM_CDKDfp_InjVCDActrVolt_C DSM_CDKDfp_InjVCDClsBank1_C DSM_CDKDfp_InjVCDClsBank2_C DSM_CDKDfp_InjVCDMonCab_C DSM_CDKDfp_InjVCDMonSwt_C DSM_CDKDfp_InjVCDShOffDCDC_C DSM_CDKDfp_InjVCDUBuf_C DSM_CDKDfp_InjVCD_CY370Ampl_C DSM_CDKDfp_InjVlvBnk1A_C DSM_CDKDfp_InjVlvBnk1B_C DSM_CDKDfp_InjVlvBnk2A_C DSM_CDKDfp_InjVlvBnk2B_C DSM_CDKDfp_InjVlvChipA_C DSM_CDKDfp_InjVlvChipB_C DSM_CDKDfp_InjVlvCyl1A_C DSM_CDKDfp_InjVlvCyl1B_C DSM_CDKDfp_InjVlvCyl1C_C DSM_CDKDfp_InjVlvCyl2A_C DSM_CDKDfp_InjVlvCyl2B_C DSM_CDKDfp_InjVlvCyl2C_C DSM_CDKDfp_InjVlvCyl3A_C DSM_CDKDfp_InjVlvCyl3B_C DSM_CDKDfp_InjVlvCyl3C_C DSM_CDKDfp_InjVlvCyl4A_C DSM_CDKDfp_InjVlvCyl4B_C DSM_CDKDfp_InjVlvCyl4C_C DSM_CDKDfp_InjVlvCyl5A_C DSM_CDKDfp_InjVlvCyl5B_C DSM_CDKDfp_InjVlvCyl5C_C DSM_CDKDfp_InjVlvCyl6A_C DSM_CDKDfp_InjVlvCyl6B_C DSM_CDKDfp_InjVlvCyl6C_C DSM_CDKDfp_InjVlvCyl7A_C DSM_CDKDfp_InjVlvCyl7B_C DSM_CDKDfp_InjVlvCyl7C_C DSM_CDKDfp_InjVlvCyl8A_C DSM_CDKDfp_InjVlvCyl8B_C DSM_CDKDfp_InjVlvCyl8C_C DSM_CDKDfp_InjVlvNVC1_C DSM_CDKDfp_InjVlvNVC2_C DSM_CDKDfp_InjVlvNVC3_C DSM_CDKDfp_InjVlvNVC4_C DSM_CDKDfp_InjVlvNVC5_C DSM_CDKDfp_InjVlvNVC6_C DSM_CDKDfp_InjVlvNVC7_C DSM_CDKDfp_InjVlvNVC8_C DSM_CDKDfp_LPACD_Max_C DSM_CDKDfp_LPACD_Min_C DSM_CDKDfp_LPACD_SigNpl_C DSM_CDKDfp_LSUCDCircNernst0_C DSM_CDKDfp_LSUCDCircPumpCur0_C DSM_CDKDfp_LSUCDCircVirtGnd0_C DSM_CDKDfp_LSUCDHeater0_C DSM_CDKDfp_LSUCDHtCoup0_C DSM_CDKDfp_LSUCDO20_C DSM_CDKDfp_LSUCDO2Clb0_C DSM_CDKDfp_LSUCDRiClb0_C DSM_CDKDfp_LSUCDSPI0_C DSM_CDKDfp_LSUCDSPIBattLow0_C DSM_CDKDfp_LSUCDWireIP0_C DSM_CDKDfp_LSUCtlRiExc0_C DSM_CDKDfp_LSUMon1Sens_C DSM_CDKDfp_LSUMon2Sens_C DSM_CDKDfp_LubCD_C DSM_CDKDfp_MIL_C DSM_CDKDfp_MRlyCD_C DSM_CDKDfp_MSidCD_Comm_C DSM_CDKDfp_MSidCD_Pin_C DSM_CDKDfp_MSidCD_Sel_INI_C DSM_CDKDfp_MSidCD_Select_C DSM_CDKDfp_MeUnCDNoLoad_C DSM_CDKDfp_MeUnCDSCBat_C DSM_CDKDfp_MeUnCDSCGnd_C DSM_CDKDfp_MeUnCD_ADC_C DSM_CDKDfp_MeUnCD_SigTst_C DSM_CDKDfp_Montr_C DSM_CDKDfp_NetMngDeviceA_C DSM_CDKDfp_NetMngDeviceB_C DSM_CDKDfp_NetMngDeviceC_C DSM_CDKDfp_OPSCD_Lamp_C DSM_CDKDfp_OPSCD_anain_C DSM_CDKDfp_OTSCD_C DSM_CDKDfp_OvRMon_C DSM_CDKDfp_OvRMonBrk_C DSM_CDKDfp_OvRMonSigA_C DSM_CDKDfp_OxiCCDTPre_C DSM_CDKDfp_PCR_GovDevNeg_C DSM_CDKDfp_PCR_GovDevPos_C DSM_CDKDfp_PCVCDNoLoad_C DSM_CDKDfp_PCVCDSCBat_C DSM_CDKDfp_PCVCDSCGnd_C DSM_CDKDfp_PCVCD_ADC_C DSM_CDKDfp_PCVCD_SigTst_C DSM_CDKDfp_PFltAPSens_C DSM_CDKDfp_PFltCDPPre_C DSM_CDKDfp_PFltCDTempPre_C DSM_CDKDfp_PFltChar_C DSM_CDKDfp_PFltEngPrt_C DSM_CDKDfp_PFltPresDynPlaus_C DSM_CDKDfp_PFltPresSens_C DSM_CDKDfp_PFltPresSensFrz_C DSM_CDKDfp_PFltPresSensHsLn_C DSM_CDKDfp_PFltPresSensSot_C DSM_CDKDfp_PFltRgnPerm_C DSM_CDKDfp_PFltTempDwnStrm_C DSM_CDKDfp_PFltTempSens_C DSM_CDKDfp_PFltTempUpStrm_C DSM_CDKDfp_PFltmSotDiffMax_C DSM_CDKDfp_QLTCD_C DSM_CDKDfp_RTMMon_C DSM_CDKDfp_RailCD_C DSM_CDKDfp_RailCDOfsTst_C DSM_CDKDfp_RailCD_PMonStrt_C DSM_CDKDfp_RailCtlModeMeUnDiag_C DSM_CDKDfp_RailCtlModePCVDiag_C DSM_CDKDfp_RailMeUn0_C DSM_CDKDfp_RailMeUn1_C DSM_CDKDfp_RailMeUn2_C DSM_CDKDfp_RailMeUn3_C DSM_CDKDfp_RailMeUn4_C DSM_CDKDfp_RailPCV0_C DSM_CDKDfp_RailPCV1_C DSM_CDKDfp_RailPCV2_C DSM_CDKDfp_RailPCV3_C DSM_CDKDfp_RailPCV4_C DSM_CDKDfp_RailPCV5_C DSM_CDKDfp_SOPTst_C DSM_CDKDfp_SSpMon1_C DSM_CDKDfp_SSpMon2_C DSM_CDKDfp_SSpMon3_C DSM_CDKDfp_ShutCD_C DSM_CDKDfp_StSysTrqShutOff_C DSM_CDKDfp_StrtCD_Actr_C DSM_CDKDfp_SysLamp_C DSM_CDKDfp_T15CD_C DSM_CDKDfp_TGearbx_C DSM_CDKDfp_TPUMon_C DSM_CDKDfp_TVACD_Max_C DSM_CDKDfp_TVACD_Min_C DSM_CDKDfp_TVACD_SigNpl_C DSM_CDKDfp_TVACD_TVADia1_C DSM_CDKDfp_TVACD_TVADia2_C DSM_CDKDfp_TVACD_TVADia3_C DSM_CDKDfp_VSACD_Max_C DSM_CDKDfp_VSACD_Min_C DSM_CDKDfp_VSACD_SigNpl_C DSM_CDKDfp_VSACD_VSADia1_C DSM_CDKDfp_VSACD_VSADia2_C DSM_CDKDfp_VSACD_VSADia3_C DSM_CDKDfp_VSACD_VSADia4_C DSM_CDKDfp_VSSCD1_C DSM_CDKDfp_VSSCD2_C DSM_CDKDfp_WdCom_C /end DEF_CHARACTERISTIC
/end FUNCTION
/begin FUNCTION dsm_auto_debclass ""
 /begin DEF_CHARACTERISTIC DSM_ClaDfp_Layer_TANS_C DSM_ClaDfp_ACCDSwtin_C DSM_ClaDfp_ACC_PlausTrqDes_C DSM_ClaDfp_ACC_trqInr_C DSM_ClaDfp_ACTrq_C DSM_ClaDfp_ADCMon_C DSM_ClaDfp_AFSCDIdlAdjVal_C DSM_ClaDfp_AFSCDLdAdjVal_C DSM_ClaDfp_AFSCD_AirTempDcyc_C DSM_ClaDfp_AFSCD_PlOffsDrft_C DSM_ClaDfp_AFSCD_PlSetyDrft_C DSM_ClaDfp_AFSCD_SRCAirTemp_C DSM_ClaDfp_AFSCD_SRCBatt_C DSM_ClaDfp_AFSCD_SRCCorrAirm_C DSM_ClaDfp_AFSCD_SRCRawAirm_C DSM_ClaDfp_AFSCD_SRCRefSigPer_C DSM_ClaDfp_AOHtCD_C DSM_ClaDfp_AOHtCD_AOHtDia1_C DSM_ClaDfp_AOHtCD_AOHtDia2_C DSM_ClaDfp_Layer_TUMG_C DSM_ClaDfp_AOHtCD_AOHtDia3_C DSM_ClaDfp_APP1_C DSM_ClaDfp_Layer_GEN_C DSM_ClaDfp_Layer_BSD_C DSM_ClaDfp_APP2_C DSM_ClaDfp_APSCD_C DSM_ClaDfp_ARS_C DSM_ClaDfp_AccPedPlausBrk_C DSM_ClaDfp_AirCtlPlateBreak_C DSM_ClaDfp_AirCtl_GovNegDev_C DSM_ClaDfp_AirCtl_GovNegDev2_C DSM_ClaDfp_AirCtl_GovPosDev_C DSM_ClaDfp_AirCtl_GovPosDev2_C DSM_ClaDfp_AltCD_C DSM_ClaDfp_Layer_QLT_C DSM_ClaDfp_BPACD_BPADia1_C DSM_ClaDfp_Layer_IBS1_C DSM_ClaDfp_Layer_IBS2_C DSM_ClaDfp_Layer_IBS3_C DSM_ClaDfp_Layer_PMBN_C DSM_ClaDfp_Layer_PMBATT_C DSM_ClaDfp_BPACD_BPADia2_C DSM_ClaDfp_BPACD_BPADia3_C DSM_ClaDfp_BPACD_Max_C DSM_ClaDfp_BPACD_Min_C DSM_ClaDfp_BPACD_SigNpl_C DSM_ClaDfp_BPSCD_C DSM_ClaDfp_BattCD_C DSM_ClaDfp_BrkCD_C DSM_ClaDfp_Bss_C DSM_ClaDfp_CBACD_C DSM_ClaDfp_CTSCD_C DSM_ClaDfp_Clg_DynTst_C DSM_ClaDfp_CmbChbMisfire1_C DSM_ClaDfp_CmbChbMisfire2_C DSM_ClaDfp_CmbChbMisfire3_C DSM_ClaDfp_CmbChbMisfire4_C DSM_ClaDfp_CmbChbMisfire5_C DSM_ClaDfp_CmbChbMisfire6_C DSM_ClaDfp_CmbChbMisfireMul_C DSM_ClaDfp_CoVMDCSh_C DSM_ClaDfp_ConvCD_C DSM_ClaDfp_CrCCDMFL_C DSM_ClaDfp_CrCtl_vCrCtl_C DSM_ClaDfp_Dummy1_C DSM_ClaDfp_EATSCD_C DSM_ClaDfp_EBAFCD_C DSM_ClaDfp_EBFCD_C DSM_ClaDfp_EBTSCD_C DSM_ClaDfp_EBTSCD_OvrTemp_C DSM_ClaDfp_EEPCDVarMng_C DSM_ClaDfp_EGPpCD_C DSM_ClaDfp_EGPpCDTPreTrbn_C DSM_ClaDfp_Layer_PMRUHVERL_C DSM_ClaDfp_EGRCD_Max_C DSM_ClaDfp_EGRCD_Min_C DSM_ClaDfp_EGRCD_SigNpl_C DSM_ClaDfp_EGTRgnOilDil_C DSM_ClaDfp_Layer_TOENS_C DSM_ClaDfp_Layer_MANHYDR_C DSM_ClaDfp_Layer_MANLUFT_C DSM_ClaDfp_ETClbETFltInj1_C DSM_ClaDfp_ETClbETFltInj2_C DSM_ClaDfp_ETClbETFltInj3_C DSM_ClaDfp_ETClbETFltInj4_C DSM_ClaDfp_ETClbETFltInj5_C DSM_ClaDfp_ETClbETFltInj6_C DSM_ClaDfp_ETClbInj1_C DSM_ClaDfp_ETClbInj2_C DSM_ClaDfp_ETClbInj3_C DSM_ClaDfp_ETClbInj4_C DSM_ClaDfp_ETClbInj5_C DSM_ClaDfp_ETClbInj6_C DSM_ClaDfp_EngMCaS1_C DSM_ClaDfp_EngMCrS1_C DSM_ClaDfp_EngMOfsCaSCrS_C DSM_ClaDfp_EngMntCtl1_Dia1_C DSM_ClaDfp_EngMntCtl1_Dia2_C DSM_ClaDfp_EngMntCtl1_Dia3_C DSM_ClaDfp_EngMntCtl1_Max_C DSM_ClaDfp_EngMntCtl1_Min_C DSM_ClaDfp_EngMntCtl1_SigNpl_C DSM_ClaDfp_EngMntCtlCD_C DSM_ClaDfp_EngMntCtl_Dia1_C DSM_ClaDfp_EngMntCtl_Dia2_C DSM_ClaDfp_EngMntCtl_Dia3_C DSM_ClaDfp_EngMntCtl_Max_C DSM_ClaDfp_EngMntCtl_Min_C DSM_ClaDfp_EngMntCtl_SigNpl_C DSM_ClaDfp_EngPrtFWODet_C DSM_ClaDfp_FBCqDvt_C DSM_ClaDfp_FMTC_NonMonotonMap_C DSM_ClaDfp_FTSCD_C DSM_ClaDfp_FanCD_C DSM_ClaDfp_FanCD_FanCtlr1_C DSM_ClaDfp_FanCD_FanCtlr2_C DSM_ClaDfp_FanCD_FanCtlr3_C DSM_ClaDfp_FlFCD_C DSM_ClaDfp_FlMngSmkDefect_C DSM_ClaDfp_FrmMngBOS_RESET_C DSM_ClaDfp_FrmMngBOS_RESET_2_C DSM_ClaDfp_FrmMngDMANFAFS_C DSM_ClaDfp_FrmMngDRMANFSSG_C DSM_ClaDfp_FrmMngGEARBX_DATA_C DSM_ClaDfp_FrmMngGEARBX_DATA2_C DSM_ClaDfp_FrmMngHEAT_AC_C DSM_ClaDfp_FrmMngLENKRADWINKEL_C DSM_ClaDfp_FrmMngMILEAGE_RANGE_C DSM_ClaDfp_FrmMngOPCRCTLACC_C DSM_ClaDfp_FrmMngPRGG_CCTR_C DSM_ClaDfp_FrmMngPWRMNG_LOADV_C DSM_ClaDfp_FrmMngParkConsumer_C DSM_ClaDfp_FrmMngRQSTGEFAN_C DSM_ClaDfp_FrmMngSSGErr_C DSM_ClaDfp_FrmMngSSGShOff_C DSM_ClaDfp_FrmMngSTAT_ANH_C DSM_ClaDfp_FrmMngSTAT_ARS_C DSM_ClaDfp_FrmMngSTAT_DSC_C DSM_ClaDfp_FrmMngSTAT_EKP_C DSM_ClaDfp_FrmMngSTAT_KOMBI_C DSM_ClaDfp_FrmMngSTAT_SITZ_C DSM_ClaDfp_FrmMngStOBDGbxMilOf_C DSM_ClaDfp_FrmMngStOBDGbxMilOn_C DSM_ClaDfp_FrmMngTEMPRELTIME_C DSM_ClaDfp_FrmMngTERMINAL_C DSM_ClaDfp_FrmMngTIME_DATE_C DSM_ClaDfp_FrmMngTORQUE_DSC_C DSM_ClaDfp_FrmMngTORQUE_GEARBX_C DSM_ClaDfp_FrmMngTrq_ReqACC_C DSM_ClaDfp_FrmMngVEH_MOD_C DSM_ClaDfp_FrmMngVELOCITY_C DSM_ClaDfp_FrmMngWHEEL_SPEED_C DSM_ClaDfp_FrmMngstCurr_C DSM_ClaDfp_FrmMngswtPSPOff_C DSM_ClaDfp_GearbxIncMax_C DSM_ClaDfp_GlwCD_C DSM_ClaDfp_GlwCDGlwCirc1_C DSM_ClaDfp_GlwCDGlwCirc2_C DSM_ClaDfp_GlwCDGlwCirc3_C DSM_ClaDfp_GlwCDGlwCirc4_C DSM_ClaDfp_GlwCDGlwCirc5_C DSM_ClaDfp_GlwCDGlwCirc6_C DSM_ClaDfp_GlwCDGlwCirc7_C DSM_ClaDfp_GlwCDGlwCirc8_C DSM_ClaDfp_GlwCtl_C DSM_ClaDfp_HWEMonCom_C DSM_ClaDfp_HWEMonEEPROM_C DSM_ClaDfp_HWEMonRcyLocked_C DSM_ClaDfp_HWEMonRcySuppressed_C DSM_ClaDfp_HWEMonRcyVisible_C DSM_ClaDfp_HWEMonUMaxSupply_C DSM_ClaDfp_HWEMonUMinSupply_C DSM_ClaDfp_IATSCD_C DSM_ClaDfp_IATSCD_CATS_C DSM_ClaDfp_ImmCtlImmCD_C DSM_ClaDfp_ImmCtlImmEep_C DSM_ClaDfp_ImmCtlMpl_C DSM_ClaDfp_IndSys1_C DSM_ClaDfp_IndSys2_C DSM_ClaDfp_InjCrv_InjLim_C DSM_ClaDfp_InjCtlAdjQnt_C DSM_ClaDfp_InjCtlDrift_C DSM_ClaDfp_InjVCDActrChrg_C DSM_ClaDfp_InjVCDActrEnrg1_C DSM_ClaDfp_InjVCDActrEnrg2_C DSM_ClaDfp_InjVCDActrEnrg3_C DSM_ClaDfp_InjVCDActrEnrg4_C DSM_ClaDfp_InjVCDActrEnrg5_C DSM_ClaDfp_InjVCDActrEnrg6_C DSM_ClaDfp_InjVCDActrEnrg7_C DSM_ClaDfp_InjVCDActrEnrg8_C DSM_ClaDfp_InjVCDActrVolt_C DSM_ClaDfp_InjVCDClsBank1_C DSM_ClaDfp_InjVCDClsBank2_C DSM_ClaDfp_InjVCDMonCab_C DSM_ClaDfp_InjVCDMonSwt_C DSM_ClaDfp_InjVCDShOffDCDC_C DSM_ClaDfp_InjVCDUBuf_C DSM_ClaDfp_InjVCD_CY370Ampl_C DSM_ClaDfp_InjVlvBnk1A_C DSM_ClaDfp_InjVlvBnk1B_C DSM_ClaDfp_InjVlvBnk2A_C DSM_ClaDfp_InjVlvBnk2B_C DSM_ClaDfp_InjVlvChipA_C DSM_ClaDfp_InjVlvChipB_C DSM_ClaDfp_InjVlvCyl1A_C DSM_ClaDfp_InjVlvCyl1B_C DSM_ClaDfp_InjVlvCyl1C_C DSM_ClaDfp_InjVlvCyl2A_C DSM_ClaDfp_InjVlvCyl2B_C DSM_ClaDfp_InjVlvCyl2C_C DSM_ClaDfp_InjVlvCyl3A_C DSM_ClaDfp_InjVlvCyl3B_C DSM_ClaDfp_InjVlvCyl3C_C DSM_ClaDfp_InjVlvCyl4A_C DSM_ClaDfp_InjVlvCyl4B_C DSM_ClaDfp_InjVlvCyl4C_C DSM_ClaDfp_InjVlvCyl5A_C DSM_ClaDfp_InjVlvCyl5B_C DSM_ClaDfp_InjVlvCyl5C_C DSM_ClaDfp_InjVlvCyl6A_C DSM_ClaDfp_InjVlvCyl6B_C DSM_ClaDfp_InjVlvCyl6C_C DSM_ClaDfp_InjVlvCyl7A_C DSM_ClaDfp_InjVlvCyl7B_C DSM_ClaDfp_InjVlvCyl7C_C DSM_ClaDfp_InjVlvCyl8A_C DSM_ClaDfp_InjVlvCyl8B_C DSM_ClaDfp_InjVlvCyl8C_C DSM_ClaDfp_InjVlvNVC1_C DSM_ClaDfp_InjVlvNVC2_C DSM_ClaDfp_InjVlvNVC3_C DSM_ClaDfp_InjVlvNVC4_C DSM_ClaDfp_InjVlvNVC5_C DSM_ClaDfp_InjVlvNVC6_C DSM_ClaDfp_InjVlvNVC7_C DSM_ClaDfp_InjVlvNVC8_C DSM_ClaDfp_LPACD_Max_C DSM_ClaDfp_LPACD_Min_C DSM_ClaDfp_LPACD_SigNpl_C DSM_ClaDfp_LSUCDCircNernst0_C DSM_ClaDfp_LSUCDCircPumpCur0_C DSM_ClaDfp_LSUCDCircVirtGnd0_C DSM_ClaDfp_LSUCDHeater0_C DSM_ClaDfp_LSUCDHtCoup0_C DSM_ClaDfp_LSUCDO20_C DSM_ClaDfp_LSUCDO2Clb0_C DSM_ClaDfp_LSUCDRiClb0_C DSM_ClaDfp_LSUCDSPI0_C DSM_ClaDfp_LSUCDSPIBattLow0_C DSM_ClaDfp_LSUCDWireIP0_C DSM_ClaDfp_LSUCtlRiExc0_C DSM_ClaDfp_LSUMon1Sens_C DSM_ClaDfp_LSUMon2Sens_C DSM_ClaDfp_LubCD_C DSM_ClaDfp_MIL_C DSM_ClaDfp_MRlyCD_C DSM_ClaDfp_MSidCD_Comm_C DSM_ClaDfp_MSidCD_Pin_C DSM_ClaDfp_MSidCD_Sel_INI_C DSM_ClaDfp_MSidCD_Select_C DSM_ClaDfp_MeUnCDNoLoad_C DSM_ClaDfp_MeUnCDSCBat_C DSM_ClaDfp_MeUnCDSCGnd_C DSM_ClaDfp_MeUnCD_ADC_C DSM_ClaDfp_MeUnCD_SigTst_C DSM_ClaDfp_Montr_C DSM_ClaDfp_NetMngDeviceA_C DSM_ClaDfp_NetMngDeviceB_C DSM_ClaDfp_NetMngDeviceC_C DSM_ClaDfp_OPSCD_Lamp_C DSM_ClaDfp_OPSCD_anain_C DSM_ClaDfp_OTSCD_C DSM_ClaDfp_OvRMon_C DSM_ClaDfp_OvRMonBrk_C DSM_ClaDfp_OvRMonSigA_C DSM_ClaDfp_OxiCCDTPre_C DSM_ClaDfp_PCR_GovDevNeg_C DSM_ClaDfp_PCR_GovDevPos_C DSM_ClaDfp_PCVCDNoLoad_C DSM_ClaDfp_PCVCDSCBat_C DSM_ClaDfp_PCVCDSCGnd_C DSM_ClaDfp_PCVCD_ADC_C DSM_ClaDfp_PCVCD_SigTst_C DSM_ClaDfp_PFltAPSens_C DSM_ClaDfp_PFltCDPPre_C DSM_ClaDfp_PFltCDTempPre_C DSM_ClaDfp_PFltChar_C DSM_ClaDfp_PFltEngPrt_C DSM_ClaDfp_PFltPresDynPlaus_C DSM_ClaDfp_PFltPresSens_C DSM_ClaDfp_PFltPresSensFrz_C DSM_ClaDfp_PFltPresSensHsLn_C DSM_ClaDfp_PFltPresSensSot_C DSM_ClaDfp_PFltRgnPerm_C DSM_ClaDfp_PFltTempDwnStrm_C DSM_ClaDfp_PFltTempSens_C DSM_ClaDfp_PFltTempUpStrm_C DSM_ClaDfp_PFltmSotDiffMax_C DSM_ClaDfp_QLTCD_C DSM_ClaDfp_RTMMon_C DSM_ClaDfp_RailCD_C DSM_ClaDfp_RailCDOfsTst_C DSM_ClaDfp_RailCD_PMonStrt_C DSM_ClaDfp_RailCtlModeMeUnDiag_C DSM_ClaDfp_RailCtlModePCVDiag_C DSM_ClaDfp_RailMeUn0_C DSM_ClaDfp_RailMeUn1_C DSM_ClaDfp_RailMeUn2_C DSM_ClaDfp_RailMeUn3_C DSM_ClaDfp_RailMeUn4_C DSM_ClaDfp_RailPCV0_C DSM_ClaDfp_RailPCV1_C DSM_ClaDfp_RailPCV2_C DSM_ClaDfp_RailPCV3_C DSM_ClaDfp_RailPCV4_C DSM_ClaDfp_RailPCV5_C DSM_ClaDfp_SOPTst_C DSM_ClaDfp_SSpMon1_C DSM_ClaDfp_SSpMon2_C DSM_ClaDfp_SSpMon3_C DSM_ClaDfp_ShutCD_C DSM_ClaDfp_StSysTrqShutOff_C DSM_ClaDfp_StrtCD_Actr_C DSM_ClaDfp_SysLamp_C DSM_ClaDfp_T15CD_C DSM_ClaDfp_TGearbx_C DSM_ClaDfp_TPUMon_C DSM_ClaDfp_TVACD_Max_C DSM_ClaDfp_TVACD_Min_C DSM_ClaDfp_TVACD_SigNpl_C DSM_ClaDfp_TVACD_TVADia1_C DSM_ClaDfp_TVACD_TVADia2_C DSM_ClaDfp_TVACD_TVADia3_C DSM_ClaDfp_VSACD_Max_C DSM_ClaDfp_VSACD_Min_C DSM_ClaDfp_VSACD_SigNpl_C DSM_ClaDfp_VSACD_VSADia1_C DSM_ClaDfp_VSACD_VSADia2_C DSM_ClaDfp_VSACD_VSADia3_C DSM_ClaDfp_VSACD_VSADia4_C DSM_ClaDfp_VSSCD1_C DSM_ClaDfp_VSSCD2_C DSM_ClaDfp_WdCom_C /end DEF_CHARACTERISTIC
/end FUNCTION
/begin COMPU_METHOD OneToOne "eins zu eins (physikalischer Wert ist gleich dem internen Wert)" RAT_FUNC "%6.2" "-" COEFFS 0 1 0 0 0 1 /end COMPU_METHOD
/begin RECORD_LAYOUT Kwb_Wu16 FNC_VALUES 1 UWORD COLUMN_DIR DIRECT /end RECORD_LAYOUT
/begin RECORD_LAYOUT Kw_Wu8 FNC_VALUES 1 UBYTE COLUMN_DIR DIRECT /end RECORD_LAYOUT
/end MODULE
/end PROJECT
