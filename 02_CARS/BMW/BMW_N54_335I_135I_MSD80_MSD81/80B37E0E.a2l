ASAP2_VERSION 1 41
/begin PROJECT MSD70 "Spray Guided DI-System with Piezo Injectors for 6-Cylinder"
/begin HEADER "_default_HeaderComment" PROJECT_NO _0B /end HEADER
/begin MODULE _default_ModuleName "_default_ModuleLongIdentifier"
/begin MOD_COMMON "_default_ModCommonComment" DEPOSIT ABSOLUTE BYTE_ORDER MSB_LAST ALIGNMENT_BYTE 1 ALIGNMENT_WORD 2 ALIGNMENT_LONG 2 ALIGNMENT_FLOAT32_IEEE 2 ALIGNMENT_FLOAT64_IEEE 4 /end MOD_COMMON
/begin MEASUREMENT lv_err_bn_msw "Present error BN2000" UBYTE _CNV_S_2_RANGE__0___1_CM 1 100. 0. 1. DISPLAY_IDENTIFIER LV_ERR_BN_MSW ECU_ADDRESS 0xd000345b BIT_MASK 0x1 /end MEASUREMENT
/begin CHARACTERISTIC c_amp_hys "maximum value between two acquired ambient pressure values" VALUE 0xa1029190 _REC_VAL_20_u2 5434. _CNV_A_R_LINEAR_____26_CM 0. 5434. DISPLAY_IDENTIFIER C_AMP_HYS FORMAT "%7.2" /end CHARACTERISTIC
/begin CHARACTERISTIC ip_amp_raw_cor__vs "correlation table for the linearization of the ambient pressure with the vehicle speed" CURVE 0xa1023078 _REC_CUR_20_u2_u1 5434. _CNV_A_R_LINEAR_____26_CM 0. 5434. DISPLAY_IDENTIFIER IP_AMP_RAW_COR__VS FORMAT "%7.2"
 /begin AXIS_DESCR COM_AXIS vs _CNV_A_R_LINEAR_____6_CM 8 0. 255. FORMAT "%3.0" AXIS_PTS_REF ldp_vs__amp_raw_cor /end AXIS_DESCR
/end CHARACTERISTIC
/begin MEASUREMENT amp_mes "valid ambient pressure" UWORD _CNV_A_R_LINEAR_____26_CM 1 100. 0. 5434. DISPLAY_IDENTIFIER AMP_MES ECU_ADDRESS 0xd0005090 FORMAT "%7.2" /end MEASUREMENT
/begin CHARACTERISTIC c_amp_crlc "correlation value for the compensation of the noise signal of the ambient pressure signal" VALUE 0xa102918c _REC_VAL_20_u1 0.99609375 _CNV_A_R_LINEAR_____27_CM 0. 0.99609375 DISPLAY_IDENTIFIER C_AMP_CRLC FORMAT "%5.3" /end CHARACTERISTIC
/begin CHARACTERISTIC c_fac_amp_min "BOT for FAC_AMP" VALUE 0xa1029378 _REC_VAL_20_u2 1.99996948242188 _CNV_A_R_LINEAR_____8_CM 0. 1.99996948242188 DISPLAY_IDENTIFIER C_FAC_AMP_MIN FORMAT "%7.5" /end CHARACTERISTIC
/begin CHARACTERISTIC c_fac_amp_max "TOP for FAC_AMP" VALUE 0xa1029376 _REC_VAL_20_u2 1.99996948242188 _CNV_A_R_LINEAR_____8_CM 0. 1.99996948242188 DISPLAY_IDENTIFIER C_FAC_AMP_MAX FORMAT "%7.5" /end CHARACTERISTIC
/begin MEASUREMENT fac_amp "factor of the ambient pressure related to the reference ambient pressure" UWORD _CNV_A_R_LINEAR_____8_CM 1 100. 0. 1.99996948242188 DISPLAY_IDENTIFIER FAC_AMP ECU_ADDRESS 0xd0005092 FORMAT "%7.5" /end MEASUREMENT
/begin AXIS_PTS ldp_vs__amp_raw_cor "" 0xa102185c vs _REC_AXS_20_u1 255. _CNV_A_R_LINEAR_____6_CM 8 0. 255. FORMAT "%3.0" /end AXIS_PTS
/begin CHARACTERISTIC ip_amp_raw__v_amp "correlation table for the linearization of the ambient pressure value acquisition with Motorola sensor" CURVE 0xa1023068 _REC_CUR_20_u2_u2 5434. _CNV_A_R_LINEAR_____26_CM 0. 5434. DISPLAY_IDENTIFIER IP_AMP_RAW__V_AMP FORMAT "%7.2"
 /begin AXIS_DESCR COM_AXIS v_amp _CNV_A_R_LINEAR_____2_CM 8 0. 4.9951171875 FORMAT "%5.3" AXIS_PTS_REF ldp_v_amp__amp_raw /end AXIS_DESCR
/end CHARACTERISTIC
/begin AXIS_PTS ldp_v_amp__amp_raw "" 0xa1021630 v_amp _REC_AXS_20_u2 4.9951171875 _CNV_A_R_LINEAR_____2_CM 8 0. 4.9951171875 FORMAT "%5.3" /end AXIS_PTS
/begin MEASUREMENT tq_loss_ars_av_can "torque loss actual value ARS from CAN" SWORD _CNV_A_R_LINEAR_____30_CM 1 100. -1024. 1023.96875 DISPLAY_IDENTIFIER TQ_LOSS_ARS_AV_CAN ECU_ADDRESS 0xd0004a64 FORMAT "%8.2" /end MEASUREMENT
/begin MEASUREMENT tq_loss_ars_sp_can "torque loss setpoint ARS from CAN" SWORD _CNV_A_R_LINEAR_____30_CM 1 100. -1024. 1023.96875 DISPLAY_IDENTIFIER TQ_LOSS_ARS_SP_CAN ECU_ADDRESS 0xd0004a66 FORMAT "%8.2" /end MEASUREMENT
/begin MEASUREMENT veh_key_nr "vehicle key number" UBYTE _CNV_A_R_LINEAR_____0_CM 1 100. 0. 15. DISPLAY_IDENTIFIER VEH_KEY_NR ECU_ADDRESS 0xc00000fd FORMAT "%2.0" /end MEASUREMENT
/begin MEASUREMENT state_ars_can "status anti roll stabilization via CAN" UBYTE _CNV_S_3_STATE_ARS__31_CM 1 100. 0. 3. DISPLAY_IDENTIFIER STATE_ARS_CAN ECU_ADDRESS 0xd00035f8 /end MEASUREMENT
/begin MEASUREMENT state_igk_can "status ignition key via CAN" UBYTE _CNV_S_3_STATE_IGK__32_CM 1 100. 0. 2. DISPLAY_IDENTIFIER STATE_IGK_CAN ECU_ADDRESS 0xd00035f9 /end MEASUREMENT
/begin MEASUREMENT lv_tcs_lih_can "logical variable traction control system limp home" UBYTE _CNV_S_2_RANGE__0___1_CM 1 100. 0. 1. DISPLAY_IDENTIFIER LV_TCS_LIH_CAN ECU_ADDRESS 0xd000363f BIT_MASK 0x1 /end MEASUREMENT
/begin MEASUREMENT state_tcs_intv "status traction control system via CAN" UBYTE _CNV_S_4_STATE_TCS__33_CM 1 100. 0. 3. DISPLAY_IDENTIFIER STATE_TCS_INTV ECU_ADDRESS 0xd000360e /end MEASUREMENT
/begin MEASUREMENT state_wal_can "logical variable fuel reserve" UBYTE _CNV_S_3_STATE_WAL__34_CM 1 100. 0. 3. DISPLAY_IDENTIFIER STATE_WAL_CAN ECU_ADDRESS 0xc0000119 /end MEASUREMENT
/begin MEASUREMENT t_ctr_rel_can "relative time counter (reseted at Kl. 30 OFF)" ULONG _CNV_A_R_LINEAR_____35_CM 1 100. 0. 4294967294. DISPLAY_IDENTIFIER T_CTR_REL_CAN ECU_ADDRESS 0xc00000b8 FORMAT "%11.0" /end MEASUREMENT
/begin MEASUREMENT v_sp_gen "target generator voltage " UBYTE _CNV_A_R_LINEAR_____36_CM 1 100. 0. 26. DISPLAY_IDENTIFIER V_SP_GEN ECU_ADDRESS 0xc000011d FORMAT "%4.1" /end MEASUREMENT
/begin MEASUREMENT t_can "day counter absolute (counts the days at sufficient mains voltage )" UWORD _CNV_A_R_LINEAR_____37_CM 1 100. 0. 65534. DISPLAY_IDENTIFIER T_CAN ECU_ADDRESS 0xd0004a7c FORMAT "%5.0" /end MEASUREMENT
/begin CHARACTERISTIC c_t_cyc_disp_icl_can "recurrence for transmission of  check control message" VALUE 0xa1029832 _REC_VAL_20_u1 15. _CNV_A_R_LINEAR_____35_CM 0. 15. DISPLAY_IDENTIFIER C_T_CYC_DISP_ICL_CAN FORMAT "%2.0" /end CHARACTERISTIC
/begin MEASUREMENT state_tcs_ctl "status closed looped control via CAN" UBYTE _CNV_S_9_STATE_TCS__38_CM 1 100. 0. 255. DISPLAY_IDENTIFIER STATE_TCS_CTL ECU_ADDRESS 0xd000360f /end MEASUREMENT
/begin MEASUREMENT state_tcs_dece "status closed loop control via CAN" UBYTE _CNV_S_5_STATE_TCS__39_CM 1 100. 0. 15. DISPLAY_IDENTIFIER STATE_TCS_DECE ECU_ADDRESS 0xd0003610 /end MEASUREMENT
/begin MEASUREMENT ac_veh_lgt_tcs "vehicle acceleration (longitudinal) TCS" SWORD _CNV_A_R_LINEAR_____40_CM 1 100. -51.175 51.175 DISPLAY_IDENTIFIER AC_VEH_LGT_TCS ECU_ADDRESS 0xd0004a6c FORMAT "%8.3" /end MEASUREMENT
/begin MEASUREMENT ac_veh_trv_tcs "vehicle acceleration (transversal) TCS" SWORD _CNV_A_R_LINEAR_____40_CM 1 100. -51.175 51.175 DISPLAY_IDENTIFIER AC_VEH_TRV_TCS ECU_ADDRESS 0xd0004a6e FORMAT "%8.3" /end MEASUREMENT
/begin MEASUREMENT state_mod_gb "State mode gearbox : SSC (Sleeping Starter Clutch), SBC (Stand By Control)" UBYTE _CNV_S_5_STATE_MOD__41_CM 1 100. 0. 7. DISPLAY_IDENTIFIER STATE_MOD_GB ECU_ADDRESS 0xd0003615 /end MEASUREMENT
/begin MEASUREMENT ctl_acin_eng_typ "special function for air conditioning control - not used with engine type M54" UBYTE _CNV_A_R_LINEAR_____0_CM 1 100. 0. 3. DISPLAY_IDENTIFIER CTL_ACIN_ENG_TYP ECU_ADDRESS 0xc0000117 FORMAT "%1.0" /end MEASUREMENT
/begin MEASUREMENT state_swi_off_vb "state switch off battery voltage (kl30)" UBYTE _CNV_A_R_LINEAR_____0_CM 1 100. 0. 3. DISPLAY_IDENTIFIER STATE_SWI_OFF_VB ECU_ADDRESS 0xc000011c FORMAT "%1.0" /end MEASUREMENT
/begin MEASUREMENT state_tcs_can "status traction control system via CAN" UBYTE _CNV_S_6_STATE_TCS__42_CM 1 100. 0. 7. DISPLAY_IDENTIFIER STATE_TCS_CAN ECU_ADDRESS 0xc0000106 /end MEASUREMENT
/begin MEASUREMENT state_temp_gb "State overtemperature gearbox  (AT)- request for cooling (overheating protection) via ECT" UBYTE _CNV_S_4_STATE_TEMP_43_CM 1 100. 0. 3. DISPLAY_IDENTIFIER STATE_TEMP_GB ECU_ADDRESS 0xd0003613 /end MEASUREMENT
/begin MEASUREMENT temp_gb "Temperature gearbox (AT) - request for cooling (overheating protection) via ECF" UBYTE _CNV_A_R_LINEAR_____25_CM 1 100. -40. 215. DISPLAY_IDENTIFIER TEMP_GB ECU_ADDRESS 0xd0003614 FORMAT "%3.0" /end MEASUREMENT
/begin CHARACTERISTIC c_temp_gb_sub "Default temperature for automatic gearbox in case of error TEMP_GB" VALUE 0xa1029a21 _REC_VAL_20_u1 255. _CNV_A_R_LINEAR_____25_CM -40. 215. DISPLAY_IDENTIFIER C_TEMP_GB_SUB FORMAT "%3.0" /end CHARACTERISTIC
/begin MEASUREMENT vs_icl_disp "displayed vehicle speed (speedometer)" UWORD _CNV_A_R_LINEAR_____44_CM 1 100. 0. 409.4 DISPLAY_IDENTIFIER VS_ICL_DISP ECU_ADDRESS 0xd0004a78 FORMAT "%5.1" /end MEASUREMENT
/begin MEASUREMENT lv_dcc_lih_can "LV indicating DCC intervention limp home" UBYTE _CNV_S_2_RANGE__0___1_CM 1 100. 0. 1. DISPLAY_IDENTIFIER LV_DCC_LIH_CAN ECU_ADDRESS 0xd000363a BIT_MASK 0x1 /end MEASUREMENT
/begin MEASUREMENT lv_dcc_puc_inh "inhibitation of PUC required by DCC" UBYTE _CNV_S_2_RANGE__0___1_CM 1 100. 0. 1. DISPLAY_IDENTIFIER LV_DCC_PUC_INH ECU_ADDRESS 0xd000363c BIT_MASK 0x1 /end MEASUREMENT
/begin MEASUREMENT tq_dcc_slow_bn "torque target (slow) for DCC via CAN interface" SWORD _CNV_A_R_LINEAR_____30_CM 1 100. -1024. 1023.96875 DISPLAY_IDENTIFIER TQ_DCC_SLOW_BN ECU_ADDRESS 0xd0004a5e FORMAT "%8.2" /end MEASUREMENT
/begin MEASUREMENT tq_dcc_fast_bn "torque target (fast) for DCC via CAN interface" SWORD _CNV_A_R_LINEAR_____30_CM 1 100. -1024. 1023.96875 DISPLAY_IDENTIFIER TQ_DCC_FAST_BN ECU_ADDRESS 0xd0004a5c FORMAT "%8.2" /end MEASUREMENT
/begin MEASUREMENT state_etcu_intv "status traction control system via CAN" UBYTE _CNV_S_4_STATE_ETCU_45_CM 1 100. 0. 3. DISPLAY_IDENTIFIER STATE_ETCU_INTV ECU_ADDRESS 0xd0003612 /end MEASUREMENT
/begin MEASUREMENT state_dcc_intv "status torque target DCC via CAN interface" UBYTE _CNV_S_4_STATE_DCC__46_CM 1 100. 0. 3. DISPLAY_IDENTIFIER STATE_DCC_INTV ECU_ADDRESS 0xd00035f2 /end MEASUREMENT
/begin MEASUREMENT state_dcc_puc_inh "status request PUC-inhibitation via CAN interface - DCC" UBYTE _CNV_S_3_STATE_DCC__47_CM 1 100. 0. 3. DISPLAY_IDENTIFIER STATE_DCC_PUC_INH ECU_ADDRESS 0xd00035f3 /end MEASUREMENT
/begin MEASUREMENT state_dcc_off_req "status switch-off DCC" UBYTE _CNV_S_4_STATE_DCC__48_CM 1 100. 0. 3. DISPLAY_IDENTIFIER STATE_DCC_OFF_REQ ECU_ADDRESS 0xd00035f4 /end MEASUREMENT
/begin MEASUREMENT state_dcc "Status DCC" UBYTE _CNV_S_8_STATE_DCC_49_CM 1 100. 0. 7. DISPLAY_IDENTIFIER STATE_DCC ECU_ADDRESS 0xd00035f5 /end MEASUREMENT
/begin MEASUREMENT lv_dcc_off_ack "Acknowledge bit for switch-off DCC" UBYTE _CNV_S_2_RANGE__0___1_CM 1 100. 0. 1. DISPLAY_IDENTIFIER LV_DCC_OFF_ACK ECU_ADDRESS 0xd000363b BIT_MASK 0x1 /end MEASUREMENT
/begin MEASUREMENT lv_err_tq_loss_ars_av_can "interface bit for TQ_LOSS_ARS calculation in case of error via CAN" UBYTE _CNV_S_2_RANGE__0___1_CM 1 100. 0. 1. DISPLAY_IDENTIFIER LV_ERR_TQ_LOSS_ARS_AV_CAN ECU_ADDRESS 0xd000363e BIT_MASK 0x1 /end MEASUREMENT
/begin MEASUREMENT lv_err_tq_loss_ars_sp_can "interface bit for TQ_LOSS_ARS calculation in case of error via CAN" UBYTE _CNV_S_2_RANGE__0___1_CM 1 100. 0. 1. DISPLAY_IDENTIFIER LV_ERR_TQ_LOSS_ARS_SP_CAN ECU_ADDRESS 0xd000363d BIT_MASK 0x1 /end MEASUREMENT
/begin MEASUREMENT lv_rly_st_can "status starter relay" UBYTE _CNV_S_2_RANGE__0___1_CM 1 100. 0. 1. DISPLAY_IDENTIFIER LV_RLY_ST_CAN ECU_ADDRESS 0xd000364a BIT_MASK 0x1 /end MEASUREMENT
/begin MEASUREMENT lv_key_aux "status Kl. R" UBYTE _CNV_S_2_RANGE__0___1_CM 1 100. 0. 1. DISPLAY_IDENTIFIER LV_KEY_AUX ECU_ADDRESS 0xd000364b BIT_MASK 0x1 /end MEASUREMENT
/begin MEASUREMENT tcc_can_cas "free running test cycle counter CAS (alive counter)" UBYTE _CNV_A_R_LINEAR_____50_CM 1 100. 0. 14. DISPLAY_IDENTIFIER TCC_CAN_CAS ECU_ADDRESS 0xc0000100 FORMAT "%2.0" /end MEASUREMENT
/begin MEASUREMENT tcc_can_etcu_2 "alive counter EGS2 message" UBYTE _CNV_A_R_LINEAR_____50_CM 1 100. 0. 14. DISPLAY_IDENTIFIER TCC_CAN_ETCU_2 ECU_ADDRESS 0xd0003713 FORMAT "%2.0" /end MEASUREMENT
/begin MEASUREMENT tq_tcs_fast_bn "torque target (fast) due to TCS via CAN" SWORD _CNV_A_R_LINEAR_____30_CM 1 100. -1024. 1023.96875 DISPLAY_IDENTIFIER TQ_TCS_FAST_BN ECU_ADDRESS 0xd0004a68 FORMAT "%8.2" /end MEASUREMENT
/begin MEASUREMENT cks_can_tq_dcc "Checksum TQ_DCC from CAN" UBYTE _CNV_A_R_LINEAR_____0_CM 1 100. 0. 255. DISPLAY_IDENTIFIER CKS_CAN_TQ_DCC ECU_ADDRESS 0xc00000f3 FORMAT "%3.0" /end MEASUREMENT
/begin MEASUREMENT tcc_can_tq_dcc "free running test cycle counter TQ_DCC (alive counter)" UBYTE _CNV_A_R_LINEAR_____50_CM 1 100. 0. 14. DISPLAY_IDENTIFIER TCC_CAN_TQ_DCC ECU_ADDRESS 0xc00000f5 FORMAT "%2.0" /end MEASUREMENT
/begin MEASUREMENT tq_tcs_slow_bn "torque target (slow) due to TCS via CAN" SWORD _CNV_A_R_LINEAR_____30_CM 1 100. -1024. 1023.96875 DISPLAY_IDENTIFIER TQ_TCS_SLOW_BN ECU_ADDRESS 0xd0004a6a FORMAT "%8.2" /end MEASUREMENT
/begin MEASUREMENT tq_gs_slow_bn "torque target (slow) for GS via CAN interface" SWORD _CNV_A_R_LINEAR_____30_CM 1 100. -1024. 1023.96875 DISPLAY_IDENTIFIER TQ_GS_SLOW_BN ECU_ADDRESS 0xd0004a72 FORMAT "%8.2" /end MEASUREMENT
/begin MEASUREMENT cks_can_tq_tcs "checksum traction control system TQ_TCS from CAN" UBYTE _CNV_A_R_LINEAR_____0_CM 1 100. 0. 255. DISPLAY_IDENTIFIER CKS_CAN_TQ_TCS ECU_ADDRESS 0xc0000107 FORMAT "%3.0" /end MEASUREMENT
/begin MEASUREMENT tcc_can_tq_tcs "free running test cycle counter TQ_TCS (alive counter)" UBYTE _CNV_A_R_LINEAR_____50_CM 1 100. 0. 14. DISPLAY_IDENTIFIER TCC_CAN_TQ_TCS ECU_ADDRESS 0xc0000109 FORMAT "%2.0" /end MEASUREMENT
/begin MEASUREMENT lv_tq_dcc_inc_req "LV indicating torque increse required by DCC" UBYTE _CNV_S_2_RANGE__0___1_CM 1 100. 0. 1. DISPLAY_IDENTIFIER LV_TQ_DCC_INC_REQ ECU_ADDRESS 0xd0003638 BIT_MASK 0x1 /end MEASUREMENT
/begin MEASUREMENT tq_gs_fast_bn "torque target (fast) for GS via CAN interface " SWORD _CNV_A_R_LINEAR_____30_CM 1 100. -1024. 1023.96875 DISPLAY_IDENTIFIER TQ_GS_FAST_BN ECU_ADDRESS 0xd0004a70 FORMAT "%8.2" /end MEASUREMENT
/begin MEASUREMENT tq_amt_fast_bn "torque target (fast) for AMT via CAN interface " SWORD _CNV_A_R_LINEAR_____30_CM 1 100. -1024. 1023.96875 DISPLAY_IDENTIFIER TQ_AMT_FAST_BN ECU_ADDRESS 0xd0004a74 FORMAT "%8.2" /end MEASUREMENT
/begin MEASUREMENT tq_amt_slow_bn "torque target (slow) for AMT via CAN interface " SWORD _CNV_A_R_LINEAR_____30_CM 1 100. -1024. 1023.96875 DISPLAY_IDENTIFIER TQ_AMT_SLOW_BN ECU_ADDRESS 0xd0004a76 FORMAT "%8.2" /end MEASUREMENT
/begin MEASUREMENT cks_can_tq_etcu "check sum TQ_ETCU from CAN" UBYTE _CNV_A_R_LINEAR_____0_CM 1 100. 0. 255. DISPLAY_IDENTIFIER CKS_CAN_TQ_ETCU ECU_ADDRESS 0xc000010b FORMAT "%3.0" /end MEASUREMENT
/begin MEASUREMENT tcc_can_tq_etcu "free running test cycle counter TQ_ETCU (alive counter)" UBYTE _CNV_A_R_LINEAR_____50_CM 1 100. 0. 14. DISPLAY_IDENTIFIER TCC_CAN_TQ_ETCU ECU_ADDRESS 0xc000010d FORMAT "%2.0" /end MEASUREMENT
/begin MEASUREMENT state_etcu_obd_err "status OBD-relevamt error - ETCU" UBYTE _CNV_S_3_STATE_ETCU_51_CM 1 100. 0. 2. DISPLAY_IDENTIFIER STATE_ETCU_OBD_ERR ECU_ADDRESS 0xd0003611 /end MEASUREMENT
/begin MEASUREMENT state_amt_intv "status torque target AMT via CAN" UBYTE _CNV_S_4_STATE_ETCU_45_CM 1 100. 0. 3. DISPLAY_IDENTIFIER STATE_AMT_INTV ECU_ADDRESS 0xd0003617 /end MEASUREMENT
/begin MEASUREMENT state_acin_can "state air-conditioning request signal CAN" UBYTE _CNV_A_R_LINEAR_____0_CM 1 100. 0. 7. DISPLAY_IDENTIFIER STATE_ACIN_CAN ECU_ADDRESS 0xc0000118 FORMAT "%1.0" /end MEASUREMENT
/begin MEASUREMENT ctr_km_bn "vehicle kilometer BN reading from Kombi - for OBD" ULONG _CNV_A_R_LINEAR_____52_CM 1 100. 0. 16777215. DISPLAY_IDENTIFIER CTR_KM_BN ECU_ADDRESS 0xd00054f8 FORMAT "%8.0" /end MEASUREMENT
/begin MEASUREMENT tcc_can_tq_amt "free running test cycle counter TQ_AMT (alive counter)" UBYTE _CNV_A_R_LINEAR_____50_CM 1 100. 0. 14. DISPLAY_IDENTIFIER TCC_CAN_TQ_AMT ECU_ADDRESS 0xc0000111 FORMAT "%2.0" /end MEASUREMENT
/begin MEASUREMENT t_ctr_swi_off_vb "shutdown counter battery-main-switch" UBYTE _CNV_A_R_LINEAR_____35_CM 1 100. 0. 255. DISPLAY_IDENTIFIER T_CTR_SWI_OFF_VB ECU_ADDRESS 0xd0003622 FORMAT "%3.0" /end MEASUREMENT
/begin MEASUREMENT v_gen_tar "target generator voltage " UBYTE _CNV_R_R_spg_gencan_53_CM 1 100. 10.6 16.975 DISPLAY_IDENTIFIER V_GEN_TAR ECU_ADDRESS 0xd000361e FORMAT "%8.4" /end MEASUREMENT
/begin CHARACTERISTIC c_t_ctr_swi_off_vb_min "Threshold shutdown counter battery-main-switch" VALUE 0xa1029826 _REC_VAL_20_u1 255. _CNV_A_R_LINEAR_____35_CM 0. 255. DISPLAY_IDENTIFIER C_T_CTR_SWI_OFF_VB_MIN FORMAT "%3.0" /end CHARACTERISTIC
/begin CHARACTERISTIC c_v_sp_gen "Generator voltage (substitute value in case of  invalid signal from CAN)" VALUE 0xa1029b94 _REC_VAL_20_u1 6.375000000000003 _CNV_R_R_spg_gencan_53_CM 10.6 16.975 DISPLAY_IDENTIFIER C_V_SP_GEN FORMAT "%8.4" /end CHARACTERISTIC
/begin MEASUREMENT cks_can_tq_amt "check sum TQ_AMT from CAN" UBYTE _CNV_A_R_LINEAR_____0_CM 1 100. 0. 255. DISPLAY_IDENTIFIER CKS_CAN_TQ_AMT ECU_ADDRESS 0xc000010f FORMAT "%3.0" /end MEASUREMENT
/begin MEASUREMENT cks_can_msw "checksum MSW - SZL" UBYTE _CNV_A_R_LINEAR_____0_CM 1 100. 0. 255. DISPLAY_IDENTIFIER CKS_CAN_MSW ECU_ADDRESS 0xc0000113 FORMAT "%3.0" /end MEASUREMENT
/begin MEASUREMENT tcc_can_icl "free running test cycle counter instrument cluster (alive counter)" UBYTE _CNV_A_R_LINEAR_____50_CM 1 100. 0. 14. DISPLAY_IDENTIFIER TCC_CAN_ICL ECU_ADDRESS 0xc000011a FORMAT "%2.0" /end MEASUREMENT
/begin MEASUREMENT tcc_can_msw "alive counter MSW - SZL" UBYTE _CNV_A_R_LINEAR_____50_CM 1 100. 0. 14. DISPLAY_IDENTIFIER TCC_CAN_MSW ECU_ADDRESS 0xc0000115 FORMAT "%2.0" /end MEASUREMENT
/begin MEASUREMENT state_bn_msw "Status MSW BN (CAN)" UBYTE _CNV_S_13_STATE_BN_M_54_CM 1 100. 0. 127. DISPLAY_IDENTIFIER STATE_BN_MSW ECU_ADDRESS 0xd0003619 /end MEASUREMENT
/begin MEASUREMENT lv_err_ang_pste_can "interface bit for TQ_LOSS_PSTE calculation in case of error via CAN" UBYTE _CNV_S_2_RANGE__0___1_CM 1 100. 0. 1. DISPLAY_IDENTIFIER LV_ERR_ANG_PSTE_CAN ECU_ADDRESS 0xd0003642 BIT_MASK 0x1 /end MEASUREMENT
/begin MEASUREMENT tcc_can_ecu "free running test cycle counter ECU1 (alive counter)" UBYTE _CNV_A_R_LINEAR_____50_CM 1 100. 0. 14. DISPLAY_IDENTIFIER TCC_CAN_ECU ECU_ADDRESS 0xc000011e FORMAT "%2.0" /end MEASUREMENT
/begin MEASUREMENT tcc_can_ecu1 "free running test cycle counter ECU1 (alive counter)" UBYTE _CNV_A_R_LINEAR_____50_CM 1 100. 0. 14. DISPLAY_IDENTIFIER TCC_CAN_ECU1 ECU_ADDRESS 0xc000011f FORMAT "%2.0" /end MEASUREMENT
/begin MEASUREMENT tcc_can_ecu2 "free running test cycle counter ECU2 (alive counter)" UBYTE _CNV_A_R_LINEAR_____50_CM 1 100. 0. 14. DISPLAY_IDENTIFIER TCC_CAN_ECU2 ECU_ADDRESS 0xc0000120 FORMAT "%2.0" /end MEASUREMENT
/begin MEASUREMENT tcc_can_ecu3 "free running test cycle counter ECU3 (alive counter)" UBYTE _CNV_A_R_LINEAR_____50_CM 1 100. 0. 14. DISPLAY_IDENTIFIER TCC_CAN_ECU3 ECU_ADDRESS 0xc0000121 FORMAT "%2.0" /end MEASUREMENT
/begin CHARACTERISTIC c_icl_disp_frq "calibratable constant for display messages on ICL" VALUE 0xa102949e _REC_VAL_20_u1 3. _CNV_A_R_LINEAR_____0_CM 0. 3. DISPLAY_IDENTIFIER C_ICL_DISP_FRQ FORMAT "%2.0" /end CHARACTERISTIC
/begin MEASUREMENT cks_can_cas "check sum CAS from CAN" UBYTE _CNV_A_R_LINEAR_____0_CM 1 100. 0. 255. DISPLAY_IDENTIFIER CKS_CAN_CAS ECU_ADDRESS 0xc00000fe FORMAT "%3.0" /end MEASUREMENT
/begin MEASUREMENT cks_clc_cas "check sum CAS" UBYTE _CNV_A_R_LINEAR_____0_CM 1 100. 0. 255. DISPLAY_IDENTIFIER CKS_CLC_CAS ECU_ADDRESS 0xc00000ff FORMAT "%3.0" /end MEASUREMENT
/begin MEASUREMENT cks_can_etcu_2 "CKS CAN EGS2 message" UBYTE _CNV_A_R_LINEAR_____0_CM 1 100. 0. 255. DISPLAY_IDENTIFIER CKS_CAN_ETCU_2 ECU_ADDRESS 0xd0003751 FORMAT "%3.0" /end MEASUREMENT
/begin MEASUREMENT cks_clc_etcu_2 "calculated CKS EGS2 message" UBYTE _CNV_A_R_LINEAR_____0_CM 1 100. 0. 255. DISPLAY_IDENTIFIER CKS_CLC_ETCU_2 ECU_ADDRESS 0xd0003752 FORMAT "%3.0" /end MEASUREMENT
/begin MEASUREMENT cks_clc_tq_dcc "check sum TQ_DCC" UBYTE _CNV_A_R_LINEAR_____0_CM 1 100. 0. 255. DISPLAY_IDENTIFIER CKS_CLC_TQ_DCC ECU_ADDRESS 0xc00000f4 FORMAT "%3.0" /end MEASUREMENT
/begin MEASUREMENT cks_clc_tq_tcs "check sum TQ_TCS" UBYTE _CNV_A_R_LINEAR_____0_CM 1 100. 0. 255. DISPLAY_IDENTIFIER CKS_CLC_TQ_TCS ECU_ADDRESS 0xc0000108 FORMAT "%3.0" /end MEASUREMENT
/begin MEASUREMENT cks_clc_tq_etcu "check sum TQ_ETCU" UBYTE _CNV_A_R_LINEAR_____0_CM 1 100. 0. 255. DISPLAY_IDENTIFIER CKS_CLC_TQ_ETCU ECU_ADDRESS 0xc000010c FORMAT "%3.0" /end MEASUREMENT
/begin MEASUREMENT cks_clc_tq_amt "check sum TQ_AMT" UBYTE _CNV_A_R_LINEAR_____0_CM 1 100. 0. 255. DISPLAY_IDENTIFIER CKS_CLC_TQ_AMT ECU_ADDRESS 0xc0000110 FORMAT "%3.0" /end MEASUREMENT
/begin MEASUREMENT cks_clc_msw "check sum CRU (SZL)" UBYTE _CNV_A_R_LINEAR_____0_CM 1 100. 0. 255. DISPLAY_IDENTIFIER CKS_CLC_MSW ECU_ADDRESS 0xc0000114 FORMAT "%3.0" /end MEASUREMENT
/begin MEASUREMENT cks_clc_ecu1 "check sum ECU 1" UBYTE _CNV_A_R_LINEAR_____0_CM 1 100. 0. 255. DISPLAY_IDENTIFIER CKS_CLC_ECU1 ECU_ADDRESS 0xc0000122 FORMAT "%3.0" /end MEASUREMENT
/begin MEASUREMENT cks_clc_ecu2 "check sum ECU 2" UBYTE _CNV_A_R_LINEAR_____0_CM 1 100. 0. 255. DISPLAY_IDENTIFIER CKS_CLC_ECU2 ECU_ADDRESS 0xc0000123 FORMAT "%3.0" /end MEASUREMENT
/begin MEASUREMENT cks_clc_ecu3 "check sum ECU 3" UBYTE _CNV_A_R_LINEAR_____0_CM 1 100. 0. 255. DISPLAY_IDENTIFIER CKS_CLC_ECU3 ECU_ADDRESS 0xc0000124 FORMAT "%3.0" /end MEASUREMENT
/begin MEASUREMENT tcc_can_ars "free running test cycle counter ARS (alive counter)" UBYTE _CNV_A_R_LINEAR_____50_CM 1 100. 0. 14. DISPLAY_IDENTIFIER TCC_CAN_ARS ECU_ADDRESS 0xc00000fb FORMAT "%2.0" /end MEASUREMENT
/begin MEASUREMENT lv_etcu_lih_can "logical value gear box limp home" UBYTE _CNV_S_2_RANGE__0___1_CM 1 100. 0. 1. DISPLAY_IDENTIFIER LV_ETCU_LIH_CAN ECU_ADDRESS 0xd0003640 BIT_MASK 0x1 /end MEASUREMENT
/begin MEASUREMENT lv_etcu_lih_can_1 "logical value gear box limp home" UBYTE _CNV_S_2_RANGE__0___1_CM 1 100. 0. 1. DISPLAY_IDENTIFIER LV_ETCU_LIH_CAN_1 ECU_ADDRESS 0xc00001b0 BIT_MASK 0x1 /end MEASUREMENT
/begin MEASUREMENT lv_etcu_lih_can_2 "logical value gear box limp home" UBYTE _CNV_S_2_RANGE__0___1_CM 1 100. 0. 1. DISPLAY_IDENTIFIER LV_ETCU_LIH_CAN_2 ECU_ADDRESS 0xc00001b1 BIT_MASK 0x1 /end MEASUREMENT
/begin MEASUREMENT lv_amt_lih_can "logical variable AMT intervention limp home" UBYTE _CNV_S_2_RANGE__0___1_CM 1 100. 0. 1. DISPLAY_IDENTIFIER LV_AMT_LIH_CAN ECU_ADDRESS 0xd0003641 BIT_MASK 0x1 /end MEASUREMENT
/begin MEASUREMENT state_st_tq_lim_gs "State starting torque limitation" UBYTE _CNV_S_3_STATE_ST_T_55_CM 1 100. 0. 3. DISPLAY_IDENTIFIER STATE_ST_TQ_LIM_GS ECU_ADDRESS 0xd0003616 /end MEASUREMENT
/begin MEASUREMENT state_st_tq_lim_amt "State starting torque limitation for AMT" UBYTE _CNV_S_3_STATE_ST_T_55_CM 1 100. 0. 3. DISPLAY_IDENTIFIER STATE_ST_TQ_LIM_AMT ECU_ADDRESS 0xd0003618 /end MEASUREMENT
/begin MEASUREMENT lv_var_etcu "BN(SSG or EGS)-transmission recognized" UBYTE _CNV_S_2_RANGE__0___1_CM 1 100. 0. 1. DISPLAY_IDENTIFIER LV_VAR_ETCU ECU_ADDRESS 0xd0003bff BIT_MASK 0x1 /end MEASUREMENT
/begin MEASUREMENT lv_var_efp_crash "EFP crash message detected" UBYTE _CNV_S_2_RANGE__0___1_CM 1 100. 0. 1. DISPLAY_IDENTIFIER LV_VAR_EFP_CRASH ECU_ADDRESS 0xd0003c02 BIT_MASK 0x1 /end MEASUREMENT
/begin MEASUREMENT lv_var_bn_msw "LV cruise control detected - BN2000" UBYTE _CNV_S_2_RANGE__0___1_CM 1 100. 0. 1. DISPLAY_IDENTIFIER LV_VAR_BN_MSW ECU_ADDRESS 0xd0003bfd BIT_MASK 0x1 /end MEASUREMENT
/begin MEASUREMENT lv_var_dcc "LV distance cruise control detected - BN2000" UBYTE _CNV_S_2_RANGE__0___1_CM 1 100. 0. 1. DISPLAY_IDENTIFIER LV_VAR_DCC ECU_ADDRESS 0xd0003bfe BIT_MASK 0x1 /end MEASUREMENT
/begin MEASUREMENT lv_var_ars "LV anti-roll-stabilisation detected - BN2000" UBYTE _CNV_S_2_RANGE__0___1_CM 1 100. 0. 1. DISPLAY_IDENTIFIER LV_VAR_ARS ECU_ADDRESS 0xd0003bfc BIT_MASK 0x1 /end MEASUREMENT
/begin MEASUREMENT state_veh_mod "vehicle mode" UBYTE _CNV_A_R_LINEAR_____0_CM 1 100. 0. 15. DISPLAY_IDENTIFIER STATE_VEH_MOD ECU_ADDRESS 0xd00035fb FORMAT "%2.0" /end MEASUREMENT
/begin CHARACTERISTIC c_cc_mess "ID2 check-control message standard ID2_CC_MESS_STD (Standard CC-report)" VALUE 0xa10291b2 _REC_VAL_20_u1 255. _CNV_A_R_LINEAR_____0_CM 0. 255. DISPLAY_IDENTIFIER C_CC_MESS FORMAT "%3.0" /end CHARACTERISTIC
/begin MEASUREMENT state_vs_icl_disp "status scaling of speedometer (displayed vehicle speed)" UBYTE _CNV_S_3_STATE_VS_I_56_CM 1 100. 0. 3. DISPLAY_IDENTIFIER STATE_VS_ICL_DISP ECU_ADDRESS 0xd00035f0 /end MEASUREMENT
/begin MEASUREMENT tcc_can_veh_mod "free running test cycle counter VEH_MOD (alive counter)" UBYTE _CNV_A_R_LINEAR_____50_CM 1 100. 0. 14. DISPLAY_IDENTIFIER TCC_CAN_VEH_MOD ECU_ADDRESS 0xc0000104 FORMAT "%2.0" /end MEASUREMENT
/begin MEASUREMENT cks_can_veh_mod "check sum VEH_MOD from CAN" UBYTE _CNV_A_R_LINEAR_____0_CM 1 100. 0. 255. DISPLAY_IDENTIFIER CKS_CAN_VEH_MOD ECU_ADDRESS 0xc0000102 FORMAT "%3.0" /end MEASUREMENT
/begin MEASUREMENT state_if_icl_bn_msw "status interface ICL/cruise control" UBYTE _CNV_A_R_LINEAR_____0_CM 1 100. 0. 7. DISPLAY_IDENTIFIER STATE_IF_ICL_BN_MSW ECU_ADDRESS 0xd00035f1 FORMAT "%1.0" /end MEASUREMENT
/begin MEASUREMENT cc_id "Checkcontrol ID" UWORD _CNV_A_R_LINEAR_____0_CM 1 100. 0. 65535. DISPLAY_IDENTIFIER CC_ID ECU_ADDRESS 0xc00000b4 FORMAT "%5.0" /end MEASUREMENT
/begin MEASUREMENT lv_mil_fll "bit for MIL flash light" UBYTE _CNV_S_2_RANGE__0___1_CM 1 100. 0. 1. DISPLAY_IDENTIFIER LV_MIL_FLL ECU_ADDRESS 0xc000013c BIT_MASK 0x1 /end MEASUREMENT
/begin CHARACTERISTIC c_tq_accin "Minimum torque ACCIN" VALUE 0xa1029ad6 _REC_VAL_20_u1 127. _CNV_A_R_LINEAR_____57_CM 0. 127. DISPLAY_IDENTIFIER C_TQ_ACCIN FORMAT "%5.1" /end CHARACTERISTIC
/begin MEASUREMENT tq_ems_bn "actual engine torque - driver's choice (converted for BN)" SWORD _CNV_A_R_LINEAR_____30_CM 1 100. -1024. 1023.96875 DISPLAY_IDENTIFIER TQ_EMS_BN ECU_ADDRESS 0xc00000b2 FORMAT "%8.2" /end MEASUREMENT
/begin MEASUREMENT tq_maf "actual engine torque - spare, positive (converted for BN)" SWORD _CNV_A_R_LINEAR_____30_CM 1 100. -1024. 1023.96875 DISPLAY_IDENTIFIER TQ_MAF ECU_ADDRESS 0xc00000ac FORMAT "%8.2" /end MEASUREMENT
/begin CHARACTERISTIC c_n_32_thd_cc_poil_swi "N_32-Threshold for activating CC-message LV_POIL_SWI" VALUE 0xa10295d1 _REC_VAL_20_u1 8160. _CNV_A_R_LINEAR_____9_CM 0. 8160. DISPLAY_IDENTIFIER C_N_32_THD_CC_POIL_SWI FORMAT "%4.0" /end CHARACTERISTIC
/begin CHARACTERISTIC ip_t_dly_poil_swi_can__toil "Delay-time for first activation of CC-message LV_POIL_SWI" CURVE 0xa1027c3c _REC_CUR_20_u2_u1 6553.5 _CNV_A_R_LINEAR_____4_CM 0. 6553.5 DISPLAY_IDENTIFIER IP_T_DLY_POIL_SWI_CAN__TOIL FORMAT "%6.1"
 /begin AXIS_DESCR COM_AXIS toil _CNV_A_R_LINEAR_____25_CM 6 -40. 160. FORMAT "%3.0" AXIS_PTS_REF ldp_toil__t_dly_poil_swi_can /end AXIS_DESCR
/end CHARACTERISTIC
/begin AXIS_PTS ldp_toil__t_dly_poil_swi_can "" 0xa10213f0 toil _REC_AXS_20_u1 200. _CNV_A_R_LINEAR_____25_CM 6 -40. 160. FORMAT "%3.0" /end AXIS_PTS
/begin CHARACTERISTIC c_n_sp_is_thd_can "engine speed setpoint threshold for reconition of ST_SW_LEV_RPM condition" VALUE 0xa1029660 _REC_VAL_20_u2 8159. _CNV_A_R_LINEAR_____13_CM 1. 8160. DISPLAY_IDENTIFIER C_N_SP_IS_THD_CAN FORMAT "%4.0" /end CHARACTERISTIC
/begin MEASUREMENT tcc_can_tq_pste_2 "free running test cycle counter TQ_PSTE_2 (alive counter)" UBYTE _CNV_A_R_LINEAR_____50_CM 1 100. 0. 14. DISPLAY_IDENTIFIER TCC_CAN_TQ_PSTE_2 ECU_ADDRESS 0xc00000f9 FORMAT "%2.0" /end MEASUREMENT
/begin MEASUREMENT cks_can_tq_pste_2 "Checksum TQ_PSTE_2 from CAN" UBYTE _CNV_A_R_LINEAR_____0_CM 1 100. 0. 255. DISPLAY_IDENTIFIER CKS_CAN_TQ_PSTE_2 ECU_ADDRESS 0xc00000f7 FORMAT "%3.0" /end MEASUREMENT
/begin MEASUREMENT state_pste_2_intv "status torque target PSTE_2 via CAN interface" UBYTE _CNV_S_4_STATE_PSTE_58_CM 1 100. 0. 3. DISPLAY_IDENTIFIER STATE_PSTE_2_INTV ECU_ADDRESS 0xd00035f7 /end MEASUREMENT
/begin MEASUREMENT tq_loss_pste_2_av_can "torque loss actual value PSTE_2 from CAN" SWORD _CNV_A_R_LINEAR_____30_CM 1 100. -1024. 1023.96875 DISPLAY_IDENTIFIER TQ_LOSS_PSTE_2_AV_CAN ECU_ADDRESS 0xd0004a60 FORMAT "%8.2" /end MEASUREMENT
/begin MEASUREMENT tq_loss_pste_2_sp_can "torque loss setpoint PSTE_2 from CAN" SWORD _CNV_A_R_LINEAR_____30_CM 1 100. -1024. 1023.96875 DISPLAY_IDENTIFIER TQ_LOSS_PSTE_2_SP_CAN ECU_ADDRESS 0xd0004a62 FORMAT "%8.2" /end MEASUREMENT
/begin MEASUREMENT lv_pste_2_err "LV indicating AFS error (sent by AFS via CAN)" UBYTE _CNV_S_2_RANGE__0___1_CM 1 100. 0. 1. DISPLAY_IDENTIFIER LV_PSTE_2_ERR ECU_ADDRESS 0xd0003645 BIT_MASK 0x1 /end MEASUREMENT
/begin MEASUREMENT state_brake_prs "status brake pressure via CAN" UBYTE _CNV_A_R_LINEAR_____0_CM 1 100. 0. 3. DISPLAY_IDENTIFIER STATE_BRAKE_PRS ECU_ADDRESS 0xd000361b FORMAT "%1.0" /end MEASUREMENT
/begin MEASUREMENT cks_clc_tq_pste_2 "check sum TQ_PSTE_2" UBYTE _CNV_A_R_LINEAR_____0_CM 1 100. 0. 255. DISPLAY_IDENTIFIER CKS_CLC_TQ_PSTE_2 ECU_ADDRESS 0xc00000f8 FORMAT "%3.0" /end MEASUREMENT
/begin MEASUREMENT lv_var_pste_2 "LV power steering detected - BN2000" UBYTE _CNV_S_2_RANGE__0___1_CM 1 100. 0. 1. DISPLAY_IDENTIFIER LV_VAR_PSTE_2 ECU_ADDRESS 0xd0003c00 BIT_MASK 0x1 /end MEASUREMENT
/begin MEASUREMENT state_cru_bn "Status of Cruise Control for BN-CAN" UBYTE _CNV_A_R_LINEAR_____0_CM 1 100. 0. 255. DISPLAY_IDENTIFIER STATE_CRU_BN ECU_ADDRESS 0xc0000125 FORMAT "%3.0" /end MEASUREMENT
/begin CHARACTERISTIC lc_msr_bn "LC for allowing MSR-intervention in case of TQ_TCS_FAST_BN <> TQ_TCS_SLOW_BN by DSC" VALUE 0xa1029d7d _REC_VAL_20_u1 1. _CNV_A_R_LINEAR_____0_CM 0. 1. DISPLAY_IDENTIFIER LC_MSR_BN FORMAT "%2.0" /end CHARACTERISTIC
/begin MEASUREMENT nr_vs_cru_if "current vehicle speed step via CAN" UBYTE _CNV_A_R_LINEAR_____0_CM 1 100. 0. 15. DISPLAY_IDENTIFIER NR_VS_CRU_IF ECU_ADDRESS 0xd0003623 FORMAT "%2.0" /end MEASUREMENT
/begin MEASUREMENT vs_step_if[0] "vehicle speed step from CAN" UWORD _CNV_A_R_LINEAR_____44_CM 1 100. 0. 409.4 DISPLAY_IDENTIFIER VS_STEP_IF_1 ECU_ADDRESS 0xd0004a7e FORMAT "%5.1" /end MEASUREMENT
/begin MEASUREMENT vs_step_if[1] "vehicle speed step from CAN" UWORD _CNV_A_R_LINEAR_____44_CM 1 100. 0. 409.4 DISPLAY_IDENTIFIER VS_STEP_IF_2 ECU_ADDRESS 0xd0004a80 FORMAT "%5.1" /end MEASUREMENT
/begin MEASUREMENT vs_step_if[2] "vehicle speed step from CAN" UWORD _CNV_A_R_LINEAR_____44_CM 1 100. 0. 409.4 DISPLAY_IDENTIFIER VS_STEP_IF_3 ECU_ADDRESS 0xd0004a82 FORMAT "%5.1" /end MEASUREMENT
/begin MEASUREMENT lv_msg_prog_step_cru "message of “Programmierung Stufentempomat” received" UBYTE _CNV_S_2_RANGE__0___1_CM 1 100. 0. 1. DISPLAY_IDENTIFIER LV_MSG_PROG_STEP_CRU ECU_ADDRESS 0xd0003646 BIT_MASK 0x1 /end MEASUREMENT
/begin CHARACTERISTIC lc_ena_cc_mil_1 "" VALUE 0xa1029d25 _REC_VAL_20_u1 1. _CNV_A_R_LINEAR_____0_CM 0. 1. DISPLAY_IDENTIFIER LC_ENA_CC_MIL_1 FORMAT "%2.0" /end CHARACTERISTIC
/begin CHARACTERISTIC lc_ena_cc_mil_2 "" VALUE 0xa1029d26 _REC_VAL_20_u1 1. _CNV_A_R_LINEAR_____0_CM 0. 1. DISPLAY_IDENTIFIER LC_ENA_CC_MIL_2 FORMAT "%2.0" /end CHARACTERISTIC
/begin MEASUREMENT lv_ltg_hdlp_l_on "state low beam: 0 off, 1 on" UBYTE _CNV_S_2_RANGE__0___1_CM 1 100. 0. 1. DISPLAY_IDENTIFIER LV_LTG_HDLP_L_ON ECU_ADDRESS 0xd000364c BIT_MASK 0x1 /end MEASUREMENT
/begin MEASUREMENT lv_ltg_inl_on "state interior lighting: 0 off, 1 on" UBYTE _CNV_S_2_RANGE__0___1_CM 1 100. 0. 1. DISPLAY_IDENTIFIER LV_LTG_INL_ON ECU_ADDRESS 0xd000364d BIT_MASK 0x1 /end MEASUREMENT
/begin MEASUREMENT opg_value_hiv_perc "status aperture water valve" UBYTE _CNV_A_R_LINEAR_____5_CM 1 100. 0. 99.609375 DISPLAY_IDENTIFIER OPG_VALUE_HIV_PERC ECU_ADDRESS 0xd00035fe FORMAT "%5.1" /end MEASUREMENT
/begin MEASUREMENT state_hiv "state water valve" UBYTE _CNV_A_R_LINEAR_____0_CM 1 100. 0. 15. DISPLAY_IDENTIFIER STATE_HIV ECU_ADDRESS 0xd00035ff FORMAT "%2.0" /end MEASUREMENT
/begin MEASUREMENT heat_req_perc "request heat flow" UBYTE _CNV_A_R_LINEAR_____59_CM 1 100. 0. 100. DISPLAY_IDENTIFIER HEAT_REQ_PERC ECU_ADDRESS 0xd00035fc FORMAT "%5.1" /end MEASUREMENT
/begin CHARACTERISTIC c_state_cc_id_34 "sending-condition for CC-message (e.g. LV_IGK, LV_KEY_AUX, etc.)" VALUE 0xa10297ab _REC_VAL_20_u1 15. _CNV_A_R_LINEAR_____0_CM 0. 15. DISPLAY_IDENTIFIER C_STATE_CC_ID_34 FORMAT "%2.0" /end CHARACTERISTIC
/begin CHARACTERISTIC c_state_cc_id_33 "sending-condition for CC-message (e.g. LV_IGK, LV_KEY_AUX, etc.)" VALUE 0xa10297aa _REC_VAL_20_u1 15. _CNV_A_R_LINEAR_____0_CM 0. 15. DISPLAY_IDENTIFIER C_STATE_CC_ID_33 FORMAT "%2.0" /end CHARACTERISTIC
/begin CHARACTERISTIC c_state_cc_id_257 "sending-condition for CC-message (e.g. LV_IGK, LV_KEY_AUX, etc.)" VALUE 0xa102979e _REC_VAL_20_u1 15. _CNV_A_R_LINEAR_____0_CM 0. 15. DISPLAY_IDENTIFIER C_STATE_CC_ID_257 FORMAT "%2.0" /end CHARACTERISTIC
/begin CHARACTERISTIC c_state_cc_id_39 "sending-condition for CC-message (e.g. LV_IGK, LV_KEY_AUX, etc.)" VALUE 0xa10297ac _REC_VAL_20_u1 15. _CNV_A_R_LINEAR_____0_CM 0. 15. DISPLAY_IDENTIFIER C_STATE_CC_ID_39 FORMAT "%2.0" /end CHARACTERISTIC
/begin CHARACTERISTIC c_state_cc_id_212 "sending-condition for CC-message (e.g. LV_IGK, LV_KEY_AUX, etc.)" VALUE 0xa1029799 _REC_VAL_20_u1 15. _CNV_A_R_LINEAR_____0_CM 0. 15. DISPLAY_IDENTIFIER C_STATE_CC_ID_212 FORMAT "%2.0" /end CHARACTERISTIC
/begin CHARACTERISTIC c_state_cc_id_213 "sending-condition for CC-message (e.g. LV_IGK, LV_KEY_AUX, etc.)" VALUE 0xa102979a _REC_VAL_20_u1 15. _CNV_A_R_LINEAR_____0_CM 0. 15. DISPLAY_IDENTIFIER C_STATE_CC_ID_213 FORMAT "%2.0" /end CHARACTERISTIC
/begin CHARACTERISTIC c_state_cc_id_26 "sending-condition for CC-message (e.g. LV_IGK, LV_KEY_AUX, etc.)" VALUE 0xa102979f _REC_VAL_20_u1 15. _CNV_A_R_LINEAR_____0_CM 0. 15. DISPLAY_IDENTIFIER C_STATE_CC_ID_26 FORMAT "%2.0" /end CHARACTERISTIC
/begin CHARACTERISTIC c_state_cc_id_28 "sending-condition for CC-message (e.g. LV_IGK, LV_KEY_AUX, etc.)" VALUE 0xa10297a3 _REC_VAL_20_u1 15. _CNV_A_R_LINEAR_____0_CM 0. 15. DISPLAY_IDENTIFIER C_STATE_CC_ID_28 FORMAT "%2.0" /end CHARACTERISTIC
/begin CHARACTERISTIC c_state_cc_id_29 "sending-condition for CC-message (e.g. LV_IGK, LV_KEY_AUX, etc.)" VALUE 0xa10297a4 _REC_VAL_20_u1 15. _CNV_A_R_LINEAR_____0_CM 0. 15. DISPLAY_IDENTIFIER C_STATE_CC_ID_29 FORMAT "%2.0" /end CHARACTERISTIC
/begin CHARACTERISTIC c_state_cc_id_31 "sending-condition for CC-message (e.g. LV_IGK, LV_KEY_AUX, etc.)" VALUE 0xa10297a8 _REC_VAL_20_u1 15. _CNV_A_R_LINEAR_____0_CM 0. 15. DISPLAY_IDENTIFIER C_STATE_CC_ID_31 FORMAT "%2.0" /end CHARACTERISTIC
/begin CHARACTERISTIC c_state_cc_id_155 "sending-condition for CC-message (e.g. LV_IGK, LV_KEY_AUX, etc.)" VALUE 0xa1029797 _REC_VAL_20_u1 15. _CNV_A_R_LINEAR_____0_CM 0. 15. DISPLAY_IDENTIFIER C_STATE_CC_ID_155 FORMAT "%2.0" /end CHARACTERISTIC
/begin CHARACTERISTIC c_state_cc_id_27 "sending-condition for CC-message (e.g. LV_IGK, LV_KEY_AUX, etc.)" VALUE 0xa10297a0 _REC_VAL_20_u1 15. _CNV_A_R_LINEAR_____0_CM 0. 15. DISPLAY_IDENTIFIER C_STATE_CC_ID_27 FORMAT "%2.0" /end CHARACTERISTIC
/begin CHARACTERISTIC c_state_cc_id_32 "sending-condition for CC-message (e.g. LV_IGK, LV_KEY_AUX, etc.)" VALUE 0xa10297a9 _REC_VAL_20_u1 15. _CNV_A_R_LINEAR_____0_CM 0. 15. DISPLAY_IDENTIFIER C_STATE_CC_ID_32 FORMAT "%2.0" /end CHARACTERISTIC
/begin CHARACTERISTIC c_state_cc_id_182 "sending-condition for CC-message (e.g. LV_IGK, LV_KEY_AUX, etc.)" VALUE 0xa1029798 _REC_VAL_20_u1 15. _CNV_A_R_LINEAR_____0_CM 0. 15. DISPLAY_IDENTIFIER C_STATE_CC_ID_182 FORMAT "%2.0" /end CHARACTERISTIC
/begin CHARACTERISTIC c_state_cc_id_229 "sending-condition for CC-message (e.g. LV_IGK, LV_KEY_AUX, etc.)" VALUE 0xa102979c _REC_VAL_20_u1 15. _CNV_A_R_LINEAR_____0_CM 0. 15. DISPLAY_IDENTIFIER C_STATE_CC_ID_229 FORMAT "%2.0" /end CHARACTERISTIC
/begin CHARACTERISTIC c_state_cc_id_247 "sending-condition for CC-message (e.g. LV_IGK, LV_KEY_AUX, etc.)" VALUE 0xa102979d _REC_VAL_20_u1 15. _CNV_A_R_LINEAR_____0_CM 0. 15. DISPLAY_IDENTIFIER C_STATE_CC_ID_247 FORMAT "%2.0" /end CHARACTERISTIC
/begin CHARACTERISTIC c_state_cc_id_220 "sending-condition for CC-message (e.g. LV_IGK, LV_KEY_AUX, etc.)" VALUE 0xa102979b _REC_VAL_20_u1 15. _CNV_A_R_LINEAR_____0_CM 0. 15. DISPLAY_IDENTIFIER C_STATE_CC_ID_220 FORMAT "%2.0" /end CHARACTERISTIC
/begin CHARACTERISTIC c_state_cc_id_304 "sending-condition for CC-message (e.g. LV_IGK, LV_KEY_AUX, etc.)" VALUE 0xa10297a5 _REC_VAL_20_u1 15. _CNV_A_R_LINEAR_____0_CM 0. 15. DISPLAY_IDENTIFIER C_STATE_CC_ID_304 FORMAT "%2.0" /end CHARACTERISTIC
/begin CHARACTERISTIC c_state_cc_id_305 "sending-condition for CC-message (e.g. LV_IGK, LV_KEY_AUX, etc.)" VALUE 0xa10297a6 _REC_VAL_20_u1 15. _CNV_A_R_LINEAR_____0_CM 0. 15. DISPLAY_IDENTIFIER C_STATE_CC_ID_305 FORMAT "%2.0" /end CHARACTERISTIC
/begin CHARACTERISTIC c_state_cc_id_306 "sending-condition for CC-message (e.g. LV_IGK, LV_KEY_AUX, etc.)" VALUE 0xa10297a7 _REC_VAL_20_u1 15. _CNV_A_R_LINEAR_____0_CM 0. 15. DISPLAY_IDENTIFIER C_STATE_CC_ID_306 FORMAT "%2.0" /end CHARACTERISTIC
/begin CHARACTERISTIC c_state_cc_id_148 "sending-condition for CC-message (e.g. LV_IGK, LV_KEY_AUX, etc.)" VALUE 0xa1029796 _REC_VAL_20_u1 15. _CNV_A_R_LINEAR_____0_CM 0. 15. DISPLAY_IDENTIFIER C_STATE_CC_ID_148 FORMAT "%2.0" /end CHARACTERISTIC
/begin CHARACTERISTIC c_state_cc_id_276 "sending-condition for CC-message (e.g. LV_IGK, LV_KEY_AUX, etc.)" VALUE 0xa10297a1 _REC_VAL_20_u1 15. _CNV_A_R_LINEAR_____0_CM 0. 15. DISPLAY_IDENTIFIER C_STATE_CC_ID_276 FORMAT "%2.0" /end CHARACTERISTIC
/begin CHARACTERISTIC c_state_cc_id_278 "sending-condition for CC-message (e.g. LV_IGK, LV_KEY_AUX, etc.)" VALUE 0xa10297a2 _REC_VAL_20_u1 15. _CNV_A_R_LINEAR_____0_CM 0. 15. DISPLAY_IDENTIFIER C_STATE_CC_ID_278 FORMAT "%2.0" /end CHARACTERISTIC
/begin MEASUREMENT state_cc_key "CC-message transmission-condition ID xx " UBYTE _CNV_A_R_LINEAR_____0_CM 1 100. 0. 15. DISPLAY_IDENTIFIER STATE_CC_KEY ECU_ADDRESS 0xc000012a FORMAT "%2.0" /end MEASUREMENT
/begin MEASUREMENT state_dcc_ctl "Status DCC control" UBYTE _CNV_A_R_LINEAR_____0_CM 1 100. 0. 7. DISPLAY_IDENTIFIER STATE_DCC_CTL ECU_ADDRESS 0xd00035f6 FORMAT "%1.0" /end MEASUREMENT
/begin MEASUREMENT state_di_puc "state disable pull cut off" UBYTE _CNV_A_R_LINEAR_____0_CM 1 100. 0. 3. DISPLAY_IDENTIFIER STATE_DI_PUC ECU_ADDRESS 0xd0003600 FORMAT "%1.0" /end MEASUREMENT
/begin MEASUREMENT state_sp_dyn_wheel "state follow dynamic" UBYTE _CNV_A_R_LINEAR_____0_CM 1 100. 0. 255. DISPLAY_IDENTIFIER STATE_SP_DYN_WHEEL ECU_ADDRESS 0xd0003601 FORMAT "%3.0" /end MEASUREMENT
/begin MEASUREMENT tq_wheel_ldm_bn "Torque request by ldm" SWORD _CNV_A_R_LINEAR_____60_CM 1 100. -32768. 32767. DISPLAY_IDENTIFIER TQ_WHEEL_LDM_BN ECU_ADDRESS 0xd0004a84 FORMAT "%6.0" /end MEASUREMENT
/begin MEASUREMENT tcc_can_ldm "free running test cycle counter TQ_DCC (alive counter)" UBYTE _CNV_A_R_LINEAR_____50_CM 1 100. 0. 14. DISPLAY_IDENTIFIER TCC_CAN_LDM ECU_ADDRESS 0xc0000132 FORMAT "%2.0" /end MEASUREMENT
/begin MEASUREMENT cks_can_ldm "Checksum LDM from CAN" UBYTE _CNV_A_R_LINEAR_____0_CM 1 100. 0. 255. DISPLAY_IDENTIFIER CKS_CAN_LDM ECU_ADDRESS 0xc0000130 FORMAT "%3.0" /end MEASUREMENT
/begin MEASUREMENT cks_clc_ldm "Checksum LDM" UBYTE _CNV_A_R_LINEAR_____0_CM 1 100. 0. 255. DISPLAY_IDENTIFIER CKS_CLC_LDM ECU_ADDRESS 0xc0000131 FORMAT "%3.0" /end MEASUREMENT
/begin MEASUREMENT cks_clc_tq_wheel_1 "check sum TQ_WHEEL_1" UBYTE _CNV_A_R_LINEAR_____0_CM 1 100. 0. 255. DISPLAY_IDENTIFIER CKS_CLC_TQ_WHEEL_1 ECU_ADDRESS 0xc0000136 FORMAT "%3.0" /end MEASUREMENT
/begin MEASUREMENT cks_clc_tq_wheel_2 "check sum TQ_WHEEL_2" UBYTE _CNV_A_R_LINEAR_____0_CM 1 100. 0. 255. DISPLAY_IDENTIFIER CKS_CLC_TQ_WHEEL_2 ECU_ADDRESS 0xc0000137 FORMAT "%3.0" /end MEASUREMENT
/begin MEASUREMENT tcc_can_tq_wheel_1 "free running test cycle counter TQ_WHEEL_1 (alive counter)" UBYTE _CNV_A_R_LINEAR_____50_CM 1 100. 0. 14. DISPLAY_IDENTIFIER TCC_CAN_TQ_WHEEL_1 ECU_ADDRESS 0xc0000134 FORMAT "%2.0" /end MEASUREMENT
/begin MEASUREMENT tcc_can_tq_wheel_2 "free running test cycle counter TQ_WHEEL_2 (alive counter)" UBYTE _CNV_A_R_LINEAR_____50_CM 1 100. 0. 14. DISPLAY_IDENTIFIER TCC_CAN_TQ_WHEEL_2 ECU_ADDRESS 0xc0000135 FORMAT "%2.0" /end MEASUREMENT
/begin MEASUREMENT fac_gb_gain "Gear Box Gain" UWORD _CNV_A_R_LINEAR_____61_CM 1 100. 0. 8191.75 DISPLAY_IDENTIFIER FAC_GB_GAIN ECU_ADDRESS 0xd0004a86 FORMAT "%6.1" /end MEASUREMENT
/begin MEASUREMENT state_pow_clas_veh "status vehicle power class via CAN" UBYTE _CNV_A_R_LINEAR_____0_CM 1 100. 0. 3. DISPLAY_IDENTIFIER STATE_POW_CLAS_VEH ECU_ADDRESS 0xd0003606 FORMAT "%1.0" /end MEASUREMENT
/begin MEASUREMENT t_clk_icl_disp_1 "Display of date (day)" UBYTE _CNV_A_R_LINEAR_____0_CM 1 100. 0. 255. DISPLAY_IDENTIFIER T_CLK_ICL_DISP_1 ECU_ADDRESS 0xd0003604 FORMAT "%3.0" /end MEASUREMENT
/begin MEASUREMENT t_clk_icl_disp_2 "Display of date (month)" UBYTE _CNV_A_R_LINEAR_____0_CM 1 100. 0. 255. DISPLAY_IDENTIFIER T_CLK_ICL_DISP_2 ECU_ADDRESS 0xd0003605 FORMAT "%3.0" /end MEASUREMENT
/begin MEASUREMENT t_clk_icl_disp_3 "Display of date (year)" UWORD _CNV_A_R_LINEAR_____0_CM 1 100. 0. 65535. DISPLAY_IDENTIFIER T_CLK_ICL_DISP_3 ECU_ADDRESS 0xd0004a88 FORMAT "%5.0" /end MEASUREMENT
/begin MEASUREMENT lv_state_trl "state trailer: 0 off, 1 on" UBYTE _CNV_S_2_RANGE__0___1_CM 1 100. 0. 1. DISPLAY_IDENTIFIER LV_STATE_TRL ECU_ADDRESS 0xd000364e BIT_MASK 0x1 /end MEASUREMENT
/begin MEASUREMENT n_ecf_can "desired ECF speed from ext. ECU (AFS, EPS)" UBYTE _CNV_A_R_LINEAR_____0_CM 1 100. 0. 15. DISPLAY_IDENTIFIER N_ECF_CAN ECU_ADDRESS 0xd0003607 FORMAT "%2.0" /end MEASUREMENT
/begin MEASUREMENT ecf_req_ext "ext. ECU (AFS, EPS) requiring ECF speed" UBYTE _CNV_A_R_LINEAR_____0_CM 1 100. 0. 255. DISPLAY_IDENTIFIER ECF_REQ_EXT ECU_ADDRESS 0xc000012b FORMAT "%3.0" /end MEASUREMENT
/begin MEASUREMENT qoil_ds_rst_can_2_1 "ID2_BOS_resetting_2" UBYTE _CNV_A_R_LINEAR_____0_CM 1 100. 0. 255. DISPLAY_IDENTIFIER QOIL_DS_RST_CAN_2_1 ECU_ADDRESS 0xd0003608 FORMAT "%3.0" /end MEASUREMENT
/begin MEASUREMENT qoil_ds_rst_can_2_2 "ID_function_BOS_resetting_2" UWORD _CNV_A_R_LINEAR_____0_CM 1 100. 0. 65535. DISPLAY_IDENTIFIER QOIL_DS_RST_CAN_2_2 ECU_ADDRESS 0xd0004a8c FORMAT "%5.0" /end MEASUREMENT
/begin MEASUREMENT qoil_ds_rst_can_2_3 "Prognose_Intervall_Weg_BOS_Rückstellung_2" UBYTE _CNV_A_R_LINEAR_____0_CM 1 100. 0. 255. DISPLAY_IDENTIFIER QOIL_DS_RST_CAN_2_3 ECU_ADDRESS 0xd0003609 FORMAT "%3.0" /end MEASUREMENT
/begin MEASUREMENT qoil_ds_rst_can_2_4 "Zieltermin_Monat_BOS_Rückstellung_2" UBYTE _CNV_A_R_LINEAR_____0_CM 1 100. 0. 255. DISPLAY_IDENTIFIER QOIL_DS_RST_CAN_2_4 ECU_ADDRESS 0xd000360a FORMAT "%3.0" /end MEASUREMENT
/begin MEASUREMENT qoil_ds_rst_can_2_5 "Zieltermin_Jahr_BOS_Rückstellung_2" UBYTE _CNV_A_R_LINEAR_____0_CM 1 100. 0. 255. DISPLAY_IDENTIFIER QOIL_DS_RST_CAN_2_5 ECU_ADDRESS 0xd000360b FORMAT "%3.0" /end MEASUREMENT
/begin MEASUREMENT qoil_ds_rst_can_2_6 "Prognose_Intervall_Zeit_BOS_Rückstellung_2" UBYTE _CNV_A_R_LINEAR_____0_CM 1 100. 0. 255. DISPLAY_IDENTIFIER QOIL_DS_RST_CAN_2_6 ECU_ADDRESS 0xd000360c FORMAT "%3.0" /end MEASUREMENT
/begin MEASUREMENT lv_pow_clas_veh_can_rcv "Status vehicle power class received via CAN" UBYTE _CNV_S_2_RANGE__0___1_CM 1 100. 0. 1. DISPLAY_IDENTIFIER LV_POW_CLAS_VEH_CAN_RCV ECU_ADDRESS 0xd000364f BIT_MASK 0x1 /end MEASUREMENT
/begin MEASUREMENT cur_wku_can "quiescent-current (vehicle-specific)" UBYTE _CNV_A_R_LINEAR_____62_CM 1 100. 0. 255. DISPLAY_IDENTIFIER CUR_WKU_CAN ECU_ADDRESS 0xd0003626 FORMAT "%3.0" /end MEASUREMENT
/begin MEASUREMENT cur_sc_min_can "minimum short-current (vehicle-specific)" UBYTE _CNV_A_R_LINEAR_____63_CM 1 100. 0. 2550. DISPLAY_IDENTIFIER CUR_SC_MIN_CAN ECU_ADDRESS 0xd0003625 FORMAT "%4.0" /end MEASUREMENT
/begin MEASUREMENT cur_sc_max_can "maximum short-current (vehicle-specific)" UBYTE _CNV_A_R_LINEAR_____63_CM 1 100. 0. 2550. DISPLAY_IDENTIFIER CUR_SC_MAX_CAN ECU_ADDRESS 0xd0003624 FORMAT "%4.0" /end MEASUREMENT
/begin MEASUREMENT idx_bat_can "implemented battery" UBYTE _CNV_A_R_LINEAR_____0_CM 1 100. 0. 255. DISPLAY_IDENTIFIER IDX_BAT_CAN ECU_ADDRESS 0xd0003627 FORMAT "%3.0" /end MEASUREMENT
/begin MEASUREMENT lv_tq_wheel_ldm_bn_err "LV indicating torque request by ldm invalid" UBYTE _CNV_S_2_RANGE__0___1_CM 1 100. 0. 1. DISPLAY_IDENTIFIER LV_TQ_WHEEL_LDM_BN_ERR ECU_ADDRESS 0xd0003652 BIT_MASK 0x1 /end MEASUREMENT
/begin MEASUREMENT state_ldm_intv "state ldm" UBYTE _CNV_A_R_LINEAR_____0_CM 1 100. 0. 3. DISPLAY_IDENTIFIER STATE_LDM_INTV ECU_ADDRESS 0xd0003603 FORMAT "%1.0" /end MEASUREMENT
/begin MEASUREMENT state_ldm "state ldm" UBYTE _CNV_A_R_LINEAR_____0_CM 1 100. 0. 15. DISPLAY_IDENTIFIER STATE_LDM ECU_ADDRESS 0xd0003602 FORMAT "%2.0" /end MEASUREMENT
/begin MEASUREMENT lv_tq_wheel_ldm_req "LDM requested via CAN" UBYTE _CNV_S_2_RANGE__0___1_CM 1 100. 0. 1. DISPLAY_IDENTIFIER LV_TQ_WHEEL_LDM_REQ ECU_ADDRESS 0xd0003650 BIT_MASK 0x1 /end MEASUREMENT
/begin MEASUREMENT lv_ldm_lih_can "LDM LIH via CAN" UBYTE _CNV_S_2_RANGE__0___1_CM 1 100. 0. 1. DISPLAY_IDENTIFIER LV_LDM_LIH_CAN ECU_ADDRESS 0xd0003651 BIT_MASK 0x1 /end MEASUREMENT
/begin MEASUREMENT fac_is_inc_req "request IS-increase" UBYTE _CNV_A_R_LINEAR_____0_CM 1 100. 0. 255. DISPLAY_IDENTIFIER FAC_IS_INC_REQ ECU_ADDRESS 0xd000361d FORMAT "%3.0" /end MEASUREMENT
/begin MEASUREMENT fac_pow_mng_vst_cns "Powermanagement Standverbraucher" UBYTE _CNV_A_R_LINEAR_____0_CM 1 100. 0. 255. DISPLAY_IDENTIFIER FAC_POW_MNG_VST_CNS ECU_ADDRESS 0xd0003628 FORMAT "%3.0" ARRAY_SIZE 15 MATRIX_DIM 15 1 1 /end MEASUREMENT
/begin MEASUREMENT state_ext_pow_cns "State power consumption (Sonderverbraucher)" UBYTE _CNV_A_R_LINEAR_____59_CM 1 100. 0. 100. DISPLAY_IDENTIFIER STATE_EXT_POW_CNS ECU_ADDRESS 0xd00035fd FORMAT "%5.1" /end MEASUREMENT
/begin MEASUREMENT state_igk_hw "status ignition key (HW) via CAN" UBYTE _CNV_A_R_LINEAR_____0_CM 1 100. 0. 3. DISPLAY_IDENTIFIER STATE_IGK_HW ECU_ADDRESS 0xd00035fa FORMAT "%1.0" /end MEASUREMENT
/begin MEASUREMENT lv_ecras_ctl_can_1 "ECRAS control via CAN step 1" UBYTE _CNV_S_2_RANGE__0___1_CM 1 100. 0. 1. DISPLAY_IDENTIFIER LV_ECRAS_CTL_CAN_1 ECU_ADDRESS 0xd0003653 BIT_MASK 0x1 /end MEASUREMENT
/begin MEASUREMENT lv_ecras_ctl_can_2 "ECRAS control via CAN step 2" UBYTE _CNV_S_2_RANGE__0___1_CM 1 100. 0. 1. DISPLAY_IDENTIFIER LV_ECRAS_CTL_CAN_2 ECU_ADDRESS 0xd0003654 BIT_MASK 0x1 /end MEASUREMENT
/begin MEASUREMENT qoil_ds_rst_can_1_5 "Restlaufleistung_BOS_Rueckstellung_1" SWORD _CNV_R_R_Def_km_sw__64_CM 1 100. -327680. 327670. DISPLAY_IDENTIFIER QOIL_DS_RST_CAN_1_5 ECU_ADDRESS 0xd0004a8a FORMAT "%6.1" /end MEASUREMENT
/begin MEASUREMENT ctr_tout_n_ecf_can "Counter for timeout-detection ext. ECF-request" UBYTE _CNV_A_R_LINEAR_____0_CM 1 100. 0. 255. DISPLAY_IDENTIFIER CTR_TOUT_N_ECF_CAN ECU_ADDRESS 0xd000360d FORMAT "%3.0" /end MEASUREMENT
/begin MEASUREMENT ctr_dly_msg_oil "Counter for delay of oil message" UBYTE _CNV_A_R_LINEAR_____0_CM 1 100. 0. 255. DISPLAY_IDENTIFIER CTR_DLY_MSG_OIL ECU_ADDRESS 0xd0003637 FORMAT "%3.0" /end MEASUREMENT
/begin CHARACTERISTIC c_ctr_tout_n_ecf_can "Threshold for counter timeout-detection ext. ECF-request" VALUE 0xa10292ca _REC_VAL_20_u1 255. _CNV_A_R_LINEAR_____0_CM 0. 255. DISPLAY_IDENTIFIER C_CTR_TOUT_N_ECF_CAN FORMAT "%3.0" /end CHARACTERISTIC
/begin CHARACTERISTIC c_ctr_dly_msg_oil "Counter for transmitting Layer-values after Kl.15 on" VALUE 0xa1029292 _REC_VAL_20_u1 255. _CNV_A_R_LINEAR_____0_CM 0. 255. DISPLAY_IDENTIFIER C_CTR_DLY_MSG_OIL FORMAT "%3.0" /end CHARACTERISTIC
/begin CHARACTERISTIC c_state_loil_sub "Default value for transmitting layer-values" VALUE 0xa10297b4 _REC_VAL_20_u1 255. _CNV_A_R_LINEAR_____35_CM 0. 255. DISPLAY_IDENTIFIER C_STATE_LOIL_SUB FORMAT "%3.0" /end CHARACTERISTIC
/begin CHARACTERISTIC c_n_ecf_can "Default value for ECF-request" VALUE 0xa10295f6 _REC_VAL_20_u1 15. _CNV_A_R_LINEAR_____0_CM 0. 15. DISPLAY_IDENTIFIER C_N_ECF_CAN FORMAT "%2.0" /end CHARACTERISTIC
/begin CHARACTERISTIC c_ctr_ldm_can_ini "Default counter value for sending ini-value of ST_INTF_PT" VALUE 0xa102929f _REC_VAL_20_u1 255. _CNV_A_R_LINEAR_____0_CM 0. 255. DISPLAY_IDENTIFIER C_CTR_LDM_CAN_INI FORMAT "%3.0" /end CHARACTERISTIC
/begin MEASUREMENT lv_ldm_can_ini "Ini-values sent via CAN" UBYTE _CNV_S_2_RANGE__0___1_CM 1 100. 0. 1. DISPLAY_IDENTIFIER LV_LDM_CAN_INI ECU_ADDRESS 0xd0003655 BIT_MASK 0x1 /end MEASUREMENT
/begin MEASUREMENT state_etcu_prog_info "State mode ETCU" UBYTE _CNV_A_R_LINEAR_____0_CM 1 100. 0. 15. DISPLAY_IDENTIFIER STATE_ETCU_PROG_INFO ECU_ADDRESS 0xd000361c FORMAT "%2.0" /end MEASUREMENT
/begin CHARACTERISTIC lc_efppwm_ctl "Switch between PT-CAN definition and EKP Ctl funktionality" VALUE 0xa1029d1e _REC_VAL_20_u1 1. _CNV_A_R_LINEAR_____0_CM 0. 1. DISPLAY_IDENTIFIER LC_EFPPWM_CTL FORMAT "%1.0" /end CHARACTERISTIC
/begin MEASUREMENT ctr_diag_tcc_can_cas "Diagnosis counter for alive counter error symptom detection" UBYTE _CNV_A_R_LINEAR_____0_CM 1 100. 0. 255. DISPLAY_IDENTIFIER CTR_DIAG_TCC_CAN_CAS ECU_ADDRESS 0xd00035c7 FORMAT "%3.0" /end MEASUREMENT
/begin MEASUREMENT ctr_diag_tcc_can_tq_tcs "Diagnosis counter for alive counter error symptom detection" UBYTE _CNV_A_R_LINEAR_____0_CM 1 100. 0. 255. DISPLAY_IDENTIFIER CTR_DIAG_TCC_CAN_TQ_TCS ECU_ADDRESS 0xd00035ae FORMAT "%3.0" /end MEASUREMENT
/begin MEASUREMENT ctr_diag_tcc_can_tq_etcu "Diagnosis counter for alive counter error symptom detection" UBYTE _CNV_A_R_LINEAR_____0_CM 1 100. 0. 255. DISPLAY_IDENTIFIER CTR_DIAG_TCC_CAN_TQ_ETCU ECU_ADDRESS 0xd00035b2 FORMAT "%3.0" /end MEASUREMENT
/begin MEASUREMENT ctr_diag_tcc_can_tq_amt "Diagnosis counter for alive counter error symptom detection" UBYTE _CNV_A_R_LINEAR_____0_CM 1 100. 0. 255. DISPLAY_IDENTIFIER CTR_DIAG_TCC_CAN_TQ_AMT ECU_ADDRESS 0xd00035b6 FORMAT "%3.0" /end MEASUREMENT
/begin MEASUREMENT ctr_diag_tcc_can_icl "Diagnosis counter for alive counter error symptom detection" UBYTE _CNV_A_R_LINEAR_____0_CM 1 100. 0. 255. DISPLAY_IDENTIFIER CTR_DIAG_TCC_CAN_ICL ECU_ADDRESS 0xd00035cb FORMAT "%3.0" /end MEASUREMENT
/begin MEASUREMENT ctr_diag_tcc_can_ars "Diagnosis counter for alive counter error symptom detection" UBYTE _CNV_A_R_LINEAR_____0_CM 1 100. 0. 255. DISPLAY_IDENTIFIER CTR_DIAG_TCC_CAN_ARS ECU_ADDRESS 0xd00035c2 FORMAT "%3.0" /end MEASUREMENT
/begin MEASUREMENT ctr_diag_tcc_can_msw "Diagnosis counter for alive counter error symptom detection" UBYTE _CNV_A_R_LINEAR_____0_CM 1 100. 0. 255. DISPLAY_IDENTIFIER CTR_DIAG_TCC_CAN_MSW ECU_ADDRESS 0xd00035ce FORMAT "%3.0" /end MEASUREMENT
/begin MEASUREMENT ctr_diag_tcc_can_tq_dcc "Diagnosis counter for alive counter error symptom detection" UBYTE _CNV_A_R_LINEAR_____0_CM 1 100. 0. 255. DISPLAY_IDENTIFIER CTR_DIAG_TCC_CAN_TQ_DCC ECU_ADDRESS 0xd00035a0 FORMAT "%3.0" /end MEASUREMENT
/begin MEASUREMENT ctr_diag_cks_cas "Diagnosis counter for checksum counter error symptom detection" UBYTE _CNV_A_R_LINEAR_____0_CM 1 100. 0. 255. DISPLAY_IDENTIFIER CTR_DIAG_CKS_CAS ECU_ADDRESS 0xd00035c8 FORMAT "%3.0" /end MEASUREMENT
/begin MEASUREMENT ctr_diag_cks_tq_tcs "Diagnosis counter for checksum counter error symptom detection" UBYTE _CNV_A_R_LINEAR_____0_CM 1 100. 0. 255. DISPLAY_IDENTIFIER CTR_DIAG_CKS_TQ_TCS ECU_ADDRESS 0xd00035af FORMAT "%3.0" /end MEASUREMENT
/begin MEASUREMENT ctr_diag_cks_tq_etcu "Diagnosis counter for checksum counter error symptom detection" UBYTE _CNV_A_R_LINEAR_____0_CM 1 100. 0. 255. DISPLAY_IDENTIFIER CTR_DIAG_CKS_TQ_ETCU ECU_ADDRESS 0xd00035b3 FORMAT "%3.0" /end MEASUREMENT
/begin MEASUREMENT ctr_diag_cks_tq_amt "Diagnosis counter for checksum counter error symptom detection" UBYTE _CNV_A_R_LINEAR_____0_CM 1 100. 0. 255. DISPLAY_IDENTIFIER CTR_DIAG_CKS_TQ_AMT ECU_ADDRESS 0xd00035b7 FORMAT "%3.0" /end MEASUREMENT
/begin MEASUREMENT ctr_diag_cks_msw "Diagnosis counter for checksum counter error symptom detection" UBYTE _CNV_A_R_LINEAR_____0_CM 1 100. 0. 255. DISPLAY_IDENTIFIER CTR_DIAG_CKS_MSW ECU_ADDRESS 0xd00035cf FORMAT "%3.0" /end MEASUREMENT
/begin MEASUREMENT ctr_diag_cks_tq_dcc "Diagnosis counter for checksum counter error symptom detection" UBYTE _CNV_A_R_LINEAR_____0_CM 1 100. 0. 255. DISPLAY_IDENTIFIER CTR_DIAG_CKS_TQ_DCC ECU_ADDRESS 0xd00035a1 FORMAT "%3.0" /end MEASUREMENT
/begin MEASUREMENT ctr_diag_tout_ars "Diagnosis counter for timeout counter error symptom detection" UBYTE _CNV_A_R_LINEAR_____0_CM 1 100. 0. 255. DISPLAY_IDENTIFIER CTR_DIAG_TOUT_ARS ECU_ADDRESS 0xd00035c3 FORMAT "%3.0" /end MEASUREMENT
/begin MEASUREMENT ctr_diag_tout_cas "Diagnosis counter for timeout counter error symptom detection" UBYTE _CNV_A_R_LINEAR_____0_CM 1 100. 0. 255. DISPLAY_IDENTIFIER CTR_DIAG_TOUT_CAS ECU_ADDRESS 0xd00035c9 FORMAT "%3.0" /end MEASUREMENT
/begin MEASUREMENT ctr_diag_tout_tq_tcs "Diagnosis counter for timeout counter error symptom detection" UBYTE _CNV_A_R_LINEAR_____0_CM 1 100. 0. 255. DISPLAY_IDENTIFIER CTR_DIAG_TOUT_TQ_TCS ECU_ADDRESS 0xd00035b0 FORMAT "%3.0" /end MEASUREMENT
/begin MEASUREMENT ctr_diag_tout_vs_tcs "Diagnosis counter for timeout counter error symptom detection" UBYTE _CNV_A_R_LINEAR_____0_CM 1 100. 0. 255. DISPLAY_IDENTIFIER CTR_DIAG_TOUT_VS_TCS ECU_ADDRESS 0xd00035be FORMAT "%3.0" /end MEASUREMENT
/begin MEASUREMENT ctr_diag_tout_tcs "Diagnosis counter for timeout counter error symptom detection" UBYTE _CNV_A_R_LINEAR_____0_CM 1 100. 0. 255. DISPLAY_IDENTIFIER CTR_DIAG_TOUT_TCS ECU_ADDRESS 0xd00035c5 FORMAT "%3.0" /end MEASUREMENT
/begin MEASUREMENT ctr_diag_tout_tq_etcu "Diagnosis counter for timeout counter error symptom detection" UBYTE _CNV_A_R_LINEAR_____0_CM 1 100. 0. 255. DISPLAY_IDENTIFIER CTR_DIAG_TOUT_TQ_ETCU ECU_ADDRESS 0xd00035b4 FORMAT "%3.0" /end MEASUREMENT
/begin MEASUREMENT ctr_diag_tout_etcu "Diagnosis counter for timeout counter error symptom detection" UBYTE _CNV_A_R_LINEAR_____0_CM 1 100. 0. 255. DISPLAY_IDENTIFIER CTR_DIAG_TOUT_ETCU ECU_ADDRESS 0xd00035ba FORMAT "%3.0" /end MEASUREMENT
/begin MEASUREMENT ctr_diag_tout_etcu_2 "Diagnosis counter for timeout counter error symptom detection" UBYTE _CNV_A_R_LINEAR_____0_CM 1 100. 0. 255. DISPLAY_IDENTIFIER CTR_DIAG_TOUT_ETCU_2 ECU_ADDRESS 0xd00035a8 FORMAT "%3.0" /end MEASUREMENT
/begin MEASUREMENT ctr_diag_tout_etcu_disp "Diagnosis counter for timeout counter error symptom detection" UBYTE _CNV_A_R_LINEAR_____0_CM 1 100. 0. 255. DISPLAY_IDENTIFIER CTR_DIAG_TOUT_ETCU_DISP ECU_ADDRESS 0xd00035c0 FORMAT "%3.0" /end MEASUREMENT
/begin MEASUREMENT ctr_diag_tout_tq_amt "Diagnosis counter for timeout counter error symptom detection" UBYTE _CNV_A_R_LINEAR_____0_CM 1 100. 0. 255. DISPLAY_IDENTIFIER CTR_DIAG_TOUT_TQ_AMT ECU_ADDRESS 0xd00035b8 FORMAT "%3.0" /end MEASUREMENT
/begin MEASUREMENT ctr_diag_tout_tq_dcc "Diagnosis counter for timeout counter error symptom detection" UBYTE _CNV_A_R_LINEAR_____0_CM 1 100. 0. 255. DISPLAY_IDENTIFIER CTR_DIAG_TOUT_TQ_DCC ECU_ADDRESS 0xd00035a2 FORMAT "%3.0" /end MEASUREMENT
/begin MEASUREMENT ctr_diag_tout_acc "Diagnosis counter for timeout counter error symptom detection" UBYTE _CNV_A_R_LINEAR_____0_CM 1 100. 0. 255. DISPLAY_IDENTIFIER CTR_DIAG_TOUT_ACC ECU_ADDRESS 0xd00035e2 FORMAT "%3.0" /end MEASUREMENT
/begin MEASUREMENT ctr_diag_tout_km_icl "Diagnosis counter for timeout counter error symptom detection" UBYTE _CNV_A_R_LINEAR_____0_CM 1 100. 0. 255. DISPLAY_IDENTIFIER CTR_DIAG_TOUT_KM_ICL ECU_ADDRESS 0xd00035de FORMAT "%3.0" /end MEASUREMENT
/begin MEASUREMENT ctr_diag_tout_icl "Diagnosis counter for timeout counter error symptom detection" UBYTE _CNV_A_R_LINEAR_____0_CM 1 100. 0. 255. DISPLAY_IDENTIFIER CTR_DIAG_TOUT_ICL ECU_ADDRESS 0xd00035cc FORMAT "%3.0" /end MEASUREMENT
/begin MEASUREMENT ctr_diag_tout_pow_vb "Diagnosis counter for timeout counter error symptom detection" UBYTE _CNV_A_R_LINEAR_____0_CM 1 100. 0. 255. DISPLAY_IDENTIFIER CTR_DIAG_TOUT_POW_VB ECU_ADDRESS 0xd00035d4 FORMAT "%3.0" /end MEASUREMENT
/begin MEASUREMENT ctr_diag_tout_pow_gen "Diagnosis counter for timeout counter error symptom detection" UBYTE _CNV_A_R_LINEAR_____0_CM 1 100. 0. 255. DISPLAY_IDENTIFIER CTR_DIAG_TOUT_POW_GEN ECU_ADDRESS 0xd00035d2 FORMAT "%3.0" /end MEASUREMENT
/begin MEASUREMENT ctr_diag_tout_msw "Diagnosis counter for timeout counter error symptom detection" UBYTE _CNV_A_R_LINEAR_____0_CM 1 100. 0. 255. DISPLAY_IDENTIFIER CTR_DIAG_TOUT_MSW ECU_ADDRESS 0xd00035d0 FORMAT "%3.0" /end MEASUREMENT
/begin MEASUREMENT ctr_diag_tout_t_icl "Diagnosis counter for timeout counter error symptom detection" UBYTE _CNV_A_R_LINEAR_____0_CM 1 100. 0. 255. DISPLAY_IDENTIFIER CTR_DIAG_TOUT_T_ICL ECU_ADDRESS 0xd00035dc FORMAT "%3.0" /end MEASUREMENT
/begin MEASUREMENT ctr_diag_tout_ang_pste "Diagnosis counter for timeout counter error symptom detection" UBYTE _CNV_A_R_LINEAR_____0_CM 1 100. 0. 255. DISPLAY_IDENTIFIER CTR_DIAG_TOUT_ANG_PSTE ECU_ADDRESS 0xd00035bc FORMAT "%3.0" /end MEASUREMENT
/begin MEASUREMENT ctr_diag_tcc_can_veh_mod "Diagnosis counter for alive counter error symptom detection" UBYTE _CNV_A_R_LINEAR_____0_CM 1 100. 0. 255. DISPLAY_IDENTIFIER CTR_DIAG_TCC_CAN_VEH_MOD ECU_ADDRESS 0xd00035e4 FORMAT "%3.0" /end MEASUREMENT
/begin MEASUREMENT ctr_diag_cks_veh_mod "Diagnosis counter for checksum counter error symptom detection" UBYTE _CNV_A_R_LINEAR_____0_CM 1 100. 0. 255. DISPLAY_IDENTIFIER CTR_DIAG_CKS_VEH_MOD ECU_ADDRESS 0xd00035e5 FORMAT "%3.0" /end MEASUREMENT
/begin MEASUREMENT ctr_diag_tout_veh_mod "Diagnosis counter for timeout counter error symptom detection" UBYTE _CNV_A_R_LINEAR_____0_CM 1 100. 0. 255. DISPLAY_IDENTIFIER CTR_DIAG_TOUT_VEH_MOD ECU_ADDRESS 0xd00035e6 FORMAT "%3.0" /end MEASUREMENT
/begin MEASUREMENT ctr_diag_tcc_can_tq_pste_2 "Diagnosis counter for alive counter error symptom detection" UBYTE _CNV_A_R_LINEAR_____0_CM 1 100. 0. 255. DISPLAY_IDENTIFIER CTR_DIAG_TCC_CAN_TQ_PSTE_2 ECU_ADDRESS 0xd00035aa FORMAT "%3.0" /end MEASUREMENT
/begin MEASUREMENT ctr_diag_cks_tq_pste_2 "Diagnosis counter for checksum counter error symptom detection" UBYTE _CNV_A_R_LINEAR_____0_CM 1 100. 0. 255. DISPLAY_IDENTIFIER CTR_DIAG_CKS_TQ_PSTE_2 ECU_ADDRESS 0xd00035ab FORMAT "%3.0" /end MEASUREMENT
/begin MEASUREMENT ctr_diag_tout_tq_pste_2 "Diagnosis counter for timeout counter error symptom detection" UBYTE _CNV_A_R_LINEAR_____0_CM 1 100. 0. 255. DISPLAY_IDENTIFIER CTR_DIAG_TOUT_TQ_PSTE_2 ECU_ADDRESS 0xd00035ac FORMAT "%3.0" /end MEASUREMENT
/begin MEASUREMENT ctr_diag_tout_efp "Diagnosis counter for timeout counter error symptom detection" UBYTE _CNV_A_R_LINEAR_____0_CM 1 100. 0. 255. DISPLAY_IDENTIFIER CTR_DIAG_TOUT_EFP ECU_ADDRESS 0xd00035e8 FORMAT "%3.0" /end MEASUREMENT
/begin MEASUREMENT ctr_diag_tout_efp_crash "Diagnosis counter for timeout counter error symptom detection" UBYTE _CNV_A_R_LINEAR_____0_CM 1 100. 0. 255. DISPLAY_IDENTIFIER CTR_DIAG_TOUT_EFP_CRASH ECU_ADDRESS 0xd00035ea FORMAT "%3.0" /end MEASUREMENT
/begin MEASUREMENT lv_err_bn_acc "Present error BN2000" UBYTE _CNV_S_2_RANGE__0___1_CM 1 100. 0. 1. DISPLAY_IDENTIFIER LV_ERR_BN_ACC ECU_ADDRESS 0xd0003454 BIT_MASK 0x1 /end MEASUREMENT
/begin MEASUREMENT lv_err_bn_cas "Present error BN2000" UBYTE _CNV_S_2_RANGE__0___1_CM 1 100. 0. 1. DISPLAY_IDENTIFIER LV_ERR_BN_CAS ECU_ADDRESS 0xd000344b BIT_MASK 0x1 /end MEASUREMENT
/begin MEASUREMENT lv_err_bn_icl "Present error BN2000" UBYTE _CNV_S_2_RANGE__0___1_CM 1 100. 0. 1. DISPLAY_IDENTIFIER LV_ERR_BN_ICL ECU_ADDRESS 0xd0003458 BIT_MASK 0x1 /end MEASUREMENT
/begin MEASUREMENT lv_err_bn_km_icl "Present error BN2000" UBYTE _CNV_S_2_RANGE__0___1_CM 1 100. 0. 1. DISPLAY_IDENTIFIER LV_ERR_BN_KM_ICL ECU_ADDRESS 0xd0003457 BIT_MASK 0x1 /end MEASUREMENT
/begin MEASUREMENT lv_err_bn_pow_gen "Present error BN2000" UBYTE _CNV_S_2_RANGE__0___1_CM 1 100. 0. 1. DISPLAY_IDENTIFIER LV_ERR_BN_POW_GEN ECU_ADDRESS 0xd000345a BIT_MASK 0x1 /end MEASUREMENT
/begin MEASUREMENT lv_err_bn_pow_vb "Present error BN2000" UBYTE _CNV_S_2_RANGE__0___1_CM 1 100. 0. 1. DISPLAY_IDENTIFIER LV_ERR_BN_POW_VB ECU_ADDRESS 0xd0003459 BIT_MASK 0x1 /end MEASUREMENT
/begin MEASUREMENT lv_err_bn_t_icl "Present error BN2000" UBYTE _CNV_S_2_RANGE__0___1_CM 1 100. 0. 1. DISPLAY_IDENTIFIER LV_ERR_BN_T_ICL ECU_ADDRESS 0xd0003455 BIT_MASK 0x1 /end MEASUREMENT
/begin MEASUREMENT lv_err_bn_tq_pste_2 "Present error BN2000" UBYTE _CNV_S_2_RANGE__0___1_CM 1 100. 0. 1. DISPLAY_IDENTIFIER LV_ERR_BN_TQ_PSTE_2 ECU_ADDRESS 0xd0003449 BIT_MASK 0x1 /end MEASUREMENT
/begin MEASUREMENT lv_err_bn_efp "Present error BN2000" UBYTE _CNV_S_2_RANGE__0___1_CM 1 100. 0. 1. DISPLAY_IDENTIFIER LV_ERR_BN_EFP ECU_ADDRESS 0xd0003464 BIT_MASK 0x1 /end MEASUREMENT
/begin MEASUREMENT lv_err_bn_efp_crash "Present error BN2000" UBYTE _CNV_S_2_RANGE__0___1_CM 1 100. 0. 1. DISPLAY_IDENTIFIER LV_ERR_BN_EFP_CRASH ECU_ADDRESS 0xd0003463 BIT_MASK 0x1 /end MEASUREMENT
/begin MEASUREMENT lv_err_bn_gear_rev "Present error BN2000" UBYTE _CNV_S_2_RANGE__0___1_CM 1 100. 0. 1. DISPLAY_IDENTIFIER LV_ERR_BN_GEAR_REV ECU_ADDRESS 0xd000345d BIT_MASK 0x1 /end MEASUREMENT
/begin MEASUREMENT ctr_diag_tout_gear_rev "Diagnosis counter for timeout counter error symptom detection" UBYTE _CNV_A_R_LINEAR_____0_CM 1 100. 0. 255. DISPLAY_IDENTIFIER CTR_DIAG_TOUT_GEAR_REV ECU_ADDRESS 0xd00035e0 FORMAT "%3.0" /end MEASUREMENT
/begin MEASUREMENT lv_err_bn_ltg_hdlp_l "Present error BN2000" UBYTE _CNV_S_2_RANGE__0___1_CM 1 100. 0. 1. DISPLAY_IDENTIFIER LV_ERR_BN_LTG_HDLP_L ECU_ADDRESS 0xd000345e BIT_MASK 0x1 /end MEASUREMENT
/begin MEASUREMENT ctr_diag_tout_ltg_hdlp_l "Diagnosis counter for timeout counter error symptom detection" UBYTE _CNV_A_R_LINEAR_____0_CM 1 100. 0. 255. DISPLAY_IDENTIFIER CTR_DIAG_TOUT_LTG_HDLP_L ECU_ADDRESS 0xd00035d6 FORMAT "%3.0" /end MEASUREMENT
/begin MEASUREMENT ctr_diag_tcc_can_ldm "Diagnosis counter for alive counter error symptom detection" UBYTE _CNV_A_R_LINEAR_____0_CM 1 100. 0. 255. DISPLAY_IDENTIFIER CTR_DIAG_TCC_CAN_LDM ECU_ADDRESS 0xd00035a4 FORMAT "%3.0" /end MEASUREMENT
/begin MEASUREMENT ctr_diag_cks_ldm "Diagnosis counter for checksum counter error symptom detection" UBYTE _CNV_A_R_LINEAR_____0_CM 1 100. 0. 255. DISPLAY_IDENTIFIER CTR_DIAG_CKS_LDM ECU_ADDRESS 0xd00035a5 FORMAT "%3.0" /end MEASUREMENT
/begin MEASUREMENT ctr_diag_tout_ldm "Diagnosis counter for timeout counter error symptom detection" UBYTE _CNV_A_R_LINEAR_____0_CM 1 100. 0. 255. DISPLAY_IDENTIFIER CTR_DIAG_TOUT_LDM ECU_ADDRESS 0xd00035a6 FORMAT "%3.0" /end MEASUREMENT
/begin MEASUREMENT lv_err_bn_ldm "Present error BN2000" UBYTE _CNV_S_2_RANGE__0___1_CM 1 100. 0. 1. DISPLAY_IDENTIFIER LV_ERR_BN_LDM ECU_ADDRESS 0xd000345f BIT_MASK 0x1 /end MEASUREMENT
/begin MEASUREMENT ctr_diag_tout_hiv "Diagnosis counter for timeout counter error symptom detection" UBYTE _CNV_A_R_LINEAR_____0_CM 1 100. 0. 255. DISPLAY_IDENTIFIER CTR_DIAG_TOUT_HIV ECU_ADDRESS 0xd00035ec FORMAT "%3.0" /end MEASUREMENT
/begin MEASUREMENT lv_err_bn_hiv "Present error BN2000" UBYTE _CNV_S_2_RANGE__0___1_CM 1 100. 0. 1. DISPLAY_IDENTIFIER LV_ERR_BN_HIV ECU_ADDRESS 0xd0003461 BIT_MASK 0x1 /end MEASUREMENT
/begin MEASUREMENT ctr_diag_tout_trl "Diagnosis counter for timeout counter error symptom detection" UBYTE _CNV_A_R_LINEAR_____0_CM 1 100. 0. 255. DISPLAY_IDENTIFIER CTR_DIAG_TOUT_TRL ECU_ADDRESS 0xd00035da FORMAT "%3.0" /end MEASUREMENT
/begin MEASUREMENT lv_err_bn_trl "Present error BN2000" UBYTE _CNV_S_2_RANGE__0___1_CM 1 100. 0. 1. DISPLAY_IDENTIFIER LV_ERR_BN_TRL ECU_ADDRESS 0xd0003460 BIT_MASK 0x1 /end MEASUREMENT
/begin MEASUREMENT ctr_diag_tout_t_clk "Diagnosis counter for timeout counter error symptom detection" UBYTE _CNV_A_R_LINEAR_____0_CM 1 100. 0. 255. DISPLAY_IDENTIFIER CTR_DIAG_TOUT_T_CLK ECU_ADDRESS 0xd00035d8 FORMAT "%3.0" /end MEASUREMENT
/begin MEASUREMENT lv_err_bn_t_clk "Present error BN2000" UBYTE _CNV_S_2_RANGE__0___1_CM 1 100. 0. 1. DISPLAY_IDENTIFIER LV_ERR_BN_T_CLK ECU_ADDRESS 0xd0003462 BIT_MASK 0x1 /end MEASUREMENT
/begin MEASUREMENT lv_err_bn_etcu_disp "Present error BN2000" UBYTE _CNV_S_2_RANGE__0___1_CM 1 100. 0. 1. DISPLAY_IDENTIFIER LV_ERR_BN_ETCU_DISP ECU_ADDRESS 0xd0003452 BIT_MASK 0x1 /end MEASUREMENT
/begin MEASUREMENT tq_amt_fast_dec_bn "fast torque decreased intervention due to AMT" SWORD _CNV_A_R_LINEAR_____30_CM 1 100. -1024. 1023.96875 DISPLAY_IDENTIFIER TQ_AMT_FAST_DEC_BN ECU_ADDRESS 0xd0004a9c FORMAT "%8.2" /end MEASUREMENT
/begin MEASUREMENT tq_amt_slow_dec_bn "slow torque decreased intervention due to AMT" SWORD _CNV_A_R_LINEAR_____30_CM 1 100. -1024. 1023.96875 DISPLAY_IDENTIFIER TQ_AMT_SLOW_DEC_BN ECU_ADDRESS 0xd0004a9e FORMAT "%8.2" /end MEASUREMENT
/begin MEASUREMENT tq_amt_fast_inc_bn "fast torque increased intervention due to AMT" SWORD _CNV_A_R_LINEAR_____30_CM 1 100. -1024. 1023.96875 DISPLAY_IDENTIFIER TQ_AMT_FAST_INC_BN ECU_ADDRESS 0xd0004a98 FORMAT "%8.2" /end MEASUREMENT
/begin MEASUREMENT tq_amt_slow_inc_bn "slow torque increased intervention due to AMT" SWORD _CNV_A_R_LINEAR_____30_CM 1 100. -1024. 1023.96875 DISPLAY_IDENTIFIER TQ_AMT_SLOW_INC_BN ECU_ADDRESS 0xd0004a9a FORMAT "%8.2" /end MEASUREMENT
/begin MEASUREMENT tq_dcc_fast_inc_bn "fast torque increased intervention due to DCC" SWORD _CNV_A_R_LINEAR_____30_CM 1 100. -1024. 1023.96875 DISPLAY_IDENTIFIER TQ_DCC_FAST_INC_BN ECU_ADDRESS 0xd0004aa0 FORMAT "%8.2" /end MEASUREMENT
/begin MEASUREMENT tq_dcc_slow_inc_bn "slow torque increased intervention due to DCC" SWORD _CNV_A_R_LINEAR_____30_CM 1 100. -1024. 1023.96875 DISPLAY_IDENTIFIER TQ_DCC_SLOW_INC_BN ECU_ADDRESS 0xd0004aa2 FORMAT "%8.2" /end MEASUREMENT
/begin MEASUREMENT tq_gs_fast_dec_bn "fast torque decreased intervention due to GS" SWORD _CNV_A_R_LINEAR_____30_CM 1 100. -1024. 1023.96875 DISPLAY_IDENTIFIER TQ_GS_FAST_DEC_BN ECU_ADDRESS 0xd0004a94 FORMAT "%8.2" /end MEASUREMENT
/begin MEASUREMENT tq_gs_fast_inc_bn "fast torque increased intervention due to GS" SWORD _CNV_A_R_LINEAR_____30_CM 1 100. -1024. 1023.96875 DISPLAY_IDENTIFIER TQ_GS_FAST_INC_BN ECU_ADDRESS 0xd0004a90 FORMAT "%8.2" /end MEASUREMENT
/begin MEASUREMENT tq_gs_slow_dec_bn "slow torque decreased intervention due to GS" SWORD _CNV_A_R_LINEAR_____30_CM 1 100. -1024. 1023.96875 DISPLAY_IDENTIFIER TQ_GS_SLOW_DEC_BN ECU_ADDRESS 0xd0004a96 FORMAT "%8.2" /end MEASUREMENT
/begin MEASUREMENT tq_gs_slow_inc_bn "slow torque increased intervention due to GS" SWORD _CNV_A_R_LINEAR_____30_CM 1 100. -1024. 1023.96875 DISPLAY_IDENTIFIER TQ_GS_SLOW_INC_BN ECU_ADDRESS 0xd0004a92 FORMAT "%8.2" /end MEASUREMENT
/begin MEASUREMENT tq_msr_fast_inc_bn "fast torque increased intervention due to TCS" SWORD _CNV_A_R_LINEAR_____30_CM 1 100. -1024. 1023.96875 DISPLAY_IDENTIFIER TQ_MSR_FAST_INC_BN ECU_ADDRESS 0xd0004aa8 FORMAT "%8.2" /end MEASUREMENT
/begin MEASUREMENT tq_msr_slow_inc_bn "slow torque increased intervention due to TCS" SWORD _CNV_A_R_LINEAR_____30_CM 1 100. -1024. 1023.96875 DISPLAY_IDENTIFIER TQ_MSR_SLOW_INC_BN ECU_ADDRESS 0xd0004aaa FORMAT "%8.2" /end MEASUREMENT
/begin MEASUREMENT tq_asr_fast_dec_bn "fast torque decreased intervention due to TCS" SWORD _CNV_A_R_LINEAR_____30_CM 1 100. -1024. 1023.96875 DISPLAY_IDENTIFIER TQ_ASR_FAST_DEC_BN ECU_ADDRESS 0xd0004aac FORMAT "%8.2" /end MEASUREMENT
/begin MEASUREMENT tq_asr_slow_dec_bn "slow torque decreased intervention due to TCS" SWORD _CNV_A_R_LINEAR_____30_CM 1 100. -1024. 1023.96875 DISPLAY_IDENTIFIER TQ_ASR_SLOW_DEC_BN ECU_ADDRESS 0xd0004aae FORMAT "%8.2" /end MEASUREMENT
/begin MEASUREMENT t_tq_dcc_cs "Time of clutch switch intervention during DCC active" UBYTE _CNV_A_R_LINEAR_____3_CM 1 100. 0. 2.55 DISPLAY_IDENTIFIER T_TQ_DCC_CS ECU_ADDRESS 0xc000014c FORMAT "%4.2" /end MEASUREMENT
/begin MEASUREMENT lv_err_sym_tq_dcc_cs "Logical bit for TQ_REQ_CAN error due to DCC torque intervention clutch switch" UBYTE _CNV_S_2_RANGE__0___1_CM 1 100. 0. 1. DISPLAY_IDENTIFIER LV_ERR_SYM_TQ_DCC_CS ECU_ADDRESS 0xd000365c BIT_MASK 0x1 /end MEASUREMENT
/begin CHARACTERISTIC c_thd_t_tq_dcc_cs "Threshold for maximum allowed torque intervention concerning clutch switch" VALUE 0xa1029a2c _REC_VAL_20_u1 2.55 _CNV_A_R_LINEAR_____3_CM 0. 2.55 DISPLAY_IDENTIFIER C_THD_T_TQ_DCC_CS FORMAT "%4.2" /end CHARACTERISTIC
/begin CHARACTERISTIC c_crlc_tq_dcc_cs_dec "Correlation constant for decrement TQ_DCC_CS intervention " VALUE 0xa1029238 _REC_VAL_20_u1 0.99610001 _CNV_A_R_LINEAR_____17_CM 0. 0.99610001 DISPLAY_IDENTIFIER C_CRLC_TQ_DCC_CS_DEC FORMAT "%5.3" /end CHARACTERISTIC
/begin CHARACTERISTIC c_crlc_tq_dcc_cs_inc "Correlation constant for increment TQ_DCC_CS intervention " VALUE 0xa1029239 _REC_VAL_20_u1 0.99610001 _CNV_A_R_LINEAR_____17_CM 0. 0.99610001 DISPLAY_IDENTIFIER C_CRLC_TQ_DCC_CS_INC FORMAT "%5.3" /end CHARACTERISTIC
/begin CHARACTERISTIC lc_ena_tq_dcc_cs "Logical constant to set the TQ_DCC_CS intervention active" VALUE 0xa1029d33 _REC_VAL_20_u1 1. _CNV_A_R_LINEAR_____0_CM 0. 1. DISPLAY_IDENTIFIER LC_ENA_TQ_DCC_CS FORMAT "%2.0" /end CHARACTERISTIC
/begin CHARACTERISTIC ip_tq_dcc_cs "Intended DCC torque during clutch switch on" CURVE 0xa1028554 _REC_CUR_20_u2_u2 2047.96875 _CNV_A_R_LINEAR_____65_CM -1024. 1023.96875 DISPLAY_IDENTIFIER IP_TQ_DCC_CS FORMAT "%6.2"
 /begin AXIS_DESCR COM_AXIS n _CNV_A_R_LINEAR_____13_CM 6 0. 8160. FORMAT "%4.0" AXIS_PTS_REF ldp_n_tq_dcc_cs /end AXIS_DESCR
/end CHARACTERISTIC
/begin AXIS_PTS ldp_n_tq_dcc_cs "" 0xa1021028 n _REC_AXS_20_u2 8160. _CNV_A_R_LINEAR_____13_CM 6 0. 8160. FORMAT "%4.0" /end AXIS_PTS
/begin MEASUREMENT tq_wheel_ldm_inc_dec_bn "torque increased intervention due to LDM" SWORD _CNV_A_R_LINEAR_____60_CM 1 100. -32768. 32767. DISPLAY_IDENTIFIER TQ_WHEEL_LDM_INC_DEC_BN ECU_ADDRESS 0xd0004ab0 FORMAT "%6.0" /end MEASUREMENT
/begin MEASUREMENT tqi_msr_can "relative indicated engine torque requested by MSR" UBYTE _CNV_A_R_LINEAR_____5_CM 1 100. 0. 99.609375 DISPLAY_IDENTIFIER TQI_MSR_CAN ECU_ADDRESS 0xd00036f5 FORMAT "%5.1" /end MEASUREMENT
/begin MEASUREMENT vs_can "vehicle speed signal from CAN" UBYTE _CNV_A_R_LINEAR_____6_CM 1 100. 0. 255. DISPLAY_IDENTIFIER VS_CAN ECU_ADDRESS 0xd00036f7 FORMAT "%3.0" /end MEASUREMENT
/begin MEASUREMENT wheel "vehicle speed signal from CAN for cruise control" UWORD _CNV_A_R_LINEAR_____66_CM 1 100. 0. 511.99218 DISPLAY_IDENTIFIER WHEEL ECU_ADDRESS 0xd0004abe FORMAT "%7.3" /end MEASUREMENT
/begin MEASUREMENT lv_plaus_asr_ctl "logical variable for ASR intervention is active" UBYTE _CNV_S_2_RANGE__0___1_CM 1 100. 0. 1. DISPLAY_IDENTIFIER LV_PLAUS_ASR_CTL ECU_ADDRESS 0xd00036fc BIT_MASK 0x1 /end MEASUREMENT
/begin MEASUREMENT lv_plaus_esp_ctl "logical variable for DSC intervention is active" UBYTE _CNV_S_2_RANGE__0___1_CM 1 100. 0. 1. DISPLAY_IDENTIFIER LV_PLAUS_ESP_CTL ECU_ADDRESS 0xd00036fe BIT_MASK 0x1 /end MEASUREMENT
/begin MEASUREMENT tqi_asr_fast_can "relative indicated engine torque requested by ASR (fast path)" UBYTE _CNV_A_R_LINEAR_____5_CM 1 100. 0. 99.609375 DISPLAY_IDENTIFIER TQI_ASR_FAST_CAN ECU_ADDRESS 0xd00036f4 FORMAT "%5.1" /end MEASUREMENT
/begin MEASUREMENT lv_err_vs_can "logical variable for VS_CAN error" UBYTE _CNV_S_2_RANGE__0___1_CM 1 100. 0. 1. DISPLAY_IDENTIFIER LV_ERR_VS_CAN ECU_ADDRESS 0xd00036fb BIT_MASK 0x1 /end MEASUREMENT
/begin CHARACTERISTIC c_max_msg_miss_asr_can "maximum number of mised ASC messages (default value 10)" VALUE 0xa1029574 _REC_VAL_20_u1 255. _CNV_A_R_LINEAR_____0_CM 0. 255. DISPLAY_IDENTIFIER C_MAX_MSG_MISS_ASR_CAN FORMAT "%3.0" /end CHARACTERISTIC
/begin MEASUREMENT tqi_asr_fast_req_can "Relative indicated engine torque request by ASR (fast path)" SWORD _CNV_A_R_LINEAR_____30_CM 1 100. -1024. 1023.96875 DISPLAY_IDENTIFIER TQI_ASR_FAST_REQ_CAN ECU_ADDRESS 0xd0004ab8 FORMAT "%8.2" /end MEASUREMENT
/begin MEASUREMENT tqi_msr_req_can "Relative indicated engine torque request by MSR" SWORD _CNV_A_R_LINEAR_____30_CM 1 100. -1024. 1023.96875 DISPLAY_IDENTIFIER TQI_MSR_REQ_CAN ECU_ADDRESS 0xd0004aba FORMAT "%8.2" /end MEASUREMENT
/begin MEASUREMENT tqi_asr_slow_can "relative indicated engine torque requested by ASR (slow path)" UBYTE _CNV_A_R_LINEAR_____5_CM 1 100. 0. 99.609375 DISPLAY_IDENTIFIER TQI_ASR_SLOW_CAN ECU_ADDRESS 0xd00036f6 FORMAT "%5.1" /end MEASUREMENT
/begin MEASUREMENT tqi_asr_slow_req_can "Relative indicated engine torque request by ASR (slow path)" SWORD _CNV_A_R_LINEAR_____30_CM 1 100. -1024. 1023.96875 DISPLAY_IDENTIFIER TQI_ASR_SLOW_REQ_CAN ECU_ADDRESS 0xd0004abc FORMAT "%8.2" /end MEASUREMENT
/begin MEASUREMENT lv_tq_asr_req "logical variable for ASR request" UBYTE _CNV_S_2_RANGE__0___1_CM 1 100. 0. 1. DISPLAY_IDENTIFIER LV_TQ_ASR_REQ ECU_ADDRESS 0xd00036f9 BIT_MASK 0x1 /end MEASUREMENT
/begin MEASUREMENT lv_tq_msr_req "logical variable for MSR request" UBYTE _CNV_S_2_RANGE__0___1_CM 1 100. 0. 1. DISPLAY_IDENTIFIER LV_TQ_MSR_REQ ECU_ADDRESS 0xd00036fa BIT_MASK 0x1 /end MEASUREMENT
/begin MEASUREMENT brake_prs "Brake pressure" UBYTE _CNV_A_R_LINEAR_____67_CM 1 100. 0. 255. DISPLAY_IDENTIFIER BRAKE_PRS ECU_ADDRESS 0xd00036f8 FORMAT "%3.0" /end MEASUREMENT
/begin CHARACTERISTIC c_tmot_sum_hys "Hysteresis for temperature threshold C_TCO_TMOT_STA" VALUE 0xa1029a58 _REC_VAL_20_u1 190.5 _CNV_A_R_LINEAR_____24_CM 0. 190.5 DISPLAY_IDENTIFIER C_TMOT_SUM_HYS FORMAT "%5.1" /end CHARACTERISTIC
/begin CHARACTERISTIC c_t_tco_can_ast "Time condition for transmitting the coolant temperature to the CAN" VALUE 0xa1029972 _REC_VAL_20_u2 6553.5 _CNV_A_R_LINEAR_____4_CM 0. 6553.5 DISPLAY_IDENTIFIER C_T_TCO_CAN_AST FORMAT "%6.1" /end CHARACTERISTIC
/begin CHARACTERISTIC c_tco_swi_wup "TCO condition for setting the bit S_WL" VALUE 0xa10299f4 _REC_VAL_20_u1 190.5 _CNV_A_R_LINEAR_____16_CM -48. 142.5 DISPLAY_IDENTIFIER C_TCO_SWI_WUP FORMAT "%5.1" /end CHARACTERISTIC
/begin MEASUREMENT lv_ack_tcs "Logical variable TCS acknowledge" UBYTE _CNV_S_2_RANGE__0___1_CM 1 100. 0. 1. DISPLAY_IDENTIFIER LV_ACK_TCS ECU_ADDRESS 0xc00001ab BIT_MASK 0x1 /end MEASUREMENT
/begin CHARACTERISTIC c_t_ctr_max_asr_can "maximum value timeout counter ASC message (default value 10)" VALUE 0xa1029825 _REC_VAL_20_u1 2.55 _CNV_A_R_LINEAR_____3_CM 0. 2.55 DISPLAY_IDENTIFIER C_T_CTR_MAX_ASR_CAN FORMAT "%4.2" /end CHARACTERISTIC
/begin CHARACTERISTIC c_tco_tmot_sta "Temperature threshold for actuating the overtemperature warning light" VALUE 0xa10299f5 _REC_VAL_20_u1 190.5 _CNV_A_R_LINEAR_____16_CM -48. 142.5 DISPLAY_IDENTIFIER C_TCO_TMOT_STA FORMAT "%5.1" /end CHARACTERISTIC
/begin CHARACTERISTIC c_fac_mff_fco "Transition factor MFF to FCO" VALUE 0xa102938e _REC_VAL_20_u2 0.9999847412109381 _CNV_A_R_LINEAR_____68_CM 0. 0.9999847412109381 DISPLAY_IDENTIFIER C_FAC_MFF_FCO FORMAT "%7.5" /end CHARACTERISTIC
/begin MEASUREMENT fco "integrated fuel consumption" ULONG _CNV_A_R_LINEAR_____69_CM 1 100. 0. 4294967295. DISPLAY_IDENTIFIER FCO ECU_ADDRESS 0xd0005514 FORMAT "%11.0" /end MEASUREMENT
/begin CHARACTERISTIC ip_t_ast_swi_wup__ctr_km_can "Time condition for setting the LV_WUP_CAN" CURVE 0xa1027a1c _REC_CUR_20_u2_u2 6553.5 _CNV_A_R_LINEAR_____4_CM 0. 6553.5 DISPLAY_IDENTIFIER IP_T_AST_SWI_WUP__CTR_KM_CAN FORMAT "%6.1"
 /begin AXIS_DESCR COM_AXIS ctr_km_can _CNV_A_R_LINEAR_____70_CM 4 0. 655340. FORMAT "%6.0" AXIS_PTS_REF lpdm_ctr_km_can /end AXIS_DESCR
/end CHARACTERISTIC
/begin CHARACTERISTIC c_pv_can_diag "limitation of PV_CAN at MTC error is active" VALUE 0xa102972e _REC_VAL_20_u1 99.609375 _CNV_A_R_LINEAR_____5_CM 0. 99.609375 DISPLAY_IDENTIFIER C_PV_CAN_DIAG FORMAT "%4.1" /end CHARACTERISTIC
/begin CHARACTERISTIC c_eng_etcu "?????" VALUE 0xa1029359 _REC_VAL_20_u1 255. _CNV_A_R_LINEAR_____0_CM 0. 255. DISPLAY_IDENTIFIER C_ENG_ETCU FORMAT "%3.0" /end CHARACTERISTIC
/begin MEASUREMENT ctl_shift_lock_can "control shift-lock" UBYTE _CNV_A_R_LINEAR_____0_CM 1 100. 0. 3. DISPLAY_IDENTIFIER CTL_SHIFT_LOCK_CAN ECU_ADDRESS 0xd0003708 FORMAT "%1.0" /end MEASUREMENT
/begin MEASUREMENT lv_level_is "status switch level rpm" UBYTE _CNV_S_2_RANGE__0___1_CM 1 100. 0. 1. DISPLAY_IDENTIFIER LV_LEVEL_IS ECU_ADDRESS 0xd000370a BIT_MASK 0x1 /end MEASUREMENT
/begin MEASUREMENT tqi_maf "indicated engine torque after charging interventions (converted for CAN)" SWORD _CNV_A_R_LINEAR_____30_CM 1 100. -1024. 1023.96875 DISPLAY_IDENTIFIER TQI_MAF ECU_ADDRESS 0xd0004ab4 FORMAT "%8.2" /end MEASUREMENT
/begin MEASUREMENT tqi_av_can "actual indicated engine torque (converted for CAN)" UBYTE _CNV_A_R_LINEAR_____5_CM 1 100. 0. 99.609375 DISPLAY_IDENTIFIER TQI_AV_CAN ECU_ADDRESS 0xc00001a6 FORMAT "%4.1" /end MEASUREMENT
/begin MEASUREMENT tqi_ems_can "requested indicated engine torque without external interventions (converted for CAN)" UBYTE _CNV_A_R_LINEAR_____5_CM 1 100. 0. 99.609375 DISPLAY_IDENTIFIER TQI_EMS_CAN ECU_ADDRESS 0xc00001a7 FORMAT "%4.1" /end MEASUREMENT
/begin MEASUREMENT tqi_maf_can "indicated engine torque after charging interventions (converted for CAN)" UBYTE _CNV_A_R_LINEAR_____5_CM 1 100. 0. 99.609375 DISPLAY_IDENTIFIER TQI_MAF_CAN ECU_ADDRESS 0xc00001a8 FORMAT "%4.1" /end MEASUREMENT
/begin MEASUREMENT lv_crul_ack "LV indicating if L_FGR-signal has been sent - for KWP-Service" UBYTE _CNV_S_2_RANGE__0___1_CM 1 100. 0. 1. DISPLAY_IDENTIFIER LV_CRUL_ACK ECU_ADDRESS 0xd000370b BIT_MASK 0x1 /end MEASUREMENT
/begin MEASUREMENT fco_av_mmv "Moving mean value of the integrated fuel consumption" UWORD _CNV_A_R_LINEAR_____69_CM 1 100. 0. 65535. DISPLAY_IDENTIFIER FCO_AV_MMV ECU_ADDRESS 0xd0004ac0 FORMAT "%5.0" /end MEASUREMENT
/begin CHARACTERISTIC c_crlc_fco_av "Correlation constant for moving mean value calculation of FCO" VALUE 0xa10291fa _REC_VAL_20_u1 0.99610001 _CNV_A_R_LINEAR_____17_CM 0. 0.99610001 DISPLAY_IDENTIFIER C_CRLC_FCO_AV FORMAT "%5.3" /end CHARACTERISTIC
/begin MEASUREMENT gear_sel_disp "Gear stick position" UBYTE _CNV_A_R_LINEAR_____0_CM 1 100. 0. 15. DISPLAY_IDENTIFIER GEAR_SEL_DISP ECU_ADDRESS 0xc00001ad FORMAT "%2.0" /end MEASUREMENT
/begin MEASUREMENT tqi_gs_req_can "Relative torque request during gearshift intervention" UBYTE _CNV_A_R_LINEAR_____71_CM 1 100. 0. 0.99609375 DISPLAY_IDENTIFIER TQI_GS_REQ_CAN ECU_ADDRESS 0xd000370c FORMAT "%5.3" /end MEASUREMENT
/begin MEASUREMENT tqi_gs_fast_req_can "Relative torque request during gearshift intervention - fast" UBYTE _CNV_A_R_LINEAR_____71_CM 1 100. 0. 0.99609375 DISPLAY_IDENTIFIER TQI_GS_FAST_REQ_CAN ECU_ADDRESS 0xd000370d FORMAT "%5.3" /end MEASUREMENT
/begin MEASUREMENT tqi_gs_slow_req_can "Relative torque request during gearshift intervention - slow" UBYTE _CNV_A_R_LINEAR_____71_CM 1 100. 0. 0.99609375 DISPLAY_IDENTIFIER TQI_GS_SLOW_REQ_CAN ECU_ADDRESS 0xd000370e FORMAT "%5.3" /end MEASUREMENT
/begin MEASUREMENT tq_gear_can "Torque from ETCU" UBYTE _CNV_A_R_LINEAR_____27_CM 1 100. 0. 0.99609375 DISPLAY_IDENTIFIER TQ_GEAR_CAN ECU_ADDRESS 0xd0003711 FORMAT "%5.3" /end MEASUREMENT
/begin MEASUREMENT tqi_gs_req "Absolute torque request during gearshift intervention" SWORD _CNV_A_R_LINEAR_____30_CM 1 100. -1024. 1023.96875 DISPLAY_IDENTIFIER TQI_GS_REQ ECU_ADDRESS 0xd0004ac6 FORMAT "%8.2" /end MEASUREMENT
/begin MEASUREMENT tqi_gs_fast_req "Absolute torque request during gearshift intervention - fast" SWORD _CNV_A_R_LINEAR_____30_CM 1 100. -1024. 1023.96875 DISPLAY_IDENTIFIER TQI_GS_FAST_REQ ECU_ADDRESS 0xd0004ac8 FORMAT "%8.2" /end MEASUREMENT
/begin MEASUREMENT tqi_gs_slow_req "Absolute torque request during gearshift intervention - slow" SWORD _CNV_A_R_LINEAR_____30_CM 1 100. -1024. 1023.96875 DISPLAY_IDENTIFIER TQI_GS_SLOW_REQ ECU_ADDRESS 0xd0004aca FORMAT "%8.2" /end MEASUREMENT
/begin MEASUREMENT lv_tq_gs_inc_req "logical variable indicating torque increase due to gear shift intervention" UBYTE _CNV_S_2_RANGE__0___1_CM 1 100. 0. 1. DISPLAY_IDENTIFIER LV_TQ_GS_INC_REQ ECU_ADDRESS 0xd0003715 BIT_MASK 0x1 /end MEASUREMENT
/begin MEASUREMENT lv_tq_gs_dec_req "logical variable indicating torque decrese due to gear shift intervention " UBYTE _CNV_S_2_RANGE__0___1_CM 1 100. 0. 1. DISPLAY_IDENTIFIER LV_TQ_GS_DEC_REQ ECU_ADDRESS 0xd0003714 BIT_MASK 0x1 /end MEASUREMENT
/begin CHARACTERISTIC c_tq_stnd "Standard torque" VALUE 0xa1029b2a _REC_VAL_20_s2 2047.96875 _CNV_A_R_LINEAR_____30_CM -1024. 1023.96875 DISPLAY_IDENTIFIER C_TQ_STND FORMAT "%8.2" /end CHARACTERISTIC
/begin MEASUREMENT gear_info "Gear information from EGS-ECU" UBYTE _CNV_A_R_LINEAR_____0_CM 1 100. 0. 7. DISPLAY_IDENTIFIER GEAR_INFO ECU_ADDRESS 0xd000370f FORMAT "%2.0" /end MEASUREMENT
/begin MEASUREMENT tq_conv_can "converter torque from ETCU" SWORD _CNV_A_R_LINEAR_____30_CM 1 100. -1024. 1023.96875 DISPLAY_IDENTIFIER TQ_CONV_CAN ECU_ADDRESS 0xd0004ac4 FORMAT "%6.2" /end MEASUREMENT
/begin MEASUREMENT state_cc "state of converter clutch (CC)" UBYTE _CNV_S_4_RANGE_STAT_72_CM 1 100. 0. 3. DISPLAY_IDENTIFIER STATE_CC ECU_ADDRESS 0xd0003710 /end MEASUREMENT
/begin MEASUREMENT state_etcu_obd "status OBD gearbox" UBYTE _CNV_S_9_STATE_ETCU_73_CM 1 100. 0. 15. DISPLAY_IDENTIFIER STATE_ETCU_OBD ECU_ADDRESS 0xd0003712 /end MEASUREMENT
/begin MEASUREMENT n_gb "input shaft speed turbine/gearbox (AT) " UWORD _CNV_A_R_LINEAR_____74_CM 1 100. 0. 8191.75 DISPLAY_IDENTIFIER N_GB ECU_ADDRESS 0xd0004ac2 FORMAT "%7.2" /end MEASUREMENT
/begin MEASUREMENT tq_accin_can "ACC-torque from CAN" UBYTE _CNV_A_R_LINEAR_____60_CM 1 100. 0. 31. DISPLAY_IDENTIFIER TQ_ACCIN_CAN ECU_ADDRESS 0xd0003724 FORMAT "%3.0" /end MEASUREMENT
/begin MEASUREMENT state_efp_crash_can "Request for switch off fuel pump after crash" UBYTE _CNV_A_R_LINEAR_____0_CM 1 100. 0. 3. DISPLAY_IDENTIFIER STATE_EFP_CRASH_CAN ECU_ADDRESS 0xd0003723 FORMAT "%2.0" /end MEASUREMENT
/begin MEASUREMENT lv_req_heat "LV increased heater power request" UBYTE _CNV_S_2_RANGE__0___1_CM 1 100. 0. 1. DISPLAY_IDENTIFIER LV_REQ_HEAT ECU_ADDRESS 0xd0003731 BIT_MASK 0x1 /end MEASUREMENT
/begin MEASUREMENT lv_ltg_swi_can "logical variable for day- (0)or night lighting (1)" UBYTE _CNV_S_2_RANGE__0___1_CM 1 100. 0. 1. DISPLAY_IDENTIFIER LV_LTG_SWI_CAN ECU_ADDRESS 0xd000372f BIT_MASK 0x1 /end MEASUREMENT
/begin MEASUREMENT lv_tam_can_err "logical variable for erroneous ambient temperature signal" UBYTE _CNV_S_2_RANGE__0___1_CM 1 100. 0. 1. DISPLAY_IDENTIFIER LV_TAM_CAN_ERR ECU_ADDRESS 0xd0003729 BIT_MASK 0x1 /end MEASUREMENT
/begin MEASUREMENT state_gear_rev_can "state reverse gear: 0 inactiv, 1 activ" UBYTE _CNV_S_2_RANGE______75_CM 1 100. 0. 1. DISPLAY_IDENTIFIER STATE_GEAR_REV_CAN ECU_ADDRESS 0xd0003730 /end MEASUREMENT
/begin MEASUREMENT ftl "fuel tank level" UBYTE _CNV_A_R_LINEAR_____76_CM 1 100. 0. 127. DISPLAY_IDENTIFIER FTL ECU_ADDRESS 0xd000371d FORMAT "%3.0" /end MEASUREMENT
/begin MEASUREMENT lv_ftl_can_err "logical value erroneous fuel tank level signal" UBYTE _CNV_S_2_RANGE__0___1_CM 1 100. 0. 1. DISPLAY_IDENTIFIER LV_FTL_CAN_ERR ECU_ADDRESS 0xd000372b BIT_MASK 0x1 /end MEASUREMENT
/begin CHARACTERISTIC c_tam_sub "substitute TAM-temperature in case of TAM-failure" VALUE 0xa10299c7 _REC_VAL_20_u1 190.5 _CNV_A_R_LINEAR_____16_CM -48. 142.5 DISPLAY_IDENTIFIER C_TAM_SUB FORMAT "%5.1" /end CHARACTERISTIC
/begin CHARACTERISTIC lc_tam_man_as "Logical constant switch TAM from CAN or application system" VALUE 0xa1029de8 _REC_VAL_20_u1 1. _CNV_A_R_LINEAR_____0_CM 0. 1. DISPLAY_IDENTIFIER LC_TAM_MAN_AS FORMAT "%1.0" /end CHARACTERISTIC
/begin CHARACTERISTIC c_tam_man_as "Ambient temperature TAM by application system" VALUE 0xa10299bc _REC_VAL_20_u1 190.5 _CNV_A_R_LINEAR_____16_CM -48. 142.5 DISPLAY_IDENTIFIER C_TAM_MAN_AS FORMAT "%5.1" /end CHARACTERISTIC
/begin MEASUREMENT n_ecf "Setpoint step of electric cooling fan speed" UBYTE _CNV_A_R_LINEAR_____0_CM 1 100. 0. 15. DISPLAY_IDENTIFIER N_ECF ECU_ADDRESS 0xd000371c FORMAT "%2.0" /end MEASUREMENT
/begin MEASUREMENT lv_req_tco_l "LV requirement for low coolant temperature" UBYTE _CNV_S_2_RANGE__0___1_CM 1 100. 0. 1. DISPLAY_IDENTIFIER LV_REQ_TCO_L ECU_ADDRESS 0xd0003728 BIT_MASK 0x1 /end MEASUREMENT
/begin MEASUREMENT lv_accin "LV ACC request" UBYTE _CNV_S_2_RANGE__0___1_CM 1 100. 0. 1. DISPLAY_IDENTIFIER LV_ACCIN ECU_ADDRESS 0xd0003727 BIT_MASK 0x1 /end MEASUREMENT
/begin MEASUREMENT ctr_km_can "vehicle kilometer reading from CAN message INSTR2" UWORD _CNV_A_R_LINEAR_____70_CM 1 100. 0. 655350. DISPLAY_IDENTIFIER CTR_KM_CAN ECU_ADDRESS 0xd0004acc FORMAT "%7.0" /end MEASUREMENT
/begin MEASUREMENT t_rel_can "relative time counter" ULONG _CNV_A_R_LINEAR_____77_CM 1 100. 0. 4294967295. DISPLAY_IDENTIFIER T_REL_CAN ECU_ADDRESS 0xd000551c FORMAT "%10.0" /end MEASUREMENT
/begin MEASUREMENT tam "Ambient temperature" UBYTE _CNV_A_R_LINEAR_____16_CM 1 100. -48. 142.5 DISPLAY_IDENTIFIER TAM ECU_ADDRESS 0xd000371b FORMAT "%5.1" /end MEASUREMENT
/begin MEASUREMENT lv_acin "LV switch ACC readiness" UBYTE _CNV_S_2_RANGE__0___1_CM 1 100. 0. 1. DISPLAY_IDENTIFIER LV_ACIN ECU_ADDRESS 0xd0003726 BIT_MASK 0x1 /end MEASUREMENT
/begin MEASUREMENT lv_ftl_le_can_err "logical variable erroneous fuel tank level (left) signal" UBYTE _CNV_S_2_RANGE__0___1_CM 1 100. 0. 1. DISPLAY_IDENTIFIER LV_FTL_LE_CAN_ERR ECU_ADDRESS 0xd000372d BIT_MASK 0x1 /end MEASUREMENT
/begin MEASUREMENT lv_ftl_ri_can_err "logical variable erroneous fuel tank level (right) signal" UBYTE _CNV_S_2_RANGE__0___1_CM 1 100. 0. 1. DISPLAY_IDENTIFIER LV_FTL_RI_CAN_ERR ECU_ADDRESS 0xd000372e BIT_MASK 0x1 /end MEASUREMENT
/begin MEASUREMENT lv_ftl_obd_inh_l "logical variable fuel reserve" UBYTE _CNV_S_2_RANGE__0___1_CM 1 100. 0. 1. DISPLAY_IDENTIFIER LV_FTL_OBD_INH_L ECU_ADDRESS 0xd000372a BIT_MASK 0x1 /end MEASUREMENT
/begin MEASUREMENT ftl_le "fuel tank level left" UBYTE _CNV_A_R_LINEAR_____76_CM 1 100. 0. 127. DISPLAY_IDENTIFIER FTL_LE ECU_ADDRESS 0xd000371e FORMAT "%3.0" /end MEASUREMENT
/begin MEASUREMENT ftl_ri "fuel tank level right" UBYTE _CNV_A_R_LINEAR_____76_CM 1 100. 0. 127. DISPLAY_IDENTIFIER FTL_RI ECU_ADDRESS 0xd000371f FORMAT "%3.0" /end MEASUREMENT
/begin CHARACTERISTIC c_tout_efp_crash "" VALUE 0xa1029a8b _REC_VAL_20_u1 51. _CNV_A_R_LINEAR_____78_CM 0. 51. DISPLAY_IDENTIFIER C_TOUT_EFP_CRASH FORMAT "%4.1" /end CHARACTERISTIC
/begin MEASUREMENT vel_ang_pste "sttering wheel sensor velocity" SWORD _CNV_A_R_LINEAR_____79_CM 1 100. -1439.98976 1439.945815 DISPLAY_IDENTIFIER VEL_ANG_PSTE ECU_ADDRESS 0xd0004ad0 FORMAT "%8.3" /end MEASUREMENT
/begin MEASUREMENT state_sens_ang_pste "status of wheel sensor" UBYTE _CNV_A_R_LINEAR_____0_CM 1 100. 0. 7. DISPLAY_IDENTIFIER STATE_SENS_ANG_PSTE ECU_ADDRESS 0xd0003736 FORMAT "%2.0" /end MEASUREMENT
/begin MEASUREMENT lv_var_pste "LV power steering detected - BN2000" UBYTE _CNV_S_2_RANGE__0___1_CM 1 100. 0. 1. DISPLAY_IDENTIFIER LV_VAR_PSTE ECU_ADDRESS 0xd0003738 BIT_MASK 0x1 /end MEASUREMENT
/begin MEASUREMENT ang_pste "sttering wheel sensor angle" SWORD _CNV_A_R_LINEAR_____80_CM 1 100. -1439.98976 1439.945815 DISPLAY_IDENTIFIER ANG_PSTE ECU_ADDRESS 0xd0004ace FORMAT "%8.3" /end MEASUREMENT
/begin MEASUREMENT lv_city "sttering wheel sensor angle" UBYTE _CNV_S_2_RANGE__0___1_CM 1 100. 0. 1. DISPLAY_IDENTIFIER LV_CITY ECU_ADDRESS 0xd0003742 BIT_MASK 0x1 /end MEASUREMENT
/begin MEASUREMENT tqi_slow_amt_req_can "torque request (slow) SSG via CAN" UBYTE _CNV_A_R_LINEAR_____5_CM 1 100. 0. 99.609375 DISPLAY_IDENTIFIER TQI_SLOW_AMT_REQ_CAN ECU_ADDRESS 0xd000373e FORMAT "%5.1" /end MEASUREMENT
/begin MEASUREMENT tqi_amt_req " torque request SSG" SWORD _CNV_A_R_LINEAR_____30_CM 1 100. -1024. 1023.96875 DISPLAY_IDENTIFIER TQI_AMT_REQ ECU_ADDRESS 0xd0004adc FORMAT "%8.2" /end MEASUREMENT
/begin MEASUREMENT tqi_slow_amt_req " torque request (slow) SSG" SWORD _CNV_A_R_LINEAR_____30_CM 1 100. -1024. 1023.96875 DISPLAY_IDENTIFIER TQI_SLOW_AMT_REQ ECU_ADDRESS 0xd0004ade FORMAT "%8.2" /end MEASUREMENT
/begin MEASUREMENT tqi_amt_req_can "torque requested SSG via CAN" UBYTE _CNV_A_R_LINEAR_____5_CM 1 100. 0. 99.609375 DISPLAY_IDENTIFIER TQI_AMT_REQ_CAN ECU_ADDRESS 0xd000373d FORMAT "%5.1" /end MEASUREMENT
/begin MEASUREMENT tqi_amt_cpl_can "complement SSG via CAN" UBYTE _CNV_A_R_LINEAR_____5_CM 1 100. 0. 99.609375 DISPLAY_IDENTIFIER TQI_AMT_CPL_CAN ECU_ADDRESS 0xd000373f FORMAT "%5.1" /end MEASUREMENT
/begin MEASUREMENT tcc_can_amt_1 "alive counter SSG" UBYTE _CNV_A_R_LINEAR_____50_CM 1 100. 0. 14. DISPLAY_IDENTIFIER TCC_CAN_AMT_1 ECU_ADDRESS 0xd0003741 FORMAT "%2.0" /end MEASUREMENT
/begin MEASUREMENT state_amt_obd_err "status OBD-relevant error - AMT" UBYTE _CNV_S_3_STATE_ETCU_51_CM 1 100. 0. 2. DISPLAY_IDENTIFIER STATE_AMT_OBD_ERR ECU_ADDRESS 0xd000373a /end MEASUREMENT
/begin MEASUREMENT state_amt "status shift-process AMT via CAN" UBYTE _CNV_S_5_STATE_AMT_81_CM 1 100. 0. 7. DISPLAY_IDENTIFIER STATE_AMT ECU_ADDRESS 0xd000373c /end MEASUREMENT
/begin MEASUREMENT state_clu_amt "status shift-process AMT via CAN" UBYTE _CNV_S_5_STATE_CLU__82_CM 1 100. 0. 7. DISPLAY_IDENTIFIER STATE_CLU_AMT ECU_ADDRESS 0xd0003740 /end MEASUREMENT
/begin MEASUREMENT lv_tq_amt_dec_req "logical variable indicating torque decrease due to AMT intervention" UBYTE _CNV_S_2_RANGE__0___1_CM 1 100. 0. 1. DISPLAY_IDENTIFIER LV_TQ_AMT_DEC_REQ ECU_ADDRESS 0xd0003747 BIT_MASK 0x1 /end MEASUREMENT
/begin MEASUREMENT lv_tq_amt_inc_req "logical variable indicating torque increase due to AMT intervention" UBYTE _CNV_S_2_RANGE__0___1_CM 1 100. 0. 1. DISPLAY_IDENTIFIER LV_TQ_AMT_INC_REQ ECU_ADDRESS 0xd0003748 BIT_MASK 0x1 /end MEASUREMENT
/begin MEASUREMENT n_max_amt_can "engine speed limit AMT via CAN" UWORD _CNV_A_R_LINEAR_____13_CM 1 100. 0. 8160. DISPLAY_IDENTIFIER N_MAX_AMT_CAN ECU_ADDRESS 0xd0004ae0 FORMAT "%4.0" /end MEASUREMENT
/begin MEASUREMENT lv_amt_es "LV indicating engine stop via CAN" UBYTE _CNV_S_2_RANGE__0___1_CM 1 100. 0. 1. DISPLAY_IDENTIFIER LV_AMT_ES ECU_ADDRESS 0xd0003744 BIT_MASK 0x1 /end MEASUREMENT
/begin MEASUREMENT lv_gs "LV indicating GS - AMT" UBYTE _CNV_S_2_RANGE__0___1_CM 1 100. 0. 1. DISPLAY_IDENTIFIER LV_GS ECU_ADDRESS 0xd0003743 BIT_MASK 0x1 /end MEASUREMENT
/begin MEASUREMENT lv_gp "LV  indicating mode gearbox - AMT" UBYTE _CNV_S_2_RANGE__0___1_CM 1 100. 0. 1. DISPLAY_IDENTIFIER LV_GP ECU_ADDRESS 0xd0003745 BIT_MASK 0x1 /end MEASUREMENT
/begin MEASUREMENT state_amt_obd "status OBD gearbox" UBYTE _CNV_S_9_STATE_ETCU_73_CM 1 100. 0. 15. DISPLAY_IDENTIFIER STATE_AMT_OBD ECU_ADDRESS 0xd000373b /end MEASUREMENT
/begin MEASUREMENT lv_pump_amt_on "LV  indicating status of hydraulic pump - AMT" UBYTE _CNV_S_2_RANGE__0___1_CM 1 100. 0. 1. DISPLAY_IDENTIFIER LV_PUMP_AMT_ON ECU_ADDRESS 0xd0003746 BIT_MASK 0x1 /end MEASUREMENT
/begin MEASUREMENT lv_var_amt "SSG transmission recognized" UBYTE _CNV_S_2_RANGE__0___1_CM 1 100. 0. 1. DISPLAY_IDENTIFIER LV_VAR_AMT ECU_ADDRESS 0xd0003749 BIT_MASK 0x1 /end MEASUREMENT
/begin MEASUREMENT tco_can "TCO for transmission on CAN11H" UBYTE _CNV_A_R_LINEAR_____16_CM 1 100. -48. 142.5 DISPLAY_IDENTIFIER TCO_CAN ECU_ADDRESS 0xd0003709 FORMAT "%5.1" /end MEASUREMENT
/begin MEASUREMENT fco_dmtl "integrated fuel consumption for DMTL" ULONG _CNV_A_R_LINEAR_____69_CM 1 100. 0. 4294967295. DISPLAY_IDENTIFIER FCO_DMTL ECU_ADDRESS 0xd0005518 FORMAT "%11.0" /end MEASUREMENT
/begin CHARACTERISTIC c_ctr_ftl_not_vld "" VALUE 0xa1029298 _REC_VAL_20_u1 255. _CNV_A_R_LINEAR_____0_CM 0. 255. DISPLAY_IDENTIFIER C_CTR_FTL_NOT_VLD FORMAT "%3.0" /end CHARACTERISTIC
/begin MEASUREMENT ctr_ftl_not_vld "Counter for messages with invalid FTL-value" UBYTE _CNV_A_R_LINEAR_____0_CM 1 100. 0. 255. DISPLAY_IDENTIFIER CTR_FTL_NOT_VLD ECU_ADDRESS 0xd0003720 FORMAT "%3.0" /end MEASUREMENT
/begin MEASUREMENT ctr_ftl_ri_not_vld "Counter for messages with invalid FTL_RI-value" UBYTE _CNV_A_R_LINEAR_____0_CM 1 100. 0. 255. DISPLAY_IDENTIFIER CTR_FTL_RI_NOT_VLD ECU_ADDRESS 0xd0003722 FORMAT "%3.0" /end MEASUREMENT
/begin MEASUREMENT ctr_ftl_le_not_vld "Counter for messages with invalid FTL_LE-value" UBYTE _CNV_A_R_LINEAR_____0_CM 1 100. 0. 255. DISPLAY_IDENTIFIER CTR_FTL_LE_NOT_VLD ECU_ADDRESS 0xd0003721 FORMAT "%3.0" /end MEASUREMENT
/begin MEASUREMENT lv_ftl_tot_can_err "logical value erroneous fuel tank level signal - total FTL" UBYTE _CNV_S_2_RANGE______75_CM 1 100. 0. 1. DISPLAY_IDENTIFIER LV_FTL_TOT_CAN_ERR ECU_ADDRESS 0xd000372c /end MEASUREMENT
/begin AXIS_PTS lpdm_ctr_km_can "" 0xa102242c ctr_km_can _REC_AXS_20_u2 655340. _CNV_A_R_LINEAR_____70_CM 4 0. 655340. FORMAT "%6.0" /end AXIS_PTS
/begin MEASUREMENT lv_ctop "State convertible top: 0 = closed, 1 = open" UBYTE _CNV_S_2_RANGE______75_CM 1 100. 0. 1. DISPLAY_IDENTIFIER LV_CTOP ECU_ADDRESS 0xd0003732 /end MEASUREMENT
/begin CHARACTERISTIC lc_tqi_maf_man "Logical constant to switch between two paths of the TQI_MAF calculation" VALUE 0xa1029e07 _REC_VAL_20_u1 1. _CNV_A_R_LINEAR_____0_CM 0. 1. DISPLAY_IDENTIFIER LC_TQI_MAF_MAN FORMAT "%1.0" /end CHARACTERISTIC
/begin MEASUREMENT lv_mil_can "Boolean indicating MIL" UBYTE _CNV_S_2_RANGE__0___1_CM 1 100. 0. 1. DISPLAY_IDENTIFIER LV_MIL_CAN ECU_ADDRESS 0xd00036f1 BIT_MASK 0x1 /end MEASUREMENT
/begin MEASUREMENT lv_wal_1_can "Boolean indicating WAL_1" UBYTE _CNV_S_2_RANGE__0___1_CM 1 100. 0. 1. DISPLAY_IDENTIFIER LV_WAL_1_CAN ECU_ADDRESS 0xd00036f2 BIT_MASK 0x1 /end MEASUREMENT
/begin MEASUREMENT lv_ct "Logical variable detection of driver passive" UBYTE _CNV_S_2_RANGE__0___1_CM 1 100. 0. 1. DISPLAY_IDENTIFIER LV_CT ECU_ADDRESS 0xd0003c84 BIT_MASK 0x1 /end MEASUREMENT
/begin CHARACTERISTIC c_fac_tq_req_clu_is_hys "Hysteresis on threshold on FAC_TQ_REQ_CLU_for IS detection" VALUE 0xa10293bc _REC_VAL_20_u2 1.99996948242188 _CNV_A_R_LINEAR_____8_CM 0. 1.99996948242188 DISPLAY_IDENTIFIER C_FAC_TQ_REQ_CLU_IS_HYS FORMAT "%7.5" /end CHARACTERISTIC
/begin CHARACTERISTIC ip_fac_tq_req_clu_is__n_32 "Threshold on FAC_TQ_REQ_CLU for IS detection" CURVE 0xa10246b0 _REC_CUR_20_u2_u1 1.99996948242188 _CNV_A_R_LINEAR_____8_CM 0. 1.99996948242188 DISPLAY_IDENTIFIER IP_FAC_TQ_REQ_CLU_IS__N_32 FORMAT "%7.5"
 /begin AXIS_DESCR COM_AXIS n_32 _CNV_A_R_LINEAR_____9_CM 3 0. 8160. FORMAT "%4.0" AXIS_PTS_REF ldp_n_32__fac_tq_req_clu_is /end AXIS_DESCR
/end CHARACTERISTIC
/begin AXIS_PTS ldp_n_32__fac_tq_req_clu_is "" 0xa1020d78 n_32 _REC_AXS_20_u1 8160. _CNV_A_R_LINEAR_____9_CM 3 0. 8160. FORMAT "%4.0" /end AXIS_PTS
/begin MEASUREMENT fast_ecu_tran_pwl_ctr "fast transition counter for transition from SYN_ENG_IGK_OFF to PWL despite engine running" UWORD _CNV_A_R_LINEAR_____3_CM 1 100. 0. 655.35 DISPLAY_IDENTIFIER FAST_ECU_TRAN_PWL_CTR ECU_ADDRESS 0xc00005aa FORMAT "%6.2" /end MEASUREMENT
/begin CHARACTERISTIC c_t_di_eng_run "Time of disabled ENG_RUN after engine stall during drive off" VALUE 0xa102983a _REC_VAL_20_u2 655.35 _CNV_A_R_LINEAR_____3_CM 0. 655.35 DISPLAY_IDENTIFIER C_T_DI_ENG_RUN FORMAT "%5.2" /end CHARACTERISTIC
/begin MEASUREMENT ecu_state "Information on ECU state" UBYTE _CNV_S_7_RANGE_ECU__144_CM 1 100. 0. 6. DISPLAY_IDENTIFIER ECU_STATE ECU_ADDRESS 0xd0003bcc /end MEASUREMENT
/begin MEASUREMENT gear "" UBYTE _CNV_A_R_LINEAR_____0_CM 1 100. 0. 255. DISPLAY_IDENTIFIER GEAR ECU_ADDRESS 0xd0003c76 FORMAT "%3.0" /end MEASUREMENT
/begin MEASUREMENT lv_err_bn_tq_etcu "Present error BN2000" UBYTE _CNV_S_2_RANGE__0___1_CM 1 100. 0. 1. DISPLAY_IDENTIFIER LV_ERR_BN_TQ_ETCU ECU_ADDRESS 0xd000344f BIT_MASK 0x1 /end MEASUREMENT
/begin CHARACTERISTIC ip_teg_egr__maf_cyl "Temperature on the exhaust side of the EGR-Valve" CURVE 0xa1027e28 _REC_CUR_20_u2_u2 2047. _CNV_A_R_LINEAR_____123_CM 0. 2047. DISPLAY_IDENTIFIER IP_TEG_EGR__MAF_CYL FORMAT "%7.2"
 /begin AXIS_DESCR COM_AXIS maf_cyl _CNV_A_R_LINEAR_____207_CM 8 0. 2047.96875 FORMAT "%6.2" AXIS_PTS_REF ldpm_maf_cyl_ex /end AXIS_DESCR
/end CHARACTERISTIC
/begin CHARACTERISTIC lc_teg_swi "Manual switch from TEG_EGR=TEG_CAT_DOWN_MDL_1 (=0)  to IP_TEG_EGR (MAF_CYL) ( =1)" VALUE 0xa1029dec _REC_VAL_20_u1 1. _CNV_A_R_LINEAR_____0_CM 0. 1. DISPLAY_IDENTIFIER LC_TEG_SWI FORMAT "%2.0" /end CHARACTERISTIC
/begin CHARACTERISTIC lc_teg_cat_down_mdl_swi "Manual switch from TEG_EGR=TEG_CAT_DOWN_MDL_x bank 1 or 2" VALUE 0xa1029deb _REC_VAL_20_u1 1. _CNV_A_R_LINEAR_____0_CM 0. 1. DISPLAY_IDENTIFIER LC_TEG_CAT_DOWN_MDL_SWI FORMAT "%2.0" /end CHARACTERISTIC
/begin MEASUREMENT prs_ex "Pressure in the exhaust system" UWORD _CNV_A_R_LINEAR_____26_CM 1 100. 0. 5434. DISPLAY_IDENTIFIER PRS_EX ECU_ADDRESS 0xd0004d94 FORMAT "%7.2" /end MEASUREMENT
/begin MEASUREMENT prs_ex_inc "increase of exhaust pressure in comparison to ambient pressure" UWORD _CNV_A_R_LINEAR_____26_CM 1 100. 0. 5434. DISPLAY_IDENTIFIER PRS_EX_INC ECU_ADDRESS 0xd0004d96 FORMAT "%7.2" /end MEASUREMENT
/begin CHARACTERISTIC ip_prs_ex_inc "pressure increase in the exhaust pipe" CURVE 0xa10276e4 _REC_CUR_20_u2_u2 5434. _CNV_A_R_LINEAR_____26_CM 0. 5434. DISPLAY_IDENTIFIER IP_PRS_EX_INC FORMAT "%7.2"
 /begin AXIS_DESCR COM_AXIS maf_cyl _CNV_A_R_LINEAR_____207_CM 8 0. 2047.96875 FORMAT "%6.2" AXIS_PTS_REF ldpm_maf_cyl_ex /end AXIS_DESCR
/end CHARACTERISTIC
/begin AXIS_PTS ldpm_maf_cyl_ex "" 0xa1021bfc maf_cyl _REC_AXS_20_u2 2047.96875 _CNV_A_R_LINEAR_____207_CM 8 0. 2047.96875 FORMAT "%6.2" /end AXIS_PTS
/begin AXIS_PTS ldpm_maf_flow_egr "" 0xa1021c24 maf_flow_ex _REC_AXS_20_u2 2047.96875 _CNV_A_R_LINEAR_____207_CM 8 0. 2047.96875 FORMAT "%6.2" /end AXIS_PTS
/begin CHARACTERISTIC ip_prs_ex_egr_inc "pressure increase in the exhaust pipe (for MAF_EGR-Calculation)" CURVE 0xa10276d4 _REC_CUR_20_u2_u2 5434. _CNV_A_R_LINEAR_____26_CM 0. 5434. DISPLAY_IDENTIFIER IP_PRS_EX_EGR_INC FORMAT "%7.2"
 /begin AXIS_DESCR COM_AXIS maf_flow_ex _CNV_A_R_LINEAR_____207_CM 8 0. 2047.96875 FORMAT "%6.2" AXIS_PTS_REF ldpm_maf_flow_egr /end AXIS_DESCR
/end CHARACTERISTIC
/begin MEASUREMENT prs_ex_egr "Pressure in the exhaust system (for MAF_EGR Calculation)" UWORD _CNV_A_R_LINEAR_____26_CM 1 100. 0. 5434. DISPLAY_IDENTIFIER PRS_EX_EGR ECU_ADDRESS 0xd0004d9a FORMAT "%7.2" /end MEASUREMENT
/begin MEASUREMENT prs_ex_egr_inc "Increase of Pressure in the exhaust system (for MAF_EGR Calculation)" UWORD _CNV_A_R_LINEAR_____26_CM 1 100. 0. 5434. DISPLAY_IDENTIFIER PRS_EX_EGR_INC ECU_ADDRESS 0xd0004d9c FORMAT "%7.2" /end MEASUREMENT
/begin AXIS_PTS ldp_v_put__put_mes_bas "Conversion characteristic for PUT_MES_BAS" 0xa1021670 v_put _REC_AXS_20_u2 4.5 _CNV_A_R_LINEAR_____2_CM 2 0. 5. FORMAT "%5.3" /end AXIS_PTS
/begin CHARACTERISTIC ip_put_mes_bas "Conversion characteristic for PUT_MES_BAS" CURVE 0xa10276fc _REC_CUR_20_u2_u2 5434. _CNV_A_R_LINEAR_____26_CM 0. 5434. DISPLAY_IDENTIFIER IP_PUT_MES_BAS FORMAT "%7.2"
 /begin AXIS_DESCR COM_AXIS v_put _CNV_A_R_LINEAR_____2_CM 2 0. 5. FORMAT "%5.3" AXIS_PTS_REF ldp_v_put__put_mes_bas /end AXIS_DESCR
/end CHARACTERISTIC
/begin CHARACTERISTIC lc_map_absv_rel_swi "Switch for calculation map_mes_bas with measured absolut or relative pressure" VALUE 0xa1029d77 _REC_VAL_20_u1 1. _CNV_A_R_LINEAR_____0_CM 0. 1. DISPLAY_IDENTIFIER LC_MAP_ABSV_REL_SWI FORMAT "%1.0" /end CHARACTERISTIC
/begin CHARACTERISTIC lc_put_absv_rel_swi "Switch for calculation put_mes_bas with measured absolut or relative pressure" VALUE 0xa1029dba _REC_VAL_20_u1 1. _CNV_A_R_LINEAR_____0_CM 0. 1. DISPLAY_IDENTIFIER LC_PUT_ABSV_REL_SWI FORMAT "%1.0" /end CHARACTERISTIC
/begin MEASUREMENT map_dip_mes_bas "Intake manifold air pressure per segment measured" UWORD _CNV_A_R_LINEAR_____26_CM 1 100. 0. 5434. DISPLAY_IDENTIFIER MAP_DIP_MES_BAS ECU_ADDRESS 0xd0004da8 FORMAT "%7.2" /end MEASUREMENT
/begin MEASUREMENT put_mes_bas "Intake manifold pressure up throttle per segment measured" UWORD _CNV_A_R_LINEAR_____26_CM 1 100. 0. 5434. DISPLAY_IDENTIFIER PUT_MES_BAS ECU_ADDRESS 0xd0004dae FORMAT "%7.2" /end MEASUREMENT
/begin MEASUREMENT map_dip_mes_bas_2seg "Intake manifold air pressure per second segment measured" UWORD _CNV_A_R_LINEAR_____26_CM 1 100. 0. 5434. DISPLAY_IDENTIFIER MAP_DIP_MES_BAS_2SEG ECU_ADDRESS 0xd0004daa FORMAT "%7.2" /end MEASUREMENT
/begin MEASUREMENT put_mes_bas_2seg "Intake manifold pressure up throttle per second segment measured" UWORD _CNV_A_R_LINEAR_____26_CM 1 100. 0. 5434. DISPLAY_IDENTIFIER PUT_MES_BAS_2SEG ECU_ADDRESS 0xd0004db0 FORMAT "%7.2" /end MEASUREMENT
/begin MEASUREMENT v_map "Voltage of the intake manifold pressure sensor (for diagnosis)" UWORD _CNV_A_R_LINEAR_____2_CM 1 100. 0. 5. DISPLAY_IDENTIFIER V_MAP ECU_ADDRESS 0xd0004dac FORMAT "%5.3" /end MEASUREMENT
/begin MEASUREMENT v_put "Voltage of the intake manifold pressure sensor up throttle (for diagnosis)" UWORD _CNV_A_R_LINEAR_____2_CM 1 100. 0. 5. DISPLAY_IDENTIFIER V_PUT ECU_ADDRESS 0xd0004db2 FORMAT "%5.3" /end MEASUREMENT
/begin CHARACTERISTIC ip_map_mes_bas "Conversion characteristic for MAP_MES_BAS" CURVE 0xa102616c _REC_CUR_20_u2_u2 5434. _CNV_A_R_LINEAR_____26_CM 0. 5434. DISPLAY_IDENTIFIER IP_MAP_MES_BAS__V_MAP FORMAT "%7.2"
 /begin AXIS_DESCR COM_AXIS v_map _CNV_A_R_LINEAR_____2_CM 2 0. 5. FORMAT "%5.3" AXIS_PTS_REF ldp_v_map__map_mes_bas /end AXIS_DESCR
/end CHARACTERISTIC
/begin AXIS_PTS ldp_v_map__map_mes_bas "" 0xa102165e v_map _REC_AXS_20_u2 4.5 _CNV_A_R_LINEAR_____2_CM 2 0. 5. FORMAT "%5.3" /end AXIS_PTS
/begin MEASUREMENT ptcha_1 "Pressure up turbo charger 1" UWORD _CNV_A_R_LINEAR_____26_CM 1 100. 0. 5434. DISPLAY_IDENTIFIER PTCHA_1 ECU_ADDRESS 0xd0004db4 FORMAT "%7.2" /end MEASUREMENT
/begin MEASUREMENT ptcha_2 "Pressure up turbo charger 2" UWORD _CNV_A_R_LINEAR_____26_CM 1 100. 0. 5434. DISPLAY_IDENTIFIER PTCHA_2 ECU_ADDRESS 0xd0004db6 FORMAT "%7.2" /end MEASUREMENT
/begin AXIS_PTS ldp_v_ptcha_1__ptcha_1 "" 0xa1021664 online_dummy _REC_AXS_20_u2 4.5 _CNV_A_R_LINEAR_____2_CM 2 0. 5. FORMAT "%5.3" /end AXIS_PTS
/begin AXIS_PTS ldp_v_ptcha_2__ptcha_2 "" 0xa102166a online_dummy _REC_AXS_20_u2 4.5 _CNV_A_R_LINEAR_____2_CM 2 0. 5. FORMAT "%5.3" /end AXIS_PTS
/begin CHARACTERISTIC ip_ptcha_1 "Conversion characteristic for PTCHA_1" CURVE 0xa10276f4 _REC_CUR_20_u2_u2 5434. _CNV_A_R_LINEAR_____26_CM 0. 5434. DISPLAY_IDENTIFIER IP_PTCHA_1 FORMAT "%7.2"
 /begin AXIS_DESCR COM_AXIS online_dummy _CNV_A_R_LINEAR_____2_CM 2 0. 5. FORMAT "%5.3" AXIS_PTS_REF ldp_v_ptcha_1__ptcha_1 /end AXIS_DESCR
/end CHARACTERISTIC
/begin CHARACTERISTIC ip_ptcha_2 "Conversion characteristic for PTCHA_2" CURVE 0xa10276f8 _REC_CUR_20_u2_u2 5434. _CNV_A_R_LINEAR_____26_CM 0. 5434. DISPLAY_IDENTIFIER IP_PTCHA_2 FORMAT "%7.2"
 /begin AXIS_DESCR COM_AXIS online_dummy _CNV_A_R_LINEAR_____2_CM 2 0. 5. FORMAT "%5.3" AXIS_PTS_REF ldp_v_ptcha_2__ptcha_2 /end AXIS_DESCR
/end CHARACTERISTIC
/begin CHARACTERISTIC lc_ptcha_absv_rel_swi "Switch for Calculation PTCHA_1/2 with measured absolute (1) or relative pressure (0)" VALUE 0xa1029db9 _REC_VAL_20_u1 1. _CNV_A_R_LINEAR_____0_CM 0. 1. DISPLAY_IDENTIFIER LC_PTCHA_ABSV_REL_SWI FORMAT "%1.0" /end CHARACTERISTIC
/begin MEASUREMENT temp_map_dip_mdl "estimated temperature of manifold pressure sensor" UBYTE _CNV_A_R_LINEAR_____16_CM 1 100. -48. 142.5 DISPLAY_IDENTIFIER TEMP_MAP_DIP_MDL ECU_ADDRESS 0xc00008d8 FORMAT "%6.2" /end MEASUREMENT
/begin MEASUREMENT v_map_ad "adapted voltage offset of manifold pressure sensor" SWORD _CNV_A_R_LINEAR_____2_CM 1 100. -2.5 2.5 DISPLAY_IDENTIFIER V_MAP_AD ECU_ADDRESS 0xd0004dbc /end MEASUREMENT
/begin MEASUREMENT v_map_dif "deviation to nominal output at differential pressure 0" SWORD _CNV_A_R_LINEAR_____2_CM 1 100. -2.5 2.5 DISPLAY_IDENTIFIER V_MAP_DIF ECU_ADDRESS 0xd0004db8 /end MEASUREMENT
/begin MEASUREMENT v_map_dif_vld "Allowed sensor output deviation at differential pressure 0" SWORD _CNV_A_R_LINEAR_____2_CM 1 100. -2.5 2.5 DISPLAY_IDENTIFIER V_MAP_DIF_VLD ECU_ADDRESS 0xd0004dba /end MEASUREMENT
/begin MEASUREMENT lv_t_dly_map_mes_ad "logical value delay time for manifold evacuation is over" UBYTE _CNV_S_2_RANGE__0___1_CM 1 100. 0. 1. DISPLAY_IDENTIFIER LV_T_DLY_MAP_MES_AD ECU_ADDRESS 0xc00008db /end MEASUREMENT
/begin CHARACTERISTIC c_t_dly_map_mes_ad "Delay time after LV_ES detection before starting adaptation of sensor characteristic" VALUE 0xa1029870 _REC_VAL_20_u2 10.23 _CNV_A_R_LINEAR_____3_CM 0. 10.23 DISPLAY_IDENTIFIER C_T_DLY_MAP_MES_AD FORMAT "%5.2" /end CHARACTERISTIC
/begin CHARACTERISTIC c_tps_v_map_ad_min "minimum tps to enable v_map adaptation" VALUE 0xa1029ad4 _REC_VAL_20_u2 119.5 _CNV_A_R_LINEAR_____221_CM 0. 119.5 DISPLAY_IDENTIFIER C_TPS_V_MAP_AD_MIN FORMAT "%7.3" /end CHARACTERISTIC
/begin CHARACTERISTIC c_fac_temp_map_dip_tco_ex "factor for tco_ex correction for map_dip temperature model" VALUE 0xa10293a1 _REC_VAL_20_u1 0.99609375 _CNV_A_R_LINEAR_____27_CM 0. 0.99609375 DISPLAY_IDENTIFIER C_FAC_TEMP_MAP_DIP_TCO_EX FORMAT "%5.3" /end CHARACTERISTIC
/begin CHARACTERISTIC c_fac_temp_map_dip_tia "factor for tia correction for map_dip temperature model" VALUE 0xa10293a2 _REC_VAL_20_u1 0.99609375 _CNV_A_R_LINEAR_____27_CM 0. 0.99609375 DISPLAY_IDENTIFIER C_FAC_TEMP_MAP_DIP_TIA FORMAT "%5.3" /end CHARACTERISTIC
/begin CHARACTERISTIC c_fac_temp_map_dip_tam "factor for tam correction for map_dip temperature model" VALUE 0xa10293a0 _REC_VAL_20_u1 0.99609375 _CNV_A_R_LINEAR_____27_CM 0. 0.99609375 DISPLAY_IDENTIFIER C_FAC_TEMP_MAP_DIP_TAM FORMAT "%5.3" /end CHARACTERISTIC
/begin CHARACTERISTIC c_fac_v_map_ad "factor for tam correction for map_dip temperature model" VALUE 0xa10293cb _REC_VAL_20_u1 0.99609375 _CNV_A_R_LINEAR_____27_CM 0. 0.99609375 DISPLAY_IDENTIFIER C_FAC_V_MAP_AD FORMAT "%5.3" /end CHARACTERISTIC
/begin CHARACTERISTIC c_fac_temp_v_map_ad "factor for tam correction for map_dip temperature model" VALUE 0xa10293a3 _REC_VAL_20_u1 0.99609375 _CNV_A_R_LINEAR_____27_CM 0. 0.99609375 DISPLAY_IDENTIFIER C_FAC_TEMP_V_MAP_AD FORMAT "%5.3" /end CHARACTERISTIC
/begin CHARACTERISTIC c_nr_v_map_acq "number of acquisitions to build the mean value v_map_mv" VALUE 0xa10296bf _REC_VAL_20_u1 255. _CNV_A_R_LINEAR_____0_CM 0. 255. DISPLAY_IDENTIFIER C_NR_V_MAP_ACQ FORMAT "%3.0" /end CHARACTERISTIC
/begin CHARACTERISTIC c_v_map_sp_ad "number of acquisitions to build the mean value v_map_mv" VALUE 0xa1029b72 _REC_VAL_20_u2 2.5 _CNV_A_R_LINEAR_____2_CM 0. 2.5 DISPLAY_IDENTIFIER C_V_MAP_SP_AD FORMAT "%5.3" /end CHARACTERISTIC
/begin CHARACTERISTIC c_v_map_ad_max "setpoint of map sensor output at stopped engine" VALUE 0xa1029b6c _REC_VAL_20_u2 2.5 _CNV_A_R_LINEAR_____2_CM 0. 2.5 DISPLAY_IDENTIFIER C_V_MAP_AD_MAX FORMAT "%5.3" /end CHARACTERISTIC
/begin CHARACTERISTIC c_temp_map_dip_mdl_fac_min "lower temp_map_dip_mdl temperature threshold to switch adaptation/diagnosis values" VALUE 0xa1029a23 _REC_VAL_20_u1 190.5 _CNV_A_R_LINEAR_____16_CM -48. 142.5 DISPLAY_IDENTIFIER C_TEMP_MAP_DIP_MDL_FAC_MIN FORMAT "%6.2" /end CHARACTERISTIC
/begin CHARACTERISTIC c_temp_map_dip_mdl_fac_max "upper temp_map_dip_mdl temperature threshold to switch adaptation/diagnosis values" VALUE 0xa1029a22 _REC_VAL_20_u1 190.5 _CNV_A_R_LINEAR_____16_CM -48. 142.5 DISPLAY_IDENTIFIER C_TEMP_MAP_DIP_MDL_FAC_MAX FORMAT "%6.2" /end CHARACTERISTIC
/begin CHARACTERISTIC c_v_map_sp_dif_max "allowed sensor output deviation at stopped engine at regular temperature condition" VALUE 0xa1029b74 _REC_VAL_20_s2 5. _CNV_A_R_LINEAR_____2_CM -2.5 2.5 DISPLAY_IDENTIFIER C_V_MAP_SP_DIF_MAX /end CHARACTERISTIC
/begin CHARACTERISTIC c_fac_temp_v_map_sp_dif_max "factor on allowed sensor output deviation at stopped engine at irregular temperature condition" VALUE 0xa10293a4 _REC_VAL_20_u1 1.9921875 _CNV_A_R_LINEAR_____100_CM 0. 1.9921875 DISPLAY_IDENTIFIER C_FAC_TEMP_V_MAP_SP_DIF_MAX FORMAT "%8.6" /end CHARACTERISTIC
/begin MEASUREMENT iga_igc_0_5_h_rng "Ignition angle applied on the respective cylinder (0 to 5)" SWORD _CNV_A_R_LINEAR_____166_CM 1 100. -90. 90. DISPLAY_IDENTIFIER IGA_IGC_0_5_H_RNG ECU_ADDRESS 0xd00050aa FORMAT "%8.4" /end MEASUREMENT
/begin MEASUREMENT iga_knk_0_5 "Spark retard due to knocking combustion of the respective cylinder (0 to 5)" UBYTE _CNV_A_R_LINEAR_____171_CM 1 100. -48. 0. DISPLAY_IDENTIFIER IGA_KNK_0_5 ECU_ADDRESS 0xc0000958 FORMAT "%5.1" /end MEASUREMENT
/begin MEASUREMENT knk_thd_0_5 "Knock threshold of the respective cylinder (0 to 5)" UBYTE _CNV_A_R_LINEAR_____189_CM 1 100. 0. 4.998 DISPLAY_IDENTIFIER KNK_THD_0_5 ECU_ADDRESS 0xc0000959 FORMAT "%6.4" /end MEASUREMENT
/begin MEASUREMENT nl_0_5 "Noise level of the respective cylinder (0 to 5)" UWORD _CNV_A_R_LINEAR_____190_CM 1 100. 0. 4.99992371 DISPLAY_IDENTIFIER NL_0_5 ECU_ADDRESS 0xc000094e FORMAT "%7.5" /end MEASUREMENT
/begin MEASUREMENT knks_0_5 "Knock control signal of the respective cylinder (0 to 5)" UWORD _CNV_A_R_LINEAR_____190_CM 1 100. 0. 4.99992371 DISPLAY_IDENTIFIER KNKS_0_5 ECU_ADDRESS 0xc000094c FORMAT "%7.5" /end MEASUREMENT
/begin MEASUREMENT knks_rel_nl_0_5 "Relative knock value" UWORD _CNV_A_R_LINEAR_____232_CM 1 100. 0. 1. DISPLAY_IDENTIFIER KNKS_REL_NL_0_5 ECU_ADDRESS 0xd00050a8 FORMAT "%6.4" /end MEASUREMENT
/begin MEASUREMENT ti_1_hom_0_5 "Cylinder individual injection time, homogeneous mode, first pulse (0 to 5)" UWORD _CNV_A_R_LINEAR_____233_CM 1 100. 0. 65.535 DISPLAY_IDENTIFIER TI_1_HOM_0_5 ECU_ADDRESS 0xc0000950 /end MEASUREMENT
/begin MEASUREMENT ti_2_hom_0_5 "Cylinder individual injection time, homogeneous mode, second pulse (0 to 5)" UWORD _CNV_A_R_LINEAR_____233_CM 1 100. 0. 65.535 DISPLAY_IDENTIFIER TI_2_HOM_0_5 ECU_ADDRESS 0xc0000952 /end MEASUREMENT
/begin MEASUREMENT ti_2_s_0_5 "Cylinder individual injection time, stratified mode, second pulse (0 to 5)" UWORD _CNV_A_R_LINEAR_____233_CM 1 100. 0. 65.535 DISPLAY_IDENTIFIER TI_2_S_0_5 ECU_ADDRESS 0xc0000956 /end MEASUREMENT
/begin MEASUREMENT ti_1_s_0_5 "Cylinder individual injection time, stratified mode, first pulse (0 to 5)" UWORD _CNV_A_R_LINEAR_____233_CM 1 100. 0. 65.535 DISPLAY_IDENTIFIER TI_1_S_0_5 ECU_ADDRESS 0xc0000954 /end MEASUREMENT
/begin CHARACTERISTIC c_t_es_tco_plaus_max "Threshold for maximum T_ES time" VALUE 0xa1029896 _REC_VAL_20_u2 65535. _CNV_A_R_LINEAR_____77_CM 0. 65535. DISPLAY_IDENTIFIER C_T_ES_TCO_PLAUS_MAX FORMAT "%5.0" /end CHARACTERISTIC
/begin CHARACTERISTIC c_t_es_tco_plaus_min "Threshold for minimum T_ES time" VALUE 0xa1029898 _REC_VAL_20_u2 65535. _CNV_A_R_LINEAR_____77_CM 0. 65535. DISPLAY_IDENTIFIER C_T_ES_TCO_PLAUS_MIN FORMAT "%5.0" /end CHARACTERISTIC
/begin CHARACTERISTIC c_tco_stop_t_es_plaus_min "Threshold for minimum differences of cooling temperature " VALUE 0xa10299f3 _REC_VAL_20_u1 190.5 _CNV_A_R_LINEAR_____24_CM 0. 190.5 DISPLAY_IDENTIFIER C_TCO_STOP_T_ES_PLAUS_MIN FORMAT "%5.1" /end CHARACTERISTIC
/begin CHARACTERISTIC c_t_es_sub "substitute value of T_ES" VALUE 0xa1029894 _REC_VAL_20_u2 65535. _CNV_A_R_LINEAR_____77_CM 0. 65535. DISPLAY_IDENTIFIER C_T_ES_SUB FORMAT "%5.0" /end CHARACTERISTIC
/begin CHARACTERISTIC c_tco_stop_t_es_plaus_max "Threshold for maximum differences of cooling temperature" VALUE 0xa10299f2 _REC_VAL_20_u1 190.5 _CNV_A_R_LINEAR_____24_CM 0. 190.5 DISPLAY_IDENTIFIER C_TCO_STOP_T_ES_PLAUS_MAX FORMAT "%5.1" /end CHARACTERISTIC
/begin CHARACTERISTIC c_tco_stop_t_es_min "Threshold for minimum cooling temperature at engine stop" VALUE 0xa10299f1 _REC_VAL_20_u1 190.5 _CNV_A_R_LINEAR_____16_CM -48. 142.5 DISPLAY_IDENTIFIER C_TCO_STOP_T_ES_MIN FORMAT "%5.1" /end CHARACTERISTIC
/begin MEASUREMENT t_es "Engine off duration" UWORD _CNV_A_R_LINEAR_____77_CM 1 100. 0. 65535. DISPLAY_IDENTIFIER T_ES ECU_ADDRESS 0xd00050ac FORMAT "%5.0" /end MEASUREMENT
/begin MEASUREMENT t_rel_can_es "Time counter value at the start of engine off phase" ULONG _CNV_A_R_LINEAR_____77_CM 1 100. 0. 4294967295. DISPLAY_IDENTIFIER T_REL_CAN_ES ECU_ADDRESS 0xd00057d8 FORMAT "%10.0" /end MEASUREMENT
/begin MEASUREMENT t_rel_can_st "Time counter value at the end of engine off phase" ULONG _CNV_A_R_LINEAR_____77_CM 1 100. 0. 4294967295. DISPLAY_IDENTIFIER T_REL_CAN_ST ECU_ADDRESS 0xc0000ba0 FORMAT "%10.0" /end MEASUREMENT
/begin MEASUREMENT lv_t_rel_can_reg "T_REL_CAN receiving of INSTR2 message" UBYTE _CNV_S_2_RANGE__0___1_CM 1 100. 0. 1. DISPLAY_IDENTIFIER LV_T_REL_CAN_REG ECU_ADDRESS 0xd0003c88 BIT_MASK 0x1 /end MEASUREMENT
/begin MEASUREMENT lv_t_es_not_plaus "T_ES not plausible" UBYTE _CNV_S_2_RANGE__0___1_CM 1 100. 0. 1. DISPLAY_IDENTIFIER LV_T_ES_NOT_PLAUS ECU_ADDRESS 0xd0003c89 BIT_MASK 0x1 /end MEASUREMENT
/begin MEASUREMENT t_es_cus "Engine off duration time for customer - value holds while engine is running" UWORD _CNV_A_R_LINEAR_____77_CM 1 100. 0. 65535. DISPLAY_IDENTIFIER T_ES_CUS ECU_ADDRESS 0xd00050ae FORMAT "%5.0" /end MEASUREMENT
/begin MEASUREMENT ctr_stc_tecu_1 "statistic counter 1 for TECU monitoring" ULONG _CNV_A_R_LINEAR_____0_CM 1 100. 0. 4294967295. DISPLAY_IDENTIFIER CTR_STC_TECU_1 ECU_ADDRESS 0xd0004f94 FORMAT "%10.0" /end MEASUREMENT
/begin MEASUREMENT ctr_stc_tecu_2 "statistic counter 2 for TECU monitoring" ULONG _CNV_A_R_LINEAR_____0_CM 1 100. 0. 4294967295. DISPLAY_IDENTIFIER CTR_STC_TECU_2 ECU_ADDRESS 0xd0004f98 FORMAT "%10.0" /end MEASUREMENT
/begin MEASUREMENT ctr_stc_tecu_3 "statistic counter 3 for TECU monitoring" ULONG _CNV_A_R_LINEAR_____0_CM 1 100. 0. 4294967295. DISPLAY_IDENTIFIER CTR_STC_TECU_3 ECU_ADDRESS 0xd0004f9c FORMAT "%10.0" /end MEASUREMENT
/begin MEASUREMENT ctr_stc_tecu_4 "statistic counter 4 for TECU monitoring" ULONG _CNV_A_R_LINEAR_____0_CM 1 100. 0. 4294967295. DISPLAY_IDENTIFIER CTR_STC_TECU_4 ECU_ADDRESS 0xd0004fa0 FORMAT "%10.0" /end MEASUREMENT
/begin MEASUREMENT ctr_stc_tecu_5 "statistic counter 5 for TECU monitoring" ULONG _CNV_A_R_LINEAR_____0_CM 1 100. 0. 4294967295. DISPLAY_IDENTIFIER CTR_STC_TECU_5 ECU_ADDRESS 0xd0004fa4 FORMAT "%10.0" /end MEASUREMENT
/begin MEASUREMENT ctr_stc_tecu_6 "statistic counter 6 for TECU monitoring" ULONG _CNV_A_R_LINEAR_____0_CM 1 100. 0. 4294967295. DISPLAY_IDENTIFIER CTR_STC_TECU_6 ECU_ADDRESS 0xd0004fa8 FORMAT "%10.0" /end MEASUREMENT
/begin MEASUREMENT ctr_stc_tecu_7 "statistic counter 7 for TECU monitoring" ULONG _CNV_A_R_LINEAR_____0_CM 1 100. 0. 4294967295. DISPLAY_IDENTIFIER CTR_STC_TECU_7 ECU_ADDRESS 0xd0004fac FORMAT "%10.0" /end MEASUREMENT
/begin MEASUREMENT ctr_stc_tecu_8 "statistic counter 8 for TECU monitoring" ULONG _CNV_A_R_LINEAR_____0_CM 1 100. 0. 4294967295. DISPLAY_IDENTIFIER CTR_STC_TECU_8 ECU_ADDRESS 0xd0004fb0 FORMAT "%10.0" /end MEASUREMENT
/begin CHARACTERISTIC ip_tecu "NTC characteristic" CURVE 0xa1027df8 _REC_CUR_20_u1_u2 190.5 _CNV_A_R_LINEAR_____16_CM -48. 142.5 DISPLAY_IDENTIFIER IP_TECU FORMAT "%5.1"
 /begin AXIS_DESCR COM_AXIS v_tecu _CNV_A_R_LINEAR_____2_CM 16 0. 4.9951171875 FORMAT "%5.3" AXIS_PTS_REF ldp_v_tecu__tecu /end AXIS_DESCR
/end CHARACTERISTIC
/begin CHARACTERISTIC c_tecu_sub "TECU substitute value" VALUE 0xa10299f8 _REC_VAL_20_u1 190.5 _CNV_A_R_LINEAR_____16_CM -48. 142.5 DISPLAY_IDENTIFIER C_TECU_SUB FORMAT "%5.1" /end CHARACTERISTIC
/begin CHARACTERISTIC c_tecu_thd_1 "ETCU threshold 1" VALUE 0xa10299f9 _REC_VAL_20_u1 190.5 _CNV_A_R_LINEAR_____16_CM -48. 142.5 DISPLAY_IDENTIFIER C_TECU_THD_1 FORMAT "%5.1" /end CHARACTERISTIC
/begin CHARACTERISTIC c_tecu_thd_2 "ETCU threshold 2" VALUE 0xa10299fa _REC_VAL_20_u1 190.5 _CNV_A_R_LINEAR_____16_CM -48. 142.5 DISPLAY_IDENTIFIER C_TECU_THD_2 FORMAT "%5.1" /end CHARACTERISTIC
/begin CHARACTERISTIC c_tecu_thd_3 "ETCU threshold 3" VALUE 0xa10299fb _REC_VAL_20_u1 190.5 _CNV_A_R_LINEAR_____16_CM -48. 142.5 DISPLAY_IDENTIFIER C_TECU_THD_3 FORMAT "%5.1" /end CHARACTERISTIC
/begin CHARACTERISTIC c_tecu_thd_4 "ETCU threshold 4" VALUE 0xa10299fc _REC_VAL_20_u1 190.5 _CNV_A_R_LINEAR_____16_CM -48. 142.5 DISPLAY_IDENTIFIER C_TECU_THD_4 FORMAT "%5.1" /end CHARACTERISTIC
/begin CHARACTERISTIC c_tecu_thd_5 "ETCU threshold 5" VALUE 0xa10299fd _REC_VAL_20_u1 190.5 _CNV_A_R_LINEAR_____16_CM -48. 142.5 DISPLAY_IDENTIFIER C_TECU_THD_5 FORMAT "%5.1" /end CHARACTERISTIC
/begin CHARACTERISTIC c_tecu_thd_6 "ETCU threshold 6" VALUE 0xa10299fe _REC_VAL_20_u1 190.5 _CNV_A_R_LINEAR_____16_CM -48. 142.5 DISPLAY_IDENTIFIER C_TECU_THD_6 FORMAT "%5.1" /end CHARACTERISTIC
/begin CHARACTERISTIC c_tecu_thd_7 "ETCU threshold 7" VALUE 0xa10299ff _REC_VAL_20_u1 190.5 _CNV_A_R_LINEAR_____16_CM -48. 142.5 DISPLAY_IDENTIFIER C_TECU_THD_7 FORMAT "%5.1" /end CHARACTERISTIC
/begin CHARACTERISTIC c_trt_dif_tecu "TRT difference for ETCU statistic" VALUE 0xa1029b4a _REC_VAL_20_u4 119304.6471 _CNV_A_R_LINEAR_____137_CM 0. 119304.6471 DISPLAY_IDENTIFIER C_TRT_DIF_TECU FORMAT "%12.5" /end CHARACTERISTIC
/begin MEASUREMENT tecu "ECU temperature" UBYTE _CNV_A_R_LINEAR_____16_CM 1 100. -48. 142.5 DISPLAY_IDENTIFIER TECU ECU_ADDRESS 0xd0003b80 FORMAT "%5.1" /end MEASUREMENT
/begin AXIS_PTS ldp_v_tecu__tecu "" 0xa102167c v_tecu _REC_AXS_20_u2 4.49560546875 _CNV_A_R_LINEAR_____2_CM 16 0. 4.9951171875 FORMAT "%5.3" /end AXIS_PTS
/begin MEASUREMENT tps_av_1 "Opening angle of the throttle valve of TPS-Poti 1" UWORD _CNV_A_R_LINEAR_____221_CM 1 100. 0. 119.5 DISPLAY_IDENTIFIER TPS_AV_1 ECU_ADDRESS 0xd000527e FORMAT "%7.3" /end MEASUREMENT
/begin MEASUREMENT tps_av_2 "Opening angle of the throttle valve of TPS-Poti 2" UWORD _CNV_A_R_LINEAR_____221_CM 1 100. 0. 119.5 DISPLAY_IDENTIFIER TPS_AV_2 ECU_ADDRESS 0xd0005280 FORMAT "%7.3" /end MEASUREMENT
/begin MEASUREMENT tps_grd "Throttle position gradient, absolute value" UBYTE _CNV_A_R_LINEAR_____260_CM 1 100. 0. 2987.5 DISPLAY_IDENTIFIER TPS_GRD ECU_ADDRESS 0xd0003e8c FORMAT "%4.0" /end MEASUREMENT
/begin MEASUREMENT tps_seg "Segment synchronous measured throttle valve position" UWORD _CNV_A_R_LINEAR_____221_CM 1 100. 0. 119.5 DISPLAY_IDENTIFIER TPS_SEG ECU_ADDRESS 0xd0005274 FORMAT "%7.3" /end MEASUREMENT
/begin MEASUREMENT tps_seg_1 "Segment synchronous measured throttle valve position channel 1" UWORD _CNV_A_R_LINEAR_____221_CM 1 100. 0. 119.5 DISPLAY_IDENTIFIER TPS_SEG_1 ECU_ADDRESS 0xd0005276 FORMAT "%7.3" /end MEASUREMENT
/begin MEASUREMENT tps_seg_2 "Segment synchronous measured throttle valve position channel 2" UWORD _CNV_A_R_LINEAR_____221_CM 1 100. 0. 119.5 DISPLAY_IDENTIFIER TPS_SEG_2 ECU_ADDRESS 0xd0005278 FORMAT "%7.3" /end MEASUREMENT
/begin MEASUREMENT tps_seg_gain_1 "Segment synchronous measured throttle valve position amplified channel 1" UWORD _CNV_A_R_LINEAR_____221_CM 1 100. 0. 119.5 DISPLAY_IDENTIFIER TPS_SEG_GAIN_1 ECU_ADDRESS 0xd000527a FORMAT "%7.3" /end MEASUREMENT
/begin MEASUREMENT tps_av_gain_1 "Opening angle of the throttle valve of amplified TPS-Poti 1" UWORD _CNV_A_R_LINEAR_____221_CM 1 100. 0. 119.5 DISPLAY_IDENTIFIER TPS_AV_GAIN_1 ECU_ADDRESS 0xc0000ca0 FORMAT "%7.3" /end MEASUREMENT
/begin MEASUREMENT v_tps_gain_tol_ena_1 "TPS1-voltage to switch from amplified to non-amplified sensor signal" UWORD _CNV_A_R_LINEAR_____2_CM 1 100. 0. 4.9951171875 DISPLAY_IDENTIFIER V_TPS_GAIN_TOL_ENA_1 ECU_ADDRESS 0xc0000ca4 FORMAT "%5.3" /end MEASUREMENT
/begin MEASUREMENT v_tps_gain_bol_ena_1 "TPS1-voltage to switch from non-amplified to amplified sensor signal" UWORD _CNV_A_R_LINEAR_____2_CM 1 100. 0. 4.9951171875 DISPLAY_IDENTIFIER V_TPS_GAIN_BOL_ENA_1 ECU_ADDRESS 0xc0000ca6 FORMAT "%5.3" /end MEASUREMENT
/begin CHARACTERISTIC c_v_tps_swi_gain_1 "" VALUE 0xa1029bc2 _REC_VAL_20_u2 4.9951171875 _CNV_A_R_LINEAR_____2_CM 0. 4.9951171875 DISPLAY_IDENTIFIER C_V_TPS_SWI_GAIN_1 FORMAT "%5.3" /end CHARACTERISTIC
/begin CHARACTERISTIC c_v_tps_hys_gain_1 "" VALUE 0xa1029bb0 _REC_VAL_20_u2 4.9951171875 _CNV_A_R_LINEAR_____2_CM 0. 4.9951171875 DISPLAY_IDENTIFIER C_V_TPS_HYS_GAIN_1 FORMAT "%5.3" /end CHARACTERISTIC
/begin MEASUREMENT tps_lih "Limp home position of the throttle valve" UWORD _CNV_A_R_LINEAR_____221_CM 1 100. 0. 119.5 DISPLAY_IDENTIFIER TPS_LIH ECU_ADDRESS 0xd0005284 FORMAT "%7.3" /end MEASUREMENT
/begin MEASUREMENT tps_av "Opening angle of the throttle valve" UWORD _CNV_A_R_LINEAR_____221_CM 1 100. 0. 119.5 DISPLAY_IDENTIFIER TPS_AV ECU_ADDRESS 0xd000527c FORMAT "%7.3" /end MEASUREMENT
/begin MEASUREMENT tps_av_ctl "Control opening angle of the throttle valve" SWORD _CNV_A_R_LINEAR_____229_CM 1 100. -119.5 119.5 DISPLAY_IDENTIFIER TPS_AV_CTL ECU_ADDRESS 0xd0005282 FORMAT "%8.3" /end MEASUREMENT
/begin MEASUREMENT tps_av_ctl_1 "Control opening angle of the throttle valve of TPS-Poti 1" SWORD _CNV_A_R_LINEAR_____229_CM 1 100. -119.5 119.5 DISPLAY_IDENTIFIER TPS_AV_CTL_1 ECU_ADDRESS 0xd0005286 FORMAT "%8.3" /end MEASUREMENT
/begin MEASUREMENT tps_av_ctl_2 "Control opening angle of the throttle valve of TPS-Poti 2" SWORD _CNV_A_R_LINEAR_____229_CM 1 100. -119.5 119.5 DISPLAY_IDENTIFIER TPS_AV_CTL_2 ECU_ADDRESS 0xd0005288 FORMAT "%8.3" /end MEASUREMENT
/begin MEASUREMENT tps_av_ctl_gain_1 "Control opening angle of the throttle valve of amplified TPS-Poti 1" SWORD _CNV_A_R_LINEAR_____229_CM 1 100. -119.5 119.5 DISPLAY_IDENTIFIER TPS_AV_CTL_GAIN_1 ECU_ADDRESS 0xc0000ca2 FORMAT "%8.3" /end MEASUREMENT
/begin CHARACTERISTIC c_v_tps_grd_max "" VALUE 0xa1029bae _REC_VAL_20_u2 4.9951171875 _CNV_A_R_LINEAR_____2_CM 0. 4.9951171875 DISPLAY_IDENTIFIER C_V_TPS_GRD_MAX FORMAT "%5.3" /end CHARACTERISTIC
/begin CHARACTERISTIC c_v_tps_gain_grd_max "TPS voltage gradient limitation" VALUE 0xa1029bac _REC_VAL_20_u2 4.9951171875 _CNV_A_R_LINEAR_____2_CM 0. 4.9951171875 DISPLAY_IDENTIFIER C_V_TPS_GAIN_GRD_MAX FORMAT "%5.3" /end CHARACTERISTIC
/begin MEASUREMENT lv_tps_gain_act_1 "Logical variable for TPS_AV based on amplified TPS 1 " UBYTE _CNV_S_2_RANGE__0___1_CM 1 100. 0. 1. DISPLAY_IDENTIFIER LV_TPS_GAIN_ACT_1 ECU_ADDRESS 0xd0003e8d BIT_MASK 0x1 /end MEASUREMENT
/begin MEASUREMENT lv_tps_grd_up "Logical variable for throttle position gradient direction" UBYTE _CNV_S_2_RANGE__0___1_CM 1 100. 0. 1. DISPLAY_IDENTIFIER LV_TPS_GRD_UP ECU_ADDRESS 0xd0003e8e BIT_MASK 0x1 /end MEASUREMENT
/begin CHARACTERISTIC c_tps_max "Maximum mechanical opening angle of the throttle valve in degree" VALUE 0xa1029a9c _REC_VAL_20_u2 119.5 _CNV_A_R_LINEAR_____221_CM 0. 119.5 DISPLAY_IDENTIFIER C_TPS_MAX /end CHARACTERISTIC
/begin CHARACTERISTIC c_tps_slop "" VALUE 0xa1029aa0 _REC_VAL_20_u2 48. _CNV_A_R_LINEAR_____261_CM 0. 48. DISPLAY_IDENTIFIER C_TPS_SLOP FORMAT "%7.4" /end CHARACTERISTIC
/begin CHARACTERISTIC ip_tq_loss_acc_inp "ACC torque loss due to engine-speed and ACC torque demand" MAP 0xa1028988 _REC_MAP_20_u2_u1_u1 2047.96875 _CNV_A_R_LINEAR_____65_CM -1024. 1023.96875 DISPLAY_IDENTIFIER IP_TQ_LOSS_ACC_INP FORMAT "%6.2"
 /begin AXIS_DESCR COM_AXIS n_32 _CNV_A_R_LINEAR_____9_CM 6 0. 8160. FORMAT "%4.0" AXIS_PTS_REF ldp_n_32__tq_loss_acc /end AXIS_DESCR
 /begin AXIS_DESCR COM_AXIS tq_accin_can _CNV_A_R_LINEAR_____60_CM 6 0. 31. FORMAT "%3.0" AXIS_PTS_REF ldp_tq_accin_can__tq_loss_acc /end AXIS_DESCR
/end CHARACTERISTIC
/begin AXIS_PTS ldp_n_32__tq_loss_acc "" 0xa1020dd2 n_32 _REC_AXS_20_u1 8160. _CNV_A_R_LINEAR_____9_CM 6 0. 8160. FORMAT "%4.0" /end AXIS_PTS
/begin AXIS_PTS ldp_tq_accin_can__tq_loss_acc "" 0xa10214e6 tq_accin_can _REC_AXS_20_u1 31. _CNV_A_R_LINEAR_____60_CM 6 0. 31. FORMAT "%3.0" /end AXIS_PTS
/begin MEASUREMENT lv_err_bn_etcu "Present error BN2000" UBYTE _CNV_S_2_RANGE__0___1_CM 1 100. 0. 1. DISPLAY_IDENTIFIER LV_ERR_BN_ETCU ECU_ADDRESS 0xd0003450 BIT_MASK 0x1 /end MEASUREMENT
/begin MEASUREMENT lv_err_bn_etcu_2 "Present error BN2000" UBYTE _CNV_S_2_RANGE__0___1_CM 1 100. 0. 1. DISPLAY_IDENTIFIER LV_ERR_BN_ETCU_2 ECU_ADDRESS 0xd0003451 BIT_MASK 0x1 /end MEASUREMENT
/begin MEASUREMENT lv_err_bn_tq_amt "Present error BN2000" UBYTE _CNV_S_2_RANGE__0___1_CM 1 100. 0. 1. DISPLAY_IDENTIFIER LV_ERR_BN_TQ_AMT ECU_ADDRESS 0xd0003453 BIT_MASK 0x1 /end MEASUREMENT
/begin MEASUREMENT lv_err_bn_ars "Present error BN2000" UBYTE _CNV_S_2_RANGE__0___1_CM 1 100. 0. 1. DISPLAY_IDENTIFIER LV_ERR_BN_ARS ECU_ADDRESS 0xd000344a BIT_MASK 0x1 /end MEASUREMENT
/begin MEASUREMENT lv_err_bn_tq_tcs "Present error BN2000" UBYTE _CNV_S_2_RANGE__0___1_CM 1 100. 0. 1. DISPLAY_IDENTIFIER LV_ERR_BN_TQ_TCS ECU_ADDRESS 0xd000344c BIT_MASK 0x1 /end MEASUREMENT
/begin MEASUREMENT lv_err_bn_vs_tcs "Present error BN2000" UBYTE _CNV_S_2_RANGE__0___1_CM 1 100. 0. 1. DISPLAY_IDENTIFIER LV_ERR_BN_VS_TCS ECU_ADDRESS 0xd000344d BIT_MASK 0x1 /end MEASUREMENT
/begin MEASUREMENT lv_err_bn_tcs "Present error BN2000" UBYTE _CNV_S_2_RANGE__0___1_CM 1 100. 0. 1. DISPLAY_IDENTIFIER LV_ERR_BN_TCS ECU_ADDRESS 0xd000344e BIT_MASK 0x1 /end MEASUREMENT
/begin MEASUREMENT lv_err_tq_req_can "Torque request via CAN not plausible" UBYTE _CNV_S_2_RANGE__0___1_CM 1 100. 0. 1. DISPLAY_IDENTIFIER LV_ERR_TQ_REQ_CAN ECU_ADDRESS 0xd0003475 BIT_MASK 0x1 /end MEASUREMENT
/begin MEASUREMENT state_tq_can_plaus "" UBYTE _CNV_A_R_LINEAR_____0_CM 1 100. 0. 255. DISPLAY_IDENTIFIER STATE_TQ_CAN_PLAUS ECU_ADDRESS 0xd0003e5c FORMAT "%3.0" /end MEASUREMENT
/begin CHARACTERISTIC c_state_tq_can_plaus_ena "Mask for selective enabling of diagnoses" VALUE 0xa10297c9 _REC_VAL_20_u1 255. _CNV_A_R_LINEAR_____0_CM 0. 255. DISPLAY_IDENTIFIER C_STATE_TQ_CAN_PLAUS_ENA FORMAT "%3.0" /end CHARACTERISTIC
/begin MEASUREMENT lv_err_bn_ang_pste "Present error BN2000" UBYTE _CNV_S_2_RANGE__0___1_CM 1 100. 0. 1. DISPLAY_IDENTIFIER LV_ERR_BN_ANG_PSTE ECU_ADDRESS 0xd000345c BIT_MASK 0x1 /end MEASUREMENT
/begin MEASUREMENT trt "total running time" ULONG _CNV_A_R_LINEAR_____137_CM 1 100. 0. 119304.6471 DISPLAY_IDENTIFIER TRT ECU_ADDRESS 0xd00057dc FORMAT "%12.5" /end MEASUREMENT
/begin CHARACTERISTIC c_t_igk_lih "Timeout for LV_IGK=1 if no CAN message \"Klemmenstatus\" available" VALUE 0xa10298aa _REC_VAL_20_u1 2.55 _CNV_A_R_LINEAR_____3_CM 0. 2.55 DISPLAY_IDENTIFIER C_T_IGK_LIH FORMAT "%4.2" /end CHARACTERISTIC
/begin CHARACTERISTIC c_t_dly_igk_off_prel "Delay time ignition off after driver's command" VALUE 0xa1029861 _REC_VAL_20_u1 2.55 _CNV_A_R_LINEAR_____3_CM 0. 2.55 DISPLAY_IDENTIFIER C_T_DLY_IGK_OFF_PREL FORMAT "%4.2" /end CHARACTERISTIC
/begin CHARACTERISTIC c_t_temp_igk_off_prel "Temp. time prel. ignition off after CAS-HW-error during dc" VALUE 0xa1029976 _REC_VAL_20_u2 655.35 _CNV_A_R_LINEAR_____3_CM 0. 655.35 DISPLAY_IDENTIFIER C_T_TEMP_IGK_OFF_PREL FORMAT "%6.2" /end CHARACTERISTIC
/begin MEASUREMENT lv_wake_up "Wake up signal detected" UBYTE _CNV_S_2_RANGE__0___1_CM 1 100. 0. 1. DISPLAY_IDENTIFIER LV_WAKE_UP ECU_ADDRESS 0xd0003c98 BIT_MASK 0x1 /end MEASUREMENT
/begin MEASUREMENT dist "Distance accumulation [100m]" ULONG _CNV_A_R_LINEAR_____446_CM 1 100. 0. 429496729500. DISPLAY_IDENTIFIER DIST ECU_ADDRESS 0xd00057d4 FORMAT "%13.0" /end MEASUREMENT
/begin CHARACTERISTIC ip_t_ast_is_ad_inh "Time after start during which idle speed adaptation is disabled" CURVE 0xa100ac60 _REC_CUR_20_u2_u1 6553.5 _CNV_A_R_LINEAR_____4_CM 0. 6553.5 DISPLAY_IDENTIFIER IP_T_AST_IS_AD_INH FORMAT "%6.1"
 /begin AXIS_DESCR COM_AXIS tco _CNV_A_R_LINEAR_____16_CM 4 -48. 142.5 FORMAT "%5.1" AXIS_PTS_REF ldp_tco_ip_t_ast_is_ad_inh /end AXIS_DESCR
/end CHARACTERISTIC
/begin AXIS_PTS ldp_tco_ip_t_ast_is_ad_inh "" 0xa100ac32 tco _REC_AXS_20_u1 190.5 _CNV_A_R_LINEAR_____16_CM 4 -48. 142.5 FORMAT "%5.1" /end AXIS_PTS
/begin MEASUREMENT lv_err_plaus_igk_bn "plausibility error of IGK-signal from CAN/HW" UBYTE _CNV_S_2_RANGE__0___1_CM 1 100. 0. 1. DISPLAY_IDENTIFIER LV_ERR_PLAUS_IGK_BN ECU_ADDRESS 0xd0003474 BIT_MASK 0x1 /end MEASUREMENT
/begin MEASUREMENT load_bat "DF-Monitor for accumulator charge in %" UBYTE _CNV_A_R_LINEAR_____5_CM 1 100. 0. 99.609375 DISPLAY_IDENTIFIER LOAD_BAT ECU_ADDRESS 0xd00038b4 /end MEASUREMENT
/begin MEASUREMENT state_cur_eng_cns "current consumption of engine" SWORD _CNV_A_R_LINEAR_____459_CM 1 100. -32768. 32767. DISPLAY_IDENTIFIER STATE_CUR_ENG_CNS ECU_ADDRESS 0xd0004cc4 FORMAT "%6.0" /end MEASUREMENT
/begin MEASUREMENT n_st_pow_mod "engine speed at start for power module" UBYTE _CNV_A_R_LINEAR_____9_CM 1 100. 0. 8160. DISPLAY_IDENTIFIER N_ST_POW_MOD ECU_ADDRESS 0xd00038b7 FORMAT "%4.0" /end MEASUREMENT
/begin MEASUREMENT lv_n_sp_is_pow_act "nominal idle speed setpoint by powermanagement" UBYTE _CNV_S_2_RANGE__0___1_CM 1 100. 0. 1. DISPLAY_IDENTIFIER LV_N_SP_IS_POW_ACT ECU_ADDRESS 0xd00038c5 BIT_MASK 0x1 /end MEASUREMENT
/begin MEASUREMENT state_alter "Status of alternator diagnosis" UBYTE _CNV_A_R_LINEAR_____0_CM 1 100. 0. 255. DISPLAY_IDENTIFIER STATE_ALTER ECU_ADDRESS 0xd00038b9 FORMAT "%3.0" /end MEASUREMENT
/begin CHARACTERISTIC lc_pwsl_ena "Ultra-low-cost powermanagement enabled" VALUE 0xa1029dbe _REC_VAL_20_u1 1. _CNV_S_2_RANGE__0___1_CM 0. 1. DISPLAY_IDENTIFIER LC_PWSL_ENA /end CHARACTERISTIC
/begin CHARACTERISTIC c_bat_psn "Position of battery in vehicle" VALUE 0xa10291ad _REC_VAL_20_u1 255. _CNV_A_R_LINEAR_____0_CM 0. 255. DISPLAY_IDENTIFIER C_BAT_PSN FORMAT "%3.0" /end CHARACTERISTIC
/begin MEASUREMENT tq_loss_alter_1 "Torque losses by alternator" SWORD _CNV_A_R_LINEAR_____30_CM 1 100. -1024. 1023.96875 DISPLAY_IDENTIFIER TQ_LOSS_ALTER_1 ECU_ADDRESS 0xd0004cc8 FORMAT "%8.2" /end MEASUREMENT
/begin MEASUREMENT cur_alter_exct_lim_sp "setpoint alternator exciting current limitation" UBYTE _CNV_A_R_LINEAR_____423_CM 1 100. 0. 7.75 DISPLAY_IDENTIFIER CUR_ALTER_EXCT_LIM__SP ECU_ADDRESS 0xd00038c3 FORMAT "%4.2" /end MEASUREMENT
/begin MEASUREMENT cur_alter_max "maximum current alternator" UBYTE _CNV_A_R_LINEAR_____459_CM 1 100. 0. 255. DISPLAY_IDENTIFIER CUR_ALTER_MAX ECU_ADDRESS 0xd00038bb FORMAT "%4.1" /end MEASUREMENT
/begin MEASUREMENT pow_rel_alter_clc "calculated DF-signal from alternator" UBYTE _CNV_A_R_LINEAR_____5_CM 1 100. 0. 99.609375 DISPLAY_IDENTIFIER POW_REL_ALTER_CLC ECU_ADDRESS 0xd00038bc /end MEASUREMENT
/begin MEASUREMENT temp_alter "temperature alternator (for environmental fault memory)" UBYTE _CNV_A_R_LINEAR_____16_CM 1 100. -48. 142.5 DISPLAY_IDENTIFIER TEMP_ALTER ECU_ADDRESS 0xd00038bd FORMAT "%6.2" /end MEASUREMENT
/begin MEASUREMENT vb_pow_mng "current battery voltage" UWORD _CNV_A_R_LINEAR_____460_CM 1 100. 0. 61.425 DISPLAY_IDENTIFIER VB_POW_MNG ECU_ADDRESS 0xd0004cc6 FORMAT "%7.3" /end MEASUREMENT
/begin MEASUREMENT cur_gen "alternator current" UBYTE _CNV_A_R_LINEAR_____459_CM 1 100. 0. 255. DISPLAY_IDENTIFIER CUR_GEN ECU_ADDRESS 0xd00038b8 FORMAT "%4.1" /end MEASUREMENT
/begin MEASUREMENT lv_alter_swi_off "Logical variable indicating 'alternator switched off = 1'" UBYTE _CNV_S_2_RANGE__0___1_CM 1 100. 0. 1. DISPLAY_IDENTIFIER LV_ALTER_SWI_OFF ECU_ADDRESS 0xd00038c6 BIT_MASK 0x1 /end MEASUREMENT
/begin MEASUREMENT t_fil_cur_exct_alter "Calibratable filter time constant for  exciting current of the alternator (Powermanagement)" UBYTE _CNV_A_R_LINEAR_____3_CM 1 100. 0. 2.55 DISPLAY_IDENTIFIER T_FIL_CUR_EXCT_ALTER ECU_ADDRESS 0xd00038c4 FORMAT "%4.2" /end MEASUREMENT
/begin MEASUREMENT lv_n_sp_is_pwr_stab "request for idle speed setpoint due to power management request for power supply stability" UBYTE _CNV_S_2_RANGE__0___1_CM 1 100. 0. 1. DISPLAY_IDENTIFIER LV_N_SP_IS_PWR_STAB ECU_ADDRESS 0xd00038c7 /end MEASUREMENT
/begin MEASUREMENT lv_maf_ctl "MAF controlled system" UBYTE _CNV_S_2_RANGE__0___1_CM 1 100. 0. 1. DISPLAY_IDENTIFIER LV_MAF_CTL ECU_ADDRESS 0xd0003a10 BIT_MASK 0x1 /end MEASUREMENT
/begin MEASUREMENT n_sp_is_pow_1 "nominal idle speed setpoint by powermanagement" UWORD _CNV_A_R_LINEAR_____13_CM 1 100. 0. 8160. DISPLAY_IDENTIFIER N_SP_IS_POW_1 ECU_ADDRESS 0xd0004b58 FORMAT "%4.0" /end MEASUREMENT
/begin MEASUREMENT toil "Oil temperature" UBYTE _CNV_A_R_LINEAR_____25_CM 1 100. -40. 160. DISPLAY_IDENTIFIER TOIL ECU_ADDRESS 0xd000385d FORMAT "%3.0" /end MEASUREMENT
/begin MEASUREMENT toil_stop "Oil temperature at transition to ES" UBYTE _CNV_A_R_LINEAR_____25_CM 1 100. -40. 160. DISPLAY_IDENTIFIER TOIL_STOP ECU_ADDRESS 0xd000385e FORMAT "%3.0" /end MEASUREMENT
/begin CHARACTERISTIC c_toil_sub_diag "Substitude value for TOIL" VALUE 0xa1029a89 _REC_VAL_20_u1 200. _CNV_A_R_LINEAR_____25_CM -40. 160. DISPLAY_IDENTIFIER C_TOIL_SUB_DIAG FORMAT "%3.0" /end CHARACTERISTIC
/begin CHARACTERISTIC c_maf_ref "reference air mass flow for rl" VALUE 0xa1029568 _REC_VAL_20_u2 1389. _CNV_A_R_LINEAR_____108_CM 0. 1389. DISPLAY_IDENTIFIER C_MAF_REF FORMAT "%7.2" /end CHARACTERISTIC
/begin CHARACTERISTIC lc_mff_sp_homs_man_act "Switch for manual homogeneus-s mode active" VALUE 0xa1029d7a _REC_VAL_20_u1 1. _CNV_S_2_RANGE__0___1_CM 0. 1. DISPLAY_IDENTIFIER LC_MFF_SP_HOMS_MAN_ACT /end CHARACTERISTIC
/begin CHARACTERISTIC c_mff_sp_1_homs_man "Fuel mass setpoint for the first pulse in homogeneous-s mode (manual adjustment)" VALUE 0xa102957c _REC_VAL_20_u2 1389. _CNV_A_R_LINEAR_____108_CM 0. 1389. DISPLAY_IDENTIFIER C_MFF_SP_1_HOMS_MAN FORMAT "%7.2" /end CHARACTERISTIC
/begin CHARACTERISTIC c_mff_sp_2_homs_man "Fuel mass setpoint for the second pulse in homogeneous-s mode (manual adjustment)" VALUE 0xa1029582 _REC_VAL_20_u2 1389. _CNV_A_R_LINEAR_____108_CM 0. 1389. DISPLAY_IDENTIFIER C_MFF_SP_2_HOMS_MAN FORMAT "%7.2" /end CHARACTERISTIC
/begin MEASUREMENT cam_psn_raw[0] "Edge of camshaft (0 = inlet, 1=exhaust)" UWORD _CNV_A_R_LINEAR_____482_CM 1 100. -32768. 32767. DISPLAY_IDENTIFIER CAM_PSN_RAW_0 ECU_ADDRESS 0xd0004b5c FORMAT "%6.2" /end MEASUREMENT
/begin MEASUREMENT cam_psn_raw[1] "Edge of camshaft (0 = inlet, 1=exhaust)" UWORD _CNV_A_R_LINEAR_____482_CM 1 100. -32768. 32767. DISPLAY_IDENTIFIER CAM_PSN_RAW_1 ECU_ADDRESS 0xd0004b5e FORMAT "%6.2" /end MEASUREMENT
/begin MEASUREMENT vls_nox_sens_1 "binary O2 signal voltage, raw value, measured by NOx-sensor" UWORD _CNV_A_R_LINEAR_____211_CM 1 100. -200. 1200. DISPLAY_IDENTIFIER VLS_NOX_SENS_1 ECU_ADDRESS 0xd0004e42 FORMAT "%4.0" /end MEASUREMENT
/begin MEASUREMENT vls_nox_sens_2 "binary O2 signal voltage, raw value, measured by NOx-sensor" UWORD _CNV_A_R_LINEAR_____211_CM 1 100. -200. 1200. DISPLAY_IDENTIFIER VLS_NOX_SENS_2 ECU_ADDRESS 0xd0004e54 FORMAT "%4.0" /end MEASUREMENT
/begin CHARACTERISTIC c_t_nox_sens_nox_hld "max. time of hold the last valid NOx signal value" VALUE 0xa102991e _REC_VAL_20_u2 327.67 _CNV_A_R_LINEAR_____3_CM 0. 327.67 DISPLAY_IDENTIFIER C_T_NOX_SENS_NOX_HLD FORMAT "%6.2" /end CHARACTERISTIC
/begin CHARACTERISTIC c_t_nox_sens_nox_auth "min. time of full NOx sensor readiness to set the NOx signal authorisation bit" VALUE 0xa102991c _REC_VAL_20_u2 327.67 _CNV_A_R_LINEAR_____3_CM 0. 327.67 DISPLAY_IDENTIFIER C_T_NOX_SENS_NOX_AUTH FORMAT "%6.2" /end CHARACTERISTIC
/begin CHARACTERISTIC c_t_nox_sens_nox_mdl "min. NOx signal \"valid\" time for set of model \"valid\" bit" VALUE 0xa1029920 _REC_VAL_20_u2 327.67 _CNV_A_R_LINEAR_____3_CM 0. 327.67 DISPLAY_IDENTIFIER C_T_NOX_SENS_NOX_MDL FORMAT "%6.2" /end CHARACTERISTIC
/begin CHARACTERISTIC c_crlc_nox_nox_sens "Correlation constant for 1st NOx signal filter" VALUE 0xa102921e _REC_VAL_20_u2 0.9999847412109381 _CNV_A_R_LINEAR_____68_CM 0. 0.9999847412109381 DISPLAY_IDENTIFIER C_CRLC_NOX_NOX_SENS FORMAT "%7.5" /end CHARACTERISTIC
/begin CHARACTERISTIC c_crlc_nox_nox_sens_diag "Correlation constant for 2nd NOx signal filter" VALUE 0xa1029220 _REC_VAL_20_u2 0.9999847412109381 _CNV_A_R_LINEAR_____68_CM 0. 0.9999847412109381 DISPLAY_IDENTIFIER C_CRLC_NOX_NOX_SENS_DIAG FORMAT "%7.5" /end CHARACTERISTIC
/begin CHARACTERISTIC c_t_nox_sens_lamb_hld "max. time of hold the last valid lambda signal value" VALUE 0xa102991a _REC_VAL_20_u2 327.67 _CNV_A_R_LINEAR_____3_CM 0. 327.67 DISPLAY_IDENTIFIER C_T_NOX_SENS_LAMB_HLD FORMAT "%6.2" /end CHARACTERISTIC
/begin CHARACTERISTIC c_t_nox_sens_vls_hld "max. time of hold the last valid binary O2 signal value" VALUE 0xa102992e _REC_VAL_20_u2 327.67 _CNV_A_R_LINEAR_____3_CM 0. 327.67 DISPLAY_IDENTIFIER C_T_NOX_SENS_VLS_HLD FORMAT "%6.2" /end CHARACTERISTIC
/begin CHARACTERISTIC c_t_nox_sens_pwr_hld "debounce time for NOx sensor power supply failures" VALUE 0xa1029924 _REC_VAL_20_u2 327.67 _CNV_A_R_LINEAR_____3_CM 0. 327.67 DISPLAY_IDENTIFIER C_T_NOX_SENS_PWR_HLD FORMAT "%6.2" /end CHARACTERISTIC
/begin MEASUREMENT nox_nox_sens_diag_1 "NOx concentration value for diagnosis function, measured by NOx-sensor" SWORD _CNV_A_R_LINEAR_____499_CM 1 100. -100. 1500. DISPLAY_IDENTIFIER NOX_NOX_SENS_DIAG_1 ECU_ADDRESS 0xd0005584 FORMAT "%4.0" /end MEASUREMENT
/begin MEASUREMENT nox_nox_sens_diag_2 "NOx concentration value for diagnosis function, measured by NOx-sensor" SWORD _CNV_A_R_LINEAR_____499_CM 1 100. -100. 1500. DISPLAY_IDENTIFIER NOX_NOX_SENS_DIAG_2 ECU_ADDRESS 0xd0005588 FORMAT "%4.0" /end MEASUREMENT
/begin MEASUREMENT lv_nox_sens_nox_diag_vld_1 "indicator that the NOx signal is valid for use into the diagnosis functions" UBYTE _CNV_S_2_RANGE__0___1_CM 1 100. 0. 1. DISPLAY_IDENTIFIER LV_NOX_SENS_NOX_DIAG_VLD_1 ECU_ADDRESS 0xd0003a8a BIT_MASK 0x1 /end MEASUREMENT
/begin MEASUREMENT lv_nox_sens_nox_diag_vld_2 "indicator that the NOx signal is valid for use into the diagnosis functions" UBYTE _CNV_S_2_RANGE__0___1_CM 1 100. 0. 1. DISPLAY_IDENTIFIER LV_NOX_SENS_NOX_DIAG_VLD_2 ECU_ADDRESS 0xd0003a96 BIT_MASK 0x1 /end MEASUREMENT
/begin MEASUREMENT nox_nox_sens_1 "NOx concentration value, measured by NOx-sensor" SWORD _CNV_A_R_LINEAR_____499_CM 1 100. -100. 1500. DISPLAY_IDENTIFIER NOX_NOX_SENS_1 ECU_ADDRESS 0xd0004e48 FORMAT "%4.0" /end MEASUREMENT
/begin MEASUREMENT nox_nox_sens_2 "NOx concentration value, measured by NOx-sensor" SWORD _CNV_A_R_LINEAR_____499_CM 1 100. -100. 1500. DISPLAY_IDENTIFIER NOX_NOX_SENS_2 ECU_ADDRESS 0xd0004e5a FORMAT "%4.0" /end MEASUREMENT
/begin MEASUREMENT lv_nox_sens_nox_vld_1 "indicator that the NOx signal is valid" UBYTE _CNV_S_2_RANGE__0___1_CM 1 100. 0. 1. DISPLAY_IDENTIFIER LV_NOX_SENS_NOX_VLD_1 ECU_ADDRESS 0xd0003a8b BIT_MASK 0x1 /end MEASUREMENT
/begin MEASUREMENT lv_nox_sens_nox_vld_2 "indicator that the NOx signal is valid" UBYTE _CNV_S_2_RANGE__0___1_CM 1 100. 0. 1. DISPLAY_IDENTIFIER LV_NOX_SENS_NOX_VLD_2 ECU_ADDRESS 0xd0003a97 BIT_MASK 0x1 /end MEASUREMENT
/begin MEASUREMENT lv_nox_sens_nox_auth_1 "indicator that the NOx signal has been reached the valid state after the start" UBYTE _CNV_S_2_RANGE__0___1_CM 1 100. 0. 1. DISPLAY_IDENTIFIER LV_NOX_SENS_NOX_AUTH_1 ECU_ADDRESS 0xd0003a8c BIT_MASK 0x1 /end MEASUREMENT
/begin MEASUREMENT lv_nox_sens_nox_auth_2 "indicator that the NOx signal has been reached the valid state after the start" UBYTE _CNV_S_2_RANGE__0___1_CM 1 100. 0. 1. DISPLAY_IDENTIFIER LV_NOX_SENS_NOX_AUTH_2 ECU_ADDRESS 0xd0003a98 BIT_MASK 0x1 /end MEASUREMENT
/begin MEASUREMENT t_nox_sens_nox_hld_1 "timer for hold of last valid NOx signal value" UWORD _CNV_A_R_LINEAR_____3_CM 1 100. 0. 327.67 DISPLAY_IDENTIFIER T_NOX_SENS_NOX_HLD_1 ECU_ADDRESS 0xd0004e38 FORMAT "%6.2" /end MEASUREMENT
/begin MEASUREMENT t_nox_sens_nox_hld_2 "timer for hold of last valid NOx signal value" UWORD _CNV_A_R_LINEAR_____3_CM 1 100. 0. 327.67 DISPLAY_IDENTIFIER T_NOX_SENS_NOX_HLD_2 ECU_ADDRESS 0xd0004e4a FORMAT "%6.2" /end MEASUREMENT
/begin MEASUREMENT lv_nox_sens_nox_mdl_vld_1 "indicator that the NOx signal is valid for use. The state \"valid\" is debounced presently." UBYTE _CNV_S_2_RANGE__0___1_CM 1 100. 0. 1. DISPLAY_IDENTIFIER LV_NOX_SENS_NOX_MDL_VLD_1 ECU_ADDRESS 0xd0003a91 BIT_MASK 0x1 /end MEASUREMENT
/begin MEASUREMENT lv_nox_sens_nox_mdl_vld_2 "indicator that the NOx signal is valid for use. The state \"valid\" is debounced presently." UBYTE _CNV_S_2_RANGE__0___1_CM 1 100. 0. 1. DISPLAY_IDENTIFIER LV_NOX_SENS_NOX_MDL_VLD_2 ECU_ADDRESS 0xd0003a9d BIT_MASK 0x1 /end MEASUREMENT
/begin MEASUREMENT t_nox_sens_nox_mdl_1 "timer for debounce of signal state \"valid\" after re-entry into state \"valid\"" UWORD _CNV_A_R_LINEAR_____3_CM 1 100. 0. 327.67 DISPLAY_IDENTIFIER T_NOX_SENS_NOX_MDL_1 ECU_ADDRESS 0xd0004e46 FORMAT "%6.2" /end MEASUREMENT
/begin MEASUREMENT t_nox_sens_nox_mdl_2 "timer for debounce of signal state \"valid\" after re-entry into state \"valid\"" UWORD _CNV_A_R_LINEAR_____3_CM 1 100. 0. 327.67 DISPLAY_IDENTIFIER T_NOX_SENS_NOX_MDL_2 ECU_ADDRESS 0xd0004e58 FORMAT "%6.2" /end MEASUREMENT
/begin CHARACTERISTIC lc_nox_sens_nox_man_1 "manual setting of NOx concentration value on/off" VALUE 0xa1029d96 _REC_VAL_20_u1 1. _CNV_A_R_LINEAR_____0_CM 0. 1. DISPLAY_IDENTIFIER LC_NOX_SENS_NOX_MAN_1 FORMAT "%1.0" /end CHARACTERISTIC
/begin CHARACTERISTIC lc_nox_sens_nox_man_2 "manual setting of NOx concentration value on/off" VALUE 0xa1029d97 _REC_VAL_20_u1 1. _CNV_A_R_LINEAR_____0_CM 0. 1. DISPLAY_IDENTIFIER LC_NOX_SENS_NOX_MAN_2 FORMAT "%1.0" /end CHARACTERISTIC
/begin CHARACTERISTIC c_nox_nox_sens_1 "manual NOx concentration value" VALUE 0xa1029690 _REC_VAL_20_s2 1600. _CNV_A_R_LINEAR_____499_CM -100. 1500. DISPLAY_IDENTIFIER C_NOX_NOX_SENS_1 FORMAT "%4.0" /end CHARACTERISTIC
/begin CHARACTERISTIC c_nox_nox_sens_2 "manual NOx concentration value" VALUE 0xa1029692 _REC_VAL_20_s2 1600. _CNV_A_R_LINEAR_____499_CM -100. 1500. DISPLAY_IDENTIFIER C_NOX_NOX_SENS_2 FORMAT "%4.0" /end CHARACTERISTIC
/begin CHARACTERISTIC lc_nox_sens_nox_vld_1 "permanently authorisation NOx signal on/off" VALUE 0xa1029d99 _REC_VAL_20_u1 1. _CNV_A_R_LINEAR_____0_CM 0. 1. DISPLAY_IDENTIFIER LC_NOX_SENS_NOX_VLD_1 FORMAT "%1.0" /end CHARACTERISTIC
/begin CHARACTERISTIC lc_nox_sens_nox_vld_2 "permanently authorisation NOx signal on/off" VALUE 0xa1029d9a _REC_VAL_20_u1 1. _CNV_A_R_LINEAR_____0_CM 0. 1. DISPLAY_IDENTIFIER LC_NOX_SENS_NOX_VLD_2 FORMAT "%1.0" /end CHARACTERISTIC
/begin MEASUREMENT lamb_nox_sens_diag_1 "lambda value for diagnosis functions, measured by NOx-sensor" UWORD _CNV_A_R_LINEAR_____122_CM 1 100. 0. 31.9990234375 DISPLAY_IDENTIFIER LAMB_NOX_SENS_DIAG_1 ECU_ADDRESS 0xd0004e3a FORMAT "%7.4" /end MEASUREMENT
/begin MEASUREMENT lamb_nox_sens_diag_2 "lambda value for diagnosis functions, measured by NOx-sensor" UWORD _CNV_A_R_LINEAR_____122_CM 1 100. 0. 31.9990234375 DISPLAY_IDENTIFIER LAMB_NOX_SENS_DIAG_2 ECU_ADDRESS 0xd0004e4c FORMAT "%7.4" /end MEASUREMENT
/begin MEASUREMENT lv_nox_sens_lamb_diag_vld_1 "indicator that the lambda signal is valid for use into the diagnosis functions" UBYTE _CNV_S_2_RANGE__0___1_CM 1 100. 0. 1. DISPLAY_IDENTIFIER LV_NOX_SENS_LAMB_DIAG_VLD_1 ECU_ADDRESS 0xd0003a8d BIT_MASK 0x1 /end MEASUREMENT
/begin MEASUREMENT lv_nox_sens_lamb_diag_vld_2 "indicator that the lambda signal is valid for use into the diagnosis functions" UBYTE _CNV_S_2_RANGE__0___1_CM 1 100. 0. 1. DISPLAY_IDENTIFIER LV_NOX_SENS_LAMB_DIAG_VLD_2 ECU_ADDRESS 0xd0003a99 BIT_MASK 0x1 /end MEASUREMENT
/begin MEASUREMENT lamb_nox_sens_1 "lambda value, measured by NOx-sensor" UWORD _CNV_A_R_LINEAR_____122_CM 1 100. 0. 31.9990234375 DISPLAY_IDENTIFIER LAMB_NOX_SENS_1 ECU_ADDRESS 0xd0004e3c FORMAT "%7.4" /end MEASUREMENT
/begin MEASUREMENT lamb_nox_sens_2 "lambda value, measured by NOx-sensor" UWORD _CNV_A_R_LINEAR_____122_CM 1 100. 0. 31.9990234375 DISPLAY_IDENTIFIER LAMB_NOX_SENS_2 ECU_ADDRESS 0xd0004e4e FORMAT "%7.4" /end MEASUREMENT
/begin MEASUREMENT lv_nox_sens_lamb_vld_1 "indicator that the lambda signal is valid" UBYTE _CNV_S_2_RANGE__0___1_CM 1 100. 0. 1. DISPLAY_IDENTIFIER LV_NOX_SENS_LAMB_VLD_1 ECU_ADDRESS 0xd0003a8e BIT_MASK 0x1 /end MEASUREMENT
/begin MEASUREMENT lv_nox_sens_lamb_vld_2 "indicator that the lambda signal is valid" UBYTE _CNV_S_2_RANGE__0___1_CM 1 100. 0. 1. DISPLAY_IDENTIFIER LV_NOX_SENS_LAMB_VLD_2 ECU_ADDRESS 0xd0003a9a BIT_MASK 0x1 /end MEASUREMENT
/begin MEASUREMENT t_nox_sens_lamb_hld_1 "timer for hold of last valid lambda signal value" UWORD _CNV_A_R_LINEAR_____3_CM 1 100. 0. 327.67 DISPLAY_IDENTIFIER T_NOX_SENS_LAMB_HLD_1 ECU_ADDRESS 0xd0004e3e FORMAT "%6.2" /end MEASUREMENT
/begin MEASUREMENT t_nox_sens_lamb_hld_2 "timer for hold of last valid lambda signal value" UWORD _CNV_A_R_LINEAR_____3_CM 1 100. 0. 327.67 DISPLAY_IDENTIFIER T_NOX_SENS_LAMB_HLD_2 ECU_ADDRESS 0xd0004e50 FORMAT "%6.2" /end MEASUREMENT
/begin CHARACTERISTIC lc_nox_sens_lamb_man_1 "manual setting of lambda value on/off" VALUE 0xa1029d91 _REC_VAL_20_u1 1. _CNV_A_R_LINEAR_____0_CM 0. 1. DISPLAY_IDENTIFIER LC_NOX_SENS_LAMB_MAN_1 FORMAT "%1.0" /end CHARACTERISTIC
/begin CHARACTERISTIC lc_nox_sens_lamb_man_2 "manual setting of lambda value on/off" VALUE 0xa1029d92 _REC_VAL_20_u1 1. _CNV_A_R_LINEAR_____0_CM 0. 1. DISPLAY_IDENTIFIER LC_NOX_SENS_LAMB_MAN_2 FORMAT "%1.0" /end CHARACTERISTIC
/begin CHARACTERISTIC c_lamb_nox_sens_1 "manual lambda value" VALUE 0xa10294da _REC_VAL_20_u2 31.9990234375 _CNV_A_R_LINEAR_____122_CM 0. 31.9990234375 DISPLAY_IDENTIFIER C_LAMB_NOX_SENS_1 FORMAT "%7.4" /end CHARACTERISTIC
/begin CHARACTERISTIC c_lamb_nox_sens_2 "manual lambda value" VALUE 0xa10294dc _REC_VAL_20_u2 31.9990234375 _CNV_A_R_LINEAR_____122_CM 0. 31.9990234375 DISPLAY_IDENTIFIER C_LAMB_NOX_SENS_2 FORMAT "%7.4" /end CHARACTERISTIC
/begin CHARACTERISTIC lc_nox_sens_lamb_vld_1 "permanently authorisation lambda signal on/off" VALUE 0xa1029d93 _REC_VAL_20_u1 1. _CNV_A_R_LINEAR_____0_CM 0. 1. DISPLAY_IDENTIFIER LC_NOX_SENS_LAMB_VLD_1 FORMAT "%1.0" /end CHARACTERISTIC
/begin CHARACTERISTIC lc_nox_sens_lamb_vld_2 "permanently authorisation lambda signal on/off" VALUE 0xa1029d94 _REC_VAL_20_u1 1. _CNV_A_R_LINEAR_____0_CM 0. 1. DISPLAY_IDENTIFIER LC_NOX_SENS_LAMB_VLD_2 FORMAT "%1.0" /end CHARACTERISTIC
/begin MEASUREMENT vls_nox_sens_diag_1 "binary O2 signal voltage for diagnosis functions, raw value, measured by NOx-sensor" UWORD _CNV_A_R_LINEAR_____211_CM 1 100. -200. 1200. DISPLAY_IDENTIFIER VLS_NOX_SENS_DIAG_1 ECU_ADDRESS 0xd0004e40 FORMAT "%4.0" /end MEASUREMENT
/begin MEASUREMENT vls_nox_sens_diag_2 "binary O2 signal voltage for diagnosis functions, raw value, measured by NOx-sensor" UWORD _CNV_A_R_LINEAR_____211_CM 1 100. -200. 1200. DISPLAY_IDENTIFIER VLS_NOX_SENS_DIAG_2 ECU_ADDRESS 0xd0004e52 FORMAT "%4.0" /end MEASUREMENT
/begin MEASUREMENT lv_nox_sens_vls_diag_vld_1 "indicator that the binary O2 signal is valid for use in the diagnosis functions" UBYTE _CNV_S_2_RANGE__0___1_CM 1 100. 0. 1. DISPLAY_IDENTIFIER LV_NOX_SENS_VLS_DIAG_VLD_1 ECU_ADDRESS 0xd0003a8f BIT_MASK 0x1 /end MEASUREMENT
/begin MEASUREMENT lv_nox_sens_vls_diag_vld_2 "indicator that the binary O2 signal is valid for use in the diagnosis functions" UBYTE _CNV_S_2_RANGE__0___1_CM 1 100. 0. 1. DISPLAY_IDENTIFIER LV_NOX_SENS_VLS_DIAG_VLD_2 ECU_ADDRESS 0xd0003a9b BIT_MASK 0x1 /end MEASUREMENT
/begin MEASUREMENT lv_nox_sens_vls_vld_1 "indicator that the binary O2 signal is valid" UBYTE _CNV_S_2_RANGE__0___1_CM 1 100. 0. 1. DISPLAY_IDENTIFIER LV_NOX_SENS_VLS_VLD_1 ECU_ADDRESS 0xd0003a90 BIT_MASK 0x1 /end MEASUREMENT
/begin MEASUREMENT lv_nox_sens_vls_vld_2 "indicator that the binary O2 signal is valid" UBYTE _CNV_S_2_RANGE__0___1_CM 1 100. 0. 1. DISPLAY_IDENTIFIER LV_NOX_SENS_VLS_VLD_2 ECU_ADDRESS 0xd0003a9c BIT_MASK 0x1 /end MEASUREMENT
/begin MEASUREMENT t_nox_sens_vls_hld_1 "timer for hold of last valid binary O2 signal value" UWORD _CNV_A_R_LINEAR_____3_CM 1 100. 0. 327.67 DISPLAY_IDENTIFIER T_NOX_SENS_VLS_HLD_1 ECU_ADDRESS 0xd0004e44 FORMAT "%6.2" /end MEASUREMENT
/begin MEASUREMENT t_nox_sens_vls_hld_2 "timer for hold of last valid binary O2 signal value" UWORD _CNV_A_R_LINEAR_____3_CM 1 100. 0. 327.67 DISPLAY_IDENTIFIER T_NOX_SENS_VLS_HLD_2 ECU_ADDRESS 0xd0004e56 FORMAT "%6.2" /end MEASUREMENT
/begin CHARACTERISTIC lc_nox_sens_vls_man_1 "manual setting of binary O2 value on/off" VALUE 0xa1029d9c _REC_VAL_20_u1 1. _CNV_A_R_LINEAR_____0_CM 0. 1. DISPLAY_IDENTIFIER LC_NOX_SENS_VLS_MAN_1 FORMAT "%1.0" /end CHARACTERISTIC
/begin CHARACTERISTIC lc_nox_sens_vls_man_2 "manual setting of binary O2 value on/off" VALUE 0xa1029d9d _REC_VAL_20_u1 1. _CNV_A_R_LINEAR_____0_CM 0. 1. DISPLAY_IDENTIFIER LC_NOX_SENS_VLS_MAN_2 FORMAT "%1.0" /end CHARACTERISTIC
/begin CHARACTERISTIC c_vls_nox_sens_1 "manual binary O2 value" VALUE 0xa1029c4c _REC_VAL_20_u2 1400. _CNV_A_R_LINEAR_____211_CM -200. 1200. DISPLAY_IDENTIFIER C_VLS_NOX_SENS_1 FORMAT "%4.0" /end CHARACTERISTIC
/begin CHARACTERISTIC c_vls_nox_sens_2 "manual binary O2 value" VALUE 0xa1029c4e _REC_VAL_20_u2 1400. _CNV_A_R_LINEAR_____211_CM -200. 1200. DISPLAY_IDENTIFIER C_VLS_NOX_SENS_2 FORMAT "%4.0" /end CHARACTERISTIC
/begin CHARACTERISTIC lc_nox_sens_vls_vld_1 "permanently authorisation binary O2 signal on/off" VALUE 0xa1029d9e _REC_VAL_20_u1 1. _CNV_A_R_LINEAR_____0_CM 0. 1. DISPLAY_IDENTIFIER LC_NOX_SENS_VLS_VLD_1 FORMAT "%1.0" /end CHARACTERISTIC
/begin CHARACTERISTIC lc_nox_sens_vls_vld_2 "permanently authorisation binary O2 signal on/off" VALUE 0xa1029d9f _REC_VAL_20_u1 1. _CNV_A_R_LINEAR_____0_CM 0. 1. DISPLAY_IDENTIFIER LC_NOX_SENS_VLS_VLD_2 FORMAT "%1.0" /end CHARACTERISTIC
/begin MEASUREMENT err_nox_sens_1 "NOx sensor failure byte" UBYTE _CNV_A_R_LINEAR_____0_CM 1 100. 0. 255. DISPLAY_IDENTIFIER ERR_NOX_SENS_1 ECU_ADDRESS 0xd0003a88 FORMAT "%3.0" /end MEASUREMENT
/begin MEASUREMENT err_nox_sens_2 "NOx sensor failure byte" UBYTE _CNV_A_R_LINEAR_____0_CM 1 100. 0. 255. DISPLAY_IDENTIFIER ERR_NOX_SENS_2 ECU_ADDRESS 0xd0003a94 FORMAT "%3.0" /end MEASUREMENT
/begin CHARACTERISTIC lc_nox_sens_err_man_1 "manual setting of error byte on/off" VALUE 0xa1029d8f _REC_VAL_20_u1 1. _CNV_A_R_LINEAR_____0_CM 0. 1. DISPLAY_IDENTIFIER LC_NOX_SENS_ERR_MAN_1 FORMAT "%1.0" /end CHARACTERISTIC
/begin CHARACTERISTIC lc_nox_sens_err_man_2 "manual setting of error byte on/off" VALUE 0xa1029d90 _REC_VAL_20_u1 1. _CNV_A_R_LINEAR_____0_CM 0. 1. DISPLAY_IDENTIFIER LC_NOX_SENS_ERR_MAN_2 FORMAT "%1.0" /end CHARACTERISTIC
/begin CHARACTERISTIC c_err_nox_sens_1 "manual value for error byte" VALUE 0xa102936b _REC_VAL_20_u1 255. _CNV_A_R_LINEAR_____0_CM 0. 255. DISPLAY_IDENTIFIER C_ERR_NOX_SENS_1 FORMAT "%3.0" /end CHARACTERISTIC
/begin CHARACTERISTIC c_err_nox_sens_2 "manual value for error byte" VALUE 0xa102936c _REC_VAL_20_u1 255. _CNV_A_R_LINEAR_____0_CM 0. 255. DISPLAY_IDENTIFIER C_ERR_NOX_SENS_2 FORMAT "%3.0" /end CHARACTERISTIC
/begin MEASUREMENT t_nox_sens_pwr_1 "timer for debounce of NOx sensor power supply failures" UWORD _CNV_A_R_LINEAR_____3_CM 1 100. 0. 327.67 DISPLAY_IDENTIFIER T_NOX_SENS_PWR_1 ECU_ADDRESS 0xc0000ab4 FORMAT "%6.2" /end MEASUREMENT
/begin MEASUREMENT t_nox_sens_pwr_2 "timer for debounce of NOx sensor power supply failures" UWORD _CNV_A_R_LINEAR_____3_CM 1 100. 0. 327.67 DISPLAY_IDENTIFIER T_NOX_SENS_PWR_2 ECU_ADDRESS 0xc0000ab6 FORMAT "%6.2" /end MEASUREMENT
/begin MEASUREMENT nox_sens_temp_1 "Indicator for state of  sensor heater management" UBYTE _CNV_A_R_LINEAR_____0_CM 1 100. 0. 3. DISPLAY_IDENTIFIER NOX_SENS_TEMP_1 ECU_ADDRESS 0xd0003a89 FORMAT "%1.0" /end MEASUREMENT
/begin MEASUREMENT nox_sens_temp_2 "Indicator for state of  sensor heater management" UBYTE _CNV_A_R_LINEAR_____0_CM 1 100. 0. 3. DISPLAY_IDENTIFIER NOX_SENS_TEMP_2 ECU_ADDRESS 0xd0003a95 FORMAT "%1.0" /end MEASUREMENT
/begin MEASUREMENT lv_nox_sens_lamb_auth_2 "indicator that the lambda signal has reached the valid state after start" UBYTE _CNV_S_2_RANGE__0___1_CM 1 100. 0. 1. DISPLAY_IDENTIFIER LV_NOX_SENS_LAMB_AUTH_2 ECU_ADDRESS 0xd0003a9f BIT_MASK 0x1 /end MEASUREMENT
/begin CHARACTERISTIC c_t_nox_sens_lamb_auth "minimum time of Lambda signal readiness to set the authorization bit" VALUE 0xa1029918 _REC_VAL_20_u2 327.67 _CNV_A_R_LINEAR_____3_CM 0. 327.67 DISPLAY_IDENTIFIER C_T_NOX_SENS_LAMB_AUTH FORMAT "%6.2" /end CHARACTERISTIC
/begin MEASUREMENT lv_nox_sens_lamb_auth_1 "indicator that the lambda signal has reached the valid state after start" UBYTE _CNV_S_2_RANGE__0___1_CM 1 100. 0. 1. DISPLAY_IDENTIFIER LV_NOX_SENS_LAMB_AUTH_1 ECU_ADDRESS 0xd0003a93 BIT_MASK 0x1 /end MEASUREMENT
/begin MEASUREMENT lv_nox_sens_vls_auth_1 "indicator that the binary O2 signal has reached the valid state after start" UBYTE _CNV_S_2_RANGE__0___1_CM 1 100. 0. 1. DISPLAY_IDENTIFIER LV_NOX_SENS_VLS_AUTH_1 ECU_ADDRESS 0xd0003a92 BIT_MASK 0x1 /end MEASUREMENT
/begin MEASUREMENT lv_nox_sens_vls_auth_2 "indicator that the binary O2 signal has reached the valid state after start" UBYTE _CNV_S_2_RANGE__0___1_CM 1 100. 0. 1. DISPLAY_IDENTIFIER LV_NOX_SENS_VLS_AUTH_2 ECU_ADDRESS 0xd0003a9e BIT_MASK 0x1 /end MEASUREMENT
/begin CHARACTERISTIC c_t_nox_sens_vls_auth "minimum time of binary O2 signal readiness to set the authorisation bit" VALUE 0xa102992c _REC_VAL_20_u2 327.67 _CNV_A_R_LINEAR_____3_CM 0. 327.67 DISPLAY_IDENTIFIER C_T_NOX_SENS_VLS_AUTH FORMAT "%6.2" /end CHARACTERISTIC
/begin CHARACTERISTIC lc_nox_sens_2 "NOx sensor for exhaust line-2 exists" VALUE 0xa1029d8d _REC_VAL_20_u1 1. _CNV_A_R_LINEAR_____0_CM 0. 1. DISPLAY_IDENTIFIER LC_NOX_SENS_2 FORMAT "%2.0" /end CHARACTERISTIC
/begin MEASUREMENT can_nox_nox_sens_2 "NOx concentration value, measured by NOx-Sensor" SWORD _CNV_A_R_LINEAR_____499_CM 1 100. -100. 1500. DISPLAY_IDENTIFIER CAN_NOX_NOX_SENS_2 ECU_ADDRESS 0xd0004aea FORMAT "%4.0" /end MEASUREMENT
/begin MEASUREMENT can_lamb_nox_sens_1 "Lambda value as measured by NOx-Sensor" UWORD _CNV_A_R_LINEAR_____0_CM 1 100. 0. 1540. DISPLAY_IDENTIFIER CAN_LAMB_NOX_SENS_1 ECU_ADDRESS 0xd0004ae6 FORMAT "%4.0" /end MEASUREMENT
/begin MEASUREMENT can_lamb_nox_sens_2 "Lambda value as measured by NOx-Sensor" UWORD _CNV_A_R_LINEAR_____0_CM 1 100. 0. 1540. DISPLAY_IDENTIFIER CAN_LAMB_NOX_SENS_2 ECU_ADDRESS 0xd0004aec FORMAT "%4.0" /end MEASUREMENT
/begin MEASUREMENT can_err_nox_sens_1 "NOx-Sensor error byte" UBYTE _CNV_A_R_LINEAR_____0_CM 1 100. 0. 255. DISPLAY_IDENTIFIER CAN_ERR_NOX_SENS_1 ECU_ADDRESS 0xd000375d FORMAT "%3.0" /end MEASUREMENT
/begin MEASUREMENT can_err_nox_sens_2 "NOx-Sensor error byte" UBYTE _CNV_A_R_LINEAR_____0_CM 1 100. 0. 255. DISPLAY_IDENTIFIER CAN_ERR_NOX_SENS_2 ECU_ADDRESS 0xd0003760 FORMAT "%3.0" /end MEASUREMENT
/begin MEASUREMENT can_vls_nox_sens_1 "Binary O2 signal voltage, raw value, measured by NOx-Sensor" UWORD _CNV_A_R_LINEAR_____211_CM 1 100. -200. 1200. DISPLAY_IDENTIFIER CAN_VLS_NOX_SENS_1 ECU_ADDRESS 0xd0004ae8 FORMAT "%4.0" /end MEASUREMENT
/begin MEASUREMENT can_vls_nox_sens_2 "Binary O2 signal voltage, raw value, measured by NOx-Sensor" UWORD _CNV_A_R_LINEAR_____211_CM 1 100. -200. 1200. DISPLAY_IDENTIFIER CAN_VLS_NOX_SENS_2 ECU_ADDRESS 0xd0004aee FORMAT "%4.0" /end MEASUREMENT
/begin MEASUREMENT can_state_nox_sens_1 "NOx-Sensor status byte" UBYTE _CNV_A_R_LINEAR_____0_CM 1 100. 0. 255. DISPLAY_IDENTIFIER CAN_STATE_NOX_SENS_1 ECU_ADDRESS 0xd000375c FORMAT "%3.0" /end MEASUREMENT
/begin MEASUREMENT can_state_nox_sens_2 "NOx-Sensor status byte" UBYTE _CNV_A_R_LINEAR_____0_CM 1 100. 0. 255. DISPLAY_IDENTIFIER CAN_STATE_NOX_SENS_2 ECU_ADDRESS 0xd000375f FORMAT "%3.0" /end MEASUREMENT
/begin MEASUREMENT can_nox_nox_sens_1 "NOx concentration value, measured by NOx-Sensor" SWORD _CNV_A_R_LINEAR_____499_CM 1 100. -100. 1500. DISPLAY_IDENTIFIER CAN_NOX_NOX_SENS_1 ECU_ADDRESS 0xd0004ae4 FORMAT "%4.0" /end MEASUREMENT
/begin CHARACTERISTIC c_nox_sens_cycnr_max "maximum number of missing NOX_SENS messages for error debounce counter increment" VALUE 0xa10296b6 _REC_VAL_20_u1 254. _CNV_A_R_LINEAR_____0_CM 1. 255. DISPLAY_IDENTIFIER C_NOX_SENS_CYCNR_MAX FORMAT "%3.0" /end CHARACTERISTIC
/begin MEASUREMENT lv_can_temp_min_thd_1 "Dew point recognition for NOx sensor" UBYTE _CNV_S_2_RANGE__0___1_CM 1 100. 0. 1. DISPLAY_IDENTIFIER LV_CAN_TEMP_MIN_THD_1 ECU_ADDRESS 0xd000375e BIT_MASK 0x1 /end MEASUREMENT
/begin MEASUREMENT lv_can_temp_min_thd_2 "Dew point recognition for NOx sensor" UBYTE _CNV_S_2_RANGE__0___1_CM 1 100. 0. 1. DISPLAY_IDENTIFIER LV_CAN_TEMP_MIN_THD_2 ECU_ADDRESS 0xd0003761 BIT_MASK 0x1 /end MEASUREMENT
/begin COMPU_METHOD _CNV_A_R_LINEAR_____0_CM "" RAT_FUNC "%6.3" "-" COEFFS 0 1. 0. 0 0 1 /end COMPU_METHOD
/begin COMPU_METHOD _CNV_S_2_RANGE__0___1_CM "" TAB_VERB "%6.3" "-" COMPU_TAB_REF _CNV_S_2_RANGE__0___1 /end COMPU_METHOD
/begin COMPU_VTAB _CNV_S_2_RANGE__0___1 "" TAB_VERB 2 0 "0" 1 "1" /end COMPU_VTAB
/begin COMPU_METHOD _CNV_A_R_LINEAR_____2_CM "" RAT_FUNC "%6.3" "V" COEFFS 0 204.8 0. 0 0 1 /end COMPU_METHOD
/begin COMPU_METHOD _CNV_A_R_LINEAR_____3_CM "" RAT_FUNC "%6.3" "s" COEFFS 0 100. 0. 0 0 1 /end COMPU_METHOD
/begin COMPU_METHOD _CNV_A_R_LINEAR_____4_CM "" RAT_FUNC "%6.3" "s" COEFFS 0 10. 0. 0 0 1 /end COMPU_METHOD
/begin COMPU_METHOD _CNV_A_R_LINEAR_____5_CM "" RAT_FUNC "%6.3" "%" COEFFS 0 2.56 0. 0 0 1 /end COMPU_METHOD
/begin COMPU_METHOD _CNV_A_R_LINEAR_____6_CM "" RAT_FUNC "%6.3" "km/h" COEFFS 0 1. 0. 0 0 1 /end COMPU_METHOD
/begin COMPU_METHOD _CNV_A_R_LINEAR_____8_CM "" RAT_FUNC "%6.3" "-" COEFFS 0 32767.99999999992 0. 0 0 1 /end COMPU_METHOD
/begin COMPU_METHOD _CNV_A_R_LINEAR_____9_CM "" RAT_FUNC "%6.3" "rpm" COEFFS 0 3.125e-002 0. 0 0 1 /end COMPU_METHOD
/begin COMPU_METHOD _CNV_A_R_LINEAR_____13_CM "" RAT_FUNC "%6.3" "rpm" COEFFS 0 1. 0. 0 0 1 /end COMPU_METHOD
/begin COMPU_METHOD _CNV_A_R_LINEAR_____16_CM "" RAT_FUNC "%6.3" "°C" COEFFS 0 1.333333333333333 64. 0 0 1 /end COMPU_METHOD
/begin COMPU_METHOD _CNV_A_R_LINEAR_____17_CM "" RAT_FUNC "%6.3" "-" COEFFS 0 255.9983911655618 0. 0 0 1 /end COMPU_METHOD
/begin COMPU_METHOD _CNV_A_R_LINEAR_____24_CM "" RAT_FUNC "%6.3" "°C" COEFFS 0 1.333333333333333 0. 0 0 1 /end COMPU_METHOD
/begin COMPU_METHOD _CNV_A_R_LINEAR_____25_CM "" RAT_FUNC "%6.3" "°C" COEFFS 0 1. 40. 0 0 1 /end COMPU_METHOD
/begin COMPU_METHOD _CNV_A_R_LINEAR_____26_CM "" RAT_FUNC "%6.3" "hPa" COEFFS 0 12.06017666543982 0. 0 0 1 /end COMPU_METHOD
/begin COMPU_METHOD _CNV_A_R_LINEAR_____27_CM "" RAT_FUNC "%6.3" "-" COEFFS 0 256. 0. 0 0 1 /end COMPU_METHOD
/begin COMPU_METHOD _CNV_A_R_LINEAR_____30_CM "" RAT_FUNC "%6.3" "Nm" COEFFS 0 32. 0. 0 0 1 /end COMPU_METHOD
/begin COMPU_METHOD _CNV_S_3_STATE_ARS__31_CM "" TAB_VERB "%6.3" "" COMPU_TAB_REF _CNV_S_3_STATE_ARS__31 /end COMPU_METHOD
/begin COMPU_VTAB _CNV_S_3_STATE_ARS__31 "" TAB_VERB 3 0 "INACTIVE" 1 "ACTIVE" 3 "INVALID SIGNAL" /end COMPU_VTAB
/begin COMPU_METHOD _CNV_S_3_STATE_IGK__32_CM "" TAB_VERB "%6.3" "" COMPU_TAB_REF _CNV_S_3_STATE_IGK__32 /end COMPU_METHOD
/begin COMPU_VTAB _CNV_S_3_STATE_IGK__32 "" TAB_VERB 3 0 "IGK OFF" 1 "IGK ON" 2 "INVALID SIGNAL" /end COMPU_VTAB
/begin COMPU_METHOD _CNV_S_4_STATE_TCS__33_CM "" TAB_VERB "%6.3" "" COMPU_TAB_REF _CNV_S_4_STATE_TCS__33 /end COMPU_METHOD
/begin COMPU_VTAB _CNV_S_4_STATE_TCS__33 "" TAB_VERB 4 0 "NO INTERVENTION" 1 "MSR INTERVENTION" 2 "ASR INTERVENTION" 3 "INTERFACE LOCKED" /end COMPU_VTAB
/begin COMPU_METHOD _CNV_S_3_STATE_WAL__34_CM "" TAB_VERB "%6.3" "" COMPU_TAB_REF _CNV_S_3_STATE_WAL__34 /end COMPU_METHOD
/begin COMPU_VTAB _CNV_S_3_STATE_WAL__34 "" TAB_VERB 3 0 "OFF" 1 "YELLOW" 3 "signal invalid" /end COMPU_VTAB
/begin COMPU_METHOD _CNV_A_R_LINEAR_____35_CM "" RAT_FUNC "%6.3" "s" COEFFS 0 1. 0. 0 0 1 /end COMPU_METHOD
/begin COMPU_METHOD _CNV_A_R_LINEAR_____36_CM "" RAT_FUNC "%6.3" "V" COEFFS 0 9.807692307692308 0. 0 0 1 /end COMPU_METHOD
/begin COMPU_METHOD _CNV_A_R_LINEAR_____37_CM "" RAT_FUNC "%6.3" "Day" COEFFS 0 1. 0. 0 0 1 /end COMPU_METHOD
/begin COMPU_METHOD _CNV_S_9_STATE_TCS__38_CM "" TAB_VERB "%6.3" "" COMPU_TAB_REF _CNV_S_9_STATE_TCS__38 /end COMPU_METHOD
/begin COMPU_VTAB _CNV_S_9_STATE_TCS__38 "" TAB_VERB 9 0 "NO_CONTROL" 1 "ABS_CONTROL" 2 "ASR_CONTROL" 4 "TCS_CONTROL" 8 "HBA_CONTROL" 16 "MSR_CONTROL" 32 "EBV_CONTROL" 64 "DYNO_ACTIVE" 255 "SIGNAL INVALID" /end COMPU_VTAB
/begin COMPU_METHOD _CNV_S_5_STATE_TCS__39_CM "" TAB_VERB "%6.3" "" COMPU_TAB_REF _CNV_S_5_STATE_TCS__39 /end COMPU_METHOD
/begin COMPU_VTAB _CNV_S_5_STATE_TCS__39 "" TAB_VERB 5 0 "NO_INTERVENTION" 1 "DCC_INTV_ACCEPTED" 2 "EMF_INTV_ACCEPTED" 3 "HBA_INTV_ACCEPTED" 15 "SIGNAL INVALID" /end COMPU_VTAB
/begin COMPU_METHOD _CNV_A_R_LINEAR_____40_CM "" RAT_FUNC "%6.3" "m/s²" COEFFS 0 640. 0. 0 0 1 /end COMPU_METHOD
/begin COMPU_METHOD _CNV_S_5_STATE_MOD__41_CM "" TAB_VERB "%6.3" "" COMPU_TAB_REF _CNV_S_5_STATE_MOD__41 /end COMPU_METHOD
/begin COMPU_VTAB _CNV_S_5_STATE_MOD__41 "" TAB_VERB 5 0 "SSC_SBC_OFF" 1 "SSC_ON" 2 "SBC_ON" 3 "SSC_SBC_ON" 7 "INVALID_SIGNAL" /end COMPU_VTAB
/begin COMPU_METHOD _CNV_S_6_STATE_TCS__42_CM "" TAB_VERB "%6.3" "" COMPU_TAB_REF _CNV_S_6_STATE_TCS__42 /end COMPU_METHOD
/begin COMPU_VTAB _CNV_S_6_STATE_TCS__42 "" TAB_VERB 6 0 "VALID" 1 "PASSIV" 2 "DEFECTIVE" 4 "TRACTION MODE" 6 "UNDERVOLTAGE_TCS" 7 "INVALID SIGNAL" /end COMPU_VTAB
/begin COMPU_METHOD _CNV_S_4_STATE_TEMP_43_CM "" TAB_VERB "%6.3" "" COMPU_TAB_REF _CNV_S_4_STATE_TEMP_43 /end COMPU_METHOD
/begin COMPU_VTAB _CNV_S_4_STATE_TEMP_43 "" TAB_VERB 4 0 "NO_REQUEST" 1 "ACTIVE_STEP_1" 2 "ACTIVE_STEP_2" 3 "INVALID_SIGNAL" /end COMPU_VTAB
/begin COMPU_METHOD _CNV_A_R_LINEAR_____44_CM "" RAT_FUNC "%6.3" "km/h" COEFFS 0 10. 0. 0 0 1 /end COMPU_METHOD
/begin COMPU_METHOD _CNV_S_4_STATE_ETCU_45_CM "" TAB_VERB "%6.3" "" COMPU_TAB_REF _CNV_S_4_STATE_ETCU_45 /end COMPU_METHOD
/begin COMPU_VTAB _CNV_S_4_STATE_ETCU_45 "" TAB_VERB 4 0 "NO INTERVENTION" 1 "TORQUE_INCREASE" 2 "TORQUE_DECREASE" 3 "INTERFACE LOCKED" /end COMPU_VTAB
/begin COMPU_METHOD _CNV_S_4_STATE_DCC__46_CM "" TAB_VERB "%6.3" "" COMPU_TAB_REF _CNV_S_4_STATE_DCC__46 /end COMPU_METHOD
/begin COMPU_VTAB _CNV_S_4_STATE_DCC__46 "" TAB_VERB 4 0 "NO_INTERVENTION" 1 "TORQUE_INCREASE" 2 "INVALID_SIGNAL" 3 "INVALID_SIGNAL" /end COMPU_VTAB
/begin COMPU_METHOD _CNV_S_3_STATE_DCC__47_CM "" TAB_VERB "%6.3" "" COMPU_TAB_REF _CNV_S_3_STATE_DCC__47 /end COMPU_METHOD
/begin COMPU_VTAB _CNV_S_3_STATE_DCC__47 "" TAB_VERB 3 0 "NO_REQUEST" 1 "INHIBIT_PUC" 3 "INVALID_SIGNAL" /end COMPU_VTAB
/begin COMPU_METHOD _CNV_S_4_STATE_DCC__48_CM "" TAB_VERB "%6.3" "" COMPU_TAB_REF _CNV_S_4_STATE_DCC__48 /end COMPU_METHOD
/begin COMPU_VTAB _CNV_S_4_STATE_DCC__48 "" TAB_VERB 4 0 "reserved" 1 "SYS_OFF" 2 "SYS_OK" 3 "INVALID_SIGNAL" /end COMPU_VTAB
/begin COMPU_METHOD _CNV_S_8_STATE_DCC_49_CM "" TAB_VERB "%6.3" "" COMPU_TAB_REF _CNV_S_8_STATE_DCC_49 /end COMPU_METHOD
/begin COMPU_VTAB _CNV_S_8_STATE_DCC_49 "" TAB_VERB 8 0 "INACTIVE" 1 "STAND_BY" 2 "NORMAL" 3 "RESERVE" 4 "BRAKE_ACTIVE" 5 "DRIVER_ACTIVE" 6 "RESERVE" 7 "INVALID_SIGNAL" /end COMPU_VTAB
/begin COMPU_METHOD _CNV_A_R_LINEAR_____50_CM "" RAT_FUNC "%6.3" "" COEFFS 0 1. 0. 0 0 1 /end COMPU_METHOD
/begin COMPU_METHOD _CNV_S_3_STATE_ETCU_51_CM "" TAB_VERB "%6.3" "" COMPU_TAB_REF _CNV_S_3_STATE_ETCU_51 /end COMPU_METHOD
/begin COMPU_VTAB _CNV_S_3_STATE_ETCU_51 "" TAB_VERB 3 0 "NO_OBD_ERROR" 1 "OBD_ERROR" 2 "INVALID_SIGNAL" /end COMPU_VTAB
/begin COMPU_METHOD _CNV_A_R_LINEAR_____52_CM "" RAT_FUNC "%6.3" "km" COEFFS 0 1. 0. 0 0 1 /end COMPU_METHOD
/begin COMPU_METHOD _CNV_R_R_spg_gencan_53_CM "" RAT_FUNC "%6.3" "V" COEFFS 0. 40. -424. 0. 0. 1. /end COMPU_METHOD
/begin COMPU_METHOD _CNV_S_13_STATE_BN_M_54_CM "" TAB_VERB "%6.3" "" COMPU_TAB_REF _CNV_S_13_STATE_BN_M_54 /end COMPU_METHOD
/begin COMPU_VTAB _CNV_S_13_STATE_BN_M_54 "" TAB_VERB 13 0 "NO_ACTION" 1 "TIP_PRE" 2 "TIP_POST" 4 "PRESS_PRE" 8 "PRESS_POST" 16 "TIP UP or DOWN" 64 "TIP_AXIAL" 65 "TIP_AXIAL" 66 "TIP_AXIAL" 68 "TIP_POST" 72 "PRESS_POST" 80 "TIP UP or DOWN" 127 "INVALID SIGNAL" /end COMPU_VTAB
/begin COMPU_METHOD _CNV_S_3_STATE_ST_T_55_CM "" TAB_VERB "%6.3" "" COMPU_TAB_REF _CNV_S_3_STATE_ST_T_55 /end COMPU_METHOD
/begin COMPU_VTAB _CNV_S_3_STATE_ST_T_55 "" TAB_VERB 3 0 "NO_INTERVENTION" 1 "INTERVENTION" 3 "INVALID_SIGNAL" /end COMPU_VTAB
/begin COMPU_METHOD _CNV_S_3_STATE_VS_I_56_CM "" TAB_VERB "%6.3" "" COMPU_TAB_REF _CNV_S_3_STATE_VS_I_56 /end COMPU_METHOD
/begin COMPU_VTAB _CNV_S_3_STATE_VS_I_56 "" TAB_VERB 3 0 "km/h" 1 "mph" 3 "INVALID SIGNAL" /end COMPU_VTAB
/begin COMPU_METHOD _CNV_A_R_LINEAR_____57_CM "" RAT_FUNC "%6.3" "Nm" COEFFS 0 2. 0. 0 0 1 /end COMPU_METHOD
/begin COMPU_METHOD _CNV_S_4_STATE_PSTE_58_CM "" TAB_VERB "%6.3" "" COMPU_TAB_REF _CNV_S_4_STATE_PSTE_58 /end COMPU_METHOD
/begin COMPU_VTAB _CNV_S_4_STATE_PSTE_58 "" TAB_VERB 4 0 "NO INTERVENTION" 1 "TORQUE INCREASE" 2 "TORQUE DECREASE" 3 "INVALID SIGNAL" /end COMPU_VTAB
/begin COMPU_METHOD _CNV_A_R_LINEAR_____59_CM "" RAT_FUNC "%6.3" "%" COEFFS 0 2. 0. 0 0 1 /end COMPU_METHOD
/begin COMPU_METHOD _CNV_A_R_LINEAR_____60_CM "" RAT_FUNC "%6.3" "Nm" COEFFS 0 1. 0. 0 0 1 /end COMPU_METHOD
/begin COMPU_METHOD _CNV_A_R_LINEAR_____61_CM "" RAT_FUNC "%6.3" "1/m" COEFFS 0 8. 0. 0 0 1 /end COMPU_METHOD
/begin COMPU_METHOD _CNV_A_R_LINEAR_____62_CM "" RAT_FUNC "%6.3" "mA" COEFFS 0 1. 0. 0 0 1 /end COMPU_METHOD
/begin COMPU_METHOD _CNV_A_R_LINEAR_____63_CM "" RAT_FUNC "%6.3" "A" COEFFS 0 0.1 0. 0 0 1 /end COMPU_METHOD
/begin COMPU_METHOD _CNV_R_R_Def_km_sw__64_CM "Def_km_sw_q10" RAT_FUNC "%6.3" "km" COEFFS 0. 1. 0. 0. 0. 10. /end COMPU_METHOD
/begin COMPU_METHOD _CNV_A_R_LINEAR_____65_CM "" RAT_FUNC "%6.3" "Nm" COEFFS 0 32. 32768. 0 0 1 /end COMPU_METHOD
/begin COMPU_METHOD _CNV_A_R_LINEAR_____66_CM "" RAT_FUNC "%6.3" "km/h" COEFFS 0 128.0000018750286 0. 0 0 1 /end COMPU_METHOD
/begin COMPU_METHOD _CNV_A_R_LINEAR_____67_CM "" RAT_FUNC "%6.3" "bar" COEFFS 0 1. 0. 0 0 1 /end COMPU_METHOD
/begin COMPU_METHOD _CNV_A_R_LINEAR_____68_CM "" RAT_FUNC "%6.3" "-" COEFFS 0 65535.99999999996 0. 0 0 1 /end COMPU_METHOD
/begin COMPU_METHOD _CNV_A_R_LINEAR_____69_CM "" RAT_FUNC "%6.3" "µl" COEFFS 0 1. 0. 0 0 1 /end COMPU_METHOD
/begin COMPU_METHOD _CNV_A_R_LINEAR_____70_CM "" RAT_FUNC "%6.3" "km" COEFFS 0 0.1 0. 0 0 1 /end COMPU_METHOD
/begin COMPU_METHOD _CNV_A_R_LINEAR_____71_CM "" RAT_FUNC "%6.3" "" COEFFS 0 256. 0. 0 0 1 /end COMPU_METHOD
/begin COMPU_METHOD _CNV_S_4_RANGE_STAT_72_CM "" TAB_VERB "%6.3" "" COMPU_TAB_REF _CNV_S_4_RANGE_STAT_72 /end COMPU_METHOD
/begin COMPU_VTAB _CNV_S_4_RANGE_STAT_72 "" TAB_VERB 4 0 "CC open" 1 "CC controlled" 2 "CC closed" 3 "not defined" /end COMPU_VTAB
/begin COMPU_METHOD _CNV_S_9_STATE_ETCU_73_CM "" TAB_VERB "%6.3" "" COMPU_TAB_REF _CNV_S_9_STATE_ETCU_73 /end COMPU_METHOD
/begin COMPU_VTAB _CNV_S_9_STATE_ETCU_73 "" TAB_VERB 9 0 "MIL_OFF" 2 "MIL_OFF" 4 "MIL_ON" 6 "MIL_ON" 8 "MIL_FLL" 10 "MIL_FLL" 12 "IDLE" 14 "INI_VALUE" 15 "INVALID_SIGNAL" /end COMPU_VTAB
/begin COMPU_METHOD _CNV_A_R_LINEAR_____74_CM "" RAT_FUNC "%6.3" "rpm" COEFFS 0 8. 0. 0 0 1 /end COMPU_METHOD
/begin COMPU_METHOD _CNV_S_2_RANGE______75_CM "" TAB_VERB "%6.3" "" COMPU_TAB_REF _CNV_S_2_RANGE______75 /end COMPU_METHOD
/begin COMPU_VTAB _CNV_S_2_RANGE______75 "" TAB_VERB 2 0 "0" 1 "1" /end COMPU_VTAB
/begin COMPU_METHOD _CNV_A_R_LINEAR_____76_CM "" RAT_FUNC "%6.3" "l" COEFFS 0 1. 0. 0 0 1 /end COMPU_METHOD
/begin COMPU_METHOD _CNV_A_R_LINEAR_____77_CM "" RAT_FUNC "%6.3" "min" COEFFS 0 1. 0. 0 0 1 /end COMPU_METHOD
/begin COMPU_METHOD _CNV_A_R_LINEAR_____78_CM "" RAT_FUNC "%6.3" "s" COEFFS 0 5. 0. 0 0 1 /end COMPU_METHOD
/begin COMPU_METHOD _CNV_A_R_LINEAR_____79_CM "" RAT_FUNC "%6.3" "°STW/s" COEFFS 0 22.75571737399022 0. 0 0 1 /end COMPU_METHOD
/begin COMPU_METHOD _CNV_A_R_LINEAR_____80_CM "" RAT_FUNC "%6.3" "°STW" COEFFS 0 22.75571737399022 0. 0 0 1 /end COMPU_METHOD
/begin COMPU_METHOD _CNV_S_5_STATE_AMT_81_CM "" TAB_VERB "%6.3" "" COMPU_TAB_REF _CNV_S_5_STATE_AMT_81 /end COMPU_METHOD
/begin COMPU_VTAB _CNV_S_5_STATE_AMT_81 "" TAB_VERB 5 0 "NO INTERVENTION" 1 "TORQUE_DECREASE" 2 "N_REGULATION" 3 "TORQUE_INCREASE" 7 "INVALID_SIGNAL" /end COMPU_VTAB
/begin COMPU_METHOD _CNV_S_5_STATE_CLU__82_CM "" TAB_VERB "%6.3" "" COMPU_TAB_REF _CNV_S_5_STATE_CLU__82 /end COMPU_METHOD
/begin COMPU_VTAB _CNV_S_5_STATE_CLU__82 "" TAB_VERB 5 0 "CLU_OPEN" 1 "CREEPING" 2 "DRIVE_OFF" 3 "CLU_CLOSED" 7 "INVALID_SIGNAL" /end COMPU_VTAB
/begin COMPU_METHOD _CNV_A_R_LINEAR_____100_CM "" RAT_FUNC "%6.3" "-" COEFFS 0 128. 0. 0 0 1 /end COMPU_METHOD
/begin COMPU_METHOD _CNV_A_R_LINEAR_____108_CM "" RAT_FUNC "%6.3" "mg/stk" COEFFS 0 47.18142548596112 0. 0 0 1 /end COMPU_METHOD
/begin COMPU_METHOD _CNV_A_R_LINEAR_____122_CM "" RAT_FUNC "%6.3" "-" COEFFS 0 1024. 0. 0 0 1 /end COMPU_METHOD
/begin COMPU_METHOD _CNV_A_R_LINEAR_____123_CM "" RAT_FUNC "%6.3" "°C" COEFFS 0 16. 0. 0 0 1 /end COMPU_METHOD
/begin COMPU_METHOD _CNV_A_R_LINEAR_____137_CM "" RAT_FUNC "%6.3" "h" COEFFS 0 35999.99999497086 0. 0 0 1 /end COMPU_METHOD
/begin COMPU_METHOD _CNV_S_7_RANGE_ECU__144_CM "" TAB_VERB "%6.3" "" COMPU_TAB_REF _CNV_S_7_RANGE_ECU__144 /end COMPU_METHOD
/begin COMPU_VTAB _CNV_S_7_RANGE_ECU__144 "" TAB_VERB 7 0 "ENG_STOP" 1 "RUN_ENG" 2 "SYN_ENG_IGK_ON" 3 "SYN_ENG_IGK_OFF" 4 "PWL" 5 "ENG_LOCK" 6 "WAKE_UP" /end COMPU_VTAB
/begin COMPU_METHOD _CNV_A_R_LINEAR_____166_CM "" RAT_FUNC "%6.3" "°CRK" COEFFS 0 16. 0. 0 0 1 /end COMPU_METHOD
/begin COMPU_METHOD _CNV_A_R_LINEAR_____171_CM "" RAT_FUNC "%6.3" "°CRK" COEFFS 0 2.666666666666667 128. 0 0 1 /end COMPU_METHOD
/begin COMPU_METHOD _CNV_A_R_LINEAR_____189_CM "" RAT_FUNC "%6.3" "V" COEFFS 0 51.0204081632653 0. 0 0 1 /end COMPU_METHOD
/begin COMPU_METHOD _CNV_A_R_LINEAR_____190_CM "" RAT_FUNC "%6.3" "V" COEFFS 0 13107.19998965744 0. 0 0 1 /end COMPU_METHOD
/begin COMPU_METHOD _CNV_A_R_LINEAR_____207_CM "" RAT_FUNC "%6.3" "kg/h" COEFFS 0 32. 0. 0 0 1 /end COMPU_METHOD
/begin COMPU_METHOD _CNV_A_R_LINEAR_____211_CM "" RAT_FUNC "%6.3" "mV" COEFFS 0 1. 200. 0 0 1 /end COMPU_METHOD
/begin COMPU_METHOD _CNV_A_R_LINEAR_____221_CM "" RAT_FUNC "%6.3" "°TPS" COEFFS 0 137.0962343096234 0. 0 0 1 /end COMPU_METHOD
/begin COMPU_METHOD _CNV_A_R_LINEAR_____229_CM "" RAT_FUNC "%6.3" "°TPS" COEFFS 0 137.0962343096234 1.818989403545857e-012 0 0 1 /end COMPU_METHOD
/begin COMPU_METHOD _CNV_A_R_LINEAR_____232_CM "" RAT_FUNC "%6.3" "" COEFFS 0 65535. 0. 0 0 1 /end COMPU_METHOD
/begin COMPU_METHOD _CNV_A_R_LINEAR_____233_CM "" RAT_FUNC "%6.3" "ms" COEFFS 0 1000. 0. 0 0 1 /end COMPU_METHOD
/begin COMPU_METHOD _CNV_A_R_LINEAR_____260_CM "" RAT_FUNC "%6.3" "°TPS/s" COEFFS 0 8.535564853556485e-002 0. 0 0 1 /end COMPU_METHOD
/begin COMPU_METHOD _CNV_A_R_LINEAR_____261_CM "" RAT_FUNC "%6.3" "°TPS/V" COEFFS 0 1365.3125 0. 0 0 1 /end COMPU_METHOD
/begin COMPU_METHOD _CNV_A_R_LINEAR_____423_CM "" RAT_FUNC "%6.3" "A" COEFFS 0 4. 0. 0 0 1 /end COMPU_METHOD
/begin COMPU_METHOD _CNV_A_R_LINEAR_____446_CM "" RAT_FUNC "%6.3" "m" COEFFS 0 1.e-002 0. 0 0 1 /end COMPU_METHOD
/begin COMPU_METHOD _CNV_A_R_LINEAR_____459_CM "" RAT_FUNC "%6.3" "A" COEFFS 0 1. 0. 0 0 1 /end COMPU_METHOD
/begin COMPU_METHOD _CNV_A_R_LINEAR_____460_CM "" RAT_FUNC "%6.3" "V" COEFFS 0 66.66666666666667 0. 0 0 1 /end COMPU_METHOD
/begin COMPU_METHOD _CNV_A_R_LINEAR_____482_CM "" RAT_FUNC "%6.3" "°CRK" COEFFS 0 42.66666666666666 0. 0 0 1 /end COMPU_METHOD
/begin COMPU_METHOD _CNV_A_R_LINEAR_____499_CM "" RAT_FUNC "%6.3" "ppm" COEFFS 0 1. 0. 0 0 1 /end COMPU_METHOD
/begin RECORD_LAYOUT _REC_VAL_20_u1 FNC_VALUES 1 UBYTE COLUMN_DIR DIRECT /end RECORD_LAYOUT
/begin RECORD_LAYOUT _REC_VAL_20_u2 FNC_VALUES 1 UWORD COLUMN_DIR DIRECT /end RECORD_LAYOUT
/begin RECORD_LAYOUT _REC_AXS_20_u1 NO_AXIS_PTS_X 1 UBYTE AXIS_PTS_X 2 UBYTE INDEX_INCR DIRECT /end RECORD_LAYOUT
/begin RECORD_LAYOUT _REC_MAP_20_u2_u1_u1 FNC_VALUES 1 UWORD COLUMN_DIR DIRECT /end RECORD_LAYOUT
/begin RECORD_LAYOUT _REC_VAL_20_s2 FNC_VALUES 1 SWORD COLUMN_DIR DIRECT /end RECORD_LAYOUT
/begin RECORD_LAYOUT _REC_AXS_20_u2 NO_AXIS_PTS_X 1 UWORD AXIS_PTS_X 2 UWORD INDEX_INCR DIRECT /end RECORD_LAYOUT
/begin RECORD_LAYOUT _REC_CUR_20_u2_u1 FNC_VALUES 1 UWORD COLUMN_DIR DIRECT /end RECORD_LAYOUT
/begin RECORD_LAYOUT _REC_CUR_20_u2_u2 FNC_VALUES 1 UWORD COLUMN_DIR DIRECT /end RECORD_LAYOUT
/begin RECORD_LAYOUT _REC_CUR_20_u1_u2 FNC_VALUES 1 UBYTE COLUMN_DIR DIRECT /end RECORD_LAYOUT
/begin RECORD_LAYOUT _REC_VAL_20_u4 FNC_VALUES 1 ULONG COLUMN_DIR DIRECT /end RECORD_LAYOUT
/begin FUNCTION SYS_Input_messages "_Input messages"
 /begin DEF_CHARACTERISTIC c_temp_gb_sub c_t_ctr_swi_off_vb_min c_v_sp_gen c_tq_accin c_tq_stnd c_tam_sub lc_tam_man_as c_tam_man_as c_tout_efp_crash c_ctr_ftl_not_vld lc_tqi_maf_man ip_tq_loss_acc_inp c_state_tq_can_plaus_ena /end DEF_CHARACTERISTIC
 /begin OUT_MEASUREMENT lv_err_bn_msw tq_loss_ars_av_can tq_loss_ars_sp_can veh_key_nr state_ars_can state_igk_can lv_tcs_lih_can state_tcs_intv state_wal_can t_ctr_rel_can v_sp_gen t_can state_tcs_ctl state_tcs_dece ac_veh_lgt_tcs ac_veh_trv_tcs state_mod_gb state_tcs_can state_temp_gb temp_gb vs_icl_disp lv_dcc_lih_can lv_dcc_puc_inh tq_dcc_slow_bn tq_dcc_fast_bn state_etcu_intv state_dcc_intv state_dcc_puc_inh state_dcc_off_req state_dcc lv_dcc_off_ack lv_err_tq_loss_ars_av_can lv_err_tq_loss_ars_sp_can lv_rly_st_can lv_key_aux tcc_can_cas tcc_can_etcu_2 tq_tcs_fast_bn tcc_can_tq_dcc tq_tcs_slow_bn tq_gs_slow_bn tcc_can_tq_tcs lv_tq_dcc_inc_req tq_gs_fast_bn tq_amt_fast_bn tq_amt_slow_bn tcc_can_tq_etcu state_etcu_obd_err state_amt_intv state_acin_can ctr_km_bn tcc_can_tq_amt t_ctr_swi_off_vb v_gen_tar tcc_can_icl tcc_can_msw state_bn_msw lv_err_ang_pste_can tcc_can_ars lv_etcu_lih_can lv_etcu_lih_can_1 lv_etcu_lih_can_2 lv_amt_lih_can state_st_tq_lim_gs state_st_tq_lim_amt lv_var_etcu lv_var_efp_crash lv_var_bn_msw lv_var_dcc lv_var_ars state_veh_mod state_vs_icl_disp tcc_can_veh_mod state_if_icl_bn_msw tcc_can_tq_pste_2 state_pste_2_intv tq_loss_pste_2_av_can tq_loss_pste_2_sp_can lv_pste_2_err state_brake_prs lv_var_pste_2 state_cru_bn nr_vs_cru_if vs_step_if[0] vs_step_if[1] vs_step_if[2] lv_msg_prog_step_cru lv_ltg_hdlp_l_on lv_ltg_inl_on opg_value_hiv_perc state_hiv heat_req_perc state_di_puc state_sp_dyn_wheel tq_wheel_ldm_bn tcc_can_ldm tcc_can_tq_wheel_1 tcc_can_tq_wheel_2 fac_gb_gain lv_state_trl lv_pow_clas_veh_can_rcv cur_wku_can cur_sc_min_can cur_sc_max_can idx_bat_can lv_tq_wheel_ldm_bn_err state_ldm_intv state_ldm lv_tq_wheel_ldm_req lv_ldm_lih_can fac_is_inc_req fac_pow_mng_vst_cns state_ext_pow_cns state_igk_hw lv_ecras_ctl_can_1 lv_ecras_ctl_can_2 qoil_ds_rst_can_1_5 ctr_tout_n_ecf_can lv_ldm_can_ini state_etcu_prog_info ctr_diag_tcc_can_cas ctr_diag_tcc_can_tq_tcs ctr_diag_tcc_can_tq_etcu ctr_diag_tcc_can_tq_amt ctr_diag_tcc_can_icl ctr_diag_tcc_can_ars ctr_diag_tcc_can_msw ctr_diag_tcc_can_tq_dcc ctr_diag_cks_cas ctr_diag_cks_tq_tcs ctr_diag_cks_tq_etcu ctr_diag_cks_tq_amt ctr_diag_cks_msw ctr_diag_cks_tq_dcc ctr_diag_tout_ars ctr_diag_tout_cas ctr_diag_tout_tq_tcs ctr_diag_tout_vs_tcs ctr_diag_tout_tcs ctr_diag_tout_tq_etcu ctr_diag_tout_etcu ctr_diag_tout_etcu_2 ctr_diag_tout_etcu_disp ctr_diag_tout_tq_amt ctr_diag_tout_tq_dcc ctr_diag_tout_acc ctr_diag_tout_km_icl ctr_diag_tout_icl ctr_diag_tout_pow_vb ctr_diag_tout_pow_gen ctr_diag_tout_msw ctr_diag_tout_t_icl ctr_diag_tout_ang_pste ctr_diag_tcc_can_veh_mod ctr_diag_cks_veh_mod ctr_diag_tout_veh_mod ctr_diag_tcc_can_tq_pste_2 ctr_diag_cks_tq_pste_2 ctr_diag_tout_tq_pste_2 ctr_diag_tout_efp ctr_diag_tout_efp_crash lv_err_bn_acc lv_err_bn_cas lv_err_bn_icl lv_err_bn_km_icl lv_err_bn_pow_gen lv_err_bn_pow_vb lv_err_bn_t_icl lv_err_bn_tq_pste_2 lv_err_bn_efp lv_err_bn_efp_crash lv_err_bn_gear_rev ctr_diag_tout_gear_rev lv_err_bn_ltg_hdlp_l ctr_diag_tout_ltg_hdlp_l ctr_diag_tcc_can_ldm ctr_diag_cks_ldm ctr_diag_tout_ldm lv_err_bn_ldm ctr_diag_tout_hiv lv_err_bn_hiv ctr_diag_tout_trl lv_err_bn_trl ctr_diag_tout_t_clk lv_err_bn_t_clk lv_err_bn_etcu_disp tqi_msr_can vs_can wheel lv_plaus_asr_ctl lv_plaus_esp_ctl tqi_asr_fast_can lv_err_vs_can tqi_asr_fast_req_can tqi_msr_req_can tqi_asr_slow_can tqi_asr_slow_req_can lv_tq_asr_req lv_tq_msr_req brake_prs gear_sel_disp tqi_gs_req_can tqi_gs_fast_req_can tqi_gs_slow_req_can tq_gear_can tqi_gs_req tqi_gs_fast_req tqi_gs_slow_req lv_tq_gs_inc_req lv_tq_gs_dec_req gear_info tq_conv_can state_cc state_etcu_obd n_gb tq_accin_can state_efp_crash_can lv_req_heat lv_ltg_swi_can lv_tam_can_err state_gear_rev_can ftl lv_ftl_can_err n_ecf lv_req_tco_l lv_accin ctr_km_can t_rel_can tam lv_acin lv_ftl_le_can_err lv_ftl_ri_can_err lv_ftl_obd_inh_l ftl_le ftl_ri vel_ang_pste state_sens_ang_pste lv_var_pste ang_pste lv_city tqi_slow_amt_req_can tqi_amt_req tqi_slow_amt_req tqi_amt_req_can tqi_amt_cpl_can tcc_can_amt_1 state_amt_obd_err state_amt state_clu_amt lv_tq_amt_dec_req lv_tq_amt_inc_req n_max_amt_can lv_amt_es lv_gs lv_gp state_amt_obd lv_pump_amt_on lv_var_amt tco_can ctr_ftl_not_vld ctr_ftl_ri_not_vld ctr_ftl_le_not_vld lv_ftl_tot_can_err lv_ctop lv_mil_can lv_wal_1_can gear lv_err_bn_tq_etcu lv_err_bn_etcu lv_err_bn_etcu_2 lv_err_bn_tq_amt lv_err_bn_ars lv_err_bn_tq_tcs lv_err_bn_vs_tcs lv_err_bn_tcs lv_err_tq_req_can state_tq_can_plaus lv_err_bn_ang_pste lv_wake_up dist lv_err_plaus_igk_bn /end OUT_MEASUREMENT
/end FUNCTION
/begin FUNCTION SYS_Oil_temperature "_Oil temperature" /begin DEF_CHARACTERISTIC c_toil_sub_diag /end DEF_CHARACTERISTIC /begin OUT_MEASUREMENT toil toil_stop /end OUT_MEASUREMENT /end FUNCTION
/begin FUNCTION SYS_Ambient_pressure_variables "_Ambient pressure variables"
 /begin DEF_CHARACTERISTIC c_amp_hys ip_amp_raw_cor__vs c_amp_crlc c_fac_amp_min c_fac_amp_max ip_amp_raw__v_amp /end DEF_CHARACTERISTIC
 /begin OUT_MEASUREMENT amp_mes fac_amp /end OUT_MEASUREMENT
/end FUNCTION
/begin FUNCTION SYS_System_variables_in_the_exhaust_pipe "_System variables in the exhaust pipe"
 /begin DEF_CHARACTERISTIC ip_teg_egr__maf_cyl lc_teg_swi lc_teg_cat_down_mdl_swi ip_prs_ex_inc ip_prs_ex_egr_inc /end DEF_CHARACTERISTIC
 /begin OUT_MEASUREMENT prs_ex prs_ex_inc prs_ex_egr prs_ex_egr_inc /end OUT_MEASUREMENT
/end FUNCTION
/begin FUNCTION SYS_Detection_of_Driver_Passive "_Detection of Driver Passive" /begin DEF_CHARACTERISTIC c_fac_tq_req_clu_is_hys ip_fac_tq_req_clu_is__n_32 /end DEF_CHARACTERISTIC /begin OUT_MEASUREMENT lv_ct /end OUT_MEASUREMENT /end FUNCTION
/begin FUNCTION SYS_System_variables_for_and_from_CUS "_System variables for and from CUS"
 /begin DEF_CHARACTERISTIC lc_pwsl_ena c_bat_psn c_maf_ref lc_mff_sp_homs_man_act c_mff_sp_1_homs_man c_mff_sp_2_homs_man /end DEF_CHARACTERISTIC
 /begin OUT_MEASUREMENT load_bat state_cur_eng_cns n_st_pow_mod lv_n_sp_is_pow_act state_alter tq_loss_alter_1 cur_alter_exct_lim_sp cur_alter_max pow_rel_alter_clc temp_alter vb_pow_mng cur_gen lv_alter_swi_off t_fil_cur_exct_alter lv_n_sp_is_pwr_stab n_sp_is_pow_1 cam_psn_raw[0] cam_psn_raw[1] /end OUT_MEASUREMENT
/end FUNCTION
/begin FUNCTION SYS_ECU_state "_ECU state" /begin DEF_CHARACTERISTIC c_t_di_eng_run /end DEF_CHARACTERISTIC /begin OUT_MEASUREMENT fast_ecu_tran_pwl_ctr ecu_state /end OUT_MEASUREMENT /end FUNCTION
/begin FUNCTION SYS_Pressure_Variables "_Pressure Variables"
 /begin DEF_CHARACTERISTIC ldp_v_put__put_mes_bas ip_put_mes_bas lc_map_absv_rel_swi lc_put_absv_rel_swi ip_map_mes_bas ldp_v_ptcha_1__ptcha_1 ldp_v_ptcha_2__ptcha_2 ip_ptcha_1 ip_ptcha_2 lc_ptcha_absv_rel_swi c_t_dly_map_mes_ad c_tps_v_map_ad_min c_fac_temp_map_dip_tco_ex c_fac_temp_map_dip_tia c_fac_temp_map_dip_tam c_fac_v_map_ad c_fac_temp_v_map_ad c_nr_v_map_acq c_v_map_sp_ad c_v_map_ad_max c_temp_map_dip_mdl_fac_min c_temp_map_dip_mdl_fac_max c_v_map_sp_dif_max c_fac_temp_v_map_sp_dif_max /end DEF_CHARACTERISTIC
 /begin OUT_MEASUREMENT map_dip_mes_bas put_mes_bas map_dip_mes_bas_2seg put_mes_bas_2seg v_map v_put ptcha_1 ptcha_2 temp_map_dip_mdl v_map_ad v_map_dif v_map_dif_vld lv_t_dly_map_mes_ad /end OUT_MEASUREMENT
/end FUNCTION
/begin FUNCTION SYS_Engine_off_duration "_Engine off duration"
 /begin DEF_CHARACTERISTIC c_t_es_tco_plaus_max c_t_es_tco_plaus_min c_tco_stop_t_es_plaus_min c_t_es_sub c_tco_stop_t_es_plaus_max c_tco_stop_t_es_min /end DEF_CHARACTERISTIC
 /begin OUT_MEASUREMENT t_es t_rel_can_es t_rel_can_st lv_t_rel_can_reg lv_t_es_not_plaus t_es_cus /end OUT_MEASUREMENT
/end FUNCTION
/begin FUNCTION SYS_Total_running_time "_Total running time" /begin OUT_MEASUREMENT trt /end OUT_MEASUREMENT /end FUNCTION
/begin FUNCTION SYS_Determination_of_Throttle_Position "_Determination of Throttle Position"
 /begin DEF_CHARACTERISTIC c_v_tps_swi_gain_1 c_v_tps_hys_gain_1 c_v_tps_grd_max c_v_tps_gain_grd_max c_tps_max c_tps_slop /end DEF_CHARACTERISTIC
 /begin OUT_MEASUREMENT tps_av_1 tps_av_2 tps_grd tps_seg tps_seg_1 tps_seg_2 tps_seg_gain_1 tps_av_gain_1 v_tps_gain_tol_ena_1 v_tps_gain_bol_ena_1 tps_lih tps_av tps_av_ctl tps_av_ctl_1 tps_av_ctl_2 tps_av_ctl_gain_1 lv_tps_gain_act_1 lv_tps_grd_up /end OUT_MEASUREMENT
/end FUNCTION
/begin FUNCTION _Intake_manifold_model "_Appl. Inc. Intake manifold model" /begin OUT_MEASUREMENT lv_maf_ctl /end OUT_MEASUREMENT /end FUNCTION
/begin FUNCTION SYS_ECU_Temperature "_ECU Temperature"
 /begin DEF_CHARACTERISTIC ip_tecu c_tecu_sub c_tecu_thd_1 c_tecu_thd_2 c_tecu_thd_3 c_tecu_thd_4 c_tecu_thd_5 c_tecu_thd_6 c_tecu_thd_7 c_trt_dif_tecu /end DEF_CHARACTERISTIC
 /begin OUT_MEASUREMENT ctr_stc_tecu_1 ctr_stc_tecu_2 ctr_stc_tecu_3 ctr_stc_tecu_4 ctr_stc_tecu_5 ctr_stc_tecu_6 ctr_stc_tecu_7 ctr_stc_tecu_8 tecu /end OUT_MEASUREMENT
/end FUNCTION
/begin FUNCTION SYS_Output_signals_of_the_DME_to_the_CAN_bus "_Output signals of the DME to the CAN bus"
 /begin DEF_CHARACTERISTIC c_t_cyc_disp_icl_can c_icl_disp_frq c_cc_mess c_n_32_thd_cc_poil_swi ip_t_dly_poil_swi_can__toil c_n_sp_is_thd_can lc_msr_bn lc_ena_cc_mil_1 lc_ena_cc_mil_2 c_state_cc_id_34 c_state_cc_id_33 c_state_cc_id_257 c_state_cc_id_39 c_state_cc_id_212 c_state_cc_id_213 c_state_cc_id_26 c_state_cc_id_28 c_state_cc_id_29 c_state_cc_id_31 c_state_cc_id_155 c_state_cc_id_27 c_state_cc_id_32 c_state_cc_id_182 c_state_cc_id_229 c_state_cc_id_247 c_state_cc_id_220 c_state_cc_id_304 c_state_cc_id_305 c_state_cc_id_306 c_state_cc_id_148 c_state_cc_id_276 c_state_cc_id_278 c_ctr_tout_n_ecf_can c_ctr_dly_msg_oil c_state_loil_sub c_n_ecf_can c_ctr_ldm_can_ini lc_efppwm_ctl c_max_msg_miss_asr_can c_tmot_sum_hys c_t_tco_can_ast c_tco_swi_wup c_t_ctr_max_asr_can c_tco_tmot_sta c_fac_mff_fco ip_t_ast_swi_wup__ctr_km_can c_pv_can_diag c_eng_etcu c_crlc_fco_av c_t_igk_lih c_t_dly_igk_off_prel c_t_temp_igk_off_prel ip_t_ast_is_ad_inh /end DEF_CHARACTERISTIC
 /begin OUT_MEASUREMENT tcc_can_ecu tcc_can_ecu1 tcc_can_ecu2 tcc_can_ecu3 cc_id lv_mil_fll tq_ems_bn tq_maf state_cc_key state_dcc_ctl ctr_dly_msg_oil lv_ack_tcs fco ctl_shift_lock_can lv_level_is tqi_maf tqi_av_can tqi_ems_can tqi_maf_can lv_crul_ack fco_av_mmv fco_dmtl /end OUT_MEASUREMENT
/end FUNCTION
/begin FUNCTION SYS_Check_Sum_Calculation "_Check Sum Calculation"
 /begin OUT_MEASUREMENT ctl_acin_eng_typ state_swi_off_vb cks_can_tq_dcc cks_can_tq_tcs cks_can_tq_etcu cks_can_tq_amt cks_can_msw cks_can_cas cks_clc_cas cks_can_etcu_2 cks_clc_etcu_2 cks_clc_tq_dcc cks_clc_tq_tcs cks_clc_tq_etcu cks_clc_tq_amt cks_clc_msw cks_clc_ecu1 cks_clc_ecu2 cks_clc_ecu3 cks_can_veh_mod cks_can_tq_pste_2 cks_clc_tq_pste_2 cks_can_ldm cks_clc_ldm cks_clc_tq_wheel_1 cks_clc_tq_wheel_2 state_pow_clas_veh t_clk_icl_disp_1 t_clk_icl_disp_2 t_clk_icl_disp_3 n_ecf_can ecf_req_ext qoil_ds_rst_can_2_1 qoil_ds_rst_can_2_2 qoil_ds_rst_can_2_3 qoil_ds_rst_can_2_4 qoil_ds_rst_can_2_5 qoil_ds_rst_can_2_6 /end OUT_MEASUREMENT
/end FUNCTION
/begin FUNCTION SYS_Multiplexed_segment_synchronous_output_variables "_Multiplexed segment-synchronous output variables"
 /begin OUT_MEASUREMENT iga_igc_0_5_h_rng iga_knk_0_5 knk_thd_0_5 nl_0_5 knks_0_5 knks_rel_nl_0_5 ti_1_hom_0_5 ti_2_hom_0_5 ti_2_s_0_5 ti_1_s_0_5 /end OUT_MEASUREMENT
/end FUNCTION
/begin FUNCTION SYS_NOx_Sensor_Interface "_NOx-Sensor Interface"
 /begin DEF_CHARACTERISTIC c_t_nox_sens_nox_hld c_t_nox_sens_nox_auth c_t_nox_sens_nox_mdl c_crlc_nox_nox_sens c_crlc_nox_nox_sens_diag c_t_nox_sens_lamb_hld c_t_nox_sens_vls_hld c_t_nox_sens_pwr_hld lc_nox_sens_nox_man_1 lc_nox_sens_nox_man_2 c_nox_nox_sens_1 c_nox_nox_sens_2 lc_nox_sens_nox_vld_1 lc_nox_sens_nox_vld_2 lc_nox_sens_lamb_man_1 lc_nox_sens_lamb_man_2 c_lamb_nox_sens_1 c_lamb_nox_sens_2 lc_nox_sens_lamb_vld_1 lc_nox_sens_lamb_vld_2 lc_nox_sens_vls_man_1 lc_nox_sens_vls_man_2 c_vls_nox_sens_1 c_vls_nox_sens_2 lc_nox_sens_vls_vld_1 lc_nox_sens_vls_vld_2 lc_nox_sens_err_man_1 lc_nox_sens_err_man_2 c_err_nox_sens_1 c_err_nox_sens_2 c_t_nox_sens_lamb_auth c_t_nox_sens_vls_auth /end DEF_CHARACTERISTIC
 /begin OUT_MEASUREMENT vls_nox_sens_1 vls_nox_sens_2 nox_nox_sens_diag_1 nox_nox_sens_diag_2 lv_nox_sens_nox_diag_vld_1 lv_nox_sens_nox_diag_vld_2 nox_nox_sens_1 nox_nox_sens_2 lv_nox_sens_nox_vld_1 lv_nox_sens_nox_vld_2 lv_nox_sens_nox_auth_1 lv_nox_sens_nox_auth_2 t_nox_sens_nox_hld_1 t_nox_sens_nox_hld_2 lv_nox_sens_nox_mdl_vld_1 lv_nox_sens_nox_mdl_vld_2 t_nox_sens_nox_mdl_1 t_nox_sens_nox_mdl_2 lamb_nox_sens_diag_1 lamb_nox_sens_diag_2 lv_nox_sens_lamb_diag_vld_1 lv_nox_sens_lamb_diag_vld_2 lamb_nox_sens_1 lamb_nox_sens_2 lv_nox_sens_lamb_vld_1 lv_nox_sens_lamb_vld_2 t_nox_sens_lamb_hld_1 t_nox_sens_lamb_hld_2 vls_nox_sens_diag_1 vls_nox_sens_diag_2 lv_nox_sens_vls_diag_vld_1 lv_nox_sens_vls_diag_vld_2 lv_nox_sens_vls_vld_1 lv_nox_sens_vls_vld_2 t_nox_sens_vls_hld_1 t_nox_sens_vls_hld_2 err_nox_sens_1 err_nox_sens_2 t_nox_sens_pwr_1 t_nox_sens_pwr_2 nox_sens_temp_1 nox_sens_temp_2 lv_nox_sens_lamb_auth_2 lv_nox_sens_lamb_auth_1 lv_nox_sens_vls_auth_1 lv_nox_sens_vls_auth_2 /end OUT_MEASUREMENT
/end FUNCTION
/begin FUNCTION SYS_Application_Incidences_NOx_Sensor_Interface "_Application Incidences NOx-Sensor Interface" /begin DEF_CHARACTERISTIC lc_nox_sens_2 c_nox_sens_cycnr_max /end DEF_CHARACTERISTIC
 /begin OUT_MEASUREMENT can_nox_nox_sens_2 can_lamb_nox_sens_1 can_lamb_nox_sens_2 can_err_nox_sens_1 can_err_nox_sens_2 can_vls_nox_sens_1 can_vls_nox_sens_2 can_state_nox_sens_1 can_state_nox_sens_2 can_nox_nox_sens_1 lv_can_temp_min_thd_1 lv_can_temp_min_thd_2 /end OUT_MEASUREMENT
/end FUNCTION
/begin FUNCTION SYS_BN2000_interface_torque_distribution "_BN2000 interface torque distribution"
 /begin DEF_CHARACTERISTIC c_thd_t_tq_dcc_cs c_crlc_tq_dcc_cs_dec c_crlc_tq_dcc_cs_inc lc_ena_tq_dcc_cs ip_tq_dcc_cs ldp_n_tq_dcc_cs /end DEF_CHARACTERISTIC
 /begin OUT_MEASUREMENT tq_amt_fast_dec_bn tq_amt_slow_dec_bn tq_amt_fast_inc_bn tq_amt_slow_inc_bn tq_dcc_fast_inc_bn tq_dcc_slow_inc_bn tq_gs_fast_dec_bn tq_gs_fast_inc_bn tq_gs_slow_dec_bn tq_gs_slow_inc_bn tq_msr_fast_inc_bn tq_msr_slow_inc_bn tq_asr_fast_dec_bn tq_asr_slow_dec_bn t_tq_dcc_cs lv_err_sym_tq_dcc_cs tq_wheel_ldm_inc_dec_bn /end OUT_MEASUREMENT
/end FUNCTION
/end MODULE
/end PROJECT
