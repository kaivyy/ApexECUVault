ASAP2_VERSION 1 31
/begin PROJECT MS45 "BMW Motorsteuerung R6"
/begin HEADER "_default_HeaderComment" PROJECT_NO _57 /end HEADER
/begin MODULE _default_ModuleName "_default_ModuleLongIdentifier"
/begin MOD_COMMON "_default_ModCommonComment" DEPOSIT ABSOLUTE BYTE_ORDER MSB_FIRST ALIGNMENT_BYTE 1 ALIGNMENT_WORD 2 ALIGNMENT_LONG 4 ALIGNMENT_FLOAT32_IEEE 4 ALIGNMENT_FLOAT64_IEEE 8 /end MOD_COMMON
/begin MEASUREMENT ctl_acin_eng_typ "special function for air conditioning control - not used with engine type M54" UBYTE _CNV_A_R_LINEAR_____0_CM 1 100. 0. 3. DISPLAY_IDENTIFIER CTL_ACIN_ENG_TYP ECU_ADDRESS 0x3fe0d2 FORMAT "%1.0" /end MEASUREMENT
/begin MEASUREMENT state_swi_off_vb "state switch off battery voltage (kl30)" UBYTE _CNV_A_R_LINEAR_____0_CM 1 100. 0. 3. DISPLAY_IDENTIFIER STATE_SWI_OFF_VB ECU_ADDRESS 0x3fe0d7 FORMAT "%1.0" /end MEASUREMENT
/begin MEASUREMENT cks_can_tq_dcc "Checksum TQ_DCC from CAN" UBYTE _CNV_A_R_LINEAR_____0_CM 1 100. 0. 255. DISPLAY_IDENTIFIER CKS_CAN_TQ_DCC ECU_ADDRESS 0x3fe0ae FORMAT "%3.0" /end MEASUREMENT
/begin MEASUREMENT cks_can_tq_tcs "checksum traction control system TQ_TCS from CAN" UBYTE _CNV_A_R_LINEAR_____0_CM 1 100. 0. 255. DISPLAY_IDENTIFIER CKS_CAN_TQ_TCS ECU_ADDRESS 0x3fe0c2 FORMAT "%3.0" /end MEASUREMENT
/begin MEASUREMENT cks_can_tq_etcu "check sum TQ_ETCU from CAN" UBYTE _CNV_A_R_LINEAR_____0_CM 1 100. 0. 255. DISPLAY_IDENTIFIER CKS_CAN_TQ_ETCU ECU_ADDRESS 0x3fe0c6 FORMAT "%3.0" /end MEASUREMENT
/begin MEASUREMENT cks_can_tq_amt "check sum TQ_AMT from CAN" UBYTE _CNV_A_R_LINEAR_____0_CM 1 100. 0. 255. DISPLAY_IDENTIFIER CKS_CAN_TQ_AMT ECU_ADDRESS 0x3fe0ca FORMAT "%3.0" /end MEASUREMENT
/begin MEASUREMENT cks_can_msw "checksum MSW - SZL" UBYTE _CNV_A_R_LINEAR_____0_CM 1 100. 0. 255. DISPLAY_IDENTIFIER CKS_CAN_MSW ECU_ADDRESS 0x3fe0ce FORMAT "%3.0" /end MEASUREMENT
/begin MEASUREMENT cks_can_cas "check sum CAS from CAN" UBYTE _CNV_A_R_LINEAR_____0_CM 1 100. 0. 255. DISPLAY_IDENTIFIER CKS_CAN_CAS ECU_ADDRESS 0x3fe0b9 FORMAT "%3.0" /end MEASUREMENT
/begin MEASUREMENT cks_clc_cas "check sum CAS" UBYTE _CNV_A_R_LINEAR_____0_CM 1 100. 0. 255. DISPLAY_IDENTIFIER CKS_CLC_CAS ECU_ADDRESS 0x3fe0ba FORMAT "%3.0" /end MEASUREMENT
/begin MEASUREMENT cks_clc_tq_dcc "check sum TQ_DCC" UBYTE _CNV_A_R_LINEAR_____0_CM 1 100. 0. 255. DISPLAY_IDENTIFIER CKS_CLC_TQ_DCC ECU_ADDRESS 0x3fe0af FORMAT "%3.0" /end MEASUREMENT
/begin MEASUREMENT cks_clc_tq_tcs "check sum TQ_TCS" UBYTE _CNV_A_R_LINEAR_____0_CM 1 100. 0. 255. DISPLAY_IDENTIFIER CKS_CLC_TQ_TCS ECU_ADDRESS 0x3fe0c3 FORMAT "%3.0" /end MEASUREMENT
/begin MEASUREMENT cks_clc_tq_etcu "check sum TQ_ETCU" UBYTE _CNV_A_R_LINEAR_____0_CM 1 100. 0. 255. DISPLAY_IDENTIFIER CKS_CLC_TQ_ETCU ECU_ADDRESS 0x3fe0c7 FORMAT "%3.0" /end MEASUREMENT
/begin MEASUREMENT cks_clc_tq_amt "check sum TQ_AMT" UBYTE _CNV_A_R_LINEAR_____0_CM 1 100. 0. 255. DISPLAY_IDENTIFIER CKS_CLC_TQ_AMT ECU_ADDRESS 0x3fe0cb FORMAT "%3.0" /end MEASUREMENT
/begin MEASUREMENT cks_clc_msw "check sum CRU (SZL)" UBYTE _CNV_A_R_LINEAR_____0_CM 1 100. 0. 255. DISPLAY_IDENTIFIER CKS_CLC_MSW ECU_ADDRESS 0x3fe0cf FORMAT "%3.0" /end MEASUREMENT
/begin MEASUREMENT cks_clc_ecu1 "check sum ECU 1" UBYTE _CNV_A_R_LINEAR_____0_CM 1 100. 0. 255. DISPLAY_IDENTIFIER CKS_CLC_ECU1 ECU_ADDRESS 0x3fe0dd FORMAT "%3.0" /end MEASUREMENT
/begin MEASUREMENT cks_clc_ecu2 "check sum ECU 2" UBYTE _CNV_A_R_LINEAR_____0_CM 1 100. 0. 255. DISPLAY_IDENTIFIER CKS_CLC_ECU2 ECU_ADDRESS 0x3fe0de FORMAT "%3.0" /end MEASUREMENT
/begin MEASUREMENT cks_clc_ecu3 "check sum ECU 3" UBYTE _CNV_A_R_LINEAR_____0_CM 1 100. 0. 255. DISPLAY_IDENTIFIER CKS_CLC_ECU3 ECU_ADDRESS 0x3fe0df FORMAT "%3.0" /end MEASUREMENT
/begin MEASUREMENT cks_can_veh_mod "check sum VEH_MOD from CAN" UBYTE _CNV_A_R_LINEAR_____0_CM 1 100. 0. 255. DISPLAY_IDENTIFIER CKS_CAN_VEH_MOD ECU_ADDRESS 0x3fe0bd FORMAT "%3.0" /end MEASUREMENT
/begin MEASUREMENT cks_can_tq_pste_2 "Checksum TQ_PSTE_2 from CAN" UBYTE _CNV_A_R_LINEAR_____0_CM 1 100. 0. 255. DISPLAY_IDENTIFIER CKS_CAN_TQ_PSTE_2 ECU_ADDRESS 0x3fe0b2 FORMAT "%3.0" /end MEASUREMENT
/begin MEASUREMENT cks_clc_tq_pste_2 "check sum TQ_PSTE_2" UBYTE _CNV_A_R_LINEAR_____0_CM 1 100. 0. 255. DISPLAY_IDENTIFIER CKS_CLC_TQ_PSTE_2 ECU_ADDRESS 0x3fe0b3 FORMAT "%3.0" /end MEASUREMENT
/begin MEASUREMENT tq_amt_fast_dec_bn "fast torque decreased intervention due to AMT" SWORD _CNV_A_R_LINEAR_____55_CM 1 100. -1024. 1023.96875 DISPLAY_IDENTIFIER TQ_AMT_FAST_DEC_BN ECU_ADDRESS 0x3fd0f4 BYTE_ORDER MSB_LAST FORMAT "%8.2" /end MEASUREMENT
/begin MEASUREMENT tq_amt_slow_dec_bn "slow torque decreased intervention due to AMT" SWORD _CNV_A_R_LINEAR_____55_CM 1 100. -1024. 1023.96875 DISPLAY_IDENTIFIER TQ_AMT_SLOW_DEC_BN ECU_ADDRESS 0x3fd0f6 BYTE_ORDER MSB_LAST FORMAT "%8.2" /end MEASUREMENT
/begin MEASUREMENT tq_amt_fast_inc_bn "fast torque increased intervention due to AMT" SWORD _CNV_A_R_LINEAR_____55_CM 1 100. -1024. 1023.96875 DISPLAY_IDENTIFIER TQ_AMT_FAST_INC_BN ECU_ADDRESS 0x3fd0f0 BYTE_ORDER MSB_LAST FORMAT "%8.2" /end MEASUREMENT
/begin MEASUREMENT tq_amt_slow_inc_bn "slow torque increased intervention due to AMT" SWORD _CNV_A_R_LINEAR_____55_CM 1 100. -1024. 1023.96875 DISPLAY_IDENTIFIER TQ_AMT_SLOW_INC_BN ECU_ADDRESS 0x3fd0f2 BYTE_ORDER MSB_LAST FORMAT "%8.2" /end MEASUREMENT
/begin MEASUREMENT tq_dcc_fast_inc_bn "fast torque increased intervention due to DCC" SWORD _CNV_A_R_LINEAR_____55_CM 1 100. -1024. 1023.96875 DISPLAY_IDENTIFIER TQ_DCC_FAST_INC_BN ECU_ADDRESS 0x3fd0f8 BYTE_ORDER MSB_LAST FORMAT "%8.2" /end MEASUREMENT
/begin MEASUREMENT tq_dcc_slow_inc_bn "slow torque increased intervention due to DCC" SWORD _CNV_A_R_LINEAR_____55_CM 1 100. -1024. 1023.96875 DISPLAY_IDENTIFIER TQ_DCC_SLOW_INC_BN ECU_ADDRESS 0x3fd0fa BYTE_ORDER MSB_LAST FORMAT "%8.2" /end MEASUREMENT
/begin MEASUREMENT tq_gs_fast_dec_bn "fast torque decreased intervention due to GS" SWORD _CNV_A_R_LINEAR_____55_CM 1 100. -1024. 1023.96875 DISPLAY_IDENTIFIER TQ_GS_FAST_DEC_BN ECU_ADDRESS 0x3fd0ec BYTE_ORDER MSB_LAST FORMAT "%8.2" /end MEASUREMENT
/begin MEASUREMENT tq_gs_fast_inc_bn "fast torque increased intervention due to GS" SWORD _CNV_A_R_LINEAR_____55_CM 1 100. -1024. 1023.96875 DISPLAY_IDENTIFIER TQ_GS_FAST_INC_BN ECU_ADDRESS 0x3fd0e8 BYTE_ORDER MSB_LAST FORMAT "%8.2" /end MEASUREMENT
/begin MEASUREMENT tq_gs_slow_dec_bn "slow torque decreased intervention due to GS" SWORD _CNV_A_R_LINEAR_____55_CM 1 100. -1024. 1023.96875 DISPLAY_IDENTIFIER TQ_GS_SLOW_DEC_BN ECU_ADDRESS 0x3fd0ee BYTE_ORDER MSB_LAST FORMAT "%8.2" /end MEASUREMENT
/begin MEASUREMENT tq_gs_slow_inc_bn "slow torque increased intervention due to GS" SWORD _CNV_A_R_LINEAR_____55_CM 1 100. -1024. 1023.96875 DISPLAY_IDENTIFIER TQ_GS_SLOW_INC_BN ECU_ADDRESS 0x3fd0ea BYTE_ORDER MSB_LAST FORMAT "%8.2" /end MEASUREMENT
/begin MEASUREMENT tq_msr_fast_inc_bn "fast torque increased intervention due to TCS" SWORD _CNV_A_R_LINEAR_____55_CM 1 100. -1024. 1023.96875 DISPLAY_IDENTIFIER TQ_MSR_FAST_INC_BN ECU_ADDRESS 0x3fd0fc BYTE_ORDER MSB_LAST FORMAT "%8.2" /end MEASUREMENT
/begin MEASUREMENT tq_msr_slow_inc_bn "slow torque increased intervention due to TCS" SWORD _CNV_A_R_LINEAR_____55_CM 1 100. -1024. 1023.96875 DISPLAY_IDENTIFIER TQ_MSR_SLOW_INC_BN ECU_ADDRESS 0x3fd0fe BYTE_ORDER MSB_LAST FORMAT "%8.2" /end MEASUREMENT
/begin MEASUREMENT tq_asr_fast_dec_bn "fast torque decreased intervention due to TCS" SWORD _CNV_A_R_LINEAR_____55_CM 1 100. -1024. 1023.96875 DISPLAY_IDENTIFIER TQ_ASR_FAST_DEC_BN ECU_ADDRESS 0x3fd100 BYTE_ORDER MSB_LAST FORMAT "%8.2" /end MEASUREMENT
/begin MEASUREMENT tq_asr_slow_dec_bn "slow torque decreased intervention due to TCS" SWORD _CNV_A_R_LINEAR_____55_CM 1 100. -1024. 1023.96875 DISPLAY_IDENTIFIER TQ_ASR_SLOW_DEC_BN ECU_ADDRESS 0x3fd102 BYTE_ORDER MSB_LAST FORMAT "%8.2" /end MEASUREMENT
/begin MEASUREMENT can_nox_nox_sens_2 "NOx concentration value, measured by NOx-Sensor" UWORD _CNV_A_R_LINEAR_____104_CM 1 100. 0. 1500. DISPLAY_IDENTIFIER CAN_NOX_NOX_SENS_2 ECU_ADDRESS 0x3fd13a BYTE_ORDER MSB_LAST FORMAT "%4.0" /end MEASUREMENT
/begin MEASUREMENT can_lamb_nox_sens_1 "Lambda value as measured by NOx-Sensor" UWORD _CNV_A_R_LINEAR_____0_CM 1 100. 0. 1540. DISPLAY_IDENTIFIER CAN_LAMB_NOX_SENS_1 ECU_ADDRESS 0x3fd136 BYTE_ORDER MSB_LAST FORMAT "%4.0" /end MEASUREMENT
/begin MEASUREMENT can_lamb_nox_sens_2 "Lambda value as measured by NOx-Sensor" UWORD _CNV_A_R_LINEAR_____0_CM 1 100. 0. 1540. DISPLAY_IDENTIFIER CAN_LAMB_NOX_SENS_2 ECU_ADDRESS 0x3fd13c BYTE_ORDER MSB_LAST FORMAT "%4.0" /end MEASUREMENT
/begin MEASUREMENT can_err_nox_sens_1 "NOx-Sensor error byte" UBYTE _CNV_A_R_LINEAR_____0_CM 1 100. 0. 255. DISPLAY_IDENTIFIER CAN_ERR_NOX_SENS_1 ECU_ADDRESS 0x3fe348 FORMAT "%3.0" /end MEASUREMENT
/begin MEASUREMENT can_err_nox_sens_2 "NOx-Sensor error byte" UBYTE _CNV_A_R_LINEAR_____0_CM 1 100. 0. 255. DISPLAY_IDENTIFIER CAN_ERR_NOX_SENS_2 ECU_ADDRESS 0x3fe34a FORMAT "%3.0" /end MEASUREMENT
/begin MEASUREMENT can_vls_nox_sens_1 "Binary O2 signal voltage, raw value, measured by NOx-Sensor" UWORD _CNV_A_R_LINEAR_____105_CM 1 100. -200. 1200. DISPLAY_IDENTIFIER CAN_VLS_NOX_SENS_1 ECU_ADDRESS 0x3fd138 BYTE_ORDER MSB_LAST FORMAT "%4.0" /end MEASUREMENT
/begin MEASUREMENT can_vls_nox_sens_2 "Binary O2 signal voltage, raw value, measured by NOx-Sensor" UWORD _CNV_A_R_LINEAR_____105_CM 1 100. -200. 1200. DISPLAY_IDENTIFIER CAN_VLS_NOX_SENS_2 ECU_ADDRESS 0x3fd13e BYTE_ORDER MSB_LAST FORMAT "%4.0" /end MEASUREMENT
/begin MEASUREMENT can_state_nox_sens_1 "NOx-Sensor status byte" UBYTE _CNV_A_R_LINEAR_____0_CM 1 100. 0. 255. DISPLAY_IDENTIFIER CAN_STATE_NOX_SENS_1 ECU_ADDRESS 0x3fe347 FORMAT "%3.0" /end MEASUREMENT
/begin MEASUREMENT can_state_nox_sens_2 "NOx-Sensor status byte" UBYTE _CNV_A_R_LINEAR_____0_CM 1 100. 0. 255. DISPLAY_IDENTIFIER CAN_STATE_NOX_SENS_2 ECU_ADDRESS 0x3fe349 FORMAT "%3.0" /end MEASUREMENT
/begin MEASUREMENT can_nox_nox_sens_1 "NOx concentration value, measured by NOx-Sensor" UWORD _CNV_A_R_LINEAR_____104_CM 1 100. 0. 1500. DISPLAY_IDENTIFIER CAN_NOX_NOX_SENS_1 ECU_ADDRESS 0x3fd134 BYTE_ORDER MSB_LAST FORMAT "%4.0" /end MEASUREMENT
/begin MEASUREMENT n_dyw_cp "N average value for dynamic window" UWORD _CNV_A_R_LINEAR_____10_CM 1 100. 0. 8160. DISPLAY_IDENTIFIER N_DYW_CP ECU_ADDRESS 0x3fd14c BYTE_ORDER MSB_LAST FORMAT "%4.0" /end MEASUREMENT
/begin MEASUREMENT maf_dyw_cp "MAF  average value for dynamic window" UWORD _CNV_A_R_LINEAR_____108_CM 1 100. 0. 1389. DISPLAY_IDENTIFIER MAF_DYW_CP ECU_ADDRESS 0x3fd14e BYTE_ORDER MSB_LAST FORMAT "%7.2" /end MEASUREMENT
/begin MEASUREMENT cdn_state_cp "Activation conditions for evaporative emission control function" UBYTE _CNV_S_6_RANGE_CDN__109_CM 1 100. 0. 5. DISPLAY_IDENTIFIER CDN_STATE_CP ECU_ADDRESS 0x3fe379 /end MEASUREMENT
/begin MEASUREMENT lv_cp_act_req "Request to inhib Catalyst and  O2 sensor diagnosis for allowing purge canister activation" UBYTE _CNV_S_2_RANGE______21_CM 1 100. 0. 1. DISPLAY_IDENTIFIER LV_CP_ACT_REQ ECU_ADDRESS 0x3fe37c BIT_MASK 0x1 /end MEASUREMENT
/begin MEASUREMENT lv_pu_cp "Flag to interrupt the purge in PU mode" UBYTE _CNV_S_2_RANGE______21_CM 1 100. 0. 1. DISPLAY_IDENTIFIER LV_PU_CP ECU_ADDRESS 0x3fe37d BIT_MASK 0x1 /end MEASUREMENT
/begin MEASUREMENT prs_cps "Pressure difference at CPS" SWORD _CNV_A_R_LINEAR_____110_CM 1 100. -2717.04 2716.96 DISPLAY_IDENTIFIER PRS_CPS ECU_ADDRESS 0x3fd148 BYTE_ORDER MSB_LAST FORMAT "%8.2" /end MEASUREMENT
/begin CHARACTERISTIC c_t_dly_pu_cps "" VALUE 0xffe41926 _REC_VAL_20_u2 6553.400000000001 _CNV_A_R_LINEAR_____24_CM 0.1 6553.5 DISPLAY_IDENTIFIER C_T_DLY_PU_CPS FORMAT "%6.1" /end CHARACTERISTIC
/begin CHARACTERISTIC c_prs_max_cps "" VALUE 0xffe40492 _REC_VAL_20_s2 5434. _CNV_A_R_LINEAR_____110_CM -2717.04 2716.96 DISPLAY_IDENTIFIER C_PRS_MAX_CPS FORMAT "%8.2" /end CHARACTERISTIC
/begin CHARACTERISTIC c_n_cp_tol "" VALUE 0xffe407d6 _REC_VAL_20_u1 8160. _CNV_A_R_LINEAR_____15_CM 0. 8160. DISPLAY_IDENTIFIER C_N_CP_TOL FORMAT "%4.0" /end CHARACTERISTIC
/begin CHARACTERISTIC c_maf_cp_bol "" VALUE 0xffe4078d _REC_VAL_20_u1 1389. _CNV_A_R_LINEAR_____27_CM 0. 1389. DISPLAY_IDENTIFIER C_MAF_CP_BOL FORMAT "%4.0" /end CHARACTERISTIC
/begin CHARACTERISTIC c_maf_cp_tol "" VALUE 0xffe4078e _REC_VAL_20_u1 1389. _CNV_A_R_LINEAR_____27_CM 0. 1389. DISPLAY_IDENTIFIER C_MAF_CP_TOL FORMAT "%4.0" /end CHARACTERISTIC
/begin CHARACTERISTIC c_t_lam_lim_cp "" VALUE 0xffe4197e _REC_VAL_20_u2 6553.5 _CNV_A_R_LINEAR_____24_CM 0. 6553.5 DISPLAY_IDENTIFIER C_T_LAM_LIM_CP FORMAT "%5.1" /end CHARACTERISTIC
/begin CHARACTERISTIC c_cl_mmv_req "" VALUE 0xffe4152c _REC_VAL_20_u2 1.99996948 _CNV_A_R_LINEAR_____20_CM 0. 1.99996948 DISPLAY_IDENTIFIER C_CL_MMV_REQ FORMAT "%7.5" /end CHARACTERISTIC
/begin CHARACTERISTIC c_t_lam_cp_dly "" VALUE 0xffe4197c _REC_VAL_20_u2 65534. _CNV_A_R_LINEAR_____30_CM 1. 65535. DISPLAY_IDENTIFIER C_T_LAM_CP_DLY FORMAT "%5.0" /end CHARACTERISTIC
/begin CHARACTERISTIC c_lam_cp_bol "" VALUE 0xffe4041c _REC_VAL_20_s2 99.99847412 _CNV_A_R_LINEAR_____111_CM -50. 49.99847412 DISPLAY_IDENTIFIER C_LAM_CP_BOL FORMAT "%5.4" /end CHARACTERISTIC
/begin CHARACTERISTIC c_lam_cp_tol "" VALUE 0xffe4041e _REC_VAL_20_s2 99.99847412 _CNV_A_R_LINEAR_____111_CM -50. 49.99847412 DISPLAY_IDENTIFIER C_LAM_CP_TOL FORMAT "%5.4" /end CHARACTERISTIC
/begin CHARACTERISTIC c_dly_n_maf_dyw_cp "" VALUE 0xffe415c0 _REC_VAL_20_u2 655.35 _CNV_A_R_LINEAR_____4_CM 0. 655.35 DISPLAY_IDENTIFIER C_DLY_N_MAF_DYW_CP FORMAT "%5.2" /end CHARACTERISTIC
/begin CHARACTERISTIC c_maf_dyw_cp "" VALUE 0xffe41740 _REC_VAL_20_u2 1389. _CNV_A_R_LINEAR_____108_CM 0. 1389. DISPLAY_IDENTIFIER C_MAF_DYW_CP FORMAT "%7.2" /end CHARACTERISTIC
/begin CHARACTERISTIC c_n_dyw_cp "" VALUE 0xffe417fe _REC_VAL_20_u2 8159. _CNV_A_R_LINEAR_____10_CM 1. 8160. DISPLAY_IDENTIFIER C_N_DYW_CP FORMAT "%4.0" /end CHARACTERISTIC
/begin CHARACTERISTIC c_tco_min_cp "" VALUE 0xffe4090e _REC_VAL_20_u1 28.575 _CNV_A_R_LINEAR_____11_CM -48. 142.5 DISPLAY_IDENTIFIER C_TCO_MIN_CP FORMAT "%5.1" /end CHARACTERISTIC
/begin MEASUREMENT lv_n_max_cp "Canister purge inhibition by engine speed limitation" UBYTE _CNV_S_2_RANGE______2_CM 1 100. 0. 1. DISPLAY_IDENTIFIER LV_N_MAX_CP ECU_ADDRESS 0x3fe37e BIT_MASK 0x1 /end MEASUREMENT
/begin MEASUREMENT lv_n_maf_dyw_cp "Dynamic windows on engine speed and maf" UBYTE _CNV_S_2_RANGE______2_CM 1 100. 0. 1. DISPLAY_IDENTIFIER LV_N_MAF_DYW_CP ECU_ADDRESS 0x3fe37b BIT_MASK 0x1 /end MEASUREMENT
/begin CHARACTERISTIC c_n_cp_bol "" VALUE 0xffe407d5 _REC_VAL_20_u1 8160. _CNV_A_R_LINEAR_____15_CM 0. 8160. DISPLAY_IDENTIFIER C_N_CP_BOL FORMAT "%4.0" /end CHARACTERISTIC
/begin CHARACTERISTIC c_n_max_cp "" VALUE 0xffe41812 _REC_VAL_20_u2 8160. _CNV_A_R_LINEAR_____10_CM 0. 8160. DISPLAY_IDENTIFIER C_N_MAX_CP FORMAT "%4.0" /end CHARACTERISTIC
/begin CHARACTERISTIC c_n_hys_max_cp "" VALUE 0xffe41804 _REC_VAL_20_u2 8160. _CNV_A_R_LINEAR_____10_CM 0. 8160. DISPLAY_IDENTIFIER C_N_HYS_MAX_CP FORMAT "%4.0" /end CHARACTERISTIC
/begin MEASUREMENT lv_cp_act "Logical value for EVAP-Control active" UBYTE _CNV_S_2_RANGE______21_CM 1 100. 0. 1. DISPLAY_IDENTIFIER LV_CP_ACT ECU_ADDRESS 0x3fe37a BIT_MASK 0x1 /end MEASUREMENT
/begin MEASUREMENT lv_lam_out_cp "" UBYTE _CNV_S_2_RANGE______21_CM 1 100. 0. 1. DISPLAY_IDENTIFIER LV_LAM_OUT_CP ECU_ADDRESS 0x3fe381 BIT_MASK 0x1 /end MEASUREMENT
/begin MEASUREMENT lv_lam_lim_cp "" UBYTE _CNV_S_2_RANGE______21_CM 1 100. 0. 1. DISPLAY_IDENTIFIER LV_LAM_LIM_CP ECU_ADDRESS 0x3fe380 BIT_MASK 0x1 /end MEASUREMENT
/begin MEASUREMENT lv_win_cp "" UBYTE _CNV_S_2_RANGE______21_CM 1 100. 0. 1. DISPLAY_IDENTIFIER LV_WIN_CP ECU_ADDRESS 0x3fe383 BIT_MASK 0x1 /end MEASUREMENT
/begin CHARACTERISTIC c_tia_min_cp "" VALUE 0xffe40963 _REC_VAL_20_u1 190.5 _CNV_A_R_LINEAR_____11_CM -48. 142.5 DISPLAY_IDENTIFIER C_TIA_MIN_CP FORMAT "%5.1" /end CHARACTERISTIC
/begin CHARACTERISTIC c_state_win_cp_not "" VALUE 0xffe40845 _REC_VAL_20_u1 2. _CNV_S_3_RANGE_C_ST_112_CM 0. 2. DISPLAY_IDENTIFIER C_STATE_WIN_CP_NOT /end CHARACTERISTIC
/begin MEASUREMENT lv_etcu_disable "Logical variable for disabling GS intervention due to EMS error" UBYTE _CNV_S_2_RANGE______2_CM 1 100. 0. 1. DISPLAY_IDENTIFIER LV_ETCU_DISABLE ECU_ADDRESS 0x3feace /end MEASUREMENT
/begin MEASUREMENT lv_etcu_disable_can "logical variable for disabling GS intervention due to CAN error" UBYTE _CNV_S_2_RANGE______2_CM 1 100. 0. 1. DISPLAY_IDENTIFIER LV_ETCU_DISABLE_CAN ECU_ADDRESS 0x3feacf BIT_MASK 0x1 /end MEASUREMENT
/begin MEASUREMENT lv_gs_ena_dec "logical variable for decreased torque intervention due to gear shift" UBYTE _CNV_S_2_RANGE______2_CM 1 100. 0. 1. DISPLAY_IDENTIFIER LV_GS_ENA_DEC ECU_ADDRESS 0x3fead0 BIT_MASK 0x1 /end MEASUREMENT
/begin MEASUREMENT lv_gs_ena "Logical variable for GS intervention enabling" UBYTE _CNV_S_2_RANGE______2_CM 1 100. 0. 1. DISPLAY_IDENTIFIER LV_GS_ENA ECU_ADDRESS 0x3fead7 BIT_MASK 0x1 /end MEASUREMENT
/begin CHARACTERISTIC c_t_max_tqr_gs_intv "Maximum duration of torque reduction due gear shift intervention" VALUE 0xffe419aa _REC_VAL_20_u2 655.35 _CNV_A_R_LINEAR_____4_CM 0. 655.35 DISPLAY_IDENTIFIER C_T_MAX_TQR_GS_INTV FORMAT "%6.2" /end CHARACTERISTIC
/begin MEASUREMENT tqi_gs_fast_dec_req_1 "Torque decrement for fast torque intervention during gear shift" SWORD _CNV_A_R_LINEAR_____55_CM 1 100. -1024. 1023.96875 DISPLAY_IDENTIFIER TQI_GS_FAST_DEC_REQ_1 ECU_ADDRESS 0x3fdd26 BYTE_ORDER MSB_LAST FORMAT "%8.2" /end MEASUREMENT
/begin MEASUREMENT tqi_gs_slow_dec_req "Torque decrement for slow torque intervention during gear shift" SWORD _CNV_A_R_LINEAR_____55_CM 1 100. -1024. 1023.96875 DISPLAY_IDENTIFIER TQI_GS_SLOW_DEC_REQ ECU_ADDRESS 0x3fdd20 BYTE_ORDER MSB_LAST FORMAT "%8.2" /end MEASUREMENT
/begin MEASUREMENT tqi_gs_fast_inc_req_1 "torque increase for fast torque intervention during gear shift" SWORD _CNV_A_R_LINEAR_____55_CM 1 100. -1024. 1023.96875 DISPLAY_IDENTIFIER TQI_GS_FAST_INC_REQ_1 ECU_ADDRESS 0x3fdd2a BYTE_ORDER MSB_LAST FORMAT "%8.2" /end MEASUREMENT
/begin MEASUREMENT tqi_gs_slow_inc_req "torque increase for slow torque intervention during gear shift" SWORD _CNV_A_R_LINEAR_____55_CM 1 100. -1024. 1023.96875 DISPLAY_IDENTIFIER TQI_GS_SLOW_INC_REQ ECU_ADDRESS 0x3fdd24 BYTE_ORDER MSB_LAST FORMAT "%8.2" /end MEASUREMENT
/begin MEASUREMENT t_tqr_gs_intv "duration of gear shift torque intervention" UWORD _CNV_A_R_LINEAR_____4_CM 1 100. 0. 655.35 DISPLAY_IDENTIFIER T_TQR_GS_INTV ECU_ADDRESS 0x3fdd1c BYTE_ORDER MSB_LAST FORMAT "%6.2" /end MEASUREMENT
/begin MEASUREMENT tqi_gs_fast_dec_req "Torque decrement for fast torque intervention during gear shift" SWORD _CNV_A_R_LINEAR_____55_CM 1 100. -1024. 1023.96875 DISPLAY_IDENTIFIER TQI_GS_FAST_DEC_REQ ECU_ADDRESS 0x3fdd1e BYTE_ORDER MSB_LAST FORMAT "%8.2" /end MEASUREMENT
/begin MEASUREMENT tqi_gs_fast_dec "torque decrement for fast torque intervention during gear shift" SWORD _CNV_A_R_LINEAR_____55_CM 1 100. -1024. 1023.96875 DISPLAY_IDENTIFIER TQI_GS_FAST_DEC ECU_ADDRESS 0x3fdd2e BYTE_ORDER MSB_LAST FORMAT "%8.2" /end MEASUREMENT
/begin MEASUREMENT tqi_gs_slow_dec_req_1 "Torque decrement for slow torque intervention during gear shift" SWORD _CNV_A_R_LINEAR_____55_CM 1 100. -1024. 1023.96875 DISPLAY_IDENTIFIER TQI_GS_SLOW_DEC_REQ_1 ECU_ADDRESS 0x3fdd28 BYTE_ORDER MSB_LAST FORMAT "%8.2" /end MEASUREMENT
/begin MEASUREMENT tqi_gs_slow_dec "Torque decrement for slow torque intervention during gear shift" SWORD _CNV_A_R_LINEAR_____55_CM 1 100. -1024. 1023.96875 DISPLAY_IDENTIFIER TQI_GS_SLOW_DEC ECU_ADDRESS 0x3fdd30 BYTE_ORDER MSB_LAST FORMAT "%8.2" /end MEASUREMENT
/begin MEASUREMENT lv_gs_ena_inc "logical variable for increased torque intervention due to gear shift" UBYTE _CNV_S_2_RANGE______2_CM 1 100. 0. 1. DISPLAY_IDENTIFIER LV_GS_ENA_INC ECU_ADDRESS 0x3fead1 BIT_MASK 0x1 /end MEASUREMENT
/begin MEASUREMENT lv_gs_dec_lih "logical variable for torque intervention LIH due to gear shift" UBYTE _CNV_S_2_RANGE______2_CM 1 100. 0. 1. DISPLAY_IDENTIFIER LV_GS_DEC_LIH ECU_ADDRESS 0x3fead8 /end MEASUREMENT
/begin CHARACTERISTIC c_gs_ena_inc_dec "Enable switch GS intervention" VALUE 0xffe40759 _REC_VAL_20_u1 3. _CNV_S_4_STATE_AMT__201_CM 0. 3. DISPLAY_IDENTIFIER C_GS_ENA_INC_DEC /end CHARACTERISTIC
/begin MEASUREMENT tqi_gs_fast_inc_req "torque increase for fast torque intervention during gear shift" SWORD _CNV_A_R_LINEAR_____55_CM 1 100. -1024. 1023.96875 DISPLAY_IDENTIFIER TQI_GS_FAST_INC_REQ ECU_ADDRESS 0x3fdd22 BYTE_ORDER MSB_LAST FORMAT "%8.2" /end MEASUREMENT
/begin MEASUREMENT tqi_gs_fast_inc "torque increase for fast torque intervention during gear shift" SWORD _CNV_A_R_LINEAR_____55_CM 1 100. -1024. 1023.96875 DISPLAY_IDENTIFIER TQI_GS_FAST_INC ECU_ADDRESS 0x3fdd32 BYTE_ORDER MSB_LAST FORMAT "%8.2" /end MEASUREMENT
/begin MEASUREMENT tqi_gs_slow_inc_req_1 "torque increase for slow torque intervention during gear shift" SWORD _CNV_A_R_LINEAR_____55_CM 1 100. -1024. 1023.96875 DISPLAY_IDENTIFIER TQI_GS_SLOW_INC_REQ_1 ECU_ADDRESS 0x3fdd2c BYTE_ORDER MSB_LAST FORMAT "%8.2" /end MEASUREMENT
/begin MEASUREMENT tqi_gs_slow_inc "torque increase for slow torque intervention during gear shift" SWORD _CNV_A_R_LINEAR_____55_CM 1 100. -1024. 1023.96875 DISPLAY_IDENTIFIER TQI_GS_SLOW_INC ECU_ADDRESS 0x3fdd34 BYTE_ORDER MSB_LAST FORMAT "%8.2" /end MEASUREMENT
/begin MEASUREMENT lv_gs_dec_act "logical variable for torque intervention due to gear shift" UBYTE _CNV_S_2_RANGE______2_CM 1 100. 0. 1. DISPLAY_IDENTIFIER LV_GS_DEC_ACT ECU_ADDRESS 0x3fead2 /end MEASUREMENT
/begin MEASUREMENT lv_gs_inc_lih "logical variable for torque intervention LIH due to gear shift" UBYTE _CNV_S_2_RANGE______2_CM 1 100. 0. 1. DISPLAY_IDENTIFIER LV_GS_INC_LIH ECU_ADDRESS 0x3fead4 /end MEASUREMENT
/begin CHARACTERISTIC c_lgrd_lih_gs_dec "limiting gradient for GS emergency ramp function (default  0.6 Nm/10ms)" VALUE 0xffe41716 _REC_VAL_20_u2 1023.96875 _CNV_A_R_LINEAR_____202_CM 0. 1023.96875 DISPLAY_IDENTIFIER C_LGRD_LIH_GS_DEC FORMAT "%7.2" /end CHARACTERISTIC
/begin CHARACTERISTIC c_lgrd_lih_gs_inc "limiting gradient for GS emergency ramp function (default  0.6 Nm/10ms)" VALUE 0xffe41718 _REC_VAL_20_u2 1023.96875 _CNV_A_R_LINEAR_____202_CM 0. 1023.96875 DISPLAY_IDENTIFIER C_LGRD_LIH_GS_INC FORMAT "%7.2" /end CHARACTERISTIC
/begin CHARACTERISTIC c_t_dly_lih_gs_dec "delay time for activation of GS emergency ramp function (default 0s)" VALUE 0xffe40883 _REC_VAL_20_u1 2.55 _CNV_A_R_LINEAR_____4_CM 0. 2.55 DISPLAY_IDENTIFIER C_T_DLY_LIH_GS_DEC FORMAT "%4.2" /end CHARACTERISTIC
/begin CHARACTERISTIC c_t_dly_lih_gs_inc "delay time for activation of GS emergency ramp function (default 0s)" VALUE 0xffe40884 _REC_VAL_20_u1 2.55 _CNV_A_R_LINEAR_____4_CM 0. 2.55 DISPLAY_IDENTIFIER C_T_DLY_LIH_GS_INC FORMAT "%4.2" /end CHARACTERISTIC
/begin MEASUREMENT lv_gs_inc_act "logical variable for torque intervention due to gear shift" UBYTE _CNV_S_2_RANGE______2_CM 1 100. 0. 1. DISPLAY_IDENTIFIER LV_GS_INC_ACT ECU_ADDRESS 0x3fead3 /end MEASUREMENT
/begin MEASUREMENT t_gs_inc_lih_ctr "delay time for activation of GS emergency ramp function " UBYTE _CNV_A_R_LINEAR_____4_CM 1 100. 0. 2.55 DISPLAY_IDENTIFIER T_GS_INC_LIH_CTR ECU_ADDRESS 0x3fead6 FORMAT "%4.2" /end MEASUREMENT
/begin MEASUREMENT t_gs_dec_lih_ctr "delay time for activation of GS emergency ramp function" UBYTE _CNV_A_R_LINEAR_____4_CM 1 100. 0. 2.55 DISPLAY_IDENTIFIER T_GS_DEC_LIH_CTR ECU_ADDRESS 0x3fead5 FORMAT "%4.2" /end MEASUREMENT
/begin MEASUREMENT lam_bank_1.ls_down_cur.bf.lv_r_down_ls_det "Boolean flag indicating that resistance has already been determined in current lean phase(lock out)" ULONG _CNV_S_2_RANGE______2_CM 1 100. 0. 1. DISPLAY_IDENTIFIER LV_R_DOWN_LS_DET_1 ECU_ADDRESS 0x3fc454 BYTE_ORDER MSB_LAST BIT_MASK 0x10000000 /end MEASUREMENT
/begin MEASUREMENT lam_bank_1.ls_down_cur.bf.lv_r_down_ls_drv1_vls_cdn "Boolean flag indicating that low gradient condition met" ULONG _CNV_S_2_RANGE______2_CM 1 100. 0. 1. DISPLAY_IDENTIFIER LV_R_DOWN_LS_DRV1_VLS_CDN_1 ECU_ADDRESS 0x3fc454 BYTE_ORDER MSB_LAST BIT_MASK 0x80000000 /end MEASUREMENT
/begin MEASUREMENT lam_bank_1.ls_down_cur.bf.lv_r_down_ls_ena "Boolean flag indicating that conditions have been met and resistance determination requested" ULONG _CNV_S_2_RANGE______2_CM 1 100. 0. 1. DISPLAY_IDENTIFIER LV_R_DOWN_LS_ENA_1 ECU_ADDRESS 0x3fc454 BYTE_ORDER MSB_LAST BIT_MASK 0x20000000 /end MEASUREMENT
/begin MEASUREMENT lam_bank_1.ls_down_cur.bf.lv_r_down_ls_vls_rng_cdn "Boolean flag indicating that VLS_DOWN at low gradient condition met" ULONG _CNV_S_2_RANGE______2_CM 1 100. 0. 1. DISPLAY_IDENTIFIER LV_R_DOWN_LS_VLS_RNG_CDN_1 ECU_ADDRESS 0x3fc454 BYTE_ORDER MSB_LAST BIT_MASK 0x40000000 /end MEASUREMENT
/begin MEASUREMENT lam_bank_1.ls_down_cur.bf.lv_vls_not_vld_down "Boolean flag indicating that VLS_DOWN_i signal not valid, i.e. masked due to Ri determination" ULONG _CNV_S_2_RANGE______2_CM 1 100. 0. 1. DISPLAY_IDENTIFIER LV_VLS_NOT_VLD_DOWN_1 ECU_ADDRESS 0x3fc454 BYTE_ORDER MSB_LAST BIT_MASK 0x8000000 /end MEASUREMENT
/begin MEASUREMENT lam_bank_1.ls_down_cur.ctr_cycnr_r_down_ls "Handshake counter indicating the number of valid resistance values determined since initial activation" UWORD _CNV_A_R_LINEAR_____0_CM 1 100. 0. 65535. DISPLAY_IDENTIFIER CTR_CYCNR_R_DOWN_LS_1 ECU_ADDRESS 0x3fc460 BYTE_ORDER MSB_LAST FORMAT "%5.0" /end MEASUREMENT
/begin MEASUREMENT lam_bank_1.ls_down_cur.drv1_vls_down_mmv_thd_max "Upper variable VLS_DOWN gradient threshold" SWORD _CNV_A_R_LINEAR_____297_CM 1 100. -2.5 2.4999 DISPLAY_IDENTIFIER DRV1_VLS_DOWN_MMV_THD_MAX_1 ECU_ADDRESS 0x3fc46e BYTE_ORDER MSB_LAST FORMAT "%7.4" /end MEASUREMENT
/begin MEASUREMENT lam_bank_1.ls_down_cur.drv1_vls_down_mmv_thd_min "Lower variable VLS_DOWN gradient threshold" SWORD _CNV_A_R_LINEAR_____297_CM 1 100. -2.5 2.4999 DISPLAY_IDENTIFIER DRV1_VLS_DOWN_MMV_THD_MIN_1 ECU_ADDRESS 0x3fc470 BYTE_ORDER MSB_LAST FORMAT "%7.4" /end MEASUREMENT
/begin MEASUREMENT lam_bank_1.ls_down_cur.fac_t_drv1_vls_down_abs "Multiplicative factor modifies C_DRV1_VLS_DOWN_ABS_MAX dependent on T_VLS_CYC_AFL_HLD" UBYTE _CNV_A_R_LINEAR_____46_CM 1 100. 0. 15.9375 DISPLAY_IDENTIFIER FAC_T_DRV1_VLS_DOWN_ABS_1 ECU_ADDRESS 0x3fc45c FORMAT "%5.2" /end MEASUREMENT
/begin MEASUREMENT lam_bank_1.ls_down_cur.fac_t_drv1_vls_down_mmv "Multiplicative factor modifies DRV1_VLS_DOWN_MMV_MIN_THD dependent on T_VLS_CYC_AFL_HLD" UBYTE _CNV_A_R_LINEAR_____308_CM 1 100. 0. 63.75 DISPLAY_IDENTIFIER FAC_T_DRV1_VLS_DOWN_MMV_1 ECU_ADDRESS 0x3fc45d FORMAT "%4.1" /end MEASUREMENT
/begin MEASUREMENT lam_bank_1.ls_down_cur.r_down_ls "Internal resistance of downstream oxygen sensor" UWORD _CNV_A_R_LINEAR_____309_CM 1 100. 0. 65535. DISPLAY_IDENTIFIER R_DOWN_LS_1 ECU_ADDRESS 0x3fc462 BYTE_ORDER MSB_LAST FORMAT "%5.0" /end MEASUREMENT
/begin MEASUREMENT lam_bank_1.ls_down_cur.r_down_ls_mes "Internal resistance of downstream oxygen sensor (Measured)" UWORD _CNV_A_R_LINEAR_____309_CM 1 100. 0. 65535. DISPLAY_IDENTIFIER R_DOWN_LS_MES_1 ECU_ADDRESS 0x3fc464 BYTE_ORDER MSB_LAST FORMAT "%5.0" /end MEASUREMENT
/begin MEASUREMENT lam_bank_1.ls_down_cur.t_sample_r_down_ls "Time measured between internal resistance samples" UWORD _CNV_A_R_LINEAR_____4_CM 1 100. 0. 655.35 DISPLAY_IDENTIFIER T_SAMPLE_R_DOWN_LS_1 ECU_ADDRESS 0x3fc46c BYTE_ORDER MSB_LAST FORMAT "%6.2" /end MEASUREMENT
/begin MEASUREMENT lam_bank_1.ls_down_cur.t_vls_cyc_afl_hld_r_down_ls "Lean mixture cycle time (measured upstream), held until next threshold crossing downstream" UBYTE _CNV_A_R_LINEAR_____4_CM 1 100. 0. 2.55 DISPLAY_IDENTIFIER T_VLS_CYC_AFL_HLD_R_DOWN_LS_1 ECU_ADDRESS 0x3fc45e FORMAT "%4.2" /end MEASUREMENT
/begin MEASUREMENT lam_bank_1.ls_down_cur.ttip_ls_down_mes "Downstream oxygen sensor ceramic temperature" SWORD _CNV_A_R_LINEAR_____303_CM 1 100. -2048. 2047.938 DISPLAY_IDENTIFIER TTIP_LS_DOWN_MES_1 ECU_ADDRESS 0x3fc472 BYTE_ORDER MSB_LAST FORMAT "%8.2" /end MEASUREMENT
/begin MEASUREMENT lam_bank_1.ls_down_cur.ttip_ls_down_mes_bol "Downstream oxygen sensor ceramic temperature, Lower limit, Unfiltered" SWORD _CNV_A_R_LINEAR_____303_CM 1 100. -2048. 2047.938 DISPLAY_IDENTIFIER TTIP_LS_DOWN_MES_BOL_1 ECU_ADDRESS 0x3fc476 BYTE_ORDER MSB_LAST FORMAT "%8.2" /end MEASUREMENT
/begin MEASUREMENT lam_bank_1.ls_down_cur.ttip_ls_down_mes_bol_mmv "Downstream oxygen sensor ceramic temperature, Lower limit, Filtered" SWORD _CNV_A_R_LINEAR_____303_CM 1 100. -2048. 2047.938 DISPLAY_IDENTIFIER TTIP_LS_DOWN_MES_BOL_MMV_1 ECU_ADDRESS 0x3fc47c BYTE_ORDER MSB_LAST FORMAT "%8.2" /end MEASUREMENT
/begin MEASUREMENT lam_bank_1.ls_down_cur.ttip_ls_down_mes_tol "Downstream oxygen sensor ceramic temperature, Upper limit, Unfiltered" SWORD _CNV_A_R_LINEAR_____303_CM 1 100. -2048. 2047.938 DISPLAY_IDENTIFIER TTIP_LS_DOWN_MES_TOL_1 ECU_ADDRESS 0x3fc474 BYTE_ORDER MSB_LAST FORMAT "%8.2" /end MEASUREMENT
/begin MEASUREMENT lam_bank_1.ls_down_cur.ttip_ls_down_mes_tol_mmv "Downstream oxygen sensor ceramic temperature, Upper limit, Filtered" SWORD _CNV_A_R_LINEAR_____303_CM 1 100. -2048. 2047.938 DISPLAY_IDENTIFIER TTIP_LS_DOWN_MES_TOL_MMV_1 ECU_ADDRESS 0x3fc478 BYTE_ORDER MSB_LAST FORMAT "%8.2" /end MEASUREMENT
/begin MEASUREMENT lam_bank_1.ls_down_cur.r_down_ls_mdl_sens_new "Internal resistance of downstream oxygen sensor (Modelled for new sensor)" UWORD _CNV_A_R_LINEAR_____309_CM 1 100. 0. 65535. DISPLAY_IDENTIFIER R_DOWN_LS_MDL_SENS_NEW_1 ECU_ADDRESS 0x3fc468 BYTE_ORDER MSB_LAST FORMAT "%5.0" /end MEASUREMENT
/begin MEASUREMENT lam_bank_1.ls_down_cur.pow_lsh_down_mmv "Moving mean value of downstream oxygen sensor heater power" UWORD _CNV_A_R_LINEAR_____310_CM 1 100. 0. 65.535 DISPLAY_IDENTIFIER POW_LSH_DOWN_MMV_1 ECU_ADDRESS 0x3fc46a BYTE_ORDER MSB_LAST /end MEASUREMENT
/begin MEASUREMENT lam_bank_1.ls_down_cur.ttip_ref_ls_down_mdl_mmv "Reference of downstream oxygen sensor ceramic temperature (Modelled for new sensor)" UWORD _CNV_A_R_LINEAR_____311_CM 1 100. 0. 2047.938 DISPLAY_IDENTIFIER TTIP_REF_LS_DOWN_MDL_MMV_1 ECU_ADDRESS 0x3fc480 BYTE_ORDER MSB_LAST FORMAT "%7.3" /end MEASUREMENT
/begin MEASUREMENT lam_bank_1.ls_temp_up_inci.lv_inh_ttip_ls_up "Boolean flag indicating that upstream oxygen sensor ceramic temperture determination shall be inhibited" UBYTE _CNV_S_2_RANGE______2_CM 1 100. 0. 1. DISPLAY_IDENTIFIER LV_INH_TTIP_LS_UP_1 ECU_ADDRESS 0x3fc694 /end MEASUREMENT
/begin MEASUREMENT lam_bank_2.ls_down_cur.bf.lv_r_down_ls_det "Boolean flag indicating that resistance has already been determined in current lean phase(lock out)" ULONG _CNV_S_2_RANGE______2_CM 1 100. 0. 1. DISPLAY_IDENTIFIER LV_R_DOWN_LS_DET_2 ECU_ADDRESS 0x3fc90c BYTE_ORDER MSB_LAST BIT_MASK 0x10000000 /end MEASUREMENT
/begin MEASUREMENT lam_bank_2.ls_down_cur.bf.lv_r_down_ls_drv1_vls_cdn "Boolean flag indicating that low gradient condition met" ULONG _CNV_S_2_RANGE______2_CM 1 100. 0. 1. DISPLAY_IDENTIFIER LV_R_DOWN_LS_DRV1_VLS_CDN_2 ECU_ADDRESS 0x3fc90c BYTE_ORDER MSB_LAST BIT_MASK 0x80000000 /end MEASUREMENT
/begin MEASUREMENT lam_bank_2.ls_down_cur.bf.lv_r_down_ls_ena "Boolean flag indicating that conditions have been met and resistance determination requested" ULONG _CNV_S_2_RANGE______2_CM 1 100. 0. 1. DISPLAY_IDENTIFIER LV_R_DOWN_LS_ENA_2 ECU_ADDRESS 0x3fc90c BYTE_ORDER MSB_LAST BIT_MASK 0x20000000 /end MEASUREMENT
/begin MEASUREMENT lam_bank_2.ls_down_cur.bf.lv_r_down_ls_vls_rng_cdn "Boolean flag indicating that VLS_DOWN at low gradient condition met" ULONG _CNV_S_2_RANGE______2_CM 1 100. 0. 1. DISPLAY_IDENTIFIER LV_R_DOWN_LS_VLS_RNG_CDN_2 ECU_ADDRESS 0x3fc90c BYTE_ORDER MSB_LAST BIT_MASK 0x40000000 /end MEASUREMENT
/begin MEASUREMENT lam_bank_2.ls_down_cur.bf.lv_vls_not_vld_down "Boolean flag indicating that VLS_DOWN_i signal not valid, i.e. masked due to Ri determination" ULONG _CNV_S_2_RANGE______2_CM 1 100. 0. 1. DISPLAY_IDENTIFIER LV_VLS_NOT_VLD_DOWN_2 ECU_ADDRESS 0x3fc90c BYTE_ORDER MSB_LAST BIT_MASK 0x8000000 /end MEASUREMENT
/begin MEASUREMENT lam_bank_2.ls_down_cur.ctr_cycnr_r_down_ls "Handshake counter indicating the number of valid resistance values determined since initial activation" UWORD _CNV_A_R_LINEAR_____0_CM 1 100. 0. 65535. DISPLAY_IDENTIFIER CTR_CYCNR_R_DOWN_LS_2 ECU_ADDRESS 0x3fc918 BYTE_ORDER MSB_LAST FORMAT "%5.0" /end MEASUREMENT
/begin MEASUREMENT lam_bank_2.ls_down_cur.drv1_vls_down_mmv_thd_max "Upper variable VLS_DOWN gradient threshold" SWORD _CNV_A_R_LINEAR_____297_CM 1 100. -2.5 2.4999 DISPLAY_IDENTIFIER DRV1_VLS_DOWN_MMV_THD_MAX_2 ECU_ADDRESS 0x3fc926 BYTE_ORDER MSB_LAST FORMAT "%7.4" /end MEASUREMENT
/begin MEASUREMENT lam_bank_2.ls_down_cur.drv1_vls_down_mmv_thd_min "Lower variable VLS_DOWN gradient threshold" SWORD _CNV_A_R_LINEAR_____297_CM 1 100. -2.5 2.4999 DISPLAY_IDENTIFIER DRV1_VLS_DOWN_MMV_THD_MIN_2 ECU_ADDRESS 0x3fc928 BYTE_ORDER MSB_LAST FORMAT "%7.4" /end MEASUREMENT
/begin MEASUREMENT lam_bank_2.ls_down_cur.fac_t_drv1_vls_down_abs "Multiplicative factor modifies C_DRV1_VLS_DOWN_ABS_MAX dependent on T_VLS_CYC_AFL_HLD" UBYTE _CNV_A_R_LINEAR_____46_CM 1 100. 0. 15.9375 DISPLAY_IDENTIFIER FAC_T_DRV1_VLS_DOWN_ABS_2 ECU_ADDRESS 0x3fc914 FORMAT "%5.2" /end MEASUREMENT
/begin MEASUREMENT lam_bank_2.ls_down_cur.fac_t_drv1_vls_down_mmv "Multiplicative factor modifies DRV1_VLS_DOWN_MMV_MIN_THD dependent on T_VLS_CYC_AFL_HLD" UBYTE _CNV_A_R_LINEAR_____308_CM 1 100. 0. 63.75 DISPLAY_IDENTIFIER FAC_T_DRV1_VLS_DOWN_MMV_2 ECU_ADDRESS 0x3fc915 FORMAT "%4.1" /end MEASUREMENT
/begin MEASUREMENT lam_bank_2.ls_down_cur.r_down_ls "Internal resistance of downstream oxygen sensor" UWORD _CNV_A_R_LINEAR_____309_CM 1 100. 0. 65535. DISPLAY_IDENTIFIER R_DOWN_LS_2 ECU_ADDRESS 0x3fc91a BYTE_ORDER MSB_LAST FORMAT "%5.0" /end MEASUREMENT
/begin MEASUREMENT lam_bank_2.ls_down_cur.r_down_ls_mes "Internal resistance of downstream oxygen sensor (Measured)" UWORD _CNV_A_R_LINEAR_____309_CM 1 100. 0. 65535. DISPLAY_IDENTIFIER R_DOWN_LS_MES_2 ECU_ADDRESS 0x3fc91c BYTE_ORDER MSB_LAST FORMAT "%5.0" /end MEASUREMENT
/begin MEASUREMENT lam_bank_2.ls_down_cur.t_sample_r_down_ls "Time measured between internal resistance samples" UWORD _CNV_A_R_LINEAR_____4_CM 1 100. 0. 655.35 DISPLAY_IDENTIFIER T_SAMPLE_R_DOWN_LS_2 ECU_ADDRESS 0x3fc924 BYTE_ORDER MSB_LAST FORMAT "%6.2" /end MEASUREMENT
/begin MEASUREMENT lam_bank_2.ls_down_cur.t_vls_cyc_afl_hld_r_down_ls "Lean mixture cycle time (measured upstream), held until next threshold crossing downstream" UBYTE _CNV_A_R_LINEAR_____4_CM 1 100. 0. 2.55 DISPLAY_IDENTIFIER T_VLS_CYC_AFL_HLD_R_DOWN_LS_2 ECU_ADDRESS 0x3fc916 FORMAT "%4.2" /end MEASUREMENT
/begin MEASUREMENT lam_bank_2.ls_down_cur.ttip_ls_down_mes "Downstream oxygen sensor ceramic temperature" SWORD _CNV_A_R_LINEAR_____303_CM 1 100. -2048. 2047.938 DISPLAY_IDENTIFIER TTIP_LS_DOWN_MES_2 ECU_ADDRESS 0x3fc92a BYTE_ORDER MSB_LAST FORMAT "%8.2" /end MEASUREMENT
/begin MEASUREMENT lam_bank_2.ls_down_cur.ttip_ls_down_mes_bol "Downstream oxygen sensor ceramic temperature, Lower limit, Unfiltered" SWORD _CNV_A_R_LINEAR_____303_CM 1 100. -2048. 2047.938 DISPLAY_IDENTIFIER TTIP_LS_DOWN_MES_BOL_2 ECU_ADDRESS 0x3fc92e BYTE_ORDER MSB_LAST FORMAT "%8.2" /end MEASUREMENT
/begin MEASUREMENT lam_bank_2.ls_down_cur.ttip_ls_down_mes_bol_mmv "Downstream oxygen sensor ceramic temperature, Lower limit, Filtered" SWORD _CNV_A_R_LINEAR_____303_CM 1 100. -2048. 2047.938 DISPLAY_IDENTIFIER TTIP_LS_DOWN_MES_BOL_MMV_2 ECU_ADDRESS 0x3fc934 BYTE_ORDER MSB_LAST FORMAT "%8.2" /end MEASUREMENT
/begin MEASUREMENT lam_bank_2.ls_down_cur.ttip_ls_down_mes_tol "Downstream oxygen sensor ceramic temperature, Upper limit, Unfiltered" SWORD _CNV_A_R_LINEAR_____303_CM 1 100. -2048. 2047.938 DISPLAY_IDENTIFIER TTIP_LS_DOWN_MES_TOL_2 ECU_ADDRESS 0x3fc92c BYTE_ORDER MSB_LAST FORMAT "%8.2" /end MEASUREMENT
/begin MEASUREMENT lam_bank_2.ls_down_cur.ttip_ls_down_mes_tol_mmv "Downstream oxygen sensor ceramic temperature, Upper limit, Filtered" SWORD _CNV_A_R_LINEAR_____303_CM 1 100. -2048. 2047.938 DISPLAY_IDENTIFIER TTIP_LS_DOWN_MES_TOL_MMV_2 ECU_ADDRESS 0x3fc930 BYTE_ORDER MSB_LAST FORMAT "%8.2" /end MEASUREMENT
/begin MEASUREMENT lam_bank_2.ls_down_cur.r_down_ls_mdl_sens_new "Internal resistance of downstream oxygen sensor (Modelled for new sensor)" UWORD _CNV_A_R_LINEAR_____309_CM 1 100. 0. 65535. DISPLAY_IDENTIFIER R_DOWN_LS_MDL_SENS_NEW_2 ECU_ADDRESS 0x3fc920 BYTE_ORDER MSB_LAST FORMAT "%5.0" /end MEASUREMENT
/begin MEASUREMENT lam_bank_2.ls_down_cur.pow_lsh_down_mmv "Moving mean value of downstream oxygen sensor heater power" UWORD _CNV_A_R_LINEAR_____310_CM 1 100. 0. 65.535 DISPLAY_IDENTIFIER POW_LSH_DOWN_MMV_2 ECU_ADDRESS 0x3fc922 BYTE_ORDER MSB_LAST /end MEASUREMENT
/begin MEASUREMENT lam_bank_2.ls_down_cur.ttip_ref_ls_down_mdl_mmv "Reference of downstream oxygen sensor ceramic temperature (Modelled for new sensor)" UWORD _CNV_A_R_LINEAR_____311_CM 1 100. 0. 2047.938 DISPLAY_IDENTIFIER TTIP_REF_LS_DOWN_MDL_MMV_2 ECU_ADDRESS 0x3fc938 BYTE_ORDER MSB_LAST FORMAT "%7.3" /end MEASUREMENT
/begin MEASUREMENT lam_bank_2.ls_temp_up_inci.lv_inh_ttip_ls_up "Boolean flag indicating that upstream oxygen sensor ceramic temperture determination shall be inhibited" UBYTE _CNV_S_2_RANGE______2_CM 1 100. 0. 1. DISPLAY_IDENTIFIER LV_INH_TTIP_LS_UP_2 ECU_ADDRESS 0x3fcb4c /end MEASUREMENT
/begin MEASUREMENT eff_lamb_bas_cor "Basic lambda efficiency" UWORD _CNV_A_R_LINEAR_____20_CM 1 100. 0. 1.99996948 DISPLAY_IDENTIFIER EFF_LAMB_BAS_COR ECU_ADDRESS 0x3fd362 BYTE_ORDER MSB_LAST FORMAT "%7.5" /end MEASUREMENT
/begin MEASUREMENT lamb_ref_cor "Corrected lambda reference value" UWORD _CNV_A_R_LINEAR_____206_CM 1 100. 0. 31.99902344 DISPLAY_IDENTIFIER LAMB_REF_COR ECU_ADDRESS 0x3fd368 BYTE_ORDER MSB_LAST FORMAT "%7.4" /end MEASUREMENT
/begin MEASUREMENT lamb_dif_bas "Basic lambda difference to corrected reference lambda" SWORD _CNV_A_R_LINEAR_____319_CM 1 100. -32.00000000125 31.99902343875 DISPLAY_IDENTIFIER LAMB_DIF_BAS ECU_ADDRESS 0x3fd370 BYTE_ORDER MSB_LAST /end MEASUREMENT
/begin MEASUREMENT lamb_dif_av "Actual lambda difference to corrected reference lambda" SWORD _CNV_A_R_LINEAR_____319_CM 1 100. -32.00000000125 31.99902343875 DISPLAY_IDENTIFIER LAMB_DIF_AV ECU_ADDRESS 0x3fd372 BYTE_ORDER MSB_LAST /end MEASUREMENT
/begin MEASUREMENT lamb_ref_add_tco "Additive correction of reference lambda value " SWORD _CNV_A_R_LINEAR_____319_CM 1 100. -32.00000000125 31.99902343875 DISPLAY_IDENTIFIER LAMB_REF_ADD_TCO ECU_ADDRESS 0x3fd36e BYTE_ORDER MSB_LAST /end MEASUREMENT
/begin MEASUREMENT lamb_dif_max "Maximum lambda difference to corrected reference lambda" SWORD _CNV_A_R_LINEAR_____319_CM 1 100. -32.00000000125 31.99902343875 DISPLAY_IDENTIFIER LAMB_DIF_MAX ECU_ADDRESS 0x3fd374 BYTE_ORDER MSB_LAST /end MEASUREMENT
/begin MEASUREMENT eff_lamb_av "Actual lambda efficiency" UWORD _CNV_A_R_LINEAR_____20_CM 1 100. 0. 1.99996948 DISPLAY_IDENTIFIER EFF_LAMB_AV ECU_ADDRESS 0x3fd364 BYTE_ORDER MSB_LAST FORMAT "%7.5" /end MEASUREMENT
/begin MEASUREMENT eff_lamb_min "Minimum lambda efficiency" UWORD _CNV_A_R_LINEAR_____20_CM 1 100. 0. 1.99996948 DISPLAY_IDENTIFIER EFF_LAMB_MIN ECU_ADDRESS 0x3fd366 BYTE_ORDER MSB_LAST FORMAT "%7.5" /end MEASUREMENT
/begin CHARACTERISTIC ip_lamb_ref_add__tco "Additive lambda correction versus coolant temperature" CURVE 0xffe4c9e2 _REC_CUR_20_u2_u1 63.99902344 _CNV_A_R_LINEAR_____277_CM -32. 31.99902344 DISPLAY_IDENTIFIER IP_LAMB_REF_ADD FORMAT "%8.4"
 /begin AXIS_DESCR COM_AXIS tco _CNV_A_R_LINEAR_____11_CM 6 -48. 142.5 FORMAT "%5.1" AXIS_PTS_REF ldp_tco__lamb_ref_add /end AXIS_DESCR
/end CHARACTERISTIC
/begin CHARACTERISTIC ip_lamb_ref__n__maf "Reference lambda" MAP 0xffe4c99a _REC_MAP_20_u2_u1_u1 31.99902344 _CNV_A_R_LINEAR_____206_CM 0. 31.99902344 DISPLAY_IDENTIFIER IP_LAMB_REF FORMAT "%7.4"
 /begin AXIS_DESCR COM_AXIS n_32 _CNV_A_R_LINEAR_____15_CM 6 0. 8160. FORMAT "%4.0" AXIS_PTS_REF ldp_n__lamb_ref /end AXIS_DESCR
 /begin AXIS_DESCR COM_AXIS maf _CNV_A_R_LINEAR_____27_CM 6 0. 1389. FORMAT "%4.0" AXIS_PTS_REF ldp_maf__lamb_ref /end AXIS_DESCR
/end CHARACTERISTIC
/begin MEASUREMENT eff_lamb_sp_bas "Basic lambda setpoint efficiency" UWORD _CNV_A_R_LINEAR_____20_CM 1 100. 0. 1.99996948 DISPLAY_IDENTIFIER EFF_LAMB_SP_BAS ECU_ADDRESS 0x3fd36a BYTE_ORDER MSB_LAST FORMAT "%7.5" /end MEASUREMENT
/begin MEASUREMENT lamb_ref "Lambda reference valua" UWORD _CNV_A_R_LINEAR_____206_CM 1 100. 0. 31.99902344 DISPLAY_IDENTIFIER LAMB_REF ECU_ADDRESS 0x3fd36c BYTE_ORDER MSB_LAST FORMAT "%7.4" /end MEASUREMENT
/begin MEASUREMENT lamb_dif_sp_bas "Basic lambda setpoint difference to corrected reference lambda" SWORD _CNV_A_R_LINEAR_____319_CM 1 100. -32.00000000125 31.99902343875 DISPLAY_IDENTIFIER LAMB_DIF_SP_BAS ECU_ADDRESS 0x3fd376 BYTE_ORDER MSB_LAST /end MEASUREMENT
/begin AXIS_PTS ldp_tco__lamb_ref_add "" 0xffe411d2 tco _REC_AXS_20_u1 190.5 _CNV_A_R_LINEAR_____11_CM 6 -48. 142.5 DISPLAY_IDENTIFIER LDP_TCO__LAMB_REF_ADD FORMAT "%5.1" /end AXIS_PTS
/begin AXIS_PTS ldp_n__lamb_ref "" 0xffe41127 n_32 _REC_AXS_20_u1 816. _CNV_A_R_LINEAR_____15_CM 6 0. 8160. DISPLAY_IDENTIFIER LDP_N__LAMB_REF FORMAT "%4.0" /end AXIS_PTS
/begin AXIS_PTS ldp_maf__lamb_ref "" 0xffe41052 maf _REC_AXS_20_u1 1389. _CNV_A_R_LINEAR_____27_CM 6 0. 1389. DISPLAY_IDENTIFIER LDP_MAF__LAMB_REF FORMAT "%4.0" /end AXIS_PTS
/begin CHARACTERISTIC ip_eff_lamb__lamb_dif "Lambda Efficiency" CURVE 0xffe4a092 _REC_CUR_20_u2_u2 1.99996948 _CNV_A_R_LINEAR_____20_CM 0. 1.99996948 DISPLAY_IDENTIFIER IP_EFF_LAMB__LAMB_DIF FORMAT "%7.5"
 /begin AXIS_DESCR COM_AXIS online_dummy _CNV_A_R_LINEAR_____277_CM 16 -32. 31.99902344 FORMAT "%8.4" AXIS_PTS_REF ldp_lamb_dif__eff_lamb /end AXIS_DESCR
/end CHARACTERISTIC
/begin AXIS_PTS ldp_lamb_dif__eff_lamb "" 0xffe50c58 online_dummy _REC_AXS_20_u2 63.99902344 _CNV_A_R_LINEAR_____277_CM 16 -32. 31.99902344 DISPLAY_IDENTIFIER LDP_LAMB_DIF__EFF_LAMB FORMAT "%8.4" /end AXIS_PTS
/begin CHARACTERISTIC c_fac_stk_drv1_vls_down_mmv "Multiplicative factor used to weight gradiant thresholds dependent on VLS_DOWN_MMV_xxx_i amplitude" VALUE 0xffe40747 _REC_VAL_20_u1 1.9921875 _CNV_A_R_LINEAR_____117_CM 0. 1.9921875 DISPLAY_IDENTIFIER C_FAC_STK_DRV1_VLS_DOWN_MMV FORMAT "%5.3" /end CHARACTERISTIC
/begin CHARACTERISTIC c_t_cur_off_ls_down "Minimum delay between cosecutive pump current activation" VALUE 0xffe418f0 _REC_VAL_20_u2 655.35 _CNV_A_R_LINEAR_____4_CM 0. 655.35 DISPLAY_IDENTIFIER C_T_CUR_OFF_LS_DOWN FORMAT "%6.2" /end CHARACTERISTIC
/begin CHARACTERISTIC c_t_cur_dly_ls_down "Duration in witch VLS_DOWN_i signal masked directly after Ri determination" VALUE 0xffe40868 _REC_VAL_20_u1 0.255 _CNV_A_R_LINEAR_____365_CM 0. 0.255 DISPLAY_IDENTIFIER C_T_CUR_DLY_LS_DOWN FORMAT "%5.3" /end CHARACTERISTIC
/begin CHARACTERISTIC c_drv1_vls_down_abs_max "Threshold for absolute maximum 1st dervative of VLS_DOWN_i signal for Ri determination" VALUE 0xffe415c2 _REC_VAL_20_u2 4.9999237 _CNV_A_R_LINEAR_____298_CM 0. 4.9999237 DISPLAY_IDENTIFIER C_DRV1_VLS_DOWN_ABS_MAX FORMAT "%6.4" /end CHARACTERISTIC
/begin CHARACTERISTIC c_temp_cur_on_ls_down "Temperature threshold for the activation of sensor pumping" VALUE 0xffe41a66 _REC_VAL_20_u2 2047. _CNV_A_R_LINEAR_____6_CM 0. 2047. DISPLAY_IDENTIFIER C_TEMP_CUR_ON_LS_DOWN FORMAT "%7.2" /end CHARACTERISTIC
/begin CHARACTERISTIC c_t_cur_on_ls_down "Duration for pump current active" VALUE 0xffe40869 _REC_VAL_20_u1 8.e-003 _CNV_A_R_LINEAR_____365_CM 0. 8.e-003 DISPLAY_IDENTIFIER C_T_CUR_ON_LS_DOWN FORMAT "%4.3" /end CHARACTERISTIC
/begin CHARACTERISTIC c_vls_mmv_min_rng_tol_ls_down "Permitted range of VLS_DOWN_i above VLS_DOWN_MMV_MIN_i at low gradient for Ri determination" VALUE 0xffe41b86 _REC_VAL_20_u2 4.99992371 _CNV_A_R_LINEAR_____252_CM 0. 4.99992371 DISPLAY_IDENTIFIER C_VLS_MMV_MIN_RNG_TOL_LS_DOWN FORMAT "%7.5" /end CHARACTERISTIC
/begin CHARACTERISTIC c_vls_mmv_min_rng_bol_ls_down "Permitted range of VLS_DOWN_i below VLS_DOWN_MMV_MIN_i at low gradient for Ri determination" VALUE 0xffe41b84 _REC_VAL_20_u2 4.99992371 _CNV_A_R_LINEAR_____252_CM 0. 4.99992371 DISPLAY_IDENTIFIER C_VLS_MMV_MIN_RNG_BOL_LS_DOWN FORMAT "%7.5" /end CHARACTERISTIC
/begin CHARACTERISTIC c_drv1_vls_down_mmv_thd_min "Minimum threshold for mean 1st derivation of VLS_DOWN_i signal for Ri determination" VALUE 0xffe403fe _REC_VAL_20_s2 4.9999 _CNV_A_R_LINEAR_____297_CM -2.5 2.4999 DISPLAY_IDENTIFIER C_DRV1_VLS_DOWN_MMV_THD_MIN FORMAT "%7.4" /end CHARACTERISTIC
/begin CHARACTERISTIC c_drv1_vls_down_mmv_thd_max "Maximum threshold for mean 1st derivation of VLS_DOWN_i signal for Ri determination" VALUE 0xffe403fc _REC_VAL_20_s2 4.9999 _CNV_A_R_LINEAR_____297_CM -2.5 2.4999 DISPLAY_IDENTIFIER C_DRV1_VLS_DOWN_MMV_THD_MAX FORMAT "%7.4" /end CHARACTERISTIC
/begin CHARACTERISTIC c_ctr_vls_afl_cyc_r_down_ls "Min. no. AF cycles post lambda controller activation to permit use of T_VLS_CYC_AFL_HLD dependency" VALUE 0xffe4158e _REC_VAL_20_u2 65535. _CNV_A_R_LINEAR_____0_CM 0. 65535. DISPLAY_IDENTIFIER C_CTR_VLS_AFL_CYC_R_DOWN_LS FORMAT "%5.0" /end CHARACTERISTIC
/begin CHARACTERISTIC c_maf_kgh_r_down_ls "Maximum MAF_KGH threshold for activation of internal resistance determination" VALUE 0xffe417ac _REC_VAL_20_u2 2047.96875 _CNV_A_R_LINEAR_____115_CM 0. 2047.96875 DISPLAY_IDENTIFIER C_MAF_KGH_R_DOWN_LS FORMAT "%7.2" /end CHARACTERISTIC
/begin CHARACTERISTIC c_fac_drv1_vls_down_mmv_min "Hysteresis factor of DRV1_VLS_DOWN_MMV_MIN governing limiting of DRV1_VLS_DOWN_MMV_MIN_THD" VALUE 0xffe40735 _REC_VAL_20_u1 0.9960940000000002 _CNV_A_R_LINEAR_____50_CM 0. 0.996094 DISPLAY_IDENTIFIER C_FAC_DRV1_VLS_DOWN_MMV_MIN FORMAT "%5.3" /end CHARACTERISTIC
/begin CHARACTERISTIC c_fac_err_pos_r_down_ls "Internal restance measurement positive error (i.e. 0% to 100%)" VALUE 0xffe40738 _REC_VAL_20_u1 0.9960940000000002 _CNV_A_R_LINEAR_____50_CM 0. 0.996094 DISPLAY_IDENTIFIER C_FAC_ERR_POS_R_DOWN_LS FORMAT "%5.3" /end CHARACTERISTIC
/begin CHARACTERISTIC c_fac_err_neg_r_down_ls "Internal restance measurement negative error (i.e. 0% to 100%)" VALUE 0xffe40737 _REC_VAL_20_u1 0.9960940000000002 _CNV_A_R_LINEAR_____50_CM 0. 0.996094 DISPLAY_IDENTIFIER C_FAC_ERR_NEG_R_DOWN_LS FORMAT "%5.3" /end CHARACTERISTIC
/begin CHARACTERISTIC c_crlc_ttip_fall_r_down_ls "Correlation (filter) constant for falling ceramic temperature, limit calcultation" VALUE 0xffe4069a _REC_VAL_20_u1 0.99610001 _CNV_A_R_LINEAR_____366_CM 0. 0.99610001 DISPLAY_IDENTIFIER C_CRLC_TTIP_FALL_R_DOWN_LS FORMAT "%5.3" /end CHARACTERISTIC
/begin CHARACTERISTIC c_crlc_ttip_rise_r_down_ls "Correlation (filter) constant for rising ceramic temperature, limit calcultation" VALUE 0xffe4069b _REC_VAL_20_u1 0.99610001 _CNV_A_R_LINEAR_____366_CM 0. 0.99610001 DISPLAY_IDENTIFIER C_CRLC_TTIP_RISE_R_DOWN_LS FORMAT "%5.3" /end CHARACTERISTIC
/begin CHARACTERISTIC lc_inh_r_down_ls_vld "Boolean flag inhibiting internal resistance determination validity function" VALUE 0xffe40f84 _REC_VAL_20_u1 1. _CNV_A_R_LINEAR_____0_CM 0. 1. DISPLAY_IDENTIFIER LC_INH_R_DOWN_LS_VLD FORMAT "%2.0" /end CHARACTERISTIC
/begin CHARACTERISTIC ip_fac_t_drv1_vls_down_mmv "Multiplictive factor modifies DRV1_VLS_DOWN_MMV_MIN_THD dependent on T_VLS_CYC_AFL_HLD" CURVE 0xffe40bf1 _REC_CUR_20_u1_u1 63.75 _CNV_A_R_LINEAR_____308_CM 0. 63.75 DISPLAY_IDENTIFIER IP_FAC_T_DRV1_VLS_DOWN_MMV FORMAT "%4.1"
 /begin AXIS_DESCR COM_AXIS online_dummy _CNV_A_R_LINEAR_____4_CM 8 0. 2.55 FORMAT "%4.2" AXIS_PTS_REF ldpm_t_vls_cyc_afl_hld /end AXIS_DESCR
/end CHARACTERISTIC
/begin CHARACTERISTIC ip_fac_t_drv1_vls_down_abs "Multiplictive factor modifies C_DRV1_VLS_DOWN_ABS_MAX dependent on T_VLS_CYC_AFL_HLD" CURVE 0xffe40be9 _REC_CUR_20_u1_u1 15.9375 _CNV_A_R_LINEAR_____46_CM 0. 15.9375 DISPLAY_IDENTIFIER IP_FAC_T_DRV1_VLS_DOWN_ABS FORMAT "%5.2"
 /begin AXIS_DESCR COM_AXIS online_dummy _CNV_A_R_LINEAR_____4_CM 8 0. 2.55 FORMAT "%4.2" AXIS_PTS_REF ldpm_t_vls_cyc_afl_hld /end AXIS_DESCR
/end CHARACTERISTIC
/begin CHARACTERISTIC ip_ttip_ls_down "Oxygen sensor temperature vs. internal resistance characteristic" CURVE 0xffe505f6 _REC_CUR_20_u2_u2 2047.96875 _CNV_A_R_LINEAR_____367_CM 0. 2047.96875 DISPLAY_IDENTIFIER IP_TTIP_LS_DOWN FORMAT "%7.2"
 /begin AXIS_DESCR COM_AXIS lam_bank_1.ls_down_cur.r_down_ls _CNV_A_R_LINEAR_____309_CM 8 0. 65535. FORMAT "%5.0" AXIS_PTS_REF ldp_r_down_ls_ip_ttip_ls_down /end AXIS_DESCR
/end CHARACTERISTIC
/begin AXIS_PTS ldpm_t_vls_cyc_afl_hld "" 0xffe485e4 online_dummy _REC_AXS_20_u1 2.55 _CNV_A_R_LINEAR_____4_CM 8 0. 2.55 DISPLAY_IDENTIFIER LDPM_T_VLS_CYC_AFL_HLD FORMAT "%4.2" /end AXIS_PTS
/begin AXIS_PTS ldp_r_down_ls_ip_ttip_ls_down "" 0xffe51248 lam_bank_1.ls_down_cur.r_down_ls _REC_AXS_20_u2 65535. _CNV_A_R_LINEAR_____309_CM 8 0. 65535. DISPLAY_IDENTIFIER LDP_R_DOWN_LS_IP_TTIP_LS_DOWN FORMAT "%5.0" /end AXIS_PTS
/begin AXIS_PTS ldp_maf_kgh_crlc_ttip_ref_ls "" 0xffe50e60 maf_kgh _REC_AXS_20_u2 2047.96875 _CNV_A_R_LINEAR_____115_CM 8 0. 2047.96875 DISPLAY_IDENTIFIER LDP_MAF_KGH_CRLC_TTIP_REF_LS FORMAT "%7.2" /end AXIS_PTS
/begin CHARACTERISTIC ip_crlc_ttip_ref_ls_down_mdl "Correlation map for calculation of reference downstream tip temperature(modelled for new sensor)" CURVE 0xffe40aef _REC_CUR_20_u1_u2 0.99610001 _CNV_A_R_LINEAR_____29_CM 0. 0.99610001 DISPLAY_IDENTIFIER IP_CRLC_TTIP_REF_LS_DOWN_MDL FORMAT "%5.3"
 /begin AXIS_DESCR COM_AXIS maf_kgh _CNV_A_R_LINEAR_____115_CM 8 0. 2047.96875 FORMAT "%7.2" AXIS_PTS_REF ldp_maf_kgh_crlc_ttip_ref_ls /end AXIS_DESCR
/end CHARACTERISTIC
/begin AXIS_PTS ldp_pow_lsh_down_mmv_r_down_ls "" 0xffe511b0 lam_bank_1.ls_down_cur.pow_lsh_down_mmv _REC_AXS_20_u2 65.535 _CNV_A_R_LINEAR_____310_CM 8 0. 65.535 DISPLAY_IDENTIFIER LDP_POW_LSH_DOWN_MMV_R_DOWN_LS /end AXIS_PTS
/begin CHARACTERISTIC c_crlc_pow_lsh_down "Correlation (filter) constant for moving mean value of downstream heater power" VALUE 0xffe4068f _REC_VAL_20_u1 0.9960940000000002 _CNV_A_R_LINEAR_____50_CM 0. 0.996094 DISPLAY_IDENTIFIER C_CRLC_POW_LSH_DOWN FORMAT "%5.3" /end CHARACTERISTIC
/begin CHARACTERISTIC ip_r_down_ls_mdl_sens_new "Internal resistance of a new downstream oxygen sensor(modelled)" MAP 0xffe4df86 _REC_MAP_20_u2_u2_u2 65535. _CNV_A_R_LINEAR_____309_CM 0. 65535. DISPLAY_IDENTIFIER IP_R_DOWN_LS_MDL_SENS_NEW FORMAT "%5.0"
 /begin AXIS_DESCR COM_AXIS lam_bank_1.ls_down_cur.pow_lsh_down_mmv _CNV_A_R_LINEAR_____310_CM 8 0. 65.535 AXIS_PTS_REF ldp_pow_lsh_down_mmv_r_down_ls /end AXIS_DESCR
 /begin AXIS_DESCR COM_AXIS lam_bank_1.ls_down_cur.ttip_ref_ls_down_mdl_mmv _CNV_A_R_LINEAR_____311_CM 8 0. 2047.938 FORMAT "%7.3" AXIS_PTS_REF ldp_ttip_ref_ls_down_mdl_r_down /end AXIS_DESCR
/end CHARACTERISTIC
/begin AXIS_PTS ldp_ttip_ref_ls_down_mdl_r_down "" 0xffe51572 lam_bank_1.ls_down_cur.ttip_ref_ls_down_mdl_mmv _REC_AXS_20_u2 2047.938 _CNV_A_R_LINEAR_____311_CM 8 0. 2047.938 DISPLAY_IDENTIFIER LDP_TTIP_REF_LS_DOWN_MDL_R_DOWN FORMAT "%7.3" /end AXIS_PTS
/begin MEASUREMENT lv_inh_r_down_ls_1 "Boolean flag indicating that downstream sensor internal resistance determiantion shall be inhibited when set" UBYTE _CNV_S_2_RANGE______21_CM 1 100. 0. 1. DISPLAY_IDENTIFIER LV_INH_R_DOWN_LS_1 ECU_ADDRESS 0x3fe543 /end MEASUREMENT
/begin MEASUREMENT lv_inh_r_down_ls_2 "Boolean flag indicating that downstream sensor internal resistance determiantion shall be inhibited when set" UBYTE _CNV_S_2_RANGE______21_CM 1 100. 0. 1. DISPLAY_IDENTIFIER LV_INH_R_DOWN_LS_2 ECU_ADDRESS 0x3fe544 /end MEASUREMENT
/begin MEASUREMENT maf_max_cor "Maximum intake air depending on engine speed an air density" UWORD _CNV_A_R_LINEAR_____108_CM 1 100. 0. 1389. DISPLAY_IDENTIFIER MAF_MAX_COR ECU_ADDRESS 0x3fd272 BYTE_ORDER MSB_LAST FORMAT "%6.2" /end MEASUREMENT
/begin MEASUREMENT eff_maf_s "Air efficiency in stratified combustion" UWORD _CNV_A_R_LINEAR_____20_CM 1 100. 0. 1.99996948 DISPLAY_IDENTIFIER EFF_MAF_S ECU_ADDRESS 0x3fd230 BYTE_ORDER MSB_LAST FORMAT "%7.5" /end MEASUREMENT
/begin MEASUREMENT iga_igc_0_5 "Ignition angle applied on the respective cylinder (0 to 5)" UBYTE _CNV_A_R_LINEAR_____203_CM 1 100. -35.625 60. DISPLAY_IDENTIFIER IGA_IGC_0_5 ECU_ADDRESS 0x3fe769 FORMAT "%5.1" /end MEASUREMENT
/begin MEASUREMENT iga_knk_0_5 "Spark retard due to knocking combustion of the respective cylinder (0 to 5)" UBYTE _CNV_A_R_LINEAR_____205_CM 1 100. -48. 0. DISPLAY_IDENTIFIER IGA_KNK_0_5 ECU_ADDRESS 0x3fe76a FORMAT "%5.1" /end MEASUREMENT
/begin MEASUREMENT knk_thd_0_5 "Knock threshold of the respective cylinder (0 to 5)" UBYTE _CNV_A_R_LINEAR_____44_CM 1 100. 0. 4.998 DISPLAY_IDENTIFIER KNK_THD_0_5 ECU_ADDRESS 0x3fe76b FORMAT "%6.4" /end MEASUREMENT
/begin MEASUREMENT nl_0_5 "Noise level of the respective cylinder (0 to 5)" UWORD _CNV_A_R_LINEAR_____252_CM 1 100. 0. 4.99992371 DISPLAY_IDENTIFIER NL_0_5 ECU_ADDRESS 0x3fd840 BYTE_ORDER MSB_LAST FORMAT "%7.5" /end MEASUREMENT
/begin MEASUREMENT ti_cyl_0_5 "fuel injection time for the respective cylinder (0 to 5)" UWORD _CNV_A_R_LINEAR_____165_CM 1 100. 0. 262.14 DISPLAY_IDENTIFIER TI_CYL_0_5 ECU_ADDRESS 0x3fd842 BYTE_ORDER MSB_LAST FORMAT "%7.3" /end MEASUREMENT
/begin MEASUREMENT knks_0_5 "Knock control signal of the respective cylinder (0 to 5)" UWORD _CNV_A_R_LINEAR_____252_CM 1 100. 0. 4.99992371 DISPLAY_IDENTIFIER KNKS_0_5 ECU_ADDRESS 0x3fd83e BYTE_ORDER MSB_LAST FORMAT "%7.5" /end MEASUREMENT
/begin MEASUREMENT nox_nox_sens_2 "NOx concentration value, measured by NOx-Sensor" SWORD _CNV_A_R_LINEAR_____429_CM 1 100. -100.000000000001 1500. DISPLAY_IDENTIFIER NOX_NOX_SENS_2 ECU_ADDRESS 0x3fd63a BYTE_ORDER MSB_LAST FORMAT "%4.0" /end MEASUREMENT
/begin MEASUREMENT lamb_nox_sens_1 "Lambda value, measured by NOx-Sensor" UWORD _CNV_A_R_LINEAR_____206_CM 1 100. 0. 31.99902344 DISPLAY_IDENTIFIER LAMB_NOX_SENS_1 ECU_ADDRESS 0x3fd620 BYTE_ORDER MSB_LAST /end MEASUREMENT
/begin MEASUREMENT lamb_nox_sens_2 "Lambda value, measured by NOx-Sensor" UWORD _CNV_A_R_LINEAR_____206_CM 1 100. 0. 31.99902344 DISPLAY_IDENTIFIER LAMB_NOX_SENS_2 ECU_ADDRESS 0x3fd630 BYTE_ORDER MSB_LAST /end MEASUREMENT
/begin MEASUREMENT lv_nox_sens_lamb_vld_1 "Indicator that the Lambda signal is valid" UBYTE _CNV_S_2_RANGE______1_R_CM 1 100. 0. 255. DISPLAY_IDENTIFIER LV_NOX_SENS_LAMB_VLD_1 ECU_ADDRESS 0x3fe5e9 /end MEASUREMENT
/begin MEASUREMENT lv_nox_sens_lamb_vld_2 "Indicator that the Lambda signal is valid" UBYTE _CNV_S_2_RANGE______1_R_CM 1 100. 0. 255. DISPLAY_IDENTIFIER LV_NOX_SENS_LAMB_VLD_2 ECU_ADDRESS 0x3fe5f2 /end MEASUREMENT
/begin MEASUREMENT lv_nox_sens_nox_vld_1 "Indicator that the NOx signal is valid" UBYTE _CNV_S_2_RANGE______21_CM 1 100. 0. 1. DISPLAY_IDENTIFIER LV_NOX_SENS_NOX_VLD_1 ECU_ADDRESS 0x3fe5e6 BIT_MASK 0x1 /end MEASUREMENT
/begin MEASUREMENT lv_nox_sens_vls_vld_2 "Indicator that thebinary O2 singal is valid" UBYTE _CNV_S_2_RANGE______21_CM 1 100. 0. 1. DISPLAY_IDENTIFIER LV_NOX_SENS_VLS_VLD_2 ECU_ADDRESS 0x3fe5f4 BIT_MASK 0x1 /end MEASUREMENT
/begin MEASUREMENT err_nox_sens_1 "NOx-Sensor failure byte" UBYTE _CNV_A_R_LINEAR_____0_CM 1 100. 0. 255. DISPLAY_IDENTIFIER ERR_NOX_SENS_1 ECU_ADDRESS 0x3fe5e4 FORMAT "%3.0" /end MEASUREMENT
/begin MEASUREMENT err_nox_sens_2 "NOx-Sensor failure byte" UBYTE _CNV_A_R_LINEAR_____0_CM 1 100. 0. 255. DISPLAY_IDENTIFIER ERR_NOX_SENS_2 ECU_ADDRESS 0x3fe5ed FORMAT "%3.0" /end MEASUREMENT
/begin MEASUREMENT nox_nox_sens_1 "NOx concentration value, measured by NOx-Sensor" SWORD _CNV_A_R_LINEAR_____429_CM 1 100. -100.000000000001 1500. DISPLAY_IDENTIFIER NOX_NOX_SENS_1 ECU_ADDRESS 0x3fd62a BYTE_ORDER MSB_LAST FORMAT "%4.0" /end MEASUREMENT
/begin MEASUREMENT lv_nox_sens_nox_vld_2 "Indicator that the NOx signal is valid" UBYTE _CNV_S_2_RANGE______21_CM 1 100. 0. 1. DISPLAY_IDENTIFIER LV_NOX_SENS_NOX_VLD_2 ECU_ADDRESS 0x3fe5ef BIT_MASK 0x1 /end MEASUREMENT
/begin MEASUREMENT lv_nox_sens_nox_diag_vld_2 "Indicator that the NOx signal is valid for use into the diagnosis functions" UBYTE _CNV_S_2_RANGE______21_CM 1 100. 0. 1. DISPLAY_IDENTIFIER LV_NOX_SENS_NOX_DIAG_VLD_2 ECU_ADDRESS 0x3fe5ee /end MEASUREMENT
/begin MEASUREMENT lv_nox_sens_nox_diag_vld_1 "Indicator that the NOx signal is valid for use into the diagnosis functions" UBYTE _CNV_S_2_RANGE______21_CM 1 100. 0. 1. DISPLAY_IDENTIFIER LV_NOX_SENS_NOX_DIAG_VLD_1 ECU_ADDRESS 0x3fe5e5 /end MEASUREMENT
/begin MEASUREMENT lv_nox_sens_nox_auth_1 "Indicator that the NOx signal has be reached the valid state after the start" UBYTE _CNV_S_2_RANGE______21_CM 1 100. 0. 1. DISPLAY_IDENTIFIER LV_NOX_SENS_NOX_AUTH_1 ECU_ADDRESS 0x3fe5e7 /end MEASUREMENT
/begin MEASUREMENT vls_nox_sens_2 "Binary O2 signal voltage, raw value, measured by NOx-Sensor" UWORD _CNV_A_R_LINEAR_____105_CM 1 100. -200. 1200. DISPLAY_IDENTIFIER VLS_NOX_SENS_2 ECU_ADDRESS 0x3fd636 BYTE_ORDER MSB_LAST FORMAT "%4.0" /end MEASUREMENT
/begin MEASUREMENT t_nox_sens_nox_hld_1 "Timer for hold of last valid NOx signal value" UWORD _CNV_A_R_LINEAR_____4_CM 1 100. 0. 327.67 DISPLAY_IDENTIFIER T_NOX_SENS_NOX_HLD_1 ECU_ADDRESS 0x3fd61c BYTE_ORDER MSB_LAST FORMAT "%6.2" /end MEASUREMENT
/begin MEASUREMENT t_nox_sens_nox_hld_2 "Timer for hold of last valid NOx signal value" UWORD _CNV_A_R_LINEAR_____4_CM 1 100. 0. 327.67 DISPLAY_IDENTIFIER T_NOX_SENS_NOX_HLD_2 ECU_ADDRESS 0x3fd62c BYTE_ORDER MSB_LAST FORMAT "%6.2" /end MEASUREMENT
/begin MEASUREMENT lamb_nox_sens_diag_1 "Lambda value for diagnosis functions, measured by NOx-Sensor" UWORD _CNV_A_R_LINEAR_____206_CM 1 100. 0. 31.99902344 DISPLAY_IDENTIFIER LAMB_NOX_SENS_DIAG_1 ECU_ADDRESS 0x3fd61e BYTE_ORDER MSB_LAST FORMAT "%7.4" /end MEASUREMENT
/begin MEASUREMENT lamb_nox_sens_diag_2 "Lambda value for diagnosis functions, measured by NOx-Sensor" UWORD _CNV_A_R_LINEAR_____206_CM 1 100. 0. 31.99902344 DISPLAY_IDENTIFIER LAMB_NOX_SENS_DIAG_2 ECU_ADDRESS 0x3fd62e BYTE_ORDER MSB_LAST FORMAT "%7.4" /end MEASUREMENT
/begin MEASUREMENT lv_nox_sens_nox_auth_2 "Indicator that the NOx signal has be reached the valid state after the start" UBYTE _CNV_S_2_RANGE______21_CM 1 100. 0. 1. DISPLAY_IDENTIFIER LV_NOX_SENS_NOX_AUTH_2 ECU_ADDRESS 0x3fe5f0 /end MEASUREMENT
/begin MEASUREMENT lv_nox_sens_lamb_diag_vld_1 "Indicator that the Lambda signal is valid for use into the diagnosis functions" UBYTE _CNV_S_2_RANGE______21_CM 1 100. 0. 1. DISPLAY_IDENTIFIER LV_NOX_SENS_LAMB_DIAG_VLD_1 ECU_ADDRESS 0x3fe5e8 /end MEASUREMENT
/begin MEASUREMENT lv_nox_sens_lamb_diag_vld_2 "Indicator that the Lambda signal is valid for use into the diagnosis functions" UBYTE _CNV_S_2_RANGE______21_CM 1 100. 0. 1. DISPLAY_IDENTIFIER LV_NOX_SENS_LAMB_DIAG_VLD_2 ECU_ADDRESS 0x3fe5f1 /end MEASUREMENT
/begin MEASUREMENT t_nox_sens_lamb_hld_1 "Timer for hold of last valid Lambda signal value" UWORD _CNV_A_R_LINEAR_____4_CM 1 100. 0. 327.67 DISPLAY_IDENTIFIER T_NOX_SENS_LAMB_HLD_1 ECU_ADDRESS 0x3fd622 BYTE_ORDER MSB_LAST FORMAT "%6.2" /end MEASUREMENT
/begin MEASUREMENT vls_nox_sens_1 "Binary O2 signal voltage, raw value, measured by NOx-Sensor" UWORD _CNV_A_R_LINEAR_____105_CM 1 100. -200. 1200. DISPLAY_IDENTIFIER VLS_NOX_SENS_1 ECU_ADDRESS 0x3fd626 BYTE_ORDER MSB_LAST FORMAT "%4.0" /end MEASUREMENT
/begin MEASUREMENT vls_nox_sens_diag_1 "Binary O2 signal voltage for diagnosis functions, raw value, measured by NOx-Sensor" UWORD _CNV_A_R_LINEAR_____105_CM 1 100. -200. 1200. DISPLAY_IDENTIFIER VLS_NOX_SENS_DIAG_1 ECU_ADDRESS 0x3fd624 BYTE_ORDER MSB_LAST FORMAT "%4.0" /end MEASUREMENT
/begin MEASUREMENT vls_nox_sens_diag_2 "Binary O2 signal voltage for diagnosis functions, raw value, measured by NOx-Sensor" UWORD _CNV_A_R_LINEAR_____105_CM 1 100. -200. 1200. DISPLAY_IDENTIFIER VLS_NOX_SENS_DIAG_2 ECU_ADDRESS 0x3fd634 BYTE_ORDER MSB_LAST FORMAT "%4.0" /end MEASUREMENT
/begin MEASUREMENT lv_nox_sens_vls_vld_1 "Indicator that thebinary O2 singal is valid" UBYTE _CNV_S_2_RANGE______21_CM 1 100. 0. 1. DISPLAY_IDENTIFIER LV_NOX_SENS_VLS_VLD_1 ECU_ADDRESS 0x3fe5eb BIT_MASK 0x1 /end MEASUREMENT
/begin MEASUREMENT lv_nox_sens_vls_diag_vld_1 "Indicator that the binary O2 signal is valid for use into the diagnosis functions" UBYTE _CNV_S_2_RANGE______21_CM 1 100. 0. 1. DISPLAY_IDENTIFIER LV_NOX_SENS_VLS_DIAG_VLD_1 ECU_ADDRESS 0x3fe5ea /end MEASUREMENT
/begin MEASUREMENT lv_nox_sens_vls_diag_vld_2 "Indicator that the binary O2 signal is valid for use into the diagnosis functions" UBYTE _CNV_S_2_RANGE______21_CM 1 100. 0. 1. DISPLAY_IDENTIFIER LV_NOX_SENS_VLS_DIAG_VLD_2 ECU_ADDRESS 0x3fe5f3 /end MEASUREMENT
/begin MEASUREMENT t_nox_sens_lamb_hld_2 "Timer for hold of last valid Lambda signal value" UWORD _CNV_A_R_LINEAR_____4_CM 1 100. 0. 327.67 DISPLAY_IDENTIFIER T_NOX_SENS_LAMB_HLD_2 ECU_ADDRESS 0x3fd632 BYTE_ORDER MSB_LAST FORMAT "%6.2" /end MEASUREMENT
/begin MEASUREMENT lv_nox_sens_temp_1 "Indicator that the sensor temperature is ok" UBYTE _CNV_S_2_RANGE______21_CM 1 100. 0. 1. DISPLAY_IDENTIFIER LV_NOX_SENS_TEMP_1 ECU_ADDRESS 0x3fe5ec /end MEASUREMENT
/begin MEASUREMENT lv_nox_sens_temp_2 "Indicator that the sensor temperature is ok" UBYTE _CNV_S_2_RANGE______21_CM 1 100. 0. 1. DISPLAY_IDENTIFIER LV_NOX_SENS_TEMP_2 ECU_ADDRESS 0x3fe5f5 /end MEASUREMENT
/begin MEASUREMENT t_nox_sens_vls_hld_2 "Timer for hold of last valid binary O2 signal value" UWORD _CNV_A_R_LINEAR_____4_CM 1 100. 0. 327.67 DISPLAY_IDENTIFIER T_NOX_SENS_VLS_HLD_2 ECU_ADDRESS 0x3fd638 BYTE_ORDER MSB_LAST FORMAT "%6.2" /end MEASUREMENT
/begin MEASUREMENT t_nox_sens_vls_hld_1 "Timer for hold of last valid binary O2 signal value" UWORD _CNV_A_R_LINEAR_____4_CM 1 100. 0. 327.67 DISPLAY_IDENTIFIER T_NOX_SENS_VLS_HLD_1 ECU_ADDRESS 0x3fd628 BYTE_ORDER MSB_LAST FORMAT "%6.2" /end MEASUREMENT
/begin CHARACTERISTIC lc_nox_sens_nox_man_2 "Manual setting of NOx concentration value on/ off" VALUE 0xffe40fba _REC_VAL_20_u1 1. _CNV_A_R_LINEAR_____0_CM 0. 1. DISPLAY_IDENTIFIER LC_NOX_SENS_NOX_MAN_2 FORMAT "%2.0" /end CHARACTERISTIC
/begin CHARACTERISTIC lc_nox_sens_nox_man_1 "Manual setting of NOx concentration value on/ off" VALUE 0xffe40fb9 _REC_VAL_20_u1 1. _CNV_A_R_LINEAR_____0_CM 0. 1. DISPLAY_IDENTIFIER LC_NOX_SENS_NOX_MAN_1 FORMAT "%2.0" /end CHARACTERISTIC
/begin CHARACTERISTIC lc_nox_sens_lamb_man_2 "Manual setting of Lambda value on/ off" VALUE 0xffe40fb6 _REC_VAL_20_u1 1. _CNV_A_R_LINEAR_____0_CM 0. 1. DISPLAY_IDENTIFIER LC_NOX_SENS_LAMB_MAN_2 FORMAT "%2.0" /end CHARACTERISTIC
/begin CHARACTERISTIC lc_nox_sens_lamb_man_1 "Manual setting of Lambda value on/ off" VALUE 0xffe40fb5 _REC_VAL_20_u1 1. _CNV_A_R_LINEAR_____0_CM 0. 1. DISPLAY_IDENTIFIER LC_NOX_SENS_LAMB_MAN_1 FORMAT "%2.0" /end CHARACTERISTIC
/begin CHARACTERISTIC c_vls_nox_sens_1 "Manual binary O2 value" VALUE 0xffe41b88 _REC_VAL_20_u2 1400. _CNV_A_R_LINEAR_____105_CM -200. 1200. DISPLAY_IDENTIFIER C_VLS_NOX_SENS_1 FORMAT "%4.0" /end CHARACTERISTIC
/begin CHARACTERISTIC lc_nox_sens_vls_man_1 "Manual setting of binary O2 value on/ off" VALUE 0xffe40fbe _REC_VAL_20_u1 1. _CNV_A_R_LINEAR_____0_CM 0. 1. DISPLAY_IDENTIFIER LC_NOX_SENS_VLS_MAN_1 FORMAT "%2.0" /end CHARACTERISTIC
/begin CHARACTERISTIC lc_nox_sens_err_man_1 "Manual setting of error byte on/ off" VALUE 0xffe40fb3 _REC_VAL_20_u1 1. _CNV_A_R_LINEAR_____0_CM 0. 1. DISPLAY_IDENTIFIER LC_NOX_SENS_ERR_MAN_1 FORMAT "%2.0" /end CHARACTERISTIC
/begin CHARACTERISTIC lc_nox_sens_err_man_2 "Manual setting of error byte on/ off" VALUE 0xffe40fb4 _REC_VAL_20_u1 1. _CNV_A_R_LINEAR_____0_CM 0. 1. DISPLAY_IDENTIFIER LC_NOX_SENS_ERR_MAN_2 FORMAT "%2.0" /end CHARACTERISTIC
/begin CHARACTERISTIC c_vls_nox_sens_2 "Manual binary O2 value" VALUE 0xffe41b8a _REC_VAL_20_u2 1400. _CNV_A_R_LINEAR_____105_CM -200. 1200. DISPLAY_IDENTIFIER C_VLS_NOX_SENS_2 FORMAT "%4.0" /end CHARACTERISTIC
/begin CHARACTERISTIC c_err_nox_sens_1 "Manual value for error byte" VALUE 0xffe40724 _REC_VAL_20_u1 255. _CNV_A_R_LINEAR_____0_CM 0. 255. DISPLAY_IDENTIFIER C_ERR_NOX_SENS_1 FORMAT "%3.0" /end CHARACTERISTIC
/begin CHARACTERISTIC c_err_nox_sens_2 "Manual value for error byte" VALUE 0xffe40725 _REC_VAL_20_u1 255. _CNV_A_R_LINEAR_____0_CM 0. 255. DISPLAY_IDENTIFIER C_ERR_NOX_SENS_2 FORMAT "%3.0" /end CHARACTERISTIC
/begin CHARACTERISTIC c_lamb_nox_sens_1 "Manual Lambda value" VALUE 0xffe416c6 _REC_VAL_20_u2 31.99902344 _CNV_A_R_LINEAR_____206_CM 0. 31.99902344 DISPLAY_IDENTIFIER C_LAMB_NOX_SENS_1 FORMAT "%7.4" /end CHARACTERISTIC
/begin CHARACTERISTIC c_lamb_nox_sens_2 "Manual Lambda value" VALUE 0xffe416c8 _REC_VAL_20_u2 31.99902344 _CNV_A_R_LINEAR_____206_CM 0. 31.99902344 DISPLAY_IDENTIFIER C_LAMB_NOX_SENS_2 FORMAT "%7.4" /end CHARACTERISTIC
/begin CHARACTERISTIC c_nox_nox_sens_2 "Manual NOx concentration value" VALUE 0xffe4048a _REC_VAL_20_s2 1600.000000000001 _CNV_A_R_LINEAR_____429_CM -100.000000000001 1500. DISPLAY_IDENTIFIER C_NOX_NOX_SENS_2 FORMAT "%4.0" /end CHARACTERISTIC
/begin MEASUREMENT nox_nox_sens_diag_1 "NOx concentration value, measured by NOx-Sensor" SWORD _CNV_A_R_LINEAR_____429_CM 1 100. -100.000000000001 1500. DISPLAY_IDENTIFIER NOX_NOX_SENS_DIAG_1 ECU_ADDRESS 0x3fcbcc BYTE_ORDER MSB_LAST FORMAT "%4.0" /end MEASUREMENT
/begin MEASUREMENT nox_nox_sens_diag_2 "NOx concentration value, measured by NOx-Sensor" SWORD _CNV_A_R_LINEAR_____429_CM 1 100. -100.000000000001 1500. DISPLAY_IDENTIFIER NOX_NOX_SENS_DIAG_2 ECU_ADDRESS 0x3fcbd0 BYTE_ORDER MSB_LAST FORMAT "%4.0" /end MEASUREMENT
/begin CHARACTERISTIC lc_nox_sens_vls_man_2 "Manual setting of binary O2 value on/ off" VALUE 0xffe40fbf _REC_VAL_20_u1 1. _CNV_A_R_LINEAR_____0_CM 0. 1. DISPLAY_IDENTIFIER LC_NOX_SENS_VLS_MAN_2 FORMAT "%2.0" /end CHARACTERISTIC
/begin CHARACTERISTIC lc_nox_sens_nox_vld_2 "Permanently authorisation NOx signal on/ off" VALUE 0xffe40fbc _REC_VAL_20_u1 1. _CNV_A_R_LINEAR_____0_CM 0. 1. DISPLAY_IDENTIFIER LC_NOX_SENS_NOX_VLD_2 FORMAT "%2.0" /end CHARACTERISTIC
/begin CHARACTERISTIC c_crlc_nox_nox_sens "Correlation constant for NOx signal filter" VALUE 0xffe41568 _REC_VAL_20_u2 0.999755 _CNV_A_R_LINEAR_____126_CM 0. 0.999755 DISPLAY_IDENTIFIER C_CRLC_NOX_NOX_SENS FORMAT "%7.5" /end CHARACTERISTIC
/begin CHARACTERISTIC lc_nox_sens_nox_vld_1 "Permanently authorisation NOx signal on/ off" VALUE 0xffe40fbb _REC_VAL_20_u1 1. _CNV_A_R_LINEAR_____0_CM 0. 1. DISPLAY_IDENTIFIER LC_NOX_SENS_NOX_VLD_1 FORMAT "%2.0" /end CHARACTERISTIC
/begin CHARACTERISTIC lc_nox_sens_lamb_vld_2 "Permanently authorisation Lambda signal on/ off" VALUE 0xffe40fb8 _REC_VAL_20_u1 1. _CNV_A_R_LINEAR_____0_CM 0. 1. DISPLAY_IDENTIFIER LC_NOX_SENS_LAMB_VLD_2 FORMAT "%2.0" /end CHARACTERISTIC
/begin CHARACTERISTIC c_t_nox_sens_nox_hld "Permanently authorisation NOx signal on/ off" VALUE 0xffe419c8 _REC_VAL_20_u2 327.67 _CNV_A_R_LINEAR_____4_CM 0. 327.67 DISPLAY_IDENTIFIER C_T_NOX_SENS_NOX_HLD FORMAT "%6.2" /end CHARACTERISTIC
/begin CHARACTERISTIC lc_nox_sens_lamb_vld_1 "Permanently authorisation Lambda signal on/ off" VALUE 0xffe40fb7 _REC_VAL_20_u1 1. _CNV_A_R_LINEAR_____0_CM 0. 1. DISPLAY_IDENTIFIER LC_NOX_SENS_LAMB_VLD_1 FORMAT "%2.0" /end CHARACTERISTIC
/begin CHARACTERISTIC lc_nox_sens_vls_vld_1 "Permanently authorisation binary O2 signal on/ off" VALUE 0xffe40fc0 _REC_VAL_20_u1 1. _CNV_A_R_LINEAR_____0_CM 0. 1. DISPLAY_IDENTIFIER LC_NOX_SENS_VLS_VLD_1 FORMAT "%2.0" /end CHARACTERISTIC
/begin CHARACTERISTIC lc_nox_sens_vls_vld_2 "Permanently authorisation binary O2 signal on/ off" VALUE 0xffe40fc1 _REC_VAL_20_u1 1. _CNV_A_R_LINEAR_____0_CM 0. 1. DISPLAY_IDENTIFIER LC_NOX_SENS_VLS_VLD_2 FORMAT "%2.0" /end CHARACTERISTIC
/begin CHARACTERISTIC c_t_nox_sens_lamb_hld "Max. time of hold the last valid Lambda signal value" VALUE 0xffe419c2 _REC_VAL_20_u2 327.67 _CNV_A_R_LINEAR_____4_CM 0. 327.67 DISPLAY_IDENTIFIER C_T_NOX_SENS_LAMB_HLD FORMAT "%6.2" /end CHARACTERISTIC
/begin CHARACTERISTIC c_t_nox_sens_vls_hld "Max. time of hold the last valid binary O2 signal value" VALUE 0xffe419cc _REC_VAL_20_u2 327.67 _CNV_A_R_LINEAR_____4_CM 0. 327.67 DISPLAY_IDENTIFIER C_T_NOX_SENS_VLS_HLD FORMAT "%6.2" /end CHARACTERISTIC
/begin CHARACTERISTIC c_nox_nox_sens_1 "Manual NOx concentration value" VALUE 0xffe40488 _REC_VAL_20_s2 1600.000000000001 _CNV_A_R_LINEAR_____429_CM -100.000000000001 1500. DISPLAY_IDENTIFIER C_NOX_NOX_SENS_1 FORMAT "%4.0" /end CHARACTERISTIC
/begin CHARACTERISTIC c_t_nox_sens_nox_auth " Min. time of full Nox-Sensor readiness to set the NOx signal authorisation bit " VALUE 0xffe419c6 _REC_VAL_20_u2 327.67 _CNV_A_R_LINEAR_____4_CM 0. 327.67 DISPLAY_IDENTIFIER C_T_NOX_SENS_NOX_AUTH FORMAT "%6.2" /end CHARACTERISTIC
/begin CHARACTERISTIC lc_inh_diag_cat_diag_nox_deac "Manual deactivation of cat diagnosis inhibition condition" VALUE 0xffe40f70 _REC_VAL_20_u1 1. _CNV_S_2_RANGE______2_CM 0. 1. DISPLAY_IDENTIFIER LC_INH_DIAG_CAT_DIAG_NOX_DEAC /end CHARACTERISTIC
/begin CHARACTERISTIC ip_fac_tq_loss_acc_on "TQ_LOSS_ACC weighting factor at ACC activation" MAP 0xffe4599c _REC_MAP_20_u1_u1_u1 1.99220002 _CNV_A_R_LINEAR_____39_CM 0. 1.99220002 DISPLAY_IDENTIFIER IP_FAC_TQ_LOSS_ACC_ON FORMAT "%5.3"
 /begin AXIS_DESCR COM_AXIS t_acc _CNV_A_R_LINEAR_____4_CM 8 0. 2.55 FORMAT "%4.2" AXIS_PTS_REF ldp_t_acc_ip_fac_tq_loss_acc_on /end AXIS_DESCR
 /begin AXIS_DESCR COM_AXIS n_32 _CNV_A_R_LINEAR_____15_CM 8 0. 8160. FORMAT "%4.0" AXIS_PTS_REF ldp_n_32_ip_fac_tq_loss_acc_on /end AXIS_DESCR
/end CHARACTERISTIC
/begin CHARACTERISTIC ip_fac_tq_loss_acc_off "TQ_LOSS_ACC weighting factor at ACC deactivation" CURVE 0xffe40c41 _REC_CUR_20_u1_u1 1.99220002 _CNV_A_R_LINEAR_____39_CM 0. 1.99220002 DISPLAY_IDENTIFIER IP_FAC_TQ_LOSS_ACC_OFF FORMAT "%5.3"
 /begin AXIS_DESCR COM_AXIS t_acc _CNV_A_R_LINEAR_____4_CM 8 0. 2.55 FORMAT "%4.2" AXIS_PTS_REF ldp_t_acc_fac_tq_loss_acc /end AXIS_DESCR
/end CHARACTERISTIC
/begin MEASUREMENT tq_add_acc "Torque reserve for switching on air conditioning compressor" SWORD _CNV_A_R_LINEAR_____55_CM 1 100. -1024. 1023.96875 DISPLAY_IDENTIFIER TQ_ADD_ACC ECU_ADDRESS 0x3fddee BYTE_ORDER MSB_LAST FORMAT "%7.1" /end MEASUREMENT
/begin MEASUREMENT tq_loss_acc "Engine torque losses air conditioning compressor" SWORD _CNV_A_R_LINEAR_____55_CM 1 100. -1024. 1023.96875 DISPLAY_IDENTIFIER TQ_LOSS_ACC ECU_ADDRESS 0x3fddec BYTE_ORDER MSB_LAST FORMAT "%8.2" /end MEASUREMENT
/begin MEASUREMENT tq_add_heat_acc "Torque reserve for switching on additional heating by ACC" SWORD _CNV_A_R_LINEAR_____55_CM 1 100. -1024. 1023.96875 DISPLAY_IDENTIFIER TQ_ADD_HEAT_ACC ECU_ADDRESS 0x3fddf0 BYTE_ORDER MSB_LAST FORMAT "%8.2" /end MEASUREMENT
/begin MEASUREMENT lv_tout_acc "logical variable to start deactivation of torque reserve and condition for switch off TQ_LOSS_ACC calculation" UBYTE _CNV_S_2_RANGE______2_CM 1 100. 0. 1. DISPLAY_IDENTIFIER LV_TOUT_ACC ECU_ADDRESS 0x3fe8f2 /end MEASUREMENT
/begin MEASUREMENT lv_req_heat_acc_ena "LV indicating that the conditions for additional heating are fulfilled" UBYTE _CNV_S_2_RANGE______2_CM 1 100. 0. 1. DISPLAY_IDENTIFIER LV_REQ_HEAT_ACC_ENA ECU_ADDRESS 0x3feaf1 /end MEASUREMENT
/begin MEASUREMENT lv_tout_req_heat_acc "logical variable to start deactivation of torque reserve TQ_ADD_HEAT_ACC" UBYTE _CNV_S_2_RANGE______2_CM 1 100. 0. 1. DISPLAY_IDENTIFIER LV_TOUT_REQ_HEAT_ACC ECU_ADDRESS 0x3feaf2 /end MEASUREMENT
/begin MEASUREMENT t_req_heat_acc "timer for duration of torque reserve TQ_ADD_HEAT_ACC calculation" UBYTE _CNV_A_R_LINEAR_____4_CM 1 100. 0. 2.55 DISPLAY_IDENTIFIER T_REQ_HEAT_ACC ECU_ADDRESS 0x3feaf0 FORMAT "%4.2" /end MEASUREMENT
/begin CHARACTERISTIC ip_tq_add_acc "Torque reserve for switching on air conditioning compressor" MAP 0xffe4f822 _REC_MAP_20_u2_u1_u2 2047.96875 _CNV_A_R_LINEAR_____187_CM -1024. 1023.96875 DISPLAY_IDENTIFIER IP_TQ_ADD_ACC FORMAT "%6.2"
 /begin AXIS_DESCR COM_AXIS n_32 _CNV_A_R_LINEAR_____15_CM 6 0. 8160. FORMAT "%4.0" AXIS_PTS_REF ldp_n_32__tq_add_acc /end AXIS_DESCR
 /begin AXIS_DESCR COM_AXIS tq_loss_acc_inp _CNV_A_R_LINEAR_____187_CM 6 -1024. 1023.96875 FORMAT "%6.2" AXIS_PTS_REF ldp_tq_loss_acc_inp__tq_add_acc /end AXIS_DESCR
/end CHARACTERISTIC
/begin CHARACTERISTIC ip_tq_add_heat_acc "Torque reserve for switching on additional heating" CURVE 0xffe4f95a _REC_CUR_20_u2_u1 2047.96875 _CNV_A_R_LINEAR_____187_CM -1024. 1023.96875 DISPLAY_IDENTIFIER IP_TQ_ADD_HEAT_ACC FORMAT "%6.2"
 /begin AXIS_DESCR COM_AXIS n_32 _CNV_A_R_LINEAR_____15_CM 6 0. 8160. FORMAT "%4.0" AXIS_PTS_REF ldp_n_32__tq_add_heat_acc /end AXIS_DESCR
/end CHARACTERISTIC
/begin CHARACTERISTIC c_tq_add_acc_lgrd "Limitation gradiant for TQ_ADD_ACC decrease after deactivation" VALUE 0xffe41ac4 _REC_VAL_20_u2 1023.96875 _CNV_A_R_LINEAR_____55_CM 0. 1023.96875 DISPLAY_IDENTIFIER C_TQ_ADD_ACC_LGRD FORMAT "%7.2" /end CHARACTERISTIC
/begin CHARACTERISTIC c_tq_add_heat_acc_lgrd "Limitation gradient for TQ_ADD_HEAT_ACC decrease after deactivation" VALUE 0xffe41acc _REC_VAL_20_u2 1023.96875 _CNV_A_R_LINEAR_____55_CM 0. 1023.96875 DISPLAY_IDENTIFIER C_TQ_ADD_HEAT_ACC_LGRD FORMAT "%7.2" /end CHARACTERISTIC
/begin CHARACTERISTIC c_tco_min_req_heat_acc "TCO threshold for enabling additional heat request" VALUE 0xffe4091f _REC_VAL_20_u1 190.5 _CNV_A_R_LINEAR_____11_CM -48. 142.5 DISPLAY_IDENTIFIER C_TCO_MIN_REQ_HEAT_ACC FORMAT "%5.1" /end CHARACTERISTIC
/begin CHARACTERISTIC c_tam_min_req_heat_acc "TAM threshold for enabling additional heat request" VALUE 0xffe408dd _REC_VAL_20_u1 190.5 _CNV_A_R_LINEAR_____11_CM -48. 142.5 DISPLAY_IDENTIFIER C_TAM_MIN_REQ_HEAT_ACC FORMAT "%5.1" /end CHARACTERISTIC
/begin CHARACTERISTIC c_tq_loss_max_acc "Maximum TQ_LOSS_ACC" VALUE 0xffe404d8 _REC_VAL_20_s2 2047.96875 _CNV_A_R_LINEAR_____55_CM -1024. 1023.96875 DISPLAY_IDENTIFIER C_TQ_LOSS_MAX_ACC FORMAT "%8.2" /end CHARACTERISTIC
/begin AXIS_PTS ldp_t_acc_ip_fac_tq_loss_acc_on "" 0xffe4819e t_acc _REC_AXS_20_u1 2.55 _CNV_A_R_LINEAR_____4_CM 8 0. 2.55 DISPLAY_IDENTIFIER LDP_T_ACC_IP_FAC_TQ_LOSS_ACC_ON FORMAT "%4.2" /end AXIS_PTS
/begin AXIS_PTS ldp_n_32_ip_fac_tq_loss_acc_on "" 0xffe480be n_32 _REC_AXS_20_u1 8160. _CNV_A_R_LINEAR_____15_CM 8 0. 8160. DISPLAY_IDENTIFIER LDP_N_32_IP_FAC_TQ_LOSS_ACC_ON FORMAT "%4.0" /end AXIS_PTS
/begin AXIS_PTS ldp_n_32__tq_add_acc "" 0xffe410b0 n_32 _REC_AXS_20_u1 8160. _CNV_A_R_LINEAR_____15_CM 6 0. 8160. DISPLAY_IDENTIFIER LDP_N_32__TQ_ADD_ACC FORMAT "%4.0" /end AXIS_PTS
/begin AXIS_PTS ldp_t_acc_fac_tq_loss_acc "" 0xffe48195 t_acc _REC_AXS_20_u1 2.55 _CNV_A_R_LINEAR_____4_CM 8 0. 2.55 DISPLAY_IDENTIFIER LDP_T_ACC_FAC_TQ_LOSS_ACC FORMAT "%4.2" /end AXIS_PTS
/begin AXIS_PTS ldp_n_32__tq_add_heat_acc "" 0xffe410b7 n_32 _REC_AXS_20_u1 8160. _CNV_A_R_LINEAR_____15_CM 6 0. 8160. DISPLAY_IDENTIFIER LDP_N_32__TQ_ADD_HEAT_ACC FORMAT "%4.0" /end AXIS_PTS
/begin MEASUREMENT tq_loss_acc_inp "ACC-torque for torque function" SWORD _CNV_A_R_LINEAR_____55_CM 1 100. -1024. 1023.96875 DISPLAY_IDENTIFIER TQ_LOSS_ACC_INP ECU_ADDRESS 0x3fddf2 BYTE_ORDER MSB_LAST FORMAT "%8.2" /end MEASUREMENT
/begin CHARACTERISTIC c_crlc_tq_loss_acc_inp "Correlation factor for TQ_ACCIN_CAN calculation" VALUE 0xffe40697 _REC_VAL_20_u1 0.9960940000000002 _CNV_A_R_LINEAR_____50_CM 0. 0.996094 DISPLAY_IDENTIFIER C_CRLC_TQ_LOSS_ACC_INP FORMAT "%5.3" /end CHARACTERISTIC
/begin AXIS_PTS ldp_tq_loss_acc_inp__tq_add_acc "" 0xffe5145c tq_loss_acc_inp _REC_AXS_20_u2 2047.96875 _CNV_A_R_LINEAR_____187_CM 6 -1024. 1023.96875 DISPLAY_IDENTIFIER LDP_TQ_LOSS_ACC_INP__TQ_ADD_ACC FORMAT "%6.2" /end AXIS_PTS
/begin CHARACTERISTIC c_tq_add_acc_lgrd_on "Limitation gradiant for TQ_ADD_ACC increase at activation" VALUE 0xffe41ac6 _REC_VAL_20_u2 1023.96875 _CNV_A_R_LINEAR_____55_CM 0. 1023.96875 DISPLAY_IDENTIFIER C_TQ_ADD_ACC_LGRD_ON FORMAT "%7.2" /end CHARACTERISTIC
/begin CHARACTERISTIC c_fil_aj_inp_0 "Filter constant 0 applied on input value of second order low pass filter" VALUE 0xffe40408 _REC_VAL_20_s2 3.125e-002 _CNV_A_R_LINEAR_____509_CM -1.5625e-002 1.5625e-002 DISPLAY_IDENTIFIER C_FIL_AJ_INP_0 FORMAT "%6.5" /end CHARACTERISTIC
/begin CHARACTERISTIC c_fil_aj_inp_1 "Filter constant 1 applied on input value of second order low pass filter" VALUE 0xffe4040a _REC_VAL_20_s2 3.125e-002 _CNV_A_R_LINEAR_____509_CM -1.5625e-002 1.5625e-002 DISPLAY_IDENTIFIER C_FIL_AJ_INP_1 FORMAT "%6.5" /end CHARACTERISTIC
/begin CHARACTERISTIC c_fil_aj_inp_2 "Filter constant 2 applied on input value of second order low pass filter" VALUE 0xffe4040c _REC_VAL_20_s2 3.125e-002 _CNV_A_R_LINEAR_____509_CM -1.5625e-002 1.5625e-002 DISPLAY_IDENTIFIER C_FIL_AJ_INP_2 FORMAT "%6.5" /end CHARACTERISTIC
/begin CHARACTERISTIC c_fil_aj_out_1 "Filter constant 1 applied in output value of second order low pass filter" VALUE 0xffe4040e _REC_VAL_20_s2 3.999938965 _CNV_A_R_LINEAR_____276_CM -2. 1.999938965 DISPLAY_IDENTIFIER C_FIL_AJ_OUT_1 FORMAT "%8.4" /end CHARACTERISTIC
/begin CHARACTERISTIC c_fil_aj_out_2 "Filter constant 2 applied on output value of second order low pass filter" VALUE 0xffe40410 _REC_VAL_20_s2 3.999938965 _CNV_A_R_LINEAR_____276_CM -2. 1.999938965 DISPLAY_IDENTIFIER C_FIL_AJ_OUT_2 FORMAT "%8.4" /end CHARACTERISTIC
/begin CHARACTERISTIC id_fac_inv_veh_mass_at "Inverse vehicle mass equivalent for automatic transmission" CURVE 0xffe48754 _REC_CUR_20_u2_u1 0.99998474 _CNV_A_R_LINEAR_____510_CM 0. 0.99998474 DISPLAY_IDENTIFIER ID_FAC_INV_VEH_MASS_AT FORMAT "%6.4"
 /begin AXIS_DESCR COM_AXIS gr_at _CNV_A_R_LINEAR_____0_CM 13 0. 255. FORMAT "%3.0" AXIS_PTS_REF ldpm_gr_at_100 /end AXIS_DESCR
/end CHARACTERISTIC
/begin CHARACTERISTIC id_fac_inv_veh_mass_mt "Inverse vehicle mass equivalent for manual transmission" CURVE 0xffe4876e _REC_CUR_20_u2_u1 0.99998474 _CNV_A_R_LINEAR_____510_CM 0. 0.99998474 DISPLAY_IDENTIFIER ID_FAC_INV_VEH_MASS_MT FORMAT "%6.4"
 /begin AXIS_DESCR COM_AXIS gr_mt _CNV_A_R_LINEAR_____0_CM 13 0. 255. FORMAT "%3.0" AXIS_PTS_REF ldpm_gr_mt_100 /end AXIS_DESCR
/end CHARACTERISTIC
/begin CHARACTERISTIC id_fac_tq_de_aj_at "Torque deviation compensation factor for AJ  N_DIF_REF determination" CURVE 0xffe487cc _REC_CUR_20_u2_u1 7.99987793 _CNV_A_R_LINEAR_____424_CM 0. 7.99987793 DISPLAY_IDENTIFIER ID_FAC_TQ_DE_AJ_AT FORMAT "%6.4"
 /begin AXIS_DESCR COM_AXIS gr_at _CNV_A_R_LINEAR_____0_CM 13 0. 255. FORMAT "%3.0" AXIS_PTS_REF ldpm_gr_at_100 /end AXIS_DESCR
/end CHARACTERISTIC
/begin CHARACTERISTIC id_fac_tq_de_aj_mt "Engine speed difference threshold for acitvation anti jerk function" CURVE 0xffe487e6 _REC_CUR_20_u2_u1 7.99987793 _CNV_A_R_LINEAR_____424_CM 0. 7.99987793 DISPLAY_IDENTIFIER ID_FAC_TQ_DE_AJ_MT FORMAT "%6.4"
 /begin AXIS_DESCR COM_AXIS gr_mt _CNV_A_R_LINEAR_____0_CM 13 0. 255. FORMAT "%3.0" AXIS_PTS_REF ldpm_gr_mt_100 /end AXIS_DESCR
/end CHARACTERISTIC
/begin MEASUREMENT n_dif_aj "engine-speed deviation at jerking vehicle" SWORD _CNV_A_R_LINEAR_____10_CM 1 100. -32768. 32767. DISPLAY_IDENTIFIER N_DIF_AJ ECU_ADDRESS 0x3fdf16 BYTE_ORDER MSB_LAST FORMAT "%6.0" /end MEASUREMENT
/begin MEASUREMENT n_dif_ref_lpf_aj "low-pass filtered N_DIF_REF_AJ for AJ function " SWORD _CNV_A_R_LINEAR_____511_CM 1 100. -512. 511.98 DISPLAY_IDENTIFIER N_DIF_REF_LPF_AJ ECU_ADDRESS 0x3fdf1a BYTE_ORDER MSB_LAST FORMAT "%7.2" /end MEASUREMENT
/begin MEASUREMENT tq_dif_aj "Torque output for anti  jerk " SWORD _CNV_A_R_LINEAR_____55_CM 1 100. -1024. 1023.96875 DISPLAY_IDENTIFIER TQ_DIF_AJ ECU_ADDRESS 0x3fdf14 BYTE_ORDER MSB_LAST FORMAT "%6.2" /end MEASUREMENT
/begin MEASUREMENT tq_fast_clu "fast torque request at clutch" SWORD _CNV_A_R_LINEAR_____55_CM 1 100. -1024. 1023.96875 DISPLAY_IDENTIFIER TQ_FAST_CLU ECU_ADDRESS 0x3fdf1c BYTE_ORDER MSB_LAST FORMAT "%6.2" /end MEASUREMENT
/begin MEASUREMENT tq_mdl_de_aj "torque deviation compensation for AJ" SWORD _CNV_A_R_LINEAR_____55_CM 1 100. -1024. 1023.96875 DISPLAY_IDENTIFIER TQ_MDL_DE_AJ ECU_ADDRESS 0x3fdf1e BYTE_ORDER MSB_LAST FORMAT "%6.2" /end MEASUREMENT
/begin MEASUREMENT n_ref_aj "reference engine-speed for anti-jerk function" SWORD _CNV_A_R_LINEAR_____10_CM 1 100. -32768. 32767. DISPLAY_IDENTIFIER N_REF_AJ ECU_ADDRESS 0x3fd024 BYTE_ORDER MSB_LAST FORMAT "%6.0" /end MEASUREMENT
/begin CHARACTERISTIC c_n_dif_ref_aj_max "Maximum limitation of N_DIF_REF_AJ" VALUE 0xffe40480 _REC_VAL_20_s2 65535. _CNV_A_R_LINEAR_____10_CM -32768. 32767. DISPLAY_IDENTIFIER C_N_DIF_REF_AJ_MAX FORMAT "%6.0" /end CHARACTERISTIC
/begin CHARACTERISTIC c_n_dif_ref_aj_min "Minimum limitation of N_DIF_REF_AJ" VALUE 0xffe40482 _REC_VAL_20_s2 65535. _CNV_A_R_LINEAR_____10_CM -32768. 32767. DISPLAY_IDENTIFIER C_N_DIF_REF_AJ_MIN FORMAT "%6.0" /end CHARACTERISTIC
/begin MEASUREMENT n_dif_ref_aj "limited reference engine-speed deviation for anti-jerk function" SWORD _CNV_A_R_LINEAR_____10_CM 1 100. -32768. 32767. DISPLAY_IDENTIFIER N_DIF_REF_AJ ECU_ADDRESS 0x3fdf18 BYTE_ORDER MSB_LAST FORMAT "%6.0" /end MEASUREMENT
/begin MEASUREMENT n_dif_ref_aj_inter "reference engine-speed deviation for anti-jerk function without limitation" SWORD _CNV_A_R_LINEAR_____10_CM 1 100. -32768. 32767. DISPLAY_IDENTIFIER N_DIF_REF_AJ_INTER ECU_ADDRESS 0x3fdf20 BYTE_ORDER MSB_LAST FORMAT "%6.0" /end MEASUREMENT
/begin CHARACTERISTIC ip_fac_tq_aj "Torque conversion factor for anti-jerk funktion" MAP 0xffe4b74a _REC_MAP_20_u2_u1_u1 4. _CNV_A_R_LINEAR_____275_CM -2. 2. DISPLAY_IDENTIFIER IP_FAC_TQ_AJ FORMAT "%8.5"
 /begin AXIS_DESCR COM_AXIS n_32 _CNV_A_R_LINEAR_____15_CM 8 0. 8160. FORMAT "%4.0" AXIS_PTS_REF ldp_n_32__fac_tq_aj /end AXIS_DESCR
 /begin AXIS_DESCR COM_AXIS gear _CNV_A_R_LINEAR_____0_CM 6 0. 6. FORMAT "%1.0" AXIS_PTS_REF ldp_gear__fac_tq_aj /end AXIS_DESCR
/end CHARACTERISTIC
/begin AXIS_PTS ldpm_gr_at_100 "" 0xffe4839d gr_at _REC_AXS_20_u1 255. _CNV_A_R_LINEAR_____0_CM 13 0. 255. DISPLAY_IDENTIFIER LDPM_GR_AT_100 FORMAT "%3.0" /end AXIS_PTS
/begin AXIS_PTS ldpm_gr_mt_100 "" 0xffe483b9 gr_mt _REC_AXS_20_u1 255. _CNV_A_R_LINEAR_____0_CM 13 0. 255. DISPLAY_IDENTIFIER LDPM_GR_MT_100 FORMAT "%3.0" /end AXIS_PTS
/begin AXIS_PTS ldp_n_32__fac_tq_aj "" 0xffe48015 n_32 _REC_AXS_20_u1 8160. _CNV_A_R_LINEAR_____15_CM 8 0. 8160. DISPLAY_IDENTIFIER LDP_N_32__FAC_TQ_AJ FORMAT "%4.0" /end AXIS_PTS
/begin AXIS_PTS ldp_gear__fac_tq_aj "" 0xffe4104b gear _REC_AXS_20_u1 6. _CNV_A_R_LINEAR_____0_CM 6 0. 6. DISPLAY_IDENTIFIER LDP_GEAR__FAC_TQ_AJ FORMAT "%1.0" /end AXIS_PTS
/begin CHARACTERISTIC c_t_pas_aj_dly "Delay time after closed drivetrain determination for PT2 filter actualisation" VALUE 0xffe408c1 _REC_VAL_20_u1 2.55 _CNV_A_R_LINEAR_____4_CM 0. 2.55 DISPLAY_IDENTIFIER C_T_PAS_AJ_DLY FORMAT "%3.2" /end CHARACTERISTIC
/begin MEASUREMENT tq_conv_can_1 "converter torque of CAN" SWORD _CNV_A_R_LINEAR_____55_CM 1 100. -1024. 1023.96875 DISPLAY_IDENTIFIER TQ_CONV_CAN_1 ECU_ADDRESS 0x3fddf8 BYTE_ORDER MSB_LAST FORMAT "%6.2" /end MEASUREMENT
/begin MEASUREMENT tq_add_conv "Torque reserve for switching converter Torque" SWORD _CNV_A_R_LINEAR_____55_CM 1 100. -1024. 1023.96875 DISPLAY_IDENTIFIER TQ_ADD_CONV ECU_ADDRESS 0x3fddfa BYTE_ORDER MSB_LAST FORMAT "%6.2" /end MEASUREMENT
/begin MEASUREMENT lv_tout_conv "logical variable to start deactivation of torque reserve and condition for switch off TQ_CONV calculation" UBYTE _CNV_S_2_RANGE______2_CM 1 100. 0. 1. DISPLAY_IDENTIFIER LV_TOUT_CONV ECU_ADDRESS 0x3feb03 /end MEASUREMENT
/begin MEASUREMENT t_conv "timer for duration of transient TQ_LOSS_CONV correction" UWORD _CNV_A_R_LINEAR_____4_CM 1 100. 0. 5.1 DISPLAY_IDENTIFIER T_CONV ECU_ADDRESS 0x3fde04 BYTE_ORDER MSB_LAST FORMAT "%4.2" /end MEASUREMENT
/begin CHARACTERISTIC c_tq_add_conv_lgrd "Limitation gradient for TQ_ADD_CONV decrease after deactivation" VALUE 0xffe41aca _REC_VAL_20_u2 1023.96875 _CNV_A_R_LINEAR_____55_CM 0. 1023.96875 DISPLAY_IDENTIFIER C_TQ_ADD_CONV_LGRD FORMAT "%7.2" /end CHARACTERISTIC
/begin MEASUREMENT tq_add_trans "Torque reserve for Transmission" SWORD _CNV_A_R_LINEAR_____55_CM 1 100. -1024. 1023.96875 DISPLAY_IDENTIFIER TQ_ADD_TRANS ECU_ADDRESS 0x3fddfe BYTE_ORDER MSB_LAST FORMAT "%8.2" /end MEASUREMENT
/begin CHARACTERISTIC ip_tq_add_conv "Torque reserve for switch GS" MAP 0xffe4f876 _REC_MAP_20_u2_u1_u1 2047.96875 _CNV_A_R_LINEAR_____187_CM -1024. 1023.96875 DISPLAY_IDENTIFIER IP_TQ_ADD_CONV FORMAT "%6.2"
 /begin AXIS_DESCR COM_AXIS n_32 _CNV_A_R_LINEAR_____15_CM 6 0. 8160. FORMAT "%4.0" AXIS_PTS_REF ldp_n_32_ip_tq_add_conv /end AXIS_DESCR
 /begin AXIS_DESCR COM_AXIS toil _CNV_A_R_LINEAR_____14_CM 6 -40. 160. FORMAT "%3.0" AXIS_PTS_REF ldpm_toil_tq_add_conv /end AXIS_DESCR
/end CHARACTERISTIC
/begin MEASUREMENT lv_dly_n_sp_is "Flag for idle speed setpoint change" UBYTE _CNV_S_2_RANGE______21_CM 1 100. 0. 1. DISPLAY_IDENTIFIER LV_DLY_N_SP_IS ECU_ADDRESS 0x3feb02 BIT_MASK 0x1 /end MEASUREMENT
/begin MEASUREMENT tq_conv_stn "Stationary Converter Torque" SWORD _CNV_A_R_LINEAR_____55_CM 1 100. -1024. 1023.96875 DISPLAY_IDENTIFIER TQ_CONV_STN ECU_ADDRESS 0x3fde0c BYTE_ORDER MSB_LAST FORMAT "%6.2" /end MEASUREMENT
/begin CHARACTERISTIC lc_tq_conv_dri_inh "logical constant converter torque calculation at LV_DRI = 0 inhibit" VALUE 0xffe40fe9 _REC_VAL_20_u1 1. _CNV_A_R_LINEAR_____0_CM 0. 1. DISPLAY_IDENTIFIER LC_TQ_CONV_DRI_INH FORMAT "%2.0" /end CHARACTERISTIC
/begin CHARACTERISTIC lc_tq_conv_can_inh "logical constant converter torque by CAN-interface inhibit" VALUE 0xffe40fe8 _REC_VAL_20_u1 1. _CNV_A_R_LINEAR_____0_CM 0. 1. DISPLAY_IDENTIFIER LC_TQ_CONV_CAN_INH FORMAT "%2.0" /end CHARACTERISTIC
/begin CHARACTERISTIC ip_fac_conv__toil "Converter characteristic" CURVE 0xffe4ae4a _REC_CUR_20_u2_u1 4.88e-004 _CNV_A_R_LINEAR_____512_CM 0. 4.88e-004 DISPLAY_IDENTIFIER IP_FAC_CONV__TOIL FORMAT "%8.7"
 /begin AXIS_DESCR COM_AXIS toil _CNV_A_R_LINEAR_____14_CM 8 -40. 160. FORMAT "%3.0" AXIS_PTS_REF ldp_toil_fac_conv /end AXIS_DESCR
/end CHARACTERISTIC
/begin CHARACTERISTIC ip_fac_conv_dri__toil "Converter characteristic" CURVE 0xffe4ae5a _REC_CUR_20_u2_u1 4.88e-004 _CNV_A_R_LINEAR_____512_CM 0. 4.88e-004 DISPLAY_IDENTIFIER IP_FAC_CONV_DRI__TOIL FORMAT "%8.7"
 /begin AXIS_DESCR COM_AXIS toil _CNV_A_R_LINEAR_____14_CM 8 -40. 160. FORMAT "%3.0" AXIS_PTS_REF ldp_toil_fac_conv /end AXIS_DESCR
/end CHARACTERISTIC
/begin CHARACTERISTIC ip_t_dly_conv__toil "Time delay for TQ_CONV activation" CURVE 0xffe40e1c _REC_CUR_20_u1_u1 2550. _CNV_A_R_LINEAR_____31_CM 0. 2550. DISPLAY_IDENTIFIER IP_T_DLY_CONV__TOIL FORMAT "%4.0"
 /begin AXIS_DESCR COM_AXIS toil _CNV_A_R_LINEAR_____14_CM 8 -40. 160. FORMAT "%3.0" AXIS_PTS_REF ldp_toil_t_dly_conv /end AXIS_DESCR
/end CHARACTERISTIC
/begin CHARACTERISTIC ip_t_dly_n_sp_is__toil "Time delay for change of idle speed setpoint " CURVE 0xffe40e24 _REC_CUR_20_u1_u1 2550. _CNV_A_R_LINEAR_____31_CM 0. 2550. DISPLAY_IDENTIFIER IP_T_DLY_N_SP_IS__TOIL FORMAT "%4.0"
 /begin AXIS_DESCR COM_AXIS toil _CNV_A_R_LINEAR_____14_CM 8 -40. 160. FORMAT "%3.0" AXIS_PTS_REF ldp_toil_t_dly_n_sp_is /end AXIS_DESCR
/end CHARACTERISTIC
/begin CHARACTERISTIC ip_fac_tq_conv__n_ratio_conv "Torque request factor" CURVE 0xffe4b7aa _REC_CUR_20_u2_u1 1.99996948 _CNV_A_R_LINEAR_____20_CM 0. 1.99996948 DISPLAY_IDENTIFIER IP_FAC_TQ_CONV__N_RATIO_CONV FORMAT "%7.5"
 /begin AXIS_DESCR COM_AXIS n_ratio_conv _CNV_A_R_LINEAR_____50_CM 8 0. 0.996094 FORMAT "%5.3" AXIS_PTS_REF ldp_n_ratio_conv_fac_tq_conv /end AXIS_DESCR
/end CHARACTERISTIC
/begin MEASUREMENT tq_conv "Converter Torque" SWORD _CNV_A_R_LINEAR_____55_CM 1 100. -1024. 1023.96875 DISPLAY_IDENTIFIER TQ_CONV ECU_ADDRESS 0x3fddf6 BYTE_ORDER MSB_LAST FORMAT "%6.2" /end MEASUREMENT
/begin CHARACTERISTIC ip_n_tur__gr_at__vs "Turbine speed" MAP 0xffe4d752 _REC_MAP_20_u2_u1_u1 65535. _CNV_A_R_LINEAR_____10_CM 0. 65535. DISPLAY_IDENTIFIER IP_N_TUR__GR_AT__VS FORMAT "%5.0"
 /begin AXIS_DESCR COM_AXIS gr_at _CNV_A_R_LINEAR_____0_CM 13 0. 8. FORMAT "%1.0" AXIS_PTS_REF ldp_gr_at_n_tur /end AXIS_DESCR
 /begin AXIS_DESCR COM_AXIS vs _CNV_A_R_LINEAR_____23_CM 2 0. 255. FORMAT "%3.0" AXIS_PTS_REF ldp_vs_n_tur /end AXIS_DESCR
/end CHARACTERISTIC
/begin CHARACTERISTIC ip_tq_conv_can "Corrected Converter tourque via N_32" MAP 0xffe4fa7a _REC_MAP_20_u2_u1_u2 2047.96875 _CNV_A_R_LINEAR_____187_CM -1024. 1023.96875 DISPLAY_IDENTIFIER IP_TQ_CONV_CAN FORMAT "%6.2"
 /begin AXIS_DESCR COM_AXIS n_32 _CNV_A_R_LINEAR_____15_CM 8 0. 8160. FORMAT "%4.0" AXIS_PTS_REF ldp_n_32__tq_conv /end AXIS_DESCR
 /begin AXIS_DESCR COM_AXIS tq_conv_can _CNV_A_R_LINEAR_____187_CM 8 -1024. 1023.96875 FORMAT "%6.2" AXIS_PTS_REF ldp_tq_conv_can__tq_conv /end AXIS_DESCR
/end CHARACTERISTIC
/begin AXIS_PTS ldp_n_32_ip_tq_add_conv "" 0xffe4110d n_32 _REC_AXS_20_u1 8160. _CNV_A_R_LINEAR_____15_CM 6 0. 8160. DISPLAY_IDENTIFIER LDP_N_32_IP_TQ_ADD_CONV FORMAT "%4.0" /end AXIS_PTS
/begin AXIS_PTS ldp_n_ratio_conv_fac_tq_conv "" 0xffe48150 n_ratio_conv _REC_AXS_20_u1 0.9960940000000002 _CNV_A_R_LINEAR_____50_CM 8 0. 0.996094 DISPLAY_IDENTIFIER LDP_N_RATIO_CONV_FAC_TQ_CONV FORMAT "%5.3" /end AXIS_PTS
/begin AXIS_PTS ldp_toil_t_dly_n_sp_is "" 0xffe482c2 toil _REC_AXS_20_u1 200. _CNV_A_R_LINEAR_____14_CM 8 -40. 160. DISPLAY_IDENTIFIER LDP_TOIL_T_DLY_N_SP_IS FORMAT "%3.0" /end AXIS_PTS
/begin AXIS_PTS ldp_toil_t_dly_conv "" 0xffe482b9 toil _REC_AXS_20_u1 200. _CNV_A_R_LINEAR_____14_CM 8 -40. 160. DISPLAY_IDENTIFIER LDP_TOIL_T_DLY_CONV FORMAT "%3.0" /end AXIS_PTS
/begin AXIS_PTS ldp_toil_fac_conv "" 0xffe482a5 toil _REC_AXS_20_u1 200. _CNV_A_R_LINEAR_____14_CM 8 -40. 160. DISPLAY_IDENTIFIER LDP_TOIL_FAC_CONV FORMAT "%3.0" /end AXIS_PTS
/begin AXIS_PTS ldp_gr_at_n_tur "" 0xffe47f32 gr_at _REC_AXS_20_u1 8. _CNV_A_R_LINEAR_____0_CM 13 0. 8. DISPLAY_IDENTIFIER LDP_GR_AT_N_TUR FORMAT "%1.0" /end AXIS_PTS
/begin AXIS_PTS ldp_n_32__tq_conv "" 0xffe480a3 n_32 _REC_AXS_20_u1 8160. _CNV_A_R_LINEAR_____15_CM 8 0. 8160. DISPLAY_IDENTIFIER LDP_N_32__TQ_CONV FORMAT "%4.0" /end AXIS_PTS
/begin AXIS_PTS ldp_vs_n_tur "" 0xffe41329 vs _REC_AXS_20_u1 255. _CNV_A_R_LINEAR_____23_CM 2 0. 255. DISPLAY_IDENTIFIER LDP_VS_N_TUR FORMAT "%3.0" /end AXIS_PTS
/begin AXIS_PTS ldp_tq_conv_can__tq_conv "" 0xffe5144a tq_conv_can _REC_AXS_20_u2 2047.96875 _CNV_A_R_LINEAR_____187_CM 8 -1024. 1023.96875 DISPLAY_IDENTIFIER LDP_TQ_CONV_CAN__TQ_CONV FORMAT "%6.2" /end AXIS_PTS
/begin AXIS_PTS ldpm_toil_tq_add_conv "" 0xffe41481 toil _REC_AXS_20_u1 200. _CNV_A_R_LINEAR_____14_CM 6 -40. 160. DISPLAY_IDENTIFIER LDPM_TOIL_TQ_ADD_CONV FORMAT "%3.0" /end AXIS_PTS
/begin AXIS_PTS ldpm_vs_tq_add_conv "" 0xffe4149d vs _REC_AXS_20_u1 255. _CNV_A_R_LINEAR_____23_CM 6 0. 255. DISPLAY_IDENTIFIER LDPM_VS_TQ_ADD_CONV FORMAT "%3.0" /end AXIS_PTS
/begin AXIS_PTS ldp_n_grd_tq_add_conv "" 0xffe41143 n_grd _REC_AXS_20_u1 8160. _CNV_A_R_LINEAR_____54_CM 6 -4096. 4064. DISPLAY_IDENTIFIER LDP_N_GRD_TQ_ADD_CONV FORMAT "%5.0" /end AXIS_PTS
/begin AXIS_PTS ldp_ac_cru_tq_add_conv "" 0xffe5094c ac_cru _REC_AXS_20_u2 31.43952 _CNV_A_R_LINEAR_____513_CM 6 -15.72 15.71952 DISPLAY_IDENTIFIER LDP_AC_CRU_TQ_ADD_CONV FORMAT "%8.4" /end AXIS_PTS
/begin CHARACTERISTIC ip_tq_add_conv_ac "Torque reserve for switch GS by AC_CRU" MAP 0xffe4f8be _REC_MAP_20_u2_u2_u1 2047.96875 _CNV_A_R_LINEAR_____187_CM -1024. 1023.96875 DISPLAY_IDENTIFIER IP_TQ_ADD_CONV_AC FORMAT "%6.2"
 /begin AXIS_DESCR COM_AXIS ac_cru _CNV_A_R_LINEAR_____513_CM 6 -15.72 15.71952 FORMAT "%8.4" AXIS_PTS_REF ldp_ac_cru_tq_add_conv /end AXIS_DESCR
 /begin AXIS_DESCR COM_AXIS vs _CNV_A_R_LINEAR_____23_CM 6 0. 255. FORMAT "%3.0" AXIS_PTS_REF ldpm_vs_tq_add_conv /end AXIS_DESCR
/end CHARACTERISTIC
/begin CHARACTERISTIC ip_tq_add_conv_n_grd "Torque reserve for switch GS by N_GRD" MAP 0xffe4f906 _REC_MAP_20_u2_u1_u1 2047.96875 _CNV_A_R_LINEAR_____187_CM -1024. 1023.96875 DISPLAY_IDENTIFIER IP_TQ_ADD_CONV_N_GRD FORMAT "%6.2"
 /begin AXIS_DESCR COM_AXIS n_grd _CNV_A_R_LINEAR_____54_CM 6 -4096. 4064. FORMAT "%5.0" AXIS_PTS_REF ldp_n_grd_tq_add_conv /end AXIS_DESCR
 /begin AXIS_DESCR COM_AXIS vs _CNV_A_R_LINEAR_____23_CM 6 0. 255. FORMAT "%3.0" AXIS_PTS_REF ldpm_vs_tq_add_conv /end AXIS_DESCR
/end CHARACTERISTIC
/begin CHARACTERISTIC ip_fac_tq_add_conv_toil "Torque reserve for switch GS" CURVE 0xffe4b73e _REC_CUR_20_u2_u1 1. _CNV_A_R_LINEAR_____514_CM 0. 1. DISPLAY_IDENTIFIER IP_FAC_TQ_ADD_CONV_TOIL FORMAT "%6.4"
 /begin AXIS_DESCR COM_AXIS toil _CNV_A_R_LINEAR_____14_CM 6 -40. 160. FORMAT "%3.0" AXIS_PTS_REF ldpm_toil_tq_add_conv /end AXIS_DESCR
/end CHARACTERISTIC
/begin MEASUREMENT tq_add_conv_2 "Torque reserve for switching converter Torque" SWORD _CNV_A_R_LINEAR_____55_CM 1 100. -1024. 1023.96875 DISPLAY_IDENTIFIER TQ_ADD_CONV_2 ECU_ADDRESS 0x3fddfc BYTE_ORDER MSB_LAST FORMAT "%6.2" /end MEASUREMENT
/begin MEASUREMENT tq_loss "Engine torque losses" SWORD _CNV_A_R_LINEAR_____55_CM 1 100. -1024. 1023.96875 DISPLAY_IDENTIFIER TQ_LOSS ECU_ADDRESS 0x3fde14 BYTE_ORDER MSB_LAST FORMAT "%6.2" /end MEASUREMENT
/begin MEASUREMENT tq_loss_1 "Engine torque losses before limiting" SWORD _CNV_A_R_LINEAR_____55_CM 1 100. -1024. 1023.96875 DISPLAY_IDENTIFIER TQ_LOSS_1 ECU_ADDRESS 0x3fde1e BYTE_ORDER MSB_LAST FORMAT "%6.2" /end MEASUREMENT
/begin MEASUREMENT tq_loss_req_clu "Engine torque losses without pumping losses for calculation of TQ_REQ_CLU" SWORD _CNV_A_R_LINEAR_____55_CM 1 100. -1024. 1023.96875 DISPLAY_IDENTIFIER TQ_LOSS_REQ_CLU ECU_ADDRESS 0x3fde16 BYTE_ORDER MSB_LAST FORMAT "%6.2" /end MEASUREMENT
/begin MEASUREMENT tqfr_mec "Mechanical friction torque of the engine" SWORD _CNV_A_R_LINEAR_____55_CM 1 100. -1024. 1023.96875 DISPLAY_IDENTIFIER TQFR_MEC ECU_ADDRESS 0x3fde20 BYTE_ORDER MSB_LAST FORMAT "%6.2" /end MEASUREMENT
/begin MEASUREMENT lv_tq_loss_lim_act "Flag for limiting torque losses is active" UBYTE _CNV_S_2_RANGE______2_CM 1 100. 0. 1. DISPLAY_IDENTIFIER LV_TQ_LOSS_LIM_ACT ECU_ADDRESS 0x3feb12 /end MEASUREMENT
/begin MEASUREMENT tqfr "Basis engine friction torque {visible is high word TQFR^sword(1)}" SWORD _CNV_A_R_LINEAR_____55_CM 1 100. -1024. 1023.96875 DISPLAY_IDENTIFIER TQFR ECU_ADDRESS 0x3fde22 BYTE_ORDER MSB_LAST FORMAT "%6.2" /end MEASUREMENT
/begin MEASUREMENT tqfr_bas "Basis engine friction torque inclusive Adaptation value" SWORD _CNV_A_R_LINEAR_____55_CM 1 100. -1024. 1023.96875 DISPLAY_IDENTIFIER TQFR_BAS ECU_ADDRESS 0x3fde24 BYTE_ORDER MSB_LAST FORMAT "%6.2" /end MEASUREMENT
/begin MEASUREMENT tqfr_add "Additive temperature correction of engine friction torque " SWORD _CNV_A_R_LINEAR_____55_CM 1 100. -1024. 1023.96875 DISPLAY_IDENTIFIER TQFR_ADD ECU_ADDRESS 0x3fde26 BYTE_ORDER MSB_LAST FORMAT "%6.2" /end MEASUREMENT
/begin MEASUREMENT tqfr_st "Additive start correction of engine friction torque" SWORD _CNV_A_R_LINEAR_____55_CM 1 100. -1024. 1023.96875 DISPLAY_IDENTIFIER TQFR_ST ECU_ADDRESS 0x3fde28 BYTE_ORDER MSB_LAST FORMAT "%6.2" /end MEASUREMENT
/begin CHARACTERISTIC ip_tqfr "Base friction torque and pumping losses" MAP 0xffe500d6 _REC_MAP_20_u2_u2_u2 1024. _CNV_A_R_LINEAR_____187_CM -1024. 0. DISPLAY_IDENTIFIER IP_TQFR FORMAT "%6.2"
 /begin AXIS_DESCR COM_AXIS n _CNV_A_R_LINEAR_____10_CM 16 0. 8160. FORMAT "%4.0" AXIS_PTS_REF ldpm_n_100 /end AXIS_DESCR
 /begin AXIS_DESCR COM_AXIS maf _CNV_A_R_LINEAR_____108_CM 8 0. 1389. FORMAT "%7.2" AXIS_PTS_REF ldp_maf_cyl_stk__tqfr /end AXIS_DESCR
/end CHARACTERISTIC
/begin CHARACTERISTIC ip_tqfr_add "Coolant and oil temperature correction of friction  torque" MAP 0xffe501d6 _REC_MAP_20_u2_u1_u1 2047.96875 _CNV_A_R_LINEAR_____187_CM -1024. 1023.96875 DISPLAY_IDENTIFIER IP_TQFR_ADD FORMAT "%6.2"
 /begin AXIS_DESCR COM_AXIS tco _CNV_A_R_LINEAR_____11_CM 8 -48. 142.5 FORMAT "%5.1" AXIS_PTS_REF ldp_tco__tqfr_add /end AXIS_DESCR
 /begin AXIS_DESCR COM_AXIS toil _CNV_A_R_LINEAR_____14_CM 8 -40. 160. FORMAT "%3.0" AXIS_PTS_REF ldp_toil_tqfr_add /end AXIS_DESCR
/end CHARACTERISTIC
/begin CHARACTERISTIC ip_tq_loss_lim "Torque losses limitation for safety" MAP 0xffe4fe7a _REC_MAP_20_u2_u2_u1 2047.96875 _CNV_A_R_LINEAR_____187_CM -1024. 1023.96875 DISPLAY_IDENTIFIER IP_TQ_LOSS_LIM FORMAT "%6.2"
 /begin AXIS_DESCR COM_AXIS n _CNV_A_R_LINEAR_____10_CM 6 0. 8160. FORMAT "%4.0" AXIS_PTS_REF ldp_n_tq_loss_lim /end AXIS_DESCR
 /begin AXIS_DESCR COM_AXIS tco _CNV_A_R_LINEAR_____11_CM 6 -48. 142.5 FORMAT "%5.1" AXIS_PTS_REF ldp_tco_tq_loss_lim /end AXIS_DESCR
/end CHARACTERISTIC
/begin CHARACTERISTIC ip_tqfr_st "Friction torque increase after start" CURVE 0xffe41d00 _REC_CUR_20_u2_u1 1024. _CNV_A_R_LINEAR_____187_CM -1024. 0. DISPLAY_IDENTIFIER IP_TQFR_ST FORMAT "%6.2"
 /begin AXIS_DESCR COM_AXIS tco_st _CNV_A_R_LINEAR_____11_CM 4 -48. 142.5 FORMAT "%5.1" AXIS_PTS_REF ldp_tco_st__tqfr_st /end AXIS_DESCR
/end CHARACTERISTIC
/begin CHARACTERISTIC ip_tqfr_dec_st "Decrement for start correction of friction torque" CURVE 0xffe41cf8 _REC_CUR_20_u2_u1 1024. _CNV_A_R_LINEAR_____187_CM -1024. 0. DISPLAY_IDENTIFIER IP_TQFR_DEC_ST FORMAT "%6.2"
 /begin AXIS_DESCR COM_AXIS tco_st _CNV_A_R_LINEAR_____11_CM 4 -48. 142.5 FORMAT "%5.1" AXIS_PTS_REF ldp_tco_st__tqfr_dec_st /end AXIS_DESCR
/end CHARACTERISTIC
/begin CHARACTERISTIC c_maf_cyl_stk_ref "Constant for the determination of the friction losses" VALUE 0xffe41730 _REC_VAL_20_u2 1389. _CNV_A_R_LINEAR_____108_CM 0. 1389. DISPLAY_IDENTIFIER C_MAF_CYL_STK_REF FORMAT "%7.2" /end CHARACTERISTIC
/begin CHARACTERISTIC c_crlc_tq_loss_req_clu "Correlation constant for TQ_LOSS_REQ_CLU filtering" VALUE 0xffe40698 _REC_VAL_20_u1 0.9960940000000002 _CNV_A_R_LINEAR_____50_CM 0. 0.996094 DISPLAY_IDENTIFIER C_CRLC_TQ_LOSS_REQ_CLU FORMAT "%5.3" /end CHARACTERISTIC
/begin AXIS_PTS ldpm_n_100 "" 0xffe51a0c n _REC_AXS_20_u2 8160. _CNV_A_R_LINEAR_____10_CM 16 0. 8160. DISPLAY_IDENTIFIER LDPM_N_100 FORMAT "%4.0" /end AXIS_PTS
/begin AXIS_PTS ldp_maf_cyl_stk__tqfr "" 0xffe50d54 maf _REC_AXS_20_u2 1389. _CNV_A_R_LINEAR_____108_CM 8 0. 1389. DISPLAY_IDENTIFIER LDP_MAF_CYL_STK__TQFR FORMAT "%7.2" /end AXIS_PTS
/begin AXIS_PTS ldp_tco__tqfr_add "" 0xffe4820a tco _REC_AXS_20_u1 190.5 _CNV_A_R_LINEAR_____11_CM 8 -48. 142.5 DISPLAY_IDENTIFIER LDP_TCO__TQFR_ADD FORMAT "%5.1" /end AXIS_PTS
/begin AXIS_PTS ldp_toil_tqfr_add "" 0xffe482dd toil _REC_AXS_20_u1 200. _CNV_A_R_LINEAR_____14_CM 8 -40. 160. DISPLAY_IDENTIFIER LDP_TOIL_TQFR_ADD FORMAT "%3.0" /end AXIS_PTS
/begin AXIS_PTS ldp_n_tq_loss_lim "" 0xffe51156 n _REC_AXS_20_u2 8160. _CNV_A_R_LINEAR_____10_CM 6 0. 8160. DISPLAY_IDENTIFIER LDP_N_TQ_LOSS_LIM FORMAT "%4.0" /end AXIS_PTS
/begin AXIS_PTS ldp_tco_tq_loss_lim "" 0xffe41255 tco _REC_AXS_20_u1 190.5 _CNV_A_R_LINEAR_____11_CM 6 -48. 142.5 DISPLAY_IDENTIFIER LDP_TCO_TQ_LOSS_LIM FORMAT "%5.1" /end AXIS_PTS
/begin AXIS_PTS ldp_tco_st__tqfr_st "" 0xffe4122c tco_st _REC_AXS_20_u1 190.5 _CNV_A_R_LINEAR_____11_CM 4 -48. 142.5 DISPLAY_IDENTIFIER LDP_TCO_ST__TQFR_ST FORMAT "%5.1" /end AXIS_PTS
/begin AXIS_PTS ldp_tco_st__tqfr_dec_st "" 0xffe41227 tco_st _REC_AXS_20_u1 190.5 _CNV_A_R_LINEAR_____11_CM 4 -48. 142.5 DISPLAY_IDENTIFIER LDP_TCO_ST__TQFR_DEC_ST FORMAT "%5.1" /end AXIS_PTS
/begin MEASUREMENT tqfr_req_clu "Engine Friction torque without pumping losses for calculation of TQ_MIN_CLU" SWORD _CNV_A_R_LINEAR_____55_CM 1 100. -1024. 1023.96875 DISPLAY_IDENTIFIER TQFR_REQ_CLU ECU_ADDRESS 0x3fde18 BYTE_ORDER MSB_LAST FORMAT "%8.2" /end MEASUREMENT
/begin MEASUREMENT tq_loss_clu_add "Engine  torque losses without pumping and friction losses for calculation of TQ_MIN_CLU" SWORD _CNV_A_R_LINEAR_____55_CM 1 100. -1024. 1023.96875 DISPLAY_IDENTIFIER TQ_LOSS_CLU_ADD ECU_ADDRESS 0x3fde1a BYTE_ORDER MSB_LAST FORMAT "%8.2" /end MEASUREMENT
/begin AXIS_PTS ldpm_tco__tqfr_add "" 0xffe4144d tco _REC_AXS_20_u1 190.5 _CNV_A_R_LINEAR_____11_CM 4 -48. 142.5 DISPLAY_IDENTIFIER LDPM_TCO__TQFR_ADD FORMAT "%5.1" /end AXIS_PTS
/begin AXIS_PTS ldpm_ctr_km_can__tqfr_add "" 0xffe517ae ctr_km_can _REC_AXS_20_u2 655350. _CNV_A_R_LINEAR_____88_CM 4 0. 655350. DISPLAY_IDENTIFIER LDPM_CTR_KM_CAN__TQFR_ADD FORMAT "%6.0" /end AXIS_PTS
/begin CHARACTERISTIC ip_tqfr_add_km_mt "Correction of friction torque of running in phase engine" MAP 0xffe50276 _REC_MAP_20_u2_u1_u2 2047.96875 _CNV_A_R_LINEAR_____187_CM -1024. 1023.96875 DISPLAY_IDENTIFIER IP_TQFR_ADD_KM_MT FORMAT "%6.2"
 /begin AXIS_DESCR COM_AXIS tco _CNV_A_R_LINEAR_____11_CM 4 -48. 142.5 FORMAT "%5.1" AXIS_PTS_REF ldpm_tco__tqfr_add /end AXIS_DESCR
 /begin AXIS_DESCR COM_AXIS ctr_km_can _CNV_A_R_LINEAR_____88_CM 4 0. 655350. FORMAT "%6.0" AXIS_PTS_REF ldpm_ctr_km_can__tqfr_add /end AXIS_DESCR
/end CHARACTERISTIC
/begin CHARACTERISTIC ip_tqfr_add_km_at "Correction of friction torque of running in phase engine and transmission" MAP 0xffe50256 _REC_MAP_20_u2_u1_u2 2047.96875 _CNV_A_R_LINEAR_____187_CM -1024. 1023.96875 DISPLAY_IDENTIFIER IP_TQFR_ADD_KM_AT FORMAT "%6.2"
 /begin AXIS_DESCR COM_AXIS tco _CNV_A_R_LINEAR_____11_CM 4 -48. 142.5 FORMAT "%5.1" AXIS_PTS_REF ldpm_tco__tqfr_add /end AXIS_DESCR
 /begin AXIS_DESCR COM_AXIS ctr_km_can _CNV_A_R_LINEAR_____88_CM 4 0. 655350. FORMAT "%6.0" AXIS_PTS_REF ldpm_ctr_km_can__tqfr_add /end AXIS_DESCR
/end CHARACTERISTIC
/begin MEASUREMENT tqfr_add_km "Temperature correction of engine friction losses depending on mileage" SWORD _CNV_A_R_LINEAR_____55_CM 1 100. -1024. 1023.96875 DISPLAY_IDENTIFIER TQFR_ADD_KM ECU_ADDRESS 0x3fde2a BYTE_ORDER MSB_LAST FORMAT "%8.2" /end MEASUREMENT
/begin MEASUREMENT tqfr_delta_amp "AMP friction losses dependency" SWORD _CNV_A_R_LINEAR_____55_CM 1 100. -1024. 1023.96875 DISPLAY_IDENTIFIER TQFR_DELTA_AMP ECU_ADDRESS 0x3fde1c BYTE_ORDER MSB_LAST FORMAT "%8.2" /end MEASUREMENT
/begin AXIS_PTS ldp_amp_dif__tqfr_amp "AMP correction of friction  torque" 0xffe5098e online_dummy _REC_AXS_20_u2 5434. _CNV_A_R_LINEAR_____116_CM 4 -2717. 2717. DISPLAY_IDENTIFIER LDP_AMP_DIF__TQFR_AMP FORMAT "%7.2" /end AXIS_PTS
/begin AXIS_PTS ldp_pq__tqfr_amp "AMP correction of friction  torque" 0xffe511e4 online_dummy _REC_AXS_20_u2 0.99998474 _CNV_A_R_LINEAR_____37_CM 4 0. 0.99998474 DISPLAY_IDENTIFIER LDP_PQ__TQFR_AMP FORMAT "%7.5" /end AXIS_PTS
/begin CHARACTERISTIC ip_tqfr_delta_amp "AMP correction of friction  torque" MAP 0xffe5236a _REC_MAP_20_u2_u2_u2 2047.96875 _CNV_A_R_LINEAR_____187_CM -1024. 1023.96875 DISPLAY_IDENTIFIER IP_TQFR_DELTA_AMP FORMAT "%6.2"
 /begin AXIS_DESCR COM_AXIS online_dummy _CNV_A_R_LINEAR_____116_CM 4 -2717. 2717. FORMAT "%7.2" AXIS_PTS_REF ldp_amp_dif__tqfr_amp /end AXIS_DESCR
 /begin AXIS_DESCR COM_AXIS online_dummy _CNV_A_R_LINEAR_____37_CM 4 0. 0.99998474 FORMAT "%7.5" AXIS_PTS_REF ldp_pq__tqfr_amp /end AXIS_DESCR
/end CHARACTERISTIC
/begin MEASUREMENT eff_scc_av "Actual efficiency fuel cut-off" UWORD _CNV_A_R_LINEAR_____20_CM 1 100. 0. 1.99996948 DISPLAY_IDENTIFIER EFF_SCC_AV ECU_ADDRESS 0x3fde40 BYTE_ORDER MSB_LAST FORMAT "%7.5" /end MEASUREMENT
/begin MEASUREMENT eff_scc_av_can "Actual efficiency fuel cut-off for CAN" UWORD _CNV_A_R_LINEAR_____20_CM 1 100. 0. 1.99996948 DISPLAY_IDENTIFIER EFF_SCC_AV_CAN ECU_ADDRESS 0x3fde42 BYTE_ORDER MSB_LAST FORMAT "%7.5" /end MEASUREMENT
/begin MEASUREMENT eff_scc_sp_hys "Setpoint efficiency fuel cut-off pattern with hysteresis" UWORD _CNV_A_R_LINEAR_____20_CM 1 100. 0. 1.99996948 DISPLAY_IDENTIFIER EFF_SCC_SP_HYS ECU_ADDRESS 0x3fde50 BYTE_ORDER MSB_LAST FORMAT "%7.5" /end MEASUREMENT
/begin MEASUREMENT eff_scc_bas "Basic efficiency fuel  cut-off" UWORD _CNV_A_R_LINEAR_____20_CM 1 100. 0. 1.99996948 DISPLAY_IDENTIFIER EFF_SCC_BAS ECU_ADDRESS 0x3fde3e BYTE_ORDER MSB_LAST FORMAT "%7.5" /end MEASUREMENT
/begin MEASUREMENT eff_scc_sp "Setpoint efficiency fuel cut-off pattern" UWORD _CNV_A_R_LINEAR_____20_CM 1 100. 0. 1.99996948 DISPLAY_IDENTIFIER EFF_SCC_SP ECU_ADDRESS 0x3fde46 BYTE_ORDER MSB_LAST FORMAT "%7.5" /end MEASUREMENT
/begin MEASUREMENT tqi_ref_iga_min_scc "indicated reference torque for single cylinder cut-off " SWORD _CNV_A_R_LINEAR_____55_CM 1 100. -1024. 1023.96875 DISPLAY_IDENTIFIER TQI_REF_IGA_MIN_SCC ECU_ADDRESS 0x3fde44 BYTE_ORDER MSB_LAST FORMAT "%8.2" /end MEASUREMENT
/begin MEASUREMENT eff_iga_min_scc "minimum reference efficiency for single cylinder cut-off " UWORD _CNV_A_R_LINEAR_____20_CM 1 100. 0. 1.99996948 DISPLAY_IDENTIFIER EFF_IGA_MIN_SCC ECU_ADDRESS 0x3fde48 BYTE_ORDER MSB_LAST FORMAT "%7.5" /end MEASUREMENT
/begin MEASUREMENT fac_iga_min_teg_iga_bas "scaling factor for efficiency calculation with EFF_IGA_MIN_TEG and EFF_IGA_BAS_COR" UWORD _CNV_A_R_LINEAR_____20_CM 1 100. 0. 1.99996948 DISPLAY_IDENTIFIER FAC_IGA_MIN_TEG_IGA_BAS ECU_ADDRESS 0x3fde52 BYTE_ORDER MSB_LAST FORMAT "%7.5" /end MEASUREMENT
/begin MEASUREMENT lv_auth_tq_pat "Logical variable for authorizing fuel cut-off pattern" UBYTE _CNV_S_2_RANGE______2_CM 1 100. 0. 1. DISPLAY_IDENTIFIER LV_AUTH_TQ_PAT ECU_ADDRESS 0x3feb14 /end MEASUREMENT
/begin MEASUREMENT nr_pat_scc "Selected index of fuel cut-off pattern" UBYTE _CNV_A_R_LINEAR_____0_CM 1 100. 0. 255. DISPLAY_IDENTIFIER NR_PAT_SCC ECU_ADDRESS 0x3feb13 FORMAT "%3.0" /end MEASUREMENT
/begin CHARACTERISTIC lc_eff_scc_sp_man "flag for setting EFF_SCC_SP by application system" VALUE 0xffe40f54 _REC_VAL_20_u1 1. _CNV_A_R_LINEAR_____0_CM 0. 1. DISPLAY_IDENTIFIER LC_EFF_SCC_SP_MAN FORMAT "%2.0" /end CHARACTERISTIC
/begin CHARACTERISTIC lc_inh_fcut_fast "inhibition flag for fuel cut-off due fast fuel cut-off" VALUE 0xffe40f77 _REC_VAL_20_u1 1. _CNV_A_R_LINEAR_____0_CM 0. 1. DISPLAY_IDENTIFIER LC_INH_FCUT_FAST FORMAT "%2.0" /end CHARACTERISTIC
/begin CHARACTERISTIC lc_ena_eff_scc_bas_man "logical variable for manually adjusting basic efficiency fuel cut-off" VALUE 0xffe40f55 _REC_VAL_20_u1 1. _CNV_A_R_LINEAR_____0_CM 0. 1. DISPLAY_IDENTIFIER LC_ENA_EFF_SCC_BAS_MAN FORMAT "%2.0" /end CHARACTERISTIC
/begin CHARACTERISTIC c_eff_scc_sp_hys "Hysteresis applied on EFF_SCC_SP for NR_PAT_SCC calculation" VALUE 0xffe415ce _REC_VAL_20_u2 1.99996948 _CNV_A_R_LINEAR_____20_CM 0. 1.99996948 DISPLAY_IDENTIFIER C_EFF_SCC_SP_HYS FORMAT "%7.5" /end CHARACTERISTIC
/begin CHARACTERISTIC c_eff_scc_bas_man "manually adjusted basic efficiency fuel cut-off" VALUE 0xffe415cc _REC_VAL_20_u2 1.99996948 _CNV_A_R_LINEAR_____20_CM 0. 1.99996948 DISPLAY_IDENTIFIER C_EFF_SCC_BAS_MAN FORMAT "%7.5" /end CHARACTERISTIC
/begin CHARACTERISTIC lc_ena_fcut_tot_gs "logical variable for setting scaling factor due to gear shift intervention" VALUE 0xffe40f5c _REC_VAL_20_u1 1. _CNV_A_R_LINEAR_____0_CM 0. 1. DISPLAY_IDENTIFIER LC_ENA_FCUT_TOT_GS FORMAT "%2.0" /end CHARACTERISTIC
/begin CHARACTERISTIC lc_inh_fcut_gs_iga "inhibition flag for fuel cut-off due to gear shift intervention with spark retarding" VALUE 0xffe40f79 _REC_VAL_20_u1 1. _CNV_A_R_LINEAR_____0_CM 0. 1. DISPLAY_IDENTIFIER LC_INH_FCUT_GS_IGA FORMAT "%2.0" /end CHARACTERISTIC
/begin CHARACTERISTIC lc_inh_fcut_asr "inhibition flag for fuel cut-off due to ASR" VALUE 0xffe40f75 _REC_VAL_20_u1 1. _CNV_A_R_LINEAR_____0_CM 0. 1. DISPLAY_IDENTIFIER LC_INH_FCUT_ASR FORMAT "%2.0" /end CHARACTERISTIC
/begin CHARACTERISTIC lc_ena_fcut_tot_asr "logical variable for setting scaling factor due to ASR" VALUE 0xffe40f59 _REC_VAL_20_u1 1. _CNV_A_R_LINEAR_____0_CM 0. 1. DISPLAY_IDENTIFIER LC_ENA_FCUT_TOT_ASR FORMAT "%2.0" /end CHARACTERISTIC
/begin CHARACTERISTIC lc_inh_fcut_n_max "inhibition flag for fuel cut-off due to speed limitation" VALUE 0xffe40f7a _REC_VAL_20_u1 1. _CNV_A_R_LINEAR_____0_CM 0. 1. DISPLAY_IDENTIFIER LC_INH_FCUT_N_MAX FORMAT "%2.0" /end CHARACTERISTIC
/begin CHARACTERISTIC lc_tq_scc_inh_man "inhibition flag for fuel cut-off due to torque management" VALUE 0xffe40ffc _REC_VAL_20_u1 1. _CNV_A_R_LINEAR_____0_CM 0. 1. DISPLAY_IDENTIFIER LC_TQ_SCC_INH_MAN FORMAT "%2.0" /end CHARACTERISTIC
/begin CHARACTERISTIC lc_ena_fcut_tot_fast "logical variable for setting scaling factor due to fast fuel cut-off" VALUE 0xffe40f5b _REC_VAL_20_u1 1. _CNV_A_R_LINEAR_____0_CM 0. 1. DISPLAY_IDENTIFIER LC_ENA_FCUT_TOT_FAST FORMAT "%2.0" /end CHARACTERISTIC
/begin CHARACTERISTIC lc_tq_scc_ena_man "flag for enabling SCC by application system" VALUE 0xffe40ffb _REC_VAL_20_u1 1. _CNV_A_R_LINEAR_____0_CM 0. 1. DISPLAY_IDENTIFIER LC_TQ_SCC_ENA_MAN FORMAT "%2.0" /end CHARACTERISTIC
/begin CHARACTERISTIC c_eff_scc_sp_man "setpoint for efficiency of fuel cut-off set by application intervention" VALUE 0xffe415d0 _REC_VAL_20_u2 1.99996948 _CNV_A_R_LINEAR_____20_CM 0. 1.99996948 DISPLAY_IDENTIFIER C_EFF_SCC_SP_MAN FORMAT "%7.5" /end CHARACTERISTIC
/begin CHARACTERISTIC c_fac_iga_min_teg_iga_bas "manually adjusted scaling factor for efficiency calculation with EFF_IGA_MIN_TEG and EFF_IGA_BAS_COR" VALUE 0xffe41608 _REC_VAL_20_u2 1. _CNV_A_R_LINEAR_____361_CM 0. 1. DISPLAY_IDENTIFIER C_FAC_IGA_MIN_TEG_IGA_BAS FORMAT "%6.4" /end CHARACTERISTIC
/begin CHARACTERISTIC c_hys_eff_iga_min_teg "hysteresis in falling direction for IGA_MIN_TEG correction" VALUE 0xffe41672 _REC_VAL_20_u2 1.99996948 _CNV_A_R_LINEAR_____20_CM 0. 1.99996948 DISPLAY_IDENTIFIER C_HYS_EFF_IGA_MIN_TEG FORMAT "%7.5" /end CHARACTERISTIC
/begin CHARACTERISTIC c_min_dec_eff_iga_min_teg_1 "minimum decrement for first decrease phase " VALUE 0xffe417e0 _REC_VAL_20_u2 1.99996948 _CNV_A_R_LINEAR_____20_CM 0. 1.99996948 DISPLAY_IDENTIFIER C_MIN_DEC_EFF_IGA_MIN_TEG_1 FORMAT "%7.5" /end CHARACTERISTIC
/begin CHARACTERISTIC c_min_dec_eff_iga_min_teg_2 "minimum decrement for second decrease phase " VALUE 0xffe417e2 _REC_VAL_20_u2 1.99996948 _CNV_A_R_LINEAR_____20_CM 0. 1.99996948 DISPLAY_IDENTIFIER C_MIN_DEC_EFF_IGA_MIN_TEG_2 FORMAT "%7.5" /end CHARACTERISTIC
/begin CHARACTERISTIC id_nr_pat_scc "SCC pattern depending on SCC efficiency" CURVE 0xffe441ec _REC_CUR_20_u1_u2 255. _CNV_A_R_LINEAR_____0_CM 0. 255. DISPLAY_IDENTIFIER ID_NR_PAT_SCC FORMAT "%3.0"
 /begin AXIS_DESCR COM_AXIS eff_scc_sp _CNV_A_R_LINEAR_____20_CM 13 0. 1.99996948 FORMAT "%7.5" AXIS_PTS_REF ldp_eff_scc_sp__nr_pat_scc /end AXIS_DESCR
/end CHARACTERISTIC
/begin CHARACTERISTIC lc_inh_fcut_gs "inhibition flag for fuel cut-off due to gear shift intervention" VALUE 0xffe40f78 _REC_VAL_20_u1 1. _CNV_A_R_LINEAR_____0_CM 0. 1. DISPLAY_IDENTIFIER LC_INH_FCUT_GS FORMAT "%2.0" /end CHARACTERISTIC
/begin CHARACTERISTIC lc_inh_fcut_amt "inhibition flag for fuel cut-off due to AMT intervention" VALUE 0xffe40f74 _REC_VAL_20_u1 1. _CNV_A_R_LINEAR_____0_CM 0. 1. DISPLAY_IDENTIFIER LC_INH_FCUT_AMT FORMAT "%2.0" /end CHARACTERISTIC
/begin CHARACTERISTIC lc_inh_fcut_dcc "inhibition flag for fuel cut-off due to DCC intervention" VALUE 0xffe40f76 _REC_VAL_20_u1 1. _CNV_A_R_LINEAR_____0_CM 0. 1. DISPLAY_IDENTIFIER LC_INH_FCUT_DCC FORMAT "%2.0" /end CHARACTERISTIC
/begin CHARACTERISTIC lc_ena_fcut_tot_n_max "logical variable for setting scaling factor due to engine speed limitation" VALUE 0xffe40f5d _REC_VAL_20_u1 1. _CNV_A_R_LINEAR_____0_CM 0. 1. DISPLAY_IDENTIFIER LC_ENA_FCUT_TOT_N_MAX FORMAT "%2.0" /end CHARACTERISTIC
/begin CHARACTERISTIC lc_ena_fcut_tot_amt "logical variable for setting scaling factor due AMT" VALUE 0xffe40f58 _REC_VAL_20_u1 1. _CNV_A_R_LINEAR_____0_CM 0. 1. DISPLAY_IDENTIFIER LC_ENA_FCUT_TOT_AMT FORMAT "%2.0" /end CHARACTERISTIC
/begin CHARACTERISTIC lc_ena_fcut_tot_dcc "logical variable for setting scaling factor due DCC" VALUE 0xffe40f5a _REC_VAL_20_u1 1. _CNV_A_R_LINEAR_____0_CM 0. 1. DISPLAY_IDENTIFIER LC_ENA_FCUT_TOT_DCC FORMAT "%2.0" /end CHARACTERISTIC
/begin AXIS_PTS ldp_eff_scc_sp__nr_pat_scc "" 0xffe50b46 eff_scc_sp _REC_AXS_20_u2 1.99996948 _CNV_A_R_LINEAR_____20_CM 13 0. 1.99996948 DISPLAY_IDENTIFIER LDP_EFF_SCC_SP__NR_PAT_SCC FORMAT "%7.5" /end AXIS_PTS
/begin MEASUREMENT t_max_fcut_fast "time counter for clutch switch observation fast fuel cut off" UBYTE _CNV_A_R_LINEAR_____4_CM 1 100. 0. 2.55 DISPLAY_IDENTIFIER T_MAX_FCUT_FAST ECU_ADDRESS 0x3feb17 FORMAT "%4.2" /end MEASUREMENT
/begin MEASUREMENT tq_st "Engine Start Torque" SWORD _CNV_A_R_LINEAR_____55_CM 1 100. -1024. 1023.96875 DISPLAY_IDENTIFIER TQ_ST ECU_ADDRESS 0x3fde56 BYTE_ORDER MSB_LAST FORMAT "%6.2" /end MEASUREMENT
/begin MEASUREMENT tq_st_1 "Engine Start Torque raw value" SWORD _CNV_A_R_LINEAR_____55_CM 1 100. -1024. 1023.96875 DISPLAY_IDENTIFIER TQ_ST_1 ECU_ADDRESS 0x3fde58 BYTE_ORDER MSB_LAST FORMAT "%6.2" /end MEASUREMENT
/begin CHARACTERISTIC c_crlc_tq_st "" VALUE 0xffe40699 _REC_VAL_20_u1 0.9960940000000002 _CNV_A_R_LINEAR_____50_CM 0. 0.996094 DISPLAY_IDENTIFIER C_CRLC_TQ_ST FORMAT "%5.3" /end CHARACTERISTIC
/begin CHARACTERISTIC ip_tq_st_mt "Engine torque at start for manual transmission" MAP 0xffe5000e _REC_MAP_20_u2_u2_u1 2047.96875 _CNV_A_R_LINEAR_____187_CM -1024. 1023.96875 DISPLAY_IDENTIFIER IP_TQ_ST_MT FORMAT "%6.2"
 /begin AXIS_DESCR COM_AXIS n_dif _CNV_A_R_LINEAR_____207_CM 8 -32768. 32767. FORMAT "%6.0" AXIS_PTS_REF ldpm_n_dif_ip_tq_st /end AXIS_DESCR
 /begin AXIS_DESCR COM_AXIS tco _CNV_A_R_LINEAR_____11_CM 8 -48. 142.5 FORMAT "%5.1" AXIS_PTS_REF ldpm_tco_ip_tq_st /end AXIS_DESCR
/end CHARACTERISTIC
/begin CHARACTERISTIC ip_tq_st_at "Engine torque at start for automatic transmission" MAP 0xffe4ff8e _REC_MAP_20_u2_u2_u1 2047.96875 _CNV_A_R_LINEAR_____187_CM -1024. 1023.96875 DISPLAY_IDENTIFIER IP_TQ_ST_AT FORMAT "%6.2"
 /begin AXIS_DESCR COM_AXIS n_dif _CNV_A_R_LINEAR_____207_CM 8 -32768. 32767. FORMAT "%6.0" AXIS_PTS_REF ldpm_n_dif_ip_tq_st /end AXIS_DESCR
 /begin AXIS_DESCR COM_AXIS tco _CNV_A_R_LINEAR_____11_CM 8 -48. 142.5 FORMAT "%5.1" AXIS_PTS_REF ldpm_tco_ip_tq_st /end AXIS_DESCR
/end CHARACTERISTIC
/begin AXIS_PTS ldpm_tco_ip_tq_st "" 0xffe4866e tco _REC_AXS_20_u1 190.5 _CNV_A_R_LINEAR_____11_CM 8 -48. 142.5 DISPLAY_IDENTIFIER LDPM_TCO_IP_TQ_ST FORMAT "%5.1" /end AXIS_PTS
/begin AXIS_PTS ldpm_n_dif_ip_tq_st "" 0xffe51b8c n_dif _REC_AXS_20_u2 65535. _CNV_A_R_LINEAR_____207_CM 8 -32768. 32767. DISPLAY_IDENTIFIER LDPM_N_DIF_IP_TQ_ST FORMAT "%6.0" /end AXIS_PTS
/begin CHARACTERISTIC ip_fac_tq_req_driv_rng_l "Scaling factor for requested torque at clutch from driver in low range mode" MAP 0xffe4ba04 _REC_MAP_20_u2_u2_u1 1.99996948 _CNV_A_R_LINEAR_____20_CM 0. 1.99996948 DISPLAY_IDENTIFIER IP_FAC_TQ_REQ_DRIV_RNG_L FORMAT "%7.5"
 /begin AXIS_DESCR COM_AXIS n _CNV_A_R_LINEAR_____10_CM 12 0. 8160. FORMAT "%4.0" AXIS_PTS_REF ldpm_n_fac_tq_req_driv /end AXIS_DESCR
 /begin AXIS_DESCR COM_AXIS pv_av _CNV_A_R_LINEAR_____9_CM 12 0. 99.609375 FORMAT "%4.1" AXIS_PTS_REF ldpm_pv_av_fac_tq_req_driv /end AXIS_DESCR
/end CHARACTERISTIC
/begin CHARACTERISTIC ip_fac_tq_req_driv "Scaling factor for requested torque at clutch from driver" MAP 0xffe4b8e4 _REC_MAP_20_u2_u2_u1 1.99996948 _CNV_A_R_LINEAR_____20_CM 0. 1.99996948 DISPLAY_IDENTIFIER IP_FAC_TQ_REQ_DRIV FORMAT "%7.5"
 /begin AXIS_DESCR COM_AXIS n _CNV_A_R_LINEAR_____10_CM 12 0. 8160. FORMAT "%4.0" AXIS_PTS_REF ldpm_n_fac_tq_req_driv /end AXIS_DESCR
 /begin AXIS_DESCR COM_AXIS pv_av _CNV_A_R_LINEAR_____9_CM 12 0. 99.609375 FORMAT "%4.1" AXIS_PTS_REF ldpm_pv_av_fac_tq_req_driv /end AXIS_DESCR
/end CHARACTERISTIC
/begin CHARACTERISTIC c_pv_av_sof_min "PV_AV threshold for activation IP_FAC_TQ_REQ_DRIV_RNG_L" VALUE 0xffe4082a _REC_VAL_20_u1 99.609375 _CNV_A_R_LINEAR_____9_CM 0. 99.609375 DISPLAY_IDENTIFIER C_PV_AV_SOF_MIN FORMAT "%4.1" /end CHARACTERISTIC
/begin CHARACTERISTIC c_fac_tq_req_driv_sof_max "Scaling factor threshold for activation IP_FAC_TQ_REQ_DRIV_RNG_L" VALUE 0xffe41646 _REC_VAL_20_u2 1.99996948 _CNV_A_R_LINEAR_____20_CM 0. 1.99996948 DISPLAY_IDENTIFIER C_FAC_TQ_REQ_DRIV_SOF_MAX FORMAT "%7.5" /end CHARACTERISTIC
/begin CHARACTERISTIC c_pv_av_grd_sof_max "Pedal value gradient rheshold for recognition of LV_RNG_L" VALUE 0xffe40826 _REC_VAL_20_u1 2490.234 _CNV_A_R_LINEAR_____40_CM -1250. 1240.234 DISPLAY_IDENTIFIER C_PV_AV_GRD_SOF_MAX FORMAT "%6.1" /end CHARACTERISTIC
/begin CHARACTERISTIC c_t_pv_av_grd_sof_max "Minimum time for pedal value gradient for recognition of LV_RNG_L" VALUE 0xffe419dc _REC_VAL_20_u2 655.35 _CNV_A_R_LINEAR_____4_CM 0. 655.35 DISPLAY_IDENTIFIER C_T_PV_AV_GRD_SOF_MAX FORMAT "%6.2" /end CHARACTERISTIC
/begin MEASUREMENT fac_tq_req_driv "Scaling factor for requested torque at clutch from driver" UWORD _CNV_A_R_LINEAR_____20_CM 1 100. 0. 1.99996948 DISPLAY_IDENTIFIER FAC_TQ_REQ_DRIV ECU_ADDRESS 0x3fdeb4 BYTE_ORDER MSB_LAST FORMAT "%7.5" /end MEASUREMENT
/begin MEASUREMENT lv_rng_l_req "Activation condition for low-range-mode" UBYTE _CNV_S_2_RANGE______2_CM 1 100. 0. 1. DISPLAY_IDENTIFIER LV_RNG_L_REQ ECU_ADDRESS 0x3feb41 /end MEASUREMENT
/begin AXIS_PTS ldpm_n_fac_tq_req_driv "" 0xffe51bb0 n _REC_AXS_20_u2 8160. _CNV_A_R_LINEAR_____10_CM 12 0. 8160. DISPLAY_IDENTIFIER LDPM_N_FAC_TQ_REQ_DRIV FORMAT "%4.0" /end AXIS_PTS
/begin AXIS_PTS ldpm_pv_av_fac_tq_req_driv "" 0xffe485ce pv_av _REC_AXS_20_u1 99.609375 _CNV_A_R_LINEAR_____9_CM 12 0. 99.609375 DISPLAY_IDENTIFIER LDPM_PV_AV_FAC_TQ_REQ_DRIV FORMAT "%4.1" /end AXIS_PTS
/begin CHARACTERISTIC lc_rng_l_man_as "logical constant for to activate IP_FAC_TQ_REQ_DRIV_RNG_L (low range mode) in case if LV_RNG_L = 0 (default value = 0)" VALUE 0xffe40fd1 _REC_VAL_20_u1 1. _CNV_A_R_LINEAR_____0_CM 0. 1. DISPLAY_IDENTIFIER LC_RNG_L_MAN_AS FORMAT "%2.0" /end CHARACTERISTIC
/begin MEASUREMENT tqi_ref_max "Maximum indicated torque from IP_TQI_REF" SWORD _CNV_A_R_LINEAR_____55_CM 1 100. -1024. 1023.96875 DISPLAY_IDENTIFIER TQI_REF_MAX ECU_ADDRESS 0x3fdd3c BYTE_ORDER MSB_LAST FORMAT "%6.2" /end MEASUREMENT
/begin MEASUREMENT tq_max_clu "Maximum torque at clutch" SWORD _CNV_A_R_LINEAR_____55_CM 1 100. -1024. 1023.96875 DISPLAY_IDENTIFIER TQ_MAX_CLU ECU_ADDRESS 0x3fdd38 BYTE_ORDER MSB_LAST FORMAT "%6.2" /end MEASUREMENT
/begin MEASUREMENT tqi_max "Maximum indicated torque " SWORD _CNV_A_R_LINEAR_____55_CM 1 100. -1024. 1023.96875 DISPLAY_IDENTIFIER TQI_MAX ECU_ADDRESS 0x3fdd3a BYTE_ORDER MSB_LAST FORMAT "%6.2" /end MEASUREMENT
/begin CHARACTERISTIC c_tqi_fac_fl "Maximum torque series variation factor" VALUE 0xffe41ae4 _REC_VAL_20_u2 1.99996948 _CNV_A_R_LINEAR_____20_CM 0. 1.99996948 DISPLAY_IDENTIFIER C_TQI_FAC_FL FORMAT "%7.5" /end CHARACTERISTIC
/begin CHARACTERISTIC ip_tqi_ref__n__maf "Indicated engine torque at reference conditions" MAP 0xffe502f6 _REC_MAP_20_u2_u1_u2 1023.96875 _CNV_A_R_LINEAR_____55_CM 0. 1023.96875 DISPLAY_IDENTIFIER IP_TQI_REF__N__MAF FORMAT "%7.2"
 /begin AXIS_DESCR COM_AXIS n_32 _CNV_A_R_LINEAR_____15_CM 16 0. 8160. FORMAT "%4.0" AXIS_PTS_REF ldpm_n_32_100 /end AXIS_DESCR
 /begin AXIS_DESCR COM_AXIS maf _CNV_A_R_LINEAR_____108_CM 12 0. 1389. FORMAT "%7.2" AXIS_PTS_REF ldpm_maf_100 /end AXIS_DESCR
/end CHARACTERISTIC
/begin AXIS_PTS ldpm_n_32_100 "" 0xffe4845f n_32 _REC_AXS_20_u1 8160. _CNV_A_R_LINEAR_____15_CM 16 0. 8160. DISPLAY_IDENTIFIER LDPM_N_32_100 FORMAT "%4.0" /end AXIS_PTS
/begin AXIS_PTS ldpm_maf_100 "" 0xffe518ac maf _REC_AXS_20_u2 1389. _CNV_A_R_LINEAR_____108_CM 12 0. 1389. DISPLAY_IDENTIFIER LDPM_MAF_100 FORMAT "%7.2" /end AXIS_PTS
/begin MEASUREMENT tq_min_clu "Minimum  torque at clutch " SWORD _CNV_A_R_LINEAR_____55_CM 1 100. -1024. 1023.96875 DISPLAY_IDENTIFIER TQ_MIN_CLU ECU_ADDRESS 0x3fdd3e BYTE_ORDER MSB_LAST FORMAT "%6.2" /end MEASUREMENT
/begin MEASUREMENT tq_min_clu_1 "Minimum  torque at clutch intermitted value 1" SWORD _CNV_A_R_LINEAR_____55_CM 1 100. -1024. 1023.96875 DISPLAY_IDENTIFIER TQ_MIN_CLU_1 ECU_ADDRESS 0x3fdd42 BYTE_ORDER MSB_LAST FORMAT "%6.2" /end MEASUREMENT
/begin MEASUREMENT tq_min_clu_2 "Minimum  torque at clutch intermitted value 2" SWORD _CNV_A_R_LINEAR_____55_CM 1 100. -1024. 1023.96875 DISPLAY_IDENTIFIER TQ_MIN_CLU_2 ECU_ADDRESS 0x3fdd44 BYTE_ORDER MSB_LAST FORMAT "%6.2" /end MEASUREMENT
/begin MEASUREMENT fac_n_dif_is "Control factor for the engine self stabilizing" SWORD _CNV_A_R_LINEAR_____25_CM 1 100. -8. 7.99975586 DISPLAY_IDENTIFIER FAC_N_DIF_IS ECU_ADDRESS 0x3fdd46 BYTE_ORDER MSB_LAST FORMAT "%7.4" /end MEASUREMENT
/begin MEASUREMENT lv_tq_min_clu "Logical variable for coordination engine start torque and minimum torque and clutch" UBYTE _CNV_S_2_RANGE______2_CM 1 100. 0. 1. DISPLAY_IDENTIFIER LV_TQ_MIN_CLU ECU_ADDRESS 0x3fead9 BIT_MASK 0x1 /end MEASUREMENT
/begin MEASUREMENT tqi_min_req_pu "Minimum requested indicated torque in PU phase" SWORD _CNV_A_R_LINEAR_____55_CM 1 100. -1024. 1023.96875 DISPLAY_IDENTIFIER TQI_MIN_REQ_PU ECU_ADDRESS 0x3fdd40 BYTE_ORDER MSB_LAST FORMAT "%6.2" /end MEASUREMENT
/begin MEASUREMENT tq_min_req_pu "Minimum requested torque at clutch in PU phase" SWORD _CNV_A_R_LINEAR_____55_CM 1 100. -1024. 1023.96875 DISPLAY_IDENTIFIER TQ_MIN_REQ_PU ECU_ADDRESS 0x3fdd48 BYTE_ORDER MSB_LAST FORMAT "%6.2" /end MEASUREMENT
/begin CHARACTERISTIC c_n_dif_tq_st_1 "N_DIF threshold 1 for deactivating TQ_ST" VALUE 0xffe40484 _REC_VAL_20_s2 65535. _CNV_A_R_LINEAR_____10_CM -32768. 32767. DISPLAY_IDENTIFIER C_N_DIF_TQ_ST_1 FORMAT "%5.0" /end CHARACTERISTIC
/begin CHARACTERISTIC c_n_dif_tq_st_2 "N_DIF threshold 2 for deactivating TQ_ST" VALUE 0xffe40486 _REC_VAL_20_s2 65535. _CNV_A_R_LINEAR_____10_CM -32768. 32767. DISPLAY_IDENTIFIER C_N_DIF_TQ_ST_2 FORMAT "%5.0" /end CHARACTERISTIC
/begin CHARACTERISTIC ip_fac_n_dif_is "Idle self stabilizing factor" CURVE 0xffe4b156 _REC_CUR_20_u2_u2 15.999756 _CNV_A_R_LINEAR_____517_CM -8. 7.999756 DISPLAY_IDENTIFIER IP_FAC_N_DIF_IS FORMAT "%7.5"
 /begin AXIS_DESCR COM_AXIS n_sp_is_ratio _CNV_A_R_LINEAR_____394_CM 8 0. 7.99987793 FORMAT "%6.4" AXIS_PTS_REF ldp_n_sp_is_ratio /end AXIS_DESCR
/end CHARACTERISTIC
/begin CHARACTERISTIC ip_tqi_min_req_pu "Minimum requested indicated torque in PU phase" MAP 0xffe50296 _REC_MAP_20_u2_u1_u1 1023.96875 _CNV_A_R_LINEAR_____55_CM 0. 1023.96875 DISPLAY_IDENTIFIER IP_TQI_MIN_REQ_PU FORMAT "%7.2"
 /begin AXIS_DESCR COM_AXIS n_32 _CNV_A_R_LINEAR_____15_CM 12 0. 8160. FORMAT "%4.0" AXIS_PTS_REF ldpm_n_32__tqi_min_pu /end AXIS_DESCR
 /begin AXIS_DESCR COM_AXIS tco _CNV_A_R_LINEAR_____11_CM 4 -48. 142.5 FORMAT "%5.1" AXIS_PTS_REF ldpm_tco__tqi_min_pu /end AXIS_DESCR
/end CHARACTERISTIC
/begin AXIS_PTS ldp_n_sp_is_ratio "" 0xffe51136 n_sp_is_ratio _REC_AXS_20_u2 7.99987793 _CNV_A_R_LINEAR_____394_CM 8 0. 7.99987793 DISPLAY_IDENTIFIER LDP_N_SP_IS_RATIO FORMAT "%6.4" /end AXIS_PTS
/begin CHARACTERISTIC lc_tq_loss_min_clu "Change of  TQ_MIN_CLU_1 calculation" VALUE 0xffe40ff6 _REC_VAL_20_u1 1. _CNV_A_R_LINEAR_____22_CM 0. 1. DISPLAY_IDENTIFIER LC_TQ_LOSS_MIN_CLU FORMAT "%1.0" /end CHARACTERISTIC
/begin CHARACTERISTIC lc_tq_loss_min_clu_1 "Change of  TQ_MIN_CLU_1 calculation addional TQ lossses" VALUE 0xffe40ff7 _REC_VAL_20_u1 1. _CNV_A_R_LINEAR_____22_CM 0. 1. DISPLAY_IDENTIFIER LC_TQ_LOSS_MIN_CLU_1 FORMAT "%1.0" /end CHARACTERISTIC
/begin CHARACTERISTIC lc_tq_loss_min_clu_is "Change of  TQ_MIN_CLU_1 calculation addional switch at LV_IS " VALUE 0xffe40ff8 _REC_VAL_20_u1 1. _CNV_A_R_LINEAR_____22_CM 0. 1. DISPLAY_IDENTIFIER LC_TQ_LOSS_MIN_CLU_IS FORMAT "%1.0" /end CHARACTERISTIC
/begin CHARACTERISTIC lc_inh_pu_req "Manual inhibition to consider LV_PU for TQ_MIN_CLU calculation" VALUE 0xffe40f82 _REC_VAL_20_u1 1. _CNV_A_R_LINEAR_____0_CM 0. 1. DISPLAY_IDENTIFIER LC_INH_PU_REQ FORMAT "%2.0" /end CHARACTERISTIC
/begin CHARACTERISTIC lc_inh_puc_req "Manual inhibition to consider LV_PUC for TQ_MIN_CLU calculation" VALUE 0xffe40f83 _REC_VAL_20_u1 1. _CNV_A_R_LINEAR_____0_CM 0. 1. DISPLAY_IDENTIFIER LC_INH_PUC_REQ FORMAT "%2.0" /end CHARACTERISTIC
/begin MEASUREMENT fac_tq_req_clu "Torque scaling factor for calculation requested torque at clutch" UWORD _CNV_A_R_LINEAR_____20_CM 1 100. 0. 1.99996948 DISPLAY_IDENTIFIER FAC_TQ_REQ_CLU ECU_ADDRESS 0x3fdeba BYTE_ORDER MSB_LAST FORMAT "%7.5" /end MEASUREMENT
/begin MEASUREMENT lv_tq_cru_act "Logical variable cruise control active" UBYTE _CNV_S_2_RANGE______2_CM 1 100. 0. 1. DISPLAY_IDENTIFIER LV_TQ_CRU_ACT ECU_ADDRESS 0x3feb45 /end MEASUREMENT
/begin MEASUREMENT tq_req_clu "Requested torque at clutch" SWORD _CNV_A_R_LINEAR_____55_CM 1 100. -1024. 1023.96875 DISPLAY_IDENTIFIER TQ_REQ_CLU ECU_ADDRESS 0x3fdebc BYTE_ORDER MSB_LAST FORMAT "%6.2" /end MEASUREMENT
/begin MEASUREMENT tqi_min_req "Minimum indicated engine torque which can be requested from driver or cruise control" SWORD _CNV_A_R_LINEAR_____55_CM 1 100. -1024. 1023.96875 DISPLAY_IDENTIFIER TQI_MIN_REQ ECU_ADDRESS 0x3fdebe BYTE_ORDER MSB_LAST FORMAT "%8.2" /end MEASUREMENT
/begin MEASUREMENT fac_tq_req "Torque factor from pedal value interpretation and cruise control" UWORD _CNV_A_R_LINEAR_____20_CM 1 100. 0. 1.99996948 DISPLAY_IDENTIFIER FAC_TQ_REQ ECU_ADDRESS 0x3fdeb8 BYTE_ORDER MSB_LAST FORMAT "%7.5" /end MEASUREMENT
/begin MEASUREMENT tqi_vs_max "???" SWORD _CNV_A_R_LINEAR_____55_CM 1 100. -1024. 1023.96875 DISPLAY_IDENTIFIER TQI_VS_MAX ECU_ADDRESS 0x3fdee0 BYTE_ORDER MSB_LAST FORMAT "%6.2" /end MEASUREMENT
/begin MEASUREMENT tq_loss_scha "Torque losses super-charger" SWORD _CNV_A_R_LINEAR_____55_CM 1 100. -1024. 1023.96875 DISPLAY_IDENTIFIER TQ_LOSS_SCHA ECU_ADDRESS 0x3fded8 BYTE_ORDER MSB_LAST FORMAT "%8.2" /end MEASUREMENT
/begin MEASUREMENT lv_tq_loss_acc_inp_orng "???" UBYTE _CNV_S_2_RANGE______2_CM 1 100. 0. 1. DISPLAY_IDENTIFIER LV_TQ_LOSS_ACC_INP_ORNG ECU_ADDRESS 0x3feb4d BIT_MASK 0x1 /end MEASUREMENT
/begin MEASUREMENT lamb_bas_cor_max "Maximum value basic lambda value" UWORD _CNV_A_R_LINEAR_____206_CM 1 100. 0. 31.99902344 DISPLAY_IDENTIFIER LAMB_BAS_COR_MAX ECU_ADDRESS 0x3fdec2 BYTE_ORDER MSB_LAST FORMAT "%7.4" /end MEASUREMENT
/begin MEASUREMENT lv_can_gs_ack "???" UBYTE _CNV_S_2_RANGE______2_CM 1 100. 0. 1. DISPLAY_IDENTIFIER LV_CAN_GS_ACK ECU_ADDRESS 0x3feb4c BIT_MASK 0x1 /end MEASUREMENT
/begin MEASUREMENT lv_acp_orng "???" UBYTE _CNV_S_2_RANGE______21_CM 1 100. 0. 1. DISPLAY_IDENTIFIER LV_ACP_ORNG ECU_ADDRESS 0x3feb4e /end MEASUREMENT
/begin MEASUREMENT eff_egr_s "???" UWORD _CNV_A_R_LINEAR_____20_CM 1 100. 0. 1.99996948 DISPLAY_IDENTIFIER EFF_EGR_S ECU_ADDRESS 0x3fdec4 BYTE_ORDER MSB_LAST FORMAT "%7.5" /end MEASUREMENT
/begin MEASUREMENT eff_pha_s "???" UWORD _CNV_A_R_LINEAR_____20_CM 1 100. 0. 1.99996948 DISPLAY_IDENTIFIER EFF_PHA_S ECU_ADDRESS 0x3fdec6 BYTE_ORDER MSB_LAST FORMAT "%7.5" /end MEASUREMENT
/begin MEASUREMENT tq_ad_add_s_swi "Adaptive engine torque value for switch between hom. and strat." SWORD _CNV_A_R_LINEAR_____55_CM 1 100. -1024. 1023.96875 DISPLAY_IDENTIFIER TQ_AD_ADD_S_SWI ECU_ADDRESS 0x3fdee4 BYTE_ORDER MSB_LAST FORMAT "%7.1" /end MEASUREMENT
/begin MEASUREMENT tqi_cat_prot "???" SWORD _CNV_A_R_LINEAR_____55_CM 1 100. -1024. 1023.96875 DISPLAY_IDENTIFIER TQI_CAT_PROT ECU_ADDRESS 0x3fdee2 BYTE_ORDER MSB_LAST FORMAT "%6.2" /end MEASUREMENT
/begin MEASUREMENT tq_loss_sa "Torque losses power steering" SWORD _CNV_A_R_LINEAR_____55_CM 1 100. -1024. 1023.96875 DISPLAY_IDENTIFIER TQ_LOSS_SA ECU_ADDRESS 0x3fded6 BYTE_ORDER MSB_LAST FORMAT "%6.2" /end MEASUREMENT
/begin MEASUREMENT tq_loss_thermo "Engine torque losses thermostat" SWORD _CNV_A_R_LINEAR_____55_CM 1 100. -1024. 1023.96875 DISPLAY_IDENTIFIER TQ_LOSS_THERMO ECU_ADDRESS 0x3fdeda BYTE_ORDER MSB_LAST FORMAT "%8.2" /end MEASUREMENT
/begin MEASUREMENT tq_loss_win_heat "Engine torque losses rar window heater" SWORD _CNV_A_R_LINEAR_____55_CM 1 100. -1024. 1023.96875 DISPLAY_IDENTIFIER TQ_LOSS_WIN_HEAT ECU_ADDRESS 0x3fdedc BYTE_ORDER MSB_LAST FORMAT "%8.2" /end MEASUREMENT
/begin MEASUREMENT tq_loss_ecf "Engine torque losses electric cooling fan" SWORD _CNV_A_R_LINEAR_____55_CM 1 100. -1024. 1023.96875 DISPLAY_IDENTIFIER TQ_LOSS_ECF ECU_ADDRESS 0x3fdeea BYTE_ORDER MSB_LAST FORMAT "%6.2" /end MEASUREMENT
/begin CHARACTERISTIC c_lgrd_tq_loss_ecf "ECF-torque loss limitation gradient" VALUE 0xffe41720 _REC_VAL_20_u2 1023.96875 _CNV_A_R_LINEAR_____518_CM 0. 1023.96875 DISPLAY_IDENTIFIER C_LGRD_TQ_LOSS_ECF FORMAT "%7.2" /end CHARACTERISTIC
/begin CHARACTERISTIC ip_pow_loss_ecf "" CURVE 0xffe40d8f _REC_CUR_20_u1_u1 -5100. _CNV_A_R_LINEAR_____519_CM 0. -5100. DISPLAY_IDENTIFIER IP_POW_LOSS_ECF FORMAT "%5.0"
 /begin AXIS_DESCR COM_AXIS ecfpwm_ecf _CNV_A_R_LINEAR_____9_CM 8 0. 99.609375 FORMAT "%4.1" AXIS_PTS_REF ldp_ecfpwm_ecf__pow_loss_ecf /end AXIS_DESCR
/end CHARACTERISTIC
/begin AXIS_PTS ldp_ecfpwm_ecf__pow_loss_ecf "" 0xffe47f20 ecfpwm_ecf _REC_AXS_20_u1 99.609375 _CNV_A_R_LINEAR_____9_CM 8 0. 99.609375 DISPLAY_IDENTIFIER LDP_ECFPWM_ECF__POW_LOSS_ECF FORMAT "%4.1" /end AXIS_PTS
/begin CHARACTERISTIC c_fac_tqe "Effective engine torque at clutch" VALUE 0xffe4074b _REC_VAL_20_u1 0.24902344 _CNV_A_R_LINEAR_____520_CM 0. 0.24902344 DISPLAY_IDENTIFIER C_FAC_TQE FORMAT "%6.4" /end CHARACTERISTIC
/begin MEASUREMENT tqi_av_hom "Actual indicated engine torque for homogeneous mode" SWORD _CNV_A_R_LINEAR_____55_CM 1 100. -1024. 1023.96875 DISPLAY_IDENTIFIER TQI_AV_HOM ECU_ADDRESS 0x3fdd74 BYTE_ORDER MSB_LAST FORMAT "%6.2" /end MEASUREMENT
/begin MEASUREMENT tq_av "Actual engine torque static at clutch" SWORD _CNV_A_R_LINEAR_____55_CM 1 100. -1024. 1023.96875 DISPLAY_IDENTIFIER TQ_AV ECU_ADDRESS 0x3fdd6e BYTE_ORDER MSB_LAST FORMAT "%6.2" /end MEASUREMENT
/begin MEASUREMENT tqe "Effective engine torque at clutch" SWORD _CNV_A_R_LINEAR_____55_CM 1 100. -1024. 1023.96875 DISPLAY_IDENTIFIER TQE ECU_ADDRESS 0x3fdd70 BYTE_ORDER MSB_LAST FORMAT "%6.2" /end MEASUREMENT
/begin MEASUREMENT tqi_av "Actual indicated engine torque" SWORD _CNV_A_R_LINEAR_____55_CM 1 100. -1024. 1023.96875 DISPLAY_IDENTIFIER TQI_AV ECU_ADDRESS 0x3fdd6c BYTE_ORDER MSB_LAST FORMAT "%6.2" /end MEASUREMENT
/begin MEASUREMENT tqe_dif "Difference effective engine torque at clutch" SWORD _CNV_A_R_LINEAR_____55_CM 1 100. -1024. 1023.96875 DISPLAY_IDENTIFIER TQE_DIF ECU_ADDRESS 0x3fdd76 BYTE_ORDER MSB_LAST FORMAT "%6.2" /end MEASUREMENT
/begin MEASUREMENT eff_tot_av "Total actual efficiency (in homogeneous mode)" UWORD _CNV_A_R_LINEAR_____20_CM 1 100. 0. 1.99996948 DISPLAY_IDENTIFIER EFF_TOT_AV ECU_ADDRESS 0x3fdd72 BYTE_ORDER MSB_LAST FORMAT "%7.5" /end MEASUREMENT
/begin MEASUREMENT tqi_av_s "Actual indicated engine torque for stratified mode" SWORD _CNV_A_R_LINEAR_____55_CM 1 100. -1024. 1023.96875 DISPLAY_IDENTIFIER TQI_AV_S ECU_ADDRESS 0x3fdd78 BYTE_ORDER MSB_LAST FORMAT "%6.2" /end MEASUREMENT
/begin MEASUREMENT eff_tot_av_s "Total actual efficiency in stratified mode" UWORD _CNV_A_R_LINEAR_____20_CM 1 100. 0. 1.99996948 DISPLAY_IDENTIFIER EFF_TOT_AV_S ECU_ADDRESS 0x3fdd7a BYTE_ORDER MSB_LAST FORMAT "%7.5" /end MEASUREMENT
/begin MEASUREMENT tqi_ref_s "Indicated  reference engine torque for stratified mode" SWORD _CNV_A_R_LINEAR_____55_CM 1 100. -1024. 1023.96875 DISPLAY_IDENTIFIER TQI_REF_S ECU_ADDRESS 0x3fdd88 BYTE_ORDER MSB_LAST FORMAT "%8.2" /end MEASUREMENT
/begin CHARACTERISTIC ip_tqi_ref_s "Referenced indicated engine torque for stratified mode" MAP 0xffe50476 _REC_MAP_20_u2_u1_u2 2047.96875 _CNV_A_R_LINEAR_____187_CM -1024. 1023.96875 DISPLAY_IDENTIFIER IP_TQI_REF_S FORMAT "%6.2"
 /begin AXIS_DESCR COM_AXIS n_32 _CNV_A_R_LINEAR_____15_CM 16 0. 8160. FORMAT "%4.0" AXIS_PTS_REF ldpm_n_32_s /end AXIS_DESCR
 /begin AXIS_DESCR COM_AXIS mff_sp_s _CNV_A_R_LINEAR_____108_CM 12 0. 1389. FORMAT "%7.2" AXIS_PTS_REF ldp_mff_sp_s__tqi_ref_s /end AXIS_DESCR
/end CHARACTERISTIC
/begin AXIS_PTS ldp_mff_sp_s__tqi_ref_s "" 0xffe50f7c mff_sp_s _REC_AXS_20_u2 1389. _CNV_A_R_LINEAR_____108_CM 12 0. 1389. DISPLAY_IDENTIFIER LDP_MFF_SP_S__TQI_REF_S FORMAT "%7.2" /end AXIS_PTS
/begin MEASUREMENT tqi_bas "Basic indicated engine torque" SWORD _CNV_A_R_LINEAR_____55_CM 1 100. -1024. 1023.96875 DISPLAY_IDENTIFIER TQI_BAS ECU_ADDRESS 0x3fdd90 BYTE_ORDER MSB_LAST FORMAT "%6.2" /end MEASUREMENT
/begin MEASUREMENT tqi_ref_iga "Indicated engine torque corrected by EFF_IGA_BAS_COR" SWORD _CNV_A_R_LINEAR_____55_CM 1 100. -1024. 1023.96875 DISPLAY_IDENTIFIER TQI_REF_IGA ECU_ADDRESS 0x3fdd98 BYTE_ORDER MSB_LAST FORMAT "%6.2" /end MEASUREMENT
/begin MEASUREMENT tqi_ref_iga_lamb "Indicated engine torque corrected by EFF_IGA_BAS_COR and EFF_LAMB_BAS" SWORD _CNV_A_R_LINEAR_____55_CM 1 100. -1024. 1023.96875 DISPLAY_IDENTIFIER TQI_REF_IGA_LAMB ECU_ADDRESS 0x3fdd96 BYTE_ORDER MSB_LAST FORMAT "%6.2" /end MEASUREMENT
/begin MEASUREMENT tqi_ref_iga_min_lamb "Indicated engine torque corrected by EFF_IGA_MIN and EFF_LAMB_BAS" SWORD _CNV_A_R_LINEAR_____55_CM 1 100. -1024. 1023.96875 DISPLAY_IDENTIFIER TQI_REF_IGA_MIN_LAMB ECU_ADDRESS 0x3fdd9e BYTE_ORDER MSB_LAST FORMAT "%6.2" /end MEASUREMENT
/begin MEASUREMENT tqi_ref_iga_scc "Indicated engine torque corrected by EFF_IGA_BAS_COR and EFF_SCC_BAS" SWORD _CNV_A_R_LINEAR_____55_CM 1 100. -1024. 1023.96875 DISPLAY_IDENTIFIER TQI_REF_IGA_SCC ECU_ADDRESS 0x3fdd9c BYTE_ORDER MSB_LAST FORMAT "%6.2" /end MEASUREMENT
/begin MEASUREMENT tqi_ref_lamb "Indicated engine torque corrected by EFF_LAMB_BAS" SWORD _CNV_A_R_LINEAR_____55_CM 1 100. -1024. 1023.96875 DISPLAY_IDENTIFIER TQI_REF_LAMB ECU_ADDRESS 0x3fdd94 BYTE_ORDER MSB_LAST FORMAT "%6.2" /end MEASUREMENT
/begin MEASUREMENT tqi_ref_lamb_scc "Indicated engine torque corrected by EFF_LAMB_BAS and EFF_SCC_BAS" SWORD _CNV_A_R_LINEAR_____55_CM 1 100. -1024. 1023.96875 DISPLAY_IDENTIFIER TQI_REF_LAMB_SCC ECU_ADDRESS 0x3fdd92 BYTE_ORDER MSB_LAST FORMAT "%6.2" /end MEASUREMENT
/begin MEASUREMENT tqi_ref_scc "Indicated engine torque corrected by EFF_SCC_BAS" SWORD _CNV_A_R_LINEAR_____55_CM 1 100. -1024. 1023.96875 DISPLAY_IDENTIFIER TQI_REF_SCC ECU_ADDRESS 0x3fdd9a BYTE_ORDER MSB_LAST FORMAT "%6.2" /end MEASUREMENT
/begin MEASUREMENT tqi_ref "Reference indicated engine torque" SWORD _CNV_A_R_LINEAR_____55_CM 1 100. -1024. 1023.96875 DISPLAY_IDENTIFIER TQI_REF ECU_ADDRESS 0x3fdd8e BYTE_ORDER MSB_LAST FORMAT "%8.2" /end MEASUREMENT
/begin MEASUREMENT eff_tot_bas "Total basic efficiency" UWORD _CNV_A_R_LINEAR_____20_CM 1 100. 0. 1.99996948 DISPLAY_IDENTIFIER EFF_TOT_BAS ECU_ADDRESS 0x3fdd8a BYTE_ORDER MSB_LAST FORMAT "%7.5" /end MEASUREMENT
/begin MEASUREMENT eff_tot_bas_slow "Total basic efficiency for feedback to slow torque path" UWORD _CNV_A_R_LINEAR_____20_CM 1 100. 0. 1.99996948 DISPLAY_IDENTIFIER EFF_TOT_BAS_SLOW ECU_ADDRESS 0x3fdd8c BYTE_ORDER MSB_LAST FORMAT "%7.5" /end MEASUREMENT
/begin CHARACTERISTIC lc_mod_eff_av "Logical variable switch to EFF_LAMB_AV and EFF_SCC_AV calculation mode for TQI_BAS" VALUE 0xffe40fac _REC_VAL_20_u1 1. _CNV_A_R_LINEAR_____22_CM 0. 1. DISPLAY_IDENTIFIER LC_MOD_EFF_AV FORMAT "%1.0" /end CHARACTERISTIC
/begin MEASUREMENT lv_tq_inc "Logical variable torque increase active" UBYTE _CNV_S_2_RANGE______2_CM 1 100. 0. 1. DISPLAY_IDENTIFIER LV_TQ_INC ECU_ADDRESS 0x3feae5 /end MEASUREMENT
/begin MEASUREMENT tqi_ems "Requested indicated engine torque without external interventions" SWORD _CNV_A_R_LINEAR_____55_CM 1 100. -1024. 1023.96875 DISPLAY_IDENTIFIER TQI_EMS ECU_ADDRESS 0x3fdda4 BYTE_ORDER MSB_LAST FORMAT "%6.2" /end MEASUREMENT
/begin MEASUREMENT tqi_req_fast_dec "Fast torque decrease request" SWORD _CNV_A_R_LINEAR_____55_CM 1 100. -1024. 1023.96875 DISPLAY_IDENTIFIER TQI_REQ_FAST_DEC ECU_ADDRESS 0x3fddae BYTE_ORDER MSB_LAST FORMAT "%6.2" /end MEASUREMENT
/begin MEASUREMENT tqi_inter_fast "Intermitted value fast torque request after minimum selection" SWORD _CNV_A_R_LINEAR_____55_CM 1 100. -1024. 1023.96875 DISPLAY_IDENTIFIER TQI_INTER_FAST ECU_ADDRESS 0x3fddaa BYTE_ORDER MSB_LAST FORMAT "%6.2" /end MEASUREMENT
/begin MEASUREMENT tqi_req_fast_inc "Fast torque increase request" SWORD _CNV_A_R_LINEAR_____55_CM 1 100. -1024. 1023.96875 DISPLAY_IDENTIFIER TQI_REQ_FAST_INC ECU_ADDRESS 0x3fddac BYTE_ORDER MSB_LAST FORMAT "%6.2" /end MEASUREMENT
/begin MEASUREMENT tqi_inter_slow "Intermitted value slow torque request after minimum selection" SWORD _CNV_A_R_LINEAR_____55_CM 1 100. -1024. 1023.96875 DISPLAY_IDENTIFIER TQI_INTER_SLOW ECU_ADDRESS 0x3fdda8 BYTE_ORDER MSB_LAST FORMAT "%6.2" /end MEASUREMENT
/begin MEASUREMENT tqi_req_slow_sel "Slow indicated engine torque request selected" SWORD _CNV_A_R_LINEAR_____55_CM 1 100. -1024. 1023.96875 DISPLAY_IDENTIFIER TQI_REQ_SLOW_SEL ECU_ADDRESS 0x3fdda0 BYTE_ORDER MSB_LAST FORMAT "%6.2" /end MEASUREMENT
/begin MEASUREMENT tqi_req_fast_sel "Fast indicated engine torque request selected" SWORD _CNV_A_R_LINEAR_____55_CM 1 100. -1024. 1023.96875 DISPLAY_IDENTIFIER TQI_REQ_FAST_SEL ECU_ADDRESS 0x3fdda2 BYTE_ORDER MSB_LAST FORMAT "%6.2" /end MEASUREMENT
/begin MEASUREMENT tqi_req_fast_sel_can "Requested indicated engine torque without external interventions for CAN" SWORD _CNV_A_R_LINEAR_____55_CM 1 100. -1024. 1023.96875 DISPLAY_IDENTIFIER TQI_REQ_FAST_SEL_CAN ECU_ADDRESS 0x3fdda6 BYTE_ORDER MSB_LAST FORMAT "%6.2" /end MEASUREMENT
/begin MEASUREMENT state_tq_intv_slow "Air paph external torque intervention" UBYTE _CNV_S_8_RANGE_STAT_521_CM 1 100. 0. 7. DISPLAY_IDENTIFIER STATE_TQ_INTV_SLOW ECU_ADDRESS 0x3feae3 /end MEASUREMENT
/begin MEASUREMENT state_tq_intv_fast "Fast external torque intervention" UBYTE _CNV_S_8_RANGE_STAT_521_CM 1 100. 0. 7. DISPLAY_IDENTIFIER STATE_TQ_INTV_FAST ECU_ADDRESS 0x3feae4 /end MEASUREMENT
/begin MEASUREMENT tq_add_req_ch "Requested torque reserve for catalyt-heating" SWORD _CNV_A_R_LINEAR_____55_CM 1 100. -1024. 1023.96875 DISPLAY_IDENTIFIER TQ_ADD_REQ_CH ECU_ADDRESS 0x3fddce BYTE_ORDER MSB_LAST FORMAT "%6.2" /end MEASUREMENT
/begin MEASUREMENT tq_add_max "Maximum possible torque reserve" SWORD _CNV_A_R_LINEAR_____55_CM 1 100. -1024. 1023.96875 DISPLAY_IDENTIFIER TQ_ADD_MAX ECU_ADDRESS 0x3fddbe BYTE_ORDER MSB_LAST FORMAT "%6.2" /end MEASUREMENT
/begin MEASUREMENT tq_add_req_max_teg "Maximum possible torque reserve request due to EFF_IGA_MIN_TEG" SWORD _CNV_A_R_LINEAR_____55_CM 1 100. -1024. 1023.96875 DISPLAY_IDENTIFIER TQ_ADD_REQ_MAX_TEG ECU_ADDRESS 0x3fddcc BYTE_ORDER MSB_LAST FORMAT "%6.2" /end MEASUREMENT
/begin MEASUREMENT maf_kgh_add_max "Maximum possible engine load for catalyst heating - kg/h" UWORD _CNV_A_R_LINEAR_____115_CM 1 100. 0. 2047.96875 DISPLAY_IDENTIFIER MAF_KGH_ADD_MAX ECU_ADDRESS 0x3fddb0 BYTE_ORDER MSB_LAST FORMAT "%7.2" /end MEASUREMENT
/begin MEASUREMENT maf_add_max "Maximum possible engine load for catalyst heating - mg/Stk" UWORD _CNV_A_R_LINEAR_____108_CM 1 100. 0. 1389. DISPLAY_IDENTIFIER MAF_ADD_MAX ECU_ADDRESS 0x3fddb2 BYTE_ORDER MSB_LAST FORMAT "%7.2" /end MEASUREMENT
/begin MEASUREMENT tqi_add_act "Active indicated engine torque inclusive torque reserve" SWORD _CNV_A_R_LINEAR_____55_CM 1 100. -1024. 1023.96875 DISPLAY_IDENTIFIER TQI_ADD_ACT ECU_ADDRESS 0x3fddb6 BYTE_ORDER MSB_LAST FORMAT "%6.2" /end MEASUREMENT
/begin MEASUREMENT eff_iga_min_add_max "Minimum possible ignition efficiency for catalyst heating" UWORD _CNV_A_R_LINEAR_____20_CM 1 100. 0. 1.99996948 DISPLAY_IDENTIFIER EFF_IGA_MIN_ADD_MAX ECU_ADDRESS 0x3fddb4 BYTE_ORDER MSB_LAST FORMAT "%7.5" /end MEASUREMENT
/begin MEASUREMENT tqi_add_max "Maximum possible indicated engine torque inclusive torque reserve" SWORD _CNV_A_R_LINEAR_____55_CM 1 100. -1024. 1023.96875 DISPLAY_IDENTIFIER TQI_ADD_MAX ECU_ADDRESS 0x3fddb8 BYTE_ORDER MSB_LAST FORMAT "%6.2" /end MEASUREMENT
/begin MEASUREMENT lv_tq_add_req "Logical variable torque reserve request can be applied" UBYTE _CNV_S_2_RANGE______2_CM 1 100. 0. 1. DISPLAY_IDENTIFIER LV_TQ_ADD_REQ ECU_ADDRESS 0x3feae6 /end MEASUREMENT
/begin MEASUREMENT tq_add_act "Active clutch torque inclusive torque reserve" SWORD _CNV_A_R_LINEAR_____55_CM 1 100. -1024. 1023.96875 DISPLAY_IDENTIFIER TQ_ADD_ACT ECU_ADDRESS 0x3fddba BYTE_ORDER MSB_LAST FORMAT "%7.1" /end MEASUREMENT
/begin MEASUREMENT tqi_add_act_tmp_1 "Temporary indicated engine-torque request inclusive torque reserve - for slow torque coordination input" SWORD _CNV_A_R_LINEAR_____55_CM 1 100. -1024. 1023.96875 DISPLAY_IDENTIFIER TQI_ADD_ACT_TMP_1 ECU_ADDRESS 0x3fddc4 BYTE_ORDER MSB_LAST FORMAT "%6.2" /end MEASUREMENT
/begin MEASUREMENT tq_add_req "Requested torque reserve after max.coordination" SWORD _CNV_A_R_LINEAR_____55_CM 1 100. -1024. 1023.96875 DISPLAY_IDENTIFIER TQ_ADD_REQ ECU_ADDRESS 0x3fddc2 BYTE_ORDER MSB_LAST FORMAT "%6.2" /end MEASUREMENT
/begin MEASUREMENT tqi_add_act_tmp_2 "Indicated engine-torque request inclusive torque reserve - for general torque-reserve request" SWORD _CNV_A_R_LINEAR_____55_CM 1 100. -1024. 1023.96875 DISPLAY_IDENTIFIER TQI_ADD_ACT_TMP_2 ECU_ADDRESS 0x3fddc6 BYTE_ORDER MSB_LAST FORMAT "%6.2" /end MEASUREMENT
/begin MEASUREMENT tqi_add_act_tmp_3 "Indicated engine-torque request inclusive torque reserve - for catalyst-heating torque-reserve request" SWORD _CNV_A_R_LINEAR_____55_CM 1 100. -1024. 1023.96875 DISPLAY_IDENTIFIER TQI_ADD_ACT_TMP_3 ECU_ADDRESS 0x3fddc8 BYTE_ORDER MSB_LAST FORMAT "%6.2" /end MEASUREMENT
/begin MEASUREMENT tqi_add_max_tol "Maximum possible indicated engine torque inclusive torque reserve at IGA_MIN" SWORD _CNV_A_R_LINEAR_____55_CM 1 100. -1024. 1023.96875 DISPLAY_IDENTIFIER TQI_ADD_MAX_TOL ECU_ADDRESS 0x3fddc0 BYTE_ORDER MSB_LAST FORMAT "%6.2" /end MEASUREMENT
/begin MEASUREMENT tqi_add_max_teg "Maximum possible indicated engine torque inclusive torque reserve at IGA_MIN_TEG" SWORD _CNV_A_R_LINEAR_____55_CM 1 100. -1024. 1023.96875 DISPLAY_IDENTIFIER TQI_ADD_MAX_TEG ECU_ADDRESS 0x3fddca BYTE_ORDER MSB_LAST FORMAT "%6.2" /end MEASUREMENT
/begin MEASUREMENT lv_tq_add_req_1 "Logical variable torque reserve request can be applied" UBYTE _CNV_S_2_RANGE______21_CM 1 100. 0. 1. DISPLAY_IDENTIFIER LV_TQ_ADD_REQ_1 ECU_ADDRESS 0x3feae7 /end MEASUREMENT
/begin MEASUREMENT tq_add_req_act "Actual realized torque-reserve-request for slow torque coordination input" SWORD _CNV_A_R_LINEAR_____55_CM 1 100. -1024. 1023.96875 DISPLAY_IDENTIFIER TQ_ADD_REQ_ACT ECU_ADDRESS 0x3fddbc BYTE_ORDER MSB_LAST FORMAT "%6.2" /end MEASUREMENT
/begin MEASUREMENT lv_tq_add_req_2 "Logical variable torque reserve request can be applied" UBYTE _CNV_S_2_RANGE______21_CM 1 100. 0. 1. DISPLAY_IDENTIFIER LV_TQ_ADD_REQ_2 ECU_ADDRESS 0x3feae8 /end MEASUREMENT
/begin CHARACTERISTIC lc_inh_tq_add_ch "Logical constant for deactivation torque-reserve request for catalyst heating" VALUE 0xffe40f88 _REC_VAL_20_u1 1. _CNV_A_R_LINEAR_____0_CM 0. 1. DISPLAY_IDENTIFIER LC_INH_TQ_ADD_CH FORMAT "%2.0" /end CHARACTERISTIC
/begin CHARACTERISTIC lc_inh_tq_add "Logical constant for deactivation general torque-reserve request" VALUE 0xffe40f87 _REC_VAL_20_u1 1. _CNV_A_R_LINEAR_____0_CM 0. 1. DISPLAY_IDENTIFIER LC_INH_TQ_ADD FORMAT "%2.0" /end CHARACTERISTIC
/begin CHARACTERISTIC c_tq_add_min_ch "Minimum threshold for authorizing torque request for catalyst heating" VALUE 0xffe404ac _REC_VAL_20_s2 2047.96875 _CNV_A_R_LINEAR_____55_CM -1024. 1023.96875 DISPLAY_IDENTIFIER C_TQ_ADD_MIN_CH FORMAT "%7.1" /end CHARACTERISTIC
/begin CHARACTERISTIC c_tq_add_hys "Torque lead hysteresis for deactivation torque lead request" VALUE 0xffe404a6 _REC_VAL_20_s2 2047.96875 _CNV_A_R_LINEAR_____55_CM -1024. 1023.96875 DISPLAY_IDENTIFIER C_TQ_ADD_HYS FORMAT "%7.1" /end CHARACTERISTIC
/begin CHARACTERISTIC c_tq_add_hys_cru "Torque lead hysteresis for deactivation torque lead request at active cruise control" VALUE 0xffe404a8 _REC_VAL_20_s2 2047.96875 _CNV_A_R_LINEAR_____55_CM -1024. 1023.96875 DISPLAY_IDENTIFIER C_TQ_ADD_HYS_CRU FORMAT "%7.1" /end CHARACTERISTIC
/begin CHARACTERISTIC c_tq_add_min "Minimum threshold for authorizing torque lead request" VALUE 0xffe404aa _REC_VAL_20_s2 2047.96875 _CNV_A_R_LINEAR_____55_CM -1024. 1023.96875 DISPLAY_IDENTIFIER C_TQ_ADD_MIN FORMAT "%7.1" /end CHARACTERISTIC
/begin CHARACTERISTIC c_tq_add_min_cru "Minimum threshold for authorizing torque lead request at active cruise control" VALUE 0xffe404ae _REC_VAL_20_s2 2047.96875 _CNV_A_R_LINEAR_____55_CM -1024. 1023.96875 DISPLAY_IDENTIFIER C_TQ_ADD_MIN_CRU FORMAT "%7.1" /end CHARACTERISTIC
/begin MEASUREMENT tq_add_st "Torque reserve at engine start" SWORD _CNV_A_R_LINEAR_____55_CM 1 100. -1024. 1023.96875 DISPLAY_IDENTIFIER TQ_ADD_ST ECU_ADDRESS 0x3fde5a BYTE_ORDER MSB_LAST FORMAT "%6.2" /end MEASUREMENT
/begin MEASUREMENT lv_tq_add_st "Logical variable torque reserve at engine start" UBYTE _CNV_S_2_RANGE______2_CM 1 100. 0. 1. DISPLAY_IDENTIFIER LV_TQ_ADD_ST ECU_ADDRESS 0x3feb1c BIT_MASK 0x1 /end MEASUREMENT
/begin CHARACTERISTIC c_t_tq_add_dly_st "Time delay for deactivation torque lead" VALUE 0xffe41a1c _REC_VAL_20_u2 655.35 _CNV_A_R_LINEAR_____4_CM 0. 655.35 DISPLAY_IDENTIFIER C_T_TQ_ADD_DLY_ST FORMAT "%5.2" /end CHARACTERISTIC
/begin CHARACTERISTIC c_tq_add_crlc_st "Correlation constant for torque  lead" VALUE 0xffe4098a _REC_VAL_20_u1 0.9960940000000002 _CNV_A_R_LINEAR_____50_CM 0. 0.996094 DISPLAY_IDENTIFIER C_TQ_ADD_CRLC_ST FORMAT "%5.3" /end CHARACTERISTIC
/begin AXIS_PTS ldp_n_tq_add_st "" 0xffe48159 n_32 _REC_AXS_20_u1 8160. _CNV_A_R_LINEAR_____15_CM 8 0. 8160. DISPLAY_IDENTIFIER LDP_N_TQ_ADD_ST FORMAT "%4.0" /end AXIS_PTS
/begin AXIS_PTS ldp_tco_tq_add_st "" 0xffe41250 tco _REC_AXS_20_u1 190.5 _CNV_A_R_LINEAR_____11_CM 4 -48. 142.5 DISPLAY_IDENTIFIER LDP_TCO_TQ_ADD_ST FORMAT "%5.1" /end AXIS_PTS
/begin CHARACTERISTIC ip_tq_add_st "Torque lead at engine start" MAP 0xffe4fa1e _REC_MAP_20_u2_u1_u1 2047.96875 _CNV_A_R_LINEAR_____187_CM -1024. 1023.96875 DISPLAY_IDENTIFIER IP_TQ_ADD_ST FORMAT "%6.2"
 /begin AXIS_DESCR COM_AXIS n_32 _CNV_A_R_LINEAR_____15_CM 8 0. 8160. FORMAT "%4.0" AXIS_PTS_REF ldp_n_tq_add_st /end AXIS_DESCR
 /begin AXIS_DESCR COM_AXIS tco _CNV_A_R_LINEAR_____11_CM 4 -48. 142.5 FORMAT "%5.1" AXIS_PTS_REF ldp_tco_tq_add_st /end AXIS_DESCR
/end CHARACTERISTIC
/begin MEASUREMENT tqi_p_max "???" SWORD _CNV_A_R_LINEAR_____55_CM 1 100. -1024. 1023.96875 DISPLAY_IDENTIFIER TQI_P_MAX ECU_ADDRESS 0x3fdf12 BYTE_ORDER MSB_LAST FORMAT "%6.2" /end MEASUREMENT
/begin CHARACTERISTIC DOLNIV "" VALUE 0xffe5b812 _REC_VAL_20_u1 127.5 _CNV_R_R_tog_ub_q0p_573_CM 0. 127.5 FORMAT "%5.1" /end CHARACTERISTIC
/begin CHARACTERISTIC ORIVERZ "" VALUE 0xffe5b813 _REC_VAL_20_u1 255. _CNV_R_R_dez_550_CM 0. 255. FORMAT "%5.1" /end CHARACTERISTIC
/begin CHARACTERISTIC PT1NMOT "" VALUE 0xffe5b814 _REC_VAL_20_u1 100. _CNV_R_R_rel_ub_b10_574_CM 0. 100. FORMAT "%5.1" /end CHARACTERISTIC
/begin CHARACTERISTIC PT1TOEL "" VALUE 0xffe5b80a _REC_VAL_20_u2 99.99847 _CNV_R_R_rel_uw_b10_575_CM 0. 99.99847 FORMAT "%8.5" /end CHARACTERISTIC
/begin CHARACTERISTIC TOGANZ "" VALUE 0xffe5b80c _REC_VAL_20_u2 2999. _CNV_R_R_dez_550_CM 1. 3000. FORMAT "%8.3" /end CHARACTERISTIC
/begin CHARACTERISTIC TOGKURZANZ "" VALUE 0xffe5b80e _REC_VAL_20_u2 999. _CNV_A_R_LINEAR_____22_CM 1. 1000. FORMAT "%5.0" /end CHARACTERISTIC
/begin CHARACTERISTIC TOGMWK "" VALUE 0xffe5b815 _REC_VAL_20_u1 99. _CNV_R_R_dez_550_CM 1. 100. FORMAT "%5.1" /end CHARACTERISTIC
/begin CHARACTERISTIC TOGNMOT "" VALUE 0xffe5b816 _REC_VAL_20_u1 10200. _CNV_R_R_nmot_ub_q4_576_CM 0. 10200. FORMAT "%5.0" /end CHARACTERISTIC
/begin CHARACTERISTIC TOGORIANZ "" VALUE 0xffe5b817 _REC_VAL_20_u1 254. _CNV_R_R_dez_550_CM 1. 255. FORMAT "%5.1" /end CHARACTERISTIC
/begin CHARACTERISTIC TOGTMOT "" VALUE 0xffe5b818 _REC_VAL_20_u1 191.3 _CNV_R_R_temp_uw_q0_577_CM -48. 143.3 FORMAT "%5.1" /end CHARACTERISTIC
/begin CHARACTERISTIC TOGTMOTORI "" VALUE 0xffe5b819 _REC_VAL_20_u1 191.3 _CNV_R_R_temp_uw_q0_577_CM -48. 143.3 FORMAT "%5.1" /end CHARACTERISTIC
/begin CHARACTERISTIC TOGVERBKZ "" VALUE 0xffe5b81a _REC_VAL_20_u1 127.5 _CNV_R_R_tog_ub_q0p_573_CM 0. 127.5 FORMAT "%5.1" /end CHARACTERISTIC
/begin CHARACTERISTIC TOGVERBNOR "" VALUE 0xffe5b81b _REC_VAL_20_u1 127.5 _CNV_R_R_tog_ub_q0p_573_CM 0. 127.5 FORMAT "%5.1" /end CHARACTERISTIC
/begin CHARACTERISTIC TOGVERLKZ "" VALUE 0xffe5b81c _REC_VAL_20_u1 127.5 _CNV_R_R_tog_ub_q0p_573_CM 0. 127.5 FORMAT "%5.1" /end CHARACTERISTIC
/begin CHARACTERISTIC TOGVERLNOR "" VALUE 0xffe5b81d _REC_VAL_20_u1 127.5 _CNV_R_R_tog_ub_q0p_573_CM 0. 127.5 FORMAT "%5.1" /end CHARACTERISTIC
/begin CHARACTERISTIC TOGVERLORI "" VALUE 0xffe5b81e _REC_VAL_20_u1 127.5 _CNV_R_R_tog_ub_q0p_573_CM 0. 127.5 FORMAT "%5.1" /end CHARACTERISTIC
/begin CHARACTERISTIC TRTYP "" VALUE 0xffe5b810 _REC_VAL_20_u2 6553.5 _CNV_R_R_t_q0p1ms_578_CM 0. 6553.5 FORMAT "%8.3" /end CHARACTERISTIC
/begin CHARACTERISTIC KLTOGNKOR "" CURVE 0xffe5b7e8 _REC_CUR_52_UBYTE_s1_u1 127.5 _CNV_R_R_tog_ub_q0p_573_CM -64. 63.5 FORMAT "%5.2"
 /begin AXIS_DESCR STD_AXIS nmotfm _CNV_R_R_nmot_ub_q4_576_CM 16 0. 10200. FORMAT "%6.1" /end AXIS_DESCR
/end CHARACTERISTIC
/begin CHARACTERISTIC KLTKTOENIV "" CURVE 0xffe5b7ac _REC_CUR_52_UWORD_u2_u2 127.5 _CNV_R_R_tog_ub_q0p_579_CM 0. 127.5 FORMAT "%5.2"
 /begin AXIS_DESCR STD_AXIS Tog_tk _CNV_A_R_LINEAR_____580_CM 7 0. 6553.5 FORMAT "%6.1" /end AXIS_DESCR
/end CHARACTERISTIC
/begin CHARACTERISTIC KLTVTOEL "" CURVE 0xffe5b7ca _REC_CUR_52_u2_u2 208. _CNV_A_R_LINEAR_____581_CM -48. 160. FORMAT "%5.1"
 /begin AXIS_DESCR STD_AXIS Toel_t _CNV_A_R_LINEAR_____580_CM 7 0.1 6553.5 FORMAT "%7.2" /end AXIS_DESCR
/end CHARACTERISTIC
/begin MEASUREMENT B_oelverb "" UBYTE _CNV_S_2_B_TRUE_582_CM 1 100. 0. 1. DISPLAY_IDENTIFIER B_OELVERB ECU_ADDRESS 0x3faa69 /end MEASUREMENT
/begin MEASUREMENT nmotf "" UBYTE _CNV_R_R_nmot_ub_q4_576_CM 1 100. 0. 10200. DISPLAY_IDENTIFIER NMOTF ECU_ADDRESS 0x3faa70 FORMAT "%5.0" /end MEASUREMENT
/begin MEASUREMENT nmotfm "" UBYTE _CNV_R_R_nmot_ub_q4_576_CM 1 100. 0. 10200. DISPLAY_IDENTIFIER NMOTFM ECU_ADDRESS 0x3faa71 FORMAT "%6.1" /end MEASUREMENT
/begin MEASUREMENT nmotfsum "" UWORD _CNV_A_R_LINEAR_____583_CM 1 100. 0. 2621400. DISPLAY_IDENTIFIER NMOTFSUM ECU_ADDRESS 0x3faa6c BYTE_ORDER MSB_LAST FORMAT "%8.0" /end MEASUREMENT
/begin MEASUREMENT Oelnivak "" UBYTE _CNV_R_R_tog_ub_q0p_573_CM 1 100. 0. 127.5 DISPLAY_IDENTIFIER OELNIVAK ECU_ADDRESS 0x3fa444 FORMAT "%5.1" /end MEASUREMENT
/begin MEASUREMENT Oelnivaknk "" UBYTE _CNV_R_R_tog_ub_q0p_573_CM 1 100. 0. 127.5 DISPLAY_IDENTIFIER OELNIVAKNK ECU_ADDRESS 0x3faa72 FORMAT "%5.1" /end MEASUREMENT
/begin MEASUREMENT Oelnivnksm "" UWORD _CNV_R_R_tog_ub_q0p_573_CM 1 100. 0. 32767.5 DISPLAY_IDENTIFIER OELNIVNKSM ECU_ADDRESS 0x3faa6e BYTE_ORDER MSB_LAST FORMAT "%8.2" /end MEASUREMENT
/begin MEASUREMENT Oelnivnorm "" UBYTE _CNV_R_R_tog_ub_q0p_573_CM 1 100. 0. 127.5 DISPLAY_IDENTIFIER OELNIVNORM ECU_ADDRESS 0x3fa447 FORMAT "%5.1" /end MEASUREMENT
/begin MEASUREMENT Oelnivori "" UBYTE _CNV_R_R_tog_ub_q0p_573_CM 1 100. 0. 127.5 DISPLAY_IDENTIFIER OELNIVORI ECU_ADDRESS 0x3fa448 FORMAT "%5.1" /end MEASUREMENT
/begin MEASUREMENT Oelnivsum "" ULONG _CNV_A_R_LINEAR_____584_CM 1 100. 0. 2147483647.5 DISPLAY_IDENTIFIER OELNIVSUM ECU_ADDRESS 0x3fa43c BYTE_ORDER MSB_LAST FORMAT "%13.2" /end MEASUREMENT
/begin MEASUREMENT Oelnivsumw "" ULONG _CNV_A_R_LINEAR_____584_CM 1 100. 0. 2147483647.5 DISPLAY_IDENTIFIER OELNIVSUMW ECU_ADDRESS 0x3fa440 BYTE_ORDER MSB_LAST FORMAT "%13.2" /end MEASUREMENT
/begin MEASUREMENT Oriverzz "" UBYTE _CNV_R_R_dez_550_CM 1 100. 0. 255. DISPLAY_IDENTIFIER ORIVERZZ ECU_ADDRESS 0x3faa73 FORMAT "%5.1" /end MEASUREMENT
/begin MEASUREMENT Toel_t "" UWORD _CNV_R_R_t_q0p1ms_578_CM 1 100. 0. 6553.5 DISPLAY_IDENTIFIER TOEL_T ECU_ADDRESS 0x3fa438 BYTE_ORDER MSB_LAST FORMAT "%8.3" /end MEASUREMENT
/begin MEASUREMENT togbw_i "" UWORD _CNV_R_R_dez_550_CM 1 100. 0. 255. DISPLAY_IDENTIFIER TOGBW_I ECU_ADDRESS 0x3fa43a BYTE_ORDER MSB_LAST FORMAT "%8.4" /end MEASUREMENT
/begin MEASUREMENT togk_i "" UBYTE _CNV_R_R_dez_550_CM 1 100. 0. 255. DISPLAY_IDENTIFIER TOGK_I ECU_ADDRESS 0x3fa449 FORMAT "%5.1" /end MEASUREMENT
/begin MEASUREMENT tog_i "" UBYTE _CNV_R_R_dez_550_CM 1 100. 0. 255. DISPLAY_IDENTIFIER TOG_I ECU_ADDRESS 0x3faa74 FORMAT "%5.1" /end MEASUREMENT
/begin MEASUREMENT tog_k "" UBYTE _CNV_S_2_B_TRUE_582_CM 1 100. 0. 1. DISPLAY_IDENTIFIER TOG_K ECU_ADDRESS 0x3faa6b /end MEASUREMENT
/begin MEASUREMENT B_oelverl "" UBYTE _CNV_S_2_B_TRUE_582_CM 1 100. 0. 1. DISPLAY_IDENTIFIER B_OELVERL ECU_ADDRESS 0x3faa6a /end MEASUREMENT
/begin MEASUREMENT Oelnivkurz "" UBYTE _CNV_R_R_tog_ub_q0p_573_CM 1 100. 0. 127.5 DISPLAY_IDENTIFIER OELNIVKURZ ECU_ADDRESS 0x3fa445 FORMAT "%5.1" /end MEASUREMENT
/begin MEASUREMENT Oelnivm "" UBYTE _CNV_R_R_tog_ub_q0p_573_CM 1 100. 0. 127.5 DISPLAY_IDENTIFIER OELNIVM ECU_ADDRESS 0x3fa446 FORMAT "%5.1" /end MEASUREMENT
/begin MEASUREMENT lv_rng_l_req_mon2 "Activation condition for low-range-mode by process monitoring" UBYTE _CNV_S_2_RANGE______2_CM 1 100. 0. 1. DISPLAY_IDENTIFIER LV_RNG_L_REQ_MON2 ECU_ADDRESS 0x3fec8b /end MEASUREMENT
/begin AXIS_PTS ldpm_n_32__tqi_min_pu "" 0xffe48507 n_32 _REC_AXS_20_u1 8160. _CNV_A_R_LINEAR_____15_CM 12 0. 8160. DISPLAY_IDENTIFIER LDPM_N_32__TQI_MIN_PU FORMAT "%4.0" /end AXIS_PTS
/begin AXIS_PTS ldpm_tco__tqi_min_pu "" 0xffe41452 tco _REC_AXS_20_u1 190.5 _CNV_A_R_LINEAR_____11_CM 4 -48. 142.5 DISPLAY_IDENTIFIER LDPM_TCO__TQI_MIN_PU FORMAT "%5.1" /end AXIS_PTS
/begin AXIS_PTS ldpm_n_32_s "" 0xffe4856d n_32 _REC_AXS_20_u1 8160. _CNV_A_R_LINEAR_____15_CM 16 0. 8160. DISPLAY_IDENTIFIER LDPM_N_32_S FORMAT "%4.0" /end AXIS_PTS
/begin CHARACTERISTIC ip_t_ramp_conv_neg__toil "Ramp after shift disengaging" CURVE 0xffe40e58 _REC_CUR_20_u1_u1 2550. _CNV_A_R_LINEAR_____31_CM 0. 2550. DISPLAY_IDENTIFIER IP_T_RAMP_CONV_NEG__TOIL FORMAT "%4.0"
 /begin AXIS_DESCR COM_AXIS toil _CNV_A_R_LINEAR_____14_CM 8 -40. 160. FORMAT "%3.0" AXIS_PTS_REF ldp_toil_t_ramp_conv_neg /end AXIS_DESCR
/end CHARACTERISTIC
/begin CHARACTERISTIC ip_t_ramp_conv_pos__toil "Ramp after shift engaging" CURVE 0xffe40e60 _REC_CUR_20_u1_u1 2550. _CNV_A_R_LINEAR_____31_CM 0. 2550. DISPLAY_IDENTIFIER IP_T_RAMP_CONV_POS__TOIL FORMAT "%4.0"
 /begin AXIS_DESCR COM_AXIS toil _CNV_A_R_LINEAR_____14_CM 8 -40. 160. FORMAT "%3.0" AXIS_PTS_REF ldp_toil_t_ramp_conv_pos /end AXIS_DESCR
/end CHARACTERISTIC
/begin AXIS_PTS ldp_toil_t_ramp_conv_pos "" 0xffe482d4 toil _REC_AXS_20_u1 200. _CNV_A_R_LINEAR_____14_CM 8 -40. 160. DISPLAY_IDENTIFIER LDP_TOIL_T_RAMP_CONV_POS FORMAT "%3.0" /end AXIS_PTS
/begin AXIS_PTS ldp_toil_t_ramp_conv_neg "" 0xffe482cb toil _REC_AXS_20_u1 200. _CNV_A_R_LINEAR_____14_CM 8 -40. 160. DISPLAY_IDENTIFIER LDP_TOIL_T_RAMP_CONV_NEG FORMAT "%3.0" /end AXIS_PTS
/begin MEASUREMENT tq_add_pl_drof "TQ reserve for drive off support" UWORD _CNV_A_R_LINEAR_____55_CM 1 100. 0. 1023.96875 DISPLAY_IDENTIFIER TQ_ADD_PL_DROF ECU_ADDRESS 0x3fd862 BYTE_ORDER MSB_LAST FORMAT "%7.2" /end MEASUREMENT
/begin MEASUREMENT n_dif_pred_pl_drof "Predicted idle speed control variable at drive-off-support" SWORD _CNV_A_R_LINEAR_____10_CM 1 100. -32768. 32767. DISPLAY_IDENTIFIER N_DIF_PRED_PL_DROF ECU_ADDRESS 0x3fd864 BYTE_ORDER MSB_LAST FORMAT "%6.0" /end MEASUREMENT
/begin MEASUREMENT lv_fast_load_im "Fast Manifold Filling enabled" UBYTE _CNV_S_2_RANGE______2_CM 1 100. 0. 1. DISPLAY_IDENTIFIER LV_FAST_LOAD_IM ECU_ADDRESS 0x3fe781 /end MEASUREMENT
/begin CHARACTERISTIC ip_t_n_dif_ofs_pred_drof "Time constant for calculation of predicted engine speed deviation at drive-off-support (PL)" CURVE 0xffe40e50 _REC_CUR_20_u1_u2 7.96875 _CNV_A_R_LINEAR_____218_CM 0. 7.96875 DISPLAY_IDENTIFIER IP_T_N_DIF_OFS_PRED_DROF FORMAT "%4.2"
 /begin AXIS_DESCR COM_AXIS n _CNV_A_R_LINEAR_____10_CM 8 0. 8160. FORMAT "%4.0" AXIS_PTS_REF ldpm_n_t_n_dif_ofs_pred /end AXIS_DESCR
/end CHARACTERISTIC
/begin AXIS_PTS ldpm_n_dif_pred_fac_tq_add_is "" 0xffe51b9e n_dif_pred_pl_drof _REC_AXS_20_u2 65535. _CNV_A_R_LINEAR_____207_CM 8 -32768. 32767. DISPLAY_IDENTIFIER LDPM_N_DIF_PRED_FAC_TQ_ADD_IS FORMAT "%6.0" /end AXIS_PTS
/begin AXIS_PTS ldpm_n_t_n_dif_ofs_pred "" 0xffe51bf2 n _REC_AXS_20_u2 8160. _CNV_A_R_LINEAR_____10_CM 8 0. 8160. DISPLAY_IDENTIFIER LDPM_N_T_N_DIF_OFS_PRED FORMAT "%4.0" /end AXIS_PTS
/begin AXIS_PTS ldpm_fac_tq_req_drof "" 0xffe5186e fac_tq_req _REC_AXS_20_u2 1.99996948 _CNV_A_R_LINEAR_____20_CM 6 0. 1.99996948 DISPLAY_IDENTIFIER LDPM_FAC_TQ_REQ_DROF FORMAT "%7.5" /end AXIS_PTS
/begin CHARACTERISTIC ip_tq_add_pl_drof "Torque reserve at part load for drive off support" MAP 0xffe4f9ae _REC_MAP_20_u2_u2_u2 1023.96875 _CNV_A_R_LINEAR_____55_CM 0. 1023.96875 DISPLAY_IDENTIFIER IP_TQ_ADD_PL_DROF FORMAT "%7.2"
 /begin AXIS_DESCR COM_AXIS n_dif_pred_pl_drof _CNV_A_R_LINEAR_____207_CM 8 -32768. 32767. FORMAT "%6.0" AXIS_PTS_REF ldpm_n_dif_pred_fac_tq_add_is /end AXIS_DESCR
 /begin AXIS_DESCR COM_AXIS fac_tq_req _CNV_A_R_LINEAR_____20_CM 6 0. 1.99996948 FORMAT "%7.5" AXIS_PTS_REF ldpm_fac_tq_req_drof /end AXIS_DESCR
/end CHARACTERISTIC
/begin CHARACTERISTIC ip_fac_tq_req_fast_load_im "Factor for TQI_SP_MAF_1-difference for trigger of Fast Manifold Filling" CURVE 0xffe40c51 _REC_CUR_20_u1_u2 1.9921875 _CNV_A_R_LINEAR_____117_CM 0. 1.9921875 DISPLAY_IDENTIFIER IP_FAC_TQ_REQ_FAST_LOAD_IM FORMAT "%5.3"
 /begin AXIS_DESCR COM_AXIS fac_tq_req _CNV_A_R_LINEAR_____20_CM 6 0. 1.99996948 FORMAT "%7.5" AXIS_PTS_REF ldpm_fac_tq_req_drof /end AXIS_DESCR
/end CHARACTERISTIC
/begin CHARACTERISTIC c_gear_max_fast_load_im "Highest gear for Fast Manifold Filling" VALUE 0xffe40758 _REC_VAL_20_u1 255. _CNV_A_R_LINEAR_____0_CM 0. 255. DISPLAY_IDENTIFIER C_GEAR_MAX_FAST_LOAD_IM FORMAT "%3.0" /end CHARACTERISTIC
/begin CHARACTERISTIC c_vs_max_fast_load_im "Highest vehicle speed  for Fast Manifold Filling" VALUE 0xffe409da _REC_VAL_20_u1 255. _CNV_A_R_LINEAR_____23_CM 0. 255. DISPLAY_IDENTIFIER C_VS_MAX_FAST_LOAD_IM FORMAT "%3.0" /end CHARACTERISTIC
/begin CHARACTERISTIC c_n_max_fast_load_im "Highest engine speed  for Fast Manifold Filling" VALUE 0xffe41816 _REC_VAL_20_u2 8160. _CNV_A_R_LINEAR_____10_CM 0. 8160. DISPLAY_IDENTIFIER C_N_MAX_FAST_LOAD_IM FORMAT "%4.0" /end CHARACTERISTIC
/begin CHARACTERISTIC c_n_max_fast_load_im_dt_1 "Max. engine speed for request of Fast Manifold Filling due to AFS when drive train is engaged" VALUE 0xffe4181a _REC_VAL_20_u2 8160. _CNV_A_R_LINEAR_____10_CM 0. 8160. DISPLAY_IDENTIFIER C_N_MAX_FAST_LOAD_IM_DT_1 FORMAT "%4.0" /end CHARACTERISTIC
/begin CHARACTERISTIC c_n_max_fast_load_im_dt_0 "Max. engine speed for request of Fast Manifold Filling due to AFS when drive train is not engaged" VALUE 0xffe41818 _REC_VAL_20_u2 8160. _CNV_A_R_LINEAR_____10_CM 0. 8160. DISPLAY_IDENTIFIER C_N_MAX_FAST_LOAD_IM_DT_0 FORMAT "%4.0" /end CHARACTERISTIC
/begin CHARACTERISTIC c_t_ast_min_fast_load_im "Minimum time after start before enabling Fast Manifold Filling" VALUE 0xffe418dc _REC_VAL_20_u2 6553.5 _CNV_A_R_LINEAR_____24_CM 0. 6553.5 DISPLAY_IDENTIFIER C_T_AST_MIN_FAST_LOAD_IM FORMAT "%6.1" /end CHARACTERISTIC
/begin CHARACTERISTIC lc_fast_load_im_is "0: Fast Manifold Filling possible only during 'idle'" VALUE 0xffe40f67 _REC_VAL_20_u1 1. _CNV_A_R_LINEAR_____0_CM 0. 1. DISPLAY_IDENTIFIER LC_FAST_LOAD_IM_IS FORMAT "%2.0" /end CHARACTERISTIC
/begin CHARACTERISTIC lc_ena_fast_load_im "1: Fast Manifold Filling is always requested" VALUE 0xffe40f56 _REC_VAL_20_u1 1. _CNV_A_R_LINEAR_____0_CM 0. 1. DISPLAY_IDENTIFIER LC_ENA_FAST_LOAD_IM FORMAT "%2.0" /end CHARACTERISTIC
/begin CHARACTERISTIC lc_ena_fast_load_im_n_sp "1: Fast Manifold Filling can be requested by LV_N_SP_IS_CS = 1" VALUE 0xffe40f57 _REC_VAL_20_u1 1. _CNV_A_R_LINEAR_____0_CM 0. 1. DISPLAY_IDENTIFIER LC_ENA_FAST_LOAD_IM_N_SP FORMAT "%2.0" /end CHARACTERISTIC
/begin CHARACTERISTIC c_tqi_dif_fast_load_min_pos "Trigger threshold for Fast Manifold Filling, positive load change" VALUE 0xffe404ec _REC_VAL_20_s2 2047.96875 _CNV_A_R_LINEAR_____55_CM -1024. 1023.96875 DISPLAY_IDENTIFIER C_TQI_DIF_FAST_LOAD_MIN_POS FORMAT "%8.2" /end CHARACTERISTIC
/begin CHARACTERISTIC c_tqi_dif_fast_load_min_neg "Trigger threshold for Fast Manifold Filling, negative load change" VALUE 0xffe404ea _REC_VAL_20_s2 2047.96875 _CNV_A_R_LINEAR_____55_CM -1024. 1023.96875 DISPLAY_IDENTIFIER C_TQI_DIF_FAST_LOAD_MIN_NEG FORMAT "%8.2" /end CHARACTERISTIC
/begin CHARACTERISTIC c_map_dif_max_fast_load_im "maximum difference of MAP - MAP_SP for disabling Fast Manifold Filling" VALUE 0xffe417ce _REC_VAL_20_u2 5434. _CNV_A_R_LINEAR_____49_CM 0. 5434. DISPLAY_IDENTIFIER C_MAP_DIF_MAX_FAST_LOAD_IM FORMAT "%7.2" /end CHARACTERISTIC
/begin COMPU_METHOD _CNV_A_R_LINEAR_____0_CM "" RAT_FUNC "%6.3" "-" COEFFS 0 1. 0. 0 0 1 /end COMPU_METHOD
/begin COMPU_METHOD _CNV_S_2_RANGE______1_R_CM "" TAB_VERB "%6.3" "[-]" COMPU_TAB_REF _CNV_S_2_RANGE______1_R /end COMPU_METHOD
/begin COMPU_VTAB_RANGE _CNV_S_2_RANGE______1_R "" 2 0 0 "0" 1 255 "1" /end COMPU_VTAB_RANGE
/begin COMPU_METHOD _CNV_S_2_RANGE______2_CM "" TAB_VERB "%6.3" "[-]" COMPU_TAB_REF _CNV_S_2_RANGE______2 /end COMPU_METHOD
/begin COMPU_VTAB _CNV_S_2_RANGE______2 "" TAB_VERB 2 0 "0" 1 "1" /end COMPU_VTAB
/begin COMPU_METHOD _CNV_A_R_LINEAR_____4_CM "" RAT_FUNC "%6.3" "s" COEFFS 0 100. 0. 0 0 1 /end COMPU_METHOD
/begin COMPU_METHOD _CNV_A_R_LINEAR_____6_CM "" RAT_FUNC "%6.3" "°C" COEFFS 0 16. 0. 0 0 1 /end COMPU_METHOD
/begin COMPU_METHOD _CNV_A_R_LINEAR_____9_CM "" RAT_FUNC "%6.3" "%" COEFFS 0 2.56 0. 0 0 1 /end COMPU_METHOD
/begin COMPU_METHOD _CNV_A_R_LINEAR_____10_CM "" RAT_FUNC "%6.3" "rpm" COEFFS 0 1. 0. 0 0 1 /end COMPU_METHOD
/begin COMPU_METHOD _CNV_A_R_LINEAR_____11_CM "" RAT_FUNC "%6.3" "°C" COEFFS 0 1.333333333333333 64. 0 0 1 /end COMPU_METHOD
/begin COMPU_METHOD _CNV_A_R_LINEAR_____14_CM "" RAT_FUNC "%6.3" "°C" COEFFS 0 1. 40. 0 0 1 /end COMPU_METHOD
/begin COMPU_METHOD _CNV_A_R_LINEAR_____15_CM "" RAT_FUNC "%6.3" "rpm" COEFFS 0 3.125e-002 0. 0 0 1 /end COMPU_METHOD
/begin COMPU_METHOD _CNV_A_R_LINEAR_____20_CM "" RAT_FUNC "%6.3" "-" COEFFS 0 32768.00003968061 0. 0 0 1 /end COMPU_METHOD
/begin COMPU_METHOD _CNV_S_2_RANGE______21_CM "" TAB_VERB "%6.3" "-" COMPU_TAB_REF _CNV_S_2_RANGE______21 /end COMPU_METHOD
/begin COMPU_VTAB _CNV_S_2_RANGE______21 "" TAB_VERB 2 0 "0" 1 "1" /end COMPU_VTAB
/begin COMPU_METHOD _CNV_A_R_LINEAR_____22_CM "" RAT_FUNC "%6.3" "[-]" COEFFS 0 1. 0. 0 0 1 /end COMPU_METHOD
/begin COMPU_METHOD _CNV_A_R_LINEAR_____23_CM "" RAT_FUNC "%6.3" "km/h" COEFFS 0 1. 0. 0 0 1 /end COMPU_METHOD
/begin COMPU_METHOD _CNV_A_R_LINEAR_____24_CM "" RAT_FUNC "%6.3" "s" COEFFS 0 10. 0. 0 0 1 /end COMPU_METHOD
/begin COMPU_METHOD _CNV_A_R_LINEAR_____25_CM "" RAT_FUNC "%6.3" "-" COEFFS 0 4095.999999839998 -1.280019205296412e-006 0 0 1 /end COMPU_METHOD
/begin COMPU_METHOD _CNV_A_R_LINEAR_____27_CM "" RAT_FUNC "%6.3" "mg/stk" COEFFS 0 0.183585313174946 0. 0 0 1 /end COMPU_METHOD
/begin COMPU_METHOD _CNV_A_R_LINEAR_____29_CM "" RAT_FUNC "%6.3" "-" COEFFS 0 255.9983911655618 0. 0 0 1 /end COMPU_METHOD
/begin COMPU_METHOD _CNV_A_R_LINEAR_____30_CM "" RAT_FUNC "%6.3" "s" COEFFS 0 1. 0. 0 0 1 /end COMPU_METHOD
/begin COMPU_METHOD _CNV_A_R_LINEAR_____31_CM "" RAT_FUNC "%6.3" "ms" COEFFS 0 0.1 0. 0 0 1 /end COMPU_METHOD
/begin COMPU_METHOD _CNV_A_R_LINEAR_____37_CM "" RAT_FUNC "%6.3" "-" COEFFS 0 65536.00007936121 0. 0 0 1 /end COMPU_METHOD
/begin COMPU_METHOD _CNV_A_R_LINEAR_____39_CM "" RAT_FUNC "%6.3" "-" COEFFS 0 127.9991955827809 0. 0 0 1 /end COMPU_METHOD
/begin COMPU_METHOD _CNV_A_R_LINEAR_____40_CM "" RAT_FUNC "%6.3" "%/s" COEFFS 0 0.1024000154202376 128.000019275297 0 0 1 /end COMPU_METHOD
/begin COMPU_METHOD _CNV_A_R_LINEAR_____44_CM "" RAT_FUNC "%6.3" "V" COEFFS 0 51.0204081632653 0. 0 0 1 /end COMPU_METHOD
/begin COMPU_METHOD _CNV_A_R_LINEAR_____46_CM "" RAT_FUNC "%6.3" "-" COEFFS 0 16. 0. 0 0 1 /end COMPU_METHOD
/begin COMPU_METHOD _CNV_A_R_LINEAR_____49_CM "" RAT_FUNC "%6.3" "hPa" COEFFS 0 12.06017666543982 0. 0 0 1 /end COMPU_METHOD
/begin COMPU_METHOD _CNV_A_R_LINEAR_____50_CM "" RAT_FUNC "%6.3" "[-]" COEFFS 0 255.9999357490357 0. 0 0 1 /end COMPU_METHOD
/begin COMPU_METHOD _CNV_A_R_LINEAR_____54_CM "" RAT_FUNC "%6.3" "rpm/s" COEFFS 0 3.125e-002 128. 0 0 1 /end COMPU_METHOD
/begin COMPU_METHOD _CNV_A_R_LINEAR_____55_CM "" RAT_FUNC "%6.3" "Nm" COEFFS 0 32. 0. 0 0 1 /end COMPU_METHOD
/begin COMPU_METHOD _CNV_A_R_LINEAR_____88_CM "" RAT_FUNC "%6.3" "km" COEFFS 0 0.1 0. 0 0 1 /end COMPU_METHOD
/begin COMPU_METHOD _CNV_A_R_LINEAR_____104_CM "" RAT_FUNC "%6.3" "ppm" COEFFS 0 1. 0. 0 0 1 /end COMPU_METHOD
/begin COMPU_METHOD _CNV_A_R_LINEAR_____105_CM "" RAT_FUNC "%6.3" "mV" COEFFS 0 1. 200. 0 0 1 /end COMPU_METHOD
/begin COMPU_METHOD _CNV_A_R_LINEAR_____108_CM "" RAT_FUNC "%6.3" "mg/stk" COEFFS 0 47.18142548596112 0. 0 0 1 /end COMPU_METHOD
/begin COMPU_METHOD _CNV_S_6_RANGE_CDN__109_CM "" TAB_VERB "%6.3" "-" COMPU_TAB_REF _CNV_S_6_RANGE_CDN__109 /end COMPU_METHOD
/begin COMPU_VTAB _CNV_S_6_RANGE_CDN__109 "" TAB_VERB 6 0 "NO_CDN" 1 "CDN_NO_PURGE" 2 "CDN_MIN_PURGE" 3 "CDN_RAMP_OPEN" 4 "CDN_RAMP_OPEN_FAST" 5 "CDN_PURGE" /end COMPU_VTAB
/begin COMPU_METHOD _CNV_A_R_LINEAR_____110_CM "" RAT_FUNC "%6.3" "hPa" COEFFS 0 12.06017666543982 -1.759293338545831e-002 0 0 1 /end COMPU_METHOD
/begin COMPU_METHOD _CNV_A_R_LINEAR_____111_CM "" RAT_FUNC "%6.3" "%" COEFFS 0 655.3600000071681 3.584063961170614e-007 0 0 1 /end COMPU_METHOD
/begin COMPU_METHOD _CNV_S_3_RANGE_C_ST_112_CM "" TAB_VERB "%6.3" "-" COMPU_TAB_REF _CNV_S_3_RANGE_C_ST_112 /end COMPU_METHOD
/begin COMPU_VTAB _CNV_S_3_RANGE_C_ST_112 "" TAB_VERB 3 0 "NONE" 1 "NO_PURGE" 2 "MIN_PURGE" /end COMPU_VTAB
/begin COMPU_METHOD _CNV_A_R_LINEAR_____115_CM "" RAT_FUNC "%6.3" "kg/h" COEFFS 0 32. 0. 0 0 1 /end COMPU_METHOD
/begin COMPU_METHOD _CNV_A_R_LINEAR_____116_CM "" RAT_FUNC "%6.3" "hPa" COEFFS 0 12.06017666543982 32767.5 0 0 1 /end COMPU_METHOD
/begin COMPU_METHOD _CNV_A_R_LINEAR_____117_CM "" RAT_FUNC "%6.3" "-" COEFFS 0 128. 0. 0 0 1 /end COMPU_METHOD
/begin COMPU_METHOD _CNV_A_R_LINEAR_____126_CM "" RAT_FUNC "%6.3" "-" COEFFS 0 65551.06000970239 0. 0 0 1 /end COMPU_METHOD
/begin COMPU_METHOD _CNV_A_R_LINEAR_____165_CM "" RAT_FUNC "%6.3" "ms" COEFFS 0 250. 0. 0 0 1 /end COMPU_METHOD
/begin COMPU_METHOD _CNV_A_R_LINEAR_____187_CM "" RAT_FUNC "%6.3" "Nm" COEFFS 0 32. 32768. 0 0 1 /end COMPU_METHOD
/begin COMPU_METHOD _CNV_S_4_STATE_AMT__201_CM "" TAB_VERB "%6.3" "[-]" COMPU_TAB_REF _CNV_S_4_STATE_AMT__201 /end COMPU_METHOD
/begin COMPU_VTAB _CNV_S_4_STATE_AMT__201 "" TAB_VERB 4 0 "NO" 1 "DEC" 2 "INC" 3 "DEC_INC" /end COMPU_VTAB
/begin COMPU_METHOD _CNV_A_R_LINEAR_____202_CM "" RAT_FUNC "%6.3" "Nm/10ms" COEFFS 0 32. 0. 0 0 1 /end COMPU_METHOD
/begin COMPU_METHOD _CNV_A_R_LINEAR_____203_CM "" RAT_FUNC "%6.3" "°CRK" COEFFS 0 2.666666666666667 95. 0 0 1 /end COMPU_METHOD
/begin COMPU_METHOD _CNV_A_R_LINEAR_____205_CM "" RAT_FUNC "%6.3" "°CRK" COEFFS 0 2.666666666666667 128. 0 0 1 /end COMPU_METHOD
/begin COMPU_METHOD _CNV_A_R_LINEAR_____206_CM "" RAT_FUNC "%6.3" "-" COEFFS 0 1023.999999919998 0. 0 0 1 /end COMPU_METHOD
/begin COMPU_METHOD _CNV_A_R_LINEAR_____207_CM "" RAT_FUNC "%6.3" "rpm" COEFFS 0 1. 32768. 0 0 1 /end COMPU_METHOD
/begin COMPU_METHOD _CNV_A_R_LINEAR_____218_CM "" RAT_FUNC "%6.3" "s" COEFFS 0 32. 0. 0 0 1 /end COMPU_METHOD
/begin COMPU_METHOD _CNV_A_R_LINEAR_____252_CM "" RAT_FUNC "%6.3" "V" COEFFS 0 13107.19998965744 0. 0 0 1 /end COMPU_METHOD
/begin COMPU_METHOD _CNV_A_R_LINEAR_____275_CM "" RAT_FUNC "%6.3" "-" COEFFS 0 16383.75 32767.5 0 0 1 /end COMPU_METHOD
/begin COMPU_METHOD _CNV_A_R_LINEAR_____276_CM "" RAT_FUNC "%6.3" "-" COEFFS 0 16383.99999935999 -1.280019205296412e-006 0 0 1 /end COMPU_METHOD
/begin COMPU_METHOD _CNV_A_R_LINEAR_____277_CM "" RAT_FUNC "%6.3" "[-]" COEFFS 0 1023.999999959999 32767.99999871998 0 0 1 /end COMPU_METHOD
/begin COMPU_METHOD _CNV_A_R_LINEAR_____297_CM "" RAT_FUNC "%6.3" "V/10ms" COEFFS 0 13107.26214524291 0.1553631072602002 0 0 1 /end COMPU_METHOD
/begin COMPU_METHOD _CNV_A_R_LINEAR_____298_CM "" RAT_FUNC "%6.3" "V/10ms" COEFFS 0 13107.20001587224 0. 0 0 1 /end COMPU_METHOD
/begin COMPU_METHOD _CNV_A_R_LINEAR_____303_CM "" RAT_FUNC "%6.3" "°C" COEFFS 0 15.99999804684544 -4.000060547696194e-003 0 0 1 /end COMPU_METHOD
/begin COMPU_METHOD _CNV_A_R_LINEAR_____308_CM "" RAT_FUNC "%6.3" "[-]" COEFFS 0 4. 0. 0 0 1 /end COMPU_METHOD
/begin COMPU_METHOD _CNV_A_R_LINEAR_____309_CM "" RAT_FUNC "%6.3" "ohm" COEFFS 0 1. 0. 0 0 1 /end COMPU_METHOD
/begin COMPU_METHOD _CNV_A_R_LINEAR_____310_CM "" RAT_FUNC "%6.3" "W" COEFFS 0 1000. 0. 0 0 1 /end COMPU_METHOD
/begin COMPU_METHOD _CNV_A_R_LINEAR_____311_CM "" RAT_FUNC "%6.3" "°C" COEFFS 0 15.99999609363174 0. 0 0 1 /end COMPU_METHOD
/begin COMPU_METHOD _CNV_A_R_LINEAR_____319_CM "" RAT_FUNC "%6.3" "-" COEFFS 0 1023.999999959999 -1.818989403545857e-011 0 0 1 /end COMPU_METHOD
/begin COMPU_METHOD _CNV_A_R_LINEAR_____361_CM "" RAT_FUNC "%6.3" "-" COEFFS 0 32768. 0. 0 0 1 /end COMPU_METHOD
/begin COMPU_METHOD _CNV_A_R_LINEAR_____365_CM "" RAT_FUNC "%6.3" "s" COEFFS 0 1000. 0. 0 0 1 /end COMPU_METHOD
/begin COMPU_METHOD _CNV_A_R_LINEAR_____366_CM "" RAT_FUNC "%6.3" "1/s" COEFFS 0 255.9983911655618 0. 0 0 1 /end COMPU_METHOD
/begin COMPU_METHOD _CNV_A_R_LINEAR_____367_CM "" RAT_FUNC "%6.3" "°C" COEFFS 0 15.99975585564965 0. 0 0 1 /end COMPU_METHOD
/begin COMPU_METHOD _CNV_A_R_LINEAR_____394_CM "" RAT_FUNC "%6.3" "-" COEFFS 0 8191.999999679995 0. 0 0 1 /end COMPU_METHOD
/begin COMPU_METHOD _CNV_A_R_LINEAR_____424_CM "" RAT_FUNC "%6.3" "Nm/rpm" COEFFS 0 8191.999999679995 0. 0 0 1 /end COMPU_METHOD
/begin COMPU_METHOD _CNV_A_R_LINEAR_____429_CM "" RAT_FUNC "%6.3" "ppm" COEFFS 0 0.9999999999999994 9.379164112033323e-013 0 0 1 /end COMPU_METHOD
/begin COMPU_METHOD _CNV_A_R_LINEAR_____509_CM "" RAT_FUNC "%6.3" "-" COEFFS 0 1048576. 0. 0 0 1 /end COMPU_METHOD
/begin COMPU_METHOD _CNV_A_R_LINEAR_____510_CM "" RAT_FUNC "%6.3" "rpm/Nm" COEFFS 0 65536.00007936121 0. 0 0 1 /end COMPU_METHOD
/begin COMPU_METHOD _CNV_A_R_LINEAR_____511_CM "" RAT_FUNC "%6.3" "rpm" COEFFS 0 64.00027344284068 0.1400027344279806 0 0 1 /end COMPU_METHOD
/begin COMPU_METHOD _CNV_A_R_LINEAR_____512_CM "" RAT_FUNC "%6.3" "Nm/rpm*rpm" COEFFS 0 134293032.7868853 0. 0 0 1 /end COMPU_METHOD
/begin COMPU_METHOD _CNV_A_R_LINEAR_____513_CM "" RAT_FUNC "%6.3" "m/s²" COEFFS 0 2084.478388983038 32768.00027481336 0 0 1 /end COMPU_METHOD
/begin COMPU_METHOD _CNV_A_R_LINEAR_____514_CM "" RAT_FUNC "%6.3" "[-]" COEFFS 0 65535. 0. 0 0 1 /end COMPU_METHOD
/begin COMPU_METHOD _CNV_A_R_LINEAR_____517_CM "" RAT_FUNC "%6.3" "-" COEFFS 0 4095.999963999451 32767.99971199561 0 0 1 /end COMPU_METHOD
/begin COMPU_METHOD _CNV_A_R_LINEAR_____518_CM "" RAT_FUNC "%6.3" "Nm/100ms" COEFFS 0 32. 0. 0 0 1 /end COMPU_METHOD
/begin COMPU_METHOD _CNV_A_R_LINEAR_____519_CM "" RAT_FUNC "%6.3" "W" COEFFS 0 -5.e-002 0. 0 0 1 /end COMPU_METHOD
/begin COMPU_METHOD _CNV_A_R_LINEAR_____520_CM "" RAT_FUNC "%6.3" "[-]" COEFFS 0 1023.999989719843 0. 0 0 1 /end COMPU_METHOD
/begin COMPU_METHOD _CNV_S_8_RANGE_STAT_521_CM "" TAB_VERB "%6.3" "-" COMPU_TAB_REF _CNV_S_8_RANGE_STAT_521 /end COMPU_METHOD
/begin COMPU_VTAB _CNV_S_8_RANGE_STAT_521 "" TAB_VERB 8 0 "no" 1 "ASR" 2 "MSR" 3 "GS_DEC" 4 "GS_INC" 5 "AMT_DEC" 6 "AMT_INC" 7 "DCC" /end COMPU_VTAB
/begin COMPU_METHOD _CNV_R_R_dez_550_CM "" RAT_FUNC "%6.3" "[-]" COEFFS 0. 1. 0. 0. 0. 1. /end COMPU_METHOD
/begin COMPU_METHOD _CNV_R_R_tog_ub_q0p_573_CM "" RAT_FUNC "%6.3" "[-]" COEFFS 0. 2. 0. 0. 0. 1. /end COMPU_METHOD
/begin COMPU_METHOD _CNV_R_R_rel_ub_b10_574_CM "" RAT_FUNC "%6.3" "%" COEFFS 0. 255. 0. 0. 0. 100. /end COMPU_METHOD
/begin COMPU_METHOD _CNV_R_R_rel_uw_b10_575_CM "" RAT_FUNC "%6.3" "%" COEFFS 0. 65536. 0. 0. 0. 100. /end COMPU_METHOD
/begin COMPU_METHOD _CNV_R_R_nmot_ub_q4_576_CM "" RAT_FUNC "%6.3" "1/min" COEFFS 0. 1. 0. 0. 0. 40. /end COMPU_METHOD
/begin COMPU_METHOD _CNV_R_R_temp_uw_q0_577_CM "" RAT_FUNC "%6.3" "Grad C" COEFFS 0. 1. 48. 0. 0. 0.75 /end COMPU_METHOD
/begin COMPU_METHOD _CNV_R_R_t_q0p1ms_578_CM "" RAT_FUNC "%6.3" "ms" COEFFS 0. 10. 0. 0. 0. 1. /end COMPU_METHOD
/begin COMPU_METHOD _CNV_R_R_tog_ub_q0p_579_CM "" RAT_FUNC "%6.3" "mm" COEFFS 0. 2. 0. 0. 0. 1. /end COMPU_METHOD
/begin COMPU_METHOD _CNV_A_R_LINEAR_____580_CM "" RAT_FUNC "%6.3" "ms" COEFFS 0 10. 0. 0 0 1 /end COMPU_METHOD
/begin COMPU_METHOD _CNV_A_R_LINEAR_____581_CM "" RAT_FUNC "%6.3" "°C" COEFFS 0 1.331730769230769 63.92307692307692 0 0 1 /end COMPU_METHOD
/begin COMPU_METHOD _CNV_S_2_B_TRUE_582_CM "" TAB_VERB "%6.3" "[-]" COMPU_TAB_REF _CNV_S_2_B_TRUE_582 /end COMPU_METHOD
/begin COMPU_VTAB _CNV_S_2_B_TRUE_582 "" TAB_VERB 2 0 "----" 1 "TRUE" /end COMPU_VTAB
/begin COMPU_METHOD _CNV_A_R_LINEAR_____583_CM "" RAT_FUNC "%6.3" "1/min" COEFFS 0 2.5e-002 0. 0 0 1 /end COMPU_METHOD
/begin COMPU_METHOD _CNV_A_R_LINEAR_____584_CM "" RAT_FUNC "%6.3" "mm" COEFFS 0 2. 0. 0 0 1 /end COMPU_METHOD
/begin RECORD_LAYOUT _REC_VAL_20_u1 FNC_VALUES 1 UBYTE COLUMN_DIR DIRECT /end RECORD_LAYOUT
/begin RECORD_LAYOUT _REC_VAL_20_u2 FNC_VALUES 1 UWORD COLUMN_DIR DIRECT /end RECORD_LAYOUT
/begin RECORD_LAYOUT _REC_CUR_20_u2_u1 FNC_VALUES 1 UWORD COLUMN_DIR DIRECT /end RECORD_LAYOUT
/begin RECORD_LAYOUT _REC_AXS_20_u1 NO_AXIS_PTS_X 1 UBYTE AXIS_PTS_X 2 UBYTE INDEX_INCR DIRECT /end RECORD_LAYOUT
/begin RECORD_LAYOUT _REC_MAP_20_u1_u1_u1 FNC_VALUES 1 UBYTE COLUMN_DIR DIRECT /end RECORD_LAYOUT
/begin RECORD_LAYOUT _REC_CUR_20_u1_u1 FNC_VALUES 1 UBYTE COLUMN_DIR DIRECT /end RECORD_LAYOUT
/begin RECORD_LAYOUT _REC_AXS_20_u2 NO_AXIS_PTS_X 1 UWORD AXIS_PTS_X 2 UWORD INDEX_INCR DIRECT /end RECORD_LAYOUT
/begin RECORD_LAYOUT _REC_MAP_20_u2_u2_u1 FNC_VALUES 1 UWORD COLUMN_DIR DIRECT /end RECORD_LAYOUT
/begin RECORD_LAYOUT _REC_CUR_20_u1_u2 FNC_VALUES 1 UBYTE COLUMN_DIR DIRECT /end RECORD_LAYOUT
/begin RECORD_LAYOUT _REC_MAP_20_u2_u1_u1 FNC_VALUES 1 UWORD COLUMN_DIR DIRECT /end RECORD_LAYOUT
/begin RECORD_LAYOUT _REC_CUR_20_u2_u2 FNC_VALUES 1 UWORD COLUMN_DIR DIRECT /end RECORD_LAYOUT
/begin RECORD_LAYOUT _REC_VAL_20_s2 FNC_VALUES 1 SWORD COLUMN_DIR DIRECT /end RECORD_LAYOUT
/begin RECORD_LAYOUT _REC_MAP_20_u2_u1_u2 FNC_VALUES 1 UWORD COLUMN_DIR DIRECT /end RECORD_LAYOUT
/begin RECORD_LAYOUT _REC_MAP_20_u2_u2_u2 FNC_VALUES 1 UWORD COLUMN_DIR DIRECT /end RECORD_LAYOUT
/begin RECORD_LAYOUT _REC_CUR_52_u2_u2 NO_AXIS_PTS_X 1 UWORD AXIS_PTS_X 2 UWORD INDEX_INCR DIRECT FNC_VALUES 3 UWORD COLUMN_DIR DIRECT /end RECORD_LAYOUT
/begin RECORD_LAYOUT _REC_CUR_52_UBYTE_s1_u1 NO_AXIS_PTS_X 1 UBYTE AXIS_PTS_X 2 UBYTE INDEX_INCR DIRECT FNC_VALUES 3 SBYTE COLUMN_DIR DIRECT /end RECORD_LAYOUT
/begin RECORD_LAYOUT _REC_CUR_52_UWORD_u2_u2 NO_AXIS_PTS_X 1 UWORD AXIS_PTS_X 2 UWORD INDEX_INCR DIRECT FNC_VALUES 3 UWORD COLUMN_DIR DIRECT /end RECORD_LAYOUT
/begin FUNCTION SYS_Downstream_oxygen_sensor_int "_Downstream oxygen sensor internal resistance determination"
 /begin DEF_CHARACTERISTIC c_fac_stk_drv1_vls_down_mmv c_t_cur_off_ls_down c_t_cur_dly_ls_down c_drv1_vls_down_abs_max c_temp_cur_on_ls_down c_t_cur_on_ls_down c_vls_mmv_min_rng_tol_ls_down c_vls_mmv_min_rng_bol_ls_down c_drv1_vls_down_mmv_thd_min c_drv1_vls_down_mmv_thd_max c_ctr_vls_afl_cyc_r_down_ls c_maf_kgh_r_down_ls c_fac_drv1_vls_down_mmv_min c_fac_err_pos_r_down_ls c_fac_err_neg_r_down_ls c_crlc_ttip_fall_r_down_ls c_crlc_ttip_rise_r_down_ls lc_inh_r_down_ls_vld ip_fac_t_drv1_vls_down_mmv ip_fac_t_drv1_vls_down_abs ip_ttip_ls_down ip_crlc_ttip_ref_ls_down_mdl c_crlc_pow_lsh_down ip_r_down_ls_mdl_sens_new /end DEF_CHARACTERISTIC
 /begin OUT_MEASUREMENT lam_bank_1.ls_down_cur.bf.lv_r_down_ls_det lam_bank_1.ls_down_cur.bf.lv_r_down_ls_drv1_vls_cdn lam_bank_1.ls_down_cur.bf.lv_r_down_ls_ena lam_bank_1.ls_down_cur.bf.lv_r_down_ls_vls_rng_cdn lam_bank_1.ls_down_cur.bf.lv_vls_not_vld_down lam_bank_1.ls_down_cur.ctr_cycnr_r_down_ls lam_bank_1.ls_down_cur.drv1_vls_down_mmv_thd_max lam_bank_1.ls_down_cur.drv1_vls_down_mmv_thd_min lam_bank_1.ls_down_cur.fac_t_drv1_vls_down_abs lam_bank_1.ls_down_cur.fac_t_drv1_vls_down_mmv lam_bank_1.ls_down_cur.r_down_ls lam_bank_1.ls_down_cur.r_down_ls_mes lam_bank_1.ls_down_cur.t_sample_r_down_ls lam_bank_1.ls_down_cur.t_vls_cyc_afl_hld_r_down_ls lam_bank_1.ls_down_cur.ttip_ls_down_mes lam_bank_1.ls_down_cur.ttip_ls_down_mes_bol lam_bank_1.ls_down_cur.ttip_ls_down_mes_bol_mmv lam_bank_1.ls_down_cur.ttip_ls_down_mes_tol lam_bank_1.ls_down_cur.ttip_ls_down_mes_tol_mmv lam_bank_1.ls_down_cur.r_down_ls_mdl_sens_new lam_bank_1.ls_down_cur.pow_lsh_down_mmv lam_bank_1.ls_down_cur.ttip_ref_ls_down_mdl_mmv lam_bank_2.ls_down_cur.bf.lv_r_down_ls_det lam_bank_2.ls_down_cur.bf.lv_r_down_ls_drv1_vls_cdn lam_bank_2.ls_down_cur.bf.lv_r_down_ls_ena lam_bank_2.ls_down_cur.bf.lv_r_down_ls_vls_rng_cdn lam_bank_2.ls_down_cur.bf.lv_vls_not_vld_down lam_bank_2.ls_down_cur.ctr_cycnr_r_down_ls lam_bank_2.ls_down_cur.drv1_vls_down_mmv_thd_max lam_bank_2.ls_down_cur.drv1_vls_down_mmv_thd_min lam_bank_2.ls_down_cur.fac_t_drv1_vls_down_abs lam_bank_2.ls_down_cur.fac_t_drv1_vls_down_mmv lam_bank_2.ls_down_cur.r_down_ls lam_bank_2.ls_down_cur.r_down_ls_mes lam_bank_2.ls_down_cur.t_sample_r_down_ls lam_bank_2.ls_down_cur.t_vls_cyc_afl_hld_r_down_ls lam_bank_2.ls_down_cur.ttip_ls_down_mes lam_bank_2.ls_down_cur.ttip_ls_down_mes_bol lam_bank_2.ls_down_cur.ttip_ls_down_mes_bol_mmv lam_bank_2.ls_down_cur.ttip_ls_down_mes_tol lam_bank_2.ls_down_cur.ttip_ls_down_mes_tol_mmv lam_bank_2.ls_down_cur.r_down_ls_mdl_sens_new lam_bank_2.ls_down_cur.pow_lsh_down_mmv lam_bank_2.ls_down_cur.ttip_ref_ls_down_mdl_mmv /end OUT_MEASUREMENT
/end FUNCTION
/begin FUNCTION SYS_Oil_temperature_and_level_se "_Oil temperature and level sensor (GGTOENS)"
 /begin DEF_CHARACTERISTIC DOLNIV ORIVERZ PT1NMOT PT1TOEL TOGANZ TOGKURZANZ TOGMWK TOGNMOT TOGORIANZ TOGTMOT TOGTMOTORI TOGVERBKZ TOGVERBNOR TOGVERLKZ TOGVERLNOR TOGVERLORI TRTYP KLTOGNKOR KLTKTOENIV KLTVTOEL /end DEF_CHARACTERISTIC
 /begin OUT_MEASUREMENT B_oelverb nmotf nmotfm nmotfsum Oelnivak Oelnivaknk Oelnivnksm Oelnivnorm Oelnivori Oelnivsum Oelnivsumw Oriverzz Toel_t togbw_i togk_i tog_i tog_k B_oelverl Oelnivkurz Oelnivm /end OUT_MEASUREMENT
/end FUNCTION
/begin FUNCTION SYS_Check_Sum_Calculation "_Check Sum Calculation"
 /begin OUT_MEASUREMENT ctl_acin_eng_typ state_swi_off_vb cks_can_tq_dcc cks_can_tq_tcs cks_can_tq_etcu cks_can_tq_amt cks_can_msw cks_can_cas cks_clc_cas cks_clc_tq_dcc cks_clc_tq_tcs cks_clc_tq_etcu cks_clc_tq_amt cks_clc_msw cks_clc_ecu1 cks_clc_ecu2 cks_clc_ecu3 cks_can_veh_mod cks_can_tq_pste_2 cks_clc_tq_pste_2 /end OUT_MEASUREMENT
/end FUNCTION
/begin FUNCTION SYS_Multiplexed_segment_synchron "_Multiplexed segment-synchronous output variables"
 /begin OUT_MEASUREMENT iga_igc_0_5 iga_knk_0_5 knk_thd_0_5 nl_0_5 ti_cyl_0_5 knks_0_5 /end OUT_MEASUREMENT
/end FUNCTION
/begin FUNCTION SYS_NOx_Sensor_Interface "_NOx-Sensor Interface"
 /begin DEF_CHARACTERISTIC lc_nox_sens_nox_man_2 lc_nox_sens_nox_man_1 lc_nox_sens_lamb_man_2 lc_nox_sens_lamb_man_1 c_vls_nox_sens_1 lc_nox_sens_vls_man_1 lc_nox_sens_err_man_1 lc_nox_sens_err_man_2 c_vls_nox_sens_2 c_err_nox_sens_1 c_err_nox_sens_2 c_lamb_nox_sens_1 c_lamb_nox_sens_2 c_nox_nox_sens_2 lc_nox_sens_vls_man_2 lc_nox_sens_nox_vld_2 c_crlc_nox_nox_sens lc_nox_sens_nox_vld_1 lc_nox_sens_lamb_vld_2 c_t_nox_sens_nox_hld lc_nox_sens_lamb_vld_1 lc_nox_sens_vls_vld_1 lc_nox_sens_vls_vld_2 c_t_nox_sens_lamb_hld c_t_nox_sens_vls_hld c_nox_nox_sens_1 c_t_nox_sens_nox_auth lc_inh_diag_cat_diag_nox_deac /end DEF_CHARACTERISTIC
 /begin OUT_MEASUREMENT nox_nox_sens_2 lamb_nox_sens_1 lamb_nox_sens_2 lv_nox_sens_lamb_vld_1 lv_nox_sens_lamb_vld_2 lv_nox_sens_nox_vld_1 lv_nox_sens_vls_vld_2 err_nox_sens_1 err_nox_sens_2 nox_nox_sens_1 lv_nox_sens_nox_vld_2 lv_nox_sens_nox_diag_vld_2 lv_nox_sens_nox_diag_vld_1 lv_nox_sens_nox_auth_1 vls_nox_sens_2 t_nox_sens_nox_hld_1 t_nox_sens_nox_hld_2 lamb_nox_sens_diag_1 lamb_nox_sens_diag_2 lv_nox_sens_nox_auth_2 lv_nox_sens_lamb_diag_vld_1 lv_nox_sens_lamb_diag_vld_2 t_nox_sens_lamb_hld_1 vls_nox_sens_1 vls_nox_sens_diag_1 vls_nox_sens_diag_2 lv_nox_sens_vls_vld_1 lv_nox_sens_vls_diag_vld_1 lv_nox_sens_vls_diag_vld_2 t_nox_sens_lamb_hld_2 lv_nox_sens_temp_1 lv_nox_sens_temp_2 t_nox_sens_vls_hld_2 t_nox_sens_vls_hld_1 nox_nox_sens_diag_1 nox_nox_sens_diag_2 /end OUT_MEASUREMENT
/end FUNCTION
/begin FUNCTION SYS_Upstream_oxygen_sensor_inter "_Upstream oxygen sensor internal resistance determination" /end FUNCTION
/begin FUNCTION SYS_Evaporative_Emission_Control "_Evaporative Emission Control activation conditions variables"
 /begin DEF_CHARACTERISTIC c_t_dly_pu_cps c_prs_max_cps c_n_cp_tol c_maf_cp_bol c_maf_cp_tol c_t_lam_lim_cp c_cl_mmv_req c_t_lam_cp_dly c_lam_cp_bol c_lam_cp_tol c_dly_n_maf_dyw_cp c_maf_dyw_cp c_n_dyw_cp c_tco_min_cp c_n_cp_bol c_n_max_cp c_n_hys_max_cp c_tia_min_cp c_state_win_cp_not /end DEF_CHARACTERISTIC
 /begin OUT_MEASUREMENT n_dyw_cp maf_dyw_cp cdn_state_cp lv_cp_act_req lv_pu_cp prs_cps lv_n_max_cp lv_n_maf_dyw_cp lv_cp_act lv_lam_out_cp lv_lam_lim_cp lv_win_cp /end OUT_MEASUREMENT
/end FUNCTION
/begin FUNCTION SYS_Application_Incidences_NOx_S "_Application Incidences NOx-Sensor Interface"
 /begin OUT_MEASUREMENT can_nox_nox_sens_2 can_lamb_nox_sens_1 can_lamb_nox_sens_2 can_err_nox_sens_1 can_err_nox_sens_2 can_vls_nox_sens_1 can_vls_nox_sens_2 can_state_nox_sens_1 can_state_nox_sens_2 can_nox_nox_sens_1 /end OUT_MEASUREMENT
/end FUNCTION
/begin FUNCTION SYS_BN2000_interface_torque_dist "_BN2000 interface torque distribution"
 /begin OUT_MEASUREMENT tq_amt_fast_dec_bn tq_amt_slow_dec_bn tq_amt_fast_inc_bn tq_amt_slow_inc_bn tq_dcc_fast_inc_bn tq_dcc_slow_inc_bn tq_gs_fast_dec_bn tq_gs_fast_inc_bn tq_gs_slow_dec_bn tq_gs_slow_inc_bn tq_msr_fast_inc_bn tq_msr_slow_inc_bn tq_asr_fast_dec_bn tq_asr_slow_dec_bn /end OUT_MEASUREMENT
/end FUNCTION
/begin FUNCTION SYS_Application_incidences_for_o "_Application incidences for oxygen sensor internal resistance" /begin OUT_MEASUREMENT lv_inh_r_down_ls_1 lv_inh_r_down_ls_2 /end OUT_MEASUREMENT /end FUNCTION
/begin FUNCTION SYS_Application_specific_conditi "_Application specific conditions for oxygen sensor ceramic temperature"
 /begin OUT_MEASUREMENT lam_bank_1.ls_temp_up_inci.lv_inh_ttip_ls_up lam_bank_2.ls_temp_up_inci.lv_inh_ttip_ls_up /end OUT_MEASUREMENT
/end FUNCTION
/begin FUNCTION SYS_Driving_off_assistance "_Driving off assistance"
 /begin DEF_CHARACTERISTIC ip_t_n_dif_ofs_pred_drof ip_tq_add_pl_drof ip_fac_tq_req_fast_load_im c_gear_max_fast_load_im c_vs_max_fast_load_im c_n_max_fast_load_im c_n_max_fast_load_im_dt_1 c_n_max_fast_load_im_dt_0 c_t_ast_min_fast_load_im lc_fast_load_im_is lc_ena_fast_load_im lc_ena_fast_load_im_n_sp c_tqi_dif_fast_load_min_pos c_tqi_dif_fast_load_min_neg c_map_dif_max_fast_load_im /end DEF_CHARACTERISTIC
 /begin OUT_MEASUREMENT tq_add_pl_drof n_dif_pred_pl_drof lv_fast_load_im /end OUT_MEASUREMENT
/end FUNCTION
/begin FUNCTION TQM_Torque_Managment "TQM"
 /begin SUB_FUNCTION TQM_Torque_request_for_gear_shif TQM_Initialization_module TQM_Torque_control_at_engine_sta TQM_Reference_and_basic_torque TQM_Torque_losses TQM_Torque_loss_and_reserve_for_ TQM_Torque_based_pattern_calcula TQM_Minimum_torque_at_clutch TQM_Converter_torque TQM_Torque_reserve_coordination TQM_Minimum_indicated_torque_at_ TQM_Torque_based_anti_jerk_funct TQM_Basic__actual_and_minimum_la TQM_Pedal_value_interpretation TQM_Maximum_torque_at_clutch TQM_Characteristic_quantity_stra TQM_Reference_and_basic_torque_f TQM_Torque_Request_at_Clutch_Gen TQM_Minimum_Maximum_Torque_Reque TQM_Torque_setpoint_for_stratifi TQM_Actual_Engine_Torque TQM_Actual_indicated_engine_torq TQM_Characteristic_quantity_homo TQM_Engine_torque_limitation TQM_Torque_Request_for_MSR TQM_Torque_Request_for_Cruise_Co TQM_Torque_Request_for_safety TQM_Torque_based_lambda_setpoint TQM_Dynamic_torque_intervention_ TQM_Torque_loss_for_power_steeri TQM_Separation_for_slow_and_fast TQM_Dynamic_Torque_request_coord TQM_Torque_Monitoring_Limitation TQM_Application_incidences_for_t TQM_Torque_Reserve_for_Torque_Tr TQM_Torque_Transient TQM_Anti_Jerk_Controller_Activat TQM_Appl_IncTorque_loss_and_rese TQM_Alternator_torque_losses TQM_Torque_request_for_distance_ TQM_AMT_Clutch_torque TQM_Torque_request_for_AMT_inter TQM_Torque_based_catalyst_heatin TQM_Minimum_indicated_engine_tor TQM_Coordination_of_additional_t TQM_Torque_Request_for_Traction_ TQM_Torque_Loss___Anti_Roll_Stab /end SUB_FUNCTION
/end FUNCTION
/begin FUNCTION TQM_Torque_request_for_gear_shif "_Torque request for gear shift intervention"
 /begin DEF_CHARACTERISTIC c_t_max_tqr_gs_intv c_gs_ena_inc_dec c_lgrd_lih_gs_dec c_lgrd_lih_gs_inc c_t_dly_lih_gs_dec c_t_dly_lih_gs_inc /end DEF_CHARACTERISTIC
 /begin OUT_MEASUREMENT lv_etcu_disable lv_etcu_disable_can lv_gs_ena_dec lv_gs_ena tqi_gs_fast_dec_req_1 tqi_gs_slow_dec_req tqi_gs_fast_inc_req_1 tqi_gs_slow_inc_req t_tqr_gs_intv tqi_gs_fast_dec_req tqi_gs_fast_dec tqi_gs_slow_dec_req_1 tqi_gs_slow_dec lv_gs_ena_inc lv_gs_dec_lih tqi_gs_fast_inc_req tqi_gs_fast_inc tqi_gs_slow_inc_req_1 tqi_gs_slow_inc lv_gs_dec_act lv_gs_inc_lih lv_gs_inc_act t_gs_inc_lih_ctr t_gs_dec_lih_ctr /end OUT_MEASUREMENT
/end FUNCTION
/begin FUNCTION TQM_Initialization_module "_Initialization module"
 /begin OUT_MEASUREMENT eff_maf_s tqi_vs_max tq_loss_scha lv_tq_loss_acc_inp_orng lamb_bas_cor_max lv_can_gs_ack lv_acp_orng eff_egr_s eff_pha_s tq_ad_add_s_swi tqi_cat_prot tq_loss_sa tq_loss_thermo tq_loss_win_heat tqi_p_max /end OUT_MEASUREMENT
/end FUNCTION
/begin FUNCTION TQM_Torque_control_at_engine_sta "_Torque control at engine start"
 /begin DEF_CHARACTERISTIC c_crlc_tq_st ip_tq_st_mt ip_tq_st_at c_t_tq_add_dly_st c_tq_add_crlc_st ip_tq_add_st /end DEF_CHARACTERISTIC
 /begin OUT_MEASUREMENT tq_st tq_st_1 tq_add_st lv_tq_add_st /end OUT_MEASUREMENT
/end FUNCTION
/begin FUNCTION TQM_Reference_and_basic_torque "_Reference and basic torque" /begin DEF_CHARACTERISTIC ip_tqi_ref__n__maf lc_mod_eff_av /end DEF_CHARACTERISTIC
 /begin OUT_MEASUREMENT tqi_bas tqi_ref_iga tqi_ref_iga_lamb tqi_ref_iga_min_lamb tqi_ref_iga_scc tqi_ref_lamb tqi_ref_lamb_scc tqi_ref_scc tqi_ref eff_tot_bas eff_tot_bas_slow /end OUT_MEASUREMENT
/end FUNCTION
/begin FUNCTION TQM_Torque_losses "_Torque losses"
 /begin DEF_CHARACTERISTIC ip_tqfr ip_tqfr_add ip_tq_loss_lim ip_tqfr_st ip_tqfr_dec_st c_maf_cyl_stk_ref c_crlc_tq_loss_req_clu ldpm_tco__tqfr_add ldpm_ctr_km_can__tqfr_add ip_tqfr_add_km_mt ip_tqfr_add_km_at ip_tqfr_delta_amp c_lgrd_tq_loss_ecf ip_pow_loss_ecf /end DEF_CHARACTERISTIC
 /begin OUT_MEASUREMENT tq_loss tq_loss_1 tq_loss_req_clu tqfr_mec lv_tq_loss_lim_act tqfr tqfr_bas tqfr_add tqfr_st tqfr_req_clu tq_loss_clu_add tqfr_add_km tqfr_delta_amp tq_loss_ecf /end OUT_MEASUREMENT
/end FUNCTION
/begin FUNCTION TQM_Torque_loss_and_reserve_for_ "_Torque loss and reserve for ACC"
 /begin DEF_CHARACTERISTIC ip_fac_tq_loss_acc_on ip_fac_tq_loss_acc_off ip_tq_add_acc ip_tq_add_heat_acc c_tq_add_acc_lgrd c_tq_add_heat_acc_lgrd c_tco_min_req_heat_acc c_tam_min_req_heat_acc c_tq_loss_max_acc c_crlc_tq_loss_acc_inp c_tq_add_acc_lgrd_on /end DEF_CHARACTERISTIC
 /begin OUT_MEASUREMENT tq_add_acc tq_loss_acc tq_add_heat_acc lv_tout_acc lv_req_heat_acc_ena lv_tout_req_heat_acc t_req_heat_acc tq_loss_acc_inp /end OUT_MEASUREMENT
/end FUNCTION
/begin FUNCTION TQM_Torque_based_pattern_calcula "_Torque based pattern calculation"
 /begin DEF_CHARACTERISTIC lc_eff_scc_sp_man lc_inh_fcut_fast lc_ena_eff_scc_bas_man c_eff_scc_sp_hys c_eff_scc_bas_man lc_ena_fcut_tot_gs lc_inh_fcut_gs_iga lc_inh_fcut_asr lc_ena_fcut_tot_asr lc_inh_fcut_n_max lc_tq_scc_inh_man lc_ena_fcut_tot_fast lc_tq_scc_ena_man c_eff_scc_sp_man c_fac_iga_min_teg_iga_bas c_hys_eff_iga_min_teg c_min_dec_eff_iga_min_teg_1 c_min_dec_eff_iga_min_teg_2 id_nr_pat_scc lc_inh_fcut_gs lc_inh_fcut_amt lc_inh_fcut_dcc lc_ena_fcut_tot_n_max lc_ena_fcut_tot_amt lc_ena_fcut_tot_dcc /end DEF_CHARACTERISTIC
 /begin OUT_MEASUREMENT eff_scc_av eff_scc_av_can eff_scc_sp_hys eff_scc_bas eff_scc_sp tqi_ref_iga_min_scc eff_iga_min_scc fac_iga_min_teg_iga_bas lv_auth_tq_pat nr_pat_scc t_max_fcut_fast /end OUT_MEASUREMENT
/end FUNCTION
/begin FUNCTION TQM_Minimum_torque_at_clutch "_Minimum torque at clutch"
 /begin DEF_CHARACTERISTIC c_n_dif_tq_st_1 c_n_dif_tq_st_2 ip_fac_n_dif_is ip_tqi_min_req_pu lc_tq_loss_min_clu lc_tq_loss_min_clu_1 lc_tq_loss_min_clu_is lc_inh_pu_req lc_inh_puc_req /end DEF_CHARACTERISTIC
 /begin OUT_MEASUREMENT tq_min_clu tq_min_clu_1 tq_min_clu_2 fac_n_dif_is lv_tq_min_clu tqi_min_req_pu tq_min_req_pu /end OUT_MEASUREMENT
/end FUNCTION
/begin FUNCTION TQM_Converter_torque "_Converter torque"
 /begin DEF_CHARACTERISTIC c_tq_add_conv_lgrd ip_tq_add_conv lc_tq_conv_dri_inh lc_tq_conv_can_inh ip_fac_conv__toil ip_fac_conv_dri__toil ip_t_dly_conv__toil ip_t_dly_n_sp_is__toil ip_fac_tq_conv__n_ratio_conv ip_n_tur__gr_at__vs ip_tq_conv_can ip_tq_add_conv_ac ip_tq_add_conv_n_grd ip_fac_tq_add_conv_toil ip_t_ramp_conv_neg__toil ip_t_ramp_conv_pos__toil /end DEF_CHARACTERISTIC
 /begin OUT_MEASUREMENT tq_conv_can_1 tq_add_conv lv_tout_conv t_conv tq_add_trans lv_dly_n_sp_is tq_conv_stn tq_conv tq_add_conv_2 /end OUT_MEASUREMENT
/end FUNCTION
/begin FUNCTION TQM_Torque_reserve_coordination "_Torque reserve coordination"
 /begin DEF_CHARACTERISTIC lc_inh_tq_add_ch lc_inh_tq_add c_tq_add_min_ch c_tq_add_hys c_tq_add_hys_cru c_tq_add_min c_tq_add_min_cru /end DEF_CHARACTERISTIC
 /begin OUT_MEASUREMENT tq_add_req_ch tq_add_max tq_add_req_max_teg maf_kgh_add_max maf_add_max tqi_add_act eff_iga_min_add_max tqi_add_max lv_tq_add_req tq_add_act tqi_add_act_tmp_1 tq_add_req tqi_add_act_tmp_2 tqi_add_act_tmp_3 tqi_add_max_tol tqi_add_max_teg lv_tq_add_req_1 tq_add_req_act lv_tq_add_req_2 /end OUT_MEASUREMENT
/end FUNCTION
/begin FUNCTION TQM_Minimum_indicated_torque_at_ "_Minimum indicated torque at trailing throttle conditions" /end FUNCTION
/begin FUNCTION TQM_Torque_based_anti_jerk_funct "_Torque based anti jerk function"
 /begin DEF_CHARACTERISTIC c_fil_aj_inp_0 c_fil_aj_inp_1 c_fil_aj_inp_2 c_fil_aj_out_1 c_fil_aj_out_2 id_fac_inv_veh_mass_at id_fac_inv_veh_mass_mt id_fac_tq_de_aj_at id_fac_tq_de_aj_mt c_n_dif_ref_aj_max c_n_dif_ref_aj_min ip_fac_tq_aj c_t_pas_aj_dly /end DEF_CHARACTERISTIC
 /begin OUT_MEASUREMENT n_dif_aj n_dif_ref_lpf_aj tq_dif_aj tq_fast_clu tq_mdl_de_aj n_ref_aj n_dif_ref_aj n_dif_ref_aj_inter /end OUT_MEASUREMENT
/end FUNCTION
/begin FUNCTION TQM_Basic__actual_and_minimum_la "_Basic, actual and minimum lambda efficiency"
 /begin DEF_CHARACTERISTIC ip_lamb_ref_add__tco ip_lamb_ref__n__maf ip_eff_lamb__lamb_dif /end DEF_CHARACTERISTIC
 /begin OUT_MEASUREMENT eff_lamb_bas_cor lamb_ref_cor lamb_dif_bas lamb_dif_av lamb_ref_add_tco lamb_dif_max eff_lamb_av eff_lamb_min eff_lamb_sp_bas lamb_ref lamb_dif_sp_bas /end OUT_MEASUREMENT
/end FUNCTION
/begin FUNCTION TQM_Pedal_value_interpretation "_Pedal value interpretation"
 /begin DEF_CHARACTERISTIC ip_fac_tq_req_driv_rng_l ip_fac_tq_req_driv c_pv_av_sof_min c_fac_tq_req_driv_sof_max c_pv_av_grd_sof_max c_t_pv_av_grd_sof_max lc_rng_l_man_as /end DEF_CHARACTERISTIC
 /begin OUT_MEASUREMENT fac_tq_req_driv lv_rng_l_req lv_rng_l_req_mon2 /end OUT_MEASUREMENT
/end FUNCTION
/begin FUNCTION TQM_Maximum_torque_at_clutch "_Maximum torque at clutch" /begin DEF_CHARACTERISTIC c_tqi_fac_fl /end DEF_CHARACTERISTIC /begin OUT_MEASUREMENT maf_max_cor tqi_ref_max tq_max_clu tqi_max /end OUT_MEASUREMENT /end FUNCTION
/begin FUNCTION TQM_Characteristic_quantity_stra "_Characteristic quantity stratified mode" /end FUNCTION
/begin FUNCTION TQM_Reference_and_basic_torque_f "_Reference and basic torque for stratified mode" /begin DEF_CHARACTERISTIC ip_tqi_ref_s /end DEF_CHARACTERISTIC /begin OUT_MEASUREMENT tqi_ref_s /end OUT_MEASUREMENT /end FUNCTION
/begin FUNCTION TQM_Torque_Request_at_Clutch_Gen "_Torque Request at Clutch General"
 /begin OUT_MEASUREMENT fac_tq_req_clu lv_tq_cru_act tq_req_clu tqi_min_req fac_tq_req /end OUT_MEASUREMENT
/end FUNCTION
/begin FUNCTION TQM_Minimum_Maximum_Torque_Reque "_Minimum/Maximum Torque Request Selection"
 /begin OUT_MEASUREMENT lv_tq_inc tqi_ems tqi_req_fast_dec tqi_inter_fast tqi_req_fast_inc tqi_inter_slow tqi_req_slow_sel tqi_req_fast_sel tqi_req_fast_sel_can state_tq_intv_slow state_tq_intv_fast /end OUT_MEASUREMENT
/end FUNCTION
/begin FUNCTION TQM_Torque_setpoint_for_stratifi "_Torque setpoint for stratified mode" /end FUNCTION
/begin FUNCTION TQM_Actual_Engine_Torque "_Actual Engine Torque" /begin DEF_CHARACTERISTIC c_fac_tqe /end DEF_CHARACTERISTIC /begin OUT_MEASUREMENT tqi_av_hom tq_av tqe tqi_av tqe_dif eff_tot_av /end OUT_MEASUREMENT /end FUNCTION
/begin FUNCTION TQM_Actual_indicated_engine_torq "_Actual indicated engine torque for stratified" /begin OUT_MEASUREMENT tqi_av_s eff_tot_av_s /end OUT_MEASUREMENT /end FUNCTION
/begin FUNCTION TQM_Characteristic_quantity_homo "_Characteristic quantity homogeneous mode" /end FUNCTION
/end MODULE
/end PROJECT
