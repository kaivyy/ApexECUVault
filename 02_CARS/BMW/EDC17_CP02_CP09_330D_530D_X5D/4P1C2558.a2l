ASAP2_VERSION 1 4
/begin PROJECT P_558 "EDC17_CP02"
/begin HEADER "" VERSION "V1C1" PROJECT_NO P_558 /end HEADER
/begin MODULE DIM ""
/begin MOD_COMMON "" BYTE_ORDER MSB_LAST ALIGNMENT_BYTE 1 ALIGNMENT_WORD 2 ALIGNMENT_LONG 4 ALIGNMENT_FLOAT32_IEEE 4 /end MOD_COMMON
/begin CHARACTERISTIC AFS_dmB1_C "" VALUE 0x80047180 Kw_Ws16 6553.500 AirMassPerTime -3276.800 3276.700 FORMAT "%8.3" /end CHARACTERISTIC
/begin CHARACTERISTIC AFS_dmB2_C "" VALUE 0x80047182 Kw_Ws16 6553.500 AirMassPerTime -3276.800 3276.700 FORMAT "%8.3" /end CHARACTERISTIC
/begin CHARACTERISTIC AFS_mAirPerCylB1_C "" VALUE 0x80047184 Kw_Ws16 6553.500 AirMassPerCyl -3276.800 3276.700 FORMAT "%8.3" /end CHARACTERISTIC
/begin CHARACTERISTIC AFS_mAirPerCylB2_C "" VALUE 0x80047186 Kw_Ws16 6553.500 AirMassPerCyl -3276.800 3276.700 FORMAT "%8.3" /end CHARACTERISTIC
/begin CHARACTERISTIC AirCCmprRedTrq_ATS.LimitTypeMsk_C "/" VALUE 0x8006FD70 Val_Wu8 255.0 OneToOne 0.00 255.0 FORMAT "%5.1" /end CHARACTERISTIC
/begin CHARACTERISTIC AirCCmprRedTrq_ATS.CnvNorm_C "/" VALUE 0x8006FD71 Val_Wu8 255.0 OneToOne 0.00 255.0 FORMAT "%5.1" /end CHARACTERISTIC
/begin CHARACTERISTIC AirCCmprRedTrq_ATS.CnvLimit_C "/" VALUE 0x8006FD72 Val_Wu8 255.0 OneToOne 0.00 255.0 FORMAT "%5.1" /end CHARACTERISTIC
/begin CHARACTERISTIC AirCCmprRedTrq_ATS.LowLim_C "/" VALUE 0x8006FD74 Val_Ws16 65535.00 OneToOne -32768.00 32767.00 FORMAT "%8.2" /end CHARACTERISTIC
/begin CHARACTERISTIC AirCCmprRedTrq_ATS.UpLim_C "/" VALUE 0x8006FD76 Val_Ws16 65535.00 OneToOne -32768.00 32767.00 FORMAT "%8.2" /end CHARACTERISTIC
/begin CHARACTERISTIC AirCCmprRedTrq_ATS.CnvFac_C "/" VALUE 0x8006FD78 Val_Ws32 4294967295.00 OneToOne -2147483648.00 2147483647.00 FORMAT "%13.2" /end CHARACTERISTIC
/begin CHARACTERISTIC AirCCmprRedTrq_ATS.CnvOfs_C "/" VALUE 0x8006FD7C Val_Ws16 65535.00 OneToOne -32768.00 32767.00 FORMAT "%8.2" /end CHARACTERISTIC
/begin CHARACTERISTIC AirCCmpr_ATS.LimitTypeMsk_C "/" VALUE 0x8006FD80 Val_Wu8 255.0 OneToOne 0.00 255.0 FORMAT "%5.1" /end CHARACTERISTIC
/begin CHARACTERISTIC AirCCmpr_ATS.CnvNorm_C "/" VALUE 0x8006FD81 Val_Wu8 255.0 OneToOne 0.00 255.0 FORMAT "%5.1" /end CHARACTERISTIC
/begin CHARACTERISTIC AirCCmpr_ATS.CnvLimit_C "/" VALUE 0x8006FD82 Val_Wu8 255.0 OneToOne 0.00 255.0 FORMAT "%5.1" /end CHARACTERISTIC
/begin CHARACTERISTIC AirCCmpr_ATS.LowLim_C "/" VALUE 0x8006FD84 Val_Ws16 65535.00 OneToOne -32768.00 32767.00 FORMAT "%8.2" /end CHARACTERISTIC
/begin CHARACTERISTIC AirCCmpr_ATS.UpLim_C "/" VALUE 0x8006FD86 Val_Ws16 65535.00 OneToOne -32768.00 32767.00 FORMAT "%8.2" /end CHARACTERISTIC
/begin CHARACTERISTIC AirCCmpr_ATS.CnvFac_C "/" VALUE 0x8006FD88 Val_Ws32 4294967295.00 OneToOne -2147483648.00 2147483647.00 FORMAT "%13.2" /end CHARACTERISTIC
/begin CHARACTERISTIC AirCCmpr_ATS.CnvOfs_C "/" VALUE 0x8006FD8C Val_Ws16 65535.00 OneToOne -32768.00 32767.00 FORMAT "%8.2" /end CHARACTERISTIC
/begin CHARACTERISTIC Air_pUnFltPCACDsB1_C "" VALUE 0x80047188 Kw_Ws16 36268.00 Pres_hPa -32768.00 3500.00 FORMAT "%8.2" EXTENDED_LIMITS -32768.00 32767.00 /end CHARACTERISTIC
/begin CHARACTERISTIC Air_pUnFltPCACDsB2_C "" VALUE 0x8004718A Kw_Ws16 36268.00 Pres_hPa -32768.00 3500.00 FORMAT "%8.2" EXTENDED_LIMITS -32768.00 32767.00 /end CHARACTERISTIC
/begin CHARACTERISTIC Air_tCACDsB1_C "" VALUE 0x8004718C Kw_Ws16 6553.500 Temp_Cels -3549.940 3003.560 FORMAT "%8.3" /end CHARACTERISTIC
/begin CHARACTERISTIC Air_tCACDsB2_C "" VALUE 0x8004718E Kw_Ws16 6553.500 Temp_Cels -3549.940 3003.560 FORMAT "%8.3" /end CHARACTERISTIC
/begin CHARACTERISTIC ASDrf_CoefADecrLim_C "Koeffizient A der Parabel y = a*x^2 + b der Steigungsbegrenzung für Momentenabsenkung" VALUE 0x80046E30 Val_Ws16 159.9951 ASDrf_LADCoefA 0.00 159.9951 FORMAT "%8.4" EXTENDED_LIMITS -160.0000 159.9951 /end CHARACTERISTIC
/begin CHARACTERISTIC ASDrf_CoefBDecrLim_C "Koeffizient B der Parabel y = a*x^2 + b der Steigungsbegrenzung für Momentenabsenkung" VALUE 0x80046E32 Val_Ws16 3276.700 dTrq 0.00 3276.700 FORMAT "%8.3" EXTENDED_LIMITS -3276.800 3276.700 /end CHARACTERISTIC
/begin CHARACTERISTIC ASDrf_dtrqIncrLimHi_C "Hystereseschwelle oben für steile Momentengradienten" VALUE 0x80046E34 Val_Ws16 3276.700 dTrq 0.00 3276.700 FORMAT "%8.3" EXTENDED_LIMITS -3276.800 3276.700 /end CHARACTERISTIC
/begin CHARACTERISTIC ASDrf_dtrqIncrLimLo_C "Hystereseschwelle unten für steile Momentengradienten" VALUE 0x80046E36 Val_Ws16 3276.700 dTrq 0.00 3276.700 FORMAT "%8.3" EXTENDED_LIMITS -3276.800 3276.700 /end CHARACTERISTIC
/begin CHARACTERISTIC ASDrf_dtrqInrLtdLim_CUR "Kurve zur Begrenzung der zeitl. Ableitung von CoETS_trqInrLtd" CURVE 0x80046E38 Cur_Xs16Ws16 4000.000 dTrq -2000.000 2000.000 FORMAT "%8.3" EXTENDED_LIMITS -3276.800 3276.700
 /begin AXIS_DESCR STD_AXIS ASDrf_dtrqInrLtd_mp dTrq 5 -3276.800 3276.700 FORMAT "%8.3" DEPOSIT ABSOLUTE /end AXIS_DESCR
/end CHARACTERISTIC
/begin CHARACTERISTIC ASDrf_dtrqSteepNeg_C "Obergrenze für Initialisierung bei steilen Eingangssignalgradienten" VALUE 0x80046E4E Val_Ws16 2000.000 dTrq -2000.000 0.00 FORMAT "%8.3" EXTENDED_LIMITS -3276.800 3276.700 /end CHARACTERISTIC
/begin CHARACTERISTIC ASDrf_dtrqSteepPos_C "Untergrenze für Initialisierung bei steilen Eingangssignalgradienten" VALUE 0x80046E50 Val_Ws16 2000.000 dTrq 0.00 2000.000 FORMAT "%8.3" EXTENDED_LIMITS -3276.800 3276.700 /end CHARACTERISTIC
/begin CHARACTERISTIC ASDrf_FltClthNeg.T1_C "/" VALUE 0x80046E74 Val_Ws32 4294.9672940 TimeDelay_s 0.000002000000001 4294.9672960 FORMAT "%12.7" /end CHARACTERISTIC
/begin CHARACTERISTIC ASDrf_FltClthNeg.Kd_C "/" VALUE 0x80046E78 Val_Ws32 32769.0000000 Kd -32768.0000000 1.00000000000 FORMAT "%13.7" EXTENDED_LIMITS -32768.0000000 32767.9999847 /end CHARACTERISTIC
/begin CHARACTERISTIC ASDrf_FltClthPos.T1_C "/" VALUE 0x80046E7C Val_Ws32 4294.9672940 TimeDelay_s 0.000002000000001 4294.9672960 FORMAT "%12.7" /end CHARACTERISTIC
/begin CHARACTERISTIC ASDrf_FltClthPos.Kd_C "/" VALUE 0x80046E80 Val_Ws32 32769.0000000 Kd -32768.0000000 1.00000000000 FORMAT "%13.7" EXTENDED_LIMITS -32768.0000000 32767.9999847 /end CHARACTERISTIC
/begin CHARACTERISTIC ASDrf_FltExtIntv.T1_C "/" VALUE 0x80046E84 Val_Ws32 4294.9672940 TimeDelay_s 0.000002000000001 4294.9672960 FORMAT "%12.7" /end CHARACTERISTIC
/begin CHARACTERISTIC ASDrf_FltExtIntv.Kd_C "/" VALUE 0x80046E88 Val_Ws32 32769.0000000 Kd -32768.0000000 1.00000000000 FORMAT "%13.7" EXTENDED_LIMITS -32768.0000000 32767.9999847 /end CHARACTERISTIC
/begin CHARACTERISTIC ASDrf_FltGripNeg.T1_CUR "/" CURVE 0x80046E8C Cur_Xs16Ws16 1.499985 TimeDelay_s_Lin_16 0.00 1.499985 FORMAT "%8.6" EXTENDED_LIMITS -5.000153 5.000000
 /begin AXIS_DESCR STD_AXIS PT_rTrq TransR 16 -327.6800 327.6700 FORMAT "%8.4" DEPOSIT ABSOLUTE /end AXIS_DESCR
/end CHARACTERISTIC
/begin CHARACTERISTIC ASDrf_FltGripNeg.Kd_CUR "/" CURVE 0x80046ECE Cur_Xs16Ws16 1.000000 Kd_Lin_16 0.00 1.000000 FORMAT "%8.6" EXTENDED_LIMITS -1.000031 1.000000
 /begin AXIS_DESCR STD_AXIS PT_rTrq TransR 16 -327.6800 327.6700 FORMAT "%8.4" DEPOSIT ABSOLUTE /end AXIS_DESCR
/end CHARACTERISTIC
/begin CHARACTERISTIC ASDrf_FltGripPos.T1_CUR "/" CURVE 0x80046F10 Cur_Xs16Ws16 1.499985 TimeDelay_s_Lin_16 0.00 1.499985 FORMAT "%8.6" EXTENDED_LIMITS -5.000153 5.000000
 /begin AXIS_DESCR STD_AXIS PT_rTrq TransR 16 -327.6800 327.6700 FORMAT "%8.4" DEPOSIT ABSOLUTE /end AXIS_DESCR
/end CHARACTERISTIC
/begin CHARACTERISTIC ASDrf_FltGripPos.Kd_CUR "/" CURVE 0x80046F52 Cur_Xs16Ws16 1.000000 Kd_Lin_16 0.00 1.000000 FORMAT "%8.6" EXTENDED_LIMITS -1.000031 1.000000
 /begin AXIS_DESCR STD_AXIS PT_rTrq TransR 16 -327.6800 327.6700 FORMAT "%8.4" DEPOSIT ABSOLUTE /end AXIS_DESCR
/end CHARACTERISTIC
/begin CHARACTERISTIC ASDrf_FltSt3Neg.T1_C "/" VALUE 0x80046F94 Val_Ws32 4294.9672940 TimeDelay_s 0.000002000000001 4294.9672960 FORMAT "%12.7" /end CHARACTERISTIC
/begin CHARACTERISTIC ASDrf_FltSt3Neg.Kd_C "/" VALUE 0x80046F98 Val_Ws32 32769.0000000 Kd -32768.0000000 1.00000000000 FORMAT "%13.7" EXTENDED_LIMITS -32768.0000000 32767.9999847 /end CHARACTERISTIC
/begin CHARACTERISTIC ASDrf_FltSt3Pos.T1_C "/" VALUE 0x80046F9C Val_Ws32 4294.9672940 TimeDelay_s 0.000002000000001 4294.9672960 FORMAT "%12.7" /end CHARACTERISTIC
/begin CHARACTERISTIC ASDrf_FltSt3Pos.Kd_C "/" VALUE 0x80046FA0 Val_Ws32 32769.0000000 Kd -32768.0000000 1.00000000000 FORMAT "%13.7" EXTENDED_LIMITS -32768.0000000 32767.9999847 /end CHARACTERISTIC
/begin CHARACTERISTIC ASDrf_FltSt4Neg.T1_C "/" VALUE 0x80046FA4 Val_Ws32 4294.9672940 TimeDelay_s 0.000002000000001 4294.9672960 FORMAT "%12.7" /end CHARACTERISTIC
/begin CHARACTERISTIC ASDrf_FltSt4Neg.Kd_C "/" VALUE 0x80046FA8 Val_Ws32 32769.0000000 Kd -32768.0000000 1.00000000000 FORMAT "%13.7" EXTENDED_LIMITS -32768.0000000 32767.9999847 /end CHARACTERISTIC
/begin CHARACTERISTIC ASDrf_FltSt4Pos.T1_C "/" VALUE 0x80046FAC Val_Ws32 4294.9672940 TimeDelay_s 0.000002000000001 4294.9672960 FORMAT "%12.7" /end CHARACTERISTIC
/begin CHARACTERISTIC ASDrf_FltSt4Pos.Kd_C "/" VALUE 0x80046FB0 Val_Ws32 32769.0000000 Kd -32768.0000000 1.00000000000 FORMAT "%13.7" EXTENDED_LIMITS -32768.0000000 32767.9999847 /end CHARACTERISTIC
/begin CHARACTERISTIC ASDrf_LADClthNeg.CoefA_C "/" VALUE 0x80046FB4 Val_Ws16 159.9951 ASDrf_LADCoefA 0.00 159.9951 FORMAT "%8.4" EXTENDED_LIMITS -160.0000 159.9951 /end CHARACTERISTIC
/begin CHARACTERISTIC ASDrf_LADClthNeg.CoefB_C "/" VALUE 0x80046FB6 Val_Ws16 3276.700 dTrq 0.00 3276.700 FORMAT "%8.3" EXTENDED_LIMITS -3276.800 3276.700 /end CHARACTERISTIC
/begin CHARACTERISTIC ASDrf_LADClthPos.CoefA_C "/" VALUE 0x80046FB8 Val_Ws16 159.9951 ASDrf_LADCoefA 0.00 159.9951 FORMAT "%8.4" EXTENDED_LIMITS -160.0000 159.9951 /end CHARACTERISTIC
/begin CHARACTERISTIC ASDrf_LADClthPos.CoefB_C "/" VALUE 0x80046FBA Val_Ws16 3276.700 dTrq 0.00 3276.700 FORMAT "%8.3" EXTENDED_LIMITS -3276.800 3276.700 /end CHARACTERISTIC
/begin CHARACTERISTIC ASDrf_LADExtIntv.CoefA_C "/" VALUE 0x80046FBC Val_Ws16 159.9951 ASDrf_LADCoefA 0.00 159.9951 FORMAT "%8.4" EXTENDED_LIMITS -160.0000 159.9951 /end CHARACTERISTIC
/begin CHARACTERISTIC ASDrf_LADExtIntv.CoefB_C "/" VALUE 0x80046FBE Val_Ws16 3276.700 dTrq 0.00 3276.700 FORMAT "%8.3" EXTENDED_LIMITS -3276.800 3276.700 /end CHARACTERISTIC
/begin CHARACTERISTIC ASDrf_LADGripNeg.CoefA_CUR "/" CURVE 0x80046FC0 Cur_Xs16Ws16 159.9951 ASDrf_LADCoefA 0.00 159.9951 FORMAT "%8.4" EXTENDED_LIMITS -160.0000 159.9951
 /begin AXIS_DESCR STD_AXIS PT_rTrq TransR 16 -327.6800 327.6700 FORMAT "%8.4" DEPOSIT ABSOLUTE /end AXIS_DESCR
/end CHARACTERISTIC
/begin CHARACTERISTIC ASDrf_LADGripNeg.CoefB_CUR "/" CURVE 0x80047002 Cur_Xs16Ws16 3276.700 dTrq 0.00 3276.700 FORMAT "%8.3" EXTENDED_LIMITS -3276.800 3276.700
 /begin AXIS_DESCR STD_AXIS PT_rTrq TransR 16 -327.6800 327.6700 FORMAT "%8.4" DEPOSIT ABSOLUTE /end AXIS_DESCR
/end CHARACTERISTIC
/begin CHARACTERISTIC ASDrf_LADGripPos.CoefA_CUR "/" CURVE 0x80047044 Cur_Xs16Ws16 159.9951 ASDrf_LADCoefA 0.00 159.9951 FORMAT "%8.4" EXTENDED_LIMITS -160.0000 159.9951
 /begin AXIS_DESCR STD_AXIS PT_rTrq TransR 16 -327.6800 327.6700 FORMAT "%8.4" DEPOSIT ABSOLUTE /end AXIS_DESCR
/end CHARACTERISTIC
/begin CHARACTERISTIC ASDrf_LADGripPos.CoefB_CUR "/" CURVE 0x80047086 Cur_Xs16Ws16 3276.700 dTrq 0.00 3276.700 FORMAT "%8.3" EXTENDED_LIMITS -3276.800 3276.700
 /begin AXIS_DESCR STD_AXIS PT_rTrq TransR 16 -327.6800 327.6700 FORMAT "%8.4" DEPOSIT ABSOLUTE /end AXIS_DESCR
/end CHARACTERISTIC
/begin CHARACTERISTIC ASDrf_LADSt3Neg.CoefA_C "/" VALUE 0x800470C8 Val_Ws16 159.9951 ASDrf_LADCoefA 0.00 159.9951 FORMAT "%8.4" EXTENDED_LIMITS -160.0000 159.9951 /end CHARACTERISTIC
/begin CHARACTERISTIC ASDrf_LADSt3Neg.CoefB_C "/" VALUE 0x800470CA Val_Ws16 3276.700 dTrq 0.00 3276.700 FORMAT "%8.3" EXTENDED_LIMITS -3276.800 3276.700 /end CHARACTERISTIC
/begin CHARACTERISTIC ASDrf_LADSt3Pos.CoefA_C "/" VALUE 0x800470CC Val_Ws16 159.9951 ASDrf_LADCoefA 0.00 159.9951 FORMAT "%8.4" EXTENDED_LIMITS -160.0000 159.9951 /end CHARACTERISTIC
/begin CHARACTERISTIC ASDrf_LADSt3Pos.CoefB_C "/" VALUE 0x800470CE Val_Ws16 3276.700 dTrq 0.00 3276.700 FORMAT "%8.3" EXTENDED_LIMITS -3276.800 3276.700 /end CHARACTERISTIC
/begin CHARACTERISTIC ASDrf_LADSt4Neg.CoefA_C "/" VALUE 0x800470D0 Val_Ws16 159.9951 ASDrf_LADCoefA 0.00 159.9951 FORMAT "%8.4" EXTENDED_LIMITS -160.0000 159.9951 /end CHARACTERISTIC
/begin CHARACTERISTIC ASDrf_LADSt4Neg.CoefB_C "/" VALUE 0x800470D2 Val_Ws16 3276.700 dTrq 0.00 3276.700 FORMAT "%8.3" EXTENDED_LIMITS -3276.800 3276.700 /end CHARACTERISTIC
/begin CHARACTERISTIC ASDrf_LADSt4Pos.CoefA_C "/" VALUE 0x800470D4 Val_Ws16 159.9951 ASDrf_LADCoefA 0.00 159.9951 FORMAT "%8.4" EXTENDED_LIMITS -160.0000 159.9951 /end CHARACTERISTIC
/begin CHARACTERISTIC ASDrf_LADSt4Pos.CoefB_C "/" VALUE 0x800470D6 Val_Ws16 3276.700 dTrq 0.00 3276.700 FORMAT "%8.3" EXTENDED_LIMITS -3276.800 3276.700 /end CHARACTERISTIC
/begin CHARACTERISTIC ASDrf_numDflSt_C "Nummer des Default-Primärzustandes (dezimal kodiert)" VALUE 0x800470D8 Val_Wu16 4.00000000000 ASDrf_numDflSt 0.00 4.00000000000 FORMAT "%13.11" /end CHARACTERISTIC
/begin CHARACTERISTIC ASDrf_numPrio_CA "Prioritäten der Primärzustände" VAL_BLK 0x800470DA ValA_Wu8 255.0 OneToOne 0.00 255.0 FORMAT "%5.1" NUMBER 5 /end CHARACTERISTIC
/begin CHARACTERISTIC ASDrf_stCfgClthOpn_C "Konfiguration der Eingangsbedingung ""offener Wandlerkupplung""" VALUE 0x800470E0 Val_Wu16 65535.00 OneToOne 0.00 65535.00 FORMAT "%8.2" /end CHARACTERISTIC
/begin CHARACTERISTIC ASDrf_stCfgClthSlipClsd_C "Konfiguration der Eingangsbedingung ""geregelter (geschlossener) Wandlerkupplung""" VALUE 0x800470E2 Val_Wu16 65535.00 OneToOne 0.00 65535.00 FORMAT "%8.2" /end CHARACTERISTIC
/begin CHARACTERISTIC ASDrf_stCfgClthSlipOpn_C "Konfiguration der Eingangsbedingung ""geregelter (offener) Wandlerkupplung""" VALUE 0x800470E4 Val_Wu16 65535.00 OneToOne 0.00 65535.00 FORMAT "%8.2" /end CHARACTERISTIC
/begin CHARACTERISTIC ASDrf_stCfgClthSlip_C "Konfiguration der Eingangsbedingung ""geregelter Wandlerkupplung""" VALUE 0x800470E6 Val_Wu16 65535.00 OneToOne 0.00 65535.00 FORMAT "%8.2" /end CHARACTERISTIC
/begin CHARACTERISTIC ASDrf_stCfgConExtIntv_C "Festlegung der Eingangsbedingung ""Externer Momenteneingriff"" (Bitmaske zur Nachricht GlbDa_stTrqDem)" VALUE 0x800470E8 Val_Wu16 65535.00 OneToOne 0.00 65535.00 FORMAT "%8.2" /end CHARACTERISTIC
/begin CHARACTERISTIC ASDrf_stEntcClth_C "Initialisierungsanforderung beim Eintritt in den Zustand ""offener Antriebstrang"" (Primärzustand 1)" VALUE 0x800470EA Val_Wu8 3.000 OneToOne 0.00 3.000 FORMAT "%5.3" EXTENDED_LIMITS 0.00 255.0 /end CHARACTERISTIC
/begin CHARACTERISTIC ASDrf_stEntcExtIntv_C "Initialisierungsanforderung beim Eintritt in den Zustand ""externer Momenteneingriff"" (Primärzustand 0)" VALUE 0x800470EB Val_Wu8 3.000 OneToOne 0.00 3.000 FORMAT "%5.3" EXTENDED_LIMITS 0.00 255.0 /end CHARACTERISTIC
/begin CHARACTERISTIC ASDrf_stEntcGrip_C "Initialisierungsanforderung beim Eintritt in den Zustand ""geschlossener Antriebsstrang"" (Primärzustand 2)" VALUE 0x800470EC Val_Wu8 3.000 OneToOne 0.00 3.000 FORMAT "%5.3" EXTENDED_LIMITS 0.00 255.0 /end CHARACTERISTIC
/begin CHARACTERISTIC ASDrf_stEntcSt3_C "Initialisierungsanforderung beim Eintritt in den Primärzustand 3" VALUE 0x800470ED Val_Wu8 3.000 OneToOne 0.00 3.000 FORMAT "%5.3" EXTENDED_LIMITS 0.00 255.0 /end CHARACTERISTIC
/begin CHARACTERISTIC ASDrf_stEntcSt4_C "Initialisierungsanforderung beim Eintritt in den Primärzustand 4" VALUE 0x800470EE Val_Wu8 3.000 OneToOne 0.00 3.000 FORMAT "%5.3" EXTENDED_LIMITS 0.00 255.0 /end CHARACTERISTIC
/begin CHARACTERISTIC ASDrf_stExClth_C "Initialisierungsanforderung beim Verlassen des Zustands ""offener Antriebsstrang"" (Primärzustand 1)" VALUE 0x800470EF Val_Wu8 3.000 OneToOne 0.00 3.000 FORMAT "%5.3" EXTENDED_LIMITS 0.00 255.0 /end CHARACTERISTIC
/begin CHARACTERISTIC ASDrf_stExExtIntv_C "Initialisierungsanforderung beim Verlassen des Zustands ""externer Momenteneingriff"" (Primärzustand 0)" VALUE 0x800470F0 Val_Wu8 3.000 OneToOne 0.00 3.000 FORMAT "%5.3" EXTENDED_LIMITS 0.00 255.0 /end CHARACTERISTIC
/begin CHARACTERISTIC ASDrf_stExGrip_C "Initialisierungsanforderung beim Verlassen des Zustands ""geschlossener Antriebsstrang"" (Primärzustand 2)" VALUE 0x800470F1 Val_Wu8 3.000 OneToOne 0.00 3.000 FORMAT "%5.3" EXTENDED_LIMITS 0.00 255.0 /end CHARACTERISTIC
/begin CHARACTERISTIC ASDrf_stExSt3_C "Initialisierungsanforderung beim Verlassen des Primärzustandes 3" VALUE 0x800470F2 Val_Wu8 3.000 OneToOne 0.00 3.000 FORMAT "%5.3" EXTENDED_LIMITS 0.00 255.0 /end CHARACTERISTIC
/begin CHARACTERISTIC ASDrf_stExSt4_C "Initialisierungsanforderung beim Verlassen des Primärzustandes 4" VALUE 0x800470F3 Val_Wu8 3.000 OneToOne 0.00 3.000 FORMAT "%5.3" EXTENDED_LIMITS 0.00 255.0 /end CHARACTERISTIC
/begin CHARACTERISTIC ASDrf_stExtIntv_C "Konfiguration der Eingangsbedingung ""Externer Momenteneingriff""" VALUE 0x800470F4 Val_Wu16 65535.00 OneToOne 0.00 65535.00 FORMAT "%8.2" /end CHARACTERISTIC
/begin CHARACTERISTIC ASDrf_stGrip_C "Konfiguration der Eingangsbedingung ""geschlossener Antriebsstrang und Nulldurchgang des Störungsreglers""" VALUE 0x800470F6 Val_Wu16 65535.00 OneToOne 0.00 65535.00 FORMAT "%8.2" /end CHARACTERISTIC
/begin CHARACTERISTIC ASDrf_swtCalcTrq_C "Schalter für die Berechnung des aktuellen ASD Moments (mit oder ohne ASDdc_trq)" VALUE 0x80046E52 Val_Wu8 1.000 OneToOne 0.00 1.000 FORMAT "%5.3" EXTENDED_LIMITS 0.00 255.0 /end CHARACTERISTIC
/begin CHARACTERISTIC ASDrf_swtFlt_C "Schalter zur Auswahl des Filters für CoETS_trqInrLtd (0 Filterung / >0 keine Filterung)" VALUE 0x80046E53 Val_Wu8 255.0 OneToOne 0.00 255.0 FORMAT "%5.1" /end CHARACTERISTIC
/begin CHARACTERISTIC ASDrf_swtFrzLos_C "Schalter für die Berechnung des Verlustmoments bei aktiver Steigungsbegrenzung (1 = eingefroren)" VALUE 0x80046E54 Val_Wu8 1.000 OneToOne 0.00 1.000 FORMAT "%5.3" EXTENDED_LIMITS 0.00 255.0 /end CHARACTERISTIC
/begin CHARACTERISTIC ASDrf_swtIniParSet_C "Schalter zur Aktivierung / Deaktivierung der kontinuierlichen Initialisierung aufgrund Parametersatzwechsels" VALUE 0x80046E55 Val_Wu8 255.0 OneToOne 0.00 255.0 FORMAT "%5.1" /end CHARACTERISTIC
/begin CHARACTERISTIC ASDrf_swtLim_C "Schalter zur Begrenzung von ASDrf_trqInrSet auf CoETS_trqInrLtd" VALUE 0x80046E56 Val_Wu8 3.000 OneToOne 0.00 3.000 FORMAT "%5.3" EXTENDED_LIMITS 0.00 255.0 /end CHARACTERISTIC
/begin CHARACTERISTIC ASDrf_swtLosCalc_C "Schalter für die Berechnung des Verlustmoments (0 = Kennlinie : 1 = gelerntes Verlustmoment)" VALUE 0x800470F8 Val_Wu8 1.000 OneToOne 0.00 1.000 FORMAT "%5.3" EXTENDED_LIMITS 0.00 255.0 /end CHARACTERISTIC
/begin CHARACTERISTIC ASDrf_swtOpr_C "Schalter des Verknüpfungsoperators (00=OR : 01=AND : 10=NAND : 11=NOR)" VALUE 0x800470FA Val_Wu16 65535.00 OneToOne 0.00 65535.00 FORMAT "%8.2" /end CHARACTERISTIC
/begin CHARACTERISTIC ASDrf_T1Flt_C "Zeitkonstante PT1 Glied zur Filterung von CoETS_trqInrLtd vor der Ableitung" VALUE 0x80046E58 Val_Ws32 4294.9672940 TimeDelay_s 0.000002000000001 4294.9672960 FORMAT "%12.7" /end CHARACTERISTIC
/begin CHARACTERISTIC ASDrf_tiTrqSty_C "Zeit für die Erkennung des stationären Zustands, wenn das Moment innerhalb des Intervalls liegt" VALUE 0x80046E5C Val_Ws16 655350.0 Time_ms -327680.0 327670.0 FORMAT "%8.1" /end CHARACTERISTIC
/begin CHARACTERISTIC ASDrf_trqDecrHi_C "Offset der oberen Intervallgrenze zur Bestimmung des stationären Zustands" VALUE 0x80046E5E Val_Ws16 1500.000 Trq -500.0000 1000.000 FORMAT "%8.3" EXTENDED_LIMITS -3276.800 3276.700 /end CHARACTERISTIC
/begin CHARACTERISTIC ASDrf_trqDecrLo_C "Offset der unteren Intervallgrenze zur Bestimmung des stationären Zustands" VALUE 0x80046E60 Val_Ws16 1500.000 Trq -500.0000 1000.000 FORMAT "%8.3" EXTENDED_LIMITS -3276.800 3276.700 /end CHARACTERISTIC
/begin CHARACTERISTIC ASDrf_trqLosNeg_CUR "Drehzahlabhängige Kennlinie der Verlustmomente für negative Eingangsänderungen" CURVE 0x800470FC Cur_Xs16Ws16 1500.000 Trq -500.0000 1000.000 FORMAT "%8.3" EXTENDED_LIMITS -3276.800 3276.700
 /begin AXIS_DESCR STD_AXIS Epm_nEng EngN 16 -16384.00 16383.50 FORMAT "%8.2" DEPOSIT ABSOLUTE /end AXIS_DESCR
/end CHARACTERISTIC
/begin CHARACTERISTIC ASDrf_trqLosPos_CUR "Drehzahlabhängige Kennlinie der Verlustmomente für positive Eingangsänderungen" CURVE 0x8004713E Cur_Xs16Ws16 1500.000 Trq -500.0000 1000.000 FORMAT "%8.3" EXTENDED_LIMITS -3276.800 3276.700
 /begin AXIS_DESCR STD_AXIS Epm_nEng EngN 16 -16384.00 16383.50 FORMAT "%8.2" DEPOSIT ABSOLUTE /end AXIS_DESCR
/end CHARACTERISTIC
/begin CHARACTERISTIC ASDrf_trqOfsNegHi_C "Annäherungsschwelle zum Verlustmoment, neg. Gradient" VALUE 0x80046E62 Val_Ws16 1500.000 Trq -500.0000 1000.000 FORMAT "%8.3" EXTENDED_LIMITS -3276.800 3276.700 /end CHARACTERISTIC
/begin CHARACTERISTIC ASDrf_trqOfsNegLo_C "Offset zum Verlustmoment für die Beendigung des Zustands ""Steigungsbegrenzung"", neg. Gradient" VALUE 0x80046E64 Val_Ws16 1500.000 Trq -500.0000 1000.000 FORMAT "%8.3" EXTENDED_LIMITS -3276.800 3276.700 /end CHARACTERISTIC
/begin CHARACTERISTIC ASDrf_trqOfsNegMid_C "Offset zum Verlustmoment für die Annäherungserkennung und Aktivierung des Zustands ""Steigungsbegrenzung"", neg. Gradient" VALUE 0x80046E66 Val_Ws16 1500.000 Trq -500.0000 1000.000 FORMAT "%8.3" EXTENDED_LIMITS -3276.800 3276.700 /end CHARACTERISTIC
/begin CHARACTERISTIC ASDrf_trqOfsPosHi_C "Offset zum Verlustmoment für die Beendigung des Zustands ""Steigungsbegrenzung"", pos. Gradient" VALUE 0x80046E68 Val_Ws16 1500.000 Trq -500.0000 1000.000 FORMAT "%8.3" EXTENDED_LIMITS -3276.800 3276.700 /end CHARACTERISTIC
/begin CHARACTERISTIC ASDrf_trqOfsPosLo_C "Annäherungsschwelle zum Verlustmoment, pos. Gradient" VALUE 0x80046E6A Val_Ws16 1500.000 Trq -500.0000 1000.000 FORMAT "%8.3" EXTENDED_LIMITS -3276.800 3276.700 /end CHARACTERISTIC
/begin CHARACTERISTIC ASDrf_trqOfsPosMid_C "Offset zum Verslustmoment für die Annäherungserkennung und Aktivierung des Zustands ""Steigungsbegrenzung"", pos. Gradient" VALUE 0x80046E6C Val_Ws16 1500.000 Trq -500.0000 1000.000 FORMAT "%8.3" EXTENDED_LIMITS -3276.800 3276.700 /end CHARACTERISTIC
/begin CHARACTERISTIC ASDrf_trqThresDecrLim_C "Abstand zum Startpunkt zur Deaktivierung der Steigungsbegrenzung durch Momentenabsenkung" VALUE 0x80046E6E Val_Ws16 1500.000 Trq -500.0000 1000.000 FORMAT "%8.3" EXTENDED_LIMITS -3276.800 3276.700 /end CHARACTERISTIC
/begin CHARACTERISTIC ASDrf_trqThresNeg_C "ASD Führungsformer Hystereseschwelle neg. Wunschmomentgradient" VALUE 0x80046E70 Val_Ws16 1500.000 Trq -500.0000 1000.000 FORMAT "%8.3" EXTENDED_LIMITS -3276.800 3276.700 /end CHARACTERISTIC
/begin CHARACTERISTIC ASDrf_trqThresPos_C "ASD Führungsformer Hystereseschwelle pos. Wunschmomentgradient" VALUE 0x80046E72 Val_Ws16 1500.000 Trq -500.0000 1000.000 FORMAT "%8.3" EXTENDED_LIMITS -3276.800 3276.700 /end CHARACTERISTIC
/begin CHARACTERISTIC ASMod_arEffTVA_CUR "effektive Querschnittsfläche der Drosselklappe" CURVE 0x8006FC44 Kl_Xs16_Ws16 50.00000 Area_cm2 0.00 50.00000 FORMAT "%8.5" EXTENDED_LIMITS -32.76800 32.76700
 /begin AXIS_DESCR STD_AXIS ASMod_rRelPosTVA Prc 10 0.00 100.0000 FORMAT "%8.4" EXTENDED_LIMITS -400.0000 399.9878 DEPOSIT ABSOLUTE /end AXIS_DESCR
/end CHARACTERISTIC
/begin CHARACTERISTIC ASMod_cndHtOfsSlw_C "Offsetwert für Wärmeleitfähigkeit" VALUE 0x800480D0 Kw_Ws16 0.009033203 Fact 0.0009765625 0.01000977 FORMAT "%10.8" EXTENDED_LIMITS -4.000000 3.999878 /end CHARACTERISTIC
/begin CHARACTERISTIC ASMod_cndHtOfs_C "Offsetwert für Wärmeleitfähigkeit" VALUE 0x80048048 Kw_Ws16 0.009033203 Fact 0.0009765625 0.01000977 FORMAT "%10.8" EXTENDED_LIMITS -4.000000 3.999878 /end CHARACTERISTIC
/begin CHARACTERISTIC ASMod_cpGs_C "Spezifische Wärmekapazität Gas" VALUE 0x800471B4 Kw_Ws32 2.00000000000 SpecificHeat 0.00 2.00000000000 FORMAT "%13.11" EXTENDED_LIMITS -214748.364800 214748.364700 /end CHARACTERISTIC
/begin CHARACTERISTIC ASMod_cpNSC_C "Wärmekapazität NSC" VALUE 0x80047E34 Kw_Ws16 2999.900 HeatCapacity 0.1000000 3000.000 FORMAT "%8.3" EXTENDED_LIMITS -3276.800 3276.700 /end CHARACTERISTIC
/begin CHARACTERISTIC ASMod_cpOxiC_C "Wärmekapazität Oxidationskatalysator" VALUE 0x80047EE4 Val_Ws16 2999.900 HeatCapacity 0.1000000 3000.000 FORMAT "%8.3" EXTENDED_LIMITS -3276.800 3276.700 /end CHARACTERISTIC
/begin CHARACTERISTIC ASMod_cpPFlt_C "Wärmekapazität des Partikelfilters" VALUE 0x80047FB8 Kw_Ws16 2999.900 HeatCapacity 0.1000000 3000.000 FORMAT "%8.3" EXTENDED_LIMITS -3276.800 3276.700 /end CHARACTERISTIC
/begin CHARACTERISTIC ASMod_cpPipeSlw_CA "Wärmekapazität des Rohres" VAL_BLK 0x800480D2 Kwb_Ws16 2999.900 HeatCapacity 0.1000000 3000.000 FORMAT "%8.3" EXTENDED_LIMITS -3276.800 3276.700 NUMBER 4 /end CHARACTERISTIC
/begin CHARACTERISTIC ASMod_cpPipe_CA "Wärmekapazität des Rohres" VAL_BLK 0x8004804A Kwb_Ws16 2999.900 HeatCapacity 0.1000000 3000.000 FORMAT "%8.3" EXTENDED_LIMITS -3276.800 3276.700 NUMBER 3 /end CHARACTERISTIC
/begin CHARACTERISTIC ASMod_dmAshEG_CUR "Kennlinie für Rußmassentrom nach Verbrennung (aus Ölverbrauch)" CURVE 0x80047270 Kl_Xs16_Ws16 326.6700 AshMassPerTime 0.00 326.6700 FORMAT "%8.4" EXTENDED_LIMITS -327.6800 327.6700
 /begin AXIS_DESCR STD_AXIS ASMod_dmOilConsCrvIn_mp OilMassPerTime 8 0.00 3.000000 FORMAT "%8.6" EXTENDED_LIMITS -3.276800 3.276700 DEPOSIT ABSOLUTE /end AXIS_DESCR
/end CHARACTERISTIC
/begin CHARACTERISTIC ASMod_dmIntMnfDsRef_MAP "Referenz des Gasmassenstroms nach Einlasskrümmer" MAP 0x80047292 Kf_Xs16_Ys16_Ws16 1400.000 AirMassPerTime 0.00 1400.000 FORMAT "%8.3" EXTENDED_LIMITS -3276.800 3276.700
 /begin AXIS_DESCR STD_AXIS Epm_nEng EngN 8 0.00 6000.000 FORMAT "%8.3" EXTENDED_LIMITS -16384.00 16383.50 DEPOSIT ABSOLUTE /end AXIS_DESCR
 /begin AXIS_DESCR STD_AXIS ASMod_qBrn_mp InjMass 8 0.00 150.0000 FORMAT "%8.4" EXTENDED_LIMITS -327.6800 327.6700 DEPOSIT ABSOLUTE /end AXIS_DESCR
/end CHARACTERISTIC
/begin CHARACTERISTIC ASMod_dmNOxBas_MAP "Kennfeld für Basis-NOx-Massenstrom ohne ARF (betriebspunktabhängig)" MAP 0x80047336 Kf_Xs16_Ys16_Ws16 1000.000 NOxMassPerTime 0.00 1000.000 FORMAT "%8.3" EXTENDED_LIMITS -3276.800 3276.700
 /begin AXIS_DESCR STD_AXIS Epm_nEng EngN 8 0.00 6000.000 FORMAT "%8.3" EXTENDED_LIMITS -16384.00 16383.50 DEPOSIT ABSOLUTE /end AXIS_DESCR
 /begin AXIS_DESCR STD_AXIS ASMod_qBrn_mp InjMass 8 0.00 150.0000 FORMAT "%8.4" EXTENDED_LIMITS -327.6800 327.6700 DEPOSIT ABSOLUTE /end AXIS_DESCR
/end CHARACTERISTIC
/begin CHARACTERISTIC ASMod_dmNOxRatEGRCorBas_MAP "Kennfeld für betriebspunktabhängige ARF-Korrektur des NOx-Massenstorms" MAP 0x800473DA Kf_Xs16_Ys16_Ws16 1000.000 NOxMassPerTime 0.00 1000.000 FORMAT "%8.3" EXTENDED_LIMITS -3276.800 3276.700
 /begin AXIS_DESCR STD_AXIS Epm_nEng EngN 8 0.00 6000.000 FORMAT "%8.3" EXTENDED_LIMITS -16384.00 16383.50 DEPOSIT ABSOLUTE /end AXIS_DESCR
 /begin AXIS_DESCR STD_AXIS ASMod_qBrn_mp InjMass 8 0.00 150.0000 FORMAT "%8.4" EXTENDED_LIMITS -327.6800 327.6700 DEPOSIT ABSOLUTE /end AXIS_DESCR
/end CHARACTERISTIC
/begin CHARACTERISTIC ASMod_dmOilConsBas_MAP "Kennfeld für Basis-Ölverbrauch des Motors" MAP 0x8004747E Kf_Xs16_Ys16_Ws16 1.000000 OilMassPerTime 0.00 1.000000 FORMAT "%8.6" EXTENDED_LIMITS -3.276800 3.276700
 /begin AXIS_DESCR STD_AXIS Epm_nEng EngN 8 0.00 6000.000 FORMAT "%8.3" EXTENDED_LIMITS -16384.00 16383.50 DEPOSIT ABSOLUTE /end AXIS_DESCR
 /begin AXIS_DESCR STD_AXIS ASMod_qBrn_mp InjMass 8 0.00 150.0000 FORMAT "%8.4" EXTENDED_LIMITS -327.6800 327.6700 DEPOSIT ABSOLUTE /end AXIS_DESCR
/end CHARACTERISTIC
/begin CHARACTERISTIC ASMod_dmSotBas_MAP "Kennfeld für Basis-Rußmassenstrom ohne ARF (betriebspunktabhängig)" MAP 0x80047522 Kf_Xs16_Ys16_Ws16 327.6700 SotMassPerTime 0.00 327.6700 FORMAT "%8.4" EXTENDED_LIMITS -327.6800 327.6700
 /begin AXIS_DESCR STD_AXIS Epm_nEng EngN 8 0.00 6000.000 FORMAT "%8.3" EXTENDED_LIMITS -16384.00 16383.50 DEPOSIT ABSOLUTE /end AXIS_DESCR
 /begin AXIS_DESCR STD_AXIS ASMod_qBrn_mp InjMass 8 0.00 150.0000 FORMAT "%8.4" EXTENDED_LIMITS -327.6800 327.6700 DEPOSIT ABSOLUTE /end AXIS_DESCR
/end CHARACTERISTIC
/begin CHARACTERISTIC ASMod_dmSotLamCor_MAP "Kennfeld für Lambda-Korrekturmassenstrom des Rußmassenstroms" MAP 0x800475C6 Kf_Xs16_Ys16_Ws16 327.6700 SotMassPerTime 0.00 327.6700 FORMAT "%8.4" EXTENDED_LIMITS -327.6800 327.6700
 /begin AXIS_DESCR STD_AXIS ASMod_rLamRecDiffRef_mp lambdaRecVal 8 0.00 2.000000 FORMAT "%8.6" EXTENDED_LIMITS -32.76800 32.76700 DEPOSIT ABSOLUTE /end AXIS_DESCR
 /begin AXIS_DESCR STD_AXIS ASMod_rLamRecEGCrvIn_mp lambdaRecVal 8 0.00 2.000000 FORMAT "%8.6" EXTENDED_LIMITS -32.76800 32.76700 DEPOSIT ABSOLUTE /end AXIS_DESCR
/end CHARACTERISTIC
/begin CHARACTERISTIC ASMod_dmSotRatEGRCorBas_MAP "Kennfeld für betriebspunktabhängige ARF-Korrektur des Rußmassenstroms" MAP 0x8004766A Kf_Xs16_Ys16_Ws16 327.6700 SotMassPerTime 0.00 327.6700 FORMAT "%8.4" EXTENDED_LIMITS -327.6800 327.6700
 /begin AXIS_DESCR STD_AXIS Epm_nEng EngN 8 0.00 6000.000 FORMAT "%8.3" EXTENDED_LIMITS -16384.00 16383.50 DEPOSIT ABSOLUTE /end AXIS_DESCR
 /begin AXIS_DESCR STD_AXIS ASMod_qBrn_mp InjMass 8 0.00 150.0000 FORMAT "%8.4" EXTENDED_LIMITS -327.6800 327.6700 DEPOSIT ABSOLUTE /end AXIS_DESCR
/end CHARACTERISTIC
/begin CHARACTERISTIC ASMod_dmSOxEG_CUR "Kennlinie für Schwefeloxidmassentrom nach Verbrennung (aus Ölverbrauch)" CURVE 0x8004770E Kl_Xs16_Ws16 0.5000000 SOxMassPerTime 0.00 0.5000000 FORMAT "%9.7" EXTENDED_LIMITS -3.276800 3.276700
 /begin AXIS_DESCR STD_AXIS ASMod_dmOilConsCrvIn_mp OilMassPerTime 8 0.00 3.000000 FORMAT "%8.6" EXTENDED_LIMITS -3.276800 3.276700 DEPOSIT ABSOLUTE /end AXIS_DESCR
/end CHARACTERISTIC
/begin CHARACTERISTIC ASMod_etaEGRClg_MAP "Wirkungsgrad des ARF-Kühlers" MAP 0x80047230 Kf_Xs16_Ys16_Ws16 1.000000 Fact 0.00 1.000000 FORMAT "%8.6" EXTENDED_LIMITS -4.000000 3.999878
 /begin AXIS_DESCR STD_AXIS ASMod_dmEGRDs AirMassPerTime 6 0.00 500.0000 FORMAT "%8.4" EXTENDED_LIMITS -3276.800 3276.700 DEPOSIT ABSOLUTE /end AXIS_DESCR
 /begin AXIS_DESCR STD_AXIS ASMod_rRelPosECB Prc 3 0.00 100.0000 FORMAT "%8.4" EXTENDED_LIMITS -400.0000 399.9878 DEPOSIT ABSOLUTE /end AXIS_DESCR
/end CHARACTERISTIC
/begin CHARACTERISTIC ASMod_etaTrbCh_MAP "Kennfeld Gesamtwirkungsgrad Turbolader" MAP 0x8006FCA0 Kf_Xs16_Ys16_Ws16 0.9998779 Fact 0.0001220703 1.000000 FORMAT "%8.6" EXTENDED_LIMITS -4.000000 3.999878
 /begin AXIS_DESCR STD_AXIS AFS_dm AirMassPerTime 8 0.00 1000.000 FORMAT "%8.3" EXTENDED_LIMITS -3276.800 3276.700 DEPOSIT ABSOLUTE /end AXIS_DESCR
 /begin AXIS_DESCR STD_AXIS ASMod_rPresCmpr_mp Fact 8 0.00 8.000000 FORMAT "%8.6" EXTENDED_LIMITS -4.000000 3.999878 DEPOSIT ABSOLUTE /end AXIS_DESCR
/end CHARACTERISTIC
/begin CHARACTERISTIC ASMod_facCalValFl_C "Unterer Heizwert Kraftstoff" VALUE 0x80047EE6 Val_Wu16 50000.00 Calory 0.00 50000.00 FORMAT "%8.2" EXTENDED_LIMITS 0.00 65535.00 /end CHARACTERISTIC
/begin CHARACTERISTIC ASMod_facCndHtSlpSlw_C "Steigungswert für Wärmeleitfähigkeit" VALUE 0x800480DA Kw_Ws16 0.00002000000 Fact8 0.00006000000 0.00008000000 FORMAT "%13.11" EXTENDED_LIMITS -0.0003276800 0.0003276700 /end CHARACTERISTIC
/begin CHARACTERISTIC ASMod_facCndHtSlp_C "Steigungswert für Wärmeleitfähigkeit" VALUE 0x80048050 Kw_Ws16 0.00002000000 Fact8 0.00006000000 0.00008000000 FORMAT "%13.11" EXTENDED_LIMITS -0.0003276800 0.0003276700 /end CHARACTERISTIC
/begin CHARACTERISTIC ASMod_facDdT_C "Faktor zur Berechnung der Gaslaufzeit durch den Motor" VALUE 0x80047730 Kw_Ws16 7.000000 Fact1 1.000000 8.000000 FORMAT "%8.6" EXTENDED_LIMITS -256.0000 255.9922 /end CHARACTERISTIC
/begin CHARACTERISTIC ASMod_facEGTempMsFlwCor_CUR "Korrekturfaktor der Temperaturerhöhung aufgrund des aktuellen Gasmassenstroms nach Einlasskrümmer" CURVE 0x80047732 Kl_Xs16_Ws16 2.000000 Fact 0.00 2.000000 FORMAT "%8.6" EXTENDED_LIMITS -4.000000 3.999878
 /begin AXIS_DESCR STD_AXIS ASMod_rMsFlwRef_mp RatAirMass 8 -1.000000 1.000000 FORMAT "%8.6" EXTENDED_LIMITS -327.6800 327.6700 DEPOSIT ABSOLUTE /end AXIS_DESCR
/end CHARACTERISTIC
/begin CHARACTERISTIC ASMod_facEGTempSOICor_CUR "Korrekturfaktor der Temperaturerhöhung aufgrund des aktuellen Spritzbeginns" CURVE 0x80047754 Kl_Xs16_Ws16 2.000000 Fact 0.00 2.000000 FORMAT "%8.6" EXTENDED_LIMITS -4.000000 3.999878
 /begin AXIS_DESCR STD_AXIS ASMod_phiDiffSOIRef_mp AngleCrS 8 -19.99573 19.99573 FORMAT "%8.5" EXTENDED_LIMITS -720.0220 720.0000 DEPOSIT ABSOLUTE /end AXIS_DESCR
/end CHARACTERISTIC
/begin CHARACTERISTIC ASMod_facGeoEGPipe_CA "geometrischer Faktor zur Druckberechnung im Abgassystem" VAL_BLK 0x800479EC Kwb_Ws16 100.0000 Fact1 0.00 100.0000 FORMAT "%8.4" EXTENDED_LIMITS -256.0000 255.9922 NUMBER 4 /end CHARACTERISTIC
/begin CHARACTERISTIC ASMod_facHtTransNoLin_CUR "Faktor zur Berücksichtigung des nichtlinearen Wärmeübergangs" CURVE 0x80047FBA Kl_Xs16_Ws16 1.000000 Fact 0.00 1.000000 FORMAT "%8.6" EXTENDED_LIMITS -4.000000 3.999878
 /begin AXIS_DESCR STD_AXIS ASMod_tPFltDiffCorr_mp TempDiff_Kelv 8 500.0000 1000.000 FORMAT "%8.3" EXTENDED_LIMITS -3276.800 3276.700 DEPOSIT ABSOLUTE /end AXIS_DESCR
/end CHARACTERISTIC
/begin CHARACTERISTIC ASMod_facIntMnfDsTempCor_C "Korrekturfaktor zur Kompensation der Abhängigkeit des Luftaufwands von der Gastemperatur nach Einlasskrümmer" VALUE 0x800481D8 Kw_Ws16 2.000000 RatAirMass 0.00 2.000000 FORMAT "%8.6" EXTENDED_LIMITS -327.6800 327.6700 /end CHARACTERISTIC
/begin CHARACTERISTIC ASMod_facNOxRatEGRCor_CUR "Kennlinie für ARF-Korrekturfaktor des NOx-Massenstroms" CURVE 0x80047776 Kl_Xs16_Ws16 3.000000 Fact 0.00 3.000000 FORMAT "%8.6" EXTENDED_LIMITS -4.000000 3.999878
 /begin AXIS_DESCR STD_AXIS ASMod_rEGRCrvIn_mp RatAirMass 8 0.00 0.8000000 FORMAT "%9.7" EXTENDED_LIMITS -327.6800 327.6700 DEPOSIT ABSOLUTE /end AXIS_DESCR
/end CHARACTERISTIC
/begin CHARACTERISTIC ASMod_facOilConsLfTCor_CUR "Kennlinie für Motorlaufzeitkorrekturfaktor des Ölverbrauchs des Motors" CURVE 0x80047798 Kl_Xs16_Ws16 3.000000 Fact 0.00 3.000000 FORMAT "%8.6" EXTENDED_LIMITS -4.000000 3.999878
 /begin AXIS_DESCR STD_AXIS ASMod_tiEngOn_mp TimeHrsEngOn 8 0.00 6000.000 FORMAT "%8.3" EXTENDED_LIMITS -3276800. 3276700. DEPOSIT ABSOLUTE /end AXIS_DESCR
/end CHARACTERISTIC
/begin CHARACTERISTIC ASMod_facPFltBlwBy_C "Thermischer Austauschfaktor für Abgas im Partikelfilter" VALUE 0x80047FDC Kw_Ws16 1.000000 Fact 0.00 1.000000 FORMAT "%8.6" EXTENDED_LIMITS -4.000000 3.999878 /end CHARACTERISTIC
/begin CHARACTERISTIC ASMod_facPowEGPipe_CUR "Potenzfunktion für Druckberechnung im Abgassystem" CURVE 0x800479F4 Kl_Xs16_Ws16 250.0000 Fact1 0.00 250.0000 FORMAT "%8.4" EXTENDED_LIMITS -256.0000 255.9922 READ_ONLY
 /begin AXIS_DESCR STD_AXIS ASMod_dVolEGPipe1_mp AirVolPerTime 11 0.00 3200.000 FORMAT "%8.3" EXTENDED_LIMITS -3276.800 3276.700 DEPOSIT ABSOLUTE /end AXIS_DESCR
/end CHARACTERISTIC
/begin CHARACTERISTIC ASMod_facRhoEtaEGPipe_MAP "Temperaturabhängiger Dichte- und Viskositätsfaktor zur Druckberechnung im Abgassystem" MAP 0x80047A22 Kf_Xs16_Ys16_Ws16 5.000000 Fact 0.00 5.000000 FORMAT "%8.6" EXTENDED_LIMITS -4.000000 3.999878
 /begin AXIS_DESCR STD_AXIS ASMod_tEGFld_mp Temp_Cels 9 -40.04000 799.9600 FORMAT "%8.4" EXTENDED_LIMITS -3549.940 3003.560 DEPOSIT ABSOLUTE /end AXIS_DESCR
 /begin AXIS_DESCR STD_AXIS ASMod_pEGFld_mp Pres_hPa 2 1000.000 3500.000 FORMAT "%8.3" EXTENDED_LIMITS -32768.00 32767.00 DEPOSIT ABSOLUTE /end AXIS_DESCR
/end CHARACTERISTIC
/begin CHARACTERISTIC ASMod_facSotRatEGRCor_CUR "Kennlinie für ARF-Korrekturfaktor des Rußmassenstroms" CURVE 0x800477BA Kl_Xs16_Ws16 3.000000 Fact 0.00 3.000000 FORMAT "%8.6" EXTENDED_LIMITS -4.000000 3.999878
 /begin AXIS_DESCR STD_AXIS ASMod_rEGRCrvIn_mp RatAirMass 8 0.00 0.8000000 FORMAT "%9.7" EXTENDED_LIMITS -327.6800 327.6700 DEPOSIT ABSOLUTE /end AXIS_DESCR
/end CHARACTERISTIC
/begin CHARACTERISTIC ASMod_facSqr_CUR "Wurzelfunktion als Kennlinie" CURVE 0x8006FC6E Kl_Xs16_Ws16 1.000000 Fact 0.00 1.000000 FORMAT "%8.6" EXTENDED_LIMITS -4.000000 3.999878 READ_ONLY
 /begin AXIS_DESCR STD_AXIS ASMod_facArgSqr_mp Fact 10 0.00 1.000000 FORMAT "%8.6" EXTENDED_LIMITS -4.000000 3.999878 DEPOSIT ABSOLUTE /end AXIS_DESCR
/end CHARACTERISTIC
/begin CHARACTERISTIC ASMod_facTempClg_CUR "Abkühlkennlinie der abgasführenden Bauteile" CURVE 0x80048160 Kl_Xs16_Ws16 2.000000 Fact 0.00 2.000000 FORMAT "%8.6" EXTENDED_LIMITS -4.000000 3.999878
 /begin AXIS_DESCR STD_AXIS ASMod_rTime Fact1 8 0.00 8.000000 FORMAT "%8.6" EXTENDED_LIMITS -256.0000 255.9922 DEPOSIT ABSOLUTE /end AXIS_DESCR
/end CHARACTERISTIC
/begin CHARACTERISTIC ASMod_facTempCmb_CUR "Temperaturabhängiger Faktor zur Korrektur der im Oxidationskatalysator abreagierenden Kraftstoffmasse" CURVE 0x80047EE8 Cur_Xs16Ws16 1.000000 Fact 0.00 1.000000 FORMAT "%8.6" EXTENDED_LIMITS -4.000000 3.999878
 /begin AXIS_DESCR STD_AXIS ASMod_tAvrgOxiC_mp Temp_Cels 8 -3549.940 3003.560 FORMAT "%8.3" DEPOSIT ABSOLUTE /end AXIS_DESCR
/end CHARACTERISTIC
/begin CHARACTERISTIC ASMod_facTimeClg_CUR "Inverse Abkühlkennlinie Motor" CURVE 0x80048182 Kl_Xs16_Ws16 255.0000 Fact1 0.00 255.0000 FORMAT "%8.4" EXTENDED_LIMITS -256.0000 255.9922
 /begin AXIS_DESCR STD_AXIS ASMod_rTempClnt_mp Fact 8 0.00 1.000000 FORMAT "%8.6" EXTENDED_LIMITS -4.000000 3.999878 DEPOSIT ABSOLUTE /end AXIS_DESCR
/end CHARACTERISTIC
/begin CHARACTERISTIC ASMod_facVolEffBas_MAP "Basiswert für Luftaufwand des Motors" MAP 0x800481DA Kf_Xs16_Ys16_Ws16 1.000000 RatAirMass 0.00 1.000000 FORMAT "%8.6" EXTENDED_LIMITS -327.6800 327.6700
 /begin AXIS_DESCR STD_AXIS Epm_nEng EngN 10 0.00 6000.000 FORMAT "%8.3" EXTENDED_LIMITS -16384.00 16383.50 DEPOSIT ABSOLUTE /end AXIS_DESCR
 /begin AXIS_DESCR STD_AXIS InjCtl_qSetUnBal InjMass 10 0.00 327.6700 FORMAT "%8.4" EXTENDED_LIMITS -327.6800 327.6700 DEPOSIT ABSOLUTE /end AXIS_DESCR
/end CHARACTERISTIC
/begin CHARACTERISTIC ASMod_facVolEffVSACor_MAP "Korrekturfaktor für Luftaufwand als Funktion von Drehzahl und relativer Drallklappenposition" MAP 0x800482CE Kf_Xs16_Ys16_Ws16 2.000000 RatAirMass 0.00 2.000000 FORMAT "%8.6" EXTENDED_LIMITS -327.6800 327.6700
 /begin AXIS_DESCR STD_AXIS Epm_nEng EngN 10 0.00 6000.000 FORMAT "%8.3" EXTENDED_LIMITS -16384.00 16383.50 DEPOSIT ABSOLUTE /end AXIS_DESCR
 /begin AXIS_DESCR STD_AXIS ASMod_rRelPosVSA Prc 10 0.00 100.0000 FORMAT "%8.4" EXTENDED_LIMITS -400.0000 399.9878 DEPOSIT ABSOLUTE /end AXIS_DESCR
/end CHARACTERISTIC
/begin CHARACTERISTIC ASMod_facVscDynSlpSlw_C "Steigungswert für dynamische Viskosität" VALUE 0x800480DC Kw_Ws16 0.0001700000 Fact7 0.00003000000 0.0002000000 FORMAT "%12.10" EXTENDED_LIMITS -0.003276800 0.003276700 /end CHARACTERISTIC
/begin CHARACTERISTIC ASMod_facVscDynSlp_C "Steigungswert für dynamische Viskosität" VALUE 0x80048052 Kw_Ws16 0.0001700000 Fact7 0.00003000000 0.0002000000 FORMAT "%12.10" EXTENDED_LIMITS -0.003276800 0.003276700 /end CHARACTERISTIC
/begin CHARACTERISTIC ASMod_facVscKinSlpSlw_C "Steigungswert für kinematische Viskosität" VALUE 0x800480DE Kw_Ws16 0.0000001200000 Fact10 0.00000008000000 0.0000002000000 FORMAT "%15.13" EXTENDED_LIMITS -0.000003276800 0.000003276700 /end CHARACTERISTIC
/begin CHARACTERISTIC ASMod_facVscKinSlp_C "Steigungswert für kinematische Viskosität" VALUE 0x80048054 Kw_Ws16 0.0000001200000 Fact10 0.00000008000000 0.0000002000000 FORMAT "%15.13" EXTENDED_LIMITS -0.000003276800 0.000003276700 /end CHARACTERISTIC
/begin CHARACTERISTIC ASMod_htcFreeCnvtPipeSlw_CA "Wärmeübertragungskoeffizient aufgrund freier Konvektion" VAL_BLK 0x800480E0 Kwb_Ws16 999.9000 ThermalCoEff 0.1000000 1000.000 FORMAT "%8.3" EXTENDED_LIMITS -3276.800 3276.700 NUMBER 4 /end CHARACTERISTIC
/begin CHARACTERISTIC ASMod_htcFreeCnvtPipe_CA "Wärmeübertragungskoeffizient aufgrund freier Konvektion" VAL_BLK 0x80048056 Kwb_Ws16 999.9000 ThermalCoEff 0.1000000 1000.000 FORMAT "%8.3" EXTENDED_LIMITS -3276.800 3276.700 NUMBER 3 /end CHARACTERISTIC
/begin CHARACTERISTIC ASMod_lDiamPipeSlw_CA "Rohrdurchmesser" VAL_BLK 0x800480E8 Kwb_Ws16 0.09375000 Length1 0.007812500 0.1015625 FORMAT "%9.7" EXTENDED_LIMITS -256.0000 255.9922 NUMBER 4 /end CHARACTERISTIC
/begin CHARACTERISTIC ASMod_lDiamPipe_CA "Rohrdurchmesser" VAL_BLK 0x8004805C Kwb_Ws16 0.09375000 Length1 0.007812500 0.1015625 FORMAT "%9.7" EXTENDED_LIMITS -256.0000 255.9922 NUMBER 3 /end CHARACTERISTIC
/begin CHARACTERISTIC ASMod_lLngthPipeSlw_CA "Rohrlänge" VAL_BLK 0x800480F0 Kwb_Ws16 2.992188 Length1 0.007812500 3.000000 FORMAT "%8.6" EXTENDED_LIMITS -256.0000 255.9922 NUMBER 4 /end CHARACTERISTIC
/begin CHARACTERISTIC ASMod_lLngthPipe_CA "Rohrlänge" VAL_BLK 0x80048062 Kwb_Ws16 2.992188 Length1 0.007812500 3.000000 FORMAT "%8.6" EXTENDED_LIMITS -256.0000 255.9922 NUMBER 3 /end CHARACTERISTIC
/begin CHARACTERISTIC ASMod_nThresDwn_C "Drehzahlschwellwert zur Erkennung auf Motorstillstand" VALUE 0x800471B8 Kw_Ws16 6000.000 EngN 0.00 6000.000 FORMAT "%8.3" EXTENDED_LIMITS -16384.00 16383.50 /end CHARACTERISTIC
/begin CHARACTERISTIC ASMod_numAirTempStrt_C "Index zur Auswahl der gewünschten Lufttemperatur" VALUE 0x800481A4 Kw_Wu8 2.00000000000 AirTempFldSel 0.00 2.00000000000 FORMAT "%13.11" /end CHARACTERISTIC
/begin CHARACTERISTIC ASMod_numAirTempTrbn_C "Index zur Auswahl der Lufttemperatur" VALUE 0x8006FD44 Kw_Wu8 2.00000000000 AirTempFldSel 0.00 2.00000000000 FORMAT "%13.11" /end CHARACTERISTIC
/begin CHARACTERISTIC ASMod_numBnk_C "" VALUE 0x800471BA Kw_Wu8 2.000 OneToOne 0.00 2.000 FORMAT "%5.3" EXTENDED_LIMITS 0.00 255.0 /end CHARACTERISTIC
/begin CHARACTERISTIC ASMod_numEngTempStrt_C "Index zur Auswahl der gewünschten Motortemperatur" VALUE 0x800481A5 Kw_Wu8 2.00000000000 EngTempFldSel 0.00 2.00000000000 FORMAT "%13.11" /end CHARACTERISTIC
/begin CHARACTERISTIC ASMod_numEnvPres_C "" VALUE 0x800471BC Kw_Ws16 255.0000 OneToOne 0.00 255.0000 FORMAT "%8.4" EXTENDED_LIMITS -32768.00 32767.00 /end CHARACTERISTIC
/begin CHARACTERISTIC ASMod_numMixPntEGDs_C "Index zur Auswahl Rohrmodell nach Mischstelle" VALUE 0x800471BE Kw_Ws16 65535.00 OneToOne -32768.00 32767.00 FORMAT "%8.2" /end CHARACTERISTIC
/begin CHARACTERISTIC ASMod_numMixPntEGUs_C "Index zur Auswahl Rohrmodell vor Mischstelle" VALUE 0x800471C0 Kw_Ws16 65535.00 OneToOne -32768.00 32767.00 FORMAT "%8.2" /end CHARACTERISTIC
/begin CHARACTERISTIC ASMod_numNSCDs_C "Index zur Auswahl Rohrmodell nach NOx-Speicherkatalysator" VALUE 0x800471C2 Kw_Ws16 7.000000 OneToOne 0.00 7.000000 FORMAT "%8.6" EXTENDED_LIMITS -32768.00 32767.00 /end CHARACTERISTIC
/begin CHARACTERISTIC ASMod_numNSCUs_C "Index zur Auswahl Rohrmodell vor NOx-Speicherkatalysator" VALUE 0x800471C4 Kw_Ws16 7.000000 OneToOne 0.00 7.000000 FORMAT "%8.6" EXTENDED_LIMITS -32768.00 32767.00 /end CHARACTERISTIC
/begin CHARACTERISTIC ASMod_numOxiCDs_C "Index zur Auswahl Rohrmodell nach Oxidationskatalysator" VALUE 0x800471C6 Kw_Ws16 7.000000 OneToOne 0.00 7.000000 FORMAT "%8.6" EXTENDED_LIMITS -32768.00 32767.00 /end CHARACTERISTIC
/begin CHARACTERISTIC ASMod_numOxiCUs_C "Index zur Auswahl Rohrmodell vor Oxidationskatalysator" VALUE 0x800471C8 Kw_Ws16 7.000000 OneToOne 0.00 7.000000 FORMAT "%8.6" EXTENDED_LIMITS -32768.00 32767.00 /end CHARACTERISTIC
/begin CHARACTERISTIC ASMod_numPFltDs_C "Index zur Auswahl Rohrmodell nach Partikelfilter" VALUE 0x800471CA Kw_Ws16 7.000000 OneToOne 0.00 7.000000 FORMAT "%8.6" EXTENDED_LIMITS -32768.00 32767.00 /end CHARACTERISTIC
/begin CHARACTERISTIC ASMod_numPFltUs_C "Index zur Auswahl Rohrmodell vor Partikelfilter" VALUE 0x800471CC Kw_Ws16 7.000000 OneToOne 0.00 7.000000 FORMAT "%8.6" EXTENDED_LIMITS -32768.00 32767.00 /end CHARACTERISTIC
/begin CHARACTERISTIC ASMod_numTrbnDs_C "Index zur Auswahl Rohrmodell nach Turbolader" VALUE 0x800471CE Kw_Ws16 6.000000 OneToOne 0.00 6.000000 FORMAT "%8.6" EXTENDED_LIMITS -32768.00 32767.00 /end CHARACTERISTIC
/begin CHARACTERISTIC ASMod_numTrbn_C "Index zur Auswahl Rohrmodell für Turboladertemperaturmodell" VALUE 0x800471D0 Kw_Ws16 14.00000 OneToOne 0.00 14.00000 FORMAT "%8.5" EXTENDED_LIMITS -32768.00 32767.00 /end CHARACTERISTIC
/begin CHARACTERISTIC ASMod_nuPipeEnvSlw_CUR "Nusseltzahl zwischen Rohrwand und Umgebung" CURVE 0x800480F8 Kl_Xs16_Ws16 5309.000 OneToOne 0.00 5309.000 FORMAT "%8.3" EXTENDED_LIMITS -32768.00 32767.00
 /begin AXIS_DESCR STD_AXIS ASMod_rePipeEnvSlw1_mp ReynoldsNum1 8 0.00 3750000. FORMAT "%8.0" EXTENDED_LIMITS -32768000. 32767000. DEPOSIT ABSOLUTE /end AXIS_DESCR
/end CHARACTERISTIC
/begin CHARACTERISTIC ASMod_nuPipeEnv_CUR "Nusseltzahl zwischen Rohrwand und Umgebung" CURVE 0x80048068 Kl_Xs16_Ws16 5309.000 OneToOne 0.00 5309.000 FORMAT "%8.3" EXTENDED_LIMITS -32768.00 32767.00
 /begin AXIS_DESCR STD_AXIS ASMod_rePipeEnv1_mp ReynoldsNum1 8 0.00 3750000. FORMAT "%8.0" EXTENDED_LIMITS -32768000. 32767000. DEPOSIT ABSOLUTE /end AXIS_DESCR
/end CHARACTERISTIC
/begin CHARACTERISTIC ASMod_nuPipeSlw_CUR "Nusseltzahl zwischen im Rohr" CURVE 0x8004811A Kl_Xs16_Ws16 1130.000 OneToOne 0.00 1130.000 FORMAT "%8.3" EXTENDED_LIMITS -32768.00 32767.00
 /begin AXIS_DESCR STD_AXIS ASMod_rePipeSlw1_mp ReynoldsNum 8 0.00 800000.0 FORMAT "%8.1" EXTENDED_LIMITS -3276800. 3276700. DEPOSIT ABSOLUTE /end AXIS_DESCR
/end CHARACTERISTIC
/begin CHARACTERISTIC ASMod_nuPipe_CUR "Nusseltzahl zwischen im Rohr" CURVE 0x8004808A Kl_Xs16_Ws16 1130.000 OneToOne 0.00 1130.000 FORMAT "%8.3" EXTENDED_LIMITS -32768.00 32767.00
 /begin AXIS_DESCR STD_AXIS ASMod_rePipe1_mp ReynoldsNum 8 0.00 800000.0 FORMAT "%8.1" EXTENDED_LIMITS -3276800. 3276700. DEPOSIT ABSOLUTE /end AXIS_DESCR
/end CHARACTERISTIC
/begin CHARACTERISTIC ASMod_pDiffPipe0_MAP "Kennfeld für Abgasgegendruck" MAP 0x80047A60 Kf_Xs16_Ys16_Ws16 3500.0000 Pres_hPa 0.00 3500.0000 FORMAT "%8.4" EXTENDED_LIMITS -32768.00 32767.00
 /begin AXIS_DESCR STD_AXIS Epm_nEng EngN 10 800.0000 4000.000 FORMAT "%8.3" EXTENDED_LIMITS -16384.00 16383.50 DEPOSIT ABSOLUTE /end AXIS_DESCR
 /begin AXIS_DESCR STD_AXIS InjCtl_qSetUnBal InjMass 10 0.00 50.00000 FORMAT "%8.5" EXTENDED_LIMITS -327.6800 327.6700 DEPOSIT ABSOLUTE /end AXIS_DESCR
/end CHARACTERISTIC
/begin CHARACTERISTIC ASMod_pDiffPipe1_MAP "Kennfeld für Abgasgegendruck" MAP 0x80047B54 Kf_Xs16_Ys16_Ws16 3500.0000 Pres_hPa 0.00 3500.0000 FORMAT "%8.4" EXTENDED_LIMITS -32768.00 32767.00
 /begin AXIS_DESCR STD_AXIS Epm_nEng EngN 10 800.0000 4000.000 FORMAT "%8.3" EXTENDED_LIMITS -16384.00 16383.50 DEPOSIT ABSOLUTE /end AXIS_DESCR
 /begin AXIS_DESCR STD_AXIS InjCtl_qSetUnBal InjMass 10 0.00 50.00000 FORMAT "%8.5" EXTENDED_LIMITS -327.6800 327.6700 DEPOSIT ABSOLUTE /end AXIS_DESCR
/end CHARACTERISTIC
/begin CHARACTERISTIC ASMod_pDiffPipe2_MAP "Kennfeld für Abgasgegendruck" MAP 0x80047C48 Kf_Xs16_Ys16_Ws16 3500.0000 Pres_hPa 0.00 3500.0000 FORMAT "%8.4" EXTENDED_LIMITS -32768.00 32767.00
 /begin AXIS_DESCR STD_AXIS Epm_nEng EngN 10 800.0000 4000.000 FORMAT "%8.3" EXTENDED_LIMITS -16384.00 16383.50 DEPOSIT ABSOLUTE /end AXIS_DESCR
 /begin AXIS_DESCR STD_AXIS InjCtl_qSetUnBal InjMass 10 0.00 50.00000 FORMAT "%8.5" EXTENDED_LIMITS -327.6800 327.6700 DEPOSIT ABSOLUTE /end AXIS_DESCR
/end CHARACTERISTIC
/begin CHARACTERISTIC ASMod_pDiffPipe3_MAP "Kennfeld für Abgasgegendruck" MAP 0x80047D3C Kf_Xs16_Ys16_Ws16 3500.0000 Pres_hPa 0.00 3500.0000 FORMAT "%8.4" EXTENDED_LIMITS -32768.00 32767.00
 /begin AXIS_DESCR STD_AXIS Epm_nEng EngN 10 800.0000 4000.000 FORMAT "%8.3" EXTENDED_LIMITS -16384.00 16383.50 DEPOSIT ABSOLUTE /end AXIS_DESCR
 /begin AXIS_DESCR STD_AXIS InjCtl_qSetUnBal InjMass 10 0.00 50.00000 FORMAT "%8.5" EXTENDED_LIMITS -327.6800 327.6700 DEPOSIT ABSOLUTE /end AXIS_DESCR
/end CHARACTERISTIC
/begin CHARACTERISTIC ASMod_phiSOIRef_MAP "Referenzkennfeld für Spritzbeginn der MI1" MAP 0x800477DC Kf_Xs16_Ys16_Ws16 59.98718 AngleCrS -19.99573 39.99145 FORMAT "%8.5" EXTENDED_LIMITS -720.0220 720.0000
 /begin AXIS_DESCR STD_AXIS Epm_nEng EngN 8 0.00 6000.000 FORMAT "%8.3" EXTENDED_LIMITS -16384.00 16383.50 DEPOSIT ABSOLUTE /end AXIS_DESCR
 /begin AXIS_DESCR STD_AXIS ASMod_qBrn_mp InjMass 8 0.00 150.0000 FORMAT "%8.4" EXTENDED_LIMITS -327.6800 327.6700 DEPOSIT ABSOLUTE /end AXIS_DESCR
/end CHARACTERISTIC
/begin CHARACTERISTIC ASMod_pInit_C "" VALUE 0x800471D2 Kw_Ws16 2600.000 Pres_hPa 900.0000 3500.000 FORMAT "%8.3" EXTENDED_LIMITS -32768.00 32767.00 /end CHARACTERISTIC
/begin CHARACTERISTIC ASMod_rArPipeSlw_CA "Anteil der vom Fahrtwind beaufschlagten Rohroberfläche" VAL_BLK 0x8004813C Kwb_Ws16 1.000000 Fact 0.00 1.000000 FORMAT "%8.6" EXTENDED_LIMITS -4.000000 3.999878 NUMBER 4 /end CHARACTERISTIC
/begin CHARACTERISTIC ASMod_rArPipe_CA "Anteil der vom Fahrtwind beaufschlagten Rohroberfläche" VAL_BLK 0x800480AC Kwb_Ws16 1.000000 Fact 0.00 1.000000 FORMAT "%8.6" EXTENDED_LIMITS -4.000000 3.999878 NUMBER 3 /end CHARACTERISTIC
/begin CHARACTERISTIC ASMod_rECBLin_CUR "Linearisierungskennlinie für den ARF-Kühler-Bypass-Steller" CURVE 0x800471D4 Kl_Xs16_Ws16 100.0000 Prc 0.00 100.0000 FORMAT "%8.4" EXTENDED_LIMITS -400.0000 399.9878
 /begin AXIS_DESCR STD_AXIS ASMod_rECBLinCrvIn_mp Prc 6 0.00 100.0000 FORMAT "%8.4" EXTENDED_LIMITS -400.0000 399.9878 DEPOSIT ABSOLUTE /end AXIS_DESCR
/end CHARACTERISTIC
/begin CHARACTERISTIC ASMod_rLamRecRef_MAP "Kennfeld für rekursiven Lambda-Referenzwert zur Rußmassenstromkorrektur (betriebspunktabhängig)" MAP 0x80047880 Kf_Xs16_Ys16_Ws16 2.000000 lambdaRecVal 0.00 2.000000 FORMAT "%8.6" EXTENDED_LIMITS -32.76800 32.76700
 /begin AXIS_DESCR STD_AXIS Epm_nEng EngN 8 0.00 6000.000 FORMAT "%8.3" EXTENDED_LIMITS -16384.00 16383.50 DEPOSIT ABSOLUTE /end AXIS_DESCR
 /begin AXIS_DESCR STD_AXIS ASMod_qBrn_mp InjMass 8 0.00 150.0000 FORMAT "%8.4" EXTENDED_LIMITS -327.6800 327.6700 DEPOSIT ABSOLUTE /end AXIS_DESCR
/end CHARACTERISTIC
/begin CHARACTERISTIC ASMod_rTempAdbt_CUR "Kennlinie für die adiabatische Zustandsänderung der Temperatur" CURVE 0x8006FD46 Kl_Xs16_Ws16 0.4000244 Fact 1.000000 1.400024 FORMAT "%8.6" EXTENDED_LIMITS -4.000000 3.999878 READ_ONLY
 /begin AXIS_DESCR STD_AXIS ASMod_rPresCmpr_mp Fact 8 1.000000 8.000000 FORMAT "%8.6" EXTENDED_LIMITS -4.000000 3.999878 DEPOSIT ABSOLUTE /end AXIS_DESCR
/end CHARACTERISTIC
/begin CHARACTERISTIC ASMod_rTVALin_CUR "Linearisierungskennlinie für den Regelklappensteller" CURVE 0x800471EE Kl_Xs16_Ws16 100.0000 Prc 0.00 100.0000 FORMAT "%8.4" EXTENDED_LIMITS -400.0000 399.9878
 /begin AXIS_DESCR STD_AXIS ASMod_rTVALinCrvIn_mp DtyCyc 6 0.00 100.0000 FORMAT "%8.4" EXTENDED_LIMITS -327.6800 327.6700 DEPOSIT ABSOLUTE /end AXIS_DESCR
/end CHARACTERISTIC
/begin CHARACTERISTIC ASMod_rVSALin_CUR "Linearisierungskennlinie für den Drallklappensteller" CURVE 0x80047208 Kl_Xs16_Ws16 100.0000 Prc 0.00 100.0000 FORMAT "%8.4" EXTENDED_LIMITS -400.0000 399.9878
 /begin AXIS_DESCR STD_AXIS ASMod_rVSALinCrvIn_mp Prc 6 0.00 100.0000 FORMAT "%8.4" EXTENDED_LIMITS -400.0000 399.9878 DEPOSIT ABSOLUTE /end AXIS_DESCR
/end CHARACTERISTIC
/begin CHARACTERISTIC ASMod_swtPFltTempModOff_C "Schalter zur Abschaltung des Partikelfilter-Temperaturmodells" VALUE 0x80047FDE Kw_Ws16 1.000000 OneToOne 0.00 1.000000 FORMAT "%8.6" EXTENDED_LIMITS -32768.00 32767.00 /end CHARACTERISTIC
/begin CHARACTERISTIC ASMod_swtPresCalc_C "Auswahlschalter für Druckberechnung im Abgassystem (Kennfeldmodell oder Simulation)" VAL_BLK 0x80047E30 Kwb_Wu8 1.000 OneToOne 0.00 1.000 FORMAT "%5.3" EXTENDED_LIMITS 0.00 255.0 NUMBER 4 /end CHARACTERISTIC
/begin CHARACTERISTIC ASMod_swtPresMidPFlt_C "Schalter für Berechnung des Drucks im Partikelfilter" VALUE 0x80047FE0 Kw_Ws16 2.000000 OneToOne 0.00 2.000000 FORMAT "%8.6" EXTENDED_LIMITS -32768.00 32767.00 /end CHARACTERISTIC
/begin CHARACTERISTIC ASMod_swtTimeNSC_C "Schalter zur Verwendung fester oder variabler Zeitkonstante" VALUE 0x80047E36 Kw_Ws16 1.000000 OneToOne 0.00 1.000000 FORMAT "%8.6" EXTENDED_LIMITS -32768.00 32767.00 /end CHARACTERISTIC
/begin CHARACTERISTIC ASMod_swtTimeOxiC_C "Schalter zur Verwendung fester oder variabler Zeitkonstante für Oxidationskatalysator" VALUE 0x80047F0A Val_Wu8 1.000 OneToOne 0.00 1.000 FORMAT "%5.3" EXTENDED_LIMITS 0.00 255.0 /end CHARACTERISTIC
/begin CHARACTERISTIC ASMod_tDiffEngBas_MAP "Grundkennfeld der Temperaturerhöhung durch Verbrennung" MAP 0x80047924 Kf_Xs16_Ys16_Ws16 1200.000 TempDiff_Kelv -600.0000 600.0000 FORMAT "%8.4" EXTENDED_LIMITS -3276.800 3276.700
 /begin AXIS_DESCR STD_AXIS Epm_nEng EngN 8 0.00 6000.000 FORMAT "%8.3" EXTENDED_LIMITS -16384.00 16383.50 DEPOSIT ABSOLUTE /end AXIS_DESCR
 /begin AXIS_DESCR STD_AXIS ASMod_qBrn_mp InjMass 8 0.00 150.0000 FORMAT "%8.4" EXTENDED_LIMITS -327.6800 327.6700 DEPOSIT ABSOLUTE /end AXIS_DESCR
/end CHARACTERISTIC
/begin CHARACTERISTIC ASMod_tEGEngTempCor_CUR "Korrektur der Temperaturerhöhung aufgrund der Motortemperatur" CURVE 0x800479C8 Kl_Xs16_Ws16 1200.000 TempDiff_Kelv -600.0000 600.0000 FORMAT "%8.4" EXTENDED_LIMITS -3276.800 3276.700
 /begin AXIS_DESCR STD_AXIS ASMod_tDiffEngRef_mp TempDiff_Kelv 8 -80.00000 120.0000 FORMAT "%8.4" EXTENDED_LIMITS -3276.800 3276.700 DEPOSIT ABSOLUTE /end AXIS_DESCR
/end CHARACTERISTIC
/begin CHARACTERISTIC ASMod_tEGRDsMin_C "untere Begrenzung der Temperatur des rückgeführten Abgases nach ARF-Kühler" VALUE 0x8004726A Kw_Ws16 1100.000 Temp_Cels -50.04000 1049.960 FORMAT "%8.3" EXTENDED_LIMITS -3549.940 3003.560 /end CHARACTERISTIC
/begin CHARACTERISTIC ASMod_TempPFltDT1.T1_C "Parameter für DT1-Glied im Partikelfiltertemperaturmodell/" VALUE 0x80047FE4 Kw_Ws32 15.016368168 TimeDelay_s 0.0010000000689 15.017368168 FORMAT "%12.9" EXTENDED_LIMITS 0.000002000000001 4294.9672960 /end CHARACTERISTIC
/begin CHARACTERISTIC ASMod_TempPFltDT1.Kd_C "Parameter für DT1-Glied im Partikelfiltertemperaturmodell/" VALUE 0x80047FE8 Kw_Ws32 100.000000000 Kd -50.0000000000 50.0000000000 FORMAT "%13.10" EXTENDED_LIMITS -32768.0000000 32767.9999847 /end CHARACTERISTIC
/begin CHARACTERISTIC ASMod_TempPFltI.Ki_C "Parameter für I-Glied im Partikelfiltertemperaturmodell/" VALUE 0x80047FEC Kw_Ws32 244140.624943 Ki_Ampc2Prc -122070.312500 122070.312443 FORMAT "%13.6" /end CHARACTERISTIC
/begin CHARACTERISTIC ASMod_TempPFltI.KiPos_C "Parameter für I-Glied im Partikelfiltertemperaturmodell/" VALUE 0x80047FF0 Kw_Ws32 4.99898078488 Ki_Ampc2Prc 0.00102318153949 5.00000396642 FORMAT "%13.11" EXTENDED_LIMITS -122070.312500 122070.312443 /end CHARACTERISTIC
/begin CHARACTERISTIC ASMod_TempPFltI.KiNeg_C "Parameter für I-Glied im Partikelfiltertemperaturmodell/" VALUE 0x80047FF4 Kw_Ws32 4.99898078488 Ki_Ampc2Prc 0.00102318153949 5.00000396642 FORMAT "%13.11" EXTENDED_LIMITS -122070.312500 122070.312443 /end CHARACTERISTIC
/begin CHARACTERISTIC ASMod_TempPFltI.WinPos_C "Parameter für I-Glied im Partikelfiltertemperaturmodell/" VALUE 0x80047FF8 Kw_Ws32 65534.0000000 AirMassPerCyl -32767.0000000 32767.0000000 FORMAT "%13.7" EXTENDED_LIMITS -214748364.800 214748364.700 /end CHARACTERISTIC
/begin CHARACTERISTIC ASMod_TempPFltI.WinNeg_C "Parameter für I-Glied im Partikelfiltertemperaturmodell/" VALUE 0x80047FFC Kw_Ws32 65534.0000000 AirMassPerCyl -32767.0000000 32767.0000000 FORMAT "%13.7" EXTENDED_LIMITS -214748364.800 214748364.700 /end CHARACTERISTIC
/begin CHARACTERISTIC ASMod_TempPipeI.Ki_C "Parameter für I-Glied im Temperaturmodell für Rohrstücke/" VALUE 0x800480B4 Kw_Ws32 4.00003045797 Ki_Kelv_Sec 0.00 4.00003045797 FORMAT "%13.11" EXTENDED_LIMITS -10000000.0000 9999999.99534 /end CHARACTERISTIC
/begin CHARACTERISTIC ASMod_TempPipeI.KiPos_C "Parameter für I-Glied im Temperaturmodell für Rohrstücke/" VALUE 0x800480B8 Kw_Ws32 4.00003045797 Ki_Kelv_Sec 0.00 4.00003045797 FORMAT "%13.11" EXTENDED_LIMITS -10000000.0000 9999999.99534 /end CHARACTERISTIC
/begin CHARACTERISTIC ASMod_TempPipeI.KiNeg_C "Parameter für I-Glied im Temperaturmodell für Rohrstücke/" VALUE 0x800480BC Kw_Ws32 4.00003045797 Ki_Kelv_Sec 0.00 4.00003045797 FORMAT "%13.11" EXTENDED_LIMITS -10000000.0000 9999999.99534 /end CHARACTERISTIC
/begin CHARACTERISTIC ASMod_TempPipeI.WinPos_C "Parameter für I-Glied im Temperaturmodell für Rohrstücke/" VALUE 0x800480C0 Kw_Ws32 4294967295.00 OneToOne -2147483648.00 2147483647.00 FORMAT "%13.2" READ_ONLY /end CHARACTERISTIC
/begin CHARACTERISTIC ASMod_TempPipeI.WinNeg_C "Parameter für I-Glied im Temperaturmodell für Rohrstücke/" VALUE 0x800480C4 Kw_Ws32 4294967295.00 OneToOne -2147483648.00 2147483647.00 FORMAT "%13.2" READ_ONLY /end CHARACTERISTIC
/begin CHARACTERISTIC ASMod_TempPipeSlwI.Ki_C "Parameter für I-Glied im Temperaturmodell für Rohrstücke/" VALUE 0x80048144 Kw_Ws32 4.00003045797 Ki_Kelv_Sec 0.00 4.00003045797 FORMAT "%13.11" EXTENDED_LIMITS -10000000.0000 9999999.99534 /end CHARACTERISTIC
/begin CHARACTERISTIC ASMod_TempPipeSlwI.KiPos_C "Parameter für I-Glied im Temperaturmodell für Rohrstücke/" VALUE 0x80048148 Kw_Ws32 4.00003045797 Ki_Kelv_Sec 0.00 4.00003045797 FORMAT "%13.11" EXTENDED_LIMITS -10000000.0000 9999999.99534 /end CHARACTERISTIC
/begin CHARACTERISTIC ASMod_TempPipeSlwI.KiNeg_C "Parameter für I-Glied im Temperaturmodell für Rohrstücke/" VALUE 0x8004814C Kw_Ws32 4.00003045797 Ki_Kelv_Sec 0.00 4.00003045797 FORMAT "%13.11" EXTENDED_LIMITS -10000000.0000 9999999.99534 /end CHARACTERISTIC
/begin CHARACTERISTIC ASMod_TempPipeSlwI.WinPos_C "Parameter für I-Glied im Temperaturmodell für Rohrstücke/" VALUE 0x80048150 Kw_Ws32 4294967295.00 OneToOne -2147483648.00 2147483647.00 FORMAT "%13.2" READ_ONLY /end CHARACTERISTIC
/begin CHARACTERISTIC ASMod_TempPipeSlwI.WinNeg_C "Parameter für I-Glied im Temperaturmodell für Rohrstücke/" VALUE 0x80048154 Kw_Ws32 4294967295.00 OneToOne -2147483648.00 2147483647.00 FORMAT "%13.2" READ_ONLY /end CHARACTERISTIC
/begin CHARACTERISTIC ASMod_tEngRef_C "Referenz der Motoretemperatur" VALUE 0x800479EA Kw_Ws16 250.0000 Temp_Cels -50.04000 199.9600 FORMAT "%8.4" EXTENDED_LIMITS -3549.940 3003.560 /end CHARACTERISTIC
/begin CHARACTERISTIC ASMod_tiClgOfs_C "Korrektur der Abkühlzeit wg. Stauwärmeeffekten" VALUE 0x800481A8 Kw_Ws32 40000000.0000 Time_s 0.00 40000000.0000 FORMAT "%13.4" EXTENDED_LIMITS -21474836.4800 21474836.4700 /end CHARACTERISTIC
/begin CHARACTERISTIC ASMod_tiExhGsDelPFlt_CUR "Wärmeübertragungszeit" CURVE 0x80048000 Kl_Xs16_Ws16 15.00000 Time_s 0.00 15.00000 FORMAT "%8.5" EXTENDED_LIMITS -327.6800 327.6700
 /begin AXIS_DESCR STD_AXIS ASMod_dmPFltUsCrvIn_mp AirMassPerTime 8 -1000.000 1000.000 FORMAT "%8.3" EXTENDED_LIMITS -3276.800 3276.700 DEPOSIT ABSOLUTE /end AXIS_DESCR
/end CHARACTERISTIC
/begin CHARACTERISTIC ASMod_tiHaValClnt_C "Abkühl-Halbwertszeit des Motors" VALUE 0x800481AC Kw_Ws32 40000000.0000 Time_s 0.00 40000000.0000 FORMAT "%13.4" EXTENDED_LIMITS -21474836.4800 21474836.4700 /end CHARACTERISTIC
/begin CHARACTERISTIC ASMod_tiHaValNSC_C "Abkühl-Halbwertszeit des NSC" VALUE 0x800481B0 Kw_Ws32 40000000.0000 Time_s 0.00 40000000.0000 FORMAT "%13.4" EXTENDED_LIMITS -21474836.4800 21474836.4700 /end CHARACTERISTIC
/begin CHARACTERISTIC ASMod_tiHaValOxiC_C "Abkühl-Halbwertszeit des OxiC" VALUE 0x800481B4 Kw_Ws32 40000000.0000 Time_s 0.00 40000000.0000 FORMAT "%13.4" EXTENDED_LIMITS -21474836.4800 21474836.4700 /end CHARACTERISTIC
/begin CHARACTERISTIC ASMod_tiHaValPipe_CA "Abkühl-Halbwertszeit der Abgasrohre" VAL_BLK 0x800481B8 Kwb_Ws32 40000000.0000 Time_s 0.00 40000000.0000 FORMAT "%13.4" EXTENDED_LIMITS -21474836.4800 21474836.4700 NUMBER 7 /end CHARACTERISTIC
/begin CHARACTERISTIC ASMod_tiHtTransDT1_CUR "Filter-Zeitkonstante entsprechend Temperatursensor vor PFlt" CURVE 0x80048022 Kl_Xs16_Ws16 15.00000 Time_s 0.00 15.00000 FORMAT "%8.5" EXTENDED_LIMITS -327.6800 327.6700
 /begin AXIS_DESCR STD_AXIS ASMod_dmPFltUsCrvIn_mp AirMassPerTime 8 -1000.000 1000.000 FORMAT "%8.3" EXTENDED_LIMITS -3276.800 3276.700 DEPOSIT ABSOLUTE /end AXIS_DESCR
/end CHARACTERISTIC
/begin CHARACTERISTIC ASMod_tiMsFlwIndVolPT1_C "Zeitkonstante des PT1-Glieds in der Funktion Einlaßvolumen (induction volume)" VALUE 0x8006FC98 Kw_Ws32 4.9499617265 TimeDelay_s 0.050000201353 4.9999619278 FORMAT "%12.10" EXTENDED_LIMITS 0.000002000000001 4294.9672960 /end CHARACTERISTIC
/begin CHARACTERISTIC ASMod_tInit_C "" VALUE 0x80047222 Kw_Ws16 120.0000 Temp_Cels -30.04000 89.96000 FORMAT "%8.5" EXTENDED_LIMITS -3549.940 3003.560 /end CHARACTERISTIC
/begin CHARACTERISTIC ASMod_tiNSCPT1_C "feste Zeitkonstante PT1 für NSC" VALUE 0x80047E38 Kw_Ws32 4294.9662960 TimeDelay_s 0.0010000000689 4294.9672960 FORMAT "%12.7" EXTENDED_LIMITS 0.000002000000001 4294.9672960 /end CHARACTERISTIC
/begin CHARACTERISTIC ASMod_tIntMnfDsRef_MAP "Referenz der Gastemperatur nach Einlasskrümmer" MAP 0x800483C2 Kf_Xs16_Ys16_Ws16 150.0000 Temp_Cels -50.04000 99.96000 FORMAT "%8.4" EXTENDED_LIMITS -3549.940 3003.560
 /begin AXIS_DESCR STD_AXIS Epm_nEng EngN 10 0.00 6000.000 FORMAT "%8.3" EXTENDED_LIMITS -16384.00 16383.50 DEPOSIT ABSOLUTE /end AXIS_DESCR
 /begin AXIS_DESCR STD_AXIS ASMod_qSetUnBalCrvIn_mp InjMass 10 0.00 327.6700 FORMAT "%8.4" EXTENDED_LIMITS -327.6800 327.6700 DEPOSIT ABSOLUTE /end AXIS_DESCR
/end CHARACTERISTIC
/begin CHARACTERISTIC ASMod_tiOxiCPT1_C "Feste Zeitkonstante Oxidationskatalysator" VALUE 0x80047F0C Val_Ws32 4294.9662960 TimeDelay_s 0.0010000000689 4294.9672960 FORMAT "%12.7" EXTENDED_LIMITS 0.000002000000001 4294.9672960 /end CHARACTERISTIC
/begin CHARACTERISTIC ASMod_tiPFltPT1_C "Filterzeitkonstante für Oberflächentemperatursimulation" VALUE 0x80048044 Val_Ws32 15.016368168 TimeDelay_s 0.0010000000689 15.017368168 FORMAT "%12.9" EXTENDED_LIMITS 0.000002000000001 4294.9672960 /end CHARACTERISTIC
/begin CHARACTERISTIC ASMod_tiRelPosECBPT1_C "Zeitkonstante der PT1-Filterung bei Positionsänderung des Stellers für den ARF-Kühler-Bypass" VALUE 0x80047224 Kw_Ws32 0.98999239186 TimeDelay_s 0.0099999937043 0.99999238556 FORMAT "%12.10" EXTENDED_LIMITS 0.000002000000001 4294.9672960 /end CHARACTERISTIC
/begin CHARACTERISTIC ASMod_tiRelPosTVAPT1_C "Zeitkonstante der PT1-Filterung bei Positionsänderung des Drosselklappestellers" VALUE 0x80047228 Kw_Ws32 0.99899238550 TimeDelay_s 0.0010000000689 0.99999238556 FORMAT "%12.10" EXTENDED_LIMITS 0.000002000000001 4294.9672960 /end CHARACTERISTIC
/begin CHARACTERISTIC ASMod_tiRelPosVSAPT1_C "Zeitkonstante der PT1-Filterung bei Positionsänderung des Drallklappenstellers" VALUE 0x8004722C Kw_Ws32 0.98999239186 TimeDelay_s 0.0099999937043 0.99999238556 FORMAT "%12.10" EXTENDED_LIMITS 0.000002000000001 4294.9672960 /end CHARACTERISTIC
/begin CHARACTERISTIC ASMod_tiTempEGRDsPT1_C "Zeitkonstante zur Tiefpaßfilterung der Temperatur nach ARF-Kühler" VALUE 0x8004726C Kw_Ws32 0.98999239186 TimeDelay_s 0.0099999937043 0.99999238556 FORMAT "%12.10" EXTENDED_LIMITS 0.000002000000001 4294.9672960 /end CHARACTERISTIC
/begin CHARACTERISTIC ASMod_tiTrbnPT1_C "Feste Zeitkonstante PT1-Filter" VALUE 0x8006FD68 Kw_Ws32 4294.9662960 TimeDelay_s 0.0010000000689 4294.9672960 FORMAT "%12.7" EXTENDED_LIMITS 0.000002000000001 4294.9672960 /end CHARACTERISTIC
/begin CHARACTERISTIC ASMod_tNSCDfl_C "Ersatzwert für NSC-Temperatur" VALUE 0x80047E3C Kw_Ws16 1095.000 Temp_Cels -45.04000 1049.960 FORMAT "%8.3" EXTENDED_LIMITS -3549.940 3003.560 /end CHARACTERISTIC
/begin CHARACTERISTIC ASMod_tNSCExoIncr_MAP "Kennfeld für Temperaturerhöhung im NSC aufgrund chemischer Reaktionen" MAP 0x80047E3E Kf_Xs16_Ys16_Ws16 1000.000 TempDiff_Kelv -500.0000 500.0000 FORMAT "%8.4" EXTENDED_LIMITS -3276.800 3276.700
 /begin AXIS_DESCR STD_AXIS ASMod_tAvrgNSC_mp Temp_Cels 8 -3549.940 3003.560 FORMAT "%8.3" DEPOSIT ABSOLUTE /end AXIS_DESCR
 /begin AXIS_DESCR STD_AXIS ASMod_rLamRecExhMnfDs lambdaRecVal 8 -30.00000 30.00000 FORMAT "%8.5" EXTENDED_LIMITS -32.76800 32.76700 DEPOSIT ABSOLUTE /end AXIS_DESCR
/end CHARACTERISTIC
/begin CHARACTERISTIC ASMod_tOxiCDfl_C "Ersatzwert Temperatur des Oxidationskatalysators" VALUE 0x80047F10 Val_Ws16 1030.000 Temp_Cels -30.04000 999.9600 FORMAT "%8.3" EXTENDED_LIMITS -3549.940 3003.560 /end CHARACTERISTIC
/begin CHARACTERISTIC ASMod_tOxiCExoIncr_MAP "Kennfeld für Temperaturerhöhung im Oxidationskatalysator aufgrund chemischer Reaktionen" MAP 0x80047F12 Kf_Xs16_Ys16_Ws16 1000.000 TempDiff_Kelv -500.0000 500.0000 FORMAT "%8.4" EXTENDED_LIMITS -3276.800 3276.700
 /begin AXIS_DESCR STD_AXIS ASMod_tAvrgOxiC_mp Temp_Cels 8 -3549.940 3003.560 FORMAT "%8.3" DEPOSIT ABSOLUTE /end AXIS_DESCR
 /begin AXIS_DESCR STD_AXIS ASMod_rLamRecExhMnfDsMapIn_mp lambdaRecVal 8 -30.00000 30.00000 FORMAT "%8.5" EXTENDED_LIMITS -32.76800 32.76700 DEPOSIT ABSOLUTE /end AXIS_DESCR
/end CHARACTERISTIC
/begin CHARACTERISTIC ASMod_tPipeDflSlw_C "Ersatzwert der berechneten Temperatur im Fehlerfall" VALUE 0x80048158 Kw_Ws16 1030.000 Temp_Cels -30.04000 999.9600 FORMAT "%8.3" EXTENDED_LIMITS -3549.940 3003.560 /end CHARACTERISTIC
/begin CHARACTERISTIC ASMod_tPipeDfl_C "Ersatzwert der berechneten Temperatur im Fehlerfall" VALUE 0x800480C8 Kw_Ws16 1030.000 Temp_Cels -30.04000 999.9600 FORMAT "%8.3" EXTENDED_LIMITS -3549.940 3003.560 /end CHARACTERISTIC
/begin CHARACTERISTIC ASMod_tStrtDfl_C "Ersatzwert für Initialisierungstemperaturen im Fehlerfall" VALUE 0x800481D4 Kw_Ws16 1040.000 Temp_Cels -40.04000 999.9600 FORMAT "%8.3" EXTENDED_LIMITS -3549.940 3003.560 /end CHARACTERISTIC
/begin CHARACTERISTIC ASMod_tTrbnDsRawDfl_C "Ersatzwert für Rohwert Abgastemperatur nach Turbolader im Fehlerfall" VALUE 0x8006FD6C Kw_Ws16 6553.500 Temp_Cels -3549.940 3003.560 FORMAT "%8.3" /end CHARACTERISTIC
/begin CHARACTERISTIC ASMod_tWallPipeDflSlw_C "Ersatzwert der berechneten Rohrwandtemperatur im Fehlerfall" VALUE 0x8004815A Kw_Ws16 1030.000 Temp_Cels -30.04000 999.9600 FORMAT "%8.3" EXTENDED_LIMITS -3549.940 3003.560 /end CHARACTERISTIC
/begin CHARACTERISTIC ASMod_tWallPipeDfl_C "Ersatzwert der berechneten Rohrwandtemperatur im Fehlerfall" VALUE 0x800480CA Kw_Ws16 1030.000 Temp_Cels -30.04000 999.9600 FORMAT "%8.3" EXTENDED_LIMITS -3549.940 3003.560 /end CHARACTERISTIC
/begin CHARACTERISTIC ASMod_volEng_C "Hubvolumen des Motors" VALUE 0x800484B6 Kw_Ws16 20.00000 Vol 0.00 20.00000 FORMAT "%8.5" EXTENDED_LIMITS -327.6800 327.6700 /end CHARACTERISTIC
/begin CHARACTERISTIC ASMod_volIndVol_C "Einlassvolumen zwischen Verdichter und Mischstelle im Einlasskrümmer" VALUE 0x8006FC9C Kw_Ws16 50.00000 Vol 0.00 50.00000 FORMAT "%8.5" EXTENDED_LIMITS -327.6800 327.6700 /end CHARACTERISTIC
/begin CHARACTERISTIC ASMod_vscDynOfsSlw_C "Offsetwert für dynamische Viskosität" VALUE 0x8004815C Kw_Ws16 0.05004883 Fact -0.03002930 0.02001953 FORMAT "%10.8" EXTENDED_LIMITS -4.000000 3.999878 /end CHARACTERISTIC
/begin CHARACTERISTIC ASMod_vscDynOfs_C "Offsetwert für dynamische Viskosität" VALUE 0x800480CC Kw_Ws16 0.05004883 Fact -0.03002930 0.02001953 FORMAT "%10.8" EXTENDED_LIMITS -4.000000 3.999878 /end CHARACTERISTIC
/begin CHARACTERISTIC ASMod_vscKinOfsSlw_C "Offsetwert für kinematische Viskosität" VALUE 0x8004815E Kw_Ws16 0.00005300000 Fact8 -0.00006000000 -0.000007000000 FORMAT "%13.11" EXTENDED_LIMITS -0.0003276800 0.0003276700 /end CHARACTERISTIC
/begin CHARACTERISTIC ASMod_vscKinOfs_C "Offsetwert für kinematische Viskosität" VALUE 0x800480CE Kw_Ws16 0.00005300000 Fact8 -0.00006000000 -0.000007000000 FORMAT "%13.11" EXTENDED_LIMITS -0.0003276800 0.0003276700 /end CHARACTERISTIC
/begin CHARACTERISTIC ATS_Standby_Disabled_C "" VALUE 0x8006FD90 Val_Wu8 255.0 OneToOne 0.00 255.0 FORMAT "%5.1" /end CHARACTERISTIC
/begin CHARACTERISTIC ATS_tiTstDemHeal_C "" VALUE 0x8006FD92 Val_Wu16 655.3500 Time_s 0.00 655.3500 FORMAT "%8.4" /end CHARACTERISTIC
/begin CHARACTERISTIC ATS_tiTstDemMax_C "" VALUE 0x8006FD94 Val_Wu16 655.3500 Time_s 0.00 655.3500 FORMAT "%8.4" /end CHARACTERISTIC
/begin CHARACTERISTIC ATS_TmrBehaviour_C "" VALUE 0x8006FD96 Val_Wu8 255.0 OneToOne 0.00 255.0 FORMAT "%5.1" /end CHARACTERISTIC
/begin CHARACTERISTIC ATS_TstDemMaxEngN_C "" VALUE 0x8006FD97 Val_Wu8 10200. EngN_LRes 0.00 10200. FORMAT "%5.0" /end CHARACTERISTIC
/begin CHARACTERISTIC ATS_TstDemMaxVSSCDV_C "" VALUE 0x8006FD98 Val_Ws16 655.3500 Vel -327.6800 327.6700 FORMAT "%8.4" /end CHARACTERISTIC
/begin CHARACTERISTIC BattU_RmpSlp.Pos_C "/" VALUE 0x8004B414 Kw_Ws32 655358999.634 RmpVoltBatt 1000.06103516 655359999.695 FORMAT "%13.3" EXTENDED_LIMITS -655360000.000 655359999.695 /end CHARACTERISTIC
/begin CHARACTERISTIC BattU_RmpSlp.Neg_C "/" VALUE 0x8004B418 Kw_Ws32 655358999.634 RmpVoltBatt 1000.06103516 655359999.695 FORMAT "%13.3" EXTENDED_LIMITS -655360000.000 655359999.695 /end CHARACTERISTIC
/begin CHARACTERISTIC BattU_swtRated_C "Schalter zur Auswahl der Nennspannung" VALUE 0x8004B41C Val_Wu8 255.0 OneToOne 0.00 255.0 FORMAT "%5.1" /end CHARACTERISTIC
/begin CHARACTERISTIC BattU_TransStagePar.Dfl_C "/" VALUE 0x8004B41E Kw_Ws16 28600.00 Volt_Batt 0.00 28600.00 FORMAT "%8.2" EXTENDED_LIMITS -655360.0 655340.0 /end CHARACTERISTIC
/begin CHARACTERISTIC BattU_TransStagePar.stSensId_C "/" VALUE 0x8004B420 Kw_Wu8 255.0 OneToOne 0.00 255.0 FORMAT "%5.1" /end CHARACTERISTIC
/begin CHARACTERISTIC BattU_uNrm_C "Normale Batteriespannung zur Berechnung des Korrekturfaktors" VALUE 0x8004B422 Val_Ws16 655340.0 Volt_Batt 0.00 655340.0 FORMAT "%8.1" EXTENDED_LIMITS -655360.0 655340.0 /end CHARACTERISTIC
/begin CHARACTERISTIC BattU_uSRCMax_C "Schwelle des SRC-Max-Fehlers" VALUE 0x8004B424 Val_Ws16 5200.000 Volt 0.00 5200.000 FORMAT "%8.3" EXTENDED_LIMITS -6553.600 6553.400 /end CHARACTERISTIC
/begin CHARACTERISTIC BattU_uSRCMin_C "Schwelle des SRC-Min-Fehlers" VALUE 0x8004B426 Val_Ws16 5200.000 Volt 0.00 5200.000 FORMAT "%8.3" EXTENDED_LIMITS -6553.600 6553.400 /end CHARACTERISTIC
/begin CHARACTERISTIC BattU_uTransf_CUR "Umwandlungskennlinie für Batteriespannung" CURVE 0x8004B3D0 Cur_Xs16Ws16 28600.00 Volt_Batt 0.00 28600.00 FORMAT "%8.2" EXTENDED_LIMITS -655360.0 655340.0
 /begin AXIS_DESCR STD_AXIS BattU_uRaw Volt 16 0.00 5199.000 FORMAT "%8.3" EXTENDED_LIMITS -6553.600 6553.400 DEPOSIT ABSOLUTE /end AXIS_DESCR
/end CHARACTERISTIC
/begin CHARACTERISTIC BrkP_pDfl_C "" VALUE 0x8006FF50 Val_Ws16 250.0000 Pres_bar -50.00000 200.0000 FORMAT "%8.4" EXTENDED_LIMITS -32768.00 32767.00 /end CHARACTERISTIC
/begin CHARACTERISTIC BrkP_pTransf_CUR "" CURVE 0x8006FEE6 Cur_Xs16Ws16 250.0000 Pres_bar -50.00000 200.0000 FORMAT "%8.4" EXTENDED_LIMITS -32768.00 32767.00
 /begin AXIS_DESCR STD_AXIS BrkP_uRaw Volt 25 0.00 5200.000 FORMAT "%8.3" EXTENDED_LIMITS -6553.600 6553.400 DEPOSIT ABSOLUTE /end AXIS_DESCR
/end CHARACTERISTIC
/begin CHARACTERISTIC BrkP_RmpSlp.Pos_C "/" VALUE 0x8006FF54 Kw_Ws32 3276798.99750 RmpTemp 1.00097656250 3276799.99847 FORMAT "%13.5" EXTENDED_LIMITS -3276800.00000 3276799.99847 /end CHARACTERISTIC
/begin CHARACTERISTIC BrkP_RmpSlp.Neg_C "/" VALUE 0x8006FF58 Kw_Ws32 3276798.99750 RmpTemp 1.00097656250 3276799.99847 FORMAT "%13.5" EXTENDED_LIMITS -3276800.00000 3276799.99847 /end CHARACTERISTIC
/begin CHARACTERISTIC BrkP_SRC.uMin_C "/" VALUE 0x8006FF4C Kw_Ws16 200.0000 Volt 0.00 200.0000 FORMAT "%8.4" EXTENDED_LIMITS -6553.600 6553.400 /end CHARACTERISTIC
/begin CHARACTERISTIC BrkP_SRC.uMax_C "/" VALUE 0x8006FF4E Kw_Ws16 3200.000 Volt 2000.000 5200.000 FORMAT "%8.3" EXTENDED_LIMITS -6553.600 6553.400 /end CHARACTERISTIC
/begin CHARACTERISTIC BrkP_swtSensPrs_C "" VALUE 0x8006FF5C Val_Wu8 255.0 OneToOne 0.00 255.0 FORMAT "%5.1" /end CHARACTERISTIC
/begin CHARACTERISTIC BrkP_TransStg.Dfl_C "/" VALUE 0x8006FF5E Kw_Ws16 250.0000 Temp_Cels -50.04000 199.9600 FORMAT "%8.4" EXTENDED_LIMITS -3549.940 3003.560 /end CHARACTERISTIC
/begin CHARACTERISTIC BrkP_TransStg.stSensId_C "/" VALUE 0x8006FF60 Kw_Wu8 255.0 OneToOne 0.00 255.0 FORMAT "%5.1" /end CHARACTERISTIC
/begin CHARACTERISTIC Brk_ctPlaDef_C "Defektschwelle dese Unplausibilitätszählers" VALUE 0x8006FEDC Kw_Wu8 255.0 OneToOne 0.00 255.0 FORMAT "%5.1" /end CHARACTERISTIC
/begin CHARACTERISTIC Brk_MnDeb.tiHiLo_C "This is LONG-NAME/" VALUE 0x8004B430 Kw_Ws16 655350.0 TimeDeb -327680.0 327670.0 FORMAT "%8.1" /end CHARACTERISTIC
/begin CHARACTERISTIC Brk_MnDeb.tiLoHi_C "This is LONG-NAME/" VALUE 0x8004B432 Kw_Ws16 655350.0 TimeDeb -327680.0 327670.0 FORMAT "%8.1" /end CHARACTERISTIC
/begin CHARACTERISTIC Brk_RedDeb.tiHiLo_C "This is LONG-NAME/" VALUE 0x8004B434 Kw_Ws16 655350.0 TimeDeb -327680.0 327670.0 FORMAT "%8.1" /end CHARACTERISTIC
/begin CHARACTERISTIC Brk_RedDeb.tiLoHi_C "This is LONG-NAME/" VALUE 0x8004B436 Kw_Ws16 655350.0 TimeDeb -327680.0 327670.0 FORMAT "%8.1" /end CHARACTERISTIC
/begin CHARACTERISTIC Brk_stDflVal_C "Redundanter Bremskontakt-Vorgabewert" VALUE 0x8006FEDD Val_Wu8 3.000 OneToOne 0.00 3.000 FORMAT "%5.3" EXTENDED_LIMITS 0.00 255.0 /end CHARACTERISTIC
/begin CHARACTERISTIC Brk_swtRedSensPrs_C "Schalter redundanter Bremskontakt vorhanden (1 = vorhanden, 0 = nicht vorhanden)" VALUE 0x8006FEDE Val_Wu8 1.000 OneToOne 0.00 1.000 FORMAT "%5.3" EXTENDED_LIMITS 0.00 255.0 /end CHARACTERISTIC
/begin CHARACTERISTIC Brk_swtSig_C "Schalterwert, Signal von HW DIO/CAN (1=CAN, 0=DIO)" VALUE 0x8004B438 Val_Wu8 255.0 OneToOne 0.00 255.0 FORMAT "%5.1" /end CHARACTERISTIC
/begin CHARACTERISTIC Brk_tiDebPlaStat_C "Entprellzeit zur Erkennung auf statische Unplausibilität" VALUE 0x8006FEE0 Kw_Wu16 655350.0 Time_ms 0.00 655350.0 FORMAT "%8.1" /end CHARACTERISTIC
/begin CHARACTERISTIC Brk_tiDebPla_C "Entprellzeit zur Erkennung auf Unplausibilität" VALUE 0x8006FEE2 Kw_Wu16 655350.0 Time_ms 0.00 655350.0 FORMAT "%8.1" /end CHARACTERISTIC
/begin CHARACTERISTIC Brk_tiDebResPla_C "Entprellzeit zur Erkennung auf Plausibilität" VALUE 0x8006FEE4 Kw_Wu16 655350.0 Time_ms 0.00 655350.0 FORMAT "%8.1" /end CHARACTERISTIC
/begin CHARACTERISTIC CByVlv_ATS.LimitTypeMsk_C "/" VALUE 0x8006FD9C Val_Wu8 255.0 OneToOne 0.00 255.0 FORMAT "%5.1" /end CHARACTERISTIC
/begin CHARACTERISTIC CByVlv_ATS.CnvNorm_C "/" VALUE 0x8006FD9D Val_Wu8 255.0 OneToOne 0.00 255.0 FORMAT "%5.1" /end CHARACTERISTIC
/begin CHARACTERISTIC CByVlv_ATS.CnvLimit_C "/" VALUE 0x8006FD9E Val_Wu8 255.0 OneToOne 0.00 255.0 FORMAT "%5.1" /end CHARACTERISTIC
/begin CHARACTERISTIC CByVlv_ATS.LowLim_C "/" VALUE 0x8006FDA0 Val_Ws16 65535.00 OneToOne -32768.00 32767.00 FORMAT "%8.2" /end CHARACTERISTIC
/begin CHARACTERISTIC CByVlv_ATS.UpLim_C "/" VALUE 0x8006FDA2 Val_Ws16 65535.00 OneToOne -32768.00 32767.00 FORMAT "%8.2" /end CHARACTERISTIC
/begin CHARACTERISTIC CByVlv_ATS.CnvFac_C "/" VALUE 0x8006FDA4 Val_Ws32 4294967295.00 OneToOne -2147483648.00 2147483647.00 FORMAT "%13.2" /end CHARACTERISTIC
/begin CHARACTERISTIC CByVlv_ATS.CnvOfs_C "/" VALUE 0x8006FDA8 Val_Ws16 65535.00 OneToOne -32768.00 32767.00 FORMAT "%8.2" /end CHARACTERISTIC
/begin CHARACTERISTIC Com_swtCalcVehV_C "" VALUE 0x8004B42E Val_Wu8 255.0 OneToOne 0.00 255.0 FORMAT "%5.1" /end CHARACTERISTIC
/begin CHARACTERISTIC Com_swtCorTrqDSC_C "" VALUE 0x8004B42F Val_Wu8 255.0 OneToOne 0.00 255.0 FORMAT "%5.1" /end CHARACTERISTIC
/begin CHARACTERISTIC Com_swtLenkradwinkel_C "" VALUE 0x8004B428 Val_Wu8 1.000 OneToOne 0.00 1.000 FORMAT "%5.3" EXTENDED_LIMITS 0.00 255.0 /end CHARACTERISTIC
/begin CHARACTERISTIC Com_swtStateDsc_C "" VALUE 0x8004B429 Val_Wu8 1.000 OneToOne 0.00 1.000 FORMAT "%5.3" EXTENDED_LIMITS 0.00 255.0 /end CHARACTERISTIC
/begin CHARACTERISTIC Com_swtTrqDemandDsc_C "" VALUE 0x8004B42A Val_Wu8 1.000 OneToOne 0.00 1.000 FORMAT "%5.3" EXTENDED_LIMITS 0.00 255.0 /end CHARACTERISTIC
/begin CHARACTERISTIC Com_swtVelocity_C "" VALUE 0x8004B42B Val_Wu8 1.000 OneToOne 0.00 1.000 FORMAT "%5.3" EXTENDED_LIMITS 0.00 255.0 /end CHARACTERISTIC
/begin CHARACTERISTIC Com_swtWheelSpeed_C "" VALUE 0x8004B42C Val_Wu8 1.000 OneToOne 0.00 1.000 FORMAT "%5.3" EXTENDED_LIMITS 0.00 255.0 /end CHARACTERISTIC
/begin CHARACTERISTIC CThmst_ATS.LimitTypeMsk_C "/" VALUE 0x8006FDAC Val_Wu8 255.0 OneToOne 0.00 255.0 FORMAT "%5.1" /end CHARACTERISTIC
/begin CHARACTERISTIC CThmst_ATS.CnvNorm_C "/" VALUE 0x8006FDAD Val_Wu8 255.0 OneToOne 0.00 255.0 FORMAT "%5.1" /end CHARACTERISTIC
/begin CHARACTERISTIC CThmst_ATS.CnvLimit_C "/" VALUE 0x8006FDAE Val_Wu8 255.0 OneToOne 0.00 255.0 FORMAT "%5.1" /end CHARACTERISTIC
/begin CHARACTERISTIC CThmst_ATS.LowLim_C "/" VALUE 0x8006FDB0 Val_Ws16 799.9878 Prc -400.0000 399.9878 FORMAT "%8.4" /end CHARACTERISTIC
/begin CHARACTERISTIC CThmst_ATS.UpLim_C "/" VALUE 0x8006FDB2 Val_Ws16 799.9878 Prc -400.0000 399.9878 FORMAT "%8.4" /end CHARACTERISTIC
/begin CHARACTERISTIC CThmst_ATS.CnvFac_C "/" VALUE 0x8006FDB4 Val_Ws32 4294967295.00 OneToOne -2147483648.00 2147483647.00 FORMAT "%13.2" /end CHARACTERISTIC
/begin CHARACTERISTIC CThmst_ATS.CnvOfs_C "/" VALUE 0x8006FDB8 Val_Ws16 65535.00 OneToOne -32768.00 32767.00 FORMAT "%8.2" /end CHARACTERISTIC
/begin CHARACTERISTIC ECBVlv_ATS.LimitTypeMsk_C "/" VALUE 0x8006FDBC Val_Wu8 255.0 OneToOne 0.00 255.0 FORMAT "%5.1" /end CHARACTERISTIC
/begin CHARACTERISTIC ECBVlv_ATS.CnvNorm_C "/" VALUE 0x8006FDBD Val_Wu8 255.0 OneToOne 0.00 255.0 FORMAT "%5.1" /end CHARACTERISTIC
/begin CHARACTERISTIC ECBVlv_ATS.CnvLimit_C "/" VALUE 0x8006FDBE Val_Wu8 255.0 OneToOne 0.00 255.0 FORMAT "%5.1" /end CHARACTERISTIC
/begin CHARACTERISTIC ECBVlv_ATS.LowLim_C "/" VALUE 0x8006FDC0 Val_Ws16 799.9878 Prc -400.0000 399.9878 FORMAT "%8.4" /end CHARACTERISTIC
/begin CHARACTERISTIC ECBVlv_ATS.UpLim_C "/" VALUE 0x8006FDC2 Val_Ws16 799.9878 Prc -400.0000 399.9878 FORMAT "%8.4" /end CHARACTERISTIC
/begin CHARACTERISTIC ECBVlv_ATS.CnvFac_C "/" VALUE 0x8006FDC4 Val_Ws32 4294967295.00 OneToOne -2147483648.00 2147483647.00 FORMAT "%13.2" /end CHARACTERISTIC
/begin CHARACTERISTIC ECBVlv_ATS.CnvOfs_C "/" VALUE 0x8006FDC8 Val_Ws16 65535.00 OneToOne -32768.00 32767.00 FORMAT "%8.2" /end CHARACTERISTIC
/begin CHARACTERISTIC ECBVlv_rB1_C "" VALUE 0x80047190 Kw_Ws16 799.9878 Prc -400.0000 399.9878 FORMAT "%8.4" /end CHARACTERISTIC
/begin CHARACTERISTIC ECBVlv_rB2_C "" VALUE 0x80047192 Kw_Ws16 799.9878 Prc -400.0000 399.9878 FORMAT "%8.4" /end CHARACTERISTIC
/begin CHARACTERISTIC EGRVlv_rActB1_C "" VALUE 0x80047194 Kw_Ws16 799.9878 Prc -400.0000 399.9878 FORMAT "%8.4" /end CHARACTERISTIC
/begin CHARACTERISTIC EGRVlv_rActB2_C "" VALUE 0x80047196 Kw_Ws16 799.9878 Prc -400.0000 399.9878 FORMAT "%8.4" /end CHARACTERISTIC
/begin CHARACTERISTIC EMDmpDig0_ATS.LimitTypeMsk_C "/" VALUE 0x8006FDCC Val_Wu8 255.0 OneToOne 0.00 255.0 FORMAT "%5.1" /end CHARACTERISTIC
/begin CHARACTERISTIC EMDmpDig0_ATS.CnvNorm_C "/" VALUE 0x8006FDCD Val_Wu8 255.0 OneToOne 0.00 255.0 FORMAT "%5.1" /end CHARACTERISTIC
/begin CHARACTERISTIC EMDmpDig0_ATS.CnvLimit_C "/" VALUE 0x8006FDCE Val_Wu8 255.0 OneToOne 0.00 255.0 FORMAT "%5.1" /end CHARACTERISTIC
/begin CHARACTERISTIC EMDmpDig0_ATS.LowLim_C "/" VALUE 0x8006FDD0 Val_Ws16 65535.00 OneToOne -32768.00 32767.00 FORMAT "%8.2" /end CHARACTERISTIC
/begin CHARACTERISTIC EMDmpDig0_ATS.UpLim_C "/" VALUE 0x8006FDD2 Val_Ws16 65535.00 OneToOne -32768.00 32767.00 FORMAT "%8.2" /end CHARACTERISTIC
/begin CHARACTERISTIC EMDmpDig0_ATS.CnvFac_C "/" VALUE 0x8006FDD4 Val_Ws32 4294967295.00 OneToOne -2147483648.00 2147483647.00 FORMAT "%13.2" /end CHARACTERISTIC
/begin CHARACTERISTIC EMDmpDig0_ATS.CnvOfs_C "/" VALUE 0x8006FDD8 Val_Ws16 65535.00 OneToOne -32768.00 32767.00 FORMAT "%8.2" /end CHARACTERISTIC
/begin CHARACTERISTIC EMDmpDig1_ATS.LimitTypeMsk_C "/" VALUE 0x8006FDDC Val_Wu8 255.0 OneToOne 0.00 255.0 FORMAT "%5.1" /end CHARACTERISTIC
/begin CHARACTERISTIC EMDmpDig1_ATS.CnvNorm_C "/" VALUE 0x8006FDDD Val_Wu8 255.0 OneToOne 0.00 255.0 FORMAT "%5.1" /end CHARACTERISTIC
/begin CHARACTERISTIC EMDmpDig1_ATS.CnvLimit_C "/" VALUE 0x8006FDDE Val_Wu8 255.0 OneToOne 0.00 255.0 FORMAT "%5.1" /end CHARACTERISTIC
/begin CHARACTERISTIC EMDmpDig1_ATS.LowLim_C "/" VALUE 0x8006FDE0 Val_Ws16 65535.00 OneToOne -32768.00 32767.00 FORMAT "%8.2" /end CHARACTERISTIC
/begin CHARACTERISTIC EMDmpDig1_ATS.UpLim_C "/" VALUE 0x8006FDE2 Val_Ws16 65535.00 OneToOne -32768.00 32767.00 FORMAT "%8.2" /end CHARACTERISTIC
/begin CHARACTERISTIC EMDmpDig1_ATS.CnvFac_C "/" VALUE 0x8006FDE4 Val_Ws32 4294967295.00 OneToOne -2147483648.00 2147483647.00 FORMAT "%13.2" /end CHARACTERISTIC
/begin CHARACTERISTIC EMDmpDig1_ATS.CnvOfs_C "/" VALUE 0x8006FDE8 Val_Ws16 65535.00 OneToOne -32768.00 32767.00 FORMAT "%8.2" /end CHARACTERISTIC
/begin CHARACTERISTIC EMDmpPWM0_ATS.LimitTypeMsk_C "/" VALUE 0x8006FDEC Val_Wu8 255.0 OneToOne 0.00 255.0 FORMAT "%5.1" /end CHARACTERISTIC
/begin CHARACTERISTIC EMDmpPWM0_ATS.CnvNorm_C "/" VALUE 0x8006FDED Val_Wu8 255.0 OneToOne 0.00 255.0 FORMAT "%5.1" /end CHARACTERISTIC
/begin CHARACTERISTIC EMDmpPWM0_ATS.CnvLimit_C "/" VALUE 0x8006FDEE Val_Wu8 255.0 OneToOne 0.00 255.0 FORMAT "%5.1" /end CHARACTERISTIC
/begin CHARACTERISTIC EMDmpPWM0_ATS.LowLim_C "/" VALUE 0x8006FDF0 Val_Ws16 799.9878 Prc -400.0000 399.9878 FORMAT "%8.4" /end CHARACTERISTIC
/begin CHARACTERISTIC EMDmpPWM0_ATS.UpLim_C "/" VALUE 0x8006FDF2 Val_Ws16 799.9878 Prc -400.0000 399.9878 FORMAT "%8.4" /end CHARACTERISTIC
/begin CHARACTERISTIC EMDmpPWM0_ATS.CnvFac_C "/" VALUE 0x8006FDF4 Val_Ws32 4294967295.00 OneToOne -2147483648.00 2147483647.00 FORMAT "%13.2" /end CHARACTERISTIC
/begin CHARACTERISTIC EMDmpPWM0_ATS.CnvOfs_C "/" VALUE 0x8006FDF8 Val_Ws16 65535.00 OneToOne -32768.00 32767.00 FORMAT "%8.2" /end CHARACTERISTIC
/begin CHARACTERISTIC EMDmpPWM1_ATS.LimitTypeMsk_C "/" VALUE 0x8006FDFC Val_Wu8 255.0 OneToOne 0.00 255.0 FORMAT "%5.1" /end CHARACTERISTIC
/begin CHARACTERISTIC EMDmpPWM1_ATS.CnvNorm_C "/" VALUE 0x8006FDFD Val_Wu8 255.0 OneToOne 0.00 255.0 FORMAT "%5.1" /end CHARACTERISTIC
/begin CHARACTERISTIC EMDmpPWM1_ATS.CnvLimit_C "/" VALUE 0x8006FDFE Val_Wu8 255.0 OneToOne 0.00 255.0 FORMAT "%5.1" /end CHARACTERISTIC
/begin CHARACTERISTIC EMDmpPWM1_ATS.LowLim_C "/" VALUE 0x8006FE00 Val_Ws16 799.9878 Prc -400.0000 399.9878 FORMAT "%8.4" /end CHARACTERISTIC
/begin CHARACTERISTIC EMDmpPWM1_ATS.UpLim_C "/" VALUE 0x8006FE02 Val_Ws16 799.9878 Prc -400.0000 399.9878 FORMAT "%8.4" /end CHARACTERISTIC
/begin CHARACTERISTIC EMDmpPWM1_ATS.CnvFac_C "/" VALUE 0x8006FE04 Val_Ws32 4294967295.00 OneToOne -2147483648.00 2147483647.00 FORMAT "%13.2" /end CHARACTERISTIC
/begin CHARACTERISTIC EMDmpPWM1_ATS.CnvOfs_C "/" VALUE 0x8006FE08 Val_Ws16 65535.00 OneToOne -32768.00 32767.00 FORMAT "%8.2" /end CHARACTERISTIC
/begin CHARACTERISTIC ErrLmpMIL_ATS.LimitTypeMsk_C "/" VALUE 0x8006FE0C Val_Wu8 255.0 OneToOne 0.00 255.0 FORMAT "%5.1" /end CHARACTERISTIC
/begin CHARACTERISTIC ErrLmpMIL_ATS.CnvNorm_C "/" VALUE 0x8006FE0D Val_Wu8 255.0 OneToOne 0.00 255.0 FORMAT "%5.1" /end CHARACTERISTIC
/begin CHARACTERISTIC ErrLmpMIL_ATS.CnvLimit_C "/" VALUE 0x8006FE0E Val_Wu8 255.0 OneToOne 0.00 255.0 FORMAT "%5.1" /end CHARACTERISTIC
/begin CHARACTERISTIC ErrLmpMIL_ATS.LowLim_C "/" VALUE 0x8006FE10 Val_Ws16 65535.00 OneToOne -32768.00 32767.00 FORMAT "%8.2" /end CHARACTERISTIC
/begin CHARACTERISTIC ErrLmpMIL_ATS.UpLim_C "/" VALUE 0x8006FE12 Val_Ws16 65535.00 OneToOne -32768.00 32767.00 FORMAT "%8.2" /end CHARACTERISTIC
/begin CHARACTERISTIC ErrLmpMIL_ATS.CnvFac_C "/" VALUE 0x8006FE14 Val_Ws32 4294967295.00 OneToOne -2147483648.00 2147483647.00 FORMAT "%13.2" /end CHARACTERISTIC
/begin CHARACTERISTIC ErrLmpMIL_ATS.CnvOfs_C "/" VALUE 0x8006FE18 Val_Ws16 65535.00 OneToOne -32768.00 32767.00 FORMAT "%8.2" /end CHARACTERISTIC
/begin CHARACTERISTIC ErrLmpSVS_ATS.LimitTypeMsk_C "/" VALUE 0x8006FE1C Val_Wu8 255.0 OneToOne 0.00 255.0 FORMAT "%5.1" /end CHARACTERISTIC
/begin CHARACTERISTIC ErrLmpSVS_ATS.CnvNorm_C "/" VALUE 0x8006FE1D Val_Wu8 255.0 OneToOne 0.00 255.0 FORMAT "%5.1" /end CHARACTERISTIC
/begin CHARACTERISTIC ErrLmpSVS_ATS.CnvLimit_C "/" VALUE 0x8006FE1E Val_Wu8 255.0 OneToOne 0.00 255.0 FORMAT "%5.1" /end CHARACTERISTIC
/begin CHARACTERISTIC ErrLmpSVS_ATS.LowLim_C "/" VALUE 0x8006FE20 Val_Ws16 65535.00 OneToOne -32768.00 32767.00 FORMAT "%8.2" /end CHARACTERISTIC
/begin CHARACTERISTIC ErrLmpSVS_ATS.UpLim_C "/" VALUE 0x8006FE22 Val_Ws16 65535.00 OneToOne -32768.00 32767.00 FORMAT "%8.2" /end CHARACTERISTIC
/begin CHARACTERISTIC ErrLmpSVS_ATS.CnvFac_C "/" VALUE 0x8006FE24 Val_Ws32 4294967295.00 OneToOne -2147483648.00 2147483647.00 FORMAT "%13.2" /end CHARACTERISTIC
/begin CHARACTERISTIC ErrLmpSVS_ATS.CnvOfs_C "/" VALUE 0x8006FE28 Val_Ws16 65535.00 OneToOne -32768.00 32767.00 FORMAT "%8.2" /end CHARACTERISTIC
/begin CHARACTERISTIC Exh_pAdapPPFltDiffB1_C "" VALUE 0x80047198 Kw_Ws16 36268.00 Pres_hPa -32768.00 3500.00 FORMAT "%8.2" EXTENDED_LIMITS -32768.00 32767.00 /end CHARACTERISTIC
/begin CHARACTERISTIC Exh_pAdapPPFltDiffB2_C "" VALUE 0x8004719A Kw_Ws16 36268.00 Pres_hPa -32768.00 3500.00 FORMAT "%8.2" EXTENDED_LIMITS -32768.00 32767.00 /end CHARACTERISTIC
/begin CHARACTERISTIC Exh_pPFltUsB1_C "" VALUE 0x8004719C Kw_Ws16 36268.00 Pres_hPa -32768.00 3500.00 FORMAT "%8.2" EXTENDED_LIMITS -32768.00 32767.00 /end CHARACTERISTIC
/begin CHARACTERISTIC Exh_pPFltUsB2_C "" VALUE 0x8004719E Kw_Ws16 36268.00 Pres_hPa -32768.00 3500.00 FORMAT "%8.2" EXTENDED_LIMITS -32768.00 32767.00 /end CHARACTERISTIC
/begin CHARACTERISTIC Exh_tPFltUsB1_C "" VALUE 0x800471A0 Kw_Ws16 6553.500 Temp_Cels -3549.940 3003.560 FORMAT "%8.3" /end CHARACTERISTIC
/begin CHARACTERISTIC Exh_tPFltUsB2_C "" VALUE 0x800471A2 Kw_Ws16 6553.500 Temp_Cels -3549.940 3003.560 FORMAT "%8.3" /end CHARACTERISTIC
/begin CHARACTERISTIC FanOut1_ATS.LimitTypeMsk_C "/" VALUE 0x8006FE2C Val_Wu8 255.0 OneToOne 0.00 255.0 FORMAT "%5.1" /end CHARACTERISTIC
/begin CHARACTERISTIC FanOut1_ATS.CnvNorm_C "/" VALUE 0x8006FE2D Val_Wu8 255.0 OneToOne 0.00 255.0 FORMAT "%5.1" /end CHARACTERISTIC
/begin CHARACTERISTIC FanOut1_ATS.CnvLimit_C "/" VALUE 0x8006FE2E Val_Wu8 255.0 OneToOne 0.00 255.0 FORMAT "%5.1" /end CHARACTERISTIC
/begin CHARACTERISTIC FanOut1_ATS.LowLim_C "/" VALUE 0x8006FE30 Val_Ws16 799.9878 Prc -400.0000 399.9878 FORMAT "%8.4" /end CHARACTERISTIC
/begin CHARACTERISTIC FanOut1_ATS.UpLim_C "/" VALUE 0x8006FE32 Val_Ws16 799.9878 Prc -400.0000 399.9878 FORMAT "%8.4" /end CHARACTERISTIC
/begin CHARACTERISTIC FanOut1_ATS.CnvFac_C "/" VALUE 0x8006FE34 Val_Ws32 4294967295.00 OneToOne -2147483648.00 2147483647.00 FORMAT "%13.2" /end CHARACTERISTIC
/begin CHARACTERISTIC FanOut1_ATS.CnvOfs_C "/" VALUE 0x8006FE38 Val_Ws16 65535.00 OneToOne -32768.00 32767.00 FORMAT "%8.2" /end CHARACTERISTIC
/begin CHARACTERISTIC InjCrv_phiMI1DesB1_C "" VALUE 0x800471A4 Kw_Ws16 1440.022 AngleCrS -720.0220 720.0000 FORMAT "%8.4" /end CHARACTERISTIC
/begin CHARACTERISTIC InjCrv_phiMI1DesB2_C "" VALUE 0x800471A6 Kw_Ws16 1440.022 AngleCrS -720.0220 720.0000 FORMAT "%8.4" /end CHARACTERISTIC
/begin CHARACTERISTIC MeUn_ActrTst_ATS.LimitTypeMsk_C "/" VALUE 0x8006FE3C Val_Wu8 255.0 OneToOne 0.00 255.0 FORMAT "%5.1" /end CHARACTERISTIC
/begin CHARACTERISTIC MeUn_ActrTst_ATS.CnvNorm_C "/" VALUE 0x8006FE3D Val_Wu8 255.0 OneToOne 0.00 255.0 FORMAT "%5.1" /end CHARACTERISTIC
/begin CHARACTERISTIC MeUn_ActrTst_ATS.CnvLimit_C "/" VALUE 0x8006FE3E Val_Wu8 255.0 OneToOne 0.00 255.0 FORMAT "%5.1" /end CHARACTERISTIC
/begin CHARACTERISTIC MeUn_ActrTst_ATS.LowLim_C "/" VALUE 0x8006FE40 Val_Ws16 799.9878 Prc -400.0000 399.9878 FORMAT "%8.4" /end CHARACTERISTIC
/begin CHARACTERISTIC MeUn_ActrTst_ATS.UpLim_C "/" VALUE 0x8006FE42 Val_Ws16 799.9878 Prc -400.0000 399.9878 FORMAT "%8.4" /end CHARACTERISTIC
/begin CHARACTERISTIC MeUn_ActrTst_ATS.CnvFac_C "/" VALUE 0x8006FE44 Val_Ws32 4294967295.00 OneToOne -2147483648.00 2147483647.00 FORMAT "%13.2" /end CHARACTERISTIC
/begin CHARACTERISTIC MeUn_ActrTst_ATS.CnvOfs_C "/" VALUE 0x8006FE48 Val_Ws16 65535.00 OneToOne -32768.00 32767.00 FORMAT "%8.2" /end CHARACTERISTIC
/begin CHARACTERISTIC OilPLmp_ATS.LimitTypeMsk_C "/" VALUE 0x8006FE4C Val_Wu8 255.0 OneToOne 0.00 255.0 FORMAT "%5.1" /end CHARACTERISTIC
/begin CHARACTERISTIC OilPLmp_ATS.CnvNorm_C "/" VALUE 0x8006FE4D Val_Wu8 255.0 OneToOne 0.00 255.0 FORMAT "%5.1" /end CHARACTERISTIC
/begin CHARACTERISTIC OilPLmp_ATS.CnvLimit_C "/" VALUE 0x8006FE4E Val_Wu8 255.0 OneToOne 0.00 255.0 FORMAT "%5.1" /end CHARACTERISTIC
/begin CHARACTERISTIC OilPLmp_ATS.LowLim_C "/" VALUE 0x8006FE50 Val_Ws16 65535.00 OneToOne -32768.00 32767.00 FORMAT "%8.2" /end CHARACTERISTIC
/begin CHARACTERISTIC OilPLmp_ATS.UpLim_C "/" VALUE 0x8006FE52 Val_Ws16 65535.00 OneToOne -32768.00 32767.00 FORMAT "%8.2" /end CHARACTERISTIC
/begin CHARACTERISTIC OilPLmp_ATS.CnvFac_C "/" VALUE 0x8006FE54 Val_Ws32 4294967295.00 OneToOne -2147483648.00 2147483647.00 FORMAT "%13.2" /end CHARACTERISTIC
/begin CHARACTERISTIC OilPLmp_ATS.CnvOfs_C "/" VALUE 0x8006FE58 Val_Ws16 65535.00 OneToOne -32768.00 32767.00 FORMAT "%8.2" /end CHARACTERISTIC
/begin CHARACTERISTIC PCV_ActrTst_ATS.LimitTypeMsk_C "/" VALUE 0x8006FE5C Val_Wu8 255.0 OneToOne 0.00 255.0 FORMAT "%5.1" /end CHARACTERISTIC
/begin CHARACTERISTIC PCV_ActrTst_ATS.CnvNorm_C "/" VALUE 0x8006FE5D Val_Wu8 255.0 OneToOne 0.00 255.0 FORMAT "%5.1" /end CHARACTERISTIC
/begin CHARACTERISTIC PCV_ActrTst_ATS.CnvLimit_C "/" VALUE 0x8006FE5E Val_Wu8 255.0 OneToOne 0.00 255.0 FORMAT "%5.1" /end CHARACTERISTIC
/begin CHARACTERISTIC PCV_ActrTst_ATS.LowLim_C "/" VALUE 0x8006FE60 Val_Ws16 799.9878 Prc -400.0000 399.9878 FORMAT "%8.4" /end CHARACTERISTIC
/begin CHARACTERISTIC PCV_ActrTst_ATS.UpLim_C "/" VALUE 0x8006FE62 Val_Ws16 799.9878 Prc -400.0000 399.9878 FORMAT "%8.4" /end CHARACTERISTIC
/begin CHARACTERISTIC PCV_ActrTst_ATS.CnvFac_C "/" VALUE 0x8006FE64 Val_Ws32 4294967295.00 OneToOne -2147483648.00 2147483647.00 FORMAT "%13.2" /end CHARACTERISTIC
/begin CHARACTERISTIC PCV_ActrTst_ATS.CnvOfs_C "/" VALUE 0x8006FE68 Val_Ws16 65535.00 OneToOne -32768.00 32767.00 FORMAT "%8.2" /end CHARACTERISTIC
/begin CHARACTERISTIC PFltLmp_ATS.LimitTypeMsk_C "/" VALUE 0x8006FE6C Val_Wu8 255.0 OneToOne 0.00 255.0 FORMAT "%5.1" /end CHARACTERISTIC
/begin CHARACTERISTIC PFltLmp_ATS.CnvNorm_C "/" VALUE 0x8006FE6D Val_Wu8 255.0 OneToOne 0.00 255.0 FORMAT "%5.1" /end CHARACTERISTIC
/begin CHARACTERISTIC PFltLmp_ATS.CnvLimit_C "/" VALUE 0x8006FE6E Val_Wu8 255.0 OneToOne 0.00 255.0 FORMAT "%5.1" /end CHARACTERISTIC
/begin CHARACTERISTIC PFltLmp_ATS.LowLim_C "/" VALUE 0x8006FE70 Val_Ws16 65535.00 OneToOne -32768.00 32767.00 FORMAT "%8.2" /end CHARACTERISTIC
/begin CHARACTERISTIC PFltLmp_ATS.UpLim_C "/" VALUE 0x8006FE72 Val_Ws16 65535.00 OneToOne -32768.00 32767.00 FORMAT "%8.2" /end CHARACTERISTIC
/begin CHARACTERISTIC PFltLmp_ATS.CnvFac_C "/" VALUE 0x8006FE74 Val_Ws32 4294967295.00 OneToOne -2147483648.00 2147483647.00 FORMAT "%13.2" /end CHARACTERISTIC
/begin CHARACTERISTIC PFltLmp_ATS.CnvOfs_C "/" VALUE 0x8006FE78 Val_Ws16 65535.00 OneToOne -32768.00 32767.00 FORMAT "%8.2" /end CHARACTERISTIC
/begin CHARACTERISTIC Strt_ATS.LimitTypeMsk_C "/" VALUE 0x8006FE7C Val_Wu8 255.0 OneToOne 0.00 255.0 FORMAT "%5.1" /end CHARACTERISTIC
/begin CHARACTERISTIC Strt_ATS.CnvNorm_C "/" VALUE 0x8006FE7D Val_Wu8 255.0 OneToOne 0.00 255.0 FORMAT "%5.1" /end CHARACTERISTIC
/begin CHARACTERISTIC Strt_ATS.CnvLimit_C "/" VALUE 0x8006FE7E Val_Wu8 255.0 OneToOne 0.00 255.0 FORMAT "%5.1" /end CHARACTERISTIC
/begin CHARACTERISTIC Strt_ATS.LowLim_C "/" VALUE 0x8006FE80 Val_Ws16 65535.00 OneToOne -32768.00 32767.00 FORMAT "%8.2" /end CHARACTERISTIC
/begin CHARACTERISTIC Strt_ATS.UpLim_C "/" VALUE 0x8006FE82 Val_Ws16 65535.00 OneToOne -32768.00 32767.00 FORMAT "%8.2" /end CHARACTERISTIC
/begin CHARACTERISTIC Strt_ATS.CnvFac_C "/" VALUE 0x8006FE84 Val_Ws32 4294967295.00 OneToOne -2147483648.00 2147483647.00 FORMAT "%13.2" /end CHARACTERISTIC
/begin CHARACTERISTIC Strt_ATS.CnvOfs_C "/" VALUE 0x8006FE88 Val_Ws16 65535.00 OneToOne -32768.00 32767.00 FORMAT "%8.2" /end CHARACTERISTIC
/begin CHARACTERISTIC ThrVlv_ATS.LimitTypeMsk_C "/" VALUE 0x8006FE8C Val_Wu8 255.0 OneToOne 0.00 255.0 FORMAT "%5.1" /end CHARACTERISTIC
/begin CHARACTERISTIC ThrVlv_ATS.CnvNorm_C "/" VALUE 0x8006FE8D Val_Wu8 255.0 OneToOne 0.00 255.0 FORMAT "%5.1" /end CHARACTERISTIC
/begin CHARACTERISTIC ThrVlv_ATS.CnvLimit_C "/" VALUE 0x8006FE8E Val_Wu8 255.0 OneToOne 0.00 255.0 FORMAT "%5.1" /end CHARACTERISTIC
/begin CHARACTERISTIC ThrVlv_ATS.LowLim_C "/" VALUE 0x8006FE90 Val_Ws16 799.9878 Prc -400.0000 399.9878 FORMAT "%8.4" /end CHARACTERISTIC
/begin CHARACTERISTIC ThrVlv_ATS.UpLim_C "/" VALUE 0x8006FE92 Val_Ws16 799.9878 Prc -400.0000 399.9878 FORMAT "%8.4" /end CHARACTERISTIC
/begin CHARACTERISTIC ThrVlv_ATS.CnvFac_C "/" VALUE 0x8006FE94 Val_Ws32 4294967295.00 OneToOne -2147483648.00 2147483647.00 FORMAT "%13.2" /end CHARACTERISTIC
/begin CHARACTERISTIC ThrVlv_ATS.CnvOfs_C "/" VALUE 0x8006FE98 Val_Ws16 65535.00 OneToOne -32768.00 32767.00 FORMAT "%8.2" /end CHARACTERISTIC
/begin CHARACTERISTIC ThrVlv_rActB1_C "" VALUE 0x800471A8 Kw_Ws16 655.3500 DtyCyc -327.6800 327.6700 FORMAT "%8.4" /end CHARACTERISTIC
/begin CHARACTERISTIC ThrVlv_rActB2_C "" VALUE 0x800471AA Kw_Ws16 655.3500 DtyCyc -327.6800 327.6700 FORMAT "%8.4" /end CHARACTERISTIC
/begin CHARACTERISTIC TrbChLP_ATS.LimitTypeMsk_C "/" VALUE 0x8006FE9C Val_Wu8 255.0 OneToOne 0.00 255.0 FORMAT "%5.1" /end CHARACTERISTIC
/begin CHARACTERISTIC TrbChLP_ATS.CnvNorm_C "/" VALUE 0x8006FE9D Val_Wu8 255.0 OneToOne 0.00 255.0 FORMAT "%5.1" /end CHARACTERISTIC
/begin CHARACTERISTIC TrbChLP_ATS.CnvLimit_C "/" VALUE 0x8006FE9E Val_Wu8 255.0 OneToOne 0.00 255.0 FORMAT "%5.1" /end CHARACTERISTIC
/begin CHARACTERISTIC TrbChLP_ATS.LowLim_C "/" VALUE 0x8006FEA0 Val_Ws16 799.9878 Prc -400.0000 399.9878 FORMAT "%8.4" /end CHARACTERISTIC
/begin CHARACTERISTIC TrbChLP_ATS.UpLim_C "/" VALUE 0x8006FEA2 Val_Ws16 799.9878 Prc -400.0000 399.9878 FORMAT "%8.4" /end CHARACTERISTIC
/begin CHARACTERISTIC TrbChLP_ATS.CnvFac_C "/" VALUE 0x8006FEA4 Val_Ws32 4294967295.00 OneToOne -2147483648.00 2147483647.00 FORMAT "%13.2" /end CHARACTERISTIC
/begin CHARACTERISTIC TrbChLP_ATS.CnvOfs_C "/" VALUE 0x8006FEA8 Val_Ws16 65535.00 OneToOne -32768.00 32767.00 FORMAT "%8.2" /end CHARACTERISTIC
/begin CHARACTERISTIC TrbCh_ATS.LimitTypeMsk_C "/" VALUE 0x8006FEAC Val_Wu8 255.0 OneToOne 0.00 255.0 FORMAT "%5.1" /end CHARACTERISTIC
/begin CHARACTERISTIC TrbCh_ATS.CnvNorm_C "/" VALUE 0x8006FEAD Val_Wu8 255.0 OneToOne 0.00 255.0 FORMAT "%5.1" /end CHARACTERISTIC
/begin CHARACTERISTIC TrbCh_ATS.CnvLimit_C "/" VALUE 0x8006FEAE Val_Wu8 255.0 OneToOne 0.00 255.0 FORMAT "%5.1" /end CHARACTERISTIC
/begin CHARACTERISTIC TrbCh_ATS.LowLim_C "/" VALUE 0x8006FEB0 Val_Ws16 799.9878 Prc -400.0000 399.9878 FORMAT "%8.4" /end CHARACTERISTIC
/begin CHARACTERISTIC TrbCh_ATS.UpLim_C "/" VALUE 0x8006FEB2 Val_Ws16 799.9878 Prc -400.0000 399.9878 FORMAT "%8.4" /end CHARACTERISTIC
/begin CHARACTERISTIC TrbCh_ATS.CnvFac_C "/" VALUE 0x8006FEB4 Val_Ws32 4294967295.00 OneToOne -2147483648.00 2147483647.00 FORMAT "%13.2" /end CHARACTERISTIC
/begin CHARACTERISTIC TrbCh_ATS.CnvOfs_C "/" VALUE 0x8006FEB8 Val_Ws16 65535.00 OneToOne -32768.00 32767.00 FORMAT "%8.2" /end CHARACTERISTIC
/begin CHARACTERISTIC TrbCh_rActB1_C "" VALUE 0x800471AC Kw_Ws16 799.9878 Prc -400.0000 399.9878 FORMAT "%8.4" /end CHARACTERISTIC
/begin CHARACTERISTIC TrbCh_rActB2_C "" VALUE 0x800471AE Kw_Ws16 799.9878 Prc -400.0000 399.9878 FORMAT "%8.4" /end CHARACTERISTIC
/begin CHARACTERISTIC VSwVlv_ATS.LimitTypeMsk_C "/" VALUE 0x8006FEBC Val_Wu8 255.0 OneToOne 0.00 255.0 FORMAT "%5.1" /end CHARACTERISTIC
/begin CHARACTERISTIC VSwVlv_ATS.CnvNorm_C "/" VALUE 0x8006FEBD Val_Wu8 255.0 OneToOne 0.00 255.0 FORMAT "%5.1" /end CHARACTERISTIC
/begin CHARACTERISTIC VSwVlv_ATS.CnvLimit_C "/" VALUE 0x8006FEBE Val_Wu8 255.0 OneToOne 0.00 255.0 FORMAT "%5.1" /end CHARACTERISTIC
/begin CHARACTERISTIC VSwVlv_ATS.LowLim_C "/" VALUE 0x8006FEC0 Val_Ws16 799.9878 Prc -400.0000 399.9878 FORMAT "%8.4" /end CHARACTERISTIC
/begin CHARACTERISTIC VSwVlv_ATS.UpLim_C "/" VALUE 0x8006FEC2 Val_Ws16 799.9878 Prc -400.0000 399.9878 FORMAT "%8.4" /end CHARACTERISTIC
/begin CHARACTERISTIC VSwVlv_ATS.CnvFac_C "/" VALUE 0x8006FEC4 Val_Ws32 4294967295.00 OneToOne -2147483648.00 2147483647.00 FORMAT "%13.2" /end CHARACTERISTIC
/begin CHARACTERISTIC VSwVlv_ATS.CnvOfs_C "/" VALUE 0x8006FEC8 Val_Ws16 65535.00 OneToOne -32768.00 32767.00 FORMAT "%8.2" /end CHARACTERISTIC
/begin CHARACTERISTIC VSwVlv_rB1_C "" VALUE 0x800471B0 Kw_Ws16 799.9878 Prc -400.0000 399.9878 FORMAT "%8.4" /end CHARACTERISTIC
/begin CHARACTERISTIC VSwVlv_rB2_C "" VALUE 0x800471B2 Kw_Ws16 799.9878 Prc -400.0000 399.9878 FORMAT "%8.4" /end CHARACTERISTIC
/begin CHARACTERISTIC WaHtEl_ATS.LimitTypeMsk_C "/" VALUE 0x8006FECC Val_Wu8 255.0 OneToOne 0.00 255.0 FORMAT "%5.1" /end CHARACTERISTIC
/begin CHARACTERISTIC WaHtEl_ATS.CnvNorm_C "/" VALUE 0x8006FECD Val_Wu8 255.0 OneToOne 0.00 255.0 FORMAT "%5.1" /end CHARACTERISTIC
/begin CHARACTERISTIC WaHtEl_ATS.CnvLimit_C "/" VALUE 0x8006FECE Val_Wu8 255.0 OneToOne 0.00 255.0 FORMAT "%5.1" /end CHARACTERISTIC
/begin CHARACTERISTIC WaHtEl_ATS.LowLim_C "/" VALUE 0x8006FED0 Val_Ws16 65535.00 OneToOne -32768.00 32767.00 FORMAT "%8.2" /end CHARACTERISTIC
/begin CHARACTERISTIC WaHtEl_ATS.UpLim_C "/" VALUE 0x8006FED2 Val_Ws16 65535.00 OneToOne -32768.00 32767.00 FORMAT "%8.2" /end CHARACTERISTIC
/begin CHARACTERISTIC WaHtEl_ATS.CnvFac_C "/" VALUE 0x8006FED4 Val_Ws32 4294967295.00 OneToOne -2147483648.00 2147483647.00 FORMAT "%13.2" /end CHARACTERISTIC
/begin CHARACTERISTIC WaHtEl_ATS.CnvOfs_C "/" VALUE 0x8006FED8 Val_Ws16 65535.00 OneToOne -32768.00 32767.00 FORMAT "%8.2" /end CHARACTERISTIC
/begin MEASUREMENT AFS_dmB1 "" SWORD AirMassPerTime 1 100 -3276.800 3276.700 FORMAT "%8.3" ECU_ADDRESS 0xD0006982 /end MEASUREMENT
/begin MEASUREMENT AFS_dmB2 "" SWORD AirMassPerTime 1 100 -3276.800 3276.700 FORMAT "%8.3" ECU_ADDRESS 0xD0006984 /end MEASUREMENT
/begin MEASUREMENT AFS_mAirPerCylB1 "" SWORD AirMassPerCyl 1 100 -3276.800 3276.700 FORMAT "%8.3" ECU_ADDRESS 0xD000698C /end MEASUREMENT
/begin MEASUREMENT AFS_mAirPerCylB2 "" SWORD AirMassPerCyl 1 100 -3276.800 3276.700 FORMAT "%8.3" ECU_ADDRESS 0xD000698E /end MEASUREMENT
/begin MEASUREMENT Air_pUnFltPCACDsB1 "" SWORD Pres_hPa 1 100 -32768.00 3500.00 FORMAT "%8.2" ECU_ADDRESS 0xD0006BD0 /end MEASUREMENT
/begin MEASUREMENT Air_pUnFltPCACDsB2 "" SWORD Pres_hPa 1 100 -32768.00 3500.00 FORMAT "%8.2" ECU_ADDRESS 0xD0006BD2 /end MEASUREMENT
/begin MEASUREMENT Air_tCACDsB1 "" SWORD Temp_Cels 1 100 -3549.940 3003.560 FORMAT "%8.3" ECU_ADDRESS 0xD0006BDE /end MEASUREMENT
/begin MEASUREMENT Air_tCACDsB2 "" SWORD Temp_Cels 1 100 -3549.940 3003.560 FORMAT "%8.3" ECU_ADDRESS 0xD0006BE0 /end MEASUREMENT
/begin MEASUREMENT ASDrf_CoefALADCurr_mp "Aktueller Kennwert für den Koeffizienten zweiter Ordnung der LSD Steigungsbegrenzung" SWORD ASDrf_LADCoefA 1 100 -160.0000 159.9951 FORMAT "%8.4" ECU_ADDRESS 0xC0000210 /end MEASUREMENT
/begin MEASUREMENT ASDrf_CoefBLADCurr_mp "Aktueller Kennwert für den Koeffizienten nullter Ordnung der LSD Steigungsbegrenzung" SWORD dTrq 1 100 -3276.800 3276.700 FORMAT "%8.3" ECU_ADDRESS 0xC0000212 /end MEASUREMENT
/begin MEASUREMENT ASDrf_dtrqDecrMax_mp "Max. Momentensteigung aufgrund der Gradientenbegrenzung bei Momentenabsenkung" SWORD dTrq 1 100 -3276.800 3276.700 FORMAT "%8.3" ECU_ADDRESS 0xC0000214 /end MEASUREMENT
/begin MEASUREMENT ASDrf_dtrqDecrMin_mp "Min. Momentensteigung aufgrund der Gradientenbegrenzung bei Momentenabsenkung" SWORD dTrq 1 100 -3276.800 3276.700 FORMAT "%8.3" ECU_ADDRESS 0xC0000216 /end MEASUREMENT
/begin MEASUREMENT ASDrf_dtrqInrLtd_mp "Zeitliche Ableitung von CoETS_trqInrLtd" SWORD dTrq 1 100 -3276.800 3276.700 FORMAT "%8.3" ECU_ADDRESS 0xC0000218 /end MEASUREMENT
/begin MEASUREMENT ASDrf_dtrqLosMax_mp "Max. Momentensteigung der Steigungsbegrenzung um das Verlustmoment" SWORD dTrq 1 100 -3276.800 3276.700 FORMAT "%8.3" ECU_ADDRESS 0xC000021A /end MEASUREMENT
/begin MEASUREMENT ASDrf_dtrqLosMin_mp "Min. Momentensteigung der Steigungsbegrenzung um das Verlustmoment" SWORD dTrq 1 100 -3276.800 3276.700 FORMAT "%8.3" ECU_ADDRESS 0xC000021C /end MEASUREMENT
/begin MEASUREMENT ASDrf_dtrqLtd_mp "Durch ASDrf_dtrqInrLtdLim_CUR begrenzte zeitliche Ableitung von CoETS_trqInrLtd" SLONG dTrq 1 100 -214748364.800 214748364.700 FORMAT "%13.3" ECU_ADDRESS 0xC0000220 /end MEASUREMENT
/begin MEASUREMENT ASDrf_dtrqMax_mp "Max. Momentensteigung in der Umgebung des Verlustmoments oder durch die Begrenzung bei Momentabsenkung" SWORD dTrq 1 100 -3276.800 3276.700 FORMAT "%8.3" ECU_ADDRESS 0xC0000224 /end MEASUREMENT
/begin MEASUREMENT ASDrf_dtrqMin_mp "Min. Momentensteigung in der Umgebung des Verlustmoments oder durch die Begrenzung bei Momentabsenkung" SWORD dTrq 1 100 -3276.800 3276.700 FORMAT "%8.3" ECU_ADDRESS 0xC0000226 /end MEASUREMENT
/begin MEASUREMENT ASDrf_KdFltCurr_mp "Aktueller Parameter Kd des ASD Führungsformers" SLONG Kd 1 100 -32768.0000000 32767.9999847 FORMAT "%13.7" ECU_ADDRESS 0xC0000228 /end MEASUREMENT
/begin MEASUREMENT ASDrf_stCon_mp "Zustand der Eingangsbedingungen (bitkodiert)" UWORD OneToOne 1 100 0.00 65535.00 FORMAT "%8.2" ECU_ADDRESS 0xC000026C /end MEASUREMENT
/begin MEASUREMENT ASDrf_stDecrLimSt_mp "Status des Zustandsautomaten für Steigungsbegrenzung bei Momentenabsenkung." UBYTE OneToOne 1 100 0.00 255.0 FORMAT "%5.1" ECU_ADDRESS 0xC000022C /end MEASUREMENT
/begin MEASUREMENT ASDrf_stIncrLim_mp "Aktueller Zustand für (flachen=1 / steilen = 0) Momentenanstieg." SWORD OneToOne 1 100 -32768.00 32767.00 FORMAT "%8.2" ECU_ADDRESS 0xC000022E /end MEASUREMENT
/begin MEASUREMENT ASDrf_stIni "Initialisierungsanforderungen / Quittierungen an PT1, PDT1-Glieder" UBYTE OneToOne 1 100 0.00 255.0 FORMAT "%5.1" ECU_ADDRESS 0xC000026A /end MEASUREMENT
/begin MEASUREMENT ASDrf_stInidtrqSteep_mp "Reinitialisierung bei Parametersatzänderung aktiv / inaktiv" UBYTE OneToOne 1 100 0.00 255.0 FORMAT "%5.1" ECU_ADDRESS 0xC0000230 /end MEASUREMENT
/begin MEASUREMENT ASDrf_stLAD "Zustandsvariable für den Automaten zur LSD Steuerung." UBYTE OneToOne 1 100 0.00 255.0 FORMAT "%5.1" ECU_ADDRESS 0xD0008EFD /end MEASUREMENT
/begin MEASUREMENT ASDrf_stPosNeg_mp "Aktueller pos. / neg. Zustand (pos. = 1 / neg. = 0)" UBYTE OneToOne 1 100 0.00 255.0 FORMAT "%5.1" ECU_ADDRESS 0xC0000231 /end MEASUREMENT
/begin MEASUREMENT ASDrf_stPrioSt_mp "Aktiver Zustand nach der Priorisierung (dezimal kodiert)" UWORD OneToOne 1 100 0.00 65535.00 FORMAT "%8.2" ECU_ADDRESS 0xC000026E /end MEASUREMENT
/begin MEASUREMENT ASDrf_stSelSt_mp "Ausgewählter Primärzustand (dezimal kodiert)" UWORD OneToOne 1 100 0.00 65535.00 FORMAT "%8.2" ECU_ADDRESS 0xC0000270 /end MEASUREMENT
/begin MEASUREMENT ASDrf_stTrqLim_mp "Zustand der Moment Gradientenbegrenzung (0 = inaktiv, 1 = aktiv)" UBYTE OneToOne 1 100 0.00 255.0 FORMAT "%5.1" ECU_ADDRESS 0xC0000232 /end MEASUREMENT
/begin MEASUREMENT ASDrf_stVldSt_mp "Auswertung der Primärzustände; konkurrierende Zustände möglich (bitkodiert)" UWORD OneToOne 1 100 0.00 65535.00 FORMAT "%8.2" ECU_ADDRESS 0xC0000272 /end MEASUREMENT
/begin MEASUREMENT ASDrf_T1FltCurr_mp "Aktueller Parameter T1 des ASD Führungsformers" ULONG TimeDelay_s 1 100 0.000001000000000 4294.9672960 FORMAT "%12.7" ECU_ADDRESS 0xC0000234 /end MEASUREMENT
/begin MEASUREMENT ASDrf_trqASDSum_mp "Aktuelles ASD Moment (Berechnung abhängig von ASDrf_swtCalcTrq_C)" SWORD Trq 1 100 -3276.800 3276.700 FORMAT "%8.3" ECU_ADDRESS 0xC0000238 /end MEASUREMENT
/begin MEASUREMENT ASDrf_trqCompOfs_mp "Offset auf den PT1 Eingang zur Polkompensation" SLONG Trq 1 100 -214748364.800 214748364.700 FORMAT "%13.3" ECU_ADDRESS 0xC000023C /end MEASUREMENT
/begin MEASUREMENT ASDrf_trqDecrLimStrt_mp "Startpunkt / Scheitelpunkt für die Steigungsbegrenzung bei Momentenabsenkung" SWORD Trq 1 100 -3276.800 3276.700 FORMAT "%8.3" ECU_ADDRESS 0xC0000240 /end MEASUREMENT
/begin MEASUREMENT ASDrf_trqIni_mp "Berechneter Initialisierungswert für PT1 Zustandsvariable" SWORD Trq 1 100 -3276.800 3276.700 FORMAT "%8.3" ECU_ADDRESS 0xC0000242 /end MEASUREMENT
/begin MEASUREMENT ASDrf_trqInrLtdFlt_mp "Gefiltertes Eingangssignal CoETS_trqInrLtd" SWORD Trq 1 100 -3276.800 3276.700 FORMAT "%8.3" ECU_ADDRESS 0xC0000244 /end MEASUREMENT
/begin MEASUREMENT ASDrf_trqInrSet "ASD Führungsformer Ausgangsmoment" SWORD Trq 1 100 -3276.800 3276.700 FORMAT "%8.3" ECU_ADDRESS 0xD00069A2 /end MEASUREMENT
/begin MEASUREMENT ASDrf_trqInrSetMaxUnLtd_mp "Aktuelle Obergrenze für ASDrf_trqInr vor der Begrenzung mit CoETS_trqInrLtd (abhängig von ASDrf_swtLim_C)" SLONG Trq32 1 100 -3276.80000000 3276.79999847 FORMAT "%13.8" ECU_ADDRESS 0xC0000248 /end MEASUREMENT
/begin MEASUREMENT ASDrf_trqInrSetMax_mp "Max. zulässiges Moment durch Steigungsbegrenzung" SLONG Trq32 1 100 -3276.80000000 3276.79999847 FORMAT "%13.8" ECU_ADDRESS 0xC000024C /end MEASUREMENT
/begin MEASUREMENT ASDrf_trqInrSetMinUnLtd_mp "Aktuelle Untergrenze für ASDrf_trqInr vor der Begrenzung mit 0 (abhängig von ASDrf_swtLim_C)" SLONG Trq32 1 100 -3276.80000000 3276.79999847 FORMAT "%13.8" ECU_ADDRESS 0xC0000250 /end MEASUREMENT
/begin MEASUREMENT ASDrf_trqInrSetMin_mp "Min. zulässiges Moment durch Steigungsbegrenzung" SLONG Trq32 1 100 -3276.80000000 3276.79999847 FORMAT "%13.8" ECU_ADDRESS 0xC0000254 /end MEASUREMENT
/begin MEASUREMENT ASDrf_trqInrSetUnLtd_mp "Ausgang des PDT1-Glieds, vor der Steigungsbegrenzung des ASD Führungsformers" SWORD Trq 1 100 -3276.800 3276.700 FORMAT "%8.3" ECU_ADDRESS 0xC0000258 /end MEASUREMENT
/begin MEASUREMENT ASDrf_trqLosNeg "Verlustmoment bei negativem Zustand von CoETS_trqInrLtd" SWORD Trq 1 100 -3276.800 3276.700 FORMAT "%8.3" ECU_ADDRESS 0xD00069A4 /end MEASUREMENT
/begin MEASUREMENT ASDrf_trqLosPos "Verlustmoment bei positivem Zustand von CoETS_trqInrLtd" SWORD Trq 1 100 -3276.800 3276.700 FORMAT "%8.3" ECU_ADDRESS 0xD00069A6 /end MEASUREMENT
/begin MEASUREMENT ASDrf_trqLos_mp "Aktuelles Verlustmoment inklusive Nebenaggregate" SWORD Trq 1 100 -3276.800 3276.700 FORMAT "%8.3" ECU_ADDRESS 0xC000025A /end MEASUREMENT
/begin MEASUREMENT ASDrf_trqPT1In_mp "Aktueller PT1 Eingangswert" SLONG Trq 1 100 -214748364.800 214748364.700 FORMAT "%13.3" ECU_ADDRESS 0xC000025C /end MEASUREMENT
/begin MEASUREMENT ASDrf_trqPT1Out_mp "Aktueller PT1 Ausgangswert" SWORD Trq 1 100 -3276.800 3276.700 FORMAT "%8.3" ECU_ADDRESS 0xC0000260 /end MEASUREMENT
/begin MEASUREMENT ASDrf_trqPT1P_mp "Ausgang P-Anteil in PT1 gefiltertem Signal" SWORD Trq 1 100 -3276.800 3276.700 FORMAT "%8.3" ECU_ADDRESS 0xC0000262 /end MEASUREMENT
/begin MEASUREMENT ASDrf_trqP_mp "Ausgang ASD Führungsformer P-Anteil" SWORD Trq 1 100 -3276.800 3276.700 FORMAT "%8.3" ECU_ADDRESS 0xC0000264 /end MEASUREMENT
/begin MEASUREMENT ASDrf_trqStyHi_mp "Obere Grenze des Momentenintervalls für die Erkennung eines stationären Zustands" SWORD Trq 1 100 -3276.800 3276.700 FORMAT "%8.3" ECU_ADDRESS 0xC0000266 /end MEASUREMENT
/begin MEASUREMENT ASDrf_trqStyLo_mp "Untere Grenze des Momentenintervalls für die Erkennung eines stationären Zustands" SWORD Trq 1 100 -3276.800 3276.700 FORMAT "%8.3" ECU_ADDRESS 0xC0000268 /end MEASUREMENT
/begin MEASUREMENT ASMod_arEffTVA_mp "effektive Querschnittsfläche der Drosselklappe" SWORD Area_cm2 1 100 -32.76800 32.76700 FORMAT "%8.5" ECU_ADDRESS 0xC00002DC /end MEASUREMENT
/begin MEASUREMENT ASMod_arPipeSlw_mp "Oberfläche Rohrstück" SWORD Area 1 100 -4.000000 3.999878 FORMAT "%8.6" ARRAY_SIZE 4 ECU_ADDRESS 0xC0000412 /end MEASUREMENT
/begin MEASUREMENT ASMod_arPipe_mp "Oberfläche Rohrstück" SWORD Area 1 100 -4.000000 3.999878 FORMAT "%8.6" ARRAY_SIZE 3 ECU_ADDRESS 0xC0000360 /end MEASUREMENT
/begin MEASUREMENT ASMod_cndHtAirSlw_mp "Wärmeleitfähigkeit der Luft" SWORD Fact 1 100 -4.000000 3.999878 FORMAT "%8.6" ARRAY_SIZE 4 ECU_ADDRESS 0xC000041A /end MEASUREMENT
/begin MEASUREMENT ASMod_cndHtAir_mp "Wärmeleitfähigkeit der Luft" SWORD Fact 1 100 -4.000000 3.999878 FORMAT "%8.6" ARRAY_SIZE 3 ECU_ADDRESS 0xC0000366 /end MEASUREMENT
/begin MEASUREMENT ASMod_cndHtEGSlw_mp "Wärmeleitfähigkeit Abgas" SWORD Fact 1 100 -4.000000 3.999878 FORMAT "%8.6" ARRAY_SIZE 4 ECU_ADDRESS 0xC0000422 /end MEASUREMENT
/begin MEASUREMENT ASMod_cndHtEG_mp "Wärmeleitfähigkeit Abgas" SWORD Fact 1 100 -4.000000 3.999878 FORMAT "%8.6" ARRAY_SIZE 3 ECU_ADDRESS 0xC000036C /end MEASUREMENT
/begin MEASUREMENT ASMod_dmAFSCor "korrigierter Frischluftmassenstrom" SWORD AirMassPerTime 1 100 -3276.800 3276.700 FORMAT "%8.3" ECU_ADDRESS 0xD00069AC /end MEASUREMENT
/begin MEASUREMENT ASMod_dmAshEG_mp "Aschemassenstrom nach Verbrennung" SWORD AshMassPerTime 1 100 -327.6800 327.6700 FORMAT "%8.4" ECU_ADDRESS 0xC0000286 /end MEASUREMENT
/begin MEASUREMENT ASMod_dmEGFld "Abgasmassenstrom-Feld" SWORD AirMassPerTime 1 100 -3276.800 3276.700 FORMAT "%8.3" ARRAY_SIZE 7 ECU_ADDRESS 0xD00069B2 /end MEASUREMENT
/begin MEASUREMENT ASMod_dmEGRDs "rückgeführter Abgasmassenstrom nach ARF-Kühler" SWORD AirMassPerTime 1 100 -3276.800 3276.700 FORMAT "%8.3" ECU_ADDRESS 0xD00069C0 /end MEASUREMENT
/begin MEASUREMENT ASMod_dmEGR_mp "rückgeführter Abgasmassenstrom" SWORD AirMassPerTime 1 100 -3276.800 3276.700 FORMAT "%8.3" ECU_ADDRESS 0xC000027A /end MEASUREMENT
/begin MEASUREMENT ASMod_dmEG_mp "Abgasmassenstrom nach Verbrennung" SWORD AirMassPerTime 1 100 -3276.800 3276.700 FORMAT "%8.3" ECU_ADDRESS 0xC0000288 /end MEASUREMENT
/begin MEASUREMENT ASMod_dmExhMnfDs "Abgasmassenstrom nach Abgaskrümmer" SWORD AirMassPerTime 1 100 -3276.800 3276.700 FORMAT "%8.3" ECU_ADDRESS 0xD00069C2 /end MEASUREMENT
/begin MEASUREMENT ASMod_dmExhMnfUs "Abgasmassenstrom vor Abgaskrümmer" SWORD AirMassPerTime 1 100 -3276.800 3276.700 FORMAT "%8.3" ECU_ADDRESS 0xD00069C8 /end MEASUREMENT
/begin MEASUREMENT ASMod_dmFlBrn_mp "Massenstrom des verbrannten Kraftstoffs" SWORD InjMassPerTime 1 100 -327.6800 327.6700 FORMAT "%8.4" ECU_ADDRESS 0xC000028A /end MEASUREMENT
/begin MEASUREMENT ASMod_dmFlCmbEffOxiC_mp "" SWORD InjMassPerTime 1 100 -327.6800 327.6700 FORMAT "%8.4" ECU_ADDRESS 0xC0000328 /end MEASUREMENT
/begin MEASUREMENT ASMod_dmFlCmbOxiC_mp "" SWORD InjMassPerTime 1 100 -327.6800 327.6700 FORMAT "%8.4" ECU_ADDRESS 0xC000032A /end MEASUREMENT
/begin MEASUREMENT ASMod_dmFlEG_mp "Kraftstoffmassenstrom nach Verbrennung" SWORD InjMassPerTime 1 100 -327.6800 327.6700 FORMAT "%8.4" ECU_ADDRESS 0xC000028C /end MEASUREMENT
/begin MEASUREMENT ASMod_dmFlInjCmb_mp "an Verbrennung teilnehmender Kraftstoffmassenstrom" SWORD InjMassPerTime 1 100 -327.6800 327.6700 FORMAT "%8.4" ECU_ADDRESS 0xC000028E /end MEASUREMENT
/begin MEASUREMENT ASMod_dmFlInjNoCmb_mp "an Verbrennung nicht teilnehmender Kraftstoffmassenstrom" SWORD InjMassPerTime 1 100 -327.6800 327.6700 FORMAT "%8.4" ECU_ADDRESS 0xC0000290 /end MEASUREMENT
/begin MEASUREMENT ASMod_dmFlNoBrn_mp "bei Verbrennung nicht umgesetzter Kraftstoffmassenstrom" SWORD InjMassPerTime 1 100 -327.6800 327.6700 FORMAT "%8.4" ECU_ADDRESS 0xC0000292 /end MEASUREMENT
/begin MEASUREMENT ASMod_dmIndAirRef "Referenzgasmassenstrom in den Motor" SWORD AirMassPerTime 1 100 -3276.800 3276.700 FORMAT "%8.3" ECU_ADDRESS 0xD00069CE /end MEASUREMENT
/begin MEASUREMENT ASMod_dmIndVolRaw_mp "zeitliche Änderung der Gasmasse im Einlassvolumen (Rohwert)" SWORD AirMassPerTime 1 100 -3276.800 3276.700 FORMAT "%8.3" ECU_ADDRESS 0xC00002DE /end MEASUREMENT
/begin MEASUREMENT ASMod_dmIndVol_mp "zeitliche Änderung der Gasmasse im Einlassvolumen" SWORD AirMassPerTime 1 100 -3276.800 3276.700 FORMAT "%8.3" ECU_ADDRESS 0xC00002E0 /end MEASUREMENT
/begin MEASUREMENT ASMod_dmIntMnfDs "Gasmassenstrom nach Einlasskrümmer" SWORD AirMassPerTime 1 100 -3276.800 3276.700 FORMAT "%8.3" ECU_ADDRESS 0xD00069D4 /end MEASUREMENT
/begin MEASUREMENT ASMod_dmIntMnfDsRef_mp "referenz des Gasmassenstroms nach Einlasskrümmer" SWORD AirMassPerTime 1 100 -3276.800 3276.700 FORMAT "%8.3" ECU_ADDRESS 0xC0000294 /end MEASUREMENT
/begin MEASUREMENT ASMod_dmIntMnfUs "Gasmassenstrom in den Einlasskrümmer" SWORD AirMassPerTime 1 100 -3276.800 3276.700 FORMAT "%8.3" ECU_ADDRESS 0xD00069DA /end MEASUREMENT
/begin MEASUREMENT ASMod_dmNOxBas_mp "Basis-NOx-Massenstrom ohne ARF" SWORD NOxMassPerTime 1 100 -3276.800 3276.700 FORMAT "%8.3" ECU_ADDRESS 0xC0000296 /end MEASUREMENT
/begin MEASUREMENT ASMod_dmNOxEG_mp "NOx-Massenstrom nach Verbrennung" SWORD NOxMassPerTime 1 100 -3276.800 3276.700 FORMAT "%8.3" ECU_ADDRESS 0xC0000298 /end MEASUREMENT
/begin MEASUREMENT ASMod_dmNOxRatEGRCorBas_mp "Basis-NOx-Massenstrom für betriebspunktabhängige ARF-Korrektur" SWORD NOxMassPerTime 1 100 -3276.800 3276.700 FORMAT "%8.3" ECU_ADDRESS 0xC000029A /end MEASUREMENT
/begin MEASUREMENT ASMod_dmNOxRatEGRCor_mp "NOx-Massenstrom für betriebspunktabhängige ARF-Korrektur" SWORD NOxMassPerTime 1 100 -3276.800 3276.700 FORMAT "%8.3" ECU_ADDRESS 0xC000029C /end MEASUREMENT
/begin MEASUREMENT ASMod_dmO2EG_mp "Sauerstoffmassenstrom nach Verbrennung" SWORD O2MassPerTime 1 100 -327.6800 327.6700 FORMAT "%8.4" ECU_ADDRESS 0xC000029E /end MEASUREMENT
/begin MEASUREMENT ASMod_dmO2IntMnfDs "Sauerstoffmassenstrom nach Einlasskrümmer" SWORD O2MassPerTime 1 100 -327.6800 327.6700 FORMAT "%8.4" ECU_ADDRESS 0xD00069DE /end MEASUREMENT
/begin MEASUREMENT ASMod_dmO2OxiCDiff "" SWORD O2MassPerTime 1 100 -327.6800 327.6700 FORMAT "%8.4" ECU_ADDRESS 0xD00069E4 /end MEASUREMENT
/begin MEASUREMENT ASMod_dmO2OxiCDs_mp "" SWORD O2MassPerTime 1 100 -327.6800 327.6700 FORMAT "%8.4" ECU_ADDRESS 0xC000032C /end MEASUREMENT
/begin MEASUREMENT ASMod_dmO2OxiC_mp "" SWORD O2MassPerTime 1 100 -327.6800 327.6700 FORMAT "%8.4" ECU_ADDRESS 0xC000032E /end MEASUREMENT
/begin MEASUREMENT ASMod_dmOilCons "Massenstrom für den Ölverbrauch des Motors" SWORD OilMassPerTime 1 100 -3.276800 3.276700 FORMAT "%8.6" ECU_ADDRESS 0xD00069EA /end MEASUREMENT
/begin MEASUREMENT ASMod_dmOilConsBas_mp "Basis-Massenstrom für den Ölverbrauch des Motors" SWORD OilMassPerTime 1 100 -3.276800 3.276700 FORMAT "%8.6" ECU_ADDRESS 0xC00002A0 /end MEASUREMENT
/begin MEASUREMENT ASMod_dmOilConsCrvIn_mp "" SWORD OilMassPerTime 1 100 -3.276800 3.276700 FORMAT "%8.6" ECU_ADDRESS 0xC00002A2 /end MEASUREMENT
/begin MEASUREMENT ASMod_dmPFltUs "" SWORD AirMassPerTime 1 100 -3276.800 3276.700 FORMAT "%8.3" ECU_ADDRESS 0xD00069F0 /end MEASUREMENT
/begin MEASUREMENT ASMod_dmPFltUsCrvIn_mp "" SWORD AirMassPerTime 1 100 -3276.800 3276.700 FORMAT "%8.3" ECU_ADDRESS 0xC0000348 /end MEASUREMENT
/begin MEASUREMENT ASMod_dmSotBas_mp "Basis-Rußmassenstrom ohne ARF" SWORD SotMassPerTime 1 100 -327.6800 327.6700 FORMAT "%8.4" ECU_ADDRESS 0xC00002A4 /end MEASUREMENT
/begin MEASUREMENT ASMod_dmSotCor_mp "ARF-korrigierter Rußmassenstrom" SWORD SotMassPerTime 1 100 -327.6800 327.6700 FORMAT "%8.4" ECU_ADDRESS 0xC00002A6 /end MEASUREMENT
/begin MEASUREMENT ASMod_dmSotEG_mp "Rußmassenstrom nach Verbrennung" SWORD SotMassPerTime 1 100 -327.6800 327.6700 FORMAT "%8.4" ECU_ADDRESS 0xC00002A8 /end MEASUREMENT
/begin MEASUREMENT ASMod_dmSotLamCor_mp "Rußmassenstrom Korrekturwert in Abhängigkeit von Lambda" SWORD SotMassPerTime 1 100 -327.6800 327.6700 FORMAT "%8.4" ECU_ADDRESS 0xC00002AA /end MEASUREMENT
/begin MEASUREMENT ASMod_dmSotRatEGRCorBas_mp "Basis-Rußmassenstrom für betriebspunktabhängige ARF-Korrektur" SWORD SotMassPerTime 1 100 -327.6800 327.6700 FORMAT "%8.4" ECU_ADDRESS 0xC00002AC /end MEASUREMENT
/begin MEASUREMENT ASMod_dmSotRatEGRCor_mp "Rußmassenstrom für betriebspunktabhängige ARF-Korrektur" SWORD SotMassPerTime 1 100 -327.6800 327.6700 FORMAT "%8.4" ECU_ADDRESS 0xC00002AE /end MEASUREMENT
/begin MEASUREMENT ASMod_dmSOxEG_mp "Schwefeloxidmassenstrom nach Verbrennung aufgrund von Ölverbrauch" SWORD SOxMassPerTime 1 100 -3.276800 3.276700 FORMAT "%8.6" ECU_ADDRESS 0xC00002B0 /end MEASUREMENT
/begin MEASUREMENT ASMod_dpExhGsMap_mp "" SWORD Pres_hPa 1 100 -32768.00 3500.00 FORMAT "%8.2" ARRAY_SIZE 4 ECU_ADDRESS 0xC00002EE /end MEASUREMENT
/begin MEASUREMENT ASMod_dpExhGsSim_mp "" SWORD Pres_hPa 1 100 -32768.00 3500.00 FORMAT "%8.2" ARRAY_SIZE 4 ECU_ADDRESS 0xC00002F6 /end MEASUREMENT
/begin MEASUREMENT ASMod_dtPipeSlw_mp "Temperaturänderung Rohrstück" SWORD Temp_Kelv_Sec 1 100 -327.6800 327.6700 FORMAT "%8.4" ARRAY_SIZE 4 ECU_ADDRESS 0xC000042A /end MEASUREMENT
/begin MEASUREMENT ASMod_dtPipe_mp "Temperaturänderung Rohrstück" SWORD Temp_Kelv_Sec 1 100 -327.6800 327.6700 FORMAT "%8.4" ARRAY_SIZE 3 ECU_ADDRESS 0xC0000372 /end MEASUREMENT
/begin MEASUREMENT ASMod_dVolEGPipe1_mp "" SWORD AirVolPerTime 1 100 -3276.800 3276.700 FORMAT "%8.3" ECU_ADDRESS 0xC00002E8 /end MEASUREMENT
/begin MEASUREMENT ASMod_dVolEGPipe_mp "Abgasvolumenstrom zur Druckberechnung im Abgassystem" SWORD AirVolPerTime 1 100 -3276.800 3276.700 FORMAT "%8.3" ARRAY_SIZE 4 ECU_ADDRESS 0xC00002FE /end MEASUREMENT
/begin MEASUREMENT ASMod_dvolIntMnfDsRaw_mp "Rohwert des Volumenstroms nach Einlasskrümmer" SWORD AirVolPerTime 1 100 -3276.800 3276.700 FORMAT "%8.3" ECU_ADDRESS 0xC0000564 /end MEASUREMENT
/begin MEASUREMENT ASMod_dvolIntMnfDsRef "Referenzgasvolumenstrom nach Einlasskrümmer" SWORD AirVolPerTime 1 100 -3276.800 3276.700 FORMAT "%8.3" ECU_ADDRESS 0xD00069F8 /end MEASUREMENT
/begin MEASUREMENT ASMod_dvolPFltEG "berechneter Abgasvolumenstrom im Partikelfilter" SWORD AirVolPerTime 1 100 -3276.800 3276.700 FORMAT "%8.3" ECU_ADDRESS 0xD00069FE /end MEASUREMENT
/begin MEASUREMENT ASMod_dwEGPipeSlw_mp "Wärmestrom zwischen Gas und Rohrwand" SWORD Pwr1 1 100 -3276.800 3276.700 FORMAT "%8.3" ARRAY_SIZE 4 ECU_ADDRESS 0xC0000432 /end MEASUREMENT
/begin MEASUREMENT ASMod_dwEGPipe_mp "Wärmestrom zwischen Gas und Rohrwand" SWORD Pwr1 1 100 -3276.800 3276.700 FORMAT "%8.3" ARRAY_SIZE 3 ECU_ADDRESS 0xC0000378 /end MEASUREMENT
/begin MEASUREMENT ASMod_dwFlCmb_mp "Wärmestrom durch spät nacheingespritzte Kraftstoffmenge" SLONG Pwr1 1 100 -214748364.800 214748364.700 FORMAT "%13.3" ECU_ADDRESS 0xC0000330 /end MEASUREMENT
/begin MEASUREMENT ASMod_dwPipeEnvSlw_mp "Wärmestrom zwischen Rohrwand und Umgebung" SWORD Pwr1 1 100 -3276.800 3276.700 FORMAT "%8.3" ARRAY_SIZE 4 ECU_ADDRESS 0xC000043A /end MEASUREMENT
/begin MEASUREMENT ASMod_dwPipeEnv_mp "Wärmestrom zwischen Rohrwand und Umgebung" SWORD Pwr1 1 100 -3276.800 3276.700 FORMAT "%8.3" ARRAY_SIZE 3 ECU_ADDRESS 0xC000037E /end MEASUREMENT
/begin MEASUREMENT ASMod_dwPipeInSlw_mp "Wärmestrom am Rohreinlass" SLONG Pwr1 1 100 -214748364.800 214748364.700 FORMAT "%13.3" ARRAY_SIZE 4 ECU_ADDRESS 0xC0000444 /end MEASUREMENT
/begin MEASUREMENT ASMod_dwPipeIn_mp "Wärmestrom am Rohreinlass" SLONG Pwr1 1 100 -214748364.800 214748364.700 FORMAT "%13.3" ARRAY_SIZE 3 ECU_ADDRESS 0xC0000384 /end MEASUREMENT
/begin MEASUREMENT ASMod_dwPipeOutSlw_mp "Wärmestrom am Rohrauslass" SLONG Pwr1 1 100 -214748364.800 214748364.700 FORMAT "%13.3" ARRAY_SIZE 4 ECU_ADDRESS 0xC0000454 /end MEASUREMENT
/begin MEASUREMENT ASMod_dwPipeOut_mp "Wärmestrom am Rohrauslass" SLONG Pwr1 1 100 -214748364.800 214748364.700 FORMAT "%13.3" ARRAY_SIZE 3 ECU_ADDRESS 0xC0000390 /end MEASUREMENT
/begin MEASUREMENT ASMod_dwPipeSlw_mp "Wärmeänderung Rohrstück" SLONG Pwr1 1 100 -214748364.800 214748364.700 FORMAT "%13.3" ARRAY_SIZE 4 ECU_ADDRESS 0xC0000464 /end MEASUREMENT
/begin MEASUREMENT ASMod_dwPipe_mp "Wärmeänderung Rohrstück" SLONG Pwr1 1 100 -214748364.800 214748364.700 FORMAT "%13.3" ARRAY_SIZE 3 ECU_ADDRESS 0xC000039C /end MEASUREMENT
/begin MEASUREMENT ASMod_etaEGRClg_mp "Wirkungsgrad des ARF-Kühlers" SWORD Fact 1 100 -4.000000 3.999878 FORMAT "%8.6" ECU_ADDRESS 0xC000027C /end MEASUREMENT
/begin MEASUREMENT ASMod_etaTrbCh_mp "Gesamtwirkungsgrad Turbolader" SWORD Fact 1 100 -4.000000 3.999878 FORMAT "%8.6" ECU_ADDRESS 0xC0000552 /end MEASUREMENT
/begin MEASUREMENT ASMod_facArgSqr_mp "Argument der Wurzel zur Berechnung des Drucks im Einlasskrümmer" SWORD Fact 1 100 -4.000000 3.999878 FORMAT "%8.6" ECU_ADDRESS 0xC00002E2 /end MEASUREMENT
/begin MEASUREMENT ASMod_facEGTempMsFlwCor_mp "Korrekturfaktor der Temperaturerhöhung aufgrund des aktuellen Gasmassenstroms" SWORD Fact 1 100 -4.000000 3.999878 FORMAT "%8.6" ECU_ADDRESS 0xC00002B2 /end MEASUREMENT
/begin MEASUREMENT ASMod_facEGTempSOICor_mp "Korrekturfaktor der Temperaturerhöhung aufgrund des aktuellen Spritzbeginns" SWORD Fact 1 100 -4.000000 3.999878 FORMAT "%8.6" ECU_ADDRESS 0xC00002B4 /end MEASUREMENT
/begin MEASUREMENT ASMod_facNOxRatEGRCor_mp "Faktor für ARF-Ratenkorektur des NOx-massenstroms" SWORD Fact 1 100 -4.000000 3.999878 FORMAT "%8.6" ECU_ADDRESS 0xC00002B6 /end MEASUREMENT
/begin MEASUREMENT ASMod_facPowEGPipe_mp "" SWORD Fact1 1 100 -256.0000 255.9922 FORMAT "%8.4" ARRAY_SIZE 4 ECU_ADDRESS 0xC0000306 /end MEASUREMENT
/begin MEASUREMENT ASMod_facPT1_mp "" SWORD Fact1 1 100 -256.0000 255.9922 FORMAT "%8.4" ECU_ADDRESS 0xC0000334 /end MEASUREMENT
/begin MEASUREMENT ASMod_facRhoEtaEGPipe_mp "" SWORD Fact 1 100 -4.000000 3.999878 FORMAT "%8.6" ARRAY_SIZE 4 ECU_ADDRESS 0xC000030E /end MEASUREMENT
/begin MEASUREMENT ASMod_facSotRatEGRCor_mp "Faktor für ARF-Ratenkorektur des Rußmassenstroms" SWORD Fact 1 100 -4.000000 3.999878 FORMAT "%8.6" ECU_ADDRESS 0xC00002B8 /end MEASUREMENT
/begin MEASUREMENT ASMod_facSqr_mp "Wurzelfunktion als Kennlinie zur Berechnung des Drucks im Einlasskrümmer" SWORD Fact 1 100 -4.000000 3.999878 FORMAT "%8.6" ECU_ADDRESS 0xC00002E4 /end MEASUREMENT
/begin MEASUREMENT ASMod_facTempClg1_mp "" SWORD Fact 1 100 -4.000000 3.999878 FORMAT "%8.6" ARRAY_SIZE 7 ECU_ADDRESS 0xC00004FC /end MEASUREMENT
/begin MEASUREMENT ASMod_facTempClgNSC_mp "" SWORD Fact 1 100 -4.000000 3.999878 FORMAT "%8.6" ECU_ADDRESS 0xC000050A /end MEASUREMENT
/begin MEASUREMENT ASMod_facTempClgOxiC_mp "" SWORD Fact 1 100 -4.000000 3.999878 FORMAT "%8.6" ECU_ADDRESS 0xC000050C /end MEASUREMENT
/begin MEASUREMENT ASMod_facTrbnPT1_mp "Variabler Faktor für Turbolader-Temperaturmodell" SWORD Fact_PT1 1 100 -256.0000 255.9922 FORMAT "%8.4" ECU_ADDRESS 0xC0000554 /end MEASUREMENT
/begin MEASUREMENT ASMod_facVolEff "Luftaufwand des Motors" SWORD RatAirMass 1 100 -327.6800 327.6700 FORMAT "%8.4" ECU_ADDRESS 0xD0006A04 /end MEASUREMENT
/begin MEASUREMENT ASMod_facVolEffBasCor_mp "korrigierter Basiswert für Luftaufwand des Motors" SWORD RatAirMass 1 100 -327.6800 327.6700 FORMAT "%8.4" ECU_ADDRESS 0xC0000568 /end MEASUREMENT
/begin MEASUREMENT ASMod_facVolEffBas_mp "Basiswert für Luftaufwand des Motors" SWORD RatAirMass 1 100 -327.6800 327.6700 FORMAT "%8.4" ECU_ADDRESS 0xC000056A /end MEASUREMENT
/begin MEASUREMENT ASMod_facVolEffTempCor_mp "Korrekturfaktor für Luftaufwand aufgrund der" SWORD RatAirMass 1 100 -327.6800 327.6700 FORMAT "%8.4" ECU_ADDRESS 0xC000056C /end MEASUREMENT
/begin MEASUREMENT ASMod_facVolEffVSACor_mp "Korrekturfaktor für Luftaufwand aufgrund der aktuellen Drallklappenposition" SWORD RatAirMass 1 100 -327.6800 327.6700 FORMAT "%8.4" ECU_ADDRESS 0xC000056E /end MEASUREMENT
/begin MEASUREMENT ASMod_htcArEGPipeSlw_mp "Wärmeübergangsleitwert zwischen Gas und Rohrwand" SWORD ThermalCoEff 1 100 -3276.800 3276.700 FORMAT "%8.3" ARRAY_SIZE 4 ECU_ADDRESS 0xC0000474 /end MEASUREMENT
/begin MEASUREMENT ASMod_htcArEGPipe_mp "Wärmeübergangsleitwert zwischen Gas und Rohrwand" SWORD ThermalCoEff 1 100 -3276.800 3276.700 FORMAT "%8.3" ARRAY_SIZE 3 ECU_ADDRESS 0xC00003A8 /end MEASUREMENT
/begin MEASUREMENT ASMod_htcArPipeEnvSlw_mp "Wärmeübergangsleitwert zwischen Rohrwand und Umgebung" SWORD ThermalCoEff 1 100 -3276.800 3276.700 FORMAT "%8.3" ARRAY_SIZE 4 ECU_ADDRESS 0xC000047C /end MEASUREMENT
/begin MEASUREMENT ASMod_htcArPipeEnv_mp "Wärmeübergangsleitwert zwischen Rohrwand und Umgebung" SWORD ThermalCoEff 1 100 -3276.800 3276.700 FORMAT "%8.3" ARRAY_SIZE 3 ECU_ADDRESS 0xC00003AE /end MEASUREMENT
/begin MEASUREMENT ASMod_htcEGPipeSlw_mp "Wärmeübergangskoeffizient zwischen Gas und Rohrwand" SWORD ThermalCoEff 1 100 -3276.800 3276.700 FORMAT "%8.3" ARRAY_SIZE 4 ECU_ADDRESS 0xC0000484 /end MEASUREMENT
/begin MEASUREMENT ASMod_htcEGPipe_mp "Wärmeübergangskoeffizient zwischen Gas und Rohrwand" SWORD ThermalCoEff 1 100 -3276.800 3276.700 FORMAT "%8.3" ARRAY_SIZE 3 ECU_ADDRESS 0xC00003B4 /end MEASUREMENT
/begin MEASUREMENT ASMod_htcPipeEnvSlw_mp "Wärmeübergangskoeffizient zwischen Rohrwand und Umgebung" SWORD ThermalCoEff 1 100 -3276.800 3276.700 FORMAT "%8.3" ARRAY_SIZE 4 ECU_ADDRESS 0xC000048C /end MEASUREMENT
/begin MEASUREMENT ASMod_htcPipeEnv_mp "Wärmeübergangskoeffizient zwischen Rohrwand und Umgebung" SWORD ThermalCoEff 1 100 -3276.800 3276.700 FORMAT "%8.3" ARRAY_SIZE 3 ECU_ADDRESS 0xC00003BA /end MEASUREMENT
/begin MEASUREMENT ASMod_htcPipeSlw_mp "" SWORD ThermalCoEff 1 100 -3276.800 3276.700 FORMAT "%8.3" ARRAY_SIZE 4 ECU_ADDRESS 0xC0000494 /end MEASUREMENT
/begin MEASUREMENT ASMod_htcPipe_mp "" SWORD ThermalCoEff 1 100 -3276.800 3276.700 FORMAT "%8.3" ARRAY_SIZE 3 ECU_ADDRESS 0xC00003C0 /end MEASUREMENT
/begin MEASUREMENT ASMod_mAirPerCylCor "dynamisch korrigierte Luftmasse pro Zylinder (vor Mischstelle im Einlasskrümmer)" SWORD AirMassPerCyl 1 100 -3276.800 3276.700 FORMAT "%8.3" ECU_ADDRESS 0xD0006A0A /end MEASUREMENT
/begin MEASUREMENT ASMod_mIndVol_mp "im Eilassvolumen (Volumen zwischen Verdichter und Mischstelle) gespeicherte Luftmasse" SWORD AirMass 1 100 -327.6800 327.6700 FORMAT "%8.4" ECU_ADDRESS 0xC00002E6 /end MEASUREMENT
/begin MEASUREMENT ASMod_nuPipeEnvSlw_mp "Nusseltzahl zwischen Rohrwand und Umgebung" SWORD OneToOne 1 100 -32768.00 32767.00 FORMAT "%8.2" ARRAY_SIZE 4 ECU_ADDRESS 0xC000049C /end MEASUREMENT
/begin MEASUREMENT ASMod_nuPipeEnv_mp "Nusseltzahl zwischen Rohrwand und Umgebung" SWORD OneToOne 1 100 -32768.00 32767.00 FORMAT "%8.2" ARRAY_SIZE 3 ECU_ADDRESS 0xC00003C6 /end MEASUREMENT
/begin MEASUREMENT ASMod_nuPipeSlw_mp "Nusseltzahl im Rohrstück" SWORD OneToOne 1 100 -32768.00 32767.00 FORMAT "%8.2" ARRAY_SIZE 4 ECU_ADDRESS 0xC00004A4 /end MEASUREMENT
/begin MEASUREMENT ASMod_nuPipe_mp "Nusseltzahl im Rohrstück" SWORD OneToOne 1 100 -32768.00 32767.00 FORMAT "%8.2" ARRAY_SIZE 3 ECU_ADDRESS 0xC00003CC /end MEASUREMENT
/begin MEASUREMENT ASMod_pDiffEGPipe_mp "Druckdifferenz über ein Rohrstück" SWORD Pres_hPa 1 100 -32768.00 3500.00 FORMAT "%8.2" ARRAY_SIZE 4 ECU_ADDRESS 0xC0000316 /end MEASUREMENT
/begin MEASUREMENT ASMod_pEGFld "Abgasgegendruck-Feld" SWORD Pres_hPa 1 100 -32768.00 3500.00 FORMAT "%8.2" ARRAY_SIZE 8 ECU_ADDRESS 0xD0006A0E /end MEASUREMENT
/begin MEASUREMENT ASMod_pEGFld_mp "" SWORD Pres_hPa 1 100 -32768.00 3500.00 FORMAT "%8.2" ECU_ADDRESS 0xC00002EA /end MEASUREMENT
/begin MEASUREMENT ASMod_phiDiffSOIRef_mp "Abweichung von der Referenz des Spritzbeginns der MI1" SWORD AngleCrS 1 100 -720.0220 720.0000 FORMAT "%8.4" ECU_ADDRESS 0xC00002BA /end MEASUREMENT
/begin MEASUREMENT ASMod_phiSOIRef_mp "referenz des Spritzbeginns der MI1" SWORD AngleCrS 1 100 -720.0220 720.0000 FORMAT "%8.4" ECU_ADDRESS 0xC00002BC /end MEASUREMENT
/begin MEASUREMENT ASMod_pIntMnf "Druck im Einlasskrümmer" SWORD Pres_hPa 1 100 -32768.00 3500.00 FORMAT "%8.2" ECU_ADDRESS 0xD0006A1E /end MEASUREMENT
/begin MEASUREMENT ASMod_pMidPFlt "Druck im Partikelfilter" SWORD Pres_hPa 1 100 -32768.00 3500.00 FORMAT "%8.2" ECU_ADDRESS 0xD0006A20 /end MEASUREMENT
/begin MEASUREMENT ASMod_pPFltSimDs "Druck nach Partikelfilter" SWORD Pres_hPa 1 100 -32768.00 3500.00 FORMAT "%8.2" ECU_ADDRESS 0xD0006A26 /end MEASUREMENT
/begin MEASUREMENT ASMod_pPFltUs_mp "Druck vor Partikelfilter" SWORD Pres_hPa 1 100 -32768.00 3500.00 FORMAT "%8.2" ECU_ADDRESS 0xC000034A /end MEASUREMENT
/begin MEASUREMENT ASMod_pwrCmpr_mp "Verdichterleistung" SWORD Pwr 1 100 -308831.1 308821.7 FORMAT "%8.1" ECU_ADDRESS 0xC0000556 /end MEASUREMENT
/begin MEASUREMENT ASMod_qBrn_mp "verbrannte Kraftstoffmenge" SWORD InjMass 1 100 -327.6800 327.6700 FORMAT "%8.4" ECU_ADDRESS 0xC00002BE /end MEASUREMENT
/begin MEASUREMENT ASMod_qCor "Korrekturmenge für Mengensignal" SWORD InjMass 1 100 -327.6800 327.6700 FORMAT "%8.4" ECU_ADDRESS 0xD0006A2C /end MEASUREMENT
/begin MEASUREMENT ASMod_qInjCmb "an der Verbrennung teilnehmende Kraftstoffmenge" SWORD InjMass 1 100 -327.6800 327.6700 FORMAT "%8.4" ECU_ADDRESS 0xD0006A32 /end MEASUREMENT
/begin MEASUREMENT ASMod_qInjNoCmb "an der Verbrennung nicht teilnehmende Kraftstoffmenge" SWORD InjMass 1 100 -327.6800 327.6700 FORMAT "%8.4" ECU_ADDRESS 0xD0006A38 /end MEASUREMENT
/begin MEASUREMENT ASMod_qSetUnBalCrvIn_mp "" SWORD InjMass 1 100 -327.6800 327.6700 FORMAT "%8.4" ECU_ADDRESS 0xC0000570 /end MEASUREMENT
/begin MEASUREMENT ASMod_rAshEG "Asche-Emissionsanteil nach Verbrennung" SWORD RatAshMass 1 100 -0.3276800 0.3276700 FORMAT "%9.7" ECU_ADDRESS 0xD0006A3E /end MEASUREMENT
/begin MEASUREMENT ASMod_rECBLinCrvIn_mp "" SWORD Prc 1 100 -400.0000 399.9878 FORMAT "%8.4" ECU_ADDRESS 0xC0000274 /end MEASUREMENT
/begin MEASUREMENT ASMod_rEGR "ARF-Rate" SWORD RatAirMass 1 100 -327.6800 327.6700 FORMAT "%8.4" ECU_ADDRESS 0xD0006A44 /end MEASUREMENT
/begin MEASUREMENT ASMod_rEGRCrvIn_mp "" SWORD RatAirMass 1 100 -327.6800 327.6700 FORMAT "%8.4" ECU_ADDRESS 0xC00002C0 /end MEASUREMENT
/begin MEASUREMENT ASMod_remOxy_mp "" SLONG InjMassPerTime 1 100 -21474836.4800 21474836.4700 FORMAT "%13.4" ECU_ADDRESS 0xC0000338 /end MEASUREMENT
/begin MEASUREMENT ASMod_rePipe1_mp "" SWORD ReynoldsNum 1 100 -3276800. 3276700. FORMAT "%8.0" ECU_ADDRESS 0xC000035C /end MEASUREMENT
/begin MEASUREMENT ASMod_rePipeEnv1_mp "" SWORD ReynoldsNum1 1 100 -32768000. 32767000. FORMAT "%8.0" ECU_ADDRESS 0xC000035E /end MEASUREMENT
/begin MEASUREMENT ASMod_rePipeEnvSlw1_mp "" SWORD ReynoldsNum1 1 100 -32768000. 32767000. FORMAT "%8.0" ECU_ADDRESS 0xC000040E /end MEASUREMENT
/begin MEASUREMENT ASMod_rePipeEnvSlw_mp "Reynoldszahl zwischen Rohrwand und Umgebung" SWORD ReynoldsNum1 1 100 -32768000. 32767000. FORMAT "%8.0" ARRAY_SIZE 4 ECU_ADDRESS 0xC00004AC /end MEASUREMENT
/begin MEASUREMENT ASMod_rePipeEnv_mp "Reynoldszahl zwischen Rohrwand und Umgebung" SWORD ReynoldsNum1 1 100 -32768000. 32767000. FORMAT "%8.0" ARRAY_SIZE 3 ECU_ADDRESS 0xC00003D2 /end MEASUREMENT
/begin MEASUREMENT ASMod_rePipeSlw1_mp "" SWORD ReynoldsNum 1 100 -3276800. 3276700. FORMAT "%8.0" ECU_ADDRESS 0xC0000410 /end MEASUREMENT
/begin MEASUREMENT ASMod_rePipeSlw_mp "Reynoldszahl im Rohrstück" SWORD ReynoldsNum 1 100 -3276800. 3276700. FORMAT "%8.0" ARRAY_SIZE 4 ECU_ADDRESS 0xC00004B4 /end MEASUREMENT
/begin MEASUREMENT ASMod_rePipe_mp "Reynoldszahl im Rohrstück" SWORD ReynoldsNum 1 100 -3276800. 3276700. FORMAT "%8.0" ARRAY_SIZE 3 ECU_ADDRESS 0xC00003D8 /end MEASUREMENT
/begin MEASUREMENT ASMod_rFlBrn_mp "Verhältnis des verbrannten Kraftstoffmassenstroms und des an der Verbrennung teilnehmenden Kraftstoffmassenstroms" SWORD RatFuelMass 1 100 -327.6800 327.6700 FORMAT "%8.4" ECU_ADDRESS 0xC00002C2 /end MEASUREMENT
/begin MEASUREMENT ASMod_rFlEG "Kraftstoffmassenanteil nach Verbrennung" SWORD RatFuelMass 1 100 -327.6800 327.6700 FORMAT "%8.4" ECU_ADDRESS 0xD0006A4A /end MEASUREMENT
/begin MEASUREMENT ASMod_rLamRecDfl "Defaultwert des reziproken Lambda-Signals" SWORD lambdaRecVal 1 100 -32.76800 32.76700 FORMAT "%8.5" ECU_ADDRESS 0xD0006A50 /end MEASUREMENT
/begin MEASUREMENT ASMod_rLamRecDiffRef_mp "rekursiver Lambda-Differenzwert zwischen Referenz- und Lambdasondenwert für Rußmassenstromkorrektur" SWORD lambdaRecVal 1 100 -32.76800 32.76700 FORMAT "%8.5" ECU_ADDRESS 0xC00002C4 /end MEASUREMENT
/begin MEASUREMENT ASMod_rLamRecEG "reziprokes Lambda-Signal nach Verbrennung" SWORD lambdaRecVal 1 100 -32.76800 32.76700 FORMAT "%8.5" ECU_ADDRESS 0xD0006A56 /end MEASUREMENT
/begin MEASUREMENT ASMod_rLamRecEGCrvIn_mp "" SWORD lambdaRecVal 1 100 -32.76800 32.76700 FORMAT "%8.5" ECU_ADDRESS 0xC00002C6 /end MEASUREMENT
/begin MEASUREMENT ASMod_rLamRecExhMnfDs "reziprokes Lambda-Signal nach Abgaskrümmer" SWORD lambdaRecVal 1 100 -32.76800 32.76700 FORMAT "%8.5" ECU_ADDRESS 0xD0006A5C /end MEASUREMENT
/begin MEASUREMENT ASMod_rLamRecExhMnfDsMapIn_mp "" SWORD lambdaRecVal 1 100 -32.76800 32.76700 FORMAT "%8.5" ECU_ADDRESS 0xC0000326 /end MEASUREMENT
/begin MEASUREMENT ASMod_rLamRecRef_mp "rekursive Lambda-Referenzwert für Rußmassenstromkorrektur" SWORD lambdaRecVal 1 100 -32.76800 32.76700 FORMAT "%8.5" ECU_ADDRESS 0xC00002C8 /end MEASUREMENT
/begin MEASUREMENT ASMod_rMsFlwRef_mp "relative Abweichung von der Referenz des Gasmassenstroms nach Einlasskrümmer" SWORD RatAirMass 1 100 -327.6800 327.6700 FORMAT "%8.4" ECU_ADDRESS 0xC00002CA /end MEASUREMENT
/begin MEASUREMENT ASMod_rNOxEG "NOx-Emissionsanteil nach Verbrennung" SWORD RatNOxMass 1 100 -0.003276800 0.003276700 FORMAT "%11.9" ECU_ADDRESS 0xD0006A62 /end MEASUREMENT
/begin MEASUREMENT ASMod_rO2EGFld "" SWORD O2 1 100 -0.3276800 0.3276700 FORMAT "%9.7" ARRAY_SIZE 7 ECU_ADDRESS 0xD0006A68 /end MEASUREMENT
/begin MEASUREMENT ASMod_rO2EG_mp "Sauerstoffmassenanteil nach Verbrennung" SWORD O2 1 100 -0.3276800 0.3276700 FORMAT "%9.7" ECU_ADDRESS 0xC00002CC /end MEASUREMENT
/begin MEASUREMENT ASMod_rO2ExhMnfDs "Sauerstoffmassenanteil des Abgases nach Abgaskrümmer" SWORD O2 1 100 -0.3276800 0.3276700 FORMAT "%9.7" ECU_ADDRESS 0xD0006A76 /end MEASUREMENT
/begin MEASUREMENT ASMod_rO2ExhMnfUs "Sauerstoffmassenanteil des Abgases vor Abgaskrümmer" SWORD O2 1 100 -0.3276800 0.3276700 FORMAT "%9.7" ECU_ADDRESS 0xD0006A78 /end MEASUREMENT
/begin MEASUREMENT ASMod_rO2IntMnfDs_mp "Sauerstoffmassenanteil des Gasmassenstroms nach Einlasskrümmer" SWORD O2 1 100 -0.3276800 0.3276700 FORMAT "%9.7" ECU_ADDRESS 0xC000027E /end MEASUREMENT
/begin MEASUREMENT ASMod_rPresCmpr_mp "Druckverhältnis am Verdichter" SWORD Fact 1 100 -4.000000 3.999878 FORMAT "%8.6" ECU_ADDRESS 0xC0000558 /end MEASUREMENT
/begin MEASUREMENT ASMod_rRelPosECB "relative Position des Stellers für den ARF-Kühler-Bypass" SWORD Prc 1 100 -400.0000 399.9878 FORMAT "%8.4" ECU_ADDRESS 0xD0006A7E /end MEASUREMENT
/begin MEASUREMENT ASMod_rRelPosTVA "relative Position der Drosselklappe" SWORD Prc 1 100 -400.0000 399.9878 FORMAT "%8.4" ECU_ADDRESS 0xD0006A84 /end MEASUREMENT
/begin MEASUREMENT ASMod_rRelPosVSA "relative Position der Drallklappe" SWORD Prc 1 100 -400.0000 399.9878 FORMAT "%8.4" ECU_ADDRESS 0xD0006A8A /end MEASUREMENT
/begin MEASUREMENT ASMod_rSotEG "Ruß-Emissionsanteil nach Verbrennung" SWORD RatSotMass 1 100 -0.3276800 0.3276700 FORMAT "%9.7" ECU_ADDRESS 0xD0006A96 /end MEASUREMENT
/begin MEASUREMENT ASMod_rSOxEG "Schwefeloxid-Emissionsanteil nach Verbrennung" SWORD RatSOxMass 1 100 -0.0003276800 0.0003276700 FORMAT "%12.10" ECU_ADDRESS 0xD0006A90 /end MEASUREMENT
/begin MEASUREMENT ASMod_rTempAdbt_mp "" SWORD Fact 1 100 -4.000000 3.999878 FORMAT "%8.6" ECU_ADDRESS 0xC000055A /end MEASUREMENT
/begin MEASUREMENT ASMod_rTempClnt_mp "Verhältnis Motorübertemperatur Motorstop / -start" SWORD Fact 1 100 -4.000000 3.999878 FORMAT "%8.6" ECU_ADDRESS 0xC000050E /end MEASUREMENT
/begin MEASUREMENT ASMod_rTime "" SWORD Fact1 1 100 -256.0000 255.9922 FORMAT "%8.4" ECU_ADDRESS 0xD0006A9C /end MEASUREMENT
/begin MEASUREMENT ASMod_rTimeNSC_mp "Verhältnis Standzeit zu Abkühl-Halbwertszeit NSC" SWORD Fact1 1 100 -256.0000 255.9922 FORMAT "%8.4" ECU_ADDRESS 0xC0000510 /end MEASUREMENT
/begin MEASUREMENT ASMod_rTimeOxiC_mp "Verhältnis Standzeit zu Abkühl-Halbwertszeit Oxidationskatalysator" SWORD Fact1 1 100 -256.0000 255.9922 FORMAT "%8.4" ECU_ADDRESS 0xC0000512 /end MEASUREMENT
/begin MEASUREMENT ASMod_rTimePipe_mp "Verhältnis Standzeit zu Abkühl-Halbwertszeit Rohrstück" SWORD Fact1 1 100 -256.0000 255.9922 FORMAT "%8.4" ARRAY_SIZE 7 ECU_ADDRESS 0xC0000514 /end MEASUREMENT
/begin MEASUREMENT ASMod_rTVALinCrvIn_mp "" SWORD DtyCyc 1 100 -327.6800 327.6700 FORMAT "%8.4" ECU_ADDRESS 0xC0000276 /end MEASUREMENT
/begin MEASUREMENT ASMod_rVSALinCrvIn_mp "" SWORD Prc 1 100 -400.0000 399.9878 FORMAT "%8.4" ECU_ADDRESS 0xC0000278 /end MEASUREMENT
/begin MEASUREMENT ASMod_stInit "Status der Umschaltung auf Initialisierungswerte" UBYTE OneToOne 1 100 0.00 255.0 FORMAT "%5.1" ECU_ADDRESS 0xD0008EFE /end MEASUREMENT
/begin MEASUREMENT ASMod_tAirStrt_mp "Lufttemperatur zur Starttemperatur-Berechnung" SWORD Temp_Cels 1 100 -3549.940 3003.560 FORMAT "%8.3" ECU_ADDRESS 0xC0000522 /end MEASUREMENT
/begin MEASUREMENT ASMod_tAirTrbn_mp "Lufttemperatur für Turbolader-Temperaturmodell" SWORD Temp_Cels 1 100 -3549.940 3003.560 FORMAT "%8.3" ECU_ADDRESS 0xC000055C /end MEASUREMENT
/begin MEASUREMENT ASMod_tAvrgNSC_mp "mittlere Temperatur NSC" SWORD Temp_Cels 1 100 -3549.940 3003.560 FORMAT "%8.3" ECU_ADDRESS 0xC000031E /end MEASUREMENT
/begin MEASUREMENT ASMod_tAvrgOxiC_mp "Mittlere Temperatur Oxidationskatalysator" SWORD Temp_Cels 1 100 -3549.940 3003.560 FORMAT "%8.3" ECU_ADDRESS 0xC000033C /end MEASUREMENT
/begin MEASUREMENT ASMod_tDiffEGPipeSlw_mp "Temperaturdifferenz zwischen Gas und Rohrwand" SWORD TempDiff_Kelv 1 100 -3276.800 3276.700 FORMAT "%8.3" ARRAY_SIZE 4 ECU_ADDRESS 0xC00004BC /end MEASUREMENT
/begin MEASUREMENT ASMod_tDiffEGPipe_mp "Temperaturdifferenz zwischen Gas und Rohrwand" SWORD TempDiff_Kelv 1 100 -3276.800 3276.700 FORMAT "%8.3" ARRAY_SIZE 3 ECU_ADDRESS 0xC00003DE /end MEASUREMENT
/begin MEASUREMENT ASMod_tDiffEGRClg_mp "Temperaturabsenkung des rückgeführten Abgsases im ARF-Kühler" SWORD Temp_Kelv 1 100 -3276.800 3276.700 FORMAT "%8.3" ECU_ADDRESS 0xC0000280 /end MEASUREMENT
/begin MEASUREMENT ASMod_tDiffEG_mp "Temperaturerhöhung des Gasmassenstroms durch Verbrennung" SWORD TempDiff_Kelv 1 100 -3276.800 3276.700 FORMAT "%8.3" ECU_ADDRESS 0xC00002CE /end MEASUREMENT
/begin MEASUREMENT ASMod_tDiffEngBas_mp "Basiswert der Temperaturerhöhung durch Verbrennung" SWORD TempDiff_Kelv 1 100 -3276.800 3276.700 FORMAT "%8.3" ECU_ADDRESS 0xC00002D0 /end MEASUREMENT
/begin MEASUREMENT ASMod_tDiffEngRef_mp "Abweichung von der Referenz der Motortemperatur" SWORD TempDiff_Kelv 1 100 -3276.800 3276.700 FORMAT "%8.3" ECU_ADDRESS 0xC00002D2 /end MEASUREMENT
/begin MEASUREMENT ASMod_tDiffPipeEnvSlw_mp "Temperaturdifferenz zwischen Rohrwand und Umgebung" SWORD TempDiff_Kelv 1 100 -3276.800 3276.700 FORMAT "%8.3" ARRAY_SIZE 4 ECU_ADDRESS 0xC00004C4 /end MEASUREMENT
/begin MEASUREMENT ASMod_tDiffPipeEnv_mp "Temperaturdifferenz zwischen Rohrwand und Umgebung" SWORD TempDiff_Kelv 1 100 -3276.800 3276.700 FORMAT "%8.3" ARRAY_SIZE 3 ECU_ADDRESS 0xC00003E4 /end MEASUREMENT
/begin MEASUREMENT ASMod_tEGEngTempCor_mp "Korrekturwert der Temperaturerhöhung aufgrund der Motortemperatur" SWORD TempDiff_Kelv 1 100 -3276.800 3276.700 FORMAT "%8.3" ECU_ADDRESS 0xC00002D4 /end MEASUREMENT
/begin MEASUREMENT ASMod_tEGFld "Abgastemperatur-Feld" SWORD Temp_Cels 1 100 -3549.940 3003.560 FORMAT "%8.3" ARRAY_SIZE 14 ECU_ADDRESS 0xD0006A9E /end MEASUREMENT
/begin MEASUREMENT ASMod_tEGFld_mp "" SWORD Temp_Cels 1 100 -3549.940 3003.560 FORMAT "%8.3" ECU_ADDRESS 0xC00002EC /end MEASUREMENT
/begin MEASUREMENT ASMod_tEGPipeDs_mp "Abgastemperatur am Rohrausgang" SWORD Temp_Cels 1 100 -3549.940 3003.560 FORMAT "%8.3" ARRAY_SIZE 3 ECU_ADDRESS 0xC00003EA /end MEASUREMENT
/begin MEASUREMENT ASMod_tEGPipeSlwDs_mp "Abgastemperatur am Rohrausgang" SWORD Temp_Cels 1 100 -3549.940 3003.560 FORMAT "%8.3" ARRAY_SIZE 4 ECU_ADDRESS 0xC00004CC /end MEASUREMENT
/begin MEASUREMENT ASMod_tEGRDs "Temperatur des rückgeführten Abgases nach ARF-Kühler" SWORD Temp_Cels 1 100 -3549.940 3003.560 FORMAT "%8.3" ECU_ADDRESS 0xD0006ABA /end MEASUREMENT
/begin MEASUREMENT ASMod_tEG_mp "Temperatur des Abgases nach Verbrennung" SWORD Temp_Cels 1 100 -3549.940 3003.560 FORMAT "%8.3" ECU_ADDRESS 0xC00002D6 /end MEASUREMENT
/begin MEASUREMENT ASMod_tEngStrt_mp "Motortemperatur zur Starttemperatur-Berechnung" SWORD Temp_Cels 1 100 -3549.940 3003.560 FORMAT "%8.3" ECU_ADDRESS 0xC0000524 /end MEASUREMENT
/begin MEASUREMENT ASMod_tExhMnfDs "Abgastemperatur nach Abgaskrümmer" SWORD Temp_Cels 1 100 -3549.940 3003.560 FORMAT "%8.3" ECU_ADDRESS 0xD0006ABC /end MEASUREMENT
/begin MEASUREMENT ASMod_tExhMnfUs "Abgastemperatur vor Abgaskrümmer" SWORD Temp_Cels 1 100 -3549.940 3003.560 FORMAT "%8.3" ECU_ADDRESS 0xD0006ABE /end MEASUREMENT
/begin MEASUREMENT ASMod_tExsClnt_mp "Motorübertemperatur" SWORD TempDiff_Kelv 1 100 -3276.800 3276.700 FORMAT "%8.3" ECU_ADDRESS 0xC0000526 /end MEASUREMENT
/begin MEASUREMENT ASMod_tHtTransCor_mp "Temperatur-Korrekturwert für Wärmeübergang am Temperatursensor vor PFlt" SWORD TempDiff_Kelv 1 100 -3276.800 3276.700 FORMAT "%8.3" ECU_ADDRESS 0xC000034C /end MEASUREMENT
/begin MEASUREMENT ASMod_tiClg "Abkühlzeit zur Starttemperatur-Berechnung" SLONG Time_s 1 100 -21474836.4800 21474836.4700 FORMAT "%13.4" ECU_ADDRESS 0xD00042BC /end MEASUREMENT
/begin MEASUREMENT ASMod_tiClgRef_mp "Referenzzeit aus Motor-Abkühlung" SLONG Time_s 1 100 -21474836.4800 21474836.4700 FORMAT "%13.4" ECU_ADDRESS 0xC0000528 /end MEASUREMENT
/begin MEASUREMENT ASMod_tiDdT_mp "Gaslaufzeit durch den Motor" SWORD TimeDeb 1 100 -327680.0 327670.0 FORMAT "%8.1" ECU_ADDRESS 0xC00002D8 /end MEASUREMENT
/begin MEASUREMENT ASMod_tiEngOn_mp "Motorbetriebszeit" SWORD TimeHrsEngOn 1 100 -3276800. 3276700. FORMAT "%8.0" ECU_ADDRESS 0xC00002DA /end MEASUREMENT
/begin MEASUREMENT ASMod_tiExhGsDelPFlt_mp "Verzögerungszeit Abgas" SWORD TimeDelay_s 1 100 0.13107600012 4294.9672960 FORMAT "%12.7" ECU_ADDRESS 0xC000034E /end MEASUREMENT
/begin MEASUREMENT ASMod_tiHtTransDT1_mp "Filter-Zeitkonstante entsprechend Temperatursensor vor PFlt" SWORD TimeDelay_s 1 100 0.13107600012 4294.9672960 FORMAT "%12.7" ECU_ADDRESS 0xC0000350 /end MEASUREMENT
/begin MEASUREMENT ASMod_tIncrPoI_mp "Temperaturerhöhung im Oxidationskatalysator aufgrund später Nacheinspritzung" SWORD TempDiff_Kelv 1 100 -3276.800 3276.700 FORMAT "%8.3" ECU_ADDRESS 0xC000033E /end MEASUREMENT
/begin MEASUREMENT ASMod_tIntMnfDs "Temperatur des Gasmassenstroms nach Einlasskrümmer" SWORD Temp_Cels 1 100 -3549.940 3003.560 FORMAT "%8.3" ECU_ADDRESS 0xD0006AC4 /end MEASUREMENT
/begin MEASUREMENT ASMod_tIntMnfDsRef "Referenzgastemperatur nach Einlasskrümmer" SWORD Temp_Cels 1 100 -3549.940 3003.560 FORMAT "%8.3" ECU_ADDRESS 0xD0006ACA /end MEASUREMENT
/begin MEASUREMENT ASMod_tMidEGPipeSlw_mp "Mittlere Temperatur zwischen Gas und Rohrwand" SWORD Temp_Cels 1 100 -3549.940 3003.560 FORMAT "%8.3" ARRAY_SIZE 4 ECU_ADDRESS 0xC00004D4 /end MEASUREMENT
/begin MEASUREMENT ASMod_tMidEGPipe_mp "Mittlere Temperatur zwischen Gas und Rohrwand" SWORD Temp_Cels 1 100 -3549.940 3003.560 FORMAT "%8.3" ARRAY_SIZE 3 ECU_ADDRESS 0xC00003F0 /end MEASUREMENT
/begin MEASUREMENT ASMod_tMidPipeEnvSlw_mp "Mittlere Temperatur zwischen Rohrwand und Umgebung" SWORD Temp_Cels 1 100 -3549.940 3003.560 FORMAT "%8.3" ARRAY_SIZE 4 ECU_ADDRESS 0xC00004DC /end MEASUREMENT
/begin MEASUREMENT ASMod_tMidPipeEnv_mp "Mittlere Temperatur zwischen Rohrwand und Umgebung" SWORD Temp_Cels 1 100 -3549.940 3003.560 FORMAT "%8.3" ARRAY_SIZE 3 ECU_ADDRESS 0xC00003F6 /end MEASUREMENT
/begin MEASUREMENT ASMod_tMixPntEGDs_mp "Abgastemperatur nach Mischstelle im Abgaskrümmer" SWORD Temp_Cels 1 100 -3549.940 3003.560 FORMAT "%8.3" ECU_ADDRESS 0xC0000282 /end MEASUREMENT
/begin MEASUREMENT ASMod_tMixPntEGUs_mp "Abgastemperatur vor Mischstelle im Abgaskrümmer" SWORD Temp_Cels 1 100 -3549.940 3003.560 FORMAT "%8.3" ECU_ADDRESS 0xC0000284 /end MEASUREMENT
/begin MEASUREMENT ASMod_tNSCDs "Temperatur nach NSC" SWORD Temp_Cels 1 100 -3549.940 3003.560 FORMAT "%8.3" ECU_ADDRESS 0xD0006AD0 /end MEASUREMENT
/begin MEASUREMENT ASMod_tNSCExoIncr_mp "Temperaturerhöhung im NSC durch chemische Reaktionen" SWORD TempDiff_Kelv 1 100 -3276.800 3276.700 FORMAT "%8.3" ECU_ADDRESS 0xC0000320 /end MEASUREMENT
/begin MEASUREMENT ASMod_tNSCStat_mp "Stationäre Temperatur NSC" SWORD Temp_Cels 1 100 -3549.940 3003.560 FORMAT "%8.3" ECU_ADDRESS 0xC0000322 /end MEASUREMENT
/begin MEASUREMENT ASMod_tNSCStrt "Initialisierungstemperatur für NSC-Modell bei Motorstart" SWORD Temp_Cels 1 100 -3549.940 3003.560 FORMAT "%8.3" ECU_ADDRESS 0xD0006AD6 /end MEASUREMENT
/begin MEASUREMENT ASMod_tNSCStrt_mp "" SWORD Temp_Cels 1 100 -3549.940 3003.560 FORMAT "%8.3" ECU_ADDRESS 0xC000052C /end MEASUREMENT
/begin MEASUREMENT ASMod_tNSCUs_mp "Temperatur vor NSC" SWORD Temp_Cels 1 100 -3549.940 3003.560 FORMAT "%8.3" ECU_ADDRESS 0xC0000324 /end MEASUREMENT
/begin MEASUREMENT ASMod_tOxiCDiff "" SWORD TempDiff_Kelv 1 100 -3276.800 3276.700 FORMAT "%8.3" ECU_ADDRESS 0xD0006ADC /end MEASUREMENT
/begin MEASUREMENT ASMod_tOxiCDs "Temperatur nach Oxidationskatalysator" SWORD Temp_Cels 1 100 -3549.940 3003.560 FORMAT "%8.3" ECU_ADDRESS 0xD0006AE2 /end MEASUREMENT
/begin MEASUREMENT ASMod_tOxiCExoIncr_mp "Temperaturerhöhung im Oxidationskatalysator durch chemische Reaktion" SWORD TempDiff_Kelv 1 100 -3276.800 3276.700 FORMAT "%8.3" ECU_ADDRESS 0xC0000340 /end MEASUREMENT
/begin MEASUREMENT ASMod_tOxiCStat_mp "Stationäre Temperatur Oxidationskatalysator" SWORD Temp_Cels 1 100 -3549.940 3003.560 FORMAT "%8.3" ECU_ADDRESS 0xC0000342 /end MEASUREMENT
/begin MEASUREMENT ASMod_tOxiCStrt "Initialisierungstemperatur für OxiC-Modell bei Motorstart" SWORD Temp_Cels 1 100 -3549.940 3003.560 FORMAT "%8.3" ECU_ADDRESS 0xD0006AE8 /end MEASUREMENT
/begin MEASUREMENT ASMod_tOxiCStrt_mp "" SWORD Temp_Cels 1 100 -3549.940 3003.560 FORMAT "%8.3" ECU_ADDRESS 0xC000052E /end MEASUREMENT
/begin MEASUREMENT ASMod_tOxiCUs_mp "Temperatur vor Oxidationskatalysator" SWORD Temp_Cels 1 100 -3549.940 3003.560 FORMAT "%8.3" ECU_ADDRESS 0xC0000344 /end MEASUREMENT
/begin MEASUREMENT ASMod_tPFltCorUs_mp "Gefilterte Temperatur vor Partikelfilter" SWORD Temp_Cels 1 100 -3549.940 3003.560 FORMAT "%8.3" ECU_ADDRESS 0xC0000352 /end MEASUREMENT
/begin MEASUREMENT ASMod_tPFltDiffCorr_mp "" SWORD TempDiff_Kelv 1 100 -3276.800 3276.700 FORMAT "%8.3" ECU_ADDRESS 0xC0000354 /end MEASUREMENT
/begin MEASUREMENT ASMod_tPFltFlt_mp "" SWORD Temp_Cels 1 100 -3549.940 3003.560 FORMAT "%8.3" ECU_ADDRESS 0xC0000356 /end MEASUREMENT
/begin MEASUREMENT ASMod_tPFltSimDiff "" SWORD TempDiff_Kelv 1 100 -3276.800 3276.700 FORMAT "%8.3" ECU_ADDRESS 0xD0006AEE /end MEASUREMENT
/begin MEASUREMENT ASMod_tPFltSimDs "Simulierte Temperatur nach Partikelfilter" SWORD Temp_Cels 1 100 -3549.940 3003.560 FORMAT "%8.3" ECU_ADDRESS 0xD0006AF4 /end MEASUREMENT
/begin MEASUREMENT ASMod_tPFltSurfSim "Oberflächentemperatur Partikelfilter" SWORD Temp_Cels 1 100 -3549.940 3003.560 FORMAT "%8.3" ECU_ADDRESS 0xD0006AFA /end MEASUREMENT
/begin MEASUREMENT ASMod_tPFltSurfSim_mp "" SWORD Temp_Cels 1 100 -3549.940 3003.560 FORMAT "%8.3" ECU_ADDRESS 0xC0000358 /end MEASUREMENT
/begin MEASUREMENT ASMod_tPFltTotCorUs_mp "Additiver Temperaturkorrekturwert" SWORD TempDiff_Kelv 1 100 -3276.800 3276.700 FORMAT "%8.3" ECU_ADDRESS 0xC000035A /end MEASUREMENT
/begin MEASUREMENT ASMod_tPFltUs "" SWORD Temp_Cels 1 100 -3549.940 3003.560 FORMAT "%8.3" ECU_ADDRESS 0xD0006B00 /end MEASUREMENT
/begin MEASUREMENT ASMod_tPipeStrt "Initialisierungstemperatur für Pipe-Modell bei Motorstart" SWORD Temp_Cels 1 100 -3549.940 3003.560 FORMAT "%8.3" ARRAY_SIZE 7 ECU_ADDRESS 0xD0006B06 /end MEASUREMENT
/begin MEASUREMENT ASMod_tPipeStrt_mp "" SWORD Temp_Cels 1 100 -3549.940 3003.560 FORMAT "%8.3" ARRAY_SIZE 7 ECU_ADDRESS 0xC0000530 /end MEASUREMENT
/begin MEASUREMENT ASMod_tShOffExsClnt_mp "Motorübertemperatur bei letztem Motorstop" SWORD TempDiff_Kelv 1 100 -3276.800 3276.700 FORMAT "%8.3" ECU_ADDRESS 0xC000053E /end MEASUREMENT
/begin MEASUREMENT ASMod_tShOffNSC_mp "Abgastemperatur nach NSC bei letztem Motorstop" SWORD Temp_Cels 1 100 -3549.940 3003.560 FORMAT "%8.3" ECU_ADDRESS 0xC0000540 /end MEASUREMENT
/begin MEASUREMENT ASMod_tShOffOxiC_mp "Abgastemperatur nach OxiC bei letztem Motorstop" SWORD Temp_Cels 1 100 -3549.940 3003.560 FORMAT "%8.3" ECU_ADDRESS 0xC0000542 /end MEASUREMENT
/begin MEASUREMENT ASMod_tShOffPipe_mp "Rohrwandtemperatur bei letztem Motorstop" SWORD Temp_Cels 1 100 -3549.940 3003.560 FORMAT "%8.3" ARRAY_SIZE 7 ECU_ADDRESS 0xC0000544 /end MEASUREMENT
/begin MEASUREMENT ASMod_tTrbnDs "Abgastemperatur nach Turbolader" SWORD Temp_Cels 1 100 -3549.940 3003.560 FORMAT "%8.3" ECU_ADDRESS 0xD0006B14 /end MEASUREMENT
/begin MEASUREMENT ASMod_tTrbnDsRaw "Rohwert Abgastemperatur nach Turbolader" SWORD Temp_Cels 1 100 -3549.940 3003.560 FORMAT "%8.3" ECU_ADDRESS 0xD0006B16 /end MEASUREMENT
/begin MEASUREMENT ASMod_tTrbnPT1_mp "" SWORD TempDiff_Kelv 1 100 -3276.800 3276.700 FORMAT "%8.3" ECU_ADDRESS 0xC000055E /end MEASUREMENT
/begin MEASUREMENT ASMod_tTrbn_mp "" SWORD TempDiff_Kelv 1 100 -3276.800 3276.700 FORMAT "%8.3" ECU_ADDRESS 0xC0000560 /end MEASUREMENT
/begin MEASUREMENT ASMod_tWallFld "Rohrwand-Temperaturfeld" SWORD Temp_Cels 1 100 -3549.940 3003.560 FORMAT "%8.3" ARRAY_SIZE 7 ECU_ADDRESS 0xD0006B18 /end MEASUREMENT
/begin MEASUREMENT ASMod_tWallPipeSlw_mp "Rohrwandtemperatur" SWORD Temp_Cels 1 100 -3549.940 3003.560 FORMAT "%8.3" ARRAY_SIZE 4 ECU_ADDRESS 0xC00004E4 /end MEASUREMENT
/begin MEASUREMENT ASMod_tWallPipe_mp "Rohrwandtemperatur" SWORD Temp_Cels 1 100 -3549.940 3003.560 FORMAT "%8.3" ARRAY_SIZE 3 ECU_ADDRESS 0xC00003FC /end MEASUREMENT
/begin MEASUREMENT ASMod_unBrnFl_mp "" SWORD InjMassPerTime 1 100 -327.6800 327.6700 FORMAT "%8.4" ECU_ADDRESS 0xC0000346 /end MEASUREMENT
/begin MEASUREMENT ASMod_volEng "Hubvolumen des Motors" SWORD Vol 1 100 -327.6800 327.6700 FORMAT "%8.4" ECU_ADDRESS 0xD0006B26 /end MEASUREMENT
/begin MEASUREMENT ASMod_vscDynPipeSlw_mp "Dynamische Viskosität des Gases im Rohr" SWORD Fact 1 100 -4.000000 3.999878 FORMAT "%8.6" ARRAY_SIZE 4 ECU_ADDRESS 0xC00004EC /end MEASUREMENT
/begin MEASUREMENT ASMod_vscDynPipe_mp "Dynamische Viskosität des Gases im Rohr" SWORD Fact 1 100 -4.000000 3.999878 FORMAT "%8.6" ARRAY_SIZE 3 ECU_ADDRESS 0xC0000402 /end MEASUREMENT
/begin MEASUREMENT ASMod_vscKinPipeSlw_mp "Kinematische Viskosität des Gases im Rohr" SWORD Fact8 1 100 -0.0003276800 0.0003276700 FORMAT "%12.10" ARRAY_SIZE 4 ECU_ADDRESS 0xC00004F4 /end MEASUREMENT
/begin MEASUREMENT ASMod_vscKinPipe_mp "Kinematische Viskosität des Gases im Rohr" SWORD Fact8 1 100 -0.0003276800 0.0003276700 FORMAT "%12.10" ARRAY_SIZE 3 ECU_ADDRESS 0xC0000408 /end MEASUREMENT
/begin MEASUREMENT ATS_IntvVal_mp "Eingriffswert" SWORD OneToOne 1 100 -32768.00 32767.00 FORMAT "%8.2" ECU_ADDRESS 0xC0000572 /end MEASUREMENT
/begin MEASUREMENT ATS_stMonTimeLimit "Verhalten Zeitlimit bei neuen Testeranforderungen" UBYTE OneToOne 1 100 0.00 255.0 FORMAT "%5.1" ECU_ADDRESS 0xD0008EFF /end MEASUREMENT
/begin MEASUREMENT ATS_TstStatus_mp "Status des Stellereingriffes" UBYTE OneToOne 1 100 0.00 255.0 FORMAT "%5.1" ECU_ADDRESS 0xC0000574 /end MEASUREMENT
/begin MEASUREMENT BattU_facCor "Batteriekorrekturfaktor" SWORD Fact 1 100 -4.000000 3.999878 FORMAT "%8.6" ECU_ADDRESS 0xD0006BFA /end MEASUREMENT
/begin MEASUREMENT BattU_u "Batteriespannung" SWORD Volt_Batt 1 100 -655360.0 655340.0 FORMAT "%8.1" ECU_ADDRESS 0xD0006BFC /end MEASUREMENT
/begin MEASUREMENT BattU_uRated "Batteriespannung" SWORD Volt_Batt 1 100 -655360.0 655340.0 FORMAT "%8.1" ECU_ADDRESS 0xD0006BFE /end MEASUREMENT
/begin MEASUREMENT BattU_uRaw "Rohsignal des Batteriespannungssensors" SWORD Volt 1 100 -6553.600 6553.400 FORMAT "%8.3" ECU_ADDRESS 0xD0006C00 /end MEASUREMENT
/begin MEASUREMENT BattU_uSens "Erfasste Batteriespannung" SWORD Volt_Batt 1 100 -655360.0 655340.0 FORMAT "%8.1" ECU_ADDRESS 0xD0006C02 /end MEASUREMENT
/begin MEASUREMENT BrkP_p "" SWORD Pres_bar 1 100 -32768.00 32767.00 FORMAT "%8.2" ECU_ADDRESS 0xD0006C04 /end MEASUREMENT
/begin MEASUREMENT BrkP_pSens "" SWORD Pres_bar 1 100 -32768.00 32767.00 FORMAT "%8.2" ECU_ADDRESS 0xD0006C06 /end MEASUREMENT
/begin MEASUREMENT BrkP_uRaw "" SWORD Volt 1 100 -6553.600 6553.400 FORMAT "%8.3" ECU_ADDRESS 0xD0006C0A /end MEASUREMENT
/begin MEASUREMENT Brk_ctPla_mp "Unplausibilitätszähler" UWORD OneToOne 1 100 0.00 65535.00 FORMAT "%8.2" ECU_ADDRESS 0xC0000576 /end MEASUREMENT
/begin MEASUREMENT Brk_st "Meldung Bremse betätigt" UBYTE OneToOne 1 100 0.00 255.0 FORMAT "%5.1" ECU_ADDRESS 0xD0008F1D /end MEASUREMENT
/begin MEASUREMENT Brk_stDeb_mp "Bremskontaktschalter - Status Fehlerentprellung Plausibilitaetspruefung" UBYTE OneToOne 1 100 0.00 255.0 FORMAT "%5.1" ECU_ADDRESS 0xC0000578 /end MEASUREMENT
/begin MEASUREMENT Brk_stFreeze_mp "" UBYTE OneToOne 1 100 0.00 255.0 FORMAT "%5.1" ECU_ADDRESS 0xC0000579 /end MEASUREMENT
/begin MEASUREMENT Brk_stMn "Digitalsignal Bremskontakt entprellt" UBYTE OneToOne 1 100 0.00 255.0 FORMAT "%5.1" ECU_ADDRESS 0xD0008F1E /end MEASUREMENT
/begin MEASUREMENT Brk_stMnRaw "Rohwert Bremskontakt nicht entprellt" UBYTE OneToOne 1 100 0.00 255.0 FORMAT "%5.1" ECU_ADDRESS 0xD0008F1F /end MEASUREMENT
/begin MEASUREMENT Brk_stRed "Redundanter Bremskontakt Aktivinformation" UBYTE OneToOne 1 100 0.00 255.0 FORMAT "%5.1" ECU_ADDRESS 0xD0008F20 /end MEASUREMENT
/begin MEASUREMENT Brk_stRedRaw "Rohwert redundanter Bremskontakt nicht entprellt" UBYTE OneToOne 1 100 0.00 255.0 FORMAT "%5.1" ECU_ADDRESS 0xD0008F21 /end MEASUREMENT
/begin MEASUREMENT Brk_stResPla_mp "Zustandsbits zum Rücksetzen der Unplausibilität" UBYTE OneToOne 1 100 0.00 255.0 FORMAT "%5.1" ECU_ADDRESS 0xC000057A /end MEASUREMENT
/begin MEASUREMENT Brk_tiDebPlaStat_mp "Statische Entprellzeit des Plausibilitäts-Check" UWORD Time_ms 1 100 0.00 655350.0 FORMAT "%8.1" ECU_ADDRESS 0xC000057C /end MEASUREMENT
/begin MEASUREMENT Com_aDirect "" SWORD Acc 1 100 -32.76800 32.76700 FORMAT "%8.5" ECU_ADDRESS 0xD0006CDE /end MEASUREMENT
/begin MEASUREMENT Com_aSide "" SWORD Acc 1 100 -32.76800 32.76700 FORMAT "%8.5" ECU_ADDRESS 0xD0006CE0 /end MEASUREMENT
/begin MEASUREMENT Com_dphiStWhlAg "" SWORD AngleVelStWhl 1 100 -1024.000 1023.969 FORMAT "%8.3" ECU_ADDRESS 0xD0006CE2 /end MEASUREMENT
/begin MEASUREMENT Com_dphiStWhlAgRaw "" SLONG AngleVelStWhl 1 100 -67108864.0000 67108863.9688 FORMAT "%13.4" ECU_ADDRESS 0xD00042F8 /end MEASUREMENT
/begin MEASUREMENT Com_dTrqDemandDscCHK "" UBYTE OneToOne 1 100 0.00 255.0 FORMAT "%5.1" ECU_ADDRESS 0xD0008F7B /end MEASUREMENT
/begin MEASUREMENT Com_dTrqDemandDscCTR "" UWORD OneToOne 1 100 0.00 65535.00 FORMAT "%8.2" ECU_ADDRESS 0xD000763E /end MEASUREMENT
/begin MEASUREMENT Com_pBrkSys "" UWORD Pres_bar 1 100 0.00 65535.00 FORMAT "%8.2" ECU_ADDRESS 0xD0007646 /end MEASUREMENT
/begin MEASUREMENT Com_phiStWhlAg "" SWORD AngleStWhl 1 100 -1024.000 1023.969 FORMAT "%8.3" ECU_ADDRESS 0xD0006CFA /end MEASUREMENT
/begin MEASUREMENT Com_phiStWhlAgRaw "" SLONG AngleStWhl 1 100 -67108864.0000 67108863.9688 FORMAT "%13.4" ECU_ADDRESS 0xD00042FC /end MEASUREMENT
/begin MEASUREMENT Com_stClCtr "" UBYTE OneToOne 1 100 0.00 255.0 FORMAT "%5.1" ECU_ADDRESS 0xD0008F84 /end MEASUREMENT
/begin MEASUREMENT Com_stDecellDSC "" UBYTE OneToOne 1 100 0.00 255.0 FORMAT "%5.1" ECU_ADDRESS 0xD0008F88 /end MEASUREMENT
/begin MEASUREMENT Com_stDSC "" UBYTE OneToOne 1 100 0.00 255.0 FORMAT "%5.1" ECU_ADDRESS 0xD0008F87 /end MEASUREMENT
/begin MEASUREMENT Com_stphiStWhlAg "" UBYTE OneToOne 1 100 0.00 255.0 FORMAT "%5.1" ECU_ADDRESS 0xD0008FAD /end MEASUREMENT
/begin MEASUREMENT Com_stTrqDSCDes "" UBYTE OneToOne 1 100 0.00 255.0 FORMAT "%5.1" ECU_ADDRESS 0xD0008FA6 /end MEASUREMENT
/begin MEASUREMENT Com_trqDSCDes "" SWORD Trq 1 100 -3276.800 3276.700 FORMAT "%8.3" ECU_ADDRESS 0xD0006D1A /end MEASUREMENT
/begin MEASUREMENT Com_v "" SWORD Vel 1 100 -327.6800 327.6700 FORMAT "%8.4" ECU_ADDRESS 0xD0006D30 /end MEASUREMENT
/begin MEASUREMENT Com_vBd "" SWORD Vel 1 100 -327.6800 327.6700 FORMAT "%8.4" ECU_ADDRESS 0xD0006D32 /end MEASUREMENT
/begin MEASUREMENT Com_vWheelFL "" SWORD Vel 1 100 -327.6800 327.6700 FORMAT "%8.4" ECU_ADDRESS 0xD0006D34 /end MEASUREMENT
/begin MEASUREMENT Com_vWheelFR "" SWORD Vel 1 100 -327.6800 327.6700 FORMAT "%8.4" ECU_ADDRESS 0xD0006D36 /end MEASUREMENT
/begin MEASUREMENT Com_vWheelRL "" SWORD Vel 1 100 -327.6800 327.6700 FORMAT "%8.4" ECU_ADDRESS 0xD0006D38 /end MEASUREMENT
/begin MEASUREMENT Com_vWheelRR "" SWORD Vel 1 100 -327.6800 327.6700 FORMAT "%8.4" ECU_ADDRESS 0xD0006D3A /end MEASUREMENT
/begin MEASUREMENT ECBVlv_rB1 "" SWORD Prc 1 100 -400.0000 399.9878 FORMAT "%8.4" ECU_ADDRESS 0xD0006D8C /end MEASUREMENT
/begin MEASUREMENT ECBVlv_rB2 "" SWORD Prc 1 100 -400.0000 399.9878 FORMAT "%8.4" ECU_ADDRESS 0xD0006D8E /end MEASUREMENT
/begin MEASUREMENT EGRVlv_rActB1 "" SWORD Prc 1 100 -400.0000 399.9878 FORMAT "%8.4" ECU_ADDRESS 0xD0006D9A /end MEASUREMENT
/begin MEASUREMENT EGRVlv_rActB2 "" SWORD Prc 1 100 -400.0000 399.9878 FORMAT "%8.4" ECU_ADDRESS 0xD0006D9C /end MEASUREMENT
/begin MEASUREMENT ESS_uBatt "Batteriespannung" SWORD Volt_Batt 1 100 -655360.0 655340.0 FORMAT "%8.1" ECU_ADDRESS 0xD0006DD0 /end MEASUREMENT
/begin MEASUREMENT Exh_pAdapPPFltDiffB1 "" SWORD Pres_hPa 1 100 -32768.00 3500.00 FORMAT "%8.2" ECU_ADDRESS 0xD0006E90 /end MEASUREMENT
/begin MEASUREMENT Exh_pAdapPPFltDiffB2 "" SWORD Pres_hPa 1 100 -32768.00 3500.00 FORMAT "%8.2" ECU_ADDRESS 0xD0006E92 /end MEASUREMENT
/begin MEASUREMENT Exh_pPFltUsB1 "" SWORD Pres_hPa 1 100 -32768.00 3500.00 FORMAT "%8.2" ECU_ADDRESS 0xD0006EB8 /end MEASUREMENT
/begin MEASUREMENT Exh_pPFltUsB2 "" SWORD Pres_hPa 1 100 -32768.00 3500.00 FORMAT "%8.2" ECU_ADDRESS 0xD0006EBA /end MEASUREMENT
/begin MEASUREMENT Exh_tPFltUsB1 "" SWORD Temp_Cels 1 100 -3549.940 3003.560 FORMAT "%8.3" ECU_ADDRESS 0xD0006EDC /end MEASUREMENT
/begin MEASUREMENT Exh_tPFltUsB2 "" SWORD Temp_Cels 1 100 -3549.940 3003.560 FORMAT "%8.3" ECU_ADDRESS 0xD0006EDE /end MEASUREMENT
/begin MEASUREMENT InjCrv_phiMI1DesB1 "" SWORD AngleCrS 1 100 -720.0220 720.0000 FORMAT "%8.4" ECU_ADDRESS 0xD000719E /end MEASUREMENT
/begin MEASUREMENT InjCrv_phiMI1DesB2 "" SWORD AngleCrS 1 100 -720.0220 720.0000 FORMAT "%8.4" ECU_ADDRESS 0xD00071A0 /end MEASUREMENT
/begin MEASUREMENT ThrVlv_rActB1 "" SWORD DtyCyc 1 100 -327.6800 327.6700 FORMAT "%8.4" ECU_ADDRESS 0xD0007570 /end MEASUREMENT
/begin MEASUREMENT ThrVlv_rActB2 "" SWORD DtyCyc 1 100 -327.6800 327.6700 FORMAT "%8.4" ECU_ADDRESS 0xD0007572 /end MEASUREMENT
/begin MEASUREMENT TrbCh_rActB1 "" SWORD Prc 1 100 -400.0000 399.9878 FORMAT "%8.4" ECU_ADDRESS 0xD00075A0 /end MEASUREMENT
/begin MEASUREMENT TrbCh_rActB2 "" SWORD Prc 1 100 -400.0000 399.9878 FORMAT "%8.4" ECU_ADDRESS 0xD00075A2 /end MEASUREMENT
/begin MEASUREMENT VehMot_stBrkPed "" UBYTE OneToOne 1 100 0.00 255.0 FORMAT "%5.1" ECU_ADDRESS 0xD0009196 /end MEASUREMENT
/begin MEASUREMENT VSwVlv_rB1 "" SWORD Prc 1 100 -400.0000 399.9878 FORMAT "%8.4" ECU_ADDRESS 0xD00075BE /end MEASUREMENT
/begin MEASUREMENT VSwVlv_rB2 "" SWORD Prc 1 100 -400.0000 399.9878 FORMAT "%8.4" ECU_ADDRESS 0xD00075C0 /end MEASUREMENT
/begin FUNCTION ASDrf_Governor ""
 /begin DEF_CHARACTERISTIC ASDrf_CoefADecrLim_C ASDrf_CoefBDecrLim_C ASDrf_dtrqIncrLimHi_C ASDrf_dtrqIncrLimLo_C ASDrf_dtrqInrLtdLim_CUR ASDrf_dtrqSteepNeg_C ASDrf_dtrqSteepPos_C ASDrf_swtCalcTrq_C ASDrf_swtFlt_C ASDrf_swtFrzLos_C ASDrf_swtIniParSet_C ASDrf_swtLim_C ASDrf_T1Flt_C ASDrf_tiTrqSty_C ASDrf_trqDecrHi_C ASDrf_trqDecrLo_C ASDrf_trqOfsNegHi_C ASDrf_trqOfsNegLo_C ASDrf_trqOfsNegMid_C ASDrf_trqOfsPosHi_C ASDrf_trqOfsPosLo_C ASDrf_trqOfsPosMid_C ASDrf_trqThresDecrLim_C ASDrf_trqThresNeg_C ASDrf_trqThresPos_C /end DEF_CHARACTERISTIC
 /begin IN_MEASUREMENT ASDdc_trq ASDrf_trqLosNeg ASDrf_trqLosPos CoETS_trqInrLtd EngDem_trqInrLim PthSet_stOvrRun PthSet_trqASDrfInit /end IN_MEASUREMENT
 /begin OUT_MEASUREMENT ASDrf_stIni ASDrf_stLAD ASDrf_trqInrSet /end OUT_MEASUREMENT
 /begin LOC_MEASUREMENT ASDrf_CoefALADCurr_mp ASDrf_CoefBLADCurr_mp ASDrf_dtrqDecrMax_mp ASDrf_dtrqDecrMin_mp ASDrf_dtrqInrLtd_mp ASDrf_dtrqLosMax_mp ASDrf_dtrqLosMin_mp ASDrf_dtrqLtd_mp ASDrf_dtrqMax_mp ASDrf_dtrqMin_mp ASDrf_KdFltCurr_mp ASDrf_stDecrLimSt_mp ASDrf_stIncrLim_mp ASDrf_stInidtrqSteep_mp ASDrf_stPosNeg_mp ASDrf_stTrqLim_mp ASDrf_T1FltCurr_mp ASDrf_trqASDSum_mp ASDrf_trqCompOfs_mp ASDrf_trqDecrLimStrt_mp ASDrf_trqIni_mp ASDrf_trqInrLtdFlt_mp ASDrf_trqInrSetMaxUnLtd_mp ASDrf_trqInrSetMax_mp ASDrf_trqInrSetMinUnLtd_mp ASDrf_trqInrSetMin_mp ASDrf_trqInrSetUnLtd_mp ASDrf_trqLos_mp ASDrf_trqPT1In_mp ASDrf_trqPT1Out_mp ASDrf_trqPT1P_mp ASDrf_trqP_mp ASDrf_trqStyHi_mp ASDrf_trqStyLo_mp /end LOC_MEASUREMENT
/end FUNCTION
/begin FUNCTION ASDrf_SelectParameter ""
 /begin DEF_CHARACTERISTIC ASDrf_FltClthNeg.T1_C ASDrf_FltClthNeg.Kd_C ASDrf_FltClthPos.T1_C ASDrf_FltClthPos.Kd_C ASDrf_FltExtIntv.T1_C ASDrf_FltExtIntv.Kd_C ASDrf_FltGripNeg.T1_CUR ASDrf_FltGripNeg.Kd_CUR ASDrf_FltGripPos.T1_CUR ASDrf_FltGripPos.Kd_CUR ASDrf_FltSt3Neg.T1_C ASDrf_FltSt3Neg.Kd_C ASDrf_FltSt3Pos.T1_C ASDrf_FltSt3Pos.Kd_C ASDrf_FltSt4Neg.T1_C ASDrf_FltSt4Neg.Kd_C ASDrf_FltSt4Pos.T1_C ASDrf_FltSt4Pos.Kd_C ASDrf_LADClthNeg.CoefA_C ASDrf_LADClthNeg.CoefB_C ASDrf_LADClthPos.CoefA_C ASDrf_LADClthPos.CoefB_C ASDrf_LADExtIntv.CoefA_C ASDrf_LADExtIntv.CoefB_C ASDrf_LADGripNeg.CoefA_CUR ASDrf_LADGripNeg.CoefB_CUR ASDrf_LADGripPos.CoefA_CUR ASDrf_LADGripPos.CoefB_CUR ASDrf_LADSt3Neg.CoefA_C ASDrf_LADSt3Neg.CoefB_C ASDrf_LADSt3Pos.CoefA_C ASDrf_LADSt3Pos.CoefB_C ASDrf_LADSt4Neg.CoefA_C ASDrf_LADSt4Neg.CoefB_C ASDrf_LADSt4Pos.CoefA_C ASDrf_LADSt4Pos.CoefB_C ASDrf_numDflSt_C ASDrf_numPrio_CA ASDrf_stCfgClthOpn_C ASDrf_stCfgClthSlipClsd_C ASDrf_stCfgClthSlipOpn_C ASDrf_stCfgClthSlip_C ASDrf_stCfgConExtIntv_C ASDrf_stEntcClth_C ASDrf_stEntcExtIntv_C ASDrf_stEntcGrip_C ASDrf_stEntcSt3_C ASDrf_stEntcSt4_C ASDrf_stExClth_C ASDrf_stExExtIntv_C ASDrf_stExGrip_C ASDrf_stExSt3_C ASDrf_stExSt4_C ASDrf_stExtIntv_C ASDrf_stGrip_C ASDrf_swtLosCalc_C ASDrf_swtOpr_C ASDrf_trqLosNeg_CUR ASDrf_trqLosPos_CUR /end DEF_CHARACTERISTIC
 /begin IN_MEASUREMENT ASDrf_stIni Clth_st CoPT_trqDesCompEng Epm_nEng GlbDa_stTrqDem PT_rTrq PT_stGrip RngMod_trqLosAdap /end IN_MEASUREMENT
 /begin OUT_MEASUREMENT ASDrf_trqLosNeg ASDrf_trqLosPos /end OUT_MEASUREMENT
 /begin LOC_MEASUREMENT ASDrf_stCon_mp ASDrf_stPrioSt_mp ASDrf_stSelSt_mp ASDrf_stVldSt_mp /end LOC_MEASUREMENT
/end FUNCTION
/begin FUNCTION ASMod_Adapt ""
 /begin DEF_CHARACTERISTIC AFS_dmB1_C AFS_dmB2_C AFS_mAirPerCylB1_C AFS_mAirPerCylB2_C Air_pUnFltPCACDsB1_C Air_pUnFltPCACDsB2_C Air_tCACDsB1_C Air_tCACDsB2_C ECBVlv_rB1_C ECBVlv_rB2_C EGRVlv_rActB1_C EGRVlv_rActB2_C Exh_pAdapPPFltDiffB1_C Exh_pAdapPPFltDiffB2_C Exh_pPFltUsB1_C Exh_pPFltUsB2_C Exh_tPFltUsB1_C Exh_tPFltUsB2_C InjCrv_phiMI1DesB1_C InjCrv_phiMI1DesB2_C ThrVlv_rActB1_C ThrVlv_rActB2_C TrbCh_rActB1_C TrbCh_rActB2_C VSwVlv_rB1_C VSwVlv_rB2_C /end DEF_CHARACTERISTIC
 /begin OUT_MEASUREMENT AFS_dmB1 AFS_dmB2 AFS_mAirPerCylB1 AFS_mAirPerCylB2 Air_pUnFltPCACDsB1 Air_pUnFltPCACDsB2 Air_tCACDsB1 Air_tCACDsB2 ECBVlv_rB1 ECBVlv_rB2 EGRVlv_rActB1 EGRVlv_rActB2 Exh_pAdapPPFltDiffB1 Exh_pAdapPPFltDiffB2 Exh_pPFltUsB1 Exh_pPFltUsB2 Exh_tPFltUsB1 Exh_tPFltUsB2 InjCrv_phiMI1DesB1 InjCrv_phiMI1DesB2 ThrVlv_rActB1 ThrVlv_rActB2 TrbCh_rActB1 TrbCh_rActB2 VSwVlv_rB1 /end OUT_MEASUREMENT
 /begin LOC_MEASUREMENT VSwVlv_rB2 /end LOC_MEASUREMENT
/end FUNCTION
/begin FUNCTION ASMod_Co ""
 /begin DEF_CHARACTERISTIC ASMod_cpGs_C ASMod_nThresDwn_C ASMod_numBnk_C ASMod_numEnvPres_C ASMod_numMixPntEGDs_C ASMod_numMixPntEGUs_C ASMod_numNSCDs_C ASMod_numNSCUs_C ASMod_numOxiCDs_C ASMod_numOxiCUs_C ASMod_numPFltDs_C ASMod_numPFltUs_C ASMod_numTrbnDs_C ASMod_numTrbn_C ASMod_pInit_C ASMod_rECBLin_CUR ASMod_rTVALin_CUR ASMod_rVSALin_CUR ASMod_tInit_C ASMod_tiRelPosECBPT1_C ASMod_tiRelPosTVAPT1_C ASMod_tiRelPosVSAPT1_C /end DEF_CHARACTERISTIC
 /begin IN_MEASUREMENT AFS_dm AFS_mAirPerCyl ECBVlv_r Epm_nEng InjCtl_qSetUnBal ThrVlv_rAct VSwVlv_r /end IN_MEASUREMENT
 /begin OUT_MEASUREMENT ASMod_dmAFSCor ASMod_dmEGFld ASMod_pEGFld ASMod_qCor ASMod_qInjCmb ASMod_qInjNoCmb ASMod_rLamRecDfl ASMod_rO2EGFld ASMod_rRelPosECB ASMod_rRelPosTVA ASMod_rRelPosVSA ASMod_stInit ASMod_tEGFld ASMod_tWallFld /end OUT_MEASUREMENT
 /begin LOC_MEASUREMENT ASMod_rECBLinCrvIn_mp ASMod_rTVALinCrvIn_mp ASMod_rVSALinCrvIn_mp /end LOC_MEASUREMENT
/end FUNCTION
/begin FUNCTION ASMod_DetCylCh ""
 /begin DEF_CHARACTERISTIC ASMod_etaEGRClg_MAP ASMod_tEGRDsMin_C ASMod_tiTempEGRDsPT1_C /end DEF_CHARACTERISTIC
 /begin IN_MEASUREMENT Air_tCACDs ASMod_dmExhMnfUs ASMod_dmIntMnfUs ASMod_dvolIntMnfDsRef ASMod_pIntMnf ASMod_rO2ExhMnfUs ASMod_rRelPosECB ASMod_stInit EngDa_tEng /end IN_MEASUREMENT
 /begin OUT_MEASUREMENT ASMod_dmEGRDs ASMod_dmExhMnfDs ASMod_dmIntMnfDs ASMod_dmO2IntMnfDs ASMod_rEGR ASMod_rLamRecExhMnfDs ASMod_rO2ExhMnfDs ASMod_tEGRDs ASMod_tExhMnfDs ASMod_tIntMnfDs /end OUT_MEASUREMENT
 /begin LOC_MEASUREMENT ASMod_dmEGR_mp ASMod_etaEGRClg_mp ASMod_rO2IntMnfDs_mp ASMod_tDiffEGRClg_mp ASMod_tMixPntEGDs_mp ASMod_tMixPntEGUs_mp /end LOC_MEASUREMENT
/end FUNCTION
/begin FUNCTION ASMod_Eng ""
 /begin DEF_CHARACTERISTIC ASMod_dmAshEG_CUR ASMod_dmIntMnfDsRef_MAP ASMod_dmNOxBas_MAP ASMod_dmNOxRatEGRCorBas_MAP ASMod_dmOilConsBas_MAP ASMod_dmSotBas_MAP ASMod_dmSotLamCor_MAP ASMod_dmSotRatEGRCorBas_MAP ASMod_dmSOxEG_CUR ASMod_facDdT_C ASMod_facEGTempMsFlwCor_CUR ASMod_facEGTempSOICor_CUR ASMod_facNOxRatEGRCor_CUR ASMod_facOilConsLfTCor_CUR ASMod_facSotRatEGRCor_CUR ASMod_phiSOIRef_MAP ASMod_rLamRecRef_MAP ASMod_tDiffEngBas_MAP ASMod_tEGEngTempCor_CUR ASMod_tEngRef_C /end DEF_CHARACTERISTIC
 /begin IN_MEASUREMENT ASMod_dmIntMnfDs ASMod_dmO2IntMnfDs ASMod_qInjCmb ASMod_qInjNoCmb ASMod_rEGR ASMod_rLamRecDfl ASMod_stInit ASMod_tIntMnfDs EngDa_tEng EngDa_tiEngOn Epm_nEng Epm_numCyl InjCrv_phiMI1Des /end IN_MEASUREMENT
 /begin OUT_MEASUREMENT ASMod_dmExhMnfUs ASMod_dmOilCons ASMod_rAshEG ASMod_rFlEG ASMod_rLamRecEG ASMod_rNOxEG ASMod_rO2ExhMnfUs ASMod_rSotEG ASMod_rSOxEG ASMod_tExhMnfUs /end OUT_MEASUREMENT
 /begin LOC_MEASUREMENT ASMod_dmAshEG_mp ASMod_dmEG_mp ASMod_dmFlBrn_mp ASMod_dmFlEG_mp ASMod_dmFlInjCmb_mp ASMod_dmFlInjNoCmb_mp ASMod_dmFlNoBrn_mp ASMod_dmIntMnfDsRef_mp ASMod_dmNOxBas_mp ASMod_dmNOxEG_mp ASMod_dmNOxRatEGRCorBas_mp ASMod_dmNOxRatEGRCor_mp ASMod_dmO2EG_mp ASMod_dmOilConsBas_mp ASMod_dmOilConsCrvIn_mp ASMod_dmSotBas_mp ASMod_dmSotCor_mp ASMod_dmSotEG_mp ASMod_dmSotLamCor_mp ASMod_dmSotRatEGRCorBas_mp ASMod_dmSotRatEGRCor_mp ASMod_dmSOxEG_mp ASMod_facEGTempMsFlwCor_mp ASMod_facEGTempSOICor_mp ASMod_facNOxRatEGRCor_mp ASMod_facSotRatEGRCor_mp ASMod_phiDiffSOIRef_mp ASMod_phiSOIRef_mp ASMod_qBrn_mp ASMod_rEGRCrvIn_mp ASMod_rFlBrn_mp ASMod_rLamRecDiffRef_mp ASMod_rLamRecEGCrvIn_mp ASMod_rLamRecRef_mp ASMod_rMsFlwRef_mp ASMod_rO2EG_mp ASMod_tDiffEG_mp ASMod_tDiffEngBas_mp ASMod_tDiffEngRef_mp ASMod_tEGEngTempCor_mp ASMod_tEG_mp ASMod_tiDdT_mp ASMod_tiEngOn_mp /end LOC_MEASUREMENT
/end FUNCTION
/begin FUNCTION asmod_indvol ""
 /begin DEF_CHARACTERISTIC ASMod_arEffTVA_CUR ASMod_facSqr_CUR ASMod_tiMsFlwIndVolPT1_C ASMod_volIndVol_C /end DEF_CHARACTERISTIC
 /begin IN_MEASUREMENT Air_pUnFltPCACDs Air_tCACDs ASMod_dmAFSCor ASMod_rRelPosTVA ASMod_stInit Epm_nEng Epm_numCyl /end IN_MEASUREMENT
 /begin OUT_MEASUREMENT ASMod_dmIntMnfUs ASMod_mAirPerCylCor ASMod_pIntMnf /end OUT_MEASUREMENT
 /begin LOC_MEASUREMENT ASMod_arEffTVA_mp ASMod_dmIndVolRaw_mp ASMod_dmIndVol_mp ASMod_facArgSqr_mp ASMod_facSqr_mp ASMod_mIndVol_mp /end LOC_MEASUREMENT
/end FUNCTION
/begin FUNCTION ASMod_PresPipe ""
 /begin DEF_CHARACTERISTIC ASMod_facGeoEGPipe_CA ASMod_facPowEGPipe_CUR ASMod_facRhoEtaEGPipe_MAP ASMod_pDiffPipe0_MAP ASMod_pDiffPipe1_MAP ASMod_pDiffPipe2_MAP ASMod_pDiffPipe3_MAP ASMod_swtPresCalc_C /end DEF_CHARACTERISTIC
 /begin IN_MEASUREMENT ASMod_dmEGFld ASMod_pEGFld ASMod_tEGFld EnvP_p Epm_nEng InjCtl_qSetUnBal /end IN_MEASUREMENT
 /begin OUT_MEASUREMENT ASMod_dpExhGsMap_mp ASMod_dpExhGsSim_mp ASMod_dVolEGPipe_mp ASMod_facPowEGPipe_mp ASMod_facRhoEtaEGPipe_mp ASMod_pDiffEGPipe_mp /end OUT_MEASUREMENT
 /begin LOC_MEASUREMENT ASMod_dVolEGPipe1_mp ASMod_pEGFld_mp ASMod_tEGFld_mp /end LOC_MEASUREMENT
/end FUNCTION
/begin FUNCTION ASMod_TempNSC ""
 /begin DEF_CHARACTERISTIC ASMod_cpNSC_C ASMod_swtTimeNSC_C ASMod_tiNSCPT1_C ASMod_tNSCDfl_C ASMod_tNSCExoIncr_MAP /end DEF_CHARACTERISTIC
 /begin IN_MEASUREMENT ASMod_dmExhMnfDs ASMod_pEGFld ASMod_rLamRecExhMnfDs ASMod_tEGFld ASMod_tNSCStrt CoEng_stEng /end IN_MEASUREMENT
 /begin OUT_MEASUREMENT ASMod_tAvrgNSC_mp ASMod_tNSCDs ASMod_tNSCExoIncr_mp ASMod_tNSCStat_mp ASMod_tNSCUs_mp /end OUT_MEASUREMENT
/end FUNCTION
/begin FUNCTION ASMod_TempOxiC ""
 /begin DEF_CHARACTERISTIC ASMod_cpOxiC_C ASMod_facCalValFl_C ASMod_facTempCmb_CUR ASMod_swtTimeOxiC_C ASMod_tiOxiCPT1_C ASMod_tOxiCDfl_C ASMod_tOxiCExoIncr_MAP /end DEF_CHARACTERISTIC
 /begin IN_MEASUREMENT ASMod_dmEGFld ASMod_pEGFld ASMod_rFlEG ASMod_rLamRecExhMnfDs ASMod_rO2EGFld ASMod_tEGFld ASMod_tOxiCStrt CoEng_stEng /end IN_MEASUREMENT
 /begin OUT_MEASUREMENT ASMod_dmFlCmbEffOxiC_mp ASMod_dmFlCmbOxiC_mp ASMod_dmO2OxiCDiff ASMod_dmO2OxiCDs_mp ASMod_dmO2OxiC_mp ASMod_dwFlCmb_mp ASMod_facPT1_mp ASMod_remOxy_mp ASMod_tAvrgOxiC_mp ASMod_tIncrPoI_mp ASMod_tOxiCDiff ASMod_tOxiCDs ASMod_tOxiCExoIncr_mp ASMod_tOxiCStat_mp ASMod_tOxiCUs_mp ASMod_unBrnFl_mp /end OUT_MEASUREMENT
 /begin LOC_MEASUREMENT ASMod_rLamRecExhMnfDsMapIn_mp /end LOC_MEASUREMENT
/end FUNCTION
/begin FUNCTION ASMod_TempPFlt ""
 /begin DEF_CHARACTERISTIC ASMod_cpPFlt_C ASMod_facHtTransNoLin_CUR ASMod_facPFltBlwBy_C ASMod_swtPFltTempModOff_C ASMod_swtPresMidPFlt_C ASMod_TempPFltDT1.T1_C ASMod_TempPFltDT1.Kd_C ASMod_TempPFltI.Ki_C ASMod_TempPFltI.KiPos_C ASMod_TempPFltI.KiNeg_C ASMod_TempPFltI.WinPos_C ASMod_TempPFltI.WinNeg_C ASMod_tiExhGsDelPFlt_CUR ASMod_tiHtTransDT1_CUR ASMod_tiPFltPT1_C /end DEF_CHARACTERISTIC
 /begin IN_MEASUREMENT ASMod_dmExhMnfDs CoEng_stEng Exh_pAdapPPFltDiff Exh_pPFltUs Exh_tPFltUs /end IN_MEASUREMENT
 /begin OUT_MEASUREMENT ASMod_dmPFltUs ASMod_dvolPFltEG ASMod_pMidPFlt ASMod_pPFltSimDs ASMod_pPFltUs_mp ASMod_tHtTransCor_mp ASMod_tiExhGsDelPFlt_mp ASMod_tiHtTransDT1_mp ASMod_tPFltCorUs_mp ASMod_tPFltDiffCorr_mp ASMod_tPFltFlt_mp ASMod_tPFltSimDiff ASMod_tPFltSimDs ASMod_tPFltSurfSim ASMod_tPFltSurfSim_mp ASMod_tPFltTotCorUs_mp ASMod_tPFltUs /end OUT_MEASUREMENT
 /begin LOC_MEASUREMENT ASMod_dmPFltUsCrvIn_mp /end LOC_MEASUREMENT
/end FUNCTION
/begin FUNCTION ASMod_TempPFlt_Inl2 "" /begin IN_MEASUREMENT ASMod_dmEGFld ASMod_pEGFld ASMod_rO2EGFld ASMod_tEGFld /end IN_MEASUREMENT /end FUNCTION
/begin FUNCTION ASMod_TempPipe ""
 /begin DEF_CHARACTERISTIC ASMod_cndHtOfs_C ASMod_cpPipe_CA ASMod_facCndHtSlp_C ASMod_facVscDynSlp_C ASMod_facVscKinSlp_C ASMod_htcFreeCnvtPipe_CA ASMod_lDiamPipe_CA ASMod_lLngthPipe_CA ASMod_nuPipeEnv_CUR ASMod_nuPipe_CUR ASMod_rArPipe_CA ASMod_TempPipeI.Ki_C ASMod_TempPipeI.KiPos_C ASMod_TempPipeI.KiNeg_C ASMod_TempPipeI.WinPos_C ASMod_TempPipeI.WinNeg_C ASMod_tPipeDfl_C ASMod_tWallPipeDfl_C ASMod_vscDynOfs_C ASMod_vscKinOfs_C /end DEF_CHARACTERISTIC
 /begin IN_MEASUREMENT ASMod_dmEGFld ASMod_tEGFld ASMod_tPipeStrt ASMod_tWallFld CoEng_stEng EnvT_t VehV_v /end IN_MEASUREMENT
 /begin OUT_MEASUREMENT ASMod_arPipe_mp ASMod_cndHtAir_mp ASMod_cndHtEG_mp ASMod_dtPipe_mp ASMod_dwEGPipe_mp ASMod_dwPipeEnv_mp ASMod_dwPipeIn_mp ASMod_dwPipeOut_mp ASMod_dwPipe_mp ASMod_htcArEGPipe_mp ASMod_htcArPipeEnv_mp ASMod_htcEGPipe_mp ASMod_htcPipeEnv_mp ASMod_htcPipe_mp ASMod_nuPipeEnv_mp ASMod_nuPipe_mp ASMod_rePipeEnv_mp ASMod_rePipe_mp ASMod_tDiffEGPipe_mp ASMod_tDiffPipeEnv_mp ASMod_tEGPipeDs_mp ASMod_tMidEGPipe_mp ASMod_tMidPipeEnv_mp ASMod_tWallPipe_mp ASMod_vscDynPipe_mp ASMod_vscKinPipe_mp /end OUT_MEASUREMENT
 /begin LOC_MEASUREMENT ASMod_rePipe1_mp ASMod_rePipeEnv1_mp /end LOC_MEASUREMENT
/end FUNCTION
/begin FUNCTION ASMod_TempPipeSlw ""
 /begin DEF_CHARACTERISTIC ASMod_cndHtOfsSlw_C ASMod_cpPipeSlw_CA ASMod_facCndHtSlpSlw_C ASMod_facVscDynSlpSlw_C ASMod_facVscKinSlpSlw_C ASMod_htcFreeCnvtPipeSlw_CA ASMod_lDiamPipeSlw_CA ASMod_lLngthPipeSlw_CA ASMod_nuPipeEnvSlw_CUR ASMod_nuPipeSlw_CUR ASMod_rArPipeSlw_CA ASMod_TempPipeSlwI.Ki_C ASMod_TempPipeSlwI.KiPos_C ASMod_TempPipeSlwI.KiNeg_C ASMod_TempPipeSlwI.WinPos_C ASMod_TempPipeSlwI.WinNeg_C ASMod_tPipeDflSlw_C ASMod_tWallPipeDflSlw_C ASMod_vscDynOfsSlw_C ASMod_vscKinOfsSlw_C /end DEF_CHARACTERISTIC
 /begin IN_MEASUREMENT ASMod_dmEGFld ASMod_tEGFld ASMod_tPipeStrt ASMod_tWallFld CoEng_stEng EnvT_t VehV_v /end IN_MEASUREMENT
 /begin OUT_MEASUREMENT ASMod_arPipeSlw_mp ASMod_cndHtAirSlw_mp ASMod_cndHtEGSlw_mp ASMod_dtPipeSlw_mp ASMod_dwEGPipeSlw_mp ASMod_dwPipeEnvSlw_mp ASMod_dwPipeInSlw_mp ASMod_dwPipeOutSlw_mp ASMod_dwPipeSlw_mp ASMod_htcArEGPipeSlw_mp ASMod_htcArPipeEnvSlw_mp ASMod_htcEGPipeSlw_mp ASMod_htcPipeEnvSlw_mp ASMod_htcPipeSlw_mp ASMod_nuPipeEnvSlw_mp ASMod_nuPipeSlw_mp ASMod_rePipeEnvSlw_mp ASMod_rePipeSlw_mp ASMod_tDiffEGPipeSlw_mp ASMod_tDiffPipeEnvSlw_mp ASMod_tEGPipeSlwDs_mp ASMod_tMidEGPipeSlw_mp ASMod_tMidPipeEnvSlw_mp ASMod_tWallPipeSlw_mp ASMod_vscDynPipeSlw_mp ASMod_vscKinPipeSlw_mp /end OUT_MEASUREMENT
 /begin LOC_MEASUREMENT ASMod_rePipeEnvSlw1_mp ASMod_rePipeSlw1_mp /end LOC_MEASUREMENT
/end FUNCTION
/begin FUNCTION ASMod_TempStrtCalc ""
 /begin DEF_CHARACTERISTIC ASMod_facTempClg_CUR ASMod_facTimeClg_CUR ASMod_numAirTempStrt_C ASMod_numEngTempStrt_C ASMod_tiClgOfs_C ASMod_tiHaValClnt_C ASMod_tiHaValNSC_C ASMod_tiHaValOxiC_C ASMod_tiHaValPipe_CA ASMod_tStrtDfl_C /end DEF_CHARACTERISTIC
 /begin IN_MEASUREMENT AirSys_tFld ASMod_stInit ASMod_tNSCDs ASMod_tOxiCDs ASMod_tWallFld CoEng_stEng EngDa_tFld /end IN_MEASUREMENT
 /begin OUT_MEASUREMENT ASMod_facTempClg1_mp ASMod_facTempClgNSC_mp ASMod_facTempClgOxiC_mp ASMod_rTempClnt_mp ASMod_rTime ASMod_rTimeNSC_mp ASMod_rTimeOxiC_mp ASMod_rTimePipe_mp ASMod_tAirStrt_mp ASMod_tEngStrt_mp ASMod_tExsClnt_mp ASMod_tiClg ASMod_tiClgRef_mp ASMod_tNSCStrt ASMod_tNSCStrt_mp ASMod_tOxiCStrt ASMod_tOxiCStrt_mp ASMod_tPipeStrt ASMod_tPipeStrt_mp ASMod_tShOffExsClnt_mp ASMod_tShOffNSC_mp ASMod_tShOffOxiC_mp ASMod_tShOffPipe_mp /end OUT_MEASUREMENT
/end FUNCTION
/begin FUNCTION asmod_temptrbch ""
 /begin DEF_CHARACTERISTIC ASMod_etaTrbCh_MAP ASMod_numAirTempTrbn_C ASMod_rTempAdbt_CUR ASMod_tiTrbnPT1_C ASMod_tTrbnDsRawDfl_C /end DEF_CHARACTERISTIC
 /begin IN_MEASUREMENT AFS_dm AirSys_tFld Air_pCACDs ASMod_dmExhMnfDs ASMod_tEGFld ASMod_tExhMnfDs CoEng_stEng EnvP_p /end IN_MEASUREMENT
 /begin OUT_MEASUREMENT ASMod_etaTrbCh_mp ASMod_facTrbnPT1_mp ASMod_pwrCmpr_mp ASMod_rPresCmpr_mp ASMod_rTempAdbt_mp ASMod_tAirTrbn_mp ASMod_tTrbnDs ASMod_tTrbnDsRaw ASMod_tTrbnPT1_mp ASMod_tTrbn_mp /end OUT_MEASUREMENT
/end FUNCTION
/begin FUNCTION ASMod_VolEff ""
 /begin DEF_CHARACTERISTIC ASMod_facIntMnfDsTempCor_C ASMod_facVolEffBas_MAP ASMod_facVolEffVSACor_MAP ASMod_tIntMnfDsRef_MAP ASMod_volEng_C /end DEF_CHARACTERISTIC
 /begin IN_MEASUREMENT Air_pUnFltPCACDs Air_tCACDs ASMod_rRelPosVSA Epm_nEng InjCtl_qSetUnBal /end IN_MEASUREMENT
 /begin OUT_MEASUREMENT ASMod_dmIndAirRef ASMod_dvolIntMnfDsRef ASMod_facVolEff ASMod_tIntMnfDsRef ASMod_volEng /end OUT_MEASUREMENT
 /begin LOC_MEASUREMENT ASMod_dvolIntMnfDsRaw_mp ASMod_facVolEffBasCor_mp ASMod_facVolEffBas_mp ASMod_facVolEffTempCor_mp ASMod_facVolEffVSACor_mp ASMod_qSetUnBalCrvIn_mp /end LOC_MEASUREMENT
/end FUNCTION
/begin FUNCTION ATS "" /begin OUT_MEASUREMENT ATS_stMonTimeLimit /end OUT_MEASUREMENT /begin LOC_MEASUREMENT ATS_IntvVal_mp ATS_TstStatus_mp /end LOC_MEASUREMENT /end FUNCTION
/begin FUNCTION ats_auto ""
 /begin DEF_CHARACTERISTIC AirCCmprRedTrq_ATS.LimitTypeMsk_C AirCCmprRedTrq_ATS.CnvNorm_C AirCCmprRedTrq_ATS.CnvLimit_C AirCCmprRedTrq_ATS.LowLim_C AirCCmprRedTrq_ATS.UpLim_C AirCCmprRedTrq_ATS.CnvFac_C AirCCmprRedTrq_ATS.CnvOfs_C AirCCmpr_ATS.LimitTypeMsk_C AirCCmpr_ATS.CnvNorm_C AirCCmpr_ATS.CnvLimit_C AirCCmpr_ATS.LowLim_C AirCCmpr_ATS.UpLim_C AirCCmpr_ATS.CnvFac_C AirCCmpr_ATS.CnvOfs_C ATS_Standby_Disabled_C ATS_tiTstDemHeal_C ATS_tiTstDemMax_C ATS_TmrBehaviour_C ATS_TstDemMaxEngN_C ATS_TstDemMaxVSSCDV_C CByVlv_ATS.LimitTypeMsk_C CByVlv_ATS.CnvNorm_C CByVlv_ATS.CnvLimit_C CByVlv_ATS.LowLim_C CByVlv_ATS.UpLim_C CByVlv_ATS.CnvFac_C CByVlv_ATS.CnvOfs_C CThmst_ATS.LimitTypeMsk_C CThmst_ATS.CnvNorm_C CThmst_ATS.CnvLimit_C CThmst_ATS.LowLim_C CThmst_ATS.UpLim_C CThmst_ATS.CnvFac_C CThmst_ATS.CnvOfs_C ECBVlv_ATS.LimitTypeMsk_C ECBVlv_ATS.CnvNorm_C ECBVlv_ATS.CnvLimit_C ECBVlv_ATS.LowLim_C ECBVlv_ATS.UpLim_C ECBVlv_ATS.CnvFac_C ECBVlv_ATS.CnvOfs_C EMDmpDig0_ATS.LimitTypeMsk_C EMDmpDig0_ATS.CnvNorm_C EMDmpDig0_ATS.CnvLimit_C EMDmpDig0_ATS.LowLim_C EMDmpDig0_ATS.UpLim_C EMDmpDig0_ATS.CnvFac_C EMDmpDig0_ATS.CnvOfs_C EMDmpDig1_ATS.LimitTypeMsk_C EMDmpDig1_ATS.CnvNorm_C EMDmpDig1_ATS.CnvLimit_C EMDmpDig1_ATS.LowLim_C EMDmpDig1_ATS.UpLim_C EMDmpDig1_ATS.CnvFac_C EMDmpDig1_ATS.CnvOfs_C EMDmpPWM0_ATS.LimitTypeMsk_C EMDmpPWM0_ATS.CnvNorm_C EMDmpPWM0_ATS.CnvLimit_C EMDmpPWM0_ATS.LowLim_C EMDmpPWM0_ATS.UpLim_C EMDmpPWM0_ATS.CnvFac_C EMDmpPWM0_ATS.CnvOfs_C EMDmpPWM1_ATS.LimitTypeMsk_C EMDmpPWM1_ATS.CnvNorm_C EMDmpPWM1_ATS.CnvLimit_C EMDmpPWM1_ATS.LowLim_C EMDmpPWM1_ATS.UpLim_C EMDmpPWM1_ATS.CnvFac_C EMDmpPWM1_ATS.CnvOfs_C ErrLmpMIL_ATS.LimitTypeMsk_C ErrLmpMIL_ATS.CnvNorm_C ErrLmpMIL_ATS.CnvLimit_C ErrLmpMIL_ATS.LowLim_C ErrLmpMIL_ATS.UpLim_C ErrLmpMIL_ATS.CnvFac_C ErrLmpMIL_ATS.CnvOfs_C ErrLmpSVS_ATS.LimitTypeMsk_C ErrLmpSVS_ATS.CnvNorm_C ErrLmpSVS_ATS.CnvLimit_C ErrLmpSVS_ATS.LowLim_C ErrLmpSVS_ATS.UpLim_C ErrLmpSVS_ATS.CnvFac_C ErrLmpSVS_ATS.CnvOfs_C FanOut1_ATS.LimitTypeMsk_C FanOut1_ATS.CnvNorm_C FanOut1_ATS.CnvLimit_C FanOut1_ATS.LowLim_C FanOut1_ATS.UpLim_C FanOut1_ATS.CnvFac_C FanOut1_ATS.CnvOfs_C MeUn_ActrTst_ATS.LimitTypeMsk_C MeUn_ActrTst_ATS.CnvNorm_C MeUn_ActrTst_ATS.CnvLimit_C MeUn_ActrTst_ATS.LowLim_C MeUn_ActrTst_ATS.UpLim_C MeUn_ActrTst_ATS.CnvFac_C MeUn_ActrTst_ATS.CnvOfs_C OilPLmp_ATS.LimitTypeMsk_C OilPLmp_ATS.CnvNorm_C OilPLmp_ATS.CnvLimit_C OilPLmp_ATS.LowLim_C OilPLmp_ATS.UpLim_C OilPLmp_ATS.CnvFac_C OilPLmp_ATS.CnvOfs_C PCV_ActrTst_ATS.LimitTypeMsk_C PCV_ActrTst_ATS.CnvNorm_C PCV_ActrTst_ATS.CnvLimit_C PCV_ActrTst_ATS.LowLim_C PCV_ActrTst_ATS.UpLim_C PCV_ActrTst_ATS.CnvFac_C PCV_ActrTst_ATS.CnvOfs_C PFltLmp_ATS.LimitTypeMsk_C PFltLmp_ATS.CnvNorm_C PFltLmp_ATS.CnvLimit_C PFltLmp_ATS.LowLim_C PFltLmp_ATS.UpLim_C PFltLmp_ATS.CnvFac_C PFltLmp_ATS.CnvOfs_C Strt_ATS.LimitTypeMsk_C Strt_ATS.CnvNorm_C Strt_ATS.CnvLimit_C Strt_ATS.LowLim_C Strt_ATS.UpLim_C Strt_ATS.CnvFac_C Strt_ATS.CnvOfs_C ThrVlv_ATS.LimitTypeMsk_C ThrVlv_ATS.CnvNorm_C ThrVlv_ATS.CnvLimit_C ThrVlv_ATS.LowLim_C ThrVlv_ATS.UpLim_C ThrVlv_ATS.CnvFac_C ThrVlv_ATS.CnvOfs_C TrbChLP_ATS.LimitTypeMsk_C TrbChLP_ATS.CnvNorm_C TrbChLP_ATS.CnvLimit_C TrbChLP_ATS.LowLim_C TrbChLP_ATS.UpLim_C TrbChLP_ATS.CnvFac_C TrbChLP_ATS.CnvOfs_C TrbCh_ATS.LimitTypeMsk_C TrbCh_ATS.CnvNorm_C TrbCh_ATS.CnvLimit_C TrbCh_ATS.LowLim_C TrbCh_ATS.UpLim_C TrbCh_ATS.CnvFac_C TrbCh_ATS.CnvOfs_C VSwVlv_ATS.LimitTypeMsk_C VSwVlv_ATS.CnvNorm_C VSwVlv_ATS.CnvLimit_C VSwVlv_ATS.LowLim_C VSwVlv_ATS.UpLim_C VSwVlv_ATS.CnvFac_C VSwVlv_ATS.CnvOfs_C WaHtEl_ATS.LimitTypeMsk_C WaHtEl_ATS.CnvNorm_C WaHtEl_ATS.CnvLimit_C WaHtEl_ATS.LowLim_C WaHtEl_ATS.UpLim_C WaHtEl_ATS.CnvFac_C WaHtEl_ATS.CnvOfs_C /end DEF_CHARACTERISTIC
/end FUNCTION
/begin FUNCTION avs "" /end FUNCTION
/begin FUNCTION BattU_DD "" /begin DEF_CHARACTERISTIC BattU_uTransf_CUR /end DEF_CHARACTERISTIC /begin OUT_MEASUREMENT BattU_uRaw BattU_uSens /end OUT_MEASUREMENT /end FUNCTION
/begin FUNCTION BattU_VD ""
 /begin DEF_CHARACTERISTIC BattU_RmpSlp.Pos_C BattU_RmpSlp.Neg_C BattU_swtRated_C BattU_TransStagePar.Dfl_C BattU_TransStagePar.stSensId_C BattU_uNrm_C BattU_uSRCMax_C BattU_uSRCMin_C /end DEF_CHARACTERISTIC
 /begin OUT_MEASUREMENT BattU_facCor BattU_u BattU_uRated /end OUT_MEASUREMENT
/end FUNCTION
/begin FUNCTION Batt_DataAcq "" /begin IN_MEASUREMENT BattU_u /end IN_MEASUREMENT /begin OUT_MEASUREMENT ESS_uBatt /end OUT_MEASUREMENT /end FUNCTION
/begin FUNCTION BrkECU_Can ""
 /begin DEF_CHARACTERISTIC Com_swtLenkradwinkel_C Com_swtStateDsc_C Com_swtTrqDemandDsc_C Com_swtVelocity_C Com_swtWheelSpeed_C /end DEF_CHARACTERISTIC
 /begin OUT_MEASUREMENT Com_v /end OUT_MEASUREMENT
/end FUNCTION
/begin FUNCTION BrkECU_co "" /begin DEF_CHARACTERISTIC Com_swtCalcVehV_C Com_swtCorTrqDSC_C /end DEF_CHARACTERISTIC
 /begin OUT_MEASUREMENT Com_dTrqDemandDscCHK Com_dTrqDemandDscCTR Com_pBrkSys Com_stClCtr Com_stDecellDSC Com_stDSC Com_stTrqDSCDes Com_trqDSCDes Com_vWheelFL Com_vWheelFR Com_vWheelRL Com_vWheelRR /end OUT_MEASUREMENT
 /begin LOC_MEASUREMENT Com_aDirect Com_aSide Com_dphiStWhlAg Com_dphiStWhlAgRaw Com_phiStWhlAg Com_phiStWhlAgRaw Com_stphiStWhlAg Com_vBd /end LOC_MEASUREMENT
/end FUNCTION
/begin FUNCTION brkped_setdata "" /begin IN_MEASUREMENT Brk_st /end IN_MEASUREMENT /begin OUT_MEASUREMENT VehMot_stBrkPed /end OUT_MEASUREMENT /end FUNCTION
/begin FUNCTION brkp_dd "" /begin DEF_CHARACTERISTIC BrkP_pTransf_CUR BrkP_SRC.uMin_C BrkP_SRC.uMax_C /end DEF_CHARACTERISTIC /begin OUT_MEASUREMENT BrkP_pSens BrkP_uRaw /end OUT_MEASUREMENT /end FUNCTION
/begin FUNCTION brkp_vd ""
 /begin DEF_CHARACTERISTIC BrkP_pDfl_C BrkP_RmpSlp.Pos_C BrkP_RmpSlp.Neg_C BrkP_swtSensPrs_C BrkP_TransStg.Dfl_C BrkP_TransStg.stSensId_C /end DEF_CHARACTERISTIC
 /begin IN_MEASUREMENT CEngDsT_t /end IN_MEASUREMENT
 /begin OUT_MEASUREMENT BrkP_p /end OUT_MEASUREMENT
/end FUNCTION
/begin FUNCTION Brk_DD ""
 /begin DEF_CHARACTERISTIC Brk_MnDeb.tiHiLo_C Brk_MnDeb.tiLoHi_C Brk_RedDeb.tiHiLo_C Brk_RedDeb.tiLoHi_C Brk_swtSig_C /end DEF_CHARACTERISTIC
/end FUNCTION
/begin FUNCTION brk_VD ""
 /begin DEF_CHARACTERISTIC Brk_ctPlaDef_C Brk_stDflVal_C Brk_swtRedSensPrs_C Brk_tiDebPlaStat_C Brk_tiDebPla_C Brk_tiDebResPla_C /end DEF_CHARACTERISTIC
 /begin IN_MEASUREMENT Com_stBrk /end IN_MEASUREMENT
 /begin OUT_MEASUREMENT Brk_st Brk_stMn Brk_stMnRaw Brk_stRed Brk_stRedRaw /end OUT_MEASUREMENT
 /begin LOC_MEASUREMENT Brk_ctPla_mp Brk_stDeb_mp Brk_stFreeze_mp Brk_stResPla_mp Brk_tiDebPlaStat_mp /end LOC_MEASUREMENT
/end FUNCTION
/begin FUNCTION Byp "" /end FUNCTION
/begin FUNCTION bypetk_auto "" /end FUNCTION
/begin FUNCTION bypint_auto "" /end FUNCTION
/begin FUNCTION byp_auto "" /end FUNCTION
/begin COMPU_METHOD Acc "" RAT_FUNC "%6.5" "m/s^2" COEFFS 0 1000 0 0 0 1 /end COMPU_METHOD
/begin COMPU_METHOD AirMass "" RAT_FUNC "%6.4" "g" COEFFS 0 100 0 0 0 1 /end COMPU_METHOD
/begin COMPU_METHOD AirMassPerCyl "" RAT_FUNC "%6.3" "mg/Hub" COEFFS 0 10 0 0 0 1 /end COMPU_METHOD
/begin COMPU_METHOD AirMassPerTime "" RAT_FUNC "%6.3" "Kg/h" COEFFS 0 10 0 0 0 1 /end COMPU_METHOD
/begin COMPU_METHOD AirTempFldSel "" TAB_VERB "%6.3" "-" COMPU_TAB_REF AirTempFldSel /end COMPU_METHOD
/begin COMPU_VTAB AirTempFldSel "" TAB_VERB 3 0 "Air_tCACDs" 1 "Air_tAFS" 2 "EnvT_t" /end COMPU_VTAB
/begin COMPU_METHOD AirVolPerTime "" RAT_FUNC "%6.3" "m^3/h" COEFFS 0 10 0 0 0 1 /end COMPU_METHOD
/begin COMPU_METHOD AngleCrS "" RAT_FUNC "%6.4" "deg CrS" COEFFS 0 45.5097222222222 0 0 0 1 /end COMPU_METHOD
/begin COMPU_METHOD AngleStWhl "" RAT_FUNC "%6.4" "deg StWhl" COEFFS 0 32 0 0 0 1 /end COMPU_METHOD
/begin COMPU_METHOD AngleVelStWhl "" RAT_FUNC "%6.4" "deg StWhl/s" COEFFS 0 32 0 0 0 1 /end COMPU_METHOD
/begin COMPU_METHOD Area "" RAT_FUNC "%6.5" "m*m" COEFFS 0 8192 0 0 0 1 /end COMPU_METHOD
/begin COMPU_METHOD Area_cm2 "" RAT_FUNC "%6.5" "cm*cm" COEFFS 0 1000 0 0 0 1 /end COMPU_METHOD
/begin COMPU_METHOD ASDrf_LADCoefA "" RAT_FUNC "%6.4" "1/(s*Nm)" COEFFS 0 204.8 0 0 0 1 /end COMPU_METHOD
/begin COMPU_METHOD ASDrf_numDflSt "" TAB_VERB "%6.3" "-" COMPU_TAB_REF ASDrf_numDflSt /end COMPU_METHOD
/begin COMPU_VTAB ASDrf_numDflSt "" TAB_VERB 5 0 "ExtInt" 1 "Clutch" 2 "Grip" 3 "State3" 4 "State4" /end COMPU_VTAB
/begin COMPU_METHOD AshMassPerTime "" RAT_FUNC "%6.4" "mg/s" COEFFS 0 100 0 0 0 1 /end COMPU_METHOD
/begin COMPU_METHOD Calory "" RAT_FUNC "%6.2" "J/g" COEFFS 0 1 0 0 0 1 /end COMPU_METHOD
/begin COMPU_METHOD COEOM_EGRCLGQNTNUMMAP_SY_Compu "" TAB_NOINTP "%6.3" "-" COMPU_TAB_REF COEOM_EGRCLGQNTNUMMAP_SY_Compu /end COMPU_METHOD
/begin COMPU_TAB COEOM_EGRCLGQNTNUMMAP_SY_Compu "" TAB_NOINTP 8 0 0 1 1 2 2 3 3 4 4 5 5 6 6 7 7 /end COMPU_TAB
/begin COMPU_METHOD COEOM_EGRCLGTRQNUMMAP_SY_Compu "" TAB_NOINTP "%6.3" "-" COMPU_TAB_REF COEOM_EGRCLGTRQNUMMAP_SY_Compu /end COMPU_METHOD
/begin COMPU_TAB COEOM_EGRCLGTRQNUMMAP_SY_Compu "" TAB_NOINTP 8 0 0 1 1 2 2 3 3 4 4 5 5 6 6 7 7 /end COMPU_TAB
/begin COMPU_METHOD COEOM_PCRCTLAUTLPQNTNUMMAP_SY_Compu "" TAB_NOINTP "%6.3" "-" COMPU_TAB_REF COEOM_PCRCTLAUTLPQNTNUMMAP_SY_Compu /end COMPU_METHOD
/begin COMPU_TAB COEOM_PCRCTLAUTLPQNTNUMMAP_SY_Compu "" TAB_NOINTP 8 0 0 1 1 2 2 3 3 4 4 5 5 6 6 7 7 /end COMPU_TAB
/begin COMPU_METHOD dTrq "" RAT_FUNC "%6.3" "Nm/s" COEFFS 0 10 0 0 0 1 /end COMPU_METHOD
/begin COMPU_METHOD DtyCyc "" RAT_FUNC "%6.4" "%" COEFFS 0 100 0 0 0 1 /end COMPU_METHOD
/begin COMPU_METHOD EngN "" RAT_FUNC "%6.3" "rpm" COEFFS 0 2 0 0 0 1 /end COMPU_METHOD
/begin COMPU_METHOD EngN_LRes "" RAT_FUNC "%6.1" "rpm" COEFFS 0 0.025 0 0 0 1 /end COMPU_METHOD
/begin COMPU_METHOD EngTempFldSel "" TAB_VERB "%6.3" "-" COMPU_TAB_REF EngTempFldSel /end COMPU_METHOD
/begin COMPU_VTAB EngTempFldSel "" TAB_VERB 3 0 "Coolant_Temperature" 1 "Oil_Temperature" 2 "EngDa_tEng" /end COMPU_VTAB
/begin COMPU_METHOD Fact "" RAT_FUNC "%6.5" "-" COEFFS 0 8192 0 0 0 1 /end COMPU_METHOD
/begin COMPU_METHOD Fact1 "" RAT_FUNC "%6.4" "-" COEFFS 0 128 0 0 0 1 /end COMPU_METHOD
/begin COMPU_METHOD Fact10 "" RAT_FUNC "%13.12" "-" COEFFS 0 10000000000 0 0 0 1 /end COMPU_METHOD
/begin COMPU_METHOD Fact7 "" RAT_FUNC "%10.9" "-" COEFFS 0 10000000 0 0 0 1 /end COMPU_METHOD
/begin COMPU_METHOD Fact8 "" RAT_FUNC "%11.10" "-" COEFFS 0 100000000 0 0 0 1 /end COMPU_METHOD
/begin COMPU_METHOD Fact_PT1 "" RAT_FUNC "%6.4" "W/K" COEFFS 0 128 0 0 0 1 /end COMPU_METHOD
/begin COMPU_METHOD HeatCapacity "" RAT_FUNC "%6.3" "J/K" COEFFS 0 10 0 0 0 1 /end COMPU_METHOD
/begin COMPU_METHOD InjMass "" RAT_FUNC "%6.4" "mg/hub" COEFFS 0 100 0 0 0 1 /end COMPU_METHOD
/begin COMPU_METHOD InjMassPerTime "" RAT_FUNC "%6.4" "Kg/h" COEFFS 0 100 0 0 0 1 /end COMPU_METHOD
/begin COMPU_METHOD Kd "" RAT_FUNC "%7.6" "1/1" COEFFS 0 65536 0 0 0 1 /end COMPU_METHOD
/begin COMPU_METHOD Kd_Lin_16 "" RAT_FUNC "%7.6" "1/1" COEFFS 0 32767 0 0 0 1 /end COMPU_METHOD
/begin COMPU_METHOD Ki_Ampc2Prc "" RAT_FUNC "%7.6" "%/(mg/Hub Luft)/s" COEFFS 0 17592.186044416 0 0 0 1 /end COMPU_METHOD
/begin COMPU_METHOD Ki_Kelv_Sec "" RAT_FUNC "%6.4" "1/s" COEFFS 0 214.7483648 0 0 0 1 /end COMPU_METHOD
/begin COMPU_METHOD lambdaRecVal "" RAT_FUNC "%6.5" "-" COEFFS 0 1000 0 0 0 1 /end COMPU_METHOD
/begin COMPU_METHOD Length1 "" RAT_FUNC "%6.4" "m" COEFFS 0 128 0 0 0 1 /end COMPU_METHOD
/begin COMPU_METHOD NOxMassPerTime "" RAT_FUNC "%6.3" "mg/s" COEFFS 0 10 0 0 0 1 /end COMPU_METHOD
/begin COMPU_METHOD O2 "" RAT_FUNC "%8.7" "-" COEFFS 0 100000 0 0 0 1 /end COMPU_METHOD
/begin COMPU_METHOD O2MassPerTime "" RAT_FUNC "%6.4" "Kg/h" COEFFS 0 100 0 0 0 1 /end COMPU_METHOD
/begin COMPU_METHOD OilMassPerTime "" RAT_FUNC "%7.6" "mg/s" COEFFS 0 10000 0 0 0 1 /end COMPU_METHOD
/begin COMPU_METHOD OneToOne "" RAT_FUNC "%6.2" "-" COEFFS 0 1 0 0 0 1 /end COMPU_METHOD
/begin COMPU_METHOD Prc "" RAT_FUNC "%6.4" "%" COEFFS 0 81.92 0 0 0 1 /end COMPU_METHOD
/begin COMPU_METHOD Pres_bar "" RAT_FUNC "%6.2" "bar" COEFFS 0 1 0 0 0 1 /end COMPU_METHOD
/begin COMPU_METHOD Pres_hPa "" RAT_FUNC "%6.2" "hPa" COEFFS 0 1 0 0 0 1 /end COMPU_METHOD
/begin COMPU_METHOD Pwr "" RAT_FUNC "%6.2" "W" COEFFS 0 0.10610329539459 0 0 0 1 /end COMPU_METHOD
/begin COMPU_METHOD Pwr1 "" RAT_FUNC "%6.3" "W" COEFFS 0 10 0 0 0 1 /end COMPU_METHOD
/begin COMPU_METHOD RatAirMass "" RAT_FUNC "%6.4" "-" COEFFS 0 100 0 0 0 1 /end COMPU_METHOD
/begin COMPU_METHOD RatAshMass "" RAT_FUNC "%8.7" "-" COEFFS 0 100000 0 0 0 1 /end COMPU_METHOD
/begin COMPU_METHOD RatFuelMass "" RAT_FUNC "%6.4" "-" COEFFS 0 100 0 0 0 1 /end COMPU_METHOD
/begin COMPU_METHOD RatNOxMass "" RAT_FUNC "%10.9" "-" COEFFS 0 10000000 0 0 0 1 /end COMPU_METHOD
/begin COMPU_METHOD RatSotMass "" RAT_FUNC "%8.7" "-" COEFFS 0 100000 0 0 0 1 /end COMPU_METHOD
/begin COMPU_METHOD RatSOxMass "" RAT_FUNC "%11.10" "-" COEFFS 0 100000000 0 0 0 1 /end COMPU_METHOD
/begin COMPU_METHOD ReynoldsNum "" RAT_FUNC "%6.0" "-" COEFFS 0 0.01 0 0 0 1 /end COMPU_METHOD
/begin COMPU_METHOD ReynoldsNum1 "" RAT_FUNC "%7.0" "-" COEFFS 0 0.001 0 0 0 1 /end COMPU_METHOD
/begin COMPU_METHOD RmpTemp "" RAT_FUNC "%6.4" "K/s" COEFFS 0 655.36 0 0 0 1 /end COMPU_METHOD
/begin COMPU_METHOD RmpVoltBatt "" RAT_FUNC "%6.3" "mV/s" COEFFS 0 3.2768 0 0 0 1 /end COMPU_METHOD
/begin COMPU_METHOD SotMassPerTime "" RAT_FUNC "%6.4" "mg/s" COEFFS 0 100 0 0 0 1 /end COMPU_METHOD
/begin COMPU_METHOD SOxMassPerTime "" RAT_FUNC "%7.6" "mg/s" COEFFS 0 10000 0 0 0 1 /end COMPU_METHOD
/begin COMPU_METHOD SpecificHeat "" RAT_FUNC "%7.6" "J/g/K" COEFFS 0 10000 0 0 0 1 /end COMPU_METHOD
/begin COMPU_METHOD TempDiff_Kelv "" RAT_FUNC "%6.3" "K" COEFFS 0 10 0 0 0 1 /end COMPU_METHOD
/begin COMPU_METHOD Temp_Cels "" RAT_FUNC "%6.1" "deg C" COEFFS 0 10 2731.4 0 0 1 /end COMPU_METHOD
/begin COMPU_METHOD Temp_Kelv "" RAT_FUNC "%6.3" "K" COEFFS 0 10 0 0 0 1 /end COMPU_METHOD
/begin COMPU_METHOD Temp_Kelv_Sec "" RAT_FUNC "%6.4" "K/s" COEFFS 0 100 0 0 0 1 /end COMPU_METHOD
/begin COMPU_METHOD ThermalCoEff "" RAT_FUNC "%6.3" "W/m/m/k" COEFFS 0 10 0 0 0 1 /end COMPU_METHOD
/begin COMPU_METHOD TimeDeb "" RAT_FUNC "%6.1" "ms" COEFFS 0 0.1 0 0 0 1 /end COMPU_METHOD
/begin COMPU_METHOD TimeDelay_s "" RAT_FUNC "%12.4" "s" COEFFS 0 0 1 0 0.00023283064365387 0 /end COMPU_METHOD
/begin COMPU_METHOD TimeDelay_s_Lin_16 "" RAT_FUNC "%6.5" "s" COEFFS 0 6553.4 0 0 0 1 /end COMPU_METHOD
/begin COMPU_METHOD TimeHrsEngOn "" RAT_FUNC "%6.0" "100h" COEFFS 0 0.01 0 0 0 1 /end COMPU_METHOD
/begin COMPU_METHOD Time_ms "" RAT_FUNC "%6.1" "ms" COEFFS 0 0.1 0 0 0 1 /end COMPU_METHOD
/begin COMPU_METHOD Time_s "" RAT_FUNC "%6.4" "s" COEFFS 0 100 0 0 0 1 /end COMPU_METHOD
/begin COMPU_METHOD TransR "" RAT_FUNC "%6.4" "-" COEFFS 0 100 0 0 0 1 /end COMPU_METHOD
/begin COMPU_METHOD Trq "" RAT_FUNC "%6.3" "Nm" COEFFS 0 10 0 0 0 1 /end COMPU_METHOD
/begin COMPU_METHOD Trq32 "" RAT_FUNC "%8.7" "Nm" COEFFS 0 655360 0 0 0 1 /end COMPU_METHOD
/begin COMPU_METHOD Vel "" RAT_FUNC "%6.4" "km/h" COEFFS 0 100 0 0 0 1 /end COMPU_METHOD
/begin COMPU_METHOD Vol "" RAT_FUNC "%6.4" "l" COEFFS 0 100 0 0 0 1 /end COMPU_METHOD
/begin COMPU_METHOD Volt "" RAT_FUNC "%6.3" "mV" COEFFS 0 5 0 0 0 1 /end COMPU_METHOD
/begin COMPU_METHOD Volt_Batt "" RAT_FUNC "%6.1" "mV" COEFFS 0 0.05 0 0 0 1 /end COMPU_METHOD
/begin RECORD_LAYOUT Cur_Xs16Ws16 NO_AXIS_PTS_X 1 SWORD AXIS_PTS_X 2 SWORD INDEX_INCR DIRECT FNC_VALUES 3 SWORD COLUMN_DIR DIRECT /end RECORD_LAYOUT
/begin RECORD_LAYOUT Kf_Xs16_Ys16_Ws16 NO_AXIS_PTS_X 1 SWORD NO_AXIS_PTS_Y 2 SWORD AXIS_PTS_X 3 SWORD INDEX_INCR DIRECT AXIS_PTS_Y 4 SWORD INDEX_INCR DIRECT FNC_VALUES 5 SWORD COLUMN_DIR DIRECT /end RECORD_LAYOUT
/begin RECORD_LAYOUT Kl_Xs16_Ws16 NO_AXIS_PTS_X 1 SWORD AXIS_PTS_X 2 SWORD INDEX_INCR DIRECT FNC_VALUES 3 SWORD COLUMN_DIR DIRECT /end RECORD_LAYOUT
/begin RECORD_LAYOUT Kwb_Ws16 FNC_VALUES 1 SWORD COLUMN_DIR DIRECT /end RECORD_LAYOUT
/begin RECORD_LAYOUT Kwb_Ws32 FNC_VALUES 1 SLONG COLUMN_DIR DIRECT /end RECORD_LAYOUT
/begin RECORD_LAYOUT Kwb_Wu8 FNC_VALUES 1 UBYTE COLUMN_DIR DIRECT /end RECORD_LAYOUT
/begin RECORD_LAYOUT Kw_Ws16 FNC_VALUES 1 SWORD COLUMN_DIR DIRECT /end RECORD_LAYOUT
/begin RECORD_LAYOUT Kw_Ws32 FNC_VALUES 1 SLONG COLUMN_DIR DIRECT /end RECORD_LAYOUT
/begin RECORD_LAYOUT Kw_Wu16 FNC_VALUES 1 UWORD COLUMN_DIR DIRECT /end RECORD_LAYOUT
/begin RECORD_LAYOUT Kw_Wu8 FNC_VALUES 1 UBYTE COLUMN_DIR DIRECT /end RECORD_LAYOUT
/begin RECORD_LAYOUT ValA_Wu8 FNC_VALUES 1 UBYTE COLUMN_DIR DIRECT /end RECORD_LAYOUT
/begin RECORD_LAYOUT Val_Ws16 FNC_VALUES 1 SWORD COLUMN_DIR DIRECT /end RECORD_LAYOUT
/begin RECORD_LAYOUT Val_Ws32 FNC_VALUES 1 SLONG COLUMN_DIR DIRECT /end RECORD_LAYOUT
/begin RECORD_LAYOUT Val_Wu16 FNC_VALUES 1 UWORD COLUMN_DIR DIRECT /end RECORD_LAYOUT
/begin RECORD_LAYOUT Val_Wu8 FNC_VALUES 1 UBYTE COLUMN_DIR DIRECT /end RECORD_LAYOUT
/end MODULE
/end PROJECT
