ASAP2_VERSION 1 3
/begin PROJECT P389 "BMW DDE6.0 4-Zylinder V70.2 30.03.2004"
/begin HEADER "" VERSION "V70.2_4Z" PROJECT_NO P389 /end HEADER
/begin MODULE DIM ""
/begin MOD_COMMON "" BYTE_ORDER MSB_FIRST ALIGNMENT_BYTE 1 ALIGNMENT_WORD 2 ALIGNMENT_LONG 4 ALIGNMENT_FLOAT32_IEEE 4 /end MOD_COMMON
/begin CHARACTERISTIC K2REI_dCodInd_C "Kennwert Codier Index" VALUE 0xC045A Kw_Wu8 255.0 OneToOne 0.00 255.0 FORMAT "%3.0" /end CHARACTERISTIC
/begin CHARACTERISTIC K2REI_dDiaInd_C "Kennwerteblock Diagnose Index" VAL_BLK 0xC045B Kwb_Wu8 255.0 OneToOne 0.00 255.0 FORMAT "%3.0" NUMBER 2 /end CHARACTERISTIC
/begin CHARACTERISTIC K2REI_dSGFam_C "Kennwerteblock Steuergeraetefamilie/Motortype" VAL_BLK 0xC0458 Kwb_Wu8 255.0 OneToOne 0.00 255.0 FORMAT "%3.0" NUMBER 2 /end CHARACTERISTIC
/begin CHARACTERISTIC Chiste_stEnaTst_C "#SSD Schalter zum Testen des Befehlstests" VALUE 0xEED44 Kw_Wu8 255.0 OneToOne 0.00 255.0 FORMAT "%5.1" /end CHARACTERISTIC
/begin CHARACTERISTIC K_IABGLMOT "Konstante Abgleichstrom Motor" VALUE 0x000C0B30 TKW_VV_VV_SW 100.0 Def_i_sw_q0p001 -32.7680 32.7670 /begin FUNCTION_LIST BGCRENG /end FUNCTION_LIST FORMAT "%6.3" /end CHARACTERISTIC
/begin CHARACTERISTIC K_IABGLNL "Konstante Abgleichstrom Kl. 15" VALUE 0x000C0B32 TKW_VV_VV_SW 100.0 Def_i_sw_q0p001 -32.7680 32.7670 /begin FUNCTION_LIST BGCRENG /end FUNCTION_LIST FORMAT "%6.3" /end CHARACTERISTIC
/begin CHARACTERISTIC K_IABGLST "Konstante Abgleichstrom Start" VALUE 0x000C0B34 TKW_VV_VV_SW 100.0 Def_i_sw_q0p001 -32.7680 32.7670 /begin FUNCTION_LIST BGCRENG /end FUNCTION_LIST FORMAT "%6.3" /end CHARACTERISTIC
/begin CHARACTERISTIC K_IKEINESA "Konstante Strom wenn keine SA" VALUE 0x000C0B36 TKW_VV_VV_SW 100.0 Def_i_sw_q0p001 -32.7680 32.7670 /begin FUNCTION_LIST BGCRENG /end FUNCTION_LIST FORMAT "%6.3" /end CHARACTERISTIC
/begin CHARACTERISTIC K_CRENGOF "" VALUE 0x000C0B38 TKW_VV_VV_UW 100.0 Def_i_uw_q0p0635 0.0 4095.9375 /begin FUNCTION_LIST BGCRENG /end FUNCTION_LIST FORMAT "%6.3" /end CHARACTERISTIC
/begin CHARACTERISTIC K_CRVVTNOT "Wert vvt_iges bei vvt_es Fehlersignal" VALUE 0x000C0B3A TKW_VV_VV_UW 100.0 Def_i_uw_q0p0635 0.0 4095.9375 /begin FUNCTION_LIST BGCRENG /end FUNCTION_LIST FORMAT "%6.3" /end CHARACTERISTIC
/begin CHARACTERISTIC K_CRVVTOF "" VALUE 0x000C0B3C TKW_VV_VV_UW 100.0 Def_i_uw_q0p0635 0.0 4095.9375 /begin FUNCTION_LIST BGCRENG /end FUNCTION_LIST FORMAT "%6.3" /end CHARACTERISTIC
/begin CHARACTERISTIC KL_ELTEMP39 "Temperaturfaktor Elüfter" CURVE 0x000C0B3E TKL_SW_VV_UW 100.0 Def_f_uw_b512 0.0 511.9921 /begin FUNCTION_LIST BGCRENG /end FUNCTION_LIST
 /begin AXIS_DESCR STD_AXIS Tans Def_t_sw_q0p1 6 -3276.8000 3276.7000 FORMAT "%4.1" /end AXIS_DESCR
 FORMAT "%6.3" /end CHARACTERISTIC
/begin CHARACTERISTIC KL_ELUB60 "" CURVE 0x000C0B58 TKL_UW_VV_UW 100.0 Def_f_uw_b512 0.0 511.9921 /begin FUNCTION_LIST BGCRENG /end FUNCTION_LIST /begin AXIS_DESCR STD_AXIS Ub Def_u_uw_q0p0942 5 0.0 6173.3970 FORMAT "%4.1" /end AXIS_DESCR FORMAT "%6.3" /end CHARACTERISTIC
/begin CHARACTERISTIC KL_IABGLST "Abgleichstrom Start" CURVE 0x000C0B6E TKL_UW_VV_UB 100.0 Def_f_ub_b8 0.0 7.9687 /begin FUNCTION_LIST BGCRENG /end FUNCTION_LIST /begin AXIS_DESCR STD_AXIS Ub Def_u_uw_q0p0942 5 0.0 6173.3970 FORMAT "%4.1" /end AXIS_DESCR /end CHARACTERISTIC
/begin CHARACTERISTIC KL_IABGLMOT "Abgleichstrom Motor" CURVE 0x000C0B80 TKL_UW_VV_UB 100.0 Def_f_ub_b8 0.0 7.9687 /begin FUNCTION_LIST BGCRENG /end FUNCTION_LIST /begin AXIS_DESCR STD_AXIS Ub Def_u_uw_q0p0942 5 0.0 6173.3970 FORMAT "%4.1" /end AXIS_DESCR /end CHARACTERISTIC
/begin CHARACTERISTIC KL_ELUB39 "" CURVE 0x000C0B92 TKL_UW_VV_UW 100.0 Def_f_uw_b512 0.0 511.9921 /begin FUNCTION_LIST BGCRENG /end FUNCTION_LIST /begin AXIS_DESCR STD_AXIS Ub Def_u_uw_q0p0942 5 0.0 6173.3970 FORMAT "%4.1" /end AXIS_DESCR FORMAT "%6.3" /end CHARACTERISTIC
/begin CHARACTERISTIC KL_ELTEMP60 "Temperaturfaktor Elüfter" CURVE 0x000C0BA8 TKL_SW_VV_UW 100.0 Def_f_uw_b512 0.0 511.9921 /begin FUNCTION_LIST BGCRENG /end FUNCTION_LIST
 /begin AXIS_DESCR STD_AXIS Tans Def_t_sw_q0p1 6 -3276.8000 3276.7000 FORMAT "%4.1" /end AXIS_DESCR
 FORMAT "%6.3" /end CHARACTERISTIC
/begin CHARACTERISTIC KL_ELSLS "Kennlinie E-Lüfter Strom" CURVE 0x000C0BC2 TKL_UW_VV_UW 100.0 Def_i_uw_q0p0635 0.0 255.0000 /begin FUNCTION_LIST BGCRENG /end FUNCTION_LIST /begin AXIS_DESCR STD_AXIS Ub Def_u_uw_q0p0942 3 0.0 6173.3970 FORMAT "%4.1" /end AXIS_DESCR FORMAT "%6.3" /end CHARACTERISTIC
/begin CHARACTERISTIC KL_IABGLNL "Abgleichstrom Kl. 15" CURVE 0x000C0BD0 TKL_UW_VV_UB 100.0 Def_f_ub_b8 0.0 7.9687 /begin FUNCTION_LIST BGCRENG /end FUNCTION_LIST /begin AXIS_DESCR STD_AXIS Ub Def_u_uw_q0p0942 5 0.0 6173.3970 FORMAT "%4.1" /end AXIS_DESCR /end CHARACTERISTIC
/begin CHARACTERISTIC KF_ELUPWM60 "Strom E-Lüfter über pwm und ub" MAP 0x000C0BE2 TKF_UW_UB_UW 100.0 Def_i_uw_q0p0635 0.0 64.0000 /begin FUNCTION_LIST BGCRENG /end FUNCTION_LIST /begin AXIS_DESCR STD_AXIS L_pwmout Def_tv_ub_q0p390625 8 0.0 99.6093 /end AXIS_DESCR /begin AXIS_DESCR STD_AXIS V Def_v_uw_q1p0 8 0.0 360.0000 /end AXIS_DESCR FORMAT "%6.3" /end CHARACTERISTIC
/begin CHARACTERISTIC KF_ELUPWM39 "Strom E-Lüfter über pwm und ub" MAP 0x000C0C7C TKF_UW_UB_UW 100.0 Def_i_uw_q0p0635 0.0 64.0000 /begin FUNCTION_LIST BGCRENG /end FUNCTION_LIST /begin AXIS_DESCR STD_AXIS L_pwmout Def_tv_ub_q0p390625 8 0.0 99.6093 /end AXIS_DESCR /begin AXIS_DESCR STD_AXIS V Def_v_uw_q1p0 8 0.0 360.0000 /end AXIS_DESCR FORMAT "%6.3" /end CHARACTERISTIC
/begin CHARACTERISTIC K_DFRUTYP "DF-Rückschaltungstyp für LLR-Anhebung" VALUE 0x000C0D16 TKW_VV_VV_UB 100.0 Def_st_ub_q1 0.0 255.0000 /begin FUNCTION_LIST BGLLGEN_1PR /end FUNCTION_LIST /end CHARACTERISTIC
/begin CHARACTERISTIC K_IGENLLRANH "Generatorstromabstand für LL-Anhebung" VALUE 0x000C0D17 TKW_VV_VV_UB 100.0 Def_i_ub_q1 0.0 254.0000 /begin FUNCTION_LIST BGLLGEN_1PR /end FUNCTION_LIST /end CHARACTERISTIC
/begin CHARACTERISTIC K_LLRABS_DF "DF-Schwelle für LL-Absenkung" VALUE 0x000C0D18 TKW_VV_VV_UB 100.0 Def_f_ub_b100 0.0 99.6093 /begin FUNCTION_LIST BGLLGEN_1PR /end FUNCTION_LIST /end CHARACTERISTIC
/begin CHARACTERISTIC K_LLRANH_DF "DF-Schwelle für LL-Anhebung" VALUE 0x000C0D19 TKW_VV_VV_UB 100.0 Def_f_ub_b100 0.0 99.6093 /begin FUNCTION_LIST BGLLGEN_1PR /end FUNCTION_LIST /end CHARACTERISTIC
/begin CHARACTERISTIC K_NTWBGLLGEN "Notlaufwert Leerlaufanhebung bei Generatorfehler" VALUE 0x000C0D1A TKW_VV_VV_UB 100.0 Def_st_ub_q1 0.0 1.0000 /begin FUNCTION_LIST BGLLGEN_1PR /end FUNCTION_LIST /end CHARACTERISTIC
/begin CHARACTERISTIC K_PRELLDFAH "Prellzeit für LLR-Anhebung" VALUE 0x000C0D1B TKW_VV_VV_UB 100.0 Def_td_ub_q0p1 0.0 25.5000 /begin FUNCTION_LIST BGLLGEN_1PR /end FUNCTION_LIST /end CHARACTERISTIC
/begin CHARACTERISTIC K_PRELLDFRF "Prellzeit für LLR-Absenkung" VALUE 0x000C0D1C TKW_VV_VV_UB 100.0 Def_td_ub_q0p1 0.0 25.5000 /begin FUNCTION_LIST BGLLGEN_1PR /end FUNCTION_LIST /end CHARACTERISTIC
/begin CHARACTERISTIC KF_DFIGEN2 "inv. Generator-DF-Ausgang" MAP 0x000C0D1D TKF_UB_UB_UB 100.0 Def_f_ub_b100 0.0 99.6093 /begin FUNCTION_LIST BGLLGEN_1PR /end FUNCTION_LIST /begin AXIS_DESCR STD_AXIS NO_INPUT_QUANTITY Def_i_ub_q1 8 0.0 255.0000 /end AXIS_DESCR /begin AXIS_DESCR STD_AXIS NO_INPUT_QUANTITY Def_i_ub_q1 8 0.0 255.0000 /end AXIS_DESCR /end CHARACTERISTIC
/begin CHARACTERISTIC KF_DFIGEN1 "inv. Generator-DF-Ausgang" MAP 0x000C0D6F TKF_UB_UB_UB 100.0 Def_f_ub_b100 0.0 99.6093 /begin FUNCTION_LIST BGLLGEN_1PR /end FUNCTION_LIST /begin AXIS_DESCR STD_AXIS NO_INPUT_QUANTITY Def_i_ub_q1 8 0.0 255.0000 /end AXIS_DESCR /begin AXIS_DESCR STD_AXIS NO_INPUT_QUANTITY Def_i_ub_q1 8 0.0 255.0000 /end AXIS_DESCR /end CHARACTERISTIC
/begin CHARACTERISTIC KF_DFIGEN4 "inv. Generator-DF-Ausgang" MAP 0x000C0DC1 TKF_UB_UB_UB 100.0 Def_f_ub_b100 0.0 99.6093 /begin FUNCTION_LIST BGLLGEN_1PR /end FUNCTION_LIST /begin AXIS_DESCR STD_AXIS NO_INPUT_QUANTITY Def_i_ub_q1 8 0.0 255.0000 /end AXIS_DESCR /begin AXIS_DESCR STD_AXIS NO_INPUT_QUANTITY Def_i_ub_q1 8 0.0 255.0000 /end AXIS_DESCR /end CHARACTERISTIC
/begin CHARACTERISTIC KF_DFIGEN3 "inv. Generator-DF-Ausgang" MAP 0x000C0E13 TKF_UB_UB_UB 100.0 Def_f_ub_b100 0.0 99.6093 /begin FUNCTION_LIST BGLLGEN_1PR /end FUNCTION_LIST /begin AXIS_DESCR STD_AXIS NO_INPUT_QUANTITY Def_i_ub_q1 8 0.0 255.0000 /end AXIS_DESCR /begin AXIS_DESCR STD_AXIS NO_INPUT_QUANTITY Def_i_ub_q1 8 0.0 255.0000 /end AXIS_DESCR /end CHARACTERISTIC
/begin CHARACTERISTIC K_GEN_DNMIN "Motordrehzahlschwelle  für Auswertung der Generatorfehler" VALUE 0x000C0E66 TKW_VV_VV_SW 100.0 Def_n_sw_q1p0 -32768.0000 32767.0000 /begin FUNCTION_LIST DGEN /end FUNCTION_LIST /end CHARACTERISTIC
/begin CHARACTERISTIC K_SNMBSDKL61 "" VALUE 0x000C0E68 TKW_VV_VV_SW 100.0 Def_n_sw_q1p0 -32768.0000 32767.0000 /begin FUNCTION_LIST DGEN /end FUNCTION_LIST /end CHARACTERISTIC
/begin CHARACTERISTIC K_GENPDTIME "Predrivetime für Ladekontrollampe KL61" VALUE 0x000C0E6A TKW_VV_VV_UB 100.0 Def_td_ub_q0p1 0.0 25.5000 /begin FUNCTION_LIST DGEN /end FUNCTION_LIST /end CHARACTERISTIC
/begin CHARACTERISTIC K_MSKGENDFP "Bitmaske Generator Fehler-> DFP" VALUE 0x000C0E6B TKW_VV_VV_UB 100.0 Def_st_ub_q1 0.0 255.0000 /begin FUNCTION_LIST DGEN /end FUNCTION_LIST /end CHARACTERISTIC
/begin CHARACTERISTIC K_MSKGENKL61 "Bitmaske fuer Generatorfehler -> Ladekontrolle" VALUE 0x000C0E6C TKW_VV_VV_UB 100.0 Def_st_ub_q1 0.0 255.0000 /begin FUNCTION_LIST DGEN /end FUNCTION_LIST /end CHARACTERISTIC
/begin CHARACTERISTIC S_BSDKOORD "" VALUE 0x000C0E6D TKW_VV_VV_UB 100.0 Identity 0.0 1.0000 /begin FUNCTION_LIST DIBS /end FUNCTION_LIST /end CHARACTERISTIC
/begin CHARACTERISTIC K_MSKIBSDFP "Bitmaske Generator Fehler-> DFP" VALUE 0x000C0E6E TKW_VV_VV_UB 100.0 Def_st_ub_q1 0.0 255.0000 /begin FUNCTION_LIST DIBS /end FUNCTION_LIST /end CHARACTERISTIC
/begin CHARACTERISTIC K_MSKIBSDFP2 "" VALUE 0x000C0E6F TKW_VV_VV_UB 100.0 Def_st_ub_q1 0.0 255.0000 /begin FUNCTION_LIST DIBS /end FUNCTION_LIST /end CHARACTERISTIC
/begin CHARACTERISTIC K_MSKIBSDIAG "Test AK disable Diagnose" VALUE 0x000C0E70 TKW_VV_VV_UB 100.0 Def_st_ub_q1 0.0 255.0000 /begin FUNCTION_LIST DIBS /end FUNCTION_LIST /end CHARACTERISTIC
/begin CHARACTERISTIC K_MSKIBSERR "" VALUE 0x000C0E71 TKW_VV_VV_UB 100.0 ident 0.0 255.0000 /begin FUNCTION_LIST DIBS /end FUNCTION_LIST /end CHARACTERISTIC
/begin CHARACTERISTIC K_MSKIBSERR2 "" VALUE 0x000C0E72 TKW_VV_VV_UB 100.0 ident 0.0 255.0000 /begin FUNCTION_LIST DIBS /end FUNCTION_LIST /end CHARACTERISTIC
/begin CHARACTERISTIC K_TOGMAXUNPL "" VALUE 0x000C0E74 TKW_VV_VV_UL 100.0 Def_dez_ul_q1 0.0 2147483647.0000 /begin FUNCTION_LIST DQLT /end FUNCTION_LIST /end CHARACTERISTIC
/begin CHARACTERISTIC K_TOG_CNTMAX "" VALUE 0x000C0E78 TKW_VV_VV_UL 100.0 Def_dez_ul_q1 0.0 4294967295.0000 /begin FUNCTION_LIST DQLT /end FUNCTION_LIST /end CHARACTERISTIC
/begin CHARACTERISTIC K_OZDIAGNMOT "Mindestdrehzahl zur QLT-Diagnose" VALUE 0x000C0E7C TKW_VV_VV_SW 100.0 Def_n_sw_q1p0 -32768.0000 32767.0000 /begin FUNCTION_LIST DQLT /end FUNCTION_LIST /end CHARACTERISTIC
/begin CHARACTERISTIC K_OZDIAGNMOT2 "Max Drehzahl zur QLT-Diagnose" VALUE 0x000C0E7E TKW_VV_VV_SW 100.0 Def_n_sw_q1p0 -32768.0000 32767.0000 /begin FUNCTION_LIST DQLT /end FUNCTION_LIST /end CHARACTERISTIC
/begin CHARACTERISTIC K_OZTEMPQERR "Temperaturschwelle für den Permittivitätsfehler" VALUE 0x000C0E80 TKW_VV_VV_SW 100.0 Def_t_sw_q0p1 -3276.8000 3276.7000 /begin FUNCTION_LIST DQLT /end FUNCTION_LIST FORMAT "%4.1" /end CHARACTERISTIC
/begin CHARACTERISTIC K_DTOG_UBMIN "" VALUE 0x000C0E82 TKW_VV_VV_UW 100.0 Def_u_uw_q0p0942 0.0 6173.3970 /begin FUNCTION_LIST DQLT /end FUNCTION_LIST FORMAT "%4.1" /end CHARACTERISTIC
/begin CHARACTERISTIC K_OZDIAGSPG "Spannung, unterhalb der die Diagnose ausgeblendet wird" VALUE 0x000C0E84 TKW_VV_VV_UW 100.0 Def_u_uw_q0p0942 0.0 6173.3970 /begin FUNCTION_LIST DQLT /end FUNCTION_LIST FORMAT "%4.1" /end CHARACTERISTIC
/begin CHARACTERISTIC K_OZERRD "Entprellzeit Sensor- und Kommunikationsfehler" VALUE 0x000C0E86 TKW_VV_VV_UW 100.0 Def_dez_uw_q1 0.0 65535.0000 /begin FUNCTION_LIST DQLT /end FUNCTION_LIST /end CHARACTERISTIC
/begin CHARACTERISTIC K_OZHEAL "Entprellzeit Fehler-Healing" VALUE 0x000C0E88 TKW_VV_VV_UW 100.0 Def_dez_uw_q1 0.0 65535.0000 /begin FUNCTION_LIST DQLT /end FUNCTION_LIST /end CHARACTERISTIC
/begin CHARACTERISTIC K_GENUEBSETZ1 "Generatoruebersetzung1" VALUE 0x000C0EE0 TKW_VV_VV_UB 100.0 Def_f_ub_b4 0.0 3.9843 /begin FUNCTION_LIST IMDGEN_1PR /end FUNCTION_LIST /end CHARACTERISTIC
/begin CHARACTERISTIC K_GENUEBSETZ2 "Generatoruebersetzung2" VALUE 0x000C0EE1 TKW_VV_VV_UB 100.0 Def_f_ub_b4 0.0 3.9843 /begin FUNCTION_LIST IMDGEN_1PR /end FUNCTION_LIST /end CHARACTERISTIC
/begin CHARACTERISTIC K_GENUEBSETZ3 "Generatoruebersetzung3" VALUE 0x000C0EE2 TKW_VV_VV_UB 100.0 Def_f_ub_b4 0.0 3.9843 /begin FUNCTION_LIST IMDGEN_1PR /end FUNCTION_LIST /end CHARACTERISTIC
/begin CHARACTERISTIC K_GENUEBSETZ4 "Generatoruebersetzung4" VALUE 0x000C0EE3 TKW_VV_VV_UB 100.0 Def_f_ub_b4 0.0 3.9843 /begin FUNCTION_LIST IMDGEN_1PR /end FUNCTION_LIST /end CHARACTERISTIC
/begin CHARACTERISTIC KF_IGENKA2 "Kaltkennfeld 2 Generator" MAP 0x000C0F22 TKF_SW_UW_UB 100.0 Def_i_ub_q1 0.0 255.0000 /begin FUNCTION_LIST IMDGEN_1PR /end FUNCTION_LIST /begin AXIS_DESCR STD_AXIS U_gen Def_u_uw_q0p1 7 0.0 6553.5000 FORMAT "%6.3" /end AXIS_DESCR /begin AXIS_DESCR STD_AXIS N_gen Def_n_sw_q1p0 9 -32768.0000 32767.0000 /end AXIS_DESCR /end CHARACTERISTIC
/begin CHARACTERISTIC KF_IGENWA2 "Warmkennfeld 2 Generator" MAP 0x000C0F84 TKF_SW_UB_UB 100.0 Def_i_ub_q1 0.0 255.0000 /begin FUNCTION_LIST IMDGEN_1PR /end FUNCTION_LIST /begin AXIS_DESCR STD_AXIS Gen_i_kaltun Def_i_ub_q1 6 0.0 255.0000 /end AXIS_DESCR
 /begin AXIS_DESCR STD_AXIS Tgen_end Def_t_sw_q0p1 7 -3276.8000 3276.7000 FORMAT "%4.1" /end AXIS_DESCR
/end CHARACTERISTIC
/begin CHARACTERISTIC KF_IGENWA1 "Warmkennfeld 1 Generator" MAP 0x000C0FC4 TKF_SW_UB_UB 100.0 Def_i_ub_q1 0.0 255.0000 /begin FUNCTION_LIST IMDGEN_1PR /end FUNCTION_LIST /begin AXIS_DESCR STD_AXIS Gen_i_kaltun Def_i_ub_q1 6 0.0 255.0000 /end AXIS_DESCR
 /begin AXIS_DESCR STD_AXIS Tgen_end Def_t_sw_q0p1 7 -3276.8000 3276.7000 FORMAT "%4.1" /end AXIS_DESCR
/end CHARACTERISTIC
/begin CHARACTERISTIC KF_IGENKA3 "Kaltkennfeld 3 Generator" MAP 0x000C1004 TKF_SW_UW_UB 100.0 Def_i_ub_q1 0.0 255.0000 /begin FUNCTION_LIST IMDGEN_1PR /end FUNCTION_LIST /begin AXIS_DESCR STD_AXIS U_gen Def_u_uw_q0p1 7 0.0 6553.5000 FORMAT "%6.3" /end AXIS_DESCR /begin AXIS_DESCR STD_AXIS N_gen Def_n_sw_q1p0 9 -32768.0000 32767.0000 /end AXIS_DESCR /end CHARACTERISTIC
/begin CHARACTERISTIC KF_IGENWA4 "Warmkennfeld 4 Generator" MAP 0x000C1066 TKF_SW_UB_UB 100.0 Def_i_ub_q1 0.0 255.0000 /begin FUNCTION_LIST IMDGEN_1PR /end FUNCTION_LIST /begin AXIS_DESCR STD_AXIS Gen_i_kaltun Def_i_ub_q1 6 0.0 255.0000 /end AXIS_DESCR
 /begin AXIS_DESCR STD_AXIS Tgen_end Def_t_sw_q0p1 7 -3276.8000 3276.7000 FORMAT "%4.1" /end AXIS_DESCR
/end CHARACTERISTIC
/begin CHARACTERISTIC KF_IGENWA3 "Warmkennfeld  3 Generator" MAP 0x000C10A6 TKF_SW_UB_UB 100.0 Def_i_ub_q1 0.0 255.0000 /begin FUNCTION_LIST IMDGEN_1PR /end FUNCTION_LIST /begin AXIS_DESCR STD_AXIS Gen_i_kaltun Def_i_ub_q1 6 0.0 255.0000 /end AXIS_DESCR
 /begin AXIS_DESCR STD_AXIS Tgen_end Def_t_sw_q0p1 7 -3276.8000 3276.7000 FORMAT "%4.1" /end AXIS_DESCR
/end CHARACTERISTIC
/begin CHARACTERISTIC KF_IGENKA1 "Kaltkennfeld 1 Generator" MAP 0x000C10E6 TKF_SW_UW_UB 100.0 Def_i_ub_q1 0.0 255.0000 /begin FUNCTION_LIST IMDGEN_1PR /end FUNCTION_LIST /begin AXIS_DESCR STD_AXIS U_gen Def_u_uw_q0p1 7 0.0 6553.5000 FORMAT "%6.3" /end AXIS_DESCR /begin AXIS_DESCR STD_AXIS N_gen Def_n_sw_q1p0 9 -32768.0000 32767.0000 /end AXIS_DESCR /end CHARACTERISTIC
/begin CHARACTERISTIC KF_IGENKA4 "Kaltkennfeld 4 Generator" MAP 0x000C1148 TKF_SW_UW_UB 100.0 Def_i_ub_q1 0.0 255.0000 /begin FUNCTION_LIST IMDGEN_1PR /end FUNCTION_LIST /begin AXIS_DESCR STD_AXIS U_gen Def_u_uw_q0p1 7 0.0 6553.5000 FORMAT "%6.3" /end AXIS_DESCR /begin AXIS_DESCR STD_AXIS N_gen Def_n_sw_q1p0 9 -32768.0000 32767.0000 /end AXIS_DESCR /end CHARACTERISTIC
/begin CHARACTERISTIC K_ENGENTANS "Schwelle Motortemperatur fuer Freigabe Generaturansaugluft " VALUE 0x000C0E8A TKW_VV_VV_SW 100.0 Def_t_sw_q0p1 -3276.8000 3276.7000 /begin FUNCTION_LIST IMDGEN_1PR /end FUNCTION_LIST FORMAT "%4.1" /end CHARACTERISTIC
/begin CHARACTERISTIC K_GENMDNMOF "Offset des Generatormoments" VALUE 0x000C0E8C TKW_VV_VV_SW 100.0 Def_m_sw_q0p1 -3276.8000 3276.7000 /begin FUNCTION_LIST IMDGEN_1PR /end FUNCTION_LIST FORMAT "%5.2" /end CHARACTERISTIC
/begin CHARACTERISTIC K_GENTEMPAPP "Geneeratortemperatur mauelle Vorgabe" VALUE 0x000C0E8E TKW_VV_VV_SW 100.0 Def_t_sw_q0p1 -3276.8000 3276.7000 /begin FUNCTION_LIST IMDGEN_1PR /end FUNCTION_LIST FORMAT "%4.1" /end CHARACTERISTIC
/begin CHARACTERISTIC K_GENTMOTDT "" VALUE 0x000C0E90 TKW_VV_VV_SW 100.0 Def_t_sw_q0p1 -3276.8000 3276.7000 /begin FUNCTION_LIST IMDGEN_1PR /end FUNCTION_LIST FORMAT "%4.1" /end CHARACTERISTIC
/begin CHARACTERISTIC K_GENTMOTOF1 "Offset Generatoransaugluft" VALUE 0x000C0E92 TKW_VV_VV_SW 100.0 Def_t_sw_q0p1 -3276.8000 3276.7000 /begin FUNCTION_LIST IMDGEN_1PR /end FUNCTION_LIST FORMAT "%4.1" /end CHARACTERISTIC
/begin CHARACTERISTIC K_GENTMOTOF2 "Offset Generatoransaugluft" VALUE 0x000C0E94 TKW_VV_VV_SW 100.0 Def_t_sw_q0p1 -3276.8000 3276.7000 /begin FUNCTION_LIST IMDGEN_1PR /end FUNCTION_LIST FORMAT "%4.1" /end CHARACTERISTIC
/begin CHARACTERISTIC K_GENTMOTOF3 "Offset Generatoransaugluft" VALUE 0x000C0E96 TKW_VV_VV_SW 100.0 Def_t_sw_q0p1 -3276.8000 3276.7000 /begin FUNCTION_LIST IMDGEN_1PR /end FUNCTION_LIST FORMAT "%4.1" /end CHARACTERISTIC
/begin CHARACTERISTIC K_GENTMOTOF4 "Offset Generatoransaugluft" VALUE 0x000C0E98 TKW_VV_VV_SW 100.0 Def_t_sw_q0p1 -3276.8000 3276.7000 /begin FUNCTION_LIST IMDGEN_1PR /end FUNCTION_LIST FORMAT "%4.1" /end CHARACTERISTIC
/begin CHARACTERISTIC K_GENRS0_1 "Generatorstatorwiderstand1 bei 25°" VALUE 0x000C0E9A TKW_VV_VV_UW 100.0 Def_f_uw_b1 0.0 9.99984741210938e-1 /begin FUNCTION_LIST IMDGEN_1PR /end FUNCTION_LIST /end CHARACTERISTIC
/begin CHARACTERISTIC K_GENRS0_2 "Generatorstatorwiderstand2 bei 25°" VALUE 0x000C0E9C TKW_VV_VV_UW 100.0 Def_f_uw_b1 0.0 9.99984741210938e-1 /begin FUNCTION_LIST IMDGEN_1PR /end FUNCTION_LIST /end CHARACTERISTIC
/begin CHARACTERISTIC K_GENRS0_3 "Generatorstatorwiderstand3 bei 25°" VALUE 0x000C0E9E TKW_VV_VV_UW 100.0 Def_f_uw_b1 0.0 9.99984741210938e-1 /begin FUNCTION_LIST IMDGEN_1PR /end FUNCTION_LIST /end CHARACTERISTIC
/begin CHARACTERISTIC K_GENRS0_4 "Generatorstatorwiderstand4 bei 25°" VALUE 0x000C0EA0 TKW_VV_VV_UW 100.0 Def_f_uw_b1 0.0 9.99984741210938e-1 /begin FUNCTION_LIST IMDGEN_1PR /end FUNCTION_LIST /end CHARACTERISTIC
/begin CHARACTERISTIC K_GENVFZGSW "geschwindigkeitsabhängige Generatoransaugluftschwelle" VALUE 0x000C0EA2 TKW_VV_VV_UW 100.0 Def_v_uw_q1p0 0.0 65535.0000 /begin FUNCTION_LIST IMDGEN_1PR /end FUNCTION_LIST /end CHARACTERISTIC
/begin CHARACTERISTIC K_GEN_IGOF "Offsetwert Generatorstrom" VALUE 0x000C0EA4 TKW_VV_VV_UW 100.0 Def_f_uw_b2048 0.0 254.0000 /begin FUNCTION_LIST IMDGEN_1PR /end FUNCTION_LIST FORMAT "%5.2" /end CHARACTERISTIC
/begin CHARACTERISTIC K_TSTFIL_IN "" VALUE 0x000C0EA6 TKW_VV_VV_UW 100.0 Def_t_uw_q0p075 0.0 49151.2500 /begin FUNCTION_LIST IMDGEN_1PR /end FUNCTION_LIST FORMAT "%5.2" /end CHARACTERISTIC
/begin CHARACTERISTIC K_ZMGENIG "" VALUE 0x000C0EA8 TKW_VV_VV_UW 100.0 Def_f_uw_b1 0.0 9.99984741210938e-1 /begin FUNCTION_LIST IMDGEN_1PR /end FUNCTION_LIST /end CHARACTERISTIC
/begin CHARACTERISTIC K_ZMGENS0HZ1 "Zeitkonstante Generatorstator1 Aufheizung im Stand" VALUE 0x000C0EAA TKW_VV_VV_UW 100.0 Def_f_uw_b1 0.0 9.99984741210938e-1 /begin FUNCTION_LIST IMDGEN_1PR /end FUNCTION_LIST /end CHARACTERISTIC
/begin CHARACTERISTIC K_ZMGENS0HZ2 "Zeitkonstante Generatorstator2 Aufheizung im Stand" VALUE 0x000C0EAC TKW_VV_VV_UW 100.0 Def_f_uw_b1 0.0 9.99984741210938e-1 /begin FUNCTION_LIST IMDGEN_1PR /end FUNCTION_LIST /end CHARACTERISTIC
/begin CHARACTERISTIC K_ZMGENS0HZ3 "Zeitkonstante Generatorstator3 Aufheizung im Stand" VALUE 0x000C0EAE TKW_VV_VV_UW 100.0 Def_f_uw_b1 0.0 9.99984741210938e-1 /begin FUNCTION_LIST IMDGEN_1PR /end FUNCTION_LIST /end CHARACTERISTIC
/begin CHARACTERISTIC K_ZMGENS0HZ4 "Zeitkonstante Generatorstator4 Aufheizung im Stand" VALUE 0x000C0EB0 TKW_VV_VV_UW 100.0 Def_f_uw_b1 0.0 9.99984741210938e-1 /begin FUNCTION_LIST IMDGEN_1PR /end FUNCTION_LIST /end CHARACTERISTIC
/begin CHARACTERISTIC K_ZMGENS0KL1 "Zeitkonstante Abkühlung Generator im Stand1" VALUE 0x000C0EB2 TKW_VV_VV_UW 100.0 Def_f_uw_b1 0.0 9.99984741210938e-1 /begin FUNCTION_LIST IMDGEN_1PR /end FUNCTION_LIST /end CHARACTERISTIC
/begin CHARACTERISTIC K_ZMGENS0KL2 "Zeitkonstante Abkühlung Generator im Stand2" VALUE 0x000C0EB4 TKW_VV_VV_UW 100.0 Def_f_uw_b1 0.0 9.99984741210938e-1 /begin FUNCTION_LIST IMDGEN_1PR /end FUNCTION_LIST /end CHARACTERISTIC
/begin CHARACTERISTIC K_ZMGENS0KL3 "Zeitkonstante Abkühlung Generator im Stand3" VALUE 0x000C0EB6 TKW_VV_VV_UW 100.0 Def_f_uw_b1 0.0 9.99984741210938e-1 /begin FUNCTION_LIST IMDGEN_1PR /end FUNCTION_LIST /end CHARACTERISTIC
/begin CHARACTERISTIC K_ZMGENS0KL4 "Zeitkonstante Abkühlung Generator im Stand4" VALUE 0x000C0EB8 TKW_VV_VV_UW 100.0 Def_f_uw_b1 0.0 9.99984741210938e-1 /begin FUNCTION_LIST IMDGEN_1PR /end FUNCTION_LIST /end CHARACTERISTIC
/begin CHARACTERISTIC K_ZMGENSTHZ1 "Zeitkonstante Generatorstator1 Aufheizung" VALUE 0x000C0EBA TKW_VV_VV_UW 100.0 Def_f_uw_b1 0.0 9.99984741210938e-1 /begin FUNCTION_LIST IMDGEN_1PR /end FUNCTION_LIST /end CHARACTERISTIC
/begin CHARACTERISTIC K_ZMGENSTHZ2 "Zeitkonstante Generatorstator2 Aufheizung" VALUE 0x000C0EBC TKW_VV_VV_UW 100.0 Def_f_uw_b1 0.0 9.99984741210938e-1 /begin FUNCTION_LIST IMDGEN_1PR /end FUNCTION_LIST /end CHARACTERISTIC
/begin CHARACTERISTIC K_ZMGENSTHZ3 "Zeitkonstante Generatorstator3 Aufheizung" VALUE 0x000C0EBE TKW_VV_VV_UW 100.0 Def_f_uw_b1 0.0 9.99984741210938e-1 /begin FUNCTION_LIST IMDGEN_1PR /end FUNCTION_LIST /end CHARACTERISTIC
/begin CHARACTERISTIC K_ZMGENSTHZ4 "Zeitkonstante Generatorstator4 Aufheizung" VALUE 0x000C0EC0 TKW_VV_VV_UW 100.0 Def_f_uw_b1 0.0 9.99984741210938e-1 /begin FUNCTION_LIST IMDGEN_1PR /end FUNCTION_LIST /end CHARACTERISTIC
/begin CHARACTERISTIC K_ZMGENSTKL1 "Zeitkonstante Abkühlung Generator1" VALUE 0x000C0EC2 TKW_VV_VV_UW 100.0 Def_f_uw_b1 0.0 9.99984741210938e-1 /begin FUNCTION_LIST IMDGEN_1PR /end FUNCTION_LIST /end CHARACTERISTIC
/begin CHARACTERISTIC K_ZMGENSTKL2 "Zeitkonstante Abkühlung Generator2" VALUE 0x000C0EC4 TKW_VV_VV_UW 100.0 Def_f_uw_b1 0.0 9.99984741210938e-1 /begin FUNCTION_LIST IMDGEN_1PR /end FUNCTION_LIST /end CHARACTERISTIC
/begin CHARACTERISTIC K_ZMGENSTKL3 "Zeitkonstante Abkühlung Generator3" VALUE 0x000C0EC6 TKW_VV_VV_UW 100.0 Def_f_uw_b1 0.0 9.99984741210938e-1 /begin FUNCTION_LIST IMDGEN_1PR /end FUNCTION_LIST /end CHARACTERISTIC
/begin CHARACTERISTIC K_ZMGENSTKL4 "Zeitkonstante Abkühlung Generator4" VALUE 0x000C0EC8 TKW_VV_VV_UW 100.0 Def_f_uw_b1 0.0 9.99984741210938e-1 /begin FUNCTION_LIST IMDGEN_1PR /end FUNCTION_LIST /end CHARACTERISTIC
/begin CHARACTERISTIC K_ZMGENTWA "" VALUE 0x000C0ECA TKW_VV_VV_UW 100.0 Def_f_uw_b1 0.0 9.99984741210938e-1 /begin FUNCTION_LIST IMDGEN_1PR /end FUNCTION_LIST /end CHARACTERISTIC
/begin CHARACTERISTIC K_ZMGN0TANS1 "Zeitkonstante Generatoransaugluft1 bei vfzg = 0" VALUE 0x000C0ECC TKW_VV_VV_UW 100.0 Def_f_uw_b1 0.0 9.99984741210938e-1 /begin FUNCTION_LIST IMDGEN_1PR /end FUNCTION_LIST /end CHARACTERISTIC
/begin CHARACTERISTIC K_ZMGN0TANS2 "Zeitkonstante Generatoransaugluft2 bei vfzg = 0" VALUE 0x000C0ECE TKW_VV_VV_UW 100.0 Def_f_uw_b1 0.0 9.99984741210938e-1 /begin FUNCTION_LIST IMDGEN_1PR /end FUNCTION_LIST /end CHARACTERISTIC
/begin CHARACTERISTIC K_ZMGN0TANS3 "Zeitkonstante Generatoransaugluft3 bei vfzg = 0" VALUE 0x000C0ED0 TKW_VV_VV_UW 100.0 Def_f_uw_b1 0.0 9.99984741210938e-1 /begin FUNCTION_LIST IMDGEN_1PR /end FUNCTION_LIST /end CHARACTERISTIC
/begin CHARACTERISTIC K_ZMGN0TANS4 "Zeitkonstante Generatoransaugluft4 bei vfzg = 0" VALUE 0x000C0ED2 TKW_VV_VV_UW 100.0 Def_f_uw_b1 0.0 9.99984741210938e-1 /begin FUNCTION_LIST IMDGEN_1PR /end FUNCTION_LIST /end CHARACTERISTIC
/begin CHARACTERISTIC K_ZMGNTANS1 "Zeitkonstante Generatoransaugluft1" VALUE 0x000C0ED4 TKW_VV_VV_UW 100.0 Def_f_uw_b1 0.0 9.99984741210938e-1 /begin FUNCTION_LIST IMDGEN_1PR /end FUNCTION_LIST /end CHARACTERISTIC
/begin CHARACTERISTIC K_ZMGNTANS2 "Zeitkonstante Generatoransaugluft2" VALUE 0x000C0ED6 TKW_VV_VV_UW 100.0 Def_f_uw_b1 0.0 9.99984741210938e-1 /begin FUNCTION_LIST IMDGEN_1PR /end FUNCTION_LIST /end CHARACTERISTIC
/begin CHARACTERISTIC K_ZMGNTANS3 "Zeitkonstante Generatoransaugluft3" VALUE 0x000C0ED8 TKW_VV_VV_UW 100.0 Def_f_uw_b1 0.0 9.99984741210938e-1 /begin FUNCTION_LIST IMDGEN_1PR /end FUNCTION_LIST /end CHARACTERISTIC
/begin CHARACTERISTIC K_ZMGNTANS4 "Zeitkonstante Generatoransaugluft3" VALUE 0x000C0EDA TKW_VV_VV_UW 100.0 Def_f_uw_b1 0.0 9.99984741210938e-1 /begin FUNCTION_LIST IMDGEN_1PR /end FUNCTION_LIST /end CHARACTERISTIC
/begin CHARACTERISTIC K_ZMIGMISCH "Zeitkonstante IG Mischung" VALUE 0x000C0EDC TKW_VV_VV_UW 100.0 Def_f_uw_b1 0.0 9.99984741210938e-1 /begin FUNCTION_LIST IMDGEN_1PR /end FUNCTION_LIST /end CHARACTERISTIC
/begin CHARACTERISTIC K_ZMTESTFIL "" VALUE 0x000C0EDE TKW_VV_VV_UW 100.0 Def_f_uw_b1 0.0 9.99984741210938e-1 /begin FUNCTION_LIST IMDGEN_1PR /end FUNCTION_LIST /end CHARACTERISTIC
/begin CHARACTERISTIC K_DF_DEAKAPP "Df-Schwelle für IG 0A Zwangssetzung" VALUE 0x000C0EE4 TKW_VV_VV_UB 100.0 Def_f_ub_b100 0.0 99.6093 /begin FUNCTION_LIST IMDGEN_1PR /end FUNCTION_LIST /end CHARACTERISTIC
/begin CHARACTERISTIC K_EN_MDGEN "" VALUE 0x000C0EE5 TKW_VV_VV_UB 100.0 Def_st_ub_q1 0.0 255.0000 /begin FUNCTION_LIST IMDGEN_1PR /end FUNCTION_LIST /end CHARACTERISTIC
/begin CHARACTERISTIC K_GENDIFAK1 "Stromfaktor Diode1" VALUE 0x000C0EE6 TKW_VV_VV_UB 100.0 Def_f_ub_b1 0.0 0.9960 /begin FUNCTION_LIST IMDGEN_1PR /end FUNCTION_LIST /end CHARACTERISTIC
/begin CHARACTERISTIC K_GENDIFAK2 "Stromfaktor Diode2" VALUE 0x000C0EE7 TKW_VV_VV_UB 100.0 Def_f_ub_b1 0.0 0.9960 /begin FUNCTION_LIST IMDGEN_1PR /end FUNCTION_LIST /end CHARACTERISTIC
/begin CHARACTERISTIC K_GENDIFAK3 "Stromfaktor Diode3" VALUE 0x000C0EE8 TKW_VV_VV_UB 100.0 Def_f_ub_b1 0.0 0.9960 /begin FUNCTION_LIST IMDGEN_1PR /end FUNCTION_LIST /end CHARACTERISTIC
/begin CHARACTERISTIC K_GENDIFAK4 "Stromfaktor Diode4" VALUE 0x000C0EE9 TKW_VV_VV_UB 100.0 Def_f_ub_b1 0.0 0.9960 /begin FUNCTION_LIST IMDGEN_1PR /end FUNCTION_LIST /end CHARACTERISTIC
/begin CHARACTERISTIC K_GENITYP "Generatorstrotyp 0=gerechnet / 1=gemessen" VALUE 0x000C0EEA TKW_VV_VV_UB 100.0 Def_st_ub_q1 0.0 1.0000 /begin FUNCTION_LIST IMDGEN_1PR /end FUNCTION_LIST /end CHARACTERISTIC
/begin CHARACTERISTIC K_GENSTFAK1 "Stromfaktor Statorspule" VALUE 0x000C0EEB TKW_VV_VV_UB 100.0 Def_f_ub_b1 0.0 0.9960 /begin FUNCTION_LIST IMDGEN_1PR /end FUNCTION_LIST /end CHARACTERISTIC
/begin CHARACTERISTIC K_GENSTFAK2 "Stromfaktor Statorspule2" VALUE 0x000C0EEC TKW_VV_VV_UB 100.0 Def_f_ub_b1 0.0 0.9960 /begin FUNCTION_LIST IMDGEN_1PR /end FUNCTION_LIST /end CHARACTERISTIC
/begin CHARACTERISTIC K_GENSTFAK3 "Stromfaktor Statorspule3" VALUE 0x000C0EED TKW_VV_VV_UB 100.0 Def_f_ub_b1 0.0 0.9960 /begin FUNCTION_LIST IMDGEN_1PR /end FUNCTION_LIST /end CHARACTERISTIC
/begin CHARACTERISTIC K_GENSTFAK4 "Stromfaktor Statorspule4" VALUE 0x000C0EEE TKW_VV_VV_UB 100.0 Def_f_ub_b1 0.0 0.9960 /begin FUNCTION_LIST IMDGEN_1PR /end FUNCTION_LIST /end CHARACTERISTIC
/begin CHARACTERISTIC K_GENTEMPMAN "Manuelle Generatorvorgabe" VALUE 0x000C0EEF TKW_VV_VV_UB 100.0 Def_st_ub_q1 0.0 255.0000 /begin FUNCTION_LIST IMDGEN_1PR /end FUNCTION_LIST /end CHARACTERISTIC
/begin CHARACTERISTIC K_GENTYP "Generatortyp" VALUE 0x000C0EF0 TKW_VV_VV_UB 100.0 Def_st_ub_q1 0.0 255.0000 /begin FUNCTION_LIST IMDGEN_1PR /end FUNCTION_LIST /end CHARACTERISTIC
/begin CHARACTERISTIC K_GENUMGTYP "" VALUE 0x000C0EF1 TKW_VV_VV_UB 100.0 Def_st_ub_q1 0.0 255.0000 /begin FUNCTION_LIST IMDGEN_1PR /end FUNCTION_LIST /end CHARACTERISTIC
/begin CHARACTERISTIC K_IGBASIS "Generatorgrundstrombedarf FZG " VALUE 0x000C0EF2 TKW_VV_VV_UB 100.0 Def_i_ub_q1 0.0 255.0000 /begin FUNCTION_LIST IMDGEN_1PR /end FUNCTION_LIST /end CHARACTERISTIC
/begin CHARACTERISTIC K_IGBASISOFF "Generatorgrundstrombedarf FZG bei Genred" VALUE 0x000C0EF3 TKW_VV_VV_UB 100.0 Def_i_ub_q1 0.0 255.0000 /begin FUNCTION_LIST IMDGEN_1PR /end FUNCTION_LIST /end CHARACTERISTIC
/begin CHARACTERISTIC K_IGNOTWERT "" VALUE 0x000C0EF4 TKW_VV_VV_UB 100.0 Def_i_ub_q1 0.0 255.0000 /begin FUNCTION_LIST IMDGEN_1PR /end FUNCTION_LIST /end CHARACTERISTIC
/begin CHARACTERISTIC K_MANAWNUMM "" VALUE 0x000C0EF5 TKW_VV_VV_UB 100.0 Def_st_ub_q1 0.0 255.0000 /begin FUNCTION_LIST IMDGEN_1PR /end FUNCTION_LIST /end CHARACTERISTIC
/begin CHARACTERISTIC K_PRELLGTMOT "Prellzeit für Tmot-Schwelle" VALUE 0x000C0EF6 TKW_VV_VV_UB 100.0 Def_td_ub_q1 0.0 255.0000 /begin FUNCTION_LIST IMDGEN_1PR /end FUNCTION_LIST /end CHARACTERISTIC
/begin CHARACTERISTIC K_TIGMISCH "" VALUE 0x000C0EF7 TKW_VV_VV_UB 100.0 Def_td_ub_q0p01 0.0 2.5500 /begin FUNCTION_LIST IMDGEN_1PR /end FUNCTION_LIST /end CHARACTERISTIC
/begin CHARACTERISTIC K_TSTCNTEN "" VALUE 0x000C0EF8 TKW_VV_VV_UB 100.0 Def_st_ub_q1 0.0 255.0000 /begin FUNCTION_LIST IMDGEN_1PR /end FUNCTION_LIST /end CHARACTERISTIC
/begin CHARACTERISTIC K_TSTFIL_INI "" VALUE 0x000C0EF9 TKW_VV_VV_UB 100.0 Def_st_ub_q1 0.0 255.0000 /begin FUNCTION_LIST IMDGEN_1PR /end FUNCTION_LIST /end CHARACTERISTIC
/begin CHARACTERISTIC K_UDIODERMS1 "RMS-Schwellspannung Generatordiode1" VALUE 0x000C0EFA TKW_VV_VV_UB 100.0 Def_f_ub_b2 0.0 1.9921 /begin FUNCTION_LIST IMDGEN_1PR /end FUNCTION_LIST /end CHARACTERISTIC
/begin CHARACTERISTIC K_UDIODERMS2 "RMS-Schwellspannung Generatordiode2" VALUE 0x000C0EFB TKW_VV_VV_UB 100.0 Def_f_ub_b2 0.0 1.9921 /begin FUNCTION_LIST IMDGEN_1PR /end FUNCTION_LIST /end CHARACTERISTIC
/begin CHARACTERISTIC K_UDIODERMS3 "RMS-Schwellspannung Generatordiode3" VALUE 0x000C0EFC TKW_VV_VV_UB 100.0 Def_f_ub_b2 0.0 1.9921 /begin FUNCTION_LIST IMDGEN_1PR /end FUNCTION_LIST /end CHARACTERISTIC
/begin CHARACTERISTIC K_UDIODERMS4 "RMS-Schwellspannung Generatordiode3" VALUE 0x000C0EFD TKW_VV_VV_UB 100.0 Def_f_ub_b2 0.0 1.9921 /begin FUNCTION_LIST IMDGEN_1PR /end FUNCTION_LIST /end CHARACTERISTIC
/begin CHARACTERISTIC S_IGMISCH "" VALUE 0x000C0EFE TKW_VV_VV_UB 100.0 Identity 0.0 1.0000 /begin FUNCTION_LIST IMDGEN_1PR /end FUNCTION_LIST /end CHARACTERISTIC
/begin CHARACTERISTIC S_RDGENTYP "" VALUE 0x000C0EFF TKW_VV_VV_UB 100.0 Def_st_ub_q1 0.0 255.0000 /begin FUNCTION_LIST IMDGEN_1PR /end FUNCTION_LIST /end CHARACTERISTIC
/begin CHARACTERISTIC K_GENTYPFELD "Generatorkennfeldzuordnung" VAL_BLK 0x000C0F00 TKW_VV_VV_UB 100.0 Def_st_ub_q1 0.0 255.0000 /begin FUNCTION_LIST IMDGEN_1PR /end FUNCTION_LIST NUMBER 33 /end CHARACTERISTIC
/begin CHARACTERISTIC KL_RTH0FAK3 "RTHfaktor3 ueber Generatorstrom" CURVE 0x000C11AA TKL_UB_VV_UB 100.0 Def_f_ub_b4 0.0 3.9843 /begin FUNCTION_LIST IMDGEN_1PR /end FUNCTION_LIST /begin AXIS_DESCR STD_AXIS I_gen_end Def_i_ub_q1 11 0.0 255.0000 /end AXIS_DESCR /end CHARACTERISTIC
/begin CHARACTERISTIC KL_GENTETA4 "Temperatur_eta_faktor Generator4" CURVE 0x000C11C2 TKL_SW_VV_UW 100.0 Def_f_uw_b2 0.0 1.9999 /begin FUNCTION_LIST IMDGEN_1PR /end FUNCTION_LIST
 /begin AXIS_DESCR STD_AXIS Tgen Def_t_sw_q0p1 3 -3276.8000 3276.7000 FORMAT "%4.1" /end AXIS_DESCR
/end CHARACTERISTIC
/begin CHARACTERISTIC KL_RTHGEN2 "RTH-Kennfeld Generator2" CURVE 0x000C11D0 TKL_SW_VV_UW 100.0 Def_f_uw_b64 0.0 1.0000 /begin FUNCTION_LIST IMDGEN_1PR /end FUNCTION_LIST /begin AXIS_DESCR STD_AXIS N_gen Def_n_sw_q1p0 6 -32768.0000 32767.0000 /end AXIS_DESCR FORMAT "%7.4" /end CHARACTERISTIC
/begin CHARACTERISTIC KL_GENTETA3 "Temperatur_eta_faktor Generator3" CURVE 0x000C11EA TKL_SW_VV_UW 100.0 Def_f_uw_b2 0.0 1.9999 /begin FUNCTION_LIST IMDGEN_1PR /end FUNCTION_LIST
 /begin AXIS_DESCR STD_AXIS Tgen Def_t_sw_q0p1 3 -3276.8000 3276.7000 FORMAT "%4.1" /end AXIS_DESCR
/end CHARACTERISTIC
/begin CHARACTERISTIC KL_RTH0FAK1 "RTHfaktor1 ueber Generatorstrom" CURVE 0x000C11F8 TKL_UB_VV_UB 100.0 Def_f_ub_b4 0.0 3.9843 /begin FUNCTION_LIST IMDGEN_1PR /end FUNCTION_LIST /begin AXIS_DESCR STD_AXIS I_gen_end Def_i_ub_q1 11 0.0 255.0000 /end AXIS_DESCR /end CHARACTERISTIC
/begin CHARACTERISTIC KL_RTHGEN1 "RTH-Kennfeld Generator1" CURVE 0x000C1210 TKL_SW_VV_UW 100.0 Def_f_uw_b64 0.0 1.0000 /begin FUNCTION_LIST IMDGEN_1PR /end FUNCTION_LIST /begin AXIS_DESCR STD_AXIS N_gen Def_n_sw_q1p0 6 -32768.0000 32767.0000 /end AXIS_DESCR FORMAT "%7.4" /end CHARACTERISTIC
/begin CHARACTERISTIC KL_RTH0FAK4 "RTHfaktor4 ueber Generatorstrom" CURVE 0x000C122A TKL_UB_VV_UB 100.0 Def_f_ub_b4 0.0 3.9843 /begin FUNCTION_LIST IMDGEN_1PR /end FUNCTION_LIST /begin AXIS_DESCR STD_AXIS I_gen_end Def_i_ub_q1 11 0.0 255.0000 /end AXIS_DESCR /end CHARACTERISTIC
/begin CHARACTERISTIC KL_GENEXP2 "Abkühlkurve Generator2" CURVE 0x000C1242 TKL_UW_VV_UB 100.0 Def_f_ub_b1 0.0 0.9960 /begin FUNCTION_LIST IMDGEN_1PR /end FUNCTION_LIST /begin AXIS_DESCR STD_AXIS Tn_abstell Def_st_uw_q1 13 0.0 65535.0000 /end AXIS_DESCR /end CHARACTERISTIC
/begin CHARACTERISTIC KL_RTHGEN3 "RTH-Kennfeld Generator3" CURVE 0x000C126C TKL_SW_VV_UW 100.0 Def_f_uw_b64 0.0 1.0000 /begin FUNCTION_LIST IMDGEN_1PR /end FUNCTION_LIST /begin AXIS_DESCR STD_AXIS N_gen Def_n_sw_q1p0 6 -32768.0000 32767.0000 /end AXIS_DESCR FORMAT "%7.4" /end CHARACTERISTIC
/begin CHARACTERISTIC KL_RTHFAK2 "RTHfaktor2 ueber Generatorstrom Fahrt" CURVE 0x000C1286 TKL_UB_VV_UB 100.0 Def_f_ub_b4 0.0 3.9843 /begin FUNCTION_LIST IMDGEN_1PR /end FUNCTION_LIST /begin AXIS_DESCR STD_AXIS I_gen_end Def_i_ub_q1 11 0.0 255.0000 /end AXIS_DESCR /end CHARACTERISTIC
/begin CHARACTERISTIC KL_GENEXP1 "Abkühlkurve Generator1" CURVE 0x000C129E TKL_UW_VV_UB 100.0 Def_f_ub_b1 0.0 0.9960 /begin FUNCTION_LIST IMDGEN_1PR /end FUNCTION_LIST /begin AXIS_DESCR STD_AXIS Tn_abstell Def_st_uw_q1 13 0.0 65535.0000 /end AXIS_DESCR /end CHARACTERISTIC
/begin CHARACTERISTIC KL_TANSGEN4 "Kennlinie Generatoransaugluft4" CURVE 0x000C12C8 TKL_UW_VV_SW 100.0 Def_t_sw_q0p1 -3276.8000 3276.7000 /begin FUNCTION_LIST IMDGEN_1PR /end FUNCTION_LIST /begin AXIS_DESCR STD_AXIS NO_INPUT_QUANTITY Def_v_uw_q1p0 10 0.0 360.0000 /end AXIS_DESCR FORMAT "%4.1" /end CHARACTERISTIC
/begin CHARACTERISTIC KL_GENEXP4 "Abkühlkurve Generator4" CURVE 0x000C12F2 TKL_UW_VV_UB 100.0 Def_f_ub_b1 0.0 0.9960 /begin FUNCTION_LIST IMDGEN_1PR /end FUNCTION_LIST /begin AXIS_DESCR STD_AXIS Tn_abstell Def_st_uw_q1 13 0.0 65535.0000 /end AXIS_DESCR /end CHARACTERISTIC
/begin CHARACTERISTIC KL_TANSGEN3 "Kennlinie Generatoransaugluft3" CURVE 0x000C131C TKL_UW_VV_SW 100.0 Def_t_sw_q0p1 -3276.8000 3276.7000 /begin FUNCTION_LIST IMDGEN_1PR /end FUNCTION_LIST /begin AXIS_DESCR STD_AXIS NO_INPUT_QUANTITY Def_v_uw_q1p0 10 0.0 360.0000 /end AXIS_DESCR FORMAT "%4.1" /end CHARACTERISTIC
/begin CHARACTERISTIC KL_TANSGEN1 "Kennlinie Generatoransaugluft1" CURVE 0x000C1346 TKL_UW_VV_SW 100.0 Def_t_sw_q0p1 -3276.8000 3276.7000 /begin FUNCTION_LIST IMDGEN_1PR /end FUNCTION_LIST /begin AXIS_DESCR STD_AXIS NO_INPUT_QUANTITY Def_v_uw_q1p0 10 0.0 360.0000 /end AXIS_DESCR FORMAT "%4.1" /end CHARACTERISTIC
/begin CHARACTERISTIC KL_RTHFAK3 "RTHfaktor3 ueber Generatorstrom Fahrt" CURVE 0x000C1370 TKL_UB_VV_UB 100.0 Def_f_ub_b4 0.0 3.9843 /begin FUNCTION_LIST IMDGEN_1PR /end FUNCTION_LIST /begin AXIS_DESCR STD_AXIS I_gen_end Def_i_ub_q1 11 0.0 255.0000 /end AXIS_DESCR /end CHARACTERISTIC
/begin CHARACTERISTIC KL_TANSGEN2 "Kennlinie Generatoransaugluft2" CURVE 0x000C1388 TKL_UW_VV_SW 100.0 Def_t_sw_q0p1 -3276.8000 3276.7000 /begin FUNCTION_LIST IMDGEN_1PR /end FUNCTION_LIST /begin AXIS_DESCR STD_AXIS NO_INPUT_QUANTITY Def_v_uw_q1p0 10 0.0 360.0000 /end AXIS_DESCR FORMAT "%4.1" /end CHARACTERISTIC
/begin CHARACTERISTIC KL_RTHFAK4 "RTHfaktor4 ueber Generatorstrom Fahrt" CURVE 0x000C13B2 TKL_UB_VV_UB 100.0 Def_f_ub_b4 0.0 3.9843 /begin FUNCTION_LIST IMDGEN_1PR /end FUNCTION_LIST /begin AXIS_DESCR STD_AXIS I_gen_end Def_i_ub_q1 11 0.0 255.0000 /end AXIS_DESCR /end CHARACTERISTIC
/begin CHARACTERISTIC KL_GENEXP3 "Abkühlkurve Generator3" CURVE 0x000C13CA TKL_UW_VV_UB 100.0 Def_f_ub_b1 0.0 0.9960 /begin FUNCTION_LIST IMDGEN_1PR /end FUNCTION_LIST /begin AXIS_DESCR STD_AXIS Tn_abstell Def_st_uw_q1 13 0.0 65535.0000 /end AXIS_DESCR /end CHARACTERISTIC
/begin CHARACTERISTIC KL_FPDIODE3 "Verlustleistungsfaktor eines Diodenpaars" CURVE 0x000C13F4 TKL_SW_VV_UB 100.0 Def_f_ub_b2 0.0 1.9921 /begin FUNCTION_LIST IMDGEN_1PR /end FUNCTION_LIST
 /begin AXIS_DESCR STD_AXIS Tgen Def_t_sw_q0p1 5 -3276.8000 3276.7000 FORMAT "%4.1" /end AXIS_DESCR
/end CHARACTERISTIC
/begin CHARACTERISTIC KL_GENTETA1 "Temperatur_eta_faktor Generator1" CURVE 0x000C1406 TKL_SW_VV_UW 100.0 Def_f_uw_b2 0.0 1.9999 /begin FUNCTION_LIST IMDGEN_1PR /end FUNCTION_LIST
 /begin AXIS_DESCR STD_AXIS Tgen Def_t_sw_q0p1 3 -3276.8000 3276.7000 FORMAT "%4.1" /end AXIS_DESCR
/end CHARACTERISTIC
/begin CHARACTERISTIC KL_RTH0FAK2 "RTHfaktor 2 ueber Generatorstrom" CURVE 0x000C1414 TKL_UB_VV_UB 100.0 Def_f_ub_b4 0.0 3.9843 /begin FUNCTION_LIST IMDGEN_1PR /end FUNCTION_LIST /begin AXIS_DESCR STD_AXIS I_gen_end Def_i_ub_q1 11 0.0 255.0000 /end AXIS_DESCR /end CHARACTERISTIC
/begin CHARACTERISTIC KL_FPDIODE1 "Verlustleistungsfaktor eines Diodenpaars1" CURVE 0x000C142C TKL_SW_VV_UB 100.0 Def_f_ub_b2 0.0 1.9921 /begin FUNCTION_LIST IMDGEN_1PR /end FUNCTION_LIST
 /begin AXIS_DESCR STD_AXIS Tgen Def_t_sw_q0p1 5 -3276.8000 3276.7000 FORMAT "%4.1" /end AXIS_DESCR
/end CHARACTERISTIC
/begin CHARACTERISTIC KL_RTHGEN4 "RTH-Kennfeld Generator4" CURVE 0x000C143E TKL_SW_VV_UW 100.0 Def_f_uw_b64 0.0 1.0000 /begin FUNCTION_LIST IMDGEN_1PR /end FUNCTION_LIST /begin AXIS_DESCR STD_AXIS N_gen Def_n_sw_q1p0 6 -32768.0000 32767.0000 /end AXIS_DESCR FORMAT "%7.4" /end CHARACTERISTIC
/begin CHARACTERISTIC KL_GENTETA2 "Temperatur_eta_faktor Generator2" CURVE 0x000C1458 TKL_SW_VV_UW 100.0 Def_f_uw_b2 0.0 1.9999 /begin FUNCTION_LIST IMDGEN_1PR /end FUNCTION_LIST
 /begin AXIS_DESCR STD_AXIS Tgen Def_t_sw_q0p1 3 -3276.8000 3276.7000 FORMAT "%4.1" /end AXIS_DESCR
/end CHARACTERISTIC
/begin CHARACTERISTIC KL_RTHFAK1 "RTHfaktor ueber Generatorstrom" CURVE 0x000C1466 TKL_UB_VV_UB 100.0 Def_f_ub_b4 0.0 3.9843 /begin FUNCTION_LIST IMDGEN_1PR /end FUNCTION_LIST /begin AXIS_DESCR STD_AXIS I_gen_end Def_i_ub_q1 11 0.0 255.0000 /end AXIS_DESCR /end CHARACTERISTIC
/begin CHARACTERISTIC KL_FPDIODE4 "Verlustleistungsfaktor eines Diodenpaars4" CURVE 0x000C147E TKL_SW_VV_UB 100.0 Def_f_ub_b2 0.0 1.9921 /begin FUNCTION_LIST IMDGEN_1PR /end FUNCTION_LIST
 /begin AXIS_DESCR STD_AXIS Tgen Def_t_sw_q0p1 5 -3276.8000 3276.7000 FORMAT "%4.1" /end AXIS_DESCR
/end CHARACTERISTIC
/begin CHARACTERISTIC KL_FPDIODE2 "Verlustleistungsfaktor eines Diodenpaars2" CURVE 0x000C1490 TKL_SW_VV_UB 100.0 Def_f_ub_b2 0.0 1.9921 /begin FUNCTION_LIST IMDGEN_1PR /end FUNCTION_LIST
 /begin AXIS_DESCR STD_AXIS Tgen Def_t_sw_q0p1 5 -3276.8000 3276.7000 FORMAT "%4.1" /end AXIS_DESCR
/end CHARACTERISTIC
/begin CHARACTERISTIC KF_GENWETA1 "Wirkungsgrad1 Generator mit 2*PI" MAP 0x000C14A2 TKF_SW_UB_UB 100.0 Def_f_ub_b8 0.0 7.9687 /begin FUNCTION_LIST IMDGEN_1PR /end FUNCTION_LIST /begin AXIS_DESCR STD_AXIS I_gm Def_i_ub_q1 8 0.0 255.0000 /end AXIS_DESCR /begin AXIS_DESCR STD_AXIS N_gen Def_n_sw_q1p0 8 -32768.0000 32767.0000 /end AXIS_DESCR /end CHARACTERISTIC
/begin CHARACTERISTIC KF_GENWETA2 "Wirkungsgrad2 Generator mit 2*PI" MAP 0x000C14FC TKF_SW_UB_UB 100.0 Def_f_ub_b8 0.0 7.9687 /begin FUNCTION_LIST IMDGEN_1PR /end FUNCTION_LIST /begin AXIS_DESCR STD_AXIS I_gm Def_i_ub_q1 8 0.0 255.0000 /end AXIS_DESCR /begin AXIS_DESCR STD_AXIS N_gen Def_n_sw_q1p0 8 -32768.0000 32767.0000 /end AXIS_DESCR /end CHARACTERISTIC
/begin CHARACTERISTIC KF_MDGENFIL "Filterung Generatormoment" MAP 0x000C1556 TKF_SW_SW_UW 100.0 Def_f_uw_b1 0.0 9.99984741210938e-1 /begin FUNCTION_LIST IMDGEN_1PR /end FUNCTION_LIST
 /begin AXIS_DESCR STD_AXIS Md_gennmufi Def_m_sw_q0p1 6 -3276.8000 3276.7000 FORMAT "%5.2" /end AXIS_DESCR
 /begin AXIS_DESCR STD_AXIS Nkw Def_n_sw_q1p0 6 -32768.0000 32767.0000 /end AXIS_DESCR
/end CHARACTERISTIC
/begin CHARACTERISTIC KF_GENWETA4 "Wirkungsgrad4 Generator mit 2*PI" MAP 0x000C15B8 TKF_SW_UB_UB 100.0 Def_f_ub_b8 0.0 7.9687 /begin FUNCTION_LIST IMDGEN_1PR /end FUNCTION_LIST /begin AXIS_DESCR STD_AXIS I_gm Def_i_ub_q1 8 0.0 255.0000 /end AXIS_DESCR /begin AXIS_DESCR STD_AXIS N_gen Def_n_sw_q1p0 8 -32768.0000 32767.0000 /end AXIS_DESCR /end CHARACTERISTIC
/begin CHARACTERISTIC KF_GENWETA3 "Wirkungsgrad3 Generator mit 2*PI" MAP 0x000C1612 TKF_SW_UB_UB 100.0 Def_f_ub_b8 0.0 7.9687 /begin FUNCTION_LIST IMDGEN_1PR /end FUNCTION_LIST /begin AXIS_DESCR STD_AXIS I_gm Def_i_ub_q1 8 0.0 255.0000 /end AXIS_DESCR /begin AXIS_DESCR STD_AXIS N_gen Def_n_sw_q1p0 8 -32768.0000 32767.0000 /end AXIS_DESCR /end CHARACTERISTIC
/begin CHARACTERISTIC KF_IGENDF2 "Generatorstrom2 DF-Kennfeld" MAP 0x000C166C TKF_UB_UB_UB 100.0 Def_i_ub_q1 0.0 255.0000 /begin FUNCTION_LIST IMDGEN_1PR /end FUNCTION_LIST /begin AXIS_DESCR STD_AXIS Dffgen Def_f_ub_b100 7 0.0 99.6093 /end AXIS_DESCR /begin AXIS_DESCR STD_AXIS I_genmax Def_i_ub_q1 8 0.0 255.0000 /end AXIS_DESCR /end CHARACTERISTIC
/begin CHARACTERISTIC KF_IGENDF1 "Generatorstrom1 DF-Kennfeld" MAP 0x000C16B5 TKF_UB_UB_UB 100.0 Def_i_ub_q1 0.0 255.0000 /begin FUNCTION_LIST IMDGEN_1PR /end FUNCTION_LIST /begin AXIS_DESCR STD_AXIS Dffgen Def_f_ub_b100 7 0.0 99.6093 /end AXIS_DESCR /begin AXIS_DESCR STD_AXIS I_genmax Def_i_ub_q1 8 0.0 255.0000 /end AXIS_DESCR /end CHARACTERISTIC
/begin CHARACTERISTIC KF_IGENDF4 "Generatorstrom4 DF-Kennfeld" MAP 0x000C16FE TKF_UB_UB_UB 100.0 Def_i_ub_q1 0.0 255.0000 /begin FUNCTION_LIST IMDGEN_1PR /end FUNCTION_LIST /begin AXIS_DESCR STD_AXIS Dffgen Def_f_ub_b100 7 0.0 99.6093 /end AXIS_DESCR /begin AXIS_DESCR STD_AXIS I_genmax Def_i_ub_q1 8 0.0 255.0000 /end AXIS_DESCR /end CHARACTERISTIC
/begin CHARACTERISTIC KF_IGENDF3 "Generatorstrom3 DF-Kennfeld" MAP 0x000C1747 TKF_UB_UB_UB 100.0 Def_i_ub_q1 0.0 255.0000 /begin FUNCTION_LIST IMDGEN_1PR /end FUNCTION_LIST /begin AXIS_DESCR STD_AXIS Dffgen Def_f_ub_b100 7 0.0 99.6093 /end AXIS_DESCR /begin AXIS_DESCR STD_AXIS I_genmax Def_i_ub_q1 8 0.0 255.0000 /end AXIS_DESCR /end CHARACTERISTIC
/begin CHARACTERISTIC K_ENISOC0 "" VALUE 0x000C1794 TKW_VV_VV_UB 100.0 Def_i_ub_q0p02 0.0 5.1000 /begin FUNCTION_LIST KT_IBS /end FUNCTION_LIST /end CHARACTERISTIC
/begin CHARACTERISTIC K_ENUSOC0 "" VALUE 0x000C1795 TKW_VV_VV_UB 100.0 Def_u_ub_q0p064_o6 6.0000 22.3200 /begin FUNCTION_LIST KT_IBS /end FUNCTION_LIST /end CHARACTERISTIC
/begin CHARACTERISTIC K_T1SOC0 "" VALUE 0x000C1796 TKW_VV_VV_UB 100.0 Def_td_ub_q256 0.0 65280.0000 /begin FUNCTION_LIST KT_IBS /end FUNCTION_LIST /end CHARACTERISTIC
/begin CHARACTERISTIC K_T2SOC0 "" VALUE 0x000C1797 TKW_VV_VV_UB 100.0 Def_td_ub_q256 0.0 65280.0000 /begin FUNCTION_LIST KT_IBS /end FUNCTION_LIST /end CHARACTERISTIC
/begin CHARACTERISTIC K_T3SOC0 "" VALUE 0x000C1798 TKW_VV_VV_UB 100.0 Def_td_ub_q256 0.0 65280.0000 /begin FUNCTION_LIST KT_IBS /end FUNCTION_LIST /end CHARACTERISTIC
/begin CHARACTERISTIC K_ISTARTTRIG "" VALUE 0x000C1799 TKW_VV_VV_UB 100.0 Def_i_ub_q5p12 0.0 1305.6000 /begin FUNCTION_LIST KT_IBS /end FUNCTION_LIST /end CHARACTERISTIC
/begin CHARACTERISTIC K_TNUSTART "" VALUE 0x000C179A TKW_VV_VV_UB 100.0 Def_td_ub_q0p0125 0.0 3.1875 /begin FUNCTION_LIST KT_IBS /end FUNCTION_LIST /end CHARACTERISTIC
/begin CHARACTERISTIC K_TNUSTARTFL "" VALUE 0x000C179B TKW_VV_VV_UB 100.0 Def_td_ub_q0p002_o01 0.0100 0.5200 /begin FUNCTION_LIST KT_IBS /end FUNCTION_LIST /end CHARACTERISTIC
/begin CHARACTERISTIC K_UTIEFAPP "" VALUE 0x000C179C TKW_VV_VV_UB 100.0 Def_u_ub_q0p064_o6 6.0000 22.3200 /begin FUNCTION_LIST KT_IBS /end FUNCTION_LIST /end CHARACTERISTIC
/begin CHARACTERISTIC K_T_UTIEFSET "" VALUE 0x000C179D TKW_VV_VV_UB 100.0 Def_td_ub_q1 0.0 255.0000 /begin FUNCTION_LIST KT_IBS /end FUNCTION_LIST /end CHARACTERISTIC
/begin CHARACTERISTIC K_TSLEEPRUH "" VALUE 0x000C179E TKW_VV_VV_UB 100.0 Def_td_ub_q16 0.0 4080.0000 /begin FUNCTION_LIST KT_IBS /end FUNCTION_LIST /end CHARACTERISTIC
/begin CHARACTERISTIC K_T1SCHWELLE "" VALUE 0x000C179F TKW_VV_VV_UB 100.0 Def_i_ub_q0p04 0.0 10.2000 /begin FUNCTION_LIST KT_IBS /end FUNCTION_LIST /end CHARACTERISTIC
/begin CHARACTERISTIC K_T2SCHWELLE "" VALUE 0x000C17A0 TKW_VV_VV_UB 100.0 Def_i_ub_q0p04 0.0 10.2000 /begin FUNCTION_LIST KT_IBS /end FUNCTION_LIST /end CHARACTERISTIC
/begin CHARACTERISTIC K_T3SCHWELLE "" VALUE 0x000C17A1 TKW_VV_VV_UB 100.0 Def_i_ub_q0p04 0.0 10.2000 /begin FUNCTION_LIST KT_IBS /end FUNCTION_LIST /end CHARACTERISTIC
/begin CHARACTERISTIC K_ISLEEPGRZ "" VALUE 0x000C17A2 TKW_VV_VV_UB 100.0 Def_i_ub_q0p02 0.0 5.1000 /begin FUNCTION_LIST KT_IBS /end FUNCTION_LIST /end CHARACTERISTIC
/begin CHARACTERISTIC K_DI1000TGRZ "" VALUE 0x000C17A3 TKW_VV_VV_UB 100.0 Def_td_ub_q1 0.0 255.0000 /begin FUNCTION_LIST KT_IBS /end FUNCTION_LIST /end CHARACTERISTIC
/begin CHARACTERISTIC K_DUIGRZ "" VALUE 0x000C17A4 TKW_VV_VV_UB 100.0 Def_i_ub_q0p02 0.0 5.1000 /begin FUNCTION_LIST KT_IBS /end FUNCTION_LIST /end CHARACTERISTIC
/begin CHARACTERISTIC K_DTMAXGRZI "" VALUE 0x000C17A5 TKW_VV_VV_UB 100.0 Def_td_ub_q1 0.0 255.0000 /begin FUNCTION_LIST KT_IBS /end FUNCTION_LIST /end CHARACTERISTIC
/begin CHARACTERISTIC K_DILOWGRZ "" VALUE 0x000C17A6 TKW_VV_VV_UB 100.0 Def_i_ub_q0p02 0.0 5.1000 /begin FUNCTION_LIST KT_IBS /end FUNCTION_LIST /end CHARACTERISTIC
/begin CHARACTERISTIC K_DIHIGHGRZ "" VALUE 0x000C17A7 TKW_VV_VV_UB 100.0 Def_i_ub_q0p08 0.0 20.4000 /begin FUNCTION_LIST KT_IBS /end FUNCTION_LIST /end CHARACTERISTIC
/begin CHARACTERISTIC K_DUMINTGRZ "" VALUE 0x000C17A8 TKW_VV_VV_UB 100.0 Def_td_ub_q0p05 0.0 12.7500 /begin FUNCTION_LIST KT_IBS /end FUNCTION_LIST /end CHARACTERISTIC
/begin CHARACTERISTIC K_DKL15FIL "" VALUE 0x000C17A9 TKW_VV_VV_UB 100.0 Def_td_ub_q0p00625 0.0 1.5937 /begin FUNCTION_LIST KT_IBS /end FUNCTION_LIST /end CHARACTERISTIC
/begin CHARACTERISTIC K_DUREFMAX "" VALUE 0x000C17AA TKW_VV_VV_UB 100.0 Def_u_ub_q0p0196 0.0 4.9980 /begin FUNCTION_LIST KT_IBS /end FUNCTION_LIST /end CHARACTERISTIC
/begin CHARACTERISTIC K_DI200STG "" VALUE 0x000C17AB TKW_VV_VV_UB 100.0 Def_i_ub_q0p02 0.0 5.1000 /begin FUNCTION_LIST KT_IBS /end FUNCTION_LIST /end CHARACTERISTIC
/begin CHARACTERISTIC K_DI1000STG "" VALUE 0x000C17AC TKW_VV_VV_UB 100.0 Def_i_ub_q0p08 0.0 20.4000 /begin FUNCTION_LIST KT_IBS /end FUNCTION_LIST /end CHARACTERISTIC
/begin CHARACTERISTIC K_DI200DT "" VALUE 0x000C17AD TKW_VV_VV_UB 100.0 Def_td_ub_q0p05 0.0 12.7500 /begin FUNCTION_LIST KT_IBS /end FUNCTION_LIST /end CHARACTERISTIC
/begin CHARACTERISTIC K_DI1000DT "" VALUE 0x000C17AE TKW_VV_VV_UB 100.0 Def_td_ub_q0p05 0.0 12.7500 /begin FUNCTION_LIST KT_IBS /end FUNCTION_LIST /end CHARACTERISTIC
/begin CHARACTERISTIC K_TMPCOM_MUL "" VALUE 0x000C17AF TKW_VV_VV_UB 100.0 Def_dez_ub_q1 0.0 255.0000 /begin FUNCTION_LIST KT_IBS /end FUNCTION_LIST /end CHARACTERISTIC
/begin CHARACTERISTIC K_TMPCOM_DIV "" VALUE 0x000C17B0 TKW_VV_VV_UB 100.0 Def_dez_ub_q1 0.0 255.0000 /begin FUNCTION_LIST KT_IBS /end FUNCTION_LIST /end CHARACTERISTIC
/begin CHARACTERISTIC K_DIPL5 "" VALUE 0x000C17B1 TKW_VV_VV_UB 100.0 Def_dez_ub_q1 0.0 255.0000 /begin FUNCTION_LIST KT_IBS /end FUNCTION_LIST /end CHARACTERISTIC
/begin CHARACTERISTIC K_DIPL6 "" VALUE 0x000C17B2 TKW_VV_VV_UB 100.0 Def_dez_ub_q1 0.0 255.0000 /begin FUNCTION_LIST KT_IBS /end FUNCTION_LIST /end CHARACTERISTIC
/begin CHARACTERISTIC K_DIPL7 "" VALUE 0x000C17B3 TKW_VV_VV_UB 100.0 Def_dez_ub_q1 0.0 255.0000 /begin FUNCTION_LIST KT_IBS /end FUNCTION_LIST /end CHARACTERISTIC
/begin CHARACTERISTIC K_DIPL8 "" VALUE 0x000C17B4 TKW_VV_VV_UB 100.0 Def_dez_ub_q1 0.0 255.0000 /begin FUNCTION_LIST KT_IBS /end FUNCTION_LIST /end CHARACTERISTIC
/begin CHARACTERISTIC K_DUREFMINI "" VALUE 0x000C17B5 TKW_VV_VV_UB 100.0 Def_u_ub_q0p0196 0.0 4.9980 /begin FUNCTION_LIST KT_IBS /end FUNCTION_LIST /end CHARACTERISTIC
/begin CHARACTERISTIC K_IBTEMPMAXI "" VALUE 0x000C17B6 TKW_VV_VV_UB 100.0 Def_dez_ub_q1 0.0 255.0000 /begin FUNCTION_LIST KT_IBS /end FUNCTION_LIST /end CHARACTERISTIC
/begin CHARACTERISTIC K_IBTEMPMINI "" VALUE 0x000C17B7 TKW_VV_VV_UB 100.0 Def_dez_ub_q1 0.0 255.0000 /begin FUNCTION_LIST KT_IBS /end FUNCTION_LIST /end CHARACTERISTIC
/begin CHARACTERISTIC K_IBSVERSION "Liste der kompatiblen IBS SW- Versionen" VAL_BLK 0x000C17B8 TKW_VV_VV_UB 100.0 Def_dez_ub_q1 0.0 255.0000 /begin FUNCTION_LIST KT_IBS /end FUNCTION_LIST NUMBER 16 /end CHARACTERISTIC
/begin CHARACTERISTIC K_ENABSDIBS "kt_ibs enable Kommunikation" VALUE 0x000C17C8 TKW_VV_VV_UB 100.0 Def_dez_ub_q1 0.0 255.0000 /begin FUNCTION_LIST KT_IBS /end FUNCTION_LIST /end CHARACTERISTIC
/begin CHARACTERISTIC K_ERREPEAT "EBSD Fehler repeat" VALUE 0x000C17C9 TKW_VV_VV_UB 100.0 Def_dez_ub_q1 0.0 255.0000 /begin FUNCTION_LIST KT_IBS /end FUNCTION_LIST /end CHARACTERISTIC
/begin CHARACTERISTIC K_IBUNPLADEL "EBSD Fehler repeat" VALUE 0x000C17CA TKW_VV_VV_UB 100.0 Def_dez_ub_q1 0.0 255.0000 /begin FUNCTION_LIST KT_IBS /end FUNCTION_LIST /end CHARACTERISTIC
/begin CHARACTERISTIC K_IBSTSTERR "EBSD Fehler repeat" VALUE 0x000C17CB TKW_VV_VV_UB 100.0 Def_dez_ub_q1 0.0 255.0000 /begin FUNCTION_LIST KT_IBS /end FUNCTION_LIST /end CHARACTERISTIC
/begin CHARACTERISTIC K_S_CLERRIBS "IBS Fehlerlöschen schaltbar" VALUE 0x000C17CC TKW_VV_VV_UB 100.0 Def_dez_ub_q1 0.0 255.0000 /begin FUNCTION_LIST KT_IBS /end FUNCTION_LIST /end CHARACTERISTIC
/begin CHARACTERISTIC K_T_CLERRIBS "" VALUE 0x000C17CD TKW_VV_VV_UB 100.0 Def_dez_ub_q1 0.0 255.0000 /begin FUNCTION_LIST KT_IBS /end FUNCTION_LIST /end CHARACTERISTIC
/begin CHARACTERISTIC K_SLEEPWAIT "" VALUE 0x000C17CE TKW_VV_VV_UB 100.0 ident 0.0 255.0000 /begin FUNCTION_LIST KT_IBS /end FUNCTION_LIST /end CHARACTERISTIC
/begin CHARACTERISTIC K_TPT1TICO "" VALUE 0x000C1790 TKW_VV_VV_UW 100.0 Def_td_uw_q0p05 0.0 3276.7500 /begin FUNCTION_LIST KT_IBS /end FUNCTION_LIST FORMAT "%5.2" /end CHARACTERISTIC
/begin CHARACTERISTIC VSACD_ctPwrStgOnMax_C "Maximaler Zähler für Powerstage On im Fehlerfall" VALUE 0xEEC80 Kw_Wu16 65535.00 OneToOne 0.00 65535.00 FORMAT "%8.2" /end CHARACTERISTIC
/begin CHARACTERISTIC VSACD_tiDebDioInDia1Def_C "Fehlerentprellzeit für Kurzschluss nach digital eingabe für Window1" VALUE 0xEEC82 Kw_Wu16 655350.0 Time_ms 0.00 655350.0 FORMAT "%8.1" /end CHARACTERISTIC
/begin CHARACTERISTIC VSACD_tiDebDioInDia1Ok_C "Heilungsentprellzeit für kurzschluss nach digital eingabe für window1" VALUE 0xEEC84 Kw_Wu16 655350.0 Time_ms 0.00 655350.0 FORMAT "%8.1" /end CHARACTERISTIC
/begin CHARACTERISTIC VSACD_tiDebDioInDia2Def_C "Fehlerentprellzeit für Kurzschluss nach digital eingabe für Window2" VALUE 0xEEC86 Kw_Wu16 655350.0 Time_ms 0.00 655350.0 FORMAT "%8.1" /end CHARACTERISTIC
/begin CHARACTERISTIC VSACD_tiDebDioInDia2Ok_C "Heilungsentprellzeit für kurzschluss nach digital eingabe für window2" VALUE 0xEEC88 Kw_Wu16 655350.0 Time_ms 0.00 655350.0 FORMAT "%8.1" /end CHARACTERISTIC
/begin CHARACTERISTIC VSACD_tiDebDioInDia3Def_C "Fehlerentprellzeit für Kurzschluss nach digital eingabe für Window3" VALUE 0xEEC8A Kw_Wu16 655350.0 Time_ms 0.00 655350.0 FORMAT "%8.1" /end CHARACTERISTIC
/begin CHARACTERISTIC VSACD_tiDebDioInDia3Ok_C "Heilungsentprellzeit für kurzschluss nach digital eingabe für window3" VALUE 0xEEC8C Kw_Wu16 655350.0 Time_ms 0.00 655350.0 FORMAT "%8.1" /end CHARACTERISTIC
/begin CHARACTERISTIC VSACD_tiDebDioInDia4Def_C "Fehlerentprellzeit für Kurzschluss nach digital eingabe für Window4" VALUE 0xEEC8E Kw_Wu16 655350.0 Time_ms 0.00 655350.0 FORMAT "%8.1" /end CHARACTERISTIC
/begin CHARACTERISTIC VSACD_tiDebDioInDia4Ok_C "Heilungsentprellzeit für kurzschluss nach digital eingabe für window4" VALUE 0xEEC90 Kw_Wu16 655350.0 Time_ms 0.00 655350.0 FORMAT "%8.1" /end CHARACTERISTIC
/begin CHARACTERISTIC VSACD_tiDebDioInMinDef_C "Fehlerentprellzeit für digital eingabe Min fehler" VALUE 0xEEC92 Kw_Wu16 655350.0 Time_ms 0.00 655350.0 FORMAT "%8.1" /end CHARACTERISTIC
/begin CHARACTERISTIC VSACD_tiDebDioInMinOk_C "Heilungsentprellzeit für digital eingabe Min fehler" VALUE 0xEEC94 Kw_Wu16 655350.0 Time_ms 0.00 655350.0 FORMAT "%8.1" /end CHARACTERISTIC
/begin CHARACTERISTIC VSACD_DebExcTempDef_C "Fehlerentprellzeit für Übertemperatur" VALUE 0xEEC96 Kw_Wu16 655350.0 Time_ms 0.00 655350.0 FORMAT "%8.1" /end CHARACTERISTIC
/begin CHARACTERISTIC VSACD_DebExcTempOk_C "Heilungsentprellzeit für Übertemperatur" VALUE 0xEEC98 Kw_Wu16 655350.0 Time_ms 0.00 655350.0 FORMAT "%8.1" /end CHARACTERISTIC
/begin CHARACTERISTIC VSACD_DebNoLoadDef_C "Fehlerentprellzeit für Lastabfall" VALUE 0xEEC9A Kw_Wu16 655350.0 Time_ms 0.00 655350.0 FORMAT "%8.1" /end CHARACTERISTIC
/begin CHARACTERISTIC VSACD_DebNoLoadOk_C "Heilungsentprellzeit für Lastabfall" VALUE 0xEEC9C Kw_Wu16 655350.0 Time_ms 0.00 655350.0 FORMAT "%8.1" /end CHARACTERISTIC
/begin CHARACTERISTIC VSACD_DebShortCircBatDef_C "Fehlerentprellzeit für Kurzschluß nach Batterie" VALUE 0xEEC9E Kw_Wu16 655350.0 Time_ms 0.00 655350.0 FORMAT "%8.1" /end CHARACTERISTIC
/begin CHARACTERISTIC VSACD_DebShortCircBatOk_C "Heilungsentprellzeit für Kurzschluß nach Batterie" VALUE 0xEECA0 Kw_Wu16 655350.0 Time_ms 0.00 655350.0 FORMAT "%8.1" /end CHARACTERISTIC
/begin CHARACTERISTIC VSACD_DebShortCircGndDef_C "Fehlerentprellzeit für Kurzschluß nach Masse" VALUE 0xEECA2 Kw_Wu16 655350.0 Time_ms 0.00 655350.0 FORMAT "%8.1" /end CHARACTERISTIC
/begin CHARACTERISTIC VSACD_DebShortCircGndOk_C "Heilungsentprellzeit für Kurzschluß nach Masse" VALUE 0xEECA4 Kw_Wu16 655350.0 Time_ms 0.00 655350.0 FORMAT "%8.1" /end CHARACTERISTIC
/begin CHARACTERISTIC VSACD_tiDebVSADia1Def_C "debounce duration for VSACD diagnosis error detection" VALUE 0xEECA6 Kw_Wu16 655350.0 Time_ms 0.00 655350.0 FORMAT "%8.1" /end CHARACTERISTIC
/begin CHARACTERISTIC VSACD_tiDebVSADia1Ok_C "debounce duration for VSACD diagnosis error healing" VALUE 0xEECA8 Kw_Wu16 655350.0 Time_ms 0.00 655350.0 FORMAT "%8.1" /end CHARACTERISTIC
/begin CHARACTERISTIC VSACD_tiDebVSADia2Def_C "debounce duration for VSACD diagnosis error detection" VALUE 0xEECAA Kw_Wu16 655350.0 Time_ms 0.00 655350.0 FORMAT "%8.1" /end CHARACTERISTIC
/begin CHARACTERISTIC VSACD_tiDebVSADia2Ok_C "debounce duration for VSACD diagnosis error healing" VALUE 0xEECAC Kw_Wu16 655350.0 Time_ms 0.00 655350.0 FORMAT "%8.1" /end CHARACTERISTIC
/begin CHARACTERISTIC VSACD_tiDebVSADia3Def_C "debounce duration for VSACD diagnosis error detection" VALUE 0xEECAE Kw_Wu16 655350.0 Time_ms 0.00 655350.0 FORMAT "%8.1" /end CHARACTERISTIC
/begin CHARACTERISTIC VSACD_tiDebVSADia3Ok_C "debounce duration for VSACD diagnosis error healing" VALUE 0xEECB0 Kw_Wu16 655350.0 Time_ms 0.00 655350.0 FORMAT "%8.1" /end CHARACTERISTIC
/begin CHARACTERISTIC VSACD_tiDebVSADia4Def_C "Fehlerentprellzeit für Drallklappensteller Diagnose viertes Zeitfenster" VALUE 0xEECB2 Kw_Wu16 655350.0 Time_ms 0.00 655350.0 FORMAT "%8.1" /end CHARACTERISTIC
/begin CHARACTERISTIC VSACD_tiDebVSADia4Ok_C "Heilentprellzeit für Drallklappensteller Diagnose viertes Zeitfenster" VALUE 0xEECB4 Kw_Wu16 655350.0 Time_ms 0.00 655350.0 FORMAT "%8.1" /end CHARACTERISTIC
/begin CHARACTERISTIC VSACD_numDia_C "#SSD Applikationsparameter fuer das Diagnose-Signal von Einlasskanal-Steller" VALUE 0xEECB6 Kw_Wu8 27.0000000000 NumPinDia 0.00 27.0000000000 FORMAT "%13.10" /end CHARACTERISTIC
/begin CHARACTERISTIC VSACD_numDioIn_C "Digitaleingang für variable Swirl Position" VALUE 0xEECB7 Kw_Wu8 14.0000000000 NumPinDioIn 0.00 14.0000000000 FORMAT "%13.10" /end CHARACTERISTIC
/begin CHARACTERISTIC VSACD_numPwmOut_C "#SSD Applikationsparameter fuer Einlasskanal-Steller" VALUE 0xEECB8 Kw_Wu8 13.0000000000 NumPinPwmOut 0.00 13.0000000000 FORMAT "%13.10" /end CHARACTERISTIC
/begin CHARACTERISTIC VSACD_stInvOut_C "Invertierungsparameter für das Signal der Drallniveaustellerendstufe" VALUE 0xEECBA Kw_Wu8 1.000 OneToOne 0.00 1.000 FORMAT "%5.3" EXTENDED_LIMITS 0.00 255.0 /end CHARACTERISTIC
/begin CHARACTERISTIC VSACD_tiPer_C "Periodendauer des Ausgangssignal für den Drallniveausteller" VALUE 0xEECBC Kw_Ws16 6553.500 Period -3276.800 3276.700 FORMAT "%8.3" /end CHARACTERISTIC
/begin CHARACTERISTIC VSACD_rCnv_CUR "Kennlinie zur Konvertierung von Öffnungsgrad in Tastverhältnis" CURVE 0xEECBE Kl_Xs16_Ws16 100.0000 DtyCyc 0.00 100.0000 FORMAT "%8.4" EXTENDED_LIMITS -327.6800 327.6700
 /begin AXIS_DESCR STD_AXIS VSA_rVSA DtyCyc 8 -100.0000 200.0000 FORMAT "%8.4" EXTENDED_LIMITS -327.6800 327.6700 DEPOSIT ABSOLUTE /end AXIS_DESCR
/end CHARACTERISTIC
/begin CHARACTERISTIC VSACD_rOutMax_C "Maximal auszugebendes Tastverhältnis" VALUE 0xEECE0 Kw_Ws16 655.3500 DtyCyc -327.6800 327.6700 FORMAT "%8.4" /end CHARACTERISTIC
/begin CHARACTERISTIC VSACD_rOutMin_C "Minimal auszugebendes Tastverhältnis" VALUE 0xEECE2 Kw_Ws16 655.3500 DtyCyc -327.6800 327.6700 FORMAT "%8.4" /end CHARACTERISTIC
/begin CHARACTERISTIC VSACD_stPwrStgActv_C "Aktivierung der Abschaltbedingungen der Endstufe" VALUE 0xEECE4 Kw_Wu8 255.0 OneToOne 0.00 255.0 FORMAT "%5.1" /end CHARACTERISTIC
/begin CHARACTERISTIC VSACD_stPwrStgDia_C "Aktivierung der Abschaltbedingungen der Endstufendiagnose" VALUE 0xEECE5 Kw_Wu8 255.0 OneToOne 0.00 255.0 FORMAT "%5.1" /end CHARACTERISTIC
/begin CHARACTERISTIC VSACD_stSPICtl_C "0 = Non SPI powerstage )" VALUE 0xEECE6 Kw_Wu8 1.000 OneToOne 0.00 1.000 FORMAT "%5.3" EXTENDED_LIMITS 0.00 255.0 /end CHARACTERISTIC
/begin CHARACTERISTIC VSACD_swtExtPinEna_C "Schalter für Drallklappensteller Diagnose mit extra Pin (1...ein, 0...aus)" VALUE 0xEECE7 Kw_Wu8 255.0 OneToOne 0.00 255.0 FORMAT "%5.1" /end CHARACTERISTIC
/begin CHARACTERISTIC VSACD_swt_C "Schalter Batteriespannungskorrektur (0 = AUS, 1 = EIN)" VALUE 0xEECE8 Kw_Wu8 255.0 OneToOne 0.00 255.0 FORMAT "%5.1" /end CHARACTERISTIC
/begin CHARACTERISTIC VSACD_tiBtwTst_C "Zeitabstand, in dem im Fehlerfall die Endstufe getestet wird" VALUE 0xEECEA Kw_Wu16 29980.00 Time_ms 20.00000 30000.00 FORMAT "%8.2" EXTENDED_LIMITS 0.00 655350.0 /end CHARACTERISTIC
/begin CHARACTERISTIC VSACD_tiDiag1Max_C "window 1 max. time" VALUE 0xEECEC Kw_Wu16 655350.0 Time_ms 0.00 655350.0 FORMAT "%8.1" /end CHARACTERISTIC
/begin CHARACTERISTIC VSACD_tiDiag1Min_C "window 1 min. time" VALUE 0xEECEE Kw_Wu16 655350.0 Time_ms 0.00 655350.0 FORMAT "%8.1" /end CHARACTERISTIC
/begin CHARACTERISTIC VSACD_tiDiag2Max_C "window 2 min. time" VALUE 0xEECF0 Kw_Wu16 655350.0 Time_ms 0.00 655350.0 FORMAT "%8.1" /end CHARACTERISTIC
/begin CHARACTERISTIC VSACD_tiDiag2Min_C "window 2 min. time" VALUE 0xEECF2 Kw_Wu16 655350.0 Time_ms 0.00 655350.0 FORMAT "%8.1" /end CHARACTERISTIC
/begin CHARACTERISTIC VSACD_tiDiag3Max_C "window 3 max. time" VALUE 0xEECF4 Kw_Wu16 655350.0 Time_ms 0.00 655350.0 FORMAT "%8.1" /end CHARACTERISTIC
/begin CHARACTERISTIC VSACD_tiDiag3Min_C "window 3 Min. time" VALUE 0xEECF6 Kw_Wu16 655350.0 Time_ms 0.00 655350.0 FORMAT "%8.1" /end CHARACTERISTIC
/begin CHARACTERISTIC VSACD_tiDiag4Max_C "Maximum des vierten Signalfensters für Fehlersignale des Drallklappenstellers" VALUE 0xEECF8 Kw_Wu16 655350.0 Time_ms 0.00 655350.0 FORMAT "%8.1" /end CHARACTERISTIC
/begin CHARACTERISTIC VSACD_tiDiag4Min_C "Minimum des vierten Signalfensters für Fehlersignale des Drallklappenstellers" VALUE 0xEECFA Kw_Wu16 655350.0 Time_ms 0.00 655350.0 FORMAT "%8.1" /end CHARACTERISTIC
/begin CHARACTERISTIC VSACD_tiDioInDia1Max_C "Maximum des ersten Signalfensters für Fehlersignale des Drallklappenstellers" VALUE 0xEECFC Kw_Wu16 655350.0 Time_ms 0.00 655350.0 FORMAT "%8.1" /end CHARACTERISTIC
/begin CHARACTERISTIC VSACD_tiDioInDia1Min_C "Minimum des ersten Signalfensters für Fehlersignale des Drallklappenstellers" VALUE 0xEECFE Kw_Wu16 655350.0 Time_ms 0.00 655350.0 FORMAT "%8.1" /end CHARACTERISTIC
/begin CHARACTERISTIC VSACD_tiDioInDia2Max_C "Maximum des zweiten Signalfensters für Fehlersignale des Drallklappenstellers" VALUE 0xEED00 Kw_Wu16 655350.0 Time_ms 0.00 655350.0 FORMAT "%8.1" /end CHARACTERISTIC
/begin CHARACTERISTIC VSACD_tiDioInDia2Min_C "Minimum des zweiten Signalfensters für Fehlersignale des Drallklappenstellers" VALUE 0xEED02 Kw_Wu16 655350.0 Time_ms 0.00 655350.0 FORMAT "%8.1" /end CHARACTERISTIC
/begin CHARACTERISTIC VSACD_tiDioInDia3Max_C "Maximum des dritten Signalfensters für Fehlersignale des Drallklappenstellers" VALUE 0xEED04 Kw_Wu16 655350.0 Time_ms 0.00 655350.0 FORMAT "%8.1" /end CHARACTERISTIC
/begin CHARACTERISTIC VSACD_tiDioInDia3Min_C "Minimum des dritten Signalfensters für Fehlersignale des Drallklappenstellers" VALUE 0xEED06 Kw_Wu16 655350.0 Time_ms 0.00 655350.0 FORMAT "%8.1" /end CHARACTERISTIC
/begin CHARACTERISTIC VSACD_tiDioInDia4Max_C "Maximum des vierten Signalfensters für Fehlersignale des Drallklappenstellers" VALUE 0xEED08 Kw_Wu16 655350.0 Time_ms 0.00 655350.0 FORMAT "%8.1" /end CHARACTERISTIC
/begin CHARACTERISTIC VSACD_tiDioInDia4Min_C "Minimum des vierten Signalfensters für Fehlersignale des Drallklappenstellers" VALUE 0xEED0A Kw_Wu16 655350.0 Time_ms 0.00 655350.0 FORMAT "%8.1" /end CHARACTERISTIC
/begin CHARACTERISTIC VSACD_tiPwrStgOn_C "Zeit für welche die Endstufe im Fehlerfall eingeschalten wird (nur nicht SPI kontrolliert)" VALUE 0xEED0C Kw_Wu16 655140.0 Time_ms 0.00 655140.0 FORMAT "%8.1" EXTENDED_LIMITS 0.00 655350.0 /end CHARACTERISTIC
/begin CHARACTERISTIC VSA_rVSA_Vector "#SSD Bypass-Label für VSA_rVSA" VALUE 0xC31AE Kw_Wu8 255.0 OneToOne 0.00 255.0 FORMAT "%5.1" /end CHARACTERISTIC
/begin CHARACTERISTIC VSA_rVSA_Channel "#SSD Bypass-Label für VSA_rVSA" VALUE 0xC31AF Kw_Wu8 255.0 OneToOne 0.00 255.0 FORMAT "%5.1" /end CHARACTERISTIC
/begin CHARACTERISTIC VSSCD_DebCanSigDef_C "#SSD Entprellzeit CAN Signal für Fahrgeschwindigkeit defekt" VALUE 0xEED10 Kw_Wu16 655350.0 Time_ms 0.00 655350.0 FORMAT "%8.1" /end CHARACTERISTIC
/begin CHARACTERISTIC VSSCD_DebCanSigOk_C "Entprellzeit Heilung CAN-Signal für Fahrgeschwindigkeit" VALUE 0xEED12 Kw_Wu16 655350.0 Time_ms 0.00 655350.0 FORMAT "%8.1" /end CHARACTERISTIC
/begin CHARACTERISTIC VSSCD_DebMaxDef_C "Entprellzeit für Defekterkennung bei Maximumtest der Fahrgeschwindigkeit" VALUE 0xEED14 Kw_Wu16 655350.0 Time_ms 0.00 655350.0 FORMAT "%8.1" /end CHARACTERISTIC
/begin CHARACTERISTIC VSSCD_DebMaxOk_C "Entprellzeit für Heilung bei Maximumtest der Fahrgeschwindigkeit" VALUE 0xEED16 Kw_Wu16 655350.0 Time_ms 0.00 655350.0 FORMAT "%8.1" /end CHARACTERISTIC
/begin CHARACTERISTIC VSSCD_DebNegPlaMonCond_C "Vorhaltlabel, nicht applizieren" VALUE 0xEED18 Kw_Wu16 655350.0 Time_ms 0.00 655350.0 FORMAT "%8.1" READ_ONLY /end CHARACTERISTIC
/begin CHARACTERISTIC VSSCD_DebPlaMonCond_C "Entprellzeit Überwachungsbedingungen für Plausibilitätstest der Fahrgeschwindigkeit" VALUE 0xEED1A Kw_Wu16 655350.0 Time_ms 0.00 655350.0 FORMAT "%8.1" /end CHARACTERISTIC
/begin CHARACTERISTIC VSSCD_DebPlaDef_C "Entprellzeit für Defekterkennung bei Plausibilitätstest der Fahrgeschwindigkeit" VALUE 0xEED1C Kw_Wu16 655350.0 Time_ms 0.00 655350.0 FORMAT "%8.1" /end CHARACTERISTIC
/begin CHARACTERISTIC VSSCD_DebPlaOk_C "Entprellzeit für Heilung bei Plausibilitätstest der Fahrgeschwindigkeit" VALUE 0xEED1E Kw_Wu16 655350.0 Time_ms 0.00 655350.0 FORMAT "%8.1" /end CHARACTERISTIC
/begin CHARACTERISTIC VSSCD_DebSigDef_C "Entprellzeit defekt für ungültiges Eingangssignal Fahrgeschwindigkeit" VALUE 0xEED20 Kw_Wu16 655350.0 Time_ms 0.00 655350.0 FORMAT "%8.1" /end CHARACTERISTIC
/begin CHARACTERISTIC VSSCD_DebSigOk_C "Entprellzeit für Heilung ungültiges Eingangssignal der Fahrgeschwindigkeit" VALUE 0xEED22 Kw_Wu16 655350.0 Time_ms 0.00 655350.0 FORMAT "%8.1" /end CHARACTERISTIC
/begin CHARACTERISTIC VSSCD_ImpPerDist_C "Streckenfaktor: FGG-Impulse pro Strecke" VALUE 0xEED40 Kw_Wu32 17.500000000000000 VSS_DistFac 2.5000000000000000 20.000000000000000 FORMAT "%20.17" EXTENDED_LIMITS 0.83819031734908711 3600000000.0000000 /end CHARACTERISTIC
/begin CHARACTERISTIC VSSCD_nThresPla_C "Drehzahschwelle für NPL-Test der Fahrgeschwindigkeit" VALUE 0xEED24 Kw_Ws16 32767.00 EngN 0.00 32767.00 FORMAT "%8.2" EXTENDED_LIMITS -32768.00 32767.00 /end CHARACTERISTIC
/begin CHARACTERISTIC VSSCD_qThresPla_C "Einspritzschwelle für NPL-Test der Fahrgeschwindigkeit" VALUE 0xEED26 Kw_Ws16 327.6700 InjMass 0.00 327.6700 FORMAT "%8.4" EXTENDED_LIMITS -327.6800 327.6700 /end CHARACTERISTIC
/begin CHARACTERISTIC VSSCD_swtSigVal_C "#SSD Signalquelle Fahrgeschwindigkeit, Datensatzwert für SW-Schalter VSSCD_swtSig (0: HW FGG, 1: CAN)" VALUE 0xEED28 Kw_Wu8 1.000 OneToOne 0.00 1.000 FORMAT "%5.3" EXTENDED_LIMITS 0.00 255.0 /end CHARACTERISTIC
/begin CHARACTERISTIC VSSCD_swtSigType_C "#SSD Einlesen SW-Schalter VSSCD_swtSig aus E2PROM (1) oder VSSCD_swtSigVal_C (2) bei Ini." VALUE 0xEED29 Kw_Wu8 1.000 OneToOne 1.000 2.000 FORMAT "%5.3" EXTENDED_LIMITS 0.00 255.0 /end CHARACTERISTIC
/begin CHARACTERISTIC VSSCD_tiAPT1_C "Zeitkonstante Filterung Fahrbeschleunigung" VALUE 0xEED2C Kw_Wu32 4294.9673 TimeDelay_s 0.0000010000000 4294.9673 FORMAT "%9.4" /end CHARACTERISTIC
/begin CHARACTERISTIC VSSCD_tiPerMax_C "Maximale Periodendauer zwischen zwei FGG-Impulsen (VSSCD_vRaw = 0  wenn VSSCD_tiPerArvg > VSSCD_tiPerMax)" VALUE 0xEED30 Kw_Ws32 13421772.8000 Time_PwmHigh 0.00 13421772.8000 FORMAT "%13.4" EXTENDED_LIMITS -214748364.800 214748364.700 /end CHARACTERISTIC
/begin CHARACTERISTIC VSSCD_tiVPT1_C "Zeitkonstante Filterung Fahrgeschwindigkeit" VALUE 0xEED34 Kw_Wu32 4294.9673 TimeDelay_s 0.0000010000000 4294.9673 FORMAT "%9.4" /end CHARACTERISTIC
/begin CHARACTERISTIC VSSCD_vDfl_C "Vorgabewert Fahrgeschwindigkeit" VALUE 0xEED38 Kw_Ws16 327.6700 Vel 0.00 327.6700 FORMAT "%8.4" EXTENDED_LIMITS -327.6800 327.6700 /end CHARACTERISTIC
/begin CHARACTERISTIC VSSCD_vMax_C "v-Schwelle für Max-Test der Fahrgeschwindigkeit" VALUE 0xEED3A Kw_Ws16 327.6700 Vel 0.00 327.6700 FORMAT "%8.4" EXTENDED_LIMITS -327.6800 327.6700 /end CHARACTERISTIC
/begin CHARACTERISTIC VSSCD_vMin_C "Minimum-Schwelle für v=0 Erkennung" VALUE 0xEED3C Kw_Ws16 20.00000 Vel 0.00 20.00000 FORMAT "%8.5" EXTENDED_LIMITS -327.6800 327.6700 /end CHARACTERISTIC
/begin CHARACTERISTIC VSSCD_vThresPla_C "v-Schwelle für NPL-Test der Fahrgeschwindigkeit" VALUE 0xEED3E Kw_Ws16 327.6700 Vel 0.00 327.6700 FORMAT "%8.4" EXTENDED_LIMITS -327.6800 327.6700 /end CHARACTERISTIC
/begin CHARACTERISTIC ZFC_dBPFacNumFBCG3_CA "Bandpassverstärkungen für Schubbetrieb im 3. Gang" VAL_BLK 0xEED7C Kwb_Wr32 30.0000000 OneToOne -15.0000000 15.0000000 FORMAT "%10.7" EXTENDED_LIMITS -1.00000000E+37 1.00000000E+37 NUMBER 3 /end CHARACTERISTIC
/begin CHARACTERISTIC ZFC_dBPFacNumFBCG4_CA "Bandpassverstärkungen für Schubbetrieb im 4. Gang" VAL_BLK 0xEED88 Kwb_Wr32 30.0000000 OneToOne -15.0000000 15.0000000 FORMAT "%10.7" EXTENDED_LIMITS -1.00000000E+37 1.00000000E+37 NUMBER 3 /end CHARACTERISTIC
/begin CHARACTERISTIC ZFC_dBPFacNumFBCG5_CA "Bandpassverstärkungen für Schubbetrieb im 5. Gang" VAL_BLK 0xEED94 Kwb_Wr32 30.0000000 OneToOne -15.0000000 15.0000000 FORMAT "%10.7" EXTENDED_LIMITS -1.00000000E+37 1.00000000E+37 NUMBER 3 /end CHARACTERISTIC
/begin CHARACTERISTIC ZFC_dBPFacNumFBCG6_CA "Bandpassverstärkungen für Schubbetrieb im 6. Gang" VAL_BLK 0xEEDA0 Kwb_Wr32 30.0000000 OneToOne -15.0000000 15.0000000 FORMAT "%10.7" EXTENDED_LIMITS -1.00000000E+37 1.00000000E+37 NUMBER 3 /end CHARACTERISTIC
/begin CHARACTERISTIC ZFC_dSegFBCCaS_CA "Segmentwahl im Schubbetrieb" VAL_BLK 0xEEDAC Kwb_Wu16 255.9961 Per_Ratio 0.00 255.9961 FORMAT "%8.4" NUMBER 3 /end CHARACTERISTIC
/begin CHARACTERISTIC ZFC_nAvrgMax_C "#SSD Maximale Drehzahl für die Nullmengenkalibrierung" VALUE 0xEEDB2 Kw_Ws16 5960.000 EngN 40.00000 6000.000 FORMAT "%8.3" EXTENDED_LIMITS -32768.00 32767.00 /end CHARACTERISTIC
/begin CHARACTERISTIC ZFC_nAvrgMin_C "#SSD Minimale Drehzahl für die Nullmengenkalibrierung" VALUE 0xEEDB4 Kw_Ws16 5960.000 EngN 40.00000 6000.000 FORMAT "%8.3" EXTENDED_LIMITS -32768.00 32767.00 /end CHARACTERISTIC
/begin CHARACTERISTIC ZFC_nChngPRailMax_C "Maximale Drehzahl für die eine Raildruckanforderung der Nullmengenkalibrierung erfolgt" VALUE 0xEEDB6 Kw_Ws16 5960.000 EngN 40.00000 6000.000 FORMAT "%8.3" EXTENDED_LIMITS -32768.00 32767.00 /end CHARACTERISTIC
/begin CHARACTERISTIC ZFC_nFBCThresMax_C "Obere Drehzahlschwelle für Berechnung der FBC-Bandpässe im Schubbetrieb" VALUE 0xEEDB8 Kw_Ws16 5960.000 EngN 40.00000 6000.000 FORMAT "%8.3" EXTENDED_LIMITS -32768.00 32767.00 /end CHARACTERISTIC
/begin CHARACTERISTIC ZFC_nHyst_C "Hysteresewert Drehzahl für die Nullmengenkalibrierung" VALUE 0xEEDBA Kw_Ws16 5960.000 EngN 40.00000 6000.000 FORMAT "%8.3" EXTENDED_LIMITS -32768.00 32767.00 /end CHARACTERISTIC
/begin CHARACTERISTIC ZFC_numRatETClb_C "#SSD Anzahl der Ansteuerdauer-Kalibrierungen hintereinander" VALUE 0xEEDBC Kw_Wu8 255.0 OneToOne 0.00 255.0 FORMAT "%5.1" /end CHARACTERISTIC
/begin CHARACTERISTIC ZFC_numRatNVClb_C "#SSD Anzahl der Ansteuerspannungs-Kalibrierungen hintereinander" VALUE 0xEEDBD Kw_Wu8 255.0 OneToOne 0.00 255.0 FORMAT "%5.1" /end CHARACTERISTIC
/begin CHARACTERISTIC ZFC_phiSet_CUR "Ansteuerbeginn für Einspritzung der Nullmengenkalibrierung" CURVE 0xEEDD8 Kl_Xs16_Ws16 1440.000 AngleCrS -720.0000 720.0000 FORMAT "%8.4" EXTENDED_LIMITS -768.0000 767.9766
 /begin AXIS_DESCR STD_AXIS Eng_nAvrg EngN 16 40.00000 6000.000 FORMAT "%8.3" EXTENDED_LIMITS -32768.00 32767.00 DEPOSIT ABSOLUTE /end AXIS_DESCR
/end CHARACTERISTIC
/begin CHARACTERISTIC ZFC_stClthSel_C "Bitmaske zur Freigabe des Kupplungssignals für die Kalibrierung" VALUE 0xEEDBE Kw_Wu8 255.0 OneToOne 0.00 255.0 FORMAT "%5.1" /end CHARACTERISTIC
/begin CHARACTERISTIC ZFC_stGearRls_CA "Gangabhängige freigabe der ZFC Kalibrierung" VAL_BLK 0xEEDBF Kwb_Wu8 1.000 OneToOne 0.00 1.000 FORMAT "%5.3" EXTENDED_LIMITS 0.00 255.0 NUMBER 7 /end CHARACTERISTIC
/begin CHARACTERISTIC ZFC_swtClbActvVal_C "Applikationswert für SW-Schalter der ZFC Kalibrierung (1: Kalibrierung aktiev, 0: inaktiev)" VALUE 0xEEDC6 Kw_Wu8 1.000 OneToOne 0.00 1.000 FORMAT "%5.3" EXTENDED_LIMITS 0.00 255.0 /end CHARACTERISTIC
/begin CHARACTERISTIC ZFC_swtClbActvType_C "Typ des Softwareschalters für die ZFC Kalibrierung" VALUE 0xEEDC7 Kw_Wu8 2.000 OneToOne 0.00 2.000 FORMAT "%5.3" EXTENDED_LIMITS 0.00 255.0 /end CHARACTERISTIC
/begin CHARACTERISTIC ZFC_tAirThres_C "Minimale Ansauglufttemperatur für die Nullmengenkalibrierung" VALUE 0xEEDC8 Kw_Ws16 250.0000 Temp_Cels -50.14000 199.8600 FORMAT "%8.4" EXTENDED_LIMITS -3549.940 3003.560 /end CHARACTERISTIC
/begin CHARACTERISTIC ZFC_tEngThres_C "Minimale Motortemperatur für die Nullmengenkalibrierung" VALUE 0xEEDCA Kw_Ws16 250.0000 Temp_Cels -50.14000 199.8600 FORMAT "%8.4" EXTENDED_LIMITS -3549.940 3003.560 /end CHARACTERISTIC
/begin CHARACTERISTIC ZFC_tFuelThresMax_C "Maximale Kraftstofftemperatur für die Nullmengenkalibrierung" VALUE 0xEEDCC Kw_Ws16 250.0000 Temp_Cels -50.14000 199.8600 FORMAT "%8.4" EXTENDED_LIMITS -3549.940 3003.560 /end CHARACTERISTIC
/begin CHARACTERISTIC ZFC_tFuelThresMin_C "Minimale Kraftstofftemperatur für die Nullmengenkalibrierung" VALUE 0xEEDCE Kw_Ws16 250.0000 Temp_Cels -50.14000 199.8600 FORMAT "%8.4" EXTENDED_LIMITS -3549.940 3003.560 /end CHARACTERISTIC
/begin CHARACTERISTIC ZFC_tiCldCham_CUR "Zeit bis der Brennraum für die Nullmengenkalibrierung zu stark abgekühlt ist" CURVE 0xEED46 Kl_Xs16_Ws16 655140.0 Time_ms 0.00 655140.0 FORMAT "%8.1" EXTENDED_LIMITS -327680.0 327670.0
 /begin AXIS_DESCR STD_AXIS IATSCD_tAir Temp_Cels 12 -50.14000 199.8600 FORMAT "%8.4" EXTENDED_LIMITS -3549.940 3003.560 DEPOSIT ABSOLUTE /end AXIS_DESCR
/end CHARACTERISTIC
/begin CHARACTERISTIC ZFC_tiDelOvrRun_C "Verzögerung nach dem Einsetzen der Schubphase für die Nullmengenkalibrierung" VALUE 0xEEDD0 Kw_Ws16 655140.0 Time_ms 0.00 655140.0 FORMAT "%8.1" EXTENDED_LIMITS -327680.0 327670.0 /end CHARACTERISTIC
/begin CHARACTERISTIC ZFC_tiDelpRailLim_C "Verzögerung zum Einschwingen des Raildrucks für die Nullmengenkalibrierung" VALUE 0xEEDD2 Kw_Ws16 655140.0 Time_ms 0.00 655140.0 FORMAT "%8.1" EXTENDED_LIMITS -327680.0 327670.0 /end CHARACTERISTIC
/begin CHARACTERISTIC ZFC_tiHotCham_C "Zeit bis der Brennraum warm genug für die Nullmengenkalibrierung ist" VALUE 0xEED78 Kw_Ws16 655140.0 Time_ms 0.00 655140.0 FORMAT "%8.1" EXTENDED_LIMITS -327680.0 327670.0 /end CHARACTERISTIC
/begin CHARACTERISTIC ZFC_uBattMin_C "Minimale Batteriespannung für die Nullmengenkalibrierung" VALUE 0xEEDD4 Kw_Ws16 640606.1 Volt_Batt 0.00 640606.1 FORMAT "%8.1" EXTENDED_LIMITS -640625.6 640606.1 /end CHARACTERISTIC
/begin MEASUREMENT VSACD_rCnv_mp "Tastverhältnis basierend aus dem Ausgang der Drallniveausteuerung" SWORD DtyCyc 1 100 -327.6800 327.6700 FORMAT "%8.4" ECU_ADDRESS 0x8FFBA8 /end MEASUREMENT
/begin MEASUREMENT VSACD_rOut "Tastverhältnis zür Endstufenansteuerung" SWORD DtyCyc 1 100 -327.6800 327.6700 FORMAT "%8.4" ECU_ADDRESS 0x7F90CE /end MEASUREMENT
/begin MEASUREMENT VSACD_stErr_mp "Status des PWM-einganges der Drallklappe" UBYTE OneToOne 1 100 0.00 255.0 FORMAT "%5.1" ECU_ADDRESS 0x8FFBAA /end MEASUREMENT
/begin MEASUREMENT VSA_rVSA "Stellgröße für Einlaßkanalabschaltung (Stellerkoordinatorausgang)" SWORD DtyCyc 1 100 -327.6800 327.6700 FORMAT "%8.4" ECU_ADDRESS 0x7F90D0 /end MEASUREMENT
/begin MEASUREMENT VSA_rVSAByp_mp "Bypass-Label, copie of VSA_rVSA" SWORD Prc 1 100 -400.0000 399.9878 FORMAT "%8.4" ECU_ADDRESS 0x8FFBA6 /end MEASUREMENT
/begin MEASUREMENT VSSCD_a "Fahrbeschleunigung" SWORD Acc 1 100 -32.76800 32.76700 FORMAT "%8.5" ECU_ADDRESS 0x7F90D2 /end MEASUREMENT
/begin MEASUREMENT VSSCD_aRaw "Rohwert Fahrbeschleunigung" SWORD Acc 1 100 -32.76800 32.76700 FORMAT "%8.5" ECU_ADDRESS 0x7F90D4 /end MEASUREMENT
/begin MEASUREMENT VSSCD_ctImp "Impulszähler Fahrgeschwindigkeit Impulssignal" UWORD OneToOne 1 100 0.00 65535.00 FORMAT "%8.2" ECU_ADDRESS 0x7F90D6 /end MEASUREMENT
/begin MEASUREMENT VSSCD_rImp_mp "Tastverhältnis Eingangssignal Fahrgeschwindigkeit (FGG)" SWORD DtyCyc 1 100 -327.6800 327.6700 FORMAT "%8.4" ECU_ADDRESS 0x8FFBAC /end MEASUREMENT
/begin MEASUREMENT VSSCD_stInHW_mp "Statusflags Eingangssignal Fahrgeschwindigkeit (FGG)" UBYTE OneToOne 1 100 0.00 255.0 FORMAT "%5.1" ECU_ADDRESS 0x8FFBAE /end MEASUREMENT
/begin MEASUREMENT VSSCD_swtSig "Signaleingangsschalter Fahrgeschwindigkeit" UBYTE OneToOne 1 100 0.00 255.0 FORMAT "%5.1" ECU_ADDRESS 0x7F89C7 /end MEASUREMENT
/begin MEASUREMENT VSSCD_tiPerAvrg "Mittlere Periodendauer zwischen zwei FGG-Impulsen" SLONG Time_PwmHigh 1 100 -214748364.800 214748364.700 FORMAT "%13.3" ECU_ADDRESS 0x7F9248 /end MEASUREMENT
/begin MEASUREMENT VSSCD_v "Fahrzeuggeschwindigkeit" SWORD Vel 1 100 -327.6800 327.6700 FORMAT "%8.4" ECU_ADDRESS 0x7F90D8 /end MEASUREMENT
/begin MEASUREMENT VSSCD_vRaw "Rohwert Fahrgeschwindigkeit" SWORD Vel 1 100 -327.6800 327.6700 FORMAT "%8.4" ECU_ADDRESS 0x7F90DA /end MEASUREMENT
/begin MEASUREMENT VSSCD_vSensVal "Vehicle speed sensed value" SWORD Vel 1 100 -327.6800 327.6700 FORMAT "%8.4" ECU_ADDRESS 0x7F90DC /end MEASUREMENT
/begin MEASUREMENT WDCom_dChisteResponse_u32 "Antwortbeitrag des Befehlstests" UWORD OneToOne 1 100 0.00 65535.00 FORMAT "%8.2" ECU_ADDRESS 0x7FDBC0 /end MEASUREMENT
/begin MEASUREMENT WDCom_dErrorCountForCntler_u8 "Kopie des überwachungsmodul-internen Fehlerzählers für den Funktionsrechner" UBYTE OneToOne 1 100 0.00 255.0 FORMAT "%5.1" ECU_ADDRESS 0x7FDC06 /end MEASUREMENT
/begin MEASUREMENT WDCom_dErrorCountForSpi_u8 "Fehlerzähler für die Kommunikation zwischen Funktionsrechner und Überwachungsmodul" UBYTE OneToOne 1 100 0.00 255.0 FORMAT "%5.1" ECU_ADDRESS 0x7FDC05 /end MEASUREMENT
/begin MEASUREMENT WDCom_dErrorCountForWD_u8 "Fehlerzähler für das Überwachungsmodul" UBYTE OneToOne 1 100 0.00 255.0 FORMAT "%5.1" ECU_ADDRESS 0x7F9B37 /end MEASUREMENT
/begin MEASUREMENT WDCom_dRequest_u32 "Aktuelle Frage des Überwachungsmoduls" UWORD OneToOne 1 100 0.00 65535.00 FORMAT "%8.2" ECU_ADDRESS 0x7FDBCC /end MEASUREMENT
/begin MEASUREMENT ZFC_dpRailLim_mp "Aktuelle max Raildruckabweichung für die Nullmengenkalibrierung" SWORD Pres_Rail 1 100 -3276.800 3276.700 FORMAT "%5.3" ECU_ADDRESS 0x8FFBB0 /end MEASUREMENT
/begin MEASUREMENT ZFC_dpRail_mp "Raildruckabweichung zum Raildruck Kalibrierungspunkt" SWORD Pres_Rail 1 100 -3276.800 3276.700 FORMAT "%5.3" ECU_ADDRESS 0x6F82C8 /end MEASUREMENT
/begin MEASUREMENT ZFC_numCylInj_mp "Aktuelle Zylindernummer für die Einspritzung der Nullmengenkalibrierung" UBYTE OneToOne 1 100 0.00 255.0 FORMAT "%5.1" ECU_ADDRESS 0x6F82E5 /end MEASUREMENT
/begin MEASUREMENT ZFC_phiInj_mp "Ansteuerbeginng der Einspritzung für die Nullmengenkalibrierung" SWORD AngleCrS 1 100 -768.0000 767.9766 FORMAT "%8.4" ECU_ADDRESS 0x8FFBBA /end MEASUREMENT
/begin MEASUREMENT ZFC_pRailSetPoint_mp "Angeforderter Raildrucksollwert der Nullmengenkalibrierung" SWORD Pres_Rail 1 100 -3276.800 3276.700 FORMAT "%5.3" ECU_ADDRESS 0x8FFBB2 /end MEASUREMENT
/begin MEASUREMENT ZFC_SigThres_mp "Aktuelle Signalschwelle für die Nullmengenkalibrierung" SWORD OneToOne 1 100 -32768.00 32767.00 FORMAT "%8.2" ECU_ADDRESS 0x8FFBB8 /end MEASUREMENT
/begin MEASUREMENT ZFC_Sig_mp "Messwert der Kalibrierung" SLONG OneToOne 1 100 -2147483648.00 2147483647.00 FORMAT "%13.2" ARRAY_SIZE 6 ECU_ADDRESS 0x6F82CC /end MEASUREMENT
/begin MEASUREMENT ZFC_stCldCham "Zustand des Brennraums für die Nullmengenkalibrierung" UBYTE OneToOne 1 100 0.00 255.0 FORMAT "%5.1" ECU_ADDRESS 0x7F89C8 /end MEASUREMENT
/begin MEASUREMENT ZFC_stCmbCham_mp "Zustand der Erkennung kalter Brennraum für die Nullmengenkalibrierung" UBYTE OneToOne 1 100 0.00 255.0 FORMAT "%5.1" ECU_ADDRESS 0x8FFBAF /end MEASUREMENT
/begin MEASUREMENT ZFC_stDem_mp "Anforderungen der Nullmengenkalibrierung" UBYTE OneToOne 1 100 0.00 255.0 FORMAT "%5.1" ECU_ADDRESS 0x8FFBB4 /end MEASUREMENT
/begin MEASUREMENT ZFC_stEvalSig_mp "Status der Auswertung des Signals der Nullmengenkalibrierung" UBYTE ZFC_EvalEngSpd_Rslt 1 100 0.00 2.00000000000 FORMAT "%13.11" ECU_ADDRESS 0x6F82E4 /end MEASUREMENT
/begin MEASUREMENT ZFC_stInj_mp "Status der Einspritzprogrammierung der Nullmengenkalibrierung" UBYTE ZFC_Inj_State 1 100 0.00 64.0000000000 FORMAT "%13.10" ECU_ADDRESS 0x6F82E6 /end MEASUREMENT
/begin MEASUREMENT ZFC_st_mp "Status der Nullmengenkalibrierung" UBYTE ZFC_State 1 100 1.00000000000 16.0000000000 FORMAT "%13.10" ECU_ADDRESS 0x6F82CA /end MEASUREMENT
/begin MEASUREMENT ZFC_swtClbActv "SW-Schalter für die Aktivierung der ZFC Kalibrierung" UBYTE OneToOne 1 100 0.00 255.0 FORMAT "%5.1" ECU_ADDRESS 0x7F89C9 /end MEASUREMENT
/begin MEASUREMENT ZFC_tiET_mp "Ansteuerdauer für die Einspritzung der Nullmengenkalibrierung" SWORD InjTime_us 1 100 -32768.00 32767.00 FORMAT "%8.2" ECU_ADDRESS 0x6F82E8 /end MEASUREMENT
/begin MEASUREMENT ZFC_vStopClb_mp "Minimale Fahrzeuggeschwindigkeit der aktuellen Ansteuerdauerkalibrierung" SWORD Vel 1 100 -327.6800 327.6700 FORMAT "%8.4" ECU_ADDRESS 0x8FFBB6 /end MEASUREMENT
/begin MEASUREMENT I_craweng "Strombedarf Motor" SWORD Def_i_sw_q1 0 0 -10.0000 254.0000 ECU_ADDRESS 0x007FF738 /begin FUNCTION_LIST BGCRENG /end FUNCTION_LIST /end MEASUREMENT
/begin MEASUREMENT Fak_ttansel "Ansaugluftfaktor E-Lüfterstrom" UWORD Def_f_uw_b512 0 0 0.0 511.9921 ECU_ADDRESS 0x007FF73A /begin FUNCTION_LIST BGCRENG /end FUNCTION_LIST /end MEASUREMENT
/begin MEASUREMENT Fak_tubel "Faktor Lüfterstrom aus Geschwindigkeit" UWORD Def_f_uw_b512 0 0 0.0 511.9921 ECU_ADDRESS 0x007FF73C /begin FUNCTION_LIST BGCRENG /end FUNCTION_LIST /end MEASUREMENT
/begin MEASUREMENT I_elu_vvt "Strom E-Lüfter und VVT-System" UWORD Def_i_uw_q0p0635 0 0 0.0 4095.9375 ECU_ADDRESS 0x007FF73E /begin FUNCTION_LIST BGCRENG /end FUNCTION_LIST /end MEASUREMENT
/begin MEASUREMENT I_eluefter "E-Lüfter Stromaufnahme" UWORD Def_i_uw_q0p0635 0 0 0.0 4095.9375 ECU_ADDRESS 0x007FF740 /begin FUNCTION_LIST BGCRENG /end FUNCTION_LIST /end MEASUREMENT
/begin MEASUREMENT I_elupwm "Lüfterstrom ohne Temperatur- und Geschwindigkeitseinfluss" UWORD Def_i_uw_q0p0635 0 0 0.0 64.0000 ECU_ADDRESS 0x007FF742 /begin FUNCTION_LIST BGCRENG /end FUNCTION_LIST /end MEASUREMENT
/begin MEASUREMENT I_eluvfzg "Lüfterstrom ohne Geschwindigkeitseinfluss" UWORD Def_i_uw_q0p0635 0 0 0.0 128.0000 ECU_ADDRESS 0x007FF744 /begin FUNCTION_LIST BGCRENG /end FUNCTION_LIST /end MEASUREMENT
/begin MEASUREMENT I_gle "Glühstrom" UWORD Def_i_uw_q0p0635 0 0 0.0 4095.9375 ECU_ADDRESS 0x007FF746 /begin FUNCTION_LIST BGCRENG /end FUNCTION_LIST /end MEASUREMENT
/begin MEASUREMENT I_sls "berechnete Groesse Strombedarf Sekundärluftpumpe" UWORD Def_i_uw_q0p0635 0 0 0.0 255.0000 ECU_ADDRESS 0x007FF748 /begin FUNCTION_LIST BGCRENG /end FUNCTION_LIST /end MEASUREMENT
/begin MEASUREMENT Vvt_ib1_2 "Gesamtstrom VVT Bank1 bzw 4Zyl. und Bank2" UWORD Def_i_uw_q0p0635 0 0 0.0 4095.9375 ECU_ADDRESS 0x007FF74A /begin FUNCTION_LIST BGCRENG /end FUNCTION_LIST /end MEASUREMENT
/begin MEASUREMENT Vvt_iges "Strombedarf des gesamten VVT-Systems" UWORD Def_i_uw_q0p0635 0 0 0.0 192.0000 ECU_ADDRESS 0x007FF74C /begin FUNCTION_LIST BGCRENG /end FUNCTION_LIST /end MEASUREMENT
/begin MEASUREMENT St_bgllgen0.B_hysllrah "" UBYTE Def_bit_ub_0 0 0 0.0 255.0 ECU_ADDRESS 0x007FF750 /begin FUNCTION_LIST BGLLGEN_1PR /end FUNCTION_LIST BIT_MASK 0x1 /end MEASUREMENT
/begin MEASUREMENT St_bgllgen0 "Statuswort" UBYTE Def_st_ub_q1 0 0 0.0 255.0000 ECU_ADDRESS 0x007FF750 /begin FUNCTION_LIST BGLLGEN_1PR /end FUNCTION_LIST /end MEASUREMENT
/begin MEASUREMENT N_idlgspec "Anforderung LL-Anhebung" UBYTE Def_st_ub_q1 0 0 0.0 255.0000 ECU_ADDRESS 0x007FF751 /begin FUNCTION_LIST BGLLGEN_1PR /end FUNCTION_LIST /end MEASUREMENT
/begin MEASUREMENT N_gsllm "" SWORD Def_n_sw_q1p0 0 0 0.0 32767.0000 ECU_ADDRESS 0x007FF74E /begin FUNCTION_LIST BGLLGEN_1PR /end FUNCTION_LIST /end MEASUREMENT
/begin MEASUREMENT Gen_dfvorhs "DF-Signal Vorhersage" UBYTE Def_f_ub_b100 0 0 0.0 99.6093 ECU_ADDRESS 0x007FF752 /begin FUNCTION_LIST BGLLGEN_1PR /end FUNCTION_LIST /end MEASUREMENT
/begin MEASUREMENT St_dgen0.B_1stbsder "" UBYTE Def_bit_ub_0 0 0 0.0 255.0 ECU_ADDRESS 0x007FFF25 /begin FUNCTION_LIST DGEN /end FUNCTION_LIST BIT_MASK 0x1 /end MEASUREMENT
/begin MEASUREMENT St_dgen0.B_kl61 "Bedingung Ladekontroll Laempchen an" UBYTE Def_bit_ub_1 0 0 0.0 255.0 ECU_ADDRESS 0x007FFF25 /begin FUNCTION_LIST DGEN /end FUNCTION_LIST BIT_MASK 0x2 /end MEASUREMENT
/begin MEASUREMENT St_dgen0.B_genfprl "Bedingung Generatorfehler entprellt" UBYTE Def_bit_ub_2 0 0 0.0 255.0 ECU_ADDRESS 0x007FFF25 /begin FUNCTION_LIST DGEN /end FUNCTION_LIST BIT_MASK 0x4 /end MEASUREMENT
/begin MEASUREMENT St_dgen0.B_gfbsupak "Generator Typ unplausibel^aus Fehlerspeicher" UBYTE Def_bit_ub_3 0 0 0.0 255.0 ECU_ADDRESS 0x007FFF25 /begin FUNCTION_LIST DGEN /end FUNCTION_LIST BIT_MASK 0x8 /end MEASUREMENT
/begin MEASUREMENT St_dgen0.B_gfelak "Generatorfehler elektrisch aus Fehlerspeicher" UBYTE Def_bit_ub_4 0 0 0.0 255.0 ECU_ADDRESS 0x007FFF25 /begin FUNCTION_LIST DGEN /end FUNCTION_LIST BIT_MASK 0x10 /end MEASUREMENT
/begin MEASUREMENT St_dgen0.B_gfhtak "Generatorfehler Uebertemperatur aus Fehlerspeicher" UBYTE Def_bit_ub_5 0 0 0.0 255.0 ECU_ADDRESS 0x007FFF25 /begin FUNCTION_LIST DGEN /end FUNCTION_LIST BIT_MASK 0x20 /end MEASUREMENT
/begin MEASUREMENT St_dgen0.B_gfmeak "Generatorfehler mechanisch aus Fehlerspeicher" UBYTE Def_bit_ub_6 0 0 0.0 255.0 ECU_ADDRESS 0x007FFF25 /begin FUNCTION_LIST DGEN /end FUNCTION_LIST BIT_MASK 0x40 /end MEASUREMENT
/begin MEASUREMENT St_dgen0.B_gfnobsak "Generator BSD Kommunikationsverlust aus Fehlerspeicher" UBYTE Def_bit_ub_7 0 0 0.0 255.0 ECU_ADDRESS 0x007FFF25 /begin FUNCTION_LIST DGEN /end FUNCTION_LIST BIT_MASK 0x80 /end MEASUREMENT
/begin MEASUREMENT St_dgen0 "Statuswort" UBYTE Def_st_ub_q1 0 0 0.0 255.0000 ECU_ADDRESS 0x007FFF25 /begin FUNCTION_LIST DGEN /end FUNCTION_LIST /end MEASUREMENT
/begin MEASUREMENT St_gen "Generatorstatus" UBYTE Def_st_ub_q1 0 0 0.0 255.0000 ECU_ADDRESS 0x008003B0 /begin FUNCTION_LIST DGEN /end FUNCTION_LIST /end MEASUREMENT
/begin MEASUREMENT St_genbsd "" UWORD Def_st_uw_q1 0 0 0.0 65535.0000 ECU_ADDRESS 0x008003AC /begin FUNCTION_LIST DGEN /end FUNCTION_LIST /end MEASUREMENT
/begin MEASUREMENT St_gengen "" UWORD Def_st_uw_q1 0 0 0.0 65535.0000 ECU_ADDRESS 0x008003AE /begin FUNCTION_LIST DGEN /end FUNCTION_LIST /end MEASUREMENT
/begin MEASUREMENT Gen_fbsak "BSD Uebertragungsfehler kodiert fuer FSPVDGEN" UBYTE Def_st_ub_q1 0 0 0.0 255.0000 ECU_ADDRESS 0x008003B1 /begin FUNCTION_LIST DGEN /end FUNCTION_LIST /end MEASUREMENT
/begin MEASUREMENT Gen_statroh "Generatorfehler kodiert fuer FSPVDGEN" UBYTE Def_st_ub_q1 0 0 0.0 255.0000 ECU_ADDRESS 0x008003B2 /begin FUNCTION_LIST DGEN /end FUNCTION_LIST /end MEASUREMENT
/begin MEASUREMENT St_dibs1.B_ifbsak "IBS Stromfehler" UBYTE Def_bit_ub_2 0 0 0.0 255.0 ECU_ADDRESS 0x007FFF26 /begin FUNCTION_LIST DIBS /end FUNCTION_LIST BIT_MASK 0x4 /end MEASUREMENT
/begin MEASUREMENT St_dibs1.B_ifebsak "" UBYTE Def_bit_ub_3 0 0 0.0 255.0 ECU_ADDRESS 0x007FFF26 /begin FUNCTION_LIST DIBS /end FUNCTION_LIST BIT_MASK 0x8 /end MEASUREMENT
/begin MEASUREMENT St_dibs1.B_ifuplak "IBS Temperaturfehler" UBYTE Def_bit_ub_4 0 0 0.0 255.0 ECU_ADDRESS 0x007FFF26 /begin FUNCTION_LIST DIBS /end FUNCTION_LIST BIT_MASK 0x10 /end MEASUREMENT
/begin MEASUREMENT St_dibs1 "Statuswort" UBYTE Def_st_ub_q1 0 0 0.0 255.0000 ECU_ADDRESS 0x007FFF26 /begin FUNCTION_LIST DIBS /end FUNCTION_LIST /end MEASUREMENT
/begin MEASUREMENT St_dibs2.B_ifisak "Fehler IBS Version unplausibel" UBYTE Def_bit_ub_0 0 0 0.0 255.0 ECU_ADDRESS 0x007FFF27 /begin FUNCTION_LIST DIBS /end FUNCTION_LIST BIT_MASK 0x1 /end MEASUREMENT
/begin MEASUREMENT St_dibs2.B_ifusak "IBS Spannungsfehler" UBYTE Def_bit_ub_1 0 0 0.0 255.0 ECU_ADDRESS 0x007FFF27 /begin FUNCTION_LIST DIBS /end FUNCTION_LIST BIT_MASK 0x2 /end MEASUREMENT
/begin MEASUREMENT St_dibs2.B_iftempak "IBS KL15 Masseschluss" UBYTE Def_bit_ub_2 0 0 0.0 255.0 ECU_ADDRESS 0x007FFF27 /begin FUNCTION_LIST DIBS /end FUNCTION_LIST BIT_MASK 0x4 /end MEASUREMENT
/begin MEASUREMENT St_dibs2.B_ifwugdak "" UBYTE Def_bit_ub_3 0 0 0.0 255.0 ECU_ADDRESS 0x007FFF27 /begin FUNCTION_LIST DIBS /end FUNCTION_LIST BIT_MASK 0x8 /end MEASUREMENT
/begin MEASUREMENT St_dibs2.B_ifwuplak "Signal nv lave loc zur Flankenerkennung" UBYTE Def_bit_ub_4 0 0 0.0 255.0 ECU_ADDRESS 0x007FFF27 /begin FUNCTION_LIST DIBS /end FUNCTION_LIST BIT_MASK 0x10 /end MEASUREMENT
/begin MEASUREMENT St_dibs2.B_ifsysak "Signal nv lave loc zur Flankenerkennung" UBYTE Def_bit_ub_5 0 0 0.0 255.0 ECU_ADDRESS 0x007FFF27 /begin FUNCTION_LIST DIBS /end FUNCTION_LIST BIT_MASK 0x20 /end MEASUREMENT
/begin MEASUREMENT St_dibs2 "Statuswort" UBYTE Def_st_ub_q1 0 0 0.0 255.0000 ECU_ADDRESS 0x007FFF27 /begin FUNCTION_LIST DIBS /end FUNCTION_LIST /end MEASUREMENT
/begin MEASUREMENT St_dibs0.B_dibloc1 "BSD Kommunikation zum IBS gestoert" UBYTE Def_bit_ub_0 0 0 0.0 255.0 ECU_ADDRESS 0x008003BE /begin FUNCTION_LIST DIBS /end FUNCTION_LIST BIT_MASK 0x1 /end MEASUREMENT
/begin MEASUREMENT St_dibs0.B_dibloc2 "Fehler erweiterte BSD Kommunikation zum IBS" UBYTE Def_bit_ub_1 0 0 0.0 255.0 ECU_ADDRESS 0x008003BE /begin FUNCTION_LIST DIBS /end FUNCTION_LIST BIT_MASK 0x2 /end MEASUREMENT
/begin MEASUREMENT St_dibs0 "Statuswort" UBYTE Def_st_ub_q1 0 0 0.0 255.0000 ECU_ADDRESS 0x008003BE /begin FUNCTION_LIST DIBS /end FUNCTION_LIST /end MEASUREMENT
/begin MEASUREMENT Ibs1_errstat "" UWORD Def_st_uw_q1 0 0 0.0 65535.0000 ECU_ADDRESS 0x008003B4 /begin FUNCTION_LIST DIBS /end FUNCTION_LIST /end MEASUREMENT
/begin MEASUREMENT Ibs2_errstat "" UWORD Def_st_uw_q1 0 0 0.0 65535.0000 ECU_ADDRESS 0x008003B6 /begin FUNCTION_LIST DIBS /end FUNCTION_LIST /end MEASUREMENT
/begin MEASUREMENT Ibs3_errstat "" UWORD Def_st_uw_q1 0 0 0.0 65535.0000 ECU_ADDRESS 0x008003B8 /begin FUNCTION_LIST DIBS /end FUNCTION_LIST /end MEASUREMENT
/begin MEASUREMENT T_count_dibs1 "" UBYTE Def_i_ub_q1 0 0 0.0 255.0000 ECU_ADDRESS 0x008003BA /begin FUNCTION_LIST DIBS /end FUNCTION_LIST /end MEASUREMENT
/begin MEASUREMENT T_count_dibs2 "" UBYTE Def_i_ub_q1 0 0 0.0 255.0000 ECU_ADDRESS 0x008003BB /begin FUNCTION_LIST DIBS /end FUNCTION_LIST /end MEASUREMENT
/begin MEASUREMENT T_count_dibs3 "" UBYTE ident 0 0 0.0 255.0000 ECU_ADDRESS 0x008003BC /begin FUNCTION_LIST DIBS /end FUNCTION_LIST /end MEASUREMENT
/begin MEASUREMENT T_count_dibs4 "" UBYTE ident 0 0 0.0 255.0000 ECU_ADDRESS 0x008003BD /begin FUNCTION_LIST DIBS /end FUNCTION_LIST /end MEASUREMENT
/begin MEASUREMENT Ibsderrs2 "Fehlerzähler IBS EBSD Kommunikation" UWORD Def_dez_uw_q1 0 0 0.0 65535.0000 ECU_ADDRESS 0x008003C0 /begin FUNCTION_LIST DIBS /end FUNCTION_LIST /end MEASUREMENT
/begin MEASUREMENT Ibsderrs1 "Fehlerzähler IBS BSD Kommunikation" UBYTE Def_dez_ub_q1 0 0 0.0 255.0000 ECU_ADDRESS 0x008003C2 /begin FUNCTION_LIST DIBS /end FUNCTION_LIST /end MEASUREMENT
/begin MEASUREMENT Ibspreco2 "Vorteiler /10 fuer Ibsderrs2" UBYTE Def_dez_ub_q1 0 0 0.0 255.0000 ECU_ADDRESS 0x008003C3 /begin FUNCTION_LIST DIBS /end FUNCTION_LIST /end MEASUREMENT
/begin MEASUREMENT St_dqlt0.B_ozlerr "Messfehler Ölniveau" UBYTE Def_bit_ub_0 0 0 0.0 255.0 ECU_ADDRESS 0x007FA872 /begin FUNCTION_LIST DQLT /end FUNCTION_LIST BIT_MASK 0x1 /end MEASUREMENT
/begin MEASUREMENT St_dqlt0.B_ozqerr "Messfehler Ölzustand" UBYTE Def_bit_ub_1 0 0 0.0 255.0 ECU_ADDRESS 0x007FA872 /begin FUNCTION_LIST DQLT /end FUNCTION_LIST BIT_MASK 0x2 /end MEASUREMENT
/begin MEASUREMENT St_dqlt0.B_ozterr "Messfehler Öltemperatur" UBYTE Def_bit_ub_2 0 0 0.0 255.0 ECU_ADDRESS 0x007FA872 /begin FUNCTION_LIST DQLT /end FUNCTION_LIST BIT_MASK 0x4 /end MEASUREMENT
/begin MEASUREMENT St_dqlt0.B_td_ogerr "" UBYTE Def_bit_ub_3 0 0 0.0 255.0 ECU_ADDRESS 0x007FA872 /begin FUNCTION_LIST DQLT /end FUNCTION_LIST BIT_MASK 0x8 /end MEASUREMENT
/begin MEASUREMENT St_dqlt0.B_td_ogupl "" UBYTE Def_bit_ub_4 0 0 0.0 255.0 ECU_ADDRESS 0x007FA872 /begin FUNCTION_LIST DQLT /end FUNCTION_LIST BIT_MASK 0x10 /end MEASUREMENT
/begin MEASUREMENT St_dqlt0.B_ozkttoens "Töns-Sensor verbaut" UBYTE Def_bit_ub_5 0 0 0.0 255.0 ECU_ADDRESS 0x007FA872 /begin FUNCTION_LIST DQLT /end FUNCTION_LIST BIT_MASK 0x20 /end MEASUREMENT
/begin MEASUREMENT St_dqlt0.B_ozerrbsd "BSD global Fehler" UBYTE Def_bit_ub_6 0 0 0.0 255.0 ECU_ADDRESS 0x007FA872 /begin FUNCTION_LIST DQLT /end FUNCTION_LIST BIT_MASK 0x40 /end MEASUREMENT
/begin MEASUREMENT St_dqlt0.B_ozdiagnmotok "Motordrehzahl ok für die Diagnose" UBYTE Def_bit_ub_7 0 0 0.0 255.0 ECU_ADDRESS 0x007FA872 /begin FUNCTION_LIST DQLT /end FUNCTION_LIST BIT_MASK 0x80 /end MEASUREMENT
/begin MEASUREMENT St_dqlt0 "Statuswort" UBYTE Def_st_ub_q1 0 0 0.0 255.0000 ECU_ADDRESS 0x007FA872 /begin FUNCTION_LIST DQLT /end FUNCTION_LIST /end MEASUREMENT
/begin MEASUREMENT St_dqlt1.B_ozerr "Sensorfehler in FS eingetragen" UBYTE Def_bit_ub_0 0 0 0.0 255.0 ECU_ADDRESS 0x007FA873 /begin FUNCTION_LIST DQLT /end FUNCTION_LIST BIT_MASK 0x1 /end MEASUREMENT
/begin MEASUREMENT St_dqlt1 "Statuswort" UBYTE Def_st_ub_q1 0 0 0.0 255.0000 ECU_ADDRESS 0x007FA873 /begin FUNCTION_LIST DQLT /end FUNCTION_LIST /end MEASUREMENT
/begin MEASUREMENT St_oz_o.B_oztemic "QLT-Temic verbaut" UBYTE Def_bit_ub_0 0 0 0.0 255.0 ECU_ADDRESS 0x007FA874 /begin FUNCTION_LIST DQLT /end FUNCTION_LIST BIT_MASK 0x1 /end MEASUREMENT
/begin MEASUREMENT St_oz_o.B_mol_sf "Sensorfehler in FS eingetragen für CC-Meldung" UBYTE Def_bit_ub_1 0 0 0.0 255.0 ECU_ADDRESS 0x007FA874 /begin FUNCTION_LIST DQLT /end FUNCTION_LIST BIT_MASK 0x2 /end MEASUREMENT
/begin MEASUREMENT St_oz_o "Statuswort" UBYTE Def_st_ub_q1 0 0 0.0 255.0000 ECU_ADDRESS 0x007FA874 /begin FUNCTION_LIST DQLT /end FUNCTION_LIST /end MEASUREMENT
/begin MEASUREMENT Oz_permerrz "" UBYTE Def_dez_ub_q1 0 0 0.0 255.0000 ECU_ADDRESS 0x008003D0 /begin FUNCTION_LIST DQLT /end FUNCTION_LIST /end MEASUREMENT
/begin MEASUREMENT Oz_diagtoens "Töns Diagnose Byte" UWORD Def_dez_uw_q1 0 0 0.0 65535.0000 ECU_ADDRESS 0x008003C4 /begin FUNCTION_LIST DQLT /end FUNCTION_LIST /end MEASUREMENT
/begin MEASUREMENT St_imdgen0.B_firstemp "Bedingung Generatorstarttemperatur-Berechnung" UBYTE Def_bit_ub_0 0 0 0.0 255.0 ECU_ADDRESS 0x007FB770 /begin FUNCTION_LIST IMDGEN_1PR /end FUNCTION_LIST BIT_MASK 0x1 /end MEASUREMENT
/begin MEASUREMENT St_imdgen0.B_gene "Generatormoment enable/disable" UBYTE Def_bit_ub_1 0 0 0.0 255.0 ECU_ADDRESS 0x007FB770 /begin FUNCTION_LIST IMDGEN_1PR /end FUNCTION_LIST BIT_MASK 0x2 /end MEASUREMENT
/begin MEASUREMENT St_imdgen0.B_generken "" UBYTE Def_bit_ub_2 0 0 0.0 255.0 ECU_ADDRESS 0x007FB770 /begin FUNCTION_LIST IMDGEN_1PR /end FUNCTION_LIST BIT_MASK 0x4 /end MEASUREMENT
/begin MEASUREMENT St_imdgen0 "Statuswort" UBYTE Def_st_ub_q1 0 0 0.0 255.0000 ECU_ADDRESS 0x007FB770 /begin FUNCTION_LIST IMDGEN_1PR /end FUNCTION_LIST /end MEASUREMENT
/begin MEASUREMENT St_imdgen_nv0.B_genfkupl "Generatortyp unplausibel" UBYTE Def_bit_ub_0 0 0 0.0 255.0 ECU_ADDRESS 0x007FB762 /begin FUNCTION_LIST IMDGEN_1PR /end FUNCTION_LIST BIT_MASK 0x1 /end MEASUREMENT
/begin MEASUREMENT St_imdgen_nv0.B_heizen "Bedingung Generator in Heizphase" UBYTE Def_bit_ub_1 0 0 0.0 255.0 ECU_ADDRESS 0x007FB762 /begin FUNCTION_LIST IMDGEN_1PR /end FUNCTION_LIST BIT_MASK 0x2 /end MEASUREMENT
/begin MEASUREMENT St_imdgen_nv0 "Statuswort" UBYTE Def_st_ub_q1 0 0 0.0 255.0000 ECU_ADDRESS 0x007FB762 /begin FUNCTION_LIST IMDGEN_1PR /end FUNCTION_LIST /end MEASUREMENT
/begin MEASUREMENT Md_gennm "gefiltertes Generatormoment absolut Ausgang" SWORD Def_m_sw_q0p1 0 0 -3276.8000 3276.7000 ECU_ADDRESS 0x007FB730 /begin FUNCTION_LIST IMDGEN_1PR /end FUNCTION_LIST /end MEASUREMENT
/begin MEASUREMENT Tgen "Generatortemperatur" SWORD Def_t_sw_q0p1 0 0 -3276.8000 3276.7000 ECU_ADDRESS 0x007FB732 /begin FUNCTION_LIST IMDGEN_1PR /end FUNCTION_LIST /end MEASUREMENT
/begin MEASUREMENT Tgen_end "Generatortemperatur endgültig" SWORD Def_t_sw_q0p1 0 0 -3276.8000 3276.7000 ECU_ADDRESS 0x007FB734 /begin FUNCTION_LIST IMDGEN_1PR /end FUNCTION_LIST /end MEASUREMENT
/begin MEASUREMENT Md_genvf "relatives Generatordrehmoment" UWORD Def_f_uw_b100 0 0 0.0 99.9984 ECU_ADDRESS 0x007FB736 /begin FUNCTION_LIST IMDGEN_1PR /end FUNCTION_LIST /end MEASUREMENT
/begin MEASUREMENT I_gen "Generatorstrom" UBYTE Def_i_ub_q1 0 0 0.0 255.0000 ECU_ADDRESS 0x007FB763 /begin FUNCTION_LIST IMDGEN_1PR /end FUNCTION_LIST /end MEASUREMENT
/begin MEASUREMENT I_genmax "korrigiertes DF Signal ueber Temperatur, Generatordrehzahl, Generatorspannung" UBYTE Def_i_ub_q1 0 0 0.0 255.0000 ECU_ADDRESS 0x007FB764 /begin FUNCTION_LIST IMDGEN_1PR /end FUNCTION_LIST /end MEASUREMENT
/begin MEASUREMENT Ierrgrenz "Grenzertrregerstrom" UBYTE Def_i_ub_q0p125 0 0 0.0 31.8750 ECU_ADDRESS 0x007FB765 /begin FUNCTION_LIST IMDGEN_1PR /end FUNCTION_LIST /end MEASUREMENT
/begin MEASUREMENT Tgen_ab "Abstelltemperatur Generator" SWORD Def_t_sw_q0p1 0 0 -3276.8000 3276.7000 ECU_ADDRESS 0x008003D2 /begin FUNCTION_LIST IMDGEN_1PR /end FUNCTION_LIST /end MEASUREMENT
/begin MEASUREMENT Gen_awnumm "Generatorkennfeldnummer" UBYTE Def_st_ub_q1 0 0 0.0 255.0000 ECU_ADDRESS 0x008003D4 /begin FUNCTION_LIST IMDGEN_1PR /end FUNCTION_LIST /end MEASUREMENT
/begin MEASUREMENT Gen_feta "Generatorwirkungsgrad Berechnnugsterm" ULONG Def_eta_ul_b8192 0 0 1.9073486328125e-6 5000.0000 ECU_ADDRESS 0x007FB728 /begin FUNCTION_LIST IMDGEN_1PR /end FUNCTION_LIST /end MEASUREMENT
/begin MEASUREMENT P_gen_ab "elektrische Generatorleistung" ULONG Def_pwr_ul_q0p03125 0 0 0.0 4096.0000 ECU_ADDRESS 0x007FB72C /begin FUNCTION_LIST IMDGEN_1PR /end FUNCTION_LIST /end MEASUREMENT
/begin MEASUREMENT Fdib_ig "" SWORD Def_i_sw_q1 0 0 -32768.0000 32767.0000 ECU_ADDRESS 0x007FB738 /begin FUNCTION_LIST IMDGEN_1PR /end FUNCTION_LIST /end MEASUREMENT
/begin MEASUREMENT Gen_dts "Temperaturerhoehung im Generatorstator" SWORD Def_t_sw_q0p1 0 0 -3276.8000 3276.7000 ECU_ADDRESS 0x007FB73A /begin FUNCTION_LIST IMDGEN_1PR /end FUNCTION_LIST /end MEASUREMENT
/begin MEASUREMENT Gen_sttemp "Generatorstarttemperatur" SWORD Def_t_sw_q0p1 0 0 -3276.8000 3276.7000 ECU_ADDRESS 0x007FB73C /begin FUNCTION_LIST IMDGEN_1PR /end FUNCTION_LIST /end MEASUREMENT
/begin MEASUREMENT Gen_tans "Generatoransauglufttemperatur" SWORD Def_t_sw_q0p1 0 0 -3276.8000 3276.7000 ECU_ADDRESS 0x007FB73E /begin FUNCTION_LIST IMDGEN_1PR /end FUNCTION_LIST /end MEASUREMENT
/begin MEASUREMENT Gen_tansend "Generatoransaugluftendwert" SWORD Def_t_sw_q0p1 0 0 -3276.8000 3276.7000 ECU_ADDRESS 0x007FB740 /begin FUNCTION_LIST IMDGEN_1PR /end FUNCTION_LIST /end MEASUREMENT
/begin MEASUREMENT Md_genfil "gefiltertes Generatormoment absolut" SWORD Def_m_sw_q0p1 0 0 -3276.8000 3276.7000 ECU_ADDRESS 0x007FB742 /begin FUNCTION_LIST IMDGEN_1PR /end FUNCTION_LIST /end MEASUREMENT
/begin MEASUREMENT Md_gennmufi "Generatormoment absolut" SWORD Def_m_sw_q0p1 0 0 -3276.8000 3276.7000 ECU_ADDRESS 0x007FB744 /begin FUNCTION_LIST IMDGEN_1PR /end FUNCTION_LIST /end MEASUREMENT
/begin MEASUREMENT N_gen "Generatordrehzahl" SWORD Def_n_sw_q1p0 0 0 0.0 32767.0000 ECU_ADDRESS 0x007FB746 /begin FUNCTION_LIST IMDGEN_1PR /end FUNCTION_LIST /end MEASUREMENT
/begin MEASUREMENT Nkw_s "Motordrehzahl U/s" SWORD Def_n_sw_q1p0 0 0 -32768.0000 32767.0000 ECU_ADDRESS 0x007FB748 /begin FUNCTION_LIST IMDGEN_1PR /end FUNCTION_LIST /end MEASUREMENT
/begin MEASUREMENT Tgen_dt "Temperaturdifferenz zwischen Abstelltemperatur und Umgebungstemperatur" SWORD Def_t_sw_q0p1 0 0 -48.0000 384.0000 ECU_ADDRESS 0x007FB74A /begin FUNCTION_LIST IMDGEN_1PR /end FUNCTION_LIST /end MEASUREMENT
/begin MEASUREMENT Tgen_exp "Delta Abkühltemperatur" SWORD Def_t_sw_q0p1 0 0 -48.0000 384.0000 ECU_ADDRESS 0x007FB74C /begin FUNCTION_LIST IMDGEN_1PR /end FUNCTION_LIST /end MEASUREMENT
/begin MEASUREMENT Tgen_fil "gefilterte Generatortemperatur" SWORD Def_t_sw_q0p1 0 0 -3276.8000 3276.7000 ECU_ADDRESS 0x007FB74E /begin FUNCTION_LIST IMDGEN_1PR /end FUNCTION_LIST /end MEASUREMENT
/begin MEASUREMENT Gen_rs "Statorwiderstand" UWORD Def_f_uw_b1 0 0 0.0 9.99984741210938e-1 ECU_ADDRESS 0x007FB750 /begin FUNCTION_LIST IMDGEN_1PR /end FUNCTION_LIST /end MEASUREMENT
/begin MEASUREMENT Gen_spv "Generatorstatorverlustleistung" UWORD Def_f_uw_b2048 0 0 0.0 2047.9687 ECU_ADDRESS 0x007FB752 /begin FUNCTION_LIST IMDGEN_1PR /end FUNCTION_LIST /end MEASUREMENT
/begin MEASUREMENT Gen_teta "Wirkungsgrad Generator W*PI temperaturkompensiert" UWORD Def_f_uw_b32 0 0 0.0 31.9995 ECU_ADDRESS 0x007FB754 /begin FUNCTION_LIST IMDGEN_1PR /end FUNCTION_LIST /end MEASUREMENT
/begin MEASUREMENT Gen_weta "Wirkungsgrad Generator mit Omega*PI" UWORD Def_f_uw_b32 0 0 0.0 31.9995 ECU_ADDRESS 0x007FB756 /begin FUNCTION_LIST IMDGEN_1PR /end FUNCTION_LIST /end MEASUREMENT
/begin MEASUREMENT I_gen_nafil "Generatorstrom nach Filter" UWORD Def_i_uw_q0p03125 0 0 0.0 256.0000 ECU_ADDRESS 0x007FB758 /begin FUNCTION_LIST IMDGEN_1PR /end FUNCTION_LIST /end MEASUREMENT
/begin MEASUREMENT I_gen_vorfil "Generatorstrom vor Filter" UWORD Def_i_uw_q0p03125 0 0 0.0 256.0000 ECU_ADDRESS 0x007FB75A /begin FUNCTION_LIST IMDGEN_1PR /end FUNCTION_LIST /end MEASUREMENT
/begin MEASUREMENT Md_genrel "relatives Generatormoment Ausgang" UWORD Def_f_uw_b100 0 0 0.0 99.9984 ECU_ADDRESS 0x007FB75C /begin FUNCTION_LIST IMDGEN_1PR /end FUNCTION_LIST /end MEASUREMENT
/begin MEASUREMENT Tst_countv "Testcounter-Wert" UWORD Def_st_uw_q1 0 0 0.0 65535.0000 ECU_ADDRESS 0x007FB75E /begin FUNCTION_LIST IMDGEN_1PR /end FUNCTION_LIST /end MEASUREMENT
/begin MEASUREMENT Tst_fil_out "Testfilter Ausgang" UWORD Def_t_uw_q0p075 0 0 0.0 768.0000 ECU_ADDRESS 0x007FB760 /begin FUNCTION_LIST IMDGEN_1PR /end FUNCTION_LIST /end MEASUREMENT
/begin MEASUREMENT Gen_i_kaltun "DF korrektiert ueber Generatordrehzahl" UBYTE Def_i_ub_q1 0 0 0.0 255.0000 ECU_ADDRESS 0x007FB766 /begin FUNCTION_LIST IMDGEN_1PR /end FUNCTION_LIST /end MEASUREMENT
/begin MEASUREMENT Gen_nummer "Erkannte Generatornummer" UBYTE Def_st_ub_q1 0 0 0.0 255.0000 ECU_ADDRESS 0x007FB767 /begin FUNCTION_LIST IMDGEN_1PR /end FUNCTION_LIST /end MEASUREMENT
/begin MEASUREMENT I_basis "Basis Strombedarf FZG mit SLP" UBYTE Def_i_ub_q1 0 0 0.0 255.0000 ECU_ADDRESS 0x007FB768 /begin FUNCTION_LIST IMDGEN_1PR /end FUNCTION_LIST /end MEASUREMENT
/begin MEASUREMENT I_gen_end "Generatorstrom gemessen / gerechnet" UBYTE Def_i_ub_q1 0 0 0.0 254.0000 ECU_ADDRESS 0x007FB769 /begin FUNCTION_LIST IMDGEN_1PR /end FUNCTION_LIST /end MEASUREMENT
/begin MEASUREMENT I_gen_g "Generatorstrom gesamt" UBYTE Def_i_ub_q1 0 0 0.0 255.0000 ECU_ADDRESS 0x007FB76A /begin FUNCTION_LIST IMDGEN_1PR /end FUNCTION_LIST /end MEASUREMENT
/begin MEASUREMENT I_gm "Generatormischstrom" UBYTE Def_i_ub_q1 0 0 0.0 255.0000 ECU_ADDRESS 0x007FB76B /begin FUNCTION_LIST IMDGEN_1PR /end FUNCTION_LIST /end MEASUREMENT
/begin MEASUREMENT I_gvor "Stromwert nach Überblendung" UBYTE Def_i_ub_q1 0 0 0.0 255.0000 ECU_ADDRESS 0x007FB76C /begin FUNCTION_LIST IMDGEN_1PR /end FUNCTION_LIST /end MEASUREMENT
/begin MEASUREMENT St_sleep.B_sleepwait "Signal Verzoegerung Sleep Indication" UBYTE Def_bit_ub_0 0 0 0.0 255.0 ECU_ADDRESS 0x007FBD24 /begin FUNCTION_LIST KT_IBS /end FUNCTION_LIST BIT_MASK 0x1 /end MEASUREMENT
/begin MEASUREMENT St_sleep "Statuswort Einschlafverhalten" UBYTE Def_st_ub_q1 0 0 0.0 255.0000 ECU_ADDRESS 0x007FBD24 /begin FUNCTION_LIST KT_IBS /end FUNCTION_LIST /end MEASUREMENT
/begin MEASUREMENT St_ibsreg4.B_startfgk "Bedingung Startfähigkeit gefährdet" UBYTE Def_bit_ub_0 0 0 0.0 255.0 ECU_ADDRESS 0x0080042C /begin FUNCTION_LIST KT_IBS /end FUNCTION_LIST BIT_MASK 0x1 /end MEASUREMENT
/begin MEASUREMENT St_ibsreg4.B_strtaw "Bedingung Startauswertung gerechnet" UBYTE Def_bit_ub_1 0 0 0.0 255.0 ECU_ADDRESS 0x0080042C /begin FUNCTION_LIST KT_IBS /end FUNCTION_LIST BIT_MASK 0x2 /end MEASUREMENT
/begin MEASUREMENT St_ibsreg4.B_ibspwf "Bedingung IBS powerfail erkannt" UBYTE Def_bit_ub_4 0 0 0.0 255.0 ECU_ADDRESS 0x0080042C /begin FUNCTION_LIST KT_IBS /end FUNCTION_LIST BIT_MASK 0x10 /end MEASUREMENT
/begin MEASUREMENT St_ibsreg4.B_tiefset "Bedingung Tiefentladung" UBYTE Def_bit_ub_5 0 0 0.0 255.0 ECU_ADDRESS 0x0080042C /begin FUNCTION_LIST KT_IBS /end FUNCTION_LIST BIT_MASK 0x20 /end MEASUREMENT
/begin MEASUREMENT St_ibsreg4 "Statuswort ibsreg4" UBYTE Def_st_ub_q1 0 0 0.0 255.0000 ECU_ADDRESS 0x0080042C /begin FUNCTION_LIST KT_IBS /end FUNCTION_LIST /end MEASUREMENT
/begin MEASUREMENT St_ibsreg5.B_fsclr "Bedingung IBS interne Fehler loeschen" UBYTE Def_bit_ub_3 0 0 0.0 255.0 ECU_ADDRESS 0x0080042D /begin FUNCTION_LIST KT_IBS /end FUNCTION_LIST BIT_MASK 0x8 /end MEASUREMENT
/begin MEASUREMENT St_ibsreg5 "Statuswort ibsreg5" UBYTE Def_st_ub_q1 0 0 0.0 255.0000 ECU_ADDRESS 0x0080042D /begin FUNCTION_LIST KT_IBS /end FUNCTION_LIST /end MEASUREMENT
/begin MEASUREMENT Ibs_reg5 "IBS Register 5 Var.not used: now St_ibsreg5" UBYTE Def_dez_ub_q1 0 0 0.0 255.0000 ECU_ADDRESS 0x0080042E /begin FUNCTION_LIST KT_IBS /end FUNCTION_LIST /end MEASUREMENT
/begin MEASUREMENT Ibs_errors "Fehler Reg. aus IBS gelesen" UBYTE Def_dez_ub_q1 0 0 0.0 255.0000 ECU_ADDRESS 0x0080042F /begin FUNCTION_LIST KT_IBS /end FUNCTION_LIST /end MEASUREMENT
/begin MEASUREMENT Ibs_msgind "Index auf EBSD Botschaft" UBYTE Def_dez_ub_q1 0 0 0.0 255.0000 ECU_ADDRESS 0x00800430 /begin FUNCTION_LIST KT_IBS /end FUNCTION_LIST /end MEASUREMENT
/begin MEASUREMENT Ibs_msgsta "EBSD Fehler Status" UBYTE Def_dez_ub_q1 0 0 0.0 255.0000 ECU_ADDRESS 0x00800431 /begin FUNCTION_LIST KT_IBS /end FUNCTION_LIST /end MEASUREMENT
/begin MEASUREMENT Kt_ibsstatus "Status BSD Statemachine" UBYTE Def_dez_ub_q1 0 0 0.0 255.0000 ECU_ADDRESS 0x00800432 /begin FUNCTION_LIST KT_IBS /end FUNCTION_LIST /end MEASUREMENT
/begin MEASUREMENT Ibs_start "Status Statemachine Startup Kommunikation" UBYTE Def_dez_ub_q1 0 0 0.0 255.0000 ECU_ADDRESS 0x00800433 /begin FUNCTION_LIST KT_IBS /end FUNCTION_LIST /end MEASUREMENT
/begin MEASUREMENT Comcontrol "Kontrolle Diagnose Modul DIBS" UBYTE Def_dez_ub_q1 0 0 0.0 255.0000 ECU_ADDRESS 0x00800434 /begin FUNCTION_LIST KT_IBS /end FUNCTION_LIST /end MEASUREMENT
/begin MEASUREMENT St_ibebsd1.B_ibs_msgrdy "Bedingung EBSD Botschaft von IBS empfangen" UBYTE Def_bit_ub_0 0 0 0.0 255.0 ECU_ADDRESS 0x00800435 /begin FUNCTION_LIST KT_IBS /end FUNCTION_LIST BIT_MASK 0x1 /end MEASUREMENT
/begin MEASUREMENT St_ibebsd1.B_ibs_msgwri "Bedingung EBSD Übertragungsrichtung schreiben" UBYTE Def_bit_ub_1 0 0 0.0 255.0 ECU_ADDRESS 0x00800435 /begin FUNCTION_LIST KT_IBS /end FUNCTION_LIST BIT_MASK 0x2 /end MEASUREMENT
/begin MEASUREMENT St_ibebsd1.B_eb_txok "Bedingung EBSD Übertragungsrichtung schreiben" UBYTE Def_bit_ub_2 0 0 0.0 255.0 ECU_ADDRESS 0x00800435 /begin FUNCTION_LIST KT_IBS /end FUNCTION_LIST BIT_MASK 0x4 /end MEASUREMENT
/begin MEASUREMENT St_ibebsd1.B_eb_busy "Bedingung EBSD Übertragungsrichtung schreiben" UBYTE Def_bit_ub_3 0 0 0.0 255.0 ECU_ADDRESS 0x00800435 /begin FUNCTION_LIST KT_IBS /end FUNCTION_LIST BIT_MASK 0x8 /end MEASUREMENT
/begin MEASUREMENT St_ibebsd1 "Statuswort ibebsd1" UBYTE Def_st_ub_q1 0 0 0.0 255.0000 ECU_ADDRESS 0x00800435 /begin FUNCTION_LIST KT_IBS /end FUNCTION_LIST /end MEASUREMENT
/begin MEASUREMENT St_ibserr.B_ibfbsd "Bedingung BSD Fehler" UBYTE Def_bit_ub_0 0 0 0.0 255.0 ECU_ADDRESS 0x00800436 /begin FUNCTION_LIST KT_IBS /end FUNCTION_LIST BIT_MASK 0x1 /end MEASUREMENT
/begin MEASUREMENT St_ibserr.B_ibfebsd "Bedingung EBSD Fehler" UBYTE Def_bit_ub_1 0 0 0.0 255.0 ECU_ADDRESS 0x00800436 /begin FUNCTION_LIST KT_IBS /end FUNCTION_LIST BIT_MASK 0x2 /end MEASUREMENT
/begin MEASUREMENT St_ibserr.B_ibunplau "Bedingung IBS Version unplausibel" UBYTE Def_bit_ub_2 0 0 0.0 255.0 ECU_ADDRESS 0x00800436 /begin FUNCTION_LIST KT_IBS /end FUNCTION_LIST BIT_MASK 0x4 /end MEASUREMENT
/begin MEASUREMENT St_ibserr "Statuswort ibserr" UBYTE Def_st_ub_q1 0 0 0.0 255.0000 ECU_ADDRESS 0x00800436 /begin FUNCTION_LIST KT_IBS /end FUNCTION_LIST /end MEASUREMENT
/begin MEASUREMENT St_ibmix.B_ibrhilo "toggle Bit Register0/ 1 hi- od. lo byte" UBYTE Def_bit_ub_0 0 0 0.0 255.0 ECU_ADDRESS 0x00800437 /begin FUNCTION_LIST KT_IBS /end FUNCTION_LIST BIT_MASK 0x1 /end MEASUREMENT
/begin MEASUREMENT St_ibmix.B_ibttog "global toggle bit" UBYTE Def_bit_ub_1 0 0 0.0 255.0 ECU_ADDRESS 0x00800437 /begin FUNCTION_LIST KT_IBS /end FUNCTION_LIST BIT_MASK 0x2 /end MEASUREMENT
/begin MEASUREMENT St_ibmix "Statuswort ibmix" UBYTE Def_st_ub_q1 0 0 0.0 255.0000 ECU_ADDRESS 0x00800437 /begin FUNCTION_LIST KT_IBS /end FUNCTION_LIST /end MEASUREMENT
/begin MEASUREMENT Ibswbase "IBS Software Baseline" UBYTE Def_dez_ub_q1 0 0 0.0 255.0000 ECU_ADDRESS 0x00800438 /begin FUNCTION_LIST KT_IBS /end FUNCTION_LIST /end MEASUREMENT
/begin MEASUREMENT Ibswchang "IBS Software Änderungs Status" UBYTE Def_dez_ub_q1 0 0 0.0 255.0000 ECU_ADDRESS 0x00800439 /begin FUNCTION_LIST KT_IBS /end FUNCTION_LIST /end MEASUREMENT
/begin MEASUREMENT Ibhwversi "IBS Hardware Version" UBYTE Def_dez_ub_q1 0 0 0.0 255.0000 ECU_ADDRESS 0x0080043A /begin FUNCTION_LIST KT_IBS /end FUNCTION_LIST /end MEASUREMENT
/begin MEASUREMENT Ib_parlen "Länge IBS Parameterliste" UBYTE Def_dez_ub_q1 0 0 0.0 255.0000 ECU_ADDRESS 0x0080043B /begin FUNCTION_LIST KT_IBS /end FUNCTION_LIST /end MEASUREMENT
/begin MEASUREMENT Ibsiicctri "IBS Fehlerzähler" UBYTE Def_dez_ub_q1 0 0 0.0 255.0000 ECU_ADDRESS 0x0080043C /begin FUNCTION_LIST KT_IBS /end FUNCTION_LIST /end MEASUREMENT
/begin MEASUREMENT Ibsbclctri "IBS Fehlerzähler" UBYTE Def_dez_ub_q1 0 0 0.0 255.0000 ECU_ADDRESS 0x0080043D /begin FUNCTION_LIST KT_IBS /end FUNCTION_LIST /end MEASUREMENT
/begin MEASUREMENT Ibseromctr "IBS Fehlerzähler" UBYTE Def_dez_ub_q1 0 0 0.0 255.0000 ECU_ADDRESS 0x0080043E /begin FUNCTION_LIST KT_IBS /end FUNCTION_LIST /end MEASUREMENT
/begin MEASUREMENT Ibsramctr "IBS Fehlerzähler" UBYTE Def_dez_ub_q1 0 0 0.0 255.0000 ECU_ADDRESS 0x0080043F /begin FUNCTION_LIST KT_IBS /end FUNCTION_LIST /end MEASUREMENT
/begin MEASUREMENT Ibspromctr "IBS Fehlerzähler" UBYTE Def_dez_ub_q1 0 0 0.0 255.0000 ECU_ADDRESS 0x00800440 /begin FUNCTION_LIST KT_IBS /end FUNCTION_LIST /end MEASUREMENT
/begin MEASUREMENT Ibsdncsctr "IBS Fehlerzähler download checksum" UBYTE Def_dez_ub_q1 0 0 0.0 255.0000 ECU_ADDRESS 0x00800441 /begin FUNCTION_LIST KT_IBS /end FUNCTION_LIST /end MEASUREMENT
/begin MEASUREMENT T_battsoci "T_battsoc0, Rohwert aus IBS" UBYTE Def_dez_ub_q1 0 0 0.0 255.0000 ECU_ADDRESS 0x00800442 /begin FUNCTION_LIST KT_IBS /end FUNCTION_LIST /end MEASUREMENT
/begin MEASUREMENT Tbatt_maxi "T_batt_max, Rohwert aus IBS" UBYTE Def_dez_ub_q1 0 0 0.0 255.0000 ECU_ADDRESS 0x00800443 /begin FUNCTION_LIST KT_IBS /end FUNCTION_LIST /end MEASUREMENT
/begin MEASUREMENT Tbatt_mini "T_batt_min, Rohwert aus IBS" UBYTE Def_dez_ub_q1 0 0 0.0 255.0000 ECU_ADDRESS 0x00800444 /begin FUNCTION_LIST KT_IBS /end FUNCTION_LIST /end MEASUREMENT
/begin MEASUREMENT Ibslvdctr "IBS Fehlerzähler" UWORD Def_dez_uw_q1 0 0 0.0 65535.0000 ECU_ADDRESS 0x008003E4 /begin FUNCTION_LIST KT_IBS /end FUNCTION_LIST /end MEASUREMENT
/begin MEASUREMENT I_batt "Batteriestrom von IBS gemessen" UWORD Def_i_uw_q0p08_o200 0 0 -200.0000 5042.8000 ECU_ADDRESS 0x008003E6 /begin FUNCTION_LIST KT_IBS /end FUNCTION_LIST /end MEASUREMENT
/begin MEASUREMENT U_batt "Batteriespannung von IBS gemessen" UWORD Def_u_uw_q0p25em3_o6 0 0 6.0000 22.3837 ECU_ADDRESS 0x008003E8 /begin FUNCTION_LIST KT_IBS /end FUNCTION_LIST /end MEASUREMENT
/begin MEASUREMENT Ibsborctr "IBS Fehlerzähler" UWORD Def_dez_uw_q1 0 0 0.0 65535.0000 ECU_ADDRESS 0x008003EA /begin FUNCTION_LIST KT_IBS /end FUNCTION_LIST /end MEASUREMENT
/begin MEASUREMENT Ibswdtctr "IBS Fehlerzähler watchdog" UWORD Def_dez_uw_q1 0 0 0.0 65535.0000 ECU_ADDRESS 0x008003EC /begin FUNCTION_LIST KT_IBS /end FUNCTION_LIST /end MEASUREMENT
/begin MEASUREMENT Ibsporctr "IBS Fehlerzähler power on" UWORD Def_dez_uw_q1 0 0 0.0 65535.0000 ECU_ADDRESS 0x008003EE /begin FUNCTION_LIST KT_IBS /end FUNCTION_LIST /end MEASUREMENT
/begin MEASUREMENT Ibsptyctr "IBS Fehlerzähler BSD parity" UWORD Def_dez_uw_q1 0 0 0.0 65535.0000 ECU_ADDRESS 0x008003F0 /begin FUNCTION_LIST KT_IBS /end FUNCTION_LIST /end MEASUREMENT
/begin MEASUREMENT Qlad "Delta Batterieladung" UWORD Def_ql_uw_q0p0182 0 0 0.0 1192.7502 ECU_ADDRESS 0x008003F2 /begin FUNCTION_LIST KT_IBS /end FUNCTION_LIST /end MEASUREMENT
/begin MEASUREMENT Qelad "Delta Batterieentladung" UWORD Def_ql_uw_q0p0182 0 0 0.0 1192.7502 ECU_ADDRESS 0x008003F4 /begin FUNCTION_LIST KT_IBS /end FUNCTION_LIST /end MEASUREMENT
/begin MEASUREMENT I_soc0 "Strom bei Ruhespannungsmessung" SWORD Def_i_sw_q0p02 0 0 -655.3600 655.3400 ECU_ADDRESS 0x008003F6 /begin FUNCTION_LIST KT_IBS /end FUNCTION_LIST /end MEASUREMENT
/begin MEASUREMENT T_battsoc0 "Batterietemperatur bei Ruhespannungsmessung" SWORD Def_t_sw_q0p1 0 0 -3276.8000 3276.7000 ECU_ADDRESS 0x008003F8 /begin FUNCTION_LIST KT_IBS /end FUNCTION_LIST /end MEASUREMENT
/begin MEASUREMENT U1soc0 "Ruhespannung 1" UWORD Def_u_uw_q0p25em3_o6 0 0 6.0000 22.3837 ECU_ADDRESS 0x008003FA /begin FUNCTION_LIST KT_IBS /end FUNCTION_LIST /end MEASUREMENT
/begin MEASUREMENT U2soc0 "Ruhespannung 1" UWORD Def_u_uw_q0p25em3_o6 0 0 6.0000 22.3837 ECU_ADDRESS 0x008003FC /begin FUNCTION_LIST KT_IBS /end FUNCTION_LIST /end MEASUREMENT
/begin MEASUREMENT U3soc0 "Ruhespannung 1" UWORD Def_u_uw_q0p25em3_o6 0 0 6.0000 22.3837 ECU_ADDRESS 0x008003FE /begin FUNCTION_LIST KT_IBS /end FUNCTION_LIST /end MEASUREMENT
/begin MEASUREMENT Qladsoc0 "Ladung bei Ruhespannungsmessung" UWORD Def_ql_uw_q0p0182 0 0 0.0 1192.7502 ECU_ADDRESS 0x00800400 /begin FUNCTION_LIST KT_IBS /end FUNCTION_LIST /end MEASUREMENT
/begin MEASUREMENT Qeladsoc0 "Entladung bei Ruhespannungsmessung" UWORD Def_ql_uw_q0p0182 0 0 0.0 1192.7502 ECU_ADDRESS 0x00800402 /begin FUNCTION_LIST KT_IBS /end FUNCTION_LIST /end MEASUREMENT
/begin MEASUREMENT U_vorstart "Spannung vor Start" UWORD Def_u_uw_q0p25em3_o6 0 0 6.0000 22.3837 ECU_ADDRESS 0x00800404 /begin FUNCTION_LIST KT_IBS /end FUNCTION_LIST /end MEASUREMENT
/begin MEASUREMENT U_tnstart "Spannung im Start" UWORD Def_u_uw_q0p25em3_o6 0 0 6.0000 22.3837 ECU_ADDRESS 0x00800406 /begin FUNCTION_LIST KT_IBS /end FUNCTION_LIST /end MEASUREMENT
/begin MEASUREMENT I_vorstart "Batteriestrom vor Start" UWORD Def_i_uw_q0p02_o200 0 0 -200.0000 1110.7000 ECU_ADDRESS 0x00800408 /begin FUNCTION_LIST KT_IBS /end FUNCTION_LIST /end MEASUREMENT
/begin MEASUREMENT I_tnstart "Batteriestrom im Start" UWORD Def_i_uw_q0p02 0 0 0.0 1310.7000 ECU_ADDRESS 0x0080040A /begin FUNCTION_LIST KT_IBS /end FUNCTION_LIST /end MEASUREMENT
/begin MEASUREMENT T1histiruh "Ruhestromhistogramm Klasse 1" UWORD Def_dez_uw_q1 0 0 0.0 65535.0000 ECU_ADDRESS 0x0080040C /begin FUNCTION_LIST KT_IBS /end FUNCTION_LIST /end MEASUREMENT
/begin MEASUREMENT T2histiruh "Ruhestromhistogramm Klasse 2" UWORD Def_dez_uw_q1 0 0 0.0 65535.0000 ECU_ADDRESS 0x0080040E /begin FUNCTION_LIST KT_IBS /end FUNCTION_LIST /end MEASUREMENT
/begin MEASUREMENT T3histiruh "Ruhestromhistogramm Klasse 3" UWORD Def_dez_uw_q1 0 0 0.0 65535.0000 ECU_ADDRESS 0x00800410 /begin FUNCTION_LIST KT_IBS /end FUNCTION_LIST /end MEASUREMENT
/begin MEASUREMENT T4histiruh "Ruhestromhistogramm Klasse 4" UWORD Def_dez_uw_q1 0 0 0.0 65535.0000 ECU_ADDRESS 0x00800412 /begin FUNCTION_LIST KT_IBS /end FUNCTION_LIST /end MEASUREMENT
/begin MEASUREMENT T_batt_ibs "Batterietemperatur" SWORD Def_t_sw_q0p1 0 0 -3276.8000 3276.7000 ECU_ADDRESS 0x00800414 /begin FUNCTION_LIST KT_IBS /end FUNCTION_LIST /end MEASUREMENT
/begin MEASUREMENT T_batt_max "Maximale Batt. Temperatur bei Stillstand" SWORD Def_t_sw_q0p1 0 0 -3276.8000 3276.7000 ECU_ADDRESS 0x00800416 /begin FUNCTION_LIST KT_IBS /end FUNCTION_LIST /end MEASUREMENT
/begin MEASUREMENT T_batt_min "Minimale Batt. Temperatur bei Stillstand" SWORD Def_t_sw_q0p1 0 0 -3276.8000 3276.7000 ECU_ADDRESS 0x00800418 /begin FUNCTION_LIST KT_IBS /end FUNCTION_LIST /end MEASUREMENT
/begin MEASUREMENT Ktupcsctr "kt_ibs Fehlerzähler EBSD Checksumme" UWORD Def_dez_uw_q1 0 0 0.0 65535.0000 ECU_ADDRESS 0x0080041A /begin FUNCTION_LIST KT_IBS /end FUNCTION_LIST /end MEASUREMENT
/begin MEASUREMENT Zbibs "Zusbaunummer" ULONG Def_dez_ul_q1 0 0 0.0 2147483647.0000 ECU_ADDRESS 0x008003D8 /begin FUNCTION_LIST KT_IBS /end FUNCTION_LIST /end MEASUREMENT
/begin MEASUREMENT Snibs "Seriennummer" ULONG Def_dez_ul_q1 0 0 0.0 2147483647.0000 ECU_ADDRESS 0x008003DC /begin FUNCTION_LIST KT_IBS /end FUNCTION_LIST /end MEASUREMENT
/begin MEASUREMENT Ebsd_varin "Index EBSD Variable" UBYTE Def_dez_ub_q1 0 0 0.0 255.0000 ECU_ADDRESS 0x00800445 /begin FUNCTION_LIST KT_IBS /end FUNCTION_LIST /end MEASUREMENT
/begin MEASUREMENT Ebsd_nbyt "Länge EBSD Variable" UBYTE Def_dez_ub_q1 0 0 0.0 255.0000 ECU_ADDRESS 0x00800446 /begin FUNCTION_LIST KT_IBS /end FUNCTION_LIST /end MEASUREMENT
/begin MEASUREMENT Unind "EBSD Puffer Index" UBYTE Def_dez_ub_q1 0 0 0.0 255.0000 ECU_ADDRESS 0x00800447 /begin FUNCTION_LIST KT_IBS /end FUNCTION_LIST /end MEASUREMENT
/begin MEASUREMENT Ebsd_adr "EBSD Adresse im IBS" UBYTE Def_dez_ub_q1 0 0 0.0 255.0000 ECU_ADDRESS 0x00800448 /begin FUNCTION_LIST KT_IBS /end FUNCTION_LIST /end MEASUREMENT
/begin MEASUREMENT Ebsd_errdir "EBSD Übertragungsrichtung bei Fehler" UBYTE Def_dez_ub_q1 0 0 0.0 255.0000 ECU_ADDRESS 0x00800449 /begin FUNCTION_LIST KT_IBS /end FUNCTION_LIST /end MEASUREMENT
/begin MEASUREMENT Ebsd_errin "EBSD Index bei Fehler" UBYTE Def_dez_ub_q1 0 0 0.0 255.0000 ECU_ADDRESS 0x0080044A /begin FUNCTION_LIST KT_IBS /end FUNCTION_LIST /end MEASUREMENT
/begin MEASUREMENT Ebsd_errep "EBSD Fehler repeat timer" UBYTE Def_dez_ub_q1 0 0 0.0 255.0000 ECU_ADDRESS 0x0080044B /begin FUNCTION_LIST KT_IBS /end FUNCTION_LIST /end MEASUREMENT
/begin MEASUREMENT Ebsd_timo "EBSD Fehler timeout counter" UBYTE Def_dez_ub_q1 0 0 0.0 255.0000 ECU_ADDRESS 0x0080044C /begin FUNCTION_LIST KT_IBS /end FUNCTION_LIST /end MEASUREMENT
/begin MEASUREMENT R5cyctim "Timer f. zyklisches Senden IBS Reg. 5" UBYTE Def_dez_ub_q1 0 0 0.0 255.0000 ECU_ADDRESS 0x0080044D /begin FUNCTION_LIST KT_IBS /end FUNCTION_LIST /end MEASUREMENT
/begin MEASUREMENT Fsclctr "Hilfszaehler IBS Fehler loeschen" UBYTE Def_dez_ub_q1 0 0 0.0 255.0000 ECU_ADDRESS 0x0080044E /begin FUNCTION_LIST KT_IBS /end FUNCTION_LIST /end MEASUREMENT
/begin MEASUREMENT Ktib_chk16 "Checksumme EBSD Übertragung intern" UWORD Def_dez_uw_q1 0 0 0.0 65535.0000 ECU_ADDRESS 0x0080041C /begin FUNCTION_LIST KT_IBS /end FUNCTION_LIST /end MEASUREMENT
/begin MEASUREMENT Ib_chk16 "Checksumme EBSD Übertragung aus IBS" UWORD Def_dez_uw_q1 0 0 0.0 65535.0000 ECU_ADDRESS 0x0080041E /begin FUNCTION_LIST KT_IBS /end FUNCTION_LIST /end MEASUREMENT
/begin MEASUREMENT Chk16_ibs "Checksumme Parameter aus IBS" UWORD Def_dez_uw_q1 0 0 0.0 65535.0000 ECU_ADDRESS 0x00800420 /begin FUNCTION_LIST KT_IBS /end FUNCTION_LIST /end MEASUREMENT
/begin MEASUREMENT Chkpara "Checksumme Parameter intern" UWORD Def_dez_uw_q1 0 0 0.0 65535.0000 ECU_ADDRESS 0x00800422 /begin FUNCTION_LIST KT_IBS /end FUNCTION_LIST /end MEASUREMENT
/begin FUNCTION vsacd "Drallniveausteller Komponententreiber"
 /begin DEF_CHARACTERISTIC VSACD_ctPwrStgOnMax_C VSACD_tiDebDioInDia1Def_C VSACD_tiDebDioInDia1Ok_C VSACD_tiDebDioInDia2Def_C VSACD_tiDebDioInDia2Ok_C VSACD_tiDebDioInDia3Def_C VSACD_tiDebDioInDia3Ok_C VSACD_tiDebDioInDia4Def_C VSACD_tiDebDioInDia4Ok_C VSACD_tiDebDioInMinDef_C VSACD_tiDebDioInMinOk_C VSACD_DebExcTempDef_C VSACD_DebExcTempOk_C VSACD_DebNoLoadDef_C VSACD_DebNoLoadOk_C VSACD_DebShortCircBatDef_C VSACD_DebShortCircBatOk_C VSACD_DebShortCircGndDef_C VSACD_DebShortCircGndOk_C VSACD_tiDebVSADia1Def_C VSACD_tiDebVSADia1Ok_C VSACD_tiDebVSADia2Def_C VSACD_tiDebVSADia2Ok_C VSACD_tiDebVSADia3Def_C VSACD_tiDebVSADia3Ok_C VSACD_tiDebVSADia4Def_C VSACD_tiDebVSADia4Ok_C VSACD_numDia_C VSACD_numDioIn_C VSACD_numPwmOut_C VSACD_stInvOut_C VSACD_tiPer_C VSACD_rCnv_CUR VSACD_rOutMax_C VSACD_rOutMin_C VSACD_stPwrStgActv_C VSACD_stPwrStgDia_C VSACD_stSPICtl_C VSACD_swtExtPinEna_C VSACD_swt_C VSACD_tiBtwTst_C VSACD_tiDiag1Max_C VSACD_tiDiag1Min_C VSACD_tiDiag2Max_C VSACD_tiDiag2Min_C VSACD_tiDiag3Max_C VSACD_tiDiag3Min_C VSACD_tiDiag4Max_C VSACD_tiDiag4Min_C VSACD_tiDioInDia1Max_C VSACD_tiDioInDia1Min_C VSACD_tiDioInDia2Max_C VSACD_tiDioInDia2Min_C VSACD_tiDioInDia3Max_C VSACD_tiDioInDia3Min_C VSACD_tiDioInDia4Max_C VSACD_tiDioInDia4Min_C VSACD_tiPwrStgOn_C /end DEF_CHARACTERISTIC
 /begin IN_MEASUREMENT VSA_rVSA /end IN_MEASUREMENT
/end FUNCTION
/begin FUNCTION vsacd_msg "" /begin OUT_MEASUREMENT VSACD_rOut /end OUT_MEASUREMENT /end FUNCTION
/begin FUNCTION vsacd_uic "" /begin OUT_MEASUREMENT VSACD_rCnv_mp VSACD_stErr_mp /end OUT_MEASUREMENT /end FUNCTION
/begin FUNCTION vsacd_var "" /end FUNCTION
/begin FUNCTION vsacd_var_uic "" /end FUNCTION
/begin FUNCTION vsa_co "Stellerkoordinator für Drallnivieausteller" /end FUNCTION
/begin FUNCTION vsa_co_msg "" /begin OUT_MEASUREMENT VSA_rVSA /end OUT_MEASUREMENT /end FUNCTION
/begin FUNCTION vsa_co_uic "" /begin DEF_CHARACTERISTIC VSA_rVSA_Vector VSA_rVSA_Channel /end DEF_CHARACTERISTIC /begin OUT_MEASUREMENT VSA_rVSAByp_mp /end OUT_MEASUREMENT /end FUNCTION
/begin FUNCTION vsscd_co "Fahrgeschwindigkeitsgeber Komponententreiber"
 /begin DEF_CHARACTERISTIC VSSCD_DebCanSigDef_C VSSCD_DebCanSigOk_C VSSCD_DebMaxDef_C VSSCD_DebMaxOk_C VSSCD_DebNegPlaMonCond_C VSSCD_DebPlaMonCond_C VSSCD_DebPlaDef_C VSSCD_DebPlaOk_C VSSCD_DebSigDef_C VSSCD_DebSigOk_C VSSCD_nThresPla_C VSSCD_qThresPla_C VSSCD_swtSigVal_C VSSCD_swtSigType_C VSSCD_tiAPT1_C VSSCD_tiPerMax_C VSSCD_tiVPT1_C VSSCD_vDfl_C VSSCD_vMax_C VSSCD_vMin_C VSSCD_vThresPla_C /end DEF_CHARACTERISTIC
/end FUNCTION
/begin FUNCTION vsscd_co_distfac "" /begin DEF_CHARACTERISTIC VSSCD_ImpPerDist_C /end DEF_CHARACTERISTIC /end FUNCTION
/begin FUNCTION vsscd_co_distfac_uic "" /end FUNCTION
/begin FUNCTION vsscd_co_uic "" /begin OUT_MEASUREMENT VSSCD_rImp_mp VSSCD_stInHW_mp /end OUT_MEASUREMENT /end FUNCTION
/begin FUNCTION vsscd_co_var "" /end FUNCTION
/begin FUNCTION vsscd_co_var_msg "" /begin OUT_MEASUREMENT VSSCD_ctImp VSSCD_swtSig VSSCD_tiPerAvrg /end OUT_MEASUREMENT /end FUNCTION
/begin FUNCTION vsscd_co_var_uic "" /end FUNCTION
/begin FUNCTION vsscd_msg "" /begin OUT_MEASUREMENT VSSCD_a VSSCD_aRaw VSSCD_v VSSCD_vRaw VSSCD_vSensVal /end OUT_MEASUREMENT /end FUNCTION
/begin FUNCTION wdcom "Frage-Antwort-Kommunikation mit Überwachungsmodul" /begin DEF_CHARACTERISTIC Chiste_stEnaTst_C /end DEF_CHARACTERISTIC /end FUNCTION
/begin FUNCTION wdcom_msg ""
 /begin OUT_MEASUREMENT WDCom_dChisteResponse_u32 WDCom_dErrorCountForCntler_u8 WDCom_dErrorCountForSpi_u8 WDCom_dErrorCountForWD_u8 WDCom_dRequest_u32 /end OUT_MEASUREMENT
/end FUNCTION
/begin FUNCTION zfc_cldcmbcham "" /begin DEF_CHARACTERISTIC ZFC_tiCldCham_CUR ZFC_tiHotCham_C /end DEF_CHARACTERISTIC /begin IN_MEASUREMENT IATSCD_tAir /end IN_MEASUREMENT /end FUNCTION
/begin FUNCTION zfc_cldcmbcham_msg "" /begin OUT_MEASUREMENT ZFC_stCldCham /end OUT_MEASUREMENT /end FUNCTION
/begin FUNCTION zfc_cldcmbcham_uic "" /begin OUT_MEASUREMENT ZFC_stCmbCham_mp /end OUT_MEASUREMENT /end FUNCTION
/begin FUNCTION zfc_co ""
 /begin DEF_CHARACTERISTIC ZFC_dBPFacNumFBCG3_CA ZFC_dBPFacNumFBCG4_CA ZFC_dBPFacNumFBCG5_CA ZFC_dBPFacNumFBCG6_CA ZFC_dSegFBCCaS_CA ZFC_nAvrgMax_C ZFC_nAvrgMin_C ZFC_nChngPRailMax_C ZFC_nFBCThresMax_C ZFC_nHyst_C ZFC_numRatETClb_C ZFC_numRatNVClb_C ZFC_stClthSel_C ZFC_stGearRls_CA ZFC_swtClbActvVal_C ZFC_swtClbActvType_C ZFC_tAirThres_C ZFC_tEngThres_C ZFC_tFuelThresMax_C ZFC_tFuelThresMin_C ZFC_tiDelOvrRun_C ZFC_tiDelpRailLim_C ZFC_uBattMin_C /end DEF_CHARACTERISTIC
/end FUNCTION
/begin FUNCTION zfc_co_uic ""
 /begin OUT_MEASUREMENT ZFC_dpRailLim_mp ZFC_dpRail_mp ZFC_pRailSetPoint_mp ZFC_stDem_mp ZFC_st_mp ZFC_vStopClb_mp /end OUT_MEASUREMENT
/end FUNCTION
/begin FUNCTION zfc_evalengspd "" /begin OUT_MEASUREMENT ZFC_Sig_mp /end OUT_MEASUREMENT /end FUNCTION
/begin FUNCTION zfc_evalengspd_uic "" /begin OUT_MEASUREMENT ZFC_SigThres_mp ZFC_stEvalSig_mp /end OUT_MEASUREMENT /end FUNCTION
/begin FUNCTION zfc_inj "Einspritzberechnung der Nullmengenkalibrierung" /begin DEF_CHARACTERISTIC ZFC_phiSet_CUR /end DEF_CHARACTERISTIC /begin IN_MEASUREMENT Eng_nAvrg /end IN_MEASUREMENT /end FUNCTION
/begin FUNCTION zfc_inj_uic "" /begin OUT_MEASUREMENT ZFC_numCylInj_mp ZFC_phiInj_mp ZFC_stInj_mp ZFC_tiET_mp /end OUT_MEASUREMENT /end FUNCTION
/begin FUNCTION zfc_msg "" /begin OUT_MEASUREMENT ZFC_swtClbActv /end OUT_MEASUREMENT /end FUNCTION
/begin FUNCTION _pa_branchtab "" /end FUNCTION
/begin FUNCTION _ksd "Kundenspezifische Daten (mit #KSD gekennzeichnet)" /begin REF_CHARACTERISTIC /end REF_CHARACTERISTIC /end FUNCTION
/begin FUNCTION _ssd "Systemspezifische Daten (mit #SSD gekennzeichnet)"
 /begin REF_CHARACTERISTIC ACC_DebPlausTrqDesDef_C ACC_DebPlausTrqDesOk_C ACC_DebTrqInrDef_C ACC_DebTrqInrOk_C ACC_dtrqLimBrkDwn_C ACC_dtrqLimBrkUp_C ACC_dtrqLimDwn_C ACC_dtrqLimUp_C AccPed_drAPPUnFltLim_C AccPed_drLimDwn_C AccPed_drLimUp_C AccPed_facAcsWghMax_C AccPed_facAcsWghMin_C AccPed_facLIOvrBehWgh_C AccPed_nErr_C AccPed_nErr_CUR AccPed_nLim_C AccPed_nLimNMR_C AccPed_nSecCase_C AccPed_rErrValPlaus_C AccPed_rThPlaus_C AccPed_rThresPrp_C AccPed_rThresSfty_C AccPed_rZero_C AccPed_swtPlausCheck_C AccPed_swtRstCon_C AccPed_swtVehDynReqd_C AccPed_tiChkDebNeg_C AccPed_tiChkDebPos_C AccPed_tiPlausBrkDebPos_C AccPed_trqDes_Channel AccPed_trqDes_Vector AccPed_trqLIOvrBehOfsL_C AccPed_trqNMRMax_C AccPed_vLim_C ACC_PlausTrqTmrDead_C ACC_qOvrRunZeroYHigh_C ACC_qOvrRunZeroYLow_C ACC_swtBrkPressedDel_C ACC_swtTrqDesShutOff_C ACC_tiBrkPressedDel_C ACC_tiPT1_C ACCtl_nMin_C ACC_trqRedShft_CUR ACC_trqReplVal_C ADCMon_DebQueueDef_C ADCMon_DebRefVltgSRCDef_C ADCMon_DebTstImpDef_C ADCMon_nQueueMon_C ADCMon_tiQueueMon_C ADCMon_tiSendTstImp_C ADCMon_uRefSRCMax_C ADCMon_uRefSRCMin_C ADCMon_uTstImpSRCMax_C AFS_swtChkDM_ANF_AFS_C AFS_swtChkSTWA_C AFS_swtdphiStrgGenSel_C AFS_trqDesMax_C AFS_trqDesMin_C AirCtl_mDesValAdd_Channel AirCtl_mDesValAdd_Vector AirCtl_mDesVal_Channel AirCtl_mDesVal_Vector AirCtl_rEGRAdd_Channel AirCtl_rEGRAdd_Vector AirCtl_rEGR_Channel AirCtl_rEGR_Vector AirCtl_rTVAAdd_Channel AirCtl_rTVAAdd_Vector AirCtl_rTVA_Channel AirCtl_rTVA_Vector Alt_pwrDes_Channel Alt_pwrDes_Vector AOHtCD_numDia_C AOHtCD_numDioIn_C AOHtCD_numPwmOut_C AOHt_nMin_C AOHt_rHtgOut_Channel AOHt_rHtgOut_Vector APPCD_DebPlaDef_C APPCD_DebPlaOk_C APPCD_DebSRCHighDef_C APPCD_DebSRCHighOk_C APPCD_DebSRCLowDef_C APPCD_DebSRCLowOk_C APPCD_drHealRmpUp_C APPCD_numAdcAPP1_C APPCD_numAdcAPP2_C APPCD_rLinAPP1_CUR APPCD_rLinAPP2_CUR APPCD_rPlaWinLowIdleXHigh_C APPCD_rPlaWinLowIdleXLow_C APPCD_rPlaWinParLoadXHigh_C APPCD_rPlaWinParLoadXLow_C APPCD_SSpMonAPP1_C APPCD_SSpMonAPP2_C APPCD_stCfgAccPed_C APPCD_swtNoFlt_C APPCD_uAPP1_SRCMax_C APPCD_uAPP1_SRCMin_C APPCD_uAPP2_SRCMax_C APPCD_uAPP2_SRCMin_C APPCD_uKickDownHighAPP1_C APPCD_uKickDownHighAPP2_C APPCD_uKickDownLowAPP1_C APPCD_uKickDownLowAPP2_C APPCD_uPlaWinFull_C APPCD_uPlaWinIdle_C APPCD_uPlaWinPar_C APSCD_numAdc_C APSCD_pDfl_C APSCD_pLin_CUR APSCD_uSRCMax_C APSCD_uSRCMin_C ASDdc_trq_Channel ASDdc_trq_Vector ASDrf_trqInr_Channel ASDrf_trqInr_Vector BattCD_numAdc_C Batt_uNrm_C BPACD_DebExcTempDef_C BPACD_DebNoLoadDef_C BPACD_DebShortCircBatDef_C BPACD_DebShortCircGndDef_C BPACD_numDia_C BPACD_numPwmOut_C BPACD_stPwrStgDia_C BPACD_tiBtwTst_C BPA_rBPACD_Channel BPA_rBPACD_Vector BPSCD_DebNplDef_C BPSCD_DebSigDef_C BPSCD_DebSRCHighDef_C BPSCD_DebSRCLowDef_C BPSCD_numAdc_C BPSCD_swtSigVal_C BPSCD_uSRCMax_C BPSCD_uSRCMin_C BrkCD_DebPlaDef_C BrkCD_DebPlaOk_C BrkCD_numDioInMn_C BrkCD_numDioInRed_C BrkCD_stMnSwtInvIn_C BrkCD_stRedSwtInvIn_C BrkCD_swtRedSwtPresent_C BrkCD_tiMnSwtDebNeg_C BrkCD_tiMnSwtDebPos_C BrkCD_tiRedSwtDebNeg_C BrkCD_tiRedSwtDebPos_C BypEtk_dNsyncStimuli16_C BypEtk_dNsyncStimuli32_C BypEtk_dNsyncStimuli64_C BypEtk_dNsyncStimuli8_C BypEtk_dTsyncStimuli16_C BypEtk_dTsyncStimuli32_C BypEtk_dTsyncStimuli64_C BypEtk_dTsyncStimuli8_C BypEtk_stAscet_C BypInt_adFunc_C BypInt_stAscet_C CaSCD_ctEdgOfs_C CaSCD_ctErrSync_C CaSCD_ctShftSync_C CaSCD_dSegSeries_C CaSCD_facPlausHigh_CUR CaSCD_facPlausLow_CUR CaSCD_nMinSpeed_C CaSCD_phiSegLen_C CaSCD_phiSegLenTolc_C CaSCD_phiSegOfs_C CaSCD_phiSpeedCalcTolc_C CaSCD_phiSpeedSegLen_C CaSCD_phiSpeedSegOfs_C CaSCD_stCalc_C CaSCD_stEdgeTrig_C CaSCD_stPinState_C CaSCD_stTPO_C CaSCD_tiPeriodRev1Max_C CaSCD_tiPeriodRev2Max_C CaSCD_tiTimOutOfs_C Chiste_stEnaTst_C CoDT_swtCoTypeType_C CoDT_swtCoTypeVal_C CoDT_trqMinInit_C CoEng_dtrqLimUp_C CoEng_dtrqLimUp1_C CoEng_ExtWaitMsk_C CoEng_ExtWaitMsk2_C CoEng_facAdjMax_C CoEng_nActrRelease_C CoEng_nShOffTstMax_C CoEng_nShOffTstMin_C CoEng_rhoFuel_C CoEng_stIRevShutOff_C CoEng_stRevShutOff_C CoEng_stShOffAddReqIRev_C CoEng_stShOffAddReqRev_C CoEng_stShOffAftRun_C CoEng_stShOffAirbFrnt_C CoEng_stShOffAirbRear_C CoEng_stShOffAirbSide_C CoEng_stShOffDblCtl_C CoEng_stShOffDiaReqFI_C CoEng_stShOffExtReq_C CoEng_stShOffFWOscDet_C CoEng_stShOffInit_C CoEng_stShOffInjMon_C CoEng_stShOffInjShCir_C CoEng_stShOffIRevSys1_C CoEng_stShOffIRevSys2_C CoEng_stShOffIRevVeh_C CoEng_stShOffIrrCmb_C CoEng_stShOffOvrSpd_C CoEng_stShOffPresMin_C CoEng_stShOffRevSys1_C CoEng_stShOffRevSys2_C CoEng_stShOffRevVeh_C CoEng_stShOffRlOvrBar_C CoEng_stShOffSV_C CoEng_stShOffTstSel_C CoEng_stSoftShOffAR_C CoEng_tiActrPrt_C CoEng_tiDlyT15_C CoEng_tiMinAftRun_C CoEng_tiOvrRunCoordDebPos_C CoEng_tiPwrStgDiaRdy_C CoEng_tiSoftShOff_CUR CoEng_trqOvrRunThres_C CoEng_trqSlpLim_Channel CoEng_trqSlpLim_Vector ConvCD_numDioIn_C CoVeh_trqPrpDes_Channel CoVeh_trqPrpDes_Vector CoVeh_trqPrpLead_Channel CoVeh_trqPrpLead_Vector CoVM_amMAX_C CoVM_swtPlausChkType_C CoVM_swtPlausChkVal_C CoVM_trqDecMax_C CoVM_trqIncMin_C CrCtl_stShutOffCodeMsk_C CrCtl_trqDes_Channel CrCtl_trqDes_Vector CrCtl_trqLead_Channel CrCtl_trqLead_Vector CrCtl_vTipStep_C CrSCD_ctGapIncs_C CrSCD_ctGaps_C CrSCD_ctIncs_C CrSCD_ctThresCtlMin_C CrSCD_ctTurns_C CrSCD_facGapPlausHigh_CUR CrSCD_facGapPlausLow_CUR CrSCD_facIncPlausHigh_CUR CrSCD_facIncPlausLow_CUR CrSCD_nFast_C CrSCD_nMax_C CrSCD_nMin_C CrSCD_nSlow_C CrSCD_nSlowHigh_C CrSCD_nThresCtlHigh_C CrSCD_nThresCtlLow_C CrSCD_numFBCSeg_C CrSCD_numShftMisf_C CrSCD_numTDCSeg_C CrSCD_phiGap2Zero_C CrSCD_phiIncCor_CUR CrSCD_phiSegLength_C CrSCD_phiSegPhase_C CrSCD_tiPlausCalcOff_C CrS_ctMaxInjStrt_C CrS_facSegTime_C CrS_facSegTimeMax_C CrS_facSegTimeMin_C CrS_phiSegLengthStrtSpd_C CrS_phiSegOfsStrtSpd_C CrS_phiSegOfsStrtSpdOld_C CTSCD_DebSigDef_C CTSCD_DebSRCHighDef_C CTSCD_DebSRCLowDef_C CTSCD_numAdc_C CTSCD_stSensIDWord_C DSM_DInDfp_EngMCaS1_C DSM_DInDfp_EngMCrS1_C DSM_DInDfp_FrmMngParkConsumer_C DSM_DInDfp_InjVlvBnk1A_C DSM_DInDfp_InjVlvBnk1B_C DSM_DInDfp_InjVlvBnk2A_C DSM_DInDfp_InjVlvBnk2B_C DSM_DInDfp_InjVlvChipA_C DSM_DInDfp_InjVlvChipB_C DSM_DInDfp_InjVlvCyl1A_C DSM_DInDfp_InjVlvCyl1B_C DSM_DInDfp_InjVlvCyl2A_C DSM_DInDfp_InjVlvCyl2B_C DSM_DInDfp_InjVlvCyl3A_C DSM_DInDfp_InjVlvCyl3B_C DSM_DInDfp_InjVlvCyl4A_C DSM_DInDfp_InjVlvCyl4B_C DSM_DInDfp_InjVlvCyl5A_C DSM_DInDfp_InjVlvCyl5B_C DSM_DInDfp_InjVlvCyl6A_C DSM_DInDfp_InjVlvCyl6B_C DSM_DInDfp_MeUnCD_ADC_C DSM_DInDfp_MeUnCDNoLoad_C DSM_DInDfp_MeUnCDSCBat_C DSM_DInDfp_MeUnCDSCGnd_C DSM_DInDfp_MeUnCD_SigTst_C DSM_DInDfp_MSidCD_Comm_C DSM_DInDfp_MSidCD_Pin_C DSM_DInDfp_MSidCD_Select_C DSM_DInDfp_MSidCD_Sel_INI_C DSM_DInDfp_PCVCD_ADC_C DSM_DInDfp_PCVCDNoLoad_C DSM_DInDfp_PCVCDSCBat_C DSM_DInDfp_PCVCDSCGnd_C DSM_DInDfp_PCVCD_SigTst_C DSM_DInDfp_RailCD_C DSM_DInDfp_RailCD_PMonStrt_C DSM_DInDfp_RailCtlModeMeUnDiag_C DSM_DInDfp_RailCtlModePCVDiag_C DSM_DInDfp_RailMeUn0_C DSM_DInDfp_RailMeUn1_C DSM_DInDfp_RailMeUn2_C DSM_DInDfp_RailMeUn3_C DSM_DInDfp_RailMeUn4_C DSM_DInDfp_RailPCV0_C DSM_DInDfp_RailPCV1_C DSM_DInDfp_RailPCV2_C DSM_DInDfp_RailPCV3_C DSM_DInDfp_RailPCV4_C DSM_DInDfp_RailPCV5_C DSM_DInDfp_RTMMon_C DSM_DInDfp_TPUMon_C DSM_InhDfp_ACC_PlausTrqDes_C DSM_InhDfp_ACTrq_C DSM_InhDfp_ADCMon_C DSM_InhDfp_AFSCD_PlSetyDrft_C DSM_InhDfp_AFSCD_SRCAirTemp_C DSM_InhDfp_AFSCD_SRCBatt_C DSM_InhDfp_AFSCD_SRCCorrAirm_C DSM_InhDfp_AFSCD_SRCRawAirm_C DSM_InhDfp_AFSCD_SRCRefSigPer_C DSM_InhDfp_AirCtl_GovNegDev_C DSM_InhDfp_AirCtl_GovNegDev2_C DSM_InhDfp_AirCtl_GovPosDev_C DSM_InhDfp_AirCtl_GovPosDev2_C DSM_InhDfp_AltCD_C DSM_InhDfp_AOHtCD_C DSM_InhDfp_APP1_C DSM_InhDfp_APP2_C DSM_InhDfp_APSCD_C DSM_InhDfp_ARS_C DSM_InhDfp_BPACD_Max_C DSM_InhDfp_BPACD_Min_C DSM_InhDfp_BPACD_SigNpl_C DSM_InhDfp_BPSCD_C DSM_InhDfp_BrkCD_C DSM_InhDfp_CmbChbMisfireMul_C DSM_InhDfp_CmbChbMisfire1_C DSM_InhDfp_CmbChbMisfire2_C DSM_InhDfp_CmbChbMisfire3_C DSM_InhDfp_CmbChbMisfire4_C DSM_InhDfp_CmbChbMisfire5_C DSM_InhDfp_CmbChbMisfire6_C DSM_InhDfp_ConvCD_C DSM_InhDfp_CrCCDMFL_C DSM_InhDfp_CrCtl_vCrCtl_C DSM_InhDfp_CTSCD_C DSM_InhDfp_EGRCD_Max_C DSM_InhDfp_EGRCD_Min_C DSM_InhDfp_EGRCD_SigNpl_C DSM_InhDfp_EngMCaS1_C DSM_InhDfp_EngMCrS1_C DSM_InhDfp_FanCD_C DSM_InhDfp_FanCD_FanCtlr1_C DSM_InhDfp_FBCqDvt_C DSM_InhDfp_FrmMngDMANFAFS_C DSM_InhDfp_FrmMngDRMANFSSG_C DSM_InhDfp_FrmMngLENKRADWINKEL_C DSM_InhDfp_FrmMngMILEAGE_RANGE_C DSM_InhDfp_FrmMngOPCRCTLACC_C DSM_InhDfp_FrmMngParkConsumer_C DSM_InhDfp_FrmMngSTAT_ARS_C DSM_InhDfp_FrmMngSTAT_DSC_C DSM_InhDfp_FrmMngSTAT_KOMBI_C DSM_InhDfp_FrmMngStOBDGbxMilOf_C DSM_InhDfp_FrmMngStOBDGbxMilOn_C DSM_InhDfp_FrmMngTERMINAL_C DSM_InhDfp_FrmMngTORQUE_DSC_C DSM_InhDfp_FrmMngTORQUE_GEARBX_C DSM_InhDfp_FrmMngWHEEL_SPEED_C DSM_InhDfp_FTSCD_C DSM_InhDfp_IATSCD_CATS_C DSM_InhDfp_ImmCtlImmCD_C DSM_InhDfp_ImmCtlImmEep_C DSM_InhDfp_ImmCtlMpl_C DSM_InhDfp_IndSys1_C DSM_InhDfp_IndSys2_C DSM_InhDfp_InjVlvBnk1A_C DSM_InhDfp_InjVlvBnk1B_C DSM_InhDfp_InjVlvBnk2A_C DSM_InhDfp_InjVlvBnk2B_C DSM_InhDfp_InjVlvChipA_C DSM_InhDfp_InjVlvChipB_C DSM_InhDfp_InjVlvCyl1A_C DSM_InhDfp_InjVlvCyl1B_C DSM_InhDfp_InjVlvCyl2A_C DSM_InhDfp_InjVlvCyl2B_C DSM_InhDfp_InjVlvCyl3A_C DSM_InhDfp_InjVlvCyl3B_C DSM_InhDfp_InjVlvCyl4A_C DSM_InhDfp_InjVlvCyl4B_C DSM_InhDfp_InjVlvCyl5A_C DSM_InhDfp_InjVlvCyl5B_C DSM_InhDfp_InjVlvCyl6A_C DSM_InhDfp_InjVlvCyl6B_C DSM_InhDfp_MeUnCD_ADC_C DSM_InhDfp_MeUnCDNoLoad_C DSM_InhDfp_MeUnCDSCBat_C DSM_InhDfp_MeUnCDSCGnd_C DSM_InhDfp_MeUnCD_SigTst_C DSM_InhDfp_Montr_C DSM_InhDfp_MSidCD_Comm_C DSM_InhDfp_MSidCD_Pin_C DSM_InhDfp_MSidCD_Select_C DSM_InhDfp_MSidCD_Sel_INI_C DSM_InhDfp_OvRMonBrk_C DSM_InhDfp_PCR_GovDevNeg_C DSM_InhDfp_PCR_GovDevPos_C DSM_InhDfp_PCVCD_ADC_C DSM_InhDfp_PCVCDNoLoad_C DSM_InhDfp_PCVCDSCBat_C DSM_InhDfp_PCVCDSCGnd_C DSM_InhDfp_PCVCD_SigTst_C DSM_InhDfp_RailCD_C DSM_InhDfp_RailCDOfsTst_C DSM_InhDfp_RailCD_PMonStrt_C DSM_InhDfp_RailCtlModeMeUnDiag_C DSM_InhDfp_RailCtlModePCVDiag_C DSM_InhDfp_RailMeUn0_C DSM_InhDfp_RailMeUn1_C DSM_InhDfp_RailMeUn2_C DSM_InhDfp_RailMeUn3_C DSM_InhDfp_RailMeUn4_C DSM_InhDfp_RailPCV0_C DSM_InhDfp_RailPCV1_C DSM_InhDfp_RailPCV2_C DSM_InhDfp_RailPCV3_C DSM_InhDfp_RailPCV4_C DSM_InhDfp_RailPCV5_C DSM_InhDfp_RTMMon_C DSM_InhDfp_SOPTst_C DSM_InhDfp_SSpMon1_C DSM_InhDfp_SSpMon2_C DSM_InhDfp_SSpMon3_C DSM_InhDfp_SysLamp_C DSM_InhDfp_TGearbx_C DSM_InhDfp_TPUMon_C DSM_InhDfp_T15CD_C DSM_InhDfp_VSACD_Max_C DSM_InhDfp_VSACD_Min_C DSM_InhDfp_VSACD_SigNpl_C DSM_InhDfp_VSSCD1_C DSM_InhDfp_VSSCD2_C DSM_SdwDfp_APP2_C DSM_SdwDfp_FrmMngDRMANFSSG_C DSM_SdwDfp_FrmMngOPCRCTLACC_C DSM_SdwDfp_FrmMngTORQUE_DSC_C DSM_SdwDfp_FrmMngTORQUE_GEARBX_C DSM_SdwDfp_FrmMngTrq_ReqACC_C EATSCD_numAdc_C EBAFCD_numDiaOut_C EBAFCD_numDioOut_C EBFCD_numDiaOut_C EBFCD_numDioOut_C EBTSCD_DebSRCHighDef_C EBTSCD_DebSRCLowDef_C EBTSCD_dtRmpSlpDwn_C EBTSCD_dtRmpSlpUp_C EBTSCD_numAdc_C EBTSCD_OvrDebSRCHighDef_C EBTSCD_stSensIDWord_C EBTSCD_tDfl_C EBTSCD_tiTECUPT1_C EBTSCD_tLin_CUR EBTSCD_tOvrTemp_C EBTSCD_uSRCMax_C EBTSCD_uSRCMin_C ECU_vPrgThres_C EGPpCD_numDia_C EGPpCD_numDioOut_C EGRCD_DebExcTempDef_C EGRCD_DebNoLoadDef_C EGRCD_DebShortCircBatDef_C EGRCD_DebShortCircGndDef_C EGRCD_numDia_C EGRCD_numPwmOut_C EGRCD_stPwrStgDia_C EGRVlv_rEGR_Channel EGRVlv_rEGR_Vector EGRVlv_rEGR2_Channel EGRVlv_rEGR2_Vector EGSys_swtPresSel_C EGT_stTSync_Channel EGT_stTSync_Vector EngM_ctOfsCaSCrS_C EngM_ctPhWhlRev_C EngM_ctPostSync_C EngM_ctReSync_C EngM_ctSpdtoZero_C EngM_ctVerSync_C EngM_DebIncCaSErrSigDef_C EngM_DebIncCaSErrSigOK_C EngM_DebIncCaSNoSigDef_C EngM_DebIncCrSErrSigDef_C EngM_DebIncCrSErrSigOK_C EngM_DebIncOfsSigCaSCrSDef_C EngM_DebPhCrSErrSigDef_C EngM_dLimitCond_ASD_CA EngM_dLimitCond_Common_CA EngM_dLimitCond_FBC_CA EngM_dLimitCond_Joint_CA EngM_dLimitCond_LiGov_CA EngM_dLimitCond_Pilot_CA EngM_nLimitInj_C EngM_nLimitThresh_CA EngM_nLimitThreshHyst_CA EngM_nMaxStrtBackUp_C EngM_nMaxStrt_C EngM_nMinDiag_C EngM_nSwtCoMa_C EngM_numDiaOut_C EngM_numDioOut_C EngM_numLimitInj_C EngM_numPin_C EngM_nWaitIncSig_C EngM_phiDelayPhNoSig_C EngM_phiDelta_C EngM_phiDeltaExtSync_C EngM_phiFrstInjInt_C EngM_phiInt_C EngM_phiMax_C EngM_phiTDC_C EngM_stBackUpVar_C EngM_stEnaBackUp_C EngM_stSyncBefGap_C EngM_swtExitOfs_C EngM_swtFirSeqFBC_C EngM_swtNumCylType_C EngM_swtNumCylVal_C EngM_swtSyncViaCAN_C EngM_tiCpuTimeOut_C EngM_tiDiffInt_C EngM_tiWaitIncSig_C EngM_trqFrc_Channel EngM_trqFrc_Vector EngPrt_nOvrSpd_C EngPrt_qPrtLim_Channel EngPrt_qPrtLim_Vector EngPrt_trqNLim_Channel EngPrt_trqNLim_Vector EngPrt_trqPrtLim_Channel EngPrt_trqPrtLim_Vector ErLpCD_numDiaErrLmp_C ErLpCD_numDiaSysLmp_C ErLpCD_numDioOutErrLmp_C ErLpCD_numDioOutSysLmp_C ESS_nBattMin_C ETClb_DebETMaxDefect_C ETClb_DebETMaxOk_C ETClb_DebETMinDefect_C ETClb_DebETMinOk_C ETClb_numCyclMeas_C ETClb_numCyclStartEnergize_C ETClb_pRailSet_CA ETClb_SigThres_CA ETClb_tiET_MAX_CA ETClb_tiET_MIN_CA ETClb_volEffectiveMin_CA ExeMon_stEnaTst_C FanCD_DebShortCircGndDef_C FanCD_numDia_C FanCD_numPwmOut_C FanCD_tiBtwTst_C FanCD_tiFanCtlr2Max_C FanCD_tiFanCtlr2Min_C FanCD_tiFanCtlr3Max_C FanCD_tiFanCtlr3Min_C FBC_lrn_Channel FBC_lrn_Vector FBC_q_Channel FBC_q_Vector FlFCD_numDioIn_C FlMng_swtFullLdRglType_C FlMng_swtFullLdRglVal_C FlSys_nDeflateMax_C FlSys_nDeflateMin_C FlSys_pDeflate_C FlSys_rhoFl_C FlSys_rhoFl_CUR FlSys_swtTempSensCfgType_C FlSys_tiDeflateDel_C FMTC_trq2qBas_MAP FMTC_trq2qRgn1_MAP FMTC_trq2qRgn2_MAP FrmMng_aSideDef_C FrmMng_cnvAccmLimTrq_Offset_C FrmMng_cnvAccmLimTrq_Slope_C FrmMng_cnvACCtrq_Offset_C FrmMng_cnvACCtrq_Slope_C FrmMng_cnvAFStrq_Offset_C FrmMng_cnvAFStrq_Slope_C FrmMng_cnvAipEng_Offset_C FrmMng_cnvAipEng_Slope_C FrmMng_cnvAngAcpd_Offset_C FrmMng_cnvAngAcpd_Slope_C FrmMng_cnvARStrq_Offset_C FrmMng_cnvARStrq_Slope_C FrmMng_cnvAVA_DSC_Offset_C FrmMng_cnvAVA_DSC_Slope_C FrmMng_cnv_BattCls_Offset_C FrmMng_cnv_BattCls_Slope_C FrmMng_cnvDSCtrq_Offset_C FrmMng_cnvDSCtrq_Slope_C FrmMng_cnvFLLV_FUTA_Offset_C FrmMng_cnvFLLV_FUTA_Slope_C FrmMng_cnv_HiLimCurr_Offset_C FrmMng_cnv_HiLimCurr_Slope_C FrmMng_cnvIjvFu_Offset_C FrmMng_cnvIjvFu_Slope_C FrmMng_cnvKOMBIv_Offset_C FrmMng_cnvKOMBIv_Slope_C FrmMng_cnv_LoLimCurr_Offset_C FrmMng_cnv_LoLimCurr_Slope_C FrmMng_cnvnSetPoint_OffSet_C FrmMng_cnvnSetPoint_Slope_C FrmMng_cnvRpmEng_Offset_C FrmMng_cnvRpmEng_Slope_C FrmMng_cnvRqamFu_Offset_C FrmMng_cnvRqamFu_Slope_C FrmMng_cnvTempEng_Offset_C FrmMng_cnvTempEng_Slope_C FrmMng_cnvTEMP_EX_Offset_C FrmMng_cnvTEMP_EX_Slope_C FrmMng_cnvtOil_Offset_C FrmMng_cnvtOil_Slope_C FrmMng_cnvTrqAvl_Offset_C FrmMng_cnvTrqAvl_Slope_C FrmMng_cnvTrqDvch_Offset_C FrmMng_cnvTrqDvch_Slope_C FrmMng_cnvtrq_Offset_C FrmMng_cnvtrq_Slope_C FrmMng_cnvvMrk_Offset_C FrmMng_cnvvMrk_Slope_C FrmMng_cnvvPrgNo_Offset_C FrmMng_cnvvPrgNo_Slope_C FrmMng_cnvV_VEH_Offset_C FrmMng_cnvV_VEH_Slope_C FrmMng_cnv_ZrCurrLim_Offset_C FrmMng_cnv_ZrCurrLim_Slope_C FrmMng_ctDebAlvDMANFAFSDef_C FrmMng_ctDebCsDMANFAFSDef_C FrmMng_ctDebSigDMANFAFSDef_C FrmMng_ctDebToDMANFAFSDef_C FrmMng_ctDebToWHEEL_SPEEDDef_C FrmMng_DebACTrqDef_C FrmMng_DebAlvDMOMENT_ACCDef_C FrmMng_DebAlvOPCRCTLACCDef_C FrmMng_DebAlvSTAT_ARSDef_C FrmMng_DebAlvSTAT_KOMBIDef_C FrmMng_DebAlvTORQUE_DSCDef_C FrmMng_DebAlvTORQUE_GEARBXDef_C FrmMng_DebCsDMOMENT_ACCDef_C FrmMng_DebCsOPCRCTLACCDef_C FrmMng_DebCsTORQUE_DSCDef_C FrmMng_DebCsTORQUE_GEARBXDef_C FrmMng_DebSigDMOMENT_ACCDef_C FrmMng_DebSigMILEAGE_RANGEDef_C FrmMng_DebSigOPCRCTLACCDef_C FrmMng_DebSigSTAT_ARSDef_C FrmMng_DebSigSTAT_DSCDef_C FrmMng_DebSigSTAT_KOMBIDef_C FrmMng_DebSigTORQUE_DSCDef_C FrmMng_DebSigTORQUE_GEARBXDef_C FrmMng_DebToDMOMENT_ACCDef_C FrmMng_DebToMILEAGE_RANGEDef_C FrmMng_DebToOPCRCTLACCDef_C FrmMng_DebToSTAT_ARSDef_C FrmMng_DebToSTAT_DSCDef_C FrmMng_DebToSTAT_KOMBIDef_C FrmMng_DebToTORQUE_DSCDef_C FrmMng_DebToTORQUE_GEARBXDef_C FrmMng_dstGear_C FrmMng_dtrqOvrRunRmpDwn_C FrmMng_numCCAddLevlNum_C FrmMng_numCCbtnachNum_C FrmMng_numCCbttdfkNum_C FrmMng_numCCbttkntNum_C FrmMng_numCCGenDef2Num_C FrmMng_numCCNoCrCtlNum_C FrmMng_numCCOelLevlNum_C FrmMng_numCCOelVerbNum_C FrmMng_numCCOelVerlNum_C FrmMng_numCCOilPresNum_C FrmMng_numCCOvrTempNum_C FrmMng_numCCOvrTem2Num_C FrmMng_numCCPFltDefNum_C FrmMng_numCCpmerrNum_C FrmMng_numCCPreGlowNum_C FrmMng_numCCprioNum_C FrmMng_numCCruhverNum_C FrmMng_numCCStatMilLmpTstNum_C FrmMng_numCCSysLampNum_C FrmMng_numInqyID_C FrmMng_stClCtrDEF_C FrmMng_stConvErr_C FrmMng_stT50Def_C FrmMng_swtDMOMENT_ACC_C FrmMng_swtDRMANFSSG_C FrmMng_tiCCAddLevlCycle_C FrmMng_tiCCbtnachCycle_C FrmMng_tiCCbttdfkCycle_C FrmMng_tiCCbttkntCycle_C FrmMng_tiCCGenDef2Cycle_C FrmMng_tiCCNoCrCtlCycle_C FrmMng_tiCCOelLevlCycle_C FrmMng_tiCCOelVerbCycle_C FrmMng_tiCCOelVerlCycle_C FrmMng_tiCCOilPresCycle_C FrmMng_tiCCOvrTempCycle_C FrmMng_tiCCOvrTem2Cycle_C FrmMng_tiCCPFltDefCycle_C FrmMng_tiCCpmerrCycle_C FrmMng_tiCCPreGlowCycle_C FrmMng_tiCCprioCycle_C FrmMng_tiCCruhverCycle_C FrmMng_tiCCStatMilCycle_C FrmMng_tiCCStatMilLmpTstCycle_C FrmMng_tiCCSysLampCycle_C FrmMng_tiCCTxDeb_C FrmMng_trqGearbxMaxSubs_C FTSCD_numAdc_C Gearbx_amMax_C Gearbx_nMin_MAP Gearbx_rTransR_C Gearbx_rTrans1_C Gearbx_rTrans2_C Gearbx_rTrans3_C Gearbx_rTrans4_C Gearbx_rTrans5_C Gearbx_rTrans6_C Gearbx_swtUnplausChk_C Gearbx_trqDecMax_C Gearbx_trqDecMax_CUR Gearbx_trqInMax_Channel Gearbx_trqInMax_Vector GearCD_numDioIn_C HPUn_nMin_C HPUn_pRailDvtOk_C HPUn_qBalLim_CUR HPUn_qFlTempLim_MAP HWEMon_DebComDef_C HWEMon_DebComOk_C HWEMon_DebComStepDown_C HWEMon_DebComStepUp_C HWEMon_numTrigRecovery_C IATSCD_DebSigDef_C IATSCD_DebSRCHighDef_C IATSCD_DebSRCLowDef_C IATSCD_numAdc_C IATSCD_numAdcCats_C IndSys_rVSAAdd_Channel IndSys_rVSAAdd_Vector IndSys_rVSA_Channel IndSys_rVSA_Vector InjCrv_DebLimDef_C InjCrv_DebLimOk_C InjCrv_numInjMaxSys_C InjCrv_phiMI1DesAdd_Channel InjCrv_phiMI1DesAdd_Vector InjCrv_phiMI1Des_Channel InjCrv_phiMI1Des_Vector InjCrv_phiMI1Max_MAP InjCrv_phiMI1Rgn_Channel InjCrv_phiMI1Rgn_Vector InjCrv_phiPiIMax_C InjCrv_phiPiI1DesAdd_Channel InjCrv_phiPiI1DesAdd_Vector InjCrv_phiPiI1Des_Channel InjCrv_phiPiI1Des_Vector InjCrv_phiPiI1Rgn_Channel InjCrv_phiPiI1Rgn_Vector InjCrv_phiPiI2DesAdd_Channel InjCrv_phiPiI2DesAdd_Vector InjCrv_phiPiI2Des_Channel InjCrv_phiPiI2Des_Vector InjCrv_phiPiI2Rgn_Channel InjCrv_phiPiI2Rgn_Vector InjCrv_phiPiI3DesAdd_Channel InjCrv_phiPiI3DesAdd_Vector InjCrv_phiPiI3Des_Channel InjCrv_phiPiI3Des_Vector InjCrv_phiPoI1DesAdd_Channel InjCrv_phiPoI1DesAdd_Vector InjCrv_phiPoI1Des_Channel InjCrv_phiPoI1Des_Vector InjCrv_phiPoI1Max_C InjCrv_phiPoI1Rgn_Channel InjCrv_phiPoI1Rgn_Vector InjCrv_phiPoI2_Channel InjCrv_phiPoI2Min_C InjCrv_phiPoI2Rgn_Channel InjCrv_phiPoI2Rgn_Vector InjCrv_phiPoI2_Vector InjCrv_qMI1DesAdd_Channel InjCrv_qMI1DesAdd_Vector InjCrv_qMI1Des_Channel InjCrv_qMI1Des_Vector InjCrv_qMI1Rgn_Channel InjCrv_qMI1Rgn_Vector InjCrv_qPiI1DesAdd_Channel InjCrv_qPiI1DesAdd_Vector InjCrv_qPiI1Des_Channel InjCrv_qPiI1Des_Vector InjCrv_qPiI1Rgn_Channel InjCrv_qPiI1Rgn_Vector InjCrv_qPiI1SetByp_Channel InjCrv_qPiI1SetByp_Vector InjCrv_qPiI2DesAdd_Channel InjCrv_qPiI2DesAdd_Vector InjCrv_qPiI2Des_Channel InjCrv_qPiI2Des_Vector InjCrv_qPiI2Rgn_Channel InjCrv_qPiI2Rgn_Vector InjCrv_qPiI2SetByp_Channel InjCrv_qPiI2SetByp_Vector InjCrv_qPiI3DesAdd_Channel InjCrv_qPiI3DesAdd_Vector InjCrv_qPiI3Des_Channel InjCrv_qPiI3Des_Vector InjCrv_qPoI1DesAdd_Channel InjCrv_qPoI1DesAdd_Vector InjCrv_qPoI1Des_Channel InjCrv_qPoI1Des_Vector InjCrv_qPoI1Rgn_Channel InjCrv_qPoI1Rgn_Vector InjCrv_qPoI2Des_Channel InjCrv_qPoI2Des_Vector InjCrv_qPoI2Eff_Channel InjCrv_qPoI2Eff_Vector InjCrv_qPoI2Rgn_Channel InjCrv_qPoI2Rgn_Vector InjCrv_stInjCharSetVal_Channel InjCrv_stInjCharSetVal_Vector InjCrv_stPiIRlsBypass_Channel InjCrv_stPiIRlsBypass_Vector InjCrv_tiPause_C InjCrv_tiPiIMax_C InjCrv_tiPiI1DesAdd_Channel InjCrv_tiPiI1DesAdd_Vector InjCrv_tiPiI1Des_Channel InjCrv_tiPiI1Des_Vector InjCrv_tiPiI1Rgn_Channel InjCrv_tiPiI1Rgn_Vector InjCrv_tiPiI2DesAdd_Channel InjCrv_tiPiI2DesAdd_Vector InjCrv_tiPiI2Des_Channel InjCrv_tiPiI2Des_Vector InjCrv_tiPiI2Rgn_Channel InjCrv_tiPiI2Rgn_Vector InjCrv_tiPoI2_Channel InjCrv_tiPoI2Max_MAP InjCrv_tiPoI2Min_C InjCrv_tiPoI2Rgn_Channel InjCrv_tiPoI2Rgn_Vector InjCrv_tiPoI2_Vector InjCtl_qCurr_Channel InjCtl_qCurr_Vector InjCtl_qLimErr_CUR InjCtl_qLimErr_MAP InjCtl_qRaw_Channel InjCtl_qRaw_Vector InjCtl_qSet_Channel InjCtl_qSet_Vector InjUn_nInjLock_C InjUn_phiTstShOffPathSet_C InjUn_tiTstShOffPathET_C InjVCD_nETMaxLim_C InjVCD_rZFCETDif2_GMAP InjVCD_stInjMode_C InjVCD_swtEnaAgDiff_C InjVCD_tiET_MAP InjVCD_tiETMax_C InjVCD_tiETMinHigh_C InjVCD_tiMI1ET_Channel InjVCD_tiMI1ET_Vector InjVCD_tiPickUpCurrBattLo_C InjVCD_tiPickUpCurr_CUR InjVCD_tiPiI1ET_Channel InjVCD_tiPiI1ET_Vector InjVCD_tiPiI2ET_Channel InjVCD_tiPiI2ET_Vector InjVCD_tiPoI1ET_Channel InjVCD_tiPoI1ET_Vector InjVCD_tiPoI2ET_Channel InjVCD_tiPoI2ET_Vector InjVCD_uThresDeltaHi_C InjVCD_uThresLo_C InjVlv_DebBnkA0Def_C InjVlv_DebBnkA0Ok_C InjVlv_DebBnkA1Def_C InjVlv_DebBnkA1Ok_C InjVlv_DebBnkA2Def_C InjVlv_DebBnkA2Ok_C InjVlv_DebBnkA3Def_C InjVlv_DebBnkA3Ok_C InjVlv_DebBnkB0Def_C InjVlv_DebBnkB0Ok_C InjVlv_DebBnkB1Def_C InjVlv_DebBnkB1Ok_C InjVlv_DebBnkB2Def_C InjVlv_DebBnkB2Ok_C InjVlv_DebBnkB3Def_C InjVlv_DebBnkB3Ok_C InjVlv_DebChipA0Def_C InjVlv_DebChipA0Ok_C InjVlv_DebChipA1Def_C InjVlv_DebChipA1Ok_C InjVlv_DebChipA2Def_C InjVlv_DebChipA2Ok_C InjVlv_DebChipA3Def_C InjVlv_DebChipA3Ok_C InjVlv_DebChipB0Def_C InjVlv_DebChipB0Ok_C InjVlv_DebChipB1Def_C InjVlv_DebChipB1Ok_C InjVlv_DebChipB2Def_C InjVlv_DebChipB2Ok_C InjVlv_DebChipB3Def_C InjVlv_DebChipB3Ok_C InjVlv_DebCylA0Def_C InjVlv_DebCylA0Ok_C InjVlv_DebCylA1Def_C InjVlv_DebCylA1Ok_C InjVlv_DebCylA2Def_C InjVlv_DebCylA2Ok_C InjVlv_DebCylA3Def_C InjVlv_DebCylA3Ok_C InjVlv_DebCylB0Def_C InjVlv_DebCylB0Ok_C InjVlv_DebCylB1Def_C InjVlv_DebCylB1Ok_C InjVlv_DebCylB2Def_C InjVlv_DebCylB2Ok_C InjVlv_DebCylB3Def_C InjVlv_DebCylB3Ok_C InjVlv_iLvlHi1_C InjVlv_iLvlHi2_C InjVlv_numInjChrgBal_MAP InjVlv_numNoLoadCylMax_C InjVlv_pMin_C InjVlv_pMin_CUR InjVlv_qWvCorMax_C InjVlv_qWvCorMin_C InjVlv_rChrgBalEngSpdHys_C InjVlv_rChrgBalVltgHys_C InjVlv_stErrMskPattern_C InjVlv_stErrMskSelect_C InjVlv_stInj_C InjVlv_stRatRchgOff_C InjVlv_stRegCfg_C InjVlv_stRegDcc_C InjVlv_stRegDmsk_C InjVlv_stRegMode_C InjVlv_stTiBstErrMax_C InjVlv_stTiBstErrMin_C InjVlv_stTiCY330Del_C InjVlv_stTiDelAftFastIDec_C InjVlv_stTiDelAftRchg_C InjVlv_stTiDelBefLSMode_C InjVlv_stTiFastIDecErrMax_C InjVlv_stTiInjMax_C InjVlv_stTiMaxRchg_C InjVlv_uCMax_C InjVlv_uCMin_C InjVlv_uCSetPoint_C InjVlv_uCThresBstStop_C InjVlv_volQntAdjLim_C LIGov_nDeltaSec_C LIGov_nDiffDelta_C LIGov_nLimHigh_C LIGov_nMSDiffMax_C LIGov_nRampBaseDwn_C LIGov_nRampSurgeDwn_C LIGov_nSetpoint_Vector LIGov_trq_Channel LIGov_trq_Vector LSUCD_facPresCompLean_CUR LSUCD_facPresCompRich_CUR LSUCD_facUToRi_C LSUCD_rO2_CUR LSUCD_stHtDis_C LSUCD_stPumpCtlDis_C LSUCD_stPwrStgDia_C LSUCD_stRefPumpDis_C LSUCD_tiHtPer_C LSUCD_tRi_CUR LSUCD_uBattMaxHigh_C LSUCD_uBattMaxLow_C LSUCD_uBattNominal_C LSUCD_uO2Ref_C LSUCD_uRiOfs_C LSUCtl_dcycHtMin_C LSUCtl_dcycRmpUp_C LSUCtl_dcycStrt_CUR LSUCtl_tRiSetPoint_C LSU_rLmbdRec_CUR MemMon_numErrChkRam_C MemMon_numErrChkRom_C MemMon_tiHealChkRam_C MemMon_tiHealChkRom_C MeUnCD_dcycMax_C MeUnCD_dcycMin_C MeUnCD_dcycSetValLin_CUR MeUnCD_dcycTst_C MeUnCD_DebExcTempDef_C MeUnCD_DebExcTempOk_C MeUnCD_DebNoLoadDef_C MeUnCD_DebNoLoadOk_C MeUnCD_DebShortCircBatDef_C MeUnCD_DebShortCircBatOk_C MeUnCD_DebShortCircGndDef_C MeUnCD_DebShortCircGndOk_C MeUnCD_DebSRCHighDef_C MeUnCD_DebSRCHighOk_C MeUnCD_DebSRCLowDef_C MeUnCD_DebSRCLowOk_C MeUnCD_facIGovInit_CUR MeUnCD_facIGovMax_C MeUnCD_facIGovMin_C MeUnCD_IGovDKd_C MeUnCD_IGovIKi_C MeUnCD_IGovIKiNeg_C MeUnCD_IGovIKiPos_C MeUnCD_iIGovIWinNeg_C MeUnCD_iIGovIWinPos_C MeUnCD_iLin_CUR MeUnCD_nDiffMax_C MeUnCD_numAdc_C MeUnCD_numDia1_C MeUnCD_numDia2_C MeUnCD_numPwmOut_C MeUnCD_resCoil_C MeUnCD_stInvOut_C MeUnCD_stPwrStgDia_C MeUnCD_swt_C MeUnCD_tiBtwTst_C MeUnCD_tiFltPT1Init_C MeUnCD_tiFlt1PT1_C MeUnCD_tiFlt2PT1_C MeUnCD_tiIGovDT1_C MeUnCD_tiIGovInit_C MeUnCD_tiPer_CUR MeUnCD_uSRCMax_C MeUnCD_uSRCMin_C MeUn_iCnvFlowRate_CUR MeUn_iSet_Channel MeUn_iSetMin_C MeUn_iSet_Vector MeUn_pActrPrt_C MeUn_pFlowOfFl_C MRlyCD_ctTooEarlyThres_C MRlyCD_numDioOutMnRly_C MRlyCD_numDioOutPSOFF_C MRlyCD_stInvOut_C MRlyCD_tiNotOpen_C MSidCD_Comm_DebNplDef_C MSidCD_numECUS_C MSidCD_Select_DebNplDef_C MSidCD_Select_DebNplOk_C MSidCD_stErrInjOFF_C MSidCD_swtCanDeb_C MSidCD_swtMAIN_C MSidCD_tiCanDeb_C NetMng_CANFadeOutMaskA_C NetMng_CANFadeOutMaskB_C NetMng_ctBusOffRetriesA_C NetMng_ctBusOffRetriesB_C NetMng_ctInitRetryCanA_C NetMng_ctInitRetryCanB_C NetMng_FadeOutMaskA_C NetMng_FadeOutMaskB_C NetMng_SplyVltgHysYHigh_C NetMng_SplyVltgHysYLow_C NetMng_swtONWM_C NetMng_tiDebNegBusMonCanA_C NetMng_tiDebNegBusMonCanB_C NetMng_tiDebNegBusOffCanA_C NetMng_tiDebNegBusOffCanB_C NetMng_tiDebNegErrCanA_C NetMng_tiDebNegErrCanB_C NetMng_tiDebNegMonCanA_C NetMng_tiDebNegMonCanB_C NetMng_tiDebPosBusMonCanA_C NetMng_tiDebPosBusMonCanB_C NetMng_tiDebPosBusOffCanA_C NetMng_tiDebPosBusOffCanB_C NetMng_tiDebPosErrCanA_C NetMng_tiDebPosErrCanB_C NetMng_tiDebPosMonCanA_C NetMng_tiDebPosMonCanB_C NetMng_tiFadeoutLowBat_C NetMng_tiRecoverA_C NetMng_tiRecoverB_C NSC_numPrio_C NSC_st_C OPSCD_DebSRCLoDef_C OPSCD_numAdc_C OPSCD_numDia_C OPSCD_numDioOut_C OPSCD_uSRCMax_C OPSCD_uSRCMin_C OTSCD_DebNplDef_C OTSCD_DebSigDef_C OTSCD_DebSRCHighDef_C OTSCD_DebSRCLowDef_C OTSCD_numAdc_C OTSCD_uSRCMax_C OTSCD_uSRCMin_C OvRMon_ctEngSpdGrad_C OvRMon_DebETDef_C OvRMon_DebSigA0Def_C OvRMon_facInjEff_MAP OvRMon_nDiffMax_C OvRMon_nLIGovLim_C OvRMon_nMin_C OvRMon_nSegMin_C OvRMon_nStSysLim_C OvRMon_nThresNrml2Strt_C OvRMon_numBrkDioInMn_C OvRMon_numBrkDioInRed_C OvRMon_stBrkMnSwtInvIn_C OvRMon_stBrkRedSwtInvIn_C OvRMon_stDebCnt_C OvRMon_stIntrInit_C OvRMon_swtBrkRedSwtPresent_C OvRMon_swtBrkSigVal_C OvRMon_tiAPP1Flt_C OvRMon_tiASDdc_C OvRMon_tiBrkMnSwtDebPos_C OvRMon_tiBrkRedSwtDebPos_C OvRMon_tiCompAcsTemp_C OvRMon_tiCrCtlBrkRmp_C OvRMon_tiCrCtlConvRmp_C OvRMon_tiDebBrk_C OvRMon_tiDebConv_C OvRMon_tiDebT15_C OvRMon_tiErrAPP_C OvRMon_tiErrDblStorage_C OvRMon_tiLimET_MAP OvRMon_tiSegMin_C OvRMon_trqThresASDdc_C OvRMon_uAPPFull_C OvRMon_uAPP1Lim_C OvRMon_uPlaWinFull_C OvRMon_uPlaWinIdle_C PCR_dnSurgeSlpDwn_C PCR_dnSurgeSlpUp_C PCR_nCoStart_C PCR_nCoStrtHigh_C PCR_nLIGovBase_C PCR_nSurgeMon1_C PCR_nSurgeMon2_C PCR_pBGDevMaxOffset_C PCR_pBGDevMinOffset_C PCR_pDesAdd_Channel PCR_pDesAdd_Vector PCR_pDes_Channel PCR_pDes_Vector PCR_rBPACDAdd_Channel PCR_rBPACDAdd_Vector PCR_rBPACD_Channel PCR_rBPACD_Vector PCR_rSurgeHigh_MAP PCR_swtRelAbsType_C PCR_swtRelAbsVal_C PCR_tiCoStrt_CUR PCR_tiStrtDelayInit_C PCR_tiSurgeMonLIGov_C PCR_vSurgeLIGov_C PCVCD_dcycMax_C PCVCD_dcycMin_C PCVCD_dcycTst_C PCVCD_DebExcTempDef_C PCVCD_DebExcTempOk_C PCVCD_DebNoLoadDef_C PCVCD_DebNoLoadOk_C PCVCD_DebShortCircBatDef_C PCVCD_DebShortCircBatOk_C PCVCD_DebShortCircGndDef_C PCVCD_DebShortCircGndOk_C PCVCD_DebSRCHighDef_C PCVCD_DebSRCHighOk_C PCVCD_DebSRCLowDef_C PCVCD_DebSRCLowOk_C PCVCD_facIGovInit_CUR PCVCD_facIGovMax_C PCVCD_facIGovMin_C PCVCD_IGovDKd_C PCVCD_IGovIKi_C PCVCD_IGovIKiNeg_C PCVCD_IGovIKiPos_C PCVCD_iIGovIWinNeg_C PCVCD_iIGovIWinPos_C PCVCD_iLin_CUR PCVCD_numAdc_C PCVCD_numDia1_C PCVCD_numDia2_C PCVCD_numPwmOut_C PCVCD_resCoil_C PCVCD_stInvOut_C PCVCD_stPwrStgDia_C PCVCD_swt_C PCVCD_swtCtlStateType_C PCVCD_swtCtlStateVal_C PCVCD_tiBtwTst_C PCVCD_tiFltPT1Init_C PCVCD_tiFlt1PT1_C PCVCD_tiFlt2PT1_C PCVCD_tiIGovDT1_C PCVCD_tiIGovInit_C PCVCD_tiPer_C PCVCD_uSRCMax_C PCVCD_uSRCMin_C PCV_dvolLeak_CUR PCV_iCnvPress_CUR PCV_iSet_Channel PCV_iSetMin_C PCV_iSet_Vector PFLTCD_numAdc_C PFLTCD_numAdc2_C PFlt_dvol_Channel PFlt_dvol_Vector PFlt_resFlow_Channel PFlt_resFlow_Vector PFlt_st_Channel PFlt_stEngPOp_Channel PFlt_stEngPOp_Vector PFlt_st_Vector RailCD_DebSRCHighDef_C RailCD_DebSRCHighOk_C RailCD_DebSRCLowDef_C RailCD_DebSRCLowOk_C RAILCD_numAdc_C RAILCD_numAdc2_C RailCD_pLin_CUR RailCD_swtOfsTst_C RailCD_tiEvalDel_C RailCD_tiOfsTstAftRun_C RailCD_tiOfsTstStrt_C RailCD_uSRCMax_C RailCD_uSRCMin_C Rail_DebMeUn0MaxDef_C Rail_DebMeUn0MaxOk_C Rail_DebMeUn1MaxDef_C Rail_DebMeUn1MaxOk_C Rail_DebMeUn2MaxDef_C Rail_DebMeUn2MaxOk_C Rail_DebMeUn3MaxDef_C Rail_DebMeUn3MaxOk_C Rail_DebMeUn4MaxDef_C Rail_DebMeUn4MaxOk_C Rail_DebPCV0MaxDef_C Rail_DebPCV0MaxOk_C Rail_DebPCV1MaxDef_C Rail_DebPCV1MaxOk_C Rail_DebPCV2MaxDef_C Rail_DebPCV2MaxOk_C Rail_DebPCV3MaxDef_C Rail_DebPCV3MaxOk_C Rail_DebPCV4MaxDef_C Rail_DebPCV4MaxOk_C Rail_DebPCV5MaxDef_C Rail_DebPCV5MaxOk_C Rail_dpSetPointDec_C Rail_dpSetPointInc_MAP Rail_dvolMeUnCtlLoLim_C Rail_dvolMeUnCtlUpLim_CUR Rail_dvolMeUnSet_Channel Rail_dvolMeUnSetMin_C Rail_dvolMeUnSet_Vector Rail_dvolOff_C Rail_dvolPreCtlCor_Channel Rail_dvolPreCtlCor_Vector Rail_dvolPreCtlPoI1_MAP Rail_dvolPreCtlPoI2_MAP Rail_dvolRedOfsLim_C Rail_dvolStrt_C Rail_facLeakAged_C Rail_facOvrMeUnNegIncr_C Rail_facOvrPCVNegIncr_C Rail_nMonEnaMax_C Rail_nMonEnaMin_C Rail_nThresStrt_C Rail_numRevDel_C Rail_numRevPlaus_C Rail_pAbsDvtMax_C Rail_pMeUnDvtMax_C Rail_pMeUnDvtMax_CUR Rail_pMeUnDvtMin_CUR Rail_pMeUnPeakMax_C Rail_pMeUnPeakMin_CUR Rail_pNIPCVMax_MAP Rail_pNIPCVMin_MAP Rail_pOvrMeUnThresHigh_C Rail_pOvrMeUnThresLow_C Rail_pOvrPCVThresHigh_C Rail_pOvrPCVThresLow_C Rail_pPCVCloseOfs_CUR Rail_pPCVCtlLoLim_C Rail_pPCVCtlLoLimStrt_C Rail_pPCVCtlUpLim_C Rail_pPCVDvtMax_C Rail_pPCVDvtMax_CUR Rail_pPCVDvtMin_C Rail_pPCVPeakMax_C Rail_pPCVPeakMin_CUR Rail_pPCVRedOfs_CUR Rail_pPCVSet_Channel Rail_pPCVSetMax_C Rail_pPCVSetMin_C Rail_pPCVSet_Vector Rail_pPreCtlCor_Channel Rail_pPreCtlCor_Vector Rail_pSetMin_C Rail_pSetPoint_Channel Rail_pSetPointLimNFlTemp_C Rail_pSetPointMax_MAP Rail_pSetPointMinDef_C Rail_pSetPointMin_MAP Rail_pSetPointRed_C Rail_pSetPointRgn_Channel Rail_pSetPointRgn_Vector Rail_pSetPoint_Vector Rail_qMeUnLoIdle_C Rail_stMonMeUnRls_C Rail_stMonPCVRls_C Rail_stPreCtlMeUnSel_C Rail_stSetPointSel_C Rail_tiDeflate_C Rail_tiSetPointRedMin_C Rail_tiThresMonEna_C Rail_tMeUnLoIdle_C Rail_volInjVlvCtl_C RTMMon_dMaxCheckDef_C RTMMon_dMaxCheckOk_C RTMMon_dPlausCheckDef_C RTMMon_dPlausCheckOk_C RTMMon_tiNoPlausCheck_C Rtmo_adStart_cu32 Rtmo_stSampleTime_cu8 ShutCD_numDia_C ShutCD_numDioOut_C SOPTst_stRcyDem_C SOPTst_stShOffPathActv_C SSpMon_DebSRCHighSplyVltgDef1_C SSpMon_DebSRCHighSplyVltgDef2_C SSpMon_DebSRCHighSplyVltgDef3_C SSpMon_DebSRCHighSplyVltgOk1_C SSpMon_DebSRCHighSplyVltgOk2_C SSpMon_DebSRCHighSplyVltgOk3_C SSpMon_DebSRCLowSplyVltgDef1_C SSpMon_DebSRCLowSplyVltgDef2_C SSpMon_DebSRCLowSplyVltgDef3_C SSpMon_DebSRCLowSplyVltgOk1_C SSpMon_DebSRCLowSplyVltgOk2_C SSpMon_DebSRCLowSplyVltgOk3_C SSpMon_numDiaVltg1_C SSpMon_numDiaVltg2_C SSpMon_numDiaVltg3_C StrtCD_numDia_C StrtCD_numDioOut_C StSys_nAdjMax_C ThrVlv_rTVA_Channel ThrVlv_rTVA_Vector TPUMon_ctDfctLim_C TPUMon_tiDiffMaxLimit_C TPUMon_tiDiffMinLimit_C TPUMon_tiDiffSumLimit_C TVACD_numDia_C TVACD_numPwmOut_C T15CD_numDioIn_C T15CD_tiDebNeg_C T15CD_tiDebPos_C UAddr_stCalibration_C VehDa_lEepUpd_C VSACD_numDia_C VSACD_numPwmOut_C VSA_rVSA_Channel VSA_rVSA_Vector VSSCD_DebCanSigDef_C VSSCD_swtSigType_C VSSCD_swtSigVal_C ZFC_nAvrgMax_C ZFC_nAvrgMin_C ZFC_numRatETClb_C ZFC_numRatNVClb_C /end REF_CHARACTERISTIC
/end FUNCTION
/begin FUNCTION _k2rei "Applizierbare Diagnose Informationen" /begin DEF_CHARACTERISTIC K2REI_dCodInd_C K2REI_dDiaInd_C K2REI_dSGFam_C /end DEF_CHARACTERISTIC /end FUNCTION
/begin FUNCTION BGCRENG "BGCRENG" /end FUNCTION
/begin FUNCTION BGLLGEN_1PR "BGLLGEN_1PR" /end FUNCTION
/begin FUNCTION DGEN "DGEN" /end FUNCTION
/begin FUNCTION DIBS "DIBS" /end FUNCTION
/begin FUNCTION DQLT "DQLT" /end FUNCTION
/begin FUNCTION IMDGEN_1PR "IMDGEN_1PR" /end FUNCTION
/begin FUNCTION KT_IBS "KT_IBS" /end FUNCTION
/begin COMPU_METHOD Acc "Fahrzeugbeschleunigung" RAT_FUNC "%6.5" "m/s^2" COEFFS 0 1000 0 0 0 1 /end COMPU_METHOD
/begin COMPU_METHOD AngleCrS "Winkel Kurbelwelle" RAT_FUNC "%6.4" "deg CrS" COEFFS 0 42.6666666666667 0 0 0 1 /end COMPU_METHOD
/begin COMPU_METHOD Def_i_sw_q1 "Def_i_sw_q1" RAT_FUNC "%8.3" "A" COEFFS 0 1 0 0 0 1 /end COMPU_METHOD
/begin COMPU_METHOD Def_f_uw_b512 "Def_f_uw_b512" RAT_FUNC "%8.3" "-" COEFFS 0 65536 0 0 0 512 /end COMPU_METHOD
/begin COMPU_METHOD Def_i_uw_q0p0635 "Def_i_uw_q0p0635" RAT_FUNC "%8.3" "A" COEFFS 0 65536 0 0 0 4096 /end COMPU_METHOD
/begin COMPU_METHOD Def_i_sw_q0p001 "Def_i_sw_q0p001" RAT_FUNC "%8.3" "A" COEFFS 0 1000 0 0 0 1 /end COMPU_METHOD
/begin COMPU_METHOD Def_t_sw_q0p1 "Def_t_sw_q0p1" RAT_FUNC "%6.1" "°C" COEFFS 0 10 0 0 0 1 /end COMPU_METHOD
/begin COMPU_METHOD Def_u_uw_q0p0942 "Def_u_uw_q0p0942" RAT_FUNC "%6.1" "V" COEFFS 0 1 0 0 0 0.0942 /end COMPU_METHOD
/begin COMPU_METHOD Def_f_ub_b8 "Def_f_ub_b8" RAT_FUNC "%5.2" "-" COEFFS 0 256 0 0 0 8 /end COMPU_METHOD
/begin COMPU_METHOD Def_v_uw_q1p0 "Def_v_uw_q1p0" RAT_FUNC "%5.0" "km/h" COEFFS 0 1 0 0 0 1 /end COMPU_METHOD
/begin COMPU_METHOD Def_tv_ub_q0p390625 "Def_tv_ub_q0p390625" RAT_FUNC "%5.2" "%" COEFFS 0 256 0 0 0 100 /end COMPU_METHOD
/begin COMPU_METHOD Def_bit_ub_0 "Def_bit_ub_0" TAB_VERB "%5.2" "-" COMPU_TAB_REF Def_bit_ub_0_VTAB /end COMPU_METHOD
/begin COMPU_METHOD Def_st_ub_q1 "Def_st_ub_q1" RAT_FUNC "%3.0" "-" COEFFS 0 1 0 0 0 1 /end COMPU_METHOD
/begin COMPU_METHOD Def_n_sw_q1p0 "Def_n_sw_q1p0" RAT_FUNC "%5.0" "Upm" COEFFS 0 1 0 0 0 1 /end COMPU_METHOD
/begin COMPU_METHOD Def_f_ub_b100 "Def_f_ub_b100" RAT_FUNC "%5.2" "%" COEFFS 0 256 0 0 0 100 /end COMPU_METHOD
/begin COMPU_METHOD Def_i_ub_q1 "Def_i_ub_q1" RAT_FUNC "%6.3" "" COEFFS 0 1 0 0 0 1 /end COMPU_METHOD
/begin COMPU_METHOD Def_td_ub_q0p1 "Def_td_ub_q0p1" RAT_FUNC "%4.1" "s" COEFFS 0 10 0 0 0 1 /end COMPU_METHOD
/begin COMPU_METHOD Def_bit_ub_1 "Def_bit_ub_1" TAB_VERB "%5.2" "-" COMPU_TAB_REF Def_bit_ub_1_VTAB /end COMPU_METHOD
/begin COMPU_METHOD Def_bit_ub_2 "Def_bit_ub_2" TAB_VERB "%5.2" "-" COMPU_TAB_REF Def_bit_ub_2_VTAB /end COMPU_METHOD
/begin COMPU_METHOD Def_bit_ub_3 "Def_bit_ub_3" TAB_VERB "%5.2" "-" COMPU_TAB_REF Def_bit_ub_3_VTAB /end COMPU_METHOD
/begin COMPU_METHOD Def_bit_ub_4 "Def_bit_ub_4" TAB_VERB "%5.2" "-" COMPU_TAB_REF Def_bit_ub_4_VTAB /end COMPU_METHOD
/begin COMPU_METHOD Def_bit_ub_5 "Def_bit_ub_5" TAB_VERB "%5.2" "-" COMPU_TAB_REF Def_bit_ub_5_VTAB /end COMPU_METHOD
/begin COMPU_METHOD Def_bit_ub_6 "Def_bit_ub_6" TAB_VERB "%5.2" "-" COMPU_TAB_REF Def_bit_ub_6_VTAB /end COMPU_METHOD
/begin COMPU_METHOD Def_bit_ub_7 "Def_bit_ub_7" TAB_VERB "%5.2" "-" COMPU_TAB_REF Def_bit_ub_7_VTAB /end COMPU_METHOD
/begin COMPU_METHOD Def_st_uw_q1 "Def_st_uw_q1" RAT_FUNC "%5.0" "-" COEFFS 0 1 0 0 0 1 /end COMPU_METHOD
/begin COMPU_METHOD ident "ident" RAT_FUNC "%4.1" "-" COEFFS 0 1 0 0 0 1 /end COMPU_METHOD
/begin COMPU_METHOD Def_dez_uw_q1 "Def_dez_uw_q1" RAT_FUNC "%5.0" "-" COEFFS 0 1 0 0 0 1 /end COMPU_METHOD
/begin COMPU_METHOD Def_dez_ub_q1 "Def_dez_ub_q1" RAT_FUNC "%3.0" "-" COEFFS 0 1 0 0 0 1 /end COMPU_METHOD
/begin COMPU_METHOD Identity "Identity" RAT_FUNC "%4.1" "-" COEFFS 0 1 0 0 0 1 /end COMPU_METHOD
/begin COMPU_METHOD Def_dez_ul_q1 "Def_dez_ul_q1" RAT_FUNC "%7.0" "-" COEFFS 0 1 0 0 0 1 /end COMPU_METHOD
/begin COMPU_METHOD Def_m_sw_q0p1 "Def_m_sw_q0p1" RAT_FUNC "%7.2" "Nm" COEFFS 0 10 0 0 0 1 /end COMPU_METHOD
/begin COMPU_METHOD Def_f_uw_b100 "Def_f_uw_b100" RAT_FUNC "%8.3" "%" COEFFS 0 65536 0 0 0 100 /end COMPU_METHOD
/begin COMPU_METHOD Def_i_ub_q0p125 "Def_i_ub_q0p125" RAT_FUNC "%6.3" "A" COEFFS 0 8 0 0 0 1 /end COMPU_METHOD
/begin COMPU_METHOD Def_f_ub_b4 "Def_f_ub_b4" RAT_FUNC "%5.2" "-" COEFFS 0 256 0 0 0 4 /end COMPU_METHOD
/begin COMPU_METHOD Def_u_uw_q0p1 "Def_u_uw_q0p1" RAT_FUNC "%8.3" "V" COEFFS 0 10 0 0 0 1 /end COMPU_METHOD
/begin COMPU_METHOD Def_eta_ul_b8192 "Def_eta_ul_b8192" RAT_FUNC "%14.6" "-" COEFFS 0 524288 0 0 0 1 /end COMPU_METHOD
/begin COMPU_METHOD Def_pwr_ul_q0p03125 "Def_pwr_ul_q0p03125" RAT_FUNC "%10.3" "-" COEFFS 0 65536 0 0 0 2048 /end COMPU_METHOD
/begin COMPU_METHOD Def_f_uw_b1 "Def_f_uw_b1" RAT_FUNC "%14.5" "-" COEFFS 0 65536 0 0 0 1 /end COMPU_METHOD
/begin COMPU_METHOD Def_f_uw_b2048 "Def_f_uw_b2048" RAT_FUNC "%7.2" "-" COEFFS 0 65536 0 0 0 2048 /end COMPU_METHOD
/begin COMPU_METHOD Def_f_uw_b32 "Def_f_uw_b32" RAT_FUNC "%9.4" "-" COEFFS 0 65536 0 0 0 32 /end COMPU_METHOD
/begin COMPU_METHOD Def_i_uw_q0p03125 "Def_i_uw_q0p03125" RAT_FUNC "%8.3" "A" COEFFS 0 65536 0 0 0 2048 /end COMPU_METHOD
/begin COMPU_METHOD Def_t_uw_q0p075 "Def_t_uw_q0p075" RAT_FUNC "%7.2" "°C" COEFFS 0 1 0 0 0 0.75 /end COMPU_METHOD
/begin COMPU_METHOD Def_f_ub_b1 "Def_f_ub_b1" RAT_FUNC "%6.3" "-" COEFFS 0 256 0 0 0 1 /end COMPU_METHOD
/begin COMPU_METHOD Def_td_ub_q1 "Def_td_ub_q1" RAT_FUNC "%5.2" "s" COEFFS 0 1 0 0 0 1 /end COMPU_METHOD
/begin COMPU_METHOD Def_td_ub_q0p01 "Def_td_ub_q0p01" RAT_FUNC "%5.2" "s" COEFFS 0 100 0 0 0 1 /end COMPU_METHOD
/begin COMPU_METHOD Def_f_ub_b2 "Def_f_ub_b2" RAT_FUNC "%6.3" "-" COEFFS 0 256 0 0 0 2 /end COMPU_METHOD
/begin COMPU_METHOD Def_f_uw_b2 "Def_f_uw_b2" RAT_FUNC "%14.5" "-" COEFFS 0 65536 0 0 0 2 /end COMPU_METHOD
/begin COMPU_METHOD Def_f_uw_b64 "Def_f_uw_b64" RAT_FUNC "%9.4" "-" COEFFS 0 65536 0 0 0 64 /end COMPU_METHOD
/begin COMPU_METHOD Def_i_uw_q0p08_o200 "Def_i_uw_q0p08_o200" RAT_FUNC "%8.3" "" COEFFS 0 25 5000 0 0 2 /end COMPU_METHOD
/begin COMPU_METHOD Def_u_uw_q0p25em3_o6 "Def_u_uw_q0p25em3_o6" RAT_FUNC "%9.4" "" COEFFS 0 -4000 24000 0 0 -1 /end COMPU_METHOD
/begin COMPU_METHOD Def_ql_uw_q0p0182 "Def_ql_uw_q0p0182" RAT_FUNC "%8.3" "Ah" COEFFS 0 989 0 0 0 18 /end COMPU_METHOD
/begin COMPU_METHOD Def_i_sw_q0p02 "Def_i_sw_q0p02" RAT_FUNC "%8.3" "A" COEFFS 0 50 0 0 0 1 /end COMPU_METHOD
/begin COMPU_METHOD Def_i_uw_q0p02_o200 "Def_i_uw_q0p02_o200" RAT_FUNC "%7.2" "A" COEFFS 0 50 10000 0 0 1 /end COMPU_METHOD
/begin COMPU_METHOD Def_i_uw_q0p02 "Def_i_uw_q0p02" RAT_FUNC "%8.3" "A" COEFFS 0 1 0 0 0 0.02 /end COMPU_METHOD
/begin COMPU_METHOD Def_i_ub_q0p02 "Def_i_ub_q0p02" RAT_FUNC "%5.2" "A" COEFFS 0 50 0 0 0 1 /end COMPU_METHOD
/begin COMPU_METHOD Def_u_ub_q0p064_o6 "Def_u_ub_q0p064_o6" RAT_FUNC "%5.2" "V" COEFFS 0 -125 750 0 0 -8 /end COMPU_METHOD
/begin COMPU_METHOD Def_td_ub_q256 "Def_td_ub_q256" RAT_FUNC "%5.2" "s" COEFFS 0 1 0 0 0 256 /end COMPU_METHOD
/begin COMPU_METHOD Def_i_ub_q5p12 "Def_i_ub_q5p12" RAT_FUNC "%5.2" "" COEFFS 0 25 0 0 0 128 /end COMPU_METHOD
/begin COMPU_METHOD Def_td_ub_q0p0125 "Def_td_ub_q0p0125" RAT_FUNC "%5.2" "s" COEFFS 0 80 0 0 0 1 /end COMPU_METHOD
/begin COMPU_METHOD Def_td_ub_q0p002_o01 "Def_td_ub_q0p002_o01" RAT_FUNC "%6.3" "s" COEFFS 0 -1 0.01 0 0 -0.002 /end COMPU_METHOD
/begin COMPU_METHOD Def_td_ub_q16 "Def_td_ub_q16" RAT_FUNC "%5.2" "s" COEFFS 0 1 0 0 0 16 /end COMPU_METHOD
/begin COMPU_METHOD Def_i_ub_q0p04 "Def_i_ub_q0p04" RAT_FUNC "%5.2" "A" COEFFS 0 25 0 0 0 1 /end COMPU_METHOD
/begin COMPU_METHOD Def_i_ub_q0p08 "Def_i_ub_q0p08" RAT_FUNC "%5.2" "A" COEFFS 0 25 0 0 0 2 /end COMPU_METHOD
/begin COMPU_METHOD Def_td_ub_q0p05 "Def_td_ub_q0p05" RAT_FUNC "%5.2" "s" COEFFS 0 20 0 0 0 1 /end COMPU_METHOD
/begin COMPU_METHOD Def_td_ub_q0p00625 "Def_td_ub_q0p00625" RAT_FUNC "%7.4" "s" COEFFS 0 160 0 0 0 1 /end COMPU_METHOD
/begin COMPU_METHOD Def_u_ub_q0p0196 "Def_u_ub_q0p0196" RAT_FUNC "%7.4" "V" COEFFS 0 1 0 0 0 0.0196 /end COMPU_METHOD
/begin COMPU_METHOD Def_td_uw_q0p05 "Def_td_uw_q0p05" RAT_FUNC "%7.2" "s" COEFFS 0 20 0 0 0 1 /end COMPU_METHOD
/begin COMPU_VTAB Def_bit_ub_0_VTAB "Def_bit_ub_0_VTAB" TAB_VERB 2 0 "FALSE" 1 "TRUE" /end COMPU_VTAB
/begin COMPU_VTAB Def_bit_ub_1_VTAB "Def_bit_ub_1_VTAB" TAB_VERB 2 0 "FALSE" 1 "TRUE" /end COMPU_VTAB
/begin COMPU_VTAB Def_bit_ub_2_VTAB "Def_bit_ub_2_VTAB" TAB_VERB 2 0 "FALSE" 1 "TRUE" /end COMPU_VTAB
/begin COMPU_VTAB Def_bit_ub_3_VTAB "Def_bit_ub_3_VTAB" TAB_VERB 2 0 "FALSE" 1 "TRUE" /end COMPU_VTAB
/begin COMPU_VTAB Def_bit_ub_4_VTAB "Def_bit_ub_4_VTAB" TAB_VERB 2 0 "FALSE" 1 "TRUE" /end COMPU_VTAB
/begin COMPU_VTAB Def_bit_ub_5_VTAB "Def_bit_ub_5_VTAB" TAB_VERB 2 0 "FALSE" 1 "TRUE" /end COMPU_VTAB
/begin COMPU_VTAB Def_bit_ub_6_VTAB "Def_bit_ub_6_VTAB" TAB_VERB 2 0 "FALSE" 1 "TRUE" /end COMPU_VTAB
/begin COMPU_VTAB Def_bit_ub_7_VTAB "Def_bit_ub_7_VTAB" TAB_VERB 2 0 "FALSE" 1 "TRUE" /end COMPU_VTAB
/begin COMPU_METHOD DtyCyc "Tastverhaeltnis" RAT_FUNC "%6.4" "%" COEFFS 0 100 0 0 0 1 /end COMPU_METHOD
/begin COMPU_METHOD EngN "Motordrehzahl" RAT_FUNC "%6.2" "rpm" COEFFS 0 1 0 0 0 1 /end COMPU_METHOD
/begin COMPU_METHOD InjMass "Einspritzmenge" RAT_FUNC "%6.4" "mg/hub" COEFFS 0 100 0 0 0 1 /end COMPU_METHOD
/begin COMPU_METHOD InjTime_us "Zeit in Microsekunden für das Einspritztiming" RAT_FUNC "%6.2" "us" COEFFS 0 1 0 0 0 1 /end COMPU_METHOD
/begin COMPU_METHOD NumPinDia "Verbale Umrechnung für Diagnose Signale" TAB_VERB "%6.3" "-" COMPU_TAB_REF NumPinDia /end COMPU_METHOD
/begin COMPU_VTAB NumPinDia "Verbale Umrechnung für Diagnose Signale" TAB_VERB 28 0 "CJ945_Diagnostic_Signal" 1 "AC_Compressor_DiaSig" 2 "Fuel_Pump_Diagnostic_Signal_232" 3 "Starter_234" 4 "Oil_Pressure_Lamp_Switch_245" 5 "Engine_Bay_Air_Flaps_123" 6 "Ebox_Fan_Actuator_Diagnostic_Signal_219" 7 "Shuttr_Actuator_Diagnostic_Signal_231" 8 "Twostage_TurboLoading_SW_DiaSig" 9 "DIO_OUT_DIAGNOSTIC_DUMMY_NOT_USED" 10 "Alternator" 11 "Boost_Pressure_Actuator_Diagnostic_Signal_193" 12 "EGR_Actuator_Diagnostic_Signal_194" 13 "1st_Pressure_Control_Valve_Diagnostic_Signal_172" 14 "2nd_Pressure_Control_Valve_Diagnostic_Signal_172" 15 "1st_Metering_Unit_Diagnostic_Signal_171" 16 "2nd_Metering_Unit_Diagnostic_Signal_171" 17 "Variable_Swirl_Actuator_Diagnostic_Signal_195" 18 "FAN_240" 19 "Add_On_Heater_244" 20 "EngM_Bearing_Actuator_Diagnostic_Signal_124" 21 "EngM_Bearing_Actuator_Diagnostic_Signal_121" 22 "Throttle_Valve_Diagnostic_Signal_196" 23 "Low pressure stage BPA_Diagnostic_Signal_117" 24 "PWM_DIAGNOSTIC_DUMMY_NOT_USED" 25 "1st_Sensor_Supply_Voltage_DiaSig" 26 "2nd_Sensor_Supply_Voltage_DiaSig" 27 "3rd_Sensor_Supply_Voltage_DiaSig" /end COMPU_VTAB
/begin COMPU_METHOD NumPinDioIn "Verbale Umrechnung für Digitaleingang Signale" TAB_VERB "%6.3" "-" COMPU_TAB_REF NumPinDioIn /end COMPU_METHOD
/begin COMPU_VTAB NumPinDioIn "Verbale Umrechnung für Digitaleingang Signale" TAB_VERB 15 0 "Terminal_15_207" 1 "Main_Brake_Switch_236" 2 "Redundant_Brake_Switch_223" 3 "Clutch_Switch" 4 "Terminal_50_224" 5 "ECU_selection_Switch_251" 6 "FlFlt_Switch_211" 7 "Coolant-heater_212" 8 "Redundant_Terminal_15_209(118)" 9 "AC-compressor_overboost_213" 10 "Additive_tank_level_switch_235" 11 "Terminal_61_113" 12 "Lambda_Regeneration" 13 "Oil_Level_sensor_138" 14 "DIO_IN_DUMMY_NOT_USED" /end COMPU_VTAB
/begin COMPU_METHOD NumPinPwmOut "Verbale Umrechnung für PWM-Ausgang Signale" TAB_VERB "%6.3" "-" COMPU_TAB_REF NumPinPwmOut /end COMPU_METHOD
/begin COMPU_VTAB NumPinPwmOut "Verbale Umrechnung für PWM-Ausgang Signale" TAB_VERB 14 0 "Boost_Pressure_Actuator_193" 1 "EGR_Actuator_194" 2 "PCV_Actuator_172" 3 "MeUn_Actuator_171" 4 "Variable_Swirl_Actuator_195" 5 "Fan_Actuator_240" 6 "Add_On_Heater_244" 7 "EngM_Bearing_Actuator_124" 8 "EngM_Bearing_Actuator_121" 9 "Throttle_Valve_196" 10 "LSU_Heater_PWMOutput" 11 "Low pressure stage BPA_117" 12 "Shuttr_Actuator_PWM_231" 13 "PWM_DUMMY_NOT_USED" /end COMPU_VTAB
/begin COMPU_METHOD OneToOne "eins zu eins (physikalischer Wert ist gleich dem internen Wert)" RAT_FUNC "%6.2" "-" COEFFS 0 1 0 0 0 1 /end COMPU_METHOD
/begin COMPU_METHOD Period "Periodendauer" RAT_FUNC "%6.3" "ms" COEFFS 0 10 0 0 0 1 /end COMPU_METHOD
/begin COMPU_METHOD Per_Ratio "Umwandlung fuer Bereichsgewichtung" RAT_FUNC "%6.4" "-" COEFFS 0 256 0 0 0 1 /end COMPU_METHOD
/begin COMPU_METHOD Prc "Prozent, gleiche interne Auflösung wie Fact, aber Darstellung in Prozent (0...100%)" RAT_FUNC "%6.4" "%" COEFFS 0 81.92 0 0 0 1 /end COMPU_METHOD
/begin COMPU_METHOD Pres_Rail "Raildruck in hPa" RAT_FUNC "%4.3" "bar" COEFFS 0 10.000000 0 0 0 1 /end COMPU_METHOD
/begin COMPU_METHOD Temp_Cels "Temperatur dargestellt in °C (gleiche interne Darstellung wie Temp_Kelv)" RAT_FUNC "%6.1" "deg C" COEFFS 0 10 2731.4 0 0 1 /end COMPU_METHOD
/begin COMPU_METHOD TimeDelay_s "Zeitkonstante T1 (in s) für PT1, DT1, etc." RAT_FUNC "%9.3" "s" COEFFS 0 0 1 0 0.00023283064365387 0 /end COMPU_METHOD
/begin COMPU_METHOD Time_ms "Zeit in ms für Fehlerentprellung (DSM) und SW-Timer" RAT_FUNC "%6.1" "ms" COEFFS 0 0.1 0 0 0 1 /end COMPU_METHOD
/begin COMPU_METHOD Time_PwmHigh "Periodenzeit von der HWE (Tio_PwmGetAvrg)" RAT_FUNC "%6.3" "us" COEFFS 0 10 0 0 0 1 /end COMPU_METHOD
/begin COMPU_METHOD Vel "Fahrzeuggeschwindigkeit, gleiche interne Auflösung wie Vel_SI" RAT_FUNC "%6.4" "km/h" COEFFS 0 100 0 0 0 1 /end COMPU_METHOD
/begin COMPU_METHOD volAdd_ml1 "Umrechnung mit Auflösung 0.0000152587890625 für die 32 bit Messages in AddPmp_AddMet" RAT_FUNC "%7.6" "ml" COEFFS 0 65536 0 0 0 1 /end COMPU_METHOD
/begin COMPU_METHOD Volt_Batt "Batteriespannung" RAT_FUNC "%6.1" "mV" COEFFS 0 0.05115 0 0 0 1 /end COMPU_METHOD
/begin COMPU_METHOD VSS_DistFac "Streckenfaktor für FGG" RAT_FUNC "%20.2" "Imp/m" COEFFS 0 0 1 0 2.77777777777778e-10 0 /end COMPU_METHOD
/begin COMPU_METHOD ZFC_EvalEngSpd_Rslt "Umrechnung für das Ergebniss der Drehzahlsignalauswertung" TAB_VERB "%6.3" "-" COMPU_TAB_REF ZFC_EvalEngSpd_Rslt /end COMPU_METHOD
/begin COMPU_VTAB ZFC_EvalEngSpd_Rslt "Umrechnung für das Ergebniss der Drehzahlsignalauswertung" TAB_VERB 3 0 "ZFC_ST_ALL_INJ_LOW" 1 "ZFC_ST_DES_INJ_MAX" 2 "ZFC_ST_ERR_INJ_MAX" /end COMPU_VTAB
/begin COMPU_METHOD ZFC_Inj_State "Umrechnung für die Ausgabe des Zustandsautomaten für die Einspritzung der Nullmengenkalibrierung" TAB_VERB "%6.3" "-" COMPU_TAB_REF ZFC_Inj_State /end COMPU_METHOD
/begin COMPU_VTAB ZFC_Inj_State "Umrechnung für die Ausgabe des Zustandsautomaten für die Einspritzung der Nullmengenkalibrierung" TAB_VERB 5 0 "ZFC_ST_INJ_IDLE" 16 "ZFC_ST_INJ_DEM" 32 "ZFC_ST_INJ_PROG" 48 "ZFC_ST_INJ_RES_OK" 64 "ZFC_ST_INJ_RES_NOK" /end COMPU_VTAB
/begin COMPU_METHOD ZFC_State "Umrechnung für Ausgabe des Nullmengenkalibrierung Statuses" TAB_VERB "%6.3" "-" COMPU_TAB_REF ZFC_State /end COMPU_METHOD
/begin COMPU_VTAB ZFC_State "Umrechnung für Ausgabe des Nullmengenkalibrierung Statuses" TAB_VERB 8 1 "ZFC_ST_BREAK" 2 "ZFC_ST_WAIT" 3 "ZFC_ST_START_OVRRUN" 4 "ZFC_ST_CHANGE_PRAIL" 5 "ZFC_ST_CHECK_PRAIL_AND_N" 6 "ZFC_ST_ETCLB" 7 "ZFC_ST_NVCLB" 16 "ZFC_ST_SUBS_FUNC" /end COMPU_VTAB
/begin RECORD_LAYOUT Kl_Xs16_Ws16 NO_AXIS_PTS_X 1 SWORD AXIS_PTS_X 2 SWORD INDEX_INCR DIRECT FNC_VALUES 3 SWORD COLUMN_DIR DIRECT /end RECORD_LAYOUT
/begin RECORD_LAYOUT Kwb_Wr32 FNC_VALUES 1 FLOAT32_IEEE COLUMN_DIR DIRECT /end RECORD_LAYOUT
/begin RECORD_LAYOUT Kwb_Wu16 FNC_VALUES 1 UWORD COLUMN_DIR DIRECT /end RECORD_LAYOUT
/begin RECORD_LAYOUT Kwb_Wu8 FNC_VALUES 1 UBYTE COLUMN_DIR DIRECT /end RECORD_LAYOUT
/begin RECORD_LAYOUT Kw_Ws16 FNC_VALUES 1 SWORD COLUMN_DIR DIRECT /end RECORD_LAYOUT
/begin RECORD_LAYOUT Kw_Ws32 FNC_VALUES 1 SLONG COLUMN_DIR DIRECT /end RECORD_LAYOUT
/begin RECORD_LAYOUT Kw_Wu16 FNC_VALUES 1 UWORD COLUMN_DIR DIRECT /end RECORD_LAYOUT
/begin RECORD_LAYOUT Kw_Wu32 FNC_VALUES 1 ULONG COLUMN_DIR DIRECT /end RECORD_LAYOUT
/begin RECORD_LAYOUT Kw_Wu8 FNC_VALUES 1 UBYTE COLUMN_DIR DIRECT /end RECORD_LAYOUT
/begin RECORD_LAYOUT TKW_VV_VV_UW FNC_VALUES 1 UWORD COLUMN_DIR DIRECT /end RECORD_LAYOUT
/begin RECORD_LAYOUT TKW_VV_VV_SW FNC_VALUES 1 SWORD COLUMN_DIR DIRECT /end RECORD_LAYOUT
/begin RECORD_LAYOUT TKL_UW_VV_UB NO_AXIS_PTS_X 1 UBYTE RESERVED 2 BYTE AXIS_PTS_X 3 UWORD INDEX_INCR DIRECT FNC_VALUES 4 UBYTE COLUMN_DIR DIRECT /end RECORD_LAYOUT
/begin RECORD_LAYOUT TKL_UW_VV_UW NO_AXIS_PTS_X 1 UBYTE RESERVED 2 BYTE AXIS_PTS_X 3 UWORD INDEX_INCR DIRECT FNC_VALUES 4 UWORD COLUMN_DIR DIRECT /end RECORD_LAYOUT
/begin RECORD_LAYOUT TKL_SW_VV_UW NO_AXIS_PTS_X 1 UBYTE RESERVED 2 BYTE AXIS_PTS_X 3 SWORD INDEX_INCR DIRECT FNC_VALUES 4 UWORD COLUMN_DIR DIRECT /end RECORD_LAYOUT
/begin RECORD_LAYOUT TKF_UW_UB_UW NO_AXIS_PTS_X 1 UBYTE NO_AXIS_PTS_Y 2 UBYTE AXIS_PTS_X 3 UBYTE INDEX_INCR DIRECT AXIS_PTS_Y 4 UWORD INDEX_INCR DIRECT FNC_VALUES 5 UWORD COLUMN_DIR DIRECT /end RECORD_LAYOUT
/begin RECORD_LAYOUT TKW_VV_VV_UB FNC_VALUES 1 UBYTE COLUMN_DIR DIRECT /end RECORD_LAYOUT
/begin RECORD_LAYOUT TKF_UB_UB_UB NO_AXIS_PTS_X 1 UBYTE NO_AXIS_PTS_Y 2 UBYTE AXIS_PTS_X 3 UBYTE INDEX_INCR DIRECT AXIS_PTS_Y 4 UBYTE INDEX_INCR DIRECT FNC_VALUES 5 UBYTE COLUMN_DIR DIRECT /end RECORD_LAYOUT
/begin RECORD_LAYOUT TKW_VV_VV_UL FNC_VALUES 1 ULONG COLUMN_DIR DIRECT /end RECORD_LAYOUT
/begin RECORD_LAYOUT TKL_UB_VV_UB NO_AXIS_PTS_X 1 UBYTE RESERVED 2 BYTE AXIS_PTS_X 3 UBYTE INDEX_INCR DIRECT FNC_VALUES 4 UBYTE COLUMN_DIR DIRECT /end RECORD_LAYOUT
/begin RECORD_LAYOUT TKL_UW_VV_SW NO_AXIS_PTS_X 1 UBYTE RESERVED 2 BYTE AXIS_PTS_X 3 UWORD INDEX_INCR DIRECT FNC_VALUES 4 SWORD COLUMN_DIR DIRECT /end RECORD_LAYOUT
/begin RECORD_LAYOUT TKL_SW_VV_UB NO_AXIS_PTS_X 1 UBYTE RESERVED 2 BYTE AXIS_PTS_X 3 SWORD INDEX_INCR DIRECT FNC_VALUES 4 UBYTE COLUMN_DIR DIRECT /end RECORD_LAYOUT
/begin RECORD_LAYOUT TKF_SW_UB_UB NO_AXIS_PTS_X 1 UBYTE NO_AXIS_PTS_Y 2 UBYTE AXIS_PTS_X 3 UBYTE INDEX_INCR DIRECT AXIS_PTS_Y 4 SWORD INDEX_INCR DIRECT FNC_VALUES 5 UBYTE COLUMN_DIR DIRECT /end RECORD_LAYOUT
/begin RECORD_LAYOUT TKF_SW_UW_UB NO_AXIS_PTS_X 1 UBYTE NO_AXIS_PTS_Y 2 UBYTE AXIS_PTS_X 3 UWORD INDEX_INCR DIRECT AXIS_PTS_Y 4 SWORD INDEX_INCR DIRECT FNC_VALUES 5 UBYTE COLUMN_DIR DIRECT /end RECORD_LAYOUT
/begin RECORD_LAYOUT TKF_SW_SW_UW NO_AXIS_PTS_X 1 UBYTE NO_AXIS_PTS_Y 2 UBYTE AXIS_PTS_X 3 SWORD INDEX_INCR DIRECT AXIS_PTS_Y 4 SWORD INDEX_INCR DIRECT FNC_VALUES 5 UWORD COLUMN_DIR DIRECT /end RECORD_LAYOUT
/end MODULE
/end PROJECT
