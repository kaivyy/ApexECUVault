ASAP2_VERSION 1 3
/begin PROJECT _725D601B "725D601B"
/begin HEADER "" VERSION "_725D601B" PROJECT_NO _725D601B /end HEADER
/begin MODULE DIM ""
/begin MOD_COMMON "" BYTE_ORDER MSB_FIRST ALIGNMENT_BYTE 1 ALIGNMENT_WORD 2 ALIGNMENT_LONG 2 ALIGNMENT_FLOAT32_IEEE 4 /end MOD_COMMON
/begin CHARACTERISTIC ADVFST "Anzahl Diagnoseversucher Fuellstand" VALUE 0xFD0514 KwUb 255.0 dez 0.00 255.0 FORMAT "%5.1" /end CHARACTERISTIC
/begin CHARACTERISTIC ATMRWT "Temperaturkorrektur f¸r Rohrwand hinter Kat aus TKATM" VALUE 0xFD01B2 KwSw 1535.977 temp_q0p0234 -768.0000 767.9766 FORMAT "%8.4" /end CHARACTERISTIC
/begin CHARACTERISTIC CDCBREMS "Codewort CARB: Bremspedalgeber" VAL_BLK 0xFD5D40 KwbUw 65535.00 dez 0.00 65535.00 FORMAT "%8.2" NUMBER 4 /end CHARACTERISTIC
/begin CHARACTERISTIC CDCBWF "Codewort CARB: PWG Bewegung" VAL_BLK 0xFD5D48 KwbUw 65535.00 dez 0.00 65535.00 FORMAT "%8.2" NUMBER 4 /end CHARACTERISTIC
/begin CHARACTERISTIC CDCDDSS "Codewort CARB: Differenzdrucksensor Saugrohr" VAL_BLK 0xFD5DD0 KwbUw 65535.00 dez 0.00 65535.00 FORMAT "%8.2" NUMBER 4 /end CHARACTERISTIC
/begin CHARACTERISTIC CDCDGEN "Codewort CARB: Generator" VAL_BLK 0xFD5DD8 KwbWU16 65535.00 dez 0.00 65535.00 FORMAT "%8.2" NUMBER 4 /end CHARACTERISTIC
/begin CHARACTERISTIC CDCDGEN2 "" VAL_BLK 0xFD5DE0 KwbWU16 65535.00 dez 0.00 65535.00 FORMAT "%8.2" NUMBER 4 /end CHARACTERISTIC
/begin CHARACTERISTIC CDCDGENB2 "" VAL_BLK 0xFD5DE8 KwbWU16 65535.00 dez 0.00 65535.00 FORMAT "%8.2" NUMBER 4 /end CHARACTERISTIC
/begin CHARACTERISTIC CDCDGENBS "Codewort  CARB: Kommunikation" VAL_BLK 0xFD5DF0 KwbWU16 65535.00 dez 0.00 65535.00 FORMAT "%8.2" NUMBER 4 /end CHARACTERISTIC
/begin CHARACTERISTIC CDCDIBS1 "Codewort Carb Behoerdentester IBS BSD Error" VAL_BLK 0xFD5E00 KwbWU16 65535.00 dez 0.00 65535.00 FORMAT "%8.2" NUMBER 4 /end CHARACTERISTIC
/begin CHARACTERISTIC CDCDIBS2 "Codewort Carb Behoerdentester IBS SW unplausibel" VAL_BLK 0xFD5E08 KwbWU16 65535.00 dez 0.00 65535.00 FORMAT "%8.2" NUMBER 4 /end CHARACTERISTIC
/begin CHARACTERISTIC CDCDIBS3 "" VAL_BLK 0xFD5E10 KwbWU16 65535.00 dez 0.00 65535.00 FORMAT "%8.2" NUMBER 4 /end CHARACTERISTIC
/begin CHARACTERISTIC CDCDMTKNM "Codewort CARB: Kleinstleck, no MIL" VAL_BLK 0xFD5E58 KwbWU16 65535.00 dez 0.00 65535.00 FORMAT "%8.2" NUMBER 4 /end CHARACTERISTIC
/begin CHARACTERISTIC CDCDSU "Codewort CARB: Drucksensor Umgebung" VAL_BLK 0xFD5E70 KwbUw 65535.00 dez 0.00 65535.00 FORMAT "%8.2" NUMBER 4 /end CHARACTERISTIC
/begin CHARACTERISTIC CDCDWA "Codewort CARB: Diebstahlwarnanlage" VAL_BLK 0xFD5F90 KwbUw 65535.00 dez 0.00 65535.00 FORMAT "%8.2" NUMBER 4 /end CHARACTERISTIC
/begin CHARACTERISTIC CDCDZKU0 "Codewort CARB:	Z¸ndspule 0" VAL_BLK 0xFD5FA8 KwbWU16 65535.00 dez 0.00 65535.00 FORMAT "%8.2" NUMBER 4 /end CHARACTERISTIC
/begin CHARACTERISTIC CDCDZKU1 "Codewort CARB:	Z¸ndspule 1" VAL_BLK 0xFD5FB0 KwbWU16 65535.00 dez 0.00 65535.00 FORMAT "%8.2" NUMBER 4 /end CHARACTERISTIC
/begin CHARACTERISTIC CDCDZKU2 "Codewort CARB:	Z¸ndspule 2" VAL_BLK 0xFD5FB8 KwbWU16 65535.00 dez 0.00 65535.00 FORMAT "%8.2" NUMBER 4 /end CHARACTERISTIC
/begin CHARACTERISTIC CDCDZKU3 "Codewort CARB:	Z¸ndspule 3" VAL_BLK 0xFD5FC0 KwbWU16 65535.00 dez 0.00 65535.00 FORMAT "%8.2" NUMBER 4 /end CHARACTERISTIC
/begin CHARACTERISTIC CDCDZKU4 "Codewort CARB:	Z¸ndspule 4" VAL_BLK 0xFD5FC8 KwbWU16 65535.00 dez 0.00 65535.00 FORMAT "%8.2" NUMBER 4 /end CHARACTERISTIC
/begin CHARACTERISTIC CDCDZKU5 "Codewort CARB:	Z¸ndspule 5" VAL_BLK 0xFD5FD0 KwbWU16 65535.00 dez 0.00 65535.00 FORMAT "%8.2" NUMBER 4 /end CHARACTERISTIC
/begin CHARACTERISTIC CDCDZKU6 "Codewort CARB:	Z¸ndspule 6" VAL_BLK 0xFD5FD8 KwbWU16 65535.00 dez 0.00 65535.00 FORMAT "%8.2" NUMBER 4 /end CHARACTERISTIC
/begin CHARACTERISTIC CDCDZKU7 "Codewort CARB:	Z¸ndspule 7" VAL_BLK 0xFD5FE0 KwbWU16 65535.00 dez 0.00 65535.00 FORMAT "%8.2" NUMBER 4 /end CHARACTERISTIC
/begin CHARACTERISTIC CDCEGFE "Codewort CARB: Lasterfassung" VAL_BLK 0xFD5FE8 KwbUw 65535.00 dez 0.00 65535.00 FORMAT "%8.2" NUMBER 4 /end CHARACTERISTIC
/begin CHARACTERISTIC CDCFP1P "Codewort CARB: Poti 1, Fahrpedal" VAL_BLK 0xFD6060 KwbUw 65535.00 dez 0.00 65535.00 FORMAT "%8.2" NUMBER 4 /end CHARACTERISTIC
/begin CHARACTERISTIC CDCFP2P "Codewort CARB: Poti 2, Fahrpedal" VAL_BLK 0xFD6068 KwbUw 65535.00 dez 0.00 65535.00 FORMAT "%8.2" NUMBER 4 /end CHARACTERISTIC
/begin CHARACTERISTIC CDCFPP "Codewort CARB: Fahrpedal" VAL_BLK 0xFD6070 KwbUw 65535.00 dez 0.00 65535.00 FORMAT "%8.2" NUMBER 4 /end CHARACTERISTIC
/begin CHARACTERISTIC CDCHSVSA "Codewort CARB:	Lambdasonden-Heizung vor Katalysator" VAL_BLK 0xFD6108 KwbWU16 65535.00 dez 0.00 65535.00 FORMAT "%8.2" NUMBER 4 /end CHARACTERISTIC
/begin CHARACTERISTIC CDCHSVSA2 "Codewort CARB:	Lambdasonden-Heizung 2 vor Katalysator" VAL_BLK 0xFD6110 KwbWU16 65535.00 dez 0.00 65535.00 FORMAT "%8.2" NUMBER 4 /end CHARACTERISTIC
/begin CHARACTERISTIC CDCLSVV "Codewort CARB: Vertauschte Lambda-Sonden vor Kat" VAL_BLK 0xFD6240 KwbUw 65535.00 dez 0.00 65535.00 FORMAT "%8.2" NUMBER 4 /end CHARACTERISTIC
/begin CHARACTERISTIC CDCMDB "Codewort CARB: Momentbegrenzung Sollmoment" VAL_BLK 0xFD62B0 KwbUw 65535.00 dez 0.00 65535.00 FORMAT "%8.2" NUMBER 4 /end CHARACTERISTIC
/begin CHARACTERISTIC CDCMFL "Codewort CARB: Multifunktionslenkrad" VAL_BLK 0xFD62B8 KwbWU16 65535.00 dez 0.00 65535.00 FORMAT "%8.2" NUMBER 4 /end CHARACTERISTIC
/begin CHARACTERISTIC CDCMINHUB "" VAL_BLK 0xFD62C0 KwbUw 65535.00 dez 0.00 65535.00 FORMAT "%8.2" NUMBER 4 /end CHARACTERISTIC
/begin CHARACTERISTIC CDCMTOEL "" VAL_BLK 0xFD62D0 KwbWU16 65535.00 dez 0.00 65535.00 FORMAT "%8.2" NUMBER 4 /end CHARACTERISTIC
/begin CHARACTERISTIC CDCNVRMON "Codewort CARB: NVRAM Backup Aktualit‰s¸berwachung" VAL_BLK 0xFD62E8 KwbUw 65535.00 dez 0.00 65535.00 FORMAT "%8.2" NUMBER 4 /end CHARACTERISTIC
/begin CHARACTERISTIC CDCNWKW "Codewort CARB: Zuordnung Nockenwelle zu Kurbelwelle" VAL_BLK 0xFD62F0 KwbWU16 65535.00 dez 0.00 65535.00 FORMAT "%8.2" NUMBER 4 /end CHARACTERISTIC
/begin CHARACTERISTIC CDCOEZS "Parameter f¸r Fehlerspeicherverwaltung" VAL_BLK 0xFD62F8 KwbWU16 65535.00 dez 0.00 65535.00 FORMAT "%8.2" NUMBER 4 /end CHARACTERISTIC
/begin CHARACTERISTIC CDCPDDSS "Codewort CARB: Druck Differenzdrucksensor Saugrohr" VAL_BLK 0xFD6300 KwbUw 65535.00 dez 0.00 65535.00 FORMAT "%8.2" NUMBER 4 /end CHARACTERISTIC
/begin CHARACTERISTIC CDCSLVE "Codewort CARB: Sekund‰rluftventil (Endstufe)" VAL_BLK 0xFD63A0 KwbWU16 65535.00 dez 0.00 65535.00 FORMAT "%8.2" NUMBER 4 /end CHARACTERISTIC
/begin CHARACTERISTIC CDCTA "Codewort CARB: TANS" VAL_BLK 0xFD63C8 KwbUw 65535.00 dez 0.00 65535.00 FORMAT "%8.2" NUMBER 4 /end CHARACTERISTIC
/begin CHARACTERISTIC CDCTKA "Codewort CARB: Temperatur K¸hlerausgang" VAL_BLK 0xFD63F0 KwbWU16 65535.00 dez 0.00 65535.00 FORMAT "%8.2" NUMBER 4 /end CHARACTERISTIC
/begin CHARACTERISTIC CDCTM "Codewort CARB: Motortemperatur TMOT" VAL_BLK 0xFD63F8 KwbUw 65535.00 dez 0.00 65535.00 FORMAT "%8.2" NUMBER 4 /end CHARACTERISTIC
/begin CHARACTERISTIC CDCTUM "Codewort CARB: Umgebungs(-luft)-Temperatur TUM" VAL_BLK 0xFD6400 KwbWU16 65535.00 dez 0.00 65535.00 FORMAT "%8.2" NUMBER 4 /end CHARACTERISTIC
/begin CHARACTERISTIC CDCUB "Codewort CARB: Batteriespannung UB (Bordnetz)" VAL_BLK 0xFD6408 KwbWU16 65535.00 dez 0.00 65535.00 FORMAT "%8.2" NUMBER 4 /end CHARACTERISTIC
/begin CHARACTERISTIC CDCVVTE "Codewort CARB: Endstufe VVT" VAL_BLK 0xFD6480 KwbWU16 65535.00 dez 0.00 65535.00 FORMAT "%8.2" NUMBER 4 /end CHARACTERISTIC
/begin CHARACTERISTIC CDCWCA "Codewort CARB: Wegfahrsperre Wechselcode-Ablage" VAL_BLK 0xFD6488 KwbUw 65535.00 dez 0.00 65535.00 FORMAT "%8.2" NUMBER 4 /end CHARACTERISTIC
/begin CHARACTERISTIC CDCWFS "Codewort CARB: Wegfahrsperre" VAL_BLK 0xFD6490 KwbUw 65535.00 dez 0.00 65535.00 FORMAT "%8.2" NUMBER 4 /end CHARACTERISTIC
/begin CHARACTERISTIC CDKBREMS "Codewort Kunde: BREMS (Bremsschalter)" VALUE 0xFD64E0 KwUw 65535.00 dez 0.00 65535.00 FORMAT "%8.2" /end CHARACTERISTIC
/begin CHARACTERISTIC CDKBWF "Codewort Kunde: PWG Bewegung" VALUE 0xFD64E2 KwUw 65535.00 dez 0.00 65535.00 FORMAT "%8.2" /end CHARACTERISTIC
/begin CHARACTERISTIC CDKDDSS "Codewort Kunde: Differenzdrucksensor Saugrohr" VALUE 0xFD6504 KwUw 65535.00 dez 0.00 65535.00 FORMAT "%8.2" /end CHARACTERISTIC
/begin CHARACTERISTIC CDKDGEN "Codewort Kunde Generator" VALUE 0xFD6506 KwWU16 65535.00 dez 0.00 65535.00 FORMAT "%8.2" /end CHARACTERISTIC
/begin CHARACTERISTIC CDKDGEN2 "" VALUE 0xFD6508 KwWU16 65535.00 dez 0.00 65535.00 FORMAT "%8.2" /end CHARACTERISTIC
/begin CHARACTERISTIC CDKDGENB2 "" VALUE 0xFD650A KwWU16 65535.00 dez 0.00 65535.00 FORMAT "%8.2" /end CHARACTERISTIC
/begin CHARACTERISTIC CDKDGENBS "Codewort Kunde Kommunikation" VALUE 0xFD650C KwWU16 65535.00 dez 0.00 65535.00 FORMAT "%8.2" /end CHARACTERISTIC
/begin CHARACTERISTIC CDKDIBS1 "Codewort Kunde IBS BSD Error" VALUE 0xFD6510 KwWU16 65535.00 dez 0.00 65535.00 FORMAT "%8.2" /end CHARACTERISTIC
/begin CHARACTERISTIC CDKDIBS2 "Codewort Kunde IBS SW unplausibel" VALUE 0xFD6512 KwWU16 65535.00 dez 0.00 65535.00 FORMAT "%8.2" /end CHARACTERISTIC
/begin CHARACTERISTIC CDKDIBS3 "" VALUE 0xFD6514 KwWU16 65535.00 dez 0.00 65535.00 FORMAT "%8.2" /end CHARACTERISTIC
/begin CHARACTERISTIC CDKDMTKNM "Codewort Kunde: Kleinstleck, no MIL" VALUE 0xFD6526 KwWU16 65535.00 dez 0.00 65535.00 FORMAT "%8.2" /end CHARACTERISTIC
/begin CHARACTERISTIC CDKDSU "Codewort Kunde: Drucksensor Umgebung" VALUE 0xFD652C KwUw 65535.00 dez 0.00 65535.00 FORMAT "%8.2" /end CHARACTERISTIC
/begin CHARACTERISTIC CDKDWA "Codewort Kunde: Diebstahlwarnanlage" VALUE 0xFD6574 KwUw 65535.00 dez 0.00 65535.00 FORMAT "%8.2" /end CHARACTERISTIC
/begin CHARACTERISTIC CDKDZKU0 "Codewort Kunde:	Z¸ndspule 0" VALUE 0xFD657A KwWU16 65535.00 dez 0.00 65535.00 FORMAT "%8.2" /end CHARACTERISTIC
/begin CHARACTERISTIC CDKDZKU1 "Codewort Kunde:	Z¸ndspule 1" VALUE 0xFD657C KwWU16 65535.00 dez 0.00 65535.00 FORMAT "%8.2" /end CHARACTERISTIC
/begin CHARACTERISTIC CDKDZKU2 "Codewort Kunde:	Z¸ndspule 2" VALUE 0xFD657E KwWU16 65535.00 dez 0.00 65535.00 FORMAT "%8.2" /end CHARACTERISTIC
/begin CHARACTERISTIC CDKDZKU3 "Codewort Kunde:	Z¸ndspule 3" VALUE 0xFD6580 KwWU16 65535.00 dez 0.00 65535.00 FORMAT "%8.2" /end CHARACTERISTIC
/begin CHARACTERISTIC CDKDZKU4 "Codewort Kunde:	Z¸ndspule 4" VALUE 0xFD6582 KwWU16 65535.00 dez 0.00 65535.00 FORMAT "%8.2" /end CHARACTERISTIC
/begin CHARACTERISTIC CDKDZKU5 "Codewort Kunde:	Z¸ndspule 5" VALUE 0xFD6584 KwWU16 65535.00 dez 0.00 65535.00 FORMAT "%8.2" /end CHARACTERISTIC
/begin CHARACTERISTIC CDKDZKU6 "Codewort Kunde:	Z¸ndspule 6" VALUE 0xFD6586 KwWU16 65535.00 dez 0.00 65535.00 FORMAT "%8.2" /end CHARACTERISTIC
/begin CHARACTERISTIC CDKDZKU7 "Codewort Kunde:	Z¸ndspule 7" VALUE 0xFD6588 KwWU16 65535.00 dez 0.00 65535.00 FORMAT "%8.2" /end CHARACTERISTIC
/begin CHARACTERISTIC CDKEGFE "Codewort Kunde: Lasterfassung" VALUE 0xFD658A KwUw 65535.00 dez 0.00 65535.00 FORMAT "%8.2" /end CHARACTERISTIC
/begin CHARACTERISTIC CDKFP1P "Codewort Kunde: Poti 1, Fahrpedal" VALUE 0xFD65A8 KwUw 65535.00 dez 0.00 65535.00 FORMAT "%8.2" /end CHARACTERISTIC
/begin CHARACTERISTIC CDKFP2P "Codewort Kunde: Poti 2, Fahrpedal" VALUE 0xFD65AA KwUw 65535.00 dez 0.00 65535.00 FORMAT "%8.2" /end CHARACTERISTIC
/begin CHARACTERISTIC CDKFPP "Codewort Kunde: Poti Fahrpedal" VALUE 0xFD65AC KwUw 65535.00 dez 0.00 65535.00 FORMAT "%8.2" /end CHARACTERISTIC
/begin CHARACTERISTIC CDKHSVSA "" VALUE 0xFD65D2 KwWU16 65535.00 dez 0.00 65535.00 FORMAT "%8.2" /end CHARACTERISTIC
/begin CHARACTERISTIC CDKHSVSA2 "" VALUE 0xFD65D4 KwWU16 65535.00 dez 0.00 65535.00 FORMAT "%8.2" /end CHARACTERISTIC
/begin CHARACTERISTIC CDKLSVV "Codewort Kunde: Vertauschte Lambda- Sonden vor Kat" VALUE 0xFD6620 KwUw 65535.00 dez 0.00 65535.00 FORMAT "%8.2" /end CHARACTERISTIC
/begin CHARACTERISTIC CDKMDB "Codewort Kunde: Momentbegrenzung Sollmoment" VALUE 0xFD663C KwUw 65535.00 dez 0.00 65535.00 FORMAT "%8.2" /end CHARACTERISTIC
/begin CHARACTERISTIC CDKMFL "Codewort Kunde: Multifunktionslenkrad" VALUE 0xFD663E KwWU16 65535.00 dez 0.00 65535.00 FORMAT "%8.2" /end CHARACTERISTIC
/begin CHARACTERISTIC CDKMINHUB "" VALUE 0xFD6640 KwUw 65535.00 dez 0.00 65535.00 FORMAT "%8.2" /end CHARACTERISTIC
/begin CHARACTERISTIC CDKMTOEL "" VALUE 0xFD6644 KwWU16 65535.00 dez 0.00 65535.00 FORMAT "%8.2" /end CHARACTERISTIC
/begin CHARACTERISTIC CDKNVRMON "Codewort Kunde: NVRAM Backup Aktualit‰ts¸berwachung" VALUE 0xFD664A KwUw 65535.00 dez 0.00 65535.00 FORMAT "%8.2" /end CHARACTERISTIC
/begin CHARACTERISTIC CDKNWKW "Codewort Kunde: Zuordnung Nockwelle zu Kurbelwelle" VALUE 0xFD664C KwWU16 65535.00 dez 0.00 65535.00 FORMAT "%8.2" /end CHARACTERISTIC
/begin CHARACTERISTIC CDKOEZS "Parameter f¸r Fehlerspeicherverwaltung" VALUE 0xFD664E KwWU16 65535.00 dez 0.00 65535.00 FORMAT "%8.2" /end CHARACTERISTIC
/begin CHARACTERISTIC CDKPDDSS "Codewort Kunde: Druck Differenzdrucksensor Saugrohr" VALUE 0xFD6650 KwUw 65535.00 dez 0.00 65535.00 FORMAT "%8.2" /end CHARACTERISTIC
/begin CHARACTERISTIC CDKSLVE "Codewort Kunde:	Sekund‰rluftventil (Endstufe)" VALUE 0xFD6678 KwWU16 65535.00 dez 0.00 65535.00 FORMAT "%8.2" /end CHARACTERISTIC
/begin CHARACTERISTIC CDKTA "Codewort Kunde:	TANS" VALUE 0xFD6682 KwUw 65535.00 dez 0.00 65535.00 FORMAT "%8.2" /end CHARACTERISTIC
/begin CHARACTERISTIC CDKTKA "Codewort Kunde: Temperatur am K¸hlerausgang" VALUE 0xFD668C KwWU16 65535.00 dez 0.00 65535.00 FORMAT "%8.2" /end CHARACTERISTIC
/begin CHARACTERISTIC CDKTM "Codewort Kunde: TMOT" VALUE 0xFD668E KwUw 65535.00 dez 0.00 65535.00 FORMAT "%8.2" /end CHARACTERISTIC
/begin CHARACTERISTIC CDKTUM "Codewort Kunde: Umgebungstemperatur" VALUE 0xFD6690 KwWU16 65535.00 dez 0.00 65535.00 FORMAT "%8.2" /end CHARACTERISTIC
/begin CHARACTERISTIC CDKUB "Codewort Kunde:	UB" VALUE 0xFD6692 KwWU16 65535.00 dez 0.00 65535.00 FORMAT "%8.2" /end CHARACTERISTIC
/begin CHARACTERISTIC CDKVVTE "Codewort Kunde: VVT- Endstufe" VALUE 0xFD66B0 KwWU16 65535.00 dez 0.00 65535.00 FORMAT "%8.2" /end CHARACTERISTIC
/begin CHARACTERISTIC CDKWCA "Codewort Kunde: Wegfahrsperre Wechselcode-Ablage" VALUE 0xFD66B2 KwUw 65535.00 dez 0.00 65535.00 FORMAT "%8.2" /end CHARACTERISTIC
/begin CHARACTERISTIC CDKWFS "Codewort Kunde: Wegfahrsperre" VALUE 0xFD66B4 KwUw 65535.00 dez 0.00 65535.00 FORMAT "%8.2" /end CHARACTERISTIC
/begin CHARACTERISTIC CDTBREMS "Fehlerpfadcode: BREMS (Bremsschalter)" VALUE 0xFD66D4 KwUw 65535.00 dez 0.00 65535.00 FORMAT "%8.2" /end CHARACTERISTIC
/begin CHARACTERISTIC CDTBWF "Codewort Tester: PWG Bewegung" VALUE 0xFD66D6 KwUw 65535.00 dez 0.00 65535.00 FORMAT "%8.2" /end CHARACTERISTIC
/begin CHARACTERISTIC CDTDDSS "Codewort Tester: Differenzdrucksensor Saugrohr" VALUE 0xFD66F8 KwUw 65535.00 dez 0.00 65535.00 FORMAT "%8.2" /end CHARACTERISTIC
/begin CHARACTERISTIC CDTDGEN "Codewort Tester Generator" VALUE 0xFD66FA KwWU16 65535.00 dez 0.00 65535.00 FORMAT "%8.2" /end CHARACTERISTIC
/begin CHARACTERISTIC CDTDGEN2 "" VALUE 0xFD66FC KwWU16 65535.00 dez 0.00 65535.00 FORMAT "%8.2" /end CHARACTERISTIC
/begin CHARACTERISTIC CDTDGENB2 "" VALUE 0xFD66FE KwWU16 65535.00 dez 0.00 65535.00 FORMAT "%8.2" /end CHARACTERISTIC
/begin CHARACTERISTIC CDTDGENBS "Codewort Tester Kommunikation" VALUE 0xFD6700 KwWU16 65535.00 dez 0.00 65535.00 FORMAT "%8.2" /end CHARACTERISTIC
/begin CHARACTERISTIC CDTDIBS1 "Codewort Tester IBS BSD Error" VALUE 0xFD6704 KwWU16 65535.00 dez 0.00 65535.00 FORMAT "%8.2" /end CHARACTERISTIC
/begin CHARACTERISTIC CDTDIBS2 "Codewort Tester IBS SW unplausibel" VALUE 0xFD6706 KwWU16 65535.00 dez 0.00 65535.00 FORMAT "%8.2" /end CHARACTERISTIC
/begin CHARACTERISTIC CDTDIBS3 "" VALUE 0xFD6708 KwWU16 65535.00 dez 0.00 65535.00 FORMAT "%8.2" /end CHARACTERISTIC
/begin CHARACTERISTIC CDTDMTKNM "Codewort Tester: Kleinstleck ohne MIL Ansteuerung" VALUE 0xFD671A KwWU16 65535.00 dez 0.00 65535.00 FORMAT "%8.2" /end CHARACTERISTIC
/begin CHARACTERISTIC CDTDSU "Codewort Tester: Drucksensor Umgebung" VALUE 0xFD6720 KwUw 65535.00 dez 0.00 65535.00 FORMAT "%8.2" /end CHARACTERISTIC
/begin CHARACTERISTIC CDTDWA "Codewort Tester: Diebstahlwarnanlage" VALUE 0xFD6768 KwUw 65535.00 dez 0.00 65535.00 FORMAT "%8.2" /end CHARACTERISTIC
/begin CHARACTERISTIC CDTDZKU0 "Codewort Tester: Z¸ndspule 0" VALUE 0xFD676E KwWU16 65535.00 dez 0.00 65535.00 FORMAT "%8.2" /end CHARACTERISTIC
/begin CHARACTERISTIC CDTDZKU1 "Codewort Tester: Z¸ndspule 1" VALUE 0xFD6770 KwWU16 65535.00 dez 0.00 65535.00 FORMAT "%8.2" /end CHARACTERISTIC
/begin CHARACTERISTIC CDTDZKU2 "Codewort Tester: Z¸ndspule 2" VALUE 0xFD6772 KwWU16 65535.00 dez 0.00 65535.00 FORMAT "%8.2" /end CHARACTERISTIC
/begin CHARACTERISTIC CDTDZKU3 "Codewort Tester: Z¸ndspule 3" VALUE 0xFD6774 KwWU16 65535.00 dez 0.00 65535.00 FORMAT "%8.2" /end CHARACTERISTIC
/begin CHARACTERISTIC CDTDZKU4 "Codewort Tester: Z¸ndspule 4" VALUE 0xFD6776 KwWU16 65535.00 dez 0.00 65535.00 FORMAT "%8.2" /end CHARACTERISTIC
/begin CHARACTERISTIC CDTDZKU5 "Codewort Tester: Z¸ndspule 5" VALUE 0xFD6778 KwWU16 65535.00 dez 0.00 65535.00 FORMAT "%8.2" /end CHARACTERISTIC
/begin CHARACTERISTIC CDTDZKU6 "Codewort Tester: Z¸ndspule 6" VALUE 0xFD677A KwWU16 65535.00 dez 0.00 65535.00 FORMAT "%8.2" /end CHARACTERISTIC
/begin CHARACTERISTIC CDTDZKU7 "Codewort Tester: Z¸ndspule 7" VALUE 0xFD677C KwWU16 65535.00 dez 0.00 65535.00 FORMAT "%8.2" /end CHARACTERISTIC
/begin CHARACTERISTIC CDTEGFE "Codeowort Tester: Eingangsgrˆﬂe F¸llungserfassung" VALUE 0xFD677E KwUw 65535.00 dez 0.00 65535.00 FORMAT "%8.2" /end CHARACTERISTIC
/begin CHARACTERISTIC CDTFP1P "Codewort Tester: Poti 1, Fahrpedal" VALUE 0xFD679C KwUw 65535.00 dez 0.00 65535.00 FORMAT "%8.2" /end CHARACTERISTIC
/begin CHARACTERISTIC CDTFP2P "Codewort Tester: Poti 2, Fahrpedal" VALUE 0xFD679E KwUw 65535.00 dez 0.00 65535.00 FORMAT "%8.2" /end CHARACTERISTIC
/begin CHARACTERISTIC CDTFPP "Codewort Tester: Poti Fahrpedal" VALUE 0xFD67A0 KwUw 65535.00 dez 0.00 65535.00 FORMAT "%8.2" /end CHARACTERISTIC
/begin CHARACTERISTIC CDTHSVSA "Codewort Tester: Lambdasonden-Heizung vor Katalysator" VALUE 0xFD67C6 KwWU16 65535.00 dez 0.00 65535.00 FORMAT "%8.2" /end CHARACTERISTIC
/begin CHARACTERISTIC CDTHSVSA2 "Codewort Tester: Lambdasonden-Heizung vor Kat., Bank 2" VALUE 0xFD67C8 KwWU16 65535.00 dez 0.00 65535.00 FORMAT "%8.2" /end CHARACTERISTIC
/begin CHARACTERISTIC CDTLSVV "Codewort Tester: Vertauschte Lambda-Sonde vor Kat" VALUE 0xFD6814 KwUw 65535.00 dez 0.00 65535.00 FORMAT "%8.2" /end CHARACTERISTIC
/begin CHARACTERISTIC CDTMDB "Codewort Tester: Momentbegrenzung Sollmoment" VALUE 0xFD6830 KwUw 65535.00 dez 0.00 65535.00 FORMAT "%8.2" /end CHARACTERISTIC
/begin CHARACTERISTIC CDTMFL "Codewort Tester: Multifunktionslenkrad" VALUE 0xFD6832 KwWU16 65535.00 dez 0.00 65535.00 FORMAT "%8.2" /end CHARACTERISTIC
/begin CHARACTERISTIC CDTMINHUB "" VALUE 0xFD6834 KwUw 65535.00 dez 0.00 65535.00 FORMAT "%8.2" /end CHARACTERISTIC
/begin CHARACTERISTIC CDTMTOEL "" VALUE 0xFD6838 KwWU16 65535.00 dez 0.00 65535.00 FORMAT "%8.2" /end CHARACTERISTIC
/begin CHARACTERISTIC CDTNVRMON "Codewort Tester: NVRAM Backup Aktualit‰ts¸berwachung" VALUE 0xFD683E KwUw 65535.00 dez 0.00 65535.00 FORMAT "%8.2" /end CHARACTERISTIC
/begin CHARACTERISTIC CDTNWKW "Codewort Tester: Zuordnung Nockenwelle zu Kurbelwelle" VALUE 0xFD6840 KwWU16 65535.00 dez 0.00 65535.00 FORMAT "%8.2" /end CHARACTERISTIC
/begin CHARACTERISTIC CDTOEZS "Parameter f¸r Fehlerspeicherverwaltung" VALUE 0xFD6842 KwWU16 65535.00 dez 0.00 65535.00 FORMAT "%8.2" /end CHARACTERISTIC
/begin CHARACTERISTIC CDTPDDSS "Codewort Tester: Druck Differenzdrucksensor Saugrohr" VALUE 0xFD6844 KwUw 65535.00 dez 0.00 65535.00 FORMAT "%8.2" /end CHARACTERISTIC
/begin CHARACTERISTIC CDTSLVE "Codewort Tester: Sekund‰rluftventil (Endstufe)" VALUE 0xFD686C KwWU16 65535.00 dez 0.00 65535.00 FORMAT "%8.2" /end CHARACTERISTIC
/begin CHARACTERISTIC CDTTA "Codewort Tester: TANS" VALUE 0xFD6876 KwUw 65535.00 dez 0.00 65535.00 FORMAT "%8.2" /end CHARACTERISTIC
/begin CHARACTERISTIC CDTTKA "Codewort Tester: Temperatur K¸hlerausgang" VALUE 0xFD6880 KwWU16 65535.00 dez 0.00 65535.00 FORMAT "%8.2" /end CHARACTERISTIC
/begin CHARACTERISTIC CDTTM "Codewort Tester: TMOT" VALUE 0xFD6882 KwUw 65535.00 dez 0.00 65535.00 FORMAT "%8.2" /end CHARACTERISTIC
/begin CHARACTERISTIC CDTTUM "Codewort Tester: Umgebungstemperatur TUM" VALUE 0xFD6884 KwWU16 65535.00 dez 0.00 65535.00 FORMAT "%8.2" /end CHARACTERISTIC
/begin CHARACTERISTIC CDTUB "Codewort Tester: UB" VALUE 0xFD6886 KwWU16 65535.00 dez 0.00 65535.00 FORMAT "%8.2" /end CHARACTERISTIC
/begin CHARACTERISTIC CDTVVTE "Codewort Tester: Endstufe VVT" VALUE 0xFD68A4 KwWU16 65535.00 dez 0.00 65535.00 FORMAT "%8.2" /end CHARACTERISTIC
/begin CHARACTERISTIC CDTWCA "Codewort Tester: Wegfahrsperre Wechselcode-Ablage" VALUE 0xFD68A6 KwUw 65535.00 dez 0.00 65535.00 FORMAT "%8.2" /end CHARACTERISTIC
/begin CHARACTERISTIC CDTWFS "Codewort Tester: Wegfahrsperre" VALUE 0xFD68A8 KwUw 65535.00 dez 0.00 65535.00 FORMAT "%8.2" /end CHARACTERISTIC
/begin CHARACTERISTIC CLABREMS "Fehlerklasse: BREMS (Bremsschalter)" VALUE 0xFD572B KwUb 255.0 dez 0.00 255.0 FORMAT "%5.1" /end CHARACTERISTIC
/begin CHARACTERISTIC CLABWF "Fehlerklasse:  PWG Bewegung" VALUE 0xFD572C KwUb 255.0 dez 0.00 255.0 FORMAT "%5.1" /end CHARACTERISTIC
/begin CHARACTERISTIC CLADDSS "Fehlerklasse: Differenzdrucksensor Saugrohr" VALUE 0xFD573D KwUb 255.0 dez 0.00 255.0 FORMAT "%5.1" /end CHARACTERISTIC
/begin CHARACTERISTIC CLADGEN "Fehlerklasse: Generator" VALUE 0xFD573E KwWU8 255.0 dez 0.00 255.0 FORMAT "%5.1" /end CHARACTERISTIC
/begin CHARACTERISTIC CLADGEN2 "" VALUE 0xFD573F KwWU8 255.0 dez 0.00 255.0 FORMAT "%5.1" /end CHARACTERISTIC
/begin CHARACTERISTIC CLADGENB2 "" VALUE 0xFD5740 KwWU8 255.0 dez 0.00 255.0 FORMAT "%5.1" /end CHARACTERISTIC
/begin CHARACTERISTIC CLADGENBS "Fehlerklasse: Kommunikation" VALUE 0xFD5741 KwWU8 255.0 dez 0.00 255.0 FORMAT "%5.1" /end CHARACTERISTIC
/begin CHARACTERISTIC CLADIBS1 "Verwaltungsklasse Entprelldaten IBS BSD Error" VALUE 0xFD5743 KwWU8 255.0 dez 0.00 255.0 FORMAT "%5.1" /end CHARACTERISTIC
/begin CHARACTERISTIC CLADIBS2 "Verwaltungsklasse IBS SW unplausibel" VALUE 0xFD5744 KwWU8 255.0 dez 0.00 255.0 FORMAT "%5.1" /end CHARACTERISTIC
/begin CHARACTERISTIC CLADIBS3 "" VALUE 0xFD5745 KwWU8 255.0 dez 0.00 255.0 FORMAT "%5.1" /end CHARACTERISTIC
/begin CHARACTERISTIC CLADMTKNM "Fehlerklasse: Kleinstleck, no MIL" VALUE 0xFD574E KwWU8 255.0 dez 0.00 255.0 FORMAT "%5.1" /end CHARACTERISTIC
/begin CHARACTERISTIC CLADSU "Fehlerklasse: Umgebungsdrucksensor" VALUE 0xFD5751 KwUb 255.0 dez 0.00 255.0 FORMAT "%5.1" /end CHARACTERISTIC
/begin CHARACTERISTIC CLADWA "Fehlerklasse: Diebstahlwarnanlage" VALUE 0xFD5775 KwUb 255.0 dez 0.00 255.0 FORMAT "%5.1" /end CHARACTERISTIC
/begin CHARACTERISTIC CLADZKU0 "Fehlerklasse: Z¸ndspule 0" VALUE 0xFD5778 KwWU8 255.0 dez 0.00 255.0 FORMAT "%5.1" /end CHARACTERISTIC
/begin CHARACTERISTIC CLADZKU1 "Fehlerklasse: Z¸ndspule 1" VALUE 0xFD5779 KwWU8 255.0 dez 0.00 255.0 FORMAT "%5.1" /end CHARACTERISTIC
/begin CHARACTERISTIC CLADZKU2 "Fehlerklasse: Z¸ndspule 2" VALUE 0xFD577A KwWU8 255.0 dez 0.00 255.0 FORMAT "%5.1" /end CHARACTERISTIC
/begin CHARACTERISTIC CLADZKU3 "Fehlerklasse: Z¸ndspule 3" VALUE 0xFD577B KwWU8 255.0 dez 0.00 255.0 FORMAT "%5.1" /end CHARACTERISTIC
/begin CHARACTERISTIC CLADZKU4 "Fehlerklasse: Z¸ndspule 4" VALUE 0xFD577C KwWU8 255.0 dez 0.00 255.0 FORMAT "%5.1" /end CHARACTERISTIC
/begin CHARACTERISTIC CLADZKU5 "Fehlerklasse: Z¸ndspule 5" VALUE 0xFD577D KwWU8 255.0 dez 0.00 255.0 FORMAT "%5.1" /end CHARACTERISTIC
/begin CHARACTERISTIC CLADZKU6 "Fehlerklasse: Z¸ndspule 6" VALUE 0xFD577E KwWU8 255.0 dez 0.00 255.0 FORMAT "%5.1" /end CHARACTERISTIC
/begin CHARACTERISTIC CLADZKU7 "Fehlerklasse: Z¸ndspule 7" VALUE 0xFD577F KwWU8 255.0 dez 0.00 255.0 FORMAT "%5.1" /end CHARACTERISTIC
/begin CHARACTERISTIC CLAEGFE "Fehlerklasse: Lasterfassung" VALUE 0xFD5780 KwUb 255.0 dez 0.00 255.0 FORMAT "%5.1" /end CHARACTERISTIC
/begin CHARACTERISTIC CLAFP1P "Fehlerklasse: Poti 1, Fahrpedal" VALUE 0xFD578F KwUb 255.0 dez 0.00 255.0 FORMAT "%5.1" /end CHARACTERISTIC
/begin CHARACTERISTIC CLAFP2P "Fehlerklasse: Poti 2, Fahrpedal" VALUE 0xFD5790 KwUb 255.0 dez 0.00 255.0 FORMAT "%5.1" /end CHARACTERISTIC
/begin CHARACTERISTIC CLAFPP "Fehlerklasse: Poti Fahrpedal" VALUE 0xFD5791 KwUb 255.0 dez 0.00 255.0 FORMAT "%5.1" /end CHARACTERISTIC
/begin CHARACTERISTIC CLAHSVSA "Fehlerklasse: Heizung Lambdasonde vor Kat" VALUE 0xFD57A4 KwWU8 255.0 dez 0.00 255.0 FORMAT "%5.1" /end CHARACTERISTIC
/begin CHARACTERISTIC CLAHSVSA2 "Fehlerklasse: Heizung Lambdasonde 2 vor Kat" VALUE 0xFD57A5 KwWU8 255.0 dez 0.00 255.0 FORMAT "%5.1" /end CHARACTERISTIC
/begin CHARACTERISTIC CLALSVV "Fehlerklasse: Vertauschte Lambda-Sonden vor Kat" VALUE 0xFD57CB KwUb 255.0 dez 0.00 255.0 FORMAT "%5.1" /end CHARACTERISTIC
/begin CHARACTERISTIC CLAMDB "Fehlerklasse: Momentbgrenzung Sollmoment" VALUE 0xFD57D9 KwUb 255.0 dez 0.00 255.0 FORMAT "%5.1" /end CHARACTERISTIC
/begin CHARACTERISTIC CLAMFL "Fehlerklasse: Multifunktionslenkrad" VALUE 0xFD57DA KwWU8 255.0 dez 0.00 255.0 FORMAT "%5.1" /end CHARACTERISTIC
/begin CHARACTERISTIC CLAMINHUB "" VALUE 0xFD57DB KwUb 255.0 dez 0.00 255.0 FORMAT "%5.1" /end CHARACTERISTIC
/begin CHARACTERISTIC CLAMTOEL "" VALUE 0xFD57DD KwWU8 255.0 dez 0.00 255.0 FORMAT "%5.1" /end CHARACTERISTIC
/begin CHARACTERISTIC CLANVRMON "Fehlerklasse: NVRAM Backup Aktualit‰ts¸berwachung" VALUE 0xFD57E0 KwUb 255.0 dez 0.00 255.0 FORMAT "%5.1" /end CHARACTERISTIC
/begin CHARACTERISTIC CLANWKW "Fehlerklasse: Zuordnung Nockenwelle zu Kurbelwelle" VALUE 0xFD57E1 KwWU8 255.0 dez 0.00 255.0 FORMAT "%5.1" /end CHARACTERISTIC
/begin CHARACTERISTIC CLAOEZS "Parameter f¸r Fehlerspeicherverwaltung" VALUE 0xFD57E2 KwWU8 255.0 dez 0.00 255.0 FORMAT "%5.1" /end CHARACTERISTIC
/begin CHARACTERISTIC CLAPDDSS "Fehlerklasse: Druck Differenzdrucksensor Saugrohr" VALUE 0xFD57E3 KwUb 255.0 dez 0.00 255.0 FORMAT "%5.1" /end CHARACTERISTIC
/begin CHARACTERISTIC CLASLVE "Fehlerklasse: Sekund‰rluftventil Endstufe" VALUE 0xFD57F7 KwWU8 255.0 dez 0.00 255.0 FORMAT "%5.1" /end CHARACTERISTIC
/begin CHARACTERISTIC CLATA "Fehlerklasse: Ansauglufttemperatur TANS (/Ladeluft-)" VALUE 0xFD57FC KwUb 255.0 dez 0.00 255.0 FORMAT "%5.1" /end CHARACTERISTIC
/begin CHARACTERISTIC CLATKA "Fehlerklasse: Temperatur K¸hlerausgang" VALUE 0xFD5801 KwWU8 255.0 dez 0.00 255.0 FORMAT "%5.1" /end CHARACTERISTIC
/begin CHARACTERISTIC CLATM "Fehlerklasse: Motortemperatur TMOT" VALUE 0xFD5802 KwUb 255.0 dez 0.00 255.0 FORMAT "%5.1" /end CHARACTERISTIC
/begin CHARACTERISTIC CLATUM "Fehlerklasse: Umgebungstemperatur TUM" VALUE 0xFD5803 KwWU8 255.0 dez 0.00 255.0 FORMAT "%5.1" /end CHARACTERISTIC
/begin CHARACTERISTIC CLAUB "Fehlerklasse: Batteriespannung UB (Bordnetz)" VALUE 0xFD5804 KwWU8 255.0 dez 0.00 255.0 FORMAT "%5.1" /end CHARACTERISTIC
/begin CHARACTERISTIC CLAVVTE "Fehlerklasse: VVT- Endstufe" VALUE 0xFD5813 KwWU8 255.0 dez 0.00 255.0 FORMAT "%5.1" /end CHARACTERISTIC
/begin CHARACTERISTIC CLAWCA "Fehlerklasse: Wegfahrsperre Wechselcode- Ablage" VALUE 0xFD5814 KwUb 255.0 dez 0.00 255.0 FORMAT "%5.1" /end CHARACTERISTIC
/begin CHARACTERISTIC CLAWFS "Fehlerklasse: Wegfahrsperre" VALUE 0xFD5815 KwUb 255.0 dez 0.00 255.0 FORMAT "%5.1" /end CHARACTERISTIC
/begin CHARACTERISTIC CWDHELSU "Codewort DHELSU" VALUE 0xFD0102 KwUb 255.0 dez 0.00 255.0 FORMAT "%5.1" /end CHARACTERISTIC
/begin CHARACTERISTIC CWDHLSH "Codewort in DHLSHK" VALUE 0xFD010A KwUb 255.0 dez 0.00 255.0 FORMAT "%5.1" /end CHARACTERISTIC
/begin CHARACTERISTIC CWDHRLSU "Codewort f¸r Freigabe DHRLSU" VALUE 0xFD01AC KwUb 3.000 dez 0.00 3.000 FORMAT "%5.3" /end CHARACTERISTIC
/begin CHARACTERISTIC CWFSTD "Codewort Tankfuellstandsdiagnose" VALUE 0xFD0515 KwUb 255.0 dez 0.00 255.0 FORMAT "%5.1" /end CHARACTERISTIC
/begin CHARACTERISTIC CWPSDHDMTE "Codewort f¸r Endstufendiagnose DM-TL Heizung aktiv" VALUE 0xFD056A KwWU8 255.0 dez 0.00 255.0 FORMAT "%5.1" /end CHARACTERISTIC
/begin CHARACTERISTIC CWPSGLFE "Codewort f¸r Endstufendiagnose gesteuerte Luftf¸hrung" VALUE 0xFD0569 KwWU8 255.0 dez 0.00 255.0 FORMAT "%5.1" /end CHARACTERISTIC
/begin CHARACTERISTIC CW_DHFM "" VALUE 0xFC40A8 KwWU8 255.0 default 0.00 255.0 FORMAT "%5.1" /end CHARACTERISTIC
/begin CHARACTERISTIC DFSKVO "Obere Toleranzgrenze fuer Fuellstandsgeberdiagnose" VALUE 0xFD051A KwSw 127.9961 vol_q3p90625Em3_l 0.00 127.9961 FORMAT "%8.4" /end CHARACTERISTIC
/begin CHARACTERISTIC DFSKVOTAV "Obere Toleranzgrenze fuer Fuellstandsgeberdiagnose bei Tank voll" VALUE 0xFD051C KwSw 127.9961 vol_q3p90625Em3_l 0.00 127.9961 FORMAT "%8.4" /end CHARACTERISTIC
/begin CHARACTERISTIC DFSKVU "Untere Toleranzgrenze fuer Fuellstandsgeberdiagnose" VALUE 0xFD051E KwSw 128.0000 vol_q3p90625Em3_l -128.0000 0.00 FORMAT "%8.4" /end CHARACTERISTIC
/begin CHARACTERISTIC DFSKVUTAV "Untere Toleranzgrenze fuer Fuellstandsgeberdiagnose bei Tank voll" VALUE 0xFD0520 KwSw 128.0000 vol_q3p90625Em3_l -128.0000 0.00 FORMAT "%8.4" /end CHARACTERISTIC
/begin CHARACTERISTIC DHFMOUMSCH "rlvw-Offset bei Umschaltung gedrosselt - ungedrosselt" VALUE 0xFC40AC KwUw 1535.977 rel_uw_q0p0234 0.00 1535.977 FORMAT "%8.3" /end CHARACTERISTIC
/begin CHARACTERISTIC DHFMUEBMN "" VALUE 0xFD0DDC KwUw 6553.500 m_q0p1 0.00 6553.500 FORMAT "%8.3" /end CHARACTERISTIC
/begin CHARACTERISTIC DHFMUEBMX "" VALUE 0xFD0DDE KwUw 6553.500 m_q0p1 0.00 6553.500 FORMAT "%8.3" /end CHARACTERISTIC
/begin CHARACTERISTIC DKVBD "Schwelle verbrauchter Kraftstoff f¸r Diagnosefreigabe" VALUE 0xFD0522 KwUw 255.9961 vol_q3p90625Em3_l 0.00 255.9961 FORMAT "%8.4" /end CHARACTERISTIC
/begin CHARACTERISTIC DKVBDTAV "Schwelle verbrauchter Kraftstoff fuer Diagnosefreigabe bei Tank voll" VALUE 0xFD0524 KwUw 255.9961 vol_q3p90625Em3_l 0.00 255.9961 FORMAT "%8.4" /end CHARACTERISTIC
/begin CHARACTERISTIC DRLHEMX "Schwelle f¸r Last‰nderung in der Heizerdiagnose" VALUE 0xFD0103 KwUb 191.3 rel_ub_q0p75 0.00 191.3 FORMAT "%5.1" /end CHARACTERISTIC
/begin CHARACTERISTIC FFTBREMS "Freeze Frame Tabelle: Pedalwertgeber Bremse" VAL_BLK 0xFD583D KwbUb 255.0 dez 0.00 255.0 FORMAT "%5.1" NUMBER 4 /end CHARACTERISTIC
/begin CHARACTERISTIC FFTBWF "Freeze Frame Tabelle: PWG Bewegung" VAL_BLK 0xFD5841 KwbUb 255.0 dez 0.00 255.0 FORMAT "%5.1" NUMBER 4 /end CHARACTERISTIC
/begin CHARACTERISTIC FFTDDSS "Freeze Frame Tabelle: Differenzdrucksensor Saugrohr" VAL_BLK 0xFD5885 KwbUb 255.0 dez 0.00 255.0 FORMAT "%5.1" NUMBER 4 /end CHARACTERISTIC
/begin CHARACTERISTIC FFTDGEN "Freeze Frame Table Generator" VAL_BLK 0xFD5889 KwbWU8 255.0 dez 0.00 255.0 FORMAT "%5.1" NUMBER 4 /end CHARACTERISTIC
/begin CHARACTERISTIC FFTDGEN2 "" VAL_BLK 0xFD588D KwbWU8 255.0 dez 0.00 255.0 FORMAT "%5.1" NUMBER 4 /end CHARACTERISTIC
/begin CHARACTERISTIC FFTDGENB2 "" VAL_BLK 0xFD5891 KwbWU8 255.0 dez 0.00 255.0 FORMAT "%5.1" NUMBER 4 /end CHARACTERISTIC
/begin CHARACTERISTIC FFTDGENBS "Freeze Frame Table Kommunikation" VAL_BLK 0xFD5895 KwbWU8 255.0 dez 0.00 255.0 FORMAT "%5.1" NUMBER 4 /end CHARACTERISTIC
/begin CHARACTERISTIC FFTDIBS1 "Freeze Frame Table IBS BSD Error" VAL_BLK 0xFD589D KwbWU8 255.0 dez 0.00 255.0 FORMAT "%5.1" NUMBER 4 /end CHARACTERISTIC
/begin CHARACTERISTIC FFTDIBS2 "Freeze Frame Table IBS SW unplausibel" VAL_BLK 0xFD58A1 KwbWU8 255.0 dez 0.00 255.0 FORMAT "%5.1" NUMBER 4 /end CHARACTERISTIC
/begin CHARACTERISTIC FFTDIBS3 "" VAL_BLK 0xFD58A5 KwbWU8 255.0 dez 0.00 255.0 FORMAT "%5.1" NUMBER 4 /end CHARACTERISTIC
/begin CHARACTERISTIC FFTDMTKNM "Freeze Frame Tabelle: Kleinstleck, no MIL" VAL_BLK 0xFD58C9 KwbWU8 255.0 dez 0.00 255.0 FORMAT "%5.1" NUMBER 4 /end CHARACTERISTIC
/begin CHARACTERISTIC FFTDSU "Freeze Frame Tabelle: Umgebungsdrucksensor" VAL_BLK 0xFD58D5 KwbUb 255.0 dez 0.00 255.0 FORMAT "%5.1" NUMBER 4 /end CHARACTERISTIC
/begin CHARACTERISTIC FFTDWA "Freeze Frame Tabelle: Diebstahlwarnanlage" VAL_BLK 0xFD5965 KwbUb 255.0 dez 0.00 255.0 FORMAT "%5.1" NUMBER 4 /end CHARACTERISTIC
/begin CHARACTERISTIC FFTDZKU0 "Freeze Frame Tabelle: Z¸ndspule 0" VAL_BLK 0xFD5971 KwbWU8 255.0 dez 0.00 255.0 FORMAT "%5.1" NUMBER 4 /end CHARACTERISTIC
/begin CHARACTERISTIC FFTDZKU1 "Freeze Frame Tabelle: Z¸ndspule 1" VAL_BLK 0xFD5975 KwbWU8 255.0 dez 0.00 255.0 FORMAT "%5.1" NUMBER 4 /end CHARACTERISTIC
/begin CHARACTERISTIC FFTDZKU2 "Freeze Frame Tabelle: Z¸ndspule 2" VAL_BLK 0xFD5979 KwbWU8 255.0 dez 0.00 255.0 FORMAT "%5.1" NUMBER 4 /end CHARACTERISTIC
/begin CHARACTERISTIC FFTDZKU3 "Freeze Frame Tabelle: Z¸ndspule 3" VAL_BLK 0xFD597D KwbWU8 255.0 dez 0.00 255.0 FORMAT "%5.1" NUMBER 4 /end CHARACTERISTIC
/begin CHARACTERISTIC FFTDZKU4 "Freeze Frame Tabelle: Z¸ndspule 4" VAL_BLK 0xFD5981 KwbWU8 255.0 dez 0.00 255.0 FORMAT "%5.1" NUMBER 4 /end CHARACTERISTIC
/begin CHARACTERISTIC FFTDZKU5 "Freeze Frame Tabelle: Z¸ndspule 5" VAL_BLK 0xFD5985 KwbWU8 255.0 dez 0.00 255.0 FORMAT "%5.1" NUMBER 4 /end CHARACTERISTIC
/begin CHARACTERISTIC FFTDZKU6 "Freeze Frame Tabelle: Z¸ndspule 6" VAL_BLK 0xFD5989 KwbWU8 255.0 dez 0.00 255.0 FORMAT "%5.1" NUMBER 4 /end CHARACTERISTIC
/begin CHARACTERISTIC FFTDZKU7 "Freeze Frame Tabelle: Z¸ndspule 7" VAL_BLK 0xFD598D KwbWU8 255.0 dez 0.00 255.0 FORMAT "%5.1" NUMBER 4 /end CHARACTERISTIC
/begin CHARACTERISTIC FFTEGFE "Freeze Frame Tabelle: Lasterfassung" VAL_BLK 0xFD5991 KwbUb 255.0 dez 0.00 255.0 FORMAT "%5.1" NUMBER 4 /end CHARACTERISTIC
/begin CHARACTERISTIC FFTFP1P "Freeze Frame Tabelle: Poti 1, Fahrpedal" VAL_BLK 0xFD59CD KwbUb 255.0 dez 0.00 255.0 FORMAT "%5.1" NUMBER 4 /end CHARACTERISTIC
/begin CHARACTERISTIC FFTFP2P "Freeze Frame Tabelle: Poti 2, Fahrpedal" VAL_BLK 0xFD59D1 KwbUb 255.0 dez 0.00 255.0 FORMAT "%5.1" NUMBER 4 /end CHARACTERISTIC
/begin CHARACTERISTIC FFTFPP "Freeze Frame Tabelle: Poti Fahrpedal" VAL_BLK 0xFD59D5 KwbUb 255.0 dez 0.00 255.0 FORMAT "%5.1" NUMBER 4 /end CHARACTERISTIC
/begin CHARACTERISTIC FFTHSVSA "Tabelle Umweltbedingungen Heizung Lambdasonde vor Kat" VAL_BLK 0xFD5A21 KwbWU8 255.0 dez 0.00 255.0 FORMAT "%5.1" NUMBER 4 /end CHARACTERISTIC
/begin CHARACTERISTIC FFTHSVSA2 "Tabelle Umweltbedingungen Heizung Lambdasonde vor Kat Bank2" VAL_BLK 0xFD5A25 KwbWU8 255.0 dez 0.00 255.0 FORMAT "%5.1" NUMBER 4 /end CHARACTERISTIC
/begin CHARACTERISTIC FFTLSVV "Tabelle Umweltbedingungen: Vertauschte Lambdasonden vor Kat" VAL_BLK 0xFD5ABD KwbUb 255.0 dez 0.00 255.0 FORMAT "%5.1" NUMBER 4 /end CHARACTERISTIC
/begin CHARACTERISTIC FFTMDB "Freeze Frame Tabelle: Momentbegrenzung Sollmoment" VAL_BLK 0xFD5AF5 KwbUb 255.0 dez 0.00 255.0 FORMAT "%5.1" NUMBER 4 /end CHARACTERISTIC
/begin CHARACTERISTIC FFTMFL "Freeze Frame Tabelle: Multifunktionslenkrad" VAL_BLK 0xFD5AF9 KwbWU8 255.0 dez 0.00 255.0 FORMAT "%5.1" NUMBER 4 /end CHARACTERISTIC
/begin CHARACTERISTIC FFTMINHUB "" VAL_BLK 0xFD5AFD KwbUb 255.0 dez 0.00 255.0 FORMAT "%5.1" NUMBER 4 /end CHARACTERISTIC
/begin CHARACTERISTIC FFTMTOEL "" VAL_BLK 0xFD5B05 KwbWU8 255.0 dez 0.00 255.0 FORMAT "%5.1" NUMBER 4 /end CHARACTERISTIC
/begin CHARACTERISTIC FFTNVRMON "Freeze Frame Tabelle: NVRAM Backup Aktualit‰ts-‹berwachung" VAL_BLK 0xFD5B11 KwbUb 255.0 dez 0.00 255.0 FORMAT "%5.1" NUMBER 4 /end CHARACTERISTIC
/begin CHARACTERISTIC FFTNWKW "Freeze Frame Tabelle: Zuordnung Nockenwelle zu Kurbelwelle" VAL_BLK 0xFD5B15 KwbWU8 255.0 dez 0.00 255.0 FORMAT "%5.1" NUMBER 4 /end CHARACTERISTIC
/begin CHARACTERISTIC FFTOEZS "Parameter f¸r Fehlerspeicherverwaltung" VAL_BLK 0xFD5B19 KwbWU8 255.0 dez 0.00 255.0 FORMAT "%5.1" NUMBER 4 /end CHARACTERISTIC
/begin CHARACTERISTIC FFTPDDSS "Freeze Frame Tabelle: Druck Differenzdrucksensor Saugrohr" VAL_BLK 0xFD5B1D KwbUb 255.0 dez 0.00 255.0 FORMAT "%5.1" NUMBER 4 /end CHARACTERISTIC
/begin CHARACTERISTIC FFTSLVE "Freeze Frame Tabelle: Sekund‰rluftventil Endstufe" VAL_BLK 0xFD5B6D KwbWU8 255.0 dez 0.00 255.0 FORMAT "%5.1" NUMBER 4 /end CHARACTERISTIC
/begin CHARACTERISTIC FFTTA "Freeze Frame Tabelle: Ansauglufttemperatur TANS (/Ladeluft-)" VAL_BLK 0xFD5B81 KwbUb 255.0 dez 0.00 255.0 FORMAT "%5.1" NUMBER 4 /end CHARACTERISTIC
/begin CHARACTERISTIC FFTTKA "Freeze Frame Tabelle: Temperatur K¸hlerausgang" VAL_BLK 0xFD5B95 KwbWU8 255.0 dez 0.00 255.0 FORMAT "%5.1" NUMBER 4 /end CHARACTERISTIC
/begin CHARACTERISTIC FFTTM "Freeze Frame Tabelle: Motortemperatur TMOT" VAL_BLK 0xFD5B99 KwbUb 255.0 dez 0.00 255.0 FORMAT "%5.1" NUMBER 4 /end CHARACTERISTIC
/begin CHARACTERISTIC FFTTUM "Freeze Frame Tabelle: Umgebungstemperatur TUM" VAL_BLK 0xFD5B9D KwbWU8 255.0 dez 0.00 255.0 FORMAT "%5.1" NUMBER 4 /end CHARACTERISTIC
/begin CHARACTERISTIC FFTUB "Freeze Frame Tabelle: Batteriespannung UB (Bordnetz)" VAL_BLK 0xFD5BA1 KwbWU8 255.0 dez 0.00 255.0 FORMAT "%5.1" NUMBER 4 /end CHARACTERISTIC
/begin CHARACTERISTIC FFTVVTE "Freeze Frame Tabelle: VVT- Endstufe" VAL_BLK 0xFD5BDD KwbWU8 255.0 dez 0.00 255.0 FORMAT "%5.1" NUMBER 4 /end CHARACTERISTIC
/begin CHARACTERISTIC FFTWCA "Freeze Frame Tabelle: Wegfahrsperre Wechselcode- Ablage" VAL_BLK 0xFD5BE1 KwbUb 255.0 dez 0.00 255.0 FORMAT "%5.1" NUMBER 4 /end CHARACTERISTIC
/begin CHARACTERISTIC FFTWFS "Freeze Frame Tabelle: Wegfahrsperre" VAL_BLK 0xFD5BE5 KwbUb 255.0 dez 0.00 255.0 FORMAT "%5.1" NUMBER 4 /end CHARACTERISTIC
/begin CHARACTERISTIC FRINH1 "Multiplikativer Faktor f¸r RIN Sollwert hinter Kat" CURVE 0xFD0112 KlAUbSstUwWUb 63.75 fak_ub_b64 0.00 63.75 FORMAT "%5.2"
 /begin AXIS_DESCR STD_AXIS tahsomf_w temp_q0p0234_o273 5 -273.1500 1262.827 FORMAT "%8.3" DEPOSIT ABSOLUTE /end AXIS_DESCR
/end CHARACTERISTIC
/begin CHARACTERISTIC FRINH2 "Multiplikativer Faktor f¸r RIN Sollwert hinter Kat" CURVE 0xFD0124 KlAUbSstUwWUb 63.75 fak_ub_b64 0.00 63.75 FORMAT "%5.2"
 /begin AXIS_DESCR STD_AXIS tahsomf2_w temp_q0p0234_o273 5 -273.1500 1262.827 FORMAT "%8.3" DEPOSIT ABSOLUTE /end AXIS_DESCR
/end CHARACTERISTIC
/begin CHARACTERISTIC FWMLHFMMN "Wichtungsfaktor f¸r minimale HFM-Luftmassen Schwelle in Abh‰ngigkeit von d.Hˆhe" CURVE 0xFD0DE0 KlAUwSstUwWUw 0.9999847 fak_uw_b1 0.00 0.9999847 FORMAT "%9.7"
 /begin AXIS_DESCR STD_AXIS fho_w fak_uw_b4 2 0.00 3.999939 FORMAT "%8.6" DEPOSIT ABSOLUTE /end AXIS_DESCR
/end CHARACTERISTIC
/begin CHARACTERISTIC GENPDTIME "Predrivetime f¸r Ladekontrollampe KL61" VALUE 0xFCA718 KwWU8 25.50 t100msxs_ub_b25p5 0.00 25.50 FORMAT "%5.2" /end CHARACTERISTIC
/begin CHARACTERISTIC GENPDTIME2 "" VALUE 0xFCA726 KwWU8 25.50 t100msxs_ub_b25p5 0.00 25.50 FORMAT "%5.2" /end CHARACTERISTIC
/begin CHARACTERISTIC GEN_DNMIN "Motordrehzahlschwelle  f¸r Auswertung der Generatordiagnose" VALUE 0xFCA714 KwWU16 16383.75 nmot_uw_q0p25 0.00 16383.75 FORMAT "%8.2" /end CHARACTERISTIC
/begin CHARACTERISTIC GEN_DNMIN2 "" VALUE 0xFCA722 KwWU16 16383.75 nmot_uw_q0p25 0.00 16383.75 FORMAT "%8.2" /end CHARACTERISTIC
/begin CHARACTERISTIC GFBSUTERR "Entprellzeit Fehlereintrag Kommunikation unplausibel" VALUE 0xFCA719 KwWU8 25.50 t100msxs_ub_b25p5 0.00 25.50 FORMAT "%5.2" /end CHARACTERISTIC
/begin CHARACTERISTIC GFBSUTERR2 "" VALUE 0xFCA727 KwWU8 25.50 t100msxs_ub_b25p5 0.00 25.50 FORMAT "%5.2" /end CHARACTERISTIC
/begin CHARACTERISTIC GFBSUTHEA2 "" VALUE 0xFCA728 KwWU8 25.50 t100msxs_ub_b25p5 0.00 25.50 FORMAT "%5.2" /end CHARACTERISTIC
/begin CHARACTERISTIC GFBSUTHEAL "Entprellzeit Fehlerheilung Kommunikation unplausibel" VALUE 0xFCA71A KwWU8 25.50 t100msxs_ub_b25p5 0.00 25.50 FORMAT "%5.2" /end CHARACTERISTIC
/begin CHARACTERISTIC GFELTERR "Entprellzeit Fehlereintrag elekt. Fehler" VALUE 0xFCA71B KwWU8 25.50 t100msxs_ub_b25p5 0.00 25.50 FORMAT "%5.2" /end CHARACTERISTIC
/begin CHARACTERISTIC GFELTERR2 "" VALUE 0xFCA729 KwWU8 25.50 t100msxs_ub_b25p5 0.00 25.50 FORMAT "%5.2" /end CHARACTERISTIC
/begin CHARACTERISTIC GFHTTERR "Entprellzeit Fehlereintrag Ueberhitzung" VALUE 0xFCA71C KwWU8 25.50 t100msxs_ub_b25p5 0.00 25.50 FORMAT "%5.2" /end CHARACTERISTIC
/begin CHARACTERISTIC GFHTTERR2 "" VALUE 0xFCA72A KwWU8 25.50 t100msxs_ub_b25p5 0.00 25.50 FORMAT "%5.2" /end CHARACTERISTIC
/begin CHARACTERISTIC GFHTTHEAL "Entprellzeit Fehlerheilung Ueberhitzung" VALUE 0xFCA71D KwWU8 25.50 t100msxs_ub_b25p5 0.00 25.50 FORMAT "%5.2" /end CHARACTERISTIC
/begin CHARACTERISTIC GFHTTHEAL2 "" VALUE 0xFCA72B KwWU8 25.50 t100msxs_ub_b25p5 0.00 25.50 FORMAT "%5.2" /end CHARACTERISTIC
/begin CHARACTERISTIC GFMETERR "Entprellzeit Fehlereintrag mechanischer Fehler" VALUE 0xFCA71E KwWU8 25.50 t100msxs_ub_b25p5 0.00 25.50 FORMAT "%5.2" /end CHARACTERISTIC
/begin CHARACTERISTIC GFMETERR2 "" VALUE 0xFCA72C KwWU8 25.50 t100msxs_ub_b25p5 0.00 25.50 FORMAT "%5.2" /end CHARACTERISTIC
/begin CHARACTERISTIC GFNOBTERR "Entprellzeit Fehlereintrag f. keine Kommunikation" VALUE 0xFCA71F KwWU8 25.50 t100msxs_ub_b25p5 0.00 25.50 FORMAT "%5.2" /end CHARACTERISTIC
/begin CHARACTERISTIC GFNOBTERR2 "" VALUE 0xFCA72D KwWU8 25.50 t100msxs_ub_b25p5 0.00 25.50 FORMAT "%5.2" /end CHARACTERISTIC
/begin CHARACTERISTIC KFDHFMMLO "Luftmassenstrom, Obere Toleranz" MAP 0xFD0DEA KfAxUwAyUwSstxUwSstyUwWUw 6553.500 m_uw_b6553p5 0.00 6553.500 FORMAT "%8.3"
 /begin AXIS_DESCR STD_AXIS nmot_w nmot_uw_q0p25 8 0.00 16383.75 FORMAT "%8.2" DEPOSIT ABSOLUTE /end AXIS_DESCR
 /begin AXIS_DESCR STD_AXIS rlvwdf_w rel_uw_q0p0234 8 0.00 1535.977 FORMAT "%8.3" DEPOSIT ABSOLUTE /end AXIS_DESCR
/end CHARACTERISTIC
/begin CHARACTERISTIC KFDHFMMLU "Luftmassenstrom, Untere Toleranz" MAP 0xFD0E8E KfAxUwAyUwSstxUwSstyUwWUw 6553.500 m_uw_b6553p5 0.00 6553.500 FORMAT "%8.3"
 /begin AXIS_DESCR STD_AXIS nmot_w nmot_uw_q0p25 8 0.00 16383.75 FORMAT "%8.2" DEPOSIT ABSOLUTE /end AXIS_DESCR
 /begin AXIS_DESCR STD_AXIS rlvwdf_w rel_uw_q0p0234 8 0.00 1535.977 FORMAT "%8.3" DEPOSIT ABSOLUTE /end AXIS_DESCR
/end CHARACTERISTIC
/begin CHARACTERISTIC KFMLD "Luftmassenstrom bei VVT-Notlauf und Fehler Diffdrucksensor" MAP 0xFD0F32 KfAxUwAyUwSstxUwSstyUwWUw 6553.500 m_uw_b6553p5 0.00 6553.500 FORMAT "%8.3"
 /begin AXIS_DESCR STD_AXIS wdkba_w relDK_q0p02441 8 -800.0000 799.9756 FORMAT "%8.4" DEPOSIT ABSOLUTE /end AXIS_DESCR
 /begin AXIS_DESCR STD_AXIS nmot_w nmot_uw_q0p25 8 0.00 16383.75 FORMAT "%8.2" DEPOSIT ABSOLUTE /end AXIS_DESCR
/end CHARACTERISTIC
/begin CHARACTERISTIC KFMLDDKMN "" MAP 0xFD0FD6 KfAxUwAyUwSstxSwSstyUwWUw 6553.500 m_q0p1 0.00 6553.500 FORMAT "%8.3"
 /begin AXIS_DESCR STD_AXIS wdkba_mldn relDK_q0p02441 8 -800.0000 799.9756 FORMAT "%8.4" DEPOSIT ABSOLUTE /end AXIS_DESCR
 /begin AXIS_DESCR STD_AXIS nmot_w nmot_uw_q0p25 8 0.00 16383.75 FORMAT "%8.2" DEPOSIT ABSOLUTE /end AXIS_DESCR
/end CHARACTERISTIC
/begin CHARACTERISTIC KFMLDDKMX "" MAP 0xFD107A KfAxUwAyUwSstxSwSstyUwWUw 6553.500 m_q0p1 0.00 6553.500 FORMAT "%8.3"
 /begin AXIS_DESCR STD_AXIS wdkba_mldm relDK_q0p02441 8 -800.0000 799.9756 FORMAT "%8.4" DEPOSIT ABSOLUTE /end AXIS_DESCR
 /begin AXIS_DESCR STD_AXIS nmot_w nmot_uw_q0p25 8 0.00 16383.75 FORMAT "%8.2" DEPOSIT ABSOLUTE /end AXIS_DESCR
/end CHARACTERISTIC
/begin CHARACTERISTIC KFMLDHUBMN "" MAP 0xFD111E KfAxUwAyUwSstxUwSstyUwWUw 6553.500 m_q0p1 0.00 6553.500 FORMAT "%8.3"
 /begin AXIS_DESCR STD_AXIS evhubimldn hub_uw_q0p001 8 0.00 65.53500 FORMAT "%8.5" DEPOSIT ABSOLUTE /end AXIS_DESCR
 /begin AXIS_DESCR STD_AXIS nmot_w nmot_uw_q0p25 8 0.00 16383.75 FORMAT "%8.2" DEPOSIT ABSOLUTE /end AXIS_DESCR
/end CHARACTERISTIC
/begin CHARACTERISTIC KFMLDHUBMX "" MAP 0xFD11C2 KfAxUwAyUwSstxUwSstyUwWUw 6553.500 m_q0p1 0.00 6553.500 FORMAT "%8.3"
 /begin AXIS_DESCR STD_AXIS evhubimldm hub_uw_q0p001 8 0.00 65.53500 FORMAT "%8.5" DEPOSIT ABSOLUTE /end AXIS_DESCR
 /begin AXIS_DESCR STD_AXIS nmot_w nmot_uw_q0p25 8 0.00 16383.75 FORMAT "%8.2" DEPOSIT ABSOLUTE /end AXIS_DESCR
/end CHARACTERISTIC
/begin CHARACTERISTIC KFRINH "Kennfeld f¸r Nernst-Innenwiderstand hinter Kat" MAP 0xFD0136 KfAxUbAyUbSstxUwSstyUbWUb 2040. r_q8 0.00 2040. FORMAT "%5.0"
 /begin AXIS_DESCR STD_AXIS tahsomf_w temp_q0p0234_o273 5 -273.1500 1262.827 FORMAT "%8.3" DEPOSIT ABSOLUTE /end AXIS_DESCR
 /begin AXIS_DESCR STD_AXIS phlsnhf fak_ub_q0p01 3 0.00 2.550 FORMAT "%5.3" DEPOSIT ABSOLUTE /end AXIS_DESCR
/end CHARACTERISTIC
/begin CHARACTERISTIC KFRINH2 "Kennfeld f¸r Nernst-Innenwiderstand hinter Kat Bank2" MAP 0xFD0154 KfAxUbAyUbSstxUwSstyUbWUb 2040. r_q8 0.00 2040. FORMAT "%5.0"
 /begin AXIS_DESCR STD_AXIS tahsomf2_w temp_q0p0234_o273 5 -273.1500 1262.827 FORMAT "%8.3" DEPOSIT ABSOLUTE /end AXIS_DESCR
 /begin AXIS_DESCR STD_AXIS phlsnhf2 fak_ub_q0p01 3 0.00 2.550 FORMAT "%5.3" DEPOSIT ABSOLUTE /end AXIS_DESCR
/end CHARACTERISTIC
/begin CHARACTERISTIC KLSDULSUMX "Schwelle delta Spannung max pro Rechentakt" CURVE 0xFC2052 KlAUbSstUbWUw 319.9951 spg_uw_b5 0.00 319.9951 FORMAT "%8.4"
 /begin AXIS_DESCR STD_AXIS ub_helsu spg_q0p1 4 0.00 25.50 FORMAT "%5.2" DEPOSIT ABSOLUTE /end AXIS_DESCR
/end CHARACTERISTIC
/begin CHARACTERISTIC KLTKERDCMN "Batterieabh‰ngige Diagnoseschwelle f¸r Keramiktemperatur" CURVE 0xFD01B4 KlAUbSstUbWUw 1535.977 temp_q0p0234_o273 -273.1500 1262.827 FORMAT "%8.3"
 /begin AXIS_DESCR STD_AXIS ub_hsv spg_q0p1 4 0.00 25.50 FORMAT "%5.2" DEPOSIT ABSOLUTE /end AXIS_DESCR
/end CHARACTERISTIC
/begin CHARACTERISTIC KRIVKMX "Maximaler Korrekturwert krivk_w" VALUE 0xFD01C2 KwUw 2559.961 r_q0p0391 0.00 2559.961 FORMAT "%8.3" /end CHARACTERISTIC
/begin CHARACTERISTIC MLHFMMN "minimale HFM-Luftmassen Schwelle zum R¸cksetzen des Min-Fehlers" VALUE 0xFD1266 KwUw 6553.500 m_q0p1 0.00 6553.500 FORMAT "%8.3" /end CHARACTERISTIC
/begin CHARACTERISTIC MSKGE2KL61 "" VALUE 0xFCA72E KwWU8 255.0 dez 0.00 255.0 FORMAT "%5.1" /end CHARACTERISTIC
/begin CHARACTERISTIC MSKGENDFP "Bitmaske Generator Fehler-> DFP" VALUE 0xFCA720 KwWU8 255.0 dez 0.00 255.0 FORMAT "%5.1" /end CHARACTERISTIC
/begin CHARACTERISTIC MSKGENDFP2 "" VALUE 0xFCA72F KwWU8 255.0 dez 0.00 255.0 FORMAT "%5.1" /end CHARACTERISTIC
/begin CHARACTERISTIC MSKGENKL61 "Bitmaske fuer Generatorfehler -> Ladekontrolle" VALUE 0xFCA721 KwWU8 255.0 dez 0.00 255.0 FORMAT "%5.1" /end CHARACTERISTIC
/begin CHARACTERISTIC RINLSUPMN "Minimale Schwelle f¸r einen plausiblen Innenwiderstand der LSU" VALUE 0xFD01C4 KwUw 2559.961 r_q0p0391 0.00 2559.961 FORMAT "%8.3" /end CHARACTERISTIC
/begin CHARACTERISTIC SEFST "Wegstrecke Entprellung Fuellstandsgeberfehler" VALUE 0xFD0526 KwUw 22755.21 s_q0p34722_m 0.00 22755.21 FORMAT "%8.2" /end CHARACTERISTIC
/begin CHARACTERISTIC SLOWRMX "Maximale STrecke seit low range aktive" VALUE 0xFD0528 KwUw 1820.417 s_q0p02777_m 0.00 1820.417 FORMAT "%8.3" /end CHARACTERISTIC
/begin CHARACTERISTIC SNMBS2KL61 "" VALUE 0xFCA724 KwWU16 16383.75 nmot_uw_q0p25 0.00 16383.75 FORMAT "%8.2" /end CHARACTERISTIC
/begin CHARACTERISTIC SNMBSDKL61 "" VALUE 0xFCA716 KwWU16 16383.75 nmot_uw_q0p25 0.00 16383.75 FORMAT "%8.2" /end CHARACTERISTIC
/begin CHARACTERISTIC SOKFST "Wegstrecke Entprellung Fuellfstandsgeber - OK" VALUE 0xFD052A KwUw 22755.21 s_q0p34722_m 0.00 22755.21 FORMAT "%8.2" /end CHARACTERISTIC
/begin CHARACTERISTIC S_DHFMLEAN "Umschaltung DHFM-Auswertung 0: DPS und Hub; 1: DK und Hub" VALUE 0xFC40A9 KwUb 255.0 dez 0.00 255.0 FORMAT "%5.1" /end CHARACTERISTIC
/begin CHARACTERISTIC TABSTHLSH "Mindestabstellzeit f¸r Diagnose Heizung Lambdasonde hinter Kat" VALUE 0xFD0172 KwUw 65535.00 t1sxs_uw_q1 0.00 65535.00 FORMAT "%8.2" /end CHARACTERISTIC
/begin CHARACTERISTIC TABSTHLSU "Mindestabstellzeit f¸r Wiederholstart Heizung LSU" VALUE 0xFD01C6 KwUw 65535.00 t1sxs_uw_b65535 0.00 65535.00 FORMAT "%8.2" /end CHARACTERISTIC
/begin CHARACTERISTIC TADHMNH "untere Temperaturschwelle f¸r die Heizerdiagnose hinter Kat" VALUE 0xFD0174 KwUw 1535.977 temp_q0p0234_o273 -273.1500 1262.827 FORMAT "%8.3" /end CHARACTERISTIC
/begin CHARACTERISTIC TADHMXH "obere Temperaturschwelle f¸r die Heizerdiagnose hinter Kat" VALUE 0xFD0176 KwUw 1535.977 temp_q0p0234_o273 -273.1500 1262.827 FORMAT "%8.3" /end CHARACTERISTIC
/begin CHARACTERISTIC TAIKRLSUMN "min. Diagnoseschwelle""Abgastemp. im Kr¸mmer"" f¸r  min. Tastverh‰ltnis" VALUE 0xFD01C8 KwUw 1535.977 temp_q0p0234_o273 -273.1500 1262.827 FORMAT "%8.3" /end CHARACTERISTIC
/begin CHARACTERISTIC TALASMX "Abgastemperatur-Schwellwert f¸r Pr¸fung Heizerkopplung" VALUE 0xFD0106 KwUw 1535.977 temp_q0p0234_o273 -273.1500 1262.827 FORMAT "%8.3" /end CHARACTERISTIC
/begin CHARACTERISTIC TANKABN "minimale Fuellstandsabnahme fuer Tankerkennung" VALUE 0xFD052C KwSw 3276.800 vol_q0p1_l -3276.800 0.00 FORMAT "%8.3" /end CHARACTERISTIC
/begin CHARACTERISTIC TANKMN "minimale Tankmenge fuer Tankerkennung" VALUE 0xFD052E KwSw 3276.700 vol_q0p1_l 0.00 3276.700 FORMAT "%8.3" /end CHARACTERISTIC
/begin CHARACTERISTIC TANSDHLSH "Ansauglufttemperaturschwelle f¸r Ri- Diagnose hinter Kat" VALUE 0xFD010B KwUb 191.3 temp_ub_q0p75_o48 -48.00 143.3 FORMAT "%5.1" /end CHARACTERISTIC
/begin CHARACTERISTIC TASOH "Temperaturschwelle f¸r Sonde hinter Kat ohne Heizung funktionsf‰hig" VALUE 0xFD0178 KwUw 1535.977 temp_q0p0234_o273 -273.1500 1262.827 FORMAT "%8.3" /end CHARACTERISTIC
/begin CHARACTERISTIC TDHFMMN "" VALUE 0xFD1268 KwUw 655.34999985 zk10msxs_uw_b655 0.010000152590 655.36000000 FORMAT "%12.8" /end CHARACTERISTIC
/begin CHARACTERISTIC TDHFMMX "" VALUE 0xFD126A KwUw 655.34999985 zk10msxs_uw_b655 0.010000152590 655.36000000 FORMAT "%12.8" /end CHARACTERISTIC
/begin CHARACTERISTIC TDMLHFM "Zeitverzˆgerung f¸r das Setzen von B_ehfm" VALUE 0xFC40AA KwUb 2.540 t10msxs_ub_b2p55 0.01000 2.550 FORMAT "%5.3" /end CHARACTERISTIC
/begin CHARACTERISTIC TDMLMN "Entprellzeit HFM-(Hauptlastgeber-)Fehlererkennung Minimalwert" VALUE 0xFD0DD2 KwUb 25.50 t100msxs_ub_b25p5 0.00 25.50 FORMAT "%5.2" /end CHARACTERISTIC
/begin CHARACTERISTIC TDMLMX "Entprellzeit HFM-(Hauptlastgeber-)Fehlererkennung Maximalwert" VALUE 0xFD0DD3 KwUb 25.50 t100msxs_ub_b25p5 0.00 25.50 FORMAT "%5.2" /end CHARACTERISTIC
/begin CHARACTERISTIC TDMLNF "Entprellzeit HFM-(Hauptlastgeber-)Diagnose mit i.O.-Meldung" VALUE 0xFD0DD4 KwUb 25.50 t100msxs_ub_b25p5 0.00 25.50 FORMAT "%5.2" /end CHARACTERISTIC
/begin CHARACTERISTIC TDMLST "Entprellzeit HFM-(Hauptlastgeber-)Fehlererkennung im Start" VALUE 0xFD0DD5 KwUb 25.50 t100msxs_ub_b25p5 0.00 25.50 FORMAT "%5.2" /end CHARACTERISTIC
/begin CHARACTERISTIC TDUBHFM "Zeit f¸r HFM-Diagnose mit u < UBHFM" VALUE 0xFD0DD6 KwUb 25.40 t100msxs_ub_b25p5 0.1000 25.50 FORMAT "%5.2" /end CHARACTERISTIC
/begin CHARACTERISTIC TEHEHRLSU "Entprellzeit zum Heilen des Fehlerpfades HRLSU" VALUE 0xFD01CA KwUw 6553.500 t100msxs_uw_b6553p5 0.00 6553.500 FORMAT "%8.3" /end CHARACTERISTIC
/begin CHARACTERISTIC TEHRF "Entprellzeit f¸r Heizungsregelungsfehler" VALUE 0xFD01CC KwUw 6553.500 t100msxs_uw_b6553p5 0.00 6553.500 FORMAT "%8.3" /end CHARACTERISTIC
/begin CHARACTERISTIC TEHRFMN "minimale Entprellzeit f¸r Heizungsregelungsfehler" VALUE 0xFD01CE KwUw 6553.500 t100msxs_uw_b6553p5 0.00 6553.500 FORMAT "%8.3" /end CHARACTERISTIC
/begin CHARACTERISTIC TEHRLSUE "Entprellzeit f¸r Heizungsregelung der LSU f¸r elektrischen Fehler" VALUE 0xFD01D0 KwUw 6553.500 t100msxs_uw_b6553p5 0.00 6553.500 FORMAT "%8.3" /end CHARACTERISTIC
/begin CHARACTERISTIC TEHRLSUZMX "Ausblendzeit zur Heilung bei hohen Temperaturen" VALUE 0xFD01D2 KwUw 6553.500 t100msxs_uw_b6553p5 0.00 6553.500 FORMAT "%8.3" /end CHARACTERISTIC
/begin CHARACTERISTIC TFSTNPW "Schwelle Tankfuellstandssignal nicht Plausibel (16 Bit)" VALUE 0xFD0530 KwUw 6553.500 vol_q0p1_l 0.00 6553.500 FORMAT "%8.3" /end CHARACTERISTIC
/begin CHARACTERISTIC TKERLSUDMN "Minimale Temperatur, die die Sonde nach Ablauf TVLSUBB erreichen muﬂ" VALUE 0xFD01D4 KwUw 1535.977 temp_q0p0234_o273 -273.1500 1262.827 FORMAT "%8.3" /end CHARACTERISTIC
/begin CHARACTERISTIC TMDHRSTMX "Max. Motorstarttemperatur zum Ausf¸hren der Startdiagnose" VALUE 0xFD01AD KwUb 191.3 temp_ub_q0p75_o48 -48.00 143.3 FORMAT "%5.1" /end CHARACTERISTIC
/begin CHARACTERISTIC TSFBREMS "Fehlersummenzeit: BREMS (Bremsschalter)" VALUE 0xFD5C0D KwUb 255.0 dez 0.00 255.0 FORMAT "%5.1" /end CHARACTERISTIC
/begin CHARACTERISTIC TSFBWF "Fehlersummenzeit: PWG Bewegung" VALUE 0xFD5C0E KwUb 255.0 dez 0.00 255.0 FORMAT "%5.1" /end CHARACTERISTIC
/begin CHARACTERISTIC TSFDDSS "Fehlersummenzeit: Differenzdrucksensor Saugrohr" VALUE 0xFD5C1F KwUb 255.0 dez 0.00 255.0 FORMAT "%5.1" /end CHARACTERISTIC
/begin CHARACTERISTIC TSFDGEN "Fehlersummenzeit: Generator" VALUE 0xFD5C20 KwWU8 255.0 dez 0.00 255.0 FORMAT "%5.1" /end CHARACTERISTIC
/begin CHARACTERISTIC TSFDGEN2 "" VALUE 0xFD5C21 KwWU8 255.0 dez 0.00 255.0 FORMAT "%5.1" /end CHARACTERISTIC
/begin CHARACTERISTIC TSFDGENB2 "" VALUE 0xFD5C22 KwWU8 255.0 dez 0.00 255.0 FORMAT "%5.1" /end CHARACTERISTIC
/begin CHARACTERISTIC TSFDGENBS "Fehlersummenzeit: Kommunikation" VALUE 0xFD5C23 KwWU8 255.0 dez 0.00 255.0 FORMAT "%5.1" /end CHARACTERISTIC
/begin CHARACTERISTIC TSFDIBS1 "Fehlersummenzeit IBS BSD Error" VALUE 0xFD5C25 KwWU8 255.0 dez 0.00 255.0 FORMAT "%5.1" /end CHARACTERISTIC
/begin CHARACTERISTIC TSFDIBS2 "Fehlersummenzeit IBS SW unplausibel" VALUE 0xFD5C26 KwWU8 255.0 dez 0.00 255.0 FORMAT "%5.1" /end CHARACTERISTIC
/begin CHARACTERISTIC TSFDIBS3 "" VALUE 0xFD5C27 KwWU8 255.0 dez 0.00 255.0 FORMAT "%5.1" /end CHARACTERISTIC
/begin CHARACTERISTIC TSFDMTKNM "Fehlersummenzeit: Feinstleck, no Mil" VALUE 0xFD5C30 KwWU8 255.0 dez 0.00 255.0 FORMAT "%5.1" /end CHARACTERISTIC
/begin CHARACTERISTIC TSFDSU "Fehlersummenzeit: Drucksensor Umgebung" VALUE 0xFD5C33 KwUb 255.0 dez 0.00 255.0 FORMAT "%5.1" /end CHARACTERISTIC
/begin CHARACTERISTIC TSFDWA "Fehlersummenzeit: Diebstahlwarnanlage" VALUE 0xFD5C57 KwUb 255.0 dez 0.00 255.0 FORMAT "%5.1" /end CHARACTERISTIC
/begin CHARACTERISTIC TSFDZKU0 "Fehlersummenzeit: Z¸ndspule 0" VALUE 0xFD5C5A KwWU8 255.0 dez 0.00 255.0 FORMAT "%5.1" /end CHARACTERISTIC
/begin CHARACTERISTIC TSFDZKU1 "Fehlersummenzeit: Z¸ndspule 1" VALUE 0xFD5C5B KwWU8 255.0 dez 0.00 255.0 FORMAT "%5.1" /end CHARACTERISTIC
/begin CHARACTERISTIC TSFDZKU2 "Fehlersummenzeit: Z¸ndspule 2" VALUE 0xFD5C5C KwWU8 255.0 dez 0.00 255.0 FORMAT "%5.1" /end CHARACTERISTIC
/begin CHARACTERISTIC TSFDZKU3 "Fehlersummenzeit: Z¸ndspule 3" VALUE 0xFD5C5D KwWU8 255.0 dez 0.00 255.0 FORMAT "%5.1" /end CHARACTERISTIC
/begin CHARACTERISTIC TSFDZKU4 "Fehlersummenzeit: Z¸ndspule 4" VALUE 0xFD5C5E KwWU8 255.0 dez 0.00 255.0 FORMAT "%5.1" /end CHARACTERISTIC
/begin CHARACTERISTIC TSFDZKU5 "Fehlersummenzeit: Z¸ndspule 5" VALUE 0xFD5C5F KwWU8 255.0 dez 0.00 255.0 FORMAT "%5.1" /end CHARACTERISTIC
/begin CHARACTERISTIC TSFDZKU6 "Fehlersummenzeit: Z¸ndspule 6" VALUE 0xFD5C60 KwWU8 255.0 dez 0.00 255.0 FORMAT "%5.1" /end CHARACTERISTIC
/begin CHARACTERISTIC TSFDZKU7 "Fehlersummenzeit: Z¸ndspule 7" VALUE 0xFD5C61 KwWU8 255.0 dez 0.00 255.0 FORMAT "%5.1" /end CHARACTERISTIC
/begin CHARACTERISTIC TSFEGFE "Fehlersummenzeit: Eingangsgrˆﬂe F¸llunserfassung" VALUE 0xFD5C62 KwUb 255.0 dez 0.00 255.0 FORMAT "%5.1" /end CHARACTERISTIC
/begin CHARACTERISTIC TSFFP1P "Fehlersummenzeit: Poti 1, Fahrpedal" VALUE 0xFD5C71 KwUb 255.0 dez 0.00 255.0 FORMAT "%5.1" /end CHARACTERISTIC
/begin CHARACTERISTIC TSFFP2P "Fehlersummenzeit: Poti 2, Fahrpedal" VALUE 0xFD5C72 KwUb 255.0 dez 0.00 255.0 FORMAT "%5.1" /end CHARACTERISTIC
/begin CHARACTERISTIC TSFFPP "Fehlersummenzeit: Poti Fahrpedal" VALUE 0xFD5C73 KwUb 255.0 dez 0.00 255.0 FORMAT "%5.1" /end CHARACTERISTIC
/begin CHARACTERISTIC TSFHSVSA "Fehlersummenzeit: Lambdasonden-Heizung vor Katalysator" VALUE 0xFD5C86 KwWU8 255.0 dez 0.00 255.0 FORMAT "%5.1" /end CHARACTERISTIC
/begin CHARACTERISTIC TSFHSVSA2 "Fehlersummenzeit: Lambdasonden-Heizung vor Katalysator, Bank 2" VALUE 0xFD5C87 KwWU8 255.0 dez 0.00 255.0 FORMAT "%5.1" /end CHARACTERISTIC
/begin CHARACTERISTIC TSFLSVV "Fehlersummenzeit: Vertauschte Lambda-Sonden vor Kat" VALUE 0xFD5CAD KwUb 255.0 dez 0.00 255.0 FORMAT "%5.1" /end CHARACTERISTIC
/begin CHARACTERISTIC TSFMDB "Fehlersummenzeit: Momentbegrenzung Sollmoment" VALUE 0xFD5CBB KwUb 255.0 dez 0.00 255.0 FORMAT "%5.1" /end CHARACTERISTIC
/begin CHARACTERISTIC TSFMFL "Fehlerschwere : Multifunktionslenkrad" VALUE 0xFD5CBC KwWU8 255.0 dez 0.00 255.0 FORMAT "%5.1" /end CHARACTERISTIC
/begin CHARACTERISTIC TSFMINHUB "" VALUE 0xFD5CBD KwUb 255.0 dez 0.00 255.0 FORMAT "%5.1" /end CHARACTERISTIC
/begin CHARACTERISTIC TSFMTOEL "" VALUE 0xFD5CBF KwWU8 255.0 dez 0.00 255.0 FORMAT "%5.1" /end CHARACTERISTIC
/begin CHARACTERISTIC TSFNVRMON "Fehlersummenzeit: NVRAM Backup Aktualit‰ts¸berwachung" VALUE 0xFD5CC2 KwUb 255.0 dez 0.00 255.0 FORMAT "%5.1" /end CHARACTERISTIC
/begin CHARACTERISTIC TSFNWKW "Fehlersummenzeit: Zuordnung Nockenwelle zu Kurbelwelle" VALUE 0xFD5CC3 KwWU8 255.0 dez 0.00 255.0 FORMAT "%5.1" /end CHARACTERISTIC
/begin CHARACTERISTIC TSFOEZS "Parameter f¸r Fehlerspeicherverwaltung" VALUE 0xFD5CC4 KwWU8 255.0 dez 0.00 255.0 FORMAT "%5.1" /end CHARACTERISTIC
/begin CHARACTERISTIC TSFPDDSS "Fehlersummenzeit: Druck Differenzdrucksensor Saugrohr" VALUE 0xFD5CC5 KwUb 255.0 dez 0.00 255.0 FORMAT "%5.1" /end CHARACTERISTIC
/begin CHARACTERISTIC TSFSLVE "Fehlersummenzeit: Sekund‰rluftventil (Endstufe)" VALUE 0xFD5CD9 KwWU8 255.0 dez 0.00 255.0 FORMAT "%5.1" /end CHARACTERISTIC
/begin CHARACTERISTIC TSFTA "Fehlersummenzeit: Ansauglufttemperatur TANS" VALUE 0xFD5CDE KwUb 255.0 dez 0.00 255.0 FORMAT "%5.1" /end CHARACTERISTIC
/begin CHARACTERISTIC TSFTKA "Fehlersummenzeit: Temperatur K¸hlerausgang" VALUE 0xFD5CE3 KwWU8 255.0 dez 0.00 255.0 FORMAT "%5.1" /end CHARACTERISTIC
/begin CHARACTERISTIC TSFTM "Fehlersummenzeit: Motortemperatur TMOT" VALUE 0xFD5CE4 KwUb 255.0 dez 0.00 255.0 FORMAT "%5.1" /end CHARACTERISTIC
/begin CHARACTERISTIC TSFTUM "Fehlersummenzeit: Umgebungstemperatur TUM" VALUE 0xFD5CE5 KwWU8 255.0 dez 0.00 255.0 FORMAT "%5.1" /end CHARACTERISTIC
/begin CHARACTERISTIC TSFUB "Fehlersummenzeit: Batteriespannung UB (Bordnetz)" VALUE 0xFD5CE6 KwWU8 255.0 dez 0.00 255.0 FORMAT "%5.1" /end CHARACTERISTIC
/begin CHARACTERISTIC TSFVVTE "Fehlersummenzeit: VVT-Endstufe" VALUE 0xFD5CF5 KwWU8 255.0 dez 0.00 255.0 FORMAT "%5.1" /end CHARACTERISTIC
/begin CHARACTERISTIC TSFWCA "Fehlersummenzeit: Wegfahrsperre Wechselcode-Ablage" VALUE 0xFD5CF6 KwUb 255.0 dez 0.00 255.0 FORMAT "%5.1" /end CHARACTERISTIC
/begin CHARACTERISTIC TSFWFS "Fehlersummenzeit: Wegfahrsperre" VALUE 0xFD5CF7 KwUb 255.0 dez 0.00 255.0 FORMAT "%5.1" /end CHARACTERISTIC
/begin CHARACTERISTIC TVENMX "Verzˆgerung der Diagnose ""mx. Tastverh‰ltnis"" nach Heizung ein"" bzw. B_SA" VALUE 0xFD01D6 KwUw 6553.500 t100msxs_uw_b6553p5 0.00 6553.500 FORMAT "%8.3" /end CHARACTERISTIC
/begin CHARACTERISTIC TVFAHRLSU "Verzˆgerungszeit betr. Funktionsanforderung" VALUE 0xFD01AE KwUb 25.50 t100msxs_ub_b25p5 0.00 25.50 FORMAT "%5.2" /end CHARACTERISTIC
/begin CHARACTERISTIC TVFHSH "Entprellzeit f¸r Heizerendstufe hinter Kat" VALUE 0xFC2060 KwUb 2.550 t10msxs_ub_b2p55 0.00 2.550 FORMAT "%5.3" /end CHARACTERISTIC
/begin CHARACTERISTIC TVFSTD "Entprellzeit elektrische Fuellstandsgeberdiagnose" VALUE 0xFD0516 KwUb 254.0 t1sxs_ub_b255 1.000 255.0 FORMAT "%5.1" /end CHARACTERISTIC
/begin CHARACTERISTIC TVHATA "Verzoegerungszeit Halt vor Tankvorgang" VALUE 0xFD0517 KwUb 254.0 t1sxs_ub_b255 1.000 255.0 FORMAT "%5.1" /end CHARACTERISTIC
/begin CHARACTERISTIC TVHKLSU "Verzˆgerungszeit f¸r Diagnose Heizerkopplung" VALUE 0xFD0108 KwUw 6553.500 t100msxs_uw_b6553p5 0.00 6553.500 FORMAT "%8.3" /end CHARACTERISTIC
/begin CHARACTERISTIC TVHKLSUV "Zeit f¸r Diagnose Heizerkopplung" VALUE 0xFC2050 KwUb 2.550 t10msxs_ub_b2p55 0.00 2.550 FORMAT "%5.3" /end CHARACTERISTIC
/begin CHARACTERISTIC TVHSHEE "Entprellzeit f¸r Heizerendstufdiagnose hinter Kat" VALUE 0xFD010C KwUb 12.75 t50msxs_ub_b12p75 0.00 12.75 FORMAT "%5.2" /end CHARACTERISTIC
/begin CHARACTERISTIC TVHSHRI "Verzˆgerungszeit f¸r Ri-Fehler hinter Kat" VALUE 0xFD010D KwUb 255.0 t1sxs_ub_b255 0.00 255.0 FORMAT "%5.1" /end CHARACTERISTIC
/begin CHARACTERISTIC TVHSHRIHEL "Verzˆgerungszeit f¸r Heilung Ri-Fehler hinter Kat, wenn B_npfhsh =1" VALUE 0xFD010E KwUb 255.0 t1sxs_ub_b255 0.00 255.0 FORMAT "%5.1" /end CHARACTERISTIC
/begin CHARACTERISTIC TVHSHRIZ "Verzˆgerungszeit f¸r Heilung Ri-Fehler hinter Kat" VALUE 0xFD010F KwUb 255.0 t1sxs_ub_b255 0.00 255.0 FORMAT "%5.1" /end CHARACTERISTIC
/begin CHARACTERISTIC TVLSUBB "maximal zul. Verzˆgerungszeit nach dem Start f¸r Betriebsbereitschaft der LSU" VALUE 0xFD01D8 KwUw 6553.500 t100msxs_uw_b6553p5 0.00 6553.500 FORMAT "%8.3" /end CHARACTERISTIC
/begin CHARACTERISTIC TVNMOT "Verzoegerungszeit nach B_nmot" VALUE 0xFD0518 KwUb 255.0 t1sxs_ub_b255 0.00 255.0 FORMAT "%5.1" /end CHARACTERISTIC
/begin CHARACTERISTIC TVRIHEE "Verzˆgerungszeit f¸r Ri-Fehler nach Endstufenfehler hinter Kat" VALUE 0xFD0110 KwUb 255.0 t1sxs_ub_b255 0.00 255.0 FORMAT "%5.1" /end CHARACTERISTIC
/begin CHARACTERISTIC TVZHRNOT "maximal zul. Zeit f¸r Unterbrechung der Startdiagnose" VALUE 0xFD01DA KwUw 6553.500 t100msxs_uw_b6553p5 0.00 6553.500 FORMAT "%8.3" /end CHARACTERISTIC
/begin CHARACTERISTIC TWHRLSUZMX "max. Rohrwandtemperatur zum Heilen/Zyklus-flag setzen des Fehlerpfades HSV" VALUE 0xFD01DC KwUw 1535.977 temp_q0p0234_o273 -273.1500 1262.827 FORMAT "%8.3" /end CHARACTERISTIC
/begin CHARACTERISTIC TWHRSTMX "max. Rohrwandtemperatur zum Setzen des Zyklusflags der Startdiagnose von DHRLSU" VALUE 0xFD01DE KwUw 1535.977 temp_q0p0234_o273 -273.1500 1262.827 FORMAT "%8.3" /end CHARACTERISTIC
/begin CHARACTERISTIC TWVDCMN "minimale Rohrwandtemperatur zum Aktivieren der Diagnose ""schwacher Heizer""" VALUE 0xFD01E0 KwUw 1535.977 temp_q0p0234_o273 -273.1500 1262.827 FORMAT "%8.3" /end CHARACTERISTIC
/begin CHARACTERISTIC TWVSOMOS "Obere Schwelle der Rohrwandtemperatur an der Sondeneinbauposition vor dem Kat." VALUE 0xFD01E2 KwUw 1535.977 temp_q0p0234_o273 -273.1500 1262.827 FORMAT "%8.3" /end CHARACTERISTIC
/begin CHARACTERISTIC UADHFMMN "min. Spannungswert f¸r Diagnose HFM im Start" VALUE 0xFD0DD7 KwUb 4.980 spg_ub_q0p019 0.00 4.980 FORMAT "%5.3" /end CHARACTERISTIC
/begin CHARACTERISTIC UADHFMMX "max. Spannungswert f¸r Diagnose HFM im Start" VALUE 0xFD0DD8 KwUb 4.980 spg_ub_q0p019 0.00 4.980 FORMAT "%5.3" /end CHARACTERISTIC
/begin CHARACTERISTIC UBDHELSUMN "minimaler Grenzwert betr. ubsq_w" VALUE 0xFD0104 KwUb 25.50 spg_q0p1 0.00 25.50 FORMAT "%5.2" /end CHARACTERISTIC
/begin CHARACTERISTIC UBDHELSUMX "maximaler Grenzwert betr. ubsq_w" VALUE 0xFD0105 KwUb 25.50 spg_q0p1 0.00 25.50 FORMAT "%5.2" /end CHARACTERISTIC
/begin CHARACTERISTIC UBDHLSHMN "untere Batteriespannungsschwelle zur Freigabe der Lambdasonden-Heizer-Diagnose" VALUE 0xFD017A KwUw 25.59961 spg_q0p00039 0.00 25.59961 FORMAT "%8.5" /end CHARACTERISTIC
/begin CHARACTERISTIC UBDHLSHMX "obere Batteriespannungsschwelle f¸r die Lambdasonden- Heizer-Diagnose" VALUE 0xFD017C KwUw 25.59961 spg_q0p00039 0.00 25.59961 FORMAT "%8.5" /end CHARACTERISTIC
/begin CHARACTERISTIC UBHFM "Batteriespannungsschwelle zur Umschaltung auf Ersatzlastsignal" VALUE 0xFD0DD9 KwUb 24.02 spg_ubatt 0.00 24.02 FORMAT "%5.2" /end CHARACTERISTIC
/begin CHARACTERISTIC UBHRLSUMN "Minimale Versorgungsspannung f¸r die Diagnose DHRLSU / DHRLSUE" VALUE 0xFD01AF KwUb 25.50 spg_q0p1 0.00 25.50 FORMAT "%5.2" /end CHARACTERISTIC
/begin CHARACTERISTIC UBHRLSUMX "Maximale Versorgungsspannung f¸r die Diagnose DHRLSU" VALUE 0xFD01B0 KwUb 25.50 spg_q0p1 0.00 25.50 FORMAT "%5.2" /end CHARACTERISTIC
/begin CHARACTERISTIC UHDMNH "Schwellwert f¸r bestromte Heizerendstufe hinter Kat" VALUE 0xFC2061 KwUb 4.980 spg_ub_b5 0.00 4.980 FORMAT "%5.3" /end CHARACTERISTIC
/begin CHARACTERISTIC UHDMXH "Schwellwert f¸r stromlose Heizerendstufe hinter Kat" VALUE 0xFC2062 KwUb 4.980 spg_ub_b5 0.00 4.980 FORMAT "%5.3" /end CHARACTERISTIC
/begin CHARACTERISTIC UNWDHFM "Umdrehungen Nockenwelle f¸r Fehlerentprellung Diagnose HFM" VALUE 0xFD0DDA KwUb 255.0 dez 0.00 255.0 FORMAT "%5.1" /end CHARACTERISTIC
/begin CHARACTERISTIC ZATMRW "Zeitkonstante f¸r Rohrwandtemperaturmodell" CURVE 0xFD01E4 KlAUwSstUwWUw 13106.800000 zk200msxs_uw_b13107 0.20000000000 13107.000000 FORMAT "%12.6"
 /begin AXIS_DESCR STD_AXIS msabg_w m_uw_b6553p5 5 0.00 6553.500 FORMAT "%8.3" DEPOSIT ABSOLUTE /end AXIS_DESCR
/end CHARACTERISTIC
/begin CHARACTERISTIC ZEHK "Fehlerz‰hler f¸r Heizerkopplung auf das Lambdasignal" VALUE 0xFC2051 KwUb 255.0 dez 0.00 255.0 FORMAT "%5.1" /end CHARACTERISTIC
/begin CHARACTERISTIC ZKARIH1 "Filterzeitkonst.f¸r Nachbildung Dynamik der Keramiktemperatur h. Kat" CURVE 0xFD017E KlAUbSstUwWUw 6553.4999985 zk100msxs_uw_b6553 0.10000152590 6553.6000000 FORMAT "%12.7"
 /begin AXIS_DESCR STD_AXIS msabnhk_w m_uw_b6553p5 5 0.00 6553.500 FORMAT "%8.3" DEPOSIT ABSOLUTE /end AXIS_DESCR
/end CHARACTERISTIC
/begin CHARACTERISTIC ZKARIH2 "Filterzeitkonst.f¸r Nachbildung Dynamik der Keramiktemperatur 2 h. Kat" CURVE 0xFD0194 KlAUbSstUwWUw 6553.4999985 zk100msxs_uw_b6553 0.10000152590 6553.6000000 FORMAT "%12.7"
 /begin AXIS_DESCR STD_AXIS msabnhk2_w m_uw_b6553p5 5 0.00 6553.500 FORMAT "%8.3" DEPOSIT ABSOLUTE /end AXIS_DESCR
/end CHARACTERISTIC
/begin CHARACTERISTIC ZKPRIH "Filter f¸r Nachbildung Dynamik der Sondenkeramiktemp.aus el.Heizleistung h.Kat" VALUE 0xFD01AA KwUw 6553.4999985 zk100msxs_uw_b6553 0.10000152590 6553.6000000 FORMAT "%12.7" /end CHARACTERISTIC
/begin CHARACTERISTIC ZKRLVWD "" VALUE 0xFD126C KwUw 0.9999847 fak_uw_b1 0.00 0.9999847 FORMAT "%9.7" /end CHARACTERISTIC
/begin CHARACTERISTIC ZMLRO "Zeitkonstante mlroh-Tiefpaﬂ bei Diagnose HFM/HLM" VALUE 0xFC40AB KwUb 2.54000 zk10msxs_ub_b2p55 0.0100000 2.55000 FORMAT "%7.5" /end CHARACTERISTIC
/begin MEASUREMENT B_1stbsde2 "" UBYTE B_TRUE 1 100 0 1 FORMAT "%13.11" ECU_ADDRESS 0x4031DE /end MEASUREMENT
/begin MEASUREMENT B_1stbsder "" UBYTE B_TRUE 1 100 0 1 FORMAT "%13.11" ECU_ADDRESS 0x4031CC /end MEASUREMENT
/begin MEASUREMENT B_bebrems "Bedingung Bandende-Funktionsanforderung Bremsschalter" UWORD B_TRUE 1 100 0 1 BIT_MASK 0x20 FORMAT "%13.11" ECU_ADDRESS 0x3FE3BE /end MEASUREMENT
/begin MEASUREMENT B_bebwf "Bedingung Bandendeanford. f¸r Bewegungsfehler FPM" UWORD B_TRUE 1 100 0 1 BIT_MASK 0x20 FORMAT "%13.11" ECU_ADDRESS 0x3FE3C0 /end MEASUREMENT
/begin MEASUREMENT B_bedgen "" UWORD B_TRUE 1 100 0 1 BIT_MASK 0x20 FORMAT "%13.11" ECU_ADDRESS 0x3FE3E4 /end MEASUREMENT
/begin MEASUREMENT B_bedgen2 "" UWORD B_TRUE 1 100 0 1 BIT_MASK 0x20 FORMAT "%13.11" ECU_ADDRESS 0x3FE3E6 /end MEASUREMENT
/begin MEASUREMENT B_bedgenb2 "" UWORD B_TRUE 1 100 0 1 BIT_MASK 0x20 FORMAT "%13.11" ECU_ADDRESS 0x3FE3E8 /end MEASUREMENT
/begin MEASUREMENT B_bedgenbs "" UWORD B_TRUE 1 100 0 1 BIT_MASK 0x20 FORMAT "%13.11" ECU_ADDRESS 0x3FE3EA /end MEASUREMENT
/begin MEASUREMENT B_bedibs1 "" UWORD B_TRUE 1 100 0 1 BIT_MASK 0x20 FORMAT "%13.11" ECU_ADDRESS 0x3FE3EE /end MEASUREMENT
/begin MEASUREMENT B_bedibs2 "" UWORD B_TRUE 1 100 0 1 BIT_MASK 0x20 FORMAT "%13.11" ECU_ADDRESS 0x3FE3F0 /end MEASUREMENT
/begin MEASUREMENT B_bedibs3 "" UWORD B_TRUE 1 100 0 1 BIT_MASK 0x20 FORMAT "%13.11" ECU_ADDRESS 0x3FE3F2 /end MEASUREMENT
/begin MEASUREMENT B_bedsu "Bedingung: Bandende-Funktionsanforderung DSU" UWORD B_TRUE 1 100 0 1 BIT_MASK 0x20 FORMAT "%13.11" ECU_ADDRESS 0x3FE40A /end MEASUREMENT
/begin MEASUREMENT B_bedwa "" UWORD B_TRUE 1 100 0 1 BIT_MASK 0x20 FORMAT "%13.11" ECU_ADDRESS 0x3FE452 /end MEASUREMENT
/begin MEASUREMENT B_bedzku0 "DSM Information : Z¸ndkreisdiagnose" UWORD B_TRUE 1 100 0 1 BIT_MASK 0x20 FORMAT "%13.11" ECU_ADDRESS 0x3FE458 /end MEASUREMENT
/begin MEASUREMENT B_bedzku1 "DSM Information : Z¸ndkreisdiagnose" UWORD B_TRUE 1 100 0 1 BIT_MASK 0x20 FORMAT "%13.11" ECU_ADDRESS 0x3FE45A /end MEASUREMENT
/begin MEASUREMENT B_bedzku2 "DSM Information : Z¸ndkreisdiagnose" UWORD B_TRUE 1 100 0 1 BIT_MASK 0x20 FORMAT "%13.11" ECU_ADDRESS 0x3FE45C /end MEASUREMENT
/begin MEASUREMENT B_bedzku3 "DSM Information : Z¸ndkreisdiagnose" UWORD B_TRUE 1 100 0 1 BIT_MASK 0x20 FORMAT "%13.11" ECU_ADDRESS 0x3FE45E /end MEASUREMENT
/begin MEASUREMENT B_bedzku4 "DSM Information : Z¸ndkreisdiagnose" UWORD B_TRUE 1 100 0 1 BIT_MASK 0x20 FORMAT "%13.11" ECU_ADDRESS 0x3FE460 /end MEASUREMENT
/begin MEASUREMENT B_bedzku5 "DSM Information : Z¸ndkreisdiagnose" UWORD B_TRUE 1 100 0 1 BIT_MASK 0x20 FORMAT "%13.11" ECU_ADDRESS 0x3FE462 /end MEASUREMENT
/begin MEASUREMENT B_bedzku6 "DSM Information : Z¸ndkreisdiagnose" UWORD B_TRUE 1 100 0 1 BIT_MASK 0x20 FORMAT "%13.11" ECU_ADDRESS 0x3FE464 /end MEASUREMENT
/begin MEASUREMENT B_bedzku7 "DSM Information : Z¸ndkreisdiagnose" UWORD B_TRUE 1 100 0 1 BIT_MASK 0x20 FORMAT "%13.11" ECU_ADDRESS 0x3FE466 /end MEASUREMENT
/begin MEASUREMENT B_beegfe "Bedingung: Bandende-Anforderung bei Eingangsgrˆﬂen der F¸llungserfassung" UWORD B_TRUE 1 100 0 1 BIT_MASK 0x20 FORMAT "%13.11" ECU_ADDRESS 0x3FE468 /end MEASUREMENT
/begin MEASUREMENT B_befp1p "Bedingung Bandendeanford. f¸r Fehler Poti1 FPM" UWORD B_TRUE 1 100 0 1 BIT_MASK 0x20 FORMAT "%13.11" ECU_ADDRESS 0x3FE486 /end MEASUREMENT
/begin MEASUREMENT B_befp2p "Bedingung Bandendeanford. f¸r Fehler Poti2 FPM" UWORD B_TRUE 1 100 0 1 BIT_MASK 0x20 FORMAT "%13.11" ECU_ADDRESS 0x3FE488 /end MEASUREMENT
/begin MEASUREMENT B_befpp "Bedingung Bandendeanford. f¸r Fehler FPM" UWORD B_TRUE 1 100 0 1 BIT_MASK 0x20 FORMAT "%13.11" ECU_ADDRESS 0x3FE48A /end MEASUREMENT
/begin MEASUREMENT B_belsvv "Bedingung Bandende-Funktionsanforderung vertauschte Lambda-Sonde vor KAT" UWORD B_TRUE 1 100 0 1 BIT_MASK 0x20 FORMAT "%13.11" ECU_ADDRESS 0x3FE4FE /end MEASUREMENT
/begin MEASUREMENT B_bemdb "Bedingung Bandende-Funktionsanforderung MDB" UWORD B_TRUE 1 100 0 1 BIT_MASK 0x20 FORMAT "%13.11" ECU_ADDRESS 0x3FE51A /end MEASUREMENT
/begin MEASUREMENT B_bemfl "Bedingung Bandende-Funktionsanforderung" UWORD B_TRUE 1 100 0 1 BIT_MASK 0x20 FORMAT "%13.11" ECU_ADDRESS 0x3FE51C /end MEASUREMENT
/begin MEASUREMENT B_beminhub "Bedingung, Bandende Funktionsanforderung Fehler Minhubadaption" UWORD B_TRUE 1 100 0 1 BIT_MASK 0x20 FORMAT "%13.11" ECU_ADDRESS 0x3FE51E /end MEASUREMENT
/begin MEASUREMENT B_bemtoel "Pruefung am Bandende" UWORD B_TRUE 1 100 0 1 BIT_MASK 0x20 FORMAT "%13.11" ECU_ADDRESS 0x3FE522 /end MEASUREMENT
/begin MEASUREMENT B_benvrmon "Bedingung Bandende-Funktionsanforderung NVRAM-Backup Akt.‹berw." UWORD B_TRUE 1 100 0 1 BIT_MASK 0x20 FORMAT "%13.11" ECU_ADDRESS 0x3FE528 /end MEASUREMENT
/begin MEASUREMENT B_beoezs "Fehlerspeichergrˆﬂe (nicht belegt)" UWORD B_TRUE 1 100 0 1 BIT_MASK 0x20 FORMAT "%13.11" ECU_ADDRESS 0x3FE52C /end MEASUREMENT
/begin MEASUREMENT B_beta "Bedingung Bandende-Funktionsanforderung Ansauglufttemperaturf¸hler" UWORD B_TRUE 1 100 0 1 BIT_MASK 0x20 FORMAT "%13.11" ECU_ADDRESS 0x3FE560 /end MEASUREMENT
/begin MEASUREMENT B_betka "Bedingung Bandende-Funktionsanforderung: TKA-Sensor" UWORD B_TRUE 1 100 0 1 BIT_MASK 0x20 FORMAT "%13.11" ECU_ADDRESS 0x3FE56A /end MEASUREMENT
/begin MEASUREMENT B_betm "Bedingung Bandende-Funktionsanforderung Motortemperaturf¸hler" UWORD B_TRUE 1 100 0 1 BIT_MASK 0x20 FORMAT "%13.11" ECU_ADDRESS 0x3FE56C /end MEASUREMENT
/begin MEASUREMENT B_betum "Bedingung Bandende-Funktionsanforderung" UWORD B_TRUE 1 100 0 1 BIT_MASK 0x20 FORMAT "%13.11" ECU_ADDRESS 0x3FE56E /end MEASUREMENT
/begin MEASUREMENT B_beub "Bedingung: Bandendefunktionanford. f¸r Batteriespannung (Bordnetz)" UWORD B_TRUE 1 100 0 1 BIT_MASK 0x20 FORMAT "%13.11" ECU_ADDRESS 0x3FE570 /end MEASUREMENT
/begin MEASUREMENT B_bevvte "Bedingung Bandendeanforderung f¸r Fehler Endstufe VVT" UWORD B_TRUE 1 100 0 1 BIT_MASK 0x20 FORMAT "%13.11" ECU_ADDRESS 0x3FE58E /end MEASUREMENT
/begin MEASUREMENT B_bewca "" UWORD B_TRUE 1 100 0 1 BIT_MASK 0x20 FORMAT "%13.11" ECU_ADDRESS 0x3FE590 /end MEASUREMENT
/begin MEASUREMENT B_bewfs "Bedingung Bandende-Funktionsanforderung Wegfahrsperre" UWORD B_TRUE 1 100 0 1 BIT_MASK 0x20 FORMAT "%13.11" ECU_ADDRESS 0x3FE592 /end MEASUREMENT
/begin MEASUREMENT B_bkbrems "Bedingung Ersatzwert aktiv: BREMS (Bremsschalter)" UWORD B_TRUE 1 100 0 1 BIT_MASK 0x40 FORMAT "%13.11" ECU_ADDRESS 0x3FE3BE /end MEASUREMENT
/begin MEASUREMENT B_bkbwf "Flag f¸r Ersatzwert: PWG Bewegung" UWORD B_TRUE 1 100 0 1 BIT_MASK 0x40 FORMAT "%13.11" ECU_ADDRESS 0x3FE3C0 /end MEASUREMENT
/begin MEASUREMENT B_bkddss "Bedingung: Ersatzwert Differenzdrucksensor Saugrohr" UWORD B_TRUE 1 100 0 1 BIT_MASK 0x40 FORMAT "%13.11" ECU_ADDRESS 0x3FE3E2 /end MEASUREMENT
/begin MEASUREMENT B_bkdgen "" UWORD B_TRUE 1 100 0 1 BIT_MASK 0x40 FORMAT "%13.11" ECU_ADDRESS 0x3FE3E4 /end MEASUREMENT
/begin MEASUREMENT B_bkdgen2 "" UWORD B_TRUE 1 100 0 1 BIT_MASK 0x40 FORMAT "%13.11" ECU_ADDRESS 0x3FE3E6 /end MEASUREMENT
/begin MEASUREMENT B_bkdgenb2 "" UWORD B_TRUE 1 100 0 1 BIT_MASK 0x40 FORMAT "%13.11" ECU_ADDRESS 0x3FE3E8 /end MEASUREMENT
/begin MEASUREMENT B_bkdgenbs "" UWORD B_TRUE 1 100 0 1 BIT_MASK 0x40 FORMAT "%13.11" ECU_ADDRESS 0x3FE3EA /end MEASUREMENT
/begin MEASUREMENT B_bkdibs1 "" UWORD B_TRUE 1 100 0 1 BIT_MASK 0x40 FORMAT "%13.11" ECU_ADDRESS 0x3FE3EE /end MEASUREMENT
/begin MEASUREMENT B_bkdibs2 "" UWORD B_TRUE 1 100 0 1 BIT_MASK 0x40 FORMAT "%13.11" ECU_ADDRESS 0x3FE3F0 /end MEASUREMENT
/begin MEASUREMENT B_bkdibs3 "" UWORD B_TRUE 1 100 0 1 BIT_MASK 0x40 FORMAT "%13.11" ECU_ADDRESS 0x3FE3F2 /end MEASUREMENT
/begin MEASUREMENT B_bkdsu "Bedingung: Umgebungsdrucksensor" UWORD B_TRUE 1 100 0 1 BIT_MASK 0x40 FORMAT "%13.11" ECU_ADDRESS 0x3FE40A /end MEASUREMENT
/begin MEASUREMENT B_bkdwa "Bedingung: Diebstahlwarnanlage" UWORD B_TRUE 1 100 0 1 BIT_MASK 0x40 FORMAT "%13.11" ECU_ADDRESS 0x3FE452 /end MEASUREMENT
/begin MEASUREMENT B_bkdzku0 "DSM Information : Z¸ndkreisdiagnose" UWORD B_TRUE 1 100 0 1 BIT_MASK 0x40 FORMAT "%13.11" ECU_ADDRESS 0x3FE458 /end MEASUREMENT
/begin MEASUREMENT B_bkdzku1 "DSM Information : Z¸ndkreisdiagnose" UWORD B_TRUE 1 100 0 1 BIT_MASK 0x40 FORMAT "%13.11" ECU_ADDRESS 0x3FE45A /end MEASUREMENT
/begin MEASUREMENT B_bkdzku2 "DSM Information : Z¸ndkreisdiagnose" UWORD B_TRUE 1 100 0 1 BIT_MASK 0x40 FORMAT "%13.11" ECU_ADDRESS 0x3FE45C /end MEASUREMENT
/begin MEASUREMENT B_bkdzku3 "DSM Information : Z¸ndkreisdiagnose" UWORD B_TRUE 1 100 0 1 BIT_MASK 0x40 FORMAT "%13.11" ECU_ADDRESS 0x3FE45E /end MEASUREMENT
/begin MEASUREMENT B_bkdzku4 "DSM Information : Z¸ndkreisdiagnose" UWORD B_TRUE 1 100 0 1 BIT_MASK 0x40 FORMAT "%13.11" ECU_ADDRESS 0x3FE460 /end MEASUREMENT
/begin MEASUREMENT B_bkdzku5 "DSM Information : Z¸ndkreisdiagnose" UWORD B_TRUE 1 100 0 1 BIT_MASK 0x40 FORMAT "%13.11" ECU_ADDRESS 0x3FE462 /end MEASUREMENT
/begin MEASUREMENT B_bkdzku6 "DSM Information : Z¸ndkreisdiagnose" UWORD B_TRUE 1 100 0 1 BIT_MASK 0x40 FORMAT "%13.11" ECU_ADDRESS 0x3FE464 /end MEASUREMENT
/begin MEASUREMENT B_bkdzku7 "DSM Information : Z¸ndkreisdiagnose" UWORD B_TRUE 1 100 0 1 BIT_MASK 0x40 FORMAT "%13.11" ECU_ADDRESS 0x3FE466 /end MEASUREMENT
/begin MEASUREMENT B_bkegfe "Bedingung: Ersatzwert aktiv bei Eingangsgrˆﬂen der F¸llungserfassung" UWORD B_TRUE 1 100 0 1 BIT_MASK 0x40 FORMAT "%13.11" ECU_ADDRESS 0x3FE468 /end MEASUREMENT
/begin MEASUREMENT B_bkfp1p "Bedingung: Fahrpedal 1.Potentiometer aktiv" UWORD B_TRUE 1 100 0 1 BIT_MASK 0x40 FORMAT "%13.11" ECU_ADDRESS 0x3FE486 /end MEASUREMENT
/begin MEASUREMENT B_bkfp2p "Bedingung: Fahrpedal 2.Potentiometer aktiv" UWORD B_TRUE 1 100 0 1 BIT_MASK 0x40 FORMAT "%13.11" ECU_ADDRESS 0x3FE488 /end MEASUREMENT
/begin MEASUREMENT B_bkfpp "Bedingung: Fahrpedal Potentiometer aktiv" UWORD B_TRUE 1 100 0 1 BIT_MASK 0x40 FORMAT "%13.11" ECU_ADDRESS 0x3FE48A /end MEASUREMENT
/begin MEASUREMENT B_bklsvv "Bedingung: vertauschte Lambdasonde vor Kat. aktiv" UWORD B_TRUE 1 100 0 1 BIT_MASK 0x40 FORMAT "%13.11" ECU_ADDRESS 0x3FE4FE /end MEASUREMENT
/begin MEASUREMENT B_bkmdb "Bedingung: Momentan¸berwachung (bergrenzt dauerhaft) aktiv" UWORD B_TRUE 1 100 0 1 BIT_MASK 0x40 FORMAT "%13.11" ECU_ADDRESS 0x3FE51A /end MEASUREMENT
/begin MEASUREMENT B_bkmfl "Bedingung Ersatzwert aktiv MFL" UWORD B_TRUE 1 100 0 1 BIT_MASK 0x40 FORMAT "%13.11" ECU_ADDRESS 0x3FE51C /end MEASUREMENT
/begin MEASUREMENT B_bkminhub "Bedingung, Ersatzwert aktiv Fehler Minhubadaption" UWORD B_TRUE 1 100 0 1 BIT_MASK 0x40 FORMAT "%13.11" ECU_ADDRESS 0x3FE51E /end MEASUREMENT
/begin MEASUREMENT B_bkmtoel "Diagnose verwendet Ersatzwert" UWORD B_TRUE 1 100 0 1 BIT_MASK 0x40 FORMAT "%13.11" ECU_ADDRESS 0x3FE522 /end MEASUREMENT
/begin MEASUREMENT B_bknvrmon "Bedingung Ersatzwert aktiv NVRAM-Backup Aktualit‰ts ‹berwachung" UWORD B_TRUE 1 100 0 1 BIT_MASK 0x40 FORMAT "%13.11" ECU_ADDRESS 0x3FE528 /end MEASUREMENT
/begin MEASUREMENT B_bkoezs "Fehlerspeichergrˆﬂe (nicht belegt)" UWORD B_TRUE 1 100 0 1 BIT_MASK 0x40 FORMAT "%13.11" ECU_ADDRESS 0x3FE52C /end MEASUREMENT
/begin MEASUREMENT B_bkpddss "Bedingung: Ersatzwert Druck Differenzdrucksensor Saugrohr" UWORD B_TRUE 1 100 0 1 BIT_MASK 0x40 FORMAT "%13.11" ECU_ADDRESS 0x3FE52E /end MEASUREMENT
/begin MEASUREMENT B_bkta "Bedingung Ersatzwert f¸r Ansauglufttemperatur (/Ladelufttemp.)" UWORD B_TRUE 1 100 0 1 BIT_MASK 0x40 FORMAT "%13.11" ECU_ADDRESS 0x3FE560 /end MEASUREMENT
/begin MEASUREMENT B_bktka "Bedingung Ersatzwert f¸r Temperatur K¸hlerausgang" UWORD B_TRUE 1 100 0 1 BIT_MASK 0x40 FORMAT "%13.11" ECU_ADDRESS 0x3FE56A /end MEASUREMENT
/begin MEASUREMENT B_bktm "Bedingung Ersatzwert f¸r Motortemperatur" UWORD B_TRUE 1 100 0 1 BIT_MASK 0x40 FORMAT "%13.11" ECU_ADDRESS 0x3FE56C /end MEASUREMENT
/begin MEASUREMENT B_bktum "Bedingung Ersatzwert f¸r Umgebumgstemperatur" UWORD B_TRUE 1 100 0 1 BIT_MASK 0x40 FORMAT "%13.11" ECU_ADDRESS 0x3FE56E /end MEASUREMENT
/begin MEASUREMENT B_bkub "Bedingung Ersatzwert f¸r Batteriespannung (Bordnetz)" UWORD B_TRUE 1 100 0 1 BIT_MASK 0x40 FORMAT "%13.11" ECU_ADDRESS 0x3FE570 /end MEASUREMENT
/begin MEASUREMENT B_bkvvte "Bedingung Ersatzwert aktiv VVT" UWORD B_TRUE 1 100 0 1 BIT_MASK 0x40 FORMAT "%13.11" ECU_ADDRESS 0x3FE58E /end MEASUREMENT
/begin MEASUREMENT B_bkwca "Bedingung: Wegfahrsperre Wechselcode-Ablage" UWORD B_TRUE 1 100 0 1 BIT_MASK 0x40 FORMAT "%13.11" ECU_ADDRESS 0x3FE590 /end MEASUREMENT
/begin MEASUREMENT B_bkwfs "Bedingung: Wegfahrsperre" UWORD B_TRUE 1 100 0 1 BIT_MASK 0x40 FORMAT "%13.11" ECU_ADDRESS 0x3FE592 /end MEASUREMENT
/begin MEASUREMENT B_clbrems "Bedingung Fehlerpfad BREMS (Bremsschalter) lˆschen" UWORD B_TRUE 1 100 0 1 BIT_MASK 0x80 FORMAT "%13.11" ECU_ADDRESS 0x3FE3BE /end MEASUREMENT
/begin MEASUREMENT B_clbwf "Flag f¸r Lˆschung: PWG Bewegung" UWORD B_TRUE 1 100 0 1 BIT_MASK 0x80 FORMAT "%13.11" ECU_ADDRESS 0x3FE3C0 /end MEASUREMENT
/begin MEASUREMENT B_clddss "Bedingung: Fehlerpfad Differenzdrucksensor Saugrohr lˆschen" UWORD B_TRUE 1 100 0 1 BIT_MASK 0x80 FORMAT "%13.11" ECU_ADDRESS 0x3FE3E2 /end MEASUREMENT
/begin MEASUREMENT B_cldgen "" UWORD B_TRUE 1 100 0 1 BIT_MASK 0x80 FORMAT "%13.11" ECU_ADDRESS 0x3FE3E4 /end MEASUREMENT
/begin MEASUREMENT B_cldgen2 "" UWORD B_TRUE 1 100 0 1 BIT_MASK 0x80 FORMAT "%13.11" ECU_ADDRESS 0x3FE3E6 /end MEASUREMENT
/begin MEASUREMENT B_cldgenb2 "" UWORD B_TRUE 1 100 0 1 BIT_MASK 0x80 FORMAT "%13.11" ECU_ADDRESS 0x3FE3E8 /end MEASUREMENT
/begin MEASUREMENT B_cldgenbs "" UWORD B_TRUE 1 100 0 1 BIT_MASK 0x80 FORMAT "%13.11" ECU_ADDRESS 0x3FE3EA /end MEASUREMENT
/begin MEASUREMENT B_cldibs1 "" UWORD B_TRUE 1 100 0 1 BIT_MASK 0x80 FORMAT "%13.11" ECU_ADDRESS 0x3FE3EE /end MEASUREMENT
/begin MEASUREMENT B_cldibs2 "" UWORD B_TRUE 1 100 0 1 BIT_MASK 0x80 FORMAT "%13.11" ECU_ADDRESS 0x3FE3F0 /end MEASUREMENT
/begin MEASUREMENT B_cldibs3 "" UWORD B_TRUE 1 100 0 1 BIT_MASK 0x80 FORMAT "%13.11" ECU_ADDRESS 0x3FE3F2 /end MEASUREMENT
/begin MEASUREMENT B_cldsu "Bedingung: Fehlerpfad Umgebungsdrucksensor lˆschen" UWORD B_TRUE 1 100 0 1 BIT_MASK 0x80 FORMAT "%13.11" ECU_ADDRESS 0x3FE40A /end MEASUREMENT
/begin MEASUREMENT B_cldwa "Bedingung lˆschen: Diebstahlwarnanlage" UWORD B_TRUE 1 100 0 1 BIT_MASK 0x80 FORMAT "%13.11" ECU_ADDRESS 0x3FE452 /end MEASUREMENT
/begin MEASUREMENT B_cldzku0 "lˆschen prim.Z¸ndkreis Zyl.0" UWORD B_TRUE 1 100 0 1 BIT_MASK 0x80 FORMAT "%13.11" ECU_ADDRESS 0x3FE458 /end MEASUREMENT
/begin MEASUREMENT B_cldzku1 "lˆschen prim.Z¸ndkreis Zyl.1" UWORD B_TRUE 1 100 0 1 BIT_MASK 0x80 FORMAT "%13.11" ECU_ADDRESS 0x3FE45A /end MEASUREMENT
/begin MEASUREMENT B_cldzku2 "lˆschen prim.Z¸ndkreis Zyl.2" UWORD B_TRUE 1 100 0 1 BIT_MASK 0x80 FORMAT "%13.11" ECU_ADDRESS 0x3FE45C /end MEASUREMENT
/begin MEASUREMENT B_cldzku3 "lˆschen prim.Z¸ndkreis Zyl.3" UWORD B_TRUE 1 100 0 1 BIT_MASK 0x80 FORMAT "%13.11" ECU_ADDRESS 0x3FE45E /end MEASUREMENT
/begin MEASUREMENT B_cldzku4 "lˆschen prim.Z¸ndkreis Zyl.4" UWORD B_TRUE 1 100 0 1 BIT_MASK 0x80 FORMAT "%13.11" ECU_ADDRESS 0x3FE460 /end MEASUREMENT
/begin MEASUREMENT B_cldzku5 "lˆschen prim.Z¸ndkreis Zyl.5" UWORD B_TRUE 1 100 0 1 BIT_MASK 0x80 FORMAT "%13.11" ECU_ADDRESS 0x3FE462 /end MEASUREMENT
/begin MEASUREMENT B_cldzku6 "lˆschen prim.Z¸ndkreis Zyl.6" UWORD B_TRUE 1 100 0 1 BIT_MASK 0x80 FORMAT "%13.11" ECU_ADDRESS 0x3FE464 /end MEASUREMENT
/begin MEASUREMENT B_cldzku7 "lˆschen prim.Z¸ndkreis Zyl.7" UWORD B_TRUE 1 100 0 1 BIT_MASK 0x80 FORMAT "%13.11" ECU_ADDRESS 0x3FE466 /end MEASUREMENT
/begin MEASUREMENT B_clegfe "Bedingung Fehlerpfad EGFE lˆschen" UWORD B_TRUE 1 100 0 1 BIT_MASK 0x80 FORMAT "%13.11" ECU_ADDRESS 0x3FE468 /end MEASUREMENT
/begin MEASUREMENT B_clfp1p "Flag f¸r Lˆschmaﬂnahmen: Fahrpedal 1. Poti" UWORD B_TRUE 1 100 0 1 BIT_MASK 0x80 FORMAT "%13.11" ECU_ADDRESS 0x3FE486 /end MEASUREMENT
/begin MEASUREMENT B_clfp2p "Flag f¸r Lˆschmaﬂnahmen: Fahrpedal 2. Poti" UWORD B_TRUE 1 100 0 1 BIT_MASK 0x80 FORMAT "%13.11" ECU_ADDRESS 0x3FE488 /end MEASUREMENT
/begin MEASUREMENT B_clfpp "Bedingung Fehlerpfad FPP (Fahrpedal-Poti) lˆschen" UWORD B_TRUE 1 100 0 1 BIT_MASK 0x80 FORMAT "%13.11" ECU_ADDRESS 0x3FE48A /end MEASUREMENT
/begin MEASUREMENT B_cllsvv "Bedingung Fehlerpfad Vertauschte Sonden lˆschen" UWORD B_TRUE 1 100 0 1 BIT_MASK 0x80 FORMAT "%13.11" ECU_ADDRESS 0x3FE4FE /end MEASUREMENT
/begin MEASUREMENT B_clmdb "Flag f¸r Lˆschung: Momentenbegrenzung begrenzt dauerhaft" UWORD B_TRUE 1 100 0 1 BIT_MASK 0x80 FORMAT "%13.11" ECU_ADDRESS 0x3FE51A /end MEASUREMENT
/begin MEASUREMENT B_clmfl "Bedingung Fehlerflag ""Multifunktionslenkrad"" lˆschen" UWORD B_TRUE 1 100 0 1 BIT_MASK 0x80 FORMAT "%13.11" ECU_ADDRESS 0x3FE51C /end MEASUREMENT
/begin MEASUREMENT B_clminhub "Fehlerpfad lˆschen f¸r Fehler Minhubadaption" UWORD B_TRUE 1 100 0 1 BIT_MASK 0x80 FORMAT "%13.11" ECU_ADDRESS 0x3FE51E /end MEASUREMENT
/begin MEASUREMENT B_clmtoel "" UWORD B_TRUE 1 100 0 1 BIT_MASK 0x80 FORMAT "%13.11" ECU_ADDRESS 0x3FE522 /end MEASUREMENT
/begin MEASUREMENT B_clnvrmon "" UWORD B_TRUE 1 100 0 1 BIT_MASK 0x80 FORMAT "%13.11" ECU_ADDRESS 0x3FE528 /end MEASUREMENT
/begin MEASUREMENT B_cloezs "Clearflag ÷lzustandssensor" UWORD B_TRUE 1 100 0 1 BIT_MASK 0x80 FORMAT "%13.11" ECU_ADDRESS 0x3FE52C /end MEASUREMENT
/begin MEASUREMENT B_clpddss "Bedingung: Fehlerpfad Druck Differenzdrucksensor Saugrohr lˆschen" UWORD B_TRUE 1 100 0 1 BIT_MASK 0x80 FORMAT "%13.11" ECU_ADDRESS 0x3FE52E /end MEASUREMENT
/begin MEASUREMENT B_clta "Bedingung Fehlerpfad Ansauglufttemperatur (/Ladeluft-) TANS lˆschen" UWORD B_TRUE 1 100 0 1 BIT_MASK 0x80 FORMAT "%13.11" ECU_ADDRESS 0x3FE560 /end MEASUREMENT
/begin MEASUREMENT B_cltka "Bedingung Fehlerpfad Temperatur K¸hlerausgang TKA lˆschen" UWORD B_TRUE 1 100 0 1 BIT_MASK 0x80 FORMAT "%13.11" ECU_ADDRESS 0x3FE56A /end MEASUREMENT
/begin MEASUREMENT B_cltm "Bedingung Fehlerpfad Motortemperatur TMOT lˆschen" UWORD B_TRUE 1 100 0 1 BIT_MASK 0x80 FORMAT "%13.11" ECU_ADDRESS 0x3FE56C /end MEASUREMENT
/begin MEASUREMENT B_cltum "Bedingung Fehlerpfad Umgebungstemperatur TUM  lˆschen" UWORD B_TRUE 1 100 0 1 BIT_MASK 0x80 FORMAT "%13.11" ECU_ADDRESS 0x3FE56E /end MEASUREMENT
/begin MEASUREMENT B_club "Bedingung Fehlerpfad Batteriespannung (Bordnetz) lˆschen" UWORD B_TRUE 1 100 0 1 BIT_MASK 0x80 FORMAT "%13.11" ECU_ADDRESS 0x3FE570 /end MEASUREMENT
/begin MEASUREMENT B_clvvte "Bedingung: Fehlerpfad Endstufe VVT lˆschen" UWORD B_TRUE 1 100 0 1 BIT_MASK 0x80 FORMAT "%13.11" ECU_ADDRESS 0x3FE58E /end MEASUREMENT
/begin MEASUREMENT B_clwca "Bedingung lˆschen: Wegfahrsperre Wechselcode-Ablage" UWORD B_TRUE 1 100 0 1 BIT_MASK 0x80 FORMAT "%13.11" ECU_ADDRESS 0x3FE590 /end MEASUREMENT
/begin MEASUREMENT B_clwfs "Bedingung Wegfahrsperre lˆschen" UWORD B_TRUE 1 100 0 1 BIT_MASK 0x80 FORMAT "%13.11" ECU_ADDRESS 0x3FE592 /end MEASUREMENT
/begin MEASUREMENT B_dfskvo "Bedingung Fuellstands-Verbrauchsdiagnose obere Schwelle" UBYTE B_TRUE 1 100 0 1 BIT_MASK 0x1 FORMAT "%13.11" ECU_ADDRESS 0x403BB0 /end MEASUREMENT
/begin MEASUREMENT B_dfskvu "Bedingung Fuellstands-Verbrauchsdiagnose untere Schwelle" UBYTE B_TRUE 1 100 0 1 BIT_MASK 0x2 FORMAT "%13.11" ECU_ADDRESS 0x403BB0 /end MEASUREMENT
/begin MEASUREMENT B_dfstav "Bedingung Diagoseschwellen Tankgeber fuer Tank voll" UBYTE B_TRUE 1 100 0 1 BIT_MASK 0x4 FORMAT "%13.11" ECU_ADDRESS 0x3FE0B6 /end MEASUREMENT
/begin MEASUREMENT B_dodgen "" UBYTE B_TRUE 1 100 0 1 FORMAT "%13.11" ECU_ADDRESS 0x4031CD /end MEASUREMENT
/begin MEASUREMENT B_dodgen2 "" UBYTE B_TRUE 1 100 0 1 FORMAT "%13.11" ECU_ADDRESS 0x4031DF /end MEASUREMENT
/begin MEASUREMENT B_dodgenb2 "" UBYTE B_TRUE 1 100 0 1 FORMAT "%13.11" ECU_ADDRESS 0x4031E0 /end MEASUREMENT
/begin MEASUREMENT B_dodgenbs "" UBYTE B_TRUE 1 100 0 1 FORMAT "%13.11" ECU_ADDRESS 0x4031CE /end MEASUREMENT
/begin MEASUREMENT B_dtankm "Bedingung Diagnose Tankvorgang moeglich" UBYTE B_TRUE 1 100 0 1 BIT_MASK 0x4 FORMAT "%13.11" ECU_ADDRESS 0x403BB0 /end MEASUREMENT
/begin MEASUREMENT B_efskvo "Bedingung Fehler Fuellstands-Verbrauchsdiagnose obere Schwelle" UBYTE B_TRUE 1 100 0 1 BIT_MASK 0x1 FORMAT "%13.11" ECU_ADDRESS 0x403BB2 /end MEASUREMENT
/begin MEASUREMENT B_efskvu "BEdingung Fehler Fuellstands-Verbrauchsdiagnose untere Schwelle" UBYTE B_TRUE 1 100 0 1 BIT_MASK 0x2 FORMAT "%13.11" ECU_ADDRESS 0x403BB2 /end MEASUREMENT
/begin MEASUREMENT B_ehfm "Bedingung Fehler HFM (ohne Entprellung)" UBYTE B_TRUE 1 100 0 1 BIT_MASK 0x1 FORMAT "%13.11" ECU_ADDRESS 0x3FC06F /end MEASUREMENT
/begin MEASUREMENT B_ehfm1 "Bedingung Fehler HFM (ohne Entprellung) (Zwischengrˆﬂe ohne Abfrage von UBAT)" UBYTE B_TRUE 1 100 0 1 BIT_MASK 0x1 FORMAT "%13.11" ECU_ADDRESS 0x3FC070 /end MEASUREMENT
/begin MEASUREMENT B_ehfs "Bedingung Ersatzwert Hauptf¸llungssensor" UBYTE B_TRUE 1 100 0 1 BIT_MASK 0x1 FORMAT "%13.11" ECU_ADDRESS 0x3FC071 /end MEASUREMENT
/begin MEASUREMENT B_ehlsu "Bedingung Fehler Heizung LSU" UBYTE B_TRUE 1 100 0 1 BIT_MASK 0x1 FORMAT "%13.11" ECU_ADDRESS 0x403B78 /end MEASUREMENT
/begin MEASUREMENT B_ehlsu2 "Bedingung Fehler Heizung LSU Bank2" UBYTE B_TRUE 1 100 0 1 BIT_MASK 0x2 FORMAT "%13.11" ECU_ADDRESS 0x403B78 /end MEASUREMENT
/begin MEASUREMENT B_elmi "Bedingung Error Luftmasse bei Initialisierung" UBYTE B_TRUE 1 100 0 1 BIT_MASK 0x1 FORMAT "%13.11" ECU_ADDRESS 0x3FC072 /end MEASUREMENT
/begin MEASUREMENT B_enh "Bedingung Freigabe Ri-Diagnose Sondenheizung hinter Kat" UBYTE B_TRUE 1 100 0 1 BIT_MASK 0x10 FORMAT "%13.11" ECU_ADDRESS 0x402A42 /end MEASUREMENT
/begin MEASUREMENT B_enh2 "Bedingung Freigabe Ri-Diagnose Sondenheizung 2 hinter Kat" UBYTE B_TRUE 1 100 0 1 BIT_MASK 0x10 FORMAT "%13.11" ECU_ADDRESS 0x402A43 /end MEASUREMENT
/begin MEASUREMENT B_enhsh "Bedingung Freigabe Diagnose Sondenheizung hinter Kat" UBYTE B_TRUE 1 100 0 1 BIT_MASK 0x1 FORMAT "%13.11" ECU_ADDRESS 0x3FBFDC /end MEASUREMENT
/begin MEASUREMENT B_enmx "Bedingung Diagnose ""schwacher Heizen"" eingeschaltet" UBYTE B_TRUE 1 100 0 1 BIT_MASK 0x20 FORMAT "%13.11" ECU_ADDRESS 0x403B79 /end MEASUREMENT
/begin MEASUREMENT B_enmx2 "Bedingung Diagnose ""schwacher Heizen"" eingeschaltet (Bank 2)" UBYTE B_TRUE 1 100 0 1 BIT_MASK 0x10 FORMAT "%13.11" ECU_ADDRESS 0x403B7A /end MEASUREMENT
/begin MEASUREMENT B_fadwa "" UWORD B_TRUE 1 100 0 1 BIT_MASK 0x10 FORMAT "%13.11" ECU_ADDRESS 0x3FE452 /end MEASUREMENT
/begin MEASUREMENT B_fawca "" UWORD B_TRUE 1 100 0 1 BIT_MASK 0x10 FORMAT "%13.11" ECU_ADDRESS 0x3FE590 /end MEASUREMENT
/begin MEASUREMENT B_fawfs "" UWORD B_TRUE 1 100 0 1 BIT_MASK 0x10 FORMAT "%13.11" ECU_ADDRESS 0x3FE592 /end MEASUREMENT
/begin MEASUREMENT B_fstclr "Bedingung Fuellstand Clearanforderung" UBYTE B_TRUE 1 100 0 1 BIT_MASK 0x10 FORMAT "%13.11" ECU_ADDRESS 0x403BB1 /end MEASUREMENT
/begin MEASUREMENT B_fstdakt "Bedingung Fuellstandsgeber - Plausibilisierung aktiv" UBYTE B_TRUE 1 100 0 1 BIT_MASK 0x8 FORMAT "%13.11" ECU_ADDRESS 0x403BB0 /end MEASUREMENT
/begin MEASUREMENT B_fstini "Bedingung Fuellstand fuer Auswertung initialisieren" UBYTE B_TRUE 1 100 0 1 BIT_MASK 0x10 FORMAT "%13.11" ECU_ADDRESS 0x403BB0 /end MEASUREMENT
/begin MEASUREMENT B_fstlowr "Bedingung Fuellstandsgeberdiagnose-Unterbrechung durch low range" UBYTE B_TRUE 1 100 0 1 BIT_MASK 0x2 FORMAT "%13.11" ECU_ADDRESS 0x3FE0B6 /end MEASUREMENT
/begin MEASUREMENT B_fstsigf "Fuellstandssignalfehler" UBYTE B_TRUE 1 100 0 1 BIT_MASK 0x20 FORMAT "%13.11" ECU_ADDRESS 0x403BB0 /end MEASUREMENT
/begin MEASUREMENT B_fsttab "Bedingung Fuellstand hat abgenommen waehrend Zuendung ein" UBYTE B_TRUE 1 100 0 1 BIT_MASK 0x40 FORMAT "%13.11" ECU_ADDRESS 0x403BB1 /end MEASUREMENT
/begin MEASUREMENT B_fsttden "Bedingung Diagnosefreigabe Fuellstand Tank" UBYTE B_TRUE 1 100 0 1 BIT_MASK 0x40 FORMAT "%13.11" ECU_ADDRESS 0x403BB0 /end MEASUREMENT
/begin MEASUREMENT B_fsttin "Bedingung Fuellstand einlesen" UBYTE B_TRUE 1 100 0 1 BIT_MASK 0x2 FORMAT "%13.11" ECU_ADDRESS 0x403BAF /end MEASUREMENT
/begin MEASUREMENT B_fsttldv "Bedingung:  Fuelstand fuer Tankleckdiagnose g¸ltig" UBYTE B_TRUE 1 100 0 1 BIT_MASK 0x8 FORMAT "%13.11" ECU_ADDRESS 0x403BAF /end MEASUREMENT
/begin MEASUREMENT B_fsttzu "Bedingung Fuellstand hat zugenommen waehrend Zuendung ein" UBYTE B_TRUE 1 100 0 1 BIT_MASK 0x20 FORMAT "%13.11" ECU_ADDRESS 0x403BB1 /end MEASUREMENT
/begin MEASUREMENT B_ftbrems "Bedingung: Fehlereintrag durch Tester f¸r Bremsschalter" UWORD B_TRUE 1 100 0 1 BIT_MASK 0x10 FORMAT "%13.11" ECU_ADDRESS 0x3FE3BE /end MEASUREMENT
/begin MEASUREMENT B_ftbwf "Bedingung Fehlereintrag durch Tester f¸r Bewegungsfehler FPM" UWORD B_TRUE 1 100 0 1 BIT_MASK 0x10 FORMAT "%13.11" ECU_ADDRESS 0x3FE3C0 /end MEASUREMENT
/begin MEASUREMENT B_ftdgen "" UWORD B_TRUE 1 100 0 1 BIT_MASK 0x10 FORMAT "%13.11" ECU_ADDRESS 0x3FE3E4 /end MEASUREMENT
/begin MEASUREMENT B_ftdgen2 "" UWORD B_TRUE 1 100 0 1 BIT_MASK 0x10 FORMAT "%13.11" ECU_ADDRESS 0x3FE3E6 /end MEASUREMENT
/begin MEASUREMENT B_ftdgenb2 "" UWORD B_TRUE 1 100 0 1 BIT_MASK 0x10 FORMAT "%13.11" ECU_ADDRESS 0x3FE3E8 /end MEASUREMENT
/begin MEASUREMENT B_ftdgenbs "" UWORD B_TRUE 1 100 0 1 BIT_MASK 0x10 FORMAT "%13.11" ECU_ADDRESS 0x3FE3EA /end MEASUREMENT
/begin MEASUREMENT B_ftdibs1 "" UWORD B_TRUE 1 100 0 1 BIT_MASK 0x10 FORMAT "%13.11" ECU_ADDRESS 0x3FE3EE /end MEASUREMENT
/begin MEASUREMENT B_ftdibs2 "" UWORD B_TRUE 1 100 0 1 BIT_MASK 0x10 FORMAT "%13.11" ECU_ADDRESS 0x3FE3F0 /end MEASUREMENT
/begin MEASUREMENT B_ftdibs3 "" UWORD B_TRUE 1 100 0 1 BIT_MASK 0x10 FORMAT "%13.11" ECU_ADDRESS 0x3FE3F2 /end MEASUREMENT
/begin MEASUREMENT B_ftdsu "Bedingung: Fehlereintrag durch Tester f¸r DSU" UWORD B_TRUE 1 100 0 1 BIT_MASK 0x10 FORMAT "%13.11" ECU_ADDRESS 0x3FE40A /end MEASUREMENT
/begin MEASUREMENT B_ftdzku0 "DSM Information : Z¸ndkreisdiagnose" UWORD B_TRUE 1 100 0 1 BIT_MASK 0x10 FORMAT "%13.11" ECU_ADDRESS 0x3FE458 /end MEASUREMENT
/begin MEASUREMENT B_ftdzku1 "DSM Information : Z¸ndkreisdiagnose" UWORD B_TRUE 1 100 0 1 BIT_MASK 0x10 FORMAT "%13.11" ECU_ADDRESS 0x3FE45A /end MEASUREMENT
/begin MEASUREMENT B_ftdzku2 "DSM Information : Z¸ndkreisdiagnose" UWORD B_TRUE 1 100 0 1 BIT_MASK 0x10 FORMAT "%13.11" ECU_ADDRESS 0x3FE45C /end MEASUREMENT
/begin MEASUREMENT B_ftdzku3 "DSM Information : Z¸ndkreisdiagnose" UWORD B_TRUE 1 100 0 1 BIT_MASK 0x10 FORMAT "%13.11" ECU_ADDRESS 0x3FE45E /end MEASUREMENT
/begin MEASUREMENT B_ftdzku4 "DSM Information : Z¸ndkreisdiagnose" UWORD B_TRUE 1 100 0 1 BIT_MASK 0x10 FORMAT "%13.11" ECU_ADDRESS 0x3FE460 /end MEASUREMENT
/begin MEASUREMENT B_ftdzku5 "DSM Information : Z¸ndkreisdiagnose" UWORD B_TRUE 1 100 0 1 BIT_MASK 0x10 FORMAT "%13.11" ECU_ADDRESS 0x3FE462 /end MEASUREMENT
/begin MEASUREMENT B_ftdzku6 "DSM Information : Z¸ndkreisdiagnose" UWORD B_TRUE 1 100 0 1 BIT_MASK 0x10 FORMAT "%13.11" ECU_ADDRESS 0x3FE464 /end MEASUREMENT
/begin MEASUREMENT B_ftdzku7 "DSM Information : Z¸ndkreisdiagnose" UWORD B_TRUE 1 100 0 1 BIT_MASK 0x10 FORMAT "%13.11" ECU_ADDRESS 0x3FE466 /end MEASUREMENT
/begin MEASUREMENT B_ftegfe "Bedingung: Fehlereintrag durch Tester f¸r DEGFE" UWORD B_TRUE 1 100 0 1 BIT_MASK 0x10 FORMAT "%13.11" ECU_ADDRESS 0x3FE468 /end MEASUREMENT
/begin MEASUREMENT B_ftfp1p "Bedingung Fehlereintrag durch Tester f¸r Poti1 FPM" UWORD B_TRUE 1 100 0 1 BIT_MASK 0x10 FORMAT "%13.11" ECU_ADDRESS 0x3FE486 /end MEASUREMENT
/begin MEASUREMENT B_ftfp2p "Bedingung Fehlereintrag durch Tester f¸r Poti2 FPM" UWORD B_TRUE 1 100 0 1 BIT_MASK 0x10 FORMAT "%13.11" ECU_ADDRESS 0x3FE488 /end MEASUREMENT
/begin MEASUREMENT B_ftfpp "Bedingung Fehlereintrag durch Tester f¸r FPM" UWORD B_TRUE 1 100 0 1 BIT_MASK 0x10 FORMAT "%13.11" ECU_ADDRESS 0x3FE48A /end MEASUREMENT
/begin MEASUREMENT B_ftlsvv "Bedingung Fehlereintrag durch Tester Lambda Sonde vertauscht vor KAT" UWORD B_TRUE 1 100 0 1 BIT_MASK 0x10 FORMAT "%13.11" ECU_ADDRESS 0x3FE4FE /end MEASUREMENT
/begin MEASUREMENT B_ftmdb "Bedingung: Fehlereintrag durch Tester f¸r MDB" UWORD B_TRUE 1 100 0 1 BIT_MASK 0x10 FORMAT "%13.11" ECU_ADDRESS 0x3FE51A /end MEASUREMENT
/begin MEASUREMENT B_ftmfl "Bedingung: Fehlereintrag durch Tester" UWORD B_TRUE 1 100 0 1 BIT_MASK 0x10 FORMAT "%13.11" ECU_ADDRESS 0x3FE51C /end MEASUREMENT
/begin MEASUREMENT B_ftminhub "Bedingung, Fehlereintrag durch Tester, Fehler Minhubadaption" UWORD B_TRUE 1 100 0 1 BIT_MASK 0x10 FORMAT "%13.11" ECU_ADDRESS 0x3FE51E /end MEASUREMENT
/begin MEASUREMENT B_ftmtoel "Pruefung durch Kundendiensttester" UWORD B_TRUE 1 100 0 1 BIT_MASK 0x10 FORMAT "%13.11" ECU_ADDRESS 0x3FE522 /end MEASUREMENT
/begin MEASUREMENT B_ftnvrmon "Bedingung Fehlereintrag durch Tester NVRAM-Backup Akt.‹berwachung" UWORD B_TRUE 1 100 0 1 BIT_MASK 0x10 FORMAT "%13.11" ECU_ADDRESS 0x3FE528 /end MEASUREMENT
/begin MEASUREMENT B_ftoezs "Fehlerspeichergrˆﬂe (nicht belegt)" UWORD B_TRUE 1 100 0 1 BIT_MASK 0x10 FORMAT "%13.11" ECU_ADDRESS 0x3FE52C /end MEASUREMENT
/begin MEASUREMENT B_ftta "Bedingung Fehlereintrag durch Tester Ansauglufttemperatur" UWORD B_TRUE 1 100 0 1 BIT_MASK 0x10 FORMAT "%13.11" ECU_ADDRESS 0x3FE560 /end MEASUREMENT
/begin MEASUREMENT B_fttka "Bedingung Fehlereintrag durch Tester: TKA-Sensor" UWORD B_TRUE 1 100 0 1 BIT_MASK 0x10 FORMAT "%13.11" ECU_ADDRESS 0x3FE56A /end MEASUREMENT
/begin MEASUREMENT B_fttm "Bedingung Fehlereintrag durch Tester f¸r Motor-/K¸hlmittel-Temperatur" UWORD B_TRUE 1 100 0 1 BIT_MASK 0x10 FORMAT "%13.11" ECU_ADDRESS 0x3FE56C /end MEASUREMENT
/begin MEASUREMENT B_fttum "Bedingung: Fehlereintrag durch Tester" UWORD B_TRUE 1 100 0 1 BIT_MASK 0x10 FORMAT "%13.11" ECU_ADDRESS 0x3FE56E /end MEASUREMENT
/begin MEASUREMENT B_ftub "Bedingung Fehlereintrag durch Tester f¸r Batteriespannung (Bordnetz)" UWORD B_TRUE 1 100 0 1 BIT_MASK 0x10 FORMAT "%13.11" ECU_ADDRESS 0x3FE570 /end MEASUREMENT
/begin MEASUREMENT B_ftvvte "Bedingung: Fehlereintrag durch Tester f¸r VVT" UWORD B_TRUE 1 100 0 1 BIT_MASK 0x10 FORMAT "%13.11" ECU_ADDRESS 0x3FE58E /end MEASUREMENT
/begin MEASUREMENT B_glfvar "Bedingung gesteuerte Luftklappe vorhanden" UBYTE B_TRUE 1 100 0 1 BIT_MASK 0x1 FORMAT "%13.11" ECU_ADDRESS 0x3FC051 /end MEASUREMENT
/begin MEASUREMENT B_hdmtlp "Bedingung Heizung DM-TL Portansteuerung" UBYTE B_TRUE 1 100 0 1 BIT_MASK 0x1 FORMAT "%13.11" ECU_ADDRESS 0x3FC052 /end MEASUREMENT
/begin MEASUREMENT B_hdmttp "Bedingung Endstufentest DMTL-Heizung mit Pr¸fpuls" UBYTE B_TRUE 1 100 0 1 BIT_MASK 0x1 FORMAT "%13.11" ECU_ADDRESS 0x3FE0BE /end MEASUREMENT
/begin MEASUREMENT B_heatf "Freigabe Heizerkopplung LSU" UBYTE B_TRUE 1 100 0 1 BIT_MASK 0x1 FORMAT "%13.11" ECU_ADDRESS 0x403B74 /end MEASUREMENT
/begin MEASUREMENT B_hehshe "Heilung von Endstufenfehlern E_hshe" UBYTE B_TRUE 1 100 0 1 BIT_MASK 0x1 FORMAT "%13.11" ECU_ADDRESS 0x3FBFDD /end MEASUREMENT
/begin MEASUREMENT B_hehshe2 "Heilung von Endstufenfehlern E_hshe2" UBYTE B_TRUE 1 100 0 1 BIT_MASK 0x1 FORMAT "%13.11" ECU_ADDRESS 0x3FBFDE /end MEASUREMENT
/begin MEASUREMENT B_helsu "Diagnose Heizerkopplung LSU erfolgt" UBYTE B_TRUE 1 100 0 1 BIT_MASK 0x2 FORMAT "%13.11" ECU_ADDRESS 0x403B75 /end MEASUREMENT
/begin MEASUREMENT B_helsu2 "Diagnose Heizerkopplung LSU2 erfolgt" UBYTE B_TRUE 1 100 0 1 BIT_MASK 0x10 FORMAT "%13.11" ECU_ADDRESS 0x403B75 /end MEASUREMENT
/begin MEASUREMENT B_hfm "Bedingung HFM messbereit" UBYTE B_TRUE 1 100 0 1 BIT_MASK 0x1 FORMAT "%13.11" ECU_ADDRESS 0x3FC073 /end MEASUREMENT
/begin MEASUREMENT B_hrlsunp "Bedingung Heizungsreglung nicht plausibel" UBYTE B_TRUE 1 100 0 1 BIT_MASK 0x10 FORMAT "%13.11" ECU_ADDRESS 0x403B79 /end MEASUREMENT
/begin MEASUREMENT B_hrlsunp2 "Bedingung Heizungsreglung nicht plausibel, Bank 2" UBYTE B_TRUE 1 100 0 1 BIT_MASK 0x8 FORMAT "%13.11" ECU_ADDRESS 0x403B7A /end MEASUREMENT
/begin MEASUREMENT B_hsokh "Bedingung Sondenheizung OK hinter Kat" UBYTE B_TRUE 1 100 0 1 BIT_MASK 0x1 FORMAT "%13.11" ECU_ADDRESS 0x3FBFDF /end MEASUREMENT
/begin MEASUREMENT B_hsokh2 "Bedingung Sondenheizung 2 OK hinter Kat" UBYTE B_TRUE 1 100 0 1 BIT_MASK 0x1 FORMAT "%13.11" ECU_ADDRESS 0x3FBFE0 /end MEASUREMENT
/begin MEASUREMENT B_initmxmn "" UBYTE B_TRUE 1 100 0 1 BIT_MASK 0x1 FORMAT "%13.11" ECU_ADDRESS 0x3FC074 /end MEASUREMENT
/begin MEASUREMENT B_kl61 "Bedingung Klemme 61" UBYTE B_TRUE 1 100 0 1 FORMAT "%13.11" ECU_ADDRESS 0x4037FD /end MEASUREMENT
/begin MEASUREMENT B_kl61_2 "" UBYTE B_TRUE 1 100 0 1 FORMAT "%13.11" ECU_ADDRESS 0x4037FE /end MEASUREMENT
/begin MEASUREMENT B_kvbd "Bedingung Freigabe Verbrauchsdiagnose" UBYTE B_TRUE 1 100 0 1 BIT_MASK 0x80 FORMAT "%13.11" ECU_ADDRESS 0x403BB0 /end MEASUREMENT
/begin MEASUREMENT B_lowra1 "" UBYTE B_TRUE 1 100 0 1 BIT_MASK 0x1 FORMAT "%13.11" ECU_ADDRESS 0x3FE0B6 /end MEASUREMENT
/begin MEASUREMENT B_lsurfc "Bedingung: Resettiere Fehler Counter" UBYTE B_TRUE 1 100 0 1 BIT_MASK 0x2 FORMAT "%13.11" ECU_ADDRESS 0x403B74 /end MEASUREMENT
/begin MEASUREMENT B_mnbrems "Fehlertyp BREMS (Bremssschalter): Minimalwert unterschritten" UWORD B_TRUE 1 100 0 1 BIT_MASK 0x200 FORMAT "%13.11" ECU_ADDRESS 0x3FE3BE /end MEASUREMENT
/begin MEASUREMENT B_mnbwf "Fehlertyp min.: PWG Bewegung" UWORD B_TRUE 1 100 0 1 BIT_MASK 0x200 FORMAT "%13.11" ECU_ADDRESS 0x3FE3C0 /end MEASUREMENT
/begin MEASUREMENT B_mnddss "Bedingung: min-Fehler Differenzdrucksensor Saugrohr" UWORD B_TRUE 1 100 0 1 BIT_MASK 0x200 FORMAT "%13.11" ECU_ADDRESS 0x3FE3E2 /end MEASUREMENT
/begin MEASUREMENT B_mndgen "" UWORD B_TRUE 1 100 0 1 BIT_MASK 0x200 FORMAT "%13.11" ECU_ADDRESS 0x3FE3E4 /end MEASUREMENT
/begin MEASUREMENT B_mndgen2 "" UWORD B_TRUE 1 100 0 1 BIT_MASK 0x200 FORMAT "%13.11" ECU_ADDRESS 0x3FE3E6 /end MEASUREMENT
/begin MEASUREMENT B_mndgenb2 "" UWORD B_TRUE 1 100 0 1 BIT_MASK 0x200 FORMAT "%13.11" ECU_ADDRESS 0x3FE3E8 /end MEASUREMENT
/begin MEASUREMENT B_mndgenbs "" UWORD B_TRUE 1 100 0 1 BIT_MASK 0x200 FORMAT "%13.11" ECU_ADDRESS 0x3FE3EA /end MEASUREMENT
/begin MEASUREMENT B_mndibs1 "" UWORD B_TRUE 1 100 0 1 BIT_MASK 0x200 FORMAT "%13.11" ECU_ADDRESS 0x3FE3EE /end MEASUREMENT
/begin MEASUREMENT B_mndibs2 "" UWORD B_TRUE 1 100 0 1 BIT_MASK 0x200 FORMAT "%13.11" ECU_ADDRESS 0x3FE3F0 /end MEASUREMENT
/begin MEASUREMENT B_mndibs3 "" UWORD B_TRUE 1 100 0 1 BIT_MASK 0x200 FORMAT "%13.11" ECU_ADDRESS 0x3FE3F2 /end MEASUREMENT
/begin MEASUREMENT B_mndsu "Bedingung: min-Fehler Umgebungsdrucksensor" UWORD B_TRUE 1 100 0 1 BIT_MASK 0x200 FORMAT "%13.11" ECU_ADDRESS 0x3FE40A /end MEASUREMENT
/begin MEASUREMENT B_mndwa "Fehlertyp min.: Diebstahlwarnanlage" UWORD B_TRUE 1 100 0 1 BIT_MASK 0x200 FORMAT "%13.11" ECU_ADDRESS 0x3FE452 /end MEASUREMENT
/begin MEASUREMENT B_mndzku0 "Minfehler Z¸ndkreis¸berwachung" UWORD B_TRUE 1 100 0 1 BIT_MASK 0x200 FORMAT "%13.11" ECU_ADDRESS 0x3FE458 /end MEASUREMENT
/begin MEASUREMENT B_mndzku1 "Minfehler Z¸ndkreis¸berwachung" UWORD B_TRUE 1 100 0 1 BIT_MASK 0x200 FORMAT "%13.11" ECU_ADDRESS 0x3FE45A /end MEASUREMENT
/begin MEASUREMENT B_mndzku2 "Minfehler Z¸ndkreis¸berwachung" UWORD B_TRUE 1 100 0 1 BIT_MASK 0x200 FORMAT "%13.11" ECU_ADDRESS 0x3FE45C /end MEASUREMENT
/begin MEASUREMENT B_mndzku3 "Minfehler Z¸ndkreis¸berwachung" UWORD B_TRUE 1 100 0 1 BIT_MASK 0x200 FORMAT "%13.11" ECU_ADDRESS 0x3FE45E /end MEASUREMENT
/begin MEASUREMENT B_mndzku4 "Minfehler Z¸ndkreis¸berwachung" UWORD B_TRUE 1 100 0 1 BIT_MASK 0x200 FORMAT "%13.11" ECU_ADDRESS 0x3FE460 /end MEASUREMENT
/begin MEASUREMENT B_mndzku5 "Minfehler Z¸ndkreis¸berwachung" UWORD B_TRUE 1 100 0 1 BIT_MASK 0x200 FORMAT "%13.11" ECU_ADDRESS 0x3FE462 /end MEASUREMENT
/begin MEASUREMENT B_mndzku6 "Minfehler Z¸ndkreis¸berwachung" UWORD B_TRUE 1 100 0 1 BIT_MASK 0x200 FORMAT "%13.11" ECU_ADDRESS 0x3FE464 /end MEASUREMENT
/begin MEASUREMENT B_mndzku7 "Minfehler Z¸ndkreis¸berwachung" UWORD B_TRUE 1 100 0 1 BIT_MASK 0x200 FORMAT "%13.11" ECU_ADDRESS 0x3FE466 /end MEASUREMENT
/begin MEASUREMENT B_mnegfe "Bedingung: MIN-Fehler Eingangsgrˆﬂen F¸llungserfassung" UWORD B_TRUE 1 100 0 1 BIT_MASK 0x200 FORMAT "%13.11" ECU_ADDRESS 0x3FE468 /end MEASUREMENT
/begin MEASUREMENT B_mnfhsh "Kurzschluﬂ Heizung Lambdasonde hinter Kat nach Masse" UBYTE B_TRUE 1 100 0 1 BIT_MASK 0x2 FORMAT "%13.11" ECU_ADDRESS 0x402A42 /end MEASUREMENT
/begin MEASUREMENT B_mnfhsh2 "Kurzschluﬂ Heizung Lambdasonde2 hinter Kat nach Masse" UBYTE B_TRUE 1 100 0 1 BIT_MASK 0x2 FORMAT "%13.11" ECU_ADDRESS 0x402A43 /end MEASUREMENT
/begin MEASUREMENT B_mnfp1p "Fehlertyp min.: Fahrpedal 1. Poti" UWORD B_TRUE 1 100 0 1 BIT_MASK 0x200 FORMAT "%13.11" ECU_ADDRESS 0x3FE486 /end MEASUREMENT
/begin MEASUREMENT B_mnfp2p "Fehlertyp min.: Fahrpedal 2. Poti" UWORD B_TRUE 1 100 0 1 BIT_MASK 0x200 FORMAT "%13.11" ECU_ADDRESS 0x3FE488 /end MEASUREMENT
/begin MEASUREMENT B_mnfpp "Fehlertyp min.: Fahrpedal Potentiometer" UWORD B_TRUE 1 100 0 1 BIT_MASK 0x200 FORMAT "%13.11" ECU_ADDRESS 0x3FE48A /end MEASUREMENT
/begin MEASUREMENT B_mnhfm "Bedingung untere Plausibilit‰tsschwelle unterschritten" UBYTE B_TRUE 1 100 0 1 BIT_MASK 0x1 FORMAT "%13.11" ECU_ADDRESS 0x3FC075 /end MEASUREMENT
/begin MEASUREMENT B_mnlsvv "MIN-Fehler: Vertauschte Lambda-Sonden" UWORD B_TRUE 1 100 0 1 BIT_MASK 0x200 FORMAT "%13.11" ECU_ADDRESS 0x3FE4FE /end MEASUREMENT
/begin MEASUREMENT B_mnmdb "Fehlertyp min.: Momentan¸berwachung begrenzt dauerhaft" UWORD B_TRUE 1 100 0 1 BIT_MASK 0x200 FORMAT "%13.11" ECU_ADDRESS 0x3FE51A /end MEASUREMENT
/begin MEASUREMENT B_mnmfl "Fehlerart Minfehler: MFL-Signal weist Frequenzfehler auf" UWORD B_TRUE 1 100 0 1 BIT_MASK 0x200 FORMAT "%13.11" ECU_ADDRESS 0x3FE51C /end MEASUREMENT
/begin MEASUREMENT B_mnminhub "Minimalfehler, Fehler Minhubadaption" UWORD B_TRUE 1 100 0 1 BIT_MASK 0x200 FORMAT "%13.11" ECU_ADDRESS 0x3FE51E /end MEASUREMENT
/begin MEASUREMENT B_mnmtoel "Minimalwert unterschritten" UWORD B_TRUE 1 100 0 1 BIT_MASK 0x200 FORMAT "%13.11" ECU_ADDRESS 0x3FE522 /end MEASUREMENT
/begin MEASUREMENT B_mnnvrmon "Fehlerart: NVRAM-Backup Aktuali‰ts-‹berwachung (nicht verwendet)" UWORD B_TRUE 1 100 0 1 BIT_MASK 0x200 FORMAT "%13.11" ECU_ADDRESS 0x3FE528 /end MEASUREMENT
/begin MEASUREMENT B_mnoezs "Bedingung Niveaumessung fehlerhaft" UWORD B_TRUE 1 100 0 1 BIT_MASK 0x200 FORMAT "%13.11" ECU_ADDRESS 0x3FE52C /end MEASUREMENT
/begin MEASUREMENT B_mnpddss "min-Fehler Druck Differenzdrucksensor Saugrohr" UWORD B_TRUE 1 100 0 1 BIT_MASK 0x200 FORMAT "%13.11" ECU_ADDRESS 0x3FE52E /end MEASUREMENT
/begin MEASUREMENT B_mnta "Fehlertyp: Minimalwertunterschreitung Ansauglufttemperatur TANS" UWORD B_TRUE 1 100 0 1 BIT_MASK 0x200 FORMAT "%13.11" ECU_ADDRESS 0x3FE560 /end MEASUREMENT
/begin MEASUREMENT B_mntka "Fehlertyp: Minimalwertunterschreitung Temperatur K¸hlerausgang" UWORD B_TRUE 1 100 0 1 BIT_MASK 0x200 FORMAT "%13.11" ECU_ADDRESS 0x3FE56A /end MEASUREMENT
/begin MEASUREMENT B_mntm "Fehlertyp: Minimalwertunterschreitung Motortemperatur" UWORD B_TRUE 1 100 0 1 BIT_MASK 0x200 FORMAT "%13.11" ECU_ADDRESS 0x3FE56C /end MEASUREMENT
/begin MEASUREMENT B_mntum "Fehlertyp: Minimalwertunterschreitung Umgebungstemperatur" UWORD B_TRUE 1 100 0 1 BIT_MASK 0x200 FORMAT "%13.11" ECU_ADDRESS 0x3FE56E /end MEASUREMENT
/begin MEASUREMENT B_mnub "Fehlertyp: Minimalwertunterschreitung Batteriespannung (Bordnetz)" UWORD B_TRUE 1 100 0 1 BIT_MASK 0x200 FORMAT "%13.11" ECU_ADDRESS 0x3FE570 /end MEASUREMENT
/begin MEASUREMENT B_mnvvte "Fehlertype: Kurzschluﬂ nach Masse Endstufe VVT" UWORD B_TRUE 1 100 0 1 BIT_MASK 0x200 FORMAT "%13.11" ECU_ADDRESS 0x3FE58E /end MEASUREMENT
/begin MEASUREMENT B_mnwca "Fehlertyp min.: Wegfahrsperre Wechselcode-Ablage" UWORD B_TRUE 1 100 0 1 BIT_MASK 0x200 FORMAT "%13.11" ECU_ADDRESS 0x3FE590 /end MEASUREMENT
/begin MEASUREMENT B_mnwfs "Fehlertyp min.: Wegfahrsperre" UWORD B_TRUE 1 100 0 1 BIT_MASK 0x200 FORMAT "%13.11" ECU_ADDRESS 0x3FE592 /end MEASUREMENT
/begin MEASUREMENT B_mxbrems "Fehlertyp BREMS (Bremsschalter): Maximalwert ¸berschritten" UWORD B_TRUE 1 100 0 1 BIT_MASK 0x100 FORMAT "%13.11" ECU_ADDRESS 0x3FE3BE /end MEASUREMENT
/begin MEASUREMENT B_mxbwf "Fehlertyp max.: PWG Bewegung" UWORD B_TRUE 1 100 0 1 BIT_MASK 0x100 FORMAT "%13.11" ECU_ADDRESS 0x3FE3C0 /end MEASUREMENT
/begin MEASUREMENT B_mxddss "Bedingung: max-Fehler Differenzdrucksensor Saugrohr" UWORD B_TRUE 1 100 0 1 BIT_MASK 0x100 FORMAT "%13.11" ECU_ADDRESS 0x3FE3E2 /end MEASUREMENT
/begin MEASUREMENT B_mxdgen "" UWORD B_TRUE 1 100 0 1 BIT_MASK 0x100 FORMAT "%13.11" ECU_ADDRESS 0x3FE3E4 /end MEASUREMENT
/begin MEASUREMENT B_mxdgen2 "" UWORD B_TRUE 1 100 0 1 BIT_MASK 0x100 FORMAT "%13.11" ECU_ADDRESS 0x3FE3E6 /end MEASUREMENT
/begin MEASUREMENT B_mxdgenb2 "" UWORD B_TRUE 1 100 0 1 BIT_MASK 0x100 FORMAT "%13.11" ECU_ADDRESS 0x3FE3E8 /end MEASUREMENT
/begin MEASUREMENT B_mxdgenbs "" UWORD B_TRUE 1 100 0 1 BIT_MASK 0x100 FORMAT "%13.11" ECU_ADDRESS 0x3FE3EA /end MEASUREMENT
/begin MEASUREMENT B_mxdibs1 "" UWORD B_TRUE 1 100 0 1 BIT_MASK 0x100 FORMAT "%13.11" ECU_ADDRESS 0x3FE3EE /end MEASUREMENT
/begin MEASUREMENT B_mxdibs2 "" UWORD B_TRUE 1 100 0 1 BIT_MASK 0x100 FORMAT "%13.11" ECU_ADDRESS 0x3FE3F0 /end MEASUREMENT
/begin MEASUREMENT B_mxdibs3 "" UWORD B_TRUE 1 100 0 1 BIT_MASK 0x100 FORMAT "%13.11" ECU_ADDRESS 0x3FE3F2 /end MEASUREMENT
/begin MEASUREMENT B_mxdsu "Bedingung: max-Fehler Umgebungsdrucksensor" UWORD B_TRUE 1 100 0 1 BIT_MASK 0x100 FORMAT "%13.11" ECU_ADDRESS 0x3FE40A /end MEASUREMENT
/begin MEASUREMENT B_mxdwa "Fehlertyp max.: Diebstahlwarnanlage" UWORD B_TRUE 1 100 0 1 BIT_MASK 0x100 FORMAT "%13.11" ECU_ADDRESS 0x3FE452 /end MEASUREMENT
/begin MEASUREMENT B_mxdzku0 "Maxfehler Z¸ndkreis¸berwachung" UWORD B_TRUE 1 100 0 1 BIT_MASK 0x100 FORMAT "%13.11" ECU_ADDRESS 0x3FE458 /end MEASUREMENT
/begin MEASUREMENT B_mxdzku1 "Maxfehler Z¸ndkreis¸berwachung" UWORD B_TRUE 1 100 0 1 BIT_MASK 0x100 FORMAT "%13.11" ECU_ADDRESS 0x3FE45A /end MEASUREMENT
/begin MEASUREMENT B_mxdzku2 "Maxfehler Z¸ndkreis¸berwachung" UWORD B_TRUE 1 100 0 1 BIT_MASK 0x100 FORMAT "%13.11" ECU_ADDRESS 0x3FE45C /end MEASUREMENT
/begin MEASUREMENT B_mxdzku3 "Maxfehler Z¸ndkreis¸berwachung" UWORD B_TRUE 1 100 0 1 BIT_MASK 0x100 FORMAT "%13.11" ECU_ADDRESS 0x3FE45E /end MEASUREMENT
/begin MEASUREMENT B_mxdzku4 "Maxfehler Z¸ndkreis¸berwachung" UWORD B_TRUE 1 100 0 1 BIT_MASK 0x100 FORMAT "%13.11" ECU_ADDRESS 0x3FE460 /end MEASUREMENT
/begin MEASUREMENT B_mxdzku5 "Maxfehler Z¸ndkreis¸berwachung" UWORD B_TRUE 1 100 0 1 BIT_MASK 0x100 FORMAT "%13.11" ECU_ADDRESS 0x3FE462 /end MEASUREMENT
/begin MEASUREMENT B_mxdzku6 "Maxfehler Z¸ndkreis¸berwachung" UWORD B_TRUE 1 100 0 1 BIT_MASK 0x100 FORMAT "%13.11" ECU_ADDRESS 0x3FE464 /end MEASUREMENT
/begin MEASUREMENT B_mxdzku7 "Maxfehler Z¸ndkreis¸berwachung" UWORD B_TRUE 1 100 0 1 BIT_MASK 0x100 FORMAT "%13.11" ECU_ADDRESS 0x3FE466 /end MEASUREMENT
/begin MEASUREMENT B_mxegfe "Bedingung: MAX-Fehler Eingangsgrˆﬂen F¸llungserfassung" UWORD B_TRUE 1 100 0 1 BIT_MASK 0x100 FORMAT "%13.11" ECU_ADDRESS 0x3FE468 /end MEASUREMENT
/begin MEASUREMENT B_mxfhsh "Kurzschluﬂ Heizung Lambdasonde hinter Kat nach UB" UBYTE B_TRUE 1 100 0 1 BIT_MASK 0x1 FORMAT "%13.11" ECU_ADDRESS 0x402A42 /end MEASUREMENT
/begin MEASUREMENT B_mxfhsh2 "Kurzschluﬂ Heizung Lambdasonde2 hinter Kat nach UB" UBYTE B_TRUE 1 100 0 1 BIT_MASK 0x1 FORMAT "%13.11" ECU_ADDRESS 0x402A43 /end MEASUREMENT
/begin MEASUREMENT B_mxfp1p "Fehlertyp max.: Fahrpedal 1. Poti" UWORD B_TRUE 1 100 0 1 BIT_MASK 0x100 FORMAT "%13.11" ECU_ADDRESS 0x3FE486 /end MEASUREMENT
/begin MEASUREMENT B_mxfp2p "Fehlertyp max.: Fahrpedal 2. Poti" UWORD B_TRUE 1 100 0 1 BIT_MASK 0x100 FORMAT "%13.11" ECU_ADDRESS 0x3FE488 /end MEASUREMENT
/begin MEASUREMENT B_mxfpp "Fehlertyp max.: Fahrpedal Potentiometer" UWORD B_TRUE 1 100 0 1 BIT_MASK 0x100 FORMAT "%13.11" ECU_ADDRESS 0x3FE48A /end MEASUREMENT
/begin MEASUREMENT B_mxhfm "Bedingung obere Plausibilit‰tsschwelle HFM ¸berschritten" UBYTE B_TRUE 1 100 0 1 BIT_MASK 0x1 FORMAT "%13.11" ECU_ADDRESS 0x3FC076 /end MEASUREMENT
/begin MEASUREMENT B_mxlsvv "MAX-Fehler: Vertauschte Lambda-Sonden" UWORD B_TRUE 1 100 0 1 BIT_MASK 0x100 FORMAT "%13.11" ECU_ADDRESS 0x3FE4FE /end MEASUREMENT
/begin MEASUREMENT B_mxmdb "Fehlerart: Maximal zul‰ssiges Sollmoment wird dauerhaft ¸berschritten" UWORD B_TRUE 1 100 0 1 BIT_MASK 0x100 FORMAT "%13.11" ECU_ADDRESS 0x3FE51A /end MEASUREMENT
/begin MEASUREMENT B_mxmfl "Fehlerart Maxfehler: MFL-Signal weist Toggelbitfehler auf" UWORD B_TRUE 1 100 0 1 BIT_MASK 0x100 FORMAT "%13.11" ECU_ADDRESS 0x3FE51C /end MEASUREMENT
/begin MEASUREMENT B_mxminhub "Maximalfehler, Fehler Minhubadaption" UWORD B_TRUE 1 100 0 1 BIT_MASK 0x100 FORMAT "%13.11" ECU_ADDRESS 0x3FE51E /end MEASUREMENT
/begin MEASUREMENT B_mxmtoel "Maximalwert ueberschritten" UWORD B_TRUE 1 100 0 1 BIT_MASK 0x100 FORMAT "%13.11" ECU_ADDRESS 0x3FE522 /end MEASUREMENT
/begin MEASUREMENT B_mxnvrmon "Fehlerart: NVRAM-Backup Aktuali‰ts-‹berwachung (nicht verwendet)" UWORD B_TRUE 1 100 0 1 BIT_MASK 0x100 FORMAT "%13.11" ECU_ADDRESS 0x3FE528 /end MEASUREMENT
/begin MEASUREMENT B_mxoezs "Bedingung Temperaturmessung fehlerhaft" UWORD B_TRUE 1 100 0 1 BIT_MASK 0x100 FORMAT "%13.11" ECU_ADDRESS 0x3FE52C /end MEASUREMENT
/begin MEASUREMENT B_mxpddss "Bedingung: max-Fehler Druck Differenzdrucksensor Saugrohr" UWORD B_TRUE 1 100 0 1 BIT_MASK 0x100 FORMAT "%13.11" ECU_ADDRESS 0x3FE52E /end MEASUREMENT
/begin MEASUREMENT B_mxta "Fehlertyp: Maximalwert¸berschreitung Ansauglufttemperatur TANS" UWORD B_TRUE 1 100 0 1 BIT_MASK 0x100 FORMAT "%13.11" ECU_ADDRESS 0x3FE560 /end MEASUREMENT
/begin MEASUREMENT B_mxtka "Fehlertyp: Maximalwert¸berschreitung Temperatur K¸hlerausgang" UWORD B_TRUE 1 100 0 1 BIT_MASK 0x100 FORMAT "%13.11" ECU_ADDRESS 0x3FE56A /end MEASUREMENT
/begin MEASUREMENT B_mxtm "Fehlertyp: Maximalwert¸berschreitung Motortemperatur" UWORD B_TRUE 1 100 0 1 BIT_MASK 0x100 FORMAT "%13.11" ECU_ADDRESS 0x3FE56C /end MEASUREMENT
/begin MEASUREMENT B_mxtum "Fehlertyp: Maximalwert¸berschreitung Umgebungstemperatur" UWORD B_TRUE 1 100 0 1 BIT_MASK 0x100 FORMAT "%13.11" ECU_ADDRESS 0x3FE56E /end MEASUREMENT
/begin MEASUREMENT B_mxub "Fehlertyp: Maximalwert¸berschreitung Batteriespannung (Bordnetz)" UWORD B_TRUE 1 100 0 1 BIT_MASK 0x100 FORMAT "%13.11" ECU_ADDRESS 0x3FE570 /end MEASUREMENT
/begin MEASUREMENT B_mxvvte "Fehlertype: Kurzschluﬂ nach Ubatt Endstufe VVT" UWORD B_TRUE 1 100 0 1 BIT_MASK 0x100 FORMAT "%13.11" ECU_ADDRESS 0x3FE58E /end MEASUREMENT
/begin MEASUREMENT B_mxwca "Fehlertyp max.: Wegfahrsperre Wechselcode-Ablage" UWORD B_TRUE 1 100 0 1 BIT_MASK 0x100 FORMAT "%13.11" ECU_ADDRESS 0x3FE590 /end MEASUREMENT
/begin MEASUREMENT B_mxwfs "Fehlertyp max.: Wegfahrsperre" UWORD B_TRUE 1 100 0 1 BIT_MASK 0x100 FORMAT "%13.11" ECU_ADDRESS 0x3FE592 /end MEASUREMENT
/begin MEASUREMENT B_npbrems "Fehlertyp BREMS (Bremsschalter): Pr¸fresultat nicht plausibel" UWORD B_TRUE 1 100 0 1 BIT_MASK 0x800 FORMAT "%13.11" ECU_ADDRESS 0x3FE3BE /end MEASUREMENT
/begin MEASUREMENT B_npbwf "Fehlertyp unplaus.: PWG Bewegung" UWORD B_TRUE 1 100 0 1 BIT_MASK 0x800 FORMAT "%13.11" ECU_ADDRESS 0x3FE3C0 /end MEASUREMENT
/begin MEASUREMENT B_npddss "Bedingung DDSS ist unplausibel" UWORD B_TRUE 1 100 0 1 BIT_MASK 0x800 FORMAT "%13.11" ECU_ADDRESS 0x3FE3E2 /end MEASUREMENT
/begin MEASUREMENT B_npdgen "" UWORD B_TRUE 1 100 0 1 BIT_MASK 0x800 FORMAT "%13.11" ECU_ADDRESS 0x3FE3E4 /end MEASUREMENT
/begin MEASUREMENT B_npdgen2 "" UWORD B_TRUE 1 100 0 1 BIT_MASK 0x800 FORMAT "%13.11" ECU_ADDRESS 0x3FE3E6 /end MEASUREMENT
/begin MEASUREMENT B_npdgenb2 "" UWORD B_TRUE 1 100 0 1 BIT_MASK 0x800 FORMAT "%13.11" ECU_ADDRESS 0x3FE3E8 /end MEASUREMENT
/begin MEASUREMENT B_npdgenbs "" UWORD B_TRUE 1 100 0 1 BIT_MASK 0x800 FORMAT "%13.11" ECU_ADDRESS 0x3FE3EA /end MEASUREMENT
/begin MEASUREMENT B_npdibs1 "" UWORD B_TRUE 1 100 0 1 BIT_MASK 0x800 FORMAT "%13.11" ECU_ADDRESS 0x3FE3EE /end MEASUREMENT
/begin MEASUREMENT B_npdibs2 "" UWORD B_TRUE 1 100 0 1 BIT_MASK 0x800 FORMAT "%13.11" ECU_ADDRESS 0x3FE3F0 /end MEASUREMENT
/begin MEASUREMENT B_npdibs3 "" UWORD B_TRUE 1 100 0 1 BIT_MASK 0x800 FORMAT "%13.11" ECU_ADDRESS 0x3FE3F2 /end MEASUREMENT
/begin MEASUREMENT B_npdsu "Bedingung: Umgebungsdrucksensor nicht plausibel" UWORD B_TRUE 1 100 0 1 BIT_MASK 0x800 FORMAT "%13.11" ECU_ADDRESS 0x3FE40A /end MEASUREMENT
/begin MEASUREMENT B_npdwa "Fehlertyp unplausibel: Diebstahlwarnanlage" UWORD B_TRUE 1 100 0 1 BIT_MASK 0x800 FORMAT "%13.11" ECU_ADDRESS 0x3FE452 /end MEASUREMENT
/begin MEASUREMENT B_npdzku0 "Fehler  nicht plausibles Signal Z¸ndkreis¸berwachung" UWORD B_TRUE 1 100 0 1 BIT_MASK 0x800 FORMAT "%13.11" ECU_ADDRESS 0x3FE458 /end MEASUREMENT
/begin MEASUREMENT B_npdzku1 "Fehler  nicht plausibles Signal Z¸ndkreis¸berwachung" UWORD B_TRUE 1 100 0 1 BIT_MASK 0x800 FORMAT "%13.11" ECU_ADDRESS 0x3FE45A /end MEASUREMENT
/begin MEASUREMENT B_npdzku2 "Fehler  nicht plausibles Signal Z¸ndkreis¸berwachung" UWORD B_TRUE 1 100 0 1 BIT_MASK 0x800 FORMAT "%13.11" ECU_ADDRESS 0x3FE45C /end MEASUREMENT
/begin MEASUREMENT B_npdzku3 "Fehler  nicht plausibles Signal Z¸ndkreis¸berwachung" UWORD B_TRUE 1 100 0 1 BIT_MASK 0x800 FORMAT "%13.11" ECU_ADDRESS 0x3FE45E /end MEASUREMENT
/begin MEASUREMENT B_npdzku4 "Fehler  nicht plausibles Signal Z¸ndkreis¸berwachung" UWORD B_TRUE 1 100 0 1 BIT_MASK 0x800 FORMAT "%13.11" ECU_ADDRESS 0x3FE460 /end MEASUREMENT
/begin MEASUREMENT B_npdzku5 "Fehler  nicht plausibles Signal Z¸ndkreis¸berwachung" UWORD B_TRUE 1 100 0 1 BIT_MASK 0x800 FORMAT "%13.11" ECU_ADDRESS 0x3FE462 /end MEASUREMENT
/begin MEASUREMENT B_npdzku6 "Fehler  nicht plausibles Signal Z¸ndkreis¸berwachung" UWORD B_TRUE 1 100 0 1 BIT_MASK 0x800 FORMAT "%13.11" ECU_ADDRESS 0x3FE464 /end MEASUREMENT
/begin MEASUREMENT B_npdzku7 "Fehler  nicht plausibles Signal Z¸ndkreis¸berwachung" UWORD B_TRUE 1 100 0 1 BIT_MASK 0x800 FORMAT "%13.11" ECU_ADDRESS 0x3FE466 /end MEASUREMENT
/begin MEASUREMENT B_npegfe "Bedingung: unplausibler Wert bei den Eingangsgrˆﬂen der F¸llungserfassung" UWORD B_TRUE 1 100 0 1 BIT_MASK 0x800 FORMAT "%13.11" ECU_ADDRESS 0x3FE468 /end MEASUREMENT
/begin MEASUREMENT B_npfhsh "Nernstwiderstand Sonde hinter Kat zu groﬂ" UBYTE B_TRUE 1 100 0 1 BIT_MASK 0x8 FORMAT "%13.11" ECU_ADDRESS 0x402A42 /end MEASUREMENT
/begin MEASUREMENT B_npfhsh2 "Nernstwiderstand Sonde 2 hinter Kat zu groﬂ" UBYTE B_TRUE 1 100 0 1 BIT_MASK 0x8 FORMAT "%13.11" ECU_ADDRESS 0x402A43 /end MEASUREMENT
/begin MEASUREMENT B_npfp1p "Fehlertyp unplaus.: Fahrpedal 1. Poti" UWORD B_TRUE 1 100 0 1 BIT_MASK 0x800 FORMAT "%13.11" ECU_ADDRESS 0x3FE486 /end MEASUREMENT
/begin MEASUREMENT B_npfp2p "Fehlertyp unplaus.: Fahrpedal 2. Poti" UWORD B_TRUE 1 100 0 1 BIT_MASK 0x800 FORMAT "%13.11" ECU_ADDRESS 0x3FE488 /end MEASUREMENT
/begin MEASUREMENT B_npfpp "Bedingung unplausible Potisignale vom Fahrpedal" UWORD B_TRUE 1 100 0 1 BIT_MASK 0x800 FORMAT "%13.11" ECU_ADDRESS 0x3FE48A /end MEASUREMENT
/begin MEASUREMENT B_nplsvv "Plausibilit‰ts-Fehler: Vertauschte Lambda-Sonden" UWORD B_TRUE 1 100 0 1 BIT_MASK 0x800 FORMAT "%13.11" ECU_ADDRESS 0x3FE4FE /end MEASUREMENT
/begin MEASUREMENT B_npmdb "Nicht plausibler Fehler: Momentan¸berwachung begrenzt dauerhaft" UWORD B_TRUE 1 100 0 1 BIT_MASK 0x800 FORMAT "%13.11" ECU_ADDRESS 0x3FE51A /end MEASUREMENT
/begin MEASUREMENT B_npmfl "Fehlerart NP: MFL-Signal nicht plausibel" UWORD B_TRUE 1 100 0 1 BIT_MASK 0x800 FORMAT "%13.11" ECU_ADDRESS 0x3FE51C /end MEASUREMENT
/begin MEASUREMENT B_npminhub "Nicht-Plausibel Fehler, Fehler Minhubadaption" UWORD B_TRUE 1 100 0 1 BIT_MASK 0x800 FORMAT "%13.11" ECU_ADDRESS 0x3FE51E /end MEASUREMENT
/begin MEASUREMENT B_npmtoel "Pruefresultat nicht plausibel" UWORD B_TRUE 1 100 0 1 BIT_MASK 0x800 FORMAT "%13.11" ECU_ADDRESS 0x3FE522 /end MEASUREMENT
/begin MEASUREMENT B_npnvrmon "Fehlerart NVRAM-Backup nicht aktuell" UWORD B_TRUE 1 100 0 1 BIT_MASK 0x800 FORMAT "%13.11" ECU_ADDRESS 0x3FE528 /end MEASUREMENT
/begin MEASUREMENT B_npoezs "Bedingung Permittivit‰tsmessung fehlerhaft" UWORD B_TRUE 1 100 0 1 BIT_MASK 0x800 FORMAT "%13.11" ECU_ADDRESS 0x3FE52C /end MEASUREMENT
/begin MEASUREMENT B_nppddss "Bedingung PDDSS ist unplausibel" UWORD B_TRUE 1 100 0 1 BIT_MASK 0x800 FORMAT "%13.11" ECU_ADDRESS 0x3FE52E /end MEASUREMENT
/begin MEASUREMENT B_npta "Fehlertyp unplaus.: Ansauglufttemperatur TANS (-Ladeluft)" UWORD B_TRUE 1 100 0 1 BIT_MASK 0x800 FORMAT "%13.11" ECU_ADDRESS 0x3FE560 /end MEASUREMENT
/begin MEASUREMENT B_nptka "Plausfehler TKA-Sensor" UWORD B_TRUE 1 100 0 1 BIT_MASK 0x800 FORMAT "%13.11" ECU_ADDRESS 0x3FE56A /end MEASUREMENT
/begin MEASUREMENT B_nptm "Fehlerart: Motortemperatursignal nicht plausibel gg¸. Modell" UWORD B_TRUE 1 100 0 1 BIT_MASK 0x800 FORMAT "%13.11" ECU_ADDRESS 0x3FE56C /end MEASUREMENT
/begin MEASUREMENT B_nptum "Fehlerart: Signal Umgebungstemperatur unplausibel" UWORD B_TRUE 1 100 0 1 BIT_MASK 0x800 FORMAT "%13.11" ECU_ADDRESS 0x3FE56E /end MEASUREMENT
/begin MEASUREMENT B_npub "Fehlerart: Batteriespannungssignal nicht plausibel" UWORD B_TRUE 1 100 0 1 BIT_MASK 0x800 FORMAT "%13.11" ECU_ADDRESS 0x3FE570 /end MEASUREMENT
/begin MEASUREMENT B_npvvte "Fehlertyp unplaus.: VVT" UWORD B_TRUE 1 100 0 1 BIT_MASK 0x800 FORMAT "%13.11" ECU_ADDRESS 0x3FE58E /end MEASUREMENT
/begin MEASUREMENT B_npwca "Fehlertyp unplausibel: Wegfahrsperre Wechselcode-Ablage" UWORD B_TRUE 1 100 0 1 BIT_MASK 0x800 FORMAT "%13.11" ECU_ADDRESS 0x3FE590 /end MEASUREMENT
/begin MEASUREMENT B_npwfs "Fehlerart: Wegfahrsperre" UWORD B_TRUE 1 100 0 1 BIT_MASK 0x800 FORMAT "%13.11" ECU_ADDRESS 0x3FE592 /end MEASUREMENT
/begin MEASUREMENT B_ps421det "Bedingung: Aktuator an CJ94x Endstufe 4.21 erkannt (GLF oder ODS)" UBYTE B_TRUE 1 100 0 1 BIT_MASK 0x1 FORMAT "%13.11" ECU_ADDRESS 0x3FE0BD /end MEASUREMENT
/begin MEASUREMENT B_ps421var "Bedingung Stellglied variante an Digitalendstufenausgang CJ94x Kanal 4.21 vorhan" UBYTE B_TRUE 1 100 0 1 BIT_MASK 0x2 FORMAT "%13.11" ECU_ADDRESS 0x3FE0BD /end MEASUREMENT
/begin MEASUREMENT B_ricalf "Bedingung Kalibrierwiderstand nicht im Sollband" UBYTE B_TRUE 1 100 0 1 BIT_MASK 0x4 FORMAT "%13.11" ECU_ADDRESS 0x403B78 /end MEASUREMENT
/begin MEASUREMENT B_ricalf2 "Bedingung Kalibrierwiderstand nicht im Sollband, Bank 2" UBYTE B_TRUE 1 100 0 1 BIT_MASK 0x8 FORMAT "%13.11" ECU_ADDRESS 0x403B78 /end MEASUREMENT
/begin MEASUREMENT B_rierrh "Ri- Fehler Lambdasonde hinter Kat" UBYTE B_TRUE 1 100 0 1 BIT_MASK 0x20 FORMAT "%13.11" ECU_ADDRESS 0x402A42 /end MEASUREMENT
/begin MEASUREMENT B_rierrh2 "Ri- Fehler Lambdasonde 2 hinter Kat" UBYTE B_TRUE 1 100 0 1 BIT_MASK 0x20 FORMAT "%13.11" ECU_ADDRESS 0x402A43 /end MEASUREMENT
/begin MEASUREMENT B_rinnp "Bedingung RI der LSU ist nicht plausibel" UBYTE B_TRUE 1 100 0 1 BIT_MASK 0x40 FORMAT "%13.11" ECU_ADDRESS 0x403B78 /end MEASUREMENT
/begin MEASUREMENT B_rinnp2 "Bedingung RI der LSU ist nicht plausibel, Bank 2" UBYTE B_TRUE 1 100 0 1 BIT_MASK 0x80 FORMAT "%13.11" ECU_ADDRESS 0x403B78 /end MEASUREMENT
/begin MEASUREMENT B_sfstres "Bedingung: Reset F|llstandsgeberplaus" UBYTE B_TRUE 1 100 0 1 BIT_MASK 0x80 FORMAT "%13.11" ECU_ADDRESS 0x403BB1 /end MEASUREMENT
/begin MEASUREMENT B_sibrems "Fehlertyp BREMS (Bremsschalter): Signal inaktiv" UWORD B_TRUE 1 100 0 1 BIT_MASK 0x400 FORMAT "%13.11" ECU_ADDRESS 0x3FE3BE /end MEASUREMENT
/begin MEASUREMENT B_sibwf "Fehlertyp sig.: PWG Bewegung" UWORD B_TRUE 1 100 0 1 BIT_MASK 0x400 FORMAT "%13.11" ECU_ADDRESS 0x3FE3C0 /end MEASUREMENT
/begin MEASUREMENT B_siddss "Fehlertyp íSignal fehltí for DDSS erkannt" UWORD B_TRUE 1 100 0 1 BIT_MASK 0x400 FORMAT "%13.11" ECU_ADDRESS 0x3FE3E2 /end MEASUREMENT
/begin MEASUREMENT B_sidgen "" UWORD B_TRUE 1 100 0 1 BIT_MASK 0x400 FORMAT "%13.11" ECU_ADDRESS 0x3FE3E4 /end MEASUREMENT
/begin MEASUREMENT B_sidgen2 "" UWORD B_TRUE 1 100 0 1 BIT_MASK 0x400 FORMAT "%13.11" ECU_ADDRESS 0x3FE3E6 /end MEASUREMENT
/begin MEASUREMENT B_sidgenb2 "" UWORD B_TRUE 1 100 0 1 BIT_MASK 0x400 FORMAT "%13.11" ECU_ADDRESS 0x3FE3E8 /end MEASUREMENT
/begin MEASUREMENT B_sidgenbs "" UWORD B_TRUE 1 100 0 1 BIT_MASK 0x400 FORMAT "%13.11" ECU_ADDRESS 0x3FE3EA /end MEASUREMENT
/begin MEASUREMENT B_sidibs1 "" UWORD B_TRUE 1 100 0 1 BIT_MASK 0x400 FORMAT "%13.11" ECU_ADDRESS 0x3FE3EE /end MEASUREMENT
/begin MEASUREMENT B_sidibs2 "" UWORD B_TRUE 1 100 0 1 BIT_MASK 0x400 FORMAT "%13.11" ECU_ADDRESS 0x3FE3F0 /end MEASUREMENT
/begin MEASUREMENT B_sidibs3 "" UWORD B_TRUE 1 100 0 1 BIT_MASK 0x400 FORMAT "%13.11" ECU_ADDRESS 0x3FE3F2 /end MEASUREMENT
/begin MEASUREMENT B_sidsu "Fehlerart: Umgebungsdrucksensor" UWORD B_TRUE 1 100 0 1 BIT_MASK 0x400 FORMAT "%13.11" ECU_ADDRESS 0x3FE40A /end MEASUREMENT
/begin MEASUREMENT B_sidwa "Fehlertyp Signal: Diebstahlwarnanlage" UWORD B_TRUE 1 100 0 1 BIT_MASK 0x400 FORMAT "%13.11" ECU_ADDRESS 0x3FE452 /end MEASUREMENT
/begin MEASUREMENT B_sidzku0 "Signalabfall Z¸ndkreis¸berwachung" UWORD B_TRUE 1 100 0 1 BIT_MASK 0x400 FORMAT "%13.11" ECU_ADDRESS 0x3FE458 /end MEASUREMENT
/begin MEASUREMENT B_sidzku1 "Signalabfall Z¸ndkreis¸berwachung" UWORD B_TRUE 1 100 0 1 BIT_MASK 0x400 FORMAT "%13.11" ECU_ADDRESS 0x3FE45A /end MEASUREMENT
/begin MEASUREMENT B_sidzku2 "Signalabfall Z¸ndkreis¸berwachung" UWORD B_TRUE 1 100 0 1 BIT_MASK 0x400 FORMAT "%13.11" ECU_ADDRESS 0x3FE45C /end MEASUREMENT
/begin MEASUREMENT B_sidzku3 "Signalabfall Z¸ndkreis¸berwachung" UWORD B_TRUE 1 100 0 1 BIT_MASK 0x400 FORMAT "%13.11" ECU_ADDRESS 0x3FE45E /end MEASUREMENT
/begin MEASUREMENT B_sidzku4 "Signalabfall Z¸ndkreis¸berwachung" UWORD B_TRUE 1 100 0 1 BIT_MASK 0x400 FORMAT "%13.11" ECU_ADDRESS 0x3FE460 /end MEASUREMENT
/begin MEASUREMENT B_sidzku5 "Signalabfall Z¸ndkreis¸berwachung" UWORD B_TRUE 1 100 0 1 BIT_MASK 0x400 FORMAT "%13.11" ECU_ADDRESS 0x3FE462 /end MEASUREMENT
/begin MEASUREMENT B_sidzku6 "Signalabfall Z¸ndkreis¸berwachung" UWORD B_TRUE 1 100 0 1 BIT_MASK 0x400 FORMAT "%13.11" ECU_ADDRESS 0x3FE464 /end MEASUREMENT
/begin MEASUREMENT B_sidzku7 "Signalfehler Z¸ndkreis¸berwachung" UWORD B_TRUE 1 100 0 1 BIT_MASK 0x400 FORMAT "%13.11" ECU_ADDRESS 0x3FE466 /end MEASUREMENT
/begin MEASUREMENT B_siegfe "Bedingung: Signal Fehler bei den Eingangsgrˆﬂen der F¸llungserfassung" UWORD B_TRUE 1 100 0 1 BIT_MASK 0x400 FORMAT "%13.11" ECU_ADDRESS 0x3FE468 /end MEASUREMENT
/begin MEASUREMENT B_sifhsh "Lastabfall Sondenheizung hinter Kat" UBYTE B_TRUE 1 100 0 1 BIT_MASK 0x4 FORMAT "%13.11" ECU_ADDRESS 0x402A42 /end MEASUREMENT
/begin MEASUREMENT B_sifhsh2 "Lastabfall Sondenheizung2 hinter Kat" UBYTE B_TRUE 1 100 0 1 BIT_MASK 0x4 FORMAT "%13.11" ECU_ADDRESS 0x402A43 /end MEASUREMENT
/begin MEASUREMENT B_sifp1p "Fehlerart: Fahrpedal 1.Potentiometer" UWORD B_TRUE 1 100 0 1 BIT_MASK 0x400 FORMAT "%13.11" ECU_ADDRESS 0x3FE486 /end MEASUREMENT
/begin MEASUREMENT B_sifp2p "Fehlerart: Fahrpedal 2.Potentiometer" UWORD B_TRUE 1 100 0 1 BIT_MASK 0x400 FORMAT "%13.11" ECU_ADDRESS 0x3FE488 /end MEASUREMENT
/begin MEASUREMENT B_sifpp "Fehlerart: Fahrpedal Potentiometer" UWORD B_TRUE 1 100 0 1 BIT_MASK 0x400 FORMAT "%13.11" ECU_ADDRESS 0x3FE48A /end MEASUREMENT
/begin MEASUREMENT B_sigflsu "‹bersprechen vom Heizertakt auf Lambdasignal" UBYTE B_TRUE 1 100 0 1 BIT_MASK 0x1 FORMAT "%13.11" ECU_ADDRESS 0x403B75 /end MEASUREMENT
/begin MEASUREMENT B_sigflsu2 "‹bersprechen vom Heizertakt auf Lambdasignal, Bank2" UBYTE B_TRUE 1 100 0 1 BIT_MASK 0x8 FORMAT "%13.11" ECU_ADDRESS 0x403B75 /end MEASUREMENT
/begin MEASUREMENT B_silsvv "Signal-Fehler: Vertauschte Lambda-Sonden" UWORD B_TRUE 1 100 0 1 BIT_MASK 0x400 FORMAT "%13.11" ECU_ADDRESS 0x3FE4FE /end MEASUREMENT
/begin MEASUREMENT B_simdb "Fehlertyp: Momentan¸berwachung begrenzt dauerhaft" UWORD B_TRUE 1 100 0 1 BIT_MASK 0x400 FORMAT "%13.11" ECU_ADDRESS 0x3FE51A /end MEASUREMENT
/begin MEASUREMENT B_simfl "Signalfehler Multifunktionslenkrad" UWORD B_TRUE 1 100 0 1 BIT_MASK 0x400 FORMAT "%13.11" ECU_ADDRESS 0x3FE51C /end MEASUREMENT
/begin MEASUREMENT B_siminhub "Signalfehler, Fehler Minhubadaption" UWORD B_TRUE 1 100 0 1 BIT_MASK 0x400 FORMAT "%13.11" ECU_ADDRESS 0x3FE51E /end MEASUREMENT
/begin MEASUREMENT B_simtoel "Signal inaktiv" UWORD B_TRUE 1 100 0 1 BIT_MASK 0x400 FORMAT "%13.11" ECU_ADDRESS 0x3FE522 /end MEASUREMENT
/begin MEASUREMENT B_sinvrmon "Fehlertyp NVRAM-Backup Akt.-‹berwachung  (nicht verwendet)" UWORD B_TRUE 1 100 0 1 BIT_MASK 0x400 FORMAT "%13.11" ECU_ADDRESS 0x3FE528 /end MEASUREMENT
/begin MEASUREMENT B_sioezs "Bedingung Kommunikationsfehler ÷lsensor" UWORD B_TRUE 1 100 0 1 BIT_MASK 0x400 FORMAT "%13.11" ECU_ADDRESS 0x3FE52C /end MEASUREMENT
/begin MEASUREMENT B_sipddss "Fehlertyp íSignal fehltí for PDDSS erkannt" UWORD B_TRUE 1 100 0 1 BIT_MASK 0x400 FORMAT "%13.11" ECU_ADDRESS 0x3FE52E /end MEASUREMENT
/begin MEASUREMENT B_sita "Fehlertyp: Ansauglufttemperatur TANS (-Ladeluft)" UWORD B_TRUE 1 100 0 1 BIT_MASK 0x400 FORMAT "%13.11" ECU_ADDRESS 0x3FE560 /end MEASUREMENT
/begin MEASUREMENT B_sitka "Signalfehler TKA-Sensor" UWORD B_TRUE 1 100 0 1 BIT_MASK 0x400 FORMAT "%13.11" ECU_ADDRESS 0x3FE56A /end MEASUREMENT
/begin MEASUREMENT B_sitm "Fehlerart: Motortemperaturschwelle f¸r Lambdaregelungsfreigabe nicht erreicht" UWORD B_TRUE 1 100 0 1 BIT_MASK 0x400 FORMAT "%13.11" ECU_ADDRESS 0x3FE56C /end MEASUREMENT
/begin MEASUREMENT B_situm "Fehlerart: Signal Umgebungstemperatur inaktiv" UWORD B_TRUE 1 100 0 1 BIT_MASK 0x400 FORMAT "%13.11" ECU_ADDRESS 0x3FE56E /end MEASUREMENT
/begin MEASUREMENT B_siub "Fehlertyp: Umweltbedingungen" UWORD B_TRUE 1 100 0 1 BIT_MASK 0x400 FORMAT "%13.11" ECU_ADDRESS 0x3FE570 /end MEASUREMENT
/begin MEASUREMENT B_sivvte "Fehlertype: Leitungsabfall Endstufe VVT" UWORD B_TRUE 1 100 0 1 BIT_MASK 0x400 FORMAT "%13.11" ECU_ADDRESS 0x3FE58E /end MEASUREMENT
/begin MEASUREMENT B_siwca "Fehlertyp Signal: Wegfahrsperre Wechselcode-Ablage" UWORD B_TRUE 1 100 0 1 BIT_MASK 0x400 FORMAT "%13.11" ECU_ADDRESS 0x3FE590 /end MEASUREMENT
/begin MEASUREMENT B_siwfs "Fehlerart: Wegfahrsperre" UWORD B_TRUE 1 100 0 1 BIT_MASK 0x400 FORMAT "%13.11" ECU_ADDRESS 0x3FE592 /end MEASUREMENT
/begin MEASUREMENT B_spdhrub "Bedingung Sperrung Diagnose DHRLSU wegen Spannungsversorgung" UBYTE B_TRUE 1 100 0 1 BIT_MASK 0x8 FORMAT "%13.11" ECU_ADDRESS 0x403B79 /end MEASUREMENT
/begin MEASUREMENT B_tahrmn "Bedingung korregiertes Tastverh‰ltnis < Min-Schwelle f¸r l‰ngere Zeit" UBYTE B_TRUE 1 100 0 1 BIT_MASK 0x2 FORMAT "%13.11" ECU_ADDRESS 0x403B79 /end MEASUREMENT
/begin MEASUREMENT B_tahrmn2 "Bedingung korregiertes Tastverh‰ltnis < Min.-Schwelle f¸r l‰ngere Zeit, Bank 2" UBYTE B_TRUE 1 100 0 1 BIT_MASK 0x2 FORMAT "%13.11" ECU_ADDRESS 0x403B7A /end MEASUREMENT
/begin MEASUREMENT B_tahrmx "Bedingung korregiertes Tastverh‰ltnis =100% f¸r l‰ngere Zeit" UBYTE B_TRUE 1 100 0 1 BIT_MASK 0x4 FORMAT "%13.11" ECU_ADDRESS 0x403B79 /end MEASUREMENT
/begin MEASUREMENT B_tahrmx2 "Bedingung korregiertes Tastverh‰ltnis =100% f¸r l‰ngere Zeit, Bank 2" UBYTE B_TRUE 1 100 0 1 BIT_MASK 0x4 FORMAT "%13.11" ECU_ADDRESS 0x403B7A /end MEASUREMENT
/begin MEASUREMENT B_tank "Bedingung Tankvorgang" UBYTE B_TRUE 1 100 0 1 BIT_MASK 0x1 FORMAT "%13.11" ECU_ADDRESS 0x403BAF /end MEASUREMENT
/begin MEASUREMENT B_tankab "Bedingung Tankinhalt hat abgenommen" UBYTE B_TRUE 1 100 0 1 BIT_MASK 0x1 FORMAT "%13.11" ECU_ADDRESS 0x403BB1 /end MEASUREMENT
/begin MEASUREMENT B_tankdy "Bedingung Fuellstandsdynamik infolge Tankvorgang" UBYTE B_TRUE 1 100 0 1 BIT_MASK 0x2 FORMAT "%13.11" ECU_ADDRESS 0x403BB1 /end MEASUREMENT
/begin MEASUREMENT B_tankend "Bedingung Tankvorgang beendet" UBYTE B_TRUE 1 100 0 1 BIT_MASK 0x4 FORMAT "%13.11" ECU_ADDRESS 0x403BB1 /end MEASUREMENT
/begin MEASUREMENT B_tankg "Betankungsbit gueltig" UBYTE B_TRUE 1 100 0 1 BIT_MASK 0x4 FORMAT "%13.11" ECU_ADDRESS 0x403BAF /end MEASUREMENT
/begin MEASUREMENT B_tankzu "Bedingung Tankinhalt hat zugenommen" UBYTE B_TRUE 1 100 0 1 BIT_MASK 0x8 FORMAT "%13.11" ECU_ADDRESS 0x403BB1 /end MEASUREMENT
/begin MEASUREMENT B_zhhrlsu "Bedingung Heilung darf durchgef¸hrt werden" UBYTE B_TRUE 1 100 0 1 BIT_MASK 0x10 FORMAT "%13.11" ECU_ADDRESS 0x403B78 /end MEASUREMENT
/begin MEASUREMENT B_zhhrlsu2 "Bedingung Heilung darf durchgef¸hrt werden, Bank 2" UBYTE B_TRUE 1 100 0 1 BIT_MASK 0x20 FORMAT "%13.11" ECU_ADDRESS 0x403B78 /end MEASUREMENT
/begin MEASUREMENT B_zhrnot "Bed. ung¸nstige Umgebungsbedingungen sperren Startdiagnose" UBYTE B_TRUE 1 100 0 1 BIT_MASK 0x40 FORMAT "%13.11" ECU_ADDRESS 0x403B79 /end MEASUREMENT
/begin MEASUREMENT B_zhrnot2 "Bedingung verhindert Zyklus und Fehlereintrag,  Bank2" UBYTE B_TRUE 1 100 0 1 BIT_MASK 0x20 FORMAT "%13.11" ECU_ADDRESS 0x403B7A /end MEASUREMENT
/begin MEASUREMENT dfskv_w "Differenz verbrauchter Kraftstoff - Fuellstandsdifferenz" SWORD vol_q3p90625Em3_l 1 100 -128 127.996 FORMAT "%8.4" ECU_ADDRESS 0x402BD4 /end MEASUREMENT
/begin MEASUREMENT dfstigof_w "Differenz Fuellstand nach Start" SWORD vol_q0p1_l 1 100 -3276.8 3276.7 FORMAT "%8.3" ECU_ADDRESS 0x402BD6 /end MEASUREMENT
/begin MEASUREMENT dfstigo_w "Differenz Fuellstand bei Fahrzeughalt" SWORD vol_q0p1_l 1 100 -3276.8 3276.7 FORMAT "%8.3" ECU_ADDRESS 0x402BD8 /end MEASUREMENT
/begin MEASUREMENT DFSTTbits "" UBYTE dez 1 100 0 255 FORMAT "%5.1" ECU_ADDRESS 0x403BAF /end MEASUREMENT
/begin MEASUREMENT DFSTTBUFRAM "" UBYTE dez 1 100 0 255 FORMAT "%5.1" ECU_ADDRESS 0x3FE0B6 /end MEASUREMENT
/begin MEASUREMENT DFSTTlokbits "" UBYTE dez 1 100 0 255 FORMAT "%5.1" ECU_ADDRESS 0x403BB0 /end MEASUREMENT
/begin MEASUREMENT DFSTTlokbits2 "" UBYTE dez 1 100 0 255 FORMAT "%5.1" ECU_ADDRESS 0x403BB1 /end MEASUREMENT
/begin MEASUREMENT DFSTTlokbits3 "" UBYTE dez 1 100 0 255 FORMAT "%5.1" ECU_ADDRESS 0x403BB2 /end MEASUREMENT
/begin MEASUREMENT dfstt_w "Differenz Fuellstand Kraftstofftank" SWORD vol_q3p90625Em3_l 1 100 -128 127.996 FORMAT "%8.4" ECU_ADDRESS 0x402BDA /end MEASUREMENT
/begin MEASUREMENT dgbhealct2 "" UBYTE t100msxs_ub_b25p5 1 100 0 25.5 FORMAT "%5.2" ECU_ADDRESS 0x4031E8 /end MEASUREMENT
/begin MEASUREMENT dgbhealctr "" UBYTE t100msxs_ub_b25p5 1 100 0 25.5 FORMAT "%5.2" ECU_ADDRESS 0x4031D6 /end MEASUREMENT
/begin MEASUREMENT dgerrctr1 "" UBYTE t100msxs_ub_b25p5 1 100 0 25.5 FORMAT "%5.2" ECU_ADDRESS 0x4031D7 /end MEASUREMENT
/begin MEASUREMENT dgerrctr12 "" UBYTE t100msxs_ub_b25p5 1 100 0 25.5 FORMAT "%5.2" ECU_ADDRESS 0x4031E9 /end MEASUREMENT
/begin MEASUREMENT dgerrctr2 "" UBYTE t100msxs_ub_b25p5 1 100 0 25.5 FORMAT "%5.2" ECU_ADDRESS 0x4031D8 /end MEASUREMENT
/begin MEASUREMENT dgerrctr22 "" UBYTE t100msxs_ub_b25p5 1 100 0 25.5 FORMAT "%5.2" ECU_ADDRESS 0x4031EA /end MEASUREMENT
/begin MEASUREMENT dgerrctr3 "" UBYTE t100msxs_ub_b25p5 1 100 0 25.5 FORMAT "%5.2" ECU_ADDRESS 0x4031D9 /end MEASUREMENT
/begin MEASUREMENT dgerrctr32 "" UBYTE t100msxs_ub_b25p5 1 100 0 25.5 FORMAT "%5.2" ECU_ADDRESS 0x4031EB /end MEASUREMENT
/begin MEASUREMENT dgerrctr4 "" UBYTE t100msxs_ub_b25p5 1 100 0 25.5 FORMAT "%5.2" ECU_ADDRESS 0x4031DA /end MEASUREMENT
/begin MEASUREMENT dgerrctr42 "" UBYTE t100msxs_ub_b25p5 1 100 0 25.5 FORMAT "%5.2" ECU_ADDRESS 0x4031EC /end MEASUREMENT
/begin MEASUREMENT dgerrctr5 "" UBYTE t100msxs_ub_b25p5 1 100 0 25.5 FORMAT "%5.2" ECU_ADDRESS 0x4031DB /end MEASUREMENT
/begin MEASUREMENT dgerrctr52 "" UBYTE t100msxs_ub_b25p5 1 100 0 25.5 FORMAT "%5.2" ECU_ADDRESS 0x4031ED /end MEASUREMENT
/begin MEASUREMENT dghealctr "" UBYTE t100msxs_ub_b25p5 1 100 0 25.5 FORMAT "%5.2" ECU_ADDRESS 0x4031DC /end MEASUREMENT
/begin MEASUREMENT dghealctr2 "" UBYTE t100msxs_ub_b25p5 1 100 0 25.5 FORMAT "%5.2" ECU_ADDRESS 0x4031EE /end MEASUREMENT
/begin MEASUREMENT dglfeLokBitsNov100ms "" UBYTE dez 1 100 0 255 FORMAT "%5.1" ECU_ADDRESS 0x3FE0BD /end MEASUREMENT
/begin MEASUREMENT dhdmteAusNvBits "" UBYTE dez 1 100 0 255 FORMAT "%5.1" ECU_ADDRESS 0x3FE0BE /end MEASUREMENT
/begin MEASUREMENT dhfmmlo_w "Luftmassenstrom obere Toleranz" UWORD m_q0p1 1 100 0 6553.5 FORMAT "%8.3" ECU_ADDRESS 0x403F96 /end MEASUREMENT
/begin MEASUREMENT dhfmmlu_w "Luftmassenstrom untere Toleranz" UWORD m_q0p1 1 100 0 6553.5 FORMAT "%8.3" ECU_ADDRESS 0x403F98 /end MEASUREMENT
/begin MEASUREMENT dhfmrlvwo "rlvw-Offset bei Umschaltung gedrosselt - ungedrosselt" UWORD rel_uw_q0p0234 1 100 0 1535.98 FORMAT "%8.3" ECU_ADDRESS 0x403F9A /end MEASUREMENT
/begin MEASUREMENT DHRLSUausbits1 "" UBYTE dez 1 100 0 255 FORMAT "%5.1" ECU_ADDRESS 0x403B78 /end MEASUREMENT
/begin MEASUREMENT DHRLSUlokbits1 "" UBYTE dez 1 100 0 255 FORMAT "%5.1" ECU_ADDRESS 0x403B79 /end MEASUREMENT
/begin MEASUREMENT DHRLSUlokbits1_2 "" UBYTE dez 1 100 0 255 FORMAT "%5.1" ECU_ADDRESS 0x403B7A /end MEASUREMENT
/begin MEASUREMENT dkvbigo_w "Differenz Verbrauch bei Fahrzeughalt" UWORD vol_q3p90625Em3_l 1 100 0 255.996 FORMAT "%8.4" ECU_ADDRESS 0x402BDC /end MEASUREMENT
/begin MEASUREMENT dkvb_w "Differenz verbrauchter Kraftstoff" UWORD vol_q3p90625Em3_l 1 100 0 255.996 FORMAT "%8.4" ECU_ADDRESS 0x402BDE /end MEASUREMENT
/begin MEASUREMENT dpipdhfm_w "Ergebnis der Kennlinie KLDPIPOL" UWORD fak_uw_b2 1 100 0 1.99997 FORMAT "%8.6" ECU_ADDRESS 0x403F9C /end MEASUREMENT
/begin MEASUREMENT dpspmax_w "Eingang der Kennlinie KLDPIPOL" UWORD fak_uw_b2 1 100 0 1.99997 FORMAT "%8.6" ECU_ADDRESS 0x403F9E /end MEASUREMENT
/begin MEASUREMENT dulsuhe2_w "Spanungsgradient UULSUV f¸r Heizereinkopplung, Bank 2" UWORD spg_uw_b5 1 100 0 319.995 FORMAT "%8.4" ECU_ADDRESS 0x403EA8 /end MEASUREMENT
/begin MEASUREMENT dulsuhe_w "Spanungsgradient UULSUV f¸r Heizereinkopplung" UWORD spg_uw_b5 1 100 0 319.995 FORMAT "%8.4" ECU_ADDRESS 0x403EAA /end MEASUREMENT
/begin MEASUREMENT en_gendia2 "" UBYTE B_TRUE 1 100 0 1 FORMAT "%13.11" ECU_ADDRESS 0x4031E1 /end MEASUREMENT
/begin MEASUREMENT en_gendiag "Disgnose Freigabe Gen.Fehler" UBYTE B_TRUE 1 100 0 1 FORMAT "%13.11" ECU_ADDRESS 0x4031CF /end MEASUREMENT
/begin MEASUREMENT evhubimldm "" UWORD hub_uw_q0p001 1 100 0 65.535 FORMAT "%8.5" ECU_ADDRESS 0x403FA0 /end MEASUREMENT
/begin MEASUREMENT evhubimldn "" UWORD hub_uw_q0p001 1 100 0 65.535 FORMAT "%8.5" ECU_ADDRESS 0x403FA2 /end MEASUREMENT
/begin MEASUREMENT E_brems "Fehlerflag: BREMS (Bremsschalter)" UWORD B_TRUE 1 100 0 1 BIT_MASK 0x1 FORMAT "%13.11" ECU_ADDRESS 0x3FE3BE /end MEASUREMENT
/begin MEASUREMENT E_bwf "Errorflag: PWG Bewegung" UWORD B_TRUE 1 100 0 1 BIT_MASK 0x1 FORMAT "%13.11" ECU_ADDRESS 0x3FE3C0 /end MEASUREMENT
/begin MEASUREMENT E_ddss "Errorflag: Differenzdrucksensor Saugrohr" UWORD B_TRUE 1 100 0 1 BIT_MASK 0x1 FORMAT "%13.11" ECU_ADDRESS 0x3FE3E2 /end MEASUREMENT
/begin MEASUREMENT E_dgen "Errorflag: Generator" UWORD B_TRUE 1 100 0 1 BIT_MASK 0x1 FORMAT "%13.11" ECU_ADDRESS 0x3FE3E4 /end MEASUREMENT
/begin MEASUREMENT E_dgen2 "" UWORD B_TRUE 1 100 0 1 BIT_MASK 0x1 FORMAT "%13.11" ECU_ADDRESS 0x3FE3E6 /end MEASUREMENT
/begin MEASUREMENT E_dgenb2 "" UWORD B_TRUE 1 100 0 1 BIT_MASK 0x1 FORMAT "%13.11" ECU_ADDRESS 0x3FE3E8 /end MEASUREMENT
/begin MEASUREMENT E_dgenbs "Errorflag: Kommunikation" UWORD B_TRUE 1 100 0 1 BIT_MASK 0x1 FORMAT "%13.11" ECU_ADDRESS 0x3FE3EA /end MEASUREMENT
/begin MEASUREMENT E_dibs1 "" UWORD B_TRUE 1 100 0 1 BIT_MASK 0x1 FORMAT "%13.11" ECU_ADDRESS 0x3FE3EE /end MEASUREMENT
/begin MEASUREMENT E_dibs2 "" UWORD B_TRUE 1 100 0 1 BIT_MASK 0x1 FORMAT "%13.11" ECU_ADDRESS 0x3FE3F0 /end MEASUREMENT
/begin MEASUREMENT E_dibs3 "" UWORD B_TRUE 1 100 0 1 BIT_MASK 0x1 FORMAT "%13.11" ECU_ADDRESS 0x3FE3F2 /end MEASUREMENT
/begin MEASUREMENT E_dmtknm "Errorflag: Tankentl¸ftungssystem Kleinstleck (nicht MIL on)" UWORD B_TRUE 1 100 0 1 BIT_MASK 0x1 FORMAT "%13.11" ECU_ADDRESS 0x3FE404 /end MEASUREMENT
/begin MEASUREMENT E_dsu "Errorflag: Umgebungsdrucksensor" UWORD B_TRUE 1 100 0 1 BIT_MASK 0x1 FORMAT "%13.11" ECU_ADDRESS 0x3FE40A /end MEASUREMENT
/begin MEASUREMENT E_dwa "Errorflag: Diebstahlwarnanlage" UWORD B_TRUE 1 100 0 1 BIT_MASK 0x1 FORMAT "%13.11" ECU_ADDRESS 0x3FE452 /end MEASUREMENT
/begin MEASUREMENT E_dzku0 "Fehler : Z¸ndkreisfehler" UWORD B_TRUE 1 100 0 1 BIT_MASK 0x1 FORMAT "%13.11" ECU_ADDRESS 0x3FE458 /end MEASUREMENT
/begin MEASUREMENT E_dzku1 "Fehler : Z¸ndkreisfehler" UWORD B_TRUE 1 100 0 1 BIT_MASK 0x1 FORMAT "%13.11" ECU_ADDRESS 0x3FE45A /end MEASUREMENT
/begin MEASUREMENT E_dzku2 "Fehler : Z¸ndkreisfehler" UWORD B_TRUE 1 100 0 1 BIT_MASK 0x1 FORMAT "%13.11" ECU_ADDRESS 0x3FE45C /end MEASUREMENT
/begin MEASUREMENT E_dzku3 "Fehler : Z¸ndkreisfehler" UWORD B_TRUE 1 100 0 1 BIT_MASK 0x1 FORMAT "%13.11" ECU_ADDRESS 0x3FE45E /end MEASUREMENT
/begin MEASUREMENT E_dzku4 "Fehler : Z¸ndkreisfehler" UWORD B_TRUE 1 100 0 1 BIT_MASK 0x1 FORMAT "%13.11" ECU_ADDRESS 0x3FE460 /end MEASUREMENT
/begin MEASUREMENT E_dzku5 "Fehler : Z¸ndkreisfehler" UWORD B_TRUE 1 100 0 1 BIT_MASK 0x1 FORMAT "%13.11" ECU_ADDRESS 0x3FE462 /end MEASUREMENT
/begin MEASUREMENT E_dzku6 "Fehler : Z¸ndkreisfehler" UWORD B_TRUE 1 100 0 1 BIT_MASK 0x1 FORMAT "%13.11" ECU_ADDRESS 0x3FE464 /end MEASUREMENT
/begin MEASUREMENT E_dzku7 "Fehler : Z¸ndkreisfehler" UWORD B_TRUE 1 100 0 1 BIT_MASK 0x1 FORMAT "%13.11" ECU_ADDRESS 0x3FE466 /end MEASUREMENT
/begin MEASUREMENT E_egfe "Errorflag: Eingangsgrˆﬂen F¸llungserfassung" UWORD B_TRUE 1 100 0 1 BIT_MASK 0x1 FORMAT "%13.11" ECU_ADDRESS 0x3FE468 /end MEASUREMENT
/begin MEASUREMENT E_fp1p "Errorflag: Fahrpedal 1. Poti" UWORD B_TRUE 1 100 0 1 BIT_MASK 0x1 FORMAT "%13.11" ECU_ADDRESS 0x3FE486 /end MEASUREMENT
/begin MEASUREMENT E_fp2p "Errorflag: Fahrpedal 2. Poti" UWORD B_TRUE 1 100 0 1 BIT_MASK 0x1 FORMAT "%13.11" ECU_ADDRESS 0x3FE488 /end MEASUREMENT
/begin MEASUREMENT E_fpp "Errorflag Fahrpedal-Poti" UWORD B_TRUE 1 100 0 1 BIT_MASK 0x1 FORMAT "%13.11" ECU_ADDRESS 0x3FE48A /end MEASUREMENT
/begin MEASUREMENT E_hsvsa "Errorflag: reduzierte  LSU-Heizung oder LSU-Kennlinie abgeflacht" UWORD B_TRUE 1 100 0 1 BIT_MASK 0x1 FORMAT "%13.11" ECU_ADDRESS 0x3FE4B0 /end MEASUREMENT
/begin MEASUREMENT E_hsvsa2 "Errorflag: reduzierte  LSU_2-Heizung oder LSU_2-Kennlinie abgeflacht" UWORD B_TRUE 1 100 0 1 BIT_MASK 0x1 FORMAT "%13.11" ECU_ADDRESS 0x3FE4B2 /end MEASUREMENT
/begin MEASUREMENT E_lsvv "Errorflag: Vertauschte Lambda-Sonden vor Kat" UWORD B_TRUE 1 100 0 1 BIT_MASK 0x1 FORMAT "%13.11" ECU_ADDRESS 0x3FE4FE /end MEASUREMENT
/begin MEASUREMENT E_mdb "Errorflag: Momenten¸berwachung begrenzt dauerhaft" UWORD B_TRUE 1 100 0 1 BIT_MASK 0x1 FORMAT "%13.11" ECU_ADDRESS 0x3FE51A /end MEASUREMENT
/begin MEASUREMENT E_mfl "Errorflag: Multifunktionslenkrad  (MFL)" UWORD B_TRUE 1 100 0 1 BIT_MASK 0x1 FORMAT "%13.11" ECU_ADDRESS 0x3FE51C /end MEASUREMENT
/begin MEASUREMENT E_minhub "Fehlerflag, Fehler Minhubadaption" UWORD B_TRUE 1 100 0 1 BIT_MASK 0x1 FORMAT "%13.11" ECU_ADDRESS 0x3FE51E /end MEASUREMENT
/begin MEASUREMENT E_mtoel "Error-Bit" UWORD B_TRUE 1 100 0 1 BIT_MASK 0x1 FORMAT "%13.11" ECU_ADDRESS 0x3FE522 /end MEASUREMENT
/begin MEASUREMENT E_nvrmon "Errorflag: NVRAM-Backup Aktualit‰ts-‹berwachung" UWORD B_TRUE 1 100 0 1 BIT_MASK 0x1 FORMAT "%13.11" ECU_ADDRESS 0x3FE528 /end MEASUREMENT
/begin MEASUREMENT E_nwkw "Errorflag: Zuordnung Nockenwelle zu Kurbelwelle" UWORD B_TRUE 1 100 0 1 BIT_MASK 0x1 FORMAT "%13.11" ECU_ADDRESS 0x3FE52A /end MEASUREMENT
/begin MEASUREMENT E_oezs "Fehlerflag ÷lzustanssensor (B_mxoezs || B_mnoezs || B_sioezs || B_npoezs)" UWORD B_TRUE 1 100 0 1 BIT_MASK 0x1 FORMAT "%13.11" ECU_ADDRESS 0x3FE52C /end MEASUREMENT
/begin MEASUREMENT E_pddss "Errorflag: Druck Differenzdrucksensor Saugrohr" UWORD B_TRUE 1 100 0 1 BIT_MASK 0x1 FORMAT "%13.11" ECU_ADDRESS 0x3FE52E /end MEASUREMENT
/begin MEASUREMENT E_slve "Errorflag: Sekund‰rluftventil (Endstufe)" UWORD B_TRUE 1 100 0 1 BIT_MASK 0x1 FORMAT "%13.11" ECU_ADDRESS 0x3FE556 /end MEASUREMENT
/begin MEASUREMENT E_ta "Errorflag: Ansauglufttemperatur" UWORD B_TRUE 1 100 0 1 BIT_MASK 0x1 FORMAT "%13.11" ECU_ADDRESS 0x3FE560 /end MEASUREMENT
/begin MEASUREMENT E_tka "Errorflag: Temperatur K¸hlerausgang" UWORD B_TRUE 1 100 0 1 BIT_MASK 0x1 FORMAT "%13.11" ECU_ADDRESS 0x3FE56A /end MEASUREMENT
/begin MEASUREMENT E_tm "Errorflag: TMOT" UWORD B_TRUE 1 100 0 1 BIT_MASK 0x1 FORMAT "%13.11" ECU_ADDRESS 0x3FE56C /end MEASUREMENT
/begin MEASUREMENT E_tum "Errorflag:  Umgebungstemperatur tumg" UWORD B_TRUE 1 100 0 1 BIT_MASK 0x1 FORMAT "%13.11" ECU_ADDRESS 0x3FE56E /end MEASUREMENT
/begin MEASUREMENT E_ub "Errorflag: UB" UWORD B_TRUE 1 100 0 1 BIT_MASK 0x1 FORMAT "%13.11" ECU_ADDRESS 0x3FE570 /end MEASUREMENT
/begin MEASUREMENT E_vvte "Errorflag: VVT-Endstufe" UWORD B_TRUE 1 100 0 1 BIT_MASK 0x1 FORMAT "%13.11" ECU_ADDRESS 0x3FE58E /end MEASUREMENT
/begin MEASUREMENT E_wca "Errorflag: Wegfahrsperre Wechselcode-Ablage" UWORD B_TRUE 1 100 0 1 BIT_MASK 0x1 FORMAT "%13.11" ECU_ADDRESS 0x3FE590 /end MEASUREMENT
/begin MEASUREMENT E_wfs "Errorflag: Wegfahrsperre" UWORD B_TRUE 1 100 0 1 BIT_MASK 0x1 FORMAT "%13.11" ECU_ADDRESS 0x3FE592 /end MEASUREMENT
/begin MEASUREMENT fstakt_w "aktueller Tankfuellstand" UWORD vol_q0p1_l 1 100 0 6553.5 FORMAT "%8.3" ECU_ADDRESS 0x402BE0 /end MEASUREMENT
/begin MEASUREMENT fstalt_w "Fuellstand bei Zuendung aus" UWORD vol_q0p1_l 1 100 0 6553.5 FORMAT "%8.3" ECU_ADDRESS 0x3FE0AC /end MEASUREMENT
/begin MEASUREMENT fsthin_w "Tankfuellstand bei Fahrzeug-Halt" UWORD vol_q0p1_l 1 100 0 6553.5 FORMAT "%8.3" ECU_ADDRESS 0x402BE2 /end MEASUREMENT
/begin MEASUREMENT fstneu_w "Fuellstand bei Start" UWORD vol_q0p1_l 1 100 0 6553.5 FORMAT "%8.3" ECU_ADDRESS 0x402BE4 /end MEASUREMENT
/begin MEASUREMENT fsttin_w "Fulelstandsinitialwert fuer Diagnosezyklus" UWORD vol_q0p1_l 1 100 0 6553.5 FORMAT "%8.3" ECU_ADDRESS 0x3FE0AE /end MEASUREMENT
/begin MEASUREMENT fwmlhfm "gewichteter MLHFMMN in Abh‰ngigkeit von Faktor Hˆhe" UWORD m_q0p1 1 100 0 6553.5 FORMAT "%8.3" ECU_ADDRESS 0x402CD6 /end MEASUREMENT
/begin MEASUREMENT genfbsak "Uebertragungsfehler kodiert fuer Fehlereintrag" UBYTE DEZ 1 100 0 255 FORMAT "%5.1" ECU_ADDRESS 0x4031DD /end MEASUREMENT
/begin MEASUREMENT genfbsak2 "" UBYTE DEZ 1 100 0 255 FORMAT "%5.1" ECU_ADDRESS 0x4031EF /end MEASUREMENT
/begin MEASUREMENT genstatro2 "" UBYTE dez 1 100 0 255 FORMAT "%5.1" ECU_ADDRESS 0x403997 /end MEASUREMENT
/begin MEASUREMENT genstatroh "Status Generator" UBYTE dez 1 100 0 255 FORMAT "%5.1" ECU_ADDRESS 0x403995 /end MEASUREMENT
/begin MEASUREMENT gfehlin1 "lokale Kopie Fehlerinput" UBYTE B_TRUE 1 100 0 1 FORMAT "%13.11" ECU_ADDRESS 0x4031D0 /end MEASUREMENT
/begin MEASUREMENT gfehlin12 "" UBYTE B_TRUE 1 100 0 1 FORMAT "%13.11" ECU_ADDRESS 0x4031E2 /end MEASUREMENT
/begin MEASUREMENT gfehlin2 "lokale Kopie Fehlerinput" UBYTE B_TRUE 1 100 0 1 FORMAT "%13.11" ECU_ADDRESS 0x4031D1 /end MEASUREMENT
/begin MEASUREMENT gfehlin22 "" UBYTE B_TRUE 1 100 0 1 FORMAT "%13.11" ECU_ADDRESS 0x4031E3 /end MEASUREMENT
/begin MEASUREMENT gfehlin3 "lokale Kopie Fehlerinput" UBYTE B_TRUE 1 100 0 1 FORMAT "%13.11" ECU_ADDRESS 0x4031D2 /end MEASUREMENT
/begin MEASUREMENT gfehlin32 "" UBYTE B_TRUE 1 100 0 1 FORMAT "%13.11" ECU_ADDRESS 0x4031E4 /end MEASUREMENT
/begin MEASUREMENT gfehlin4 "lokale Kopie Fehlerinput" UBYTE B_TRUE 1 100 0 1 FORMAT "%13.11" ECU_ADDRESS 0x4031D3 /end MEASUREMENT
/begin MEASUREMENT gfehlin42 "" UBYTE B_TRUE 1 100 0 1 FORMAT "%13.11" ECU_ADDRESS 0x4031E5 /end MEASUREMENT
/begin MEASUREMENT gfehlin5 "lokale Kopie Fehlerinput" UBYTE B_TRUE 1 100 0 1 FORMAT "%13.11" ECU_ADDRESS 0x4031D4 /end MEASUREMENT
/begin MEASUREMENT gfehlin52 "" UBYTE B_TRUE 1 100 0 1 FORMAT "%13.11" ECU_ADDRESS 0x4031E6 /end MEASUREMENT
/begin MEASUREMENT kl61loc "Kl61 lokal" UBYTE B_TRUE 1 100 0 1 FORMAT "%13.11" ECU_ADDRESS 0x4031D5 /end MEASUREMENT
/begin MEASUREMENT kl61loc2 "" UBYTE B_TRUE 1 100 0 1 FORMAT "%13.11" ECU_ADDRESS 0x4031E7 /end MEASUREMENT
/begin MEASUREMENT kvbadd_w "verbrauchter Kraftstoff im letzten Fahrzyklus" UWORD vol_q3p90625Em3_l 1 100 0 255.996 FORMAT "%8.4" ECU_ADDRESS 0x402BE6 /end MEASUREMENT
/begin MEASUREMENT kvbakt_w "aktueller verbrauchter Kraftstoff" UWORD vol_q3p90625Em3_l 1 100 0 255.996 FORMAT "%8.4" ECU_ADDRESS 0x3FE0B0 /end MEASUREMENT
/begin MEASUREMENT kvbres_w "verbrauchter Kraftstoff f¸r Diagnose-Reset" UWORD vol_q3p90625Em3_l 1 100 0 255.996 FORMAT "%8.4" ECU_ADDRESS 0x402BE8 /end MEASUREMENT
/begin MEASUREMENT mlddkdps_w "Luftmasse aus Differenzdruck und DK-Winkel" UWORD m_q0p1 1 100 0 6553.5 FORMAT "%8.3" ECU_ADDRESS 0x403FA4 /end MEASUREMENT
/begin MEASUREMENT mlddkmn "" UWORD m_q0p1 1 100 0 6553.5 FORMAT "%8.3" ECU_ADDRESS 0x403FA6 /end MEASUREMENT
/begin MEASUREMENT mlddkmx "" UWORD m_q0p1 1 100 0 6553.5 FORMAT "%8.3" ECU_ADDRESS 0x403FA8 /end MEASUREMENT
/begin MEASUREMENT mlddk_w "Luftmasse bei VVT-Notlauf und Fehler Diffdrucksensor" UWORD m_q0p1 1 100 0 6553.5 FORMAT "%8.3" ECU_ADDRESS 0x403FAA /end MEASUREMENT
/begin MEASUREMENT mldhfm_w "Vergleichs-Luftmasse" UWORD m_q0p1 1 100 0 6553.5 FORMAT "%8.3" ECU_ADDRESS 0x403FAC /end MEASUREMENT
/begin MEASUREMENT mldhubmn "" UWORD m_q0p1 1 100 0 6553.5 FORMAT "%8.3" ECU_ADDRESS 0x403FAE /end MEASUREMENT
/begin MEASUREMENT mldhubmx "" UWORD m_q0p1 1 100 0 6553.5 FORMAT "%8.3" ECU_ADDRESS 0x403FB0 /end MEASUREMENT
/begin MEASUREMENT mldmn2_w "minimale Luftmasse aus Kennfeld KFMLDMN (2.HFM)" UWORD m_q0p1 1 100 0 6553.5 FORMAT "%8.3" ECU_ADDRESS 0x403FB2 /end MEASUREMENT
/begin MEASUREMENT mldmn_w "minimale Luftmasse aus Kennfeld KFMLDMN" SWORD m_q0p1 1 100 -3276.8 3276.7 FORMAT "%8.3" ECU_ADDRESS 0x403FB4 /end MEASUREMENT
/begin MEASUREMENT mldmx2_w "maximale Luftmasse aus Kennfeld KFMLDMX (2.HFM)" UWORD m_q0p1 1 100 0 6553.5 FORMAT "%8.3" ECU_ADDRESS 0x403FB6 /end MEASUREMENT
/begin MEASUREMENT mldmx_w "maximale Luftmasse aus Kennfeld KFMLDMX" UWORD m_q0p1 1 100 0 6553.5 FORMAT "%8.3" ECU_ADDRESS 0x403FB8 /end MEASUREMENT
/begin MEASUREMENT mldvvt1_w "" UWORD m_q0p1 1 100 0 6553.5 FORMAT "%8.3" ECU_ADDRESS 0x403FBA /end MEASUREMENT
/begin MEASUREMENT mldvvt2_w "" UWORD m_q0p1 1 100 0 6553.5 FORMAT "%8.3" ECU_ADDRESS 0x403FBC /end MEASUREMENT
/begin MEASUREMENT mldvvt_w "Luftmasse aus Einlaﬂhub und Drehzahl" UWORD m_q0p1 1 100 0 6553.5 FORMAT "%8.3" ECU_ADDRESS 0x403FBE /end MEASUREMENT
/begin MEASUREMENT mlhfmf_w "gefilterter Luftmassen HFM-Mittelwert 16Bit-Wert" UWORD m_q0p1 1 100 0 6553.5 FORMAT "%8.3" ECU_ADDRESS 0x403FC0 /end MEASUREMENT
/begin MEASUREMENT phlsnhf "normierte Heizleistung der Lambdasonde hinter Kat, gefiltert" UBYTE fak_ub_q0p01 1 100 0 2.55 FORMAT "%5.3" ECU_ADDRESS 0x402A44 /end MEASUREMENT
/begin MEASUREMENT phlsnhf2 "normierte Heizleistung der Lambdasonde 2 hinter Kat, gefiltert" UBYTE fak_ub_q0p01 1 100 0 2.55 FORMAT "%5.3" ECU_ADDRESS 0x402A45 /end MEASUREMENT
/begin MEASUREMENT rinkfh "Innenwiderstand Nernstzelle der Lambdasonde aus Kennfeld vor Kat" UBYTE r_q8 1 100 0 2040 FORMAT "%5.0" ECU_ADDRESS 0x402A46 /end MEASUREMENT
/begin MEASUREMENT rinkfh2 "Innenwiderstand Nernstzelle der Lambdasonde 2 aus Kennfeld vor Kat" UBYTE r_q8 1 100 0 2040 FORMAT "%5.0" ECU_ADDRESS 0x402A47 /end MEASUREMENT
/begin MEASUREMENT rinsh2_w "Grenzwert Innenwiderstand Nernstzelle der Lambdasonde 2 hinter Kat" UWORD r_uw_q2 1 100 0 131070 FORMAT "%8.1" ECU_ADDRESS 0x402A48 /end MEASUREMENT
/begin MEASUREMENT rinsh_w "Grenzwert Innenwiderstand Nernstzelle der Lambdasonde hinter Kat" UWORD r_uw_q2 1 100 0 131070 FORMAT "%8.1" ECU_ADDRESS 0x402A4A /end MEASUREMENT
/begin MEASUREMENT rldhfmmn_w "" UWORD rel_uw_q0p0234 1 100 0 1535.98 FORMAT "%8.3" ECU_ADDRESS 0x403FC2 /end MEASUREMENT
/begin MEASUREMENT rldhfmmx_w "" UWORD rel_uw_q0p0234 1 100 0 1535.98 FORMAT "%8.3" ECU_ADDRESS 0x403FC4 /end MEASUREMENT
/begin MEASUREMENT rlvwdf_w "" UWORD rel_uw_q0p0234 1 100 0 1535.98 FORMAT "%8.3" ECU_ADDRESS 0x403FC6 /end MEASUREMENT
/begin MEASUREMENT rlvwd_w "rlvw_w + Offset bei Umschaltung gedrosselt - ungedrosselt" UWORD rel_uw_q0p0234 1 100 0 1535.98 FORMAT "%8.3" ECU_ADDRESS 0x403FC8 /end MEASUREMENT
/begin MEASUREMENT sdulsumx_w "Schwelle delta Spannung max. pro Rechentakt" UWORD spg_uw_b5 1 100 0 319.995 FORMAT "%8.4" ECU_ADDRESS 0x403EAC /end MEASUREMENT
/begin MEASUREMENT sefst_w "Wegstrecke Entprellung: Fuellstandsgeberfehler" UWORD s_q0p34722_m 1 100 0 22755.2 FORMAT "%8.2" ECU_ADDRESS 0x3FE0B2 /end MEASUREMENT
/begin MEASUREMENT sfpbrems "Status Fehlerpfad BREMS: Bremsschalter" UWORD dez 1 100 0 65535 FORMAT "%8.2" ECU_ADDRESS 0x3FE3BE /end MEASUREMENT
/begin MEASUREMENT sfpbwf "Statuswort:  PWG Bewegung" UWORD dez 1 100 0 65535 FORMAT "%8.2" ECU_ADDRESS 0x3FE3C0 /end MEASUREMENT
/begin MEASUREMENT sfpddss "Status Fehlerpfad: Differenzdrucksensor Saugrohr" UWORD dez 1 100 0 65535 FORMAT "%8.2" ECU_ADDRESS 0x3FE3E2 /end MEASUREMENT
/begin MEASUREMENT sfpdgen "" UWORD dez 1 100 0 65535 FORMAT "%8.2" ECU_ADDRESS 0x3FE3E4 /end MEASUREMENT
/begin MEASUREMENT sfpdgen2 "" UWORD dez 1 100 0 65535 FORMAT "%8.2" ECU_ADDRESS 0x3FE3E6 /end MEASUREMENT
/begin MEASUREMENT sfpdgenb2 "" UWORD dez 1 100 0 65535 FORMAT "%8.2" ECU_ADDRESS 0x3FE3E8 /end MEASUREMENT
/begin MEASUREMENT sfpdgenbs "" UWORD dez 1 100 0 65535 FORMAT "%8.2" ECU_ADDRESS 0x3FE3EA /end MEASUREMENT
/begin MEASUREMENT sfpdibs1 "" UWORD dez 1 100 0 65535 FORMAT "%8.2" ECU_ADDRESS 0x3FE3EE /end MEASUREMENT
/begin MEASUREMENT sfpdibs2 "" UWORD dez 1 100 0 65535 FORMAT "%8.2" ECU_ADDRESS 0x3FE3F0 /end MEASUREMENT
/begin MEASUREMENT sfpdibs3 "" UWORD dez 1 100 0 65535 FORMAT "%8.2" ECU_ADDRESS 0x3FE3F2 /end MEASUREMENT
/begin MEASUREMENT sfpdmtknm "Status Fehlerpfad: Tankentl¸ftungssystem Kleinstleck" UWORD dez 1 100 0 65535 FORMAT "%8.2" ECU_ADDRESS 0x3FE404 /end MEASUREMENT
/begin MEASUREMENT sfpdsu "Status Fehlerpfad: Umgebungsdrucksensor" UWORD dez 1 100 0 65535 FORMAT "%8.2" ECU_ADDRESS 0x3FE40A /end MEASUREMENT
/begin MEASUREMENT sfpdwa "Status Fehlerpfad: Diebstahlwarnanlage" UWORD dez 1 100 0 65535 FORMAT "%8.2" ECU_ADDRESS 0x3FE452 /end MEASUREMENT
/begin MEASUREMENT sfpdzku0 "Fehlerpuffer Z¸ndkreisfehler" UWORD dez 1 100 0 65535 FORMAT "%8.2" ECU_ADDRESS 0x3FE458 /end MEASUREMENT
/begin MEASUREMENT sfpdzku1 "Fehlerpuffer Z¸ndkreisfehler" UWORD dez 1 100 0 65535 FORMAT "%8.2" ECU_ADDRESS 0x3FE45A /end MEASUREMENT
/begin MEASUREMENT sfpdzku2 "Fehlerpuffer Z¸ndkreisfehler" UWORD dez 1 100 0 65535 FORMAT "%8.2" ECU_ADDRESS 0x3FE45C /end MEASUREMENT
/begin MEASUREMENT sfpdzku3 "Fehlerpuffer Z¸ndkreisfehler" UWORD dez 1 100 0 65535 FORMAT "%8.2" ECU_ADDRESS 0x3FE45E /end MEASUREMENT
/begin MEASUREMENT sfpdzku4 "Fehlerpuffer Z¸ndkreisfehler" UWORD dez 1 100 0 65535 FORMAT "%8.2" ECU_ADDRESS 0x3FE460 /end MEASUREMENT
/begin MEASUREMENT sfpdzku5 "Fehlerpuffer Z¸ndkreisfehler" UWORD dez 1 100 0 65535 FORMAT "%8.2" ECU_ADDRESS 0x3FE462 /end MEASUREMENT
/begin MEASUREMENT sfpdzku6 "Fehlerpuffer Z¸ndkreisfehler" UWORD dez 1 100 0 65535 FORMAT "%8.2" ECU_ADDRESS 0x3FE464 /end MEASUREMENT
/begin MEASUREMENT sfpdzku7 "Fehlerpuffer Z¸ndkreisfehler" UWORD dez 1 100 0 65535 FORMAT "%8.2" ECU_ADDRESS 0x3FE466 /end MEASUREMENT
/begin MEASUREMENT sfpegfe "Status Fehlerpfad: Diagose der Eingangsgrˆﬂen der F¸llungserfassung" UWORD dez 1 100 0 65535 FORMAT "%8.2" ECU_ADDRESS 0x3FE468 /end MEASUREMENT
/begin MEASUREMENT sfpfp1p "Status Fehlerpfad: Fahrpedal 1.Potentiometer" UWORD dez 1 100 0 65535 FORMAT "%8.2" ECU_ADDRESS 0x3FE486 /end MEASUREMENT
/begin MEASUREMENT sfpfp2p "Status Fehlerpfad: Fahrpedal 2.Potentiometer" UWORD dez 1 100 0 65535 FORMAT "%8.2" ECU_ADDRESS 0x3FE488 /end MEASUREMENT
/begin MEASUREMENT sfpfpp "Status Fehlerpfad: Fahrpedal Potentiometer" UWORD dez 1 100 0 65535 FORMAT "%8.2" ECU_ADDRESS 0x3FE48A /end MEASUREMENT
/begin MEASUREMENT sfphsvsa "Status Fehlerpfad: Heizung Lambdasonde vor Kat" UWORD dez 1 100 0 65535 FORMAT "%8.2" ECU_ADDRESS 0x3FE4B0 /end MEASUREMENT
/begin MEASUREMENT sfphsvsa2 "Status Fehlerpfad: Heizung Lambdasonde 2 vor Kat" UWORD dez 1 100 0 65535 FORMAT "%8.2" ECU_ADDRESS 0x3FE4B2 /end MEASUREMENT
/begin MEASUREMENT sfplsvv "Status Fehlerpfad: Diagnose Lambdasonde vertauscht vor Kat" UWORD dez 1 100 0 65535 FORMAT "%8.2" ECU_ADDRESS 0x3FE4FE /end MEASUREMENT
/begin MEASUREMENT sfpmdb "Status Fehlerpfad: Momentan¸berwachung begrenzt dauerhaft" UWORD dez 1 100 0 65535 FORMAT "%8.2" ECU_ADDRESS 0x3FE51A /end MEASUREMENT
/begin MEASUREMENT sfpmfl "Statuswort: Multifunktionslenkrad" UWORD dez 1 100 0 65535 FORMAT "%8.2" ECU_ADDRESS 0x3FE51C /end MEASUREMENT
/begin MEASUREMENT sfpminhub "Status Fehlerpfad, Fehler Minhubadaption" UWORD dez 1 100 0 65535 FORMAT "%8.2" ECU_ADDRESS 0x3FE51E /end MEASUREMENT
/begin MEASUREMENT sfpmtoel "Status des Fehlerpfades" UWORD dez 1 100 0 65535 FORMAT "%8.2" ECU_ADDRESS 0x3FE522 /end MEASUREMENT
/begin MEASUREMENT sfpnvrmon "Status Fehlerpfad: NVRAM-Backup Aktualit‰ts-‹berwachung" UWORD dez 1 100 0 65535 FORMAT "%8.2" ECU_ADDRESS 0x3FE528 /end MEASUREMENT
/begin MEASUREMENT sfpnwkw "Status Fehlerpfad: Zuordnung Nockenwelle zu Kurbelwelle" UWORD dez 1 100 0 65535 FORMAT "%8.2" ECU_ADDRESS 0x3FE52A /end MEASUREMENT
/begin MEASUREMENT sfpoezs "lokaler Fehlerspeicher" UWORD dez 1 100 0 65535 FORMAT "%8.2" ECU_ADDRESS 0x3FE52C /end MEASUREMENT
/begin MEASUREMENT sfppddss "Status Fehlerpfad: Druck Differenzdrucksensor Saugrohr" UWORD dez 1 100 0 65535 FORMAT "%8.2" ECU_ADDRESS 0x3FE52E /end MEASUREMENT
/begin MEASUREMENT sfpslve "Status Fehlerpfad: Sekund‰rluftventil Endstufe" UWORD dez 1 100 0 65535 FORMAT "%8.2" ECU_ADDRESS 0x3FE556 /end MEASUREMENT
/begin MEASUREMENT sfpta "Status Fehlerpfad: Ansauglufttemperatur (Ladeluft-) TANS" UWORD dez 1 100 0 65535 FORMAT "%8.2" ECU_ADDRESS 0x3FE560 /end MEASUREMENT
/begin MEASUREMENT sfptka "Status Fehlerpfad: Temperatur K¸hlerausgang" UWORD dez 1 100 0 65535 FORMAT "%8.2" ECU_ADDRESS 0x3FE56A /end MEASUREMENT
/begin MEASUREMENT sfptm "Status Fehlerpfad: Motortemperatur TMOT" UWORD dez 1 100 0 65535 FORMAT "%8.2" ECU_ADDRESS 0x3FE56C /end MEASUREMENT
/begin MEASUREMENT sfptum "Status Fehlerpfad: Umgebungstemperatur TUM" UWORD dez 1 100 0 65535 FORMAT "%8.2" ECU_ADDRESS 0x3FE56E /end MEASUREMENT
/begin MEASUREMENT sfpub "Status Fehlerpfad: Batteriespannung UB (Bordnetz)" UWORD dez 1 100 0 65535 FORMAT "%8.2" ECU_ADDRESS 0x3FE570 /end MEASUREMENT
/begin MEASUREMENT sfpvvte "Status Fehlerpfad: VVT- Endstufe" UWORD dez 1 100 0 65535 FORMAT "%8.2" ECU_ADDRESS 0x3FE58E /end MEASUREMENT
/begin MEASUREMENT sfpwca "Status Fehlerpfad: Wegfahrsperre Wechselcode-Ablage" UWORD dez 1 100 0 65535 FORMAT "%8.2" ECU_ADDRESS 0x3FE590 /end MEASUREMENT
/begin MEASUREMENT sfpwfs "Status Fehlerpfad: Wegfahrsperre" UWORD dez 1 100 0 65535 FORMAT "%8.2" ECU_ADDRESS 0x3FE592 /end MEASUREMENT
/begin MEASUREMENT slowr_w "Fahrstrecke seit low range ein" UWORD s_q0p02777_m 1 100 0 1820.42 FORMAT "%8.3" ECU_ADDRESS 0x3FE0B4 /end MEASUREMENT
/begin MEASUREMENT st_gen "Generatorstatus" UBYTE dez 1 100 0 255 FORMAT "%5.1" ECU_ADDRESS 0x403996 /end MEASUREMENT
/begin MEASUREMENT st_gen2 "" UBYTE dez 1 100 0 255 FORMAT "%5.1" ECU_ADDRESS 0x403998 /end MEASUREMENT
/begin MEASUREMENT tahsomf2_w "gefilterte Abgastemperatur an Sonde hinter Kat aus Modell, Bank 2" UWORD temp_q0p0234_o273 1 100 -273.15 1262.83 FORMAT "%8.3" ECU_ADDRESS 0x402A4C /end MEASUREMENT
/begin MEASUREMENT tahsomf_w "gefilterte Abgastemperatur an Sonde hinter Kat aus Modell" UWORD temp_q0p0234_o273 1 100 -273.15 1262.83 FORMAT "%8.3" ECU_ADDRESS 0x402A4E /end MEASUREMENT
/begin MEASUREMENT tkerdcmn_w "UBat abh‰ngige Diagnoseschwelle f¸r max. Tastverh‰ltnis" UWORD temp_q0p0234_o273 1 100 -273.15 1262.83 FORMAT "%8.3" ECU_ADDRESS 0x402A52 /end MEASUREMENT
/begin MEASUREMENT twvsom2_w "Wandtemperatur vordere Sonde modelliert, Bank2" UWORD temp_q0p0234_o273 1 100 -273.15 1262.83 FORMAT "%8.3" ECU_ADDRESS 0x402A54 /end MEASUREMENT
/begin MEASUREMENT twvsom_w "Wandtemperatur vordere Sonde modelliert" UWORD temp_q0p0234_o273 1 100 -273.15 1262.83 FORMAT "%8.3" ECU_ADDRESS 0x402A56 /end MEASUREMENT
/begin MEASUREMENT TYP_brems "Fehlertyp: Gebergrˆﬂe Bremsschalter" UWORD B_TRUE 1 100 0 1 BIT_MASK 0xf00 FORMAT "%13.11" ECU_ADDRESS 0x3FE3BE /end MEASUREMENT
/begin MEASUREMENT TYP_bwf "Fehlertyp:  PWG Bewegung" UWORD B_TRUE 1 100 0 1 BIT_MASK 0xf00 FORMAT "%13.11" ECU_ADDRESS 0x3FE3C0 /end MEASUREMENT
/begin MEASUREMENT TYP_ddss "" UWORD B_TRUE 1 100 0 1 BIT_MASK 0xf00 FORMAT "%13.11" ECU_ADDRESS 0x3FE3E2 /end MEASUREMENT
/begin MEASUREMENT TYP_dgen "" UWORD B_TRUE 1 100 0 1 BIT_MASK 0xf00 FORMAT "%13.11" ECU_ADDRESS 0x3FE3E4 /end MEASUREMENT
/begin MEASUREMENT TYP_dgen2 "" UWORD B_TRUE 1 100 0 1 BIT_MASK 0xf00 FORMAT "%13.11" ECU_ADDRESS 0x3FE3E6 /end MEASUREMENT
/begin MEASUREMENT TYP_dgenb2 "" UWORD B_TRUE 1 100 0 1 BIT_MASK 0xf00 FORMAT "%13.11" ECU_ADDRESS 0x3FE3E8 /end MEASUREMENT
/begin MEASUREMENT TYP_dgenbs "" UWORD B_TRUE 1 100 0 1 BIT_MASK 0xf00 FORMAT "%13.11" ECU_ADDRESS 0x3FE3EA /end MEASUREMENT
/begin MEASUREMENT TYP_dibs1 "" UWORD B_TRUE 1 100 0 1 BIT_MASK 0xf00 FORMAT "%13.11" ECU_ADDRESS 0x3FE3EE /end MEASUREMENT
/begin MEASUREMENT TYP_dibs2 "" UWORD B_TRUE 1 100 0 1 BIT_MASK 0xf00 FORMAT "%13.11" ECU_ADDRESS 0x3FE3F0 /end MEASUREMENT
/begin MEASUREMENT TYP_dibs3 "" UWORD B_TRUE 1 100 0 1 BIT_MASK 0xf00 FORMAT "%13.11" ECU_ADDRESS 0x3FE3F2 /end MEASUREMENT
/begin MEASUREMENT TYP_dsu "" UWORD B_TRUE 1 100 0 1 BIT_MASK 0xf00 FORMAT "%13.11" ECU_ADDRESS 0x3FE40A /end MEASUREMENT
/begin MEASUREMENT TYP_dwa "" UWORD B_TRUE 1 100 0 1 BIT_MASK 0xf00 FORMAT "%13.11" ECU_ADDRESS 0x3FE452 /end MEASUREMENT
/begin MEASUREMENT TYP_dzku0 "" UWORD B_TRUE 1 100 0 1 BIT_MASK 0xf00 FORMAT "%13.11" ECU_ADDRESS 0x3FE458 /end MEASUREMENT
/begin MEASUREMENT TYP_dzku1 "" UWORD B_TRUE 1 100 0 1 BIT_MASK 0xf00 FORMAT "%13.11" ECU_ADDRESS 0x3FE45A /end MEASUREMENT
/begin MEASUREMENT TYP_dzku2 "" UWORD B_TRUE 1 100 0 1 BIT_MASK 0xf00 FORMAT "%13.11" ECU_ADDRESS 0x3FE45C /end MEASUREMENT
/begin MEASUREMENT TYP_dzku3 "" UWORD B_TRUE 1 100 0 1 BIT_MASK 0xf00 FORMAT "%13.11" ECU_ADDRESS 0x3FE45E /end MEASUREMENT
/begin MEASUREMENT TYP_dzku4 "" UWORD B_TRUE 1 100 0 1 BIT_MASK 0xf00 FORMAT "%13.11" ECU_ADDRESS 0x3FE460 /end MEASUREMENT
/begin MEASUREMENT TYP_dzku5 "" UWORD B_TRUE 1 100 0 1 BIT_MASK 0xf00 FORMAT "%13.11" ECU_ADDRESS 0x3FE462 /end MEASUREMENT
/begin MEASUREMENT TYP_dzku6 "" UWORD B_TRUE 1 100 0 1 BIT_MASK 0xf00 FORMAT "%13.11" ECU_ADDRESS 0x3FE464 /end MEASUREMENT
/begin MEASUREMENT TYP_dzku7 "" UWORD B_TRUE 1 100 0 1 BIT_MASK 0xf00 FORMAT "%13.11" ECU_ADDRESS 0x3FE466 /end MEASUREMENT
/begin MEASUREMENT TYP_egfe "" UWORD B_TRUE 1 100 0 1 BIT_MASK 0xf00 FORMAT "%13.11" ECU_ADDRESS 0x3FE468 /end MEASUREMENT
/begin MEASUREMENT TYP_fp1p "" UWORD B_TRUE 1 100 0 1 BIT_MASK 0xf00 FORMAT "%13.11" ECU_ADDRESS 0x3FE486 /end MEASUREMENT
/begin MEASUREMENT TYP_fp2p "" UWORD B_TRUE 1 100 0 1 BIT_MASK 0xf00 FORMAT "%13.11" ECU_ADDRESS 0x3FE488 /end MEASUREMENT
/begin MEASUREMENT TYP_fpp "" UWORD B_TRUE 1 100 0 1 BIT_MASK 0xf00 FORMAT "%13.11" ECU_ADDRESS 0x3FE48A /end MEASUREMENT
/begin MEASUREMENT TYP_lsvv "" UWORD B_TRUE 1 100 0 1 BIT_MASK 0xf00 FORMAT "%13.11" ECU_ADDRESS 0x3FE4FE /end MEASUREMENT
/begin MEASUREMENT TYP_mdb "Fehlertyp: Momentenbegrenzung (begrenzt dauerhaft) aktiv" UWORD B_TRUE 1 100 0 1 BIT_MASK 0xf00 FORMAT "%13.11" ECU_ADDRESS 0x3FE51A /end MEASUREMENT
/begin MEASUREMENT TYP_mfl "" UWORD B_TRUE 1 100 0 1 BIT_MASK 0xf00 FORMAT "%13.11" ECU_ADDRESS 0x3FE51C /end MEASUREMENT
/begin MEASUREMENT TYP_minhub "" UWORD B_TRUE 1 100 0 1 BIT_MASK 0xf00 FORMAT "%13.11" ECU_ADDRESS 0x3FE51E /end MEASUREMENT
/begin MEASUREMENT TYP_mtoel "" UWORD B_TRUE 1 100 0 1 BIT_MASK 0xf00 FORMAT "%13.11" ECU_ADDRESS 0x3FE522 /end MEASUREMENT
/begin MEASUREMENT TYP_nvrmon "" UWORD B_TRUE 1 100 0 1 BIT_MASK 0xf00 FORMAT "%13.11" ECU_ADDRESS 0x3FE528 /end MEASUREMENT
/begin MEASUREMENT TYP_oezs "" UWORD B_TRUE 1 100 0 1 BIT_MASK 0xf00 FORMAT "%13.11" ECU_ADDRESS 0x3FE52C /end MEASUREMENT
/begin MEASUREMENT TYP_pddss "" UWORD B_TRUE 1 100 0 1 BIT_MASK 0xf00 FORMAT "%13.11" ECU_ADDRESS 0x3FE52E /end MEASUREMENT
/begin MEASUREMENT TYP_ta "" UWORD B_TRUE 1 100 0 1 BIT_MASK 0xf00 FORMAT "%13.11" ECU_ADDRESS 0x3FE560 /end MEASUREMENT
/begin MEASUREMENT TYP_tka "" UWORD B_TRUE 1 100 0 1 BIT_MASK 0xf00 FORMAT "%13.11" ECU_ADDRESS 0x3FE56A /end MEASUREMENT
/begin MEASUREMENT TYP_tum "" UWORD B_TRUE 1 100 0 1 BIT_MASK 0xf00 FORMAT "%13.11" ECU_ADDRESS 0x3FE56E /end MEASUREMENT
/begin MEASUREMENT TYP_ub "" UWORD B_TRUE 1 100 0 1 BIT_MASK 0xf00 FORMAT "%13.11" ECU_ADDRESS 0x3FE570 /end MEASUREMENT
/begin MEASUREMENT TYP_vvte "" UWORD B_TRUE 1 100 0 1 BIT_MASK 0xf00 FORMAT "%13.11" ECU_ADDRESS 0x3FE58E /end MEASUREMENT
/begin MEASUREMENT TYP_wca "" UWORD B_TRUE 1 100 0 1 BIT_MASK 0xf00 FORMAT "%13.11" ECU_ADDRESS 0x3FE590 /end MEASUREMENT
/begin MEASUREMENT TYP_wfs "" UWORD B_TRUE 1 100 0 1 BIT_MASK 0xf00 FORMAT "%13.11" ECU_ADDRESS 0x3FE592 /end MEASUREMENT
/begin MEASUREMENT ub_helsu "Bordnetzspannung f¸r Heizereinkopplung, Standard-Quantisierung" UBYTE spg_q0p1 1 100 0 25.5 FORMAT "%5.2" ECU_ADDRESS 0x402A40 /end MEASUREMENT
/begin MEASUREMENT ub_hsv "Bordnetzspannung f¸r Sondenheizung, Standard-Quantisierung" UBYTE spg_q0p1 1 100 0 25.5 FORMAT "%5.2" ECU_ADDRESS 0x402A50 /end MEASUREMENT
/begin MEASUREMENT wdkba_mldm "" SWORD relDK_q0p02441 1 100 -800 799.976 FORMAT "%8.4" ECU_ADDRESS 0x403FCA /end MEASUREMENT
/begin MEASUREMENT wdkba_mldn "" SWORD relDK_q0p02441 1 100 -800 799.976 FORMAT "%8.4" ECU_ADDRESS 0x403FCC /end MEASUREMENT
/begin MEASUREMENT zatmwvs2_w "Zeitkonstante f¸r Rohrwandtemperatur, Bank2" UWORD zk200msxs_uw_b13107 1 100 0.2 13107 FORMAT "%12.6" ECU_ADDRESS 0x402A58 /end MEASUREMENT
/begin MEASUREMENT zatmwvs_w "Zeitkonstante f¸r Rohrwandtemperatur" UWORD zk200msxs_uw_b13107 1 100 0.2 13107 FORMAT "%12.6" ECU_ADDRESS 0x402A5A /end MEASUREMENT
/begin MEASUREMENT zhklsu "Z‰hler Heizerkopplung LSU" UBYTE dez 1 100 0 255 FORMAT "%5.1" ECU_ADDRESS 0x403B76 /end MEASUREMENT
/begin MEASUREMENT zhklsu2 "Z‰hler Heizerkopplung LSU2" UBYTE dez 1 100 0 255 FORMAT "%5.1" ECU_ADDRESS 0x403B77 /end MEASUREMENT
/begin MEASUREMENT Z_brems "Zyklusflag: BREMS (Bremsschalter)" UWORD B_TRUE 1 100 0 1 BIT_MASK 0x2 FORMAT "%13.11" ECU_ADDRESS 0x3FE3BE /end MEASUREMENT
/begin MEASUREMENT Z_bwf "Zyklusflag: PWG Bewegung" UWORD B_TRUE 1 100 0 1 BIT_MASK 0x2 FORMAT "%13.11" ECU_ADDRESS 0x3FE3C0 /end MEASUREMENT
/begin MEASUREMENT Z_ddss "Zyklusflag: Differenzdrucksensor Saugrohr" UWORD B_TRUE 1 100 0 1 BIT_MASK 0x2 FORMAT "%13.11" ECU_ADDRESS 0x3FE3E2 /end MEASUREMENT
/begin MEASUREMENT Z_dgen "Zyklusflag: Generator" UWORD B_TRUE 1 100 0 1 BIT_MASK 0x2 FORMAT "%13.11" ECU_ADDRESS 0x3FE3E4 /end MEASUREMENT
/begin MEASUREMENT Z_dgen2 "" UWORD B_TRUE 1 100 0 1 BIT_MASK 0x2 FORMAT "%13.11" ECU_ADDRESS 0x3FE3E6 /end MEASUREMENT
/begin MEASUREMENT Z_dgenb2 "" UWORD B_TRUE 1 100 0 1 BIT_MASK 0x2 FORMAT "%13.11" ECU_ADDRESS 0x3FE3E8 /end MEASUREMENT
/begin MEASUREMENT Z_dgenbs "Zyklusflag: Kommunikation" UWORD B_TRUE 1 100 0 1 BIT_MASK 0x2 FORMAT "%13.11" ECU_ADDRESS 0x3FE3EA /end MEASUREMENT
/begin MEASUREMENT Z_dibs1 "" UWORD B_TRUE 1 100 0 1 BIT_MASK 0x2 FORMAT "%13.11" ECU_ADDRESS 0x3FE3EE /end MEASUREMENT
/begin MEASUREMENT Z_dibs2 "" UWORD B_TRUE 1 100 0 1 BIT_MASK 0x2 FORMAT "%13.11" ECU_ADDRESS 0x3FE3F0 /end MEASUREMENT
/begin MEASUREMENT Z_dibs3 "" UWORD B_TRUE 1 100 0 1 BIT_MASK 0x2 FORMAT "%13.11" ECU_ADDRESS 0x3FE3F2 /end MEASUREMENT
/begin MEASUREMENT Z_dmtknm "Zyklusflag: Tankentl¸ftungssystem Kleinstleck (keine MIL on)" UWORD B_TRUE 1 100 0 1 BIT_MASK 0x2 FORMAT "%13.11" ECU_ADDRESS 0x3FE404 /end MEASUREMENT
/begin MEASUREMENT Z_dsu "Zyklusflag: Umgebungsdrucksensor" UWORD B_TRUE 1 100 0 1 BIT_MASK 0x2 FORMAT "%13.11" ECU_ADDRESS 0x3FE40A /end MEASUREMENT
/begin MEASUREMENT Z_dwa "Zyklusflag: Diebstahlwarnanlage" UWORD B_TRUE 1 100 0 1 BIT_MASK 0x2 FORMAT "%13.11" ECU_ADDRESS 0x3FE452 /end MEASUREMENT
/begin MEASUREMENT Z_dzku0 "Zyklusflag Z¸ndkreisdiagnose" UWORD B_TRUE 1 100 0 1 BIT_MASK 0x2 FORMAT "%13.11" ECU_ADDRESS 0x3FE458 /end MEASUREMENT
/begin MEASUREMENT Z_dzku1 "Zyklusflag Z¸ndkreisdiagnose" UWORD B_TRUE 1 100 0 1 BIT_MASK 0x2 FORMAT "%13.11" ECU_ADDRESS 0x3FE45A /end MEASUREMENT
/begin MEASUREMENT Z_dzku2 "Zyklusflag Z¸ndkreisdiagnose" UWORD B_TRUE 1 100 0 1 BIT_MASK 0x2 FORMAT "%13.11" ECU_ADDRESS 0x3FE45C /end MEASUREMENT
/begin MEASUREMENT Z_dzku3 "Zyklusflag Z¸ndkreisdiagnose" UWORD B_TRUE 1 100 0 1 BIT_MASK 0x2 FORMAT "%13.11" ECU_ADDRESS 0x3FE45E /end MEASUREMENT
/begin MEASUREMENT Z_dzku4 "Zyklusflag Z¸ndkreisdiagnose" UWORD B_TRUE 1 100 0 1 BIT_MASK 0x2 FORMAT "%13.11" ECU_ADDRESS 0x3FE460 /end MEASUREMENT
/begin MEASUREMENT Z_dzku5 "Zyklusflag Z¸ndkreisdiagnose" UWORD B_TRUE 1 100 0 1 BIT_MASK 0x2 FORMAT "%13.11" ECU_ADDRESS 0x3FE462 /end MEASUREMENT
/begin MEASUREMENT Z_dzku6 "Zyklusflag Z¸ndkreisdiagnose" UWORD B_TRUE 1 100 0 1 BIT_MASK 0x2 FORMAT "%13.11" ECU_ADDRESS 0x3FE464 /end MEASUREMENT
/begin MEASUREMENT Z_dzku7 "Zyklusflag Z¸ndkreisdiagnose" UWORD B_TRUE 1 100 0 1 BIT_MASK 0x2 FORMAT "%13.11" ECU_ADDRESS 0x3FE466 /end MEASUREMENT
/begin MEASUREMENT Z_egfe "Zyklusflag: Eingangsgrˆﬂen F¸llungserfassung" UWORD B_TRUE 1 100 0 1 BIT_MASK 0x2 FORMAT "%13.11" ECU_ADDRESS 0x3FE468 /end MEASUREMENT
/begin MEASUREMENT Z_fp1p "Zyklusflag: Fahrpedal 1. Poti" UWORD B_TRUE 1 100 0 1 BIT_MASK 0x2 FORMAT "%13.11" ECU_ADDRESS 0x3FE486 /end MEASUREMENT
/begin MEASUREMENT Z_fp2p "Zyklusflag: Fahrpedal 2. Poti" UWORD B_TRUE 1 100 0 1 BIT_MASK 0x2 FORMAT "%13.11" ECU_ADDRESS 0x3FE488 /end MEASUREMENT
/begin MEASUREMENT Z_fpp "Zyklusflag Fahrpedal-Poti" UWORD B_TRUE 1 100 0 1 BIT_MASK 0x2 FORMAT "%13.11" ECU_ADDRESS 0x3FE48A /end MEASUREMENT
/begin MEASUREMENT Z_hsvsa "Zyklusflag:  reduzierte  LSU-Heizung oder LSU-Kennlinie abgeflacht" UWORD B_TRUE 1 100 0 1 BIT_MASK 0x2 FORMAT "%13.11" ECU_ADDRESS 0x3FE4B0 /end MEASUREMENT
/begin MEASUREMENT Z_hsvsa2 "Zyklusflag: reduzierte  LSU_2-Heizung oder LSU_2-Kennlinie abgeflacht" UWORD B_TRUE 1 100 0 1 BIT_MASK 0x2 FORMAT "%13.11" ECU_ADDRESS 0x3FE4B2 /end MEASUREMENT
/begin MEASUREMENT Z_lsvv "Zyklusflag: Vertauschte Lambda-Sonden vor Kat" UWORD B_TRUE 1 100 0 1 BIT_MASK 0x2 FORMAT "%13.11" ECU_ADDRESS 0x3FE4FE /end MEASUREMENT
/begin MEASUREMENT Z_mdb "Zyklusflag: Momentenbegrenzung begrenzt dauerhaft" UWORD B_TRUE 1 100 0 1 BIT_MASK 0x2 FORMAT "%13.11" ECU_ADDRESS 0x3FE51A /end MEASUREMENT
/begin MEASUREMENT Z_mfl "Zyklusflag: Multifunktionslenrad (MFL)" UWORD B_TRUE 1 100 0 1 BIT_MASK 0x2 FORMAT "%13.11" ECU_ADDRESS 0x3FE51C /end MEASUREMENT
/begin MEASUREMENT Z_minhub "Zyklusflag, Fehler Minhubadaption" UWORD B_TRUE 1 100 0 1 BIT_MASK 0x2 FORMAT "%13.11" ECU_ADDRESS 0x3FE51E /end MEASUREMENT
/begin MEASUREMENT Z_mtoel "Zyklus-Bit" UWORD B_TRUE 1 100 0 1 BIT_MASK 0x2 FORMAT "%13.11" ECU_ADDRESS 0x3FE522 /end MEASUREMENT
/begin MEASUREMENT Z_nvrmon "Zyklusflag: NVRAM-Backup Aktualit‰ts-‹berwachung" UWORD B_TRUE 1 100 0 1 BIT_MASK 0x2 FORMAT "%13.11" ECU_ADDRESS 0x3FE528 /end MEASUREMENT
/begin MEASUREMENT Z_nwkw "Zyklusflag: Zuordnung Nockenwelle zu Kurbelwelle" UWORD B_TRUE 1 100 0 1 BIT_MASK 0x2 FORMAT "%13.11" ECU_ADDRESS 0x3FE52A /end MEASUREMENT
/begin MEASUREMENT Z_oezs "Zyklusflag ÷lzustandssensor" UWORD B_TRUE 1 100 0 1 BIT_MASK 0x2 FORMAT "%13.11" ECU_ADDRESS 0x3FE52C /end MEASUREMENT
/begin MEASUREMENT Z_pddss "Zyklusflag: Druck Differenzdrucksensor Saugrohr" UWORD B_TRUE 1 100 0 1 BIT_MASK 0x2 FORMAT "%13.11" ECU_ADDRESS 0x3FE52E /end MEASUREMENT
/begin MEASUREMENT Z_slve "Zyklusflag:	Sekund‰rluftventil (Endstufe)" UWORD B_TRUE 1 100 0 1 BIT_MASK 0x2 FORMAT "%13.11" ECU_ADDRESS 0x3FE556 /end MEASUREMENT
/begin MEASUREMENT Z_ta "Zyklusflag: TANS" UWORD B_TRUE 1 100 0 1 BIT_MASK 0x2 FORMAT "%13.11" ECU_ADDRESS 0x3FE560 /end MEASUREMENT
/begin MEASUREMENT Z_tka "Zyklusflag Temperatur K¸hlerausgang" UWORD B_TRUE 1 100 0 1 BIT_MASK 0x2 FORMAT "%13.11" ECU_ADDRESS 0x3FE56A /end MEASUREMENT
/begin MEASUREMENT Z_tm "Zyklusflag:	TMOT" UWORD B_TRUE 1 100 0 1 BIT_MASK 0x2 FORMAT "%13.11" ECU_ADDRESS 0x3FE56C /end MEASUREMENT
/begin MEASUREMENT Z_tum "Zyklusflag: Umgebungstemperatur TUM" UWORD B_TRUE 1 100 0 1 BIT_MASK 0x2 FORMAT "%13.11" ECU_ADDRESS 0x3FE56E /end MEASUREMENT
/begin MEASUREMENT Z_ub "Zyklusflag:	UB" UWORD B_TRUE 1 100 0 1 BIT_MASK 0x2 FORMAT "%13.11" ECU_ADDRESS 0x3FE570 /end MEASUREMENT
/begin MEASUREMENT Z_vvte "Zyklusflag: VVT-Endstufe" UWORD B_TRUE 1 100 0 1 BIT_MASK 0x2 FORMAT "%13.11" ECU_ADDRESS 0x3FE58E /end MEASUREMENT
/begin MEASUREMENT Z_wca "Zyklusflag: Wegfahrsperre Wechselcode-Ablage" UWORD B_TRUE 1 100 0 1 BIT_MASK 0x2 FORMAT "%13.11" ECU_ADDRESS 0x3FE590 /end MEASUREMENT
/begin MEASUREMENT Z_wfs "Zyklusflag: Wegfahrsperre" UWORD B_TRUE 1 100 0 1 BIT_MASK 0x2 FORMAT "%13.11" ECU_ADDRESS 0x3FE592 /end MEASUREMENT
/begin FUNCTION DFPM_DVVTE "" /begin DEF_CHARACTERISTIC CDCVVTE CDKVVTE CDTVVTE CLAVVTE FFTVVTE TSFVVTE /end DEF_CHARACTERISTIC
 /begin OUT_MEASUREMENT B_bevvte B_bkvvte B_clvvte B_ftvvte B_mnvvte B_mxvvte B_npvvte B_sivvte E_vvte sfpvvte TYP_vvte Z_vvte /end OUT_MEASUREMENT
/end FUNCTION
/begin FUNCTION DFPM_DZKU ""
 /begin DEF_CHARACTERISTIC CDCDZKU0 CDCDZKU1 CDCDZKU2 CDCDZKU3 CDCDZKU4 CDCDZKU5 CDCDZKU6 CDCDZKU7 CDKDZKU0 CDKDZKU1 CDKDZKU2 CDKDZKU3 CDKDZKU4 CDKDZKU5 CDKDZKU6 CDKDZKU7 CDTDZKU0 CDTDZKU1 CDTDZKU2 CDTDZKU3 CDTDZKU4 CDTDZKU5 CDTDZKU6 CDTDZKU7 CLADZKU0 CLADZKU1 CLADZKU2 CLADZKU3 CLADZKU4 CLADZKU5 CLADZKU6 CLADZKU7 FFTDZKU0 FFTDZKU1 FFTDZKU2 FFTDZKU3 FFTDZKU4 FFTDZKU5 FFTDZKU6 FFTDZKU7 TSFDZKU0 TSFDZKU1 TSFDZKU2 TSFDZKU3 TSFDZKU4 TSFDZKU5 TSFDZKU6 TSFDZKU7 /end DEF_CHARACTERISTIC
 /begin OUT_MEASUREMENT B_bedzku0 B_bedzku1 B_bedzku2 B_bedzku3 B_bedzku4 B_bedzku5 B_bedzku6 B_bedzku7 B_bkdzku0 B_bkdzku1 B_bkdzku2 B_bkdzku3 B_bkdzku4 B_bkdzku5 B_bkdzku6 B_bkdzku7 B_cldzku0 B_cldzku1 B_cldzku2 B_cldzku3 B_cldzku4 B_cldzku5 B_cldzku6 B_cldzku7 B_ftdzku0 B_ftdzku1 B_ftdzku2 B_ftdzku3 B_ftdzku4 B_ftdzku5 B_ftdzku6 B_ftdzku7 B_mndzku0 B_mndzku1 B_mndzku2 B_mndzku3 B_mndzku4 B_mndzku5 B_mndzku6 B_mndzku7 B_mxdzku0 B_mxdzku1 B_mxdzku2 B_mxdzku3 B_mxdzku4 B_mxdzku5 B_mxdzku6 B_mxdzku7 B_npdzku0 B_npdzku1 B_npdzku2 B_npdzku3 B_npdzku4 B_npdzku5 B_npdzku6 B_npdzku7 B_sidzku0 B_sidzku1 B_sidzku2 B_sidzku3 B_sidzku4 B_sidzku5 B_sidzku6 B_sidzku7 E_dzku0 E_dzku1 E_dzku2 E_dzku3 E_dzku4 E_dzku5 E_dzku6 E_dzku7 sfpdzku0 sfpdzku1 sfpdzku2 sfpdzku3 sfpdzku4 sfpdzku5 sfpdzku6 sfpdzku7 TYP_dzku0 TYP_dzku1 TYP_dzku2 TYP_dzku3 TYP_dzku4 TYP_dzku5 TYP_dzku6 TYP_dzku7 Z_dzku0 Z_dzku1 Z_dzku2 Z_dzku3 Z_dzku4 Z_dzku5 Z_dzku6 Z_dzku7 /end OUT_MEASUREMENT
/end FUNCTION
/begin FUNCTION DFPM_EGFE "" /begin DEF_CHARACTERISTIC CDCEGFE CDKEGFE CDTEGFE CLAEGFE FFTEGFE TSFEGFE /end DEF_CHARACTERISTIC
 /begin OUT_MEASUREMENT B_beegfe B_bkegfe B_clegfe B_ftegfe B_mnegfe B_mxegfe B_npegfe B_siegfe E_egfe sfpegfe TYP_egfe Z_egfe /end OUT_MEASUREMENT
/end FUNCTION
/begin FUNCTION DFPM_FSPVDGEN "FSPVDGEN.exported"
 /begin DEF_CHARACTERISTIC CDCDGEN CDCDGENBS CDKDGEN CDKDGENBS CDTDGEN CDTDGENBS CLADGEN CLADGENBS FFTDGEN FFTDGENBS TSFDGEN TSFDGENBS /end DEF_CHARACTERISTIC
 /begin OUT_MEASUREMENT B_bedgen B_bedgenbs B_bkdgen B_bkdgenbs B_cldgen B_cldgenbs B_ftdgen B_ftdgenbs B_mndgen B_mndgenbs B_mxdgen B_mxdgenbs B_npdgen B_npdgenbs B_sidgen B_sidgenbs E_dgen E_dgenbs sfpdgen sfpdgenbs TYP_dgen TYP_dgenbs Z_dgen Z_dgenbs /end OUT_MEASUREMENT
/end FUNCTION
/begin FUNCTION DFPM_FSPVDGEN2 "FSPVDGEN2.exported"
 /begin DEF_CHARACTERISTIC CDCDGEN2 CDCDGENB2 CDKDGEN2 CDKDGENB2 CDTDGEN2 CDTDGENB2 CLADGEN2 CLADGENB2 FFTDGEN2 FFTDGENB2 TSFDGEN2 TSFDGENB2 /end DEF_CHARACTERISTIC
 /begin OUT_MEASUREMENT B_bedgen2 B_bedgenb2 B_bkdgen2 B_bkdgenb2 B_cldgen2 B_cldgenb2 B_ftdgen2 B_ftdgenb2 B_mndgen2 B_mndgenb2 B_mxdgen2 B_mxdgenb2 B_npdgen2 B_npdgenb2 B_sidgen2 B_sidgenb2 E_dgen2 E_dgenb2 sfpdgen2 sfpdgenb2 TYP_dgen2 TYP_dgenb2 Z_dgen2 Z_dgenb2 /end OUT_MEASUREMENT
/end FUNCTION
/begin FUNCTION DFPM_FSPVDIBS "FSPVDIBS.exported"
 /begin DEF_CHARACTERISTIC CDCDIBS1 CDCDIBS2 CDCDIBS3 CDKDIBS1 CDKDIBS2 CDKDIBS3 CDTDIBS1 CDTDIBS2 CDTDIBS3 CLADIBS1 CLADIBS2 CLADIBS3 FFTDIBS1 FFTDIBS2 FFTDIBS3 TSFDIBS1 TSFDIBS2 TSFDIBS3 /end DEF_CHARACTERISTIC
 /begin OUT_MEASUREMENT B_bedibs1 B_bedibs2 B_bedibs3 B_bkdibs1 B_bkdibs2 B_bkdibs3 B_cldibs1 B_cldibs2 B_cldibs3 B_ftdibs1 B_ftdibs2 B_ftdibs3 B_mndibs1 B_mndibs2 B_mndibs3 B_mxdibs1 B_mxdibs2 B_mxdibs3 B_npdibs1 B_npdibs2 B_npdibs3 B_sidibs1 B_sidibs2 B_sidibs3 E_dibs1 E_dibs2 E_dibs3 sfpdibs1 sfpdibs2 sfpdibs3 TYP_dibs1 TYP_dibs2 TYP_dibs3 Z_dibs1 Z_dibs2 Z_dibs3 /end OUT_MEASUREMENT
/end FUNCTION
/begin FUNCTION DFPM_FSPVDQLT "" /begin DEF_CHARACTERISTIC CDCOEZS CDKOEZS CDTOEZS CLAOEZS FFTOEZS TSFOEZS /end DEF_CHARACTERISTIC
 /begin OUT_MEASUREMENT B_beoezs B_bkoezs B_cloezs B_ftoezs B_mnoezs B_mxoezs B_npoezs B_sioezs E_oezs sfpoezs TYP_oezs Z_oezs /end OUT_MEASUREMENT
/end FUNCTION
/begin FUNCTION DFPM_GGDDSS ""
 /begin DEF_CHARACTERISTIC CDCDDSS CDCPDDSS CDKDDSS CDKPDDSS CDTDDSS CDTPDDSS CLADDSS CLAPDDSS FFTDDSS FFTPDDSS TSFDDSS TSFPDDSS /end DEF_CHARACTERISTIC
 /begin OUT_MEASUREMENT B_bkddss B_bkpddss B_clddss B_clpddss B_mnddss B_mnpddss B_mxddss B_mxpddss B_npddss B_nppddss B_siddss B_sipddss E_ddss E_pddss sfpddss sfppddss TYP_ddss TYP_pddss Z_ddss Z_pddss /end OUT_MEASUREMENT
/end FUNCTION
/begin FUNCTION DFPM_GGDSAS "" /begin DEF_CHARACTERISTIC CDCDSU CDKDSU CDTDSU CLADSU FFTDSU TSFDSU /end DEF_CHARACTERISTIC
 /begin OUT_MEASUREMENT B_bedsu B_bkdsu B_cldsu B_ftdsu B_mndsu B_mxdsu B_npdsu B_sidsu E_dsu sfpdsu TYP_dsu Z_dsu /end OUT_MEASUREMENT
/end FUNCTION
/begin FUNCTION DFPM_GGEGAS "" /begin DEF_CHARACTERISTIC CDCBREMS CDKBREMS CDTBREMS CLABREMS FFTBREMS TSFBREMS /end DEF_CHARACTERISTIC
 /begin OUT_MEASUREMENT B_bebrems B_bkbrems B_clbrems B_ftbrems B_mnbrems B_mxbrems B_npbrems B_sibrems E_brems sfpbrems TYP_brems Z_brems /end OUT_MEASUREMENT
/end FUNCTION
/begin FUNCTION DFPM_GGMFL "" /begin DEF_CHARACTERISTIC CDCMFL CDKMFL CDTMFL CLAMFL FFTMFL TSFMFL /end DEF_CHARACTERISTIC
 /begin OUT_MEASUREMENT B_bemfl B_bkmfl B_clmfl B_ftmfl B_mnmfl B_mxmfl B_npmfl B_simfl E_mfl sfpmfl TYP_mfl Z_mfl /end OUT_MEASUREMENT
/end FUNCTION
/begin FUNCTION DFPM_GGPED ""
 /begin DEF_CHARACTERISTIC CDCBWF CDCFP1P CDCFP2P CDCFPP CDKBWF CDKFP1P CDKFP2P CDKFPP CDTBWF CDTFP1P CDTFP2P CDTFPP CLABWF CLAFP1P CLAFP2P CLAFPP FFTBWF FFTFP1P FFTFP2P FFTFPP TSFBWF TSFFP1P TSFFP2P TSFFPP /end DEF_CHARACTERISTIC
 /begin OUT_MEASUREMENT B_bebwf B_befp1p B_befp2p B_befpp B_bkbwf B_bkfp1p B_bkfp2p B_bkfpp B_clbwf B_clfp1p B_clfp2p B_clfpp B_ftbwf B_ftfp1p B_ftfp2p B_ftfpp B_mnbwf B_mnfp1p B_mnfp2p B_mnfpp B_mxbwf B_mxfp1p B_mxfp2p B_mxfpp B_npbwf B_npfp1p B_npfp2p B_npfpp B_sibwf B_sifp1p B_sifp2p B_sifpp E_bwf E_fp1p E_fp2p E_fpp sfpbwf sfpfp1p sfpfp2p sfpfpp TYP_bwf TYP_fp1p TYP_fp2p TYP_fpp Z_bwf Z_fp1p Z_fp2p Z_fpp /end OUT_MEASUREMENT
/end FUNCTION
/begin FUNCTION DFPM_GGTFA "" /begin DEF_CHARACTERISTIC CDCTA CDKTA CDTTA CLATA FFTTA TSFTA /end DEF_CHARACTERISTIC
 /begin OUT_MEASUREMENT B_beta B_bkta B_clta B_ftta B_mnta B_mxta B_npta B_sita E_ta sfpta TYP_ta Z_ta /end OUT_MEASUREMENT
/end FUNCTION
/begin FUNCTION DFPM_GGTFM "" /begin DEF_CHARACTERISTIC CDCTM CDKTM CDTTM CLATM FFTTM TSFTM /end DEF_CHARACTERISTIC
 /begin OUT_MEASUREMENT B_betm B_bktm B_cltm B_fttm B_mntm B_mxtm B_nptm B_sitm E_tm sfptm Z_tm /end OUT_MEASUREMENT
/end FUNCTION
/begin FUNCTION DFPM_GGTFUMG "" /begin DEF_CHARACTERISTIC CDCTUM CDKTUM CDTTUM CLATUM FFTTUM TSFTUM /end DEF_CHARACTERISTIC
 /begin OUT_MEASUREMENT B_betum B_bktum B_cltum B_fttum B_mntum B_mxtum B_nptum B_situm E_tum sfptum TYP_tum Z_tum /end OUT_MEASUREMENT
/end FUNCTION
/begin FUNCTION DFPM_GGTKA "" /begin DEF_CHARACTERISTIC CDCTKA CDKTKA CDTTKA CLATKA FFTTKA TSFTKA /end DEF_CHARACTERISTIC
 /begin OUT_MEASUREMENT B_betka B_bktka B_cltka B_fttka B_mntka B_mxtka B_nptka B_sitka E_tka sfptka TYP_tka Z_tka /end OUT_MEASUREMENT
/end FUNCTION
/begin FUNCTION DFPM_GGUB "" /begin DEF_CHARACTERISTIC CDCUB CDKUB CDTUB CLAUB FFTUB TSFUB /end DEF_CHARACTERISTIC
 /begin OUT_MEASUREMENT B_beub B_bkub B_club B_ftub B_mnub B_mxub B_npub B_siub E_ub sfpub TYP_ub Z_ub /end OUT_MEASUREMENT
/end FUNCTION
/begin FUNCTION DFPM_LSVV "" /begin DEF_CHARACTERISTIC CDCLSVV CDKLSVV CDTLSVV CLALSVV FFTLSVV TSFLSVV /end DEF_CHARACTERISTIC
 /begin OUT_MEASUREMENT B_belsvv B_bklsvv B_cllsvv B_ftlsvv B_mnlsvv B_mxlsvv B_nplsvv B_silsvv E_lsvv sfplsvv TYP_lsvv Z_lsvv /end OUT_MEASUREMENT
/end FUNCTION
/begin FUNCTION DFPM_MDKOG "" /begin DEF_CHARACTERISTIC CDCMDB CDKMDB CDTMDB CLAMDB FFTMDB TSFMDB /end DEF_CHARACTERISTIC
 /begin OUT_MEASUREMENT B_bemdb B_bkmdb B_clmdb B_ftmdb B_mnmdb B_mxmdb B_npmdb B_simdb E_mdb sfpmdb TYP_mdb Z_mdb /end OUT_MEASUREMENT
/end FUNCTION
/begin FUNCTION DFPM_MINHUB ""
 /begin DEF_CHARACTERISTIC CDCMINHUB CDKMINHUB CDTMINHUB CLAMINHUB FFTMINHUB TSFMINHUB /end DEF_CHARACTERISTIC
 /begin OUT_MEASUREMENT B_beminhub B_bkminhub B_clminhub B_ftminhub B_mnminhub B_mxminhub B_npminhub B_siminhub E_minhub sfpminhub TYP_minhub Z_minhub /end OUT_MEASUREMENT
/end FUNCTION
/begin FUNCTION DFPM_MTOEL "" /begin DEF_CHARACTERISTIC CDCMTOEL CDKMTOEL CDTMTOEL CLAMTOEL FFTMTOEL TSFMTOEL /end DEF_CHARACTERISTIC
 /begin OUT_MEASUREMENT B_bemtoel B_bkmtoel B_clmtoel B_ftmtoel B_mnmtoel B_mxmtoel B_npmtoel B_simtoel E_mtoel sfpmtoel TYP_mtoel Z_mtoel /end OUT_MEASUREMENT
/end FUNCTION
/begin FUNCTION DFPM_NVRMON ""
 /begin DEF_CHARACTERISTIC CDCNVRMON CDKNVRMON CDTNVRMON CLANVRMON FFTNVRMON TSFNVRMON /end DEF_CHARACTERISTIC
 /begin OUT_MEASUREMENT B_benvrmon B_bknvrmon B_clnvrmon B_ftnvrmon B_mnnvrmon B_mxnvrmon B_npnvrmon B_sinvrmon E_nvrmon sfpnvrmon TYP_nvrmon Z_nvrmon /end OUT_MEASUREMENT
/end FUNCTION
/begin FUNCTION DFPM_SWADP ""
 /begin DEF_CHARACTERISTIC CDCDMTKNM CDCHSVSA CDCHSVSA2 CDCNWKW CDCSLVE CDKDMTKNM CDKHSVSA CDKHSVSA2 CDKNWKW CDKSLVE CDTDMTKNM CDTHSVSA CDTHSVSA2 CDTNWKW CDTSLVE CLADMTKNM CLAHSVSA CLAHSVSA2 CLANWKW CLASLVE FFTDMTKNM FFTHSVSA FFTHSVSA2 FFTNWKW FFTSLVE TSFDMTKNM TSFHSVSA TSFHSVSA2 TSFNWKW TSFSLVE /end DEF_CHARACTERISTIC
 /begin OUT_MEASUREMENT E_dmtknm E_hsvsa E_hsvsa2 E_nwkw E_slve sfpdmtknm sfphsvsa sfphsvsa2 sfpnwkw sfpslve Z_dmtknm Z_hsvsa Z_hsvsa2 Z_nwkw Z_slve /end OUT_MEASUREMENT
/end FUNCTION
/begin FUNCTION DFPM_WFS ""
 /begin DEF_CHARACTERISTIC CDCDWA CDCWCA CDCWFS CDKDWA CDKWCA CDKWFS CDTDWA CDTWCA CDTWFS CLADWA CLAWCA CLAWFS FFTDWA FFTWCA FFTWFS TSFDWA TSFWCA TSFWFS /end DEF_CHARACTERISTIC
 /begin OUT_MEASUREMENT B_bedwa B_bewca B_bewfs B_bkdwa B_bkwca B_bkwfs B_cldwa B_clwca B_clwfs B_fadwa B_fawca B_fawfs B_mndwa B_mnwca B_mnwfs B_mxdwa B_mxwca B_mxwfs B_npdwa B_npwca B_npwfs B_sidwa B_siwca B_siwfs E_dwa E_wca E_wfs sfpdwa sfpwca sfpwfs TYP_dwa TYP_wca TYP_wfs Z_dwa Z_wca Z_wfs /end OUT_MEASUREMENT
/end FUNCTION
/begin FUNCTION DFRZ "20.20     OBDII; Beschreibung 'freeze frame'" /end FUNCTION
/begin FUNCTION DFSTT "1.100     Diagnose Fullstandsgeber Tank"
 /begin DEF_CHARACTERISTIC ADVFST CWFSTD DFSKVO DFSKVOTAV DFSKVU DFSKVUTAV DKVBD DKVBDTAV SEFST SLOWRMX SOKFST TANKABN TANKMN TFSTNPW TVFSTD TVHATA TVNMOT /end DEF_CHARACTERISTIC
 /begin IN_MEASUREMENT B_cdfst B_fstcanok B_fsttsh B_fsttval B_kvta B_lowra B_nachl B_nmot B_pwf B_tav B_tfst2ok B_tfstok fstt_w kvb_w tfst_w vfzg /end IN_MEASUREMENT
 /begin OUT_MEASUREMENT B_fsttin B_fsttldv B_tank B_tankg DFSTTbits DFSTTBUFRAM sefst_w slowr_w /end OUT_MEASUREMENT
 /begin LOC_MEASUREMENT B_dfskvo B_dfskvu B_dfstav B_dtankm B_efskvo B_efskvu B_fstclr B_fstdakt B_fstini B_fstlowr B_fstsigf B_fsttab B_fsttden B_fsttzu B_kvbd B_lowra1 B_sfstres B_tankab B_tankdy B_tankend B_tankzu dfskv_w dfstigof_w dfstigo_w DFSTTlokbits DFSTTlokbits2 DFSTTlokbits3 dfstt_w dkvbigo_w dkvb_w fstakt_w fstalt_w fsthin_w fstneu_w fsttin_w kvbadd_w kvbakt_w kvbres_w /end LOC_MEASUREMENT
/end FUNCTION
/begin FUNCTION DGEN "1.70      Diagnose BSD-Generator und KL61-Bildung"
 /begin DEF_CHARACTERISTIC GENPDTIME GEN_DNMIN GFBSUTERR GFBSUTHEAL GFELTERR GFHTTERR GFHTTHEAL GFMETERR GFNOBTERR MSKGENDFP MSKGENKL61 SNMBSDKL61 /end DEF_CHARACTERISTIC
 /begin IN_MEASUREMENT B_genactiv B_genfbsd B_genfel B_genfht B_genfkupl B_genfme B_genoff B_gfbsupak B_gfelak B_gfhtak B_gfmeak B_gfnobsak B_nmot nmot_w /end IN_MEASUREMENT
 /begin OUT_MEASUREMENT B_1stbsder B_dodgen B_dodgenbs B_kl61 genfbsak genstatroh st_gen /end OUT_MEASUREMENT
 /begin LOC_MEASUREMENT dgbhealctr dgerrctr1 dgerrctr2 dgerrctr3 dgerrctr4 dgerrctr5 dghealctr en_gendiag gfehlin1 gfehlin2 gfehlin3 gfehlin4 gfehlin5 kl61loc /end LOC_MEASUREMENT
/end FUNCTION
/begin FUNCTION DGEN2 "1.10"
 /begin DEF_CHARACTERISTIC GENPDTIME2 GEN_DNMIN2 GFBSUTERR2 GFBSUTHEA2 GFELTERR2 GFHTTERR2 GFHTTHEAL2 GFMETERR2 GFNOBTERR2 MSKGE2KL61 MSKGENDFP2 SNMBS2KL61 /end DEF_CHARACTERISTIC
 /begin IN_MEASUREMENT B_genacti2 B_genfbsd2 B_genfel2 B_genfht2 B_genfkup2 B_genfme2 B_genoff2 B_gfbsupa2 B_gfelak2 B_gfhtak2 B_gfmeak2 B_gfnobsa2 B_nmot nmot_w /end IN_MEASUREMENT
 /begin OUT_MEASUREMENT B_1stbsde2 B_dodgen2 B_dodgenb2 B_kl61_2 genfbsak2 genstatro2 st_gen2 /end OUT_MEASUREMENT
 /begin LOC_MEASUREMENT dgbhealct2 dgerrctr12 dgerrctr22 dgerrctr32 dgerrctr42 dgerrctr52 dghealctr2 en_gendia2 gfehlin12 gfehlin22 gfehlin32 gfehlin42 gfehlin52 kl61loc2 /end LOC_MEASUREMENT
/end FUNCTION
/begin FUNCTION DGLFE "2.20      Diagnose; Endstufe gesteuerte Luftf¸hrung" /begin DEF_CHARACTERISTIC CWPSGLFE /end DEF_CHARACTERISTIC /begin REF_CHARACTERISTIC TVP /end REF_CHARACTERISTIC /begin IN_MEASUREMENT B_clvar B_desee B_end421 /end IN_MEASUREMENT /begin OUT_MEASUREMENT B_glfvar /end OUT_MEASUREMENT /begin LOC_MEASUREMENT B_ps421det B_ps421var dglfeLokBitsNov100ms /end LOC_MEASUREMENT /begin SUB_FUNCTION DFPM_DGLFE /end SUB_FUNCTION /end FUNCTION
/begin FUNCTION DHDMTE "1.40      Endstufendiagnose Heizung DM-TL" /begin DEF_CHARACTERISTIC CWPSDHDMTE /end DEF_CHARACTERISTIC /begin REF_CHARACTERISTIC TVP /end REF_CHARACTERISTIC /begin IN_MEASUREMENT B_cddmtl B_desee B_dmhet B_fadmtl B_hdmtl /end IN_MEASUREMENT /begin OUT_MEASUREMENT B_hdmtlp B_hdmttp dhdmteAusNvBits /end OUT_MEASUREMENT /begin SUB_FUNCTION DFPM_DHDMTE /end SUB_FUNCTION /end FUNCTION
/begin FUNCTION DHELSU "1.80      Diagnose Heizereinkopplung"
 /begin DEF_CHARACTERISTIC CWDHELSU DRLHEMX KLSDULSUMX TALASMX TVHKLSU TVHKLSUV UBDHELSUMN UBDHELSUMX ZEHK /end DEF_CHARACTERISTIC
 /begin REF_CHARACTERISTIC TAHRLSUMN TVTKLSU /end REF_CHARACTERISTIC
 /begin IN_MEASUREMENT B_cdhelsu B_evloc B_fa B_henrin B_hstlsua B_hsve B_hsve2 B_kh B_mdarv B_sls B_tal B_talval rl tahrlsu2_w tahrlsu_w tavvkm2_w tavvkm_w ua10ms2_w ua10ms_w ubsq uulsuv2_w uulsuv_w /end IN_MEASUREMENT
 /begin OUT_MEASUREMENT B_heatf B_lsurfc /end OUT_MEASUREMENT
 /begin LOC_MEASUREMENT B_helsu B_helsu2 B_sigflsu B_sigflsu2 dulsuhe2_w dulsuhe_w sdulsumx_w ub_helsu zhklsu zhklsu2 /end LOC_MEASUREMENT
/end FUNCTION
/begin FUNCTION DHFM "81.50     Diagnose; Plausibilit‰tspr¸fung HFM"
 /begin DEF_CHARACTERISTIC CW_DHFM DHFMOUMSCH DHFMUEBMN DHFMUEBMX FWMLHFMMN KFDHFMMLO KFDHFMMLU KFMLD KFMLDDKMN KFMLDDKMX KFMLDHUBMN KFMLDHUBMX MLHFMMN S_DHFMLEAN TDHFMMN TDHFMMX TDMLHFM TDMLMN TDMLMX TDMLNF TDMLST TDUBHFM UADHFMMN UADHFMMX UBHFM UNWDHFM ZKRLVWD ZMLRO /end DEF_CHARACTERISTIC
 /begin REF_CHARACTERISTIC KFDKMS KFEHUBIV KLDPIPOL MLOFS PMAX1013 /end REF_CHARACTERISTIC
 /begin IN_MEASUREMENT Btvdpsrlvw B_edks B_iwfalse B_iwfalse2 B_stend B_vvtnotl dps_w evhubin2_w evhubin_w evhubi_w fho_w mlhfmm_w nmot_w rlvw_w ub uhfm_w umsrln_w uzkw_w wdkba_w /end IN_MEASUREMENT
 /begin OUT_MEASUREMENT B_ehfm B_ehfm1 B_ehfs B_elmi B_hfm fwmlhfm mlddk_w mldmn2_w mldmx2_w mlhfmf_w rldhfmmn_w rldhfmmx_w rlvwdf_w rlvwd_w /end OUT_MEASUREMENT
 /begin LOC_MEASUREMENT B_initmxmn B_mnhfm B_mxhfm dhfmmlo_w dhfmmlu_w dhfmrlvwo dpipdhfm_w dpspmax_w evhubimldm evhubimldn mlddkdps_w mlddkmn mlddkmx mldhfm_w mldhubmn mldhubmx mldmn_w mldmx_w mldvvt1_w mldvvt2_w mldvvt_w wdkba_mldm wdkba_mldn /end LOC_MEASUREMENT
/end FUNCTION
/begin FUNCTION DHLSHK "6.10      Diagnose Sondenheizung hinter Kat"
 /begin DEF_CHARACTERISTIC CWDHLSH FRINH1 FRINH2 KFRINH KFRINH2 TABSTHLSH TADHMNH TADHMXH TANSDHLSH TASOH TVFHSH TVHSHEE TVHSHRI TVHSHRIHEL TVHSHRIZ TVRIHEE UBDHLSHMN UBDHLSHMX UHDMNH UHDMXH ZKARIH1 ZKARIH2 ZKPRIH /end DEF_CHARACTERISTIC
 /begin IN_MEASUREMENT B_atmst B_atmst2 B_bvhls B_cdhsh B_cdhshe B_hshe B_hshe2 B_lsh B_lsh2 B_nmot B_rinh B_rinh2 B_risigh B_risigh2 B_sa B_stend msabnhk2_w msabnhk_w phlsnh phlsnh2 rinh2_w rinh_w tabst_w tahso2_w tahso_w tans ubsq_w uhsh uhsh2 /end IN_MEASUREMENT
 /begin LOC_MEASUREMENT B_enh B_enh2 B_enhsh B_hehshe B_hehshe2 B_hsokh B_hsokh2 B_mnfhsh B_mnfhsh2 B_mxfhsh B_mxfhsh2 B_npfhsh B_npfhsh2 B_rierrh B_rierrh2 B_sifhsh B_sifhsh2 phlsnhf phlsnhf2 rinkfh rinkfh2 rinsh2_w rinsh_w tahsomf2_w tahsomf_w /end LOC_MEASUREMENT
/end FUNCTION
/begin FUNCTION DHRLSU "3.110     Diagnose Heizungsregelung LSU"
 /begin DEF_CHARACTERISTIC ATMRWT CWDHRLSU KLTKERDCMN KRIVKMX RINLSUPMN TABSTHLSU TAIKRLSUMN TEHEHRLSU TEHRF TEHRFMN TEHRLSUE TEHRLSUZMX TKERLSUDMN TMDHRSTMX TVENMX TVFAHRLSU TVLSUBB TVZHRNOT TWHRLSUZMX TWHRSTMX TWVDCMN TWVSOMOS UBHRLSUMN UBHRLSUMX ZATMRW /end DEF_CHARACTERISTIC
 /begin REF_CHARACTERISTIC TKERLSUS /end REF_CHARACTERISTIC
 /begin IN_MEASUREMENT B_atmng B_atmst B_atmtpa B_atmtpa2 B_cdhrlsu B_ehsve B_ehsve2 B_eiclsu B_eiclsu2 B_elsuwi B_elsuwi2 B_eshlsu B_eshlsu2 B_evloc B_fa B_henrin B_henrin2 B_hlsumx B_hlsumx2 B_hrlsaus B_hsv B_hsv2 B_mdarv B_nmot B_sa B_stend krivk2_w krivk_w msabg2_w msabg_w rinlsu2_w rinlsu_w tabst_w tahrlsu2_w tahrlsu_w tavso2_w tavso_w tkerlsu2_w tkerlsu_w tmst ubsq /end IN_MEASUREMENT
 /begin OUT_MEASUREMENT B_ehlsu B_ehlsu2 B_ricalf B_ricalf2 B_rinnp B_rinnp2 B_zhhrlsu B_zhhrlsu2 DHRLSUausbits1 /end OUT_MEASUREMENT
 /begin LOC_MEASUREMENT B_enmx B_enmx2 B_hrlsunp B_hrlsunp2 B_spdhrub B_tahrmn B_tahrmn2 B_tahrmx B_tahrmx2 B_zhrnot B_zhrnot2 DHRLSUlokbits1 DHRLSUlokbits1_2 tkerdcmn_w twvsom2_w twvsom_w ub_hsv zatmwvs2_w zatmwvs_w /end LOC_MEASUREMENT
/end FUNCTION
/begin COMPU_METHOD B_TRUE "boolsche Zust‰nde, positive Logik" TAB_VERB "%6.3" "" COMPU_TAB_REF B_TRUE /end COMPU_METHOD
/begin COMPU_VTAB B_TRUE "boolsche Zust‰nde, positive Logik" TAB_VERB 2 0 "----" 1 "TRUE" /end COMPU_VTAB
/begin COMPU_METHOD DEZ "1 : 1 Umrechnug (dez/hex)" RAT_FUNC "%6.2" "" COEFFS 0 1 0 0 0 1 /end COMPU_METHOD
/begin COMPU_METHOD dez "1 : 1 Umrechnug (dez/hex)" RAT_FUNC "%6.2" "" COEFFS 0 1 0 0 0 1 /end COMPU_METHOD
/begin COMPU_METHOD fak_ub_b64 "" RAT_FUNC "%6.3" "-" COEFFS 0 256 0 0 0 64 /end COMPU_METHOD
/begin COMPU_METHOD fak_ub_q0p01 "" RAT_FUNC "%6.4" "-" COEFFS 0 1 0 0 0 0.01 /end COMPU_METHOD
/begin COMPU_METHOD fak_uw_b1 "" RAT_FUNC "%7.6" "-" COEFFS 0 65536 0 0 0 1 /end COMPU_METHOD
/begin COMPU_METHOD fak_uw_b2 "" RAT_FUNC "%7.6" "-" COEFFS 0 65536 0 0 0 2 /end COMPU_METHOD
/begin COMPU_METHOD fak_uw_b4 "" RAT_FUNC "%7.6" "-" COEFFS 0 65536 0 0 0 4 /end COMPU_METHOD
/begin COMPU_METHOD hub_uw_q0p001 "" RAT_FUNC "%6.5" "mm" COEFFS 0 1000 0 0 0 1 /end COMPU_METHOD
/begin COMPU_METHOD m_q0p1 "" RAT_FUNC "%6.3" "kg/h" COEFFS 0 10 0 0 0 1 /end COMPU_METHOD
/begin COMPU_METHOD m_uw_b6553p5 "" RAT_FUNC "%6.3" "kg/h" COEFFS 0 1 0 0 0 0.1 /end COMPU_METHOD
/begin COMPU_METHOD nmot_uw_q0p25 "" RAT_FUNC "%6.3" "1/min" COEFFS 0 1 0 0 0 0.25 /end COMPU_METHOD
/begin COMPU_METHOD relDK_q0p02441 "" RAT_FUNC "%6.4" "%DK" COEFFS 0 65536 0 0 0 1600 /end COMPU_METHOD
/begin COMPU_METHOD rel_ub_q0p75 "" RAT_FUNC "%6.3" "%" COEFFS 0 1 0 0 0 0.75 /end COMPU_METHOD
/begin COMPU_METHOD rel_uw_q0p0234 "" RAT_FUNC "%6.4" "%" COEFFS 0 32 0 0 0 0.75 /end COMPU_METHOD
/begin COMPU_METHOD r_q0p0391 "" RAT_FUNC "%6.4" "Ohm" COEFFS 0 65536 0 0 0 2560 /end COMPU_METHOD
/begin COMPU_METHOD r_q8 "" RAT_FUNC "%6.2" "Ohm" COEFFS 0 1 0 0 0 8 /end COMPU_METHOD
/begin COMPU_METHOD r_uw_q2 "" RAT_FUNC "%6.2" "Ohm" COEFFS 0 1 0 0 0 2 /end COMPU_METHOD
/begin COMPU_METHOD spg_q0p00039 "" RAT_FUNC "%6.5" "V" COEFFS 0 1 0 0 0 0.000390625 /end COMPU_METHOD
/begin COMPU_METHOD spg_q0p1 "" RAT_FUNC "%6.3" "V" COEFFS 0 1 0 0 0 0.1 /end COMPU_METHOD
/begin COMPU_METHOD spg_ubatt "" RAT_FUNC "%6.3" "V" COEFFS 0 1 0 0 0 0.0942 /end COMPU_METHOD
/begin COMPU_METHOD spg_ub_b5 "" RAT_FUNC "%6.4" "V" COEFFS 0 256 0 0 0 5 /end COMPU_METHOD
/begin COMPU_METHOD spg_ub_q0p019 "" RAT_FUNC "%6.4" "V" COEFFS 0 256 0 0 0 5 /end COMPU_METHOD
/begin COMPU_METHOD spg_uw_b5 "" RAT_FUNC "%6.4" "V" COEFFS 0 1024 0 0 0 5 /end COMPU_METHOD
/begin COMPU_METHOD s_q0p02777_m "" RAT_FUNC "%6.4" "m" COEFFS 0 36 0 0 0 1 /end COMPU_METHOD
/begin COMPU_METHOD s_q0p34722_m "" RAT_FUNC "%6.3" "m" COEFFS 0 3600 0 0 0 1250 /end COMPU_METHOD
/begin COMPU_METHOD t100msxs_ub_b25p5 "" RAT_FUNC "%6.3" "s" COEFFS 0 1 0 0 0 0.1 /end COMPU_METHOD
/begin COMPU_METHOD t100msxs_uw_b6553p5 "" RAT_FUNC "%6.3" "s" COEFFS 0 1 0 0 0 0.1 /end COMPU_METHOD
/begin COMPU_METHOD t10msxs_ub_b2p55 "" RAT_FUNC "%6.4" "s" COEFFS 0 1 0 0 0 0.01 /end COMPU_METHOD
/begin COMPU_METHOD t1sxs_ub_b255 "" RAT_FUNC "%6.2" "s" COEFFS 0 1 0 0 0 1 /end COMPU_METHOD
/begin COMPU_METHOD t1sxs_uw_b65535 "" RAT_FUNC "%6.2" "s" COEFFS 0 1 0 0 0 1 /end COMPU_METHOD
/begin COMPU_METHOD t1sxs_uw_q1 "" RAT_FUNC "%6.2" "s" COEFFS 0 1 0 0 0 1 /end COMPU_METHOD
/begin COMPU_METHOD t50msxs_ub_b12p75 "" RAT_FUNC "%6.4" "s" COEFFS 0 1 0 0 0 0.05 /end COMPU_METHOD
/begin COMPU_METHOD temp_q0p0234 "" RAT_FUNC "%6.4" "K" COEFFS 0 256 0 0 0 6 /end COMPU_METHOD
/begin COMPU_METHOD temp_q0p0234_o273 "" RAT_FUNC "%6.1" "Grad C" COEFFS 0 1 273.15 0 0 0.0234375 /end COMPU_METHOD
/begin COMPU_METHOD temp_ub_q0p75_o48 "" RAT_FUNC "%6.2" "Grad C" COEFFS 0 1 48 0 0 0.75 /end COMPU_METHOD
/begin COMPU_METHOD vol_q0p1_l "" RAT_FUNC "%6.3" "l" COEFFS 0 1 0 0 0 0.1 /end COMPU_METHOD
/begin COMPU_METHOD vol_q3p90625Em3_l "" RAT_FUNC "%6.4" "l" COEFFS 0 65536 0 0 0 256 /end COMPU_METHOD
/begin COMPU_METHOD zk100msxs_uw_b6553 "" RAT_FUNC "%6.1" "s" COEFFS 0 0 65536 0 10 0 /end COMPU_METHOD
/begin COMPU_METHOD zk10msxs_ub_b2p55 "" RAT_FUNC "%6.4" "s" COEFFS 0 0 255 0 100 0 /end COMPU_METHOD
/begin COMPU_METHOD zk10msxs_uw_b655 "" RAT_FUNC "%6.2" "s" COEFFS 0 0 65536 0 100 0 /end COMPU_METHOD
/begin COMPU_METHOD zk200msxs_uw_b13107 "" RAT_FUNC "%6.0" "s" COEFFS 0 0 13107 0 1 0 /end COMPU_METHOD
/begin COMPU_METHOD default "" RAT_FUNC "%6.2" "" COEFFS 0 1 0 0 0 1 /end COMPU_METHOD
/begin RECORD_LAYOUT KfAxUbAyUbSstxUwSstyUbWUb NO_AXIS_PTS_X 1 UBYTE NO_AXIS_PTS_Y 2 UBYTE AXIS_PTS_X 3 UWORD INDEX_INCR DIRECT AXIS_PTS_Y 4 UBYTE INDEX_INCR DIRECT FNC_VALUES 5 UBYTE COLUMN_DIR DIRECT /end RECORD_LAYOUT
/begin RECORD_LAYOUT KfAxUwAyUwSstxSwSstyUwWUw NO_AXIS_PTS_X 1 UWORD NO_AXIS_PTS_Y 2 UWORD AXIS_PTS_X 3 SWORD INDEX_INCR DIRECT AXIS_PTS_Y 4 UWORD INDEX_INCR DIRECT FNC_VALUES 5 UWORD COLUMN_DIR DIRECT /end RECORD_LAYOUT
/begin RECORD_LAYOUT KfAxUwAyUwSstxUwSstyUwWUw NO_AXIS_PTS_X 1 UWORD NO_AXIS_PTS_Y 2 UWORD AXIS_PTS_X 3 UWORD INDEX_INCR DIRECT AXIS_PTS_Y 4 UWORD INDEX_INCR DIRECT FNC_VALUES 5 UWORD COLUMN_DIR DIRECT /end RECORD_LAYOUT
/begin RECORD_LAYOUT KlAUbSstUbWUw NO_AXIS_PTS_X 1 UBYTE AXIS_PTS_X 2 UBYTE INDEX_INCR DIRECT FNC_VALUES 3 UWORD COLUMN_DIR DIRECT /end RECORD_LAYOUT
/begin RECORD_LAYOUT KlAUbSstUwWUb NO_AXIS_PTS_X 1 UBYTE AXIS_PTS_X 2 UWORD INDEX_INCR DIRECT FNC_VALUES 3 UBYTE COLUMN_DIR DIRECT /end RECORD_LAYOUT
/begin RECORD_LAYOUT KlAUbSstUwWUw NO_AXIS_PTS_X 1 UWORD AXIS_PTS_X 2 UWORD INDEX_INCR DIRECT FNC_VALUES 3 UWORD COLUMN_DIR DIRECT /end RECORD_LAYOUT
/begin RECORD_LAYOUT KlAUwSstUwWUw NO_AXIS_PTS_X 1 UWORD AXIS_PTS_X 2 UWORD INDEX_INCR DIRECT FNC_VALUES 3 UWORD COLUMN_DIR DIRECT /end RECORD_LAYOUT
/begin RECORD_LAYOUT KwbUb FNC_VALUES 1 UBYTE COLUMN_DIR DIRECT /end RECORD_LAYOUT
/begin RECORD_LAYOUT KwbUw FNC_VALUES 1 UWORD COLUMN_DIR DIRECT /end RECORD_LAYOUT
/begin RECORD_LAYOUT KwbWU16 FNC_VALUES 1 UWORD COLUMN_DIR DIRECT /end RECORD_LAYOUT
/begin RECORD_LAYOUT KwbWU8 FNC_VALUES 1 UBYTE COLUMN_DIR DIRECT /end RECORD_LAYOUT
/begin RECORD_LAYOUT KwSw FNC_VALUES 1 SWORD COLUMN_DIR DIRECT /end RECORD_LAYOUT
/begin RECORD_LAYOUT KwUb FNC_VALUES 1 UBYTE COLUMN_DIR DIRECT /end RECORD_LAYOUT
/begin RECORD_LAYOUT KwUw FNC_VALUES 1 UWORD COLUMN_DIR DIRECT /end RECORD_LAYOUT
/begin RECORD_LAYOUT KwWU16 FNC_VALUES 1 UWORD COLUMN_DIR DIRECT /end RECORD_LAYOUT
/begin RECORD_LAYOUT KwWU8 FNC_VALUES 1 UBYTE COLUMN_DIR DIRECT /end RECORD_LAYOUT
/end MODULE
/end PROJECT
