ASAP2_VERSION 1 41
/begin PROJECT MSD85 "Spray Guided DI-System with Piezo Injectors for 8-Cylinder"
/begin HEADER "_default_HeaderComment" PROJECT_NO _91 /end HEADER
/begin MODULE _default_ModuleName "_default_ModuleLongIdentifier"
/begin MOD_COMMON "_default_ModCommonComment" DEPOSIT ABSOLUTE BYTE_ORDER MSB_LAST ALIGNMENT_BYTE 1 ALIGNMENT_WORD 2 ALIGNMENT_LONG 2 ALIGNMENT_FLOAT32_IEEE 2 ALIGNMENT_FLOAT64_IEEE 4 /end MOD_COMMON
/begin AXIS_PTS ldpm_n_32_ls_up_dyn "" 0xa0800fa4 n_32 _REC_AXS_20_u1 8160. _CNV_A_R_LINEAR_____10_CM 8 0. 8160. FORMAT "%4.0" /end AXIS_PTS
/begin AXIS_PTS ldpm_maf_hb_ls_up_dyn "" 0xa0800f64 maf_hb _REC_AXS_20_u1 1389. _CNV_A_R_LINEAR_____15_CM 8 0. 1389. FORMAT "%4.0" /end AXIS_PTS
/begin MEASUREMENT egcp[0].egcp_struct_sigcvridi0.lv_inh_r_it_ls_down "Boolean flag indicating that downstream sensor internal resistance determination shall be inhibited when set" UBYTE _CNV_S_2_RANGE__0___1_CM 1 100. 0. 1. DISPLAY_IDENTIFIER LV_INH_R_IT_LS_DOWN[1] ECU_ADDRESS 0xd0005748 BIT_MASK 0x1 /end MEASUREMENT
/begin MEASUREMENT egcp[0].egcp_struct_sigdglsdi2.lv_inh_diag_swt_ls_down "Flag indicating inhibition of lambda sensor switching time diagnosis downstream" UBYTE _CNV_S_2_RANGE__0___1_CM 1 100. 0. 1. DISPLAY_IDENTIFIER LV_INH_DIAG_SWT_LS_DOWN[1] ECU_ADDRESS 0xd00057f8 BIT_MASK 0x1 /end MEASUREMENT
/begin MEASUREMENT egcp[0].egcp_struct_sigdglsdi2.lv_inh_diag_rbm_swt_ls_down "Flag indicating inhibition of RBM for lambda sensor switching time diagnosis downstream" UBYTE _CNV_S_2_RANGE__0___1_CM 1 100. 0. 1. DISPLAY_IDENTIFIER LV_INH_DIAG_RBM_SWT_LS_DOWN[1] ECU_ADDRESS 0xd00057f9 BIT_MASK 0x1 /end MEASUREMENT
/begin MEASUREMENT egcp[0].egcp_struct_sigdglsdi2.lv_inh_diag_pue_ls_down "Flag indicating inhibition of lambda sensor PUC-end diagnosis downstream" UBYTE _CNV_S_2_RANGE__0___1_CM 1 100. 0. 1. DISPLAY_IDENTIFIER LV_INH_DIAG_PUE_LS_DOWN[1] ECU_ADDRESS 0xd00057fa BIT_MASK 0x1 /end MEASUREMENT
/begin MEASUREMENT egcp[0].egcp_struct_sigdglsdi2.state_rbm_swt_ls_down "Interface of SWT_LS_DOWN monitor with the Rate Based Monitoring statistics" UBYTE _CNV_A_R_LINEAR_____0_CM 1 100. 0. 255. DISPLAY_IDENTIFIER STATE_RBM_SWT_LS_DOWN[1] ECU_ADDRESS 0xd00057fb FORMAT "%3.0" /end MEASUREMENT
/begin MEASUREMENT egcp[0].egcp_struct_sigdglsdi2.lv_inh_diag_tmp_ls_down "Flag indicating inhibition for PUE_ and SWT_LS_DOWN" UBYTE _CNV_S_2_RANGE__0___1_CM 1 100. 0. 1. DISPLAY_IDENTIFIER LV_INH_DIAG_TMP_LS_DOWN[1] ECU_ADDRESS 0xd00057fc BIT_MASK 0x1 /end MEASUREMENT
/begin MEASUREMENT egcp[0].egcp_struct_fctdglslhi0.lv_inh_diag_obd_lsh_up "Boolean inhibit flag for O2 sensor heater OBDII monitoring" UBYTE _CNV_S_2_RANGE__0___1_CM 1 100. 0. 1. DISPLAY_IDENTIFIER LV_INH_DIAG_OBD_LSH_UP[1] ECU_ADDRESS 0xd00057fe BIT_MASK 0x1 /end MEASUREMENT
/begin MEASUREMENT egcp[0].egcp_struct_fctdglslhi0.state_rbm_obd_vld_lsh_up "Interface of OBD_VLD_LSH_UP[NC_CBK_EX_NR] monitor with the Rate-Based Monitoring statistics" UBYTE _CNV_A_R_LINEAR_____0_CM 1 100. 0. 255. DISPLAY_IDENTIFIER STATE_RBM_OBD_VLD_LSH_UP[1] ECU_ADDRESS 0xd00057ff FORMAT "%3.0" /end MEASUREMENT
/begin MEASUREMENT egcp[0].egcp_struct_fctdglslhi0.lv_inh_diag_rbm_obd_lsh_up "Boolean inhibit flag for Rate Based Monitoring of O2 sensor heater OBDII diagnosis" UBYTE _CNV_S_2_RANGE__0___1_CM 1 100. 0. 1. DISPLAY_IDENTIFIER LV_INH_DIAG_RBM_OBD_LSH_UP[1] ECU_ADDRESS 0xd0005800 BIT_MASK 0x1 /end MEASUREMENT
/begin MEASUREMENT egcp[0].egcp_struct_pladglsli1.lv_diag_act_inh_ls_up_down "general inhibition Oxygen Sensor Active Plausibility Check" UBYTE _CNV_S_2_RANGE__0___1_CM 1 100. 0. 1. DISPLAY_IDENTIFIER LV_DIAG_ACT_INH_LS_UP_DOWN[1] ECU_ADDRESS 0xd0005802 BIT_MASK 0x1 /end MEASUREMENT
/begin MEASUREMENT egcp[0].egcp_struct_pladglsli1.lv_diag_afr_afl_inh_ls_up_down "Inhibition of open loop diag while interferring functions are deactivated in failure case" UBYTE _CNV_S_2_RANGE__0___1_CM 1 100. 0. 1. DISPLAY_IDENTIFIER LV_DIAG_AFR_AFL_INH_LS_UP_DOWN[1] ECU_ADDRESS 0xd0005803 BIT_MASK 0x1 /end MEASUREMENT
/begin MEASUREMENT egcp[0].egcp_struct_pladglsli1.lv_diag_eol_req_ls_up_down "Start EOL active test " UBYTE _CNV_S_2_RANGE__0___1_CM 1 100. 0. 1. DISPLAY_IDENTIFIER LV_DIAG_EOL_REQ_LS_UP_DOWN[1] ECU_ADDRESS 0xd0005804 BIT_MASK 0x1 /end MEASUREMENT
/begin MEASUREMENT egcp[0].egcp_struct_pladglsli1.lv_diag_opl_req_cbk "request open loop diagnosis" UBYTE _CNV_S_2_RANGE__0___1_CM 1 100. 0. 1. DISPLAY_IDENTIFIER LV_DIAG_OPL_REQ_CBK[1] ECU_ADDRESS 0xd0005805 BIT_MASK 0x1 /end MEASUREMENT
/begin MEASUREMENT egcp[0].egcp_struct_pladglsli1.lv_diag_act_inh_rbm_ls_up_down "Inhibit- flag for RBM for Oxygen Sensor Active Plausibility Check" UBYTE _CNV_S_2_RANGE__0___1_CM 1 100. 0. 1. DISPLAY_IDENTIFIER LV_DIAG_ACT_INH_RBM_LS_UP_DOWN[1] ECU_ADDRESS 0xd0005806 BIT_MASK 0x1 /end MEASUREMENT
/begin MEASUREMENT egcp[0].egcp_struct_sigdglsl3.lamb_delta_rise_lpf "Mean value for heater coupling (rising edge)" SWORD _CNV_A_R_LINEAR_____24_CM 1 100. -2. 1.99993896484375 DISPLAY_IDENTIFIER LAMB_DELTA_RISE_LPF[1] ECU_ADDRESS 0xd0005808 FORMAT "%8.5" /end MEASUREMENT
/begin MEASUREMENT egcp[0].egcp_struct_sigdglsl3.lamb_delta_fall_lpf "Mean value for heater coupling (falling edge)" SWORD _CNV_A_R_LINEAR_____24_CM 1 100. -2. 1.99993896484375 DISPLAY_IDENTIFIER LAMB_DELTA_FALL_LPF[1] ECU_ADDRESS 0xd000580a FORMAT "%8.5" /end MEASUREMENT
/begin MEASUREMENT egcp[0].egcp_struct_sigdglsl3.lamb_syn_lshpwm_fall "Lambda value acquied after lshpwm signal falling edge" UWORD _CNV_A_R_LINEAR_____24_CM 1 100. 0. 1.99993896484375 DISPLAY_IDENTIFIER LAMB_SYN_LSHPWM_FALL[1] ECU_ADDRESS 0xd000580c FORMAT "%7.5" /end MEASUREMENT
/begin MEASUREMENT egcp[0].egcp_struct_sigdglsl3.lamb_syn_lshpwm_rise "Lambda value acquied after lshpwm signal rising edge" UWORD _CNV_A_R_LINEAR_____24_CM 1 100. 0. 1.99993896484375 DISPLAY_IDENTIFIER LAMB_SYN_LSHPWM_RISE[1] ECU_ADDRESS 0xd000580e FORMAT "%7.5" /end MEASUREMENT
/begin MEASUREMENT egcp[0].egcp_struct_sigdglsl3.lamb_delta_rise "Variation of lambda value before and after lshpwm signal rising edge" SWORD _CNV_A_R_LINEAR_____24_CM 1 100. -2. 1.99993896484375 DISPLAY_IDENTIFIER LAMB_DELTA_RISE[1] ECU_ADDRESS 0xd0005810 FORMAT "%8.5" /end MEASUREMENT
/begin MEASUREMENT egcp[0].egcp_struct_sigdglsl3.lamb_delta_fall "Variation of lambda value before and after lshpwm signal falling edge" SWORD _CNV_A_R_LINEAR_____24_CM 1 100. -2. 1.99993896484375 DISPLAY_IDENTIFIER LAMB_DELTA_FALL[1] ECU_ADDRESS 0xd0005812 FORMAT "%8.5" /end MEASUREMENT
/begin MEASUREMENT egcp[0].egcp_struct_sigdglsl3.ctr_sym_diag_lsh_lsl_up "Counter of forced stimulation periods with a present symptom" UBYTE _CNV_A_R_LINEAR_____0_CM 1 100. 0. 255. DISPLAY_IDENTIFIER CTR_SYM_DIAG_LSH_LSL_UP[1] ECU_ADDRESS 0xd0005814 FORMAT "%3.0" /end MEASUREMENT
/begin MEASUREMENT egcp[0].egcp_struct_sigdglsl3.cycnr_diag_lsh_lsl_up "Counter of forced stimulation periods investigated" UBYTE _CNV_A_R_LINEAR_____0_CM 1 100. 0. 255. DISPLAY_IDENTIFIER CYCNR_DIAG_LSH_LSL_UP[1] ECU_ADDRESS 0xd0005815 FORMAT "%3.0" /end MEASUREMENT
/begin MEASUREMENT egcp[0].egcp_struct_sigdglsl3.t_dly_trig_lsh_up "Time delay for acquisition of oxygen sensor signal and lambda model" UBYTE _CNV_A_R_EGCP_LINEA_344_CM 1 100. 0. 0.255 DISPLAY_IDENTIFIER T_DLY_TRIG_LSH_UP[1] ECU_ADDRESS 0xd0005816 FORMAT "%5.3" /end MEASUREMENT
/begin MEASUREMENT egcp[0].egcp_struct_sigdglsli3.lv_inh_diag_lsh_lsl_up "Deactivation of \"Diagnosis of the Heater Coupling in the Sensor Signal\"" UBYTE _CNV_S_2_RANGE__0___1_CM 1 100. 0. 1. DISPLAY_IDENTIFIER LV_INH_DIAG_LSH_LSL_UP[1] ECU_ADDRESS 0xd0005818 BIT_MASK 0x1 /end MEASUREMENT
/begin MEASUREMENT egcp[0].egcp_struct_pladgls0.maf_sym_raw_plaus_lsl_up "MAF integral for the plausibility symptom (compensation of the catalyst delay)" UWORD _CNV_A_R_LINEAR_____287_CM 1 100. 0. 1820.41666666667 DISPLAY_IDENTIFIER MAF_SYM_RAW_PLAUS_LSL_UP[1] ECU_ADDRESS 0xd0005864 FORMAT "%7.2" /end MEASUREMENT
/begin MEASUREMENT egcp[0].egcp_struct_pladgls0.maf_sym_plaus_lsl_up "MAF integral for detection of mutual not plausible sensor signals" UWORD _CNV_A_R_LINEAR_____287_CM 1 100. 0. 1820.41666666667 DISPLAY_IDENTIFIER MAF_SYM_PLAUS_LSL_UP[1] ECU_ADDRESS 0xd0005866 FORMAT "%7.2" /end MEASUREMENT
/begin MEASUREMENT egcp[0].egcp_struct_pladgls0.maf_end_plaus_lsl_up "MAF integral for valid diagnostic result" UWORD _CNV_A_R_LINEAR_____287_CM 1 100. 0. 1820.41666666667 DISPLAY_IDENTIFIER MAF_END_PLAUS_LSL_UP[1] ECU_ADDRESS 0xd0005868 FORMAT "%7.2" /end MEASUREMENT
/begin MEASUREMENT egcp[0].egcp_struct_pladgls0.state_sym_diag_plaus_lsl_up "Oxygen Sensor Plausibility Check Symptom " UBYTE _CNV_S_5_EGCP_RANGE_338_CM 1 100. 0. 8. DISPLAY_IDENTIFIER STATE_SYM_DIAG_PLAUS_LSL_UP[1] ECU_ADDRESS 0xd000586a /end MEASUREMENT
/begin MEASUREMENT egcp[0].egcp_struct_pladgls0.lv_diag_plaus_sym_lsl_up "Debounced diagnosis result of the signal plausibility for the wide range A/F sensor" UBYTE _CNV_S_2_RANGE__0___1_CM 1 100. 0. 1. DISPLAY_IDENTIFIER LV_DIAG_PLAUS_SYM_LSL_UP[1] ECU_ADDRESS 0xd000586b BIT_MASK 0x1 /end MEASUREMENT
/begin MEASUREMENT egcp[0].egcp_struct_pladgls0.lv_diag_cdn_plaus_lsl_up "Oxygen Sensor Plausibility Check condition" UBYTE _CNV_S_2_RANGE__0___1_CM 1 100. 0. 1. DISPLAY_IDENTIFIER LV_DIAG_CDN_PLAUS_LSL_UP[1] ECU_ADDRESS 0xd000586c BIT_MASK 0x1 /end MEASUREMENT
/begin MEASUREMENT egcp[0].egcp_struct_pladgls0.lv_diag_plaus_end_lsl_up "Oxygen Sensor Plausibility Check result available " UBYTE _CNV_S_2_RANGE__0___1_CM 1 100. 0. 1. DISPLAY_IDENTIFIER LV_DIAG_PLAUS_END_LSL_UP[1] ECU_ADDRESS 0xd000586d BIT_MASK 0x1 /end MEASUREMENT
/begin MEASUREMENT egcp[0].egcp_struct_pladgls0.lv_diag_afr_sym_plaus_lsl_up "Oxygen Sensor Plausibility Check - not debounced symptom \"SENS_AFR\"  " UBYTE _CNV_S_2_RANGE__0___1_CM 1 100. 0. 1. DISPLAY_IDENTIFIER LV_DIAG_AFR_SYM_PLAUS_LSL_UP[1] ECU_ADDRESS 0xd000586e BIT_MASK 0x1 /end MEASUREMENT
/begin MEASUREMENT egcp[0].egcp_struct_pladgls0.lv_diag_afl_sym_plaus_lsl_up "Oxygen Sensor Plausibility Check - not debounced symptom -SENS_AFL-" UBYTE _CNV_S_2_RANGE__0___1_CM 1 100. 0. 1. DISPLAY_IDENTIFIER LV_DIAG_AFL_SYM_PLAUS_LSL_UP[1] ECU_ADDRESS 0xd000586f BIT_MASK 0x1 /end MEASUREMENT
/begin MEASUREMENT egcp[0].egcp_struct_pladglsl0.lamb_lpf_diag_dyn_lsl_up "Lambda value filtered with a Low Pass Filter" UWORD _CNV_A_R_LINEAR_____129_CM 1 100. 0. 31.9990234375 DISPLAY_IDENTIFIER LAMB_LPF_DIAG_DYN_LSL_UP[1] ECU_ADDRESS 0xd0005870 FORMAT "%7.4" /end MEASUREMENT
/begin MEASUREMENT egcp[0].egcp_struct_pladglsl0.lamb_min_diag_dyn_lsl_up "Minimum value of the lambda sensor signal (per sample period)" UWORD _CNV_A_R_LINEAR_____129_CM 1 100. 0. 31.9990234375 DISPLAY_IDENTIFIER LAMB_MIN_DIAG_DYN_LSL_UP[1] ECU_ADDRESS 0xd0005872 FORMAT "%7.4" /end MEASUREMENT
/begin MEASUREMENT egcp[0].egcp_struct_pladglsl0.lamb_max_diag_dyn_lsl_up "Maximum value of the lambda sensor signal (per sample period)" UWORD _CNV_A_R_LINEAR_____129_CM 1 100. 0. 31.9990234375 DISPLAY_IDENTIFIER LAMB_MAX_DIAG_DYN_LSL_UP[1] ECU_ADDRESS 0xd0005874 FORMAT "%7.4" /end MEASUREMENT
/begin MEASUREMENT egcp[0].egcp_struct_pladglsl0.lamb_ampl_int_diag_dyn_lsl_up "Integral over carried out single sensor signal amplitude measurement" UWORD _CNV_A_R_LINEAR_____129_CM 1 100. 0. 31.9990234375 DISPLAY_IDENTIFIER LAMB_AMPL_INT_DIAG_DYN_LSL_UP[1] ECU_ADDRESS 0xd0005876 FORMAT "%7.4" /end MEASUREMENT
/begin MEASUREMENT egcp[0].egcp_struct_pladglsl0.fac_value_diag_dyn_lsl_up "Normalised single sensor signal amplitude " UWORD _CNV_A_R_LINEAR_____129_CM 1 100. 0. 31.9990234375 DISPLAY_IDENTIFIER FAC_VALUE_DIAG_DYN_LSL_UP[1] ECU_ADDRESS 0xd0005878 FORMAT "%7.4" /end MEASUREMENT
/begin MEASUREMENT egcp[0].egcp_struct_pladglsl0.fac_sum_diag_dyn_lsl_up "Summation over all normalised single sensor signal amplitude" UWORD _CNV_A_R_EGCP_LINEA_316_CM 1 100. 0. 63.999023 DISPLAY_IDENTIFIER FAC_SUM_DIAG_DYN_LSL_UP[1] ECU_ADDRESS 0xd000587a FORMAT "%7.4" /end MEASUREMENT
/begin MEASUREMENT egcp[0].egcp_struct_pladglsl0.fac_mv_diag_dyn_lsl_up "Mean value of normalised single sensor signal amplitude" UWORD _CNV_A_R_LINEAR_____129_CM 1 100. 0. 31.9990234375 DISPLAY_IDENTIFIER FAC_MV_DIAG_DYN_LSL_UP[1] ECU_ADDRESS 0xd000587c FORMAT "%7.4" /end MEASUREMENT
/begin MEASUREMENT egcp[0].egcp_struct_pladglsl0.fac_diag_dyn_lsl_up "Adaption factor to the modeled sensor time constant" UWORD _CNV_A_R_LINEAR_____129_CM 1 100. 0. 31.9990234375 DISPLAY_IDENTIFIER FAC_DIAG_DYN_LSL_UP[1] ECU_ADDRESS 0xd000587e FORMAT "%7.4" /end MEASUREMENT
/begin MEASUREMENT egcp[0].egcp_struct_pladglsl0.t_dyn_diag_afl "Timer for maximum amplitude measurement duration after LV_AFL 0 -> 1" UWORD _CNV_A_R_LINEAR_____110_CM 1 100. 0. 1310.7 DISPLAY_IDENTIFIER T_DYN_DIAG_AFL[1] ECU_ADDRESS 0xd0005880 FORMAT "%7.2" /end MEASUREMENT
/begin MEASUREMENT egcp[0].egcp_struct_pladglsl0.t_dyn_diag_afr "Timer for maximum amplitude measurement duration after LV_AFL 1 -> 0" UWORD _CNV_A_R_LINEAR_____110_CM 1 100. 0. 1310.7 DISPLAY_IDENTIFIER T_DYN_DIAG_AFR[1] ECU_ADDRESS 0xd0005882 FORMAT "%7.2" /end MEASUREMENT
/begin MEASUREMENT egcp[0].egcp_struct_pladglsl0.lamb_ampl_diag_dyn_lsl_up "carried out single sensor signal amplitude measurement" UBYTE _CNV_A_R_EGCP_LINEA_346_CM 1 100. 0. 0.124023 DISPLAY_IDENTIFIER LAMB_AMPL_DIAG_DYN_LSL_UP[1] ECU_ADDRESS 0xd0005884 FORMAT "%6.4" /end MEASUREMENT
/begin MEASUREMENT egcp[0].egcp_struct_pladglsl0.lamb_ampl_min_diag_dyn_lsl_up "Minimum acceptable carried out single sensor signal amplitude measurement" UBYTE _CNV_A_R_EGCP_LINEA_346_CM 1 100. 0. 0.124023 DISPLAY_IDENTIFIER LAMB_AMPL_MIN_DIAG_DYN_LSL_UP[1] ECU_ADDRESS 0xd0005885 FORMAT "%6.4" /end MEASUREMENT
/begin MEASUREMENT egcp[0].egcp_struct_pladglsl0.lamb_ampl_max_diag_dyn_lsl_up "Maximum acceptable carried out single sensor signal amplitude measurement" UBYTE _CNV_A_R_EGCP_LINEA_346_CM 1 100. 0. 0.124023 DISPLAY_IDENTIFIER LAMB_AMPL_MAX_DIAG_DYN_LSL_UP[1] ECU_ADDRESS 0xd0005886 FORMAT "%6.4" /end MEASUREMENT
/begin MEASUREMENT egcp[0].egcp_struct_pladglsl0.lamb_ampl_mv_diag_dyn_lsl_up "sensor signal amplitude mean value" UBYTE _CNV_A_R_EGCP_LINEA_346_CM 1 100. 0. 0.124023 DISPLAY_IDENTIFIER LAMB_AMPL_MV_DIAG_DYN_LSL_UP[1] ECU_ADDRESS 0xd0005887 FORMAT "%6.4" /end MEASUREMENT
/begin MEASUREMENT egcp[0].egcp_struct_pladglsl0.ctr_diag_dyn_lsl_up "Number of  carried out single valid amplitude measurements" UBYTE _CNV_A_R_LINEAR_____0_CM 1 100. 0. 255. DISPLAY_IDENTIFIER CTR_DIAG_DYN_LSL_UP[1] ECU_ADDRESS 0xd0005888 FORMAT "%3.0" /end MEASUREMENT
/begin MEASUREMENT egcp[0].egcp_struct_pladglsl0.ctr_wait_diag_dyn_lsl_up "Number of forced stimulation periods before carrying out amplitude measurements" UBYTE _CNV_A_R_LINEAR_____0_CM 1 100. 0. 255. DISPLAY_IDENTIFIER CTR_WAIT_DIAG_DYN_LSL_UP[1] ECU_ADDRESS 0xd0005889 FORMAT "%3.0" /end MEASUREMENT
/begin MEASUREMENT egcp[0].egcp_struct_pladglsl0.cycnr_diag_dyn_lsl_up "number of cycles necessary to finish the diagnosis" UBYTE _CNV_A_R_LINEAR_____0_CM 1 100. 0. 255. DISPLAY_IDENTIFIER CYCNR_DIAG_DYN_LSL_UP[1] ECU_ADDRESS 0xd000588a FORMAT "%3.0" /end MEASUREMENT
/begin MEASUREMENT egcp[0].egcp_struct_pladglsl0.state_dyn_diag "State shows the condition of the forced stimulation " UBYTE _CNV_S_4_EGCP_RANGE_347_CM 1 100. 0. 3. DISPLAY_IDENTIFIER STATE_DYN_DIAG[1] ECU_ADDRESS 0xd000588b /end MEASUREMENT
/begin MEASUREMENT egcp[0].egcp_struct_pladglsl0.lv_diag_dyn_sym_lsl_up "Debounce diagnosis value of the sensor dynamics" UBYTE _CNV_S_2_RANGE__0___1_CM 1 100. 0. 1. DISPLAY_IDENTIFIER LV_DIAG_DYN_SYM_LSL_UP[1] ECU_ADDRESS 0xd000588c BIT_MASK 0x1 /end MEASUREMENT
/begin MEASUREMENT egcp[0].egcp_struct_pladglsl0.lv_diag_dyn_cdn_lsl_up "Diagnosis condition" UBYTE _CNV_S_2_RANGE__0___1_CM 1 100. 0. 1. DISPLAY_IDENTIFIER LV_DIAG_DYN_CDN_LSL_UP[1] ECU_ADDRESS 0xd000588d BIT_MASK 0x1 /end MEASUREMENT
/begin MEASUREMENT egcp[0].egcp_struct_pladglsl0.lv_diag_dyn_end_lsl_up "Result of diagnosis exist" UBYTE _CNV_S_2_RANGE__0___1_CM 1 100. 0. 1. DISPLAY_IDENTIFIER LV_DIAG_DYN_END_LSL_UP[1] ECU_ADDRESS 0xd000588e BIT_MASK 0x1 /end MEASUREMENT
/begin MEASUREMENT egcp[0].egcp_struct_pladglsl0.lv_lamb_pls_req_dyn_lsl_up "Request forced stimulation parameters specific for the WRAF sensor dynamic" UBYTE _CNV_S_2_RANGE__0___1_CM 1 100. 0. 1. DISPLAY_IDENTIFIER LV_LAMB_PLS_REQ_DYN_LSL_UP[1] ECU_ADDRESS 0xd000588f BIT_MASK 0x1 /end MEASUREMENT
/begin MEASUREMENT egcp[0].egcp_struct_pladglsl0.lv_lam_adj_req_dyn_lsl_up "Request dynamic trim controller parameters specific for the WRAF sensor dynamic" UBYTE _CNV_S_2_RANGE__0___1_CM 1 100. 0. 1. DISPLAY_IDENTIFIER LV_LAM_ADJ_REQ_DYN_LSL_UP[1] ECU_ADDRESS 0xd0005890 BIT_MASK 0x1 /end MEASUREMENT
/begin MEASUREMENT egcp[0].egcp_struct_pladglsl5.t_sym_diag_air_lsl_up "Timer to debounce an error" UWORD _CNV_A_R_LINEAR_____4_CM 1 100. 0. 6553.5 DISPLAY_IDENTIFIER T_SYM_DIAG_AIR_LSL_UP[1] ECU_ADDRESS 0xd0005894 FORMAT "%6.1" /end MEASUREMENT
/begin MEASUREMENT egcp[0].egcp_struct_pladglsl5.t_end_diag_air_lsl_up "Timer to have a diagnostic available" UWORD _CNV_A_R_LINEAR_____4_CM 1 100. 0. 6553.5 DISPLAY_IDENTIFIER T_END_DIAG_AIR_LSL_UP[1] ECU_ADDRESS 0xd0005896 FORMAT "%6.1" /end MEASUREMENT
/begin MEASUREMENT egcp[0].egcp_struct_pladglsl2.t_diag_end_puc_lsl_up "Timer to have a diagnostic available" UWORD _CNV_A_R_LINEAR_____4_CM 1 100. 0. 6553.5 DISPLAY_IDENTIFIER T_DIAG_END_PUC_LSL_UP[1] ECU_ADDRESS 0xd0005898 FORMAT "%6.1" /end MEASUREMENT
/begin MEASUREMENT egcp[0].egcp_struct_pladglsl2.t_max_diag_end_puc_lsl_up "Time to set the END_DIAG bit " UWORD _CNV_A_R_LINEAR_____4_CM 1 100. 0. 6553.5 DISPLAY_IDENTIFIER T_MAX_DIAG_END_PUC_LSL_UP[1] ECU_ADDRESS 0xd000589a FORMAT "%6.1" /end MEASUREMENT
/begin MEASUREMENT egcp[0].egcp_struct_pladglsl2.t_dly_diag_puc_lsl_up "Delay Time to activate the diagnosis" UWORD _CNV_A_R_LINEAR_____4_CM 1 100. 0. 6553.5 DISPLAY_IDENTIFIER T_DLY_DIAG_PUC_LSL_UP[1] ECU_ADDRESS 0xd000589c FORMAT "%6.1" /end MEASUREMENT
/begin MEASUREMENT egcp[0].egcp_struct_pladglsl2.t_max_dly_diag_puc_lsl_up "Maximimum delay time to activate the diagnosis" UWORD _CNV_A_R_LINEAR_____4_CM 1 100. 0. 6553.5 DISPLAY_IDENTIFIER T_MAX_DLY_DIAG_PUC_LSL_UP[1] ECU_ADDRESS 0xd000589e FORMAT "%6.1" /end MEASUREMENT
/begin MEASUREMENT egcp[0].egcp_struct_pladglsl2.t_diag_sym_puc_lsl_up "Symptom debouncer timer" UWORD _CNV_A_R_LINEAR_____4_CM 1 100. 0. 6553.5 DISPLAY_IDENTIFIER T_DIAG_SYM_PUC_LSL_UP[1] ECU_ADDRESS 0xd00058a0 FORMAT "%6.1" /end MEASUREMENT
/begin MEASUREMENT egcp[0].egcp_struct_pladglsl2.t_max_diag_sym_puc_lsl_up "Symptom debouncer time" UWORD _CNV_A_R_LINEAR_____4_CM 1 100. 0. 6553.5 DISPLAY_IDENTIFIER T_MAX_DIAG_SYM_PUC_LSL_UP[1] ECU_ADDRESS 0xd00058a2 FORMAT "%6.1" /end MEASUREMENT
/begin MEASUREMENT egcp[0].egcp_struct_pladglsl2.vls_up_diag_save_puc_lsl_up "Upstream sensor voltage - value used during the diagnosis and transmitted to the Scan Tool in mode06" SWORD _CNV_A_R_LINEAR_____2_CM 1 100. -160. 159.9951171875 DISPLAY_IDENTIFIER VLS_UP_DIAG_SAVE_PUC_LSL_UP[1] ECU_ADDRESS 0xd00058a4 FORMAT "%8.3" /end MEASUREMENT
/begin MEASUREMENT egcp[0].egcp_struct_pladglsl2.state_sym_diag_puc_lsl_up "Symptom of the signal plausibility from the upstream sensor during PUC" UBYTE _CNV_S_4_EGCP_RANGE_348_CM 1 100. 0. 4. DISPLAY_IDENTIFIER STATE_SYM_DIAG_PUC_LSL_UP[1] ECU_ADDRESS 0xd00058a6 /end MEASUREMENT
/begin MEASUREMENT egcp[0].egcp_struct_pladglsl2.lv_diag_puc_end_lsl_up "Result of diagnosis exist" UBYTE _CNV_S_2_RANGE__0___1_CM 1 100. 0. 1. DISPLAY_IDENTIFIER LV_DIAG_PUC_END_LSL_UP[1] ECU_ADDRESS 0xd00058a7 BIT_MASK 0x1 /end MEASUREMENT
/begin MEASUREMENT egcp[0].egcp_struct_pladglsl2.lv_diag_cdn_puc_lsl_up "Diagnosis condition" UBYTE _CNV_S_2_RANGE__0___1_CM 1 100. 0. 1. DISPLAY_IDENTIFIER LV_DIAG_CDN_PUC_LSL_UP[1] ECU_ADDRESS 0xd00058a8 BIT_MASK 0x1 /end MEASUREMENT
/begin MEASUREMENT egcp[0].egcp_struct_pladglsl2.lv_diag_puc_sym_lsl_up "Debounced failure symptom of the signal plausibility from the upstream sensor during PUC" UBYTE _CNV_S_2_RANGE__0___1_CM 1 100. 0. 1. DISPLAY_IDENTIFIER LV_DIAG_PUC_SYM_LSL_UP[1] ECU_ADDRESS 0xd00058a9 BIT_MASK 0x1 /end MEASUREMENT
/begin MEASUREMENT egcp[0].egcp_struct_pladglsl3.ctr_raw_act_sym_lsl_up "Counter to set the raw symptom of sensor no-activity check (first part)" UWORD _CNV_A_R_LINEAR_____0_CM 1 100. 0. 65535. DISPLAY_IDENTIFIER CTR_RAW_ACT_SYM_LSL_UP[1] ECU_ADDRESS 0xd00058ac FORMAT "%5.0" /end MEASUREMENT
/begin MEASUREMENT egcp[0].egcp_struct_pladglsl3.ctr_raw_act_end_lsl_up "Counter to have valid diagnostic result from the no-activity check (first part)" UWORD _CNV_A_R_LINEAR_____0_CM 1 100. 0. 65535. DISPLAY_IDENTIFIER CTR_RAW_ACT_END_LSL_UP[1] ECU_ADDRESS 0xd00058ae FORMAT "%5.0" /end MEASUREMENT
/begin MEASUREMENT egcp[0].egcp_struct_pladglsl3.lamb_de_lsl "Deviation of the instantaneous lambda value from the mean moving value " UWORD _CNV_A_R_EGCP_LINEA_316_CM 1 100. 0. 63.999023 DISPLAY_IDENTIFIER LAMB_DE_LSL[1] ECU_ADDRESS 0xd00058b0 FORMAT "%7.4" /end MEASUREMENT
/begin MEASUREMENT egcp[0].egcp_struct_pladglsl3.lamb_de_int_act_lsl_up "Cumulating value of the lambda deviation" UWORD _CNV_A_R_EGCP_LINEA_316_CM 1 100. 0. 63.999023 DISPLAY_IDENTIFIER LAMB_DE_INT_ACT_LSL_UP[1] ECU_ADDRESS 0xd00058b2 FORMAT "%7.4" /end MEASUREMENT
/begin MEASUREMENT egcp[0].egcp_struct_pladglsl3.lamb_de_tot_act_lsl_up "Total cumulated lambda deviation" UWORD _CNV_A_R_EGCP_LINEA_316_CM 1 100. 0. 63.999023 DISPLAY_IDENTIFIER LAMB_DE_TOT_ACT_LSL_UP[1] ECU_ADDRESS 0xd00058b4 FORMAT "%7.4" /end MEASUREMENT
/begin MEASUREMENT egcp[0].egcp_struct_pladglsl3.lamb_mmv_act_lsl_up "Lambda moving mean value during the time the forced stimulation is active" UWORD _CNV_A_R_LINEAR_____129_CM 1 100. 0. 31.9990234375 DISPLAY_IDENTIFIER LAMB_MMV_ACT_LSL_UP[1] ECU_ADDRESS 0xd00058b6 FORMAT "%7.4" /end MEASUREMENT
/begin MEASUREMENT egcp[0].egcp_struct_pladglsl3.ctr_sym_act_lsl_up "Debounce counter of the sensor non-activity symptom" UBYTE _CNV_A_R_LINEAR_____0_CM 1 100. 0. 255. DISPLAY_IDENTIFIER CTR_SYM_ACT_LSL_UP[1] ECU_ADDRESS 0xd00058b8 FORMAT "%3.0" /end MEASUREMENT
/begin MEASUREMENT egcp[0].egcp_struct_pladglsl3.ctr_end_act_lsl_up "Counter to have valid diagnostic result from the no-activity check (second part)" UBYTE _CNV_A_R_LINEAR_____0_CM 1 100. 0. 255. DISPLAY_IDENTIFIER CTR_END_ACT_LSL_UP[1] ECU_ADDRESS 0xd00058b9 FORMAT "%3.0" /end MEASUREMENT
/begin MEASUREMENT egcp[0].egcp_struct_pladglsl3.ctr_lamb_de_int_act_lsl_up "Counter of forced stimulation periods" UBYTE _CNV_A_R_LINEAR_____0_CM 1 100. 0. 255. DISPLAY_IDENTIFIER CTR_LAMB_DE_INT_ACT_LSL_UP[1] ECU_ADDRESS 0xd00058ba FORMAT "%3.0" /end MEASUREMENT
/begin MEASUREMENT egcp[0].egcp_struct_pladglsl3.lv_diag_raw_act_sym_lsl_up "Boolean flag indicating a detected raw symptom of sensor non-activity (from first test)" UBYTE _CNV_S_2_RANGE__0___1_CM 1 100. 0. 1. DISPLAY_IDENTIFIER LV_DIAG_RAW_ACT_SYM_LSL_UP[1] ECU_ADDRESS 0xd00058bb BIT_MASK 0x1 /end MEASUREMENT
/begin MEASUREMENT egcp[0].egcp_struct_pladglsl3.lv_diag_raw_act_end_lsl_up "Boolean flag indicating end of raw symptom test of no-activity check (from first test)" UBYTE _CNV_S_2_RANGE__0___1_CM 1 100. 0. 1. DISPLAY_IDENTIFIER LV_DIAG_RAW_ACT_END_LSL_UP[1] ECU_ADDRESS 0xd00058bc BIT_MASK 0x1 /end MEASUREMENT
/begin MEASUREMENT egcp[0].egcp_struct_pladglsl3.lv_diag_act_cdn_lsl_up "Boolean flag indicating the conditions to activate the second test  for sensor non-activity are fulfilled" UBYTE _CNV_S_2_RANGE__0___1_CM 1 100. 0. 1. DISPLAY_IDENTIFIER LV_DIAG_ACT_CDN_LSL_UP[1] ECU_ADDRESS 0xd00058bd BIT_MASK 0x1 /end MEASUREMENT
/begin MEASUREMENT egcp[0].egcp_struct_pladglsl3.lv_diag_act_sho_cdn_lsl_up "Boolean flag indicating the short term conditions to activate the second test  for sensor non-activity are fulfilled" UBYTE _CNV_S_2_RANGE__0___1_CM 1 100. 0. 1. DISPLAY_IDENTIFIER LV_DIAG_ACT_SHO_CDN_LSL_UP[1] ECU_ADDRESS 0xd00058be BIT_MASK 0x1 /end MEASUREMENT
/begin MEASUREMENT egcp[0].egcp_struct_pladglsl3.lv_diag_act_sym_lsl_up "Boolean flag indicating a detected poor upstream sensor activity  (from second test)" UBYTE _CNV_S_2_RANGE__0___1_CM 1 100. 0. 1. DISPLAY_IDENTIFIER LV_DIAG_ACT_SYM_LSL_UP[1] ECU_ADDRESS 0xd00058bf BIT_MASK 0x1 /end MEASUREMENT
/begin MEASUREMENT egcp[0].egcp_struct_pladglsl3.lv_diag_act_end_lsl_up "Boolean flag indicating end of detailed test of no-activity check (from second test)" UBYTE _CNV_S_2_RANGE__0___1_CM 1 100. 0. 1. DISPLAY_IDENTIFIER LV_DIAG_ACT_END_LSL_UP[1] ECU_ADDRESS 0xd00058c0 BIT_MASK 0x1 /end MEASUREMENT
/begin MEASUREMENT egcp[0].egcp_struct_pladgspi1.t_diag_act_ofs "time offset adjustment is active" UWORD _CNV_A_R_LINEAR_____3_CM 1 100. 0. 655.35 DISPLAY_IDENTIFIER T_DIAG_ACT_OFS[1] ECU_ADDRESS 0xd00058c4 FORMAT "%6.2" /end MEASUREMENT
/begin MEASUREMENT egcp[0].egcp_struct_pladgspi1.ctr_ofs_adj_cmpl "number of completed offset adjustments" UWORD _CNV_A_R_LINEAR_____0_CM 1 100. 0. 65535. DISPLAY_IDENTIFIER CTR_OFS_ADJ_CMPL[1] ECU_ADDRESS 0xd00058c6 FORMAT "%5.0" /end MEASUREMENT
/begin MEASUREMENT egcp[0].egcp_struct_pladgspi1.err_diag_ctl_lsl_up "Symptom of pump current controller fault on the upstream WRAF sensor controller" UBYTE _CNV_S_16_RANGE_ERR__349_CM 1 100. 0. 15. DISPLAY_IDENTIFIER ERR_DIAG_CTL_LSL_UP[1] ECU_ADDRESS 0xd00058c8 /end MEASUREMENT
/begin MEASUREMENT egcp[0].egcp_struct_pladgspi1.cdn_diag_ctl_lsl_up "Condtions to run the pump current controller diagnosis for the WRAF sensor controller" UBYTE _CNV_A_R_LINEAR_____0_CM 1 100. 0. 255. DISPLAY_IDENTIFIER CDN_DIAG_CTL_LSL_UP[1] ECU_ADDRESS 0xd00058c9 FORMAT "%3.0" /end MEASUREMENT
/begin MEASUREMENT egcp[0].egcp_struct_pladgspi1.lv_err_ofs_lsl_up "Debounced diagnosis value caused by an offset correction error of the WRAF Sensor controller" UBYTE _CNV_S_2_RANGE__0___1_CM 1 100. 0. 1. DISPLAY_IDENTIFIER LV_ERR_OFS_LSL_UP[1] ECU_ADDRESS 0xd00058ca BIT_MASK 0x1 /end MEASUREMENT
/begin MEASUREMENT egcp[0].egcp_struct_pladgspi1.lv_end_diag_ofs_lsl_up "Result of present diagnostis status is valid" UBYTE _CNV_S_2_RANGE__0___1_CM 1 100. 0. 1. DISPLAY_IDENTIFIER LV_END_DIAG_OFS_LSL_UP[1] ECU_ADDRESS 0xd00058cb BIT_MASK 0x1 /end MEASUREMENT
/begin MEASUREMENT egcp[0].egcp_struct_pladgspi1.lv_lsl_ofs_adj_diag_ofs_old "Value of LV_LS_OFS_ADJ_ACT from last recurrence of the WRAF controller offset diagnosis" UBYTE _CNV_S_2_RANGE__0___1_CM 1 100. 0. 1. DISPLAY_IDENTIFIER LV_LSL_OFS_ADJ_DIAG_OFS_OLD[1] ECU_ADDRESS 0xd00058cc BIT_MASK 0x1 /end MEASUREMENT
/begin MEASUREMENT egcp[0].egcp_struct_pladgspi1.lv_err_ctl_lsl_up "Debounced result of pump current controller diagnosis" UBYTE _CNV_S_2_RANGE__0___1_CM 1 100. 0. 1. DISPLAY_IDENTIFIER LV_ERR_CTL_LSL_UP[1] ECU_ADDRESS 0xd00058cd BIT_MASK 0x1 /end MEASUREMENT
/begin MEASUREMENT egcp[0].egcp_struct_pladgspi1.lv_end_diag_ctl_lsl_up "End flag of the pump current controller diagnosis for WRAF sensor controller" UBYTE _CNV_S_2_RANGE__0___1_CM 1 100. 0. 1. DISPLAY_IDENTIFIER LV_END_DIAG_CTL_LSL_UP[1] ECU_ADDRESS 0xd00058ce BIT_MASK 0x1 /end MEASUREMENT
/begin MEASUREMENT egcp[0].egcp_struct_pladgspii1.cdn_diag_ctl_lsl_di "Permanently disabled monitors for the pump current controller diagnosis" UBYTE _CNV_A_R_LINEAR_____0_CM 1 100. 0. 255. DISPLAY_IDENTIFIER CDN_DIAG_CTL_LSL_DI[1] ECU_ADDRESS 0xd00058d0 FORMAT "%3.0" /end MEASUREMENT
/begin MEASUREMENT egcp[0].egcp_struct_pladgspii1.cdn_diag_ctl_lsl_inh "Temporarily inhibited monitors for the pump current controller diagnosis" UBYTE _CNV_A_R_LINEAR_____0_CM 1 100. 0. 255. DISPLAY_IDENTIFIER CDN_DIAG_CTL_LSL_INH[1] ECU_ADDRESS 0xd00058d1 FORMAT "%3.0" /end MEASUREMENT
/begin MEASUREMENT egcp[0].egcp_struct_pladgspii1.lv_inh_diag_ofs_lsl "Inhibition condition for  the Offset adjustment diagnosis" UBYTE _CNV_S_2_RANGE__0___1_CM 1 100. 0. 1. DISPLAY_IDENTIFIER LV_INH_DIAG_OFS_LSL[1] ECU_ADDRESS 0xd00058d2 BIT_MASK 0x1 /end MEASUREMENT
/begin MEASUREMENT egcp[0].egcp_struct_pladgspii1.lv_inh_diag_ctl_lsl_up "Inhibition condition for  the pump current controller diagnosis" UBYTE _CNV_S_2_RANGE__0___1_CM 1 100. 0. 1. DISPLAY_IDENTIFIER LV_INH_DIAG_CTL_LSL_UP[1] ECU_ADDRESS 0xd00058d3 BIT_MASK 0x1 /end MEASUREMENT
/begin MEASUREMENT egcp[0].egcp_struct_pladglsi0.lv_diag_plaus_inh_lsl_up "Deactivation of Plausibility check of the sensor signal" UBYTE _CNV_S_2_RANGE__0___1_CM 1 100. 0. 1. DISPLAY_IDENTIFIER LV_DIAG_PLAUS_INH_LSL_UP[1] ECU_ADDRESS 0xd0005904 BIT_MASK 0x1 /end MEASUREMENT
/begin MEASUREMENT egcp[0].egcp_struct_pladglsi0.lv_inh_diag_rbm_plaus_lsl_up "Deactivation of  Rate Base Monitoring of  Plausibility check of the sensor signal" UBYTE _CNV_S_2_RANGE__0___1_CM 1 100. 0. 1. DISPLAY_IDENTIFIER LV_INH_DIAG_RBM_PLAUS_LSL_UP[1] ECU_ADDRESS 0xd0005905 BIT_MASK 0x1 /end MEASUREMENT
/begin MEASUREMENT egcp[0].egcp_struct_pladglsli0.state_rbm_dyn_vld_ls_up "Interface of DYN_VLD_LS_UP[NC_CBK_EX_NR] monitor with the Rate-Based Monitoring statistics" UBYTE _CNV_A_R_LINEAR_____0_CM 1 100. 0. 255. DISPLAY_IDENTIFIER STATE_RBM_DYN_VLD_LS_UP[1] ECU_ADDRESS 0xd0005906 FORMAT "%3.0" /end MEASUREMENT
/begin MEASUREMENT egcp[0].egcp_struct_pladglsli0.lv_diag_dyn_inh_lsl_up "Deactivation of \"Diagnosis of the WRAF Sensor Dynamic\"" UBYTE _CNV_S_2_RANGE__0___1_CM 1 100. 0. 1. DISPLAY_IDENTIFIER LV_DIAG_DYN_INH_LSL_UP[1] ECU_ADDRESS 0xd0005907 BIT_MASK 0x1 /end MEASUREMENT
/begin MEASUREMENT egcp[0].egcp_struct_pladglsli0.lv_inh_diag_rbm_dyn_vld_ls_up "Deactivation of Rate Based Monitoring of  \"Diagnosis of WRAF Sensor Dynamic\" by malfunction" UBYTE _CNV_S_2_RANGE__0___1_CM 1 100. 0. 1. DISPLAY_IDENTIFIER LV_INH_DIAG_RBM_DYN_VLD_LS_UP[1] ECU_ADDRESS 0xd0005908 BIT_MASK 0x1 /end MEASUREMENT
/begin MEASUREMENT egcp[0].egcp_struct_pladglsli0.lv_diag_eol_dyn_ls_up_dc "Logical Value as reminder for End of Line test within this driving cycle" UBYTE _CNV_S_2_RANGE__0___1_CM 1 100. 0. 1. DISPLAY_IDENTIFIER LV_DIAG_EOL_DYN_LS_UP_DC[1] ECU_ADDRESS 0xd0005909 BIT_MASK 0x1 /end MEASUREMENT
/begin MEASUREMENT egcp[0].egcp_struct_pladglsli0.lv_diag_eol_dyn_ls_up "Activation of short trip for WRAF sensor dynamic diagnosis" UBYTE _CNV_S_2_RANGE__0___1_CM 1 100. 0. 1. DISPLAY_IDENTIFIER LV_DIAG_EOL_DYN_LS_UP[1] ECU_ADDRESS 0xd000590a BIT_MASK 0x1 /end MEASUREMENT
/begin MEASUREMENT egcp[0].egcp_struct_pladglsli5.state_rbm_air_lsl_up "Interface of AIR_LSL_UP[NC_CBK_EX_NR] monitor with the Rate-Based Monitoring statistics" UBYTE _CNV_A_R_LINEAR_____0_CM 1 100. 0. 255. DISPLAY_IDENTIFIER STATE_RBM_AIR_LSL_UP[1] ECU_ADDRESS 0xd000590c FORMAT "%3.0" /end MEASUREMENT
/begin MEASUREMENT egcp[0].egcp_struct_pladglsli5.lv_inh_diag_air_lsl_up "Deactivation of Monitoring Upstream Sensor Signal " UBYTE _CNV_S_2_RANGE__0___1_CM 1 100. 0. 1. DISPLAY_IDENTIFIER LV_INH_DIAG_AIR_LSL_UP[1] ECU_ADDRESS 0xd000590d BIT_MASK 0x1 /end MEASUREMENT
/begin MEASUREMENT egcp[0].egcp_struct_pladglsli5.lv_inh_diag_rbm_air_lsl_up "Deactivation of Rate Based Monitoring of Monitoring Upstream Sensor Signal by malfunction" UBYTE _CNV_S_2_RANGE__0___1_CM 1 100. 0. 1. DISPLAY_IDENTIFIER LV_INH_DIAG_RBM_AIR_LSL_UP[1] ECU_ADDRESS 0xd000590e BIT_MASK 0x1 /end MEASUREMENT
/begin MEASUREMENT egcp[0].egcp_struct_pladglsli5.lv_diag_eol_air_lsl_up_dc "Logical Value as reminder for End of Line test within this driving cycle" UBYTE _CNV_S_2_RANGE__0___1_CM 1 100. 0. 1. DISPLAY_IDENTIFIER LV_DIAG_EOL_AIR_LSL_UP_DC[1] ECU_ADDRESS 0xd000590f BIT_MASK 0x1 /end MEASUREMENT
/begin MEASUREMENT egcp[0].egcp_struct_pladglsli5.lv_diag_eol_air_lsl_up "Activation of short trip for upstream sensor signal monitoring" UBYTE _CNV_S_2_RANGE__0___1_CM 1 100. 0. 1. DISPLAY_IDENTIFIER LV_DIAG_EOL_AIR_LSL_UP[1] ECU_ADDRESS 0xd0005910 BIT_MASK 0x1 /end MEASUREMENT
/begin MEASUREMENT egcp[0].egcp_struct_pladglsli2.lv_inh_diag_puc_lsl_up "Deactivation of Monitoring Upstream Sensor Signal during PUC" UBYTE _CNV_S_2_RANGE__0___1_CM 1 100. 0. 1. DISPLAY_IDENTIFIER LV_INH_DIAG_PUC_LSL_UP[1] ECU_ADDRESS 0xd0005912 BIT_MASK 0x1 /end MEASUREMENT
/begin MEASUREMENT egcp[0].egcp_struct_pladglsli2.lv_inh_diag_rbm_puc_lsl_up "Deactivation of Monitoring Upstream Sensor Signal during PUC by other other failures" UBYTE _CNV_S_2_RANGE__0___1_CM 1 100. 0. 1. DISPLAY_IDENTIFIER LV_INH_DIAG_RBM_PUC_LSL_UP[1] ECU_ADDRESS 0xd0005913 BIT_MASK 0x1 /end MEASUREMENT
/begin MEASUREMENT egcp[0].egcp_struct_pladglsli2.lv_diag_eol_puc_lsl_up "Activation of short trip for Monitoring Upstream Sensor during PUC" UBYTE _CNV_S_2_RANGE__0___1_CM 1 100. 0. 1. DISPLAY_IDENTIFIER LV_DIAG_EOL_PUC_LSL_UP[1] ECU_ADDRESS 0xd0005914 BIT_MASK 0x1 /end MEASUREMENT
/begin MEASUREMENT egcp[0].egcp_struct_pladglsli3.lv_diag_act_inh_lsl_up "Deactivation of \"Activity Diagnosis\"" UBYTE _CNV_S_2_RANGE__0___1_CM 1 100. 0. 1. DISPLAY_IDENTIFIER LV_DIAG_ACT_INH_LSL_UP[1] ECU_ADDRESS 0xd0005916 BIT_MASK 0x1 /end MEASUREMENT
/begin MEASUREMENT egcp[0].egcp_struct_sigdglsd3.vls_down_rgn_nt_end "Monitor sensor voltage at the time of leaving regeneration phase of NOx trap, Bank i (i=1.2)" UWORD _CNV_A_R_LINEAR_____2_CM 1 100. 0. 4.9951171875 DISPLAY_IDENTIFIER VLS_DOWN_RGN_NT_END[1] ECU_ADDRESS 0xd0005930 FORMAT "%5.3" /end MEASUREMENT
/begin MEASUREMENT egcp[0].egcp_struct_sigdglsd3.maf_int_rgn_nt_s_act "Mass air flow which has passed since activation of stratified mode" UWORD _CNV_A_R_LINEAR_____314_CM 1 100. 0. 2912.66666666667 DISPLAY_IDENTIFIER MAF_INT_RGN_NT_S_ACT[1] ECU_ADDRESS 0xd0005932 FORMAT "%7.2" /end MEASUREMENT
/begin MEASUREMENT egcp[0].egcp_struct_sigdglsd3.maf_int_rgn_nt_end "Mass air flow which has passed since last regeneration cycle" UWORD _CNV_A_R_LINEAR_____314_CM 1 100. 0. 2912.66666666667 DISPLAY_IDENTIFIER MAF_INT_RGN_NT_END[1] ECU_ADDRESS 0xd0005934 FORMAT "%7.2" /end MEASUREMENT
/begin MEASUREMENT egcp[0].egcp_struct_sigdglsd3.t_rgn_nt_end "Time which has passed after leaving last regeneration cycle" UWORD _CNV_A_R_LINEAR_____110_CM 1 100. 0. 1310.7 DISPLAY_IDENTIFIER T_RGN_NT_END[1] ECU_ADDRESS 0xd0005936 FORMAT "%7.2" /end MEASUREMENT
/begin MEASUREMENT egcp[0].egcp_struct_sigdglsd3.ctr_sym_diag_rgn_nt_ls_down "Counter for internal anti-bounce of error symptom" UWORD _CNV_A_R_LINEAR_____0_CM 1 100. 0. 65535. DISPLAY_IDENTIFIER CTR_SYM_DIAG_RGN_NT_LS_DOWN[1] ECU_ADDRESS 0xd0005938 FORMAT "%5.0" /end MEASUREMENT
/begin MEASUREMENT egcp[0].egcp_struct_sigdglsd3.vls_down_rgn_nt_dif "Measured Voltage difference used for error detection" SWORD _CNV_A_R_LINEAR_____315_CM 1 100. -5.00000000000182 4.99511718999747 DISPLAY_IDENTIFIER VLS_DOWN_RGN_NT_DIF[1] ECU_ADDRESS 0xd000593a /end MEASUREMENT
/begin MEASUREMENT egcp[0].egcp_struct_sigdglsd3.ctr_end_diag_rgn_nt_ls_down "Counter for end bit calculation" UBYTE _CNV_A_R_LINEAR_____0_CM 1 100. 0. 255. DISPLAY_IDENTIFIER CTR_END_DIAG_RGN_NT_LS_DOWN[1] ECU_ADDRESS 0xd000593c FORMAT "%3.0" /end MEASUREMENT
/begin MEASUREMENT egcp[0].egcp_struct_sigdglsd3.vls_down_rgn_nt_min_end "minimum monitor sensor voltage during maf integral calculation in stratified mode" UWORD _CNV_A_R_LINEAR_____2_CM 1 100. 0. 4.9951171875 DISPLAY_IDENTIFIER VLS_DOWN_RGN_NT_MIN_END[1] ECU_ADDRESS 0xd000593e FORMAT "%5.3" /end MEASUREMENT
/begin MEASUREMENT egcp[0].egcp_struct_sigdglsd3.vls_down_rgn_nt_min_tmp "temporary minimum monitor sensor voltage during maf integral calculation in stratified mode" UWORD _CNV_A_R_LINEAR_____2_CM 1 100. 0. 4.9951171875 DISPLAY_IDENTIFIER VLS_DOWN_RGN_NT_MIN_TMP[1] ECU_ADDRESS 0xd0005940 FORMAT "%5.3" /end MEASUREMENT
/begin MEASUREMENT egcp[0].egcp_struct_sigdglsd3.vls_down_rgn_nt_max_tmp "Temporary maximum monitor sensor voltage during MAF integral calculation in stratified mode" UWORD _CNV_A_R_LINEAR_____2_CM 1 100. 0. 4.9951171875 DISPLAY_IDENTIFIER VLS_DOWN_RGN_NT_MAX_TMP[1] ECU_ADDRESS 0xd0005942 FORMAT "%5.3" /end MEASUREMENT
/begin MEASUREMENT egcp[0].egcp_struct_sigdglsd3.vls_down_rgn_nt_mes_sae "test value for diagnosis result evaluation for mode 6 communication" UWORD _CNV_A_R_EGCP_LINEA_353_CM 1 100. 0. 7.9998779296875 DISPLAY_IDENTIFIER VLS_DOWN_RGN_NT_MES_SAE[1] ECU_ADDRESS 0xd0005944 FORMAT "%6.4" /end MEASUREMENT
/begin MEASUREMENT egcp[0].egcp_struct_sigdglsd3.vls_down_rgn_nt_min_sae "Minimum voltage threshold for diagnosis result evaluation for mode 6 communication" UWORD _CNV_A_R_EGCP_LINEA_353_CM 1 100. 0. 7.9998779296875 DISPLAY_IDENTIFIER VLS_DOWN_RGN_NT_MIN_SAE[1] ECU_ADDRESS 0xd0005946 FORMAT "%6.4" /end MEASUREMENT
/begin MEASUREMENT egcp[0].egcp_struct_sigdglsd3.lv_diag_act_rgn_nt_ls_down "Logical variable indicating that diagnosis conditions are fulfilled" UBYTE _CNV_S_2_RANGE__0___1_CM 1 100. 0. 1. DISPLAY_IDENTIFIER LV_DIAG_ACT_RGN_NT_LS_DOWN[1] ECU_ADDRESS 0xd0005948 BIT_MASK 0x1 /end MEASUREMENT
/begin MEASUREMENT egcp[0].egcp_struct_sigdglsd3.lv_diag_rgn_nt_ls_down_err "Debounced diagnosis result for monitoring lean to rich switching times after Nox cat regeneration" UBYTE _CNV_S_2_RANGE__0___1_CM 1 100. 0. 1. DISPLAY_IDENTIFIER LV_DIAG_RGN_NT_LS_DOWN_ERR[1] ECU_ADDRESS 0xd0005949 BIT_MASK 0x1 /end MEASUREMENT
/begin MEASUREMENT egcp[0].egcp_struct_sigdglsd3.lv_diag_rgn_nt_ls_down_end "End bit for monitoring lean to rich switching times after Nox cat regeneration" UBYTE _CNV_S_2_RANGE__0___1_CM 1 100. 0. 1. DISPLAY_IDENTIFIER LV_DIAG_RGN_NT_LS_DOWN_END[1] ECU_ADDRESS 0xd000594a BIT_MASK 0x1 /end MEASUREMENT
/begin MEASUREMENT egcp[0].egcp_struct_sigdglsdi3.lv_inh_diag_rgn_nt_ls_down "Logical variable indicating inhibition of downstream oxygen sensor diagnosis after NOx cat regeneration" UBYTE _CNV_S_2_RANGE__0___1_CM 1 100. 0. 1. DISPLAY_IDENTIFIER LV_INH_DIAG_RGN_NT_LS_DOWN[1] ECU_ADDRESS 0xd000594c BIT_MASK 0x1 /end MEASUREMENT
/begin MEASUREMENT egcp[0].egcp_struct_pladglsli4.state_rbm_shift_afl_lsl_up "Interface of SHIFT_AFL_LSL_UP[NC_CBK_EX_NR] monitor with the Rate-Based Monitoring statistics" UBYTE _CNV_A_R_LINEAR_____0_CM 1 100. 0. 255. DISPLAY_IDENTIFIER STATE_RBM_SHIFT_AFL_LSL_UP[1] ECU_ADDRESS 0xd000594e FORMAT "%3.0" /end MEASUREMENT
/begin MEASUREMENT egcp[0].egcp_struct_pladglsli4.state_rbm_shift_afr_lsl_up "Interface of SHIFT_AFR_LSL_UP[NC_CBK_EX_NR] monitor with the Rate-Based Monitoring statistics" UBYTE _CNV_A_R_LINEAR_____0_CM 1 100. 0. 255. DISPLAY_IDENTIFIER STATE_RBM_SHIFT_AFR_LSL_UP[1] ECU_ADDRESS 0xd000594f FORMAT "%3.0" /end MEASUREMENT
/begin MEASUREMENT egcp[0].egcp_struct_pladglsl4.t_dly_diag_shift_down "Delay timer for the end flag of the shift down diagnosis in the no failure case (RBM purpose)" UWORD _CNV_A_R_LINEAR_____4_CM 1 100. 0. 6553.5 DISPLAY_IDENTIFIER T_DLY_DIAG_SHIFT_DOWN[1] ECU_ADDRESS 0xd0005950 FORMAT "%6.1" /end MEASUREMENT
/begin MEASUREMENT egcp[0].egcp_struct_pladglsl4.lv_t_dly_diag_shift_down "End flag of the shift down diagnosis in the no failure case (RBM purpose)" UBYTE _CNV_S_2_RANGE__0___1_CM 1 100. 0. 1. DISPLAY_IDENTIFIER LV_T_DLY_DIAG_SHIFT_DOWN[1] ECU_ADDRESS 0xd0005952 BIT_MASK 0x1 /end MEASUREMENT
/begin MEASUREMENT egcp[0].egcp_struct_pladglsl6.fac_sum_diag_dyn_s_lsl_up "sum of all diagnostic values for stratified dynamics diagnosis sampled in the current driving cycle" SLONG _CNV_A_R_LINEAR_____28_CM 1 100. -8388608. 8388607.99609375 DISPLAY_IDENTIFIER FAC_SUM_DIAG_DYN_S_LSL_UP[1] ECU_ADDRESS 0xd0005954 FORMAT "%12.3" /end MEASUREMENT
/begin MEASUREMENT egcp[0].egcp_struct_pladglsl6.fac_mv_diag_dyn_s_lsl_up "final diagnostic value of stratified dynamics diagnosis" SWORD _CNV_A_R_LINEAR_____28_CM 1 100. -128. 127.99609375 DISPLAY_IDENTIFIER FAC_MV_DIAG_DYN_S_LSL_UP[1] ECU_ADDRESS 0xd0005958 FORMAT "%11.6" /end MEASUREMENT
/begin MEASUREMENT egcp[0].egcp_struct_pladglsl6.fac_mv_diag_dyn_s_lsl_up_sae "Mode 6 output of diagnostic result of upstream stratified dynamics diagnosis" SWORD _CNV_A_R_EGCP_LINEA_354_CM 1 100. -327.68 327.67 DISPLAY_IDENTIFIER FAC_MV_DIAG_DYN_S_LSL_UP_SAE[1] ECU_ADDRESS 0xd000595a FORMAT "%7.2" /end MEASUREMENT
/begin MEASUREMENT egcp[0].egcp_struct_pladglsl6.fac_value_diag_dyn_s_lsl_up "last sample of stratified dynamics diagnosis value" SWORD _CNV_A_R_LINEAR_____28_CM 1 100. -128. 127.99609375 DISPLAY_IDENTIFIER FAC_VALUE_DIAG_DYN_S_LSL_UP[1] ECU_ADDRESS 0xd000595c FORMAT "%11.6" /end MEASUREMENT
/begin MEASUREMENT egcp[0].egcp_struct_pladglsl6.conc_o2_mes_diag_dyn_s "O2 concentration derived from measured lambda value from sensor" SWORD _CNV_A_R_LINEAR_____24_CM 1 100. -2. 1.99993896484375 DISPLAY_IDENTIFIER CONC_O2_MES_DIAG_DYN_S[1] ECU_ADDRESS 0xd000595e FORMAT "%8.5" /end MEASUREMENT
/begin MEASUREMENT egcp[0].egcp_struct_pladglsl6.conc_o2_mes_max_diag_dyn_s "measured O2 concentration at time of last transition out of homogenous combustion mode" SWORD _CNV_A_R_LINEAR_____24_CM 1 100. -2. 1.99993896484375 DISPLAY_IDENTIFIER CONC_O2_MES_MAX_DIAG_DYN_S[1] ECU_ADDRESS 0xd0005960 FORMAT "%8.5" /end MEASUREMENT
/begin MEASUREMENT egcp[0].egcp_struct_pladglsl6.conc_o2_clc_diag_dyn_s "O2 concentration derived from lambda value of sensor model" SWORD _CNV_A_R_LINEAR_____24_CM 1 100. -2. 1.99993896484375 DISPLAY_IDENTIFIER CONC_O2_CLC_DIAG_DYN_S[1] ECU_ADDRESS 0xd0005962 FORMAT "%8.5" /end MEASUREMENT
/begin MEASUREMENT egcp[0].egcp_struct_pladglsl6.conc_o2_clc_int_diag_dyn_s "integral of modelled O2 concentration in stratified dynamics diagnosis" SWORD _CNV_A_R_LINEAR_____24_CM 1 100. -2. 1.99993896484375 DISPLAY_IDENTIFIER CONC_O2_CLC_INT_DIAG_DYN_S[1] ECU_ADDRESS 0xd0005964 FORMAT "%8.5" /end MEASUREMENT
/begin MEASUREMENT egcp[0].egcp_struct_pladglsl6.conc_o2_dif_int_diag_dyn_s "integral of the difference between modelled and measured O2 concentration in stratified dynamics diagnosis" SWORD _CNV_A_R_LINEAR_____24_CM 1 100. -2. 1.99993896484375 DISPLAY_IDENTIFIER CONC_O2_DIF_INT_DIAG_DYN_S[1] ECU_ADDRESS 0xd0005966 FORMAT "%8.5" /end MEASUREMENT
/begin MEASUREMENT egcp[0].egcp_struct_pladglsl6.conc_o2_mes_diag_dyn_s_st "measured O2 concentration at time of last transition out of homogenous combustion mode" SWORD _CNV_A_R_LINEAR_____24_CM 1 100. -2. 1.99993896484375 DISPLAY_IDENTIFIER CONC_O2_MES_DIAG_DYN_S_ST[1] ECU_ADDRESS 0xd0005968 FORMAT "%8.5" /end MEASUREMENT
/begin MEASUREMENT egcp[0].egcp_struct_pladglsl6.conc_o2_clc_diag_dyn_s_st "O2 concentration from sensor model at the last transition out of homogenous combustion mode" SWORD _CNV_A_R_LINEAR_____24_CM 1 100. -2. 1.99993896484375 DISPLAY_IDENTIFIER CONC_O2_CLC_DIAG_DYN_S_ST[1] ECU_ADDRESS 0xd000596a FORMAT "%8.5" /end MEASUREMENT
/begin MEASUREMENT egcp[0].egcp_struct_pladglsl6.ctr_diag_dyn_s_lsl_up "number of valid diagnostic samples in the current driving cycle" UWORD _CNV_A_R_LINEAR_____0_CM 1 100. 0. 65535. DISPLAY_IDENTIFIER CTR_DIAG_DYN_S_LSL_UP[1] ECU_ADDRESS 0xd000596c FORMAT "%5.0" /end MEASUREMENT
/begin MEASUREMENT egcp[0].egcp_struct_pladglsl6.maf_int_diag_dyn_s_act "MAF integral since transition out of homogenous combustion mode" UWORD _CNV_A_R_LINEAR_____314_CM 1 100. 0. 2912.66666666667 DISPLAY_IDENTIFIER MAF_INT_DIAG_DYN_S_ACT[1] ECU_ADDRESS 0xd000596e FORMAT "%7.2" /end MEASUREMENT
/begin MEASUREMENT egcp[0].egcp_struct_pladglsl6.state_sym_diag_dyn_s_lsl_up "error symptom from stratified dynamics diagnosis" UBYTE _CNV_A_R_LINEAR_____0_CM 1 100. 0. 255. DISPLAY_IDENTIFIER STATE_SYM_DIAG_DYN_S_LSL_UP[1] ECU_ADDRESS 0xd0005970 FORMAT "%3.0" /end MEASUREMENT
/begin MEASUREMENT egcp[0].egcp_struct_pladglsl6.lv_diag_dyn_s_lsl_up_end "End flag from stratified combustion lambda sensor dynamics diagnosis" UBYTE _CNV_S_2_RANGE__0___1_CM 1 100. 0. 1. DISPLAY_IDENTIFIER LV_DIAG_DYN_S_LSL_UP_END[1] ECU_ADDRESS 0xd0005971 BIT_MASK 0x1 /end MEASUREMENT
/begin MEASUREMENT egcp[0].egcp_struct_pladglsl6.lv_diag_dyn_s_lsl_up_err "error signalization from stratified dynamics diagnosis" UBYTE _CNV_S_2_RANGE__0___1_CM 1 100. 0. 1. DISPLAY_IDENTIFIER LV_DIAG_DYN_S_LSL_UP_ERR[1] ECU_ADDRESS 0xd0005972 BIT_MASK 0x1 /end MEASUREMENT
/begin MEASUREMENT egcp[0].egcp_struct_pladglsl6.lv_diag_dyn_s_lsl_up_sample "signals that a new diagnostic sample should be calculated and included into the average" UBYTE _CNV_S_2_RANGE__0___1_CM 1 100. 0. 1. DISPLAY_IDENTIFIER LV_DIAG_DYN_S_LSL_UP_SAMPLE[1] ECU_ADDRESS 0xd0005973 BIT_MASK 0x1 /end MEASUREMENT
/begin MEASUREMENT egcp[0].egcp_struct_pladglsl6.lv_diag_dyn_s_lsl_up_stop "signals that the diagnosis shall sleep until reactivated by another homogenous combustion phase" UBYTE _CNV_S_2_RANGE__0___1_CM 1 100. 0. 1. DISPLAY_IDENTIFIER LV_DIAG_DYN_S_LSL_UP_STOP[1] ECU_ADDRESS 0xd0005974 BIT_MASK 0x1 /end MEASUREMENT
/begin MEASUREMENT egcp[0].egcp_struct_pladglsli6.lv_inh_dyn_diag_s_lsl_up "Inhibition of linear lambda sensor dynamic diagnosis for stratified combustion" UBYTE _CNV_S_2_RANGE__0___1_CM 1 100. 0. 1. DISPLAY_IDENTIFIER LV_INH_DYN_DIAG_S_LSL_UP[1] ECU_ADDRESS 0xd0005978 BIT_MASK 0x1 /end MEASUREMENT
/begin MEASUREMENT egcp[0].egcp_struct_sigdglsd4.lamb_sp_osc_chk "lambda setpoint requested by oscillation check for downstream lambda sensor" UWORD _CNV_A_R_LINEAR_____129_CM 1 100. 0. 31.9990234375 DISPLAY_IDENTIFIER LAMB_SP_OSC_CHK[1] ECU_ADDRESS 0xd000597a FORMAT "%7.4" /end MEASUREMENT
/begin MEASUREMENT egcp[0].egcp_struct_sigdglsd4.lv_err_osc_chk "Debounced failure of oscillation diagnosis for downstream sensor" UBYTE _CNV_S_2_RANGE__0___1_CM 1 100. 0. 1. DISPLAY_IDENTIFIER LV_ERR_OSC_CHK[1] ECU_ADDRESS 0xd000597c BIT_MASK 0x1 /end MEASUREMENT
/begin MEASUREMENT egcp[0].egcp_struct_sigdglsd4.lv_end_diag_osc_chk "End of oscillation diagnosis for downstream sensor" UBYTE _CNV_S_2_RANGE__0___1_CM 1 100. 0. 1. DISPLAY_IDENTIFIER LV_END_DIAG_OSC_CHK[1] ECU_ADDRESS 0xd000597d BIT_MASK 0x1 /end MEASUREMENT
/begin MEASUREMENT egcp[1].egcp_struct_sigcvridi0.lv_inh_r_it_ls_down "Boolean flag indicating that downstream sensor internal resistance determination shall be inhibited when set" UBYTE _CNV_S_2_RANGE__0___1_CM 1 100. 0. 1. DISPLAY_IDENTIFIER LV_INH_R_IT_LS_DOWN[2] ECU_ADDRESS 0xd0005adc BIT_MASK 0x1 /end MEASUREMENT
/begin MEASUREMENT egcp[1].egcp_struct_sigdglsdi2.lv_inh_diag_swt_ls_down "Flag indicating inhibition of lambda sensor switching time diagnosis downstream" UBYTE _CNV_S_2_RANGE__0___1_CM 1 100. 0. 1. DISPLAY_IDENTIFIER LV_INH_DIAG_SWT_LS_DOWN[2] ECU_ADDRESS 0xd0005b8c BIT_MASK 0x1 /end MEASUREMENT
/begin MEASUREMENT egcp[1].egcp_struct_sigdglsdi2.lv_inh_diag_rbm_swt_ls_down "Flag indicating inhibition of RBM for lambda sensor switching time diagnosis downstream" UBYTE _CNV_S_2_RANGE__0___1_CM 1 100. 0. 1. DISPLAY_IDENTIFIER LV_INH_DIAG_RBM_SWT_LS_DOWN[2] ECU_ADDRESS 0xd0005b8d BIT_MASK 0x1 /end MEASUREMENT
/begin MEASUREMENT egcp[1].egcp_struct_sigdglsdi2.lv_inh_diag_pue_ls_down "Flag indicating inhibition of lambda sensor PUC-end diagnosis downstream" UBYTE _CNV_S_2_RANGE__0___1_CM 1 100. 0. 1. DISPLAY_IDENTIFIER LV_INH_DIAG_PUE_LS_DOWN[2] ECU_ADDRESS 0xd0005b8e BIT_MASK 0x1 /end MEASUREMENT
/begin MEASUREMENT egcp[1].egcp_struct_sigdglsdi2.state_rbm_swt_ls_down "Interface of SWT_LS_DOWN monitor with the Rate Based Monitoring statistics" UBYTE _CNV_A_R_LINEAR_____0_CM 1 100. 0. 255. DISPLAY_IDENTIFIER STATE_RBM_SWT_LS_DOWN[2] ECU_ADDRESS 0xd0005b8f FORMAT "%3.0" /end MEASUREMENT
/begin MEASUREMENT egcp[1].egcp_struct_sigdglsdi2.lv_inh_diag_tmp_ls_down "Flag indicating inhibition for PUE_ and SWT_LS_DOWN" UBYTE _CNV_S_2_RANGE__0___1_CM 1 100. 0. 1. DISPLAY_IDENTIFIER LV_INH_DIAG_TMP_LS_DOWN[2] ECU_ADDRESS 0xd0005b90 BIT_MASK 0x1 /end MEASUREMENT
/begin MEASUREMENT egcp[1].egcp_struct_fctdglslhi0.lv_inh_diag_obd_lsh_up "Boolean inhibit flag for O2 sensor heater OBDII monitoring" UBYTE _CNV_S_2_RANGE__0___1_CM 1 100. 0. 1. DISPLAY_IDENTIFIER LV_INH_DIAG_OBD_LSH_UP[2] ECU_ADDRESS 0xd0005b92 BIT_MASK 0x1 /end MEASUREMENT
/begin MEASUREMENT egcp[1].egcp_struct_fctdglslhi0.state_rbm_obd_vld_lsh_up "Interface of OBD_VLD_LSH_UP[NC_CBK_EX_NR] monitor with the Rate-Based Monitoring statistics" UBYTE _CNV_A_R_LINEAR_____0_CM 1 100. 0. 255. DISPLAY_IDENTIFIER STATE_RBM_OBD_VLD_LSH_UP[2] ECU_ADDRESS 0xd0005b93 FORMAT "%3.0" /end MEASUREMENT
/begin MEASUREMENT egcp[1].egcp_struct_fctdglslhi0.lv_inh_diag_rbm_obd_lsh_up "Boolean inhibit flag for Rate Based Monitoring of O2 sensor heater OBDII diagnosis" UBYTE _CNV_S_2_RANGE__0___1_CM 1 100. 0. 1. DISPLAY_IDENTIFIER LV_INH_DIAG_RBM_OBD_LSH_UP[2] ECU_ADDRESS 0xd0005b94 BIT_MASK 0x1 /end MEASUREMENT
/begin MEASUREMENT egcp[1].egcp_struct_pladglsli1.lv_diag_act_inh_ls_up_down "general inhibition Oxygen Sensor Active Plausibility Check" UBYTE _CNV_S_2_RANGE__0___1_CM 1 100. 0. 1. DISPLAY_IDENTIFIER LV_DIAG_ACT_INH_LS_UP_DOWN[2] ECU_ADDRESS 0xd0005b96 BIT_MASK 0x1 /end MEASUREMENT
/begin MEASUREMENT egcp[1].egcp_struct_pladglsli1.lv_diag_afr_afl_inh_ls_up_down "Inhibition of open loop diag while interferring functions are deactivated in failure case" UBYTE _CNV_S_2_RANGE__0___1_CM 1 100. 0. 1. DISPLAY_IDENTIFIER LV_DIAG_AFR_AFL_INH_LS_UP_DOWN[2] ECU_ADDRESS 0xd0005b97 BIT_MASK 0x1 /end MEASUREMENT
/begin MEASUREMENT egcp[1].egcp_struct_pladglsli1.lv_diag_eol_req_ls_up_down "Start EOL active test " UBYTE _CNV_S_2_RANGE__0___1_CM 1 100. 0. 1. DISPLAY_IDENTIFIER LV_DIAG_EOL_REQ_LS_UP_DOWN[2] ECU_ADDRESS 0xd0005b98 BIT_MASK 0x1 /end MEASUREMENT
/begin MEASUREMENT egcp[1].egcp_struct_pladglsli1.lv_diag_opl_req_cbk "request open loop diagnosis" UBYTE _CNV_S_2_RANGE__0___1_CM 1 100. 0. 1. DISPLAY_IDENTIFIER LV_DIAG_OPL_REQ_CBK[2] ECU_ADDRESS 0xd0005b99 BIT_MASK 0x1 /end MEASUREMENT
/begin MEASUREMENT egcp[1].egcp_struct_pladglsli1.lv_diag_act_inh_rbm_ls_up_down "Inhibit- flag for RBM for Oxygen Sensor Active Plausibility Check" UBYTE _CNV_S_2_RANGE__0___1_CM 1 100. 0. 1. DISPLAY_IDENTIFIER LV_DIAG_ACT_INH_RBM_LS_UP_DOWN[2] ECU_ADDRESS 0xd0005b9a BIT_MASK 0x1 /end MEASUREMENT
/begin MEASUREMENT egcp[1].egcp_struct_sigdglsl3.lamb_delta_rise_lpf "Mean value for heater coupling (rising edge)" SWORD _CNV_A_R_LINEAR_____24_CM 1 100. -2. 1.99993896484375 DISPLAY_IDENTIFIER LAMB_DELTA_RISE_LPF[2] ECU_ADDRESS 0xd0005b9c FORMAT "%8.5" /end MEASUREMENT
/begin MEASUREMENT egcp[1].egcp_struct_sigdglsl3.lamb_delta_fall_lpf "Mean value for heater coupling (falling edge)" SWORD _CNV_A_R_LINEAR_____24_CM 1 100. -2. 1.99993896484375 DISPLAY_IDENTIFIER LAMB_DELTA_FALL_LPF[2] ECU_ADDRESS 0xd0005b9e FORMAT "%8.5" /end MEASUREMENT
/begin MEASUREMENT egcp[1].egcp_struct_sigdglsl3.lamb_syn_lshpwm_fall "Lambda value acquied after lshpwm signal falling edge" UWORD _CNV_A_R_LINEAR_____24_CM 1 100. 0. 1.99993896484375 DISPLAY_IDENTIFIER LAMB_SYN_LSHPWM_FALL[2] ECU_ADDRESS 0xd0005ba0 FORMAT "%7.5" /end MEASUREMENT
/begin MEASUREMENT egcp[1].egcp_struct_sigdglsl3.lamb_syn_lshpwm_rise "Lambda value acquied after lshpwm signal rising edge" UWORD _CNV_A_R_LINEAR_____24_CM 1 100. 0. 1.99993896484375 DISPLAY_IDENTIFIER LAMB_SYN_LSHPWM_RISE[2] ECU_ADDRESS 0xd0005ba2 FORMAT "%7.5" /end MEASUREMENT
/begin MEASUREMENT egcp[1].egcp_struct_sigdglsl3.lamb_delta_rise "Variation of lambda value before and after lshpwm signal rising edge" SWORD _CNV_A_R_LINEAR_____24_CM 1 100. -2. 1.99993896484375 DISPLAY_IDENTIFIER LAMB_DELTA_RISE[2] ECU_ADDRESS 0xd0005ba4 FORMAT "%8.5" /end MEASUREMENT
/begin MEASUREMENT egcp[1].egcp_struct_sigdglsl3.lamb_delta_fall "Variation of lambda value before and after lshpwm signal falling edge" SWORD _CNV_A_R_LINEAR_____24_CM 1 100. -2. 1.99993896484375 DISPLAY_IDENTIFIER LAMB_DELTA_FALL[2] ECU_ADDRESS 0xd0005ba6 FORMAT "%8.5" /end MEASUREMENT
/begin MEASUREMENT egcp[1].egcp_struct_sigdglsl3.ctr_sym_diag_lsh_lsl_up "Counter of forced stimulation periods with a present symptom" UBYTE _CNV_A_R_LINEAR_____0_CM 1 100. 0. 255. DISPLAY_IDENTIFIER CTR_SYM_DIAG_LSH_LSL_UP[2] ECU_ADDRESS 0xd0005ba8 FORMAT "%3.0" /end MEASUREMENT
/begin MEASUREMENT egcp[1].egcp_struct_sigdglsl3.cycnr_diag_lsh_lsl_up "Counter of forced stimulation periods investigated" UBYTE _CNV_A_R_LINEAR_____0_CM 1 100. 0. 255. DISPLAY_IDENTIFIER CYCNR_DIAG_LSH_LSL_UP[2] ECU_ADDRESS 0xd0005ba9 FORMAT "%3.0" /end MEASUREMENT
/begin MEASUREMENT egcp[1].egcp_struct_sigdglsl3.t_dly_trig_lsh_up "Time delay for acquisition of oxygen sensor signal and lambda model" UBYTE _CNV_A_R_EGCP_LINEA_344_CM 1 100. 0. 0.255 DISPLAY_IDENTIFIER T_DLY_TRIG_LSH_UP[2] ECU_ADDRESS 0xd0005baa FORMAT "%5.3" /end MEASUREMENT
/begin MEASUREMENT egcp[1].egcp_struct_sigdglsli3.lv_inh_diag_lsh_lsl_up "Deactivation of \"Diagnosis of the Heater Coupling in the Sensor Signal\"" UBYTE _CNV_S_2_RANGE__0___1_CM 1 100. 0. 1. DISPLAY_IDENTIFIER LV_INH_DIAG_LSH_LSL_UP[2] ECU_ADDRESS 0xd0005bac BIT_MASK 0x1 /end MEASUREMENT
/begin MEASUREMENT egcp[1].egcp_struct_pladgls0.maf_sym_raw_plaus_lsl_up "MAF integral for the plausibility symptom (compensation of the catalyst delay)" UWORD _CNV_A_R_LINEAR_____287_CM 1 100. 0. 1820.41666666667 DISPLAY_IDENTIFIER MAF_SYM_RAW_PLAUS_LSL_UP[2] ECU_ADDRESS 0xd0005bf8 FORMAT "%7.2" /end MEASUREMENT
/begin MEASUREMENT egcp[1].egcp_struct_pladgls0.maf_sym_plaus_lsl_up "MAF integral for detection of mutual not plausible sensor signals" UWORD _CNV_A_R_LINEAR_____287_CM 1 100. 0. 1820.41666666667 DISPLAY_IDENTIFIER MAF_SYM_PLAUS_LSL_UP[2] ECU_ADDRESS 0xd0005bfa FORMAT "%7.2" /end MEASUREMENT
/begin MEASUREMENT egcp[1].egcp_struct_pladgls0.maf_end_plaus_lsl_up "MAF integral for valid diagnostic result" UWORD _CNV_A_R_LINEAR_____287_CM 1 100. 0. 1820.41666666667 DISPLAY_IDENTIFIER MAF_END_PLAUS_LSL_UP[2] ECU_ADDRESS 0xd0005bfc FORMAT "%7.2" /end MEASUREMENT
/begin MEASUREMENT egcp[1].egcp_struct_pladgls0.state_sym_diag_plaus_lsl_up "Oxygen Sensor Plausibility Check Symptom " UBYTE _CNV_S_5_EGCP_RANGE_338_CM 1 100. 0. 8. DISPLAY_IDENTIFIER STATE_SYM_DIAG_PLAUS_LSL_UP[2] ECU_ADDRESS 0xd0005bfe /end MEASUREMENT
/begin MEASUREMENT egcp[1].egcp_struct_pladgls0.lv_diag_plaus_sym_lsl_up "Debounced diagnosis result of the signal plausibility for the wide range A/F sensor" UBYTE _CNV_S_2_RANGE__0___1_CM 1 100. 0. 1. DISPLAY_IDENTIFIER LV_DIAG_PLAUS_SYM_LSL_UP[2] ECU_ADDRESS 0xd0005bff BIT_MASK 0x1 /end MEASUREMENT
/begin MEASUREMENT egcp[1].egcp_struct_pladgls0.lv_diag_cdn_plaus_lsl_up "Oxygen Sensor Plausibility Check condition" UBYTE _CNV_S_2_RANGE__0___1_CM 1 100. 0. 1. DISPLAY_IDENTIFIER LV_DIAG_CDN_PLAUS_LSL_UP[2] ECU_ADDRESS 0xd0005c00 BIT_MASK 0x1 /end MEASUREMENT
/begin MEASUREMENT egcp[1].egcp_struct_pladgls0.lv_diag_plaus_end_lsl_up "Oxygen Sensor Plausibility Check result available " UBYTE _CNV_S_2_RANGE__0___1_CM 1 100. 0. 1. DISPLAY_IDENTIFIER LV_DIAG_PLAUS_END_LSL_UP[2] ECU_ADDRESS 0xd0005c01 BIT_MASK 0x1 /end MEASUREMENT
/begin MEASUREMENT egcp[1].egcp_struct_pladgls0.lv_diag_afr_sym_plaus_lsl_up "Oxygen Sensor Plausibility Check - not debounced symptom \"SENS_AFR\"  " UBYTE _CNV_S_2_RANGE__0___1_CM 1 100. 0. 1. DISPLAY_IDENTIFIER LV_DIAG_AFR_SYM_PLAUS_LSL_UP[2] ECU_ADDRESS 0xd0005c02 BIT_MASK 0x1 /end MEASUREMENT
/begin MEASUREMENT egcp[1].egcp_struct_pladgls0.lv_diag_afl_sym_plaus_lsl_up "Oxygen Sensor Plausibility Check - not debounced symptom -SENS_AFL-" UBYTE _CNV_S_2_RANGE__0___1_CM 1 100. 0. 1. DISPLAY_IDENTIFIER LV_DIAG_AFL_SYM_PLAUS_LSL_UP[2] ECU_ADDRESS 0xd0005c03 BIT_MASK 0x1 /end MEASUREMENT
/begin MEASUREMENT egcp[1].egcp_struct_pladglsl0.lamb_lpf_diag_dyn_lsl_up "Lambda value filtered with a Low Pass Filter" UWORD _CNV_A_R_LINEAR_____129_CM 1 100. 0. 31.9990234375 DISPLAY_IDENTIFIER LAMB_LPF_DIAG_DYN_LSL_UP[2] ECU_ADDRESS 0xd0005c04 FORMAT "%7.4" /end MEASUREMENT
/begin MEASUREMENT egcp[1].egcp_struct_pladglsl0.lamb_min_diag_dyn_lsl_up "Minimum value of the lambda sensor signal (per sample period)" UWORD _CNV_A_R_LINEAR_____129_CM 1 100. 0. 31.9990234375 DISPLAY_IDENTIFIER LAMB_MIN_DIAG_DYN_LSL_UP[2] ECU_ADDRESS 0xd0005c06 FORMAT "%7.4" /end MEASUREMENT
/begin MEASUREMENT egcp[1].egcp_struct_pladglsl0.lamb_max_diag_dyn_lsl_up "Maximum value of the lambda sensor signal (per sample period)" UWORD _CNV_A_R_LINEAR_____129_CM 1 100. 0. 31.9990234375 DISPLAY_IDENTIFIER LAMB_MAX_DIAG_DYN_LSL_UP[2] ECU_ADDRESS 0xd0005c08 FORMAT "%7.4" /end MEASUREMENT
/begin MEASUREMENT egcp[1].egcp_struct_pladglsl0.lamb_ampl_int_diag_dyn_lsl_up "Integral over carried out single sensor signal amplitude measurement" UWORD _CNV_A_R_LINEAR_____129_CM 1 100. 0. 31.9990234375 DISPLAY_IDENTIFIER LAMB_AMPL_INT_DIAG_DYN_LSL_UP[2] ECU_ADDRESS 0xd0005c0a FORMAT "%7.4" /end MEASUREMENT
/begin MEASUREMENT egcp[1].egcp_struct_pladglsl0.fac_value_diag_dyn_lsl_up "Normalised single sensor signal amplitude " UWORD _CNV_A_R_LINEAR_____129_CM 1 100. 0. 31.9990234375 DISPLAY_IDENTIFIER FAC_VALUE_DIAG_DYN_LSL_UP[2] ECU_ADDRESS 0xd0005c0c FORMAT "%7.4" /end MEASUREMENT
/begin MEASUREMENT egcp[1].egcp_struct_pladglsl0.fac_sum_diag_dyn_lsl_up "Summation over all normalised single sensor signal amplitude" UWORD _CNV_A_R_EGCP_LINEA_316_CM 1 100. 0. 63.999023 DISPLAY_IDENTIFIER FAC_SUM_DIAG_DYN_LSL_UP[2] ECU_ADDRESS 0xd0005c0e FORMAT "%7.4" /end MEASUREMENT
/begin MEASUREMENT egcp[1].egcp_struct_pladglsl0.fac_mv_diag_dyn_lsl_up "Mean value of normalised single sensor signal amplitude" UWORD _CNV_A_R_LINEAR_____129_CM 1 100. 0. 31.9990234375 DISPLAY_IDENTIFIER FAC_MV_DIAG_DYN_LSL_UP[2] ECU_ADDRESS 0xd0005c10 FORMAT "%7.4" /end MEASUREMENT
/begin MEASUREMENT egcp[1].egcp_struct_pladglsl0.fac_diag_dyn_lsl_up "Adaption factor to the modeled sensor time constant" UWORD _CNV_A_R_LINEAR_____129_CM 1 100. 0. 31.9990234375 DISPLAY_IDENTIFIER FAC_DIAG_DYN_LSL_UP[2] ECU_ADDRESS 0xd0005c12 FORMAT "%7.4" /end MEASUREMENT
/begin MEASUREMENT egcp[1].egcp_struct_pladglsl0.t_dyn_diag_afl "Timer for maximum amplitude measurement duration after LV_AFL 0 -> 1" UWORD _CNV_A_R_LINEAR_____110_CM 1 100. 0. 1310.7 DISPLAY_IDENTIFIER T_DYN_DIAG_AFL[2] ECU_ADDRESS 0xd0005c14 FORMAT "%7.2" /end MEASUREMENT
/begin MEASUREMENT egcp[1].egcp_struct_pladglsl0.t_dyn_diag_afr "Timer for maximum amplitude measurement duration after LV_AFL 1 -> 0" UWORD _CNV_A_R_LINEAR_____110_CM 1 100. 0. 1310.7 DISPLAY_IDENTIFIER T_DYN_DIAG_AFR[2] ECU_ADDRESS 0xd0005c16 FORMAT "%7.2" /end MEASUREMENT
/begin MEASUREMENT egcp[1].egcp_struct_pladglsl0.lamb_ampl_diag_dyn_lsl_up "carried out single sensor signal amplitude measurement" UBYTE _CNV_A_R_EGCP_LINEA_346_CM 1 100. 0. 0.124023 DISPLAY_IDENTIFIER LAMB_AMPL_DIAG_DYN_LSL_UP[2] ECU_ADDRESS 0xd0005c18 FORMAT "%6.4" /end MEASUREMENT
/begin MEASUREMENT egcp[1].egcp_struct_pladglsl0.lamb_ampl_min_diag_dyn_lsl_up "Minimum acceptable carried out single sensor signal amplitude measurement" UBYTE _CNV_A_R_EGCP_LINEA_346_CM 1 100. 0. 0.124023 DISPLAY_IDENTIFIER LAMB_AMPL_MIN_DIAG_DYN_LSL_UP[2] ECU_ADDRESS 0xd0005c19 FORMAT "%6.4" /end MEASUREMENT
/begin MEASUREMENT egcp[1].egcp_struct_pladglsl0.lamb_ampl_max_diag_dyn_lsl_up "Maximum acceptable carried out single sensor signal amplitude measurement" UBYTE _CNV_A_R_EGCP_LINEA_346_CM 1 100. 0. 0.124023 DISPLAY_IDENTIFIER LAMB_AMPL_MAX_DIAG_DYN_LSL_UP[2] ECU_ADDRESS 0xd0005c1a FORMAT "%6.4" /end MEASUREMENT
/begin MEASUREMENT egcp[1].egcp_struct_pladglsl0.lamb_ampl_mv_diag_dyn_lsl_up "sensor signal amplitude mean value" UBYTE _CNV_A_R_EGCP_LINEA_346_CM 1 100. 0. 0.124023 DISPLAY_IDENTIFIER LAMB_AMPL_MV_DIAG_DYN_LSL_UP[2] ECU_ADDRESS 0xd0005c1b FORMAT "%6.4" /end MEASUREMENT
/begin MEASUREMENT egcp[1].egcp_struct_pladglsl0.ctr_diag_dyn_lsl_up "Number of  carried out single valid amplitude measurements" UBYTE _CNV_A_R_LINEAR_____0_CM 1 100. 0. 255. DISPLAY_IDENTIFIER CTR_DIAG_DYN_LSL_UP[2] ECU_ADDRESS 0xd0005c1c FORMAT "%3.0" /end MEASUREMENT
/begin MEASUREMENT egcp[1].egcp_struct_pladglsl0.ctr_wait_diag_dyn_lsl_up "Number of forced stimulation periods before carrying out amplitude measurements" UBYTE _CNV_A_R_LINEAR_____0_CM 1 100. 0. 255. DISPLAY_IDENTIFIER CTR_WAIT_DIAG_DYN_LSL_UP[2] ECU_ADDRESS 0xd0005c1d FORMAT "%3.0" /end MEASUREMENT
/begin MEASUREMENT egcp[1].egcp_struct_pladglsl0.cycnr_diag_dyn_lsl_up "number of cycles necessary to finish the diagnosis" UBYTE _CNV_A_R_LINEAR_____0_CM 1 100. 0. 255. DISPLAY_IDENTIFIER CYCNR_DIAG_DYN_LSL_UP[2] ECU_ADDRESS 0xd0005c1e FORMAT "%3.0" /end MEASUREMENT
/begin MEASUREMENT egcp[1].egcp_struct_pladglsl0.state_dyn_diag "State shows the condition of the forced stimulation " UBYTE _CNV_S_4_EGCP_RANGE_347_CM 1 100. 0. 3. DISPLAY_IDENTIFIER STATE_DYN_DIAG[2] ECU_ADDRESS 0xd0005c1f /end MEASUREMENT
/begin MEASUREMENT egcp[1].egcp_struct_pladglsl0.lv_diag_dyn_sym_lsl_up "Debounce diagnosis value of the sensor dynamics" UBYTE _CNV_S_2_RANGE__0___1_CM 1 100. 0. 1. DISPLAY_IDENTIFIER LV_DIAG_DYN_SYM_LSL_UP[2] ECU_ADDRESS 0xd0005c20 BIT_MASK 0x1 /end MEASUREMENT
/begin MEASUREMENT egcp[1].egcp_struct_pladglsl0.lv_diag_dyn_cdn_lsl_up "Diagnosis condition" UBYTE _CNV_S_2_RANGE__0___1_CM 1 100. 0. 1. DISPLAY_IDENTIFIER LV_DIAG_DYN_CDN_LSL_UP[2] ECU_ADDRESS 0xd0005c21 BIT_MASK 0x1 /end MEASUREMENT
/begin MEASUREMENT egcp[1].egcp_struct_pladglsl0.lv_diag_dyn_end_lsl_up "Result of diagnosis exist" UBYTE _CNV_S_2_RANGE__0___1_CM 1 100. 0. 1. DISPLAY_IDENTIFIER LV_DIAG_DYN_END_LSL_UP[2] ECU_ADDRESS 0xd0005c22 BIT_MASK 0x1 /end MEASUREMENT
/begin MEASUREMENT egcp[1].egcp_struct_pladglsl0.lv_lamb_pls_req_dyn_lsl_up "Request forced stimulation parameters specific for the WRAF sensor dynamic" UBYTE _CNV_S_2_RANGE__0___1_CM 1 100. 0. 1. DISPLAY_IDENTIFIER LV_LAMB_PLS_REQ_DYN_LSL_UP[2] ECU_ADDRESS 0xd0005c23 BIT_MASK 0x1 /end MEASUREMENT
/begin MEASUREMENT egcp[1].egcp_struct_pladglsl0.lv_lam_adj_req_dyn_lsl_up "Request dynamic trim controller parameters specific for the WRAF sensor dynamic" UBYTE _CNV_S_2_RANGE__0___1_CM 1 100. 0. 1. DISPLAY_IDENTIFIER LV_LAM_ADJ_REQ_DYN_LSL_UP[2] ECU_ADDRESS 0xd0005c24 BIT_MASK 0x1 /end MEASUREMENT
/begin MEASUREMENT egcp[1].egcp_struct_pladglsl5.t_sym_diag_air_lsl_up "Timer to debounce an error" UWORD _CNV_A_R_LINEAR_____4_CM 1 100. 0. 6553.5 DISPLAY_IDENTIFIER T_SYM_DIAG_AIR_LSL_UP[2] ECU_ADDRESS 0xd0005c28 FORMAT "%6.1" /end MEASUREMENT
/begin MEASUREMENT egcp[1].egcp_struct_pladglsl5.t_end_diag_air_lsl_up "Timer to have a diagnostic available" UWORD _CNV_A_R_LINEAR_____4_CM 1 100. 0. 6553.5 DISPLAY_IDENTIFIER T_END_DIAG_AIR_LSL_UP[2] ECU_ADDRESS 0xd0005c2a FORMAT "%6.1" /end MEASUREMENT
/begin MEASUREMENT egcp[1].egcp_struct_pladglsl2.t_diag_end_puc_lsl_up "Timer to have a diagnostic available" UWORD _CNV_A_R_LINEAR_____4_CM 1 100. 0. 6553.5 DISPLAY_IDENTIFIER T_DIAG_END_PUC_LSL_UP[2] ECU_ADDRESS 0xd0005c2c FORMAT "%6.1" /end MEASUREMENT
/begin MEASUREMENT egcp[1].egcp_struct_pladglsl2.t_max_diag_end_puc_lsl_up "Time to set the END_DIAG bit " UWORD _CNV_A_R_LINEAR_____4_CM 1 100. 0. 6553.5 DISPLAY_IDENTIFIER T_MAX_DIAG_END_PUC_LSL_UP[2] ECU_ADDRESS 0xd0005c2e FORMAT "%6.1" /end MEASUREMENT
/begin MEASUREMENT egcp[1].egcp_struct_pladglsl2.t_dly_diag_puc_lsl_up "Delay Time to activate the diagnosis" UWORD _CNV_A_R_LINEAR_____4_CM 1 100. 0. 6553.5 DISPLAY_IDENTIFIER T_DLY_DIAG_PUC_LSL_UP[2] ECU_ADDRESS 0xd0005c30 FORMAT "%6.1" /end MEASUREMENT
/begin MEASUREMENT egcp[1].egcp_struct_pladglsl2.t_max_dly_diag_puc_lsl_up "Maximimum delay time to activate the diagnosis" UWORD _CNV_A_R_LINEAR_____4_CM 1 100. 0. 6553.5 DISPLAY_IDENTIFIER T_MAX_DLY_DIAG_PUC_LSL_UP[2] ECU_ADDRESS 0xd0005c32 FORMAT "%6.1" /end MEASUREMENT
/begin MEASUREMENT egcp[1].egcp_struct_pladglsl2.t_diag_sym_puc_lsl_up "Symptom debouncer timer" UWORD _CNV_A_R_LINEAR_____4_CM 1 100. 0. 6553.5 DISPLAY_IDENTIFIER T_DIAG_SYM_PUC_LSL_UP[2] ECU_ADDRESS 0xd0005c34 FORMAT "%6.1" /end MEASUREMENT
/begin MEASUREMENT egcp[1].egcp_struct_pladglsl2.t_max_diag_sym_puc_lsl_up "Symptom debouncer time" UWORD _CNV_A_R_LINEAR_____4_CM 1 100. 0. 6553.5 DISPLAY_IDENTIFIER T_MAX_DIAG_SYM_PUC_LSL_UP[2] ECU_ADDRESS 0xd0005c36 FORMAT "%6.1" /end MEASUREMENT
/begin MEASUREMENT egcp[1].egcp_struct_pladglsl2.vls_up_diag_save_puc_lsl_up "Upstream sensor voltage - value used during the diagnosis and transmitted to the Scan Tool in mode06" SWORD _CNV_A_R_LINEAR_____2_CM 1 100. -160. 159.9951171875 DISPLAY_IDENTIFIER VLS_UP_DIAG_SAVE_PUC_LSL_UP[2] ECU_ADDRESS 0xd0005c38 FORMAT "%8.3" /end MEASUREMENT
/begin MEASUREMENT egcp[1].egcp_struct_pladglsl2.state_sym_diag_puc_lsl_up "Symptom of the signal plausibility from the upstream sensor during PUC" UBYTE _CNV_S_4_EGCP_RANGE_348_CM 1 100. 0. 4. DISPLAY_IDENTIFIER STATE_SYM_DIAG_PUC_LSL_UP[2] ECU_ADDRESS 0xd0005c3a /end MEASUREMENT
/begin MEASUREMENT egcp[1].egcp_struct_pladglsl2.lv_diag_puc_end_lsl_up "Result of diagnosis exist" UBYTE _CNV_S_2_RANGE__0___1_CM 1 100. 0. 1. DISPLAY_IDENTIFIER LV_DIAG_PUC_END_LSL_UP[2] ECU_ADDRESS 0xd0005c3b BIT_MASK 0x1 /end MEASUREMENT
/begin MEASUREMENT egcp[1].egcp_struct_pladglsl2.lv_diag_cdn_puc_lsl_up "Diagnosis condition" UBYTE _CNV_S_2_RANGE__0___1_CM 1 100. 0. 1. DISPLAY_IDENTIFIER LV_DIAG_CDN_PUC_LSL_UP[2] ECU_ADDRESS 0xd0005c3c BIT_MASK 0x1 /end MEASUREMENT
/begin MEASUREMENT egcp[1].egcp_struct_pladglsl2.lv_diag_puc_sym_lsl_up "Debounced failure symptom of the signal plausibility from the upstream sensor during PUC" UBYTE _CNV_S_2_RANGE__0___1_CM 1 100. 0. 1. DISPLAY_IDENTIFIER LV_DIAG_PUC_SYM_LSL_UP[2] ECU_ADDRESS 0xd0005c3d BIT_MASK 0x1 /end MEASUREMENT
/begin MEASUREMENT egcp[1].egcp_struct_pladglsl3.ctr_raw_act_sym_lsl_up "Counter to set the raw symptom of sensor no-activity check (first part)" UWORD _CNV_A_R_LINEAR_____0_CM 1 100. 0. 65535. DISPLAY_IDENTIFIER CTR_RAW_ACT_SYM_LSL_UP[2] ECU_ADDRESS 0xd0005c40 FORMAT "%5.0" /end MEASUREMENT
/begin MEASUREMENT egcp[1].egcp_struct_pladglsl3.ctr_raw_act_end_lsl_up "Counter to have valid diagnostic result from the no-activity check (first part)" UWORD _CNV_A_R_LINEAR_____0_CM 1 100. 0. 65535. DISPLAY_IDENTIFIER CTR_RAW_ACT_END_LSL_UP[2] ECU_ADDRESS 0xd0005c42 FORMAT "%5.0" /end MEASUREMENT
/begin MEASUREMENT egcp[1].egcp_struct_pladglsl3.lamb_de_lsl "Deviation of the instantaneous lambda value from the mean moving value " UWORD _CNV_A_R_EGCP_LINEA_316_CM 1 100. 0. 63.999023 DISPLAY_IDENTIFIER LAMB_DE_LSL[2] ECU_ADDRESS 0xd0005c44 FORMAT "%7.4" /end MEASUREMENT
/begin MEASUREMENT egcp[1].egcp_struct_pladglsl3.lamb_de_int_act_lsl_up "Cumulating value of the lambda deviation" UWORD _CNV_A_R_EGCP_LINEA_316_CM 1 100. 0. 63.999023 DISPLAY_IDENTIFIER LAMB_DE_INT_ACT_LSL_UP[2] ECU_ADDRESS 0xd0005c46 FORMAT "%7.4" /end MEASUREMENT
/begin MEASUREMENT egcp[1].egcp_struct_pladglsl3.lamb_de_tot_act_lsl_up "Total cumulated lambda deviation" UWORD _CNV_A_R_EGCP_LINEA_316_CM 1 100. 0. 63.999023 DISPLAY_IDENTIFIER LAMB_DE_TOT_ACT_LSL_UP[2] ECU_ADDRESS 0xd0005c48 FORMAT "%7.4" /end MEASUREMENT
/begin MEASUREMENT egcp[1].egcp_struct_pladglsl3.lamb_mmv_act_lsl_up "Lambda moving mean value during the time the forced stimulation is active" UWORD _CNV_A_R_LINEAR_____129_CM 1 100. 0. 31.9990234375 DISPLAY_IDENTIFIER LAMB_MMV_ACT_LSL_UP[2] ECU_ADDRESS 0xd0005c4a FORMAT "%7.4" /end MEASUREMENT
/begin MEASUREMENT egcp[1].egcp_struct_pladglsl3.ctr_sym_act_lsl_up "Debounce counter of the sensor non-activity symptom" UBYTE _CNV_A_R_LINEAR_____0_CM 1 100. 0. 255. DISPLAY_IDENTIFIER CTR_SYM_ACT_LSL_UP[2] ECU_ADDRESS 0xd0005c4c FORMAT "%3.0" /end MEASUREMENT
/begin MEASUREMENT egcp[1].egcp_struct_pladglsl3.ctr_end_act_lsl_up "Counter to have valid diagnostic result from the no-activity check (second part)" UBYTE _CNV_A_R_LINEAR_____0_CM 1 100. 0. 255. DISPLAY_IDENTIFIER CTR_END_ACT_LSL_UP[2] ECU_ADDRESS 0xd0005c4d FORMAT "%3.0" /end MEASUREMENT
/begin MEASUREMENT egcp[1].egcp_struct_pladglsl3.ctr_lamb_de_int_act_lsl_up "Counter of forced stimulation periods" UBYTE _CNV_A_R_LINEAR_____0_CM 1 100. 0. 255. DISPLAY_IDENTIFIER CTR_LAMB_DE_INT_ACT_LSL_UP[2] ECU_ADDRESS 0xd0005c4e FORMAT "%3.0" /end MEASUREMENT
/begin MEASUREMENT egcp[1].egcp_struct_pladglsl3.lv_diag_raw_act_sym_lsl_up "Boolean flag indicating a detected raw symptom of sensor non-activity (from first test)" UBYTE _CNV_S_2_RANGE__0___1_CM 1 100. 0. 1. DISPLAY_IDENTIFIER LV_DIAG_RAW_ACT_SYM_LSL_UP[2] ECU_ADDRESS 0xd0005c4f BIT_MASK 0x1 /end MEASUREMENT
/begin MEASUREMENT egcp[1].egcp_struct_pladglsl3.lv_diag_raw_act_end_lsl_up "Boolean flag indicating end of raw symptom test of no-activity check (from first test)" UBYTE _CNV_S_2_RANGE__0___1_CM 1 100. 0. 1. DISPLAY_IDENTIFIER LV_DIAG_RAW_ACT_END_LSL_UP[2] ECU_ADDRESS 0xd0005c50 BIT_MASK 0x1 /end MEASUREMENT
/begin MEASUREMENT egcp[1].egcp_struct_pladglsl3.lv_diag_act_cdn_lsl_up "Boolean flag indicating the conditions to activate the second test  for sensor non-activity are fulfilled" UBYTE _CNV_S_2_RANGE__0___1_CM 1 100. 0. 1. DISPLAY_IDENTIFIER LV_DIAG_ACT_CDN_LSL_UP[2] ECU_ADDRESS 0xd0005c51 BIT_MASK 0x1 /end MEASUREMENT
/begin MEASUREMENT egcp[1].egcp_struct_pladglsl3.lv_diag_act_sho_cdn_lsl_up "Boolean flag indicating the short term conditions to activate the second test  for sensor non-activity are fulfilled" UBYTE _CNV_S_2_RANGE__0___1_CM 1 100. 0. 1. DISPLAY_IDENTIFIER LV_DIAG_ACT_SHO_CDN_LSL_UP[2] ECU_ADDRESS 0xd0005c52 BIT_MASK 0x1 /end MEASUREMENT
/begin MEASUREMENT egcp[1].egcp_struct_pladglsl3.lv_diag_act_sym_lsl_up "Boolean flag indicating a detected poor upstream sensor activity  (from second test)" UBYTE _CNV_S_2_RANGE__0___1_CM 1 100. 0. 1. DISPLAY_IDENTIFIER LV_DIAG_ACT_SYM_LSL_UP[2] ECU_ADDRESS 0xd0005c53 BIT_MASK 0x1 /end MEASUREMENT
/begin MEASUREMENT egcp[1].egcp_struct_pladglsl3.lv_diag_act_end_lsl_up "Boolean flag indicating end of detailed test of no-activity check (from second test)" UBYTE _CNV_S_2_RANGE__0___1_CM 1 100. 0. 1. DISPLAY_IDENTIFIER LV_DIAG_ACT_END_LSL_UP[2] ECU_ADDRESS 0xd0005c54 BIT_MASK 0x1 /end MEASUREMENT
/begin MEASUREMENT egcp[1].egcp_struct_pladgspi1.t_diag_act_ofs "time offset adjustment is active" UWORD _CNV_A_R_LINEAR_____3_CM 1 100. 0. 655.35 DISPLAY_IDENTIFIER T_DIAG_ACT_OFS[2] ECU_ADDRESS 0xd0005c58 FORMAT "%6.2" /end MEASUREMENT
/begin MEASUREMENT egcp[1].egcp_struct_pladgspi1.ctr_ofs_adj_cmpl "number of completed offset adjustments" UWORD _CNV_A_R_LINEAR_____0_CM 1 100. 0. 65535. DISPLAY_IDENTIFIER CTR_OFS_ADJ_CMPL[2] ECU_ADDRESS 0xd0005c5a FORMAT "%5.0" /end MEASUREMENT
/begin MEASUREMENT egcp[1].egcp_struct_pladgspi1.err_diag_ctl_lsl_up "Symptom of pump current controller fault on the upstream WRAF sensor controller" UBYTE _CNV_S_16_RANGE_ERR__349_CM 1 100. 0. 15. DISPLAY_IDENTIFIER ERR_DIAG_CTL_LSL_UP[2] ECU_ADDRESS 0xd0005c5c /end MEASUREMENT
/begin MEASUREMENT egcp[1].egcp_struct_pladgspi1.cdn_diag_ctl_lsl_up "Condtions to run the pump current controller diagnosis for the WRAF sensor controller" UBYTE _CNV_A_R_LINEAR_____0_CM 1 100. 0. 255. DISPLAY_IDENTIFIER CDN_DIAG_CTL_LSL_UP[2] ECU_ADDRESS 0xd0005c5d FORMAT "%3.0" /end MEASUREMENT
/begin MEASUREMENT egcp[1].egcp_struct_pladgspi1.lv_err_ofs_lsl_up "Debounced diagnosis value caused by an offset correction error of the WRAF Sensor controller" UBYTE _CNV_S_2_RANGE__0___1_CM 1 100. 0. 1. DISPLAY_IDENTIFIER LV_ERR_OFS_LSL_UP[2] ECU_ADDRESS 0xd0005c5e BIT_MASK 0x1 /end MEASUREMENT
/begin MEASUREMENT egcp[1].egcp_struct_pladgspi1.lv_end_diag_ofs_lsl_up "Result of present diagnostis status is valid" UBYTE _CNV_S_2_RANGE__0___1_CM 1 100. 0. 1. DISPLAY_IDENTIFIER LV_END_DIAG_OFS_LSL_UP[2] ECU_ADDRESS 0xd0005c5f BIT_MASK 0x1 /end MEASUREMENT
/begin MEASUREMENT egcp[1].egcp_struct_pladgspi1.lv_lsl_ofs_adj_diag_ofs_old "Value of LV_LS_OFS_ADJ_ACT from last recurrence of the WRAF controller offset diagnosis" UBYTE _CNV_S_2_RANGE__0___1_CM 1 100. 0. 1. DISPLAY_IDENTIFIER LV_LSL_OFS_ADJ_DIAG_OFS_OLD[2] ECU_ADDRESS 0xd0005c60 BIT_MASK 0x1 /end MEASUREMENT
/begin MEASUREMENT egcp[1].egcp_struct_pladgspi1.lv_err_ctl_lsl_up "Debounced result of pump current controller diagnosis" UBYTE _CNV_S_2_RANGE__0___1_CM 1 100. 0. 1. DISPLAY_IDENTIFIER LV_ERR_CTL_LSL_UP[2] ECU_ADDRESS 0xd0005c61 BIT_MASK 0x1 /end MEASUREMENT
/begin MEASUREMENT egcp[1].egcp_struct_pladgspi1.lv_end_diag_ctl_lsl_up "End flag of the pump current controller diagnosis for WRAF sensor controller" UBYTE _CNV_S_2_RANGE__0___1_CM 1 100. 0. 1. DISPLAY_IDENTIFIER LV_END_DIAG_CTL_LSL_UP[2] ECU_ADDRESS 0xd0005c62 BIT_MASK 0x1 /end MEASUREMENT
/begin MEASUREMENT egcp[1].egcp_struct_pladgspii1.cdn_diag_ctl_lsl_di "Permanently disabled monitors for the pump current controller diagnosis" UBYTE _CNV_A_R_LINEAR_____0_CM 1 100. 0. 255. DISPLAY_IDENTIFIER CDN_DIAG_CTL_LSL_DI[2] ECU_ADDRESS 0xd0005c64 FORMAT "%3.0" /end MEASUREMENT
/begin MEASUREMENT egcp[1].egcp_struct_pladgspii1.cdn_diag_ctl_lsl_inh "Temporarily inhibited monitors for the pump current controller diagnosis" UBYTE _CNV_A_R_LINEAR_____0_CM 1 100. 0. 255. DISPLAY_IDENTIFIER CDN_DIAG_CTL_LSL_INH[2] ECU_ADDRESS 0xd0005c65 FORMAT "%3.0" /end MEASUREMENT
/begin MEASUREMENT egcp[1].egcp_struct_pladgspii1.lv_inh_diag_ofs_lsl "Inhibition condition for  the Offset adjustment diagnosis" UBYTE _CNV_S_2_RANGE__0___1_CM 1 100. 0. 1. DISPLAY_IDENTIFIER LV_INH_DIAG_OFS_LSL[2] ECU_ADDRESS 0xd0005c66 BIT_MASK 0x1 /end MEASUREMENT
/begin MEASUREMENT egcp[1].egcp_struct_pladgspii1.lv_inh_diag_ctl_lsl_up "Inhibition condition for  the pump current controller diagnosis" UBYTE _CNV_S_2_RANGE__0___1_CM 1 100. 0. 1. DISPLAY_IDENTIFIER LV_INH_DIAG_CTL_LSL_UP[2] ECU_ADDRESS 0xd0005c67 BIT_MASK 0x1 /end MEASUREMENT
/begin MEASUREMENT egcp[1].egcp_struct_pladglsi0.lv_diag_plaus_inh_lsl_up "Deactivation of Plausibility check of the sensor signal" UBYTE _CNV_S_2_RANGE__0___1_CM 1 100. 0. 1. DISPLAY_IDENTIFIER LV_DIAG_PLAUS_INH_LSL_UP[2] ECU_ADDRESS 0xd0005c98 BIT_MASK 0x1 /end MEASUREMENT
/begin MEASUREMENT egcp[1].egcp_struct_pladglsi0.lv_inh_diag_rbm_plaus_lsl_up "Deactivation of  Rate Base Monitoring of  Plausibility check of the sensor signal" UBYTE _CNV_S_2_RANGE__0___1_CM 1 100. 0. 1. DISPLAY_IDENTIFIER LV_INH_DIAG_RBM_PLAUS_LSL_UP[2] ECU_ADDRESS 0xd0005c99 BIT_MASK 0x1 /end MEASUREMENT
/begin MEASUREMENT egcp[1].egcp_struct_pladglsli0.state_rbm_dyn_vld_ls_up "Interface of DYN_VLD_LS_UP[NC_CBK_EX_NR] monitor with the Rate-Based Monitoring statistics" UBYTE _CNV_A_R_LINEAR_____0_CM 1 100. 0. 255. DISPLAY_IDENTIFIER STATE_RBM_DYN_VLD_LS_UP[2] ECU_ADDRESS 0xd0005c9a FORMAT "%3.0" /end MEASUREMENT
/begin MEASUREMENT egcp[1].egcp_struct_pladglsli0.lv_diag_dyn_inh_lsl_up "Deactivation of \"Diagnosis of the WRAF Sensor Dynamic\"" UBYTE _CNV_S_2_RANGE__0___1_CM 1 100. 0. 1. DISPLAY_IDENTIFIER LV_DIAG_DYN_INH_LSL_UP[2] ECU_ADDRESS 0xd0005c9b BIT_MASK 0x1 /end MEASUREMENT
/begin MEASUREMENT egcp[1].egcp_struct_pladglsli0.lv_inh_diag_rbm_dyn_vld_ls_up "Deactivation of Rate Based Monitoring of  \"Diagnosis of WRAF Sensor Dynamic\" by malfunction" UBYTE _CNV_S_2_RANGE__0___1_CM 1 100. 0. 1. DISPLAY_IDENTIFIER LV_INH_DIAG_RBM_DYN_VLD_LS_UP[2] ECU_ADDRESS 0xd0005c9c BIT_MASK 0x1 /end MEASUREMENT
/begin MEASUREMENT egcp[1].egcp_struct_pladglsli0.lv_diag_eol_dyn_ls_up_dc "Logical Value as reminder for End of Line test within this driving cycle" UBYTE _CNV_S_2_RANGE__0___1_CM 1 100. 0. 1. DISPLAY_IDENTIFIER LV_DIAG_EOL_DYN_LS_UP_DC[2] ECU_ADDRESS 0xd0005c9d BIT_MASK 0x1 /end MEASUREMENT
/begin MEASUREMENT egcp[1].egcp_struct_pladglsli0.lv_diag_eol_dyn_ls_up "Activation of short trip for WRAF sensor dynamic diagnosis" UBYTE _CNV_S_2_RANGE__0___1_CM 1 100. 0. 1. DISPLAY_IDENTIFIER LV_DIAG_EOL_DYN_LS_UP[2] ECU_ADDRESS 0xd0005c9e BIT_MASK 0x1 /end MEASUREMENT
/begin MEASUREMENT egcp[1].egcp_struct_pladglsli5.state_rbm_air_lsl_up "Interface of AIR_LSL_UP[NC_CBK_EX_NR] monitor with the Rate-Based Monitoring statistics" UBYTE _CNV_A_R_LINEAR_____0_CM 1 100. 0. 255. DISPLAY_IDENTIFIER STATE_RBM_AIR_LSL_UP[2] ECU_ADDRESS 0xd0005ca0 FORMAT "%3.0" /end MEASUREMENT
/begin MEASUREMENT egcp[1].egcp_struct_pladglsli5.lv_inh_diag_air_lsl_up "Deactivation of Monitoring Upstream Sensor Signal " UBYTE _CNV_S_2_RANGE__0___1_CM 1 100. 0. 1. DISPLAY_IDENTIFIER LV_INH_DIAG_AIR_LSL_UP[2] ECU_ADDRESS 0xd0005ca1 BIT_MASK 0x1 /end MEASUREMENT
/begin MEASUREMENT egcp[1].egcp_struct_pladglsli5.lv_inh_diag_rbm_air_lsl_up "Deactivation of Rate Based Monitoring of Monitoring Upstream Sensor Signal by malfunction" UBYTE _CNV_S_2_RANGE__0___1_CM 1 100. 0. 1. DISPLAY_IDENTIFIER LV_INH_DIAG_RBM_AIR_LSL_UP[2] ECU_ADDRESS 0xd0005ca2 BIT_MASK 0x1 /end MEASUREMENT
/begin MEASUREMENT egcp[1].egcp_struct_pladglsli5.lv_diag_eol_air_lsl_up_dc "Logical Value as reminder for End of Line test within this driving cycle" UBYTE _CNV_S_2_RANGE__0___1_CM 1 100. 0. 1. DISPLAY_IDENTIFIER LV_DIAG_EOL_AIR_LSL_UP_DC[2] ECU_ADDRESS 0xd0005ca3 BIT_MASK 0x1 /end MEASUREMENT
/begin MEASUREMENT egcp[1].egcp_struct_pladglsli5.lv_diag_eol_air_lsl_up "Activation of short trip for upstream sensor signal monitoring" UBYTE _CNV_S_2_RANGE__0___1_CM 1 100. 0. 1. DISPLAY_IDENTIFIER LV_DIAG_EOL_AIR_LSL_UP[2] ECU_ADDRESS 0xd0005ca4 BIT_MASK 0x1 /end MEASUREMENT
/begin MEASUREMENT egcp[1].egcp_struct_pladglsli2.lv_inh_diag_puc_lsl_up "Deactivation of Monitoring Upstream Sensor Signal during PUC" UBYTE _CNV_S_2_RANGE__0___1_CM 1 100. 0. 1. DISPLAY_IDENTIFIER LV_INH_DIAG_PUC_LSL_UP[2] ECU_ADDRESS 0xd0005ca6 BIT_MASK 0x1 /end MEASUREMENT
/begin MEASUREMENT egcp[1].egcp_struct_pladglsli2.lv_inh_diag_rbm_puc_lsl_up "Deactivation of Monitoring Upstream Sensor Signal during PUC by other other failures" UBYTE _CNV_S_2_RANGE__0___1_CM 1 100. 0. 1. DISPLAY_IDENTIFIER LV_INH_DIAG_RBM_PUC_LSL_UP[2] ECU_ADDRESS 0xd0005ca7 BIT_MASK 0x1 /end MEASUREMENT
/begin MEASUREMENT egcp[1].egcp_struct_pladglsli2.lv_diag_eol_puc_lsl_up "Activation of short trip for Monitoring Upstream Sensor during PUC" UBYTE _CNV_S_2_RANGE__0___1_CM 1 100. 0. 1. DISPLAY_IDENTIFIER LV_DIAG_EOL_PUC_LSL_UP[2] ECU_ADDRESS 0xd0005ca8 BIT_MASK 0x1 /end MEASUREMENT
/begin MEASUREMENT egcp[1].egcp_struct_pladglsli3.lv_diag_act_inh_lsl_up "Deactivation of \"Activity Diagnosis\"" UBYTE _CNV_S_2_RANGE__0___1_CM 1 100. 0. 1. DISPLAY_IDENTIFIER LV_DIAG_ACT_INH_LSL_UP[2] ECU_ADDRESS 0xd0005caa BIT_MASK 0x1 /end MEASUREMENT
/begin MEASUREMENT egcp[1].egcp_struct_sigdglsd3.vls_down_rgn_nt_end "Monitor sensor voltage at the time of leaving regeneration phase of NOx trap, Bank i (i=1.2)" UWORD _CNV_A_R_LINEAR_____2_CM 1 100. 0. 4.9951171875 DISPLAY_IDENTIFIER VLS_DOWN_RGN_NT_END[2] ECU_ADDRESS 0xd0005cc4 FORMAT "%5.3" /end MEASUREMENT
/begin MEASUREMENT egcp[1].egcp_struct_sigdglsd3.maf_int_rgn_nt_s_act "Mass air flow which has passed since activation of stratified mode" UWORD _CNV_A_R_LINEAR_____314_CM 1 100. 0. 2912.66666666667 DISPLAY_IDENTIFIER MAF_INT_RGN_NT_S_ACT[2] ECU_ADDRESS 0xd0005cc6 FORMAT "%7.2" /end MEASUREMENT
/begin MEASUREMENT egcp[1].egcp_struct_sigdglsd3.maf_int_rgn_nt_end "Mass air flow which has passed since last regeneration cycle" UWORD _CNV_A_R_LINEAR_____314_CM 1 100. 0. 2912.66666666667 DISPLAY_IDENTIFIER MAF_INT_RGN_NT_END[2] ECU_ADDRESS 0xd0005cc8 FORMAT "%7.2" /end MEASUREMENT
/begin MEASUREMENT egcp[1].egcp_struct_sigdglsd3.t_rgn_nt_end "Time which has passed after leaving last regeneration cycle" UWORD _CNV_A_R_LINEAR_____110_CM 1 100. 0. 1310.7 DISPLAY_IDENTIFIER T_RGN_NT_END[2] ECU_ADDRESS 0xd0005cca FORMAT "%7.2" /end MEASUREMENT
/begin MEASUREMENT egcp[1].egcp_struct_sigdglsd3.ctr_sym_diag_rgn_nt_ls_down "Counter for internal anti-bounce of error symptom" UWORD _CNV_A_R_LINEAR_____0_CM 1 100. 0. 65535. DISPLAY_IDENTIFIER CTR_SYM_DIAG_RGN_NT_LS_DOWN[2] ECU_ADDRESS 0xd0005ccc FORMAT "%5.0" /end MEASUREMENT
/begin MEASUREMENT egcp[1].egcp_struct_sigdglsd3.vls_down_rgn_nt_dif "Measured Voltage difference used for error detection" SWORD _CNV_A_R_LINEAR_____315_CM 1 100. -5.00000000000182 4.99511718999747 DISPLAY_IDENTIFIER VLS_DOWN_RGN_NT_DIF[2] ECU_ADDRESS 0xd0005cce /end MEASUREMENT
/begin MEASUREMENT egcp[1].egcp_struct_sigdglsd3.ctr_end_diag_rgn_nt_ls_down "Counter for end bit calculation" UBYTE _CNV_A_R_LINEAR_____0_CM 1 100. 0. 255. DISPLAY_IDENTIFIER CTR_END_DIAG_RGN_NT_LS_DOWN[2] ECU_ADDRESS 0xd0005cd0 FORMAT "%3.0" /end MEASUREMENT
/begin MEASUREMENT egcp[1].egcp_struct_sigdglsd3.vls_down_rgn_nt_min_end "minimum monitor sensor voltage during maf integral calculation in stratified mode" UWORD _CNV_A_R_LINEAR_____2_CM 1 100. 0. 4.9951171875 DISPLAY_IDENTIFIER VLS_DOWN_RGN_NT_MIN_END[2] ECU_ADDRESS 0xd0005cd2 FORMAT "%5.3" /end MEASUREMENT
/begin MEASUREMENT egcp[1].egcp_struct_sigdglsd3.vls_down_rgn_nt_min_tmp "temporary minimum monitor sensor voltage during maf integral calculation in stratified mode" UWORD _CNV_A_R_LINEAR_____2_CM 1 100. 0. 4.9951171875 DISPLAY_IDENTIFIER VLS_DOWN_RGN_NT_MIN_TMP[2] ECU_ADDRESS 0xd0005cd4 FORMAT "%5.3" /end MEASUREMENT
/begin MEASUREMENT egcp[1].egcp_struct_sigdglsd3.vls_down_rgn_nt_max_tmp "Temporary maximum monitor sensor voltage during MAF integral calculation in stratified mode" UWORD _CNV_A_R_LINEAR_____2_CM 1 100. 0. 4.9951171875 DISPLAY_IDENTIFIER VLS_DOWN_RGN_NT_MAX_TMP[2] ECU_ADDRESS 0xd0005cd6 FORMAT "%5.3" /end MEASUREMENT
/begin MEASUREMENT egcp[1].egcp_struct_sigdglsd3.vls_down_rgn_nt_mes_sae "test value for diagnosis result evaluation for mode 6 communication" UWORD _CNV_A_R_EGCP_LINEA_353_CM 1 100. 0. 7.9998779296875 DISPLAY_IDENTIFIER VLS_DOWN_RGN_NT_MES_SAE[2] ECU_ADDRESS 0xd0005cd8 FORMAT "%6.4" /end MEASUREMENT
/begin MEASUREMENT egcp[1].egcp_struct_sigdglsd3.vls_down_rgn_nt_min_sae "Minimum voltage threshold for diagnosis result evaluation for mode 6 communication" UWORD _CNV_A_R_EGCP_LINEA_353_CM 1 100. 0. 7.9998779296875 DISPLAY_IDENTIFIER VLS_DOWN_RGN_NT_MIN_SAE[2] ECU_ADDRESS 0xd0005cda FORMAT "%6.4" /end MEASUREMENT
/begin MEASUREMENT egcp[1].egcp_struct_sigdglsd3.lv_diag_act_rgn_nt_ls_down "Logical variable indicating that diagnosis conditions are fulfilled" UBYTE _CNV_S_2_RANGE__0___1_CM 1 100. 0. 1. DISPLAY_IDENTIFIER LV_DIAG_ACT_RGN_NT_LS_DOWN[2] ECU_ADDRESS 0xd0005cdc BIT_MASK 0x1 /end MEASUREMENT
/begin MEASUREMENT egcp[1].egcp_struct_sigdglsd3.lv_diag_rgn_nt_ls_down_err "Debounced diagnosis result for monitoring lean to rich switching times after Nox cat regeneration" UBYTE _CNV_S_2_RANGE__0___1_CM 1 100. 0. 1. DISPLAY_IDENTIFIER LV_DIAG_RGN_NT_LS_DOWN_ERR[2] ECU_ADDRESS 0xd0005cdd BIT_MASK 0x1 /end MEASUREMENT
/begin MEASUREMENT egcp[1].egcp_struct_sigdglsd3.lv_diag_rgn_nt_ls_down_end "End bit for monitoring lean to rich switching times after Nox cat regeneration" UBYTE _CNV_S_2_RANGE__0___1_CM 1 100. 0. 1. DISPLAY_IDENTIFIER LV_DIAG_RGN_NT_LS_DOWN_END[2] ECU_ADDRESS 0xd0005cde BIT_MASK 0x1 /end MEASUREMENT
/begin MEASUREMENT egcp[1].egcp_struct_sigdglsdi3.lv_inh_diag_rgn_nt_ls_down "Logical variable indicating inhibition of downstream oxygen sensor diagnosis after NOx cat regeneration" UBYTE _CNV_S_2_RANGE__0___1_CM 1 100. 0. 1. DISPLAY_IDENTIFIER LV_INH_DIAG_RGN_NT_LS_DOWN[2] ECU_ADDRESS 0xd0005ce0 BIT_MASK 0x1 /end MEASUREMENT
/begin MEASUREMENT egcp[1].egcp_struct_pladglsli4.state_rbm_shift_afl_lsl_up "Interface of SHIFT_AFL_LSL_UP[NC_CBK_EX_NR] monitor with the Rate-Based Monitoring statistics" UBYTE _CNV_A_R_LINEAR_____0_CM 1 100. 0. 255. DISPLAY_IDENTIFIER STATE_RBM_SHIFT_AFL_LSL_UP[2] ECU_ADDRESS 0xd0005ce2 FORMAT "%3.0" /end MEASUREMENT
/begin MEASUREMENT egcp[1].egcp_struct_pladglsli4.state_rbm_shift_afr_lsl_up "Interface of SHIFT_AFR_LSL_UP[NC_CBK_EX_NR] monitor with the Rate-Based Monitoring statistics" UBYTE _CNV_A_R_LINEAR_____0_CM 1 100. 0. 255. DISPLAY_IDENTIFIER STATE_RBM_SHIFT_AFR_LSL_UP[2] ECU_ADDRESS 0xd0005ce3 FORMAT "%3.0" /end MEASUREMENT
/begin MEASUREMENT egcp[1].egcp_struct_pladglsl4.t_dly_diag_shift_down "Delay timer for the end flag of the shift down diagnosis in the no failure case (RBM purpose)" UWORD _CNV_A_R_LINEAR_____4_CM 1 100. 0. 6553.5 DISPLAY_IDENTIFIER T_DLY_DIAG_SHIFT_DOWN[2] ECU_ADDRESS 0xd0005ce4 FORMAT "%6.1" /end MEASUREMENT
/begin MEASUREMENT egcp[1].egcp_struct_pladglsl4.lv_t_dly_diag_shift_down "End flag of the shift down diagnosis in the no failure case (RBM purpose)" UBYTE _CNV_S_2_RANGE__0___1_CM 1 100. 0. 1. DISPLAY_IDENTIFIER LV_T_DLY_DIAG_SHIFT_DOWN[2] ECU_ADDRESS 0xd0005ce6 BIT_MASK 0x1 /end MEASUREMENT
/begin MEASUREMENT egcp[1].egcp_struct_pladglsl6.fac_sum_diag_dyn_s_lsl_up "sum of all diagnostic values for stratified dynamics diagnosis sampled in the current driving cycle" SLONG _CNV_A_R_LINEAR_____28_CM 1 100. -8388608. 8388607.99609375 DISPLAY_IDENTIFIER FAC_SUM_DIAG_DYN_S_LSL_UP[2] ECU_ADDRESS 0xd0005ce8 FORMAT "%12.3" /end MEASUREMENT
/begin MEASUREMENT egcp[1].egcp_struct_pladglsl6.fac_mv_diag_dyn_s_lsl_up "final diagnostic value of stratified dynamics diagnosis" SWORD _CNV_A_R_LINEAR_____28_CM 1 100. -128. 127.99609375 DISPLAY_IDENTIFIER FAC_MV_DIAG_DYN_S_LSL_UP[2] ECU_ADDRESS 0xd0005cec FORMAT "%11.6" /end MEASUREMENT
/begin MEASUREMENT egcp[1].egcp_struct_pladglsl6.fac_mv_diag_dyn_s_lsl_up_sae "Mode 6 output of diagnostic result of upstream stratified dynamics diagnosis" SWORD _CNV_A_R_EGCP_LINEA_354_CM 1 100. -327.68 327.67 DISPLAY_IDENTIFIER FAC_MV_DIAG_DYN_S_LSL_UP_SAE[2] ECU_ADDRESS 0xd0005cee FORMAT "%7.2" /end MEASUREMENT
/begin MEASUREMENT egcp[1].egcp_struct_pladglsl6.fac_value_diag_dyn_s_lsl_up "last sample of stratified dynamics diagnosis value" SWORD _CNV_A_R_LINEAR_____28_CM 1 100. -128. 127.99609375 DISPLAY_IDENTIFIER FAC_VALUE_DIAG_DYN_S_LSL_UP[2] ECU_ADDRESS 0xd0005cf0 FORMAT "%11.6" /end MEASUREMENT
/begin MEASUREMENT egcp[1].egcp_struct_pladglsl6.conc_o2_mes_diag_dyn_s "O2 concentration derived from measured lambda value from sensor" SWORD _CNV_A_R_LINEAR_____24_CM 1 100. -2. 1.99993896484375 DISPLAY_IDENTIFIER CONC_O2_MES_DIAG_DYN_S[2] ECU_ADDRESS 0xd0005cf2 FORMAT "%8.5" /end MEASUREMENT
/begin MEASUREMENT egcp[1].egcp_struct_pladglsl6.conc_o2_mes_max_diag_dyn_s "measured O2 concentration at time of last transition out of homogenous combustion mode" SWORD _CNV_A_R_LINEAR_____24_CM 1 100. -2. 1.99993896484375 DISPLAY_IDENTIFIER CONC_O2_MES_MAX_DIAG_DYN_S[2] ECU_ADDRESS 0xd0005cf4 FORMAT "%8.5" /end MEASUREMENT
/begin MEASUREMENT egcp[1].egcp_struct_pladglsl6.conc_o2_clc_diag_dyn_s "O2 concentration derived from lambda value of sensor model" SWORD _CNV_A_R_LINEAR_____24_CM 1 100. -2. 1.99993896484375 DISPLAY_IDENTIFIER CONC_O2_CLC_DIAG_DYN_S[2] ECU_ADDRESS 0xd0005cf6 FORMAT "%8.5" /end MEASUREMENT
/begin MEASUREMENT egcp[1].egcp_struct_pladglsl6.conc_o2_clc_int_diag_dyn_s "integral of modelled O2 concentration in stratified dynamics diagnosis" SWORD _CNV_A_R_LINEAR_____24_CM 1 100. -2. 1.99993896484375 DISPLAY_IDENTIFIER CONC_O2_CLC_INT_DIAG_DYN_S[2] ECU_ADDRESS 0xd0005cf8 FORMAT "%8.5" /end MEASUREMENT
/begin MEASUREMENT egcp[1].egcp_struct_pladglsl6.conc_o2_dif_int_diag_dyn_s "integral of the difference between modelled and measured O2 concentration in stratified dynamics diagnosis" SWORD _CNV_A_R_LINEAR_____24_CM 1 100. -2. 1.99993896484375 DISPLAY_IDENTIFIER CONC_O2_DIF_INT_DIAG_DYN_S[2] ECU_ADDRESS 0xd0005cfa FORMAT "%8.5" /end MEASUREMENT
/begin MEASUREMENT egcp[1].egcp_struct_pladglsl6.conc_o2_mes_diag_dyn_s_st "measured O2 concentration at time of last transition out of homogenous combustion mode" SWORD _CNV_A_R_LINEAR_____24_CM 1 100. -2. 1.99993896484375 DISPLAY_IDENTIFIER CONC_O2_MES_DIAG_DYN_S_ST[2] ECU_ADDRESS 0xd0005cfc FORMAT "%8.5" /end MEASUREMENT
/begin MEASUREMENT egcp[1].egcp_struct_pladglsl6.conc_o2_clc_diag_dyn_s_st "O2 concentration from sensor model at the last transition out of homogenous combustion mode" SWORD _CNV_A_R_LINEAR_____24_CM 1 100. -2. 1.99993896484375 DISPLAY_IDENTIFIER CONC_O2_CLC_DIAG_DYN_S_ST[2] ECU_ADDRESS 0xd0005cfe FORMAT "%8.5" /end MEASUREMENT
/begin MEASUREMENT egcp[1].egcp_struct_pladglsl6.ctr_diag_dyn_s_lsl_up "number of valid diagnostic samples in the current driving cycle" UWORD _CNV_A_R_LINEAR_____0_CM 1 100. 0. 65535. DISPLAY_IDENTIFIER CTR_DIAG_DYN_S_LSL_UP[2] ECU_ADDRESS 0xd0005d00 FORMAT "%5.0" /end MEASUREMENT
/begin MEASUREMENT egcp[1].egcp_struct_pladglsl6.maf_int_diag_dyn_s_act "MAF integral since transition out of homogenous combustion mode" UWORD _CNV_A_R_LINEAR_____314_CM 1 100. 0. 2912.66666666667 DISPLAY_IDENTIFIER MAF_INT_DIAG_DYN_S_ACT[2] ECU_ADDRESS 0xd0005d02 FORMAT "%7.2" /end MEASUREMENT
/begin MEASUREMENT egcp[1].egcp_struct_pladglsl6.state_sym_diag_dyn_s_lsl_up "error symptom from stratified dynamics diagnosis" UBYTE _CNV_A_R_LINEAR_____0_CM 1 100. 0. 255. DISPLAY_IDENTIFIER STATE_SYM_DIAG_DYN_S_LSL_UP[2] ECU_ADDRESS 0xd0005d04 FORMAT "%3.0" /end MEASUREMENT
/begin MEASUREMENT egcp[1].egcp_struct_pladglsl6.lv_diag_dyn_s_lsl_up_end "End flag from stratified combustion lambda sensor dynamics diagnosis" UBYTE _CNV_S_2_RANGE__0___1_CM 1 100. 0. 1. DISPLAY_IDENTIFIER LV_DIAG_DYN_S_LSL_UP_END[2] ECU_ADDRESS 0xd0005d05 BIT_MASK 0x1 /end MEASUREMENT
/begin MEASUREMENT egcp[1].egcp_struct_pladglsl6.lv_diag_dyn_s_lsl_up_err "error signalization from stratified dynamics diagnosis" UBYTE _CNV_S_2_RANGE__0___1_CM 1 100. 0. 1. DISPLAY_IDENTIFIER LV_DIAG_DYN_S_LSL_UP_ERR[2] ECU_ADDRESS 0xd0005d06 BIT_MASK 0x1 /end MEASUREMENT
/begin MEASUREMENT egcp[1].egcp_struct_pladglsl6.lv_diag_dyn_s_lsl_up_sample "signals that a new diagnostic sample should be calculated and included into the average" UBYTE _CNV_S_2_RANGE__0___1_CM 1 100. 0. 1. DISPLAY_IDENTIFIER LV_DIAG_DYN_S_LSL_UP_SAMPLE[2] ECU_ADDRESS 0xd0005d07 BIT_MASK 0x1 /end MEASUREMENT
/begin MEASUREMENT egcp[1].egcp_struct_pladglsl6.lv_diag_dyn_s_lsl_up_stop "signals that the diagnosis shall sleep until reactivated by another homogenous combustion phase" UBYTE _CNV_S_2_RANGE__0___1_CM 1 100. 0. 1. DISPLAY_IDENTIFIER LV_DIAG_DYN_S_LSL_UP_STOP[2] ECU_ADDRESS 0xd0005d08 BIT_MASK 0x1 /end MEASUREMENT
/begin MEASUREMENT egcp[1].egcp_struct_pladglsli6.lv_inh_dyn_diag_s_lsl_up "Inhibition of linear lambda sensor dynamic diagnosis for stratified combustion" UBYTE _CNV_S_2_RANGE__0___1_CM 1 100. 0. 1. DISPLAY_IDENTIFIER LV_INH_DYN_DIAG_S_LSL_UP[2] ECU_ADDRESS 0xd0005d0c BIT_MASK 0x1 /end MEASUREMENT
/begin MEASUREMENT egcp[1].egcp_struct_sigdglsd4.lamb_sp_osc_chk "lambda setpoint requested by oscillation check for downstream lambda sensor" UWORD _CNV_A_R_LINEAR_____129_CM 1 100. 0. 31.9990234375 DISPLAY_IDENTIFIER LAMB_SP_OSC_CHK[2] ECU_ADDRESS 0xd0005d0e FORMAT "%7.4" /end MEASUREMENT
/begin MEASUREMENT egcp[1].egcp_struct_sigdglsd4.lv_err_osc_chk "Debounced failure of oscillation diagnosis for downstream sensor" UBYTE _CNV_S_2_RANGE__0___1_CM 1 100. 0. 1. DISPLAY_IDENTIFIER LV_ERR_OSC_CHK[2] ECU_ADDRESS 0xd0005d10 BIT_MASK 0x1 /end MEASUREMENT
/begin MEASUREMENT egcp[1].egcp_struct_sigdglsd4.lv_end_diag_osc_chk "End of oscillation diagnosis for downstream sensor" UBYTE _CNV_S_2_RANGE__0___1_CM 1 100. 0. 1. DISPLAY_IDENTIFIER LV_END_DIAG_OSC_CHK[2] ECU_ADDRESS 0xd0005d11 BIT_MASK 0x1 /end MEASUREMENT
/begin CHARACTERISTIC c_teg_min_plaus_lsl_up[0] "Minimum temperature of the catalyst to carry out the plausibility" VALUE 0xa0801602 _REC_VAL_20_u2 2047.9375 _CNV_A_R_LINEAR_____214_CM -273.15 1774.7875 DISPLAY_IDENTIFIER C_TEG_MIN_PLAUS_LSL_UP[1] FORMAT "%9.4" /end CHARACTERISTIC
/begin CHARACTERISTIC c_teg_min_plaus_lsl_up[1] "Minimum temperature of the catalyst to carry out the plausibility" VALUE 0xa0801604 _REC_VAL_20_u2 2047.9375 _CNV_A_R_LINEAR_____214_CM -273.15 1774.7875 DISPLAY_IDENTIFIER C_TEG_MIN_PLAUS_LSL_UP[2] FORMAT "%9.4" /end CHARACTERISTIC
/begin CHARACTERISTIC c_teg_max_plaus_lsl_up[0] "Maximum temperature of the catalyst to carry out the plausibility" VALUE 0xa08015f8 _REC_VAL_20_u2 2047.9375 _CNV_A_R_LINEAR_____214_CM -273.15 1774.7875 DISPLAY_IDENTIFIER C_TEG_MAX_PLAUS_LSL_UP[1] FORMAT "%9.4" /end CHARACTERISTIC
/begin CHARACTERISTIC c_teg_max_plaus_lsl_up[1] "Maximum temperature of the catalyst to carry out the plausibility" VALUE 0xa08015fa _REC_VAL_20_u2 2047.9375 _CNV_A_R_LINEAR_____214_CM -273.15 1774.7875 DISPLAY_IDENTIFIER C_TEG_MAX_PLAUS_LSL_UP[2] FORMAT "%9.4" /end CHARACTERISTIC
/begin CHARACTERISTIC c_maf_kgh_min_diag_plaus_lsl_up "Minimum mass air flow to carry out the plausibility" VALUE 0xa08014d8 _REC_VAL_20_u2 2047.96875 _CNV_A_R_LINEAR_____215_CM 0. 2047.96875 DISPLAY_IDENTIFIER C_MAF_KGH_MIN_DIAG_PLAUS_LSL_UP FORMAT "%10.5" /end CHARACTERISTIC
/begin CHARACTERISTIC c_maf_kgh_max_diag_plaus_lsl_up "Maximum mass air flow to carry out the plausibility" VALUE 0xa08014d2 _REC_VAL_20_u2 2047.96875 _CNV_A_R_LINEAR_____215_CM 0. 2047.96875 DISPLAY_IDENTIFIER C_MAF_KGH_MAX_DIAG_PLAUS_LSL_UP FORMAT "%10.5" /end CHARACTERISTIC
/begin CHARACTERISTIC c_n_min_diag_plaus_lsl_up "Lower engine speed admitted to carry out the plausibility" VALUE 0xa080150c _REC_VAL_20_u1 8160. _CNV_A_R_LINEAR_____10_CM 0. 8160. DISPLAY_IDENTIFIER C_N_MIN_DIAG_PLAUS_LSL_UP FORMAT "%4.0" /end CHARACTERISTIC
/begin CHARACTERISTIC c_vls_down_afl_plaus_lsl_up[0] "Lean-mixture threshold of the downstream sensor voltage" VALUE 0xa0801662 _REC_VAL_20_u2 4.9951171875 _CNV_A_R_LINEAR_____2_CM 0. 4.9951171875 DISPLAY_IDENTIFIER C_VLS_DOWN_AFL_PLAUS_LSL_UP[1] FORMAT "%5.3" /end CHARACTERISTIC
/begin CHARACTERISTIC c_vls_down_afl_plaus_lsl_up[1] "Lean-mixture threshold of the downstream sensor voltage" VALUE 0xa0801664 _REC_VAL_20_u2 4.9951171875 _CNV_A_R_LINEAR_____2_CM 0. 4.9951171875 DISPLAY_IDENTIFIER C_VLS_DOWN_AFL_PLAUS_LSL_UP[2] FORMAT "%5.3" /end CHARACTERISTIC
/begin CHARACTERISTIC c_vls_down_afr_plaus_lsl_up[0] "Rich-mixture threshold of the downstream sensor voltage" VALUE 0xa0801668 _REC_VAL_20_u2 4.9951171875 _CNV_A_R_LINEAR_____2_CM 0. 4.9951171875 DISPLAY_IDENTIFIER C_VLS_DOWN_AFR_PLAUS_LSL_UP[1] FORMAT "%5.3" /end CHARACTERISTIC
/begin CHARACTERISTIC c_vls_down_afr_plaus_lsl_up[1] "Rich-mixture threshold of the downstream sensor voltage" VALUE 0xa080166a _REC_VAL_20_u2 4.9951171875 _CNV_A_R_LINEAR_____2_CM 0. 4.9951171875 DISPLAY_IDENTIFIER C_VLS_DOWN_AFR_PLAUS_LSL_UP[2] FORMAT "%5.3" /end CHARACTERISTIC
/begin CHARACTERISTIC c_lamb_afl_plaus_lsl_up[0] "Lean-mixture threshold of the upstream sensor voltage" VALUE 0xa080143c _REC_VAL_20_u2 31.9990234375 _CNV_A_R_LINEAR_____129_CM 0. 31.9990234375 DISPLAY_IDENTIFIER C_LAMB_AFL_PLAUS_LSL_UP[1] FORMAT "%7.4" /end CHARACTERISTIC
/begin CHARACTERISTIC c_lamb_afl_plaus_lsl_up[1] "Lean-mixture threshold of the upstream sensor voltage" VALUE 0xa080143e _REC_VAL_20_u2 31.9990234375 _CNV_A_R_LINEAR_____129_CM 0. 31.9990234375 DISPLAY_IDENTIFIER C_LAMB_AFL_PLAUS_LSL_UP[2] FORMAT "%7.4" /end CHARACTERISTIC
/begin CHARACTERISTIC c_lamb_afr_plaus_lsl_up[0] "Rich-mixture threshold of the upstream sensor voltage" VALUE 0xa0801446 _REC_VAL_20_u2 31.9990234375 _CNV_A_R_LINEAR_____129_CM 0. 31.9990234375 DISPLAY_IDENTIFIER C_LAMB_AFR_PLAUS_LSL_UP[1] FORMAT "%7.4" /end CHARACTERISTIC
/begin CHARACTERISTIC c_lamb_afr_plaus_lsl_up[1] "Rich-mixture threshold of the upstream sensor voltage" VALUE 0xa0801448 _REC_VAL_20_u2 31.9990234375 _CNV_A_R_LINEAR_____129_CM 0. 31.9990234375 DISPLAY_IDENTIFIER C_LAMB_AFR_PLAUS_LSL_UP[2] FORMAT "%7.4" /end CHARACTERISTIC
/begin CHARACTERISTIC c_tco_min_diag_plaus_lsl_up "Minimum threshold of the cooling-water temperature to activate the function" VALUE 0xa08015e4 _REC_VAL_20_u1 190.5 _CNV_A_R_LINEAR_____17_CM -48. 142.5 DISPLAY_IDENTIFIER C_TCO_MIN_DIAG_PLAUS_LSL_UP FORMAT "%6.2" /end CHARACTERISTIC
/begin CHARACTERISTIC c_maf_sym_plaus_lsl_up[0] "MAF integral threshold for detection of mutual not plausible sensor signals" VALUE 0xa08014f0 _REC_VAL_20_u2 1820.41666666667 _CNV_A_R_LINEAR_____287_CM 0. 1820.41666666667 DISPLAY_IDENTIFIER C_MAF_SYM_PLAUS_LSL_UP[1] FORMAT "%7.2" /end CHARACTERISTIC
/begin CHARACTERISTIC c_maf_sym_plaus_lsl_up[1] "MAF integral threshold for detection of mutual not plausible sensor signals" VALUE 0xa08014f2 _REC_VAL_20_u2 1820.41666666667 _CNV_A_R_LINEAR_____287_CM 0. 1820.41666666667 DISPLAY_IDENTIFIER C_MAF_SYM_PLAUS_LSL_UP[2] FORMAT "%7.2" /end CHARACTERISTIC
/begin CHARACTERISTIC c_maf_sym_raw_rst_plaus_lsl_up[0] "MAF integral threshold for reset of raw symptom" VALUE 0xa08014f8 _REC_VAL_20_u2 1820.41666666667 _CNV_A_R_LINEAR_____287_CM 0. 1820.41666666667 DISPLAY_IDENTIFIER C_MAF_SYM_RAW_RST_PLAUS_LSL_UP[1] FORMAT "%7.2" /end CHARACTERISTIC
/begin CHARACTERISTIC c_maf_sym_raw_rst_plaus_lsl_up[1] "MAF integral threshold for reset of raw symptom" VALUE 0xa08014fa _REC_VAL_20_u2 1820.41666666667 _CNV_A_R_LINEAR_____287_CM 0. 1820.41666666667 DISPLAY_IDENTIFIER C_MAF_SYM_RAW_RST_PLAUS_LSL_UP[2] FORMAT "%7.2" /end CHARACTERISTIC
/begin CHARACTERISTIC c_maf_sym_raw_plaus_lsl_up[0] "MAF integral threshold for compensation of the catalyst delay" VALUE 0xa08014f4 _REC_VAL_20_u2 1820.41666666667 _CNV_A_R_LINEAR_____287_CM 0. 1820.41666666667 DISPLAY_IDENTIFIER C_MAF_SYM_RAW_PLAUS_LSL_UP[1] FORMAT "%7.2" /end CHARACTERISTIC
/begin CHARACTERISTIC c_maf_sym_raw_plaus_lsl_up[1] "MAF integral threshold for compensation of the catalyst delay" VALUE 0xa08014f6 _REC_VAL_20_u2 1820.41666666667 _CNV_A_R_LINEAR_____287_CM 0. 1820.41666666667 DISPLAY_IDENTIFIER C_MAF_SYM_RAW_PLAUS_LSL_UP[2] FORMAT "%7.2" /end CHARACTERISTIC
/begin CHARACTERISTIC c_ctr_min_diag_dyn_lsl_up "Number of  forced stimulation periods needed to calculate the short term mean value" VALUE 0xa08013ca _REC_VAL_20_u1 255. _CNV_A_R_LINEAR_____0_CM 0. 255. DISPLAY_IDENTIFIER C_CTR_MIN_DIAG_DYN_LSL_UP FORMAT "%3.0" /end CHARACTERISTIC
/begin CHARACTERISTIC c_ctr_min_diag_eol_dyn_lsl_up "Number of  forced stimulation periods needed to calculate the short term mean value (EOL test)" VALUE 0xa08013cb _REC_VAL_20_u1 255. _CNV_A_R_LINEAR_____0_CM 0. 255. DISPLAY_IDENTIFIER C_CTR_MIN_DIAG_EOL_DYN_LSL_UP FORMAT "%3.0" /end CHARACTERISTIC
/begin CHARACTERISTIC c_ctr_wait_diag_dyn_lsl_up "Number of  forced stimulation periods during the diagnosis status transition \"wait\"  to  \"acquisition\"" VALUE 0xa08013e4 _REC_VAL_20_u1 255. _CNV_A_R_LINEAR_____0_CM 0. 255. DISPLAY_IDENTIFIER C_CTR_WAIT_DIAG_DYN_LSL_UP FORMAT "%3.0" /end CHARACTERISTIC
/begin CHARACTERISTIC c_cycnr_min_diag_dyn_lsl_up "Minimum number of short term mean values to calculate the long term mean value" VALUE 0xa08013e8 _REC_VAL_20_u1 255. _CNV_A_R_LINEAR_____0_CM 0. 255. DISPLAY_IDENTIFIER C_CYCNR_MIN_DIAG_DYN_LSL_UP FORMAT "%3.0" /end CHARACTERISTIC
/begin CHARACTERISTIC c_cycnr_end_diag_dyn_lsl_up "Number of long term mean values to deliver the sensor dynamic diagnostic" VALUE 0xa08013e5 _REC_VAL_20_u1 255. _CNV_A_R_LINEAR_____0_CM 0. 255. DISPLAY_IDENTIFIER C_CYCNR_END_DIAG_DYN_LSL_UP FORMAT "%3.0" /end CHARACTERISTIC
/begin CHARACTERISTIC c_cycnr_eol_diag_dyn_lsl_up "Number of long term mean values to deliver the sensor dynamic diagnostic (EOL test)" VALUE 0xa08013e6 _REC_VAL_20_u1 255. _CNV_A_R_LINEAR_____0_CM 0. 255. DISPLAY_IDENTIFIER C_CYCNR_EOL_DIAG_DYN_LSL_UP FORMAT "%3.0" /end CHARACTERISTIC
/begin CHARACTERISTIC c_n_min_diag_dyn_lsl_up "Minimum engine speed to activate the diagnosis" VALUE 0xa080150b _REC_VAL_20_u1 8160. _CNV_A_R_LINEAR_____10_CM 0. 8160. DISPLAY_IDENTIFIER C_N_MIN_DIAG_DYN_LSL_UP FORMAT "%4.0" /end CHARACTERISTIC
/begin CHARACTERISTIC c_n_max_diag_dyn_lsl_up "Maximum engine speed to activate the diagnosis" VALUE 0xa0801506 _REC_VAL_20_u1 8160. _CNV_A_R_LINEAR_____10_CM 0. 8160. DISPLAY_IDENTIFIER C_N_MAX_DIAG_DYN_LSL_UP FORMAT "%4.0" /end CHARACTERISTIC
/begin CHARACTERISTIC c_maf_max_diag_dyn_lsl_up "Maximum mass airflow rate to activate the diagnosis function" VALUE 0xa08014e2 _REC_VAL_20_u2 1389. _CNV_A_R_LINEAR_____111_CM 0. 1389. DISPLAY_IDENTIFIER C_MAF_MAX_DIAG_DYN_LSL_UP FORMAT "%7.2" /end CHARACTERISTIC
/begin CHARACTERISTIC c_maf_min_diag_dyn_lsl_up "Minimum mass airflow rate to activate the diagnosis function" VALUE 0xa08014e8 _REC_VAL_20_u2 1389. _CNV_A_R_LINEAR_____111_CM 0. 1389. DISPLAY_IDENTIFIER C_MAF_MIN_DIAG_DYN_LSL_UP FORMAT "%7.2" /end CHARACTERISTIC
/begin CHARACTERISTIC c_crlc_lpf_lamb_diag_dyn_lsl_up "Correlation factor for low pass filtered lambda value" VALUE 0xa08013a6 _REC_VAL_20_u2 0.9999847412109381 _CNV_A_R_LINEAR_____89_CM 0. 0.9999847412109381 DISPLAY_IDENTIFIER C_CRLC_LPF_LAMB_DIAG_DYN_LSL_UP FORMAT "%7.5" /end CHARACTERISTIC
/begin CHARACTERISTIC c_lamb_min_diag_dyn_lsl_up "Lowest allowed sensor signal min value" VALUE 0xa0801466 _REC_VAL_20_u2 31.9990234375 _CNV_A_R_LINEAR_____129_CM 0. 31.9990234375 DISPLAY_IDENTIFIER C_LAMB_MIN_DIAG_DYN_LSL_UP FORMAT "%7.4" /end CHARACTERISTIC
/begin CHARACTERISTIC c_lamb_max_diag_dyn_lsl_up "Highest allowed sensor signal max value" VALUE 0xa0801464 _REC_VAL_20_u2 31.9990234375 _CNV_A_R_LINEAR_____129_CM 0. 31.9990234375 DISPLAY_IDENTIFIER C_LAMB_MAX_DIAG_DYN_LSL_UP FORMAT "%7.4" /end CHARACTERISTIC
/begin CHARACTERISTIC c_lamb_ampl_min_dyn_lsl_up "Calibration data for adjust the expected amplitude:  low range" VALUE 0xa080144d _REC_VAL_20_u1 0.124023 _CNV_A_R_EGCP_LINEA_346_CM 0. 0.124023 DISPLAY_IDENTIFIER C_LAMB_AMPL_MIN_DYN_LSL_UP FORMAT "%6.4" /end CHARACTERISTIC
/begin CHARACTERISTIC c_lamb_ampl_max_dyn_lsl_up "Calibration data for adjust the expected amplitude:  high range" VALUE 0xa080144c _REC_VAL_20_u1 0.124023 _CNV_A_R_EGCP_LINEA_346_CM 0. 0.124023 DISPLAY_IDENTIFIER C_LAMB_AMPL_MAX_DYN_LSL_UP FORMAT "%6.4" /end CHARACTERISTIC
/begin CHARACTERISTIC c_fac_mv_thd_diag_dyn_lsl_up "Limited diagnosis value for the error diagnosis" VALUE 0xa080140e _REC_VAL_20_u2 31.9990234375 _CNV_A_R_LINEAR_____129_CM 0. 31.9990234375 DISPLAY_IDENTIFIER C_FAC_MV_THD_DIAG_DYN_LSL_UP FORMAT "%7.4" /end CHARACTERISTIC
/begin CHARACTERISTIC c_fac_ad_thd_diag_dyn_lsl_up "Diagnosis value threshold for begin adaptation of sensor time constant model" VALUE 0xa08013ec _REC_VAL_20_u2 31.9990234375 _CNV_A_R_LINEAR_____129_CM 0. 31.9990234375 DISPLAY_IDENTIFIER C_FAC_AD_THD_DIAG_DYN_LSL_UP FORMAT "%7.4" /end CHARACTERISTIC
/begin CHARACTERISTIC c_fac_ad_rst_diag_dyn_lsl_up "Diagnosis value threshold to reset adaptation of sensor time constant model" VALUE 0xa08013ea _REC_VAL_20_u2 31.9990234375 _CNV_A_R_LINEAR_____129_CM 0. 31.9990234375 DISPLAY_IDENTIFIER C_FAC_AD_RST_DIAG_DYN_LSL_UP FORMAT "%7.4" /end CHARACTERISTIC
/begin CHARACTERISTIC c_crlc_lpf_fac_ad_dyn_lsl_up "Correlation factor for low pass filtered (sensor time constant) adaptation factor" VALUE 0xa08013a3 _REC_VAL_20_u1 0.99609375 _CNV_A_R_LINEAR_____28_CM 0. 0.99609375 DISPLAY_IDENTIFIER C_CRLC_LPF_FAC_AD_DYN_LSL_UP FORMAT "%5.3" /end CHARACTERISTIC
/begin CHARACTERISTIC lc_diag_dyn_lsl_up_cat_syn "Boolean switch to synchronise the dynamic diagnosis with the catalyst efficiency diagnosis" VALUE 0xa08016cd _REC_VAL_20_u1 1. _CNV_A_R_LINEAR_____0_CM 0. 1. DISPLAY_IDENTIFIER LC_DIAG_DYN_LSL_UP_CAT_SYN FORMAT "%1.0" /end CHARACTERISTIC
/begin CHARACTERISTIC lc_t1_ad_diag_dyn_lsl_up "Boolean switch to allow the adaptation of the sensor time constant model T1_LSL_UP[i]" VALUE 0xa080171d _REC_VAL_20_u1 1. _CNV_A_R_LINEAR_____0_CM 0. 1. DISPLAY_IDENTIFIER LC_T1_AD_DIAG_DYN_LSL_UP FORMAT "%1.0" /end CHARACTERISTIC
/begin CHARACTERISTIC ip_lamb_ampl_max_dyn_lsl_up "Nominal sensor expected amplitude during the Dynamic Diagnosis Rem.: The same points in LDPM_N_32_2_EGTR and LDPM_MAF_HB_2_EGTR shall be used" MAP 0xa08011f0 _REC_MAP_20_u1_u1_u1 0.124023 _CNV_A_R_EGCP_LINEA_346_CM 0. 0.124023 DISPLAY_IDENTIFIER IP_LAMB_AMPL_MAX_DYN_LSL_UP FORMAT "%6.4"
 /begin AXIS_DESCR COM_AXIS n_32 _CNV_A_R_LINEAR_____10_CM 8 0. 8160. FORMAT "%4.0" AXIS_PTS_REF ldpm_n_32_ls_up_dyn /end AXIS_DESCR
 /begin AXIS_DESCR COM_AXIS maf_hb _CNV_A_R_LINEAR_____15_CM 8 0. 1389. FORMAT "%4.0" AXIS_PTS_REF ldpm_maf_hb_ls_up_dyn /end AXIS_DESCR
/end CHARACTERISTIC
/begin CHARACTERISTIC ip_lamb_ampl_min_dyn_lsl_up "Limit sensor expected amplitude during the Dynamic Diagnosis Rem.: The same points in LDPM_N_32_2_EGTR and LDPM_MAF_HB_2_EGTR shall be used" MAP 0xa0801230 _REC_MAP_20_u1_u1_u1 0.124023 _CNV_A_R_EGCP_LINEA_346_CM 0. 0.124023 DISPLAY_IDENTIFIER IP_LAMB_AMPL_MIN_DYN_LSL_UP FORMAT "%6.4"
 /begin AXIS_DESCR COM_AXIS n_32 _CNV_A_R_LINEAR_____10_CM 8 0. 8160. FORMAT "%4.0" AXIS_PTS_REF ldpm_n_32_ls_up_dyn /end AXIS_DESCR
 /begin AXIS_DESCR COM_AXIS maf_hb _CNV_A_R_LINEAR_____15_CM 8 0. 1389. FORMAT "%4.0" AXIS_PTS_REF ldpm_maf_hb_ls_up_dyn /end AXIS_DESCR
/end CHARACTERISTIC
/begin CHARACTERISTIC ip_t_dyn_diag "Amplitude measurement time: same points than in LDPM_N_32_2_EGTR and LDPM_MAF_HB_2_EGTR shall be used" MAP 0xa080d690 _REC_MAP_20_u2_u1_u1 1310.7 _CNV_A_R_LINEAR_____110_CM 0. 1310.7 DISPLAY_IDENTIFIER IP_T_DYN_DIAG FORMAT "%7.2"
 /begin AXIS_DESCR COM_AXIS n_32 _CNV_A_R_LINEAR_____10_CM 8 0. 8160. FORMAT "%4.0" AXIS_PTS_REF ldpm_n_32_ls_up_dyn /end AXIS_DESCR
 /begin AXIS_DESCR COM_AXIS maf_hb _CNV_A_R_LINEAR_____15_CM 8 0. 1389. FORMAT "%4.0" AXIS_PTS_REF ldpm_maf_hb_ls_up_dyn /end AXIS_DESCR
/end CHARACTERISTIC
/begin MEASUREMENT ctr_min_diag_dyn_lsl_up "Minimum number of  carried out single valid amplitude measurements" UBYTE _CNV_A_R_LINEAR_____0_CM 1 100. 0. 255. DISPLAY_IDENTIFIER CTR_MIN_DIAG_DYN_LSL_UP ECU_ADDRESS 0xd0002304 FORMAT "%3.0" /end MEASUREMENT
/begin MEASUREMENT lv_err_dyn_vld_ls_up_1 "Boolean flag indicating the validation of correspondent symptom (transmitted to the error management)" UBYTE _CNV_S_2_RANGE__0___1_CM 1 100. 0. 1. DISPLAY_IDENTIFIER LV_ERR_DYN_VLD_LS_UP[1] ECU_ADDRESS 0xd0007ff7 BIT_MASK 0x1 /end MEASUREMENT
/begin MEASUREMENT lv_err_dyn_vld_ls_up_2 "Boolean flag indicating the validation of correspondent symptom (transmitted to the error management)" UBYTE _CNV_S_2_RANGE__0___1_CM 1 100. 0. 1. DISPLAY_IDENTIFIER LV_ERR_DYN_VLD_LS_UP[2] ECU_ADDRESS 0xd0008012 BIT_MASK 0x1 /end MEASUREMENT
/begin CHARACTERISTIC c_t_diag_sym_puc_lsl_up "Time filter to detect a symptom" VALUE 0xa0801548 _REC_VAL_20_u2 6553.5 _CNV_A_R_LINEAR_____4_CM 0. 6553.5 DISPLAY_IDENTIFIER C_T_DIAG_SYM_PUC_LSL_UP FORMAT "%6.1" /end CHARACTERISTIC
/begin CHARACTERISTIC c_t_diag_sym_eol_puc_lsl_up "Time filter to detect a symptom (EOL test)" VALUE 0xa0801546 _REC_VAL_20_u2 6553.5 _CNV_A_R_LINEAR_____4_CM 0. 6553.5 DISPLAY_IDENTIFIER C_T_DIAG_SYM_EOL_PUC_LSL_UP FORMAT "%6.1" /end CHARACTERISTIC
/begin CHARACTERISTIC c_t_dly_diag_puc_lsl_up "Waiting time after beginning of PUC to test sensor signal " VALUE 0xa0801554 _REC_VAL_20_u2 6553.5 _CNV_A_R_LINEAR_____4_CM 0. 6553.5 DISPLAY_IDENTIFIER C_T_DLY_DIAG_PUC_LSL_UP FORMAT "%6.1" /end CHARACTERISTIC
/begin CHARACTERISTIC c_t_dly_diag_eol_puc_lsl_up "Waiting time after beginning of PUC to test sensor signal (EOL test)" VALUE 0xa0801550 _REC_VAL_20_u2 6553.5 _CNV_A_R_LINEAR_____4_CM 0. 6553.5 DISPLAY_IDENTIFIER C_T_DLY_DIAG_EOL_PUC_LSL_UP FORMAT "%6.1" /end CHARACTERISTIC
/begin CHARACTERISTIC c_vls_up_diag_afs_puc_lsl_up "Upstream sensor output voltage in PUC corresponding to Open Circuit on WRAF Sensor" VALUE 0xa08016aa _REC_VAL_20_s2 319.9951171875 _CNV_A_R_LINEAR_____2_CM -160. 159.9951171875 DISPLAY_IDENTIFIER C_VLS_UP_DIAG_AFS_PUC_LSL_UP FORMAT "%8.3" /end CHARACTERISTIC
/begin CHARACTERISTIC c_vls_up_diag_min_puc_lsl_up "Minimum admissible upstream sensor output voltage in PUC" VALUE 0xa08016b2 _REC_VAL_20_s2 319.9951171875 _CNV_A_R_LINEAR_____2_CM -160. 159.9951171875 DISPLAY_IDENTIFIER C_VLS_UP_DIAG_MIN_PUC_LSL_UP FORMAT "%8.3" /end CHARACTERISTIC
/begin CHARACTERISTIC c_vls_up_diag_max_puc_lsl_up "Upstream sensor output voltage in PUC corresponding to Open Circuit on WRAF Sensor" VALUE 0xa08016ae _REC_VAL_20_s2 319.9951171875 _CNV_A_R_LINEAR_____2_CM -160. 159.9951171875 DISPLAY_IDENTIFIER C_VLS_UP_DIAG_MAX_PUC_LSL_UP FORMAT "%8.3" /end CHARACTERISTIC
/begin CHARACTERISTIC c_teg_min_diag_puc_lsl_up "Minimum admissible exhaust gas temperature in PUC" VALUE 0xa0801600 _REC_VAL_20_u2 2047.9375 _CNV_A_R_LINEAR_____214_CM -273.15 1774.7875 DISPLAY_IDENTIFIER C_TEG_MIN_DIAG_PUC_LSL_UP FORMAT "%9.4" /end CHARACTERISTIC
/begin CHARACTERISTIC c_t_diag_end_puc_lsl_up "Time to have a diagnostic available" VALUE 0xa080153e _REC_VAL_20_u2 6553.5 _CNV_A_R_LINEAR_____4_CM 0. 6553.5 DISPLAY_IDENTIFIER C_T_DIAG_END_PUC_LSL_UP FORMAT "%6.1" /end CHARACTERISTIC
/begin CHARACTERISTIC c_t_diag_end_eol_puc_lsl_up "Time to have a diagnostic available (EOL test) " VALUE 0xa080153c _REC_VAL_20_u2 6553.5 _CNV_A_R_LINEAR_____4_CM 0. 6553.5 DISPLAY_IDENTIFIER C_T_DIAG_END_EOL_PUC_LSL_UP FORMAT "%6.1" /end CHARACTERISTIC
/begin MEASUREMENT lv_err_puc_vld_ls_up_1 "Debounced failure of the signal plausibility from the upstream sensor during PUC" UBYTE _CNV_S_2_RANGE__0___1_CM 1 100. 0. 1. DISPLAY_IDENTIFIER LV_ERR_PUC_VLD_LS_UP[1] ECU_ADDRESS 0xd0007ff8 BIT_MASK 0x1 /end MEASUREMENT
/begin MEASUREMENT lv_err_puc_vld_ls_up_2 "Debounced failure of the signal plausibility from the upstream sensor during PUC" UBYTE _CNV_S_2_RANGE__0___1_CM 1 100. 0. 1. DISPLAY_IDENTIFIER LV_ERR_PUC_VLD_LS_UP[2] ECU_ADDRESS 0xd0008013 BIT_MASK 0x1 /end MEASUREMENT
/begin CHARACTERISTIC c_fac_dyn_int_act_lsl_up "Relative sensor signal damping admitted to monitor the sensor activity" VALUE 0xa08013f4 _REC_VAL_20_u2 31.9990234375 _CNV_A_R_LINEAR_____129_CM 0. 31.9990234375 DISPLAY_IDENTIFIER C_FAC_DYN_INT_ACT_LSL_UP FORMAT "%7.4" /end CHARACTERISTIC
/begin CHARACTERISTIC c_n_min_act_lsl_up "Lower engine speed admitted to monitor the sensor activity " VALUE 0xa080150a _REC_VAL_20_u1 8160. _CNV_A_R_LINEAR_____10_CM 0. 8160. DISPLAY_IDENTIFIER C_N_MIN_ACT_LSL_UP FORMAT "%4.0" /end CHARACTERISTIC
/begin CHARACTERISTIC c_t_sum_afl_afr_act_lsl_up "Lower forced stimulation period admitted to monitor the sensor activity" VALUE 0xa08015b4 _REC_VAL_20_u2 655.35 _CNV_A_R_LINEAR_____3_CM 0. 655.35 DISPLAY_IDENTIFIER C_T_SUM_AFL_AFR_ACT_LSL_UP FORMAT "%6.2" /end CHARACTERISTIC
/begin CHARACTERISTIC c_lamb_sp_de_pls_act_lsl_up "Lower forced stimulation amplitude admitted to monitor the sensor activity" VALUE 0xa0801472 _REC_VAL_20_u2 0.124939 _CNV_A_R_EGCP_LINEA_356_CM 0. 0.124939 DISPLAY_IDENTIFIER C_LAMB_SP_DE_PLS_ACT_LSL_UP FORMAT "%7.5" /end CHARACTERISTIC
/begin CHARACTERISTIC c_maf_kgh_min_act_lsl_up "Lower mass airflow in Kg/h admitted to monitor the sensor activity" VALUE 0xa08014d6 _REC_VAL_20_u2 2047.96875 _CNV_A_R_LINEAR_____215_CM 0. 2047.96875 DISPLAY_IDENTIFIER C_MAF_KGH_MIN_ACT_LSL_UP FORMAT "%10.5" /end CHARACTERISTIC
/begin CHARACTERISTIC c_ctr_lamb_de_int_act_lsl_up "Number of forced stimulation periods to calculate the total cumulated lambda deviation" VALUE 0xa08013c6 _REC_VAL_20_u1 255. _CNV_A_R_LINEAR_____0_CM 0. 255. DISPLAY_IDENTIFIER C_CTR_LAMB_DE_INT_ACT_LSL_UP FORMAT "%3.0" /end CHARACTERISTIC
/begin CHARACTERISTIC c_lamb_de_tot_act_lsl_up "Threshold of the total cumulated lambda deviation to debounce the sensor non-activity symptom " VALUE 0xa0801450 _REC_VAL_20_u2 63.999023 _CNV_A_R_EGCP_LINEA_316_CM 0. 63.999023 DISPLAY_IDENTIFIER C_LAMB_DE_TOT_ACT_LSL_UP FORMAT "%7.4" /end CHARACTERISTIC
/begin CHARACTERISTIC c_ctr_sym_max_act_lsl_up "Counter threshold to set the sensor non-activity symptom flag" VALUE 0xa08013e0 _REC_VAL_20_u1 255. _CNV_A_R_LINEAR_____0_CM 0. 255. DISPLAY_IDENTIFIER C_CTR_SYM_MAX_ACT_LSL_UP FORMAT "%3.0" /end CHARACTERISTIC
/begin CHARACTERISTIC c_ctr_sym_inc_act_lsl_up "Counter increment to set the sensor non-activity symptom flag" VALUE 0xa08013de _REC_VAL_20_u1 255. _CNV_A_R_LINEAR_____0_CM 0. 255. DISPLAY_IDENTIFIER C_CTR_SYM_INC_ACT_LSL_UP FORMAT "%3.0" /end CHARACTERISTIC
/begin CHARACTERISTIC c_ctr_sym_dec_act_lsl_up "Counter decrement to set the sensor non-activity symptom flag" VALUE 0xa08013dc _REC_VAL_20_u1 255. _CNV_A_R_LINEAR_____0_CM 0. 255. DISPLAY_IDENTIFIER C_CTR_SYM_DEC_ACT_LSL_UP FORMAT "%3.0" /end CHARACTERISTIC
/begin CHARACTERISTIC c_crlc_act_lsl_up "Correlation factor for the moving mean value" VALUE 0xa080139c _REC_VAL_20_u2 0.9999847412109381 _CNV_A_R_LINEAR_____89_CM 0. 0.9999847412109381 DISPLAY_IDENTIFIER C_CRLC_ACT_LSL_UP FORMAT "%7.5" /end CHARACTERISTIC
/begin AXIS_PTS ldp_maf_kgh_id_ctr_act_lsl_up "" 0xa0800e14 maf_kgh _REC_AXS_20_u2 2047.96875 _CNV_A_R_LINEAR_____215_CM 8 0. 2047.96875 FORMAT "%10.5" /end AXIS_PTS
/begin CHARACTERISTIC id_ctr_inc_raw_act_lsl_up "Counter increment to detect raw symptom of upstream sensor non-activity" CURVE 0xa080102c _REC_CUR_20_u1_u2 255. _CNV_A_R_LINEAR_____0_CM 0. 255. DISPLAY_IDENTIFIER ID_CTR_INC_RAW_ACT_LSL_UP FORMAT "%3.0"
 /begin AXIS_DESCR COM_AXIS maf_kgh _CNV_A_R_LINEAR_____215_CM 8 0. 2047.96875 FORMAT "%10.5" AXIS_PTS_REF ldp_maf_kgh_id_ctr_act_lsl_up /end AXIS_DESCR
/end CHARACTERISTIC
/begin AXIS_PTS ldp_vls_down_id_lamb_gain "" 0xa0800f48 online_dummy _REC_AXS_20_u2 4.9951171875 _CNV_A_R_LINEAR_____2_CM 8 0. 4.9951171875 FORMAT "%5.3" /end AXIS_PTS
/begin CHARACTERISTIC id_lamb_gain_vls_down "Gain/Damping factor to calculate LAMB_DE_INT_ACT_LSL_UP to double-check with VLS_DOWN " CURVE 0xa080103c _REC_CUR_20_u1_u2 1.9921875 _CNV_A_R_LINEAR_____103_CM 0. 1.9921875 DISPLAY_IDENTIFIER ID_LAMB_GAIN_VLS_DOWN FORMAT "%8.6"
 /begin AXIS_DESCR COM_AXIS online_dummy _CNV_A_R_LINEAR_____2_CM 8 0. 4.9951171875 FORMAT "%5.3" AXIS_PTS_REF ldp_vls_down_id_lamb_gain /end AXIS_DESCR
/end CHARACTERISTIC
/begin AXIS_PTS ldp_fac_diag_dyn_lsl_up_id_lamb "" 0xa0800db0 online_dummy _REC_AXS_20_u2 1. _CNV_A_R_EGCP_LINEA_316_CM 8 0. 1. FORMAT "%7.4" /end AXIS_PTS
/begin CHARACTERISTIC id_lamb_gain_ls_up_dyn "Gain factor to consider an aged linear lambda sensor " CURVE 0xa0801034 _REC_CUR_20_u1_u2 31.875 _CNV_A_R_EGCP_LINEA_355_CM 0. 31.875 DISPLAY_IDENTIFIER ID_LAMB_GAIN_LS_UP_DYN
 /begin AXIS_DESCR COM_AXIS online_dummy _CNV_A_R_EGCP_LINEA_316_CM 8 0. 1. FORMAT "%7.4" AXIS_PTS_REF ldp_fac_diag_dyn_lsl_up_id_lamb /end AXIS_DESCR
/end CHARACTERISTIC
/begin CHARACTERISTIC c_vls_up_afs_min_plaus_lsl_up "Lower limit of upstream sensor signal window to detect the sensor non-activity" VALUE 0xa08016a8 _REC_VAL_20_s2 319.9951171875 _CNV_A_R_LINEAR_____2_CM -160. 159.9951171875 DISPLAY_IDENTIFIER C_VLS_UP_AFS_MIN_PLAUS_LSL_UP FORMAT "%8.3" /end CHARACTERISTIC
/begin CHARACTERISTIC c_vls_up_afs_max_plaus_lsl_up "Upper limit of upstream sensor signal window to detect the sensor non-activity" VALUE 0xa08016a6 _REC_VAL_20_s2 319.9951171875 _CNV_A_R_LINEAR_____2_CM -160. 159.9951171875 DISPLAY_IDENTIFIER C_VLS_UP_AFS_MAX_PLAUS_LSL_UP FORMAT "%8.3" /end CHARACTERISTIC
/begin CHARACTERISTIC c_ctr_raw_act_end_lsl_up "Counter threshold to have valid diagnostic result from the no-activity check (first part)" VALUE 0xa08013ce _REC_VAL_20_u2 65535. _CNV_A_R_LINEAR_____0_CM 0. 65535. DISPLAY_IDENTIFIER C_CTR_RAW_ACT_END_LSL_UP FORMAT "%5.0" /end CHARACTERISTIC
/begin CHARACTERISTIC c_ctr_raw_act_rst_lsl_up "Counter threshold to reset symptom counter if raw symptom has disappeared" VALUE 0xa08013d0 _REC_VAL_20_u2 65535. _CNV_A_R_LINEAR_____0_CM 0. 65535. DISPLAY_IDENTIFIER C_CTR_RAW_ACT_RST_LSL_UP FORMAT "%5.0" /end CHARACTERISTIC
/begin CHARACTERISTIC c_ctr_raw_act_sym_lsl_up "Counter threshold to set the raw symptom flag of the no-activity check (first part)" VALUE 0xa08013d2 _REC_VAL_20_u2 65535. _CNV_A_R_LINEAR_____0_CM 0. 65535. DISPLAY_IDENTIFIER C_CTR_RAW_ACT_SYM_LSL_UP FORMAT "%5.0" /end CHARACTERISTIC
/begin MEASUREMENT lv_err_shift_afl_lsl_up_1 "WRAF Sensor characteristic line shift to lean ERROR detected" UBYTE _CNV_S_2_RANGE__0___1_CM 1 100. 0. 1. DISPLAY_IDENTIFIER LV_ERR_SHIFT_AFL_LSL_UP[1] ECU_ADDRESS 0xd0007ffb BIT_MASK 0x1 /end MEASUREMENT
/begin MEASUREMENT lv_err_shift_afr_lsl_up_1 "WRAF Sensor characteristic line shift to rich ERROR detected" UBYTE _CNV_S_2_RANGE__0___1_CM 1 100. 0. 1. DISPLAY_IDENTIFIER LV_ERR_SHIFT_AFR_LSL_UP[1] ECU_ADDRESS 0xd0007ffc BIT_MASK 0x1 /end MEASUREMENT
/begin MEASUREMENT lv_err_shift_afl_lsl_up_2 "WRAF Sensor characteristic line shift to lean ERROR detected" UBYTE _CNV_S_2_RANGE__0___1_CM 1 100. 0. 1. DISPLAY_IDENTIFIER LV_ERR_SHIFT_AFL_LSL_UP[2] ECU_ADDRESS 0xd0008016 BIT_MASK 0x1 /end MEASUREMENT
/begin MEASUREMENT lv_err_shift_afr_lsl_up_2 "WRAF Sensor characteristic line shift to rich ERROR detected" UBYTE _CNV_S_2_RANGE__0___1_CM 1 100. 0. 1. DISPLAY_IDENTIFIER LV_ERR_SHIFT_AFR_LSL_UP[2] ECU_ADDRESS 0xd0008017 BIT_MASK 0x1 /end MEASUREMENT
/begin CHARACTERISTIC c_t_dly_diag_shift_down[0] "Threshold for the \"end flag\" delay timer in the no failure case" VALUE 0xa0801558 _REC_VAL_20_u2 6553.5 _CNV_A_R_LINEAR_____4_CM 0. 6553.5 DISPLAY_IDENTIFIER C_T_DLY_DIAG_SHIFT_DOWN[1] FORMAT "%6.1" /end CHARACTERISTIC
/begin CHARACTERISTIC c_t_dly_diag_shift_down[1] "Threshold for the \"end flag\" delay timer in the no failure case" VALUE 0xa080155a _REC_VAL_20_u2 6553.5 _CNV_A_R_LINEAR_____4_CM 0. 6553.5 DISPLAY_IDENTIFIER C_T_DLY_DIAG_SHIFT_DOWN[2] FORMAT "%6.1" /end CHARACTERISTIC
/begin CHARACTERISTIC c_vls_up_diag_max_air_lsl_up "Upstream sensor signal max. threshold during engine operation (PUC excepted)" VALUE 0xa08016ac _REC_VAL_20_s2 319.9951171875 _CNV_A_R_LINEAR_____2_CM -160. 159.9951171875 DISPLAY_IDENTIFIER C_VLS_UP_DIAG_MAX_AIR_LSL_UP FORMAT "%8.3" /end CHARACTERISTIC
/begin CHARACTERISTIC c_t_sym_diag_air_lsl_up "Time filter to detect a symptom" VALUE 0xa08015ca _REC_VAL_20_u2 6553.5 _CNV_A_R_LINEAR_____4_CM 0. 6553.5 DISPLAY_IDENTIFIER C_T_SYM_DIAG_AIR_LSL_UP FORMAT "%6.1" /end CHARACTERISTIC
/begin MEASUREMENT lv_err_air_lsl_up_1 "Debounced diagnosis result of upstream sensor signal monitoring" UBYTE _CNV_S_2_RANGE__0___1_CM 1 100. 0. 1. DISPLAY_IDENTIFIER LV_ERR_AIR_LSL_UP[1] ECU_ADDRESS 0xd0007ff3 BIT_MASK 0x1 /end MEASUREMENT
/begin MEASUREMENT lv_err_air_lsl_up_2 "Debounced diagnosis result of upstream sensor signal monitoring" UBYTE _CNV_S_2_RANGE__0___1_CM 1 100. 0. 1. DISPLAY_IDENTIFIER LV_ERR_AIR_LSL_UP[2] ECU_ADDRESS 0xd000800e BIT_MASK 0x1 /end MEASUREMENT
/begin CHARACTERISTIC c_t_end_diag_air_lsl_up "Time to have a diagnostic available" VALUE 0xa0801580 _REC_VAL_20_u2 6553.5 _CNV_A_R_LINEAR_____4_CM 0. 6553.5 DISPLAY_IDENTIFIER C_T_END_DIAG_AIR_LSL_UP FORMAT "%6.1" /end CHARACTERISTIC
/begin CHARACTERISTIC c_conc_o2_clc_hom_max_dyn_s "maximum allowable modelled O2 concentration for stratified dynamics diagnosis" VALUE 0xa0801394 _REC_VAL_20_s2 3.99993896484375 _CNV_A_R_LINEAR_____24_CM -2. 1.99993896484375 DISPLAY_IDENTIFIER C_CONC_O2_CLC_HOM_MAX_DYN_S FORMAT "%8.5" /end CHARACTERISTIC
/begin CHARACTERISTIC c_conc_o2_dif_max_diag_dyn_s "maximum allowable difference between measured and modelled O2 concentration for stratified dynamics diagnosis" VALUE 0xa0801396 _REC_VAL_20_s2 3.99993896484375 _CNV_A_R_LINEAR_____24_CM -2. 1.99993896484375 DISPLAY_IDENTIFIER C_CONC_O2_DIF_MAX_DIAG_DYN_S FORMAT "%8.5" /end CHARACTERISTIC
/begin CHARACTERISTIC c_conc_o2_dif_st_max_diag_dyn_s "maximum difference between measured and modelled O2 concentration to allow stratified dynamics diagnosis" VALUE 0xa0801398 _REC_VAL_20_s2 3.99993896484375 _CNV_A_R_LINEAR_____24_CM -2. 1.99993896484375 DISPLAY_IDENTIFIER C_CONC_O2_DIF_ST_MAX_DIAG_DYN_S FORMAT "%8.5" /end CHARACTERISTIC
/begin CHARACTERISTIC c_ctr_diag_dyn_s_lsl_up "Number of valid regeneration cycles needed for averaging in stratified dynamics diagnosis" VALUE 0xa08013b6 _REC_VAL_20_u1 255. _CNV_A_R_LINEAR_____0_CM 0. 255. DISPLAY_IDENTIFIER C_CTR_DIAG_DYN_S_LSL_UP FORMAT "%3.0" /end CHARACTERISTIC
/begin CHARACTERISTIC c_fac_conc_o2_cor_diag_dyn_s "scaling factor in stratified dynamics diagnosis for correction of measured O2 concentration" VALUE 0xa08013ee _REC_VAL_20_u1 1.9921875 _CNV_A_R_LINEAR_____103_CM 0. 1.9921875 DISPLAY_IDENTIFIER C_FAC_CONC_O2_COR_DIAG_DYN_S FORMAT "%8.6" /end CHARACTERISTIC
/begin CHARACTERISTIC c_fac_diag_dyn_s_lsl_up_max "maximum dynamics characterization value from stratified diagnosis allowable for a \"good\" lambda sensor" VALUE 0xa08013f2 _REC_VAL_20_s2 255.99609375 _CNV_A_R_LINEAR_____28_CM -128. 127.99609375 DISPLAY_IDENTIFIER C_FAC_DIAG_DYN_S_LSL_UP_MAX FORMAT "%11.6" /end CHARACTERISTIC
/begin CHARACTERISTIC c_maf_int_end_diag_dyn_s "air mass integral after end of regeneration phase after which to one diagnosis cycle ends" VALUE 0xa08014a4 _REC_VAL_20_u2 2912.666666666671 _CNV_A_R_LINEAR_____314_CM 0. 2912.66666666667 DISPLAY_IDENTIFIER C_MAF_INT_END_DIAG_DYN_S FORMAT "%7.2" /end CHARACTERISTIC
/begin CHARACTERISTIC c_maf_int_st_diag_dyn_s "air mass integral to wait for before starting integration of differences in stratified dynamics diagnosis" VALUE 0xa08014c8 _REC_VAL_20_u2 2912.666666666671 _CNV_A_R_LINEAR_____314_CM 0. 2912.66666666667 DISPLAY_IDENTIFIER C_MAF_INT_ST_DIAG_DYN_S FORMAT "%7.2" /end CHARACTERISTIC
/begin CHARACTERISTIC c_n_max_stop_diag_dyn_s "maximum engine speed to conduct stratified dynamics diagnosis" VALUE 0xa0801507 _REC_VAL_20_u1 8160. _CNV_A_R_LINEAR_____10_CM 0. 8160. DISPLAY_IDENTIFIER C_N_MAX_STOP_DIAG_DYN_S FORMAT "%4.0" /end CHARACTERISTIC
/begin CHARACTERISTIC c_n_min_stop_diag_dyn_s "maximum engine speed to conduct stratified dynamics diagnosis" VALUE 0xa080150d _REC_VAL_20_u1 8160. _CNV_A_R_LINEAR_____10_CM 0. 8160. DISPLAY_IDENTIFIER C_N_MIN_STOP_DIAG_DYN_S FORMAT "%4.0" /end CHARACTERISTIC
/begin CHARACTERISTIC lc_diag_dyn_s_lsl_up_mod "switch between integral and difference as basis for dynamics diagnosis" VALUE 0xa08016ce _REC_VAL_20_u1 1. _CNV_A_R_LINEAR_____0_CM 0. 1. DISPLAY_IDENTIFIER LC_DIAG_DYN_S_LSL_UP_MOD FORMAT "%1.0" /end CHARACTERISTIC
/begin CHARACTERISTIC c_tqi_max_diag_dyn_s "maximum torque request allowable for stratified dynamics diagnosis" VALUE 0xa080160c _REC_VAL_20_s2 2047.96875 _CNV_A_R_LINEAR_____31_CM -1024. 1023.96875 DISPLAY_IDENTIFIER C_TQI_MAX_DIAG_DYN_S FORMAT "%11.5" /end CHARACTERISTIC
/begin CHARACTERISTIC c_tqi_min_diag_dyn_s "minimum torque request allowable for stratified dynamics diagnosis" VALUE 0xa080160e _REC_VAL_20_s2 2047.96875 _CNV_A_R_LINEAR_____31_CM -1024. 1023.96875 DISPLAY_IDENTIFIER C_TQI_MIN_DIAG_DYN_S FORMAT "%11.5" /end CHARACTERISTIC
/begin CHARACTERISTIC ip_fac_cor_conc_o2_dif_dyn_s "weighting factor for dynamics diagnosis result" MAP 0xa0801084 _REC_MAP_20_u1_u1_u2 6.2256e-002 _CNV_A_R_LINEAR_____357_CM 0. 6.2256e-002 DISPLAY_IDENTIFIER IP_FAC_COR_CONC_O2_DIF_DYN_S FORMAT "%8.6"
 /begin AXIS_DESCR COM_AXIS n_32 _CNV_A_R_LINEAR_____10_CM 8 0. 8160. FORMAT "%4.0" AXIS_PTS_REF ldpm_n_32_ls_up_dyn /end AXIS_DESCR
 /begin AXIS_DESCR COM_AXIS tqi_sp_s _CNV_A_R_LINEAR_____87_CM 8 -1024. 1023.96875 FORMAT "%11.5" AXIS_PTS_REF ldp_tqi_sp_s_ip_conc_o2_dyn_s /end AXIS_DESCR
/end CHARACTERISTIC
/begin CHARACTERISTIC c_conc_o2_mes_dec_max_dyn_s "maximum allowable difference between measured and modelled O2 concentration for stratified dynamics" VALUE 0xa080139a _REC_VAL_20_s2 3.99993896484375 _CNV_A_R_LINEAR_____24_CM -2. 1.99993896484375 DISPLAY_IDENTIFIER C_CONC_O2_MES_DEC_MAX_DYN_S FORMAT "%8.5" /end CHARACTERISTIC
/begin AXIS_PTS ldp_tqi_sp_s_ip_conc_o2_dyn_s "" 0xa0800f04 tqi_sp_s _REC_AXS_20_u2 2047.96875 _CNV_A_R_LINEAR_____87_CM 8 -1024. 1023.96875 FORMAT "%11.5" /end AXIS_PTS
/begin CHARACTERISTIC c_cl_mmv_ls_up_diag_max "Maximum degree of saturation of the evaporative canister to activate the function" VALUE 0xa0801392 _REC_VAL_20_u2 1.99996948242188 _CNV_A_R_LINEAR_____9_CM 0. 1.99996948242188 DISPLAY_IDENTIFIER C_CL_MMV_LS_UP_DIAG_MAX FORMAT "%7.5" /end CHARACTERISTIC
/begin MEASUREMENT lv_inh_diag_ls_up_dyn_cp "Canister Purge Load too high" UBYTE _CNV_S_2_RANGE__0___1_CM 1 100. 0. 1. DISPLAY_IDENTIFIER LV_INH_DIAG_LS_UP_DYN_CP ECU_ADDRESS 0xd0007473 BIT_MASK 0x1 /end MEASUREMENT
/begin CHARACTERISTIC lc_inh_dyn_diag_s_lsl_up[0] "Manual inhibition of WRAF sensor dynamic diagnosis in stratified operation" VALUE 0xa08016e4 _REC_VAL_20_u1 1. _CNV_A_R_LINEAR_____0_CM 0. 1. DISPLAY_IDENTIFIER LC_INH_DYN_DIAG_S_LSL_UP[1] FORMAT "%1.0" /end CHARACTERISTIC
/begin CHARACTERISTIC lc_inh_dyn_diag_s_lsl_up[1] "Manual inhibition of WRAF sensor dynamic diagnosis in stratified operation" VALUE 0xa08016e5 _REC_VAL_20_u1 1. _CNV_A_R_LINEAR_____0_CM 0. 1. DISPLAY_IDENTIFIER LC_INH_DYN_DIAG_S_LSL_UP[2] FORMAT "%1.0" /end CHARACTERISTIC
/begin CHARACTERISTIC c_t_diag_act_ofs_max "Maximum allowed duration of offset adjustment" VALUE 0xa080153a _REC_VAL_20_u2 655.35 _CNV_A_R_LINEAR_____3_CM 0. 655.35 DISPLAY_IDENTIFIER C_T_DIAG_ACT_OFS_MAX FORMAT "%6.2" /end CHARACTERISTIC
/begin CHARACTERISTIC c_lamb_sp_min_diag_ctl_lsl_up "Minimum lambda setpoint to execute pump current controller diagnosis" VALUE 0xa080147a _REC_VAL_20_u2 31.9990234375 _CNV_A_R_LINEAR_____129_CM 0. 31.9990234375 DISPLAY_IDENTIFIER C_LAMB_SP_MIN_DIAG_CTL_LSL_UP FORMAT "%7.4" /end CHARACTERISTIC
/begin CHARACTERISTIC c_lamb_sp_max_diag_ctl_lsl_up "Maximum lambda setpoint to execute pump current controller diagnosis" VALUE 0xa0801474 _REC_VAL_20_u2 31.9990234375 _CNV_A_R_LINEAR_____129_CM 0. 31.9990234375 DISPLAY_IDENTIFIER C_LAMB_SP_MAX_DIAG_CTL_LSL_UP FORMAT "%7.4" /end CHARACTERISTIC
/begin CHARACTERISTIC c_ttip_min_diag_ctl_lsl_up "Minimum sensor tip temperature to allow pump current controller diagnosis" VALUE 0xa0801618 _REC_VAL_20_s2 4095.9375 _CNV_A_R_LINEAR_____130_CM -2048. 2047.9375 DISPLAY_IDENTIFIER C_TTIP_MIN_DIAG_CTL_LSL_UP FORMAT "%10.4" /end CHARACTERISTIC
/begin CHARACTERISTIC c_ttip_max_diag_ctl_lsl_up "Maximum sensor tip temperature to allow pump current controller diagnosis" VALUE 0xa0801612 _REC_VAL_20_s2 4095.9375 _CNV_A_R_LINEAR_____130_CM -2048. 2047.9375 DISPLAY_IDENTIFIER C_TTIP_MAX_DIAG_CTL_LSL_UP FORMAT "%10.4" /end CHARACTERISTIC
/begin CHARACTERISTIC c_vls_up_min_diag_ctl_lsl_up "Lower end of blind spot for pump current controller diagnosis" VALUE 0xa08016ba _REC_VAL_20_s2 319.9951171875 _CNV_A_R_LINEAR_____2_CM -160. 159.9951171875 DISPLAY_IDENTIFIER C_VLS_UP_MIN_DIAG_CTL_LSL_UP FORMAT "%8.3" /end CHARACTERISTIC
/begin CHARACTERISTIC c_vls_up_max_diag_ctl_lsl_up "Upper end of blind spot for pump current controller diagnosis" VALUE 0xa08016b4 _REC_VAL_20_s2 319.9951171875 _CNV_A_R_LINEAR_____2_CM -160. 159.9951171875 DISPLAY_IDENTIFIER C_VLS_UP_MAX_DIAG_CTL_LSL_UP FORMAT "%8.3" /end CHARACTERISTIC
/begin CHARACTERISTIC c_abc_inc_diag_ofs_lsl_up[0] "Antibounce counter increment of offset adjustment diagnosis" VALUE 0xa0801372 _REC_VAL_20_u1 255. _CNV_A_R_LINEAR_____0_CM 0. 255. DISPLAY_IDENTIFIER C_ABC_INC_DIAG_OFS_LSL_UP[1] FORMAT "%3.0" /end CHARACTERISTIC
/begin CHARACTERISTIC c_abc_inc_diag_ofs_lsl_up[1] "Antibounce counter increment of offset adjustment diagnosis" VALUE 0xa0801373 _REC_VAL_20_u1 255. _CNV_A_R_LINEAR_____0_CM 0. 255. DISPLAY_IDENTIFIER C_ABC_INC_DIAG_OFS_LSL_UP[2] FORMAT "%3.0" /end CHARACTERISTIC
/begin CHARACTERISTIC c_abc_inc_diag_ctl_lsl_up[0] "Antibounce counter increment of pump current controller diagnosis" VALUE 0xa080136e _REC_VAL_20_u1 255. _CNV_A_R_LINEAR_____0_CM 0. 255. DISPLAY_IDENTIFIER C_ABC_INC_DIAG_CTL_LSL_UP[1] FORMAT "%3.0" /end CHARACTERISTIC
/begin CHARACTERISTIC c_abc_inc_diag_ctl_lsl_up[1] "Antibounce counter increment of pump current controller diagnosis" VALUE 0xa080136f _REC_VAL_20_u1 255. _CNV_A_R_LINEAR_____0_CM 0. 255. DISPLAY_IDENTIFIER C_ABC_INC_DIAG_CTL_LSL_UP[2] FORMAT "%3.0" /end CHARACTERISTIC
/begin CHARACTERISTIC c_abc_max_diag_ofs_lsl_up[0] "Maximumvalue for antibounce counter of offset adjustment diagnosis" VALUE 0xa0801382 _REC_VAL_20_u1 254. _CNV_A_R_LINEAR_____0_CM 1. 255. DISPLAY_IDENTIFIER C_ABC_MAX_DIAG_OFS_LSL_UP[1] FORMAT "%3.0" /end CHARACTERISTIC
/begin CHARACTERISTIC c_abc_max_diag_ofs_lsl_up[1] "Maximumvalue for antibounce counter of offset adjustment diagnosis" VALUE 0xa0801383 _REC_VAL_20_u1 254. _CNV_A_R_LINEAR_____0_CM 1. 255. DISPLAY_IDENTIFIER C_ABC_MAX_DIAG_OFS_LSL_UP[2] FORMAT "%3.0" /end CHARACTERISTIC
/begin CHARACTERISTIC c_abc_max_diag_ctl_lsl_up[0] "Maximumvalue for antibounce counter of pump current controller diagnosis" VALUE 0xa080137e _REC_VAL_20_u1 254. _CNV_A_R_LINEAR_____0_CM 1. 255. DISPLAY_IDENTIFIER C_ABC_MAX_DIAG_CTL_LSL_UP[1] FORMAT "%3.0" /end CHARACTERISTIC
/begin CHARACTERISTIC c_abc_max_diag_ctl_lsl_up[1] "Maximumvalue for antibounce counter of pump current controller diagnosis" VALUE 0xa080137f _REC_VAL_20_u1 254. _CNV_A_R_LINEAR_____0_CM 1. 255. DISPLAY_IDENTIFIER C_ABC_MAX_DIAG_CTL_LSL_UP[2] FORMAT "%3.0" /end CHARACTERISTIC
/begin CHARACTERISTIC c_cdn_diag_ctl_lsl_di "Constant for permanently disable monitors for the pump current controller diagnosis" VALUE 0xa0801390 _REC_VAL_20_u1 255. _CNV_A_R_LINEAR_____0_CM 0. 255. DISPLAY_IDENTIFIER C_CDN_DIAG_CTL_LSL_DI FORMAT "%3.0" /end CHARACTERISTIC
/begin CHARACTERISTIC c_tco_cur_on_ls_down_min "TCO-threshold for detection of R_IT_LS_DOWN" VALUE 0xa08015e2 _REC_VAL_20_u1 190.5 _CNV_A_R_LINEAR_____17_CM -48. 142.5 DISPLAY_IDENTIFIER C_TCO_CUR_ON_LS_DOWN_MIN FORMAT "%5.1" /end CHARACTERISTIC
/begin CHARACTERISTIC c_tco_min_diag_rgn_nt_ls_down "Minimum coolant temperature for activation of RGN_NT_LS_DOWN[i] diagnosis" VALUE 0xa08015e5 _REC_VAL_20_u1 190.5 _CNV_A_R_LINEAR_____17_CM -48. 142.5 DISPLAY_IDENTIFIER C_TCO_MIN_DIAG_RGN_NT_LS_DOWN FORMAT "%6.2" /end CHARACTERISTIC
/begin CHARACTERISTIC c_maf_min_diag_rgn_nt_ls_down "Minimum mass air flow for activation of RGN_NT_LS_DOWN[i] diagnosis" VALUE 0xa08014ea _REC_VAL_20_u2 2047.96875 _CNV_A_R_LINEAR_____215_CM 0. 2047.96875 DISPLAY_IDENTIFIER C_MAF_MIN_DIAG_RGN_NT_LS_DOWN FORMAT "%10.5" /end CHARACTERISTIC
/begin CHARACTERISTIC c_maf_max_diag_rgn_nt_ls_down "Maximum mass air flow for activation of RGN_NT_LS_DOWN[i] diagnosis" VALUE 0xa08014e4 _REC_VAL_20_u2 2047.96875 _CNV_A_R_LINEAR_____215_CM 0. 2047.96875 DISPLAY_IDENTIFIER C_MAF_MAX_DIAG_RGN_NT_LS_DOWN FORMAT "%10.5" /end CHARACTERISTIC
/begin CHARACTERISTIC c_temp_min_diag_rgn_nt_ls_down "Catalyst temperature threshold for activation of RGN_NT_LS_DOWN[i] diagnosis" VALUE 0xa0801608 _REC_VAL_20_u2 2047.9375 _CNV_A_R_LINEAR_____214_CM -273.15 1774.7875 DISPLAY_IDENTIFIER C_TEMP_MIN_DIAG_RGN_NT_LS_DOWN FORMAT "%9.4" /end CHARACTERISTIC
/begin CHARACTERISTIC lc_state_rgn_l_ampl_deac "Logical calibration data to skip check of STATE_RGN[i] depending on regeneration strategy" VALUE 0xa080171b _REC_VAL_20_u1 1. _CNV_A_R_LINEAR_____0_CM 0. 1. DISPLAY_IDENTIFIER LC_STATE_RGN_L_AMPL_DEAC FORMAT "%1.0" /end CHARACTERISTIC
/begin CHARACTERISTIC c_vls_min_diag_rgn_ls_down "Minimum voltage during regeneration phase to enable diagnosis" VALUE 0xa0801690 _REC_VAL_20_u2 4.9951171875 _CNV_A_R_LINEAR_____2_CM 0. 4.9951171875 DISPLAY_IDENTIFIER C_VLS_MIN_DIAG_RGN_LS_DOWN FORMAT "%5.3" /end CHARACTERISTIC
/begin CHARACTERISTIC c_maf_int_rgn_nt_s_act "Mass air flow which has passed since activation of stratified mode" VALUE 0xa08014c2 _REC_VAL_20_u2 2912.666666666671 _CNV_A_R_LINEAR_____314_CM 0. 2912.66666666667 DISPLAY_IDENTIFIER C_MAF_INT_RGN_NT_S_ACT FORMAT "%7.2" /end CHARACTERISTIC
/begin CHARACTERISTIC c_maf_int_rgn_nt_end "Mass air flow which has passed since last regeneration cycle" VALUE 0xa08014c0 _REC_VAL_20_u2 2912.666666666671 _CNV_A_R_LINEAR_____314_CM 0. 2912.66666666667 DISPLAY_IDENTIFIER C_MAF_INT_RGN_NT_END FORMAT "%7.2" /end CHARACTERISTIC
/begin CHARACTERISTIC c_t_rgn_nt_end "Threshold for time which has passed after leaving last regeneration cycle" VALUE 0xa08015ae _REC_VAL_20_u2 1310.7 _CNV_A_R_LINEAR_____110_CM 0. 1310.7 DISPLAY_IDENTIFIER C_T_RGN_NT_END FORMAT "%7.2" /end CHARACTERISTIC
/begin CHARACTERISTIC c_ctr_sym_max_rgn_nt_ls_down "Threshold for detection of downstream sensor dynamic error after NOx cat regeneration" VALUE 0xa08013e2 _REC_VAL_20_u2 65535. _CNV_A_R_LINEAR_____0_CM 0. 65535. DISPLAY_IDENTIFIER C_CTR_SYM_MAX_RGN_NT_LS_DOWN FORMAT "%5.0" /end CHARACTERISTIC
/begin CHARACTERISTIC c_ctr_inc_diag_rgn_nt_ls_down "Counter increment for present error symptom" VALUE 0xa08013c0 _REC_VAL_20_u1 255. _CNV_A_R_LINEAR_____0_CM 0. 255. DISPLAY_IDENTIFIER C_CTR_INC_DIAG_RGN_NT_LS_DOWN FORMAT "%3.0" /end CHARACTERISTIC
/begin CHARACTERISTIC c_ctr_end_diag_rgn_nt_ls_down "Counter threshold for setting of diagnosis end bit" VALUE 0xa08013ba _REC_VAL_20_u1 255. _CNV_A_R_LINEAR_____0_CM 0. 255. DISPLAY_IDENTIFIER C_CTR_END_DIAG_RGN_NT_LS_DOWN FORMAT "%3.0" /end CHARACTERISTIC
/begin CHARACTERISTIC c_vls_down_rgn_nt_dif_thd "Measured Voltage difference used for error detection" VALUE 0xa0801686 _REC_VAL_20_u2 4.9951171875 _CNV_A_R_LINEAR_____2_CM 0. 4.9951171875 DISPLAY_IDENTIFIER C_VLS_DOWN_RGN_NT_DIF_THD FORMAT "%5.3" /end CHARACTERISTIC
/begin CHARACTERISTIC lc_inh_diag_pue_ls_down[0] "Manual deactivation of the PUE diagnosis(when = 1))" VALUE 0xa08016de _REC_VAL_20_u1 1. _CNV_S_2_RANGE__0___1_CM 0. 1. DISPLAY_IDENTIFIER LC_INH_DIAG_PUE_LS_DOWN[1] /end CHARACTERISTIC
/begin CHARACTERISTIC lc_inh_diag_pue_ls_down[1] "Manual deactivation of the PUE diagnosis(when = 1))" VALUE 0xa08016df _REC_VAL_20_u1 1. _CNV_S_2_RANGE__0___1_CM 0. 1. DISPLAY_IDENTIFIER LC_INH_DIAG_PUE_LS_DOWN[2] /end CHARACTERISTIC
/begin CHARACTERISTIC lc_inh_diag_swt_ls_down[0] "Manual deactivation of the SWT diagnosis(when = 1))" VALUE 0xa08016e2 _REC_VAL_20_u1 1. _CNV_S_2_RANGE__0___1_CM 0. 1. DISPLAY_IDENTIFIER LC_INH_DIAG_SWT_LS_DOWN[1] /end CHARACTERISTIC
/begin CHARACTERISTIC lc_inh_diag_swt_ls_down[1] "Manual deactivation of the SWT diagnosis(when = 1))" VALUE 0xa08016e3 _REC_VAL_20_u1 1. _CNV_S_2_RANGE__0___1_CM 0. 1. DISPLAY_IDENTIFIER LC_INH_DIAG_SWT_LS_DOWN[2] /end CHARACTERISTIC
/begin CHARACTERISTIC lc_inh_ls_down_man_deac "Manual deactivation of inhibit conditions (When = 1)" VALUE 0xa08016e6 _REC_VAL_20_u1 1. _CNV_S_2_RANGE__0___1_CM 0. 1. DISPLAY_IDENTIFIER LC_INH_LS_DOWN_MAN_DEAC /end CHARACTERISTIC
/begin CHARACTERISTIC lc_inh_diag_rgn_nt_ls_down[0] "Manual deactivation of the RGN NT LS DOWN diagnosis when=1" VALUE 0xa08016e0 _REC_VAL_20_u1 1. _CNV_A_R_LINEAR_____0_CM 0. 1. DISPLAY_IDENTIFIER LC_INH_DIAG_RGN_NT_LS_DOWN[1] FORMAT "%1.0" /end CHARACTERISTIC
/begin CHARACTERISTIC lc_inh_diag_rgn_nt_ls_down[1] "Manual deactivation of the RGN NT LS DOWN diagnosis when=1" VALUE 0xa08016e1 _REC_VAL_20_u1 1. _CNV_A_R_LINEAR_____0_CM 0. 1. DISPLAY_IDENTIFIER LC_INH_DIAG_RGN_NT_LS_DOWN[2] FORMAT "%1.0" /end CHARACTERISTIC
/begin MEASUREMENT maf_int_diag_lsh_lsl_up "Integral of the air flow, for the activation of the heater coupling diagnosis" UWORD _CNV_A_R_LINEAR_____287_CM 1 100. 0. 1820.41666666667 DISPLAY_IDENTIFIER MAF_INT_DIAG_LSH_LSL_UP ECU_ADDRESS 0xd00022f4 FORMAT "%7.2" /end MEASUREMENT
/begin CHARACTERISTIC c_lamb_delta_lpf_thd "Threshold for the maximum transition of the sensor signal" VALUE 0xa0801456 _REC_VAL_20_u2 1.99993896484375 _CNV_A_R_LINEAR_____24_CM 0. 1.99993896484375 DISPLAY_IDENTIFIER C_LAMB_DELTA_LPF_THD FORMAT "%7.5" /end CHARACTERISTIC
/begin CHARACTERISTIC c_cycnr_max_diag_lsh_lsl_up "Quantity of valid diagnosis values in one function cycle" VALUE 0xa08013e7 _REC_VAL_20_u1 255. _CNV_A_R_LINEAR_____0_CM 0. 255. DISPLAY_IDENTIFIER C_CYCNR_MAX_DIAG_LSH_LSL_UP FORMAT "%3.0" /end CHARACTERISTIC
/begin CHARACTERISTIC c_ctr_sym_diag_lsh_lsl_up "Limit value of the diagnosis results to diagnose the heater coupling" VALUE 0xa08013dd _REC_VAL_20_u1 255. _CNV_A_R_LINEAR_____0_CM 0. 255. DISPLAY_IDENTIFIER C_CTR_SYM_DIAG_LSH_LSL_UP FORMAT "%3.0" /end CHARACTERISTIC
/begin CHARACTERISTIC c_lamb_sp_de_diag_lsh_lsl_up "Maximum value of the forced excitation amplitude to activate the diagnosis" VALUE 0xa0801470 _REC_VAL_20_u1 0.124023 _CNV_A_R_EGCP_LINEA_346_CM 0. 0.124023 DISPLAY_IDENTIFIER C_LAMB_SP_DE_DIAG_LSH_LSL_UP FORMAT "%6.4" /end CHARACTERISTIC
/begin CHARACTERISTIC c_maf_int_diag_lsh_lsl_up "Threshold for the activation of the MAF-Integral" VALUE 0xa080149e _REC_VAL_20_u2 1820.41666666667 _CNV_A_R_LINEAR_____287_CM 0. 1820.41666666667 DISPLAY_IDENTIFIER C_MAF_INT_DIAG_LSH_LSL_UP FORMAT "%7.2" /end CHARACTERISTIC
/begin CHARACTERISTIC c_crlc_lpf_fall_diag_lsh_lsl_up "Filter constant for Fall" VALUE 0xa08013a4 _REC_VAL_20_u1 0.99609375 _CNV_A_R_LINEAR_____28_CM 0. 0.99609375 DISPLAY_IDENTIFIER C_CRLC_LPF_FALL_DIAG_LSH_LSL_UP FORMAT "%5.3" /end CHARACTERISTIC
/begin CHARACTERISTIC c_crlc_lpf_rise_diag_lsh_lsl_up "Filter constant for Rise" VALUE 0xa08013a8 _REC_VAL_20_u1 0.99609375 _CNV_A_R_LINEAR_____28_CM 0. 0.99609375 DISPLAY_IDENTIFIER C_CRLC_LPF_RISE_DIAG_LSH_LSL_UP FORMAT "%5.3" /end CHARACTERISTIC
/begin CHARACTERISTIC c_lshpwm_min_diag_lsh_lsl_up "Minimum heater PWM value allowed to carry out the heater coupling diagnosis" VALUE 0xa0801491 _REC_VAL_20_u1 99.609375 _CNV_A_R_LINEAR_____5_CM 0. 99.609375 DISPLAY_IDENTIFIER C_LSHPWM_MIN_DIAG_LSH_LSL_UP FORMAT "%9.6" /end CHARACTERISTIC
/begin CHARACTERISTIC c_lshpwm_max_diag_lsh_lsl_up "Maximum heater PWM value allowed to carry out the heater coupling diagnosis" VALUE 0xa080148d _REC_VAL_20_u1 99.609375 _CNV_A_R_LINEAR_____5_CM 0. 99.609375 DISPLAY_IDENTIFIER C_LSHPWM_MAX_DIAG_LSH_LSL_UP FORMAT "%9.6" /end CHARACTERISTIC
/begin MEASUREMENT lv_err_lsh_lsl_up_1 "Debounced heater coupling failure " UBYTE _CNV_S_2_RANGE__0___1_CM 1 100. 0. 1. DISPLAY_IDENTIFIER LV_ERR_LSH_LSL_UP[1] ECU_ADDRESS 0xd0007ff2 BIT_MASK 0x1 /end MEASUREMENT
/begin MEASUREMENT lv_err_lsh_lsl_up_2 "Debounced heater coupling failure " UBYTE _CNV_S_2_RANGE__0___1_CM 1 100. 0. 1. DISPLAY_IDENTIFIER LV_ERR_LSH_LSL_UP[2] ECU_ADDRESS 0xd000800d BIT_MASK 0x1 /end MEASUREMENT
/begin AXIS_PTS ldp_lshpwm_up_ip_t_dly_acq_vls "" 0xa0800e0e online_dummy _REC_AXS_20_u1 99.609375 _CNV_A_R_LINEAR_____5_CM 4 0. 99.609375 FORMAT "%9.6" /end AXIS_PTS
/begin CHARACTERISTIC ip_t_dly_trig_lsh_up "Time delay to trigger oxygen sensor signal and lambda model" CURVE 0xa08012e0 _REC_CUR_20_u1_u1 0.255 _CNV_A_R_EGCP_LINEA_344_CM 0. 0.255 DISPLAY_IDENTIFIER IP_T_DLY_TRIG_LSH_UP FORMAT "%5.3"
 /begin AXIS_DESCR COM_AXIS online_dummy _CNV_A_R_LINEAR_____5_CM 4 0. 99.609375 FORMAT "%9.6" AXIS_PTS_REF ldp_lshpwm_up_ip_t_dly_acq_vls /end AXIS_DESCR
/end CHARACTERISTIC
/begin CHARACTERISTIC c_t_afl_afr_diag_lsh_lsl_up "Threshold of the MAF-Integral to activate the heater-coupling diagnosis" VALUE 0xa080152e _REC_VAL_20_u2 655.35 _CNV_A_R_LINEAR_____3_CM 0. 655.35 DISPLAY_IDENTIFIER C_T_AFL_AFR_DIAG_LSH_LSL_UP FORMAT "%6.2" /end CHARACTERISTIC
/begin CHARACTERISTIC c_teg_min_diag_lsh_lsl_up "Minimum value of the exhaust temperature to activate  the function" VALUE 0xa08015fe _REC_VAL_20_u2 2047.9375 _CNV_A_R_LINEAR_____214_CM -273.15 1774.7875 DISPLAY_IDENTIFIER C_TEG_MIN_DIAG_LSH_LSL_UP FORMAT "%9.4" /end CHARACTERISTIC
/begin MEASUREMENT lv_ls_up_obd_man_deac_ext "Upstream WRAF Sensor Diagnosis deactivation for all banks" UBYTE _CNV_S_2_RANGE__0___1_CM 1 100. 0. 1. DISPLAY_IDENTIFIER LV_LS_UP_OBD_MAN_DEAC_EXT ECU_ADDRESS 0xd0007eec BIT_MASK 0x1 /end MEASUREMENT
/begin MEASUREMENT lv_ls_down_obd_man_deac_ext "Downstream WRAF Sensor Diagnosis deactivation for all banks" UBYTE _CNV_S_2_RANGE__0___1_CM 1 100. 0. 1. DISPLAY_IDENTIFIER LV_LS_DOWN_OBD_MAN_DEAC_EXT ECU_ADDRESS 0xd0007eed BIT_MASK 0x1 /end MEASUREMENT
/begin CHARACTERISTIC lc_lsl_diag_lsh_lsl_up_deac "Logical calibration data for manual deactivation of heater coupling diagnosis" VALUE 0xa080170a _REC_VAL_20_u1 1. _CNV_A_R_LINEAR_____0_CM 0. 1. DISPLAY_IDENTIFIER LC_LSL_DIAG_LSH_LSL_UP_DEAC FORMAT "%1.0" /end CHARACTERISTIC
/begin MEASUREMENT lv_lsl_diag_lsh_lsl_up_deac "Manual Deactivation of \"Diagnosis of the Heater Coupling in the Sensor Signal\"" UBYTE _CNV_S_2_RANGE__0___1_CM 1 100. 0. 1. DISPLAY_IDENTIFIER LV_LSL_DIAG_LSH_LSL_UP_DEAC ECU_ADDRESS 0xd0007474 BIT_MASK 0x1 /end MEASUREMENT
/begin AXIS_PTS ldpm_n_32_4_laco "" 0xa080679e n_32 _REC_AXS_20_u1 8160. _CNV_A_R_LINEAR_____10_CM 6 0. 8160. FORMAT "%4.0" /end AXIS_PTS
/begin AXIS_PTS ldpm_n_32_2_laco "" 0xa0806796 n_32 _REC_AXS_20_u1 8160. _CNV_A_R_LINEAR_____10_CM 6 0. 8160. FORMAT "%4.0" /end AXIS_PTS
/begin AXIS_PTS ldpm_maf_cyl_1_laco "" 0xa0806768 maf_cyl _REC_AXS_20_u2 2047.96875 _CNV_A_R_LINEAR_____215_CM 6 0. 2047.96875 FORMAT "%10.5" /end AXIS_PTS
/begin AXIS_PTS ldpm_eff_cat_diag_1_laco "" 0xa0806728 online_dummy _REC_AXS_20_u1 1.9921875 _CNV_A_R_LINEAR_____103_CM 8 0. 1.9921875 FORMAT "%8.6" /end AXIS_PTS
/begin AXIS_PTS ldpm_n_1_laco "" 0xa0806784 n _REC_AXS_20_u2 8160. _CNV_A_R_LINEAR_____14_CM 8 0. 8160. FORMAT "%4.0" /end AXIS_PTS
/begin AXIS_PTS ldpm_t1_lsl_up_1_laco "" 0xa08067b4 online_dummy _REC_AXS_20_u2 1.99996948242188 _CNV_A_R_LINEAR_____117_CM 8 0. 1.99996948242188 FORMAT "%7.5" /end AXIS_PTS
/begin AXIS_PTS ldpm_t1_lsl_up_2_laco "" 0xa08067c8 online_dummy _REC_AXS_20_u2 1.99996948242188 _CNV_A_R_LINEAR_____117_CM 4 0. 1.99996948242188 FORMAT "%7.5" /end AXIS_PTS
/begin AXIS_PTS ldpm_tco_1_laco "" 0xa08067f2 tco _REC_AXS_20_u1 190.5 _CNV_A_R_LINEAR_____17_CM 6 -48. 142.5 FORMAT "%6.2" /end AXIS_PTS
/begin AXIS_PTS ldpm_tco_st_1_laco "" 0xa0806808 tco_st _REC_AXS_20_u1 190.5 _CNV_A_R_LINEAR_____17_CM 6 -48. 142.5 FORMAT "%6.2" /end AXIS_PTS
/begin AXIS_PTS ldpm_t_dly_soi_lsl_pos_1_laco "" 0xa08067d4 online_dummy _REC_AXS_20_u2 1.023984 _CNV_A_R_LINEAR_____361_CM 8 0. 1.023984 FORMAT "%7.5" /end AXIS_PTS
/begin AXIS_PTS ldpm_t_dly_soi_lsl_pos_2_laco "" 0xa08067e8 online_dummy _REC_AXS_20_u2 1.023984 _CNV_A_R_LINEAR_____361_CM 4 0. 1.023984 FORMAT "%7.5" /end AXIS_PTS
/begin AXIS_PTS ldpm_vls_dif_lam_adj_1_laco "" 0xa0806810 online_dummy _REC_AXS_20_u2 9.99511719 _CNV_A_R_LACO_LINEA_362_CM 16 -5. 4.99511719 /end AXIS_PTS
/begin AXIS_PTS ldpm_vls_dif_lam_adj_2_laco "" 0xa0806834 online_dummy _REC_AXS_20_u2 9.99511719 _CNV_A_R_LACO_LINEA_362_CM 16 -5. 4.99511719 /end AXIS_PTS
/begin AXIS_PTS ldpm_maf_1_laco "" 0xa0806754 maf _REC_AXS_20_u2 1389. _CNV_A_R_LINEAR_____111_CM 8 0. 1389. FORMAT "%7.2" /end AXIS_PTS
/begin AXIS_PTS ldpm_tco_2_laco "" 0xa08067fa tco _REC_AXS_20_u1 190.5 _CNV_A_R_LINEAR_____17_CM 5 -48. 142.5 FORMAT "%6.2" /end AXIS_PTS
/begin AXIS_PTS ldpm_tco_3_laco "" 0xa0806800 tco _REC_AXS_20_u1 190.5 _CNV_A_R_LINEAR_____17_CM 6 -48. 142.5 FORMAT "%6.2" /end AXIS_PTS
/begin AXIS_PTS ldpm_n_32_5_laco "" 0xa08067a8 n_32 _REC_AXS_20_u1 8160. _CNV_A_R_LINEAR_____10_CM 8 0. 8160. FORMAT "%4.0" /end AXIS_PTS
/begin AXIS_PTS ldpm_fac_lam_mv_1_laco "" 0xa0806740 online_dummy _REC_AXS_20_u2 99.99847412 _CNV_A_R_LINEAR_____178_CM 8 -50. 49.99847412 FORMAT "%7.3" /end AXIS_PTS
/begin AXIS_PTS ldpm_fac_lam_ad_1_laco "" 0xa0806734 online_dummy _REC_AXS_20_u2 99.99847412 _CNV_A_R_LINEAR_____178_CM 5 -50. 49.99847412 FORMAT "%7.3" /end AXIS_PTS
/begin COMPU_METHOD _CNV_A_R_LINEAR_____0_CM "" RAT_FUNC "%6.3" "-" COEFFS 0 1. 0. 0 0 1 /end COMPU_METHOD
/begin COMPU_METHOD _CNV_S_2_RANGE__0___1_CM "" TAB_VERB "%6.3" "-" COMPU_TAB_REF _CNV_S_2_RANGE__0___1 /end COMPU_METHOD
/begin COMPU_VTAB _CNV_S_2_RANGE__0___1 "" TAB_VERB 2 0 "0" 1 "1" /end COMPU_VTAB
/begin COMPU_METHOD _CNV_A_R_LINEAR_____2_CM "" RAT_FUNC "%6.3" "V" COEFFS 0 204.8 0. 0 0 1 /end COMPU_METHOD
/begin COMPU_METHOD _CNV_A_R_LINEAR_____3_CM "" RAT_FUNC "%6.3" "s" COEFFS 0 100. 0. 0 0 1 /end COMPU_METHOD
/begin COMPU_METHOD _CNV_A_R_LINEAR_____4_CM "" RAT_FUNC "%6.3" "s" COEFFS 0 10. 0. 0 0 1 /end COMPU_METHOD
/begin COMPU_METHOD _CNV_A_R_LINEAR_____5_CM "" RAT_FUNC "%6.3" "%" COEFFS 0 2.56 0. 0 0 1 /end COMPU_METHOD
/begin COMPU_METHOD _CNV_A_R_LINEAR_____9_CM "" RAT_FUNC "%6.3" "-" COEFFS 0 32767.99999999992 0. 0 0 1 /end COMPU_METHOD
/begin COMPU_METHOD _CNV_A_R_LINEAR_____10_CM "" RAT_FUNC "%6.3" "rpm" COEFFS 0 3.125e-002 0. 0 0 1 /end COMPU_METHOD
/begin COMPU_METHOD _CNV_A_R_LINEAR_____14_CM "" RAT_FUNC "%6.3" "rpm" COEFFS 0 1. 0. 0 0 1 /end COMPU_METHOD
/begin COMPU_METHOD _CNV_A_R_LINEAR_____15_CM "" RAT_FUNC "%6.3" "mg/stk" COEFFS 0 0.183585313174946 0. 0 0 1 /end COMPU_METHOD
/begin COMPU_METHOD _CNV_A_R_LINEAR_____17_CM "" RAT_FUNC "%6.3" "°C" COEFFS 0 1.333333333333333 64. 0 0 1 /end COMPU_METHOD
/begin COMPU_METHOD _CNV_A_R_LINEAR_____24_CM "" RAT_FUNC "%6.3" "-" COEFFS 0 16384. 0. 0 0 1 /end COMPU_METHOD
/begin COMPU_METHOD _CNV_A_R_LINEAR_____28_CM "" RAT_FUNC "%6.3" "-" COEFFS 0 256. 0. 0 0 1 /end COMPU_METHOD
/begin COMPU_METHOD _CNV_A_R_LINEAR_____31_CM "" RAT_FUNC "%6.3" "Nm" COEFFS 0 32. 0. 0 0 1 /end COMPU_METHOD
/begin COMPU_METHOD _CNV_A_R_LINEAR_____87_CM "" RAT_FUNC "%6.3" "Nm" COEFFS 0 32. 32768. 0 0 1 /end COMPU_METHOD
/begin COMPU_METHOD _CNV_A_R_LINEAR_____89_CM "" RAT_FUNC "%6.3" "-" COEFFS 0 65535.99999999996 0. 0 0 1 /end COMPU_METHOD
/begin COMPU_METHOD _CNV_A_R_LINEAR_____103_CM "" RAT_FUNC "%6.3" "-" COEFFS 0 128. 0. 0 0 1 /end COMPU_METHOD
/begin COMPU_METHOD _CNV_A_R_LINEAR_____110_CM "" RAT_FUNC "%6.3" "s" COEFFS 0 50. 0. 0 0 1 /end COMPU_METHOD
/begin COMPU_METHOD _CNV_A_R_LINEAR_____111_CM "" RAT_FUNC "%6.3" "mg/stk" COEFFS 0 47.18142548596112 0. 0 0 1 /end COMPU_METHOD
/begin COMPU_METHOD _CNV_A_R_LINEAR_____117_CM "" RAT_FUNC "%6.3" "s" COEFFS 0 32767.99999999992 0. 0 0 1 /end COMPU_METHOD
/begin COMPU_METHOD _CNV_A_R_LINEAR_____129_CM "" RAT_FUNC "%6.3" "-" COEFFS 0 1024. 0. 0 0 1 /end COMPU_METHOD
/begin COMPU_METHOD _CNV_A_R_LINEAR_____130_CM "" RAT_FUNC "%6.3" "°C" COEFFS 0 16. 0. 0 0 1 /end COMPU_METHOD
/begin COMPU_METHOD _CNV_A_R_LINEAR_____178_CM "" RAT_FUNC "%6.3" "%" COEFFS 0 655.3600000071681 32768.00000035841 0 0 1 /end COMPU_METHOD
/begin COMPU_METHOD _CNV_A_R_LINEAR_____214_CM "" RAT_FUNC "%6.3" "°C" COEFFS 0 16. 4370.4 0 0 1 /end COMPU_METHOD
/begin COMPU_METHOD _CNV_A_R_LINEAR_____215_CM "" RAT_FUNC "%6.3" "kg/h" COEFFS 0 32. 0. 0 0 1 /end COMPU_METHOD
/begin COMPU_METHOD _CNV_A_R_LINEAR_____287_CM "" RAT_FUNC "%6.3" "g" COEFFS 0 35.99999999999994 0. 0 0 1 /end COMPU_METHOD
/begin COMPU_METHOD _CNV_A_R_LINEAR_____314_CM "" RAT_FUNC "%6.3" "g" COEFFS 0 22.49999999999997 0. 0 0 1 /end COMPU_METHOD
/begin COMPU_METHOD _CNV_A_R_LINEAR_____315_CM "" RAT_FUNC "%6.3" "V" COEFFS 0 204.7999999487896 -2.556795379859977e-007 0 0 1 /end COMPU_METHOD
/begin COMPU_METHOD _CNV_A_R_EGCP_LINEA_316_CM "Battery voltage" RAT_FUNC "%6.3" "-" COEFFS 0 1024.000007000107 0. 0 0 1 /end COMPU_METHOD
/begin COMPU_METHOD _CNV_S_5_EGCP_RANGE_338_CM "" TAB_VERB "%6.3" "-" COMPU_TAB_REF _CNV_S_5_EGCP_RANGE_338 /end COMPU_METHOD
/begin COMPU_VTAB _CNV_S_5_EGCP_RANGE_338 "" TAB_VERB 5 0 "NO_SYM" 1 "SYM_0" 2 "SYM_1" 4 "SYM_2" 8 "SYM_3" /end COMPU_VTAB
/begin COMPU_METHOD _CNV_A_R_EGCP_LINEA_344_CM "" RAT_FUNC "%6.3" "s" COEFFS 0 1000. 0. 0 0 1 /end COMPU_METHOD
/begin COMPU_METHOD _CNV_A_R_EGCP_LINEA_346_CM "" RAT_FUNC "%6.3" "-" COEFFS 0 1024.003612233215 0. 0 0 1 /end COMPU_METHOD
/begin COMPU_METHOD _CNV_S_4_EGCP_RANGE_347_CM "" TAB_VERB "%6.3" "-" COMPU_TAB_REF _CNV_S_4_EGCP_RANGE_347 /end COMPU_METHOD
/begin COMPU_VTAB _CNV_S_4_EGCP_RANGE_347 "" TAB_VERB 4 0 "PASSIVE" 1 "WAIT" 2 "ACQUISITION" 3 "END" /end COMPU_VTAB
/begin COMPU_METHOD _CNV_S_4_EGCP_RANGE_348_CM "" TAB_VERB "%6.3" "-" COMPU_TAB_REF _CNV_S_4_EGCP_RANGE_348 /end COMPU_METHOD
/begin COMPU_VTAB _CNV_S_4_EGCP_RANGE_348 "" TAB_VERB 4 0 "VLS_OK" 1 "VLS_L" 2 "VLS_H_OC" 4 "VLS_AFS_OC" /end COMPU_VTAB
/begin COMPU_METHOD _CNV_S_16_RANGE_ERR__349_CM "" TAB_VERB "%6.3" "-" COMPU_TAB_REF _CNV_S_16_RANGE_ERR__349 /end COMPU_METHOD
/begin COMPU_VTAB _CNV_S_16_RANGE_ERR__349 "" TAB_VERB 16 0 "NO_SYM" 1 "SYM_0" 2 "SYM_1" 3 "SYM_0, SYM_1" 4 "SYM_2" 5 "SYM_0, SYM_2" 6 "SYM_1, SYM_2" 7 "SYM_0, SYM_1, SYM_2" 8 "SYM_3" 9 "SYM_0, SYM_3" 10 "SYM_1, SYM_3" 11 "SYM_0, SYM_1,SYM_3" 12 "SYM_2, SYM_3" 13 "SYM_0, SYM_2, SYM_3" 14 "SYM_1, SYM_2, SYM_3" 15 "SYM_0, SYM_1, SYM_2, SYM_3" /end COMPU_VTAB
/begin COMPU_METHOD _CNV_A_R_EGCP_LINEA_353_CM "" RAT_FUNC "%6.3" "V" COEFFS 0 8192. 0. 0 0 1 /end COMPU_METHOD
/begin COMPU_METHOD _CNV_A_R_EGCP_LINEA_354_CM "" RAT_FUNC "%6.3" "-" COEFFS 0 100. 0. 0 0 1 /end COMPU_METHOD
/begin COMPU_METHOD _CNV_A_R_EGCP_LINEA_355_CM "" RAT_FUNC "%6.3" "-" COEFFS 0 8. 0. 0 0 1 /end COMPU_METHOD
/begin COMPU_METHOD _CNV_A_R_EGCP_LINEA_356_CM "" RAT_FUNC "%6.3" "-" COEFFS 0 16383.9953897502 0. 0 0 1 /end COMPU_METHOD
/begin COMPU_METHOD _CNV_A_R_LINEAR_____357_CM "" RAT_FUNC "%6.3" "-" COEFFS 0 4095.990747879723 0. 0 0 1 /end COMPU_METHOD
/begin COMPU_METHOD _CNV_A_R_LINEAR_____361_CM "" RAT_FUNC "%6.3" "s" COEFFS 0 64000.02343786621 0. 0 0 1 /end COMPU_METHOD
/begin COMPU_METHOD _CNV_A_R_LACO_LINEA_362_CM "" RAT_FUNC "%6.3" "V" COEFFS 0 204.799999948775 1023.999999743875 0 0 1 /end COMPU_METHOD
/begin RECORD_LAYOUT _REC_VAL_20_u1 FNC_VALUES 1 UBYTE COLUMN_DIR DIRECT /end RECORD_LAYOUT
/begin RECORD_LAYOUT _REC_VAL_20_u2 FNC_VALUES 1 UWORD COLUMN_DIR DIRECT /end RECORD_LAYOUT
/begin RECORD_LAYOUT _REC_AXS_20_u1 NO_AXIS_PTS_X 1 UBYTE AXIS_PTS_X 2 UBYTE INDEX_INCR DIRECT /end RECORD_LAYOUT
/begin RECORD_LAYOUT _REC_MAP_20_u2_u1_u1 FNC_VALUES 1 UWORD COLUMN_DIR DIRECT /end RECORD_LAYOUT
/begin RECORD_LAYOUT _REC_CUR_20_u1_u1 FNC_VALUES 1 UBYTE COLUMN_DIR DIRECT /end RECORD_LAYOUT
/begin RECORD_LAYOUT _REC_VAL_20_s2 FNC_VALUES 1 SWORD COLUMN_DIR DIRECT /end RECORD_LAYOUT
/begin RECORD_LAYOUT _REC_AXS_20_u2 NO_AXIS_PTS_X 1 UWORD AXIS_PTS_X 2 UWORD INDEX_INCR DIRECT /end RECORD_LAYOUT
/begin RECORD_LAYOUT _REC_CUR_20_u1_u2 FNC_VALUES 1 UBYTE COLUMN_DIR DIRECT /end RECORD_LAYOUT
/begin RECORD_LAYOUT _REC_MAP_20_u1_u1_u1 FNC_VALUES 1 UBYTE COLUMN_DIR DIRECT /end RECORD_LAYOUT
/begin RECORD_LAYOUT _REC_MAP_20_u1_u1_u2 FNC_VALUES 1 UBYTE COLUMN_DIR DIRECT /end RECORD_LAYOUT
/begin FUNCTION EGCP_O2_sensor_down_diag_inci "O2_sensor_down_diag_inci"
 /begin DEF_CHARACTERISTIC lc_inh_diag_pue_ls_down[0] lc_inh_diag_pue_ls_down[1] lc_inh_diag_swt_ls_down[0] lc_inh_diag_swt_ls_down[1] lc_inh_ls_down_man_deac /end DEF_CHARACTERISTIC
 /begin OUT_MEASUREMENT egcp[0].egcp_struct_sigdglsdi2.lv_inh_diag_swt_ls_down egcp[0].egcp_struct_sigdglsdi2.lv_inh_diag_rbm_swt_ls_down egcp[0].egcp_struct_sigdglsdi2.lv_inh_diag_pue_ls_down egcp[0].egcp_struct_sigdglsdi2.state_rbm_swt_ls_down egcp[0].egcp_struct_sigdglsdi2.lv_inh_diag_tmp_ls_down egcp[1].egcp_struct_sigdglsdi2.lv_inh_diag_swt_ls_down egcp[1].egcp_struct_sigdglsdi2.lv_inh_diag_rbm_swt_ls_down egcp[1].egcp_struct_sigdglsdi2.lv_inh_diag_pue_ls_down egcp[1].egcp_struct_sigdglsdi2.state_rbm_swt_ls_down egcp[1].egcp_struct_sigdglsdi2.lv_inh_diag_tmp_ls_down /end OUT_MEASUREMENT
/end FUNCTION
/begin FUNCTION EGCP_O2_sensor_up_heater_diag_ai "O2_sensor_up_heater_diag_ai"
 /begin OUT_MEASUREMENT egcp[0].egcp_struct_fctdglslhi0.lv_inh_diag_obd_lsh_up egcp[0].egcp_struct_fctdglslhi0.state_rbm_obd_vld_lsh_up egcp[0].egcp_struct_fctdglslhi0.lv_inh_diag_rbm_obd_lsh_up egcp[1].egcp_struct_fctdglslhi0.lv_inh_diag_obd_lsh_up egcp[1].egcp_struct_fctdglslhi0.state_rbm_obd_vld_lsh_up egcp[1].egcp_struct_fctdglslhi0.lv_inh_diag_rbm_obd_lsh_up /end OUT_MEASUREMENT
/end FUNCTION
/begin FUNCTION EGCP_O2_sensor_diag_manag_inci "O2_sensor_diag_manag_inci" /begin OUT_MEASUREMENT lv_ls_up_obd_man_deac_ext lv_ls_down_obd_man_deac_ext /end OUT_MEASUREMENT /end FUNCTION
/begin FUNCTION EGCP_O2_sensor_probe_diag_inci "O2_sensor_probe_diag_inci"
 /begin OUT_MEASUREMENT egcp[0].egcp_struct_pladglsli1.lv_diag_act_inh_ls_up_down egcp[0].egcp_struct_pladglsli1.lv_diag_afr_afl_inh_ls_up_down egcp[0].egcp_struct_pladglsli1.lv_diag_eol_req_ls_up_down egcp[0].egcp_struct_pladglsli1.lv_diag_opl_req_cbk egcp[0].egcp_struct_pladglsli1.lv_diag_act_inh_rbm_ls_up_down egcp[1].egcp_struct_pladglsli1.lv_diag_act_inh_ls_up_down egcp[1].egcp_struct_pladglsli1.lv_diag_afr_afl_inh_ls_up_down egcp[1].egcp_struct_pladglsli1.lv_diag_eol_req_ls_up_down egcp[1].egcp_struct_pladglsli1.lv_diag_opl_req_cbk egcp[1].egcp_struct_pladglsli1.lv_diag_act_inh_rbm_ls_up_down /end OUT_MEASUREMENT
/end FUNCTION
/begin FUNCTION EGCP_Down_O2_sensor_resist_inci "Down_O2_sensor_resist_inci" /begin DEF_CHARACTERISTIC c_tco_cur_on_ls_down_min /end DEF_CHARACTERISTIC
 /begin OUT_MEASUREMENT egcp[0].egcp_struct_sigcvridi0.lv_inh_r_it_ls_down egcp[1].egcp_struct_sigcvridi0.lv_inh_r_it_ls_down /end OUT_MEASUREMENT
/end FUNCTION
/begin FUNCTION EGCP_Linear_O2_sensor_hea_diag "Linear_O2_sensor_hea_diag"
 /begin DEF_CHARACTERISTIC c_lamb_delta_lpf_thd c_cycnr_max_diag_lsh_lsl_up c_ctr_sym_diag_lsh_lsl_up c_lamb_sp_de_diag_lsh_lsl_up c_maf_int_diag_lsh_lsl_up c_crlc_lpf_fall_diag_lsh_lsl_up c_crlc_lpf_rise_diag_lsh_lsl_up c_lshpwm_min_diag_lsh_lsl_up c_lshpwm_max_diag_lsh_lsl_up ldp_lshpwm_up_ip_t_dly_acq_vls ip_t_dly_trig_lsh_up c_t_afl_afr_diag_lsh_lsl_up c_teg_min_diag_lsh_lsl_up lc_lsl_diag_lsh_lsl_up_deac /end DEF_CHARACTERISTIC
 /begin OUT_MEASUREMENT egcp[0].egcp_struct_sigdglsl3.lamb_delta_rise_lpf egcp[0].egcp_struct_sigdglsl3.lamb_delta_fall_lpf egcp[0].egcp_struct_sigdglsl3.lamb_syn_lshpwm_fall egcp[0].egcp_struct_sigdglsl3.lamb_syn_lshpwm_rise egcp[0].egcp_struct_sigdglsl3.lamb_delta_rise egcp[0].egcp_struct_sigdglsl3.lamb_delta_fall egcp[0].egcp_struct_sigdglsl3.ctr_sym_diag_lsh_lsl_up egcp[0].egcp_struct_sigdglsl3.cycnr_diag_lsh_lsl_up egcp[0].egcp_struct_sigdglsl3.t_dly_trig_lsh_up egcp[1].egcp_struct_sigdglsl3.lamb_delta_rise_lpf egcp[1].egcp_struct_sigdglsl3.lamb_delta_fall_lpf egcp[1].egcp_struct_sigdglsl3.lamb_syn_lshpwm_fall egcp[1].egcp_struct_sigdglsl3.lamb_syn_lshpwm_rise egcp[1].egcp_struct_sigdglsl3.lamb_delta_rise egcp[1].egcp_struct_sigdglsl3.lamb_delta_fall egcp[1].egcp_struct_sigdglsl3.ctr_sym_diag_lsh_lsl_up egcp[1].egcp_struct_sigdglsl3.cycnr_diag_lsh_lsl_up egcp[1].egcp_struct_sigdglsl3.t_dly_trig_lsh_up maf_int_diag_lsh_lsl_up lv_err_lsh_lsl_up_1 lv_err_lsh_lsl_up_2 /end OUT_MEASUREMENT
/end FUNCTION
/begin FUNCTION EGCP_Linear_O2_sens_hea_diag_AI "Linear_O2_sens_hea_diag_AI"
 /begin OUT_MEASUREMENT egcp[0].egcp_struct_sigdglsli3.lv_inh_diag_lsh_lsl_up egcp[1].egcp_struct_sigdglsli3.lv_inh_diag_lsh_lsl_up lv_lsl_diag_lsh_lsl_up_deac /end OUT_MEASUREMENT
/end FUNCTION
/begin FUNCTION EGCP_O2_sensor_plaus_diag "O2_sensor_plaus_diag"
 /begin DEF_CHARACTERISTIC c_teg_min_plaus_lsl_up[0] c_teg_min_plaus_lsl_up[1] c_teg_max_plaus_lsl_up[0] c_teg_max_plaus_lsl_up[1] c_maf_kgh_min_diag_plaus_lsl_up c_maf_kgh_max_diag_plaus_lsl_up c_n_min_diag_plaus_lsl_up c_vls_down_afl_plaus_lsl_up[0] c_vls_down_afl_plaus_lsl_up[1] c_vls_down_afr_plaus_lsl_up[0] c_vls_down_afr_plaus_lsl_up[1] c_lamb_afl_plaus_lsl_up[0] c_lamb_afl_plaus_lsl_up[1] c_lamb_afr_plaus_lsl_up[0] c_lamb_afr_plaus_lsl_up[1] c_tco_min_diag_plaus_lsl_up c_maf_sym_plaus_lsl_up[0] c_maf_sym_plaus_lsl_up[1] c_maf_sym_raw_rst_plaus_lsl_up[0] c_maf_sym_raw_rst_plaus_lsl_up[1] c_maf_sym_raw_plaus_lsl_up[0] c_maf_sym_raw_plaus_lsl_up[1] /end DEF_CHARACTERISTIC
 /begin OUT_MEASUREMENT egcp[0].egcp_struct_pladgls0.maf_sym_raw_plaus_lsl_up egcp[0].egcp_struct_pladgls0.maf_sym_plaus_lsl_up egcp[0].egcp_struct_pladgls0.maf_end_plaus_lsl_up egcp[0].egcp_struct_pladgls0.state_sym_diag_plaus_lsl_up egcp[0].egcp_struct_pladgls0.lv_diag_plaus_sym_lsl_up egcp[0].egcp_struct_pladgls0.lv_diag_cdn_plaus_lsl_up egcp[0].egcp_struct_pladgls0.lv_diag_plaus_end_lsl_up egcp[0].egcp_struct_pladgls0.lv_diag_afr_sym_plaus_lsl_up egcp[0].egcp_struct_pladgls0.lv_diag_afl_sym_plaus_lsl_up egcp[1].egcp_struct_pladgls0.maf_sym_raw_plaus_lsl_up egcp[1].egcp_struct_pladgls0.maf_sym_plaus_lsl_up egcp[1].egcp_struct_pladgls0.maf_end_plaus_lsl_up egcp[1].egcp_struct_pladgls0.state_sym_diag_plaus_lsl_up egcp[1].egcp_struct_pladgls0.lv_diag_plaus_sym_lsl_up egcp[1].egcp_struct_pladgls0.lv_diag_cdn_plaus_lsl_up egcp[1].egcp_struct_pladgls0.lv_diag_plaus_end_lsl_up egcp[1].egcp_struct_pladgls0.lv_diag_afr_sym_plaus_lsl_up egcp[1].egcp_struct_pladgls0.lv_diag_afl_sym_plaus_lsl_up /end OUT_MEASUREMENT
/end FUNCTION
/begin FUNCTION EGCP_O2_sensor_dynamic_diag "O2_sensor_dynamic_diag"
 /begin DEF_CHARACTERISTIC c_ctr_min_diag_dyn_lsl_up c_ctr_min_diag_eol_dyn_lsl_up c_ctr_wait_diag_dyn_lsl_up c_cycnr_min_diag_dyn_lsl_up c_cycnr_end_diag_dyn_lsl_up c_cycnr_eol_diag_dyn_lsl_up c_n_min_diag_dyn_lsl_up c_n_max_diag_dyn_lsl_up c_maf_max_diag_dyn_lsl_up c_maf_min_diag_dyn_lsl_up c_crlc_lpf_lamb_diag_dyn_lsl_up c_lamb_min_diag_dyn_lsl_up c_lamb_max_diag_dyn_lsl_up c_lamb_ampl_min_dyn_lsl_up c_lamb_ampl_max_dyn_lsl_up c_fac_mv_thd_diag_dyn_lsl_up c_fac_ad_thd_diag_dyn_lsl_up c_fac_ad_rst_diag_dyn_lsl_up c_crlc_lpf_fac_ad_dyn_lsl_up lc_diag_dyn_lsl_up_cat_syn lc_t1_ad_diag_dyn_lsl_up ip_lamb_ampl_max_dyn_lsl_up ip_lamb_ampl_min_dyn_lsl_up ip_t_dyn_diag /end DEF_CHARACTERISTIC
 /begin OUT_MEASUREMENT egcp[0].egcp_struct_pladglsl0.lamb_lpf_diag_dyn_lsl_up egcp[0].egcp_struct_pladglsl0.lamb_min_diag_dyn_lsl_up egcp[0].egcp_struct_pladglsl0.lamb_max_diag_dyn_lsl_up egcp[0].egcp_struct_pladglsl0.lamb_ampl_int_diag_dyn_lsl_up egcp[0].egcp_struct_pladglsl0.fac_value_diag_dyn_lsl_up egcp[0].egcp_struct_pladglsl0.fac_sum_diag_dyn_lsl_up egcp[0].egcp_struct_pladglsl0.fac_mv_diag_dyn_lsl_up egcp[0].egcp_struct_pladglsl0.fac_diag_dyn_lsl_up egcp[0].egcp_struct_pladglsl0.t_dyn_diag_afl egcp[0].egcp_struct_pladglsl0.t_dyn_diag_afr egcp[0].egcp_struct_pladglsl0.lamb_ampl_diag_dyn_lsl_up egcp[0].egcp_struct_pladglsl0.lamb_ampl_min_diag_dyn_lsl_up egcp[0].egcp_struct_pladglsl0.lamb_ampl_max_diag_dyn_lsl_up egcp[0].egcp_struct_pladglsl0.lamb_ampl_mv_diag_dyn_lsl_up egcp[0].egcp_struct_pladglsl0.ctr_diag_dyn_lsl_up egcp[0].egcp_struct_pladglsl0.ctr_wait_diag_dyn_lsl_up egcp[0].egcp_struct_pladglsl0.cycnr_diag_dyn_lsl_up egcp[0].egcp_struct_pladglsl0.state_dyn_diag egcp[0].egcp_struct_pladglsl0.lv_diag_dyn_sym_lsl_up egcp[0].egcp_struct_pladglsl0.lv_diag_dyn_cdn_lsl_up egcp[0].egcp_struct_pladglsl0.lv_diag_dyn_end_lsl_up egcp[0].egcp_struct_pladglsl0.lv_lamb_pls_req_dyn_lsl_up egcp[0].egcp_struct_pladglsl0.lv_lam_adj_req_dyn_lsl_up egcp[1].egcp_struct_pladglsl0.lamb_lpf_diag_dyn_lsl_up egcp[1].egcp_struct_pladglsl0.lamb_min_diag_dyn_lsl_up egcp[1].egcp_struct_pladglsl0.lamb_max_diag_dyn_lsl_up egcp[1].egcp_struct_pladglsl0.lamb_ampl_int_diag_dyn_lsl_up egcp[1].egcp_struct_pladglsl0.fac_value_diag_dyn_lsl_up egcp[1].egcp_struct_pladglsl0.fac_sum_diag_dyn_lsl_up egcp[1].egcp_struct_pladglsl0.fac_mv_diag_dyn_lsl_up egcp[1].egcp_struct_pladglsl0.fac_diag_dyn_lsl_up egcp[1].egcp_struct_pladglsl0.t_dyn_diag_afl egcp[1].egcp_struct_pladglsl0.t_dyn_diag_afr egcp[1].egcp_struct_pladglsl0.lamb_ampl_diag_dyn_lsl_up egcp[1].egcp_struct_pladglsl0.lamb_ampl_min_diag_dyn_lsl_up egcp[1].egcp_struct_pladglsl0.lamb_ampl_max_diag_dyn_lsl_up egcp[1].egcp_struct_pladglsl0.lamb_ampl_mv_diag_dyn_lsl_up egcp[1].egcp_struct_pladglsl0.ctr_diag_dyn_lsl_up egcp[1].egcp_struct_pladglsl0.ctr_wait_diag_dyn_lsl_up egcp[1].egcp_struct_pladglsl0.cycnr_diag_dyn_lsl_up egcp[1].egcp_struct_pladglsl0.state_dyn_diag egcp[1].egcp_struct_pladglsl0.lv_diag_dyn_sym_lsl_up egcp[1].egcp_struct_pladglsl0.lv_diag_dyn_cdn_lsl_up egcp[1].egcp_struct_pladglsl0.lv_diag_dyn_end_lsl_up egcp[1].egcp_struct_pladglsl0.lv_lamb_pls_req_dyn_lsl_up egcp[1].egcp_struct_pladglsl0.lv_lam_adj_req_dyn_lsl_up ctr_min_diag_dyn_lsl_up lv_err_dyn_vld_ls_up_1 lv_err_dyn_vld_ls_up_2 /end OUT_MEASUREMENT
/end FUNCTION
/begin FUNCTION EGCP_O2_sensor_not_mount_diag "O2_sensor_not_mount_diag"
 /begin DEF_CHARACTERISTIC c_vls_up_diag_max_air_lsl_up c_t_sym_diag_air_lsl_up c_t_end_diag_air_lsl_up /end DEF_CHARACTERISTIC
 /begin OUT_MEASUREMENT egcp[0].egcp_struct_pladglsl5.t_sym_diag_air_lsl_up egcp[0].egcp_struct_pladglsl5.t_end_diag_air_lsl_up egcp[1].egcp_struct_pladglsl5.t_sym_diag_air_lsl_up egcp[1].egcp_struct_pladglsl5.t_end_diag_air_lsl_up lv_err_air_lsl_up_1 lv_err_air_lsl_up_2 /end OUT_MEASUREMENT
/end FUNCTION
/begin FUNCTION EGCP_O2_sensor_PUC_plaus_diag "O2_sensor_PUC_plaus_diag"
 /begin DEF_CHARACTERISTIC c_t_diag_sym_puc_lsl_up c_t_diag_sym_eol_puc_lsl_up c_t_dly_diag_puc_lsl_up c_t_dly_diag_eol_puc_lsl_up c_vls_up_diag_afs_puc_lsl_up c_vls_up_diag_min_puc_lsl_up c_vls_up_diag_max_puc_lsl_up c_teg_min_diag_puc_lsl_up c_t_diag_end_puc_lsl_up c_t_diag_end_eol_puc_lsl_up /end DEF_CHARACTERISTIC
 /begin OUT_MEASUREMENT egcp[0].egcp_struct_pladglsl2.t_diag_end_puc_lsl_up egcp[0].egcp_struct_pladglsl2.t_max_diag_end_puc_lsl_up egcp[0].egcp_struct_pladglsl2.t_dly_diag_puc_lsl_up egcp[0].egcp_struct_pladglsl2.t_max_dly_diag_puc_lsl_up egcp[0].egcp_struct_pladglsl2.t_diag_sym_puc_lsl_up egcp[0].egcp_struct_pladglsl2.t_max_diag_sym_puc_lsl_up egcp[0].egcp_struct_pladglsl2.vls_up_diag_save_puc_lsl_up egcp[0].egcp_struct_pladglsl2.state_sym_diag_puc_lsl_up egcp[0].egcp_struct_pladglsl2.lv_diag_puc_end_lsl_up egcp[0].egcp_struct_pladglsl2.lv_diag_cdn_puc_lsl_up egcp[0].egcp_struct_pladglsl2.lv_diag_puc_sym_lsl_up egcp[1].egcp_struct_pladglsl2.t_diag_end_puc_lsl_up egcp[1].egcp_struct_pladglsl2.t_max_diag_end_puc_lsl_up egcp[1].egcp_struct_pladglsl2.t_dly_diag_puc_lsl_up egcp[1].egcp_struct_pladglsl2.t_max_dly_diag_puc_lsl_up egcp[1].egcp_struct_pladglsl2.t_diag_sym_puc_lsl_up egcp[1].egcp_struct_pladglsl2.t_max_diag_sym_puc_lsl_up egcp[1].egcp_struct_pladglsl2.vls_up_diag_save_puc_lsl_up egcp[1].egcp_struct_pladglsl2.state_sym_diag_puc_lsl_up egcp[1].egcp_struct_pladglsl2.lv_diag_puc_end_lsl_up egcp[1].egcp_struct_pladglsl2.lv_diag_cdn_puc_lsl_up egcp[1].egcp_struct_pladglsl2.lv_diag_puc_sym_lsl_up lv_err_puc_vld_ls_up_1 lv_err_puc_vld_ls_up_2 /end OUT_MEASUREMENT
/end FUNCTION
/begin FUNCTION EGCP_O2_sensor_activity_diag "O2_sensor_activity_diag"
 /begin DEF_CHARACTERISTIC c_fac_dyn_int_act_lsl_up c_n_min_act_lsl_up c_t_sum_afl_afr_act_lsl_up c_lamb_sp_de_pls_act_lsl_up c_maf_kgh_min_act_lsl_up c_ctr_lamb_de_int_act_lsl_up c_lamb_de_tot_act_lsl_up c_ctr_sym_max_act_lsl_up c_ctr_sym_inc_act_lsl_up c_ctr_sym_dec_act_lsl_up c_crlc_act_lsl_up ldp_maf_kgh_id_ctr_act_lsl_up id_ctr_inc_raw_act_lsl_up ldp_vls_down_id_lamb_gain id_lamb_gain_vls_down ldp_fac_diag_dyn_lsl_up_id_lamb id_lamb_gain_ls_up_dyn c_vls_up_afs_min_plaus_lsl_up c_vls_up_afs_max_plaus_lsl_up c_ctr_raw_act_end_lsl_up c_ctr_raw_act_rst_lsl_up c_ctr_raw_act_sym_lsl_up /end DEF_CHARACTERISTIC
 /begin OUT_MEASUREMENT egcp[0].egcp_struct_pladglsl3.ctr_raw_act_sym_lsl_up egcp[0].egcp_struct_pladglsl3.ctr_raw_act_end_lsl_up egcp[0].egcp_struct_pladglsl3.lamb_de_lsl egcp[0].egcp_struct_pladglsl3.lamb_de_int_act_lsl_up egcp[0].egcp_struct_pladglsl3.lamb_de_tot_act_lsl_up egcp[0].egcp_struct_pladglsl3.lamb_mmv_act_lsl_up egcp[0].egcp_struct_pladglsl3.ctr_sym_act_lsl_up egcp[0].egcp_struct_pladglsl3.ctr_end_act_lsl_up egcp[0].egcp_struct_pladglsl3.ctr_lamb_de_int_act_lsl_up egcp[0].egcp_struct_pladglsl3.lv_diag_raw_act_sym_lsl_up egcp[0].egcp_struct_pladglsl3.lv_diag_raw_act_end_lsl_up egcp[0].egcp_struct_pladglsl3.lv_diag_act_cdn_lsl_up egcp[0].egcp_struct_pladglsl3.lv_diag_act_sho_cdn_lsl_up egcp[0].egcp_struct_pladglsl3.lv_diag_act_sym_lsl_up egcp[0].egcp_struct_pladglsl3.lv_diag_act_end_lsl_up egcp[1].egcp_struct_pladglsl3.ctr_raw_act_sym_lsl_up egcp[1].egcp_struct_pladglsl3.ctr_raw_act_end_lsl_up egcp[1].egcp_struct_pladglsl3.lamb_de_lsl egcp[1].egcp_struct_pladglsl3.lamb_de_int_act_lsl_up egcp[1].egcp_struct_pladglsl3.lamb_de_tot_act_lsl_up egcp[1].egcp_struct_pladglsl3.lamb_mmv_act_lsl_up egcp[1].egcp_struct_pladglsl3.ctr_sym_act_lsl_up egcp[1].egcp_struct_pladglsl3.ctr_end_act_lsl_up egcp[1].egcp_struct_pladglsl3.ctr_lamb_de_int_act_lsl_up egcp[1].egcp_struct_pladglsl3.lv_diag_raw_act_sym_lsl_up egcp[1].egcp_struct_pladglsl3.lv_diag_raw_act_end_lsl_up egcp[1].egcp_struct_pladglsl3.lv_diag_act_cdn_lsl_up egcp[1].egcp_struct_pladglsl3.lv_diag_act_sho_cdn_lsl_up egcp[1].egcp_struct_pladglsl3.lv_diag_act_sym_lsl_up egcp[1].egcp_struct_pladglsl3.lv_diag_act_end_lsl_up /end OUT_MEASUREMENT
/end FUNCTION
/begin FUNCTION EGCP_WRAF_Controller_ofs_dg "WRAF_Controller_ofs_dg"
 /begin DEF_CHARACTERISTIC c_t_diag_act_ofs_max c_lamb_sp_min_diag_ctl_lsl_up c_lamb_sp_max_diag_ctl_lsl_up c_ttip_min_diag_ctl_lsl_up c_ttip_max_diag_ctl_lsl_up c_vls_up_min_diag_ctl_lsl_up c_vls_up_max_diag_ctl_lsl_up /end DEF_CHARACTERISTIC
 /begin OUT_MEASUREMENT egcp[0].egcp_struct_pladgspi1.t_diag_act_ofs egcp[0].egcp_struct_pladgspi1.ctr_ofs_adj_cmpl egcp[0].egcp_struct_pladgspi1.err_diag_ctl_lsl_up egcp[0].egcp_struct_pladgspi1.cdn_diag_ctl_lsl_up egcp[0].egcp_struct_pladgspi1.lv_err_ofs_lsl_up egcp[0].egcp_struct_pladgspi1.lv_end_diag_ofs_lsl_up egcp[0].egcp_struct_pladgspi1.lv_lsl_ofs_adj_diag_ofs_old egcp[0].egcp_struct_pladgspi1.lv_err_ctl_lsl_up egcp[0].egcp_struct_pladgspi1.lv_end_diag_ctl_lsl_up egcp[1].egcp_struct_pladgspi1.t_diag_act_ofs egcp[1].egcp_struct_pladgspi1.ctr_ofs_adj_cmpl egcp[1].egcp_struct_pladgspi1.err_diag_ctl_lsl_up egcp[1].egcp_struct_pladgspi1.cdn_diag_ctl_lsl_up egcp[1].egcp_struct_pladgspi1.lv_err_ofs_lsl_up egcp[1].egcp_struct_pladgspi1.lv_end_diag_ofs_lsl_up egcp[1].egcp_struct_pladgspi1.lv_lsl_ofs_adj_diag_ofs_old egcp[1].egcp_struct_pladgspi1.lv_err_ctl_lsl_up egcp[1].egcp_struct_pladgspi1.lv_end_diag_ctl_lsl_up /end OUT_MEASUREMENT
/end FUNCTION
/begin FUNCTION EGCP_WRAF_Controller_ofs_dg__AI "WRAF_Controller_ofs_dg__AI"
 /begin DEF_CHARACTERISTIC c_abc_inc_diag_ofs_lsl_up[0] c_abc_inc_diag_ofs_lsl_up[1] c_abc_inc_diag_ctl_lsl_up[0] c_abc_inc_diag_ctl_lsl_up[1] c_abc_max_diag_ofs_lsl_up[0] c_abc_max_diag_ofs_lsl_up[1] c_abc_max_diag_ctl_lsl_up[0] c_abc_max_diag_ctl_lsl_up[1] c_cdn_diag_ctl_lsl_di /end DEF_CHARACTERISTIC
 /begin OUT_MEASUREMENT egcp[0].egcp_struct_pladgspii1.cdn_diag_ctl_lsl_di egcp[0].egcp_struct_pladgspii1.cdn_diag_ctl_lsl_inh egcp[0].egcp_struct_pladgspii1.lv_inh_diag_ofs_lsl egcp[0].egcp_struct_pladgspii1.lv_inh_diag_ctl_lsl_up egcp[1].egcp_struct_pladgspii1.cdn_diag_ctl_lsl_di egcp[1].egcp_struct_pladgspii1.cdn_diag_ctl_lsl_inh egcp[1].egcp_struct_pladgspii1.lv_inh_diag_ofs_lsl egcp[1].egcp_struct_pladgspii1.lv_inh_diag_ctl_lsl_up /end OUT_MEASUREMENT
/end FUNCTION
/begin FUNCTION EGCP_O2_sensor_plaus_diag_AI "O2_sensor_plaus_diag_AI"
 /begin OUT_MEASUREMENT egcp[0].egcp_struct_pladglsi0.lv_diag_plaus_inh_lsl_up egcp[0].egcp_struct_pladglsi0.lv_inh_diag_rbm_plaus_lsl_up egcp[1].egcp_struct_pladglsi0.lv_diag_plaus_inh_lsl_up egcp[1].egcp_struct_pladglsi0.lv_inh_diag_rbm_plaus_lsl_up /end OUT_MEASUREMENT
/end FUNCTION
/begin FUNCTION EGCP_O2_sensor_dynamic_diag_AI "O2_sensor_dynamic_diag_AI" /begin DEF_CHARACTERISTIC c_cl_mmv_ls_up_diag_max /end DEF_CHARACTERISTIC
 /begin OUT_MEASUREMENT egcp[0].egcp_struct_pladglsli0.state_rbm_dyn_vld_ls_up egcp[0].egcp_struct_pladglsli0.lv_diag_dyn_inh_lsl_up egcp[0].egcp_struct_pladglsli0.lv_inh_diag_rbm_dyn_vld_ls_up egcp[0].egcp_struct_pladglsli0.lv_diag_eol_dyn_ls_up_dc egcp[0].egcp_struct_pladglsli0.lv_diag_eol_dyn_ls_up egcp[1].egcp_struct_pladglsli0.state_rbm_dyn_vld_ls_up egcp[1].egcp_struct_pladglsli0.lv_diag_dyn_inh_lsl_up egcp[1].egcp_struct_pladglsli0.lv_inh_diag_rbm_dyn_vld_ls_up egcp[1].egcp_struct_pladglsli0.lv_diag_eol_dyn_ls_up_dc egcp[1].egcp_struct_pladglsli0.lv_diag_eol_dyn_ls_up lv_inh_diag_ls_up_dyn_cp /end OUT_MEASUREMENT
/end FUNCTION
/begin FUNCTION EGCP_O2_sensor_not_mount_diag_AI "O2_sensor_not_mount_diag_AI"
 /begin OUT_MEASUREMENT egcp[0].egcp_struct_pladglsli5.state_rbm_air_lsl_up egcp[0].egcp_struct_pladglsli5.lv_inh_diag_air_lsl_up egcp[0].egcp_struct_pladglsli5.lv_inh_diag_rbm_air_lsl_up egcp[0].egcp_struct_pladglsli5.lv_diag_eol_air_lsl_up_dc egcp[0].egcp_struct_pladglsli5.lv_diag_eol_air_lsl_up egcp[1].egcp_struct_pladglsli5.state_rbm_air_lsl_up egcp[1].egcp_struct_pladglsli5.lv_inh_diag_air_lsl_up egcp[1].egcp_struct_pladglsli5.lv_inh_diag_rbm_air_lsl_up egcp[1].egcp_struct_pladglsli5.lv_diag_eol_air_lsl_up_dc egcp[1].egcp_struct_pladglsli5.lv_diag_eol_air_lsl_up /end OUT_MEASUREMENT
/end FUNCTION
/begin FUNCTION EGCP_O2_sensor_PUC_plaus_diag_AI "O2_sensor_PUC_plaus_diag_AI"
 /begin OUT_MEASUREMENT egcp[0].egcp_struct_pladglsli2.lv_inh_diag_puc_lsl_up egcp[0].egcp_struct_pladglsli2.lv_inh_diag_rbm_puc_lsl_up egcp[0].egcp_struct_pladglsli2.lv_diag_eol_puc_lsl_up egcp[1].egcp_struct_pladglsli2.lv_inh_diag_puc_lsl_up egcp[1].egcp_struct_pladglsli2.lv_inh_diag_rbm_puc_lsl_up egcp[1].egcp_struct_pladglsli2.lv_diag_eol_puc_lsl_up /end OUT_MEASUREMENT
/end FUNCTION
/begin FUNCTION EGCP_O2_sensor_activity_diag_AI "O2_sensor_activity_diag_AI"
 /begin OUT_MEASUREMENT egcp[0].egcp_struct_pladglsli3.lv_diag_act_inh_lsl_up egcp[1].egcp_struct_pladglsli3.lv_diag_act_inh_lsl_up /end OUT_MEASUREMENT
/end FUNCTION
/begin FUNCTION EGCP_O2_down_diag_NOx_rgn "O2_down_diag_NOx_rgn"
 /begin DEF_CHARACTERISTIC c_tco_min_diag_rgn_nt_ls_down c_maf_min_diag_rgn_nt_ls_down c_maf_max_diag_rgn_nt_ls_down c_temp_min_diag_rgn_nt_ls_down lc_state_rgn_l_ampl_deac c_vls_min_diag_rgn_ls_down c_maf_int_rgn_nt_s_act c_maf_int_rgn_nt_end c_t_rgn_nt_end c_ctr_sym_max_rgn_nt_ls_down c_ctr_inc_diag_rgn_nt_ls_down c_ctr_end_diag_rgn_nt_ls_down c_vls_down_rgn_nt_dif_thd /end DEF_CHARACTERISTIC
 /begin OUT_MEASUREMENT egcp[0].egcp_struct_sigdglsd3.vls_down_rgn_nt_end egcp[0].egcp_struct_sigdglsd3.maf_int_rgn_nt_s_act egcp[0].egcp_struct_sigdglsd3.maf_int_rgn_nt_end egcp[0].egcp_struct_sigdglsd3.t_rgn_nt_end egcp[0].egcp_struct_sigdglsd3.ctr_sym_diag_rgn_nt_ls_down egcp[0].egcp_struct_sigdglsd3.vls_down_rgn_nt_dif egcp[0].egcp_struct_sigdglsd3.ctr_end_diag_rgn_nt_ls_down egcp[0].egcp_struct_sigdglsd3.vls_down_rgn_nt_min_end egcp[0].egcp_struct_sigdglsd3.vls_down_rgn_nt_min_tmp egcp[0].egcp_struct_sigdglsd3.vls_down_rgn_nt_max_tmp egcp[0].egcp_struct_sigdglsd3.vls_down_rgn_nt_mes_sae egcp[0].egcp_struct_sigdglsd3.vls_down_rgn_nt_min_sae egcp[0].egcp_struct_sigdglsd3.lv_diag_act_rgn_nt_ls_down egcp[0].egcp_struct_sigdglsd3.lv_diag_rgn_nt_ls_down_err egcp[0].egcp_struct_sigdglsd3.lv_diag_rgn_nt_ls_down_end egcp[1].egcp_struct_sigdglsd3.vls_down_rgn_nt_end egcp[1].egcp_struct_sigdglsd3.maf_int_rgn_nt_s_act egcp[1].egcp_struct_sigdglsd3.maf_int_rgn_nt_end egcp[1].egcp_struct_sigdglsd3.t_rgn_nt_end egcp[1].egcp_struct_sigdglsd3.ctr_sym_diag_rgn_nt_ls_down egcp[1].egcp_struct_sigdglsd3.vls_down_rgn_nt_dif egcp[1].egcp_struct_sigdglsd3.ctr_end_diag_rgn_nt_ls_down egcp[1].egcp_struct_sigdglsd3.vls_down_rgn_nt_min_end egcp[1].egcp_struct_sigdglsd3.vls_down_rgn_nt_min_tmp egcp[1].egcp_struct_sigdglsd3.vls_down_rgn_nt_max_tmp egcp[1].egcp_struct_sigdglsd3.vls_down_rgn_nt_mes_sae egcp[1].egcp_struct_sigdglsd3.vls_down_rgn_nt_min_sae egcp[1].egcp_struct_sigdglsd3.lv_diag_act_rgn_nt_ls_down egcp[1].egcp_struct_sigdglsd3.lv_diag_rgn_nt_ls_down_err egcp[1].egcp_struct_sigdglsd3.lv_diag_rgn_nt_ls_down_end /end OUT_MEASUREMENT
/end FUNCTION
/begin FUNCTION EGCP_O2_down_diag_NOx_rgn_AI "O2_down_diag_NOx_rgn_AI"
 /begin DEF_CHARACTERISTIC lc_inh_diag_rgn_nt_ls_down[0] lc_inh_diag_rgn_nt_ls_down[1] /end DEF_CHARACTERISTIC
 /begin OUT_MEASUREMENT egcp[0].egcp_struct_sigdglsdi3.lv_inh_diag_rgn_nt_ls_down egcp[1].egcp_struct_sigdglsdi3.lv_inh_diag_rgn_nt_ls_down /end OUT_MEASUREMENT
/end FUNCTION
/begin FUNCTION EGCP_O2_sensor_char_line_diag "O2_sensor_char_line_diag" /begin DEF_CHARACTERISTIC c_t_dly_diag_shift_down[0] c_t_dly_diag_shift_down[1] /end DEF_CHARACTERISTIC
 /begin OUT_MEASUREMENT egcp[0].egcp_struct_pladglsl4.t_dly_diag_shift_down egcp[0].egcp_struct_pladglsl4.lv_t_dly_diag_shift_down egcp[1].egcp_struct_pladglsl4.t_dly_diag_shift_down egcp[1].egcp_struct_pladglsl4.lv_t_dly_diag_shift_down lv_err_shift_afl_lsl_up_1 lv_err_shift_afr_lsl_up_1 lv_err_shift_afl_lsl_up_2 lv_err_shift_afr_lsl_up_2 /end OUT_MEASUREMENT
/end FUNCTION
/begin FUNCTION EGCP_O2_sensor_char_line_diag_AI "O2_sensor_char_line_diag_AI"
 /begin OUT_MEASUREMENT egcp[0].egcp_struct_pladglsli4.state_rbm_shift_afl_lsl_up egcp[0].egcp_struct_pladglsli4.state_rbm_shift_afr_lsl_up egcp[1].egcp_struct_pladglsli4.state_rbm_shift_afl_lsl_up egcp[1].egcp_struct_pladglsli4.state_rbm_shift_afr_lsl_up /end OUT_MEASUREMENT
/end FUNCTION
/begin FUNCTION EGCP_O2_sensor_diag_NOx_rgn "O2_sensor_diag_NOx_rgn"
 /begin DEF_CHARACTERISTIC c_conc_o2_clc_hom_max_dyn_s c_conc_o2_dif_max_diag_dyn_s c_conc_o2_dif_st_max_diag_dyn_s c_ctr_diag_dyn_s_lsl_up c_fac_conc_o2_cor_diag_dyn_s c_fac_diag_dyn_s_lsl_up_max c_maf_int_end_diag_dyn_s c_maf_int_st_diag_dyn_s c_n_max_stop_diag_dyn_s c_n_min_stop_diag_dyn_s lc_diag_dyn_s_lsl_up_mod c_tqi_max_diag_dyn_s c_tqi_min_diag_dyn_s ip_fac_cor_conc_o2_dif_dyn_s c_conc_o2_mes_dec_max_dyn_s ldp_tqi_sp_s_ip_conc_o2_dyn_s /end DEF_CHARACTERISTIC
 /begin OUT_MEASUREMENT egcp[0].egcp_struct_pladglsl6.fac_sum_diag_dyn_s_lsl_up egcp[0].egcp_struct_pladglsl6.fac_mv_diag_dyn_s_lsl_up egcp[0].egcp_struct_pladglsl6.fac_mv_diag_dyn_s_lsl_up_sae egcp[0].egcp_struct_pladglsl6.fac_value_diag_dyn_s_lsl_up egcp[0].egcp_struct_pladglsl6.conc_o2_mes_diag_dyn_s egcp[0].egcp_struct_pladglsl6.conc_o2_mes_max_diag_dyn_s egcp[0].egcp_struct_pladglsl6.conc_o2_clc_diag_dyn_s egcp[0].egcp_struct_pladglsl6.conc_o2_clc_int_diag_dyn_s egcp[0].egcp_struct_pladglsl6.conc_o2_dif_int_diag_dyn_s egcp[0].egcp_struct_pladglsl6.conc_o2_mes_diag_dyn_s_st egcp[0].egcp_struct_pladglsl6.conc_o2_clc_diag_dyn_s_st egcp[0].egcp_struct_pladglsl6.ctr_diag_dyn_s_lsl_up egcp[0].egcp_struct_pladglsl6.maf_int_diag_dyn_s_act egcp[0].egcp_struct_pladglsl6.state_sym_diag_dyn_s_lsl_up egcp[0].egcp_struct_pladglsl6.lv_diag_dyn_s_lsl_up_end egcp[0].egcp_struct_pladglsl6.lv_diag_dyn_s_lsl_up_err egcp[0].egcp_struct_pladglsl6.lv_diag_dyn_s_lsl_up_sample egcp[0].egcp_struct_pladglsl6.lv_diag_dyn_s_lsl_up_stop egcp[1].egcp_struct_pladglsl6.fac_sum_diag_dyn_s_lsl_up egcp[1].egcp_struct_pladglsl6.fac_mv_diag_dyn_s_lsl_up egcp[1].egcp_struct_pladglsl6.fac_mv_diag_dyn_s_lsl_up_sae egcp[1].egcp_struct_pladglsl6.fac_value_diag_dyn_s_lsl_up egcp[1].egcp_struct_pladglsl6.conc_o2_mes_diag_dyn_s egcp[1].egcp_struct_pladglsl6.conc_o2_mes_max_diag_dyn_s egcp[1].egcp_struct_pladglsl6.conc_o2_clc_diag_dyn_s egcp[1].egcp_struct_pladglsl6.conc_o2_clc_int_diag_dyn_s egcp[1].egcp_struct_pladglsl6.conc_o2_dif_int_diag_dyn_s egcp[1].egcp_struct_pladglsl6.conc_o2_mes_diag_dyn_s_st egcp[1].egcp_struct_pladglsl6.conc_o2_clc_diag_dyn_s_st egcp[1].egcp_struct_pladglsl6.ctr_diag_dyn_s_lsl_up egcp[1].egcp_struct_pladglsl6.maf_int_diag_dyn_s_act egcp[1].egcp_struct_pladglsl6.state_sym_diag_dyn_s_lsl_up egcp[1].egcp_struct_pladglsl6.lv_diag_dyn_s_lsl_up_end egcp[1].egcp_struct_pladglsl6.lv_diag_dyn_s_lsl_up_err egcp[1].egcp_struct_pladglsl6.lv_diag_dyn_s_lsl_up_sample egcp[1].egcp_struct_pladglsl6.lv_diag_dyn_s_lsl_up_stop /end OUT_MEASUREMENT
/end FUNCTION
/begin FUNCTION EGCP_O2_sensor_diag_NOx_rgn_AI "O2_sensor_diag_NOx_rgn_AI" /begin DEF_CHARACTERISTIC lc_inh_dyn_diag_s_lsl_up[0] lc_inh_dyn_diag_s_lsl_up[1] /end DEF_CHARACTERISTIC
 /begin OUT_MEASUREMENT egcp[0].egcp_struct_pladglsli6.lv_inh_dyn_diag_s_lsl_up egcp[1].egcp_struct_pladglsli6.lv_inh_dyn_diag_s_lsl_up /end OUT_MEASUREMENT
/end FUNCTION
/begin FUNCTION EGCP_O2_sensor_down_osci_diag ""
 /begin OUT_MEASUREMENT egcp[0].egcp_struct_sigdglsd4.lamb_sp_osc_chk egcp[0].egcp_struct_sigdglsd4.lv_err_osc_chk egcp[0].egcp_struct_sigdglsd4.lv_end_diag_osc_chk egcp[1].egcp_struct_sigdglsd4.lamb_sp_osc_chk egcp[1].egcp_struct_sigdglsd4.lv_err_osc_chk egcp[1].egcp_struct_sigdglsd4.lv_end_diag_osc_chk /end OUT_MEASUREMENT
/end FUNCTION
/begin FUNCTION C_7_LACO "C_7_LACO"
 /begin DEF_CHARACTERISTIC ldpm_n_32_4_laco ldpm_n_32_2_laco ldpm_maf_cyl_1_laco ldpm_eff_cat_diag_1_laco ldpm_n_1_laco ldpm_t1_lsl_up_1_laco ldpm_t1_lsl_up_2_laco ldpm_tco_1_laco ldpm_tco_st_1_laco ldpm_t_dly_soi_lsl_pos_1_laco ldpm_t_dly_soi_lsl_pos_2_laco ldpm_vls_dif_lam_adj_1_laco ldpm_vls_dif_lam_adj_2_laco ldpm_maf_1_laco ldpm_tco_2_laco ldpm_tco_3_laco ldpm_n_32_5_laco ldpm_fac_lam_mv_1_laco ldpm_fac_lam_ad_1_laco /end DEF_CHARACTERISTIC
 /begin SUB_FUNCTION LACO_Lambda_adaptation LACO_MV_CLC_limited_dynamics LACO_Lambda_CTL_WRAF_SENS LACO_Trim_CTL_lin_lambda_CTL LACO_Linear_lambda_CTL__AI LACO_Trim_CTL_lin_lambda_CTL__AI LACO_Lambda_adaptation__AI LACO_Lambda_control_conditions LACO_Vld_cdn_chk_WRAF_char_ad LACO_WRAF_sens_char_ad_trim_ctl LACO_Lambda_adaptation_WUP /end SUB_FUNCTION
/end FUNCTION
/end MODULE
/end PROJECT
