ASAP2_VERSION 1 3
/begin PROJECT P390 "BMW DDE6.2 6-Zylinder VP0.1 11.11.2003 CAN12H"
/begin HEADER "" VERSION "VP01_6Z_CAN12H" PROJECT_NO P390 /end HEADER
/begin MODULE DIM ""
/begin MOD_COMMON "" BYTE_ORDER MSB_FIRST ALIGNMENT_BYTE 1 ALIGNMENT_WORD 2 ALIGNMENT_LONG 4 ALIGNMENT_FLOAT32_IEEE 4 /end MOD_COMMON
/begin CHARACTERISTIC ErLpCD_tiDefMil_C "Zeit für MIL Defekterkennung (Endstufenüberwachung)" VALUE 0xCFDD8 Kw_Wu16 655350.0 Time_ms 0.00 655350.0 FORMAT "%8.1" /end CHARACTERISTIC
/begin CHARACTERISTIC ErLpCD_tiOkMil_C "Zeit für MIL in Ordnung Erkennung (Endstufenüberwachung)" VALUE 0xCFDDA Kw_Wu16 655350.0 Time_ms 0.00 655350.0 FORMAT "%8.1" /end CHARACTERISTIC
/begin CHARACTERISTIC ErLpCD_nThresMil_C "Drehzahlgrenze für MIL-Test" VALUE 0xCFDDC Kw_Ws16 65535.00 EngN -32768.00 32767.00 FORMAT "%8.2" /end CHARACTERISTIC
/begin CHARACTERISTIC ErLpCD_tiMaxMil_C "Zeitgrenze für MIL-Test" VALUE 0xCFDDE Kw_Wu16 655350.0 Time_ms 0.00 655350.0 FORMAT "%8.1" /end CHARACTERISTIC
/begin CHARACTERISTIC ErLpCD_tiMilTst_C "zusätzliche MIL Test Zeit nach Überschreiten Drehzahlschwelle" VALUE 0xCFDE0 Kw_Wu16 655350.0 Time_ms 0.00 655350.0 FORMAT "%8.1" /end CHARACTERISTIC
/begin CHARACTERISTIC ErLpCD_tiDelMil_C "Verzögerung der MIL Anzeige nach Lampentest" VALUE 0xCFDE2 Kw_Wu16 655350.0 Time_ms 0.00 655350.0 FORMAT "%8.1" /end CHARACTERISTIC
/begin CHARACTERISTIC ErLpCD_tiBlkMil_C "halbe Zeit der MIL Blink Periodedauer" VALUE 0xCFDE4 Kw_Wu16 655350.0 Time_ms 0.00 655350.0 FORMAT "%8.1" /end CHARACTERISTIC
/begin CHARACTERISTIC ErLpCD_swtMilEna_C "MIL Freigabe Schalter (0 = abgeschaltet; 1 = eingeschaltet)" VALUE 0xCFDE6 Kw_Wu8 1.000 OneToOne 0.00 1.000 FORMAT "%5.3" EXTENDED_LIMITS 0.00 255.0 /end CHARACTERISTIC
/begin CHARACTERISTIC ErLpCD_numDiaErrLmp_C "#SSD application parameter for error lamp diagnostic signal" VALUE 0xCFDE8 Kw_Wu8 34.0000000000 NumPinDia 0.00 34.0000000000 FORMAT "%13.10" /end CHARACTERISTIC
/begin CHARACTERISTIC ErLpCD_numDiaSysLmp_C "#SSD application parameter for system lamp diagnostic signal" VALUE 0xCFDE9 Kw_Wu8 34.0000000000 NumPinDia 0.00 34.0000000000 FORMAT "%13.10" /end CHARACTERISTIC
/begin CHARACTERISTIC ErLpCD_numDioOutErrLmp_C "#SSD application parameter for error lamp" VALUE 0xCFDEA Kw_Wu8 10.0000000000 NumPinDioOut 0.00 10.0000000000 FORMAT "%13.10" /end CHARACTERISTIC
/begin CHARACTERISTIC ErLpCD_numDioOutSysLmp_C "#SSD application parameter for system lamp" VALUE 0xCFDEB Kw_Wu8 10.0000000000 NumPinDioOut 0.00 10.0000000000 FORMAT "%13.10" /end CHARACTERISTIC
/begin CHARACTERISTIC ErLpCD_stPwrStgActvLmp_C "Spezifikation des Abschaltverhaltens der Lamp-Endstufe" VALUE 0xCFDEC Kw_Wu8 255.0 OneToOne 0.00 255.0 FORMAT "%5.1" /end CHARACTERISTIC
/begin CHARACTERISTIC ErLpCD_stPwrStgActvMil_C "Spezifikation des Abschaltverhaltens der MIL-Endstufe" VALUE 0xCFDED Kw_Wu8 255.0 OneToOne 0.00 255.0 FORMAT "%5.1" /end CHARACTERISTIC
/begin CHARACTERISTIC ErLpCD_stPwrStgDiaLmp_C "Spezifikation des Diagnoseabschaltverhaltens der Lamp-Endstufe" VALUE 0xCFDEE Kw_Wu8 255.0 OneToOne 0.00 255.0 FORMAT "%5.1" /end CHARACTERISTIC
/begin CHARACTERISTIC ErLpCD_stPwrStgDiaMil_C "Spezifikation des Diagnoseabschaltverhaltens der MIL-Endstufe" VALUE 0xCFDEF Kw_Wu8 255.0 OneToOne 0.00 255.0 FORMAT "%5.1" /end CHARACTERISTIC
/begin CHARACTERISTIC ErLpCD_swtSysEqGlwLmp_C "SysLamp entspricht Glühlampe (Signalumleitung) (0 = abgeschaltet; 1 = eingeschaltet)" VALUE 0xCFDF0 Kw_Wu8 1.000 OneToOne 0.00 1.000 FORMAT "%5.3" EXTENDED_LIMITS 0.00 255.0 /end CHARACTERISTIC
/begin CHARACTERISTIC ErLpCD_tiDefSysLmp_C "Zeit für SysLamp Defekterkennung (Endstufenüberwachung)" VALUE 0xCFDF2 Kw_Wu16 655350.0 Time_ms 0.00 655350.0 FORMAT "%8.1" /end CHARACTERISTIC
/begin CHARACTERISTIC ErLpCD_tiOkSysLmp_C "Zeit für SysLamp in Ordnung Erkennung (Endstufenüberwachung)" VALUE 0xCFDF4 Kw_Wu16 655350.0 Time_ms 0.00 655350.0 FORMAT "%8.1" /end CHARACTERISTIC
/begin CHARACTERISTIC ErLpCD_nThresSysLmp_C "Drehzahlgrenze für SysLamp-Test" VALUE 0xCFDF6 Kw_Ws16 65535.00 EngN -32768.00 32767.00 FORMAT "%8.2" /end CHARACTERISTIC
/begin CHARACTERISTIC ErLpCD_tiMaxSysLmp_C "Zeitgrenze für SysLamp-Test" VALUE 0xCFDF8 Kw_Wu16 655350.0 Time_ms 0.00 655350.0 FORMAT "%8.1" /end CHARACTERISTIC
/begin CHARACTERISTIC ErLpCD_tiTstSysLmp_C "zusätzliche SysLamp Test Zeit nach Überschreiten Drehzahlschwelle" VALUE 0xCFDFA Kw_Wu16 655350.0 Time_ms 0.00 655350.0 FORMAT "%8.1" /end CHARACTERISTIC
/begin CHARACTERISTIC ErLpCD_tiDelSysLmp_C "Verzögerung der SysLamp Anzeige nach Lampentest" VALUE 0xCFDFC Kw_Wu16 655350.0 Time_ms 0.00 655350.0 FORMAT "%8.1" /end CHARACTERISTIC
/begin CHARACTERISTIC ErLpCD_tiBlkSysLmp_C "halbe Zeit der SysLamp Blink Periodedauer" VALUE 0xCFDFE Kw_Wu16 655350.0 Time_ms 0.00 655350.0 FORMAT "%8.1" /end CHARACTERISTIC
/begin CHARACTERISTIC ErLpCD_swtSysLmpEna_C "SysLamp Freigabe Schalter (0 = abgeschaltet; 1 = eingeschaltet)" VALUE 0xCFE00 Kw_Wu8 1.000 OneToOne 0.00 1.000 FORMAT "%5.3" EXTENDED_LIMITS 0.00 255.0 /end CHARACTERISTIC
/begin CHARACTERISTIC ESS_nBattMin_C "#SSD Wert der geforderten Drehzahl nach Freigabe" VALUE 0xCFE0A Kw_Ws16 38768.00 EngN -32768.00 6000.000 FORMAT "%8.2" EXTENDED_LIMITS -32768.00 32767.00 /end CHARACTERISTIC
/begin CHARACTERISTIC ESS_nLIBattThres_C "Schwelle Drehzahl zur Aktivierung der Drehzahlforderung" VALUE 0xCFE02 Kw_Ws16 38768.00 EngN -32768.00 6000.000 FORMAT "%8.2" EXTENDED_LIMITS -32768.00 32767.00 /end CHARACTERISTIC
/begin CHARACTERISTIC ESS_nMinThres_C "Drehzahlschwelle zur Verhinderung eines Momentensprungs" VALUE 0xCFE04 Kw_Ws16 38768.00 EngN -32768.00 6000.000 FORMAT "%8.2" EXTENDED_LIMITS -32768.00 32767.00 /end CHARACTERISTIC
/begin CHARACTERISTIC ESS_tiDelayUBattFFRes_C "Zeit bis Rücknahme der Drehzahlforderung nach Deaktivierung" VALUE 0xCFE0C Kw_Ws16 655.3500 Time_s -327.6800 327.6700 FORMAT "%8.4" /end CHARACTERISTIC
/begin CHARACTERISTIC ESS_tiDelayUBattFFSet_C "Zeit bis Freigabe der Drehzahlforderung nach Aktivierung" VALUE 0xCFE06 Kw_Ws16 655.3500 Time_s -327.6800 327.6700 FORMAT "%8.4" /end CHARACTERISTIC
/begin CHARACTERISTIC ESS_uLIBattThresFFRes_C "Schwelle Batteriespannung zur Deaktivierung der Drehzahlforderung" VALUE 0xCFE0E Kw_Ws16 1281232. Volt_Batt -640625.6 640606.1 FORMAT "%8.1" /end CHARACTERISTIC
/begin CHARACTERISTIC ESS_uLIBattThresFFSet_C "Schwelle Batteriespannung zur Aktivierung der Drehzahlforderung" VALUE 0xCFE08 Kw_Ws16 1281232. Volt_Batt -640625.6 640606.1 FORMAT "%8.1" /end CHARACTERISTIC
/begin CHARACTERISTIC ETClb_ctDflLrn_CA "Defaultwerte für die applikative Änderung der Lernzykluszähler der Ansteuerdauerkalibrierung für die ZFC" VAL_BLK 0xCFE74 Kwb_Wu16 65535.00 OneToOne 0.00 65535.00 FORMAT "%8.2" NUMBER 3 /end CHARACTERISTIC
/begin CHARACTERISTIC ETClb_ctLrnThres2_C "" VALUE 0xCFE10 Kw_Wu16 65535.00 OneToOne 0.00 65535.00 FORMAT "%8.2" /end CHARACTERISTIC
/begin CHARACTERISTIC ETClb_ctLrnThresQck_C "Anzahl der Lernzyklen für die Freigabe der Ansteuerdauerkorrektur durch die Ansteurdauerkalibrierung bei Schnellkalibrierung" VALUE 0xCFE12 Kw_Wu16 65535.00 OneToOne 0.00 65535.00 FORMAT "%8.2" /end CHARACTERISTIC
/begin CHARACTERISTIC ETClb_ctLrnThres_C "Anzahl der Lernzyklen für die Freigabe der Ansteuerdauerkorrektur durch die Ansteurdauerkalibrierung" VALUE 0xCFE14 Kw_Wu16 65535.00 OneToOne 0.00 65535.00 FORMAT "%8.2" /end CHARACTERISTIC
/begin CHARACTERISTIC ETClb_DebETFltMaxDefect_C "Entprellzeit der Defekterkennung der Überschreitung der maximalen gefilterten Ansteuerdauer von der Ansteuerdauerkalibrierung" VALUE 0xCFE16 Kw_Wu16 0.00 OneToOne 1.000000 1.000000 FORMAT "%8.6" EXTENDED_LIMITS 0.00 65535.00 /end CHARACTERISTIC
/begin CHARACTERISTIC ETClb_DebETFltMaxOk_C "Entprellzeit der Intakterkennung der Überschreitung der maximalen gefilterten Ansteuerdauer von der Ansteuerdauerkalibrierung" VALUE 0xCFE18 Kw_Wu16 0.00 OneToOne 0.00 0.00 FORMAT "%8.2" EXTENDED_LIMITS 0.00 65535.00 /end CHARACTERISTIC
/begin CHARACTERISTIC ETClb_DebETFltMinDefect_C "Entprellzeit der Defekterkennung der Unterschreitung der minimalen gefilterten Ansteuerdauer von der Ansteuerdauerkalibrierung" VALUE 0xCFE1A Kw_Wu16 0.00 OneToOne 1.000000 1.000000 FORMAT "%8.6" EXTENDED_LIMITS 0.00 65535.00 /end CHARACTERISTIC
/begin CHARACTERISTIC ETClb_DebETFltMinOk_C "Entprellzeit der Intakterkennung der Unterschreitung der minimalen gefilterten Ansteuerdauer von der Ansteuerdauerkalibrierung" VALUE 0xCFE1C Kw_Wu16 0.00 OneToOne 0.00 0.00 FORMAT "%8.2" EXTENDED_LIMITS 0.00 65535.00 /end CHARACTERISTIC
/begin CHARACTERISTIC ETClb_DebETMaxDefect_C "#SSD Entprellzeit der Defekterkennung der Überschreitung der maximalen Ansteuerdauer von der Ansteuerdauerkalibrierung" VALUE 0xCFE58 Kw_Wu16 65535.00 OneToOne 0.00 65535.00 FORMAT "%8.2" /end CHARACTERISTIC
/begin CHARACTERISTIC ETClb_DebETMaxOk_C "#SSD Entprellzeit der Intakterkennung der Überschreitung der maximalen Ansteuerdauer von der Ansteuerdauerkalibrierung" VALUE 0xCFE5A Kw_Wu16 65535.00 OneToOne 0.00 65535.00 FORMAT "%8.2" /end CHARACTERISTIC
/begin CHARACTERISTIC ETClb_DebETMinDefect_C "#SSD Entprellzeit der Defekterkennung der Unterschreitung der minimalen Ansteuerdauer von der Ansteuerdauerkalibrierung" VALUE 0xCFE5C Kw_Wu16 65535.00 OneToOne 0.00 65535.00 FORMAT "%8.2" /end CHARACTERISTIC
/begin CHARACTERISTIC ETClb_DebETMinOk_C "#SSD Entprellzeit der Intakterkennung der Unterschreitung der minimalen Ansteuerdauer von der Ansteuerdauerkalibrierung" VALUE 0xCFE5E Kw_Wu16 65535.00 OneToOne 0.00 65535.00 FORMAT "%8.2" /end CHARACTERISTIC
/begin CHARACTERISTIC ETClb_dpRailLim_CA "Raildruck-Kalibrierpunkt abhängige max. Abweichung des Raildrucks für die Nullmengenkalibrierung" VAL_BLK 0xCFE1E Kwb_Ws16 2000.000 Pres_Rail 0.00 2000.000 FORMAT "%5.3" EXTENDED_LIMITS -3276.800 3276.700 NUMBER 3 /end CHARACTERISTIC
/begin CHARACTERISTIC ETClb_dtiDflETFlt0_CA "Defaultwerte für die gefilterte Ansteuerdauerdifferenz der Ansteuerdauerkalibrierung für den Raildruck-Kalibrierpunkt 0" VAL_BLK 0xCFE7A Kwb_Ws16 5000.000 InjTime_us 0.00 5000.000 FORMAT "%8.3" EXTENDED_LIMITS -32768.00 32767.00 NUMBER 6 /end CHARACTERISTIC
/begin CHARACTERISTIC ETClb_dtiDflETFlt1_CA "Defaultwerte für die gefilterte Ansteuerdauerdifferenz der Ansteuerdauerkalibrierung für den Raildruck-Kalibrierpunkt 1" VAL_BLK 0xCFE86 Kwb_Ws16 5000.000 InjTime_us 0.00 5000.000 FORMAT "%8.3" EXTENDED_LIMITS -32768.00 32767.00 NUMBER 6 /end CHARACTERISTIC
/begin CHARACTERISTIC ETClb_dtiDflETFlt2_CA "Defaultwerte für die gefilterte Ansteuerdauerdifferenz der Ansteuerdauerkalibrierung für den Raildruck-Kalibrierpunkt 2" VAL_BLK 0xCFE92 Kwb_Ws16 5000.000 InjTime_us 0.00 5000.000 FORMAT "%8.3" EXTENDED_LIMITS -32768.00 32767.00 NUMBER 6 /end CHARACTERISTIC
/begin CHARACTERISTIC ETClb_facFlt2_C "" VALUE 0xCFE24 Kw_Wu16 1.000000 Fact 0.00 1.000000 FORMAT "%8.6" EXTENDED_LIMITS 0.00 7.999878 /end CHARACTERISTIC
/begin CHARACTERISTIC ETClb_facFltQck_C "Filterkonstante für die Ansteuerdauerdifferenz der Ansteuerdauerkalibrierung bei Schnellkalibrierung" VALUE 0xCFE26 Kw_Wu16 1.000000 Fact 0.00 1.000000 FORMAT "%8.6" EXTENDED_LIMITS 0.00 7.999878 /end CHARACTERISTIC
/begin CHARACTERISTIC ETClb_facFlt_C "Filterkonstante für die Ansteuerdauerdifferenz der Ansteuerdauerkalibrierung" VALUE 0xCFE28 Kw_Wu16 1.000000 Fact 0.00 1.000000 FORMAT "%8.6" EXTENDED_LIMITS 0.00 7.999878 /end CHARACTERISTIC
/begin CHARACTERISTIC ETClb_numCyclMeas_C "#SSD Anzahl der Einspritzzyklen für die Messung der Ansteuerdauerkalibrierung" VALUE 0xCFE2A Kw_Wu16 65535.00 OneToOne 0.00 65535.00 FORMAT "%8.2" /end CHARACTERISTIC
/begin CHARACTERISTIC ETClb_numCyclNoDyn_C "Anzahl der Einspritzzyklen bis die Ansteuerdauekalibrierung den maximalen Drehzahlanstieg prüft" VALUE 0xCFE2C Kw_Wu16 65535.00 OneToOne 0.00 65535.00 FORMAT "%8.2" /end CHARACTERISTIC
/begin CHARACTERISTIC ETClb_numCyclStartEnergize_C "#SSD Anzahl der Einspritzzyklen bis die Ansteuerdauerkalibrierung für die Messung eingeschwungen ist" VALUE 0xCFE2E Kw_Wu16 65535.00 OneToOne 0.00 65535.00 FORMAT "%8.2" /end CHARACTERISTIC
/begin CHARACTERISTIC ETClb_numDflCylCur_CA "Testwerte für die aktuellen Zylinder der Ansteuerdauerkalibrierung für jeden Raildruck-Kalibrierpunkt" VAL_BLK 0xCFE9E Kwb_Wu8 5.000 OneToOne 1.000 6.000 FORMAT "%5.3" EXTENDED_LIMITS 0.00 255.0 NUMBER 3 /end CHARACTERISTIC
/begin CHARACTERISTIC ETClb_pRailSet_CA "#SSD Raildruck-Kalibrierpunkte für die Ansteuerdauerkalibrierung" VAL_BLK 0xCFE30 Kwb_Ws16 2000.000 Pres_Rail 0.00 2000.000 FORMAT "%5.3" EXTENDED_LIMITS -3276.800 3276.700 NUMBER 3 /end CHARACTERISTIC
/begin CHARACTERISTIC ETClb_SigThres_CA "#SSD Raildurck-Kalibrierpunkt abhänge Signalschwelle der Nullmengenkalibrierung" VAL_BLK 0xCFE36 Kwb_Ws16 200.0000 OneToOne 0.00 200.0000 FORMAT "%8.4" EXTENDED_LIMITS -32768.00 32767.00 NUMBER 3 /end CHARACTERISTIC
/begin CHARACTERISTIC ETClb_swtCorActvVal_C "Applikativer Wert des SW-Schalters für die Ansteuerdauerkorrektur" VALUE 0xCFE3C Kw_Wu8 1.000 OneToOne 0.00 1.000 FORMAT "%5.3" EXTENDED_LIMITS 0.00 255.0 /end CHARACTERISTIC
/begin CHARACTERISTIC ETClb_swtCorActvType_C "Typ des SW-Schalters für die Ansteuerdauerkorrektur der Nullmengenkalibrierung" VALUE 0xCFE3D Kw_Wu8 2.000 OneToOne 0.00 2.000 FORMAT "%5.3" EXTENDED_LIMITS 0.00 255.0 /end CHARACTERISTIC
/begin CHARACTERISTIC ETClb_swtDflQckClb_C "Testwert zum Umschalten auf Schnellkalibrierung der Ansteuerdauerkalibrierung" VALUE 0xCFEA1 Kw_Wu8 1.000 OneToOne 0.00 1.000 FORMAT "%5.3" EXTENDED_LIMITS 0.00 255.0 /end CHARACTERISTIC
/begin CHARACTERISTIC ETClb_swtWrDflVal_C "Aktivierung zum schreiben der Testwerte für die Ansteuerdauerkalibrierung bei Wechsel von 0 nach 1" VALUE 0xCFE3E Kw_Wu8 1.000 OneToOne 0.00 1.000 FORMAT "%5.3" EXTENDED_LIMITS 0.00 255.0 /end CHARACTERISTIC
/begin CHARACTERISTIC ETClb_tiDflETCur_CA "Testwert der aktuellen Ansteuerdauer für die Ansteuerdauerkalibrierung bei jedem Raildruck-Kalibrierpunkt" VAL_BLK 0xCFEA2 Kwb_Ws16 5000.000 InjTime_us 0.00 5000.000 FORMAT "%8.3" EXTENDED_LIMITS -32768.00 32767.00 NUMBER 3 /end CHARACTERISTIC
/begin CHARACTERISTIC ETClb_tiDflInjInit_C "Defaultwert für die applikative Änderung des Ininitialisierungswerts des Injektor-Betriebsstundenzählers" VALUE 0xCFEA8 Kw_Wu32 4294967295.00 OneToOne 0.00 4294967295.00 FORMAT "%13.2" /end CHARACTERISTIC
/begin CHARACTERISTIC ETClb_tiETOfs_CA "Offset der max. gefilterten Ansteuerdauer zur max. Ansteuerdauer für jeden Raildruck-Kalibrierpunkt" VAL_BLK 0xCFE40 Kwb_Ws16 5000.0000 InjTime_us 0.00 5000.0000 FORMAT "%8.4" EXTENDED_LIMITS -32768.00 32767.00 NUMBER 3 /end CHARACTERISTIC
/begin CHARACTERISTIC ETClb_tiETStep_CA "Schrittweite der Ansteuerdauer für die Anhebung oder Senkung der Ansteuerdauer von der Ansteuerdauer-Kalibrierung" VAL_BLK 0xCFE60 Kwb_Ws16 5000.000 InjTime_us 0.00 5000.000 FORMAT "%8.3" EXTENDED_LIMITS -32768.00 32767.00 NUMBER 3 /end CHARACTERISTIC
/begin CHARACTERISTIC ETClb_tiET_MAX_CA "#SSD Maximale Ansteuerdauer der Einspritzungen für die Ansteuerdauerkalibrierung für jeden Raildruck-Kalibirierpunkt" VAL_BLK 0xCFE66 Kwb_Ws16 32767.00 InjTime_us 0.00 32767.00 FORMAT "%8.2" EXTENDED_LIMITS -32768.00 32767.00 NUMBER 3 /end CHARACTERISTIC
/begin CHARACTERISTIC ETClb_tiET_MIN_CA "#SSD Minimale Ansteuerdauer der Einspritzungen für die Ansteuerdauerkalibrierung für jeden Raildruck-Kalibirierpunkt" VAL_BLK 0xCFE6C Kwb_Ws16 32767.00 InjTime_us 0.00 32767.00 FORMAT "%8.2" EXTENDED_LIMITS -32768.00 32767.00 NUMBER 3 /end CHARACTERISTIC
/begin CHARACTERISTIC ETClb_volEffectiveMin_CA "#SSD Menge der Wirkgrenze für die Ansteuerdauerkalibrierung" VAL_BLK 0xCFE46 Kwb_Ws16 100.0000 InjQntInj 0.00 100.0000 FORMAT "%8.4" EXTENDED_LIMITS -327.6800 327.6700 NUMBER 3 /end CHARACTERISTIC
/begin CHARACTERISTIC ETClb_vStartClb_CA "Minimale Fahrzeuggeschwindigkeit zum Starten der Ansteuerdauerkalibrierung bei jedem Raildruck-Kalibrierpunkt" VAL_BLK 0xCFE4C Kwb_Ws16 200.0000 Vel 0.00 200.0000 FORMAT "%8.4" EXTENDED_LIMITS -327.6800 327.6700 NUMBER 3 /end CHARACTERISTIC
/begin CHARACTERISTIC ETClb_vStopClb_CA "Minimale Fahrzeuggeschwindigkeit der Ansteuerdauerkalibrierung bei jedem Raildruck-Kalibrierpunkt" VAL_BLK 0xCFE52 Kwb_Ws16 200.0000 Vel 0.00 200.0000 FORMAT "%8.4" EXTENDED_LIMITS -327.6800 327.6700 NUMBER 3 /end CHARACTERISTIC
/begin CHARACTERISTIC FanCD_DebExcTempDef_C "Fehlerentprellzeit für Fehler Übertemperatur" VALUE 0xCFEAC Kw_Wu16 655350.0 Time_ms 0.00 655350.0 FORMAT "%8.1" /end CHARACTERISTIC
/begin CHARACTERISTIC FanCD_DebExcTempOk_C "Heilungsentprellzeit für Fehler Übertemperatur" VALUE 0xCFEAE Kw_Wu16 655350.0 Time_ms 0.00 655350.0 FORMAT "%8.1" /end CHARACTERISTIC
/begin CHARACTERISTIC FanCD_tiDebDia1Def_C "Fehlerentprellzeit für Lüfter Diagnose erstes Zeitfenster" VALUE 0xCFEB0 Kw_Wu16 655350.0 Time_ms 0.00 655350.0 FORMAT "%8.1" /end CHARACTERISTIC
/begin CHARACTERISTIC FanCD_tiDebDia1Ok_C "Fehlerheilzeit für Lüfter Diagnose erstes Zeitfenster" VALUE 0xCFEB2 Kw_Wu16 655350.0 Time_ms 0.00 655350.0 FORMAT "%8.1" /end CHARACTERISTIC
/begin CHARACTERISTIC FanCD_tiDebDia2Def_C "Fehlerentprellzeit für Lüfter Diagnose zweites Zeitfenster" VALUE 0xCFEB4 Kw_Wu16 655350.0 Time_ms 0.00 655350.0 FORMAT "%8.1" /end CHARACTERISTIC
/begin CHARACTERISTIC FanCD_tiDebDia2Ok_C "Fehlerheilzeit für Lüfter Diagnose zweites Zeitfenster" VALUE 0xCFEB6 Kw_Wu16 655350.0 Time_ms 0.00 655350.0 FORMAT "%8.1" /end CHARACTERISTIC
/begin CHARACTERISTIC FanCD_tiDebDia3Def_C "Fehlerentprellzeit für Lüfter Diagnose drittes Zeitfenster" VALUE 0xCFEB8 Kw_Wu16 655350.0 Time_ms 0.00 655350.0 FORMAT "%8.1" /end CHARACTERISTIC
/begin CHARACTERISTIC FanCD_tiDebDia3Ok_C "Fehlerheilzeit für Lüfter Diagnose drittes Zeitfenster" VALUE 0xCFEBA Kw_Wu16 655350.0 Time_ms 0.00 655350.0 FORMAT "%8.1" /end CHARACTERISTIC
/begin CHARACTERISTIC FanCD_DebNoLoadDef_C "Defektentprellung für den Lastabfall des Lüfters" VALUE 0xCFEBC Kw_Wu16 655350.0 Time_ms 0.00 655350.0 FORMAT "%8.1" /end CHARACTERISTIC
/begin CHARACTERISTIC FanCD_DebNoLoadOk_C "Heilungsentprellung für den Lastabfall des Lüfters" VALUE 0xCFEBE Kw_Wu16 655350.0 Time_ms 0.00 655350.0 FORMAT "%8.1" /end CHARACTERISTIC
/begin CHARACTERISTIC FanCD_DebShortCircBatDef_C "Entprelldauer für Fehler Kurzschluss zur Batterie" VALUE 0xCFEC0 Kw_Wu16 655350.0 Time_ms 0.00 655350.0 FORMAT "%8.1" /end CHARACTERISTIC
/begin CHARACTERISTIC FanCD_DebShortCircBatOk_C "Heilungsdauer für Fehler Kurzschluss zur Batterie" VALUE 0xCFEC2 Kw_Wu16 655350.0 Time_ms 0.00 655350.0 FORMAT "%8.1" /end CHARACTERISTIC
/begin CHARACTERISTIC FanCD_DebShortCircGndDef_C "#SSD Entprelldauer für Fehler Kurzschluss zur Masse" VALUE 0xCFEC4 Kw_Wu16 655350.0 Time_ms 0.00 655350.0 FORMAT "%8.1" /end CHARACTERISTIC
/begin CHARACTERISTIC FanCD_DebShortCircGndOk_C "Heilungsdauer für Fehler Kurzschluss zur Masse" VALUE 0xCFEC6 Kw_Wu16 655350.0 Time_ms 0.00 655350.0 FORMAT "%8.1" /end CHARACTERISTIC
/begin CHARACTERISTIC FanCD_numDia_C "#SSD Applikationsparameter fuer Luefter Komponententreiber" VALUE 0xCFEC8 Kw_Wu8 34.0000000000 NumPinDia 0.00 34.0000000000 FORMAT "%13.10" /end CHARACTERISTIC
/begin CHARACTERISTIC FanCD_numPwmOut_C "#SSD Applikationsparameter fuer Luefter" VALUE 0xCFEC9 Kw_Wu8 12.0000000000 NumPinPwmOut 0.00 12.0000000000 FORMAT "%13.10" /end CHARACTERISTIC
/begin CHARACTERISTIC FanCD_rTst_C "Tastverhältnis, das im Fehlerfall zyklisch ausgegeben wird" VALUE 0xCFECA Kw_Ws16 100.0000 DtyCyc 0.00 100.0000 FORMAT "%8.4" EXTENDED_LIMITS -327.6800 327.6700 /end CHARACTERISTIC
/begin CHARACTERISTIC FanCD_stInvOut_C "Invertierungsparameter der PWM-Endstufe" VALUE 0xCFECC Kw_Wu8 1.000 OneToOne 0.00 1.000 FORMAT "%5.3" EXTENDED_LIMITS 0.00 255.0 /end CHARACTERISTIC
/begin CHARACTERISTIC FanCD_tiBtwTst_C "#SSD Zeitabstand, in dem im Fehlerfall die Endstufe getestet wird" VALUE 0xCFECE Kw_Wu16 29980.00 Time_ms 20.00000 30000.00 FORMAT "%8.2" EXTENDED_LIMITS 0.00 655350.0 /end CHARACTERISTIC
/begin CHARACTERISTIC FanCD_tiFanCtlr1Max_C "Maximum des ersten Signalfensters für Fehlersignale des Lüfter-SG" VALUE 0xCFED0 Kw_Wu16 655350.0 Time_ms 0.00 655350.0 FORMAT "%8.1" /end CHARACTERISTIC
/begin CHARACTERISTIC FanCD_tiFanCtlr1Min_C "Minimum des ersten Signalfensters für Fehlersignale des Lüfter-SG" VALUE 0xCFED2 Kw_Wu16 655350.0 Time_ms 0.00 655350.0 FORMAT "%8.1" /end CHARACTERISTIC
/begin CHARACTERISTIC FanCD_tiFanCtlr2Max_C "#SSD Maximum des zweiten Signalfensters für Fehlersignale des Lüfter-SG" VALUE 0xCFED4 Kw_Wu16 655350.0 Time_ms 0.00 655350.0 FORMAT "%8.1" /end CHARACTERISTIC
/begin CHARACTERISTIC FanCD_tiFanCtlr2Min_C "#SSD Minimum des zweiten Signalfensters für Fehlersignale des Lüfter-SG" VALUE 0xCFED6 Kw_Wu16 655350.0 Time_ms 0.00 655350.0 FORMAT "%8.1" /end CHARACTERISTIC
/begin CHARACTERISTIC FanCD_tiFanCtlr3Max_C "#SSD Maximum des dritten Signalfensters für Fehlersignale des Lüfter-SG" VALUE 0xCFED8 Kw_Wu16 655350.0 Time_ms 0.00 655350.0 FORMAT "%8.1" /end CHARACTERISTIC
/begin CHARACTERISTIC FanCD_tiFanCtlr3Min_C "#SSD Minimum des dritten Signalfensters für Fehlersignale des Lüfter-SG" VALUE 0xCFEDA Kw_Wu16 655350.0 Time_ms 0.00 655350.0 FORMAT "%8.1" /end CHARACTERISTIC
/begin CHARACTERISTIC FanCtl_dcycAftRun_C "TV für 10Hz Nachlauf" VALUE 0xCFEDC Kw_Ws16 100.0000 DtyCyc 0.00 100.0000 FORMAT "%8.4" EXTENDED_LIMITS -327.6800 327.6700 /end CHARACTERISTIC
/begin CHARACTERISTIC FanCtl_dcycHysDelta_C "Hystereseschwelle" VALUE 0xCFEDE Kw_Ws16 100.0000 DtyCyc 0.00 100.0000 FORMAT "%8.4" EXTENDED_LIMITS -327.6800 327.6700 /end CHARACTERISTIC
/begin CHARACTERISTIC FanCtl_dcycMax_C "High-PWM-Signal der Hysterese" VALUE 0xCFEE0 Kw_Ws16 100.0000 DtyCyc 0.00 100.0000 FORMAT "%8.4" EXTENDED_LIMITS -327.6800 327.6700 /end CHARACTERISTIC
/begin CHARACTERISTIC FanCtl_dcycMinOff_C "Minimumwert, ""Lüfter aus""" VALUE 0xCFEE2 Kw_Ws16 100.0000 DtyCyc 0.00 100.0000 FORMAT "%8.4" EXTENDED_LIMITS -327.6800 327.6700 /end CHARACTERISTIC
/begin CHARACTERISTIC FanCtl_dcycSwtLimOff_C "Schwelle für Erkennung ""Lüfter aus""" VALUE 0xCFEE4 Kw_Ws16 100.0000 DtyCyc 0.00 100.0000 FORMAT "%8.4" EXTENDED_LIMITS -327.6800 327.6700 /end CHARACTERISTIC
/begin CHARACTERISTIC FanCtl_dcycSwtLimOn_C "Schwelle für Erkennung ""Lüfter ein""" VALUE 0xCFEE6 Kw_Ws16 100.0000 DtyCyc 0.00 100.0000 FORMAT "%8.4" EXTENDED_LIMITS -327.6800 327.6700 /end CHARACTERISTIC
/begin CHARACTERISTIC FanCtl_dcyc_CUR "Umrechnungs-KL, Drehzahl / Tastverhältnis" CURVE 0xCFEE8 Kl_Xs16_Ws16 100.0000 DtyCyc 0.00 100.0000 FORMAT "%8.4" EXTENDED_LIMITS -327.6800 327.6700
 /begin AXIS_DESCR STD_AXIS FanCtl_nSetPoint FanSpd 4 0.00 3000.000 FORMAT "%8.3" EXTENDED_LIMITS -3000.092 3000.000 DEPOSIT ABSOLUTE /end AXIS_DESCR
/end CHARACTERISTIC
/begin CHARACTERISTIC FanCtl_facWghFctr_CUR "wighting factor for fanspeed = f(veh. speed)" CURVE 0xCFEFA Kl_Xs16_Ws16 10.00000 Fact 0.00 10.00000 FORMAT "%8.5" EXTENDED_LIMITS -4.000000 3.999878
 /begin AXIS_DESCR STD_AXIS VSSCD_v Vel 4 0.00 300.0000 FORMAT "%8.4" EXTENDED_LIMITS -327.6800 327.6700 DEPOSIT ABSOLUTE /end AXIS_DESCR
/end CHARACTERISTIC
/begin CHARACTERISTIC FanCtl_nDemFanOffLim_C "Drehzahlausschaltschwelle für hohe Lenköltemperaturen" VALUE 0xCFF0C Kw_Ws16 5960.000 EngN 40.00000 6000.000 FORMAT "%8.3" EXTENDED_LIMITS -32768.00 32767.00 /end CHARACTERISTIC
/begin CHARACTERISTIC FanCtl_nDemFanOn_C "Drehzahl Vorgabewert des Lüfters für hohe Lenköltemperaturen" VALUE 0xCFF0E Kw_Ws16 5960.000 EngN 40.00000 6000.000 FORMAT "%8.3" EXTENDED_LIMITS -32768.00 32767.00 /end CHARACTERISTIC
/begin CHARACTERISTIC FanCtl_nMin_C "Drehzahlschwelle für ""Lüfter ein""" VALUE 0xCFF10 Kw_Ws16 5960.000 EngN 40.00000 6000.000 FORMAT "%8.3" EXTENDED_LIMITS -32768.00 32767.00 /end CHARACTERISTIC
/begin CHARACTERISTIC FanCtl_nSetGbxOil_MAP "fan speed derived from vehicle speed and  gearbox temperature" MAP 0xCFF12 Kf_Xs16_Ys16_Ws16 3000.000 FanSpd 0.00 3000.000 FORMAT "%8.3" EXTENDED_LIMITS -3000.092 3000.000
 /begin AXIS_DESCR STD_AXIS VSSCD_v Vel 8 0.00 300.0000 FORMAT "%8.4" EXTENDED_LIMITS -327.6800 327.6700 DEPOSIT ABSOLUTE /end AXIS_DESCR
 /begin AXIS_DESCR STD_AXIS FanCtl_tGbxOil_mp Temp_Cels 10 -50.14000 199.8600 FORMAT "%8.4" EXTENDED_LIMITS -3549.940 3003.560 DEPOSIT ABSOLUTE /end AXIS_DESCR
/end CHARACTERISTIC
/begin CHARACTERISTIC FanCtl_nSetPnt_MAP "fanspeed = f(veh. speed, coolant temp.)" MAP 0xCFFDA Kf_Xs16_Ys16_Ws16 3000.000 FanSpd 0.00 3000.000 FORMAT "%8.3" EXTENDED_LIMITS -3000.092 3000.000
 /begin AXIS_DESCR STD_AXIS VSSCD_v Vel 8 0.00 300.0000 FORMAT "%8.4" EXTENDED_LIMITS -327.6800 327.6700 DEPOSIT ABSOLUTE /end AXIS_DESCR
 /begin AXIS_DESCR STD_AXIS FanCtl_tClnt_mp Temp_Cels 10 -50.14000 199.8600 FORMAT "%8.4" EXTENDED_LIMITS -3549.940 3003.560 DEPOSIT ABSOLUTE /end AXIS_DESCR
/end CHARACTERISTIC
/begin CHARACTERISTIC FanCtl_nSetPointFanOn_C "Drehzahl Vorgabewert des Lüfters für hohe Lenköltemperaturen" VALUE 0xD00A2 Kw_Ws16 3000.000 FanSpd 0.00 3000.000 FORMAT "%8.3" EXTENDED_LIMITS -3000.092 3000.000 /end CHARACTERISTIC
/begin CHARACTERISTIC FanCtl_stDemFanOffGear_C "Gang bei dem der Lüfter ausgeschaltet wird um die Lenköltemperatur zu veringern" VALUE 0xD00A4 Kw_Ws8 7.000 OneToOne -1.000 6.000 FORMAT "%5.3" EXTENDED_LIMITS -128.0 127.0 /end CHARACTERISTIC
/begin CHARACTERISTIC FanCtl_stDemFanOnGear_C "Gang bei dem der Lüfter eingeschaltet wird um die Lenköltemperatur zu veringern" VALUE 0xD00A5 Kw_Ws8 7.000 OneToOne -1.000 6.000 FORMAT "%5.3" EXTENDED_LIMITS -128.0 127.0 /end CHARACTERISTIC
/begin CHARACTERISTIC FanCtl_swtBattCor_C "Schalter zur Aktivierung Ubatt Korrektur (0...aus / 1...ein)" VALUE 0xD00A6 Kw_Ws16 1.000000 OneToOne 0.00 1.000000 FORMAT "%8.6" EXTENDED_LIMITS -32768.00 32767.00 /end CHARACTERISTIC
/begin CHARACTERISTIC FanCtl_tClntDfl_C "Wassertemperaturersatzwert bei defektem Wassertemperatursensor" VALUE 0xD00A8 Kw_Ws16 250.0000 Temp_Cels -50.14000 199.8600 FORMAT "%8.4" EXTENDED_LIMITS -3549.940 3003.560 /end CHARACTERISTIC
/begin CHARACTERISTIC FanCtl_tDemFanOffLim_C "Drehzahlausschaltschwelle für hohe Lenköltemperaturen" VALUE 0xD00AA Kw_Ws16 250.0000 Temp_Cels -50.14000 199.8600 FORMAT "%8.4" EXTENDED_LIMITS -3549.940 3003.560 /end CHARACTERISTIC
/begin CHARACTERISTIC FanCtl_tDemFanOnLim_C "Einschalttemperaturschwelle für hohe Lenköltemperaturen" VALUE 0xD00AC Kw_Ws16 250.0000 Temp_Cels -50.14000 199.8600 FORMAT "%8.4" EXTENDED_LIMITS -3549.940 3003.560 /end CHARACTERISTIC
/begin CHARACTERISTIC FanCtl_tEngAftRunThres_C "Motortemp. Schwelle für 10Hz Nachlauf" VALUE 0xD00AE Kw_Ws16 250.0000 Temp_Cels -50.14000 199.8600 FORMAT "%8.4" EXTENDED_LIMITS -3549.940 3003.560 /end CHARACTERISTIC
/begin CHARACTERISTIC FanCtl_tGbxOilDfl_C "Default Gear box oil temperature" VALUE 0xD00B0 Kw_Ws16 950.0000 Temp_Cels -50.1400 899.8600 FORMAT "%8.4" EXTENDED_LIMITS -3549.940 3003.560 /end CHARACTERISTIC
/begin CHARACTERISTIC FanCtl_tiDemFanOn_C "Zeit bis die Lüfterdrehzahl auf den Vorgabewert für hohe Lenköltemperaturen umgeschaltet wird" VALUE 0xD00B4 Kw_Wu32 42949672.9500 Time_s 0.00 42949672.9500 FORMAT "%13.4" /end CHARACTERISTIC
/begin CHARACTERISTIC FanCtl_tiMinAftRunOfs_C "neg. Offset zur min. SG-Nachlaufzeit" VALUE 0xD00B8 Kw_Wu32 42949672950.0 Time_ms 0.00 42949672950.0 FORMAT "%13.1" /end CHARACTERISTIC
/begin CHARACTERISTIC FanCtl_uBattRef_C "Batteriespannungs, Referenzwert" VALUE 0xD00BC Kw_Ws16 28602.15 Volt_Batt 0.00 28602.15 FORMAT "%8.2" EXTENDED_LIMITS -640625.6 640606.1 /end CHARACTERISTIC
/begin CHARACTERISTIC FanCtl_vDemFanOffMax_C "Obere Ausschaltgeschwindigkeitsschwelle für hohe Lenköltemperaturen" VALUE 0xD00BE Kw_Ws16 327.6700 Vel 0.00 327.6700 FORMAT "%8.4" EXTENDED_LIMITS -327.6800 327.6700 /end CHARACTERISTIC
/begin CHARACTERISTIC FanCtl_vDemFanOffMin_C "Untere Ausschaltgeschwindigkeitsschwelle für hohe Lenköltemperaturen" VALUE 0xD00C0 Kw_Ws16 327.6700 Vel 0.00 327.6700 FORMAT "%8.4" EXTENDED_LIMITS -327.6800 327.6700 /end CHARACTERISTIC
/begin CHARACTERISTIC FanCtl_vDemFanOnMax_C "Obere Einschaltgeschwindigkeitsschwelle für hohe Lenköltemperaturen" VALUE 0xD00C2 Kw_Ws16 327.6700 Vel 0.00 327.6700 FORMAT "%8.4" EXTENDED_LIMITS -327.6800 327.6700 /end CHARACTERISTIC
/begin CHARACTERISTIC FanCtl_vDemFanOnMin_C "Untere Einschaltgeschwindigkeitsschwelle für hohe Lenköltemperaturen" VALUE 0xD00C4 Kw_Ws16 327.6700 Vel 0.00 327.6700 FORMAT "%8.4" EXTENDED_LIMITS -327.6800 327.6700 /end CHARACTERISTIC
/begin CHARACTERISTIC FBC_AACoeff_C "Antialiasingfilterkoeffizienten" VAL_BLK 0xD01C0 Kwb_Wr32 2.00000000 OneToOne -1.00000000 1.00000000 FORMAT "%10.8" EXTENDED_LIMITS -1.00000000E+37 1.00000000E+37 NUMBER 9 /end CHARACTERISTIC
/begin CHARACTERISTIC FBC_AAOrd_C "Filterordnung des Antialiasingfilter" VALUE 0xD01E4 Kw_Wu8 8.000 OneToOne 0.00 8.000 FORMAT "%5.3" EXTENDED_LIMITS 0.00 255.0 /end CHARACTERISTIC
/begin CHARACTERISTIC FBC_Act_C "=0: Geberradadaption inaktiv; =1 aktiv; =2 lösche Adaptionsergebnisspeicher (EEPROM)" VALUE 0xD01E5 Kw_Wu8 2.000 OneToOne 0.00 2.000 FORMAT "%5.3" EXTENDED_LIMITS 0.00 255.0 /end CHARACTERISTIC
/begin CHARACTERISTIC FBC_BPFac1NumG_CUR "drehmomentübersetzungsabhänige Nockenwellenbandpassverstärkung" CURVE 0xD00C8 Kl_Xs16_Ws16 60.00183 FBC_BPfac -30.00092 30.00092 FORMAT "%8.5" EXTENDED_LIMITS -60.00183 60.00000
 /begin AXIS_DESCR STD_AXIS DrvTrn_rTransDT TransR 6 0.00 100.0000 FORMAT "%8.4" EXTENDED_LIMITS -327.6800 327.6700 DEPOSIT ABSOLUTE /end AXIS_DESCR
/end CHARACTERISTIC
/begin CHARACTERISTIC FBC_dBPFacNumLo_CA "Bandpass array: Zählerkoeffizienten für unteren Drehzahlbereich" VAL_BLK 0xD00E4 Kwb_Wr32 30.0000000 OneToOne -15.0000000 15.0000000 FORMAT "%10.7" EXTENDED_LIMITS -1.00000000E+37 1.00000000E+37 NUMBER 3 /end CHARACTERISTIC
/begin CHARACTERISTIC FBC_dBPFacNumHi_CA "Bandpass array: Zählerkoeffizienten für den oberen Drehzahlbereich" VAL_BLK 0xD00F0 Kwb_Wr32 30.0000000 OneToOne -15.0000000 15.0000000 FORMAT "%10.7" EXTENDED_LIMITS -1.00000000E+37 1.00000000E+37 NUMBER 3 /end CHARACTERISTIC
/begin CHARACTERISTIC FBC_dBPFacDen1_CA "Bandpass Array: Nenner 1" VAL_BLK 0xD00FC Kwb_Wr32 20.0000000 OneToOne -10.0000000 10.0000000 FORMAT "%10.7" EXTENDED_LIMITS -1.00000000E+37 1.00000000E+37 NUMBER 3 /end CHARACTERISTIC
/begin CHARACTERISTIC FBC_dBPFacDen2_CA "Bandpass Array: Nenner 2" VAL_BLK 0xD0108 Kwb_Wr32 20.0000000 OneToOne -10.0000000 10.0000000 FORMAT "%10.7" EXTENDED_LIMITS -1.00000000E+37 1.00000000E+37 NUMBER 3 /end CHARACTERISTIC
/begin CHARACTERISTIC FBC_ctSegOffset_C "Abstand zwischen FBC-Berechnung und entsprechendem OT" VALUE 0xD0114 Kw_Ws8 0.00 OneToOne 3.000 3.000 FORMAT "%5.3" EXTENDED_LIMITS -128.0 127.0 /end CHARACTERISTIC
/begin CHARACTERISTIC FBC_dSegNhiCaS_C "Segmentwert für Eng_nAvrg > FBC_nThresFbc_C" VAL_BLK 0xD0116 Kwb_Wu16 255.9961 Per_Ratio 0.00 255.9961 FORMAT "%8.4" NUMBER 3 /end CHARACTERISTIC
/begin CHARACTERISTIC FBC_dSegNloCaS_C "Segmentwert für Eng_nAvrg < FBC_nThresFbc_C" VAL_BLK 0xD011C Kwb_Wu16 255.9961 Per_Ratio 0.00 255.9961 FORMAT "%8.4" NUMBER 3 /end CHARACTERISTIC
/begin CHARACTERISTIC FBC_dSyn_C "Abstand OT Zyl.1 zu Segmentzählerstand 0 (bezogen auf CrSCD_numSeg)" VALUE 0xD0122 Kw_Ws8 24.00 OneToOne -12.00 12.00 FORMAT "%5.2" EXTENDED_LIMITS -128.0 127.0 /end CHARACTERISTIC
/begin CHARACTERISTIC FBC_DXadptl_C "Untere Schwelle der Adaptionsgüte" VALUE 0xD01E8 Kw_Wr32 1.00000000 Prc_float 0.00 1.00000000 FORMAT "%10.8" EXTENDED_LIMITS -1.00000000E+39 1.00000000E+39 /end CHARACTERISTIC
/begin CHARACTERISTIC FBC_DXadptu_C "Obere Schwelle der Adaptionsgüte" VALUE 0xD01EC Kw_Wr32 1.00000000 Prc_float 0.00 1.00000000 FORMAT "%10.8" EXTENDED_LIMITS -1.00000000E+39 1.00000000E+39 /end CHARACTERISTIC
/begin CHARACTERISTIC FBC_DXalf0_C "Startwerte für FBC_DXSfn, FBC_DXSfp" VALUE 0xD01F0 Kw_Wr32 3.00000000 Prc_float 0.00 3.00000000 FORMAT "%10.8" EXTENDED_LIMITS -1.00000000E+39 1.00000000E+39 READ_ONLY /end CHARACTERISTIC
/begin CHARACTERISTIC FBC_fSurge_CUR "drehmomentübersetzungsabhängige Ruckelfrequenzen" CURVE 0xD0124 Kl_Xs16_Ws16 20.00000 Surge_Frq 0.00 20.00000 FORMAT "%8.5" EXTENDED_LIMITS -273.0667 273.0583
 /begin AXIS_DESCR STD_AXIS DrvTrn_rTransDT TransR 6 0.00 100.0000 FORMAT "%8.4" EXTENDED_LIMITS -327.6800 327.6700 DEPOSIT ABSOLUTE /end AXIS_DESCR
/end CHARACTERISTIC
/begin CHARACTERISTIC FBC_GvrnIKi_C "Regler: Integrationskonstante" VALUE 0xD0140 Kw_Wr32 1.00000000 FBC_GvrnIKi_float 0.00 1.00000000 FORMAT "%10.8" EXTENDED_LIMITS -1.00000000E+37 1.00000000E+37 /end CHARACTERISTIC
/begin CHARACTERISTIC FBC_GvrnIKiPos_C "Regler: Integrationskonstante" VALUE 0xD0144 Kw_Wr32 1.00000000 FBC_GvrnIKi_float 0.00 1.00000000 FORMAT "%10.8" EXTENDED_LIMITS -1.00000000E+37 1.00000000E+37 READ_ONLY /end CHARACTERISTIC
/begin CHARACTERISTIC FBC_GvrnIKiNeg_C "Regler: Integrationskonstante" VALUE 0xD0148 Kw_Wr32 1.00000000 FBC_GvrnIKi_float 0.00 1.00000000 FORMAT "%10.8" EXTENDED_LIMITS -1.00000000E+37 1.00000000E+37 READ_ONLY /end CHARACTERISTIC
/begin CHARACTERISTIC FBC_GvrnIWinPos_C "Regler: I-Parameter" VALUE 0xD014C Kw_Wr32 12200.0000 EngN_float -6100.00000 6100.00000 FORMAT "%10.5" EXTENDED_LIMITS -1.00000000E+37 1.00000000E+37 READ_ONLY /end CHARACTERISTIC
/begin CHARACTERISTIC FBC_GvrnIWinNeg_C "Regler: I-Parameter" VALUE 0xD0150 Kw_Wr32 12200.0000 EngN_float -6100.00000 6100.00000 FORMAT "%10.5" EXTENDED_LIMITS -1.00000000E+37 1.00000000E+37 READ_ONLY /end CHARACTERISTIC
/begin CHARACTERISTIC FBC_GvrnPKp_C "Regler: Proportionaltitätskonstante" VALUE 0xD0154 Kw_Wr32 1.00000000 FBC_GvrnPKp_float 0.00 1.00000000 FORMAT "%10.8" EXTENDED_LIMITS -1.00000000E+37 1.00000000E+37 /end CHARACTERISTIC
/begin CHARACTERISTIC FBC_GvrnPKpPos_C "Regler: Proportionaltitätskonstante" VALUE 0xD0158 Kw_Wr32 1.00000000 FBC_GvrnPKp_float 0.00 1.00000000 FORMAT "%10.8" EXTENDED_LIMITS -1.00000000E+37 1.00000000E+37 READ_ONLY /end CHARACTERISTIC
/begin CHARACTERISTIC FBC_GvrnPKpNeg_C "Regler: Proportionaltitätskonstante" VALUE 0xD015C Kw_Wr32 1.00000000 FBC_GvrnPKp_float 0.00 1.00000000 FORMAT "%10.8" EXTENDED_LIMITS -1.00000000E+37 1.00000000E+37 READ_ONLY /end CHARACTERISTIC
/begin CHARACTERISTIC FBC_GvrnPWinPos_C "Regler: P-Parameter" VALUE 0xD0160 Kw_Wr32 12200.0000 EngN_float -6100.00000 6100.00000 FORMAT "%10.5" EXTENDED_LIMITS -1.00000000E+37 1.00000000E+37 READ_ONLY /end CHARACTERISTIC
/begin CHARACTERISTIC FBC_GvrnPWinNeg_C "Regler: P-Parameter" VALUE 0xD0164 Kw_Wr32 12200.0000 EngN_float -6100.00000 6100.00000 FORMAT "%10.5" EXTENDED_LIMITS -1.00000000E+37 1.00000000E+37 READ_ONLY /end CHARACTERISTIC
/begin CHARACTERISTIC FBC_lrn_Vector "#SSD Bypass Label, nicht ändern!" VALUE 0xC2D5E Kw_Wu8 255.0 OneToOne 0.00 255.0 FORMAT "%5.1" /end CHARACTERISTIC
/begin CHARACTERISTIC FBC_lrn_Channel "#SSD Bypass Label, nicht ändern!" VALUE 0xC2D5F Kw_Wu8 255.0 OneToOne 0.00 255.0 FORMAT "%5.1" /end CHARACTERISTIC
/begin CHARACTERISTIC FBC_nCtlOfsMin_C "Offset der unteren drehzahlabhängigen Steuerschwelle zur aktuellen Leerlaufdrehzahl" VALUE 0xD0168 Kw_Ws16 65535.00 EngN -32768.00 32767.00 FORMAT "%8.2" /end CHARACTERISTIC
/begin CHARACTERISTIC FBC_nCtlThresMax_C "obere Drehzahlsteuerschwelle" VALUE 0xD016A Kw_Ws16 65535.00 EngN -32768.00 32767.00 FORMAT "%8.2" /end CHARACTERISTIC
/begin CHARACTERISTIC FBC_nGvrnOfsMin_C "Offset der unteren drehzahlabhängigen Regelschwelle zur aktuellen Leerlaufdrehzahl" VALUE 0xD016C Kw_Ws16 65535.00 EngN -32768.00 32767.00 FORMAT "%8.2" /end CHARACTERISTIC
/begin CHARACTERISTIC FBC_nGvrnThresMax_C "obere Drehzahlregelschwelle" VALUE 0xD016E Kw_Ws16 6000.000 EngN 0.00 6000.000 FORMAT "%8.3" EXTENDED_LIMITS -32768.00 32767.00 /end CHARACTERISTIC
/begin CHARACTERISTIC FBC_nHyst_C "Drehzahlhysterese" VALUE 0xD0170 Kw_Ws16 100.0000 EngN 0.00 100.0000 FORMAT "%8.4" EXTENDED_LIMITS -32768.00 32767.00 /end CHARACTERISTIC
/begin CHARACTERISTIC FBC_nLrnThres_C "Drehzahlschwellen der Lernbereiche der Geberradadaption" VAL_BLK 0xD01F4 Kwb_Ws16 6000.000 EngN 0.00 6000.000 FORMAT "%8.3" EXTENDED_LIMITS -32768.00 32767.00 NUMBER 3 /end CHARACTERISTIC
/begin CHARACTERISTIC FBC_nSurgeOffset_C "pos. Offset zur kritischen Drehzahl, bei der fNW=fRuck gilt." VALUE 0xD0172 Kw_Ws16 1000.000 EngN 0.00 1000.000 FORMAT "%8.3" EXTENDED_LIMITS -32768.00 32767.00 /end CHARACTERISTIC
/begin CHARACTERISTIC FBC_nThresFbc_C "Komfortdrehzahlbereich für Segmentwerte" VALUE 0xD01FA Kw_Ws16 65535.00 EngN -32768.00 32767.00 FORMAT "%8.2" /end CHARACTERISTIC
/begin CHARACTERISTIC FBC_qCtlOfsMax_C "Offset für obere mengenabhängige Steuerschwelle" VALUE 0xD0174 Kw_Ws16 655.3500 InjMass -327.6800 327.6700 FORMAT "%8.4" /end CHARACTERISTIC
/begin CHARACTERISTIC FBC_qCtlThresMin_C "untere Mengensteuerschwelle" VALUE 0xD0176 Kw_Ws16 655.3500 InjMass -327.6800 327.6700 FORMAT "%8.4" /end CHARACTERISTIC
/begin CHARACTERISTIC FBC_qDvtMax_CUR "Kennlinie zur Berechnung der max. Integratorwertschwelle" CURVE 0xD0178 Kl_Xs16_Ws16 655.3400 InjMass -327.6700 327.6700 FORMAT "%8.4" EXTENDED_LIMITS -327.6800 327.6700
 /begin AXIS_DESCR STD_AXIS InjCtl_qSetUnBal InjMassCyc 2 0.00 327.6700 FORMAT "%8.4" EXTENDED_LIMITS -327.6800 327.6700 DEPOSIT ABSOLUTE /end AXIS_DESCR
/end CHARACTERISTIC
/begin CHARACTERISTIC FBC_qDvtMin_CUR "Kennlinie zur Berechnung der min. Integratorwertschwelle" CURVE 0xD0182 Kl_Xs16_Ws16 655.3400 InjMass -327.6700 327.6700 FORMAT "%8.4" EXTENDED_LIMITS -327.6800 327.6700
 /begin AXIS_DESCR STD_AXIS InjCtl_qSetUnBal InjMassCyc 2 0.00 327.6700 FORMAT "%8.4" EXTENDED_LIMITS -327.6800 327.6700 DEPOSIT ABSOLUTE /end AXIS_DESCR
/end CHARACTERISTIC
/begin CHARACTERISTIC FBC_qGvrnThresMax_CUR "obere mengenabhängige Regelschwelle" CURVE 0xD018C Kl_Xs16_Ws16 327.6700 InjMass 0.00 327.6700 FORMAT "%8.4" EXTENDED_LIMITS -327.6800 327.6700
 /begin AXIS_DESCR STD_AXIS Eng_nAvrg EngN 4 0.00 6000.000 FORMAT "%8.3" EXTENDED_LIMITS -32768.00 32767.00 DEPOSIT ABSOLUTE /end AXIS_DESCR
/end CHARACTERISTIC
/begin CHARACTERISTIC FBC_qGvrnThresMin_C "untere Mengenregelschwelle" VALUE 0xD019E Kw_Ws16 655.3500 InjMass -327.6800 327.6700 FORMAT "%8.4" /end CHARACTERISTIC
/begin CHARACTERISTIC FBC_qLim_CUR "mengenabhängige Korrekturmengenbegrenzung" CURVE 0xD01A0 Kl_Xs16_Ws16 327.6700 InjMass 0.00 327.6700 FORMAT "%8.4" EXTENDED_LIMITS -327.6800 327.6700
 /begin AXIS_DESCR STD_AXIS InjCtl_qSetUnBal InjMassCyc 4 0.00 327.6700 FORMAT "%8.4" EXTENDED_LIMITS -327.6800 327.6700 DEPOSIT ABSOLUTE /end AXIS_DESCR
/end CHARACTERISTIC
/begin CHARACTERISTIC FBC_q_Vector "#SSD Bypass Label, nicht ändern!" VALUE 0xC2D5C Kw_Wu8 255.0 OneToOne 0.00 255.0 FORMAT "%5.1" /end CHARACTERISTIC
/begin CHARACTERISTIC FBC_q_Channel "#SSD Bypass Label, nicht ändern!" VALUE 0xC2D5D Kw_Wu8 255.0 OneToOne 0.00 255.0 FORMAT "%5.1" /end CHARACTERISTIC
/begin CHARACTERISTIC FBC_stInitI_C "Initialisierung des I-Anteils im Zustand ""inaktiv"": '0' einfrieren, '1' mit 0 initialisieren." VALUE 0xD01B2 Kw_Ws8 1.000 OneToOne 0.00 1.000 FORMAT "%5.3" EXTENDED_LIMITS -128.0 127.0 /end CHARACTERISTIC
/begin CHARACTERISTIC FBC_stMskRgn_C "Maske für Regenerationsstatus (NOx-Kat)" VALUE 0xD01B4 Kw_Ws32 4294967295.00 OneToOne -2147483648.00 2147483647.00 FORMAT "%13.2" /end CHARACTERISTIC
/begin CHARACTERISTIC FBC_TFlrn_C "Filterkoeffizient des Bewertungsfilters" VALUE 0xD01FC Kw_Wr32 1.00000000 OneToOne 0.00 1.00000000 FORMAT "%10.8" EXTENDED_LIMITS -1.00000000E+37 1.00000000E+37 /end CHARACTERISTIC
/begin CHARACTERISTIC FBC_TF_C "Filterkoeffizient des Adaptionsfilters" VALUE 0xD0200 Kw_Wr32 1.00000000 OneToOne 0.00 1.00000000 FORMAT "%10.8" EXTENDED_LIMITS -1.00000000E+37 1.00000000E+37 /end CHARACTERISTIC
/begin CHARACTERISTIC FBC_ThresDyn_C "Drehzahldynamikgrenzwert um die Adaption zu deaktivieren" VALUE 0xD0204 Kw_Wr32 1.00000000 OneToOne 0.00 1.00000000 FORMAT "%10.8" EXTENDED_LIMITS -1.00000000E+37 1.00000000E+37 /end CHARACTERISTIC
/begin CHARACTERISTIC FBC_tiDvtMaxDefect_C "Fehler-Entprellzeit Überwachung Integratorwert (Max)" VALUE 0xD01B8 Kw_Wu16 655350.0 Time_ms 0.00 655350.0 FORMAT "%8.1" /end CHARACTERISTIC
/begin CHARACTERISTIC FBC_tiDvtMaxOk_C "Heilung-Entprellzeit Überwachung Integratorwert (Max)" VALUE 0xD01BA Kw_Wu16 655350.0 Time_ms 0.00 655350.0 FORMAT "%8.1" /end CHARACTERISTIC
/begin CHARACTERISTIC FBC_tiDvtMinDefect_C "Fehler-Entprellzeit Überwachung Integratorwert (Min)" VALUE 0xD01BC Kw_Wu16 655350.0 Time_ms 0.00 655350.0 FORMAT "%8.1" /end CHARACTERISTIC
/begin CHARACTERISTIC FBC_tiDvtMinOk_C "Heilung-Entprellzeit Überwachung Integratorwert (Min)" VALUE 0xD01BE Kw_Wu16 655350.0 Time_ms 0.00 655350.0 FORMAT "%8.1" /end CHARACTERISTIC
/begin CHARACTERISTIC FBC_TSm_C "Koeffizienten für Mittelwertfilter" VAL_BLK 0xD0208 Kwb_Wr32 13.0000000 OneToOne -6.00000000 7.00000000 FORMAT "%10.8" EXTENDED_LIMITS -1.00000000E+37 1.00000000E+37 NUMBER 2 /end CHARACTERISTIC
/begin CHARACTERISTIC FlFCD_numDioIn_C "#SSD Auswahl des digitalen Eingangspins des Sensors der Wasserstandserkennung im Kraftstofffilter" VALUE 0xD0210 Kw_Wu8 14.0000000000 NumPinDioIn 0.00 14.0000000000 FORMAT "%13.10" /end CHARACTERISTIC
/begin CHARACTERISTIC FlFCD_swtFlFltInv_C "Schalter zum Invertieren des Eingangssignals" VALUE 0xD0211 Kw_Wu8 1.000 OneToOne 0.00 1.000 FORMAT "%5.3" EXTENDED_LIMITS 0.00 255.0 /end CHARACTERISTIC
/begin CHARACTERISTIC FlFCD_swtFlFltSens_C "Kraftstofffilter-Sensor vorhanden" VALUE 0xD0212 Kw_Wu8 1.000 OneToOne 0.00 1.000 FORMAT "%5.3" EXTENDED_LIMITS 0.00 255.0 /end CHARACTERISTIC
/begin CHARACTERISTIC FlFCD_tiDebFlFltDef_C "Fehlerentprellzeit für Kraftstofffilter-Sensor" VALUE 0xD0214 Kw_Wu16 655350.0 Time_ms 0.00 655350.0 FORMAT "%8.1" /end CHARACTERISTIC
/begin CHARACTERISTIC FlFCD_tiDebFlFltOk_C "Heilungsentprellzeit für Kraftstofffilter-Sensor" VALUE 0xD0216 Kw_Wu16 655350.0 Time_ms 0.00 655350.0 FORMAT "%8.1" /end CHARACTERISTIC
/begin CHARACTERISTIC FlFCD_tiFlFltDebNeg_C "Entprellzeit für negative Flanken" VALUE 0xD0218 Kw_Wu16 2000.000 TimeDeb 0.00 2000.000 FORMAT "%8.3" EXTENDED_LIMITS 0.00 655350.0 /end CHARACTERISTIC
/begin CHARACTERISTIC FlFCD_tiFlFltDebPos_C "Entprellzeit für positive Flanken" VALUE 0xD021A Kw_Wu16 2000.000 TimeDeb 0.00 2000.000 FORMAT "%8.3" EXTENDED_LIMITS 0.00 655350.0 /end CHARACTERISTIC
/begin CHARACTERISTIC FlMng_tiDebSmkDefectDef_C "debounce duration for detached charge air tube error detection" VALUE 0xD021C Kw_Wu16 655350.0 Time_ms 0.00 655350.0 FORMAT "%8.1" /end CHARACTERISTIC
/begin CHARACTERISTIC FlMng_tiDebSmkDefectOk_C "debounce duration for detached charge air tube error healing" VALUE 0xD021E Kw_Wu16 655350.0 Time_ms 0.00 655350.0 FORMAT "%8.1" /end CHARACTERISTIC
/begin CHARACTERISTIC FlMng_dqLimUp_C "step per time interval for ramping up" VALUE 0xD0220 Kw_Wu32 655359.999847 RmpInjMass 0.00 655359.999847 FORMAT "%13.6" /end CHARACTERISTIC
/begin CHARACTERISTIC FlMng_dqLimDwn_C "step per time interval for ramping down" VALUE 0xD0224 Kw_Wu32 655359.999847 RmpInjMass 0.00 655359.999847 FORMAT "%13.6" /end CHARACTERISTIC
/begin CHARACTERISTIC FlMng_dSmkLimUp_C "ramp gradient for ramping up" VALUE 0xD0228 Kw_Wu32 2621439999.39 PrcPerSec 0.00 2621439999.39 FORMAT "%13.2" /end CHARACTERISTIC
/begin CHARACTERISTIC FlMng_dSmkLimDwn_C "ramp gradient for ramping down" VALUE 0xD022C Kw_Wu32 2621439999.39 PrcPerSec 0.00 2621439999.39 FORMAT "%13.2" /end CHARACTERISTIC
/begin CHARACTERISTIC FlMng_facAPSCorNeg_CUR "Kennlinie zur multiplikativen Korrektur der Filterzeitkonstante bei negativer Änderung der Luftmasse" CURVE 0xD0230 Kl_Xs16_Ws16 5.000000 Fact 0.00 5.000000 FORMAT "%8.6" EXTENDED_LIMITS -4.000000 3.999878
 /begin AXIS_DESCR STD_AXIS APSCD_pVal Pres_hPa 8 0.00 3500.0000 FORMAT "%8.4" EXTENDED_LIMITS -32768.00 32767.00 DEPOSIT ABSOLUTE /end AXIS_DESCR
/end CHARACTERISTIC
/begin CHARACTERISTIC FlMng_facAPSCorPos_CUR "Kennlinie zur multiplikativen Korrektur der Filterzeitkonstante bei positiver Änderung der Luftmasse" CURVE 0xD0252 Kl_Xs16_Ws16 5.000000 Fact 0.00 5.000000 FORMAT "%8.6" EXTENDED_LIMITS -4.000000 3.999878
 /begin AXIS_DESCR STD_AXIS APSCD_pVal Pres_hPa 8 0.00 3500.0000 FORMAT "%8.4" EXTENDED_LIMITS -32768.00 32767.00 DEPOSIT ABSOLUTE /end AXIS_DESCR
/end CHARACTERISTIC
/begin CHARACTERISTIC FlMng_facLmbdAPSCor_CUR "Multiplicative air pressure correction" CURVE 0xD0274 Kl_Xs16_Ws16 5.000000 Fact 0.00 5.000000 FORMAT "%8.6" EXTENDED_LIMITS -4.000000 3.999878
 /begin AXIS_DESCR STD_AXIS APSCD_pVal Pres_hPa 8 0.00 3500.0000 FORMAT "%8.4" EXTENDED_LIMITS -32768.00 32767.00 DEPOSIT ABSOLUTE /end AXIS_DESCR
/end CHARACTERISTIC
/begin CHARACTERISTIC FlMng_facLmbdATSCor_CUR "Multiplicative ATS correction" CURVE 0xD0296 Kl_Xs16_Ws16 5.000000 Fact 0.00 5.000000 FORMAT "%8.6" EXTENDED_LIMITS -4.000000 3.999878
 /begin AXIS_DESCR STD_AXIS IATSCD_tAir Temp_Cels 8 -50.1400 899.8600 FORMAT "%8.4" EXTENDED_LIMITS -3549.940 3003.560 DEPOSIT ABSOLUTE /end AXIS_DESCR
/end CHARACTERISTIC
/begin CHARACTERISTIC FlMng_facLmbdETSCor_CUR "Multiplicative ETS correction" CURVE 0xD02B8 Kl_Xs16_Ws16 5.000000 Fact 0.00 5.000000 FORMAT "%8.6" EXTENDED_LIMITS -4.000000 3.999878
 /begin AXIS_DESCR STD_AXIS Eng_tEng Temp_Cels 8 -50.1400 899.8600 FORMAT "%8.4" EXTENDED_LIMITS -3549.940 3003.560 DEPOSIT ABSOLUTE /end AXIS_DESCR
/end CHARACTERISTIC
/begin CHARACTERISTIC FlMng_FullLdRglIKi_CUR "Drehzahlabhängige Ki-Parameter der Vollastregelung" CURVE 0xD24C0 Kl_Xs16_Ws16 762.9162 Ki_LmbdRec2InjMass 0.00 762.9162 FORMAT "%8.4" EXTENDED_LIMITS -762.9395 762.9162
 /begin AXIS_DESCR STD_AXIS Eng_nAvrg EngN 7 0.00 6000.000 FORMAT "%8.3" EXTENDED_LIMITS -32768.00 32767.00 DEPOSIT ABSOLUTE /end AXIS_DESCR
/end CHARACTERISTIC
/begin CHARACTERISTIC FlMng_qFullLdRglMax_C "Maximale Stellgröße für Vollastregler" VALUE 0xD24DE Kw_Ws16 327.6700 InjMass 0.00 327.6700 FORMAT "%8.4" EXTENDED_LIMITS -327.6800 327.6700 /end CHARACTERISTIC
/begin CHARACTERISTIC FlMng_qFullLdRglMin_C "Minimale Stellgröße für Volllastregler" VALUE 0xD24E0 Kw_Ws16 327.6800 InjMass -327.6800 0.00 FORMAT "%8.4" EXTENDED_LIMITS -327.6800 327.6700 /end CHARACTERISTIC
/begin CHARACTERISTIC FlMng_FullLdRglPKp_CUR "Drehzahlabhängige P-Parameter der Vollastregelung" CURVE 0xD24E2 Kl_Xs16_Ws16 399.9878 Kp_LmbdRec2InjMass_1 0.00 399.9878 FORMAT "%8.4" EXTENDED_LIMITS -400.0000 399.9878
 /begin AXIS_DESCR STD_AXIS Eng_nAvrg EngN 7 0.00 6000.000 FORMAT "%8.3" EXTENDED_LIMITS -32768.00 32767.00 DEPOSIT ABSOLUTE /end AXIS_DESCR
/end CHARACTERISTIC
/begin CHARACTERISTIC FlMng_mAirPerCylMin_C "untere Begrenzung der Luftmasse" VALUE 0xD02DA Kw_Ws16 6553.500 AirMassPerCyl -3276.800 3276.700 FORMAT "%8.3" /end CHARACTERISTIC
/begin CHARACTERISTIC FlMng_numRevEng_C "Threshold for revolution counter" VALUE 0xD02DC Kw_Wu16 65535.00 OneToOne 0.00 65535.00 FORMAT "%8.2" /end CHARACTERISTIC
/begin CHARACTERISTIC FlMng_pThresLmbd0_C "environment pressure threshold for dynamic smoke limitation" VALUE 0xD02DE Kw_Ws16 3500.000 Pres_hPa 0.00 3500.000 FORMAT "%8.3" EXTENDED_LIMITS -32768.00 32767.00 /end CHARACTERISTIC
/begin CHARACTERISTIC FlMng_pThresLmbd1_C "environment pressure threshold  for static smoke limitation" VALUE 0xD02E0 Kw_Ws16 3500.000 Pres_hPa 0.00 3500.000 FORMAT "%8.3" EXTENDED_LIMITS -32768.00 32767.00 /end CHARACTERISTIC
/begin CHARACTERISTIC FlMng_pThresLmbd2_C "environment pressure threshold for static smoke limitation" VALUE 0xD02E2 Kw_Ws16 3500.000 Pres_hPa 0.00 3500.000 FORMAT "%8.3" EXTENDED_LIMITS -32768.00 32767.00 /end CHARACTERISTIC
/begin CHARACTERISTIC FlMng_qDefectMin_MAP "Rauchbegrenzungsmenge bei abgefallenen Ladeluftschlauch" MAP 0xD02E4 Kf_Xs16_Ys16_Ws16 327.6700 InjMass 0.00 327.6700 FORMAT "%8.4" EXTENDED_LIMITS -327.6800 327.6700
 /begin AXIS_DESCR STD_AXIS Eng_nAvrg EngN 16 0.00 6000.000 FORMAT "%8.3" EXTENDED_LIMITS -32768.00 32767.00 DEPOSIT ABSOLUTE /end AXIS_DESCR
 /begin AXIS_DESCR STD_AXIS APSCD_pVal Pres_hPa 16 0.00 3500.000 FORMAT "%8.3" EXTENDED_LIMITS -32768.00 32767.00 DEPOSIT ABSOLUTE /end AXIS_DESCR
/end CHARACTERISTIC
/begin CHARACTERISTIC FlMng_qDefectOfs_C "Offset Wert für Erkennung eines abgefallenen Ladeluftschlauch" VALUE 0xD0528 Kw_Ws16 327.6700 InjMass 0.00 327.6700 FORMAT "%8.4" EXTENDED_LIMITS -327.6800 327.6700 /end CHARACTERISTIC
/begin CHARACTERISTIC FlMng_qEngTemp_CUR "fuel mass = f(engine temperature)" CURVE 0xD052A Kl_Xs16_Ws16 327.6700 InjMassInj 0.00 327.6700 FORMAT "%8.4" EXTENDED_LIMITS -327.6800 327.6700
 /begin AXIS_DESCR STD_AXIS Eng_tEng Temp_Cels 5 -50.14000 199.8600 FORMAT "%8.4" EXTENDED_LIMITS -3549.940 3003.560 DEPOSIT ABSOLUTE /end AXIS_DESCR
/end CHARACTERISTIC
/begin CHARACTERISTIC FlMng_rLmbdAPSCor_MAP "Kennfeld zur Ermittlung des Lambda-Korrekturwertes in Abhängigkeit des Umgebungsdrucks" MAP 0xD0540 Kf_Xs16_Ys16_Ws16 32.00000 lambda 0.00 32.00000 FORMAT "%8.5" EXTENDED_LIMITS -32.76800 32.76700
 /begin AXIS_DESCR STD_AXIS Eng_nAvrg EngN 16 0.00 6000.000 FORMAT "%8.3" EXTENDED_LIMITS -32768.00 32767.00 DEPOSIT ABSOLUTE /end AXIS_DESCR
 /begin AXIS_DESCR STD_AXIS ASMod_mAirPerCylCorr AirMassPerCyl 16 0.00 2500.000 FORMAT "%8.3" EXTENDED_LIMITS -3276.800 3276.700 DEPOSIT ABSOLUTE /end AXIS_DESCR
/end CHARACTERISTIC
/begin CHARACTERISTIC FlMng_rLmbdATSCor_MAP "map to determine the lambda value of smoke limitation for Intake air temperature correction" MAP 0xD0784 Kf_Xs16_Ys16_Ws16 32.00000 lambda 0.00 32.00000 FORMAT "%8.5" EXTENDED_LIMITS -32.76800 32.76700
 /begin AXIS_DESCR STD_AXIS Eng_nAvrg EngN 16 0.00 6000.000 FORMAT "%8.3" EXTENDED_LIMITS -32768.00 32767.00 DEPOSIT ABSOLUTE /end AXIS_DESCR
 /begin AXIS_DESCR STD_AXIS ASMod_mAirPerCylCorr AirMassPerCyl 16 0.00 2500.000 FORMAT "%8.3" EXTENDED_LIMITS -3276.800 3276.700 DEPOSIT ABSOLUTE /end AXIS_DESCR
/end CHARACTERISTIC
/begin CHARACTERISTIC FlMng_rLmbdETSCor_MAP "map to determine the lambda value of smoke limitation for Engine temperature correction" MAP 0xD09C8 Kf_Xs16_Ys16_Ws16 32.00000 lambda 0.00 32.00000 FORMAT "%8.5" EXTENDED_LIMITS -32.76800 32.76700
 /begin AXIS_DESCR STD_AXIS Eng_nAvrg EngN 16 0.00 6000.000 FORMAT "%8.3" EXTENDED_LIMITS -32768.00 32767.00 DEPOSIT ABSOLUTE /end AXIS_DESCR
 /begin AXIS_DESCR STD_AXIS ASMod_mAirPerCylCorr AirMassPerCyl 16 0.00 2500.000 FORMAT "%8.3" EXTENDED_LIMITS -3276.800 3276.700 DEPOSIT ABSOLUTE /end AXIS_DESCR
/end CHARACTERISTIC
/begin CHARACTERISTIC FlMng_rLmbdRecDvtMax_C "Maximale reziproke Lamda-Regelabweichung der Volllastregelung" VALUE 0xD2500 Kw_Ws16 1.330000 lambdaRec 0.00 1.330000 FORMAT "%8.6" EXTENDED_LIMITS -3.276800 3.276700 /end CHARACTERISTIC
/begin CHARACTERISTIC FlMng_rLmbdRecDvtMin_C "Minimale reziproke Lambda-Regelabweichung der Vollastregelung" VALUE 0xD2502 Kw_Ws16 1.330000 lambdaRec -1.330000 0.00 FORMAT "%8.6" EXTENDED_LIMITS -3.276800 3.276700 /end CHARACTERISTIC
/begin CHARACTERISTIC FlMng_rLmbdSmk2FDC_MAP " 2nd map to determine the lambda value of smoke limitation" MAP 0xD0C0C Kf_Xs16_Ys16_Ws16 32.00000 lambda 0.00 32.00000 FORMAT "%8.5" EXTENDED_LIMITS -32.76800 32.76700
 /begin AXIS_DESCR STD_AXIS Eng_nAvrg EngN 16 0.00 6000.000 FORMAT "%8.3" EXTENDED_LIMITS -32768.00 32767.00 DEPOSIT ABSOLUTE /end AXIS_DESCR
 /begin AXIS_DESCR STD_AXIS FlMng_mAirPerCylFltSmk_mp AirMassPerCyl 16 0.00 2500.000 FORMAT "%8.3" EXTENDED_LIMITS -3276.800 3276.700 DEPOSIT ABSOLUTE /end AXIS_DESCR
/end CHARACTERISTIC
/begin CHARACTERISTIC FlMng_rLmbdSmk2UpperGbxFDC_MAP "2nd map to determine the lambda value of smoke limitation in case the gear belongs to upper gear box" MAP 0xD0E50 Kf_Xs16_Ys16_Ws16 32.00000 lambda 0.00 32.00000 FORMAT "%8.5" EXTENDED_LIMITS -32.76800 32.76700
 /begin AXIS_DESCR STD_AXIS Eng_nAvrg EngN 16 0.00 6000.000 FORMAT "%8.3" EXTENDED_LIMITS -32768.00 32767.00 DEPOSIT ABSOLUTE /end AXIS_DESCR
 /begin AXIS_DESCR STD_AXIS FlMng_mAirPerCylFltSmk_mp AirMassPerCyl 16 0.00 2500.000 FORMAT "%8.3" EXTENDED_LIMITS -3276.800 3276.700 DEPOSIT ABSOLUTE /end AXIS_DESCR
/end CHARACTERISTIC
/begin CHARACTERISTIC FlMng_rLmbdSmk2UpperGbx_MAP "2nd map to determine the lambda value of smoke limitation in case the gear belongs to upper gear box" MAP 0xD1094 Kf_Xs16_Ys16_Ws16 32.00000 lambda 0.00 32.00000 FORMAT "%8.5" EXTENDED_LIMITS -32.76800 32.76700
 /begin AXIS_DESCR STD_AXIS Eng_nAvrg EngN 16 0.00 6000.000 FORMAT "%8.3" EXTENDED_LIMITS -32768.00 32767.00 DEPOSIT ABSOLUTE /end AXIS_DESCR
 /begin AXIS_DESCR STD_AXIS ASMod_mAirPerCylCorr AirMassPerCyl 16 0.00 2500.000 FORMAT "%8.3" EXTENDED_LIMITS -3276.800 3276.700 DEPOSIT ABSOLUTE /end AXIS_DESCR
/end CHARACTERISTIC
/begin CHARACTERISTIC FlMng_rLmbdSmk2_MAP "Map number 2 for determining the lambda value for smoke limitation" MAP 0xD12D8 Kf_Xs16_Ys16_Ws16 32.00000 lambda 0.00 32.00000 FORMAT "%8.5" EXTENDED_LIMITS -32.76800 32.76700
 /begin AXIS_DESCR STD_AXIS Eng_nAvrg EngN 16 0.00 6000.000 FORMAT "%8.3" EXTENDED_LIMITS -32768.00 32767.00 DEPOSIT ABSOLUTE /end AXIS_DESCR
 /begin AXIS_DESCR STD_AXIS ASMod_mAirPerCylCorr AirMassPerCyl 16 0.00 2500.000 FORMAT "%8.3" EXTENDED_LIMITS -3276.800 3276.700 DEPOSIT ABSOLUTE /end AXIS_DESCR
/end CHARACTERISTIC
/begin CHARACTERISTIC FlMng_rLmbdSmkFDC_MAP "map to determine the lambda value of smoke limitation" MAP 0xD151C Kf_Xs16_Ys16_Ws16 32.00000 lambda 0.00 32.00000 FORMAT "%8.5" EXTENDED_LIMITS -32.76800 32.76700
 /begin AXIS_DESCR STD_AXIS Eng_nAvrg EngN 16 0.00 6000.000 FORMAT "%8.3" EXTENDED_LIMITS -32768.00 32767.00 DEPOSIT ABSOLUTE /end AXIS_DESCR
 /begin AXIS_DESCR STD_AXIS FlMng_mAirPerCylFltSmk_mp AirMassPerCyl 16 0.00 2500.000 FORMAT "%8.3" EXTENDED_LIMITS -3276.800 3276.700 DEPOSIT ABSOLUTE /end AXIS_DESCR
/end CHARACTERISTIC
/begin CHARACTERISTIC FlMng_rLmbdSmkRgn1_MAP "Kennfeld zur Ermittlung des Lambda-Wertes der Rauchbegrenzung im Regenerationszustand 1" MAP 0xD1760 Kf_Xs16_Ys16_Ws16 32.00000 lambda 0.00 32.00000 FORMAT "%8.5" EXTENDED_LIMITS -32.76800 32.76700
 /begin AXIS_DESCR STD_AXIS Eng_nAvrg EngN 16 0.00 6000.000 FORMAT "%8.3" EXTENDED_LIMITS -32768.00 32767.00 DEPOSIT ABSOLUTE /end AXIS_DESCR
 /begin AXIS_DESCR STD_AXIS ASMod_mAirPerCylCorr AirMassPerCyl 16 0.00 2500.000 FORMAT "%8.3" EXTENDED_LIMITS -3276.800 3276.700 DEPOSIT ABSOLUTE /end AXIS_DESCR
/end CHARACTERISTIC
/begin CHARACTERISTIC FlMng_rLmbdSmkRgn2_MAP "Kennfeld zur Ermittlung des Lambda-Wertes der Rauchbegrenzung im Regenerationszustand 2" MAP 0xD19A4 Kf_Xs16_Ys16_Ws16 32.00000 lambda 0.00 32.00000 FORMAT "%8.5" EXTENDED_LIMITS -32.76800 32.76700
 /begin AXIS_DESCR STD_AXIS Eng_nAvrg EngN 16 0.00 6000.000 FORMAT "%8.3" EXTENDED_LIMITS -32768.00 32767.00 DEPOSIT ABSOLUTE /end AXIS_DESCR
 /begin AXIS_DESCR STD_AXIS ASMod_mAirPerCylCorr AirMassPerCyl 16 0.00 2500.000 FORMAT "%8.3" EXTENDED_LIMITS -3276.800 3276.700 DEPOSIT ABSOLUTE /end AXIS_DESCR
/end CHARACTERISTIC
/begin CHARACTERISTIC FlMng_rLmbdSmkUpperGbxFDC_MAP "map to determine the lambda value of smoke limitation in case the gear belongs to upper gear box" MAP 0xD1BE8 Kf_Xs16_Ys16_Ws16 32.00000 lambda 0.00 32.00000 FORMAT "%8.5" EXTENDED_LIMITS -32.76800 32.76700
 /begin AXIS_DESCR STD_AXIS Eng_nAvrg EngN 16 0.00 6000.000 FORMAT "%8.3" EXTENDED_LIMITS -32768.00 32767.00 DEPOSIT ABSOLUTE /end AXIS_DESCR
 /begin AXIS_DESCR STD_AXIS FlMng_mAirPerCylFltSmk_mp AirMassPerCyl 16 0.00 2500.000 FORMAT "%8.3" EXTENDED_LIMITS -3276.800 3276.700 DEPOSIT ABSOLUTE /end AXIS_DESCR
/end CHARACTERISTIC
/begin CHARACTERISTIC FlMng_rLmbdSmkUpperGbx_MAP "map to determine the lambda value of smoke limitation in case the gear belongs to upper gear box" MAP 0xD1E2C Kf_Xs16_Ys16_Ws16 32.00000 lambda 0.00 32.00000 FORMAT "%8.5" EXTENDED_LIMITS -32.76800 32.76700
 /begin AXIS_DESCR STD_AXIS Eng_nAvrg EngN 16 0.00 6000.000 FORMAT "%8.3" EXTENDED_LIMITS -32768.00 32767.00 DEPOSIT ABSOLUTE /end AXIS_DESCR
 /begin AXIS_DESCR STD_AXIS ASMod_mAirPerCylCorr AirMassPerCyl 16 0.00 2500.000 FORMAT "%8.3" EXTENDED_LIMITS -3276.800 3276.700 DEPOSIT ABSOLUTE /end AXIS_DESCR
/end CHARACTERISTIC
/begin CHARACTERISTIC FlMng_rLmbdSmk_MAP "Kennfeld zur Ermittlung des Lambda-Werts der Rauchbegrenzung" MAP 0xD2070 Kf_Xs16_Ys16_Ws16 32.00000 lambda 0.00 32.00000 FORMAT "%8.5" EXTENDED_LIMITS -32.76800 32.76700
 /begin AXIS_DESCR STD_AXIS Eng_nAvrg EngN 16 0.00 6000.000 FORMAT "%8.3" EXTENDED_LIMITS -32768.00 32767.00 DEPOSIT ABSOLUTE /end AXIS_DESCR
 /begin AXIS_DESCR STD_AXIS ASMod_mAirPerCylCorr AirMassPerCyl 16 0.00 2500.000 FORMAT "%8.3" EXTENDED_LIMITS -3276.800 3276.700 DEPOSIT ABSOLUTE /end AXIS_DESCR
/end CHARACTERISTIC
/begin CHARACTERISTIC FlMng_dqSlpPos_C "Positive Steigung der Abklingrampe der Vollastregelung" VALUE 0xD2504 Kw_Wu32 655359.999847 RmpInjMass 0.00 655359.999847 FORMAT "%13.6" /end CHARACTERISTIC
/begin CHARACTERISTIC FlMng_dqSlpNeg_C "Negative Steigung der Abklingrampe der Vollastregelung" VALUE 0xD2508 Kw_Wu32 655359.999847 RmpInjMass 0.00 655359.999847 FORMAT "%13.6" /end CHARACTERISTIC
/begin CHARACTERISTIC FlMng_stEGTRglOff_C "Maske zur Abschaltung des Reglers bei Regenerationsbetrieb bei Abgasnachbehandlung" VALUE 0xD250C Kw_Ws32 4294967295.00 OneToOne -2147483648.00 2147483647.00 FORMAT "%13.2" /end CHARACTERISTIC
/begin CHARACTERISTIC FlMng_stGearGroupSwitch_C "Switch to determine the upper gear group and the lower gear group" VALUE 0xD22B4 Kw_Wu8 9.000 OneToOne 1.000 10.00 FORMAT "%5.2" EXTENDED_LIMITS 0.00 255.0 /end CHARACTERISTIC
/begin CHARACTERISTIC FlMng_stRgnMsk1_C "applizierbare Bitmaske für Regenerationsanforderung 1 der Abgasnachbehandlung" VALUE 0xD22B8 Kw_Wu32 2147483647.00 OneToOne 0.00 2147483647.00 FORMAT "%13.2" EXTENDED_LIMITS 0.00 4294967295.00 /end CHARACTERISTIC
/begin CHARACTERISTIC FlMng_stRgnMsk2_C "applizierbare Bitmaske für Regenerationsanforderung 2 der Abgasnachbehandlung" VALUE 0xD22BC Kw_Wu32 2147483647.00 OneToOne 0.00 2147483647.00 FORMAT "%13.2" EXTENDED_LIMITS 0.00 4294967295.00 /end CHARACTERISTIC
/begin CHARACTERISTIC FlMng_swtFullLdRglVal_C "#SSD Schalter um Volllastregelung zu (de)aktivieren" VALUE 0xD2510 Kw_Wu8 1.000 OneToOne 0.00 1.000 FORMAT "%5.3" EXTENDED_LIMITS 0.00 255.0 /end CHARACTERISTIC
/begin CHARACTERISTIC FlMng_swtFullLdRglType_C "#SSD Typ des Schalters um Volllastregelung zu (de)aktivieren" VALUE 0xD2511 Kw_Wu8 1.000 OneToOne 1.000 2.000 FORMAT "%5.3" EXTENDED_LIMITS 0.00 255.0 /end CHARACTERISTIC
/begin CHARACTERISTIC FlMng_tiAirPerCylPT1_MAP "map to get filter time constant for AFSCD_mAirPerCyl PT1 filtering" MAP 0xD22C0 Kf_Xs16_Ys16_Ws16 16.776216 TimeDelay_s_2 0.0010000129 16.777216 FORMAT "%9.6" EXTENDED_LIMITS 0.00051201563 16.777216
 /begin AXIS_DESCR STD_AXIS Eng_nAvrg EngN 8 0.00 6000.000 FORMAT "%8.3" EXTENDED_LIMITS -32768.00 32767.00 DEPOSIT ABSOLUTE /end AXIS_DESCR
 /begin AXIS_DESCR STD_AXIS PCR_pBGDev Pres_hPa 8 -5000.000 5000.000 FORMAT "%8.3" EXTENDED_LIMITS -32768.00 32767.00 DEPOSIT ABSOLUTE /end AXIS_DESCR
/end CHARACTERISTIC
/begin CHARACTERISTIC FlMng_tiDefectDead_C "Zeitverzögerung zur Erkennung eines abgefallenen Ladeluftschlauchs" VALUE 0xD2364 Kw_Wu16 655.1400 Time_s 0.00 655.1400 FORMAT "%8.4" EXTENDED_LIMITS 0.00 655.3500 /end CHARACTERISTIC
/begin CHARACTERISTIC FlMng_tiFullLdRglDel_CUR "Drehzahlabhängige Einschaltverzögerung der Vollastregelung" CURVE 0xD2512 Kl_Xs16_Ws16 327670.0 Time_ms 0.00 327670.0 FORMAT "%8.1" EXTENDED_LIMITS -327680.0 327670.0
 /begin AXIS_DESCR STD_AXIS Eng_nAvrg EngN 10 0.00 6000.000 FORMAT "%8.3" EXTENDED_LIMITS -32768.00 32767.00 DEPOSIT ABSOLUTE /end AXIS_DESCR
/end CHARACTERISTIC
/begin CHARACTERISTIC FlMng_tiPT1Neg_MAP "Kennfeld zur Ermittlung der Basisfilterzeitkonstante zur Filterung der Luftmasse bei negativer Änderung" MAP 0xD2366 Kf_Xs16_Ys16_Ws16 16.776216 TimeDelay_s_2 0.0010000129 16.777216 FORMAT "%9.6" EXTENDED_LIMITS 0.00051201563 16.777216
 /begin AXIS_DESCR STD_AXIS Eng_nAvrg EngN 8 0.00 6000.000 FORMAT "%8.3" EXTENDED_LIMITS -32768.00 32767.00 DEPOSIT ABSOLUTE /end AXIS_DESCR
 /begin AXIS_DESCR STD_AXIS PCR_pBGDev Pres_hPa 8 -5000.000 5000.000 FORMAT "%8.3" EXTENDED_LIMITS -32768.00 32767.00 DEPOSIT ABSOLUTE /end AXIS_DESCR
/end CHARACTERISTIC
/begin CHARACTERISTIC FlMng_tiPT1Pos_MAP "Kennfeld zur Ermittlung der Basisfilterzeitkonstante zur Filterung der Luftmasse bei positiver Änderung" MAP 0xD240A Kf_Xs16_Ys16_Ws16 16.776216 TimeDelay_s_2 0.0010000129 16.777216 FORMAT "%9.6" EXTENDED_LIMITS 0.00051201563 16.777216
 /begin AXIS_DESCR STD_AXIS Eng_nAvrg EngN 8 0.00 6000.000 FORMAT "%8.3" EXTENDED_LIMITS -32768.00 32767.00 DEPOSIT ABSOLUTE /end AXIS_DESCR
 /begin AXIS_DESCR STD_AXIS PCR_pBGDev Pres_hPa 8 -5000.000 5000.000 FORMAT "%8.3" EXTENDED_LIMITS -32768.00 32767.00 DEPOSIT ABSOLUTE /end AXIS_DESCR
/end CHARACTERISTIC
/begin CHARACTERISTIC FlMng_tiRmpSlp_C "Rampenlaufzeit für Mehrfachschalter EGT_RgnSwtE" VALUE 0xD24B0 Kw_Wu32 31.775030303030302 TimeEGTRmp 0.99296969696969695 32.768000000000001 FORMAT "%19.16" EXTENDED_LIMITS 0.000000015258789066052715 65.536000000000001 /end CHARACTERISTIC
/begin CHARACTERISTIC FlMng_trqEpsLim_C "halbe Intervallbreite für Abfrage der Abschaltbedingung" VALUE 0xD253C Kw_Ws16 3276.700 Trq 0.00 3276.700 FORMAT "%8.3" EXTENDED_LIMITS -3276.800 3276.700 /end CHARACTERISTIC
/begin CHARACTERISTIC FlMng_trqEps_C "Hysterese für Momentenschwellwert der Vollastregelung" VALUE 0xD253E Kw_Ws16 3276.700 Trq 0.00 3276.700 FORMAT "%8.3" EXTENDED_LIMITS -3276.800 3276.700 /end CHARACTERISTIC
/begin CHARACTERISTIC FlMng_trqThresInrDes0_C "torque threshold for dynamic smoke limitation" VALUE 0xD24B4 Kw_Ws16 1500.000 Trq -500.0000 1000.000 FORMAT "%8.3" EXTENDED_LIMITS -3276.800 3276.700 /end CHARACTERISTIC
/begin CHARACTERISTIC FlMng_trqThresInrDes1_C "torque threshold for static smoke limitation" VALUE 0xD24B6 Kw_Ws16 1500.000 Trq -500.0000 1000.000 FORMAT "%8.3" EXTENDED_LIMITS -3276.800 3276.700 /end CHARACTERISTIC
/begin CHARACTERISTIC FlMng_trqThresInrDes2_C "torque threshold for static smoke limitation" VALUE 0xD24B8 Kw_Ws16 1500.000 Trq -500.0000 1000.000 FORMAT "%8.3" EXTENDED_LIMITS -3276.800 3276.700 /end CHARACTERISTIC
/begin CHARACTERISTIC FlMng_trqThresInr_C "torque threshold for smoke limitation" VALUE 0xD24BA Kw_Ws16 1500.000 Trq -500.0000 1000.000 FORMAT "%8.3" EXTENDED_LIMITS -3276.800 3276.700 /end CHARACTERISTIC
/begin CHARACTERISTIC FlMng_tThresLmbdHigh_C "temperature threshold high for smoke limitation" VALUE 0xD24BC Kw_Ws16 250.0000 Temp_Cels -50.14000 199.8600 FORMAT "%8.4" EXTENDED_LIMITS -3549.940 3003.560 /end CHARACTERISTIC
/begin CHARACTERISTIC FlMng_tThresLmbdLow_C "temperature threshold low for smoke limitation" VALUE 0xD24BE Kw_Ws16 250.0000 Temp_Cels -50.14000 199.8600 FORMAT "%8.4" EXTENDED_LIMITS -3549.940 3003.560 /end CHARACTERISTIC
/begin CHARACTERISTIC FlSys_nDeflateMax_C "#SSD obere Drehzahlschwelle für die Entlueftung Niederdruckkreis" VALUE 0xD254C Kw_Ws16 32767.00 EngN 0.00 32767.00 FORMAT "%8.2" EXTENDED_LIMITS -32768.00 32767.00 /end CHARACTERISTIC
/begin CHARACTERISTIC FlSys_nDeflateMin_C "#SSD untere Drehzahlschwelle für die Entlueftung Niederdruckkreis" VALUE 0xD254E Kw_Ws16 32767.00 EngN 0.00 32767.00 FORMAT "%8.2" EXTENDED_LIMITS -32768.00 32767.00 /end CHARACTERISTIC
/begin CHARACTERISTIC FlSys_pDeflate_C "#SSD Raildruckschwelle für die Entlueftung Niederdruckkreis" VALUE 0xD2550 Kw_Ws16 2000.000 Pres_Rail 0.00 2000.000 FORMAT "%5.3" EXTENDED_LIMITS -3276.800 3276.700 /end CHARACTERISTIC
/begin CHARACTERISTIC FlSys_rhoFl_C "#SSD Kraftstoffdichte bei Normtemperatur" VALUE 0xD2540 Kw_Ws16 999.9000 RhoFuel 0.1000000 1000.000 FORMAT "%8.3" EXTENDED_LIMITS -3276.800 3276.700 /end CHARACTERISTIC
/begin CHARACTERISTIC FlSys_rhoFl_CUR "#SSD temperaturabhängige Kraftstoffdichte" CURVE 0xD2542 Kl_Xs16_Ws16 999.9000 RhoFuel 0.1000000 1000.000 FORMAT "%8.3" EXTENDED_LIMITS -3276.800 3276.700
 /begin AXIS_DESCR STD_AXIS FTSCD_tFuel Temp_Cels 2 -50.14000 199.8600 FORMAT "%8.4" EXTENDED_LIMITS -3549.940 3003.560 DEPOSIT ABSOLUTE /end AXIS_DESCR
/end CHARACTERISTIC
/begin CHARACTERISTIC FlSys_swtTempSel_C "Auswahl der Kraftstoffsystemtemperatur" VALUE 0xD2554 Kw_Wu8 2.000 OneToOne 0.00 2.000 FORMAT "%5.3" EXTENDED_LIMITS 0.00 255.0 /end CHARACTERISTIC
/begin CHARACTERISTIC FlSys_swtTempSensCfgVal_C "Schalterwert, ob Kraftstofftemperaturfühler vorhanden" VALUE 0xD2555 Kw_Wu8 1.000 OneToOne 0.00 1.000 FORMAT "%5.3" EXTENDED_LIMITS 0.00 255.0 /end CHARACTERISTIC
/begin CHARACTERISTIC FlSys_swtTempSensCfgType_C "#SSD Auswahl der Quelle des Softwareschalters ob Kraftstofftemperaturfühler vorhanden. (Datensatz oder EEPROM)" VALUE 0xD2556 Kw_Wu8 0.00 OneToOne 2.000 2.000 FORMAT "%5.3" EXTENDED_LIMITS 0.00 255.0 /end CHARACTERISTIC
/begin CHARACTERISTIC FlSys_tDfl_C "Ersatzwert für Kraftstoffsystemtemperatur" VALUE 0xD2558 Kw_Ws16 250.0000 Temp_Cels -50.14000 199.8600 FORMAT "%8.4" EXTENDED_LIMITS -3549.940 3003.560 /end CHARACTERISTIC
/begin CHARACTERISTIC FlSys_tiDeflateDel_C "#SSD Verzoegerungszeit für die Entlueftung Niederdruckkreis" VALUE 0xD2552 Kw_Wu16 655350.0 Time_ms 0.00 655350.0 FORMAT "%8.1" /end CHARACTERISTIC
/begin CHARACTERISTIC FMA_dfacSwtOffMax_C "Maximal zulässige Änderungsgeschwindigkeit der temperaturabhängigen Abschaltfaktoren" VALUE 0xD25F0 Kw_Wu32 50.0000007451 Rmp_Fact 0.00 50.0000007451 FORMAT "%13.10" EXTENDED_LIMITS 0.00 7999.99999814 /end CHARACTERISTIC
/begin CHARACTERISTIC FMA_dqThrs_C "Schwelle für Erkennung starker Einspritzmengenänderungen der FMA" VALUE 0xD25F4 Kw_Ws16 200.0000 InjMassSec 0.00 200.0000 FORMAT "%8.4" EXTENDED_LIMITS -327.6800 327.6700 /end CHARACTERISTIC
/begin CHARACTERISTIC FMA_drLmbdThrs_C "Schwelle für Erkennung starker Lambdaänderung der FMA" VALUE 0xD25F6 Kw_Ws16 10.20000 lambdaSec -0.2000000 10.00000 FORMAT "%8.5" EXTENDED_LIMITS -32.76800 32.76700 /end CHARACTERISTIC
/begin CHARACTERISTIC FMA_facAirSwtOff_CUR "Kennlinie des ansauglufttemperaturabhängigen Abschaltfaktors der FMA" CURVE 0xD25F8 Kl_Xs16_Ws16 1.000000 Fact 0.00 1.000000 FORMAT "%8.6" EXTENDED_LIMITS -4.000000 3.999878
 /begin AXIS_DESCR STD_AXIS IATSCD_tAir Temp_Cels 8 -50.14000 199.8600 FORMAT "%8.4" EXTENDED_LIMITS -3549.940 3003.560 DEPOSIT ABSOLUTE /end AXIS_DESCR
/end CHARACTERISTIC
/begin CHARACTERISTIC FMA_facAPSwtOff_CUR "Kennlinie des atmosphärendruckabhängigen Abschaltfaktors der FMA" CURVE 0xD261A Kl_Xs16_Ws16 1.000000 Fact 0.00 1.000000 FORMAT "%8.6" EXTENDED_LIMITS -4.000000 3.999878
 /begin AXIS_DESCR STD_AXIS APSCD_pVal Pres_hPa 8 0.00 3500.000 FORMAT "%8.3" EXTENDED_LIMITS -32768.00 32767.00 DEPOSIT ABSOLUTE /end AXIS_DESCR
/end CHARACTERISTIC
/begin CHARACTERISTIC FMA_facDensCor_C "Faktor für Dichtekorrektur bei Angabe der Kraftstoffmenge in" VALUE 0xD255A Kw_Ws16 0.1999512 Fact 0.8000488 1.000000 FORMAT "%8.6" EXTENDED_LIMITS -4.000000 3.999878 /end CHARACTERISTIC
/begin CHARACTERISTIC FMA_facEngSwtOff_CUR "Kennlinie des motortemperaturabhängigen Abschaltfaktors der FMA" CURVE 0xD263C Kl_Xs16_Ws16 1.000000 Fact 0.00 1.000000 FORMAT "%8.6" EXTENDED_LIMITS -4.000000 3.999878
 /begin AXIS_DESCR STD_AXIS Eng_tEng Temp_Cels 8 -50.14000 199.8600 FORMAT "%8.4" EXTENDED_LIMITS -3549.940 3003.560 DEPOSIT ABSOLUTE /end AXIS_DESCR
/end CHARACTERISTIC
/begin CHARACTERISTIC FMA_facFlSwtOff_CUR "Kennlinie des kraftstofftemperaturabhängigen Abschaltfaktors der FMA" CURVE 0xD265E Kl_Xs16_Ws16 1.000000 Fact 0.00 1.000000 FORMAT "%8.6" EXTENDED_LIMITS -4.000000 3.999878
 /begin AXIS_DESCR STD_AXIS FTSCD_tFuel Temp_Cels 8 -50.14000 199.8600 FORMAT "%8.4" EXTENDED_LIMITS -3549.940 3003.560 DEPOSIT ABSOLUTE /end AXIS_DESCR
/end CHARACTERISTIC
/begin CHARACTERISTIC FMA_facNQSwtOff_MAP "Kennfeld des motodrehzahl-/einspritzmengenabhängigen Abschaltfaktors der FMA für betriebsbereichsabhängige Abschaltung" MAP 0xD2560 Kf_Xs16_Ys16_Ws16 1.000000 Fact 0.00 1.000000 FORMAT "%8.6" EXTENDED_LIMITS -4.000000 3.999878
 /begin AXIS_DESCR STD_AXIS Eng_nAvrg EngN 4 0.00 8000.000 FORMAT "%8.3" EXTENDED_LIMITS -32768.00 32767.00 DEPOSIT ABSOLUTE /end AXIS_DESCR
 /begin AXIS_DESCR STD_AXIS FMA_qCtl_mp InjMass 4 0.00 200.0000 FORMAT "%8.4" EXTENDED_LIMITS -327.6800 327.6700 DEPOSIT ABSOLUTE /end AXIS_DESCR
/end CHARACTERISTIC
/begin CHARACTERISTIC FMA_IKiFst_C "Integriererverstärkung der FMA bei Kleinsignalen (schnelles Einlernen des Kennfelds)" VALUE 0xD2594 Kw_Wu32 4.00003045797 Ki 0.00 4.00003045797 FORMAT "%13.11" EXTENDED_LIMITS 0.00 999999.999767 /end CHARACTERISTIC
/begin CHARACTERISTIC FMA_IKiPosFst_C "Integriererverstärkung der FMA bei positiven Großsignalen (schnelles Einlernen des Kennfelds)" VALUE 0xD2598 Kw_Wu32 4.00003045797 Ki 0.00 4.00003045797 FORMAT "%13.11" EXTENDED_LIMITS 0.00 999999.999767 /end CHARACTERISTIC
/begin CHARACTERISTIC FMA_IKiNegFst_C "Integriererverstärkung der FMA bei negativen Großsignalen (schnelles Einlernen des Kennfelds)" VALUE 0xD259C Kw_Wu32 4.00003045797 Ki 0.00 4.00003045797 FORMAT "%13.11" EXTENDED_LIMITS 0.00 999999.999767 /end CHARACTERISTIC
/begin CHARACTERISTIC FMA_qIWinPosFst_C "Obere Kleinsignalgrenze für Integratoren der FMA (schnelles Einlernen des Kennfelds)" VALUE 0xD25A0 Kw_Ws16 20.00000 InjMass 0.00 20.00000 FORMAT "%8.5" EXTENDED_LIMITS -327.6800 327.6700 /end CHARACTERISTIC
/begin CHARACTERISTIC FMA_qIWinNegFst_C "Untere Kleinsignalgrenze für Integratoren der FMA (schnelles Einlernen des Kennfelds)" VALUE 0xD25A2 Kw_Ws16 20.00000 InjMass -20.00000 0.00 FORMAT "%8.5" EXTENDED_LIMITS -327.6800 327.6700 /end CHARACTERISTIC
/begin CHARACTERISTIC FMA_IKiSlw_C "Integriererverstärkung der FMA bei Kleinsignalen (langsames Einlernen des Kennfelds)" VALUE 0xD25A4 Kw_Wu32 4.00003045797 Ki 0.00 4.00003045797 FORMAT "%13.11" EXTENDED_LIMITS 0.00 999999.999767 /end CHARACTERISTIC
/begin CHARACTERISTIC FMA_IKiPosSlw_C "Integriererverstärkung der FMA bei positiven Großsignalen (langsames Einlernen des Kennfelds)" VALUE 0xD25A8 Kw_Wu32 4.00003045797 Ki 0.00 4.00003045797 FORMAT "%13.11" EXTENDED_LIMITS 0.00 999999.999767 /end CHARACTERISTIC
/begin CHARACTERISTIC FMA_IKiNegSlw_C "Integriererverstärkung der FMA bei negativen Großsignalen (langsames Einlernen des Kennfelds)" VALUE 0xD25AC Kw_Wu32 4.00003045797 Ki 0.00 4.00003045797 FORMAT "%13.11" EXTENDED_LIMITS 0.00 999999.999767 /end CHARACTERISTIC
/begin CHARACTERISTIC FMA_qIWinPosSlw_C "Obere Kleinsignalgrenze für Integratoren der FMA (langsames Einlernen des Kennfelds)" VALUE 0xD25B0 Kw_Ws16 20.00000 InjMass 0.00 20.00000 FORMAT "%8.5" EXTENDED_LIMITS -327.6800 327.6700 /end CHARACTERISTIC
/begin CHARACTERISTIC FMA_qIWinNegSlw_C "Untere Kleinsignalgrenze für Integratoren der FMA (langsames Einlernen des Kennfelds)" VALUE 0xD25B2 Kw_Ws16 20.00000 InjMass -20.00000 0.00 FORMAT "%8.5" EXTENDED_LIMITS -327.6800 327.6700 /end CHARACTERISTIC
/begin CHARACTERISTIC FMA_nGrid_C "Vektor der Drehzahlwerte der Kennfeldstützstellen" VAL_BLK 0xD25B4 Kwb_Ws16 4000.000 EngN 0.00 4000.000 FORMAT "%8.3" EXTENDED_LIMITS -32768.00 32767.00 NUMBER 8 /end CHARACTERISTIC
/begin CHARACTERISTIC FMA_nThrs_C "Drehzahlschwelle für Schuberkennung der FMA" VALUE 0xD2680 Kw_Ws16 5960.000 EngN 40.00000 6000.000 FORMAT "%8.3" EXTENDED_LIMITS -32768.00 32767.00 /end CHARACTERISTIC
/begin CHARACTERISTIC FMA_numNGrid_C "Anzahl der Drehzahlstützstellen des adaptiven Kenfelds" VALUE 0xD25C4 Kw_Wu8 6.000 OneToOne 2.000 8.000 FORMAT "%5.3" EXTENDED_LIMITS 0.00 255.0 /end CHARACTERISTIC
/begin CHARACTERISTIC FMA_numQGrid_C "Anzahl der Mengenstützstellen des adaptiven Kenfelds" VALUE 0xD25C5 Kw_Wu8 6.000 OneToOne 2.000 8.000 FORMAT "%5.3" EXTENDED_LIMITS 0.00 255.0 /end CHARACTERISTIC
/begin CHARACTERISTIC FMA_tiPT1Fst_C "Zeitkonstante der PT1-Filter zur Filterung des aktuellen Mengenfehlers (schnelles Einlernen des Kennfelds)" VALUE 0xD25C8 Kw_Wu32 4294.9663 TimeDelay_s 0.0010000001 4294.9673 FORMAT "%9.4" EXTENDED_LIMITS 0.0000010000000 4294.9673 /end CHARACTERISTIC
/begin CHARACTERISTIC FMA_tiPT1Slw_C "Zeitkonstante der PT1-Filter zur Filterung des aktuellen Mengenfehlers (langsames Einlernen des Kennfelds)" VALUE 0xD25CC Kw_Wu32 4294.9663 TimeDelay_s 0.0010000001 4294.9673 FORMAT "%9.4" EXTENDED_LIMITS 0.0000010000000 4294.9673 /end CHARACTERISTIC
/begin CHARACTERISTIC FMA_qGrid_C "Vektor der Mengenwerte der Kennfeldstützstellen" VAL_BLK 0xD25D0 Kwb_Ws16 80.00000 InjMass -40.00000 40.00000 FORMAT "%8.5" EXTENDED_LIMITS -327.6800 327.6700 NUMBER 8 /end CHARACTERISTIC
/begin CHARACTERISTIC FMA_qIntMax_C "Maximal zulässiger Wert für adaptierte Mengenfehler in den Lernpunkten , d.h. für Zustände der Integratoren und PT1-Glieder" VALUE 0xD25E0 Kw_Ws16 80.00000 InjMass -40.00000 40.00000 FORMAT "%8.5" EXTENDED_LIMITS -327.6800 327.6700 /end CHARACTERISTIC
/begin CHARACTERISTIC FMA_qIntMin_C "Minimal zulässiger Wert für adaptierte Mengenfehler in den Lernpunkten , d.h. für Zustände der Integratoren und PT1-Glieder" VALUE 0xD25E2 Kw_Ws16 80.00000 InjMass -40.00000 40.00000 FORMAT "%8.5" EXTENDED_LIMITS -327.6800 327.6700 /end CHARACTERISTIC
/begin CHARACTERISTIC FMA_qMax_C "Oberer Grenzwert für Einspritzmengenkorrektur der FMA" VALUE 0xD25E4 Kw_Ws16 80.00000 InjMass -40.00000 40.00000 FORMAT "%8.5" EXTENDED_LIMITS -327.6800 327.6700 /end CHARACTERISTIC
/begin CHARACTERISTIC FMA_qMin_C "Unterer Grenzwert für Einspritzmengenkorrektur der FMA" VALUE 0xD25E6 Kw_Ws16 80.00000 InjMass -40.00000 40.00000 FORMAT "%8.5" EXTENDED_LIMITS -327.6800 327.6700 /end CHARACTERISTIC
/begin CHARACTERISTIC FMA_qThrs_C "Einspritzmengenschwelle für Schuberkennung der FMA" VALUE 0xD2682 Kw_Ws16 40.00000 InjMass 0.00 40.00000 FORMAT "%8.5" EXTENDED_LIMITS -327.6800 327.6700 /end CHARACTERISTIC
/begin CHARACTERISTIC FMA_rLmbdThrsMax_C "Obere Grenze des für FMA zulässigen Lambdabereichs" VALUE 0xD2684 Kw_Ws16 10.20000 lambda -0.2000000 10.00000 FORMAT "%8.5" EXTENDED_LIMITS -32.76800 32.76700 /end CHARACTERISTIC
/begin CHARACTERISTIC FMA_rLmbdThrsMin_C "Untere Grenze des für FMA zulässigen Lambdabereichs" VALUE 0xD2686 Kw_Ws16 10.20000 lambda -0.2000000 10.00000 FORMAT "%8.5" EXTENDED_LIMITS -32.76800 32.76700 /end CHARACTERISTIC
/begin CHARACTERISTIC FMA_stRgnMsk_C "Bitmaske zur Abschaltung der FMA bei bestimmten Regenerationszuständen EGT_st" VALUE 0xD2688 Kw_Wu32 4294967295.00 OneToOne 0.00 4294967295.00 FORMAT "%13.2" /end CHARACTERISTIC
/begin CHARACTERISTIC FMA_swtIC_C "Schalter für Betriebsartauswahl der FMA (Indirect Control - Direct Control)" VALUE 0xD255C Kw_Wu8 1.000 OneToOne 0.00 1.000 FORMAT "%5.3" EXTENDED_LIMITS 0.00 255.0 READ_ONLY /end CHARACTERISTIC
/begin CHARACTERISTIC FMA_swtOnFMA_C "Schalter zum Ein-/Ausschalten der gesamten FMA" VALUE 0xD268C Kw_Wu8 1.000 OneToOne 0.00 1.000 FORMAT "%5.3" EXTENDED_LIMITS 0.00 255.0 /end CHARACTERISTIC
/begin CHARACTERISTIC FMA_swtRst_C "Schalter zur Reinitialisierung des Fehlermodells" VALUE 0xD25E8 Kw_Wu8 1.000 OneToOne 0.00 1.000 FORMAT "%5.3" EXTENDED_LIMITS 0.00 255.0 /end CHARACTERISTIC
/begin CHARACTERISTIC FMA_tiDLmbdThrs_C "Wartezeit bis der FMA- Lambdaänderungsstatus nach Ende der Lambdaänderung zurückgesetzt wird" VALUE 0xD268E Kw_Wu16 20.00000 Time_s 0.00 20.00000 FORMAT "%8.5" EXTENDED_LIMITS 0.00 655.3500 /end CHARACTERISTIC
/begin CHARACTERISTIC FMA_tiDynThrs_C "Wartezeit bis der FMA-Einspritzmengendynamikstatus nach Ende der Einspritzmengenänderung zurückgesetzt wird" VALUE 0xD2690 Kw_Wu16 20.00000 Time_s 0.00 20.00000 FORMAT "%8.5" EXTENDED_LIMITS 0.00 655.3500 /end CHARACTERISTIC
/begin CHARACTERISTIC FMA_tiFaultRmp_C "Dauer des rampenförmigen Abschaltens der FMA bei schweren Systemfehlern" VALUE 0xD2694 Kw_Wu32 40.0000000000 Time_s 0.00 40.0000000000 FORMAT "%13.10" EXTENDED_LIMITS 0.00 42949672.9500 /end CHARACTERISTIC
/begin CHARACTERISTIC FMA_tiLmbdDT1_C "Verzögerungszeitkonstante der Differentiation von Lambda in der FMA" VALUE 0xD2698 Kw_Wu32 3.9980385 TimeDelay_s 0.0010000001 3.9990385 FORMAT "%9.7" EXTENDED_LIMITS 0.0000010000000 4294.9673 /end CHARACTERISTIC
/begin CHARACTERISTIC FMA_tiLmbdThrs_C "Wartezeit bis der FMA- Lambdabereichstatus nach Bereichs-verletzung zurückgesetzt wird" VALUE 0xD269C Kw_Wu16 20.00000 Time_s 0.00 20.00000 FORMAT "%8.5" EXTENDED_LIMITS 0.00 655.3500 /end CHARACTERISTIC
/begin CHARACTERISTIC FMA_tiOvrRun_C "Wartezeit bis der FMA-Schbstatus nach Schubende zurückgesetzt wird" VALUE 0xD269E Kw_Wu16 20.00000 Time_s 0.00 20.00000 FORMAT "%8.5" EXTENDED_LIMITS 0.00 655.3500 /end CHARACTERISTIC
/begin CHARACTERISTIC FMA_tiQDT1_C "Vezögerungszeitkonstante der Differentiation der Einspritzmenge für Erkennung starker Mengenänderungen der FMA" VALUE 0xD26A0 Kw_Wu32 3.9980385 TimeDelay_s 0.0010000001 3.9990385 FORMAT "%9.7" EXTENDED_LIMITS 0.0000010000000 4294.9673 /end CHARACTERISTIC
/begin CHARACTERISTIC FMA_tiQLmbd_C "Verzögerungszeit nach einer Resetierung um die Adaption zuzulassen" VALUE 0xD26A4 Kw_Wu16 20.00000 Time_s 0.00 20.00000 FORMAT "%8.5" EXTENDED_LIMITS 0.00 655.3500 /end CHARACTERISTIC
/begin CHARACTERISTIC FMA_tiSwtPar_C "Betriebszeit der FMA, nach der von schnellem auf langsames Lernen umgeschaltet wird" VALUE 0xD25EC Kw_Ws32 1000000.00000 Time_s 0.00 1000000.00000 FORMAT "%13.5" EXTENDED_LIMITS -21474836.4800 21474836.4700 /end CHARACTERISTIC
/begin CHARACTERISTIC FMTC_dqtrq2qBasRmpUp_C "Positiver Rampengradient" VALUE 0xD26A8 Kw_Wu32 655359.999847 RmpInjMass 0.00 655359.999847 FORMAT "%13.6" /end CHARACTERISTIC
/begin CHARACTERISTIC FMTC_dqtrq2qBasRmpDwn_C "Negativer Rampengradient" VALUE 0xD26AC Kw_Wu32 655359.999847 RmpInjMass 0.00 655359.999847 FORMAT "%13.6" /end CHARACTERISTIC
/begin CHARACTERISTIC FMTC_eta0_C "fester Wirkungsgradfaktor zur Umrechnung Startmoment in Startmenge" VALUE 0xD26B0 Kw_Ws16 100.0000 Eta 0.00 100.0000 FORMAT "%8.4" EXTENDED_LIMITS -256.0000 255.9922 /end CHARACTERISTIC
/begin CHARACTERISTIC FMTC_facAirCorr_CUR "Gewichtungsfaktor der Eta-Korrektur für die Abweichug der Luft pro Zylinder vom Referenzwert" CURVE 0xD3270 Kl_Xs16_Ws16 503.9999 Fact -500.0000 3.999878 FORMAT "%8.4" EXTENDED_LIMITS -4.000000 3.999878
 /begin AXIS_DESCR STD_AXIS CoEng_trqInrSet Trq 8 -3276.800 3276.700 FORMAT "%8.3" DEPOSIT ABSOLUTE /end AXIS_DESCR
/end CHARACTERISTIC
/begin CHARACTERISTIC FMTC_facAirCorr_MAP "eta correction for start of injection, base value" MAP 0xD3292 Kf_Xs16_Ys16_Ws16 10.00000 Fact 0.00 10.00000 FORMAT "%8.5" EXTENDED_LIMITS -4.000000 3.999878
 /begin AXIS_DESCR STD_AXIS Eng_nAvrg EngN 8 0.00 6000.000 FORMAT "%8.3" EXTENDED_LIMITS -32768.00 32767.00 DEPOSIT ABSOLUTE /end AXIS_DESCR
 /begin AXIS_DESCR STD_AXIS FMTC_mAirDiff_mp AirMassPerCyl 8 -30.00000 30.00000 FORMAT "%8.5" EXTENDED_LIMITS -3276.800 3276.700 DEPOSIT ABSOLUTE /end AXIS_DESCR
/end CHARACTERISTIC
/begin CHARACTERISTIC FMTC_facStrtInjCorr_CUR "Eta-Korrektur für die Abweichug des Spritzbeginns vom Referenzwert, Gewichtungsfaktor" CURVE 0xD3336 Kl_Xs16_Ws16 3.999878 Fact 0.00 3.999878 FORMAT "%8.6" EXTENDED_LIMITS -4.000000 3.999878
 /begin AXIS_DESCR STD_AXIS CoEng_trqInrSet Trq 8 -500.0000 1000.000 FORMAT "%8.3" EXTENDED_LIMITS -3276.800 3276.700 DEPOSIT ABSOLUTE /end AXIS_DESCR
/end CHARACTERISTIC
/begin CHARACTERISTIC FMTC_facStrtInjCorr_MAP "eta correction for start of injection, base value" MAP 0xD3358 Kf_Xs16_Ys16_Ws16 10.00000 Fact 0.00 10.00000 FORMAT "%8.5" EXTENDED_LIMITS -4.000000 3.999878
 /begin AXIS_DESCR STD_AXIS Eng_nAvrg EngN 8 0.00 6000.000 FORMAT "%8.3" EXTENDED_LIMITS -32768.00 32767.00 DEPOSIT ABSOLUTE /end AXIS_DESCR
 /begin AXIS_DESCR STD_AXIS FMTC_phiStrtInjDiff_mp AngleCrS 8 -30.00000 30.00000 FORMAT "%8.5" EXTENDED_LIMITS -768.0000 767.9766 DEPOSIT ABSOLUTE /end AXIS_DESCR
/end CHARACTERISTIC
/begin CHARACTERISTIC FMTC_mAirOpt_MAP "optimale Frischluftmasse  (bzgl. Wirkungsgrad)" MAP 0xD33FC Kf_Xs16_Ys16_Ws16 3276.700 AirMassPerCyl 0.00 3276.700 FORMAT "%8.3" EXTENDED_LIMITS -3276.800 3276.700
 /begin AXIS_DESCR STD_AXIS Eng_nAvrg EngN 16 0.00 6000.000 FORMAT "%8.3" EXTENDED_LIMITS -32768.00 32767.00 DEPOSIT ABSOLUTE /end AXIS_DESCR
 /begin AXIS_DESCR STD_AXIS CoEng_trqInrSet Trq 16 -500.0000 1000.000 FORMAT "%8.3" EXTENDED_LIMITS -3276.800 3276.700 DEPOSIT ABSOLUTE /end AXIS_DESCR
/end CHARACTERISTIC
/begin CHARACTERISTIC FMTC_phiStrtInjOpt_MAP "Eta-Korrektur, Referenzwert für den Spritzbeginn" MAP 0xD3640 Kf_Xs16_Ys16_Ws16 60.00000 AngleCrS -30.00000 30.00000 FORMAT "%8.5" EXTENDED_LIMITS -768.0000 767.9766
 /begin AXIS_DESCR STD_AXIS Eng_nAvrg EngN 16 0.00 6000.000 FORMAT "%8.3" EXTENDED_LIMITS -32768.00 32767.00 DEPOSIT ABSOLUTE /end AXIS_DESCR
 /begin AXIS_DESCR STD_AXIS CoEng_trqInrSet Trq 16 -500.0000 1000.000 FORMAT "%8.3" EXTENDED_LIMITS -3276.800 3276.700 DEPOSIT ABSOLUTE /end AXIS_DESCR
/end CHARACTERISTIC
/begin CHARACTERISTIC FMTC_stRgnMsk1_C "applizierbare Bitmaske für Regenerationsstatus 1" VALUE 0xD26B4 Kw_Wu32 4294967295.00 OneToOne 0.00 4294967295.00 FORMAT "%13.2" /end CHARACTERISTIC
/begin CHARACTERISTIC FMTC_stRgnMsk2_C "applizierbare Bitmaske für Regenerationsstatus 2" VALUE 0xD26B8 Kw_Wu32 4294967295.00 OneToOne 0.00 4294967295.00 FORMAT "%13.2" /end CHARACTERISTIC
/begin CHARACTERISTIC FMTC_swtCorr_C "Softwareschalter Aktivieren/Deaktivieren der Wirkungsgradkorrektur" VALUE 0xD3884 Kw_Wu8 3.000 OneToOne 0.00 3.000 FORMAT "%5.3" EXTENDED_LIMITS 0.00 255.0 /end CHARACTERISTIC
/begin CHARACTERISTIC FMTC_tiRmpSlp_C "Rampenlaufzeit für Mehrfachschalter" VALUE 0xD26BC Kw_Wu16 65.435945038 TimeEGTRmp 0.10005496183 65.536000000 FORMAT "%12.9" EXTENDED_LIMITS 0.0010000152590 65.536000000 /end CHARACTERISTIC
/begin CHARACTERISTIC FMTC_trq2qBasCBOpn_MAP "Basis-Grundkennfeld fuer Drehmoment zu q Umwandlung bei geoeffnetem Verdichterbypass" MAP 0xD26BE Kf_Xs16_Ys16_Ws16 327.6700 InjMassCyc 0.00 327.6700 FORMAT "%8.4" EXTENDED_LIMITS -327.6800 327.6700
 /begin AXIS_DESCR STD_AXIS Eng_nAvrg EngN 16 0.00 6000.000 FORMAT "%8.3" EXTENDED_LIMITS -32768.00 32767.00 DEPOSIT ABSOLUTE /end AXIS_DESCR
 /begin AXIS_DESCR STD_AXIS CoEng_trqInrSet Trq 16 -500.0000 1000.000 FORMAT "%8.3" EXTENDED_LIMITS -3276.800 3276.700 DEPOSIT ABSOLUTE /end AXIS_DESCR
/end CHARACTERISTIC
/begin CHARACTERISTIC FMTC_trq2qBas_MAP "#SSD Grundkennfeld für Moment/Menge Umrechnung als Funktion des Arbeitspunktes" MAP 0xD2902 Kf_Xs16_Ys16_Ws16 327.6700 InjMassCyc 0.00 327.6700 FORMAT "%8.4" EXTENDED_LIMITS -327.6800 327.6700
 /begin AXIS_DESCR STD_AXIS Eng_nAvrg EngN 24 0.00 6000.000 FORMAT "%8.3" EXTENDED_LIMITS -32768.00 32767.00 DEPOSIT ABSOLUTE /end AXIS_DESCR
 /begin AXIS_DESCR STD_AXIS CoEng_trqInrSet Trq 24 -500.0000 1000.000 FORMAT "%8.3" EXTENDED_LIMITS -3276.800 3276.700 DEPOSIT ABSOLUTE /end AXIS_DESCR
/end CHARACTERISTIC
/begin CHARACTERISTIC FMTC_trq2qRgn1_MAP "#SSD Grundkennfeld für Moment-/Mengenumrechnung unter Regenerationsanforderung 1 der Abgasnachbehandlung" MAP 0xD2DE6 Kf_Xs16_Ys16_Ws16 327.6700 InjMassCyc 0.00 327.6700 FORMAT "%8.4" EXTENDED_LIMITS -327.6800 327.6700
 /begin AXIS_DESCR STD_AXIS Eng_nAvrg EngN 16 0.00 6000.000 FORMAT "%8.3" EXTENDED_LIMITS -32768.00 32767.00 DEPOSIT ABSOLUTE /end AXIS_DESCR
 /begin AXIS_DESCR STD_AXIS CoEng_trqInrSet Trq 16 -500.0000 1000.000 FORMAT "%8.3" EXTENDED_LIMITS -3276.800 3276.700 DEPOSIT ABSOLUTE /end AXIS_DESCR
/end CHARACTERISTIC
/begin CHARACTERISTIC FMTC_trq2qRgn2_MAP "#SSD Grundkennfeld für Moment-/Mengenumrechnung unter Regenerationsanforderung 2 der Abgasnachbehandlung" MAP 0xD302A Kf_Xs16_Ys16_Ws16 327.6700 InjMassCyc 0.00 327.6700 FORMAT "%8.4" EXTENDED_LIMITS -327.6800 327.6700
 /begin AXIS_DESCR STD_AXIS Eng_nAvrg EngN 16 0.00 6000.000 FORMAT "%8.3" EXTENDED_LIMITS -32768.00 32767.00 DEPOSIT ABSOLUTE /end AXIS_DESCR
 /begin AXIS_DESCR STD_AXIS CoEng_trqInrSet Trq 16 -500.0000 1000.000 FORMAT "%8.3" EXTENDED_LIMITS -3276.800 3276.700 DEPOSIT ABSOLUTE /end AXIS_DESCR
/end CHARACTERISTIC
/begin MEASUREMENT ErLpCD_OrdGlwLmp "Message vom Fehlerlampen Handler and Glühzeitsteuerung, steuert die Glühlampe bei Systemlampenfehlern an." UBYTE OneToOne 1 100 0.00 255.0 FORMAT "%5.1" ECU_ADDRESS 0x7F883D /end MEASUREMENT
/begin MEASUREMENT ErLpCD_stMil "Gesamtatus der MIL und Status der Aktivierungsquellen" UBYTE OneToOne 1 100 0.00 255.0 FORMAT "%5.1" ECU_ADDRESS 0x7F883E /end MEASUREMENT
/begin MEASUREMENT ErLpCD_stMilLmpTst "status of the MIL due the lamp test" UBYTE OneToOne 1 100 0.00 255.0 FORMAT "%5.1" ECU_ADDRESS 0x7F883F /end MEASUREMENT
/begin MEASUREMENT ErLpCD_stMilReq "Status der externen MIL Ansteuerungs Anforderung (Achtung: wechselt während der Ansteuerung dauernd den Zustand)" UBYTE OneToOne 1 100 0.00 255.0 FORMAT "%5.1" ECU_ADDRESS 0x7F8840 /end MEASUREMENT
/begin MEASUREMENT ErLpCD_stSysLmp "Gesamtatus der System Lampe und Status der Aktivierungsquellen" UBYTE OneToOne 1 100 0.00 255.0 FORMAT "%5.1" ECU_ADDRESS 0x7F8841 /end MEASUREMENT
/begin MEASUREMENT ErLpCD_stSysLmpReq "Status der externen Systemlampen  Ansteuerungs Anforderung (Achtung: wechselt während der Ansteuerung dauernd den Zustand)" UBYTE OneToOne 1 100 0.00 255.0 FORMAT "%5.1" ECU_ADDRESS 0x7F8842 /end MEASUREMENT
/begin MEASUREMENT ErLpCD_stTstMIL_mp "Testzustand und Fehlerspeicheranforderung der MIL" UBYTE OneToOne 1 100 0.00 255.0 FORMAT "%5.1" ECU_ADDRESS 0x8FEDDE /end MEASUREMENT
/begin MEASUREMENT ErLpCD_stTstSysLmp_mp "Testzustand und Anforderung durch Fehlerspeicher für Systemlampe" UBYTE OneToOne 1 100 0.00 255.0 FORMAT "%5.1" ECU_ADDRESS 0x8FEDDF /end MEASUREMENT
/begin MEASUREMENT ESS_nBattMin "Leerlaufdrehzahl wegen schwacher Batterie" SWORD EngN 1 100 -32768.00 32767.00 FORMAT "%8.2" ECU_ADDRESS 0x7F8BEE /end MEASUREMENT
/begin MEASUREMENT ESS_nMax "Hoechstdrehzahl für ESS" SWORD EngN 1 100 -32768.00 32767.00 FORMAT "%8.2" ECU_ADDRESS 0x7F8BF0 /end MEASUREMENT
/begin MEASUREMENT ESS_nMin "Leerlaufdrehzahl aus ESS" SWORD EngN 1 100 -32768.00 32767.00 FORMAT "%8.2" ECU_ADDRESS 0x7F8BF2 /end MEASUREMENT
/begin MEASUREMENT ESS_pwrDes "Leistungsbedarf aller Aggregate des Bordnetzes" SWORD Pwr 1 100 -308831.1 308821.7 FORMAT "%8.1" ECU_ADDRESS 0x7F8BF4 /end MEASUREMENT
/begin MEASUREMENT ESS_pwrLead "Vorhaltleistung des el. Bordnetzes" SWORD Pwr 1 100 -308831.1 308821.7 FORMAT "%8.1" ECU_ADDRESS 0x7F8BF6 /end MEASUREMENT
/begin MEASUREMENT ETClb_ctInjCycl_mp "Aktuelle Anzahl der Einspritzzyklen für die Ansteuerdauerkalibrierung" UWORD OneToOne 1 100 0.00 65535.00 FORMAT "%8.2" ECU_ADDRESS 0x8FEE44 /end MEASUREMENT
/begin MEASUREMENT ETClb_ctLrn_mp "Lernzykluszähler für jeden Raildruck-Kalibrierpunkt der Ansteuerdauerkalibrierung" UWORD OneToOne 1 100 0.00 65535.00 FORMAT "%8.2" ARRAY_SIZE 3 ECU_ADDRESS 0x8FEDE0 /end MEASUREMENT
/begin MEASUREMENT ETClb_dtiETFlt0_mp "Gefilterte Ansteuerdauerdifferenz der Ansteuerdauerkalibrierung für jeden Zylinder beim Raildruck-Kalibrierpunkt 0" SWORD InjTime_us 1 100 -32768.00 32767.00 FORMAT "%8.2" ARRAY_SIZE 6 ECU_ADDRESS 0x8FEDE6 /end MEASUREMENT
/begin MEASUREMENT ETClb_dtiETFlt1_mp "Gefilterte Ansteuerdauerdifferenz der Ansteuerdauerkalibrierung für jeden Zylinder beim Raildruck-Kalibrierpunkt 1" SWORD InjTime_us 1 100 -32768.00 32767.00 FORMAT "%8.2" ARRAY_SIZE 6 ECU_ADDRESS 0x8FEDF2 /end MEASUREMENT
/begin MEASUREMENT ETClb_dtiETFlt2_mp "Gefilterte Ansteuerdauerdifferenz der Ansteuerdauerkalibrierung für jeden Zylinder beim Raildruck-Kalibrierpunkt 2" SWORD InjTime_us 1 100 -32768.00 32767.00 FORMAT "%8.2" ARRAY_SIZE 6 ECU_ADDRESS 0x8FEDFE /end MEASUREMENT
/begin MEASUREMENT ETClb_numCylCur_mp "Aktueller Zylinder für die Ansteuerdauerkalibrierung bei jedem Raildruck-Kalibrierpunkt" UBYTE OneToOne 1 100 0.00 255.0 FORMAT "%5.1" ARRAY_SIZE 3 ECU_ADDRESS 0x8FEE0A /end MEASUREMENT
/begin MEASUREMENT ETClb_numPres_mp "Aktueller Raildruck-Kalibrierpunkt der Ansteuerdauerkalibrierung" UBYTE OneToOne 1 100 0.00 255.0 FORMAT "%5.1" ECU_ADDRESS 0x8FEE46 /end MEASUREMENT
/begin MEASUREMENT ETClb_numRailPresClbPnt_mp "Anzahl der Raildruck-Kalibrierpunkte für die Ansteuerdauerkalibrierung" UBYTE OneToOne 1 100 0.00 255.0 FORMAT "%5.1" ECU_ADDRESS 0x8FEE47 /end MEASUREMENT
/begin MEASUREMENT ETClb_stCor "Statusanzeige der Freigaben für die Ansteuerdauerkorrektur der Nullmengenkalibrierung" UBYTE OneToOne 1 100 0.00 255.0 FORMAT "%5.1" ECU_ADDRESS 0x7F8825 /end MEASUREMENT
/begin MEASUREMENT ETClb_stDemCor_mp "Anforderung der Ansteuerdauerkorrektur der Ansteuerdauerkalibrierung" UBYTE OneToOne 1 100 0.00 255.0 FORMAT "%5.1" ECU_ADDRESS 0x8FEE48 /end MEASUREMENT
/begin MEASUREMENT ETClb_stEvalResult_mp "Ergebnis der Ansteuerdauerkalibrierungs-Einspritzungen" UBYTE ETClb_Eval_Rslt 1 100 0.00 2.00000000000 FORMAT "%13.11" ECU_ADDRESS 0x8FEE4C /end MEASUREMENT
/begin MEASUREMENT ETClb_stEval_mp "Zustand des Zustandsautomaten zur Auswertung der Ansteuerdauerkalibrierung" UBYTE ETClb_Eval_State 1 100 0.00 2.00000000000 FORMAT "%13.11" ARRAY_SIZE 3 ECU_ADDRESS 0x8FEE49 /end MEASUREMENT
/begin MEASUREMENT ETClb_stRlsCylCor_mp "Zylinderspezifische Freigabe der Ansteuerdauerkorrektur der Ansteuerdauerkalibrierung" UBYTE OneToOne 1 100 0.00 255.0 FORMAT "%5.1" ECU_ADDRESS 0x6F8085 /end MEASUREMENT
/begin MEASUREMENT ETClb_st_mp "Zustand der Ansteuerdauerkalibrierung" UBYTE ETClb_State 1 100 0.00 3.00000000000 FORMAT "%13.11" ECU_ADDRESS 0x6F8086 /end MEASUREMENT
/begin MEASUREMENT ETClb_swtCorActv "SW-Schalter zur Aktivierung der Ansteuerdauerkorrektur der Nullmengenkalibrierung" UBYTE OneToOne 1 100 0.00 255.0 FORMAT "%5.1" ECU_ADDRESS 0x7F8826 /end MEASUREMENT
/begin MEASUREMENT ETClb_swtQckClb_mp "Anzeiger der Umschaltung auf schnelle Ansteuerdauerkalibrierung" UBYTE OneToOne 1 100 0.00 255.0 FORMAT "%5.1" ECU_ADDRESS 0x8FEE0D /end MEASUREMENT
/begin MEASUREMENT ETClb_tiETCor0_mp "Ansteuerdauerkorrekturwert der Ansteuerdauer-Kalibrierung für den Raildruck-Kalibrierpunkt 0" SWORD InjTime_us 1 100 -32768.00 32767.00 FORMAT "%8.2" ARRAY_SIZE 6 ECU_ADDRESS 0x8FEE0E /end MEASUREMENT
/begin MEASUREMENT ETClb_tiETCor1_mp "Ansteuerdauerkorrekturwert der Ansteuerdauer-Kalibrierung für den Raildruck-Kalibrierpunkt 1" SWORD InjTime_us 1 100 -32768.00 32767.00 FORMAT "%8.2" ARRAY_SIZE 6 ECU_ADDRESS 0x8FEE1A /end MEASUREMENT
/begin MEASUREMENT ETClb_tiETCor2_mp "Ansteuerdauerkorrekturwert der Ansteuerdauer-Kalibrierung für den Raildruck-Kalibrierpunkt 2" SWORD InjTime_us 1 100 -32768.00 32767.00 FORMAT "%8.2" ARRAY_SIZE 6 ECU_ADDRESS 0x8FEE26 /end MEASUREMENT
/begin MEASUREMENT ETClb_tiETCur_mp "Aktuelle Ansteuerdauer der Ansteuerdauer-Kalibrierung für jeden Raildruck-Kalibrierpunkt" SWORD InjTime_us 1 100 -32768.00 32767.00 FORMAT "%8.2" ARRAY_SIZE 3 ECU_ADDRESS 0x8FEE32 /end MEASUREMENT
/begin MEASUREMENT ETClb_tiETMinEff_mp "Ansteuerdauer der Nullmenge des aktuellen Zylinder fuer jeden Raildruck-Kalibrierpunkt" SWORD InjTime_us 1 100 -32768.00 32767.00 FORMAT "%8.2" ARRAY_SIZE 3 ECU_ADDRESS 0x8FEE38 /end MEASUREMENT
/begin MEASUREMENT ETClb_tiETZFCCor_mp "Ansteuerdauer für die Überwachung der gefilterten Ansteurdauerdifferenzen der Nullmengenkalibrierung" SWORD InjTime_us 1 100 -32768.00 32767.00 FORMAT "%8.2" ARRAY_SIZE 3 ECU_ADDRESS 0x8FEE3E /end MEASUREMENT
/begin MEASUREMENT FanCD_dcycRaw_mp "fanspeed transfered to dutycycle" SWORD DtyCyc 1 100 -327.6800 327.6700 FORMAT "%8.4" ECU_ADDRESS 0x6F8088 /end MEASUREMENT
/begin MEASUREMENT FanCtl_dcycAftRun_mp "Tastverhältnis im Nachlauf" SWORD DtyCyc 1 100 -327.6800 327.6700 FORMAT "%8.4" ECU_ADDRESS 0x8FEE4E /end MEASUREMENT
/begin MEASUREMENT FanCtl_dcycBattCor_mp "TV nach Batt-Korr. und Hysteresefunktion" SWORD DtyCyc 1 100 -327.6800 327.6700 FORMAT "%8.4" ECU_ADDRESS 0x8FEE50 /end MEASUREMENT
/begin MEASUREMENT FanCtl_dcycHysStart_mp "Startwert der Hysterese" SWORD DtyCyc 1 100 -327.6800 327.6700 FORMAT "%8.4" ECU_ADDRESS 0x8FEE52 /end MEASUREMENT
/begin MEASUREMENT FanCtl_dcycHys_mp "TV am Ausgang der Hysteresefunktion" SWORD DtyCyc 1 100 -327.6800 327.6700 FORMAT "%8.4" ECU_ADDRESS 0x8FEE54 /end MEASUREMENT
/begin MEASUREMENT FanCtl_dcycOut "Tastverhältnis, Lüfter" SWORD DtyCyc 1 100 -327.6800 327.6700 FORMAT "%8.4" ECU_ADDRESS 0x7F8C5A /end MEASUREMENT
/begin MEASUREMENT FanCtl_dcycRaw_mp "Tastverhältnis Rohwert" SWORD DtyCyc 1 100 -327.6800 327.6700 FORMAT "%8.4" ECU_ADDRESS 0x8FEE56 /end MEASUREMENT
/begin MEASUREMENT FanCtl_facWghFctr_mp "weighting factor for fanspeed from CAN" SWORD Fact 1 100 -4.000000 3.999878 FORMAT "%8.6" ECU_ADDRESS 0x8FEE58 /end MEASUREMENT
/begin MEASUREMENT FanCtl_nSetGbxOilMap_mp "fanspeed dependend on vehicle speed and Oil temp" SWORD FanSpd 1 100 -3000.092 3000.000 FORMAT "%8.3" ECU_ADDRESS 0x8FEE5A /end MEASUREMENT
/begin MEASUREMENT FanCtl_nSetPntCAN_mp "fanspeed derived from CAN" SWORD FanSpd 1 100 -3000.092 3000.000 FORMAT "%8.3" ECU_ADDRESS 0x8FEE5C /end MEASUREMENT
/begin MEASUREMENT FanCtl_nSetPntMap_mp "fanspeed dependend on veh.speed and coolant temp." SWORD FanSpd 1 100 -3000.092 3000.000 FORMAT "%8.3" ECU_ADDRESS 0x8FEE5E /end MEASUREMENT
/begin MEASUREMENT FanCtl_nSetPoint "Endgültige Soll- Lüfterdrehzahl" SWORD FanSpd 1 100 -3000.092 3000.000 FORMAT "%8.3" ECU_ADDRESS 0x7F8C5C /end MEASUREMENT
/begin MEASUREMENT FanCtl_nSetPoint_mp "Lüfter-Drehzahlsollwert" SWORD FanSpd 1 100 -3000.092 3000.000 FORMAT "%8.3" ECU_ADDRESS 0x8FEE60 /end MEASUREMENT
/begin MEASUREMENT FanCtl_stAftRun "Statuswort, Lüftersteuerung" UBYTE OneToOne 1 100 0.00 255.0 FORMAT "%5.1" ECU_ADDRESS 0x7F8848 /end MEASUREMENT
/begin MEASUREMENT FanCtl_stDemFanShOff_mp "Ausschaltbitleiste für hohe Lenköltemperaturen" UBYTE OneToOne 1 100 0.00 255.0 FORMAT "%5.1" ECU_ADDRESS 0x8FEE62 /end MEASUREMENT
/begin MEASUREMENT FanCtl_stDemFan_mp "Einschaltbitleiste für hohe Lenköltemperaturen" UBYTE OneToOne 1 100 0.00 255.0 FORMAT "%5.1" ECU_ADDRESS 0x8FEE63 /end MEASUREMENT
/begin MEASUREMENT FanCtl_stHys_mp "Statuswort der Hysteresefunktion" UBYTE OneToOne 1 100 0.00 255.0 FORMAT "%5.1" ECU_ADDRESS 0x8FEE64 /end MEASUREMENT
/begin MEASUREMENT FanCtl_stLogic_mp "Statuswort der Ansteuerlogik" UBYTE OneToOne 1 100 0.00 255.0 FORMAT "%5.1" ECU_ADDRESS 0x8FEE65 /end MEASUREMENT
/begin MEASUREMENT FanCtl_stOut "Zustand Lüfternachlauf" UBYTE OneToOne 1 100 0.00 255.0 FORMAT "%5.1" ECU_ADDRESS 0x7F8C5E /end MEASUREMENT
/begin MEASUREMENT FanCtl_tClnt_mp "intern verwendete Kühlwassertemperatur" SWORD Temp_Cels 1 100 -50.140 899.860 FORMAT "%8.3" ECU_ADDRESS 0x8FEE66 /end MEASUREMENT
/begin MEASUREMENT FanCtl_tGbxOil_mp "Oil temp or Default Temp  for MAP i/p" SWORD Temp_Cels 1 100 -50.140 899.860 FORMAT "%8.3" ECU_ADDRESS 0x8FEE68 /end MEASUREMENT
/begin MEASUREMENT FBC_AALOut_mp "Ausgang des Antialiasingfiler" FLOAT32_IEEE OneToOne 1 100 -150000000. 150000000. FORMAT "%10.0" ECU_ADDRESS 0x8FEE84 /end MEASUREMENT
/begin MEASUREMENT FBC_Badpt "Adaptionsstatus" UBYTE OneToOne 1 100 0.00 255.0 FORMAT "%5.1" ECU_ADDRESS 0x7F8843 /end MEASUREMENT
/begin MEASUREMENT FBC_ctSegInt "interner Segmentzähler von FBC" UBYTE OneToOne 1 100 0.00 255.0 FORMAT "%5.1" ECU_ADDRESS 0x7F8845 /end MEASUREMENT
/begin MEASUREMENT FBC_dBPCaS_mp "Array der Bandpassausgänge" SWORD EngN 1 100 -32768.00 32767.00 FORMAT "%8.2" ARRAY_SIZE 3 ECU_ADDRESS 0x8FEE6A /end MEASUREMENT
/begin MEASUREMENT FBC_dBPSum "FBC Mengenersatzsignal, Eingang PI-Regler" SWORD OneToOne 1 100 -32768.00 32767.00 FORMAT "%8.2" ECU_ADDRESS 0x7F8C30 /end MEASUREMENT
/begin MEASUREMENT FBC_DXadpt_mp "aktuelle Adaptionsgüte" SWORD Dxs 1 100 -0.8192000 0.8191750 FORMAT "%9.7" ECU_ADDRESS 0x8FEE88 /end MEASUREMENT
/begin MEASUREMENT FBC_DXSfn_mp "Ausgang des negativen Bewertungsfilter" SWORD Dxs 1 100 -0.8192000 0.8191750 FORMAT "%9.7" ARRAY_SIZE 12 ECU_ADDRESS 0x8FEE8A /end MEASUREMENT
/begin MEASUREMENT FBC_DXSfp_mp "Ausgang des positiven Bewertungsfilter" SWORD Dxs 1 100 -0.8192000 0.8191750 FORMAT "%9.7" ARRAY_SIZE 12 ECU_ADDRESS 0x8FEEA2 /end MEASUREMENT
/begin MEASUREMENT FBC_DXSf_mp "relative,aktuelle und gefilterte Zahnteilungsfehler (Adaptionsfilter)" SWORD Dxs 1 100 -0.8192000 0.8191750 FORMAT "%9.7" ARRAY_SIZE 12 ECU_ADDRESS 0x8FEEBA /end MEASUREMENT
/begin MEASUREMENT FBC_DXSl_mp "relative, gefilterte Zahnteilungsfehler (Adaptionsfilter, eingelernte Werte)" SWORD Dxs 1 100 -0.8192000 0.8191750 FORMAT "%9.7" ARRAY_SIZE 12 ECU_ADDRESS 0x8FEED2 /end MEASUREMENT
/begin MEASUREMENT FBC_DXS_mp "relative Zahnteilungsfehler (ungefiltert)" SWORD Dxs 1 100 -0.8192000 0.8191750 FORMAT "%9.7" ARRAY_SIZE 12 ECU_ADDRESS 0x8FEEEA /end MEASUREMENT
/begin MEASUREMENT FBC_facBPNum_mp "aktuell verwendete Bandpasszählerkoeffizienten" SWORD FBC_BPfac 1 100 -60.00183 60.00000 FORMAT "%8.5" ARRAY_SIZE 3 ECU_ADDRESS 0x8FEE70 /end MEASUREMENT
/begin MEASUREMENT FBC_facSegVal_mp "aktuelle verwendete Segmentwahl" UWORD Per_Ratio 1 100 0.00 255.9961 FORMAT "%8.4" ARRAY_SIZE 3 ECU_ADDRESS 0x8FEE76 /end MEASUREMENT
/begin MEASUREMENT FBC_nMaxOvrRun_mp "maximale Drehzahl, bis zu der die Bandpässe berechnet werden" SWORD EngN 1 100 -32768.00 32767.00 FORMAT "%8.2" ECU_ADDRESS 0x8FEE7C /end MEASUREMENT
/begin MEASUREMENT FBC_q "Ausgangsmenge der Mengenausgleichsregelung" SWORD InjMass 1 100 -327.6800 327.6700 FORMAT "%8.4" ECU_ADDRESS 0x7F8C32 /end MEASUREMENT
/begin MEASUREMENT FBC_qDvtCyl "aktuelle zylinderindividuelle Korrekturmenge: I-Anteil" SWORD InjMass 1 100 -327.6800 327.6700 FORMAT "%8.4" ARRAY_SIZE 7 ECU_ADDRESS 0x7F93CE /end MEASUREMENT
/begin MEASUREMENT FBC_qDvtMax_mp "obere Integratorwertschwelle" SWORD InjMass 1 100 -327.6800 327.6700 FORMAT "%8.4" ECU_ADDRESS 0x8FEE7E /end MEASUREMENT
/begin MEASUREMENT FBC_qDvtMin_mp "untere Integratorwertschwelle" SWORD InjMass 1 100 -327.6800 327.6700 FORMAT "%8.4" ECU_ADDRESS 0x8FEE80 /end MEASUREMENT
/begin MEASUREMENT FBC_qLimAct "Aktuelle Begrenzungsmenge für FBC_q" SWORD InjMass 1 100 -327.6800 327.6700 FORMAT "%8.4" ECU_ADDRESS 0x7F8C34 /end MEASUREMENT
/begin MEASUREMENT FBC_RegionChng "signalisiert einen Wechsel der Lernregion in der FBC" UBYTE OneToOne 1 100 0.00 255.0 FORMAT "%5.1" ECU_ADDRESS 0x7F8844 /end MEASUREMENT
/begin MEASUREMENT FBC_Region_mp "Drehzahl-/Mengenbereich für ""regeln - steuern - inaktiv""" UBYTE OneToOne 1 100 0.00 255.0 FORMAT "%5.1" ECU_ADDRESS 0x8FEF02 /end MEASUREMENT
/begin MEASUREMENT FBC_stActive "Status FBC-Regler -> '1': Regeln; '0': Steuern" UBYTE OneToOne 1 100 0.00 255.0 FORMAT "%5.1" ECU_ADDRESS 0x7F8846 /end MEASUREMENT
/begin MEASUREMENT FBC_stDvt_mp "Status der Überwachung Integratorwerte" UBYTE OneToOne 1 100 0.00 255.0 FORMAT "%5.1" ECU_ADDRESS 0x8FEE82 /end MEASUREMENT
/begin MEASUREMENT FBC_stEqualInit "Initialisierungsstatus für FBC-Regler" UBYTE OneToOne 1 100 0.00 255.0 FORMAT "%5.1" ECU_ADDRESS 0x7F8847 /end MEASUREMENT
/begin MEASUREMENT FBC_stLearn "Bitfeld für Übergänge des Zustandsautomaten" UWORD OneToOne 1 100 0.00 65535.00 FORMAT "%8.2" ECU_ADDRESS 0x7F8C36 /end MEASUREMENT
/begin MEASUREMENT FBC_stRegion_mp "Status  Regler in Abhängigkeit von Menge/Drehzahl ('regeln','steuern','inaktiv')" UBYTE OneToOne 1 100 0.00 255.0 FORMAT "%5.1" ECU_ADDRESS 0x8FEE83 /end MEASUREMENT
/begin MEASUREMENT FBC_stState_mp "Status des Zustandsautomates der Adaption" UBYTE FBC_LrnState 1 100 1.00000000000 5.00000000000 FORMAT "%13.11" ECU_ADDRESS 0x8FEF03 /end MEASUREMENT
/begin MEASUREMENT FBC_WheelLrnOut "Eingangsignal für FBC Bandpässe" FLOAT32_IEEE OneToOne 1 100 -1.00000000E+35 1.00000000E+35 FORMAT "%10.0" ECU_ADDRESS 0x7F9130 /end MEASUREMENT
/begin MEASUREMENT FlFCD_stFlFltDebVal "Entprellter Zustand des Kraftstofffilters" UBYTE OneToOne 1 100 0.00 255.0 FORMAT "%5.1" ECU_ADDRESS 0x7F8849 /end MEASUREMENT
/begin MEASUREMENT FlFCD_stFlFltRawVal "Unentprellter Zustand des Kraftstofffilters" UBYTE OneToOne 1 100 0.00 255.0 FORMAT "%5.1" ECU_ADDRESS 0x7F884A /end MEASUREMENT
/begin MEASUREMENT FlMng_mAirPerCylFltSmk_mp "PT1 filtered air mass per cylinder" SWORD AirMassPerCyl 1 100 -3276.800 3276.700 FORMAT "%8.3" ECU_ADDRESS 0x8FEF10 /end MEASUREMENT
/begin MEASUREMENT FlMng_mAirPerCylLim_mp "begrenzte Luftmasse" SWORD AirMassPerCyl 1 100 -3276.800 3276.700 FORMAT "%8.3" ECU_ADDRESS 0x8FEF12 /end MEASUREMENT
/begin MEASUREMENT FlMng_qFullLdRgl "Korrekturmenge der Volllastregelung" SWORD InjMass 1 100 -327.6800 327.6700 FORMAT "%8.4" ECU_ADDRESS 0x7F8C60 /end MEASUREMENT
/begin MEASUREMENT FlMng_qFullLdRglI_mp "I-Anteil der Vollastregelung" SLONG InjMass 1 100 -21474836.4800 21474836.4700 FORMAT "%13.4" ECU_ADDRESS 0x8FEF04 /end MEASUREMENT
/begin MEASUREMENT FlMng_qFullLdRglP_mp "P-Anteil der Vollastregelung" SWORD InjMass 1 100 -327.6800 327.6700 FORMAT "%8.4" ECU_ADDRESS 0x8FEF08 /end MEASUREMENT
/begin MEASUREMENT FlMng_qLimSmk "Begrenzungsmenge zur Rauchbegrenzung" SWORD InjMass 1 100 -327.6800 327.6700 FORMAT "%8.4" ECU_ADDRESS 0x7F8C62 /end MEASUREMENT
/begin MEASUREMENT FlMng_qLimSmkDefect_mp "Quantity to detect and in the case of an detached charge air tube" SWORD InjMass 1 100 -327.6800 327.6700 FORMAT "%8.4" ECU_ADDRESS 0x8FEF14 /end MEASUREMENT
/begin MEASUREMENT FlMng_qLimSmk_mp "rauchabhängige Mengenbegrenzung" SWORD InjMass 1 100 -327.6800 327.6700 FORMAT "%8.4" ECU_ADDRESS 0x8FEF16 /end MEASUREMENT
/begin MEASUREMENT FlMng_rLmbdAPSCor_mp "Lambda-Korrekturwertes in Abhängigkeit des Umgebungsdrucks für die Rauchbegrenzung" SWORD lambda 1 100 -32.76800 32.76700 FORMAT "%8.5" ECU_ADDRESS 0x8FEF18 /end MEASUREMENT
/begin MEASUREMENT FlMng_rLmbdRecDvt_mp "Kehrwert der Lambdaabweichung bei Volllastregelung" SWORD lambdaRec 1 100 -3.276800 3.276700 FORMAT "%8.6" ECU_ADDRESS 0x8FEF0A /end MEASUREMENT
/begin MEASUREMENT FlMng_rLmbdSet "Stellgröße für Lambda-Regler" SWORD lambda 1 100 -32.76800 32.76700 FORMAT "%8.5" ECU_ADDRESS 0x7F8C64 /end MEASUREMENT
/begin MEASUREMENT FlMng_rLmbdSmk_mp "Lambda-Wert der Rauchbegrenzung" SWORD lambda 1 100 -32.76800 32.76700 FORMAT "%8.5" ECU_ADDRESS 0x8FEF1A /end MEASUREMENT
/begin MEASUREMENT FlMng_stCurrInp_mp "Status, welcher Eingang von EGT_RgnSwtE3 momentan berechnet werden muss" UBYTE OneToOne 1 100 0.00 255.0 FORMAT "%5.1" ECU_ADDRESS 0x8FEF1C /end MEASUREMENT
/begin MEASUREMENT FlMng_stDefect_mp "Current defect stat" UBYTE OneToOne 1 100 0.00 255.0 FORMAT "%5.1" ECU_ADDRESS 0x8FEF1D /end MEASUREMENT
/begin MEASUREMENT FlMng_stGearGroup_mp "Gear group status" SWORD OneToOne 1 100 -32768.00 32767.00 FORMAT "%8.2" ECU_ADDRESS 0x8FEF1E /end MEASUREMENT
/begin MEASUREMENT FlMng_stMon_mp "Status der Einschaltlogik und Überwachung der VOllastregellung" UBYTE OneToOne 1 100 0.00 255.0 FORMAT "%5.1" ECU_ADDRESS 0x8FEF0C /end MEASUREMENT
/begin MEASUREMENT FlMng_stSmkLim_mp "status of smoke limitation map switching" UBYTE OneToOne 1 100 0.00 255.0 FORMAT "%5.1" ECU_ADDRESS 0x8FEF20 /end MEASUREMENT
/begin MEASUREMENT FlMng_swtFullLdRgl "Schalter zur (de)aktivierung der Vollastregelung" UBYTE OneToOne 1 100 0.00 255.0 FORMAT "%5.1" ECU_ADDRESS 0x7F884B /end MEASUREMENT
/begin MEASUREMENT FlMng_tiAirPerCylPT1_mp "Time constant for PT1 filtering of air mass per cylinder" ULONG TimeDelay_s 1 100 0.0000010000000 4294.9673 FORMAT "%9.4" ECU_ADDRESS 0x8FEF24 /end MEASUREMENT
/begin MEASUREMENT FlSys_rhoFl "Koeffizient Kraftstoffdichte" SWORD RhoFuel 1 100 -3276.800 3276.700 FORMAT "%8.3" ECU_ADDRESS 0x7F8C68 /end MEASUREMENT
/begin MEASUREMENT FlSys_stDeflate_mp "Aktivierung der Niederdruckentlueftung" UBYTE OneToOne 1 100 0.00 255.0 FORMAT "%5.1" ECU_ADDRESS 0x8FEF28 /end MEASUREMENT
/begin MEASUREMENT FlSys_stTemp_mp "Statusbits zur Erfassung der Kraftstoffsystemtemperatur" UBYTE OneToOne 1 100 0.00 255.0 FORMAT "%5.1" ECU_ADDRESS 0x8FEF29 /end MEASUREMENT
/begin MEASUREMENT FlSys_swtTempSensCfg "Schalter, ob Kraftstofftemperaturfühler vorhanden" UBYTE OneToOne 1 100 0.00 255.0 FORMAT "%5.1" ECU_ADDRESS 0x7F884C /end MEASUREMENT
/begin MEASUREMENT FlSys_t "aktuelle Systemtemperatur" SWORD Temp_Cels 1 100 -50.140 899.860 FORMAT "%8.3" ECU_ADDRESS 0x7F8C6A /end MEASUREMENT
/begin MEASUREMENT FMA_dqAbs_mp "Absolutwert der Einspritzmengenänderung für FMA" SWORD InjMassSec 1 100 -327.6800 327.6700 FORMAT "%8.4" ECU_ADDRESS 0x8FEFC4 /end MEASUREMENT
/begin MEASUREMENT FMA_drLmbdAbs_mp "Absolutwert der Lambdaänderung für FMA" SWORD lambdaSec 1 100 -32.76800 32.76700 FORMAT "%8.5" ECU_ADDRESS 0x8FEFC6 /end MEASUREMENT
/begin MEASUREMENT FMA_facAirSwtOff_mp "Ansauglufttemperaturabhängiger Abschaltfaktor der FMA" SWORD Fact 1 100 -4.000000 3.999878 FORMAT "%8.6" ECU_ADDRESS 0x8FEFC8 /end MEASUREMENT
/begin MEASUREMENT FMA_facAPSwtOff_mp "Atmosphärendruckabhängiger Abschaltfaktor der FMA" SWORD Fact 1 100 -4.000000 3.999878 FORMAT "%8.6" ECU_ADDRESS 0x8FEFCA /end MEASUREMENT
/begin MEASUREMENT FMA_facEngSwtOff_mp "Motortemperaturabhängiger Abschaltfaktor der FMA" SWORD Fact 1 100 -4.000000 3.999878 FORMAT "%8.6" ECU_ADDRESS 0x8FEFCC /end MEASUREMENT
/begin MEASUREMENT FMA_facFaultSwtOff_mp "Faktor für langsame FMA-Abschaltung bei schweren Systemfehlern" SWORD Fact 1 100 -4.000000 3.999878 FORMAT "%8.6" ECU_ADDRESS 0x8FEFCE /end MEASUREMENT
/begin MEASUREMENT FMA_facFlSwtOff_mp "Kraftstofftemperaturabhängiger Abschaltfaktor der FMA" SWORD Fact 1 100 -4.000000 3.999878 FORMAT "%8.6" ECU_ADDRESS 0x8FEFD0 /end MEASUREMENT
/begin MEASUREMENT FMA_facNQSwtOff_mp "Drehzahl-/einspritzmengenabhängiger Abschaltfaktor der FMA für betriebsbereichsabhängige Abschaltung" SWORD Fact 1 100 -4.000000 3.999878 FORMAT "%8.6" ECU_ADDRESS 0x8FEFB4 /end MEASUREMENT
/begin MEASUREMENT FMA_facRgnSwtOff_mp "Regenerations-/ Applikationsabhängiger Abschaltfaktor der FMA" SWORD Fact 1 100 -4.000000 3.999878 FORMAT "%8.6" ECU_ADDRESS 0x8FEFD2 /end MEASUREMENT
/begin MEASUREMENT FMA_facSlpSwtOff_mp "Abschaltfaktor der FMA, gebildet aus den 4 oberen Abschaltfaktoren" SWORD Fact 1 100 -4.000000 3.999878 FORMAT "%8.6" ECU_ADDRESS 0x8FEFD4 /end MEASUREMENT
/begin MEASUREMENT FMA_facSwtOff "Abschaltfaktor zum langsamen Aus- und Einschalten der FMA" SWORD Fact 1 100 -4.000000 3.999878 FORMAT "%8.6" ECU_ADDRESS 0x7F8C38 /end MEASUREMENT
/begin MEASUREMENT FMA_facSwtOffTot_mp "Gesamtabschaltfaktor zum langsamen Aus- und Einschalten der FMA" SWORD Fact 1 100 -4.000000 3.999878 FORMAT "%8.6" ECU_ADDRESS 0x8FEFB6 /end MEASUREMENT
/begin MEASUREMENT FMA_qAct_mp "Aus Lambda- und Luftmassenmessung ermittelte Einspritzmenge. ""Wirkliche"" Einspritzmenge der FMA" SWORD InjMass 1 100 -327.6800 327.6700 FORMAT "%8.4" ECU_ADDRESS 0x8FEF2A /end MEASUREMENT
/begin MEASUREMENT FMA_qCtl_mp "Für Bestimmung des Mengenfehlers verwendetes Mengensignal" SWORD InjMass 1 100 -327.6800 327.6700 FORMAT "%8.4" ECU_ADDRESS 0x8FEF2E /end MEASUREMENT
/begin MEASUREMENT FMA_qDC "Von FMA ermittelter Einspritzmengenfehler bzw. -korrekturwert für Betriebsart Direct Control (Modellfehler)" SWORD InjMass 1 100 -327.6800 327.6700 FORMAT "%8.4" ECU_ADDRESS 0x7F8C3A /end MEASUREMENT
/begin MEASUREMENT FMA_qDev_mp "Abweichung der ""wirklichen"" Einspritzmenge von der gewünschten Einspritzmenge in der FMA" SWORD InjMass 1 100 -327.6800 327.6700 FORMAT "%8.4" ECU_ADDRESS 0x8FEF2C /end MEASUREMENT
/begin MEASUREMENT FMA_qDiff_mp "Differenz aus Einspritzmengenfehler und aktuellem Kennfeldwert" SWORD InjMass 1 100 -327.6800 327.6700 FORMAT "%8.4" ECU_ADDRESS 0x8FEFB8 /end MEASUREMENT
/begin MEASUREMENT FMA_qErrMod_mp "Aus Fehlermodell ermittelter Rohwert des Einspritzmengenfehlers" SWORD InjMass 1 100 -327.6800 327.6700 FORMAT "%8.4" ECU_ADDRESS 0x8FEFBA /end MEASUREMENT
/begin MEASUREMENT FMA_qIC "Von FMA ermittelter Einspritzmengenfehler bzw. -korrekturwert für Betriebsart Indirect Control (Modellfehler)" SWORD InjMass 1 100 -327.6800 327.6700 FORMAT "%8.4" ECU_ADDRESS 0x7F8C3C /end MEASUREMENT
/begin MEASUREMENT FMA_qMapRow0_mp "Kennfeldwerte für erste Mengenstützstelle (erste zeile von adaptive Kennfeld)" SWORD InjMass 1 100 -327.6800 327.6700 FORMAT "%8.4" ARRAY_SIZE 8 ECU_ADDRESS 0x8FEF32 /end MEASUREMENT
/begin MEASUREMENT FMA_qMapRow1_mp "Kennfeldwerte für zweite Mengenstützstelle (zweite zeile von adaptive Kennfeld)" SWORD InjMass 1 100 -327.6800 327.6700 FORMAT "%8.4" ARRAY_SIZE 8 ECU_ADDRESS 0x8FEF42 /end MEASUREMENT
/begin MEASUREMENT FMA_qMapRow2_mp "Kennfeldwerte für dritte Mengenstützstelle (dritte zeile von adaptive Kennfeld)" SWORD InjMass 1 100 -327.6800 327.6700 FORMAT "%8.4" ARRAY_SIZE 8 ECU_ADDRESS 0x8FEF52 /end MEASUREMENT
/begin MEASUREMENT FMA_qMapRow3_mp "Kennfeldwerte für vierte Mengenstützstelle (vierte zeile von adaptive Kennfeld)" SWORD InjMass 1 100 -327.6800 327.6700 FORMAT "%8.4" ARRAY_SIZE 8 ECU_ADDRESS 0x8FEF62 /end MEASUREMENT
/begin MEASUREMENT FMA_qMapRow4_mp "Kennfeldwerte für fünfte Mengenstützstelle (fünfte zeile von adaptive Kennfeld)" SWORD InjMass 1 100 -327.6800 327.6700 FORMAT "%8.4" ARRAY_SIZE 8 ECU_ADDRESS 0x8FEF72 /end MEASUREMENT
/begin MEASUREMENT FMA_qMapRow5_mp "Kennfeldwerte für sechste Mengenstützstelle (sechste zeile von adaptive Kennfeld)" SWORD InjMass 1 100 -327.6800 327.6700 FORMAT "%8.4" ARRAY_SIZE 8 ECU_ADDRESS 0x8FEF82 /end MEASUREMENT
/begin MEASUREMENT FMA_qMapRow6_mp "Kennfeldwerte für siebte Mengenstützstelle (siebte zeile von adaptive Kennfeld)" SWORD InjMass 1 100 -327.6800 327.6700 FORMAT "%8.4" ARRAY_SIZE 8 ECU_ADDRESS 0x8FEF92 /end MEASUREMENT
/begin MEASUREMENT FMA_qMapRow7_mp "Kennfeldwerte für achte Mengenstützstelle (achte zeile von adaptive Kennfeld)" SWORD InjMass 1 100 -327.6800 327.6700 FORMAT "%8.4" ARRAY_SIZE 8 ECU_ADDRESS 0x8FEFA2 /end MEASUREMENT
/begin MEASUREMENT FMA_qReg_mp "Einspritzmengenfehler im aktuellen Lernbereich" SWORD InjMass 1 100 -327.6800 327.6700 FORMAT "%8.4" ECU_ADDRESS 0x8FEFBC /end MEASUREMENT
/begin MEASUREMENT FMA_qSetFil_mp "Initialisierungswert für Integrierer bzw. PT1-Filter" SWORD InjMass 1 100 -327.6800 327.6700 FORMAT "%8.4" ECU_ADDRESS 0x8FEFBE /end MEASUREMENT
/begin MEASUREMENT FMA_q_mp "Mit abshaltfactor multiplizierter Mengenfehler des Fehlermodells" SWORD InjMass 1 100 -327.6800 327.6700 FORMAT "%8.4" ECU_ADDRESS 0x8FEF30 /end MEASUREMENT
/begin MEASUREMENT FMA_stDynDlyd_mp "FMA-Status: Aktuell oder vor kurzem starke Änderung der Einspritzmenge (verzögerte Einspritzmengendynamik)" UBYTE OneToOne 1 100 0.00 255.0 FORMAT "%5.1" ECU_ADDRESS 0x8FEFD6 /end MEASUREMENT
/begin MEASUREMENT FMA_stDynLmbd_mp "FMA- Status: Aktuell oder bis vor kurzem starke Lambdaänderung" UBYTE OneToOne 1 100 0.00 255.0 FORMAT "%5.1" ECU_ADDRESS 0x8FEFD7 /end MEASUREMENT
/begin MEASUREMENT FMA_stNoAdapt_mp "Status: Adaption des FMA-Fehlermodells angehalten" UWORD OneToOne 1 100 0.00 65535.00 FORMAT "%8.2" ECU_ADDRESS 0x8FEFD8 /end MEASUREMENT
/begin MEASUREMENT FMA_stOvrRunDlyd_mp "FMA-Status: Aktuell oder bis vor kurzem Schubbetrieb (verzögerter Schubbetrieb)" UBYTE OneToOne 1 100 0.00 255.0 FORMAT "%5.1" ECU_ADDRESS 0x8FEFDA /end MEASUREMENT
/begin MEASUREMENT FMA_stReset_mp "Status: FMA-Fehlermodell wird zurückgesetzt" UBYTE OneToOne 1 100 0.00 255.0 FORMAT "%5.1" ECU_ADDRESS 0x8FEFDB /end MEASUREMENT
/begin MEASUREMENT FMA_stRngLmbd_mp "FMA_ Status: Lambda aktuell oder bis vor kurzem außerhalb" UBYTE OneToOne 1 100 0.00 255.0 FORMAT "%5.1" ECU_ADDRESS 0x8FEFDC /end MEASUREMENT
/begin MEASUREMENT FMA_stSwtOff "Abschaltzustand der FMA" UWORD OneToOne 1 100 0.00 65535.00 FORMAT "%8.2" ECU_ADDRESS 0x7F8C3E /end MEASUREMENT
/begin MEASUREMENT FMA_tiFuncOp_mp "Betriebszeit des Fehlermodells seit der letzten Initialisierung der Lernwerte" SLONG Time_s 1 100 -21474836.4800 21474836.4700 FORMAT "%13.4" ECU_ADDRESS 0x8FEFC0 /end MEASUREMENT
/begin MEASUREMENT FMTC_etaCurr "aktueller Wirkunggsgrad (korrigiert)" SWORD Eta 1 100 -256.0000 255.9922 FORMAT "%8.4" ECU_ADDRESS 0x7F8C40 /end MEASUREMENT
/begin MEASUREMENT FMTC_etaCurrStd "aktueller Standard-Wirkungsgradfaktor (ohne Regenerationsmaßnahmen)" SWORD Eta 1 100 -256.0000 255.9922 FORMAT "%8.4" ECU_ADDRESS 0x7F8C42 /end MEASUREMENT
/begin MEASUREMENT FMTC_facAirCor_mp "Eta-Korrekturfaktor für die Frischluft pro Zylinder" SWORD Fact 1 100 -4.000000 3.999878 FORMAT "%8.6" ECU_ADDRESS 0x8FEFDE /end MEASUREMENT
/begin MEASUREMENT FMTC_facEtaCor "aktueller Wirkungsgradkorrekturwert" SWORD Fact 1 100 -4.000000 3.999878 FORMAT "%8.6" ECU_ADDRESS 0x7F8C44 /end MEASUREMENT
/begin MEASUREMENT FMTC_facStrtInjCor_mp "Eta-Korrekturfaktor für den Spritzbeginn" SWORD Fact 1 100 -4.000000 3.999878 FORMAT "%8.6" ECU_ADDRESS 0x8FEFE0 /end MEASUREMENT
/begin MEASUREMENT FMTC_mAirDiff_mp "Differenz Luftmasse optimal-aktueller Wert" SWORD AirMassPerCyl 1 100 -3276.800 3276.700 FORMAT "%8.3" ECU_ADDRESS 0x8FEFE2 /end MEASUREMENT
/begin MEASUREMENT FMTC_mAirOpt_mp "Eta-Korrektur, Referenzwert für die Luft pro Zylinder" SWORD AirMassPerCyl 1 100 -3276.800 3276.700 FORMAT "%8.3" ECU_ADDRESS 0x8FEFE4 /end MEASUREMENT
/begin MEASUREMENT FMTC_phiStrtInjDiff_mp "Differenz Spritzbeginn optimal-aktueller Wert" SWORD AngleCrS 1 100 -768.0000 767.9766 FORMAT "%8.4" ECU_ADDRESS 0x8FEFE6 /end MEASUREMENT
/begin MEASUREMENT FMTC_phiStrtInjOpt_mp "aktueller Seferenzwert für Spritzbeginnkorrektur" SWORD AngleCrS 1 100 -768.0000 767.9766 FORMAT "%8.4" ECU_ADDRESS 0x8FEFE8 /end MEASUREMENT
/begin MEASUREMENT FMTC_qCurr "Einspritzmenge aktueller Wert" SWORD InjMass 1 100 -327.6800 327.6700 FORMAT "%8.4" ECU_ADDRESS 0x7F8C46 /end MEASUREMENT
/begin MEASUREMENT FMTC_qDes "Einspritzmenge Wunschwert" SWORD InjMass 1 100 -327.6800 327.6700 FORMAT "%8.4" ECU_ADDRESS 0x7F8C48 /end MEASUREMENT
/begin MEASUREMENT FMTC_qRaw "Einspritzmenge Rohwert (>Luftsystem)" SWORD InjMass 1 100 -327.6800 327.6700 FORMAT "%8.4" ECU_ADDRESS 0x7F8C4A /end MEASUREMENT
/begin MEASUREMENT FMTC_qSet "Einspritzmenge Sollwert (>Einspritzung)" SWORD InjMass 1 100 -327.6800 327.6700 FORMAT "%8.4" ECU_ADDRESS 0x7F8C4C /end MEASUREMENT
/begin MEASUREMENT FMTC_qSetOptStd_mp "optimale Standardsollmenge ohne Korrekturen" SWORD InjMass 1 100 -327.6800 327.6700 FORMAT "%8.4" ECU_ADDRESS 0x8FEFEA /end MEASUREMENT
/begin MEASUREMENT FMTC_qSetRgn1_mp "Regenerationseinspritzmenge Sollwert mit Berücksichtigung einer Regenerationsanforderung 1 der Abgasnachbehandlung" SWORD InjMass 1 100 -327.6800 327.6700 FORMAT "%8.4" ECU_ADDRESS 0x8FEFEC /end MEASUREMENT
/begin MEASUREMENT FMTC_qSetRgn2_mp "Regenerationseinspritzmenge Sollwert mit Berücksichtigung einer Regenerationsanforderung 2 der Abgasnachbehandlung" SWORD InjMass 1 100 -327.6800 327.6700 FORMAT "%8.4" ECU_ADDRESS 0x8FEFEE /end MEASUREMENT
/begin MEASUREMENT FMTC_qSetStd_mp "Standardeinspritzmenge Sollwert ohne Berücksichtigung der Regenerationsanforderung der Abgasnachbehandlung" SWORD InjMass 1 100 -327.6800 327.6700 FORMAT "%8.4" ECU_ADDRESS 0x8FEFF0 /end MEASUREMENT
/begin MEASUREMENT FMTC_qStrt "Einspritzmenge Startwert" SWORD InjMass 1 100 -327.6800 327.6700 FORMAT "%8.4" ECU_ADDRESS 0x7F8C4E /end MEASUREMENT
/begin MEASUREMENT FMTC_trqInr "aktuelles rückgerechnetes inneres Motormoment" SWORD Trq 1 100 -3276.800 3276.700 FORMAT "%8.3" ECU_ADDRESS 0x7F8C50 /end MEASUREMENT
/begin MEASUREMENT FMTC_trqInrLimSmk "Begrenzungsmoment Rauchgrenze" SWORD Trq 1 100 -3276.800 3276.700 FORMAT "%8.3" ECU_ADDRESS 0x7F8C52 /end MEASUREMENT
/begin FUNCTION erlpcd "Fehlerlampe Komponententreiber"
 /begin DEF_CHARACTERISTIC ErLpCD_tiDefMil_C ErLpCD_tiOkMil_C ErLpCD_nThresMil_C ErLpCD_tiMaxMil_C ErLpCD_tiMilTst_C ErLpCD_tiDelMil_C ErLpCD_tiBlkMil_C ErLpCD_swtMilEna_C ErLpCD_numDiaErrLmp_C ErLpCD_numDiaSysLmp_C ErLpCD_numDioOutErrLmp_C ErLpCD_numDioOutSysLmp_C ErLpCD_stPwrStgActvLmp_C ErLpCD_stPwrStgActvMil_C ErLpCD_stPwrStgDiaLmp_C ErLpCD_stPwrStgDiaMil_C ErLpCD_swtSysEqGlwLmp_C ErLpCD_tiDefSysLmp_C ErLpCD_tiOkSysLmp_C ErLpCD_nThresSysLmp_C ErLpCD_tiMaxSysLmp_C ErLpCD_tiTstSysLmp_C ErLpCD_tiDelSysLmp_C ErLpCD_tiBlkSysLmp_C ErLpCD_swtSysLmpEna_C /end DEF_CHARACTERISTIC
/end FUNCTION
/begin FUNCTION erlpcd_msg ""
 /begin OUT_MEASUREMENT ErLpCD_OrdGlwLmp ErLpCD_stMil ErLpCD_stMilLmpTst ErLpCD_stMilReq ErLpCD_stSysLmp ErLpCD_stSysLmpReq /end OUT_MEASUREMENT
/end FUNCTION
/begin FUNCTION erlpcd_uic "" /begin OUT_MEASUREMENT ErLpCD_stTstMIL_mp ErLpCD_stTstSysLmp_mp /end OUT_MEASUREMENT /end FUNCTION
/begin FUNCTION error "" /end FUNCTION
/begin FUNCTION ess_getnmin "Leerlaufanhebung bei schwacher Batterie"
 /begin DEF_CHARACTERISTIC ESS_nLIBattThres_C ESS_nMinThres_C ESS_tiDelayUBattFFSet_C ESS_uLIBattThresFFSet_C /end DEF_CHARACTERISTIC
/end FUNCTION
/begin FUNCTION ess_getnmin_uic "" /end FUNCTION
/begin FUNCTION ess_getnmin_var ""
 /begin DEF_CHARACTERISTIC ESS_nBattMin_C ESS_tiDelayUBattFFRes_C ESS_uLIBattThresFFRes_C /end DEF_CHARACTERISTIC
/end FUNCTION
/begin FUNCTION ess_getnmin_var_uic "" /end FUNCTION
/begin FUNCTION ess_msg "" /begin OUT_MEASUREMENT ESS_nBattMin ESS_nMax ESS_nMin ESS_pwrDes ESS_pwrLead /end OUT_MEASUREMENT /end FUNCTION
/begin FUNCTION ess_updatedem "" /end FUNCTION
/begin FUNCTION ess_updatedem_uic "" /end FUNCTION
/begin FUNCTION etclb_calibration "Ansteuerdauer Kalibrierung"
 /begin DEF_CHARACTERISTIC ETClb_ctLrnThres2_C ETClb_ctLrnThresQck_C ETClb_ctLrnThres_C ETClb_DebETFltMaxDefect_C ETClb_DebETFltMaxOk_C ETClb_DebETFltMinDefect_C ETClb_DebETFltMinOk_C ETClb_dpRailLim_CA ETClb_facFlt2_C ETClb_facFltQck_C ETClb_facFlt_C ETClb_numCyclMeas_C ETClb_numCyclNoDyn_C ETClb_numCyclStartEnergize_C ETClb_pRailSet_CA ETClb_SigThres_CA ETClb_swtCorActvVal_C ETClb_swtCorActvType_C ETClb_swtWrDflVal_C ETClb_tiETOfs_CA ETClb_volEffectiveMin_CA ETClb_vStartClb_CA ETClb_vStopClb_CA /end DEF_CHARACTERISTIC
 /begin OUT_MEASUREMENT ETClb_ctLrn_mp ETClb_dtiETFlt0_mp ETClb_dtiETFlt1_mp ETClb_dtiETFlt2_mp ETClb_numCylCur_mp ETClb_swtQckClb_mp ETClb_tiETCor0_mp ETClb_tiETCor1_mp ETClb_tiETCor2_mp ETClb_tiETCur_mp ETClb_tiETMinEff_mp ETClb_tiETZFCCor_mp /end OUT_MEASUREMENT
/end FUNCTION
/begin FUNCTION etclb_calibration_msg "" /begin OUT_MEASUREMENT ETClb_stCor ETClb_swtCorActv /end OUT_MEASUREMENT /end FUNCTION
/begin FUNCTION etclb_calibration_uic ""
 /begin OUT_MEASUREMENT ETClb_ctInjCycl_mp ETClb_numPres_mp ETClb_numRailPresClbPnt_mp ETClb_stDemCor_mp ETClb_stRlsCylCor_mp ETClb_st_mp /end OUT_MEASUREMENT
/end FUNCTION
/begin FUNCTION etclb_eval "Auswertung von Einspritzungen fuer die Ansteuerdauer Kalibrierung"
 /begin DEF_CHARACTERISTIC ETClb_DebETMaxDefect_C ETClb_DebETMaxOk_C ETClb_DebETMinDefect_C ETClb_DebETMinOk_C ETClb_tiETStep_CA ETClb_tiET_MAX_CA ETClb_tiET_MIN_CA /end DEF_CHARACTERISTIC
 /begin OUT_MEASUREMENT ETClb_stEval_mp /end OUT_MEASUREMENT
/end FUNCTION
/begin FUNCTION etclb_eval_uic "" /begin OUT_MEASUREMENT ETClb_stEvalResult_mp /end OUT_MEASUREMENT /end FUNCTION
/begin FUNCTION etclb_lib ""
 /begin DEF_CHARACTERISTIC ETClb_ctDflLrn_CA ETClb_dtiDflETFlt0_CA ETClb_dtiDflETFlt1_CA ETClb_dtiDflETFlt2_CA ETClb_numDflCylCur_CA ETClb_swtDflQckClb_C ETClb_tiDflETCur_CA ETClb_tiDflInjInit_C /end DEF_CHARACTERISTIC
/end FUNCTION
/begin FUNCTION etclb_lib_uic "" /end FUNCTION
/begin FUNCTION fancd_co "Komponententreiber Lüfter Koordination"
 /begin DEF_CHARACTERISTIC FanCD_DebExcTempDef_C FanCD_DebExcTempOk_C FanCD_tiDebDia1Def_C FanCD_tiDebDia1Ok_C FanCD_tiDebDia2Def_C FanCD_tiDebDia2Ok_C FanCD_tiDebDia3Def_C FanCD_tiDebDia3Ok_C FanCD_DebNoLoadDef_C FanCD_DebNoLoadOk_C FanCD_DebShortCircBatDef_C FanCD_DebShortCircBatOk_C FanCD_DebShortCircGndDef_C FanCD_DebShortCircGndOk_C FanCD_numDia_C FanCD_numPwmOut_C FanCD_rTst_C FanCD_stInvOut_C FanCD_tiBtwTst_C FanCD_tiFanCtlr1Max_C FanCD_tiFanCtlr1Min_C FanCD_tiFanCtlr2Max_C FanCD_tiFanCtlr2Min_C FanCD_tiFanCtlr3Max_C FanCD_tiFanCtlr3Min_C /end DEF_CHARACTERISTIC
/end FUNCTION
/begin FUNCTION fancd_co_uic "" /begin OUT_MEASUREMENT FanCD_dcycRaw_mp /end OUT_MEASUREMENT /end FUNCTION
/begin FUNCTION fancd_msg "" /end FUNCTION
/begin FUNCTION fanctl "Lüftersteuerung"
 /begin DEF_CHARACTERISTIC FanCtl_dcycAftRun_C FanCtl_dcycHysDelta_C FanCtl_dcycMax_C FanCtl_dcycMinOff_C FanCtl_dcycSwtLimOff_C FanCtl_dcycSwtLimOn_C FanCtl_dcyc_CUR FanCtl_facWghFctr_CUR FanCtl_nDemFanOffLim_C FanCtl_nDemFanOn_C FanCtl_nMin_C FanCtl_nSetGbxOil_MAP FanCtl_nSetPnt_MAP FanCtl_nSetPointFanOn_C FanCtl_stDemFanOffGear_C FanCtl_stDemFanOnGear_C FanCtl_swtBattCor_C FanCtl_tClntDfl_C FanCtl_tDemFanOffLim_C FanCtl_tDemFanOnLim_C FanCtl_tEngAftRunThres_C FanCtl_tGbxOilDfl_C FanCtl_tiDemFanOn_C FanCtl_tiMinAftRunOfs_C FanCtl_uBattRef_C FanCtl_vDemFanOffMax_C FanCtl_vDemFanOffMin_C FanCtl_vDemFanOnMax_C FanCtl_vDemFanOnMin_C /end DEF_CHARACTERISTIC
 /begin IN_MEASUREMENT FanCtl_nSetPoint FanCtl_tClnt_mp FanCtl_tGbxOil_mp VSSCD_v /end IN_MEASUREMENT
/end FUNCTION
/begin FUNCTION fanctl_msg ""
 /begin OUT_MEASUREMENT FanCtl_dcycOut FanCtl_nSetPoint FanCtl_stAftRun FanCtl_stOut /end OUT_MEASUREMENT
/end FUNCTION
/begin FUNCTION fanctl_uic ""
 /begin OUT_MEASUREMENT FanCtl_dcycAftRun_mp FanCtl_dcycBattCor_mp FanCtl_dcycHysStart_mp FanCtl_dcycHys_mp FanCtl_dcycRaw_mp FanCtl_facWghFctr_mp FanCtl_nSetGbxOilMap_mp FanCtl_nSetPntCAN_mp FanCtl_nSetPntMap_mp FanCtl_nSetPoint_mp FanCtl_stDemFanShOff_mp FanCtl_stDemFan_mp FanCtl_stHys_mp FanCtl_stLogic_mp FanCtl_tClnt_mp FanCtl_tGbxOil_mp /end OUT_MEASUREMENT
/end FUNCTION
/begin FUNCTION fbc_equal "Laufruheregler"
 /begin DEF_CHARACTERISTIC FBC_BPFac1NumG_CUR FBC_dBPFacNumLo_CA FBC_dBPFacNumHi_CA FBC_dBPFacDen1_CA FBC_dBPFacDen2_CA FBC_ctSegOffset_C FBC_dSegNhiCaS_C FBC_dSegNloCaS_C FBC_dSyn_C FBC_fSurge_CUR FBC_GvrnIKi_C FBC_GvrnIKiPos_C FBC_GvrnIKiNeg_C FBC_GvrnIWinPos_C FBC_GvrnIWinNeg_C FBC_GvrnPKp_C FBC_GvrnPKpPos_C FBC_GvrnPKpNeg_C FBC_GvrnPWinPos_C FBC_GvrnPWinNeg_C FBC_nCtlOfsMin_C FBC_nCtlThresMax_C FBC_nGvrnOfsMin_C FBC_nGvrnThresMax_C FBC_nHyst_C FBC_nSurgeOffset_C FBC_qCtlOfsMax_C FBC_qCtlThresMin_C FBC_qDvtMax_CUR FBC_qDvtMin_CUR FBC_qGvrnThresMax_CUR FBC_qGvrnThresMin_C FBC_qLim_CUR FBC_stInitI_C FBC_stMskRgn_C FBC_tiDvtMaxDefect_C FBC_tiDvtMaxOk_C FBC_tiDvtMinDefect_C FBC_tiDvtMinOk_C /end DEF_CHARACTERISTIC
 /begin IN_MEASUREMENT DrvTrn_rTransDT Eng_nAvrg InjCtl_qSetUnBal /end IN_MEASUREMENT
 /begin OUT_MEASUREMENT FBC_dBPCaS_mp FBC_facBPNum_mp FBC_facSegVal_mp FBC_nMaxOvrRun_mp /end OUT_MEASUREMENT
/end FUNCTION
/begin FUNCTION fbc_equal_uic "" /begin DEF_CHARACTERISTIC FBC_q_Vector FBC_q_Channel /end DEF_CHARACTERISTIC /begin OUT_MEASUREMENT FBC_qDvtMax_mp FBC_qDvtMin_mp FBC_stDvt_mp FBC_stRegion_mp /end OUT_MEASUREMENT /end FUNCTION
/begin FUNCTION fbc_msg ""
 /begin OUT_MEASUREMENT FBC_Badpt FBC_ctSegInt FBC_dBPSum FBC_q FBC_qDvtCyl FBC_qLimAct FBC_RegionChng FBC_stActive FBC_stEqualInit FBC_stLearn FBC_WheelLrnOut /end OUT_MEASUREMENT
/end FUNCTION
/begin FUNCTION fbc_wheellrn "Antialiasingfilter und Geberradadaption"
 /begin DEF_CHARACTERISTIC FBC_AACoeff_C FBC_AAOrd_C FBC_Act_C FBC_DXadptl_C FBC_DXadptu_C FBC_DXalf0_C FBC_nLrnThres_C FBC_nThresFbc_C FBC_TFlrn_C FBC_TF_C FBC_ThresDyn_C FBC_TSm_C /end DEF_CHARACTERISTIC
 /begin OUT_MEASUREMENT FBC_AALOut_mp FBC_DXadpt_mp FBC_DXSfn_mp FBC_DXSfp_mp FBC_DXSf_mp FBC_DXSl_mp FBC_DXS_mp FBC_Region_mp FBC_stState_mp /end OUT_MEASUREMENT
/end FUNCTION
/begin FUNCTION fbc_wheellrn_uic "" /begin DEF_CHARACTERISTIC FBC_lrn_Vector FBC_lrn_Channel /end DEF_CHARACTERISTIC /end FUNCTION
/begin FUNCTION flfcd "Kraftstoffilter Komponententreiber"
 /begin DEF_CHARACTERISTIC FlFCD_numDioIn_C FlFCD_swtFlFltInv_C FlFCD_swtFlFltSens_C FlFCD_tiDebFlFltDef_C FlFCD_tiDebFlFltOk_C FlFCD_tiFlFltDebNeg_C FlFCD_tiFlFltDebPos_C /end DEF_CHARACTERISTIC
/end FUNCTION
/begin FUNCTION flfcd_msg "" /begin OUT_MEASUREMENT FlFCD_stFlFltDebVal FlFCD_stFlFltRawVal /end OUT_MEASUREMENT /end FUNCTION
/begin FUNCTION flfcd_uic "" /end FUNCTION
/begin FUNCTION flmng "Gemischbildung"
 /begin DEF_CHARACTERISTIC FlMng_tiDebSmkDefectDef_C FlMng_tiDebSmkDefectOk_C FlMng_dqLimUp_C FlMng_dqLimDwn_C FlMng_dSmkLimUp_C FlMng_dSmkLimDwn_C FlMng_facAPSCorNeg_CUR FlMng_facAPSCorPos_CUR FlMng_facLmbdAPSCor_CUR FlMng_facLmbdATSCor_CUR FlMng_facLmbdETSCor_CUR FlMng_mAirPerCylMin_C FlMng_numRevEng_C FlMng_pThresLmbd0_C FlMng_pThresLmbd1_C FlMng_pThresLmbd2_C FlMng_qDefectMin_MAP FlMng_qDefectOfs_C FlMng_qEngTemp_CUR FlMng_rLmbdAPSCor_MAP FlMng_rLmbdATSCor_MAP FlMng_rLmbdETSCor_MAP FlMng_rLmbdSmk2FDC_MAP FlMng_rLmbdSmk2UpperGbxFDC_MAP FlMng_rLmbdSmk2UpperGbx_MAP FlMng_rLmbdSmk2_MAP FlMng_rLmbdSmkFDC_MAP FlMng_rLmbdSmkRgn1_MAP FlMng_rLmbdSmkRgn2_MAP FlMng_rLmbdSmkUpperGbxFDC_MAP FlMng_rLmbdSmkUpperGbx_MAP FlMng_rLmbdSmk_MAP FlMng_stGearGroupSwitch_C FlMng_stRgnMsk1_C FlMng_stRgnMsk2_C FlMng_tiAirPerCylPT1_MAP FlMng_tiDefectDead_C FlMng_tiPT1Neg_MAP FlMng_tiPT1Pos_MAP FlMng_tiRmpSlp_C FlMng_trqThresInrDes0_C FlMng_trqThresInrDes1_C FlMng_trqThresInrDes2_C FlMng_trqThresInr_C FlMng_tThresLmbdHigh_C FlMng_tThresLmbdLow_C /end DEF_CHARACTERISTIC
 /begin IN_MEASUREMENT APSCD_pVal ASMod_mAirPerCylCorr Eng_nAvrg Eng_tEng FlMng_mAirPerCylFltSmk_mp IATSCD_tAir PCR_pBGDev /end IN_MEASUREMENT
/end FUNCTION
/begin FUNCTION flmng_fullldrgl "Volllastreglung"
 /begin DEF_CHARACTERISTIC FlMng_FullLdRglIKi_CUR FlMng_qFullLdRglMax_C FlMng_qFullLdRglMin_C FlMng_FullLdRglPKp_CUR FlMng_rLmbdRecDvtMax_C FlMng_rLmbdRecDvtMin_C FlMng_dqSlpPos_C FlMng_dqSlpNeg_C FlMng_stEGTRglOff_C FlMng_swtFullLdRglVal_C FlMng_swtFullLdRglType_C FlMng_tiFullLdRglDel_CUR FlMng_trqEpsLim_C FlMng_trqEps_C /end DEF_CHARACTERISTIC
 /begin IN_MEASUREMENT Eng_nAvrg /end IN_MEASUREMENT
/end FUNCTION
/begin FUNCTION flmng_fullldrgl_msg "" /begin OUT_MEASUREMENT FlMng_qFullLdRgl FlMng_swtFullLdRgl /end OUT_MEASUREMENT /end FUNCTION
/begin FUNCTION flmng_fullldrgl_uic ""
 /begin OUT_MEASUREMENT FlMng_qFullLdRglI_mp FlMng_qFullLdRglP_mp FlMng_rLmbdRecDvt_mp FlMng_stMon_mp /end OUT_MEASUREMENT
/end FUNCTION
/begin FUNCTION flmng_fullldrgl_var "" /end FUNCTION
/begin FUNCTION flmng_fullldrgl_var_uic "" /end FUNCTION
/begin FUNCTION flmng_msg "" /begin OUT_MEASUREMENT FlMng_qLimSmk FlMng_rLmbdSet /end OUT_MEASUREMENT /end FUNCTION
/begin FUNCTION flmng_uic ""
 /begin OUT_MEASUREMENT FlMng_mAirPerCylFltSmk_mp FlMng_mAirPerCylLim_mp FlMng_qLimSmkDefect_mp FlMng_qLimSmk_mp FlMng_rLmbdAPSCor_mp FlMng_rLmbdSmk_mp FlMng_stCurrInp_mp FlMng_stDefect_mp FlMng_stGearGroup_mp FlMng_stSmkLim_mp FlMng_tiAirPerCylPT1_mp /end OUT_MEASUREMENT
/end FUNCTION
/begin FUNCTION flmng_var "" /end FUNCTION
/begin FUNCTION flmng_var_uic "" /end FUNCTION
/begin FUNCTION flsys_calccnvfac "Berechnung Umwandlungsfaktor von Einspritzmenge nach Einspritzvolumen" /begin DEF_CHARACTERISTIC FlSys_rhoFl_C FlSys_rhoFl_CUR /end DEF_CHARACTERISTIC /begin IN_MEASUREMENT FTSCD_tFuel /end IN_MEASUREMENT /end FUNCTION
/begin FUNCTION flsys_calccnvfac_msg "" /begin OUT_MEASUREMENT FlSys_rhoFl /end OUT_MEASUREMENT /end FUNCTION
/begin FUNCTION flsys_calccnvfac_uic "" /end FUNCTION
/begin FUNCTION flsys_deflate "Entlueftung des Niederdruckkreislaufs"
 /begin DEF_CHARACTERISTIC FlSys_nDeflateMax_C FlSys_nDeflateMin_C FlSys_pDeflate_C FlSys_tiDeflateDel_C /end DEF_CHARACTERISTIC
/end FUNCTION
/begin FUNCTION flsys_deflate_uic "" /begin OUT_MEASUREMENT FlSys_stDeflate_mp /end OUT_MEASUREMENT /end FUNCTION
/begin FUNCTION flsys_shofftst "Test des niederdruckseitigen Abstellpfades" /end FUNCTION
/begin FUNCTION flsys_shofftst_uic "" /end FUNCTION
/begin FUNCTION flsys_temp "Kraftstoffsystem-Temperatur"
 /begin DEF_CHARACTERISTIC FlSys_swtTempSel_C FlSys_swtTempSensCfgVal_C FlSys_swtTempSensCfgType_C FlSys_tDfl_C /end DEF_CHARACTERISTIC
/end FUNCTION
/begin FUNCTION flsys_temp_msg "" /begin OUT_MEASUREMENT FlSys_swtTempSensCfg FlSys_t /end OUT_MEASUREMENT /end FUNCTION
/begin FUNCTION flsys_temp_uic "" /begin OUT_MEASUREMENT FlSys_stTemp_mp /end OUT_MEASUREMENT /end FUNCTION
/begin FUNCTION fma_adapt "Mengenmittelwertadaption - Adaption des Einspritzmengen-Fehlermodells" /begin DEF_CHARACTERISTIC FMA_facDensCor_C /end DEF_CHARACTERISTIC /end FUNCTION
/begin FUNCTION fma_adapt_uic "" /begin OUT_MEASUREMENT FMA_qAct_mp FMA_qDev_mp /end OUT_MEASUREMENT /end FUNCTION
/begin FUNCTION fma_ctlcalc "Mengenmittelwertadaption - Berechnung des Einspritzmengenfehlers mittels adaptiver Steuerung" /begin DEF_CHARACTERISTIC FMA_swtIC_C /end DEF_CHARACTERISTIC /end FUNCTION
/begin FUNCTION fma_ctlcalc_msg "" /begin OUT_MEASUREMENT FMA_qDC FMA_qIC /end OUT_MEASUREMENT /end FUNCTION
/begin FUNCTION fma_ctlcalc_uic "" /begin OUT_MEASUREMENT FMA_qCtl_mp FMA_q_mp /end OUT_MEASUREMENT /end FUNCTION
/begin FUNCTION fma_errmod "Mengenmittelwertadaption - Algoithmen für Adaption und Auswertung des Fehlermodells für FMA_Adapt und FMA_CtlCalc"
 /begin DEF_CHARACTERISTIC FMA_facNQSwtOff_MAP FMA_IKiFst_C FMA_IKiPosFst_C FMA_IKiNegFst_C FMA_qIWinPosFst_C FMA_qIWinNegFst_C FMA_IKiSlw_C FMA_IKiPosSlw_C FMA_IKiNegSlw_C FMA_qIWinPosSlw_C FMA_qIWinNegSlw_C FMA_nGrid_C FMA_numNGrid_C FMA_numQGrid_C FMA_tiPT1Fst_C FMA_tiPT1Slw_C FMA_qGrid_C FMA_qIntMax_C FMA_qIntMin_C FMA_qMax_C FMA_qMin_C FMA_swtRst_C FMA_tiSwtPar_C /end DEF_CHARACTERISTIC
 /begin IN_MEASUREMENT Eng_nAvrg FMA_qCtl_mp /end IN_MEASUREMENT
 /begin OUT_MEASUREMENT FMA_qMapRow0_mp FMA_qMapRow1_mp FMA_qMapRow2_mp FMA_qMapRow3_mp FMA_qMapRow4_mp FMA_qMapRow5_mp FMA_qMapRow6_mp FMA_qMapRow7_mp /end OUT_MEASUREMENT
/end FUNCTION
/begin FUNCTION fma_errmod_uic ""
 /begin OUT_MEASUREMENT FMA_facNQSwtOff_mp FMA_facSwtOffTot_mp FMA_qDiff_mp FMA_qErrMod_mp FMA_qReg_mp FMA_qSetFil_mp FMA_tiFuncOp_mp /end OUT_MEASUREMENT
/end FUNCTION
/begin FUNCTION fma_monitor "Mengenmittelwertadaption - Überwachung und Abschaltung"
 /begin DEF_CHARACTERISTIC FMA_dfacSwtOffMax_C FMA_dqThrs_C FMA_drLmbdThrs_C FMA_facAirSwtOff_CUR FMA_facAPSwtOff_CUR FMA_facEngSwtOff_CUR FMA_facFlSwtOff_CUR FMA_nThrs_C FMA_qThrs_C FMA_rLmbdThrsMax_C FMA_rLmbdThrsMin_C FMA_stRgnMsk_C FMA_swtOnFMA_C FMA_tiDLmbdThrs_C FMA_tiDynThrs_C FMA_tiFaultRmp_C FMA_tiLmbdDT1_C FMA_tiLmbdThrs_C FMA_tiOvrRun_C FMA_tiQDT1_C FMA_tiQLmbd_C /end DEF_CHARACTERISTIC
 /begin IN_MEASUREMENT APSCD_pVal Eng_tEng FTSCD_tFuel IATSCD_tAir /end IN_MEASUREMENT
/end FUNCTION
/begin FUNCTION fma_monitor_msg "" /begin OUT_MEASUREMENT FMA_facSwtOff FMA_stSwtOff /end OUT_MEASUREMENT /end FUNCTION
/begin FUNCTION fma_monitor_uic ""
 /begin OUT_MEASUREMENT FMA_dqAbs_mp FMA_drLmbdAbs_mp FMA_facAirSwtOff_mp FMA_facAPSwtOff_mp FMA_facEngSwtOff_mp FMA_facFaultSwtOff_mp FMA_facFlSwtOff_mp FMA_facRgnSwtOff_mp FMA_facSlpSwtOff_mp FMA_stDynDlyd_mp FMA_stDynLmbd_mp FMA_stNoAdapt_mp FMA_stOvrRunDlyd_mp FMA_stReset_mp FMA_stRngLmbd_mp /end OUT_MEASUREMENT
/end FUNCTION
/begin FUNCTION fmtc "Masse/Momenten-Wandler"
 /begin DEF_CHARACTERISTIC FMTC_dqtrq2qBasRmpUp_C FMTC_dqtrq2qBasRmpDwn_C FMTC_eta0_C FMTC_stRgnMsk1_C FMTC_stRgnMsk2_C FMTC_tiRmpSlp_C FMTC_trq2qBasCBOpn_MAP FMTC_trq2qBas_MAP FMTC_trq2qRgn1_MAP FMTC_trq2qRgn2_MAP /end DEF_CHARACTERISTIC
 /begin IN_MEASUREMENT CoEng_trqInrSet Eng_nAvrg /end IN_MEASUREMENT
/end FUNCTION
/begin FUNCTION fmtc_calccorr "Berchnung des Wirkungsgrad Korrekturfaktors"
 /begin DEF_CHARACTERISTIC FMTC_facAirCorr_CUR FMTC_facAirCorr_MAP FMTC_facStrtInjCorr_CUR FMTC_facStrtInjCorr_MAP FMTC_mAirOpt_MAP FMTC_phiStrtInjOpt_MAP FMTC_swtCorr_C /end DEF_CHARACTERISTIC
 /begin IN_MEASUREMENT CoEng_trqInrSet Eng_nAvrg FMTC_mAirDiff_mp FMTC_phiStrtInjDiff_mp /end IN_MEASUREMENT
/end FUNCTION
/begin FUNCTION fmtc_calccorr_msg "" /begin OUT_MEASUREMENT FMTC_facEtaCor /end OUT_MEASUREMENT /end FUNCTION
/begin FUNCTION fmtc_calccorr_uic ""
 /begin OUT_MEASUREMENT FMTC_facAirCor_mp FMTC_facStrtInjCor_mp FMTC_mAirDiff_mp FMTC_mAirOpt_mp FMTC_phiStrtInjDiff_mp FMTC_phiStrtInjOpt_mp /end OUT_MEASUREMENT
/end FUNCTION
/begin FUNCTION fmtc_msg ""
 /begin OUT_MEASUREMENT FMTC_etaCurr FMTC_etaCurrStd FMTC_qCurr FMTC_qDes FMTC_qRaw FMTC_qSet FMTC_qStrt FMTC_trqInr FMTC_trqInrLimSmk /end OUT_MEASUREMENT
/end FUNCTION
/begin FUNCTION fmtc_uic ""
 /begin OUT_MEASUREMENT FMTC_qSetOptStd_mp FMTC_qSetRgn1_mp FMTC_qSetRgn2_mp FMTC_qSetStd_mp /end OUT_MEASUREMENT
/end FUNCTION
/begin COMPU_METHOD AirMassPerCyl "Luftmasse pro Zylinder" RAT_FUNC "%6.3" "mg/Hub" COEFFS 0 10 0 0 0 1 /end COMPU_METHOD
/begin COMPU_METHOD AngleCrS "Winkel Kurbelwelle" RAT_FUNC "%6.4" "deg CrS" COEFFS 0 42.6666666666667 0 0 0 1 /end COMPU_METHOD
/begin COMPU_METHOD DtyCyc "Tastverhaeltnis" RAT_FUNC "%6.4" "%" COEFFS 0 100 0 0 0 1 /end COMPU_METHOD
/begin COMPU_METHOD Dxs "Prozentsatz fuer DXs (-100% ... 100%)" RAT_FUNC "%7.6" "%" COEFFS 0 40000 0 0 0 1 /end COMPU_METHOD
/begin COMPU_METHOD EngN "Motordrehzahl" RAT_FUNC "%6.2" "rpm" COEFFS 0 1 0 0 0 1 /end COMPU_METHOD
/begin COMPU_METHOD EngN_float "Formel fuer die Drehzahl (Fließkomma)" RAT_FUNC "%6.2" "rpm" COEFFS 0 1 0 0 0 1 /end COMPU_METHOD
/begin COMPU_METHOD Eta "Umrechnugsformel für Wirkungsgradfaktor eta" RAT_FUNC "%6.4" "Nm/(mg/cyc)" COEFFS 0 128 0 0 0 1 /end COMPU_METHOD
/begin COMPU_METHOD ETClb_Eval_Rslt "Umrechnung der Zustände der  Ansteuerdauerkalibrierungsauswertung" TAB_VERB "%6.3" "-" COMPU_TAB_REF ETClb_Eval_Rslt /end COMPU_METHOD
/begin COMPU_VTAB ETClb_Eval_Rslt "Umrechnung der Zustände der  Ansteuerdauerkalibrierungsauswertung" TAB_VERB 3 0 "ZFC_ST_CLB_CONT" 1 "ZFC_ST_CLB_END" 2 "ZFC_ST_CLB_ERR" /end COMPU_VTAB
/begin COMPU_METHOD ETClb_Eval_State "Umrechnung der Zustände der Ausgabe des Zustandsautomaten der Evaluierung der Nullmengenkalibrierung" TAB_VERB "%6.3" "-" COMPU_TAB_REF ETClb_Eval_State /end COMPU_METHOD
/begin COMPU_VTAB ETClb_Eval_State "Umrechnung der Zustände der Ausgabe des Zustandsautomaten der Evaluierung der Nullmengenkalibrierung" TAB_VERB 3 0 "ETCLB_ST_EVAL_INIT" 1 "ETCLB_ST_EVAL_ADD" 2 "ETCLB_ST_EVAL_SUB" /end COMPU_VTAB
/begin COMPU_METHOD ETClb_State "Zustand des Zusandsautmaten der Ansteuerdauerkalibrierung" TAB_VERB "%6.3" "-" COMPU_TAB_REF ETClb_State /end COMPU_METHOD
/begin COMPU_VTAB ETClb_State "Zustand des Zusandsautmaten der Ansteuerdauerkalibrierung" TAB_VERB 4 0 "ETCLB_ST_NOT_ACTV" 1 "ETCLB_ST_START_ENERGIZE" 2 "ETCLB_ST_MEASURE" 3 "ETCLB_ST_EVALUATE" /end COMPU_VTAB
/begin COMPU_METHOD Fact "Faktor mit Auflösung 1 / 8192, hauptsächlich für einen Faktorenbereich 0...1 verwendet" RAT_FUNC "%6.5" "-" COEFFS 0 8192 0 0 0 1 /end COMPU_METHOD
/begin COMPU_METHOD FanSpd "(MAXSINT16 / FANSPD_MAX) * phys" RAT_FUNC "%6.3" "1/min" COEFFS 0 10.9223333333333 0 0 0 1 /end COMPU_METHOD
/begin COMPU_METHOD FBC_BPfac "Umrechnungsformel für drehmomentübersetzungsabhängige Bandpassverstärkung" RAT_FUNC "%6.4" "-" COEFFS 0 546.116666666667 0 0 0 1 /end COMPU_METHOD
/begin COMPU_METHOD FBC_GvrnIKi_float "Integrationskonstante für FBC" RAT_FUNC "%6.2" "mg/((1/min^2)*s)" COEFFS 0 1 0 0 0 1 /end COMPU_METHOD
/begin COMPU_METHOD FBC_GvrnPKp_float "Proportinalitäts-Faktor für FBC" RAT_FUNC "%6.2" "mg/(1/min^2)" COEFFS 0 1 0 0 0 1 /end COMPU_METHOD
/begin COMPU_METHOD FBC_LrnState "Zustände des FBC Zustandsautomaten" TAB_VERB "%6.3" "-" COMPU_TAB_REF FBC_LrnState /end COMPU_METHOD
/begin COMPU_VTAB FBC_LrnState "Zustände des FBC Zustandsautomaten" TAB_VERB 5 1 "INIT   " 2 "DX_WAIT" 3 "LEARN  " 4 "APPLY  " 5 "DELAY  " /end COMPU_VTAB
/begin COMPU_METHOD InjMass "Einspritzmenge" RAT_FUNC "%6.4" "mg/hub" COEFFS 0 100 0 0 0 1 /end COMPU_METHOD
/begin COMPU_METHOD InjMassCyc "Einspritzmenge pro Zyklus (mg/Zyklus)" RAT_FUNC "%6.4" "mg/cyc" COEFFS 0 100 0 0 0 1 /end COMPU_METHOD
/begin COMPU_METHOD InjMassInj "Einspritzmenge pro Einspritzung (mg/Einspritzung)" RAT_FUNC "%6.4" "mg/inj" COEFFS 0 100 0 0 0 1 /end COMPU_METHOD
/begin COMPU_METHOD InjMassNSlp "Steigung der Korrektureinspritzmenge aufgrund der Drehzahlrichtung" RAT_FUNC "%7.6" "(mg/hub)/rpm" COEFFS 0 10000 0 0 0 1 /end COMPU_METHOD
/begin COMPU_METHOD InjMassQSlp "Steigung der Korrektureinspritzmenge aufgrund der Mengenrichtung" RAT_FUNC "%6.4" "-" COEFFS 0 100 0 0 0 1 /end COMPU_METHOD
/begin COMPU_METHOD InjMassSec "Einspritzmenge pro Sekunde" RAT_FUNC "%6.4" "mg/hub/s" COEFFS 0 100 0 0 0 1 /end COMPU_METHOD
/begin COMPU_METHOD InjQntInj "Einspritzmenge der einzelnen Einspritzung" RAT_FUNC "%6.4" "mm^3/inj" COEFFS 0 100 0 0 0 1 /end COMPU_METHOD
/begin COMPU_METHOD InjTime_us "Zeit in Microsekunden für das Einspritztiming" RAT_FUNC "%6.2" "us" COEFFS 0 1 0 0 0 1 /end COMPU_METHOD
/begin COMPU_METHOD Ki "Integrale Verstärkung Ki (gleiche Einheit/Umrechnungsregel an Ein- und Ausgang)" RAT_FUNC "%6.5" "1/s" COEFFS 0 4294.967296 0 0 0 1 /end COMPU_METHOD
/begin COMPU_METHOD Ki_LmbdRec2InjMass "Integrationsverstärkung (reziprokes Lambda zu Einspritzmenge)" RAT_FUNC "%6.4" "mg/stroke/s" COEFFS 0 42.94967296 0 0 0 1 /end COMPU_METHOD
/begin COMPU_METHOD Kp_LmbdRec2InjMass_1 "Proportionale Verstärkung Kp (reziprokes Lambda zu Einspritzmenge)" RAT_FUNC "%6.4" "mg/stroke" COEFFS 0 81.92 0 0 0 1 /end COMPU_METHOD
/begin COMPU_METHOD lambda "Lambda" RAT_FUNC "%6.5" "-" COEFFS 0 1000 0 0 0 1 /end COMPU_METHOD
/begin COMPU_METHOD lambdaRec "Kehrwert von Lambda" RAT_FUNC "%7.6" "-" COEFFS 0 10000 0 0 0 1 /end COMPU_METHOD
/begin COMPU_METHOD lambdaSec "Lambda Aenderungsrate" RAT_FUNC "%6.5" "-/s" COEFFS 0 1000 0 0 0 1 /end COMPU_METHOD
/begin COMPU_METHOD NumPinDia "Verbale Umrechnung für Diagnose Signale" TAB_VERB "%6.3" "-" COMPU_TAB_REF NumPinDia /end COMPU_METHOD
/begin COMPU_VTAB NumPinDia "Verbale Umrechnung für Diagnose Signale" TAB_VERB 35 0 "CJ945_Diagnostic_Signal" 1 "AC_Compressor_DiaSig" 2 "Fuel_Pump_DiaSig" 3 "Starter_234" 4 "Oil_Pressure_Lamp_Switch_245" 5 "Engine_Bay_Air_Flaps_123" 6 "Glow_Relay_Diagnostic_Signal1" 7 "reserved Glow_Relay_Diagnostic_Signal2" 8 "Ebox_Fan_Actuator_Diagnostic_Signal_219" 9 "Shuttr_Actuator_Diagnostic_Signal_231" 10 "Twostage_TurboLoading_SW_DiaSig" 11 "DIO_OUT_DIAGNOSTIC_DUMMY_NOT_USED" 12 "1st_Pressure_Control_Valve_Diagnostic_Signal_172" 13 "2nd_Pressure_Control_Valve_Diagnostic_Signal_172" 14 "1st_Metering_Unit_Diagnostic_Signal_171" 15 "2nd_Metering_Unit_Diagnostic_Signal_171" 16 "Boost_Pressure_Actuator_Diagnostic_Signal_193" 17 "Boost_Pressure_Actuator_Diagnostic_Signal_193_2" 18 "EGR_Actuator_Diagnostic_Signal_194" 19 "EGR_Actuator_Diagnostic_Signal2" 20 "Variable_Swirl_Actuator_Diagnostic_Signal_195" 21 "Throttle_Valve_Diagnostic_Signal_196" 22 "Throttle_Valve2_Diagnostic_Signal_196" 23 "FAN_240" 24 "Add_On_Heater_244" 25 "EngM_Bearing_Actuator_Diagnostic_Signal_124" 26 "EngM_Bearing_Actuator_Diagnostic_Signal_121" 27 "Low pressure stage BPA_Diagnostic_Signal_117" 28 "PWM_DIAGNOSTIC_DUMMY_NOT_USED" 29 "1st_Sensor_Supply_Voltage_DiaSig" 30 "2nd_Sensor_Supply_Voltage_DiaSig" 31 "3rd_Sensor_Supply_Voltage_DiaSig" 32 "4th_Sensor_Supply_Voltage_DiaSig" 33 "5th_Sensor_Supply_Voltage_DiaSig" 34 "6th_Sensor_Supply_Voltage_DiaSig" /end COMPU_VTAB
/begin COMPU_METHOD NumPinDioIn "Verbale Umrechnung für Digitaleingang Signale" TAB_VERB "%6.3" "-" COMPU_TAB_REF NumPinDioIn /end COMPU_METHOD
/begin COMPU_VTAB NumPinDioIn "Verbale Umrechnung für Digitaleingang Signale" TAB_VERB 15 0 "Terminal_15_207" 1 "Main_Brake_Switch_236" 2 "Redundant_Brake_Switch_223" 3 "Clutch_Switch" 4 "Terminal_50_224" 5 "ECU_selection_Switch_251" 6 "FlFlt_Switch_211" 7 "Coolant-heater_212" 8 "Redundant_Terminal_15_209(118)" 9 "AC-compressor_overboost_213" 10 "Additive_tank_level_switch_235" 11 "Terminal_61_113" 12 "Lambda_Regeneration" 13 "OilLevelSensor_138" 14 "DIO_IN_DUMMY_NOT_USED" /end COMPU_VTAB
/begin COMPU_METHOD NumPinDioOut "Verbale Umrechnung für Digitalausgang Signale" TAB_VERB "%6.3" "-" COMPU_TAB_REF NumPinDioOut /end COMPU_METHOD
/begin COMPU_VTAB NumPinDioOut "Verbale Umrechnung für Digitalausgang Signale" TAB_VERB 11 0 "Main_Relay_220(144)" 1 "AC_Compressor" 2 "Fuel_Pump_232" 3 "Starter_234" 4 "OPS_Lamp_245" 5 "EBAF_123" 6 "Ebox_Fan_Actuator_219" 7 "Shuttr_Actuator_231" 8 "STATREG_PSOFF_Bit" 9 "Twostage_TurboLoading_120" 10 "DIO_OUT_DUMMY_NOT_USED" /end COMPU_VTAB
/begin COMPU_METHOD NumPinPwmOut "Verbale Umrechnung für PWM-Ausgang Signale" TAB_VERB "%6.3" "-" COMPU_TAB_REF NumPinPwmOut /end COMPU_METHOD
/begin COMPU_VTAB NumPinPwmOut "Verbale Umrechnung für PWM-Ausgang Signale" TAB_VERB 13 0 "Boost_Pressure_Actuator_193" 1 "EGR_Actuator_194" 2 "PCV_Actuator_172" 3 "MeUn_Actuator_171" 4 "Variable_Swirl_Actuator_195" 5 "Fan_Actuator_240" 6 "Add_On_Heater_244" 7 "EngM_Bearing_Actuator_124" 8 "EngM_Bearing_Actuator_121" 9 "Throttle Valve" 10 "LSU_Heater_PWMOutput" 11 "Low pressure stage BPA_117" 12 "PWM_DUMMY_NOT_USED" /end COMPU_VTAB
/begin COMPU_METHOD OneToOne "eins zu eins (physikalischer Wert ist gleich dem internen Wert)" RAT_FUNC "%6.2" "-" COEFFS 0 1 0 0 0 1 /end COMPU_METHOD
/begin COMPU_METHOD Per_Ratio "Umwandlung fuer Bereichsgewichtung" RAT_FUNC "%6.4" "-" COEFFS 0 256 0 0 0 1 /end COMPU_METHOD
/begin COMPU_METHOD PrcPerSec "Prozentänderung pro Sekunde für 20ms-Tasks" RAT_FUNC "%6.3" "%/s" COEFFS 0 1.6384 0 0 0 1 /end COMPU_METHOD
/begin COMPU_METHOD Prc_float "Prozent Umrechnung für float" RAT_FUNC "%6.0" "%" COEFFS 0 0.01 0 0 0 1 /end COMPU_METHOD
/begin COMPU_METHOD Pres_hPa "Druck (angezeigt in [hPa])" RAT_FUNC "%6.2" "hPa" COEFFS 0 1 0 0 0 1 /end COMPU_METHOD
/begin COMPU_METHOD Pres_Rail "Raildruck in hPa" RAT_FUNC "%4.3" "bar" COEFFS 0 10.000000 0 0 0 1 /end COMPU_METHOD
/begin COMPU_METHOD Pwr "Leistung" RAT_FUNC "%6.2" "W" COEFFS 0 0.10610329539459 0 0 0 1 /end COMPU_METHOD
/begin COMPU_METHOD RhoFuel "Kraftstoffdichte" RAT_FUNC "%6.3" "kg/m^3" COEFFS 0 10 0 0 0 1 /end COMPU_METHOD
/begin COMPU_METHOD RmpInjMass "Rampengradient für Einspritzmenge" RAT_FUNC "%6.5" "(mg/stroke)/s" COEFFS 0 6553.6 0 0 0 1 /end COMPU_METHOD
/begin COMPU_METHOD Rmp_Fact "Rampenfaktorgradient" RAT_FUNC "%8.7" "1/s" COEFFS 0 536870.912 0 0 0 1 /end COMPU_METHOD
/begin COMPU_METHOD Surge_Frq "Umrechung der Ruckelfrequenz in kritische Drehzahl für fNW=fRuck" RAT_FUNC "%6.4" "Hz" COEFFS 0 120 0 0 0 1 /end COMPU_METHOD
/begin COMPU_METHOD Temp_Cels "Temperatur dargestellt in °C (gleiche interne Darstellung wie Temp_Kelv)" RAT_FUNC "%6.1" "deg C" COEFFS 0 10 2731.4 0 0 1 /end COMPU_METHOD
/begin COMPU_METHOD TimeDeb "Entprellzeit in Millisekunden für Libraryfunktion Debounce" RAT_FUNC "%6.1" "ms" COEFFS 0 0.1 0 0 0 1 /end COMPU_METHOD
/begin COMPU_METHOD TimeDelay_s "Zeitkonstante T1 (in s) für PT1, DT1, etc." RAT_FUNC "%9.3" "s" COEFFS 0 0 1 0 0.00023283064365387 0 /end COMPU_METHOD
/begin COMPU_METHOD TimeDelay_s_2 "Zeitkonstante T1 (in s) für PT1, DT1, etc. normiert auf 16 bit" RAT_FUNC "%9.4" "s" COEFFS 0 0 1 0 0.0596046447753906 0 /end COMPU_METHOD
/begin COMPU_METHOD TimeEGTRmp "Umrechnung  Zeit in Rampensteigung,  Verwendet in EGT-Bibliothek" RAT_FUNC "%6.3" "s" COEFFS 0 0 1 0 0.0152587890625 0 /end COMPU_METHOD
/begin COMPU_METHOD Time_ms "Zeit in ms für Fehlerentprellung (DSM) und SW-Timer" RAT_FUNC "%6.1" "ms" COEFFS 0 0.1 0 0 0 1 /end COMPU_METHOD
/begin COMPU_METHOD Time_s "Zeit in s für Fehlerentprellung (DSM) und SW-Timer" RAT_FUNC "%6.4" "s" COEFFS 0 100 0 0 0 1 /end COMPU_METHOD
/begin COMPU_METHOD TransR "Übersetzungsverhältnis (Getriebe etc.)" RAT_FUNC "%6.4" "-" COEFFS 0 100 0 0 0 1 /end COMPU_METHOD
/begin COMPU_METHOD Trq "Motormoment" RAT_FUNC "%6.3" "Nm" COEFFS 0 10 0 0 0 1 /end COMPU_METHOD
/begin COMPU_METHOD Vel "Fahrzeuggeschwindigkeit, gleiche interne Auflösung wie Vel_SI" RAT_FUNC "%6.4" "km/h" COEFFS 0 100 0 0 0 1 /end COMPU_METHOD
/begin COMPU_METHOD Volt_Batt "Batteriespannung" RAT_FUNC "%6.1" "mV" COEFFS 0 0.05115 0 0 0 1 /end COMPU_METHOD
/begin RECORD_LAYOUT Kf_Xs16_Ys16_Ws16 NO_AXIS_PTS_X 1 SWORD NO_AXIS_PTS_Y 2 SWORD AXIS_PTS_X 3 SWORD INDEX_INCR DIRECT AXIS_PTS_Y 4 SWORD INDEX_INCR DIRECT FNC_VALUES 5 SWORD COLUMN_DIR DIRECT /end RECORD_LAYOUT
/begin RECORD_LAYOUT Kl_Xs16_Ws16 NO_AXIS_PTS_X 1 SWORD AXIS_PTS_X 2 SWORD INDEX_INCR DIRECT FNC_VALUES 3 SWORD COLUMN_DIR DIRECT /end RECORD_LAYOUT
/begin RECORD_LAYOUT Kwb_Wr32 FNC_VALUES 1 FLOAT32_IEEE COLUMN_DIR DIRECT /end RECORD_LAYOUT
/begin RECORD_LAYOUT Kwb_Ws16 FNC_VALUES 1 SWORD COLUMN_DIR DIRECT /end RECORD_LAYOUT
/begin RECORD_LAYOUT Kwb_Wu16 FNC_VALUES 1 UWORD COLUMN_DIR DIRECT /end RECORD_LAYOUT
/begin RECORD_LAYOUT Kwb_Wu8 FNC_VALUES 1 UBYTE COLUMN_DIR DIRECT /end RECORD_LAYOUT
/begin RECORD_LAYOUT Kw_Wr32 FNC_VALUES 1 FLOAT32_IEEE COLUMN_DIR DIRECT /end RECORD_LAYOUT
/begin RECORD_LAYOUT Kw_Ws16 FNC_VALUES 1 SWORD COLUMN_DIR DIRECT /end RECORD_LAYOUT
/begin RECORD_LAYOUT Kw_Ws32 FNC_VALUES 1 SLONG COLUMN_DIR DIRECT /end RECORD_LAYOUT
/begin RECORD_LAYOUT Kw_Ws8 FNC_VALUES 1 SBYTE COLUMN_DIR DIRECT /end RECORD_LAYOUT
/begin RECORD_LAYOUT Kw_Wu16 FNC_VALUES 1 UWORD COLUMN_DIR DIRECT /end RECORD_LAYOUT
/begin RECORD_LAYOUT Kw_Wu32 FNC_VALUES 1 ULONG COLUMN_DIR DIRECT /end RECORD_LAYOUT
/begin RECORD_LAYOUT Kw_Wu8 FNC_VALUES 1 UBYTE COLUMN_DIR DIRECT /end RECORD_LAYOUT
/end MODULE
/end PROJECT
