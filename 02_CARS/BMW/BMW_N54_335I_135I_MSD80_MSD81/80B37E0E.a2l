ASAP2_VERSION 1 41
/begin PROJECT MSD70 "Spray Guided DI-System with Piezo Injectors for 6-Cylinder"
/begin HEADER "_default_HeaderComment" PROJECT_NO _0B /end HEADER
/begin MODULE _default_ModuleName "_default_ModuleLongIdentifier"
/begin MOD_COMMON "_default_ModCommonComment" DEPOSIT ABSOLUTE BYTE_ORDER MSB_LAST ALIGNMENT_BYTE 1 ALIGNMENT_WORD 2 ALIGNMENT_LONG 2 ALIGNMENT_FLOAT32_IEEE 2 ALIGNMENT_FLOAT64_IEEE 4 /end MOD_COMMON
/begin MEASUREMENT Ag_ewp_help_1 "" UBYTE _CNV_R_R_Def_f_ub_b_573_CM 1 100. 0. 0.996 DISPLAY_IDENTIFIER AG_EWP_HELP_1 ECU_ADDRESS 0xc00050d0 /end MEASUREMENT
/begin MEASUREMENT Ag_ewp_help_2 "" SWORD _CNV_R_R_Def_m_sw_q_574_CM 1 100. -3276.8 3276.7 DISPLAY_IDENTIFIER AG_EWP_HELP_2 ECU_ADDRESS 0xc00050ca FORMAT "%7.2" /end MEASUREMENT
/begin MEASUREMENT Ag_ewp_help_3 "" SWORD _CNV_R_R_Def_m_sw_q_574_CM 1 100. -3276.8 3276.7 DISPLAY_IDENTIFIER AG_EWP_HELP_3 ECU_ADDRESS 0xc00050cc FORMAT "%7.2" /end MEASUREMENT
/begin MEASUREMENT Ag_ewp_help_4 "" SLONG _CNV_R_R_Def_dez_sl_575_CM 1 100. -7483648. 7483647. DISPLAY_IDENTIFIER AG_EWP_HELP_4 ECU_ADDRESS 0xc00050c2 FORMAT "%7.0" /end MEASUREMENT
/begin MEASUREMENT Ag_ewp_help_5 "" UWORD _CNV_R_R_Def_dez_sl_575_CM 1 100. 0. 65535. DISPLAY_IDENTIFIER AG_EWP_HELP_5 ECU_ADDRESS 0xc00050ce FORMAT "%5.0" /end MEASUREMENT
/begin MEASUREMENT Agr_rate "AGR-Rate" UWORD _CNV_R_R_Def_f_uw_b_576_CM 1 100. 0. 99.9984 DISPLAY_IDENTIFIER AGR_RATE ECU_ADDRESS 0xd000697c FORMAT "%8.3" /end MEASUREMENT
/begin MEASUREMENT B_dtes "Aktive Diagnose TEV" UBYTE _CNV_R_R_Def_dez_sl_575_CM 1 100. 0. 255. DISPLAY_IDENTIFIER B_DTES ECU_ADDRESS 0xd0006968 FORMAT "%3.0" /end MEASUREMENT
/begin MEASUREMENT Ba_switch_uek "Schalter für Wandfilmkompensation" UBYTE _CNV_R_R_Def_dez_sl_575_CM 1 100. 0. 255. DISPLAY_IDENTIFIER BA_SWITCH_UEK ECU_ADDRESS 0xc00029bd FORMAT "%3.0" /end MEASUREMENT
/begin MEASUREMENT Ba_wm_ist "Ist Betriebsart Wärmemanagement" UBYTE _CNV_S_11_Def_ba_wm_590_CM 1 100. 0. 10. DISPLAY_IDENTIFIER BA_WM_IST ECU_ADDRESS 0xc00050d8 BIT_MASK 0xFF /end MEASUREMENT
/begin MEASUREMENT Ba_wm_prio "Priorisierte Betriebsart Wärmemanagement" UBYTE _CNV_S_11_Def_ba_wm_590_CM 1 100. 0. 10. DISPLAY_IDENTIFIER BA_WM_PRIO ECU_ADDRESS 0xc00050d9 BIT_MASK 0xFF /end MEASUREMENT
/begin MEASUREMENT Ba_wm_soll "Soll Betriebsart Wärmemanagement" UBYTE _CNV_S_11_Def_ba_wm_590_CM 1 100. 0. 10. DISPLAY_IDENTIFIER BA_WM_SOLL ECU_ADDRESS 0xc00050da BIT_MASK 0xFF /end MEASUREMENT
/begin MEASUREMENT Bapr_wm_appl "Hilfsgrösse" UWORD _CNV_R_R_Def_dez_sl_575_CM 1 100. 0. 65535. DISPLAY_IDENTIFIER BAPR_WM_APPL ECU_ADDRESS 0xc00050dc FORMAT "%5.0" /end MEASUREMENT
/begin MEASUREMENT Bapr_wm_bfel "Hilfsgrösse" UWORD _CNV_R_R_Def_dez_sl_575_CM 1 100. 0. 65535. DISPLAY_IDENTIFIER BAPR_WM_BFEL ECU_ADDRESS 0xc00050de FORMAT "%5.0" /end MEASUREMENT
/begin MEASUREMENT Bapr_wm_bs "Hilfsgrösse" UWORD _CNV_R_R_Def_dez_sl_575_CM 1 100. 0. 65535. DISPLAY_IDENTIFIER BAPR_WM_BS ECU_ADDRESS 0xc00050e0 FORMAT "%5.0" /end MEASUREMENT
/begin MEASUREMENT Bapr_wm_gbtr "Hilfsgrösse" UWORD _CNV_R_R_Def_dez_sl_575_CM 1 100. 0. 65535. DISPLAY_IDENTIFIER BAPR_WM_GBTR ECU_ADDRESS 0xc00050e2 FORMAT "%5.0" /end MEASUREMENT
/begin MEASUREMENT Bapr_wm_heizl "Hilfsgrösse" UWORD _CNV_R_R_Def_dez_sl_575_CM 1 100. 0. 65535. DISPLAY_IDENTIFIER BAPR_WM_HEIZL ECU_ADDRESS 0xc00050e4 FORMAT "%5.0" /end MEASUREMENT
/begin MEASUREMENT Bapr_wm_nfks "Hilfsgrösse" UWORD _CNV_R_R_Def_dez_sl_575_CM 1 100. 0. 65535. DISPLAY_IDENTIFIER BAPR_WM_NFKS ECU_ADDRESS 0xc00050e6 FORMAT "%5.0" /end MEASUREMENT
/begin MEASUREMENT Bapr_wm_warm "Hilfsgrösse" UWORD _CNV_R_R_Def_dez_sl_575_CM 1 100. 0. 65535. DISPLAY_IDENTIFIER BAPR_WM_WARM ECU_ADDRESS 0xc00050e8 FORMAT "%5.0" /end MEASUREMENT
/begin MEASUREMENT Baw_wm_heizl "Hilfsgrösse" UBYTE _CNV_R_R_Def_dez_sl_575_CM 1 100. 0. 255. DISPLAY_IDENTIFIER BAW_WM_HEIZL ECU_ADDRESS 0xc00050f4 FORMAT "%3.0" /end MEASUREMENT
/begin MEASUREMENT Bd_fofu "Brenndauer Folgefunken" UWORD _CNV_R_R_Def_td_uw__592_CM 1 100. 0. 65.535 DISPLAY_IDENTIFIER BD_FOFU ECU_ADDRESS 0xd000698e FORMAT "%8.3" /end MEASUREMENT
/begin MEASUREMENT Ctrpwrentl "Prio CF aufgrund Entlastung" UWORD _CNV_R_R_Def_dez_sl_575_CM 1 100. 0. 65535. DISPLAY_IDENTIFIER CTRPWRENTL ECU_ADDRESS 0xd000697a FORMAT "%5.0" /end MEASUREMENT
/begin MEASUREMENT Dtes12_s "(schicht)" SWORD _CNV_R_R_Def_td_sw__619_CM 1 100. -131.072 131.068 DISPLAY_IDENTIFIER DTES12_S ECU_ADDRESS 0xd000711c FORMAT "%8.3" /end MEASUREMENT
/begin MEASUREMENT Dtkwsoll "Regeldifferenz KFT" SWORD _CNV_R_R_Def_t_sw_q_620_CM 1 100. -327.68 327.67 DISPLAY_IDENTIFIER DTKWSOLL ECU_ADDRESS 0xc0002a7c FORMAT "%7.2" /end MEASUREMENT
/begin MEASUREMENT Dwese2_bas_h "" SWORD _CNV_R_R_Def_kw_sw__622_CM 1 100. -768. 767.9765 DISPLAY_IDENTIFIER DWESE2_BAS_H ECU_ADDRESS 0xd0007110 FORMAT "%8.3" /end MEASUREMENT
/begin MEASUREMENT Dwese2_h "" SWORD _CNV_R_R_Def_kw_sw__622_CM 1 100. -768. 767.9765 DISPLAY_IDENTIFIER DWESE2_H ECU_ADDRESS 0xd00070d8 FORMAT "%8.3" ARRAY_SIZE 6 MATRIX_DIM 6 1 1 /end MEASUREMENT
/begin MEASUREMENT Dwese_hs "Deltawinkel auf Zündwinkel geschichtet aus Kennfeld (homogen-schicht)" SWORD _CNV_R_R_Def_kw_sw__622_CM 1 100. -768. 767.9765 DISPLAY_IDENTIFIER DWESE_HS ECU_ADDRESS 0xd0007116 FORMAT "%8.3" /end MEASUREMENT
/begin MEASUREMENT Dwese_s "Deltawinkel auf Zündwinkel geschichtet aus Kennfeld (schicht)" SWORD _CNV_R_R_Def_kw_sw__622_CM 1 100. -768. 767.9765 DISPLAY_IDENTIFIER DWESE_S ECU_ADDRESS 0xd0007114 FORMAT "%8.3" /end MEASUREMENT
/begin MEASUREMENT Dwesest_h "" SWORD _CNV_R_R_Def_kw_sw__622_CM 1 100. -768. 767.9765 DISPLAY_IDENTIFIER DWESEST_H ECU_ADDRESS 0xd0007112 FORMAT "%8.3" /end MEASUREMENT
/begin MEASUREMENT Dzw_agr_s "Deltazündwinkel AGR (schicht)" SWORD _CNV_R_R_Def_zw_sw__599_CM 1 100. -50. 60. DISPLAY_IDENTIFIER DZW_AGR_S ECU_ADDRESS 0xd0006cb6 FORMAT "%6.1" /end MEASUREMENT
/begin MEASUREMENT Dzw_hs "Deltazündwinkel (homogen-schicht)" SWORD _CNV_R_R_Def_zw_sw__599_CM 1 100. -50. 60. DISPLAY_IDENTIFIER DZW_HS ECU_ADDRESS 0xd0006cbe FORMAT "%6.1" /end MEASUREMENT
/begin MEASUREMENT Dzw_kr_hs "" SWORD _CNV_R_R_Def_zw_sw__599_CM 1 100. -50. 60. DISPLAY_IDENTIFIER DZW_KR_HS ECU_ADDRESS 0xd0006c98 FORMAT "%6.1" ARRAY_SIZE 6 MATRIX_DIM 6 1 1 /end MEASUREMENT
/begin MEASUREMENT Dzw_rf_s "Deltazündwinkel (schicht)" SWORD _CNV_R_R_Def_zw_sw__599_CM 1 100. -50. 60. DISPLAY_IDENTIFIER DZW_RF_S ECU_ADDRESS 0xd0006cb8 FORMAT "%6.1" /end MEASUREMENT
/begin MEASUREMENT Etazw_hs "Zündwinkelwirkungsgrad (homogen-schicht)" UWORD _CNV_R_R_Def_eta_uw_627_CM 1 100. 0. 199.9969 DISPLAY_IDENTIFIER ETAZW_HS ECU_ADDRESS 0xd0006c94 FORMAT "%8.3" /end MEASUREMENT
/begin MEASUREMENT Exwink_ist "-" UWORD _CNV_R_R_Def_exwink_601_CM 1 100. 0. 180. DISPLAY_IDENTIFIER EXWINK_IST ECU_ADDRESS 0xd0006980 FORMAT "%7.2" /end MEASUREMENT
/begin MEASUREMENT Exwinkkor "Korrekturwinkel Excenterwelle zur Hubkorrektur" SWORD _CNV_R_R_Def_exwink_601_CM 1 100. -720. 180. DISPLAY_IDENTIFIER EXWINKKOR ECU_ADDRESS 0xd0006982 FORMAT "%7.2" /end MEASUREMENT
/begin MEASUREMENT F_ewp_ba "Fakto eWAPU" UBYTE _CNV_R_R_Def_f_ub_b_573_CM 1 100. 0. 0.996 DISPLAY_IDENTIFIER F_EWP_BA ECU_ADDRESS 0xc0005180 /end MEASUREMENT
/begin MEASUREMENT F_ewp_co "Faktor Fcool" UBYTE _CNV_R_R_Def_f_ub_b_573_CM 1 100. 0. 0.996 DISPLAY_IDENTIFIER F_EWP_CO ECU_ADDRESS 0xc00050d1 /end MEASUREMENT
/begin MEASUREMENT F_ewpw_ba "Fakto eWAPU" UBYTE _CNV_R_R_Def_f_ub_b_573_CM 1 100. 0. 0.996 DISPLAY_IDENTIFIER F_EWPW_BA ECU_ADDRESS 0xc0005181 /end MEASUREMENT
/begin MEASUREMENT F_kft_ba "Faktor KFT" UBYTE _CNV_R_R_Def_f_ub_b_573_CM 1 100. 0. 0.996 DISPLAY_IDENTIFIER F_KFT_BA ECU_ADDRESS 0xc0005182 /end MEASUREMENT
/begin MEASUREMENT F_kftw_ba "Faktor KFT" UBYTE _CNV_R_R_Def_f_ub_b_573_CM 1 100. 0. 0.996 DISPLAY_IDENTIFIER F_KFTW_BA ECU_ADDRESS 0xc0005183 /end MEASUREMENT
/begin MEASUREMENT F_kuehln "Leistungsreduzierung bei hoher Drehzahl" UWORD _CNV_R_R_Def_f_uw_b_580_CM 1 100. 0. 63.999 DISPLAY_IDENTIFIER F_KUEHLN ECU_ADDRESS 0xc000514a FORMAT "%9.4" /end MEASUREMENT
/begin MEASUREMENT F_kuehlvred "Leistungsreduzierung bei hohem Tget" UWORD _CNV_R_R_Def_f_uw_b_630_CM 1 100. 0. 2047.9687 DISPLAY_IDENTIFIER F_KUEHLVRED ECU_ADDRESS 0xc000514c FORMAT "%7.2" /end MEASUREMENT
/begin MEASUREMENT F_mdres_wm "Faktor für Momentenvorhalt über Tmot_start und Tn_start_10" UBYTE _CNV_R_R_Def_f_ub_b_573_CM 1 100. 0. 0.996 DISPLAY_IDENTIFIER F_MDRES_WM ECU_ADDRESS 0xc000516c /end MEASUREMENT
/begin MEASUREMENT F_nelueft_v "Faktor Fahrgeschwindigkeit für E-Lüfter Ansteuerung" UBYTE _CNV_R_R_Def_f_ub_b_573_CM 1 100. 0. 0.996 DISPLAY_IDENTIFIER F_NELUEFT_V ECU_ADDRESS 0xc000516d /end MEASUREMENT
/begin MEASUREMENT F_sicher_rf "Überblendfaktor aus Verbrennungsregelung für Hub und Spreizungen" UBYTE _CNV_R_R_Def_f_ub_b_573_CM 1 100. 0. 0.996 DISPLAY_IDENTIFIER F_SICHER_RF ECU_ADDRESS 0xd0006969 /end MEASUREMENT
/begin MEASUREMENT F_sicher_zw "Überblendfaktor aus Verbrennungsregelung für Zündwinkel" UBYTE _CNV_R_R_Def_f_ub_b_573_CM 1 100. 0. 0.996 DISPLAY_IDENTIFIER F_SICHER_ZW ECU_ADDRESS 0xd000696d /end MEASUREMENT
/begin MEASUREMENT F_spr_ba "Faktor Umschaltung Spreizung" UBYTE _CNV_R_R_Def_f_ub_b_573_CM 1 100. 0. 0.996 DISPLAY_IDENTIFIER F_SPR_BA ECU_ADDRESS 0xd000696a /end MEASUREMENT
/begin MEASUREMENT F_teblg "Beladungsgrad AKF" SWORD _CNV_R_R_Def_f_sw_b_634_CM 1 100. -64. 63.998 DISPLAY_IDENTIFIER F_TEBLG ECU_ADDRESS 0xd000697e FORMAT "%8.3" /end MEASUREMENT
/begin MEASUREMENT G_zspul "Leitwert Zündspule" UWORD _CNV_R_R_Def_g_uw_b_640_CM 1 100. 0. 127.998 DISPLAY_IDENTIFIER G_ZSPUL ECU_ADDRESS 0xd000699a FORMAT "%5.0" /end MEASUREMENT
/begin MEASUREMENT Gen_i_temp "" UBYTE _CNV_R_R_DEZ_436_CM 1 100. 0. 255. DISPLAY_IDENTIFIER GEN_I_TEMP ECU_ADDRESS 0xc00029be /end MEASUREMENT
/begin MEASUREMENT I_zlim "Limitierter Zündstrom" SWORD _CNV_R_R_Def_i_sw_q_650_CM 1 100. -32.768 32.767 DISPLAY_IDENTIFIER I_ZLIM ECU_ADDRESS 0xd0006996 FORMAT "%8.3" /end MEASUREMENT
/begin MEASUREMENT I_zuend "Zuendstrom" SWORD _CNV_R_R_Def_i_sw_q_650_CM 1 100. -32.768 32.767 DISPLAY_IDENTIFIER I_ZUEND ECU_ADDRESS 0xd0006998 FORMAT "%8.3" /end MEASUREMENT
/begin MEASUREMENT Kft_d "Ausgangswert KFT-Regler Differentialanteil" SWORD _CNV_R_R_Def_rel_sw_584_CM 1 100. -100. 99.9969 DISPLAY_IDENTIFIER KFT_D ECU_ADDRESS 0xc0002a84 FORMAT "%8.3" /end MEASUREMENT
/begin MEASUREMENT Kft_i "Ausgangswert KFT-Regler Integralanteil" SWORD _CNV_R_R_Def_rel_sw_584_CM 1 100. -100. 99.9969 DISPLAY_IDENTIFIER KFT_I ECU_ADDRESS 0xc0002a82 FORMAT "%8.3" /end MEASUREMENT
/begin MEASUREMENT Kft_p "Ausgangswert KFT-Regler Proportionalanteil" SWORD _CNV_R_R_Def_rel_sw_584_CM 1 100. -100. 99.9969 DISPLAY_IDENTIFIER KFT_P ECU_ADDRESS 0xc0002a80 FORMAT "%8.3" /end MEASUREMENT
/begin MEASUREMENT Kft_p_loc "Eingangswert KFT-Regler Proportionalanteil" UWORD _CNV_R_R_Def_f_uw_b_580_CM 1 100. 0. 63.999 DISPLAY_IDENTIFIER KFT_P_LOC ECU_ADDRESS 0xc0002a76 FORMAT "%9.4" /end MEASUREMENT
/begin MEASUREMENT Kft_status "Statuswert KFT-Regler" UBYTE _CNV_R_R_Def_dez_sl_575_CM 1 100. 0. 255. DISPLAY_IDENTIFIER KFT_STATUS ECU_ADDRESS 0xc0002a74 FORMAT "%3.0" /end MEASUREMENT
/begin MEASUREMENT Lurabs_f "gefilterte Laufunruhedeltas eines Zylinders" SWORD _CNV_R_R_Def_f_sw_q_658_CM 1 100. -3276.8 3276.7 DISPLAY_IDENTIFIER LURABS_F ECU_ADDRESS 0xd000695c FORMAT "%7.2" ARRAY_SIZE 6 MATRIX_DIM 6 1 1 /end MEASUREMENT
/begin MEASUREMENT Lurdif_f "gefilterte mittlere Abweichung des Lur-Wertes" SWORD _CNV_R_R_Def_f_sw_q_658_CM 1 100. -3276.8 3276.7 DISPLAY_IDENTIFIER LURDIF_F ECU_ADDRESS 0xd0006950 FORMAT "%7.2" ARRAY_SIZE 6 MATRIX_DIM 6 1 1 /end MEASUREMENT
/begin MEASUREMENT Md_kuehl_ap "Momentenreduzierung Ba Applikation" SWORD _CNV_R_R_Def_m_sw_q_574_CM 1 100. -3276.8 3276.7 DISPLAY_IDENTIFIER MD_KUEHL_AP ECU_ADDRESS 0xc0005136 FORMAT "%7.2" /end MEASUREMENT
/begin MEASUREMENT Md_kuehl_wa "Momentenreduzierung Ba Warmlauf" SWORD _CNV_R_R_Def_m_sw_q_574_CM 1 100. -3276.8 3276.7 DISPLAY_IDENTIFIER MD_KUEHL_WA ECU_ADDRESS 0xc0005138 FORMAT "%7.2" /end MEASUREMENT
/begin MEASUREMENT Md_max_klima "Begrenzungsmoment Klimakompressor" SWORD _CNV_R_R_Def_m_sw_q_574_CM 1 100. -3276.8 3276.7 DISPLAY_IDENTIFIER MD_MAX_KLIMA ECU_ADDRESS 0xc00050fc FORMAT "%7.2" /end MEASUREMENT
/begin MEASUREMENT Mdi_ist_m "optimales Moment" SWORD _CNV_R_R_Def_m_sw_q_574_CM 1 100. -3276.8 3276.7 DISPLAY_IDENTIFIER MDI_IST_M ECU_ADDRESS 0xd0006948 FORMAT "%7.2" /end MEASUREMENT
/begin MEASUREMENT Mdi_res_he "Momentenreserve WMK in BA Heizleistung" SWORD _CNV_R_R_Def_m_sw_q_574_CM 1 100. -3276.8 3276.7 DISPLAY_IDENTIFIER MDI_RES_HE ECU_ADDRESS 0xc000513a FORMAT "%7.2" /end MEASUREMENT
/begin MEASUREMENT Mdi_res_he1 "Hilfsgrösse 1 für Momentenreserve WMK in BA HE" SWORD _CNV_R_R_Def_m_sw_q_574_CM 1 100. -3276.8 3276.7 DISPLAY_IDENTIFIER MDI_RES_HE1 ECU_ADDRESS 0xc000513c FORMAT "%7.2" /end MEASUREMENT
/begin MEASUREMENT Mdi_res_he2 "Hilfsgrösse 2 für Momentenreserve WMK in BA HE" SWORD _CNV_R_R_Def_m_sw_q_574_CM 1 100. -3276.8 3276.7 DISPLAY_IDENTIFIER MDI_RES_HE2 ECU_ADDRESS 0xc000513e FORMAT "%7.2" /end MEASUREMENT
/begin MEASUREMENT Mdi_res_he3 "Hilfsgrösse 3 für Momentenreserve WMK in BA HE" SWORD _CNV_R_R_Def_m_sw_q_574_CM 1 100. -3276.8 3276.7 DISPLAY_IDENTIFIER MDI_RES_HE3 ECU_ADDRESS 0xc0005140 FORMAT "%7.2" /end MEASUREMENT
/begin MEASUREMENT Mdi_res_hom_mag "Momentenreserve für Umschaltung homogen mager" SWORD _CNV_R_R_Def_m_sw_q_574_CM 1 100. -3276.8 3276.7 DISPLAY_IDENTIFIER MDI_RES_HOM_MAG ECU_ADDRESS 0xd000694a FORMAT "%7.2" /end MEASUREMENT
/begin MEASUREMENT Mdi_res_wm "Anforderung Momentenreserve für Wärmemanagement" SWORD _CNV_R_R_Def_m_sw_q_574_CM 1 100. -3276.8 3276.7 DISPLAY_IDENTIFIER MDI_RES_WM ECU_ADDRESS 0xc00050fe FORMAT "%7.2" /end MEASUREMENT
/begin MEASUREMENT Mdk_ewp "Berechnetes Nutzmoment" SWORD _CNV_R_R_Def_m_sw_q_574_CM 1 100. -3276.8 3276.7 DISPLAY_IDENTIFIER MDK_EWP ECU_ADDRESS 0xc00050b8 FORMAT "%7.2" /end MEASUREMENT
/begin MEASUREMENT Mdk_ewp_help "Hilfsgrösse für KF_GBTR" SWORD _CNV_R_R_Def_m_sw_q_574_CM 1 100. -3276.8 3276.7 DISPLAY_IDENTIFIER MDK_EWP_HELP ECU_ADDRESS 0xc00050d4 FORMAT "%7.2" /end MEASUREMENT
/begin MEASUREMENT Mdk_ext_minus "" SWORD _CNV_R_R_Def_m_sw_q_574_CM 1 100. -3276.8 3276.7 DISPLAY_IDENTIFIER MDK_EXT_MINUS ECU_ADDRESS 0xd0006986 FORMAT "%7.2" /end MEASUREMENT
/begin MEASUREMENT Mdk_ext_plus "" SWORD _CNV_R_R_Def_m_sw_q_574_CM 1 100. -3276.8 3276.7 DISPLAY_IDENTIFIER MDK_EXT_PLUS ECU_ADDRESS 0xd0006984 FORMAT "%7.2" /end MEASUREMENT
/begin MEASUREMENT Mdk_kuehl_help "Momentenreduzierung BA Bauteilschutz, Notfall" SWORD _CNV_R_R_Def_m_sw_q_574_CM 1 100. -3276.8 3276.7 DISPLAY_IDENTIFIER MDK_KUEHL_HELP ECU_ADDRESS 0xc0005142 FORMAT "%7.2" /end MEASUREMENT
/begin MEASUREMENT Mdk_kuehl_mx "Leistungsreduzierung Wärmemanagementkoodinator" SWORD _CNV_R_R_Def_m_sw_q_574_CM 1 100. -3276.8 3276.7 DISPLAY_IDENTIFIER MDK_KUEHL_MX ECU_ADDRESS 0xc0005100 FORMAT "%7.2" /end MEASUREMENT
/begin MEASUREMENT Minhub "" UWORD _CNV_R_R_Def_hub_uw_605_CM 1 100. 0. 65.535 DISPLAY_IDENTIFIER MINHUB ECU_ADDRESS 0xc00029c4 FORMAT "%8.3" /end MEASUREMENT
/begin MEASUREMENT Ms_hub_inv "Massenstrom Zylinder durch invertierter Hub-kennfelder" UWORD _CNV_R_R_Def_ms_uw__611_CM 1 100. 0. 2047.9687 DISPLAY_IDENTIFIER MS_HUB_INV ECU_ADDRESS 0xd0006944 FORMAT "%8.3" /end MEASUREMENT
/begin MEASUREMENT Mszyl_hub_inv "Korrigierter Massenstrom Zylinder durch invertierter Hub-kennfelder" UWORD _CNV_R_R_Def_ms_uw__611_CM 1 100. 0. 2047.9687 DISPLAY_IDENTIFIER MSZYL_HUB_INV ECU_ADDRESS 0xd0006946 FORMAT "%8.3" /end MEASUREMENT
/begin MEASUREMENT Nelueft_eco "Tkwsoll für BA-ECO" UBYTE _CNV_R_R_Def_f_ub_b_602_CM 1 100. 0. 99.60930000000001 DISPLAY_IDENTIFIER NELUEFT_ECO ECU_ADDRESS 0xc000516e FORMAT "%5.2" /end MEASUREMENT
/begin MEASUREMENT Nelueft_ext_h1 "E-Lüfter Ansteuerung vor KL_EL_V" UBYTE _CNV_R_R_Def_f_ub_b_602_CM 1 100. 0. 99.60930000000001 DISPLAY_IDENTIFIER NELUEFT_EXT_H1 ECU_ADDRESS 0xc000516f FORMAT "%5.2" /end MEASUREMENT
/begin MEASUREMENT Nelueft_ext_h2 "E-Lüfter Ansteuerung nach KL_EL_V" UBYTE _CNV_R_R_Def_f_ub_b_602_CM 1 100. 0. 99.60930000000001 DISPLAY_IDENTIFIER NELUEFT_EXT_H2 ECU_ADDRESS 0xc0005170 FORMAT "%5.2" /end MEASUREMENT
/begin MEASUREMENT Nelueft_genh "Hilfsgrösse nach Schalter S_EL_GEN" UBYTE _CNV_R_R_Def_f_ub_b_602_CM 1 100. 0. 99.60930000000001 DISPLAY_IDENTIFIER NELUEFT_GENH ECU_ADDRESS 0xc0005171 FORMAT "%5.2" /end MEASUREMENT
/begin MEASUREMENT Nelueft_h3 "T_eltd_h2 mit Faktor" UBYTE _CNV_R_R_Def_f_ub_b_602_CM 1 100. 0. 99.60930000000001 DISPLAY_IDENTIFIER NELUEFT_H3 ECU_ADDRESS 0xc0005172 FORMAT "%5.2" /end MEASUREMENT
/begin MEASUREMENT Nelueft_hi "Tkwsoll für BA-HIGH" UBYTE _CNV_R_R_Def_f_ub_b_602_CM 1 100. 0. 99.60930000000001 DISPLAY_IDENTIFIER NELUEFT_HI ECU_ADDRESS 0xc0005173 FORMAT "%5.2" /end MEASUREMENT
/begin MEASUREMENT Nelueft_hk "Tkwsoll für BA-HIGH+KFT" UBYTE _CNV_R_R_Def_f_ub_b_602_CM 1 100. 0. 99.60930000000001 DISPLAY_IDENTIFIER NELUEFT_HK ECU_ADDRESS 0xc0005174 FORMAT "%5.2" /end MEASUREMENT
/begin MEASUREMENT Nelueft_khl1 "Hilfsgrösse Ausgang K_EL_KHL1" UBYTE _CNV_R_R_Def_f_ub_b_602_CM 1 100. 0. 99.60930000000001 DISPLAY_IDENTIFIER NELUEFT_KHL1 ECU_ADDRESS 0xc0005175 FORMAT "%5.2" /end MEASUREMENT
/begin MEASUREMENT Nelueft_local "E-Lüfter Sollwert aus Berechnung 1 und 2" UBYTE _CNV_R_R_Def_f_ub_b_602_CM 1 100. 0. 99.60930000000001 DISPLAY_IDENTIFIER NELUEFT_LOCAL ECU_ADDRESS 0xc0005176 FORMAT "%5.2" /end MEASUREMENT
/begin MEASUREMENT Nelueft_no "Tkwsoll für BA-Normal" UBYTE _CNV_R_R_Def_f_ub_b_602_CM 1 100. 0. 99.60930000000001 DISPLAY_IDENTIFIER NELUEFT_NO ECU_ADDRESS 0xc0005177 FORMAT "%5.2" /end MEASUREMENT
/begin MEASUREMENT Nelueft_pwm "E-Lüfter PWM Sollwert" UBYTE _CNV_R_R_Def_f_ub_b_602_CM 1 100. 0. 99.60930000000001 DISPLAY_IDENTIFIER NELUEFT_PWM ECU_ADDRESS 0xc0005178 FORMAT "%5.2" /end MEASUREMENT
/begin MEASUREMENT Nelueft_tget "Hilftsgrösse Ausgang KL_EL_TGET" UBYTE _CNV_R_R_Def_f_ub_b_602_CM 1 100. 0. 99.60930000000001 DISPLAY_IDENTIFIER NELUEFT_TGET ECU_ADDRESS 0xc0005179 FORMAT "%5.2" /end MEASUREMENT
/begin MEASUREMENT Nelueft_tka "Hilfsgrösse Ausgang KL_EL_TKA" UBYTE _CNV_R_R_Def_f_ub_b_602_CM 1 100. 0. 99.60930000000001 DISPLAY_IDENTIFIER NELUEFT_TKA ECU_ADDRESS 0xc000517a FORMAT "%5.2" /end MEASUREMENT
/begin MEASUREMENT Nelueft_tmot "Hilfsgrösse Ausgang KL_EL_TMOT" UBYTE _CNV_R_R_Def_f_ub_b_602_CM 1 100. 0. 99.60930000000001 DISPLAY_IDENTIFIER NELUEFT_TMOT ECU_ADDRESS 0xc000517b FORMAT "%5.2" /end MEASUREMENT
/begin MEASUREMENT Nelueft_twr1 "Hilftsgrösse Ausgang KL_EL_TWR1" UBYTE _CNV_R_R_Def_f_ub_b_602_CM 1 100. 0. 99.60930000000001 DISPLAY_IDENTIFIER NELUEFT_TWR1 ECU_ADDRESS 0xc000517c FORMAT "%5.2" /end MEASUREMENT
/begin MEASUREMENT Nelueft_wa "E-Lüfter Ansteuerung in BA Warmlauf" UBYTE _CNV_R_R_Def_f_ub_b_602_CM 1 100. 0. 99.60930000000001 DISPLAY_IDENTIFIER NELUEFT_WA ECU_ADDRESS 0xc000517d FORMAT "%5.2" /end MEASUREMENT
/begin MEASUREMENT Nelueft_wm "Solldrehzahl E-Lüfter Vorgabe WM" UBYTE _CNV_R_R_Def_f_ub_b_602_CM 1 100. 0. 99.60930000000001 DISPLAY_IDENTIFIER NELUEFT_WM ECU_ADDRESS 0xc0005102 FORMAT "%5.2" /end MEASUREMENT
/begin MEASUREMENT Newp_soll "Solldrehzahl für BSD-Schnitstelle" UBYTE _CNV_R_R_Def_dez_sl_575_CM 1 100. 0. 255. DISPLAY_IDENTIFIER NEWP_SOLL ECU_ADDRESS 0xc0005103 FORMAT "%3.0" /end MEASUREMENT
/begin MEASUREMENT Nkw_help_pe "Hilfsgrösse für Pe Berechnung" UWORD _CNV_R_R_Def_f_uw_b_591_CM 1 100. 0. 0.9999847412109381 DISPLAY_IDENTIFIER NKW_HELP_PE ECU_ADDRESS 0xc00050ea FORMAT "%14.5" /end MEASUREMENT
/begin MEASUREMENT Pe "Effektive Motorleistung" UWORD _CNV_R_R_Def_pe_uw__687_CM 1 100. 0. 999.9847 DISPLAY_IDENTIFIER PE ECU_ADDRESS 0xc00050ec FORMAT "%8.3" /end MEASUREMENT
/begin MEASUREMENT Pi_kuehlmx "Innere Leistung nach KF_KUEHLPIMX" UWORD _CNV_R_R_Def_f_uw_b_630_CM 1 100. 0. 2047.9687 DISPLAY_IDENTIFIER PI_KUEHLMX ECU_ADDRESS 0xc000514e FORMAT "%7.2" /end MEASUREMENT
/begin MEASUREMENT Pi_kuehlmx_1 "Innere Leistung nach Momentenreduzierung" UWORD _CNV_R_R_Def_f_uw_b_630_CM 1 100. 0. 2047.9687 DISPLAY_IDENTIFIER PI_KUEHLMX_1 ECU_ADDRESS 0xc0005150 FORMAT "%7.2" /end MEASUREMENT
/begin MEASUREMENT Pi_max "maximale innere Leistung" UWORD _CNV_R_R_Def_f_uw_b_630_CM 1 100. 0. 2047.9687 DISPLAY_IDENTIFIER PI_MAX ECU_ADDRESS 0xc0005152 FORMAT "%7.2" /end MEASUREMENT
/begin MEASUREMENT Pmigrlowctr "PM iGR Low Massnahmen Counter" UWORD _CNV_R_R_Def_dez_sl_575_CM 1 100. 0. 65535. DISPLAY_IDENTIFIER PMIGRLOWCTR ECU_ADDRESS 0xc0002a32 FORMAT "%5.0" /end MEASUREMENT
/begin MEASUREMENT Ptc_entl "Ptc Wert aufg. Entlastung" UBYTE _CNV_R_R_Def_f_ub_b_595_CM 1 100. 0. 127.5 DISPLAY_IDENTIFIER PTC_ENTL ECU_ADDRESS 0xc00029c2 FORMAT "%5.2" /end MEASUREMENT
/begin MEASUREMENT Qs_anf "Wärmestromanforderung von IHKA " UBYTE _CNV_R_R_Def_f_ub_b_602_CM 1 100. 0. 99.60930000000001 DISPLAY_IDENTIFIER QS_ANF ECU_ADDRESS 0xc000517e FORMAT "%5.2" /end MEASUREMENT
/begin MEASUREMENT Qs_anf_sw "Qs_anf_klima in l/h" UWORD _CNV_R_R_Def_vs_uw__693_CM 1 100. 0. 9999.847400000001 DISPLAY_IDENTIFIER QS_ANF_SW ECU_ADDRESS 0xc0005154 FORMAT "%7.2" /end MEASUREMENT
/begin MEASUREMENT R_spul "Spulenwiederstand der Zündspule" UWORD _CNV_R_R_Def_r_uw_b_694_CM 1 100. 0. 1.9999 DISPLAY_IDENTIFIER R_SPUL ECU_ADDRESS 0xc0004cbc FORMAT "%7.2" /end MEASUREMENT
/begin MEASUREMENT Rf_max "" SWORD _CNV_R_R_Def_rf_sw__616_CM 1 100. -327.68 327.67 DISPLAY_IDENTIFIER RF_MAX ECU_ADDRESS 0xd0006988 FORMAT "%9.4" /end MEASUREMENT
/begin MEASUREMENT Rk "Relative Kraftstoffmasse" UWORD _CNV_R_R_Def_rk_uw__696_CM 1 100. 0. 31.9995 DISPLAY_IDENTIFIER RK ECU_ADDRESS 0xd000699c FORMAT "%9.4" /end MEASUREMENT
/begin MEASUREMENT Rkukg "Relative Kraftstoffmasse Übergangskompensation" SWORD _CNV_R_R_Def_rk_sw__697_CM 1 100. -1600. 1599.9511 DISPLAY_IDENTIFIER RKUKG ECU_ADDRESS 0xd000694c FORMAT "%8.3" /end MEASUREMENT
/begin MEASUREMENT Segkorroff "Zahn, bei welchem die Hubkorrektur ausgeschaltet wird" UBYTE _CNV_R_R_Def_dez_sl_575_CM 1 100. 0. 255. DISPLAY_IDENTIFIER SEGKORROFF ECU_ADDRESS 0xd000696e FORMAT "%3.0" /end MEASUREMENT
/begin MEASUREMENT Segkorron "Zahn, bei welchem die Hubkorrektur eingeschaltet wird" UBYTE _CNV_R_R_Def_dez_sl_575_CM 1 100. 0. 255. DISPLAY_IDENTIFIER SEGKORRON ECU_ADDRESS 0xd000696f FORMAT "%3.0" /end MEASUREMENT
/begin MEASUREMENT St_bv_kath "Statuswort" UBYTE _CNV_R_R_Def_dez_sl_575_CM 1 100. 0. 255. DISPLAY_IDENTIFIER ST_BV_KATH ECU_ADDRESS 0xd0006974 FORMAT "%3.0" /end MEASUREMENT
/begin MEASUREMENT St_bv_kath.B_hsplit_akt "Statuswort" UBYTE _CNV_S_2_Def_bit_ub_703_CM 1 100. 0. 8. DISPLAY_IDENTIFIER B_HSPLIT_AKT ECU_ADDRESS 0xd0006974 BIT_MASK 0x8 /end MEASUREMENT
/begin MEASUREMENT St_bv_kath.B_nesps_akt "Statuswort" UBYTE _CNV_S_2_Def_bit_ub_701_CM 1 100. 0. 2. DISPLAY_IDENTIFIER B_NESPS_AKT ECU_ADDRESS 0xd0006974 BIT_MASK 0x2 /end MEASUREMENT
/begin MEASUREMENT St_bv_kath.B_zwkh_akt "Statuswort" UBYTE _CNV_S_2_Def_bit_ub_702_CM 1 100. 0. 4. DISPLAY_IDENTIFIER B_ZWKH_AKT ECU_ADDRESS 0xd0006974 BIT_MASK 0x4 /end MEASUREMENT
/begin MEASUREMENT St_dvvt0 "Statuswort dvvt 0" UBYTE _CNV_R_R_Def_dez_sl_575_CM 1 100. 0. 255. DISPLAY_IDENTIFIER ST_DVVT0 ECU_ADDRESS 0xc00029ba FORMAT "%3.0" /end MEASUREMENT
/begin MEASUREMENT St_dvvt0.B_btvvta_ena "Statuswort dvvt 0" UBYTE _CNV_S_2_Def_bit_ub_700_CM 1 100. 0. 1. DISPLAY_IDENTIFIER B_BTVVTA_ENA ECU_ADDRESS 0xc00029ba BIT_MASK 0x1 /end MEASUREMENT
/begin MEASUREMENT St_dvvt0.B_evvt_vsa "Notlaufbetrieb Vanos Auslass" UBYTE _CNV_S_2_Def_bit_ub_703_CM 1 100. 0. 8. DISPLAY_IDENTIFIER B_EVVT_VSA ECU_ADDRESS 0xc00029ba BIT_MASK 0x8 /end MEASUREMENT
/begin MEASUREMENT St_dvvt0.B_evvt_vse "Notlaufbetrieb Vanos Einlass" UBYTE _CNV_S_2_Def_bit_ub_704_CM 1 100. 0. 16. DISPLAY_IDENTIFIER B_EVVT_VSE ECU_ADDRESS 0xc00029ba BIT_MASK 0x10 /end MEASUREMENT
/begin MEASUREMENT St_dvvt1 "Statuswort" UBYTE _CNV_R_R_Def_dez_sl_575_CM 1 100. 0. 255. DISPLAY_IDENTIFIER ST_DVVT1 ECU_ADDRESS 0xc00029bb FORMAT "%3.0" /end MEASUREMENT
/begin MEASUREMENT St_dvvt1.B_vvtnotl "Bedingung VVT Notlauf" UBYTE _CNV_S_2_Def_bit_ub_705_CM 1 100. 0. 32. DISPLAY_IDENTIFIER B_VVTNOTL ECU_ADDRESS 0xc00029bb BIT_MASK 0x20 /end MEASUREMENT
/begin MEASUREMENT St_dvvt2 "Statuswort" UBYTE _CNV_R_R_Def_dez_sl_575_CM 1 100. 0. 255. DISPLAY_IDENTIFIER ST_DVVT2 ECU_ADDRESS 0xc00029bc FORMAT "%3.0" /end MEASUREMENT
/begin MEASUREMENT St_ewp1 "Statuswort mit  Biteingangsgroessen EWAPU" UBYTE _CNV_R_R_Def_dez_sl_575_CM 1 100. 0. 255. DISPLAY_IDENTIFIER ST_EWP1 ECU_ADDRESS 0xc00029c0 FORMAT "%3.0" /end MEASUREMENT
/begin MEASUREMENT St_hubkor "Statuswort für Bitgroessen HUBKOR" UBYTE _CNV_R_R_Def_dez_sl_575_CM 1 100. 0. 255. DISPLAY_IDENTIFIER ST_HUBKOR ECU_ADDRESS 0xd0006972 FORMAT "%3.0" /end MEASUREMENT
/begin MEASUREMENT St_hubkor.B_hubkor "Bedingung Hubkorrektur aktiv" UBYTE _CNV_S_2_Def_bit_ub_701_CM 1 100. 0. 2. DISPLAY_IDENTIFIER B_HUBKOR ECU_ADDRESS 0xd0006972 BIT_MASK 0x2 /end MEASUREMENT
/begin MEASUREMENT St_hubkor_5ms "Statuswort" UBYTE _CNV_R_R_Def_dez_sl_575_CM 1 100. 0. 255. DISPLAY_IDENTIFIER ST_HUBKOR_5MS ECU_ADDRESS 0xd0006971 FORMAT "%3.0" /end MEASUREMENT
/begin MEASUREMENT St_hubkor_5ms.B_hubistkor "Bedingung Hub wird gerade korrigiert" UBYTE _CNV_S_2_Def_bit_ub_700_CM 1 100. 0. 1. DISPLAY_IDENTIFIER B_HUBISTKOR ECU_ADDRESS 0xd0006971 BIT_MASK 0x1 /end MEASUREMENT
/begin MEASUREMENT St_khm "Statuswort KHM" UBYTE _CNV_R_R_Def_dez_sl_575_CM 1 100. 0. 255. DISPLAY_IDENTIFIER ST_KHM ECU_ADDRESS 0xd000696c FORMAT "%3.0" /end MEASUREMENT
/begin MEASUREMENT St_khm.B_khm_h "Statuswort KHM" UBYTE _CNV_S_2_Def_bit_ub_700_CM 1 100. 0. 1. DISPLAY_IDENTIFIER B_KHM_H ECU_ADDRESS 0xd000696c BIT_MASK 0x1 /end MEASUREMENT
/begin MEASUREMENT St_khm.B_khm_hs "Statuswort KHM" UBYTE _CNV_S_2_Def_bit_ub_701_CM 1 100. 0. 2. DISPLAY_IDENTIFIER B_KHM_HS ECU_ADDRESS 0xd000696c BIT_MASK 0x2 /end MEASUREMENT
/begin MEASUREMENT St_khm.B_khm_s "Statuswort KHM" UBYTE _CNV_S_2_Def_bit_ub_702_CM 1 100. 0. 4. DISPLAY_IDENTIFIER B_KHM_S ECU_ADDRESS 0xd000696c BIT_MASK 0x4 /end MEASUREMENT
/begin MEASUREMENT St_minhubad0 "" UBYTE _CNV_R_R_Def_dez_sl_575_CM 1 100. 0. 255. DISPLAY_IDENTIFIER ST_MINHUBAD0 ECU_ADDRESS 0xc00029b8 FORMAT "%3.0" /end MEASUREMENT
/begin MEASUREMENT St_minhubad0.B_mdarv "" UBYTE _CNV_S_2_Def_bit_ub_705_CM 1 100. 0. 32. DISPLAY_IDENTIFIER B_MDARV ECU_ADDRESS 0xc00029b8 BIT_MASK 0x20 /end MEASUREMENT
/begin MEASUREMENT St_pmentl0 "Statuswort" UBYTE _CNV_R_R_Def_dez_sl_575_CM 1 100. 0. 255. DISPLAY_IDENTIFIER ST_PMENTL0 ECU_ADDRESS 0xd0006942 FORMAT "%3.0" /end MEASUREMENT
/begin MEASUREMENT St_pmentl0.B_entl "Bit Ugen Entlastung aktiv" UBYTE _CNV_S_2_Def_bit_ub_700_CM 1 100. 0. 1. DISPLAY_IDENTIFIER B_ENTL ECU_ADDRESS 0xd0006942 BIT_MASK 0x1 /end MEASUREMENT
/begin MEASUREMENT St_pmentl0.B_pwrentl "Entlastung auf Prio aktiv" UBYTE _CNV_S_2_Def_bit_ub_701_CM 1 100. 0. 2. DISPLAY_IDENTIFIER B_PWRENTL ECU_ADDRESS 0xd0006942 BIT_MASK 0x2 /end MEASUREMENT
/begin MEASUREMENT St_pr "Statuswort für Bitgroessen Raildruck" UBYTE _CNV_R_R_Def_dez_sl_575_CM 1 100. 0. 255. DISPLAY_IDENTIFIER ST_PR ECU_ADDRESS 0xc00029c1 FORMAT "%3.0" /end MEASUREMENT
/begin MEASUREMENT St_pr.B_prsoll_h "Bedingung Raildruckkennfeld" UBYTE _CNV_S_2_Def_bit_ub_700_CM 1 100. 0. 1. DISPLAY_IDENTIFIER B_PRSOLL_H ECU_ADDRESS 0xc00029c1 BIT_MASK 0x1 /end MEASUREMENT
/begin MEASUREMENT St_rf "Status" UBYTE _CNV_R_R_Def_dez_sl_575_CM 1 100. 0. 255. DISPLAY_IDENTIFIER ST_RF ECU_ADDRESS 0xd000696b FORMAT "%3.0" /end MEASUREMENT
/begin MEASUREMENT St_rf.B_rfmin "Bedingung Minimalbegrenzung Rf aktiv" UBYTE _CNV_S_2_Def_bit_ub_700_CM 1 100. 0. 1. DISPLAY_IDENTIFIER B_RFMIN ECU_ADDRESS 0xd000696b BIT_MASK 0x1 /end MEASUREMENT
/begin MEASUREMENT St_sa "Status" UBYTE _CNV_R_R_Def_dez_sl_575_CM 1 100. 0. 255. DISPLAY_IDENTIFIER ST_SA ECU_ADDRESS 0xd0006973 FORMAT "%3.0" /end MEASUREMENT
/begin MEASUREMENT St_sa.B_ums_vbsa "Bed. " UBYTE _CNV_S_2_Def_bit_ub_700_CM 1 100. 0. 1. DISPLAY_IDENTIFIER B_UMS_VBSA ECU_ADDRESS 0xd0006973 BIT_MASK 0x1 /end MEASUREMENT
/begin MEASUREMENT St_sa.B_vbbmw_sa "Bed. " UBYTE _CNV_S_2_Def_bit_ub_701_CM 1 100. 0. 2. DISPLAY_IDENTIFIER B_VBBMW_SA ECU_ADDRESS 0xd0006973 BIT_MASK 0x2 /end MEASUREMENT
/begin MEASUREMENT St_szcal0 "Statuswort" UBYTE _CNV_R_R_Def_dez_sl_575_CM 1 100. 0. 255. DISPLAY_IDENTIFIER ST_SZCAL0 ECU_ADDRESS 0xd000698c FORMAT "%3.0" /end MEASUREMENT
/begin MEASUREMENT St_szcal0.B_zstart "Bedingung Start für Schliesszeitberechnung " UBYTE _CNV_S_2_Def_bit_ub_700_CM 1 100. 0. 1. DISPLAY_IDENTIFIER B_ZSTART ECU_ADDRESS 0xd000698c BIT_MASK 0x1 /end MEASUREMENT
/begin MEASUREMENT St_tan "Statuswort" UBYTE _CNV_R_R_Def_dez_sl_575_CM 1 100. 0. 255. DISPLAY_IDENTIFIER ST_TAN ECU_ADDRESS 0xd0006941 FORMAT "%3.0" /end MEASUREMENT
/begin MEASUREMENT St_tan.B_taners "Statuswort" UBYTE _CNV_S_2_Def_bit_ub_700_CM 1 100. 0. 1. DISPLAY_IDENTIFIER B_TANERS ECU_ADDRESS 0xd0006941 BIT_MASK 0x1 /end MEASUREMENT
/begin MEASUREMENT St_ubw "Statuswort" UBYTE _CNV_R_R_Def_dez_sl_575_CM 1 100. 0. 255. DISPLAY_IDENTIFIER ST_UBW ECU_ADDRESS 0xd00072cc FORMAT "%3.0" /end MEASUREMENT
/begin MEASUREMENT St_ubw.B_ubw_aktiv "Bedingung Spannungswächter aktiv" UBYTE _CNV_S_2_Def_bit_ub_702_CM 1 100. 0. 4. DISPLAY_IDENTIFIER B_UBW_AKTIV ECU_ADDRESS 0xd00072cc BIT_MASK 0x4 /end MEASUREMENT
/begin MEASUREMENT St_ubw.B_ubw_ullow "Bedingung anhaltende Unterspannung" UBYTE _CNV_S_2_Def_bit_ub_701_CM 1 100. 0. 2. DISPLAY_IDENTIFIER B_UBW_ULLOW ECU_ADDRESS 0xd00072cc BIT_MASK 0x2 /end MEASUREMENT
/begin MEASUREMENT St_ubw.B_ubw_ulow "Bedingung instabiles Bordnetz " UBYTE _CNV_S_2_Def_bit_ub_700_CM 1 100. 0. 1. DISPLAY_IDENTIFIER B_UBW_ULOW ECU_ADDRESS 0xd00072cc BIT_MASK 0x1 /end MEASUREMENT
/begin MEASUREMENT St_ugenkor0 "Statuswort" UBYTE _CNV_R_R_Def_dez_sl_575_CM 1 100. 0. 255. DISPLAY_IDENTIFIER ST_UGENKOR0 ECU_ADDRESS 0xd0007288 FORMAT "%3.0" /end MEASUREMENT
/begin MEASUREMENT St_ugenkor0.B_1stugen "Bedingung ctrgenutar noch nicht gueltig" UBYTE _CNV_S_2_Def_bit_ub_700_CM 1 100. 0. 1. DISPLAY_IDENTIFIER B_1STUGEN ECU_ADDRESS 0xd0007288 BIT_MASK 0x1 /end MEASUREMENT
/begin MEASUREMENT St_ugenkor0.B_genoff "Bedingung Generator ausgeschaltet" UBYTE _CNV_S_2_Def_bit_ub_703_CM 1 100. 0. 8. DISPLAY_IDENTIFIER B_GENOFF ECU_ADDRESS 0xd0007288 BIT_MASK 0x8 /end MEASUREMENT
/begin MEASUREMENT St_ugenkor0.B_genoff2 "Bedingung Generator2 ausgeschaltet" UBYTE _CNV_S_2_Def_bit_ub_704_CM 1 100. 0. 16. DISPLAY_IDENTIFIER B_GENOFF2 ECU_ADDRESS 0xd0007288 BIT_MASK 0x10 /end MEASUREMENT
/begin MEASUREMENT St_ugenkor0.B_genoffok "Bedingung Generatorabschaltfreigabe Sicherheitstimer" UBYTE _CNV_S_2_Def_bit_ub_705_CM 1 100. 0. 32. DISPLAY_IDENTIFIER B_GENOFFOK ECU_ADDRESS 0xd0007288 BIT_MASK 0x20 /end MEASUREMENT
/begin MEASUREMENT St_ugenkor0.B_genoffout "Bedingung Abschaltung Generator" UBYTE _CNV_S_2_Def_bit_ub_701_CM 1 100. 0. 2. DISPLAY_IDENTIFIER B_GENOFFOUT ECU_ADDRESS 0xd0007288 BIT_MASK 0x2 /end MEASUREMENT
/begin MEASUREMENT St_ugenkor0.B_noctrgen "Bedingung Ladespannungvorgabe ignoriert" UBYTE _CNV_S_2_Def_bit_ub_706_CM 1 100. 0. 64. DISPLAY_IDENTIFIER B_NOCTRGEN ECU_ADDRESS 0xd0007288 BIT_MASK 0x40 /end MEASUREMENT
/begin MEASUREMENT St_ugenkor0.B_ugenini "Initialisierung Generatorspannung" UBYTE _CNV_S_2_Def_bit_ub_702_CM 1 100. 0. 4. DISPLAY_IDENTIFIER B_UGENINI ECU_ADDRESS 0xd0007288 BIT_MASK 0x4 /end MEASUREMENT
/begin MEASUREMENT St_ugenkor0.B_verb_off "Bedingung elektr. Verbraucher AUS" UBYTE _CNV_S_2_Def_bit_ub_707_CM 1 100. 0. 128. DISPLAY_IDENTIFIER B_VERB_OFF ECU_ADDRESS 0xd0007288 BIT_MASK 0x80 /end MEASUREMENT
/begin MEASUREMENT St_ugenkor1 "Statuswort" UBYTE _CNV_R_R_Def_dez_sl_575_CM 1 100. 0. 255. DISPLAY_IDENTIFIER ST_UGENKOR1 ECU_ADDRESS 0xc000464c FORMAT "%3.0" /end MEASUREMENT
/begin MEASUREMENT St_ugenkor1.B_gentoggl "Bedindung Toggel Generatorauswahl" UBYTE _CNV_S_2_Def_bit_ub_700_CM 1 100. 0. 1. DISPLAY_IDENTIFIER B_GENTOGGL ECU_ADDRESS 0xc000464c BIT_MASK 0x1 /end MEASUREMENT
/begin MEASUREMENT St_ugenkor2 "Statuswort" UBYTE _CNV_R_R_Def_dez_sl_575_CM 1 100. 0. 255. DISPLAY_IDENTIFIER ST_UGENKOR2 ECU_ADDRESS 0xc0002a24 FORMAT "%3.0" /end MEASUREMENT
/begin MEASUREMENT St_ugenkor2.B_saaktiv "Modulspezifische Bedingung für Schubabschalten" UBYTE _CNV_S_2_Def_bit_ub_700_CM 1 100. 0. 1. DISPLAY_IDENTIFIER B_SAAKTIV ECU_ADDRESS 0xc0002a24 BIT_MASK 0x1 /end MEASUREMENT
/begin MEASUREMENT St_ugenkor2.B_saset "Freigabe für modulspezifisches Schubabschalten" UBYTE _CNV_S_2_Def_bit_ub_701_CM 1 100. 0. 2. DISPLAY_IDENTIFIER B_SASET ECU_ADDRESS 0xc0002a24 BIT_MASK 0x2 /end MEASUREMENT
/begin MEASUREMENT St_varkat "Status Variante Abgasanlage (mono/stereo)" UBYTE _CNV_R_R_Def_dez_sl_575_CM 1 100. 0. 255. DISPLAY_IDENTIFIER ST_VARKAT ECU_ADDRESS 0xc00029b9 FORMAT "%3.0" /end MEASUREMENT
/begin MEASUREMENT St_varkat.B_varkat "Bedingung Variante Abgasanlage (mono/stereo)" UBYTE _CNV_S_2_Def_bit_ub_700_CM 1 100. 0. 1. DISPLAY_IDENTIFIER B_VARKAT ECU_ADDRESS 0xc00029b9 BIT_MASK 0x1 /end MEASUREMENT
/begin MEASUREMENT St_vvtlr "Statuswort VVTLR" UBYTE _CNV_R_R_Def_dez_sl_575_CM 1 100. 0. 255. DISPLAY_IDENTIFIER ST_VVTLR ECU_ADDRESS 0xd0006940 FORMAT "%3.0" /end MEASUREMENT
/begin MEASUREMENT St_vvtlr.B_vvtad "Bedingung VVT-Lageregler Anschlag lernen aktiv" UBYTE _CNV_S_2_Def_bit_ub_704_CM 1 100. 0. 16. DISPLAY_IDENTIFIER B_VVTAD ECU_ADDRESS 0xd0006940 BIT_MASK 0x10 /end MEASUREMENT
/begin MEASUREMENT St_wese "Statuswort WESE" UBYTE _CNV_R_R_Def_dez_sl_575_CM 1 100. 0. 255. DISPLAY_IDENTIFIER ST_WESE ECU_ADDRESS 0xd00070a4 FORMAT "%3.0" /end MEASUREMENT
/begin MEASUREMENT St_wese.B_tesmin12 "Begrenzung Abstand zwischen 1. und 2. Einspritzung aktiv" UBYTE _CNV_S_2_Def_bit_ub_700_CM 1 100. 0. 1. DISPLAY_IDENTIFIER B_TESMIN12 ECU_ADDRESS 0xd00070a4 BIT_MASK 0x1 /end MEASUREMENT
/begin MEASUREMENT St_wese.B_wese2h_abs "Statuswort WESE" UBYTE _CNV_S_2_Def_bit_ub_701_CM 1 100. 0. 2. DISPLAY_IDENTIFIER B_WESE2H_ABS ECU_ADDRESS 0xd00070a4 BIT_MASK 0x2 /end MEASUREMENT
/begin MEASUREMENT St_wm1 "Statuswort" UBYTE _CNV_R_R_Def_dez_sl_575_CM 1 100. 0. 255. DISPLAY_IDENTIFIER ST_WM1 ECU_ADDRESS 0xd0006b84 FORMAT "%3.0" /end MEASUREMENT
/begin MEASUREMENT St_wm1.B_lklps "Bedingung Luftklappen auf" UBYTE _CNV_S_2_Def_bit_ub_701_CM 1 100. 0. 2. DISPLAY_IDENTIFIER B_LKLPS ECU_ADDRESS 0xd0006b84 BIT_MASK 0x2 /end MEASUREMENT
/begin MEASUREMENT St_wm1.B_lklps1 "Bedingung Luftklappe1 auf" UBYTE _CNV_S_2_Def_bit_ub_706_CM 1 100. 0. 64. DISPLAY_IDENTIFIER B_LKLPS1 ECU_ADDRESS 0xd0006b84 BIT_MASK 0x40 /end MEASUREMENT
/begin MEASUREMENT St_wm1.B_ntlkws "Bedingung Notlauf Kühlkreislauf" UBYTE _CNV_S_2_Def_bit_ub_702_CM 1 100. 0. 4. DISPLAY_IDENTIFIER B_NTLKWS ECU_ADDRESS 0xd0006b84 BIT_MASK 0x4 /end MEASUREMENT
/begin MEASUREMENT St_wm1.B_tmmi_warn1 "Bedingung Wanrlampe (gelb) Stufe1 an MMI" UBYTE _CNV_S_2_Def_bit_ub_703_CM 1 100. 0. 8. DISPLAY_IDENTIFIER B_TMMI_WARN1 ECU_ADDRESS 0xd0006b84 BIT_MASK 0x8 /end MEASUREMENT
/begin MEASUREMENT St_wm1.B_tmmi_warn2 "Bedingung Warnlampe (rot) Stufe 2 an MMI" UBYTE _CNV_S_2_Def_bit_ub_704_CM 1 100. 0. 16. DISPLAY_IDENTIFIER B_TMMI_WARN2 ECU_ADDRESS 0xd0006b84 BIT_MASK 0x10 /end MEASUREMENT
/begin MEASUREMENT St_wm1.B_tmmi_warn3 "Bedingung Hochschalten" UBYTE _CNV_S_2_Def_bit_ub_705_CM 1 100. 0. 32. DISPLAY_IDENTIFIER B_TMMI_WARN3 ECU_ADDRESS 0xd0006b84 BIT_MASK 0x20 /end MEASUREMENT
/begin MEASUREMENT St_wm_nl0 "Statuswort" UBYTE _CNV_R_R_Def_dez_sl_575_CM 1 100. 0. 255. DISPLAY_IDENTIFIER ST_WM_NL0 ECU_ADDRESS 0xc0002a4c FORMAT "%3.0" /end MEASUREMENT
/begin MEASUREMENT St_wm_nl0.B_nlewp_b1 "Bedingung für EWAPU Nachlauf bei Tmot > 112°C" UBYTE _CNV_S_2_Def_bit_ub_700_CM 1 100. 0. 1. DISPLAY_IDENTIFIER B_NLEWP_B1 ECU_ADDRESS 0xc0002a4c BIT_MASK 0x1 /end MEASUREMENT
/begin MEASUREMENT St_wm_nl0.B_nlewp_b2 "Bedingung für EWAPU Nachlauf bei 106°C >=Tmot <= 112°C" UBYTE _CNV_S_2_Def_bit_ub_701_CM 1 100. 0. 2. DISPLAY_IDENTIFIER B_NLEWP_B2 ECU_ADDRESS 0xc0002a4c BIT_MASK 0x2 /end MEASUREMENT
/begin MEASUREMENT St_wm_nl0.B_nlewp_b3 "Bedingung für EWAPU-Sollwert = 0 (abhängig von Tmot)" UBYTE _CNV_S_2_Def_bit_ub_702_CM 1 100. 0. 4. DISPLAY_IDENTIFIER B_NLEWP_B3 ECU_ADDRESS 0xc0002a4c BIT_MASK 0x4 /end MEASUREMENT
/begin MEASUREMENT St_wm_nl0.B_nlewp_b4 "Bedingung für EWAPU-Sollwert Rücksetzen (kein Nachlauf)" UBYTE _CNV_S_2_Def_bit_ub_703_CM 1 100. 0. 8. DISPLAY_IDENTIFIER B_NLEWP_B4 ECU_ADDRESS 0xc0002a4c BIT_MASK 0x8 /end MEASUREMENT
/begin MEASUREMENT St_wm_nl0.B_nlqs1 "Bedingung für EWAPU-Restwärme kurz" UBYTE _CNV_S_2_Def_bit_ub_704_CM 1 100. 0. 16. DISPLAY_IDENTIFIER B_NLQS1 ECU_ADDRESS 0xc0002a4c BIT_MASK 0x10 /end MEASUREMENT
/begin MEASUREMENT St_wm_nl0.B_nlqs2 "Bedingung für EWAPU-Restwärme abgelaufen (Rücksetzen)" UBYTE _CNV_S_2_Def_bit_ub_705_CM 1 100. 0. 32. DISPLAY_IDENTIFIER B_NLQS2 ECU_ADDRESS 0xc0002a4c BIT_MASK 0x20 /end MEASUREMENT
/begin MEASUREMENT St_wm_nl0.B_nlqs3 "Bedingung für EWAPU-Restwärme lang" UBYTE _CNV_S_2_Def_bit_ub_706_CM 1 100. 0. 64. DISPLAY_IDENTIFIER B_NLQS3 ECU_ADDRESS 0xc0002a4c BIT_MASK 0x40 /end MEASUREMENT
/begin MEASUREMENT St_wm_nl0.B_nlqs4 "Bedingung Qs_anf_klima gesetzt" UBYTE _CNV_S_2_Def_bit_ub_707_CM 1 100. 0. 128. DISPLAY_IDENTIFIER B_NLQS4 ECU_ADDRESS 0xc0002a4c BIT_MASK 0x80 /end MEASUREMENT
/begin MEASUREMENT St_wm_nl1 "Statuswort" UBYTE _CNV_R_R_Def_dez_sl_575_CM 1 100. 0. 255. DISPLAY_IDENTIFIER ST_WM_NL1 ECU_ADDRESS 0xc0002a4d FORMAT "%3.0" /end MEASUREMENT
/begin MEASUREMENT St_wm_nl1.B_nlqs5 "Rücksetzen EWAPU bei Qs_anf_klima=0" UBYTE _CNV_S_2_Def_bit_ub_700_CM 1 100. 0. 1. DISPLAY_IDENTIFIER B_NLQS5 ECU_ADDRESS 0xc0002a4d BIT_MASK 0x1 /end MEASUREMENT
/begin MEASUREMENT St_wmprio "Statuswort" UBYTE _CNV_R_R_Def_dez_sl_575_CM 1 100. 0. 255. DISPLAY_IDENTIFIER ST_WMPRIO ECU_ADDRESS 0xd0006b80 FORMAT "%3.0" /end MEASUREMENT
/begin MEASUREMENT St_wmprio.B_ewptmwae "Bedingung Abbruch Warmlauf durch Tmot" UBYTE _CNV_S_2_Def_bit_ub_703_CM 1 100. 0. 8. DISPLAY_IDENTIFIER B_EWPTMWAE ECU_ADDRESS 0xd0006b80 BIT_MASK 0x8 /end MEASUREMENT
/begin MEASUREMENT St_wmprio.B_ewpwae "Bedingung Abbruch Warmlauf" UBYTE _CNV_S_2_Def_bit_ub_700_CM 1 100. 0. 1. DISPLAY_IDENTIFIER B_EWPWAE ECU_ADDRESS 0xd0006b80 BIT_MASK 0x1 /end MEASUREMENT
/begin MEASUREMENT St_wmprio.B_fi_eluee "Bedingung Elüfterfehler" UBYTE _CNV_S_2_Def_bit_ub_701_CM 1 100. 0. 2. DISPLAY_IDENTIFIER B_FI_ELUEE ECU_ADDRESS 0xd0006b80 BIT_MASK 0x2 /end MEASUREMENT
/begin MEASUREMENT St_wmprio.B_fi_tmot "Bedingung Tmotfehler" UBYTE _CNV_S_2_Def_bit_ub_704_CM 1 100. 0. 16. DISPLAY_IDENTIFIER B_FI_TMOT ECU_ADDRESS 0xd0006b80 BIT_MASK 0x10 /end MEASUREMENT
/begin MEASUREMENT St_wmprio.B_heiz_prio "Bedingung Heizleistung " UBYTE _CNV_S_2_Def_bit_ub_707_CM 1 100. 0. 128. DISPLAY_IDENTIFIER B_HEIZ_PRIO ECU_ADDRESS 0xd0006b80 BIT_MASK 0x80 /end MEASUREMENT
/begin MEASUREMENT St_wmprio.B_pwg_ist "Bedingung Gaspedal für eine Zeit x " UBYTE _CNV_S_2_Def_bit_ub_702_CM 1 100. 0. 4. DISPLAY_IDENTIFIER B_PWG_IST ECU_ADDRESS 0xd0006b80 BIT_MASK 0x4 /end MEASUREMENT
/begin MEASUREMENT St_wmprio.B_tmheiz "Bedingung Tmot für Heizleistung" UBYTE _CNV_S_2_Def_bit_ub_706_CM 1 100. 0. 64. DISPLAY_IDENTIFIER B_TMHEIZ ECU_ADDRESS 0xd0006b80 BIT_MASK 0x40 /end MEASUREMENT
/begin MEASUREMENT St_wmprio.B_tuheiz "Bedingung Tumg für Heizleistung" UBYTE _CNV_S_2_Def_bit_ub_705_CM 1 100. 0. 32. DISPLAY_IDENTIFIER B_TUHEIZ ECU_ADDRESS 0xd0006b80 BIT_MASK 0x20 /end MEASUREMENT
/begin MEASUREMENT St_wmprio0 "Statuswort" UBYTE _CNV_R_R_Def_dez_sl_575_CM 1 100. 0. 255. DISPLAY_IDENTIFIER ST_WMPRIO0 ECU_ADDRESS 0xd0006b81 FORMAT "%3.0" /end MEASUREMENT
/begin MEASUREMENT St_wmprio0.B_ewp_pe "Bedingung Abbruch Warmlauf durch Motoleistung" UBYTE _CNV_S_2_Def_bit_ub_700_CM 1 100. 0. 1. DISPLAY_IDENTIFIER B_EWP_PE ECU_ADDRESS 0xd0006b81 BIT_MASK 0x1 /end MEASUREMENT
/begin MEASUREMENT St_wmprio0.B_ewp_qs "Bedingung Abbruch Warmlauf durch Wärmestromanforderung IHKA" UBYTE _CNV_S_2_Def_bit_ub_704_CM 1 100. 0. 16. DISPLAY_IDENTIFIER B_EWP_QS ECU_ADDRESS 0xd0006b81 BIT_MASK 0x10 /end MEASUREMENT
/begin MEASUREMENT St_wmprio0.B_ewp_vs "Bedingung Abbruch Warmlauf durch Kraftstoffmenge" UBYTE _CNV_S_2_Def_bit_ub_701_CM 1 100. 0. 2. DISPLAY_IDENTIFIER B_EWP_VS ECU_ADDRESS 0xd0006b81 BIT_MASK 0x2 /end MEASUREMENT
/begin MEASUREMENT St_wmprio0.B_help_pe "Hilfsgrösse B_ewp_pe" UBYTE _CNV_S_2_Def_bit_ub_702_CM 1 100. 0. 4. DISPLAY_IDENTIFIER B_HELP_PE ECU_ADDRESS 0xd0006b81 BIT_MASK 0x4 /end MEASUREMENT
/begin MEASUREMENT St_wmprio0.B_help_qs "Hilfsgrösse B_ewp_qs" UBYTE _CNV_S_2_Def_bit_ub_705_CM 1 100. 0. 32. DISPLAY_IDENTIFIER B_HELP_QS ECU_ADDRESS 0xd0006b81 BIT_MASK 0x20 /end MEASUREMENT
/begin MEASUREMENT St_wmprio0.B_n46 "Bedingung N46B20" UBYTE _CNV_S_2_Def_bit_ub_703_CM 1 100. 0. 8. DISPLAY_IDENTIFIER B_N46 ECU_ADDRESS 0xd0006b81 BIT_MASK 0x8 /end MEASUREMENT
/begin MEASUREMENT St_wmprio0.B_nkwtget "Bedingung Nkw und Tget " UBYTE _CNV_S_2_Def_bit_ub_707_CM 1 100. 0. 128. DISPLAY_IDENTIFIER B_NKWTGET ECU_ADDRESS 0xd0006b81 BIT_MASK 0x80 /end MEASUREMENT
/begin MEASUREMENT St_wmprio0.B_pwg90 "Bedingung Pwg_ist über 90" UBYTE _CNV_S_2_Def_bit_ub_706_CM 1 100. 0. 64. DISPLAY_IDENTIFIER B_PWG90 ECU_ADDRESS 0xd0006b81 BIT_MASK 0x40 /end MEASUREMENT
/begin MEASUREMENT St_wmschalt0 "Statuswort" UBYTE _CNV_R_R_Def_dez_sl_575_CM 1 100. 0. 255. DISPLAY_IDENTIFIER ST_WMSCHALT0 ECU_ADDRESS 0xd0006b85 FORMAT "%3.0" /end MEASUREMENT
/begin MEASUREMENT St_wmschalt0.B_beende "Bedingung Befüllenende erreicht" UBYTE _CNV_S_2_Def_bit_ub_705_CM 1 100. 0. 32. DISPLAY_IDENTIFIER B_BEENDE ECU_ADDRESS 0xd0006b85 BIT_MASK 0x20 /end MEASUREMENT
/begin MEASUREMENT St_wmschalt0.B_hz_wm "Anforderung Heizleistung aus Wärmemanagementkoordinator" UBYTE _CNV_S_2_Def_bit_ub_700_CM 1 100. 0. 1. DISPLAY_IDENTIFIER B_HZ_WM ECU_ADDRESS 0xd0006b85 BIT_MASK 0x1 /end MEASUREMENT
/begin MEASUREMENT St_wmschalt0.B_wm_stat "Bedingung für Start Statistik" UBYTE _CNV_S_2_Def_bit_ub_702_CM 1 100. 0. 4. DISPLAY_IDENTIFIER B_WM_STAT ECU_ADDRESS 0xd0006b85 BIT_MASK 0x4 /end MEASUREMENT
/begin MEASUREMENT St_wmschalt0.B_wm_stat2 "Bedingung für Tget Statistik" UBYTE _CNV_S_2_Def_bit_ub_703_CM 1 100. 0. 8. DISPLAY_IDENTIFIER B_WM_STAT2 ECU_ADDRESS 0xd0006b85 BIT_MASK 0x8 /end MEASUREMENT
/begin MEASUREMENT St_zwaus "Statuswort ZWAUS" UBYTE _CNV_R_R_Def_dez_sl_575_CM 1 100. 0. 255. DISPLAY_IDENTIFIER ST_ZWAUS ECU_ADDRESS 0xd0006cb0 FORMAT "%3.0" /end MEASUREMENT
/begin MEASUREMENT St_zwaus.B_zwmin_hs "Statuswort ZWAUS" UBYTE _CNV_S_2_Def_bit_ub_700_CM 1 100. 0. 1. DISPLAY_IDENTIFIER B_ZWMIN_HS ECU_ADDRESS 0xd0006cb0 BIT_MASK 0x1 /end MEASUREMENT
/begin MEASUREMENT Sz "Schliesszeit" UWORD _CNV_R_R_Def_td_uw__592_CM 1 100. 0. 65.535 DISPLAY_IDENTIFIER SZ ECU_ADDRESS 0xd0006990 FORMAT "%8.3" /end MEASUREMENT
/begin MEASUREMENT Sz_ffmax "Schliesszeit für Folgefunken maximal" UWORD _CNV_R_R_Def_td_uw__592_CM 1 100. 0. 65.535 DISPLAY_IDENTIFIER SZ_FFMAX ECU_ADDRESS 0xd000699e FORMAT "%8.3" /end MEASUREMENT
/begin MEASUREMENT Sz_ffmin "Schliesszeit für Folgefunken minimal" UWORD _CNV_R_R_Def_td_uw__592_CM 1 100. 0. 65.535 DISPLAY_IDENTIFIER SZ_FFMIN ECU_ADDRESS 0xd00069a0 FORMAT "%8.3" /end MEASUREMENT
/begin MEASUREMENT Sz_fofu "Schliesszeit Folgefunken" UWORD _CNV_R_R_Def_td_uw__592_CM 1 100. 0. 65.535 DISPLAY_IDENTIFIER SZ_FOFU ECU_ADDRESS 0xd0006992 FORMAT "%8.3" /end MEASUREMENT
/begin MEASUREMENT T_batt "Batterietemperatur" SWORD _CNV_R_R_Def_t_sw_q_618_CM 1 100. -3276.8 3276.7 DISPLAY_IDENTIFIER T_BATT ECU_ADDRESS 0xd000728a FORMAT "%6.1" /end MEASUREMENT
/begin MEASUREMENT T_eltd_h1 "Hilfsgrösse tmot-tkwsoll" SWORD _CNV_R_R_Def_t_sw_q_620_CM 1 100. -327.68 327.67 DISPLAY_IDENTIFIER T_ELTD_H1 ECU_ADDRESS 0xc0005144 FORMAT "%7.2" /end MEASUREMENT
/begin MEASUREMENT T_eltd_h2 "Hilfsgrösse tmot-tkwsoll gefiltert" SWORD _CNV_R_R_Def_t_sw_q_620_CM 1 100. -327.68 327.67 DISPLAY_IDENTIFIER T_ELTD_H2 ECU_ADDRESS 0xc0005146 FORMAT "%7.2" /end MEASUREMENT
/begin MEASUREMENT T_es12_hs "(homogen-schicht)" UWORD _CNV_R_R_Def_td_sw__619_CM 1 100. 0. 262.14 DISPLAY_IDENTIFIER T_ES12_HS ECU_ADDRESS 0xd000711e FORMAT "%7.2" /end MEASUREMENT
/begin MEASUREMENT T_es12_s "(schicht)" UWORD _CNV_R_R_Def_td_sw__619_CM 1 100. 0. 262.14 DISPLAY_IDENTIFIER T_ES12_S ECU_ADDRESS 0xd000711a FORMAT "%7.2" /end MEASUREMENT
/begin MEASUREMENT Tabg_sensturb1 "Abgastemperatursensor Bank 1 für N54" SWORD _CNV_R_R_Def_t_sw_q_618_CM 1 100. -3276.8 3276.7 DISPLAY_IDENTIFIER TABG_SENSTURB1 ECU_ADDRESS 0xc0004cb8 FORMAT "%6.1" /end MEASUREMENT
/begin MEASUREMENT Tabg_sensturb2 "Abgastemperatursensor Bank 2 für N54" SWORD _CNV_R_R_Def_t_sw_q_618_CM 1 100. -3276.8 3276.7 DISPLAY_IDENTIFIER TABG_SENSTURB2 ECU_ADDRESS 0xc0004cba FORMAT "%6.1" /end MEASUREMENT
/begin MEASUREMENT Td_wese "Zeitabstände zwischen Einspritzung schicht zylinderindividuell" UWORD _CNV_R_R_Def_td_sw__619_CM 1 100. 0. 262.14 DISPLAY_IDENTIFIER TD_WESE ECU_ADDRESS 0xd00070b4 FORMAT "%7.2" ARRAY_SIZE 6 MATRIX_DIM 6 1 1 /end MEASUREMENT
/begin MEASUREMENT Tget_b1 "Temperatur < 80°C" UWORD _CNV_R_R_Def_f_uw_b_576_CM 1 100. 0. 99.9984 DISPLAY_IDENTIFIER TGET_B1 ECU_ADDRESS 0xc000510e FORMAT "%8.3" /end MEASUREMENT
/begin MEASUREMENT Tget_b2 "80°C =< Temperatur =< 109°C" UWORD _CNV_R_R_Def_f_uw_b_576_CM 1 100. 0. 99.9984 DISPLAY_IDENTIFIER TGET_B2 ECU_ADDRESS 0xc0005110 FORMAT "%8.3" /end MEASUREMENT
/begin MEASUREMENT Tget_b3 "110°C =< Temperatur =< 124°C" UWORD _CNV_R_R_Def_f_uw_b_576_CM 1 100. 0. 99.9984 DISPLAY_IDENTIFIER TGET_B3 ECU_ADDRESS 0xc0005112 FORMAT "%8.3" /end MEASUREMENT
/begin MEASUREMENT Tget_b4 "125°C =< Temperatur =< 129°C" UWORD _CNV_R_R_Def_f_uw_b_576_CM 1 100. 0. 99.9984 DISPLAY_IDENTIFIER TGET_B4 ECU_ADDRESS 0xc0005114 FORMAT "%8.3" /end MEASUREMENT
/begin MEASUREMENT Tget_b5 "Temperatur > 129°C" UWORD _CNV_R_R_Def_f_uw_b_576_CM 1 100. 0. 99.9984 DISPLAY_IDENTIFIER TGET_B5 ECU_ADDRESS 0xc0005116 FORMAT "%8.3" /end MEASUREMENT
/begin MEASUREMENT Tget_stat "" SWORD _CNV_R_R_Def_t_sw_q_620_CM 1 100. -327.68 327.67 DISPLAY_IDENTIFIER TGET_STAT ECU_ADDRESS 0xc0005108 FORMAT "%7.2" /end MEASUREMENT
/begin MEASUREMENT Tget_stat_b1 "Statistik für Tget, Bereich 1" FLOAT32_IEEE _CNV_R_R_Def_dez_sl_575_CM 1 100. 0. 4294967295. DISPLAY_IDENTIFIER TGET_STAT_B1 ECU_ADDRESS 0xc0004130 FORMAT "%14.7" /end MEASUREMENT
/begin MEASUREMENT Tget_stat_b2 "Statistik für Tget, Bereich 2" FLOAT32_IEEE _CNV_R_R_Def_dez_sl_575_CM 1 100. 0. 4294967295. DISPLAY_IDENTIFIER TGET_STAT_B2 ECU_ADDRESS 0xc0004134 FORMAT "%14.7" /end MEASUREMENT
/begin MEASUREMENT Tget_stat_b3 "Statistik für Tget, Bereich 3" FLOAT32_IEEE _CNV_R_R_Def_dez_sl_575_CM 1 100. 0. 4294967295. DISPLAY_IDENTIFIER TGET_STAT_B3 ECU_ADDRESS 0xc0004138 FORMAT "%14.7" /end MEASUREMENT
/begin MEASUREMENT Tget_stat_b4 "Statistik für Tget, Bereich 4" FLOAT32_IEEE _CNV_R_R_Def_dez_sl_575_CM 1 100. 0. 4294967295. DISPLAY_IDENTIFIER TGET_STAT_B4 ECU_ADDRESS 0xc000413c FORMAT "%14.7" /end MEASUREMENT
/begin MEASUREMENT Tget_stat_b5 "Statistik für Tget, Bereich 5" FLOAT32_IEEE _CNV_R_R_Def_dez_sl_575_CM 1 100. 0. 4294967295. DISPLAY_IDENTIFIER TGET_STAT_B5 ECU_ADDRESS 0xc0004140 FORMAT "%14.7" /end MEASUREMENT
/begin MEASUREMENT Tget_stat_help1 "" FLOAT32_IEEE _CNV_R_R_Def_dez_sl_575_CM 1 100. 0. 4294967295. DISPLAY_IDENTIFIER TGET_STAT_HELP1 ECU_ADDRESS 0xc00041bc FORMAT "%14.7" /end MEASUREMENT
/begin MEASUREMENT Tget_stat_help2 "" FLOAT32_IEEE _CNV_R_R_Def_dez_sl_575_CM 1 100. 0. 4294967295. DISPLAY_IDENTIFIER TGET_STAT_HELP2 ECU_ADDRESS 0xc00041c0 FORMAT "%14.7" /end MEASUREMENT
/begin MEASUREMENT Tget_stat_help3 "" FLOAT32_IEEE _CNV_R_R_Def_dez_sl_575_CM 1 100. 0. 4294967295. DISPLAY_IDENTIFIER TGET_STAT_HELP3 ECU_ADDRESS 0xc00041c4 FORMAT "%14.7" /end MEASUREMENT
/begin MEASUREMENT Tget_stat_help4 "" FLOAT32_IEEE _CNV_R_R_Def_dez_sl_575_CM 1 100. 0. 4294967295. DISPLAY_IDENTIFIER TGET_STAT_HELP4 ECU_ADDRESS 0xc00041c8 FORMAT "%14.7" /end MEASUREMENT
/begin MEASUREMENT Tget_stat_help5 "" FLOAT32_IEEE _CNV_R_R_Def_dez_sl_575_CM 1 100. 0. 4294967295. DISPLAY_IDENTIFIER TGET_STAT_HELP5 ECU_ADDRESS 0xc00041cc FORMAT "%14.7" /end MEASUREMENT
/begin MEASUREMENT Tget_sum "" FLOAT32_IEEE _CNV_R_R_Def_dez_sl_575_CM 1 100. 0. 4294967295. DISPLAY_IDENTIFIER TGET_SUM ECU_ADDRESS 0xc00041dc FORMAT "%14.7" /end MEASUREMENT
/begin MEASUREMENT Tget_wm "Getriebetemperaturersatzwert Wärmemanagement" SWORD _CNV_R_R_Def_t_sw_q_620_CM 1 100. -327.68 327.67 DISPLAY_IDENTIFIER TGET_WM ECU_ADDRESS 0xc0005148 FORMAT "%7.2" /end MEASUREMENT
/begin MEASUREMENT Tkwsoll "Solltemperatur Kühlwasser" SWORD _CNV_R_R_Def_t_sw_q_620_CM 1 100. -327.68 327.67 DISPLAY_IDENTIFIER TKWSOLL ECU_ADDRESS 0xc0002a7a FORMAT "%7.2" /end MEASUREMENT
/begin MEASUREMENT Tmot_b1 "Temperatur < 98°C" UWORD _CNV_R_R_Def_f_uw_b_576_CM 1 100. 0. 99.9984 DISPLAY_IDENTIFIER TMOT_B1 ECU_ADDRESS 0xc0005118 FORMAT "%8.3" /end MEASUREMENT
/begin MEASUREMENT Tmot_b2 "98°C =< Temperatur =< 112°C" UWORD _CNV_R_R_Def_f_uw_b_576_CM 1 100. 0. 99.9984 DISPLAY_IDENTIFIER TMOT_B2 ECU_ADDRESS 0xc000511a FORMAT "%8.3" /end MEASUREMENT
/begin MEASUREMENT Tmot_b3 "113°C =< Temperatur =< 120°C" UWORD _CNV_R_R_Def_f_uw_b_576_CM 1 100. 0. 99.9984 DISPLAY_IDENTIFIER TMOT_B3 ECU_ADDRESS 0xc000511c FORMAT "%8.3" /end MEASUREMENT
/begin MEASUREMENT Tmot_b4 "121°C =< Temperatur =< 125°C" UWORD _CNV_R_R_Def_f_uw_b_576_CM 1 100. 0. 99.9984 DISPLAY_IDENTIFIER TMOT_B4 ECU_ADDRESS 0xc000511e FORMAT "%8.3" /end MEASUREMENT
/begin MEASUREMENT Tmot_b5 "Temperatur > 125°C" UWORD _CNV_R_R_Def_f_uw_b_576_CM 1 100. 0. 99.9984 DISPLAY_IDENTIFIER TMOT_B5 ECU_ADDRESS 0xc0005120 FORMAT "%8.3" /end MEASUREMENT
/begin MEASUREMENT Tmot_stat "" SWORD _CNV_R_R_Def_t_sw_q_620_CM 1 100. -327.68 327.67 DISPLAY_IDENTIFIER TMOT_STAT ECU_ADDRESS 0xc0005106 FORMAT "%7.2" /end MEASUREMENT
/begin MEASUREMENT Tmot_stat_b1 "Statistik für Tmot, Bereich 1" FLOAT32_IEEE _CNV_R_R_Def_dez_sl_575_CM 1 100. 0. 4294967295. DISPLAY_IDENTIFIER TMOT_STAT_B1 ECU_ADDRESS 0xc0004144 FORMAT "%14.7" /end MEASUREMENT
/begin MEASUREMENT Tmot_stat_b2 "Statistik für Tmot, Bereich 2" FLOAT32_IEEE _CNV_R_R_Def_dez_sl_575_CM 1 100. 0. 4294967295. DISPLAY_IDENTIFIER TMOT_STAT_B2 ECU_ADDRESS 0xc0004148 FORMAT "%14.7" /end MEASUREMENT
/begin MEASUREMENT Tmot_stat_b3 "Statistik für Tmot, Bereich 3" FLOAT32_IEEE _CNV_R_R_Def_dez_sl_575_CM 1 100. 0. 4294967295. DISPLAY_IDENTIFIER TMOT_STAT_B3 ECU_ADDRESS 0xc000414c FORMAT "%14.7" /end MEASUREMENT
/begin MEASUREMENT Tmot_stat_b4 "Statistik für Tmot, Bereich 4" FLOAT32_IEEE _CNV_R_R_Def_dez_sl_575_CM 1 100. 0. 4294967295. DISPLAY_IDENTIFIER TMOT_STAT_B4 ECU_ADDRESS 0xc0004150 FORMAT "%14.7" /end MEASUREMENT
/begin MEASUREMENT Tmot_stat_b5 "Statistik für Tmot, Bereich 5" FLOAT32_IEEE _CNV_R_R_Def_dez_sl_575_CM 1 100. 0. 4294967295. DISPLAY_IDENTIFIER TMOT_STAT_B5 ECU_ADDRESS 0xc0004154 FORMAT "%14.7" /end MEASUREMENT
/begin MEASUREMENT Tmot_stat_help1 "" FLOAT32_IEEE _CNV_R_R_Def_dez_sl_575_CM 1 100. 0. 4294967295. DISPLAY_IDENTIFIER TMOT_STAT_HELP1 ECU_ADDRESS 0xc0004158 FORMAT "%14.7" /end MEASUREMENT
/begin MEASUREMENT Tmot_stat_help2 "" FLOAT32_IEEE _CNV_R_R_Def_dez_sl_575_CM 1 100. 0. 4294967295. DISPLAY_IDENTIFIER TMOT_STAT_HELP2 ECU_ADDRESS 0xc000415c FORMAT "%14.7" /end MEASUREMENT
/begin MEASUREMENT Tmot_stat_help3 "" FLOAT32_IEEE _CNV_R_R_Def_dez_sl_575_CM 1 100. 0. 4294967295. DISPLAY_IDENTIFIER TMOT_STAT_HELP3 ECU_ADDRESS 0xc0004160 FORMAT "%14.7" /end MEASUREMENT
/begin MEASUREMENT Tmot_stat_help4 "" FLOAT32_IEEE _CNV_R_R_Def_dez_sl_575_CM 1 100. 0. 4294967295. DISPLAY_IDENTIFIER TMOT_STAT_HELP4 ECU_ADDRESS 0xc0004164 FORMAT "%14.7" /end MEASUREMENT
/begin MEASUREMENT Tmot_stat_help5 "" FLOAT32_IEEE _CNV_R_R_Def_dez_sl_575_CM 1 100. 0. 4294967295. DISPLAY_IDENTIFIER TMOT_STAT_HELP5 ECU_ADDRESS 0xc0004168 FORMAT "%14.7" /end MEASUREMENT
/begin MEASUREMENT Tmot_sum "" FLOAT32_IEEE _CNV_R_R_Def_dez_sl_575_CM 1 100. 0. 4294967295. DISPLAY_IDENTIFIER TMOT_SUM ECU_ADDRESS 0xc00041d4 FORMAT "%14.7" /end MEASUREMENT
/begin MEASUREMENT Tmot_wm "Tmot für WMK" SWORD _CNV_R_R_Def_t_sw_q_620_CM 1 100. -327.68 327.67 DISPLAY_IDENTIFIER TMOT_WM ECU_ADDRESS 0xc00050d6 FORMAT "%7.2" /end MEASUREMENT
/begin MEASUREMENT Toel_b1 "Temperatur < 80°C" UWORD _CNV_R_R_Def_f_uw_b_576_CM 1 100. 0. 99.9984 DISPLAY_IDENTIFIER TOEL_B1 ECU_ADDRESS 0xc0005122 FORMAT "%8.3" /end MEASUREMENT
/begin MEASUREMENT Toel_b2 "80°C =< Temperatur =< 110°C" UWORD _CNV_R_R_Def_f_uw_b_576_CM 1 100. 0. 99.9984 DISPLAY_IDENTIFIER TOEL_B2 ECU_ADDRESS 0xc0005124 FORMAT "%8.3" /end MEASUREMENT
/begin MEASUREMENT Toel_b3 "110°C =< Temperatur =< 135°C" UWORD _CNV_R_R_Def_f_uw_b_576_CM 1 100. 0. 99.9984 DISPLAY_IDENTIFIER TOEL_B3 ECU_ADDRESS 0xc0005126 FORMAT "%8.3" /end MEASUREMENT
/begin MEASUREMENT Toel_b4 "135°C =< Temperatur =< 150°C" UWORD _CNV_R_R_Def_f_uw_b_576_CM 1 100. 0. 99.9984 DISPLAY_IDENTIFIER TOEL_B4 ECU_ADDRESS 0xc0005128 FORMAT "%8.3" /end MEASUREMENT
/begin MEASUREMENT Toel_b5 "Temperatur > 150°C" UWORD _CNV_R_R_Def_f_uw_b_576_CM 1 100. 0. 99.9984 DISPLAY_IDENTIFIER TOEL_B5 ECU_ADDRESS 0xc000512a FORMAT "%8.3" /end MEASUREMENT
/begin MEASUREMENT Toel_stat "" SWORD _CNV_R_R_Def_t_sw_q_618_CM 1 100. -3276.8 3276.7 DISPLAY_IDENTIFIER TOEL_STAT ECU_ADDRESS 0xc000510a FORMAT "%6.1" /end MEASUREMENT
/begin MEASUREMENT Toel_stat_b1 "Statistik für Toel, Bereich 1" FLOAT32_IEEE _CNV_R_R_Def_dez_sl_575_CM 1 100. 0. 4294967295. DISPLAY_IDENTIFIER TOEL_STAT_B1 ECU_ADDRESS 0xc000416c FORMAT "%14.7" /end MEASUREMENT
/begin MEASUREMENT Toel_stat_b2 "Statistik für Toel, Bereich 2" FLOAT32_IEEE _CNV_R_R_Def_dez_sl_575_CM 1 100. 0. 4294967295. DISPLAY_IDENTIFIER TOEL_STAT_B2 ECU_ADDRESS 0xc0004170 FORMAT "%14.7" /end MEASUREMENT
/begin MEASUREMENT Toel_stat_b3 "Statistik für Toel, Bereich 3" FLOAT32_IEEE _CNV_R_R_Def_dez_sl_575_CM 1 100. 0. 4294967295. DISPLAY_IDENTIFIER TOEL_STAT_B3 ECU_ADDRESS 0xc0004174 FORMAT "%14.7" /end MEASUREMENT
/begin MEASUREMENT Toel_stat_b4 "Statistik für Toel, Bereich 4" FLOAT32_IEEE _CNV_R_R_Def_dez_sl_575_CM 1 100. 0. 4294967295. DISPLAY_IDENTIFIER TOEL_STAT_B4 ECU_ADDRESS 0xc0004178 FORMAT "%14.7" /end MEASUREMENT
/begin MEASUREMENT Toel_stat_b5 "Statistik für Toel, Bereich 5" FLOAT32_IEEE _CNV_R_R_Def_dez_sl_575_CM 1 100. 0. 4294967295. DISPLAY_IDENTIFIER TOEL_STAT_B5 ECU_ADDRESS 0xc000417c FORMAT "%14.7" /end MEASUREMENT
/begin MEASUREMENT Toel_stat_help1 "" FLOAT32_IEEE _CNV_R_R_Def_dez_sl_575_CM 1 100. 0. 4294967295. DISPLAY_IDENTIFIER TOEL_STAT_HELP1 ECU_ADDRESS 0xc00041a8 FORMAT "%14.7" /end MEASUREMENT
/begin MEASUREMENT Toel_stat_help2 "" FLOAT32_IEEE _CNV_R_R_Def_dez_sl_575_CM 1 100. 0. 4294967295. DISPLAY_IDENTIFIER TOEL_STAT_HELP2 ECU_ADDRESS 0xc00041ac FORMAT "%14.7" /end MEASUREMENT
/begin MEASUREMENT Toel_stat_help3 "" FLOAT32_IEEE _CNV_R_R_Def_dez_sl_575_CM 1 100. 0. 4294967295. DISPLAY_IDENTIFIER TOEL_STAT_HELP3 ECU_ADDRESS 0xc00041b0 FORMAT "%14.7" /end MEASUREMENT
/begin MEASUREMENT Toel_stat_help4 "" FLOAT32_IEEE _CNV_R_R_Def_dez_sl_575_CM 1 100. 0. 4294967295. DISPLAY_IDENTIFIER TOEL_STAT_HELP4 ECU_ADDRESS 0xc00041b4 FORMAT "%14.7" /end MEASUREMENT
/begin MEASUREMENT Toel_stat_help5 "" FLOAT32_IEEE _CNV_R_R_Def_dez_sl_575_CM 1 100. 0. 4294967295. DISPLAY_IDENTIFIER TOEL_STAT_HELP5 ECU_ADDRESS 0xc00041b8 FORMAT "%14.7" /end MEASUREMENT
/begin MEASUREMENT Toel_sum "" FLOAT32_IEEE _CNV_R_R_Def_dez_sl_575_CM 1 100. 0. 4294967295. DISPLAY_IDENTIFIER TOEL_SUM ECU_ADDRESS 0xc00041d0 FORMAT "%14.7" /end MEASUREMENT
/begin MEASUREMENT Tumg_b1 "Temperatur < 3°C" UWORD _CNV_R_R_Def_f_uw_b_576_CM 1 100. 0. 99.9984 DISPLAY_IDENTIFIER TUMG_B1 ECU_ADDRESS 0xc000512c FORMAT "%8.3" /end MEASUREMENT
/begin MEASUREMENT Tumg_b2 "3°C =< Temperatur =< 19°C" UWORD _CNV_R_R_Def_f_uw_b_576_CM 1 100. 0. 99.9984 DISPLAY_IDENTIFIER TUMG_B2 ECU_ADDRESS 0xc000512e FORMAT "%8.3" /end MEASUREMENT
/begin MEASUREMENT Tumg_b3 "20°C =< Temperatur =< 29°C" UWORD _CNV_R_R_Def_f_uw_b_576_CM 1 100. 0. 99.9984 DISPLAY_IDENTIFIER TUMG_B3 ECU_ADDRESS 0xc0005130 FORMAT "%8.3" /end MEASUREMENT
/begin MEASUREMENT Tumg_b4 "30°C =< Temperatur =< 39°C" UWORD _CNV_R_R_Def_f_uw_b_576_CM 1 100. 0. 99.9984 DISPLAY_IDENTIFIER TUMG_B4 ECU_ADDRESS 0xc0005132 FORMAT "%8.3" /end MEASUREMENT
/begin MEASUREMENT Tumg_b5 "Temperatur > 39°C" UWORD _CNV_R_R_Def_f_uw_b_576_CM 1 100. 0. 99.9984 DISPLAY_IDENTIFIER TUMG_B5 ECU_ADDRESS 0xc0005134 FORMAT "%8.3" /end MEASUREMENT
/begin MEASUREMENT Tumg_stat "" SWORD _CNV_R_R_Def_t_sw_q_620_CM 1 100. -327.68 327.67 DISPLAY_IDENTIFIER TUMG_STAT ECU_ADDRESS 0xc000510c FORMAT "%7.2" /end MEASUREMENT
/begin MEASUREMENT Tumg_stat_b1 "Statistik für Tumg, Bereich 1" FLOAT32_IEEE _CNV_R_R_Def_dez_sl_575_CM 1 100. 0. 4294967295. DISPLAY_IDENTIFIER TUMG_STAT_B1 ECU_ADDRESS 0xc0004180 FORMAT "%14.7" /end MEASUREMENT
/begin MEASUREMENT Tumg_stat_b2 "Statistik für Tumg, Bereich 2" FLOAT32_IEEE _CNV_R_R_Def_dez_sl_575_CM 1 100. 0. 4294967295. DISPLAY_IDENTIFIER TUMG_STAT_B2 ECU_ADDRESS 0xc0004184 FORMAT "%14.7" /end MEASUREMENT
/begin MEASUREMENT Tumg_stat_b3 "Statistik für Tumg, Bereich 3" FLOAT32_IEEE _CNV_R_R_Def_dez_sl_575_CM 1 100. 0. 4294967295. DISPLAY_IDENTIFIER TUMG_STAT_B3 ECU_ADDRESS 0xc0004188 FORMAT "%14.7" /end MEASUREMENT
/begin MEASUREMENT Tumg_stat_b4 "Statistik für Tumg, Bereich 4" FLOAT32_IEEE _CNV_R_R_Def_dez_sl_575_CM 1 100. 0. 4294967295. DISPLAY_IDENTIFIER TUMG_STAT_B4 ECU_ADDRESS 0xc000418c FORMAT "%14.7" /end MEASUREMENT
/begin MEASUREMENT Tumg_stat_b5 "Statistik für Tumg, Bereich 5" FLOAT32_IEEE _CNV_R_R_Def_dez_sl_575_CM 1 100. 0. 4294967295. DISPLAY_IDENTIFIER TUMG_STAT_B5 ECU_ADDRESS 0xc0004190 FORMAT "%14.7" /end MEASUREMENT
/begin MEASUREMENT Tumg_stat_help1 "" FLOAT32_IEEE _CNV_R_R_Def_dez_sl_575_CM 1 100. 0. 4294967295. DISPLAY_IDENTIFIER TUMG_STAT_HELP1 ECU_ADDRESS 0xc0004194 FORMAT "%14.7" /end MEASUREMENT
/begin MEASUREMENT Tumg_stat_help2 "" FLOAT32_IEEE _CNV_R_R_Def_dez_sl_575_CM 1 100. 0. 4294967295. DISPLAY_IDENTIFIER TUMG_STAT_HELP2 ECU_ADDRESS 0xc0004198 FORMAT "%14.7" /end MEASUREMENT
/begin MEASUREMENT Tumg_stat_help3 "" FLOAT32_IEEE _CNV_R_R_Def_dez_sl_575_CM 1 100. 0. 4294967295. DISPLAY_IDENTIFIER TUMG_STAT_HELP3 ECU_ADDRESS 0xc000419c FORMAT "%14.7" /end MEASUREMENT
/begin MEASUREMENT Tumg_stat_help4 "" FLOAT32_IEEE _CNV_R_R_Def_dez_sl_575_CM 1 100. 0. 4294967295. DISPLAY_IDENTIFIER TUMG_STAT_HELP4 ECU_ADDRESS 0xc00041a0 FORMAT "%14.7" /end MEASUREMENT
/begin MEASUREMENT Tumg_stat_help5 "" FLOAT32_IEEE _CNV_R_R_Def_dez_sl_575_CM 1 100. 0. 4294967295. DISPLAY_IDENTIFIER TUMG_STAT_HELP5 ECU_ADDRESS 0xc00041a4 FORMAT "%14.7" /end MEASUREMENT
/begin MEASUREMENT Tumg_sum "" FLOAT32_IEEE _CNV_R_R_Def_dez_sl_575_CM 1 100. 0. 4294967295. DISPLAY_IDENTIFIER TUMG_SUM ECU_ADDRESS 0xc00041d8 FORMAT "%14.7" /end MEASUREMENT
/begin MEASUREMENT Tv_av_heizkr "Stellgrösse Absperrventil Heizkreislauf" UBYTE _CNV_R_R_Def_tv_ub__729_CM 1 100. 0. 100. DISPLAY_IDENTIFIER TV_AV_HEIZKR ECU_ADDRESS 0xc0005104 FORMAT "%5.2" /end MEASUREMENT
/begin MEASUREMENT Tv_kft "Tastverhaeltnis zur Ansteuerung des KFT vor extern-Auswahl" UWORD _CNV_R_R_Def_f_uw_b_576_CM 1 100. 0. 99.9984 DISPLAY_IDENTIFIER TV_KFT ECU_ADDRESS 0xc0002a78 FORMAT "%8.3" /end MEASUREMENT
/begin MEASUREMENT Tvkft "Tastverhaeltnis zur Ansteuerung des KFT vor extern-Auswahl" SWORD _CNV_R_R_Def_rel_sw_584_CM 1 100. -100. 99.9969 DISPLAY_IDENTIFIER TVKFT ECU_ADDRESS 0xc0002a7e FORMAT "%8.3" /end MEASUREMENT
/begin MEASUREMENT Tvulv "ULV Ansteuerung" UWORD _CNV_R_R_Def_f_uw_b_576_CM 1 100. 0. 99.9984 DISPLAY_IDENTIFIER TVULV ECU_ADDRESS 0xd0006ac8 FORMAT "%8.3" /end MEASUREMENT
/begin MEASUREMENT Tvulvpump "Ansteuerung ULV Offset bei Pumpeingriffen" UWORD _CNV_R_R_Def_f_uw_b_576_CM 1 100. 0. 99.9984 DISPLAY_IDENTIFIER TVULVPUMP ECU_ADDRESS 0xd0006aca FORMAT "%8.3" /end MEASUREMENT
/begin MEASUREMENT Tvulvpump23 "Pumpeingriff durch Ansteuerung ULV - adaptiver Wert" UWORD _CNV_R_R_Def_f_uw_b_576_CM 1 100. 0. 99.9984 DISPLAY_IDENTIFIER TVULVPUMP23 ECU_ADDRESS 0xc0004034 FORMAT "%8.3" /end MEASUREMENT
/begin MEASUREMENT U_gen "Sollwert Generatorspannung" UWORD _CNV_R_R_Def_u_uw_q_731_CM 1 100. 0. 6553.5 DISPLAY_IDENTIFIER U_GEN ECU_ADDRESS 0xc0002a26 FORMAT "%8.3" /end MEASUREMENT
/begin MEASUREMENT U_gen2 "Generatosspannungssollwert für Generator2" UWORD _CNV_R_R_Def_u_uw_q_731_CM 1 100. 0. 16. DISPLAY_IDENTIFIER U_GEN2 ECU_ADDRESS 0xc0002a28 FORMAT "%8.3" /end MEASUREMENT
/begin MEASUREMENT U_gen_igr "Leitungskompensierte Generatorspg für iGR" UWORD _CNV_R_R_Def_u_uw_q_731_CM 1 100. 0. 6553.5 DISPLAY_IDENTIFIER U_GEN_IGR ECU_ADDRESS 0xc0002a34 FORMAT "%8.3" /end MEASUREMENT
/begin MEASUREMENT U_gsoll "Generatorsollspannung Basis" UWORD _CNV_R_R_Def_u_uw_q_731_CM 1 100. 0. 6553.5 DISPLAY_IDENTIFIER U_GSOLL ECU_ADDRESS 0xc0002a2a FORMAT "%8.3" /end MEASUREMENT
/begin MEASUREMENT U_gsoll_off "Generatorsollspannung Basis" UWORD _CNV_R_R_Def_u_uw_q_731_CM 1 100. 0. 6553.5 DISPLAY_IDENTIFIER U_GSOLL_OFF ECU_ADDRESS 0xc0002a2c FORMAT "%8.3" /end MEASUREMENT
/begin MEASUREMENT U_gsoll_tp "Generatorsollspannung Basis" UWORD _CNV_R_R_Def_u_uw_q_731_CM 1 100. 0. 6553.5 DISPLAY_IDENTIFIER U_GSOLL_TP ECU_ADDRESS 0xc0002a2e FORMAT "%8.3" /end MEASUREMENT
/begin MEASUREMENT U_gsoll_tp2 "Generatorsollspannung Basis" UWORD _CNV_R_R_Def_u_uw_q_731_CM 1 100. 0. 6553.5 DISPLAY_IDENTIFIER U_GSOLL_TP2 ECU_ADDRESS 0xc0002a36 FORMAT "%8.3" /end MEASUREMENT
/begin MEASUREMENT U_gsoll_tp3 "Generatorsollspannung Basis 3" UWORD _CNV_R_R_Def_u_uw_q_731_CM 1 100. 0. 6553.5 DISPLAY_IDENTIFIER U_GSOLL_TP3 ECU_ADDRESS 0xc0002a30 FORMAT "%8.3" /end MEASUREMENT
/begin MEASUREMENT U_gsollred "reduzierte Generatorsollspannung" UWORD _CNV_R_R_Def_u_uw_q_731_CM 1 100. 0. 6553.5 DISPLAY_IDENTIFIER U_GSOLLRED ECU_ADDRESS 0xc0002a38 FORMAT "%8.3" /end MEASUREMENT
/begin MEASUREMENT U_gsolltmp "reduzierte Zwischengeneratorsollspannung" UWORD _CNV_R_R_Def_u_uw_q_731_CM 1 100. 0. 6553.5 DISPLAY_IDENTIFIER U_GSOLLTMP ECU_ADDRESS 0xc0002a3a FORMAT "%8.3" /end MEASUREMENT
/begin MEASUREMENT U_rampentl "Spannungsrampe bei Entlastunganforderung" UWORD _CNV_R_R_Def_u_uw_q_731_CM 1 100. 0. 6553.5 DISPLAY_IDENTIFIER U_RAMPENTL ECU_ADDRESS 0xd0006976 FORMAT "%8.3" /end MEASUREMENT
/begin MEASUREMENT U_sollentl "Spannung bei Entlastunganforderung" UWORD _CNV_R_R_Def_u_uw_q_731_CM 1 100. 0. 6553.5 DISPLAY_IDENTIFIER U_SOLLENTL ECU_ADDRESS 0xd0006978 FORMAT "%8.3" /end MEASUREMENT
/begin MEASUREMENT Ubw_uszr "Schwingungszähler Bordnetzspannung" UBYTE _CNV_R_R_Def_dez_sl_575_CM 1 100. 0. 255. DISPLAY_IDENTIFIER UBW_USZR ECU_ADDRESS 0xd00072d4 FORMAT "%3.0" /end MEASUREMENT
/begin MEASUREMENT Ubw_zr "Zähler Bordnetzspannung instabil" UWORD _CNV_R_R_Def_dez_sl_575_CM 1 100. 0. 65535. DISPLAY_IDENTIFIER UBW_ZR ECU_ADDRESS 0xd00072ce FORMAT "%5.0" /end MEASUREMENT
/begin MEASUREMENT Ugin_fq "" UWORD _CNV_R_R_Def_u_uw_q_735_CM 1 100. 0. 983.025 DISPLAY_IDENTIFIER UGIN_FQ ECU_ADDRESS 0xc0002a3c FORMAT "%8.3" /end MEASUREMENT
/begin MEASUREMENT Ulvr "Umluftventil - Stellgrösse" UWORD _CNV_R_R_Def_f_uw_b_576_CM 1 100. 0. 99.9984 DISPLAY_IDENTIFIER ULVR ECU_ADDRESS 0xd0006ad8 FORMAT "%8.3" /end MEASUREMENT
/begin MEASUREMENT Ulvr_d "Stellgröße - D Anteil" SWORD _CNV_R_R_Def_rel_sw_584_CM 1 100. -100. 99.9969 DISPLAY_IDENTIFIER ULVR_D ECU_ADDRESS 0xd0006ada FORMAT "%8.3" /end MEASUREMENT
/begin MEASUREMENT Ulvr_i "Stellgröße - I Anteil" SWORD _CNV_R_R_Def_rel_sw_584_CM 1 100. -100. 99.9969 DISPLAY_IDENTIFIER ULVR_I ECU_ADDRESS 0xd0006adc FORMAT "%8.3" /end MEASUREMENT
/begin MEASUREMENT Ulvr_p "Stellgröße - P Anteil" SWORD _CNV_R_R_Def_rel_sw_584_CM 1 100. -100. 99.9969 DISPLAY_IDENTIFIER ULVR_P ECU_ADDRESS 0xd0006ade FORMAT "%8.3" /end MEASUREMENT
/begin MEASUREMENT Ulvvst "Vorsteuerung Umluftventil" UWORD _CNV_R_R_Def_f_uw_b_576_CM 1 100. 0. 99.9984 DISPLAY_IDENTIFIER ULVVST ECU_ADDRESS 0xd0006ae0 FORMAT "%8.3" /end MEASUREMENT
/begin MEASUREMENT Ulzr "Zähler für Erkennung zyklischer Spannungseinbruch" UWORD _CNV_R_R_Def_dez_sl_575_CM 1 100. 0. 65535. DISPLAY_IDENTIFIER ULZR ECU_ADDRESS 0xd00072d0 FORMAT "%5.0" /end MEASUREMENT
/begin MEASUREMENT Uszr "Zähler für Erkennung dauerhafter Spannungseinbruch" UWORD _CNV_R_R_Def_dez_sl_575_CM 1 100. 0. 65535. DISPLAY_IDENTIFIER USZR ECU_ADDRESS 0xd00072d2 FORMAT "%5.0" /end MEASUREMENT
/begin MEASUREMENT Vs_eco_agsw "gefilterter und faktorisierter Volumenstrom automatik Getriebe Sollwert" UWORD _CNV_R_R_Def_vs_uw__693_CM 1 100. 0. 9999.847400000001 DISPLAY_IDENTIFIER VS_ECO_AGSW ECU_ADDRESS 0xc0005156 FORMAT "%7.2" /end MEASUREMENT
/begin MEASUREMENT Vs_eco_motsw "gefilterter und faktoriesierter Volumenstrommotor Sollwert für eWAPU" UWORD _CNV_R_R_Def_vs_uw__693_CM 1 100. 0. 9999.847400000001 DISPLAY_IDENTIFIER VS_ECO_MOTSW ECU_ADDRESS 0xc0005158 FORMAT "%7.2" /end MEASUREMENT
/begin MEASUREMENT Vs_ewp_ag "Volumenstromanforderung Automatikgetriebe" UWORD _CNV_R_R_Def_vs_uw__693_CM 1 100. 0. 9999.847400000001 DISPLAY_IDENTIFIER VS_EWP_AG ECU_ADDRESS 0xc00050ba FORMAT "%7.2" /end MEASUREMENT
/begin MEASUREMENT Vs_ewp_bsd "Volumenstrom EWP gesamt" UWORD _CNV_R_R_Def_vs_uw__693_CM 1 100. 0. 9999.847400000001 DISPLAY_IDENTIFIER VS_EWP_BSD ECU_ADDRESS 0xc000515a FORMAT "%7.2" /end MEASUREMENT
/begin MEASUREMENT Vs_ewp_mot "Volumenstromanforderung Motor" UWORD _CNV_R_R_Def_vs_uw__693_CM 1 100. 0. 9999.847400000001 DISPLAY_IDENTIFIER VS_EWP_MOT ECU_ADDRESS 0xc00050bc FORMAT "%7.2" /end MEASUREMENT
/begin MEASUREMENT Vs_ewp_of "" UWORD _CNV_R_R_Def_dez_sl_575_CM 1 100. 0. 65535. DISPLAY_IDENTIFIER VS_EWP_OF ECU_ADDRESS 0xc00050be FORMAT "%5.0" /end MEASUREMENT
/begin MEASUREMENT Vs_ewp_warml "Volumenstrom Anforderung eWAPU im Warmlauf" UWORD _CNV_R_R_Def_vs_uw__693_CM 1 100. 0. 9999.847400000001 DISPLAY_IDENTIFIER VS_EWP_WARML ECU_ADDRESS 0xc000515c FORMAT "%7.2" /end MEASUREMENT
/begin MEASUREMENT Vs_ewpkaac "Aktueller Wert aufsummierter Kraftstoffmassenstrom" UWORD _CNV_R_R_Def_f_uw_b_739_CM 1 100. 0. 2999.9542 DISPLAY_IDENTIFIER VS_EWPKAAC ECU_ADDRESS 0xc00050ee FORMAT "%7.2" /end MEASUREMENT
/begin MEASUREMENT Vs_ewpvbz "Berechnetes Verbrauchsziel" UWORD _CNV_R_R_Def_dez_sl_575_CM 1 100. 0. 65535. DISPLAY_IDENTIFIER VS_EWPVBZ ECU_ADDRESS 0xc00050f0 FORMAT "%5.0" /end MEASUREMENT
/begin MEASUREMENT Vs_high_agsw "Volumenstromanforderung eWAPU für Highbetrieb" UWORD _CNV_R_R_Def_vs_uw__693_CM 1 100. 0. 9999.847400000001 DISPLAY_IDENTIFIER VS_HIGH_AGSW ECU_ADDRESS 0xc000515e FORMAT "%7.2" /end MEASUREMENT
/begin MEASUREMENT Vs_high_motsw "Volumenstromanforderung eWAPU für Highbetriebsart" UWORD _CNV_R_R_Def_vs_uw__693_CM 1 100. 0. 9999.847400000001 DISPLAY_IDENTIFIER VS_HIGH_MOTSW ECU_ADDRESS 0xc0005160 FORMAT "%7.2" /end MEASUREMENT
/begin MEASUREMENT Vs_hkft_agsw "Volumenstromanforderung AG für High+Kft Betrieb" UWORD _CNV_R_R_Def_vs_uw__693_CM 1 100. 0. 9999.847400000001 DISPLAY_IDENTIFIER VS_HKFT_AGSW ECU_ADDRESS 0xc0005162 FORMAT "%7.2" /end MEASUREMENT
/begin MEASUREMENT Vs_hkft_motsw "Volumenstromanforderung Motor für High+Kft Betrieb" UWORD _CNV_R_R_Def_vs_uw__693_CM 1 100. 0. 9999.847400000001 DISPLAY_IDENTIFIER VS_HKFT_MOTSW ECU_ADDRESS 0xc0005164 FORMAT "%7.2" /end MEASUREMENT
/begin MEASUREMENT Vs_norm_agsw "Volumenstromanforderung automatik Getriebe für Normalbetrieb" UWORD _CNV_R_R_Def_vs_uw__693_CM 1 100. 0. 9999.847400000001 DISPLAY_IDENTIFIER VS_NORM_AGSW ECU_ADDRESS 0xc0005166 FORMAT "%7.2" /end MEASUREMENT
/begin MEASUREMENT Vs_norm_motsw "Volumenstromanforderung Motor für Normalbetrieb" UWORD _CNV_R_R_Def_vs_uw__693_CM 1 100. 0. 9999.847400000001 DISPLAY_IDENTIFIER VS_NORM_MOTSW ECU_ADDRESS 0xc0005168 FORMAT "%7.2" /end MEASUREMENT
/begin MEASUREMENT Vskr_ewp_ist "Kraftstoffverbrauch plausibilisiert" UWORD _CNV_R_R_Def_dez_sl_575_CM 1 100. 0. 65535. DISPLAY_IDENTIFIER VSKR_EWP_IST ECU_ADDRESS 0xc00050c0 FORMAT "%5.0" /end MEASUREMENT
/begin MEASUREMENT Vvtaet "Exzenterwinkelvorgabe vom Tester" UBYTE _CNV_R_R_Def_exwink_746_CM 1 100. 0. 179.2968 DISPLAY_IDENTIFIER VVTAET ECU_ADDRESS 0xd0006970 FORMAT "%5.2" /end MEASUREMENT
/begin MEASUREMENT Wes "Winkel Einlaß schließt bezogen auf ZOT" SWORD _CNV_R_R_Def_kw_sw__622_CM 1 100. -768. 767.9765 DISPLAY_IDENTIFIER WES ECU_ADDRESS 0xc0002a48 FORMAT "%8.3" /end MEASUREMENT
/begin MEASUREMENT Wesb1_bas_h "" SWORD _CNV_R_R_Def_kw_sw__622_CM 1 100. -768. 767.9765 DISPLAY_IDENTIFIER WESB1_BAS_H ECU_ADDRESS 0xd000710c FORMAT "%8.3" /end MEASUREMENT
/begin MEASUREMENT Wesb1_h "" SWORD _CNV_R_R_Def_kw_sw__622_CM 1 100. -768. 767.9765 DISPLAY_IDENTIFIER WESB1_H ECU_ADDRESS 0xd00070c0 FORMAT "%8.3" ARRAY_SIZE 6 MATRIX_DIM 6 1 1 /end MEASUREMENT
/begin MEASUREMENT Wesb1_hs "" SWORD _CNV_R_R_Def_kw_sw__622_CM 1 100. -768. 767.9765 DISPLAY_IDENTIFIER WESB1_HS ECU_ADDRESS 0xd00070f0 FORMAT "%8.3" ARRAY_SIZE 6 MATRIX_DIM 6 1 1 /end MEASUREMENT
/begin MEASUREMENT Wesb3_kh_s "Einspritzbeginn 3. Einspritzung für KH" SWORD _CNV_R_R_Def_kw_sw__622_CM 1 100. -768. 767.9765 DISPLAY_IDENTIFIER WESB3_KH_S ECU_ADDRESS 0xd000710a FORMAT "%8.3" /end MEASUREMENT
/begin MEASUREMENT Wesb3_s "" SWORD _CNV_R_R_Def_kw_sw__622_CM 1 100. -768. 767.9765 DISPLAY_IDENTIFIER WESB3_S ECU_ADDRESS 0xd00070e4 FORMAT "%8.3" ARRAY_SIZE 6 MATRIX_DIM 6 1 1 /end MEASUREMENT
/begin MEASUREMENT Wesbst_h "" SWORD _CNV_R_R_Def_kw_sw__622_CM 1 100. -768. 767.9765 DISPLAY_IDENTIFIER WESBST_H ECU_ADDRESS 0xd000710e FORMAT "%8.3" /end MEASUREMENT
/begin MEASUREMENT Wese2_bas_h "" SWORD _CNV_R_R_Def_kw_sw__622_CM 1 100. -768. 767.9765 DISPLAY_IDENTIFIER WESE2_BAS_H ECU_ADDRESS 0xd0007108 FORMAT "%8.3" /end MEASUREMENT
/begin MEASUREMENT Wese2_h "" SWORD _CNV_R_R_Def_kw_sw__622_CM 1 100. -768. 767.9765 DISPLAY_IDENTIFIER WESE2_H ECU_ADDRESS 0xd00070cc FORMAT "%8.3" ARRAY_SIZE 6 MATRIX_DIM 6 1 1 /end MEASUREMENT
/begin MEASUREMENT Wese2_hs "(homogen-schicht)" SWORD _CNV_R_R_Def_kw_sw__622_CM 1 100. -768. 767.9765 DISPLAY_IDENTIFIER WESE2_HS ECU_ADDRESS 0xd00070fc FORMAT "%8.3" ARRAY_SIZE 6 MATRIX_DIM 6 1 1 /end MEASUREMENT
/begin MEASUREMENT Wese2_s "(schicht)" SWORD _CNV_R_R_Def_kw_sw__622_CM 1 100. -768. 767.9765 DISPLAY_IDENTIFIER WESE2_S ECU_ADDRESS 0xd0007118 FORMAT "%8.3" /end MEASUREMENT
/begin MEASUREMENT Wese_s "Einspritzende Haupteinspritzung zylinderindivduell" SWORD _CNV_R_R_Def_kw_sw__622_CM 1 100. -768. 767.9765 DISPLAY_IDENTIFIER WESE_S ECU_ADDRESS 0xd00070a8 FORMAT "%8.3" ARRAY_SIZE 6 MATRIX_DIM 6 1 1 /end MEASUREMENT
/begin MEASUREMENT Wesnesprau "Winkel Einlaß schließt ahängig vom Hub" SWORD _CNV_R_R_Def_kw_sw__622_CM 1 100. -768. 767.9765 DISPLAY_IDENTIFIER WESNESPRAU ECU_ADDRESS 0xc0002a4a FORMAT "%8.3" /end MEASUREMENT
/begin MEASUREMENT Wkrm "-" UBYTE _CNV_R_R_Def_zw_ub__748_CM 1 100. -191.25 0. DISPLAY_IDENTIFIER WKRM ECU_ADDRESS 0xc00029bf FORMAT "%5.2" /end MEASUREMENT
/begin MEASUREMENT Z_fofu "Anzahl Folgefunken" UBYTE _CNV_R_R_Def_dez_sl_575_CM 1 100. 0. 255. DISPLAY_IDENTIFIER Z_FOFU ECU_ADDRESS 0xd0006994 FORMAT "%3.0" /end MEASUREMENT
/begin MEASUREMENT Zaehl_beug "Zähler Befüllen/Entlüften" UWORD _CNV_R_R_Def_dez_sl_575_CM 1 100. 0. 65535. DISPLAY_IDENTIFIER ZAEHL_BEUG ECU_ADDRESS 0xc000516a FORMAT "%5.0" /end MEASUREMENT
/begin MEASUREMENT Zaehl_w_ugwm "" UWORD _CNV_R_R_Def_dez_sl_575_CM 1 100. 0. 65535. DISPLAY_IDENTIFIER ZAEHL_W_UGWM ECU_ADDRESS 0xc0005184 FORMAT "%5.0" /end MEASUREMENT
/begin MEASUREMENT Zaehl_wm_sta "Zähler WMK Statistik" UBYTE _CNV_R_R_Def_dez_sl_575_CM 1 100. 0. 255. DISPLAY_IDENTIFIER ZAEHL_WM_STA ECU_ADDRESS 0xc000517f FORMAT "%3.0" /end MEASUREMENT
/begin MEASUREMENT Zaehler_qsnl "Zähler im Nachlauf u. Wake-up für Qs_anf_klima" UWORD _CNV_R_R_Def_dez_sl_575_CM 1 100. 0. 65535. DISPLAY_IDENTIFIER ZAEHLER_QSNL ECU_ADDRESS 0xc0005188 FORMAT "%5.0" /end MEASUREMENT
/begin MEASUREMENT Zaehler_ugwm "" UWORD _CNV_R_R_Def_dez_sl_575_CM 1 100. 0. 65535. DISPLAY_IDENTIFIER ZAEHLER_UGWM ECU_ADDRESS 0xc0005186 FORMAT "%5.0" /end MEASUREMENT
/begin MEASUREMENT Zahler_pwg "Zähler für  Pedalwertgeber" UWORD _CNV_R_R_Def_dez_sl_575_CM 1 100. 0. 65535. DISPLAY_IDENTIFIER ZAHLER_PWG ECU_ADDRESS 0xc00050f2 FORMAT "%5.0" /end MEASUREMENT
/begin MEASUREMENT Zw_bas_hs "Grundzündwinkel (homogen-schicht)" SWORD _CNV_R_R_Def_zw_sw__599_CM 1 100. -50. 60. DISPLAY_IDENTIFIER ZW_BAS_HS ECU_ADDRESS 0xd0006cb4 FORMAT "%6.1" /end MEASUREMENT
/begin MEASUREMENT Zw_bas_s "Grundzündwinkel (schicht)" SWORD _CNV_R_R_Def_zw_sw__599_CM 1 100. -50. 60. DISPLAY_IDENTIFIER ZW_BAS_S ECU_ADDRESS 0xd0006cb2 FORMAT "%6.1" /end MEASUREMENT
/begin MEASUREMENT Zw_kor_hs "korigierter Grundzündwinkel (homogen-schicht)" SWORD _CNV_R_R_Def_zw_sw__599_CM 1 100. -50. 60. DISPLAY_IDENTIFIER ZW_KOR_HS ECU_ADDRESS 0xd0006c7a FORMAT "%6.1" /end MEASUREMENT
/begin MEASUREMENT Zw_kor_s "korigierter Grundzündwinkel (schicht)" SWORD _CNV_R_R_Def_zw_sw__599_CM 1 100. -50. 60. DISPLAY_IDENTIFIER ZW_KOR_S ECU_ADDRESS 0xd0006c78 FORMAT "%6.1" /end MEASUREMENT
/begin MEASUREMENT Zw_korkr_hs "" SWORD _CNV_R_R_Def_zw_sw__599_CM 1 100. -50. 60. DISPLAY_IDENTIFIER ZW_KORKR_HS ECU_ADDRESS 0xd0006ca4 FORMAT "%6.1" ARRAY_SIZE 6 MATRIX_DIM 6 1 1 /end MEASUREMENT
/begin MEASUREMENT Zw_min_hs "minimal möglicher Zündwinkel (homogen-schicht)" SWORD _CNV_R_R_Def_zw_sw__599_CM 1 100. -50. 60. DISPLAY_IDENTIFIER ZW_MIN_HS ECU_ADDRESS 0xd0006cba FORMAT "%6.1" /end MEASUREMENT
/begin MEASUREMENT Zw_opt_hs "optimaler Zündwinkel (homogen-schicht)" SWORD _CNV_R_R_Def_zw_sw__599_CM 1 100. -50. 60. DISPLAY_IDENTIFIER ZW_OPT_HS ECU_ADDRESS 0xd0006cbc FORMAT "%6.1" /end MEASUREMENT
/begin MEASUREMENT Zw_soll_hs "Sollzündwinkel (homogen-schicht)" SWORD _CNV_R_R_Def_zw_sw__599_CM 1 100. -50. 60. DISPLAY_IDENTIFIER ZW_SOLL_HS ECU_ADDRESS 0xd0006c88 FORMAT "%6.1" ARRAY_SIZE 6 MATRIX_DIM 6 1 1 /end MEASUREMENT
/begin MEASUREMENT Zw_soll_s "Sollzündwinkel (schicht)" SWORD _CNV_R_R_Def_zw_sw__599_CM 1 100. -50. 60. DISPLAY_IDENTIFIER ZW_SOLL_S ECU_ADDRESS 0xd0006c7c FORMAT "%6.1" ARRAY_SIZE 6 MATRIX_DIM 6 1 1 /end MEASUREMENT
/begin MEASUREMENT Zw_sollm_hs "gemittelter Zündwinkel (homogen-schicht)" SWORD _CNV_R_R_Def_zw_sw__599_CM 1 100. -50. 60. DISPLAY_IDENTIFIER ZW_SOLLM_HS ECU_ADDRESS 0xd0006cc0 FORMAT "%6.1" /end MEASUREMENT
/begin MEASUREMENT kvaverbr_help "" SLONG _CNV_R_R_Def_dez_sl_575_CM 1 100. -2147483648. 2147483647. DISPLAY_IDENTIFIER KVAVERBR_HELP ECU_ADDRESS 0xc00050c6 FORMAT "%7.0" /end MEASUREMENT
/begin CHARACTERISTIC CW_BNSUMAX "Freischatung Berücksichtigung Bordnetzstabilität" VALUE 0xa101753c _REC_VAL_20_u1 99.45 _CNV_R_R_Def_dez_sl_575_CM 0. 255. FORMAT "%3.0" /end CHARACTERISTIC
/begin CHARACTERISTIC CW_GENOFFSLP "Codewort zum Sperren Eingriff Sekundärluftpumpe" VALUE 0xa101753d _REC_VAL_20_u1 1. _CNV_R_R_Def_dez_sl_575_CM 0. 1. FORMAT "%4.1" /end CHARACTERISTIC
/begin CHARACTERISTIC CW_HEIZART "Auswahl Heizleistungsart" VALUE 0xa100e4d0 _REC_VAL_20_u1 99.45 _CNV_R_R_Def_dez_sl_575_CM 0. 255. FORMAT "%3.0" /end CHARACTERISTIC
/begin CHARACTERISTIC KF_DTES12_S "" MAP 0xa10143a4 _REC_MAP_52_UBYTE_s2_s2_s2 99.61320000000001 _CNV_R_R_Def_td_sw__619_CM -131.072 131.068
 /begin AXIS_DESCR STD_AXIS Nkw _CNV_R_R_Def_n_sw_q_612_CM 6 -32768. 32767. FORMAT "%5.0" /end AXIS_DESCR
 /begin AXIS_DESCR STD_AXIS Drfopt_s _CNV_R_R_Def_eta_sw_617_CM 4 -200. 199.9938 /end AXIS_DESCR
/end CHARACTERISTIC
/begin CHARACTERISTIC KF_DWESB1TM_H "" MAP 0xa10143ec _REC_MAP_52_UBYTE_s2_s2_s2 107.518355 _CNV_R_R_Def_kw_sw__622_CM -768. 767.9765
 /begin AXIS_DESCR STD_AXIS Tmot _CNV_R_R_Def_t_sw_q_620_CM 10 -327.68 327.67 FORMAT "%5.2" /end AXIS_DESCR
 /begin AXIS_DESCR STD_AXIS Rk_sollm_h _CNV_R_R_Def_rk_sw__697_CM 12 -1600. 1599.9511 /end AXIS_DESCR
/end CHARACTERISTIC
/begin CHARACTERISTIC KF_DWESE2TM_H "" MAP 0xa101450c _REC_MAP_52_UBYTE_s2_s2_s2 107.518355 _CNV_R_R_Def_kw_sw__622_CM -768. 767.9765
 /begin AXIS_DESCR STD_AXIS Tmot _CNV_R_R_Def_t_sw_q_620_CM 10 -327.68 327.67 FORMAT "%5.2" /end AXIS_DESCR
 /begin AXIS_DESCR STD_AXIS Rk_sollm_h _CNV_R_R_Def_rk_sw__697_CM 12 -1600. 1599.9511 /end AXIS_DESCR
/end CHARACTERISTIC
/begin CHARACTERISTIC KF_DWESE2_H "(homogen)" MAP 0xa1014164 _REC_MAP_52_UBYTE_s2_s2_s2 107.518355 _CNV_R_R_Def_kw_sw__622_CM -768. 767.9765
 /begin AXIS_DESCR STD_AXIS Nkw _CNV_R_R_Def_n_sw_q_612_CM 10 -32768. 32767. FORMAT "%5.0" /end AXIS_DESCR
 /begin AXIS_DESCR STD_AXIS Rk_sollm_h _CNV_R_R_Def_rk_sw__697_CM 12 -1600. 1599.9511 /end AXIS_DESCR
/end CHARACTERISTIC
/begin CHARACTERISTIC KF_DWESEST_H "(homogen)" MAP 0xa1014284 _REC_MAP_52_UBYTE_s2_s2_s2 107.518355 _CNV_R_R_Def_kw_sw__622_CM -768. 767.9765
 /begin AXIS_DESCR STD_AXIS Nkw _CNV_R_R_Def_n_sw_q_612_CM 10 -32768. 32767. FORMAT "%5.0" /end AXIS_DESCR
 /begin AXIS_DESCR STD_AXIS Tmot _CNV_R_R_Def_t_sw_q_620_CM 12 -327.68 327.67 FORMAT "%5.2" /end AXIS_DESCR
/end CHARACTERISTIC
/begin CHARACTERISTIC KF_DWESE_HS "Deltawinkel auf Zündwinkel für Haupteinspritzung DI (homogen-schicht)" MAP 0xa101373c _REC_MAP_52_UBYTE_s2_s2_s2 107.518355 _CNV_R_R_Def_kw_sw__622_CM -768. 767.9765
 /begin AXIS_DESCR STD_AXIS Nkw _CNV_R_R_Def_n_sw_q_612_CM 16 -32768. 32767. FORMAT "%5.0" /end AXIS_DESCR
 /begin AXIS_DESCR STD_AXIS Rk_soll_s _CNV_R_R_Def_rk_sw__697_CM 16 -1600. 1599.9511 /end AXIS_DESCR
/end CHARACTERISTIC
/begin CHARACTERISTIC KF_DWESE_S "Deltawinkel auf Zündwinkel für Haupteinspritzung DI (schicht)" MAP 0xa10134f8 _REC_MAP_52_UBYTE_s2_s2_s2 107.518355 _CNV_R_R_Def_kw_sw__622_CM -768. 767.9765
 /begin AXIS_DESCR STD_AXIS Nkw _CNV_R_R_Def_n_sw_q_612_CM 16 -32768. 32767. FORMAT "%5.0" /end AXIS_DESCR
 /begin AXIS_DESCR STD_AXIS Rk_soll_s _CNV_R_R_Def_rk_sw__697_CM 16 -1600. 1599.9511 /end AXIS_DESCR
/end CHARACTERISTIC
/begin CHARACTERISTIC KF_DZWAGR_S "Kennfeld Deltazündwinkel AGR (schicht)" MAP 0xa1011108 _REC_MAP_52_UBYTE_s2_s2_u2 100.1 _CNV_R_R_Def_zw_sw__599_CM -50. 60. FORMAT "%4.1"
 /begin AXIS_DESCR STD_AXIS Nkw _CNV_R_R_Def_n_sw_q_612_CM 8 -32768. 32767. FORMAT "%5.0" /end AXIS_DESCR
 /begin AXIS_DESCR STD_AXIS Agr_rate _CNV_R_R_Def_f_uw_b_591_CM 6 0. 0.9999 FORMAT "%14.5" /end AXIS_DESCR
/end CHARACTERISTIC
/begin CHARACTERISTIC KF_DZWRF_S "Kennfeld Deltazündwinkel (schicht)" MAP 0xa10110c0 _REC_MAP_52_UBYTE_s2_s2_s2 100.1 _CNV_R_R_Def_zw_sw__599_CM -50. 60. FORMAT "%4.1"
 /begin AXIS_DESCR STD_AXIS Nkw _CNV_R_R_Def_n_sw_q_612_CM 6 -32768. 32767. FORMAT "%5.0" /end AXIS_DESCR
 /begin AXIS_DESCR STD_AXIS Drfopt_s _CNV_R_R_Def_eta_sw_617_CM 4 -200. 199.9938 /end AXIS_DESCR
/end CHARACTERISTIC
/begin CHARACTERISTIC KF_EWPFCL_DI "" MAP 0xa100e35c _REC_MAP_52_u1_s2_s2 0.996 _CNV_R_R_Def_f_ub_b_573_CM 0. 0.996
 /begin AXIS_DESCR STD_AXIS Nkw _CNV_R_R_Def_n_sw_q_612_CM 8 -32768. 32767. FORMAT "%5.0" /end AXIS_DESCR
 /begin AXIS_DESCR STD_AXIS Mdk_ewp _CNV_R_R_Def_m_sw_q_574_CM 6 -3276.8 3276.7 FORMAT "%5.2" /end AXIS_DESCR
/end CHARACTERISTIC
/begin CHARACTERISTIC KF_EWPFCOOL "Wärmebilanzkennfeld" MAP 0xa100e3ac _REC_MAP_52_u1_s2_s2 0.996 _CNV_R_R_Def_f_ub_b_573_CM 0. 0.996
 /begin AXIS_DESCR STD_AXIS Nkw _CNV_R_R_Def_n_sw_q_612_CM 8 -32768. 32767. FORMAT "%5.0" /end AXIS_DESCR
 /begin AXIS_DESCR STD_AXIS Mdk_ewp _CNV_R_R_Def_m_sw_q_574_CM 6 -3276.8 3276.7 FORMAT "%5.2" /end AXIS_DESCR
/end CHARACTERISTIC
/begin CHARACTERISTIC KF_FULVPUMP "Wichtung  Pumpeingiff durch ULV" MAP 0xa100c6c8 _REC_MAP_52_u1_u2_u2 0.996 _CNV_R_R_Def_f_ub_b_573_CM 0. 0.996
 /begin AXIS_DESCR STD_AXIS Pldr_soll _CNV_R_R_Def_p_sw_q_578_CM 6 0. 2559.9609 FORMAT "%5.2" /end AXIS_DESCR
 /begin AXIS_DESCR STD_AXIS Vsvld_f _CNV_R_R_Def_vs_uw__745_CM 6 0. 1279.9804 FORMAT "%5.2" /end AXIS_DESCR
/end CHARACTERISTIC
/begin CHARACTERISTIC KF_FULVUES "Faktor bei Drucküberschwinger" MAP 0xa100c7ac _REC_MAP_52_UBYTE_u2_u2_u2 1.9999 _CNV_R_R_Def_f_uw_b_579_CM 0. 1.9999 FORMAT "%14.5"
 /begin AXIS_DESCR STD_AXIS Pvdkds _CNV_R_R_Def_p_sw_q_578_CM 8 0. 2559.9609 FORMAT "%5.2" /end AXIS_DESCR
 /begin AXIS_DESCR STD_AXIS Mszyl _CNV_R_R_Def_ms_uw__611_CM 8 0. 2047.9687 /end AXIS_DESCR
/end CHARACTERISTIC
/begin CHARACTERISTIC KF_GBTR "Kennfeld geregelter Betrieb" MAP 0xa100e480 _REC_MAP_52_u1_s2_s2 99.45 _CNV_R_R_Def_dez_sl_575_CM 0. 255. FORMAT "%3.0"
 /begin AXIS_DESCR STD_AXIS Nkw _CNV_R_R_Def_n_sw_q_612_CM 8 -32768. 32767. FORMAT "%5.0" /end AXIS_DESCR
 /begin AXIS_DESCR STD_AXIS Mdk_ewp_help _CNV_R_R_Def_m_sw_q_574_CM 6 -3276.8 3276.7 FORMAT "%5.2" /end AXIS_DESCR
/end CHARACTERISTIC
/begin CHARACTERISTIC KF_IZGRUND "Grundkennfeld für Zündstrom" MAP 0xa100b054 _REC_MAP_52_UBYTE_s2_s2_u2 65.535 _CNV_R_R_Def_i_sw_q_650_CM -32.768 32.767
 /begin AXIS_DESCR STD_AXIS Nkw _CNV_R_R_Def_n_sw_q_612_CM 8 -32768. 32767. FORMAT "%5.0" /end AXIS_DESCR
 /begin AXIS_DESCR STD_AXIS Rk _CNV_R_R_Def_rk_uw__696_CM 8 0. 31.9995 FORMAT "%7.4" /end AXIS_DESCR
/end CHARACTERISTIC
/begin CHARACTERISTIC KF_IZLIMMAX "Maximale rZuendstrom" MAP 0xa100b0f8 _REC_MAP_52_UBYTE_s2_s2_u2 65.535 _CNV_R_R_Def_i_sw_q_650_CM -32.768 32.767
 /begin AXIS_DESCR STD_AXIS Nkw _CNV_R_R_Def_n_sw_q_612_CM 8 -32768. 32767. FORMAT "%5.0" /end AXIS_DESCR
 /begin AXIS_DESCR STD_AXIS Rk _CNV_R_R_Def_rk_uw__696_CM 8 0. 31.9995 FORMAT "%7.4" /end AXIS_DESCR
/end CHARACTERISTIC
/begin CHARACTERISTIC KF_IZLIMMIN "Minimaler Zuendstrom" MAP 0xa100afb0 _REC_MAP_52_UBYTE_s2_s2_u2 65.535 _CNV_R_R_Def_i_sw_q_650_CM -32.768 32.767
 /begin AXIS_DESCR STD_AXIS Nkw _CNV_R_R_Def_n_sw_q_612_CM 8 -32768. 32767. FORMAT "%5.0" /end AXIS_DESCR
 /begin AXIS_DESCR STD_AXIS Rk _CNV_R_R_Def_rk_uw__696_CM 8 0. 31.9995 FORMAT "%7.4" /end AXIS_DESCR
/end CHARACTERISTIC
/begin CHARACTERISTIC KF_KUEHLN "Kennfeld Leistungsreduzierung über hohe Drehzahlen" MAP 0xa100e8d0 _REC_MAP_52_UBYTE_u2_s2_s2 63.99900000000001 _CNV_R_R_Def_f_uw_b_580_CM 0. 63.999 FORMAT "%7.4"
 /begin AXIS_DESCR STD_AXIS Mdk_ewp_help _CNV_R_R_Def_m_sw_q_574_CM 6 -3276.8 3276.7 FORMAT "%5.2" /end AXIS_DESCR
 /begin AXIS_DESCR STD_AXIS Nkw _CNV_R_R_Def_n_sw_q_612_CM 8 -32768. 32767. FORMAT "%5.0" /end AXIS_DESCR
/end CHARACTERISTIC
/begin CHARACTERISTIC KF_KUEHLPIMX "Kennfeld Leistungsreduzierung über Tmot und Töl" MAP 0xa100e76c _REC_MAP_52_UBYTE_u2_s2_s2 102.398435 _CNV_R_R_Def_f_uw_b_630_CM 0. 2047.9687 FORMAT "%5.2"
 /begin AXIS_DESCR STD_AXIS Tmot _CNV_R_R_Def_t_sw_q_620_CM 8 -327.68 327.67 FORMAT "%5.2" /end AXIS_DESCR
 /begin AXIS_DESCR STD_AXIS Toel _CNV_R_R_Def_t_sw_q_618_CM 8 -3276.8 3276.7 FORMAT "%4.1" /end AXIS_DESCR
/end CHARACTERISTIC
/begin CHARACTERISTIC KF_MDRES_WM "Kennfeld Momentenreserve Wärmemanagement" MAP 0xa100e850 _REC_MAP_52_UBYTE_s2_s2_s2 131.07 _CNV_R_R_Def_m_sw_q_574_CM -3276.8 3276.7 FORMAT "%5.2"
 /begin AXIS_DESCR STD_AXIS Nkw _CNV_R_R_Def_n_sw_q_612_CM 8 -32768. 32767. FORMAT "%5.0" /end AXIS_DESCR
 /begin AXIS_DESCR STD_AXIS Mdi_zw_soll _CNV_R_R_Def_m_sw_q_574_CM 6 -3276.8 3276.7 FORMAT "%5.2" /end AXIS_DESCR
/end CHARACTERISTIC
/begin CHARACTERISTIC KF_NLELUEFT "Kennfeld für Elüfter-Sollwerte in Abhängigkeit von Tmot und Tw-r1 (Rohrwandtemp)" MAP 0xa100e9c0 _REC_MAP_52_u1_s2_s2 99.60930000000001 _CNV_R_R_Def_f_ub_b_602_CM 0. 99.60930000000001 FORMAT "%5.2"
 /begin AXIS_DESCR STD_AXIS Tw_r1 _CNV_R_R_Def_t_sw_q_618_CM 4 -3276.8 3276.7 FORMAT "%4.1" /end AXIS_DESCR
 /begin AXIS_DESCR STD_AXIS Tmot _CNV_R_R_Def_t_sw_q_620_CM 3 -327.68 327.67 FORMAT "%5.2" /end AXIS_DESCR
/end CHARACTERISTIC
/begin CHARACTERISTIC KF_TES12_S "Deltazeit zwischen 1. und 2. Einspritzung (schicht)" MAP 0xa1013980 _REC_MAP_52_UBYTE_u2_s2_s2 99.61320000000001 _CNV_R_R_Def_td_sw__619_CM 0. 262.14 FORMAT "%5.2"
 /begin AXIS_DESCR STD_AXIS Nkw _CNV_R_R_Def_n_sw_q_612_CM 16 -32768. 32767. FORMAT "%5.0" /end AXIS_DESCR
 /begin AXIS_DESCR STD_AXIS Rk_soll_s _CNV_R_R_Def_rk_sw__697_CM 16 -1600. 1599.9511 /end AXIS_DESCR
/end CHARACTERISTIC
/begin CHARACTERISTIC KF_TMSTMDRES "Kennfeld für Faktor zum Momentenvorhalt für Heizleistungssteigerung" MAP 0xa100e810 _REC_MAP_52_u1_s2_u2 0.996 _CNV_R_R_Def_f_ub_b_573_CM 0. 0.996
 /begin AXIS_DESCR STD_AXIS Tmot _CNV_R_R_Def_t_sw_q_620_CM 6 -327.68 327.67 FORMAT "%5.2" /end AXIS_DESCR
 /begin AXIS_DESCR STD_AXIS Tn_start_10 _CNV_R_R_Def_td_uw__679_CM 6 0. 655.35 FORMAT "%5.2" /end AXIS_DESCR
/end CHARACTERISTIC
/begin CHARACTERISTIC KF_ULVUES "Offset bei Drucküberschwinger" MAP 0xa100c708 _REC_MAP_52_UBYTE_u2_s2_s2 99.9984 _CNV_R_R_Def_f_uw_b_576_CM 0. 99.9984
 /begin AXIS_DESCR STD_AXIS Pld_diff_fil _CNV_R_R_Def_p_sw_q_614_CM 8 -2560. 2559.9218 FORMAT "%5.2" /end AXIS_DESCR
 /begin AXIS_DESCR STD_AXIS Pld_diff_grd _CNV_R_R_Def_p_sw_q_614_CM 8 -2560. 2559.9218 FORMAT "%5.2" /end AXIS_DESCR
/end CHARACTERISTIC
/begin CHARACTERISTIC KF_ULVVST "ULV - Regler - Vorsteuerung" MAP 0xa100c884 _REC_MAP_52_UBYTE_u2_u2_u2 99.9984 _CNV_R_R_Def_f_uw_b_576_CM 0. 99.9984
 /begin AXIS_DESCR STD_AXIS F_pldsvld_f _CNV_R_R_Def_f_sw_b_608_CM 16 0. 3.9999 FORMAT "%14.5" /end AXIS_DESCR
 /begin AXIS_DESCR STD_AXIS Vsvld_f _CNV_R_R_Def_vs_uw__745_CM 12 0. 1279.9804 FORMAT "%5.2" /end AXIS_DESCR
/end CHARACTERISTIC
/begin CHARACTERISTIC KF_ULVVST_K "ULV - Vorsteuerung - Offset" MAP 0xa100ca40 _REC_MAP_52_UBYTE_s2_u2_u2 99.99844999999999 _CNV_R_R_Def_rel_sw_584_CM -100. 99.9969
 /begin AXIS_DESCR STD_AXIS F_pldsvld_f _CNV_R_R_Def_f_sw_b_608_CM 16 0. 3.9999 FORMAT "%14.5" /end AXIS_DESCR
 /begin AXIS_DESCR STD_AXIS Vsvld_f _CNV_R_R_Def_vs_uw__745_CM 12 0. 1279.9804 FORMAT "%5.2" /end AXIS_DESCR
/end CHARACTERISTIC
/begin CHARACTERISTIC KF_WESB1NL_H "(homogen)" MAP 0xa1013ce4 _REC_MAP_52_UBYTE_s2_s2_s2 107.518355 _CNV_R_R_Def_kw_sw__622_CM -768. 767.9765
 /begin AXIS_DESCR STD_AXIS Nkw _CNV_R_R_Def_n_sw_q_612_CM 10 -32768. 32767. FORMAT "%5.0" /end AXIS_DESCR
 /begin AXIS_DESCR STD_AXIS Rk_sollm_h _CNV_R_R_Def_rk_sw__697_CM 12 -1600. 1599.9511 /end AXIS_DESCR
/end CHARACTERISTIC
/begin CHARACTERISTIC KF_WESB1_H "(homogen)" MAP 0xa1013bc4 _REC_MAP_52_UBYTE_s2_s2_s2 107.518355 _CNV_R_R_Def_kw_sw__622_CM -768. 767.9765
 /begin AXIS_DESCR STD_AXIS Nkw _CNV_R_R_Def_n_sw_q_612_CM 10 -32768. 32767. FORMAT "%5.0" /end AXIS_DESCR
 /begin AXIS_DESCR STD_AXIS Rk_sollm_h _CNV_R_R_Def_rk_sw__697_CM 12 -1600. 1599.9511 /end AXIS_DESCR
/end CHARACTERISTIC
/begin CHARACTERISTIC KF_WESB1_HS "(homogen-schicht)" MAP 0xa1013f24 _REC_MAP_52_UBYTE_s2_s2_s2 107.518355 _CNV_R_R_Def_kw_sw__622_CM -768. 767.9765
 /begin AXIS_DESCR STD_AXIS Nkw _CNV_R_R_Def_n_sw_q_612_CM 10 -32768. 32767. FORMAT "%5.0" /end AXIS_DESCR
 /begin AXIS_DESCR STD_AXIS Rk_soll_h _CNV_R_R_Def_rk_sw__697_CM 12 -1600. 1599.9511 /end AXIS_DESCR
/end CHARACTERISTIC
/begin CHARACTERISTIC KF_WESBST_H "(homogen)" MAP 0xa1014044 _REC_MAP_52_UBYTE_s2_s2_s2 107.518355 _CNV_R_R_Def_kw_sw__622_CM -768. 767.9765
 /begin AXIS_DESCR STD_AXIS Nkw _CNV_R_R_Def_n_sw_q_612_CM 10 -32768. 32767. FORMAT "%5.0" /end AXIS_DESCR
 /begin AXIS_DESCR STD_AXIS Tmot _CNV_R_R_Def_t_sw_q_620_CM 12 -327.68 327.67 FORMAT "%5.2" /end AXIS_DESCR
/end CHARACTERISTIC
/begin CHARACTERISTIC KF_WESE2_H "(homogen)" MAP 0xa1013e04 _REC_MAP_52_UBYTE_s2_s2_s2 107.518355 _CNV_R_R_Def_kw_sw__622_CM -768. 767.9765
 /begin AXIS_DESCR STD_AXIS Nkw _CNV_R_R_Def_n_sw_q_612_CM 10 -32768. 32767. FORMAT "%5.0" /end AXIS_DESCR
 /begin AXIS_DESCR STD_AXIS Rk_sollm_h _CNV_R_R_Def_rk_sw__697_CM 12 -1600. 1599.9511 /end AXIS_DESCR
/end CHARACTERISTIC
/begin CHARACTERISTIC KF_ZESK "Zündendstufenkorrektur" MAP 0xa100af38 _REC_MAP_52_UBYTE_u2_s2_s2 99.198481 _CNV_R_R_Def_u_uw_q_734_CM 0. 319.9951
 /begin AXIS_DESCR STD_AXIS Tmot _CNV_R_R_Def_t_sw_q_620_CM 2 -327.68 327.67 FORMAT "%5.2" /end AXIS_DESCR
 /begin AXIS_DESCR STD_AXIS I_zuend _CNV_R_R_Def_i_sw_q_650_CM 2 -32.768 32.767 /end AXIS_DESCR
/end CHARACTERISTIC
/begin CHARACTERISTIC KF_ZFOFUHOM "Anzahl Folgefunken Homogen" MAP 0xa100af4c _REC_MAP_52_u1_s2_u2 99.45 _CNV_R_R_Def_dez_sl_575_CM 0. 255. FORMAT "%3.0"
 /begin AXIS_DESCR STD_AXIS Nkw _CNV_R_R_Def_n_sw_q_612_CM 8 -32768. 32767. FORMAT "%5.0" /end AXIS_DESCR
 /begin AXIS_DESCR STD_AXIS Rk _CNV_R_R_Def_rk_uw__696_CM 8 0. 31.9995 FORMAT "%7.4" /end AXIS_DESCR
/end CHARACTERISTIC
/begin CHARACTERISTIC KF_ZFOFUSCHI "Anzahl Folgefunken Schicht" MAP 0xa100aed4 _REC_MAP_52_u1_s2_u2 99.45 _CNV_R_R_Def_dez_sl_575_CM 0. 255. FORMAT "%3.0"
 /begin AXIS_DESCR STD_AXIS Nkw _CNV_R_R_Def_n_sw_q_612_CM 8 -32768. 32767. FORMAT "%5.0" /end AXIS_DESCR
 /begin AXIS_DESCR STD_AXIS Rk _CNV_R_R_Def_rk_uw__696_CM 8 0. 31.9995 FORMAT "%7.4" /end AXIS_DESCR
/end CHARACTERISTIC
/begin CHARACTERISTIC KF_ZWBASDOE_HS "Kennfeld Basiszündwinkel (homogen-schicht)" MAP 0xa1010f04 _REC_MAP_52_UBYTE_s2_s2_s2 100.1 _CNV_R_R_Def_zw_sw__599_CM -50. 60. FORMAT "%4.1"
 /begin AXIS_DESCR STD_AXIS Nkw _CNV_R_R_Def_n_sw_q_612_CM 16 -32768. 32767. FORMAT "%5.0" /end AXIS_DESCR
 /begin AXIS_DESCR STD_AXIS Rk_soll_hs _CNV_R_R_Def_rk_sw__697_CM 12 -1600. 1599.9511 /end AXIS_DESCR
/end CHARACTERISTIC
/begin CHARACTERISTIC KF_ZWBASDOE_S "Kennfeld Basiszündwinkel (schicht)" MAP 0xa1010d48 _REC_MAP_52_UBYTE_s2_s2_s2 100.1 _CNV_R_R_Def_zw_sw__599_CM -50. 60. FORMAT "%4.1"
 /begin AXIS_DESCR STD_AXIS Nkw _CNV_R_R_Def_n_sw_q_612_CM 16 -32768. 32767. FORMAT "%5.0" /end AXIS_DESCR
 /begin AXIS_DESCR STD_AXIS Rk_soll_s _CNV_R_R_Def_rk_sw__697_CM 12 -1600. 1599.9511 /end AXIS_DESCR
/end CHARACTERISTIC
/begin CHARACTERISTIC KF_ZWBAS_HS "Kennfeld Basiszündwinkel (homogen-schicht)" MAP 0xa1010814 _REC_MAP_52_UBYTE_s2_s2_s2 100.1 _CNV_R_R_Def_zw_sw__599_CM -50. 60. FORMAT "%4.1"
 /begin AXIS_DESCR STD_AXIS Nkw _CNV_R_R_Def_n_sw_q_612_CM 16 -32768. 32767. FORMAT "%5.0" /end AXIS_DESCR
 /begin AXIS_DESCR STD_AXIS Rk_soll_hs _CNV_R_R_Def_rk_sw__697_CM 12 -1600. 1599.9511 /end AXIS_DESCR
/end CHARACTERISTIC
/begin CHARACTERISTIC KF_ZWBAS_S "Kennfeld Basiszündwinkel (schicht)" MAP 0xa1010658 _REC_MAP_52_UBYTE_s2_s2_s2 100.1 _CNV_R_R_Def_zw_sw__599_CM -50. 60. FORMAT "%4.1"
 /begin AXIS_DESCR STD_AXIS Nkw _CNV_R_R_Def_n_sw_q_612_CM 16 -32768. 32767. FORMAT "%5.0" /end AXIS_DESCR
 /begin AXIS_DESCR STD_AXIS Rk_soll_s _CNV_R_R_Def_rk_sw__697_CM 12 -1600. 1599.9511 /end AXIS_DESCR
/end CHARACTERISTIC
/begin CHARACTERISTIC KF_ZWMIN_HS "Kennfeld minimal möglicher Zündwinkel (homogen-schicht)" MAP 0xa10109d0 _REC_MAP_52_UBYTE_s2_s2_s2 100.1 _CNV_R_R_Def_zw_sw__599_CM -50. 60. FORMAT "%4.1"
 /begin AXIS_DESCR STD_AXIS Nkw _CNV_R_R_Def_n_sw_q_612_CM 16 -32768. 32767. FORMAT "%5.0" /end AXIS_DESCR
 /begin AXIS_DESCR STD_AXIS Rk_soll_hs _CNV_R_R_Def_rk_sw__697_CM 12 -1600. 1599.9511 /end AXIS_DESCR
/end CHARACTERISTIC
/begin CHARACTERISTIC KF_ZWOPT_HS "Kennfeld optimaler Zündwinkel (homogen-schicht)" MAP 0xa1010b8c _REC_MAP_52_UBYTE_s2_s2_s2 100.1 _CNV_R_R_Def_zw_sw__599_CM -50. 60. FORMAT "%4.1"
 /begin AXIS_DESCR STD_AXIS Nkw _CNV_R_R_Def_n_sw_q_612_CM 16 -32768. 32767. FORMAT "%5.0" /end AXIS_DESCR
 /begin AXIS_DESCR STD_AXIS Rk_soll_hs _CNV_R_R_Def_rk_sw__697_CM 12 -1600. 1599.9511 /end AXIS_DESCR
/end CHARACTERISTIC
/begin CHARACTERISTIC KL_BDGRUND "Grundkennfeld für Brenndauer Folgefunken" CURVE 0xa100ae30 _REC_CUR_TKL_UW_VV__u2_s2 65.535 _CNV_R_R_Def_td_uw__592_CM 0. 65.535
 /begin AXIS_DESCR STD_AXIS Nkw _CNV_R_R_Def_n_sw_q_612_CM 8 -32768. 32767. FORMAT "%5.0" /end AXIS_DESCR
/end CHARACTERISTIC
/begin CHARACTERISTIC KL_DWESB1P_H "(homogen)" CURVE 0xa10134b0 _REC_CUR_TKL_UW_VV__s2_u2 107.518355 _CNV_R_R_Def_kw_sw__622_CM -768. 767.9765
 /begin AXIS_DESCR STD_AXIS Prail_ist _CNV_R_R_Def_p_uw_q_685_CM 8 0. 39.9993 FORMAT "%7.4" /end AXIS_DESCR
/end CHARACTERISTIC
/begin CHARACTERISTIC KL_DWESE2P_H "(homogen)" CURVE 0xa10134d4 _REC_CUR_TKL_UW_VV__s2_u2 107.518355 _CNV_R_R_Def_kw_sw__622_CM -768. 767.9765
 /begin AXIS_DESCR STD_AXIS Prail_ist _CNV_R_R_Def_p_uw_q_685_CM 8 0. 39.9993 FORMAT "%7.4" /end AXIS_DESCR
/end CHARACTERISTIC
/begin CHARACTERISTIC KL_EL_TGET "Kennlinie E-Lüftersollwert über Tget" CURVE 0xa100e6dc _REC_CUR_TKL_UW_VV__u1_s2 99.60930000000001 _CNV_R_R_Def_f_ub_b_602_CM 0. 99.60930000000001 FORMAT "%5.2"
 /begin AXIS_DESCR STD_AXIS Tget_wm _CNV_R_R_Def_t_sw_q_620_CM 6 -327.68 327.67 FORMAT "%5.2" /end AXIS_DESCR
/end CHARACTERISTIC
/begin CHARACTERISTIC KL_EL_TKA "Kennlinie E-Lüftersollwert über TKA" CURVE 0xa100e6ac _REC_CUR_TKL_UW_VV__u1_s2 99.60930000000001 _CNV_R_R_Def_f_ub_b_602_CM 0. 99.60930000000001 FORMAT "%5.2"
 /begin AXIS_DESCR STD_AXIS Tka _CNV_R_R_Def_t_sw_q_620_CM 6 -327.68 327.67 FORMAT "%5.2" /end AXIS_DESCR
/end CHARACTERISTIC
/begin CHARACTERISTIC KL_EL_TMOT "Kennlinie Elüfteranforderung über Tmot-Tkwsoll gefiltert" CURVE 0xa100e658 _REC_CUR_TKL_UW_VV__u1_s2 99.60930000000001 _CNV_R_R_Def_f_ub_b_602_CM 0. 99.60930000000001 FORMAT "%5.2"
 /begin AXIS_DESCR STD_AXIS T_eltd_h2 _CNV_R_R_Def_t_sw_q_620_CM 6 -327.68 327.67 FORMAT "%5.2" /end AXIS_DESCR
/end CHARACTERISTIC
/begin CHARACTERISTIC KL_EL_TWR1 "Kennlinie E-Lüftersollwert über Tw_r1 (Krümmertemperatur)" CURVE 0xa100e600 _REC_CUR_TKL_UW_VV__u1_s2 99.60930000000001 _CNV_R_R_Def_f_ub_b_602_CM 0. 99.60930000000001 FORMAT "%5.2"
 /begin AXIS_DESCR STD_AXIS Tw_r1 _CNV_R_R_Def_t_sw_q_618_CM 6 -3276.8 3276.7 FORMAT "%4.1" /end AXIS_DESCR
/end CHARACTERISTIC
/begin CHARACTERISTIC KL_EL_V "Kennlinie E-Lüftersollwert über Fahrgeschwindigkeit" CURVE 0xa100e614 _REC_CUR_TKL_UW_VV__u1_u2 0.996 _CNV_R_R_Def_f_ub_b_573_CM 0. 0.996
 /begin AXIS_DESCR STD_AXIS NO_INPUT_QUANTITY _CNV_R_R_Def_v_uw_q_737_CM 6 0. 360. FORMAT "%5.0" /end AXIS_DESCR
/end CHARACTERISTIC
/begin CHARACTERISTIC KL_ETAZW_HS "Zündwinkelwirkungsgrad (homogen-schicht)" CURVE 0xa101062c _REC_CUR_TKL_UW_VV__u2_s2 99.99845000000002 _CNV_R_R_Def_eta_uw_627_CM 0. 199.9969
 /begin AXIS_DESCR STD_AXIS Dzw_hs _CNV_R_R_Def_zw_sw__599_CM 10 -50. 60. FORMAT "%4.1" /end AXIS_DESCR
/end CHARACTERISTIC
/begin CHARACTERISTIC KL_EWP_VBE "Kennlinie zur Ansteuerung EWP in BA Befüllen / Entlüften" CURVE 0xa100e6f0 _REC_CUR_TKL_UW_VV__u2_u2 99.998474 _CNV_R_R_Def_vs_uw__693_CM 0. 9999.847400000001 FORMAT "%5.2"
 /begin AXIS_DESCR STD_AXIS NO_INPUT_QUANTITY _CNV_R_R_Def_dez_sl_575_CM 30 0. 65535. FORMAT "%5.0" /end AXIS_DESCR
/end CHARACTERISTIC
/begin CHARACTERISTIC KL_EWP_VBSD "Kennlinie zur Umrechung Volumenstrom EWP in BSD" CURVE 0xa100e66c _REC_CUR_TKL_UW_VV__u1_u2 99.45 _CNV_R_R_Def_dez_sl_575_CM 0. 255. FORMAT "%3.0"
 /begin AXIS_DESCR STD_AXIS Vs_ewp_bsd _CNV_R_R_Def_vs_uw__693_CM 4 0. 9999.847400000001 FORMAT "%5.2" /end AXIS_DESCR
/end CHARACTERISTIC
/begin CHARACTERISTIC KL_FEWPW_BA "Kennlinie Übergang EWP, weich" CURVE 0xa100e954 _REC_CUR_TKL_UW_VV__u1_u2 0.996 _CNV_R_R_Def_f_ub_b_573_CM 0. 0.996
 /begin AXIS_DESCR STD_AXIS NO_INPUT_QUANTITY _CNV_R_R_Def_dez_sl_575_CM 10 0. 65535. FORMAT "%5.0" /end AXIS_DESCR
/end CHARACTERISTIC
/begin CHARACTERISTIC KL_FEWP_BA "Kennlinie Übergang EWP, hart" CURVE 0xa100e974 _REC_CUR_TKL_UW_VV__u1_u2 0.996 _CNV_R_R_Def_f_ub_b_573_CM 0. 0.996
 /begin AXIS_DESCR STD_AXIS NO_INPUT_QUANTITY _CNV_R_R_Def_dez_sl_575_CM 4 0. 65535. FORMAT "%5.0" /end AXIS_DESCR
/end CHARACTERISTIC
/begin CHARACTERISTIC KL_FKFTW_BA "Kennlinie Übergang KFT, weich" CURVE 0xa100e994 _REC_CUR_TKL_UW_VV__u1_u2 0.996 _CNV_R_R_Def_f_ub_b_573_CM 0. 0.996
 /begin AXIS_DESCR STD_AXIS NO_INPUT_QUANTITY _CNV_R_R_Def_dez_sl_575_CM 10 0. 65535. FORMAT "%5.0" /end AXIS_DESCR
/end CHARACTERISTIC
/begin CHARACTERISTIC KL_FKFT_BA "Kennlinie Übergang KFT, hart" CURVE 0xa100e984 _REC_CUR_TKL_UW_VV__u1_u2 0.996 _CNV_R_R_Def_f_ub_b_573_CM 0. 0.996
 /begin AXIS_DESCR STD_AXIS NO_INPUT_QUANTITY _CNV_R_R_Def_dez_sl_575_CM 4 0. 65535. FORMAT "%5.0" /end AXIS_DESCR
/end CHARACTERISTIC
/begin CHARACTERISTIC KL_IZGRUND "Grundkennlinie für Zuendstrom" CURVE 0xa100aeb0 _REC_CUR_TKL_UW_VV__s2_s2 65.535 _CNV_R_R_Def_i_sw_q_650_CM -32.768 32.767
 /begin AXIS_DESCR STD_AXIS Nkw _CNV_R_R_Def_n_sw_q_612_CM 8 -32768. 32767. FORMAT "%5.0" /end AXIS_DESCR
/end CHARACTERISTIC
/begin CHARACTERISTIC KL_KFT_HI "Kennlinie KFT-Sollwert über Tumg für BA High" CURVE 0xa100e67c _REC_CUR_TKL_UW_VV__s2_s2 98.30250000000001 _CNV_R_R_Def_t_sw_q_620_CM -327.68 327.67 FORMAT "%5.2"
 /begin AXIS_DESCR STD_AXIS Tumg _CNV_R_R_Def_t_sw_q_618_CM 4 -3276.8 3276.7 FORMAT "%4.1" /end AXIS_DESCR
/end CHARACTERISTIC
/begin CHARACTERISTIC KL_KFT_HK "Kennlinie KFT-Sollwert über Tumg für BA High+KFT" CURVE 0xa100e644 _REC_CUR_TKL_UW_VV__s2_s2 98.30250000000001 _CNV_R_R_Def_t_sw_q_620_CM -327.68 327.67 FORMAT "%5.2"
 /begin AXIS_DESCR STD_AXIS Tumg _CNV_R_R_Def_t_sw_q_618_CM 4 -3276.8 3276.7 FORMAT "%4.1" /end AXIS_DESCR
/end CHARACTERISTIC
/begin CHARACTERISTIC KL_KFT_PLOC "P-Anteil KL fuer Kft_p_loc" CURVE 0xa100e408 _REC_CUR_TKL_UW_VV__u2_s2 63.99900000000001 _CNV_R_R_Def_f_uw_b_580_CM 0. 63.999 FORMAT "%7.4"
 /begin AXIS_DESCR STD_AXIS Dtkwsoll _CNV_R_R_Def_t_sw_q_620_CM 4 -327.68 327.67 FORMAT "%5.2" /end AXIS_DESCR
/end CHARACTERISTIC
/begin CHARACTERISTIC KL_KUEHLGET "Kennlinie zur Leistungsreduzierung über Tget" CURVE 0xa100e690 _REC_CUR_TKL_UW_VV__u2_s2 102.398435 _CNV_R_R_Def_f_uw_b_630_CM 0. 2047.9687 FORMAT "%5.2"
 /begin AXIS_DESCR STD_AXIS Tget_wm _CNV_R_R_Def_t_sw_q_620_CM 6 -327.68 327.67 FORMAT "%5.2" /end AXIS_DESCR
/end CHARACTERISTIC
/begin CHARACTERISTIC KL_LN "LN Berechnung" CURVE 0xa100ae84 _REC_CUR_TKL_UW_VV__u2_u2 1.9999 _CNV_R_R_Def_f_uw_b_579_CM 0. 1.9999 FORMAT "%14.5"
 /begin AXIS_DESCR STD_AXIS NO_INPUT_QUANTITY _CNV_R_R_Def_f_sw_b_608_CM 10 0. 3.9999 FORMAT "%14.5" /end AXIS_DESCR
/end CHARACTERISTIC
/begin CHARACTERISTIC KL_NEL_PWM "Kennline zur Umrechung E-Lüfter Sollwert in PWM" CURVE 0xa100e6c8 _REC_CUR_TKL_UW_VV__u1_u1 99.60930000000001 _CNV_R_R_Def_f_ub_b_602_CM 0. 99.60930000000001 FORMAT "%5.2"
 /begin AXIS_DESCR STD_AXIS Nelueft_local _CNV_R_R_Def_f_ub_b_602_CM 8 0. 99.60930000000001 FORMAT "%5.2" /end AXIS_DESCR
/end CHARACTERISTIC
/begin CHARACTERISTIC KL_QUADRATW "Quadratwurzelberechnung" CURVE 0xa100ae0c _REC_CUR_TKL_UW_VV__u2_u2 99.83844000000001 _CNV_R_R_Def_i_uw_b_760_CM 0. 255.996
 /begin AXIS_DESCR STD_AXIS NO_INPUT_QUANTITY _CNV_R_R_Def_i_uw_b_760_CM 8 0. 255.996 /end AXIS_DESCR
/end CHARACTERISTIC
/begin CHARACTERISTIC KL_SPULR "Zuendspulenwiderstand" CURVE 0xa100ae54 _REC_CUR_TKL_UW_VV__u2_s2 1.9999 _CNV_R_R_Def_r_uw_b_694_CM 0. 1.9999 FORMAT "%5.2"
 /begin AXIS_DESCR STD_AXIS Tmot _CNV_R_R_Def_t_sw_q_620_CM 2 -327.68 327.67 FORMAT "%5.2" /end AXIS_DESCR
/end CHARACTERISTIC
/begin CHARACTERISTIC KL_SZOLD "Altes Schliesszeitkennfeld" CURVE 0xa100ae60 _REC_CUR_TKL_UW_VV__u2_u2 65.535 _CNV_R_R_Def_td_uw__592_CM 0. 65.535
 /begin AXIS_DESCR STD_AXIS Ub _CNV_R_R_Def_u_sb_q_598_CM 8 0. 6173.397 FORMAT "%4.1" /end AXIS_DESCR
/end CHARACTERISTIC
/begin CHARACTERISTIC KL_TGMDKLIMA "Kennline max. Moment Klimakompressor über Tget" CURVE 0xa100e628 _REC_CUR_TKL_UW_VV__s2_s2 131.07 _CNV_R_R_Def_m_sw_q_574_CM -3276.8 3276.7 FORMAT "%5.2"
 /begin AXIS_DESCR STD_AXIS Tget_wm _CNV_R_R_Def_t_sw_q_620_CM 6 -327.68 327.67 FORMAT "%5.2" /end AXIS_DESCR
/end CHARACTERISTIC
/begin CHARACTERISTIC KL_TMMDKLIMA "Kennlinie max. Moment Klimakompressor über Tmot" CURVE 0xa100e5e4 _REC_CUR_TKL_UW_VV__s2_s2 131.07 _CNV_R_R_Def_m_sw_q_574_CM -3276.8 3276.7 FORMAT "%5.2"
 /begin AXIS_DESCR STD_AXIS Tmot _CNV_R_R_Def_t_sw_q_620_CM 6 -327.68 327.67 FORMAT "%5.2" /end AXIS_DESCR
/end CHARACTERISTIC
/begin CHARACTERISTIC KL_TMQSANF "Kennlinie Wärmestromanforderung über Tmot" CURVE 0xa100e6c0 _REC_CUR_TKL_UW_VV__u1_s2 0.996 _CNV_R_R_Def_f_ub_b_573_CM 0. 0.996
 /begin AXIS_DESCR STD_AXIS NO_INPUT_QUANTITY _CNV_R_R_Def_t_sw_q_620_CM 2 -327.68 327.67 FORMAT "%5.2" /end AXIS_DESCR
/end CHARACTERISTIC
/begin CHARACTERISTIC KL_TOMDKLIMA "Kennlinie max. Moment Klimakompressor über Toel" CURVE 0xa100e5c8 _REC_CUR_TKL_UW_VV__s2_s2 131.07 _CNV_R_R_Def_m_sw_q_574_CM -3276.8 3276.7 FORMAT "%5.2"
 /begin AXIS_DESCR STD_AXIS Toel _CNV_R_R_Def_t_sw_q_618_CM 6 -3276.8 3276.7 FORMAT "%4.1" /end AXIS_DESCR
/end CHARACTERISTIC
/begin CHARACTERISTIC KL_TVULV_DN "Ansteuerung ULV - schliessende Richtung" CURVE 0xa100c680 _REC_CUR_TKL_UW_VV__u2_u2 99.9984 _CNV_R_R_Def_f_uw_b_576_CM 0. 99.9984 /begin AXIS_DESCR STD_AXIS Ulvr _CNV_R_R_Def_f_uw_b_576_CM 8 0. 99.9984 /end AXIS_DESCR /end CHARACTERISTIC
/begin CHARACTERISTIC KL_TVULV_UP "Ansteuerung ULV - öffnende Richtung" CURVE 0xa100c6a4 _REC_CUR_TKL_UW_VV__u2_u2 99.9984 _CNV_R_R_Def_f_uw_b_576_CM 0. 99.9984 /begin AXIS_DESCR STD_AXIS Ulvr _CNV_R_R_Def_f_uw_b_576_CM 8 0. 99.9984 /end AXIS_DESCR /end CHARACTERISTIC
/begin CHARACTERISTIC KL_UBW_ULOFFSET "Offset für Limit für langsame Mittelung der Bordnetzspannung" CURVE 0xa1017c8c _REC_CUR_TKL_UW_VV__u1_u2 24.0112 _CNV_R_R_Def_u_sb_q_598_CM 0. 24.0112 FORMAT "%7.4" /begin AXIS_DESCR STD_AXIS U_fgen _CNV_R_R_Def_u_uw_q_731_CM 3 0. 6553.5 /end AXIS_DESCR /end CHARACTERISTIC
/begin CHARACTERISTIC KL_UBW_USOFFSET "Offset für Limit für schnelle Mittelung der Bordnetzspannung" CURVE 0xa1017c98 _REC_CUR_TKL_UW_VV__u1_u2 24.0112 _CNV_R_R_Def_u_sb_q_598_CM 0. 24.0112 FORMAT "%7.4" /begin AXIS_DESCR STD_AXIS U_fgen _CNV_R_R_Def_u_uw_q_731_CM 5 0. 6553.5 /end AXIS_DESCR /end CHARACTERISTIC
/begin CHARACTERISTIC KL_ULVDYN "ULV - Ansteuerung bei Lastdynamik" CURVE 0xa100c65c _REC_CUR_TKL_UW_VV__u2_u2 99.9984 _CNV_R_R_Def_f_uw_b_576_CM 0. 99.9984
 /begin AXIS_DESCR STD_AXIS Vsvld_f _CNV_R_R_Def_vs_uw__745_CM 8 0. 1279.9804 FORMAT "%5.2" /end AXIS_DESCR
/end CHARACTERISTIC
/begin CHARACTERISTIC KL_ULVVST_P "ULV - Vorsteuerung - Druckkorrektur" CURVE 0xa100c870 _REC_CUR_TKL_UW_VV__u1_u2 1.9921 _CNV_R_R_Def_f_ub_b_625_CM 0. 1.9921
 /begin AXIS_DESCR STD_AXIS Pu _CNV_R_R_Def_p_sw_q_578_CM 6 0. 2559.9609 FORMAT "%5.2" /end AXIS_DESCR
/end CHARACTERISTIC
/begin CHARACTERISTIC KL_ULVVST_T "ULV - Vortseuerung - Temperaturkorrektur" CURVE 0xa100c854 _REC_CUR_TKL_UW_VV__u1_s2 1.9921 _CNV_R_R_Def_f_ub_b_625_CM 0. 1.9921
 /begin AXIS_DESCR STD_AXIS Tvld _CNV_R_R_Def_t_sw_q_618_CM 8 -3276.8 3276.7 FORMAT "%4.1" /end AXIS_DESCR
/end CHARACTERISTIC
/begin CHARACTERISTIC KL_VTANS "KL für Schwell Tans zur Umschaltung in BA-HK" CURVE 0xa100e464 _REC_CUR_TKL_UW_VV__s2_u2 131.07 _CNV_R_R_Def_t_sw_q_618_CM -3276.8 3276.7 FORMAT "%4.1"
 /begin AXIS_DESCR STD_AXIS NO_INPUT_QUANTITY _CNV_R_R_Def_v_uw_q_737_CM 6 0. 360. FORMAT "%5.0" /end AXIS_DESCR
/end CHARACTERISTIC
/begin CHARACTERISTIC KL_WESNESPR "Kennlinie Winkel Einlaß schließt ahängig vom Hub" CURVE 0xa101ffbc _REC_CUR_TKL_UW_VV__s2_u2 107.518355 _CNV_R_R_Def_kw_sw__622_CM -768. 767.9765 /begin AXIS_DESCR STD_AXIS Hubev_soll _CNV_R_R_Def_hub_uw_605_CM 8 0. 65.535 /end AXIS_DESCR /end CHARACTERISTIC
/begin CHARACTERISTIC K_APP_UGEN "Umschaltung auf manuelle Generatorspannungsvorgabe" VALUE 0xa101753e _REC_VAL_20_u1 99.45 _CNV_R_R_Def_dez_sl_575_CM 0. 255. FORMAT "%3.0" /end CHARACTERISTIC
/begin CHARACTERISTIC K_BA_WMAPPL "Auswahl Betriebsart Wärmemanagement" VALUE 0xa100e454 _REC_VAL_20_u1 3.9 _CNV_S_11_Def_ba_wm_590_CM 0. 10. BIT_MASK 0xFF /end CHARACTERISTIC
/begin CHARACTERISTIC K_BDFFMAX "Maximale Brenndauer Folgefunken" VALUE 0xa100adfe _REC_VAL_20_u2 65.535 _CNV_R_R_Def_td_uw__592_CM 0. 65.535 /end CHARACTERISTIC
/begin CHARACTERISTIC K_BDFFMIN "Minimale Brenndauer Folgefunken" VALUE 0xa100ae00 _REC_VAL_20_u2 65.535 _CNV_R_R_Def_td_uw__592_CM 0. 65.535 /end CHARACTERISTIC
/begin CHARACTERISTIC K_BEQSANFMN "Schwelle für Qs_anf_klima BA-Befüllen/Entlüften" VALUE 0xa100e455 _REC_VAL_20_u1 99.60930000000001 _CNV_R_R_Def_f_ub_b_602_CM 0. 99.60930000000001 FORMAT "%5.2" /end CHARACTERISTIC
/begin CHARACTERISTIC K_BEZAEHLUG "Inkrement für Zähler Laufzeit Befüllen/Entlüften" VALUE 0xa100e4fa _REC_VAL_20_u2 0. _CNV_R_R_Def_dez_sl_575_CM 0. 65535. FORMAT "%5.0" /end CHARACTERISTIC
/begin CHARACTERISTIC K_BHZ_AP "Applikationskonstante für Heizleistungsbit (N4x)" VALUE 0xa100e516 _REC_VAL_20_u1 1. _CNV_R_R_Def_dez_sl_575_CM 0. 1. FORMAT "%4.1" /end CHARACTERISTIC
/begin CHARACTERISTIC K_BLKLPS_AP "Applikationskonstante für Luftklappe auf (True, 1)" VALUE 0xa100e517 _REC_VAL_20_u1 1. _CNV_R_R_Def_dez_sl_575_CM 0. 1. FORMAT "%4.1" /end CHARACTERISTIC
/begin CHARACTERISTIC K_DWESE2APP_H "" VALUE 0xa10134a8 _REC_VAL_20_s2 107.518355 _CNV_R_R_Def_kw_sw__622_CM -768. 767.9765 /end CHARACTERISTIC
/begin CHARACTERISTIC K_DWESEAPP_HS "Deltazündwinkel auf Zündwinkel Applikationswert (homogen-schicht)" VALUE 0xa10134a0 _REC_VAL_20_s2 107.518355 _CNV_R_R_Def_kw_sw__622_CM -768. 767.9765 /end CHARACTERISTIC
/begin CHARACTERISTIC K_DWESEAPP_S "Deltazündwinkel auf Zündwinkel Applikationswert (schicht)" VALUE 0xa101349e _REC_VAL_20_s2 107.518355 _CNV_R_R_Def_kw_sw__622_CM -768. 767.9765 /end CHARACTERISTIC
/begin CHARACTERISTIC K_DZW_HS "Deltazündwinkel (homogen-schicht)" VALUE 0xa1010624 _REC_VAL_20_s2 100.1 _CNV_R_R_Def_zw_sw__599_CM -50. 60. FORMAT "%4.1" /end CHARACTERISTIC
/begin CHARACTERISTIC K_DZW_S "Deltazündwinkel (schicht)" VALUE 0xa1010622 _REC_VAL_20_s2 100.1 _CNV_R_R_Def_zw_sw__599_CM -50. 60. FORMAT "%4.1" /end CHARACTERISTIC
/begin CHARACTERISTIC K_EL_ECO "Faktor für Elüfter BA-ECO" VALUE 0xa100e518 _REC_VAL_20_u1 7.9687 _CNV_R_R_Def_f_ub_b_753_CM 0. 7.9687 FORMAT "%5.2" /end CHARACTERISTIC
/begin CHARACTERISTIC K_EL_HI "Faktor für Elüfter BA-HIGH" VALUE 0xa100e519 _REC_VAL_20_u1 7.9687 _CNV_R_R_Def_f_ub_b_753_CM 0. 7.9687 FORMAT "%5.2" /end CHARACTERISTIC
/begin CHARACTERISTIC K_EL_HK "Faktor für Elüfter BA-HIGH+KFT" VALUE 0xa100e51a _REC_VAL_20_u1 7.9687 _CNV_R_R_Def_f_ub_b_753_CM 0. 7.9687 FORMAT "%5.2" /end CHARACTERISTIC
/begin CHARACTERISTIC K_EL_KHL1 "E-Lüfter Sollwert bei EGS-Kühlstufe 1" VALUE 0xa100e51b _REC_VAL_20_u1 99.60930000000001 _CNV_R_R_Def_f_ub_b_602_CM 0. 99.60930000000001 FORMAT "%5.2" /end CHARACTERISTIC
/begin CHARACTERISTIC K_EL_NO "Faktor für Elüfter BA-Normal" VALUE 0xa100e51c _REC_VAL_20_u1 7.9687 _CNV_R_R_Def_f_ub_b_753_CM 0. 7.9687 FORMAT "%5.2" /end CHARACTERISTIC
/begin CHARACTERISTIC K_EL_TDLP "Faktor für Tiefpassfilter E-Lüfter Berechnung" VALUE 0xa100e4fc _REC_VAL_20_u2 131.07 _CNV_R_R_Def_td_uw__726_CM 0. 13107. FORMAT "%4.1" /end CHARACTERISTIC
/begin CHARACTERISTIC K_ENGENTOGGL "Freigabe Generatortoggeln" VALUE 0xa101753f _REC_VAL_20_u1 1. _CNV_R_R_Def_dez_sl_575_CM 0. 1. FORMAT "%4.1" /end CHARACTERISTIC
/begin CHARACTERISTIC K_ETA_EWPGETR "" VALUE 0xa100e358 _REC_VAL_20_u1 0.996 _CNV_R_R_Def_f_ub_b_573_CM 0. 0.996 /end CHARACTERISTIC
/begin CHARACTERISTIC K_ETA_MIN "minimales ETA zur Absicherung Momentenberechnung" VALUE 0xa100adea _REC_VAL_20_s2 100. _CNV_R_R_Def_eta_sw_628_CM 0. 100. /end CHARACTERISTIC
/begin CHARACTERISTIC K_EWPACMX "Maximaler wert für Aufsummierte Kraftstoffmenge" VALUE 0xa100e446 _REC_VAL_20_u2 89.998626 _CNV_R_R_Def_f_uw_b_739_CM 0. 2999.9542 FORMAT "%5.2" /end CHARACTERISTIC
/begin CHARACTERISTIC K_EWPNLTM1 "Tmotschwelle1 für EWAPU Ansteuerung im Nachaluf" VALUE 0xa100e9b4 _REC_VAL_20_s2 98.30250000000001 _CNV_R_R_Def_t_sw_q_620_CM -327.68 327.67 FORMAT "%5.2" /end CHARACTERISTIC
/begin CHARACTERISTIC K_EWPNLTM2 "Tmotschwelle2 für EWAPU Ansteuerung im Nachaluf" VALUE 0xa100e9b6 _REC_VAL_20_s2 98.30250000000001 _CNV_R_R_Def_t_sw_q_620_CM -327.68 327.67 FORMAT "%5.2" /end CHARACTERISTIC
/begin CHARACTERISTIC K_EWPTMST "Schwelle Tmot_start für EWAPU Ansteuerung mit K_EWP_MN1" VALUE 0xa100e4d2 _REC_VAL_20_s2 98.30250000000001 _CNV_R_R_Def_t_sw_q_620_CM -327.68 327.67 FORMAT "%5.2" /end CHARACTERISTIC
/begin CHARACTERISTIC K_EWPTUST "Schwelle Tumg für EWAPU Ansteuerung mit K_EWP_MN1" VALUE 0xa100e4d4 _REC_VAL_20_s2 131.07 _CNV_R_R_Def_t_sw_q_618_CM -3276.8 3276.7 FORMAT "%4.1" /end CHARACTERISTIC
/begin CHARACTERISTIC K_EWPTWAlMX "Temperaturschwelle für Ende Warmlauf" VALUE 0xa100e41c _REC_VAL_20_s2 98.30250000000001 _CNV_R_R_Def_t_sw_q_620_CM -327.68 327.67 DISPLAY_IDENTIFIER K_EWPTWALMX FORMAT "%5.2" /end CHARACTERISTIC
/begin CHARACTERISTIC K_EWPWACAL "Kalibrierfaktor für Verbrauchsziel-Berechnung" VALUE 0xa100e41e _REC_VAL_20_s2 98.30250000000001 _CNV_R_R_Def_t_sw_q_620_CM -327.68 327.67 FORMAT "%5.2" /end CHARACTERISTIC
/begin CHARACTERISTIC K_EWPWAKOR "Korrekturfaktor für Verbrauchszielberechnung" VALUE 0xa100e456 _REC_VAL_20_u1 0.9335 _CNV_R_R_Def_f_ub_b_573_CM 6.25e-002 0.996 /end CHARACTERISTIC
/begin CHARACTERISTIC K_EWPWA_B "Temperatur-Wert für Verbrauchszielberechnung" VALUE 0xa100e420 _REC_VAL_20_s2 98.30250000000001 _CNV_R_R_Def_t_sw_q_620_CM -327.68 327.67 FORMAT "%5.2" /end CHARACTERISTIC
/begin CHARACTERISTIC K_EWP_AP "Volumenstromanforderung EWP BA Applikation" VALUE 0xa100e4fe _REC_VAL_20_u2 99.998474 _CNV_R_R_Def_vs_uw__693_CM 0. 9999.847400000001 FORMAT "%5.2" /end CHARACTERISTIC
/begin CHARACTERISTIC K_EWP_CALV "Faktor für Volumenstromberechnung" VALUE 0xa100e359 _REC_VAL_20_u1 15.9375 _CNV_R_R_Def_f_ub_b_754_CM 0. 15.9375 FORMAT "%5.2" /end CHARACTERISTIC
/begin CHARACTERISTIC K_EWP_EC "Faktor für ECO-Volumenstromberechnung" VALUE 0xa100e500 _REC_VAL_20_u2 99.9984 _CNV_R_R_Def_f_uw_b_576_CM 0. 99.9984 /end CHARACTERISTIC
/begin CHARACTERISTIC K_EWP_HI "Faktor für High-Volumenstromberechnung" VALUE 0xa100e502 _REC_VAL_20_u2 99.9984 _CNV_R_R_Def_f_uw_b_576_CM 0. 99.9984 /end CHARACTERISTIC
/begin CHARACTERISTIC K_EWP_HK "Faktor für High+Kft Volumenstromberechnung" VALUE 0xa100e504 _REC_VAL_20_u2 99.9984 _CNV_R_R_Def_f_uw_b_576_CM 0. 99.9984 /end CHARACTERISTIC
/begin CHARACTERISTIC K_EWP_MDKMN "Schwelle Moment für Umschaltung schnelle EWP-Ansteuerung" VALUE 0xa100e4d6 _REC_VAL_20_s2 131.07 _CNV_R_R_Def_m_sw_q_574_CM -3276.8 3276.7 FORMAT "%5.2" /end CHARACTERISTIC
/begin CHARACTERISTIC K_EWP_MN "Minimalvolumenstrom bei verbrauchsberechneter Größe" VALUE 0xa100e354 _REC_VAL_20_u2 99.998474 _CNV_R_R_Def_vs_uw__693_CM 0. 9999.847400000001 FORMAT "%5.2" /end CHARACTERISTIC
/begin CHARACTERISTIC K_EWP_MN1 "Mindestvolumenstrom EWP bei Motorstart unter Schwelltemperatur K_EWPTMST" VALUE 0xa100e506 _REC_VAL_20_u2 99.998474 _CNV_R_R_Def_vs_uw__693_CM 0. 9999.847400000001 FORMAT "%5.2" /end CHARACTERISTIC
/begin CHARACTERISTIC K_EWP_MX "Maximaler Volumenstrom bei verbrauchsberechneter Größe" VALUE 0xa100e356 _REC_VAL_20_u2 99.998474 _CNV_R_R_Def_vs_uw__693_CM 0. 9999.847400000001 FORMAT "%5.2" /end CHARACTERISTIC
/begin CHARACTERISTIC K_EWP_NO "Faktor für Normal-Volumenstromberechnung" VALUE 0xa100e508 _REC_VAL_20_u2 99.9984 _CNV_R_R_Def_f_uw_b_576_CM 0. 99.9984 /end CHARACTERISTIC
/begin CHARACTERISTIC K_EWP_PE "Leistungsschwelle zum Abbruch BA-Warmlauf" VALUE 0xa100e448 _REC_VAL_20_u2 99.99847 _CNV_R_R_Def_pe_uw__687_CM 0. 999.9847 /end CHARACTERISTIC
/begin CHARACTERISTIC K_EWP_QS "Wärmstromanforderungs Schwelle für verzögerten Warmlaufabbruch " VALUE 0xa100e457 _REC_VAL_20_u1 99.60930000000001 _CNV_R_R_Def_f_ub_b_602_CM 0. 99.60930000000001 FORMAT "%5.2" /end CHARACTERISTIC
/begin CHARACTERISTIC K_EWP_TDMD "Zeitkonstante für Erkennung Vollastanforderung" VALUE 0xa100e50a _REC_VAL_20_u2 131.07 _CNV_R_R_Def_td_uw__726_CM 0. 13107. FORMAT "%4.1" /end CHARACTERISTIC
/begin CHARACTERISTIC K_EWP_TDPE "Zeitverzögerung für Abbruch BA-Warmlauf" VALUE 0xa100e44a _REC_VAL_20_u2 131.07 _CNV_R_R_Def_td_uw__726_CM 0. 13107. FORMAT "%4.1" /end CHARACTERISTIC
/begin CHARACTERISTIC K_EWP_TDQS "Zeit für Verzögerung Wärmstrom Abbruchanforderung" VALUE 0xa100e44c _REC_VAL_20_u2 51. _CNV_R_R_Def_td_uw__726_CM 0. 51. FORMAT "%4.1" /end CHARACTERISTIC
/begin CHARACTERISTIC K_EWP_WA "Anforderung Volumenstrom BA Warmlauf" VALUE 0xa100e50c _REC_VAL_20_u2 99.998474 _CNV_R_R_Def_vs_uw__693_CM 0. 9999.847400000001 FORMAT "%5.2" /end CHARACTERISTIC
/begin CHARACTERISTIC K_FAK_MX "Schwelle für Faktor Bitumschaltung" VALUE 0xa100e51d _REC_VAL_20_u1 0.996 _CNV_R_R_Def_f_ub_b_573_CM 0. 0.996 /end CHARACTERISTIC
/begin CHARACTERISTIC K_FKTVULVP "Filterkonstante f. Abschwächung des Pumpeingriffes" VALUE 0xa100c650 _REC_VAL_20_u2 0.9999847412109381 _CNV_R_R_Def_f_uw_b_591_CM 0. 0.9999847412109381 FORMAT "%14.5" /end CHARACTERISTIC
/begin CHARACTERISTIC K_FSICHER_MAN "Überblendfaktor VVT sicher für Applikation" VALUE 0xa100ade4 _REC_VAL_20_u1 0.996 _CNV_R_R_Def_f_ub_b_573_CM 0. 0.996 /end CHARACTERISTIC
/begin CHARACTERISTIC K_FV_EWPGETR "Kalibrierfaktor für Volumenstromberechnung Automatikgetriebe" VALUE 0xa100e35a _REC_VAL_20_u1 0.498 _CNV_R_R_Def_f_ub_b_609_CM 0. 0.498 /end CHARACTERISTIC
/begin CHARACTERISTIC K_F_EWPTDLP1 "Filterkonstante EWP niedrige Last" VALUE 0xa100e50e _REC_VAL_20_u2 131.07 _CNV_R_R_Def_td_uw__726_CM 0. 13107. FORMAT "%4.1" /end CHARACTERISTIC
/begin CHARACTERISTIC K_F_EWPTDLP2 "Filterkonstante EWP hohe Last" VALUE 0xa100e510 _REC_VAL_20_u2 131.07 _CNV_R_R_Def_td_uw__726_CM 0. 13107. FORMAT "%4.1" /end CHARACTERISTIC
/begin CHARACTERISTIC K_F_QSANF "Faktor zur Umrechnung Qs_anf_klima % in l/h für EWAPU" VALUE 0xa100e51e _REC_VAL_20_u1 99.45 _CNV_R_R_Def_dez_ub_667_CM 0. 127.5 /end CHARACTERISTIC
/begin CHARACTERISTIC K_F_QSANFAUT "Faktor zur Umrechnung Qs_anf_klima % in l/h für EWAPU (Automatik)" VALUE 0xa100e51f _REC_VAL_20_u1 99.45 _CNV_R_R_Def_dez_ub_667_CM 0. 127.5 /end CHARACTERISTIC
/begin CHARACTERISTIC K_GENOFFTIME "maximale Generatorauszeit" VALUE 0xa101751c _REC_VAL_20_u2 131.07 _CNV_R_R_Def_td_ub__593_CM 0. 6553.5 FORMAT "%4.1" /end CHARACTERISTIC
/begin CHARACTERISTIC K_GENUMAX "maximale Generatorspannung" VALUE 0xa101751e _REC_VAL_20_u2 131.07 _CNV_R_R_Def_u_uw_q_731_CM 0. 6553.5 /end CHARACTERISTIC
/begin CHARACTERISTIC K_GENURAMP "Spannungsinkrement fuer Rampe" VALUE 0xa1017520 _REC_VAL_20_u2 98.30250000000001 _CNV_R_R_Def_u_uw_q_735_CM 0. 983.025 /end CHARACTERISTIC
/begin CHARACTERISTIC K_GENURAMPOF "Spannungsinkrement fuer Rampe, Generator ausschalten" VALUE 0xa1017522 _REC_VAL_20_u2 98.30250000000001 _CNV_R_R_Def_u_uw_q_735_CM 0. 983.025 /end CHARACTERISTIC
/begin CHARACTERISTIC K_GEN_APPUG "Manuelle Generatorspannungsvorgabe" VALUE 0xa1017524 _REC_VAL_20_u2 131.07 _CNV_R_R_Def_u_uw_q_731_CM 0. 6553.5 /end CHARACTERISTIC
/begin CHARACTERISTIC K_IFFMAX "Maximaler ZuendstromFolgefunken" VALUE 0xa100adf8 _REC_VAL_20_s2 65.535 _CNV_R_R_Def_i_sw_q_650_CM -32.768 32.767 /end CHARACTERISTIC
/begin CHARACTERISTIC K_IFFMIN "Minimaler Zuendstrom Folgefunken" VALUE 0xa100adfa _REC_VAL_20_s2 65.535 _CNV_R_R_Def_i_sw_q_650_CM -32.768 32.767 /end CHARACTERISTIC
/begin CHARACTERISTIC K_KFT_AP "Applikationswert für Sollwertvorgabe KFT " VALUE 0xa100e4d8 _REC_VAL_20_s2 98.30250000000001 _CNV_R_R_Def_t_sw_q_620_CM -327.68 327.67 FORMAT "%5.2" /end CHARACTERISTIC
/begin CHARACTERISTIC K_KFT_D "D-Anteil KFT-Regler" VALUE 0xa100e3fe _REC_VAL_20_u2 63.99900000000001 _CNV_R_R_Def_f_uw_b_580_CM 0. 63.999 FORMAT "%7.4" /end CHARACTERISTIC
/begin CHARACTERISTIC K_KFT_I "I-Anteil KFT-Regler" VALUE 0xa100e3fc _REC_VAL_20_u2 1.9999 _CNV_R_R_Def_f_uw_b_579_CM 0. 1.9999 FORMAT "%14.5" /end CHARACTERISTIC
/begin CHARACTERISTIC K_KFT_IMN "Minimalbegrenzung I-Anteil KFT-Regler" VALUE 0xa100e404 _REC_VAL_20_s2 99.99844999999999 _CNV_R_R_Def_rel_sw_584_CM -100. 99.9969 /end CHARACTERISTIC
/begin CHARACTERISTIC K_KFT_IMX "Maximalbegrenzung I-Anteil KFT-Regler" VALUE 0xa100e406 _REC_VAL_20_s2 99.99844999999999 _CNV_R_R_Def_rel_sw_584_CM -100. 99.9969 /end CHARACTERISTIC
/begin CHARACTERISTIC K_KFT_NK "Sollwertvorgabe für KFT in BA Notfall" VALUE 0xa100e4da _REC_VAL_20_s2 98.30250000000001 _CNV_R_R_Def_t_sw_q_620_CM -327.68 327.67 FORMAT "%5.2" /end CHARACTERISTIC
/begin CHARACTERISTIC K_KFT_NO "Sollwertvorgabe für KFT in BA Normal" VALUE 0xa100e4dc _REC_VAL_20_s2 98.30250000000001 _CNV_R_R_Def_t_sw_q_620_CM -327.68 327.67 FORMAT "%5.2" /end CHARACTERISTIC
/begin CHARACTERISTIC K_KFT_REGMN "Minimalbegrenzung Reglerausgang KFT-Regler" VALUE 0xa100e400 _REC_VAL_20_s2 99.99844999999999 _CNV_R_R_Def_rel_sw_584_CM -100. 99.9969 /end CHARACTERISTIC
/begin CHARACTERISTIC K_KFT_REGMX "Maximalbegrenzung Reglerausgang KFT-Regler" VALUE 0xa100e402 _REC_VAL_20_s2 99.99844999999999 _CNV_R_R_Def_rel_sw_584_CM -100. 99.9969 /end CHARACTERISTIC
/begin CHARACTERISTIC K_KFT_WA "Sollwertvorgabe für KFT in BA Warmlauf" VALUE 0xa100e4de _REC_VAL_20_s2 98.30250000000001 _CNV_R_R_Def_t_sw_q_620_CM -327.68 327.67 FORMAT "%5.2" /end CHARACTERISTIC
/begin CHARACTERISTIC K_LKLPS_NEL "Schwelle E-Lüfter Sollwert zur Öffnung LKS" VALUE 0xa100e520 _REC_VAL_20_u1 99.60930000000001 _CNV_R_R_Def_f_ub_b_602_CM 0. 99.60930000000001 FORMAT "%5.2" /end CHARACTERISTIC
/begin CHARACTERISTIC K_LKLPS_TU1 "Schwelle Tumg für LKLPS-Ansteuerung in BA High" VALUE 0xa100e4e0 _REC_VAL_20_s2 131.07 _CNV_R_R_Def_t_sw_q_618_CM -3276.8 3276.7 FORMAT "%4.1" /end CHARACTERISTIC
/begin CHARACTERISTIC K_LKLPS_TU2 "Schwelle Tumg für LKLPS-Ansteuerung in BA High+KFT" VALUE 0xa100e4e2 _REC_VAL_20_s2 131.07 _CNV_R_R_Def_t_sw_q_618_CM -3276.8 3276.7 FORMAT "%4.1" /end CHARACTERISTIC
/begin CHARACTERISTIC K_LSPULE "Induktivität Spule" VALUE 0xa100ae02 _REC_VAL_20_u2 15.9997 _CNV_R_R_Def_l_uw_b_776_CM 0. 15.9997 FORMAT "%7.4" /end CHARACTERISTIC
/begin CHARACTERISTIC K_LZR_DOWN "Steigung für Zähler für langsame Mittelung der Bordnetzspannung´(Runterzählen)" VALUE 0xa1017c6e _REC_VAL_20_u2 0. _CNV_R_R_Def_dez_sl_575_CM 0. 65535. FORMAT "%5.0" /end CHARACTERISTIC
/begin CHARACTERISTIC K_LZR_MAX "Grenzwert für Zähler für langsame Mittelung der Bordnetzspannung" VALUE 0xa1017c70 _REC_VAL_20_u2 0. _CNV_R_R_Def_dez_sl_575_CM 0. 65535. FORMAT "%5.0" /end CHARACTERISTIC
/begin CHARACTERISTIC K_MAT_BHZ "Vektor für Schaltung Heizleistungsteigerung (gedrosselter Betrieb)" VAL_BLK 0xa100e52c _REC_VAL_2_u1 99.45 _CNV_R_R_Def_dez_sl_575_CM 0. 255. FORMAT "%3.0" NUMBER 12 /end CHARACTERISTIC
/begin CHARACTERISTIC K_MAT_EGS "Vektor für Schaltung Getriebeeingriff" VAL_BLK 0xa100e538 _REC_VAL_2_u1 99.45 _CNV_R_R_Def_dez_sl_575_CM 0. 255. FORMAT "%3.0" NUMBER 12 /end CHARACTERISTIC
/begin CHARACTERISTIC K_MAT_ELUEFT "Vektor für Schaltung E-Lüfter" VAL_BLK 0xa100e544 _REC_VAL_2_u1 99.45 _CNV_R_R_Def_dez_sl_575_CM 0. 255. FORMAT "%3.0" NUMBER 12 /end CHARACTERISTIC
/begin CHARACTERISTIC K_MAT_EWP "Vektor für Schaltung EWP" VAL_BLK 0xa100e550 _REC_VAL_2_u1 99.45 _CNV_R_R_Def_dez_sl_575_CM 0. 255. FORMAT "%3.0" NUMBER 12 /end CHARACTERISTIC
/begin CHARACTERISTIC K_MAT_KFT "Vektor für Schaltung KFT" VAL_BLK 0xa100e55c _REC_VAL_2_u1 99.45 _CNV_R_R_Def_dez_sl_575_CM 0. 255. FORMAT "%3.0" NUMBER 12 /end CHARACTERISTIC
/begin CHARACTERISTIC K_MAT_LKLPS "Vektor für Schaltung Luftklappe" VAL_BLK 0xa100e568 _REC_VAL_2_u1 99.45 _CNV_R_R_Def_dez_sl_575_CM 0. 255. FORMAT "%3.0" NUMBER 12 /end CHARACTERISTIC
/begin CHARACTERISTIC K_MAT_MDAC "Vektor für Schaltung Klima-Reduzierung" VAL_BLK 0xa100e574 _REC_VAL_2_u1 99.45 _CNV_R_R_Def_dez_sl_575_CM 0. 255. FORMAT "%3.0" NUMBER 12 /end CHARACTERISTIC
/begin CHARACTERISTIC K_MAT_MDRED "Vektor für Schaltung Leistungsreduzierung" VAL_BLK 0xa100e580 _REC_VAL_2_u1 99.45 _CNV_R_R_Def_dez_sl_575_CM 0. 255. FORMAT "%3.0" NUMBER 12 /end CHARACTERISTIC
/begin CHARACTERISTIC K_MAT_MDRES "Vektor für Schaltung Heizleistungsteigerung (Momentenreserve)" VAL_BLK 0xa100e58c _REC_VAL_2_u1 99.45 _CNV_R_R_Def_dez_sl_575_CM 0. 255. FORMAT "%3.0" NUMBER 12 /end CHARACTERISTIC
/begin CHARACTERISTIC K_MAT_TV "Vektor für Schaltung Heizungsabsperrventil" VAL_BLK 0xa100e598 _REC_VAL_2_u1 99.45 _CNV_R_R_Def_dez_sl_575_CM 0. 255. FORMAT "%3.0" NUMBER 12 /end CHARACTERISTIC
/begin CHARACTERISTIC K_MAT_WARN1 "Vektor für Schaltung gelbe Warnlampe" VAL_BLK 0xa100e5a4 _REC_VAL_2_u1 99.45 _CNV_R_R_Def_dez_sl_575_CM 0. 255. FORMAT "%3.0" NUMBER 12 /end CHARACTERISTIC
/begin CHARACTERISTIC K_MAT_WARN2 "Vektor für Schaltung rote Warnlampe" VAL_BLK 0xa100e5b0 _REC_VAL_2_u1 99.45 _CNV_R_R_Def_dez_sl_575_CM 0. 255. FORMAT "%3.0" NUMBER 12 /end CHARACTERISTIC
/begin CHARACTERISTIC K_MAT_WARN3 "Vektor für Schaltung Meldung" VAL_BLK 0xa100e5bc _REC_VAL_2_u1 99.45 _CNV_R_R_Def_dez_sl_575_CM 0. 255. FORMAT "%3.0" NUMBER 12 /end CHARACTERISTIC
/begin CHARACTERISTIC K_MDKEWPTDLP "Zeitkonstante für Filterung Mdk_ewp" VALUE 0xa100e44e _REC_VAL_20_u2 131.07 _CNV_R_R_Def_td_uw__726_CM 0. 13107. FORMAT "%4.1" /end CHARACTERISTIC
/begin CHARACTERISTIC K_MDKLIMA_AP "Applikationskonstante für Klima-Reduzierung" VALUE 0xa100e4e4 _REC_VAL_20_s2 131.07 _CNV_R_R_Def_m_sw_q_574_CM -3276.8 3276.7 FORMAT "%5.2" /end CHARACTERISTIC
/begin CHARACTERISTIC K_MDKUEHL_AP "Applikationskonstante für Leistungsreduzierung (Moment)" VALUE 0xa100e4e6 _REC_VAL_20_s2 131.07 _CNV_R_R_Def_m_sw_q_574_CM -3276.8 3276.7 FORMAT "%5.2" /end CHARACTERISTIC
/begin CHARACTERISTIC K_MDK_EXT_MINUS "" VALUE 0xa100ade8 _REC_VAL_20_s2 131.07 _CNV_R_R_Def_m_sw_q_574_CM -3276.8 3276.7 FORMAT "%5.2" /end CHARACTERISTIC
/begin CHARACTERISTIC K_MDK_EXT_PLUS "" VALUE 0xa100ade6 _REC_VAL_20_s2 131.07 _CNV_R_R_Def_m_sw_q_574_CM -3276.8 3276.7 FORMAT "%5.2" /end CHARACTERISTIC
/begin CHARACTERISTIC K_MDRES_AP "Applikationskonstante für Heizlestungssteigerung (Momenst)" VALUE 0xa100e4e8 _REC_VAL_20_s2 131.07 _CNV_R_R_Def_m_sw_q_574_CM -3276.8 3276.7 FORMAT "%5.2" /end CHARACTERISTIC
/begin CHARACTERISTIC K_MINHUB "-" VALUE 0xa100adee _REC_VAL_20_u2 65.535 _CNV_R_R_Def_hub_uw_605_CM 0. 65.535 /end CHARACTERISTIC
/begin CHARACTERISTIC K_MMI_ZEIT1 "Zeit1 für Unterdrückung Warnlampe1 nach Motorstart" VALUE 0xa100e512 _REC_VAL_20_u2 131.07 _CNV_R_R_Def_td_uw__726_CM 0. 13107. FORMAT "%4.1" /end CHARACTERISTIC
/begin CHARACTERISTIC K_MMI_ZEIT2 "Zeit2  für Unterdrückung Warnlampe2 nach Motorstart" VALUE 0xa100e514 _REC_VAL_20_u2 131.07 _CNV_R_R_Def_td_uw__726_CM 0. 13107. FORMAT "%4.1" /end CHARACTERISTIC
/begin CHARACTERISTIC K_NEL_AP "Applikationskonstante für E-Lüfter-Sollwert" VALUE 0xa100e521 _REC_VAL_20_u1 99.60930000000001 _CNV_R_R_Def_f_ub_b_602_CM 0. 99.60930000000001 FORMAT "%5.2" /end CHARACTERISTIC
/begin CHARACTERISTIC K_NEL_NTLKS "E-Lüfter Sollwert für BA Notfall" VALUE 0xa100e522 _REC_VAL_20_u1 99.60930000000001 _CNV_R_R_Def_f_ub_b_602_CM 0. 99.60930000000001 FORMAT "%5.2" /end CHARACTERISTIC
/begin CHARACTERISTIC K_NKW_MN "Drezahlschwelle " VALUE 0xa100e422 _REC_VAL_20_s2 0. _CNV_R_R_Def_n_sw_q_612_CM -32768. 32767. FORMAT "%5.0" /end CHARACTERISTIC
/begin CHARACTERISTIC K_NLEWPMX "Max. EWAPU-Sollwert für Nachlauf und Wake-up" VALUE 0xa100e9bc _REC_VAL_20_u1 99.45 _CNV_R_R_Def_dez_sl_575_CM 0. 255. FORMAT "%3.0" /end CHARACTERISTIC
/begin CHARACTERISTIC K_NLKFTMX "Max. KFT-Sollwet im Nachlauf" VALUE 0xa100e9b8 _REC_VAL_20_s2 98.30250000000001 _CNV_R_R_Def_t_sw_q_620_CM -327.68 327.67 FORMAT "%5.2" /end CHARACTERISTIC
/begin CHARACTERISTIC K_NTLKWS_AP "Applikationskonstante für Getriebeeingriff" VALUE 0xa100e523 _REC_VAL_20_u1 1. _CNV_R_R_Def_dez_sl_575_CM 0. 1. FORMAT "%4.1" /end CHARACTERISTIC
/begin CHARACTERISTIC K_PMSA_DEC "Pmigrlowctr dekrementfaktor" VALUE 0xa1017540 _REC_VAL_20_u1 99.45 _CNV_R_R_Def_dez_sl_575_CM 0. 255. FORMAT "%3.0" /end CHARACTERISTIC
/begin CHARACTERISTIC K_PMSA_INC "Pmigrlowctr inkrementfaktor" VALUE 0xa1017541 _REC_VAL_20_u1 99.45 _CNV_R_R_Def_dez_sl_575_CM 0. 255. FORMAT "%3.0" /end CHARACTERISTIC
/begin CHARACTERISTIC K_PMSA_RST "Untere Hystereseschwelle iGR Reaktivieren" VALUE 0xa1017526 _REC_VAL_20_u2 0. _CNV_R_R_Def_dez_sl_575_CM 0. 65535. FORMAT "%5.0" /end CHARACTERISTIC
/begin CHARACTERISTIC K_PMSA_SET "Obere Hystereseschwelle iGR Deaktivieren" VALUE 0xa1017528 _REC_VAL_20_u2 0. _CNV_R_R_Def_dez_sl_575_CM 0. 65535. FORMAT "%5.0" /end CHARACTERISTIC
/begin CHARACTERISTIC K_PRIO_WMBA "Priorisierung BA geregelt-Warmlauf-Heizung-Sicherheit-Applikation" VAL_BLK 0xa100e45a _REC_VAL_2_u1 99.45 _CNV_R_R_Def_dez_sl_575_CM 0. 255. FORMAT "%3.0" NUMBER 7 /end CHARACTERISTIC
/begin CHARACTERISTIC K_QSNLZAEHL "Zählervorgabe für Qs_anf_klima im Nachlauf und Wake-up" VALUE 0xa100e9ba _REC_VAL_20_u2 0. _CNV_R_R_Def_dez_sl_575_CM 0. 65535. FORMAT "%5.0" /end CHARACTERISTIC
/begin CHARACTERISTIC K_RESTDELAY "Verzögerungszeit für Qs_anf_klima" VALUE 0xa100e9bd _REC_VAL_20_u1 25.5 _CNV_R_R_Def_td_ub__593_CM 0. 25.5 FORMAT "%4.1" /end CHARACTERISTIC
/begin CHARACTERISTIC K_RF_MAX "" VALUE 0xa100adec _REC_VAL_20_s2 98.30250000000001 _CNV_R_R_Def_rf_sw__616_CM -327.68 327.67 FORMAT "%7.4" /end CHARACTERISTIC
/begin CHARACTERISTIC K_R_KBB "Widerstand Kabelbaum" VALUE 0xa100ae04 _REC_VAL_20_u2 1.9999 _CNV_R_R_Def_r_uw_b_694_CM 0. 1.9999 FORMAT "%5.2" /end CHARACTERISTIC
/begin CHARACTERISTIC K_SZR_DOWN "Steigung für Zähler für schnelle Mittelung der Bordnetzspannung´(Runterzählen)" VALUE 0xa1017c72 _REC_VAL_20_u2 0. _CNV_R_R_Def_dez_sl_575_CM 0. 65535. FORMAT "%5.0" /end CHARACTERISTIC
/begin CHARACTERISTIC K_SZR_MAX "Grenzwert für Zähler für schnelle Mittelung der Bordnetzspannung" VALUE 0xa1017c74 _REC_VAL_20_u2 0. _CNV_R_R_Def_dez_sl_575_CM 0. 65535. FORMAT "%5.0" /end CHARACTERISTIC
/begin CHARACTERISTIC K_TDGENOFFST "Zeitverzögerung B_start für Spannung im Start Generator" VALUE 0xa1017542 _REC_VAL_20_u1 25.5 _CNV_R_R_Def_td_ub__593_CM 0. 25.5 FORMAT "%4.1" /end CHARACTERISTIC
/begin CHARACTERISTIC K_TES12APP_S "" VALUE 0xa10134ac _REC_VAL_20_u2 99.61320000000001 _CNV_R_R_Def_td_sw__619_CM 0. 262.14 FORMAT "%5.2" /end CHARACTERISTIC
/begin CHARACTERISTIC K_TESMIN "Minimalbegrenzung Deltazeit zwischen 2 Einspritzungen" VALUE 0xa10134aa _REC_VAL_20_u2 99.61320000000001 _CNV_R_R_Def_td_sw__619_CM 0. 262.14 FORMAT "%5.2" /end CHARACTERISTIC
/begin CHARACTERISTIC K_TGBSMX "Tget Schwelle für Erkennung Bauteilschutz" VALUE 0xa100e424 _REC_VAL_20_s2 98.30250000000001 _CNV_R_R_Def_t_sw_q_620_CM -327.68 327.67 FORMAT "%5.2" /end CHARACTERISTIC
/begin CHARACTERISTIC K_TGET_MN "Tget Schwelle für Aufhebung Unterdrückung HK Auswahl" VALUE 0xa100e426 _REC_VAL_20_s2 98.30250000000001 _CNV_R_R_Def_t_sw_q_620_CM -327.68 327.67 FORMAT "%5.2" /end CHARACTERISTIC
/begin CHARACTERISTIC K_TGET_MX "Tget Schwelle für Unterdrückung HK Auswahl" VALUE 0xa100e428 _REC_VAL_20_s2 98.30250000000001 _CNV_R_R_Def_t_sw_q_620_CM -327.68 327.67 FORMAT "%5.2" /end CHARACTERISTIC
/begin CHARACTERISTIC K_TGNFKSMX "Tget Schwelle für Erkennung Notfall Kühlkreislauf" VALUE 0xa100e42a _REC_VAL_20_s2 98.30250000000001 _CNV_R_R_Def_t_sw_q_620_CM -327.68 327.67 FORMAT "%5.2" /end CHARACTERISTIC
/begin CHARACTERISTIC K_TMBSMX "Tmot Schwelle für Erkennung BA-Bauteilschutz" VALUE 0xa100e42c _REC_VAL_20_s2 98.30250000000001 _CNV_R_R_Def_t_sw_q_620_CM -327.68 327.67 FORMAT "%5.2" /end CHARACTERISTIC
/begin CHARACTERISTIC K_TMHEIZMN "Schwell Motortemperatur für BA-Heizleistung" VALUE 0xa100e42e _REC_VAL_20_s2 98.30250000000001 _CNV_R_R_Def_t_sw_q_620_CM -327.68 327.67 FORMAT "%5.2" /end CHARACTERISTIC
/begin CHARACTERISTIC K_TMNFKSMX "Tmot Schwelle für Erkennung Notfall Kühlkreislauf" VALUE 0xa100e430 _REC_VAL_20_s2 98.30250000000001 _CNV_R_R_Def_t_sw_q_620_CM -327.68 327.67 FORMAT "%5.2" /end CHARACTERISTIC
/begin CHARACTERISTIC K_TMOTKALT "Schwelle für Motortemperatur für Startbedingung Schliesszeit" VALUE 0xa100adfc _REC_VAL_20_s2 98.30250000000001 _CNV_R_R_Def_t_sw_q_620_CM -327.68 327.67 FORMAT "%5.2" /end CHARACTERISTIC
/begin CHARACTERISTIC K_TMWARNMN "Rücknahme Tmot Schwelle für Warnlampen bei E-Lüfter-Fehler" VALUE 0xa100e4ea _REC_VAL_20_s2 98.30250000000001 _CNV_R_R_Def_t_sw_q_620_CM -327.68 327.67 FORMAT "%5.2" /end CHARACTERISTIC
/begin CHARACTERISTIC K_TMWARN_1 "Schwelle für Tmot gelbe Warnlampe" VALUE 0xa100e4ec _REC_VAL_20_s2 98.30250000000001 _CNV_R_R_Def_t_sw_q_620_CM -327.68 327.67 FORMAT "%5.2" /end CHARACTERISTIC
/begin CHARACTERISTIC K_TMWARN_2 "Schwelle für Tmot rote Warnlampe" VALUE 0xa100e4ee _REC_VAL_20_s2 98.30250000000001 _CNV_R_R_Def_t_sw_q_620_CM -327.68 327.67 FORMAT "%5.2" /end CHARACTERISTIC
/begin CHARACTERISTIC K_TMWARN_HYS "Hysterese für Tmot, Rücknahme Warnlampen" VALUE 0xa100e4f0 _REC_VAL_20_s2 98.30250000000001 _CNV_R_R_Def_t_sw_q_620_CM -327.68 327.67 FORMAT "%5.2" /end CHARACTERISTIC
/begin CHARACTERISTIC K_TOBSMX "Toel Schwell für Erkennung BA-Bauteilschutz" VALUE 0xa100e432 _REC_VAL_20_s2 131.07 _CNV_R_R_Def_t_sw_q_618_CM -3276.8 3276.7 FORMAT "%4.1" /end CHARACTERISTIC
/begin CHARACTERISTIC K_TOHKMX "Max. Schwelle für Hysterese Toel im WMPRIO Modul für HK Betrieb" VALUE 0xa100e434 _REC_VAL_20_s2 131.07 _CNV_R_R_Def_t_sw_q_618_CM -3276.8 3276.7 FORMAT "%4.1" /end CHARACTERISTIC
/begin CHARACTERISTIC K_TONFKSMX "Toel Schwelle für Erkennung Notfall Kühlkreislauf" VALUE 0xa100e436 _REC_VAL_20_s2 131.07 _CNV_R_R_Def_t_sw_q_618_CM -3276.8 3276.7 FORMAT "%4.1" /end CHARACTERISTIC
/begin CHARACTERISTIC K_TOWARN_1 "Schwelle für Toel gelbe Warnlampe" VALUE 0xa100e4f2 _REC_VAL_20_s2 131.07 _CNV_R_R_Def_t_sw_q_618_CM -3276.8 3276.7 FORMAT "%4.1" /end CHARACTERISTIC
/begin CHARACTERISTIC K_TOWARN_2 "Schwelle für Toel rote Warnlampe" VALUE 0xa100e4f4 _REC_VAL_20_s2 131.07 _CNV_R_R_Def_t_sw_q_618_CM -3276.8 3276.7 FORMAT "%4.1" /end CHARACTERISTIC
/begin CHARACTERISTIC K_TOWARN_3 "Schwelle für Toel Meldung " VALUE 0xa100e4f6 _REC_VAL_20_s2 131.07 _CNV_R_R_Def_t_sw_q_618_CM -3276.8 3276.7 FORMAT "%4.1" /end CHARACTERISTIC
/begin CHARACTERISTIC K_TOWARN_HYS "Hysterese für Toel, Rücknahme Warnlampen" VALUE 0xa100e4f8 _REC_VAL_20_s2 131.07 _CNV_R_R_Def_t_sw_q_618_CM -3276.8 3276.7 FORMAT "%4.1" /end CHARACTERISTIC
/begin CHARACTERISTIC K_TUHEIZMN "Schwelle Umgebungstemperatur für BA-Heizleistung" VALUE 0xa100e438 _REC_VAL_20_s2 131.07 _CNV_R_R_Def_t_sw_q_618_CM -3276.8 3276.7 FORMAT "%4.1" /end CHARACTERISTIC
/begin CHARACTERISTIC K_TVAV_AP "Applikationskonstante für Heizungsabsperrventil" VALUE 0xa100e524 _REC_VAL_20_u1 100. _CNV_R_R_Def_tv_ub__729_CM 0. 100. FORMAT "%5.2" /end CHARACTERISTIC
/begin CHARACTERISTIC K_TVAV_BE "Sollwert für Heizungsabsperrventil in BA Befüllen / Entlüften" VALUE 0xa100e525 _REC_VAL_20_u1 100. _CNV_R_R_Def_tv_ub__729_CM 0. 100. FORMAT "%5.2" /end CHARACTERISTIC
/begin CHARACTERISTIC K_TVAV_BS "Sollwert für Heizungsabsperrventil in BA Bauteilschutz" VALUE 0xa100e526 _REC_VAL_20_u1 100. _CNV_R_R_Def_tv_ub__729_CM 0. 100. FORMAT "%5.2" /end CHARACTERISTIC
/begin CHARACTERISTIC K_TVAV_NK "Sollwert für Heizungsabsperrventil in BA Notfall" VALUE 0xa100e527 _REC_VAL_20_u1 100. _CNV_R_R_Def_tv_ub__729_CM 0. 100. FORMAT "%5.2" /end CHARACTERISTIC
/begin CHARACTERISTIC K_TVULV "ULV Ansteuerung - manuell" VALUE 0xa100c652 _REC_VAL_20_u2 99.9984 _CNV_R_R_Def_f_uw_b_576_CM 0. 99.9984 /end CHARACTERISTIC
/begin CHARACTERISTIC K_TVULVPUMP1 "Max. zus. ULV Tastverhältnis bei Pumpen" VALUE 0xa100c654 _REC_VAL_20_u2 99.9984 _CNV_R_R_Def_f_uw_b_576_CM 0. 99.9984 /end CHARACTERISTIC
/begin CHARACTERISTIC K_TVULVPUMP2 "Max. zus. ULV Tastverhältnis bei Pumpen" VALUE 0xa100c656 _REC_VAL_20_u2 99.9984 _CNV_R_R_Def_f_uw_b_576_CM 0. 99.9984 /end CHARACTERISTIC
/begin CHARACTERISTIC K_TVULVPUMP3 "Minderung Pumpeingriff " VALUE 0xa100c658 _REC_VAL_20_u2 99.9984 _CNV_R_R_Def_f_uw_b_576_CM 0. 99.9984 /end CHARACTERISTIC
/begin CHARACTERISTIC K_T_IGRNACHL "Nachlaufzeit iGR aktiv" VALUE 0xa101752a _REC_VAL_20_u2 131.07 _CNV_R_R_Def_td_ub__593_CM 0. 6553.5 FORMAT "%4.1" /end CHARACTERISTIC
/begin CHARACTERISTIC K_T_VERBON "Verzugszeit Verbraucherzuschaltung nach Aufhebung Genertorreduzierung" VALUE 0xa1017543 _REC_VAL_20_u1 25.5 _CNV_R_R_Def_td_ub__593_CM 0. 25.5 FORMAT "%4.1" /end CHARACTERISTIC
/begin CHARACTERISTIC K_UBNS "Spannungswert für krit. Bordnetzzustand" VALUE 0xa101752c _REC_VAL_20_u2 131.07 _CNV_R_R_Def_u_uw_q_731_CM 0. 6553.5 /end CHARACTERISTIC
/begin CHARACTERISTIC K_UBW_DELAY "Verzögerungszeit UBW nach Beginn Generatorteillast" VALUE 0xa1017c76 _REC_VAL_20_u2 98.30250000000001 _CNV_R_R_Def_td_uw__679_CM 0. 655.35 FORMAT "%5.2" /end CHARACTERISTIC
/begin CHARACTERISTIC K_UBW_DFMAX "Maximale Generatorauslastung für Batteriespannungswächter" VALUE 0xa1017c80 _REC_VAL_20_u1 99.60930000000001 _CNV_R_R_Def_f_ub_b_602_CM 0. 99.60930000000001 FORMAT "%5.2" /end CHARACTERISTIC
/begin CHARACTERISTIC K_UBW_DFMIN "Minimale Generatorauslastung für Batteriespannungswächter" VALUE 0xa1017c81 _REC_VAL_20_u1 99.60930000000001 _CNV_R_R_Def_f_ub_b_602_CM 0. 99.60930000000001 FORMAT "%5.2" /end CHARACTERISTIC
/begin CHARACTERISTIC K_UBW_DZR "Zählerinkrement für Batteriespannungswächter (nicht ändern!)" VALUE 0xa1017c78 _REC_VAL_20_u2 0. _CNV_R_R_Def_dez_sl_575_CM 0. 65535. FORMAT "%5.0" /end CHARACTERISTIC
/begin CHARACTERISTIC K_UBW_NKWSCH "Drehzahlschwelle Bordnetzwächter" VALUE 0xa1017c6c _REC_VAL_20_s2 0. _CNV_R_R_Def_n_sw_q_612_CM 0. 32767. FORMAT "%5.0" /end CHARACTERISTIC
/begin CHARACTERISTIC K_UBW_TABL "Ablaufzeit (Reset) für Batteriespannungswächter" VALUE 0xa1017c7a _REC_VAL_20_u2 0. _CNV_R_R_Def_dez_sl_575_CM 0. 65535. FORMAT "%5.0" /end CHARACTERISTIC
/begin CHARACTERISTIC K_UBW_ULMN "Minimalwert für Bordnetzspannung (langsame Mittelung) [für BSDII bei Außenlicht an]" VALUE 0xa1017c82 _REC_VAL_20_u1 24.0112 _CNV_R_R_Def_u_sb_q_598_CM 0. 24.0112 FORMAT "%7.4" /end CHARACTERISTIC
/begin CHARACTERISTIC K_UBW_ULMNIL "Minimalwert für Bordnetzspannung (langsame Mittelung) bei Innenlicht an" VALUE 0xa1017c83 _REC_VAL_20_u1 24.0112 _CNV_R_R_Def_u_sb_q_598_CM 0. 24.0112 FORMAT "%7.4" /end CHARACTERISTIC
/begin CHARACTERISTIC K_UBW_ULMNOFF "Minimalwert für Bordnetzspannung (langsame Mittelung) bei Licht aus" VALUE 0xa1017c84 _REC_VAL_20_u1 24.0112 _CNV_R_R_Def_u_sb_q_598_CM 0. 24.0112 FORMAT "%7.4" /end CHARACTERISTIC
/begin CHARACTERISTIC K_UBW_USMN "Minimalwert für Bordnetzspannung (schnelle Mittelung) [für BSDII bei Außenlicht an]" VALUE 0xa1017c85 _REC_VAL_20_u1 24.0112 _CNV_R_R_Def_u_sb_q_598_CM 0. 24.0112 FORMAT "%7.4" /end CHARACTERISTIC
/begin CHARACTERISTIC K_UBW_USMNIL "Minimalwert für Bordnetzspannung (schnelle Mittelung) bei Innenlicht an" VALUE 0xa1017c86 _REC_VAL_20_u1 24.0112 _CNV_R_R_Def_u_sb_q_598_CM 0. 24.0112 FORMAT "%7.4" /end CHARACTERISTIC
/begin CHARACTERISTIC K_UBW_USMNOFF "Minimalwert für Bordnetzspannung (schnelle Mittelung) bei Licht aus" VALUE 0xa1017c87 _REC_VAL_20_u1 24.0112 _CNV_R_R_Def_u_sb_q_598_CM 0. 24.0112 FORMAT "%7.4" /end CHARACTERISTIC
/begin CHARACTERISTIC K_UBW_USZRMX "Grenzwert Schwingungszähler Batteriespannungswächter" VALUE 0xa1017c88 _REC_VAL_20_u1 99.45 _CNV_R_R_Def_dez_sl_575_CM 0. 255. FORMAT "%3.0" /end CHARACTERISTIC
/begin CHARACTERISTIC K_UBW_ZKL "Schwelle für Erkennung dauerhafter Einbruch der Bordnetzspannung" VALUE 0xa1017c89 _REC_VAL_20_u1 99.45 _CNV_R_R_Def_dez_sl_575_CM 0. 255. FORMAT "%3.0" /end CHARACTERISTIC
/begin CHARACTERISTIC K_UBW_ZKSMN "Schwelle für Erkennung zyklischer Einbruch der Bordnetzspannung (Hysterese MN)" VALUE 0xa1017c7c _REC_VAL_20_u2 0. _CNV_R_R_Def_dez_sl_575_CM 0. 65535. FORMAT "%5.0" /end CHARACTERISTIC
/begin CHARACTERISTIC K_UBW_ZKSMX "Schwelle für Erkennung zyklischer Einbruch der Bordnetzspannung (Hysterese MX)" VALUE 0xa1017c7e _REC_VAL_20_u2 0. _CNV_R_R_Def_dez_sl_575_CM 0. 65535. FORMAT "%5.0" /end CHARACTERISTIC
/begin CHARACTERISTIC K_UFAKRKTI "Umrechnungsfaktor Rk nach Ti" VALUE 0xa1013496 _REC_VAL_20_u2 0.9999 _CNV_R_R_Def_f_uw_b_591_CM 0. 0.9999 FORMAT "%14.5" /end CHARACTERISTIC
/begin CHARACTERISTIC K_UGENDELTA "Spannungsdelta bei Betrieb von 2 Generatoren" VALUE 0xa101752e _REC_VAL_20_u2 131.07 _CNV_R_R_Def_u_uw_q_731_CM 0. 6553.5 /end CHARACTERISTIC
/begin CHARACTERISTIC K_UGENMAXE65 "Maximale Generatorspannung im E65" VALUE 0xa1017530 _REC_VAL_20_u2 131.07 _CNV_R_R_Def_u_uw_q_731_CM 0. 6553.5 /end CHARACTERISTIC
/begin CHARACTERISTIC K_UGENOFF "Generatorauschaltspannung bei vfzg = 0" VALUE 0xa1017532 _REC_VAL_20_u2 131.07 _CNV_R_R_Def_u_uw_q_731_CM 0. 6553.5 /end CHARACTERISTIC
/begin CHARACTERISTIC K_UGENOFFSTART "Spannung im Start Generator" VALUE 0xa1017534 _REC_VAL_20_u2 131.07 _CNV_R_R_Def_u_uw_q_731_CM 0. 6553.5 /end CHARACTERISTIC
/begin CHARACTERISTIC K_UGENOFFV0 "Generatorauschaltspannung bei vfzg != 0" VALUE 0xa1017536 _REC_VAL_20_u2 131.07 _CNV_R_R_Def_u_uw_q_731_CM 0. 6553.5 /end CHARACTERISTIC
/begin CHARACTERISTIC K_U_BNMAX "Maximale Bordnetzspannung" VALUE 0xa1017538 _REC_VAL_20_u2 131.07 _CNV_R_R_Def_u_uw_q_731_CM 0. 6553.5 /end CHARACTERISTIC
/begin CHARACTERISTIC K_U_IGRRAMP "iGR Spannungsrampe" VALUE 0xa101753a _REC_VAL_20_u2 98.30250000000001 _CNV_R_R_Def_u_uw_q_735_CM 0. 983.025 /end CHARACTERISTIC
/begin CHARACTERISTIC K_VNFKSMN "Min. Schwelle für V abhängige Freischaltung FI_ELUEE für Auswahl BA Notfallkühlsystem " VALUE 0xa100e450 _REC_VAL_20_u2 0. _CNV_R_R_Def_v_uw_q_737_CM 0. 65535. FORMAT "%5.0" /end CHARACTERISTIC
/begin CHARACTERISTIC K_WARN1_AP "Applikationskonstante für gelbe Warnlampe" VALUE 0xa100e528 _REC_VAL_20_u1 1. _CNV_R_R_Def_dez_sl_575_CM 0. 1. FORMAT "%4.1" /end CHARACTERISTIC
/begin CHARACTERISTIC K_WARN2_AP "Applikationskonstante für rote Warnlampe" VALUE 0xa100e529 _REC_VAL_20_u1 1. _CNV_R_R_Def_dez_sl_575_CM 0. 1. FORMAT "%4.1" /end CHARACTERISTIC
/begin CHARACTERISTIC K_WARN3_AP "Applikationskonstante für rote Warnlampe" VALUE 0xa100e52a _REC_VAL_20_u1 1. _CNV_R_R_Def_dez_sl_575_CM 0. 1. FORMAT "%4.1" /end CHARACTERISTIC
/begin CHARACTERISTIC K_WESB1APP_H "" VALUE 0xa10134a2 _REC_VAL_20_s2 107.518355 _CNV_R_R_Def_kw_sw__622_CM -768. 767.9765 /end CHARACTERISTIC
/begin CHARACTERISTIC K_WESB1APP_HS "" VALUE 0xa10134a4 _REC_VAL_20_s2 107.518355 _CNV_R_R_Def_kw_sw__622_CM -768. 767.9765 /end CHARACTERISTIC
/begin CHARACTERISTIC K_WESB3APP_S "Appl. Einspritzbeginn 3. Einspritzung für KH (schicht)" VALUE 0xa101349c _REC_VAL_20_s2 107.518355 _CNV_R_R_Def_kw_sw__622_CM -768. 767.9765 /end CHARACTERISTIC
/begin CHARACTERISTIC K_WESB3MAX_S "Maximaler Einspritzbeginn 3. Einspritzung für KH (schicht)" VALUE 0xa101349a _REC_VAL_20_s2 107.518355 _CNV_R_R_Def_kw_sw__622_CM -768. 767.9765 /end CHARACTERISTIC
/begin CHARACTERISTIC K_WESB3MIN_S "Minimaler Einspritzbeginn 3. Einspritzung für KH (schicht)" VALUE 0xa1013498 _REC_VAL_20_s2 107.518355 _CNV_R_R_Def_kw_sw__622_CM -768. 767.9765 /end CHARACTERISTIC
/begin CHARACTERISTIC K_WESE2APP_H "" VALUE 0xa10134a6 _REC_VAL_20_s2 107.518355 _CNV_R_R_Def_kw_sw__622_CM -768. 767.9765 /end CHARACTERISTIC
/begin CHARACTERISTIC K_WMKVDFAK "" VALUE 0xa100e35b _REC_VAL_20_u1 3.9686 _CNV_R_R_Def_f_ub_b_670_CM 1.57e-002 3.9843 FORMAT "%5.2" /end CHARACTERISTIC
/begin CHARACTERISTIC K_WMTANSHYS "Hysterese für Tans" VALUE 0xa100e43a _REC_VAL_20_s2 131.07 _CNV_R_R_Def_t_sw_q_618_CM -3276.8 3276.7 FORMAT "%4.1" /end CHARACTERISTIC
/begin CHARACTERISTIC K_WMTMTGHYS "WMK Hysterese für Tmot  und Tget" VALUE 0xa100e43c _REC_VAL_20_s2 98.30250000000001 _CNV_R_R_Def_t_sw_q_620_CM -327.68 327.67 FORMAT "%5.2" /end CHARACTERISTIC
/begin CHARACTERISTIC K_WMTM_ER "Ersatzwert für WMK bei Fehler Tmot" VALUE 0xa100e43e _REC_VAL_20_s2 98.30250000000001 _CNV_R_R_Def_t_sw_q_620_CM -327.68 327.67 FORMAT "%5.2" /end CHARACTERISTIC
/begin CHARACTERISTIC K_WMTOHYS "Hysterese für Toel " VALUE 0xa100e440 _REC_VAL_20_s2 131.07 _CNV_R_R_Def_t_sw_q_618_CM -3276.8 3276.7 FORMAT "%4.1" /end CHARACTERISTIC
/begin CHARACTERISTIC K_WMTU_1 "Schwelle Tumg für Auswahl BA High" VALUE 0xa100e442 _REC_VAL_20_s2 131.07 _CNV_R_R_Def_t_sw_q_618_CM -3276.8 3276.7 FORMAT "%4.1" /end CHARACTERISTIC
/begin CHARACTERISTIC K_WMTU_2 "Schwelle Tumg für Auswahl BA High+KFT" VALUE 0xa100e444 _REC_VAL_20_s2 131.07 _CNV_R_R_Def_t_sw_q_618_CM -3276.8 3276.7 FORMAT "%4.1" /end CHARACTERISTIC
/begin CHARACTERISTIC K_ZAEHLWE_UG "Zähler Übergang Betriebsart, weich" VALUE 0xa100e950 _REC_VAL_20_u2 0. _CNV_R_R_Def_dez_sl_575_CM 0. 65535. FORMAT "%5.0" /end CHARACTERISTIC
/begin CHARACTERISTIC K_ZAEHL_PWG "Startwert Zähler für Pwg_ist Betätigung" VALUE 0xa100e452 _REC_VAL_20_u2 0. _CNV_R_R_Def_dez_sl_575_CM 0. 65535. FORMAT "%5.0" /end CHARACTERISTIC
/begin CHARACTERISTIC K_ZAEHL_UG "Zähler Übergang Betriebsart, hart" VALUE 0xa100e952 _REC_VAL_20_u2 0. _CNV_R_R_Def_dez_sl_575_CM 0. 65535. FORMAT "%5.0" /end CHARACTERISTIC
/begin CHARACTERISTIC K_ZKZSTART "Zeitkonstante für Verzögerung Startbedingung in Schliesszeit" VALUE 0xa100ae06 _REC_VAL_20_u2 98.30250000000001 _CNV_R_R_Def_td_uw__679_CM 0. 655.35 FORMAT "%5.2" /end CHARACTERISTIC
/begin CHARACTERISTIC K_ZWAPP_HS "Applizierbareszündwinkel (homogen-schicht)" VALUE 0xa1010628 _REC_VAL_20_s2 100.1 _CNV_R_R_Def_zw_sw__599_CM -50. 60. FORMAT "%4.1" /end CHARACTERISTIC
/begin CHARACTERISTIC K_ZWAPP_S "Applizierbareszündwinkel (schicht)" VALUE 0xa1010626 _REC_VAL_20_s2 100.1 _CNV_R_R_Def_zw_sw__599_CM -50. 60. FORMAT "%4.1" /end CHARACTERISTIC
/begin CHARACTERISTIC K_ZWMINHYS_HS "" VALUE 0xa101062a _REC_VAL_20_s2 100.1 _CNV_R_R_Def_zw_sw__599_CM -50. 60. FORMAT "%4.1" /end CHARACTERISTIC
/begin CHARACTERISTIC S_DWESE2APP_H "" VALUE 0xa101348e _REC_VAL_20_u1 99.45 _CNV_R_R_Def_dez_sl_575_CM 0. 255. FORMAT "%3.0" /end CHARACTERISTIC
/begin CHARACTERISTIC S_DWESEAPP_HS "(homogen-schicht)" VALUE 0xa1013492 _REC_VAL_20_u1 99.45 _CNV_R_R_Def_dez_sl_575_CM 0. 255. FORMAT "%3.0" /end CHARACTERISTIC
/begin CHARACTERISTIC S_DWESEAPP_S "(schicht)" VALUE 0xa1013493 _REC_VAL_20_u1 99.45 _CNV_R_R_Def_dez_sl_575_CM 0. 255. FORMAT "%3.0" /end CHARACTERISTIC
/begin CHARACTERISTIC S_EL_GEN "Schalter zur Deaktivierung Generator Anforderung E-Lüfter " VALUE 0xa100e52b _REC_VAL_20_u1 1. _CNV_R_R_Def_dez_sl_575_CM 0. 1. FORMAT "%4.1" /end CHARACTERISTIC
/begin CHARACTERISTIC S_ENTLENA "Schalter Generatorentlastungsrampe aktivieren" VALUE 0xa1017544 _REC_VAL_20_u1 1. _CNV_R_R_Def_dez_sl_575_CM 0. 1. FORMAT "%4.1" /end CHARACTERISTIC
/begin CHARACTERISTIC S_EWPDIAG "Schalter für PPP-EWP Diagnose" VALUE 0xa100e458 _REC_VAL_20_u1 1. _CNV_R_R_Def_dez_sl_575_CM 0. 1. FORMAT "%4.1" /end CHARACTERISTIC
/begin CHARACTERISTIC S_GENOFFSTART "Schalter zum Freischalten Startausschaltspannung" VALUE 0xa1017545 _REC_VAL_20_u1 1. _CNV_R_R_Def_dez_sl_575_CM 0. 1. FORMAT "%4.1" /end CHARACTERISTIC
/begin CHARACTERISTIC S_GOFFRAMP "Schalter Sprung auf 10,6V unverzoegert" VALUE 0xa1017546 _REC_VAL_20_u1 99.45 _CNV_R_R_Def_dez_sl_575_CM 0. 255. FORMAT "%3.0" /end CHARACTERISTIC
/begin CHARACTERISTIC S_IGRLOW "Schalter iGR Low Funktion aktiv" VALUE 0xa1017547 _REC_VAL_20_u1 1. _CNV_R_R_Def_dez_sl_575_CM 0. 1. FORMAT "%4.1" /end CHARACTERISTIC
/begin CHARACTERISTIC S_SZOLD "Alte Berechnung Schliesszeit" VALUE 0xa100ae08 _REC_VAL_20_u1 1. _CNV_R_R_Def_dez_sl_575_CM 0. 1. FORMAT "%4.1" /end CHARACTERISTIC
/begin CHARACTERISTIC S_TES12APP_S "" VALUE 0xa101348f _REC_VAL_20_u1 99.45 _CNV_R_R_Def_dez_sl_575_CM 0. 255. FORMAT "%3.0" /end CHARACTERISTIC
/begin CHARACTERISTIC S_TVULV_MAN "ULV  Ansteuerung - manuell" VALUE 0xa100c65a _REC_VAL_20_u1 1. _CNV_R_R_Def_dez_sl_575_CM 0. 1. FORMAT "%4.1" /end CHARACTERISTIC
/begin CHARACTERISTIC S_ULVVST_OFF "ULV Vorsteuerung ausschalten" VALUE 0xa100c850 _REC_VAL_20_u1 1. _CNV_R_R_Def_dez_sl_575_CM 0. 1. FORMAT "%4.1" /end CHARACTERISTIC
/begin CHARACTERISTIC S_WESB1APP_H "" VALUE 0xa1013490 _REC_VAL_20_u1 99.45 _CNV_R_R_Def_dez_sl_575_CM 0. 255. FORMAT "%3.0" /end CHARACTERISTIC
/begin CHARACTERISTIC S_WESB1APP_HS "" VALUE 0xa1013491 _REC_VAL_20_u1 99.45 _CNV_R_R_Def_dez_sl_575_CM 0. 255. FORMAT "%3.0" /end CHARACTERISTIC
/begin CHARACTERISTIC S_WESB3APP_S "(schicht)" VALUE 0xa1013494 _REC_VAL_20_u1 99.45 _CNV_R_R_Def_dez_sl_575_CM 0. 255. FORMAT "%3.0" /end CHARACTERISTIC
/begin CHARACTERISTIC S_WESE2ABS_H "" VALUE 0xa101348c _REC_VAL_20_u1 99.45 _CNV_R_R_Def_dez_sl_575_CM 0. 255. FORMAT "%3.0" /end CHARACTERISTIC
/begin CHARACTERISTIC S_WESE2APP_H "" VALUE 0xa101348d _REC_VAL_20_u1 99.45 _CNV_R_R_Def_dez_sl_575_CM 0. 255. FORMAT "%3.0" /end CHARACTERISTIC
/begin CHARACTERISTIC S_ZWAPP_HS "Schalter für Applicationszündwinkel (homogen-schicht)" VALUE 0xa1010621 _REC_VAL_20_u1 1. _CNV_R_R_Def_dez_sl_575_CM 0. 1. FORMAT "%3.0" /end CHARACTERISTIC
/begin CHARACTERISTIC S_ZWAPP_S "Schalter für Applicationszündwinkel (schicht)" VALUE 0xa1010620 _REC_VAL_20_u1 1. _CNV_R_R_Def_dez_sl_575_CM 0. 1. FORMAT "%3.0" /end CHARACTERISTIC
/begin COMPU_METHOD _CNV_R_R_DEZ_436_CM "" RAT_FUNC "%6.3" "" COEFFS 0. 1. 0. 0. 0. 1. /end COMPU_METHOD
/begin COMPU_METHOD _CNV_R_R_Def_f_ub_b_573_CM "Def_f_ub_b1" RAT_FUNC "%6.3" "-" COEFFS 0. 256. 0. 0. 0. 1. /end COMPU_METHOD
/begin COMPU_METHOD _CNV_R_R_Def_m_sw_q_574_CM "Def_m_sw_q0p1" RAT_FUNC "%6.3" "Nm" COEFFS 0. 10. 0. 0. 0. 1. /end COMPU_METHOD
/begin COMPU_METHOD _CNV_R_R_Def_dez_sl_575_CM "Def_dez_sl_q1" RAT_FUNC "%6.3" "-" COEFFS 0. 1. 0. 0. 0. 1. /end COMPU_METHOD
/begin COMPU_METHOD _CNV_R_R_Def_f_uw_b_576_CM "Def_f_uw_b100" RAT_FUNC "%6.3" "%" COEFFS 0. 65536. 0. 0. 0. 100. /end COMPU_METHOD
/begin COMPU_METHOD _CNV_R_R_Def_p_sw_q_578_CM "Def_p_sw_q0p039" RAT_FUNC "%6.3" "hPa" COEFFS 0. 256. 0. 0. 0. 10. /end COMPU_METHOD
/begin COMPU_METHOD _CNV_R_R_Def_f_uw_b_579_CM "Def_f_uw_b2" RAT_FUNC "%6.3" "-" COEFFS 0. 65536. 0. 0. 0. 2. /end COMPU_METHOD
/begin COMPU_METHOD _CNV_R_R_Def_f_uw_b_580_CM "Def_f_uw_b64" RAT_FUNC "%6.3" "-" COEFFS 0. 65536. 0. 0. 0. 64. /end COMPU_METHOD
/begin COMPU_METHOD _CNV_R_R_Def_rel_sw_584_CM "Def_rel_sw_b100" RAT_FUNC "%6.3" "%" COEFFS 0. 32768. 0. 0. 0. 100. /end COMPU_METHOD
/begin COMPU_METHOD _CNV_S_11_Def_ba_wm_590_CM "Def_ba_wm" TAB_VERB "%6.3" "-" COMPU_TAB_REF _CNV_S_11_Def_ba_wm_590 /end COMPU_METHOD
/begin COMPU_VTAB _CNV_S_11_Def_ba_wm_590 "Def_ba_wm" TAB_VERB 11 0 "Keine" 1 "WARMLAUF" 2 "ECO" 3 "NORMAL" 4 "HIGH" 5 "HIGH+KFT" 6 "BAUTEILSCHUTZ" 7 "HEIZLEISTUNG" 8 "NOTLAUF" 9 "APPLIKATION" 10 "Befüllen/Entlüften" /end COMPU_VTAB
/begin COMPU_METHOD _CNV_R_R_Def_f_uw_b_591_CM "Def_f_uw_b1" RAT_FUNC "%6.3" "-" COEFFS 0. 65536. 0. 0. 0. 1. /end COMPU_METHOD
/begin COMPU_METHOD _CNV_R_R_Def_td_uw__592_CM "Def_td_uw_q0p001" RAT_FUNC "%6.3" "ms" COEFFS 0. 1000. 0. 0. 0. 1. /end COMPU_METHOD
/begin COMPU_METHOD _CNV_R_R_Def_td_ub__593_CM "Def_td_ub_q0p1" RAT_FUNC "%6.3" "s" COEFFS 0. 10. 0. 0. 0. 1. /end COMPU_METHOD
/begin COMPU_METHOD _CNV_R_R_Def_f_ub_b_595_CM "Def_f_ub_b127p5" RAT_FUNC "%6.3" "%" COEFFS 0. 2. 0. 0. 0. 1. /end COMPU_METHOD
/begin COMPU_METHOD _CNV_R_R_Def_u_sb_q_598_CM "Def_u_sb_q0p0942" RAT_FUNC "%6.3" "V" COEFFS 0. 1. 0. 0. 0. 9.420000000000001e-002 /end COMPU_METHOD
/begin COMPU_METHOD _CNV_R_R_Def_zw_sw__599_CM "Def_zw_sw_q0p1" RAT_FUNC "%6.3" "°" COEFFS 0. 10. 0. 0. 0. 1. /end COMPU_METHOD
/begin COMPU_METHOD _CNV_R_R_Def_exwink_601_CM "Def_exwink_uw_q0p022" RAT_FUNC "%6.3" "°" COEFFS 0. 8192. 0. 0. 0. 180. /end COMPU_METHOD
/begin COMPU_METHOD _CNV_R_R_Def_f_ub_b_602_CM "Def_f_ub_b100" RAT_FUNC "%6.3" "%" COEFFS 0. 256. 0. 0. 0. 100. /end COMPU_METHOD
/begin COMPU_METHOD _CNV_R_R_Def_hub_uw_605_CM "Def_hub_uw_q0p001" RAT_FUNC "%6.3" "mm" COEFFS 0. 1000. 0. 0. 0. 1. /end COMPU_METHOD
/begin COMPU_METHOD _CNV_R_R_Def_f_sw_b_608_CM "Def_f_sw_b2" RAT_FUNC "%6.3" "-" COEFFS 0. 65536. 0. 0. 0. 4. /end COMPU_METHOD
/begin COMPU_METHOD _CNV_R_R_Def_f_ub_b_609_CM "Def_f_ub_b0p5" RAT_FUNC "%6.3" "-" COEFFS 0. 256. 0. 0. 0. 0.5 /end COMPU_METHOD
/begin COMPU_METHOD _CNV_R_R_Def_ms_uw__611_CM "Def_ms_uw_q0p03125" RAT_FUNC "%6.3" "kg/h" COEFFS 0. 32. 0. 0. 0. 1. /end COMPU_METHOD
/begin COMPU_METHOD _CNV_R_R_Def_n_sw_q_612_CM "Def_n_sw_q1p0" RAT_FUNC "%6.3" "Upm" COEFFS 0. 1. 0. 0. 0. 1. /end COMPU_METHOD
/begin COMPU_METHOD _CNV_R_R_Def_p_sw_q_614_CM "Def_p_sw_q0p078" RAT_FUNC "%6.3" "hPa" COEFFS 0. 256. 0. 0. 0. 20. /end COMPU_METHOD
/begin COMPU_METHOD _CNV_R_R_Def_rf_sw__616_CM "Def_rf_sw_q0p01" RAT_FUNC "%6.3" "%" COEFFS 0. 100. 0. 0. 0. 1. /end COMPU_METHOD
/begin COMPU_METHOD _CNV_R_R_Def_eta_sw_617_CM "Def_eta_sw_b200" RAT_FUNC "%6.3" "%" COEFFS 0. 32768. 0. 0. 0. 200. /end COMPU_METHOD
/begin COMPU_METHOD _CNV_R_R_Def_t_sw_q_618_CM "Def_t_sw_q0p1" RAT_FUNC "%6.3" "°C" COEFFS 0. 10. 0. 0. 0. 1. /end COMPU_METHOD
/begin COMPU_METHOD _CNV_R_R_Def_td_sw__619_CM "Def_td_sw_q0p004" RAT_FUNC "%6.3" "ms" COEFFS 0. 250. 0. 0. 0. 1. /end COMPU_METHOD
/begin COMPU_METHOD _CNV_R_R_Def_t_sw_q_620_CM "Def_t_sw_q0p01" RAT_FUNC "%6.3" "°C" COEFFS 0. 100. 0. 0. 0. 1. /end COMPU_METHOD
/begin COMPU_METHOD _CNV_R_R_Def_kw_sw__622_CM "Def_kw_sw_q0p0234" RAT_FUNC "%6.3" "°KW" COEFFS 0. 256. 0. 0. 0. 6. /end COMPU_METHOD
/begin COMPU_METHOD _CNV_R_R_Def_f_ub_b_625_CM "Def_f_ub_b2" RAT_FUNC "%6.3" "-" COEFFS 0. 256. 0. 0. 0. 2. /end COMPU_METHOD
/begin COMPU_METHOD _CNV_R_R_Def_eta_uw_627_CM "Def_eta_uw_b200" RAT_FUNC "%6.3" "%" COEFFS 0. 65536. 0. 0. 0. 200. /end COMPU_METHOD
/begin COMPU_METHOD _CNV_R_R_Def_eta_sw_628_CM "Def_eta_sw_q0p00305" RAT_FUNC "%6.3" "%" COEFFS 0. 32767. 0. 0. 0. 100. /end COMPU_METHOD
/begin COMPU_METHOD _CNV_R_R_Def_f_uw_b_630_CM "Def_f_uw_b2048" RAT_FUNC "%6.3" "-" COEFFS 0. 65536. 0. 0. 0. 2048. /end COMPU_METHOD
/begin COMPU_METHOD _CNV_R_R_Def_f_sw_b_634_CM "Def_f_sw_b64" RAT_FUNC "%6.3" "-" COEFFS 0. 65536. 0. 0. 0. 128. /end COMPU_METHOD
/begin COMPU_METHOD _CNV_R_R_Def_g_uw_b_640_CM "Def_g_uw_b128" RAT_FUNC "%6.3" "S" COEFFS 0. 512. 0. 0. 0. 1. /end COMPU_METHOD
/begin COMPU_METHOD _CNV_R_R_Def_i_sw_q_650_CM "Def_i_sw_q0p001" RAT_FUNC "%6.3" "A" COEFFS 0. 1000. 0. 0. 0. 1. /end COMPU_METHOD
/begin COMPU_METHOD _CNV_R_R_Def_f_sw_q_658_CM "Def_f_sw_q0p1" RAT_FUNC "%6.3" "-" COEFFS 0. 10. 0. 0. 0. 1. /end COMPU_METHOD
/begin COMPU_METHOD _CNV_R_R_Def_dez_ub_667_CM "Def_dez_ub_q0p5" RAT_FUNC "%6.3" "-" COEFFS 0. 2. 0. 0. 0. 1. /end COMPU_METHOD
/begin COMPU_METHOD _CNV_R_R_Def_f_ub_b_670_CM "Def_f_ub_b4" RAT_FUNC "%6.3" "-" COEFFS 0. 256. 0. 0. 0. 4. /end COMPU_METHOD
/begin COMPU_METHOD _CNV_R_R_Def_td_uw__679_CM "Def_td_uw_q0p01" RAT_FUNC "%6.3" "s" COEFFS 0. 100. 0. 0. 0. 1. /end COMPU_METHOD
/begin COMPU_METHOD _CNV_R_R_Def_p_uw_q_685_CM "Def_p_uw_q0p0061" RAT_FUNC "%6.3" "MPa" COEFFS 0. 65536. 0. 0. 0. 40. /end COMPU_METHOD
/begin COMPU_METHOD _CNV_R_R_Def_pe_uw__687_CM "Def_pe_uw_b1000" RAT_FUNC "%6.3" "kW" COEFFS 0. 65536. 0. 0. 0. 1000. /end COMPU_METHOD
/begin COMPU_METHOD _CNV_R_R_Def_vs_uw__693_CM "Def_vs_uw_b10000" RAT_FUNC "%6.3" "l/h" COEFFS 0. 65536. 0. 0. 0. 10000. /end COMPU_METHOD
/begin COMPU_METHOD _CNV_R_R_Def_r_uw_b_694_CM "Def_r_uw_b2" RAT_FUNC "%6.3" "Ohm" COEFFS 0. 32768. 0. 0. 0. 1. /end COMPU_METHOD
/begin COMPU_METHOD _CNV_R_R_Def_rk_uw__696_CM "Def_rk_uw_b16" RAT_FUNC "%6.3" "-" COEFFS 0. 2048. 0. 0. 0. 1. /end COMPU_METHOD
/begin COMPU_METHOD _CNV_R_R_Def_rk_sw__697_CM "Def_rk_sw_b1600" RAT_FUNC "%6.3" "%" COEFFS 0. 2048. 0. 0. 0. 100. /end COMPU_METHOD
/begin COMPU_METHOD _CNV_S_2_Def_bit_ub_700_CM "Def_bit_ub_0" TAB_VERB "%6.3" "-" COMPU_TAB_REF _CNV_S_2_Def_bit_ub_700 /end COMPU_METHOD
/begin COMPU_VTAB _CNV_S_2_Def_bit_ub_700 "Def_bit_ub_0" TAB_VERB 2 0 "FALSE" 1 "TRUE" /end COMPU_VTAB
/begin COMPU_METHOD _CNV_S_2_Def_bit_ub_701_CM "Def_bit_ub_1" TAB_VERB "%6.3" "-" COMPU_TAB_REF _CNV_S_2_Def_bit_ub_701 /end COMPU_METHOD
/begin COMPU_VTAB _CNV_S_2_Def_bit_ub_701 "Def_bit_ub_1" TAB_VERB 2 0 "FALSE" 2 "TRUE" /end COMPU_VTAB
/begin COMPU_METHOD _CNV_S_2_Def_bit_ub_702_CM "Def_bit_ub_2" TAB_VERB "%6.3" "-" COMPU_TAB_REF _CNV_S_2_Def_bit_ub_702 /end COMPU_METHOD
/begin COMPU_VTAB _CNV_S_2_Def_bit_ub_702 "Def_bit_ub_2" TAB_VERB 2 0 "FALSE" 4 "TRUE" /end COMPU_VTAB
/begin COMPU_METHOD _CNV_S_2_Def_bit_ub_703_CM "Def_bit_ub_3" TAB_VERB "%6.3" "-" COMPU_TAB_REF _CNV_S_2_Def_bit_ub_703 /end COMPU_METHOD
/begin COMPU_VTAB _CNV_S_2_Def_bit_ub_703 "Def_bit_ub_3" TAB_VERB 2 0 "FALSE" 8 "TRUE" /end COMPU_VTAB
/begin COMPU_METHOD _CNV_S_2_Def_bit_ub_704_CM "Def_bit_ub_4" TAB_VERB "%6.3" "-" COMPU_TAB_REF _CNV_S_2_Def_bit_ub_704 /end COMPU_METHOD
/begin COMPU_VTAB _CNV_S_2_Def_bit_ub_704 "Def_bit_ub_4" TAB_VERB 2 0 "FALSE" 16 "TRUE" /end COMPU_VTAB
/begin COMPU_METHOD _CNV_S_2_Def_bit_ub_705_CM "Def_bit_ub_5" TAB_VERB "%6.3" "-" COMPU_TAB_REF _CNV_S_2_Def_bit_ub_705 /end COMPU_METHOD
/begin COMPU_VTAB _CNV_S_2_Def_bit_ub_705 "Def_bit_ub_5" TAB_VERB 2 0 "FALSE" 32 "TRUE" /end COMPU_VTAB
/begin COMPU_METHOD _CNV_S_2_Def_bit_ub_706_CM "Def_bit_ub_6" TAB_VERB "%6.3" "-" COMPU_TAB_REF _CNV_S_2_Def_bit_ub_706 /end COMPU_METHOD
/begin COMPU_VTAB _CNV_S_2_Def_bit_ub_706 "Def_bit_ub_6" TAB_VERB 2 0 "FALSE" 64 "TRUE" /end COMPU_VTAB
/begin COMPU_METHOD _CNV_S_2_Def_bit_ub_707_CM "Def_bit_ub_7" TAB_VERB "%6.3" "-" COMPU_TAB_REF _CNV_S_2_Def_bit_ub_707 /end COMPU_METHOD
/begin COMPU_VTAB _CNV_S_2_Def_bit_ub_707 "Def_bit_ub_7" TAB_VERB 2 0 "FALSE" 128 "TRUE" /end COMPU_VTAB
/begin COMPU_METHOD _CNV_R_R_Def_td_uw__726_CM "Def_td_uw_q0p2" RAT_FUNC "%6.3" "s" COEFFS 0. 5. 0. 0. 0. 1. /end COMPU_METHOD
/begin COMPU_METHOD _CNV_R_R_Def_tv_ub__729_CM "Def_tv_ub_q10" RAT_FUNC "%6.3" "%" COEFFS 0. 10. 0. 0. 0. 100. /end COMPU_METHOD
/begin COMPU_METHOD _CNV_R_R_Def_u_uw_q_731_CM "Def_u_uw_q0p1" RAT_FUNC "%6.3" "V" COEFFS 0. 10. 0. 0. 0. 1. /end COMPU_METHOD
/begin COMPU_METHOD _CNV_R_R_Def_u_uw_q_734_CM "Def_u_uw_q0p00488" RAT_FUNC "%6.3" "V" COEFFS 0. 1024. 0. 0. 0. 5. /end COMPU_METHOD
/begin COMPU_METHOD _CNV_R_R_Def_u_uw_q_735_CM "Def_u_uw_q0p015" RAT_FUNC "%6.3" "V" COEFFS 0. 200. 0. 0. 0. 3. /end COMPU_METHOD
/begin COMPU_METHOD _CNV_R_R_Def_v_uw_q_737_CM "Def_v_uw_q1p0" RAT_FUNC "%6.3" "km/h" COEFFS 0. 1. 0. 0. 0. 1. /end COMPU_METHOD
/begin COMPU_METHOD _CNV_R_R_Def_f_uw_b_739_CM "Def_f_uw_b3000" RAT_FUNC "%6.3" "-" COEFFS 0. 65536. 0. 0. 0. 3000. /end COMPU_METHOD
/begin COMPU_METHOD _CNV_R_R_Def_vs_uw__745_CM "Def_vs_uw_b1280" RAT_FUNC "%6.3" "m^3/h" COEFFS 0. 65536. 0. 0. 0. 1280. /end COMPU_METHOD
/begin COMPU_METHOD _CNV_R_R_Def_exwink_746_CM "Def_exwink_ub_q0p703" RAT_FUNC "%6.3" "°" COEFFS 0. 256. 0. 0. 0. 180. /end COMPU_METHOD
/begin COMPU_METHOD _CNV_R_R_Def_zw_ub__748_CM "Def_zw_ub_q0p75" RAT_FUNC "%6.3" "°" COEFFS 0. -1. 0. 0. 0. 0.75 /end COMPU_METHOD
/begin COMPU_METHOD _CNV_R_R_Def_f_ub_b_753_CM "Def_f_ub_b8" RAT_FUNC "%6.3" "-" COEFFS 0. 256. 0. 0. 0. 8. /end COMPU_METHOD
/begin COMPU_METHOD _CNV_R_R_Def_f_ub_b_754_CM "Def_f_ub_b16" RAT_FUNC "%6.3" "-" COEFFS 0. 256. 0. 0. 0. 16. /end COMPU_METHOD
/begin COMPU_METHOD _CNV_R_R_Def_i_uw_b_760_CM "Def_i_uw_b256" RAT_FUNC "%6.3" "A" COEFFS 0. 256. 0. 0. 0. 1. /end COMPU_METHOD
/begin COMPU_METHOD _CNV_R_R_Def_l_uw_b_776_CM "Def_l_uw_b16" RAT_FUNC "%6.3" "mH" COEFFS 0. 4096. 0. 0. 0. 1. /end COMPU_METHOD
/begin RECORD_LAYOUT _REC_VAL_20_u1 FNC_VALUES 1 UBYTE COLUMN_DIR DIRECT /end RECORD_LAYOUT
/begin RECORD_LAYOUT _REC_VAL_20_u2 FNC_VALUES 1 UWORD COLUMN_DIR DIRECT /end RECORD_LAYOUT
/begin RECORD_LAYOUT _REC_VAL_20_s2 FNC_VALUES 1 SWORD COLUMN_DIR DIRECT /end RECORD_LAYOUT
/begin RECORD_LAYOUT _REC_MAP_52_UBYTE_s2_s2_u2 NO_AXIS_PTS_X 1 UBYTE NO_AXIS_PTS_Y 2 UBYTE AXIS_PTS_X 3 SWORD INDEX_INCR DIRECT AXIS_PTS_Y 4 UWORD INDEX_INCR DIRECT FNC_VALUES 5 SWORD COLUMN_DIR DIRECT /end RECORD_LAYOUT
/begin RECORD_LAYOUT _REC_MAP_52_UBYTE_u2_s2_s2 NO_AXIS_PTS_X 1 UBYTE NO_AXIS_PTS_Y 2 UBYTE AXIS_PTS_X 3 SWORD INDEX_INCR DIRECT AXIS_PTS_Y 4 SWORD INDEX_INCR DIRECT FNC_VALUES 5 UWORD COLUMN_DIR DIRECT /end RECORD_LAYOUT
/begin RECORD_LAYOUT _REC_MAP_52_UBYTE_u2_u2_u2 NO_AXIS_PTS_X 1 UBYTE NO_AXIS_PTS_Y 2 UBYTE AXIS_PTS_X 3 UWORD INDEX_INCR DIRECT AXIS_PTS_Y 4 UWORD INDEX_INCR DIRECT FNC_VALUES 5 UWORD COLUMN_DIR DIRECT /end RECORD_LAYOUT
/begin RECORD_LAYOUT _REC_MAP_52_u1_s2_s2 NO_AXIS_PTS_X 1 UBYTE NO_AXIS_PTS_Y 2 UBYTE AXIS_PTS_X 3 SWORD INDEX_INCR DIRECT AXIS_PTS_Y 4 SWORD INDEX_INCR DIRECT FNC_VALUES 5 UBYTE COLUMN_DIR DIRECT /end RECORD_LAYOUT
/begin RECORD_LAYOUT _REC_MAP_52_UBYTE_s2_s2_s2 NO_AXIS_PTS_X 1 UBYTE NO_AXIS_PTS_Y 2 UBYTE AXIS_PTS_X 3 SWORD INDEX_INCR DIRECT AXIS_PTS_Y 4 SWORD INDEX_INCR DIRECT FNC_VALUES 5 SWORD COLUMN_DIR DIRECT /end RECORD_LAYOUT
/begin RECORD_LAYOUT _REC_MAP_52_UBYTE_s2_u2_u2 NO_AXIS_PTS_X 1 UBYTE NO_AXIS_PTS_Y 2 UBYTE AXIS_PTS_X 3 UWORD INDEX_INCR DIRECT AXIS_PTS_Y 4 UWORD INDEX_INCR DIRECT FNC_VALUES 5 SWORD COLUMN_DIR DIRECT /end RECORD_LAYOUT
/begin RECORD_LAYOUT _REC_MAP_52_u1_u2_u2 NO_AXIS_PTS_X 1 UBYTE NO_AXIS_PTS_Y 2 UBYTE AXIS_PTS_X 3 UWORD INDEX_INCR DIRECT AXIS_PTS_Y 4 UWORD INDEX_INCR DIRECT FNC_VALUES 5 UBYTE COLUMN_DIR DIRECT /end RECORD_LAYOUT
/begin RECORD_LAYOUT _REC_MAP_52_u1_s2_u2 NO_AXIS_PTS_X 1 UBYTE NO_AXIS_PTS_Y 2 UBYTE AXIS_PTS_X 3 SWORD INDEX_INCR DIRECT AXIS_PTS_Y 4 UWORD INDEX_INCR DIRECT FNC_VALUES 5 UBYTE COLUMN_DIR DIRECT /end RECORD_LAYOUT
/begin RECORD_LAYOUT _REC_CUR_TKL_UW_VV__u2_u2 NO_AXIS_PTS_X 1 UBYTE RESERVED 2 BYTE AXIS_PTS_X 3 UWORD INDEX_INCR DIRECT FNC_VALUES 4 UWORD COLUMN_DIR DIRECT /end RECORD_LAYOUT
/begin RECORD_LAYOUT _REC_CUR_TKL_UW_VV__u2_s2 NO_AXIS_PTS_X 1 UBYTE RESERVED 2 BYTE AXIS_PTS_X 3 SWORD INDEX_INCR DIRECT FNC_VALUES 4 UWORD COLUMN_DIR DIRECT /end RECORD_LAYOUT
/begin RECORD_LAYOUT _REC_CUR_TKL_UW_VV__u1_s2 NO_AXIS_PTS_X 1 UBYTE RESERVED 2 BYTE AXIS_PTS_X 3 SWORD INDEX_INCR DIRECT FNC_VALUES 4 UBYTE COLUMN_DIR DIRECT /end RECORD_LAYOUT
/begin RECORD_LAYOUT _REC_CUR_TKL_UW_VV__u1_u2 NO_AXIS_PTS_X 1 UBYTE RESERVED 2 BYTE AXIS_PTS_X 3 UWORD INDEX_INCR DIRECT FNC_VALUES 4 UBYTE COLUMN_DIR DIRECT /end RECORD_LAYOUT
/begin RECORD_LAYOUT _REC_CUR_TKL_UW_VV__s2_u2 NO_AXIS_PTS_X 1 UBYTE RESERVED 2 BYTE AXIS_PTS_X 3 UWORD INDEX_INCR DIRECT FNC_VALUES 4 SWORD COLUMN_DIR DIRECT /end RECORD_LAYOUT
/begin RECORD_LAYOUT _REC_CUR_TKL_UW_VV__s2_s2 NO_AXIS_PTS_X 1 UBYTE RESERVED 2 BYTE AXIS_PTS_X 3 SWORD INDEX_INCR DIRECT FNC_VALUES 4 SWORD COLUMN_DIR DIRECT /end RECORD_LAYOUT
/begin RECORD_LAYOUT _REC_CUR_TKL_UW_VV__u1_u1 NO_AXIS_PTS_X 1 UBYTE RESERVED 2 BYTE AXIS_PTS_X 3 UBYTE INDEX_INCR DIRECT FNC_VALUES 4 UBYTE COLUMN_DIR DIRECT /end RECORD_LAYOUT
/begin RECORD_LAYOUT _REC_VAL_2_u1 FNC_VALUES 1 UBYTE COLUMN_DIR DIRECT /end RECORD_LAYOUT
/begin FUNCTION SS_EXP ""
 /begin DEF_CHARACTERISTIC K_ETA_MIN K_FSICHER_MAN K_MDK_EXT_MINUS K_MDK_EXT_PLUS K_MINHUB K_RF_MAX /end DEF_CHARACTERISTIC
 /begin OUT_MEASUREMENT Agr_rate B_dtes Ba_switch_uek Ctrpwrentl Exwink_ist Exwinkkor F_sicher_rf F_sicher_zw F_spr_ba F_teblg Gen_i_temp Lurabs_f Lurdif_f Mdi_ist_m Mdi_res_hom_mag Mdk_ext_minus Mdk_ext_plus Minhub Ms_hub_inv Mszyl_hub_inv Ptc_entl Rf_max Rkukg Segkorroff Segkorron St_bv_kath St_bv_kath.B_hsplit_akt St_bv_kath.B_nesps_akt St_bv_kath.B_zwkh_akt St_dvvt0 St_dvvt0.B_btvvta_ena St_dvvt0.B_evvt_vsa St_dvvt0.B_evvt_vse St_dvvt1 St_dvvt1.B_vvtnotl St_dvvt2 St_ewp1 St_hubkor St_hubkor.B_hubkor St_hubkor_5ms St_hubkor_5ms.B_hubistkor St_khm St_khm.B_khm_h St_khm.B_khm_hs St_khm.B_khm_s St_minhubad0 St_minhubad0.B_mdarv St_pmentl0 St_pmentl0.B_entl St_pmentl0.B_pwrentl St_pr St_pr.B_prsoll_h St_rf St_rf.B_rfmin St_sa St_sa.B_ums_vbsa St_sa.B_vbbmw_sa St_tan St_tan.B_taners St_varkat St_varkat.B_varkat St_vvtlr St_vvtlr.B_vvtad Tabg_sensturb1 Tabg_sensturb2 U_rampentl U_sollentl Vvtaet Wkrm /end OUT_MEASUREMENT
/end FUNCTION
/begin FUNCTION SZCAL ""
 /begin DEF_CHARACTERISTIC KF_IZGRUND KF_IZLIMMAX KF_IZLIMMIN KF_ZESK KF_ZFOFUHOM KF_ZFOFUSCHI KL_BDGRUND KL_IZGRUND KL_LN KL_QUADRATW KL_SPULR KL_SZOLD K_BDFFMAX K_BDFFMIN K_IFFMAX K_IFFMIN K_LSPULE K_R_KBB K_TMOTKALT K_ZKZSTART S_SZOLD /end DEF_CHARACTERISTIC
 /begin OUT_MEASUREMENT Bd_fofu G_zspul I_zlim I_zuend R_spul Rk St_szcal0 St_szcal0.B_zstart Sz Sz_ffmax Sz_ffmin Sz_fofu Z_fofu /end OUT_MEASUREMENT
/end FUNCTION
/begin FUNCTION UBW ""
 /begin DEF_CHARACTERISTIC KL_UBW_ULOFFSET KL_UBW_USOFFSET K_LZR_DOWN K_LZR_MAX K_SZR_DOWN K_SZR_MAX K_UBW_DELAY K_UBW_DFMAX K_UBW_DFMIN K_UBW_DZR K_UBW_NKWSCH K_UBW_TABL K_UBW_ULMN K_UBW_ULMNIL K_UBW_ULMNOFF K_UBW_USMN K_UBW_USMNIL K_UBW_USMNOFF K_UBW_USZRMX K_UBW_ZKL K_UBW_ZKSMN K_UBW_ZKSMX /end DEF_CHARACTERISTIC
 /begin OUT_MEASUREMENT St_ubw St_ubw.B_ubw_aktiv St_ubw.B_ubw_ullow St_ubw.B_ubw_ulow Ubw_uszr Ubw_zr Ulzr Uszr /end OUT_MEASUREMENT
/end FUNCTION
/begin FUNCTION UGENKOR ""
 /begin DEF_CHARACTERISTIC CW_BNSUMAX CW_GENOFFSLP K_APP_UGEN K_ENGENTOGGL K_GENOFFTIME K_GENUMAX K_GENURAMP K_GENURAMPOF K_GEN_APPUG K_PMSA_DEC K_PMSA_INC K_PMSA_RST K_PMSA_SET K_TDGENOFFST K_T_IGRNACHL K_T_VERBON K_UBNS K_UGENDELTA K_UGENMAXE65 K_UGENOFF K_UGENOFFSTART K_UGENOFFV0 K_U_BNMAX K_U_IGRRAMP S_ENTLENA S_GENOFFSTART S_GOFFRAMP S_IGRLOW /end DEF_CHARACTERISTIC
 /begin OUT_MEASUREMENT Pmigrlowctr St_ugenkor0 St_ugenkor0.B_1stugen St_ugenkor0.B_genoff St_ugenkor0.B_genoff2 St_ugenkor0.B_genoffok St_ugenkor0.B_genoffout St_ugenkor0.B_noctrgen St_ugenkor0.B_ugenini St_ugenkor0.B_verb_off St_ugenkor1 St_ugenkor1.B_gentoggl St_ugenkor2 St_ugenkor2.B_saaktiv St_ugenkor2.B_saset T_batt U_gen U_gen2 U_gen_igr U_gsoll U_gsoll_off U_gsoll_tp U_gsoll_tp2 U_gsoll_tp3 U_gsollred U_gsolltmp Ugin_fq /end OUT_MEASUREMENT
/end FUNCTION
/begin FUNCTION ULVOUT ""
 /begin DEF_CHARACTERISTIC KF_FULVPUMP KF_FULVUES KF_ULVUES KL_TVULV_DN KL_TVULV_UP KL_ULVDYN K_FKTVULVP K_TVULV K_TVULVPUMP1 K_TVULVPUMP2 K_TVULVPUMP3 S_TVULV_MAN /end DEF_CHARACTERISTIC
 /begin OUT_MEASUREMENT Tvulv Tvulvpump Tvulvpump23 /end OUT_MEASUREMENT
/end FUNCTION
/begin FUNCTION ULVREG "" /begin DEF_CHARACTERISTIC KF_ULVVST KF_ULVVST_K KL_ULVVST_P KL_ULVVST_T S_ULVVST_OFF /end DEF_CHARACTERISTIC /begin OUT_MEASUREMENT Ulvr Ulvr_d Ulvr_i Ulvr_p Ulvvst /end OUT_MEASUREMENT /end FUNCTION
/begin FUNCTION WES "" /begin DEF_CHARACTERISTIC KL_WESNESPR /end DEF_CHARACTERISTIC /begin OUT_MEASUREMENT Wes Wesnesprau /end OUT_MEASUREMENT /end FUNCTION
/begin FUNCTION WESE ""
 /begin DEF_CHARACTERISTIC KF_DTES12_S KF_DWESB1TM_H KF_DWESE2TM_H KF_DWESE2_H KF_DWESEST_H KF_DWESE_HS KF_DWESE_S KF_TES12_S KF_WESB1NL_H KF_WESB1_H KF_WESB1_HS KF_WESBST_H KF_WESE2_H KL_DWESB1P_H KL_DWESE2P_H K_DWESE2APP_H K_DWESEAPP_HS K_DWESEAPP_S K_TES12APP_S K_TESMIN K_UFAKRKTI K_WESB1APP_H K_WESB1APP_HS K_WESB3APP_S K_WESB3MAX_S K_WESB3MIN_S K_WESE2APP_H S_DWESE2APP_H S_DWESEAPP_HS S_DWESEAPP_S S_TES12APP_S S_WESB1APP_H S_WESB1APP_HS S_WESB3APP_S S_WESE2ABS_H S_WESE2APP_H /end DEF_CHARACTERISTIC
 /begin OUT_MEASUREMENT Dtes12_s Dwese2_bas_h Dwese2_h Dwese_hs Dwese_s Dwesest_h St_wese St_wese.B_tesmin12 St_wese.B_wese2h_abs T_es12_hs T_es12_s Td_wese Wesb1_bas_h Wesb1_h Wesb1_hs Wesb3_kh_s Wesb3_s Wesbst_h Wese2_bas_h Wese2_h Wese2_hs Wese2_s Wese_s /end OUT_MEASUREMENT
/end FUNCTION
/begin FUNCTION WMEWAPU ""
 /begin DEF_CHARACTERISTIC KF_EWPFCL_DI KF_EWPFCOOL K_ETA_EWPGETR K_EWP_CALV K_EWP_MN K_EWP_MX K_FV_EWPGETR K_WMKVDFAK /end DEF_CHARACTERISTIC
 /begin OUT_MEASUREMENT Ag_ewp_help_1 Ag_ewp_help_2 Ag_ewp_help_3 Ag_ewp_help_4 Ag_ewp_help_5 F_ewp_co Mdk_ewp Vs_ewp_ag Vs_ewp_mot Vs_ewp_of Vskr_ewp_ist kvaverbr_help /end OUT_MEASUREMENT
/end FUNCTION
/begin FUNCTION WMKFT ""
 /begin DEF_CHARACTERISTIC KL_KFT_PLOC K_KFT_D K_KFT_I K_KFT_IMN K_KFT_IMX K_KFT_REGMN K_KFT_REGMX /end DEF_CHARACTERISTIC
 /begin OUT_MEASUREMENT Dtkwsoll Kft_d Kft_i Kft_p Kft_p_loc Kft_status Tkwsoll Tv_kft Tvkft /end OUT_MEASUREMENT
/end FUNCTION
/begin FUNCTION WMPRIO ""
 /begin DEF_CHARACTERISTIC KF_GBTR KL_VTANS K_BA_WMAPPL K_BEQSANFMN K_EWPACMX K_EWPTWAlMX K_EWPWACAL K_EWPWAKOR K_EWPWA_B K_EWP_PE K_EWP_QS K_EWP_TDPE K_EWP_TDQS K_MDKEWPTDLP K_NKW_MN K_PRIO_WMBA K_TGBSMX K_TGET_MN K_TGET_MX K_TGNFKSMX K_TMBSMX K_TMHEIZMN K_TMNFKSMX K_TOBSMX K_TOHKMX K_TONFKSMX K_TUHEIZMN K_VNFKSMN K_WMTANSHYS K_WMTMTGHYS K_WMTM_ER K_WMTOHYS K_WMTU_1 K_WMTU_2 K_ZAEHL_PWG S_EWPDIAG /end DEF_CHARACTERISTIC
 /begin OUT_MEASUREMENT Ba_wm_ist Ba_wm_prio Ba_wm_soll Bapr_wm_appl Bapr_wm_bfel Bapr_wm_bs Bapr_wm_gbtr Bapr_wm_heizl Bapr_wm_nfks Bapr_wm_warm Baw_wm_heizl Mdk_ewp_help Nkw_help_pe Pe St_wmprio St_wmprio.B_ewptmwae St_wmprio.B_ewpwae St_wmprio.B_fi_eluee St_wmprio.B_fi_tmot St_wmprio.B_heiz_prio St_wmprio.B_pwg_ist St_wmprio.B_tmheiz St_wmprio.B_tuheiz St_wmprio0 St_wmprio0.B_ewp_pe St_wmprio0.B_ewp_qs St_wmprio0.B_ewp_vs St_wmprio0.B_help_pe St_wmprio0.B_help_qs St_wmprio0.B_n46 St_wmprio0.B_nkwtget St_wmprio0.B_pwg90 Tmot_wm Vs_ewpkaac Vs_ewpvbz Zahler_pwg /end OUT_MEASUREMENT
/end FUNCTION
/begin FUNCTION WMSCHALT ""
 /begin DEF_CHARACTERISTIC CW_HEIZART KF_KUEHLN KF_KUEHLPIMX KF_MDRES_WM KF_TMSTMDRES KL_EL_TGET KL_EL_TKA KL_EL_TMOT KL_EL_TWR1 KL_EL_V KL_EWP_VBE KL_EWP_VBSD KL_KFT_HI KL_KFT_HK KL_KUEHLGET KL_NEL_PWM KL_TGMDKLIMA KL_TMMDKLIMA KL_TMQSANF KL_TOMDKLIMA K_BEZAEHLUG K_BHZ_AP K_BLKLPS_AP K_EL_ECO K_EL_HI K_EL_HK K_EL_KHL1 K_EL_NO K_EL_TDLP K_EWPTMST K_EWPTUST K_EWP_AP K_EWP_EC K_EWP_HI K_EWP_HK K_EWP_MDKMN K_EWP_MN1 K_EWP_NO K_EWP_TDMD K_EWP_WA K_FAK_MX K_F_EWPTDLP1 K_F_EWPTDLP2 K_F_QSANF K_F_QSANFAUT K_KFT_AP K_KFT_NK K_KFT_NO K_KFT_WA K_LKLPS_NEL K_LKLPS_TU1 K_LKLPS_TU2 K_MAT_BHZ K_MAT_EGS K_MAT_ELUEFT K_MAT_EWP K_MAT_KFT K_MAT_LKLPS K_MAT_MDAC K_MAT_MDRED K_MAT_MDRES K_MAT_TV K_MAT_WARN1 K_MAT_WARN2 K_MAT_WARN3 K_MDKLIMA_AP K_MDKUEHL_AP K_MDRES_AP K_MMI_ZEIT1 K_MMI_ZEIT2 K_NEL_AP K_NEL_NTLKS K_NTLKWS_AP K_TMWARNMN K_TMWARN_1 K_TMWARN_2 K_TMWARN_HYS K_TOWARN_1 K_TOWARN_2 K_TOWARN_3 K_TOWARN_HYS K_TVAV_AP K_TVAV_BE K_TVAV_BS K_TVAV_NK K_WARN1_AP K_WARN2_AP K_WARN3_AP S_EL_GEN /end DEF_CHARACTERISTIC
 /begin OUT_MEASUREMENT F_kuehln F_kuehlvred F_mdres_wm F_nelueft_v Md_kuehl_ap Md_kuehl_wa Md_max_klima Mdi_res_he Mdi_res_he1 Mdi_res_he2 Mdi_res_he3 Mdi_res_wm Mdk_kuehl_help Mdk_kuehl_mx Nelueft_eco Nelueft_ext_h1 Nelueft_ext_h2 Nelueft_genh Nelueft_h3 Nelueft_hi Nelueft_hk Nelueft_khl1 Nelueft_local Nelueft_no Nelueft_pwm Nelueft_tget Nelueft_tka Nelueft_tmot Nelueft_twr1 Nelueft_wa Nelueft_wm Newp_soll Pi_kuehlmx Pi_kuehlmx_1 Pi_max Qs_anf Qs_anf_sw St_wm1 St_wm1.B_lklps St_wm1.B_lklps1 St_wm1.B_ntlkws St_wm1.B_tmmi_warn1 St_wm1.B_tmmi_warn2 St_wm1.B_tmmi_warn3 St_wmschalt0 St_wmschalt0.B_beende St_wmschalt0.B_hz_wm St_wmschalt0.B_wm_stat St_wmschalt0.B_wm_stat2 T_eltd_h1 T_eltd_h2 Tget_b1 Tget_b2 Tget_b3 Tget_b4 Tget_b5 Tget_stat Tget_stat_b1 Tget_stat_b2 Tget_stat_b3 Tget_stat_b4 Tget_stat_b5 Tget_stat_help1 Tget_stat_help2 Tget_stat_help3 Tget_stat_help4 Tget_stat_help5 Tget_sum Tget_wm Tmot_b1 Tmot_b2 Tmot_b3 Tmot_b4 Tmot_b5 Tmot_stat Tmot_stat_b1 Tmot_stat_b2 Tmot_stat_b3 Tmot_stat_b4 Tmot_stat_b5 Tmot_stat_help1 Tmot_stat_help2 Tmot_stat_help3 Tmot_stat_help4 Tmot_stat_help5 Tmot_sum Toel_b1 Toel_b2 Toel_b3 Toel_b4 Toel_b5 Toel_stat Toel_stat_b1 Toel_stat_b2 Toel_stat_b3 Toel_stat_b4 Toel_stat_b5 Toel_stat_help1 Toel_stat_help2 Toel_stat_help3 Toel_stat_help4 Toel_stat_help5 Toel_sum Tumg_b1 Tumg_b2 Tumg_b3 Tumg_b4 Tumg_b5 Tumg_stat Tumg_stat_b1 Tumg_stat_b2 Tumg_stat_b3 Tumg_stat_b4 Tumg_stat_b5 Tumg_stat_help1 Tumg_stat_help2 Tumg_stat_help3 Tumg_stat_help4 Tumg_stat_help5 Tumg_sum Tv_av_heizkr Vs_eco_agsw Vs_eco_motsw Vs_ewp_bsd Vs_ewp_warml Vs_high_agsw Vs_high_motsw Vs_hkft_agsw Vs_hkft_motsw Vs_norm_agsw Vs_norm_motsw Zaehl_beug Zaehl_wm_sta /end OUT_MEASUREMENT
/end FUNCTION
/begin FUNCTION WMZUSTA ""
 /begin DEF_CHARACTERISTIC KL_FEWPW_BA KL_FEWP_BA KL_FKFTW_BA KL_FKFT_BA K_ZAEHLWE_UG K_ZAEHL_UG /end DEF_CHARACTERISTIC
 /begin OUT_MEASUREMENT F_ewp_ba F_ewpw_ba F_kft_ba F_kftw_ba Zaehl_w_ugwm Zaehler_ugwm /end OUT_MEASUREMENT
/end FUNCTION
/begin FUNCTION WM_NL ""
 /begin DEF_CHARACTERISTIC KF_NLELUEFT K_EWPNLTM1 K_EWPNLTM2 K_NLEWPMX K_NLKFTMX K_QSNLZAEHL K_RESTDELAY /end DEF_CHARACTERISTIC
 /begin OUT_MEASUREMENT St_wm_nl0 St_wm_nl0.B_nlewp_b1 St_wm_nl0.B_nlewp_b2 St_wm_nl0.B_nlewp_b3 St_wm_nl0.B_nlewp_b4 St_wm_nl0.B_nlqs1 St_wm_nl0.B_nlqs2 St_wm_nl0.B_nlqs3 St_wm_nl0.B_nlqs4 St_wm_nl1 St_wm_nl1.B_nlqs5 Zaehler_qsnl /end OUT_MEASUREMENT
/end FUNCTION
/begin FUNCTION WM_START "" /end FUNCTION
/begin FUNCTION ZWAUS ""
 /begin DEF_CHARACTERISTIC KF_DZWAGR_S KF_DZWRF_S KF_ZWBASDOE_HS KF_ZWBASDOE_S KF_ZWBAS_HS KF_ZWBAS_S KF_ZWMIN_HS KF_ZWOPT_HS KL_ETAZW_HS K_DZW_HS K_DZW_S K_ZWAPP_HS K_ZWAPP_S K_ZWMINHYS_HS S_ZWAPP_HS S_ZWAPP_S /end DEF_CHARACTERISTIC
 /begin OUT_MEASUREMENT Dzw_agr_s Dzw_hs Dzw_kr_hs Dzw_rf_s Etazw_hs St_zwaus St_zwaus.B_zwmin_hs Zw_bas_hs Zw_bas_s Zw_kor_hs Zw_kor_s Zw_korkr_hs Zw_min_hs Zw_opt_hs Zw_soll_hs Zw_soll_s Zw_sollm_hs /end OUT_MEASUREMENT
/end FUNCTION
/end MODULE
/end PROJECT
