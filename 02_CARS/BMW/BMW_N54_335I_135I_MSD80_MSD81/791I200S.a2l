ASAP2_VERSION 1 41
/begin PROJECT MSD85 "Spray Guided DI-System with Piezo Injectors for 8-Cylinder"
/begin HEADER "_default_HeaderComment" PROJECT_NO _91 /end HEADER
/begin MODULE _default_ModuleName "_default_ModuleLongIdentifier"
/begin MOD_COMMON "_default_ModCommonComment" DEPOSIT ABSOLUTE BYTE_ORDER MSB_LAST ALIGNMENT_BYTE 1 ALIGNMENT_WORD 2 ALIGNMENT_LONG 2 ALIGNMENT_FLOAT32_IEEE 2 ALIGNMENT_FLOAT64_IEEE 4 /end MOD_COMMON
/begin MEASUREMENT iga_av_mv "Mean value of actual ignition angle" UBYTE _CNV_A_R_LINEAR_____190_CM 1 100. -35.625 60. DISPLAY_IDENTIFIER IGA_AV_MV ECU_ADDRESS 0xd0008c24 FORMAT "%5.1" /end MEASUREMENT
/begin MEASUREMENT iga_igc[0] "Ignition angle applied on cylinder CYL" UBYTE _CNV_A_R_LINEAR_____190_CM 1 100. -35.625 60. DISPLAY_IDENTIFIER IGA_IGC[0] ECU_ADDRESS 0xd0008c28 FORMAT "%5.1" /end MEASUREMENT
/begin MEASUREMENT iga_igc[1] "Ignition angle applied on cylinder CYL" UBYTE _CNV_A_R_LINEAR_____190_CM 1 100. -35.625 60. DISPLAY_IDENTIFIER IGA_IGC[1] ECU_ADDRESS 0xd0008c29 FORMAT "%5.1" /end MEASUREMENT
/begin MEASUREMENT iga_igc[2] "Ignition angle applied on cylinder CYL" UBYTE _CNV_A_R_LINEAR_____190_CM 1 100. -35.625 60. DISPLAY_IDENTIFIER IGA_IGC[2] ECU_ADDRESS 0xd0008c2a FORMAT "%5.1" /end MEASUREMENT
/begin MEASUREMENT iga_igc[3] "Ignition angle applied on cylinder CYL" UBYTE _CNV_A_R_LINEAR_____190_CM 1 100. -35.625 60. DISPLAY_IDENTIFIER IGA_IGC[3] ECU_ADDRESS 0xd0008c2b FORMAT "%5.1" /end MEASUREMENT
/begin MEASUREMENT iga_igc[4] "Ignition angle applied on cylinder CYL" UBYTE _CNV_A_R_LINEAR_____190_CM 1 100. -35.625 60. DISPLAY_IDENTIFIER IGA_IGC[4] ECU_ADDRESS 0xd0008c2c FORMAT "%5.1" /end MEASUREMENT
/begin MEASUREMENT iga_igc[5] "Ignition angle applied on cylinder CYL" UBYTE _CNV_A_R_LINEAR_____190_CM 1 100. -35.625 60. DISPLAY_IDENTIFIER IGA_IGC[5] ECU_ADDRESS 0xd0008c2d FORMAT "%5.1" /end MEASUREMENT
/begin MEASUREMENT iga_igc[6] "Ignition angle applied on cylinder CYL" UBYTE _CNV_A_R_LINEAR_____190_CM 1 100. -35.625 60. DISPLAY_IDENTIFIER IGA_IGC[6] ECU_ADDRESS 0xd0008c2e FORMAT "%5.1" /end MEASUREMENT
/begin MEASUREMENT iga_igc[7] "Ignition angle applied on cylinder CYL" UBYTE _CNV_A_R_LINEAR_____190_CM 1 100. -35.625 60. DISPLAY_IDENTIFIER IGA_IGC[7] ECU_ADDRESS 0xd0008c2f FORMAT "%5.1" /end MEASUREMENT
/begin MEASUREMENT iga_av[0] "Ignition angle applied on cylinder CYL" UBYTE _CNV_A_R_LINEAR_____190_CM 1 100. -35.625 60. DISPLAY_IDENTIFIER IGA_AV[0] ECU_ADDRESS 0xd0008c30 FORMAT "%5.1" /end MEASUREMENT
/begin MEASUREMENT iga_av[1] "Ignition angle applied on cylinder CYL" UBYTE _CNV_A_R_LINEAR_____190_CM 1 100. -35.625 60. DISPLAY_IDENTIFIER IGA_AV[1] ECU_ADDRESS 0xd0008c31 FORMAT "%5.1" /end MEASUREMENT
/begin MEASUREMENT iga_av[2] "Ignition angle applied on cylinder CYL" UBYTE _CNV_A_R_LINEAR_____190_CM 1 100. -35.625 60. DISPLAY_IDENTIFIER IGA_AV[2] ECU_ADDRESS 0xd0008c32 FORMAT "%5.1" /end MEASUREMENT
/begin MEASUREMENT iga_av[3] "Ignition angle applied on cylinder CYL" UBYTE _CNV_A_R_LINEAR_____190_CM 1 100. -35.625 60. DISPLAY_IDENTIFIER IGA_AV[3] ECU_ADDRESS 0xd0008c33 FORMAT "%5.1" /end MEASUREMENT
/begin MEASUREMENT iga_av[4] "Ignition angle applied on cylinder CYL" UBYTE _CNV_A_R_LINEAR_____190_CM 1 100. -35.625 60. DISPLAY_IDENTIFIER IGA_AV[4] ECU_ADDRESS 0xd0008c34 FORMAT "%5.1" /end MEASUREMENT
/begin MEASUREMENT iga_av[5] "Ignition angle applied on cylinder CYL" UBYTE _CNV_A_R_LINEAR_____190_CM 1 100. -35.625 60. DISPLAY_IDENTIFIER IGA_AV[5] ECU_ADDRESS 0xd0008c35 FORMAT "%5.1" /end MEASUREMENT
/begin MEASUREMENT iga_av[6] "Ignition angle applied on cylinder CYL" UBYTE _CNV_A_R_LINEAR_____190_CM 1 100. -35.625 60. DISPLAY_IDENTIFIER IGA_AV[6] ECU_ADDRESS 0xd0008c36 FORMAT "%5.1" /end MEASUREMENT
/begin MEASUREMENT iga_av[7] "Ignition angle applied on cylinder CYL" UBYTE _CNV_A_R_LINEAR_____190_CM 1 100. -35.625 60. DISPLAY_IDENTIFIER IGA_AV[7] ECU_ADDRESS 0xd0008c37 FORMAT "%5.1" /end MEASUREMENT
/begin MEASUREMENT ti_add[0] "Total cylinder balancing additive correction value" SWORD _CNV_A_R_LINEAR_____228_CM 1 100. -32.768 32.767 DISPLAY_IDENTIFIER TI_ADD_0 ECU_ADDRESS 0xd000a208 FORMAT "%7.3" /end MEASUREMENT
/begin MEASUREMENT ti_add[1] "Total cylinder balancing additive correction value" SWORD _CNV_A_R_LINEAR_____228_CM 1 100. -32.768 32.767 DISPLAY_IDENTIFIER TI_ADD_1 ECU_ADDRESS 0xd000a20a FORMAT "%7.3" /end MEASUREMENT
/begin MEASUREMENT ti_add[2] "Total cylinder balancing additive correction value" SWORD _CNV_A_R_LINEAR_____228_CM 1 100. -32.768 32.767 DISPLAY_IDENTIFIER TI_ADD_2 ECU_ADDRESS 0xd000a20c FORMAT "%7.3" /end MEASUREMENT
/begin MEASUREMENT ti_add[3] "Total cylinder balancing additive correction value" SWORD _CNV_A_R_LINEAR_____228_CM 1 100. -32.768 32.767 DISPLAY_IDENTIFIER TI_ADD_3 ECU_ADDRESS 0xd000a20e FORMAT "%7.3" /end MEASUREMENT
/begin MEASUREMENT ti_add[4] "Total cylinder balancing additive correction value" SWORD _CNV_A_R_LINEAR_____228_CM 1 100. -32.768 32.767 DISPLAY_IDENTIFIER TI_ADD_4 ECU_ADDRESS 0xd000a210 FORMAT "%7.3" /end MEASUREMENT
/begin MEASUREMENT ti_add[5] "Total cylinder balancing additive correction value" SWORD _CNV_A_R_LINEAR_____228_CM 1 100. -32.768 32.767 DISPLAY_IDENTIFIER TI_ADD_5 ECU_ADDRESS 0xd000a212 FORMAT "%7.3" /end MEASUREMENT
/begin MEASUREMENT ti_add[6] "Total cylinder balancing additive correction value" SWORD _CNV_A_R_LINEAR_____228_CM 1 100. -32.768 32.767 DISPLAY_IDENTIFIER TI_ADD[6] ECU_ADDRESS 0xd000a214 FORMAT "%7.3" /end MEASUREMENT
/begin MEASUREMENT ti_add[7] "Total cylinder balancing additive correction value" SWORD _CNV_A_R_LINEAR_____228_CM 1 100. -32.768 32.767 DISPLAY_IDENTIFIER TI_ADD[7] ECU_ADDRESS 0xd000a216 FORMAT "%7.3" /end MEASUREMENT
/begin MEASUREMENT ti_fac[0] "Total cylinder balancing multiple correction factor" UWORD _CNV_A_R_LINEAR_____9_CM 1 100. 0. 1.99996948242188 DISPLAY_IDENTIFIER TI_FAC_0 ECU_ADDRESS 0xd000a218 FORMAT "%7.5" /end MEASUREMENT
/begin MEASUREMENT ti_fac[1] "Total cylinder balancing multiple correction factor" UWORD _CNV_A_R_LINEAR_____9_CM 1 100. 0. 1.99996948242188 DISPLAY_IDENTIFIER TI_FAC_1 ECU_ADDRESS 0xd000a21a FORMAT "%7.5" /end MEASUREMENT
/begin MEASUREMENT ti_fac[2] "Total cylinder balancing multiple correction factor" UWORD _CNV_A_R_LINEAR_____9_CM 1 100. 0. 1.99996948242188 DISPLAY_IDENTIFIER TI_FAC_2 ECU_ADDRESS 0xd000a21c FORMAT "%7.5" /end MEASUREMENT
/begin MEASUREMENT ti_fac[3] "Total cylinder balancing multiple correction factor" UWORD _CNV_A_R_LINEAR_____9_CM 1 100. 0. 1.99996948242188 DISPLAY_IDENTIFIER TI_FAC_3 ECU_ADDRESS 0xd000a21e FORMAT "%7.5" /end MEASUREMENT
/begin MEASUREMENT ti_fac[4] "Total cylinder balancing multiple correction factor" UWORD _CNV_A_R_LINEAR_____9_CM 1 100. 0. 1.99996948242188 DISPLAY_IDENTIFIER TI_FAC_4 ECU_ADDRESS 0xd000a220 FORMAT "%7.5" /end MEASUREMENT
/begin MEASUREMENT ti_fac[5] "Total cylinder balancing multiple correction factor" UWORD _CNV_A_R_LINEAR_____9_CM 1 100. 0. 1.99996948242188 DISPLAY_IDENTIFIER TI_FAC_5 ECU_ADDRESS 0xd000a222 FORMAT "%7.5" /end MEASUREMENT
/begin MEASUREMENT ti_fac[6] "Total cylinder balancing multiple correction factor" UWORD _CNV_A_R_LINEAR_____9_CM 1 100. 0. 1.99996948242188 DISPLAY_IDENTIFIER TI_FAC[6] ECU_ADDRESS 0xd000a224 FORMAT "%7.5" /end MEASUREMENT
/begin MEASUREMENT ti_fac[7] "Total cylinder balancing multiple correction factor" UWORD _CNV_A_R_LINEAR_____9_CM 1 100. 0. 1.99996948242188 DISPLAY_IDENTIFIER TI_FAC[7] ECU_ADDRESS 0xd000a226 FORMAT "%7.5" /end MEASUREMENT
/begin MEASUREMENT lv_tldv_req "Flag indicating the activation requirement for the diagnosis" UBYTE _CNV_S_2_RANGE__0___1_CM 1 100. 0. 1. DISPLAY_IDENTIFIER LV_TLDV_REQ ECU_ADDRESS 0xd0007edf BIT_MASK 0x1 /end MEASUREMENT
/begin MEASUREMENT lv_fac_lam_diagcp "logical value for flag for lambda control to set initialize controller output" UBYTE _CNV_S_2_RANGE__0___1_CM 1 100. 0. 1. DISPLAY_IDENTIFIER LV_FAC_LAM_DIAGCP ECU_ADDRESS 0xd0007ee2 BIT_MASK 0x1 /end MEASUREMENT
/begin MEASUREMENT lv_diagcp_cps_act "flag indicating EVAM taking the control on flow setpoint" UBYTE _CNV_S_2_RANGE__0___1_CM 1 100. 0. 1. DISPLAY_IDENTIFIER LV_DIAGCP_CPS_ACT ECU_ADDRESS 0xd0007edb BIT_MASK 0x1 /end MEASUREMENT
/begin MEASUREMENT lv_err_mec_open_cps "Boolean for CPS stuck in open position (after debounce)" UBYTE _CNV_S_2_RANGE__0___1_CM 1 100. 0. 1. DISPLAY_IDENTIFIER LV_ERR_MEC_OPEN_CPS ECU_ADDRESS 0xd0007ede BIT_MASK 0x1 /end MEASUREMENT
/begin MEASUREMENT flow_sp_cps_evap "setpoint for flow CPS at evacuation. Flow setpoint through the CPS during functional check CPS (interface to EVAC AGGR" UWORD _CNV_A_R_LINEAR_____162_CM 1 100. 0. 7.9998779296875 DISPLAY_IDENTIFIER FLOW_SP_CPS_EVAP ECU_ADDRESS 0xd00092d6 FORMAT "%7.4" /end MEASUREMENT
/begin MEASUREMENT cl_mmv_norm_purge_end "Canister load at the end of MAX_PURGE operation" UWORD _CNV_A_R_LINEAR_____9_CM 1 100. 0. 1.99996948242188 DISPLAY_IDENTIFIER CL_MMV_NORM_PURGE_END ECU_ADDRESS 0xd00092d4 FORMAT "%7.5" /end MEASUREMENT
/begin MEASUREMENT lv_cp_new_ramp_open_mem "locally memorised version of LV_CP_NEW_RAMP_OPEN" UBYTE _CNV_S_2_RANGE__0___1_CM 1 100. 0. 1. DISPLAY_IDENTIFIER LV_CP_NEW_RAMP_OPEN_MEM ECU_ADDRESS 0xd0007eda BIT_MASK 0x1 /end MEASUREMENT
/begin MEASUREMENT lv_cl_mmv "Interface flag to functional check cps" UBYTE _CNV_S_2_RANGE__0___1_CM 1 100. 0. 1. DISPLAY_IDENTIFIER LV_CL_MMV ECU_ADDRESS 0xd0007ed9 BIT_MASK 0x1 /end MEASUREMENT
/begin MEASUREMENT lv_err_el_sov "Boolean for error currently present on canister shutoff valve command signal" UBYTE _CNV_S_2_RANGE__0___1_CM 1 100. 0. 1. DISPLAY_IDENTIFIER LV_ERR_EL_SOV ECU_ADDRESS 0xd0007edc BIT_MASK 0x1 /end MEASUREMENT
/begin MEASUREMENT lv_err_mec_close_sov "Boolean for error currently present due to canister shut off valve stuck in closed position" UBYTE _CNV_S_2_RANGE__0___1_CM 1 100. 0. 1. DISPLAY_IDENTIFIER LV_ERR_MEC_CLOSE_SOV ECU_ADDRESS 0xd0007edd BIT_MASK 0x1 /end MEASUREMENT
/begin MEASUREMENT lv_err_cps "Flag indicating failure on canister purge valve" UBYTE _CNV_S_2_RANGE__0___1_CM 1 100. 0. 1. DISPLAY_IDENTIFIER LV_ERR_CPS ECU_ADDRESS 0xd0007ee0 BIT_MASK 0x1 /end MEASUREMENT
/begin MEASUREMENT lv_cl_calc_avl "interface flag to cat.diag.: cl known" UBYTE _CNV_S_2_RANGE__0___1_CM 1 100. 0. 1. DISPLAY_IDENTIFIER LV_CL_CALC_AVL ECU_ADDRESS 0xd0007ee1 BIT_MASK 0x1 /end MEASUREMENT
/begin MEASUREMENT state_cp_mem_ad "locally memorised version of STATE_CP" UBYTE _CNV_S_9_RANGE_STAT_445_CM 1 100. 0. 11. DISPLAY_IDENTIFIER STATE_CP_MEM_AD ECU_ADDRESS 0xd0007ed8 /end MEASUREMENT
/begin CHARACTERISTIC c_t_dly_purge_diagcps "Delay time for activating DIAGCPS-diagnosis (step2) after LV CL MMV 0-->1" VALUE 0xa0805674 _REC_VAL_20_u2 1310.7 _CNV_A_R_LINEAR_____110_CM 0. 1310.7 DISPLAY_IDENTIFIER C_T_DLY_PURGE_DIAGCPS FORMAT "%7.2" /end CHARACTERISTIC
/begin CHARACTERISTIC c_t_dly_cl_mmv "Delay time for setting LV_CL_MMV 0-->1" VALUE 0xa0805658 _REC_VAL_20_u2 1310.7 _CNV_A_R_LINEAR_____110_CM 0. 1310.7 DISPLAY_IDENTIFIER C_T_DLY_CL_MMV FORMAT "%7.2" /end CHARACTERISTIC
/begin MEASUREMENT t_dly_cl_mmv "Delay time for setting LV_CL_MMV 0-->1" UWORD _CNV_A_R_LINEAR_____110_CM 1 100. 0. 1310.7 DISPLAY_IDENTIFIER T_DLY_CL_MMV ECU_ADDRESS 0xd00029a0 FORMAT "%7.2" /end MEASUREMENT
/begin CHARACTERISTIC c_t_dly_cl_mmv_ready "Delay time after which TEV check starts once Ramp_open has been started " VALUE 0xa080565a _REC_VAL_20_u2 1310.7 _CNV_A_R_LINEAR_____110_CM 0. 1310.7 DISPLAY_IDENTIFIER C_T_DLY_CL_MMV_READY FORMAT "%7.2" /end CHARACTERISTIC
/begin MEASUREMENT lv_t_dly_cl_mmv_ready "Flag when the first transition Wait Ramp Open to Ramp Open occurs" UBYTE _CNV_S_2_RANGE__0___1_CM 1 100. 0. 1. DISPLAY_IDENTIFIER LV_T_DLY_CL_MMV_READY ECU_ADDRESS 0xd0007ee3 BIT_MASK 0x1 /end MEASUREMENT
/begin MEASUREMENT lv_cl_mmv_tmp "Intermediate value for interface flag to functional check cps" UBYTE _CNV_S_2_RANGE__0___1_CM 1 100. 0. 1. DISPLAY_IDENTIFIER LV_CL_MMV_TMP ECU_ADDRESS 0xd00029a6 BIT_MASK 0x1 /end MEASUREMENT
/begin MEASUREMENT t_dly_cl_mmv_ready "Delay time after which TEV check starts once Ramp_open has been started" UWORD _CNV_A_R_LINEAR_____110_CM 1 100. 0. 1310.7 DISPLAY_IDENTIFIER T_DLY_CL_MMV_READY ECU_ADDRESS 0xd00029a2 FORMAT "%7.2" /end MEASUREMENT
/begin MEASUREMENT lv_lih_coc_on "limp home cooling circuit - engine overtemperature - request to transmission" UBYTE _CNV_S_2_RANGE__0___1_CM 1 100. 0. 1. DISPLAY_IDENTIFIER LV_LIH_COC_ON ECU_ADDRESS 0xd000873b BIT_MASK 0x1 /end MEASUREMENT
/begin MEASUREMENT n_rel_cwp_sp "setpoint of EWAPU sent via bsd-component driver" UBYTE _CNV_A_R_LINEAR_____0_CM 1 100. 0. 255. DISPLAY_IDENTIFIER N_REL_CWP_SP ECU_ADDRESS 0xd0008736 FORMAT "%3.0" /end MEASUREMENT
/begin MEASUREMENT lv_temp_eng_warn_1 "1: activate yellow warning lamp for TCO overtemperature (Check-Control-Messages in BN vehicles)" UBYTE _CNV_S_2_RANGE__0___1_CM 1 100. 0. 1. DISPLAY_IDENTIFIER LV_TEMP_ENG_WARN_1 ECU_ADDRESS 0xd000873c BIT_MASK 0x1 /end MEASUREMENT
/begin MEASUREMENT state_coc "State coolant circuit management " UBYTE _CNV_A_R_LINEAR_____0_CM 1 100. 0. 255. DISPLAY_IDENTIFIER STATE_COC ECU_ADDRESS 0xd0008737 FORMAT "%3.0" /end MEASUREMENT
/begin MEASUREMENT ectpwm_clc "PWM for ECT from BMW, for MSx70 specific solution of ECT functionality" UWORD _CNV_A_R_LINEAR_____8_CM 1 100. 0. 99.99847412109381 DISPLAY_IDENTIFIER ECTPWM_CLC ECU_ADDRESS 0xd000a2d4 FORMAT "%5.2" /end MEASUREMENT
/begin MEASUREMENT n_perc_ecf "percentage value of electronic fan speed setpoint" UBYTE _CNV_A_R_LINEAR_____5_CM 1 100. 0. 99.609375 DISPLAY_IDENTIFIER N_PERC_ECF ECU_ADDRESS 0xd0008734 FORMAT "%5.2" /end MEASUREMENT
/begin MEASUREMENT lv_temp_eng_warn_2 "1: activate red warning lamp for TCO overtemperature (Check-Control-Messages in BN vehicles)" UBYTE _CNV_S_2_RANGE__0___1_CM 1 100. 0. 1. DISPLAY_IDENTIFIER LV_TEMP_ENG_WARN_2 ECU_ADDRESS 0xd000873d BIT_MASK 0x1 /end MEASUREMENT
/begin MEASUREMENT lv_temp_eng_warn_3 "1: activate gearshift up for TCO overtemperature (Check-Control-Messages in BN vehicles)" UBYTE _CNV_S_2_RANGE__0___1_CM 1 100. 0. 1. DISPLAY_IDENTIFIER LV_TEMP_ENG_WARN_3 ECU_ADDRESS 0xd0008741 BIT_MASK 0x1 /end MEASUREMENT
/begin MEASUREMENT fup_sp_ext[0] "Fuel pressure setpoint BMW" UWORD _CNV_A_R_LINEAR_____171_CM 1 100. 0. 347776. DISPLAY_IDENTIFIER FUP_SP_EXT[0] ECU_ADDRESS 0xd000a384 FORMAT "%6.0" /end MEASUREMENT
/begin MEASUREMENT fup_sp_ext[1] "Fuel pressure setpoint BMW" UWORD _CNV_A_R_LINEAR_____171_CM 1 100. 0. 347776. DISPLAY_IDENTIFIER FUP_SP_EXT[1] ECU_ADDRESS 0xd000a386 FORMAT "%6.0" /end MEASUREMENT
/begin MEASUREMENT lv_fup_sp_ext_req "External request of fuel pressure setpoint (high pressure)" UBYTE _CNV_S_2_RANGE__0___1_CM 1 100. 0. 1. DISPLAY_IDENTIFIER LV_FUP_SP_EXT_REQ ECU_ADDRESS 0xd00087b0 BIT_MASK 0x1 /end MEASUREMENT
/begin MEASUREMENT fup_h_sp_s_ext "Fuel pressure setpoint for stratified mode, high range" UWORD _CNV_A_R_LINEAR_____171_CM 1 100. 0. 347776. DISPLAY_IDENTIFIER FUP_H_SP_S_EXT ECU_ADDRESS 0xd000a388 FORMAT "%6.0" /end MEASUREMENT
/begin MEASUREMENT efppwm_can "Pump speed of the electrical fuel pump as 8 bit PWM signal" UBYTE _CNV_A_R_LINEAR_____5_CM 1 100. 0. 99.609375 DISPLAY_IDENTIFIER EFPPWM_CAN ECU_ADDRESS 0xd00087b5 FORMAT "%4.1" /end MEASUREMENT
/begin MEASUREMENT vff_efp "Required amount of fuel" UBYTE _CNV_A_R_LINEAR_____174_CM 1 100. 0. 255. DISPLAY_IDENTIFIER VFF_EFP ECU_ADDRESS 0xd00087b4 FORMAT "%4.0" /end MEASUREMENT
/begin MEASUREMENT fup_ad "Adaptation value for fuel pressure adaptation" SWORD _CNV_A_R_LINEAR_____525_CM 1 100. -173890.6533608 173885.3466392 DISPLAY_IDENTIFIER FUP_AD ECU_ADDRESS 0xd000a394 FORMAT "%9.2" /end MEASUREMENT
/begin CHARACTERISTIC c_egy_level_iv_bal_ofs "Cylinder balancing injection valve energy level offset" VALUE 0xa080bc96 _REC_VAL_20_s2 100. _CNV_A_R_INJR_LINEA_460_CM -50. 50. DISPLAY_IDENTIFIER C_EGY_LEVEL_IV_BAL_OFS FORMAT "%7.3" /end CHARACTERISTIC
/begin MEASUREMENT egy_level_iv_bal_adj[0] "Cylinder balancing injection valve energy level adjustment" SWORD _CNV_A_R_INJR_LINEA_460_CM 1 100. -50. 50. DISPLAY_IDENTIFIER EGY_LEVEL_IV_BAL_ADJ[0] ECU_ADDRESS 0xd00016cc FORMAT "%7.3" /end MEASUREMENT
/begin MEASUREMENT egy_level_iv_bal_adj[1] "Cylinder balancing injection valve energy level adjustment" SWORD _CNV_A_R_INJR_LINEA_460_CM 1 100. -50. 50. DISPLAY_IDENTIFIER EGY_LEVEL_IV_BAL_ADJ[1] ECU_ADDRESS 0xd00016ce FORMAT "%7.3" /end MEASUREMENT
/begin MEASUREMENT egy_level_iv_bal_adj[2] "Cylinder balancing injection valve energy level adjustment" SWORD _CNV_A_R_INJR_LINEA_460_CM 1 100. -50. 50. DISPLAY_IDENTIFIER EGY_LEVEL_IV_BAL_ADJ[2] ECU_ADDRESS 0xd00016d0 FORMAT "%7.3" /end MEASUREMENT
/begin MEASUREMENT egy_level_iv_bal_adj[3] "Cylinder balancing injection valve energy level adjustment" SWORD _CNV_A_R_INJR_LINEA_460_CM 1 100. -50. 50. DISPLAY_IDENTIFIER EGY_LEVEL_IV_BAL_ADJ[3] ECU_ADDRESS 0xd00016d2 FORMAT "%7.3" /end MEASUREMENT
/begin MEASUREMENT egy_level_iv_bal_adj[4] "Cylinder balancing injection valve energy level adjustment" SWORD _CNV_A_R_INJR_LINEA_460_CM 1 100. -50. 50. DISPLAY_IDENTIFIER EGY_LEVEL_IV_BAL_ADJ[4] ECU_ADDRESS 0xd00016d4 FORMAT "%7.3" /end MEASUREMENT
/begin MEASUREMENT egy_level_iv_bal_adj[5] "Cylinder balancing injection valve energy level adjustment" SWORD _CNV_A_R_INJR_LINEA_460_CM 1 100. -50. 50. DISPLAY_IDENTIFIER EGY_LEVEL_IV_BAL_ADJ[5] ECU_ADDRESS 0xd00016d6 FORMAT "%7.3" /end MEASUREMENT
/begin MEASUREMENT egy_level_iv_bal_adj[6] "Cylinder balancing injection valve energy level adjustment" SWORD _CNV_A_R_INJR_LINEA_460_CM 1 100. -50. 50. DISPLAY_IDENTIFIER EGY_LEVEL_IV_BAL_ADJ[6] ECU_ADDRESS 0xd00016d8 FORMAT "%7.3" /end MEASUREMENT
/begin MEASUREMENT egy_level_iv_bal_adj[7] "Cylinder balancing injection valve energy level adjustment" SWORD _CNV_A_R_INJR_LINEA_460_CM 1 100. -50. 50. DISPLAY_IDENTIFIER EGY_LEVEL_IV_BAL_ADJ[7] ECU_ADDRESS 0xd00016da FORMAT "%7.3" /end MEASUREMENT
/begin MEASUREMENT nr_cyc_egy_level_iv_bal_ctl_max "Corresponding segment number of the controller that has reached the maximum limit" UBYTE _CNV_A_R_LINEAR_____0_CM 1 100. 0. 255. DISPLAY_IDENTIFIER NR_CYC_EGY_LEVEL_IV_BAL_CTL_MAX ECU_ADDRESS 0xd0001718 FORMAT "%3.0" /end MEASUREMENT
/begin MEASUREMENT egy_level_iv_bal_ctl[0] "Cylinder balancing injection valve energy level control" SWORD _CNV_A_R_INJR_LINEA_460_CM 1 100. -50. 50. DISPLAY_IDENTIFIER EGY_LEVEL_IV_BAL_CTL[0] ECU_ADDRESS 0xd00016dc FORMAT "%7.3" /end MEASUREMENT
/begin MEASUREMENT egy_level_iv_bal_ctl[1] "Cylinder balancing injection valve energy level control" SWORD _CNV_A_R_INJR_LINEA_460_CM 1 100. -50. 50. DISPLAY_IDENTIFIER EGY_LEVEL_IV_BAL_CTL[1] ECU_ADDRESS 0xd00016de FORMAT "%7.3" /end MEASUREMENT
/begin MEASUREMENT egy_level_iv_bal_ctl[2] "Cylinder balancing injection valve energy level control" SWORD _CNV_A_R_INJR_LINEA_460_CM 1 100. -50. 50. DISPLAY_IDENTIFIER EGY_LEVEL_IV_BAL_CTL[2] ECU_ADDRESS 0xd00016e0 FORMAT "%7.3" /end MEASUREMENT
/begin MEASUREMENT egy_level_iv_bal_ctl[3] "Cylinder balancing injection valve energy level control" SWORD _CNV_A_R_INJR_LINEA_460_CM 1 100. -50. 50. DISPLAY_IDENTIFIER EGY_LEVEL_IV_BAL_CTL[3] ECU_ADDRESS 0xd00016e2 FORMAT "%7.3" /end MEASUREMENT
/begin MEASUREMENT egy_level_iv_bal_ctl[4] "Cylinder balancing injection valve energy level control" SWORD _CNV_A_R_INJR_LINEA_460_CM 1 100. -50. 50. DISPLAY_IDENTIFIER EGY_LEVEL_IV_BAL_CTL[4] ECU_ADDRESS 0xd00016e4 FORMAT "%7.3" /end MEASUREMENT
/begin MEASUREMENT egy_level_iv_bal_ctl[5] "Cylinder balancing injection valve energy level control" SWORD _CNV_A_R_INJR_LINEA_460_CM 1 100. -50. 50. DISPLAY_IDENTIFIER EGY_LEVEL_IV_BAL_CTL[5] ECU_ADDRESS 0xd00016e6 FORMAT "%7.3" /end MEASUREMENT
/begin MEASUREMENT egy_level_iv_bal_ctl[6] "Cylinder balancing injection valve energy level control" SWORD _CNV_A_R_INJR_LINEA_460_CM 1 100. -50. 50. DISPLAY_IDENTIFIER EGY_LEVEL_IV_BAL_CTL[6] ECU_ADDRESS 0xd00016e8 FORMAT "%7.3" /end MEASUREMENT
/begin MEASUREMENT egy_level_iv_bal_ctl[7] "Cylinder balancing injection valve energy level control" SWORD _CNV_A_R_INJR_LINEA_460_CM 1 100. -50. 50. DISPLAY_IDENTIFIER EGY_LEVEL_IV_BAL_CTL[7] ECU_ADDRESS 0xd00016ea FORMAT "%7.3" /end MEASUREMENT
/begin MEASUREMENT egy_level_iv_bal[0] "Cylinder balancing injection valve energy level" SWORD _CNV_A_R_INJR_LINEA_460_CM 1 100. -50. 50. DISPLAY_IDENTIFIER EGY_LEVEL_IV_BAL[0] ECU_ADDRESS 0xd000a8ec FORMAT "%7.3" /end MEASUREMENT
/begin MEASUREMENT egy_level_iv_bal[1] "Cylinder balancing injection valve energy level" SWORD _CNV_A_R_INJR_LINEA_460_CM 1 100. -50. 50. DISPLAY_IDENTIFIER EGY_LEVEL_IV_BAL[1] ECU_ADDRESS 0xd000a8ee FORMAT "%7.3" /end MEASUREMENT
/begin MEASUREMENT egy_level_iv_bal[2] "Cylinder balancing injection valve energy level" SWORD _CNV_A_R_INJR_LINEA_460_CM 1 100. -50. 50. DISPLAY_IDENTIFIER EGY_LEVEL_IV_BAL[2] ECU_ADDRESS 0xd000a8f0 FORMAT "%7.3" /end MEASUREMENT
/begin MEASUREMENT egy_level_iv_bal[3] "Cylinder balancing injection valve energy level" SWORD _CNV_A_R_INJR_LINEA_460_CM 1 100. -50. 50. DISPLAY_IDENTIFIER EGY_LEVEL_IV_BAL[3] ECU_ADDRESS 0xd000a8f2 FORMAT "%7.3" /end MEASUREMENT
/begin MEASUREMENT egy_level_iv_bal[4] "Cylinder balancing injection valve energy level" SWORD _CNV_A_R_INJR_LINEA_460_CM 1 100. -50. 50. DISPLAY_IDENTIFIER EGY_LEVEL_IV_BAL[4] ECU_ADDRESS 0xd000a8f4 FORMAT "%7.3" /end MEASUREMENT
/begin MEASUREMENT egy_level_iv_bal[5] "Cylinder balancing injection valve energy level" SWORD _CNV_A_R_INJR_LINEA_460_CM 1 100. -50. 50. DISPLAY_IDENTIFIER EGY_LEVEL_IV_BAL[5] ECU_ADDRESS 0xd000a8f6 FORMAT "%7.3" /end MEASUREMENT
/begin MEASUREMENT egy_level_iv_bal[6] "Cylinder balancing injection valve energy level" SWORD _CNV_A_R_INJR_LINEA_460_CM 1 100. -50. 50. DISPLAY_IDENTIFIER EGY_LEVEL_IV_BAL[6] ECU_ADDRESS 0xd000a8f8 FORMAT "%7.3" /end MEASUREMENT
/begin MEASUREMENT egy_level_iv_bal[7] "Cylinder balancing injection valve energy level" SWORD _CNV_A_R_INJR_LINEA_460_CM 1 100. -50. 50. DISPLAY_IDENTIFIER EGY_LEVEL_IV_BAL[7] ECU_ADDRESS 0xd000a8fa FORMAT "%7.3" /end MEASUREMENT
/begin MEASUREMENT fac_ti_sum_bal[0] "Cylinder balancing multiple correction factor summary" SWORD _CNV_A_R_LINEAR_____259_CM 1 100. -1. 0.999969482421875 DISPLAY_IDENTIFIER FAC_TI_SUM_BAL[0] ECU_ADDRESS 0xd00016ac FORMAT "%8.5" /end MEASUREMENT
/begin MEASUREMENT fac_ti_sum_bal[1] "Cylinder balancing multiple correction factor summary" SWORD _CNV_A_R_LINEAR_____259_CM 1 100. -1. 0.999969482421875 DISPLAY_IDENTIFIER FAC_TI_SUM_BAL[1] ECU_ADDRESS 0xd00016ae FORMAT "%8.5" /end MEASUREMENT
/begin MEASUREMENT fac_ti_sum_bal[2] "Cylinder balancing multiple correction factor summary" SWORD _CNV_A_R_LINEAR_____259_CM 1 100. -1. 0.999969482421875 DISPLAY_IDENTIFIER FAC_TI_SUM_BAL[2] ECU_ADDRESS 0xd00016b0 FORMAT "%8.5" /end MEASUREMENT
/begin MEASUREMENT fac_ti_sum_bal[3] "Cylinder balancing multiple correction factor summary" SWORD _CNV_A_R_LINEAR_____259_CM 1 100. -1. 0.999969482421875 DISPLAY_IDENTIFIER FAC_TI_SUM_BAL[3] ECU_ADDRESS 0xd00016b2 FORMAT "%8.5" /end MEASUREMENT
/begin MEASUREMENT fac_ti_sum_bal[4] "Cylinder balancing multiple correction factor summary" SWORD _CNV_A_R_LINEAR_____259_CM 1 100. -1. 0.999969482421875 DISPLAY_IDENTIFIER FAC_TI_SUM_BAL[4] ECU_ADDRESS 0xd00016b4 FORMAT "%8.5" /end MEASUREMENT
/begin MEASUREMENT fac_ti_sum_bal[5] "Cylinder balancing multiple correction factor summary" SWORD _CNV_A_R_LINEAR_____259_CM 1 100. -1. 0.999969482421875 DISPLAY_IDENTIFIER FAC_TI_SUM_BAL[5] ECU_ADDRESS 0xd00016b6 FORMAT "%8.5" /end MEASUREMENT
/begin MEASUREMENT fac_ti_sum_bal[6] "Cylinder balancing multiple correction factor summary" SWORD _CNV_A_R_LINEAR_____259_CM 1 100. -1. 0.999969482421875 DISPLAY_IDENTIFIER FAC_TI_SUM_BAL[6] ECU_ADDRESS 0xd00016b8 FORMAT "%8.5" /end MEASUREMENT
/begin MEASUREMENT fac_ti_sum_bal[7] "Cylinder balancing multiple correction factor summary" SWORD _CNV_A_R_LINEAR_____259_CM 1 100. -1. 0.999969482421875 DISPLAY_IDENTIFIER FAC_TI_SUM_BAL[7] ECU_ADDRESS 0xd00016ba FORMAT "%8.5" /end MEASUREMENT
/begin MEASUREMENT fac_ti_dif_bal[0] "Cylinder balancing multiple correction factor difference" SWORD _CNV_A_R_LINEAR_____259_CM 1 100. -1. 0.999969482421875 DISPLAY_IDENTIFIER FAC_TI_DIF_BAL[0] ECU_ADDRESS 0xd00016bc FORMAT "%8.5" /end MEASUREMENT
/begin MEASUREMENT fac_ti_dif_bal[1] "Cylinder balancing multiple correction factor difference" SWORD _CNV_A_R_LINEAR_____259_CM 1 100. -1. 0.999969482421875 DISPLAY_IDENTIFIER FAC_TI_DIF_BAL[1] ECU_ADDRESS 0xd00016be FORMAT "%8.5" /end MEASUREMENT
/begin MEASUREMENT fac_ti_dif_bal[2] "Cylinder balancing multiple correction factor difference" SWORD _CNV_A_R_LINEAR_____259_CM 1 100. -1. 0.999969482421875 DISPLAY_IDENTIFIER FAC_TI_DIF_BAL[2] ECU_ADDRESS 0xd00016c0 FORMAT "%8.5" /end MEASUREMENT
/begin MEASUREMENT fac_ti_dif_bal[3] "Cylinder balancing multiple correction factor difference" SWORD _CNV_A_R_LINEAR_____259_CM 1 100. -1. 0.999969482421875 DISPLAY_IDENTIFIER FAC_TI_DIF_BAL[3] ECU_ADDRESS 0xd00016c2 FORMAT "%8.5" /end MEASUREMENT
/begin MEASUREMENT fac_ti_dif_bal[4] "Cylinder balancing multiple correction factor difference" SWORD _CNV_A_R_LINEAR_____259_CM 1 100. -1. 0.999969482421875 DISPLAY_IDENTIFIER FAC_TI_DIF_BAL[4] ECU_ADDRESS 0xd00016c4 FORMAT "%8.5" /end MEASUREMENT
/begin MEASUREMENT fac_ti_dif_bal[5] "Cylinder balancing multiple correction factor difference" SWORD _CNV_A_R_LINEAR_____259_CM 1 100. -1. 0.999969482421875 DISPLAY_IDENTIFIER FAC_TI_DIF_BAL[5] ECU_ADDRESS 0xd00016c6 FORMAT "%8.5" /end MEASUREMENT
/begin MEASUREMENT fac_ti_dif_bal[6] "Cylinder balancing multiple correction factor difference" SWORD _CNV_A_R_LINEAR_____259_CM 1 100. -1. 0.999969482421875 DISPLAY_IDENTIFIER FAC_TI_DIF_BAL[6] ECU_ADDRESS 0xd00016c8 FORMAT "%8.5" /end MEASUREMENT
/begin MEASUREMENT fac_ti_dif_bal[7] "Cylinder balancing multiple correction factor difference" SWORD _CNV_A_R_LINEAR_____259_CM 1 100. -1. 0.999969482421875 DISPLAY_IDENTIFIER FAC_TI_DIF_BAL[7] ECU_ADDRESS 0xd00016ca FORMAT "%8.5" /end MEASUREMENT
/begin MEASUREMENT ctr_step_fac_ti_bal[0] "Number of cylinder balancing multiple correction steps" SBYTE _CNV_A_R_LINEAR_____0_CM 1 100. -128. 127. DISPLAY_IDENTIFIER CTR_STEP_FAC_TI_BAL[0] ECU_ADDRESS 0xd0001710 FORMAT "%4.0" /end MEASUREMENT
/begin MEASUREMENT ctr_step_fac_ti_bal[1] "Number of cylinder balancing multiple correction steps" SBYTE _CNV_A_R_LINEAR_____0_CM 1 100. -128. 127. DISPLAY_IDENTIFIER CTR_STEP_FAC_TI_BAL[1] ECU_ADDRESS 0xd0001711 FORMAT "%4.0" /end MEASUREMENT
/begin MEASUREMENT ctr_step_fac_ti_bal[2] "Number of cylinder balancing multiple correction steps" SBYTE _CNV_A_R_LINEAR_____0_CM 1 100. -128. 127. DISPLAY_IDENTIFIER CTR_STEP_FAC_TI_BAL[2] ECU_ADDRESS 0xd0001712 FORMAT "%4.0" /end MEASUREMENT
/begin MEASUREMENT ctr_step_fac_ti_bal[3] "Number of cylinder balancing multiple correction steps" SBYTE _CNV_A_R_LINEAR_____0_CM 1 100. -128. 127. DISPLAY_IDENTIFIER CTR_STEP_FAC_TI_BAL[3] ECU_ADDRESS 0xd0001713 FORMAT "%4.0" /end MEASUREMENT
/begin MEASUREMENT ctr_step_fac_ti_bal[4] "Number of cylinder balancing multiple correction steps" SBYTE _CNV_A_R_LINEAR_____0_CM 1 100. -128. 127. DISPLAY_IDENTIFIER CTR_STEP_FAC_TI_BAL[4] ECU_ADDRESS 0xd0001714 FORMAT "%4.0" /end MEASUREMENT
/begin MEASUREMENT ctr_step_fac_ti_bal[5] "Number of cylinder balancing multiple correction steps" SBYTE _CNV_A_R_LINEAR_____0_CM 1 100. -128. 127. DISPLAY_IDENTIFIER CTR_STEP_FAC_TI_BAL[5] ECU_ADDRESS 0xd0001715 FORMAT "%4.0" /end MEASUREMENT
/begin MEASUREMENT ctr_step_fac_ti_bal[6] "Number of cylinder balancing multiple correction steps" SBYTE _CNV_A_R_LINEAR_____0_CM 1 100. -128. 127. DISPLAY_IDENTIFIER CTR_STEP_FAC_TI_BAL[6] ECU_ADDRESS 0xd0001716 FORMAT "%4.0" /end MEASUREMENT
/begin MEASUREMENT ctr_step_fac_ti_bal[7] "Number of cylinder balancing multiple correction steps" SBYTE _CNV_A_R_LINEAR_____0_CM 1 100. -128. 127. DISPLAY_IDENTIFIER CTR_STEP_FAC_TI_BAL[7] ECU_ADDRESS 0xd0001717 FORMAT "%4.0" /end MEASUREMENT
/begin MEASUREMENT egy_level_iv_bal_ctl_max[0] "Cylinder balancing injection valve energy level maximum controller output value reached" UWORD _CNV_A_R_LINEAR_____0_CM 1 100. 0. 65535. DISPLAY_IDENTIFIER EGY_LEVEL_IV_BAL_CTL_MAX[0] ECU_ADDRESS 0xd00016ec FORMAT "%5.0" /end MEASUREMENT
/begin MEASUREMENT egy_level_iv_bal_ctl_max[1] "Cylinder balancing injection valve energy level maximum controller output value reached" UWORD _CNV_A_R_LINEAR_____0_CM 1 100. 0. 65535. DISPLAY_IDENTIFIER EGY_LEVEL_IV_BAL_CTL_MAX[1] ECU_ADDRESS 0xd00016ee FORMAT "%5.0" /end MEASUREMENT
/begin MEASUREMENT egy_level_iv_bal_ctl_max[2] "Cylinder balancing injection valve energy level maximum controller output value reached" UWORD _CNV_A_R_LINEAR_____0_CM 1 100. 0. 65535. DISPLAY_IDENTIFIER EGY_LEVEL_IV_BAL_CTL_MAX[2] ECU_ADDRESS 0xd00016f0 FORMAT "%5.0" /end MEASUREMENT
/begin MEASUREMENT egy_level_iv_bal_ctl_max[3] "Cylinder balancing injection valve energy level maximum controller output value reached" UWORD _CNV_A_R_LINEAR_____0_CM 1 100. 0. 65535. DISPLAY_IDENTIFIER EGY_LEVEL_IV_BAL_CTL_MAX[3] ECU_ADDRESS 0xd00016f2 FORMAT "%5.0" /end MEASUREMENT
/begin MEASUREMENT egy_level_iv_bal_ctl_max[4] "Cylinder balancing injection valve energy level maximum controller output value reached" UWORD _CNV_A_R_LINEAR_____0_CM 1 100. 0. 65535. DISPLAY_IDENTIFIER EGY_LEVEL_IV_BAL_CTL_MAX[4] ECU_ADDRESS 0xd00016f4 FORMAT "%5.0" /end MEASUREMENT
/begin MEASUREMENT egy_level_iv_bal_ctl_max[5] "Cylinder balancing injection valve energy level maximum controller output value reached" UWORD _CNV_A_R_LINEAR_____0_CM 1 100. 0. 65535. DISPLAY_IDENTIFIER EGY_LEVEL_IV_BAL_CTL_MAX[5] ECU_ADDRESS 0xd00016f6 FORMAT "%5.0" /end MEASUREMENT
/begin MEASUREMENT egy_level_iv_bal_ctl_max[6] "Cylinder balancing injection valve energy level maximum controller output value reached" UWORD _CNV_A_R_LINEAR_____0_CM 1 100. 0. 65535. DISPLAY_IDENTIFIER EGY_LEVEL_IV_BAL_CTL_MAX[6] ECU_ADDRESS 0xd00016f8 FORMAT "%5.0" /end MEASUREMENT
/begin MEASUREMENT egy_level_iv_bal_ctl_max[7] "Cylinder balancing injection valve energy level maximum controller output value reached" UWORD _CNV_A_R_LINEAR_____0_CM 1 100. 0. 65535. DISPLAY_IDENTIFIER EGY_LEVEL_IV_BAL_CTL_MAX[7] ECU_ADDRESS 0xd00016fa FORMAT "%5.0" /end MEASUREMENT
/begin MEASUREMENT ctr_dly_ti_bal_cor_ena "Segment counter to delay cylinder balancing TI correction activation" UBYTE _CNV_A_R_LINEAR_____0_CM 1 100. 0. 255. DISPLAY_IDENTIFIER CTR_DLY_TI_BAL_COR_ENA ECU_ADDRESS 0xd0001719 FORMAT "%3.0" /end MEASUREMENT
/begin CHARACTERISTIC c_egy_level_iv_bal_max_neg "Maximum negative threshold for injection valve energy level value" VALUE 0xa080bc92 _REC_VAL_20_s2 100. _CNV_A_R_INJR_LINEA_460_CM -50. 50. DISPLAY_IDENTIFIER C_EGY_LEVEL_IV_BAL_MAX_NEG FORMAT "%7.3" /end CHARACTERISTIC
/begin CHARACTERISTIC c_egy_level_iv_bal_max_pos "Maximum positive threshold for injection valve energy level value" VALUE 0xa080bc94 _REC_VAL_20_s2 100. _CNV_A_R_INJR_LINEA_460_CM -50. 50. DISPLAY_IDENTIFIER C_EGY_LEVEL_IV_BAL_MAX_POS FORMAT "%7.3" /end CHARACTERISTIC
/begin CHARACTERISTIC c_fac_ti_dif_bal "Threshold for cylinder balancing multiple correction difference" VALUE 0xa080bcf6 _REC_VAL_20_u2 1.99996948242188 _CNV_A_R_LINEAR_____9_CM 0. 1.99996948242188 DISPLAY_IDENTIFIER C_FAC_TI_DIF_BAL FORMAT "%7.5" /end CHARACTERISTIC
/begin CHARACTERISTIC lc_fac_ti_bal_rst_man "Manual switch for cylinder balancing multiple correction reset" VALUE 0xa080c571 _REC_VAL_20_u1 1. _CNV_A_R_LINEAR_____0_CM 0. 1. DISPLAY_IDENTIFIER LC_FAC_TI_BAL_RST_MAN FORMAT "%1.0" /end CHARACTERISTIC
/begin CHARACTERISTIC c_ctr_dly_ti_bal_cor_ini "Segment counter initialization value to delay cylinder balancing TI correction activation" VALUE 0xa080bb85 _REC_VAL_20_u1 255. _CNV_A_R_LINEAR_____0_CM 0. 255. DISPLAY_IDENTIFIER C_CTR_DLY_TI_BAL_COR_INI FORMAT "%3.0" /end CHARACTERISTIC
/begin MEASUREMENT egy_level_iv_bal_conv[0] "Cylinder balancing injection valve energy level converter output" SWORD _CNV_A_R_INJR_LINEA_460_CM 1 100. -50. 50. DISPLAY_IDENTIFIER EGY_LEVEL_IV_BAL_CONV[0] ECU_ADDRESS 0xd000a8dc FORMAT "%7.3" /end MEASUREMENT
/begin MEASUREMENT egy_level_iv_bal_conv[1] "Cylinder balancing injection valve energy level converter output" SWORD _CNV_A_R_INJR_LINEA_460_CM 1 100. -50. 50. DISPLAY_IDENTIFIER EGY_LEVEL_IV_BAL_CONV[1] ECU_ADDRESS 0xd000a8de FORMAT "%7.3" /end MEASUREMENT
/begin MEASUREMENT egy_level_iv_bal_conv[2] "Cylinder balancing injection valve energy level converter output" SWORD _CNV_A_R_INJR_LINEA_460_CM 1 100. -50. 50. DISPLAY_IDENTIFIER EGY_LEVEL_IV_BAL_CONV[2] ECU_ADDRESS 0xd000a8e0 FORMAT "%7.3" /end MEASUREMENT
/begin MEASUREMENT egy_level_iv_bal_conv[3] "Cylinder balancing injection valve energy level converter output" SWORD _CNV_A_R_INJR_LINEA_460_CM 1 100. -50. 50. DISPLAY_IDENTIFIER EGY_LEVEL_IV_BAL_CONV[3] ECU_ADDRESS 0xd000a8e2 FORMAT "%7.3" /end MEASUREMENT
/begin MEASUREMENT egy_level_iv_bal_conv[4] "Cylinder balancing injection valve energy level converter output" SWORD _CNV_A_R_INJR_LINEA_460_CM 1 100. -50. 50. DISPLAY_IDENTIFIER EGY_LEVEL_IV_BAL_CONV[4] ECU_ADDRESS 0xd000a8e4 FORMAT "%7.3" /end MEASUREMENT
/begin MEASUREMENT egy_level_iv_bal_conv[5] "Cylinder balancing injection valve energy level converter output" SWORD _CNV_A_R_INJR_LINEA_460_CM 1 100. -50. 50. DISPLAY_IDENTIFIER EGY_LEVEL_IV_BAL_CONV[5] ECU_ADDRESS 0xd000a8e6 FORMAT "%7.3" /end MEASUREMENT
/begin MEASUREMENT egy_level_iv_bal_conv[6] "Cylinder balancing injection valve energy level converter output" SWORD _CNV_A_R_INJR_LINEA_460_CM 1 100. -50. 50. DISPLAY_IDENTIFIER EGY_LEVEL_IV_BAL_CONV[6] ECU_ADDRESS 0xd000a8e8 FORMAT "%7.3" /end MEASUREMENT
/begin MEASUREMENT egy_level_iv_bal_conv[7] "Cylinder balancing injection valve energy level converter output" SWORD _CNV_A_R_INJR_LINEA_460_CM 1 100. -50. 50. DISPLAY_IDENTIFIER EGY_LEVEL_IV_BAL_CONV[7] ECU_ADDRESS 0xd000a8ea FORMAT "%7.3" /end MEASUREMENT
/begin AXIS_PTS ldp_fac_ti_sum_bal_ip_egy_bal "" 0xa0808628 online_dummy _REC_AXS_20_u2 1.99996948 _CNV_A_R_INJR_LINEA_465_CM 8 -1. 0.99996948 FORMAT "%8.5" /end AXIS_PTS
/begin CHARACTERISTIC ip_egy_level_iv_bal_conv "Index table for cylinder balancing injection valve energy level conversion" CURVE 0xa080a240 _REC_CUR_20_u2_u2 100. _CNV_A_R_INJR_LINEA_526_CM -50. 50. DISPLAY_IDENTIFIER IP_EGY_LEVEL_IV_BAL_CONV FORMAT "%7.3"
 /begin AXIS_DESCR COM_AXIS online_dummy _CNV_A_R_INJR_LINEA_465_CM 8 -1. 0.99996948 FORMAT "%8.5" AXIS_PTS_REF ldp_fac_ti_sum_bal_ip_egy_bal /end AXIS_DESCR
/end CHARACTERISTIC
/begin MEASUREMENT fac_ti_bal[0] "Total cylinder balancing multiple correction factor" UWORD _CNV_A_R_LINEAR_____9_CM 1 100. 0. 1.99996948242188 DISPLAY_IDENTIFIER FAC_TI_BAL[0] ECU_ADDRESS 0xd000a8cc FORMAT "%7.5" /end MEASUREMENT
/begin MEASUREMENT fac_ti_bal[1] "Total cylinder balancing multiple correction factor" UWORD _CNV_A_R_LINEAR_____9_CM 1 100. 0. 1.99996948242188 DISPLAY_IDENTIFIER FAC_TI_BAL[1] ECU_ADDRESS 0xd000a8ce FORMAT "%7.5" /end MEASUREMENT
/begin MEASUREMENT fac_ti_bal[2] "Total cylinder balancing multiple correction factor" UWORD _CNV_A_R_LINEAR_____9_CM 1 100. 0. 1.99996948242188 DISPLAY_IDENTIFIER FAC_TI_BAL[2] ECU_ADDRESS 0xd000a8d0 FORMAT "%7.5" /end MEASUREMENT
/begin MEASUREMENT fac_ti_bal[3] "Total cylinder balancing multiple correction factor" UWORD _CNV_A_R_LINEAR_____9_CM 1 100. 0. 1.99996948242188 DISPLAY_IDENTIFIER FAC_TI_BAL[3] ECU_ADDRESS 0xd000a8d2 FORMAT "%7.5" /end MEASUREMENT
/begin MEASUREMENT fac_ti_bal[4] "Total cylinder balancing multiple correction factor" UWORD _CNV_A_R_LINEAR_____9_CM 1 100. 0. 1.99996948242188 DISPLAY_IDENTIFIER FAC_TI_BAL[4] ECU_ADDRESS 0xd000a8d4 FORMAT "%7.5" /end MEASUREMENT
/begin MEASUREMENT fac_ti_bal[5] "Total cylinder balancing multiple correction factor" UWORD _CNV_A_R_LINEAR_____9_CM 1 100. 0. 1.99996948242188 DISPLAY_IDENTIFIER FAC_TI_BAL[5] ECU_ADDRESS 0xd000a8d6 FORMAT "%7.5" /end MEASUREMENT
/begin MEASUREMENT fac_ti_bal[6] "Total cylinder balancing multiple correction factor" UWORD _CNV_A_R_LINEAR_____9_CM 1 100. 0. 1.99996948242188 DISPLAY_IDENTIFIER FAC_TI_BAL[6] ECU_ADDRESS 0xd000a8d8 FORMAT "%7.5" /end MEASUREMENT
/begin MEASUREMENT fac_ti_bal[7] "Total cylinder balancing multiple correction factor" UWORD _CNV_A_R_LINEAR_____9_CM 1 100. 0. 1.99996948242188 DISPLAY_IDENTIFIER FAC_TI_BAL[7] ECU_ADDRESS 0xd000a8da FORMAT "%7.5" /end MEASUREMENT
/begin MEASUREMENT mff_add_bal[0] "Total cylinder balancing additive MFF correction value" SWORD _CNV_A_R_LINEAR_____128_CM 1 100. -694.510597390707 694.4894026092931 DISPLAY_IDENTIFIER MFF_ADD_BAL[0] ECU_ADDRESS 0xd000a8bc FORMAT "%7.2" /end MEASUREMENT
/begin MEASUREMENT mff_add_bal[1] "Total cylinder balancing additive MFF correction value" SWORD _CNV_A_R_LINEAR_____128_CM 1 100. -694.510597390707 694.4894026092931 DISPLAY_IDENTIFIER MFF_ADD_BAL[1] ECU_ADDRESS 0xd000a8be FORMAT "%7.2" /end MEASUREMENT
/begin MEASUREMENT mff_add_bal[2] "Total cylinder balancing additive MFF correction value" SWORD _CNV_A_R_LINEAR_____128_CM 1 100. -694.510597390707 694.4894026092931 DISPLAY_IDENTIFIER MFF_ADD_BAL[2] ECU_ADDRESS 0xd000a8c0 FORMAT "%7.2" /end MEASUREMENT
/begin MEASUREMENT mff_add_bal[3] "Total cylinder balancing additive MFF correction value" SWORD _CNV_A_R_LINEAR_____128_CM 1 100. -694.510597390707 694.4894026092931 DISPLAY_IDENTIFIER MFF_ADD_BAL[3] ECU_ADDRESS 0xd000a8c2 FORMAT "%7.2" /end MEASUREMENT
/begin MEASUREMENT mff_add_bal[4] "Total cylinder balancing additive MFF correction value" SWORD _CNV_A_R_LINEAR_____128_CM 1 100. -694.510597390707 694.4894026092931 DISPLAY_IDENTIFIER MFF_ADD_BAL[4] ECU_ADDRESS 0xd000a8c4 FORMAT "%7.2" /end MEASUREMENT
/begin MEASUREMENT mff_add_bal[5] "Total cylinder balancing additive MFF correction value" SWORD _CNV_A_R_LINEAR_____128_CM 1 100. -694.510597390707 694.4894026092931 DISPLAY_IDENTIFIER MFF_ADD_BAL[5] ECU_ADDRESS 0xd000a8c6 FORMAT "%7.2" /end MEASUREMENT
/begin MEASUREMENT mff_add_bal[6] "Total cylinder balancing additive MFF correction value" SWORD _CNV_A_R_LINEAR_____128_CM 1 100. -694.510597390707 694.4894026092931 DISPLAY_IDENTIFIER MFF_ADD_BAL[6] ECU_ADDRESS 0xd000a8c8 FORMAT "%7.2" /end MEASUREMENT
/begin MEASUREMENT mff_add_bal[7] "Total cylinder balancing additive MFF correction value" SWORD _CNV_A_R_LINEAR_____128_CM 1 100. -694.510597390707 694.4894026092931 DISPLAY_IDENTIFIER MFF_ADD_BAL[7] ECU_ADDRESS 0xd000a8ca FORMAT "%7.2" /end MEASUREMENT
/begin MEASUREMENT mff_add_sum_bal[0] "Cylinder balancing additive MFF correction value summary" SWORD _CNV_A_R_LINEAR_____128_CM 1 100. -694.510597390707 694.4894026092931 DISPLAY_IDENTIFIER MFF_ADD_SUM_BAL[0] ECU_ADDRESS 0xd00016fc FORMAT "%7.2" /end MEASUREMENT
/begin MEASUREMENT mff_add_sum_bal[1] "Cylinder balancing additive MFF correction value summary" SWORD _CNV_A_R_LINEAR_____128_CM 1 100. -694.510597390707 694.4894026092931 DISPLAY_IDENTIFIER MFF_ADD_SUM_BAL[1] ECU_ADDRESS 0xd00016fe FORMAT "%7.2" /end MEASUREMENT
/begin MEASUREMENT mff_add_sum_bal[2] "Cylinder balancing additive MFF correction value summary" SWORD _CNV_A_R_LINEAR_____128_CM 1 100. -694.510597390707 694.4894026092931 DISPLAY_IDENTIFIER MFF_ADD_SUM_BAL[2] ECU_ADDRESS 0xd0001700 FORMAT "%7.2" /end MEASUREMENT
/begin MEASUREMENT mff_add_sum_bal[3] "Cylinder balancing additive MFF correction value summary" SWORD _CNV_A_R_LINEAR_____128_CM 1 100. -694.510597390707 694.4894026092931 DISPLAY_IDENTIFIER MFF_ADD_SUM_BAL[3] ECU_ADDRESS 0xd0001702 FORMAT "%7.2" /end MEASUREMENT
/begin MEASUREMENT mff_add_sum_bal[4] "Cylinder balancing additive MFF correction value summary" SWORD _CNV_A_R_LINEAR_____128_CM 1 100. -694.510597390707 694.4894026092931 DISPLAY_IDENTIFIER MFF_ADD_SUM_BAL[4] ECU_ADDRESS 0xd0001704 FORMAT "%7.2" /end MEASUREMENT
/begin MEASUREMENT mff_add_sum_bal[5] "Cylinder balancing additive MFF correction value summary" SWORD _CNV_A_R_LINEAR_____128_CM 1 100. -694.510597390707 694.4894026092931 DISPLAY_IDENTIFIER MFF_ADD_SUM_BAL[5] ECU_ADDRESS 0xd0001706 FORMAT "%7.2" /end MEASUREMENT
/begin MEASUREMENT mff_add_sum_bal[6] "Cylinder balancing additive MFF correction value summary" SWORD _CNV_A_R_LINEAR_____128_CM 1 100. -694.510597390707 694.4894026092931 DISPLAY_IDENTIFIER MFF_ADD_SUM_BAL[6] ECU_ADDRESS 0xd0001708 FORMAT "%7.2" /end MEASUREMENT
/begin MEASUREMENT mff_add_sum_bal[7] "Cylinder balancing additive MFF correction value summary" SWORD _CNV_A_R_LINEAR_____128_CM 1 100. -694.510597390707 694.4894026092931 DISPLAY_IDENTIFIER MFF_ADD_SUM_BAL[7] ECU_ADDRESS 0xd000170a FORMAT "%7.2" /end MEASUREMENT
/begin CHARACTERISTIC c_fac_ti_bal_act_man "Manual adjustment of activation conditions for injection valve energy level calculation" VALUE 0xa080bcf5 _REC_VAL_20_u1 3. _CNV_S_4_CYBL_RANGE_540_CM 0. 3. DISPLAY_IDENTIFIER C_FAC_TI_BAL_ACT_MAN /end CHARACTERISTIC
/begin CHARACTERISTIC c_mff_cor_bal_mod_man "Manual switch for cylinder balancing correction mode determination" VALUE 0xa080be79 _REC_VAL_20_u1 4. _CNV_S_5_CYBL_RANGE_541_CM 0. 4. DISPLAY_IDENTIFIER C_MFF_COR_BAL_MOD_MAN /end CHARACTERISTIC
/begin AXIS_PTS ldpm_n_2_cybl "" 0xa08095c4 n _REC_AXS_20_u2 8160. _CNV_A_R_LINEAR_____14_CM 4 0. 8160. FORMAT "%4.0" /end AXIS_PTS
/begin AXIS_PTS ldp_mff_sp_mv_ip_fac_egy_bal "" 0xa080896c mff_sp_mv _REC_AXS_20_u2 1389. _CNV_A_R_LINEAR_____111_CM 8 0. 1389. FORMAT "%7.2" /end AXIS_PTS
/begin CHARACTERISTIC ip_fac_mff_add_er_bal "Index table for cylinder balancing additive MFF correction factor" MAP 0xa080a384 _REC_MAP_20_u2_u2_u2 1.99996948242188 _CNV_A_R_LINEAR_____9_CM 0. 1.99996948242188 DISPLAY_IDENTIFIER IP_FAC_MFF_ADD_ER_BAL FORMAT "%7.5"
 /begin AXIS_DESCR COM_AXIS n _CNV_A_R_LINEAR_____14_CM 4 0. 8160. FORMAT "%4.0" AXIS_PTS_REF ldpm_n_2_cybl /end AXIS_DESCR
 /begin AXIS_DESCR COM_AXIS mff_sp_mv _CNV_A_R_LINEAR_____111_CM 4 0. 1389. FORMAT "%7.2" AXIS_PTS_REF ldpm_mff_sp_mv_1_cybl /end AXIS_DESCR
/end CHARACTERISTIC
/begin MEASUREMENT egy_level_iv_bal_lim "Cylinder balancing injection valve energy level converter output limited" SWORD _CNV_A_R_INJR_LINEA_460_CM 1 100. -50. 50. DISPLAY_IDENTIFIER EGY_LEVEL_IV_BAL_LIM ECU_ADDRESS 0xd000170c FORMAT "%7.3" /end MEASUREMENT
/begin AXIS_PTS ldpm_mff_sp_mv_1_cybl "" 0xa080955c mff_sp_mv _REC_AXS_20_u2 1389. _CNV_A_R_LINEAR_____111_CM 4 0. 1389. FORMAT "%7.2" /end AXIS_PTS
/begin CHARACTERISTIC ip_fac_mff_add_bal_ext "Index table for cylinder balancing additive MFF correction factor" MAP 0xa080a364 _REC_MAP_20_u2_u2_u2 1.99996948242188 _CNV_A_R_LINEAR_____9_CM 0. 1.99996948242188 DISPLAY_IDENTIFIER IP_FAC_MFF_ADD_BAL_EXT FORMAT "%7.5"
 /begin AXIS_DESCR COM_AXIS n _CNV_A_R_LINEAR_____14_CM 4 0. 8160. FORMAT "%4.0" AXIS_PTS_REF ldpm_n_2_cybl /end AXIS_DESCR
 /begin AXIS_DESCR COM_AXIS mff_sp_mv _CNV_A_R_LINEAR_____111_CM 4 0. 1389. FORMAT "%7.2" AXIS_PTS_REF ldpm_mff_sp_mv_1_cybl /end AXIS_DESCR
/end CHARACTERISTIC
/begin MEASUREMENT tqi_req_tra "Indicated torque request after transient torque function" SWORD _CNV_A_R_LINEAR_____31_CM 1 100. -1024. 1023.96875 DISPLAY_IDENTIFIER TQI_REQ_TRA ECU_ADDRESS 0xd000a148 FORMAT "%6.2" /end MEASUREMENT
/begin MEASUREMENT lv_act_aj "LV anti-jerk function active" UBYTE _CNV_S_2_RANGE__0___1_CM 1 100. 0. 1. DISPLAY_IDENTIFIER LV_ACT_AJ ECU_ADDRESS 0xd000868c BIT_MASK 0x1 /end MEASUREMENT
/begin MEASUREMENT tco_ex "tco_2 adaptation" UBYTE _CNV_A_R_LINEAR_____17_CM 1 100. -48. 142.5 DISPLAY_IDENTIFIER TCO_EX ECU_ADDRESS 0xd0008744 FORMAT "%6.2" /end MEASUREMENT
/begin MEASUREMENT ecfpwm_ecf "electric fan control pulse width modulation" UBYTE _CNV_A_R_LINEAR_____5_CM 1 100. 0. 99.609375 DISPLAY_IDENTIFIER ECFPWM_ECF ECU_ADDRESS 0xd0008746 FORMAT "%9.6" /end MEASUREMENT
/begin MEASUREMENT tco_ex_mes "tco_2_mes adaptation" UBYTE _CNV_A_R_LINEAR_____17_CM 1 100. -48. 142.5 DISPLAY_IDENTIFIER TCO_EX_MES ECU_ADDRESS 0xd0008745 FORMAT "%6.2" /end MEASUREMENT
/begin MEASUREMENT lv_err_tco_ex "adaptation of tco_2 diagnosis to ERRM" UBYTE _CNV_S_2_RANGE__0___1_CM 1 100. 0. 1. DISPLAY_IDENTIFIER LV_ERR_TCO_EX ECU_ADDRESS 0xd0008747 BIT_MASK 0x1 /end MEASUREMENT
/begin MEASUREMENT lv_err_ect_mec "Boolean for electronic controlled thermostat mechanical error" UBYTE _CNV_S_2_RANGE__0___1_CM 1 100. 0. 1. DISPLAY_IDENTIFIER LV_ERR_ECT_MEC ECU_ADDRESS 0xd0008748 BIT_MASK 0x1 /end MEASUREMENT
/begin MEASUREMENT delta_lamb_sp_o2l_mdl[0] "Lambda set point shift of catalyst o2 loading condition function" SWORD _CNV_A_R_LINEAR_____24_CM 1 100. -0.125 0.125 DISPLAY_IDENTIFIER DELTA_LAMB_SP_O2L_MDL[0] ECU_ADDRESS 0xd000a280 FORMAT "%8.5" /end MEASUREMENT
/begin MEASUREMENT delta_lamb_sp_o2l_mdl[1] "Lambda set point shift of catalyst o2 loading condition function" SWORD _CNV_A_R_LINEAR_____24_CM 1 100. -0.125 0.125 DISPLAY_IDENTIFIER DELTA_LAMB_SP_O2L_MDL[1] ECU_ADDRESS 0xd000a282 FORMAT "%8.5" /end MEASUREMENT
/begin MEASUREMENT cat_diag_mod_6[0] "Cat. Diag. value for OBD Scantools Mod 6 output" UBYTE _CNV_A_R_LINEAR_____266_CM 1 100. 0. 1.984375 DISPLAY_IDENTIFIER CAT_DIAG_MOD_6[0] ECU_ADDRESS 0xd0008700 FORMAT "%8.6" /end MEASUREMENT
/begin MEASUREMENT cat_diag_mod_6[1] "Cat. Diag. value for OBD Scantools Mod 6 output" UBYTE _CNV_A_R_LINEAR_____266_CM 1 100. 0. 1.984375 DISPLAY_IDENTIFIER CAT_DIAG_MOD_6[1] ECU_ADDRESS 0xd0008701 FORMAT "%8.6" /end MEASUREMENT
/begin MEASUREMENT lv_lam_adj_rng_vld_cat_diag_1 "Boolean flag indicating Trim Ctr P-Share is inside a calibrateable window" UBYTE _CNV_S_2_RANGE__0___1_CM 1 100. 0. 1. DISPLAY_IDENTIFIER LV_LAM_ADJ_RNG_VLD_CAT_DIAG_1 ECU_ADDRESS 0xd0008704 /end MEASUREMENT
/begin MEASUREMENT lv_lam_adj_rng_vld_cat_diag_2 "Boolean flag indicating Trim Ctr P-Share is inside a calibrateable window" UBYTE _CNV_S_2_RANGE__0___1_CM 1 100. 0. 1. DISPLAY_IDENTIFIER LV_LAM_ADJ_RNG_VLD_CAT_DIAG_2 ECU_ADDRESS 0xd0008705 /end MEASUREMENT
/begin MEASUREMENT amp_mdl "Ambient pressure (modelled)" UWORD _CNV_A_R_LINEAR_____146_CM 1 100. 0. 5434.25976563 DISPLAY_IDENTIFIER AMP_MDL ECU_ADDRESS 0xd000a328 FORMAT "%7.2" /end MEASUREMENT
/begin MEASUREMENT amp "Ambient pressure (measured or adapted)" UWORD _CNV_A_R_LINEAR_____146_CM 1 100. 0. 5434.25976563 DISPLAY_IDENTIFIER AMP ECU_ADDRESS 0xd000a324 FORMAT "%7.2" /end MEASUREMENT
/begin MEASUREMENT amp_ad "Ambient pressure (adapted)" UWORD _CNV_A_R_LINEAR_____146_CM 1 100. 0. 5434.25976563 DISPLAY_IDENTIFIER AMP_AD ECU_ADDRESS 0xd000a326 FORMAT "%7.2" /end MEASUREMENT
/begin MEASUREMENT maf_int_pue "air mass flow integral during not pull cut off phase" UWORD _CNV_A_R_LINEAR_____314_CM 1 100. 0. 2912.66666666667 DISPLAY_IDENTIFIER MAF_INT_PUE ECU_ADDRESS 0xd000a32c FORMAT "%7.2" /end MEASUREMENT
/begin MEASUREMENT maf_int_puc "air mass flow integral during pull cut off phase" UWORD _CNV_A_R_LINEAR_____314_CM 1 100. 0. 2912.66666666667 DISPLAY_IDENTIFIER MAF_INT_PUC ECU_ADDRESS 0xd000a32a FORMAT "%7.2" /end MEASUREMENT
/begin MEASUREMENT pv "global degree of activation of the accelerator pedal (high resolution)" UWORD _CNV_A_R_CPULOAD__0_448_CM 1 100. 0. 99.90234375 DISPLAY_IDENTIFIER PV ECU_ADDRESS 0xd000a284 FORMAT "%5.2" /end MEASUREMENT
/begin MEASUREMENT er_stnd_bal "Normalized cylinder selective engine roughness values" SWORD _CNV_A_R_LINEAR_____140_CM 1 100. -325.78 325.770057983398 DISPLAY_IDENTIFIER ER_STND_BAL ECU_ADDRESS 0xd0000844 FORMAT "%8.3" /end MEASUREMENT
/begin MEASUREMENT er_stnd_fil_bal "Normalized cylinder selective engine roughness values after median filter" SWORD _CNV_A_R_LINEAR_____140_CM 1 100. -325.78 325.770057983398 DISPLAY_IDENTIFIER ER_STND_FIL_BAL ECU_ADDRESS 0xd0000846 FORMAT "%8.3" /end MEASUREMENT
/begin MEASUREMENT er_stnd_mmv_bal[0] "Filtered normalized cylinder selective engine roughness values" SWORD _CNV_A_R_LINEAR_____140_CM 1 100. -325.78 325.770057983398 DISPLAY_IDENTIFIER ER_STND_MMV_BAL[0] ECU_ADDRESS 0xd000a82c FORMAT "%8.3" /end MEASUREMENT
/begin MEASUREMENT er_stnd_mmv_bal[1] "Filtered normalized cylinder selective engine roughness values" SWORD _CNV_A_R_LINEAR_____140_CM 1 100. -325.78 325.770057983398 DISPLAY_IDENTIFIER ER_STND_MMV_BAL[1] ECU_ADDRESS 0xd000a82e FORMAT "%8.3" /end MEASUREMENT
/begin MEASUREMENT er_stnd_mmv_bal[2] "Filtered normalized cylinder selective engine roughness values" SWORD _CNV_A_R_LINEAR_____140_CM 1 100. -325.78 325.770057983398 DISPLAY_IDENTIFIER ER_STND_MMV_BAL[2] ECU_ADDRESS 0xd000a830 FORMAT "%8.3" /end MEASUREMENT
/begin MEASUREMENT er_stnd_mmv_bal[3] "Filtered normalized cylinder selective engine roughness values" SWORD _CNV_A_R_LINEAR_____140_CM 1 100. -325.78 325.770057983398 DISPLAY_IDENTIFIER ER_STND_MMV_BAL[3] ECU_ADDRESS 0xd000a832 FORMAT "%8.3" /end MEASUREMENT
/begin MEASUREMENT er_stnd_mmv_bal[4] "Filtered normalized cylinder selective engine roughness values" SWORD _CNV_A_R_LINEAR_____140_CM 1 100. -325.78 325.770057983398 DISPLAY_IDENTIFIER ER_STND_MMV_BAL[4] ECU_ADDRESS 0xd000a834 FORMAT "%8.3" /end MEASUREMENT
/begin MEASUREMENT er_stnd_mmv_bal[5] "Filtered normalized cylinder selective engine roughness values" SWORD _CNV_A_R_LINEAR_____140_CM 1 100. -325.78 325.770057983398 DISPLAY_IDENTIFIER ER_STND_MMV_BAL[5] ECU_ADDRESS 0xd000a836 FORMAT "%8.3" /end MEASUREMENT
/begin MEASUREMENT er_stnd_mmv_bal[6] "Filtered normalized cylinder selective engine roughness values" SWORD _CNV_A_R_LINEAR_____140_CM 1 100. -325.78 325.770057983398 DISPLAY_IDENTIFIER ER_STND_MMV_BAL[6] ECU_ADDRESS 0xd000a838 FORMAT "%8.3" /end MEASUREMENT
/begin MEASUREMENT er_stnd_mmv_bal[7] "Filtered normalized cylinder selective engine roughness values" SWORD _CNV_A_R_LINEAR_____140_CM 1 100. -325.78 325.770057983398 DISPLAY_IDENTIFIER ER_STND_MMV_BAL[7] ECU_ADDRESS 0xd000a83a FORMAT "%8.3" /end MEASUREMENT
/begin MEASUREMENT er_stnd_mmv_mv_bal "Mean value of all engine roughness values of the last [NC_CYL_NR] segments" SWORD _CNV_A_R_LINEAR_____140_CM 1 100. -325.78 325.770057983398 DISPLAY_IDENTIFIER ER_STND_MMV_MV_BAL ECU_ADDRESS 0xd0000848 FORMAT "%8.3" /end MEASUREMENT
/begin MEASUREMENT er_stnd_mmv_dif_bal[0] "Difference of filtered normalized and average engine roughness value" SWORD _CNV_A_R_LINEAR_____140_CM 1 100. -325.78 325.770057983398 DISPLAY_IDENTIFIER ER_STND_MMV_DIF_BAL[0] ECU_ADDRESS 0xd000a83c FORMAT "%8.3" /end MEASUREMENT
/begin MEASUREMENT er_stnd_mmv_dif_bal[1] "Difference of filtered normalized and average engine roughness value" SWORD _CNV_A_R_LINEAR_____140_CM 1 100. -325.78 325.770057983398 DISPLAY_IDENTIFIER ER_STND_MMV_DIF_BAL[1] ECU_ADDRESS 0xd000a83e FORMAT "%8.3" /end MEASUREMENT
/begin MEASUREMENT er_stnd_mmv_dif_bal[2] "Difference of filtered normalized and average engine roughness value" SWORD _CNV_A_R_LINEAR_____140_CM 1 100. -325.78 325.770057983398 DISPLAY_IDENTIFIER ER_STND_MMV_DIF_BAL[2] ECU_ADDRESS 0xd000a840 FORMAT "%8.3" /end MEASUREMENT
/begin MEASUREMENT er_stnd_mmv_dif_bal[3] "Difference of filtered normalized and average engine roughness value" SWORD _CNV_A_R_LINEAR_____140_CM 1 100. -325.78 325.770057983398 DISPLAY_IDENTIFIER ER_STND_MMV_DIF_BAL[3] ECU_ADDRESS 0xd000a842 FORMAT "%8.3" /end MEASUREMENT
/begin MEASUREMENT er_stnd_mmv_dif_bal[4] "Difference of filtered normalized and average engine roughness value" SWORD _CNV_A_R_LINEAR_____140_CM 1 100. -325.78 325.770057983398 DISPLAY_IDENTIFIER ER_STND_MMV_DIF_BAL[4] ECU_ADDRESS 0xd000a844 FORMAT "%8.3" /end MEASUREMENT
/begin MEASUREMENT er_stnd_mmv_dif_bal[5] "Difference of filtered normalized and average engine roughness value" SWORD _CNV_A_R_LINEAR_____140_CM 1 100. -325.78 325.770057983398 DISPLAY_IDENTIFIER ER_STND_MMV_DIF_BAL[5] ECU_ADDRESS 0xd000a846 FORMAT "%8.3" /end MEASUREMENT
/begin MEASUREMENT er_stnd_mmv_dif_bal[6] "Difference of filtered normalized and average engine roughness value" SWORD _CNV_A_R_LINEAR_____140_CM 1 100. -325.78 325.770057983398 DISPLAY_IDENTIFIER ER_STND_MMV_DIF_BAL[6] ECU_ADDRESS 0xd000a848 FORMAT "%8.3" /end MEASUREMENT
/begin MEASUREMENT er_stnd_mmv_dif_bal[7] "Difference of filtered normalized and average engine roughness value" SWORD _CNV_A_R_LINEAR_____140_CM 1 100. -325.78 325.770057983398 DISPLAY_IDENTIFIER ER_STND_MMV_DIF_BAL[7] ECU_ADDRESS 0xd000a84a FORMAT "%8.3" /end MEASUREMENT
/begin MEASUREMENT er_stnd_mmv_std_bal[0] "Filtered normalized engine roughness values for calculation of the standard deviation" SWORD _CNV_A_R_LINEAR_____140_CM 1 100. -325.78 325.770057983398 DISPLAY_IDENTIFIER ER_STND_MMV_STD_BAL[0] ECU_ADDRESS 0xd000a85c FORMAT "%8.3" /end MEASUREMENT
/begin MEASUREMENT er_stnd_mmv_std_bal[1] "Filtered normalized engine roughness values for calculation of the standard deviation" SWORD _CNV_A_R_LINEAR_____140_CM 1 100. -325.78 325.770057983398 DISPLAY_IDENTIFIER ER_STND_MMV_STD_BAL[1] ECU_ADDRESS 0xd000a85e FORMAT "%8.3" /end MEASUREMENT
/begin MEASUREMENT er_stnd_mmv_std_bal[2] "Filtered normalized engine roughness values for calculation of the standard deviation" SWORD _CNV_A_R_LINEAR_____140_CM 1 100. -325.78 325.770057983398 DISPLAY_IDENTIFIER ER_STND_MMV_STD_BAL[2] ECU_ADDRESS 0xd000a860 FORMAT "%8.3" /end MEASUREMENT
/begin MEASUREMENT er_stnd_mmv_std_bal[3] "Filtered normalized engine roughness values for calculation of the standard deviation" SWORD _CNV_A_R_LINEAR_____140_CM 1 100. -325.78 325.770057983398 DISPLAY_IDENTIFIER ER_STND_MMV_STD_BAL[3] ECU_ADDRESS 0xd000a862 FORMAT "%8.3" /end MEASUREMENT
/begin MEASUREMENT er_stnd_mmv_std_bal[4] "Filtered normalized engine roughness values for calculation of the standard deviation" SWORD _CNV_A_R_LINEAR_____140_CM 1 100. -325.78 325.770057983398 DISPLAY_IDENTIFIER ER_STND_MMV_STD_BAL[4] ECU_ADDRESS 0xd000a864 FORMAT "%8.3" /end MEASUREMENT
/begin MEASUREMENT er_stnd_mmv_std_bal[5] "Filtered normalized engine roughness values for calculation of the standard deviation" SWORD _CNV_A_R_LINEAR_____140_CM 1 100. -325.78 325.770057983398 DISPLAY_IDENTIFIER ER_STND_MMV_STD_BAL[5] ECU_ADDRESS 0xd000a866 FORMAT "%8.3" /end MEASUREMENT
/begin MEASUREMENT er_stnd_mmv_std_bal[6] "Filtered normalized engine roughness values for calculation of the standard deviation" SWORD _CNV_A_R_LINEAR_____140_CM 1 100. -325.78 325.770057983398 DISPLAY_IDENTIFIER ER_STND_MMV_STD_BAL[6] ECU_ADDRESS 0xd000a868 FORMAT "%8.3" /end MEASUREMENT
/begin MEASUREMENT er_stnd_mmv_std_bal[7] "Filtered normalized engine roughness values for calculation of the standard deviation" SWORD _CNV_A_R_LINEAR_____140_CM 1 100. -325.78 325.770057983398 DISPLAY_IDENTIFIER ER_STND_MMV_STD_BAL[7] ECU_ADDRESS 0xd000a86a FORMAT "%8.3" /end MEASUREMENT
/begin MEASUREMENT er_std_dif_bal "Difference of the filtered normalized and normalized engine roughness values for calc. of the standard deviation" SWORD _CNV_A_R_LINEAR_____140_CM 1 100. -325.78 325.770057983398 DISPLAY_IDENTIFIER ER_STD_DIF_BAL ECU_ADDRESS 0xd000084a FORMAT "%8.3" /end MEASUREMENT
/begin MEASUREMENT er_std_bal[0] "Standard deviation of the engine roughness" SWORD _CNV_A_R_LINEAR_____140_CM 1 100. -325.78 325.770057983398 DISPLAY_IDENTIFIER ER_STD_BAL[0] ECU_ADDRESS 0xd000084c FORMAT "%8.3" /end MEASUREMENT
/begin MEASUREMENT er_std_bal[1] "Standard deviation of the engine roughness" SWORD _CNV_A_R_LINEAR_____140_CM 1 100. -325.78 325.770057983398 DISPLAY_IDENTIFIER ER_STD_BAL[1] ECU_ADDRESS 0xd000084e FORMAT "%8.3" /end MEASUREMENT
/begin MEASUREMENT er_std_bal[2] "Standard deviation of the engine roughness" SWORD _CNV_A_R_LINEAR_____140_CM 1 100. -325.78 325.770057983398 DISPLAY_IDENTIFIER ER_STD_BAL[2] ECU_ADDRESS 0xd0000850 FORMAT "%8.3" /end MEASUREMENT
/begin MEASUREMENT er_std_bal[3] "Standard deviation of the engine roughness" SWORD _CNV_A_R_LINEAR_____140_CM 1 100. -325.78 325.770057983398 DISPLAY_IDENTIFIER ER_STD_BAL[3] ECU_ADDRESS 0xd0000852 FORMAT "%8.3" /end MEASUREMENT
/begin MEASUREMENT er_std_bal[4] "Standard deviation of the engine roughness" SWORD _CNV_A_R_LINEAR_____140_CM 1 100. -325.78 325.770057983398 DISPLAY_IDENTIFIER ER_STD_BAL[4] ECU_ADDRESS 0xd0000854 FORMAT "%8.3" /end MEASUREMENT
/begin MEASUREMENT er_std_bal[5] "Standard deviation of the engine roughness" SWORD _CNV_A_R_LINEAR_____140_CM 1 100. -325.78 325.770057983398 DISPLAY_IDENTIFIER ER_STD_BAL[5] ECU_ADDRESS 0xd0000856 FORMAT "%8.3" /end MEASUREMENT
/begin MEASUREMENT er_std_bal[6] "Standard deviation of the engine roughness" SWORD _CNV_A_R_LINEAR_____140_CM 1 100. -325.78 325.770057983398 DISPLAY_IDENTIFIER ER_STD_BAL[6] ECU_ADDRESS 0xd0000858 FORMAT "%8.3" /end MEASUREMENT
/begin MEASUREMENT er_std_bal[7] "Standard deviation of the engine roughness" SWORD _CNV_A_R_LINEAR_____140_CM 1 100. -325.78 325.770057983398 DISPLAY_IDENTIFIER ER_STD_BAL[7] ECU_ADDRESS 0xd000085a FORMAT "%8.3" /end MEASUREMENT
/begin MEASUREMENT er_std_mmv_bal[0] "Filtered standard deviation of the engine roughness" SWORD _CNV_A_R_LINEAR_____140_CM 1 100. -325.78 325.770057983398 DISPLAY_IDENTIFIER ER_STD_MMV_BAL[0] ECU_ADDRESS 0xd000a84c FORMAT "%8.3" /end MEASUREMENT
/begin MEASUREMENT er_std_mmv_bal[1] "Filtered standard deviation of the engine roughness" SWORD _CNV_A_R_LINEAR_____140_CM 1 100. -325.78 325.770057983398 DISPLAY_IDENTIFIER ER_STD_MMV_BAL[1] ECU_ADDRESS 0xd000a84e FORMAT "%8.3" /end MEASUREMENT
/begin MEASUREMENT er_std_mmv_bal[2] "Filtered standard deviation of the engine roughness" SWORD _CNV_A_R_LINEAR_____140_CM 1 100. -325.78 325.770057983398 DISPLAY_IDENTIFIER ER_STD_MMV_BAL[2] ECU_ADDRESS 0xd000a850 FORMAT "%8.3" /end MEASUREMENT
/begin MEASUREMENT er_std_mmv_bal[3] "Filtered standard deviation of the engine roughness" SWORD _CNV_A_R_LINEAR_____140_CM 1 100. -325.78 325.770057983398 DISPLAY_IDENTIFIER ER_STD_MMV_BAL[3] ECU_ADDRESS 0xd000a852 FORMAT "%8.3" /end MEASUREMENT
/begin MEASUREMENT er_std_mmv_bal[4] "Filtered standard deviation of the engine roughness" SWORD _CNV_A_R_LINEAR_____140_CM 1 100. -325.78 325.770057983398 DISPLAY_IDENTIFIER ER_STD_MMV_BAL[4] ECU_ADDRESS 0xd000a854 FORMAT "%8.3" /end MEASUREMENT
/begin MEASUREMENT er_std_mmv_bal[5] "Filtered standard deviation of the engine roughness" SWORD _CNV_A_R_LINEAR_____140_CM 1 100. -325.78 325.770057983398 DISPLAY_IDENTIFIER ER_STD_MMV_BAL[5] ECU_ADDRESS 0xd000a856 FORMAT "%8.3" /end MEASUREMENT
/begin MEASUREMENT er_std_mmv_bal[6] "Filtered standard deviation of the engine roughness" SWORD _CNV_A_R_LINEAR_____140_CM 1 100. -325.78 325.770057983398 DISPLAY_IDENTIFIER ER_STD_MMV_BAL[6] ECU_ADDRESS 0xd000a858 FORMAT "%8.3" /end MEASUREMENT
/begin MEASUREMENT er_std_mmv_bal[7] "Filtered standard deviation of the engine roughness" SWORD _CNV_A_R_LINEAR_____140_CM 1 100. -325.78 325.770057983398 DISPLAY_IDENTIFIER ER_STD_MMV_BAL[7] ECU_ADDRESS 0xd000a85a FORMAT "%8.3" /end MEASUREMENT
/begin MEASUREMENT drv1_stnd_bal "Standardized acceleration component of the ER value" SWORD _CNV_A_R_LINEAR_____140_CM 1 100. -325.78 325.770057983398 DISPLAY_IDENTIFIER DRV1_STND_BAL ECU_ADDRESS 0xd000085c FORMAT "%8.3" /end MEASUREMENT
/begin MEASUREMENT dly_drv1_stnd_bal "Segment delay for acceleration fade out of cylinder balancing" UWORD _CNV_A_R_LINEAR_____0_CM 1 100. 0. 65535. DISPLAY_IDENTIFIER DLY_DRV1_STND_BAL ECU_ADDRESS 0xd0000840 FORMAT "%5.0" /end MEASUREMENT
/begin MEASUREMENT ctr_dly_drv1_stnd_bal "Segment delay counter for acceleration fade out of cylinder balancing" UWORD _CNV_A_R_LINEAR_____0_CM 1 100. 0. 65535. DISPLAY_IDENTIFIER CTR_DLY_DRV1_STND_BAL ECU_ADDRESS 0xd0000842 FORMAT "%5.0" /end MEASUREMENT
/begin MEASUREMENT lv_drv1_stnd_bal_fdout "Flag for acceleration fade out of cylinder balancing" UBYTE _CNV_S_2_RANGE__0___1_CM 1 100. 0. 1. DISPLAY_IDENTIFIER LV_DRV1_STND_BAL_FDOUT ECU_ADDRESS 0xd0008c90 BIT_MASK 0x1 /end MEASUREMENT
/begin CHARACTERISTIC c_crlc_er_stnd_bal "Correlation constant for ER_STND_FIL_BAL value filter" VALUE 0xa080bad1 _REC_VAL_20_u1 0.99609375 _CNV_A_R_LINEAR_____28_CM 0. 0.99609375 DISPLAY_IDENTIFIER C_CRLC_ER_STND_BAL FORMAT "%5.3" /end CHARACTERISTIC
/begin CHARACTERISTIC c_crlc_er_std_bal "Correlation constant for ER_STND_FIL_BAL value filter for standard deviation" VALUE 0xa080bacf _REC_VAL_20_u1 0.99609375 _CNV_A_R_LINEAR_____28_CM 0. 0.99609375 DISPLAY_IDENTIFIER C_CRLC_ER_STD_BAL FORMAT "%5.3" /end CHARACTERISTIC
/begin CHARACTERISTIC c_crlc_er_std_mmv_bal "Correlation constant for ER_STD_BAL value filter" VALUE 0xa080bad0 _REC_VAL_20_u1 0.99609375 _CNV_A_R_LINEAR_____28_CM 0. 0.99609375 DISPLAY_IDENTIFIER C_CRLC_ER_STD_MMV_BAL FORMAT "%5.3" /end CHARACTERISTIC
/begin CHARACTERISTIC c_fac_er_std_neg_bal "Weighing factor for negative ER_STD_DIF_BAL values" VALUE 0xa080bcca _REC_VAL_20_u1 0.99609375 _CNV_A_R_LINEAR_____28_CM 0. 0.99609375 DISPLAY_IDENTIFIER C_FAC_ER_STD_NEG_BAL FORMAT "%5.3" /end CHARACTERISTIC
/begin CHARACTERISTIC c_fac_er_std_pos_bal "Weighing factor for positive ER_STD_DIF_BAL values" VALUE 0xa080bccb _REC_VAL_20_u1 0.99609375 _CNV_A_R_LINEAR_____28_CM 0. 0.99609375 DISPLAY_IDENTIFIER C_FAC_ER_STD_POS_BAL FORMAT "%5.3" /end CHARACTERISTIC
/begin CHARACTERISTIC c_ctr_dly_drv1_stnd_bal_dec "Segment delay counter decrement value" VALUE 0xa080bb83 _REC_VAL_20_u1 255. _CNV_A_R_LINEAR_____0_CM 0. 255. DISPLAY_IDENTIFIER C_CTR_DLY_DRV1_STND_BAL_DEC FORMAT "%3.0" /end CHARACTERISTIC
/begin AXIS_PTS ldp_drv1_stnd_bal_ip_dly_bal "" 0xa0808570 drv1_stnd_bal _REC_AXS_20_u2 651.5500579833979 _CNV_A_R_LINEAR_____143_CM 8 -325.78 325.770057983398 FORMAT "%8.3" /end AXIS_PTS
/begin CHARACTERISTIC ip_dly_drv1_stnd_bal "Segment delay counter start value" CURVE 0xa080a130 _REC_CUR_20_u2_u2 65535. _CNV_A_R_LINEAR_____0_CM 0. 65535. DISPLAY_IDENTIFIER IP_DLY_DRV1_STND_BAL FORMAT "%5.0"
 /begin AXIS_DESCR COM_AXIS drv1_stnd_bal _CNV_A_R_LINEAR_____143_CM 8 -325.78 325.770057983398 FORMAT "%8.3" AXIS_PTS_REF ldp_drv1_stnd_bal_ip_dly_bal /end AXIS_DESCR
/end CHARACTERISTIC
/begin MEASUREMENT er_stnd_fac_ti_er_bal "Controller input value at multiple path of cylinder balancing via TI intervention" SWORD _CNV_A_R_LINEAR_____140_CM 1 100. -325.78 325.770057983398 DISPLAY_IDENTIFIER ER_STND_FAC_TI_ER_BAL ECU_ADDRESS 0xd00007fa FORMAT "%8.3" /end MEASUREMENT
/begin MEASUREMENT fac_ti_er_bal_ctl "Controller output value at multiple path of cylinder balancing via TI intervention" SWORD _CNV_A_R_LINEAR_____259_CM 1 100. -1. 0.999969482421875 DISPLAY_IDENTIFIER FAC_TI_ER_BAL_CTL ECU_ADDRESS 0xd00007fc FORMAT "%8.5" /end MEASUREMENT
/begin MEASUREMENT fac_ti_er_bal_ctl_p "P-part of the controller output value at multiple path of cylinder balancing via TI intervention" SWORD _CNV_A_R_LINEAR_____259_CM 1 100. -1. 0.999969482421875 DISPLAY_IDENTIFIER FAC_TI_ER_BAL_CTL_P ECU_ADDRESS 0xd00007fe FORMAT "%8.5" /end MEASUREMENT
/begin MEASUREMENT fac_ti_er_bal_ctl_i[0] "I-part of the controller output value at multiple path of cylinder balancing via TI intervention" SWORD _CNV_A_R_LINEAR_____259_CM 1 100. -1. 0.999969482421875 DISPLAY_IDENTIFIER FAC_TI_ER_BAL_CTL_I[0] ECU_ADDRESS 0xd0000800 FORMAT "%8.5" /end MEASUREMENT
/begin MEASUREMENT fac_ti_er_bal_ctl_i[1] "I-part of the controller output value at multiple path of cylinder balancing via TI intervention" SWORD _CNV_A_R_LINEAR_____259_CM 1 100. -1. 0.999969482421875 DISPLAY_IDENTIFIER FAC_TI_ER_BAL_CTL_I[1] ECU_ADDRESS 0xd0000802 FORMAT "%8.5" /end MEASUREMENT
/begin MEASUREMENT fac_ti_er_bal_ctl_i[2] "I-part of the controller output value at multiple path of cylinder balancing via TI intervention" SWORD _CNV_A_R_LINEAR_____259_CM 1 100. -1. 0.999969482421875 DISPLAY_IDENTIFIER FAC_TI_ER_BAL_CTL_I[2] ECU_ADDRESS 0xd0000804 FORMAT "%8.5" /end MEASUREMENT
/begin MEASUREMENT fac_ti_er_bal_ctl_i[3] "I-part of the controller output value at multiple path of cylinder balancing via TI intervention" SWORD _CNV_A_R_LINEAR_____259_CM 1 100. -1. 0.999969482421875 DISPLAY_IDENTIFIER FAC_TI_ER_BAL_CTL_I[3] ECU_ADDRESS 0xd0000806 FORMAT "%8.5" /end MEASUREMENT
/begin MEASUREMENT fac_ti_er_bal_ctl_i[4] "I-part of the controller output value at multiple path of cylinder balancing via TI intervention" SWORD _CNV_A_R_LINEAR_____259_CM 1 100. -1. 0.999969482421875 DISPLAY_IDENTIFIER FAC_TI_ER_BAL_CTL_I[4] ECU_ADDRESS 0xd0000808 FORMAT "%8.5" /end MEASUREMENT
/begin MEASUREMENT fac_ti_er_bal_ctl_i[5] "I-part of the controller output value at multiple path of cylinder balancing via TI intervention" SWORD _CNV_A_R_LINEAR_____259_CM 1 100. -1. 0.999969482421875 DISPLAY_IDENTIFIER FAC_TI_ER_BAL_CTL_I[5] ECU_ADDRESS 0xd000080a FORMAT "%8.5" /end MEASUREMENT
/begin MEASUREMENT fac_ti_er_bal_ctl_i[6] "I-part of the controller output value at multiple path of cylinder balancing via TI intervention" SWORD _CNV_A_R_LINEAR_____259_CM 1 100. -1. 0.999969482421875 DISPLAY_IDENTIFIER FAC_TI_ER_BAL_CTL_I[6] ECU_ADDRESS 0xd000080c FORMAT "%8.5" /end MEASUREMENT
/begin MEASUREMENT fac_ti_er_bal_ctl_i[7] "I-part of the controller output value at multiple path of cylinder balancing via TI intervention" SWORD _CNV_A_R_LINEAR_____259_CM 1 100. -1. 0.999969482421875 DISPLAY_IDENTIFIER FAC_TI_ER_BAL_CTL_I[7] ECU_ADDRESS 0xd000080e FORMAT "%8.5" /end MEASUREMENT
/begin MEASUREMENT fac_ti_er_bal_ctl_max "Controller output value maximum limit reached at multiple path of cylinder balancing via TI intervention" UWORD _CNV_A_R_LINEAR_____0_CM 1 100. 0. 65535. DISPLAY_IDENTIFIER FAC_TI_ER_BAL_CTL_MAX ECU_ADDRESS 0xd00007f8 FORMAT "%5.0" /end MEASUREMENT
/begin MEASUREMENT fac_ti_er_bal_lim[0] "Limited controller output value at multiple path of cylinder balancing via TI intervention" SWORD _CNV_A_R_LINEAR_____259_CM 1 100. -1. 0.999969482421875 DISPLAY_IDENTIFIER FAC_TI_ER_BAL_LIM[0] ECU_ADDRESS 0xd0000810 FORMAT "%8.5" /end MEASUREMENT
/begin MEASUREMENT fac_ti_er_bal_lim[1] "Limited controller output value at multiple path of cylinder balancing via TI intervention" SWORD _CNV_A_R_LINEAR_____259_CM 1 100. -1. 0.999969482421875 DISPLAY_IDENTIFIER FAC_TI_ER_BAL_LIM[1] ECU_ADDRESS 0xd0000812 FORMAT "%8.5" /end MEASUREMENT
/begin MEASUREMENT fac_ti_er_bal_lim[2] "Limited controller output value at multiple path of cylinder balancing via TI intervention" SWORD _CNV_A_R_LINEAR_____259_CM 1 100. -1. 0.999969482421875 DISPLAY_IDENTIFIER FAC_TI_ER_BAL_LIM[2] ECU_ADDRESS 0xd0000814 FORMAT "%8.5" /end MEASUREMENT
/begin MEASUREMENT fac_ti_er_bal_lim[3] "Limited controller output value at multiple path of cylinder balancing via TI intervention" SWORD _CNV_A_R_LINEAR_____259_CM 1 100. -1. 0.999969482421875 DISPLAY_IDENTIFIER FAC_TI_ER_BAL_LIM[3] ECU_ADDRESS 0xd0000816 FORMAT "%8.5" /end MEASUREMENT
/begin MEASUREMENT fac_ti_er_bal_lim[4] "Limited controller output value at multiple path of cylinder balancing via TI intervention" SWORD _CNV_A_R_LINEAR_____259_CM 1 100. -1. 0.999969482421875 DISPLAY_IDENTIFIER FAC_TI_ER_BAL_LIM[4] ECU_ADDRESS 0xd0000818 FORMAT "%8.5" /end MEASUREMENT
/begin MEASUREMENT fac_ti_er_bal_lim[5] "Limited controller output value at multiple path of cylinder balancing via TI intervention" SWORD _CNV_A_R_LINEAR_____259_CM 1 100. -1. 0.999969482421875 DISPLAY_IDENTIFIER FAC_TI_ER_BAL_LIM[5] ECU_ADDRESS 0xd000081a FORMAT "%8.5" /end MEASUREMENT
/begin MEASUREMENT fac_ti_er_bal_lim[6] "Limited controller output value at multiple path of cylinder balancing via TI intervention" SWORD _CNV_A_R_LINEAR_____259_CM 1 100. -1. 0.999969482421875 DISPLAY_IDENTIFIER FAC_TI_ER_BAL_LIM[6] ECU_ADDRESS 0xd000081c FORMAT "%8.5" /end MEASUREMENT
/begin MEASUREMENT fac_ti_er_bal_lim[7] "Limited controller output value at multiple path of cylinder balancing via TI intervention" SWORD _CNV_A_R_LINEAR_____259_CM 1 100. -1. 0.999969482421875 DISPLAY_IDENTIFIER FAC_TI_ER_BAL_LIM[7] ECU_ADDRESS 0xd000081e FORMAT "%8.5" /end MEASUREMENT
/begin MEASUREMENT fac_ti_er_bal_cor[0] "Corrected multiple correction value for cylinder balancing via TI intervention" SWORD _CNV_A_R_LINEAR_____259_CM 1 100. -1. 0.999969482421875 DISPLAY_IDENTIFIER FAC_TI_ER_BAL_COR[0] ECU_ADDRESS 0xd0000820 FORMAT "%8.5" /end MEASUREMENT
/begin MEASUREMENT fac_ti_er_bal_cor[1] "Corrected multiple correction value for cylinder balancing via TI intervention" SWORD _CNV_A_R_LINEAR_____259_CM 1 100. -1. 0.999969482421875 DISPLAY_IDENTIFIER FAC_TI_ER_BAL_COR[1] ECU_ADDRESS 0xd0000822 FORMAT "%8.5" /end MEASUREMENT
/begin MEASUREMENT fac_ti_er_bal_cor[2] "Corrected multiple correction value for cylinder balancing via TI intervention" SWORD _CNV_A_R_LINEAR_____259_CM 1 100. -1. 0.999969482421875 DISPLAY_IDENTIFIER FAC_TI_ER_BAL_COR[2] ECU_ADDRESS 0xd0000824 FORMAT "%8.5" /end MEASUREMENT
/begin MEASUREMENT fac_ti_er_bal_cor[3] "Corrected multiple correction value for cylinder balancing via TI intervention" SWORD _CNV_A_R_LINEAR_____259_CM 1 100. -1. 0.999969482421875 DISPLAY_IDENTIFIER FAC_TI_ER_BAL_COR[3] ECU_ADDRESS 0xd0000826 FORMAT "%8.5" /end MEASUREMENT
/begin MEASUREMENT fac_ti_er_bal_cor[4] "Corrected multiple correction value for cylinder balancing via TI intervention" SWORD _CNV_A_R_LINEAR_____259_CM 1 100. -1. 0.999969482421875 DISPLAY_IDENTIFIER FAC_TI_ER_BAL_COR[4] ECU_ADDRESS 0xd0000828 FORMAT "%8.5" /end MEASUREMENT
/begin MEASUREMENT fac_ti_er_bal_cor[5] "Corrected multiple correction value for cylinder balancing via TI intervention" SWORD _CNV_A_R_LINEAR_____259_CM 1 100. -1. 0.999969482421875 DISPLAY_IDENTIFIER FAC_TI_ER_BAL_COR[5] ECU_ADDRESS 0xd000082a FORMAT "%8.5" /end MEASUREMENT
/begin MEASUREMENT fac_ti_er_bal_cor[6] "Corrected multiple correction value for cylinder balancing via TI intervention" SWORD _CNV_A_R_LINEAR_____259_CM 1 100. -1. 0.999969482421875 DISPLAY_IDENTIFIER FAC_TI_ER_BAL_COR[6] ECU_ADDRESS 0xd000082c FORMAT "%8.5" /end MEASUREMENT
/begin MEASUREMENT fac_ti_er_bal_cor[7] "Corrected multiple correction value for cylinder balancing via TI intervention" SWORD _CNV_A_R_LINEAR_____259_CM 1 100. -1. 0.999969482421875 DISPLAY_IDENTIFIER FAC_TI_ER_BAL_COR[7] ECU_ADDRESS 0xd000082e FORMAT "%8.5" /end MEASUREMENT
/begin MEASUREMENT fac_ti_er_bal[0] "Multiple correction value for cylinder balancing via TI intervention" SWORD _CNV_A_R_LINEAR_____259_CM 1 100. -1. 0.999969482421875 DISPLAY_IDENTIFIER FAC_TI_ER_BAL[0] ECU_ADDRESS 0xd000a88c FORMAT "%8.5" /end MEASUREMENT
/begin MEASUREMENT fac_ti_er_bal[1] "Multiple correction value for cylinder balancing via TI intervention" SWORD _CNV_A_R_LINEAR_____259_CM 1 100. -1. 0.999969482421875 DISPLAY_IDENTIFIER FAC_TI_ER_BAL[1] ECU_ADDRESS 0xd000a88e FORMAT "%8.5" /end MEASUREMENT
/begin MEASUREMENT fac_ti_er_bal[2] "Multiple correction value for cylinder balancing via TI intervention" SWORD _CNV_A_R_LINEAR_____259_CM 1 100. -1. 0.999969482421875 DISPLAY_IDENTIFIER FAC_TI_ER_BAL[2] ECU_ADDRESS 0xd000a890 FORMAT "%8.5" /end MEASUREMENT
/begin MEASUREMENT fac_ti_er_bal[3] "Multiple correction value for cylinder balancing via TI intervention" SWORD _CNV_A_R_LINEAR_____259_CM 1 100. -1. 0.999969482421875 DISPLAY_IDENTIFIER FAC_TI_ER_BAL[3] ECU_ADDRESS 0xd000a892 FORMAT "%8.5" /end MEASUREMENT
/begin MEASUREMENT fac_ti_er_bal[4] "Multiple correction value for cylinder balancing via TI intervention" SWORD _CNV_A_R_LINEAR_____259_CM 1 100. -1. 0.999969482421875 DISPLAY_IDENTIFIER FAC_TI_ER_BAL[4] ECU_ADDRESS 0xd000a894 FORMAT "%8.5" /end MEASUREMENT
/begin MEASUREMENT fac_ti_er_bal[5] "Multiple correction value for cylinder balancing via TI intervention" SWORD _CNV_A_R_LINEAR_____259_CM 1 100. -1. 0.999969482421875 DISPLAY_IDENTIFIER FAC_TI_ER_BAL[5] ECU_ADDRESS 0xd000a896 FORMAT "%8.5" /end MEASUREMENT
/begin MEASUREMENT fac_ti_er_bal[6] "Multiple correction value for cylinder balancing via TI intervention" SWORD _CNV_A_R_LINEAR_____259_CM 1 100. -1. 0.999969482421875 DISPLAY_IDENTIFIER FAC_TI_ER_BAL[6] ECU_ADDRESS 0xd000a898 FORMAT "%8.5" /end MEASUREMENT
/begin MEASUREMENT fac_ti_er_bal[7] "Multiple correction value for cylinder balancing via TI intervention" SWORD _CNV_A_R_LINEAR_____259_CM 1 100. -1. 0.999969482421875 DISPLAY_IDENTIFIER FAC_TI_ER_BAL[7] ECU_ADDRESS 0xd000a89a FORMAT "%8.5" /end MEASUREMENT
/begin MEASUREMENT fac_ti_ad_er_bal[0] "Multiple adaptation value for cylinder balancing via TI intervention" SWORD _CNV_A_R_LINEAR_____259_CM 1 100. -1. 0.999969482421875 DISPLAY_IDENTIFIER FAC_TI_AD_ER_BAL[0] ECU_ADDRESS 0xd000a89c FORMAT "%8.5" /end MEASUREMENT
/begin MEASUREMENT fac_ti_ad_er_bal[1] "Multiple adaptation value for cylinder balancing via TI intervention" SWORD _CNV_A_R_LINEAR_____259_CM 1 100. -1. 0.999969482421875 DISPLAY_IDENTIFIER FAC_TI_AD_ER_BAL[1] ECU_ADDRESS 0xd000a89e FORMAT "%8.5" /end MEASUREMENT
/begin MEASUREMENT fac_ti_ad_er_bal[2] "Multiple adaptation value for cylinder balancing via TI intervention" SWORD _CNV_A_R_LINEAR_____259_CM 1 100. -1. 0.999969482421875 DISPLAY_IDENTIFIER FAC_TI_AD_ER_BAL[2] ECU_ADDRESS 0xd000a8a0 FORMAT "%8.5" /end MEASUREMENT
/begin MEASUREMENT fac_ti_ad_er_bal[3] "Multiple adaptation value for cylinder balancing via TI intervention" SWORD _CNV_A_R_LINEAR_____259_CM 1 100. -1. 0.999969482421875 DISPLAY_IDENTIFIER FAC_TI_AD_ER_BAL[3] ECU_ADDRESS 0xd000a8a2 FORMAT "%8.5" /end MEASUREMENT
/begin MEASUREMENT fac_ti_ad_er_bal[4] "Multiple adaptation value for cylinder balancing via TI intervention" SWORD _CNV_A_R_LINEAR_____259_CM 1 100. -1. 0.999969482421875 DISPLAY_IDENTIFIER FAC_TI_AD_ER_BAL[4] ECU_ADDRESS 0xd000a8a4 FORMAT "%8.5" /end MEASUREMENT
/begin MEASUREMENT fac_ti_ad_er_bal[5] "Multiple adaptation value for cylinder balancing via TI intervention" SWORD _CNV_A_R_LINEAR_____259_CM 1 100. -1. 0.999969482421875 DISPLAY_IDENTIFIER FAC_TI_AD_ER_BAL[5] ECU_ADDRESS 0xd000a8a6 FORMAT "%8.5" /end MEASUREMENT
/begin MEASUREMENT fac_ti_ad_er_bal[6] "Multiple adaptation value for cylinder balancing via TI intervention" SWORD _CNV_A_R_LINEAR_____259_CM 1 100. -1. 0.999969482421875 DISPLAY_IDENTIFIER FAC_TI_AD_ER_BAL[6] ECU_ADDRESS 0xd000a8a8 FORMAT "%8.5" /end MEASUREMENT
/begin MEASUREMENT fac_ti_ad_er_bal[7] "Multiple adaptation value for cylinder balancing via TI intervention" SWORD _CNV_A_R_LINEAR_____259_CM 1 100. -1. 0.999969482421875 DISPLAY_IDENTIFIER FAC_TI_AD_ER_BAL[7] ECU_ADDRESS 0xd000a8aa FORMAT "%8.5" /end MEASUREMENT
/begin MEASUREMENT nr_cyc_fac_ti_er_bal_ctl_max "Corresponding segment number of the controller that has reached the maximum limit (multiple TI path)" UBYTE _CNV_A_R_LINEAR_____0_CM 1 100. 0. 255. DISPLAY_IDENTIFIER NR_CYC_FAC_TI_ER_BAL_CTL_MAX ECU_ADDRESS 0xd0000830 FORMAT "%3.0" /end MEASUREMENT
/begin CHARACTERISTIC c_er_stnd_thd_pos_fac_ti_bal "Positive threshold for ER input value at multiple path of cylinder balancing via TI intervention" VALUE 0xa080bca8 _REC_VAL_20_s2 651.5500579833979 _CNV_A_R_LINEAR_____140_CM -325.78 325.770057983398 DISPLAY_IDENTIFIER C_ER_STND_THD_POS_FAC_TI_BAL FORMAT "%8.3" /end CHARACTERISTIC
/begin CHARACTERISTIC c_er_stnd_thd_neg_fac_ti_bal "Negative threshold for ER input value at multiple path of  cylinder balancing via TI intervention" VALUE 0xa080bca4 _REC_VAL_20_s2 651.5500579833979 _CNV_A_R_LINEAR_____140_CM -325.78 325.770057983398 DISPLAY_IDENTIFIER C_ER_STND_THD_NEG_FAC_TI_BAL FORMAT "%8.3" /end CHARACTERISTIC
/begin CHARACTERISTIC c_fac_ti_er_bal_rst "Reset of multiple correction- and adaptation values for cylinder balancing via TI intervention" VALUE 0xa080bd00 _REC_VAL_20_u1 2. _CNV_S_3_CYBL_RANGE_797_CM 0. 2. DISPLAY_IDENTIFIER C_FAC_TI_ER_BAL_RST /end CHARACTERISTIC
/begin AXIS_PTS ldp_er_stnd_fac_ti_ip_p_er_bal "" 0xa08085ec er_stnd_fac_ti_er_bal _REC_AXS_20_u2 651.5500579833979 _CNV_A_R_LINEAR_____143_CM 8 -325.78 325.770057983398 FORMAT "%8.3" /end AXIS_PTS
/begin CHARACTERISTIC ip_fac_ti_p_er_bal "Controller P-part value for multiple path of cylinder balancing via TI intervention" CURVE 0xa080a7a8 _REC_CUR_20_u2_u2 1.99996948 _CNV_A_R_INJR_LINEA_465_CM -1. 0.99996948 DISPLAY_IDENTIFIER IP_FAC_TI_P_ER_BAL FORMAT "%8.5"
 /begin AXIS_DESCR COM_AXIS er_stnd_fac_ti_er_bal _CNV_A_R_LINEAR_____143_CM 8 -325.78 325.770057983398 FORMAT "%8.3" AXIS_PTS_REF ldp_er_stnd_fac_ti_ip_p_er_bal /end AXIS_DESCR
/end CHARACTERISTIC
/begin AXIS_PTS ldp_er_stnd_fac_ti_ip_i_er_bal "" 0xa08085d8 er_stnd_fac_ti_er_bal _REC_AXS_20_u2 651.5500579833979 _CNV_A_R_LINEAR_____143_CM 8 -325.78 325.770057983398 FORMAT "%8.3" /end AXIS_PTS
/begin CHARACTERISTIC ip_fac_ti_i_er_bal "Controller I-part value for multiple path of cylinder balancing via TI intervention" CURVE 0xa080a798 _REC_CUR_20_u2_u2 1.99996948 _CNV_A_R_INJR_LINEA_465_CM -1. 0.99996948 DISPLAY_IDENTIFIER IP_FAC_TI_I_ER_BAL FORMAT "%8.5"
 /begin AXIS_DESCR COM_AXIS er_stnd_fac_ti_er_bal _CNV_A_R_LINEAR_____143_CM 8 -325.78 325.770057983398 FORMAT "%8.3" AXIS_PTS_REF ldp_er_stnd_fac_ti_ip_i_er_bal /end AXIS_DESCR
/end CHARACTERISTIC
/begin CHARACTERISTIC lc_fac_ti_er_bal_rst_man "Manual reset of multiple correction values for cylinder balancing via TI intervention" VALUE 0xa080c573 _REC_VAL_20_u1 1. _CNV_A_R_LINEAR_____0_CM 0. 1. DISPLAY_IDENTIFIER LC_FAC_TI_ER_BAL_RST_MAN FORMAT "%1.0" /end CHARACTERISTIC
/begin CHARACTERISTIC c_fac_ti_er_bal_obd_max_neg "Negative maximum OBD limit for multiple correction value of cylinder balancing via TI intervention" VALUE 0xa080bcfc _REC_VAL_20_s2 1.999969482421875 _CNV_A_R_LINEAR_____259_CM -1. 0.999969482421875 DISPLAY_IDENTIFIER C_FAC_TI_ER_BAL_OBD_MAX_NEG FORMAT "%8.5" /end CHARACTERISTIC
/begin CHARACTERISTIC c_fac_ti_er_bal_ctl_max_pos "Positive maximum limit for controller output at multiple path of cylinder balancing via TI intervention" VALUE 0xa080bcfa _REC_VAL_20_s2 1.999969482421875 _CNV_A_R_LINEAR_____259_CM -1. 0.999969482421875 DISPLAY_IDENTIFIER C_FAC_TI_ER_BAL_CTL_MAX_POS FORMAT "%8.5" /end CHARACTERISTIC
/begin CHARACTERISTIC c_fac_ti_er_bal_obd_max_pos "Positive maximum OBD limit for multiple correction value of cylinder balancing via TI intervention" VALUE 0xa080bcfe _REC_VAL_20_s2 1.999969482421875 _CNV_A_R_LINEAR_____259_CM -1. 0.999969482421875 DISPLAY_IDENTIFIER C_FAC_TI_ER_BAL_OBD_MAX_POS FORMAT "%8.5" /end CHARACTERISTIC
/begin MEASUREMENT lv_er_stnd_fac_ti_er_bal "Flag for controller input at multiple path of cylinder balancing via TI intervention" UBYTE _CNV_S_2_RANGE__0___1_CM 1 100. 0. 1. DISPLAY_IDENTIFIER LV_ER_STND_FAC_TI_ER_BAL ECU_ADDRESS 0xd0000833 BIT_MASK 0x1 /end MEASUREMENT
/begin MEASUREMENT lv_mff_fac_er_bal_obd_max_pos[0] "Flag for maximum OBD limit reached at multiple part of engine roughness based cylinder balancing" UBYTE _CNV_S_2_RANGE__0___1_CM 1 100. 0. 1. DISPLAY_IDENTIFIER LV_MFF_FAC_ER_BAL_OBD_MAX_POS[0] ECU_ADDRESS 0xd0008ca4 BIT_MASK 0x1 /end MEASUREMENT
/begin MEASUREMENT lv_mff_fac_er_bal_obd_max_pos[1] "Flag for maximum OBD limit reached at multiple part of engine roughness based cylinder balancing" UBYTE _CNV_S_2_RANGE__0___1_CM 1 100. 0. 1. DISPLAY_IDENTIFIER LV_MFF_FAC_ER_BAL_OBD_MAX_POS[1] ECU_ADDRESS 0xd0008ca5 BIT_MASK 0x1 /end MEASUREMENT
/begin MEASUREMENT lv_mff_fac_er_bal_obd_max_pos[2] "Flag for maximum OBD limit reached at multiple part of engine roughness based cylinder balancing" UBYTE _CNV_S_2_RANGE__0___1_CM 1 100. 0. 1. DISPLAY_IDENTIFIER LV_MFF_FAC_ER_BAL_OBD_MAX_POS[2] ECU_ADDRESS 0xd0008ca6 BIT_MASK 0x1 /end MEASUREMENT
/begin MEASUREMENT lv_mff_fac_er_bal_obd_max_pos[3] "Flag for maximum OBD limit reached at multiple part of engine roughness based cylinder balancing" UBYTE _CNV_S_2_RANGE__0___1_CM 1 100. 0. 1. DISPLAY_IDENTIFIER LV_MFF_FAC_ER_BAL_OBD_MAX_POS[3] ECU_ADDRESS 0xd0008ca7 BIT_MASK 0x1 /end MEASUREMENT
/begin MEASUREMENT lv_mff_fac_er_bal_obd_max_pos[4] "Flag for maximum OBD limit reached at multiple part of engine roughness based cylinder balancing" UBYTE _CNV_S_2_RANGE__0___1_CM 1 100. 0. 1. DISPLAY_IDENTIFIER LV_MFF_FAC_ER_BAL_OBD_MAX_POS[4] ECU_ADDRESS 0xd0008ca8 BIT_MASK 0x1 /end MEASUREMENT
/begin MEASUREMENT lv_mff_fac_er_bal_obd_max_pos[5] "Flag for maximum OBD limit reached at multiple part of engine roughness based cylinder balancing" UBYTE _CNV_S_2_RANGE__0___1_CM 1 100. 0. 1. DISPLAY_IDENTIFIER LV_MFF_FAC_ER_BAL_OBD_MAX_POS[5] ECU_ADDRESS 0xd0008ca9 BIT_MASK 0x1 /end MEASUREMENT
/begin MEASUREMENT lv_mff_fac_er_bal_obd_max_pos[6] "Flag for maximum OBD limit reached at multiple part of engine roughness based cylinder balancing" UBYTE _CNV_S_2_RANGE__0___1_CM 1 100. 0. 1. DISPLAY_IDENTIFIER LV_MFF_FAC_ER_BAL_OBD_MAX_POS[6] ECU_ADDRESS 0xd0008caa BIT_MASK 0x1 /end MEASUREMENT
/begin MEASUREMENT lv_mff_fac_er_bal_obd_max_pos[7] "Flag for maximum OBD limit reached at multiple part of engine roughness based cylinder balancing" UBYTE _CNV_S_2_RANGE__0___1_CM 1 100. 0. 1. DISPLAY_IDENTIFIER LV_MFF_FAC_ER_BAL_OBD_MAX_POS[7] ECU_ADDRESS 0xd0008cab BIT_MASK 0x1 /end MEASUREMENT
/begin MEASUREMENT lv_mff_fac_er_bal_obd_max_neg[0] "Flag for minimum OBD limit reached at multiple part of engine roughness based cylinder balancing" UBYTE _CNV_S_2_RANGE__0___1_CM 1 100. 0. 1. DISPLAY_IDENTIFIER LV_MFF_FAC_ER_BAL_OBD_MAX_NEG[0] ECU_ADDRESS 0xd0008cac BIT_MASK 0x1 /end MEASUREMENT
/begin MEASUREMENT lv_mff_fac_er_bal_obd_max_neg[1] "Flag for minimum OBD limit reached at multiple part of engine roughness based cylinder balancing" UBYTE _CNV_S_2_RANGE__0___1_CM 1 100. 0. 1. DISPLAY_IDENTIFIER LV_MFF_FAC_ER_BAL_OBD_MAX_NEG[1] ECU_ADDRESS 0xd0008cad BIT_MASK 0x1 /end MEASUREMENT
/begin MEASUREMENT lv_mff_fac_er_bal_obd_max_neg[2] "Flag for minimum OBD limit reached at multiple part of engine roughness based cylinder balancing" UBYTE _CNV_S_2_RANGE__0___1_CM 1 100. 0. 1. DISPLAY_IDENTIFIER LV_MFF_FAC_ER_BAL_OBD_MAX_NEG[2] ECU_ADDRESS 0xd0008cae BIT_MASK 0x1 /end MEASUREMENT
/begin MEASUREMENT lv_mff_fac_er_bal_obd_max_neg[3] "Flag for minimum OBD limit reached at multiple part of engine roughness based cylinder balancing" UBYTE _CNV_S_2_RANGE__0___1_CM 1 100. 0. 1. DISPLAY_IDENTIFIER LV_MFF_FAC_ER_BAL_OBD_MAX_NEG[3] ECU_ADDRESS 0xd0008caf BIT_MASK 0x1 /end MEASUREMENT
/begin MEASUREMENT lv_mff_fac_er_bal_obd_max_neg[4] "Flag for minimum OBD limit reached at multiple part of engine roughness based cylinder balancing" UBYTE _CNV_S_2_RANGE__0___1_CM 1 100. 0. 1. DISPLAY_IDENTIFIER LV_MFF_FAC_ER_BAL_OBD_MAX_NEG[4] ECU_ADDRESS 0xd0008cb0 BIT_MASK 0x1 /end MEASUREMENT
/begin MEASUREMENT lv_mff_fac_er_bal_obd_max_neg[5] "Flag for minimum OBD limit reached at multiple part of engine roughness based cylinder balancing" UBYTE _CNV_S_2_RANGE__0___1_CM 1 100. 0. 1. DISPLAY_IDENTIFIER LV_MFF_FAC_ER_BAL_OBD_MAX_NEG[5] ECU_ADDRESS 0xd0008cb1 BIT_MASK 0x1 /end MEASUREMENT
/begin MEASUREMENT lv_mff_fac_er_bal_obd_max_neg[6] "Flag for minimum OBD limit reached at multiple part of engine roughness based cylinder balancing" UBYTE _CNV_S_2_RANGE__0___1_CM 1 100. 0. 1. DISPLAY_IDENTIFIER LV_MFF_FAC_ER_BAL_OBD_MAX_NEG[6] ECU_ADDRESS 0xd0008cb2 BIT_MASK 0x1 /end MEASUREMENT
/begin MEASUREMENT lv_mff_fac_er_bal_obd_max_neg[7] "Flag for minimum OBD limit reached at multiple part of engine roughness based cylinder balancing" UBYTE _CNV_S_2_RANGE__0___1_CM 1 100. 0. 1. DISPLAY_IDENTIFIER LV_MFF_FAC_ER_BAL_OBD_MAX_NEG[7] ECU_ADDRESS 0xd0008cb3 BIT_MASK 0x1 /end MEASUREMENT
/begin CHARACTERISTIC lc_fac_ti_ad_er_bal_rst_man "Manual reset of multiple adaptation values for cylinder balancing via TI intervention" VALUE 0xa080c570 _REC_VAL_20_u1 1. _CNV_A_R_LINEAR_____0_CM 0. 1. DISPLAY_IDENTIFIER LC_FAC_TI_AD_ER_BAL_RST_MAN FORMAT "%1.0" /end CHARACTERISTIC
/begin CHARACTERISTIC lc_fac_ti_er_bal_cor "Manual switch for overall correction of controller output values for cylinder balancing via multiple TI intervention" VALUE 0xa080c572 _REC_VAL_20_u1 1. _CNV_A_R_LINEAR_____0_CM 0. 1. DISPLAY_IDENTIFIER LC_FAC_TI_ER_BAL_COR FORMAT "%1.0" /end CHARACTERISTIC
/begin CHARACTERISTIC c_fac_ti_er_bal_ctl_max_neg "Negative maximum limit for controller output at multiple path of cylinder balancing via TI intervention" VALUE 0xa080bcf8 _REC_VAL_20_s2 1.999969482421875 _CNV_A_R_LINEAR_____259_CM -1. 0.999969482421875 DISPLAY_IDENTIFIER C_FAC_TI_ER_BAL_CTL_MAX_NEG FORMAT "%8.5" /end CHARACTERISTIC
/begin CHARACTERISTIC c_cycnr_fac_ti_er_bal "Number of cycles for calculation of controller output values for cylinder balancing via multiple TI intervention" VALUE 0xa080bc22 _REC_VAL_20_u1 254. _CNV_A_R_LINEAR_____0_CM 1. 255. DISPLAY_IDENTIFIER C_CYCNR_FAC_TI_ER_BAL FORMAT "%3.0" /end CHARACTERISTIC
/begin MEASUREMENT mff_add_bal_ext[0] "External cylinder balancing additive MFF correction value" SWORD _CNV_A_R_LINEAR_____202_CM 1 100. -694.5 694.478806 DISPLAY_IDENTIFIER MFF_ADD_BAL_EXT[0] ECU_ADDRESS 0xd000a8ac FORMAT "%7.2" /end MEASUREMENT
/begin MEASUREMENT mff_add_bal_ext[1] "External cylinder balancing additive MFF correction value" SWORD _CNV_A_R_LINEAR_____202_CM 1 100. -694.5 694.478806 DISPLAY_IDENTIFIER MFF_ADD_BAL_EXT[1] ECU_ADDRESS 0xd000a8ae FORMAT "%7.2" /end MEASUREMENT
/begin MEASUREMENT mff_add_bal_ext[2] "External cylinder balancing additive MFF correction value" SWORD _CNV_A_R_LINEAR_____202_CM 1 100. -694.5 694.478806 DISPLAY_IDENTIFIER MFF_ADD_BAL_EXT[2] ECU_ADDRESS 0xd000a8b0 FORMAT "%7.2" /end MEASUREMENT
/begin MEASUREMENT mff_add_bal_ext[3] "External cylinder balancing additive MFF correction value" SWORD _CNV_A_R_LINEAR_____202_CM 1 100. -694.5 694.478806 DISPLAY_IDENTIFIER MFF_ADD_BAL_EXT[3] ECU_ADDRESS 0xd000a8b2 FORMAT "%7.2" /end MEASUREMENT
/begin MEASUREMENT mff_add_bal_ext[4] "External cylinder balancing additive MFF correction value" SWORD _CNV_A_R_LINEAR_____202_CM 1 100. -694.5 694.478806 DISPLAY_IDENTIFIER MFF_ADD_BAL_EXT[4] ECU_ADDRESS 0xd000a8b4 FORMAT "%7.2" /end MEASUREMENT
/begin MEASUREMENT mff_add_bal_ext[5] "External cylinder balancing additive MFF correction value" SWORD _CNV_A_R_LINEAR_____202_CM 1 100. -694.5 694.478806 DISPLAY_IDENTIFIER MFF_ADD_BAL_EXT[5] ECU_ADDRESS 0xd000a8b6 FORMAT "%7.2" /end MEASUREMENT
/begin MEASUREMENT mff_add_bal_ext[6] "External cylinder balancing additive MFF correction value" SWORD _CNV_A_R_LINEAR_____202_CM 1 100. -694.5 694.478806 DISPLAY_IDENTIFIER MFF_ADD_BAL_EXT[6] ECU_ADDRESS 0xd000a8b8 FORMAT "%7.2" /end MEASUREMENT
/begin MEASUREMENT mff_add_bal_ext[7] "External cylinder balancing additive MFF correction value" SWORD _CNV_A_R_LINEAR_____202_CM 1 100. -694.5 694.478806 DISPLAY_IDENTIFIER MFF_ADD_BAL_EXT[7] ECU_ADDRESS 0xd000a8ba FORMAT "%7.2" /end MEASUREMENT
/begin CHARACTERISTIC lc_mff_add_iv_ext_adj_ena "Logical constant to enable external adjustment of cylinder balancing additive MFF correction" VALUE 0xa080c5af _REC_VAL_20_u1 1. _CNV_A_R_LINEAR_____0_CM 0. 1. DISPLAY_IDENTIFIER LC_MFF_ADD_IV_EXT_ADJ_ENA FORMAT "%1.0" /end CHARACTERISTIC
/begin CHARACTERISTIC c_mff_absv_iv_ext_adj[0] "Default value for external cylinder balancing absolute MFF correction value" VALUE 0xa080be60 _REC_VAL_20_u2 1389. _CNV_A_R_LINEAR_____111_CM 0. 1389. DISPLAY_IDENTIFIER C_MFF_ABSV_IV_EXT_ADJ[0] FORMAT "%7.2" /end CHARACTERISTIC
/begin CHARACTERISTIC c_mff_absv_iv_ext_adj[1] "Default value for external cylinder balancing absolute MFF correction value" VALUE 0xa080be62 _REC_VAL_20_u2 1389. _CNV_A_R_LINEAR_____111_CM 0. 1389. DISPLAY_IDENTIFIER C_MFF_ABSV_IV_EXT_ADJ[1] FORMAT "%7.2" /end CHARACTERISTIC
/begin CHARACTERISTIC c_mff_absv_iv_ext_adj[2] "Default value for external cylinder balancing absolute MFF correction value" VALUE 0xa080be64 _REC_VAL_20_u2 1389. _CNV_A_R_LINEAR_____111_CM 0. 1389. DISPLAY_IDENTIFIER C_MFF_ABSV_IV_EXT_ADJ[2] FORMAT "%7.2" /end CHARACTERISTIC
/begin CHARACTERISTIC c_mff_absv_iv_ext_adj[3] "Default value for external cylinder balancing absolute MFF correction value" VALUE 0xa080be66 _REC_VAL_20_u2 1389. _CNV_A_R_LINEAR_____111_CM 0. 1389. DISPLAY_IDENTIFIER C_MFF_ABSV_IV_EXT_ADJ[3] FORMAT "%7.2" /end CHARACTERISTIC
/begin CHARACTERISTIC c_mff_absv_iv_ext_adj[4] "Default value for external cylinder balancing absolute MFF correction value" VALUE 0xa080be68 _REC_VAL_20_u2 1389. _CNV_A_R_LINEAR_____111_CM 0. 1389. DISPLAY_IDENTIFIER C_MFF_ABSV_IV_EXT_ADJ[4] FORMAT "%7.2" /end CHARACTERISTIC
/begin CHARACTERISTIC c_mff_absv_iv_ext_adj[5] "Default value for external cylinder balancing absolute MFF correction value" VALUE 0xa080be6a _REC_VAL_20_u2 1389. _CNV_A_R_LINEAR_____111_CM 0. 1389. DISPLAY_IDENTIFIER C_MFF_ABSV_IV_EXT_ADJ[5] FORMAT "%7.2" /end CHARACTERISTIC
/begin CHARACTERISTIC c_mff_absv_iv_ext_adj[6] "Default value for external cylinder balancing absolute MFF correction value" VALUE 0xa080be6c _REC_VAL_20_u2 1389. _CNV_A_R_LINEAR_____111_CM 0. 1389. DISPLAY_IDENTIFIER C_MFF_ABSV_IV_EXT_ADJ[6] FORMAT "%7.2" /end CHARACTERISTIC
/begin CHARACTERISTIC c_mff_absv_iv_ext_adj[7] "Default value for external cylinder balancing absolute MFF correction value" VALUE 0xa080be6e _REC_VAL_20_u2 1389. _CNV_A_R_LINEAR_____111_CM 0. 1389. DISPLAY_IDENTIFIER C_MFF_ABSV_IV_EXT_ADJ[7] FORMAT "%7.2" /end CHARACTERISTIC
/begin CHARACTERISTIC c_mff_nom_iv_ext_adj "Default value for external cylinder balancing nominal MFF correction value" VALUE 0xa080be92 _REC_VAL_20_u2 1389. _CNV_A_R_LINEAR_____111_CM 0. 1389. DISPLAY_IDENTIFIER C_MFF_NOM_IV_EXT_ADJ FORMAT "%7.2" /end CHARACTERISTIC
/begin AXIS_PTS ldp_dist_iv_dif_ip_mff_add_agi "" 0xa080854c NO_INPUT_QUANTITY _REC_AXS_20_u2 524280. _CNV_A_R_LINEAR_____255_CM 16 0. 524280. FORMAT "%6.0" /end AXIS_PTS
/begin CHARACTERISTIC ip_mff_add_iv_agi_dist "Additive MFF correction value depending on driving distance for compensation of aging effects" CURVE 0xa080aedc _REC_CUR_20_u2_u2 1389. _CNV_A_R_LACO_LINEA_363_CM -694.510597 694.489403 DISPLAY_IDENTIFIER IP_MFF_ADD_IV_AGI_DIST FORMAT "%7.2"
 /begin AXIS_DESCR COM_AXIS NO_INPUT_QUANTITY _CNV_A_R_LINEAR_____255_CM 16 0. 524280. FORMAT "%6.0" AXIS_PTS_REF ldp_dist_iv_dif_ip_mff_add_agi /end AXIS_DESCR
/end CHARACTERISTIC
/begin MEASUREMENT er_stnd_mff_add_er_bal "Controller input value at additive path of cylinder balancing via MFF intervention" SWORD _CNV_A_R_LINEAR_____140_CM 1 100. -325.78 325.770057983398 DISPLAY_IDENTIFIER ER_STND_MFF_ADD_ER_BAL ECU_ADDRESS 0xd00007ba FORMAT "%8.3" /end MEASUREMENT
/begin MEASUREMENT mff_add_er_bal_ctl "Controller output value at additive path of cylinder balancing via MFF intervention" SWORD _CNV_A_R_LINEAR_____128_CM 1 100. -694.510597390707 694.4894026092931 DISPLAY_IDENTIFIER MFF_ADD_ER_BAL_CTL ECU_ADDRESS 0xd00007bc FORMAT "%7.2" /end MEASUREMENT
/begin MEASUREMENT mff_add_er_bal_ctl_p "P-part of the controller output value at additive path of cylinder balancing via MFF intervention" SWORD _CNV_A_R_LINEAR_____128_CM 1 100. -694.510597390707 694.4894026092931 DISPLAY_IDENTIFIER MFF_ADD_ER_BAL_CTL_P ECU_ADDRESS 0xd00007be FORMAT "%7.2" /end MEASUREMENT
/begin MEASUREMENT mff_add_er_bal_ctl_i[0] "I-part of the controller output value at additive path of cylinder balancing via MFF intervention" SWORD _CNV_A_R_LINEAR_____128_CM 1 100. -694.510597390707 694.4894026092931 DISPLAY_IDENTIFIER MFF_ADD_ER_BAL_CTL_I[0] ECU_ADDRESS 0xd00007c0 FORMAT "%7.2" /end MEASUREMENT
/begin MEASUREMENT mff_add_er_bal_ctl_i[1] "I-part of the controller output value at additive path of cylinder balancing via MFF intervention" SWORD _CNV_A_R_LINEAR_____128_CM 1 100. -694.510597390707 694.4894026092931 DISPLAY_IDENTIFIER MFF_ADD_ER_BAL_CTL_I[1] ECU_ADDRESS 0xd00007c2 FORMAT "%7.2" /end MEASUREMENT
/begin MEASUREMENT mff_add_er_bal_ctl_i[2] "I-part of the controller output value at additive path of cylinder balancing via MFF intervention" SWORD _CNV_A_R_LINEAR_____128_CM 1 100. -694.510597390707 694.4894026092931 DISPLAY_IDENTIFIER MFF_ADD_ER_BAL_CTL_I[2] ECU_ADDRESS 0xd00007c4 FORMAT "%7.2" /end MEASUREMENT
/begin MEASUREMENT mff_add_er_bal_ctl_i[3] "I-part of the controller output value at additive path of cylinder balancing via MFF intervention" SWORD _CNV_A_R_LINEAR_____128_CM 1 100. -694.510597390707 694.4894026092931 DISPLAY_IDENTIFIER MFF_ADD_ER_BAL_CTL_I[3] ECU_ADDRESS 0xd00007c6 FORMAT "%7.2" /end MEASUREMENT
/begin MEASUREMENT mff_add_er_bal_ctl_i[4] "I-part of the controller output value at additive path of cylinder balancing via MFF intervention" SWORD _CNV_A_R_LINEAR_____128_CM 1 100. -694.510597390707 694.4894026092931 DISPLAY_IDENTIFIER MFF_ADD_ER_BAL_CTL_I[4] ECU_ADDRESS 0xd00007c8 FORMAT "%7.2" /end MEASUREMENT
/begin MEASUREMENT mff_add_er_bal_ctl_i[5] "I-part of the controller output value at additive path of cylinder balancing via MFF intervention" SWORD _CNV_A_R_LINEAR_____128_CM 1 100. -694.510597390707 694.4894026092931 DISPLAY_IDENTIFIER MFF_ADD_ER_BAL_CTL_I[5] ECU_ADDRESS 0xd00007ca FORMAT "%7.2" /end MEASUREMENT
/begin MEASUREMENT mff_add_er_bal_ctl_i[6] "I-part of the controller output value at additive path of cylinder balancing via MFF intervention" SWORD _CNV_A_R_LINEAR_____128_CM 1 100. -694.510597390707 694.4894026092931 DISPLAY_IDENTIFIER MFF_ADD_ER_BAL_CTL_I[6] ECU_ADDRESS 0xd00007cc FORMAT "%7.2" /end MEASUREMENT
/begin MEASUREMENT mff_add_er_bal_ctl_i[7] "I-part of the controller output value at additive path of cylinder balancing via MFF intervention" SWORD _CNV_A_R_LINEAR_____128_CM 1 100. -694.510597390707 694.4894026092931 DISPLAY_IDENTIFIER MFF_ADD_ER_BAL_CTL_I[7] ECU_ADDRESS 0xd00007ce FORMAT "%7.2" /end MEASUREMENT
/begin MEASUREMENT mff_add_er_bal_ctl_max "Controller output value maximum limit reached at additive path of cylinder balancing via MFF intervention" UWORD _CNV_A_R_LINEAR_____0_CM 1 100. 0. 65535. DISPLAY_IDENTIFIER MFF_ADD_ER_BAL_CTL_MAX ECU_ADDRESS 0xd00007b8 FORMAT "%5.0" /end MEASUREMENT
/begin MEASUREMENT mff_add_er_bal_lim[0] "Limited controller output value at additive path of cylinder balancing via MFF intervention" SWORD _CNV_A_R_LINEAR_____128_CM 1 100. -694.510597390707 694.4894026092931 DISPLAY_IDENTIFIER MFF_ADD_ER_BAL_LIM[0] ECU_ADDRESS 0xd00007d0 FORMAT "%7.2" /end MEASUREMENT
/begin MEASUREMENT mff_add_er_bal_lim[1] "Limited controller output value at additive path of cylinder balancing via MFF intervention" SWORD _CNV_A_R_LINEAR_____128_CM 1 100. -694.510597390707 694.4894026092931 DISPLAY_IDENTIFIER MFF_ADD_ER_BAL_LIM[1] ECU_ADDRESS 0xd00007d2 FORMAT "%7.2" /end MEASUREMENT
/begin MEASUREMENT mff_add_er_bal_lim[2] "Limited controller output value at additive path of cylinder balancing via MFF intervention" SWORD _CNV_A_R_LINEAR_____128_CM 1 100. -694.510597390707 694.4894026092931 DISPLAY_IDENTIFIER MFF_ADD_ER_BAL_LIM[2] ECU_ADDRESS 0xd00007d4 FORMAT "%7.2" /end MEASUREMENT
/begin MEASUREMENT mff_add_er_bal_lim[3] "Limited controller output value at additive path of cylinder balancing via MFF intervention" SWORD _CNV_A_R_LINEAR_____128_CM 1 100. -694.510597390707 694.4894026092931 DISPLAY_IDENTIFIER MFF_ADD_ER_BAL_LIM[3] ECU_ADDRESS 0xd00007d6 FORMAT "%7.2" /end MEASUREMENT
/begin MEASUREMENT mff_add_er_bal_lim[4] "Limited controller output value at additive path of cylinder balancing via MFF intervention" SWORD _CNV_A_R_LINEAR_____128_CM 1 100. -694.510597390707 694.4894026092931 DISPLAY_IDENTIFIER MFF_ADD_ER_BAL_LIM[4] ECU_ADDRESS 0xd00007d8 FORMAT "%7.2" /end MEASUREMENT
/begin MEASUREMENT mff_add_er_bal_lim[5] "Limited controller output value at additive path of cylinder balancing via MFF intervention" SWORD _CNV_A_R_LINEAR_____128_CM 1 100. -694.510597390707 694.4894026092931 DISPLAY_IDENTIFIER MFF_ADD_ER_BAL_LIM[5] ECU_ADDRESS 0xd00007da FORMAT "%7.2" /end MEASUREMENT
/begin MEASUREMENT mff_add_er_bal_lim[6] "Limited controller output value at additive path of cylinder balancing via MFF intervention" SWORD _CNV_A_R_LINEAR_____128_CM 1 100. -694.510597390707 694.4894026092931 DISPLAY_IDENTIFIER MFF_ADD_ER_BAL_LIM[6] ECU_ADDRESS 0xd00007dc FORMAT "%7.2" /end MEASUREMENT
/begin MEASUREMENT mff_add_er_bal_lim[7] "Limited controller output value at additive path of cylinder balancing via MFF intervention" SWORD _CNV_A_R_LINEAR_____128_CM 1 100. -694.510597390707 694.4894026092931 DISPLAY_IDENTIFIER MFF_ADD_ER_BAL_LIM[7] ECU_ADDRESS 0xd00007de FORMAT "%7.2" /end MEASUREMENT
/begin MEASUREMENT mff_add_er_bal_cor[0] "Corrected additive correction value for cylinder balancing via MFF intervention" SWORD _CNV_A_R_LINEAR_____128_CM 1 100. -694.510597390707 694.4894026092931 DISPLAY_IDENTIFIER MFF_ADD_ER_BAL_COR[0] ECU_ADDRESS 0xd00007e0 FORMAT "%7.2" /end MEASUREMENT
/begin MEASUREMENT mff_add_er_bal_cor[1] "Corrected additive correction value for cylinder balancing via MFF intervention" SWORD _CNV_A_R_LINEAR_____128_CM 1 100. -694.510597390707 694.4894026092931 DISPLAY_IDENTIFIER MFF_ADD_ER_BAL_COR[1] ECU_ADDRESS 0xd00007e2 FORMAT "%7.2" /end MEASUREMENT
/begin MEASUREMENT mff_add_er_bal_cor[2] "Corrected additive correction value for cylinder balancing via MFF intervention" SWORD _CNV_A_R_LINEAR_____128_CM 1 100. -694.510597390707 694.4894026092931 DISPLAY_IDENTIFIER MFF_ADD_ER_BAL_COR[2] ECU_ADDRESS 0xd00007e4 FORMAT "%7.2" /end MEASUREMENT
/begin MEASUREMENT mff_add_er_bal_cor[3] "Corrected additive correction value for cylinder balancing via MFF intervention" SWORD _CNV_A_R_LINEAR_____128_CM 1 100. -694.510597390707 694.4894026092931 DISPLAY_IDENTIFIER MFF_ADD_ER_BAL_COR[3] ECU_ADDRESS 0xd00007e6 FORMAT "%7.2" /end MEASUREMENT
/begin MEASUREMENT mff_add_er_bal_cor[4] "Corrected additive correction value for cylinder balancing via MFF intervention" SWORD _CNV_A_R_LINEAR_____128_CM 1 100. -694.510597390707 694.4894026092931 DISPLAY_IDENTIFIER MFF_ADD_ER_BAL_COR[4] ECU_ADDRESS 0xd00007e8 FORMAT "%7.2" /end MEASUREMENT
/begin MEASUREMENT mff_add_er_bal_cor[5] "Corrected additive correction value for cylinder balancing via MFF intervention" SWORD _CNV_A_R_LINEAR_____128_CM 1 100. -694.510597390707 694.4894026092931 DISPLAY_IDENTIFIER MFF_ADD_ER_BAL_COR[5] ECU_ADDRESS 0xd00007ea FORMAT "%7.2" /end MEASUREMENT
/begin MEASUREMENT mff_add_er_bal_cor[6] "Corrected additive correction value for cylinder balancing via MFF intervention" SWORD _CNV_A_R_LINEAR_____128_CM 1 100. -694.510597390707 694.4894026092931 DISPLAY_IDENTIFIER MFF_ADD_ER_BAL_COR[6] ECU_ADDRESS 0xd00007ec FORMAT "%7.2" /end MEASUREMENT
/begin MEASUREMENT mff_add_er_bal_cor[7] "Corrected additive correction value for cylinder balancing via MFF intervention" SWORD _CNV_A_R_LINEAR_____128_CM 1 100. -694.510597390707 694.4894026092931 DISPLAY_IDENTIFIER MFF_ADD_ER_BAL_COR[7] ECU_ADDRESS 0xd00007ee FORMAT "%7.2" /end MEASUREMENT
/begin MEASUREMENT mff_add_er_bal[0] "Additive correction value for cylinder balancing via MFF intervention" SWORD _CNV_A_R_LINEAR_____128_CM 1 100. -694.510597390707 694.4894026092931 DISPLAY_IDENTIFIER MFF_ADD_ER_BAL[0] ECU_ADDRESS 0xd000a86c FORMAT "%7.2" /end MEASUREMENT
/begin MEASUREMENT mff_add_er_bal[1] "Additive correction value for cylinder balancing via MFF intervention" SWORD _CNV_A_R_LINEAR_____128_CM 1 100. -694.510597390707 694.4894026092931 DISPLAY_IDENTIFIER MFF_ADD_ER_BAL[1] ECU_ADDRESS 0xd000a86e FORMAT "%7.2" /end MEASUREMENT
/begin MEASUREMENT mff_add_er_bal[2] "Additive correction value for cylinder balancing via MFF intervention" SWORD _CNV_A_R_LINEAR_____128_CM 1 100. -694.510597390707 694.4894026092931 DISPLAY_IDENTIFIER MFF_ADD_ER_BAL[2] ECU_ADDRESS 0xd000a870 FORMAT "%7.2" /end MEASUREMENT
/begin MEASUREMENT mff_add_er_bal[3] "Additive correction value for cylinder balancing via MFF intervention" SWORD _CNV_A_R_LINEAR_____128_CM 1 100. -694.510597390707 694.4894026092931 DISPLAY_IDENTIFIER MFF_ADD_ER_BAL[3] ECU_ADDRESS 0xd000a872 FORMAT "%7.2" /end MEASUREMENT
/begin MEASUREMENT mff_add_er_bal[4] "Additive correction value for cylinder balancing via MFF intervention" SWORD _CNV_A_R_LINEAR_____128_CM 1 100. -694.510597390707 694.4894026092931 DISPLAY_IDENTIFIER MFF_ADD_ER_BAL[4] ECU_ADDRESS 0xd000a874 FORMAT "%7.2" /end MEASUREMENT
/begin MEASUREMENT mff_add_er_bal[5] "Additive correction value for cylinder balancing via MFF intervention" SWORD _CNV_A_R_LINEAR_____128_CM 1 100. -694.510597390707 694.4894026092931 DISPLAY_IDENTIFIER MFF_ADD_ER_BAL[5] ECU_ADDRESS 0xd000a876 FORMAT "%7.2" /end MEASUREMENT
/begin MEASUREMENT mff_add_er_bal[6] "Additive correction value for cylinder balancing via MFF intervention" SWORD _CNV_A_R_LINEAR_____128_CM 1 100. -694.510597390707 694.4894026092931 DISPLAY_IDENTIFIER MFF_ADD_ER_BAL[6] ECU_ADDRESS 0xd000a878 FORMAT "%7.2" /end MEASUREMENT
/begin MEASUREMENT mff_add_er_bal[7] "Additive correction value for cylinder balancing via MFF intervention" SWORD _CNV_A_R_LINEAR_____128_CM 1 100. -694.510597390707 694.4894026092931 DISPLAY_IDENTIFIER MFF_ADD_ER_BAL[7] ECU_ADDRESS 0xd000a87a FORMAT "%7.2" /end MEASUREMENT
/begin MEASUREMENT mff_add_ad_er_bal[0] "Additive adaptation value for cylinder balancing via MFF intervention" SWORD _CNV_A_R_LINEAR_____128_CM 1 100. -694.510597390707 694.4894026092931 DISPLAY_IDENTIFIER MFF_ADD_AD_ER_BAL[0] ECU_ADDRESS 0xd000a87c FORMAT "%7.2" /end MEASUREMENT
/begin MEASUREMENT mff_add_ad_er_bal[1] "Additive adaptation value for cylinder balancing via MFF intervention" SWORD _CNV_A_R_LINEAR_____128_CM 1 100. -694.510597390707 694.4894026092931 DISPLAY_IDENTIFIER MFF_ADD_AD_ER_BAL[1] ECU_ADDRESS 0xd000a87e FORMAT "%7.2" /end MEASUREMENT
/begin MEASUREMENT mff_add_ad_er_bal[2] "Additive adaptation value for cylinder balancing via MFF intervention" SWORD _CNV_A_R_LINEAR_____128_CM 1 100. -694.510597390707 694.4894026092931 DISPLAY_IDENTIFIER MFF_ADD_AD_ER_BAL[2] ECU_ADDRESS 0xd000a880 FORMAT "%7.2" /end MEASUREMENT
/begin MEASUREMENT mff_add_ad_er_bal[3] "Additive adaptation value for cylinder balancing via MFF intervention" SWORD _CNV_A_R_LINEAR_____128_CM 1 100. -694.510597390707 694.4894026092931 DISPLAY_IDENTIFIER MFF_ADD_AD_ER_BAL[3] ECU_ADDRESS 0xd000a882 FORMAT "%7.2" /end MEASUREMENT
/begin MEASUREMENT mff_add_ad_er_bal[4] "Additive adaptation value for cylinder balancing via MFF intervention" SWORD _CNV_A_R_LINEAR_____128_CM 1 100. -694.510597390707 694.4894026092931 DISPLAY_IDENTIFIER MFF_ADD_AD_ER_BAL[4] ECU_ADDRESS 0xd000a884 FORMAT "%7.2" /end MEASUREMENT
/begin MEASUREMENT mff_add_ad_er_bal[5] "Additive adaptation value for cylinder balancing via MFF intervention" SWORD _CNV_A_R_LINEAR_____128_CM 1 100. -694.510597390707 694.4894026092931 DISPLAY_IDENTIFIER MFF_ADD_AD_ER_BAL[5] ECU_ADDRESS 0xd000a886 FORMAT "%7.2" /end MEASUREMENT
/begin MEASUREMENT mff_add_ad_er_bal[6] "Additive adaptation value for cylinder balancing via MFF intervention" SWORD _CNV_A_R_LINEAR_____128_CM 1 100. -694.510597390707 694.4894026092931 DISPLAY_IDENTIFIER MFF_ADD_AD_ER_BAL[6] ECU_ADDRESS 0xd000a888 FORMAT "%7.2" /end MEASUREMENT
/begin MEASUREMENT mff_add_ad_er_bal[7] "Additive adaptation value for cylinder balancing via MFF intervention" SWORD _CNV_A_R_LINEAR_____128_CM 1 100. -694.510597390707 694.4894026092931 DISPLAY_IDENTIFIER MFF_ADD_AD_ER_BAL[7] ECU_ADDRESS 0xd000a88a FORMAT "%7.2" /end MEASUREMENT
/begin MEASUREMENT nr_cyc_mff_add_er_bal_ctl_max "Corresponding segment number of the controller that has reached the maximum limit (additive MFF path)" UBYTE _CNV_A_R_LINEAR_____0_CM 1 100. 0. 255. DISPLAY_IDENTIFIER NR_CYC_MFF_ADD_ER_BAL_CTL_MAX ECU_ADDRESS 0xd00007f0 FORMAT "%3.0" /end MEASUREMENT
/begin CHARACTERISTIC c_er_stnd_thd_pos_mff_add_bal "Positive threshold for ER input value at additive path of cylinder balancing via MFF intervention" VALUE 0xa080bcaa _REC_VAL_20_s2 651.5500579833979 _CNV_A_R_LINEAR_____140_CM -325.78 325.770057983398 DISPLAY_IDENTIFIER C_ER_STND_THD_POS_MFF_ADD_BAL FORMAT "%8.3" /end CHARACTERISTIC
/begin CHARACTERISTIC c_er_stnd_thd_neg_mff_add_bal "Negative threshold for ER input value at additive path of  cylinder balancing via MFF intervention" VALUE 0xa080bca6 _REC_VAL_20_s2 651.5500579833979 _CNV_A_R_LINEAR_____140_CM -325.78 325.770057983398 DISPLAY_IDENTIFIER C_ER_STND_THD_NEG_MFF_ADD_BAL FORMAT "%8.3" /end CHARACTERISTIC
/begin CHARACTERISTIC c_mff_add_er_bal_ctl_max_pos "Positive maximum limit for controller output at additive path of cylinder balancing via MFF intervention" VALUE 0xa080be72 _REC_VAL_20_s2 1389. _CNV_A_R_LINEAR_____128_CM -694.510597390707 694.4894026092931 DISPLAY_IDENTIFIER C_MFF_ADD_ER_BAL_CTL_MAX_POS FORMAT "%7.2" /end CHARACTERISTIC
/begin CHARACTERISTIC c_cycnr_mff_add_er_bal "Number of cycles for calculation of controller output values for cylinder balancing via MFF intervention" VALUE 0xa080bc2a _REC_VAL_20_u1 254. _CNV_A_R_LINEAR_____0_CM 1. 255. DISPLAY_IDENTIFIER C_CYCNR_MFF_ADD_ER_BAL FORMAT "%3.0" /end CHARACTERISTIC
/begin CHARACTERISTIC lc_mff_add_er_bal_cor "Manual switch for overall correction of controller output values for cylinder balancing via MFF intervention" VALUE 0xa080c5ac _REC_VAL_20_u1 1. _CNV_A_R_LINEAR_____0_CM 0. 1. DISPLAY_IDENTIFIER LC_MFF_ADD_ER_BAL_COR FORMAT "%1.0" /end CHARACTERISTIC
/begin CHARACTERISTIC lc_mff_add_ad_er_bal_rst_man "Manual reset of additive adaptation values for cylinder balancing via MFF intervention" VALUE 0xa080c5aa _REC_VAL_20_u1 1. _CNV_A_R_LINEAR_____0_CM 0. 1. DISPLAY_IDENTIFIER LC_MFF_ADD_AD_ER_BAL_RST_MAN FORMAT "%1.0" /end CHARACTERISTIC
/begin CHARACTERISTIC c_mff_add_er_bal_rst "Reset of additive correction- and adaptation values for cylinder balancing via MFF intervention" VALUE 0xa080be78 _REC_VAL_20_u1 2. _CNV_S_3_CYBL_RANGE_797_CM 0. 2. DISPLAY_IDENTIFIER C_MFF_ADD_ER_BAL_RST /end CHARACTERISTIC
/begin AXIS_PTS ldp_er_stnd_mff_add_ip_p_er_bal "" 0xa0808614 er_stnd_mff_add_er_bal _REC_AXS_20_u2 651.5500579833979 _CNV_A_R_LINEAR_____143_CM 8 -325.78 325.770057983398 FORMAT "%8.3" /end AXIS_PTS
/begin CHARACTERISTIC ip_mff_add_p_er_bal "Controller P-part value for additive path of cylinder balancing via MFF intervention" CURVE 0xa080aefc _REC_CUR_20_u2_u2 1389. _CNV_A_R_LACO_LINEA_363_CM -694.510597 694.489403 DISPLAY_IDENTIFIER IP_MFF_ADD_P_ER_BAL FORMAT "%7.2"
 /begin AXIS_DESCR COM_AXIS er_stnd_mff_add_er_bal _CNV_A_R_LINEAR_____143_CM 8 -325.78 325.770057983398 FORMAT "%8.3" AXIS_PTS_REF ldp_er_stnd_mff_add_ip_p_er_bal /end AXIS_DESCR
/end CHARACTERISTIC
/begin AXIS_PTS ldp_er_stnd_mff_add_ip_i_er_bal "" 0xa0808600 er_stnd_mff_add_er_bal _REC_AXS_20_u2 651.5500579833979 _CNV_A_R_LINEAR_____143_CM 8 -325.78 325.770057983398 FORMAT "%8.3" /end AXIS_PTS
/begin CHARACTERISTIC ip_mff_add_i_er_bal "Controller I-part value for additive path of cylinder balancing via MFF intervention" CURVE 0xa080aecc _REC_CUR_20_u2_u2 1389. _CNV_A_R_LACO_LINEA_363_CM -694.510597 694.489403 DISPLAY_IDENTIFIER IP_MFF_ADD_I_ER_BAL FORMAT "%7.2"
 /begin AXIS_DESCR COM_AXIS er_stnd_mff_add_er_bal _CNV_A_R_LINEAR_____143_CM 8 -325.78 325.770057983398 FORMAT "%8.3" AXIS_PTS_REF ldp_er_stnd_mff_add_ip_i_er_bal /end AXIS_DESCR
/end CHARACTERISTIC
/begin CHARACTERISTIC lc_mff_add_er_bal_rst_man "Manual reset of additive correction values for cylinder balancing via MFF intervention" VALUE 0xa080c5ae _REC_VAL_20_u1 1. _CNV_A_R_LINEAR_____0_CM 0. 1. DISPLAY_IDENTIFIER LC_MFF_ADD_ER_BAL_RST_MAN FORMAT "%1.0" /end CHARACTERISTIC
/begin MEASUREMENT lv_er_stnd_mff_add_er_bal "Flag for controller input at additive path of cylinder balancing via MFF intervention" UBYTE _CNV_S_2_RANGE__0___1_CM 1 100. 0. 1. DISPLAY_IDENTIFIER LV_ER_STND_MFF_ADD_ER_BAL ECU_ADDRESS 0xd00007f3 BIT_MASK 0x1 /end MEASUREMENT
/begin MEASUREMENT lv_mff_add_er_bal_obd_max_pos[0] "Flag for maximum OBD limit reached at additive part of engine roughness based cylinder balancing" UBYTE _CNV_S_2_RANGE__0___1_CM 1 100. 0. 1. DISPLAY_IDENTIFIER LV_MFF_ADD_ER_BAL_OBD_MAX_POS[0] ECU_ADDRESS 0xd0008c94 BIT_MASK 0x1 /end MEASUREMENT
/begin MEASUREMENT lv_mff_add_er_bal_obd_max_pos[1] "Flag for maximum OBD limit reached at additive part of engine roughness based cylinder balancing" UBYTE _CNV_S_2_RANGE__0___1_CM 1 100. 0. 1. DISPLAY_IDENTIFIER LV_MFF_ADD_ER_BAL_OBD_MAX_POS[1] ECU_ADDRESS 0xd0008c95 BIT_MASK 0x1 /end MEASUREMENT
/begin MEASUREMENT lv_mff_add_er_bal_obd_max_pos[2] "Flag for maximum OBD limit reached at additive part of engine roughness based cylinder balancing" UBYTE _CNV_S_2_RANGE__0___1_CM 1 100. 0. 1. DISPLAY_IDENTIFIER LV_MFF_ADD_ER_BAL_OBD_MAX_POS[2] ECU_ADDRESS 0xd0008c96 BIT_MASK 0x1 /end MEASUREMENT
/begin MEASUREMENT lv_mff_add_er_bal_obd_max_pos[3] "Flag for maximum OBD limit reached at additive part of engine roughness based cylinder balancing" UBYTE _CNV_S_2_RANGE__0___1_CM 1 100. 0. 1. DISPLAY_IDENTIFIER LV_MFF_ADD_ER_BAL_OBD_MAX_POS[3] ECU_ADDRESS 0xd0008c97 BIT_MASK 0x1 /end MEASUREMENT
/begin MEASUREMENT lv_mff_add_er_bal_obd_max_pos[4] "Flag for maximum OBD limit reached at additive part of engine roughness based cylinder balancing" UBYTE _CNV_S_2_RANGE__0___1_CM 1 100. 0. 1. DISPLAY_IDENTIFIER LV_MFF_ADD_ER_BAL_OBD_MAX_POS[4] ECU_ADDRESS 0xd0008c98 BIT_MASK 0x1 /end MEASUREMENT
/begin MEASUREMENT lv_mff_add_er_bal_obd_max_pos[5] "Flag for maximum OBD limit reached at additive part of engine roughness based cylinder balancing" UBYTE _CNV_S_2_RANGE__0___1_CM 1 100. 0. 1. DISPLAY_IDENTIFIER LV_MFF_ADD_ER_BAL_OBD_MAX_POS[5] ECU_ADDRESS 0xd0008c99 BIT_MASK 0x1 /end MEASUREMENT
/begin MEASUREMENT lv_mff_add_er_bal_obd_max_pos[6] "Flag for maximum OBD limit reached at additive part of engine roughness based cylinder balancing" UBYTE _CNV_S_2_RANGE__0___1_CM 1 100. 0. 1. DISPLAY_IDENTIFIER LV_MFF_ADD_ER_BAL_OBD_MAX_POS[6] ECU_ADDRESS 0xd0008c9a BIT_MASK 0x1 /end MEASUREMENT
/begin MEASUREMENT lv_mff_add_er_bal_obd_max_pos[7] "Flag for maximum OBD limit reached at additive part of engine roughness based cylinder balancing" UBYTE _CNV_S_2_RANGE__0___1_CM 1 100. 0. 1. DISPLAY_IDENTIFIER LV_MFF_ADD_ER_BAL_OBD_MAX_POS[7] ECU_ADDRESS 0xd0008c9b BIT_MASK 0x1 /end MEASUREMENT
/begin MEASUREMENT lv_mff_add_er_bal_obd_max_neg[0] "Flag for minimum OBD limit reached at additive part of engine roughness based cylinder balancing" UBYTE _CNV_S_2_RANGE__0___1_CM 1 100. 0. 1. DISPLAY_IDENTIFIER LV_MFF_ADD_ER_BAL_OBD_MAX_NEG[0] ECU_ADDRESS 0xd0008c9c BIT_MASK 0x1 /end MEASUREMENT
/begin MEASUREMENT lv_mff_add_er_bal_obd_max_neg[1] "Flag for minimum OBD limit reached at additive part of engine roughness based cylinder balancing" UBYTE _CNV_S_2_RANGE__0___1_CM 1 100. 0. 1. DISPLAY_IDENTIFIER LV_MFF_ADD_ER_BAL_OBD_MAX_NEG[1] ECU_ADDRESS 0xd0008c9d BIT_MASK 0x1 /end MEASUREMENT
/begin MEASUREMENT lv_mff_add_er_bal_obd_max_neg[2] "Flag for minimum OBD limit reached at additive part of engine roughness based cylinder balancing" UBYTE _CNV_S_2_RANGE__0___1_CM 1 100. 0. 1. DISPLAY_IDENTIFIER LV_MFF_ADD_ER_BAL_OBD_MAX_NEG[2] ECU_ADDRESS 0xd0008c9e BIT_MASK 0x1 /end MEASUREMENT
/begin MEASUREMENT lv_mff_add_er_bal_obd_max_neg[3] "Flag for minimum OBD limit reached at additive part of engine roughness based cylinder balancing" UBYTE _CNV_S_2_RANGE__0___1_CM 1 100. 0. 1. DISPLAY_IDENTIFIER LV_MFF_ADD_ER_BAL_OBD_MAX_NEG[3] ECU_ADDRESS 0xd0008c9f BIT_MASK 0x1 /end MEASUREMENT
/begin MEASUREMENT lv_mff_add_er_bal_obd_max_neg[4] "Flag for minimum OBD limit reached at additive part of engine roughness based cylinder balancing" UBYTE _CNV_S_2_RANGE__0___1_CM 1 100. 0. 1. DISPLAY_IDENTIFIER LV_MFF_ADD_ER_BAL_OBD_MAX_NEG[4] ECU_ADDRESS 0xd0008ca0 BIT_MASK 0x1 /end MEASUREMENT
/begin MEASUREMENT lv_mff_add_er_bal_obd_max_neg[5] "Flag for minimum OBD limit reached at additive part of engine roughness based cylinder balancing" UBYTE _CNV_S_2_RANGE__0___1_CM 1 100. 0. 1. DISPLAY_IDENTIFIER LV_MFF_ADD_ER_BAL_OBD_MAX_NEG[5] ECU_ADDRESS 0xd0008ca1 BIT_MASK 0x1 /end MEASUREMENT
/begin MEASUREMENT lv_mff_add_er_bal_obd_max_neg[6] "Flag for minimum OBD limit reached at additive part of engine roughness based cylinder balancing" UBYTE _CNV_S_2_RANGE__0___1_CM 1 100. 0. 1. DISPLAY_IDENTIFIER LV_MFF_ADD_ER_BAL_OBD_MAX_NEG[6] ECU_ADDRESS 0xd0008ca2 BIT_MASK 0x1 /end MEASUREMENT
/begin MEASUREMENT lv_mff_add_er_bal_obd_max_neg[7] "Flag for minimum OBD limit reached at additive part of engine roughness based cylinder balancing" UBYTE _CNV_S_2_RANGE__0___1_CM 1 100. 0. 1. DISPLAY_IDENTIFIER LV_MFF_ADD_ER_BAL_OBD_MAX_NEG[7] ECU_ADDRESS 0xd0008ca3 BIT_MASK 0x1 /end MEASUREMENT
/begin CHARACTERISTIC c_mff_add_er_bal_ctl_max_neg "Negative maximum limit for controller output at additive path of cylinder balancing via MFF intervention" VALUE 0xa080be70 _REC_VAL_20_s2 1389. _CNV_A_R_LINEAR_____128_CM -694.510597390707 694.4894026092931 DISPLAY_IDENTIFIER C_MFF_ADD_ER_BAL_CTL_MAX_NEG FORMAT "%7.2" /end CHARACTERISTIC
/begin CHARACTERISTIC c_mff_add_er_bal_obd_max_neg "Negative maximum OBD limit for additive correction value of cylinder balancing via MFF intervention" VALUE 0xa080be74 _REC_VAL_20_s2 1389. _CNV_A_R_LINEAR_____128_CM -694.510597390707 694.4894026092931 DISPLAY_IDENTIFIER C_MFF_ADD_ER_BAL_OBD_MAX_NEG FORMAT "%7.2" /end CHARACTERISTIC
/begin CHARACTERISTIC c_mff_add_er_bal_obd_max_pos "Positive maximum OBD limit for additive correction value of cylinder balancing via MFF intervention" VALUE 0xa080be76 _REC_VAL_20_s2 1389. _CNV_A_R_LINEAR_____128_CM -694.510597390707 694.4894026092931 DISPLAY_IDENTIFIER C_MFF_ADD_ER_BAL_OBD_MAX_POS FORMAT "%7.2" /end CHARACTERISTIC
/begin MEASUREMENT lv_warm_rst "warm reset during ECU-run has occured" UBYTE _CNV_S_2_RANGE__0___1_CM 1 100. 0. 1. DISPLAY_IDENTIFIER LV_WARM_RST ECU_ADDRESS 0xd0008e6b BIT_MASK 0x1 /end MEASUREMENT
/begin MEASUREMENT lv_rst_det "warm reset during current ECU-lifetime has occured" UBYTE _CNV_S_2_RANGE__0___1_CM 1 100. 0. 1. DISPLAY_IDENTIFIER LV_RST_DET ECU_ADDRESS 0xd00055a8 BIT_MASK 0x1 /end MEASUREMENT
/begin MEASUREMENT rst_typ "Status-byte: reset type during current ECU-run" UBYTE _CNV_A_R_LINEAR_____0_CM 1 100. 0. 255. DISPLAY_IDENTIFIER RST_TYP ECU_ADDRESS 0xd0008e68 FORMAT "%3.0" /end MEASUREMENT
/begin MEASUREMENT rst_sec "Status-byte:  security info during current ECU-run" UBYTE _CNV_A_R_LINEAR_____0_CM 1 100. 0. 255. DISPLAY_IDENTIFIER RST_SEC ECU_ADDRESS 0xd0008e69 FORMAT "%3.0" /end MEASUREMENT
/begin MEASUREMENT rst_info_ctr "Number of atypical warm-resets since last power-up (BSW)" UBYTE _CNV_A_R_LINEAR_____0_CM 1 100. 0. 255. DISPLAY_IDENTIFIER RST_INFO_CTR ECU_ADDRESS 0xd0008e6a FORMAT "%3.0" /end MEASUREMENT
/begin MEASUREMENT lv_err_warm_rst "warm reset error flag" UBYTE _CNV_S_2_RANGE__0___1_CM 1 100. 0. 1. DISPLAY_IDENTIFIER LV_ERR_WARM_RST ECU_ADDRESS 0xd0008026 BIT_MASK 0x1 /end MEASUREMENT
/begin CHARACTERISTIC lc_warm_rst_ena "Logical constant for enabling Warm reset detection" VALUE 0xa080c624 _REC_VAL_20_u1 1. _CNV_A_R_LINEAR_____0_CM 0. 1. DISPLAY_IDENTIFIER LC_WARM_RST_ENA FORMAT "%2.0" /end CHARACTERISTIC
/begin CHARACTERISTIC c_n_rst_det "Engine speed for activation of reset detection in errror-management" VALUE 0xa080bfae _REC_VAL_20_u2 8160. _CNV_A_R_LINEAR_____14_CM 0. 8160. DISPLAY_IDENTIFIER C_N_RST_DET FORMAT "%4.0" /end CHARACTERISTIC
/begin COMPU_METHOD _CNV_A_R_LINEAR_____0_CM "" RAT_FUNC "%6.3" "-" COEFFS 0 1. 0. 0 0 1 /end COMPU_METHOD
/begin COMPU_METHOD _CNV_S_2_RANGE__0___1_CM "" TAB_VERB "%6.3" "-" COMPU_TAB_REF _CNV_S_2_RANGE__0___1 /end COMPU_METHOD
/begin COMPU_VTAB _CNV_S_2_RANGE__0___1 "" TAB_VERB 2 0 "0" 1 "1" /end COMPU_VTAB
/begin COMPU_METHOD _CNV_A_R_LINEAR_____5_CM "" RAT_FUNC "%6.3" "%" COEFFS 0 2.56 0. 0 0 1 /end COMPU_METHOD
/begin COMPU_METHOD _CNV_A_R_LINEAR_____8_CM "" RAT_FUNC "%6.3" "%" COEFFS 0 655.3599999999997 0. 0 0 1 /end COMPU_METHOD
/begin COMPU_METHOD _CNV_A_R_LINEAR_____9_CM "" RAT_FUNC "%6.3" "-" COEFFS 0 32767.99999999992 0. 0 0 1 /end COMPU_METHOD
/begin COMPU_METHOD _CNV_A_R_LINEAR_____14_CM "" RAT_FUNC "%6.3" "rpm" COEFFS 0 1. 0. 0 0 1 /end COMPU_METHOD
/begin COMPU_METHOD _CNV_A_R_LINEAR_____17_CM "" RAT_FUNC "%6.3" "°C" COEFFS 0 1.333333333333333 64. 0 0 1 /end COMPU_METHOD
/begin COMPU_METHOD _CNV_A_R_LINEAR_____24_CM "" RAT_FUNC "%6.3" "-" COEFFS 0 16384. 0. 0 0 1 /end COMPU_METHOD
/begin COMPU_METHOD _CNV_A_R_LINEAR_____28_CM "" RAT_FUNC "%6.3" "-" COEFFS 0 256. 0. 0 0 1 /end COMPU_METHOD
/begin COMPU_METHOD _CNV_A_R_LINEAR_____31_CM "" RAT_FUNC "%6.3" "Nm" COEFFS 0 32. 0. 0 0 1 /end COMPU_METHOD
/begin COMPU_METHOD _CNV_A_R_LINEAR_____110_CM "" RAT_FUNC "%6.3" "s" COEFFS 0 50. 0. 0 0 1 /end COMPU_METHOD
/begin COMPU_METHOD _CNV_A_R_LINEAR_____111_CM "" RAT_FUNC "%6.3" "mg/stk" COEFFS 0 47.18142548596112 0. 0 0 1 /end COMPU_METHOD
/begin COMPU_METHOD _CNV_A_R_LINEAR_____128_CM "" RAT_FUNC "%6.3" "mg/stk" COEFFS 0 47.18142548596112 -1.455191522836685e-011 0 0 1 /end COMPU_METHOD
/begin COMPU_METHOD _CNV_A_R_LINEAR_____140_CM "" RAT_FUNC "%6.3" "1/s²" COEFFS 0 100.5832156670146 2.182787284255028e-011 0 0 1 /end COMPU_METHOD
/begin COMPU_METHOD _CNV_A_R_LINEAR_____143_CM "" RAT_FUNC "%6.3" "1/s²" COEFFS 0 100.5832156670146 32768.00000000002 0 0 1 /end COMPU_METHOD
/begin COMPU_METHOD _CNV_A_R_LINEAR_____146_CM "" RAT_FUNC "%6.3" "hPa" COEFFS 0 12.05960017121163 0. 0 0 1 /end COMPU_METHOD
/begin COMPU_METHOD _CNV_A_R_LINEAR_____162_CM "" RAT_FUNC "%6.3" "kg/h" COEFFS 0 8192. 0. 0 0 1 /end COMPU_METHOD
/begin COMPU_METHOD _CNV_A_R_LINEAR_____171_CM "" RAT_FUNC "%6.3" "hPa" COEFFS 0 0.1884402603974972 0. 0 0 1 /end COMPU_METHOD
/begin COMPU_METHOD _CNV_A_R_LINEAR_____174_CM "" RAT_FUNC "%6.3" "l/h" COEFFS 0 1. 0. 0 0 1 /end COMPU_METHOD
/begin COMPU_METHOD _CNV_A_R_LINEAR_____190_CM "" RAT_FUNC "%6.3" "°CRK" COEFFS 0 2.666666666666667 95. 0 0 1 /end COMPU_METHOD
/begin COMPU_METHOD _CNV_A_R_LINEAR_____202_CM "" RAT_FUNC "%6.3" "mg/stk" COEFFS 0 47.18214541280769 -1.080506262951531e-005 0 0 1 /end COMPU_METHOD
/begin COMPU_METHOD _CNV_A_R_LINEAR_____228_CM "" RAT_FUNC "%6.3" "ms" COEFFS 0 1000. 0. 0 0 1 /end COMPU_METHOD
/begin COMPU_METHOD _CNV_A_R_LINEAR_____255_CM "" RAT_FUNC "%6.3" "km" COEFFS 0 0.125 0. 0 0 1 /end COMPU_METHOD
/begin COMPU_METHOD _CNV_A_R_LINEAR_____259_CM "" RAT_FUNC "%6.3" "-" COEFFS 0 32768. 0. 0 0 1 /end COMPU_METHOD
/begin COMPU_METHOD _CNV_A_R_LINEAR_____266_CM "" RAT_FUNC "%6.3" "-" COEFFS 0 64. 0. 0 0 1 /end COMPU_METHOD
/begin COMPU_METHOD _CNV_A_R_LINEAR_____314_CM "" RAT_FUNC "%6.3" "g" COEFFS 0 22.49999999999997 0. 0 0 1 /end COMPU_METHOD
/begin COMPU_METHOD _CNV_A_R_LACO_LINEA_363_CM "" RAT_FUNC "%6.3" "mg/stk" COEFFS 0 47.18142548596112 32767.99998156587 0 0 1 /end COMPU_METHOD
/begin COMPU_METHOD _CNV_S_9_RANGE_STAT_445_CM "" TAB_VERB "%6.3" "" COMPU_TAB_REF _CNV_S_9_RANGE_STAT_445 /end COMPU_METHOD
/begin COMPU_VTAB _CNV_S_9_RANGE_STAT_445 "" TAB_VERB 9 0 "CP_NOT_ACT" 1 "NO_PURGE" 2 "RAMP_TO_NO_PURGE" 3 "WAIT_RAMP_OPEN" 4 "MIN_PURGE" 8 "RAMP_OPEN" 9 "RAMP_OPEN_FAST" 10 "MAX_PURGE" 11 "RAMP_CLOSE" /end COMPU_VTAB
/begin COMPU_METHOD _CNV_A_R_CPULOAD__0_448_CM "" RAT_FUNC "%6.3" "%" COEFFS 0 10.24 0. 0 0 1 /end COMPU_METHOD
/begin COMPU_METHOD _CNV_A_R_INJR_LINEA_460_CM "" RAT_FUNC "%6.3" "%" COEFFS 0 163.84 0. 0 0 1 /end COMPU_METHOD
/begin COMPU_METHOD _CNV_A_R_INJR_LINEA_465_CM "" RAT_FUNC "%6.3" "-" COEFFS 0 32768.00003968061 32768.00003968061 0 0 1 /end COMPU_METHOD
/begin COMPU_METHOD _CNV_A_R_LINEAR_____525_CM "" RAT_FUNC "%6.3" "hPa" COEFFS 0 0.1884402603974972 8.003553375601769e-011 0 0 1 /end COMPU_METHOD
/begin COMPU_METHOD _CNV_A_R_INJR_LINEA_526_CM "" RAT_FUNC "%6.3" "%" COEFFS 0 163.84 8192. 0 0 1 /end COMPU_METHOD
/begin COMPU_METHOD _CNV_S_4_CYBL_RANGE_540_CM "" TAB_VERB "%6.3" "-" COMPU_TAB_REF _CNV_S_4_CYBL_RANGE_540 /end COMPU_METHOD
/begin COMPU_VTAB _CNV_S_4_CYBL_RANGE_540 "" TAB_VERB 4 0 "Disable" 1 "Adjustment" 2 "Control" 3 "ADJ&CTL" /end COMPU_VTAB
/begin COMPU_METHOD _CNV_S_5_CYBL_RANGE_541_CM "states for C_MFF_COR_BAL_MOD_MAN" TAB_VERB "%6.3" "-" COMPU_TAB_REF _CNV_S_5_CYBL_RANGE_541 /end COMPU_METHOD
/begin COMPU_VTAB _CNV_S_5_CYBL_RANGE_541 "states for C_MFF_COR_BAL_MOD_MAN" TAB_VERB 5 0 "NORM" 1 "LAM" 2 "ER" 3 "TOT" 4 "ER_ADD" /end COMPU_VTAB
/begin COMPU_METHOD _CNV_S_3_CYBL_RANGE_797_CM "" TAB_VERB "%6.3" "-" COMPU_TAB_REF _CNV_S_3_CYBL_RANGE_797 /end COMPU_METHOD
/begin COMPU_VTAB _CNV_S_3_CYBL_RANGE_797 "" TAB_VERB 3 0 "INI_ZERO" 1 "INI_CTL" 2 "INI_AD" /end COMPU_VTAB
/begin RECORD_LAYOUT _REC_VAL_20_u1 FNC_VALUES 1 UBYTE COLUMN_DIR DIRECT /end RECORD_LAYOUT
/begin RECORD_LAYOUT _REC_VAL_20_u2 FNC_VALUES 1 UWORD COLUMN_DIR DIRECT /end RECORD_LAYOUT
/begin RECORD_LAYOUT _REC_VAL_20_s2 FNC_VALUES 1 SWORD COLUMN_DIR DIRECT /end RECORD_LAYOUT
/begin RECORD_LAYOUT _REC_AXS_20_u2 NO_AXIS_PTS_X 1 UWORD AXIS_PTS_X 2 UWORD INDEX_INCR DIRECT /end RECORD_LAYOUT
/begin RECORD_LAYOUT _REC_CUR_20_u2_u2 FNC_VALUES 1 UWORD COLUMN_DIR DIRECT /end RECORD_LAYOUT
/begin RECORD_LAYOUT _REC_MAP_20_u2_u2_u2 FNC_VALUES 1 UWORD COLUMN_DIR DIRECT /end RECORD_LAYOUT
/begin FUNCTION AGGR_DRVB_adaptation "" /begin OUT_MEASUREMENT tqi_req_tra lv_act_aj /end OUT_MEASUREMENT /end FUNCTION
/begin FUNCTION AGGR_EGRC_adaption "" /end FUNCTION
/begin FUNCTION AGGR_ENTE_adaptation ""
 /begin OUT_MEASUREMENT lv_lih_coc_on n_rel_cwp_sp lv_temp_eng_warn_1 state_coc ectpwm_clc n_perc_ecf lv_temp_eng_warn_2 lv_temp_eng_warn_3 tco_ex ecfpwm_ecf tco_ex_mes lv_err_tco_ex lv_err_ect_mec /end OUT_MEASUREMENT
/end FUNCTION
/begin FUNCTION AGGR_EVAM_adaptation "" /begin DEF_CHARACTERISTIC c_t_dly_purge_diagcps c_t_dly_cl_mmv c_t_dly_cl_mmv_ready /end DEF_CHARACTERISTIC
 /begin OUT_MEASUREMENT lv_tldv_req lv_fac_lam_diagcp lv_diagcp_cps_act lv_err_mec_open_cps flow_sp_cps_evap cl_mmv_norm_purge_end lv_cp_new_ramp_open_mem lv_cl_mmv lv_err_el_sov lv_err_mec_close_sov lv_err_cps lv_cl_calc_avl state_cp_mem_ad t_dly_cl_mmv lv_t_dly_cl_mmv_ready lv_cl_mmv_tmp t_dly_cl_mmv_ready /end OUT_MEASUREMENT
/end FUNCTION
/begin FUNCTION AGGR_FUSL_adaptation ""
 /begin OUT_MEASUREMENT fup_sp_ext[0] fup_sp_ext[1] lv_fup_sp_ext_req fup_h_sp_s_ext efppwm_can vff_efp fup_ad /end OUT_MEASUREMENT
/end FUNCTION
/begin FUNCTION AGGR_DRRQ_adaption "" /begin OUT_MEASUREMENT pv /end OUT_MEASUREMENT /end FUNCTION
/begin FUNCTION AGGR_INSY_adaption "" /begin OUT_MEASUREMENT amp_mdl amp amp_ad maf_int_pue maf_int_puc /end OUT_MEASUREMENT /end FUNCTION
/begin FUNCTION AGGR_CYBL_adaption ""
 /begin OUT_MEASUREMENT ti_add[0] ti_add[1] ti_add[2] ti_add[3] ti_add[4] ti_add[5] ti_add[6] ti_add[7] ti_fac[0] ti_fac[1] ti_fac[2] ti_fac[3] ti_fac[4] ti_fac[5] ti_fac[6] ti_fac[7] /end OUT_MEASUREMENT
/end FUNCTION
/begin FUNCTION AGGR_INJR_adaptation "" /end FUNCTION
/begin FUNCTION AGGR_IGRE_adaptation ""
 /begin OUT_MEASUREMENT iga_av_mv iga_igc[0] iga_igc[1] iga_igc[2] iga_igc[3] iga_igc[4] iga_igc[5] iga_igc[6] iga_igc[7] iga_av[0] iga_av[1] iga_av[2] iga_av[3] iga_av[4] iga_av[5] iga_av[6] iga_av[7] /end OUT_MEASUREMENT
/end FUNCTION
/begin FUNCTION C_0_RST "C_0_RST" /begin SUB_FUNCTION RST_Warm_reset_data /end SUB_FUNCTION /end FUNCTION
/begin FUNCTION RST_Warm_reset_data "_Warm reset data" /begin DEF_CHARACTERISTIC lc_warm_rst_ena c_n_rst_det /end DEF_CHARACTERISTIC
 /begin OUT_MEASUREMENT lv_warm_rst lv_rst_det rst_typ rst_sec rst_info_ctr lv_err_warm_rst /end OUT_MEASUREMENT
/end FUNCTION
/begin FUNCTION AGGR_EGTR_adaption ""
 /begin OUT_MEASUREMENT delta_lamb_sp_o2l_mdl[0] delta_lamb_sp_o2l_mdl[1] cat_diag_mod_6[0] cat_diag_mod_6[1] lv_lam_adj_rng_vld_cat_diag_1 lv_lam_adj_rng_vld_cat_diag_2 /end OUT_MEASUREMENT
/end FUNCTION
/begin FUNCTION C_4_CYBL "C_4_CYBL" /begin SUB_FUNCTION CYBL_ER_Sig_prepartion_Cyl_Bal /end SUB_FUNCTION /end FUNCTION
/begin FUNCTION CYBL_ER_Sig_prepartion_Cyl_Bal "ER_Sig_prepartion_Cyl_Bal"
 /begin DEF_CHARACTERISTIC c_crlc_er_stnd_bal c_crlc_er_std_bal c_crlc_er_std_mmv_bal c_fac_er_std_neg_bal c_fac_er_std_pos_bal c_ctr_dly_drv1_stnd_bal_dec ldp_drv1_stnd_bal_ip_dly_bal ip_dly_drv1_stnd_bal /end DEF_CHARACTERISTIC
 /begin OUT_MEASUREMENT er_stnd_bal er_stnd_fil_bal er_stnd_mmv_bal[0] er_stnd_mmv_bal[1] er_stnd_mmv_bal[2] er_stnd_mmv_bal[3] er_stnd_mmv_bal[4] er_stnd_mmv_bal[5] er_stnd_mmv_bal[6] er_stnd_mmv_bal[7] er_stnd_mmv_mv_bal er_stnd_mmv_dif_bal[0] er_stnd_mmv_dif_bal[1] er_stnd_mmv_dif_bal[2] er_stnd_mmv_dif_bal[3] er_stnd_mmv_dif_bal[4] er_stnd_mmv_dif_bal[5] er_stnd_mmv_dif_bal[6] er_stnd_mmv_dif_bal[7] er_stnd_mmv_std_bal[0] er_stnd_mmv_std_bal[1] er_stnd_mmv_std_bal[2] er_stnd_mmv_std_bal[3] er_stnd_mmv_std_bal[4] er_stnd_mmv_std_bal[5] er_stnd_mmv_std_bal[6] er_stnd_mmv_std_bal[7] er_std_dif_bal er_std_bal[0] er_std_bal[1] er_std_bal[2] er_std_bal[3] er_std_bal[4] er_std_bal[5] er_std_bal[6] er_std_bal[7] er_std_mmv_bal[0] er_std_mmv_bal[1] er_std_mmv_bal[2] er_std_mmv_bal[3] er_std_mmv_bal[4] er_std_mmv_bal[5] er_std_mmv_bal[6] er_std_mmv_bal[7] drv1_stnd_bal dly_drv1_stnd_bal ctr_dly_drv1_stnd_bal lv_drv1_stnd_bal_fdout /end OUT_MEASUREMENT
/end FUNCTION
/begin FUNCTION C_7_CYBL "C_7_CYBL"
 /begin SUB_FUNCTION CYBL_Cyl_Bal_ER_AI CYBL_Coord_Inj_Time_Cor_Fac_CYBL CYBL_Cyl_Bal_Mul_TI_Intervent CYBL_Cyl_Bal_Add_MFF_Intervent CYBL_Cyl_Bal_via_Lam_Sens CYBL_CILC_AI CYBL_Phase_Shift_Adaptation CYBL_Dect_of_Lim_Dyn_Cyl_Lam /end SUB_FUNCTION
/end FUNCTION
/begin FUNCTION CYBL_Cyl_Bal_ER_AI "Cyl_Bal_ER_AI"
 /begin DEF_CHARACTERISTIC lc_mff_add_iv_ext_adj_ena c_mff_absv_iv_ext_adj[0] c_mff_absv_iv_ext_adj[1] c_mff_absv_iv_ext_adj[2] c_mff_absv_iv_ext_adj[3] c_mff_absv_iv_ext_adj[4] c_mff_absv_iv_ext_adj[5] c_mff_absv_iv_ext_adj[6] c_mff_absv_iv_ext_adj[7] c_mff_nom_iv_ext_adj ldp_dist_iv_dif_ip_mff_add_agi ip_mff_add_iv_agi_dist /end DEF_CHARACTERISTIC
 /begin OUT_MEASUREMENT mff_add_bal_ext[0] mff_add_bal_ext[1] mff_add_bal_ext[2] mff_add_bal_ext[3] mff_add_bal_ext[4] mff_add_bal_ext[5] mff_add_bal_ext[6] mff_add_bal_ext[7] /end OUT_MEASUREMENT
/end FUNCTION
/begin FUNCTION CYBL_Coord_Inj_Time_Cor_Fac_CYBL "Coord_Inj_Time_Cor_Fac_CYBL"
 /begin DEF_CHARACTERISTIC c_egy_level_iv_bal_ofs c_egy_level_iv_bal_max_neg c_egy_level_iv_bal_max_pos c_fac_ti_dif_bal lc_fac_ti_bal_rst_man c_ctr_dly_ti_bal_cor_ini ldp_fac_ti_sum_bal_ip_egy_bal ip_egy_level_iv_bal_conv c_fac_ti_bal_act_man c_mff_cor_bal_mod_man ldpm_n_2_cybl ldp_mff_sp_mv_ip_fac_egy_bal ip_fac_mff_add_er_bal ldpm_mff_sp_mv_1_cybl ip_fac_mff_add_bal_ext /end DEF_CHARACTERISTIC
 /begin OUT_MEASUREMENT egy_level_iv_bal_adj[0] egy_level_iv_bal_adj[1] egy_level_iv_bal_adj[2] egy_level_iv_bal_adj[3] egy_level_iv_bal_adj[4] egy_level_iv_bal_adj[5] egy_level_iv_bal_adj[6] egy_level_iv_bal_adj[7] nr_cyc_egy_level_iv_bal_ctl_max egy_level_iv_bal_ctl[0] egy_level_iv_bal_ctl[1] egy_level_iv_bal_ctl[2] egy_level_iv_bal_ctl[3] egy_level_iv_bal_ctl[4] egy_level_iv_bal_ctl[5] egy_level_iv_bal_ctl[6] egy_level_iv_bal_ctl[7] egy_level_iv_bal[0] egy_level_iv_bal[1] egy_level_iv_bal[2] egy_level_iv_bal[3] egy_level_iv_bal[4] egy_level_iv_bal[5] egy_level_iv_bal[6] egy_level_iv_bal[7] fac_ti_sum_bal[0] fac_ti_sum_bal[1] fac_ti_sum_bal[2] fac_ti_sum_bal[3] fac_ti_sum_bal[4] fac_ti_sum_bal[5] fac_ti_sum_bal[6] fac_ti_sum_bal[7] fac_ti_dif_bal[0] fac_ti_dif_bal[1] fac_ti_dif_bal[2] fac_ti_dif_bal[3] fac_ti_dif_bal[4] fac_ti_dif_bal[5] fac_ti_dif_bal[6] fac_ti_dif_bal[7] ctr_step_fac_ti_bal[0] ctr_step_fac_ti_bal[1] ctr_step_fac_ti_bal[2] ctr_step_fac_ti_bal[3] ctr_step_fac_ti_bal[4] ctr_step_fac_ti_bal[5] ctr_step_fac_ti_bal[6] ctr_step_fac_ti_bal[7] egy_level_iv_bal_ctl_max[0] egy_level_iv_bal_ctl_max[1] egy_level_iv_bal_ctl_max[2] egy_level_iv_bal_ctl_max[3] egy_level_iv_bal_ctl_max[4] egy_level_iv_bal_ctl_max[5] egy_level_iv_bal_ctl_max[6] egy_level_iv_bal_ctl_max[7] ctr_dly_ti_bal_cor_ena egy_level_iv_bal_conv[0] egy_level_iv_bal_conv[1] egy_level_iv_bal_conv[2] egy_level_iv_bal_conv[3] egy_level_iv_bal_conv[4] egy_level_iv_bal_conv[5] egy_level_iv_bal_conv[6] egy_level_iv_bal_conv[7] fac_ti_bal[0] fac_ti_bal[1] fac_ti_bal[2] fac_ti_bal[3] fac_ti_bal[4] fac_ti_bal[5] fac_ti_bal[6] fac_ti_bal[7] mff_add_bal[0] mff_add_bal[1] mff_add_bal[2] mff_add_bal[3] mff_add_bal[4] mff_add_bal[5] mff_add_bal[6] mff_add_bal[7] mff_add_sum_bal[0] mff_add_sum_bal[1] mff_add_sum_bal[2] mff_add_sum_bal[3] mff_add_sum_bal[4] mff_add_sum_bal[5] mff_add_sum_bal[6] mff_add_sum_bal[7] egy_level_iv_bal_lim /end OUT_MEASUREMENT
/end FUNCTION
/begin FUNCTION CYBL_Cyl_Bal_Mul_TI_Intervent "Cyl_Bal_Mul_TI_Intervent"
 /begin DEF_CHARACTERISTIC c_er_stnd_thd_pos_fac_ti_bal c_er_stnd_thd_neg_fac_ti_bal c_fac_ti_er_bal_rst ldp_er_stnd_fac_ti_ip_p_er_bal ip_fac_ti_p_er_bal ldp_er_stnd_fac_ti_ip_i_er_bal ip_fac_ti_i_er_bal lc_fac_ti_er_bal_rst_man c_fac_ti_er_bal_obd_max_neg c_fac_ti_er_bal_ctl_max_pos c_fac_ti_er_bal_obd_max_pos lc_fac_ti_ad_er_bal_rst_man lc_fac_ti_er_bal_cor c_fac_ti_er_bal_ctl_max_neg c_cycnr_fac_ti_er_bal /end DEF_CHARACTERISTIC
 /begin OUT_MEASUREMENT er_stnd_fac_ti_er_bal fac_ti_er_bal_ctl fac_ti_er_bal_ctl_p fac_ti_er_bal_ctl_i[0] fac_ti_er_bal_ctl_i[1] fac_ti_er_bal_ctl_i[2] fac_ti_er_bal_ctl_i[3] fac_ti_er_bal_ctl_i[4] fac_ti_er_bal_ctl_i[5] fac_ti_er_bal_ctl_i[6] fac_ti_er_bal_ctl_i[7] fac_ti_er_bal_ctl_max fac_ti_er_bal_lim[0] fac_ti_er_bal_lim[1] fac_ti_er_bal_lim[2] fac_ti_er_bal_lim[3] fac_ti_er_bal_lim[4] fac_ti_er_bal_lim[5] fac_ti_er_bal_lim[6] fac_ti_er_bal_lim[7] fac_ti_er_bal_cor[0] fac_ti_er_bal_cor[1] fac_ti_er_bal_cor[2] fac_ti_er_bal_cor[3] fac_ti_er_bal_cor[4] fac_ti_er_bal_cor[5] fac_ti_er_bal_cor[6] fac_ti_er_bal_cor[7] fac_ti_er_bal[0] fac_ti_er_bal[1] fac_ti_er_bal[2] fac_ti_er_bal[3] fac_ti_er_bal[4] fac_ti_er_bal[5] fac_ti_er_bal[6] fac_ti_er_bal[7] fac_ti_ad_er_bal[0] fac_ti_ad_er_bal[1] fac_ti_ad_er_bal[2] fac_ti_ad_er_bal[3] fac_ti_ad_er_bal[4] fac_ti_ad_er_bal[5] fac_ti_ad_er_bal[6] fac_ti_ad_er_bal[7] nr_cyc_fac_ti_er_bal_ctl_max lv_er_stnd_fac_ti_er_bal lv_mff_fac_er_bal_obd_max_pos[0] lv_mff_fac_er_bal_obd_max_pos[1] lv_mff_fac_er_bal_obd_max_pos[2] lv_mff_fac_er_bal_obd_max_pos[3] lv_mff_fac_er_bal_obd_max_pos[4] lv_mff_fac_er_bal_obd_max_pos[5] lv_mff_fac_er_bal_obd_max_pos[6] lv_mff_fac_er_bal_obd_max_pos[7] lv_mff_fac_er_bal_obd_max_neg[0] lv_mff_fac_er_bal_obd_max_neg[1] lv_mff_fac_er_bal_obd_max_neg[2] lv_mff_fac_er_bal_obd_max_neg[3] lv_mff_fac_er_bal_obd_max_neg[4] lv_mff_fac_er_bal_obd_max_neg[5] lv_mff_fac_er_bal_obd_max_neg[6] lv_mff_fac_er_bal_obd_max_neg[7] /end OUT_MEASUREMENT
/end FUNCTION
/begin FUNCTION CYBL_Cyl_Bal_Add_MFF_Intervent "Cyl_Bal_Add_MFF_Intervent"
 /begin DEF_CHARACTERISTIC c_er_stnd_thd_pos_mff_add_bal c_er_stnd_thd_neg_mff_add_bal c_mff_add_er_bal_ctl_max_pos c_cycnr_mff_add_er_bal lc_mff_add_er_bal_cor lc_mff_add_ad_er_bal_rst_man c_mff_add_er_bal_rst ldp_er_stnd_mff_add_ip_p_er_bal ip_mff_add_p_er_bal ldp_er_stnd_mff_add_ip_i_er_bal ip_mff_add_i_er_bal lc_mff_add_er_bal_rst_man c_mff_add_er_bal_ctl_max_neg c_mff_add_er_bal_obd_max_neg c_mff_add_er_bal_obd_max_pos /end DEF_CHARACTERISTIC
 /begin OUT_MEASUREMENT er_stnd_mff_add_er_bal mff_add_er_bal_ctl mff_add_er_bal_ctl_p mff_add_er_bal_ctl_i[0] mff_add_er_bal_ctl_i[1] mff_add_er_bal_ctl_i[2] mff_add_er_bal_ctl_i[3] mff_add_er_bal_ctl_i[4] mff_add_er_bal_ctl_i[5] mff_add_er_bal_ctl_i[6] mff_add_er_bal_ctl_i[7] mff_add_er_bal_ctl_max mff_add_er_bal_lim[0] mff_add_er_bal_lim[1] mff_add_er_bal_lim[2] mff_add_er_bal_lim[3] mff_add_er_bal_lim[4] mff_add_er_bal_lim[5] mff_add_er_bal_lim[6] mff_add_er_bal_lim[7] mff_add_er_bal_cor[0] mff_add_er_bal_cor[1] mff_add_er_bal_cor[2] mff_add_er_bal_cor[3] mff_add_er_bal_cor[4] mff_add_er_bal_cor[5] mff_add_er_bal_cor[6] mff_add_er_bal_cor[7] mff_add_er_bal[0] mff_add_er_bal[1] mff_add_er_bal[2] mff_add_er_bal[3] mff_add_er_bal[4] mff_add_er_bal[5] mff_add_er_bal[6] mff_add_er_bal[7] mff_add_ad_er_bal[0] mff_add_ad_er_bal[1] mff_add_ad_er_bal[2] mff_add_ad_er_bal[3] mff_add_ad_er_bal[4] mff_add_ad_er_bal[5] mff_add_ad_er_bal[6] mff_add_ad_er_bal[7] nr_cyc_mff_add_er_bal_ctl_max lv_er_stnd_mff_add_er_bal lv_mff_add_er_bal_obd_max_pos[0] lv_mff_add_er_bal_obd_max_pos[1] lv_mff_add_er_bal_obd_max_pos[2] lv_mff_add_er_bal_obd_max_pos[3] lv_mff_add_er_bal_obd_max_pos[4] lv_mff_add_er_bal_obd_max_pos[5] lv_mff_add_er_bal_obd_max_pos[6] lv_mff_add_er_bal_obd_max_pos[7] lv_mff_add_er_bal_obd_max_neg[0] lv_mff_add_er_bal_obd_max_neg[1] lv_mff_add_er_bal_obd_max_neg[2] lv_mff_add_er_bal_obd_max_neg[3] lv_mff_add_er_bal_obd_max_neg[4] lv_mff_add_er_bal_obd_max_neg[5] lv_mff_add_er_bal_obd_max_neg[6] lv_mff_add_er_bal_obd_max_neg[7] /end OUT_MEASUREMENT
/end FUNCTION
/end MODULE
/end PROJECT
