ASAP2_VERSION 1 3
/begin PROJECT P383 "BMW DDE6.3 8-Zylinder V9E.3 11.10.2004 CAN12H"
/begin HEADER "" VERSION "V9E.3_8Z_CAN12H" PROJECT_NO P383 /end HEADER
/begin MODULE DIM ""
/begin MOD_COMMON "" BYTE_ORDER MSB_FIRST ALIGNMENT_BYTE 1 ALIGNMENT_WORD 2 ALIGNMENT_LONG 4 ALIGNMENT_FLOAT32_IEEE 4 /end MOD_COMMON
/begin CHARACTERISTIC ANZMRKAUS "wie oft die anzeige ausgeschalten wird" VALUE 0xC05C0 KwWU8 255.0 dez 0.00 255.0 FORMAT "%5.1" /end CHARACTERISTIC
/begin CHARACTERISTIC ANZMRKMX "max. zulässige anzahl von geschwindigkeits- marken beim stufentempomat" VALUE 0xC05C1 KwWU8 255.0 dez 0.00 255.0 FORMAT "%5.1" /end CHARACTERISTIC
/begin CHARACTERISTIC CrCtl_aAccLim_C "Minimal erlaubte Fahrzeugbeschleunigung für Übergang von SET+ zu HOLD" VALUE 0xCA96C Kw_Ws16 10.00000 Acc 0.00 10.00000 FORMAT "%8.5" EXTENDED_LIMITS -32.76800 32.76700 /end CHARACTERISTIC
/begin CHARACTERISTIC CrCtl_AccGear2PKp_C "P-Reglerparametersatz für Beschleunigung 2.Gang" VALUE 0xCA970 Kw_Wu32 1310719.99969 Kp_Vel2TrqPrp 0.00 1310719.99969 FORMAT "%13.5" /end CHARACTERISTIC
/begin CHARACTERISTIC CrCtl_AccGear2PKpPos_C "P-Reglerparametersatz für Beschleunigung 2.Gang" VALUE 0xCA974 Kw_Wu32 1310719.99969 Kp_Vel2TrqPrp 0.00 1310719.99969 FORMAT "%13.5" /end CHARACTERISTIC
/begin CHARACTERISTIC CrCtl_AccGear2PKpNeg_C "P-Reglerparametersatz für Beschleunigung 2.Gang" VALUE 0xCA978 Kw_Wu32 1310719.99969 Kp_Vel2TrqPrp 0.00 1310719.99969 FORMAT "%13.5" /end CHARACTERISTIC
/begin CHARACTERISTIC CrCtl_vAccGear2PWinPos_C "P-Reglerparametersatz für Beschleunigung 2.Gang" VALUE 0xCA97C Kw_Ws16 300.0000 Vel 0.00 300.0000 FORMAT "%8.4" EXTENDED_LIMITS -327.6800 327.6700 /end CHARACTERISTIC
/begin CHARACTERISTIC CrCtl_vAccGear2PWinNeg_C "P-Reglerparametersatz für Beschleunigung 2.Gang" VALUE 0xCA97E Kw_Ws16 300.0000 Vel -300.0000 0.00 FORMAT "%8.4" EXTENDED_LIMITS -327.6800 327.6700 /end CHARACTERISTIC
/begin CHARACTERISTIC CrCtl_AccGear3PKp_C "P-Reglerparametersatz für Beschleunigung 3.Gang" VALUE 0xCA980 Kw_Wu32 1310719.99969 Kp_Vel2TrqPrp 0.00 1310719.99969 FORMAT "%13.5" /end CHARACTERISTIC
/begin CHARACTERISTIC CrCtl_AccGear3PKpPos_C "P-Reglerparametersatz für Beschleunigung 3.Gang" VALUE 0xCA984 Kw_Wu32 1310719.99969 Kp_Vel2TrqPrp 0.00 1310719.99969 FORMAT "%13.5" /end CHARACTERISTIC
/begin CHARACTERISTIC CrCtl_AccGear3PKpNeg_C "P-Reglerparametersatz für Beschleunigung 3.Gang" VALUE 0xCA988 Kw_Wu32 1310719.99969 Kp_Vel2TrqPrp 0.00 1310719.99969 FORMAT "%13.5" /end CHARACTERISTIC
/begin CHARACTERISTIC CrCtl_vAccGear3PWinPos_C "P-Reglerparametersatz für Beschleunigung 3.Gang" VALUE 0xCA98C Kw_Ws16 300.0000 Vel 0.00 300.0000 FORMAT "%8.4" EXTENDED_LIMITS -327.6800 327.6700 /end CHARACTERISTIC
/begin CHARACTERISTIC CrCtl_vAccGear3PWinNeg_C "P-Reglerparametersatz für Beschleunigung 3.Gang" VALUE 0xCA98E Kw_Ws16 300.0000 Vel -300.0000 0.00 FORMAT "%8.4" EXTENDED_LIMITS -327.6800 327.6700 /end CHARACTERISTIC
/begin CHARACTERISTIC CrCtl_AccGear4PKp_C "P-Reglerparametersatz für Beschleunigung 4.Gang" VALUE 0xCA990 Kw_Wu32 1310719.99969 Kp_Vel2TrqPrp 0.00 1310719.99969 FORMAT "%13.5" /end CHARACTERISTIC
/begin CHARACTERISTIC CrCtl_AccGear4PKpPos_C "P-Reglerparametersatz für Beschleunigung 4.Gang" VALUE 0xCA994 Kw_Wu32 1310719.99969 Kp_Vel2TrqPrp 0.00 1310719.99969 FORMAT "%13.5" /end CHARACTERISTIC
/begin CHARACTERISTIC CrCtl_AccGear4PKpNeg_C "P-Reglerparametersatz für Beschleunigung 4.Gang" VALUE 0xCA998 Kw_Wu32 1310719.99969 Kp_Vel2TrqPrp 0.00 1310719.99969 FORMAT "%13.5" /end CHARACTERISTIC
/begin CHARACTERISTIC CrCtl_vAccGear4PWinPos_C "P-Reglerparametersatz für Beschleunigung 4.Gang" VALUE 0xCA99C Kw_Ws16 300.0000 Vel 0.00 300.0000 FORMAT "%8.4" EXTENDED_LIMITS -327.6800 327.6700 /end CHARACTERISTIC
/begin CHARACTERISTIC CrCtl_vAccGear4PWinNeg_C "P-Reglerparametersatz für Beschleunigung 4.Gang" VALUE 0xCA99E Kw_Ws16 300.0000 Vel -300.0000 0.00 FORMAT "%8.4" EXTENDED_LIMITS -327.6800 327.6700 /end CHARACTERISTIC
/begin CHARACTERISTIC CrCtl_AccGear5PKp_C "P-Reglerparametersatz für Beschleunigung 5.Gang" VALUE 0xCA9A0 Kw_Wu32 1310719.99969 Kp_Vel2TrqPrp 0.00 1310719.99969 FORMAT "%13.5" /end CHARACTERISTIC
/begin CHARACTERISTIC CrCtl_AccGear5PKpPos_C "P-Reglerparametersatz für Beschleunigung 5.Gang" VALUE 0xCA9A4 Kw_Wu32 1310719.99969 Kp_Vel2TrqPrp 0.00 1310719.99969 FORMAT "%13.5" /end CHARACTERISTIC
/begin CHARACTERISTIC CrCtl_AccGear5PKpNeg_C "P-Reglerparametersatz für Beschleunigung 5.Gang" VALUE 0xCA9A8 Kw_Wu32 1310719.99969 Kp_Vel2TrqPrp 0.00 1310719.99969 FORMAT "%13.5" /end CHARACTERISTIC
/begin CHARACTERISTIC CrCtl_vAccGear5PWinPos_C "P-Reglerparametersatz für Beschleunigung 5.Gang" VALUE 0xCA9AC Kw_Ws16 300.0000 Vel 0.00 300.0000 FORMAT "%8.4" EXTENDED_LIMITS -327.6800 327.6700 /end CHARACTERISTIC
/begin CHARACTERISTIC CrCtl_vAccGear5PWinNeg_C "P-Reglerparametersatz für Beschleunigung 5.Gang" VALUE 0xCA9AE Kw_Ws16 300.0000 Vel -300.0000 0.00 FORMAT "%8.4" EXTENDED_LIMITS -327.6800 327.6700 /end CHARACTERISTIC
/begin CHARACTERISTIC CrCtl_AccGear6PKp_C "P-Reglerparametersatz für Beschleunigung 6.Gang" VALUE 0xCA9B0 Kw_Wu32 1310719.99969 Kp_Vel2TrqPrp 0.00 1310719.99969 FORMAT "%13.5" /end CHARACTERISTIC
/begin CHARACTERISTIC CrCtl_AccGear6PKpPos_C "P-Reglerparametersatz für Beschleunigung 6.Gang" VALUE 0xCA9B4 Kw_Wu32 1310719.99969 Kp_Vel2TrqPrp 0.00 1310719.99969 FORMAT "%13.5" /end CHARACTERISTIC
/begin CHARACTERISTIC CrCtl_AccGear6PKpNeg_C "P-Reglerparametersatz für Beschleunigung 6.Gang" VALUE 0xCA9B8 Kw_Wu32 1310719.99969 Kp_Vel2TrqPrp 0.00 1310719.99969 FORMAT "%13.5" /end CHARACTERISTIC
/begin CHARACTERISTIC CrCtl_vAccGear6PWinPos_C "P-Reglerparametersatz für Beschleunigung 6.Gang" VALUE 0xCA9BC Kw_Ws16 300.0000 Vel 0.00 300.0000 FORMAT "%8.4" EXTENDED_LIMITS -327.6800 327.6700 /end CHARACTERISTIC
/begin CHARACTERISTIC CrCtl_vAccGear6PWinNeg_C "P-Reglerparametersatz für Beschleunigung 6.Gang" VALUE 0xCA9BE Kw_Ws16 300.0000 Vel -300.0000 0.00 FORMAT "%8.4" EXTENDED_LIMITS -327.6800 327.6700 /end CHARACTERISTIC
/begin CHARACTERISTIC CrCtl_aDeclLim_C "neg. Beschleunigungsschwelle Übergang EIN- zu HALTEN" VALUE 0xCA9C0 Kw_Ws16 10.00000 Acc -10.00000 0.00 FORMAT "%8.5" EXTENDED_LIMITS -32.76800 32.76700 /end CHARACTERISTIC
/begin CHARACTERISTIC CrCtl_ctMaxTip_C "Maximal erlaubte Tipanzahl ohne Erreichen der Sollgeschwindigkeit" VALUE 0xCA9C2 Kw_Wu8 100.0 OneToOne 0.00 100.0 FORMAT "%5.1" EXTENDED_LIMITS 0.00 255.0 /end CHARACTERISTIC
/begin CHARACTERISTIC CrCtl_DebToVCrCtlDef_C "dfhjdghkj" VALUE 0xCAEEC Kw_Wu16 65535.00 OneToOne 0.00 65535.00 FORMAT "%8.2" /end CHARACTERISTIC
/begin CHARACTERISTIC CrCtl_DebToVCrCtlOk_C " Healing time for CrCtl_-messages Timeout" VALUE 0xCAEEE Kw_Wu16 65535.00 OneToOne 0.00 65535.00 FORMAT "%8.2" /end CHARACTERISTIC
/begin CHARACTERISTIC CrCtl_DeclGear2PKp_C "P-Reglerparametersatz für Verzögerung 2.Gang" VALUE 0xCA9C4 Kw_Wu32 1310719.99969 Kp_Vel2TrqPrp 0.00 1310719.99969 FORMAT "%13.5" /end CHARACTERISTIC
/begin CHARACTERISTIC CrCtl_DeclGear2PKpPos_C "P-Reglerparametersatz für Verzögerung 2.Gang" VALUE 0xCA9C8 Kw_Wu32 1310719.99969 Kp_Vel2TrqPrp 0.00 1310719.99969 FORMAT "%13.5" /end CHARACTERISTIC
/begin CHARACTERISTIC CrCtl_DeclGear2PKpNeg_C "P-Reglerparametersatz für Verzögerung 2.Gang" VALUE 0xCA9CC Kw_Wu32 1310719.99969 Kp_Vel2TrqPrp 0.00 1310719.99969 FORMAT "%13.5" /end CHARACTERISTIC
/begin CHARACTERISTIC CrCtl_vDeclGear2PWinPos_C "P-Reglerparametersatz für Verzögerung 2.Gang" VALUE 0xCA9D0 Kw_Ws16 300.0000 Vel 0.00 300.0000 FORMAT "%8.4" EXTENDED_LIMITS -327.6800 327.6700 /end CHARACTERISTIC
/begin CHARACTERISTIC CrCtl_vDeclGear2PWinNeg_C "P-Reglerparametersatz für Verzögerung 2.Gang" VALUE 0xCA9D2 Kw_Ws16 300.0000 Vel -300.0000 0.00 FORMAT "%8.4" EXTENDED_LIMITS -327.6800 327.6700 /end CHARACTERISTIC
/begin CHARACTERISTIC CrCtl_DeclGear3PKp_C "P-Reglerparametersatz für Verzögerung 3.Gang" VALUE 0xCA9D4 Kw_Wu32 1310719.99969 Kp_Vel2TrqPrp 0.00 1310719.99969 FORMAT "%13.5" /end CHARACTERISTIC
/begin CHARACTERISTIC CrCtl_DeclGear3PKpPos_C "P-Reglerparametersatz für Verzögerung 3.Gang" VALUE 0xCA9D8 Kw_Wu32 1310719.99969 Kp_Vel2TrqPrp 0.00 1310719.99969 FORMAT "%13.5" /end CHARACTERISTIC
/begin CHARACTERISTIC CrCtl_DeclGear3PKpNeg_C "P-Reglerparametersatz für Verzögerung 3.Gang" VALUE 0xCA9DC Kw_Wu32 1310719.99969 Kp_Vel2TrqPrp 0.00 1310719.99969 FORMAT "%13.5" /end CHARACTERISTIC
/begin CHARACTERISTIC CrCtl_vDeclGear3PWinPos_C "P-Reglerparametersatz für Verzögerung 3.Gang" VALUE 0xCA9E0 Kw_Ws16 300.0000 Vel 0.00 300.0000 FORMAT "%8.4" EXTENDED_LIMITS -327.6800 327.6700 /end CHARACTERISTIC
/begin CHARACTERISTIC CrCtl_vDeclGear3PWinNeg_C "P-Reglerparametersatz für Verzögerung 3.Gang" VALUE 0xCA9E2 Kw_Ws16 300.0000 Vel -300.0000 0.00 FORMAT "%8.4" EXTENDED_LIMITS -327.6800 327.6700 /end CHARACTERISTIC
/begin CHARACTERISTIC CrCtl_DeclGear4PKp_C "P-Reglerparametersatz für Verzögerung 4.Gang" VALUE 0xCA9E4 Kw_Wu32 1310719.99969 Kp_Vel2TrqPrp 0.00 1310719.99969 FORMAT "%13.5" /end CHARACTERISTIC
/begin CHARACTERISTIC CrCtl_DeclGear4PKpPos_C "P-Reglerparametersatz für Verzögerung 4.Gang" VALUE 0xCA9E8 Kw_Wu32 1310719.99969 Kp_Vel2TrqPrp 0.00 1310719.99969 FORMAT "%13.5" /end CHARACTERISTIC
/begin CHARACTERISTIC CrCtl_DeclGear4PKpNeg_C "P-Reglerparametersatz für Verzögerung 4.Gang" VALUE 0xCA9EC Kw_Wu32 1310719.99969 Kp_Vel2TrqPrp 0.00 1310719.99969 FORMAT "%13.5" /end CHARACTERISTIC
/begin CHARACTERISTIC CrCtl_vDeclGear4PWinPos_C "P-Reglerparametersatz für Verzögerung 4.Gang" VALUE 0xCA9F0 Kw_Ws16 300.0000 Vel 0.00 300.0000 FORMAT "%8.4" EXTENDED_LIMITS -327.6800 327.6700 /end CHARACTERISTIC
/begin CHARACTERISTIC CrCtl_vDeclGear4PWinNeg_C "P-Reglerparametersatz für Verzögerung 4.Gang" VALUE 0xCA9F2 Kw_Ws16 300.0000 Vel -300.0000 0.00 FORMAT "%8.4" EXTENDED_LIMITS -327.6800 327.6700 /end CHARACTERISTIC
/begin CHARACTERISTIC CrCtl_DeclGear5PKp_C "P-Reglerparametersatz für Verzögerung 5.Gang" VALUE 0xCA9F4 Kw_Wu32 1310719.99969 Kp_Vel2TrqPrp 0.00 1310719.99969 FORMAT "%13.5" /end CHARACTERISTIC
/begin CHARACTERISTIC CrCtl_DeclGear5PKpPos_C "P-Reglerparametersatz für Verzögerung 5.Gang" VALUE 0xCA9F8 Kw_Wu32 1310719.99969 Kp_Vel2TrqPrp 0.00 1310719.99969 FORMAT "%13.5" /end CHARACTERISTIC
/begin CHARACTERISTIC CrCtl_DeclGear5PKpNeg_C "P-Reglerparametersatz für Verzögerung 5.Gang" VALUE 0xCA9FC Kw_Wu32 1310719.99969 Kp_Vel2TrqPrp 0.00 1310719.99969 FORMAT "%13.5" /end CHARACTERISTIC
/begin CHARACTERISTIC CrCtl_vDeclGear5PWinPos_C "P-Reglerparametersatz für Verzögerung 5.Gang" VALUE 0xCAA00 Kw_Ws16 300.0000 Vel 0.00 300.0000 FORMAT "%8.4" EXTENDED_LIMITS -327.6800 327.6700 /end CHARACTERISTIC
/begin CHARACTERISTIC CrCtl_vDeclGear5PWinNeg_C "P-Reglerparametersatz für Verzögerung 5.Gang" VALUE 0xCAA02 Kw_Ws16 300.0000 Vel -300.0000 0.00 FORMAT "%8.4" EXTENDED_LIMITS -327.6800 327.6700 /end CHARACTERISTIC
/begin CHARACTERISTIC CrCtl_DeclGear6PKp_C "P-Reglerparametersatz für Verzögerung 6.Gang" VALUE 0xCAA04 Kw_Wu32 1310719.99969 Kp_Vel2TrqPrp 0.00 1310719.99969 FORMAT "%13.5" /end CHARACTERISTIC
/begin CHARACTERISTIC CrCtl_DeclGear6PKpPos_C "P-Reglerparametersatz für Verzögerung 6.Gang" VALUE 0xCAA08 Kw_Wu32 1310719.99969 Kp_Vel2TrqPrp 0.00 1310719.99969 FORMAT "%13.5" /end CHARACTERISTIC
/begin CHARACTERISTIC CrCtl_DeclGear6PKpNeg_C "P-Reglerparametersatz für Verzögerung 6.Gang" VALUE 0xCAA0C Kw_Wu32 1310719.99969 Kp_Vel2TrqPrp 0.00 1310719.99969 FORMAT "%13.5" /end CHARACTERISTIC
/begin CHARACTERISTIC CrCtl_vDeclGear6PWinPos_C "P-Reglerparametersatz für Verzögerung 6.Gang" VALUE 0xCAA10 Kw_Ws16 300.0000 Vel 0.00 300.0000 FORMAT "%8.4" EXTENDED_LIMITS -327.6800 327.6700 /end CHARACTERISTIC
/begin CHARACTERISTIC CrCtl_vDeclGear6PWinNeg_C "P-Reglerparametersatz für Verzögerung 6.Gang" VALUE 0xCAA12 Kw_Ws16 300.0000 Vel -300.0000 0.00 FORMAT "%8.4" EXTENDED_LIMITS -327.6800 327.6700 /end CHARACTERISTIC
/begin CHARACTERISTIC CrCtl_tiDT1vCurr_C "Zeitkonstante des DT1-Gliedes zur Filterung von v_Curr für die Berechnung der Momentenreduzierung im Zustand HOLD." VALUE 0xCAA14 Kw_Wu32 4294.9673 TimeDelay_s 0.0000010000000 4294.9673 FORMAT "%9.4" /end CHARACTERISTIC
/begin CHARACTERISTIC CrCtl_kdDT1vCurr_C "Verstärkung des DT1-Gliedes zur Filterung von v_Curr für die Berechnung der Momentenreduzierung im Zustand HOLD." VALUE 0xCAA18 Kw_Ws32 1310719.99969 Kd_Vel2TrqPrp -655360.000000 655359.999695 FORMAT "%13.6" /end CHARACTERISTIC
/begin CHARACTERISTIC CrCtl_dtrqAccDwn_C "FGR: EIN+: Anstieg Momentenverringerung nach Loslassen EIN+ Taste" VALUE 0xCAA1C Kw_Ws16 327670.0 dTrqPrp_20ms 0.00 327670.0 FORMAT "%8.1" EXTENDED_LIMITS -327680.0 327670.0 /end CHARACTERISTIC
/begin CHARACTERISTIC CrCtl_dtrqDeclUp_C "FGR, EIN-: Momentenanstieg nach Loslassen EIN- Taste" VALUE 0xCAA1E Kw_Ws16 327670.0 dTrqPrp_20ms 0.00 327670.0 FORMAT "%8.1" EXTENDED_LIMITS -327680.0 327670.0 /end CHARACTERISTIC
/begin CHARACTERISTIC CrCtl_dtrqOffComf1_C "Rampensteigung 1 Komfortabschaltung" VALUE 0xCAA20 Kw_Ws16 327670.0 dTrqPrp_20ms 0.00 327670.0 FORMAT "%8.1" EXTENDED_LIMITS -327680.0 327670.0 /end CHARACTERISTIC
/begin CHARACTERISTIC CrCtl_dtrqOffComf2_C "Rampensteigung 2 Komfortabschaltung" VALUE 0xCAA22 Kw_Ws16 327670.0 dTrqPrp_20ms 0.00 327670.0 FORMAT "%8.1" EXTENDED_LIMITS -327680.0 327670.0 /end CHARACTERISTIC
/begin CHARACTERISTIC CrCtl_dtrqOffFast1_CUR "Kurve für erste Rampe bei Schnellabschaltung" CURVE 0xCAA24 Kl_Xs16_Ws16 327670.0 dTrqPrp_20ms 0.00 327670.0 FORMAT "%8.1" EXTENDED_LIMITS -327680.0 327670.0
 /begin AXIS_DESCR STD_AXIS Gearbx_stGear OneToOne 8 -1.000 6.000 FORMAT "%5.3" EXTENDED_LIMITS -128.0 127.0 DEPOSIT ABSOLUTE /end AXIS_DESCR
/end CHARACTERISTIC
/begin CHARACTERISTIC CrCtl_dtrqOffFast2_CUR "Kurve für zweite Rampe bei Schnellabschaltung" CURVE 0xCAA46 Kl_Xs16_Ws16 327670.0 dTrqPrp_20ms 0.00 327670.0 FORMAT "%8.1" EXTENDED_LIMITS -327680.0 327670.0
 /begin AXIS_DESCR STD_AXIS Gearbx_stGear OneToOne 8 -1.000 6.000 FORMAT "%5.3" EXTENDED_LIMITS -128.0 127.0 DEPOSIT ABSOLUTE /end AXIS_DESCR
/end CHARACTERISTIC
/begin CHARACTERISTIC CrCtl_dtrqOffFast3_CUR "Kennfled für dritte Rampe bei Schnellabschaltung" CURVE 0xCAA68 Kl_Xs16_Ws16 327670.0 dTrqPrp_20ms 0.00 327670.0 FORMAT "%8.1" EXTENDED_LIMITS -327680.0 327670.0
 /begin AXIS_DESCR STD_AXIS Gearbx_stGear OneToOne 8 -1.000 6.000 FORMAT "%5.3" EXTENDED_LIMITS -128.0 127.0 DEPOSIT ABSOLUTE /end AXIS_DESCR
/end CHARACTERISTIC
/begin CHARACTERISTIC CrCtl_dvAccFDCG3_CUR "Curve for slope of ramp speed in acceleration <= 3th gear" CURVE 0xCAA8A Kl_Xs16_Ws16 16383.50 dVel_20ms 0.00 16383.50 FORMAT "%8.2" EXTENDED_LIMITS -16384.00 16383.50
 /begin AXIS_DESCR STD_AXIS CrCtl_vBeg Vel 3 0.00 300.0000 FORMAT "%8.4" EXTENDED_LIMITS -327.6800 327.6700 DEPOSIT ABSOLUTE /end AXIS_DESCR
/end CHARACTERISTIC
/begin CHARACTERISTIC CrCtl_dvAccFDCG4_CUR "Curve for slope of ramp speed in acceleration (EIN+), 4th gear" CURVE 0xCAA98 Kl_Xs16_Ws16 16383.50 dVel_20ms 0.00 16383.50 FORMAT "%8.2" EXTENDED_LIMITS -16384.00 16383.50
 /begin AXIS_DESCR STD_AXIS CrCtl_vBeg Vel 3 0.00 300.0000 FORMAT "%8.4" EXTENDED_LIMITS -327.6800 327.6700 DEPOSIT ABSOLUTE /end AXIS_DESCR
/end CHARACTERISTIC
/begin CHARACTERISTIC CrCtl_dvAccFDCG5_CUR "Curve for slope of ramp speed in acceleration (EIN+), 5th gear" CURVE 0xCAAA6 Kl_Xs16_Ws16 16383.50 dVel_20ms 0.00 16383.50 FORMAT "%8.2" EXTENDED_LIMITS -16384.00 16383.50
 /begin AXIS_DESCR STD_AXIS CrCtl_vBeg Vel 3 0.00 300.0000 FORMAT "%8.4" EXTENDED_LIMITS -327.6800 327.6700 DEPOSIT ABSOLUTE /end AXIS_DESCR
/end CHARACTERISTIC
/begin CHARACTERISTIC CrCtl_dvAccFDCG6_CUR "Curve for slope of ramp speed in acceleration (EIN+), >= 6th gear" CURVE 0xCAAB4 Kl_Xs16_Ws16 16383.50 dVel_20ms 0.00 16383.50 FORMAT "%8.2" EXTENDED_LIMITS -16384.00 16383.50
 /begin AXIS_DESCR STD_AXIS CrCtl_vBeg Vel 3 0.00 300.0000 FORMAT "%8.4" EXTENDED_LIMITS -327.6800 327.6700 DEPOSIT ABSOLUTE /end AXIS_DESCR
/end CHARACTERISTIC
/begin CHARACTERISTIC CrCtl_dvAccG3_CUR "KL Anstieg FGR Rampengeschwindigkeit bei EIN+ für Gang <= 3" CURVE 0xCAAC2 Kl_Xs16_Ws16 16383.50 dVel_20ms 0.00 16383.50 FORMAT "%8.2" EXTENDED_LIMITS -16384.00 16383.50
 /begin AXIS_DESCR STD_AXIS CrCtl_vBeg Vel 3 0.00 300.0000 FORMAT "%8.4" EXTENDED_LIMITS -327.6800 327.6700 DEPOSIT ABSOLUTE /end AXIS_DESCR
/end CHARACTERISTIC
/begin CHARACTERISTIC CrCtl_dvAccG4_CUR "KL Anstieg FGR Rampengeschwindigkeit bei EIN+ für 4. Gang" CURVE 0xCAAD0 Kl_Xs16_Ws16 16383.50 dVel_20ms 0.00 16383.50 FORMAT "%8.2" EXTENDED_LIMITS -16384.00 16383.50
 /begin AXIS_DESCR STD_AXIS CrCtl_vBeg Vel 3 0.00 300.0000 FORMAT "%8.4" EXTENDED_LIMITS -327.6800 327.6700 DEPOSIT ABSOLUTE /end AXIS_DESCR
/end CHARACTERISTIC
/begin CHARACTERISTIC CrCtl_dvAccG5_CUR "KL Anstieg FGR Rampengeschwindigkeit bei EIN+ für 5. Gang" CURVE 0xCAADE Kl_Xs16_Ws16 16383.50 dVel_20ms 0.00 16383.50 FORMAT "%8.2" EXTENDED_LIMITS -16384.00 16383.50
 /begin AXIS_DESCR STD_AXIS CrCtl_vBeg Vel 3 0.00 300.0000 FORMAT "%8.4" EXTENDED_LIMITS -327.6800 327.6700 DEPOSIT ABSOLUTE /end AXIS_DESCR
/end CHARACTERISTIC
/begin CHARACTERISTIC CrCtl_dvAccG6_CUR "KL Anstieg FGR Rampengeschwindigkeit bei EIN+ für 6. Gang" CURVE 0xCAAEC Kl_Xs16_Ws16 16383.50 dVel_20ms 0.00 16383.50 FORMAT "%8.2" EXTENDED_LIMITS -16384.00 16383.50
 /begin AXIS_DESCR STD_AXIS CrCtl_vBeg Vel 3 0.00 300.0000 FORMAT "%8.4" EXTENDED_LIMITS -327.6800 327.6700 DEPOSIT ABSOLUTE /end AXIS_DESCR
/end CHARACTERISTIC
/begin CHARACTERISTIC CrCtl_dvDeclFDCG3_CUR "Curve for slope of ramp speed in acceleration (EIN+), >= 3rd gear" CURVE 0xCAAFA Kl_Xs16_Ws16 16383.50 dVel_20ms 0.00 16383.50 FORMAT "%8.2" EXTENDED_LIMITS -16384.00 16383.50
 /begin AXIS_DESCR STD_AXIS CrCtl_vBeg Vel 3 0.00 300.0000 FORMAT "%8.4" EXTENDED_LIMITS -327.6800 327.6700 DEPOSIT ABSOLUTE /end AXIS_DESCR
/end CHARACTERISTIC
/begin CHARACTERISTIC CrCtl_dvDeclFDCG4_CUR "Curve for slope of ramp speed in deceleration (EIN-), 4th gear" CURVE 0xCAB08 Kl_Xs16_Ws16 16383.50 dVel_20ms 0.00 16383.50 FORMAT "%8.2" EXTENDED_LIMITS -16384.00 16383.50
 /begin AXIS_DESCR STD_AXIS CrCtl_vBeg Vel 3 0.00 300.0000 FORMAT "%8.4" EXTENDED_LIMITS -327.6800 327.6700 DEPOSIT ABSOLUTE /end AXIS_DESCR
/end CHARACTERISTIC
/begin CHARACTERISTIC CrCtl_dvDeclFDCG5_CUR "curve for ramp slope SET+ 5th gear for sport mode" CURVE 0xCAB16 Kl_Xs16_Ws16 16383.50 dVel_20ms 0.00 16383.50 FORMAT "%8.2" EXTENDED_LIMITS -16384.00 16383.50
 /begin AXIS_DESCR STD_AXIS CrCtl_vBeg Vel 3 0.00 300.0000 FORMAT "%8.4" EXTENDED_LIMITS -327.6800 327.6700 DEPOSIT ABSOLUTE /end AXIS_DESCR
/end CHARACTERISTIC
/begin CHARACTERISTIC CrCtl_dvDeclFDCG6_CUR "Curve for slope of ramp speed in deceleration (EIN-), >= 6th gear" CURVE 0xCAB24 Kl_Xs16_Ws16 16383.50 dVel_20ms 0.00 16383.50 FORMAT "%8.2" EXTENDED_LIMITS -16384.00 16383.50
 /begin AXIS_DESCR STD_AXIS CrCtl_vBeg Vel 3 0.00 300.0000 FORMAT "%8.4" EXTENDED_LIMITS -327.6800 327.6700 DEPOSIT ABSOLUTE /end AXIS_DESCR
/end CHARACTERISTIC
/begin CHARACTERISTIC CrCtl_dvDeclG3_CUR "KL Abstieg FGR Rampengeschwindigkeit bei EIN- für Gang <= 3" CURVE 0xCAB32 Kl_Xs16_Ws16 16383.50 dVel_20ms 0.00 16383.50 FORMAT "%8.2" EXTENDED_LIMITS -16384.00 16383.50
 /begin AXIS_DESCR STD_AXIS CrCtl_vBeg Vel 3 0.00 300.0000 FORMAT "%8.4" EXTENDED_LIMITS -327.6800 327.6700 DEPOSIT ABSOLUTE /end AXIS_DESCR
/end CHARACTERISTIC
/begin CHARACTERISTIC CrCtl_dvDeclG4_CUR "KL Abstieg FGR Rampengeschwindigkeit bei EIN- für 4. Gang" CURVE 0xCAB40 Kl_Xs16_Ws16 16383.50 dVel_20ms 0.00 16383.50 FORMAT "%8.2" EXTENDED_LIMITS -16384.00 16383.50
 /begin AXIS_DESCR STD_AXIS CrCtl_vBeg Vel 3 0.00 300.0000 FORMAT "%8.4" EXTENDED_LIMITS -327.6800 327.6700 DEPOSIT ABSOLUTE /end AXIS_DESCR
/end CHARACTERISTIC
/begin CHARACTERISTIC CrCtl_dvDeclG5_CUR "KL Abstieg FGR Rampengeschwindigkeit bei EIN- für 5. Gang" CURVE 0xCAB4E Kl_Xs16_Ws16 16383.50 dVel_20ms 0.00 16383.50 FORMAT "%8.2" EXTENDED_LIMITS -16384.00 16383.50
 /begin AXIS_DESCR STD_AXIS CrCtl_vBeg Vel 3 0.00 300.0000 FORMAT "%8.4" EXTENDED_LIMITS -327.6800 327.6700 DEPOSIT ABSOLUTE /end AXIS_DESCR
/end CHARACTERISTIC
/begin CHARACTERISTIC CrCtl_dvDeclG6_CUR "KL Abstieg FGR Rampengeschwindigkeit bei EIN- für 6. Gang" CURVE 0xCAB5C Kl_Xs16_Ws16 16383.50 dVel_20ms 0.00 16383.50 FORMAT "%8.2" EXTENDED_LIMITS -16384.00 16383.50
 /begin AXIS_DESCR STD_AXIS CrCtl_vBeg Vel 3 0.00 300.0000 FORMAT "%8.4" EXTENDED_LIMITS -327.6800 327.6700 DEPOSIT ABSOLUTE /end AXIS_DESCR
/end CHARACTERISTIC
/begin CHARACTERISTIC CrCtl_dvResAbvFDCG3_CUR "Curve for slope of set speed ramp RESUME ABOVE, >=3th gear" CURVE 0xCAB6A Kl_Xs16_Ws16 16383.50 dVel_20ms 0.00 16383.50 FORMAT "%8.2" EXTENDED_LIMITS -16384.00 16383.50
 /begin AXIS_DESCR STD_AXIS CrCtl_vBeg Vel 3 0.00 300.0000 FORMAT "%8.4" EXTENDED_LIMITS -327.6800 327.6700 DEPOSIT ABSOLUTE /end AXIS_DESCR
/end CHARACTERISTIC
/begin CHARACTERISTIC CrCtl_dvResAbvFDCG4_CUR "Curve for slope of set speed ramp RESUME ABOVE, >=4th gear" CURVE 0xCAB78 Kl_Xs16_Ws16 16383.50 dVel_20ms 0.00 16383.50 FORMAT "%8.2" EXTENDED_LIMITS -16384.00 16383.50
 /begin AXIS_DESCR STD_AXIS CrCtl_vBeg Vel 3 0.00 300.0000 FORMAT "%8.4" EXTENDED_LIMITS -327.6800 327.6700 DEPOSIT ABSOLUTE /end AXIS_DESCR
/end CHARACTERISTIC
/begin CHARACTERISTIC CrCtl_dvResAbvFDCG5_CUR "Curve for slope of set speed ramp RESUME ABOVE, >=5th gear" CURVE 0xCAB86 Kl_Xs16_Ws16 16383.50 dVel_20ms 0.00 16383.50 FORMAT "%8.2" EXTENDED_LIMITS -16384.00 16383.50
 /begin AXIS_DESCR STD_AXIS CrCtl_vBeg Vel 3 0.00 300.0000 FORMAT "%8.4" EXTENDED_LIMITS -327.6800 327.6700 DEPOSIT ABSOLUTE /end AXIS_DESCR
/end CHARACTERISTIC
/begin CHARACTERISTIC CrCtl_dvResAbvFDCG6_CUR "Curve for slope of set speed ramp RESUME ABOVE, >=6th gear" CURVE 0xCAB94 Kl_Xs16_Ws16 16383.50 dVel_20ms 0.00 16383.50 FORMAT "%8.2" EXTENDED_LIMITS -16384.00 16383.50
 /begin AXIS_DESCR STD_AXIS CrCtl_vBeg Vel 3 0.00 300.0000 FORMAT "%8.4" EXTENDED_LIMITS -327.6800 327.6700 DEPOSIT ABSOLUTE /end AXIS_DESCR
/end CHARACTERISTIC
/begin CHARACTERISTIC CrCtl_dvResAbvG3_MAP "KF Abstieg FGR Rampengeschwindigkeit bei WA von oben für Gang <= 3" MAP 0xCABA2 Kf_Xs16_Ys16_Ws16 16383.50 dVel_20ms 0.00 16383.50 FORMAT "%8.2" EXTENDED_LIMITS -16384.00 16383.50
 /begin AXIS_DESCR STD_AXIS CrCtl_vBeg Vel 3 0.00 300.0000 FORMAT "%8.4" EXTENDED_LIMITS -327.6800 327.6700 DEPOSIT ABSOLUTE /end AXIS_DESCR
 /begin AXIS_DESCR STD_AXIS CrCtl_vDiff_mp Vel 1 0.00 300.0000 FORMAT "%8.4" EXTENDED_LIMITS -327.6800 327.6700 DEPOSIT ABSOLUTE /end AXIS_DESCR
/end CHARACTERISTIC
/begin CHARACTERISTIC CrCtl_dvResAbvG4_MAP "KF Abstieg FGR Rampengeschwindigkeit bei WA von oben für 4. Gang" MAP 0xCABB4 Kf_Xs16_Ys16_Ws16 16383.50 dVel_20ms 0.00 16383.50 FORMAT "%8.2" EXTENDED_LIMITS -16384.00 16383.50
 /begin AXIS_DESCR STD_AXIS CrCtl_vBeg Vel 3 0.00 300.0000 FORMAT "%8.4" EXTENDED_LIMITS -327.6800 327.6700 DEPOSIT ABSOLUTE /end AXIS_DESCR
 /begin AXIS_DESCR STD_AXIS CrCtl_vDiff_mp Vel 1 0.00 300.0000 FORMAT "%8.4" EXTENDED_LIMITS -327.6800 327.6700 DEPOSIT ABSOLUTE /end AXIS_DESCR
/end CHARACTERISTIC
/begin CHARACTERISTIC CrCtl_dvResAbvG5_MAP "KF Abstieg FGR Rampengeschwindigkeit bei WA von oben für 5. Gang" MAP 0xCABC6 Kf_Xs16_Ys16_Ws16 16383.50 dVel_20ms 0.00 16383.50 FORMAT "%8.2" EXTENDED_LIMITS -16384.00 16383.50
 /begin AXIS_DESCR STD_AXIS CrCtl_vBeg Vel 3 0.00 300.0000 FORMAT "%8.4" EXTENDED_LIMITS -327.6800 327.6700 DEPOSIT ABSOLUTE /end AXIS_DESCR
 /begin AXIS_DESCR STD_AXIS CrCtl_vDiff_mp Vel 1 0.00 300.0000 FORMAT "%8.4" EXTENDED_LIMITS -327.6800 327.6700 DEPOSIT ABSOLUTE /end AXIS_DESCR
/end CHARACTERISTIC
/begin CHARACTERISTIC CrCtl_dvResAbvG6_MAP "KF Abstieg FGR Rampengeschwindigkeit bei WA von oben für 6. Gang" MAP 0xCABD8 Kf_Xs16_Ys16_Ws16 16383.50 dVel_20ms 0.00 16383.50 FORMAT "%8.2" EXTENDED_LIMITS -16384.00 16383.50
 /begin AXIS_DESCR STD_AXIS CrCtl_vBeg Vel 3 0.00 300.0000 FORMAT "%8.4" EXTENDED_LIMITS -327.6800 327.6700 DEPOSIT ABSOLUTE /end AXIS_DESCR
 /begin AXIS_DESCR STD_AXIS CrCtl_vDiff_mp Vel 1 0.00 300.0000 FORMAT "%8.4" EXTENDED_LIMITS -327.6800 327.6700 DEPOSIT ABSOLUTE /end AXIS_DESCR
/end CHARACTERISTIC
/begin CHARACTERISTIC CrCtl_dvResBlwFDCG3_CUR "Curve for slope of set speed ramp RESUME BELOW, <= 3th gear" CURVE 0xCABEA Kl_Xs16_Ws16 16383.50 dVel_20ms 0.00 16383.50 FORMAT "%8.2" EXTENDED_LIMITS -16384.00 16383.50
 /begin AXIS_DESCR STD_AXIS CrCtl_vBeg Vel 3 0.00 300.0000 FORMAT "%8.4" EXTENDED_LIMITS -327.6800 327.6700 DEPOSIT ABSOLUTE /end AXIS_DESCR
/end CHARACTERISTIC
/begin CHARACTERISTIC CrCtl_dvResBlwFDCG4_CUR "Curve for slope of set speed ramp RESUME BELOW, <= 4th gear" CURVE 0xCABF8 Kl_Xs16_Ws16 16383.50 dVel_20ms 0.00 16383.50 FORMAT "%8.2" EXTENDED_LIMITS -16384.00 16383.50
 /begin AXIS_DESCR STD_AXIS CrCtl_vBeg Vel 3 0.00 300.0000 FORMAT "%8.4" EXTENDED_LIMITS -327.6800 327.6700 DEPOSIT ABSOLUTE /end AXIS_DESCR
/end CHARACTERISTIC
/begin CHARACTERISTIC CrCtl_dvResBlwFDCG5_CUR "Curve for slope of set speed ramp RESUME BELOW, <= 5th gear" CURVE 0xCAC06 Kl_Xs16_Ws16 16383.50 dVel_20ms 0.00 16383.50 FORMAT "%8.2" EXTENDED_LIMITS -16384.00 16383.50
 /begin AXIS_DESCR STD_AXIS CrCtl_vBeg Vel 3 0.00 300.0000 FORMAT "%8.4" EXTENDED_LIMITS -327.6800 327.6700 DEPOSIT ABSOLUTE /end AXIS_DESCR
/end CHARACTERISTIC
/begin CHARACTERISTIC CrCtl_dvResBlwFDCG6_CUR "Curve for slope of set speed ramp RESUME BELOW, >=6th gear" CURVE 0xCAC14 Kl_Xs16_Ws16 16383.50 dVel_20ms 0.00 16383.50 FORMAT "%8.2" EXTENDED_LIMITS -16384.00 16383.50
 /begin AXIS_DESCR STD_AXIS CrCtl_vBeg Vel 3 0.00 300.0000 FORMAT "%8.4" EXTENDED_LIMITS -327.6800 327.6700 DEPOSIT ABSOLUTE /end AXIS_DESCR
/end CHARACTERISTIC
/begin CHARACTERISTIC CrCtl_dvResBlwG3_MAP "KF Anstieg FGR Rampengeschwindigkeit bei WA von unten für Gang <= 3" MAP 0xCAC22 Kf_Xs16_Ys16_Ws16 16383.50 dVel_20ms 0.00 16383.50 FORMAT "%8.2" EXTENDED_LIMITS -16384.00 16383.50
 /begin AXIS_DESCR STD_AXIS CrCtl_vBeg Vel 3 0.00 300.0000 FORMAT "%8.4" EXTENDED_LIMITS -327.6800 327.6700 DEPOSIT ABSOLUTE /end AXIS_DESCR
 /begin AXIS_DESCR STD_AXIS CrCtl_vDiff_mp Vel 1 0.00 300.0000 FORMAT "%8.4" EXTENDED_LIMITS -327.6800 327.6700 DEPOSIT ABSOLUTE /end AXIS_DESCR
/end CHARACTERISTIC
/begin CHARACTERISTIC CrCtl_dvResBlwG4_MAP "KF Anstieg FGR Rampengeschwindigkeit bei WA von unten für 4. Gang" MAP 0xCAC34 Kf_Xs16_Ys16_Ws16 16383.50 dVel_20ms 0.00 16383.50 FORMAT "%8.2" EXTENDED_LIMITS -16384.00 16383.50
 /begin AXIS_DESCR STD_AXIS CrCtl_vBeg Vel 3 0.00 300.0000 FORMAT "%8.4" EXTENDED_LIMITS -327.6800 327.6700 DEPOSIT ABSOLUTE /end AXIS_DESCR
 /begin AXIS_DESCR STD_AXIS CrCtl_vDiff_mp Vel 1 0.00 300.0000 FORMAT "%8.4" EXTENDED_LIMITS -327.6800 327.6700 DEPOSIT ABSOLUTE /end AXIS_DESCR
/end CHARACTERISTIC
/begin CHARACTERISTIC CrCtl_dvResBlwG5_MAP "KF Anstieg FGR Rampengeschwindigkeit bei WA von unten für 5. Gang" MAP 0xCAC46 Kf_Xs16_Ys16_Ws16 16383.50 dVel_20ms 0.00 16383.50 FORMAT "%8.2" EXTENDED_LIMITS -16384.00 16383.50
 /begin AXIS_DESCR STD_AXIS CrCtl_vBeg Vel 3 0.00 300.0000 FORMAT "%8.4" EXTENDED_LIMITS -327.6800 327.6700 DEPOSIT ABSOLUTE /end AXIS_DESCR
 /begin AXIS_DESCR STD_AXIS CrCtl_vDiff_mp Vel 1 0.00 300.0000 FORMAT "%8.4" EXTENDED_LIMITS -327.6800 327.6700 DEPOSIT ABSOLUTE /end AXIS_DESCR
/end CHARACTERISTIC
/begin CHARACTERISTIC CrCtl_dvResBlwG6_MAP "KF Anstieg FGR Rampengeschwindigkeit bei WA von unten für 6. Gang" MAP 0xCAC58 Kf_Xs16_Ys16_Ws16 16383.50 dVel_20ms 0.00 16383.50 FORMAT "%8.2" EXTENDED_LIMITS -16384.00 16383.50
 /begin AXIS_DESCR STD_AXIS CrCtl_vBeg Vel 3 0.00 300.0000 FORMAT "%8.4" EXTENDED_LIMITS -327.6800 327.6700 DEPOSIT ABSOLUTE /end AXIS_DESCR
 /begin AXIS_DESCR STD_AXIS CrCtl_vDiff_mp Vel 1 0.00 300.0000 FORMAT "%8.4" EXTENDED_LIMITS -327.6800 327.6700 DEPOSIT ABSOLUTE /end AXIS_DESCR
/end CHARACTERISTIC
/begin CHARACTERISTIC CrCtl_facIncSlope_CUR "Überhöhungskennlinie für SET+, SET-, WA+, WA-" CURVE 0xCAC6A Kl_Xs16_Ws16 7800.049 Prc_1000 -3900.024 3900.024 FORMAT "%8.3" EXTENDED_LIMITS -4000.000 3999.878
 /begin AXIS_DESCR STD_AXIS Rail_tiThresMonEna Time_ms 6 0.00 655350.0 FORMAT "%8.1" DEPOSIT ABSOLUTE /end AXIS_DESCR
/end CHARACTERISTIC
/begin CHARACTERISTIC CrCtl_facPropAcc_C "Proportionalfaktor für Initialmoment von Fahrgeschwindigkeit in EIN+/WAU des FGR" VALUE 0xCAC84 Kw_Ws16 79.99756 Vel2TrqPrp 0.00 79.99756 FORMAT "%8.5" EXTENDED_LIMITS -80.00000 79.99756 /end CHARACTERISTIC
/begin CHARACTERISTIC CrCtl_facPropDecl_C "Proportionalfaktor für Offset von Fahrgeschwindigkeit zur Momentenerhöhung nach EIN-" VALUE 0xCAC86 Kw_Ws16 79.99756 Vel2TrqPrp 0.00 79.99756 FORMAT "%8.5" EXTENDED_LIMITS -80.00000 79.99756 /end CHARACTERISTIC
/begin CHARACTERISTIC CrCtl_facRedDecl_C "Faktor zur Momentenreduzierung bei Übergang HALTEN zu EIN- nach Ablauf TIP-Erkennung" VALUE 0xCAC88 Kw_Ws16 100.0000 Prc 0.00 100.0000 FORMAT "%8.4" EXTENDED_LIMITS -400.0000 399.9878 /end CHARACTERISTIC
/begin CHARACTERISTIC CrCtl_facRedHi_C "höherer Faktor Reduzierung FGR Moment bei Loslassen EIN+ (FGR-Moment > Schwelle)" VALUE 0xCAC8A Kw_Ws16 100.0000 Prc 0.00 100.0000 FORMAT "%8.4" EXTENDED_LIMITS -400.0000 399.9878 /end CHARACTERISTIC
/begin CHARACTERISTIC CrCtl_facRedLo_C "niederer Faktor Reduzierung FGR-Moment bei Loslassen EIN+ (FGR-Moment <= Schwelle)" VALUE 0xCAC8C Kw_Ws16 100.0000 Prc 0.00 100.0000 FORMAT "%8.4" EXTENDED_LIMITS -400.0000 399.9878 /end CHARACTERISTIC
/begin CHARACTERISTIC CrCtl_facResAbvFDC_CUR "Curve for reducing the slope of ramp speed in WA- and Tip- at the end of the ramp" CURVE 0xCAC8E Kl_Xs16_Ws16 99.97559 Prc_1000 0.00 99.97559 FORMAT "%8.4" EXTENDED_LIMITS -4000.000 3999.878
 /begin AXIS_DESCR STD_AXIS CrCtl_vDiffRed_mp Vel 6 -327.6800 327.6700 FORMAT "%8.4" DEPOSIT ABSOLUTE /end AXIS_DESCR
/end CHARACTERISTIC
/begin CHARACTERISTIC CrCtl_facResAbv_CUR "Abflachungskennlinie für WA-" CURVE 0xCACA8 Kl_Xs16_Ws16 99.97559 Prc_1000 0.00 99.97559 FORMAT "%8.4" EXTENDED_LIMITS -4000.000 3999.878
 /begin AXIS_DESCR STD_AXIS CrCtl_vDiffRed_mp Vel 6 -327.6800 327.6700 FORMAT "%8.4" DEPOSIT ABSOLUTE /end AXIS_DESCR
/end CHARACTERISTIC
/begin CHARACTERISTIC CrCtl_facResBlwFDC_CUR " Curve for reducing the slope of ramp speed in WA+ and Tip+ at the end of the ramp" CURVE 0xCACC2 Kl_Xs16_Ws16 99.97559 Prc_1000 0.00 99.97559 FORMAT "%8.4" EXTENDED_LIMITS -4000.000 3999.878
 /begin AXIS_DESCR STD_AXIS CrCtl_vDiffRed_mp Vel 6 -327.6800 327.6700 FORMAT "%8.4" DEPOSIT ABSOLUTE /end AXIS_DESCR
/end CHARACTERISTIC
/begin CHARACTERISTIC CrCtl_facResBlw_CUR "Abflachungskennlinie für WA+" CURVE 0xCACDC Kl_Xs16_Ws16 99.97559 Prc_1000 0.00 99.97559 FORMAT "%8.4" EXTENDED_LIMITS -4000.000 3999.878
 /begin AXIS_DESCR STD_AXIS CrCtl_vDiffRed_mp Vel 6 -327.6800 327.6700 FORMAT "%8.4" DEPOSIT ABSOLUTE /end AXIS_DESCR
/end CHARACTERISTIC
/begin CHARACTERISTIC CrCtl_facRmpRes_C "Faktor für Rampensteigung FGR-Geschwindigkeit WA (Endphase WA-Rampe)" VALUE 0xCACF6 Kw_Ws16 1.000000 Fact 0.00 1.000000 FORMAT "%8.6" EXTENDED_LIMITS -4.000000 3.999878 /end CHARACTERISTIC
/begin CHARACTERISTIC CrCtl_HoldGear2IKi_C "Integralverstärkung Ki Kleinsignalbereich in HALTEN für 2. Gang" VALUE 0xCACF8 Kw_Wu32 19999999.9953 Ki_Vel2TrqPrp 0.00 19999999.9953 FORMAT "%13.4" /end CHARACTERISTIC
/begin CHARACTERISTIC CrCtl_HoldGear2IKiPos_C "Integralverstärkung Ki pos. Großsignalbereich in HALTEN für 2. Gang" VALUE 0xCACFC Kw_Wu32 19999999.9953 Ki_Vel2TrqPrp 0.00 19999999.9953 FORMAT "%13.4" /end CHARACTERISTIC
/begin CHARACTERISTIC CrCtl_HoldGear2IKiNeg_C "Integralverstärkung Ki neg. Großsignalbereich in HALTEN für 2. Gang" VALUE 0xCAD00 Kw_Wu32 19999999.9953 Ki_Vel2TrqPrp 0.00 19999999.9953 FORMAT "%13.4" /end CHARACTERISTIC
/begin CHARACTERISTIC CrCtl_vHoldGear2IWinPos_C "obere Grenze Kleinsignalbereich I-Anteil in HALTEN, 2. Gang" VALUE 0xCAD04 Kw_Ws16 300.0000 Vel 0.00 300.0000 FORMAT "%8.4" EXTENDED_LIMITS -327.6800 327.6700 /end CHARACTERISTIC
/begin CHARACTERISTIC CrCtl_vHoldGear2IWinNeg_C "untere Grenze Kleinsignalbereich I-Anteil in HALTEN, 2. Gang" VALUE 0xCAD06 Kw_Ws16 300.0000 Vel -300.0000 0.00 FORMAT "%8.4" EXTENDED_LIMITS -327.6800 327.6700 /end CHARACTERISTIC
/begin CHARACTERISTIC CrCtl_HoldGear2PKp_C "Proportionalverstärkung Kp Kleinsignalbereich in HALTEN, 2. Gang" VALUE 0xCAD08 Kw_Wu32 1310719.99969 Kp_Vel2TrqPrp 0.00 1310719.99969 FORMAT "%13.5" /end CHARACTERISTIC
/begin CHARACTERISTIC CrCtl_HoldGear2PKpPos_C "Proportionalverstärkung Kp pos. Großsignalbereich in HALTEN, 2. Gang" VALUE 0xCAD0C Kw_Wu32 1310719.99969 Kp_Vel2TrqPrp 0.00 1310719.99969 FORMAT "%13.5" /end CHARACTERISTIC
/begin CHARACTERISTIC CrCtl_HoldGear2PKpNeg_C "Proportionalverstärkung Kp neg. Großsignalbereich in HALTEN, 2. Gang" VALUE 0xCAD10 Kw_Wu32 1310719.99969 Kp_Vel2TrqPrp 0.00 1310719.99969 FORMAT "%13.5" /end CHARACTERISTIC
/begin CHARACTERISTIC CrCtl_vHoldGear2PWinPos_C "obere Grenze Kleinsignalbereich P-Anteil in HALTEN, 2. Gang" VALUE 0xCAD14 Kw_Ws16 300.0000 Vel 0.00 300.0000 FORMAT "%8.4" EXTENDED_LIMITS -327.6800 327.6700 /end CHARACTERISTIC
/begin CHARACTERISTIC CrCtl_vHoldGear2PWinNeg_C "untere Grenze Kleinsignalbereich P-Anteil in HALTEN, 2. Gang" VALUE 0xCAD16 Kw_Ws16 300.0000 Vel -300.0000 0.00 FORMAT "%8.4" EXTENDED_LIMITS -327.6800 327.6700 /end CHARACTERISTIC
/begin CHARACTERISTIC CrCtl_HoldGear3IKi_C "Integralverstärkung Kleinsignalbereich in HALTEN, 3. Gang" VALUE 0xCAD18 Kw_Wu32 19999999.9953 Ki_Vel2TrqPrp 0.00 19999999.9953 FORMAT "%13.4" /end CHARACTERISTIC
/begin CHARACTERISTIC CrCtl_HoldGear3IKiPos_C "Integralverstärkung Ki pos. Großsignalbereich in HALTEN, 3. Gang" VALUE 0xCAD1C Kw_Wu32 19999999.9953 Ki_Vel2TrqPrp 0.00 19999999.9953 FORMAT "%13.4" /end CHARACTERISTIC
/begin CHARACTERISTIC CrCtl_HoldGear3IKiNeg_C "Integralverstärkung Ki neg. Großsignalbereich in HALTEN, 3. Gang" VALUE 0xCAD20 Kw_Wu32 19999999.9953 Ki_Vel2TrqPrp 0.00 19999999.9953 FORMAT "%13.4" /end CHARACTERISTIC
/begin CHARACTERISTIC CrCtl_vHoldGear3IWinPos_C "obere Grenze Kleinsignalbereich I-Anteil in HALTEN, 3. Gang" VALUE 0xCAD24 Kw_Ws16 300.0000 Vel 0.00 300.0000 FORMAT "%8.4" EXTENDED_LIMITS -327.6800 327.6700 /end CHARACTERISTIC
/begin CHARACTERISTIC CrCtl_vHoldGear3IWinNeg_C "untere Grenze Kleinsignalbereich I-Anteil in HALTEN, 3. Gang" VALUE 0xCAD26 Kw_Ws16 300.0000 Vel -300.0000 0.00 FORMAT "%8.4" EXTENDED_LIMITS -327.6800 327.6700 /end CHARACTERISTIC
/begin CHARACTERISTIC CrCtl_HoldGear3PKp_C "Proportionalverstärkung Kp Kleinsignalbereich in HALTEN, 3. Gang" VALUE 0xCAD28 Kw_Wu32 1310719.99969 Kp_Vel2TrqPrp 0.00 1310719.99969 FORMAT "%13.5" /end CHARACTERISTIC
/begin CHARACTERISTIC CrCtl_HoldGear3PKpPos_C "Proportionalverstärkung Kp pos. Großsignalbereich in HALTEN, 3. Gang" VALUE 0xCAD2C Kw_Wu32 1310719.99969 Kp_Vel2TrqPrp 0.00 1310719.99969 FORMAT "%13.5" /end CHARACTERISTIC
/begin CHARACTERISTIC CrCtl_HoldGear3PKpNeg_C "Proportionalverstärkung Kp neg. Großsignalbereich in HALTEN, 3. Gang" VALUE 0xCAD30 Kw_Wu32 1310719.99969 Kp_Vel2TrqPrp 0.00 1310719.99969 FORMAT "%13.5" /end CHARACTERISTIC
/begin CHARACTERISTIC CrCtl_vHoldGear3PWinPos_C "obere Grenze Kleinsignalbereich P-Anteil in HALTEN, 3. Gang" VALUE 0xCAD34 Kw_Ws16 300.0000 Vel 0.00 300.0000 FORMAT "%8.4" EXTENDED_LIMITS -327.6800 327.6700 /end CHARACTERISTIC
/begin CHARACTERISTIC CrCtl_vHoldGear3PWinNeg_C "untere Grenze Kleinsignalbereich P-Anteil in HALTEN, 3. Gang" VALUE 0xCAD36 Kw_Ws16 300.0000 Vel -300.0000 0.00 FORMAT "%8.4" EXTENDED_LIMITS -327.6800 327.6700 /end CHARACTERISTIC
/begin CHARACTERISTIC CrCtl_HoldGear4IKi_C "Integralverstärkung Kleinsignalbereich in HALTEN, 4. Gang" VALUE 0xCAD38 Kw_Wu32 19999999.9953 Ki_Vel2TrqPrp 0.00 19999999.9953 FORMAT "%13.4" /end CHARACTERISTIC
/begin CHARACTERISTIC CrCtl_HoldGear4IKiPos_C "Integralverstärkung Ki pos. Großsignalbereich in HALTEN, 4. Gang" VALUE 0xCAD3C Kw_Wu32 19999999.9953 Ki_Vel2TrqPrp 0.00 19999999.9953 FORMAT "%13.4" /end CHARACTERISTIC
/begin CHARACTERISTIC CrCtl_HoldGear4IKiNeg_C "Integralverstärkung Ki neg. Großsignalbereich in HALTEN, 4. Gang" VALUE 0xCAD40 Kw_Wu32 19999999.9953 Ki_Vel2TrqPrp 0.00 19999999.9953 FORMAT "%13.4" /end CHARACTERISTIC
/begin CHARACTERISTIC CrCtl_vHoldGear4IWinPos_C "obere Grenze Kleinsignalbereich I-Anteil in HALTEN, 4. Gang" VALUE 0xCAD44 Kw_Ws16 300.0000 Vel 0.00 300.0000 FORMAT "%8.4" EXTENDED_LIMITS -327.6800 327.6700 /end CHARACTERISTIC
/begin CHARACTERISTIC CrCtl_vHoldGear4IWinNeg_C "untere Grenze Kleinsignalbereich I-Anteil in HALTEN, 4. Gang" VALUE 0xCAD46 Kw_Ws16 300.0000 Vel -300.0000 0.00 FORMAT "%8.4" EXTENDED_LIMITS -327.6800 327.6700 /end CHARACTERISTIC
/begin CHARACTERISTIC CrCtl_HoldGear4PKp_C "Proportionalverstärkung Kp Kleinsignalbereich in HALTEN, 4 Gang" VALUE 0xCAD48 Kw_Wu32 1310719.99969 Kp_Vel2TrqPrp 0.00 1310719.99969 FORMAT "%13.5" /end CHARACTERISTIC
/begin CHARACTERISTIC CrCtl_HoldGear4PKpPos_C "Proportionalverstärkung Kp pos. Großsignalbereich in HALTEN, 4. Gang" VALUE 0xCAD4C Kw_Wu32 1310719.99969 Kp_Vel2TrqPrp 0.00 1310719.99969 FORMAT "%13.5" /end CHARACTERISTIC
/begin CHARACTERISTIC CrCtl_HoldGear4PKpNeg_C "Proportionalverstärkung Kp neg. Großsignalbereich in HALTEN, 4. Gang" VALUE 0xCAD50 Kw_Wu32 1310719.99969 Kp_Vel2TrqPrp 0.00 1310719.99969 FORMAT "%13.5" /end CHARACTERISTIC
/begin CHARACTERISTIC CrCtl_vHoldGear4PWinPos_C "obere Grenze Kleinsignalbereich P-Anteil in HALTEN, 4. Gang" VALUE 0xCAD54 Kw_Ws16 300.0000 Vel 0.00 300.0000 FORMAT "%8.4" EXTENDED_LIMITS -327.6800 327.6700 /end CHARACTERISTIC
/begin CHARACTERISTIC CrCtl_vHoldGear4PWinNeg_C "untere Grenze Kleinsignalbereich P-Anteil in HALTEN, 4. Gang" VALUE 0xCAD56 Kw_Ws16 300.0000 Vel -300.0000 0.00 FORMAT "%8.4" EXTENDED_LIMITS -327.6800 327.6700 /end CHARACTERISTIC
/begin CHARACTERISTIC CrCtl_HoldGear5IKi_C "Integralverstärkung Kleinsignalbereich in HALTEN, 5. Gang" VALUE 0xCAD58 Kw_Wu32 19999999.9953 Ki_Vel2TrqPrp 0.00 19999999.9953 FORMAT "%13.4" /end CHARACTERISTIC
/begin CHARACTERISTIC CrCtl_HoldGear5IKiPos_C "Integralverstärkung Ki pos. Großsignalbereich in HALTEN, 5. Gang" VALUE 0xCAD5C Kw_Wu32 19999999.9953 Ki_Vel2TrqPrp 0.00 19999999.9953 FORMAT "%13.4" /end CHARACTERISTIC
/begin CHARACTERISTIC CrCtl_HoldGear5IKiNeg_C "Integralverstärkung Ki neg. Großsignalbereich in HALTEN, 5. Gang" VALUE 0xCAD60 Kw_Wu32 19999999.9953 Ki_Vel2TrqPrp 0.00 19999999.9953 FORMAT "%13.4" /end CHARACTERISTIC
/begin CHARACTERISTIC CrCtl_vHoldGear5IWinPos_C "obere Grenze Kleinsignalbereich I-Anteil in HALTEN, 5. Gang" VALUE 0xCAD64 Kw_Ws16 300.0000 Vel 0.00 300.0000 FORMAT "%8.4" EXTENDED_LIMITS -327.6800 327.6700 /end CHARACTERISTIC
/begin CHARACTERISTIC CrCtl_vHoldGear5IWinNeg_C "untere Grenze Kleinsignalbereich I-Anteil in HALTEN, 5. Gang" VALUE 0xCAD66 Kw_Ws16 300.0000 Vel -300.0000 0.00 FORMAT "%8.4" EXTENDED_LIMITS -327.6800 327.6700 /end CHARACTERISTIC
/begin CHARACTERISTIC CrCtl_HoldGear5PKp_C "Proportionalverstärkung Kp Kleinsignalbereich in HALTEN, 5 Gang" VALUE 0xCAD68 Kw_Wu32 1310719.99969 Kp_Vel2TrqPrp 0.00 1310719.99969 FORMAT "%13.5" /end CHARACTERISTIC
/begin CHARACTERISTIC CrCtl_HoldGear5PKpPos_C "Proportionalverstärkung Kp pos. Großsignalbereich in HALTEN, 5. Gang" VALUE 0xCAD6C Kw_Wu32 1310719.99969 Kp_Vel2TrqPrp 0.00 1310719.99969 FORMAT "%13.5" /end CHARACTERISTIC
/begin CHARACTERISTIC CrCtl_HoldGear5PKpNeg_C "Proportionalverstärkung Kp neg. Großsignalbereich in HALTEN, 5. Gang" VALUE 0xCAD70 Kw_Wu32 1310719.99969 Kp_Vel2TrqPrp 0.00 1310719.99969 FORMAT "%13.5" /end CHARACTERISTIC
/begin CHARACTERISTIC CrCtl_vHoldGear5PWinPos_C "obere Grenze Kleinsignalbereich P-Anteil in HALTEN, 5. Gang" VALUE 0xCAD74 Kw_Ws16 300.0000 Vel 0.00 300.0000 FORMAT "%8.4" EXTENDED_LIMITS -327.6800 327.6700 /end CHARACTERISTIC
/begin CHARACTERISTIC CrCtl_vHoldGear5PWinNeg_C "untere Grenze Kleinsignalbereich P-Anteil in HALTEN, 5. Gang" VALUE 0xCAD76 Kw_Ws16 300.0000 Vel -300.0000 0.00 FORMAT "%8.4" EXTENDED_LIMITS -327.6800 327.6700 /end CHARACTERISTIC
/begin CHARACTERISTIC CrCtl_HoldGear6IKi_C "Integralverstärkung Kleinsignalbereich in HALTEN, 6. Gang" VALUE 0xCAD78 Kw_Wu32 19999999.9953 Ki_Vel2TrqPrp 0.00 19999999.9953 FORMAT "%13.4" /end CHARACTERISTIC
/begin CHARACTERISTIC CrCtl_HoldGear6IKiPos_C "Integralverstärkung Ki neg. Großsignalbereich in HALTEN, 6. Gang" VALUE 0xCAD7C Kw_Wu32 19999999.9953 Ki_Vel2TrqPrp 0.00 19999999.9953 FORMAT "%13.4" /end CHARACTERISTIC
/begin CHARACTERISTIC CrCtl_HoldGear6IKiNeg_C "Integralverstärkung Ki neg. Großsignalbereich in HALTEN, 6. Gang" VALUE 0xCAD80 Kw_Wu32 19999999.9953 Ki_Vel2TrqPrp 0.00 19999999.9953 FORMAT "%13.4" /end CHARACTERISTIC
/begin CHARACTERISTIC CrCtl_vHoldGear6IWinPos_C "obere Grenze Kleinsignalbereich I-Anteil in HALTEN, 6. Gang" VALUE 0xCAD84 Kw_Ws16 300.0000 Vel 0.00 300.0000 FORMAT "%8.4" EXTENDED_LIMITS -327.6800 327.6700 /end CHARACTERISTIC
/begin CHARACTERISTIC CrCtl_vHoldGear6IWinNeg_C "untere Grenze Kleinsignalbereich I-Anteil in HALTEN, 6. Gang" VALUE 0xCAD86 Kw_Ws16 300.0000 Vel -300.0000 0.00 FORMAT "%8.4" EXTENDED_LIMITS -327.6800 327.6700 /end CHARACTERISTIC
/begin CHARACTERISTIC CrCtl_HoldGear6PKp_C "Proportionalverstärkung Kp Kleinsignalbereich in HALTEN, 6 Gang" VALUE 0xCAD88 Kw_Wu32 1310719.99969 Kp_Vel2TrqPrp 0.00 1310719.99969 FORMAT "%13.5" /end CHARACTERISTIC
/begin CHARACTERISTIC CrCtl_HoldGear6PKpPos_C "Proportionalverstärkung Kp pos. Großsignalbereich in HALTEN, 6. Gang" VALUE 0xCAD8C Kw_Wu32 1310719.99969 Kp_Vel2TrqPrp 0.00 1310719.99969 FORMAT "%13.5" /end CHARACTERISTIC
/begin CHARACTERISTIC CrCtl_HoldGear6PKpNeg_C "Proportionalverstärkung Kp neg. Großsignalbereich in HALTEN, 6. Gang" VALUE 0xCAD90 Kw_Wu32 1310719.99969 Kp_Vel2TrqPrp 0.00 1310719.99969 FORMAT "%13.5" /end CHARACTERISTIC
/begin CHARACTERISTIC CrCtl_vHoldGear6PWinPos_C "obere Grenze Kleinsignalbereich P-Anteil in HALTEN, 6. Gang" VALUE 0xCAD94 Kw_Ws16 300.0000 Vel 0.00 300.0000 FORMAT "%8.4" EXTENDED_LIMITS -327.6800 327.6700 /end CHARACTERISTIC
/begin CHARACTERISTIC CrCtl_vHoldGear6PWinNeg_C "untere Grenze Kleinsignalbereich P-Anteil in HALTEN, 6. Gang" VALUE 0xCAD96 Kw_Ws16 300.0000 Vel -300.0000 0.00 FORMAT "%8.4" EXTENDED_LIMITS -327.6800 327.6700 /end CHARACTERISTIC
/begin CHARACTERISTIC CrCtl_rAccPedVelMin_C "Minimum acc per ratio for cruise control" VALUE 0xCAEF0 Kw_Ws16 799.9878 Prc -400.0000 399.9878 FORMAT "%8.4" /end CHARACTERISTIC
/begin CHARACTERISTIC CrCtl_tiResAbvGear2DT1_C "DT1 Zeitkonstante T1 Endphase WA oben für 2. Gang" VALUE 0xCAD98 Kw_Wu32 4294.9673 TimeDelay_s 0.0000010000000 4294.9673 FORMAT "%9.4" /end CHARACTERISTIC
/begin CHARACTERISTIC CrCtl_ResAbvGear2DT1Kd_C "Differentialverstärkung Endphase WA oben 2. Gang" VALUE 0xCAD9C Kw_Ws32 1310719.99969 Kd_Vel2TrqPrp -655360.000000 655359.999695 FORMAT "%13.6" /end CHARACTERISTIC
/begin CHARACTERISTIC CrCtl_tiResAbvGear3DT1_C "DT1 Zeitkonstante T1 Endphase WA oben für 3. Gang" VALUE 0xCADA0 Kw_Wu32 4294.9673 TimeDelay_s 0.0000010000000 4294.9673 FORMAT "%9.4" /end CHARACTERISTIC
/begin CHARACTERISTIC CrCtl_ResAbvGear3DT1Kd_C "Differentialverstärkung Endphase WA oben 3. Gang" VALUE 0xCADA4 Kw_Ws32 1310719.99969 Kd_Vel2TrqPrp -655360.000000 655359.999695 FORMAT "%13.6" /end CHARACTERISTIC
/begin CHARACTERISTIC CrCtl_tiResAbvGear4DT1_C "DT1 Zeitkonstante T1 Endphase WA oben für 4. Gang" VALUE 0xCADA8 Kw_Wu32 4294.9673 TimeDelay_s 0.0000010000000 4294.9673 FORMAT "%9.4" /end CHARACTERISTIC
/begin CHARACTERISTIC CrCtl_ResAbvGear4DT1Kd_C "Differentialverstärkung Endphase WA oben 4. Gang" VALUE 0xCADAC Kw_Ws32 1310719.99969 Kd_Vel2TrqPrp -655360.000000 655359.999695 FORMAT "%13.6" /end CHARACTERISTIC
/begin CHARACTERISTIC CrCtl_tiResAbvGear5DT1_C "DT1 Zeitkonstante T1 Endphase WA oben für 5. Gang" VALUE 0xCADB0 Kw_Wu32 4294.9673 TimeDelay_s 0.0000010000000 4294.9673 FORMAT "%9.4" /end CHARACTERISTIC
/begin CHARACTERISTIC CrCtl_ResAbvGear5DT1Kd_C "Differentialverstärkung Endphase WA oben 5. Gang" VALUE 0xCADB4 Kw_Ws32 1310719.99969 Kd_Vel2TrqPrp -655360.000000 655359.999695 FORMAT "%13.6" /end CHARACTERISTIC
/begin CHARACTERISTIC CrCtl_tiResAbvGear6DT1_C "DT1 Zeitkonstante T1 Endphase WA oben für 6. Gang" VALUE 0xCADB8 Kw_Wu32 4294.9673 TimeDelay_s 0.0000010000000 4294.9673 FORMAT "%9.4" /end CHARACTERISTIC
/begin CHARACTERISTIC CrCtl_ResAbvGear6DT1Kd_C "Differentialverstärkung Endphase WA oben 6. Gang" VALUE 0xCADBC Kw_Ws32 1310719.99969 Kd_Vel2TrqPrp -655360.000000 655359.999695 FORMAT "%13.6" /end CHARACTERISTIC
/begin CHARACTERISTIC CrCtl_ResBlwGear2IKi_C "PI-Reglerparametersatz für WA+ 2.Gang" VALUE 0xCADC0 Kw_Wu32 19999999.9953 Ki_Vel2TrqPrp 0.00 19999999.9953 FORMAT "%13.4" /end CHARACTERISTIC
/begin CHARACTERISTIC CrCtl_ResBlwGear2IKiPos_C "PI-Reglerparametersatz für WA+ 2.Gang" VALUE 0xCADC4 Kw_Wu32 19999999.9953 Ki_Vel2TrqPrp 0.00 19999999.9953 FORMAT "%13.4" /end CHARACTERISTIC
/begin CHARACTERISTIC CrCtl_ResBlwGear2IKiNeg_C "PI-Reglerparametersatz für WA+ 2.Gang" VALUE 0xCADC8 Kw_Wu32 19999999.9953 Ki_Vel2TrqPrp 0.00 19999999.9953 FORMAT "%13.4" /end CHARACTERISTIC
/begin CHARACTERISTIC CrCtl_vResBlwGear2IWinPos_C "PI-Reglerparametersatz für WA+ 2.Gang" VALUE 0xCADCC Kw_Ws16 300.0000 Vel 0.00 300.0000 FORMAT "%8.4" EXTENDED_LIMITS -327.6800 327.6700 /end CHARACTERISTIC
/begin CHARACTERISTIC CrCtl_vResBlwGear2IWinNeg_C "PI-Reglerparametersatz für WA+ 2.Gang" VALUE 0xCADCE Kw_Ws16 300.0000 Vel -300.0000 0.00 FORMAT "%8.4" EXTENDED_LIMITS -327.6800 327.6700 /end CHARACTERISTIC
/begin CHARACTERISTIC CrCtl_ResBlwGear2PKp_C "PI-Reglerparametersatz für WA+ 2.Gang" VALUE 0xCADD0 Kw_Wu32 1310719.99969 Kp_Vel2TrqPrp 0.00 1310719.99969 FORMAT "%13.5" /end CHARACTERISTIC
/begin CHARACTERISTIC CrCtl_ResBlwGear2PKpPos_C "PI-Reglerparametersatz für WA+ 2.Gang" VALUE 0xCADD4 Kw_Wu32 1310719.99969 Kp_Vel2TrqPrp 0.00 1310719.99969 FORMAT "%13.5" /end CHARACTERISTIC
/begin CHARACTERISTIC CrCtl_ResBlwGear2PKpNeg_C "PI-Reglerparametersatz für WA+ 2.Gang" VALUE 0xCADD8 Kw_Wu32 1310719.99969 Kp_Vel2TrqPrp 0.00 1310719.99969 FORMAT "%13.5" /end CHARACTERISTIC
/begin CHARACTERISTIC CrCtl_vResBlwGear2PWinPos_C "PI-Reglerparametersatz für WA+ 2.Gang" VALUE 0xCADDC Kw_Ws16 300.0000 Vel 0.00 300.0000 FORMAT "%8.4" EXTENDED_LIMITS -327.6800 327.6700 /end CHARACTERISTIC
/begin CHARACTERISTIC CrCtl_vResBlwGear2PWinNeg_C "PI-Reglerparametersatz für WA+ 2.Gang" VALUE 0xCADDE Kw_Ws16 300.0000 Vel -300.0000 0.00 FORMAT "%8.4" EXTENDED_LIMITS -327.6800 327.6700 /end CHARACTERISTIC
/begin CHARACTERISTIC CrCtl_ResBlwGear3IKi_C "PI-Reglerparametersatz für WA+ 3.Gang" VALUE 0xCADE0 Kw_Wu32 19999999.9953 Ki_Vel2TrqPrp 0.00 19999999.9953 FORMAT "%13.4" /end CHARACTERISTIC
/begin CHARACTERISTIC CrCtl_ResBlwGear3IKiPos_C "PI-Reglerparametersatz für WA+ 3.Gang" VALUE 0xCADE4 Kw_Wu32 19999999.9953 Ki_Vel2TrqPrp 0.00 19999999.9953 FORMAT "%13.4" /end CHARACTERISTIC
/begin CHARACTERISTIC CrCtl_ResBlwGear3IKiNeg_C "PI-Reglerparametersatz für WA+ 3.Gang" VALUE 0xCADE8 Kw_Wu32 19999999.9953 Ki_Vel2TrqPrp 0.00 19999999.9953 FORMAT "%13.4" /end CHARACTERISTIC
/begin CHARACTERISTIC CrCtl_vResBlwGear3IWinPos_C "PI-Reglerparametersatz für WA+ 3.Gang" VALUE 0xCADEC Kw_Ws16 300.0000 Vel 0.00 300.0000 FORMAT "%8.4" EXTENDED_LIMITS -327.6800 327.6700 /end CHARACTERISTIC
/begin CHARACTERISTIC CrCtl_vResBlwGear3IWinNeg_C "PI-Reglerparametersatz für WA+ 3.Gang" VALUE 0xCADEE Kw_Ws16 300.0000 Vel -300.0000 0.00 FORMAT "%8.4" EXTENDED_LIMITS -327.6800 327.6700 /end CHARACTERISTIC
/begin CHARACTERISTIC CrCtl_ResBlwGear3PKp_C "PI-Reglerparametersatz für WA+ 3.Gang" VALUE 0xCADF0 Kw_Wu32 1310719.99969 Kp_Vel2TrqPrp 0.00 1310719.99969 FORMAT "%13.5" /end CHARACTERISTIC
/begin CHARACTERISTIC CrCtl_ResBlwGear3PKpPos_C "PI-Reglerparametersatz für WA+ 3.Gang" VALUE 0xCADF4 Kw_Wu32 1310719.99969 Kp_Vel2TrqPrp 0.00 1310719.99969 FORMAT "%13.5" /end CHARACTERISTIC
/begin CHARACTERISTIC CrCtl_ResBlwGear3PKpNeg_C "PI-Reglerparametersatz für WA+ 3.Gang" VALUE 0xCADF8 Kw_Wu32 1310719.99969 Kp_Vel2TrqPrp 0.00 1310719.99969 FORMAT "%13.5" /end CHARACTERISTIC
/begin CHARACTERISTIC CrCtl_vResBlwGear3PWinPos_C "PI-Reglerparametersatz für WA+ 3.Gang" VALUE 0xCADFC Kw_Ws16 300.0000 Vel 0.00 300.0000 FORMAT "%8.4" EXTENDED_LIMITS -327.6800 327.6700 /end CHARACTERISTIC
/begin CHARACTERISTIC CrCtl_vResBlwGear3PWinNeg_C "PI-Reglerparametersatz für WA+ 3.Gang" VALUE 0xCADFE Kw_Ws16 300.0000 Vel -300.0000 0.00 FORMAT "%8.4" EXTENDED_LIMITS -327.6800 327.6700 /end CHARACTERISTIC
/begin CHARACTERISTIC CrCtl_ResBlwGear4IKi_C "PI-Reglerparametersatz für WA+ 4.Gang" VALUE 0xCAE00 Kw_Wu32 19999999.9953 Ki_Vel2TrqPrp 0.00 19999999.9953 FORMAT "%13.4" /end CHARACTERISTIC
/begin CHARACTERISTIC CrCtl_ResBlwGear4IKiPos_C "PI-Reglerparametersatz für WA+ 4.Gang" VALUE 0xCAE04 Kw_Wu32 19999999.9953 Ki_Vel2TrqPrp 0.00 19999999.9953 FORMAT "%13.4" /end CHARACTERISTIC
/begin CHARACTERISTIC CrCtl_ResBlwGear4IKiNeg_C "PI-Reglerparametersatz für WA+ 4.Gang" VALUE 0xCAE08 Kw_Wu32 19999999.9953 Ki_Vel2TrqPrp 0.00 19999999.9953 FORMAT "%13.4" /end CHARACTERISTIC
/begin CHARACTERISTIC CrCtl_vResBlwGear4IWinPos_C "PI-Reglerparametersatz für WA+ 4.Gang" VALUE 0xCAE0C Kw_Ws16 300.0000 Vel 0.00 300.0000 FORMAT "%8.4" EXTENDED_LIMITS -327.6800 327.6700 /end CHARACTERISTIC
/begin CHARACTERISTIC CrCtl_vResBlwGear4IWinNeg_C "PI-Reglerparametersatz für WA+ 4.Gang" VALUE 0xCAE0E Kw_Ws16 300.0000 Vel -300.0000 0.00 FORMAT "%8.4" EXTENDED_LIMITS -327.6800 327.6700 /end CHARACTERISTIC
/begin CHARACTERISTIC CrCtl_ResBlwGear4PKp_C "PI-Reglerparametersatz für WA+ 4.Gang" VALUE 0xCAE10 Kw_Wu32 1310719.99969 Kp_Vel2TrqPrp 0.00 1310719.99969 FORMAT "%13.5" /end CHARACTERISTIC
/begin CHARACTERISTIC CrCtl_ResBlwGear4PKpPos_C "PI-Reglerparametersatz für WA+ 4.Gang" VALUE 0xCAE14 Kw_Wu32 1310719.99969 Kp_Vel2TrqPrp 0.00 1310719.99969 FORMAT "%13.5" /end CHARACTERISTIC
/begin CHARACTERISTIC CrCtl_ResBlwGear4PKpNeg_C "PI-Reglerparametersatz für WA+ 4.Gang" VALUE 0xCAE18 Kw_Wu32 1310719.99969 Kp_Vel2TrqPrp 0.00 1310719.99969 FORMAT "%13.5" /end CHARACTERISTIC
/begin CHARACTERISTIC CrCtl_vResBlwGear4PWinPos_C "PI-Reglerparametersatz für WA+ 4.Gang" VALUE 0xCAE1C Kw_Ws16 300.0000 Vel 0.00 300.0000 FORMAT "%8.4" EXTENDED_LIMITS -327.6800 327.6700 /end CHARACTERISTIC
/begin CHARACTERISTIC CrCtl_vResBlwGear4PWinNeg_C "PI-Reglerparametersatz für WA+ 4.Gang" VALUE 0xCAE1E Kw_Ws16 300.0000 Vel -300.0000 0.00 FORMAT "%8.4" EXTENDED_LIMITS -327.6800 327.6700 /end CHARACTERISTIC
/begin CHARACTERISTIC CrCtl_ResBlwGear5IKi_C "PI-Reglerparametersatz für WA+ 5.Gang" VALUE 0xCAE20 Kw_Wu32 19999999.9953 Ki_Vel2TrqPrp 0.00 19999999.9953 FORMAT "%13.4" /end CHARACTERISTIC
/begin CHARACTERISTIC CrCtl_ResBlwGear5IKiPos_C "PI-Reglerparametersatz für WA+ 5.Gang" VALUE 0xCAE24 Kw_Wu32 19999999.9953 Ki_Vel2TrqPrp 0.00 19999999.9953 FORMAT "%13.4" /end CHARACTERISTIC
/begin CHARACTERISTIC CrCtl_ResBlwGear5IKiNeg_C "PI-Reglerparametersatz für WA+ 5.Gang" VALUE 0xCAE28 Kw_Wu32 19999999.9953 Ki_Vel2TrqPrp 0.00 19999999.9953 FORMAT "%13.4" /end CHARACTERISTIC
/begin CHARACTERISTIC CrCtl_vResBlwGear5IWinPos_C "PI-Reglerparametersatz für WA+ 5.Gang" VALUE 0xCAE2C Kw_Ws16 300.0000 Vel 0.00 300.0000 FORMAT "%8.4" EXTENDED_LIMITS -327.6800 327.6700 /end CHARACTERISTIC
/begin CHARACTERISTIC CrCtl_vResBlwGear5IWinNeg_C "PI-Reglerparametersatz für WA+ 5.Gang" VALUE 0xCAE2E Kw_Ws16 300.0000 Vel -300.0000 0.00 FORMAT "%8.4" EXTENDED_LIMITS -327.6800 327.6700 /end CHARACTERISTIC
/begin CHARACTERISTIC CrCtl_ResBlwGear5PKp_C "PI-Reglerparametersatz für WA+ 5.Gang" VALUE 0xCAE30 Kw_Wu32 1310719.99969 Kp_Vel2TrqPrp 0.00 1310719.99969 FORMAT "%13.5" /end CHARACTERISTIC
/begin CHARACTERISTIC CrCtl_ResBlwGear5PKpPos_C "PI-Reglerparametersatz für WA+ 5.Gang" VALUE 0xCAE34 Kw_Wu32 1310719.99969 Kp_Vel2TrqPrp 0.00 1310719.99969 FORMAT "%13.5" /end CHARACTERISTIC
/begin CHARACTERISTIC CrCtl_ResBlwGear5PKpNeg_C "PI-Reglerparametersatz für WA+ 5.Gang" VALUE 0xCAE38 Kw_Wu32 1310719.99969 Kp_Vel2TrqPrp 0.00 1310719.99969 FORMAT "%13.5" /end CHARACTERISTIC
/begin CHARACTERISTIC CrCtl_vResBlwGear5PWinPos_C "PI-Reglerparametersatz für WA+ 5.Gang" VALUE 0xCAE3C Kw_Ws16 300.0000 Vel 0.00 300.0000 FORMAT "%8.4" EXTENDED_LIMITS -327.6800 327.6700 /end CHARACTERISTIC
/begin CHARACTERISTIC CrCtl_vResBlwGear5PWinNeg_C "PI-Reglerparametersatz für WA+ 5.Gang" VALUE 0xCAE3E Kw_Ws16 300.0000 Vel -300.0000 0.00 FORMAT "%8.4" EXTENDED_LIMITS -327.6800 327.6700 /end CHARACTERISTIC
/begin CHARACTERISTIC CrCtl_ResBlwGear6IKi_C "PI-Reglerparametersatz für WA+ 6.Gang" VALUE 0xCAE40 Kw_Wu32 19999999.9953 Ki_Vel2TrqPrp 0.00 19999999.9953 FORMAT "%13.4" /end CHARACTERISTIC
/begin CHARACTERISTIC CrCtl_ResBlwGear6IKiPos_C "PI-Reglerparametersatz für WA+ 6.Gang" VALUE 0xCAE44 Kw_Wu32 19999999.9953 Ki_Vel2TrqPrp 0.00 19999999.9953 FORMAT "%13.4" /end CHARACTERISTIC
/begin CHARACTERISTIC CrCtl_ResBlwGear6IKiNeg_C "PI-Reglerparametersatz für WA+ 6.Gang" VALUE 0xCAE48 Kw_Wu32 19999999.9953 Ki_Vel2TrqPrp 0.00 19999999.9953 FORMAT "%13.4" /end CHARACTERISTIC
/begin CHARACTERISTIC CrCtl_vResBlwGear6IWinPos_C "PI-Reglerparametersatz für WA+ 6.Gang" VALUE 0xCAE4C Kw_Ws16 300.0000 Vel 0.00 300.0000 FORMAT "%8.4" EXTENDED_LIMITS -327.6800 327.6700 /end CHARACTERISTIC
/begin CHARACTERISTIC CrCtl_vResBlwGear6IWinNeg_C "PI-Reglerparametersatz für WA+ 6.Gang" VALUE 0xCAE4E Kw_Ws16 300.0000 Vel -300.0000 0.00 FORMAT "%8.4" EXTENDED_LIMITS -327.6800 327.6700 /end CHARACTERISTIC
/begin CHARACTERISTIC CrCtl_ResBlwGear6PKp_C "PI-Reglerparametersatz für WA+ 6.Gang" VALUE 0xCAE50 Kw_Wu32 1310719.99969 Kp_Vel2TrqPrp 0.00 1310719.99969 FORMAT "%13.5" /end CHARACTERISTIC
/begin CHARACTERISTIC CrCtl_ResBlwGear6PKpPos_C "PI-Reglerparametersatz für WA+ 6.Gang" VALUE 0xCAE54 Kw_Wu32 1310719.99969 Kp_Vel2TrqPrp 0.00 1310719.99969 FORMAT "%13.5" /end CHARACTERISTIC
/begin CHARACTERISTIC CrCtl_ResBlwGear6PKpNeg_C "PI-Reglerparametersatz für WA+ 6.Gang" VALUE 0xCAE58 Kw_Wu32 1310719.99969 Kp_Vel2TrqPrp 0.00 1310719.99969 FORMAT "%13.5" /end CHARACTERISTIC
/begin CHARACTERISTIC CrCtl_vResBlwGear6PWinPos_C "PI-Reglerparametersatz für WA+ 6.Gang" VALUE 0xCAE5C Kw_Ws16 300.0000 Vel 0.00 300.0000 FORMAT "%8.4" EXTENDED_LIMITS -327.6800 327.6700 /end CHARACTERISTIC
/begin CHARACTERISTIC CrCtl_vResBlwGear6PWinNeg_C "PI-Reglerparametersatz für WA+ 6.Gang" VALUE 0xCAE5E Kw_Ws16 300.0000 Vel -300.0000 0.00 FORMAT "%8.4" EXTENDED_LIMITS -327.6800 327.6700 /end CHARACTERISTIC
/begin CHARACTERISTIC CrCtl_ResRmpGear2PKp_C "P-Reglerparametersatz für WA 2.Gang" VALUE 0xCAE60 Kw_Wu32 1310719.99969 Kp_Vel2TrqPrp 0.00 1310719.99969 FORMAT "%13.5" /end CHARACTERISTIC
/begin CHARACTERISTIC CrCtl_ResRmpGear2PKpPos_C "P-Reglerparametersatz für WA 2.Gang" VALUE 0xCAE64 Kw_Wu32 1310719.99969 Kp_Vel2TrqPrp 0.00 1310719.99969 FORMAT "%13.5" /end CHARACTERISTIC
/begin CHARACTERISTIC CrCtl_ResRmpGear2PKpNeg_C "P-Reglerparametersatz für WA 2.Gang" VALUE 0xCAE68 Kw_Wu32 1310719.99969 Kp_Vel2TrqPrp 0.00 1310719.99969 FORMAT "%13.5" /end CHARACTERISTIC
/begin CHARACTERISTIC CrCtl_vResRmpGear2PWinPos_C "P-Reglerparametersatz für WA 2.Gang" VALUE 0xCAE6C Kw_Ws16 300.0000 Vel 0.00 300.0000 FORMAT "%8.4" EXTENDED_LIMITS -327.6800 327.6700 /end CHARACTERISTIC
/begin CHARACTERISTIC CrCtl_vResRmpGear2PWinNeg_C "P-Reglerparametersatz für WA 2.Gang" VALUE 0xCAE6E Kw_Ws16 300.0000 Vel -300.0000 0.00 FORMAT "%8.4" EXTENDED_LIMITS -327.6800 327.6700 /end CHARACTERISTIC
/begin CHARACTERISTIC CrCtl_ResRmpGear3PKp_C "P-Reglerparametersatz für WA 3.Gang" VALUE 0xCAE70 Kw_Wu32 1310719.99969 Kp_Vel2TrqPrp 0.00 1310719.99969 FORMAT "%13.5" /end CHARACTERISTIC
/begin CHARACTERISTIC CrCtl_ResRmpGear3PKpPos_C "P-Reglerparametersatz für WA 3.Gang" VALUE 0xCAE74 Kw_Wu32 1310719.99969 Kp_Vel2TrqPrp 0.00 1310719.99969 FORMAT "%13.5" /end CHARACTERISTIC
/begin CHARACTERISTIC CrCtl_ResRmpGear3PKpNeg_C "P-Reglerparametersatz für WA 3.Gang" VALUE 0xCAE78 Kw_Wu32 1310719.99969 Kp_Vel2TrqPrp 0.00 1310719.99969 FORMAT "%13.5" /end CHARACTERISTIC
/begin CHARACTERISTIC CrCtl_vResRmpGear3PWinPos_C "P-Reglerparametersatz für WA 3.Gang" VALUE 0xCAE7C Kw_Ws16 300.0000 Vel 0.00 300.0000 FORMAT "%8.4" EXTENDED_LIMITS -327.6800 327.6700 /end CHARACTERISTIC
/begin CHARACTERISTIC CrCtl_vResRmpGear3PWinNeg_C "P-Reglerparametersatz für WA 3.Gang" VALUE 0xCAE7E Kw_Ws16 300.0000 Vel -300.0000 0.00 FORMAT "%8.4" EXTENDED_LIMITS -327.6800 327.6700 /end CHARACTERISTIC
/begin CHARACTERISTIC CrCtl_ResRmpGear4PKp_C "P-Reglerparametersatz für WA 4.Gang" VALUE 0xCAE80 Kw_Wu32 1310719.99969 Kp_Vel2TrqPrp 0.00 1310719.99969 FORMAT "%13.5" /end CHARACTERISTIC
/begin CHARACTERISTIC CrCtl_ResRmpGear4PKpPos_C "P-Reglerparametersatz für WA 4.Gang" VALUE 0xCAE84 Kw_Wu32 1310719.99969 Kp_Vel2TrqPrp 0.00 1310719.99969 FORMAT "%13.5" /end CHARACTERISTIC
/begin CHARACTERISTIC CrCtl_ResRmpGear4PKpNeg_C "P-Reglerparametersatz für WA 4.Gang" VALUE 0xCAE88 Kw_Wu32 1310719.99969 Kp_Vel2TrqPrp 0.00 1310719.99969 FORMAT "%13.5" /end CHARACTERISTIC
/begin CHARACTERISTIC CrCtl_vResRmpGear4PWinPos_C "P-Reglerparametersatz für WA 4.Gang" VALUE 0xCAE8C Kw_Ws16 300.0000 Vel 0.00 300.0000 FORMAT "%8.4" EXTENDED_LIMITS -327.6800 327.6700 /end CHARACTERISTIC
/begin CHARACTERISTIC CrCtl_vResRmpGear4PWinNeg_C "P-Reglerparametersatz für WA 4.Gang" VALUE 0xCAE8E Kw_Ws16 300.0000 Vel -300.0000 0.00 FORMAT "%8.4" EXTENDED_LIMITS -327.6800 327.6700 /end CHARACTERISTIC
/begin CHARACTERISTIC CrCtl_ResRmpGear5PKp_C "P-Reglerparametersatz für WA 5.Gang" VALUE 0xCAE90 Kw_Wu32 1310719.99969 Kp_Vel2TrqPrp 0.00 1310719.99969 FORMAT "%13.5" /end CHARACTERISTIC
/begin CHARACTERISTIC CrCtl_ResRmpGear5PKpPos_C "P-Reglerparametersatz für WA 5.Gang" VALUE 0xCAE94 Kw_Wu32 1310719.99969 Kp_Vel2TrqPrp 0.00 1310719.99969 FORMAT "%13.5" /end CHARACTERISTIC
/begin CHARACTERISTIC CrCtl_ResRmpGear5PKpNeg_C "P-Reglerparametersatz für WA 5.Gang" VALUE 0xCAE98 Kw_Wu32 1310719.99969 Kp_Vel2TrqPrp 0.00 1310719.99969 FORMAT "%13.5" /end CHARACTERISTIC
/begin CHARACTERISTIC CrCtl_vResRmpGear5PWinPos_C "P-Reglerparametersatz für WA 5.Gang" VALUE 0xCAE9C Kw_Ws16 300.0000 Vel 0.00 300.0000 FORMAT "%8.4" EXTENDED_LIMITS -327.6800 327.6700 /end CHARACTERISTIC
/begin CHARACTERISTIC CrCtl_vResRmpGear5PWinNeg_C "P-Reglerparametersatz für WA 5.Gang" VALUE 0xCAE9E Kw_Ws16 300.0000 Vel -300.0000 0.00 FORMAT "%8.4" EXTENDED_LIMITS -327.6800 327.6700 /end CHARACTERISTIC
/begin CHARACTERISTIC CrCtl_ResRmpGear6PKp_C "P-Reglerparametersatz für WA 6.Gang" VALUE 0xCAEA0 Kw_Wu32 1310719.99969 Kp_Vel2TrqPrp 0.00 1310719.99969 FORMAT "%13.5" /end CHARACTERISTIC
/begin CHARACTERISTIC CrCtl_ResRmpGear6PKpPos_C "P-Reglerparametersatz für WA 6.Gang" VALUE 0xCAEA4 Kw_Wu32 1310719.99969 Kp_Vel2TrqPrp 0.00 1310719.99969 FORMAT "%13.5" /end CHARACTERISTIC
/begin CHARACTERISTIC CrCtl_ResRmpGear6PKpNeg_C "P-Reglerparametersatz für WA 6.Gang" VALUE 0xCAEA8 Kw_Wu32 1310719.99969 Kp_Vel2TrqPrp 0.00 1310719.99969 FORMAT "%13.5" /end CHARACTERISTIC
/begin CHARACTERISTIC CrCtl_vResRmpGear6PWinPos_C "P-Reglerparametersatz für WA 6.Gang" VALUE 0xCAEAC Kw_Ws16 300.0000 Vel 0.00 300.0000 FORMAT "%8.4" EXTENDED_LIMITS -327.6800 327.6700 /end CHARACTERISTIC
/begin CHARACTERISTIC CrCtl_vResRmpGear6PWinNeg_C "P-Reglerparametersatz für WA 6.Gang" VALUE 0xCAEAE Kw_Ws16 300.0000 Vel -300.0000 0.00 FORMAT "%8.4" EXTENDED_LIMITS -327.6800 327.6700 /end CHARACTERISTIC
/begin CHARACTERISTIC CrCtl_swtCrCtlType_C "Schalter um Typ des Tempomats auszuwählen (1: herkömmlicher Tempomat, 2: Stufentempomat)" VALUE 0xCAEF2 Kw_Wu8 255.0 OneToOne 0.00 255.0 FORMAT "%5.1" /end CHARACTERISTIC
/begin CHARACTERISTIC CrCtl_swtOffset_C "Umschaltung zwischen gesendeter und berechneter Anzeigegeschwindigkeit (1: berechnete, 0: gesendete)" VALUE 0xCAEF3 Kw_Wu8 255.0 OneToOne 0.00 255.0 FORMAT "%5.1" /end CHARACTERISTIC
/begin CHARACTERISTIC CrCtl_swtResOff_C "0...keine Wiederaufnahme im Stufentemp. Zustand OFF; 1...Wiederaufnahme im Stufentempomat-Zustand OFF erlaubt" VALUE 0xCAEB0 Kw_Wu8 255.0 OneToOne 0.00 255.0 FORMAT "%5.1" /end CHARACTERISTIC
/begin CHARACTERISTIC CrCtl_swtVSSFil_C "Schalter zur Auswahl zwischen gefilterter und ungefilterter Fahrzeug-Ist-Geschwindigkeit (1: gefiltert 0: ungefiltert)" VALUE 0xCAEF4 Kw_Wu8 255.0 OneToOne 0.00 255.0 FORMAT "%5.1" /end CHARACTERISTIC
/begin CHARACTERISTIC CrCtl_tiDisableDiagVCrCtl_C "Time to disable cruise control diagnostics" VALUE 0xCAEF8 Kw_Wu32 42949672950.0 Time_ms 0.00 42949672950.0 FORMAT "%13.1" /end CHARACTERISTIC
/begin CHARACTERISTIC CrCtl_tiDispOffFil_C "time delay for tracking speed set point" VALUE 0xCAEFC Kw_Wu32 4294.9673 TimeDelay_s 0.0000010000000 4294.9673 FORMAT "%9.4" /end CHARACTERISTIC
/begin CHARACTERISTIC CrCtl_tiOff_C "Dauer zum niederrampen zum gewünschten Drehmoment" VALUE 0xCAEB2 Kw_Wu16 655350.0 TimeDeb 0.00 655350.0 FORMAT "%8.1" /end CHARACTERISTIC
/begin CHARACTERISTIC CrCtl_tiTipUpDn_C "Erkennungszeit TIP-UP/DOWN" VALUE 0xCAEB4 Kw_Wu16 655350.0 Time_ms 0.00 655350.0 FORMAT "%8.1" /end CHARACTERISTIC
/begin CHARACTERISTIC CrCtl_tiVSSFil2_C "" VALUE 0xCAF00 Kw_Wu32 4294.9673 TimeDelay_s 0.0000010000000 4294.9673 FORMAT "%9.4" /end CHARACTERISTIC
/begin CHARACTERISTIC CrCtl_tiVSSFil_C "time delay for tracking speed set point" VALUE 0xCAF04 Kw_Wu32 4294.9673 TimeDelay_s 0.0000010000000 4294.9673 FORMAT "%9.4" /end CHARACTERISTIC
/begin CHARACTERISTIC CrCtl_trqDesThres_C "Momentenschwelle zur Entscheidung der Momentenrampensteigung zur Momentenreduzierung nach SET+" VALUE 0xCAEB6 Kw_Ws16 500.0000 TrqPrp 0.00 500.0000 FORMAT "%8.4" EXTENDED_LIMITS -6553.600 6553.400 /end CHARACTERISTIC
/begin CHARACTERISTIC CrCtl_trqDes_Vector "Bypass label, nicht editieren!" VALUE 0xC38E6 Kw_Wu8 255.0 OneToOne 0.00 255.0 FORMAT "%5.1" /end CHARACTERISTIC
/begin CHARACTERISTIC CrCtl_trqDes_Channel "Bypass label, nicht editieren!" VALUE 0xC38E7 Kw_Wu8 255.0 OneToOne 0.00 255.0 FORMAT "%5.1" /end CHARACTERISTIC
/begin CHARACTERISTIC CrCtl_trqLead_Vector "Bypass label, nicht editieren!" VALUE 0xC38E8 Kw_Wu8 255.0 OneToOne 0.00 255.0 FORMAT "%5.1" /end CHARACTERISTIC
/begin CHARACTERISTIC CrCtl_trqLead_Channel "Bypass label, nicht editieren!" VALUE 0xC38E9 Kw_Wu8 255.0 OneToOne 0.00 255.0 FORMAT "%5.1" /end CHARACTERISTIC
/begin CHARACTERISTIC CrCtl_trqMaxOfs_C "Offset auf maximales Moment CoDT_trqMax" VALUE 0xCAEB8 Kw_Ws16 500.0000 TrqPrp 0.00 500.0000 FORMAT "%8.4" EXTENDED_LIMITS -6553.600 6553.400 /end CHARACTERISTIC
/begin CHARACTERISTIC CrCtl_trqOffComf_C "Momentenschwelle für Umschaltung der Rampensteigung bei Komfortabschaltung" VALUE 0xCAEBA Kw_Ws16 11000.00 TrqPrp -5000.000 6000.000 FORMAT "%8.3" EXTENDED_LIMITS -6553.600 6553.400 /end CHARACTERISTIC
/begin CHARACTERISTIC CrCtl_trqOffFast12_C "Umschaltschwelle von Rampe 1 auf Rampe 2" VALUE 0xCAEBC Kw_Ws16 11000.00 TrqPrp -5000.000 6000.000 FORMAT "%8.3" EXTENDED_LIMITS -6553.600 6553.400 /end CHARACTERISTIC
/begin CHARACTERISTIC CrCtl_trqOffFast23_C "Umschaltschwelle von Rampe 2 auf Rampe 3" VALUE 0xCAEBE Kw_Ws16 11000.00 TrqPrp -5000.000 6000.000 FORMAT "%8.3" EXTENDED_LIMITS -6553.600 6553.400 /end CHARACTERISTIC
/begin CHARACTERISTIC CrCtl_uBattMin_C "min batteriespannung" VALUE 0xCAF08 Kw_Ws16 1281232. Volt_Batt -640625.6 640606.1 FORMAT "%8.1" /end CHARACTERISTIC
/begin CHARACTERISTIC CrCtl_vAccSet_C "Setzwertkorrektur nach SET+" VALUE 0xCAEC0 Kw_Ws16 300.0000 Vel 0.00 300.0000 FORMAT "%8.4" EXTENDED_LIMITS -327.6800 327.6700 /end CHARACTERISTIC
/begin CHARACTERISTIC CrCtl_vAlwDvtThres_C "zulässige Regelabweichung für TIP-UP/DOWN FGR" VALUE 0xCAEC2 Kw_Ws16 300.0000 Vel 0.00 300.0000 FORMAT "%8.4" EXTENDED_LIMITS -327.6800 327.6700 /end CHARACTERISTIC
/begin CHARACTERISTIC CrCtl_vAlwMaxKm_C "maximal erlaubte FGR-geschw." VALUE 0xCAF0A Kw_Ws16 300.0000 Vel 0.00 300.0000 FORMAT "%8.4" EXTENDED_LIMITS -327.6800 327.6700 /end CHARACTERISTIC
/begin CHARACTERISTIC CrCtl_vAlwMaxMPH_C "max. erlaubte FGR-Geschwindigkeit bei mph-Kodierung" VALUE 0xCAF0C Kw_Ws16 300.0000 Vel 0.00 300.0000 FORMAT "%8.4" EXTENDED_LIMITS -327.6800 327.6700 /end CHARACTERISTIC
/begin CHARACTERISTIC CrCtl_vAlwMinKm_C "min. erlaubte FGR-geschwindigkeit" VALUE 0xCAF0E Kw_Ws16 300.0000 Vel 0.00 300.0000 FORMAT "%8.4" EXTENDED_LIMITS -327.6800 327.6700 /end CHARACTERISTIC
/begin CHARACTERISTIC CrCtl_vAlwMinMPH_C "min. erlaubte FGR-Geschwindigkeit bei mph-Kodierung" VALUE 0xCAF10 Kw_Ws16 300.0000 Vel 0.00 300.0000 FORMAT "%8.4" EXTENDED_LIMITS -327.6800 327.6700 /end CHARACTERISTIC
/begin CHARACTERISTIC CrCtl_vDeclSet_C "Setzwertkorrektur nach SET-" VALUE 0xCAEC4 Kw_Ws16 300.0000 Vel 0.00 300.0000 FORMAT "%8.4" EXTENDED_LIMITS -327.6800 327.6700 /end CHARACTERISTIC
/begin CHARACTERISTIC CrCtl_vDiffAccMax_C "Geschwindigkeitsschwelle für Setzwertkorrektur nach SET+" VALUE 0xCAEC6 Kw_Ws16 300.0000 Vel 0.00 300.0000 FORMAT "%8.4" EXTENDED_LIMITS -327.6800 327.6700 /end CHARACTERISTIC
/begin CHARACTERISTIC CrCtl_vDiffAcc_C "Geschwindigkeitsoffset für doppelte Momentenrampensteigung bei Übergang EIN+ zu HALTEN des FGR" VALUE 0xCAEC8 Kw_Ws16 300.0000 Vel 0.00 300.0000 FORMAT "%8.4" EXTENDED_LIMITS -327.6800 327.6700 /end CHARACTERISTIC
/begin CHARACTERISTIC CrCtl_vDiffActvTrqDecHi_C "Grenze für die Regelabweichung, ab der die Momentenreduzierung aktiviert wird." VALUE 0xCAECA Kw_Ws16 300.0000 Vel 0.00 300.0000 FORMAT "%8.4" EXTENDED_LIMITS -327.6800 327.6700 /end CHARACTERISTIC
/begin CHARACTERISTIC CrCtl_vDiffActvTrqDecLo_C "Grenze für die Regelabweichung, ab der die Momentenreduzierung deaktiviert wird." VALUE 0xCAECC Kw_Ws16 300.0000 Vel 0.00 300.0000 FORMAT "%8.4" EXTENDED_LIMITS -327.6800 327.6700 /end CHARACTERISTIC
/begin CHARACTERISTIC CrCtl_vDiffDeclMax_C "Geschwindigkeitsschwelle für Setzwertkorrektur nach SET-" VALUE 0xCAECE Kw_Ws16 300.0000 Vel 0.00 300.0000 FORMAT "%8.4" EXTENDED_LIMITS -327.6800 327.6700 /end CHARACTERISTIC
/begin CHARACTERISTIC CrCtl_vDiffDecl_C "Geschwindigkeitsoffset für doppelte Momentenrampensteigung bei Übergang EIN- zu HALTEN des FGR" VALUE 0xCAED0 Kw_Ws16 300.0000 Vel 0.00 300.0000 FORMAT "%8.4" EXTENDED_LIMITS -327.6800 327.6700 /end CHARACTERISTIC
/begin CHARACTERISTIC CrCtl_vDiffResAbv_C "Schwelle Differenz Ist- und Sollgeschwindigkeit für Reduzierung Zielgeschwindigkeitsrampe bei WA von oben" VALUE 0xCAED2 Kw_Ws16 300.0000 Vel 0.00 300.0000 FORMAT "%8.4" EXTENDED_LIMITS -327.6800 327.6700 /end CHARACTERISTIC
/begin CHARACTERISTIC CrCtl_vDiffResBlw_C "Schwelle Differenz Ist- und Sollgeschwindigkeit für Reduzierung Zielgeschwindigkeitsrampe bei WA von unten" VALUE 0xCAED4 Kw_Ws16 300.0000 Vel 0.00 300.0000 FORMAT "%8.4" EXTENDED_LIMITS -327.6800 327.6700 /end CHARACTERISTIC
/begin CHARACTERISTIC CrCtl_vDvtNegSwtToResAbv_C "Größte  zulässige negative Regelabweichung bevor Umschaltung in Zustand RESUME from above statt findet." VALUE 0xCAED6 Kw_Ws16 300.0000 Vel 0.00 300.0000 FORMAT "%8.4" EXTENDED_LIMITS -327.6800 327.6700 /end CHARACTERISTIC
/begin CHARACTERISTIC CrCtl_vDvtNegTipDwn_C "FGR: zulässige negative Regelabweichung TIP-DWN" VALUE 0xCAED8 Kw_Ws16 300.0000 Vel 0.00 300.0000 FORMAT "%8.4" EXTENDED_LIMITS -327.6800 327.6700 /end CHARACTERISTIC
/begin CHARACTERISTIC CrCtl_vDvtNegTipUp_C "FGR: zulässige negative Regelabweichung TIP-UP" VALUE 0xCAEDA Kw_Ws16 300.0000 Vel 0.00 300.0000 FORMAT "%8.4" EXTENDED_LIMITS -327.6800 327.6700 /end CHARACTERISTIC
/begin CHARACTERISTIC CrCtl_vDvtPosTipDwn_C "FGR: zulässige positive Regelabweichung TIP-DWN" VALUE 0xCAEDC Kw_Ws16 300.0000 Vel 0.00 300.0000 FORMAT "%8.4" EXTENDED_LIMITS -327.6800 327.6700 /end CHARACTERISTIC
/begin CHARACTERISTIC CrCtl_vHypDenom_C "Nenner-Summand des hyperbolischen Faktors zur Abschwächung des Reduktionsmomentes im Zustand HOLD." VALUE 0xCAEDE Kw_Ws16 300.0000 Vel 0.00 300.0000 FORMAT "%8.4" EXTENDED_LIMITS -327.6800 327.6700 /end CHARACTERISTIC
/begin CHARACTERISTIC CrCtl_vHypNum_C "Zähler des hyperbolischen Faktors zur Abschwächung des Reduktionsmomentes im Zustand HOLD." VALUE 0xCAEE0 Kw_Ws16 300.0000 Vel 0.00 300.0000 FORMAT "%8.4" EXTENDED_LIMITS -327.6800 327.6700 /end CHARACTERISTIC
/begin CHARACTERISTIC CrCtl_vOffMax_C "Maximum velocity of cruise control" VALUE 0xCAF12 Kw_Ws16 300.0000 Vel 0.00 300.0000 FORMAT "%8.4" EXTENDED_LIMITS -327.6800 327.6700 /end CHARACTERISTIC
/begin CHARACTERISTIC CrCtl_vOfsDecl_C "neg. Offset für Sollgeschwindigkeit für Übergang EIN- zu HALTEN des FGR" VALUE 0xCAEE2 Kw_Ws16 300.0000 Vel 0.00 300.0000 FORMAT "%8.4" EXTENDED_LIMITS -327.6800 327.6700 /end CHARACTERISTIC
/begin CHARACTERISTIC CrCtl_vOfsResBlw_C "Geschwindigkeitsoffset für Übergang WA+ --> Konstantfahrt" VALUE 0xCAEE4 Kw_Ws16 300.0000 Vel 0.00 300.0000 FORMAT "%8.4" EXTENDED_LIMITS -327.6800 327.6700 /end CHARACTERISTIC
/begin CHARACTERISTIC CrCtl_vOfsRes_C "Offset FGR-Sollgeschwindigkeit für Übergang WA zu HALTEN" VALUE 0xCAEE6 Kw_Ws16 300.0000 Vel 0.00 300.0000 FORMAT "%8.4" EXTENDED_LIMITS -327.6800 327.6700 /end CHARACTERISTIC
/begin CHARACTERISTIC CrCtl_vRlsOfsI_C "FGR, Offset-Schwellwert für Freigabe Integrator" VALUE 0xCAEE8 Kw_Ws16 300.0000 Vel 0.00 300.0000 FORMAT "%8.4" EXTENDED_LIMITS -327.6800 327.6700 /end CHARACTERISTIC
/begin CHARACTERISTIC CrCtl_vTipStep_C "FGR TIP-UP/DOWN Geschwindigkeitsschritt" VALUE 0xCAEEA Kw_Ws16 300.0000 Vel 0.00 300.0000 FORMAT "%8.4" EXTENDED_LIMITS -327.6800 327.6700 /end CHARACTERISTIC
/begin CHARACTERISTIC CrSCD_ctGapIncs_C "Kurbelwellenkonfiguration: Anzahl der fehlenden Inkremente in der Lücke (virtuelle Inkremente)" VALUE 0xC05F2 Kw_Wu8 0.00 OneToOne 2.000 2.000 FORMAT "%5.3" EXTENDED_LIMITS 0.00 255.0 /end CHARACTERISTIC
/begin CHARACTERISTIC CrSCD_ctGaps_C "Kurbelwellenkonfiguration: Anzahl der Lücken auf dem Inkrementgeberrad" VALUE 0xC05F3 Kw_Wu8 3.000 OneToOne 1.000 4.000 FORMAT "%5.3" EXTENDED_LIMITS 0.00 255.0 /end CHARACTERISTIC
/begin CHARACTERISTIC CrSCD_ctIncs_C "Kurbelwellenkonfiguration: Anzahl der Inkremente einschließlich virtueller Lückenzähne" VALUE 0xC05F4 Kw_Wu8 110.0 OneToOne 10.00 120.0 FORMAT "%5.1" EXTENDED_LIMITS 0.00 255.0 /end CHARACTERISTIC
/begin CHARACTERISTIC CrSCD_ctThresCtlMin_C "Kleinste Schwelle der dyn. Schwellennachführung des Kurbelwellensignals" VALUE 0xC05EC Kw_Wu8 7.000 OneToOne 0.00 7.000 FORMAT "%5.3" EXTENDED_LIMITS 0.00 255.0 /end CHARACTERISTIC
/begin CHARACTERISTIC CrSCD_ctTurns_C "Anzahl der Kurbelwellenumdrehungen pro Nockenwellenumdrehung (1 = 2 Takter, 2 = 4 Takter)" VALUE 0xC05DA Kw_Wu8 1.000 OneToOne 1.000 2.000 FORMAT "%5.3" EXTENDED_LIMITS 0.00 255.0 /end CHARACTERISTIC
/begin CHARACTERISTIC CrSCD_facGapPlausHigh_CUR "Verhältnis zur Bestimmung der oberen Grenze des Fensters zur Lückenplausibilisierung des Inkrementsignals" CURVE 0xCAF54 Kl_Xs16_Ws16 3.000000 Fact_Inc 3.000000 6.000000 FORMAT "%8.6" EXTENDED_LIMITS -128.0000 127.9961
 /begin AXIS_DESCR STD_AXIS CrSCD_tiIncr TimeDT 10 100.0000 32767.00 FORMAT "%8.2" EXTENDED_LIMITS 0.00 65535.00 DEPOSIT ABSOLUTE /end AXIS_DESCR
/end CHARACTERISTIC
/begin CHARACTERISTIC CrSCD_facGapPlausLow_CUR "Verhältnis zur Bestimmung der unteren Grenze des Fensters zur Lückenplausibilisierung des Inkrementsignals" CURVE 0xCAF7E Kl_Xs16_Ws16 3.000000 Fact_Inc 0.00 3.000000 FORMAT "%8.6" EXTENDED_LIMITS -128.0000 127.9961
 /begin AXIS_DESCR STD_AXIS CrSCD_tiIncr TimeDT 10 100.0000 32767.00 FORMAT "%8.2" EXTENDED_LIMITS 0.00 65535.00 DEPOSIT ABSOLUTE /end AXIS_DESCR
/end CHARACTERISTIC
/begin CHARACTERISTIC CrSCD_facIncPlausHigh_CUR "Verhältnis zur Bestimmung der obere Grenze des Fensters zur Plausibilisierung des Inkrementsignals" CURVE 0xCAFA8 Kl_Xs16_Ws16 1.000000 Fact_Inc 1.000000 2.000000 FORMAT "%8.6" EXTENDED_LIMITS -128.0000 127.9961
 /begin AXIS_DESCR STD_AXIS CrSCD_tiIncr TimeDT 10 100.0000 32767.00 FORMAT "%8.2" EXTENDED_LIMITS 0.00 65535.00 DEPOSIT ABSOLUTE /end AXIS_DESCR
/end CHARACTERISTIC
/begin CHARACTERISTIC CrSCD_facIncPlausLow_CUR "Verhältnis zur Bestimmung der unteren Grenze des Fensters zur Plausibilisierung des Inkrementsignals" CURVE 0xCAFD2 Kl_Xs16_Ws16 1.000000 Fact_Inc 0.00 1.000000 FORMAT "%8.6" EXTENDED_LIMITS -128.0000 127.9961
 /begin AXIS_DESCR STD_AXIS CrSCD_tiIncr TimeDT 10 100.0000 32767.00 FORMAT "%8.2" EXTENDED_LIMITS 0.00 65535.00 DEPOSIT ABSOLUTE /end AXIS_DESCR
/end CHARACTERISTIC
/begin CHARACTERISTIC CrSCD_nFast_C "Frequenz für das winkelsynchrone Interruptsystem, wenn kein Inkrementsignal vorhanden" VALUE 0xC05DC Kw_Ws16 8000.000 EngN 0.00 8000.000 FORMAT "%8.3" EXTENDED_LIMITS -32768.00 32767.00 /end CHARACTERISTIC
/begin CHARACTERISTIC CrSCD_nMax_C "Größte zulässige Frequenz des Inkrementsignals" VALUE 0xC05DE Kw_Ws16 2000.000 EngN 5000.000 7000.000 FORMAT "%8.3" EXTENDED_LIMITS -32768.00 32767.00 /end CHARACTERISTIC
/begin CHARACTERISTIC CrSCD_nMin_C "Kleinste zulässige Frequenz des Inkrementsignals" VALUE 0xC05E0 Kw_Ws16 480.0000 EngN 20.00000 500.0000 FORMAT "%8.4" EXTENDED_LIMITS -32768.00 32767.00 /end CHARACTERISTIC
/begin CHARACTERISTIC CrSCD_nSlowHigh_C "Obere Drehzahlschwelle ab der das Slow-Bit für die Diahnose zurückgesetzt wird" VALUE 0xC05E2 Kw_Ws16 3000.000 EngN 0.00 3000.000 FORMAT "%8.3" EXTENDED_LIMITS -32768.00 32767.00 /end CHARACTERISTIC
/begin CHARACTERISTIC CrSCD_nSlow_C "Schwelle ab der Unterdrehzahl gemeldet wird" VALUE 0xC05E4 Kw_Ws16 1000.000 EngN 0.00 1000.000 FORMAT "%8.3" EXTENDED_LIMITS -32768.00 32767.00 /end CHARACTERISTIC
/begin CHARACTERISTIC CrSCD_nThresCtlHigh_C "Obere Schwelle zur Aktiviereung der dyn. Schwellennachführung" VALUE 0xC05EE Kw_Ws16 65535.00 EngN -32768.00 32767.00 FORMAT "%8.2" /end CHARACTERISTIC
/begin CHARACTERISTIC CrSCD_nThresCtlLow_C "Untere Schwelle zur Aktivierung der dyn. Schwellennachführung" VALUE 0xC05F0 Kw_Ws16 65535.00 EngN -32768.00 32767.00 FORMAT "%8.2" /end CHARACTERISTIC
/begin CHARACTERISTIC CrSCD_numFBCSeg_C "Anzahl der FBC segmente" VALUE 0xC05F5 Kw_Wu8 7.000 OneToOne 1.000 8.000 FORMAT "%5.3" EXTENDED_LIMITS 0.00 255.0 /end CHARACTERISTIC
/begin CHARACTERISTIC CrSCD_numShftMisf_C "Phasenverschiebung Segmentsystem für Aussetzererkennung (in MAR-Segmenten)" VALUE 0xC05E6 Kw_Wu8 2.000 OneToOne 0.00 2.000 FORMAT "%5.3" EXTENDED_LIMITS 0.00 255.0 /end CHARACTERISTIC
/begin CHARACTERISTIC CrSCD_numTDCSeg_C "Anzahl der Segment pro OT" VALUE 0xC05F6 Kw_Wu8 0.00 OneToOne 2.000 2.000 FORMAT "%5.3" EXTENDED_LIMITS 0.00 255.0 READ_ONLY /end CHARACTERISTIC
/begin CHARACTERISTIC CrSCD_phiGap2Zero_C "Winkel zwischen Lücke und physikalischer Nullposition" VALUE 0xC05F8 Kw_Ws16 720.0000 AngleCrS 0.00 720.0000 FORMAT "%8.4" EXTENDED_LIMITS -768.0000 767.9766 /end CHARACTERISTIC
/begin CHARACTERISTIC CrSCD_phiIncCor_CUR "Phasenkorrekturkennlinie des Inkrementsystems der Kurbelwelle" CURVE 0xCAF22 Kl_Xs16_Ws16 50.01562 AngleCrS -25.00781 25.00781 FORMAT "%8.5" EXTENDED_LIMITS -768.0000 767.9766
 /begin AXIS_DESCR STD_AXIS CrSCD_nAvrg EngN 12 0.00 6000.000 FORMAT "%8.3" EXTENDED_LIMITS -32768.00 32767.00 DEPOSIT ABSOLUTE /end AXIS_DESCR
/end CHARACTERISTIC
/begin CHARACTERISTIC CrSCD_phiSegLength_C "Kurbelwellenkonfiguration: Segementlänge" VALUE 0xC05E8 Kw_Ws16 90.00000 AngleCrS 30.00000 120.0000 FORMAT "%8.4" EXTENDED_LIMITS -768.0000 767.9766 /end CHARACTERISTIC
/begin CHARACTERISTIC CrSCD_phiSegPhase_C "Phasenlage der Drehzahlsegmente zum OT" VALUE 0xC05EA Kw_Ws16 720.0000 AngleCrS 0.00 720.0000 FORMAT "%8.4" EXTENDED_LIMITS -768.0000 767.9766 /end CHARACTERISTIC
/begin CHARACTERISTIC CrSCD_tiPlausCalcOff_C "Schwelle zum Abschalten der Berechnung der Plausibilitätsfenster" VALUE 0xC05FA Kw_Ws16 32767.00 TimeDT 0.00 32767.00 FORMAT "%8.2" EXTENDED_LIMITS -32768.00 32767.00 /end CHARACTERISTIC
/begin CHARACTERISTIC CrS_ctMaxInjStrt_C "Maximale Anzahl von Testeinspritzungen" VALUE 0xC05CA Kw_Wu16 100.0000 OneToOne 0.00 100.0000 FORMAT "%8.4" EXTENDED_LIMITS 0.00 65535.00 /end CHARACTERISTIC
/begin CHARACTERISTIC CrS_facSegTimeMax_C "Maximales Verhältnis der Segmentzeiten, das eine konstante Motordrehzahl signalisiert" VALUE 0xC05CC Kw_Ws32 100.000000000 Fact1 0.00 100.000000000 FORMAT "%13.9" EXTENDED_LIMITS -16777216.0000 16777215.9922 /end CHARACTERISTIC
/begin CHARACTERISTIC CrS_facSegTimeMin_C "Minimales Verhältnis der Segmentzeiten, das eine konstante Motordrehzahl signalisiert" VALUE 0xC05D0 Kw_Ws32 100.000000000 Fact1 0.00 100.000000000 FORMAT "%13.9" EXTENDED_LIMITS -16777216.0000 16777215.9922 /end CHARACTERISTIC
/begin CHARACTERISTIC CrS_facSegTime_CUR "Verhältnis der Segmentzeiten (motordrehzahlabhängig)" CURVE 0xCAF14 Kl_Xs16_Ws16 99.00000 Fact1 1.000000 100.0000 FORMAT "%8.4" EXTENDED_LIMITS -256.0000 255.9922
 /begin AXIS_DESCR STD_AXIS Eng_nAvrg EngN 3 0.00 6000.000 FORMAT "%8.3" EXTENDED_LIMITS -32768.00 32767.00 DEPOSIT ABSOLUTE /end AXIS_DESCR
/end CHARACTERISTIC
/begin CHARACTERISTIC CrS_phiSegLengthStrtSpd_C "Segmentlänge, die berechnet werden soll" VALUE 0xC05D4 Kw_Ws16 180.0000 AngleCrS 0.00 180.0000 FORMAT "%8.4" EXTENDED_LIMITS -768.0000 767.9766 /end CHARACTERISTIC
/begin CHARACTERISTIC CrS_phiSegOfsStrtSpdOld_C "Segment Offset des alten Segmentes bezüglich TDC" VALUE 0xC05D6 Kw_Ws16 1440.000 AngleCrS -720.0000 720.0000 FORMAT "%8.4" EXTENDED_LIMITS -768.0000 767.9766 /end CHARACTERISTIC
/begin CHARACTERISTIC CrS_phiSegOfsStrtSpd_C "Segment Offset des aktuellen Segmentes bezüglich TDC" VALUE 0xC05D8 Kw_Ws16 1440.000 AngleCrS -720.0000 720.0000 FORMAT "%8.4" EXTENDED_LIMITS -768.0000 767.9766 /end CHARACTERISTIC
/begin CHARACTERISTIC CTSCD_uSRCMin_C "Minimalwert für SRC WTF-Sensor" VALUE 0xCAFFC Kw_Ws16 5200.391 Volt 0.00 5200.391 FORMAT "%8.3" EXTENDED_LIMITS -160156.4 160151.5 /end CHARACTERISTIC
/begin CHARACTERISTIC CTSCD_uSRCMax_C "Maximalwert für SRC WTF-Sensor" VALUE 0xCAFFE Kw_Ws16 5200.391 Volt 0.00 5200.391 FORMAT "%8.3" EXTENDED_LIMITS -160156.4 160151.5 /end CHARACTERISTIC
/begin CHARACTERISTIC CTSCD_tLin_CUR "Linearisierungskennlinie für WTF-Sensor" CURVE 0xCB000 Kl_Xs16_Ws16 950.0000 Temp_Cels -50.1400 899.8600 FORMAT "%8.4" EXTENDED_LIMITS -3549.940 3003.560
 /begin AXIS_DESCR STD_AXIS CTSCD_uRaw Volt 20 0.00 5200.391 FORMAT "%8.3" EXTENDED_LIMITS -160156.4 160151.5 DEPOSIT ABSOLUTE /end AXIS_DESCR
/end CHARACTERISTIC
/begin CHARACTERISTIC CTSCD_DebSigDef_C "Fehlerentprellung Wassertemperatur über CAN" VALUE 0xCB052 Kw_Wu16 655350.0 Time_ms 0.00 655350.0 FORMAT "%8.1" /end CHARACTERISTIC
/begin CHARACTERISTIC CTSCD_DebSigOk_C "Heilungsentprellung Wassertemperatur über CAN" VALUE 0xCB054 Kw_Wu16 655350.0 Time_ms 0.00 655350.0 FORMAT "%8.1" /end CHARACTERISTIC
/begin CHARACTERISTIC CTSCD_DebSRCHighDef_C "WTF Fehlerentprellzeit fuer SRC-High" VALUE 0xCB056 Kw_Wu16 655350.0 Time_ms 0.00 655350.0 FORMAT "%8.1" /end CHARACTERISTIC
/begin CHARACTERISTIC CTSCD_DebSRCHighOk_C "WTF Heilungsentprellzeit fuer SRC-High" VALUE 0xCB058 Kw_Wu16 655350.0 Time_ms 0.00 655350.0 FORMAT "%8.1" /end CHARACTERISTIC
/begin CHARACTERISTIC CTSCD_DebSRCLowDef_C "WTF Fehlerentprellzeit fuer SRC-Low" VALUE 0xCB05A Kw_Wu16 655350.0 Time_ms 0.00 655350.0 FORMAT "%8.1" /end CHARACTERISTIC
/begin CHARACTERISTIC CTSCD_DebSRCLowOk_C "WTF Heilungsentprellzeit fuer SRC-Low" VALUE 0xCB05C Kw_Wu16 655350.0 Time_ms 0.00 655350.0 FORMAT "%8.1" /end CHARACTERISTIC
/begin CHARACTERISTIC CTSCD_dtRmpSlp2UpDwn_C "Auf- und Abwärts Rampensteigung im Zustand 2 beim Übergang  zweier Ersatzwerte für den Wassertemperaturfühler" VALUE 0xCB060 Kw_Wu32 6553598.99749 RmpTemp 1.00097656250 6553599.99847 FORMAT "%13.5" EXTENDED_LIMITS 0.00 6553599.99847 /end CHARACTERISTIC
/begin CHARACTERISTIC CTSCD_dtFlTempUp_C "ramp slope up in C/ms" VALUE 0xCB064 Kw_Wu32 6553.59899750 RmpTempCels 0.00100097656250 6553.59999847 FORMAT "%13.8" EXTENDED_LIMITS 0.00 6553.59999847 /end CHARACTERISTIC
/begin CHARACTERISTIC CTSCD_dtFlTempDwn_C " ramp slope down in C/ms" VALUE 0xCB068 Kw_Wu32 6553.59899750 RmpTempCels 0.00100097656250 6553.59999847 FORMAT "%13.8" EXTENDED_LIMITS 0.00 6553.59999847 /end CHARACTERISTIC
/begin CHARACTERISTIC CTSCD_numAdc_C "Applikationsparameter fuer Kuehlwassertemperatur-Fuehler" VALUE 0xCB06C Kw_Wu8 60.0000000000 NumPinAdc 0.00 60.0000000000 FORMAT "%13.10" /end CHARACTERISTIC
/begin CHARACTERISTIC CTSCD_dtRmpSlp1Up_C "Aufwärts Rampensteigung  im Zustand 1 bei  Übergang Messwert  Vorgabewert für WTF" VALUE 0xCB070 Kw_Wu32 6553598.99749 RmpTemp 1.00097656250 6553599.99847 FORMAT "%13.5" EXTENDED_LIMITS 0.00 6553599.99847 /end CHARACTERISTIC
/begin CHARACTERISTIC CTSCD_dtRmpSlp1Dwn_C "Abwärtsrampensteigung im Zustand 1 beim Übergang  Messwert Vorgabewert   für WTF" VALUE 0xCB074 Kw_Wu32 6553598.99749 RmpTemp 1.00097656250 6553599.99847 FORMAT "%13.5" EXTENDED_LIMITS 0.00 6553599.99847 /end CHARACTERISTIC
/begin CHARACTERISTIC CTSCD_stSensIDWord_C "Geberkennwort WTF-Sensor" VALUE 0xCB078 Kw_Wu8 255.0 OneToOne 0.00 255.0 FORMAT "%5.1" /end CHARACTERISTIC
/begin CHARACTERISTIC CTSCD_swtPHtrIgnoreCAN_C "Schalter um Wert von CAN oder HW zu wählen (1: CAN, 0: HW)" VALUE 0xCB079 Kw_Wu8 1.000 OneToOne 0.00 1.000 FORMAT "%5.3" EXTENDED_LIMITS 0.00 255.0 /end CHARACTERISTIC
/begin CHARACTERISTIC CTSCD_swtSigVal_C "Signalquelle ADC/CAN (0: ADC, 1: CAN)" VALUE 0xCB07A Kw_Wu8 1.000 OneToOne 0.00 1.000 FORMAT "%5.3" EXTENDED_LIMITS 0.00 255.0 /end CHARACTERISTIC
/begin CHARACTERISTIC CTSCD_tClntPMin_C "Threshold Value of Coolant Temperature before Correction" VALUE 0xCB07C Kw_Ws16 250.0000 Temp_Cels -50.14000 199.8600 FORMAT "%8.4" EXTENDED_LIMITS -3549.940 3003.560 /end CHARACTERISTIC
/begin CHARACTERISTIC CTSCD_tDflCold_C "Wassertemperatur-Vorgabewert  im  Glüh und Startvorgang bei defektem WTS-Sensor" VALUE 0xCB07E Kw_Ws16 950.0000 Temp_Cels -50.1400 899.8600 FORMAT "%8.4" EXTENDED_LIMITS -3549.940 3003.560 /end CHARACTERISTIC
/begin CHARACTERISTIC CTSCD_tDflWarm_C "Wassertemperatur-Vorgabewert  nach Glüh und Startvorgang  bei defektem WTS-Sensor" VALUE 0xCB080 Kw_Ws16 950.0000 Temp_Cels -50.1400 899.8600 FORMAT "%8.4" EXTENDED_LIMITS -3549.940 3003.560 /end CHARACTERISTIC
/begin CHARACTERISTIC CTSCD_tDiffThres_C "Difference Threshold value of Fuel and Coolant Temperature" VALUE 0xCB082 Kw_Ws16 250.0000 Temp_Cels -50.14000 199.8600 FORMAT "%8.4" EXTENDED_LIMITS -3549.940 3003.560 /end CHARACTERISTIC
/begin CHARACTERISTIC CTSCD_tFuelMin_C "Threshold Value of Fuel Temperature" VALUE 0xCB084 Kw_Ws16 250.0000 Temp_Cels -50.14000 199.8600 FORMAT "%8.4" EXTENDED_LIMITS -3549.940 3003.560 /end CHARACTERISTIC
/begin CHARACTERISTIC CTSCD_tiWait_C "Time delay to set CTSCD_stPHtr 5th Bit" VALUE 0xCB086 Kw_Wu16 655350.0 Time_ms 0.00 655350.0 FORMAT "%8.1" /end CHARACTERISTIC
/begin CHARACTERISTIC CWBGSTUT "0: Programmiermodus gesperrt, 1: Programmiermodus verfügbar" VALUE 0xC05C2 KwWU8 255.0 dez 0.00 255.0 FORMAT "%5.1" /end CHARACTERISTIC
/begin CHARACTERISTIC CycSigCheck_nLimit_C "Drehzahllimit für Berechnung des zyklische Signaturchecks" VALUE 0xCB088 Kw_Wu16 6000.000 EngN 0.00 6000.000 FORMAT "%8.3" EXTENDED_LIMITS 0.00 65535.00 /end CHARACTERISTIC
/begin CHARACTERISTIC CycSigCheck_swtMode_C "Cycsig Berechnung startet mit: 0 Prgramm; 1 Daten" VALUE 0xCB08A Kw_Wu8 1.000 OneToOne 0.00 1.000 FORMAT "%5.3" EXTENDED_LIMITS 0.00 255.0 /end CHARACTERISTIC
/begin CHARACTERISTIC CycSigCheck_swtOff_C "Abschalten der Erkennung von fehlerhaften Signaturen in Applikations SG" VALUE 0xCB08B Kw_Wu8 1.000 OneToOne 0.00 1.000 FORMAT "%5.3" EXTENDED_LIMITS 0.00 255.0 /end CHARACTERISTIC
/begin CHARACTERISTIC DrvTrn_drTransDTUp_C "Positive slope for torque changes" VALUE 0xCB08C Kw_Wu32 655359.999847 RmpTransR 0.00 655359.999847 FORMAT "%13.6" /end CHARACTERISTIC
/begin CHARACTERISTIC DrvTrn_drTransDTDwn_C "negative slope for torque changes" VALUE 0xCB090 Kw_Wu32 655359.999847 RmpTransR 0.00 655359.999847 FORMAT "%13.6" /end CHARACTERISTIC
/begin CHARACTERISTIC DrvTrn_rFlatTransDT_C "Ausgangswert des flachen Getriebeverhältnisses des drivetrain" VALUE 0xCB094 Kw_Ws16 100.0000 TransR 0.00 100.0000 FORMAT "%8.4" EXTENDED_LIMITS -327.6800 327.6700 /end CHARACTERISTIC
/begin CHARACTERISTIC DrvTrn_rTransDTInit_C "Triebstrangübersetzungs-Vorgabewert (Radmoment pro Motormoment)" VALUE 0xCB096 Kw_Ws16 100.0000 TransR 0.00 100.0000 FORMAT "%8.4" EXTENDED_LIMITS -327.6800 327.6700 /end CHARACTERISTIC
/begin CHARACTERISTIC DrvTrn_swtrTransSel_C "Schalter zur aktivierung des Übersetzungsverhältniss-Momentanwertes (1: verzögert, 0: direkter Wert)" VALUE 0xCB098 Kw_Wu8 1.000 OneToOne 0.00 1.000 FORMAT "%5.3" EXTENDED_LIMITS 0.00 255.0 /end CHARACTERISTIC
/begin CHARACTERISTIC DrvTrn_tiRTransDT_C "Zeitintervall für das Einfrieren des aktuellen Triebstrangübersetzungswert" VALUE 0xCB09A Kw_Ws16 655140.0 Time_ms 0.00 655140.0 FORMAT "%8.1" EXTENDED_LIMITS -327680.0 327670.0 /end CHARACTERISTIC
/begin CHARACTERISTIC DSCHED_numSelFID_C "FID auswählbar zur Anzeige der defekten und nicht defekten DFPs welche den ausgewählten FID verriegeln" VALUE 0xCB09C Kw_Wu16 61811.0000000 FidName 0.00 61811.0000000 FORMAT "%13.7" /end CHARACTERISTIC
/begin CHARACTERISTIC DVMARK "Mindestabstand von Geschwindigkeits-Marken beim Stufentempomat" VALUE 0xC05B0 KwWU16 655.3500 Vel 0.00 655.3500 FORMAT "%8.4" /end CHARACTERISTIC
/begin CHARACTERISTIC DVMARKMI "dvmark_w für mph-Tachometer" VALUE 0xC05B2 KwWU16 655.3500 Vel 0.00 655.3500 FORMAT "%8.4" /end CHARACTERISTIC
/begin CHARACTERISTIC DVPRG "Schrittweite bei Anzeige der Regelgeschwindigkeit im Programmiermodus" VALUE 0xC05B4 KwWU16 655.3500 Vel 0.00 655.3500 FORMAT "%8.4" /end CHARACTERISTIC
/begin CHARACTERISTIC DVPRGMI "dvprg_w für mph-Tachometer" VALUE 0xC05B6 KwWU16 655.3500 Vel 0.00 655.3500 FORMAT "%8.4" /end CHARACTERISTIC
/begin CHARACTERISTIC DVSTUTOM "Schrittweite f ür Verstellung der Zielgeschwindigkeit ohne programmierte Marken" VALUE 0xC05B8 KwWU16 655.3500 Vel 0.00 655.3500 FORMAT "%8.4" /end CHARACTERISTIC
/begin CHARACTERISTIC DVSTUTOMMI "dvstutom_w für mph - tacho" VALUE 0xC05BA KwWU16 655.3500 Vel 0.00 655.3500 FORMAT "%8.4" /end CHARACTERISTIC
/begin CHARACTERISTIC TFGRTP "Zeit für Tip-Erkennung bei FGR-Bedientasten" VALUE 0xC05C3 KwWU8 5.100 t20msxs_ub_b5p1 0.00 5.100 FORMAT "%5.3" /end CHARACTERISTIC
/begin CHARACTERISTIC TMARK "Verzögerungszeit f ür Ein- und Ausblenden der Marken mit Tipschalter Aus" VALUE 0xC05C4 KwWU8 5.100 t20msxs_ub_b5p1 0.00 5.100 FORMAT "%5.3" /end CHARACTERISTIC
/begin CHARACTERISTIC TMRKBLI "Zeit für Ein- und Ausschaltung beim Blinken der Markenanzeige" VALUE 0xC05C5 KwWU8 5.100 t20msxs_ub_b5p1 0.00 5.100 FORMAT "%5.3" /end CHARACTERISTIC
/begin CHARACTERISTIC TSELO "Verzögerungszeit für das Setzen und Löschen von Marken" VALUE 0xC05C6 KwWU8 5.100 t20msxs_ub_b5p1 0.00 5.100 FORMAT "%5.3" /end CHARACTERISTIC
/begin CHARACTERISTIC TVSTUTK "Verzögerungszeit kurz für Verstellung bei gehaltener Taste" VALUE 0xC05C7 KwWU8 5.100 t20msxs_ub_b5p1 0.00 5.100 FORMAT "%5.3" /end CHARACTERISTIC
/begin CHARACTERISTIC TVSTUTL "Verzögerungszeit lang für Verstellung bei gehaltener Taste" VALUE 0xC05C8 KwWU8 5.100 t20msxs_ub_b5p1 0.00 5.100 FORMAT "%5.3" /end CHARACTERISTIC
/begin CHARACTERISTIC VFGRPRG "Geschindigkeitsschwelle zum Abschalten des FGR Programmiermodus" VALUE 0xC05BC KwWU16 655.3500 Vel 0.00 655.3500 FORMAT "%8.4" /end CHARACTERISTIC
/begin CHARACTERISTIC VVEMOFS "Offset zur eingefrorenen vIst bei verzögern, ab der die v-Marke wieder zum Schleppzeiger wird" VALUE 0xC05BE KwWU16 655.3500 Vel 0.00 655.3500 FORMAT "%8.4" /end CHARACTERISTIC
/begin MEASUREMENT anzmark "Anzahl Geschwindigkeits-Marken Stufentempomat" UBYTE dez 1 100 0.00 255.0 FORMAT "%5.1" ECU_ADDRESS 0x7F8A37 /end MEASUREMENT
/begin MEASUREMENT BGSTUTlokbits0 "keine Funktion" UWORD dez 1 100 0.00 65535.00 FORMAT "%8.2" ECU_ADDRESS 0x7F8B3C /end MEASUREMENT
/begin MEASUREMENT B_acc "Bedingung ACC-Steuergerät vorhanden" UBYTE B_TRUE 1 100 0.00 1.00000000000 BIT_MASK 0x1 FORMAT "%13.11" ECU_ADDRESS 0x7F87E1 /end MEASUREMENT
/begin MEASUREMENT B_besch "Bedingung FGR im Zustand Beschleunigen" UBYTE B_TRUE 1 100 0.00 1.00000000000 BIT_MASK 0x1 FORMAT "%13.11" ECU_ADDRESS 0x7F87E3 /end MEASUREMENT
/begin MEASUREMENT B_beveh "Bedingung Halten der Beschleunigen- oder Verzögerungs-Taste" UBYTE B_TRUE 1 100 0.00 1.00000000000 FORMAT "%13.11" ECU_ADDRESS 0x7F87E4 /end MEASUREMENT
/begin MEASUREMENT B_bv1 "Bedingung Bediensignal Stufentempomat Beschleunigen oder Verzögern 1. Stufe" UBYTE B_TRUE 1 100 0.00 1.00000000000 FORMAT "%13.11" ECU_ADDRESS 0x7F87E5 /end MEASUREMENT
/begin MEASUREMENT B_bv2 "Bedingung Bediensignal Stufentempomat Beschleunigen oder Verzögern 2. Stufe" UBYTE B_TRUE 1 100 0.00 1.00000000000 FORMAT "%13.11" ECU_ADDRESS 0x7F87E6 /end MEASUREMENT
/begin MEASUREMENT B_envtwa "Bedingung FGR aktiv vor Betätigung der Wiederaufnahme-Taste" UBYTE B_TRUE 1 100 0.00 1.00000000000 FORMAT "%13.11" ECU_ADDRESS 0x7F87E8 /end MEASUREMENT
/begin MEASUREMENT B_fgrat "Bedingung: Tip-Schalter Aus am FGR-Bedienteil betätigt" UBYTE B_TRUE 1 100 0.00 1.00000000000 BIT_MASK 0x1 FORMAT "%13.11" ECU_ADDRESS 0x7F87EA /end MEASUREMENT
/begin MEASUREMENT B_fgren "Bedingung Fahrgeschwindigkeitsregelung aktiv (Enable)" UBYTE B_TRUE 1 100 0.00 1.00000000000 BIT_MASK 0x1 FORMAT "%13.11" ECU_ADDRESS 0x7F87EB /end MEASUREMENT
/begin MEASUREMENT B_fgrepa "Status in Cruise control" UBYTE B_TRUE 1 100 0.00 1.00000000000 FORMAT "%13.11" ECU_ADDRESS 0x7F87EC /end MEASUREMENT
/begin MEASUREMENT B_fgresv "Layer" UBYTE B_TRUE 1 100 0.00 1.00000000000 BIT_MASK 0x1 FORMAT "%13.11" ECU_ADDRESS 0x7F87ED /end MEASUREMENT
/begin MEASUREMENT B_fgrtb2 "Bedingung FGR-Taste Auswahl der nächsthöheren Zielgeschwindigkeit" UBYTE B_TRUE 1 100 0.00 1.00000000000 BIT_MASK 0x1 FORMAT "%13.11" ECU_ADDRESS 0x7F87EE /end MEASUREMENT
/begin MEASUREMENT B_fgrtbe "Bedingung FGR-Taste Beschleunigen" UBYTE B_TRUE 1 100 0.00 1.00000000000 BIT_MASK 0x1 FORMAT "%13.11" ECU_ADDRESS 0x7F87EF /end MEASUREMENT
/begin MEASUREMENT B_fgrtv2 "Bedingung FGR-Taste Auswahl der nächstniederen Zielgeschwindigkeit" UBYTE B_TRUE 1 100 0.00 1.00000000000 BIT_MASK 0x1 FORMAT "%13.11" ECU_ADDRESS 0x7F87F0 /end MEASUREMENT
/begin MEASUREMENT B_fgrtve "Bedingung FGR-Taste Verzöägern" UBYTE B_TRUE 1 100 0.00 1.00000000000 BIT_MASK 0x1 FORMAT "%13.11" ECU_ADDRESS 0x7F87F1 /end MEASUREMENT
/begin MEASUREMENT B_fgrtwa "Bedingung FGR-Taste Wiederaufnahme" UBYTE B_TRUE 1 100 0.00 1.00000000000 BIT_MASK 0x1 FORMAT "%13.11" ECU_ADDRESS 0x7F87F2 /end MEASUREMENT
/begin MEASUREMENT B_fgrvem "Bedingung: FGR im Zustand Verzögern (aus ME)" UBYTE B_TRUE 1 100 0.00 1.00000000000 BIT_MASK 0x1 FORMAT "%13.11" ECU_ADDRESS 0x7F87F3 /end MEASUREMENT
/begin MEASUREMENT B_insfgre "Bedingung Fehler im INST-Kombi, FGR muss abgeschaltet werden" UBYTE B_TRUE 1 100 0.00 1.00000000000 BIT_MASK 0x1 FORMAT "%13.11" ECU_ADDRESS 0x7F87F4 /end MEASUREMENT
/begin MEASUREMENT B_kl15 "Bedingung Klemme 15" UBYTE B_TRUE 1 100 0.00 1.00000000000 BIT_MASK 0x1 FORMAT "%13.11" ECU_ADDRESS 0x7F87F5 /end MEASUREMENT
/begin MEASUREMENT B_km "Bedingung CAN-Kombi-Kodierung in km/h" UBYTE B_TRUE 1 100 0.00 1.00000000000 BIT_MASK 0x1 FORMAT "%13.11" ECU_ADDRESS 0x7F87F6 /end MEASUREMENT
/begin MEASUREMENT B_mmiena "Status bit" UBYTE B_TRUE 1 100 0.00 1.00000000000 BIT_MASK 0x1 FORMAT "%13.11" ECU_ADDRESS 0x7F87F7 /end MEASUREMENT
/begin MEASUREMENT B_mrkbli "Bedingung Blinken der Markenanzeige" UBYTE B_TRUE 1 100 0.00 1.00000000000 FORMAT "%13.11" ECU_ADDRESS 0x7F87F8 /end MEASUREMENT
/begin MEASUREMENT B_mrkein "Bedingung Anzeige Geschwindigkeits-Marken im Kombi ein" UBYTE B_TRUE 1 100 0.00 1.00000000000 BIT_MASK 0x1 FORMAT "%13.11" ECU_ADDRESS 0x7F87F9 /end MEASUREMENT
/begin MEASUREMENT B_mrkv "Bedingung Veränderung der Geschwindigkeits-Marken Stufentempomat" UBYTE B_TRUE 1 100 0.00 1.00000000000 BIT_MASK 0x1 FORMAT "%13.11" ECU_ADDRESS 0x7F87FA /end MEASUREMENT
/begin MEASUREMENT B_prgmod "Bedingung Programmiermodus Stufentempomat" UBYTE B_TRUE 1 100 0.00 1.00000000000 FORMAT "%13.11" ECU_ADDRESS 0x7F87FC /end MEASUREMENT
/begin MEASUREMENT B_tmark "Bedingung Taste Aus für die Zeit TMARK betätigt" UBYTE B_TRUE 1 100 0.00 1.00000000000 FORMAT "%13.11" ECU_ADDRESS 0x7F87FD /end MEASUREMENT
/begin MEASUREMENT B_tmrkbli "Bedingung"" Blinken der Markenanzeige""" UBYTE B_TRUE 1 100 0.00 1.00000000000 FORMAT "%13.11" ECU_ADDRESS 0x7F87FE /end MEASUREMENT
/begin MEASUREMENT B_vziels "Bedingung Übernahme berechnete Zielgeschwindigkeit" UBYTE B_TRUE 1 100 0.00 1.00000000000 BIT_MASK 0x1 FORMAT "%13.11" ECU_ADDRESS 0x7F87FF /end MEASUREMENT
/begin MEASUREMENT canzbl "Zähler für Aus-/Ein-Schaltungen beim Blinken der Markenanzeige" UBYTE dez 1 100 0.00 255.0 FORMAT "%5.1" ECU_ADDRESS 0x7F8A38 /end MEASUREMENT
/begin MEASUREMENT CrCtl_BGSTUTbits2_mp "Instrumente für bgcmsggts_20ms" UWORD OneToOne 1 100 0.00 65535.00 FORMAT "%8.2" ECU_ADDRESS 0x8FD652 /end MEASUREMENT
/begin MEASUREMENT CrCtl_dvAcc_mp "Rampensteigung bei Beschleunigung SET+" SWORD dVel_20ms 1 100 -16384.00 16383.50 FORMAT "%8.2" ECU_ADDRESS 0x8FD638 /end MEASUREMENT
/begin MEASUREMENT CrCtl_dvDecl_mp "Rampensteigung bei Verzögerung SET-" SWORD dVel_20ms 1 100 -16384.00 16383.50 FORMAT "%8.2" ECU_ADDRESS 0x8FD63A /end MEASUREMENT
/begin MEASUREMENT CrCtl_dvResAbv_mp "Rampensteigung bei WA-" SWORD dVel_20ms 1 100 -16384.00 16383.50 FORMAT "%8.2" ECU_ADDRESS 0x8FD63C /end MEASUREMENT
/begin MEASUREMENT CrCtl_dvResBlw_mp "Rampensteigung WA+" SWORD dVel_20ms 1 100 -16384.00 16383.50 FORMAT "%8.2" ECU_ADDRESS 0x8FD63E /end MEASUREMENT
/begin MEASUREMENT CrCtl_facHyp_mp "Wert des hyperbolischen Faktors zur Reduktionsmomenten-Abschwächung im Zustand HOLD." SWORD Fact 1 100 -4.000000 3.999878 FORMAT "%8.6" ECU_ADDRESS 0x8FD640 /end MEASUREMENT
/begin MEASUREMENT CrCtl_mrkeinvp_mp "Instrumente für bgcmsggts_20ms" UBYTE OneToOne 1 100 0.00 255.0 FORMAT "%5.1" ECU_ADDRESS 0x8FD654 /end MEASUREMENT
/begin MEASUREMENT CrCtl_numVMrk "1 Index für vmrki..." UBYTE OneToOne 1 100 0.00 255.0 FORMAT "%5.1" ECU_ADDRESS 0x7F884B /end MEASUREMENT
/begin MEASUREMENT CrCtl_rVnBeg "Verhältnis Geschwindigkeit zu Drehzahl bei Aktivierung FGR" SWORD VelToN 1 100 0.00 0.3276700 FORMAT "%9.7" ECU_ADDRESS 0x7F8C38 /end MEASUREMENT
/begin MEASUREMENT CrCtl_st "Status FGR" UBYTE OneToOne 1 100 0.00 255.0 FORMAT "%5.1" ECU_ADDRESS 0x7F884C /end MEASUREMENT
/begin MEASUREMENT CrCtl_stCAN "Status der CrCtl für CAN" UBYTE OneToOne 1 100 0.00 255.0 FORMAT "%5.1" ECU_ADDRESS 0x7F884E /end MEASUREMENT
/begin MEASUREMENT CrCtl_stCC "Status FGR" UBYTE OneToOne 1 100 0.00 255.0 FORMAT "%5.1" ECU_ADDRESS 0x7F884F /end MEASUREMENT
/begin MEASUREMENT CrCtl_stFrzIGovGbx_mp "Integratorzustand (eingefroren oder nicht) infolge eines Getriebeeingriffes im Zustand HOLD." UBYTE OneToOne 1 100 0.00 255.0 FORMAT "%5.1" ECU_ADDRESS 0x8FD642 /end MEASUREMENT
/begin MEASUREMENT CrCtl_stHysTrqDec_mp "Aktueller Zustand der Momentenreduktionskomponente im Zustand HOLD." UBYTE OneToOne 1 100 0.00 255.0 FORMAT "%5.1" ECU_ADDRESS 0x8FD643 /end MEASUREMENT
/begin MEASUREMENT CrCtl_stLampOut "Status der CrCtl-Lampe (wird über CAN versendet)" UBYTE OneToOne 1 100 0.00 255.0 FORMAT "%5.1" ECU_ADDRESS 0x7F8850 /end MEASUREMENT
/begin MEASUREMENT CrCtl_stUpdateVMrk "Trigger zum senden der Botschaft" UBYTE OneToOne 1 100 0.00 255.0 FORMAT "%5.1" ECU_ADDRESS 0x7F8852 /end MEASUREMENT
/begin MEASUREMENT CrCtl_stVCrCtl "Diagnosefreigabestatus für Anzeigegeschwindigkeit" UBYTE OneToOne 1 100 0.00 255.0 FORMAT "%5.1" ECU_ADDRESS 0x7F8853 /end MEASUREMENT
/begin MEASUREMENT CrCtl_stVDisp "Marke aus/ein" UBYTE OneToOne 1 100 0.00 255.0 FORMAT "%5.1" ECU_ADDRESS 0x7F8854 /end MEASUREMENT
/begin MEASUREMENT CrCtl_stVSetNew "neue Sollgeschwindigkeit aus Stufentempomat übernehmen" UBYTE OneToOne 1 100 0.00 255.0 FORMAT "%5.1" ECU_ADDRESS 0x7F8855 /end MEASUREMENT
/begin MEASUREMENT CrCtl_trqDec_mp "Wert des reduzierenden Momentes im Zustand HOLD." SWORD TrqPrp 1 100 -6553.600 6553.400 FORMAT "%8.3" ECU_ADDRESS 0x8FD644 /end MEASUREMENT
/begin MEASUREMENT CrCtl_trqDT1_mp "DT1 Ausgang FGR" SWORD TrqPrp 1 100 -6553.600 6553.400 FORMAT "%8.3" ECU_ADDRESS 0x8FD646 /end MEASUREMENT
/begin MEASUREMENT CrCtl_trqI_mp "I-Anteil FGR" SWORD TrqPrp 1 100 -6553.600 6553.400 FORMAT "%8.3" ECU_ADDRESS 0x8FD648 /end MEASUREMENT
/begin MEASUREMENT CrCtl_trqMax_mp "Maximales Moment FGR" SWORD TrqPrp 1 100 -6553.600 6553.400 FORMAT "%8.3" ECU_ADDRESS 0x8FD64A /end MEASUREMENT
/begin MEASUREMENT CrCtl_trqP_mp "P-Anteil der Fahrgeschwindigkeits PI-Regelung" SWORD TrqPrp 1 100 -6553.600 6553.400 FORMAT "%8.3" ECU_ADDRESS 0x8FD64C /end MEASUREMENT
/begin MEASUREMENT CrCtl_vAlwMax "Obere Grenze für FGR-Sollgeschwindigkeit" SWORD Vel 1 100 0.00 300.0000 FORMAT "%8.4" ECU_ADDRESS 0x7F8C3E /end MEASUREMENT
/begin MEASUREMENT CrCtl_vAlwMin "min. mögliche Setzgeschwindigkeit" SWORD Vel 1 100 0.00 300.0000 FORMAT "%8.4" ECU_ADDRESS 0x7F8C40 /end MEASUREMENT
/begin MEASUREMENT CrCtl_vBeg "FGR: Fahrgeschwindigkeit am Anfang von EIN+, EIN- und WA" SWORD Vel 1 100 0.00 300.0000 FORMAT "%8.4" ECU_ADDRESS 0x7F8C42 /end MEASUREMENT
/begin MEASUREMENT CrCtl_vCurr "Fahrzeuggeschwindigkeit für FGR" SWORD Vel 1 100 0.00 300.0000 FORMAT "%8.4" ECU_ADDRESS 0x7F8C44 /end MEASUREMENT
/begin MEASUREMENT CrCtl_vDes "Sollgeschwindigkeit FGR" SWORD Vel 1 100 0.00 300.0000 FORMAT "%8.4" ECU_ADDRESS 0x7F8C46 /end MEASUREMENT
/begin MEASUREMENT CrCtl_vDesDisp "aktuelle Zielgeschwindigkeit STUT" SWORD Vel 1 100 0.00 300.0000 FORMAT "%8.4" ECU_ADDRESS 0x7F8C48 /end MEASUREMENT
/begin MEASUREMENT CrCtl_vDiffRed_mp "Geschwindigkeitsdifferenz für Abflachungskennlinie" SWORD Vel 1 100 -327.6800 327.6700 FORMAT "%8.4" ECU_ADDRESS 0x8FD64E /end MEASUREMENT
/begin MEASUREMENT CrCtl_vDiff_mp "FGR: | CrCtl_vDes - CrCtl_vBeg |, Differenz V_SOLL und v bei Anfang EIN+, EIN- und WA" SWORD Vel 1 100 -327.6800 327.6700 FORMAT "%8.4" ECU_ADDRESS 0x8FD650 /end MEASUREMENT
/begin MEASUREMENT CrCtl_vDispOffset "Abweichung Anzeigegeschwindigkeit - gef. Messgeschwindigkeit" SWORD Vel 1 100 0.00 300.0000 FORMAT "%8.4" ECU_ADDRESS 0x7F8C4A /end MEASUREMENT
/begin MEASUREMENT CrCtl_vMrk1 "v-Marke 1 für Botschaft" SWORD Vel 1 100 0.00 300.0000 FORMAT "%8.4" ECU_ADDRESS 0x7F8C4C /end MEASUREMENT
/begin MEASUREMENT CrCtl_vMrk2 "v-Marke für 2 Botschaft" SWORD Vel 1 100 0.00 300.0000 FORMAT "%8.4" ECU_ADDRESS 0x7F8C4E /end MEASUREMENT
/begin MEASUREMENT CrCtl_vMrk3 "v-Marke 3 für Botschaft" SWORD Vel 1 100 0.00 300.0000 FORMAT "%8.4" ECU_ADDRESS 0x7F8C50 /end MEASUREMENT
/begin MEASUREMENT CrCtl_vRmp "Rampenzielgeschwindigkeit FGR" SWORD Vel 1 100 0.00 300.0000 FORMAT "%8.4" ECU_ADDRESS 0x7F8C52 /end MEASUREMENT
/begin MEASUREMENT CrCtl_vSetNew "neue Sollgeschwindigkeit aus Stufentempomat" SWORD Vel 1 100 0.00 300.0000 FORMAT "%8.4" ECU_ADDRESS 0x7F8C54 /end MEASUREMENT
/begin MEASUREMENT CrSCD_dSegMisf "Verschiebung Segmentsystem für Aussetzererkennung" SBYTE OneToOne 1 100 -128.0 127.0 FORMAT "%5.1" ECU_ADDRESS 0x7F8856 /end MEASUREMENT
/begin MEASUREMENT CrSCD_incNextIntDelta_mp "Anzahl der Inkrements bis zum nächsten statischen  Interrupt" SWORD OneToOne 1 100 -32768.00 32767.00 FORMAT "%8.2" ECU_ADDRESS 0x8FD66C /end MEASUREMENT
/begin MEASUREMENT CrSCD_incNextInt_mp "Anzahl der Inkrements bis zum nächsten statischen  Interrupt" SBYTE OneToOne 1 100 -128.0 127.0 FORMAT "%5.1" ECU_ADDRESS 0x8FD66E /end MEASUREMENT
/begin MEASUREMENT CrSCD_nAvrg "gemittelte Kurbelwellendrehzahl des letzten und vorletzten segmentes" SWORD EngN 1 100 -32768.00 32767.00 FORMAT "%8.2" ECU_ADDRESS 0x7F8C56 /end MEASUREMENT
/begin MEASUREMENT CrSCD_nAvrgHiRes "Gemittelte hochauflösende Drehzahl" SLONG EngN_HiRes 1 100 -268435456.000 268435455.875 FORMAT "%13.3" ECU_ADDRESS 0x7F9380 /end MEASUREMENT
/begin MEASUREMENT CrSCD_nCurr "aktuelle Motordrehzahl aus der letzten Segmentperiode" SWORD EngN 1 100 -32768.00 32767.00 FORMAT "%8.2" ECU_ADDRESS 0x7F8C58 /end MEASUREMENT
/begin MEASUREMENT CrSCD_nCurrHiRes "Aktuelle hochauflösende Drehzahl" SLONG EngN_HiRes 1 100 -268435456.000 268435455.875 FORMAT "%13.3" ECU_ADDRESS 0x7F9384 /end MEASUREMENT
/begin MEASUREMENT CrSCD_nDyn "aktuelle Motordrehzahl mit Filter für Segment der Dekompressionsphase" SWORD EngN 1 100 -32768.00 32767.00 FORMAT "%8.2" ECU_ADDRESS 0x7F8C5A /end MEASUREMENT
/begin MEASUREMENT CrSCD_nHold "aktuelle Motordrehzahl des vorletzten Segmentes" SWORD EngN 1 100 -32768.00 32767.00 FORMAT "%8.2" ECU_ADDRESS 0x7F8C5C /end MEASUREMENT
/begin MEASUREMENT CrSCD_nIncr "Motordrehzahl aus Inkrementperiode" SWORD EngN 1 100 -32768.00 32767.00 FORMAT "%8.2" ECU_ADDRESS 0x7F8C5E /end MEASUREMENT
/begin MEASUREMENT CrSCD_nMisf "Drehzahlsignal für ODB-Zündaussetzererkennung" SWORD EngN 1 100 -32768.00 32767.00 FORMAT "%8.2" ECU_ADDRESS 0x7F8C60 /end MEASUREMENT
/begin MEASUREMENT CrSCD_numSeg "aktuelle Segmentnummer  (Segment 0 ist bei OT 1)" UBYTE OneToOne 1 100 0.00 255.0 FORMAT "%5.1" ECU_ADDRESS 0x7F8857 /end MEASUREMENT
/begin MEASUREMENT CrSCD_phiCurr_mp "Aktueller Winkel basierent auf dem Inkrementsystem" SWORD AngleCrS 1 100 -768.0000 767.9766 FORMAT "%8.4" ECU_ADDRESS 0x8FD670 /end MEASUREMENT
/begin MEASUREMENT CrSCD_phiIncCor "aktuelle Phasenkorrektur des Inkrementsystems der Kurbelwelle" SWORD AngleCrS 1 100 -768.0000 767.9766 FORMAT "%8.4" ECU_ADDRESS 0x7F8C62 /end MEASUREMENT
/begin MEASUREMENT CrSCD_phiIncr "Winkel eines Inkrements in Grad Kurbelwelle" SWORD AngleCrS 1 100 -768.0000 767.9766 FORMAT "%8.4" ECU_ADDRESS 0x7F8C64 /end MEASUREMENT
/begin MEASUREMENT CrSCD_phiSegGrid_mp "Berechnete Drehzahlsegmentlänge" SWORD AngleCrS 1 100 -768.0000 767.9766 FORMAT "%8.4" ECU_ADDRESS 0x8FD672 /end MEASUREMENT
/begin MEASUREMENT CrSCD_stIncErr_mp "Fehlerstatus des Inkrementgebersignals (Signalstöhrungen, Frequenzstatus, Inkrementpufferstatus)" UBYTE OneToOne 1 100 0.00 255.0 FORMAT "%5.1" ECU_ADDRESS 0x8FD674 /end MEASUREMENT
/begin MEASUREMENT CrSCD_stIncSig_mp "Status des Inkrementgeber Signalauswertung (Plausibilisierung der Zahnflankenzeiten und -anzahl)" UBYTE OneToOne 1 100 0.00 255.0 FORMAT "%5.1" ECU_ADDRESS 0x8FD675 /end MEASUREMENT
/begin MEASUREMENT CrSCD_stIncSyncInc_mp "Synchronisationsstatus des Inkrementgebersignals nach Aufruf von CrSCD_UpdPos (Intern, Debugging)" UBYTE OneToOne 1 100 0.00 255.0 FORMAT "%5.1" ECU_ADDRESS 0x8FD676 /end MEASUREMENT
/begin MEASUREMENT CrSCD_stIncSyncPhase_mp "Synchronisationsstatus des Inkrementgebersignals nach Aufruf von CaSCD_GetPos (Intern, Debugging)" UBYTE OneToOne 1 100 0.00 255.0 FORMAT "%5.1" ECU_ADDRESS 0x8FD677 /end MEASUREMENT
/begin MEASUREMENT CrSCD_tiIncr "aktuelle Inkrementperiode (1 Inkrement = Winkelbereich aus 360°KW/CrSCD_ctIncs_C, Abtastung = 2ms)" UWORD TimeDT 1 100 0.00 65535.00 FORMAT "%8.2" ECU_ADDRESS 0x7F8C66 /end MEASUREMENT
/begin MEASUREMENT CrSCD_tiSeg "aktuelle Segmentperiode (1 Segment = Winkelbereich der über CrSCD_phiSeg_C appliziert ist, Abtastung = n-sync.)" ULONG Per_Dur 1 100 0.00 4294967295.00 FORMAT "%13.2" ECU_ADDRESS 0x7F9388 /end MEASUREMENT
/begin MEASUREMENT CrS_ctInjStrt_mp "Anzahl der durchgeführten Testeinspritzungen" UWORD OneToOne 1 100 0.00 65535.00 FORMAT "%8.2" ECU_ADDRESS 0x8FD656 /end MEASUREMENT
/begin MEASUREMENT CrS_facSegTime_mp "Verhältnis der Segmentzeiten" SLONG Fact1 1 100 -16777216.0000 16777215.9922 FORMAT "%13.4" ECU_ADDRESS 0x8FD658 /end MEASUREMENT
/begin MEASUREMENT CrS_numTDCStrtLst_mp "Zeigt den Zylinder an, in den als letztes eingespritzt wurde" UWORD OneToOne 1 100 0.00 65535.00 FORMAT "%8.2" ECU_ADDRESS 0x8FD65C /end MEASUREMENT
/begin MEASUREMENT CrS_numTDCStrt_mp "Zeigt die Zylinder an, in die bereits eingespritzt wurde" UWORD OneToOne 1 100 0.00 65535.00 FORMAT "%8.2" ECU_ADDRESS 0x8FD65E /end MEASUREMENT
/begin MEASUREMENT CrS_stStrt_mp "Messpunkt für Zustandsautomat" UBYTE OneToOne 1 100 0.00 255.0 FORMAT "%5.1" ECU_ADDRESS 0x8FD660 /end MEASUREMENT
/begin MEASUREMENT CrS_tiSegOld_mp "Segmentzeit vor einer Testeinspritzung" SLONG Per_Dur 1 100 -2147483648.00 2147483647.00 FORMAT "%13.2" ECU_ADDRESS 0x8FD664 /end MEASUREMENT
/begin MEASUREMENT CrS_tiSeg_mp "Segmentzeit nach einer Testeinspritzung" SLONG Per_Dur 1 100 -2147483648.00 2147483647.00 FORMAT "%13.2" ECU_ADDRESS 0x8FD668 /end MEASUREMENT
/begin MEASUREMENT ctblink "Zeitzähler für Blinken der Markenanzeige" UBYTE t20msxs_ub_b5p1 1 100 0.00 5.100 FORMAT "%5.3" ECU_ADDRESS 0x7F8A39 /end MEASUREMENT
/begin MEASUREMENT CTSCD_dtClnt "Wechselrate der Kuehlwassertemperatur" SWORD TempCels_100ms 1 100 -32768.00 32767.00 FORMAT "%8.2" ECU_ADDRESS 0x7F8B68 /end MEASUREMENT
/begin MEASUREMENT CTSCD_stErrIni "Fehlerstatus ADC Kanal Kühlwassertemperatur während SG-Hochlauf" UBYTE OneToOne 1 100 0.00 255.0 FORMAT "%5.1" ECU_ADDRESS 0x7F8809 /end MEASUREMENT
/begin MEASUREMENT CTSCD_stPHtr "Heater Temperature status" UBYTE OneToOne 1 100 0.00 255.0 FORMAT "%5.1" ECU_ADDRESS 0x7F880A /end MEASUREMENT
/begin MEASUREMENT CTSCD_stRmp_mp "Zustandsinformation aktiver Rampensteigungsparametersatz" UBYTE OneToOne 1 100 0.00 255.0 FORMAT "%5.1" ECU_ADDRESS 0x8FD678 /end MEASUREMENT
/begin MEASUREMENT CTSCD_swtSig "Wassertemperatur über CAN oder ADC" UBYTE OneToOne 1 100 0.00 255.0 FORMAT "%5.1" ECU_ADDRESS 0x7F880B /end MEASUREMENT
/begin MEASUREMENT CTSCD_tClnt "Kühlmitteltemperatur" SWORD Temp_Cels 1 100 -50.140 899.860 FORMAT "%8.3" ECU_ADDRESS 0x7F8B6A /end MEASUREMENT
/begin MEASUREMENT CTSCD_tClntLin "linearisierter Wert aus HWK vorm Aufruf der Übergangsfunktion" SWORD Temp_Cels 1 100 -50.140 899.860 FORMAT "%8.3" ECU_ADDRESS 0x7F8B6C /end MEASUREMENT
/begin MEASUREMENT CTSCD_tClntP "Coolant Temperature Before correction" SWORD Temp_Cels 1 100 -50.140 899.860 FORMAT "%8.3" ECU_ADDRESS 0x7F8B6E /end MEASUREMENT
/begin MEASUREMENT CTSCD_uRaw "Wassertemperatur Spannungsrohwert" SWORD Volt 1 100 -160156.4 160151.5 FORMAT "%8.1" ECU_ADDRESS 0x7F8B70 /end MEASUREMENT
/begin MEASUREMENT CycSigCheck_stTest "cycsigcheck Status Bit0: 0/1 Prog/Data; Bit1: falsche Sig erkennen; Bit2: Zyklus kompl.; Bit3: shoff requ.; Bit4/5: Prog/Data OK" UBYTE OneToOne 1 100 0.00 255.0 FORMAT "%5.1" ECU_ADDRESS 0x7F8858 /end MEASUREMENT
/begin MEASUREMENT DrvTrn_rFlatTransDT "Zugverhältnis für flache Drehkraftstruktur fahren" SWORD TransR 1 100 -327.6800 327.6700 FORMAT "%8.4" ECU_ADDRESS 0x7F8C7A /end MEASUREMENT
/begin MEASUREMENT DrvTrn_rTransDT "Triebstrang-Übersetzung (Radmoment pro Motormoment)" SWORD TransR 1 100 -327.6800 327.6700 FORMAT "%8.4" ECU_ADDRESS 0x7F8C7C /end MEASUREMENT
/begin MEASUREMENT DrvTrn_rTransDTact_mp "aktueller Wert der Triebstrangübersetzung" SWORD TransR 1 100 -327.6800 327.6700 FORMAT "%8.4" ECU_ADDRESS 0x8FD67A /end MEASUREMENT
/begin MEASUREMENT DrvTrn_rTransDTRmpIn_mp "Input to the ramp for delaying torque requests" SWORD TransR 1 100 -327.6800 327.6700 FORMAT "%8.4" ECU_ADDRESS 0x8FD67C /end MEASUREMENT
/begin MEASUREMENT DSC_stTstTrigger_mp "Zustand Testeranforderung an DSM Scheduler" UBYTE OneToOne 1 100 0.00 255.0 FORMAT "%5.1" ECU_ADDRESS 0x8FD67E /end MEASUREMENT
/begin MEASUREMENT dvmark_w "Mindestabstand von Geschwindigkeitsmarken beim Stufentempomat" UWORD Vel 1 100 0.00 655.3500 FORMAT "%8.4" ECU_ADDRESS 0x7F9300 /end MEASUREMENT
/begin MEASUREMENT dvprg_w "Schrittweite bei Anzeige der Regelgeschwindigkeit im Programmiermodus" UWORD Vel 1 100 0.00 655.3500 FORMAT "%8.4" ECU_ADDRESS 0x7F9302 /end MEASUREMENT
/begin MEASUREMENT dvstutom_w "Schrittweite für Verstellung der Zielgeschwindigkeit ohne programmierte Marken" UWORD Vel 1 100 0.00 655.3500 FORMAT "%8.4" ECU_ADDRESS 0x7F9304 /end MEASUREMENT
/begin MEASUREMENT mmimrk_w "ported from ME9" UWORD Vel 1 100 0.00 655.3500 FORMAT "%8.4" ARRAY_SIZE 15 ECU_ADDRESS 0x7F97C6 /end MEASUREMENT
/begin MEASUREMENT mrknrc "Nummer veränderte Geschwindigkeits-Marke für schnelle CAN- Übertragung" UBYTE dez 1 100 0.00 255.0 FORMAT "%5.1" ECU_ADDRESS 0x7F8A3B /end MEASUREMENT
/begin MEASUREMENT mrknrcan "Nummer Geschwindigkeits-Marken Stufentempomat f ür CAN- Übertragung" UBYTE dez 1 100 0.00 255.0 FORMAT "%5.1" ARRAY_SIZE 15 ECU_ADDRESS 0x7F9526 /end MEASUREMENT
/begin MEASUREMENT mrknrint "Nummer Geschwindigkeits-Marken Stufentempomat intern" UBYTE dez 1 100 0.00 255.0 FORMAT "%5.1" ARRAY_SIZE 15 ECU_ADDRESS 0x7F9535 /end MEASUREMENT
/begin MEASUREMENT mrkstut_w "Geschwindigkeits-Marken Stufentempomat" UWORD Vel 1 100 0.00 655.3500 FORMAT "%8.4" ARRAY_SIZE 15 ECU_ADDRESS 0x7F97E4 /end MEASUREMENT
/begin MEASUREMENT statvza "Status Zielgeschwindigkeit für Kombi-Anzeige Stufentempomat" UBYTE dez 1 100 0.00 255.0 FORMAT "%5.1" ECU_ADDRESS 0x7F8A40 /end MEASUREMENT
/begin MEASUREMENT vfgr_w "Fahrzeug-Ist-Geschwindigkeit für FGR" UWORD Vel 1 100 0.00 655.3500 FORMAT "%8.4" ECU_ADDRESS 0x7F9308 /end MEASUREMENT
/begin MEASUREMENT vreglmax_w "Maximal zulässige Sollgeschwindigkeit für FGR" UWORD Vel 1 100 0.00 655.3500 FORMAT "%8.4" ECU_ADDRESS 0x7F9310 /end MEASUREMENT
/begin MEASUREMENT vreglmin_w "minimal zulässige Sollgeschwindigkeit für FGR" UWORD Vel 1 100 0.00 655.3500 FORMAT "%8.4" ECU_ADDRESS 0x7F9312 /end MEASUREMENT
/begin MEASUREMENT vzielakvp_w "Variable für Zielgeschwindigkeit im Kombi" UWORD Vel 1 100 0.00 655.3500 FORMAT "%8.4" ECU_ADDRESS 0x7F9318 /end MEASUREMENT
/begin MEASUREMENT vzielak_w "Zielgeschwindigkeit für Kombi-Anzeige Stufentempomat" UWORD Vel 1 100 0.00 655.3500 FORMAT "%8.4" ECU_ADDRESS 0x7F9316 /end MEASUREMENT
/begin MEASUREMENT vziels_w "Berechnete Soll-Zielgeschwindigkeit für FGR" UWORD Vel 1 100 0.00 655.3500 FORMAT "%8.4" ECU_ADDRESS 0x7F931A /end MEASUREMENT
/begin MEASUREMENT vziel_w "Zielgeschwindigkeit für FGR" UWORD Vel 1 100 0.00 655.3500 FORMAT "%8.4" ECU_ADDRESS 0x7F9314 /end MEASUREMENT
/begin FUNCTION crctl_updatedem "FGR-Anforderungen Update (Abschalten + Regler)"
 /begin DEF_CHARACTERISTIC CrCtl_aAccLim_C CrCtl_AccGear2PKp_C CrCtl_AccGear2PKpPos_C CrCtl_AccGear2PKpNeg_C CrCtl_vAccGear2PWinPos_C CrCtl_vAccGear2PWinNeg_C CrCtl_AccGear3PKp_C CrCtl_AccGear3PKpPos_C CrCtl_AccGear3PKpNeg_C CrCtl_vAccGear3PWinPos_C CrCtl_vAccGear3PWinNeg_C CrCtl_AccGear4PKp_C CrCtl_AccGear4PKpPos_C CrCtl_AccGear4PKpNeg_C CrCtl_vAccGear4PWinPos_C CrCtl_vAccGear4PWinNeg_C CrCtl_AccGear5PKp_C CrCtl_AccGear5PKpPos_C CrCtl_AccGear5PKpNeg_C CrCtl_vAccGear5PWinPos_C CrCtl_vAccGear5PWinNeg_C CrCtl_AccGear6PKp_C CrCtl_AccGear6PKpPos_C CrCtl_AccGear6PKpNeg_C CrCtl_vAccGear6PWinPos_C CrCtl_vAccGear6PWinNeg_C CrCtl_aDeclLim_C CrCtl_ctMaxTip_C CrCtl_DeclGear2PKp_C CrCtl_DeclGear2PKpPos_C CrCtl_DeclGear2PKpNeg_C CrCtl_vDeclGear2PWinPos_C CrCtl_vDeclGear2PWinNeg_C CrCtl_DeclGear3PKp_C CrCtl_DeclGear3PKpPos_C CrCtl_DeclGear3PKpNeg_C CrCtl_vDeclGear3PWinPos_C CrCtl_vDeclGear3PWinNeg_C CrCtl_DeclGear4PKp_C CrCtl_DeclGear4PKpPos_C CrCtl_DeclGear4PKpNeg_C CrCtl_vDeclGear4PWinPos_C CrCtl_vDeclGear4PWinNeg_C CrCtl_DeclGear5PKp_C CrCtl_DeclGear5PKpPos_C CrCtl_DeclGear5PKpNeg_C CrCtl_vDeclGear5PWinPos_C CrCtl_vDeclGear5PWinNeg_C CrCtl_DeclGear6PKp_C CrCtl_DeclGear6PKpPos_C CrCtl_DeclGear6PKpNeg_C CrCtl_vDeclGear6PWinPos_C CrCtl_vDeclGear6PWinNeg_C CrCtl_tiDT1vCurr_C CrCtl_kdDT1vCurr_C CrCtl_dtrqAccDwn_C CrCtl_dtrqDeclUp_C CrCtl_dtrqOffComf1_C CrCtl_dtrqOffComf2_C CrCtl_dtrqOffFast1_CUR CrCtl_dtrqOffFast2_CUR CrCtl_dtrqOffFast3_CUR CrCtl_dvAccFDCG3_CUR CrCtl_dvAccFDCG4_CUR CrCtl_dvAccFDCG5_CUR CrCtl_dvAccFDCG6_CUR CrCtl_dvAccG3_CUR CrCtl_dvAccG4_CUR CrCtl_dvAccG5_CUR CrCtl_dvAccG6_CUR CrCtl_dvDeclFDCG3_CUR CrCtl_dvDeclFDCG4_CUR CrCtl_dvDeclFDCG5_CUR CrCtl_dvDeclFDCG6_CUR CrCtl_dvDeclG3_CUR CrCtl_dvDeclG4_CUR CrCtl_dvDeclG5_CUR CrCtl_dvDeclG6_CUR CrCtl_dvResAbvFDCG3_CUR CrCtl_dvResAbvFDCG4_CUR CrCtl_dvResAbvFDCG5_CUR CrCtl_dvResAbvFDCG6_CUR CrCtl_dvResAbvG3_MAP CrCtl_dvResAbvG4_MAP CrCtl_dvResAbvG5_MAP CrCtl_dvResAbvG6_MAP CrCtl_dvResBlwFDCG3_CUR CrCtl_dvResBlwFDCG4_CUR CrCtl_dvResBlwFDCG5_CUR CrCtl_dvResBlwFDCG6_CUR CrCtl_dvResBlwG3_MAP CrCtl_dvResBlwG4_MAP CrCtl_dvResBlwG5_MAP CrCtl_dvResBlwG6_MAP CrCtl_facIncSlope_CUR CrCtl_facPropAcc_C CrCtl_facPropDecl_C CrCtl_facRedDecl_C CrCtl_facRedHi_C CrCtl_facRedLo_C CrCtl_facResAbvFDC_CUR CrCtl_facResAbv_CUR CrCtl_facResBlwFDC_CUR CrCtl_facResBlw_CUR CrCtl_facRmpRes_C CrCtl_HoldGear2IKi_C CrCtl_HoldGear2IKiPos_C CrCtl_HoldGear2IKiNeg_C CrCtl_vHoldGear2IWinPos_C CrCtl_vHoldGear2IWinNeg_C CrCtl_HoldGear2PKp_C CrCtl_HoldGear2PKpPos_C CrCtl_HoldGear2PKpNeg_C CrCtl_vHoldGear2PWinPos_C CrCtl_vHoldGear2PWinNeg_C CrCtl_HoldGear3IKi_C CrCtl_HoldGear3IKiPos_C CrCtl_HoldGear3IKiNeg_C CrCtl_vHoldGear3IWinPos_C CrCtl_vHoldGear3IWinNeg_C CrCtl_HoldGear3PKp_C CrCtl_HoldGear3PKpPos_C CrCtl_HoldGear3PKpNeg_C CrCtl_vHoldGear3PWinPos_C CrCtl_vHoldGear3PWinNeg_C CrCtl_HoldGear4IKi_C CrCtl_HoldGear4IKiPos_C CrCtl_HoldGear4IKiNeg_C CrCtl_vHoldGear4IWinPos_C CrCtl_vHoldGear4IWinNeg_C CrCtl_HoldGear4PKp_C CrCtl_HoldGear4PKpPos_C CrCtl_HoldGear4PKpNeg_C CrCtl_vHoldGear4PWinPos_C CrCtl_vHoldGear4PWinNeg_C CrCtl_HoldGear5IKi_C CrCtl_HoldGear5IKiPos_C CrCtl_HoldGear5IKiNeg_C CrCtl_vHoldGear5IWinPos_C CrCtl_vHoldGear5IWinNeg_C CrCtl_HoldGear5PKp_C CrCtl_HoldGear5PKpPos_C CrCtl_HoldGear5PKpNeg_C CrCtl_vHoldGear5PWinPos_C CrCtl_vHoldGear5PWinNeg_C CrCtl_HoldGear6IKi_C CrCtl_HoldGear6IKiPos_C CrCtl_HoldGear6IKiNeg_C CrCtl_vHoldGear6IWinPos_C CrCtl_vHoldGear6IWinNeg_C CrCtl_HoldGear6PKp_C CrCtl_HoldGear6PKpPos_C CrCtl_HoldGear6PKpNeg_C CrCtl_vHoldGear6PWinPos_C CrCtl_vHoldGear6PWinNeg_C CrCtl_tiResAbvGear2DT1_C CrCtl_ResAbvGear2DT1Kd_C CrCtl_tiResAbvGear3DT1_C CrCtl_ResAbvGear3DT1Kd_C CrCtl_tiResAbvGear4DT1_C CrCtl_ResAbvGear4DT1Kd_C CrCtl_tiResAbvGear5DT1_C CrCtl_ResAbvGear5DT1Kd_C CrCtl_tiResAbvGear6DT1_C CrCtl_ResAbvGear6DT1Kd_C CrCtl_ResBlwGear2IKi_C CrCtl_ResBlwGear2IKiPos_C CrCtl_ResBlwGear2IKiNeg_C CrCtl_vResBlwGear2IWinPos_C CrCtl_vResBlwGear2IWinNeg_C CrCtl_ResBlwGear2PKp_C CrCtl_ResBlwGear2PKpPos_C CrCtl_ResBlwGear2PKpNeg_C CrCtl_vResBlwGear2PWinPos_C CrCtl_vResBlwGear2PWinNeg_C CrCtl_ResBlwGear3IKi_C CrCtl_ResBlwGear3IKiPos_C CrCtl_ResBlwGear3IKiNeg_C CrCtl_vResBlwGear3IWinPos_C CrCtl_vResBlwGear3IWinNeg_C CrCtl_ResBlwGear3PKp_C CrCtl_ResBlwGear3PKpPos_C CrCtl_ResBlwGear3PKpNeg_C CrCtl_vResBlwGear3PWinPos_C CrCtl_vResBlwGear3PWinNeg_C CrCtl_ResBlwGear4IKi_C CrCtl_ResBlwGear4IKiPos_C CrCtl_ResBlwGear4IKiNeg_C CrCtl_vResBlwGear4IWinPos_C CrCtl_vResBlwGear4IWinNeg_C CrCtl_ResBlwGear4PKp_C CrCtl_ResBlwGear4PKpPos_C CrCtl_ResBlwGear4PKpNeg_C CrCtl_vResBlwGear4PWinPos_C CrCtl_vResBlwGear4PWinNeg_C CrCtl_ResBlwGear5IKi_C CrCtl_ResBlwGear5IKiPos_C CrCtl_ResBlwGear5IKiNeg_C CrCtl_vResBlwGear5IWinPos_C CrCtl_vResBlwGear5IWinNeg_C CrCtl_ResBlwGear5PKp_C CrCtl_ResBlwGear5PKpPos_C CrCtl_ResBlwGear5PKpNeg_C CrCtl_vResBlwGear5PWinPos_C CrCtl_vResBlwGear5PWinNeg_C CrCtl_ResBlwGear6IKi_C CrCtl_ResBlwGear6IKiPos_C CrCtl_ResBlwGear6IKiNeg_C CrCtl_vResBlwGear6IWinPos_C CrCtl_vResBlwGear6IWinNeg_C CrCtl_ResBlwGear6PKp_C CrCtl_ResBlwGear6PKpPos_C CrCtl_ResBlwGear6PKpNeg_C CrCtl_vResBlwGear6PWinPos_C CrCtl_vResBlwGear6PWinNeg_C CrCtl_ResRmpGear2PKp_C CrCtl_ResRmpGear2PKpPos_C CrCtl_ResRmpGear2PKpNeg_C CrCtl_vResRmpGear2PWinPos_C CrCtl_vResRmpGear2PWinNeg_C CrCtl_ResRmpGear3PKp_C CrCtl_ResRmpGear3PKpPos_C CrCtl_ResRmpGear3PKpNeg_C CrCtl_vResRmpGear3PWinPos_C CrCtl_vResRmpGear3PWinNeg_C CrCtl_ResRmpGear4PKp_C CrCtl_ResRmpGear4PKpPos_C CrCtl_ResRmpGear4PKpNeg_C CrCtl_vResRmpGear4PWinPos_C CrCtl_vResRmpGear4PWinNeg_C CrCtl_ResRmpGear5PKp_C CrCtl_ResRmpGear5PKpPos_C CrCtl_ResRmpGear5PKpNeg_C CrCtl_vResRmpGear5PWinPos_C CrCtl_vResRmpGear5PWinNeg_C CrCtl_ResRmpGear6PKp_C CrCtl_ResRmpGear6PKpPos_C CrCtl_ResRmpGear6PKpNeg_C CrCtl_vResRmpGear6PWinPos_C CrCtl_vResRmpGear6PWinNeg_C CrCtl_swtResOff_C CrCtl_tiOff_C CrCtl_tiTipUpDn_C CrCtl_trqDesThres_C CrCtl_trqMaxOfs_C CrCtl_trqOffComf_C CrCtl_trqOffFast12_C CrCtl_trqOffFast23_C CrCtl_vAccSet_C CrCtl_vAlwDvtThres_C CrCtl_vDeclSet_C CrCtl_vDiffAccMax_C CrCtl_vDiffAcc_C CrCtl_vDiffActvTrqDecHi_C CrCtl_vDiffActvTrqDecLo_C CrCtl_vDiffDeclMax_C CrCtl_vDiffDecl_C CrCtl_vDiffResAbv_C CrCtl_vDiffResBlw_C CrCtl_vDvtNegSwtToResAbv_C CrCtl_vDvtNegTipDwn_C CrCtl_vDvtNegTipUp_C CrCtl_vDvtPosTipDwn_C CrCtl_vHypDenom_C CrCtl_vHypNum_C CrCtl_vOfsDecl_C CrCtl_vOfsResBlw_C CrCtl_vOfsRes_C CrCtl_vRlsOfsI_C CrCtl_vTipStep_C /end DEF_CHARACTERISTIC
 /begin IN_MEASUREMENT CrCtl_vBeg CrCtl_vDiffRed_mp CrCtl_vDiff_mp Gearbx_stGear Rail_tiThresMonEna /end IN_MEASUREMENT
/end FUNCTION
/begin FUNCTION crctl_updatedem_msg ""
 /begin OUT_MEASUREMENT CrCtl_rVnBeg CrCtl_st CrCtl_stCAN CrCtl_stLampOut CrCtl_vBeg CrCtl_vDes CrCtl_vRmp /end OUT_MEASUREMENT
/end FUNCTION
/begin FUNCTION crctl_updatedem_uic ""
 /begin DEF_CHARACTERISTIC CrCtl_trqDes_Vector CrCtl_trqDes_Channel CrCtl_trqLead_Vector CrCtl_trqLead_Channel /end DEF_CHARACTERISTIC
 /begin OUT_MEASUREMENT CrCtl_dvAcc_mp CrCtl_dvDecl_mp CrCtl_dvResAbv_mp CrCtl_dvResBlw_mp CrCtl_facHyp_mp CrCtl_stFrzIGovGbx_mp CrCtl_stHysTrqDec_mp CrCtl_trqDec_mp CrCtl_trqDT1_mp CrCtl_trqI_mp CrCtl_trqMax_mp CrCtl_trqP_mp CrCtl_vDiffRed_mp CrCtl_vDiff_mp /end OUT_MEASUREMENT
/end FUNCTION
/begin FUNCTION crctl_vcrctl "Aktuelle Fahrzeuggeschwindigkeit für GRA"
 /begin DEF_CHARACTERISTIC CrCtl_DebToVCrCtlDef_C CrCtl_DebToVCrCtlOk_C CrCtl_rAccPedVelMin_C CrCtl_swtCrCtlType_C CrCtl_swtOffset_C CrCtl_swtVSSFil_C CrCtl_tiDisableDiagVCrCtl_C CrCtl_tiDispOffFil_C CrCtl_tiVSSFil2_C CrCtl_tiVSSFil_C CrCtl_uBattMin_C CrCtl_vAlwMaxKm_C CrCtl_vAlwMaxMPH_C CrCtl_vAlwMinKm_C CrCtl_vAlwMinMPH_C CrCtl_vOffMax_C /end DEF_CHARACTERISTIC
/end FUNCTION
/begin FUNCTION crctl_vcrctl_msg ""
 /begin OUT_MEASUREMENT CrCtl_stVCrCtl CrCtl_vAlwMax CrCtl_vAlwMin CrCtl_vCurr CrCtl_vDispOffset /end OUT_MEASUREMENT
/end FUNCTION
/begin FUNCTION crctl_vcrctl_uic "" /end FUNCTION
/begin FUNCTION crctl_vsetstep "Stufentempomat"
 /begin DEF_CHARACTERISTIC ANZMRKAUS ANZMRKMX CWBGSTUT DVMARK DVMARKMI DVPRG DVPRGMI DVSTUTOM DVSTUTOMMI TFGRTP TMARK TMRKBLI TSELO TVSTUTK TVSTUTL VFGRPRG VVEMOFS /end DEF_CHARACTERISTIC
/end FUNCTION
/begin FUNCTION crctl_vsetstep_msg ""
 /begin OUT_MEASUREMENT anzmark BGSTUTlokbits0 B_beveh B_bv1 B_bv2 B_envtwa B_fgrepa B_mrkbli B_mrkein B_mrkv B_prgmod B_tmark B_tmrkbli B_vziels canzbl ctblink dvmark_w dvprg_w dvstutom_w mrknrc mrknrcan mrknrint mrkstut_w statvza vzielakvp_w vzielak_w vziels_w /end OUT_MEASUREMENT
/end FUNCTION
/begin FUNCTION crctl_vsetstep_uic "" /begin OUT_MEASUREMENT CrCtl_BGSTUTbits2_mp CrCtl_mrkeinvp_mp /end OUT_MEASUREMENT /end FUNCTION
/begin FUNCTION crctl_vstepadapt "Aufbereitung der Größen für den Stufentempomaten" /end FUNCTION
/begin FUNCTION crctl_vstepadapt_msg ""
 /begin OUT_MEASUREMENT B_acc B_besch B_fgrat B_fgren B_fgresv B_fgrtb2 B_fgrtbe B_fgrtv2 B_fgrtve B_fgrtwa B_fgrvem B_insfgre B_kl15 B_km B_mmiena CrCtl_numVMrk CrCtl_stCC CrCtl_stUpdateVMrk CrCtl_stVDisp CrCtl_stVSetNew CrCtl_vDesDisp CrCtl_vMrk1 CrCtl_vMrk2 CrCtl_vMrk3 CrCtl_vSetNew mmimrk_w vfgr_w vreglmax_w vreglmin_w vziel_w /end OUT_MEASUREMENT
/end FUNCTION
/begin FUNCTION crctl_vstepadapt_uic "" /end FUNCTION
/begin FUNCTION crscd "Komponententreiber Kurbelwelle"
 /begin DEF_CHARACTERISTIC CrSCD_ctTurns_C CrSCD_nFast_C CrSCD_nMax_C CrSCD_nMin_C CrSCD_nSlowHigh_C CrSCD_nSlow_C CrSCD_numShftMisf_C CrSCD_phiIncCor_CUR CrSCD_phiSegLength_C CrSCD_phiSegPhase_C /end DEF_CHARACTERISTIC
 /begin IN_MEASUREMENT CrSCD_nAvrg /end IN_MEASUREMENT
/end FUNCTION
/begin FUNCTION crscd_msg ""
 /begin OUT_MEASUREMENT CrSCD_dSegMisf CrSCD_nAvrg CrSCD_nAvrgHiRes CrSCD_nCurr CrSCD_nCurrHiRes CrSCD_nDyn CrSCD_nHold CrSCD_nMisf CrSCD_numSeg CrSCD_phiIncCor CrSCD_phiIncr CrSCD_tiSeg /end OUT_MEASUREMENT
/end FUNCTION
/begin FUNCTION crscd_thresctl ""
 /begin DEF_CHARACTERISTIC CrSCD_ctThresCtlMin_C CrSCD_nThresCtlHigh_C CrSCD_nThresCtlLow_C /end DEF_CHARACTERISTIC
/end FUNCTION
/begin FUNCTION crscd_uic ""
 /begin OUT_MEASUREMENT CrSCD_incNextIntDelta_mp CrSCD_incNextInt_mp CrSCD_phiCurr_mp CrSCD_phiSegGrid_mp CrSCD_stIncErr_mp CrSCD_stIncSig_mp CrSCD_stIncSyncInc_mp CrSCD_stIncSyncPhase_mp /end OUT_MEASUREMENT
/end FUNCTION
/begin FUNCTION crscd_var ""
 /begin DEF_CHARACTERISTIC CrSCD_ctGapIncs_C CrSCD_ctGaps_C CrSCD_ctIncs_C CrSCD_facGapPlausHigh_CUR CrSCD_facGapPlausLow_CUR CrSCD_facIncPlausHigh_CUR CrSCD_facIncPlausLow_CUR CrSCD_numFBCSeg_C CrSCD_numTDCSeg_C CrSCD_phiGap2Zero_C CrSCD_tiPlausCalcOff_C /end DEF_CHARACTERISTIC
 /begin IN_MEASUREMENT CrSCD_tiIncr /end IN_MEASUREMENT
/end FUNCTION
/begin FUNCTION crscd_var_msg "" /begin OUT_MEASUREMENT CrSCD_nIncr CrSCD_tiIncr /end OUT_MEASUREMENT /end FUNCTION
/begin FUNCTION crs_chkstrtspd "Redundanter Start nur mit Kurbelwelle"
 /begin DEF_CHARACTERISTIC CrS_ctMaxInjStrt_C CrS_facSegTimeMax_C CrS_facSegTimeMin_C CrS_facSegTime_CUR CrS_phiSegLengthStrtSpd_C CrS_phiSegOfsStrtSpdOld_C CrS_phiSegOfsStrtSpd_C /end DEF_CHARACTERISTIC
 /begin IN_MEASUREMENT Eng_nAvrg /end IN_MEASUREMENT
/end FUNCTION
/begin FUNCTION crs_chkstrtspd_uic ""
 /begin OUT_MEASUREMENT CrS_ctInjStrt_mp CrS_facSegTime_mp CrS_numTDCStrtLst_mp CrS_numTDCStrt_mp CrS_stStrt_mp CrS_tiSegOld_mp CrS_tiSeg_mp /end OUT_MEASUREMENT
/end FUNCTION
/begin FUNCTION ctscd "Wassertemperaturfühler Komponententreiber"
 /begin DEF_CHARACTERISTIC CTSCD_uSRCMin_C CTSCD_uSRCMax_C CTSCD_tLin_CUR CTSCD_DebSigDef_C CTSCD_DebSigOk_C CTSCD_DebSRCHighDef_C CTSCD_DebSRCHighOk_C CTSCD_DebSRCLowDef_C CTSCD_DebSRCLowOk_C CTSCD_dtRmpSlp2UpDwn_C CTSCD_dtFlTempUp_C CTSCD_dtFlTempDwn_C CTSCD_numAdc_C CTSCD_dtRmpSlp1Up_C CTSCD_dtRmpSlp1Dwn_C CTSCD_stSensIDWord_C CTSCD_swtPHtrIgnoreCAN_C CTSCD_swtSigVal_C CTSCD_tClntPMin_C CTSCD_tDflCold_C CTSCD_tDflWarm_C CTSCD_tDiffThres_C CTSCD_tFuelMin_C CTSCD_tiWait_C /end DEF_CHARACTERISTIC
 /begin IN_MEASUREMENT CTSCD_uRaw /end IN_MEASUREMENT
/end FUNCTION
/begin FUNCTION ctscd_msg ""
 /begin OUT_MEASUREMENT CTSCD_dtClnt CTSCD_stErrIni CTSCD_stPHtr CTSCD_swtSig CTSCD_tClnt CTSCD_tClntLin CTSCD_tClntP CTSCD_uRaw /end OUT_MEASUREMENT
/end FUNCTION
/begin FUNCTION ctscd_uic "" /begin OUT_MEASUREMENT CTSCD_stRmp_mp /end OUT_MEASUREMENT /end FUNCTION
/begin FUNCTION ctscd_var "" /end FUNCTION
/begin FUNCTION ctscd_var_msg "" /end FUNCTION
/begin FUNCTION curmap_size_base "" /end FUNCTION
/begin FUNCTION curmap_size_proj "" /end FUNCTION
/begin FUNCTION curmap_size_sys "" /end FUNCTION
/begin FUNCTION cycsigcheck ""
 /begin DEF_CHARACTERISTIC CycSigCheck_nLimit_C CycSigCheck_swtMode_C CycSigCheck_swtOff_C /end DEF_CHARACTERISTIC
/end FUNCTION
/begin FUNCTION cycsigcheck_msg "" /begin OUT_MEASUREMENT CycSigCheck_stTest /end OUT_MEASUREMENT /end FUNCTION
/begin FUNCTION drvtrn "Antriebsstrang"
 /begin DEF_CHARACTERISTIC DrvTrn_drTransDTUp_C DrvTrn_drTransDTDwn_C DrvTrn_rFlatTransDT_C DrvTrn_rTransDTInit_C DrvTrn_swtrTransSel_C DrvTrn_tiRTransDT_C /end DEF_CHARACTERISTIC
/end FUNCTION
/begin FUNCTION drvtrn_msg "" /begin OUT_MEASUREMENT DrvTrn_rFlatTransDT DrvTrn_rTransDT /end OUT_MEASUREMENT /end FUNCTION
/begin FUNCTION drvtrn_uic "" /begin OUT_MEASUREMENT DrvTrn_rTransDTact_mp DrvTrn_rTransDTRmpIn_mp /end OUT_MEASUREMENT /end FUNCTION
/begin FUNCTION dsched "" /begin DEF_CHARACTERISTIC DSCHED_numSelFID_C /end DEF_CHARACTERISTIC /end FUNCTION
/begin FUNCTION dsched_msg "" /end FUNCTION
/begin FUNCTION dsched_uic "" /begin OUT_MEASUREMENT DSC_stTstTrigger_mp /end OUT_MEASUREMENT /end FUNCTION
/begin COMPU_METHOD Acc "Fahrzeugbeschleunigung" RAT_FUNC "%6.5" "m/s^2" COEFFS 0 1000 0 0 0 1 /end COMPU_METHOD
/begin COMPU_METHOD AngleCrS "Winkel Kurbelwelle" RAT_FUNC "%6.4" "deg CrS" COEFFS 0 42.6666666666667 0 0 0 1 /end COMPU_METHOD
/begin COMPU_METHOD B_TRUE "Umrechnung   ----> FALSE;    TRUE = TRUE" TAB_VERB "%6.3" "-" COMPU_TAB_REF B_TRUE /end COMPU_METHOD
/begin COMPU_VTAB B_TRUE "Umrechnung   ----> FALSE;    TRUE = TRUE" TAB_VERB 2 0 "----" 1 "TRUE" /end COMPU_VTAB
/begin COMPU_METHOD dez "K3 Umwandlungen" RAT_FUNC "%6.2" "-" COEFFS 0 1 0 0 0 1 /end COMPU_METHOD
/begin COMPU_METHOD dTrqPrp_20ms "Anstieg Vortriebsmoment im 20 ms Raster" RAT_FUNC "%6.1" "Nm/s" COEFFS 0 0.1 0 0 0 1 /end COMPU_METHOD
/begin COMPU_METHOD dVel_20ms "Anstieg Fahrgeschwindigkeit im 20 ms Raster" RAT_FUNC "%6.3" "(km/h)/s" COEFFS 0 2 0 0 0 1 /end COMPU_METHOD
/begin COMPU_METHOD EngN "Motordrehzahl" RAT_FUNC "%6.2" "rpm" COEFFS 0 1 0 0 0 1 /end COMPU_METHOD
/begin COMPU_METHOD EngN_HiRes "Motordrehzahl, höhere Auflösung als EngM" RAT_FUNC "%6.3" "rpm" COEFFS 0 8 0 0 0 1 /end COMPU_METHOD
/begin COMPU_METHOD Fact "Faktor mit Auflösung 1 / 8192, hauptsächlich für einen Faktorenbereich 0...1 verwendet" RAT_FUNC "%6.5" "-" COEFFS 0 8192 0 0 0 1 /end COMPU_METHOD
/begin COMPU_METHOD Fact1 "Faktor mit Auflösung 0,01 (100 mal höherer Bereich als Fact)" RAT_FUNC "%6.4" "-" COEFFS 0 128 0 0 0 1 /end COMPU_METHOD
/begin COMPU_METHOD FactHigh "Faktor mit Auflösung 1/4096, hauptsächlich für einen Faktorenbereich 0.1...10 verwendet" RAT_FUNC "%6.5" "-" COEFFS 0 8192 0 0 0 1 /end COMPU_METHOD
/begin COMPU_METHOD Fact_Inc "Faktor für Inkrement/Gap Plausibilitäts-Fenster" RAT_FUNC "%6.4" "-" COEFFS 0 256 0 0 0 1 /end COMPU_METHOD
/begin COMPU_METHOD FidName "Verbale Umrechnung für Fid-Namen" TAB_VERB "%6.3" "-" COMPU_TAB_REF FidName /end COMPU_METHOD
/begin COMPU_VTAB FidName "Verbale Umrechnung für Fid-Namen" TAB_VERB 1856 0 "Fid_unused" 4097 "Fid_ACCIRevErr_MAX" 4098 "Fid_ACCRevErr_MAX" 4099 "Fid_ACC_AliveErr_MAX" 4100 "Fid_ACC_CanDef_MAX" 4101 "Fid_ACC_CsErr_MAX" 4102 "Fid_ACC_TiOutErr_MAX" 4103 "Fid_ACCtl_ACTrqErr_MAX" 4104 "Fid_ACCtl_CTSErr_MAX" 4105 "Fid_ACCtl_FanErr_MAX" 4106 "Fid_ACCtl_TGearbxErr_MAX" 4107 "Fid_ACCtl_VSSErr_MAX" 4108 "Fid_AFSCD_MAX" 4109 "Fid_AFSCD2_MAX" 4110 "Fid_AFSCD_AirPerCyl_MAX" 4111 "Fid_AFSCD_AirPerCyl2_MAX" 4112 "Fid_AFSCD_AirPerTime_MAX" 4113 "Fid_AFSCD_AirPerTime2_MAX" 4114 "Fid_AFSCD_BPSCDErr_MAX" 4115 "Fid_AFSCD_PlAirPerCylDifOff_MAX" 4116 "Fid_AFSCD_PlOffsDrft_MAX" 4117 "Fid_AFSCD_PlOffsDrft2_MAX" 4118 "Fid_AFSCD_PlSetyDrft_MAX" 4119 "Fid_AFSCD_PlSetyDrft2_MAX" 4120 "Fid_AFSCD_SRCCorrAirm_MAX" 4121 "Fid_AFSCD_SRCCorrAirm2_MAX" 4122 "Fid_AFSCD_SRCDcyc_MAX" 4123 "Fid_AFSCD_SRCDcyc2_MAX" 4124 "Fid_AFSCD_SRCRawAirm_MAX" 4125 "Fid_AFSCD_SRCRawAirm2_MAX" 4126 "Fid_AFSCD_SRCRefSig_MAX" 4127 "Fid_AFSCD_SRCRefSig2_MAX" 4128 "Fid_AFSCD_tAir1_MAX" 4129 "Fid_AFSCD_tAir2_MAX" 4130 "Fid_AOHt_AltErr_MAX" 4131 "Fid_AOHt_ShutOffErr_MAX" 4132 "Fid_APP1_MAX" 4133 "Fid_APP2_MAX" 4134 "Fid_APPKickdown_MAX" 4135 "Fid_APSCD_MAX" 4136 "Fid_ARSOff_MAX" 4137 "Fid_ASDdc_MAX" 4138 "Fid_ASModSwtOffEng_MAX" 4139 "Fid_ASModSwtOffIndVol_MAX" 4140 "Fid_AccPed_MAX" 4141 "Fid_AccPedBrkPres_MAX" 4142 "Fid_AccPedVel_MAX" 4143 "Fid_AccPed_Brk_MAX" 4144 "Fid_AirCtl_MAX" 4145 "Fid_AirCtlCorrAlt_MAX" 4146 "Fid_AirCtlDyn_MAX" 4147 "Fid_AirCtlNeg_MAX" 4148 "Fid_AirCtlNeg2_MAX" 4149 "Fid_AirCtlPFltEGRRed_MAX" 4150 "Fid_AirCtlPlateBreak_MAX" 4151 "Fid_AirCtlPlateBreakAct_MAX" 4152 "Fid_AirCtlPos_MAX" 4153 "Fid_AirCtlPos2_MAX" 4154 "Fid_AirCtl_Brk_MAX" 4155 "Fid_AirCtl_Gear_MAX" 4156 "Fid_BPSCDMon_MAX" 4157 "Fid_CTSCDFlTemp_MAX" 4158 "Fid_CTSCD_Plaus_MAX" 4159 "Fid_ClgDynTst_MAX" 4160 "Fid_CmbChb_MAX" 4161 "Fid_CoDT_GripDeb_MAX" 4162 "Fid_CoDT_Mon_MAX" 4163 "Fid_CoDT_TRQ_MAX" 4164 "Fid_CoEngIRevSys1_MAX" 4165 "Fid_CoEngIRevSys2_MAX" 4166 "Fid_CoEngIRevVeh_MAX" 4167 "Fid_CoEngPFltErr_MAX" 4168 "Fid_CoEngPFltOvldErr_MAX" 4169 "Fid_CoEngRevSys1_MAX" 4170 "Fid_CoEngRevSys2_MAX" 4171 "Fid_CoEngRevVeh_MAX" 4172 "Fid_CoEngShOffTst_MAX" 4173 "Fid_CoEngSoftShOffTV_MAX" 4174 "Fid_CoEng_ActrPrt_MAX" 4175 "Fid_CoEng_Nrml2Strt_MAX" 4176 "Fid_CoEng_PwrStgEnable_MAX" 4177 "Fid_CoEng_trqLimErr_MAX" 4178 "Fid_CoEng_trqLimErr1_MAX" 4179 "Fid_CoEng_trqLimErr2_MAX" 4180 "Fid_CoEng_trqLimErr3_MAX" 4181 "Fid_CoEng_trqLimErr4_MAX" 4182 "Fid_CoVM_StabDem_Err_MAX" 4183 "Fid_CoVehtrqLimErr_MAX" 4184 "Fid_CpBVlvOff_MAX" 4185 "Fid_CrCtlShutOffIr_MAX" 4186 "Fid_CrCtl_ASCTimeout_MAX" 4187 "Fid_CrCtl_CanDef_MAX" 4188 "Fid_CrCtl_KombiTimeout_MAX" 4189 "Fid_CrCtl_vCrCtl_MAX" 4190 "Fid_DSM_Wuc_MAX" 4191 "Fid_EATSCDTSubs_MAX" 4192 "Fid_EBAFCD_MAX" 4193 "Fid_EBFCD_MAX" 4194 "Fid_ECU_MAX" 4195 "Fid_EGSysCoLSU0_MAX" 4196 "Fid_EGSysCoNSC_MAX" 4197 "Fid_EGSysCoOxi_MAX" 4198 "Fid_EGSysCoTrbn_MAX" 4199 "Fid_EGSysCoTube0_MAX" 4200 "Fid_EGSysCoTube1_MAX" 4201 "Fid_EGSysHtgDel_MAX" 4202 "Fid_EGSysMaxTOxiPreB1_MAX" 4203 "Fid_EGSysMaxTOxiPreB2_MAX" 4204 "Fid_EGSysMaxTPreB1_MAX" 4205 "Fid_EGSysMaxTPreB2_MAX" 4206 "Fid_EGSysMaxTPreRgnB1_MAX" 4207 "Fid_EGSysMaxTPreRgnB2_MAX" 4208 "Fid_EGSysMxTOxiPreRgnB1_MAX" 4209 "Fid_EGSysMxTOxiPreRgnB2_MAX" 4210 "Fid_EGSysNSC_MAX" 4211 "Fid_EGSysOxiCat_MAX" 4212 "Fid_EGSysPresEnv_MAX" 4213 "Fid_EGSysStrt_MAX" 4214 "Fid_EGSysTemp_MAX" 4215 "Fid_EGSysTrbn_MAX" 4216 "Fid_EGSysTube_MAX" 4217 "Fid_EGSys_AP_MAX" 4218 "Fid_EGTRgnLck_MAX" 4219 "Fid_EGTTempGvnrAirCtl_MAX" 4220 "Fid_EGTTempGvnrInrB1_MAX" 4221 "Fid_EGTTempGvnrInrB2_MAX" 4222 "Fid_EGTTempGvnrOutrB1_MAX" 4223 "Fid_EGTTempGvnrOutrB2_MAX" 4224 "Fid_ETClbCorActv_MAX" 4225 "Fid_EngCTSCD_MAX" 4226 "Fid_EngMCaS1_MAX" 4227 "Fid_EngMCaSBackUp_MAX" 4228 "Fid_EngMCrS1_MAX" 4229 "Fid_EngMCrSBackUp_MAX" 4230 "Fid_EngMTEng_MAX" 4231 "Fid_EngMTrqFrcPDiff_MAX" 4232 "Fid_EngMVVeh_MAX" 4233 "Fid_EngM_ChkStrtSpd_MAX" 4234 "Fid_EngPrt_nLimErr_MAX" 4235 "Fid_FBC_MAX" 4236 "Fid_FBCMonI_MAX" 4237 "Fid_FMASwtOff1_MAX" 4238 "Fid_FMASwtOff2_MAX" 4239 "Fid_FMASwtOff3_MAX" 4240 "Fid_FMTC_AirCorr_MAX" 4241 "Fid_FMTC_PCRCorr_MAX" 4242 "Fid_FMTC_SOECorr_MAX" 4243 "Fid_FTSCDErr_MAX" 4244 "Fid_FanCtl_MAX" 4245 "Fid_FanGbxOil_MAX" 4246 "Fid_FlMngFullLdRglOff_MAX" 4247 "Fid_FlMngSmkDefect_MAX" 4248 "Fid_FlMngTPFltErr_MAX" 4249 "Fid_FlSysCTSSens_MAX" 4250 "Fid_FlSysDens_MAX" 4251 "Fid_FlSysFTSSens_MAX" 4252 "Fid_FrmMngAOHt_MAX" 4253 "Fid_FrmMngAPP_MAX" 4254 "Fid_FrmMngARS_MAX" 4255 "Fid_FrmMngAddLevl_MAX" 4256 "Fid_FrmMngBrk_MAX" 4257 "Fid_FrmMngBrkDef_MAX" 4258 "Fid_FrmMngCoEng_MAX" 4259 "Fid_FrmMngCoEng_St2_MAX" 4260 "Fid_FrmMngConvDef_MAX" 4261 "Fid_FrmMngEngOvrSpd_MAX" 4262 "Fid_FrmMngEngRpmTemp_MAX" 4263 "Fid_FrmMngEngSpd_MAX" 4264 "Fid_FrmMngInjDU1_MAX" 4265 "Fid_FrmMngInjDU2_MAX" 4266 "Fid_FrmMngInjVlv_MAX" 4267 "Fid_FrmMngOBDCtl_MAX" 4268 "Fid_FrmMngPFltDef_MAX" 4269 "Fid_FrmMngParkConsumer_MAX" 4270 "Fid_FrmMngPla_DSC_MAX" 4271 "Fid_FrmMngPla_EGS_MAX" 4272 "Fid_FrmMngPowerTrainCAN_MAX" 4273 "Fid_FrmMngPrvCan_MAX" 4274 "Fid_FrmMngPwrMngLIGovSt_MAX" 4275 "Fid_FrmMngRpmRduc_MAX" 4276 "Fid_FrmMngSIG_ARS_MAX" 4277 "Fid_FrmMngSIG_DSC_MAX" 4278 "Fid_FrmMngSig_EGS_MAX" 4279 "Fid_FrmMngTO_ARS_MAX" 4280 "Fid_FrmMngTO_DSC_MAX" 4281 "Fid_FrmMngTo_EGS_MAX" 4282 "Fid_FrmMngTrqGearbx_MAX" 4283 "Fid_FrmMngWaterVlv_MAX" 4284 "Fid_FrmMng_ST_TORQ_MAX" 4285 "Fid_FrmMng_stTrq_MAX" 4286 "Fid_FrmMngnSetpoint_MAX" 4287 "Fid_FrmMngpVal_MAX" 4288 "Fid_FrmMngtEng_MAX" 4289 "Fid_GearbxDrvAway_MAX" 4290 "Fid_GearbxDrvAwayInactv_MAX" 4291 "Fid_GearbxNmin_MAX" 4292 "Fid_GearbxPtCANErr_MAX" 4293 "Fid_GearbxSlip_MAX" 4294 "Fid_GearbxTrqLimErr_MAX" 4295 "Fid_Gearbx_GearDet_MAX" 4296 "Fid_Gearbx_TrqIntv_Err_MAX" 4297 "Fid_GlwCtl1_MAX" 4298 "Fid_GlwCtl2_MAX" 4299 "Fid_GlwCtl3_MAX" 4300 "Fid_HDC_MAX" 4301 "Fid_IATSCD_MAX" 4302 "Fid_IATSCD_tAir1_MAX" 4303 "Fid_IATSCD_tAir2_MAX" 4304 "Fid_IndSys1_MAX" 4305 "Fid_IndSys2_MAX" 4306 "Fid_InjCrvCoErr_MAX" 4307 "Fid_InjCrvCylOffs_MAX" 4308 "Fid_InjCtl_qLimErr_MAX" 4309 "Fid_InjVCDActrEnrgTemp_MAX" 4310 "Fid_InjVCDCls_MAX" 4311 "Fid_InjVCDTPUErr_MAX" 4312 "Fid_InjVlvActrTemp_MAX" 4313 "Fid_InjVlvInjLim_MAX" 4314 "Fid_InjVlvMon_MAX" 4315 "Fid_InjVlvNVC_MAX" 4316 "Fid_InjVlvSetUpVolt_MAX" 4317 "Fid_InjVlvWvCorOff_MAX" 4318 "Fid_LIGovSetpointDrvAwy_MAX" 4319 "Fid_LIGovUbr_MAX" 4320 "Fid_LSUCDMon0_MAX" 4321 "Fid_LSUCDO20_MAX" 4322 "Fid_LSUCDRi0_MAX" 4323 "Fid_LSUCDactiv0_MAX" 4324 "Fid_LSUCDlsu0_MAX" 4325 "Fid_LSUClbSched_MAX" 4326 "Fid_LSUCtl0_MAX" 4327 "Fid_LSUMonAllChecks_MAX" 4328 "Fid_LSUMonPlausChk_MAX" 4329 "Fid_Layer_FI_TANS_MAX" 4330 "Fid_Layer_FI_TUMG_MAX" 4331 "Fid_Layer_MANHYDR_MAX" 4332 "Fid_Layer_MANLUFT_MAX" 4333 "Fid_MSCDPrivCan_MAX" 4334 "Fid_MSMonNetMngPtCan_MAX" 4335 "Fid_MSMonPFlt1_MAX" 4336 "Fid_MSMonPFlt2_MAX" 4337 "Fid_MSMonPFlt3_MAX" 4338 "Fid_MSMonPFlt4_MAX" 4339 "Fid_MSMonStEGS_MAX" 4340 "Fid_MSMon_ARS_TO_MAX" 4341 "Fid_MSMon_CanDef_MAX" 4342 "Fid_MSMon_DSC_TO_MAX" 4343 "Fid_MSMon_EGS_TO_MAX" 4344 "Fid_MSMon_FrmMngPT_MAX" 4345 "Fid_MSMon_FrmMngPT2_MAX" 4346 "Fid_MSMon_trqOff_MAX" 4347 "Fid_MSidCD_ECU_MAX" 4348 "Fid_MSidCD_Pin_MAX" 4349 "Fid_MeUnCDCalcI_MAX" 4350 "Fid_Mil_MAX" 4351 "Fid_OTSCD_MAX" 4352 "Fid_OxiCat_pPreCat_MAX" 4353 "Fid_PCBSPFltDef_MAX" 4354 "Fid_PCR_MAX" 4355 "Fid_PCRBalGvnr_MAX" 4356 "Fid_PCRBalGvnrP40Corr_MAX" 4357 "Fid_PCRExtnLimActr_MAX" 4358 "Fid_PCRGvnrDvtNeg_MAX" 4359 "Fid_PCRGvnrDvtPos_MAX" 4360 "Fid_PCRLPGvnrDvtNeg_MAX" 4361 "Fid_PCRLPGvnrDvtPos_MAX" 4362 "Fid_PCRSurgeGvnr_MAX" 4363 "Fid_PCRSurgeLIGov_MAX" 4364 "Fid_PCR_LP_MAX" 4365 "Fid_PCR_LPMS_MAX" 4366 "Fid_PCR_MS_MAX" 4367 "Fid_PCR_SurgeDet_MAX" 4368 "Fid_PCVCDCalcI_MAX" 4369 "Fid_PFltAshCor_MAX" 4370 "Fid_PFltAshCorRgn_MAX" 4371 "Fid_PFltBrk_MAX" 4372 "Fid_PFltCharB1_MAX" 4373 "Fid_PFltCharB2_MAX" 4374 "Fid_PFltChngParB1_MAX" 4375 "Fid_PFltChngParB2_MAX" 4376 "Fid_PFltClth_MAX" 4377 "Fid_PFltDynChkB1_MAX" 4378 "Fid_PFltDynChkB2_MAX" 4379 "Fid_PFltEngPrtRgnMon_MAX" 4380 "Fid_PFltGearDet_MAX" 4381 "Fid_PFltHsLnChkB1_MAX" 4382 "Fid_PFltHsLnChkB2_MAX" 4383 "Fid_PFltLckRgnErr_MAX" 4384 "Fid_PFltLckRgnFuel_MAX" 4385 "Fid_PFltNumPFltErr_MAX" 4386 "Fid_PFltNumPFltErrLck_MAX" 4387 "Fid_PFltPlausPresB1_MAX" 4388 "Fid_PFltPlausPresB2_MAX" 4389 "Fid_PFltPlausTempB1_MAX" 4390 "Fid_PFltPlausTempB2_MAX" 4391 "Fid_PFltPresPlausProj_MAX" 4392 "Fid_PFltPresSensFrz_MAX" 4393 "Fid_PFltPresSensHsLnB1_MAX" 4394 "Fid_PFltPresSensHsLnB2_MAX" 4395 "Fid_PFltPresSensPreB1_MAX" 4396 "Fid_PFltPresSensPreB2_MAX" 4397 "Fid_PFltSRCPresB1_MAX" 4398 "Fid_PFltSRCPresB2_MAX" 4399 "Fid_PFltSRCTempB1_MAX" 4400 "Fid_PFltSRCTempB2_MAX" 4401 "Fid_PFltSimOnB1_MAX" 4402 "Fid_PFltSimOnB2_MAX" 4403 "Fid_PFltSpdVeh_MAX" 4404 "Fid_PFltSucB1_MAX" 4405 "Fid_PFltSucB2_MAX" 4406 "Fid_PFltTOxiPreDiffB1_MAX" 4407 "Fid_PFltTOxiPreDiffB2_MAX" 4408 "Fid_PFltTPreDiffB1_MAX" 4409 "Fid_PFltTPreDiffB2_MAX" 4410 "Fid_PFltTempAir_MAX" 4411 "Fid_PFltTempClnt_MAX" 4412 "Fid_PFltTempOxiPreB1_MAX" 4413 "Fid_PFltTempOxiPreB2_MAX" 4414 "Fid_PFltTempOxiPstB1_MAX" 4415 "Fid_PFltTempOxiPstB2_MAX" 4416 "Fid_PFltTempPreB1_MAX" 4417 "Fid_PFltTempPreB2_MAX" 4418 "Fid_PFltTempSensB1_MAX" 4419 "Fid_PFltTempSensB2_MAX" 4420 "Fid_PFltTempSensFrz_MAX" 4421 "Fid_PFltTwFlwTempDev_MAX" 4422 "Fid_PFltVltgBatt_MAX" 4423 "Fid_RailCDRPSErrChk_MAX" 4424 "Fid_RailCDSubstVal_MAX" 4425 "Fid_RailCD_PMonStrt_MAX" 4426 "Fid_RailCPCtlMeUnMode_MAX" 4427 "Fid_RailCPCtlPCVMode_MAX" 4428 "Fid_RailCtlMode_MAX" 4429 "Fid_RailMeUn0Blk_MAX" 4430 "Fid_RailMeUn0Rls_MAX" 4431 "Fid_RailMeUn1Blk_MAX" 4432 "Fid_RailMeUn1Rls_MAX" 4433 "Fid_RailMeUn2Blk_MAX" 4434 "Fid_RailMeUn2Rls_MAX" 4435 "Fid_RailMeUn3Blk_MAX" 4436 "Fid_RailMeUn3Rls_MAX" 4437 "Fid_RailMeUn4Blk_MAX" 4438 "Fid_RailMeUn4Rls_MAX" 4439 "Fid_RailMeUnCtlMode_MAX" 4440 "Fid_RailPCV0Blk_MAX" 4441 "Fid_RailPCV0Rls_MAX" 4442 "Fid_RailPCV1Blk_MAX" 4443 "Fid_RailPCV1Rls_MAX" 4444 "Fid_RailPCV2Blk_MAX" 4445 "Fid_RailPCV2Rls_MAX" 4446 "Fid_RailPCV3Blk_MAX" 4447 "Fid_RailPCV3Rls_MAX" 4448 "Fid_RailPCV4Blk_MAX" 4449 "Fid_RailPCV4Rls_MAX" 4450 "Fid_RailPCV5Blk_MAX" 4451 "Fid_RailPCV5Rls_MAX" 4452 "Fid_RailPCVCtlMode_MAX" 4453 "Fid_RailSetPointLim_MAX" 4454 "Fid_RailSetPointRed_MAX" 4455 "Fid_SignalsTstNLim_MAX" 4456 "Fid_StSysImmo_MAX" 4457 "Fid_StSysStrtTipGbxDat_MAX" 4458 "Fid_SysLamp_MAX" 4459 "Fid_T15CDCanError_MAX" 4460 "Fid_T50CDSig_MAX" 4461 "Fid_TVACD_AirMonOff_MAX" 4462 "Fid_ThrVlvMon_MAX" 4463 "Fid_VSACDDioInDia_MAX" 4464 "Fid_VSSCD_Tx_MAX" 4465 "Fid_VehDaDist_MAX" 4466 "Fid_ZFCClbActv_MAX" 4467 "Fid_ZFCCldCmbCham_MAX" 8193 "Fid_ACCIRevErr_MIN" 8194 "Fid_ACCRevErr_MIN" 8195 "Fid_ACC_AliveErr_MIN" 8196 "Fid_ACC_CanDef_MIN" 8197 "Fid_ACC_CsErr_MIN" 8198 "Fid_ACC_TiOutErr_MIN" 8199 "Fid_ACCtl_ACTrqErr_MIN" 8200 "Fid_ACCtl_CTSErr_MIN" 8201 "Fid_ACCtl_FanErr_MIN" 8202 "Fid_ACCtl_TGearbxErr_MIN" 8203 "Fid_ACCtl_VSSErr_MIN" 8204 "Fid_AFSCD_MIN" 8205 "Fid_AFSCD2_MIN" 8206 "Fid_AFSCD_AirPerCyl_MIN" 8207 "Fid_AFSCD_AirPerCyl2_MIN" 8208 "Fid_AFSCD_AirPerTime_MIN" 8209 "Fid_AFSCD_AirPerTime2_MIN" 8210 "Fid_AFSCD_BPSCDErr_MIN" 8211 "Fid_AFSCD_PlAirPerCylDifOff_MIN" 8212 "Fid_AFSCD_PlOffsDrft_MIN" 8213 "Fid_AFSCD_PlOffsDrft2_MIN" 8214 "Fid_AFSCD_PlSetyDrft_MIN" 8215 "Fid_AFSCD_PlSetyDrft2_MIN" 8216 "Fid_AFSCD_SRCCorrAirm_MIN" 8217 "Fid_AFSCD_SRCCorrAirm2_MIN" 8218 "Fid_AFSCD_SRCDcyc_MIN" 8219 "Fid_AFSCD_SRCDcyc2_MIN" 8220 "Fid_AFSCD_SRCRawAirm_MIN" 8221 "Fid_AFSCD_SRCRawAirm2_MIN" 8222 "Fid_AFSCD_SRCRefSig_MIN" 8223 "Fid_AFSCD_SRCRefSig2_MIN" 8224 "Fid_AFSCD_tAir1_MIN" 8225 "Fid_AFSCD_tAir2_MIN" 8226 "Fid_AOHt_AltErr_MIN" 8227 "Fid_AOHt_ShutOffErr_MIN" 8228 "Fid_APP1_MIN" 8229 "Fid_APP2_MIN" 8230 "Fid_APPKickdown_MIN" 8231 "Fid_APSCD_MIN" 8232 "Fid_ARSOff_MIN" 8233 "Fid_ASDdc_MIN" 8234 "Fid_ASModSwtOffEng_MIN" 8235 "Fid_ASModSwtOffIndVol_MIN" 8236 "Fid_AccPed_MIN" 8237 "Fid_AccPedBrkPres_MIN" 8238 "Fid_AccPedVel_MIN" 8239 "Fid_AccPed_Brk_MIN" 8240 "Fid_AirCtl_MIN" 8241 "Fid_AirCtlCorrAlt_MIN" 8242 "Fid_AirCtlDyn_MIN" 8243 "Fid_AirCtlNeg_MIN" 8244 "Fid_AirCtlNeg2_MIN" 8245 "Fid_AirCtlPFltEGRRed_MIN" 8246 "Fid_AirCtlPlateBreak_MIN" 8247 "Fid_AirCtlPlateBreakAct_MIN" 8248 "Fid_AirCtlPos_MIN" 8249 "Fid_AirCtlPos2_MIN" 8250 "Fid_AirCtl_Brk_MIN" 8251 "Fid_AirCtl_Gear_MIN" 8252 "Fid_BPSCDMon_MIN" 8253 "Fid_CTSCDFlTemp_MIN" 8254 "Fid_CTSCD_Plaus_MIN" 8255 "Fid_ClgDynTst_MIN" 8256 "Fid_CmbChb_MIN" 8257 "Fid_CoDT_GripDeb_MIN" 8258 "Fid_CoDT_Mon_MIN" 8259 "Fid_CoDT_TRQ_MIN" 8260 "Fid_CoEngIRevSys1_MIN" 8261 "Fid_CoEngIRevSys2_MIN" 8262 "Fid_CoEngIRevVeh_MIN" 8263 "Fid_CoEngPFltErr_MIN" 8264 "Fid_CoEngPFltOvldErr_MIN" 8265 "Fid_CoEngRevSys1_MIN" 8266 "Fid_CoEngRevSys2_MIN" 8267 "Fid_CoEngRevVeh_MIN" 8268 "Fid_CoEngShOffTst_MIN" 8269 "Fid_CoEngSoftShOffTV_MIN" 8270 "Fid_CoEng_ActrPrt_MIN" 8271 "Fid_CoEng_Nrml2Strt_MIN" 8272 "Fid_CoEng_PwrStgEnable_MIN" 8273 "Fid_CoEng_trqLimErr_MIN" 8274 "Fid_CoEng_trqLimErr1_MIN" 8275 "Fid_CoEng_trqLimErr2_MIN" 8276 "Fid_CoEng_trqLimErr3_MIN" 8277 "Fid_CoEng_trqLimErr4_MIN" 8278 "Fid_CoVM_StabDem_Err_MIN" 8279 "Fid_CoVehtrqLimErr_MIN" 8280 "Fid_CpBVlvOff_MIN" 8281 "Fid_CrCtlShutOffIr_MIN" 8282 "Fid_CrCtl_ASCTimeout_MIN" 8283 "Fid_CrCtl_CanDef_MIN" 8284 "Fid_CrCtl_KombiTimeout_MIN" 8285 "Fid_CrCtl_vCrCtl_MIN" 8286 "Fid_DSM_Wuc_MIN" 8287 "Fid_EATSCDTSubs_MIN" 8288 "Fid_EBAFCD_MIN" 8289 "Fid_EBFCD_MIN" 8290 "Fid_ECU_MIN" 8291 "Fid_EGSysCoLSU0_MIN" 8292 "Fid_EGSysCoNSC_MIN" 8293 "Fid_EGSysCoOxi_MIN" 8294 "Fid_EGSysCoTrbn_MIN" 8295 "Fid_EGSysCoTube0_MIN" 8296 "Fid_EGSysCoTube1_MIN" 8297 "Fid_EGSysHtgDel_MIN" 8298 "Fid_EGSysMaxTOxiPreB1_MIN" 8299 "Fid_EGSysMaxTOxiPreB2_MIN" 8300 "Fid_EGSysMaxTPreB1_MIN" 8301 "Fid_EGSysMaxTPreB2_MIN" 8302 "Fid_EGSysMaxTPreRgnB1_MIN" 8303 "Fid_EGSysMaxTPreRgnB2_MIN" 8304 "Fid_EGSysMxTOxiPreRgnB1_MIN" 8305 "Fid_EGSysMxTOxiPreRgnB2_MIN" 8306 "Fid_EGSysNSC_MIN" 8307 "Fid_EGSysOxiCat_MIN" 8308 "Fid_EGSysPresEnv_MIN" 8309 "Fid_EGSysStrt_MIN" 8310 "Fid_EGSysTemp_MIN" 8311 "Fid_EGSysTrbn_MIN" 8312 "Fid_EGSysTube_MIN" 8313 "Fid_EGSys_AP_MIN" 8314 "Fid_EGTRgnLck_MIN" 8315 "Fid_EGTTempGvnrAirCtl_MIN" 8316 "Fid_EGTTempGvnrInrB1_MIN" 8317 "Fid_EGTTempGvnrInrB2_MIN" 8318 "Fid_EGTTempGvnrOutrB1_MIN" 8319 "Fid_EGTTempGvnrOutrB2_MIN" 8320 "Fid_ETClbCorActv_MIN" 8321 "Fid_EngCTSCD_MIN" 8322 "Fid_EngMCaS1_MIN" 8323 "Fid_EngMCaSBackUp_MIN" 8324 "Fid_EngMCrS1_MIN" 8325 "Fid_EngMCrSBackUp_MIN" 8326 "Fid_EngMTEng_MIN" 8327 "Fid_EngMTrqFrcPDiff_MIN" 8328 "Fid_EngMVVeh_MIN" 8329 "Fid_EngM_ChkStrtSpd_MIN" 8330 "Fid_EngPrt_nLimErr_MIN" 8331 "Fid_FBC_MIN" 8332 "Fid_FBCMonI_MIN" 8333 "Fid_FMASwtOff1_MIN" 8334 "Fid_FMASwtOff2_MIN" 8335 "Fid_FMASwtOff3_MIN" 8336 "Fid_FMTC_AirCorr_MIN" 8337 "Fid_FMTC_PCRCorr_MIN" 8338 "Fid_FMTC_SOECorr_MIN" 8339 "Fid_FTSCDErr_MIN" 8340 "Fid_FanCtl_MIN" 8341 "Fid_FanGbxOil_MIN" 8342 "Fid_FlMngFullLdRglOff_MIN" 8343 "Fid_FlMngSmkDefect_MIN" 8344 "Fid_FlMngTPFltErr_MIN" 8345 "Fid_FlSysCTSSens_MIN" 8346 "Fid_FlSysDens_MIN" 8347 "Fid_FlSysFTSSens_MIN" 8348 "Fid_FrmMngAOHt_MIN" 8349 "Fid_FrmMngAPP_MIN" 8350 "Fid_FrmMngARS_MIN" 8351 "Fid_FrmMngAddLevl_MIN" 8352 "Fid_FrmMngBrk_MIN" 8353 "Fid_FrmMngBrkDef_MIN" 8354 "Fid_FrmMngCoEng_MIN" 8355 "Fid_FrmMngCoEng_St2_MIN" 8356 "Fid_FrmMngConvDef_MIN" 8357 "Fid_FrmMngEngOvrSpd_MIN" 8358 "Fid_FrmMngEngRpmTemp_MIN" 8359 "Fid_FrmMngEngSpd_MIN" 8360 "Fid_FrmMngInjDU1_MIN" 8361 "Fid_FrmMngInjDU2_MIN" 8362 "Fid_FrmMngInjVlv_MIN" 8363 "Fid_FrmMngOBDCtl_MIN" 8364 "Fid_FrmMngPFltDef_MIN" 8365 "Fid_FrmMngParkConsumer_MIN" 8366 "Fid_FrmMngPla_DSC_MIN" 8367 "Fid_FrmMngPla_EGS_MIN" 8368 "Fid_FrmMngPowerTrainCAN_MIN" 8369 "Fid_FrmMngPrvCan_MIN" 8370 "Fid_FrmMngPwrMngLIGovSt_MIN" 8371 "Fid_FrmMngRpmRduc_MIN" 8372 "Fid_FrmMngSIG_ARS_MIN" 8373 "Fid_FrmMngSIG_DSC_MIN" 8374 "Fid_FrmMngSig_EGS_MIN" 8375 "Fid_FrmMngTO_ARS_MIN" 8376 "Fid_FrmMngTO_DSC_MIN" 8377 "Fid_FrmMngTo_EGS_MIN" 8378 "Fid_FrmMngTrqGearbx_MIN" 8379 "Fid_FrmMngWaterVlv_MIN" 8380 "Fid_FrmMng_ST_TORQ_MIN" 8381 "Fid_FrmMng_stTrq_MIN" 8382 "Fid_FrmMngnSetpoint_MIN" 8383 "Fid_FrmMngpVal_MIN" 8384 "Fid_FrmMngtEng_MIN" 8385 "Fid_GearbxDrvAway_MIN" 8386 "Fid_GearbxDrvAwayInactv_MIN" 8387 "Fid_GearbxNmin_MIN" 8388 "Fid_GearbxPtCANErr_MIN" 8389 "Fid_GearbxSlip_MIN" 8390 "Fid_GearbxTrqLimErr_MIN" 8391 "Fid_Gearbx_GearDet_MIN" 8392 "Fid_Gearbx_TrqIntv_Err_MIN" 8393 "Fid_GlwCtl1_MIN" 8394 "Fid_GlwCtl2_MIN" 8395 "Fid_GlwCtl3_MIN" 8396 "Fid_HDC_MIN" 8397 "Fid_IATSCD_MIN" 8398 "Fid_IATSCD_tAir1_MIN" 8399 "Fid_IATSCD_tAir2_MIN" 8400 "Fid_IndSys1_MIN" 8401 "Fid_IndSys2_MIN" 8402 "Fid_InjCrvCoErr_MIN" 8403 "Fid_InjCrvCylOffs_MIN" 8404 "Fid_InjCtl_qLimErr_MIN" 8405 "Fid_InjVCDActrEnrgTemp_MIN" 8406 "Fid_InjVCDCls_MIN" 8407 "Fid_InjVCDTPUErr_MIN" 8408 "Fid_InjVlvActrTemp_MIN" 8409 "Fid_InjVlvInjLim_MIN" 8410 "Fid_InjVlvMon_MIN" 8411 "Fid_InjVlvNVC_MIN" 8412 "Fid_InjVlvSetUpVolt_MIN" 8413 "Fid_InjVlvWvCorOff_MIN" 8414 "Fid_LIGovSetpointDrvAwy_MIN" 8415 "Fid_LIGovUbr_MIN" 8416 "Fid_LSUCDMon0_MIN" 8417 "Fid_LSUCDO20_MIN" 8418 "Fid_LSUCDRi0_MIN" 8419 "Fid_LSUCDactiv0_MIN" 8420 "Fid_LSUCDlsu0_MIN" 8421 "Fid_LSUClbSched_MIN" 8422 "Fid_LSUCtl0_MIN" 8423 "Fid_LSUMonAllChecks_MIN" 8424 "Fid_LSUMonPlausChk_MIN" 8425 "Fid_Layer_FI_TANS_MIN" 8426 "Fid_Layer_FI_TUMG_MIN" 8427 "Fid_Layer_MANHYDR_MIN" 8428 "Fid_Layer_MANLUFT_MIN" 8429 "Fid_MSCDPrivCan_MIN" 8430 "Fid_MSMonNetMngPtCan_MIN" 8431 "Fid_MSMonPFlt1_MIN" 8432 "Fid_MSMonPFlt2_MIN" 8433 "Fid_MSMonPFlt3_MIN" 8434 "Fid_MSMonPFlt4_MIN" 8435 "Fid_MSMonStEGS_MIN" 8436 "Fid_MSMon_ARS_TO_MIN" 8437 "Fid_MSMon_CanDef_MIN" 8438 "Fid_MSMon_DSC_TO_MIN" 8439 "Fid_MSMon_EGS_TO_MIN" 8440 "Fid_MSMon_FrmMngPT_MIN" 8441 "Fid_MSMon_FrmMngPT2_MIN" 8442 "Fid_MSMon_trqOff_MIN" 8443 "Fid_MSidCD_ECU_MIN" 8444 "Fid_MSidCD_Pin_MIN" 8445 "Fid_MeUnCDCalcI_MIN" 8446 "Fid_Mil_MIN" 8447 "Fid_OTSCD_MIN" 8448 "Fid_OxiCat_pPreCat_MIN" 8449 "Fid_PCBSPFltDef_MIN" 8450 "Fid_PCR_MIN" 8451 "Fid_PCRBalGvnr_MIN" 8452 "Fid_PCRBalGvnrP40Corr_MIN" 8453 "Fid_PCRExtnLimActr_MIN" 8454 "Fid_PCRGvnrDvtNeg_MIN" 8455 "Fid_PCRGvnrDvtPos_MIN" 8456 "Fid_PCRLPGvnrDvtNeg_MIN" 8457 "Fid_PCRLPGvnrDvtPos_MIN" 8458 "Fid_PCRSurgeGvnr_MIN" 8459 "Fid_PCRSurgeLIGov_MIN" 8460 "Fid_PCR_LP_MIN" 8461 "Fid_PCR_LPMS_MIN" 8462 "Fid_PCR_MS_MIN" 8463 "Fid_PCR_SurgeDet_MIN" 8464 "Fid_PCVCDCalcI_MIN" 8465 "Fid_PFltAshCor_MIN" 8466 "Fid_PFltAshCorRgn_MIN" 8467 "Fid_PFltBrk_MIN" 8468 "Fid_PFltCharB1_MIN" 8469 "Fid_PFltCharB2_MIN" 8470 "Fid_PFltChngParB1_MIN" 8471 "Fid_PFltChngParB2_MIN" 8472 "Fid_PFltClth_MIN" 8473 "Fid_PFltDynChkB1_MIN" 8474 "Fid_PFltDynChkB2_MIN" 8475 "Fid_PFltEngPrtRgnMon_MIN" 8476 "Fid_PFltGearDet_MIN" 8477 "Fid_PFltHsLnChkB1_MIN" 8478 "Fid_PFltHsLnChkB2_MIN" 8479 "Fid_PFltLckRgnErr_MIN" 8480 "Fid_PFltLckRgnFuel_MIN" 8481 "Fid_PFltNumPFltErr_MIN" 8482 "Fid_PFltNumPFltErrLck_MIN" 8483 "Fid_PFltPlausPresB1_MIN" 8484 "Fid_PFltPlausPresB2_MIN" 8485 "Fid_PFltPlausTempB1_MIN" 8486 "Fid_PFltPlausTempB2_MIN" 8487 "Fid_PFltPresPlausProj_MIN" 8488 "Fid_PFltPresSensFrz_MIN" 8489 "Fid_PFltPresSensHsLnB1_MIN" 8490 "Fid_PFltPresSensHsLnB2_MIN" 8491 "Fid_PFltPresSensPreB1_MIN" 8492 "Fid_PFltPresSensPreB2_MIN" 8493 "Fid_PFltSRCPresB1_MIN" 8494 "Fid_PFltSRCPresB2_MIN" 8495 "Fid_PFltSRCTempB1_MIN" 8496 "Fid_PFltSRCTempB2_MIN" 8497 "Fid_PFltSimOnB1_MIN" 8498 "Fid_PFltSimOnB2_MIN" 8499 "Fid_PFltSpdVeh_MIN" 8500 "Fid_PFltSucB1_MIN" 8501 "Fid_PFltSucB2_MIN" 8502 "Fid_PFltTOxiPreDiffB1_MIN" 8503 "Fid_PFltTOxiPreDiffB2_MIN" 8504 "Fid_PFltTPreDiffB1_MIN" 8505 "Fid_PFltTPreDiffB2_MIN" 8506 "Fid_PFltTempAir_MIN" 8507 "Fid_PFltTempClnt_MIN" 8508 "Fid_PFltTempOxiPreB1_MIN" 8509 "Fid_PFltTempOxiPreB2_MIN" 8510 "Fid_PFltTempOxiPstB1_MIN" 8511 "Fid_PFltTempOxiPstB2_MIN" 8512 "Fid_PFltTempPreB1_MIN" 8513 "Fid_PFltTempPreB2_MIN" 8514 "Fid_PFltTempSensB1_MIN" 8515 "Fid_PFltTempSensB2_MIN" 8516 "Fid_PFltTempSensFrz_MIN" 8517 "Fid_PFltTwFlwTempDev_MIN" 8518 "Fid_PFltVltgBatt_MIN" 8519 "Fid_RailCDRPSErrChk_MIN" 8520 "Fid_RailCDSubstVal_MIN" 8521 "Fid_RailCD_PMonStrt_MIN" 8522 "Fid_RailCPCtlMeUnMode_MIN" 8523 "Fid_RailCPCtlPCVMode_MIN" 8524 "Fid_RailCtlMode_MIN" 8525 "Fid_RailMeUn0Blk_MIN" 8526 "Fid_RailMeUn0Rls_MIN" 8527 "Fid_RailMeUn1Blk_MIN" 8528 "Fid_RailMeUn1Rls_MIN" 8529 "Fid_RailMeUn2Blk_MIN" 8530 "Fid_RailMeUn2Rls_MIN" 8531 "Fid_RailMeUn3Blk_MIN" 8532 "Fid_RailMeUn3Rls_MIN" 8533 "Fid_RailMeUn4Blk_MIN" 8534 "Fid_RailMeUn4Rls_MIN" 8535 "Fid_RailMeUnCtlMode_MIN" 8536 "Fid_RailPCV0Blk_MIN" 8537 "Fid_RailPCV0Rls_MIN" 8538 "Fid_RailPCV1Blk_MIN" 8539 "Fid_RailPCV1Rls_MIN" 8540 "Fid_RailPCV2Blk_MIN" 8541 "Fid_RailPCV2Rls_MIN" 8542 "Fid_RailPCV3Blk_MIN" 8543 "Fid_RailPCV3Rls_MIN" 8544 "Fid_RailPCV4Blk_MIN" 8545 "Fid_RailPCV4Rls_MIN" 8546 "Fid_RailPCV5Blk_MIN" 8547 "Fid_RailPCV5Rls_MIN" 8548 "Fid_RailPCVCtlMode_MIN" 8549 "Fid_RailSetPointLim_MIN" 8550 "Fid_RailSetPointRed_MIN" 8551 "Fid_SignalsTstNLim_MIN" 8552 "Fid_StSysImmo_MIN" 8553 "Fid_StSysStrtTipGbxDat_MIN" 8554 "Fid_SysLamp_MIN" 8555 "Fid_T15CDCanError_MIN" 8556 "Fid_T50CDSig_MIN" 8557 "Fid_TVACD_AirMonOff_MIN" 8558 "Fid_ThrVlvMon_MIN" 8559 "Fid_VSACDDioInDia_MIN" 8560 "Fid_VSSCD_Tx_MIN" 8561 "Fid_VehDaDist_MIN" 8562 "Fid_ZFCClbActv_MIN" 8563 "Fid_ZFCCldCmbCham_MIN" 16385 "Fid_ACCIRevErr_SIG" 16386 "Fid_ACCRevErr_SIG" 16387 "Fid_ACC_AliveErr_SIG" 16388 "Fid_ACC_CanDef_SIG" 16389 "Fid_ACC_CsErr_SIG" 16390 "Fid_ACC_TiOutErr_SIG" 16391 "Fid_ACCtl_ACTrqErr_SIG" 16392 "Fid_ACCtl_CTSErr_SIG" 16393 "Fid_ACCtl_FanErr_SIG" 16394 "Fid_ACCtl_TGearbxErr_SIG" 16395 "Fid_ACCtl_VSSErr_SIG" 16396 "Fid_AFSCD_SIG" 16397 "Fid_AFSCD2_SIG" 16398 "Fid_AFSCD_AirPerCyl_SIG" 16399 "Fid_AFSCD_AirPerCyl2_SIG" 16400 "Fid_AFSCD_AirPerTime_SIG" 16401 "Fid_AFSCD_AirPerTime2_SIG" 16402 "Fid_AFSCD_BPSCDErr_SIG" 16403 "Fid_AFSCD_PlAirPerCylDifOff_SIG" 16404 "Fid_AFSCD_PlOffsDrft_SIG" 16405 "Fid_AFSCD_PlOffsDrft2_SIG" 16406 "Fid_AFSCD_PlSetyDrft_SIG" 16407 "Fid_AFSCD_PlSetyDrft2_SIG" 16408 "Fid_AFSCD_SRCCorrAirm_SIG" 16409 "Fid_AFSCD_SRCCorrAirm2_SIG" 16410 "Fid_AFSCD_SRCDcyc_SIG" 16411 "Fid_AFSCD_SRCDcyc2_SIG" 16412 "Fid_AFSCD_SRCRawAirm_SIG" 16413 "Fid_AFSCD_SRCRawAirm2_SIG" 16414 "Fid_AFSCD_SRCRefSig_SIG" 16415 "Fid_AFSCD_SRCRefSig2_SIG" 16416 "Fid_AFSCD_tAir1_SIG" 16417 "Fid_AFSCD_tAir2_SIG" 16418 "Fid_AOHt_AltErr_SIG" 16419 "Fid_AOHt_ShutOffErr_SIG" 16420 "Fid_APP1_SIG" 16421 "Fid_APP2_SIG" 16422 "Fid_APPKickdown_SIG" 16423 "Fid_APSCD_SIG" 16424 "Fid_ARSOff_SIG" 16425 "Fid_ASDdc_SIG" 16426 "Fid_ASModSwtOffEng_SIG" 16427 "Fid_ASModSwtOffIndVol_SIG" 16428 "Fid_AccPed_SIG" 16429 "Fid_AccPedBrkPres_SIG" 16430 "Fid_AccPedVel_SIG" 16431 "Fid_AccPed_Brk_SIG" 16432 "Fid_AirCtl_SIG" 16433 "Fid_AirCtlCorrAlt_SIG" 16434 "Fid_AirCtlDyn_SIG" 16435 "Fid_AirCtlNeg_SIG" 16436 "Fid_AirCtlNeg2_SIG" 16437 "Fid_AirCtlPFltEGRRed_SIG" 16438 "Fid_AirCtlPlateBreak_SIG" 16439 "Fid_AirCtlPlateBreakAct_SIG" 16440 "Fid_AirCtlPos_SIG" 16441 "Fid_AirCtlPos2_SIG" 16442 "Fid_AirCtl_Brk_SIG" 16443 "Fid_AirCtl_Gear_SIG" 16444 "Fid_BPSCDMon_SIG" 16445 "Fid_CTSCDFlTemp_SIG" 16446 "Fid_CTSCD_Plaus_SIG" 16447 "Fid_ClgDynTst_SIG" 16448 "Fid_CmbChb_SIG" 16449 "Fid_CoDT_GripDeb_SIG" 16450 "Fid_CoDT_Mon_SIG" 16451 "Fid_CoDT_TRQ_SIG" 16452 "Fid_CoEngIRevSys1_SIG" 16453 "Fid_CoEngIRevSys2_SIG" 16454 "Fid_CoEngIRevVeh_SIG" 16455 "Fid_CoEngPFltErr_SIG" 16456 "Fid_CoEngPFltOvldErr_SIG" 16457 "Fid_CoEngRevSys1_SIG" 16458 "Fid_CoEngRevSys2_SIG" 16459 "Fid_CoEngRevVeh_SIG" 16460 "Fid_CoEngShOffTst_SIG" 16461 "Fid_CoEngSoftShOffTV_SIG" 16462 "Fid_CoEng_ActrPrt_SIG" 16463 "Fid_CoEng_Nrml2Strt_SIG" 16464 "Fid_CoEng_PwrStgEnable_SIG" 16465 "Fid_CoEng_trqLimErr_SIG" 16466 "Fid_CoEng_trqLimErr1_SIG" 16467 "Fid_CoEng_trqLimErr2_SIG" 16468 "Fid_CoEng_trqLimErr3_SIG" 16469 "Fid_CoEng_trqLimErr4_SIG" 16470 "Fid_CoVM_StabDem_Err_SIG" 16471 "Fid_CoVehtrqLimErr_SIG" 16472 "Fid_CpBVlvOff_SIG" 16473 "Fid_CrCtlShutOffIr_SIG" 16474 "Fid_CrCtl_ASCTimeout_SIG" 16475 "Fid_CrCtl_CanDef_SIG" 16476 "Fid_CrCtl_KombiTimeout_SIG" 16477 "Fid_CrCtl_vCrCtl_SIG" 16478 "Fid_DSM_Wuc_SIG" 16479 "Fid_EATSCDTSubs_SIG" 16480 "Fid_EBAFCD_SIG" 16481 "Fid_EBFCD_SIG" 16482 "Fid_ECU_SIG" 16483 "Fid_EGSysCoLSU0_SIG" 16484 "Fid_EGSysCoNSC_SIG" 16485 "Fid_EGSysCoOxi_SIG" 16486 "Fid_EGSysCoTrbn_SIG" 16487 "Fid_EGSysCoTube0_SIG" 16488 "Fid_EGSysCoTube1_SIG" 16489 "Fid_EGSysHtgDel_SIG" 16490 "Fid_EGSysMaxTOxiPreB1_SIG" 16491 "Fid_EGSysMaxTOxiPreB2_SIG" 16492 "Fid_EGSysMaxTPreB1_SIG" 16493 "Fid_EGSysMaxTPreB2_SIG" 16494 "Fid_EGSysMaxTPreRgnB1_SIG" 16495 "Fid_EGSysMaxTPreRgnB2_SIG" 16496 "Fid_EGSysMxTOxiPreRgnB1_SIG" 16497 "Fid_EGSysMxTOxiPreRgnB2_SIG" 16498 "Fid_EGSysNSC_SIG" 16499 "Fid_EGSysOxiCat_SIG" 16500 "Fid_EGSysPresEnv_SIG" 16501 "Fid_EGSysStrt_SIG" 16502 "Fid_EGSysTemp_SIG" 16503 "Fid_EGSysTrbn_SIG" 16504 "Fid_EGSysTube_SIG" 16505 "Fid_EGSys_AP_SIG" 16506 "Fid_EGTRgnLck_SIG" 16507 "Fid_EGTTempGvnrAirCtl_SIG" 16508 "Fid_EGTTempGvnrInrB1_SIG" 16509 "Fid_EGTTempGvnrInrB2_SIG" 16510 "Fid_EGTTempGvnrOutrB1_SIG" 16511 "Fid_EGTTempGvnrOutrB2_SIG" 16512 "Fid_ETClbCorActv_SIG" 16513 "Fid_EngCTSCD_SIG" 16514 "Fid_EngMCaS1_SIG" 16515 "Fid_EngMCaSBackUp_SIG" 16516 "Fid_EngMCrS1_SIG" 16517 "Fid_EngMCrSBackUp_SIG" 16518 "Fid_EngMTEng_SIG" 16519 "Fid_EngMTrqFrcPDiff_SIG" 16520 "Fid_EngMVVeh_SIG" 16521 "Fid_EngM_ChkStrtSpd_SIG" 16522 "Fid_EngPrt_nLimErr_SIG" 16523 "Fid_FBC_SIG" 16524 "Fid_FBCMonI_SIG" 16525 "Fid_FMASwtOff1_SIG" 16526 "Fid_FMASwtOff2_SIG" 16527 "Fid_FMASwtOff3_SIG" 16528 "Fid_FMTC_AirCorr_SIG" 16529 "Fid_FMTC_PCRCorr_SIG" 16530 "Fid_FMTC_SOECorr_SIG" 16531 "Fid_FTSCDErr_SIG" 16532 "Fid_FanCtl_SIG" 16533 "Fid_FanGbxOil_SIG" 16534 "Fid_FlMngFullLdRglOff_SIG" 16535 "Fid_FlMngSmkDefect_SIG" 16536 "Fid_FlMngTPFltErr_SIG" 16537 "Fid_FlSysCTSSens_SIG" 16538 "Fid_FlSysDens_SIG" 16539 "Fid_FlSysFTSSens_SIG" 16540 "Fid_FrmMngAOHt_SIG" 16541 "Fid_FrmMngAPP_SIG" 16542 "Fid_FrmMngARS_SIG" 16543 "Fid_FrmMngAddLevl_SIG" 16544 "Fid_FrmMngBrk_SIG" 16545 "Fid_FrmMngBrkDef_SIG" 16546 "Fid_FrmMngCoEng_SIG" 16547 "Fid_FrmMngCoEng_St2_SIG" 16548 "Fid_FrmMngConvDef_SIG" 16549 "Fid_FrmMngEngOvrSpd_SIG" 16550 "Fid_FrmMngEngRpmTemp_SIG" 16551 "Fid_FrmMngEngSpd_SIG" 16552 "Fid_FrmMngInjDU1_SIG" 16553 "Fid_FrmMngInjDU2_SIG" 16554 "Fid_FrmMngInjVlv_SIG" 16555 "Fid_FrmMngOBDCtl_SIG" 16556 "Fid_FrmMngPFltDef_SIG" 16557 "Fid_FrmMngParkConsumer_SIG" 16558 "Fid_FrmMngPla_DSC_SIG" 16559 "Fid_FrmMngPla_EGS_SIG" 16560 "Fid_FrmMngPowerTrainCAN_SIG" 16561 "Fid_FrmMngPrvCan_SIG" 16562 "Fid_FrmMngPwrMngLIGovSt_SIG" 16563 "Fid_FrmMngRpmRduc_SIG" 16564 "Fid_FrmMngSIG_ARS_SIG" 16565 "Fid_FrmMngSIG_DSC_SIG" 16566 "Fid_FrmMngSig_EGS_SIG" 16567 "Fid_FrmMngTO_ARS_SIG" 16568 "Fid_FrmMngTO_DSC_SIG" 16569 "Fid_FrmMngTo_EGS_SIG" 16570 "Fid_FrmMngTrqGearbx_SIG" 16571 "Fid_FrmMngWaterVlv_SIG" 16572 "Fid_FrmMng_ST_TORQ_SIG" 16573 "Fid_FrmMng_stTrq_SIG" 16574 "Fid_FrmMngnSetpoint_SIG" 16575 "Fid_FrmMngpVal_SIG" 16576 "Fid_FrmMngtEng_SIG" 16577 "Fid_GearbxDrvAway_SIG" 16578 "Fid_GearbxDrvAwayInactv_SIG" 16579 "Fid_GearbxNmin_SIG" 16580 "Fid_GearbxPtCANErr_SIG" 16581 "Fid_GearbxSlip_SIG" 16582 "Fid_GearbxTrqLimErr_SIG" 16583 "Fid_Gearbx_GearDet_SIG" 16584 "Fid_Gearbx_TrqIntv_Err_SIG" 16585 "Fid_GlwCtl1_SIG" 16586 "Fid_GlwCtl2_SIG" 16587 "Fid_GlwCtl3_SIG" 16588 "Fid_HDC_SIG" 16589 "Fid_IATSCD_SIG" 16590 "Fid_IATSCD_tAir1_SIG" 16591 "Fid_IATSCD_tAir2_SIG" 16592 "Fid_IndSys1_SIG" 16593 "Fid_IndSys2_SIG" 16594 "Fid_InjCrvCoErr_SIG" 16595 "Fid_InjCrvCylOffs_SIG" 16596 "Fid_InjCtl_qLimErr_SIG" 16597 "Fid_InjVCDActrEnrgTemp_SIG" 16598 "Fid_InjVCDCls_SIG" 16599 "Fid_InjVCDTPUErr_SIG" 16600 "Fid_InjVlvActrTemp_SIG" 16601 "Fid_InjVlvInjLim_SIG" 16602 "Fid_InjVlvMon_SIG" 16603 "Fid_InjVlvNVC_SIG" 16604 "Fid_InjVlvSetUpVolt_SIG" 16605 "Fid_InjVlvWvCorOff_SIG" 16606 "Fid_LIGovSetpointDrvAwy_SIG" 16607 "Fid_LIGovUbr_SIG" 16608 "Fid_LSUCDMon0_SIG" 16609 "Fid_LSUCDO20_SIG" 16610 "Fid_LSUCDRi0_SIG" 16611 "Fid_LSUCDactiv0_SIG" 16612 "Fid_LSUCDlsu0_SIG" 16613 "Fid_LSUClbSched_SIG" 16614 "Fid_LSUCtl0_SIG" 16615 "Fid_LSUMonAllChecks_SIG" 16616 "Fid_LSUMonPlausChk_SIG" 16617 "Fid_Layer_FI_TANS_SIG" 16618 "Fid_Layer_FI_TUMG_SIG" 16619 "Fid_Layer_MANHYDR_SIG" 16620 "Fid_Layer_MANLUFT_SIG" 16621 "Fid_MSCDPrivCan_SIG" 16622 "Fid_MSMonNetMngPtCan_SIG" 16623 "Fid_MSMonPFlt1_SIG" 16624 "Fid_MSMonPFlt2_SIG" 16625 "Fid_MSMonPFlt3_SIG" 16626 "Fid_MSMonPFlt4_SIG" 16627 "Fid_MSMonStEGS_SIG" 16628 "Fid_MSMon_ARS_TO_SIG" 16629 "Fid_MSMon_CanDef_SIG" 16630 "Fid_MSMon_DSC_TO_SIG" 16631 "Fid_MSMon_EGS_TO_SIG" 16632 "Fid_MSMon_FrmMngPT_SIG" 16633 "Fid_MSMon_FrmMngPT2_SIG" 16634 "Fid_MSMon_trqOff_SIG" 16635 "Fid_MSidCD_ECU_SIG" 16636 "Fid_MSidCD_Pin_SIG" 16637 "Fid_MeUnCDCalcI_SIG" 16638 "Fid_Mil_SIG" 16639 "Fid_OTSCD_SIG" 16640 "Fid_OxiCat_pPreCat_SIG" 16641 "Fid_PCBSPFltDef_SIG" 16642 "Fid_PCR_SIG" 16643 "Fid_PCRBalGvnr_SIG" 16644 "Fid_PCRBalGvnrP40Corr_SIG" 16645 "Fid_PCRExtnLimActr_SIG" 16646 "Fid_PCRGvnrDvtNeg_SIG" 16647 "Fid_PCRGvnrDvtPos_SIG" 16648 "Fid_PCRLPGvnrDvtNeg_SIG" 16649 "Fid_PCRLPGvnrDvtPos_SIG" 16650 "Fid_PCRSurgeGvnr_SIG" 16651 "Fid_PCRSurgeLIGov_SIG" 16652 "Fid_PCR_LP_SIG" 16653 "Fid_PCR_LPMS_SIG" 16654 "Fid_PCR_MS_SIG" 16655 "Fid_PCR_SurgeDet_SIG" 16656 "Fid_PCVCDCalcI_SIG" 16657 "Fid_PFltAshCor_SIG" 16658 "Fid_PFltAshCorRgn_SIG" 16659 "Fid_PFltBrk_SIG" 16660 "Fid_PFltCharB1_SIG" 16661 "Fid_PFltCharB2_SIG" 16662 "Fid_PFltChngParB1_SIG" 16663 "Fid_PFltChngParB2_SIG" 16664 "Fid_PFltClth_SIG" 16665 "Fid_PFltDynChkB1_SIG" 16666 "Fid_PFltDynChkB2_SIG" 16667 "Fid_PFltEngPrtRgnMon_SIG" 16668 "Fid_PFltGearDet_SIG" 16669 "Fid_PFltHsLnChkB1_SIG" 16670 "Fid_PFltHsLnChkB2_SIG" 16671 "Fid_PFltLckRgnErr_SIG" 16672 "Fid_PFltLckRgnFuel_SIG" 16673 "Fid_PFltNumPFltErr_SIG" 16674 "Fid_PFltNumPFltErrLck_SIG" 16675 "Fid_PFltPlausPresB1_SIG" 16676 "Fid_PFltPlausPresB2_SIG" 16677 "Fid_PFltPlausTempB1_SIG" 16678 "Fid_PFltPlausTempB2_SIG" 16679 "Fid_PFltPresPlausProj_SIG" 16680 "Fid_PFltPresSensFrz_SIG" 16681 "Fid_PFltPresSensHsLnB1_SIG" 16682 "Fid_PFltPresSensHsLnB2_SIG" 16683 "Fid_PFltPresSensPreB1_SIG" 16684 "Fid_PFltPresSensPreB2_SIG" 16685 "Fid_PFltSRCPresB1_SIG" 16686 "Fid_PFltSRCPresB2_SIG" 16687 "Fid_PFltSRCTempB1_SIG" 16688 "Fid_PFltSRCTempB2_SIG" 16689 "Fid_PFltSimOnB1_SIG" 16690 "Fid_PFltSimOnB2_SIG" 16691 "Fid_PFltSpdVeh_SIG" 16692 "Fid_PFltSucB1_SIG" 16693 "Fid_PFltSucB2_SIG" 16694 "Fid_PFltTOxiPreDiffB1_SIG" 16695 "Fid_PFltTOxiPreDiffB2_SIG" 16696 "Fid_PFltTPreDiffB1_SIG" 16697 "Fid_PFltTPreDiffB2_SIG" 16698 "Fid_PFltTempAir_SIG" 16699 "Fid_PFltTempClnt_SIG" 16700 "Fid_PFltTempOxiPreB1_SIG" 16701 "Fid_PFltTempOxiPreB2_SIG" 16702 "Fid_PFltTempOxiPstB1_SIG" 16703 "Fid_PFltTempOxiPstB2_SIG" 16704 "Fid_PFltTempPreB1_SIG" 16705 "Fid_PFltTempPreB2_SIG" 16706 "Fid_PFltTempSensB1_SIG" 16707 "Fid_PFltTempSensB2_SIG" 16708 "Fid_PFltTempSensFrz_SIG" 16709 "Fid_PFltTwFlwTempDev_SIG" 16710 "Fid_PFltVltgBatt_SIG" 16711 "Fid_RailCDRPSErrChk_SIG" 16712 "Fid_RailCDSubstVal_SIG" 16713 "Fid_RailCD_PMonStrt_SIG" 16714 "Fid_RailCPCtlMeUnMode_SIG" 16715 "Fid_RailCPCtlPCVMode_SIG" 16716 "Fid_RailCtlMode_SIG" 16717 "Fid_RailMeUn0Blk_SIG" 16718 "Fid_RailMeUn0Rls_SIG" 16719 "Fid_RailMeUn1Blk_SIG" 16720 "Fid_RailMeUn1Rls_SIG" 16721 "Fid_RailMeUn2Blk_SIG" 16722 "Fid_RailMeUn2Rls_SIG" 16723 "Fid_RailMeUn3Blk_SIG" 16724 "Fid_RailMeUn3Rls_SIG" 16725 "Fid_RailMeUn4Blk_SIG" 16726 "Fid_RailMeUn4Rls_SIG" 16727 "Fid_RailMeUnCtlMode_SIG" 16728 "Fid_RailPCV0Blk_SIG" 16729 "Fid_RailPCV0Rls_SIG" 16730 "Fid_RailPCV1Blk_SIG" 16731 "Fid_RailPCV1Rls_SIG" 16732 "Fid_RailPCV2Blk_SIG" 16733 "Fid_RailPCV2Rls_SIG" 16734 "Fid_RailPCV3Blk_SIG" 16735 "Fid_RailPCV3Rls_SIG" 16736 "Fid_RailPCV4Blk_SIG" 16737 "Fid_RailPCV4Rls_SIG" 16738 "Fid_RailPCV5Blk_SIG" 16739 "Fid_RailPCV5Rls_SIG" 16740 "Fid_RailPCVCtlMode_SIG" 16741 "Fid_RailSetPointLim_SIG" 16742 "Fid_RailSetPointRed_SIG" 16743 "Fid_SignalsTstNLim_SIG" 16744 "Fid_StSysImmo_SIG" 16745 "Fid_StSysStrtTipGbxDat_SIG" 16746 "Fid_SysLamp_SIG" 16747 "Fid_T15CDCanError_SIG" 16748 "Fid_T50CDSig_SIG" 16749 "Fid_TVACD_AirMonOff_SIG" 16750 "Fid_ThrVlvMon_SIG" 16751 "Fid_VSACDDioInDia_SIG" 16752 "Fid_VSSCD_Tx_SIG" 16753 "Fid_VehDaDist_SIG" 16754 "Fid_ZFCClbActv_SIG" 16755 "Fid_ZFCCldCmbCham_SIG" 32769 "Fid_ACCIRevErr_NPL" 32770 "Fid_ACCRevErr_NPL" 32771 "Fid_ACC_AliveErr_NPL" 32772 "Fid_ACC_CanDef_NPL" 32773 "Fid_ACC_CsErr_NPL" 32774 "Fid_ACC_TiOutErr_NPL" 32775 "Fid_ACCtl_ACTrqErr_NPL" 32776 "Fid_ACCtl_CTSErr_NPL" 32777 "Fid_ACCtl_FanErr_NPL" 32778 "Fid_ACCtl_TGearbxErr_NPL" 32779 "Fid_ACCtl_VSSErr_NPL" 32780 "Fid_AFSCD_NPL" 32781 "Fid_AFSCD2_NPL" 32782 "Fid_AFSCD_AirPerCyl_NPL" 32783 "Fid_AFSCD_AirPerCyl2_NPL" 32784 "Fid_AFSCD_AirPerTime_NPL" 32785 "Fid_AFSCD_AirPerTime2_NPL" 32786 "Fid_AFSCD_BPSCDErr_NPL" 32787 "Fid_AFSCD_PlAirPerCylDifOff_NPL" 32788 "Fid_AFSCD_PlOffsDrft_NPL" 32789 "Fid_AFSCD_PlOffsDrft2_NPL" 32790 "Fid_AFSCD_PlSetyDrft_NPL" 32791 "Fid_AFSCD_PlSetyDrft2_NPL" 32792 "Fid_AFSCD_SRCCorrAirm_NPL" 32793 "Fid_AFSCD_SRCCorrAirm2_NPL" 32794 "Fid_AFSCD_SRCDcyc_NPL" 32795 "Fid_AFSCD_SRCDcyc2_NPL" 32796 "Fid_AFSCD_SRCRawAirm_NPL" 32797 "Fid_AFSCD_SRCRawAirm2_NPL" 32798 "Fid_AFSCD_SRCRefSig_NPL" 32799 "Fid_AFSCD_SRCRefSig2_NPL" 32800 "Fid_AFSCD_tAir1_NPL" 32801 "Fid_AFSCD_tAir2_NPL" 32802 "Fid_AOHt_AltErr_NPL" 32803 "Fid_AOHt_ShutOffErr_NPL" 32804 "Fid_APP1_NPL" 32805 "Fid_APP2_NPL" 32806 "Fid_APPKickdown_NPL" 32807 "Fid_APSCD_NPL" 32808 "Fid_ARSOff_NPL" 32809 "Fid_ASDdc_NPL" 32810 "Fid_ASModSwtOffEng_NPL" 32811 "Fid_ASModSwtOffIndVol_NPL" 32812 "Fid_AccPed_NPL" 32813 "Fid_AccPedBrkPres_NPL" 32814 "Fid_AccPedVel_NPL" 32815 "Fid_AccPed_Brk_NPL" 32816 "Fid_AirCtl_NPL" 32817 "Fid_AirCtlCorrAlt_NPL" 32818 "Fid_AirCtlDyn_NPL" 32819 "Fid_AirCtlNeg_NPL" 32820 "Fid_AirCtlNeg2_NPL" 32821 "Fid_AirCtlPFltEGRRed_NPL" 32822 "Fid_AirCtlPlateBreak_NPL" 32823 "Fid_AirCtlPlateBreakAct_NPL" 32824 "Fid_AirCtlPos_NPL" 32825 "Fid_AirCtlPos2_NPL" 32826 "Fid_AirCtl_Brk_NPL" 32827 "Fid_AirCtl_Gear_NPL" 32828 "Fid_BPSCDMon_NPL" 32829 "Fid_CTSCDFlTemp_NPL" 32830 "Fid_CTSCD_Plaus_NPL" 32831 "Fid_ClgDynTst_NPL" 32832 "Fid_CmbChb_NPL" 32833 "Fid_CoDT_GripDeb_NPL" 32834 "Fid_CoDT_Mon_NPL" 32835 "Fid_CoDT_TRQ_NPL" 32836 "Fid_CoEngIRevSys1_NPL" 32837 "Fid_CoEngIRevSys2_NPL" 32838 "Fid_CoEngIRevVeh_NPL" 32839 "Fid_CoEngPFltErr_NPL" 32840 "Fid_CoEngPFltOvldErr_NPL" 32841 "Fid_CoEngRevSys1_NPL" 32842 "Fid_CoEngRevSys2_NPL" 32843 "Fid_CoEngRevVeh_NPL" 32844 "Fid_CoEngShOffTst_NPL" 32845 "Fid_CoEngSoftShOffTV_NPL" 32846 "Fid_CoEng_ActrPrt_NPL" 32847 "Fid_CoEng_Nrml2Strt_NPL" 32848 "Fid_CoEng_PwrStgEnable_NPL" 32849 "Fid_CoEng_trqLimErr_NPL" 32850 "Fid_CoEng_trqLimErr1_NPL" 32851 "Fid_CoEng_trqLimErr2_NPL" 32852 "Fid_CoEng_trqLimErr3_NPL" 32853 "Fid_CoEng_trqLimErr4_NPL" 32854 "Fid_CoVM_StabDem_Err_NPL" 32855 "Fid_CoVehtrqLimErr_NPL" 32856 "Fid_CpBVlvOff_NPL" 32857 "Fid_CrCtlShutOffIr_NPL" 32858 "Fid_CrCtl_ASCTimeout_NPL" 32859 "Fid_CrCtl_CanDef_NPL" 32860 "Fid_CrCtl_KombiTimeout_NPL" 32861 "Fid_CrCtl_vCrCtl_NPL" 32862 "Fid_DSM_Wuc_NPL" 32863 "Fid_EATSCDTSubs_NPL" 32864 "Fid_EBAFCD_NPL" 32865 "Fid_EBFCD_NPL" 32866 "Fid_ECU_NPL" 32867 "Fid_EGSysCoLSU0_NPL" 32868 "Fid_EGSysCoNSC_NPL" 32869 "Fid_EGSysCoOxi_NPL" 32870 "Fid_EGSysCoTrbn_NPL" 32871 "Fid_EGSysCoTube0_NPL" 32872 "Fid_EGSysCoTube1_NPL" 32873 "Fid_EGSysHtgDel_NPL" 32874 "Fid_EGSysMaxTOxiPreB1_NPL" 32875 "Fid_EGSysMaxTOxiPreB2_NPL" 32876 "Fid_EGSysMaxTPreB1_NPL" 32877 "Fid_EGSysMaxTPreB2_NPL" 32878 "Fid_EGSysMaxTPreRgnB1_NPL" 32879 "Fid_EGSysMaxTPreRgnB2_NPL" 32880 "Fid_EGSysMxTOxiPreRgnB1_NPL" 32881 "Fid_EGSysMxTOxiPreRgnB2_NPL" 32882 "Fid_EGSysNSC_NPL" 32883 "Fid_EGSysOxiCat_NPL" 32884 "Fid_EGSysPresEnv_NPL" 32885 "Fid_EGSysStrt_NPL" 32886 "Fid_EGSysTemp_NPL" 32887 "Fid_EGSysTrbn_NPL" 32888 "Fid_EGSysTube_NPL" 32889 "Fid_EGSys_AP_NPL" 32890 "Fid_EGTRgnLck_NPL" 32891 "Fid_EGTTempGvnrAirCtl_NPL" 32892 "Fid_EGTTempGvnrInrB1_NPL" 32893 "Fid_EGTTempGvnrInrB2_NPL" 32894 "Fid_EGTTempGvnrOutrB1_NPL" 32895 "Fid_EGTTempGvnrOutrB2_NPL" 32896 "Fid_ETClbCorActv_NPL" 32897 "Fid_EngCTSCD_NPL" 32898 "Fid_EngMCaS1_NPL" 32899 "Fid_EngMCaSBackUp_NPL" 32900 "Fid_EngMCrS1_NPL" 32901 "Fid_EngMCrSBackUp_NPL" 32902 "Fid_EngMTEng_NPL" 32903 "Fid_EngMTrqFrcPDiff_NPL" 32904 "Fid_EngMVVeh_NPL" 32905 "Fid_EngM_ChkStrtSpd_NPL" 32906 "Fid_EngPrt_nLimErr_NPL" 32907 "Fid_FBC_NPL" 32908 "Fid_FBCMonI_NPL" 32909 "Fid_FMASwtOff1_NPL" 32910 "Fid_FMASwtOff2_NPL" 32911 "Fid_FMASwtOff3_NPL" 32912 "Fid_FMTC_AirCorr_NPL" 32913 "Fid_FMTC_PCRCorr_NPL" 32914 "Fid_FMTC_SOECorr_NPL" 32915 "Fid_FTSCDErr_NPL" 32916 "Fid_FanCtl_NPL" 32917 "Fid_FanGbxOil_NPL" 32918 "Fid_FlMngFullLdRglOff_NPL" 32919 "Fid_FlMngSmkDefect_NPL" 32920 "Fid_FlMngTPFltErr_NPL" 32921 "Fid_FlSysCTSSens_NPL" 32922 "Fid_FlSysDens_NPL" 32923 "Fid_FlSysFTSSens_NPL" 32924 "Fid_FrmMngAOHt_NPL" 32925 "Fid_FrmMngAPP_NPL" 32926 "Fid_FrmMngARS_NPL" 32927 "Fid_FrmMngAddLevl_NPL" 32928 "Fid_FrmMngBrk_NPL" 32929 "Fid_FrmMngBrkDef_NPL" 32930 "Fid_FrmMngCoEng_NPL" 32931 "Fid_FrmMngCoEng_St2_NPL" 32932 "Fid_FrmMngConvDef_NPL" 32933 "Fid_FrmMngEngOvrSpd_NPL" 32934 "Fid_FrmMngEngRpmTemp_NPL" 32935 "Fid_FrmMngEngSpd_NPL" 32936 "Fid_FrmMngInjDU1_NPL" 32937 "Fid_FrmMngInjDU2_NPL" 32938 "Fid_FrmMngInjVlv_NPL" 32939 "Fid_FrmMngOBDCtl_NPL" 32940 "Fid_FrmMngPFltDef_NPL" 32941 "Fid_FrmMngParkConsumer_NPL" 32942 "Fid_FrmMngPla_DSC_NPL" 32943 "Fid_FrmMngPla_EGS_NPL" 32944 "Fid_FrmMngPowerTrainCAN_NPL" 32945 "Fid_FrmMngPrvCan_NPL" 32946 "Fid_FrmMngPwrMngLIGovSt_NPL" 32947 "Fid_FrmMngRpmRduc_NPL" 32948 "Fid_FrmMngSIG_ARS_NPL" 32949 "Fid_FrmMngSIG_DSC_NPL" 32950 "Fid_FrmMngSig_EGS_NPL" 32951 "Fid_FrmMngTO_ARS_NPL" 32952 "Fid_FrmMngTO_DSC_NPL" 32953 "Fid_FrmMngTo_EGS_NPL" 32954 "Fid_FrmMngTrqGearbx_NPL" 32955 "Fid_FrmMngWaterVlv_NPL" 32956 "Fid_FrmMng_ST_TORQ_NPL" 32957 "Fid_FrmMng_stTrq_NPL" 32958 "Fid_FrmMngnSetpoint_NPL" 32959 "Fid_FrmMngpVal_NPL" 32960 "Fid_FrmMngtEng_NPL" 32961 "Fid_GearbxDrvAway_NPL" 32962 "Fid_GearbxDrvAwayInactv_NPL" 32963 "Fid_GearbxNmin_NPL" 32964 "Fid_GearbxPtCANErr_NPL" 32965 "Fid_GearbxSlip_NPL" 32966 "Fid_GearbxTrqLimErr_NPL" 32967 "Fid_Gearbx_GearDet_NPL" 32968 "Fid_Gearbx_TrqIntv_Err_NPL" 32969 "Fid_GlwCtl1_NPL" 32970 "Fid_GlwCtl2_NPL" 32971 "Fid_GlwCtl3_NPL" 32972 "Fid_HDC_NPL" 32973 "Fid_IATSCD_NPL" 32974 "Fid_IATSCD_tAir1_NPL" 32975 "Fid_IATSCD_tAir2_NPL" 32976 "Fid_IndSys1_NPL" 32977 "Fid_IndSys2_NPL" 32978 "Fid_InjCrvCoErr_NPL" 32979 "Fid_InjCrvCylOffs_NPL" 32980 "Fid_InjCtl_qLimErr_NPL" 32981 "Fid_InjVCDActrEnrgTemp_NPL" 32982 "Fid_InjVCDCls_NPL" 32983 "Fid_InjVCDTPUErr_NPL" 32984 "Fid_InjVlvActrTemp_NPL" 32985 "Fid_InjVlvInjLim_NPL" 32986 "Fid_InjVlvMon_NPL" 32987 "Fid_InjVlvNVC_NPL" 32988 "Fid_InjVlvSetUpVolt_NPL" 32989 "Fid_InjVlvWvCorOff_NPL" 32990 "Fid_LIGovSetpointDrvAwy_NPL" 32991 "Fid_LIGovUbr_NPL" 32992 "Fid_LSUCDMon0_NPL" 32993 "Fid_LSUCDO20_NPL" 32994 "Fid_LSUCDRi0_NPL" 32995 "Fid_LSUCDactiv0_NPL" 32996 "Fid_LSUCDlsu0_NPL" 32997 "Fid_LSUClbSched_NPL" 32998 "Fid_LSUCtl0_NPL" 32999 "Fid_LSUMonAllChecks_NPL" 33000 "Fid_LSUMonPlausChk_NPL" 33001 "Fid_Layer_FI_TANS_NPL" 33002 "Fid_Layer_FI_TUMG_NPL" 33003 "Fid_Layer_MANHYDR_NPL" 33004 "Fid_Layer_MANLUFT_NPL" 33005 "Fid_MSCDPrivCan_NPL" 33006 "Fid_MSMonNetMngPtCan_NPL" 33007 "Fid_MSMonPFlt1_NPL" 33008 "Fid_MSMonPFlt2_NPL" 33009 "Fid_MSMonPFlt3_NPL" 33010 "Fid_MSMonPFlt4_NPL" 33011 "Fid_MSMonStEGS_NPL" 33012 "Fid_MSMon_ARS_TO_NPL" 33013 "Fid_MSMon_CanDef_NPL" 33014 "Fid_MSMon_DSC_TO_NPL" 33015 "Fid_MSMon_EGS_TO_NPL" 33016 "Fid_MSMon_FrmMngPT_NPL" 33017 "Fid_MSMon_FrmMngPT2_NPL" 33018 "Fid_MSMon_trqOff_NPL" 33019 "Fid_MSidCD_ECU_NPL" 33020 "Fid_MSidCD_Pin_NPL" 33021 "Fid_MeUnCDCalcI_NPL" 33022 "Fid_Mil_NPL" 33023 "Fid_OTSCD_NPL" 33024 "Fid_OxiCat_pPreCat_NPL" 33025 "Fid_PCBSPFltDef_NPL" 33026 "Fid_PCR_NPL" 33027 "Fid_PCRBalGvnr_NPL" 33028 "Fid_PCRBalGvnrP40Corr_NPL" 33029 "Fid_PCRExtnLimActr_NPL" 33030 "Fid_PCRGvnrDvtNeg_NPL" 33031 "Fid_PCRGvnrDvtPos_NPL" 33032 "Fid_PCRLPGvnrDvtNeg_NPL" 33033 "Fid_PCRLPGvnrDvtPos_NPL" 33034 "Fid_PCRSurgeGvnr_NPL" 33035 "Fid_PCRSurgeLIGov_NPL" 33036 "Fid_PCR_LP_NPL" 33037 "Fid_PCR_LPMS_NPL" 33038 "Fid_PCR_MS_NPL" 33039 "Fid_PCR_SurgeDet_NPL" 33040 "Fid_PCVCDCalcI_NPL" 33041 "Fid_PFltAshCor_NPL" 33042 "Fid_PFltAshCorRgn_NPL" 33043 "Fid_PFltBrk_NPL" 33044 "Fid_PFltCharB1_NPL" 33045 "Fid_PFltCharB2_NPL" 33046 "Fid_PFltChngParB1_NPL" 33047 "Fid_PFltChngParB2_NPL" 33048 "Fid_PFltClth_NPL" 33049 "Fid_PFltDynChkB1_NPL" 33050 "Fid_PFltDynChkB2_NPL" 33051 "Fid_PFltEngPrtRgnMon_NPL" 33052 "Fid_PFltGearDet_NPL" 33053 "Fid_PFltHsLnChkB1_NPL" 33054 "Fid_PFltHsLnChkB2_NPL" 33055 "Fid_PFltLckRgnErr_NPL" 33056 "Fid_PFltLckRgnFuel_NPL" 33057 "Fid_PFltNumPFltErr_NPL" 33058 "Fid_PFltNumPFltErrLck_NPL" 33059 "Fid_PFltPlausPresB1_NPL" 33060 "Fid_PFltPlausPresB2_NPL" 33061 "Fid_PFltPlausTempB1_NPL" 33062 "Fid_PFltPlausTempB2_NPL" 33063 "Fid_PFltPresPlausProj_NPL" 33064 "Fid_PFltPresSensFrz_NPL" 33065 "Fid_PFltPresSensHsLnB1_NPL" 33066 "Fid_PFltPresSensHsLnB2_NPL" 33067 "Fid_PFltPresSensPreB1_NPL" 33068 "Fid_PFltPresSensPreB2_NPL" 33069 "Fid_PFltSRCPresB1_NPL" 33070 "Fid_PFltSRCPresB2_NPL" 33071 "Fid_PFltSRCTempB1_NPL" 33072 "Fid_PFltSRCTempB2_NPL" 33073 "Fid_PFltSimOnB1_NPL" 33074 "Fid_PFltSimOnB2_NPL" 33075 "Fid_PFltSpdVeh_NPL" 33076 "Fid_PFltSucB1_NPL" 33077 "Fid_PFltSucB2_NPL" 33078 "Fid_PFltTOxiPreDiffB1_NPL" 33079 "Fid_PFltTOxiPreDiffB2_NPL" 33080 "Fid_PFltTPreDiffB1_NPL" 33081 "Fid_PFltTPreDiffB2_NPL" 33082 "Fid_PFltTempAir_NPL" 33083 "Fid_PFltTempClnt_NPL" 33084 "Fid_PFltTempOxiPreB1_NPL" 33085 "Fid_PFltTempOxiPreB2_NPL" 33086 "Fid_PFltTempOxiPstB1_NPL" 33087 "Fid_PFltTempOxiPstB2_NPL" 33088 "Fid_PFltTempPreB1_NPL" 33089 "Fid_PFltTempPreB2_NPL" 33090 "Fid_PFltTempSensB1_NPL" 33091 "Fid_PFltTempSensB2_NPL" 33092 "Fid_PFltTempSensFrz_NPL" 33093 "Fid_PFltTwFlwTempDev_NPL" 33094 "Fid_PFltVltgBatt_NPL" 33095 "Fid_RailCDRPSErrChk_NPL" 33096 "Fid_RailCDSubstVal_NPL" 33097 "Fid_RailCD_PMonStrt_NPL" 33098 "Fid_RailCPCtlMeUnMode_NPL" 33099 "Fid_RailCPCtlPCVMode_NPL" 33100 "Fid_RailCtlMode_NPL" 33101 "Fid_RailMeUn0Blk_NPL" 33102 "Fid_RailMeUn0Rls_NPL" 33103 "Fid_RailMeUn1Blk_NPL" 33104 "Fid_RailMeUn1Rls_NPL" 33105 "Fid_RailMeUn2Blk_NPL" 33106 "Fid_RailMeUn2Rls_NPL" 33107 "Fid_RailMeUn3Blk_NPL" 33108 "Fid_RailMeUn3Rls_NPL" 33109 "Fid_RailMeUn4Blk_NPL" 33110 "Fid_RailMeUn4Rls_NPL" 33111 "Fid_RailMeUnCtlMode_NPL" 33112 "Fid_RailPCV0Blk_NPL" 33113 "Fid_RailPCV0Rls_NPL" 33114 "Fid_RailPCV1Blk_NPL" 33115 "Fid_RailPCV1Rls_NPL" 33116 "Fid_RailPCV2Blk_NPL" 33117 "Fid_RailPCV2Rls_NPL" 33118 "Fid_RailPCV3Blk_NPL" 33119 "Fid_RailPCV3Rls_NPL" 33120 "Fid_RailPCV4Blk_NPL" 33121 "Fid_RailPCV4Rls_NPL" 33122 "Fid_RailPCV5Blk_NPL" 33123 "Fid_RailPCV5Rls_NPL" 33124 "Fid_RailPCVCtlMode_NPL" 33125 "Fid_RailSetPointLim_NPL" 33126 "Fid_RailSetPointRed_NPL" 33127 "Fid_SignalsTstNLim_NPL" 33128 "Fid_StSysImmo_NPL" 33129 "Fid_StSysStrtTipGbxDat_NPL" 33130 "Fid_SysLamp_NPL" 33131 "Fid_T15CDCanError_NPL" 33132 "Fid_T50CDSig_NPL" 33133 "Fid_TVACD_AirMonOff_NPL" 33134 "Fid_ThrVlvMon_NPL" 33135 "Fid_VSACDDioInDia_NPL" 33136 "Fid_VSSCD_Tx_NPL" 33137 "Fid_VehDaDist_NPL" 33138 "Fid_ZFCClbActv_NPL" 33139 "Fid_ZFCCldCmbCham_NPL" 61441 "Fid_ACCIRevErr" 61442 "Fid_ACCRevErr" 61443 "Fid_ACC_AliveErr" 61444 "Fid_ACC_CanDef" 61445 "Fid_ACC_CsErr" 61446 "Fid_ACC_TiOutErr" 61447 "Fid_ACCtl_ACTrqErr" 61448 "Fid_ACCtl_CTSErr" 61449 "Fid_ACCtl_FanErr" 61450 "Fid_ACCtl_TGearbxErr" 61451 "Fid_ACCtl_VSSErr" 61452 "Fid_AFSCD" 61453 "Fid_AFSCD2" 61454 "Fid_AFSCD_AirPerCyl" 61455 "Fid_AFSCD_AirPerCyl2" 61456 "Fid_AFSCD_AirPerTime" 61457 "Fid_AFSCD_AirPerTime2" 61458 "Fid_AFSCD_BPSCDErr" 61459 "Fid_AFSCD_PlAirPerCylDifOff" 61460 "Fid_AFSCD_PlOffsDrft" 61461 "Fid_AFSCD_PlOffsDrft2" 61462 "Fid_AFSCD_PlSetyDrft" 61463 "Fid_AFSCD_PlSetyDrft2" 61464 "Fid_AFSCD_SRCCorrAirm" 61465 "Fid_AFSCD_SRCCorrAirm2" 61466 "Fid_AFSCD_SRCDcyc" 61467 "Fid_AFSCD_SRCDcyc2" 61468 "Fid_AFSCD_SRCRawAirm" 61469 "Fid_AFSCD_SRCRawAirm2" 61470 "Fid_AFSCD_SRCRefSig" 61471 "Fid_AFSCD_SRCRefSig2" 61472 "Fid_AFSCD_tAir1" 61473 "Fid_AFSCD_tAir2" 61474 "Fid_AOHt_AltErr" 61475 "Fid_AOHt_ShutOffErr" 61476 "Fid_APP1" 61477 "Fid_APP2" 61478 "Fid_APPKickdown" 61479 "Fid_APSCD" 61480 "Fid_ARSOff" 61481 "Fid_ASDdc" 61482 "Fid_ASModSwtOffEng" 61483 "Fid_ASModSwtOffIndVol" 61484 "Fid_AccPed" 61485 "Fid_AccPedBrkPres" 61486 "Fid_AccPedVel" 61487 "Fid_AccPed_Brk" 61488 "Fid_AirCtl" 61489 "Fid_AirCtlCorrAlt" 61490 "Fid_AirCtlDyn" 61491 "Fid_AirCtlNeg" 61492 "Fid_AirCtlNeg2" 61493 "Fid_AirCtlPFltEGRRed" 61494 "Fid_AirCtlPlateBreak" 61495 "Fid_AirCtlPlateBreakAct" 61496 "Fid_AirCtlPos" 61497 "Fid_AirCtlPos2" 61498 "Fid_AirCtl_Brk" 61499 "Fid_AirCtl_Gear" 61500 "Fid_BPSCDMon" 61501 "Fid_CTSCDFlTemp" 61502 "Fid_CTSCD_Plaus" 61503 "Fid_ClgDynTst" 61504 "Fid_CmbChb" 61505 "Fid_CoDT_GripDeb" 61506 "Fid_CoDT_Mon" 61507 "Fid_CoDT_TRQ" 61508 "Fid_CoEngIRevSys1" 61509 "Fid_CoEngIRevSys2" 61510 "Fid_CoEngIRevVeh" 61511 "Fid_CoEngPFltErr" 61512 "Fid_CoEngPFltOvldErr" 61513 "Fid_CoEngRevSys1" 61514 "Fid_CoEngRevSys2" 61515 "Fid_CoEngRevVeh" 61516 "Fid_CoEngShOffTst" 61517 "Fid_CoEngSoftShOffTV" 61518 "Fid_CoEng_ActrPrt" 61519 "Fid_CoEng_Nrml2Strt" 61520 "Fid_CoEng_PwrStgEnable" 61521 "Fid_CoEng_trqLimErr" 61522 "Fid_CoEng_trqLimErr1" 61523 "Fid_CoEng_trqLimErr2" 61524 "Fid_CoEng_trqLimErr3" 61525 "Fid_CoEng_trqLimErr4" 61526 "Fid_CoVM_StabDem_Err" 61527 "Fid_CoVehtrqLimErr" 61528 "Fid_CpBVlvOff" 61529 "Fid_CrCtlShutOffIr" 61530 "Fid_CrCtl_ASCTimeout" 61531 "Fid_CrCtl_CanDef" 61532 "Fid_CrCtl_KombiTimeout" 61533 "Fid_CrCtl_vCrCtl" 61534 "Fid_DSM_Wuc" 61535 "Fid_EATSCDTSubs" 61536 "Fid_EBAFCD" 61537 "Fid_EBFCD" 61538 "Fid_ECU" 61539 "Fid_EGSysCoLSU0" 61540 "Fid_EGSysCoNSC" 61541 "Fid_EGSysCoOxi" 61542 "Fid_EGSysCoTrbn" 61543 "Fid_EGSysCoTube0" 61544 "Fid_EGSysCoTube1" 61545 "Fid_EGSysHtgDel" 61546 "Fid_EGSysMaxTOxiPreB1" 61547 "Fid_EGSysMaxTOxiPreB2" 61548 "Fid_EGSysMaxTPreB1" 61549 "Fid_EGSysMaxTPreB2" 61550 "Fid_EGSysMaxTPreRgnB1" 61551 "Fid_EGSysMaxTPreRgnB2" 61552 "Fid_EGSysMxTOxiPreRgnB1" 61553 "Fid_EGSysMxTOxiPreRgnB2" 61554 "Fid_EGSysNSC" 61555 "Fid_EGSysOxiCat" 61556 "Fid_EGSysPresEnv" 61557 "Fid_EGSysStrt" 61558 "Fid_EGSysTemp" 61559 "Fid_EGSysTrbn" 61560 "Fid_EGSysTube" 61561 "Fid_EGSys_AP" 61562 "Fid_EGTRgnLck" 61563 "Fid_EGTTempGvnrAirCtl" 61564 "Fid_EGTTempGvnrInrB1" 61565 "Fid_EGTTempGvnrInrB2" 61566 "Fid_EGTTempGvnrOutrB1" 61567 "Fid_EGTTempGvnrOutrB2" 61568 "Fid_ETClbCorActv" 61569 "Fid_EngCTSCD" 61570 "Fid_EngMCaS1" 61571 "Fid_EngMCaSBackUp" 61572 "Fid_EngMCrS1" 61573 "Fid_EngMCrSBackUp" 61574 "Fid_EngMTEng" 61575 "Fid_EngMTrqFrcPDiff" 61576 "Fid_EngMVVeh" 61577 "Fid_EngM_ChkStrtSpd" 61578 "Fid_EngPrt_nLimErr" 61579 "Fid_FBC" 61580 "Fid_FBCMonI" 61581 "Fid_FMASwtOff1" 61582 "Fid_FMASwtOff2" 61583 "Fid_FMASwtOff3" 61584 "Fid_FMTC_AirCorr" 61585 "Fid_FMTC_PCRCorr" 61586 "Fid_FMTC_SOECorr" 61587 "Fid_FTSCDErr" 61588 "Fid_FanCtl" 61589 "Fid_FanGbxOil" 61590 "Fid_FlMngFullLdRglOff" 61591 "Fid_FlMngSmkDefect" 61592 "Fid_FlMngTPFltErr" 61593 "Fid_FlSysCTSSens" 61594 "Fid_FlSysDens" 61595 "Fid_FlSysFTSSens" 61596 "Fid_FrmMngAOHt" 61597 "Fid_FrmMngAPP" 61598 "Fid_FrmMngARS" 61599 "Fid_FrmMngAddLevl" 61600 "Fid_FrmMngBrk" 61601 "Fid_FrmMngBrkDef" 61602 "Fid_FrmMngCoEng" 61603 "Fid_FrmMngCoEng_St2" 61604 "Fid_FrmMngConvDef" 61605 "Fid_FrmMngEngOvrSpd" 61606 "Fid_FrmMngEngRpmTemp" 61607 "Fid_FrmMngEngSpd" 61608 "Fid_FrmMngInjDU1" 61609 "Fid_FrmMngInjDU2" 61610 "Fid_FrmMngInjVlv" 61611 "Fid_FrmMngOBDCtl" 61612 "Fid_FrmMngPFltDef" 61613 "Fid_FrmMngParkConsumer" 61614 "Fid_FrmMngPla_DSC" 61615 "Fid_FrmMngPla_EGS" 61616 "Fid_FrmMngPowerTrainCAN" 61617 "Fid_FrmMngPrvCan" 61618 "Fid_FrmMngPwrMngLIGovSt" 61619 "Fid_FrmMngRpmRduc" 61620 "Fid_FrmMngSIG_ARS" 61621 "Fid_FrmMngSIG_DSC" 61622 "Fid_FrmMngSig_EGS" 61623 "Fid_FrmMngTO_ARS" 61624 "Fid_FrmMngTO_DSC" 61625 "Fid_FrmMngTo_EGS" 61626 "Fid_FrmMngTrqGearbx" 61627 "Fid_FrmMngWaterVlv" 61628 "Fid_FrmMng_ST_TORQ" 61629 "Fid_FrmMng_stTrq" 61630 "Fid_FrmMngnSetpoint" 61631 "Fid_FrmMngpVal" 61632 "Fid_FrmMngtEng" 61633 "Fid_GearbxDrvAway" 61634 "Fid_GearbxDrvAwayInactv" 61635 "Fid_GearbxNmin" 61636 "Fid_GearbxPtCANErr" 61637 "Fid_GearbxSlip" 61638 "Fid_GearbxTrqLimErr" 61639 "Fid_Gearbx_GearDet" 61640 "Fid_Gearbx_TrqIntv_Err" 61641 "Fid_GlwCtl1" 61642 "Fid_GlwCtl2" 61643 "Fid_GlwCtl3" 61644 "Fid_HDC" 61645 "Fid_IATSCD" 61646 "Fid_IATSCD_tAir1" 61647 "Fid_IATSCD_tAir2" 61648 "Fid_IndSys1" 61649 "Fid_IndSys2" 61650 "Fid_InjCrvCoErr" 61651 "Fid_InjCrvCylOffs" 61652 "Fid_InjCtl_qLimErr" 61653 "Fid_InjVCDActrEnrgTemp" 61654 "Fid_InjVCDCls" 61655 "Fid_InjVCDTPUErr" 61656 "Fid_InjVlvActrTemp" 61657 "Fid_InjVlvInjLim" 61658 "Fid_InjVlvMon" 61659 "Fid_InjVlvNVC" 61660 "Fid_InjVlvSetUpVolt" 61661 "Fid_InjVlvWvCorOff" 61662 "Fid_LIGovSetpointDrvAwy" 61663 "Fid_LIGovUbr" 61664 "Fid_LSUCDMon0" 61665 "Fid_LSUCDO20" 61666 "Fid_LSUCDRi0" 61667 "Fid_LSUCDactiv0" 61668 "Fid_LSUCDlsu0" 61669 "Fid_LSUClbSched" 61670 "Fid_LSUCtl0" 61671 "Fid_LSUMonAllChecks" 61672 "Fid_LSUMonPlausChk" 61673 "Fid_Layer_FI_TANS" 61674 "Fid_Layer_FI_TUMG" 61675 "Fid_Layer_MANHYDR" 61676 "Fid_Layer_MANLUFT" 61677 "Fid_MSCDPrivCan" 61678 "Fid_MSMonNetMngPtCan" 61679 "Fid_MSMonPFlt1" 61680 "Fid_MSMonPFlt2" 61681 "Fid_MSMonPFlt3" 61682 "Fid_MSMonPFlt4" 61683 "Fid_MSMonStEGS" 61684 "Fid_MSMon_ARS_TO" 61685 "Fid_MSMon_CanDef" 61686 "Fid_MSMon_DSC_TO" 61687 "Fid_MSMon_EGS_TO" 61688 "Fid_MSMon_FrmMngPT" 61689 "Fid_MSMon_FrmMngPT2" 61690 "Fid_MSMon_trqOff" 61691 "Fid_MSidCD_ECU" 61692 "Fid_MSidCD_Pin" 61693 "Fid_MeUnCDCalcI" 61694 "Fid_Mil" 61695 "Fid_OTSCD" 61696 "Fid_OxiCat_pPreCat" 61697 "Fid_PCBSPFltDef" 61698 "Fid_PCR" 61699 "Fid_PCRBalGvnr" 61700 "Fid_PCRBalGvnrP40Corr" 61701 "Fid_PCRExtnLimActr" 61702 "Fid_PCRGvnrDvtNeg" 61703 "Fid_PCRGvnrDvtPos" 61704 "Fid_PCRLPGvnrDvtNeg" 61705 "Fid_PCRLPGvnrDvtPos" 61706 "Fid_PCRSurgeGvnr" 61707 "Fid_PCRSurgeLIGov" 61708 "Fid_PCR_LP" 61709 "Fid_PCR_LPMS" 61710 "Fid_PCR_MS" 61711 "Fid_PCR_SurgeDet" 61712 "Fid_PCVCDCalcI" 61713 "Fid_PFltAshCor" 61714 "Fid_PFltAshCorRgn" 61715 "Fid_PFltBrk" 61716 "Fid_PFltCharB1" 61717 "Fid_PFltCharB2" 61718 "Fid_PFltChngParB1" 61719 "Fid_PFltChngParB2" 61720 "Fid_PFltClth" 61721 "Fid_PFltDynChkB1" 61722 "Fid_PFltDynChkB2" 61723 "Fid_PFltEngPrtRgnMon" 61724 "Fid_PFltGearDet" 61725 "Fid_PFltHsLnChkB1" 61726 "Fid_PFltHsLnChkB2" 61727 "Fid_PFltLckRgnErr" 61728 "Fid_PFltLckRgnFuel" 61729 "Fid_PFltNumPFltErr" 61730 "Fid_PFltNumPFltErrLck" 61731 "Fid_PFltPlausPresB1" 61732 "Fid_PFltPlausPresB2" 61733 "Fid_PFltPlausTempB1" 61734 "Fid_PFltPlausTempB2" 61735 "Fid_PFltPresPlausProj" 61736 "Fid_PFltPresSensFrz" 61737 "Fid_PFltPresSensHsLnB1" 61738 "Fid_PFltPresSensHsLnB2" 61739 "Fid_PFltPresSensPreB1" 61740 "Fid_PFltPresSensPreB2" 61741 "Fid_PFltSRCPresB1" 61742 "Fid_PFltSRCPresB2" 61743 "Fid_PFltSRCTempB1" 61744 "Fid_PFltSRCTempB2" 61745 "Fid_PFltSimOnB1" 61746 "Fid_PFltSimOnB2" 61747 "Fid_PFltSpdVeh" 61748 "Fid_PFltSucB1" 61749 "Fid_PFltSucB2" 61750 "Fid_PFltTOxiPreDiffB1" 61751 "Fid_PFltTOxiPreDiffB2" 61752 "Fid_PFltTPreDiffB1" 61753 "Fid_PFltTPreDiffB2" 61754 "Fid_PFltTempAir" 61755 "Fid_PFltTempClnt" 61756 "Fid_PFltTempOxiPreB1" 61757 "Fid_PFltTempOxiPreB2" 61758 "Fid_PFltTempOxiPstB1" 61759 "Fid_PFltTempOxiPstB2" 61760 "Fid_PFltTempPreB1" 61761 "Fid_PFltTempPreB2" 61762 "Fid_PFltTempSensB1" 61763 "Fid_PFltTempSensB2" 61764 "Fid_PFltTempSensFrz" 61765 "Fid_PFltTwFlwTempDev" 61766 "Fid_PFltVltgBatt" 61767 "Fid_RailCDRPSErrChk" 61768 "Fid_RailCDSubstVal" 61769 "Fid_RailCD_PMonStrt" 61770 "Fid_RailCPCtlMeUnMode" 61771 "Fid_RailCPCtlPCVMode" 61772 "Fid_RailCtlMode" 61773 "Fid_RailMeUn0Blk" 61774 "Fid_RailMeUn0Rls" 61775 "Fid_RailMeUn1Blk" 61776 "Fid_RailMeUn1Rls" 61777 "Fid_RailMeUn2Blk" 61778 "Fid_RailMeUn2Rls" 61779 "Fid_RailMeUn3Blk" 61780 "Fid_RailMeUn3Rls" 61781 "Fid_RailMeUn4Blk" 61782 "Fid_RailMeUn4Rls" 61783 "Fid_RailMeUnCtlMode" 61784 "Fid_RailPCV0Blk" 61785 "Fid_RailPCV0Rls" 61786 "Fid_RailPCV1Blk" 61787 "Fid_RailPCV1Rls" 61788 "Fid_RailPCV2Blk" 61789 "Fid_RailPCV2Rls" 61790 "Fid_RailPCV3Blk" 61791 "Fid_RailPCV3Rls" 61792 "Fid_RailPCV4Blk" 61793 "Fid_RailPCV4Rls" 61794 "Fid_RailPCV5Blk" 61795 "Fid_RailPCV5Rls" 61796 "Fid_RailPCVCtlMode" 61797 "Fid_RailSetPointLim" 61798 "Fid_RailSetPointRed" 61799 "Fid_SignalsTstNLim" 61800 "Fid_StSysImmo" 61801 "Fid_StSysStrtTipGbxDat" 61802 "Fid_SysLamp" 61803 "Fid_T15CDCanError" 61804 "Fid_T50CDSig" 61805 "Fid_TVACD_AirMonOff" 61806 "Fid_ThrVlvMon" 61807 "Fid_VSACDDioInDia" 61808 "Fid_VSSCD_Tx" 61809 "Fid_VehDaDist" 61810 "Fid_ZFCClbActv" 61811 "Fid_ZFCCldCmbCham" /end COMPU_VTAB
/begin COMPU_METHOD Kd_Vel2TrqPrp "Differentialverstärkung (Fahrgeschwindigkeit zu Vortriebsmoment)" RAT_FUNC "%6.5" "Nm/(km/h)" COEFFS 0 3276.8 0 0 0 1 /end COMPU_METHOD
/begin COMPU_METHOD Ki_Vel2TrqPrp "Integralverstärkung (Fahrgeschwindigkeit zu Vortriebsmoment)" RAT_FUNC "%6.4" "Nm/(km/h)/s" COEFFS 0 214.7483648 0 0 0 1 /end COMPU_METHOD
/begin COMPU_METHOD Kp_Vel2TrqPrp "Proportionalverstärkung (Fahrgeschwindigkeit zu Vortriebsmoment)" RAT_FUNC "%6.5" "Nm/(km/h)" COEFFS 0 3276.8 0 0 0 1 /end COMPU_METHOD
/begin COMPU_METHOD NumPinAdc "verbale Umrechnung für ADC Signale" TAB_VERB "%6.3" "-" COMPU_TAB_REF NumPinAdc /end COMPU_METHOD
/begin COMPU_VTAB NumPinAdc "verbale Umrechnung für ADC Signale" TAB_VERB 61 0 "ADC_REF" 1 "Voltage_Lambda1_Ua" 2 "Voltage_Lambda1_Ri" 3 "Temperature_ECU_PCB" 4 "Voltage_Bank_1" 5 "Voltage_Bank_2" 6 "ADC_DUMMYA" 7 "1st_APP_Sensor_252" 8 "ADC_Reserve-S1" 9 "2nd_APP_Sensor_239" 10 "ADC_Reserve-S2" 11 "Water_Temperature_Sensor_182" 12 "TKS" 13 "Charge_Air_Temperature_Sensor_183_2" 14 "Exhaust_Temperature_Sensor_1_MASTER_158" 15 "Exhaust_Temperature_Sensor_1_SLAVE_158" 16 "Atmospheric_Pressure_Sensor" 17 "Charge_Air_Temperature_Sensor_183" 18 "ADC_DUMMYB_NOT_USED" 19 "Rail_Pressure_Peak_Value_156" 20 "Rail_Pressure_Peak_Value-DummySlave" 21 "Boost_Pressure_Sensor_154" 22 "Boost_Pressure_Sensor_2" 23 "Booster_Voltage_Sensor" 24 "Rail_Pressure_Sensor_156" 25 "Pressure_Upstream_Particle_Filter_MASTER_159" 26 "Pressure_Upstream_Particle_Filter_SLAVE_159" 27 "Temperature_Upstream_Particle_Filter_MASTER_134" 28 "Temperature_Upstream_Particle_Filter_SLAVE_134" 29 "Current_MeUn_Sensor" 30 "Current_PCV_Sensor" 31 "Engine_Oil_Pressure_110" 32 "Battery_Voltage_Sensor" 33 "ADC_DUMMY_SLAVE_NOT_USED" 34 "ADC_DUMMY_NOT_USED" 35 "Charge_Actuator_Event_0" 36 "Voltage_Piezo_Actuator_Bank_2_Event_0" 37 "Voltage_Piezo_Actuator_Bank_1_Event_0" 38 "Charge_Actuator_Event_1" 39 "Voltage_Piezo_Actuator_Bank_2_Event_1" 40 "Voltage_Piezo_Actuator_Bank_1_Event_1" 41 "Charge_Actuator_Event_2" 42 "Voltage_Piezo_Actuator_Bank_2_Event_2" 43 "Voltage_Piezo_Actuator_Bank_1_Event_2" 44 "Charge_Actuator_Event_3" 45 "Voltage_Piezo_Actuator_Bank_2_Event_3" 46 "Voltage_Piezo_Actuator_Bank_1_Event_3" 47 "Charge_Actuator_Event_4" 48 "Voltage_Piezo_Actuator_Bank_2_Event_4" 49 "Voltage_Piezo_Actuator_Bank_1_Event_4" 50 "Charge_Actuator_Event_5" 51 "Voltage_Piezo_Actuator_Bank_2_Event_5" 52 "Voltage_Piezo_Actuator_Bank_1_Event_5" 53 "Charge_Actuator_Event_6" 54 "Voltage_Piezo_Actuator_Bank_2_Event_6" 55 "Voltage_Piezo_Actuator_Bank_1_Event_6" 56 "Charge_Actuator_Event_7" 57 "Voltage_Piezo_Actuator_Bank_2_Event_7" 58 "Voltage_Piezo_Actuator_Bank_1_Event_7" 59 "Booster_Voltage_Piezo" 60 "Piezo_Voltage" /end COMPU_VTAB
/begin COMPU_METHOD OneToOne "eins zu eins (physikalischer Wert ist gleich dem internen Wert)" RAT_FUNC "%6.2" "-" COEFFS 0 1 0 0 0 1 /end COMPU_METHOD
/begin COMPU_METHOD Per_Dur "Periodendauer Segmentzeit" RAT_FUNC "%6.2" "usec" COEFFS 0 1 0 0 0 1 /end COMPU_METHOD
/begin COMPU_METHOD Prc "Prozent, gleiche interne Auflösung wie Fact, aber Darstellung in Prozent (0...100%)" RAT_FUNC "%6.4" "%" COEFFS 0 81.92 0 0 0 1 /end COMPU_METHOD
/begin COMPU_METHOD Prc_1000 "Prozentumrechnung mit größerer Quantisierung, dafür größerer Wertebereich" RAT_FUNC "%6.3" "%" COEFFS 0 8.192 0 0 0 1 /end COMPU_METHOD
/begin COMPU_METHOD RmpTemp "Rampengradient für Temperatur" RAT_FUNC "%6.4" "deg C/s" COEFFS 0 655.36 0 0 0 1 /end COMPU_METHOD
/begin COMPU_METHOD RmpTempCels "temperature ramp gradient in Centigrade" RAT_FUNC "%8.7" "C/ms" COEFFS 0 655360 0 0 0 1 /end COMPU_METHOD
/begin COMPU_METHOD RmpTransR "Umrechnung für die Rampensteigung des Triebstrangübersetzungverhältnisses" RAT_FUNC "%6.5" "1/s" COEFFS 0 6553.6 0 0 0 1 /end COMPU_METHOD
/begin COMPU_METHOD t20msxs_ub_b5p1 "K3 Umwandlungen" RAT_FUNC "%6.4" "s" COEFFS 0 1 0 0 0 0.02 /end COMPU_METHOD
/begin COMPU_METHOD TempCels_100ms "Temperatur Differenz in Grad C/sec (bezgl. 100ms task)" RAT_FUNC "%6.2" "deg C/s" COEFFS 0 1 0 0 0 1 /end COMPU_METHOD
/begin COMPU_METHOD Temp_Cels "Temperatur dargestellt in °C (gleiche interne Darstellung wie Temp_Kelv)" RAT_FUNC "%6.1" "deg C" COEFFS 0 10 2731.4 0 0 1 /end COMPU_METHOD
/begin COMPU_METHOD TimeDeb "Entprellzeit in Millisekunden für Libraryfunktion Debounce" RAT_FUNC "%6.1" "ms" COEFFS 0 0.1 0 0 0 1 /end COMPU_METHOD
/begin COMPU_METHOD TimeDelay_s "Zeitkonstante T1 (in s) für PT1, DT1, etc." RAT_FUNC "%9.3" "s" COEFFS 0 0 1 0 0.00023283064365387 0 /end COMPU_METHOD
/begin COMPU_METHOD TimeDT "Abtastzeit (in us) für Library Regler, Filter, etc." RAT_FUNC "%6.2" "us" COEFFS 0 1 0 0 0 1 /end COMPU_METHOD
/begin COMPU_METHOD Time_ms "Zeit in ms für Fehlerentprellung (DSM) und SW-Timer" RAT_FUNC "%6.1" "ms" COEFFS 0 0.1 0 0 0 1 /end COMPU_METHOD
/begin COMPU_METHOD TransR "Übersetzungsverhältnis (Getriebe etc.)" RAT_FUNC "%6.4" "-" COEFFS 0 100 0 0 0 1 /end COMPU_METHOD
/begin COMPU_METHOD TrqPrp "Vortriebsmoment" RAT_FUNC "%6.3" "Nm" COEFFS 0 5 0 0 0 1 /end COMPU_METHOD
/begin COMPU_METHOD Vel "Fahrzeuggeschwindigkeit, gleiche interne Auflösung wie Vel_SI" RAT_FUNC "%6.4" "km/h" COEFFS 0 100 0 0 0 1 /end COMPU_METHOD
/begin COMPU_METHOD Vel2TrqPrp "Umwandlung von Fahrgeschwindigkeit zu Vortriebsmoment" RAT_FUNC "%6.4" "Nm/(km/h)" COEFFS 0 409.6 0 0 0 1 /end COMPU_METHOD
/begin COMPU_METHOD VelToN "Verhältnis Fahrzeuggeschwindigkeit zu Motordrehzahl v/n" RAT_FUNC "%8.7" "(km/h)/rpm" COEFFS 0 100000 0 0 0 1 /end COMPU_METHOD
/begin COMPU_METHOD Volt "Spannung in V (von ADC)" RAT_FUNC "%6.2" "mV" COEFFS 0 0.2046 0 0 0 1 /end COMPU_METHOD
/begin COMPU_METHOD Volt_Batt "Batteriespannung" RAT_FUNC "%6.1" "mV" COEFFS 0 0.05115 0 0 0 1 /end COMPU_METHOD
/begin RECORD_LAYOUT Kf_Xs16_Ys16_Ws16 NO_AXIS_PTS_X 1 SWORD NO_AXIS_PTS_Y 2 SWORD AXIS_PTS_X 3 SWORD INDEX_INCR DIRECT AXIS_PTS_Y 4 SWORD INDEX_INCR DIRECT FNC_VALUES 5 SWORD COLUMN_DIR DIRECT /end RECORD_LAYOUT
/begin RECORD_LAYOUT Kl_Xs16_Ws16 NO_AXIS_PTS_X 1 SWORD AXIS_PTS_X 2 SWORD INDEX_INCR DIRECT FNC_VALUES 3 SWORD COLUMN_DIR DIRECT /end RECORD_LAYOUT
/begin RECORD_LAYOUT KwWU16 FNC_VALUES 1 UWORD COLUMN_DIR DIRECT /end RECORD_LAYOUT
/begin RECORD_LAYOUT KwWU8 FNC_VALUES 1 UBYTE COLUMN_DIR DIRECT /end RECORD_LAYOUT
/begin RECORD_LAYOUT Kw_Ws16 FNC_VALUES 1 SWORD COLUMN_DIR DIRECT /end RECORD_LAYOUT
/begin RECORD_LAYOUT Kw_Ws32 FNC_VALUES 1 SLONG COLUMN_DIR DIRECT /end RECORD_LAYOUT
/begin RECORD_LAYOUT Kw_Wu16 FNC_VALUES 1 UWORD COLUMN_DIR DIRECT /end RECORD_LAYOUT
/begin RECORD_LAYOUT Kw_Wu32 FNC_VALUES 1 ULONG COLUMN_DIR DIRECT /end RECORD_LAYOUT
/begin RECORD_LAYOUT Kw_Wu8 FNC_VALUES 1 UBYTE COLUMN_DIR DIRECT /end RECORD_LAYOUT
/end MODULE
/end PROJECT
