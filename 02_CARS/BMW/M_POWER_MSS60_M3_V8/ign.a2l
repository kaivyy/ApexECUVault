ASAP2_VERSION 1 30
/begin PROJECT MSS65-ign "Generiert am 14.10.05 um 09:57:47"
/begin HEADER "" VERSION "R341" /end HEADER
/begin MODULE _MSS65-ign "Generiert am 14.10.05 um 09:57:47"
/begin MOD_COMMON "" BYTE_ORDER MSB_FIRST ALIGNMENT_BYTE 1 ALIGNMENT_WORD 2 ALIGNMENT_LONG 4 ALIGNMENT_FLOAT32_IEEE 4 ALIGNMENT_FLOAT64_IEEE 8 /end MOD_COMMON
/begin CHARACTERISTIC K_ED_AUSS_ABG_MULT.OK_SCHWELLE "Filterschwelle fuer Fehleraustrag" VALUE 0x71517 TKW_VV_VV_UB 100.0 FORMULA_0003 0.0 255.0 /end CHARACTERISTIC
/begin CHARACTERISTIC K_ED_AUSS_ABG_MULT.P_CODE_OPENLOAD "P-Code fuer die Art OPENLOAD" VALUE 0x71512 TKW_VV_VV_UW 100.0 FORMULA_0010 0.0 65535.0 /end CHARACTERISTIC
/begin CHARACTERISTIC K_ED_AUSS_ABG_MULT.P_CODE_SH_TO_GND "P-Code fuer die Art SH_TO_GND" VALUE 0x71510 TKW_VV_VV_UW 100.0 FORMULA_0010 0.0 65535.0 /end CHARACTERISTIC
/begin CHARACTERISTIC K_ED_AUSS_ABG_MULT.P_CODE_SH_TO_UB "P-Code fuer die Art SH_TO_UB" VALUE 0x7150E TKW_VV_VV_UW 100.0 FORMULA_0010 0.0 65535.0 /end CHARACTERISTIC
/begin CHARACTERISTIC K_ED_AUSS_ABG_MULT.P_CODE_UNPLAUSIBEL "P-Code fuer die Art UNPLAUSIBEL" VALUE 0x71514 TKW_VV_VV_UW 100.0 FORMULA_0010 0.0 65535.0 /end CHARACTERISTIC
/begin CHARACTERISTIC K_ED_AUSS_ABG_Z1.DEC_NACH_EINTRAG "Filterverringerung nach Fehlerspeichereintrag" VALUE 0x713E3 TKW_VV_VV_UB 100.0 FORMULA_0003 0.0 255.0 /end CHARACTERISTIC
/begin CHARACTERISTIC K_ED_AUSS_ABG_Z1.DEC_VOR_EINTRAG "Filterverringerung vorm Fehlerspeichereintrag" VALUE 0x713E1 TKW_VV_VV_UB 100.0 FORMULA_0003 0.0 255.0 /end CHARACTERISTIC
/begin CHARACTERISTIC K_ED_AUSS_ABG_Z1.FEHLERSCHWELLE "Filterschwelle fuer Fehlereintrag" VALUE 0x713DE TKW_VV_VV_UB 100.0 FORMULA_0003 0.0 255.0 /end CHARACTERISTIC
/begin CHARACTERISTIC K_ED_AUSS_ABG_Z1.INC_NACH_EINTRAG "Filtererhoehung nach Fehlerspeichereintrag" VALUE 0x713E2 TKW_VV_VV_UB 100.0 FORMULA_0003 0.0 255.0 /end CHARACTERISTIC
/begin CHARACTERISTIC K_ED_AUSS_ABG_Z1.INC_VOR_EINTRAG "Filtererhoehung vorm Fehlerspeichereintrag" VALUE 0x713E0 TKW_VV_VV_UB 100.0 FORMULA_0003 0.0 255.0 /end CHARACTERISTIC
/begin CHARACTERISTIC K_ED_AUSS_ABG_Z1.KLASSENINDEX "Auswahl der Fehlerklasse" VALUE 0x713E4 TKW_VV_VV_UB 100.0 FORMULA_0003 0.0 8.0 /end CHARACTERISTIC
/begin CHARACTERISTIC K_ED_AUSS_ABG_Z1.OK_SCHWELLE "Filterschwelle fuer Fehleraustrag" VALUE 0x713DF TKW_VV_VV_UB 100.0 FORMULA_0003 0.0 255.0 /end CHARACTERISTIC
/begin CHARACTERISTIC K_ED_AUSS_ABG_Z1.P_CODE_OPENLOAD "P-Code fuer die Art OPENLOAD" VALUE 0x713DA TKW_VV_VV_UW 100.0 FORMULA_0010 0.0 65535.0 /end CHARACTERISTIC
/begin CHARACTERISTIC K_ED_AUSS_ABG_Z1.P_CODE_SH_TO_GND "P-Code fuer die Art SH_TO_GND" VALUE 0x713D8 TKW_VV_VV_UW 100.0 FORMULA_0010 0.0 65535.0 /end CHARACTERISTIC
/begin CHARACTERISTIC K_ED_AUSS_ABG_Z1.P_CODE_SH_TO_UB "P-Code fuer die Art SH_TO_UB" VALUE 0x713D6 TKW_VV_VV_UW 100.0 FORMULA_0010 0.0 65535.0 /end CHARACTERISTIC
/begin CHARACTERISTIC K_ED_AUSS_ABG_Z1.P_CODE_UNPLAUSIBEL "P-Code fuer die Art UNPLAUSIBEL" VALUE 0x713DC TKW_VV_VV_UW 100.0 FORMULA_0010 0.0 65535.0 /end CHARACTERISTIC
/begin CHARACTERISTIC K_ED_AUSS_ABG_Z10.DEC_NACH_EINTRAG "Filterverringerung nach Fehlerspeichereintrag" VALUE 0x714CD TKW_VV_VV_UB 100.0 FORMULA_0003 0.0 255.0 /end CHARACTERISTIC
/begin CHARACTERISTIC K_ED_AUSS_ABG_Z10.DEC_VOR_EINTRAG "Filterverringerung vorm Fehlerspeichereintrag" VALUE 0x714CB TKW_VV_VV_UB 100.0 FORMULA_0003 0.0 255.0 /end CHARACTERISTIC
/begin CHARACTERISTIC K_ED_AUSS_ABG_Z10.FEHLERSCHWELLE "Filterschwelle fuer Fehlereintrag" VALUE 0x714C8 TKW_VV_VV_UB 100.0 FORMULA_0003 0.0 255.0 /end CHARACTERISTIC
/begin CHARACTERISTIC K_ED_AUSS_ABG_Z10.INC_NACH_EINTRAG "Filtererhoehung nach Fehlerspeichereintrag" VALUE 0x714CC TKW_VV_VV_UB 100.0 FORMULA_0003 0.0 255.0 /end CHARACTERISTIC
/begin CHARACTERISTIC K_ED_AUSS_ABG_Z10.INC_VOR_EINTRAG "Filtererhoehung vorm Fehlerspeichereintrag" VALUE 0x714CA TKW_VV_VV_UB 100.0 FORMULA_0003 0.0 255.0 /end CHARACTERISTIC
/begin CHARACTERISTIC K_ED_AUSS_ABG_Z10.KLASSENINDEX "Auswahl der Fehlerklasse" VALUE 0x714CE TKW_VV_VV_UB 100.0 FORMULA_0003 0.0 8.0 /end CHARACTERISTIC
/begin CHARACTERISTIC K_ED_AUSS_ABG_Z10.OK_SCHWELLE "Filterschwelle fuer Fehleraustrag" VALUE 0x714C9 TKW_VV_VV_UB 100.0 FORMULA_0003 0.0 255.0 /end CHARACTERISTIC
/begin CHARACTERISTIC K_ED_AUSS_ABG_Z10.P_CODE_OPENLOAD "P-Code fuer die Art OPENLOAD" VALUE 0x714C4 TKW_VV_VV_UW 100.0 FORMULA_0010 0.0 65535.0 /end CHARACTERISTIC
/begin CHARACTERISTIC K_ED_AUSS_ABG_Z10.P_CODE_SH_TO_GND "P-Code fuer die Art SH_TO_GND" VALUE 0x714C2 TKW_VV_VV_UW 100.0 FORMULA_0010 0.0 65535.0 /end CHARACTERISTIC
/begin CHARACTERISTIC K_ED_AUSS_ABG_Z10.P_CODE_SH_TO_UB "P-Code fuer die Art SH_TO_UB" VALUE 0x714C0 TKW_VV_VV_UW 100.0 FORMULA_0010 0.0 65535.0 /end CHARACTERISTIC
/begin CHARACTERISTIC K_ED_AUSS_ABG_Z10.P_CODE_UNPLAUSIBEL "P-Code fuer die Art UNPLAUSIBEL" VALUE 0x714C6 TKW_VV_VV_UW 100.0 FORMULA_0010 0.0 65535.0 /end CHARACTERISTIC
/begin CHARACTERISTIC K_ED_AUSS_ABG_Z2.DEC_NACH_EINTRAG "Filterverringerung nach Fehlerspeichereintrag" VALUE 0x713FD TKW_VV_VV_UB 100.0 FORMULA_0003 0.0 255.0 /end CHARACTERISTIC
/begin CHARACTERISTIC K_ED_AUSS_ABG_Z2.DEC_VOR_EINTRAG "Filterverringerung vorm Fehlerspeichereintrag" VALUE 0x713FB TKW_VV_VV_UB 100.0 FORMULA_0003 0.0 255.0 /end CHARACTERISTIC
/begin CHARACTERISTIC K_ED_AUSS_ABG_Z2.FEHLERSCHWELLE "Filterschwelle fuer Fehlereintrag" VALUE 0x713F8 TKW_VV_VV_UB 100.0 FORMULA_0003 0.0 255.0 /end CHARACTERISTIC
/begin CHARACTERISTIC K_ED_AUSS_ABG_Z2.INC_NACH_EINTRAG "Filtererhoehung nach Fehlerspeichereintrag" VALUE 0x713FC TKW_VV_VV_UB 100.0 FORMULA_0003 0.0 255.0 /end CHARACTERISTIC
/begin CHARACTERISTIC K_ED_AUSS_ABG_Z2.INC_VOR_EINTRAG "Filtererhoehung vorm Fehlerspeichereintrag" VALUE 0x713FA TKW_VV_VV_UB 100.0 FORMULA_0003 0.0 255.0 /end CHARACTERISTIC
/begin CHARACTERISTIC K_ED_AUSS_ABG_Z2.KLASSENINDEX "Auswahl der Fehlerklasse" VALUE 0x713FE TKW_VV_VV_UB 100.0 FORMULA_0003 0.0 8.0 /end CHARACTERISTIC
/begin CHARACTERISTIC K_ED_AUSS_ABG_Z2.OK_SCHWELLE "Filterschwelle fuer Fehleraustrag" VALUE 0x713F9 TKW_VV_VV_UB 100.0 FORMULA_0003 0.0 255.0 /end CHARACTERISTIC
/begin CHARACTERISTIC K_ED_AUSS_ABG_Z2.P_CODE_OPENLOAD "P-Code fuer die Art OPENLOAD" VALUE 0x713F4 TKW_VV_VV_UW 100.0 FORMULA_0010 0.0 65535.0 /end CHARACTERISTIC
/begin CHARACTERISTIC K_ED_AUSS_ABG_Z2.P_CODE_SH_TO_GND "P-Code fuer die Art SH_TO_GND" VALUE 0x713F2 TKW_VV_VV_UW 100.0 FORMULA_0010 0.0 65535.0 /end CHARACTERISTIC
/begin CHARACTERISTIC K_ED_AUSS_ABG_Z2.P_CODE_SH_TO_UB "P-Code fuer die Art SH_TO_UB" VALUE 0x713F0 TKW_VV_VV_UW 100.0 FORMULA_0010 0.0 65535.0 /end CHARACTERISTIC
/begin CHARACTERISTIC K_ED_AUSS_ABG_Z2.P_CODE_UNPLAUSIBEL "P-Code fuer die Art UNPLAUSIBEL" VALUE 0x713F6 TKW_VV_VV_UW 100.0 FORMULA_0010 0.0 65535.0 /end CHARACTERISTIC
/begin CHARACTERISTIC K_ED_AUSS_ABG_Z3.DEC_NACH_EINTRAG "Filterverringerung nach Fehlerspeichereintrag" VALUE 0x71417 TKW_VV_VV_UB 100.0 FORMULA_0003 0.0 255.0 /end CHARACTERISTIC
/begin CHARACTERISTIC K_ED_AUSS_ABG_Z3.DEC_VOR_EINTRAG "Filterverringerung vorm Fehlerspeichereintrag" VALUE 0x71415 TKW_VV_VV_UB 100.0 FORMULA_0003 0.0 255.0 /end CHARACTERISTIC
/begin CHARACTERISTIC K_ED_AUSS_ABG_Z3.FEHLERSCHWELLE "Filterschwelle fuer Fehlereintrag" VALUE 0x71412 TKW_VV_VV_UB 100.0 FORMULA_0003 0.0 255.0 /end CHARACTERISTIC
/begin CHARACTERISTIC K_ED_AUSS_ABG_Z3.INC_NACH_EINTRAG "Filtererhoehung nach Fehlerspeichereintrag" VALUE 0x71416 TKW_VV_VV_UB 100.0 FORMULA_0003 0.0 255.0 /end CHARACTERISTIC
/begin CHARACTERISTIC K_ED_AUSS_ABG_Z3.INC_VOR_EINTRAG "Filtererhoehung vorm Fehlerspeichereintrag" VALUE 0x71414 TKW_VV_VV_UB 100.0 FORMULA_0003 0.0 255.0 /end CHARACTERISTIC
/begin CHARACTERISTIC K_ED_AUSS_ABG_Z3.KLASSENINDEX "Auswahl der Fehlerklasse" VALUE 0x71418 TKW_VV_VV_UB 100.0 FORMULA_0003 0.0 8.0 /end CHARACTERISTIC
/begin CHARACTERISTIC K_ED_AUSS_ABG_Z3.OK_SCHWELLE "Filterschwelle fuer Fehleraustrag" VALUE 0x71413 TKW_VV_VV_UB 100.0 FORMULA_0003 0.0 255.0 /end CHARACTERISTIC
/begin CHARACTERISTIC K_ED_AUSS_ABG_Z3.P_CODE_OPENLOAD "P-Code fuer die Art OPENLOAD" VALUE 0x7140E TKW_VV_VV_UW 100.0 FORMULA_0010 0.0 65535.0 /end CHARACTERISTIC
/begin CHARACTERISTIC K_ED_AUSS_ABG_Z3.P_CODE_SH_TO_GND "P-Code fuer die Art SH_TO_GND" VALUE 0x7140C TKW_VV_VV_UW 100.0 FORMULA_0010 0.0 65535.0 /end CHARACTERISTIC
/begin CHARACTERISTIC K_ED_AUSS_ABG_Z3.P_CODE_SH_TO_UB "P-Code fuer die Art SH_TO_UB" VALUE 0x7140A TKW_VV_VV_UW 100.0 FORMULA_0010 0.0 65535.0 /end CHARACTERISTIC
/begin CHARACTERISTIC K_ED_AUSS_ABG_Z3.P_CODE_UNPLAUSIBEL "P-Code fuer die Art UNPLAUSIBEL" VALUE 0x71410 TKW_VV_VV_UW 100.0 FORMULA_0010 0.0 65535.0 /end CHARACTERISTIC
/begin CHARACTERISTIC K_ED_AUSS_ABG_Z4.DEC_NACH_EINTRAG "Filterverringerung nach Fehlerspeichereintrag" VALUE 0x71431 TKW_VV_VV_UB 100.0 FORMULA_0003 0.0 255.0 /end CHARACTERISTIC
/begin CHARACTERISTIC K_ED_AUSS_ABG_Z4.DEC_VOR_EINTRAG "Filterverringerung vorm Fehlerspeichereintrag" VALUE 0x7142F TKW_VV_VV_UB 100.0 FORMULA_0003 0.0 255.0 /end CHARACTERISTIC
/begin CHARACTERISTIC K_ED_AUSS_ABG_Z4.FEHLERSCHWELLE "Filterschwelle fuer Fehlereintrag" VALUE 0x7142C TKW_VV_VV_UB 100.0 FORMULA_0003 0.0 255.0 /end CHARACTERISTIC
/begin CHARACTERISTIC K_ED_AUSS_ABG_Z4.INC_NACH_EINTRAG "Filtererhoehung nach Fehlerspeichereintrag" VALUE 0x71430 TKW_VV_VV_UB 100.0 FORMULA_0003 0.0 255.0 /end CHARACTERISTIC
/begin CHARACTERISTIC K_ED_AUSS_ABG_Z4.INC_VOR_EINTRAG "Filtererhoehung vorm Fehlerspeichereintrag" VALUE 0x7142E TKW_VV_VV_UB 100.0 FORMULA_0003 0.0 255.0 /end CHARACTERISTIC
/begin CHARACTERISTIC K_ED_AUSS_ABG_Z4.KLASSENINDEX "Auswahl der Fehlerklasse" VALUE 0x71432 TKW_VV_VV_UB 100.0 FORMULA_0003 0.0 8.0 /end CHARACTERISTIC
/begin CHARACTERISTIC K_ED_AUSS_ABG_Z4.OK_SCHWELLE "Filterschwelle fuer Fehleraustrag" VALUE 0x7142D TKW_VV_VV_UB 100.0 FORMULA_0003 0.0 255.0 /end CHARACTERISTIC
/begin CHARACTERISTIC K_ED_AUSS_ABG_Z4.P_CODE_OPENLOAD "P-Code fuer die Art OPENLOAD" VALUE 0x71428 TKW_VV_VV_UW 100.0 FORMULA_0010 0.0 65535.0 /end CHARACTERISTIC
/begin CHARACTERISTIC K_ED_AUSS_ABG_Z4.P_CODE_SH_TO_GND "P-Code fuer die Art SH_TO_GND" VALUE 0x71426 TKW_VV_VV_UW 100.0 FORMULA_0010 0.0 65535.0 /end CHARACTERISTIC
/begin CHARACTERISTIC K_ED_AUSS_ABG_Z4.P_CODE_SH_TO_UB "P-Code fuer die Art SH_TO_UB" VALUE 0x71424 TKW_VV_VV_UW 100.0 FORMULA_0010 0.0 65535.0 /end CHARACTERISTIC
/begin CHARACTERISTIC K_ED_AUSS_ABG_Z4.P_CODE_UNPLAUSIBEL "P-Code fuer die Art UNPLAUSIBEL" VALUE 0x7142A TKW_VV_VV_UW 100.0 FORMULA_0010 0.0 65535.0 /end CHARACTERISTIC
/begin CHARACTERISTIC K_ED_AUSS_ABG_Z5.DEC_NACH_EINTRAG "Filterverringerung nach Fehlerspeichereintrag" VALUE 0x7144B TKW_VV_VV_UB 100.0 FORMULA_0003 0.0 255.0 /end CHARACTERISTIC
/begin CHARACTERISTIC K_ED_AUSS_ABG_Z5.DEC_VOR_EINTRAG "Filterverringerung vorm Fehlerspeichereintrag" VALUE 0x71449 TKW_VV_VV_UB 100.0 FORMULA_0003 0.0 255.0 /end CHARACTERISTIC
/begin CHARACTERISTIC K_ED_AUSS_ABG_Z5.FEHLERSCHWELLE "Filterschwelle fuer Fehlereintrag" VALUE 0x71446 TKW_VV_VV_UB 100.0 FORMULA_0003 0.0 255.0 /end CHARACTERISTIC
/begin CHARACTERISTIC K_ED_AUSS_ABG_Z5.INC_NACH_EINTRAG "Filtererhoehung nach Fehlerspeichereintrag" VALUE 0x7144A TKW_VV_VV_UB 100.0 FORMULA_0003 0.0 255.0 /end CHARACTERISTIC
/begin CHARACTERISTIC K_ED_AUSS_ABG_Z5.INC_VOR_EINTRAG "Filtererhoehung vorm Fehlerspeichereintrag" VALUE 0x71448 TKW_VV_VV_UB 100.0 FORMULA_0003 0.0 255.0 /end CHARACTERISTIC
/begin CHARACTERISTIC K_ED_AUSS_ABG_Z5.KLASSENINDEX "Auswahl der Fehlerklasse" VALUE 0x7144C TKW_VV_VV_UB 100.0 FORMULA_0003 0.0 8.0 /end CHARACTERISTIC
/begin CHARACTERISTIC K_ED_AUSS_ABG_Z5.OK_SCHWELLE "Filterschwelle fuer Fehleraustrag" VALUE 0x71447 TKW_VV_VV_UB 100.0 FORMULA_0003 0.0 255.0 /end CHARACTERISTIC
/begin CHARACTERISTIC K_ED_AUSS_ABG_Z5.P_CODE_OPENLOAD "P-Code fuer die Art OPENLOAD" VALUE 0x71442 TKW_VV_VV_UW 100.0 FORMULA_0010 0.0 65535.0 /end CHARACTERISTIC
/begin CHARACTERISTIC K_ED_AUSS_ABG_Z5.P_CODE_SH_TO_GND "P-Code fuer die Art SH_TO_GND" VALUE 0x71440 TKW_VV_VV_UW 100.0 FORMULA_0010 0.0 65535.0 /end CHARACTERISTIC
/begin CHARACTERISTIC K_ED_AUSS_ABG_Z5.P_CODE_SH_TO_UB "P-Code fuer die Art SH_TO_UB" VALUE 0x7143E TKW_VV_VV_UW 100.0 FORMULA_0010 0.0 65535.0 /end CHARACTERISTIC
/begin CHARACTERISTIC K_ED_AUSS_ABG_Z5.P_CODE_UNPLAUSIBEL "P-Code fuer die Art UNPLAUSIBEL" VALUE 0x71444 TKW_VV_VV_UW 100.0 FORMULA_0010 0.0 65535.0 /end CHARACTERISTIC
/begin CHARACTERISTIC K_ED_AUSS_ABG_Z6.DEC_NACH_EINTRAG "Filterverringerung nach Fehlerspeichereintrag" VALUE 0x71465 TKW_VV_VV_UB 100.0 FORMULA_0003 0.0 255.0 /end CHARACTERISTIC
/begin CHARACTERISTIC K_ED_AUSS_ABG_Z6.DEC_VOR_EINTRAG "Filterverringerung vorm Fehlerspeichereintrag" VALUE 0x71463 TKW_VV_VV_UB 100.0 FORMULA_0003 0.0 255.0 /end CHARACTERISTIC
/begin CHARACTERISTIC K_ED_AUSS_ABG_Z6.FEHLERSCHWELLE "Filterschwelle fuer Fehlereintrag" VALUE 0x71460 TKW_VV_VV_UB 100.0 FORMULA_0003 0.0 255.0 /end CHARACTERISTIC
/begin CHARACTERISTIC K_ED_AUSS_ABG_Z6.INC_NACH_EINTRAG "Filtererhoehung nach Fehlerspeichereintrag" VALUE 0x71464 TKW_VV_VV_UB 100.0 FORMULA_0003 0.0 255.0 /end CHARACTERISTIC
/begin CHARACTERISTIC K_ED_AUSS_ABG_Z6.INC_VOR_EINTRAG "Filtererhoehung vorm Fehlerspeichereintrag" VALUE 0x71462 TKW_VV_VV_UB 100.0 FORMULA_0003 0.0 255.0 /end CHARACTERISTIC
/begin CHARACTERISTIC K_ED_AUSS_ABG_Z6.KLASSENINDEX "Auswahl der Fehlerklasse" VALUE 0x71466 TKW_VV_VV_UB 100.0 FORMULA_0003 0.0 8.0 /end CHARACTERISTIC
/begin CHARACTERISTIC K_ED_AUSS_ABG_Z6.OK_SCHWELLE "Filterschwelle fuer Fehleraustrag" VALUE 0x71461 TKW_VV_VV_UB 100.0 FORMULA_0003 0.0 255.0 /end CHARACTERISTIC
/begin CHARACTERISTIC K_ED_AUSS_ABG_Z6.P_CODE_OPENLOAD "P-Code fuer die Art OPENLOAD" VALUE 0x7145C TKW_VV_VV_UW 100.0 FORMULA_0010 0.0 65535.0 /end CHARACTERISTIC
/begin CHARACTERISTIC K_ED_AUSS_ABG_Z6.P_CODE_SH_TO_GND "P-Code fuer die Art SH_TO_GND" VALUE 0x7145A TKW_VV_VV_UW 100.0 FORMULA_0010 0.0 65535.0 /end CHARACTERISTIC
/begin CHARACTERISTIC K_ED_AUSS_ABG_Z6.P_CODE_SH_TO_UB "P-Code fuer die Art SH_TO_UB" VALUE 0x71458 TKW_VV_VV_UW 100.0 FORMULA_0010 0.0 65535.0 /end CHARACTERISTIC
/begin CHARACTERISTIC K_ED_AUSS_ABG_Z6.P_CODE_UNPLAUSIBEL "P-Code fuer die Art UNPLAUSIBEL" VALUE 0x7145E TKW_VV_VV_UW 100.0 FORMULA_0010 0.0 65535.0 /end CHARACTERISTIC
/begin CHARACTERISTIC K_ED_AUSS_ABG_Z7.DEC_NACH_EINTRAG "Filterverringerung nach Fehlerspeichereintrag" VALUE 0x7147F TKW_VV_VV_UB 100.0 FORMULA_0003 0.0 255.0 /end CHARACTERISTIC
/begin CHARACTERISTIC K_ED_AUSS_ABG_Z7.DEC_VOR_EINTRAG "Filterverringerung vorm Fehlerspeichereintrag" VALUE 0x7147D TKW_VV_VV_UB 100.0 FORMULA_0003 0.0 255.0 /end CHARACTERISTIC
/begin CHARACTERISTIC K_ED_AUSS_ABG_Z7.FEHLERSCHWELLE "Filterschwelle fuer Fehlereintrag" VALUE 0x7147A TKW_VV_VV_UB 100.0 FORMULA_0003 0.0 255.0 /end CHARACTERISTIC
/begin CHARACTERISTIC K_ED_AUSS_ABG_Z7.INC_NACH_EINTRAG "Filtererhoehung nach Fehlerspeichereintrag" VALUE 0x7147E TKW_VV_VV_UB 100.0 FORMULA_0003 0.0 255.0 /end CHARACTERISTIC
/begin CHARACTERISTIC K_ED_AUSS_ABG_Z7.INC_VOR_EINTRAG "Filtererhoehung vorm Fehlerspeichereintrag" VALUE 0x7147C TKW_VV_VV_UB 100.0 FORMULA_0003 0.0 255.0 /end CHARACTERISTIC
/begin CHARACTERISTIC K_ED_AUSS_ABG_Z7.KLASSENINDEX "Auswahl der Fehlerklasse" VALUE 0x71480 TKW_VV_VV_UB 100.0 FORMULA_0003 0.0 8.0 /end CHARACTERISTIC
/begin CHARACTERISTIC K_ED_AUSS_ABG_Z7.OK_SCHWELLE "Filterschwelle fuer Fehleraustrag" VALUE 0x7147B TKW_VV_VV_UB 100.0 FORMULA_0003 0.0 255.0 /end CHARACTERISTIC
/begin CHARACTERISTIC K_ED_AUSS_ABG_Z7.P_CODE_OPENLOAD "P-Code fuer die Art OPENLOAD" VALUE 0x71476 TKW_VV_VV_UW 100.0 FORMULA_0010 0.0 65535.0 /end CHARACTERISTIC
/begin CHARACTERISTIC K_ED_AUSS_ABG_Z7.P_CODE_SH_TO_GND "P-Code fuer die Art SH_TO_GND" VALUE 0x71474 TKW_VV_VV_UW 100.0 FORMULA_0010 0.0 65535.0 /end CHARACTERISTIC
/begin CHARACTERISTIC K_ED_AUSS_ABG_Z7.P_CODE_SH_TO_UB "P-Code fuer die Art SH_TO_UB" VALUE 0x71472 TKW_VV_VV_UW 100.0 FORMULA_0010 0.0 65535.0 /end CHARACTERISTIC
/begin CHARACTERISTIC K_ED_AUSS_ABG_Z7.P_CODE_UNPLAUSIBEL "P-Code fuer die Art UNPLAUSIBEL" VALUE 0x71478 TKW_VV_VV_UW 100.0 FORMULA_0010 0.0 65535.0 /end CHARACTERISTIC
/begin CHARACTERISTIC K_ED_AUSS_ABG_Z8.DEC_NACH_EINTRAG "Filterverringerung nach Fehlerspeichereintrag" VALUE 0x71499 TKW_VV_VV_UB 100.0 FORMULA_0003 0.0 255.0 /end CHARACTERISTIC
/begin CHARACTERISTIC K_ED_AUSS_ABG_Z8.DEC_VOR_EINTRAG "Filterverringerung vorm Fehlerspeichereintrag" VALUE 0x71497 TKW_VV_VV_UB 100.0 FORMULA_0003 0.0 255.0 /end CHARACTERISTIC
/begin CHARACTERISTIC K_ED_AUSS_ABG_Z8.FEHLERSCHWELLE "Filterschwelle fuer Fehlereintrag" VALUE 0x71494 TKW_VV_VV_UB 100.0 FORMULA_0003 0.0 255.0 /end CHARACTERISTIC
/begin CHARACTERISTIC K_ED_AUSS_ABG_Z8.INC_NACH_EINTRAG "Filtererhoehung nach Fehlerspeichereintrag" VALUE 0x71498 TKW_VV_VV_UB 100.0 FORMULA_0003 0.0 255.0 /end CHARACTERISTIC
/begin CHARACTERISTIC K_ED_AUSS_ABG_Z8.INC_VOR_EINTRAG "Filtererhoehung vorm Fehlerspeichereintrag" VALUE 0x71496 TKW_VV_VV_UB 100.0 FORMULA_0003 0.0 255.0 /end CHARACTERISTIC
/begin CHARACTERISTIC K_ED_AUSS_ABG_Z8.KLASSENINDEX "Auswahl der Fehlerklasse" VALUE 0x7149A TKW_VV_VV_UB 100.0 FORMULA_0003 0.0 8.0 /end CHARACTERISTIC
/begin CHARACTERISTIC K_ED_AUSS_ABG_Z8.OK_SCHWELLE "Filterschwelle fuer Fehleraustrag" VALUE 0x71495 TKW_VV_VV_UB 100.0 FORMULA_0003 0.0 255.0 /end CHARACTERISTIC
/begin CHARACTERISTIC K_ED_AUSS_ABG_Z8.P_CODE_OPENLOAD "P-Code fuer die Art OPENLOAD" VALUE 0x71490 TKW_VV_VV_UW 100.0 FORMULA_0010 0.0 65535.0 /end CHARACTERISTIC
/begin CHARACTERISTIC K_ED_AUSS_ABG_Z8.P_CODE_SH_TO_GND "P-Code fuer die Art SH_TO_GND" VALUE 0x7148E TKW_VV_VV_UW 100.0 FORMULA_0010 0.0 65535.0 /end CHARACTERISTIC
/begin CHARACTERISTIC K_ED_AUSS_ABG_Z8.P_CODE_SH_TO_UB "P-Code fuer die Art SH_TO_UB" VALUE 0x7148C TKW_VV_VV_UW 100.0 FORMULA_0010 0.0 65535.0 /end CHARACTERISTIC
/begin CHARACTERISTIC K_ED_AUSS_ABG_Z8.P_CODE_UNPLAUSIBEL "P-Code fuer die Art UNPLAUSIBEL" VALUE 0x71492 TKW_VV_VV_UW 100.0 FORMULA_0010 0.0 65535.0 /end CHARACTERISTIC
/begin CHARACTERISTIC K_ED_AUSS_ABG_Z9.DEC_NACH_EINTRAG "Filterverringerung nach Fehlerspeichereintrag" VALUE 0x714B3 TKW_VV_VV_UB 100.0 FORMULA_0003 0.0 255.0 /end CHARACTERISTIC
/begin CHARACTERISTIC K_ED_AUSS_ABG_Z9.DEC_VOR_EINTRAG "Filterverringerung vorm Fehlerspeichereintrag" VALUE 0x714B1 TKW_VV_VV_UB 100.0 FORMULA_0003 0.0 255.0 /end CHARACTERISTIC
/begin CHARACTERISTIC K_ED_AUSS_ABG_Z9.FEHLERSCHWELLE "Filterschwelle fuer Fehlereintrag" VALUE 0x714AE TKW_VV_VV_UB 100.0 FORMULA_0003 0.0 255.0 /end CHARACTERISTIC
/begin CHARACTERISTIC K_ED_AUSS_ABG_Z9.INC_NACH_EINTRAG "Filtererhoehung nach Fehlerspeichereintrag" VALUE 0x714B2 TKW_VV_VV_UB 100.0 FORMULA_0003 0.0 255.0 /end CHARACTERISTIC
/begin CHARACTERISTIC K_ED_AUSS_ABG_Z9.INC_VOR_EINTRAG "Filtererhoehung vorm Fehlerspeichereintrag" VALUE 0x714B0 TKW_VV_VV_UB 100.0 FORMULA_0003 0.0 255.0 /end CHARACTERISTIC
/begin CHARACTERISTIC K_ED_AUSS_ABG_Z9.KLASSENINDEX "Auswahl der Fehlerklasse" VALUE 0x714B4 TKW_VV_VV_UB 100.0 FORMULA_0003 0.0 8.0 /end CHARACTERISTIC
/begin CHARACTERISTIC K_ED_AUSS_ABG_Z9.OK_SCHWELLE "Filterschwelle fuer Fehleraustrag" VALUE 0x714AF TKW_VV_VV_UB 100.0 FORMULA_0003 0.0 255.0 /end CHARACTERISTIC
/begin CHARACTERISTIC K_ED_AUSS_ABG_Z9.P_CODE_OPENLOAD "P-Code fuer die Art OPENLOAD" VALUE 0x714AA TKW_VV_VV_UW 100.0 FORMULA_0010 0.0 65535.0 /end CHARACTERISTIC
/begin CHARACTERISTIC K_ED_AUSS_ABG_Z9.P_CODE_SH_TO_GND "P-Code fuer die Art SH_TO_GND" VALUE 0x714A8 TKW_VV_VV_UW 100.0 FORMULA_0010 0.0 65535.0 /end CHARACTERISTIC
/begin CHARACTERISTIC K_ED_AUSS_ABG_Z9.P_CODE_SH_TO_UB "P-Code fuer die Art SH_TO_UB" VALUE 0x714A6 TKW_VV_VV_UW 100.0 FORMULA_0010 0.0 65535.0 /end CHARACTERISTIC
/begin CHARACTERISTIC K_ED_AUSS_ABG_Z9.P_CODE_UNPLAUSIBEL "P-Code fuer die Art UNPLAUSIBEL" VALUE 0x714AC TKW_VV_VV_UW 100.0 FORMULA_0010 0.0 65535.0 /end CHARACTERISTIC
/begin CHARACTERISTIC K_ED_AUSS_KAT_MULT.DEC_NACH_EINTRAG "Filterverringerung nach Fehlerspeichereintrag" VALUE 0x713C9 TKW_VV_VV_UB 100.0 FORMULA_0003 0.0 255.0 /end CHARACTERISTIC
/begin CHARACTERISTIC K_ED_AUSS_KAT_MULT.DEC_VOR_EINTRAG "Filterverringerung vorm Fehlerspeichereintrag" VALUE 0x713C7 TKW_VV_VV_UB 100.0 FORMULA_0003 0.0 255.0 /end CHARACTERISTIC
/begin CHARACTERISTIC K_ED_AUSS_KAT_MULT.FEHLERSCHWELLE "Filterschwelle fuer Fehlereintrag" VALUE 0x713C4 TKW_VV_VV_UB 100.0 FORMULA_0003 0.0 255.0 /end CHARACTERISTIC
/begin CHARACTERISTIC K_ED_AUSS_KAT_MULT.INC_NACH_EINTRAG "Filtererhoehung nach Fehlerspeichereintrag" VALUE 0x713C8 TKW_VV_VV_UB 100.0 FORMULA_0003 0.0 255.0 /end CHARACTERISTIC
/begin CHARACTERISTIC K_ED_AUSS_KAT_MULT.INC_VOR_EINTRAG "Filtererhoehung vorm Fehlerspeichereintrag" VALUE 0x713C6 TKW_VV_VV_UB 100.0 FORMULA_0003 0.0 255.0 /end CHARACTERISTIC
/begin CHARACTERISTIC K_ED_AUSS_KAT_MULT.KLASSENINDEX "Auswahl der Fehlerklasse" VALUE 0x713CA TKW_VV_VV_UB 100.0 FORMULA_0003 0.0 8.0 /end CHARACTERISTIC
/begin CHARACTERISTIC K_ED_AUSS_KAT_MULT.OK_SCHWELLE "Filterschwelle fuer Fehleraustrag" VALUE 0x713C5 TKW_VV_VV_UB 100.0 FORMULA_0003 0.0 255.0 /end CHARACTERISTIC
/begin CHARACTERISTIC K_ED_AUSS_KAT_MULT.P_CODE_OPENLOAD "P-Code fuer die Art OPENLOAD" VALUE 0x713C0 TKW_VV_VV_UW 100.0 FORMULA_0010 0.0 65535.0 /end CHARACTERISTIC
/begin CHARACTERISTIC K_ED_AUSS_KAT_MULT.P_CODE_SH_TO_GND "P-Code fuer die Art SH_TO_GND" VALUE 0x713BE TKW_VV_VV_UW 100.0 FORMULA_0010 0.0 65535.0 /end CHARACTERISTIC
/begin CHARACTERISTIC K_ED_AUSS_KAT_MULT.P_CODE_SH_TO_UB "P-Code fuer die Art SH_TO_UB" VALUE 0x713BC TKW_VV_VV_UW 100.0 FORMULA_0010 0.0 65535.0 /end CHARACTERISTIC
/begin CHARACTERISTIC K_ED_AUSS_KAT_MULT.P_CODE_UNPLAUSIBEL "P-Code fuer die Art UNPLAUSIBEL" VALUE 0x713C2 TKW_VV_VV_UW 100.0 FORMULA_0010 0.0 65535.0 /end CHARACTERISTIC
/begin CHARACTERISTIC K_ED_AUSS_KAT_Z1.DEC_NACH_EINTRAG "Filterverringerung nach Fehlerspeichereintrag" VALUE 0x71291 TKW_VV_VV_UB 100.0 FORMULA_0003 0.0 255.0 /end CHARACTERISTIC
/begin CHARACTERISTIC K_ED_AUSS_KAT_Z1.DEC_VOR_EINTRAG "Filterverringerung vorm Fehlerspeichereintrag" VALUE 0x7128F TKW_VV_VV_UB 100.0 FORMULA_0003 0.0 255.0 /end CHARACTERISTIC
/begin CHARACTERISTIC K_ED_AUSS_KAT_Z1.FEHLERSCHWELLE "Filterschwelle fuer Fehlereintrag" VALUE 0x7128C TKW_VV_VV_UB 100.0 FORMULA_0003 0.0 255.0 /end CHARACTERISTIC
/begin CHARACTERISTIC K_ED_AUSS_KAT_Z1.INC_NACH_EINTRAG "Filtererhoehung nach Fehlerspeichereintrag" VALUE 0x71290 TKW_VV_VV_UB 100.0 FORMULA_0003 0.0 255.0 /end CHARACTERISTIC
/begin CHARACTERISTIC K_ED_AUSS_KAT_Z1.INC_VOR_EINTRAG "Filtererhoehung vorm Fehlerspeichereintrag" VALUE 0x7128E TKW_VV_VV_UB 100.0 FORMULA_0003 0.0 255.0 /end CHARACTERISTIC
/begin CHARACTERISTIC K_ED_AUSS_KAT_Z1.KLASSENINDEX "Auswahl der Fehlerklasse" VALUE 0x71292 TKW_VV_VV_UB 100.0 FORMULA_0003 0.0 8.0 /end CHARACTERISTIC
/begin CHARACTERISTIC K_ED_AUSS_KAT_Z1.OK_SCHWELLE "Filterschwelle fuer Fehleraustrag" VALUE 0x7128D TKW_VV_VV_UB 100.0 FORMULA_0003 0.0 255.0 /end CHARACTERISTIC
/begin CHARACTERISTIC K_ED_AUSS_KAT_Z1.P_CODE_OPENLOAD "P-Code fuer die Art OPENLOAD" VALUE 0x71288 TKW_VV_VV_UW 100.0 FORMULA_0010 0.0 65535.0 /end CHARACTERISTIC
/begin CHARACTERISTIC K_ED_AUSS_KAT_Z1.P_CODE_SH_TO_GND "P-Code fuer die Art SH_TO_GND" VALUE 0x71286 TKW_VV_VV_UW 100.0 FORMULA_0010 0.0 65535.0 /end CHARACTERISTIC
/begin CHARACTERISTIC K_ED_AUSS_KAT_Z1.P_CODE_SH_TO_UB "P-Code fuer die Art SH_TO_UB" VALUE 0x71284 TKW_VV_VV_UW 100.0 FORMULA_0010 0.0 65535.0 /end CHARACTERISTIC
/begin CHARACTERISTIC K_ED_AUSS_KAT_Z1.P_CODE_UNPLAUSIBEL "P-Code fuer die Art UNPLAUSIBEL" VALUE 0x7128A TKW_VV_VV_UW 100.0 FORMULA_0010 0.0 65535.0 /end CHARACTERISTIC
/begin CHARACTERISTIC K_ED_AUSS_KAT_Z10.DEC_NACH_EINTRAG "Filterverringerung nach Fehlerspeichereintrag" VALUE 0x7137B TKW_VV_VV_UB 100.0 FORMULA_0003 0.0 255.0 /end CHARACTERISTIC
/begin CHARACTERISTIC K_ED_AUSS_KAT_Z10.DEC_VOR_EINTRAG "Filterverringerung vorm Fehlerspeichereintrag" VALUE 0x71379 TKW_VV_VV_UB 100.0 FORMULA_0003 0.0 255.0 /end CHARACTERISTIC
/begin CHARACTERISTIC K_ED_AUSS_KAT_Z10.FEHLERSCHWELLE "Filterschwelle fuer Fehlereintrag" VALUE 0x71376 TKW_VV_VV_UB 100.0 FORMULA_0003 0.0 255.0 /end CHARACTERISTIC
/begin CHARACTERISTIC K_ED_AUSS_KAT_Z10.INC_NACH_EINTRAG "Filtererhoehung nach Fehlerspeichereintrag" VALUE 0x7137A TKW_VV_VV_UB 100.0 FORMULA_0003 0.0 255.0 /end CHARACTERISTIC
/begin CHARACTERISTIC K_ED_AUSS_KAT_Z10.INC_VOR_EINTRAG "Filtererhoehung vorm Fehlerspeichereintrag" VALUE 0x71378 TKW_VV_VV_UB 100.0 FORMULA_0003 0.0 255.0 /end CHARACTERISTIC
/begin CHARACTERISTIC K_ED_AUSS_KAT_Z10.KLASSENINDEX "Auswahl der Fehlerklasse" VALUE 0x7137C TKW_VV_VV_UB 100.0 FORMULA_0003 0.0 8.0 /end CHARACTERISTIC
/begin CHARACTERISTIC K_ED_AUSS_KAT_Z10.OK_SCHWELLE "Filterschwelle fuer Fehleraustrag" VALUE 0x71377 TKW_VV_VV_UB 100.0 FORMULA_0003 0.0 255.0 /end CHARACTERISTIC
/begin CHARACTERISTIC K_ED_AUSS_KAT_Z10.P_CODE_OPENLOAD "P-Code fuer die Art OPENLOAD" VALUE 0x71372 TKW_VV_VV_UW 100.0 FORMULA_0010 0.0 65535.0 /end CHARACTERISTIC
/begin CHARACTERISTIC K_ED_AUSS_KAT_Z10.P_CODE_SH_TO_GND "P-Code fuer die Art SH_TO_GND" VALUE 0x71370 TKW_VV_VV_UW 100.0 FORMULA_0010 0.0 65535.0 /end CHARACTERISTIC
/begin CHARACTERISTIC K_ED_AUSS_KAT_Z10.P_CODE_SH_TO_UB "P-Code fuer die Art SH_TO_UB" VALUE 0x7136E TKW_VV_VV_UW 100.0 FORMULA_0010 0.0 65535.0 /end CHARACTERISTIC
/begin CHARACTERISTIC K_ED_AUSS_KAT_Z10.P_CODE_UNPLAUSIBEL "P-Code fuer die Art UNPLAUSIBEL" VALUE 0x71374 TKW_VV_VV_UW 100.0 FORMULA_0010 0.0 65535.0 /end CHARACTERISTIC
/begin CHARACTERISTIC K_ED_AUSS_KAT_Z2.DEC_NACH_EINTRAG "Filterverringerung nach Fehlerspeichereintrag" VALUE 0x712AB TKW_VV_VV_UB 100.0 FORMULA_0003 0.0 255.0 /end CHARACTERISTIC
/begin CHARACTERISTIC K_ED_AUSS_KAT_Z2.DEC_VOR_EINTRAG "Filterverringerung vorm Fehlerspeichereintrag" VALUE 0x712A9 TKW_VV_VV_UB 100.0 FORMULA_0003 0.0 255.0 /end CHARACTERISTIC
/begin CHARACTERISTIC K_ED_AUSS_KAT_Z2.FEHLERSCHWELLE "Filterschwelle fuer Fehlereintrag" VALUE 0x712A6 TKW_VV_VV_UB 100.0 FORMULA_0003 0.0 255.0 /end CHARACTERISTIC
/begin CHARACTERISTIC K_ED_AUSS_KAT_Z2.INC_NACH_EINTRAG "Filtererhoehung nach Fehlerspeichereintrag" VALUE 0x712AA TKW_VV_VV_UB 100.0 FORMULA_0003 0.0 255.0 /end CHARACTERISTIC
/begin CHARACTERISTIC K_ED_AUSS_KAT_Z2.INC_VOR_EINTRAG "Filtererhoehung vorm Fehlerspeichereintrag" VALUE 0x712A8 TKW_VV_VV_UB 100.0 FORMULA_0003 0.0 255.0 /end CHARACTERISTIC
/begin CHARACTERISTIC K_ED_AUSS_KAT_Z2.KLASSENINDEX "Auswahl der Fehlerklasse" VALUE 0x712AC TKW_VV_VV_UB 100.0 FORMULA_0003 0.0 8.0 /end CHARACTERISTIC
/begin CHARACTERISTIC K_ED_AUSS_KAT_Z2.OK_SCHWELLE "Filterschwelle fuer Fehleraustrag" VALUE 0x712A7 TKW_VV_VV_UB 100.0 FORMULA_0003 0.0 255.0 /end CHARACTERISTIC
/begin CHARACTERISTIC K_ED_AUSS_KAT_Z2.P_CODE_OPENLOAD "P-Code fuer die Art OPENLOAD" VALUE 0x712A2 TKW_VV_VV_UW 100.0 FORMULA_0010 0.0 65535.0 /end CHARACTERISTIC
/begin CHARACTERISTIC K_ED_AUSS_KAT_Z2.P_CODE_SH_TO_GND "P-Code fuer die Art SH_TO_GND" VALUE 0x712A0 TKW_VV_VV_UW 100.0 FORMULA_0010 0.0 65535.0 /end CHARACTERISTIC
/begin CHARACTERISTIC K_ED_AUSS_KAT_Z2.P_CODE_SH_TO_UB "P-Code fuer die Art SH_TO_UB" VALUE 0x7129E TKW_VV_VV_UW 100.0 FORMULA_0010 0.0 65535.0 /end CHARACTERISTIC
/begin CHARACTERISTIC K_ED_AUSS_KAT_Z2.P_CODE_UNPLAUSIBEL "P-Code fuer die Art UNPLAUSIBEL" VALUE 0x712A4 TKW_VV_VV_UW 100.0 FORMULA_0010 0.0 65535.0 /end CHARACTERISTIC
/begin CHARACTERISTIC K_ED_AUSS_KAT_Z3.DEC_NACH_EINTRAG "Filterverringerung nach Fehlerspeichereintrag" VALUE 0x712C5 TKW_VV_VV_UB 100.0 FORMULA_0003 0.0 255.0 /end CHARACTERISTIC
/begin CHARACTERISTIC K_ED_AUSS_KAT_Z3.DEC_VOR_EINTRAG "Filterverringerung vorm Fehlerspeichereintrag" VALUE 0x712C3 TKW_VV_VV_UB 100.0 FORMULA_0003 0.0 255.0 /end CHARACTERISTIC
/begin CHARACTERISTIC K_ED_AUSS_KAT_Z3.FEHLERSCHWELLE "Filterschwelle fuer Fehlereintrag" VALUE 0x712C0 TKW_VV_VV_UB 100.0 FORMULA_0003 0.0 255.0 /end CHARACTERISTIC
/begin CHARACTERISTIC K_ED_AUSS_KAT_Z3.INC_NACH_EINTRAG "Filtererhoehung nach Fehlerspeichereintrag" VALUE 0x712C4 TKW_VV_VV_UB 100.0 FORMULA_0003 0.0 255.0 /end CHARACTERISTIC
/begin CHARACTERISTIC K_ED_AUSS_KAT_Z3.INC_VOR_EINTRAG "Filtererhoehung vorm Fehlerspeichereintrag" VALUE 0x712C2 TKW_VV_VV_UB 100.0 FORMULA_0003 0.0 255.0 /end CHARACTERISTIC
/begin CHARACTERISTIC K_ED_AUSS_KAT_Z3.KLASSENINDEX "Auswahl der Fehlerklasse" VALUE 0x712C6 TKW_VV_VV_UB 100.0 FORMULA_0003 0.0 8.0 /end CHARACTERISTIC
/begin CHARACTERISTIC K_ED_AUSS_KAT_Z3.OK_SCHWELLE "Filterschwelle fuer Fehleraustrag" VALUE 0x712C1 TKW_VV_VV_UB 100.0 FORMULA_0003 0.0 255.0 /end CHARACTERISTIC
/begin CHARACTERISTIC K_ED_AUSS_KAT_Z3.P_CODE_OPENLOAD "P-Code fuer die Art OPENLOAD" VALUE 0x712BC TKW_VV_VV_UW 100.0 FORMULA_0010 0.0 65535.0 /end CHARACTERISTIC
/begin CHARACTERISTIC K_ED_AUSS_KAT_Z3.P_CODE_SH_TO_GND "P-Code fuer die Art SH_TO_GND" VALUE 0x712BA TKW_VV_VV_UW 100.0 FORMULA_0010 0.0 65535.0 /end CHARACTERISTIC
/begin CHARACTERISTIC K_ED_AUSS_KAT_Z3.P_CODE_SH_TO_UB "P-Code fuer die Art SH_TO_UB" VALUE 0x712B8 TKW_VV_VV_UW 100.0 FORMULA_0010 0.0 65535.0 /end CHARACTERISTIC
/begin CHARACTERISTIC K_ED_AUSS_KAT_Z3.P_CODE_UNPLAUSIBEL "P-Code fuer die Art UNPLAUSIBEL" VALUE 0x712BE TKW_VV_VV_UW 100.0 FORMULA_0010 0.0 65535.0 /end CHARACTERISTIC
/begin CHARACTERISTIC K_ED_AUSS_KAT_Z4.DEC_NACH_EINTRAG "Filterverringerung nach Fehlerspeichereintrag" VALUE 0x712DF TKW_VV_VV_UB 100.0 FORMULA_0003 0.0 255.0 /end CHARACTERISTIC
/begin CHARACTERISTIC K_ED_AUSS_KAT_Z4.DEC_VOR_EINTRAG "Filterverringerung vorm Fehlerspeichereintrag" VALUE 0x712DD TKW_VV_VV_UB 100.0 FORMULA_0003 0.0 255.0 /end CHARACTERISTIC
/begin CHARACTERISTIC K_ED_AUSS_KAT_Z4.FEHLERSCHWELLE "Filterschwelle fuer Fehlereintrag" VALUE 0x712DA TKW_VV_VV_UB 100.0 FORMULA_0003 0.0 255.0 /end CHARACTERISTIC
/begin CHARACTERISTIC K_ED_AUSS_KAT_Z4.INC_NACH_EINTRAG "Filtererhoehung nach Fehlerspeichereintrag" VALUE 0x712DE TKW_VV_VV_UB 100.0 FORMULA_0003 0.0 255.0 /end CHARACTERISTIC
/begin CHARACTERISTIC K_ED_AUSS_KAT_Z4.INC_VOR_EINTRAG "Filtererhoehung vorm Fehlerspeichereintrag" VALUE 0x712DC TKW_VV_VV_UB 100.0 FORMULA_0003 0.0 255.0 /end CHARACTERISTIC
/begin CHARACTERISTIC K_ED_AUSS_KAT_Z4.KLASSENINDEX "Auswahl der Fehlerklasse" VALUE 0x712E0 TKW_VV_VV_UB 100.0 FORMULA_0003 0.0 8.0 /end CHARACTERISTIC
/begin CHARACTERISTIC K_ED_AUSS_KAT_Z4.OK_SCHWELLE "Filterschwelle fuer Fehleraustrag" VALUE 0x712DB TKW_VV_VV_UB 100.0 FORMULA_0003 0.0 255.0 /end CHARACTERISTIC
/begin CHARACTERISTIC K_ED_AUSS_KAT_Z4.P_CODE_OPENLOAD "P-Code fuer die Art OPENLOAD" VALUE 0x712D6 TKW_VV_VV_UW 100.0 FORMULA_0010 0.0 65535.0 /end CHARACTERISTIC
/begin CHARACTERISTIC K_ED_AUSS_KAT_Z4.P_CODE_SH_TO_GND "P-Code fuer die Art SH_TO_GND" VALUE 0x712D4 TKW_VV_VV_UW 100.0 FORMULA_0010 0.0 65535.0 /end CHARACTERISTIC
/begin CHARACTERISTIC K_ED_AUSS_KAT_Z4.P_CODE_SH_TO_UB "P-Code fuer die Art SH_TO_UB" VALUE 0x712D2 TKW_VV_VV_UW 100.0 FORMULA_0010 0.0 65535.0 /end CHARACTERISTIC
/begin CHARACTERISTIC K_ED_AUSS_KAT_Z4.P_CODE_UNPLAUSIBEL "P-Code fuer die Art UNPLAUSIBEL" VALUE 0x712D8 TKW_VV_VV_UW 100.0 FORMULA_0010 0.0 65535.0 /end CHARACTERISTIC
/begin CHARACTERISTIC K_ED_AUSS_KAT_Z5.DEC_NACH_EINTRAG "Filterverringerung nach Fehlerspeichereintrag" VALUE 0x712F9 TKW_VV_VV_UB 100.0 FORMULA_0003 0.0 255.0 /end CHARACTERISTIC
/begin CHARACTERISTIC K_ED_AUSS_KAT_Z5.DEC_VOR_EINTRAG "Filterverringerung vorm Fehlerspeichereintrag" VALUE 0x712F7 TKW_VV_VV_UB 100.0 FORMULA_0003 0.0 255.0 /end CHARACTERISTIC
/begin CHARACTERISTIC K_ED_AUSS_KAT_Z5.FEHLERSCHWELLE "Filterschwelle fuer Fehlereintrag" VALUE 0x712F4 TKW_VV_VV_UB 100.0 FORMULA_0003 0.0 255.0 /end CHARACTERISTIC
/begin CHARACTERISTIC K_ED_AUSS_KAT_Z5.INC_NACH_EINTRAG "Filtererhoehung nach Fehlerspeichereintrag" VALUE 0x712F8 TKW_VV_VV_UB 100.0 FORMULA_0003 0.0 255.0 /end CHARACTERISTIC
/begin CHARACTERISTIC K_ED_AUSS_KAT_Z5.INC_VOR_EINTRAG "Filtererhoehung vorm Fehlerspeichereintrag" VALUE 0x712F6 TKW_VV_VV_UB 100.0 FORMULA_0003 0.0 255.0 /end CHARACTERISTIC
/begin CHARACTERISTIC K_ED_AUSS_KAT_Z5.KLASSENINDEX "Auswahl der Fehlerklasse" VALUE 0x712FA TKW_VV_VV_UB 100.0 FORMULA_0003 0.0 8.0 /end CHARACTERISTIC
/begin CHARACTERISTIC K_ED_AUSS_KAT_Z5.OK_SCHWELLE "Filterschwelle fuer Fehleraustrag" VALUE 0x712F5 TKW_VV_VV_UB 100.0 FORMULA_0003 0.0 255.0 /end CHARACTERISTIC
/begin CHARACTERISTIC K_ED_AUSS_KAT_Z5.P_CODE_OPENLOAD "P-Code fuer die Art OPENLOAD" VALUE 0x712F0 TKW_VV_VV_UW 100.0 FORMULA_0010 0.0 65535.0 /end CHARACTERISTIC
/begin CHARACTERISTIC K_ED_AUSS_KAT_Z5.P_CODE_SH_TO_GND "P-Code fuer die Art SH_TO_GND" VALUE 0x712EE TKW_VV_VV_UW 100.0 FORMULA_0010 0.0 65535.0 /end CHARACTERISTIC
/begin CHARACTERISTIC K_ED_AUSS_KAT_Z5.P_CODE_SH_TO_UB "P-Code fuer die Art SH_TO_UB" VALUE 0x712EC TKW_VV_VV_UW 100.0 FORMULA_0010 0.0 65535.0 /end CHARACTERISTIC
/begin CHARACTERISTIC K_ED_AUSS_KAT_Z5.P_CODE_UNPLAUSIBEL "P-Code fuer die Art UNPLAUSIBEL" VALUE 0x712F2 TKW_VV_VV_UW 100.0 FORMULA_0010 0.0 65535.0 /end CHARACTERISTIC
/begin CHARACTERISTIC K_ED_AUSS_KAT_Z6.DEC_NACH_EINTRAG "Filterverringerung nach Fehlerspeichereintrag" VALUE 0x71313 TKW_VV_VV_UB 100.0 FORMULA_0003 0.0 255.0 /end CHARACTERISTIC
/begin CHARACTERISTIC K_ED_AUSS_KAT_Z6.DEC_VOR_EINTRAG "Filterverringerung vorm Fehlerspeichereintrag" VALUE 0x71311 TKW_VV_VV_UB 100.0 FORMULA_0003 0.0 255.0 /end CHARACTERISTIC
/begin CHARACTERISTIC K_ED_AUSS_KAT_Z6.FEHLERSCHWELLE "Filterschwelle fuer Fehlereintrag" VALUE 0x7130E TKW_VV_VV_UB 100.0 FORMULA_0003 0.0 255.0 /end CHARACTERISTIC
/begin CHARACTERISTIC K_ED_AUSS_KAT_Z6.INC_NACH_EINTRAG "Filtererhoehung nach Fehlerspeichereintrag" VALUE 0x71312 TKW_VV_VV_UB 100.0 FORMULA_0003 0.0 255.0 /end CHARACTERISTIC
/begin CHARACTERISTIC K_ED_AUSS_KAT_Z6.INC_VOR_EINTRAG "Filtererhoehung vorm Fehlerspeichereintrag" VALUE 0x71310 TKW_VV_VV_UB 100.0 FORMULA_0003 0.0 255.0 /end CHARACTERISTIC
/begin CHARACTERISTIC K_ED_AUSS_KAT_Z6.KLASSENINDEX "Auswahl der Fehlerklasse" VALUE 0x71314 TKW_VV_VV_UB 100.0 FORMULA_0003 0.0 8.0 /end CHARACTERISTIC
/begin CHARACTERISTIC K_ED_AUSS_KAT_Z6.OK_SCHWELLE "Filterschwelle fuer Fehleraustrag" VALUE 0x7130F TKW_VV_VV_UB 100.0 FORMULA_0003 0.0 255.0 /end CHARACTERISTIC
/begin CHARACTERISTIC K_ED_AUSS_KAT_Z6.P_CODE_OPENLOAD "P-Code fuer die Art OPENLOAD" VALUE 0x7130A TKW_VV_VV_UW 100.0 FORMULA_0010 0.0 65535.0 /end CHARACTERISTIC
/begin CHARACTERISTIC K_ED_AUSS_KAT_Z6.P_CODE_SH_TO_GND "P-Code fuer die Art SH_TO_GND" VALUE 0x71308 TKW_VV_VV_UW 100.0 FORMULA_0010 0.0 65535.0 /end CHARACTERISTIC
/begin CHARACTERISTIC K_ED_AUSS_KAT_Z6.P_CODE_SH_TO_UB "P-Code fuer die Art SH_TO_UB" VALUE 0x71306 TKW_VV_VV_UW 100.0 FORMULA_0010 0.0 65535.0 /end CHARACTERISTIC
/begin CHARACTERISTIC K_ED_AUSS_KAT_Z6.P_CODE_UNPLAUSIBEL "P-Code fuer die Art UNPLAUSIBEL" VALUE 0x7130C TKW_VV_VV_UW 100.0 FORMULA_0010 0.0 65535.0 /end CHARACTERISTIC
/begin CHARACTERISTIC K_ED_AUSS_KAT_Z7.DEC_NACH_EINTRAG "Filterverringerung nach Fehlerspeichereintrag" VALUE 0x7132D TKW_VV_VV_UB 100.0 FORMULA_0003 0.0 255.0 /end CHARACTERISTIC
/begin CHARACTERISTIC K_ED_AUSS_KAT_Z7.DEC_VOR_EINTRAG "Filterverringerung vorm Fehlerspeichereintrag" VALUE 0x7132B TKW_VV_VV_UB 100.0 FORMULA_0003 0.0 255.0 /end CHARACTERISTIC
/begin CHARACTERISTIC K_ED_AUSS_KAT_Z7.FEHLERSCHWELLE "Filterschwelle fuer Fehlereintrag" VALUE 0x71328 TKW_VV_VV_UB 100.0 FORMULA_0003 0.0 255.0 /end CHARACTERISTIC
/begin CHARACTERISTIC K_ED_AUSS_KAT_Z7.INC_NACH_EINTRAG "Filtererhoehung nach Fehlerspeichereintrag" VALUE 0x7132C TKW_VV_VV_UB 100.0 FORMULA_0003 0.0 255.0 /end CHARACTERISTIC
/begin CHARACTERISTIC K_ED_AUSS_KAT_Z7.INC_VOR_EINTRAG "Filtererhoehung vorm Fehlerspeichereintrag" VALUE 0x7132A TKW_VV_VV_UB 100.0 FORMULA_0003 0.0 255.0 /end CHARACTERISTIC
/begin CHARACTERISTIC K_ED_AUSS_KAT_Z7.KLASSENINDEX "Auswahl der Fehlerklasse" VALUE 0x7132E TKW_VV_VV_UB 100.0 FORMULA_0003 0.0 8.0 /end CHARACTERISTIC
/begin CHARACTERISTIC K_ED_AUSS_KAT_Z7.OK_SCHWELLE "Filterschwelle fuer Fehleraustrag" VALUE 0x71329 TKW_VV_VV_UB 100.0 FORMULA_0003 0.0 255.0 /end CHARACTERISTIC
/begin CHARACTERISTIC K_ED_AUSS_KAT_Z7.P_CODE_OPENLOAD "P-Code fuer die Art OPENLOAD" VALUE 0x71324 TKW_VV_VV_UW 100.0 FORMULA_0010 0.0 65535.0 /end CHARACTERISTIC
/begin CHARACTERISTIC K_ED_AUSS_KAT_Z7.P_CODE_SH_TO_GND "P-Code fuer die Art SH_TO_GND" VALUE 0x71322 TKW_VV_VV_UW 100.0 FORMULA_0010 0.0 65535.0 /end CHARACTERISTIC
/begin CHARACTERISTIC K_ED_AUSS_KAT_Z7.P_CODE_SH_TO_UB "P-Code fuer die Art SH_TO_UB" VALUE 0x71320 TKW_VV_VV_UW 100.0 FORMULA_0010 0.0 65535.0 /end CHARACTERISTIC
/begin CHARACTERISTIC K_ED_AUSS_KAT_Z7.P_CODE_UNPLAUSIBEL "P-Code fuer die Art UNPLAUSIBEL" VALUE 0x71326 TKW_VV_VV_UW 100.0 FORMULA_0010 0.0 65535.0 /end CHARACTERISTIC
/begin CHARACTERISTIC K_ED_AUSS_KAT_Z8.DEC_NACH_EINTRAG "Filterverringerung nach Fehlerspeichereintrag" VALUE 0x71347 TKW_VV_VV_UB 100.0 FORMULA_0003 0.0 255.0 /end CHARACTERISTIC
/begin CHARACTERISTIC K_ED_AUSS_KAT_Z8.DEC_VOR_EINTRAG "Filterverringerung vorm Fehlerspeichereintrag" VALUE 0x71345 TKW_VV_VV_UB 100.0 FORMULA_0003 0.0 255.0 /end CHARACTERISTIC
/begin CHARACTERISTIC K_ED_AUSS_KAT_Z8.FEHLERSCHWELLE "Filterschwelle fuer Fehlereintrag" VALUE 0x71342 TKW_VV_VV_UB 100.0 FORMULA_0003 0.0 255.0 /end CHARACTERISTIC
/begin CHARACTERISTIC K_ED_AUSS_KAT_Z8.INC_NACH_EINTRAG "Filtererhoehung nach Fehlerspeichereintrag" VALUE 0x71346 TKW_VV_VV_UB 100.0 FORMULA_0003 0.0 255.0 /end CHARACTERISTIC
/begin CHARACTERISTIC K_ED_AUSS_KAT_Z8.INC_VOR_EINTRAG "Filtererhoehung vorm Fehlerspeichereintrag" VALUE 0x71344 TKW_VV_VV_UB 100.0 FORMULA_0003 0.0 255.0 /end CHARACTERISTIC
/begin CHARACTERISTIC K_ED_AUSS_KAT_Z8.KLASSENINDEX "Auswahl der Fehlerklasse" VALUE 0x71348 TKW_VV_VV_UB 100.0 FORMULA_0003 0.0 8.0 /end CHARACTERISTIC
/begin CHARACTERISTIC K_ED_AUSS_KAT_Z8.OK_SCHWELLE "Filterschwelle fuer Fehleraustrag" VALUE 0x71343 TKW_VV_VV_UB 100.0 FORMULA_0003 0.0 255.0 /end CHARACTERISTIC
/begin CHARACTERISTIC K_ED_AUSS_KAT_Z8.P_CODE_OPENLOAD "P-Code fuer die Art OPENLOAD" VALUE 0x7133E TKW_VV_VV_UW 100.0 FORMULA_0010 0.0 65535.0 /end CHARACTERISTIC
/begin CHARACTERISTIC K_ED_AUSS_KAT_Z8.P_CODE_SH_TO_GND "P-Code fuer die Art SH_TO_GND" VALUE 0x7133C TKW_VV_VV_UW 100.0 FORMULA_0010 0.0 65535.0 /end CHARACTERISTIC
/begin CHARACTERISTIC K_ED_AUSS_KAT_Z8.P_CODE_SH_TO_UB "P-Code fuer die Art SH_TO_UB" VALUE 0x7133A TKW_VV_VV_UW 100.0 FORMULA_0010 0.0 65535.0 /end CHARACTERISTIC
/begin CHARACTERISTIC K_ED_AUSS_KAT_Z8.P_CODE_UNPLAUSIBEL "P-Code fuer die Art UNPLAUSIBEL" VALUE 0x71340 TKW_VV_VV_UW 100.0 FORMULA_0010 0.0 65535.0 /end CHARACTERISTIC
/begin CHARACTERISTIC K_ED_AUSS_KAT_Z9.DEC_NACH_EINTRAG "Filterverringerung nach Fehlerspeichereintrag" VALUE 0x71361 TKW_VV_VV_UB 100.0 FORMULA_0003 0.0 255.0 /end CHARACTERISTIC
/begin CHARACTERISTIC K_ED_AUSS_KAT_Z9.DEC_VOR_EINTRAG "Filterverringerung vorm Fehlerspeichereintrag" VALUE 0x7135F TKW_VV_VV_UB 100.0 FORMULA_0003 0.0 255.0 /end CHARACTERISTIC
/begin CHARACTERISTIC K_ED_AUSS_KAT_Z9.FEHLERSCHWELLE "Filterschwelle fuer Fehlereintrag" VALUE 0x7135C TKW_VV_VV_UB 100.0 FORMULA_0003 0.0 255.0 /end CHARACTERISTIC
/begin CHARACTERISTIC K_ED_AUSS_KAT_Z9.INC_NACH_EINTRAG "Filtererhoehung nach Fehlerspeichereintrag" VALUE 0x71360 TKW_VV_VV_UB 100.0 FORMULA_0003 0.0 255.0 /end CHARACTERISTIC
/begin CHARACTERISTIC K_ED_AUSS_KAT_Z9.INC_VOR_EINTRAG "Filtererhoehung vorm Fehlerspeichereintrag" VALUE 0x7135E TKW_VV_VV_UB 100.0 FORMULA_0003 0.0 255.0 /end CHARACTERISTIC
/begin CHARACTERISTIC K_ED_AUSS_KAT_Z9.KLASSENINDEX "Auswahl der Fehlerklasse" VALUE 0x71362 TKW_VV_VV_UB 100.0 FORMULA_0003 0.0 8.0 /end CHARACTERISTIC
/begin CHARACTERISTIC K_ED_AUSS_KAT_Z9.OK_SCHWELLE "Filterschwelle fuer Fehleraustrag" VALUE 0x7135D TKW_VV_VV_UB 100.0 FORMULA_0003 0.0 255.0 /end CHARACTERISTIC
/begin CHARACTERISTIC K_ED_AUSS_KAT_Z9.P_CODE_OPENLOAD "P-Code fuer die Art OPENLOAD" VALUE 0x71358 TKW_VV_VV_UW 100.0 FORMULA_0010 0.0 65535.0 /end CHARACTERISTIC
/begin CHARACTERISTIC K_ED_AUSS_KAT_Z9.P_CODE_SH_TO_GND "P-Code fuer die Art SH_TO_GND" VALUE 0x71356 TKW_VV_VV_UW 100.0 FORMULA_0010 0.0 65535.0 /end CHARACTERISTIC
/begin CHARACTERISTIC K_ED_AUSS_KAT_Z9.P_CODE_SH_TO_UB "P-Code fuer die Art SH_TO_UB" VALUE 0x71354 TKW_VV_VV_UW 100.0 FORMULA_0010 0.0 65535.0 /end CHARACTERISTIC
/begin CHARACTERISTIC K_ED_AUSS_KAT_Z9.P_CODE_UNPLAUSIBEL "P-Code fuer die Art UNPLAUSIBEL" VALUE 0x7135A TKW_VV_VV_UW 100.0 FORMULA_0010 0.0 65535.0 /end CHARACTERISTIC
/begin CHARACTERISTIC K_ED_BLS_PLAU.DEC_NACH_EINTRAG "Filterverringerung nach Fehlerspeichereintrag" VALUE 0x715EB TKW_VV_VV_UB 100.0 FORMULA_0003 0.0 255.0 /end CHARACTERISTIC
/begin CHARACTERISTIC K_ED_BLS_PLAU.DEC_VOR_EINTRAG "Filterverringerung vorm Fehlerspeichereintrag" VALUE 0x715E9 TKW_VV_VV_UB 100.0 FORMULA_0003 0.0 255.0 /end CHARACTERISTIC
/begin CHARACTERISTIC K_ED_BLS_PLAU.FEHLERSCHWELLE "Filterschwelle fuer Fehlereintrag" VALUE 0x715E6 TKW_VV_VV_UB 100.0 FORMULA_0003 0.0 255.0 /end CHARACTERISTIC
/begin CHARACTERISTIC K_ED_BLS_PLAU.INC_NACH_EINTRAG "Filtererhoehung nach Fehlerspeichereintrag" VALUE 0x715EA TKW_VV_VV_UB 100.0 FORMULA_0003 0.0 255.0 /end CHARACTERISTIC
/begin CHARACTERISTIC K_ED_BLS_PLAU.INC_VOR_EINTRAG "Filtererhoehung vorm Fehlerspeichereintrag" VALUE 0x715E8 TKW_VV_VV_UB 100.0 FORMULA_0003 0.0 255.0 /end CHARACTERISTIC
/begin CHARACTERISTIC K_ED_BLS_PLAU.KLASSENINDEX "Auswahl der Fehlerklasse" VALUE 0x715EC TKW_VV_VV_UB 100.0 FORMULA_0003 0.0 8.0 /end CHARACTERISTIC
/begin CHARACTERISTIC K_ED_BLS_PLAU.OK_SCHWELLE "Filterschwelle fuer Fehleraustrag" VALUE 0x715E7 TKW_VV_VV_UB 100.0 FORMULA_0003 0.0 255.0 /end CHARACTERISTIC
/begin CHARACTERISTIC K_ED_BLS_PLAU.P_CODE_OPENLOAD "P-Code fuer die Art OPENLOAD" VALUE 0x715E2 TKW_VV_VV_UW 100.0 FORMULA_0010 0.0 65535.0 /end CHARACTERISTIC
/begin CHARACTERISTIC K_ED_BLS_PLAU.P_CODE_SH_TO_GND "P-Code fuer die Art SH_TO_GND" VALUE 0x715E0 TKW_VV_VV_UW 100.0 FORMULA_0010 0.0 65535.0 /end CHARACTERISTIC
/begin CHARACTERISTIC K_ED_BLS_PLAU.P_CODE_SH_TO_UB "P-Code fuer die Art SH_TO_UB" VALUE 0x715DE TKW_VV_VV_UW 100.0 FORMULA_0010 0.0 65535.0 /end CHARACTERISTIC
/begin CHARACTERISTIC K_ED_BLS_PLAU.P_CODE_UNPLAUSIBEL "P-Code fuer die Art UNPLAUSIBEL" VALUE 0x715E4 TKW_VV_VV_UW 100.0 FORMULA_0010 0.0 65535.0 /end CHARACTERISTIC
/begin CHARACTERISTIC K_ED_DK_INIT.DEC_NACH_EINTRAG "Filterverringerung nach Fehlerspeichereintrag" VALUE 0x70F37 TKW_VV_VV_UB 100.0 FORMULA_0003 0.0 255.0 /end CHARACTERISTIC
/begin CHARACTERISTIC K_ED_DK_INIT.DEC_VOR_EINTRAG "Filterverringerung vorm Fehlerspeichereintrag" VALUE 0x70F35 TKW_VV_VV_UB 100.0 FORMULA_0003 0.0 255.0 /end CHARACTERISTIC
/begin CHARACTERISTIC K_ED_DK_INIT.FEHLERSCHWELLE "Filterschwelle fuer Fehlereintrag" VALUE 0x70F32 TKW_VV_VV_UB 100.0 FORMULA_0003 0.0 255.0 /end CHARACTERISTIC
/begin CHARACTERISTIC K_ED_DK_INIT.INC_NACH_EINTRAG "Filtererhoehung nach Fehlerspeichereintrag" VALUE 0x70F36 TKW_VV_VV_UB 100.0 FORMULA_0003 0.0 255.0 /end CHARACTERISTIC
/begin CHARACTERISTIC K_ED_DK_INIT.INC_VOR_EINTRAG "Filtererhoehung vorm Fehlerspeichereintrag" VALUE 0x70F34 TKW_VV_VV_UB 100.0 FORMULA_0003 0.0 255.0 /end CHARACTERISTIC
/begin CHARACTERISTIC K_ED_DK_INIT.KLASSENINDEX "Auswahl der Fehlerklasse" VALUE 0x70F38 TKW_VV_VV_UB 100.0 FORMULA_0003 0.0 8.0 /end CHARACTERISTIC
/begin CHARACTERISTIC K_ED_DK_INIT.OK_SCHWELLE "Filterschwelle fuer Fehleraustrag" VALUE 0x70F33 TKW_VV_VV_UB 100.0 FORMULA_0003 0.0 255.0 /end CHARACTERISTIC
/begin CHARACTERISTIC K_ED_DK_INIT.P_CODE_OPENLOAD "P-Code fuer die Art OPENLOAD" VALUE 0x70F2E TKW_VV_VV_UW 100.0 FORMULA_0010 0.0 65535.0 /end CHARACTERISTIC
/begin CHARACTERISTIC K_ED_DK_INIT.P_CODE_SH_TO_GND "P-Code fuer die Art SH_TO_GND" VALUE 0x70F2C TKW_VV_VV_UW 100.0 FORMULA_0010 0.0 65535.0 /end CHARACTERISTIC
/begin CHARACTERISTIC K_ED_DK_INIT.P_CODE_SH_TO_UB "P-Code fuer die Art SH_TO_UB" VALUE 0x70F2A TKW_VV_VV_UW 100.0 FORMULA_0010 0.0 65535.0 /end CHARACTERISTIC
/begin CHARACTERISTIC K_ED_DK_INIT.P_CODE_UNPLAUSIBEL "P-Code fuer die Art UNPLAUSIBEL" VALUE 0x70F30 TKW_VV_VV_UW 100.0 FORMULA_0010 0.0 65535.0 /end CHARACTERISTIC
/begin CHARACTERISTIC K_ED_DK1_ADAPT.DEC_NACH_EINTRAG "Filterverringerung nach Fehlerspeichereintrag" VALUE 0x70F85 TKW_VV_VV_UB 100.0 FORMULA_0003 0.0 255.0 /end CHARACTERISTIC
/begin CHARACTERISTIC K_ED_DK1_ADAPT.DEC_VOR_EINTRAG "Filterverringerung vorm Fehlerspeichereintrag" VALUE 0x70F83 TKW_VV_VV_UB 100.0 FORMULA_0003 0.0 255.0 /end CHARACTERISTIC
/begin CHARACTERISTIC K_ED_DK1_ADAPT.FEHLERSCHWELLE "Filterschwelle fuer Fehlereintrag" VALUE 0x70F80 TKW_VV_VV_UB 100.0 FORMULA_0003 0.0 255.0 /end CHARACTERISTIC
/begin CHARACTERISTIC K_ED_DK1_ADAPT.INC_NACH_EINTRAG "Filtererhoehung nach Fehlerspeichereintrag" VALUE 0x70F84 TKW_VV_VV_UB 100.0 FORMULA_0003 0.0 255.0 /end CHARACTERISTIC
/begin CHARACTERISTIC K_ED_DK1_ADAPT.INC_VOR_EINTRAG "Filtererhoehung vorm Fehlerspeichereintrag" VALUE 0x70F82 TKW_VV_VV_UB 100.0 FORMULA_0003 0.0 255.0 /end CHARACTERISTIC
/begin CHARACTERISTIC K_ED_DK1_ADAPT.KLASSENINDEX "Auswahl der Fehlerklasse" VALUE 0x70F86 TKW_VV_VV_UB 100.0 FORMULA_0003 0.0 8.0 /end CHARACTERISTIC
/begin CHARACTERISTIC K_ED_DK1_ADAPT.OK_SCHWELLE "Filterschwelle fuer Fehleraustrag" VALUE 0x70F81 TKW_VV_VV_UB 100.0 FORMULA_0003 0.0 255.0 /end CHARACTERISTIC
/begin CHARACTERISTIC K_ED_DK1_ADAPT.P_CODE_OPENLOAD "P-Code fuer die Art OPENLOAD" VALUE 0x70F7C TKW_VV_VV_UW 100.0 FORMULA_0010 0.0 65535.0 /end CHARACTERISTIC
/begin CHARACTERISTIC K_ED_DK1_ADAPT.P_CODE_SH_TO_GND "P-Code fuer die Art SH_TO_GND" VALUE 0x70F7A TKW_VV_VV_UW 100.0 FORMULA_0010 0.0 65535.0 /end CHARACTERISTIC
/begin CHARACTERISTIC K_ED_DK1_ADAPT.P_CODE_SH_TO_UB "P-Code fuer die Art SH_TO_UB" VALUE 0x70F78 TKW_VV_VV_UW 100.0 FORMULA_0010 0.0 65535.0 /end CHARACTERISTIC
/begin CHARACTERISTIC K_ED_DK1_ADAPT.P_CODE_UNPLAUSIBEL "P-Code fuer die Art UNPLAUSIBEL" VALUE 0x70F7E TKW_VV_VV_UW 100.0 FORMULA_0010 0.0 65535.0 /end CHARACTERISTIC
/begin CHARACTERISTIC K_ED_DK1_CAN.DEC_NACH_EINTRAG "Filterverringerung nach Fehlerspeichereintrag" VALUE 0x70E4D TKW_VV_VV_UB 100.0 FORMULA_0003 0.0 255.0 /end CHARACTERISTIC
/begin CHARACTERISTIC K_ED_DK1_CAN.DEC_VOR_EINTRAG "Filterverringerung vorm Fehlerspeichereintrag" VALUE 0x70E4B TKW_VV_VV_UB 100.0 FORMULA_0003 0.0 255.0 /end CHARACTERISTIC
/begin CHARACTERISTIC K_ED_DK1_CAN.FEHLERSCHWELLE "Filterschwelle fuer Fehlereintrag" VALUE 0x70E48 TKW_VV_VV_UB 100.0 FORMULA_0003 0.0 255.0 /end CHARACTERISTIC
/begin CHARACTERISTIC K_ED_DK1_CAN.INC_NACH_EINTRAG "Filtererhoehung nach Fehlerspeichereintrag" VALUE 0x70E4C TKW_VV_VV_UB 100.0 FORMULA_0003 0.0 255.0 /end CHARACTERISTIC
/begin CHARACTERISTIC K_ED_DK1_CAN.INC_VOR_EINTRAG "Filtererhoehung vorm Fehlerspeichereintrag" VALUE 0x70E4A TKW_VV_VV_UB 100.0 FORMULA_0003 0.0 255.0 /end CHARACTERISTIC
/begin CHARACTERISTIC K_ED_DK1_CAN.KLASSENINDEX "Auswahl der Fehlerklasse" VALUE 0x70E4E TKW_VV_VV_UB 100.0 FORMULA_0003 0.0 8.0 /end CHARACTERISTIC
/begin CHARACTERISTIC K_ED_DK1_CAN.OK_SCHWELLE "Filterschwelle fuer Fehleraustrag" VALUE 0x70E49 TKW_VV_VV_UB 100.0 FORMULA_0003 0.0 255.0 /end CHARACTERISTIC
/begin CHARACTERISTIC K_ED_DK1_CAN.P_CODE_OPENLOAD "P-Code fuer die Art OPENLOAD" VALUE 0x70E44 TKW_VV_VV_UW 100.0 FORMULA_0010 0.0 65535.0 /end CHARACTERISTIC
/begin CHARACTERISTIC K_ED_DK1_CAN.P_CODE_SH_TO_GND "P-Code fuer die Art SH_TO_GND" VALUE 0x70E42 TKW_VV_VV_UW 100.0 FORMULA_0010 0.0 65535.0 /end CHARACTERISTIC
/begin CHARACTERISTIC K_ED_DK1_CAN.P_CODE_SH_TO_UB "P-Code fuer die Art SH_TO_UB" VALUE 0x70E40 TKW_VV_VV_UW 100.0 FORMULA_0010 0.0 65535.0 /end CHARACTERISTIC
/begin CHARACTERISTIC K_ED_DK1_CAN.P_CODE_UNPLAUSIBEL "P-Code fuer die Art UNPLAUSIBEL" VALUE 0x70E46 TKW_VV_VV_UW 100.0 FORMULA_0010 0.0 65535.0 /end CHARACTERISTIC
/begin CHARACTERISTIC K_ED_DK1_CMD.DEC_NACH_EINTRAG "Filterverringerung nach Fehlerspeichereintrag" VALUE 0x711A7 TKW_VV_VV_UB 100.0 FORMULA_0003 0.0 255.0 /end CHARACTERISTIC
/begin CHARACTERISTIC K_ED_DK1_CMD.DEC_VOR_EINTRAG "Filterverringerung vorm Fehlerspeichereintrag" VALUE 0x711A5 TKW_VV_VV_UB 100.0 FORMULA_0003 0.0 255.0 /end CHARACTERISTIC
/begin CHARACTERISTIC K_ED_DK1_CMD.FEHLERSCHWELLE "Filterschwelle fuer Fehlereintrag" VALUE 0x711A2 TKW_VV_VV_UB 100.0 FORMULA_0003 0.0 255.0 /end CHARACTERISTIC
/begin CHARACTERISTIC K_ED_DK1_CMD.INC_NACH_EINTRAG "Filtererhoehung nach Fehlerspeichereintrag" VALUE 0x711A6 TKW_VV_VV_UB 100.0 FORMULA_0003 0.0 255.0 /end CHARACTERISTIC
/begin CHARACTERISTIC K_ED_DK1_CMD.INC_VOR_EINTRAG "Filtererhoehung vorm Fehlerspeichereintrag" VALUE 0x711A4 TKW_VV_VV_UB 100.0 FORMULA_0003 0.0 255.0 /end CHARACTERISTIC
/begin CHARACTERISTIC K_ED_DK1_CMD.KLASSENINDEX "Auswahl der Fehlerklasse" VALUE 0x711A8 TKW_VV_VV_UB 100.0 FORMULA_0003 0.0 8.0 /end CHARACTERISTIC
/begin CHARACTERISTIC K_ED_DK1_CMD.OK_SCHWELLE "Filterschwelle fuer Fehleraustrag" VALUE 0x711A3 TKW_VV_VV_UB 100.0 FORMULA_0003 0.0 255.0 /end CHARACTERISTIC
/begin CHARACTERISTIC K_ED_DK1_CMD.P_CODE_OPENLOAD "P-Code fuer die Art OPENLOAD" VALUE 0x7119E TKW_VV_VV_UW 100.0 FORMULA_0010 0.0 65535.0 /end CHARACTERISTIC
/begin CHARACTERISTIC K_ED_DK1_CMD.P_CODE_SH_TO_GND "P-Code fuer die Art SH_TO_GND" VALUE 0x7119C TKW_VV_VV_UW 100.0 FORMULA_0010 0.0 65535.0 /end CHARACTERISTIC
/begin CHARACTERISTIC K_ED_DK1_CMD.P_CODE_SH_TO_UB "P-Code fuer die Art SH_TO_UB" VALUE 0x7119A TKW_VV_VV_UW 100.0 FORMULA_0010 0.0 65535.0 /end CHARACTERISTIC
/begin CHARACTERISTIC K_ED_DK1_CMD.P_CODE_UNPLAUSIBEL "P-Code fuer die Art UNPLAUSIBEL" VALUE 0x711A0 TKW_VV_VV_UW 100.0 FORMULA_0010 0.0 65535.0 /end CHARACTERISTIC
/begin CHARACTERISTIC K_ED_DK1_FEDERN.DEC_NACH_EINTRAG "Filterverringerung nach Fehlerspeichereintrag" VALUE 0x71125 TKW_VV_VV_UB 100.0 FORMULA_0003 0.0 255.0 /end CHARACTERISTIC
/begin CHARACTERISTIC K_ED_DK1_FEDERN.DEC_VOR_EINTRAG "Filterverringerung vorm Fehlerspeichereintrag" VALUE 0x71123 TKW_VV_VV_UB 100.0 FORMULA_0003 0.0 255.0 /end CHARACTERISTIC
/begin CHARACTERISTIC K_ED_DK1_FEDERN.FEHLERSCHWELLE "Filterschwelle fuer Fehlereintrag" VALUE 0x71120 TKW_VV_VV_UB 100.0 FORMULA_0003 0.0 255.0 /end CHARACTERISTIC
/begin CHARACTERISTIC K_ED_DK1_FEDERN.INC_NACH_EINTRAG "Filtererhoehung nach Fehlerspeichereintrag" VALUE 0x71124 TKW_VV_VV_UB 100.0 FORMULA_0003 0.0 255.0 /end CHARACTERISTIC
/begin CHARACTERISTIC K_ED_DK1_FEDERN.INC_VOR_EINTRAG "Filtererhoehung vorm Fehlerspeichereintrag" VALUE 0x71122 TKW_VV_VV_UB 100.0 FORMULA_0003 0.0 255.0 /end CHARACTERISTIC
/begin CHARACTERISTIC K_ED_DK1_FEDERN.KLASSENINDEX "Auswahl der Fehlerklasse" VALUE 0x71126 TKW_VV_VV_UB 100.0 FORMULA_0003 0.0 8.0 /end CHARACTERISTIC
/begin CHARACTERISTIC K_ED_DK1_FEDERN.OK_SCHWELLE "Filterschwelle fuer Fehleraustrag" VALUE 0x71121 TKW_VV_VV_UB 100.0 FORMULA_0003 0.0 255.0 /end CHARACTERISTIC
/begin CHARACTERISTIC K_ED_DK1_FEDERN.P_CODE_OPENLOAD "P-Code fuer die Art OPENLOAD" VALUE 0x7111C TKW_VV_VV_UW 100.0 FORMULA_0010 0.0 65535.0 /end CHARACTERISTIC
/begin CHARACTERISTIC K_ED_DK1_FEDERN.P_CODE_SH_TO_GND "P-Code fuer die Art SH_TO_GND" VALUE 0x7111A TKW_VV_VV_UW 100.0 FORMULA_0010 0.0 65535.0 /end CHARACTERISTIC
/begin CHARACTERISTIC K_ED_DK1_FEDERN.P_CODE_SH_TO_UB "P-Code fuer die Art SH_TO_UB" VALUE 0x71118 TKW_VV_VV_UW 100.0 FORMULA_0010 0.0 65535.0 /end CHARACTERISTIC
/begin CHARACTERISTIC K_ED_DK1_FEDERN.P_CODE_UNPLAUSIBEL "P-Code fuer die Art UNPLAUSIBEL" VALUE 0x7111E TKW_VV_VV_UW 100.0 FORMULA_0010 0.0 65535.0 /end CHARACTERISTIC
/begin CHARACTERISTIC K_ED_DK1_PDR.DEC_NACH_EINTRAG "Filterverringerung nach Fehlerspeichereintrag" VALUE 0x71089 TKW_VV_VV_UB 100.0 FORMULA_0003 0.0 255.0 /end CHARACTERISTIC
/begin CHARACTERISTIC K_ED_DK1_PDR.DEC_VOR_EINTRAG "Filterverringerung vorm Fehlerspeichereintrag" VALUE 0x71087 TKW_VV_VV_UB 100.0 FORMULA_0003 0.0 255.0 /end CHARACTERISTIC
/begin CHARACTERISTIC K_ED_DK1_PDR.FEHLERSCHWELLE "Filterschwelle fuer Fehlereintrag" VALUE 0x71084 TKW_VV_VV_UB 100.0 FORMULA_0003 0.0 255.0 /end CHARACTERISTIC
/begin CHARACTERISTIC K_ED_DK1_PDR.INC_NACH_EINTRAG "Filtererhoehung nach Fehlerspeichereintrag" VALUE 0x71088 TKW_VV_VV_UB 100.0 FORMULA_0003 0.0 255.0 /end CHARACTERISTIC
/begin CHARACTERISTIC K_ED_DK1_PDR.INC_VOR_EINTRAG "Filtererhoehung vorm Fehlerspeichereintrag" VALUE 0x71086 TKW_VV_VV_UB 100.0 FORMULA_0003 0.0 255.0 /end CHARACTERISTIC
/begin CHARACTERISTIC K_ED_DK1_PDR.KLASSENINDEX "Auswahl der Fehlerklasse" VALUE 0x7108A TKW_VV_VV_UB 100.0 FORMULA_0003 0.0 8.0 /end CHARACTERISTIC
/begin CHARACTERISTIC K_ED_DK1_PDR.OK_SCHWELLE "Filterschwelle fuer Fehleraustrag" VALUE 0x71085 TKW_VV_VV_UB 100.0 FORMULA_0003 0.0 255.0 /end CHARACTERISTIC
/begin CHARACTERISTIC K_ED_DK1_PDR.P_CODE_OPENLOAD "P-Code fuer die Art OPENLOAD" VALUE 0x71080 TKW_VV_VV_UW 100.0 FORMULA_0010 0.0 65535.0 /end CHARACTERISTIC
/begin CHARACTERISTIC K_ED_DK1_PDR.P_CODE_SH_TO_GND "P-Code fuer die Art SH_TO_GND" VALUE 0x7107E TKW_VV_VV_UW 100.0 FORMULA_0010 0.0 65535.0 /end CHARACTERISTIC
/begin CHARACTERISTIC K_ED_DK1_PDR.P_CODE_SH_TO_UB "P-Code fuer die Art SH_TO_UB" VALUE 0x7107C TKW_VV_VV_UW 100.0 FORMULA_0010 0.0 65535.0 /end CHARACTERISTIC
/begin CHARACTERISTIC K_ED_DK1_PDR.P_CODE_UNPLAUSIBEL "P-Code fuer die Art UNPLAUSIBEL" VALUE 0x71082 TKW_VV_VV_UW 100.0 FORMULA_0010 0.0 65535.0 /end CHARACTERISTIC
/begin CHARACTERISTIC K_ED_DK1_REGLER.DEC_NACH_EINTRAG "Filterverringerung nach Fehlerspeichereintrag" VALUE 0x70F51 TKW_VV_VV_UB 100.0 FORMULA_0003 0.0 255.0 /end CHARACTERISTIC
/begin CHARACTERISTIC K_ED_DK1_REGLER.DEC_VOR_EINTRAG "Filterverringerung vorm Fehlerspeichereintrag" VALUE 0x70F4F TKW_VV_VV_UB 100.0 FORMULA_0003 0.0 255.0 /end CHARACTERISTIC
/begin CHARACTERISTIC K_ED_DK1_REGLER.FEHLERSCHWELLE "Filterschwelle fuer Fehlereintrag" VALUE 0x70F4C TKW_VV_VV_UB 100.0 FORMULA_0003 0.0 255.0 /end CHARACTERISTIC
/begin CHARACTERISTIC K_ED_DK1_REGLER.INC_NACH_EINTRAG "Filtererhoehung nach Fehlerspeichereintrag" VALUE 0x70F50 TKW_VV_VV_UB 100.0 FORMULA_0003 0.0 255.0 /end CHARACTERISTIC
/begin CHARACTERISTIC K_ED_DK1_REGLER.INC_VOR_EINTRAG "Filtererhoehung vorm Fehlerspeichereintrag" VALUE 0x70F4E TKW_VV_VV_UB 100.0 FORMULA_0003 0.0 255.0 /end CHARACTERISTIC
/begin CHARACTERISTIC K_ED_DK1_REGLER.KLASSENINDEX "Auswahl der Fehlerklasse" VALUE 0x70F52 TKW_VV_VV_UB 100.0 FORMULA_0003 0.0 8.0 /end CHARACTERISTIC
/begin CHARACTERISTIC K_ED_DK1_REGLER.OK_SCHWELLE "Filterschwelle fuer Fehleraustrag" VALUE 0x70F4D TKW_VV_VV_UB 100.0 FORMULA_0003 0.0 255.0 /end CHARACTERISTIC
/begin CHARACTERISTIC K_ED_DK1_REGLER.P_CODE_OPENLOAD "P-Code fuer die Art OPENLOAD" VALUE 0x70F48 TKW_VV_VV_UW 100.0 FORMULA_0010 0.0 65535.0 /end CHARACTERISTIC
/begin CHARACTERISTIC K_ED_DK1_REGLER.P_CODE_SH_TO_GND "P-Code fuer die Art SH_TO_GND" VALUE 0x70F46 TKW_VV_VV_UW 100.0 FORMULA_0010 0.0 65535.0 /end CHARACTERISTIC
/begin CHARACTERISTIC K_ED_DK1_REGLER.P_CODE_SH_TO_UB "P-Code fuer die Art SH_TO_UB" VALUE 0x70F44 TKW_VV_VV_UW 100.0 FORMULA_0010 0.0 65535.0 /end CHARACTERISTIC
/begin CHARACTERISTIC K_ED_DK1_REGLER.P_CODE_UNPLAUSIBEL "P-Code fuer die Art UNPLAUSIBEL" VALUE 0x70F4A TKW_VV_VV_UW 100.0 FORMULA_0010 0.0 65535.0 /end CHARACTERISTIC
/begin CHARACTERISTIC K_ED_DK1_SK_ERR.DEC_NACH_EINTRAG "Filterverringerung nach Fehlerspeichereintrag" VALUE 0x710F1 TKW_VV_VV_UB 100.0 FORMULA_0003 0.0 255.0 /end CHARACTERISTIC
/begin CHARACTERISTIC K_ED_DK1_SK_ERR.DEC_VOR_EINTRAG "Filterverringerung vorm Fehlerspeichereintrag" VALUE 0x710EF TKW_VV_VV_UB 100.0 FORMULA_0003 0.0 255.0 /end CHARACTERISTIC
/begin CHARACTERISTIC K_ED_DK1_SK_ERR.FEHLERSCHWELLE "Filterschwelle fuer Fehlereintrag" VALUE 0x710EC TKW_VV_VV_UB 100.0 FORMULA_0003 0.0 255.0 /end CHARACTERISTIC
/begin CHARACTERISTIC K_ED_DK1_SK_ERR.INC_NACH_EINTRAG "Filtererhoehung nach Fehlerspeichereintrag" VALUE 0x710F0 TKW_VV_VV_UB 100.0 FORMULA_0003 0.0 255.0 /end CHARACTERISTIC
/begin CHARACTERISTIC K_ED_DK1_SK_ERR.INC_VOR_EINTRAG "Filtererhoehung vorm Fehlerspeichereintrag" VALUE 0x710EE TKW_VV_VV_UB 100.0 FORMULA_0003 0.0 255.0 /end CHARACTERISTIC
/begin CHARACTERISTIC K_ED_DK1_SK_ERR.KLASSENINDEX "Auswahl der Fehlerklasse" VALUE 0x710F2 TKW_VV_VV_UB 100.0 FORMULA_0003 0.0 8.0 /end CHARACTERISTIC
/begin CHARACTERISTIC K_ED_DK1_SK_ERR.OK_SCHWELLE "Filterschwelle fuer Fehleraustrag" VALUE 0x710ED TKW_VV_VV_UB 100.0 FORMULA_0003 0.0 255.0 /end CHARACTERISTIC
/begin CHARACTERISTIC K_ED_DK1_SK_ERR.P_CODE_OPENLOAD "P-Code fuer die Art OPENLOAD" VALUE 0x710E8 TKW_VV_VV_UW 100.0 FORMULA_0010 0.0 65535.0 /end CHARACTERISTIC
/begin CHARACTERISTIC K_ED_DK1_SK_ERR.P_CODE_SH_TO_GND "P-Code fuer die Art SH_TO_GND" VALUE 0x710E6 TKW_VV_VV_UW 100.0 FORMULA_0010 0.0 65535.0 /end CHARACTERISTIC
/begin CHARACTERISTIC K_ED_DK1_SK_ERR.P_CODE_SH_TO_UB "P-Code fuer die Art SH_TO_UB" VALUE 0x710E4 TKW_VV_VV_UW 100.0 FORMULA_0010 0.0 65535.0 /end CHARACTERISTIC
/begin CHARACTERISTIC K_ED_DK1_SK_ERR.P_CODE_UNPLAUSIBEL "P-Code fuer die Art UNPLAUSIBEL" VALUE 0x710EA TKW_VV_VV_UW 100.0 FORMULA_0010 0.0 65535.0 /end CHARACTERISTIC
/begin CHARACTERISTIC K_ED_DK1_WDK.DEC_NACH_EINTRAG "Filterverringerung nach Fehlerspeichereintrag" VALUE 0x71055 TKW_VV_VV_UB 100.0 FORMULA_0003 0.0 255.0 /end CHARACTERISTIC
/begin CHARACTERISTIC K_ED_DK1_WDK.DEC_VOR_EINTRAG "Filterverringerung vorm Fehlerspeichereintrag" VALUE 0x71053 TKW_VV_VV_UB 100.0 FORMULA_0003 0.0 255.0 /end CHARACTERISTIC
/begin CHARACTERISTIC K_ED_DK1_WDK.FEHLERSCHWELLE "Filterschwelle fuer Fehlereintrag" VALUE 0x71050 TKW_VV_VV_UB 100.0 FORMULA_0003 0.0 255.0 /end CHARACTERISTIC
/begin CHARACTERISTIC K_ED_DK1_WDK.INC_NACH_EINTRAG "Filtererhoehung nach Fehlerspeichereintrag" VALUE 0x71054 TKW_VV_VV_UB 100.0 FORMULA_0003 0.0 255.0 /end CHARACTERISTIC
/begin CHARACTERISTIC K_ED_DK1_WDK.INC_VOR_EINTRAG "Filtererhoehung vorm Fehlerspeichereintrag" VALUE 0x71052 TKW_VV_VV_UB 100.0 FORMULA_0003 0.0 255.0 /end CHARACTERISTIC
/begin CHARACTERISTIC K_ED_DK1_WDK.KLASSENINDEX "Auswahl der Fehlerklasse" VALUE 0x71056 TKW_VV_VV_UB 100.0 FORMULA_0003 0.0 8.0 /end CHARACTERISTIC
/begin CHARACTERISTIC K_ED_DK1_WDK.OK_SCHWELLE "Filterschwelle fuer Fehleraustrag" VALUE 0x71051 TKW_VV_VV_UB 100.0 FORMULA_0003 0.0 255.0 /end CHARACTERISTIC
/begin CHARACTERISTIC K_ED_DK1_WDK.P_CODE_OPENLOAD "P-Code fuer die Art OPENLOAD" VALUE 0x7104C TKW_VV_VV_UW 100.0 FORMULA_0010 0.0 65535.0 /end CHARACTERISTIC
/begin CHARACTERISTIC K_ED_DK1_WDK.P_CODE_SH_TO_GND "P-Code fuer die Art SH_TO_GND" VALUE 0x7104A TKW_VV_VV_UW 100.0 FORMULA_0010 0.0 65535.0 /end CHARACTERISTIC
/begin CHARACTERISTIC K_ED_DK1_WDK.P_CODE_SH_TO_UB "P-Code fuer die Art SH_TO_UB" VALUE 0x71048 TKW_VV_VV_UW 100.0 FORMULA_0010 0.0 65535.0 /end CHARACTERISTIC
/begin CHARACTERISTIC K_ED_DK1_WDK.P_CODE_UNPLAUSIBEL "P-Code fuer die Art UNPLAUSIBEL" VALUE 0x7104E TKW_VV_VV_UW 100.0 FORMULA_0010 0.0 65535.0 /end CHARACTERISTIC
/begin CHARACTERISTIC K_ED_DK1_ZUST.DEC_NACH_EINTRAG "Filterverringerung nach Fehlerspeichereintrag" VALUE 0x7166D TKW_VV_VV_UB 100.0 FORMULA_0003 0.0 255.0 /end CHARACTERISTIC
/begin CHARACTERISTIC K_ED_DK1_ZUST.DEC_VOR_EINTRAG "Filterverringerung vorm Fehlerspeichereintrag" VALUE 0x7166B TKW_VV_VV_UB 100.0 FORMULA_0003 0.0 255.0 /end CHARACTERISTIC
/begin CHARACTERISTIC K_ED_DK1_ZUST.FEHLERSCHWELLE "Filterschwelle fuer Fehlereintrag" VALUE 0x71668 TKW_VV_VV_UB 100.0 FORMULA_0003 0.0 255.0 /end CHARACTERISTIC
/begin CHARACTERISTIC K_ED_DK1_ZUST.INC_NACH_EINTRAG "Filtererhoehung nach Fehlerspeichereintrag" VALUE 0x7166C TKW_VV_VV_UB 100.0 FORMULA_0003 0.0 255.0 /end CHARACTERISTIC
/begin CHARACTERISTIC K_ED_DK1_ZUST.INC_VOR_EINTRAG "Filtererhoehung vorm Fehlerspeichereintrag" VALUE 0x7166A TKW_VV_VV_UB 100.0 FORMULA_0003 0.0 255.0 /end CHARACTERISTIC
/begin CHARACTERISTIC K_ED_DK1_ZUST.KLASSENINDEX "Auswahl der Fehlerklasse" VALUE 0x7166E TKW_VV_VV_UB 100.0 FORMULA_0003 0.0 8.0 /end CHARACTERISTIC
/begin CHARACTERISTIC K_ED_DK1_ZUST.OK_SCHWELLE "Filterschwelle fuer Fehleraustrag" VALUE 0x71669 TKW_VV_VV_UB 100.0 FORMULA_0003 0.0 255.0 /end CHARACTERISTIC
/begin CHARACTERISTIC K_ED_DK1_ZUST.P_CODE_OPENLOAD "P-Code fuer die Art OPENLOAD" VALUE 0x71664 TKW_VV_VV_UW 100.0 FORMULA_0010 0.0 65535.0 /end CHARACTERISTIC
/begin CHARACTERISTIC K_ED_DK1_ZUST.P_CODE_SH_TO_GND "P-Code fuer die Art SH_TO_GND" VALUE 0x71662 TKW_VV_VV_UW 100.0 FORMULA_0010 0.0 65535.0 /end CHARACTERISTIC
/begin CHARACTERISTIC K_ED_DK1_ZUST.P_CODE_SH_TO_UB "P-Code fuer die Art SH_TO_UB" VALUE 0x71660 TKW_VV_VV_UW 100.0 FORMULA_0010 0.0 65535.0 /end CHARACTERISTIC
/begin CHARACTERISTIC K_ED_DK1_ZUST.P_CODE_UNPLAUSIBEL "P-Code fuer die Art UNPLAUSIBEL" VALUE 0x71666 TKW_VV_VV_UW 100.0 FORMULA_0010 0.0 65535.0 /end CHARACTERISTIC
/begin CHARACTERISTIC K_ED_DK2_ADAPT.DEC_NACH_EINTRAG "Filterverringerung nach Fehlerspeichereintrag" VALUE 0x70F9F TKW_VV_VV_UB 100.0 FORMULA_0003 0.0 255.0 /end CHARACTERISTIC
/begin CHARACTERISTIC K_ED_DK2_ADAPT.DEC_VOR_EINTRAG "Filterverringerung vorm Fehlerspeichereintrag" VALUE 0x70F9D TKW_VV_VV_UB 100.0 FORMULA_0003 0.0 255.0 /end CHARACTERISTIC
/begin CHARACTERISTIC K_ED_DK2_ADAPT.FEHLERSCHWELLE "Filterschwelle fuer Fehlereintrag" VALUE 0x70F9A TKW_VV_VV_UB 100.0 FORMULA_0003 0.0 255.0 /end CHARACTERISTIC
/begin CHARACTERISTIC K_ED_DK2_ADAPT.INC_NACH_EINTRAG "Filtererhoehung nach Fehlerspeichereintrag" VALUE 0x70F9E TKW_VV_VV_UB 100.0 FORMULA_0003 0.0 255.0 /end CHARACTERISTIC
/begin CHARACTERISTIC K_ED_DK2_ADAPT.INC_VOR_EINTRAG "Filtererhoehung vorm Fehlerspeichereintrag" VALUE 0x70F9C TKW_VV_VV_UB 100.0 FORMULA_0003 0.0 255.0 /end CHARACTERISTIC
/begin CHARACTERISTIC K_ED_DK2_ADAPT.KLASSENINDEX "Auswahl der Fehlerklasse" VALUE 0x70FA0 TKW_VV_VV_UB 100.0 FORMULA_0003 0.0 8.0 /end CHARACTERISTIC
/begin CHARACTERISTIC K_ED_DK2_ADAPT.OK_SCHWELLE "Filterschwelle fuer Fehleraustrag" VALUE 0x70F9B TKW_VV_VV_UB 100.0 FORMULA_0003 0.0 255.0 /end CHARACTERISTIC
/begin CHARACTERISTIC K_ED_DK2_ADAPT.P_CODE_OPENLOAD "P-Code fuer die Art OPENLOAD" VALUE 0x70F96 TKW_VV_VV_UW 100.0 FORMULA_0010 0.0 65535.0 /end CHARACTERISTIC
/begin CHARACTERISTIC K_ED_DK2_ADAPT.P_CODE_SH_TO_GND "P-Code fuer die Art SH_TO_GND" VALUE 0x70F94 TKW_VV_VV_UW 100.0 FORMULA_0010 0.0 65535.0 /end CHARACTERISTIC
/begin CHARACTERISTIC K_ED_DK2_ADAPT.P_CODE_SH_TO_UB "P-Code fuer die Art SH_TO_UB" VALUE 0x70F92 TKW_VV_VV_UW 100.0 FORMULA_0010 0.0 65535.0 /end CHARACTERISTIC
/begin CHARACTERISTIC K_ED_DK2_ADAPT.P_CODE_UNPLAUSIBEL "P-Code fuer die Art UNPLAUSIBEL" VALUE 0x70F98 TKW_VV_VV_UW 100.0 FORMULA_0010 0.0 65535.0 /end CHARACTERISTIC
/begin CHARACTERISTIC K_ED_DK2_CAN.DEC_NACH_EINTRAG "Filterverringerung nach Fehlerspeichereintrag" VALUE 0x70E67 TKW_VV_VV_UB 100.0 FORMULA_0003 0.0 255.0 /end CHARACTERISTIC
/begin CHARACTERISTIC K_ED_DK2_CAN.DEC_VOR_EINTRAG "Filterverringerung vorm Fehlerspeichereintrag" VALUE 0x70E65 TKW_VV_VV_UB 100.0 FORMULA_0003 0.0 255.0 /end CHARACTERISTIC
/begin CHARACTERISTIC K_ED_DK2_CAN.FEHLERSCHWELLE "Filterschwelle fuer Fehlereintrag" VALUE 0x70E62 TKW_VV_VV_UB 100.0 FORMULA_0003 0.0 255.0 /end CHARACTERISTIC
/begin CHARACTERISTIC K_ED_DK2_CAN.INC_NACH_EINTRAG "Filtererhoehung nach Fehlerspeichereintrag" VALUE 0x70E66 TKW_VV_VV_UB 100.0 FORMULA_0003 0.0 255.0 /end CHARACTERISTIC
/begin CHARACTERISTIC K_ED_DK2_CAN.INC_VOR_EINTRAG "Filtererhoehung vorm Fehlerspeichereintrag" VALUE 0x70E64 TKW_VV_VV_UB 100.0 FORMULA_0003 0.0 255.0 /end CHARACTERISTIC
/begin CHARACTERISTIC K_ED_DK2_CAN.KLASSENINDEX "Auswahl der Fehlerklasse" VALUE 0x70E68 TKW_VV_VV_UB 100.0 FORMULA_0003 0.0 8.0 /end CHARACTERISTIC
/begin CHARACTERISTIC K_ED_DK2_CAN.OK_SCHWELLE "Filterschwelle fuer Fehleraustrag" VALUE 0x70E63 TKW_VV_VV_UB 100.0 FORMULA_0003 0.0 255.0 /end CHARACTERISTIC
/begin CHARACTERISTIC K_ED_DK2_CAN.P_CODE_OPENLOAD "P-Code fuer die Art OPENLOAD" VALUE 0x70E5E TKW_VV_VV_UW 100.0 FORMULA_0010 0.0 65535.0 /end CHARACTERISTIC
/begin CHARACTERISTIC K_ED_DK2_CAN.P_CODE_SH_TO_GND "P-Code fuer die Art SH_TO_GND" VALUE 0x70E5C TKW_VV_VV_UW 100.0 FORMULA_0010 0.0 65535.0 /end CHARACTERISTIC
/begin CHARACTERISTIC K_ED_DK2_CAN.P_CODE_SH_TO_UB "P-Code fuer die Art SH_TO_UB" VALUE 0x70E5A TKW_VV_VV_UW 100.0 FORMULA_0010 0.0 65535.0 /end CHARACTERISTIC
/begin CHARACTERISTIC K_ED_DK2_CAN.P_CODE_UNPLAUSIBEL "P-Code fuer die Art UNPLAUSIBEL" VALUE 0x70E60 TKW_VV_VV_UW 100.0 FORMULA_0010 0.0 65535.0 /end CHARACTERISTIC
/begin CHARACTERISTIC K_ED_DK2_CMD.DEC_NACH_EINTRAG "Filterverringerung nach Fehlerspeichereintrag" VALUE 0x711C1 TKW_VV_VV_UB 100.0 FORMULA_0003 0.0 255.0 /end CHARACTERISTIC
/begin CHARACTERISTIC K_ED_DK2_CMD.DEC_VOR_EINTRAG "Filterverringerung vorm Fehlerspeichereintrag" VALUE 0x711BF TKW_VV_VV_UB 100.0 FORMULA_0003 0.0 255.0 /end CHARACTERISTIC
/begin CHARACTERISTIC K_ED_DK2_CMD.FEHLERSCHWELLE "Filterschwelle fuer Fehlereintrag" VALUE 0x711BC TKW_VV_VV_UB 100.0 FORMULA_0003 0.0 255.0 /end CHARACTERISTIC
/begin CHARACTERISTIC K_ED_DK2_CMD.INC_NACH_EINTRAG "Filtererhoehung nach Fehlerspeichereintrag" VALUE 0x711C0 TKW_VV_VV_UB 100.0 FORMULA_0003 0.0 255.0 /end CHARACTERISTIC
/begin CHARACTERISTIC K_ED_DK2_CMD.INC_VOR_EINTRAG "Filtererhoehung vorm Fehlerspeichereintrag" VALUE 0x711BE TKW_VV_VV_UB 100.0 FORMULA_0003 0.0 255.0 /end CHARACTERISTIC
/begin CHARACTERISTIC K_ED_DK2_CMD.KLASSENINDEX "Auswahl der Fehlerklasse" VALUE 0x711C2 TKW_VV_VV_UB 100.0 FORMULA_0003 0.0 8.0 /end CHARACTERISTIC
/begin CHARACTERISTIC K_ED_DK2_CMD.OK_SCHWELLE "Filterschwelle fuer Fehleraustrag" VALUE 0x711BD TKW_VV_VV_UB 100.0 FORMULA_0003 0.0 255.0 /end CHARACTERISTIC
/begin CHARACTERISTIC K_ED_DK2_CMD.P_CODE_OPENLOAD "P-Code fuer die Art OPENLOAD" VALUE 0x711B8 TKW_VV_VV_UW 100.0 FORMULA_0010 0.0 65535.0 /end CHARACTERISTIC
/begin CHARACTERISTIC K_ED_DK2_CMD.P_CODE_SH_TO_GND "P-Code fuer die Art SH_TO_GND" VALUE 0x711B6 TKW_VV_VV_UW 100.0 FORMULA_0010 0.0 65535.0 /end CHARACTERISTIC
/begin CHARACTERISTIC K_ED_DK2_CMD.P_CODE_SH_TO_UB "P-Code fuer die Art SH_TO_UB" VALUE 0x711B4 TKW_VV_VV_UW 100.0 FORMULA_0010 0.0 65535.0 /end CHARACTERISTIC
/begin CHARACTERISTIC K_ED_DK2_CMD.P_CODE_UNPLAUSIBEL "P-Code fuer die Art UNPLAUSIBEL" VALUE 0x711BA TKW_VV_VV_UW 100.0 FORMULA_0010 0.0 65535.0 /end CHARACTERISTIC
/begin CHARACTERISTIC K_ED_DK2_FEDERN.DEC_NACH_EINTRAG "Filterverringerung nach Fehlerspeichereintrag" VALUE 0x7113F TKW_VV_VV_UB 100.0 FORMULA_0003 0.0 255.0 /end CHARACTERISTIC
/begin CHARACTERISTIC K_ED_DK2_FEDERN.DEC_VOR_EINTRAG "Filterverringerung vorm Fehlerspeichereintrag" VALUE 0x7113D TKW_VV_VV_UB 100.0 FORMULA_0003 0.0 255.0 /end CHARACTERISTIC
/begin CHARACTERISTIC K_ED_DK2_FEDERN.FEHLERSCHWELLE "Filterschwelle fuer Fehlereintrag" VALUE 0x7113A TKW_VV_VV_UB 100.0 FORMULA_0003 0.0 255.0 /end CHARACTERISTIC
/begin CHARACTERISTIC K_ED_DK2_FEDERN.INC_NACH_EINTRAG "Filtererhoehung nach Fehlerspeichereintrag" VALUE 0x7113E TKW_VV_VV_UB 100.0 FORMULA_0003 0.0 255.0 /end CHARACTERISTIC
/begin CHARACTERISTIC K_ED_DK2_FEDERN.INC_VOR_EINTRAG "Filtererhoehung vorm Fehlerspeichereintrag" VALUE 0x7113C TKW_VV_VV_UB 100.0 FORMULA_0003 0.0 255.0 /end CHARACTERISTIC
/begin CHARACTERISTIC K_ED_DK2_FEDERN.KLASSENINDEX "Auswahl der Fehlerklasse" VALUE 0x71140 TKW_VV_VV_UB 100.0 FORMULA_0003 0.0 8.0 /end CHARACTERISTIC
/begin CHARACTERISTIC K_ED_DK2_FEDERN.OK_SCHWELLE "Filterschwelle fuer Fehleraustrag" VALUE 0x7113B TKW_VV_VV_UB 100.0 FORMULA_0003 0.0 255.0 /end CHARACTERISTIC
/begin CHARACTERISTIC K_ED_DK2_FEDERN.P_CODE_OPENLOAD "P-Code fuer die Art OPENLOAD" VALUE 0x71136 TKW_VV_VV_UW 100.0 FORMULA_0010 0.0 65535.0 /end CHARACTERISTIC
/begin CHARACTERISTIC K_ED_DK2_FEDERN.P_CODE_SH_TO_GND "P-Code fuer die Art SH_TO_GND" VALUE 0x71134 TKW_VV_VV_UW 100.0 FORMULA_0010 0.0 65535.0 /end CHARACTERISTIC
/begin CHARACTERISTIC K_ED_DK2_FEDERN.P_CODE_SH_TO_UB "P-Code fuer die Art SH_TO_UB" VALUE 0x71132 TKW_VV_VV_UW 100.0 FORMULA_0010 0.0 65535.0 /end CHARACTERISTIC
/begin CHARACTERISTIC K_ED_DK2_FEDERN.P_CODE_UNPLAUSIBEL "P-Code fuer die Art UNPLAUSIBEL" VALUE 0x71138 TKW_VV_VV_UW 100.0 FORMULA_0010 0.0 65535.0 /end CHARACTERISTIC
/begin CHARACTERISTIC K_ED_DK2_PDR.DEC_NACH_EINTRAG "Filterverringerung nach Fehlerspeichereintrag" VALUE 0x710A3 TKW_VV_VV_UB 100.0 FORMULA_0003 0.0 255.0 /end CHARACTERISTIC
/begin CHARACTERISTIC K_ED_DK2_PDR.DEC_VOR_EINTRAG "Filterverringerung vorm Fehlerspeichereintrag" VALUE 0x710A1 TKW_VV_VV_UB 100.0 FORMULA_0003 0.0 255.0 /end CHARACTERISTIC
/begin CHARACTERISTIC K_ED_DK2_PDR.FEHLERSCHWELLE "Filterschwelle fuer Fehlereintrag" VALUE 0x7109E TKW_VV_VV_UB 100.0 FORMULA_0003 0.0 255.0 /end CHARACTERISTIC
/begin CHARACTERISTIC K_ED_DK2_PDR.INC_NACH_EINTRAG "Filtererhoehung nach Fehlerspeichereintrag" VALUE 0x710A2 TKW_VV_VV_UB 100.0 FORMULA_0003 0.0 255.0 /end CHARACTERISTIC
/begin CHARACTERISTIC K_ED_DK2_PDR.INC_VOR_EINTRAG "Filtererhoehung vorm Fehlerspeichereintrag" VALUE 0x710A0 TKW_VV_VV_UB 100.0 FORMULA_0003 0.0 255.0 /end CHARACTERISTIC
/begin CHARACTERISTIC K_ED_DK2_PDR.KLASSENINDEX "Auswahl der Fehlerklasse" VALUE 0x710A4 TKW_VV_VV_UB 100.0 FORMULA_0003 0.0 8.0 /end CHARACTERISTIC
/begin CHARACTERISTIC K_ED_DK2_PDR.OK_SCHWELLE "Filterschwelle fuer Fehleraustrag" VALUE 0x7109F TKW_VV_VV_UB 100.0 FORMULA_0003 0.0 255.0 /end CHARACTERISTIC
/begin CHARACTERISTIC K_ED_DK2_PDR.P_CODE_OPENLOAD "P-Code fuer die Art OPENLOAD" VALUE 0x7109A TKW_VV_VV_UW 100.0 FORMULA_0010 0.0 65535.0 /end CHARACTERISTIC
/begin CHARACTERISTIC K_ED_DK2_PDR.P_CODE_SH_TO_GND "P-Code fuer die Art SH_TO_GND" VALUE 0x71098 TKW_VV_VV_UW 100.0 FORMULA_0010 0.0 65535.0 /end CHARACTERISTIC
/begin CHARACTERISTIC K_ED_DK2_PDR.P_CODE_SH_TO_UB "P-Code fuer die Art SH_TO_UB" VALUE 0x71096 TKW_VV_VV_UW 100.0 FORMULA_0010 0.0 65535.0 /end CHARACTERISTIC
/begin CHARACTERISTIC K_ED_DK2_PDR.P_CODE_UNPLAUSIBEL "P-Code fuer die Art UNPLAUSIBEL" VALUE 0x7109C TKW_VV_VV_UW 100.0 FORMULA_0010 0.0 65535.0 /end CHARACTERISTIC
/begin CHARACTERISTIC K_ED_DK2_REGLER.DEC_NACH_EINTRAG "Filterverringerung nach Fehlerspeichereintrag" VALUE 0x70F6B TKW_VV_VV_UB 100.0 FORMULA_0003 0.0 255.0 /end CHARACTERISTIC
/begin CHARACTERISTIC K_ED_DK2_REGLER.DEC_VOR_EINTRAG "Filterverringerung vorm Fehlerspeichereintrag" VALUE 0x70F69 TKW_VV_VV_UB 100.0 FORMULA_0003 0.0 255.0 /end CHARACTERISTIC
/begin CHARACTERISTIC K_ED_DK2_REGLER.FEHLERSCHWELLE "Filterschwelle fuer Fehlereintrag" VALUE 0x70F66 TKW_VV_VV_UB 100.0 FORMULA_0003 0.0 255.0 /end CHARACTERISTIC
/begin CHARACTERISTIC K_ED_DK2_REGLER.INC_NACH_EINTRAG "Filtererhoehung nach Fehlerspeichereintrag" VALUE 0x70F6A TKW_VV_VV_UB 100.0 FORMULA_0003 0.0 255.0 /end CHARACTERISTIC
/begin CHARACTERISTIC K_ED_DK2_REGLER.INC_VOR_EINTRAG "Filtererhoehung vorm Fehlerspeichereintrag" VALUE 0x70F68 TKW_VV_VV_UB 100.0 FORMULA_0003 0.0 255.0 /end CHARACTERISTIC
/begin CHARACTERISTIC K_ED_DK2_REGLER.KLASSENINDEX "Auswahl der Fehlerklasse" VALUE 0x70F6C TKW_VV_VV_UB 100.0 FORMULA_0003 0.0 8.0 /end CHARACTERISTIC
/begin CHARACTERISTIC K_ED_DK2_REGLER.OK_SCHWELLE "Filterschwelle fuer Fehleraustrag" VALUE 0x70F67 TKW_VV_VV_UB 100.0 FORMULA_0003 0.0 255.0 /end CHARACTERISTIC
/begin CHARACTERISTIC K_ED_DK2_REGLER.P_CODE_OPENLOAD "P-Code fuer die Art OPENLOAD" VALUE 0x70F62 TKW_VV_VV_UW 100.0 FORMULA_0010 0.0 65535.0 /end CHARACTERISTIC
/begin CHARACTERISTIC K_ED_DK2_REGLER.P_CODE_SH_TO_GND "P-Code fuer die Art SH_TO_GND" VALUE 0x70F60 TKW_VV_VV_UW 100.0 FORMULA_0010 0.0 65535.0 /end CHARACTERISTIC
/begin CHARACTERISTIC K_ED_DK2_REGLER.P_CODE_SH_TO_UB "P-Code fuer die Art SH_TO_UB" VALUE 0x70F5E TKW_VV_VV_UW 100.0 FORMULA_0010 0.0 65535.0 /end CHARACTERISTIC
/begin CHARACTERISTIC K_ED_DK2_REGLER.P_CODE_UNPLAUSIBEL "P-Code fuer die Art UNPLAUSIBEL" VALUE 0x70F64 TKW_VV_VV_UW 100.0 FORMULA_0010 0.0 65535.0 /end CHARACTERISTIC
/begin CHARACTERISTIC K_ED_DK2_SK_ERR.DEC_NACH_EINTRAG "Filterverringerung nach Fehlerspeichereintrag" VALUE 0x7110B TKW_VV_VV_UB 100.0 FORMULA_0003 0.0 255.0 /end CHARACTERISTIC
/begin CHARACTERISTIC K_ED_DK2_SK_ERR.DEC_VOR_EINTRAG "Filterverringerung vorm Fehlerspeichereintrag" VALUE 0x71109 TKW_VV_VV_UB 100.0 FORMULA_0003 0.0 255.0 /end CHARACTERISTIC
/begin CHARACTERISTIC K_ED_DK2_SK_ERR.FEHLERSCHWELLE "Filterschwelle fuer Fehlereintrag" VALUE 0x71106 TKW_VV_VV_UB 100.0 FORMULA_0003 0.0 255.0 /end CHARACTERISTIC
/begin CHARACTERISTIC K_ED_DK2_SK_ERR.INC_NACH_EINTRAG "Filtererhoehung nach Fehlerspeichereintrag" VALUE 0x7110A TKW_VV_VV_UB 100.0 FORMULA_0003 0.0 255.0 /end CHARACTERISTIC
/begin CHARACTERISTIC K_ED_DK2_SK_ERR.INC_VOR_EINTRAG "Filtererhoehung vorm Fehlerspeichereintrag" VALUE 0x71108 TKW_VV_VV_UB 100.0 FORMULA_0003 0.0 255.0 /end CHARACTERISTIC
/begin CHARACTERISTIC K_ED_DK2_SK_ERR.KLASSENINDEX "Auswahl der Fehlerklasse" VALUE 0x7110C TKW_VV_VV_UB 100.0 FORMULA_0003 0.0 8.0 /end CHARACTERISTIC
/begin CHARACTERISTIC K_ED_DK2_SK_ERR.OK_SCHWELLE "Filterschwelle fuer Fehleraustrag" VALUE 0x71107 TKW_VV_VV_UB 100.0 FORMULA_0003 0.0 255.0 /end CHARACTERISTIC
/begin CHARACTERISTIC K_ED_DK2_SK_ERR.P_CODE_OPENLOAD "P-Code fuer die Art OPENLOAD" VALUE 0x71102 TKW_VV_VV_UW 100.0 FORMULA_0010 0.0 65535.0 /end CHARACTERISTIC
/begin CHARACTERISTIC K_ED_DK2_SK_ERR.P_CODE_SH_TO_GND "P-Code fuer die Art SH_TO_GND" VALUE 0x71100 TKW_VV_VV_UW 100.0 FORMULA_0010 0.0 65535.0 /end CHARACTERISTIC
/begin CHARACTERISTIC K_ED_DK2_SK_ERR.P_CODE_SH_TO_UB "P-Code fuer die Art SH_TO_UB" VALUE 0x710FE TKW_VV_VV_UW 100.0 FORMULA_0010 0.0 65535.0 /end CHARACTERISTIC
/begin CHARACTERISTIC K_ED_DK2_SK_ERR.P_CODE_UNPLAUSIBEL "P-Code fuer die Art UNPLAUSIBEL" VALUE 0x71104 TKW_VV_VV_UW 100.0 FORMULA_0010 0.0 65535.0 /end CHARACTERISTIC
/begin CHARACTERISTIC K_ED_DK2_WDK.DEC_NACH_EINTRAG "Filterverringerung nach Fehlerspeichereintrag" VALUE 0x7106F TKW_VV_VV_UB 100.0 FORMULA_0003 0.0 255.0 /end CHARACTERISTIC
/begin CHARACTERISTIC K_ED_DK2_WDK.DEC_VOR_EINTRAG "Filterverringerung vorm Fehlerspeichereintrag" VALUE 0x7106D TKW_VV_VV_UB 100.0 FORMULA_0003 0.0 255.0 /end CHARACTERISTIC
/begin CHARACTERISTIC K_ED_DK2_WDK.FEHLERSCHWELLE "Filterschwelle fuer Fehlereintrag" VALUE 0x7106A TKW_VV_VV_UB 100.0 FORMULA_0003 0.0 255.0 /end CHARACTERISTIC
/begin CHARACTERISTIC K_ED_DK2_WDK.INC_NACH_EINTRAG "Filtererhoehung nach Fehlerspeichereintrag" VALUE 0x7106E TKW_VV_VV_UB 100.0 FORMULA_0003 0.0 255.0 /end CHARACTERISTIC
/begin CHARACTERISTIC K_ED_DK2_WDK.INC_VOR_EINTRAG "Filtererhoehung vorm Fehlerspeichereintrag" VALUE 0x7106C TKW_VV_VV_UB 100.0 FORMULA_0003 0.0 255.0 /end CHARACTERISTIC
/begin CHARACTERISTIC K_ED_DK2_WDK.KLASSENINDEX "Auswahl der Fehlerklasse" VALUE 0x71070 TKW_VV_VV_UB 100.0 FORMULA_0003 0.0 8.0 /end CHARACTERISTIC
/begin CHARACTERISTIC K_ED_DK2_WDK.OK_SCHWELLE "Filterschwelle fuer Fehleraustrag" VALUE 0x7106B TKW_VV_VV_UB 100.0 FORMULA_0003 0.0 255.0 /end CHARACTERISTIC
/begin CHARACTERISTIC K_ED_DK2_WDK.P_CODE_OPENLOAD "P-Code fuer die Art OPENLOAD" VALUE 0x71066 TKW_VV_VV_UW 100.0 FORMULA_0010 0.0 65535.0 /end CHARACTERISTIC
/begin CHARACTERISTIC K_ED_DK2_WDK.P_CODE_SH_TO_GND "P-Code fuer die Art SH_TO_GND" VALUE 0x71064 TKW_VV_VV_UW 100.0 FORMULA_0010 0.0 65535.0 /end CHARACTERISTIC
/begin CHARACTERISTIC K_ED_DK2_WDK.P_CODE_SH_TO_UB "P-Code fuer die Art SH_TO_UB" VALUE 0x71062 TKW_VV_VV_UW 100.0 FORMULA_0010 0.0 65535.0 /end CHARACTERISTIC
/begin CHARACTERISTIC K_ED_DK2_WDK.P_CODE_UNPLAUSIBEL "P-Code fuer die Art UNPLAUSIBEL" VALUE 0x71068 TKW_VV_VV_UW 100.0 FORMULA_0010 0.0 65535.0 /end CHARACTERISTIC
/begin CHARACTERISTIC K_ED_DK2_ZUST.DEC_NACH_EINTRAG "Filterverringerung nach Fehlerspeichereintrag" VALUE 0x71687 TKW_VV_VV_UB 100.0 FORMULA_0003 0.0 255.0 /end CHARACTERISTIC
/begin CHARACTERISTIC K_ED_DK2_ZUST.DEC_VOR_EINTRAG "Filterverringerung vorm Fehlerspeichereintrag" VALUE 0x71685 TKW_VV_VV_UB 100.0 FORMULA_0003 0.0 255.0 /end CHARACTERISTIC
/begin CHARACTERISTIC K_ED_DK2_ZUST.FEHLERSCHWELLE "Filterschwelle fuer Fehlereintrag" VALUE 0x71682 TKW_VV_VV_UB 100.0 FORMULA_0003 0.0 255.0 /end CHARACTERISTIC
/begin CHARACTERISTIC K_ED_DK2_ZUST.INC_NACH_EINTRAG "Filtererhoehung nach Fehlerspeichereintrag" VALUE 0x71686 TKW_VV_VV_UB 100.0 FORMULA_0003 0.0 255.0 /end CHARACTERISTIC
/begin CHARACTERISTIC K_ED_DK2_ZUST.INC_VOR_EINTRAG "Filtererhoehung vorm Fehlerspeichereintrag" VALUE 0x71684 TKW_VV_VV_UB 100.0 FORMULA_0003 0.0 255.0 /end CHARACTERISTIC
/begin CHARACTERISTIC K_ED_DK2_ZUST.KLASSENINDEX "Auswahl der Fehlerklasse" VALUE 0x71688 TKW_VV_VV_UB 100.0 FORMULA_0003 0.0 8.0 /end CHARACTERISTIC
/begin CHARACTERISTIC K_ED_DK2_ZUST.OK_SCHWELLE "Filterschwelle fuer Fehleraustrag" VALUE 0x71683 TKW_VV_VV_UB 100.0 FORMULA_0003 0.0 255.0 /end CHARACTERISTIC
/begin CHARACTERISTIC K_ED_DK2_ZUST.P_CODE_OPENLOAD "P-Code fuer die Art OPENLOAD" VALUE 0x7167E TKW_VV_VV_UW 100.0 FORMULA_0010 0.0 65535.0 /end CHARACTERISTIC
/begin CHARACTERISTIC K_ED_DK2_ZUST.P_CODE_SH_TO_GND "P-Code fuer die Art SH_TO_GND" VALUE 0x7167C TKW_VV_VV_UW 100.0 FORMULA_0010 0.0 65535.0 /end CHARACTERISTIC
/begin CHARACTERISTIC K_ED_DK2_ZUST.P_CODE_SH_TO_UB "P-Code fuer die Art SH_TO_UB" VALUE 0x7167A TKW_VV_VV_UW 100.0 FORMULA_0010 0.0 65535.0 /end CHARACTERISTIC
/begin CHARACTERISTIC K_ED_DK2_ZUST.P_CODE_UNPLAUSIBEL "P-Code fuer die Art UNPLAUSIBEL" VALUE 0x71680 TKW_VV_VV_UW 100.0 FORMULA_0010 0.0 65535.0 /end CHARACTERISTIC
/begin CHARACTERISTIC K_ED_DKG_EINGR.DEC_NACH_EINTRAG "Filterverringerung nach Fehlerspeichereintrag" VALUE 0x7154F TKW_VV_VV_UB 100.0 FORMULA_0003 0.0 255.0 /end CHARACTERISTIC
/begin CHARACTERISTIC K_ED_DKG_EINGR.DEC_VOR_EINTRAG "Filterverringerung vorm Fehlerspeichereintrag" VALUE 0x7154D TKW_VV_VV_UB 100.0 FORMULA_0003 0.0 255.0 /end CHARACTERISTIC
/begin CHARACTERISTIC K_ED_DKG_EINGR.FEHLERSCHWELLE "Filterschwelle fuer Fehlereintrag" VALUE 0x7154A TKW_VV_VV_UB 100.0 FORMULA_0003 0.0 255.0 /end CHARACTERISTIC
/begin CHARACTERISTIC K_ED_DKG_EINGR.INC_NACH_EINTRAG "Filtererhoehung nach Fehlerspeichereintrag" VALUE 0x7154E TKW_VV_VV_UB 100.0 FORMULA_0003 0.0 255.0 /end CHARACTERISTIC
/begin CHARACTERISTIC K_ED_DKG_EINGR.INC_VOR_EINTRAG "Filtererhoehung vorm Fehlerspeichereintrag" VALUE 0x7154C TKW_VV_VV_UB 100.0 FORMULA_0003 0.0 255.0 /end CHARACTERISTIC
/begin CHARACTERISTIC K_ED_DKG_EINGR.KLASSENINDEX "Auswahl der Fehlerklasse" VALUE 0x71550 TKW_VV_VV_UB 100.0 FORMULA_0003 0.0 8.0 /end CHARACTERISTIC
/begin CHARACTERISTIC K_ED_DKG_EINGR.OK_SCHWELLE "Filterschwelle fuer Fehleraustrag" VALUE 0x7154B TKW_VV_VV_UB 100.0 FORMULA_0003 0.0 255.0 /end CHARACTERISTIC
/begin CHARACTERISTIC K_ED_DKG_EINGR.P_CODE_OPENLOAD "P-Code fuer die Art OPENLOAD" VALUE 0x71546 TKW_VV_VV_UW 100.0 FORMULA_0010 0.0 65535.0 /end CHARACTERISTIC
/begin CHARACTERISTIC K_ED_DKG_EINGR.P_CODE_SH_TO_GND "P-Code fuer die Art SH_TO_GND" VALUE 0x71544 TKW_VV_VV_UW 100.0 FORMULA_0010 0.0 65535.0 /end CHARACTERISTIC
/begin CHARACTERISTIC K_ED_DKG_EINGR.P_CODE_SH_TO_UB "P-Code fuer die Art SH_TO_UB" VALUE 0x71542 TKW_VV_VV_UW 100.0 FORMULA_0010 0.0 65535.0 /end CHARACTERISTIC
/begin CHARACTERISTIC K_ED_DKG_EINGR.P_CODE_UNPLAUSIBEL "P-Code fuer die Art UNPLAUSIBEL" VALUE 0x71548 TKW_VV_VV_UW 100.0 FORMULA_0010 0.0 65535.0 /end CHARACTERISTIC
/begin CHARACTERISTIC K_ED_DSC_EINGR.DEC_NACH_EINTRAG "Filterverringerung nach Fehlerspeichereintrag" VALUE 0x7118D TKW_VV_VV_UB 100.0 FORMULA_0003 0.0 255.0 /end CHARACTERISTIC
/begin CHARACTERISTIC K_ED_DSC_EINGR.DEC_VOR_EINTRAG "Filterverringerung vorm Fehlerspeichereintrag" VALUE 0x7118B TKW_VV_VV_UB 100.0 FORMULA_0003 0.0 255.0 /end CHARACTERISTIC
/begin CHARACTERISTIC K_ED_DSC_EINGR.FEHLERSCHWELLE "Filterschwelle fuer Fehlereintrag" VALUE 0x71188 TKW_VV_VV_UB 100.0 FORMULA_0003 0.0 255.0 /end CHARACTERISTIC
/begin CHARACTERISTIC K_ED_DSC_EINGR.INC_NACH_EINTRAG "Filtererhoehung nach Fehlerspeichereintrag" VALUE 0x7118C TKW_VV_VV_UB 100.0 FORMULA_0003 0.0 255.0 /end CHARACTERISTIC
/begin CHARACTERISTIC K_ED_DSC_EINGR.INC_VOR_EINTRAG "Filtererhoehung vorm Fehlerspeichereintrag" VALUE 0x7118A TKW_VV_VV_UB 100.0 FORMULA_0003 0.0 255.0 /end CHARACTERISTIC
/begin CHARACTERISTIC K_ED_DSC_EINGR.KLASSENINDEX "Auswahl der Fehlerklasse" VALUE 0x7118E TKW_VV_VV_UB 100.0 FORMULA_0003 0.0 8.0 /end CHARACTERISTIC
/begin CHARACTERISTIC K_ED_DSC_EINGR.OK_SCHWELLE "Filterschwelle fuer Fehleraustrag" VALUE 0x71189 TKW_VV_VV_UB 100.0 FORMULA_0003 0.0 255.0 /end CHARACTERISTIC
/begin CHARACTERISTIC K_ED_DSC_EINGR.P_CODE_OPENLOAD "P-Code fuer die Art OPENLOAD" VALUE 0x71184 TKW_VV_VV_UW 100.0 FORMULA_0010 0.0 65535.0 /end CHARACTERISTIC
/begin CHARACTERISTIC K_ED_DSC_EINGR.P_CODE_SH_TO_GND "P-Code fuer die Art SH_TO_GND" VALUE 0x71182 TKW_VV_VV_UW 100.0 FORMULA_0010 0.0 65535.0 /end CHARACTERISTIC
/begin CHARACTERISTIC K_ED_DSC_EINGR.P_CODE_SH_TO_UB "P-Code fuer die Art SH_TO_UB" VALUE 0x71180 TKW_VV_VV_UW 100.0 FORMULA_0010 0.0 65535.0 /end CHARACTERISTIC
/begin CHARACTERISTIC K_ED_DSC_EINGR.P_CODE_UNPLAUSIBEL "P-Code fuer die Art UNPLAUSIBEL" VALUE 0x71186 TKW_VV_VV_UW 100.0 FORMULA_0010 0.0 65535.0 /end CHARACTERISTIC
/begin CHARACTERISTIC K_ED_E2_IGN.DEC_NACH_EINTRAG "Filterverringerung nach Fehlerspeichereintrag" VALUE 0x715D1 TKW_VV_VV_UB 100.0 FORMULA_0003 0.0 255.0 /end CHARACTERISTIC
/begin CHARACTERISTIC K_ED_E2_IGN.DEC_VOR_EINTRAG "Filterverringerung vorm Fehlerspeichereintrag" VALUE 0x715CF TKW_VV_VV_UB 100.0 FORMULA_0003 0.0 255.0 /end CHARACTERISTIC
/begin CHARACTERISTIC K_ED_E2_IGN.FEHLERSCHWELLE "Filterschwelle fuer Fehlereintrag" VALUE 0x715CC TKW_VV_VV_UB 100.0 FORMULA_0003 0.0 255.0 /end CHARACTERISTIC
/begin CHARACTERISTIC K_ED_E2_IGN.INC_NACH_EINTRAG "Filtererhoehung nach Fehlerspeichereintrag" VALUE 0x715D0 TKW_VV_VV_UB 100.0 FORMULA_0003 0.0 255.0 /end CHARACTERISTIC
/begin CHARACTERISTIC K_ED_E2_IGN.INC_VOR_EINTRAG "Filtererhoehung vorm Fehlerspeichereintrag" VALUE 0x715CE TKW_VV_VV_UB 100.0 FORMULA_0003 0.0 255.0 /end CHARACTERISTIC
/begin CHARACTERISTIC K_ED_E2_IGN.KLASSENINDEX "Auswahl der Fehlerklasse" VALUE 0x715D2 TKW_VV_VV_UB 100.0 FORMULA_0003 0.0 8.0 /end CHARACTERISTIC
/begin CHARACTERISTIC K_ED_E2_IGN.OK_SCHWELLE "Filterschwelle fuer Fehleraustrag" VALUE 0x715CD TKW_VV_VV_UB 100.0 FORMULA_0003 0.0 255.0 /end CHARACTERISTIC
/begin CHARACTERISTIC K_ED_E2_IGN.P_CODE_OPENLOAD "P-Code fuer die Art OPENLOAD" VALUE 0x715C8 TKW_VV_VV_UW 100.0 FORMULA_0010 0.0 65535.0 /end CHARACTERISTIC
/begin CHARACTERISTIC K_ED_E2_IGN.P_CODE_SH_TO_GND "P-Code fuer die Art SH_TO_GND" VALUE 0x715C6 TKW_VV_VV_UW 100.0 FORMULA_0010 0.0 65535.0 /end CHARACTERISTIC
/begin CHARACTERISTIC K_ED_E2_IGN.P_CODE_SH_TO_UB "P-Code fuer die Art SH_TO_UB" VALUE 0x715C4 TKW_VV_VV_UW 100.0 FORMULA_0010 0.0 65535.0 /end CHARACTERISTIC
/begin CHARACTERISTIC K_ED_E2_IGN.P_CODE_UNPLAUSIBEL "P-Code fuer die Art UNPLAUSIBEL" VALUE 0x715CA TKW_VV_VV_UW 100.0 FORMULA_0010 0.0 65535.0 /end CHARACTERISTIC
/begin CHARACTERISTIC K_ED_EC_BUSOFF.DEC_NACH_EINTRAG "Filterverringerung nach Fehlerspeichereintrag" VALUE 0x71277 TKW_VV_VV_UB 100.0 FORMULA_0003 0.0 255.0 /end CHARACTERISTIC
/begin CHARACTERISTIC K_ED_EC_BUSOFF.DEC_VOR_EINTRAG "Filterverringerung vorm Fehlerspeichereintrag" VALUE 0x71275 TKW_VV_VV_UB 100.0 FORMULA_0003 0.0 255.0 /end CHARACTERISTIC
/begin CHARACTERISTIC K_ED_EC_BUSOFF.FEHLERSCHWELLE "Filterschwelle fuer Fehlereintrag" VALUE 0x71272 TKW_VV_VV_UB 100.0 FORMULA_0003 0.0 255.0 /end CHARACTERISTIC
/begin CHARACTERISTIC K_ED_EC_BUSOFF.INC_NACH_EINTRAG "Filtererhoehung nach Fehlerspeichereintrag" VALUE 0x71276 TKW_VV_VV_UB 100.0 FORMULA_0003 0.0 255.0 /end CHARACTERISTIC
/begin CHARACTERISTIC K_ED_EC_BUSOFF.INC_VOR_EINTRAG "Filtererhoehung vorm Fehlerspeichereintrag" VALUE 0x71274 TKW_VV_VV_UB 100.0 FORMULA_0003 0.0 255.0 /end CHARACTERISTIC
/begin CHARACTERISTIC K_ED_EC_BUSOFF.KLASSENINDEX "Auswahl der Fehlerklasse" VALUE 0x71278 TKW_VV_VV_UB 100.0 FORMULA_0003 0.0 8.0 /end CHARACTERISTIC
/begin CHARACTERISTIC K_ED_EC_BUSOFF.OK_SCHWELLE "Filterschwelle fuer Fehleraustrag" VALUE 0x71273 TKW_VV_VV_UB 100.0 FORMULA_0003 0.0 255.0 /end CHARACTERISTIC
/begin CHARACTERISTIC K_ED_EC_BUSOFF.P_CODE_OPENLOAD "P-Code fuer die Art OPENLOAD" VALUE 0x7126E TKW_VV_VV_UW 100.0 FORMULA_0010 0.0 65535.0 /end CHARACTERISTIC
/begin CHARACTERISTIC K_ED_EC_BUSOFF.P_CODE_SH_TO_GND "P-Code fuer die Art SH_TO_GND" VALUE 0x7126C TKW_VV_VV_UW 100.0 FORMULA_0010 0.0 65535.0 /end CHARACTERISTIC
/begin CHARACTERISTIC K_ED_EC_BUSOFF.P_CODE_SH_TO_UB "P-Code fuer die Art SH_TO_UB" VALUE 0x7126A TKW_VV_VV_UW 100.0 FORMULA_0010 0.0 65535.0 /end CHARACTERISTIC
/begin CHARACTERISTIC K_ED_EC_BUSOFF.P_CODE_UNPLAUSIBEL "P-Code fuer die Art UNPLAUSIBEL" VALUE 0x71270 TKW_VV_VV_UW 100.0 FORMULA_0010 0.0 65535.0 /end CHARACTERISTIC
/begin CHARACTERISTIC K_ED_FGR_ABWURF.DEC_NACH_EINTRAG "Filterverringerung nach Fehlerspeichereintrag" VALUE 0x716A1 TKW_VV_VV_UB 100.0 FORMULA_0003 0.0 255.0 /end CHARACTERISTIC
/begin CHARACTERISTIC K_ED_FGR_ABWURF.DEC_VOR_EINTRAG "Filterverringerung vorm Fehlerspeichereintrag" VALUE 0x7169F TKW_VV_VV_UB 100.0 FORMULA_0003 0.0 255.0 /end CHARACTERISTIC
/begin CHARACTERISTIC K_ED_FGR_ABWURF.FEHLERSCHWELLE "Filterschwelle fuer Fehlereintrag" VALUE 0x7169C TKW_VV_VV_UB 100.0 FORMULA_0003 0.0 255.0 /end CHARACTERISTIC
/begin CHARACTERISTIC K_ED_FGR_ABWURF.INC_NACH_EINTRAG "Filtererhoehung nach Fehlerspeichereintrag" VALUE 0x716A0 TKW_VV_VV_UB 100.0 FORMULA_0003 0.0 255.0 /end CHARACTERISTIC
/begin CHARACTERISTIC K_ED_FGR_ABWURF.INC_VOR_EINTRAG "Filtererhoehung vorm Fehlerspeichereintrag" VALUE 0x7169E TKW_VV_VV_UB 100.0 FORMULA_0003 0.0 255.0 /end CHARACTERISTIC
/begin CHARACTERISTIC K_ED_FGR_ABWURF.KLASSENINDEX "Auswahl der Fehlerklasse" VALUE 0x716A2 TKW_VV_VV_UB 100.0 FORMULA_0003 0.0 8.0 /end CHARACTERISTIC
/begin CHARACTERISTIC K_ED_FGR_ABWURF.OK_SCHWELLE "Filterschwelle fuer Fehleraustrag" VALUE 0x7169D TKW_VV_VV_UB 100.0 FORMULA_0003 0.0 255.0 /end CHARACTERISTIC
/begin CHARACTERISTIC K_ED_FGR_ABWURF.P_CODE_OPENLOAD "P-Code fuer die Art OPENLOAD" VALUE 0x71698 TKW_VV_VV_UW 100.0 FORMULA_0010 0.0 65535.0 /end CHARACTERISTIC
/begin CHARACTERISTIC K_ED_FGR_ABWURF.P_CODE_SH_TO_GND "P-Code fuer die Art SH_TO_GND" VALUE 0x71696 TKW_VV_VV_UW 100.0 FORMULA_0010 0.0 65535.0 /end CHARACTERISTIC
/begin CHARACTERISTIC K_ED_FGR_ABWURF.P_CODE_SH_TO_UB "P-Code fuer die Art SH_TO_UB" VALUE 0x71694 TKW_VV_VV_UW 100.0 FORMULA_0010 0.0 65535.0 /end CHARACTERISTIC
/begin CHARACTERISTIC K_ED_FGR_ABWURF.P_CODE_UNPLAUSIBEL "P-Code fuer die Art UNPLAUSIBEL" VALUE 0x7169A TKW_VV_VV_UW 100.0 FORMULA_0010 0.0 65535.0 /end CHARACTERISTIC
/begin CHARACTERISTIC K_ED_INDEX_121_IGN.DEC_NACH_EINTRAG "Filterverringerung nach Fehlerspeichereintrag" VALUE 0x718A9 TKW_VV_VV_UB 100.0 FORMULA_0003 0.0 255.0 /end CHARACTERISTIC
/begin CHARACTERISTIC K_ED_INDEX_121_IGN.DEC_VOR_EINTRAG "Filterverringerung vorm Fehlerspeichereintrag" VALUE 0x718A7 TKW_VV_VV_UB 100.0 FORMULA_0003 0.0 255.0 /end CHARACTERISTIC
/begin CHARACTERISTIC K_ED_INDEX_121_IGN.FEHLERSCHWELLE "Filterschwelle fuer Fehlereintrag" VALUE 0x718A4 TKW_VV_VV_UB 100.0 FORMULA_0003 0.0 255.0 /end CHARACTERISTIC
/begin CHARACTERISTIC K_ED_INDEX_121_IGN.INC_NACH_EINTRAG "Filtererhoehung nach Fehlerspeichereintrag" VALUE 0x718A8 TKW_VV_VV_UB 100.0 FORMULA_0003 0.0 255.0 /end CHARACTERISTIC
/begin CHARACTERISTIC K_ED_INDEX_121_IGN.INC_VOR_EINTRAG "Filtererhoehung vorm Fehlerspeichereintrag" VALUE 0x718A6 TKW_VV_VV_UB 100.0 FORMULA_0003 0.0 255.0 /end CHARACTERISTIC
/begin CHARACTERISTIC K_ED_INDEX_121_IGN.KLASSENINDEX "Auswahl der Fehlerklasse" VALUE 0x718AA TKW_VV_VV_UB 100.0 FORMULA_0003 0.0 8.0 /end CHARACTERISTIC
/begin CHARACTERISTIC K_ED_INDEX_121_IGN.OK_SCHWELLE "Filterschwelle fuer Fehleraustrag" VALUE 0x718A5 TKW_VV_VV_UB 100.0 FORMULA_0003 0.0 255.0 /end CHARACTERISTIC
/begin CHARACTERISTIC K_ED_INDEX_121_IGN.P_CODE_OPENLOAD "P-Code fuer die Art OPENLOAD" VALUE 0x718A0 TKW_VV_VV_UW 100.0 FORMULA_0010 0.0 65535.0 /end CHARACTERISTIC
/begin CHARACTERISTIC K_ED_INDEX_121_IGN.P_CODE_SH_TO_GND "P-Code fuer die Art SH_TO_GND" VALUE 0x7189E TKW_VV_VV_UW 100.0 FORMULA_0010 0.0 65535.0 /end CHARACTERISTIC
/begin CHARACTERISTIC K_ED_INDEX_121_IGN.P_CODE_SH_TO_UB "P-Code fuer die Art SH_TO_UB" VALUE 0x7189C TKW_VV_VV_UW 100.0 FORMULA_0010 0.0 65535.0 /end CHARACTERISTIC
/begin CHARACTERISTIC K_ED_INDEX_121_IGN.P_CODE_UNPLAUSIBEL "P-Code fuer die Art UNPLAUSIBEL" VALUE 0x718A2 TKW_VV_VV_UW 100.0 FORMULA_0010 0.0 65535.0 /end CHARACTERISTIC
/begin CHARACTERISTIC K_ED_INDEX_122_IGN.DEC_NACH_EINTRAG "Filterverringerung nach Fehlerspeichereintrag" VALUE 0x718C3 TKW_VV_VV_UB 100.0 FORMULA_0003 0.0 255.0 /end CHARACTERISTIC
/begin CHARACTERISTIC K_ED_INDEX_122_IGN.DEC_VOR_EINTRAG "Filterverringerung vorm Fehlerspeichereintrag" VALUE 0x718C1 TKW_VV_VV_UB 100.0 FORMULA_0003 0.0 255.0 /end CHARACTERISTIC
/begin CHARACTERISTIC K_ED_INDEX_122_IGN.FEHLERSCHWELLE "Filterschwelle fuer Fehlereintrag" VALUE 0x718BE TKW_VV_VV_UB 100.0 FORMULA_0003 0.0 255.0 /end CHARACTERISTIC
/begin CHARACTERISTIC K_ED_INDEX_122_IGN.INC_NACH_EINTRAG "Filtererhoehung nach Fehlerspeichereintrag" VALUE 0x718C2 TKW_VV_VV_UB 100.0 FORMULA_0003 0.0 255.0 /end CHARACTERISTIC
/begin CHARACTERISTIC K_ED_INDEX_122_IGN.INC_VOR_EINTRAG "Filtererhoehung vorm Fehlerspeichereintrag" VALUE 0x718C0 TKW_VV_VV_UB 100.0 FORMULA_0003 0.0 255.0 /end CHARACTERISTIC
/begin CHARACTERISTIC K_ED_INDEX_122_IGN.KLASSENINDEX "Auswahl der Fehlerklasse" VALUE 0x718C4 TKW_VV_VV_UB 100.0 FORMULA_0003 0.0 8.0 /end CHARACTERISTIC
/begin CHARACTERISTIC K_ED_INDEX_122_IGN.OK_SCHWELLE "Filterschwelle fuer Fehleraustrag" VALUE 0x718BF TKW_VV_VV_UB 100.0 FORMULA_0003 0.0 255.0 /end CHARACTERISTIC
/begin CHARACTERISTIC K_ED_INDEX_122_IGN.P_CODE_OPENLOAD "P-Code fuer die Art OPENLOAD" VALUE 0x718BA TKW_VV_VV_UW 100.0 FORMULA_0010 0.0 65535.0 /end CHARACTERISTIC
/begin CHARACTERISTIC K_ED_INDEX_122_IGN.P_CODE_SH_TO_GND "P-Code fuer die Art SH_TO_GND" VALUE 0x718B8 TKW_VV_VV_UW 100.0 FORMULA_0010 0.0 65535.0 /end CHARACTERISTIC
/begin CHARACTERISTIC K_ED_INDEX_122_IGN.P_CODE_SH_TO_UB "P-Code fuer die Art SH_TO_UB" VALUE 0x718B6 TKW_VV_VV_UW 100.0 FORMULA_0010 0.0 65535.0 /end CHARACTERISTIC
/begin CHARACTERISTIC K_ED_INDEX_122_IGN.P_CODE_UNPLAUSIBEL "P-Code fuer die Art UNPLAUSIBEL" VALUE 0x718BC TKW_VV_VV_UW 100.0 FORMULA_0010 0.0 65535.0 /end CHARACTERISTIC
/begin CHARACTERISTIC K_ED_INDEX_123_IGN.DEC_NACH_EINTRAG "Filterverringerung nach Fehlerspeichereintrag" VALUE 0x718DD TKW_VV_VV_UB 100.0 FORMULA_0003 0.0 255.0 /end CHARACTERISTIC
/begin CHARACTERISTIC K_ED_INDEX_123_IGN.DEC_VOR_EINTRAG "Filterverringerung vorm Fehlerspeichereintrag" VALUE 0x718DB TKW_VV_VV_UB 100.0 FORMULA_0003 0.0 255.0 /end CHARACTERISTIC
/begin CHARACTERISTIC K_ED_INDEX_123_IGN.FEHLERSCHWELLE "Filterschwelle fuer Fehlereintrag" VALUE 0x718D8 TKW_VV_VV_UB 100.0 FORMULA_0003 0.0 255.0 /end CHARACTERISTIC
/begin CHARACTERISTIC K_ED_INDEX_123_IGN.INC_NACH_EINTRAG "Filtererhoehung nach Fehlerspeichereintrag" VALUE 0x718DC TKW_VV_VV_UB 100.0 FORMULA_0003 0.0 255.0 /end CHARACTERISTIC
/begin CHARACTERISTIC K_ED_INDEX_123_IGN.INC_VOR_EINTRAG "Filtererhoehung vorm Fehlerspeichereintrag" VALUE 0x718DA TKW_VV_VV_UB 100.0 FORMULA_0003 0.0 255.0 /end CHARACTERISTIC
/begin CHARACTERISTIC K_ED_INDEX_123_IGN.KLASSENINDEX "Auswahl der Fehlerklasse" VALUE 0x718DE TKW_VV_VV_UB 100.0 FORMULA_0003 0.0 8.0 /end CHARACTERISTIC
/begin CHARACTERISTIC K_ED_INDEX_123_IGN.OK_SCHWELLE "Filterschwelle fuer Fehleraustrag" VALUE 0x718D9 TKW_VV_VV_UB 100.0 FORMULA_0003 0.0 255.0 /end CHARACTERISTIC
/begin CHARACTERISTIC K_ED_INDEX_123_IGN.P_CODE_OPENLOAD "P-Code fuer die Art OPENLOAD" VALUE 0x718D4 TKW_VV_VV_UW 100.0 FORMULA_0010 0.0 65535.0 /end CHARACTERISTIC
/begin CHARACTERISTIC K_ED_INDEX_123_IGN.P_CODE_SH_TO_GND "P-Code fuer die Art SH_TO_GND" VALUE 0x718D2 TKW_VV_VV_UW 100.0 FORMULA_0010 0.0 65535.0 /end CHARACTERISTIC
/begin CHARACTERISTIC K_ED_INDEX_123_IGN.P_CODE_SH_TO_UB "P-Code fuer die Art SH_TO_UB" VALUE 0x718D0 TKW_VV_VV_UW 100.0 FORMULA_0010 0.0 65535.0 /end CHARACTERISTIC
/begin CHARACTERISTIC K_ED_INDEX_123_IGN.P_CODE_UNPLAUSIBEL "P-Code fuer die Art UNPLAUSIBEL" VALUE 0x718D6 TKW_VV_VV_UW 100.0 FORMULA_0010 0.0 65535.0 /end CHARACTERISTIC
/begin CHARACTERISTIC K_ED_INDEX_124_IGN.DEC_NACH_EINTRAG "Filterverringerung nach Fehlerspeichereintrag" VALUE 0x718F7 TKW_VV_VV_UB 100.0 FORMULA_0003 0.0 255.0 /end CHARACTERISTIC
/begin CHARACTERISTIC K_ED_INDEX_124_IGN.DEC_VOR_EINTRAG "Filterverringerung vorm Fehlerspeichereintrag" VALUE 0x718F5 TKW_VV_VV_UB 100.0 FORMULA_0003 0.0 255.0 /end CHARACTERISTIC
/begin CHARACTERISTIC K_ED_INDEX_124_IGN.FEHLERSCHWELLE "Filterschwelle fuer Fehlereintrag" VALUE 0x718F2 TKW_VV_VV_UB 100.0 FORMULA_0003 0.0 255.0 /end CHARACTERISTIC
/begin CHARACTERISTIC K_ED_INDEX_124_IGN.INC_NACH_EINTRAG "Filtererhoehung nach Fehlerspeichereintrag" VALUE 0x718F6 TKW_VV_VV_UB 100.0 FORMULA_0003 0.0 255.0 /end CHARACTERISTIC
/begin CHARACTERISTIC K_ED_INDEX_124_IGN.INC_VOR_EINTRAG "Filtererhoehung vorm Fehlerspeichereintrag" VALUE 0x718F4 TKW_VV_VV_UB 100.0 FORMULA_0003 0.0 255.0 /end CHARACTERISTIC
/begin CHARACTERISTIC K_ED_INDEX_124_IGN.KLASSENINDEX "Auswahl der Fehlerklasse" VALUE 0x718F8 TKW_VV_VV_UB 100.0 FORMULA_0003 0.0 8.0 /end CHARACTERISTIC
/begin CHARACTERISTIC K_ED_INDEX_124_IGN.OK_SCHWELLE "Filterschwelle fuer Fehleraustrag" VALUE 0x718F3 TKW_VV_VV_UB 100.0 FORMULA_0003 0.0 255.0 /end CHARACTERISTIC
/begin CHARACTERISTIC K_ED_INDEX_124_IGN.P_CODE_OPENLOAD "P-Code fuer die Art OPENLOAD" VALUE 0x718EE TKW_VV_VV_UW 100.0 FORMULA_0010 0.0 65535.0 /end CHARACTERISTIC
/begin CHARACTERISTIC K_ED_INDEX_124_IGN.P_CODE_SH_TO_GND "P-Code fuer die Art SH_TO_GND" VALUE 0x718EC TKW_VV_VV_UW 100.0 FORMULA_0010 0.0 65535.0 /end CHARACTERISTIC
/begin CHARACTERISTIC K_ED_INDEX_124_IGN.P_CODE_SH_TO_UB "P-Code fuer die Art SH_TO_UB" VALUE 0x718EA TKW_VV_VV_UW 100.0 FORMULA_0010 0.0 65535.0 /end CHARACTERISTIC
/begin CHARACTERISTIC K_ED_INDEX_124_IGN.P_CODE_UNPLAUSIBEL "P-Code fuer die Art UNPLAUSIBEL" VALUE 0x718F0 TKW_VV_VV_UW 100.0 FORMULA_0010 0.0 65535.0 /end CHARACTERISTIC
/begin CHARACTERISTIC K_ED_INDEX_125_IGN.DEC_NACH_EINTRAG "Filterverringerung nach Fehlerspeichereintrag" VALUE 0x71911 TKW_VV_VV_UB 100.0 FORMULA_0003 0.0 255.0 /end CHARACTERISTIC
/begin CHARACTERISTIC K_ED_INDEX_125_IGN.DEC_VOR_EINTRAG "Filterverringerung vorm Fehlerspeichereintrag" VALUE 0x7190F TKW_VV_VV_UB 100.0 FORMULA_0003 0.0 255.0 /end CHARACTERISTIC
/begin CHARACTERISTIC K_ED_INDEX_125_IGN.FEHLERSCHWELLE "Filterschwelle fuer Fehlereintrag" VALUE 0x7190C TKW_VV_VV_UB 100.0 FORMULA_0003 0.0 255.0 /end CHARACTERISTIC
/begin CHARACTERISTIC K_ED_INDEX_125_IGN.INC_NACH_EINTRAG "Filtererhoehung nach Fehlerspeichereintrag" VALUE 0x71910 TKW_VV_VV_UB 100.0 FORMULA_0003 0.0 255.0 /end CHARACTERISTIC
/begin CHARACTERISTIC K_ED_INDEX_125_IGN.INC_VOR_EINTRAG "Filtererhoehung vorm Fehlerspeichereintrag" VALUE 0x7190E TKW_VV_VV_UB 100.0 FORMULA_0003 0.0 255.0 /end CHARACTERISTIC
/begin CHARACTERISTIC K_ED_INDEX_125_IGN.KLASSENINDEX "Auswahl der Fehlerklasse" VALUE 0x71912 TKW_VV_VV_UB 100.0 FORMULA_0003 0.0 8.0 /end CHARACTERISTIC
/begin CHARACTERISTIC K_ED_INDEX_125_IGN.OK_SCHWELLE "Filterschwelle fuer Fehleraustrag" VALUE 0x7190D TKW_VV_VV_UB 100.0 FORMULA_0003 0.0 255.0 /end CHARACTERISTIC
/begin CHARACTERISTIC K_ED_INDEX_125_IGN.P_CODE_OPENLOAD "P-Code fuer die Art OPENLOAD" VALUE 0x71908 TKW_VV_VV_UW 100.0 FORMULA_0010 0.0 65535.0 /end CHARACTERISTIC
/begin CHARACTERISTIC K_ED_INDEX_125_IGN.P_CODE_SH_TO_GND "P-Code fuer die Art SH_TO_GND" VALUE 0x71906 TKW_VV_VV_UW 100.0 FORMULA_0010 0.0 65535.0 /end CHARACTERISTIC
/begin CHARACTERISTIC K_ED_INDEX_125_IGN.P_CODE_SH_TO_UB "P-Code fuer die Art SH_TO_UB" VALUE 0x71904 TKW_VV_VV_UW 100.0 FORMULA_0010 0.0 65535.0 /end CHARACTERISTIC
/begin CHARACTERISTIC K_ED_INDEX_125_IGN.P_CODE_UNPLAUSIBEL "P-Code fuer die Art UNPLAUSIBEL" VALUE 0x7190A TKW_VV_VV_UW 100.0 FORMULA_0010 0.0 65535.0 /end CHARACTERISTIC
/begin CHARACTERISTIC K_ED_INDEX_126_IGN.DEC_NACH_EINTRAG "Filterverringerung nach Fehlerspeichereintrag" VALUE 0x7192B TKW_VV_VV_UB 100.0 FORMULA_0003 0.0 255.0 /end CHARACTERISTIC
/begin CHARACTERISTIC K_ED_INDEX_126_IGN.DEC_VOR_EINTRAG "Filterverringerung vorm Fehlerspeichereintrag" VALUE 0x71929 TKW_VV_VV_UB 100.0 FORMULA_0003 0.0 255.0 /end CHARACTERISTIC
/begin CHARACTERISTIC K_ED_INDEX_126_IGN.FEHLERSCHWELLE "Filterschwelle fuer Fehlereintrag" VALUE 0x71926 TKW_VV_VV_UB 100.0 FORMULA_0003 0.0 255.0 /end CHARACTERISTIC
/begin CHARACTERISTIC K_ED_INDEX_126_IGN.INC_NACH_EINTRAG "Filtererhoehung nach Fehlerspeichereintrag" VALUE 0x7192A TKW_VV_VV_UB 100.0 FORMULA_0003 0.0 255.0 /end CHARACTERISTIC
/begin CHARACTERISTIC K_ED_INDEX_126_IGN.INC_VOR_EINTRAG "Filtererhoehung vorm Fehlerspeichereintrag" VALUE 0x71928 TKW_VV_VV_UB 100.0 FORMULA_0003 0.0 255.0 /end CHARACTERISTIC
/begin CHARACTERISTIC K_ED_INDEX_126_IGN.KLASSENINDEX "Auswahl der Fehlerklasse" VALUE 0x7192C TKW_VV_VV_UB 100.0 FORMULA_0003 0.0 8.0 /end CHARACTERISTIC
/begin CHARACTERISTIC K_ED_INDEX_126_IGN.OK_SCHWELLE "Filterschwelle fuer Fehleraustrag" VALUE 0x71927 TKW_VV_VV_UB 100.0 FORMULA_0003 0.0 255.0 /end CHARACTERISTIC
/begin CHARACTERISTIC K_ED_INDEX_126_IGN.P_CODE_OPENLOAD "P-Code fuer die Art OPENLOAD" VALUE 0x71922 TKW_VV_VV_UW 100.0 FORMULA_0010 0.0 65535.0 /end CHARACTERISTIC
/begin CHARACTERISTIC K_ED_INDEX_126_IGN.P_CODE_SH_TO_GND "P-Code fuer die Art SH_TO_GND" VALUE 0x71920 TKW_VV_VV_UW 100.0 FORMULA_0010 0.0 65535.0 /end CHARACTERISTIC
/begin CHARACTERISTIC K_ED_INDEX_126_IGN.P_CODE_SH_TO_UB "P-Code fuer die Art SH_TO_UB" VALUE 0x7191E TKW_VV_VV_UW 100.0 FORMULA_0010 0.0 65535.0 /end CHARACTERISTIC
/begin CHARACTERISTIC K_ED_INDEX_126_IGN.P_CODE_UNPLAUSIBEL "P-Code fuer die Art UNPLAUSIBEL" VALUE 0x71924 TKW_VV_VV_UW 100.0 FORMULA_0010 0.0 65535.0 /end CHARACTERISTIC
/begin CHARACTERISTIC K_ED_INDEX_127_IGN.DEC_NACH_EINTRAG "Filterverringerung nach Fehlerspeichereintrag" VALUE 0x71945 TKW_VV_VV_UB 100.0 FORMULA_0003 0.0 255.0 /end CHARACTERISTIC
/begin CHARACTERISTIC K_ED_INDEX_127_IGN.DEC_VOR_EINTRAG "Filterverringerung vorm Fehlerspeichereintrag" VALUE 0x71943 TKW_VV_VV_UB 100.0 FORMULA_0003 0.0 255.0 /end CHARACTERISTIC
/begin CHARACTERISTIC K_ED_INDEX_127_IGN.FEHLERSCHWELLE "Filterschwelle fuer Fehlereintrag" VALUE 0x71940 TKW_VV_VV_UB 100.0 FORMULA_0003 0.0 255.0 /end CHARACTERISTIC
/begin CHARACTERISTIC K_ED_INDEX_127_IGN.INC_NACH_EINTRAG "Filtererhoehung nach Fehlerspeichereintrag" VALUE 0x71944 TKW_VV_VV_UB 100.0 FORMULA_0003 0.0 255.0 /end CHARACTERISTIC
/begin CHARACTERISTIC K_ED_INDEX_127_IGN.INC_VOR_EINTRAG "Filtererhoehung vorm Fehlerspeichereintrag" VALUE 0x71942 TKW_VV_VV_UB 100.0 FORMULA_0003 0.0 255.0 /end CHARACTERISTIC
/begin CHARACTERISTIC K_ED_INDEX_127_IGN.KLASSENINDEX "Auswahl der Fehlerklasse" VALUE 0x71946 TKW_VV_VV_UB 100.0 FORMULA_0003 0.0 8.0 /end CHARACTERISTIC
/begin CHARACTERISTIC K_ED_INDEX_127_IGN.OK_SCHWELLE "Filterschwelle fuer Fehleraustrag" VALUE 0x71941 TKW_VV_VV_UB 100.0 FORMULA_0003 0.0 255.0 /end CHARACTERISTIC
/begin CHARACTERISTIC K_ED_INDEX_127_IGN.P_CODE_OPENLOAD "P-Code fuer die Art OPENLOAD" VALUE 0x7193C TKW_VV_VV_UW 100.0 FORMULA_0010 0.0 65535.0 /end CHARACTERISTIC
/begin CHARACTERISTIC K_ED_INDEX_127_IGN.P_CODE_SH_TO_GND "P-Code fuer die Art SH_TO_GND" VALUE 0x7193A TKW_VV_VV_UW 100.0 FORMULA_0010 0.0 65535.0 /end CHARACTERISTIC
/begin CHARACTERISTIC K_ED_INDEX_127_IGN.P_CODE_SH_TO_UB "P-Code fuer die Art SH_TO_UB" VALUE 0x71938 TKW_VV_VV_UW 100.0 FORMULA_0010 0.0 65535.0 /end CHARACTERISTIC
/begin CHARACTERISTIC K_ED_INDEX_127_IGN.P_CODE_UNPLAUSIBEL "P-Code fuer die Art UNPLAUSIBEL" VALUE 0x7193E TKW_VV_VV_UW 100.0 FORMULA_0010 0.0 65535.0 /end CHARACTERISTIC
/begin CHARACTERISTIC K_ED_INDEX_33_IGN.DEC_NACH_EINTRAG "Filterverringerung nach Fehlerspeichereintrag" VALUE 0x70FB9 TKW_VV_VV_UB 100.0 FORMULA_0003 0.0 255.0 /end CHARACTERISTIC
/begin CHARACTERISTIC K_ED_INDEX_33_IGN.DEC_VOR_EINTRAG "Filterverringerung vorm Fehlerspeichereintrag" VALUE 0x70FB7 TKW_VV_VV_UB 100.0 FORMULA_0003 0.0 255.0 /end CHARACTERISTIC
/begin CHARACTERISTIC K_ED_INDEX_33_IGN.FEHLERSCHWELLE "Filterschwelle fuer Fehlereintrag" VALUE 0x70FB4 TKW_VV_VV_UB 100.0 FORMULA_0003 0.0 255.0 /end CHARACTERISTIC
/begin CHARACTERISTIC K_ED_INDEX_33_IGN.INC_NACH_EINTRAG "Filtererhoehung nach Fehlerspeichereintrag" VALUE 0x70FB8 TKW_VV_VV_UB 100.0 FORMULA_0003 0.0 255.0 /end CHARACTERISTIC
/begin CHARACTERISTIC K_ED_INDEX_33_IGN.INC_VOR_EINTRAG "Filtererhoehung vorm Fehlerspeichereintrag" VALUE 0x70FB6 TKW_VV_VV_UB 100.0 FORMULA_0003 0.0 255.0 /end CHARACTERISTIC
/begin CHARACTERISTIC K_ED_INDEX_33_IGN.KLASSENINDEX "Auswahl der Fehlerklasse" VALUE 0x70FBA TKW_VV_VV_UB 100.0 FORMULA_0003 0.0 8.0 /end CHARACTERISTIC
/begin CHARACTERISTIC K_ED_INDEX_33_IGN.OK_SCHWELLE "Filterschwelle fuer Fehleraustrag" VALUE 0x70FB5 TKW_VV_VV_UB 100.0 FORMULA_0003 0.0 255.0 /end CHARACTERISTIC
/begin CHARACTERISTIC K_ED_INDEX_33_IGN.P_CODE_OPENLOAD "P-Code fuer die Art OPENLOAD" VALUE 0x70FB0 TKW_VV_VV_UW 100.0 FORMULA_0010 0.0 65535.0 /end CHARACTERISTIC
/begin CHARACTERISTIC K_ED_INDEX_33_IGN.P_CODE_SH_TO_GND "P-Code fuer die Art SH_TO_GND" VALUE 0x70FAE TKW_VV_VV_UW 100.0 FORMULA_0010 0.0 65535.0 /end CHARACTERISTIC
/begin CHARACTERISTIC K_ED_INDEX_33_IGN.P_CODE_SH_TO_UB "P-Code fuer die Art SH_TO_UB" VALUE 0x70FAC TKW_VV_VV_UW 100.0 FORMULA_0010 0.0 65535.0 /end CHARACTERISTIC
/begin CHARACTERISTIC K_ED_INDEX_33_IGN.P_CODE_UNPLAUSIBEL "P-Code fuer die Art UNPLAUSIBEL" VALUE 0x70FB2 TKW_VV_VV_UW 100.0 FORMULA_0010 0.0 65535.0 /end CHARACTERISTIC
/begin CHARACTERISTIC K_ED_INDEX_34_IGN.DEC_NACH_EINTRAG "Filterverringerung nach Fehlerspeichereintrag" VALUE 0x70FD3 TKW_VV_VV_UB 100.0 FORMULA_0003 0.0 255.0 /end CHARACTERISTIC
/begin CHARACTERISTIC K_ED_INDEX_34_IGN.DEC_VOR_EINTRAG "Filterverringerung vorm Fehlerspeichereintrag" VALUE 0x70FD1 TKW_VV_VV_UB 100.0 FORMULA_0003 0.0 255.0 /end CHARACTERISTIC
/begin CHARACTERISTIC K_ED_INDEX_34_IGN.FEHLERSCHWELLE "Filterschwelle fuer Fehlereintrag" VALUE 0x70FCE TKW_VV_VV_UB 100.0 FORMULA_0003 0.0 255.0 /end CHARACTERISTIC
/begin CHARACTERISTIC K_ED_INDEX_34_IGN.INC_NACH_EINTRAG "Filtererhoehung nach Fehlerspeichereintrag" VALUE 0x70FD2 TKW_VV_VV_UB 100.0 FORMULA_0003 0.0 255.0 /end CHARACTERISTIC
/begin CHARACTERISTIC K_ED_INDEX_34_IGN.INC_VOR_EINTRAG "Filtererhoehung vorm Fehlerspeichereintrag" VALUE 0x70FD0 TKW_VV_VV_UB 100.0 FORMULA_0003 0.0 255.0 /end CHARACTERISTIC
/begin CHARACTERISTIC K_ED_INDEX_34_IGN.KLASSENINDEX "Auswahl der Fehlerklasse" VALUE 0x70FD4 TKW_VV_VV_UB 100.0 FORMULA_0003 0.0 8.0 /end CHARACTERISTIC
/begin CHARACTERISTIC K_ED_INDEX_34_IGN.OK_SCHWELLE "Filterschwelle fuer Fehleraustrag" VALUE 0x70FCF TKW_VV_VV_UB 100.0 FORMULA_0003 0.0 255.0 /end CHARACTERISTIC
/begin CHARACTERISTIC K_ED_INDEX_34_IGN.P_CODE_OPENLOAD "P-Code fuer die Art OPENLOAD" VALUE 0x70FCA TKW_VV_VV_UW 100.0 FORMULA_0010 0.0 65535.0 /end CHARACTERISTIC
/begin CHARACTERISTIC K_ED_INDEX_34_IGN.P_CODE_SH_TO_GND "P-Code fuer die Art SH_TO_GND" VALUE 0x70FC8 TKW_VV_VV_UW 100.0 FORMULA_0010 0.0 65535.0 /end CHARACTERISTIC
/begin CHARACTERISTIC K_ED_INDEX_34_IGN.P_CODE_SH_TO_UB "P-Code fuer die Art SH_TO_UB" VALUE 0x70FC6 TKW_VV_VV_UW 100.0 FORMULA_0010 0.0 65535.0 /end CHARACTERISTIC
/begin CHARACTERISTIC K_ED_INDEX_34_IGN.P_CODE_UNPLAUSIBEL "P-Code fuer die Art UNPLAUSIBEL" VALUE 0x70FCC TKW_VV_VV_UW 100.0 FORMULA_0010 0.0 65535.0 /end CHARACTERISTIC
/begin CHARACTERISTIC K_ED_INDEX_35_IGN.DEC_NACH_EINTRAG "Filterverringerung nach Fehlerspeichereintrag" VALUE 0x70FED TKW_VV_VV_UB 100.0 FORMULA_0003 0.0 255.0 /end CHARACTERISTIC
/begin CHARACTERISTIC K_ED_INDEX_35_IGN.DEC_VOR_EINTRAG "Filterverringerung vorm Fehlerspeichereintrag" VALUE 0x70FEB TKW_VV_VV_UB 100.0 FORMULA_0003 0.0 255.0 /end CHARACTERISTIC
/begin CHARACTERISTIC K_ED_INDEX_35_IGN.FEHLERSCHWELLE "Filterschwelle fuer Fehlereintrag" VALUE 0x70FE8 TKW_VV_VV_UB 100.0 FORMULA_0003 0.0 255.0 /end CHARACTERISTIC
/begin CHARACTERISTIC K_ED_INDEX_35_IGN.INC_NACH_EINTRAG "Filtererhoehung nach Fehlerspeichereintrag" VALUE 0x70FEC TKW_VV_VV_UB 100.0 FORMULA_0003 0.0 255.0 /end CHARACTERISTIC
/begin CHARACTERISTIC K_ED_INDEX_35_IGN.INC_VOR_EINTRAG "Filtererhoehung vorm Fehlerspeichereintrag" VALUE 0x70FEA TKW_VV_VV_UB 100.0 FORMULA_0003 0.0 255.0 /end CHARACTERISTIC
/begin CHARACTERISTIC K_ED_INDEX_35_IGN.KLASSENINDEX "Auswahl der Fehlerklasse" VALUE 0x70FEE TKW_VV_VV_UB 100.0 FORMULA_0003 0.0 8.0 /end CHARACTERISTIC
/begin CHARACTERISTIC K_ED_INDEX_35_IGN.OK_SCHWELLE "Filterschwelle fuer Fehleraustrag" VALUE 0x70FE9 TKW_VV_VV_UB 100.0 FORMULA_0003 0.0 255.0 /end CHARACTERISTIC
/begin CHARACTERISTIC K_ED_INDEX_35_IGN.P_CODE_OPENLOAD "P-Code fuer die Art OPENLOAD" VALUE 0x70FE4 TKW_VV_VV_UW 100.0 FORMULA_0010 0.0 65535.0 /end CHARACTERISTIC
/begin CHARACTERISTIC K_ED_INDEX_35_IGN.P_CODE_SH_TO_GND "P-Code fuer die Art SH_TO_GND" VALUE 0x70FE2 TKW_VV_VV_UW 100.0 FORMULA_0010 0.0 65535.0 /end CHARACTERISTIC
/begin CHARACTERISTIC K_ED_INDEX_35_IGN.P_CODE_SH_TO_UB "P-Code fuer die Art SH_TO_UB" VALUE 0x70FE0 TKW_VV_VV_UW 100.0 FORMULA_0010 0.0 65535.0 /end CHARACTERISTIC
/begin CHARACTERISTIC K_ED_INDEX_35_IGN.P_CODE_UNPLAUSIBEL "P-Code fuer die Art UNPLAUSIBEL" VALUE 0x70FE6 TKW_VV_VV_UW 100.0 FORMULA_0010 0.0 65535.0 /end CHARACTERISTIC
/begin CHARACTERISTIC K_ED_INDEX_36_IGN.DEC_NACH_EINTRAG "Filterverringerung nach Fehlerspeichereintrag" VALUE 0x71007 TKW_VV_VV_UB 100.0 FORMULA_0003 0.0 255.0 /end CHARACTERISTIC
/begin CHARACTERISTIC K_ED_INDEX_36_IGN.DEC_VOR_EINTRAG "Filterverringerung vorm Fehlerspeichereintrag" VALUE 0x71005 TKW_VV_VV_UB 100.0 FORMULA_0003 0.0 255.0 /end CHARACTERISTIC
/begin CHARACTERISTIC K_ED_INDEX_36_IGN.FEHLERSCHWELLE "Filterschwelle fuer Fehlereintrag" VALUE 0x71002 TKW_VV_VV_UB 100.0 FORMULA_0003 0.0 255.0 /end CHARACTERISTIC
/begin CHARACTERISTIC K_ED_INDEX_36_IGN.INC_NACH_EINTRAG "Filtererhoehung nach Fehlerspeichereintrag" VALUE 0x71006 TKW_VV_VV_UB 100.0 FORMULA_0003 0.0 255.0 /end CHARACTERISTIC
/begin CHARACTERISTIC K_ED_INDEX_36_IGN.INC_VOR_EINTRAG "Filtererhoehung vorm Fehlerspeichereintrag" VALUE 0x71004 TKW_VV_VV_UB 100.0 FORMULA_0003 0.0 255.0 /end CHARACTERISTIC
/begin CHARACTERISTIC K_ED_INDEX_36_IGN.KLASSENINDEX "Auswahl der Fehlerklasse" VALUE 0x71008 TKW_VV_VV_UB 100.0 FORMULA_0003 0.0 8.0 /end CHARACTERISTIC
/begin CHARACTERISTIC K_ED_INDEX_36_IGN.OK_SCHWELLE "Filterschwelle fuer Fehleraustrag" VALUE 0x71003 TKW_VV_VV_UB 100.0 FORMULA_0003 0.0 255.0 /end CHARACTERISTIC
/begin CHARACTERISTIC K_ED_INDEX_36_IGN.P_CODE_OPENLOAD "P-Code fuer die Art OPENLOAD" VALUE 0x70FFE TKW_VV_VV_UW 100.0 FORMULA_0010 0.0 65535.0 /end CHARACTERISTIC
/begin CHARACTERISTIC K_ED_INDEX_36_IGN.P_CODE_SH_TO_GND "P-Code fuer die Art SH_TO_GND" VALUE 0x70FFC TKW_VV_VV_UW 100.0 FORMULA_0010 0.0 65535.0 /end CHARACTERISTIC
/begin CHARACTERISTIC K_ED_INDEX_36_IGN.P_CODE_SH_TO_UB "P-Code fuer die Art SH_TO_UB" VALUE 0x70FFA TKW_VV_VV_UW 100.0 FORMULA_0010 0.0 65535.0 /end CHARACTERISTIC
/begin CHARACTERISTIC K_ED_INDEX_36_IGN.P_CODE_UNPLAUSIBEL "P-Code fuer die Art UNPLAUSIBEL" VALUE 0x71000 TKW_VV_VV_UW 100.0 FORMULA_0010 0.0 65535.0 /end CHARACTERISTIC
/begin CHARACTERISTIC K_ED_INDEX_71_IGN.DEC_NACH_EINTRAG "Filterverringerung nach Fehlerspeichereintrag" VALUE 0x71395 TKW_VV_VV_UB 100.0 FORMULA_0003 0.0 255.0 /end CHARACTERISTIC
/begin CHARACTERISTIC K_ED_INDEX_71_IGN.DEC_VOR_EINTRAG "Filterverringerung vorm Fehlerspeichereintrag" VALUE 0x71393 TKW_VV_VV_UB 100.0 FORMULA_0003 0.0 255.0 /end CHARACTERISTIC
/begin CHARACTERISTIC K_ED_INDEX_71_IGN.FEHLERSCHWELLE "Filterschwelle fuer Fehlereintrag" VALUE 0x71390 TKW_VV_VV_UB 100.0 FORMULA_0003 0.0 255.0 /end CHARACTERISTIC
/begin CHARACTERISTIC K_ED_INDEX_71_IGN.INC_NACH_EINTRAG "Filtererhoehung nach Fehlerspeichereintrag" VALUE 0x71394 TKW_VV_VV_UB 100.0 FORMULA_0003 0.0 255.0 /end CHARACTERISTIC
/begin CHARACTERISTIC K_ED_INDEX_71_IGN.INC_VOR_EINTRAG "Filtererhoehung vorm Fehlerspeichereintrag" VALUE 0x71392 TKW_VV_VV_UB 100.0 FORMULA_0003 0.0 255.0 /end CHARACTERISTIC
/begin CHARACTERISTIC K_ED_INDEX_71_IGN.KLASSENINDEX "Auswahl der Fehlerklasse" VALUE 0x71396 TKW_VV_VV_UB 100.0 FORMULA_0003 0.0 8.0 /end CHARACTERISTIC
/begin CHARACTERISTIC K_ED_INDEX_71_IGN.OK_SCHWELLE "Filterschwelle fuer Fehleraustrag" VALUE 0x71391 TKW_VV_VV_UB 100.0 FORMULA_0003 0.0 255.0 /end CHARACTERISTIC
/begin CHARACTERISTIC K_ED_INDEX_71_IGN.P_CODE_OPENLOAD "P-Code fuer die Art OPENLOAD" VALUE 0x7138C TKW_VV_VV_UW 100.0 FORMULA_0010 0.0 65535.0 /end CHARACTERISTIC
/begin CHARACTERISTIC K_ED_INDEX_71_IGN.P_CODE_SH_TO_GND "P-Code fuer die Art SH_TO_GND" VALUE 0x7138A TKW_VV_VV_UW 100.0 FORMULA_0010 0.0 65535.0 /end CHARACTERISTIC
/begin CHARACTERISTIC K_ED_INDEX_71_IGN.P_CODE_SH_TO_UB "P-Code fuer die Art SH_TO_UB" VALUE 0x71388 TKW_VV_VV_UW 100.0 FORMULA_0010 0.0 65535.0 /end CHARACTERISTIC
/begin CHARACTERISTIC K_ED_INDEX_71_IGN.P_CODE_UNPLAUSIBEL "P-Code fuer die Art UNPLAUSIBEL" VALUE 0x7138E TKW_VV_VV_UW 100.0 FORMULA_0010 0.0 65535.0 /end CHARACTERISTIC
/begin CHARACTERISTIC K_ED_INDEX_72_IGN.DEC_NACH_EINTRAG "Filterverringerung nach Fehlerspeichereintrag" VALUE 0x713AF TKW_VV_VV_UB 100.0 FORMULA_0003 0.0 255.0 /end CHARACTERISTIC
/begin CHARACTERISTIC K_ED_INDEX_72_IGN.DEC_VOR_EINTRAG "Filterverringerung vorm Fehlerspeichereintrag" VALUE 0x713AD TKW_VV_VV_UB 100.0 FORMULA_0003 0.0 255.0 /end CHARACTERISTIC
/begin CHARACTERISTIC K_ED_INDEX_72_IGN.FEHLERSCHWELLE "Filterschwelle fuer Fehlereintrag" VALUE 0x713AA TKW_VV_VV_UB 100.0 FORMULA_0003 0.0 255.0 /end CHARACTERISTIC
/begin CHARACTERISTIC K_ED_INDEX_72_IGN.INC_NACH_EINTRAG "Filtererhoehung nach Fehlerspeichereintrag" VALUE 0x713AE TKW_VV_VV_UB 100.0 FORMULA_0003 0.0 255.0 /end CHARACTERISTIC
/begin CHARACTERISTIC K_ED_INDEX_72_IGN.INC_VOR_EINTRAG "Filtererhoehung vorm Fehlerspeichereintrag" VALUE 0x713AC TKW_VV_VV_UB 100.0 FORMULA_0003 0.0 255.0 /end CHARACTERISTIC
/begin CHARACTERISTIC K_ED_INDEX_72_IGN.KLASSENINDEX "Auswahl der Fehlerklasse" VALUE 0x713B0 TKW_VV_VV_UB 100.0 FORMULA_0003 0.0 8.0 /end CHARACTERISTIC
/begin CHARACTERISTIC K_ED_INDEX_72_IGN.OK_SCHWELLE "Filterschwelle fuer Fehleraustrag" VALUE 0x713AB TKW_VV_VV_UB 100.0 FORMULA_0003 0.0 255.0 /end CHARACTERISTIC
/begin CHARACTERISTIC K_ED_INDEX_72_IGN.P_CODE_OPENLOAD "P-Code fuer die Art OPENLOAD" VALUE 0x713A6 TKW_VV_VV_UW 100.0 FORMULA_0010 0.0 65535.0 /end CHARACTERISTIC
/begin CHARACTERISTIC K_ED_INDEX_72_IGN.P_CODE_SH_TO_GND "P-Code fuer die Art SH_TO_GND" VALUE 0x713A4 TKW_VV_VV_UW 100.0 FORMULA_0010 0.0 65535.0 /end CHARACTERISTIC
/begin CHARACTERISTIC K_ED_INDEX_72_IGN.P_CODE_SH_TO_UB "P-Code fuer die Art SH_TO_UB" VALUE 0x713A2 TKW_VV_VV_UW 100.0 FORMULA_0010 0.0 65535.0 /end CHARACTERISTIC
/begin CHARACTERISTIC K_ED_INDEX_72_IGN.P_CODE_UNPLAUSIBEL "P-Code fuer die Art UNPLAUSIBEL" VALUE 0x713A8 TKW_VV_VV_UW 100.0 FORMULA_0010 0.0 65535.0 /end CHARACTERISTIC
/begin CHARACTERISTIC K_ED_INDEX_84_IGN.DEC_NACH_EINTRAG "Filterverringerung nach Fehlerspeichereintrag" VALUE 0x714E7 TKW_VV_VV_UB 100.0 FORMULA_0003 0.0 255.0 /end CHARACTERISTIC
/begin CHARACTERISTIC K_ED_INDEX_84_IGN.DEC_VOR_EINTRAG "Filterverringerung vorm Fehlerspeichereintrag" VALUE 0x714E5 TKW_VV_VV_UB 100.0 FORMULA_0003 0.0 255.0 /end CHARACTERISTIC
/begin CHARACTERISTIC K_ED_INDEX_84_IGN.FEHLERSCHWELLE "Filterschwelle fuer Fehlereintrag" VALUE 0x714E2 TKW_VV_VV_UB 100.0 FORMULA_0003 0.0 255.0 /end CHARACTERISTIC
/begin CHARACTERISTIC K_ED_INDEX_84_IGN.INC_NACH_EINTRAG "Filtererhoehung nach Fehlerspeichereintrag" VALUE 0x714E6 TKW_VV_VV_UB 100.0 FORMULA_0003 0.0 255.0 /end CHARACTERISTIC
/begin CHARACTERISTIC K_ED_INDEX_84_IGN.INC_VOR_EINTRAG "Filtererhoehung vorm Fehlerspeichereintrag" VALUE 0x714E4 TKW_VV_VV_UB 100.0 FORMULA_0003 0.0 255.0 /end CHARACTERISTIC
/begin CHARACTERISTIC K_ED_INDEX_84_IGN.KLASSENINDEX "Auswahl der Fehlerklasse" VALUE 0x714E8 TKW_VV_VV_UB 100.0 FORMULA_0003 0.0 8.0 /end CHARACTERISTIC
/begin CHARACTERISTIC K_ED_INDEX_84_IGN.OK_SCHWELLE "Filterschwelle fuer Fehleraustrag" VALUE 0x714E3 TKW_VV_VV_UB 100.0 FORMULA_0003 0.0 255.0 /end CHARACTERISTIC
/begin CHARACTERISTIC K_ED_INDEX_84_IGN.P_CODE_OPENLOAD "P-Code fuer die Art OPENLOAD" VALUE 0x714DE TKW_VV_VV_UW 100.0 FORMULA_0010 0.0 65535.0 /end CHARACTERISTIC
/begin CHARACTERISTIC K_ED_INDEX_84_IGN.P_CODE_SH_TO_GND "P-Code fuer die Art SH_TO_GND" VALUE 0x714DC TKW_VV_VV_UW 100.0 FORMULA_0010 0.0 65535.0 /end CHARACTERISTIC
/begin CHARACTERISTIC K_ED_INDEX_84_IGN.P_CODE_SH_TO_UB "P-Code fuer die Art SH_TO_UB" VALUE 0x714DA TKW_VV_VV_UW 100.0 FORMULA_0010 0.0 65535.0 /end CHARACTERISTIC
/begin CHARACTERISTIC K_ED_INDEX_84_IGN.P_CODE_UNPLAUSIBEL "P-Code fuer die Art UNPLAUSIBEL" VALUE 0x714E0 TKW_VV_VV_UW 100.0 FORMULA_0010 0.0 65535.0 /end CHARACTERISTIC
/begin CHARACTERISTIC K_ED_INDEX_85_IGN.DEC_NACH_EINTRAG "Filterverringerung nach Fehlerspeichereintrag" VALUE 0x71501 TKW_VV_VV_UB 100.0 FORMULA_0003 0.0 255.0 /end CHARACTERISTIC
/begin CHARACTERISTIC K_ED_INDEX_85_IGN.DEC_VOR_EINTRAG "Filterverringerung vorm Fehlerspeichereintrag" VALUE 0x714FF TKW_VV_VV_UB 100.0 FORMULA_0003 0.0 255.0 /end CHARACTERISTIC
/begin CHARACTERISTIC K_ED_INDEX_85_IGN.FEHLERSCHWELLE "Filterschwelle fuer Fehlereintrag" VALUE 0x714FC TKW_VV_VV_UB 100.0 FORMULA_0003 0.0 255.0 /end CHARACTERISTIC
/begin CHARACTERISTIC K_ED_INDEX_85_IGN.INC_NACH_EINTRAG "Filtererhoehung nach Fehlerspeichereintrag" VALUE 0x71500 TKW_VV_VV_UB 100.0 FORMULA_0003 0.0 255.0 /end CHARACTERISTIC
/begin CHARACTERISTIC K_ED_INDEX_85_IGN.INC_VOR_EINTRAG "Filtererhoehung vorm Fehlerspeichereintrag" VALUE 0x714FE TKW_VV_VV_UB 100.0 FORMULA_0003 0.0 255.0 /end CHARACTERISTIC
/begin CHARACTERISTIC K_ED_INDEX_85_IGN.KLASSENINDEX "Auswahl der Fehlerklasse" VALUE 0x71502 TKW_VV_VV_UB 100.0 FORMULA_0003 0.0 8.0 /end CHARACTERISTIC
/begin CHARACTERISTIC K_ED_INDEX_85_IGN.OK_SCHWELLE "Filterschwelle fuer Fehleraustrag" VALUE 0x714FD TKW_VV_VV_UB 100.0 FORMULA_0003 0.0 255.0 /end CHARACTERISTIC
/begin CHARACTERISTIC K_ED_INDEX_85_IGN.P_CODE_OPENLOAD "P-Code fuer die Art OPENLOAD" VALUE 0x714F8 TKW_VV_VV_UW 100.0 FORMULA_0010 0.0 65535.0 /end CHARACTERISTIC
/begin CHARACTERISTIC K_ED_INDEX_85_IGN.P_CODE_SH_TO_GND "P-Code fuer die Art SH_TO_GND" VALUE 0x714F6 TKW_VV_VV_UW 100.0 FORMULA_0010 0.0 65535.0 /end CHARACTERISTIC
/begin CHARACTERISTIC K_ED_INDEX_85_IGN.P_CODE_SH_TO_UB "P-Code fuer die Art SH_TO_UB" VALUE 0x714F4 TKW_VV_VV_UW 100.0 FORMULA_0010 0.0 65535.0 /end CHARACTERISTIC
/begin CHARACTERISTIC K_ED_INDEX_85_IGN.P_CODE_UNPLAUSIBEL "P-Code fuer die Art UNPLAUSIBEL" VALUE 0x714FA TKW_VV_VV_UW 100.0 FORMULA_0010 0.0 65535.0 /end CHARACTERISTIC
/begin CHARACTERISTIC K_ED_LLR_DIAG.DEC_NACH_EINTRAG "Filterverringerung nach Fehlerspeichereintrag" VALUE 0x7161F TKW_VV_VV_UB 100.0 FORMULA_0003 0.0 255.0 /end CHARACTERISTIC
/begin CHARACTERISTIC K_ED_LLR_DIAG.DEC_VOR_EINTRAG "Filterverringerung vorm Fehlerspeichereintrag" VALUE 0x7161D TKW_VV_VV_UB 100.0 FORMULA_0003 0.0 255.0 /end CHARACTERISTIC
/begin CHARACTERISTIC K_ED_LLR_DIAG.FEHLERSCHWELLE "Filterschwelle fuer Fehlereintrag" VALUE 0x7161A TKW_VV_VV_UB 100.0 FORMULA_0003 0.0 255.0 /end CHARACTERISTIC
/begin CHARACTERISTIC K_ED_LLR_DIAG.INC_NACH_EINTRAG "Filtererhoehung nach Fehlerspeichereintrag" VALUE 0x7161E TKW_VV_VV_UB 100.0 FORMULA_0003 0.0 255.0 /end CHARACTERISTIC
/begin CHARACTERISTIC K_ED_LLR_DIAG.INC_VOR_EINTRAG "Filtererhoehung vorm Fehlerspeichereintrag" VALUE 0x7161C TKW_VV_VV_UB 100.0 FORMULA_0003 0.0 255.0 /end CHARACTERISTIC
/begin CHARACTERISTIC K_ED_LLR_DIAG.KLASSENINDEX "Auswahl der Fehlerklasse" VALUE 0x71620 TKW_VV_VV_UB 100.0 FORMULA_0003 0.0 8.0 /end CHARACTERISTIC
/begin CHARACTERISTIC K_ED_LLR_DIAG.OK_SCHWELLE "Filterschwelle fuer Fehleraustrag" VALUE 0x7161B TKW_VV_VV_UB 100.0 FORMULA_0003 0.0 255.0 /end CHARACTERISTIC
/begin CHARACTERISTIC K_ED_LLR_DIAG.P_CODE_OPENLOAD "P-Code fuer die Art OPENLOAD" VALUE 0x71616 TKW_VV_VV_UW 100.0 FORMULA_0010 0.0 65535.0 /end CHARACTERISTIC
/begin CHARACTERISTIC K_ED_LLR_DIAG.P_CODE_SH_TO_GND "P-Code fuer die Art SH_TO_GND" VALUE 0x71614 TKW_VV_VV_UW 100.0 FORMULA_0010 0.0 65535.0 /end CHARACTERISTIC
/begin CHARACTERISTIC K_ED_LLR_DIAG.P_CODE_SH_TO_UB "P-Code fuer die Art SH_TO_UB" VALUE 0x71612 TKW_VV_VV_UW 100.0 FORMULA_0010 0.0 65535.0 /end CHARACTERISTIC
/begin CHARACTERISTIC K_ED_LLR_DIAG.P_CODE_UNPLAUSIBEL "P-Code fuer die Art UNPLAUSIBEL" VALUE 0x71618 TKW_VV_VV_UW 100.0 FORMULA_0010 0.0 65535.0 /end CHARACTERISTIC
/begin CHARACTERISTIC K_ED_LLR_DIAG_CSS.DEC_NACH_EINTRAG "Filterverringerung nach Fehlerspeichereintrag" VALUE 0x71771 TKW_VV_VV_UB 100.0 FORMULA_0003 0.0 255.0 /end CHARACTERISTIC
/begin CHARACTERISTIC K_ED_LLR_DIAG_CSS.DEC_VOR_EINTRAG "Filterverringerung vorm Fehlerspeichereintrag" VALUE 0x7176F TKW_VV_VV_UB 100.0 FORMULA_0003 0.0 255.0 /end CHARACTERISTIC
/begin CHARACTERISTIC K_ED_LLR_DIAG_CSS.FEHLERSCHWELLE "Filterschwelle fuer Fehlereintrag" VALUE 0x7176C TKW_VV_VV_UB 100.0 FORMULA_0003 0.0 255.0 /end CHARACTERISTIC
/begin CHARACTERISTIC K_ED_LLR_DIAG_CSS.INC_NACH_EINTRAG "Filtererhoehung nach Fehlerspeichereintrag" VALUE 0x71770 TKW_VV_VV_UB 100.0 FORMULA_0003 0.0 255.0 /end CHARACTERISTIC
/begin CHARACTERISTIC K_ED_LLR_DIAG_CSS.INC_VOR_EINTRAG "Filtererhoehung vorm Fehlerspeichereintrag" VALUE 0x7176E TKW_VV_VV_UB 100.0 FORMULA_0003 0.0 255.0 /end CHARACTERISTIC
/begin CHARACTERISTIC K_ED_LLR_DIAG_CSS.KLASSENINDEX "Auswahl der Fehlerklasse" VALUE 0x71772 TKW_VV_VV_UB 100.0 FORMULA_0003 0.0 8.0 /end CHARACTERISTIC
/begin CHARACTERISTIC K_ED_LLR_DIAG_CSS.OK_SCHWELLE "Filterschwelle fuer Fehleraustrag" VALUE 0x7176D TKW_VV_VV_UB 100.0 FORMULA_0003 0.0 255.0 /end CHARACTERISTIC
/begin CHARACTERISTIC K_ED_LLR_DIAG_CSS.P_CODE_OPENLOAD "P-Code fuer die Art OPENLOAD" VALUE 0x71768 TKW_VV_VV_UW 100.0 FORMULA_0010 0.0 65535.0 /end CHARACTERISTIC
/begin CHARACTERISTIC K_ED_LLR_DIAG_CSS.P_CODE_SH_TO_GND "P-Code fuer die Art SH_TO_GND" VALUE 0x71766 TKW_VV_VV_UW 100.0 FORMULA_0010 0.0 65535.0 /end CHARACTERISTIC
/begin CHARACTERISTIC K_ED_LLR_DIAG_CSS.P_CODE_SH_TO_UB "P-Code fuer die Art SH_TO_UB" VALUE 0x71764 TKW_VV_VV_UW 100.0 FORMULA_0010 0.0 65535.0 /end CHARACTERISTIC
/begin CHARACTERISTIC K_ED_LLR_DIAG_CSS.P_CODE_UNPLAUSIBEL "P-Code fuer die Art UNPLAUSIBEL" VALUE 0x7176A TKW_VV_VV_UW 100.0 FORMULA_0010 0.0 65535.0 /end CHARACTERISTIC
/begin CHARACTERISTIC K_ED_LLS_INIT.DEC_NACH_EINTRAG "Filterverringerung nach Fehlerspeichereintrag" VALUE 0x71173 TKW_VV_VV_UB 100.0 FORMULA_0003 0.0 255.0 /end CHARACTERISTIC
/begin CHARACTERISTIC K_ED_LLS_INIT.DEC_VOR_EINTRAG "Filterverringerung vorm Fehlerspeichereintrag" VALUE 0x71171 TKW_VV_VV_UB 100.0 FORMULA_0003 0.0 255.0 /end CHARACTERISTIC
/begin CHARACTERISTIC K_ED_LLS_INIT.FEHLERSCHWELLE "Filterschwelle fuer Fehlereintrag" VALUE 0x7116E TKW_VV_VV_UB 100.0 FORMULA_0003 0.0 255.0 /end CHARACTERISTIC
/begin CHARACTERISTIC K_ED_LLS_INIT.INC_NACH_EINTRAG "Filtererhoehung nach Fehlerspeichereintrag" VALUE 0x71172 TKW_VV_VV_UB 100.0 FORMULA_0003 0.0 255.0 /end CHARACTERISTIC
/begin CHARACTERISTIC K_ED_LLS_INIT.INC_VOR_EINTRAG "Filtererhoehung vorm Fehlerspeichereintrag" VALUE 0x71170 TKW_VV_VV_UB 100.0 FORMULA_0003 0.0 255.0 /end CHARACTERISTIC
/begin CHARACTERISTIC K_ED_LLS_INIT.KLASSENINDEX "Auswahl der Fehlerklasse" VALUE 0x71174 TKW_VV_VV_UB 100.0 FORMULA_0003 0.0 8.0 /end CHARACTERISTIC
/begin CHARACTERISTIC K_ED_LLS_INIT.OK_SCHWELLE "Filterschwelle fuer Fehleraustrag" VALUE 0x7116F TKW_VV_VV_UB 100.0 FORMULA_0003 0.0 255.0 /end CHARACTERISTIC
/begin CHARACTERISTIC K_ED_LLS_INIT.P_CODE_OPENLOAD "P-Code fuer die Art OPENLOAD" VALUE 0x7116A TKW_VV_VV_UW 100.0 FORMULA_0010 0.0 65535.0 /end CHARACTERISTIC
/begin CHARACTERISTIC K_ED_LLS_INIT.P_CODE_SH_TO_GND "P-Code fuer die Art SH_TO_GND" VALUE 0x71168 TKW_VV_VV_UW 100.0 FORMULA_0010 0.0 65535.0 /end CHARACTERISTIC
/begin CHARACTERISTIC K_ED_LLS_INIT.P_CODE_SH_TO_UB "P-Code fuer die Art SH_TO_UB" VALUE 0x71166 TKW_VV_VV_UW 100.0 FORMULA_0010 0.0 65535.0 /end CHARACTERISTIC
/begin CHARACTERISTIC K_ED_LLS_INIT.P_CODE_UNPLAUSIBEL "P-Code fuer die Art UNPLAUSIBEL" VALUE 0x7116C TKW_VV_VV_UW 100.0 FORMULA_0010 0.0 65535.0 /end CHARACTERISTIC
/begin CHARACTERISTIC K_ED_LLS1_CAN.DEC_NACH_EINTRAG "Filterverringerung nach Fehlerspeichereintrag" VALUE 0x70E19 TKW_VV_VV_UB 100.0 FORMULA_0003 0.0 255.0 /end CHARACTERISTIC
/begin CHARACTERISTIC K_ED_LLS1_CAN.DEC_VOR_EINTRAG "Filterverringerung vorm Fehlerspeichereintrag" VALUE 0x70E17 TKW_VV_VV_UB 100.0 FORMULA_0003 0.0 255.0 /end CHARACTERISTIC
/begin CHARACTERISTIC K_ED_LLS1_CAN.FEHLERSCHWELLE "Filterschwelle fuer Fehlereintrag" VALUE 0x70E14 TKW_VV_VV_UB 100.0 FORMULA_0003 0.0 255.0 /end CHARACTERISTIC
/begin CHARACTERISTIC K_ED_LLS1_CAN.INC_NACH_EINTRAG "Filtererhoehung nach Fehlerspeichereintrag" VALUE 0x70E18 TKW_VV_VV_UB 100.0 FORMULA_0003 0.0 255.0 /end CHARACTERISTIC
/begin CHARACTERISTIC K_ED_LLS1_CAN.INC_VOR_EINTRAG "Filtererhoehung vorm Fehlerspeichereintrag" VALUE 0x70E16 TKW_VV_VV_UB 100.0 FORMULA_0003 0.0 255.0 /end CHARACTERISTIC
/begin CHARACTERISTIC K_ED_LLS1_CAN.KLASSENINDEX "Auswahl der Fehlerklasse" VALUE 0x70E1A TKW_VV_VV_UB 100.0 FORMULA_0003 0.0 8.0 /end CHARACTERISTIC
/begin CHARACTERISTIC K_ED_LLS1_CAN.OK_SCHWELLE "Filterschwelle fuer Fehleraustrag" VALUE 0x70E15 TKW_VV_VV_UB 100.0 FORMULA_0003 0.0 255.0 /end CHARACTERISTIC
/begin CHARACTERISTIC K_ED_LLS1_CAN.P_CODE_OPENLOAD "P-Code fuer die Art OPENLOAD" VALUE 0x70E10 TKW_VV_VV_UW 100.0 FORMULA_0010 0.0 65535.0 /end CHARACTERISTIC
/begin CHARACTERISTIC K_ED_LLS1_CAN.P_CODE_SH_TO_GND "P-Code fuer die Art SH_TO_GND" VALUE 0x70E0E TKW_VV_VV_UW 100.0 FORMULA_0010 0.0 65535.0 /end CHARACTERISTIC
/begin CHARACTERISTIC K_ED_LLS1_CAN.P_CODE_SH_TO_UB "P-Code fuer die Art SH_TO_UB" VALUE 0x70E0C TKW_VV_VV_UW 100.0 FORMULA_0010 0.0 65535.0 /end CHARACTERISTIC
/begin CHARACTERISTIC K_ED_LLS1_CAN.P_CODE_UNPLAUSIBEL "P-Code fuer die Art UNPLAUSIBEL" VALUE 0x70E12 TKW_VV_VV_UW 100.0 FORMULA_0010 0.0 65535.0 /end CHARACTERISTIC
/begin CHARACTERISTIC K_ED_LLS1_CMD.DEC_NACH_EINTRAG "Filterverringerung nach Fehlerspeichereintrag" VALUE 0x711DB TKW_VV_VV_UB 100.0 FORMULA_0003 0.0 255.0 /end CHARACTERISTIC
/begin CHARACTERISTIC K_ED_LLS1_CMD.DEC_VOR_EINTRAG "Filterverringerung vorm Fehlerspeichereintrag" VALUE 0x711D9 TKW_VV_VV_UB 100.0 FORMULA_0003 0.0 255.0 /end CHARACTERISTIC
/begin CHARACTERISTIC K_ED_LLS1_CMD.FEHLERSCHWELLE "Filterschwelle fuer Fehlereintrag" VALUE 0x711D6 TKW_VV_VV_UB 100.0 FORMULA_0003 0.0 255.0 /end CHARACTERISTIC
/begin CHARACTERISTIC K_ED_LLS1_CMD.INC_NACH_EINTRAG "Filtererhoehung nach Fehlerspeichereintrag" VALUE 0x711DA TKW_VV_VV_UB 100.0 FORMULA_0003 0.0 255.0 /end CHARACTERISTIC
/begin CHARACTERISTIC K_ED_LLS1_CMD.INC_VOR_EINTRAG "Filtererhoehung vorm Fehlerspeichereintrag" VALUE 0x711D8 TKW_VV_VV_UB 100.0 FORMULA_0003 0.0 255.0 /end CHARACTERISTIC
/begin CHARACTERISTIC K_ED_LLS1_CMD.KLASSENINDEX "Auswahl der Fehlerklasse" VALUE 0x711DC TKW_VV_VV_UB 100.0 FORMULA_0003 0.0 8.0 /end CHARACTERISTIC
/begin CHARACTERISTIC K_ED_LLS1_CMD.OK_SCHWELLE "Filterschwelle fuer Fehleraustrag" VALUE 0x711D7 TKW_VV_VV_UB 100.0 FORMULA_0003 0.0 255.0 /end CHARACTERISTIC
/begin CHARACTERISTIC K_ED_LLS1_CMD.P_CODE_OPENLOAD "P-Code fuer die Art OPENLOAD" VALUE 0x711D2 TKW_VV_VV_UW 100.0 FORMULA_0010 0.0 65535.0 /end CHARACTERISTIC
/begin CHARACTERISTIC K_ED_LLS1_CMD.P_CODE_SH_TO_GND "P-Code fuer die Art SH_TO_GND" VALUE 0x711D0 TKW_VV_VV_UW 100.0 FORMULA_0010 0.0 65535.0 /end CHARACTERISTIC
/begin CHARACTERISTIC K_ED_LLS1_CMD.P_CODE_SH_TO_UB "P-Code fuer die Art SH_TO_UB" VALUE 0x711CE TKW_VV_VV_UW 100.0 FORMULA_0010 0.0 65535.0 /end CHARACTERISTIC
/begin CHARACTERISTIC K_ED_LLS1_CMD.P_CODE_UNPLAUSIBEL "P-Code fuer die Art UNPLAUSIBEL" VALUE 0x711D4 TKW_VV_VV_UW 100.0 FORMULA_0010 0.0 65535.0 /end CHARACTERISTIC
/begin CHARACTERISTIC K_ED_LLS1_REGLER.DEC_NACH_EINTRAG "Filterverringerung nach Fehlerspeichereintrag" VALUE 0x710BD TKW_VV_VV_UB 100.0 FORMULA_0003 0.0 255.0 /end CHARACTERISTIC
/begin CHARACTERISTIC K_ED_LLS1_REGLER.DEC_VOR_EINTRAG "Filterverringerung vorm Fehlerspeichereintrag" VALUE 0x710BB TKW_VV_VV_UB 100.0 FORMULA_0003 0.0 255.0 /end CHARACTERISTIC
/begin CHARACTERISTIC K_ED_LLS1_REGLER.FEHLERSCHWELLE "Filterschwelle fuer Fehlereintrag" VALUE 0x710B8 TKW_VV_VV_UB 100.0 FORMULA_0003 0.0 255.0 /end CHARACTERISTIC
/begin CHARACTERISTIC K_ED_LLS1_REGLER.INC_NACH_EINTRAG "Filtererhoehung nach Fehlerspeichereintrag" VALUE 0x710BC TKW_VV_VV_UB 100.0 FORMULA_0003 0.0 255.0 /end CHARACTERISTIC
/begin CHARACTERISTIC K_ED_LLS1_REGLER.INC_VOR_EINTRAG "Filtererhoehung vorm Fehlerspeichereintrag" VALUE 0x710BA TKW_VV_VV_UB 100.0 FORMULA_0003 0.0 255.0 /end CHARACTERISTIC
/begin CHARACTERISTIC K_ED_LLS1_REGLER.KLASSENINDEX "Auswahl der Fehlerklasse" VALUE 0x710BE TKW_VV_VV_UB 100.0 FORMULA_0003 0.0 8.0 /end CHARACTERISTIC
/begin CHARACTERISTIC K_ED_LLS1_REGLER.OK_SCHWELLE "Filterschwelle fuer Fehleraustrag" VALUE 0x710B9 TKW_VV_VV_UB 100.0 FORMULA_0003 0.0 255.0 /end CHARACTERISTIC
/begin CHARACTERISTIC K_ED_LLS1_REGLER.P_CODE_OPENLOAD "P-Code fuer die Art OPENLOAD" VALUE 0x710B4 TKW_VV_VV_UW 100.0 FORMULA_0010 0.0 65535.0 /end CHARACTERISTIC
/begin CHARACTERISTIC K_ED_LLS1_REGLER.P_CODE_SH_TO_GND "P-Code fuer die Art SH_TO_GND" VALUE 0x710B2 TKW_VV_VV_UW 100.0 FORMULA_0010 0.0 65535.0 /end CHARACTERISTIC
/begin CHARACTERISTIC K_ED_LLS1_REGLER.P_CODE_SH_TO_UB "P-Code fuer die Art SH_TO_UB" VALUE 0x710B0 TKW_VV_VV_UW 100.0 FORMULA_0010 0.0 65535.0 /end CHARACTERISTIC
/begin CHARACTERISTIC K_ED_LLS1_REGLER.P_CODE_UNPLAUSIBEL "P-Code fuer die Art UNPLAUSIBEL" VALUE 0x710B6 TKW_VV_VV_UW 100.0 FORMULA_0010 0.0 65535.0 /end CHARACTERISTIC
/begin CHARACTERISTIC K_ED_LLS1_SK.DEC_NACH_EINTRAG "Filterverringerung nach Fehlerspeichereintrag" VALUE 0x70E81 TKW_VV_VV_UB 100.0 FORMULA_0003 0.0 255.0 /end CHARACTERISTIC
/begin CHARACTERISTIC K_ED_LLS1_SK.DEC_VOR_EINTRAG "Filterverringerung vorm Fehlerspeichereintrag" VALUE 0x70E7F TKW_VV_VV_UB 100.0 FORMULA_0003 0.0 255.0 /end CHARACTERISTIC
/begin CHARACTERISTIC K_ED_LLS1_SK.FEHLERSCHWELLE "Filterschwelle fuer Fehlereintrag" VALUE 0x70E7C TKW_VV_VV_UB 100.0 FORMULA_0003 0.0 255.0 /end CHARACTERISTIC
/begin CHARACTERISTIC K_ED_LLS1_SK.INC_NACH_EINTRAG "Filtererhoehung nach Fehlerspeichereintrag" VALUE 0x70E80 TKW_VV_VV_UB 100.0 FORMULA_0003 0.0 255.0 /end CHARACTERISTIC
/begin CHARACTERISTIC K_ED_LLS1_SK.INC_VOR_EINTRAG "Filtererhoehung vorm Fehlerspeichereintrag" VALUE 0x70E7E TKW_VV_VV_UB 100.0 FORMULA_0003 0.0 255.0 /end CHARACTERISTIC
/begin CHARACTERISTIC K_ED_LLS1_SK.KLASSENINDEX "Auswahl der Fehlerklasse" VALUE 0x70E82 TKW_VV_VV_UB 100.0 FORMULA_0003 0.0 8.0 /end CHARACTERISTIC
/begin CHARACTERISTIC K_ED_LLS1_SK.OK_SCHWELLE "Filterschwelle fuer Fehleraustrag" VALUE 0x70E7D TKW_VV_VV_UB 100.0 FORMULA_0003 0.0 255.0 /end CHARACTERISTIC
/begin CHARACTERISTIC K_ED_LLS1_SK.P_CODE_OPENLOAD "P-Code fuer die Art OPENLOAD" VALUE 0x70E78 TKW_VV_VV_UW 100.0 FORMULA_0010 0.0 65535.0 /end CHARACTERISTIC
/begin CHARACTERISTIC K_ED_LLS1_SK.P_CODE_SH_TO_GND "P-Code fuer die Art SH_TO_GND" VALUE 0x70E76 TKW_VV_VV_UW 100.0 FORMULA_0010 0.0 65535.0 /end CHARACTERISTIC
/begin CHARACTERISTIC K_ED_LLS1_SK.P_CODE_SH_TO_UB "P-Code fuer die Art SH_TO_UB" VALUE 0x70E74 TKW_VV_VV_UW 100.0 FORMULA_0010 0.0 65535.0 /end CHARACTERISTIC
/begin CHARACTERISTIC K_ED_LLS1_SK.P_CODE_UNPLAUSIBEL "P-Code fuer die Art UNPLAUSIBEL" VALUE 0x70E7A TKW_VV_VV_UW 100.0 FORMULA_0010 0.0 65535.0 /end CHARACTERISTIC
/begin CHARACTERISTIC K_ED_LLS2_CAN.DEC_NACH_EINTRAG "Filterverringerung nach Fehlerspeichereintrag" VALUE 0x70E33 TKW_VV_VV_UB 100.0 FORMULA_0003 0.0 255.0 /end CHARACTERISTIC
/begin CHARACTERISTIC K_ED_LLS2_CAN.DEC_VOR_EINTRAG "Filterverringerung vorm Fehlerspeichereintrag" VALUE 0x70E31 TKW_VV_VV_UB 100.0 FORMULA_0003 0.0 255.0 /end CHARACTERISTIC
/begin CHARACTERISTIC K_ED_LLS2_CAN.FEHLERSCHWELLE "Filterschwelle fuer Fehlereintrag" VALUE 0x70E2E TKW_VV_VV_UB 100.0 FORMULA_0003 0.0 255.0 /end CHARACTERISTIC
/begin CHARACTERISTIC K_ED_LLS2_CAN.INC_NACH_EINTRAG "Filtererhoehung nach Fehlerspeichereintrag" VALUE 0x70E32 TKW_VV_VV_UB 100.0 FORMULA_0003 0.0 255.0 /end CHARACTERISTIC
/begin CHARACTERISTIC K_ED_LLS2_CAN.INC_VOR_EINTRAG "Filtererhoehung vorm Fehlerspeichereintrag" VALUE 0x70E30 TKW_VV_VV_UB 100.0 FORMULA_0003 0.0 255.0 /end CHARACTERISTIC
/begin CHARACTERISTIC K_ED_LLS2_CAN.KLASSENINDEX "Auswahl der Fehlerklasse" VALUE 0x70E34 TKW_VV_VV_UB 100.0 FORMULA_0003 0.0 8.0 /end CHARACTERISTIC
/begin CHARACTERISTIC K_ED_LLS2_CAN.OK_SCHWELLE "Filterschwelle fuer Fehleraustrag" VALUE 0x70E2F TKW_VV_VV_UB 100.0 FORMULA_0003 0.0 255.0 /end CHARACTERISTIC
/begin CHARACTERISTIC K_ED_LLS2_CAN.P_CODE_OPENLOAD "P-Code fuer die Art OPENLOAD" VALUE 0x70E2A TKW_VV_VV_UW 100.0 FORMULA_0010 0.0 65535.0 /end CHARACTERISTIC
/begin CHARACTERISTIC K_ED_LLS2_CAN.P_CODE_SH_TO_GND "P-Code fuer die Art SH_TO_GND" VALUE 0x70E28 TKW_VV_VV_UW 100.0 FORMULA_0010 0.0 65535.0 /end CHARACTERISTIC
/begin CHARACTERISTIC K_ED_LLS2_CAN.P_CODE_SH_TO_UB "P-Code fuer die Art SH_TO_UB" VALUE 0x70E26 TKW_VV_VV_UW 100.0 FORMULA_0010 0.0 65535.0 /end CHARACTERISTIC
/begin CHARACTERISTIC K_ED_LLS2_CAN.P_CODE_UNPLAUSIBEL "P-Code fuer die Art UNPLAUSIBEL" VALUE 0x70E2C TKW_VV_VV_UW 100.0 FORMULA_0010 0.0 65535.0 /end CHARACTERISTIC
/begin CHARACTERISTIC K_ED_LLS2_CMD.DEC_NACH_EINTRAG "Filterverringerung nach Fehlerspeichereintrag" VALUE 0x711F5 TKW_VV_VV_UB 100.0 FORMULA_0003 0.0 255.0 /end CHARACTERISTIC
/begin CHARACTERISTIC K_ED_LLS2_CMD.DEC_VOR_EINTRAG "Filterverringerung vorm Fehlerspeichereintrag" VALUE 0x711F3 TKW_VV_VV_UB 100.0 FORMULA_0003 0.0 255.0 /end CHARACTERISTIC
/begin CHARACTERISTIC K_ED_LLS2_CMD.FEHLERSCHWELLE "Filterschwelle fuer Fehlereintrag" VALUE 0x711F0 TKW_VV_VV_UB 100.0 FORMULA_0003 0.0 255.0 /end CHARACTERISTIC
/begin CHARACTERISTIC K_ED_LLS2_CMD.INC_NACH_EINTRAG "Filtererhoehung nach Fehlerspeichereintrag" VALUE 0x711F4 TKW_VV_VV_UB 100.0 FORMULA_0003 0.0 255.0 /end CHARACTERISTIC
/begin CHARACTERISTIC K_ED_LLS2_CMD.INC_VOR_EINTRAG "Filtererhoehung vorm Fehlerspeichereintrag" VALUE 0x711F2 TKW_VV_VV_UB 100.0 FORMULA_0003 0.0 255.0 /end CHARACTERISTIC
/begin CHARACTERISTIC K_ED_LLS2_CMD.KLASSENINDEX "Auswahl der Fehlerklasse" VALUE 0x711F6 TKW_VV_VV_UB 100.0 FORMULA_0003 0.0 8.0 /end CHARACTERISTIC
/begin CHARACTERISTIC K_ED_LLS2_CMD.OK_SCHWELLE "Filterschwelle fuer Fehleraustrag" VALUE 0x711F1 TKW_VV_VV_UB 100.0 FORMULA_0003 0.0 255.0 /end CHARACTERISTIC
/begin CHARACTERISTIC K_ED_LLS2_CMD.P_CODE_OPENLOAD "P-Code fuer die Art OPENLOAD" VALUE 0x711EC TKW_VV_VV_UW 100.0 FORMULA_0010 0.0 65535.0 /end CHARACTERISTIC
/begin CHARACTERISTIC K_ED_LLS2_CMD.P_CODE_SH_TO_GND "P-Code fuer die Art SH_TO_GND" VALUE 0x711EA TKW_VV_VV_UW 100.0 FORMULA_0010 0.0 65535.0 /end CHARACTERISTIC
/begin CHARACTERISTIC K_ED_LLS2_CMD.P_CODE_SH_TO_UB "P-Code fuer die Art SH_TO_UB" VALUE 0x711E8 TKW_VV_VV_UW 100.0 FORMULA_0010 0.0 65535.0 /end CHARACTERISTIC
/begin CHARACTERISTIC K_ED_LLS2_CMD.P_CODE_UNPLAUSIBEL "P-Code fuer die Art UNPLAUSIBEL" VALUE 0x711EE TKW_VV_VV_UW 100.0 FORMULA_0010 0.0 65535.0 /end CHARACTERISTIC
/begin CHARACTERISTIC K_ED_LLS2_REGLER.DEC_NACH_EINTRAG "Filterverringerung nach Fehlerspeichereintrag" VALUE 0x710D7 TKW_VV_VV_UB 100.0 FORMULA_0003 0.0 255.0 /end CHARACTERISTIC
/begin CHARACTERISTIC K_ED_LLS2_REGLER.DEC_VOR_EINTRAG "Filterverringerung vorm Fehlerspeichereintrag" VALUE 0x710D5 TKW_VV_VV_UB 100.0 FORMULA_0003 0.0 255.0 /end CHARACTERISTIC
/begin CHARACTERISTIC K_ED_LLS2_REGLER.FEHLERSCHWELLE "Filterschwelle fuer Fehlereintrag" VALUE 0x710D2 TKW_VV_VV_UB 100.0 FORMULA_0003 0.0 255.0 /end CHARACTERISTIC
/begin CHARACTERISTIC K_ED_LLS2_REGLER.INC_NACH_EINTRAG "Filtererhoehung nach Fehlerspeichereintrag" VALUE 0x710D6 TKW_VV_VV_UB 100.0 FORMULA_0003 0.0 255.0 /end CHARACTERISTIC
/begin CHARACTERISTIC K_ED_LLS2_REGLER.INC_VOR_EINTRAG "Filtererhoehung vorm Fehlerspeichereintrag" VALUE 0x710D4 TKW_VV_VV_UB 100.0 FORMULA_0003 0.0 255.0 /end CHARACTERISTIC
/begin CHARACTERISTIC K_ED_LLS2_REGLER.KLASSENINDEX "Auswahl der Fehlerklasse" VALUE 0x710D8 TKW_VV_VV_UB 100.0 FORMULA_0003 0.0 8.0 /end CHARACTERISTIC
/begin CHARACTERISTIC K_ED_LLS2_REGLER.OK_SCHWELLE "Filterschwelle fuer Fehleraustrag" VALUE 0x710D3 TKW_VV_VV_UB 100.0 FORMULA_0003 0.0 255.0 /end CHARACTERISTIC
/begin CHARACTERISTIC K_ED_LLS2_REGLER.P_CODE_OPENLOAD "P-Code fuer die Art OPENLOAD" VALUE 0x710CE TKW_VV_VV_UW 100.0 FORMULA_0010 0.0 65535.0 /end CHARACTERISTIC
/begin CHARACTERISTIC K_ED_LLS2_REGLER.P_CODE_SH_TO_GND "P-Code fuer die Art SH_TO_GND" VALUE 0x710CC TKW_VV_VV_UW 100.0 FORMULA_0010 0.0 65535.0 /end CHARACTERISTIC
/begin CHARACTERISTIC K_ED_LLS2_REGLER.P_CODE_SH_TO_UB "P-Code fuer die Art SH_TO_UB" VALUE 0x710CA TKW_VV_VV_UW 100.0 FORMULA_0010 0.0 65535.0 /end CHARACTERISTIC
/begin CHARACTERISTIC K_ED_LLS2_REGLER.P_CODE_UNPLAUSIBEL "P-Code fuer die Art UNPLAUSIBEL" VALUE 0x710D0 TKW_VV_VV_UW 100.0 FORMULA_0010 0.0 65535.0 /end CHARACTERISTIC
/begin CHARACTERISTIC K_ED_LLS2_SK.DEC_NACH_EINTRAG "Filterverringerung nach Fehlerspeichereintrag" VALUE 0x70E9B TKW_VV_VV_UB 100.0 FORMULA_0003 0.0 255.0 /end CHARACTERISTIC
/begin CHARACTERISTIC K_ED_LLS2_SK.DEC_VOR_EINTRAG "Filterverringerung vorm Fehlerspeichereintrag" VALUE 0x70E99 TKW_VV_VV_UB 100.0 FORMULA_0003 0.0 255.0 /end CHARACTERISTIC
/begin CHARACTERISTIC K_ED_LLS2_SK.FEHLERSCHWELLE "Filterschwelle fuer Fehlereintrag" VALUE 0x70E96 TKW_VV_VV_UB 100.0 FORMULA_0003 0.0 255.0 /end CHARACTERISTIC
/begin CHARACTERISTIC K_ED_LLS2_SK.INC_NACH_EINTRAG "Filtererhoehung nach Fehlerspeichereintrag" VALUE 0x70E9A TKW_VV_VV_UB 100.0 FORMULA_0003 0.0 255.0 /end CHARACTERISTIC
/begin CHARACTERISTIC K_ED_LLS2_SK.INC_VOR_EINTRAG "Filtererhoehung vorm Fehlerspeichereintrag" VALUE 0x70E98 TKW_VV_VV_UB 100.0 FORMULA_0003 0.0 255.0 /end CHARACTERISTIC
/begin CHARACTERISTIC K_ED_LLS2_SK.KLASSENINDEX "Auswahl der Fehlerklasse" VALUE 0x70E9C TKW_VV_VV_UB 100.0 FORMULA_0003 0.0 8.0 /end CHARACTERISTIC
/begin CHARACTERISTIC K_ED_LLS2_SK.OK_SCHWELLE "Filterschwelle fuer Fehleraustrag" VALUE 0x70E97 TKW_VV_VV_UB 100.0 FORMULA_0003 0.0 255.0 /end CHARACTERISTIC
/begin CHARACTERISTIC K_ED_LLS2_SK.P_CODE_OPENLOAD "P-Code fuer die Art OPENLOAD" VALUE 0x70E92 TKW_VV_VV_UW 100.0 FORMULA_0010 0.0 65535.0 /end CHARACTERISTIC
/begin CHARACTERISTIC K_ED_LLS2_SK.P_CODE_SH_TO_GND "P-Code fuer die Art SH_TO_GND" VALUE 0x70E90 TKW_VV_VV_UW 100.0 FORMULA_0010 0.0 65535.0 /end CHARACTERISTIC
/begin CHARACTERISTIC K_ED_LLS2_SK.P_CODE_SH_TO_UB "P-Code fuer die Art SH_TO_UB" VALUE 0x70E8E TKW_VV_VV_UW 100.0 FORMULA_0010 0.0 65535.0 /end CHARACTERISTIC
/begin CHARACTERISTIC K_ED_LLS2_SK.P_CODE_UNPLAUSIBEL "P-Code fuer die Art UNPLAUSIBEL" VALUE 0x70E94 TKW_VV_VV_UW 100.0 FORMULA_0010 0.0 65535.0 /end CHARACTERISTIC
/begin CHARACTERISTIC K_ED_M_SPULE_Z1.DEC_NACH_EINTRAG "Filterverringerung nach Fehlerspeichereintrag" VALUE 0x717A5 TKW_VV_VV_UB 100.0 FORMULA_0003 0.0 255.0 /end CHARACTERISTIC
/begin CHARACTERISTIC K_ED_M_SPULE_Z1.DEC_VOR_EINTRAG "Filterverringerung vorm Fehlerspeichereintrag" VALUE 0x717A3 TKW_VV_VV_UB 100.0 FORMULA_0003 0.0 255.0 /end CHARACTERISTIC
/begin CHARACTERISTIC K_ED_M_SPULE_Z1.FEHLERSCHWELLE "Filterschwelle fuer Fehlereintrag" VALUE 0x717A0 TKW_VV_VV_UB 100.0 FORMULA_0003 0.0 255.0 /end CHARACTERISTIC
/begin CHARACTERISTIC K_ED_M_SPULE_Z1.INC_NACH_EINTRAG "Filtererhoehung nach Fehlerspeichereintrag" VALUE 0x717A4 TKW_VV_VV_UB 100.0 FORMULA_0003 0.0 255.0 /end CHARACTERISTIC
/begin CHARACTERISTIC K_ED_M_SPULE_Z1.INC_VOR_EINTRAG "Filtererhoehung vorm Fehlerspeichereintrag" VALUE 0x717A2 TKW_VV_VV_UB 100.0 FORMULA_0003 0.0 255.0 /end CHARACTERISTIC
/begin CHARACTERISTIC K_ED_M_SPULE_Z1.KLASSENINDEX "Auswahl der Fehlerklasse" VALUE 0x717A6 TKW_VV_VV_UB 100.0 FORMULA_0003 0.0 8.0 /end CHARACTERISTIC
/begin CHARACTERISTIC K_ED_M_SPULE_Z1.OK_SCHWELLE "Filterschwelle fuer Fehleraustrag" VALUE 0x717A1 TKW_VV_VV_UB 100.0 FORMULA_0003 0.0 255.0 /end CHARACTERISTIC
/begin CHARACTERISTIC K_ED_M_SPULE_Z1.P_CODE_OPENLOAD "P-Code fuer die Art OPENLOAD" VALUE 0x7179C TKW_VV_VV_UW 100.0 FORMULA_0010 0.0 65535.0 /end CHARACTERISTIC
/begin CHARACTERISTIC K_ED_M_SPULE_Z1.P_CODE_SH_TO_GND "P-Code fuer die Art SH_TO_GND" VALUE 0x7179A TKW_VV_VV_UW 100.0 FORMULA_0010 0.0 65535.0 /end CHARACTERISTIC
/begin CHARACTERISTIC K_ED_M_SPULE_Z1.P_CODE_SH_TO_UB "P-Code fuer die Art SH_TO_UB" VALUE 0x71798 TKW_VV_VV_UW 100.0 FORMULA_0010 0.0 65535.0 /end CHARACTERISTIC
/begin CHARACTERISTIC K_ED_M_SPULE_Z1.P_CODE_UNPLAUSIBEL "P-Code fuer die Art UNPLAUSIBEL" VALUE 0x7179E TKW_VV_VV_UW 100.0 FORMULA_0010 0.0 65535.0 /end CHARACTERISTIC
/begin CHARACTERISTIC K_ED_M_SPULE_Z10.DEC_NACH_EINTRAG "Filterverringerung nach Fehlerspeichereintrag" VALUE 0x7188F TKW_VV_VV_UB 100.0 FORMULA_0003 0.0 255.0 /end CHARACTERISTIC
/begin CHARACTERISTIC K_ED_M_SPULE_Z10.DEC_VOR_EINTRAG "Filterverringerung vorm Fehlerspeichereintrag" VALUE 0x7188D TKW_VV_VV_UB 100.0 FORMULA_0003 0.0 255.0 /end CHARACTERISTIC
/begin CHARACTERISTIC K_ED_M_SPULE_Z10.FEHLERSCHWELLE "Filterschwelle fuer Fehlereintrag" VALUE 0x7188A TKW_VV_VV_UB 100.0 FORMULA_0003 0.0 255.0 /end CHARACTERISTIC
/begin CHARACTERISTIC K_ED_M_SPULE_Z10.INC_NACH_EINTRAG "Filtererhoehung nach Fehlerspeichereintrag" VALUE 0x7188E TKW_VV_VV_UB 100.0 FORMULA_0003 0.0 255.0 /end CHARACTERISTIC
/begin CHARACTERISTIC K_ED_M_SPULE_Z10.INC_VOR_EINTRAG "Filtererhoehung vorm Fehlerspeichereintrag" VALUE 0x7188C TKW_VV_VV_UB 100.0 FORMULA_0003 0.0 255.0 /end CHARACTERISTIC
/begin CHARACTERISTIC K_ED_M_SPULE_Z10.KLASSENINDEX "Auswahl der Fehlerklasse" VALUE 0x71890 TKW_VV_VV_UB 100.0 FORMULA_0003 0.0 8.0 /end CHARACTERISTIC
/begin CHARACTERISTIC K_ED_M_SPULE_Z10.OK_SCHWELLE "Filterschwelle fuer Fehleraustrag" VALUE 0x7188B TKW_VV_VV_UB 100.0 FORMULA_0003 0.0 255.0 /end CHARACTERISTIC
/begin CHARACTERISTIC K_ED_M_SPULE_Z10.P_CODE_OPENLOAD "P-Code fuer die Art OPENLOAD" VALUE 0x71886 TKW_VV_VV_UW 100.0 FORMULA_0010 0.0 65535.0 /end CHARACTERISTIC
/begin CHARACTERISTIC K_ED_M_SPULE_Z10.P_CODE_SH_TO_GND "P-Code fuer die Art SH_TO_GND" VALUE 0x71884 TKW_VV_VV_UW 100.0 FORMULA_0010 0.0 65535.0 /end CHARACTERISTIC
/begin CHARACTERISTIC K_ED_M_SPULE_Z10.P_CODE_SH_TO_UB "P-Code fuer die Art SH_TO_UB" VALUE 0x71882 TKW_VV_VV_UW 100.0 FORMULA_0010 0.0 65535.0 /end CHARACTERISTIC
/begin CHARACTERISTIC K_ED_M_SPULE_Z10.P_CODE_UNPLAUSIBEL "P-Code fuer die Art UNPLAUSIBEL" VALUE 0x71888 TKW_VV_VV_UW 100.0 FORMULA_0010 0.0 65535.0 /end CHARACTERISTIC
/begin CHARACTERISTIC K_ED_M_SPULE_Z2.DEC_NACH_EINTRAG "Filterverringerung nach Fehlerspeichereintrag" VALUE 0x717BF TKW_VV_VV_UB 100.0 FORMULA_0003 0.0 255.0 /end CHARACTERISTIC
/begin CHARACTERISTIC K_ED_M_SPULE_Z2.DEC_VOR_EINTRAG "Filterverringerung vorm Fehlerspeichereintrag" VALUE 0x717BD TKW_VV_VV_UB 100.0 FORMULA_0003 0.0 255.0 /end CHARACTERISTIC
/begin CHARACTERISTIC K_ED_M_SPULE_Z2.FEHLERSCHWELLE "Filterschwelle fuer Fehlereintrag" VALUE 0x717BA TKW_VV_VV_UB 100.0 FORMULA_0003 0.0 255.0 /end CHARACTERISTIC
/begin CHARACTERISTIC K_ED_M_SPULE_Z2.INC_NACH_EINTRAG "Filtererhoehung nach Fehlerspeichereintrag" VALUE 0x717BE TKW_VV_VV_UB 100.0 FORMULA_0003 0.0 255.0 /end CHARACTERISTIC
/begin CHARACTERISTIC K_ED_M_SPULE_Z2.INC_VOR_EINTRAG "Filtererhoehung vorm Fehlerspeichereintrag" VALUE 0x717BC TKW_VV_VV_UB 100.0 FORMULA_0003 0.0 255.0 /end CHARACTERISTIC
/begin CHARACTERISTIC K_ED_M_SPULE_Z2.KLASSENINDEX "Auswahl der Fehlerklasse" VALUE 0x717C0 TKW_VV_VV_UB 100.0 FORMULA_0003 0.0 8.0 /end CHARACTERISTIC
/begin CHARACTERISTIC K_ED_M_SPULE_Z2.OK_SCHWELLE "Filterschwelle fuer Fehleraustrag" VALUE 0x717BB TKW_VV_VV_UB 100.0 FORMULA_0003 0.0 255.0 /end CHARACTERISTIC
/begin CHARACTERISTIC K_ED_M_SPULE_Z2.P_CODE_OPENLOAD "P-Code fuer die Art OPENLOAD" VALUE 0x717B6 TKW_VV_VV_UW 100.0 FORMULA_0010 0.0 65535.0 /end CHARACTERISTIC
/begin CHARACTERISTIC K_ED_M_SPULE_Z2.P_CODE_SH_TO_GND "P-Code fuer die Art SH_TO_GND" VALUE 0x717B4 TKW_VV_VV_UW 100.0 FORMULA_0010 0.0 65535.0 /end CHARACTERISTIC
/begin CHARACTERISTIC K_ED_M_SPULE_Z2.P_CODE_SH_TO_UB "P-Code fuer die Art SH_TO_UB" VALUE 0x717B2 TKW_VV_VV_UW 100.0 FORMULA_0010 0.0 65535.0 /end CHARACTERISTIC
/begin CHARACTERISTIC K_ED_M_SPULE_Z2.P_CODE_UNPLAUSIBEL "P-Code fuer die Art UNPLAUSIBEL" VALUE 0x717B8 TKW_VV_VV_UW 100.0 FORMULA_0010 0.0 65535.0 /end CHARACTERISTIC
/begin CHARACTERISTIC K_ED_M_SPULE_Z3.DEC_NACH_EINTRAG "Filterverringerung nach Fehlerspeichereintrag" VALUE 0x717D9 TKW_VV_VV_UB 100.0 FORMULA_0003 0.0 255.0 /end CHARACTERISTIC
/begin CHARACTERISTIC K_ED_M_SPULE_Z3.DEC_VOR_EINTRAG "Filterverringerung vorm Fehlerspeichereintrag" VALUE 0x717D7 TKW_VV_VV_UB 100.0 FORMULA_0003 0.0 255.0 /end CHARACTERISTIC
/begin CHARACTERISTIC K_ED_M_SPULE_Z3.FEHLERSCHWELLE "Filterschwelle fuer Fehlereintrag" VALUE 0x717D4 TKW_VV_VV_UB 100.0 FORMULA_0003 0.0 255.0 /end CHARACTERISTIC
/begin CHARACTERISTIC K_ED_M_SPULE_Z3.INC_NACH_EINTRAG "Filtererhoehung nach Fehlerspeichereintrag" VALUE 0x717D8 TKW_VV_VV_UB 100.0 FORMULA_0003 0.0 255.0 /end CHARACTERISTIC
/begin CHARACTERISTIC K_ED_M_SPULE_Z3.INC_VOR_EINTRAG "Filtererhoehung vorm Fehlerspeichereintrag" VALUE 0x717D6 TKW_VV_VV_UB 100.0 FORMULA_0003 0.0 255.0 /end CHARACTERISTIC
/begin CHARACTERISTIC K_ED_M_SPULE_Z3.KLASSENINDEX "Auswahl der Fehlerklasse" VALUE 0x717DA TKW_VV_VV_UB 100.0 FORMULA_0003 0.0 8.0 /end CHARACTERISTIC
/begin CHARACTERISTIC K_ED_M_SPULE_Z3.OK_SCHWELLE "Filterschwelle fuer Fehleraustrag" VALUE 0x717D5 TKW_VV_VV_UB 100.0 FORMULA_0003 0.0 255.0 /end CHARACTERISTIC
/begin CHARACTERISTIC K_ED_M_SPULE_Z3.P_CODE_OPENLOAD "P-Code fuer die Art OPENLOAD" VALUE 0x717D0 TKW_VV_VV_UW 100.0 FORMULA_0010 0.0 65535.0 /end CHARACTERISTIC
/begin CHARACTERISTIC K_ED_M_SPULE_Z3.P_CODE_SH_TO_GND "P-Code fuer die Art SH_TO_GND" VALUE 0x717CE TKW_VV_VV_UW 100.0 FORMULA_0010 0.0 65535.0 /end CHARACTERISTIC
/begin CHARACTERISTIC K_ED_M_SPULE_Z3.P_CODE_SH_TO_UB "P-Code fuer die Art SH_TO_UB" VALUE 0x717CC TKW_VV_VV_UW 100.0 FORMULA_0010 0.0 65535.0 /end CHARACTERISTIC
/begin CHARACTERISTIC K_ED_M_SPULE_Z3.P_CODE_UNPLAUSIBEL "P-Code fuer die Art UNPLAUSIBEL" VALUE 0x717D2 TKW_VV_VV_UW 100.0 FORMULA_0010 0.0 65535.0 /end CHARACTERISTIC
/begin CHARACTERISTIC K_ED_M_SPULE_Z4.DEC_NACH_EINTRAG "Filterverringerung nach Fehlerspeichereintrag" VALUE 0x717F3 TKW_VV_VV_UB 100.0 FORMULA_0003 0.0 255.0 /end CHARACTERISTIC
/begin CHARACTERISTIC K_ED_M_SPULE_Z4.DEC_VOR_EINTRAG "Filterverringerung vorm Fehlerspeichereintrag" VALUE 0x717F1 TKW_VV_VV_UB 100.0 FORMULA_0003 0.0 255.0 /end CHARACTERISTIC
/begin CHARACTERISTIC K_ED_M_SPULE_Z4.FEHLERSCHWELLE "Filterschwelle fuer Fehlereintrag" VALUE 0x717EE TKW_VV_VV_UB 100.0 FORMULA_0003 0.0 255.0 /end CHARACTERISTIC
/begin CHARACTERISTIC K_ED_M_SPULE_Z4.INC_NACH_EINTRAG "Filtererhoehung nach Fehlerspeichereintrag" VALUE 0x717F2 TKW_VV_VV_UB 100.0 FORMULA_0003 0.0 255.0 /end CHARACTERISTIC
/begin CHARACTERISTIC K_ED_M_SPULE_Z4.INC_VOR_EINTRAG "Filtererhoehung vorm Fehlerspeichereintrag" VALUE 0x717F0 TKW_VV_VV_UB 100.0 FORMULA_0003 0.0 255.0 /end CHARACTERISTIC
/begin CHARACTERISTIC K_ED_M_SPULE_Z4.KLASSENINDEX "Auswahl der Fehlerklasse" VALUE 0x717F4 TKW_VV_VV_UB 100.0 FORMULA_0003 0.0 8.0 /end CHARACTERISTIC
/begin CHARACTERISTIC K_ED_M_SPULE_Z4.OK_SCHWELLE "Filterschwelle fuer Fehleraustrag" VALUE 0x717EF TKW_VV_VV_UB 100.0 FORMULA_0003 0.0 255.0 /end CHARACTERISTIC
/begin CHARACTERISTIC K_ED_M_SPULE_Z4.P_CODE_OPENLOAD "P-Code fuer die Art OPENLOAD" VALUE 0x717EA TKW_VV_VV_UW 100.0 FORMULA_0010 0.0 65535.0 /end CHARACTERISTIC
/begin CHARACTERISTIC K_ED_M_SPULE_Z4.P_CODE_SH_TO_GND "P-Code fuer die Art SH_TO_GND" VALUE 0x717E8 TKW_VV_VV_UW 100.0 FORMULA_0010 0.0 65535.0 /end CHARACTERISTIC
/begin CHARACTERISTIC K_ED_M_SPULE_Z4.P_CODE_SH_TO_UB "P-Code fuer die Art SH_TO_UB" VALUE 0x717E6 TKW_VV_VV_UW 100.0 FORMULA_0010 0.0 65535.0 /end CHARACTERISTIC
/begin CHARACTERISTIC K_ED_M_SPULE_Z4.P_CODE_UNPLAUSIBEL "P-Code fuer die Art UNPLAUSIBEL" VALUE 0x717EC TKW_VV_VV_UW 100.0 FORMULA_0010 0.0 65535.0 /end CHARACTERISTIC
/begin CHARACTERISTIC K_ED_M_SPULE_Z5.DEC_NACH_EINTRAG "Filterverringerung nach Fehlerspeichereintrag" VALUE 0x7180D TKW_VV_VV_UB 100.0 FORMULA_0003 0.0 255.0 /end CHARACTERISTIC
/begin CHARACTERISTIC K_ED_M_SPULE_Z5.DEC_VOR_EINTRAG "Filterverringerung vorm Fehlerspeichereintrag" VALUE 0x7180B TKW_VV_VV_UB 100.0 FORMULA_0003 0.0 255.0 /end CHARACTERISTIC
/begin CHARACTERISTIC K_ED_M_SPULE_Z5.FEHLERSCHWELLE "Filterschwelle fuer Fehlereintrag" VALUE 0x71808 TKW_VV_VV_UB 100.0 FORMULA_0003 0.0 255.0 /end CHARACTERISTIC
/begin CHARACTERISTIC K_ED_M_SPULE_Z5.INC_NACH_EINTRAG "Filtererhoehung nach Fehlerspeichereintrag" VALUE 0x7180C TKW_VV_VV_UB 100.0 FORMULA_0003 0.0 255.0 /end CHARACTERISTIC
/begin CHARACTERISTIC K_ED_M_SPULE_Z5.INC_VOR_EINTRAG "Filtererhoehung vorm Fehlerspeichereintrag" VALUE 0x7180A TKW_VV_VV_UB 100.0 FORMULA_0003 0.0 255.0 /end CHARACTERISTIC
/begin CHARACTERISTIC K_ED_M_SPULE_Z5.KLASSENINDEX "Auswahl der Fehlerklasse" VALUE 0x7180E TKW_VV_VV_UB 100.0 FORMULA_0003 0.0 8.0 /end CHARACTERISTIC
/begin CHARACTERISTIC K_ED_M_SPULE_Z5.OK_SCHWELLE "Filterschwelle fuer Fehleraustrag" VALUE 0x71809 TKW_VV_VV_UB 100.0 FORMULA_0003 0.0 255.0 /end CHARACTERISTIC
/begin CHARACTERISTIC K_ED_M_SPULE_Z5.P_CODE_OPENLOAD "P-Code fuer die Art OPENLOAD" VALUE 0x71804 TKW_VV_VV_UW 100.0 FORMULA_0010 0.0 65535.0 /end CHARACTERISTIC
/begin CHARACTERISTIC K_ED_M_SPULE_Z5.P_CODE_SH_TO_GND "P-Code fuer die Art SH_TO_GND" VALUE 0x71802 TKW_VV_VV_UW 100.0 FORMULA_0010 0.0 65535.0 /end CHARACTERISTIC
/begin CHARACTERISTIC K_ED_M_SPULE_Z5.P_CODE_SH_TO_UB "P-Code fuer die Art SH_TO_UB" VALUE 0x71800 TKW_VV_VV_UW 100.0 FORMULA_0010 0.0 65535.0 /end CHARACTERISTIC
/begin CHARACTERISTIC K_ED_M_SPULE_Z5.P_CODE_UNPLAUSIBEL "P-Code fuer die Art UNPLAUSIBEL" VALUE 0x71806 TKW_VV_VV_UW 100.0 FORMULA_0010 0.0 65535.0 /end CHARACTERISTIC
/begin CHARACTERISTIC K_ED_M_SPULE_Z6.DEC_NACH_EINTRAG "Filterverringerung nach Fehlerspeichereintrag" VALUE 0x71827 TKW_VV_VV_UB 100.0 FORMULA_0003 0.0 255.0 /end CHARACTERISTIC
/begin CHARACTERISTIC K_ED_M_SPULE_Z6.DEC_VOR_EINTRAG "Filterverringerung vorm Fehlerspeichereintrag" VALUE 0x71825 TKW_VV_VV_UB 100.0 FORMULA_0003 0.0 255.0 /end CHARACTERISTIC
/begin CHARACTERISTIC K_ED_M_SPULE_Z6.FEHLERSCHWELLE "Filterschwelle fuer Fehlereintrag" VALUE 0x71822 TKW_VV_VV_UB 100.0 FORMULA_0003 0.0 255.0 /end CHARACTERISTIC
/begin CHARACTERISTIC K_ED_M_SPULE_Z6.INC_NACH_EINTRAG "Filtererhoehung nach Fehlerspeichereintrag" VALUE 0x71826 TKW_VV_VV_UB 100.0 FORMULA_0003 0.0 255.0 /end CHARACTERISTIC
/begin CHARACTERISTIC K_ED_M_SPULE_Z6.INC_VOR_EINTRAG "Filtererhoehung vorm Fehlerspeichereintrag" VALUE 0x71824 TKW_VV_VV_UB 100.0 FORMULA_0003 0.0 255.0 /end CHARACTERISTIC
/begin CHARACTERISTIC K_ED_M_SPULE_Z6.KLASSENINDEX "Auswahl der Fehlerklasse" VALUE 0x71828 TKW_VV_VV_UB 100.0 FORMULA_0003 0.0 8.0 /end CHARACTERISTIC
/begin CHARACTERISTIC K_ED_M_SPULE_Z6.OK_SCHWELLE "Filterschwelle fuer Fehleraustrag" VALUE 0x71823 TKW_VV_VV_UB 100.0 FORMULA_0003 0.0 255.0 /end CHARACTERISTIC
/begin CHARACTERISTIC K_ED_M_SPULE_Z6.P_CODE_OPENLOAD "P-Code fuer die Art OPENLOAD" VALUE 0x7181E TKW_VV_VV_UW 100.0 FORMULA_0010 0.0 65535.0 /end CHARACTERISTIC
/begin CHARACTERISTIC K_ED_M_SPULE_Z6.P_CODE_SH_TO_GND "P-Code fuer die Art SH_TO_GND" VALUE 0x7181C TKW_VV_VV_UW 100.0 FORMULA_0010 0.0 65535.0 /end CHARACTERISTIC
/begin CHARACTERISTIC K_ED_M_SPULE_Z6.P_CODE_SH_TO_UB "P-Code fuer die Art SH_TO_UB" VALUE 0x7181A TKW_VV_VV_UW 100.0 FORMULA_0010 0.0 65535.0 /end CHARACTERISTIC
/begin CHARACTERISTIC K_ED_M_SPULE_Z6.P_CODE_UNPLAUSIBEL "P-Code fuer die Art UNPLAUSIBEL" VALUE 0x71820 TKW_VV_VV_UW 100.0 FORMULA_0010 0.0 65535.0 /end CHARACTERISTIC
/begin CHARACTERISTIC K_ED_M_SPULE_Z7.DEC_NACH_EINTRAG "Filterverringerung nach Fehlerspeichereintrag" VALUE 0x71841 TKW_VV_VV_UB 100.0 FORMULA_0003 0.0 255.0 /end CHARACTERISTIC
/begin CHARACTERISTIC K_ED_M_SPULE_Z7.DEC_VOR_EINTRAG "Filterverringerung vorm Fehlerspeichereintrag" VALUE 0x7183F TKW_VV_VV_UB 100.0 FORMULA_0003 0.0 255.0 /end CHARACTERISTIC
/begin CHARACTERISTIC K_ED_M_SPULE_Z7.FEHLERSCHWELLE "Filterschwelle fuer Fehlereintrag" VALUE 0x7183C TKW_VV_VV_UB 100.0 FORMULA_0003 0.0 255.0 /end CHARACTERISTIC
/begin CHARACTERISTIC K_ED_M_SPULE_Z7.INC_NACH_EINTRAG "Filtererhoehung nach Fehlerspeichereintrag" VALUE 0x71840 TKW_VV_VV_UB 100.0 FORMULA_0003 0.0 255.0 /end CHARACTERISTIC
/begin CHARACTERISTIC K_ED_M_SPULE_Z7.INC_VOR_EINTRAG "Filtererhoehung vorm Fehlerspeichereintrag" VALUE 0x7183E TKW_VV_VV_UB 100.0 FORMULA_0003 0.0 255.0 /end CHARACTERISTIC
/begin CHARACTERISTIC K_ED_M_SPULE_Z7.KLASSENINDEX "Auswahl der Fehlerklasse" VALUE 0x71842 TKW_VV_VV_UB 100.0 FORMULA_0003 0.0 8.0 /end CHARACTERISTIC
/begin CHARACTERISTIC K_ED_M_SPULE_Z7.OK_SCHWELLE "Filterschwelle fuer Fehleraustrag" VALUE 0x7183D TKW_VV_VV_UB 100.0 FORMULA_0003 0.0 255.0 /end CHARACTERISTIC
/begin CHARACTERISTIC K_ED_M_SPULE_Z7.P_CODE_OPENLOAD "P-Code fuer die Art OPENLOAD" VALUE 0x71838 TKW_VV_VV_UW 100.0 FORMULA_0010 0.0 65535.0 /end CHARACTERISTIC
/begin CHARACTERISTIC K_ED_M_SPULE_Z7.P_CODE_SH_TO_GND "P-Code fuer die Art SH_TO_GND" VALUE 0x71836 TKW_VV_VV_UW 100.0 FORMULA_0010 0.0 65535.0 /end CHARACTERISTIC
/begin CHARACTERISTIC K_ED_M_SPULE_Z7.P_CODE_SH_TO_UB "P-Code fuer die Art SH_TO_UB" VALUE 0x71834 TKW_VV_VV_UW 100.0 FORMULA_0010 0.0 65535.0 /end CHARACTERISTIC
/begin CHARACTERISTIC K_ED_M_SPULE_Z7.P_CODE_UNPLAUSIBEL "P-Code fuer die Art UNPLAUSIBEL" VALUE 0x7183A TKW_VV_VV_UW 100.0 FORMULA_0010 0.0 65535.0 /end CHARACTERISTIC
/begin CHARACTERISTIC K_ED_M_SPULE_Z8.DEC_NACH_EINTRAG "Filterverringerung nach Fehlerspeichereintrag" VALUE 0x7185B TKW_VV_VV_UB 100.0 FORMULA_0003 0.0 255.0 /end CHARACTERISTIC
/begin CHARACTERISTIC K_ED_M_SPULE_Z8.DEC_VOR_EINTRAG "Filterverringerung vorm Fehlerspeichereintrag" VALUE 0x71859 TKW_VV_VV_UB 100.0 FORMULA_0003 0.0 255.0 /end CHARACTERISTIC
/begin CHARACTERISTIC K_ED_M_SPULE_Z8.FEHLERSCHWELLE "Filterschwelle fuer Fehlereintrag" VALUE 0x71856 TKW_VV_VV_UB 100.0 FORMULA_0003 0.0 255.0 /end CHARACTERISTIC
/begin CHARACTERISTIC K_ED_M_SPULE_Z8.INC_NACH_EINTRAG "Filtererhoehung nach Fehlerspeichereintrag" VALUE 0x7185A TKW_VV_VV_UB 100.0 FORMULA_0003 0.0 255.0 /end CHARACTERISTIC
/begin CHARACTERISTIC K_ED_M_SPULE_Z8.INC_VOR_EINTRAG "Filtererhoehung vorm Fehlerspeichereintrag" VALUE 0x71858 TKW_VV_VV_UB 100.0 FORMULA_0003 0.0 255.0 /end CHARACTERISTIC
/begin CHARACTERISTIC K_ED_M_SPULE_Z8.KLASSENINDEX "Auswahl der Fehlerklasse" VALUE 0x7185C TKW_VV_VV_UB 100.0 FORMULA_0003 0.0 8.0 /end CHARACTERISTIC
/begin CHARACTERISTIC K_ED_M_SPULE_Z8.OK_SCHWELLE "Filterschwelle fuer Fehleraustrag" VALUE 0x71857 TKW_VV_VV_UB 100.0 FORMULA_0003 0.0 255.0 /end CHARACTERISTIC
/begin CHARACTERISTIC K_ED_M_SPULE_Z8.P_CODE_OPENLOAD "P-Code fuer die Art OPENLOAD" VALUE 0x71852 TKW_VV_VV_UW 100.0 FORMULA_0010 0.0 65535.0 /end CHARACTERISTIC
/begin CHARACTERISTIC K_ED_M_SPULE_Z8.P_CODE_SH_TO_GND "P-Code fuer die Art SH_TO_GND" VALUE 0x71850 TKW_VV_VV_UW 100.0 FORMULA_0010 0.0 65535.0 /end CHARACTERISTIC
/begin CHARACTERISTIC K_ED_M_SPULE_Z8.P_CODE_SH_TO_UB "P-Code fuer die Art SH_TO_UB" VALUE 0x7184E TKW_VV_VV_UW 100.0 FORMULA_0010 0.0 65535.0 /end CHARACTERISTIC
/begin CHARACTERISTIC K_ED_M_SPULE_Z8.P_CODE_UNPLAUSIBEL "P-Code fuer die Art UNPLAUSIBEL" VALUE 0x71854 TKW_VV_VV_UW 100.0 FORMULA_0010 0.0 65535.0 /end CHARACTERISTIC
/begin CHARACTERISTIC K_ED_M_SPULE_Z9.DEC_NACH_EINTRAG "Filterverringerung nach Fehlerspeichereintrag" VALUE 0x71875 TKW_VV_VV_UB 100.0 FORMULA_0003 0.0 255.0 /end CHARACTERISTIC
/begin CHARACTERISTIC K_ED_M_SPULE_Z9.DEC_VOR_EINTRAG "Filterverringerung vorm Fehlerspeichereintrag" VALUE 0x71873 TKW_VV_VV_UB 100.0 FORMULA_0003 0.0 255.0 /end CHARACTERISTIC
/begin CHARACTERISTIC K_ED_M_SPULE_Z9.FEHLERSCHWELLE "Filterschwelle fuer Fehlereintrag" VALUE 0x71870 TKW_VV_VV_UB 100.0 FORMULA_0003 0.0 255.0 /end CHARACTERISTIC
/begin CHARACTERISTIC K_ED_M_SPULE_Z9.INC_NACH_EINTRAG "Filtererhoehung nach Fehlerspeichereintrag" VALUE 0x71874 TKW_VV_VV_UB 100.0 FORMULA_0003 0.0 255.0 /end CHARACTERISTIC
/begin CHARACTERISTIC K_ED_M_SPULE_Z9.INC_VOR_EINTRAG "Filtererhoehung vorm Fehlerspeichereintrag" VALUE 0x71872 TKW_VV_VV_UB 100.0 FORMULA_0003 0.0 255.0 /end CHARACTERISTIC
/begin CHARACTERISTIC K_ED_M_SPULE_Z9.KLASSENINDEX "Auswahl der Fehlerklasse" VALUE 0x71876 TKW_VV_VV_UB 100.0 FORMULA_0003 0.0 8.0 /end CHARACTERISTIC
/begin CHARACTERISTIC K_ED_M_SPULE_Z9.OK_SCHWELLE "Filterschwelle fuer Fehleraustrag" VALUE 0x71871 TKW_VV_VV_UB 100.0 FORMULA_0003 0.0 255.0 /end CHARACTERISTIC
/begin CHARACTERISTIC K_ED_M_SPULE_Z9.P_CODE_OPENLOAD "P-Code fuer die Art OPENLOAD" VALUE 0x7186C TKW_VV_VV_UW 100.0 FORMULA_0010 0.0 65535.0 /end CHARACTERISTIC
/begin CHARACTERISTIC K_ED_M_SPULE_Z9.P_CODE_SH_TO_GND "P-Code fuer die Art SH_TO_GND" VALUE 0x7186A TKW_VV_VV_UW 100.0 FORMULA_0010 0.0 65535.0 /end CHARACTERISTIC
/begin CHARACTERISTIC K_ED_M_SPULE_Z9.P_CODE_SH_TO_UB "P-Code fuer die Art SH_TO_UB" VALUE 0x71868 TKW_VV_VV_UW 100.0 FORMULA_0010 0.0 65535.0 /end CHARACTERISTIC
/begin CHARACTERISTIC K_ED_M_SPULE_Z9.P_CODE_UNPLAUSIBEL "P-Code fuer die Art UNPLAUSIBEL" VALUE 0x7186E TKW_VV_VV_UW 100.0 FORMULA_0010 0.0 65535.0 /end CHARACTERISTIC
/begin CHARACTERISTIC K_ED_MD_SK_ERR.DEC_NACH_EINTRAG "Filterverringerung nach Fehlerspeichereintrag" VALUE 0x71159 TKW_VV_VV_UB 100.0 FORMULA_0003 0.0 255.0 /end CHARACTERISTIC
/begin CHARACTERISTIC K_ED_MD_SK_ERR.DEC_VOR_EINTRAG "Filterverringerung vorm Fehlerspeichereintrag" VALUE 0x71157 TKW_VV_VV_UB 100.0 FORMULA_0003 0.0 255.0 /end CHARACTERISTIC
/begin CHARACTERISTIC K_ED_MD_SK_ERR.FEHLERSCHWELLE "Filterschwelle fuer Fehlereintrag" VALUE 0x71154 TKW_VV_VV_UB 100.0 FORMULA_0003 0.0 255.0 /end CHARACTERISTIC
/begin CHARACTERISTIC K_ED_MD_SK_ERR.INC_NACH_EINTRAG "Filtererhoehung nach Fehlerspeichereintrag" VALUE 0x71158 TKW_VV_VV_UB 100.0 FORMULA_0003 0.0 255.0 /end CHARACTERISTIC
/begin CHARACTERISTIC K_ED_MD_SK_ERR.INC_VOR_EINTRAG "Filtererhoehung vorm Fehlerspeichereintrag" VALUE 0x71156 TKW_VV_VV_UB 100.0 FORMULA_0003 0.0 255.0 /end CHARACTERISTIC
/begin CHARACTERISTIC K_ED_MD_SK_ERR.KLASSENINDEX "Auswahl der Fehlerklasse" VALUE 0x7115A TKW_VV_VV_UB 100.0 FORMULA_0003 0.0 8.0 /end CHARACTERISTIC
/begin CHARACTERISTIC K_ED_MD_SK_ERR.OK_SCHWELLE "Filterschwelle fuer Fehleraustrag" VALUE 0x71155 TKW_VV_VV_UB 100.0 FORMULA_0003 0.0 255.0 /end CHARACTERISTIC
/begin CHARACTERISTIC K_ED_MD_SK_ERR.P_CODE_OPENLOAD "P-Code fuer die Art OPENLOAD" VALUE 0x71150 TKW_VV_VV_UW 100.0 FORMULA_0010 0.0 65535.0 /end CHARACTERISTIC
/begin CHARACTERISTIC K_ED_MD_SK_ERR.P_CODE_SH_TO_GND "P-Code fuer die Art SH_TO_GND" VALUE 0x7114E TKW_VV_VV_UW 100.0 FORMULA_0010 0.0 65535.0 /end CHARACTERISTIC
/begin CHARACTERISTIC K_ED_MD_SK_ERR.P_CODE_SH_TO_UB "P-Code fuer die Art SH_TO_UB" VALUE 0x7114C TKW_VV_VV_UW 100.0 FORMULA_0010 0.0 65535.0 /end CHARACTERISTIC
/begin CHARACTERISTIC K_ED_MD_SK_ERR.P_CODE_UNPLAUSIBEL "P-Code fuer die Art UNPLAUSIBEL" VALUE 0x71152 TKW_VV_VV_UW 100.0 FORMULA_0010 0.0 65535.0 /end CHARACTERISTIC
/begin CHARACTERISTIC K_ED_N_GETR_EIN_HS.DEC_NACH_EINTRAG "Filterverringerung nach Fehlerspeichereintrag" VALUE 0x71709 TKW_VV_VV_UB 100.0 FORMULA_0003 0.0 255.0 /end CHARACTERISTIC
/begin CHARACTERISTIC K_ED_N_GETR_EIN_HS.DEC_VOR_EINTRAG "Filterverringerung vorm Fehlerspeichereintrag" VALUE 0x71707 TKW_VV_VV_UB 100.0 FORMULA_0003 0.0 255.0 /end CHARACTERISTIC
/begin CHARACTERISTIC K_ED_N_GETR_EIN_HS.FEHLERSCHWELLE "Filterschwelle fuer Fehlereintrag" VALUE 0x71704 TKW_VV_VV_UB 100.0 FORMULA_0003 0.0 255.0 /end CHARACTERISTIC
/begin CHARACTERISTIC K_ED_N_GETR_EIN_HS.INC_NACH_EINTRAG "Filtererhoehung nach Fehlerspeichereintrag" VALUE 0x71708 TKW_VV_VV_UB 100.0 FORMULA_0003 0.0 255.0 /end CHARACTERISTIC
/begin CHARACTERISTIC K_ED_N_GETR_EIN_HS.INC_VOR_EINTRAG "Filtererhoehung vorm Fehlerspeichereintrag" VALUE 0x71706 TKW_VV_VV_UB 100.0 FORMULA_0003 0.0 255.0 /end CHARACTERISTIC
/begin CHARACTERISTIC K_ED_N_GETR_EIN_HS.KLASSENINDEX "Auswahl der Fehlerklasse" VALUE 0x7170A TKW_VV_VV_UB 100.0 FORMULA_0003 0.0 8.0 /end CHARACTERISTIC
/begin CHARACTERISTIC K_ED_N_GETR_EIN_HS.OK_SCHWELLE "Filterschwelle fuer Fehleraustrag" VALUE 0x71705 TKW_VV_VV_UB 100.0 FORMULA_0003 0.0 255.0 /end CHARACTERISTIC
/begin CHARACTERISTIC K_ED_N_GETR_EIN_HS.P_CODE_OPENLOAD "P-Code fuer die Art OPENLOAD" VALUE 0x71700 TKW_VV_VV_UW 100.0 FORMULA_0010 0.0 65535.0 /end CHARACTERISTIC
/begin CHARACTERISTIC K_ED_N_GETR_EIN_HS.P_CODE_SH_TO_GND "P-Code fuer die Art SH_TO_GND" VALUE 0x716FE TKW_VV_VV_UW 100.0 FORMULA_0010 0.0 65535.0 /end CHARACTERISTIC
/begin CHARACTERISTIC K_ED_N_GETR_EIN_HS.P_CODE_SH_TO_UB "P-Code fuer die Art SH_TO_UB" VALUE 0x716FC TKW_VV_VV_UW 100.0 FORMULA_0010 0.0 65535.0 /end CHARACTERISTIC
/begin CHARACTERISTIC K_ED_N_GETR_EIN_HS.P_CODE_UNPLAUSIBEL "P-Code fuer die Art UNPLAUSIBEL" VALUE 0x71702 TKW_VV_VV_UW 100.0 FORMULA_0010 0.0 65535.0 /end CHARACTERISTIC
/begin CHARACTERISTIC K_ED_PCTRL_IGN.DEC_NACH_EINTRAG "Filterverringerung nach Fehlerspeichereintrag" VALUE 0x70DFF TKW_VV_VV_UB 100.0 FORMULA_0003 0.0 255.0 /end CHARACTERISTIC
/begin COMPU_METHOD FORMULA_0003 "FORMULA_0003" RAT_FUNC "%3.0" "-" COEFFS 0 1 0 0 0 1 /end COMPU_METHOD
/begin COMPU_METHOD FORMULA_0010 "FORMULA_0010" RAT_FUNC "%5.0" "-" COEFFS 0 1 0 0 0 1 /end COMPU_METHOD
/begin FUNCTION Eigendiagnose ""
 /begin DEF_CHARACTERISTIC K_ED_AUSS_ABG_MULT.OK_SCHWELLE K_ED_AUSS_ABG_MULT.P_CODE_OPENLOAD K_ED_AUSS_ABG_MULT.P_CODE_SH_TO_GND K_ED_AUSS_ABG_MULT.P_CODE_SH_TO_UB K_ED_AUSS_ABG_MULT.P_CODE_UNPLAUSIBEL K_ED_AUSS_ABG_Z1.DEC_NACH_EINTRAG K_ED_AUSS_ABG_Z1.DEC_VOR_EINTRAG K_ED_AUSS_ABG_Z1.FEHLERSCHWELLE K_ED_AUSS_ABG_Z1.INC_NACH_EINTRAG K_ED_AUSS_ABG_Z1.INC_VOR_EINTRAG K_ED_AUSS_ABG_Z1.KLASSENINDEX K_ED_AUSS_ABG_Z1.OK_SCHWELLE K_ED_AUSS_ABG_Z1.P_CODE_OPENLOAD K_ED_AUSS_ABG_Z1.P_CODE_SH_TO_GND K_ED_AUSS_ABG_Z1.P_CODE_SH_TO_UB K_ED_AUSS_ABG_Z1.P_CODE_UNPLAUSIBEL K_ED_AUSS_ABG_Z10.DEC_NACH_EINTRAG K_ED_AUSS_ABG_Z10.DEC_VOR_EINTRAG K_ED_AUSS_ABG_Z10.FEHLERSCHWELLE K_ED_AUSS_ABG_Z10.INC_NACH_EINTRAG K_ED_AUSS_ABG_Z10.INC_VOR_EINTRAG K_ED_AUSS_ABG_Z10.KLASSENINDEX K_ED_AUSS_ABG_Z10.OK_SCHWELLE K_ED_AUSS_ABG_Z10.P_CODE_OPENLOAD K_ED_AUSS_ABG_Z10.P_CODE_SH_TO_GND K_ED_AUSS_ABG_Z10.P_CODE_SH_TO_UB K_ED_AUSS_ABG_Z10.P_CODE_UNPLAUSIBEL K_ED_AUSS_ABG_Z2.DEC_NACH_EINTRAG K_ED_AUSS_ABG_Z2.DEC_VOR_EINTRAG K_ED_AUSS_ABG_Z2.FEHLERSCHWELLE K_ED_AUSS_ABG_Z2.INC_NACH_EINTRAG K_ED_AUSS_ABG_Z2.INC_VOR_EINTRAG K_ED_AUSS_ABG_Z2.KLASSENINDEX K_ED_AUSS_ABG_Z2.OK_SCHWELLE K_ED_AUSS_ABG_Z2.P_CODE_OPENLOAD K_ED_AUSS_ABG_Z2.P_CODE_SH_TO_GND K_ED_AUSS_ABG_Z2.P_CODE_SH_TO_UB K_ED_AUSS_ABG_Z2.P_CODE_UNPLAUSIBEL K_ED_AUSS_ABG_Z3.DEC_NACH_EINTRAG K_ED_AUSS_ABG_Z3.DEC_VOR_EINTRAG K_ED_AUSS_ABG_Z3.FEHLERSCHWELLE K_ED_AUSS_ABG_Z3.INC_NACH_EINTRAG K_ED_AUSS_ABG_Z3.INC_VOR_EINTRAG K_ED_AUSS_ABG_Z3.KLASSENINDEX K_ED_AUSS_ABG_Z3.OK_SCHWELLE K_ED_AUSS_ABG_Z3.P_CODE_OPENLOAD K_ED_AUSS_ABG_Z3.P_CODE_SH_TO_GND K_ED_AUSS_ABG_Z3.P_CODE_SH_TO_UB K_ED_AUSS_ABG_Z3.P_CODE_UNPLAUSIBEL K_ED_AUSS_ABG_Z4.DEC_NACH_EINTRAG K_ED_AUSS_ABG_Z4.DEC_VOR_EINTRAG K_ED_AUSS_ABG_Z4.FEHLERSCHWELLE K_ED_AUSS_ABG_Z4.INC_NACH_EINTRAG K_ED_AUSS_ABG_Z4.INC_VOR_EINTRAG K_ED_AUSS_ABG_Z4.KLASSENINDEX K_ED_AUSS_ABG_Z4.OK_SCHWELLE K_ED_AUSS_ABG_Z4.P_CODE_OPENLOAD K_ED_AUSS_ABG_Z4.P_CODE_SH_TO_GND K_ED_AUSS_ABG_Z4.P_CODE_SH_TO_UB K_ED_AUSS_ABG_Z4.P_CODE_UNPLAUSIBEL K_ED_AUSS_ABG_Z5.DEC_NACH_EINTRAG K_ED_AUSS_ABG_Z5.DEC_VOR_EINTRAG K_ED_AUSS_ABG_Z5.FEHLERSCHWELLE K_ED_AUSS_ABG_Z5.INC_NACH_EINTRAG K_ED_AUSS_ABG_Z5.INC_VOR_EINTRAG K_ED_AUSS_ABG_Z5.KLASSENINDEX K_ED_AUSS_ABG_Z5.OK_SCHWELLE K_ED_AUSS_ABG_Z5.P_CODE_OPENLOAD K_ED_AUSS_ABG_Z5.P_CODE_SH_TO_GND K_ED_AUSS_ABG_Z5.P_CODE_SH_TO_UB K_ED_AUSS_ABG_Z5.P_CODE_UNPLAUSIBEL K_ED_AUSS_ABG_Z6.DEC_NACH_EINTRAG K_ED_AUSS_ABG_Z6.DEC_VOR_EINTRAG K_ED_AUSS_ABG_Z6.FEHLERSCHWELLE K_ED_AUSS_ABG_Z6.INC_NACH_EINTRAG K_ED_AUSS_ABG_Z6.INC_VOR_EINTRAG K_ED_AUSS_ABG_Z6.KLASSENINDEX K_ED_AUSS_ABG_Z6.OK_SCHWELLE K_ED_AUSS_ABG_Z6.P_CODE_OPENLOAD K_ED_AUSS_ABG_Z6.P_CODE_SH_TO_GND K_ED_AUSS_ABG_Z6.P_CODE_SH_TO_UB K_ED_AUSS_ABG_Z6.P_CODE_UNPLAUSIBEL K_ED_AUSS_ABG_Z7.DEC_NACH_EINTRAG K_ED_AUSS_ABG_Z7.DEC_VOR_EINTRAG K_ED_AUSS_ABG_Z7.FEHLERSCHWELLE K_ED_AUSS_ABG_Z7.INC_NACH_EINTRAG K_ED_AUSS_ABG_Z7.INC_VOR_EINTRAG K_ED_AUSS_ABG_Z7.KLASSENINDEX K_ED_AUSS_ABG_Z7.OK_SCHWELLE K_ED_AUSS_ABG_Z7.P_CODE_OPENLOAD K_ED_AUSS_ABG_Z7.P_CODE_SH_TO_GND K_ED_AUSS_ABG_Z7.P_CODE_SH_TO_UB K_ED_AUSS_ABG_Z7.P_CODE_UNPLAUSIBEL K_ED_AUSS_ABG_Z8.DEC_NACH_EINTRAG K_ED_AUSS_ABG_Z8.DEC_VOR_EINTRAG K_ED_AUSS_ABG_Z8.FEHLERSCHWELLE K_ED_AUSS_ABG_Z8.INC_NACH_EINTRAG K_ED_AUSS_ABG_Z8.INC_VOR_EINTRAG K_ED_AUSS_ABG_Z8.KLASSENINDEX K_ED_AUSS_ABG_Z8.OK_SCHWELLE K_ED_AUSS_ABG_Z8.P_CODE_OPENLOAD K_ED_AUSS_ABG_Z8.P_CODE_SH_TO_GND K_ED_AUSS_ABG_Z8.P_CODE_SH_TO_UB K_ED_AUSS_ABG_Z8.P_CODE_UNPLAUSIBEL K_ED_AUSS_ABG_Z9.DEC_NACH_EINTRAG K_ED_AUSS_ABG_Z9.DEC_VOR_EINTRAG K_ED_AUSS_ABG_Z9.FEHLERSCHWELLE K_ED_AUSS_ABG_Z9.INC_NACH_EINTRAG K_ED_AUSS_ABG_Z9.INC_VOR_EINTRAG K_ED_AUSS_ABG_Z9.KLASSENINDEX K_ED_AUSS_ABG_Z9.OK_SCHWELLE K_ED_AUSS_ABG_Z9.P_CODE_OPENLOAD K_ED_AUSS_ABG_Z9.P_CODE_SH_TO_GND K_ED_AUSS_ABG_Z9.P_CODE_SH_TO_UB K_ED_AUSS_ABG_Z9.P_CODE_UNPLAUSIBEL K_ED_AUSS_KAT_MULT.DEC_NACH_EINTRAG K_ED_AUSS_KAT_MULT.DEC_VOR_EINTRAG K_ED_AUSS_KAT_MULT.FEHLERSCHWELLE K_ED_AUSS_KAT_MULT.INC_NACH_EINTRAG K_ED_AUSS_KAT_MULT.INC_VOR_EINTRAG K_ED_AUSS_KAT_MULT.KLASSENINDEX K_ED_AUSS_KAT_MULT.OK_SCHWELLE K_ED_AUSS_KAT_MULT.P_CODE_OPENLOAD K_ED_AUSS_KAT_MULT.P_CODE_SH_TO_GND K_ED_AUSS_KAT_MULT.P_CODE_SH_TO_UB K_ED_AUSS_KAT_MULT.P_CODE_UNPLAUSIBEL K_ED_AUSS_KAT_Z1.DEC_NACH_EINTRAG K_ED_AUSS_KAT_Z1.DEC_VOR_EINTRAG K_ED_AUSS_KAT_Z1.FEHLERSCHWELLE K_ED_AUSS_KAT_Z1.INC_NACH_EINTRAG K_ED_AUSS_KAT_Z1.INC_VOR_EINTRAG K_ED_AUSS_KAT_Z1.KLASSENINDEX K_ED_AUSS_KAT_Z1.OK_SCHWELLE K_ED_AUSS_KAT_Z1.P_CODE_OPENLOAD K_ED_AUSS_KAT_Z1.P_CODE_SH_TO_GND K_ED_AUSS_KAT_Z1.P_CODE_SH_TO_UB K_ED_AUSS_KAT_Z1.P_CODE_UNPLAUSIBEL K_ED_AUSS_KAT_Z10.DEC_NACH_EINTRAG K_ED_AUSS_KAT_Z10.DEC_VOR_EINTRAG K_ED_AUSS_KAT_Z10.FEHLERSCHWELLE K_ED_AUSS_KAT_Z10.INC_NACH_EINTRAG K_ED_AUSS_KAT_Z10.INC_VOR_EINTRAG K_ED_AUSS_KAT_Z10.KLASSENINDEX K_ED_AUSS_KAT_Z10.OK_SCHWELLE K_ED_AUSS_KAT_Z10.P_CODE_OPENLOAD K_ED_AUSS_KAT_Z10.P_CODE_SH_TO_GND K_ED_AUSS_KAT_Z10.P_CODE_SH_TO_UB K_ED_AUSS_KAT_Z10.P_CODE_UNPLAUSIBEL K_ED_AUSS_KAT_Z2.DEC_NACH_EINTRAG K_ED_AUSS_KAT_Z2.DEC_VOR_EINTRAG K_ED_AUSS_KAT_Z2.FEHLERSCHWELLE K_ED_AUSS_KAT_Z2.INC_NACH_EINTRAG K_ED_AUSS_KAT_Z2.INC_VOR_EINTRAG K_ED_AUSS_KAT_Z2.KLASSENINDEX K_ED_AUSS_KAT_Z2.OK_SCHWELLE K_ED_AUSS_KAT_Z2.P_CODE_OPENLOAD K_ED_AUSS_KAT_Z2.P_CODE_SH_TO_GND K_ED_AUSS_KAT_Z2.P_CODE_SH_TO_UB K_ED_AUSS_KAT_Z2.P_CODE_UNPLAUSIBEL K_ED_AUSS_KAT_Z3.DEC_NACH_EINTRAG K_ED_AUSS_KAT_Z3.DEC_VOR_EINTRAG K_ED_AUSS_KAT_Z3.FEHLERSCHWELLE K_ED_AUSS_KAT_Z3.INC_NACH_EINTRAG K_ED_AUSS_KAT_Z3.INC_VOR_EINTRAG K_ED_AUSS_KAT_Z3.KLASSENINDEX K_ED_AUSS_KAT_Z3.OK_SCHWELLE K_ED_AUSS_KAT_Z3.P_CODE_OPENLOAD K_ED_AUSS_KAT_Z3.P_CODE_SH_TO_GND K_ED_AUSS_KAT_Z3.P_CODE_SH_TO_UB K_ED_AUSS_KAT_Z3.P_CODE_UNPLAUSIBEL K_ED_AUSS_KAT_Z4.DEC_NACH_EINTRAG K_ED_AUSS_KAT_Z4.DEC_VOR_EINTRAG K_ED_AUSS_KAT_Z4.FEHLERSCHWELLE K_ED_AUSS_KAT_Z4.INC_NACH_EINTRAG K_ED_AUSS_KAT_Z4.INC_VOR_EINTRAG K_ED_AUSS_KAT_Z4.KLASSENINDEX K_ED_AUSS_KAT_Z4.OK_SCHWELLE K_ED_AUSS_KAT_Z4.P_CODE_OPENLOAD K_ED_AUSS_KAT_Z4.P_CODE_SH_TO_GND K_ED_AUSS_KAT_Z4.P_CODE_SH_TO_UB K_ED_AUSS_KAT_Z4.P_CODE_UNPLAUSIBEL K_ED_AUSS_KAT_Z5.DEC_NACH_EINTRAG K_ED_AUSS_KAT_Z5.DEC_VOR_EINTRAG K_ED_AUSS_KAT_Z5.FEHLERSCHWELLE K_ED_AUSS_KAT_Z5.INC_NACH_EINTRAG K_ED_AUSS_KAT_Z5.INC_VOR_EINTRAG K_ED_AUSS_KAT_Z5.KLASSENINDEX K_ED_AUSS_KAT_Z5.OK_SCHWELLE K_ED_AUSS_KAT_Z5.P_CODE_OPENLOAD K_ED_AUSS_KAT_Z5.P_CODE_SH_TO_GND K_ED_AUSS_KAT_Z5.P_CODE_SH_TO_UB K_ED_AUSS_KAT_Z5.P_CODE_UNPLAUSIBEL K_ED_AUSS_KAT_Z6.DEC_NACH_EINTRAG K_ED_AUSS_KAT_Z6.DEC_VOR_EINTRAG K_ED_AUSS_KAT_Z6.FEHLERSCHWELLE K_ED_AUSS_KAT_Z6.INC_NACH_EINTRAG K_ED_AUSS_KAT_Z6.INC_VOR_EINTRAG K_ED_AUSS_KAT_Z6.KLASSENINDEX K_ED_AUSS_KAT_Z6.OK_SCHWELLE K_ED_AUSS_KAT_Z6.P_CODE_OPENLOAD K_ED_AUSS_KAT_Z6.P_CODE_SH_TO_GND K_ED_AUSS_KAT_Z6.P_CODE_SH_TO_UB K_ED_AUSS_KAT_Z6.P_CODE_UNPLAUSIBEL K_ED_AUSS_KAT_Z7.DEC_NACH_EINTRAG K_ED_AUSS_KAT_Z7.DEC_VOR_EINTRAG K_ED_AUSS_KAT_Z7.FEHLERSCHWELLE K_ED_AUSS_KAT_Z7.INC_NACH_EINTRAG K_ED_AUSS_KAT_Z7.INC_VOR_EINTRAG K_ED_AUSS_KAT_Z7.KLASSENINDEX K_ED_AUSS_KAT_Z7.OK_SCHWELLE K_ED_AUSS_KAT_Z7.P_CODE_OPENLOAD K_ED_AUSS_KAT_Z7.P_CODE_SH_TO_GND K_ED_AUSS_KAT_Z7.P_CODE_SH_TO_UB K_ED_AUSS_KAT_Z7.P_CODE_UNPLAUSIBEL K_ED_AUSS_KAT_Z8.DEC_NACH_EINTRAG K_ED_AUSS_KAT_Z8.DEC_VOR_EINTRAG K_ED_AUSS_KAT_Z8.FEHLERSCHWELLE K_ED_AUSS_KAT_Z8.INC_NACH_EINTRAG K_ED_AUSS_KAT_Z8.INC_VOR_EINTRAG K_ED_AUSS_KAT_Z8.KLASSENINDEX K_ED_AUSS_KAT_Z8.OK_SCHWELLE K_ED_AUSS_KAT_Z8.P_CODE_OPENLOAD K_ED_AUSS_KAT_Z8.P_CODE_SH_TO_GND K_ED_AUSS_KAT_Z8.P_CODE_SH_TO_UB K_ED_AUSS_KAT_Z8.P_CODE_UNPLAUSIBEL K_ED_AUSS_KAT_Z9.DEC_NACH_EINTRAG K_ED_AUSS_KAT_Z9.DEC_VOR_EINTRAG K_ED_AUSS_KAT_Z9.FEHLERSCHWELLE K_ED_AUSS_KAT_Z9.INC_NACH_EINTRAG K_ED_AUSS_KAT_Z9.INC_VOR_EINTRAG K_ED_AUSS_KAT_Z9.KLASSENINDEX K_ED_AUSS_KAT_Z9.OK_SCHWELLE K_ED_AUSS_KAT_Z9.P_CODE_OPENLOAD K_ED_AUSS_KAT_Z9.P_CODE_SH_TO_GND K_ED_AUSS_KAT_Z9.P_CODE_SH_TO_UB K_ED_AUSS_KAT_Z9.P_CODE_UNPLAUSIBEL K_ED_BLS_PLAU.DEC_NACH_EINTRAG K_ED_BLS_PLAU.DEC_VOR_EINTRAG K_ED_BLS_PLAU.FEHLERSCHWELLE K_ED_BLS_PLAU.INC_NACH_EINTRAG K_ED_BLS_PLAU.INC_VOR_EINTRAG K_ED_BLS_PLAU.KLASSENINDEX K_ED_BLS_PLAU.OK_SCHWELLE K_ED_BLS_PLAU.P_CODE_OPENLOAD K_ED_BLS_PLAU.P_CODE_SH_TO_GND K_ED_BLS_PLAU.P_CODE_SH_TO_UB K_ED_BLS_PLAU.P_CODE_UNPLAUSIBEL K_ED_DK_INIT.DEC_NACH_EINTRAG K_ED_DK_INIT.DEC_VOR_EINTRAG K_ED_DK_INIT.FEHLERSCHWELLE K_ED_DK_INIT.INC_NACH_EINTRAG K_ED_DK_INIT.INC_VOR_EINTRAG K_ED_DK_INIT.KLASSENINDEX K_ED_DK_INIT.OK_SCHWELLE K_ED_DK_INIT.P_CODE_OPENLOAD K_ED_DK_INIT.P_CODE_SH_TO_GND K_ED_DK_INIT.P_CODE_SH_TO_UB K_ED_DK_INIT.P_CODE_UNPLAUSIBEL K_ED_DK1_ADAPT.DEC_NACH_EINTRAG K_ED_DK1_ADAPT.DEC_VOR_EINTRAG K_ED_DK1_ADAPT.FEHLERSCHWELLE K_ED_DK1_ADAPT.INC_NACH_EINTRAG K_ED_DK1_ADAPT.INC_VOR_EINTRAG K_ED_DK1_ADAPT.KLASSENINDEX K_ED_DK1_ADAPT.OK_SCHWELLE K_ED_DK1_ADAPT.P_CODE_OPENLOAD K_ED_DK1_ADAPT.P_CODE_SH_TO_GND K_ED_DK1_ADAPT.P_CODE_SH_TO_UB K_ED_DK1_ADAPT.P_CODE_UNPLAUSIBEL K_ED_DK1_CAN.DEC_NACH_EINTRAG K_ED_DK1_CAN.DEC_VOR_EINTRAG K_ED_DK1_CAN.FEHLERSCHWELLE K_ED_DK1_CAN.INC_NACH_EINTRAG K_ED_DK1_CAN.INC_VOR_EINTRAG K_ED_DK1_CAN.KLASSENINDEX K_ED_DK1_CAN.OK_SCHWELLE K_ED_DK1_CAN.P_CODE_OPENLOAD K_ED_DK1_CAN.P_CODE_SH_TO_GND K_ED_DK1_CAN.P_CODE_SH_TO_UB K_ED_DK1_CAN.P_CODE_UNPLAUSIBEL K_ED_DK1_CMD.DEC_NACH_EINTRAG K_ED_DK1_CMD.DEC_VOR_EINTRAG K_ED_DK1_CMD.FEHLERSCHWELLE K_ED_DK1_CMD.INC_NACH_EINTRAG K_ED_DK1_CMD.INC_VOR_EINTRAG K_ED_DK1_CMD.KLASSENINDEX K_ED_DK1_CMD.OK_SCHWELLE K_ED_DK1_CMD.P_CODE_OPENLOAD K_ED_DK1_CMD.P_CODE_SH_TO_GND K_ED_DK1_CMD.P_CODE_SH_TO_UB K_ED_DK1_CMD.P_CODE_UNPLAUSIBEL K_ED_DK1_FEDERN.DEC_NACH_EINTRAG K_ED_DK1_FEDERN.DEC_VOR_EINTRAG K_ED_DK1_FEDERN.FEHLERSCHWELLE K_ED_DK1_FEDERN.INC_NACH_EINTRAG K_ED_DK1_FEDERN.INC_VOR_EINTRAG K_ED_DK1_FEDERN.KLASSENINDEX K_ED_DK1_FEDERN.OK_SCHWELLE K_ED_DK1_FEDERN.P_CODE_OPENLOAD K_ED_DK1_FEDERN.P_CODE_SH_TO_GND K_ED_DK1_FEDERN.P_CODE_SH_TO_UB K_ED_DK1_FEDERN.P_CODE_UNPLAUSIBEL K_ED_DK1_PDR.DEC_NACH_EINTRAG K_ED_DK1_PDR.DEC_VOR_EINTRAG K_ED_DK1_PDR.FEHLERSCHWELLE K_ED_DK1_PDR.INC_NACH_EINTRAG K_ED_DK1_PDR.INC_VOR_EINTRAG K_ED_DK1_PDR.KLASSENINDEX K_ED_DK1_PDR.OK_SCHWELLE K_ED_DK1_PDR.P_CODE_OPENLOAD K_ED_DK1_PDR.P_CODE_SH_TO_GND K_ED_DK1_PDR.P_CODE_SH_TO_UB K_ED_DK1_PDR.P_CODE_UNPLAUSIBEL K_ED_DK1_REGLER.DEC_NACH_EINTRAG K_ED_DK1_REGLER.DEC_VOR_EINTRAG K_ED_DK1_REGLER.FEHLERSCHWELLE K_ED_DK1_REGLER.INC_NACH_EINTRAG K_ED_DK1_REGLER.INC_VOR_EINTRAG K_ED_DK1_REGLER.KLASSENINDEX K_ED_DK1_REGLER.OK_SCHWELLE K_ED_DK1_REGLER.P_CODE_OPENLOAD K_ED_DK1_REGLER.P_CODE_SH_TO_GND K_ED_DK1_REGLER.P_CODE_SH_TO_UB K_ED_DK1_REGLER.P_CODE_UNPLAUSIBEL K_ED_DK1_SK_ERR.DEC_NACH_EINTRAG K_ED_DK1_SK_ERR.DEC_VOR_EINTRAG K_ED_DK1_SK_ERR.FEHLERSCHWELLE K_ED_DK1_SK_ERR.INC_NACH_EINTRAG K_ED_DK1_SK_ERR.INC_VOR_EINTRAG K_ED_DK1_SK_ERR.KLASSENINDEX K_ED_DK1_SK_ERR.OK_SCHWELLE K_ED_DK1_SK_ERR.P_CODE_OPENLOAD K_ED_DK1_SK_ERR.P_CODE_SH_TO_GND K_ED_DK1_SK_ERR.P_CODE_SH_TO_UB K_ED_DK1_SK_ERR.P_CODE_UNPLAUSIBEL K_ED_DK1_WDK.DEC_NACH_EINTRAG K_ED_DK1_WDK.DEC_VOR_EINTRAG K_ED_DK1_WDK.FEHLERSCHWELLE K_ED_DK1_WDK.INC_NACH_EINTRAG K_ED_DK1_WDK.INC_VOR_EINTRAG K_ED_DK1_WDK.KLASSENINDEX K_ED_DK1_WDK.OK_SCHWELLE K_ED_DK1_WDK.P_CODE_OPENLOAD K_ED_DK1_WDK.P_CODE_SH_TO_GND K_ED_DK1_WDK.P_CODE_SH_TO_UB K_ED_DK1_WDK.P_CODE_UNPLAUSIBEL K_ED_DK1_ZUST.DEC_NACH_EINTRAG K_ED_DK1_ZUST.DEC_VOR_EINTRAG K_ED_DK1_ZUST.FEHLERSCHWELLE K_ED_DK1_ZUST.INC_NACH_EINTRAG K_ED_DK1_ZUST.INC_VOR_EINTRAG K_ED_DK1_ZUST.KLASSENINDEX K_ED_DK1_ZUST.OK_SCHWELLE K_ED_DK1_ZUST.P_CODE_OPENLOAD K_ED_DK1_ZUST.P_CODE_SH_TO_GND K_ED_DK1_ZUST.P_CODE_SH_TO_UB K_ED_DK1_ZUST.P_CODE_UNPLAUSIBEL K_ED_DK2_ADAPT.DEC_NACH_EINTRAG K_ED_DK2_ADAPT.DEC_VOR_EINTRAG K_ED_DK2_ADAPT.FEHLERSCHWELLE K_ED_DK2_ADAPT.INC_NACH_EINTRAG K_ED_DK2_ADAPT.INC_VOR_EINTRAG K_ED_DK2_ADAPT.KLASSENINDEX K_ED_DK2_ADAPT.OK_SCHWELLE K_ED_DK2_ADAPT.P_CODE_OPENLOAD K_ED_DK2_ADAPT.P_CODE_SH_TO_GND K_ED_DK2_ADAPT.P_CODE_SH_TO_UB K_ED_DK2_ADAPT.P_CODE_UNPLAUSIBEL K_ED_DK2_CAN.DEC_NACH_EINTRAG K_ED_DK2_CAN.DEC_VOR_EINTRAG K_ED_DK2_CAN.FEHLERSCHWELLE K_ED_DK2_CAN.INC_NACH_EINTRAG K_ED_DK2_CAN.INC_VOR_EINTRAG K_ED_DK2_CAN.KLASSENINDEX K_ED_DK2_CAN.OK_SCHWELLE K_ED_DK2_CAN.P_CODE_OPENLOAD K_ED_DK2_CAN.P_CODE_SH_TO_GND K_ED_DK2_CAN.P_CODE_SH_TO_UB K_ED_DK2_CAN.P_CODE_UNPLAUSIBEL K_ED_DK2_CMD.DEC_NACH_EINTRAG K_ED_DK2_CMD.DEC_VOR_EINTRAG K_ED_DK2_CMD.FEHLERSCHWELLE K_ED_DK2_CMD.INC_NACH_EINTRAG K_ED_DK2_CMD.INC_VOR_EINTRAG K_ED_DK2_CMD.KLASSENINDEX K_ED_DK2_CMD.OK_SCHWELLE K_ED_DK2_CMD.P_CODE_OPENLOAD K_ED_DK2_CMD.P_CODE_SH_TO_GND K_ED_DK2_CMD.P_CODE_SH_TO_UB K_ED_DK2_CMD.P_CODE_UNPLAUSIBEL K_ED_DK2_FEDERN.DEC_NACH_EINTRAG K_ED_DK2_FEDERN.DEC_VOR_EINTRAG K_ED_DK2_FEDERN.FEHLERSCHWELLE K_ED_DK2_FEDERN.INC_NACH_EINTRAG K_ED_DK2_FEDERN.INC_VOR_EINTRAG K_ED_DK2_FEDERN.KLASSENINDEX K_ED_DK2_FEDERN.OK_SCHWELLE K_ED_DK2_FEDERN.P_CODE_OPENLOAD K_ED_DK2_FEDERN.P_CODE_SH_TO_GND K_ED_DK2_FEDERN.P_CODE_SH_TO_UB K_ED_DK2_FEDERN.P_CODE_UNPLAUSIBEL K_ED_DK2_PDR.DEC_NACH_EINTRAG K_ED_DK2_PDR.DEC_VOR_EINTRAG K_ED_DK2_PDR.FEHLERSCHWELLE K_ED_DK2_PDR.INC_NACH_EINTRAG K_ED_DK2_PDR.INC_VOR_EINTRAG K_ED_DK2_PDR.KLASSENINDEX K_ED_DK2_PDR.OK_SCHWELLE K_ED_DK2_PDR.P_CODE_OPENLOAD K_ED_DK2_PDR.P_CODE_SH_TO_GND K_ED_DK2_PDR.P_CODE_SH_TO_UB K_ED_DK2_PDR.P_CODE_UNPLAUSIBEL K_ED_DK2_REGLER.DEC_NACH_EINTRAG K_ED_DK2_REGLER.DEC_VOR_EINTRAG K_ED_DK2_REGLER.FEHLERSCHWELLE K_ED_DK2_REGLER.INC_NACH_EINTRAG K_ED_DK2_REGLER.INC_VOR_EINTRAG K_ED_DK2_REGLER.KLASSENINDEX K_ED_DK2_REGLER.OK_SCHWELLE K_ED_DK2_REGLER.P_CODE_OPENLOAD K_ED_DK2_REGLER.P_CODE_SH_TO_GND K_ED_DK2_REGLER.P_CODE_SH_TO_UB K_ED_DK2_REGLER.P_CODE_UNPLAUSIBEL K_ED_DK2_SK_ERR.DEC_NACH_EINTRAG K_ED_DK2_SK_ERR.DEC_VOR_EINTRAG K_ED_DK2_SK_ERR.FEHLERSCHWELLE K_ED_DK2_SK_ERR.INC_NACH_EINTRAG K_ED_DK2_SK_ERR.INC_VOR_EINTRAG K_ED_DK2_SK_ERR.KLASSENINDEX K_ED_DK2_SK_ERR.OK_SCHWELLE K_ED_DK2_SK_ERR.P_CODE_OPENLOAD K_ED_DK2_SK_ERR.P_CODE_SH_TO_GND K_ED_DK2_SK_ERR.P_CODE_SH_TO_UB K_ED_DK2_SK_ERR.P_CODE_UNPLAUSIBEL K_ED_DK2_WDK.DEC_NACH_EINTRAG K_ED_DK2_WDK.DEC_VOR_EINTRAG K_ED_DK2_WDK.FEHLERSCHWELLE K_ED_DK2_WDK.INC_NACH_EINTRAG K_ED_DK2_WDK.INC_VOR_EINTRAG K_ED_DK2_WDK.KLASSENINDEX K_ED_DK2_WDK.OK_SCHWELLE K_ED_DK2_WDK.P_CODE_OPENLOAD K_ED_DK2_WDK.P_CODE_SH_TO_GND K_ED_DK2_WDK.P_CODE_SH_TO_UB K_ED_DK2_WDK.P_CODE_UNPLAUSIBEL K_ED_DK2_ZUST.DEC_NACH_EINTRAG K_ED_DK2_ZUST.DEC_VOR_EINTRAG K_ED_DK2_ZUST.FEHLERSCHWELLE K_ED_DK2_ZUST.INC_NACH_EINTRAG K_ED_DK2_ZUST.INC_VOR_EINTRAG K_ED_DK2_ZUST.KLASSENINDEX K_ED_DK2_ZUST.OK_SCHWELLE K_ED_DK2_ZUST.P_CODE_OPENLOAD K_ED_DK2_ZUST.P_CODE_SH_TO_GND K_ED_DK2_ZUST.P_CODE_SH_TO_UB K_ED_DK2_ZUST.P_CODE_UNPLAUSIBEL K_ED_DKG_EINGR.DEC_NACH_EINTRAG K_ED_DKG_EINGR.DEC_VOR_EINTRAG K_ED_DKG_EINGR.FEHLERSCHWELLE K_ED_DKG_EINGR.INC_NACH_EINTRAG K_ED_DKG_EINGR.INC_VOR_EINTRAG K_ED_DKG_EINGR.KLASSENINDEX K_ED_DKG_EINGR.OK_SCHWELLE K_ED_DKG_EINGR.P_CODE_OPENLOAD K_ED_DKG_EINGR.P_CODE_SH_TO_GND K_ED_DKG_EINGR.P_CODE_SH_TO_UB K_ED_DKG_EINGR.P_CODE_UNPLAUSIBEL K_ED_DSC_EINGR.DEC_NACH_EINTRAG K_ED_DSC_EINGR.DEC_VOR_EINTRAG K_ED_DSC_EINGR.FEHLERSCHWELLE K_ED_DSC_EINGR.INC_NACH_EINTRAG K_ED_DSC_EINGR.INC_VOR_EINTRAG K_ED_DSC_EINGR.KLASSENINDEX K_ED_DSC_EINGR.OK_SCHWELLE K_ED_DSC_EINGR.P_CODE_OPENLOAD K_ED_DSC_EINGR.P_CODE_SH_TO_GND K_ED_DSC_EINGR.P_CODE_SH_TO_UB K_ED_DSC_EINGR.P_CODE_UNPLAUSIBEL K_ED_E2_IGN.DEC_NACH_EINTRAG K_ED_E2_IGN.DEC_VOR_EINTRAG K_ED_E2_IGN.FEHLERSCHWELLE K_ED_E2_IGN.INC_NACH_EINTRAG K_ED_E2_IGN.INC_VOR_EINTRAG K_ED_E2_IGN.KLASSENINDEX K_ED_E2_IGN.OK_SCHWELLE K_ED_E2_IGN.P_CODE_OPENLOAD K_ED_E2_IGN.P_CODE_SH_TO_GND K_ED_E2_IGN.P_CODE_SH_TO_UB K_ED_E2_IGN.P_CODE_UNPLAUSIBEL K_ED_EC_BUSOFF.DEC_NACH_EINTRAG K_ED_EC_BUSOFF.DEC_VOR_EINTRAG K_ED_EC_BUSOFF.FEHLERSCHWELLE K_ED_EC_BUSOFF.INC_NACH_EINTRAG K_ED_EC_BUSOFF.INC_VOR_EINTRAG K_ED_EC_BUSOFF.KLASSENINDEX K_ED_EC_BUSOFF.OK_SCHWELLE K_ED_EC_BUSOFF.P_CODE_OPENLOAD K_ED_EC_BUSOFF.P_CODE_SH_TO_GND K_ED_EC_BUSOFF.P_CODE_SH_TO_UB K_ED_EC_BUSOFF.P_CODE_UNPLAUSIBEL K_ED_FGR_ABWURF.DEC_NACH_EINTRAG K_ED_FGR_ABWURF.DEC_VOR_EINTRAG K_ED_FGR_ABWURF.FEHLERSCHWELLE K_ED_FGR_ABWURF.INC_NACH_EINTRAG K_ED_FGR_ABWURF.INC_VOR_EINTRAG K_ED_FGR_ABWURF.KLASSENINDEX K_ED_FGR_ABWURF.OK_SCHWELLE K_ED_FGR_ABWURF.P_CODE_OPENLOAD K_ED_FGR_ABWURF.P_CODE_SH_TO_GND K_ED_FGR_ABWURF.P_CODE_SH_TO_UB K_ED_FGR_ABWURF.P_CODE_UNPLAUSIBEL K_ED_INDEX_121_IGN.DEC_NACH_EINTRAG K_ED_INDEX_121_IGN.DEC_VOR_EINTRAG K_ED_INDEX_121_IGN.FEHLERSCHWELLE K_ED_INDEX_121_IGN.INC_NACH_EINTRAG K_ED_INDEX_121_IGN.INC_VOR_EINTRAG K_ED_INDEX_121_IGN.KLASSENINDEX K_ED_INDEX_121_IGN.OK_SCHWELLE K_ED_INDEX_121_IGN.P_CODE_OPENLOAD K_ED_INDEX_121_IGN.P_CODE_SH_TO_GND K_ED_INDEX_121_IGN.P_CODE_SH_TO_UB K_ED_INDEX_121_IGN.P_CODE_UNPLAUSIBEL K_ED_INDEX_122_IGN.DEC_NACH_EINTRAG K_ED_INDEX_122_IGN.DEC_VOR_EINTRAG K_ED_INDEX_122_IGN.FEHLERSCHWELLE K_ED_INDEX_122_IGN.INC_NACH_EINTRAG K_ED_INDEX_122_IGN.INC_VOR_EINTRAG K_ED_INDEX_122_IGN.KLASSENINDEX K_ED_INDEX_122_IGN.OK_SCHWELLE K_ED_INDEX_122_IGN.P_CODE_OPENLOAD K_ED_INDEX_122_IGN.P_CODE_SH_TO_GND K_ED_INDEX_122_IGN.P_CODE_SH_TO_UB K_ED_INDEX_122_IGN.P_CODE_UNPLAUSIBEL K_ED_INDEX_123_IGN.DEC_NACH_EINTRAG K_ED_INDEX_123_IGN.DEC_VOR_EINTRAG K_ED_INDEX_123_IGN.FEHLERSCHWELLE K_ED_INDEX_123_IGN.INC_NACH_EINTRAG K_ED_INDEX_123_IGN.INC_VOR_EINTRAG K_ED_INDEX_123_IGN.KLASSENINDEX K_ED_INDEX_123_IGN.OK_SCHWELLE K_ED_INDEX_123_IGN.P_CODE_OPENLOAD K_ED_INDEX_123_IGN.P_CODE_SH_TO_GND K_ED_INDEX_123_IGN.P_CODE_SH_TO_UB K_ED_INDEX_123_IGN.P_CODE_UNPLAUSIBEL K_ED_INDEX_124_IGN.DEC_NACH_EINTRAG K_ED_INDEX_124_IGN.DEC_VOR_EINTRAG K_ED_INDEX_124_IGN.FEHLERSCHWELLE K_ED_INDEX_124_IGN.INC_NACH_EINTRAG K_ED_INDEX_124_IGN.INC_VOR_EINTRAG K_ED_INDEX_124_IGN.KLASSENINDEX K_ED_INDEX_124_IGN.OK_SCHWELLE K_ED_INDEX_124_IGN.P_CODE_OPENLOAD K_ED_INDEX_124_IGN.P_CODE_SH_TO_GND K_ED_INDEX_124_IGN.P_CODE_SH_TO_UB K_ED_INDEX_124_IGN.P_CODE_UNPLAUSIBEL K_ED_INDEX_125_IGN.DEC_NACH_EINTRAG K_ED_INDEX_125_IGN.DEC_VOR_EINTRAG K_ED_INDEX_125_IGN.FEHLERSCHWELLE K_ED_INDEX_125_IGN.INC_NACH_EINTRAG K_ED_INDEX_125_IGN.INC_VOR_EINTRAG K_ED_INDEX_125_IGN.KLASSENINDEX K_ED_INDEX_125_IGN.OK_SCHWELLE K_ED_INDEX_125_IGN.P_CODE_OPENLOAD K_ED_INDEX_125_IGN.P_CODE_SH_TO_GND K_ED_INDEX_125_IGN.P_CODE_SH_TO_UB K_ED_INDEX_125_IGN.P_CODE_UNPLAUSIBEL K_ED_INDEX_126_IGN.DEC_NACH_EINTRAG K_ED_INDEX_126_IGN.DEC_VOR_EINTRAG K_ED_INDEX_126_IGN.FEHLERSCHWELLE K_ED_INDEX_126_IGN.INC_NACH_EINTRAG K_ED_INDEX_126_IGN.INC_VOR_EINTRAG K_ED_INDEX_126_IGN.KLASSENINDEX K_ED_INDEX_126_IGN.OK_SCHWELLE K_ED_INDEX_126_IGN.P_CODE_OPENLOAD K_ED_INDEX_126_IGN.P_CODE_SH_TO_GND K_ED_INDEX_126_IGN.P_CODE_SH_TO_UB K_ED_INDEX_126_IGN.P_CODE_UNPLAUSIBEL K_ED_INDEX_127_IGN.DEC_NACH_EINTRAG K_ED_INDEX_127_IGN.DEC_VOR_EINTRAG K_ED_INDEX_127_IGN.FEHLERSCHWELLE K_ED_INDEX_127_IGN.INC_NACH_EINTRAG K_ED_INDEX_127_IGN.INC_VOR_EINTRAG K_ED_INDEX_127_IGN.KLASSENINDEX K_ED_INDEX_127_IGN.OK_SCHWELLE K_ED_INDEX_127_IGN.P_CODE_OPENLOAD K_ED_INDEX_127_IGN.P_CODE_SH_TO_GND K_ED_INDEX_127_IGN.P_CODE_SH_TO_UB K_ED_INDEX_127_IGN.P_CODE_UNPLAUSIBEL K_ED_INDEX_33_IGN.DEC_NACH_EINTRAG K_ED_INDEX_33_IGN.DEC_VOR_EINTRAG K_ED_INDEX_33_IGN.FEHLERSCHWELLE K_ED_INDEX_33_IGN.INC_NACH_EINTRAG K_ED_INDEX_33_IGN.INC_VOR_EINTRAG K_ED_INDEX_33_IGN.KLASSENINDEX K_ED_INDEX_33_IGN.OK_SCHWELLE K_ED_INDEX_33_IGN.P_CODE_OPENLOAD K_ED_INDEX_33_IGN.P_CODE_SH_TO_GND K_ED_INDEX_33_IGN.P_CODE_SH_TO_UB K_ED_INDEX_33_IGN.P_CODE_UNPLAUSIBEL K_ED_INDEX_34_IGN.DEC_NACH_EINTRAG K_ED_INDEX_34_IGN.DEC_VOR_EINTRAG K_ED_INDEX_34_IGN.FEHLERSCHWELLE K_ED_INDEX_34_IGN.INC_NACH_EINTRAG K_ED_INDEX_34_IGN.INC_VOR_EINTRAG K_ED_INDEX_34_IGN.KLASSENINDEX K_ED_INDEX_34_IGN.OK_SCHWELLE K_ED_INDEX_34_IGN.P_CODE_OPENLOAD K_ED_INDEX_34_IGN.P_CODE_SH_TO_GND K_ED_INDEX_34_IGN.P_CODE_SH_TO_UB K_ED_INDEX_34_IGN.P_CODE_UNPLAUSIBEL K_ED_INDEX_35_IGN.DEC_NACH_EINTRAG K_ED_INDEX_35_IGN.DEC_VOR_EINTRAG K_ED_INDEX_35_IGN.FEHLERSCHWELLE K_ED_INDEX_35_IGN.INC_NACH_EINTRAG K_ED_INDEX_35_IGN.INC_VOR_EINTRAG K_ED_INDEX_35_IGN.KLASSENINDEX K_ED_INDEX_35_IGN.OK_SCHWELLE K_ED_INDEX_35_IGN.P_CODE_OPENLOAD K_ED_INDEX_35_IGN.P_CODE_SH_TO_GND K_ED_INDEX_35_IGN.P_CODE_SH_TO_UB K_ED_INDEX_35_IGN.P_CODE_UNPLAUSIBEL K_ED_INDEX_36_IGN.DEC_NACH_EINTRAG K_ED_INDEX_36_IGN.DEC_VOR_EINTRAG K_ED_INDEX_36_IGN.FEHLERSCHWELLE K_ED_INDEX_36_IGN.INC_NACH_EINTRAG K_ED_INDEX_36_IGN.INC_VOR_EINTRAG K_ED_INDEX_36_IGN.KLASSENINDEX K_ED_INDEX_36_IGN.OK_SCHWELLE K_ED_INDEX_36_IGN.P_CODE_OPENLOAD K_ED_INDEX_36_IGN.P_CODE_SH_TO_GND K_ED_INDEX_36_IGN.P_CODE_SH_TO_UB K_ED_INDEX_36_IGN.P_CODE_UNPLAUSIBEL K_ED_INDEX_71_IGN.DEC_NACH_EINTRAG K_ED_INDEX_71_IGN.DEC_VOR_EINTRAG K_ED_INDEX_71_IGN.FEHLERSCHWELLE K_ED_INDEX_71_IGN.INC_NACH_EINTRAG K_ED_INDEX_71_IGN.INC_VOR_EINTRAG K_ED_INDEX_71_IGN.KLASSENINDEX K_ED_INDEX_71_IGN.OK_SCHWELLE K_ED_INDEX_71_IGN.P_CODE_OPENLOAD K_ED_INDEX_71_IGN.P_CODE_SH_TO_GND K_ED_INDEX_71_IGN.P_CODE_SH_TO_UB K_ED_INDEX_71_IGN.P_CODE_UNPLAUSIBEL K_ED_INDEX_72_IGN.DEC_NACH_EINTRAG K_ED_INDEX_72_IGN.DEC_VOR_EINTRAG K_ED_INDEX_72_IGN.FEHLERSCHWELLE K_ED_INDEX_72_IGN.INC_NACH_EINTRAG K_ED_INDEX_72_IGN.INC_VOR_EINTRAG K_ED_INDEX_72_IGN.KLASSENINDEX K_ED_INDEX_72_IGN.OK_SCHWELLE K_ED_INDEX_72_IGN.P_CODE_OPENLOAD K_ED_INDEX_72_IGN.P_CODE_SH_TO_GND K_ED_INDEX_72_IGN.P_CODE_SH_TO_UB K_ED_INDEX_72_IGN.P_CODE_UNPLAUSIBEL K_ED_INDEX_84_IGN.DEC_NACH_EINTRAG K_ED_INDEX_84_IGN.DEC_VOR_EINTRAG K_ED_INDEX_84_IGN.FEHLERSCHWELLE K_ED_INDEX_84_IGN.INC_NACH_EINTRAG K_ED_INDEX_84_IGN.INC_VOR_EINTRAG K_ED_INDEX_84_IGN.KLASSENINDEX K_ED_INDEX_84_IGN.OK_SCHWELLE K_ED_INDEX_84_IGN.P_CODE_OPENLOAD K_ED_INDEX_84_IGN.P_CODE_SH_TO_GND K_ED_INDEX_84_IGN.P_CODE_SH_TO_UB K_ED_INDEX_84_IGN.P_CODE_UNPLAUSIBEL K_ED_INDEX_85_IGN.DEC_NACH_EINTRAG K_ED_INDEX_85_IGN.DEC_VOR_EINTRAG K_ED_INDEX_85_IGN.FEHLERSCHWELLE K_ED_INDEX_85_IGN.INC_NACH_EINTRAG K_ED_INDEX_85_IGN.INC_VOR_EINTRAG K_ED_INDEX_85_IGN.KLASSENINDEX K_ED_INDEX_85_IGN.OK_SCHWELLE K_ED_INDEX_85_IGN.P_CODE_OPENLOAD K_ED_INDEX_85_IGN.P_CODE_SH_TO_GND K_ED_INDEX_85_IGN.P_CODE_SH_TO_UB K_ED_INDEX_85_IGN.P_CODE_UNPLAUSIBEL K_ED_LLR_DIAG.DEC_NACH_EINTRAG K_ED_LLR_DIAG.DEC_VOR_EINTRAG K_ED_LLR_DIAG.FEHLERSCHWELLE K_ED_LLR_DIAG.INC_NACH_EINTRAG K_ED_LLR_DIAG.INC_VOR_EINTRAG K_ED_LLR_DIAG.KLASSENINDEX K_ED_LLR_DIAG.OK_SCHWELLE K_ED_LLR_DIAG.P_CODE_OPENLOAD K_ED_LLR_DIAG.P_CODE_SH_TO_GND K_ED_LLR_DIAG.P_CODE_SH_TO_UB K_ED_LLR_DIAG.P_CODE_UNPLAUSIBEL K_ED_LLR_DIAG_CSS.DEC_NACH_EINTRAG K_ED_LLR_DIAG_CSS.DEC_VOR_EINTRAG K_ED_LLR_DIAG_CSS.FEHLERSCHWELLE K_ED_LLR_DIAG_CSS.INC_NACH_EINTRAG K_ED_LLR_DIAG_CSS.INC_VOR_EINTRAG K_ED_LLR_DIAG_CSS.KLASSENINDEX K_ED_LLR_DIAG_CSS.OK_SCHWELLE K_ED_LLR_DIAG_CSS.P_CODE_OPENLOAD K_ED_LLR_DIAG_CSS.P_CODE_SH_TO_GND K_ED_LLR_DIAG_CSS.P_CODE_SH_TO_UB K_ED_LLR_DIAG_CSS.P_CODE_UNPLAUSIBEL K_ED_LLS_INIT.DEC_NACH_EINTRAG K_ED_LLS_INIT.DEC_VOR_EINTRAG K_ED_LLS_INIT.FEHLERSCHWELLE K_ED_LLS_INIT.INC_NACH_EINTRAG K_ED_LLS_INIT.INC_VOR_EINTRAG K_ED_LLS_INIT.KLASSENINDEX K_ED_LLS_INIT.OK_SCHWELLE K_ED_LLS_INIT.P_CODE_OPENLOAD K_ED_LLS_INIT.P_CODE_SH_TO_GND K_ED_LLS_INIT.P_CODE_SH_TO_UB K_ED_LLS_INIT.P_CODE_UNPLAUSIBEL K_ED_LLS1_CAN.DEC_NACH_EINTRAG K_ED_LLS1_CAN.DEC_VOR_EINTRAG K_ED_LLS1_CAN.FEHLERSCHWELLE K_ED_LLS1_CAN.INC_NACH_EINTRAG K_ED_LLS1_CAN.INC_VOR_EINTRAG K_ED_LLS1_CAN.KLASSENINDEX K_ED_LLS1_CAN.OK_SCHWELLE K_ED_LLS1_CAN.P_CODE_OPENLOAD K_ED_LLS1_CAN.P_CODE_SH_TO_GND K_ED_LLS1_CAN.P_CODE_SH_TO_UB K_ED_LLS1_CAN.P_CODE_UNPLAUSIBEL K_ED_LLS1_CMD.DEC_NACH_EINTRAG K_ED_LLS1_CMD.DEC_VOR_EINTRAG K_ED_LLS1_CMD.FEHLERSCHWELLE K_ED_LLS1_CMD.INC_NACH_EINTRAG K_ED_LLS1_CMD.INC_VOR_EINTRAG K_ED_LLS1_CMD.KLASSENINDEX K_ED_LLS1_CMD.OK_SCHWELLE K_ED_LLS1_CMD.P_CODE_OPENLOAD K_ED_LLS1_CMD.P_CODE_SH_TO_GND K_ED_LLS1_CMD.P_CODE_SH_TO_UB K_ED_LLS1_CMD.P_CODE_UNPLAUSIBEL K_ED_LLS1_REGLER.DEC_NACH_EINTRAG K_ED_LLS1_REGLER.DEC_VOR_EINTRAG K_ED_LLS1_REGLER.FEHLERSCHWELLE K_ED_LLS1_REGLER.INC_NACH_EINTRAG K_ED_LLS1_REGLER.INC_VOR_EINTRAG K_ED_LLS1_REGLER.KLASSENINDEX K_ED_LLS1_REGLER.OK_SCHWELLE K_ED_LLS1_REGLER.P_CODE_OPENLOAD K_ED_LLS1_REGLER.P_CODE_SH_TO_GND K_ED_LLS1_REGLER.P_CODE_SH_TO_UB K_ED_LLS1_REGLER.P_CODE_UNPLAUSIBEL K_ED_LLS1_SK.DEC_NACH_EINTRAG K_ED_LLS1_SK.DEC_VOR_EINTRAG K_ED_LLS1_SK.FEHLERSCHWELLE K_ED_LLS1_SK.INC_NACH_EINTRAG K_ED_LLS1_SK.INC_VOR_EINTRAG K_ED_LLS1_SK.KLASSENINDEX K_ED_LLS1_SK.OK_SCHWELLE K_ED_LLS1_SK.P_CODE_OPENLOAD K_ED_LLS1_SK.P_CODE_SH_TO_GND K_ED_LLS1_SK.P_CODE_SH_TO_UB K_ED_LLS1_SK.P_CODE_UNPLAUSIBEL K_ED_LLS2_CAN.DEC_NACH_EINTRAG K_ED_LLS2_CAN.DEC_VOR_EINTRAG K_ED_LLS2_CAN.FEHLERSCHWELLE K_ED_LLS2_CAN.INC_NACH_EINTRAG K_ED_LLS2_CAN.INC_VOR_EINTRAG K_ED_LLS2_CAN.KLASSENINDEX K_ED_LLS2_CAN.OK_SCHWELLE K_ED_LLS2_CAN.P_CODE_OPENLOAD K_ED_LLS2_CAN.P_CODE_SH_TO_GND K_ED_LLS2_CAN.P_CODE_SH_TO_UB K_ED_LLS2_CAN.P_CODE_UNPLAUSIBEL K_ED_LLS2_CMD.DEC_NACH_EINTRAG K_ED_LLS2_CMD.DEC_VOR_EINTRAG K_ED_LLS2_CMD.FEHLERSCHWELLE K_ED_LLS2_CMD.INC_NACH_EINTRAG K_ED_LLS2_CMD.INC_VOR_EINTRAG K_ED_LLS2_CMD.KLASSENINDEX K_ED_LLS2_CMD.OK_SCHWELLE K_ED_LLS2_CMD.P_CODE_OPENLOAD K_ED_LLS2_CMD.P_CODE_SH_TO_GND K_ED_LLS2_CMD.P_CODE_SH_TO_UB K_ED_LLS2_CMD.P_CODE_UNPLAUSIBEL K_ED_LLS2_REGLER.DEC_NACH_EINTRAG K_ED_LLS2_REGLER.DEC_VOR_EINTRAG K_ED_LLS2_REGLER.FEHLERSCHWELLE K_ED_LLS2_REGLER.INC_NACH_EINTRAG K_ED_LLS2_REGLER.INC_VOR_EINTRAG K_ED_LLS2_REGLER.KLASSENINDEX K_ED_LLS2_REGLER.OK_SCHWELLE K_ED_LLS2_REGLER.P_CODE_OPENLOAD K_ED_LLS2_REGLER.P_CODE_SH_TO_GND K_ED_LLS2_REGLER.P_CODE_SH_TO_UB K_ED_LLS2_REGLER.P_CODE_UNPLAUSIBEL K_ED_LLS2_SK.DEC_NACH_EINTRAG K_ED_LLS2_SK.DEC_VOR_EINTRAG K_ED_LLS2_SK.FEHLERSCHWELLE K_ED_LLS2_SK.INC_NACH_EINTRAG K_ED_LLS2_SK.INC_VOR_EINTRAG K_ED_LLS2_SK.KLASSENINDEX K_ED_LLS2_SK.OK_SCHWELLE K_ED_LLS2_SK.P_CODE_OPENLOAD K_ED_LLS2_SK.P_CODE_SH_TO_GND K_ED_LLS2_SK.P_CODE_SH_TO_UB K_ED_LLS2_SK.P_CODE_UNPLAUSIBEL K_ED_M_SPULE_Z1.DEC_NACH_EINTRAG K_ED_M_SPULE_Z1.DEC_VOR_EINTRAG K_ED_M_SPULE_Z1.FEHLERSCHWELLE K_ED_M_SPULE_Z1.INC_NACH_EINTRAG K_ED_M_SPULE_Z1.INC_VOR_EINTRAG K_ED_M_SPULE_Z1.KLASSENINDEX K_ED_M_SPULE_Z1.OK_SCHWELLE K_ED_M_SPULE_Z1.P_CODE_OPENLOAD K_ED_M_SPULE_Z1.P_CODE_SH_TO_GND K_ED_M_SPULE_Z1.P_CODE_SH_TO_UB K_ED_M_SPULE_Z1.P_CODE_UNPLAUSIBEL K_ED_M_SPULE_Z10.DEC_NACH_EINTRAG K_ED_M_SPULE_Z10.DEC_VOR_EINTRAG K_ED_M_SPULE_Z10.FEHLERSCHWELLE K_ED_M_SPULE_Z10.INC_NACH_EINTRAG K_ED_M_SPULE_Z10.INC_VOR_EINTRAG K_ED_M_SPULE_Z10.KLASSENINDEX K_ED_M_SPULE_Z10.OK_SCHWELLE K_ED_M_SPULE_Z10.P_CODE_OPENLOAD K_ED_M_SPULE_Z10.P_CODE_SH_TO_GND K_ED_M_SPULE_Z10.P_CODE_SH_TO_UB K_ED_M_SPULE_Z10.P_CODE_UNPLAUSIBEL K_ED_M_SPULE_Z2.DEC_NACH_EINTRAG K_ED_M_SPULE_Z2.DEC_VOR_EINTRAG K_ED_M_SPULE_Z2.FEHLERSCHWELLE K_ED_M_SPULE_Z2.INC_NACH_EINTRAG K_ED_M_SPULE_Z2.INC_VOR_EINTRAG K_ED_M_SPULE_Z2.KLASSENINDEX K_ED_M_SPULE_Z2.OK_SCHWELLE K_ED_M_SPULE_Z2.P_CODE_OPENLOAD K_ED_M_SPULE_Z2.P_CODE_SH_TO_GND K_ED_M_SPULE_Z2.P_CODE_SH_TO_UB K_ED_M_SPULE_Z2.P_CODE_UNPLAUSIBEL K_ED_M_SPULE_Z3.DEC_NACH_EINTRAG K_ED_M_SPULE_Z3.DEC_VOR_EINTRAG K_ED_M_SPULE_Z3.FEHLERSCHWELLE K_ED_M_SPULE_Z3.INC_NACH_EINTRAG K_ED_M_SPULE_Z3.INC_VOR_EINTRAG K_ED_M_SPULE_Z3.KLASSENINDEX K_ED_M_SPULE_Z3.OK_SCHWELLE K_ED_M_SPULE_Z3.P_CODE_OPENLOAD K_ED_M_SPULE_Z3.P_CODE_SH_TO_GND K_ED_M_SPULE_Z3.P_CODE_SH_TO_UB K_ED_M_SPULE_Z3.P_CODE_UNPLAUSIBEL K_ED_M_SPULE_Z4.DEC_NACH_EINTRAG K_ED_M_SPULE_Z4.DEC_VOR_EINTRAG K_ED_M_SPULE_Z4.FEHLERSCHWELLE K_ED_M_SPULE_Z4.INC_NACH_EINTRAG K_ED_M_SPULE_Z4.INC_VOR_EINTRAG K_ED_M_SPULE_Z4.KLASSENINDEX K_ED_M_SPULE_Z4.OK_SCHWELLE K_ED_M_SPULE_Z4.P_CODE_OPENLOAD K_ED_M_SPULE_Z4.P_CODE_SH_TO_GND K_ED_M_SPULE_Z4.P_CODE_SH_TO_UB K_ED_M_SPULE_Z4.P_CODE_UNPLAUSIBEL K_ED_M_SPULE_Z5.DEC_NACH_EINTRAG K_ED_M_SPULE_Z5.DEC_VOR_EINTRAG K_ED_M_SPULE_Z5.FEHLERSCHWELLE K_ED_M_SPULE_Z5.INC_NACH_EINTRAG K_ED_M_SPULE_Z5.INC_VOR_EINTRAG K_ED_M_SPULE_Z5.KLASSENINDEX K_ED_M_SPULE_Z5.OK_SCHWELLE K_ED_M_SPULE_Z5.P_CODE_OPENLOAD K_ED_M_SPULE_Z5.P_CODE_SH_TO_GND K_ED_M_SPULE_Z5.P_CODE_SH_TO_UB K_ED_M_SPULE_Z5.P_CODE_UNPLAUSIBEL K_ED_M_SPULE_Z6.DEC_NACH_EINTRAG K_ED_M_SPULE_Z6.DEC_VOR_EINTRAG K_ED_M_SPULE_Z6.FEHLERSCHWELLE K_ED_M_SPULE_Z6.INC_NACH_EINTRAG K_ED_M_SPULE_Z6.INC_VOR_EINTRAG K_ED_M_SPULE_Z6.KLASSENINDEX K_ED_M_SPULE_Z6.OK_SCHWELLE K_ED_M_SPULE_Z6.P_CODE_OPENLOAD K_ED_M_SPULE_Z6.P_CODE_SH_TO_GND K_ED_M_SPULE_Z6.P_CODE_SH_TO_UB K_ED_M_SPULE_Z6.P_CODE_UNPLAUSIBEL K_ED_M_SPULE_Z7.DEC_NACH_EINTRAG K_ED_M_SPULE_Z7.DEC_VOR_EINTRAG K_ED_M_SPULE_Z7.FEHLERSCHWELLE K_ED_M_SPULE_Z7.INC_NACH_EINTRAG K_ED_M_SPULE_Z7.INC_VOR_EINTRAG K_ED_M_SPULE_Z7.KLASSENINDEX K_ED_M_SPULE_Z7.OK_SCHWELLE K_ED_M_SPULE_Z7.P_CODE_OPENLOAD K_ED_M_SPULE_Z7.P_CODE_SH_TO_GND K_ED_M_SPULE_Z7.P_CODE_SH_TO_UB K_ED_M_SPULE_Z7.P_CODE_UNPLAUSIBEL K_ED_M_SPULE_Z8.DEC_NACH_EINTRAG K_ED_M_SPULE_Z8.DEC_VOR_EINTRAG K_ED_M_SPULE_Z8.FEHLERSCHWELLE K_ED_M_SPULE_Z8.INC_NACH_EINTRAG K_ED_M_SPULE_Z8.INC_VOR_EINTRAG K_ED_M_SPULE_Z8.KLASSENINDEX K_ED_M_SPULE_Z8.OK_SCHWELLE K_ED_M_SPULE_Z8.P_CODE_OPENLOAD K_ED_M_SPULE_Z8.P_CODE_SH_TO_GND K_ED_M_SPULE_Z8.P_CODE_SH_TO_UB K_ED_M_SPULE_Z8.P_CODE_UNPLAUSIBEL K_ED_M_SPULE_Z9.DEC_NACH_EINTRAG K_ED_M_SPULE_Z9.DEC_VOR_EINTRAG K_ED_M_SPULE_Z9.FEHLERSCHWELLE K_ED_M_SPULE_Z9.INC_NACH_EINTRAG K_ED_M_SPULE_Z9.INC_VOR_EINTRAG K_ED_M_SPULE_Z9.KLASSENINDEX K_ED_M_SPULE_Z9.OK_SCHWELLE K_ED_M_SPULE_Z9.P_CODE_OPENLOAD K_ED_M_SPULE_Z9.P_CODE_SH_TO_GND K_ED_M_SPULE_Z9.P_CODE_SH_TO_UB K_ED_M_SPULE_Z9.P_CODE_UNPLAUSIBEL K_ED_MD_SK_ERR.DEC_NACH_EINTRAG K_ED_MD_SK_ERR.DEC_VOR_EINTRAG K_ED_MD_SK_ERR.FEHLERSCHWELLE K_ED_MD_SK_ERR.INC_NACH_EINTRAG K_ED_MD_SK_ERR.INC_VOR_EINTRAG K_ED_MD_SK_ERR.KLASSENINDEX K_ED_MD_SK_ERR.OK_SCHWELLE K_ED_MD_SK_ERR.P_CODE_OPENLOAD K_ED_MD_SK_ERR.P_CODE_SH_TO_GND K_ED_MD_SK_ERR.P_CODE_SH_TO_UB K_ED_MD_SK_ERR.P_CODE_UNPLAUSIBEL K_ED_N_GETR_EIN_HS.DEC_NACH_EINTRAG K_ED_N_GETR_EIN_HS.DEC_VOR_EINTRAG K_ED_N_GETR_EIN_HS.FEHLERSCHWELLE K_ED_N_GETR_EIN_HS.INC_NACH_EINTRAG K_ED_N_GETR_EIN_HS.INC_VOR_EINTRAG K_ED_N_GETR_EIN_HS.KLASSENINDEX K_ED_N_GETR_EIN_HS.OK_SCHWELLE K_ED_N_GETR_EIN_HS.P_CODE_OPENLOAD K_ED_N_GETR_EIN_HS.P_CODE_SH_TO_GND K_ED_N_GETR_EIN_HS.P_CODE_SH_TO_UB K_ED_N_GETR_EIN_HS.P_CODE_UNPLAUSIBEL K_ED_PCTRL_IGN.DEC_NACH_EINTRAG /end DEF_CHARACTERISTIC
/end FUNCTION
/begin RECORD_LAYOUT TKW_VV_VV_UB FNC_VALUES 1 UBYTE COLUMN_DIR DIRECT /end RECORD_LAYOUT
/begin RECORD_LAYOUT TKW_VV_VV_UW FNC_VALUES 1 UWORD COLUMN_DIR DIRECT /end RECORD_LAYOUT
/end MODULE
/end PROJECT
