ASAP2_VERSION 1 31
/begin PROJECT MS45 "BMW Motorsteuerung R6"
/begin HEADER "_default_HeaderComment" PROJECT_NO _57 /end HEADER
/begin MODULE _default_ModuleName "_default_ModuleLongIdentifier"
/begin MOD_COMMON "_default_ModCommonComment" DEPOSIT ABSOLUTE BYTE_ORDER MSB_FIRST ALIGNMENT_BYTE 1 ALIGNMENT_WORD 2 ALIGNMENT_LONG 4 ALIGNMENT_FLOAT32_IEEE 4 ALIGNMENT_FLOAT64_IEEE 8 /end MOD_COMMON
/begin MEASUREMENT cdn_diag_dmtlh "Diagnosis conditions forDMTL Heater" UBYTE _CNV_A_R_LINEAR_____0_CM 1 100. 0. 255. DISPLAY_IDENTIFIER CDN_DIAG_DMTLH ECU_ADDRESS 0x3fe958 FORMAT "%3.0" /end MEASUREMENT
/begin MEASUREMENT lv_err_dmtlh "Logical value for DMTL heater stage error" UBYTE _CNV_S_2_RANGE______1_R_CM 1 100. 0. 255. DISPLAY_IDENTIFIER LV_ERR_DMTLH ECU_ADDRESS 0x3fba9c /end MEASUREMENT
/begin MEASUREMENT lv_inh_diag_dmtlh "DMTL heater diagnosis: application incidence to inhibit the diagnosis" UBYTE _CNV_S_2_RANGE______2_CM 1 100. 0. 1. DISPLAY_IDENTIFIER LV_INH_DIAG_DMTLH ECU_ADDRESS 0x3fe957 /end MEASUREMENT
/begin MEASUREMENT ctr_det_dmtlh "Diagnosis counter for checksum counter error symptom detection" UBYTE _CNV_A_R_LINEAR_____0_CM 1 100. 0. 255. DISPLAY_IDENTIFIER CTR_DET_DMTLH ECU_ADDRESS 0x3fe959 FORMAT "%3.0" /end MEASUREMENT
/begin MEASUREMENT ctr_ready_dmtlh "Counter for end of diagnosis calculation for DMTL heater" UBYTE _CNV_A_R_LINEAR_____0_CM 1 100. 0. 255. DISPLAY_IDENTIFIER CTR_READY_DMTLH ECU_ADDRESS 0x3fe95a FORMAT "%3.0" /end MEASUREMENT
/begin CHARACTERISTIC c_v_dmtl_max_diag "threshold voltage to recognise short to battery" VALUE 0xffe41af2 _REC_VAL_20_u2 0.4995117190000001 _CNV_A_R_LINEAR_____3_CM 0. 4.99511719 DISPLAY_IDENTIFIER C_V_DMTL_MAX_DIAG FORMAT "%5.3" /end CHARACTERISTIC
/begin CHARACTERISTIC c_t_v_dmtl_max_diag "bounce time for recognise short to battery" VALUE 0xffe408d3 _REC_VAL_20_u1 0.254 _CNV_A_R_LINEAR_____4_CM 1.e-002 2.55 DISPLAY_IDENTIFIER C_T_V_DMTL_MAX_DIAG FORMAT "%4.2" /end CHARACTERISTIC
/begin MEASUREMENT cdn_diag_dmtl_pump "Diagnosis conditions for DMTL Pump" UBYTE _CNV_A_R_LINEAR_____0_CM 1 100. 0. 255. DISPLAY_IDENTIFIER CDN_DIAG_DMTL_PUMP ECU_ADDRESS 0x3fe951 FORMAT "%3.0" /end MEASUREMENT
/begin MEASUREMENT lv_err_dmtl_pump "Error flag, DMTL pump" UBYTE _CNV_S_2_RANGE______1_R_CM 1 100. 0. 255. DISPLAY_IDENTIFIER LV_ERR_DMTL_PUMP ECU_ADDRESS 0x3fba68 /end MEASUREMENT
/begin MEASUREMENT lv_inh_diag_dmtl_pump "DMTL pump diagnosis: application incidence to inhibit the diagnosis" UBYTE _CNV_S_2_RANGE______2_CM 1 100. 0. 1. DISPLAY_IDENTIFIER LV_INH_DIAG_DMTL_PUMP ECU_ADDRESS 0x3fe950 /end MEASUREMENT
/begin MEASUREMENT ctr_det_dmtl_pump "Diagnosis counter for checksum counter error symptom detection" UBYTE _CNV_A_R_LINEAR_____0_CM 1 100. 0. 255. DISPLAY_IDENTIFIER CTR_DET_DMTL_PUMP ECU_ADDRESS 0x3fe952 FORMAT "%3.0" /end MEASUREMENT
/begin MEASUREMENT ctr_ready_dmtl_pump "Counter for end of diagnosis calculation for DMTL pump" UBYTE _CNV_A_R_LINEAR_____0_CM 1 100. 0. 255. DISPLAY_IDENTIFIER CTR_READY_DMTL_PUMP ECU_ADDRESS 0x3fe953 FORMAT "%3.0" /end MEASUREMENT
/begin MEASUREMENT t_v_dmtl_max_diag "debouince time" UBYTE _CNV_A_R_LINEAR_____4_CM 1 100. 0. 2.55 DISPLAY_IDENTIFIER T_V_DMTL_MAX_DIAG ECU_ADDRESS 0x3fe954 FORMAT "%4.2" /end MEASUREMENT
/begin MEASUREMENT cdn_diag_dmtls "Diagnosis conditions for DMTL change over  Valve" UBYTE _CNV_A_R_LINEAR_____0_CM 1 100. 0. 255. DISPLAY_IDENTIFIER CDN_DIAG_DMTLS ECU_ADDRESS 0x3fe94c FORMAT "%3.0" /end MEASUREMENT
/begin MEASUREMENT lv_inh_diag_dmtls "DMTL change-over valve diagnosis: application incidence to inhibit the diagnosis" UBYTE _CNV_S_2_RANGE______2_CM 1 100. 0. 1. DISPLAY_IDENTIFIER LV_INH_DIAG_DMTLS ECU_ADDRESS 0x3fe94b /end MEASUREMENT
/begin MEASUREMENT lv_err_dmtls "Error flag, DMTL change-over valve" UBYTE _CNV_S_2_RANGE______1_R_CM 1 100. 0. 255. DISPLAY_IDENTIFIER LV_ERR_DMTLS ECU_ADDRESS 0x3fba64 /end MEASUREMENT
/begin MEASUREMENT ctr_det_dmtls "Diagnosis counter for checksum counter error symptom detection" UBYTE _CNV_A_R_LINEAR_____0_CM 1 100. 0. 255. DISPLAY_IDENTIFIER CTR_DET_DMTLS ECU_ADDRESS 0x3fe94d FORMAT "%3.0" /end MEASUREMENT
/begin MEASUREMENT ctr_ready_dmtls "Counter for end of diagnosis calculation for DMTL change over valve" UBYTE _CNV_A_R_LINEAR_____0_CM 1 100. 0. 255. DISPLAY_IDENTIFIER CTR_READY_DMTLS ECU_ADDRESS 0x3fe94e FORMAT "%3.0" /end MEASUREMENT
/begin MEASUREMENT cdn_diag_ebox_cfa "Diagnosis conditions for E-Box Cooling FAN" UBYTE _CNV_A_R_LINEAR_____0_CM 1 100. 0. 255. DISPLAY_IDENTIFIER CDN_DIAG_EBOX_CFA ECU_ADDRESS 0x3fe947 FORMAT "%3.0" /end MEASUREMENT
/begin MEASUREMENT ctr_det_ebox_cfa "Diagnosis counter for checksum counter error symptom detection" UBYTE _CNV_A_R_LINEAR_____0_CM 1 100. 0. 255. DISPLAY_IDENTIFIER CTR_DET_EBOX_CFA ECU_ADDRESS 0x3fe948 FORMAT "%3.0" /end MEASUREMENT
/begin MEASUREMENT ctr_ready_ebox_cfa "Counter for end of diagnosis calculation for EBOX_CFA" UBYTE _CNV_A_R_LINEAR_____0_CM 1 100. 0. 255. DISPLAY_IDENTIFIER CTR_READY_EBOX_CFA ECU_ADDRESS 0x3fe949 FORMAT "%3.0" /end MEASUREMENT
/begin MEASUREMENT lv_err_ebox_cfa "Logical value for EBOX CFA error" UBYTE _CNV_S_2_RANGE______1_R_CM 1 100. 0. 255. DISPLAY_IDENTIFIER LV_ERR_EBOX_CFA ECU_ADDRESS 0x3fba50 /end MEASUREMENT
/begin MEASUREMENT lv_err_ecras "Boolean for currently present on ECRAS diagnosis" UBYTE _CNV_S_2_RANGE______1_R_CM 1 100. 0. 255. DISPLAY_IDENTIFIER LV_ERR_ECRAS ECU_ADDRESS 0x3fba98 /end MEASUREMENT
/begin MEASUREMENT lv_inh_diag_ecras "ECRAS diagnosis: application incidence to inhibit the diagnosis" UBYTE _CNV_S_2_RANGE______2_CM 1 100. 0. 1. DISPLAY_IDENTIFIER LV_INH_DIAG_ECRAS ECU_ADDRESS 0x3fe973 /end MEASUREMENT
/begin MEASUREMENT cdn_diag_ecras "Diagnosis conditions for electronic. controlled radiator shutter" UBYTE _CNV_A_R_LINEAR_____0_CM 1 100. 0. 255. DISPLAY_IDENTIFIER CDN_DIAG_ECRAS ECU_ADDRESS 0x3fe974 FORMAT "%3.0" /end MEASUREMENT
/begin MEASUREMENT ctr_det_ecras "Diagnosis counter for checksum counter error symptom detection" UBYTE _CNV_A_R_LINEAR_____0_CM 1 100. 0. 255. DISPLAY_IDENTIFIER CTR_DET_ECRAS ECU_ADDRESS 0x3fe975 FORMAT "%3.0" /end MEASUREMENT
/begin MEASUREMENT ctr_ready_ecras "Counter for end of diagnosis calculation for ECRAS" UBYTE _CNV_A_R_LINEAR_____0_CM 1 100. 0. 255. DISPLAY_IDENTIFIER CTR_READY_ECRAS ECU_ADDRESS 0x3fe976 FORMAT "%3.0" /end MEASUREMENT
/begin MEASUREMENT lv_err_rly_st "Status of starter output diagnosis" UBYTE _CNV_S_2_RANGE______1_R_CM 1 100. 0. 255. DISPLAY_IDENTIFIER LV_ERR_RLY_ST ECU_ADDRESS 0x3fba7c /end MEASUREMENT
/begin MEASUREMENT cdn_diag_rly_st "Activation conditions for starter relay" UBYTE _CNV_A_R_LINEAR_____0_CM 1 100. 0. 255. DISPLAY_IDENTIFIER CDN_DIAG_RLY_ST ECU_ADDRESS 0x3fe969 FORMAT "%3.0" /end MEASUREMENT
/begin MEASUREMENT ctr_det_rly_st "Debounce counter for RLY_ST" UBYTE _CNV_A_R_LINEAR_____0_CM 1 100. 0. 255. DISPLAY_IDENTIFIER CTR_DET_RLY_ST ECU_ADDRESS 0x3fe96a FORMAT "%3.0" /end MEASUREMENT
/begin MEASUREMENT lv_inh_diag_rly_st "Inhibit diagnosis starter relay" UBYTE _CNV_S_2_RANGE______2_CM 1 100. 0. 1. DISPLAY_IDENTIFIER LV_INH_DIAG_RLY_ST ECU_ADDRESS 0x3fe968 /end MEASUREMENT
/begin MEASUREMENT ctr_ready_rly_st "Counter for end of diagnosis calculation for RLY_ST" UBYTE _CNV_A_R_LINEAR_____0_CM 1 100. 0. 255. DISPLAY_IDENTIFIER CTR_READY_RLY_ST ECU_ADDRESS 0x3fe96b FORMAT "%3.0" /end MEASUREMENT
/begin MEASUREMENT lv_err_slv_ivvt_in_1 "Error flag solenoid valve of inlet camshaft 1" UBYTE _CNV_S_2_RANGE______1_R_CM 1 100. 0. 255. DISPLAY_IDENTIFIER LV_ERR_SLV_IVVT_IN_1 ECU_ADDRESS 0x3fb86c /end MEASUREMENT
/begin MEASUREMENT lv_err_slv_ivvt_ex_1 "Error flag solenoid valve of exhaust camshaft 1" UBYTE _CNV_S_2_RANGE______1_R_CM 1 100. 0. 255. DISPLAY_IDENTIFIER LV_ERR_SLV_IVVT_EX_1 ECU_ADDRESS 0x3fb870 /end MEASUREMENT
/begin MEASUREMENT lv_inh_diag_slv_ivvt_in_1 "Diagnosis inhibition IVVT_IN" UBYTE _CNV_S_2_RANGE______2_CM 1 100. 0. 1. DISPLAY_IDENTIFIER LV_INH_DIAG_SLV_IVVT_IN_1 ECU_ADDRESS 0x3fe4c4 BIT_MASK 0x1 /end MEASUREMENT
/begin MEASUREMENT cdn_diag_slv_ivvt_ex_1 "Diagnosis condition for each symptom for IVVT_EX" UBYTE _CNV_A_R_LINEAR_____0_CM 1 100. 0. 255. DISPLAY_IDENTIFIER CDN_DIAG_SLV_IVVT_EX_1 ECU_ADDRESS 0x3fe4ca FORMAT "%3.0" /end MEASUREMENT
/begin MEASUREMENT ctr_det_slv_ivvt_ex_1 "Debounce counter for  IVVT_EX" UBYTE _CNV_A_R_LINEAR_____0_CM 1 100. 0. 255. DISPLAY_IDENTIFIER CTR_DET_SLV_IVVT_EX_1 ECU_ADDRESS 0x3fe4c9 FORMAT "%3.0" /end MEASUREMENT
/begin MEASUREMENT ctr_ready_slv_ivvt_in_1 "Counter for end of diagnosis calculation for  IVVT_IN" UBYTE _CNV_A_R_LINEAR_____0_CM 1 100. 0. 255. DISPLAY_IDENTIFIER CTR_READY_SLV_IVVT_IN_1 ECU_ADDRESS 0x3fe4c8 FORMAT "%3.0" /end MEASUREMENT
/begin CHARACTERISTIC c_slv_ivvt_pwm_diag_min_oc "Maximum threshold for OC diagnosis window" VALUE 0xffe418ac _REC_VAL_20_u2 99.99847412 _CNV_A_R_LINEAR_____8_CM 0. 99.99847412 DISPLAY_IDENTIFIER C_SLV_IVVT_PWM_DIAG_MIN_OC FORMAT "%5.2" /end CHARACTERISTIC
/begin CHARACTERISTIC c_slv_ivvt_pwm_diag_min_scb "Minimum threshold for SCB diagnosis window" VALUE 0xffe418ae _REC_VAL_20_u2 99.99847412 _CNV_A_R_LINEAR_____8_CM 0. 99.99847412 DISPLAY_IDENTIFIER C_SLV_IVVT_PWM_DIAG_MIN_SCB FORMAT "%5.2" /end CHARACTERISTIC
/begin CHARACTERISTIC c_slv_ivvt_pwm_diag_max_scg "Maximum threshold for SCG diagnosis window" VALUE 0xffe418aa _REC_VAL_20_u2 99.99847412 _CNV_A_R_LINEAR_____8_CM 0. 99.99847412 DISPLAY_IDENTIFIER C_SLV_IVVT_PWM_DIAG_MAX_SCG FORMAT "%5.2" /end CHARACTERISTIC
/begin MEASUREMENT lv_inh_diag_slv_ivvt_ex_1 "Diagnosis inhibition IVVT_EX" UBYTE _CNV_S_2_RANGE______2_CM 1 100. 0. 1. DISPLAY_IDENTIFIER LV_INH_DIAG_SLV_IVVT_EX_1 ECU_ADDRESS 0x3fe4c5 BIT_MASK 0x1 /end MEASUREMENT
/begin MEASUREMENT cdn_diag_slv_ivvt_in_1 "Diagnosis condition for each symptom for IVVT_IN" UBYTE _CNV_A_R_LINEAR_____0_CM 1 100. 0. 255. DISPLAY_IDENTIFIER CDN_DIAG_SLV_IVVT_IN_1 ECU_ADDRESS 0x3fe4c7 FORMAT "%3.0" /end MEASUREMENT
/begin MEASUREMENT ctr_det_slv_ivvt_in_1 "Debounce counter for  IVVT_IN" UBYTE _CNV_A_R_LINEAR_____0_CM 1 100. 0. 255. DISPLAY_IDENTIFIER CTR_DET_SLV_IVVT_IN_1 ECU_ADDRESS 0x3fe4c6 FORMAT "%3.0" /end MEASUREMENT
/begin MEASUREMENT ctr_ready_slv_ivvt_ex_1 "Counter for end of diagnosis calculation for  IVVT_EX" UBYTE _CNV_A_R_LINEAR_____0_CM 1 100. 0. 255. DISPLAY_IDENTIFIER CTR_READY_SLV_IVVT_EX_1 ECU_ADDRESS 0x3fe4cb FORMAT "%3.0" /end MEASUREMENT
/begin CHARACTERISTIC c_t_max_ecu "time delay to switch off the ECU" VALUE 0xffe41994 _REC_VAL_20_u2 102.2 _CNV_A_R_LINEAR_____30_CM 1. 1023. DISPLAY_IDENTIFIER C_T_MAX_ECU FORMAT "%4.0" /end CHARACTERISTIC
/begin CHARACTERISTIC lc_sof_conf "Configuration switch for activation logic of sound flap (0 = normal,  1 = inverted)" VALUE 0xffe40fd5 _REC_VAL_20_u1 1. _CNV_A_R_LINEAR_____22_CM 0. 1. DISPLAY_IDENTIFIER LC_SOF_CONF FORMAT "%1.0" /end CHARACTERISTIC
/begin MEASUREMENT v_tps_gain_1 "Actual value of amplified TPS-channel 1" UWORD _CNV_A_R_LINEAR_____3_CM 1 100. 0. 4.99511719 DISPLAY_IDENTIFIER V_TPS_GAIN_1 ECU_ADDRESS 0x3fd758 BYTE_ORDER MSB_LAST FORMAT "%5.3" /end MEASUREMENT
/begin CHARACTERISTIC c_ctr_diag_tout_max_pow_vb "Maximum number of missing message events before error detection of BN2000 message" VALUE 0xffe406c3 _REC_VAL_20_u1 255. _CNV_A_R_LINEAR_____0_CM 0. 255. DISPLAY_IDENTIFIER C_CTR_DIAG_TOUT_MAX_POW_VB FORMAT "%3.0" /end CHARACTERISTIC
/begin CHARACTERISTIC c_ctr_diag_tout_max_pow_gen "Maximum number of missing message events before error detection of BN2000 message" VALUE 0xffe406c2 _REC_VAL_20_u1 255. _CNV_A_R_LINEAR_____0_CM 0. 255. DISPLAY_IDENTIFIER C_CTR_DIAG_TOUT_MAX_POW_GEN FORMAT "%3.0" /end CHARACTERISTIC
/begin CHARACTERISTIC c_ctr_diag_tout_max_msw "Maximum number of missing message events before error detection of BN2000 message" VALUE 0xffe406c1 _REC_VAL_20_u1 255. _CNV_A_R_LINEAR_____0_CM 0. 255. DISPLAY_IDENTIFIER C_CTR_DIAG_TOUT_MAX_MSW FORMAT "%3.0" /end CHARACTERISTIC
/begin CHARACTERISTIC c_ctr_diag_tout_max_etcu "Maximum number of missing message events before error detection of BN2000 message" VALUE 0xffe406be _REC_VAL_20_u1 255. _CNV_A_R_LINEAR_____0_CM 0. 255. DISPLAY_IDENTIFIER C_CTR_DIAG_TOUT_MAX_ETCU FORMAT "%3.0" /end CHARACTERISTIC
/begin CHARACTERISTIC c_ctr_diag_tout_max_ang_pste "Maximum number of missing message events before error detection of BN2000 message" VALUE 0xffe406ba _REC_VAL_20_u1 255. _CNV_A_R_LINEAR_____0_CM 0. 255. DISPLAY_IDENTIFIER C_CTR_DIAG_TOUT_MAX_ANG_PSTE FORMAT "%3.0" /end CHARACTERISTIC
/begin CHARACTERISTIC c_abc_max_bn_ars "Maximum value of the anti - bounce counter BN2000 diagnosis" VALUE 0xffe405c1 _REC_VAL_20_u1 254. _CNV_A_R_LINEAR_____0_CM 1. 255. DISPLAY_IDENTIFIER C_ABC_MAX_BN_ARS FORMAT "%3.0" /end CHARACTERISTIC
/begin CHARACTERISTIC c_abc_inc_bn_ars "Anti - bounce counter increment BN2000 Diagnosis" VALUE 0xffe4054b _REC_VAL_20_u1 255. _CNV_A_R_LINEAR_____0_CM 0. 255. DISPLAY_IDENTIFIER C_ABC_INC_BN_ARS FORMAT "%3.0" /end CHARACTERISTIC
/begin CHARACTERISTIC c_abc_dec_bn_tq_dcc "Anti - bounce counter increment BN2000 Diagnosis" VALUE 0xffe4053e _REC_VAL_20_u1 255. _CNV_A_R_LINEAR_____0_CM 0. 255. DISPLAY_IDENTIFIER C_ABC_DEC_BN_TQ_DCC FORMAT "%3.0" /end CHARACTERISTIC
/begin CHARACTERISTIC c_abc_dec_bn_ars "Anti - bounce counter increment BN2000 Diagnosis" VALUE 0xffe40532 _REC_VAL_20_u1 255. _CNV_A_R_LINEAR_____0_CM 0. 255. DISPLAY_IDENTIFIER C_ABC_DEC_BN_ARS FORMAT "%3.0" /end CHARACTERISTIC
/begin CHARACTERISTIC c_abc_dec_bn_cas "Anti - bounce counter increment BN2000 Diagnosis" VALUE 0xffe40533 _REC_VAL_20_u1 255. _CNV_A_R_LINEAR_____0_CM 0. 255. DISPLAY_IDENTIFIER C_ABC_DEC_BN_CAS FORMAT "%3.0" /end CHARACTERISTIC
/begin CHARACTERISTIC c_abc_dec_bn_tq_tcs "Anti - bounce counter increment BN2000 Diagnosis" VALUE 0xffe40541 _REC_VAL_20_u1 255. _CNV_A_R_LINEAR_____0_CM 0. 255. DISPLAY_IDENTIFIER C_ABC_DEC_BN_TQ_TCS FORMAT "%3.0" /end CHARACTERISTIC
/begin CHARACTERISTIC c_abc_dec_bn_vs_tcs "Anti - bounce counter increment BN2000 Diagnosis" VALUE 0xffe40543 _REC_VAL_20_u1 255. _CNV_A_R_LINEAR_____0_CM 0. 255. DISPLAY_IDENTIFIER C_ABC_DEC_BN_VS_TCS FORMAT "%3.0" /end CHARACTERISTIC
/begin CHARACTERISTIC c_abc_dec_bn_tcs "Anti - bounce counter increment BN2000 Diagnosis" VALUE 0xffe4053c _REC_VAL_20_u1 255. _CNV_A_R_LINEAR_____0_CM 0. 255. DISPLAY_IDENTIFIER C_ABC_DEC_BN_TCS FORMAT "%3.0" /end CHARACTERISTIC
/begin CHARACTERISTIC c_abc_dec_bn_tq_etcu "Anti - bounce counter increment BN2000 Diagnosis" VALUE 0xffe4053f _REC_VAL_20_u1 255. _CNV_A_R_LINEAR_____0_CM 0. 255. DISPLAY_IDENTIFIER C_ABC_DEC_BN_TQ_ETCU FORMAT "%3.0" /end CHARACTERISTIC
/begin CHARACTERISTIC c_abc_dec_bn_etcu "Anti - bounce counter increment BN2000 Diagnosis" VALUE 0xffe40535 _REC_VAL_20_u1 255. _CNV_A_R_LINEAR_____0_CM 0. 255. DISPLAY_IDENTIFIER C_ABC_DEC_BN_ETCU FORMAT "%3.0" /end CHARACTERISTIC
/begin CHARACTERISTIC c_abc_dec_bn_tq_amt "Anti - bounce counter increment BN2000 Diagnosis" VALUE 0xffe4053d _REC_VAL_20_u1 255. _CNV_A_R_LINEAR_____0_CM 0. 255. DISPLAY_IDENTIFIER C_ABC_DEC_BN_TQ_AMT FORMAT "%3.0" /end CHARACTERISTIC
/begin CHARACTERISTIC c_abc_dec_bn_acc "Anti - bounce counter increment BN2000 Diagnosis" VALUE 0xffe40530 _REC_VAL_20_u1 255. _CNV_A_R_LINEAR_____0_CM 0. 255. DISPLAY_IDENTIFIER C_ABC_DEC_BN_ACC FORMAT "%3.0" /end CHARACTERISTIC
/begin CHARACTERISTIC c_abc_dec_bn_icl "Anti - bounce counter increment BN2000 Diagnosis" VALUE 0xffe40536 _REC_VAL_20_u1 255. _CNV_A_R_LINEAR_____0_CM 0. 255. DISPLAY_IDENTIFIER C_ABC_DEC_BN_ICL FORMAT "%3.0" /end CHARACTERISTIC
/begin CHARACTERISTIC c_abc_dec_bn_km_icl "Anti - bounce counter increment BN2000 Diagnosis" VALUE 0xffe40537 _REC_VAL_20_u1 255. _CNV_A_R_LINEAR_____0_CM 0. 255. DISPLAY_IDENTIFIER C_ABC_DEC_BN_KM_ICL FORMAT "%3.0" /end CHARACTERISTIC
/begin CHARACTERISTIC c_abc_dec_bn_t_icl "Anti - bounce counter increment BN2000 Diagnosis" VALUE 0xffe4053b _REC_VAL_20_u1 255. _CNV_A_R_LINEAR_____0_CM 0. 255. DISPLAY_IDENTIFIER C_ABC_DEC_BN_T_ICL FORMAT "%3.0" /end CHARACTERISTIC
/begin CHARACTERISTIC c_abc_dec_bn_pow_vb "Anti - bounce counter increment BN2000 Diagnosis" VALUE 0xffe4053a _REC_VAL_20_u1 255. _CNV_A_R_LINEAR_____0_CM 0. 255. DISPLAY_IDENTIFIER C_ABC_DEC_BN_POW_VB FORMAT "%3.0" /end CHARACTERISTIC
/begin CHARACTERISTIC c_abc_dec_bn_pow_gen "Anti - bounce counter increment BN2000 Diagnosis" VALUE 0xffe40539 _REC_VAL_20_u1 255. _CNV_A_R_LINEAR_____0_CM 0. 255. DISPLAY_IDENTIFIER C_ABC_DEC_BN_POW_GEN FORMAT "%3.0" /end CHARACTERISTIC
/begin CHARACTERISTIC c_abc_dec_bn_msw "Anti - bounce counter increment BN2000 Diagnosis" VALUE 0xffe40538 _REC_VAL_20_u1 255. _CNV_A_R_LINEAR_____0_CM 0. 255. DISPLAY_IDENTIFIER C_ABC_DEC_BN_MSW FORMAT "%3.0" /end CHARACTERISTIC
/begin CHARACTERISTIC c_abc_dec_bn_ang_pste "Anti - bounce counter increment BN2000 Diagnosis" VALUE 0xffe40531 _REC_VAL_20_u1 255. _CNV_A_R_LINEAR_____0_CM 0. 255. DISPLAY_IDENTIFIER C_ABC_DEC_BN_ANG_PSTE FORMAT "%3.0" /end CHARACTERISTIC
/begin CHARACTERISTIC c_abc_dec_bn_veh_mod "Anti - bounce counter increment BN2000 Diagnosis" VALUE 0xffe40542 _REC_VAL_20_u1 255. _CNV_A_R_LINEAR_____0_CM 0. 255. DISPLAY_IDENTIFIER C_ABC_DEC_BN_VEH_MOD FORMAT "%3.0" /end CHARACTERISTIC
/begin CHARACTERISTIC c_abc_inc_bn_tq_pste_2 "Anti - bounce counter increment BN2000 Diagnosis" VALUE 0xffe40559 _REC_VAL_20_u1 255. _CNV_A_R_LINEAR_____0_CM 0. 255. DISPLAY_IDENTIFIER C_ABC_INC_BN_TQ_PSTE_2 FORMAT "%3.0" /end CHARACTERISTIC
/begin CHARACTERISTIC c_abc_max_bn_tq_pste_2 "Maximum value of the anti - bounce counter BN2000 diagnosis" VALUE 0xffe405cf _REC_VAL_20_u1 254. _CNV_A_R_LINEAR_____0_CM 1. 255. DISPLAY_IDENTIFIER C_ABC_MAX_BN_TQ_PSTE_2 FORMAT "%3.0" /end CHARACTERISTIC
/begin CHARACTERISTIC c_abc_dec_bn_tq_pste_2 "Anti - bounce counter increment BN2000 Diagnosis" VALUE 0xffe40540 _REC_VAL_20_u1 255. _CNV_A_R_LINEAR_____0_CM 0. 255. DISPLAY_IDENTIFIER C_ABC_DEC_BN_TQ_PSTE_2 FORMAT "%3.0" /end CHARACTERISTIC
/begin CHARACTERISTIC c_ctr_diag_tcc_can_max_tq_pste_2 "Maximum number of wrong ATCC_CAN count events before error detection of BN2000 message" VALUE 0xffe406b6 _REC_VAL_20_u1 255. _CNV_A_R_LINEAR_____0_CM 0. 255. DISPLAY_IDENTIFIER C_CTR_DIAG_TCC_CAN_MAX_TQ_PSTE_2 FORMAT "%3.0" /end CHARACTERISTIC
/begin CHARACTERISTIC c_ctr_diag_cks_max_tq_pste_2 "Maximum number of wrong checksum calculation events before error detection of BN2000 message" VALUE 0xffe406a9 _REC_VAL_20_u1 255. _CNV_A_R_LINEAR_____0_CM 0. 255. DISPLAY_IDENTIFIER C_CTR_DIAG_CKS_MAX_TQ_PSTE_2 FORMAT "%3.0" /end CHARACTERISTIC
/begin CHARACTERISTIC c_ctr_diag_tout_max_tq_pste_2 "Maximum number of missing message events before error detection of BN2000 message" VALUE 0xffe406c9 _REC_VAL_20_u1 255. _CNV_A_R_LINEAR_____0_CM 0. 255. DISPLAY_IDENTIFIER C_CTR_DIAG_TOUT_MAX_TQ_PSTE_2 FORMAT "%3.0" /end CHARACTERISTIC
/begin CHARACTERISTIC c_abc_inc_bn_efp "Anti - bounce counter increment BN2000 Diagnosis" VALUE 0xffe4054d _REC_VAL_20_u1 255. _CNV_A_R_LINEAR_____0_CM 0. 255. DISPLAY_IDENTIFIER C_ABC_INC_BN_EFP FORMAT "%3.0" /end CHARACTERISTIC
/begin CHARACTERISTIC c_abc_max_bn_efp "Maximum value of the anti - bounce counter BN2000 diagnosis" VALUE 0xffe405c3 _REC_VAL_20_u1 254. _CNV_A_R_LINEAR_____0_CM 1. 255. DISPLAY_IDENTIFIER C_ABC_MAX_BN_EFP FORMAT "%3.0" /end CHARACTERISTIC
/begin CHARACTERISTIC c_abc_dec_bn_efp "Anti - bounce counter increment BN2000 Diagnosis" VALUE 0xffe40534 _REC_VAL_20_u1 255. _CNV_A_R_LINEAR_____0_CM 0. 255. DISPLAY_IDENTIFIER C_ABC_DEC_BN_EFP FORMAT "%3.0" /end CHARACTERISTIC
/begin CHARACTERISTIC c_ctr_diag_tout_max_efp "Maximum number of missing message events before error detection of BN2000 message" VALUE 0xffe406bd _REC_VAL_20_u1 255. _CNV_A_R_LINEAR_____0_CM 0. 255. DISPLAY_IDENTIFIER C_CTR_DIAG_TOUT_MAX_EFP FORMAT "%3.0" /end CHARACTERISTIC
/begin CHARACTERISTIC c_abc_inc_bsd "Anti - bounce counter increment" VALUE 0xffe4055d _REC_VAL_20_u1 255. _CNV_A_R_LINEAR_____0_CM 0. 255. DISPLAY_IDENTIFIER C_ABC_INC_BSD FORMAT "%3.0" /end CHARACTERISTIC
/begin CHARACTERISTIC c_abc_max_bsd "Debounce counter maximum value" VALUE 0xffe405d3 _REC_VAL_20_u1 254. _CNV_A_R_LINEAR_____0_CM 1. 255. DISPLAY_IDENTIFIER C_ABC_MAX_BSD FORMAT "%3.0" /end CHARACTERISTIC
/begin CHARACTERISTIC c_abc_inc_cam_per_0 "anti-bounce counter increment for CAM_0 camshaft period error diagnosis" VALUE 0xffe4055e _REC_VAL_20_u1 255. _CNV_A_R_LINEAR_____0_CM 0. 255. DISPLAY_IDENTIFIER C_ABC_INC_CAM_PER_0 FORMAT "%3.0" /end CHARACTERISTIC
/begin CHARACTERISTIC c_abc_inc_cam_per_1 "anti-bounce counter increment for CAM_1 camshaft period error diagnosis" VALUE 0xffe4055f _REC_VAL_20_u1 255. _CNV_A_R_LINEAR_____0_CM 0. 255. DISPLAY_IDENTIFIER C_ABC_INC_CAM_PER_1 FORMAT "%3.0" /end CHARACTERISTIC
/begin CHARACTERISTIC c_abc_max_cam_per_1 "maximum value of the anti-bounce counter for CAM_1 camshaft period error diagnosis" VALUE 0xffe405d5 _REC_VAL_20_u1 254. _CNV_A_R_LINEAR_____0_CM 1. 255. DISPLAY_IDENTIFIER C_ABC_MAX_CAM_PER_1 FORMAT "%3.0" /end CHARACTERISTIC
/begin CHARACTERISTIC c_abc_max_cam_per_0 "maximum value of the anti-bounce counter for CAM_0 camshaft period error diagnosis" VALUE 0xffe405d4 _REC_VAL_20_u1 254. _CNV_A_R_LINEAR_____0_CM 1. 255. DISPLAY_IDENTIFIER C_ABC_MAX_CAM_PER_0 FORMAT "%3.0" /end CHARACTERISTIC
/begin CHARACTERISTIC c_abc_inc_cam_psn_1 "anti-bounce counter increment for CAM_1 camshaft position diagnosis" VALUE 0xffe40561 _REC_VAL_20_u1 255. _CNV_A_R_LINEAR_____0_CM 0. 255. DISPLAY_IDENTIFIER C_ABC_INC_CAM_PSN_1 FORMAT "%3.0" /end CHARACTERISTIC
/begin CHARACTERISTIC c_abc_max_cam_psn_0 "maximum value of the anti-bounce counter for CAM_0 camshaft position diagnosis" VALUE 0xffe405d6 _REC_VAL_20_u1 254. _CNV_A_R_LINEAR_____0_CM 1. 255. DISPLAY_IDENTIFIER C_ABC_MAX_CAM_PSN_0 FORMAT "%3.0" /end CHARACTERISTIC
/begin CHARACTERISTIC c_abc_max_cam_psn_1 "maximum value of the anti-bounce counter for CAM_1 camshaft position diagnosis" VALUE 0xffe405d7 _REC_VAL_20_u1 254. _CNV_A_R_LINEAR_____0_CM 1. 255. DISPLAY_IDENTIFIER C_ABC_MAX_CAM_PSN_1 FORMAT "%3.0" /end CHARACTERISTIC
/begin CHARACTERISTIC c_abc_inc_cam_psn_0 "anti-bounce counter increment for CAM_0 camshaft position diagnosis" VALUE 0xffe40560 _REC_VAL_20_u1 255. _CNV_A_R_LINEAR_____0_CM 0. 255. DISPLAY_IDENTIFIER C_ABC_INC_CAM_PSN_0 FORMAT "%3.0" /end CHARACTERISTIC
/begin MEASUREMENT lv_err_locan_boff "present error LOCAN bus off" UBYTE _CNV_S_2_RANGE______1_R_CM 1 100. 0. 255. DISPLAY_IDENTIFIER LV_ERR_LOCAN_BOFF ECU_ADDRESS 0x3fbb08 /end MEASUREMENT
/begin CHARACTERISTIC c_abc_inc_tout_asr_3 "anti bounce counter increment  - diagnosis of timeout CAN message ASC3" VALUE 0xffe405a0 _REC_VAL_20_u1 255. _CNV_A_R_LINEAR_____0_CM 0. 255. DISPLAY_IDENTIFIER C_ABC_INC_TOUT_ASR_3 FORMAT "%3.0" /end CHARACTERISTIC
/begin CHARACTERISTIC c_abc_max_tout_asr_3 "anti bounce counter maximum value  - diagnosis of timeout CAN message ASC3 " VALUE 0xffe40610 _REC_VAL_20_u1 254. _CNV_A_R_LINEAR_____0_CM 1. 255. DISPLAY_IDENTIFIER C_ABC_MAX_TOUT_ASR_3 FORMAT "%3.0" /end CHARACTERISTIC
/begin CHARACTERISTIC c_abc_inc_can_boff "anti bounce counter increment  - diagnosis of CAN bus on / off" VALUE 0xffe40562 _REC_VAL_20_u1 255. _CNV_A_R_LINEAR_____0_CM 0. 255. DISPLAY_IDENTIFIER C_ABC_INC_CAN_BOFF FORMAT "%3.0" /end CHARACTERISTIC
/begin CHARACTERISTIC c_abc_max_can_boff "anti bounce counter maximum value  - diagnosis of CAN bus on / off" VALUE 0xffe405d8 _REC_VAL_20_u1 254. _CNV_A_R_LINEAR_____0_CM 1. 255. DISPLAY_IDENTIFIER C_ABC_MAX_CAN_BOFF FORMAT "%3.0" /end CHARACTERISTIC
/begin CHARACTERISTIC c_abc_inc_tout_asr_1 "anti bounce counter increment  - diagnosis of timeout CAN message ASC1" VALUE 0xffe4059f _REC_VAL_20_u1 255. _CNV_A_R_LINEAR_____0_CM 0. 255. DISPLAY_IDENTIFIER C_ABC_INC_TOUT_ASR_1 FORMAT "%3.0" /end CHARACTERISTIC
/begin CHARACTERISTIC c_abc_max_tout_asr_1 "anti bounce counter maximum value  - diagnosis of timeout CAN message ASC1 " VALUE 0xffe4060f _REC_VAL_20_u1 254. _CNV_A_R_LINEAR_____0_CM 1. 255. DISPLAY_IDENTIFIER C_ABC_MAX_TOUT_ASR_1 FORMAT "%3.0" /end CHARACTERISTIC
/begin CHARACTERISTIC c_abc_inc_tout_asr_4 "anti bounce counter increment  - diagnosis of timeout CAN message ASC4" VALUE 0xffe405a1 _REC_VAL_20_u1 255. _CNV_A_R_LINEAR_____0_CM 0. 255. DISPLAY_IDENTIFIER C_ABC_INC_TOUT_ASR_4 FORMAT "%3.0" /end CHARACTERISTIC
/begin CHARACTERISTIC c_abc_max_tout_asr_4 "anti bounce counter maximum value  - diagnosis of timeout CAN message ASC4 " VALUE 0xffe40611 _REC_VAL_20_u1 254. _CNV_A_R_LINEAR_____0_CM 1. 255. DISPLAY_IDENTIFIER C_ABC_MAX_TOUT_ASR_4 FORMAT "%3.0" /end CHARACTERISTIC
/begin MEASUREMENT cyc_ctr_efp_diag "counter of not received EFP messages" UBYTE _CNV_A_R_LINEAR_____0_CM 1 100. 0. 255. DISPLAY_IDENTIFIER CYC_CTR_EFP_DIAG ECU_ADDRESS 0x3fe315 FORMAT "%3.0" /end MEASUREMENT
/begin CHARACTERISTIC c_efp_cycnr_max "maximumnumber of missing EFP messages for error debounce counter increment" VALUE 0xffe40720 _REC_VAL_20_u1 254. _CNV_A_R_LINEAR_____0_CM 1. 255. DISPLAY_IDENTIFIER C_EFP_CYCNR_MAX FORMAT "%3.0" /end CHARACTERISTIC
/begin CHARACTERISTIC c_abc_inc_tout_efp "anti bounce counter increment  - diagnosis of timeout CAN message EFP" VALUE 0xffe405a2 _REC_VAL_20_u1 255. _CNV_A_R_LINEAR_____0_CM 0. 255. DISPLAY_IDENTIFIER C_ABC_INC_TOUT_EFP FORMAT "%3.0" /end CHARACTERISTIC
/begin CHARACTERISTIC c_abc_max_tout_efp "anti bounce counter maximum value  - diagnosis of timeout CAN message EFP" VALUE 0xffe40612 _REC_VAL_20_u1 254. _CNV_A_R_LINEAR_____0_CM 1. 255. DISPLAY_IDENTIFIER C_ABC_MAX_TOUT_EFP FORMAT "%3.0" /end CHARACTERISTIC
/begin CHARACTERISTIC c_abc_inc_locan_boff "Debounce counter increment - diagnosis of LOCAN bus on / off" VALUE 0xffe40579 _REC_VAL_20_u1 255. _CNV_A_R_LINEAR_____0_CM 0. 255. DISPLAY_IDENTIFIER C_ABC_INC_LOCAN_BOFF FORMAT "%3.0" /end CHARACTERISTIC
/begin CHARACTERISTIC c_abc_max_locan_boff "debounce counter maximum value - diagnosis of LOCAN bus on / off" VALUE 0xffe405ec _REC_VAL_20_u1 254. _CNV_A_R_LINEAR_____0_CM 1. 255. DISPLAY_IDENTIFIER C_ABC_MAX_LOCAN_BOFF FORMAT "%3.0" /end CHARACTERISTIC
/begin MEASUREMENT lv_err_efp "logical variable error in case of EFP self diagnosis" UBYTE _CNV_S_2_RANGE______1_R_CM 1 100. 0. 255. DISPLAY_IDENTIFIER LV_ERR_EFP ECU_ADDRESS 0x3fbb04 /end MEASUREMENT
/begin MEASUREMENT lv_err_efp_crash "logical variable error in case of crash switch off EFP" UBYTE _CNV_S_2_RANGE______1_R_CM 1 100. 0. 255. DISPLAY_IDENTIFIER LV_ERR_EFP_CRASH ECU_ADDRESS 0x3fbb00 /end MEASUREMENT
/begin MEASUREMENT lv_err_tout_efp "logical variable timeout error CAN message EKP" UBYTE _CNV_S_2_RANGE______1_R_CM 1 100. 0. 255. DISPLAY_IDENTIFIER LV_ERR_TOUT_EFP ECU_ADDRESS 0x3fba88 /end MEASUREMENT
/begin CHARACTERISTIC c_abc_inc_tout_etcu_1 "anti bounce counter increment  - diagnosis of timeout CAN message EGS1" VALUE 0xffe405a3 _REC_VAL_20_u1 255. _CNV_A_R_LINEAR_____0_CM 0. 255. DISPLAY_IDENTIFIER C_ABC_INC_TOUT_ETCU_1 FORMAT "%3.0" /end CHARACTERISTIC
/begin CHARACTERISTIC c_abc_inc_tout_etcu_2 "anti bounce counter increment  - diagnosis of timeout CAN message EGS2" VALUE 0xffe405a4 _REC_VAL_20_u1 255. _CNV_A_R_LINEAR_____0_CM 0. 255. DISPLAY_IDENTIFIER C_ABC_INC_TOUT_ETCU_2 FORMAT "%3.0" /end CHARACTERISTIC
/begin CHARACTERISTIC c_abc_max_tout_etcu_1 "anti bounce counter maximum value  - diagnosis of timeout CAN message EGS1 " VALUE 0xffe40613 _REC_VAL_20_u1 254. _CNV_A_R_LINEAR_____0_CM 1. 255. DISPLAY_IDENTIFIER C_ABC_MAX_TOUT_ETCU_1 FORMAT "%3.0" /end CHARACTERISTIC
/begin CHARACTERISTIC c_abc_max_tout_etcu_2 "anti bounce counter maximum value  - diagnosis of timeout CAN message EGS2" VALUE 0xffe40614 _REC_VAL_20_u1 254. _CNV_A_R_LINEAR_____0_CM 1. 255. DISPLAY_IDENTIFIER C_ABC_MAX_TOUT_ETCU_2 FORMAT "%3.0" /end CHARACTERISTIC
/begin CHARACTERISTIC c_abc_inc_tout_icl_2 "anti bounce counter increment  - diagnosis of timeout CAN message INSTR2" VALUE 0xffe405a5 _REC_VAL_20_u1 255. _CNV_A_R_LINEAR_____0_CM 0. 255. DISPLAY_IDENTIFIER C_ABC_INC_TOUT_ICL_2_ FORMAT "%3.0" /end CHARACTERISTIC
/begin CHARACTERISTIC c_abc_max_tout_icl_2 "anti bounce counter maximum value  - diagnosis of timeout CAN message INSTR2" VALUE 0xffe40615 _REC_VAL_20_u1 254. _CNV_A_R_LINEAR_____0_CM 1. 255. DISPLAY_IDENTIFIER C_ABC_MAX_TOUT_ICL_2 FORMAT "%3.0" /end CHARACTERISTIC
/begin CHARACTERISTIC c_abc_inc_tout_icl_3 "anti bounce counter increment  - diagnosis of timeout CAN message INSTR3" VALUE 0xffe405a6 _REC_VAL_20_u1 255. _CNV_A_R_LINEAR_____0_CM 0. 255. DISPLAY_IDENTIFIER C_ABC_INC_TOUT_ICL_3_ FORMAT "%3.0" /end CHARACTERISTIC
/begin CHARACTERISTIC c_abc_max_tout_icl_3 "anti bounce counter maximum value  - diagnosis of timeout CAN message INSTR3" VALUE 0xffe40616 _REC_VAL_20_u1 254. _CNV_A_R_LINEAR_____0_CM 1. 255. DISPLAY_IDENTIFIER C_ABC_MAX_TOUT_ICL_3 FORMAT "%3.0" /end CHARACTERISTIC
/begin CHARACTERISTIC c_abc_inc_tout_pste_1 "anti bounce counter increment  - diagnosis of timeout CAN message EGS2" VALUE 0xffe405a8 _REC_VAL_20_u1 255. _CNV_A_R_LINEAR_____0_CM 0. 255. DISPLAY_IDENTIFIER C_ABC_INC_TOUT_PSTE_1 FORMAT "%3.0" /end CHARACTERISTIC
/begin CHARACTERISTIC c_abc_max_tout_pste_1 "anti bounce counter maximum value  - diagnosis of timeout CAN message LWS1" VALUE 0xffe40618 _REC_VAL_20_u1 254. _CNV_A_R_LINEAR_____0_CM 1. 255. DISPLAY_IDENTIFIER C_ABC_MAX_TOUT_PSTE_1 FORMAT "%3.0" /end CHARACTERISTIC
/begin CHARACTERISTIC c_abc_inc_dcc_inh_mon "Anti bounce counter increment" VALUE 0xffe51f39 _REC_VAL_20_u1 255. _CNV_A_R_LINEAR_____0_CM 0. 255. DISPLAY_IDENTIFIER C_ABC_INC_DCC_INH_MON FORMAT "%3.0" /end CHARACTERISTIC
/begin CHARACTERISTIC c_abc_max_dcc_inh_mon "Maximum value of anti-bounce counter" VALUE 0xffe51f4e _REC_VAL_20_u1 254. _CNV_A_R_LINEAR_____0_CM 1. 255. DISPLAY_IDENTIFIER C_ABC_MAX_DCC_INH_MON FORMAT "%3.0" /end CHARACTERISTIC
/begin CHARACTERISTIC c_abc_inc_dcc_rev_mon "Increment counter" VALUE 0xffe51f3b _REC_VAL_20_u1 255. _CNV_A_R_LINEAR_____0_CM 0. 255. DISPLAY_IDENTIFIER C_ABC_INC_DCC_REV_MON FORMAT "%3.0" /end CHARACTERISTIC
/begin CHARACTERISTIC c_abc_max_dcc_rev_mon "Maximum counter" VALUE 0xffe51f50 _REC_VAL_20_u1 254. _CNV_A_R_LINEAR_____0_CM 1. 255. DISPLAY_IDENTIFIER C_ABC_MAX_DCC_REV_MON FORMAT "%3.0" /end CHARACTERISTIC
/begin CHARACTERISTIC c_abc_inc_dcc_irrev_mon "Increment counter" VALUE 0xffe51f3a _REC_VAL_20_u1 255. _CNV_A_R_LINEAR_____0_CM 0. 255. DISPLAY_IDENTIFIER C_ABC_INC_DCC_IRREV_MON FORMAT "%3.0" /end CHARACTERISTIC
/begin CHARACTERISTIC c_abc_max_dcc_irrev_mon "Maximum counter" VALUE 0xffe51f4f _REC_VAL_20_u1 254. _CNV_A_R_LINEAR_____0_CM 1. 255. DISPLAY_IDENTIFIER C_ABC_MAX_DCC_IRREV_MON FORMAT "%3.0" /end CHARACTERISTIC
/begin CHARACTERISTIC c_abc_inc_amt_inh_mon "Anti bounce counter increment" VALUE 0xffe51f36 _REC_VAL_20_u1 255. _CNV_A_R_LINEAR_____0_CM 0. 255. DISPLAY_IDENTIFIER C_ABC_INC_AMT_INH_MON FORMAT "%3.0" /end CHARACTERISTIC
/begin CHARACTERISTIC c_abc_max_amt_inh_mon "Maximum value of anti-bounce counter" VALUE 0xffe51f4b _REC_VAL_20_u1 254. _CNV_A_R_LINEAR_____0_CM 1. 255. DISPLAY_IDENTIFIER C_ABC_MAX_AMT_INH_MON FORMAT "%3.0" /end CHARACTERISTIC
/begin CHARACTERISTIC c_abc_inc_gs_inh_mon "Anti bounce counter increment" VALUE 0xffe51f3c _REC_VAL_20_u1 255. _CNV_A_R_LINEAR_____0_CM 0. 255. DISPLAY_IDENTIFIER C_ABC_INC_GS_INH_MON FORMAT "%3.0" /end CHARACTERISTIC
/begin CHARACTERISTIC c_abc_inc_tq_gs_inc_plaus_mon "Debounce counter increment - TQ_GS_INC Diagnosis" VALUE 0xffe51f45 _REC_VAL_20_u1 255. _CNV_A_R_LINEAR_____0_CM 0. 255. DISPLAY_IDENTIFIER C_ABC_INC_TQ_GS_INC_PLAUS_MON FORMAT "%3.0" /end CHARACTERISTIC
/begin CHARACTERISTIC c_abc_max_gs_inh_mon "Maximum value of anti-bounce counter" VALUE 0xffe51f51 _REC_VAL_20_u1 254. _CNV_A_R_LINEAR_____0_CM 1. 255. DISPLAY_IDENTIFIER C_ABC_MAX_GS_INH_MON FORMAT "%3.0" /end CHARACTERISTIC
/begin CHARACTERISTIC c_abc_max_tq_gs_inc_plaus_mon "Debounce counter maximum - TQ_GS_INC Diagnosis" VALUE 0xffe51f5a _REC_VAL_20_u1 254. _CNV_A_R_LINEAR_____0_CM 1. 255. DISPLAY_IDENTIFIER C_ABC_MAX_TQ_GS_INC_PLAUS_MON FORMAT "%3.0" /end CHARACTERISTIC
/begin MEASUREMENT cyc_ctr_nox_sens_1_diag "counter of not received NOX_SENS_i messages" UBYTE _CNV_A_R_LINEAR_____0_CM 1 100. 0. 255. DISPLAY_IDENTIFIER CYC_CTR_NOX_SENS_1_DIAG ECU_ADDRESS 0x3fe34d FORMAT "%3.0" /end MEASUREMENT
/begin MEASUREMENT cyc_ctr_nox_sens_2_diag "counter of not received NOX_SENS_i messages" UBYTE _CNV_A_R_LINEAR_____0_CM 1 100. 0. 255. DISPLAY_IDENTIFIER CYC_CTR_NOX_SENS_2_DIAG ECU_ADDRESS 0x3fe34e FORMAT "%3.0" /end MEASUREMENT
/begin CHARACTERISTIC c_nox_sens_cycnr_max "maximum number of missing NOX_SENS messages for error debounce counter increment" VALUE 0xffe4080c _REC_VAL_20_u1 254. _CNV_A_R_LINEAR_____0_CM 1. 255. DISPLAY_IDENTIFIER C_NOX_SENS_CYCNR_MAX FORMAT "%3.0" /end CHARACTERISTIC
/begin CHARACTERISTIC c_abc_inc_tout_nox_sens "Debounce counter increment - diagnosis of timeout CAN message NOX_SENS" VALUE 0xffe405a7 _REC_VAL_20_u1 255. _CNV_A_R_LINEAR_____0_CM 0. 255. DISPLAY_IDENTIFIER C_ABC_INC_TOUT_NOX_SENS FORMAT "%3.0" /end CHARACTERISTIC
/begin CHARACTERISTIC c_abc_max_tout_nox_sens "debounce counter maximum value - diagnosis of timeout CAN message NOX_SENS" VALUE 0xffe40617 _REC_VAL_20_u1 254. _CNV_A_R_LINEAR_____0_CM 1. 255. DISPLAY_IDENTIFIER C_ABC_MAX_TOUT_NOX_SENS FORMAT "%3.0" /end CHARACTERISTIC
/begin CHARACTERISTIC c_abc_inc_tout_amt_1 "anti bounce counter increment  - diagnosis of timeout CAN message SSG1" VALUE 0xffe4059e _REC_VAL_20_u1 255. _CNV_A_R_LINEAR_____0_CM 0. 255. DISPLAY_IDENTIFIER C_ABC_INC_TOUT_AMT_1 FORMAT "%3.0" /end CHARACTERISTIC
/begin CHARACTERISTIC c_abc_max_tout_amt_1 "anti bounce counter maximum value  - diagnosis of timeout CAN message SSG1 " VALUE 0xffe4060e _REC_VAL_20_u1 254. _CNV_A_R_LINEAR_____0_CM 1. 255. DISPLAY_IDENTIFIER C_ABC_MAX_TOUT_AMT_1 FORMAT "%3.0" /end CHARACTERISTIC
/begin CHARACTERISTIC c_abc_inc_tout_txu_1 "anti bounce counter increment  - diagnosis of timeout CAN message TXU1" VALUE 0xffe405a9 _REC_VAL_20_u1 255. _CNV_A_R_LINEAR_____0_CM 0. 255. DISPLAY_IDENTIFIER C_ABC_INC_TOUT_TXU_1 FORMAT "%3.0" /end CHARACTERISTIC
/begin CHARACTERISTIC c_abc_max_tout_txu_1 "anti bounce counter maximum value  - diagnosis of timeout CAN message TXU1" VALUE 0xffe40619 _REC_VAL_20_u1 254. _CNV_A_R_LINEAR_____0_CM 1. 255. DISPLAY_IDENTIFIER C_ABC_MAX_TOUT_TXU_1 FORMAT "%3.0" /end CHARACTERISTIC
/begin CHARACTERISTIC c_abc_inc_eng_psn_prev_syn "anti-bounce counter increment engine position error previous engine synchronization" VALUE 0xffe4056d _REC_VAL_20_u1 255. _CNV_A_R_LINEAR_____0_CM 0. 255. DISPLAY_IDENTIFIER C_ABC_INC_ENG_PSN_PREV_SYN FORMAT "%3.0" /end CHARACTERISTIC
/begin CHARACTERISTIC c_abc_inc_eng_psn_dur_st "anti-bounce counter increment engine position error during start" VALUE 0xffe4056c _REC_VAL_20_u1 255. _CNV_A_R_LINEAR_____0_CM 0. 255. DISPLAY_IDENTIFIER C_ABC_INC_ENG_PSN_DUR_ST FORMAT "%3.0" /end CHARACTERISTIC
/begin CHARACTERISTIC c_abc_max_eng_psn "maximum value of the anti-bounce counter for engine position error" VALUE 0xffe405e0 _REC_VAL_20_u1 254. _CNV_A_R_LINEAR_____0_CM 1. 255. DISPLAY_IDENTIFIER C_ABC_MAX_ENG_PSN FORMAT "%3.0" /end CHARACTERISTIC
/begin CHARACTERISTIC c_abc_inc_eng_psn_ast "anti-bounce counter increment engine position error after start" VALUE 0xffe4056b _REC_VAL_20_u1 255. _CNV_A_R_LINEAR_____0_CM 0. 255. DISPLAY_IDENTIFIER C_ABC_INC_ENG_PSN_AST FORMAT "%3.0" /end CHARACTERISTIC
/begin CHARACTERISTIC c_abc_inc_tooth_per_prev_syn "anti-bounce counter increment tooth period error previous engine synchronization" VALUE 0xffe4059d _REC_VAL_20_u1 255. _CNV_A_R_LINEAR_____0_CM 0. 255. DISPLAY_IDENTIFIER C_ABC_INC_TOOTH_PER_PREV_SYN FORMAT "%3.0" /end CHARACTERISTIC
/begin CHARACTERISTIC c_abc_inc_tooth_per_ast "anti-bounce counter increment tooth period error after start" VALUE 0xffe4059b _REC_VAL_20_u1 255. _CNV_A_R_LINEAR_____0_CM 0. 255. DISPLAY_IDENTIFIER C_ABC_INC_TOOTH_PER_AST FORMAT "%3.0" /end CHARACTERISTIC
/begin CHARACTERISTIC c_abc_max_tooth_per "maximum value of the anti-bounce counter for tooth period error" VALUE 0xffe4060d _REC_VAL_20_u1 254. _CNV_A_R_LINEAR_____0_CM 1. 255. DISPLAY_IDENTIFIER C_ABC_MAX_TOOTH_PER FORMAT "%3.0" /end CHARACTERISTIC
/begin CHARACTERISTIC c_abc_inc_tooth_per_dur_st "anti-bounce counter increment tooth period error during start" VALUE 0xffe4059c _REC_VAL_20_u1 255. _CNV_A_R_LINEAR_____0_CM 0. 255. DISPLAY_IDENTIFIER C_ABC_INC_TOOTH_PER_DUR_ST FORMAT "%3.0" /end CHARACTERISTIC
/begin CHARACTERISTIC c_abc_inc_tpu_syn_prev_syn "anti-bounce counter increment TPU synchronization error previous engine synchronization" VALUE 0xffe405af _REC_VAL_20_u1 255. _CNV_A_R_LINEAR_____0_CM 0. 255. DISPLAY_IDENTIFIER C_ABC_INC_TPU_SYN_PREV_SYN FORMAT "%3.0" /end CHARACTERISTIC
/begin CHARACTERISTIC c_abc_inc_tpu_syn_dur_st "anti-bounce counter increment TPU synchronization error during start" VALUE 0xffe405ae _REC_VAL_20_u1 255. _CNV_A_R_LINEAR_____0_CM 0. 255. DISPLAY_IDENTIFIER C_ABC_INC_TPU_SYN_DUR_ST FORMAT "%3.0" /end CHARACTERISTIC
/begin CHARACTERISTIC c_abc_max_tpu_syn "maximum value of the anti-bounce counter for TPU synchronization error" VALUE 0xffe4061d _REC_VAL_20_u1 254. _CNV_A_R_LINEAR_____0_CM 1. 255. DISPLAY_IDENTIFIER C_ABC_MAX_TPU_SYN FORMAT "%3.0" /end CHARACTERISTIC
/begin CHARACTERISTIC c_abc_inc_tpu_syn_ast "anti-bounce counter increment TPU synchronization error after start" VALUE 0xffe405ad _REC_VAL_20_u1 255. _CNV_A_R_LINEAR_____0_CM 0. 255. DISPLAY_IDENTIFIER C_ABC_INC_TPU_SYN_AST FORMAT "%3.0" /end CHARACTERISTIC
/begin CHARACTERISTIC c_abc_inc_crk_not_plaus "Anti bounce counter increment crankshaft sensor signal not plausible" VALUE 0xffe40565 _REC_VAL_20_u1 255. _CNV_A_R_LINEAR_____0_CM 0. 255. DISPLAY_IDENTIFIER C_ABC_INC_CRK_NOT_PLAUS FORMAT "%3.0" /end CHARACTERISTIC
/begin CHARACTERISTIC c_abc_max_crk_not_plaus "Maximum of anti bounce counter sensor signal not plausible" VALUE 0xffe405da _REC_VAL_20_u1 254. _CNV_A_R_LINEAR_____0_CM 1. 255. DISPLAY_IDENTIFIER C_ABC_MAX_CRK_NOT_PLAUS FORMAT "%3.0" /end CHARACTERISTIC
/begin CHARACTERISTIC c_abc_inc_dcc "Increment counter" VALUE 0xffe40567 _REC_VAL_20_u1 255. _CNV_A_R_LINEAR_____0_CM 0. 255. DISPLAY_IDENTIFIER C_ABC_INC_DCC FORMAT "%3.0" /end CHARACTERISTIC
/begin CHARACTERISTIC c_abc_max_dcc "Maximum counter" VALUE 0xffe405dc _REC_VAL_20_u1 254. _CNV_A_R_LINEAR_____0_CM 1. 255. DISPLAY_IDENTIFIER C_ABC_MAX_DCC FORMAT "%3.0" /end CHARACTERISTIC
/begin MEASUREMENT lv_dcc_off_ecu "Irreversible DCC error" UBYTE _CNV_S_2_RANGE______2_CM 1 100. 0. 1. DISPLAY_IDENTIFIER LV_DCC_OFF_ECU ECU_ADDRESS 0x3fea05 /end MEASUREMENT
/begin MEASUREMENT t_dcc_brake_det "Brake delay timer" UBYTE _CNV_A_R_LINEAR_____4_CM 1 100. 0. 2.55 DISPLAY_IDENTIFIER T_DCC_BRAKE_DET ECU_ADDRESS 0x3fea06 FORMAT "%4.2" /end MEASUREMENT
/begin CHARACTERISTIC c_t_max_brake_det_dcc "Maximum Brake delay timer" VALUE 0xffe408a4 _REC_VAL_20_u1 2.55 _CNV_A_R_LINEAR_____4_CM 0. 2.55 DISPLAY_IDENTIFIER C_T_MAX_BRAKE_DET_DCC FORMAT "%4.2" /end CHARACTERISTIC
/begin MEASUREMENT lv_err_dcc "DCC error" UBYTE _CNV_S_2_RANGE______1_R_CM 1 100. 0. 255. DISPLAY_IDENTIFIER LV_ERR_DCC ECU_ADDRESS 0x3fba94 /end MEASUREMENT
/begin CHARACTERISTIC c_maf_cs_diag "MAF threshold for error detection" VALUE 0xffe4172c _REC_VAL_20_u2 1389. _CNV_A_R_LINEAR_____108_CM 0. 1389. DISPLAY_IDENTIFIER C_MAF_CS_DIAG FORMAT "%7.2" /end CHARACTERISTIC
/begin CHARACTERISTIC c_n_32_cs_diag "N32 threshold for error detection" VALUE 0xffe407c1 _REC_VAL_20_u1 8160. _CNV_A_R_LINEAR_____15_CM 0. 8160. DISPLAY_IDENTIFIER C_N_32_CS_DIAG FORMAT "%4.0" /end CHARACTERISTIC
/begin CHARACTERISTIC c_abc_inc_cs "Anti bounce increment CS diagnosis" VALUE 0xffe40566 _REC_VAL_20_u1 255. _CNV_A_R_LINEAR_____0_CM 0. 255. DISPLAY_IDENTIFIER C_ABC_INC_CS FORMAT "%3.0" /end CHARACTERISTIC
/begin CHARACTERISTIC c_abc_max_cs "Anti bounce maximum CS diagnosis" VALUE 0xffe405db _REC_VAL_20_u1 254. _CNV_A_R_LINEAR_____0_CM 1. 255. DISPLAY_IDENTIFIER C_ABC_MAX_CS FORMAT "%3.0" /end CHARACTERISTIC
/begin MEASUREMENT lv_err_cs "Active CS error" UBYTE _CNV_A_R_LINEAR_____22_CM 1 100. 0. 1. DISPLAY_IDENTIFIER LV_ERR_CS ECU_ADDRESS 0x3fbaa0 FORMAT "%1.0" /end MEASUREMENT
/begin MEASUREMENT lv_cs_diag "Flag set when vehicle was stopped = pre-condition for diagnosis cycle" UBYTE _CNV_A_R_LINEAR_____22_CM 1 100. 0. 1. DISPLAY_IDENTIFIER LV_CS_DIAG ECU_ADDRESS 0x3fe9cd FORMAT "%1.0" /end MEASUREMENT
/begin MEASUREMENT lv_cs_swi "Flag set when CS change its state" UBYTE _CNV_A_R_LINEAR_____22_CM 1 100. 0. 1. DISPLAY_IDENTIFIER LV_CS_SWI ECU_ADDRESS 0x3fe9ce FORMAT "%1.0" /end MEASUREMENT
/begin MEASUREMENT t_min_maf_cs_diag "Minimum diagnosis time for MAF condition" UBYTE _CNV_A_R_LINEAR_____30_CM 1 100. 0. 255. DISPLAY_IDENTIFIER T_MIN_MAF_CS_DIAG ECU_ADDRESS 0x3fe9cc FORMAT "%3.0" /end MEASUREMENT
/begin CHARACTERISTIC c_vs_cs_diag "Speed threshold for activation of diagnosis cycle" VALUE 0xffe409c8 _REC_VAL_20_u1 255. _CNV_A_R_LINEAR_____23_CM 0. 255. DISPLAY_IDENTIFIER C_VS_CS_DIAG FORMAT "%3.0" /end CHARACTERISTIC
/begin CHARACTERISTIC c_t_min_maf_cs_diag "Minimum diagnosis time for MAF condition" VALUE 0xffe408b3 _REC_VAL_20_u1 255. _CNV_A_R_LINEAR_____30_CM 0. 255. DISPLAY_IDENTIFIER C_T_MIN_MAF_CS_DIAG FORMAT "%3.0" /end CHARACTERISTIC
/begin MEASUREMENT iso_m6_diag_ram_com.m6_cur_dmtl_cor_fil_cid18 "" UWORD _CNV_A_R_LINEAR_____168_CM 1 100. 0. 400. DISPLAY_IDENTIFIER M6_CUR_DMTL_COR_FIL_CID18 ECU_ADDRESS 0x3fdb1a BYTE_ORDER MSB_LAST FORMAT "%7.3" /end MEASUREMENT
/begin MEASUREMENT iso_m6_diag_ram_com.m6_cur_dmtl_cor_fil_cid19 "" UWORD _CNV_A_R_LINEAR_____168_CM 1 100. 0. 400. DISPLAY_IDENTIFIER M6_CUR_DMTL_COR_FIL_CID19 ECU_ADDRESS 0x3fdb1e BYTE_ORDER MSB_LAST FORMAT "%7.3" /end MEASUREMENT
/begin MEASUREMENT iso_m6_diag_ram_com.m6_cur_dmtl_dmtls_test "" UWORD _CNV_A_R_LINEAR_____168_CM 1 100. 0. 400. DISPLAY_IDENTIFIER M6_CUR_DMTL_DMTLS_TEST ECU_ADDRESS 0x3fdb22 BYTE_ORDER MSB_LAST FORMAT "%7.3" /end MEASUREMENT
/begin MEASUREMENT iso_m6_diag_ram_com.m6_cur_dmtl_thd_dmtls_test "" UWORD _CNV_A_R_LINEAR_____168_CM 1 100. 0. 400. DISPLAY_IDENTIFIER M6_CUR_DMTL_THD_DMTLS_TEST ECU_ADDRESS 0x3fdb24 BYTE_ORDER MSB_LAST FORMAT "%7.3" /end MEASUREMENT
/begin MEASUREMENT iso_m6_diag_ram_com.m6_cur_dmtl_rough_leak_end "" UWORD _CNV_A_R_LINEAR_____168_CM 1 100. 0. 400. DISPLAY_IDENTIFIER M6_CUR_DMTL_ROUGH_LEAK_END ECU_ADDRESS 0x3fdb26 BYTE_ORDER MSB_LAST FORMAT "%7.3" /end MEASUREMENT
/begin MEASUREMENT iso_m6_diag_ram_com.m6_cur_dmtl_thd_rough_leak "" UWORD _CNV_A_R_LINEAR_____168_CM 1 100. 0. 400. DISPLAY_IDENTIFIER M6_CUR_DMTL_THD_ROUGH_LEAK ECU_ADDRESS 0x3fdb28 BYTE_ORDER MSB_LAST FORMAT "%7.3" /end MEASUREMENT
/begin MEASUREMENT iso_m6_diag_ram_com.m6_cur_dmtl_small_leak_end "" UWORD _CNV_A_R_LINEAR_____168_CM 1 100. 0. 400. DISPLAY_IDENTIFIER M6_CUR_DMTL_SMALL_LEAK_END ECU_ADDRESS 0x3fdb2a BYTE_ORDER MSB_LAST FORMAT "%7.3" /end MEASUREMENT
/begin MEASUREMENT iso_m6_diag_ram_com.m6_cur_dmtl_ref_leak "" UWORD _CNV_A_R_LINEAR_____168_CM 1 100. 0. 400. DISPLAY_IDENTIFIER M6_CUR_DMTL_REF_LEAK ECU_ADDRESS 0x3fdb2c BYTE_ORDER MSB_LAST FORMAT "%7.3" /end MEASUREMENT
/begin MEASUREMENT iso_m6_diag_ram_com.m6_cur_dmtl_rough_leak_len_end "" UWORD _CNV_A_R_LINEAR_____168_CM 1 100. 0. 400. DISPLAY_IDENTIFIER M6_CUR_DMTL_ROUGH_LEAK_LEN_END ECU_ADDRESS 0x3fdb32 BYTE_ORDER MSB_LAST FORMAT "%7.3" /end MEASUREMENT
/begin MEASUREMENT iso_m6_diag_ram_com.m6_cur_dmtl_thd_rough_leak_len "" UWORD _CNV_A_R_LINEAR_____168_CM 1 100. 0. 400. DISPLAY_IDENTIFIER M6_CUR_DMTL_THD_ROUGH_LEAK_LEN ECU_ADDRESS 0x3fdb34 BYTE_ORDER MSB_LAST FORMAT "%7.3" /end MEASUREMENT
/begin MEASUREMENT iso_m6_diag_ram_com.m6_ctr_cnl_small_leak_mes "" UBYTE _CNV_A_R_LINEAR_____0_CM 1 100. 0. 255. DISPLAY_IDENTIFIER M6_CTR_CNL_SMALL_LEAK_MES ECU_ADDRESS 0x3fdb2e FORMAT "%3.0" /end MEASUREMENT
/begin CHARACTERISTIC c_abc_inc_ect_mec "Debounce counter increment - Thermostat heating diagnosis" VALUE 0xffe40568 _REC_VAL_20_u1 255. _CNV_A_R_LINEAR_____0_CM 0. 255. DISPLAY_IDENTIFIER C_ABC_INC_ECT_MEC FORMAT "%3.0" /end CHARACTERISTIC
/begin CHARACTERISTIC c_abc_max_ect_mec "Debounce counter maximum value - Thermostat heating diagnosis" VALUE 0xffe405dd _REC_VAL_20_u1 254. _CNV_A_R_LINEAR_____0_CM 1. 255. DISPLAY_IDENTIFIER C_ABC_MAX_ECT_MEC FORMAT "%3.0" /end CHARACTERISTIC
/begin MEASUREMENT lv_mu_inh_pwl_tran_es_el "LV request to shut off MU, POINT OF NO RETURN, for ECU shut down" UBYTE _CNV_S_2_RANGE______2_CM 1 100. 0. 1. DISPLAY_IDENTIFIER LV_MU_INH_PWL_TRAN_ES_EL ECU_ADDRESS 0x3fe69e /end MEASUREMENT
/begin MEASUREMENT lv_es "Engine operating state \"Engine stopped\"" UBYTE _CNV_S_2_RANGE______2_CM 1 100. 0. 1. DISPLAY_IDENTIFIER LV_ES ECU_ADDRESS 0x3fe79b BIT_MASK 0x1 /end MEASUREMENT
/begin MEASUREMENT lv_st "Engine operating state \"Start\"" UBYTE _CNV_S_2_RANGE______21_CM 1 100. 0. 1. DISPLAY_IDENTIFIER LV_ST ECU_ADDRESS 0x3fe79c BIT_MASK 0x1 /end MEASUREMENT
/begin MEASUREMENT lv_st_end "Engine operating state \"Start\" not active" UBYTE _CNV_S_2_RANGE______2_CM 1 100. 0. 1. DISPLAY_IDENTIFIER LV_ST_END ECU_ADDRESS 0x3fe79d BIT_MASK 0x1 /end MEASUREMENT
/begin CHARACTERISTIC ip_cyc_cast__tco "Cycle counter to define the duration of the start phase characterised by LV_ST" CURVE 0xffe49ec4 _REC_CUR_20_u2_u1 65535. _CNV_A_R_LINEAR_____0_CM 0. 65535. DISPLAY_IDENTIFIER IP_CYC_CAST__TCO FORMAT "%5.0"
 /begin AXIS_DESCR COM_AXIS tco _CNV_A_R_LINEAR_____11_CM 9 -48. 142.5 FORMAT "%5.1" AXIS_PTS_REF ldpm_tco_9 /end AXIS_DESCR
/end CHARACTERISTIC
/begin MEASUREMENT lv_is "Engine operating state \"Idle Speed\"" UBYTE _CNV_S_2_RANGE______2_CM 1 100. 0. 1. DISPLAY_IDENTIFIER LV_IS ECU_ADDRESS 0x3fe79e BIT_MASK 0x1 /end MEASUREMENT
/begin CHARACTERISTIC c_n_max_bol_st "Engine speed threshold to detect LV_ST or LV_PL from LV_IS" VALUE 0xffe407e4 _REC_VAL_20_u1 408. _CNV_A_R_LINEAR_____15_CM 0. 8160. DISPLAY_IDENTIFIER C_N_MAX_BOL_ST FORMAT "%4.0" /end CHARACTERISTIC
/begin MEASUREMENT lv_pl "Engine operating state „Part Load\"" UBYTE _CNV_S_2_RANGE______2_CM 1 100. 0. 1. DISPLAY_IDENTIFIER LV_PL ECU_ADDRESS 0x3fe79f BIT_MASK 0x1 /end MEASUREMENT
/begin MEASUREMENT lv_pu "Engine operating state \"Trailing throttle\"" UBYTE _CNV_S_2_RANGE______2_CM 1 100. 0. 1. DISPLAY_IDENTIFIER LV_PU ECU_ADDRESS 0x3fe7a0 BIT_MASK 0x1 /end MEASUREMENT
/begin MEASUREMENT t_pu "Time elapsed into LV_PU" UWORD _CNV_A_R_LINEAR_____4_CM 1 100. 0. 655.35 DISPLAY_IDENTIFIER T_PU ECU_ADDRESS 0x3fd87e BYTE_ORDER MSB_LAST FORMAT "%5.2" /end MEASUREMENT
/begin CHARACTERISTIC c_t_min_pu "Minimum delay time of PUC activation after entry of PU" VALUE 0xffe419b6 _REC_VAL_20_u2 655.35 _CNV_A_R_LINEAR_____4_CM 0. 655.35 DISPLAY_IDENTIFIER C_T_MIN_PU FORMAT "%6.2" /end CHARACTERISTIC
/begin CHARACTERISTIC c_t_max_pu "Maximum delay time of PUC activation after entry of PU" VALUE 0xffe4199e _REC_VAL_20_u2 655.35 _CNV_A_R_LINEAR_____4_CM 0. 655.35 DISPLAY_IDENTIFIER C_T_MAX_PU FORMAT "%6.2" /end CHARACTERISTIC
/begin CHARACTERISTIC lc_inh_dt_pu "Manual inhibition bit for deactivation drivetrain impact for controlling transition to PUC" VALUE 0xffe40f72 _REC_VAL_20_u1 1. _CNV_S_2_RANGE______2_CM 0. 1. DISPLAY_IDENTIFIER LC_INH_DT_PU /end CHARACTERISTIC
/begin CHARACTERISTIC c_t_min_pu_msr "Minimum delay time of PUC activation after MSR" VALUE 0xffe419b8 _REC_VAL_20_u2 655.35 _CNV_A_R_LINEAR_____4_CM 0. 655.35 DISPLAY_IDENTIFIER C_T_MIN_PU_MSR FORMAT "%6.2" /end CHARACTERISTIC
/begin CHARACTERISTIC c_t_min_pu_rng_l "Minimum delay time of PUC activation after entry of PU for LV_RNG_L =1" VALUE 0xffe419ba _REC_VAL_20_u2 655.35 _CNV_A_R_LINEAR_____4_CM 0. 655.35 DISPLAY_IDENTIFIER C_T_MIN_PU_RNG_L FORMAT "%6.2" /end CHARACTERISTIC
/begin MEASUREMENT lv_puc "engine operating state \"trailing throttle fuel cut off \"" UBYTE _CNV_S_2_RANGE______2_CM 1 100. 0. 1. DISPLAY_IDENTIFIER LV_PUC ECU_ADDRESS 0x3fe7a1 BIT_MASK 0x1 /end MEASUREMENT
/begin CHARACTERISTIC id_n_hys_max_puc__gr_at "Engine speed hysteresis set entering LV_PUC" CURVE 0xffe44184 _REC_CUR_20_u1_u1 8160. _CNV_A_R_LINEAR_____15_CM 0. 8160. DISPLAY_IDENTIFIER ID_N_HYS_MAX_PUC__GR_AT FORMAT "%4.0"
 /begin AXIS_DESCR COM_AXIS gr_at _CNV_A_R_LINEAR_____0_CM 13 0. 255. FORMAT "%3.0" AXIS_PTS_REF ldpm_gr_at_3 /end AXIS_DESCR
/end CHARACTERISTIC
/begin CHARACTERISTIC id_n_hys_max_puc__gr_mt "Engine speed hysteresis set entering LV_PUC" CURVE 0xffe44191 _REC_CUR_20_u1_u1 8160. _CNV_A_R_LINEAR_____15_CM 0. 8160. DISPLAY_IDENTIFIER ID_N_HYS_MAX_PUC__GR_MT FORMAT "%4.0"
 /begin AXIS_DESCR COM_AXIS gr_mt _CNV_A_R_LINEAR_____0_CM 13 0. 255. FORMAT "%3.0" AXIS_PTS_REF ldpm_gr_mt_3 /end AXIS_DESCR
/end CHARACTERISTIC
/begin CHARACTERISTIC id_n_hys_min_puc__gr_at "Engine speed hysteresis reset when C_CYCNR_HYS_PUC_xx achieved" CURVE 0xffe4419e _REC_CUR_20_u1_u1 8160. _CNV_A_R_LINEAR_____15_CM 0. 8160. DISPLAY_IDENTIFIER ID_N_HYS_MIN_PUC__GR_AT FORMAT "%4.0"
 /begin AXIS_DESCR COM_AXIS gr_at _CNV_A_R_LINEAR_____0_CM 13 0. 255. FORMAT "%3.0" AXIS_PTS_REF ldpm_gr_at_3 /end AXIS_DESCR
/end CHARACTERISTIC
/begin CHARACTERISTIC id_n_hys_min_puc__gr_mt "Engine speed hysteresis reset when C_CYCNR_HYS_PUC_xx achieved" CURVE 0xffe441ab _REC_CUR_20_u1_u1 8160. _CNV_A_R_LINEAR_____15_CM 0. 8160. DISPLAY_IDENTIFIER ID_N_HYS_MIN_PUC__GR_MT FORMAT "%4.0"
 /begin AXIS_DESCR COM_AXIS gr_mt _CNV_A_R_LINEAR_____0_CM 13 0. 255. FORMAT "%3.0" AXIS_PTS_REF ldpm_gr_mt_3 /end AXIS_DESCR
/end CHARACTERISTIC
/begin CHARACTERISTIC id_n_hys_puc_st__gr_at "Engine speed hysteresis set entering LV_PUC in cold condition" CURVE 0xffe441b8 _REC_CUR_20_u1_u1 8160. _CNV_A_R_LINEAR_____15_CM 0. 8160. DISPLAY_IDENTIFIER ID_N_HYS_PUC_ST__GR_AT FORMAT "%4.0"
 /begin AXIS_DESCR COM_AXIS gr_at _CNV_A_R_LINEAR_____0_CM 13 0. 255. FORMAT "%3.0" AXIS_PTS_REF ldpm_gr_at_3 /end AXIS_DESCR
/end CHARACTERISTIC
/begin CHARACTERISTIC id_n_hys_puc_st__gr_mt "Engine speed hysteresis set entering LV_PUC in cold condition" CURVE 0xffe441c5 _REC_CUR_20_u1_u1 8160. _CNV_A_R_LINEAR_____15_CM 0. 8160. DISPLAY_IDENTIFIER ID_N_HYS_PUC_ST__GR_MT FORMAT "%4.0"
 /begin AXIS_DESCR COM_AXIS gr_mt _CNV_A_R_LINEAR_____0_CM 13 0. 255. FORMAT "%3.0" AXIS_PTS_REF ldpm_gr_mt_3 /end AXIS_DESCR
/end CHARACTERISTIC
/begin CHARACTERISTIC c_cycnr_hys_puc "Cycle counter to reset the LV_PUC engine speed hysteresis " VALUE 0xffe415ac _REC_VAL_20_u2 655.35 _CNV_A_R_LINEAR_____185_CM 0. 65535. DISPLAY_IDENTIFIER C_CYCNR_HYS_PUC FORMAT "%5.0" /end CHARACTERISTIC
/begin CHARACTERISTIC c_cycnr_hys_puc_st "Cycle counter to reset the LV_PUC engine speed hysteresis in cold condition" VALUE 0xffe415ae _REC_VAL_20_u2 655.35 _CNV_A_R_LINEAR_____185_CM 0. 65535. DISPLAY_IDENTIFIER C_CYCNR_HYS_PUC_ST FORMAT "%5.0" /end CHARACTERISTIC
/begin CHARACTERISTIC c_tco_min_puc_st "Coolant temperature to select the LV_PUC engine speed hysteresis" VALUE 0xffe4091e _REC_VAL_20_u1 28.575 _CNV_A_R_LINEAR_____11_CM -48. 142.5 DISPLAY_IDENTIFIER C_TCO_MIN_PUC_ST FORMAT "%5.1" /end CHARACTERISTIC
/begin MEASUREMENT lv_puc_req "Engine operating state \"Trailing throttle\" for torque structure" UBYTE _CNV_S_2_RANGE______2_CM 1 100. 0. 1. DISPLAY_IDENTIFIER LV_PUC_REQ ECU_ADDRESS 0x3fe7a3 BIT_MASK 0x1 /end MEASUREMENT
/begin MEASUREMENT state_eng "" UBYTE _CNV_S_6_RANGE_STAT_186_CM 1 100. 0. 5. DISPLAY_IDENTIFIER STATE_ENG ECU_ADDRESS 0x3fe79a /end MEASUREMENT
/begin CHARACTERISTIC ip_n_min_puc__tco__gr_mt "LV_PUC engine speed threshold" MAP 0xffe46ddd _REC_MAP_20_u1_u1_u1 8160. _CNV_A_R_LINEAR_____15_CM 0. 8160. DISPLAY_IDENTIFIER IP_N_MIN_PUC__TCO__GR_MT FORMAT "%4.0"
 /begin AXIS_DESCR COM_AXIS tco _CNV_A_R_LINEAR_____11_CM 6 -48. 142.5 FORMAT "%5.1" AXIS_PTS_REF ldpm_tco_1_6 /end AXIS_DESCR
 /begin AXIS_DESCR COM_AXIS gr_mt _CNV_A_R_LINEAR_____0_CM 13 0. 255. FORMAT "%3.0" AXIS_PTS_REF ldpm_gr_mt_3 /end AXIS_DESCR
/end CHARACTERISTIC
/begin CHARACTERISTIC ip_n_accout_min_puc__tco__gr_mt "LV_PUC engine speed threshold with air conditioned compressor active" MAP 0xffe46d38 _REC_MAP_20_u1_u1_u1 8160. _CNV_A_R_LINEAR_____15_CM 0. 8160. DISPLAY_IDENTIFIER IP_N_ACCOUT_MIN_PUC__TCO__GR_MT FORMAT "%4.0"
 /begin AXIS_DESCR COM_AXIS tco _CNV_A_R_LINEAR_____11_CM 6 -48. 142.5 FORMAT "%5.1" AXIS_PTS_REF ldpm_tco_1_6 /end AXIS_DESCR
 /begin AXIS_DESCR COM_AXIS gr_mt _CNV_A_R_LINEAR_____0_CM 13 0. 255. FORMAT "%3.0" AXIS_PTS_REF ldpm_gr_mt_3 /end AXIS_DESCR
/end CHARACTERISTIC
/begin CHARACTERISTIC ip_n_accout_min_puc__tco__gr_at "LV_PUC engine speed threshold with air conditioned compressor active" MAP 0xffe46cea _REC_MAP_20_u1_u1_u1 8160. _CNV_A_R_LINEAR_____15_CM 0. 8160. DISPLAY_IDENTIFIER IP_N_ACCOUT_MIN_PUC__TCO__GR_AT FORMAT "%4.0"
 /begin AXIS_DESCR COM_AXIS tco _CNV_A_R_LINEAR_____11_CM 6 -48. 142.5 FORMAT "%5.1" AXIS_PTS_REF ldpm_tco_1_6 /end AXIS_DESCR
 /begin AXIS_DESCR COM_AXIS gr_at _CNV_A_R_LINEAR_____0_CM 13 0. 255. FORMAT "%3.0" AXIS_PTS_REF ldpm_gr_at_3 /end AXIS_DESCR
/end CHARACTERISTIC
/begin AXIS_PTS ldpm_tco_1_6 "" 0xffe41426 tco _REC_AXS_20_u1 28.575 _CNV_A_R_LINEAR_____11_CM 6 -48. 142.5 DISPLAY_IDENTIFIER LDPM_TCO_1_6 FORMAT "%5.1" /end AXIS_PTS
/begin AXIS_PTS ldpm_gr_mt_3 "" 0xffe483d0 gr_mt _REC_AXS_20_u1 255. _CNV_A_R_LINEAR_____0_CM 13 0. 255. DISPLAY_IDENTIFIER LDPM_GR_MT_3 FORMAT "%3.0" /end AXIS_PTS
/begin AXIS_PTS ldpm_gr_at_3 "" 0xffe483ab gr_at _REC_AXS_20_u1 255. _CNV_A_R_LINEAR_____0_CM 13 0. 255. DISPLAY_IDENTIFIER LDPM_GR_AT_3 FORMAT "%3.0" /end AXIS_PTS
/begin CHARACTERISTIC c_n_dif_ast "Additional engine speed hysteresis to avoid \"LV_PU\" direct after start" VALUE 0xffe417f2 _REC_VAL_20_u2 50. _CNV_A_R_LINEAR_____10_CM 0. 1000. DISPLAY_IDENTIFIER C_N_DIF_AST FORMAT "%4.0" /end CHARACTERISTIC
/begin CHARACTERISTIC c_t_n_dif_ast "Tme after start where C_N_DIF_AST is additional calculated to engine speed hysteresis" VALUE 0xffe419c0 _REC_VAL_20_u2 327.675 _CNV_A_R_LINEAR_____24_CM 0. 6553.5 DISPLAY_IDENTIFIER C_T_N_DIF_AST FORMAT "%6.1" /end CHARACTERISTIC
/begin AXIS_PTS ldp_tq_loss_ars_sp_can__puc "" 0xffe5148a tq_loss_ars_sp_can _REC_AXS_20_u2 2047.96875 _CNV_A_R_LINEAR_____187_CM 6 -1024. 1023.96875 DISPLAY_IDENTIFIER LDP_TQ_LOSS_ARS_SP_CAN__PUC FORMAT "%6.2" /end AXIS_PTS
/begin CHARACTERISTIC ip_n_min_puc__tco__gr_at "LV_PUC engine speed threshold" MAP 0xffe46d8f _REC_MAP_20_u1_u1_u1 8160. _CNV_A_R_LINEAR_____15_CM 0. 8160. DISPLAY_IDENTIFIER IP_N_MIN_PUC__TCO__GR_AT FORMAT "%4.0"
 /begin AXIS_DESCR COM_AXIS tco _CNV_A_R_LINEAR_____11_CM 6 -48. 142.5 FORMAT "%5.1" AXIS_PTS_REF ldpm_tco_1_6 /end AXIS_DESCR
 /begin AXIS_DESCR COM_AXIS gr_at _CNV_A_R_LINEAR_____0_CM 13 0. 255. FORMAT "%3.0" AXIS_PTS_REF ldpm_gr_at_3 /end AXIS_DESCR
/end CHARACTERISTIC
/begin CHARACTERISTIC ip_n_min_puc_add_ars "Additive term for reactivation engine speed" CURVE 0xffe40d63 _REC_CUR_20_u1_u2 8160. _CNV_A_R_LINEAR_____15_CM 0. 8160. DISPLAY_IDENTIFIER IP_N_MIN_PUC_ADD_ARS FORMAT "%4.0"
 /begin AXIS_DESCR COM_AXIS tq_loss_ars_sp_can _CNV_A_R_LINEAR_____187_CM 6 -1024. 1023.96875 FORMAT "%6.2" AXIS_PTS_REF ldp_tq_loss_ars_sp_can__puc /end AXIS_DESCR
/end CHARACTERISTIC
/begin AXIS_PTS ldpm_tco_9 "" 0xffe4861a tco _REC_AXS_20_u1 28.575 _CNV_A_R_LINEAR_____11_CM 9 -48. 142.5 DISPLAY_IDENTIFIER LDPM_TCO_9 FORMAT "%5.1" /end AXIS_PTS
/begin MEASUREMENT lv_iga_min_puc "Conditions for IGA_MIN_PUC" UBYTE _CNV_S_2_RANGE______2_CM 1 100. 0. 1. DISPLAY_IDENTIFIER LV_IGA_MIN_PUC ECU_ADDRESS 0x3fe7a2 BIT_MASK 0x1 /end MEASUREMENT
/begin CHARACTERISTIC c_t_min_pu_vs "Minimum delay time of PUC activation after entry of PU" VALUE 0xffe419bc _REC_VAL_20_u2 655.35 _CNV_A_R_LINEAR_____4_CM 0. 655.35 DISPLAY_IDENTIFIER C_T_MIN_PU_VS FORMAT "%6.2" /end CHARACTERISTIC
/begin AXIS_PTS ldp_n__t_min_pu "" 0xffe51012 n _REC_AXS_20_u2 8159. _CNV_A_R_LINEAR_____10_CM 8 1. 8160. DISPLAY_IDENTIFIER LDP_N__T_MIN_PU FORMAT "%4.0" /end AXIS_PTS
/begin AXIS_PTS ldp_tco__t_min_pu "" 0xffe411e5 tco _REC_AXS_20_u1 190.5 _CNV_A_R_LINEAR_____11_CM 6 -48. 142.5 DISPLAY_IDENTIFIER LDP_TCO__T_MIN_PU FORMAT "%5.1" /end AXIS_PTS
/begin CHARACTERISTIC c_vs_min_pu "Threshold for vehicle speed for loading T_PU" VALUE 0xffe409e6 _REC_VAL_20_u1 12.75 _CNV_A_R_LINEAR_____23_CM 0. 255. DISPLAY_IDENTIFIER C_VS_MIN_PU FORMAT "%3.0" /end CHARACTERISTIC
/begin CHARACTERISTIC ip_t_min_pu__n__tco "Minimum delay time of PUC activation" MAP 0xffe4eab2 _REC_MAP_20_u2_u2_u1 655.35 _CNV_A_R_LINEAR_____4_CM 0. 655.35 DISPLAY_IDENTIFIER IP_T_MIN_PU__N__TCO FORMAT "%6.2"
 /begin AXIS_DESCR COM_AXIS n _CNV_A_R_LINEAR_____10_CM 8 1. 8160. FORMAT "%4.0" AXIS_PTS_REF ldp_n__t_min_pu /end AXIS_DESCR
 /begin AXIS_DESCR COM_AXIS tco _CNV_A_R_LINEAR_____11_CM 6 -48. 142.5 FORMAT "%5.1" AXIS_PTS_REF ldp_tco__t_min_pu /end AXIS_DESCR
/end CHARACTERISTIC
/begin CHARACTERISTIC ip_t_min_pu_rng_l__n__tco "Minimum delay time of PUC activation" MAP 0xffe4eb12 _REC_MAP_20_u2_u2_u1 655.35 _CNV_A_R_LINEAR_____4_CM 0. 655.35 DISPLAY_IDENTIFIER IP_T_MIN_PU_RNG_L__N__TCO FORMAT "%6.2"
 /begin AXIS_DESCR COM_AXIS n _CNV_A_R_LINEAR_____10_CM 8 1. 8160. FORMAT "%4.0" AXIS_PTS_REF ldp_n__t_min_pu /end AXIS_DESCR
 /begin AXIS_DESCR COM_AXIS tco _CNV_A_R_LINEAR_____11_CM 6 -48. 142.5 FORMAT "%5.1" AXIS_PTS_REF ldp_tco__t_min_pu /end AXIS_DESCR
/end CHARACTERISTIC
/begin AXIS_PTS ldp_n_grd_n_dif_max_is "" 0xffe41135 n_grd _REC_AXS_20_u1 8160. _CNV_A_R_LINEAR_____54_CM 6 -4096. 4064. DISPLAY_IDENTIFIER LDP_N_GRD_N_DIF_MAX_IS FORMAT "%5.0" /end AXIS_PTS
/begin CHARACTERISTIC ip_n_dif_max_is "Engine speed hysteresis before \"Idle speed\" (LV_IS)" CURVE 0xffe4d67a _REC_CUR_20_u2_u1 8160. _CNV_A_R_LINEAR_____10_CM 0. 8160. DISPLAY_IDENTIFIER IP_N_DIF_MAX_IS FORMAT "%4.0"
 /begin AXIS_DESCR COM_AXIS n_grd _CNV_A_R_LINEAR_____54_CM 6 -4096. 4064. FORMAT "%5.0" AXIS_PTS_REF ldp_n_grd_n_dif_max_is /end AXIS_DESCR
/end CHARACTERISTIC
/begin CHARACTERISTIC lc_abc_bench "logical constant to manage the anti-bounce bench mode" VALUE 0xffe40f17 _REC_VAL_20_u1 1. _CNV_A_R_LINEAR_____0_CM 0. 1. DISPLAY_IDENTIFIER LC_ABC_BENCH FORMAT "%2.0" /end CHARACTERISTIC
/begin CHARACTERISTIC lc_err_det_upd "logical constant to manage some functionality as the visualisation of the sporadic error" VALUE 0xffe40f62 _REC_VAL_20_u1 1. _CNV_A_R_LINEAR_____0_CM 0. 1. DISPLAY_IDENTIFIER LC_ERR_DET_UPD FORMAT "%2.0" /end CHARACTERISTIC
/begin MEASUREMENT state_diag_gs "Status of GS diagnosis for feedback to gearbox" UBYTE _CNV_A_R_LINEAR_____0_CM 1 100. 0. 255. DISPLAY_IDENTIFIER STATE_DIAG_GS ECU_ADDRESS 0x3fea07 FORMAT "%3.0" /end MEASUREMENT
/begin MEASUREMENT lv_err_gs "Boolean for error currently present on GS" UBYTE _CNV_S_2_RANGE______1_R_CM 1 100. 0. 255. DISPLAY_IDENTIFIER LV_ERR_GS ECU_ADDRESS 0x3fbb28 /end MEASUREMENT
/begin CHARACTERISTIC lc_var_gs_eobd "Logical constant for variant EOBD (=1) or US (=0)" VALUE 0xffe41006 _REC_VAL_20_u1 1. _CNV_A_R_LINEAR_____0_CM 0. 1. DISPLAY_IDENTIFIER LC_VAR_GS_EOBD FORMAT "%2.0" /end CHARACTERISTIC
/begin CHARACTERISTIC c_abc_max_td_igc_cut "Maximum value of anti-bounce counter for the ignition system diagnosis to switch off the coil" VALUE 0xffe40608 _REC_VAL_20_u1 254. _CNV_A_R_LINEAR_____0_CM 1. 255. DISPLAY_IDENTIFIER C_ABC_MAX_TD_IGC_CUT FORMAT "%3.0" /end CHARACTERISTIC
/begin CHARACTERISTIC c_abc_inc_v_dur_igc "Debounce counter increment" VALUE 0xffe405b4 _REC_VAL_20_u1 255. _CNV_A_R_LINEAR_____0_CM 0. 255. DISPLAY_IDENTIFIER C_ABC_INC_V_DUR_IGC FORMAT "%3.0" /end CHARACTERISTIC
/begin CHARACTERISTIC c_abc_max_v_dur_igc "Debounce counter maximum" VALUE 0xffe40622 _REC_VAL_20_u1 254. _CNV_A_R_LINEAR_____0_CM 1. 255. DISPLAY_IDENTIFIER C_ABC_MAX_V_DUR_IGC FORMAT "%3.0" /end CHARACTERISTIC
/begin CHARACTERISTIC c_abc_inc_td_igc_cut "Anti-bounce counter increment for the ignition system diagnosis 1/720°CRK" VALUE 0xffe40596 _REC_VAL_20_u1 255. _CNV_A_R_LINEAR_____0_CM 0. 255. DISPLAY_IDENTIFIER C_ABC_INC_TD_IGC_CUT FORMAT "%3.0" /end CHARACTERISTIC
/begin CHARACTERISTIC c_abc_max_ref_ivvt "Debounce counter maximum value - VANOS diagnosis magnetic valves" VALUE 0xffe405ff _REC_VAL_20_u1 254. _CNV_A_R_LINEAR_____0_CM 1. 255. DISPLAY_IDENTIFIER C_ABC_MAX_REF_IVVT FORMAT "%3.0" /end CHARACTERISTIC
/begin CHARACTERISTIC c_abc_inc_ref_ivvt "Debounce counter increment - VANOS diagnosis magnetic valve CAM_IN" VALUE 0xffe4058d _REC_VAL_20_u1 255. _CNV_A_R_LINEAR_____0_CM 0. 255. DISPLAY_IDENTIFIER C_ABC_INC_REF_IVVT FORMAT "%3.0" /end CHARACTERISTIC
/begin CHARACTERISTIC c_abc_inc_knks_diag "Debounce counter increment - knock sensor diagnosis" VALUE 0xffe40577 _REC_VAL_20_u1 255. _CNV_A_R_LINEAR_____0_CM 0. 255. DISPLAY_IDENTIFIER C_ABC_INC_KNKS_DIAG FORMAT "%3.0" /end CHARACTERISTIC
/begin CHARACTERISTIC c_abc_max_knks_diag "Debounce counter maximum value - knock sensor diagnosis" VALUE 0xffe405ea _REC_VAL_20_u1 254. _CNV_A_R_LINEAR_____0_CM 1. 255. DISPLAY_IDENTIFIER C_ABC_MAX_KNKS_DIAG FORMAT "%3.0" /end CHARACTERISTIC
/begin MEASUREMENT lam_bank_1.ls_down_diag.t_dly_vls_down_min_cold "Delay time for final diagnosis activation" UWORD _CNV_A_R_LINEAR_____24_CM 1 100. 0. 6553.5 DISPLAY_IDENTIFIER T_DLY_VLS_DOWN_MIN_COLD_1 ECU_ADDRESS 0x3fc440 BYTE_ORDER MSB_LAST FORMAT "%5.1" /end MEASUREMENT
/begin MEASUREMENT lam_bank_1.ls_down_diag.t_diag_vls_down_min_cold "Maximum activation time for diagnosis activation" UWORD _CNV_A_R_LINEAR_____24_CM 1 100. 0. 6553.5 DISPLAY_IDENTIFIER T_DIAG_VLS_DOWN_MIN_COLD_1 ECU_ADDRESS 0x3fc442 BYTE_ORDER MSB_LAST FORMAT "%5.1" /end MEASUREMENT
/begin MEASUREMENT lam_bank_1.ls_down_diag.t_dly_vls_down_min "Delay time for final diagnosis activation" UWORD _CNV_A_R_LINEAR_____24_CM 1 100. 0. 6553.5 DISPLAY_IDENTIFIER T_DLY_VLS_DOWN_MIN_1 ECU_ADDRESS 0x3fc44c BYTE_ORDER MSB_LAST FORMAT "%5.1" /end MEASUREMENT
/begin MEASUREMENT lam_bank_1.ls_down_diag.t_dly_vls_down_oc "Delay time for final diagnosis activation" UWORD _CNV_A_R_LINEAR_____24_CM 1 100. 0. 6553.5 DISPLAY_IDENTIFIER T_DLY_VLS_DOWN_OC_1 ECU_ADDRESS 0x3fc44e BYTE_ORDER MSB_LAST FORMAT "%5.1" /end MEASUREMENT
/begin MEASUREMENT lam_bank_1.ls_down_diag.bf.lv_req_chk_ls_down "Request for starting the downstream sensor active plausibility check" ULONG _CNV_S_2_RANGE______2_CM 1 100. 0. 1. DISPLAY_IDENTIFIER LV_REQ_CHK_LS_DOWN_1 ECU_ADDRESS 0x3fc43c BYTE_ORDER MSB_LAST BIT_MASK 0x80000000 /end MEASUREMENT
/begin MEASUREMENT lam_bank_1.ls_down_diag.t_err_cdn_vls_down_min "Detection time for status MIN before diagnosis" UWORD _CNV_A_R_LINEAR_____24_CM 1 100. 0. 6553.5 DISPLAY_IDENTIFIER T_ERR_CDN_VLS_DOWN_MIN_1 ECU_ADDRESS 0x3fc444 BYTE_ORDER MSB_LAST FORMAT "%5.1" /end MEASUREMENT
/begin MEASUREMENT lam_bank_1.ls_down_diag.t_err_cdn_vls_down_oc "Detection time for status OC for diagnosis" UWORD _CNV_A_R_LINEAR_____24_CM 1 100. 0. 6553.5 DISPLAY_IDENTIFIER T_ERR_CDN_VLS_DOWN_OC_1 ECU_ADDRESS 0x3fc446 BYTE_ORDER MSB_LAST FORMAT "%5.1" /end MEASUREMENT
/begin MEASUREMENT lam_bank_1.ls_down_diag.t_end_diag_vls_down_min "Timer for setting LV_END_DIAG_VLS_DOWN_MIN" UWORD _CNV_A_R_LINEAR_____24_CM 1 100. 0. 6553.5 DISPLAY_IDENTIFIER T_END_DIAG_VLS_DOWN_MIN_1 ECU_ADDRESS 0x3fc448 BYTE_ORDER MSB_LAST FORMAT "%5.1" /end MEASUREMENT
/begin MEASUREMENT lam_bank_1.ls_down_diag.t_end_diag_vls_down_oc "Timer for setting LV_END_DIAG_VLS_DOWN_OC" UWORD _CNV_A_R_LINEAR_____24_CM 1 100. 0. 6553.5 DISPLAY_IDENTIFIER T_END_DIAG_VLS_DOWN_OC_1 ECU_ADDRESS 0x3fc44a BYTE_ORDER MSB_LAST FORMAT "%5.1" /end MEASUREMENT
/begin MEASUREMENT lam_bank_1.ls_down_diag_inci.bf.lv_inh_diag_vls_down_min "Boolean flag indicating project specific application conditions for downstream SCG diagnosis not met" ULONG _CNV_S_2_RANGE______2_CM 1 100. 0. 1. DISPLAY_IDENTIFIER LV_INH_DIAG_VLS_DOWN_MIN_1 ECU_ADDRESS 0x3fc450 BYTE_ORDER MSB_LAST BIT_MASK 0x80000000 /end MEASUREMENT
/begin MEASUREMENT lam_bank_1.ls_down_diag_inci.bf.lv_inh_diag_vls_down_max "Boolean flag indicating project specific application conditions for downstream short to plus diagnosis not met" ULONG _CNV_S_2_RANGE______2_CM 1 100. 0. 1. DISPLAY_IDENTIFIER LV_INH_DIAG_VLS_DOWN_MAX_1 ECU_ADDRESS 0x3fc450 BYTE_ORDER MSB_LAST BIT_MASK 0x40000000 /end MEASUREMENT
/begin MEASUREMENT lam_bank_1.ls_down_diag_inci.bf.lv_inh_diag_vls_down_oc "Boolean flag indicating project specific application conditions for downstream open line diagnosis not met" ULONG _CNV_S_2_RANGE______2_CM 1 100. 0. 1. DISPLAY_IDENTIFIER LV_INH_DIAG_VLS_DOWN_OC_1 ECU_ADDRESS 0x3fc450 BYTE_ORDER MSB_LAST BIT_MASK 0x20000000 /end MEASUREMENT
/begin MEASUREMENT lam_bank_1.ls_down_diag_inci.bf.lv_inh_diag_vls_down_puc "Boolean flag indicating project specific application conditions for downstream PUC diagnosis not met" ULONG _CNV_S_2_RANGE______2_CM 1 100. 0. 1. DISPLAY_IDENTIFIER LV_INH_DIAG_VLS_DOWN_PUC_1 ECU_ADDRESS 0x3fc450 BYTE_ORDER MSB_LAST BIT_MASK 0x10000000 /end MEASUREMENT
/begin MEASUREMENT lam_bank_1.ls_down_diag_inci.bf.lv_inh_diag_vls_down_min_cold "Boolean flag indicating project specific application conditions for downstream SCG (Cold test) diagnosis not met" ULONG _CNV_S_2_RANGE______2_CM 1 100. 0. 1. DISPLAY_IDENTIFIER LV_INH_DIAG_VLS_DOWN_MIN_COLD_1 ECU_ADDRESS 0x3fc450 BYTE_ORDER MSB_LAST BIT_MASK 0x4000000 /end MEASUREMENT
/begin MEASUREMENT lam_bank_1.ls_down_diag_inci.bf.lv_inh_diag_vls_down_fl "Boolean flag indicating project specific application conditions for downstream FL diagnosis not met" ULONG _CNV_S_2_RANGE______2_CM 1 100. 0. 1. DISPLAY_IDENTIFIER LV_INH_DIAG_VLS_DOWN_FL_1 ECU_ADDRESS 0x3fc450 BYTE_ORDER MSB_LAST BIT_MASK 0x8000000 /end MEASUREMENT
/begin MEASUREMENT lam_bank_1.ls_ctl_diag_inci.bf.lv_inh_diag_if_lsl "Inhibit diagnosis" ULONG _CNV_S_2_RANGE______2_CM 1 100. 0. 1. DISPLAY_IDENTIFIER LV_INH_DIAG_IF_LSL_1 ECU_ADDRESS 0x3fc62c BYTE_ORDER MSB_LAST BIT_MASK 0x80000000 /end MEASUREMENT
/begin MEASUREMENT lam_bank_1.ls_ctl_diag.ctr_err_lsl_if_spi_wr_save "Number of communication errors during the WRAF sensor controller initialization" UBYTE _CNV_A_R_LINEAR_____0_CM 1 100. 0. 255. DISPLAY_IDENTIFIER CTR_ERR_LSL_IF_SPI_WR_SAVE_1 ECU_ADDRESS 0x3fc624 FORMAT "%3.0" /end MEASUREMENT
/begin MEASUREMENT lam_bank_2.ls_down_diag.t_dly_vls_down_min_cold "Delay time for final diagnosis activation" UWORD _CNV_A_R_LINEAR_____24_CM 1 100. 0. 6553.5 DISPLAY_IDENTIFIER T_DLY_VLS_DOWN_MIN_COLD_2 ECU_ADDRESS 0x3fc8f8 BYTE_ORDER MSB_LAST FORMAT "%5.1" /end MEASUREMENT
/begin MEASUREMENT lam_bank_2.ls_down_diag.t_diag_vls_down_min_cold "Maximum activation time for diagnosis activation" UWORD _CNV_A_R_LINEAR_____24_CM 1 100. 0. 6553.5 DISPLAY_IDENTIFIER T_DIAG_VLS_DOWN_MIN_COLD_2 ECU_ADDRESS 0x3fc8fa BYTE_ORDER MSB_LAST FORMAT "%5.1" /end MEASUREMENT
/begin MEASUREMENT lam_bank_2.ls_down_diag.t_dly_vls_down_min "Delay time for final diagnosis activation" UWORD _CNV_A_R_LINEAR_____24_CM 1 100. 0. 6553.5 DISPLAY_IDENTIFIER T_DLY_VLS_DOWN_MIN_2 ECU_ADDRESS 0x3fc904 BYTE_ORDER MSB_LAST FORMAT "%5.1" /end MEASUREMENT
/begin MEASUREMENT lam_bank_2.ls_down_diag.t_dly_vls_down_oc "Delay time for final diagnosis activation" UWORD _CNV_A_R_LINEAR_____24_CM 1 100. 0. 6553.5 DISPLAY_IDENTIFIER T_DLY_VLS_DOWN_OC_2 ECU_ADDRESS 0x3fc906 BYTE_ORDER MSB_LAST FORMAT "%5.1" /end MEASUREMENT
/begin MEASUREMENT lam_bank_2.ls_down_diag.bf.lv_req_chk_ls_down "Request for starting the downstream sensor active plausibility check" ULONG _CNV_S_2_RANGE______2_CM 1 100. 0. 1. DISPLAY_IDENTIFIER LV_REQ_CHK_LS_DOWN_2 ECU_ADDRESS 0x3fc8f4 BYTE_ORDER MSB_LAST BIT_MASK 0x80000000 /end MEASUREMENT
/begin MEASUREMENT lam_bank_2.ls_down_diag.t_err_cdn_vls_down_min "Detection time for status MIN before diagnosis" UWORD _CNV_A_R_LINEAR_____24_CM 1 100. 0. 6553.5 DISPLAY_IDENTIFIER T_ERR_CDN_VLS_DOWN_MIN_2 ECU_ADDRESS 0x3fc8fc BYTE_ORDER MSB_LAST FORMAT "%5.1" /end MEASUREMENT
/begin MEASUREMENT lam_bank_2.ls_down_diag.t_err_cdn_vls_down_oc "Detection time for status OC for diagnosis" UWORD _CNV_A_R_LINEAR_____24_CM 1 100. 0. 6553.5 DISPLAY_IDENTIFIER T_ERR_CDN_VLS_DOWN_OC_2 ECU_ADDRESS 0x3fc8fe BYTE_ORDER MSB_LAST FORMAT "%5.1" /end MEASUREMENT
/begin MEASUREMENT lam_bank_2.ls_down_diag.t_end_diag_vls_down_min "Timer for setting LV_END_DIAG_VLS_DOWN_MIN" UWORD _CNV_A_R_LINEAR_____24_CM 1 100. 0. 6553.5 DISPLAY_IDENTIFIER T_END_DIAG_VLS_DOWN_MIN_2 ECU_ADDRESS 0x3fc900 BYTE_ORDER MSB_LAST FORMAT "%5.1" /end MEASUREMENT
/begin MEASUREMENT lam_bank_2.ls_down_diag.t_end_diag_vls_down_oc "Timer for setting LV_END_DIAG_VLS_DOWN_OC" UWORD _CNV_A_R_LINEAR_____24_CM 1 100. 0. 6553.5 DISPLAY_IDENTIFIER T_END_DIAG_VLS_DOWN_OC_2 ECU_ADDRESS 0x3fc902 BYTE_ORDER MSB_LAST FORMAT "%5.1" /end MEASUREMENT
/begin MEASUREMENT lam_bank_2.ls_down_diag_inci.bf.lv_inh_diag_vls_down_min "Boolean flag indicating project specific application conditions for downstream SCG diagnosis not met" ULONG _CNV_S_2_RANGE______2_CM 1 100. 0. 1. DISPLAY_IDENTIFIER LV_INH_DIAG_VLS_DOWN_MIN_2 ECU_ADDRESS 0x3fc908 BYTE_ORDER MSB_LAST BIT_MASK 0x80000000 /end MEASUREMENT
/begin MEASUREMENT lam_bank_2.ls_down_diag_inci.bf.lv_inh_diag_vls_down_max "Boolean flag indicating project specific application conditions for downstream short to plus diagnosis not met" ULONG _CNV_S_2_RANGE______2_CM 1 100. 0. 1. DISPLAY_IDENTIFIER LV_INH_DIAG_VLS_DOWN_MAX_2 ECU_ADDRESS 0x3fc908 BYTE_ORDER MSB_LAST BIT_MASK 0x40000000 /end MEASUREMENT
/begin MEASUREMENT lam_bank_2.ls_down_diag_inci.bf.lv_inh_diag_vls_down_oc "Boolean flag indicating project specific application conditions for downstream open line diagnosis not met" ULONG _CNV_S_2_RANGE______2_CM 1 100. 0. 1. DISPLAY_IDENTIFIER LV_INH_DIAG_VLS_DOWN_OC_2 ECU_ADDRESS 0x3fc908 BYTE_ORDER MSB_LAST BIT_MASK 0x20000000 /end MEASUREMENT
/begin MEASUREMENT lam_bank_2.ls_down_diag_inci.bf.lv_inh_diag_vls_down_puc "Boolean flag indicating project specific application conditions for downstream PUC diagnosis not met" ULONG _CNV_S_2_RANGE______2_CM 1 100. 0. 1. DISPLAY_IDENTIFIER LV_INH_DIAG_VLS_DOWN_PUC_2 ECU_ADDRESS 0x3fc908 BYTE_ORDER MSB_LAST BIT_MASK 0x10000000 /end MEASUREMENT
/begin MEASUREMENT lam_bank_2.ls_down_diag_inci.bf.lv_inh_diag_vls_down_min_cold "Boolean flag indicating project specific application conditions for downstream SCG (Cold test) diagnosis not met" ULONG _CNV_S_2_RANGE______2_CM 1 100. 0. 1. DISPLAY_IDENTIFIER LV_INH_DIAG_VLS_DOWN_MIN_COLD_2 ECU_ADDRESS 0x3fc908 BYTE_ORDER MSB_LAST BIT_MASK 0x4000000 /end MEASUREMENT
/begin MEASUREMENT lam_bank_2.ls_down_diag_inci.bf.lv_inh_diag_vls_down_fl "Boolean flag indicating project specific application conditions for downstream FL diagnosis not met" ULONG _CNV_S_2_RANGE______2_CM 1 100. 0. 1. DISPLAY_IDENTIFIER LV_INH_DIAG_VLS_DOWN_FL_2 ECU_ADDRESS 0x3fc908 BYTE_ORDER MSB_LAST BIT_MASK 0x8000000 /end MEASUREMENT
/begin MEASUREMENT lam_bank_2.ls_ctl_diag_inci.bf.lv_inh_diag_if_lsl "Inhibit diagnosis" ULONG _CNV_S_2_RANGE______2_CM 1 100. 0. 1. DISPLAY_IDENTIFIER LV_INH_DIAG_IF_LSL_2 ECU_ADDRESS 0x3fcae4 BYTE_ORDER MSB_LAST BIT_MASK 0x80000000 /end MEASUREMENT
/begin MEASUREMENT lam_bank_2.ls_ctl_diag.ctr_err_lsl_if_spi_wr_save "Number of communication errors during the WRAF sensor controller initialization" UBYTE _CNV_A_R_LINEAR_____0_CM 1 100. 0. 255. DISPLAY_IDENTIFIER CTR_ERR_LSL_IF_SPI_WR_SAVE_2 ECU_ADDRESS 0x3fcadc FORMAT "%3.0" /end MEASUREMENT
/begin MEASUREMENT lv_err_vls_down_1 "General error flag for Lambda downstream sensors" UBYTE _CNV_S_2_RANGE______21_CM 1 100. 0. 1. DISPLAY_IDENTIFIER LV_ERR_VLS_DOWN_1 ECU_ADDRESS 0x3fe521 BIT_MASK 0x1 /end MEASUREMENT
/begin MEASUREMENT lv_err_vls_down_2 "General error flag for Lambda downstream sensors" UBYTE _CNV_S_2_RANGE______21_CM 1 100. 0. 1. DISPLAY_IDENTIFIER LV_ERR_VLS_DOWN_2 ECU_ADDRESS 0x3fe522 BIT_MASK 0x1 /end MEASUREMENT
/begin CHARACTERISTIC c_r_down_ls_max_vls_down_min "Maximum resistance threshold oxygen sensor internal resistance during short to ground sensor" VALUE 0xffe41890 _REC_VAL_20_u2 65535. _CNV_A_R_LINEAR_____309_CM 0. 65535. DISPLAY_IDENTIFIER C_R_DOWN_LS_MAX_VLS_DOWN_MIN FORMAT "%5.0" /end CHARACTERISTIC
/begin CHARACTERISTIC c_maf_kgh_min_vls_down_min "Minimum duration required for continious low VLS_DOWN_i detection" VALUE 0xffe417aa _REC_VAL_20_u2 2047.96875 _CNV_A_R_LINEAR_____115_CM 0. 2047.96875 DISPLAY_IDENTIFIER C_MAF_KGH_MIN_VLS_DOWN_MIN FORMAT "%7.2" /end CHARACTERISTIC
/begin CHARACTERISTIC c_vls_down_min_diag "Oxygen sensor voltage threshold under which short to GND may be present" VALUE 0xffe41b5e _REC_VAL_20_u2 4.99511719 _CNV_A_R_LINEAR_____3_CM 0. 4.99511719 DISPLAY_IDENTIFIER C_VLS_DOWN_MIN_DIAG FORMAT "%5.3" /end CHARACTERISTIC
/begin CHARACTERISTIC c_vls_down_max_diag "Oxygen sensor voltage threshold over which short to Vbatt present" VALUE 0xffe41b5a _REC_VAL_20_u2 4.99511719 _CNV_A_R_LINEAR_____3_CM 0. 4.99511719 DISPLAY_IDENTIFIER C_VLS_DOWN_MAX_DIAG FORMAT "%5.3" /end CHARACTERISTIC
/begin CHARACTERISTIC c_vls_down_afl_diag "Oxygen sensor voltage-lean mixture threshold for diagnosis" VALUE 0xffe41b42 _REC_VAL_20_u2 4.99511719 _CNV_A_R_LINEAR_____3_CM 0. 4.99511719 DISPLAY_IDENTIFIER C_VLS_DOWN_AFL_DIAG FORMAT "%5.3" /end CHARACTERISTIC
/begin CHARACTERISTIC c_vls_down_afr_diag "Oxygen sensor voltage-rich mixture threshold for diagnosis" VALUE 0xffe41b46 _REC_VAL_20_u2 4.99511719 _CNV_A_R_LINEAR_____3_CM 0. 4.99511719 DISPLAY_IDENTIFIER C_VLS_DOWN_AFR_DIAG FORMAT "%5.3" /end CHARACTERISTIC
/begin CHARACTERISTIC c_abc_max_vls_down_max "Debounce counter maximum for short to plus electrical check" VALUE 0xffe40626 _REC_VAL_20_u1 254. _CNV_A_R_LINEAR_____0_CM 1. 255. DISPLAY_IDENTIFIER C_ABC_MAX_VLS_DOWN_MAX FORMAT "%3.0" /end CHARACTERISTIC
/begin CHARACTERISTIC c_abc_inc_vls_down_max "Debounce counter increment for short to plus electrical check" VALUE 0xffe405b8 _REC_VAL_20_u1 255. _CNV_A_R_LINEAR_____0_CM 0. 255. DISPLAY_IDENTIFIER C_ABC_INC_VLS_DOWN_MAX FORMAT "%3.0" /end CHARACTERISTIC
/begin CHARACTERISTIC c_r_down_min_vls_down_oc "Minimum resistance threshold oxygen sensor internal resistance during open circuit sensor" VALUE 0xffe41892 _REC_VAL_20_u2 65535. _CNV_A_R_LINEAR_____309_CM 0. 65535. DISPLAY_IDENTIFIER C_R_DOWN_MIN_VLS_DOWN_OC FORMAT "%5.0" /end CHARACTERISTIC
/begin CHARACTERISTIC c_t_dly_vls_down_min "Minimum duration required for low VLS_DOWN_i detection" VALUE 0xffe41938 _REC_VAL_20_u2 6553.5 _CNV_A_R_LINEAR_____24_CM 0. 6553.5 DISPLAY_IDENTIFIER C_T_DLY_VLS_DOWN_MIN FORMAT "%5.1" /end CHARACTERISTIC
/begin CHARACTERISTIC c_t_es_dew_vls_down_min_cold "Minimum required ES time for short to ground diagnosis (Cold - test)" VALUE 0xffe41968 _REC_VAL_20_u2 65535. _CNV_A_R_LINEAR_____97_CM 0. 65535. DISPLAY_IDENTIFIER C_T_ES_DEW_VLS_DOWN_MIN_COLD FORMAT "%5.0" /end CHARACTERISTIC
/begin CHARACTERISTIC c_t_diag_vls_down_min_cold "Maximum activation time for diagnosis activation (Cold - test)" VALUE 0xffe418fe _REC_VAL_20_u2 6553.5 _CNV_A_R_LINEAR_____24_CM 0. 6553.5 DISPLAY_IDENTIFIER C_T_DIAG_VLS_DOWN_MIN_COLD FORMAT "%5.1" /end CHARACTERISTIC
/begin CHARACTERISTIC c_t_dly_vls_down_min_cold "Minimum required delay after ST for activation of short to ground diagnosis (Cold - test)" VALUE 0xffe4193a _REC_VAL_20_u2 6553.5 _CNV_A_R_LINEAR_____24_CM 0. 6553.5 DISPLAY_IDENTIFIER C_T_DLY_VLS_DOWN_MIN_COLD FORMAT "%5.1" /end CHARACTERISTIC
/begin CHARACTERISTIC c_t_dly_vls_down_oc "Minimum resistance threshold oxygen sensor internal resistance during open circuit sensor" VALUE 0xffe4193c _REC_VAL_20_u2 6553.5 _CNV_A_R_LINEAR_____24_CM 0. 6553.5 DISPLAY_IDENTIFIER C_T_DLY_VLS_DOWN_OC FORMAT "%5.1" /end CHARACTERISTIC
/begin CHARACTERISTIC c_teg_cat_down_mdl_vls_down_oc "Minimum requested exhaust gas temperature for diagnosis" VALUE 0xffe41a3e _REC_VAL_20_u2 2047. _CNV_A_R_LINEAR_____6_CM 0. 2047. DISPLAY_IDENTIFIER C_TEG_CAT_DOWN_MDL_VLS_DOWN_OC FORMAT "%7.2" /end CHARACTERISTIC
/begin CHARACTERISTIC c_abc_inc_vls_down_min_cold "Debounce counter increment for short to ground electrical check" VALUE 0xffe405b9 _REC_VAL_20_u1 255. _CNV_A_R_LINEAR_____0_CM 0. 255. DISPLAY_IDENTIFIER C_ABC_INC_VLS_DOWN_MIN_COLD FORMAT "%3.0" /end CHARACTERISTIC
/begin CHARACTERISTIC c_abc_max_vls_down_min_cold "Debounce counter maximum for short to ground electrical check" VALUE 0xffe40627 _REC_VAL_20_u1 254. _CNV_A_R_LINEAR_____0_CM 1. 255. DISPLAY_IDENTIFIER C_ABC_MAX_VLS_DOWN_MIN_COLD FORMAT "%3.0" /end CHARACTERISTIC
/begin MEASUREMENT lv_err_vls_down_min_2 "Boolean error flag, short to ground fault currently present on downstream oxygen sensor signal" UBYTE _CNV_S_2_RANGE______21_CM 1 100. 0. 1. DISPLAY_IDENTIFIER LV_ERR_VLS_DOWN_MIN_2 ECU_ADDRESS 0x3fb820 BIT_MASK 0x1 /end MEASUREMENT
/begin MEASUREMENT lv_err_vls_down_max_2 "Boolean error flag, short to plus fault currently present on downstream oxygen sensor signal" UBYTE _CNV_S_2_RANGE______21_CM 1 100. 0. 1. DISPLAY_IDENTIFIER LV_ERR_VLS_DOWN_MAX_2 ECU_ADDRESS 0x3fb810 BIT_MASK 0x1 /end MEASUREMENT
/begin MEASUREMENT lv_err_vls_down_max_1 "Boolean error flag, short to plus fault currently present on downstream oxygen sensor signal" UBYTE _CNV_S_2_RANGE______21_CM 1 100. 0. 1. DISPLAY_IDENTIFIER LV_ERR_VLS_DOWN_MAX_1 ECU_ADDRESS 0x3fb80c BIT_MASK 0x1 /end MEASUREMENT
/begin MEASUREMENT lv_err_vls_down_oc_1 "Boolean error flag, short to ground fault currently present on downstream oxygen sensor signal" UBYTE _CNV_S_2_RANGE______21_CM 1 100. 0. 1. DISPLAY_IDENTIFIER LV_ERR_VLS_DOWN_OC_1 ECU_ADDRESS 0x3fb824 BIT_MASK 0x1 /end MEASUREMENT
/begin MEASUREMENT lv_err_vls_down_oc_2 "Boolean error flag, short to ground fault currently present on downstream oxygen sensor signal" UBYTE _CNV_S_2_RANGE______21_CM 1 100. 0. 1. DISPLAY_IDENTIFIER LV_ERR_VLS_DOWN_OC_2 ECU_ADDRESS 0x3fb828 BIT_MASK 0x1 /end MEASUREMENT
/begin MEASUREMENT lv_err_vls_down_min_1 "Boolean error flag, short to ground fault currently present on downstream oxygen sensor signal" UBYTE _CNV_S_2_RANGE______21_CM 1 100. 0. 1. DISPLAY_IDENTIFIER LV_ERR_VLS_DOWN_MIN_1 ECU_ADDRESS 0x3fb81c BIT_MASK 0x1 /end MEASUREMENT
/begin MEASUREMENT lv_err_vls_down_min_cold_1 "Boolean error flag, short to ground fault currently present on downstream oxygen sensor signal" UBYTE _CNV_S_2_RANGE______5_R_CM 1 100. 0. 255. DISPLAY_IDENTIFIER LV_ERR_VLS_DOWN_MIN_COLD_1 ECU_ADDRESS 0x3fb814 /end MEASUREMENT
/begin MEASUREMENT lv_err_vls_down_min_cold_2 "Boolean error flag, short to ground fault currently present on downstream oxygen sensor signal" UBYTE _CNV_S_2_RANGE______5_R_CM 1 100. 0. 255. DISPLAY_IDENTIFIER LV_ERR_VLS_DOWN_MIN_COLD_2 ECU_ADDRESS 0x3fb818 /end MEASUREMENT
/begin CHARACTERISTIC c_t_err_cdn_vls_down_min "Minimum duration required for continuus low VLS_DOWN_i detection" VALUE 0xffe41960 _REC_VAL_20_u2 6553.5 _CNV_A_R_LINEAR_____24_CM 0. 6553.5 DISPLAY_IDENTIFIER C_T_ERR_CDN_VLS_DOWN_MIN FORMAT "%5.1" /end CHARACTERISTIC
/begin CHARACTERISTIC c_t_err_cdn_vls_down_oc "Minimum required duration where voltage and resistance lie inside of the limits for operable sensor to detect fault" VALUE 0xffe41962 _REC_VAL_20_u2 6553.5 _CNV_A_R_LINEAR_____24_CM 0. 6553.5 DISPLAY_IDENTIFIER C_T_ERR_CDN_VLS_DOWN_OC FORMAT "%5.1" /end CHARACTERISTIC
/begin CHARACTERISTIC c_abc_max_vls_down_puc "Debounce counter maximum for PUC plausibility" VALUE 0xffe40628 _REC_VAL_20_u1 254. _CNV_A_R_LINEAR_____0_CM 1. 255. DISPLAY_IDENTIFIER C_ABC_MAX_VLS_DOWN_PUC FORMAT "%3.0" /end CHARACTERISTIC
/begin CHARACTERISTIC c_abc_max_vls_down_fl "Debounce counter maximum for FL plausibility" VALUE 0xffe40625 _REC_VAL_20_u1 254. _CNV_A_R_LINEAR_____0_CM 1. 255. DISPLAY_IDENTIFIER C_ABC_MAX_VLS_DOWN_FL FORMAT "%3.0" /end CHARACTERISTIC
/begin CHARACTERISTIC c_abc_inc_vls_down_puc "Debounce counter increment for PUC plausibility" VALUE 0xffe405ba _REC_VAL_20_u1 255. _CNV_A_R_LINEAR_____0_CM 0. 255. DISPLAY_IDENTIFIER C_ABC_INC_VLS_DOWN_PUC FORMAT "%3.0" /end CHARACTERISTIC
/begin CHARACTERISTIC c_abc_inc_vls_down_fl "Debounce counter increment for PUC plausibility" VALUE 0xffe405b7 _REC_VAL_20_u1 255. _CNV_A_R_LINEAR_____0_CM 0. 255. DISPLAY_IDENTIFIER C_ABC_INC_VLS_DOWN_FL FORMAT "%3.0" /end CHARACTERISTIC
/begin CHARACTERISTIC c_maf_int_max_vls_down_diag_puc "Maximum threshold for MAF integral to end downstream PUC signal plausibility" VALUE 0xffe41762 _REC_VAL_20_u2 1820.398 _CNV_A_R_LINEAR_____287_CM 0. 1820.398 DISPLAY_IDENTIFIER C_MAF_INT_MAX_VLS_DOWN_DIAG_PUC FORMAT "%7.2" /end CHARACTERISTIC
/begin CHARACTERISTIC c_maf_int_max_vls_down_diag_fl "Maximum threshold for MAF integral to end downstream FL signal plausibility" VALUE 0xffe41760 _REC_VAL_20_u2 1820.398 _CNV_A_R_LINEAR_____287_CM 0. 1820.398 DISPLAY_IDENTIFIER C_MAF_INT_MAX_VLS_DOWN_DIAG_FL FORMAT "%7.2" /end CHARACTERISTIC
/begin CHARACTERISTIC c_maf_int_min_vls_down_diag_puc "Minimum threshold for MAF integral to end downstream PUC signal plausibility" VALUE 0xffe41776 _REC_VAL_20_u2 1820.398 _CNV_A_R_LINEAR_____287_CM 0. 1820.398 DISPLAY_IDENTIFIER C_MAF_INT_MIN_VLS_DOWN_DIAG_PUC FORMAT "%7.2" /end CHARACTERISTIC
/begin CHARACTERISTIC c_maf_int_min_vls_down_diag_fl "Minimum threshold for MAF integral to end downstream FL signal plausibility" VALUE 0xffe41774 _REC_VAL_20_u2 1820.398 _CNV_A_R_LINEAR_____287_CM 0. 1820.398 DISPLAY_IDENTIFIER C_MAF_INT_MIN_VLS_DOWN_DIAG_FL FORMAT "%7.2" /end CHARACTERISTIC
/begin CHARACTERISTIC c_vls_down_min_puc "VLS voltage threshold for PUC fault detection" VALUE 0xffe41b60 _REC_VAL_20_u2 4.99511719 _CNV_A_R_LINEAR_____3_CM 0. 4.99511719 DISPLAY_IDENTIFIER C_VLS_DOWN_MIN_PUC FORMAT "%5.3" /end CHARACTERISTIC
/begin CHARACTERISTIC c_vls_down_max_fl "VLS voltage threshold for FL fault detection" VALUE 0xffe41b5c _REC_VAL_20_u2 4.99511719 _CNV_A_R_LINEAR_____3_CM 0. 4.99511719 DISPLAY_IDENTIFIER C_VLS_DOWN_MAX_FL FORMAT "%5.3" /end CHARACTERISTIC
/begin MEASUREMENT lv_err_plaus_vls_down_2 "Boolean  flag, error plausibility check on downstream oxygen sensor signal" UBYTE _CNV_S_2_RANGE______1_R_CM 1 100. 0. 255. DISPLAY_IDENTIFIER LV_ERR_PLAUS_VLS_DOWN_2 ECU_ADDRESS 0x3fe524 /end MEASUREMENT
/begin MEASUREMENT maf_int_fl "integral of air mass flow while FL active" UWORD _CNV_A_R_LINEAR_____287_CM 1 100. 0. 1820.398 DISPLAY_IDENTIFIER MAF_INT_FL ECU_ADDRESS 0x3fd4a4 BYTE_ORDER MSB_LAST FORMAT "%7.2" /end MEASUREMENT
/begin MEASUREMENT lv_err_plaus_vls_down_1 "Boolean  flag, error plausibility check on downstream oxygen sensor signal" UBYTE _CNV_S_2_RANGE______1_R_CM 1 100. 0. 255. DISPLAY_IDENTIFIER LV_ERR_PLAUS_VLS_DOWN_1 ECU_ADDRESS 0x3fe523 /end MEASUREMENT
/begin MEASUREMENT lv_cdn_plaus_vls_down_1 "Boolean  flag, plausibility check on downstream oxygen sensor signal possible" UBYTE _CNV_S_2_RANGE______2_CM 1 100. 0. 1. DISPLAY_IDENTIFIER LV_CDN_PLAUS_VLS_DOWN_1 ECU_ADDRESS 0x3fe525 /end MEASUREMENT
/begin MEASUREMENT lv_cdn_plaus_vls_down_2 "Boolean  flag, plausibility check on downstream oxygen sensor signal possible" UBYTE _CNV_S_2_RANGE______2_CM 1 100. 0. 1. DISPLAY_IDENTIFIER LV_CDN_PLAUS_VLS_DOWN_2 ECU_ADDRESS 0x3fe526 /end MEASUREMENT
/begin MEASUREMENT lv_err_vls_down_fl_1 "Boolean error flag, FL plausibility fault currently present on downstream oxygen sensor signal" UBYTE _CNV_S_2_RANGE______1_R_CM 1 100. 0. 255. DISPLAY_IDENTIFIER LV_ERR_VLS_DOWN_FL_1 ECU_ADDRESS 0x3fbb68 /end MEASUREMENT
/begin MEASUREMENT lv_err_vls_down_fl_2 "Boolean error flag, FL plausibility fault currently present on downstream oxygen sensor signal" UBYTE _CNV_S_2_RANGE______1_R_CM 1 100. 0. 255. DISPLAY_IDENTIFIER LV_ERR_VLS_DOWN_FL_2 ECU_ADDRESS 0x3fbb6c /end MEASUREMENT
/begin MEASUREMENT lv_inh_diag_el_ls_up_2 "Debounced diagnosis of an electrical fault on the upstream WRAF-Sensor" UBYTE _CNV_S_2_RANGE______2_CM 1 100. 0. 1. DISPLAY_IDENTIFIER LV_INH_DIAG_EL_LS_UP_2 ECU_ADDRESS 0x3fe52b /end MEASUREMENT
/begin MEASUREMENT lv_inh_diag_oc_ls_up_1 "Debounced diagnosis of an electrical fault on the upstream WRAF-Sensor" UBYTE _CNV_S_2_RANGE______2_CM 1 100. 0. 1. DISPLAY_IDENTIFIER LV_INH_DIAG_OC_LS_UP_1 ECU_ADDRESS 0x3fe52a /end MEASUREMENT
/begin MEASUREMENT lv_inh_diag_el_ls_up_1 "Debounced diagnosis of an electrical fault on the upstream WRAF-Sensor" UBYTE _CNV_S_2_RANGE______2_CM 1 100. 0. 1. DISPLAY_IDENTIFIER LV_INH_DIAG_EL_LS_UP_1 ECU_ADDRESS 0x3fe529 /end MEASUREMENT
/begin MEASUREMENT lv_inh_diag_oc_ls_up_2 "Debounced diagnosis of an electrical fault on the upstream WRAF-Sensor" UBYTE _CNV_S_2_RANGE______2_CM 1 100. 0. 1. DISPLAY_IDENTIFIER LV_INH_DIAG_OC_LS_UP_2 ECU_ADDRESS 0x3fe52c /end MEASUREMENT
/begin CHARACTERISTIC c_abc_inc_el_lsl_1 "Anti - bounce counter increment" VALUE 0xffe40569 _REC_VAL_20_u1 255. _CNV_A_R_LINEAR_____0_CM 0. 255. DISPLAY_IDENTIFIER C_ABC_INC_EL_LSL_1 FORMAT "%3.0" /end CHARACTERISTIC
/begin CHARACTERISTIC c_abc_inc_el_lsl_2 "Anti - bounce counter increment" VALUE 0xffe4056a _REC_VAL_20_u1 255. _CNV_A_R_LINEAR_____0_CM 0. 255. DISPLAY_IDENTIFIER C_ABC_INC_EL_LSL_2 FORMAT "%3.0" /end CHARACTERISTIC
/begin CHARACTERISTIC c_abc_max_el_lsl_1 "Maximum value of the anti - bounce counter" VALUE 0xffe405de _REC_VAL_20_u1 254. _CNV_A_R_LINEAR_____0_CM 1. 255. DISPLAY_IDENTIFIER C_ABC_MAX_EL_LSL_1 FORMAT "%3.0" /end CHARACTERISTIC
/begin CHARACTERISTIC c_abc_max_el_lsl_2 "Maximum value of the anti - bounce counter" VALUE 0xffe405df _REC_VAL_20_u1 254. _CNV_A_R_LINEAR_____0_CM 1. 255. DISPLAY_IDENTIFIER C_ABC_MAX_EL_LSL_2 FORMAT "%3.0" /end CHARACTERISTIC
/begin CHARACTERISTIC c_t_oc_lsl_diag "Max. waiting time before begin diagnosis" VALUE 0xffe419d0 _REC_VAL_20_u2 6553.5 _CNV_A_R_LINEAR_____24_CM 0. 6553.5 DISPLAY_IDENTIFIER C_T_OC_LSL_DIAG FORMAT "%6.1" /end CHARACTERISTIC
/begin MEASUREMENT lv_inh_diag_vls_up_1 "" UBYTE _CNV_S_2_RANGE______2_CM 1 100. 0. 1. DISPLAY_IDENTIFIER LV_INH_DIAG_VLS_UP_1 ECU_ADDRESS 0x3fed68 /end MEASUREMENT
/begin MEASUREMENT lv_inh_diag_vls_up_2 "" UBYTE _CNV_S_2_RANGE______2_CM 1 100. 0. 1. DISPLAY_IDENTIFIER LV_INH_DIAG_VLS_UP_2 ECU_ADDRESS 0x3fed72 /end MEASUREMENT
/begin MEASUREMENT lv_err_el_lsl_1 "Debounced diagnosis of an electrical fault on the upstream WRAF-Sensor" UBYTE _CNV_S_2_RANGE______1_R_CM 1 100. 0. 255. DISPLAY_IDENTIFIER LV_ERR_EL_LSL_1 ECU_ADDRESS 0x3fbb50 /end MEASUREMENT
/begin MEASUREMENT lv_err_el_lsl_2 "Debounced diagnosis of an electrical fault on the upstream WRAF-Sensor" UBYTE _CNV_S_2_RANGE______1_R_CM 1 100. 0. 255. DISPLAY_IDENTIFIER LV_ERR_EL_LSL_2 ECU_ADDRESS 0x3fbb54 /end MEASUREMENT
/begin MEASUREMENT lv_err_oc_lsl_1 "Debounced diagnosis of an electrical fault on the upstream WRAF-Sensor" UBYTE _CNV_S_2_RANGE______1_R_CM 1 100. 0. 255. DISPLAY_IDENTIFIER LV_ERR_OC_LSL_1 ECU_ADDRESS 0x3fbb40 /end MEASUREMENT
/begin MEASUREMENT lv_err_oc_lsl_2 "Debounced diagnosis of an electrical fault on the upstream WRAF-Sensor" UBYTE _CNV_S_2_RANGE______1_R_CM 1 100. 0. 255. DISPLAY_IDENTIFIER LV_ERR_OC_LSL_2 ECU_ADDRESS 0x3fbb44 /end MEASUREMENT
/begin CHARACTERISTIC c_t_end_diag_oc_lsl "Time to have a diagnostic available" VALUE 0xffe41958 _REC_VAL_20_u2 6553.5 _CNV_A_R_LINEAR_____24_CM 0. 6553.5 DISPLAY_IDENTIFIER C_T_END_DIAG_OC_LSL FORMAT "%6.1" /end CHARACTERISTIC
/begin CHARACTERISTIC c_t_dly_diag_el_lsl "Time to have a diagnostic available" VALUE 0xffe41908 _REC_VAL_20_u2 655.35 _CNV_A_R_LINEAR_____4_CM 0. 655.35 DISPLAY_IDENTIFIER C_T_DLY_DIAG_EL_LSL FORMAT "%5.2" /end CHARACTERISTIC
/begin CHARACTERISTIC c_max_ctr_err_lsl_if_spi_wr "Max. allowed number of SPE comunication errors" VALUE 0xffe4079a _REC_VAL_20_u1 255. _CNV_A_R_LINEAR_____0_CM 0. 255. DISPLAY_IDENTIFIER C_MAX_CTR_ERR_LSL_IF_SPI_WR FORMAT "%3.0" /end CHARACTERISTIC
/begin CHARACTERISTIC c_t_max_lsl_if_spi_rst_end "Max. waiting time for the initialization of the WRAF sensor controller" VALUE 0xffe4199c _REC_VAL_20_u2 655.3200000000001 _CNV_A_R_LINEAR_____364_CM 0. 655.3200000000001 DISPLAY_IDENTIFIER C_T_MAX_LSL_IF_SPI_RST_END FORMAT "%6.2" /end CHARACTERISTIC
/begin CHARACTERISTIC c_t_end_diag_if_lsl "Time to diagnositc availability" VALUE 0xffe41952 _REC_VAL_20_u2 655.3200000000001 _CNV_A_R_LINEAR_____364_CM 0. 655.3200000000001 DISPLAY_IDENTIFIER C_T_END_DIAG_IF_LSL FORMAT "%6.2" /end CHARACTERISTIC
/begin MEASUREMENT lv_err_if_lsl_1 "Present error in the CJ120 WRAF sensor controller" UBYTE _CNV_S_2_RANGE______1_R_CM 1 100. 0. 255. DISPLAY_IDENTIFIER LV_ERR_IF_LSL_1 ECU_ADDRESS 0x3fbbb0 /end MEASUREMENT
/begin MEASUREMENT lv_err_if_lsl_2 "Present error in the CJ120 WRAF sensor controller" UBYTE _CNV_S_2_RANGE______1_R_CM 1 100. 0. 255. DISPLAY_IDENTIFIER LV_ERR_IF_LSL_2 ECU_ADDRESS 0x3fbbb4 /end MEASUREMENT
/begin CHARACTERISTIC c_abc_inc_chk_ls_down "Anti - bounce counter increment" VALUE 0xffe40563 _REC_VAL_20_u1 255. _CNV_A_R_LINEAR_____0_CM 0. 255. DISPLAY_IDENTIFIER C_ABC_INC_CHK_LS_DOWN FORMAT "%3.0" /end CHARACTERISTIC
/begin CHARACTERISTIC c_abc_max_chk_ls_down "Maximum value of the anti - bounce counter" VALUE 0xffe405d9 _REC_VAL_20_u1 254. _CNV_A_R_LINEAR_____0_CM 1. 255. DISPLAY_IDENTIFIER C_ABC_MAX_CHK_LS_DOWN FORMAT "%3.0" /end CHARACTERISTIC
/begin CHARACTERISTIC c_abc_inc_maf "Debounce counter increment, mass air flow meter diagnosis" VALUE 0xffe4057a _REC_VAL_20_u1 255. _CNV_A_R_LINEAR_____0_CM 0. 255. DISPLAY_IDENTIFIER C_ABC_INC_MAF FORMAT "%3.0" /end CHARACTERISTIC
/begin CHARACTERISTIC c_abc_max_maf "Debounce counter maximum value, mass air flow meter diagnosis" VALUE 0xffe405ed _REC_VAL_20_u1 254. _CNV_A_R_LINEAR_____0_CM 1. 255. DISPLAY_IDENTIFIER C_ABC_MAX_MAF FORMAT "%3.0" /end CHARACTERISTIC
/begin CHARACTERISTIC c_abc_inc_mis_low_fuel "Increment value of the anti - bounce counter for Bench mode" VALUE 0xffe4057b _REC_VAL_20_u1 255. _CNV_A_R_LINEAR_____0_CM 0. 255. DISPLAY_IDENTIFIER C_ABC_INC_MIS_LOW_FUEL FORMAT "%3.0" /end CHARACTERISTIC
/begin CHARACTERISTIC c_abc_max_msw_2 "Debounce counter maximum value - MSW diagnosis" VALUE 0xffe405ee _REC_VAL_20_u1 254. _CNV_A_R_LINEAR_____0_CM 1. 255. DISPLAY_IDENTIFIER C_ABC_MAX_MSW_2 FORMAT "%3.0" /end CHARACTERISTIC
/begin CHARACTERISTIC c_abc_inc_msw_2 "Debounce counter increment - MSW diagnosis" VALUE 0xffe4057c _REC_VAL_20_u1 255. _CNV_A_R_LINEAR_____0_CM 0. 255. DISPLAY_IDENTIFIER C_ABC_INC_MSW_2 FORMAT "%3.0" /end CHARACTERISTIC
/begin CHARACTERISTIC c_abc_inc_msw_tog "Debounce counter increment - Toggle bit monitoring" VALUE 0xffe4057e _REC_VAL_20_u1 255. _CNV_A_R_LINEAR_____0_CM 0. 255. DISPLAY_IDENTIFIER C_ABC_INC_MSW_TOG FORMAT "%3.0" /end CHARACTERISTIC
/begin CHARACTERISTIC c_abc_max_msw_tog "Debounce counter maximum value - Toggle bit monitoring" VALUE 0xffe405f0 _REC_VAL_20_u1 254. _CNV_A_R_LINEAR_____0_CM 1. 255. DISPLAY_IDENTIFIER C_ABC_MAX_MSW_TOG FORMAT "%3.0" /end CHARACTERISTIC
/begin CHARACTERISTIC c_abc_inc_msw_3 "Debounce counter increment - MSW diagnosis" VALUE 0xffe4057d _REC_VAL_20_u1 255. _CNV_A_R_LINEAR_____0_CM 0. 255. DISPLAY_IDENTIFIER C_ABC_INC_MSW_3 FORMAT "%3.0" /end CHARACTERISTIC
/begin CHARACTERISTIC c_abc_max_msw_3 "Debounce counter maximum value - MSW diagnosis" VALUE 0xffe405ef _REC_VAL_20_u1 254. _CNV_A_R_LINEAR_____0_CM 1. 255. DISPLAY_IDENTIFIER C_ABC_MAX_MSW_3 FORMAT "%3.0" /end CHARACTERISTIC
/begin CHARACTERISTIC c_mtcpwm_pi_max_diag "Diagnosis threshold for MTCPWM" VALUE 0xffe417e6 _REC_VAL_20_u2 100. _CNV_A_R_LINEAR_____415_CM 0. 100. DISPLAY_IDENTIFIER C_MTCPWM_PI_MAX_DIAG FORMAT "%7.3" /end CHARACTERISTIC
/begin CHARACTERISTIC c_tps_dif_max_diag "Maximum permissible control variance" VALUE 0xffe41a8e _REC_VAL_20_u2 119.5 _CNV_A_R_LINEAR_____53_CM 0. 119.5 DISPLAY_IDENTIFIER C_TPS_DIF_MAX_DIAG FORMAT "%7.3" /end CHARACTERISTIC
/begin CHARACTERISTIC c_t_tps_dif_diag "Tolerance time control variance" VALUE 0xffe408d0 _REC_VAL_20_u1 2.55 _CNV_A_R_LINEAR_____4_CM 0. 2.55 DISPLAY_IDENTIFIER C_T_TPS_DIF_DIAG FORMAT "%4.2" /end CHARACTERISTIC
/begin CHARACTERISTIC c_t_mtcpwm_pi_diag_cur_off "Time threshold for end \"break-away\"" VALUE 0xffe408bb _REC_VAL_20_u1 2.55 _CNV_A_R_LINEAR_____4_CM 0. 2.55 DISPLAY_IDENTIFIER C_T_MTCPWM_PI_DIAG_CUR_OFF FORMAT "%4.2" /end CHARACTERISTIC
/begin CHARACTERISTIC c_t_mtcpwm_pi_diag "Tolerance time MTCPWM-error" VALUE 0xffe408ba _REC_VAL_20_u1 2.55 _CNV_A_R_LINEAR_____4_CM 0. 2.55 DISPLAY_IDENTIFIER C_T_MTCPWM_PI_DIAG FORMAT "%4.2" /end CHARACTERISTIC
/begin CHARACTERISTIC ip_n_max_tol_st "upper engine speed limit for ST" CURVE 0xffe46d86 _REC_CUR_20_u1_u1 8160. _CNV_A_R_LINEAR_____15_CM 0. 8160. DISPLAY_IDENTIFIER IP_N_MAX_TOL_ST FORMAT "%4.0"
 /begin AXIS_DESCR COM_AXIS tco _CNV_A_R_LINEAR_____11_CM 9 -48. 142.5 FORMAT "%5.1" AXIS_PTS_REF ldpm_tco_9 /end AXIS_DESCR
/end CHARACTERISTIC
/begin MEASUREMENT lv_inh_diag_nox_sens_1 "Inhibit flag for NOx-Sensor heater OBD I diagnosis" UBYTE _CNV_S_2_RANGE______2_CM 1 100. 0. 1. DISPLAY_IDENTIFIER LV_INH_DIAG_NOX_SENS_1 ECU_ADDRESS 0x3fe5f6 /end MEASUREMENT
/begin MEASUREMENT lv_inh_diag_nox_sens_2 "Inhibit flag for NOx-Sensor heater OBD I diagnosis" UBYTE _CNV_S_2_RANGE______2_CM 1 100. 0. 1. DISPLAY_IDENTIFIER LV_INH_DIAG_NOX_SENS_2 ECU_ADDRESS 0x3fe5f9 /end MEASUREMENT
/begin MEASUREMENT lv_err_nox_sens_can_boff "CAN bus, at which the NOx-Sensor is connected, is into the state bus off" UBYTE _CNV_S_2_RANGE______1_R_CM 1 100. 0. 255. DISPLAY_IDENTIFIER LV_ERR_NOX_SENS_CAN_BOFF ECU_ADDRESS 0x3fe5f8 /end MEASUREMENT
/begin MEASUREMENT lv_err_tout_nox_sens_1 "logical variable timeout error CAN message NOX_SENS_i" UBYTE _CNV_S_2_RANGE______1_R_CM 1 100. 0. 255. DISPLAY_IDENTIFIER LV_ERR_TOUT_NOX_SENS_1 ECU_ADDRESS 0x3fbba0 /end MEASUREMENT
/begin MEASUREMENT lv_err_tout_nox_sens_2 "logical variable timeout error CAN message NOX_SENS_i" UBYTE _CNV_S_2_RANGE______1_R_CM 1 100. 0. 255. DISPLAY_IDENTIFIER LV_ERR_TOUT_NOX_SENS_2 ECU_ADDRESS 0x3fbba8 /end MEASUREMENT
/begin CHARACTERISTIC c_abc_inc_nox_sens "Anti - bounce counter increment of NOx-Sensor OBD I diagnosis" VALUE 0xffe40580 _REC_VAL_20_u1 255. _CNV_A_R_LINEAR_____0_CM 0. 255. DISPLAY_IDENTIFIER C_ABC_INC_NOX_SENS FORMAT "%3.0" /end CHARACTERISTIC
/begin CHARACTERISTIC c_abc_max_nox_sens "Maximum value of the anti - bounce counter for NOx-Sensor OBD I diagnosis" VALUE 0xffe405f2 _REC_VAL_20_u1 254. _CNV_A_R_LINEAR_____0_CM 1. 255. DISPLAY_IDENTIFIER C_ABC_MAX_NOX_SENS FORMAT "%3.0" /end CHARACTERISTIC
/begin MEASUREMENT o3_conc_up "Ozone concentration sensor pre radiator" UBYTE _CNV_A_R_LINEAR_____431_CM 1 100. 0. 1020. DISPLAY_IDENTIFIER O3_CONC_UP ECU_ADDRESS 0x3fe56a FORMAT "%4.0" /end MEASUREMENT
/begin MEASUREMENT o3_conc_down "Ozone concentration sensor post radiator" UBYTE _CNV_A_R_LINEAR_____431_CM 1 100. 0. 1020. DISPLAY_IDENTIFIER O3_CONC_DOWN ECU_ADDRESS 0x3fe56b FORMAT "%4.0" /end MEASUREMENT
/begin MEASUREMENT v_o3_up "Voltage ozone sensor pre radiator" UWORD _CNV_A_R_LINEAR_____3_CM 1 100. 0. 4.99511719 DISPLAY_IDENTIFIER V_O3_UP ECU_ADDRESS 0x3fd4dc BYTE_ORDER MSB_LAST FORMAT "%5.3" /end MEASUREMENT
/begin MEASUREMENT v_o3_down "Voltage ozone sensor post radiator" UWORD _CNV_A_R_LINEAR_____3_CM 1 100. 0. 4.99511719 DISPLAY_IDENTIFIER V_O3_DOWN ECU_ADDRESS 0x3fd4de BYTE_ORDER MSB_LAST FORMAT "%5.3" /end MEASUREMENT
/begin CHARACTERISTIC ip_o3__v_o3 "Conversion of voltage into the ozone concentration" CURVE 0xffe46e2b _REC_CUR_20_u1_u2 1020. _CNV_A_R_LINEAR_____431_CM 0. 1020. DISPLAY_IDENTIFIER IP_O3__V_O3 FORMAT "%4.0"
 /begin AXIS_DESCR COM_AXIS o3_conc_up _CNV_A_R_LINEAR_____3_CM 16 0. 4.99511719 FORMAT "%5.3" AXIS_PTS_REF ldp_v_o3_x_ip_o3 /end AXIS_DESCR
/end CHARACTERISTIC
/begin AXIS_PTS ldp_v_o3_x_ip_o3 "" 0xffe515a8 o3_conc_up _REC_AXS_20_u2 0.2497558595 _CNV_A_R_LINEAR_____3_CM 16 0. 4.99511719 DISPLAY_IDENTIFIER LDP_V_O3_X_IP_O3 FORMAT "%5.3" /end AXIS_PTS
/begin MEASUREMENT o3_dif "Concentration differences of pre and post radiator" UBYTE _CNV_A_R_LINEAR_____431_CM 1 100. 0. 1020. DISPLAY_IDENTIFIER O3_DIF ECU_ADDRESS 0x3fe56c FORMAT "%4.0" /end MEASUREMENT
/begin MEASUREMENT o3_dif_quo_min "Corrected threshold proportionality" UBYTE _CNV_A_R_LINEAR_____432_CM 1 100. 0. 9.960000000000001 DISPLAY_IDENTIFIER O3_DIF_QUO_MIN ECU_ADDRESS 0x3fe56e FORMAT "%4.3" /end MEASUREMENT
/begin MEASUREMENT sum_o3_mes_min "Summation of verifications" UWORD _CNV_A_R_LINEAR_____0_CM 1 100. 0. 65534. DISPLAY_IDENTIFIER SUM_O3_MES_MIN ECU_ADDRESS 0x3fd4e0 BYTE_ORDER MSB_LAST FORMAT "%5.0" /end MEASUREMENT
/begin MEASUREMENT o3_diag_min "Diagnosis threshold" UBYTE _CNV_A_R_LINEAR_____432_CM 1 100. 0. 9.960000000000001 DISPLAY_IDENTIFIER O3_DIAG_MIN ECU_ADDRESS 0x3fe56d FORMAT "%4.3" /end MEASUREMENT
/begin MEASUREMENT state_o3_con_diag "State of diagnosis" UBYTE _CNV_S_7_RANGE_STAT_433_CM 1 100. 0. 6. DISPLAY_IDENTIFIER STATE_O3_CON_DIAG ECU_ADDRESS 0x3fe56f /end MEASUREMENT
/begin CHARACTERISTIC c_o3_max_diag "O3 threshold for short to ground - O3 diagnosis" VALUE 0xffe40817 _REC_VAL_20_u1 190.5 _CNV_A_R_LINEAR_____11_CM -48. 142.5 DISPLAY_IDENTIFIER C_O3_MAX_DIAG FORMAT "%5.1" /end CHARACTERISTIC
/begin CHARACTERISTIC c_o3_min_diag "O3 threshold for short to VB or line break - O3 diagnosis" VALUE 0xffe40818 _REC_VAL_20_u1 190.5 _CNV_A_R_LINEAR_____11_CM -48. 142.5 DISPLAY_IDENTIFIER C_O3_MIN_DIAG FORMAT "%5.1" /end CHARACTERISTIC
/begin CHARACTERISTIC c_abc_inc_o3_up "Anti-bounce increment - Ozone sensor diagnosis" VALUE 0xffe40587 _REC_VAL_20_u1 255. _CNV_A_R_LINEAR_____0_CM 0. 255. DISPLAY_IDENTIFIER C_ABC_INC_O3_UP FORMAT "%3.0" /end CHARACTERISTIC
/begin CHARACTERISTIC c_abc_inc_o3_down "Anti-bounce increment - Ozone sensor diagnosis" VALUE 0xffe40586 _REC_VAL_20_u1 255. _CNV_A_R_LINEAR_____0_CM 0. 255. DISPLAY_IDENTIFIER C_ABC_INC_O3_DOWN FORMAT "%3.0" /end CHARACTERISTIC
/begin CHARACTERISTIC c_abc_max_o3_up "" VALUE 0xffe405f9 _REC_VAL_20_u1 254. _CNV_A_R_LINEAR_____0_CM 1. 255. DISPLAY_IDENTIFIER C_ABC_MAX_O3_UP FORMAT "%3.0" /end CHARACTERISTIC
/begin CHARACTERISTIC c_abc_max_o3_down "" VALUE 0xffe405f8 _REC_VAL_20_u1 254. _CNV_A_R_LINEAR_____0_CM 1. 255. DISPLAY_IDENTIFIER C_ABC_MAX_O3_DOWN FORMAT "%3.0" /end CHARACTERISTIC
/begin CHARACTERISTIC c_o3_conc_vs_min "Minimum vehicle speed" VALUE 0xffe40815 _REC_VAL_20_u1 255. _CNV_A_R_LINEAR_____23_CM 0. 255. DISPLAY_IDENTIFIER C_O3_CONC_VS_MIN FORMAT "%3.0" /end CHARACTERISTIC
/begin CHARACTERISTIC c_o3_conc_tco_min "Reached engine temperature" VALUE 0xffe40814 _REC_VAL_20_u1 190.5 _CNV_A_R_LINEAR_____11_CM -48. 142.5 DISPLAY_IDENTIFIER C_O3_CONC_TCO_MIN FORMAT "%5.1" /end CHARACTERISTIC
/begin CHARACTERISTIC c_o3_conc_tco_ex_min "Reached radiator outlet temperature" VALUE 0xffe40813 _REC_VAL_20_u1 190.5 _CNV_A_R_LINEAR_____11_CM -48. 142.5 DISPLAY_IDENTIFIER C_O3_CONC_TCO_EX_MIN FORMAT "%5.1" /end CHARACTERISTIC
/begin CHARACTERISTIC c_t_ast_o3_conc "Time after Start" VALUE 0xffe418de _REC_VAL_20_u2 6553.5 _CNV_A_R_LINEAR_____24_CM 0. 6553.5 DISPLAY_IDENTIFIER C_T_AST_O3_CONC FORMAT "%5.1" /end CHARACTERISTIC
/begin CHARACTERISTIC c_o3_conc_min "Minimum concentration inlet" VALUE 0xffe40812 _REC_VAL_20_u1 1020. _CNV_A_R_LINEAR_____431_CM 0. 1020. DISPLAY_IDENTIFIER C_O3_CONC_MIN FORMAT "%4.0" /end CHARACTERISTIC
/begin CHARACTERISTIC c_sum_o3_mes_min "Minimum concentration inlet" VALUE 0xffe418ba _REC_VAL_20_u2 65535. _CNV_A_R_LINEAR_____0_CM 0. 65535. DISPLAY_IDENTIFIER C_SUM_O3_MES_MIN FORMAT "%5.0" /end CHARACTERISTIC
/begin CHARACTERISTIC c_o3_diag_min "Threshold error detection" VALUE 0xffe40816 _REC_VAL_20_u1 9.960000000000001 _CNV_A_R_LINEAR_____432_CM 0. 9.960000000000001 DISPLAY_IDENTIFIER C_O3_DIAG_MIN FORMAT "%4.3" /end CHARACTERISTIC
/begin CHARACTERISTIC ip_o3_dif_diag_min "Minimum concentration of ozone differences" CURVE 0xffe40d87 _REC_CUR_20_u1_u1 1020. _CNV_A_R_LINEAR_____431_CM 0. 1020. DISPLAY_IDENTIFIER IP_O3_DIF_DIAG_MIN FORMAT "%4.0"
 /begin AXIS_DESCR COM_AXIS o3_conc_up _CNV_A_R_LINEAR_____431_CM 8 0. 1020. FORMAT "%4.0" AXIS_PTS_REF ldpm_o3_conc_up /end AXIS_DESCR
/end CHARACTERISTIC
/begin CHARACTERISTIC id_o3_fac "correction sensorsensivität" CURVE 0xffe40a73 _REC_CUR_20_u1_u1 255. _CNV_A_R_LINEAR_____0_CM 0. 255. DISPLAY_IDENTIFIER ID_O3_FAC FORMAT "%3.0"
 /begin AXIS_DESCR COM_AXIS o3_conc_up _CNV_A_R_LINEAR_____431_CM 8 0. 1020. FORMAT "%4.0" AXIS_PTS_REF ldpm_o3_conc_up /end AXIS_DESCR
/end CHARACTERISTIC
/begin CHARACTERISTIC lc_o3_ena "O3 sensor diagnosis enable flag" VALUE 0xffe40fc2 _REC_VAL_20_u1 1. _CNV_A_R_LINEAR_____0_CM 0. 1. DISPLAY_IDENTIFIER LC_O3_ENA FORMAT "%2.0" /end CHARACTERISTIC
/begin AXIS_PTS ldpm_o3_conc_up "" 0xffe485c5 o3_conc_up _REC_AXS_20_u1 51. _CNV_A_R_LINEAR_____431_CM 8 0. 1020. DISPLAY_IDENTIFIER LDPM_O3_CONC_UP FORMAT "%4.0" /end AXIS_PTS
/begin MEASUREMENT lv_err_o3_down "OZONE error flag post sensor" UBYTE _CNV_S_2_RANGE______1_R_CM 1 100. 0. 255. DISPLAY_IDENTIFIER LV_ERR_O3_DOWN ECU_ADDRESS 0x3fbb84 /end MEASUREMENT
/begin MEASUREMENT lv_err_o3_up "OZONE error flag pre sensor" UBYTE _CNV_S_2_RANGE______1_R_CM 1 100. 0. 255. DISPLAY_IDENTIFIER LV_ERR_O3_UP ECU_ADDRESS 0x3fbb80 /end MEASUREMENT
/begin MEASUREMENT lv_err_vls_down_puc_1 "Boolean error flag, PUC plausibility fault currently present on downstream oxygen sensor signal" UBYTE _CNV_S_2_RANGE______1_R_CM 1 100. 0. 255. DISPLAY_IDENTIFIER LV_ERR_VLS_DOWN_PUC_1 ECU_ADDRESS 0x3fbb60 /end MEASUREMENT
/begin MEASUREMENT lv_err_vls_down_puc_2 "Boolean error flag, PUC plausibility fault currently present on downstream oxygen sensor signal" UBYTE _CNV_S_2_RANGE______1_R_CM 1 100. 0. 255. DISPLAY_IDENTIFIER LV_ERR_VLS_DOWN_PUC_2 ECU_ADDRESS 0x3fbb64 /end MEASUREMENT
/begin CHARACTERISTIC c_abc_inc_load_tps_plaus "ABC increment value" VALUE 0xffe40578 _REC_VAL_20_u1 255. _CNV_A_R_LINEAR_____0_CM 0. 255. DISPLAY_IDENTIFIER C_ABC_INC_LOAD_TPS_PLAUS FORMAT "%3.0" /end CHARACTERISTIC
/begin CHARACTERISTIC c_abc_max_load_tps_plaus "ABC Maximum value" VALUE 0xffe405eb _REC_VAL_20_u1 254. _CNV_A_R_LINEAR_____0_CM 1. 255. DISPLAY_IDENTIFIER C_ABC_MAX_LOAD_TPS_PLAUS FORMAT "%3.0" /end CHARACTERISTIC
/begin MEASUREMENT t_poil_swi_pwl "Timer for oil pressure inclination after engine stop" UBYTE _CNV_A_R_LINEAR_____24_CM 1 100. 0. 6.2 DISPLAY_IDENTIFIER T_POIL_SWI_PWL ECU_ADDRESS 0x3fe780 FORMAT "%3.1" /end MEASUREMENT
/begin CHARACTERISTIC c_abc_inc_poil_swi "Anti bounce increment value, POIL_SWI" VALUE 0xffe40588 _REC_VAL_20_u1 255. _CNV_A_R_LINEAR_____0_CM 0. 255. DISPLAY_IDENTIFIER C_ABC_INC_POIL_SWI FORMAT "%3.0" /end CHARACTERISTIC
/begin CHARACTERISTIC c_abc_max_poil_swi "Anti-bounce max. value, POIL_SWI" VALUE 0xffe405fa _REC_VAL_20_u1 254. _CNV_A_R_LINEAR_____0_CM 1. 255. DISPLAY_IDENTIFIER C_ABC_MAX_POIL_SWI FORMAT "%3.0" /end CHARACTERISTIC
/begin CHARACTERISTIC c_t_poil_swi_pwl "Time for oil pressure inclination" VALUE 0xffe408c4 _REC_VAL_20_u1 6.2 _CNV_A_R_LINEAR_____24_CM 0. 6.2 DISPLAY_IDENTIFIER C_T_POIL_SWI_PWL FORMAT "%3.1" /end CHARACTERISTIC
/begin CHARACTERISTIC c_toil_poil_swi_max_diag "Time for oil pressure inclination" VALUE 0xffe4097c _REC_VAL_20_u1 200. _CNV_A_R_LINEAR_____14_CM -40. 160. DISPLAY_IDENTIFIER C_TOIL_POIL_SWI_MAX_DIAG FORMAT "%3.0" /end CHARACTERISTIC
/begin CHARACTERISTIC c_toil_poil_swi_min_diag "Minimum diagnosis threshold TOIL" VALUE 0xffe4097d _REC_VAL_20_u1 200. _CNV_A_R_LINEAR_____14_CM -40. 160. DISPLAY_IDENTIFIER C_TOIL_POIL_SWI_MIN_DIAG FORMAT "%3.0" /end CHARACTERISTIC
/begin MEASUREMENT lv_err_poil_swi "Error oil pressure switch" UBYTE _CNV_S_2_RANGE______1_R_CM 1 100. 0. 255. DISPLAY_IDENTIFIER LV_ERR_POIL_SWI ECU_ADDRESS 0x3fba84 /end MEASUREMENT
/begin CHARACTERISTIC c_abc_inc_pvs_ratio "Increment debounce counter" VALUE 0xffe4058c _REC_VAL_20_u1 255. _CNV_A_R_LINEAR_____0_CM 0. 255. DISPLAY_IDENTIFIER C_ABC_INC_PVS_RATIO FORMAT "%3.0" /end CHARACTERISTIC
/begin CHARACTERISTIC c_abc_max_pvs_ratio "Maximum value debounce counter " VALUE 0xffe405fe _REC_VAL_20_u1 254. _CNV_A_R_LINEAR_____0_CM 1. 255. DISPLAY_IDENTIFIER C_ABC_MAX_PVS_RATIO FORMAT "%3.0" /end CHARACTERISTIC
/begin CHARACTERISTIC c_abc_max_pvs_bls_not_plaus "" VALUE 0xffe405fd _REC_VAL_20_u1 254. _CNV_A_R_LINEAR_____0_CM 1. 255. DISPLAY_IDENTIFIER C_ABC_MAX_PVS_BLS_NOT_PLAUS FORMAT "%3.0" /end CHARACTERISTIC
/begin CHARACTERISTIC c_abc_inc_pvs_bls_not_plaus "" VALUE 0xffe4058b _REC_VAL_20_u1 255. _CNV_A_R_LINEAR_____0_CM 0. 255. DISPLAY_IDENTIFIER C_ABC_INC_PVS_BLS_NOT_PLAUS FORMAT "%3.0" /end CHARACTERISTIC
/begin CHARACTERISTIC c_abc_inc_v_ref_1 "Anti bounce increment value for V_REF_1" VALUE 0xffe405b5 _REC_VAL_20_u1 255. _CNV_A_R_LINEAR_____0_CM 0. 255. DISPLAY_IDENTIFIER C_ABC_INC_V_REF_1 FORMAT "%3.0" /end CHARACTERISTIC
/begin CHARACTERISTIC c_abc_inc_v_ref_2 "Anti bounce increment value for V_REF_2" VALUE 0xffe405b6 _REC_VAL_20_u1 255. _CNV_A_R_LINEAR_____0_CM 0. 255. DISPLAY_IDENTIFIER C_ABC_INC_V_REF_2 FORMAT "%3.0" /end CHARACTERISTIC
/begin CHARACTERISTIC c_abc_max_v_ref_1 "Anti-bounce maximum value (x=1,2)" VALUE 0xffe40623 _REC_VAL_20_u1 254. _CNV_A_R_LINEAR_____0_CM 1. 255. DISPLAY_IDENTIFIER C_ABC_MAX_V_REF_1 FORMAT "%3.0" /end CHARACTERISTIC
/begin CHARACTERISTIC c_abc_max_v_ref_2 "Anti-bounce maximum value (x=1,2)" VALUE 0xffe40624 _REC_VAL_20_u1 254. _CNV_A_R_LINEAR_____0_CM 1. 255. DISPLAY_IDENTIFIER C_ABC_MAX_V_REF_2 FORMAT "%3.0" /end CHARACTERISTIC
/begin CHARACTERISTIC c_abc_inc_pvs_1 "Anti-bounce increment value, PVS 1" VALUE 0xffe40589 _REC_VAL_20_u1 255. _CNV_A_R_LINEAR_____0_CM 0. 255. DISPLAY_IDENTIFIER C_ABC_INC_PVS_1 FORMAT "%3.0" /end CHARACTERISTIC
/begin CHARACTERISTIC c_abc_inc_pvs_2 "Anti-bounce increment value, PVS 2" VALUE 0xffe4058a _REC_VAL_20_u1 255. _CNV_A_R_LINEAR_____0_CM 0. 255. DISPLAY_IDENTIFIER C_ABC_INC_PVS_2 FORMAT "%3.0" /end CHARACTERISTIC
/begin CHARACTERISTIC c_abc_max_pvs_1 "Anti-bounce maximum value, PVS 1" VALUE 0xffe405fb _REC_VAL_20_u1 254. _CNV_A_R_LINEAR_____0_CM 1. 255. DISPLAY_IDENTIFIER C_ABC_MAX_PVS_1 FORMAT "%3.0" /end CHARACTERISTIC
/begin CHARACTERISTIC c_abc_max_pvs_2 "Anti-bounce maximum value, PVS 2" VALUE 0xffe405fc _REC_VAL_20_u1 254. _CNV_A_R_LINEAR_____0_CM 1. 255. DISPLAY_IDENTIFIER C_ABC_MAX_PVS_2 FORMAT "%3.0" /end CHARACTERISTIC
/begin CHARACTERISTIC c_abc_inc_rly_main "Debounce counter increment - RLY_MAIN diagnosis" VALUE 0xffe4058f _REC_VAL_20_u1 255. _CNV_A_R_LINEAR_____0_CM 0. 255. DISPLAY_IDENTIFIER C_ABC_INC_RLY_MAIN FORMAT "%3.0" /end CHARACTERISTIC
/begin CHARACTERISTIC c_abc_max_rly_main "Debounce counter maximum value - RLY_MAIN diagnosis" VALUE 0xffe40601 _REC_VAL_20_u1 254. _CNV_A_R_LINEAR_____0_CM 1. 255. DISPLAY_IDENTIFIER C_ABC_MAX_RLY_MAIN FORMAT "%3.0" /end CHARACTERISTIC
/begin CHARACTERISTIC c_v_sof_swi_min "Input voltage threshold min" VALUE 0xffe41b06 _REC_VAL_20_u2 4.99511719 _CNV_A_R_LINEAR_____3_CM 0. 4.99511719 DISPLAY_IDENTIFIER C_V_SOF_SWI_MIN FORMAT "%5.3" /end CHARACTERISTIC
/begin CHARACTERISTIC c_abc_inc_sof_req "Anti - bounce counter increment" VALUE 0xffe40590 _REC_VAL_20_u1 255. _CNV_A_R_LINEAR_____0_CM 0. 255. DISPLAY_IDENTIFIER C_ABC_INC_SOF_REQ FORMAT "%3.0" /end CHARACTERISTIC
/begin CHARACTERISTIC c_abc_max_sof_req "Debounce counter maximum value" VALUE 0xffe40602 _REC_VAL_20_u1 254. _CNV_A_R_LINEAR_____0_CM 1. 255. DISPLAY_IDENTIFIER C_ABC_MAX_SOF_REQ FORMAT "%3.0" /end CHARACTERISTIC
/begin CHARACTERISTIC c_v_sof_swi_max "Input voltage threshold max" VALUE 0xffe41b04 _REC_VAL_20_u2 4.99511719 _CNV_A_R_LINEAR_____3_CM 0. 4.99511719 DISPLAY_IDENTIFIER C_V_SOF_SWI_MAX FORMAT "%5.3" /end CHARACTERISTIC
/begin MEASUREMENT lv_err_sof_req "Erroflag sport-mode switch request" UBYTE _CNV_S_2_RANGE______1_R_CM 1 100. 0. 255. DISPLAY_IDENTIFIER LV_ERR_SOF_REQ ECU_ADDRESS 0x3fba78 /end MEASUREMENT
/begin MEASUREMENT lv_err_sof "Erroflag sound flap" UBYTE _CNV_S_2_RANGE______1_R_CM 1 100. 0. 255. DISPLAY_IDENTIFIER LV_ERR_SOF ECU_ADDRESS 0x3fba74 /end MEASUREMENT
/begin CHARACTERISTIC c_abc_inc_tco_grd_diag "Debounce counter increment - TCO Signal gradient diagnosis" VALUE 0xffe40595 _REC_VAL_20_u1 255. _CNV_A_R_LINEAR_____0_CM 0. 255. DISPLAY_IDENTIFIER C_ABC_INC_TCO_GRD_DIAG FORMAT "%3.0" /end CHARACTERISTIC
/begin CHARACTERISTIC c_abc_max_tco_grd_diag "Debounce counter maximum value - TCO Signal gradient diagnosis" VALUE 0xffe40607 _REC_VAL_20_u1 254. _CNV_A_R_LINEAR_____0_CM 1. 255. DISPLAY_IDENTIFIER C_ABC_MAX_TCO_GRD_DIAG FORMAT "%3.0" /end CHARACTERISTIC
/begin CHARACTERISTIC c_abc_max_tco_el "Debounce counter maximum value - TCO diagnosis" VALUE 0xffe40605 _REC_VAL_20_u1 254. _CNV_A_R_LINEAR_____0_CM 1. 255. DISPLAY_IDENTIFIER C_ABC_MAX_TCO_EL FORMAT "%3.0" /end CHARACTERISTIC
/begin CHARACTERISTIC c_abc_inc_tco_el "Debounce counter increment- TCO diagnosis" VALUE 0xffe40593 _REC_VAL_20_u1 255. _CNV_A_R_LINEAR_____0_CM 0. 255. DISPLAY_IDENTIFIER C_ABC_INC_TCO_EL FORMAT "%3.0" /end CHARACTERISTIC
/begin CHARACTERISTIC c_abc_inc_tco_ex "Debounce counter increment - TCO_EX diagnosis" VALUE 0xffe40594 _REC_VAL_20_u1 255. _CNV_A_R_LINEAR_____0_CM 0. 255. DISPLAY_IDENTIFIER C_ABC_INC_TCO_EX FORMAT "%3.0" /end CHARACTERISTIC
/begin CHARACTERISTIC c_abc_max_tco_ex "Debounce counter maximum value- TCO_EX diagnosis" VALUE 0xffe40606 _REC_VAL_20_u1 254. _CNV_A_R_LINEAR_____0_CM 1. 255. DISPLAY_IDENTIFIER C_ABC_MAX_TCO_EX FORMAT "%3.0" /end CHARACTERISTIC
/begin CHARACTERISTIC c_abc_inc_tq_gs_inc_plaus "Debounce counter increment - TQ_GS_INC Diagnosis" VALUE 0xffe405b0 _REC_VAL_20_u1 255. _CNV_A_R_LINEAR_____0_CM 0. 255. DISPLAY_IDENTIFIER C_ABC_INC_TQ_GS_INC_PLAUS FORMAT "%3.0" /end CHARACTERISTIC
/begin CHARACTERISTIC c_abc_max_tq_gs_inc_plaus "Debounce counter maximum - TQ_GS_INC Diagnosis" VALUE 0xffe4061e _REC_VAL_20_u1 254. _CNV_A_R_LINEAR_____0_CM 1. 255. DISPLAY_IDENTIFIER C_ABC_MAX_TQ_GS_INC_PLAUS FORMAT "%3.0" /end CHARACTERISTIC
/begin MEASUREMENT int_tq_gs_inc "Integrated Torque request EGS" UWORD _CNV_A_R_LINEAR_____102_CM 1 100. 0. 204.7 DISPLAY_IDENTIFIER INT_TQ_GS_INC ECU_ADDRESS 0x3fdb70 BYTE_ORDER MSB_LAST FORMAT "%7.3" /end MEASUREMENT
/begin MEASUREMENT lv_ac_max_tq_gs_inc "GS about AC requested torque value to high and not plausible" UBYTE _CNV_S_2_RANGE______2_CM 1 100. 0. 1. DISPLAY_IDENTIFIER LV_AC_MAX_TQ_GS_INC ECU_ADDRESS 0x3fe9f9 /end MEASUREMENT
/begin MEASUREMENT lv_t_min_tq_gs_inc_deac "Minimum time between two requests to low" UBYTE _CNV_S_2_RANGE______2_CM 1 100. 0. 1. DISPLAY_IDENTIFIER LV_T_MIN_TQ_GS_INC_DEAC ECU_ADDRESS 0x3fe9fa /end MEASUREMENT
/begin MEASUREMENT ctr_t_dif_min_tq_gs_inc "Counter Min time limit threshold time delay" UBYTE _CNV_A_R_LINEAR_____4_CM 1 100. 0. 2.55 DISPLAY_IDENTIFIER CTR_T_DIF_MIN_TQ_GS_INC ECU_ADDRESS 0x3fea00 FORMAT "%4.2" /end MEASUREMENT
/begin MEASUREMENT state_gs_plaus "State GS torque increase not plausible" UBYTE _CNV_A_R_LINEAR_____0_CM 1 100. 0. 255. DISPLAY_IDENTIFIER STATE_GS_PLAUS ECU_ADDRESS 0x3fe9f3 FORMAT "%3.0" /end MEASUREMENT
/begin MEASUREMENT lv_vs_min_tq_gs_inc "GS about VS torque increase not plausible" UBYTE _CNV_S_2_RANGE______2_CM 1 100. 0. 1. DISPLAY_IDENTIFIER LV_VS_MIN_TQ_GS_INC ECU_ADDRESS 0x3fe9f7 /end MEASUREMENT
/begin MEASUREMENT ctr_t_vs_tq_gs_inc "Vehicle speed threshold time delay" UBYTE _CNV_A_R_LINEAR_____4_CM 1 100. 0. 2.55 DISPLAY_IDENTIFIER CTR_T_VS_TQ_GS_INC ECU_ADDRESS 0x3fe9fe FORMAT "%4.2" /end MEASUREMENT
/begin CHARACTERISTIC c_int_tq_gs_inc_rest "Minimum integrated GS intervention torque" VALUE 0xffe4167a _REC_VAL_20_u2 204.7 _CNV_A_R_LINEAR_____102_CM 0. 204.7 DISPLAY_IDENTIFIER C_INT_TQ_GS_INC_REST FORMAT "%7.3" /end CHARACTERISTIC
/begin CHARACTERISTIC c_vs_min_tq_gs_inc "Vehicle speed threshold" VALUE 0xffe41bb8 _REC_VAL_20_u2 511.99218 _CNV_A_R_LINEAR_____85_CM 0. 511.99218 DISPLAY_IDENTIFIER C_VS_MIN_TQ_GS_INC FORMAT "%7.3" /end CHARACTERISTIC
/begin CHARACTERISTIC c_t_dly_min_vs_tq_gs_inc "Vehicle speed threshold time delay" VALUE 0xffe4088c _REC_VAL_20_u1 2.55 _CNV_A_R_LINEAR_____4_CM 0. 2.55 DISPLAY_IDENTIFIER C_T_DLY_MIN_VS_TQ_GS_INC FORMAT "%4.2" /end CHARACTERISTIC
/begin CHARACTERISTIC c_crlc_tq_gs_inc_plaus "Correlation of torque request " VALUE 0xffe40696 _REC_VAL_20_u1 0.99610001 _CNV_A_R_LINEAR_____29_CM 0. 0.99610001 DISPLAY_IDENTIFIER C_CRLC_TQ_GS_INC_PLAUS FORMAT "%5.3" /end CHARACTERISTIC
/begin CHARACTERISTIC c_int_max_tq_gs_inc "Max value integrated torque" VALUE 0xffe41676 _REC_VAL_20_u2 204.7 _CNV_A_R_LINEAR_____102_CM 0. 204.7 DISPLAY_IDENTIFIER C_INT_MAX_TQ_GS_INC FORMAT "%7.3" /end CHARACTERISTIC
/begin CHARACTERISTIC c_int_min_tq_gs_inc "Min value integrated torque" VALUE 0xffe41678 _REC_VAL_20_u2 204.7 _CNV_A_R_LINEAR_____102_CM 0. 204.7 DISPLAY_IDENTIFIER C_INT_MIN_TQ_GS_INC FORMAT "%7.3" /end CHARACTERISTIC
/begin CHARACTERISTIC c_t_dly_min_ac_tq_gs_inc "AC threshold time delay" VALUE 0xffe4088b _REC_VAL_20_u1 2.55 _CNV_A_R_LINEAR_____4_CM 0. 2.55 DISPLAY_IDENTIFIER C_T_DLY_MIN_AC_TQ_GS_INC FORMAT "%4.2" /end CHARACTERISTIC
/begin MEASUREMENT lv_int_max_tq_gs_inc "Gs requested torque value to high and not plausible" UBYTE _CNV_S_2_RANGE______2_CM 1 100. 0. 1. DISPLAY_IDENTIFIER LV_INT_MAX_TQ_GS_INC ECU_ADDRESS 0x3fe9f8 /end MEASUREMENT
/begin MEASUREMENT ctr_t_ac_tq_gs_inc "AC counter time delay" UBYTE _CNV_A_R_LINEAR_____4_CM 1 100. 0. 2.55 DISPLAY_IDENTIFIER CTR_T_AC_TQ_GS_INC ECU_ADDRESS 0x3fe9ff FORMAT "%4.2" /end MEASUREMENT
/begin CHARACTERISTIC c_t_dif_min_tq_gs_inc "Min time limit threshold time delay" VALUE 0xffe40872 _REC_VAL_20_u1 2.55 _CNV_A_R_LINEAR_____4_CM 0. 2.55 DISPLAY_IDENTIFIER C_T_DIF_MIN_TQ_GS_INC FORMAT "%4.2" /end CHARACTERISTIC
/begin MEASUREMENT lv_t_max_tq_gs_inc "Requesting time to long" UBYTE _CNV_S_2_RANGE______2_CM 1 100. 0. 1. DISPLAY_IDENTIFIER LV_T_MAX_TQ_GS_INC ECU_ADDRESS 0x3fe9fb /end MEASUREMENT
/begin MEASUREMENT ctr_t_max_tq_gs_inc "Counter MAX time limit threshold time" UBYTE _CNV_A_R_LINEAR_____4_CM 1 100. 0. 2.55 DISPLAY_IDENTIFIER CTR_T_MAX_TQ_GS_INC ECU_ADDRESS 0x3fea01 FORMAT "%4.2" /end MEASUREMENT
/begin CHARACTERISTIC ip_ac_max_tq_gs_inc "Acceleration threshold" CURVE 0xffe48e9c _REC_CUR_20_u2_u2 102.35 _CNV_A_R_LINEAR_____103_CM -51.175 51.175 DISPLAY_IDENTIFIER IP_AC_MAX_TQ_GS_INC FORMAT "%7.4"
 /begin AXIS_DESCR COM_AXIS vs_fil _CNV_A_R_LINEAR_____85_CM 6 0. 511.99218 FORMAT "%7.3" AXIS_PTS_REF ldp_vs_fil__tq_gs_inc /end AXIS_DESCR
/end CHARACTERISTIC
/begin CHARACTERISTIC ip_tq_max_tq_gs_inc "Maximum requested torque EGS" CURVE 0xffe4ff42 _REC_CUR_20_u2_u1 1023.96875 _CNV_A_R_LINEAR_____55_CM 0. 1023.96875 DISPLAY_IDENTIFIER IP_TQ_MAX_TQ_GS_INC FORMAT "%7.2"
 /begin AXIS_DESCR COM_AXIS n_32 _CNV_A_R_LINEAR_____15_CM 6 0. 8160. FORMAT "%4.0" AXIS_PTS_REF ldp_n_32__tq_gs_inc /end AXIS_DESCR
/end CHARACTERISTIC
/begin CHARACTERISTIC c_t_max_tq_gs_inc "Min time limit threshold time delay" VALUE 0xffe408b0 _REC_VAL_20_u1 2.55 _CNV_A_R_LINEAR_____4_CM 0. 2.55 DISPLAY_IDENTIFIER C_T_MAX_TQ_GS_INC FORMAT "%4.2" /end CHARACTERISTIC
/begin CHARACTERISTIC c_t_dly_tq_max_tq_gs_inc "Min time limit threshold time delay" VALUE 0xffe40893 _REC_VAL_20_u1 2.55 _CNV_A_R_LINEAR_____4_CM 0. 2.55 DISPLAY_IDENTIFIER C_T_DLY_TQ_MAX_TQ_GS_INC FORMAT "%4.2" /end CHARACTERISTIC
/begin MEASUREMENT state_err_amt_can "State of AMT Error intervention CAN 11H" UBYTE _CNV_A_R_LINEAR_____0_CM 1 100. 0. 5. DISPLAY_IDENTIFIER STATE_ERR_AMT_CAN ECU_ADDRESS 0x3fe9f5 FORMAT "%2.0" /end MEASUREMENT
/begin MEASUREMENT lv_amt_es_req "AMT request of engine stop" UBYTE _CNV_S_2_RANGE______2_CM 1 100. 0. 1. DISPLAY_IDENTIFIER LV_AMT_ES_REQ ECU_ADDRESS 0x3fe9fd /end MEASUREMENT
/begin MEASUREMENT t_state_amt_1_diag "Intervention  in shift phase 1" UWORD _CNV_A_R_LINEAR_____4_CM 1 100. 0. 655.35 DISPLAY_IDENTIFIER T_STATE_AMT_1_DIAG ECU_ADDRESS 0x3fdb74 BYTE_ORDER MSB_LAST FORMAT "%6.2" /end MEASUREMENT
/begin MEASUREMENT t_state_amt_2_diag "Intervention  in shift phase 2" UWORD _CNV_A_R_LINEAR_____4_CM 1 100. 0. 655.35 DISPLAY_IDENTIFIER T_STATE_AMT_2_DIAG ECU_ADDRESS 0x3fdb76 BYTE_ORDER MSB_LAST FORMAT "%6.2" /end MEASUREMENT
/begin MEASUREMENT t_state_amt_3_diag "Intervention  in shift phase 3" UWORD _CNV_A_R_LINEAR_____4_CM 1 100. 0. 655.35 DISPLAY_IDENTIFIER T_STATE_AMT_3_DIAG ECU_ADDRESS 0x3fdb78 BYTE_ORDER MSB_LAST FORMAT "%6.2" /end MEASUREMENT
/begin MEASUREMENT state_err_amt "State of AMT Error intervention" UBYTE _CNV_A_R_LINEAR_____0_CM 1 100. 0. 255. DISPLAY_IDENTIFIER STATE_ERR_AMT ECU_ADDRESS 0x3fe9f4 FORMAT "%3.0" /end MEASUREMENT
/begin MEASUREMENT state_amt_old "Previos shift phase3" UBYTE _CNV_A_R_LINEAR_____0_CM 1 100. 0. 3. DISPLAY_IDENTIFIER STATE_AMT_OLD ECU_ADDRESS 0x3fea03 FORMAT "%2.0" /end MEASUREMENT
/begin MEASUREMENT t_state_clu_amt_diag "Timer clutch state " UWORD _CNV_A_R_LINEAR_____4_CM 1 100. 0. 655.35 DISPLAY_IDENTIFIER T_STATE_CLU_AMT_DIAG ECU_ADDRESS 0x3fdb7e BYTE_ORDER MSB_LAST FORMAT "%6.2" /end MEASUREMENT
/begin CHARACTERISTIC c_vs_fil_amt "Vehicle speed threshold  engine stop" VALUE 0xffe41bac _REC_VAL_20_u2 511.99218 _CNV_A_R_LINEAR_____85_CM 0. 511.99218 DISPLAY_IDENTIFIER C_VS_FIL_AMT FORMAT "%7.3" /end CHARACTERISTIC
/begin CHARACTERISTIC c_t_max_state_amt_1_diag "Max Intervention  in shift phase 1" VALUE 0xffe419a0 _REC_VAL_20_u2 655.35 _CNV_A_R_LINEAR_____4_CM 0. 655.35 DISPLAY_IDENTIFIER C_T_MAX_STATE_AMT_1_DIAG FORMAT "%6.2" /end CHARACTERISTIC
/begin CHARACTERISTIC c_t_max_state_amt_2_diag "Max Intervention  in shift phase 2" VALUE 0xffe419a2 _REC_VAL_20_u2 655.35 _CNV_A_R_LINEAR_____4_CM 0. 655.35 DISPLAY_IDENTIFIER C_T_MAX_STATE_AMT_2_DIAG FORMAT "%6.2" /end CHARACTERISTIC
/begin CHARACTERISTIC c_t_max_tqi_amt_diag "Max. timer shift intervention phase 1or 3" VALUE 0xffe419a8 _REC_VAL_20_u2 655.35 _CNV_A_R_LINEAR_____4_CM 0. 655.35 DISPLAY_IDENTIFIER C_T_MAX_TQI_AMT_DIAG FORMAT "%6.2" /end CHARACTERISTIC
/begin CHARACTERISTIC c_tqi_amt_diag "Plausibility torque intervention hysteresis" VALUE 0xffe41ae0 _REC_VAL_20_u2 1023.96875 _CNV_A_R_LINEAR_____55_CM 0. 1023.96875 DISPLAY_IDENTIFIER C_TQI_AMT_DIAG FORMAT "%7.2" /end CHARACTERISTIC
/begin CHARACTERISTIC c_tqi_amt_cond_diag "Torque at shift phase 0" VALUE 0xffe41ade _REC_VAL_20_u2 1023.96875 _CNV_A_R_LINEAR_____55_CM 0. 1023.96875 DISPLAY_IDENTIFIER C_TQI_AMT_COND_DIAG FORMAT "%7.2" /end CHARACTERISTIC
/begin CHARACTERISTIC c_tqi_amt_can_es "Torque at engine stop" VALUE 0xffe41adc _REC_VAL_20_u2 1023.96875 _CNV_A_R_LINEAR_____55_CM 0. 1023.96875 DISPLAY_IDENTIFIER C_TQI_AMT_CAN_ES FORMAT "%7.2" /end CHARACTERISTIC
/begin CHARACTERISTIC c_t_max_state_amt_3_diag "Max Intervention  in shift phase 3" VALUE 0xffe419a4 _REC_VAL_20_u2 655.35 _CNV_A_R_LINEAR_____4_CM 0. 655.35 DISPLAY_IDENTIFIER C_T_MAX_STATE_AMT_3_DIAG FORMAT "%6.2" /end CHARACTERISTIC
/begin CHARACTERISTIC c_t_max_state_clu_amt_diag "Max. time at clutch" VALUE 0xffe419a6 _REC_VAL_20_u2 655.35 _CNV_A_R_LINEAR_____4_CM 0. 655.35 DISPLAY_IDENTIFIER C_T_MAX_STATE_CLU_AMT_DIAG FORMAT "%6.2" /end CHARACTERISTIC
/begin MEASUREMENT lv_tq_max_tq_gs_inc "Inegrated torque to high" UBYTE _CNV_S_2_RANGE______2_CM 1 100. 0. 1. DISPLAY_IDENTIFIER LV_TQ_MAX_TQ_GS_INC ECU_ADDRESS 0x3fe9fc /end MEASUREMENT
/begin MEASUREMENT ctr_t_tq_max_tq_gs_inc "Min time limit threshold time delay" UBYTE _CNV_A_R_LINEAR_____4_CM 1 100. 0. 2.55 DISPLAY_IDENTIFIER CTR_T_TQ_MAX_TQ_GS_INC ECU_ADDRESS 0x3fea02 FORMAT "%4.2" /end MEASUREMENT
/begin MEASUREMENT tqi_amt_plaus "Plausibility torque" UWORD _CNV_A_R_LINEAR_____55_CM 1 100. 0. 1023.96875 DISPLAY_IDENTIFIER TQI_AMT_PLAUS ECU_ADDRESS 0x3fdb72 BYTE_ORDER MSB_LAST FORMAT "%7.2" /end MEASUREMENT
/begin AXIS_PTS ldp_vs_fil__tq_gs_inc "" 0xffe51708 vs_fil _REC_AXS_20_u2 511.99218 _CNV_A_R_LINEAR_____85_CM 6 0. 511.99218 DISPLAY_IDENTIFIER LDP_VS_FIL__TQ_GS_INC FORMAT "%7.3" /end AXIS_PTS
/begin AXIS_PTS ldp_n_32__tq_gs_inc "" 0xffe410c5 n_32 _REC_AXS_20_u1 8160. _CNV_A_R_LINEAR_____15_CM 6 0. 8160. DISPLAY_IDENTIFIER LDP_N_32__TQ_GS_INC FORMAT "%4.0" /end AXIS_PTS
/begin MEASUREMENT lv_err_tq_gs_inc_plaus "GS torque increase not plausible" UBYTE _CNV_S_2_RANGE______1_R_CM 1 100. 0. 255. DISPLAY_IDENTIFIER LV_ERR_TQ_GS_INC_PLAUS ECU_ADDRESS 0x3fba90 /end MEASUREMENT
/begin MEASUREMENT lv_err_tecu "TECU error flag" UBYTE _CNV_S_2_RANGE______1_R_CM 1 100. 0. 255. DISPLAY_IDENTIFIER LV_ERR_TECU ECU_ADDRESS 0x3fba4c /end MEASUREMENT
/begin CHARACTERISTIC c_tia_max_tecu_diag "TIA threshold - TECU diagnosis" VALUE 0xffe40961 _REC_VAL_20_u1 190.5 _CNV_A_R_LINEAR_____11_CM -48. 142.5 DISPLAY_IDENTIFIER C_TIA_MAX_TECU_DIAG FORMAT "%5.1" /end CHARACTERISTIC
/begin CHARACTERISTIC c_abc_max_tecu "Maximum value of the anti - bounce counter" VALUE 0xffe40609 _REC_VAL_20_u1 254. _CNV_A_R_LINEAR_____0_CM 1. 255. DISPLAY_IDENTIFIER C_ABC_MAX_TECU FORMAT "%3.0" /end CHARACTERISTIC
/begin CHARACTERISTIC c_abc_inc_tecu "Anti - bounce counter increment" VALUE 0xffe40597 _REC_VAL_20_u1 255. _CNV_A_R_LINEAR_____0_CM 0. 255. DISPLAY_IDENTIFIER C_ABC_INC_TECU FORMAT "%3.0" /end CHARACTERISTIC
/begin CHARACTERISTIC c_v_tecu_min_diag "V_TECU threshold for short to VB or line break - TECU diagnosis" VALUE 0xffe41b0e _REC_VAL_20_u2 4.99511719 _CNV_A_R_LINEAR_____3_CM 0. 4.99511719 DISPLAY_IDENTIFIER C_V_TECU_MIN_DIAG FORMAT "%5.3" /end CHARACTERISTIC
/begin CHARACTERISTIC c_v_tecu_max_diag "V_TECU threshold for short to ground - TECU diagnosis" VALUE 0xffe41b0c _REC_VAL_20_u2 4.99511719 _CNV_A_R_LINEAR_____3_CM 0. 4.99511719 DISPLAY_IDENTIFIER C_V_TECU_MAX_DIAG FORMAT "%5.3" /end CHARACTERISTIC
/begin CHARACTERISTIC c_abc_inc_tia "Debounce counter increment - TIA diagnosis" VALUE 0xffe40598 _REC_VAL_20_u1 255. _CNV_A_R_LINEAR_____0_CM 0. 255. DISPLAY_IDENTIFIER C_ABC_INC_TIA FORMAT "%3.0" /end CHARACTERISTIC
/begin CHARACTERISTIC c_abc_max_tia "Debounce counter maximum value - TIA diagnosis" VALUE 0xffe4060a _REC_VAL_20_u1 254. _CNV_A_R_LINEAR_____0_CM 1. 255. DISPLAY_IDENTIFIER C_ABC_MAX_TIA FORMAT "%3.0" /end CHARACTERISTIC
/begin CHARACTERISTIC c_n_max_tps_ad "" VALUE 0xffe407ec _REC_VAL_20_u1 8160. _CNV_A_R_LINEAR_____15_CM 0. 8160. DISPLAY_IDENTIFIER C_N_MAX_TPS_AD FORMAT "%4.0" /end CHARACTERISTIC
/begin CHARACTERISTIC c_t_max_tps_ad "Maximum time for Adaptation of the LIH and BOL position" VALUE 0xffe408ad _REC_VAL_20_u1 1.275 _CNV_A_R_LINEAR_____414_CM 0. 1.275 DISPLAY_IDENTIFIER C_T_MAX_TPS_AD FORMAT "%4.3" /end CHARACTERISTIC
/begin CHARACTERISTIC c_t_max_tps_lih_chk "Maximum time for Limp Home recognition" VALUE 0xffe408ae _REC_VAL_20_u1 1.275 _CNV_A_R_LINEAR_____414_CM 0. 1.275 DISPLAY_IDENTIFIER C_T_MAX_TPS_LIH_CHK FORMAT "%4.3" /end CHARACTERISTIC
/begin CHARACTERISTIC c_t_max_tps_sp_rst_chk "Maximum time to reach the position C_TPS_SP_RST_CHK" VALUE 0xffe408af _REC_VAL_20_u1 1.275 _CNV_A_R_LINEAR_____414_CM 0. 1.275 DISPLAY_IDENTIFIER C_T_MAX_TPS_SP_RST_CHK FORMAT "%4.3" /end CHARACTERISTIC
/begin CHARACTERISTIC c_t_tps_ad_hys "Time period for hysteresis band to Adaptation" VALUE 0xffe408ce _REC_VAL_20_u1 1.275 _CNV_A_R_LINEAR_____414_CM 0. 1.275 DISPLAY_IDENTIFIER C_T_TPS_AD_HYS FORMAT "%4.3" /end CHARACTERISTIC
/begin CHARACTERISTIC c_tco_max_tps_ad "" VALUE 0xffe4090b _REC_VAL_20_u1 190.5 _CNV_A_R_LINEAR_____11_CM -48. 142.5 DISPLAY_IDENTIFIER C_TCO_MAX_TPS_AD FORMAT "%5.1" /end CHARACTERISTIC
/begin CHARACTERISTIC c_tco_min_tps_ad "" VALUE 0xffe40921 _REC_VAL_20_u1 190.5 _CNV_A_R_LINEAR_____11_CM -48. 142.5 DISPLAY_IDENTIFIER C_TCO_MIN_TPS_AD FORMAT "%5.1" /end CHARACTERISTIC
/begin CHARACTERISTIC c_tia_min_tps_ad "" VALUE 0xffe40966 _REC_VAL_20_u1 190.5 _CNV_A_R_LINEAR_____11_CM -48. 142.5 DISPLAY_IDENTIFIER C_TIA_MIN_TPS_AD FORMAT "%4.1" /end CHARACTERISTIC
/begin CHARACTERISTIC c_tps_sp_bol_lgrd "Change limitation for stopping the lower position" VALUE 0xffe40985 _REC_VAL_20_u1 1.85271285 _CNV_A_R_LINEAR_____501_CM 7.29415e-003 1.860007 DISPLAY_IDENTIFIER C_TPS_SP_BOL_LGRD FORMAT "%4.3" /end CHARACTERISTIC
/begin CHARACTERISTIC c_tps_sp_rst_chk_bas "TPS_SP for testing the retracting spring" VALUE 0xffe41ab8 _REC_VAL_20_u2 119.5 _CNV_A_R_LINEAR_____53_CM 0. 119.5 DISPLAY_IDENTIFIER C_TPS_SP_RST_CHK_BAS /end CHARACTERISTIC
/begin CHARACTERISTIC c_tps_sp_rst_chk_hys "Hysteresis of C_TPS_SP_RST_CHK" VALUE 0xffe40987 _REC_VAL_20_u1 1.85271285 _CNV_A_R_LINEAR_____502_CM 7.29415e-003 1.860007 DISPLAY_IDENTIFIER C_TPS_SP_RST_CHK_HYS FORMAT "%4.3" /end CHARACTERISTIC
/begin CHARACTERISTIC c_tps_sp_rst_chk_lgrd "Change limitation for stopping the position C_TPS_SP_RST_CHK" VALUE 0xffe40988 _REC_VAL_20_u1 1.85271285 _CNV_A_R_LINEAR_____501_CM 7.29415e-003 1.860007 DISPLAY_IDENTIFIER C_TPS_SP_RST_CHK_LGRD FORMAT "%4.3" /end CHARACTERISTIC
/begin CHARACTERISTIC c_v_tps_ad_hys "Hysteresis band for Adaptation value determination" VALUE 0xffe409a3 _REC_VAL_20_u1 1.24511719 _CNV_A_R_LINEAR_____447_CM 0. 1.24511719 DISPLAY_IDENTIFIER C_V_TPS_AD_HYS FORMAT "%4.3" /end CHARACTERISTIC
/begin CHARACTERISTIC c_v_tps_ad_win_lih "Adaptation window size (+/-) for Adaptation of the Limp Home position" VALUE 0xffe409a6 _REC_VAL_20_u1 2.49023438 _CNV_A_R_LINEAR_____503_CM 0. 2.49023438 DISPLAY_IDENTIFIER C_V_TPS_AD_WIN_LIH FORMAT "%4.3" /end CHARACTERISTIC
/begin CHARACTERISTIC c_v_tps_sp_bol_1 "" VALUE 0xffe409a8 _REC_VAL_20_u1 4.998 _CNV_A_R_LINEAR_____44_CM 0. 4.998 DISPLAY_IDENTIFIER C_V_TPS_SP_BOL_1 FORMAT "%3.2" /end CHARACTERISTIC
/begin CHARACTERISTIC c_v_tps_sp_bol_2 "" VALUE 0xffe409a9 _REC_VAL_20_u1 4.998 _CNV_A_R_LINEAR_____44_CM 0. 4.998 DISPLAY_IDENTIFIER C_V_TPS_SP_BOL_2 FORMAT "%3.2" /end CHARACTERISTIC
/begin CHARACTERISTIC c_vb_min_tps_ad "" VALUE 0xffe409c2 _REC_VAL_20_u1 25.8984 _CNV_A_R_LINEAR_____34_CM 0. 25.8984 DISPLAY_IDENTIFIER C_VB_MIN_TPS_AD FORMAT "%3.1" /end CHARACTERISTIC
/begin MEASUREMENT lv_n_lim_tps_ad "Demand security trailing throttle fuel cut off (SAS)" UBYTE _CNV_S_2_RANGE______2_CM 1 100. 0. 1. DISPLAY_IDENTIFIER LV_N_LIM_TPS_AD ECU_ADDRESS 0x3fea9d BIT_MASK 0x1 /end MEASUREMENT
/begin MEASUREMENT lv_tps_ad_cur_off "Demand ETC Limp Home" UBYTE _CNV_S_2_RANGE______2_CM 1 100. 0. 1. DISPLAY_IDENTIFIER LV_TPS_AD_CUR_OFF ECU_ADDRESS 0x3feaa1 BIT_MASK 0x1 /end MEASUREMENT
/begin MEASUREMENT lv_tps_ad_diag_cur_off "Demand ETC LIMP HOME" UBYTE _CNV_S_2_RANGE______2_CM 1 100. 0. 1. DISPLAY_IDENTIFIER LV_TPS_AD_DIAG_CUR_OFF ECU_ADDRESS 0x3fea9e BIT_MASK 0x1 /end MEASUREMENT
/begin MEASUREMENT tps_sp_ad "Throttle position setpoint during Adaptation" UWORD _CNV_A_R_LINEAR_____53_CM 1 100. 0. 119.5 DISPLAY_IDENTIFIER TPS_SP_AD ECU_ADDRESS 0x3fdcd0 BYTE_ORDER MSB_LAST FORMAT "%7.3" /end MEASUREMENT
/begin MEASUREMENT v_tps_ad_el_bol_1 "Adaptation value for the lower electronic stop, TPS-channel 1" UWORD _CNV_A_R_LINEAR_____3_CM 1 100. 0. 4.99511719 DISPLAY_IDENTIFIER V_TPS_AD_EL_BOL_1 ECU_ADDRESS 0x3fdcc4 BYTE_ORDER MSB_LAST FORMAT "%5.3" /end MEASUREMENT
/begin MEASUREMENT v_tps_ad_el_bol_2 "Adaptation value for the lower electronic stop, TPS-channel 2" UWORD _CNV_A_R_LINEAR_____3_CM 1 100. 0. 4.99511719 DISPLAY_IDENTIFIER V_TPS_AD_EL_BOL_2 ECU_ADDRESS 0x3fdcc6 BYTE_ORDER MSB_LAST FORMAT "%5.3" /end MEASUREMENT
/begin MEASUREMENT v_tps_ad_lih_1 "Adaptation value for the limp home position, TPS-channel 1" UWORD _CNV_A_R_LINEAR_____3_CM 1 100. 0. 4.99511719 DISPLAY_IDENTIFIER V_TPS_AD_LIH_1 ECU_ADDRESS 0x3fdcc8 BYTE_ORDER MSB_LAST FORMAT "%5.3" /end MEASUREMENT
/begin MEASUREMENT v_tps_ad_lih_2 "Adaptation value for the limp home position, TPS-channel 2" UWORD _CNV_A_R_LINEAR_____3_CM 1 100. 0. 4.99511719 DISPLAY_IDENTIFIER V_TPS_AD_LIH_2 ECU_ADDRESS 0x3fdcca BYTE_ORDER MSB_LAST FORMAT "%5.3" /end MEASUREMENT
/begin MEASUREMENT lv_tps_ad_act "TPS diagnosis/Adaptation condition is fulfilled" UBYTE _CNV_S_2_RANGE______2_CM 1 100. 0. 1. DISPLAY_IDENTIFIER LV_TPS_AD_ACT ECU_ADDRESS 0x3feaa0 BIT_MASK 0x1 /end MEASUREMENT
/begin MEASUREMENT tps_ad_slop_gain_1 "Adaptation value of the amplification factor of amplified poti 1" UWORD _CNV_A_R_LINEAR_____394_CM 1 100. 0. 7.99987793 DISPLAY_IDENTIFIER TPS_AD_SLOP_GAIN_1 ECU_ADDRESS 0x3fdccc BYTE_ORDER MSB_LAST FORMAT "%6.4" /end MEASUREMENT
/begin MEASUREMENT tps_lih_1 "Limp home position of the throttle valve of TPS-Poti 1" UWORD _CNV_A_R_LINEAR_____53_CM 1 100. 0. 119.5 DISPLAY_IDENTIFIER TPS_LIH_1 ECU_ADDRESS 0x3fdcd2 BYTE_ORDER MSB_LAST FORMAT "%7.3" /end MEASUREMENT
/begin MEASUREMENT tps_lih_2 "Limp home position  of the throttle valve of TPS-Poti 2" UWORD _CNV_A_R_LINEAR_____53_CM 1 100. 0. 119.5 DISPLAY_IDENTIFIER TPS_LIH_2 ECU_ADDRESS 0x3fdcd4 BYTE_ORDER MSB_LAST FORMAT "%7.3" /end MEASUREMENT
/begin MEASUREMENT lv_tps_ad_req "Demand TPS-Adaptation" UBYTE _CNV_S_2_RANGE______2_CM 1 100. 0. 1. DISPLAY_IDENTIFIER LV_TPS_AD_REQ ECU_ADDRESS 0x3fea9f BIT_MASK 0x1 /end MEASUREMENT
/begin CHARACTERISTIC c_tps_sp_spr_chk_up "TPS_SP for limp home spring test on the Adaptation routine" VALUE 0xffe41aba _REC_VAL_20_u2 119.5 _CNV_A_R_LINEAR_____53_CM 0. 119.5 DISPLAY_IDENTIFIER C_TPS_SP_SPR_CHK_UP FORMAT "%7.3" /end CHARACTERISTIC
/begin MEASUREMENT tps_lih_ini "" UWORD _CNV_A_R_LINEAR_____53_CM 1 100. 0. 119.5 DISPLAY_IDENTIFIER TPS_LIH_INI ECU_ADDRESS 0x3fdcd6 BYTE_ORDER MSB_LAST FORMAT "%7.3" /end MEASUREMENT
/begin MEASUREMENT v_tps_ad_bol_gain_1 "Adaptation value for the lower mechanical stop of the amplification poti 1" UWORD _CNV_A_R_LINEAR_____3_CM 1 100. 0. 4.99511719 DISPLAY_IDENTIFIER V_TPS_AD_BOL_GAIN_1 ECU_ADDRESS 0x3fdcdc BYTE_ORDER MSB_LAST FORMAT "%5.3" /end MEASUREMENT
/begin MEASUREMENT v_tps_ad_tol_1 "Non-amplified upper value for the Adaptation of amplified of TPS-channel 1" UWORD _CNV_A_R_LINEAR_____3_CM 1 100. 0. 4.99511719 DISPLAY_IDENTIFIER V_TPS_AD_TOL_1 ECU_ADDRESS 0x3fdce0 BYTE_ORDER MSB_LAST FORMAT "%5.3" /end MEASUREMENT
/begin MEASUREMENT v_tps_ad_tol_gain_1 "Amplified upper value for the Adaptation of amplified of TPS-channel 1" UWORD _CNV_A_R_LINEAR_____3_CM 1 100. 0. 4.99511719 DISPLAY_IDENTIFIER V_TPS_AD_TOL_GAIN_1 ECU_ADDRESS 0x3fdcde BYTE_ORDER MSB_LAST FORMAT "%5.3" /end MEASUREMENT
/begin MEASUREMENT inh_iv_tps_ad "logical variable to inhibit injection and ignition during TPS Adaptation" UBYTE _CNV_S_2_RANGE______1_R_CM 1 100. 0. 255. DISPLAY_IDENTIFIER INH_IV_TPS_AD ECU_ADDRESS 0x3fea9c /end MEASUREMENT
/begin MEASUREMENT v_tps_ad_ofs_gain_1 "Adaptation value of the amplification offset of  of amplified poti 1" SWORD _CNV_A_R_LINEAR_____269_CM 1 100. -2.5 2.5 DISPLAY_IDENTIFIER V_TPS_AD_OFS_GAIN_1 ECU_ADDRESS 0x3fdcce BYTE_ORDER MSB_LAST /end MEASUREMENT
/begin MEASUREMENT lv_tps_ad_mec_bol "logical variable data" UBYTE _CNV_S_2_RANGE______5_R_CM 1 100. 0. 255. DISPLAY_IDENTIFIER LV_TPS_AD_MEC_BOL ECU_ADDRESS 0x3feaa2 /end MEASUREMENT
/begin MEASUREMENT tps_ad_step "Steps of throttle Adaptation" ULONG _CNV_S_11_RANGE_TPS__504_CM 1 100. 0. 10. DISPLAY_IDENTIFIER TPS_AD_STEP ECU_ADDRESS 0x3feaa4 BYTE_ORDER MSB_LAST /end MEASUREMENT
/begin CHARACTERISTIC c_tps_sp_rst_chk "TPS_SP for testing the retracting spring" VALUE 0xffe41ab6 _REC_VAL_20_u2 119.5 _CNV_A_R_LINEAR_____53_CM 0. 119.5 DISPLAY_IDENTIFIER C_TPS_SP_RST_CHK /end CHARACTERISTIC
/begin CHARACTERISTIC c_tps_av_rst_chk "Threshold for activation the position controller" VALUE 0xffe41a8a _REC_VAL_20_u2 119.5 _CNV_A_R_LINEAR_____53_CM 0. 119.5 DISPLAY_IDENTIFIER C_TPS_AV_RST_CHK FORMAT "%7.3" /end CHARACTERISTIC
/begin CHARACTERISTIC c_t_tps_av_rst_chk "Time condition for deactivation the position controller" VALUE 0xffe408cf _REC_VAL_20_u1 1.275 _CNV_A_R_LINEAR_____414_CM 0. 1.275 DISPLAY_IDENTIFIER C_T_TPS_AV_RST_CHK FORMAT "%5.3" /end CHARACTERISTIC
/begin CHARACTERISTIC c_abc_inc_tps_ad_bol "Anti - bounce counter increment" VALUE 0xffe405ac _REC_VAL_20_u1 255. _CNV_A_R_LINEAR_____0_CM 0. 255. DISPLAY_IDENTIFIER C_ABC_INC_TPS_AD_BOL FORMAT "%3.0" /end CHARACTERISTIC
/begin CHARACTERISTIC c_abc_max_tps_ad_bol "Maximum value of the anti - bounce counter" VALUE 0xffe4061c _REC_VAL_20_u1 254. _CNV_A_R_LINEAR_____0_CM 1. 255. DISPLAY_IDENTIFIER C_ABC_MAX_TPS_AD_BOL FORMAT "%3.0" /end CHARACTERISTIC
/begin CHARACTERISTIC c_v_tps_ad_win_bol "Adaptation window size (+/-) for Adaptation of lower stop" VALUE 0xffe409a5 _REC_VAL_20_u1 2.49023438 _CNV_A_R_LINEAR_____503_CM 0. 2.49023438 DISPLAY_IDENTIFIER C_V_TPS_AD_WIN_BOL FORMAT "%4.3" /end CHARACTERISTIC
/begin CHARACTERISTIC c_v_tps_ad_win_2_bol "Adaptation window size (+/-) for continously mec BOL Adaptation of lower stop" VALUE 0xffe409a4 _REC_VAL_20_u1 2.49023438 _CNV_A_R_LINEAR_____503_CM 0. 2.49023438 DISPLAY_IDENTIFIER C_V_TPS_AD_WIN_2_BOL FORMAT "%5.3" /end CHARACTERISTIC
/begin MEASUREMENT ctr_st_chk_chk_lih_1_ready "Start check check limp home 1 passed" UWORD _CNV_A_R_LINEAR_____0_CM 1 100. 0. 65535. DISPLAY_IDENTIFIER CTR_ST_CHK_CHK_LIH_1_READY ECU_ADDRESS 0x3fdcd8 BYTE_ORDER MSB_LAST FORMAT "%5.0" /end MEASUREMENT
/begin MEASUREMENT ctr_st_chk_chk_lih_1_err "Start check check limp home 1 not passed" UWORD _CNV_A_R_LINEAR_____0_CM 1 100. 0. 65535. DISPLAY_IDENTIFIER CTR_ST_CHK_CHK_LIH_1_ERR ECU_ADDRESS 0x3fdcda BYTE_ORDER MSB_LAST FORMAT "%5.0" /end MEASUREMENT
/begin MEASUREMENT lv_err_tps_st_chk_2 "TPS-error-bit (Return spring test)" UBYTE _CNV_S_2_RANGE______5_R_CM 1 100. 0. 255. DISPLAY_IDENTIFIER LV_ERR_TPS_ST_CHK_2 ECU_ADDRESS 0x3fb92c /end MEASUREMENT
/begin MEASUREMENT lv_err_tps_ad "TPS-error-bit (Adaptation)" UBYTE _CNV_S_2_RANGE______5_R_CM 1 100. 0. 255. DISPLAY_IDENTIFIER LV_ERR_TPS_AD ECU_ADDRESS 0x3fb920 /end MEASUREMENT
/begin MEASUREMENT lv_err_tps_ad_bol "Error bit" UBYTE _CNV_S_2_RANGE______5_R_CM 1 100. 0. 255. DISPLAY_IDENTIFIER LV_ERR_TPS_AD_BOL ECU_ADDRESS 0x3fb924 /end MEASUREMENT
/begin CHARACTERISTIC c_t_dyw_tps_lih_chk "Time period for Dynamic window around Limp Home" VALUE 0xffe40896 _REC_VAL_20_u1 1.275 _CNV_A_R_LINEAR_____414_CM 0. 1.275 DISPLAY_IDENTIFIER C_T_DYW_TPS_LIH_CHK FORMAT "%4.3" /end CHARACTERISTIC
/begin CHARACTERISTIC c_v_tps_ad_bol_ini_1 "Start value for the Adaptation value lower start (Poti 1)" VALUE 0xffe409a1 _REC_VAL_20_u1 4.998 _CNV_A_R_LINEAR_____44_CM 0. 4.998 DISPLAY_IDENTIFIER C_V_TPS_AD_BOL_INI_1 FORMAT "%3.2" /end CHARACTERISTIC
/begin CHARACTERISTIC c_v_tps_ad_bol_ini_2 "Start value for the Adaptation value lower start (Poti 2)" VALUE 0xffe409a2 _REC_VAL_20_u1 4.998 _CNV_A_R_LINEAR_____44_CM 0. 4.998 DISPLAY_IDENTIFIER C_V_TPS_AD_BOL_INI_2 FORMAT "%3.2" /end CHARACTERISTIC
/begin CHARACTERISTIC c_v_tps_lih_chk_hys "Voltage window around Limp Home position for recognizing a correct MTC" VALUE 0xffe409a7 _REC_VAL_20_u1 1.24511719 _CNV_A_R_LINEAR_____447_CM 0. 1.24511719 DISPLAY_IDENTIFIER C_V_TPS_LIH_CHK_HYS FORMAT "%4.3" /end CHARACTERISTIC
/begin CHARACTERISTIC c_v_tps_sp_lih_1 "Nominal value of the TPS-voltage in Limp Home for Poti 1" VALUE 0xffe409aa _REC_VAL_20_u1 4.998 _CNV_A_R_LINEAR_____44_CM 0. 4.998 DISPLAY_IDENTIFIER C_V_TPS_SP_LIH_1 FORMAT "%3.2" /end CHARACTERISTIC
/begin CHARACTERISTIC c_v_tps_sp_lih_2 "Nominal value of the TPS-voltage in Limp Home for Poti 1" VALUE 0xffe409ab _REC_VAL_20_u1 4.998 _CNV_A_R_LINEAR_____44_CM 0. 4.998 DISPLAY_IDENTIFIER C_V_TPS_SP_LIH_2 FORMAT "%3.2" /end CHARACTERISTIC
/begin CHARACTERISTIC c_tps_ad_slop_gain_ini_1 "" VALUE 0xffe41a86 _REC_VAL_20_u2 7.99987793 _CNV_A_R_LINEAR_____394_CM 0. 7.99987793 DISPLAY_IDENTIFIER C_TPS_AD_SLOP_GAIN_INI_1 FORMAT "%6.4" /end CHARACTERISTIC
/begin CHARACTERISTIC c_v_tps_ad_ofs_gain_ini_1 "" VALUE 0xffe40500 _REC_VAL_20_s2 5. _CNV_A_R_LINEAR_____269_CM -2.5 2.5 DISPLAY_IDENTIFIER C_V_TPS_AD_OFS_GAIN_INI_1 /end CHARACTERISTIC
/begin MEASUREMENT lv_err_tps_st_chk_1 "TPS-error-bit (Return spring test)" UBYTE _CNV_S_2_RANGE______5_R_CM 1 100. 0. 255. DISPLAY_IDENTIFIER LV_ERR_TPS_ST_CHK_1 ECU_ADDRESS 0x3fb928 /end MEASUREMENT
/begin MEASUREMENT lv_tps_mtc_n_lim "LV limp home request TPS" UBYTE _CNV_S_2_RANGE______2_CM 1 100. 0. 1. DISPLAY_IDENTIFIER LV_TPS_MTC_N_LIM ECU_ADDRESS 0x3feabb BIT_MASK 0x1 /end MEASUREMENT
/begin CHARACTERISTIC c_abc_inc_tps_1 "Debounce counter Increment, TPS diagnosis, Channel 1" VALUE 0xffe405aa _REC_VAL_20_u1 255. _CNV_A_R_LINEAR_____0_CM 0. 255. DISPLAY_IDENTIFIER C_ABC_INC_TPS_1 FORMAT "%3.0" /end CHARACTERISTIC
/begin CHARACTERISTIC c_abc_inc_tps_2 "Debounce counter Increment, TPS diagnosis, Channel 2" VALUE 0xffe405ab _REC_VAL_20_u1 255. _CNV_A_R_LINEAR_____0_CM 0. 255. DISPLAY_IDENTIFIER C_ABC_INC_TPS_2 FORMAT "%3.0" /end CHARACTERISTIC
/begin CHARACTERISTIC c_abc_max_tps_2 "Debounce counter maximum value, TPS diagnosis, Channel 2" VALUE 0xffe4061b _REC_VAL_20_u1 254. _CNV_A_R_LINEAR_____0_CM 1. 255. DISPLAY_IDENTIFIER C_ABC_MAX_TPS_2 FORMAT "%3.0" /end CHARACTERISTIC
/begin MEASUREMENT lv_mtc_lih_cur_off "ETC-Limp home is activ" UBYTE _CNV_S_2_RANGE______2_CM 1 100. 0. 1. DISPLAY_IDENTIFIER LV_MTC_LIH_CUR_OFF ECU_ADDRESS 0x3feab9 BIT_MASK 0x1 /end MEASUREMENT
/begin MEASUREMENT lv_err_tps "Error currently present on at least one throttle position sensor" UBYTE _CNV_S_2_RANGE______1_R_CM 1 100. 0. 255. DISPLAY_IDENTIFIER LV_ERR_TPS ECU_ADDRESS 0x3feab7 /end MEASUREMENT
/begin MEASUREMENT lv_n_lim_etc_lih "LV safety cut off" UBYTE _CNV_S_2_RANGE______2_CM 1 100. 0. 1. DISPLAY_IDENTIFIER LV_N_LIM_ETC_LIH ECU_ADDRESS 0x3feaba BIT_MASK 0x1 /end MEASUREMENT
/begin MEASUREMENT lv_n_lim_etc_lih_rev "ETC-LIMP-HOME-3  (Reversible)" UBYTE _CNV_S_2_RANGE______2_CM 1 100. 0. 1. DISPLAY_IDENTIFIER LV_N_LIM_ETC_LIH_REV ECU_ADDRESS 0x3feabd BIT_MASK 0x1 /end MEASUREMENT
/begin MEASUREMENT state_tps_diag "Status TPS Diagnosis" UBYTE _CNV_S_5_RANGE_STAT_505_CM 1 100. 0. 8. DISPLAY_IDENTIFIER STATE_TPS_DIAG ECU_ADDRESS 0x3feab5 /end MEASUREMENT
/begin CHARACTERISTIC c_abc_max_tps_1 "Debounce counter maximum value, TPS diagnosis, Channel 1" VALUE 0xffe4061a _REC_VAL_20_u1 254. _CNV_A_R_LINEAR_____0_CM 1. 255. DISPLAY_IDENTIFIER C_ABC_MAX_TPS_1 FORMAT "%3.0" /end CHARACTERISTIC
/begin MEASUREMENT state_etc_lih "Status ETC Limp-Home" UBYTE _CNV_S_5_RANGE_STAT_506_CM 1 100. 0. 8. DISPLAY_IDENTIFIER STATE_ETC_LIH ECU_ADDRESS 0x3feab6 /end MEASUREMENT
/begin MEASUREMENT lv_mtc_cur_off_req "ETC without power request" UBYTE _CNV_S_2_RANGE______2_CM 1 100. 0. 1. DISPLAY_IDENTIFIER LV_MTC_CUR_OFF_REQ ECU_ADDRESS 0x3feabc /end MEASUREMENT
/begin MEASUREMENT lv_err_mtc_ctl_2 "Logical variable (set. if a MTCPWM error is present)" UBYTE _CNV_S_2_RANGE______5_R_CM 1 100. 0. 255. DISPLAY_IDENTIFIER LV_ERR_MTC_CTL_2 ECU_ADDRESS 0x3fb918 /end MEASUREMENT
/begin MEASUREMENT lv_err_mtc_ctl_3 "Logical variable (set. if a MTCPWM error is present)" UBYTE _CNV_S_2_RANGE______5_R_CM 1 100. 0. 255. DISPLAY_IDENTIFIER LV_ERR_MTC_CTL_3 ECU_ADDRESS 0x3fb91c /end MEASUREMENT
/begin MEASUREMENT lv_err_mtc_ctl_1 "Logical variable (set. if a MTCPWM error is present)" UBYTE _CNV_S_2_RANGE______1_R_CM 1 100. 0. 255. DISPLAY_IDENTIFIER LV_ERR_MTC_CTL_1 ECU_ADDRESS 0x3fb914 /end MEASUREMENT
/begin CHARACTERISTIC c_abc_inc_tqi_lim "Increment counter for torque request for safety" VALUE 0xffe405b2 _REC_VAL_20_u1 255. _CNV_A_R_LINEAR_____0_CM 0. 255. DISPLAY_IDENTIFIER C_ABC_INC_TQI_LIM FORMAT "%3.0" /end CHARACTERISTIC
/begin CHARACTERISTIC c_abc_max_tqi_lim "Maximum counter for torque request for safety" VALUE 0xffe40620 _REC_VAL_20_u1 254. _CNV_A_R_LINEAR_____0_CM 1. 255. DISPLAY_IDENTIFIER C_ABC_MAX_TQI_LIM FORMAT "%3.0" /end CHARACTERISTIC
/begin MEASUREMENT lv_err_tqi_lim "Error flag torque request for safety is active" UBYTE _CNV_S_2_RANGE______2_CM 1 100. 0. 1. DISPLAY_IDENTIFIER LV_ERR_TQI_LIM ECU_ADDRESS 0x3fba58 BIT_MASK 0x1 /end MEASUREMENT
/begin CHARACTERISTIC c_abc_inc_tq_loss_mon "anti bounce counter increment" VALUE 0xffe51f46 _REC_VAL_20_u1 255. _CNV_A_R_LINEAR_____0_CM 0. 255. DISPLAY_IDENTIFIER C_ABC_INC_TQ_LOSS_MON FORMAT "%3.0" /end CHARACTERISTIC
/begin CHARACTERISTIC c_abc_max_tq_loss_mon "maximum of anti bounce counter" VALUE 0xffe51f5b _REC_VAL_20_u1 254. _CNV_A_R_LINEAR_____0_CM 1. 255. DISPLAY_IDENTIFIER C_ABC_MAX_TQ_LOSS_MON FORMAT "%3.0" /end CHARACTERISTIC
/begin CHARACTERISTIC TOGMAXUNPL "" VALUE 0xffe5b7ab _REC_VAL_20_u1 251. _CNV_R_R_dez_550_CM 4. 255. FORMAT "%5.1" /end CHARACTERISTIC
/begin CHARACTERISTIC TOG_CNTMAX "" VALUE 0xffe5b7a8 _REC_VAL_20_u2 655.35 _CNV_R_R_t10msxs_ub_561_CM 0. 655.35 FORMAT "%8.4" /end CHARACTERISTIC
/begin CHARACTERISTIC DTOG_UBMIN "" VALUE 0xffe5b7aa _REC_VAL_20_u1 24.02 _CNV_R_R_spg_ubatt_562_CM 0. 24.02 FORMAT "%5.2" /end CHARACTERISTIC
/begin CHARACTERISTIC c_abc_inc_seg_t_ad "Increment value of the anti - bounce counter for segment period measurement diagnosis." VALUE 0xffe40241 _REC_VAL_20_u1 255. _CNV_A_R_LINEAR_____0_CM 0. 255. DISPLAY_IDENTIFIER C_ABC_INC_SEG_T_AD FORMAT "%3.0" /end CHARACTERISTIC
/begin CHARACTERISTIC c_abc_inc_seg_t "Increment value of the anti - bounce counter for segment period measurement diagnosis." VALUE 0xffe40240 _REC_VAL_20_u1 255. _CNV_A_R_LINEAR_____0_CM 0. 255. DISPLAY_IDENTIFIER C_ABC_INC_SEG_T FORMAT "%3.0" /end CHARACTERISTIC
/begin CHARACTERISTIC c_abc_max_seg_t_ad "Maximum value of the anti - bounce counter for segment period measurement diagnosis." VALUE 0xffe40243 _REC_VAL_20_u1 254. _CNV_A_R_LINEAR_____0_CM 1. 255. DISPLAY_IDENTIFIER C_ABC_MAX_SEG_T_AD FORMAT "%3.0" /end CHARACTERISTIC
/begin CHARACTERISTIC c_abc_max_seg_t "Maximum value of the anti - bounce counter for segment period measurement diagnosis." VALUE 0xffe40242 _REC_VAL_20_u1 254. _CNV_A_R_LINEAR_____0_CM 1. 255. DISPLAY_IDENTIFIER C_ABC_MAX_SEG_T FORMAT "%3.0" /end CHARACTERISTIC
/begin MEASUREMENT lv_err_bsd "logical variable for BSD error" UBYTE _CNV_S_2_RANGE______1_R_CM 1 100. 0. 255. DISPLAY_IDENTIFIER LV_ERR_BSD ECU_ADDRESS 0x3fba80 /end MEASUREMENT
/begin CHARACTERISTIC c_abc_inc_gen "Increment debounce counter - Generator error" VALUE 0xffe4056e _REC_VAL_20_u1 255. _CNV_A_R_LINEAR_____0_CM 0. 255. DISPLAY_IDENTIFIER C_ABC_INC_GEN FORMAT "%3.0" /end CHARACTERISTIC
/begin CHARACTERISTIC c_abc_inc_gen_if "Increment debounce counter - Generator error" VALUE 0xffe40570 _REC_VAL_20_u1 255. _CNV_A_R_LINEAR_____0_CM 0. 255. DISPLAY_IDENTIFIER C_ABC_INC_GEN_IF FORMAT "%3.0" /end CHARACTERISTIC
/begin CHARACTERISTIC c_abc_max_gen "Maximum value debounce counter - Generator error" VALUE 0xffe405e1 _REC_VAL_20_u1 254. _CNV_A_R_LINEAR_____0_CM 1. 255. DISPLAY_IDENTIFIER C_ABC_MAX_GEN FORMAT "%3.0" /end CHARACTERISTIC
/begin CHARACTERISTIC c_abc_max_gen_if "Maximum value debounce counter - Generator error" VALUE 0xffe405e3 _REC_VAL_20_u1 254. _CNV_A_R_LINEAR_____0_CM 1. 255. DISPLAY_IDENTIFIER C_ABC_MAX_GEN_IF FORMAT "%3.0" /end CHARACTERISTIC
/begin CHARACTERISTIC c_abc_max_gen_diag "Maximum value debounce counter - Generator switch off diagnosis" VALUE 0xffe405e2 _REC_VAL_20_u1 254. _CNV_A_R_LINEAR_____0_CM 1. 255. DISPLAY_IDENTIFIER C_ABC_MAX_GEN_DIAG FORMAT "%3.0" /end CHARACTERISTIC
/begin CHARACTERISTIC c_abc_inc_gen_diag "Increment debounce counter - Generator switch off " VALUE 0xffe4056f _REC_VAL_20_u1 255. _CNV_A_R_LINEAR_____0_CM 0. 255. DISPLAY_IDENTIFIER C_ABC_INC_GEN_DIAG FORMAT "%3.0" /end CHARACTERISTIC
/begin CHARACTERISTIC c_abc_inc_toil_level "Anti bounce increment" VALUE 0xffe4059a _REC_VAL_20_u1 255. _CNV_A_R_LINEAR_____0_CM 0. 255. DISPLAY_IDENTIFIER C_ABC_INC_TOIL_LEVEL FORMAT "%3.0" /end CHARACTERISTIC
/begin CHARACTERISTIC c_abc_inc_bat_sens "Anti bounce increment" VALUE 0xffe40546 _REC_VAL_20_u1 255. _CNV_A_R_LINEAR_____0_CM 0. 255. DISPLAY_IDENTIFIER C_ABC_INC_BAT_SENS FORMAT "%3.0" /end CHARACTERISTIC
/begin CHARACTERISTIC c_abc_inc_bat_sens_it "Anti bounce increment" VALUE 0xffe40547 _REC_VAL_20_u1 255. _CNV_A_R_LINEAR_____0_CM 0. 255. DISPLAY_IDENTIFIER C_ABC_INC_BAT_SENS_IT FORMAT "%3.0" /end CHARACTERISTIC
/begin CHARACTERISTIC c_abc_inc_bat_sens_it_el "Anti bounce increment" VALUE 0xffe40548 _REC_VAL_20_u1 255. _CNV_A_R_LINEAR_____0_CM 0. 255. DISPLAY_IDENTIFIER C_ABC_INC_BAT_SENS_IT_EL FORMAT "%3.0" /end CHARACTERISTIC
/begin CHARACTERISTIC c_abc_max_toil_level "Anti boune maximum" VALUE 0xffe4060c _REC_VAL_20_u1 254. _CNV_A_R_LINEAR_____0_CM 1. 255. DISPLAY_IDENTIFIER C_ABC_MAX_TOIL_LEVEL FORMAT "%3.0" /end CHARACTERISTIC
/begin CHARACTERISTIC c_abc_max_bat_sens "Anti boune maximum" VALUE 0xffe405bc _REC_VAL_20_u1 254. _CNV_A_R_LINEAR_____0_CM 1. 255. DISPLAY_IDENTIFIER C_ABC_MAX_BAT_SENS FORMAT "%3.0" /end CHARACTERISTIC
/begin CHARACTERISTIC c_abc_max_bat_sens_it "Anti boune maximum" VALUE 0xffe405bd _REC_VAL_20_u1 254. _CNV_A_R_LINEAR_____0_CM 1. 255. DISPLAY_IDENTIFIER C_ABC_MAX_BAT_SENS_IT FORMAT "%3.0" /end CHARACTERISTIC
/begin CHARACTERISTIC c_abc_max_bat_sens_it_el "Anti boune maximum" VALUE 0xffe405be _REC_VAL_20_u1 254. _CNV_A_R_LINEAR_____0_CM 1. 255. DISPLAY_IDENTIFIER C_ABC_MAX_BAT_SENS_IT_EL FORMAT "%3.0" /end CHARACTERISTIC
/begin MEASUREMENT lv_err_toil_level "Error condition of TOENS" UBYTE _CNV_S_2_RANGE______1_R_CM 1 100. 0. 255. DISPLAY_IDENTIFIER LV_ERR_TOIL_LEVEL ECU_ADDRESS 0x3fb880 /end MEASUREMENT
/begin MEASUREMENT lv_err_bat_sens "Error condition of TOENS" UBYTE _CNV_S_2_RANGE______1_R_CM 1 100. 0. 255. DISPLAY_IDENTIFIER LV_ERR_BAT_SENS ECU_ADDRESS 0x3fbb18 /end MEASUREMENT
/begin MEASUREMENT lv_err_bat_sens_it "Error condition of TOENS" UBYTE _CNV_S_2_RANGE______1_R_CM 1 100. 0. 255. DISPLAY_IDENTIFIER LV_ERR_BAT_SENS_IT ECU_ADDRESS 0x3fbb1c /end MEASUREMENT
/begin MEASUREMENT lv_err_bat_sens_it_el "Error condition of TOENS" UBYTE _CNV_S_2_RANGE______1_R_CM 1 100. 0. 255. DISPLAY_IDENTIFIER LV_ERR_BAT_SENS_IT_EL ECU_ADDRESS 0x3fbb20 /end MEASUREMENT
/begin CHARACTERISTIC c_abc_inc_conv_mon "Anti bounce counter increment (additive value in case of ADC error)" VALUE 0xffe51f37 _REC_VAL_20_u1 255. _CNV_A_R_LINEAR_____0_CM 0. 255. DISPLAY_IDENTIFIER C_ABC_INC_CONV_MON FORMAT "%3.0" /end CHARACTERISTIC
/begin CHARACTERISTIC c_abc_inc_maf_mon "Anti bounce counter increment (additive value in case of MAF diagnosis error)" VALUE 0xffe51f3d _REC_VAL_20_u1 255. _CNV_A_R_LINEAR_____0_CM 0. 255. DISPLAY_IDENTIFIER C_ABC_INC_MAF_MON FORMAT "%3.0" /end CHARACTERISTIC
/begin CHARACTERISTIC c_abc_inc_n_32_mon "Anti bounce counter increment (additive value in case of N_32 ratio error)" VALUE 0xffe51f3f _REC_VAL_20_u1 255. _CNV_A_R_LINEAR_____0_CM 0. 255. DISPLAY_IDENTIFIER C_ABC_INC_N_32_MON FORMAT "%3.0" /end CHARACTERISTIC
/begin CHARACTERISTIC c_abc_inc_pvs_ratio_mon "Anti bounce counter increment (additive value in case of error)" VALUE 0xffe51f40 _REC_VAL_20_u1 255. _CNV_A_R_LINEAR_____0_CM 0. 255. DISPLAY_IDENTIFIER C_ABC_INC_PVS_RATIO_MON FORMAT "%3.0" /end CHARACTERISTIC
/begin CHARACTERISTIC c_abc_inc_tps_ratio_mon "Anti bounce counter increment (additive value in case of ratio error)" VALUE 0xffe51f42 _REC_VAL_20_u1 255. _CNV_A_R_LINEAR_____0_CM 0. 255. DISPLAY_IDENTIFIER C_ABC_INC_TPS_RATIO_MON FORMAT "%3.0" /end CHARACTERISTIC
/begin CHARACTERISTIC c_abc_max_conv_mon "Value at which ADC error is recognized, when reached" VALUE 0xffe51f4c _REC_VAL_20_u1 254. _CNV_A_R_LINEAR_____0_CM 1. 255. DISPLAY_IDENTIFIER C_ABC_MAX_CONV_MON FORMAT "%3.0" /end CHARACTERISTIC
/begin CHARACTERISTIC c_abc_max_maf_mon "Value at which MAF diagnosis error is recognized, when reached" VALUE 0xffe51f52 _REC_VAL_20_u1 254. _CNV_A_R_LINEAR_____0_CM 1. 255. DISPLAY_IDENTIFIER C_ABC_MAX_MAF_MON FORMAT "%3.0" /end CHARACTERISTIC
/begin CHARACTERISTIC c_abc_max_n_32_mon "Value at which N_32 ratio error is recognized, when reached" VALUE 0xffe51f54 _REC_VAL_20_u1 254. _CNV_A_R_LINEAR_____0_CM 1. 255. DISPLAY_IDENTIFIER C_ABC_MAX_N_32_MON FORMAT "%3.0" /end CHARACTERISTIC
/begin CHARACTERISTIC c_abc_max_pvs_ratio_mon "Value at which ratio error is recognized. when reached" VALUE 0xffe51f55 _REC_VAL_20_u1 254. _CNV_A_R_LINEAR_____0_CM 1. 255. DISPLAY_IDENTIFIER C_ABC_MAX_PVS_RATIO_MON FORMAT "%3.0" /end CHARACTERISTIC
/begin CHARACTERISTIC c_abc_max_tps_ratio_mon "Value at which ratio error is recognized, when reached" VALUE 0xffe51f57 _REC_VAL_20_u1 254. _CNV_A_R_LINEAR_____0_CM 1. 255. DISPLAY_IDENTIFIER C_ABC_MAX_TPS_RATIO_MON FORMAT "%3.0" /end CHARACTERISTIC
/begin CHARACTERISTIC c_abc_max_tqi_n_max_mon "Maximum value of anti-bounce counter" VALUE 0xffe51f5f _REC_VAL_20_u1 254. _CNV_A_R_LINEAR_____0_CM 1. 255. DISPLAY_IDENTIFIER C_ABC_MAX_TQI_N_MAX_MON FORMAT "%3.0" /end CHARACTERISTIC
/begin CHARACTERISTIC c_abc_inc_tqi_n_max_mon "Anti bounce counter increment" VALUE 0xffe51f4a _REC_VAL_20_u1 255. _CNV_A_R_LINEAR_____0_CM 0. 255. DISPLAY_IDENTIFIER C_ABC_INC_TQI_N_MAX_MON FORMAT "%3.0" /end CHARACTERISTIC
/begin CHARACTERISTIC c_abc_inc_tq_dif_p_d_is_mon "Anti bounce counter increment" VALUE 0xffe51f44 _REC_VAL_20_u1 255. _CNV_A_R_LINEAR_____0_CM 0. 255. DISPLAY_IDENTIFIER C_ABC_INC_TQ_DIF_P_D_IS_MON FORMAT "%3.0" /end CHARACTERISTIC
/begin CHARACTERISTIC c_abc_inc_tq_dif_i_is_mon "Anti bounce counter increment" VALUE 0xffe51f43 _REC_VAL_20_u1 255. _CNV_A_R_LINEAR_____0_CM 0. 255. DISPLAY_IDENTIFIER C_ABC_INC_TQ_DIF_I_IS_MON FORMAT "%3.0" /end CHARACTERISTIC
/begin CHARACTERISTIC c_abc_max_tq_dif_p_d_is_mon "Maximum of anti bounce counter" VALUE 0xffe51f59 _REC_VAL_20_u1 254. _CNV_A_R_LINEAR_____0_CM 1. 255. DISPLAY_IDENTIFIER C_ABC_MAX_TQ_DIF_P_D_IS_MON FORMAT "%3.0" /end CHARACTERISTIC
/begin CHARACTERISTIC c_abc_max_tq_dif_i_is_mon "Maximum of anti bounce counter" VALUE 0xffe51f58 _REC_VAL_20_u1 254. _CNV_A_R_LINEAR_____0_CM 1. 255. DISPLAY_IDENTIFIER C_ABC_MAX_TQ_DIF_I_IS_MON FORMAT "%3.0" /end CHARACTERISTIC
/begin CHARACTERISTIC c_abc_inc_tqi_av_mon "Anti bounce counter increment" VALUE 0xffe51f49 _REC_VAL_20_u1 255. _CNV_A_R_LINEAR_____0_CM 0. 255. DISPLAY_IDENTIFIER C_ABC_INC_TQI_AV_MON FORMAT "%3.0" /end CHARACTERISTIC
/begin CHARACTERISTIC c_abc_max_tqi_av_mon "Maximum value of anti-bounce counter" VALUE 0xffe51f5e _REC_VAL_20_u1 254. _CNV_A_R_LINEAR_____0_CM 1. 255. DISPLAY_IDENTIFIER C_ABC_MAX_TQI_AV_MON FORMAT "%3.0" /end CHARACTERISTIC
/begin CHARACTERISTIC c_abc_inc_tq_min_clu_mon "Anti bounce counter increment" VALUE 0xffe51f48 _REC_VAL_20_u1 255. _CNV_A_R_LINEAR_____0_CM 0. 255. DISPLAY_IDENTIFIER C_ABC_INC_TQ_MIN_CLU_MON FORMAT "%3.0" /end CHARACTERISTIC
/begin CHARACTERISTIC c_abc_max_tq_min_clu_mon "Maximum of anti bounce counter" VALUE 0xffe51f5d _REC_VAL_20_u1 254. _CNV_A_R_LINEAR_____0_CM 1. 255. DISPLAY_IDENTIFIER C_ABC_MAX_TQ_MIN_CLU_MON FORMAT "%3.0" /end CHARACTERISTIC
/begin CHARACTERISTIC c_abc_inc_msr_inh_mon "Anti bounce counter increment" VALUE 0xffe51f3e _REC_VAL_20_u1 255. _CNV_A_R_LINEAR_____0_CM 0. 255. DISPLAY_IDENTIFIER C_ABC_INC_MSR_INH_MON FORMAT "%3.0" /end CHARACTERISTIC
/begin CHARACTERISTIC c_abc_max_msr_inh_mon "Maximum value of anti - bounce counter" VALUE 0xffe51f53 _REC_VAL_20_u1 254. _CNV_A_R_LINEAR_____0_CM 1. 255. DISPLAY_IDENTIFIER C_ABC_MAX_MSR_INH_MON FORMAT "%3.0" /end CHARACTERISTIC
/begin CHARACTERISTIC c_abc_inc_cru_inh_mon "Anti bouncecounter increment" VALUE 0xffe51f38 _REC_VAL_20_u1 255. _CNV_A_R_LINEAR_____0_CM 0. 255. DISPLAY_IDENTIFIER C_ABC_INC_CRU_INH_MON FORMAT "%3.0" /end CHARACTERISTIC
/begin CHARACTERISTIC c_abc_max_cru_inh_mon "Maximum value of anti-bounce counter" VALUE 0xffe51f4d _REC_VAL_20_u1 254. _CNV_A_R_LINEAR_____0_CM 1. 255. DISPLAY_IDENTIFIER C_ABC_MAX_CRU_INH_MON FORMAT "%3.0" /end CHARACTERISTIC
/begin CHARACTERISTIC c_abc_inc_tq_max_clu_mon "Anti bounce counter increment" VALUE 0xffe51f47 _REC_VAL_20_u1 255. _CNV_A_R_LINEAR_____0_CM 0. 255. DISPLAY_IDENTIFIER C_ABC_INC_TQ_MAX_CLU_MON FORMAT "%3.0" /end CHARACTERISTIC
/begin CHARACTERISTIC c_abc_max_tq_max_clu_mon "Maximum of anti bounce counter" VALUE 0xffe51f5c _REC_VAL_20_u1 254. _CNV_A_R_LINEAR_____0_CM 1. 255. DISPLAY_IDENTIFIER C_ABC_MAX_TQ_MAX_CLU_MON FORMAT "%3.0" /end CHARACTERISTIC
/begin CHARACTERISTIC c_abc_max_tqi_n_max_mon2 "" VALUE 0xffe40621 _REC_VAL_20_u1 254. _CNV_A_R_LINEAR_____0_CM 1. 255. DISPLAY_IDENTIFIER C_ABC_MAX_TQI_N_MAX_MON2 FORMAT "%3.0" /end CHARACTERISTIC
/begin CHARACTERISTIC c_abc_max_tqi_av_mon2 "" VALUE 0xffe4061f _REC_VAL_20_u1 254. _CNV_A_R_LINEAR_____0_CM 1. 255. DISPLAY_IDENTIFIER C_ABC_MAX_TQI_AV_MON2 FORMAT "%3.0" /end CHARACTERISTIC
/begin CHARACTERISTIC c_abc_inc_tqi_n_max_mon2 "" VALUE 0xffe405b3 _REC_VAL_20_u1 255. _CNV_A_R_LINEAR_____0_CM 0. 255. DISPLAY_IDENTIFIER C_ABC_INC_TQI_N_MAX_MON2 FORMAT "%3.0" /end CHARACTERISTIC
/begin CHARACTERISTIC c_abc_inc_tqi_av_mon2 "" VALUE 0xffe405b1 _REC_VAL_20_u1 255. _CNV_A_R_LINEAR_____0_CM 0. 255. DISPLAY_IDENTIFIER C_ABC_INC_TQI_AV_MON2 FORMAT "%3.0" /end CHARACTERISTIC
/begin CHARACTERISTIC c_abc_inc_toil "Debounce counter increment - TOIL diagnosis" VALUE 0xffe40599 _REC_VAL_20_u1 255. _CNV_A_R_LINEAR_____0_CM 0. 255. DISPLAY_IDENTIFIER C_ABC_INC_TOIL FORMAT "%3.0" /end CHARACTERISTIC
/begin CHARACTERISTIC c_abc_max_toil "Debounce counter maximum value - TOIL diagnosis" VALUE 0xffe4060b _REC_VAL_20_u1 254. _CNV_A_R_LINEAR_____0_CM 1. 255. DISPLAY_IDENTIFIER C_ABC_MAX_TOIL FORMAT "%3.0" /end CHARACTERISTIC
/begin MEASUREMENT lv_err_ecu_ram "Present error flag ECU_RAM" UBYTE _CNV_S_2_RANGE______1_R_CM 1 100. 0. 255. DISPLAY_IDENTIFIER LV_ERR_ECU_RAM ECU_ADDRESS 0x3fba54 BIT_MASK 0x1 /end MEASUREMENT
/begin MEASUREMENT lv_err_ecu_cks "ECU_CKS error detected" UBYTE _CNV_S_2_RANGE______1_R_CM 1 100. 0. 255. DISPLAY_IDENTIFIER LV_ERR_ECU_CKS ECU_ADDRESS 0x3fb87c BIT_MASK 0x1 /end MEASUREMENT
/begin MEASUREMENT lv_err_ecu_nvmy "Present ECU NVMY error" UBYTE _CNV_S_2_RANGE______1_R_CM 1 100. 0. 255. DISPLAY_IDENTIFIER LV_ERR_ECU_NVMY ECU_ADDRESS 0x3fbb24 BIT_MASK 0x1 /end MEASUREMENT
/begin CHARACTERISTIC c_abc_inc_mtc_dr "Debounce counter increment,MTC driver diagnosis" VALUE 0xffe4057f _REC_VAL_20_u1 255. _CNV_A_R_LINEAR_____0_CM 0. 255. DISPLAY_IDENTIFIER C_ABC_INC_MTC_DR FORMAT "%3.0" /end CHARACTERISTIC
/begin CHARACTERISTIC c_abc_max_mtc_dr "Debounce counter maximum value, MTC driver diagnosis" VALUE 0xffe405f1 _REC_VAL_20_u1 254. _CNV_A_R_LINEAR_____0_CM 1. 255. DISPLAY_IDENTIFIER C_ABC_MAX_MTC_DR FORMAT "%3.0" /end CHARACTERISTIC
/begin CHARACTERISTIC c_abc_max_spi_mps "Anti bounce maxi,um SPI_MPS diagnosis" VALUE 0xffe40604 _REC_VAL_20_u1 254. _CNV_A_R_LINEAR_____0_CM 1. 255. DISPLAY_IDENTIFIER C_ABC_MAX_SPI_MPS FORMAT "%3.0" /end CHARACTERISTIC
/begin CHARACTERISTIC c_abc_max_spi_knk "Anti bounce maxi,um SPI_KNK diagnosis" VALUE 0xffe40603 _REC_VAL_20_u1 254. _CNV_A_R_LINEAR_____0_CM 1. 255. DISPLAY_IDENTIFIER C_ABC_MAX_SPI_KNK FORMAT "%3.0" /end CHARACTERISTIC
/begin CHARACTERISTIC c_abc_inc_spi_mps "Antibounce increment SPI_MPS diagnosis" VALUE 0xffe40592 _REC_VAL_20_u1 255. _CNV_A_R_LINEAR_____0_CM 0. 255. DISPLAY_IDENTIFIER C_ABC_INC_SPI_MPS FORMAT "%3.0" /end CHARACTERISTIC
/begin CHARACTERISTIC c_abc_inc_spi_knk "Antibounce increment SPI_KNK diagnosis" VALUE 0xffe40591 _REC_VAL_20_u1 255. _CNV_A_R_LINEAR_____0_CM 0. 255. DISPLAY_IDENTIFIER C_ABC_INC_SPI_KNK FORMAT "%3.0" /end CHARACTERISTIC
/begin MEASUREMENT lv_err_spi_mps "Present failure SPI-bus for Multi-powerstage" UBYTE _CNV_S_2_RANGE______1_R_CM 1 100. 0. 255. DISPLAY_IDENTIFIER LV_ERR_SPI_MPS ECU_ADDRESS 0x3fbaa4 /end MEASUREMENT
/begin MEASUREMENT lv_err_spi_knk "Present failure SPI-bus diagnosis for Knock sensor" UBYTE _CNV_S_2_RANGE______1_R_CM 1 100. 0. 255. DISPLAY_IDENTIFIER LV_ERR_SPI_KNK ECU_ADDRESS 0x3fbaa8 /end MEASUREMENT
/begin CHARACTERISTIC c_thd_brake_prs "maximum threshold for brake pressure(erroro detection)" VALUE 0xffe4094b _REC_VAL_20_u1 255. _CNV_A_R_LINEAR_____86_CM 0. 255. DISPLAY_IDENTIFIER C_THD_BRAKE_PRS FORMAT "%3.0" /end CHARACTERISTIC
/begin CHARACTERISTIC c_t_dly_brake_prs "Delay time for detection of emergency braking" VALUE 0xffe41900 _REC_VAL_20_u2 655.35 _CNV_A_R_LINEAR_____4_CM 0. 655.35 DISPLAY_IDENTIFIER C_T_DLY_BRAKE_PRS FORMAT "%6.2" /end CHARACTERISTIC
/begin MEASUREMENT lv_brake_prs_pvs_diag "LV indicating if brake pressure exceeds max. threshold" UBYTE _CNV_A_R_LINEAR_____22_CM 1 100. 0. 1. DISPLAY_IDENTIFIER LV_BRAKE_PRS_PVS_DIAG ECU_ADDRESS 0x3fe618 FORMAT "%1.0" /end MEASUREMENT
/begin MEASUREMENT t_dly_brake_prs "Delay time for detection of emergency braking" UWORD _CNV_A_R_LINEAR_____4_CM 1 100. 0. 655.35 DISPLAY_IDENTIFIER T_DLY_BRAKE_PRS ECU_ADDRESS 0x3fd650 BYTE_ORDER MSB_LAST FORMAT "%6.2" /end MEASUREMENT
/begin COMPU_METHOD _CNV_A_R_LINEAR_____0_CM "" RAT_FUNC "%6.3" "-" COEFFS 0 1. 0. 0 0 1 /end COMPU_METHOD
/begin COMPU_METHOD _CNV_S_2_RANGE______1_R_CM "" TAB_VERB "%6.3" "[-]" COMPU_TAB_REF _CNV_S_2_RANGE______1_R /end COMPU_METHOD
/begin COMPU_VTAB_RANGE _CNV_S_2_RANGE______1_R "" 2 0 0 "0" 1 255 "1" /end COMPU_VTAB_RANGE
/begin COMPU_METHOD _CNV_S_2_RANGE______2_CM "" TAB_VERB "%6.3" "[-]" COMPU_TAB_REF _CNV_S_2_RANGE______2 /end COMPU_METHOD
/begin COMPU_VTAB _CNV_S_2_RANGE______2 "" TAB_VERB 2 0 "0" 1 "1" /end COMPU_VTAB
/begin COMPU_METHOD _CNV_A_R_LINEAR_____3_CM "" RAT_FUNC "%6.3" "V" COEFFS 0 204.7999998974999 0. 0 0 1 /end COMPU_METHOD
/begin COMPU_METHOD _CNV_A_R_LINEAR_____4_CM "" RAT_FUNC "%6.3" "s" COEFFS 0 100. 0. 0 0 1 /end COMPU_METHOD
/begin COMPU_METHOD _CNV_S_2_RANGE______5_R_CM "" TAB_VERB "%6.3" "-" COMPU_TAB_REF _CNV_S_2_RANGE______5_R /end COMPU_METHOD
/begin COMPU_VTAB_RANGE _CNV_S_2_RANGE______5_R "" 2 0 0 "0" 1 255 "1" /end COMPU_VTAB_RANGE
/begin COMPU_METHOD _CNV_A_R_LINEAR_____6_CM "" RAT_FUNC "%6.3" "°C" COEFFS 0 16. 0. 0 0 1 /end COMPU_METHOD
/begin COMPU_METHOD _CNV_A_R_LINEAR_____8_CM "" RAT_FUNC "%6.3" "%" COEFFS 0 655.3600000071681 0. 0 0 1 /end COMPU_METHOD
/begin COMPU_METHOD _CNV_A_R_LINEAR_____10_CM "" RAT_FUNC "%6.3" "rpm" COEFFS 0 1. 0. 0 0 1 /end COMPU_METHOD
/begin COMPU_METHOD _CNV_A_R_LINEAR_____11_CM "" RAT_FUNC "%6.3" "°C" COEFFS 0 1.333333333333333 64. 0 0 1 /end COMPU_METHOD
/begin COMPU_METHOD _CNV_A_R_LINEAR_____14_CM "" RAT_FUNC "%6.3" "°C" COEFFS 0 1. 40. 0 0 1 /end COMPU_METHOD
/begin COMPU_METHOD _CNV_A_R_LINEAR_____15_CM "" RAT_FUNC "%6.3" "rpm" COEFFS 0 3.125e-002 0. 0 0 1 /end COMPU_METHOD
/begin COMPU_METHOD _CNV_S_2_RANGE______21_CM "" TAB_VERB "%6.3" "-" COMPU_TAB_REF _CNV_S_2_RANGE______21 /end COMPU_METHOD
/begin COMPU_VTAB _CNV_S_2_RANGE______21 "" TAB_VERB 2 0 "0" 1 "1" /end COMPU_VTAB
/begin COMPU_METHOD _CNV_A_R_LINEAR_____22_CM "" RAT_FUNC "%6.3" "[-]" COEFFS 0 1. 0. 0 0 1 /end COMPU_METHOD
/begin COMPU_METHOD _CNV_A_R_LINEAR_____23_CM "" RAT_FUNC "%6.3" "km/h" COEFFS 0 1. 0. 0 0 1 /end COMPU_METHOD
/begin COMPU_METHOD _CNV_A_R_LINEAR_____24_CM "" RAT_FUNC "%6.3" "s" COEFFS 0 10. 0. 0 0 1 /end COMPU_METHOD
/begin COMPU_METHOD _CNV_A_R_LINEAR_____29_CM "" RAT_FUNC "%6.3" "-" COEFFS 0 255.9983911655618 0. 0 0 1 /end COMPU_METHOD
/begin COMPU_METHOD _CNV_A_R_LINEAR_____30_CM "" RAT_FUNC "%6.3" "s" COEFFS 0 1. 0. 0 0 1 /end COMPU_METHOD
/begin COMPU_METHOD _CNV_A_R_LINEAR_____34_CM "" RAT_FUNC "%6.3" "V" COEFFS 0 9.846168103048838 0. 0 0 1 /end COMPU_METHOD
/begin COMPU_METHOD _CNV_A_R_LINEAR_____44_CM "" RAT_FUNC "%6.3" "V" COEFFS 0 51.0204081632653 0. 0 0 1 /end COMPU_METHOD
/begin COMPU_METHOD _CNV_A_R_LINEAR_____53_CM "" RAT_FUNC "%6.3" "°TPS" COEFFS 0 137.0962343096234 0. 0 0 1 /end COMPU_METHOD
/begin COMPU_METHOD _CNV_A_R_LINEAR_____54_CM "" RAT_FUNC "%6.3" "rpm/s" COEFFS 0 3.125e-002 128. 0 0 1 /end COMPU_METHOD
/begin COMPU_METHOD _CNV_A_R_LINEAR_____55_CM "" RAT_FUNC "%6.3" "Nm" COEFFS 0 32. 0. 0 0 1 /end COMPU_METHOD
/begin COMPU_METHOD _CNV_A_R_LINEAR_____85_CM "" RAT_FUNC "%6.3" "km/h" COEFFS 0 128.0000018750286 0. 0 0 1 /end COMPU_METHOD
/begin COMPU_METHOD _CNV_A_R_LINEAR_____86_CM "" RAT_FUNC "%6.3" "bar" COEFFS 0 1. 0. 0 0 1 /end COMPU_METHOD
/begin COMPU_METHOD _CNV_A_R_LINEAR_____97_CM "" RAT_FUNC "%6.3" "min" COEFFS 0 1. 0. 0 0 1 /end COMPU_METHOD
/begin COMPU_METHOD _CNV_A_R_LINEAR_____102_CM "" RAT_FUNC "%6.3" "Nms" COEFFS 0 320.1514411333659 0. 0 0 1 /end COMPU_METHOD
/begin COMPU_METHOD _CNV_A_R_LINEAR_____103_CM "" RAT_FUNC "%6.3" "m/s²" COEFFS 0 640. 32768. 0 0 1 /end COMPU_METHOD
/begin COMPU_METHOD _CNV_A_R_LINEAR_____108_CM "" RAT_FUNC "%6.3" "mg/stk" COEFFS 0 47.18142548596112 0. 0 0 1 /end COMPU_METHOD
/begin COMPU_METHOD _CNV_A_R_LINEAR_____115_CM "" RAT_FUNC "%6.3" "kg/h" COEFFS 0 32. 0. 0 0 1 /end COMPU_METHOD
/begin COMPU_METHOD _CNV_A_R_LINEAR_____168_CM "" RAT_FUNC "%6.3" "mA" COEFFS 0 163.8375 0. 0 0 1 /end COMPU_METHOD
/begin COMPU_METHOD _CNV_A_R_LINEAR_____185_CM "" RAT_FUNC "%6.3" "Seg" COEFFS 0 1. 0. 0 0 1 /end COMPU_METHOD
/begin COMPU_METHOD _CNV_S_6_RANGE_STAT_186_CM "" TAB_VERB "%6.3" "[-]" COMPU_TAB_REF _CNV_S_6_RANGE_STAT_186 /end COMPU_METHOD
/begin COMPU_VTAB _CNV_S_6_RANGE_STAT_186 "" TAB_VERB 6 0 "ES" 1 "ST" 2 "IS" 3 "PL" 4 "PU" 5 "PUC" /end COMPU_VTAB
/begin COMPU_METHOD _CNV_A_R_LINEAR_____187_CM "" RAT_FUNC "%6.3" "Nm" COEFFS 0 32. 32768. 0 0 1 /end COMPU_METHOD
/begin COMPU_METHOD _CNV_A_R_LINEAR_____269_CM "" RAT_FUNC "%6.3" "V" COEFFS 0 204.8 0. 0 0 1 /end COMPU_METHOD
/begin COMPU_METHOD _CNV_A_R_LINEAR_____287_CM "" RAT_FUNC "%6.3" "g" COEFFS 0 36.00036915004301 0. 0 0 1 /end COMPU_METHOD
/begin COMPU_METHOD _CNV_A_R_LINEAR_____309_CM "" RAT_FUNC "%6.3" "ohm" COEFFS 0 1. 0. 0 0 1 /end COMPU_METHOD
/begin COMPU_METHOD _CNV_A_R_LINEAR_____364_CM "" RAT_FUNC "%6.3" "s" COEFFS 0 100.0015259720442 0. 0 0 1 /end COMPU_METHOD
/begin COMPU_METHOD _CNV_A_R_LINEAR_____394_CM "" RAT_FUNC "%6.3" "-" COEFFS 0 8191.999999679995 0. 0 0 1 /end COMPU_METHOD
/begin COMPU_METHOD _CNV_A_R_LINEAR_____414_CM "" RAT_FUNC "%6.3" "s" COEFFS 0 200. 0. 0 0 1 /end COMPU_METHOD
/begin COMPU_METHOD _CNV_A_R_LINEAR_____415_CM "" RAT_FUNC "%6.3" "%" COEFFS 0 327.67 0. 0 0 1 /end COMPU_METHOD
/begin COMPU_METHOD _CNV_A_R_LINEAR_____431_CM "" RAT_FUNC "%6.3" "ppm" COEFFS 0 0.25 0. 0 0 1 /end COMPU_METHOD
/begin COMPU_METHOD _CNV_A_R_LINEAR_____432_CM "" RAT_FUNC "%6.3" "-" COEFFS 0 25.60240963855421 0. 0 0 1 /end COMPU_METHOD
/begin COMPU_METHOD _CNV_S_7_RANGE_STAT_433_CM "" TAB_VERB "%6.3" "-" COMPU_TAB_REF _CNV_S_7_RANGE_STAT_433 /end COMPU_METHOD
/begin COMPU_VTAB _CNV_S_7_RANGE_STAT_433 "" TAB_VERB 7 0 "O3_DIAG_NOT_START" 1 "O3_DIAG_ACT" 2 "O3_DIAG_VS" 3 "O3_DIAG_TCO" 4 "O3_DIAG_TCO_EX" 5 "O3_DIAG_CONC_MIN" 6 "O3_DIAG_END" /end COMPU_VTAB
/begin COMPU_METHOD _CNV_A_R_LINEAR_____447_CM "" RAT_FUNC "%6.3" "V" COEFFS 0 204.7999995887937 0. 0 0 1 /end COMPU_METHOD
/begin COMPU_METHOD _CNV_A_R_LINEAR_____501_CM "" RAT_FUNC "%6.3" "°TPS/5ms" COEFFS 0 137.0962586026216 -6.746863121520619e-007 0 0 1 /end COMPU_METHOD
/begin COMPU_METHOD _CNV_A_R_LINEAR_____502_CM "" RAT_FUNC "%6.3" "°TPS" COEFFS 0 137.0962586026216 -6.746863121520619e-007 0 0 1 /end COMPU_METHOD
/begin COMPU_METHOD _CNV_A_R_LINEAR_____503_CM "" RAT_FUNC "%6.3" "V" COEFFS 0 102.3999997943969 0. 0 0 1 /end COMPU_METHOD
/begin COMPU_METHOD _CNV_S_11_RANGE_TPS__504_CM "" TAB_VERB "%6.3" "[-]" COMPU_TAB_REF _CNV_S_11_RANGE_TPS__504 /end COMPU_METHOD
/begin COMPU_VTAB _CNV_S_11_RANGE_TPS__504 "" TAB_VERB 11 0 "ST_CHK_CHK_LIH_1" 1 "ST_CHK_GO_UPPER_POS" 2 "ST_CHK_CHK_LIH_2" 3 "ST_CHK_END" 4 "AD_CHK_LIH_1" 5 "AD_GO_UPPER_POS" 6 "AD_CHK_LIH_2" 7 "AD_GO_LOWER_STOP" 8 "AD_GO_LIH" 9 "AD_CHK_LIH_3" 10 "AD_END" /end COMPU_VTAB
/begin COMPU_METHOD _CNV_S_5_RANGE_STAT_505_CM "" TAB_VERB "%6.3" "-" COMPU_TAB_REF _CNV_S_5_RANGE_STAT_505 /end COMPU_METHOD
/begin COMPU_VTAB _CNV_S_5_RANGE_STAT_505 "" TAB_VERB 5 0 "TPS_NO_ERROR" 1 "TPS_LIH_1" 2 "TPS_LIH_2" 4 "TPS_LIH_MAX" 8 "TPS_DBL_ERROR" /end COMPU_VTAB
/begin COMPU_METHOD _CNV_S_5_RANGE_STAT_506_CM "" TAB_VERB "%6.3" "-" COMPU_TAB_REF _CNV_S_5_RANGE_STAT_506 /end COMPU_METHOD
/begin COMPU_VTAB _CNV_S_5_RANGE_STAT_506 "" TAB_VERB 5 0 "ETC_NO_LIH" 1 "ETC_LIH_1" 2 "ETC_LIH_2_REV" 4 "ETC_LIH_2" 8 "ETC_LIH_3" /end COMPU_VTAB
/begin COMPU_METHOD _CNV_R_R_dez_550_CM "" RAT_FUNC "%6.3" "[-]" COEFFS 0. 1. 0. 0. 0. 1. /end COMPU_METHOD
/begin COMPU_METHOD _CNV_R_R_t10msxs_ub_561_CM "" RAT_FUNC "%6.3" "s" COEFFS 0. 1. 0. 0. 0. 1.e-002 /end COMPU_METHOD
/begin COMPU_METHOD _CNV_R_R_spg_ubatt_562_CM "" RAT_FUNC "%6.3" "V" COEFFS 0. 1. 0. 0. 0. 9.420000000000001e-002 /end COMPU_METHOD
/begin RECORD_LAYOUT _REC_VAL_20_u1 FNC_VALUES 1 UBYTE COLUMN_DIR DIRECT /end RECORD_LAYOUT
/begin RECORD_LAYOUT _REC_VAL_20_u2 FNC_VALUES 1 UWORD COLUMN_DIR DIRECT /end RECORD_LAYOUT
/begin RECORD_LAYOUT _REC_CUR_20_u2_u1 FNC_VALUES 1 UWORD COLUMN_DIR DIRECT /end RECORD_LAYOUT
/begin RECORD_LAYOUT _REC_AXS_20_u1 NO_AXIS_PTS_X 1 UBYTE AXIS_PTS_X 2 UBYTE INDEX_INCR DIRECT /end RECORD_LAYOUT
/begin RECORD_LAYOUT _REC_MAP_20_u1_u1_u1 FNC_VALUES 1 UBYTE COLUMN_DIR DIRECT /end RECORD_LAYOUT
/begin RECORD_LAYOUT _REC_CUR_20_u1_u1 FNC_VALUES 1 UBYTE COLUMN_DIR DIRECT /end RECORD_LAYOUT
/begin RECORD_LAYOUT _REC_AXS_20_u2 NO_AXIS_PTS_X 1 UWORD AXIS_PTS_X 2 UWORD INDEX_INCR DIRECT /end RECORD_LAYOUT
/begin RECORD_LAYOUT _REC_MAP_20_u2_u2_u1 FNC_VALUES 1 UWORD COLUMN_DIR DIRECT /end RECORD_LAYOUT
/begin RECORD_LAYOUT _REC_CUR_20_u1_u2 FNC_VALUES 1 UBYTE COLUMN_DIR DIRECT /end RECORD_LAYOUT
/begin RECORD_LAYOUT _REC_CUR_20_u2_u2 FNC_VALUES 1 UWORD COLUMN_DIR DIRECT /end RECORD_LAYOUT
/begin RECORD_LAYOUT _REC_VAL_20_s2 FNC_VALUES 1 SWORD COLUMN_DIR DIRECT /end RECORD_LAYOUT
/begin FUNCTION DIA_Anti_bounce_algorithm "_Anti-bounce-algorithm"
 /begin DEF_CHARACTERISTIC c_ctr_diag_tout_max_pow_vb c_ctr_diag_tout_max_pow_gen c_ctr_diag_tout_max_msw c_ctr_diag_tout_max_etcu c_ctr_diag_tout_max_ang_pste c_abc_max_bn_ars c_abc_inc_bn_ars c_abc_dec_bn_tq_dcc c_abc_dec_bn_ars c_abc_dec_bn_cas c_abc_dec_bn_tq_tcs c_abc_dec_bn_vs_tcs c_abc_dec_bn_tcs c_abc_dec_bn_tq_etcu c_abc_dec_bn_etcu c_abc_dec_bn_tq_amt c_abc_dec_bn_acc c_abc_dec_bn_icl c_abc_dec_bn_km_icl c_abc_dec_bn_t_icl c_abc_dec_bn_pow_vb c_abc_dec_bn_pow_gen c_abc_dec_bn_msw c_abc_dec_bn_ang_pste c_abc_dec_bn_veh_mod c_abc_inc_bn_tq_pste_2 c_abc_max_bn_tq_pste_2 c_abc_dec_bn_tq_pste_2 c_ctr_diag_tcc_can_max_tq_pste_2 c_ctr_diag_cks_max_tq_pste_2 c_ctr_diag_tout_max_tq_pste_2 c_abc_inc_bn_efp c_abc_max_bn_efp c_abc_dec_bn_efp c_ctr_diag_tout_max_efp c_abc_inc_bsd c_abc_max_bsd c_abc_inc_cam_per_0 c_abc_inc_cam_per_1 c_abc_max_cam_per_1 c_abc_max_cam_per_0 c_abc_inc_cam_psn_1 c_abc_max_cam_psn_0 c_abc_max_cam_psn_1 c_abc_inc_cam_psn_0 c_abc_inc_tout_asr_3 c_abc_max_tout_asr_3 c_abc_inc_can_boff c_abc_max_can_boff c_abc_inc_tout_asr_1 c_abc_max_tout_asr_1 c_abc_inc_tout_asr_4 c_abc_max_tout_asr_4 c_abc_inc_tout_efp c_abc_max_tout_efp c_abc_inc_locan_boff c_abc_max_locan_boff c_abc_inc_tout_etcu_1 c_abc_inc_tout_etcu_2 c_abc_max_tout_etcu_1 c_abc_max_tout_etcu_2 c_abc_inc_tout_icl_2 c_abc_max_tout_icl_2 c_abc_inc_tout_icl_3 c_abc_max_tout_icl_3 c_abc_inc_tout_pste_1 c_abc_max_tout_pste_1 c_abc_inc_dcc_inh_mon c_abc_max_dcc_inh_mon c_abc_inc_dcc_rev_mon c_abc_max_dcc_rev_mon c_abc_inc_dcc_irrev_mon c_abc_max_dcc_irrev_mon c_abc_inc_amt_inh_mon c_abc_max_amt_inh_mon c_abc_inc_gs_inh_mon c_abc_inc_tq_gs_inc_plaus_mon c_abc_max_gs_inh_mon c_abc_max_tq_gs_inc_plaus_mon c_abc_inc_tout_nox_sens c_abc_max_tout_nox_sens c_abc_inc_tout_amt_1 c_abc_max_tout_amt_1 c_abc_inc_tout_txu_1 c_abc_max_tout_txu_1 c_abc_inc_eng_psn_prev_syn c_abc_inc_eng_psn_dur_st c_abc_max_eng_psn c_abc_inc_eng_psn_ast c_abc_inc_tooth_per_prev_syn c_abc_inc_tooth_per_ast c_abc_max_tooth_per c_abc_inc_tooth_per_dur_st c_abc_inc_tpu_syn_prev_syn c_abc_inc_tpu_syn_dur_st c_abc_max_tpu_syn c_abc_inc_tpu_syn_ast c_abc_inc_crk_not_plaus c_abc_max_crk_not_plaus c_abc_inc_dcc c_abc_max_dcc c_abc_inc_cs c_abc_max_cs c_abc_inc_ect_mec c_abc_max_ect_mec lc_abc_bench lc_err_det_upd c_abc_max_td_igc_cut c_abc_inc_v_dur_igc c_abc_max_v_dur_igc c_abc_inc_td_igc_cut c_abc_max_ref_ivvt c_abc_inc_ref_ivvt c_abc_inc_knks_diag c_abc_max_knks_diag c_abc_max_vls_down_max c_abc_inc_vls_down_max c_abc_inc_vls_down_min_cold c_abc_max_vls_down_min_cold c_abc_max_vls_down_puc c_abc_max_vls_down_fl c_abc_inc_vls_down_puc c_abc_inc_vls_down_fl c_abc_inc_el_lsl_1 c_abc_inc_el_lsl_2 c_abc_max_el_lsl_1 c_abc_max_el_lsl_2 c_abc_inc_chk_ls_down c_abc_max_chk_ls_down c_abc_inc_maf c_abc_max_maf c_abc_inc_mis_low_fuel c_abc_max_msw_2 c_abc_inc_msw_2 c_abc_inc_msw_tog c_abc_max_msw_tog c_abc_inc_msw_3 c_abc_max_msw_3 c_abc_inc_nox_sens c_abc_max_nox_sens c_abc_inc_load_tps_plaus c_abc_max_load_tps_plaus c_abc_inc_poil_swi c_abc_max_poil_swi c_abc_inc_pvs_ratio c_abc_max_pvs_ratio c_abc_max_pvs_bls_not_plaus c_abc_inc_pvs_bls_not_plaus c_abc_inc_v_ref_1 c_abc_inc_v_ref_2 c_abc_max_v_ref_1 c_abc_max_v_ref_2 c_abc_inc_pvs_1 c_abc_inc_pvs_2 c_abc_max_pvs_1 c_abc_max_pvs_2 c_abc_inc_rly_main c_abc_max_rly_main c_abc_inc_sof_req c_abc_max_sof_req c_abc_inc_tco_grd_diag c_abc_max_tco_grd_diag c_abc_max_tco_el c_abc_inc_tco_el c_abc_inc_tco_ex c_abc_max_tco_ex c_abc_inc_tq_gs_inc_plaus c_abc_max_tq_gs_inc_plaus c_abc_max_tecu c_abc_inc_tecu c_abc_inc_tia c_abc_max_tia c_abc_inc_tps_ad_bol c_abc_max_tps_ad_bol c_abc_inc_tps_1 c_abc_inc_tps_2 c_abc_max_tps_2 c_abc_max_tps_1 c_abc_inc_tqi_lim c_abc_max_tqi_lim c_abc_inc_tq_loss_mon c_abc_max_tq_loss_mon c_abc_inc_seg_t_ad c_abc_inc_seg_t c_abc_max_seg_t_ad c_abc_max_seg_t c_abc_inc_gen c_abc_inc_gen_if c_abc_max_gen c_abc_max_gen_if c_abc_max_gen_diag c_abc_inc_gen_diag c_abc_inc_toil_level c_abc_inc_bat_sens c_abc_inc_bat_sens_it c_abc_inc_bat_sens_it_el c_abc_max_toil_level c_abc_max_bat_sens c_abc_max_bat_sens_it c_abc_max_bat_sens_it_el c_abc_inc_conv_mon c_abc_inc_maf_mon c_abc_inc_n_32_mon c_abc_inc_pvs_ratio_mon c_abc_inc_tps_ratio_mon c_abc_max_conv_mon c_abc_max_maf_mon c_abc_max_n_32_mon c_abc_max_pvs_ratio_mon c_abc_max_tps_ratio_mon c_abc_max_tqi_n_max_mon c_abc_inc_tqi_n_max_mon c_abc_inc_tq_dif_p_d_is_mon c_abc_inc_tq_dif_i_is_mon c_abc_max_tq_dif_p_d_is_mon c_abc_max_tq_dif_i_is_mon c_abc_inc_tqi_av_mon c_abc_max_tqi_av_mon c_abc_inc_tq_min_clu_mon c_abc_max_tq_min_clu_mon c_abc_inc_msr_inh_mon c_abc_max_msr_inh_mon c_abc_inc_cru_inh_mon c_abc_max_cru_inh_mon c_abc_inc_tq_max_clu_mon c_abc_max_tq_max_clu_mon c_abc_max_tqi_n_max_mon2 c_abc_max_tqi_av_mon2 c_abc_inc_tqi_n_max_mon2 c_abc_inc_tqi_av_mon2 c_abc_inc_toil c_abc_max_toil c_abc_inc_mtc_dr c_abc_max_mtc_dr c_abc_max_spi_mps c_abc_max_spi_knk c_abc_inc_spi_mps c_abc_inc_spi_knk /end DEF_CHARACTERISTIC
/end FUNCTION
/begin FUNCTION DIA_Torque_Request_for_Safety_Di "_Torque Request for Safety Diagnosis" /begin OUT_MEASUREMENT lv_err_tqi_lim /end OUT_MEASUREMENT /end FUNCTION
/begin FUNCTION DIA_E_box_cooling_fan_diagnosis "_E-box cooling fan diagnosis" /begin OUT_MEASUREMENT lv_err_ebox_cfa /end OUT_MEASUREMENT /end FUNCTION
/begin FUNCTION DIA_ECU_temperature_sensor_diagn "_ECU temperature sensor diagnosis" /begin DEF_CHARACTERISTIC c_tia_max_tecu_diag c_v_tecu_min_diag c_v_tecu_max_diag /end DEF_CHARACTERISTIC /begin OUT_MEASUREMENT lv_err_tecu /end OUT_MEASUREMENT /end FUNCTION
/begin FUNCTION DIA_Application_incidences_for_d "_Application incidences for downstream oxygen sensor probe diagnosis"
 /begin OUT_MEASUREMENT lam_bank_1.ls_down_diag_inci.bf.lv_inh_diag_vls_down_min lam_bank_1.ls_down_diag_inci.bf.lv_inh_diag_vls_down_max lam_bank_1.ls_down_diag_inci.bf.lv_inh_diag_vls_down_oc lam_bank_1.ls_down_diag_inci.bf.lv_inh_diag_vls_down_puc lam_bank_1.ls_down_diag_inci.bf.lv_inh_diag_vls_down_min_cold lam_bank_1.ls_down_diag_inci.bf.lv_inh_diag_vls_down_fl lam_bank_2.ls_down_diag_inci.bf.lv_inh_diag_vls_down_min lam_bank_2.ls_down_diag_inci.bf.lv_inh_diag_vls_down_max lam_bank_2.ls_down_diag_inci.bf.lv_inh_diag_vls_down_oc lam_bank_2.ls_down_diag_inci.bf.lv_inh_diag_vls_down_puc lam_bank_2.ls_down_diag_inci.bf.lv_inh_diag_vls_down_min_cold lam_bank_2.ls_down_diag_inci.bf.lv_inh_diag_vls_down_fl /end OUT_MEASUREMENT
/end FUNCTION
/begin FUNCTION DIA_Downstream_oxygen_sensor_sig "_Downstream oxygen sensor signal monitoring"
 /begin DEF_CHARACTERISTIC c_r_down_ls_max_vls_down_min c_maf_kgh_min_vls_down_min c_vls_down_min_diag c_vls_down_max_diag c_vls_down_afl_diag c_vls_down_afr_diag c_r_down_min_vls_down_oc c_t_dly_vls_down_min c_t_es_dew_vls_down_min_cold c_t_diag_vls_down_min_cold c_t_dly_vls_down_min_cold c_t_dly_vls_down_oc c_teg_cat_down_mdl_vls_down_oc c_t_err_cdn_vls_down_min c_t_err_cdn_vls_down_oc /end DEF_CHARACTERISTIC
 /begin OUT_MEASUREMENT lam_bank_1.ls_down_diag.t_dly_vls_down_min_cold lam_bank_1.ls_down_diag.t_diag_vls_down_min_cold lam_bank_1.ls_down_diag.t_dly_vls_down_min lam_bank_1.ls_down_diag.t_dly_vls_down_oc lam_bank_1.ls_down_diag.bf.lv_req_chk_ls_down lam_bank_1.ls_down_diag.t_err_cdn_vls_down_min lam_bank_1.ls_down_diag.t_err_cdn_vls_down_oc lam_bank_1.ls_down_diag.t_end_diag_vls_down_min lam_bank_1.ls_down_diag.t_end_diag_vls_down_oc lam_bank_2.ls_down_diag.t_dly_vls_down_min_cold lam_bank_2.ls_down_diag.t_diag_vls_down_min_cold lam_bank_2.ls_down_diag.t_dly_vls_down_min lam_bank_2.ls_down_diag.t_dly_vls_down_oc lam_bank_2.ls_down_diag.bf.lv_req_chk_ls_down lam_bank_2.ls_down_diag.t_err_cdn_vls_down_min lam_bank_2.ls_down_diag.t_err_cdn_vls_down_oc lam_bank_2.ls_down_diag.t_end_diag_vls_down_min lam_bank_2.ls_down_diag.t_end_diag_vls_down_oc lv_err_vls_down_1 lv_err_vls_down_2 lv_err_vls_down_min_2 lv_err_vls_down_max_2 lv_err_vls_down_max_1 lv_err_vls_down_oc_1 lv_err_vls_down_oc_2 lv_err_vls_down_min_1 lv_err_vls_down_min_cold_1 lv_err_vls_down_min_cold_2 /end OUT_MEASUREMENT
/end FUNCTION
/begin FUNCTION DIA_Tank_leakage_pump_diagnosis "_Tank leakage pump diagnosis" /begin DEF_CHARACTERISTIC c_v_dmtl_max_diag c_t_v_dmtl_max_diag /end DEF_CHARACTERISTIC
 /begin OUT_MEASUREMENT cdn_diag_dmtlh lv_err_dmtlh lv_inh_diag_dmtlh ctr_det_dmtlh ctr_ready_dmtlh cdn_diag_dmtl_pump lv_err_dmtl_pump lv_inh_diag_dmtl_pump ctr_det_dmtl_pump ctr_ready_dmtl_pump t_v_dmtl_max_diag cdn_diag_dmtls lv_inh_diag_dmtls lv_err_dmtls ctr_det_dmtls ctr_ready_dmtls iso_m6_diag_ram_com.m6_cur_dmtl_cor_fil_cid18 iso_m6_diag_ram_com.m6_cur_dmtl_cor_fil_cid19 iso_m6_diag_ram_com.m6_cur_dmtl_dmtls_test iso_m6_diag_ram_com.m6_cur_dmtl_thd_dmtls_test iso_m6_diag_ram_com.m6_cur_dmtl_rough_leak_end iso_m6_diag_ram_com.m6_cur_dmtl_thd_rough_leak iso_m6_diag_ram_com.m6_cur_dmtl_small_leak_end iso_m6_diag_ram_com.m6_cur_dmtl_ref_leak iso_m6_diag_ram_com.m6_cur_dmtl_rough_leak_len_end iso_m6_diag_ram_com.m6_cur_dmtl_thd_rough_leak_len iso_m6_diag_ram_com.m6_ctr_cnl_small_leak_mes /end OUT_MEASUREMENT
/end FUNCTION
/begin FUNCTION DIA_SOF_diagnosis "_SOF diagnosis" /begin DEF_CHARACTERISTIC lc_sof_conf c_v_sof_swi_min c_v_sof_swi_max /end DEF_CHARACTERISTIC /begin OUT_MEASUREMENT lv_err_sof_req lv_err_sof /end OUT_MEASUREMENT /end FUNCTION
/begin FUNCTION DIA_HW_based_diagnosis_for_the_C "_HW-based diagnosis for the CJ120 WRAF sensor controller" /begin DEF_CHARACTERISTIC c_t_oc_lsl_diag c_t_end_diag_oc_lsl c_t_dly_diag_el_lsl /end DEF_CHARACTERISTIC
 /begin OUT_MEASUREMENT lv_inh_diag_el_ls_up_2 lv_inh_diag_oc_ls_up_1 lv_inh_diag_el_ls_up_1 lv_inh_diag_oc_ls_up_2 lv_inh_diag_vls_up_1 lv_inh_diag_vls_up_2 lv_err_el_lsl_1 lv_err_el_lsl_2 lv_err_oc_lsl_1 lv_err_oc_lsl_2 /end OUT_MEASUREMENT
/end FUNCTION
/begin FUNCTION DIA_Oxygen_sensor_ceramic_temper "_Oxygen sensor ceramic temperature" /end FUNCTION
/begin FUNCTION DIA_Downstream_oxygen_sensor_int "_Downstream oxygen sensor internal resistance" /end FUNCTION
/begin FUNCTION DIA_TPS___ETC_Limp_Home_Manager "DIA_TPS / ETC Limp-Home Manager"
 /begin OUT_MEASUREMENT lv_tps_mtc_n_lim lv_mtc_lih_cur_off lv_err_tps lv_n_lim_etc_lih lv_n_lim_etc_lih_rev state_tps_diag state_etc_lih lv_mtc_cur_off_req /end OUT_MEASUREMENT
/end FUNCTION
/begin FUNCTION DIA_Diagnosis_Oil_temperature_an "_Diagnosis Oil temperature and level sensor  (DTOENS)" /begin DEF_CHARACTERISTIC TOGMAXUNPL TOG_CNTMAX DTOG_UBMIN /end DEF_CHARACTERISTIC
 /begin OUT_MEASUREMENT lv_err_toil_level lv_err_bat_sens lv_err_bat_sens_it lv_err_bat_sens_it_el /end OUT_MEASUREMENT
/end FUNCTION
/begin FUNCTION DIA_BSD_Diagnosis "_BSD Diagnosis" /begin OUT_MEASUREMENT lv_err_bsd /end OUT_MEASUREMENT /end FUNCTION
/begin FUNCTION DIA_Starter_Output_Diagnosis "_Starter Output Diagnosis"
 /begin OUT_MEASUREMENT cdn_diag_ebox_cfa ctr_det_ebox_cfa ctr_ready_ebox_cfa lv_err_rly_st cdn_diag_rly_st ctr_det_rly_st lv_inh_diag_rly_st ctr_ready_rly_st /end OUT_MEASUREMENT
/end FUNCTION
/begin FUNCTION DIA_Oil_pressure_switch_diagnosi "_Oil pressure switch diagnosis"
 /begin DEF_CHARACTERISTIC c_t_poil_swi_pwl c_toil_poil_swi_max_diag c_toil_poil_swi_min_diag /end DEF_CHARACTERISTIC
 /begin OUT_MEASUREMENT t_poil_swi_pwl lv_err_poil_swi /end OUT_MEASUREMENT
/end FUNCTION
/begin FUNCTION DIA_CAN_diagnosis_for_EFP_contro "_CAN diagnosis for EFP control" /begin DEF_CHARACTERISTIC c_efp_cycnr_max /end DEF_CHARACTERISTIC
 /begin OUT_MEASUREMENT cyc_ctr_efp_diag lv_err_efp lv_err_efp_crash lv_err_tout_efp /end OUT_MEASUREMENT
/end FUNCTION
/begin FUNCTION DIA_Signal_plausibility_monitori "_Signal plausibility monitoring"
 /begin DEF_CHARACTERISTIC c_maf_int_max_vls_down_diag_puc c_maf_int_max_vls_down_diag_fl c_maf_int_min_vls_down_diag_puc c_maf_int_min_vls_down_diag_fl c_vls_down_min_puc c_vls_down_max_fl /end DEF_CHARACTERISTIC
 /begin OUT_MEASUREMENT lv_err_plaus_vls_down_2 maf_int_fl lv_err_plaus_vls_down_1 lv_cdn_plaus_vls_down_1 lv_cdn_plaus_vls_down_2 lv_err_vls_down_fl_1 lv_err_vls_down_fl_2 lv_err_vls_down_puc_1 lv_err_vls_down_puc_2 /end OUT_MEASUREMENT
/end FUNCTION
/begin FUNCTION DIA_ETC_Actuator_diagnosis_and_A "_ETC Actuator diagnosis and Adaptation"
 /begin DEF_CHARACTERISTIC c_mtcpwm_pi_max_diag c_tps_dif_max_diag c_t_tps_dif_diag c_t_mtcpwm_pi_diag_cur_off c_t_mtcpwm_pi_diag c_n_max_tps_ad c_t_max_tps_ad c_t_max_tps_lih_chk c_t_max_tps_sp_rst_chk c_t_tps_ad_hys c_tco_max_tps_ad c_tco_min_tps_ad c_tia_min_tps_ad c_tps_sp_bol_lgrd c_tps_sp_rst_chk_bas c_tps_sp_rst_chk_hys c_tps_sp_rst_chk_lgrd c_v_tps_ad_hys c_v_tps_ad_win_lih c_v_tps_sp_bol_1 c_v_tps_sp_bol_2 c_vb_min_tps_ad c_tps_sp_spr_chk_up c_tps_sp_rst_chk c_tps_av_rst_chk c_t_tps_av_rst_chk c_v_tps_ad_win_bol c_v_tps_ad_win_2_bol c_t_dyw_tps_lih_chk c_v_tps_ad_bol_ini_1 c_v_tps_ad_bol_ini_2 c_v_tps_lih_chk_hys c_v_tps_sp_lih_1 c_v_tps_sp_lih_2 c_tps_ad_slop_gain_ini_1 c_v_tps_ad_ofs_gain_ini_1 /end DEF_CHARACTERISTIC
 /begin OUT_MEASUREMENT v_tps_gain_1 lv_n_lim_tps_ad lv_tps_ad_cur_off lv_tps_ad_diag_cur_off tps_sp_ad v_tps_ad_el_bol_1 v_tps_ad_el_bol_2 v_tps_ad_lih_1 v_tps_ad_lih_2 lv_tps_ad_act tps_ad_slop_gain_1 tps_lih_1 tps_lih_2 lv_tps_ad_req tps_lih_ini v_tps_ad_bol_gain_1 v_tps_ad_tol_1 v_tps_ad_tol_gain_1 inh_iv_tps_ad v_tps_ad_ofs_gain_1 lv_tps_ad_mec_bol tps_ad_step ctr_st_chk_chk_lih_1_ready ctr_st_chk_chk_lih_1_err lv_err_tps_st_chk_2 lv_err_tps_ad lv_err_tps_ad_bol lv_err_tps_st_chk_1 lv_err_mtc_ctl_2 lv_err_mtc_ctl_3 lv_err_mtc_ctl_1 /end OUT_MEASUREMENT
/end FUNCTION
/begin FUNCTION DIA_Electric_solenoid_valve_diag "_Electric solenoid valve diagnosis"
 /begin DEF_CHARACTERISTIC c_slv_ivvt_pwm_diag_min_oc c_slv_ivvt_pwm_diag_min_scb c_slv_ivvt_pwm_diag_max_scg /end DEF_CHARACTERISTIC
 /begin OUT_MEASUREMENT lv_err_slv_ivvt_in_1 lv_err_slv_ivvt_ex_1 lv_inh_diag_slv_ivvt_in_1 cdn_diag_slv_ivvt_ex_1 ctr_det_slv_ivvt_ex_1 ctr_ready_slv_ivvt_in_1 lv_inh_diag_slv_ivvt_ex_1 cdn_diag_slv_ivvt_in_1 ctr_det_slv_ivvt_in_1 ctr_ready_slv_ivvt_ex_1 /end OUT_MEASUREMENT
/end FUNCTION
/begin FUNCTION DIA_Ozone_sensor_diagnosis "_Ozone sensor diagnosis"
 /begin DEF_CHARACTERISTIC ip_o3__v_o3 c_o3_max_diag c_o3_min_diag c_abc_inc_o3_up c_abc_inc_o3_down c_abc_max_o3_up c_abc_max_o3_down c_o3_conc_vs_min c_o3_conc_tco_min c_o3_conc_tco_ex_min c_t_ast_o3_conc c_o3_conc_min c_sum_o3_mes_min c_o3_diag_min ip_o3_dif_diag_min id_o3_fac lc_o3_ena /end DEF_CHARACTERISTIC
 /begin OUT_MEASUREMENT o3_dif o3_dif_quo_min sum_o3_mes_min o3_diag_min state_o3_con_diag lv_err_o3_down lv_err_o3_up /end OUT_MEASUREMENT
/end FUNCTION
/begin FUNCTION DIA_Acquition_of_ozone_concentra "_Acquition of ozone concentration" /begin OUT_MEASUREMENT o3_conc_up o3_conc_down v_o3_up v_o3_down /end OUT_MEASUREMENT /end FUNCTION
/begin FUNCTION DIA_AMT_intervention_plausibilit "_AMT intervention plausibility"
 /begin DEF_CHARACTERISTIC c_vs_fil_amt c_t_max_state_amt_1_diag c_t_max_state_amt_2_diag c_t_max_tqi_amt_diag c_tqi_amt_diag c_tqi_amt_cond_diag c_tqi_amt_can_es c_t_max_state_amt_3_diag c_t_max_state_clu_amt_diag /end DEF_CHARACTERISTIC
 /begin OUT_MEASUREMENT state_err_amt_can lv_amt_es_req t_state_amt_1_diag t_state_amt_2_diag t_state_amt_3_diag state_err_amt state_amt_old t_state_clu_amt_diag tqi_amt_plaus /end OUT_MEASUREMENT
/end FUNCTION
/begin FUNCTION DIA_GS_intervention_plausibility "_GS intervention plausibility Diagnosis"
 /begin DEF_CHARACTERISTIC c_int_tq_gs_inc_rest c_vs_min_tq_gs_inc c_t_dly_min_vs_tq_gs_inc c_crlc_tq_gs_inc_plaus c_int_max_tq_gs_inc c_int_min_tq_gs_inc c_t_dly_min_ac_tq_gs_inc c_t_dif_min_tq_gs_inc ip_ac_max_tq_gs_inc ip_tq_max_tq_gs_inc c_t_max_tq_gs_inc c_t_dly_tq_max_tq_gs_inc /end DEF_CHARACTERISTIC
 /begin OUT_MEASUREMENT int_tq_gs_inc lv_ac_max_tq_gs_inc lv_t_min_tq_gs_inc_deac ctr_t_dif_min_tq_gs_inc state_gs_plaus lv_vs_min_tq_gs_inc ctr_t_vs_tq_gs_inc lv_int_max_tq_gs_inc ctr_t_ac_tq_gs_inc lv_t_max_tq_gs_inc ctr_t_max_tq_gs_inc lv_tq_max_tq_gs_inc ctr_t_tq_max_tq_gs_inc lv_err_tq_gs_inc_plaus /end OUT_MEASUREMENT
/end FUNCTION
/begin FUNCTION DIA_Distance_cruise_control_diag "_Distance cruise control diagnosis" /begin DEF_CHARACTERISTIC c_t_max_brake_det_dcc /end DEF_CHARACTERISTIC /begin OUT_MEASUREMENT lv_dcc_off_ecu t_dcc_brake_det lv_err_dcc /end OUT_MEASUREMENT /end FUNCTION
/begin FUNCTION DIA_DMTL_heater_diagnosis "_DMTL heater diagnosis" /end FUNCTION
/begin FUNCTION DIA_Electronically_controlled_ra "_Electronically controlled radiator shutter diagnosis"
 /begin OUT_MEASUREMENT lv_err_ecras lv_inh_diag_ecras cdn_diag_ecras ctr_det_ecras ctr_ready_ecras /end OUT_MEASUREMENT
/end FUNCTION
/begin FUNCTION DIA_Upstream_oxygen_sensor_signa "_Upstream oxygen sensor signal monitoring" /end FUNCTION
/begin FUNCTION DIA_CAN_diagnosis_for_NOX_contro "_CAN diagnosis for NOX control" /begin DEF_CHARACTERISTIC c_nox_sens_cycnr_max /end DEF_CHARACTERISTIC
 /begin OUT_MEASUREMENT lv_err_locan_boff cyc_ctr_nox_sens_1_diag cyc_ctr_nox_sens_2_diag lv_err_tout_nox_sens_1 lv_err_tout_nox_sens_2 /end OUT_MEASUREMENT
/end FUNCTION
/begin FUNCTION DIA_NOx_Sensor_Diagnosis___OBD_I "_NOx-Sensor Diagnosis - OBD I" /end FUNCTION
/begin FUNCTION DIA_Application_incidences_NOx_S "_Application incidences NOx-Sensor Diagnosis - OBD I"
 /begin OUT_MEASUREMENT lv_inh_diag_nox_sens_1 lv_inh_diag_nox_sens_2 lv_err_nox_sens_can_boff /end OUT_MEASUREMENT
/end FUNCTION
/begin FUNCTION DIA_Application_Incidences_of__W ""
 /begin OUT_MEASUREMENT lam_bank_1.ls_ctl_diag_inci.bf.lv_inh_diag_if_lsl lam_bank_2.ls_ctl_diag_inci.bf.lv_inh_diag_if_lsl /end OUT_MEASUREMENT
/end FUNCTION
/begin FUNCTION DIA_WRAF_Sensor_Controller_Diagn ""
 /begin DEF_CHARACTERISTIC c_max_ctr_err_lsl_if_spi_wr c_t_max_lsl_if_spi_rst_end c_t_end_diag_if_lsl /end DEF_CHARACTERISTIC
 /begin OUT_MEASUREMENT lam_bank_1.ls_ctl_diag.ctr_err_lsl_if_spi_wr_save lam_bank_2.ls_ctl_diag.ctr_err_lsl_if_spi_wr_save lv_err_if_lsl_1 lv_err_if_lsl_2 /end OUT_MEASUREMENT
/end FUNCTION
/begin FUNCTION DIA_Clutch_switch_diagnosis "_Clutch switch diagnosis"
 /begin DEF_CHARACTERISTIC c_maf_cs_diag c_n_32_cs_diag c_vs_cs_diag c_t_min_maf_cs_diag /end DEF_CHARACTERISTIC
 /begin OUT_MEASUREMENT lv_err_cs lv_cs_diag lv_cs_swi t_min_maf_cs_diag /end OUT_MEASUREMENT
/end FUNCTION
/begin FUNCTION DIA_ECU_selftest "_ECU-selftest" /begin OUT_MEASUREMENT lv_err_ecu_ram lv_err_ecu_cks lv_err_ecu_nvmy /end OUT_MEASUREMENT /end FUNCTION
/begin FUNCTION DIA_SPI_Bus_diagnosis "_SPI-Bus diagnosis" /begin OUT_MEASUREMENT lv_err_spi_mps lv_err_spi_knk /end OUT_MEASUREMENT /end FUNCTION
/begin FUNCTION DIA_PVS_diagnosis_application_in "_PVS diagnosis application incidences" /begin DEF_CHARACTERISTIC c_thd_brake_prs c_t_dly_brake_prs /end DEF_CHARACTERISTIC /begin OUT_MEASUREMENT lv_brake_prs_pvs_diag t_dly_brake_prs /end OUT_MEASUREMENT /end FUNCTION
/begin FUNCTION DIA_Automatic_gear_shift_signal_ "_Automatic gear shift signal diagnosis" /begin DEF_CHARACTERISTIC lc_var_gs_eobd /end DEF_CHARACTERISTIC /begin OUT_MEASUREMENT state_diag_gs lv_err_gs /end OUT_MEASUREMENT /end FUNCTION
/begin FUNCTION EOS_Engine_Operating_States "EOS"
 /begin SUB_FUNCTION EOS_General_engine_operating_sta EOS_Basic_operating_states__LV_S EOS_Basic_functions__FL__INF___R EOS_Auxiliary_start_functions EOS_Combustion_Management EOS_Catalyst_heating_functions EOS_Combustion_Mode_Switch EOS_Combustion_switch_request_to EOS_Runtime_Optimization_by_Recu /end SUB_FUNCTION
/end FUNCTION
/begin FUNCTION EOS_General_engine_operating_sta "_General engine operating states" /begin DEF_CHARACTERISTIC c_t_max_ecu ip_n_max_tol_st /end DEF_CHARACTERISTIC /begin OUT_MEASUREMENT lv_mu_inh_pwl_tran_es_el /end OUT_MEASUREMENT /end FUNCTION
/begin FUNCTION EOS_Basic_operating_states__LV_S "_Basic operating states: LV_ST, LV_IS, LV_REQ_ISC, LV_PL, LV_PU & LV_PUC"
 /begin DEF_CHARACTERISTIC ip_cyc_cast__tco c_n_max_bol_st c_t_min_pu c_t_max_pu lc_inh_dt_pu c_t_min_pu_msr c_t_min_pu_rng_l id_n_hys_max_puc__gr_at id_n_hys_max_puc__gr_mt id_n_hys_min_puc__gr_at id_n_hys_min_puc__gr_mt id_n_hys_puc_st__gr_at id_n_hys_puc_st__gr_mt c_cycnr_hys_puc c_cycnr_hys_puc_st c_tco_min_puc_st ip_n_min_puc__tco__gr_mt ip_n_accout_min_puc__tco__gr_mt ip_n_accout_min_puc__tco__gr_at c_n_dif_ast c_t_n_dif_ast ip_n_min_puc__tco__gr_at ip_n_min_puc_add_ars c_t_min_pu_vs c_vs_min_pu ip_t_min_pu__n__tco ip_t_min_pu_rng_l__n__tco ip_n_dif_max_is /end DEF_CHARACTERISTIC
 /begin OUT_MEASUREMENT lv_es lv_st lv_st_end lv_is lv_pl lv_pu t_pu lv_puc lv_puc_req state_eng lv_iga_min_puc /end OUT_MEASUREMENT
/end FUNCTION
/end MODULE
/end PROJECT
