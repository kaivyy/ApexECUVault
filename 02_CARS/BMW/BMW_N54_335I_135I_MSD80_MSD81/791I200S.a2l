ASAP2_VERSION 1 41
/begin PROJECT MSD85 "Spray Guided DI-System with Piezo Injectors for 8-Cylinder"
/begin HEADER "_default_HeaderComment" PROJECT_NO _91 /end HEADER
/begin MODULE _default_ModuleName "_default_ModuleLongIdentifier"
/begin MOD_COMMON "_default_ModCommonComment" DEPOSIT ABSOLUTE BYTE_ORDER MSB_LAST ALIGNMENT_BYTE 1 ALIGNMENT_WORD 2 ALIGNMENT_LONG 2 ALIGNMENT_FLOAT32_IEEE 2 ALIGNMENT_FLOAT64_IEEE 4 /end MOD_COMMON
/begin CHARACTERISTIC id_err_clas_a_fmt "Sub Class A definition" CURVE 0xa0804e20 _REC_CUR_20_u1_u2 255. _CNV_A_R_LINEAR_____0_CM 0. 255. DISPLAY_IDENTIFIER ID_ERR_CLAS_A_FMT FORMAT "%3.0"
 /begin AXIS_DESCR COM_AXIS errm_online_dummy _CNV_A_R_LINEAR_____0_CM 16 0. 65535. FORMAT "%5.0" AXIS_PTS_REF ldpm_clas_a_id_clas_fmy /end AXIS_DESCR
/end CHARACTERISTIC
/begin CHARACTERISTIC id_err_clas_b_fmt "Sub Class B definition" MAP 0xa0804e30 _REC_MAP_20_u1_u2_u2 255. _CNV_A_R_LINEAR_____0_CM 0. 255. DISPLAY_IDENTIFIER ID_ERR_CLAS_B_FMT FORMAT "%3.0"
 /begin AXIS_DESCR COM_AXIS errm_online_dummy _CNV_A_R_LINEAR_____0_CM 16 0. 65535. FORMAT "%5.0" AXIS_PTS_REF ldpm_clas_a_id_clas_fmy /end AXIS_DESCR
 /begin AXIS_DESCR COM_AXIS errm_online_dummy _CNV_A_R_LINEAR_____0_CM 4 0. 65535. FORMAT "%5.0" AXIS_PTS_REF ldp_clas_b_id_clas_fmy /end AXIS_DESCR
/end CHARACTERISTIC
/begin AXIS_PTS ldpm_clas_a_id_clas_fmy "" 0xa080292c errm_online_dummy _REC_AXS_20_u2 65535. _CNV_A_R_LINEAR_____0_CM 16 0. 65535. FORMAT "%5.0" /end AXIS_PTS
/begin AXIS_PTS ldp_clas_b_id_clas_fmy "" 0xa08028ec errm_online_dummy _REC_AXS_20_u2 65535. _CNV_A_R_LINEAR_____0_CM 4 0. 65535. FORMAT "%5.0" /end AXIS_PTS
/begin MEASUREMENT state_mil "State of MIL illumination commanded by error management (ON(1), OFF(0), MIL_FLL(2))" UBYTE _CNV_S_3_ERRM_RANGE_476_CM 1 100. 0. 2. DISPLAY_IDENTIFIER STATE_MIL ECU_ADDRESS 0xd0008137 /end MEASUREMENT
/begin MEASUREMENT lv_wal_2 "Boolean indicating WAL_2 physical output (0 : off / 1 : on)" UBYTE _CNV_S_2_RANGE__0___1_CM 1 100. 0. 1. DISPLAY_IDENTIFIER LV_WAL_2 ECU_ADDRESS 0xd000814b BIT_MASK 0x1 /end MEASUREMENT
/begin MEASUREMENT state_wal_1 "State of WAL_1 illumination commanded by error management (ON(1), OFF(0))" UBYTE _CNV_S_3_ERRM_RANGE_476_CM 1 100. 0. 2. DISPLAY_IDENTIFIER STATE_WAL_1 ECU_ADDRESS 0xd000813b /end MEASUREMENT
/begin MEASUREMENT state_wal_2 "State of WAL_2 illumination commanded by error management (ON(1), OFF(0))" UBYTE _CNV_S_3_ERRM_RANGE_476_CM 1 100. 0. 2. DISPLAY_IDENTIFIER STATE_WAL_2 ECU_ADDRESS 0xd000813c /end MEASUREMENT
/begin CHARACTERISTIC c_conf_mil "Configuration of MIL" VALUE 0xa0804eb8 _REC_VAL_20_u1 255. _CNV_A_R_LINEAR_____0_CM 0. 255. DISPLAY_IDENTIFIER C_CONF_MIL FORMAT "%3.0" /end CHARACTERISTIC
/begin CHARACTERISTIC c_conf_wal_1 "Configuration of warning lamp 1 (WAL_1)" VALUE 0xa0804eb9 _REC_VAL_20_u1 255. _CNV_A_R_LINEAR_____0_CM 0. 255. DISPLAY_IDENTIFIER C_CONF_WAL_1 FORMAT "%3.0" /end CHARACTERISTIC
/begin CHARACTERISTIC c_conf_wal_2 "Configuration of warning lamp 2 (WAL_2)" VALUE 0xa0804eba _REC_VAL_20_u1 255. _CNV_A_R_LINEAR_____0_CM 0. 255. DISPLAY_IDENTIFIER C_CONF_WAL_2 FORMAT "%3.0" /end CHARACTERISTIC
/begin CHARACTERISTIC c_dly_inh_iv_mis "Delay for MIL blinking in case of misfiring present failure with cylinder cut off" VALUE 0xa0804ebe _REC_VAL_20_u1 127.5 _CNV_A_R_LINEAR_____19_CM 0. 127.5 DISPLAY_IDENTIFIER C_DLY_INH_IV_MIS FORMAT "%5.1" /end CHARACTERISTIC
/begin MEASUREMENT lv_wal_1 "Boolean indicating WAL_1 physical output (0 : off / 1 : on)" UBYTE _CNV_S_2_RANGE__0___1_CM 1 100. 0. 1. DISPLAY_IDENTIFIER LV_WAL_1 ECU_ADDRESS 0xd0008149 BIT_MASK 0x1 /end MEASUREMENT
/begin MEASUREMENT lv_wal_st "Boolean indicating Pre-drive check mode (0 : off / 1 : on)" UBYTE _CNV_S_2_RANGE__0___1_CM 1 100. 0. 1. DISPLAY_IDENTIFIER LV_WAL_ST ECU_ADDRESS 0xd000814d BIT_MASK 0x1 /end MEASUREMENT
/begin MEASUREMENT dly_mil_ready "Delay time to enable MIL blinking during pre-drive check mode" UWORD _CNV_A_R_LINEAR_____19_CM 1 100. 0. 32767.5 DISPLAY_IDENTIFIER DLY_MIL_READY ECU_ADDRESS 0xd0002780 FORMAT "%8.1" /end MEASUREMENT
/begin CHARACTERISTIC c_dly_mil_ready_2 "MIL blink duration for readiness display during pre-drive check" VALUE 0xa0804ec0 _REC_VAL_20_u1 127.5 _CNV_A_R_LINEAR_____19_CM 0. 127.5 DISPLAY_IDENTIFIER C_DLY_MIL_READY_2 FORMAT "%5.1" /end CHARACTERISTIC
/begin CHARACTERISTIC c_dly_mil_ready_1 "Delay to start MIL blinking for readiness display during pre-drive check" VALUE 0xa0804ebf _REC_VAL_20_u1 127.5 _CNV_A_R_LINEAR_____19_CM 0. 127.5 DISPLAY_IDENTIFIER C_DLY_MIL_READY_1 FORMAT "%5.1" /end CHARACTERISTIC
/begin MEASUREMENT lv_mil "Boolean indicating MIL physical output (0 : off / 1 : on)" UBYTE _CNV_S_2_RANGE__0___1_CM 1 100. 0. 1. DISPLAY_IDENTIFIER LV_MIL ECU_ADDRESS 0xd0008144 BIT_MASK 0x1 /end MEASUREMENT
/begin MEASUREMENT lv_mil_wup "Flag that indicate a MIL activation during the current WUP" UBYTE _CNV_S_2_RANGE__0___1_CM 1 100. 0. 1. DISPLAY_IDENTIFIER LV_MIL_WUP ECU_ADDRESS 0xd000279d BIT_MASK 0x1 /end MEASUREMENT
/begin MEASUREMENT lv_wal_1_wup "Flag that indicate a WAL_1 activation during the current WUP" UBYTE _CNV_S_2_RANGE__0___1_CM 1 100. 0. 1. DISPLAY_IDENTIFIER LV_WAL_1_WUP ECU_ADDRESS 0xd000279e BIT_MASK 0x1 /end MEASUREMENT
/begin MEASUREMENT lv_wal_2_wup "Flag that indicate a WAL_2 activation during the current WUP" UBYTE _CNV_S_2_RANGE__0___1_CM 1 100. 0. 1. DISPLAY_IDENTIFIER LV_WAL_2_WUP ECU_ADDRESS 0xd000279f BIT_MASK 0x1 /end MEASUREMENT
/begin MEASUREMENT lv_mil_fll_ready "" UBYTE _CNV_S_2_RANGE__0___1_CM 1 100. 0. 1. DISPLAY_IDENTIFIER LV_MIL_FLL_READY ECU_ADDRESS 0xd0008146 BIT_MASK 0x1 /end MEASUREMENT
/begin CHARACTERISTIC c_t_min_wal_st "Minimum time of pre-drive check duration" VALUE 0xa0804ece _REC_VAL_20_u1 127.5 _CNV_A_R_LINEAR_____19_CM 0. 127.5 DISPLAY_IDENTIFIER C_T_MIN_WAL_ST FORMAT "%5.1" /end CHARACTERISTIC
/begin CHARACTERISTIC lc_t_max_wal_st_ena "Activation of maximum time of pre-drive check" VALUE 0xa0804ee1 _REC_VAL_20_u1 1. _CNV_A_R_LINEAR_____0_CM 0. 1. DISPLAY_IDENTIFIER LC_T_MAX_WAL_ST_ENA FORMAT "%1.0" /end CHARACTERISTIC
/begin MEASUREMENT t_wal_st "Time for pre-drive check duration" UBYTE _CNV_A_R_LINEAR_____19_CM 1 100. 0. 127.5 DISPLAY_IDENTIFIER T_WAL_ST ECU_ADDRESS 0xd0002798 FORMAT "%5.1" /end MEASUREMENT
/begin MEASUREMENT errm_online_dummy "" UWORD _CNV_A_R_LINEAR_____0_CM 1 100. 0. 65535. DISPLAY_IDENTIFIER DUMMY ECU_ADDRESS 0xd0009ff8 FORMAT "%5.0" /end MEASUREMENT
/begin CHARACTERISTIC fmy_id_imob_0.dtc "DTC table declaration for the diagnosis instance XX" MAP 0xa0803b60 _REC_MAP_20_u2_u2_u2 65535. _CNV_A_R_LINEAR_____0_CM 0. 65535. DISPLAY_IDENTIFIER ID_ERR_DTC_IMOB_0 FORMAT "%5.0"
 /begin AXIS_DESCR COM_AXIS errm_online_dummy _CNV_S_2_ERRM_DTC_R_477_CM 1 0. 1. AXIS_PTS_REF ldp_nr_1_id_err_dtc /end AXIS_DESCR
 /begin AXIS_DESCR COM_AXIS errm_online_dummy _CNV_S_6_ERRM_DTC_R_478_CM 6 0. 5. AXIS_PTS_REF ldp_nr_2_id_err_dtc /end AXIS_DESCR
/end CHARACTERISTIC
/begin CHARACTERISTIC fmy_id_imob_0.c_err_clas "Failure class number for failure XX" VALUE 0xa0803b70 _REC_VAL_20_u1 255. _CNV_A_R_LINEAR_____0_CM 0. 255. DISPLAY_IDENTIFIER C_ERR_CLAS_IMOB_0 FORMAT "%3.0" /end CHARACTERISTIC
/begin CHARACTERISTIC fmy_id_imob_1.dtc "DTC table declaration for the diagnosis instance XX" MAP 0xa0803b74 _REC_MAP_20_u2_u2_u2 65535. _CNV_A_R_LINEAR_____0_CM 0. 65535. DISPLAY_IDENTIFIER ID_ERR_DTC_IMOB_1 FORMAT "%5.0"
 /begin AXIS_DESCR COM_AXIS errm_online_dummy _CNV_S_2_ERRM_DTC_R_477_CM 1 0. 1. AXIS_PTS_REF ldp_nr_1_id_err_dtc /end AXIS_DESCR
 /begin AXIS_DESCR COM_AXIS errm_online_dummy _CNV_S_6_ERRM_DTC_R_478_CM 6 0. 5. AXIS_PTS_REF ldp_nr_2_id_err_dtc /end AXIS_DESCR
/end CHARACTERISTIC
/begin CHARACTERISTIC fmy_id_imob_1.c_err_clas "Failure class number for failure XX" VALUE 0xa0803b84 _REC_VAL_20_u1 255. _CNV_A_R_LINEAR_____0_CM 0. 255. DISPLAY_IDENTIFIER C_ERR_CLAS_IMOB_1 FORMAT "%3.0" /end CHARACTERISTIC
/begin CHARACTERISTIC fmy_id_imob_2.dtc "DTC table declaration for the diagnosis instance XX" MAP 0xa0803b88 _REC_MAP_20_u2_u2_u2 65535. _CNV_A_R_LINEAR_____0_CM 0. 65535. DISPLAY_IDENTIFIER ID_ERR_DTC_IMOB_2 FORMAT "%5.0"
 /begin AXIS_DESCR COM_AXIS errm_online_dummy _CNV_S_2_ERRM_DTC_R_477_CM 1 0. 1. AXIS_PTS_REF ldp_nr_1_id_err_dtc /end AXIS_DESCR
 /begin AXIS_DESCR COM_AXIS errm_online_dummy _CNV_S_6_ERRM_DTC_R_478_CM 6 0. 5. AXIS_PTS_REF ldp_nr_2_id_err_dtc /end AXIS_DESCR
/end CHARACTERISTIC
/begin CHARACTERISTIC fmy_id_imob_2.c_err_clas "Failure class number for failure XX" VALUE 0xa0803b98 _REC_VAL_20_u1 255. _CNV_A_R_LINEAR_____0_CM 0. 255. DISPLAY_IDENTIFIER C_ERR_CLAS_IMOB_2 FORMAT "%3.0" /end CHARACTERISTIC
/begin CHARACTERISTIC fmy_id_imob_3.dtc "DTC table declaration for the diagnosis instance XX" MAP 0xa0803b9c _REC_MAP_20_u2_u2_u2 65535. _CNV_A_R_LINEAR_____0_CM 0. 65535. DISPLAY_IDENTIFIER ID_ERR_DTC_IMOB_3 FORMAT "%5.0"
 /begin AXIS_DESCR COM_AXIS errm_online_dummy _CNV_S_2_ERRM_DTC_R_477_CM 1 0. 1. AXIS_PTS_REF ldp_nr_1_id_err_dtc /end AXIS_DESCR
 /begin AXIS_DESCR COM_AXIS errm_online_dummy _CNV_S_6_ERRM_DTC_R_478_CM 6 0. 5. AXIS_PTS_REF ldp_nr_2_id_err_dtc /end AXIS_DESCR
/end CHARACTERISTIC
/begin CHARACTERISTIC fmy_id_imob_3.c_err_clas "Failure class number for failure XX" VALUE 0xa0803bac _REC_VAL_20_u1 255. _CNV_A_R_LINEAR_____0_CM 0. 255. DISPLAY_IDENTIFIER C_ERR_CLAS_IMOB_3 FORMAT "%3.0" /end CHARACTERISTIC
/begin CHARACTERISTIC fmy_id_tco_el.dtc "DTC table declaration for the diagnosis instance XX" MAP 0xa0804934 _REC_MAP_20_u2_u2_u2 65535. _CNV_A_R_LINEAR_____0_CM 0. 65535. DISPLAY_IDENTIFIER ID_ERR_DTC_TCO_EL FORMAT "%5.0"
 /begin AXIS_DESCR COM_AXIS errm_online_dummy _CNV_S_2_ERRM_DTC_R_477_CM 1 0. 1. AXIS_PTS_REF ldp_nr_1_id_err_dtc /end AXIS_DESCR
 /begin AXIS_DESCR COM_AXIS errm_online_dummy _CNV_S_6_ERRM_DTC_R_478_CM 6 0. 5. AXIS_PTS_REF ldp_nr_2_id_err_dtc /end AXIS_DESCR
/end CHARACTERISTIC
/begin CHARACTERISTIC fmy_id_tco_el.c_err_clas "Failure class number for failure XX" VALUE 0xa0804944 _REC_VAL_20_u1 255. _CNV_A_R_LINEAR_____0_CM 0. 255. DISPLAY_IDENTIFIER C_ERR_CLAS_TCO_EL FORMAT "%3.0" /end CHARACTERISTIC
/begin CHARACTERISTIC fmy_id_tco_grd.dtc "DTC table declaration for the diagnosis instance XX" MAP 0xa0804948 _REC_MAP_20_u2_u2_u2 65535. _CNV_A_R_LINEAR_____0_CM 0. 65535. DISPLAY_IDENTIFIER ID_ERR_DTC_TCO_GRD FORMAT "%5.0"
 /begin AXIS_DESCR COM_AXIS errm_online_dummy _CNV_S_2_ERRM_DTC_R_477_CM 1 0. 1. AXIS_PTS_REF ldp_nr_1_id_err_dtc /end AXIS_DESCR
 /begin AXIS_DESCR COM_AXIS errm_online_dummy _CNV_S_6_ERRM_DTC_R_478_CM 6 0. 5. AXIS_PTS_REF ldp_nr_2_id_err_dtc /end AXIS_DESCR
/end CHARACTERISTIC
/begin CHARACTERISTIC fmy_id_tco_grd.c_err_clas "Failure class number for failure XX" VALUE 0xa0804958 _REC_VAL_20_u1 255. _CNV_A_R_LINEAR_____0_CM 0. 255. DISPLAY_IDENTIFIER C_ERR_CLAS_TCO_GRD FORMAT "%3.0" /end CHARACTERISTIC
/begin CHARACTERISTIC fmy_id_tco_stuck.dtc "DTC table declaration for the diagnosis instance XX" MAP 0xa0804970 _REC_MAP_20_u2_u2_u2 65535. _CNV_A_R_LINEAR_____0_CM 0. 65535. DISPLAY_IDENTIFIER ID_ERR_DTC_TCO_STUCK FORMAT "%5.0"
 /begin AXIS_DESCR COM_AXIS errm_online_dummy _CNV_S_2_ERRM_DTC_R_477_CM 1 0. 1. AXIS_PTS_REF ldp_nr_1_id_err_dtc /end AXIS_DESCR
 /begin AXIS_DESCR COM_AXIS errm_online_dummy _CNV_S_6_ERRM_DTC_R_478_CM 6 0. 5. AXIS_PTS_REF ldp_nr_2_id_err_dtc /end AXIS_DESCR
/end CHARACTERISTIC
/begin CHARACTERISTIC fmy_id_tco_stuck.c_err_clas "Failure class number for failure XX" VALUE 0xa0804980 _REC_VAL_20_u1 255. _CNV_A_R_LINEAR_____0_CM 0. 255. DISPLAY_IDENTIFIER C_ERR_CLAS_TCO_STUCK FORMAT "%3.0" /end CHARACTERISTIC
/begin CHARACTERISTIC fmy_id_tco_stuck_rng.dtc "DTC table declaration for the diagnosis instance XX" MAP 0xa0804984 _REC_MAP_20_u2_u2_u2 65535. _CNV_A_R_LINEAR_____0_CM 0. 65535. DISPLAY_IDENTIFIER ID_ERR_DTC_TCO_STUCK_RNG FORMAT "%5.0"
 /begin AXIS_DESCR COM_AXIS errm_online_dummy _CNV_S_2_ERRM_DTC_R_477_CM 1 0. 1. AXIS_PTS_REF ldp_nr_1_id_err_dtc /end AXIS_DESCR
 /begin AXIS_DESCR COM_AXIS errm_online_dummy _CNV_S_6_ERRM_DTC_R_478_CM 6 0. 5. AXIS_PTS_REF ldp_nr_2_id_err_dtc /end AXIS_DESCR
/end CHARACTERISTIC
/begin CHARACTERISTIC fmy_id_tco_stuck_rng.c_err_clas "Failure class number for failure XX" VALUE 0xa0804994 _REC_VAL_20_u1 255. _CNV_A_R_LINEAR_____0_CM 0. 255. DISPLAY_IDENTIFIER C_ERR_CLAS_TCO_STUCK_RNG FORMAT "%3.0" /end CHARACTERISTIC
/begin CHARACTERISTIC fmy_id_tco_plaus.dtc "DTC table declaration for the diagnosis instance XX" MAP 0xa080495c _REC_MAP_20_u2_u2_u2 65535. _CNV_A_R_LINEAR_____0_CM 0. 65535. DISPLAY_IDENTIFIER ID_ERR_DTC_TCO_PLAUS FORMAT "%5.0"
 /begin AXIS_DESCR COM_AXIS errm_online_dummy _CNV_S_2_ERRM_DTC_R_477_CM 1 0. 1. AXIS_PTS_REF ldp_nr_1_id_err_dtc /end AXIS_DESCR
 /begin AXIS_DESCR COM_AXIS errm_online_dummy _CNV_S_6_ERRM_DTC_R_478_CM 6 0. 5. AXIS_PTS_REF ldp_nr_2_id_err_dtc /end AXIS_DESCR
/end CHARACTERISTIC
/begin CHARACTERISTIC fmy_id_tco_plaus.c_err_clas "Failure class number for failure XX" VALUE 0xa080496c _REC_VAL_20_u1 255. _CNV_A_R_LINEAR_____0_CM 0. 255. DISPLAY_IDENTIFIER C_ERR_CLAS_TCO_PLAUS FORMAT "%3.0" /end CHARACTERISTIC
/begin CHARACTERISTIC fmy_id_tco_2_el.dtc "DTC table declaration for the diagnosis instance XX" MAP 0xa08048f8 _REC_MAP_20_u2_u2_u2 65535. _CNV_A_R_LINEAR_____0_CM 0. 65535. DISPLAY_IDENTIFIER ID_ERR_DTC_TCO_2_EL FORMAT "%5.0"
 /begin AXIS_DESCR COM_AXIS errm_online_dummy _CNV_S_2_ERRM_DTC_R_477_CM 1 0. 1. AXIS_PTS_REF ldp_nr_1_id_err_dtc /end AXIS_DESCR
 /begin AXIS_DESCR COM_AXIS errm_online_dummy _CNV_S_6_ERRM_DTC_R_478_CM 6 0. 5. AXIS_PTS_REF ldp_nr_2_id_err_dtc /end AXIS_DESCR
/end CHARACTERISTIC
/begin CHARACTERISTIC fmy_id_tco_2_el.c_err_clas "Failure class number for failure XX" VALUE 0xa0804908 _REC_VAL_20_u1 255. _CNV_A_R_LINEAR_____0_CM 0. 255. DISPLAY_IDENTIFIER C_ERR_CLAS_TCO_2_EL FORMAT "%3.0" /end CHARACTERISTIC
/begin CHARACTERISTIC fmy_id_tco_2_grd.dtc "DTC table declaration for the diagnosis instance XX" MAP 0xa080490c _REC_MAP_20_u2_u2_u2 65535. _CNV_A_R_LINEAR_____0_CM 0. 65535. DISPLAY_IDENTIFIER ID_ERR_DTC_TCO_2_GRD FORMAT "%5.0"
 /begin AXIS_DESCR COM_AXIS errm_online_dummy _CNV_S_2_ERRM_DTC_R_477_CM 1 0. 1. AXIS_PTS_REF ldp_nr_1_id_err_dtc /end AXIS_DESCR
 /begin AXIS_DESCR COM_AXIS errm_online_dummy _CNV_S_6_ERRM_DTC_R_478_CM 6 0. 5. AXIS_PTS_REF ldp_nr_2_id_err_dtc /end AXIS_DESCR
/end CHARACTERISTIC
/begin CHARACTERISTIC fmy_id_tco_2_grd.c_err_clas "Failure class number for failure XX" VALUE 0xa080491c _REC_VAL_20_u1 255. _CNV_A_R_LINEAR_____0_CM 0. 255. DISPLAY_IDENTIFIER C_ERR_CLAS_TCO_2_GRD FORMAT "%3.0" /end CHARACTERISTIC
/begin CHARACTERISTIC fmy_id_tco_2_plaus.dtc "DTC table declaration for the diagnosis instance XX" MAP 0xa0804920 _REC_MAP_20_u2_u2_u2 65535. _CNV_A_R_LINEAR_____0_CM 0. 65535. DISPLAY_IDENTIFIER ID_ERR_DTC_TCO_2_PLAUS FORMAT "%5.0"
 /begin AXIS_DESCR COM_AXIS errm_online_dummy _CNV_S_2_ERRM_DTC_R_477_CM 1 0. 1. AXIS_PTS_REF ldp_nr_1_id_err_dtc /end AXIS_DESCR
 /begin AXIS_DESCR COM_AXIS errm_online_dummy _CNV_S_6_ERRM_DTC_R_478_CM 6 0. 5. AXIS_PTS_REF ldp_nr_2_id_err_dtc /end AXIS_DESCR
/end CHARACTERISTIC
/begin CHARACTERISTIC fmy_id_tco_2_plaus.c_err_clas "Failure class number for failure XX" VALUE 0xa0804930 _REC_VAL_20_u1 255. _CNV_A_R_LINEAR_____0_CM 0. 255. DISPLAY_IDENTIFIER C_ERR_CLAS_TCO_2_PLAUS FORMAT "%3.0" /end CHARACTERISTIC
/begin CHARACTERISTIC fmy_id_ect_el.dtc "DTC table declaration for the diagnosis instance XX" MAP 0xa08035e8 _REC_MAP_20_u2_u2_u2 65535. _CNV_A_R_LINEAR_____0_CM 0. 65535. DISPLAY_IDENTIFIER ID_ERR_DTC_ECT_EL FORMAT "%5.0"
 /begin AXIS_DESCR COM_AXIS errm_online_dummy _CNV_S_2_ERRM_DTC_R_477_CM 1 0. 1. AXIS_PTS_REF ldp_nr_1_id_err_dtc /end AXIS_DESCR
 /begin AXIS_DESCR COM_AXIS errm_online_dummy _CNV_S_6_ERRM_DTC_R_478_CM 6 0. 5. AXIS_PTS_REF ldp_nr_2_id_err_dtc /end AXIS_DESCR
/end CHARACTERISTIC
/begin CHARACTERISTIC fmy_id_ect_el.c_err_clas "Failure class number for failure XX" VALUE 0xa08035f8 _REC_VAL_20_u1 255. _CNV_A_R_LINEAR_____0_CM 0. 255. DISPLAY_IDENTIFIER C_ERR_CLAS_ECT_EL FORMAT "%3.0" /end CHARACTERISTIC
/begin CHARACTERISTIC fmy_id_ecf_el_1.dtc "DTC table declaration for the diagnosis instance XX" MAP 0xa0803548 _REC_MAP_20_u2_u2_u2 65535. _CNV_A_R_LINEAR_____0_CM 0. 65535. DISPLAY_IDENTIFIER ID_ERR_DTC_ECF_EL_1 FORMAT "%5.0"
 /begin AXIS_DESCR COM_AXIS errm_online_dummy _CNV_S_2_ERRM_DTC_R_477_CM 1 0. 1. AXIS_PTS_REF ldp_nr_1_id_err_dtc /end AXIS_DESCR
 /begin AXIS_DESCR COM_AXIS errm_online_dummy _CNV_S_6_ERRM_DTC_R_478_CM 6 0. 5. AXIS_PTS_REF ldp_nr_2_id_err_dtc /end AXIS_DESCR
/end CHARACTERISTIC
/begin CHARACTERISTIC fmy_id_ecf_el_1.c_err_clas "Failure class number for failure XX" VALUE 0xa0803558 _REC_VAL_20_u1 255. _CNV_A_R_LINEAR_____0_CM 0. 255. DISPLAY_IDENTIFIER C_ERR_CLAS_ECF_EL_1 FORMAT "%3.0" /end CHARACTERISTIC
/begin CHARACTERISTIC fmy_id_ecf_el_2.dtc "DTC table declaration for the diagnosis instance XX" MAP 0xa080355c _REC_MAP_20_u2_u2_u2 65535. _CNV_A_R_LINEAR_____0_CM 0. 65535. DISPLAY_IDENTIFIER ID_ERR_DTC_ECF_EL_2 FORMAT "%5.0"
 /begin AXIS_DESCR COM_AXIS errm_online_dummy _CNV_S_2_ERRM_DTC_R_477_CM 1 0. 1. AXIS_PTS_REF ldp_nr_1_id_err_dtc /end AXIS_DESCR
 /begin AXIS_DESCR COM_AXIS errm_online_dummy _CNV_S_6_ERRM_DTC_R_478_CM 6 0. 5. AXIS_PTS_REF ldp_nr_2_id_err_dtc /end AXIS_DESCR
/end CHARACTERISTIC
/begin CHARACTERISTIC fmy_id_ecf_el_2.c_err_clas "Failure class number for failure XX" VALUE 0xa080356c _REC_VAL_20_u1 255. _CNV_A_R_LINEAR_____0_CM 0. 255. DISPLAY_IDENTIFIER C_ERR_CLAS_ECF_EL_2 FORMAT "%3.0" /end CHARACTERISTIC
/begin CHARACTERISTIC fmy_id_ecfpwm_fb_1.dtc "DTC table declaration for the diagnosis instance XX" MAP 0xa0803570 _REC_MAP_20_u2_u2_u2 65535. _CNV_A_R_LINEAR_____0_CM 0. 65535. DISPLAY_IDENTIFIER ID_ERR_DTC_ECFPWM_FB_1 FORMAT "%5.0"
 /begin AXIS_DESCR COM_AXIS errm_online_dummy _CNV_S_2_ERRM_DTC_R_477_CM 1 0. 1. AXIS_PTS_REF ldp_nr_1_id_err_dtc /end AXIS_DESCR
 /begin AXIS_DESCR COM_AXIS errm_online_dummy _CNV_S_6_ERRM_DTC_R_478_CM 6 0. 5. AXIS_PTS_REF ldp_nr_2_id_err_dtc /end AXIS_DESCR
/end CHARACTERISTIC
/begin CHARACTERISTIC fmy_id_ecfpwm_fb_1.c_err_clas "Failure class number for failure XX" VALUE 0xa0803580 _REC_VAL_20_u1 255. _CNV_A_R_LINEAR_____0_CM 0. 255. DISPLAY_IDENTIFIER C_ERR_CLAS_ECFPWM_FB_1 FORMAT "%3.0" /end CHARACTERISTIC
/begin CHARACTERISTIC fmy_id_ecfpwm_fb_2.dtc "DTC table declaration for the diagnosis instance XX" MAP 0xa0803584 _REC_MAP_20_u2_u2_u2 65535. _CNV_A_R_LINEAR_____0_CM 0. 65535. DISPLAY_IDENTIFIER ID_ERR_DTC_ECFPWM_FB_2 FORMAT "%5.0"
 /begin AXIS_DESCR COM_AXIS errm_online_dummy _CNV_S_2_ERRM_DTC_R_477_CM 1 0. 1. AXIS_PTS_REF ldp_nr_1_id_err_dtc /end AXIS_DESCR
 /begin AXIS_DESCR COM_AXIS errm_online_dummy _CNV_S_6_ERRM_DTC_R_478_CM 6 0. 5. AXIS_PTS_REF ldp_nr_2_id_err_dtc /end AXIS_DESCR
/end CHARACTERISTIC
/begin CHARACTERISTIC fmy_id_ecfpwm_fb_2.c_err_clas "Failure class number for failure XX" VALUE 0xa0803594 _REC_VAL_20_u1 255. _CNV_A_R_LINEAR_____0_CM 0. 255. DISPLAY_IDENTIFIER C_ERR_CLAS_ECFPWM_FB_2 FORMAT "%3.0" /end CHARACTERISTIC
/begin CHARACTERISTIC fmy_id_th.dtc "DTC table declaration for the diagnosis instance XX" MAP 0xa08049e8 _REC_MAP_20_u2_u2_u2 65535. _CNV_A_R_LINEAR_____0_CM 0. 65535. DISPLAY_IDENTIFIER ID_ERR_DTC_TH FORMAT "%5.0"
 /begin AXIS_DESCR COM_AXIS errm_online_dummy _CNV_S_2_ERRM_DTC_R_477_CM 1 0. 1. AXIS_PTS_REF ldp_nr_1_id_err_dtc /end AXIS_DESCR
 /begin AXIS_DESCR COM_AXIS errm_online_dummy _CNV_S_6_ERRM_DTC_R_478_CM 6 0. 5. AXIS_PTS_REF ldp_nr_2_id_err_dtc /end AXIS_DESCR
/end CHARACTERISTIC
/begin CHARACTERISTIC fmy_id_th.c_err_clas "Failure class number for failure XX" VALUE 0xa08049f8 _REC_VAL_20_u1 255. _CNV_A_R_LINEAR_____0_CM 0. 255. DISPLAY_IDENTIFIER C_ERR_CLAS_TH FORMAT "%3.0" /end CHARACTERISTIC
/begin CHARACTERISTIC fmy_id_ftl_min.dtc "DTC table declaration for the diagnosis instance XX" MAP 0xa08037dc _REC_MAP_20_u2_u2_u2 65535. _CNV_A_R_LINEAR_____0_CM 0. 65535. DISPLAY_IDENTIFIER ID_ERR_DTC_FTL_MIN FORMAT "%5.0"
 /begin AXIS_DESCR COM_AXIS errm_online_dummy _CNV_S_2_ERRM_DTC_R_477_CM 1 0. 1. AXIS_PTS_REF ldp_nr_1_id_err_dtc /end AXIS_DESCR
 /begin AXIS_DESCR COM_AXIS errm_online_dummy _CNV_S_6_ERRM_DTC_R_478_CM 6 0. 5. AXIS_PTS_REF ldp_nr_2_id_err_dtc /end AXIS_DESCR
/end CHARACTERISTIC
/begin CHARACTERISTIC fmy_id_ftl_min.c_err_clas "Failure class number for failure XX" VALUE 0xa08037ec _REC_VAL_20_u1 255. _CNV_A_R_LINEAR_____0_CM 0. 255. DISPLAY_IDENTIFIER C_ERR_CLAS_FTL_MIN FORMAT "%3.0" /end CHARACTERISTIC
/begin CHARACTERISTIC fmy_id_tia_el_1.dtc "DTC table declaration for the diagnosis instance XX" MAP 0xa08049fc _REC_MAP_20_u2_u2_u2 65535. _CNV_A_R_LINEAR_____0_CM 0. 65535. DISPLAY_IDENTIFIER ID_ERR_DTC_TIA_EL_1 FORMAT "%5.0"
 /begin AXIS_DESCR COM_AXIS errm_online_dummy _CNV_S_2_ERRM_DTC_R_477_CM 1 0. 1. AXIS_PTS_REF ldp_nr_1_id_err_dtc /end AXIS_DESCR
 /begin AXIS_DESCR COM_AXIS errm_online_dummy _CNV_S_6_ERRM_DTC_R_478_CM 6 0. 5. AXIS_PTS_REF ldp_nr_2_id_err_dtc /end AXIS_DESCR
/end CHARACTERISTIC
/begin CHARACTERISTIC fmy_id_tia_el_1.c_err_clas "Failure class number for failure XX" VALUE 0xa0804a0c _REC_VAL_20_u1 255. _CNV_A_R_LINEAR_____0_CM 0. 255. DISPLAY_IDENTIFIER C_ERR_CLAS_TIA_EL_1 FORMAT "%3.0" /end CHARACTERISTIC
/begin CHARACTERISTIC fmy_id_tia_el_2.dtc "DTC table declaration for the diagnosis instance XX" MAP 0xa0804a10 _REC_MAP_20_u2_u2_u2 65535. _CNV_A_R_LINEAR_____0_CM 0. 65535. DISPLAY_IDENTIFIER ID_ERR_DTC_TIA_EL_2 FORMAT "%5.0"
 /begin AXIS_DESCR COM_AXIS errm_online_dummy _CNV_S_2_ERRM_DTC_R_477_CM 1 0. 1. AXIS_PTS_REF ldp_nr_1_id_err_dtc /end AXIS_DESCR
 /begin AXIS_DESCR COM_AXIS errm_online_dummy _CNV_S_6_ERRM_DTC_R_478_CM 6 0. 5. AXIS_PTS_REF ldp_nr_2_id_err_dtc /end AXIS_DESCR
/end CHARACTERISTIC
/begin CHARACTERISTIC fmy_id_tia_el_2.c_err_clas "Failure class number for failure XX" VALUE 0xa0804a20 _REC_VAL_20_u1 255. _CNV_A_R_LINEAR_____0_CM 0. 255. DISPLAY_IDENTIFIER C_ERR_CLAS_TIA_EL_2 FORMAT "%3.0" /end CHARACTERISTIC
/begin CHARACTERISTIC fmy_id_tia_thr_el_1.dtc "DTC table declaration for the diagnosis instance XX" MAP 0xa0804a38 _REC_MAP_20_u2_u2_u2 65535. _CNV_A_R_LINEAR_____0_CM 0. 65535. DISPLAY_IDENTIFIER ID_ERR_DTC_TIA_THR_EL_1 FORMAT "%5.0"
 /begin AXIS_DESCR COM_AXIS errm_online_dummy _CNV_S_2_ERRM_DTC_R_477_CM 1 0. 1. AXIS_PTS_REF ldp_nr_1_id_err_dtc /end AXIS_DESCR
 /begin AXIS_DESCR COM_AXIS errm_online_dummy _CNV_S_6_ERRM_DTC_R_478_CM 6 0. 5. AXIS_PTS_REF ldp_nr_2_id_err_dtc /end AXIS_DESCR
/end CHARACTERISTIC
/begin CHARACTERISTIC fmy_id_tia_thr_el_1.c_err_clas "Failure class number for failure XX" VALUE 0xa0804a48 _REC_VAL_20_u1 255. _CNV_A_R_LINEAR_____0_CM 0. 255. DISPLAY_IDENTIFIER C_ERR_CLAS_TIA_THR_EL_1 FORMAT "%3.0" /end CHARACTERISTIC
/begin CHARACTERISTIC fmy_id_tia_thr_el_2.dtc "DTC table declaration for the diagnosis instance XX" MAP 0xa0804a4c _REC_MAP_20_u2_u2_u2 65535. _CNV_A_R_LINEAR_____0_CM 0. 65535. DISPLAY_IDENTIFIER ID_ERR_DTC_TIA_THR_EL_2 FORMAT "%5.0"
 /begin AXIS_DESCR COM_AXIS errm_online_dummy _CNV_S_2_ERRM_DTC_R_477_CM 1 0. 1. AXIS_PTS_REF ldp_nr_1_id_err_dtc /end AXIS_DESCR
 /begin AXIS_DESCR COM_AXIS errm_online_dummy _CNV_S_6_ERRM_DTC_R_478_CM 6 0. 5. AXIS_PTS_REF ldp_nr_2_id_err_dtc /end AXIS_DESCR
/end CHARACTERISTIC
/begin CHARACTERISTIC fmy_id_tia_thr_el_2.c_err_clas "Failure class number for failure XX" VALUE 0xa0804a5c _REC_VAL_20_u1 255. _CNV_A_R_LINEAR_____0_CM 0. 255. DISPLAY_IDENTIFIER C_ERR_CLAS_TIA_THR_EL_2 FORMAT "%3.0" /end CHARACTERISTIC
/begin CHARACTERISTIC fmy_id_amp.dtc "DTC table declaration for the diagnosis instance XX" MAP 0xa0802a08 _REC_MAP_20_u2_u2_u2 65535. _CNV_A_R_LINEAR_____0_CM 0. 65535. DISPLAY_IDENTIFIER ID_ERR_DTC_AMP FORMAT "%5.0"
 /begin AXIS_DESCR COM_AXIS errm_online_dummy _CNV_S_2_ERRM_DTC_R_477_CM 1 0. 1. AXIS_PTS_REF ldp_nr_1_id_err_dtc /end AXIS_DESCR
 /begin AXIS_DESCR COM_AXIS errm_online_dummy _CNV_S_6_ERRM_DTC_R_478_CM 6 0. 5. AXIS_PTS_REF ldp_nr_2_id_err_dtc /end AXIS_DESCR
/end CHARACTERISTIC
/begin CHARACTERISTIC fmy_id_amp.c_err_clas "Failure class number for failure XX" VALUE 0xa0802a18 _REC_VAL_20_u1 255. _CNV_A_R_LINEAR_____0_CM 0. 255. DISPLAY_IDENTIFIER C_ERR_CLAS_AMP FORMAT "%3.0" /end CHARACTERISTIC
/begin CHARACTERISTIC fmy_id_amp_plaus.dtc "DTC table declaration for the diagnosis instance XX" MAP 0xa0802a1c _REC_MAP_20_u2_u2_u2 65535. _CNV_A_R_LINEAR_____0_CM 0. 65535. DISPLAY_IDENTIFIER ID_ERR_DTC_AMP_PLAUS FORMAT "%5.0"
 /begin AXIS_DESCR COM_AXIS errm_online_dummy _CNV_S_2_ERRM_DTC_R_477_CM 1 0. 1. AXIS_PTS_REF ldp_nr_1_id_err_dtc /end AXIS_DESCR
 /begin AXIS_DESCR COM_AXIS errm_online_dummy _CNV_S_6_ERRM_DTC_R_478_CM 6 0. 5. AXIS_PTS_REF ldp_nr_2_id_err_dtc /end AXIS_DESCR
/end CHARACTERISTIC
/begin CHARACTERISTIC fmy_id_amp_plaus.c_err_clas "Failure class number for failure XX" VALUE 0xa0802a2c _REC_VAL_20_u1 255. _CNV_A_R_LINEAR_____0_CM 0. 255. DISPLAY_IDENTIFIER C_ERR_CLAS_AMP_PLAUS FORMAT "%3.0" /end CHARACTERISTIC
/begin CHARACTERISTIC fmy_id_maf.dtc "DTC table declaration for the diagnosis instance XX" MAP 0xa0803e58 _REC_MAP_20_u2_u2_u2 65535. _CNV_A_R_LINEAR_____0_CM 0. 65535. DISPLAY_IDENTIFIER ID_ERR_DTC_MAF FORMAT "%5.0"
 /begin AXIS_DESCR COM_AXIS errm_online_dummy _CNV_S_2_ERRM_DTC_R_477_CM 1 0. 1. AXIS_PTS_REF ldp_nr_1_id_err_dtc /end AXIS_DESCR
 /begin AXIS_DESCR COM_AXIS errm_online_dummy _CNV_S_6_ERRM_DTC_R_478_CM 6 0. 5. AXIS_PTS_REF ldp_nr_2_id_err_dtc /end AXIS_DESCR
/end CHARACTERISTIC
/begin CHARACTERISTIC fmy_id_maf.c_err_clas "Failure class number for failure XX" VALUE 0xa0803e68 _REC_VAL_20_u1 255. _CNV_A_R_LINEAR_____0_CM 0. 255. DISPLAY_IDENTIFIER C_ERR_CLAS_MAF FORMAT "%3.0" /end CHARACTERISTIC
/begin CHARACTERISTIC fmy_id_el_cps.dtc "DTC table declaration for the diagnosis instance XX" MAP 0xa0803674 _REC_MAP_20_u2_u2_u2 65535. _CNV_A_R_LINEAR_____0_CM 0. 65535. DISPLAY_IDENTIFIER ID_ERR_DTC_EL_CPS FORMAT "%5.0"
 /begin AXIS_DESCR COM_AXIS errm_online_dummy _CNV_S_2_ERRM_DTC_R_477_CM 1 0. 1. AXIS_PTS_REF ldp_nr_1_id_err_dtc /end AXIS_DESCR
 /begin AXIS_DESCR COM_AXIS errm_online_dummy _CNV_S_6_ERRM_DTC_R_478_CM 6 0. 5. AXIS_PTS_REF ldp_nr_2_id_err_dtc /end AXIS_DESCR
/end CHARACTERISTIC
/begin CHARACTERISTIC fmy_id_el_cps.c_err_clas "Failure class number for failure XX" VALUE 0xa0803684 _REC_VAL_20_u1 255. _CNV_A_R_LINEAR_____0_CM 0. 255. DISPLAY_IDENTIFIER C_ERR_CLAS_EL_CPS FORMAT "%3.0" /end CHARACTERISTIC
/begin CHARACTERISTIC fmy_id_slv_ivvt_in_1.dtc "DTC table declaration for the diagnosis instance XX" MAP 0xa08046f0 _REC_MAP_20_u2_u2_u2 65535. _CNV_A_R_LINEAR_____0_CM 0. 65535. DISPLAY_IDENTIFIER ID_ERR_DTC_SLV_IVVT_IN_1 FORMAT "%5.0"
 /begin AXIS_DESCR COM_AXIS errm_online_dummy _CNV_S_2_ERRM_DTC_R_477_CM 1 0. 1. AXIS_PTS_REF ldp_nr_1_id_err_dtc /end AXIS_DESCR
 /begin AXIS_DESCR COM_AXIS errm_online_dummy _CNV_S_6_ERRM_DTC_R_478_CM 6 0. 5. AXIS_PTS_REF ldp_nr_2_id_err_dtc /end AXIS_DESCR
/end CHARACTERISTIC
/begin CHARACTERISTIC fmy_id_slv_ivvt_in_1.c_err_clas "Failure class number for failure XX" VALUE 0xa0804700 _REC_VAL_20_u1 255. _CNV_A_R_LINEAR_____0_CM 0. 255. DISPLAY_IDENTIFIER C_ERR_CLAS_SLV_IVVT_IN_1 FORMAT "%3.0" /end CHARACTERISTIC
/begin CHARACTERISTIC fmy_id_slv_ivvt_in_2.dtc "DTC table declaration for the diagnosis instance XX" MAP 0xa0804704 _REC_MAP_20_u2_u2_u2 65535. _CNV_A_R_LINEAR_____0_CM 0. 65535. DISPLAY_IDENTIFIER ID_ERR_DTC_SLV_IVVT_IN_2 FORMAT "%5.0"
 /begin AXIS_DESCR COM_AXIS errm_online_dummy _CNV_S_2_ERRM_DTC_R_477_CM 1 0. 1. AXIS_PTS_REF ldp_nr_1_id_err_dtc /end AXIS_DESCR
 /begin AXIS_DESCR COM_AXIS errm_online_dummy _CNV_S_6_ERRM_DTC_R_478_CM 6 0. 5. AXIS_PTS_REF ldp_nr_2_id_err_dtc /end AXIS_DESCR
/end CHARACTERISTIC
/begin CHARACTERISTIC fmy_id_slv_ivvt_in_2.c_err_clas "Failure class number for failure XX" VALUE 0xa0804714 _REC_VAL_20_u1 255. _CNV_A_R_LINEAR_____0_CM 0. 255. DISPLAY_IDENTIFIER C_ERR_CLAS_SLV_IVVT_IN_2 FORMAT "%3.0" /end CHARACTERISTIC
/begin CHARACTERISTIC fmy_id_slv_ivvt_ex_1.dtc "DTC table declaration for the diagnosis instance XX" MAP 0xa08046b4 _REC_MAP_20_u2_u2_u2 65535. _CNV_A_R_LINEAR_____0_CM 0. 65535. DISPLAY_IDENTIFIER ID_ERR_DTC_SLV_IVVT_EX_1 FORMAT "%5.0"
 /begin AXIS_DESCR COM_AXIS errm_online_dummy _CNV_S_2_ERRM_DTC_R_477_CM 1 0. 1. AXIS_PTS_REF ldp_nr_1_id_err_dtc /end AXIS_DESCR
 /begin AXIS_DESCR COM_AXIS errm_online_dummy _CNV_S_6_ERRM_DTC_R_478_CM 6 0. 5. AXIS_PTS_REF ldp_nr_2_id_err_dtc /end AXIS_DESCR
/end CHARACTERISTIC
/begin CHARACTERISTIC fmy_id_slv_ivvt_ex_1.c_err_clas "Failure class number for failure XX" VALUE 0xa08046c4 _REC_VAL_20_u1 255. _CNV_A_R_LINEAR_____0_CM 0. 255. DISPLAY_IDENTIFIER C_ERR_CLAS_SLV_IVVT_EX_1 FORMAT "%3.0" /end CHARACTERISTIC
/begin CHARACTERISTIC fmy_id_slv_ivvt_ex_2.dtc "DTC table declaration for the diagnosis instance XX" MAP 0xa08046c8 _REC_MAP_20_u2_u2_u2 65535. _CNV_A_R_LINEAR_____0_CM 0. 65535. DISPLAY_IDENTIFIER ID_ERR_DTC_SLV_IVVT_EX_2 FORMAT "%5.0"
 /begin AXIS_DESCR COM_AXIS errm_online_dummy _CNV_S_2_ERRM_DTC_R_477_CM 1 0. 1. AXIS_PTS_REF ldp_nr_1_id_err_dtc /end AXIS_DESCR
 /begin AXIS_DESCR COM_AXIS errm_online_dummy _CNV_S_6_ERRM_DTC_R_478_CM 6 0. 5. AXIS_PTS_REF ldp_nr_2_id_err_dtc /end AXIS_DESCR
/end CHARACTERISTIC
/begin CHARACTERISTIC fmy_id_slv_ivvt_ex_2.c_err_clas "Failure class number for failure XX" VALUE 0xa08046d8 _REC_VAL_20_u1 255. _CNV_A_R_LINEAR_____0_CM 0. 255. DISPLAY_IDENTIFIER C_ERR_CLAS_SLV_IVVT_EX_2 FORMAT "%3.0" /end CHARACTERISTIC
/begin CHARACTERISTIC fmy_id_ecu_cks.dtc "DTC table declaration for the diagnosis instance XX" MAP 0xa08035fc _REC_MAP_20_u2_u2_u2 65535. _CNV_A_R_LINEAR_____0_CM 0. 65535. DISPLAY_IDENTIFIER ID_ERR_DTC_ECU_CKS FORMAT "%5.0"
 /begin AXIS_DESCR COM_AXIS errm_online_dummy _CNV_S_2_ERRM_DTC_R_477_CM 1 0. 1. AXIS_PTS_REF ldp_nr_1_id_err_dtc /end AXIS_DESCR
 /begin AXIS_DESCR COM_AXIS errm_online_dummy _CNV_S_6_ERRM_DTC_R_478_CM 6 0. 5. AXIS_PTS_REF ldp_nr_2_id_err_dtc /end AXIS_DESCR
/end CHARACTERISTIC
/begin CHARACTERISTIC fmy_id_ecu_cks.c_err_clas "Failure class number for failure XX" VALUE 0xa080360c _REC_VAL_20_u1 255. _CNV_A_R_LINEAR_____0_CM 0. 255. DISPLAY_IDENTIFIER C_ERR_CLAS_ECU_CKS FORMAT "%3.0" /end CHARACTERISTIC
/begin CHARACTERISTIC fmy_id_vs.dtc "DTC table declaration for the diagnosis instance XX" MAP 0xa0804da8 _REC_MAP_20_u2_u2_u2 65535. _CNV_A_R_LINEAR_____0_CM 0. 65535. DISPLAY_IDENTIFIER ID_ERR_DTC_VS FORMAT "%5.0"
 /begin AXIS_DESCR COM_AXIS errm_online_dummy _CNV_S_2_ERRM_DTC_R_477_CM 1 0. 1. AXIS_PTS_REF ldp_nr_1_id_err_dtc /end AXIS_DESCR
 /begin AXIS_DESCR COM_AXIS errm_online_dummy _CNV_S_6_ERRM_DTC_R_478_CM 6 0. 5. AXIS_PTS_REF ldp_nr_2_id_err_dtc /end AXIS_DESCR
/end CHARACTERISTIC
/begin CHARACTERISTIC fmy_id_vs.c_err_clas "Failure class number for failure XX" VALUE 0xa0804db8 _REC_VAL_20_u1 255. _CNV_A_R_LINEAR_____0_CM 0. 255. DISPLAY_IDENTIFIER C_ERR_CLAS_VS FORMAT "%3.0" /end CHARACTERISTIC
/begin CHARACTERISTIC fmy_id_knks_1.dtc "DTC table declaration for the diagnosis instance XX" MAP 0xa0803d18 _REC_MAP_20_u2_u2_u2 65535. _CNV_A_R_LINEAR_____0_CM 0. 65535. DISPLAY_IDENTIFIER ID_ERR_DTC_KNKS_1 FORMAT "%5.0"
 /begin AXIS_DESCR COM_AXIS errm_online_dummy _CNV_S_2_ERRM_DTC_R_477_CM 1 0. 1. AXIS_PTS_REF ldp_nr_1_id_err_dtc /end AXIS_DESCR
 /begin AXIS_DESCR COM_AXIS errm_online_dummy _CNV_S_6_ERRM_DTC_R_478_CM 6 0. 5. AXIS_PTS_REF ldp_nr_2_id_err_dtc /end AXIS_DESCR
/end CHARACTERISTIC
/begin CHARACTERISTIC fmy_id_knks_1.c_err_clas "Failure class number for failure XX" VALUE 0xa0803d28 _REC_VAL_20_u1 255. _CNV_A_R_LINEAR_____0_CM 0. 255. DISPLAY_IDENTIFIER C_ERR_CLAS_KNKS_1 FORMAT "%3.0" /end CHARACTERISTIC
/begin CHARACTERISTIC fmy_id_knks_2.dtc "DTC table declaration for the diagnosis instance XX" MAP 0xa0803d2c _REC_MAP_20_u2_u2_u2 65535. _CNV_A_R_LINEAR_____0_CM 0. 65535. DISPLAY_IDENTIFIER ID_ERR_DTC_KNKS_2 FORMAT "%5.0"
 /begin AXIS_DESCR COM_AXIS errm_online_dummy _CNV_S_2_ERRM_DTC_R_477_CM 1 0. 1. AXIS_PTS_REF ldp_nr_1_id_err_dtc /end AXIS_DESCR
 /begin AXIS_DESCR COM_AXIS errm_online_dummy _CNV_S_6_ERRM_DTC_R_478_CM 6 0. 5. AXIS_PTS_REF ldp_nr_2_id_err_dtc /end AXIS_DESCR
/end CHARACTERISTIC
/begin CHARACTERISTIC fmy_id_knks_2.c_err_clas "Failure class number for failure XX" VALUE 0xa0803d3c _REC_VAL_20_u1 255. _CNV_A_R_LINEAR_____0_CM 0. 255. DISPLAY_IDENTIFIER C_ERR_CLAS_KNKS_2 FORMAT "%3.0" /end CHARACTERISTIC
/begin CHARACTERISTIC fmy_id_knks_3.dtc "DTC table declaration for the diagnosis instance XX" MAP 0xa0803d40 _REC_MAP_20_u2_u2_u2 65535. _CNV_A_R_LINEAR_____0_CM 0. 65535. DISPLAY_IDENTIFIER ID_ERR_DTC_KNKS_3 FORMAT "%5.0"
 /begin AXIS_DESCR COM_AXIS errm_online_dummy _CNV_S_2_ERRM_DTC_R_477_CM 1 0. 1. AXIS_PTS_REF ldp_nr_1_id_err_dtc /end AXIS_DESCR
 /begin AXIS_DESCR COM_AXIS errm_online_dummy _CNV_S_6_ERRM_DTC_R_478_CM 6 0. 5. AXIS_PTS_REF ldp_nr_2_id_err_dtc /end AXIS_DESCR
/end CHARACTERISTIC
/begin CHARACTERISTIC fmy_id_knks_3.c_err_clas "Failure class number for failure XX" VALUE 0xa0803d50 _REC_VAL_20_u1 255. _CNV_A_R_LINEAR_____0_CM 0. 255. DISPLAY_IDENTIFIER C_ERR_CLAS_KNKS_3 FORMAT "%3.0" /end CHARACTERISTIC
/begin CHARACTERISTIC fmy_id_knks_4.dtc "DTC table declaration for the diagnosis instance XX" MAP 0xa0803d54 _REC_MAP_20_u2_u2_u2 65535. _CNV_A_R_LINEAR_____0_CM 0. 65535. DISPLAY_IDENTIFIER ID_ERR_DTC_KNKS_4 FORMAT "%5.0"
 /begin AXIS_DESCR COM_AXIS errm_online_dummy _CNV_S_2_ERRM_DTC_R_477_CM 1 0. 1. AXIS_PTS_REF ldp_nr_1_id_err_dtc /end AXIS_DESCR
 /begin AXIS_DESCR COM_AXIS errm_online_dummy _CNV_S_6_ERRM_DTC_R_478_CM 6 0. 5. AXIS_PTS_REF ldp_nr_2_id_err_dtc /end AXIS_DESCR
/end CHARACTERISTIC
/begin CHARACTERISTIC fmy_id_knks_4.c_err_clas "Failure class number for failure XX" VALUE 0xa0803d64 _REC_VAL_20_u1 255. _CNV_A_R_LINEAR_____0_CM 0. 255. DISPLAY_IDENTIFIER C_ERR_CLAS_KNKS_4 FORMAT "%3.0" /end CHARACTERISTIC
/begin CHARACTERISTIC fmy_id_rfp_dr_1.dtc "DTC table declaration for the diagnosis instance XX" MAP 0xa08044fc _REC_MAP_20_u2_u2_u2 65535. _CNV_A_R_LINEAR_____0_CM 0. 65535. DISPLAY_IDENTIFIER ID_ERR_DTC_RFP_DR_1 FORMAT "%5.0"
 /begin AXIS_DESCR COM_AXIS errm_online_dummy _CNV_S_2_ERRM_DTC_R_477_CM 1 0. 1. AXIS_PTS_REF ldp_nr_1_id_err_dtc /end AXIS_DESCR
 /begin AXIS_DESCR COM_AXIS errm_online_dummy _CNV_S_6_ERRM_DTC_R_478_CM 6 0. 5. AXIS_PTS_REF ldp_nr_2_id_err_dtc /end AXIS_DESCR
/end CHARACTERISTIC
/begin CHARACTERISTIC fmy_id_rfp_dr_1.c_err_clas "Failure class number for failure XX" VALUE 0xa080450c _REC_VAL_20_u1 255. _CNV_A_R_LINEAR_____0_CM 0. 255. DISPLAY_IDENTIFIER C_ERR_CLAS_RFP_DR_1 FORMAT "%3.0" /end CHARACTERISTIC
/begin CHARACTERISTIC fmy_id_rfp_dr_2.dtc "DTC table declaration for the diagnosis instance XX" MAP 0xa0804510 _REC_MAP_20_u2_u2_u2 65535. _CNV_A_R_LINEAR_____0_CM 0. 65535. DISPLAY_IDENTIFIER ID_ERR_DTC_RFP_DR_2 FORMAT "%5.0"
 /begin AXIS_DESCR COM_AXIS errm_online_dummy _CNV_S_2_ERRM_DTC_R_477_CM 1 0. 1. AXIS_PTS_REF ldp_nr_1_id_err_dtc /end AXIS_DESCR
 /begin AXIS_DESCR COM_AXIS errm_online_dummy _CNV_S_6_ERRM_DTC_R_478_CM 6 0. 5. AXIS_PTS_REF ldp_nr_2_id_err_dtc /end AXIS_DESCR
/end CHARACTERISTIC
/begin CHARACTERISTIC fmy_id_rfp_dr_2.c_err_clas "Failure class number for failure XX" VALUE 0xa0804520 _REC_VAL_20_u1 255. _CNV_A_R_LINEAR_____0_CM 0. 255. DISPLAY_IDENTIFIER C_ERR_CLAS_RFP_DR_2 FORMAT "%3.0" /end CHARACTERISTIC
/begin CHARACTERISTIC fmy_id_wg_1_dr.dtc "DTC table declaration for the diagnosis instance XX" MAP 0xa0804df8 _REC_MAP_20_u2_u2_u2 65535. _CNV_A_R_LINEAR_____0_CM 0. 65535. DISPLAY_IDENTIFIER ID_ERR_DTC_WG_1_DR FORMAT "%5.0"
 /begin AXIS_DESCR COM_AXIS errm_online_dummy _CNV_S_2_ERRM_DTC_R_477_CM 1 0. 1. AXIS_PTS_REF ldp_nr_1_id_err_dtc /end AXIS_DESCR
 /begin AXIS_DESCR COM_AXIS errm_online_dummy _CNV_S_6_ERRM_DTC_R_478_CM 6 0. 5. AXIS_PTS_REF ldp_nr_2_id_err_dtc /end AXIS_DESCR
/end CHARACTERISTIC
/begin CHARACTERISTIC fmy_id_wg_1_dr.c_err_clas "Failure class number for failure XX" VALUE 0xa0804e08 _REC_VAL_20_u1 255. _CNV_A_R_LINEAR_____0_CM 0. 255. DISPLAY_IDENTIFIER C_ERR_CLAS_WG_1_DR FORMAT "%3.0" /end CHARACTERISTIC
/begin CHARACTERISTIC fmy_id_wg_2_dr.dtc "DTC table declaration for the diagnosis instance XX" MAP 0xa0804e0c _REC_MAP_20_u2_u2_u2 65535. _CNV_A_R_LINEAR_____0_CM 0. 65535. DISPLAY_IDENTIFIER ID_ERR_DTC_WG_2_DR FORMAT "%5.0"
 /begin AXIS_DESCR COM_AXIS errm_online_dummy _CNV_S_2_ERRM_DTC_R_477_CM 1 0. 1. AXIS_PTS_REF ldp_nr_1_id_err_dtc /end AXIS_DESCR
 /begin AXIS_DESCR COM_AXIS errm_online_dummy _CNV_S_6_ERRM_DTC_R_478_CM 6 0. 5. AXIS_PTS_REF ldp_nr_2_id_err_dtc /end AXIS_DESCR
/end CHARACTERISTIC
/begin CHARACTERISTIC fmy_id_wg_2_dr.c_err_clas "Failure class number for failure XX" VALUE 0xa0804e1c _REC_VAL_20_u1 255. _CNV_A_R_LINEAR_____0_CM 0. 255. DISPLAY_IDENTIFIER C_ERR_CLAS_WG_2_DR FORMAT "%3.0" /end CHARACTERISTIC
/begin CHARACTERISTIC fmy_id_put_el_1.dtc "DTC table declaration for the diagnosis instance XX" MAP 0xa08043d0 _REC_MAP_20_u2_u2_u2 65535. _CNV_A_R_LINEAR_____0_CM 0. 65535. DISPLAY_IDENTIFIER ID_ERR_DTC_PUT_EL_1 FORMAT "%5.0"
 /begin AXIS_DESCR COM_AXIS errm_online_dummy _CNV_S_2_ERRM_DTC_R_477_CM 1 0. 1. AXIS_PTS_REF ldp_nr_1_id_err_dtc /end AXIS_DESCR
 /begin AXIS_DESCR COM_AXIS errm_online_dummy _CNV_S_6_ERRM_DTC_R_478_CM 6 0. 5. AXIS_PTS_REF ldp_nr_2_id_err_dtc /end AXIS_DESCR
/end CHARACTERISTIC
/begin CHARACTERISTIC fmy_id_put_el_1.c_err_clas "Failure class number for failure XX" VALUE 0xa08043e0 _REC_VAL_20_u1 255. _CNV_A_R_LINEAR_____0_CM 0. 255. DISPLAY_IDENTIFIER C_ERR_CLAS_PUT_EL_1 FORMAT "%3.0" /end CHARACTERISTIC
/begin CHARACTERISTIC fmy_id_put_el_2.dtc "DTC table declaration for the diagnosis instance XX" MAP 0xa08043e4 _REC_MAP_20_u2_u2_u2 65535. _CNV_A_R_LINEAR_____0_CM 0. 65535. DISPLAY_IDENTIFIER ID_ERR_DTC_PUT_EL_2 FORMAT "%5.0"
 /begin AXIS_DESCR COM_AXIS errm_online_dummy _CNV_S_2_ERRM_DTC_R_477_CM 1 0. 1. AXIS_PTS_REF ldp_nr_1_id_err_dtc /end AXIS_DESCR
 /begin AXIS_DESCR COM_AXIS errm_online_dummy _CNV_S_6_ERRM_DTC_R_478_CM 6 0. 5. AXIS_PTS_REF ldp_nr_2_id_err_dtc /end AXIS_DESCR
/end CHARACTERISTIC
/begin CHARACTERISTIC fmy_id_put_el_2.c_err_clas "Failure class number for failure XX" VALUE 0xa08043f4 _REC_VAL_20_u1 255. _CNV_A_R_LINEAR_____0_CM 0. 255. DISPLAY_IDENTIFIER C_ERR_CLAS_PUT_EL_2 FORMAT "%3.0" /end CHARACTERISTIC
/begin CHARACTERISTIC fmy_id_igc_scp_0.dtc "DTC table declaration for the diagnosis instance XX" MAP 0xa0803a98 _REC_MAP_20_u2_u2_u2 65535. _CNV_A_R_LINEAR_____0_CM 0. 65535. DISPLAY_IDENTIFIER ID_ERR_DTC_IGC_SCP_0 FORMAT "%5.0"
 /begin AXIS_DESCR COM_AXIS errm_online_dummy _CNV_S_2_ERRM_DTC_R_477_CM 1 0. 1. AXIS_PTS_REF ldp_nr_1_id_err_dtc /end AXIS_DESCR
 /begin AXIS_DESCR COM_AXIS errm_online_dummy _CNV_S_6_ERRM_DTC_R_478_CM 6 0. 5. AXIS_PTS_REF ldp_nr_2_id_err_dtc /end AXIS_DESCR
/end CHARACTERISTIC
/begin CHARACTERISTIC fmy_id_igc_scp_0.c_err_clas "Failure class number for failure XX" VALUE 0xa0803aa8 _REC_VAL_20_u1 255. _CNV_A_R_LINEAR_____0_CM 0. 255. DISPLAY_IDENTIFIER C_ERR_CLAS_IGC_SCP_0 FORMAT "%3.0" /end CHARACTERISTIC
/begin CHARACTERISTIC fmy_id_igc_scp_1.dtc "DTC table declaration for the diagnosis instance XX" MAP 0xa0803aac _REC_MAP_20_u2_u2_u2 65535. _CNV_A_R_LINEAR_____0_CM 0. 65535. DISPLAY_IDENTIFIER ID_ERR_DTC_IGC_SCP_1 FORMAT "%5.0"
 /begin AXIS_DESCR COM_AXIS errm_online_dummy _CNV_S_2_ERRM_DTC_R_477_CM 1 0. 1. AXIS_PTS_REF ldp_nr_1_id_err_dtc /end AXIS_DESCR
 /begin AXIS_DESCR COM_AXIS errm_online_dummy _CNV_S_6_ERRM_DTC_R_478_CM 6 0. 5. AXIS_PTS_REF ldp_nr_2_id_err_dtc /end AXIS_DESCR
/end CHARACTERISTIC
/begin CHARACTERISTIC fmy_id_igc_scp_1.c_err_clas "Failure class number for failure XX" VALUE 0xa0803abc _REC_VAL_20_u1 255. _CNV_A_R_LINEAR_____0_CM 0. 255. DISPLAY_IDENTIFIER C_ERR_CLAS_IGC_SCP_1 FORMAT "%3.0" /end CHARACTERISTIC
/begin CHARACTERISTIC fmy_id_igc_scp_2.dtc "DTC table declaration for the diagnosis instance XX" MAP 0xa0803ac0 _REC_MAP_20_u2_u2_u2 65535. _CNV_A_R_LINEAR_____0_CM 0. 65535. DISPLAY_IDENTIFIER ID_ERR_DTC_IGC_SCP_2 FORMAT "%5.0"
 /begin AXIS_DESCR COM_AXIS errm_online_dummy _CNV_S_2_ERRM_DTC_R_477_CM 1 0. 1. AXIS_PTS_REF ldp_nr_1_id_err_dtc /end AXIS_DESCR
 /begin AXIS_DESCR COM_AXIS errm_online_dummy _CNV_S_6_ERRM_DTC_R_478_CM 6 0. 5. AXIS_PTS_REF ldp_nr_2_id_err_dtc /end AXIS_DESCR
/end CHARACTERISTIC
/begin CHARACTERISTIC fmy_id_igc_scp_2.c_err_clas "Failure class number for failure XX" VALUE 0xa0803ad0 _REC_VAL_20_u1 255. _CNV_A_R_LINEAR_____0_CM 0. 255. DISPLAY_IDENTIFIER C_ERR_CLAS_IGC_SCP_2 FORMAT "%3.0" /end CHARACTERISTIC
/begin CHARACTERISTIC fmy_id_igc_scp_3.dtc "DTC table declaration for the diagnosis instance XX" MAP 0xa0803ad4 _REC_MAP_20_u2_u2_u2 65535. _CNV_A_R_LINEAR_____0_CM 0. 65535. DISPLAY_IDENTIFIER ID_ERR_DTC_IGC_SCP_3 FORMAT "%5.0"
 /begin AXIS_DESCR COM_AXIS errm_online_dummy _CNV_S_2_ERRM_DTC_R_477_CM 1 0. 1. AXIS_PTS_REF ldp_nr_1_id_err_dtc /end AXIS_DESCR
 /begin AXIS_DESCR COM_AXIS errm_online_dummy _CNV_S_6_ERRM_DTC_R_478_CM 6 0. 5. AXIS_PTS_REF ldp_nr_2_id_err_dtc /end AXIS_DESCR
/end CHARACTERISTIC
/begin CHARACTERISTIC fmy_id_igc_scp_3.c_err_clas "Failure class number for failure XX" VALUE 0xa0803ae4 _REC_VAL_20_u1 255. _CNV_A_R_LINEAR_____0_CM 0. 255. DISPLAY_IDENTIFIER C_ERR_CLAS_IGC_SCP_3 FORMAT "%3.0" /end CHARACTERISTIC
/begin CHARACTERISTIC fmy_id_igc_scp_4.dtc "DTC table declaration for the diagnosis instance XX" MAP 0xa0803ae8 _REC_MAP_20_u2_u2_u2 65535. _CNV_A_R_LINEAR_____0_CM 0. 65535. DISPLAY_IDENTIFIER ID_ERR_DTC_IGC_SCP_4 FORMAT "%5.0"
 /begin AXIS_DESCR COM_AXIS errm_online_dummy _CNV_S_2_ERRM_DTC_R_477_CM 1 0. 1. AXIS_PTS_REF ldp_nr_1_id_err_dtc /end AXIS_DESCR
 /begin AXIS_DESCR COM_AXIS errm_online_dummy _CNV_S_6_ERRM_DTC_R_478_CM 6 0. 5. AXIS_PTS_REF ldp_nr_2_id_err_dtc /end AXIS_DESCR
/end CHARACTERISTIC
/begin CHARACTERISTIC fmy_id_igc_scp_4.c_err_clas "Failure class number for failure XX" VALUE 0xa0803af8 _REC_VAL_20_u1 255. _CNV_A_R_LINEAR_____0_CM 0. 255. DISPLAY_IDENTIFIER C_ERR_CLAS_IGC_SCP_4 FORMAT "%3.0" /end CHARACTERISTIC
/begin CHARACTERISTIC fmy_id_igc_scp_5.dtc "DTC table declaration for the diagnosis instance XX" MAP 0xa0803afc _REC_MAP_20_u2_u2_u2 65535. _CNV_A_R_LINEAR_____0_CM 0. 65535. DISPLAY_IDENTIFIER ID_ERR_DTC_IGC_SCP_5 FORMAT "%5.0"
 /begin AXIS_DESCR COM_AXIS errm_online_dummy _CNV_S_2_ERRM_DTC_R_477_CM 1 0. 1. AXIS_PTS_REF ldp_nr_1_id_err_dtc /end AXIS_DESCR
 /begin AXIS_DESCR COM_AXIS errm_online_dummy _CNV_S_6_ERRM_DTC_R_478_CM 6 0. 5. AXIS_PTS_REF ldp_nr_2_id_err_dtc /end AXIS_DESCR
/end CHARACTERISTIC
/begin CHARACTERISTIC fmy_id_igc_scp_5.c_err_clas "Failure class number for failure XX" VALUE 0xa0803b0c _REC_VAL_20_u1 255. _CNV_A_R_LINEAR_____0_CM 0. 255. DISPLAY_IDENTIFIER C_ERR_CLAS_IGC_SCP_5 FORMAT "%3.0" /end CHARACTERISTIC
/begin CHARACTERISTIC fmy_id_igc_scp_6.dtc "DTC table declaration for the diagnosis instance XX" MAP 0xa0803b10 _REC_MAP_20_u2_u2_u2 65535. _CNV_A_R_LINEAR_____0_CM 0. 65535. DISPLAY_IDENTIFIER ID_ERR_DTC_IGC_SCP_6 FORMAT "%5.0"
 /begin AXIS_DESCR COM_AXIS errm_online_dummy _CNV_S_2_ERRM_DTC_R_477_CM 1 0. 1. AXIS_PTS_REF ldp_nr_1_id_err_dtc /end AXIS_DESCR
 /begin AXIS_DESCR COM_AXIS errm_online_dummy _CNV_S_6_ERRM_DTC_R_478_CM 6 0. 5. AXIS_PTS_REF ldp_nr_2_id_err_dtc /end AXIS_DESCR
/end CHARACTERISTIC
/begin CHARACTERISTIC fmy_id_igc_scp_6.c_err_clas "Failure class number for failure XX" VALUE 0xa0803b20 _REC_VAL_20_u1 255. _CNV_A_R_LINEAR_____0_CM 0. 255. DISPLAY_IDENTIFIER C_ERR_CLAS_IGC_SCP_6 FORMAT "%3.0" /end CHARACTERISTIC
/begin CHARACTERISTIC fmy_id_igc_scp_7.dtc "DTC table declaration for the diagnosis instance XX" MAP 0xa0803b24 _REC_MAP_20_u2_u2_u2 65535. _CNV_A_R_LINEAR_____0_CM 0. 65535. DISPLAY_IDENTIFIER ID_ERR_DTC_IGC_SCP_7 FORMAT "%5.0"
 /begin AXIS_DESCR COM_AXIS errm_online_dummy _CNV_S_2_ERRM_DTC_R_477_CM 1 0. 1. AXIS_PTS_REF ldp_nr_1_id_err_dtc /end AXIS_DESCR
 /begin AXIS_DESCR COM_AXIS errm_online_dummy _CNV_S_6_ERRM_DTC_R_478_CM 6 0. 5. AXIS_PTS_REF ldp_nr_2_id_err_dtc /end AXIS_DESCR
/end CHARACTERISTIC
/begin CHARACTERISTIC fmy_id_igc_scp_7.c_err_clas "Failure class number for failure XX" VALUE 0xa0803b34 _REC_VAL_20_u1 255. _CNV_A_R_LINEAR_____0_CM 0. 255. DISPLAY_IDENTIFIER C_ERR_CLAS_IGC_SCP_7 FORMAT "%3.0" /end CHARACTERISTIC
/begin CHARACTERISTIC fmy_id_igc_scg_0.dtc "DTC table declaration for the diagnosis instance XX" MAP 0xa08039f8 _REC_MAP_20_u2_u2_u2 65535. _CNV_A_R_LINEAR_____0_CM 0. 65535. DISPLAY_IDENTIFIER ID_ERR_DTC_IGC_SCG_0 FORMAT "%5.0"
 /begin AXIS_DESCR COM_AXIS errm_online_dummy _CNV_S_2_ERRM_DTC_R_477_CM 1 0. 1. AXIS_PTS_REF ldp_nr_1_id_err_dtc /end AXIS_DESCR
 /begin AXIS_DESCR COM_AXIS errm_online_dummy _CNV_S_6_ERRM_DTC_R_478_CM 6 0. 5. AXIS_PTS_REF ldp_nr_2_id_err_dtc /end AXIS_DESCR
/end CHARACTERISTIC
/begin CHARACTERISTIC fmy_id_igc_scg_0.c_err_clas "Failure class number for failure XX" VALUE 0xa0803a08 _REC_VAL_20_u1 255. _CNV_A_R_LINEAR_____0_CM 0. 255. DISPLAY_IDENTIFIER C_ERR_CLAS_IGC_SCG_0 FORMAT "%3.0" /end CHARACTERISTIC
/begin CHARACTERISTIC fmy_id_igc_scg_1.dtc "DTC table declaration for the diagnosis instance XX" MAP 0xa0803a0c _REC_MAP_20_u2_u2_u2 65535. _CNV_A_R_LINEAR_____0_CM 0. 65535. DISPLAY_IDENTIFIER ID_ERR_DTC_IGC_SCG_1 FORMAT "%5.0"
 /begin AXIS_DESCR COM_AXIS errm_online_dummy _CNV_S_2_ERRM_DTC_R_477_CM 1 0. 1. AXIS_PTS_REF ldp_nr_1_id_err_dtc /end AXIS_DESCR
 /begin AXIS_DESCR COM_AXIS errm_online_dummy _CNV_S_6_ERRM_DTC_R_478_CM 6 0. 5. AXIS_PTS_REF ldp_nr_2_id_err_dtc /end AXIS_DESCR
/end CHARACTERISTIC
/begin CHARACTERISTIC fmy_id_igc_scg_1.c_err_clas "Failure class number for failure XX" VALUE 0xa0803a1c _REC_VAL_20_u1 255. _CNV_A_R_LINEAR_____0_CM 0. 255. DISPLAY_IDENTIFIER C_ERR_CLAS_IGC_SCG_1 FORMAT "%3.0" /end CHARACTERISTIC
/begin CHARACTERISTIC fmy_id_igc_scg_2.dtc "DTC table declaration for the diagnosis instance XX" MAP 0xa0803a20 _REC_MAP_20_u2_u2_u2 65535. _CNV_A_R_LINEAR_____0_CM 0. 65535. DISPLAY_IDENTIFIER ID_ERR_DTC_IGC_SCG_2 FORMAT "%5.0"
 /begin AXIS_DESCR COM_AXIS errm_online_dummy _CNV_S_2_ERRM_DTC_R_477_CM 1 0. 1. AXIS_PTS_REF ldp_nr_1_id_err_dtc /end AXIS_DESCR
 /begin AXIS_DESCR COM_AXIS errm_online_dummy _CNV_S_6_ERRM_DTC_R_478_CM 6 0. 5. AXIS_PTS_REF ldp_nr_2_id_err_dtc /end AXIS_DESCR
/end CHARACTERISTIC
/begin CHARACTERISTIC fmy_id_igc_scg_2.c_err_clas "Failure class number for failure XX" VALUE 0xa0803a30 _REC_VAL_20_u1 255. _CNV_A_R_LINEAR_____0_CM 0. 255. DISPLAY_IDENTIFIER C_ERR_CLAS_IGC_SCG_2 FORMAT "%3.0" /end CHARACTERISTIC
/begin CHARACTERISTIC fmy_id_igc_scg_3.dtc "DTC table declaration for the diagnosis instance XX" MAP 0xa0803a34 _REC_MAP_20_u2_u2_u2 65535. _CNV_A_R_LINEAR_____0_CM 0. 65535. DISPLAY_IDENTIFIER ID_ERR_DTC_IGC_SCG_3 FORMAT "%5.0"
 /begin AXIS_DESCR COM_AXIS errm_online_dummy _CNV_S_2_ERRM_DTC_R_477_CM 1 0. 1. AXIS_PTS_REF ldp_nr_1_id_err_dtc /end AXIS_DESCR
 /begin AXIS_DESCR COM_AXIS errm_online_dummy _CNV_S_6_ERRM_DTC_R_478_CM 6 0. 5. AXIS_PTS_REF ldp_nr_2_id_err_dtc /end AXIS_DESCR
/end CHARACTERISTIC
/begin CHARACTERISTIC fmy_id_igc_scg_3.c_err_clas "Failure class number for failure XX" VALUE 0xa0803a44 _REC_VAL_20_u1 255. _CNV_A_R_LINEAR_____0_CM 0. 255. DISPLAY_IDENTIFIER C_ERR_CLAS_IGC_SCG_3 FORMAT "%3.0" /end CHARACTERISTIC
/begin CHARACTERISTIC fmy_id_igc_scg_4.dtc "DTC table declaration for the diagnosis instance XX" MAP 0xa0803a48 _REC_MAP_20_u2_u2_u2 65535. _CNV_A_R_LINEAR_____0_CM 0. 65535. DISPLAY_IDENTIFIER ID_ERR_DTC_IGC_SCG_4 FORMAT "%5.0"
 /begin AXIS_DESCR COM_AXIS errm_online_dummy _CNV_S_2_ERRM_DTC_R_477_CM 1 0. 1. AXIS_PTS_REF ldp_nr_1_id_err_dtc /end AXIS_DESCR
 /begin AXIS_DESCR COM_AXIS errm_online_dummy _CNV_S_6_ERRM_DTC_R_478_CM 6 0. 5. AXIS_PTS_REF ldp_nr_2_id_err_dtc /end AXIS_DESCR
/end CHARACTERISTIC
/begin CHARACTERISTIC fmy_id_igc_scg_4.c_err_clas "Failure class number for failure XX" VALUE 0xa0803a58 _REC_VAL_20_u1 255. _CNV_A_R_LINEAR_____0_CM 0. 255. DISPLAY_IDENTIFIER C_ERR_CLAS_IGC_SCG_4 FORMAT "%3.0" /end CHARACTERISTIC
/begin CHARACTERISTIC fmy_id_igc_scg_5.dtc "DTC table declaration for the diagnosis instance XX" MAP 0xa0803a5c _REC_MAP_20_u2_u2_u2 65535. _CNV_A_R_LINEAR_____0_CM 0. 65535. DISPLAY_IDENTIFIER ID_ERR_DTC_IGC_SCG_5 FORMAT "%5.0"
 /begin AXIS_DESCR COM_AXIS errm_online_dummy _CNV_S_2_ERRM_DTC_R_477_CM 1 0. 1. AXIS_PTS_REF ldp_nr_1_id_err_dtc /end AXIS_DESCR
 /begin AXIS_DESCR COM_AXIS errm_online_dummy _CNV_S_6_ERRM_DTC_R_478_CM 6 0. 5. AXIS_PTS_REF ldp_nr_2_id_err_dtc /end AXIS_DESCR
/end CHARACTERISTIC
/begin CHARACTERISTIC fmy_id_igc_scg_5.c_err_clas "Failure class number for failure XX" VALUE 0xa0803a6c _REC_VAL_20_u1 255. _CNV_A_R_LINEAR_____0_CM 0. 255. DISPLAY_IDENTIFIER C_ERR_CLAS_IGC_SCG_5 FORMAT "%3.0" /end CHARACTERISTIC
/begin CHARACTERISTIC fmy_id_igc_scg_6.dtc "DTC table declaration for the diagnosis instance XX" MAP 0xa0803a70 _REC_MAP_20_u2_u2_u2 65535. _CNV_A_R_LINEAR_____0_CM 0. 65535. DISPLAY_IDENTIFIER ID_ERR_DTC_IGC_SCG_6 FORMAT "%5.0"
 /begin AXIS_DESCR COM_AXIS errm_online_dummy _CNV_S_2_ERRM_DTC_R_477_CM 1 0. 1. AXIS_PTS_REF ldp_nr_1_id_err_dtc /end AXIS_DESCR
 /begin AXIS_DESCR COM_AXIS errm_online_dummy _CNV_S_6_ERRM_DTC_R_478_CM 6 0. 5. AXIS_PTS_REF ldp_nr_2_id_err_dtc /end AXIS_DESCR
/end CHARACTERISTIC
/begin CHARACTERISTIC fmy_id_igc_scg_6.c_err_clas "Failure class number for failure XX" VALUE 0xa0803a80 _REC_VAL_20_u1 255. _CNV_A_R_LINEAR_____0_CM 0. 255. DISPLAY_IDENTIFIER C_ERR_CLAS_IGC_SCG_6 FORMAT "%3.0" /end CHARACTERISTIC
/begin CHARACTERISTIC fmy_id_igc_scg_7.dtc "DTC table declaration for the diagnosis instance XX" MAP 0xa0803a84 _REC_MAP_20_u2_u2_u2 65535. _CNV_A_R_LINEAR_____0_CM 0. 65535. DISPLAY_IDENTIFIER ID_ERR_DTC_IGC_SCG_7 FORMAT "%5.0"
 /begin AXIS_DESCR COM_AXIS errm_online_dummy _CNV_S_2_ERRM_DTC_R_477_CM 1 0. 1. AXIS_PTS_REF ldp_nr_1_id_err_dtc /end AXIS_DESCR
 /begin AXIS_DESCR COM_AXIS errm_online_dummy _CNV_S_6_ERRM_DTC_R_478_CM 6 0. 5. AXIS_PTS_REF ldp_nr_2_id_err_dtc /end AXIS_DESCR
/end CHARACTERISTIC
/begin CHARACTERISTIC fmy_id_igc_scg_7.c_err_clas "Failure class number for failure XX" VALUE 0xa0803a94 _REC_VAL_20_u1 255. _CNV_A_R_LINEAR_____0_CM 0. 255. DISPLAY_IDENTIFIER C_ERR_CLAS_IGC_SCG_7 FORMAT "%3.0" /end CHARACTERISTIC
/begin CHARACTERISTIC fmy_id_igc_ol_0.dtc "DTC table declaration for the diagnosis instance XX" MAP 0xa0803958 _REC_MAP_20_u2_u2_u2 65535. _CNV_A_R_LINEAR_____0_CM 0. 65535. DISPLAY_IDENTIFIER ID_ERR_DTC_IGC_OL_0 FORMAT "%5.0"
 /begin AXIS_DESCR COM_AXIS errm_online_dummy _CNV_S_2_ERRM_DTC_R_477_CM 1 0. 1. AXIS_PTS_REF ldp_nr_1_id_err_dtc /end AXIS_DESCR
 /begin AXIS_DESCR COM_AXIS errm_online_dummy _CNV_S_6_ERRM_DTC_R_478_CM 6 0. 5. AXIS_PTS_REF ldp_nr_2_id_err_dtc /end AXIS_DESCR
/end CHARACTERISTIC
/begin CHARACTERISTIC fmy_id_igc_ol_0.c_err_clas "Failure class number for failure XX" VALUE 0xa0803968 _REC_VAL_20_u1 255. _CNV_A_R_LINEAR_____0_CM 0. 255. DISPLAY_IDENTIFIER C_ERR_CLAS_IGC_OL_0 FORMAT "%3.0" /end CHARACTERISTIC
/begin CHARACTERISTIC fmy_id_igc_ol_1.dtc "DTC table declaration for the diagnosis instance XX" MAP 0xa080396c _REC_MAP_20_u2_u2_u2 65535. _CNV_A_R_LINEAR_____0_CM 0. 65535. DISPLAY_IDENTIFIER ID_ERR_DTC_IGC_OL_1 FORMAT "%5.0"
 /begin AXIS_DESCR COM_AXIS errm_online_dummy _CNV_S_2_ERRM_DTC_R_477_CM 1 0. 1. AXIS_PTS_REF ldp_nr_1_id_err_dtc /end AXIS_DESCR
 /begin AXIS_DESCR COM_AXIS errm_online_dummy _CNV_S_6_ERRM_DTC_R_478_CM 6 0. 5. AXIS_PTS_REF ldp_nr_2_id_err_dtc /end AXIS_DESCR
/end CHARACTERISTIC
/begin CHARACTERISTIC fmy_id_igc_ol_1.c_err_clas "Failure class number for failure XX" VALUE 0xa080397c _REC_VAL_20_u1 255. _CNV_A_R_LINEAR_____0_CM 0. 255. DISPLAY_IDENTIFIER C_ERR_CLAS_IGC_OL_1 FORMAT "%3.0" /end CHARACTERISTIC
/begin CHARACTERISTIC fmy_id_igc_ol_2.dtc "DTC table declaration for the diagnosis instance XX" MAP 0xa0803980 _REC_MAP_20_u2_u2_u2 65535. _CNV_A_R_LINEAR_____0_CM 0. 65535. DISPLAY_IDENTIFIER ID_ERR_DTC_IGC_OL_2 FORMAT "%5.0"
 /begin AXIS_DESCR COM_AXIS errm_online_dummy _CNV_S_2_ERRM_DTC_R_477_CM 1 0. 1. AXIS_PTS_REF ldp_nr_1_id_err_dtc /end AXIS_DESCR
 /begin AXIS_DESCR COM_AXIS errm_online_dummy _CNV_S_6_ERRM_DTC_R_478_CM 6 0. 5. AXIS_PTS_REF ldp_nr_2_id_err_dtc /end AXIS_DESCR
/end CHARACTERISTIC
/begin CHARACTERISTIC fmy_id_igc_ol_2.c_err_clas "Failure class number for failure XX" VALUE 0xa0803990 _REC_VAL_20_u1 255. _CNV_A_R_LINEAR_____0_CM 0. 255. DISPLAY_IDENTIFIER C_ERR_CLAS_IGC_OL_2 FORMAT "%3.0" /end CHARACTERISTIC
/begin CHARACTERISTIC fmy_id_igc_ol_3.dtc "DTC table declaration for the diagnosis instance XX" MAP 0xa0803994 _REC_MAP_20_u2_u2_u2 65535. _CNV_A_R_LINEAR_____0_CM 0. 65535. DISPLAY_IDENTIFIER ID_ERR_DTC_IGC_OL_3 FORMAT "%5.0"
 /begin AXIS_DESCR COM_AXIS errm_online_dummy _CNV_S_2_ERRM_DTC_R_477_CM 1 0. 1. AXIS_PTS_REF ldp_nr_1_id_err_dtc /end AXIS_DESCR
 /begin AXIS_DESCR COM_AXIS errm_online_dummy _CNV_S_6_ERRM_DTC_R_478_CM 6 0. 5. AXIS_PTS_REF ldp_nr_2_id_err_dtc /end AXIS_DESCR
/end CHARACTERISTIC
/begin CHARACTERISTIC fmy_id_igc_ol_3.c_err_clas "Failure class number for failure XX" VALUE 0xa08039a4 _REC_VAL_20_u1 255. _CNV_A_R_LINEAR_____0_CM 0. 255. DISPLAY_IDENTIFIER C_ERR_CLAS_IGC_OL_3 FORMAT "%3.0" /end CHARACTERISTIC
/begin CHARACTERISTIC fmy_id_igc_ol_4.dtc "DTC table declaration for the diagnosis instance XX" MAP 0xa08039a8 _REC_MAP_20_u2_u2_u2 65535. _CNV_A_R_LINEAR_____0_CM 0. 65535. DISPLAY_IDENTIFIER ID_ERR_DTC_IGC_OL_4 FORMAT "%5.0"
 /begin AXIS_DESCR COM_AXIS errm_online_dummy _CNV_S_2_ERRM_DTC_R_477_CM 1 0. 1. AXIS_PTS_REF ldp_nr_1_id_err_dtc /end AXIS_DESCR
 /begin AXIS_DESCR COM_AXIS errm_online_dummy _CNV_S_6_ERRM_DTC_R_478_CM 6 0. 5. AXIS_PTS_REF ldp_nr_2_id_err_dtc /end AXIS_DESCR
/end CHARACTERISTIC
/begin CHARACTERISTIC fmy_id_igc_ol_4.c_err_clas "Failure class number for failure XX" VALUE 0xa08039b8 _REC_VAL_20_u1 255. _CNV_A_R_LINEAR_____0_CM 0. 255. DISPLAY_IDENTIFIER C_ERR_CLAS_IGC_OL_4 FORMAT "%3.0" /end CHARACTERISTIC
/begin CHARACTERISTIC fmy_id_igc_ol_5.dtc "DTC table declaration for the diagnosis instance XX" MAP 0xa08039bc _REC_MAP_20_u2_u2_u2 65535. _CNV_A_R_LINEAR_____0_CM 0. 65535. DISPLAY_IDENTIFIER ID_ERR_DTC_IGC_OL_5 FORMAT "%5.0"
 /begin AXIS_DESCR COM_AXIS errm_online_dummy _CNV_S_2_ERRM_DTC_R_477_CM 1 0. 1. AXIS_PTS_REF ldp_nr_1_id_err_dtc /end AXIS_DESCR
 /begin AXIS_DESCR COM_AXIS errm_online_dummy _CNV_S_6_ERRM_DTC_R_478_CM 6 0. 5. AXIS_PTS_REF ldp_nr_2_id_err_dtc /end AXIS_DESCR
/end CHARACTERISTIC
/begin CHARACTERISTIC fmy_id_igc_ol_5.c_err_clas "Failure class number for failure XX" VALUE 0xa08039cc _REC_VAL_20_u1 255. _CNV_A_R_LINEAR_____0_CM 0. 255. DISPLAY_IDENTIFIER C_ERR_CLAS_IGC_OL_5 FORMAT "%3.0" /end CHARACTERISTIC
/begin CHARACTERISTIC fmy_id_igc_ol_6.dtc "DTC table declaration for the diagnosis instance XX" MAP 0xa08039d0 _REC_MAP_20_u2_u2_u2 65535. _CNV_A_R_LINEAR_____0_CM 0. 65535. DISPLAY_IDENTIFIER ID_ERR_DTC_IGC_OL_6 FORMAT "%5.0"
 /begin AXIS_DESCR COM_AXIS errm_online_dummy _CNV_S_2_ERRM_DTC_R_477_CM 1 0. 1. AXIS_PTS_REF ldp_nr_1_id_err_dtc /end AXIS_DESCR
 /begin AXIS_DESCR COM_AXIS errm_online_dummy _CNV_S_6_ERRM_DTC_R_478_CM 6 0. 5. AXIS_PTS_REF ldp_nr_2_id_err_dtc /end AXIS_DESCR
/end CHARACTERISTIC
/begin CHARACTERISTIC fmy_id_igc_ol_6.c_err_clas "Failure class number for failure XX" VALUE 0xa08039e0 _REC_VAL_20_u1 255. _CNV_A_R_LINEAR_____0_CM 0. 255. DISPLAY_IDENTIFIER C_ERR_CLAS_IGC_OL_6 FORMAT "%3.0" /end CHARACTERISTIC
/begin CHARACTERISTIC fmy_id_igc_ol_7.dtc "DTC table declaration for the diagnosis instance XX" MAP 0xa08039e4 _REC_MAP_20_u2_u2_u2 65535. _CNV_A_R_LINEAR_____0_CM 0. 65535. DISPLAY_IDENTIFIER ID_ERR_DTC_IGC_OL_7 FORMAT "%5.0"
 /begin AXIS_DESCR COM_AXIS errm_online_dummy _CNV_S_2_ERRM_DTC_R_477_CM 1 0. 1. AXIS_PTS_REF ldp_nr_1_id_err_dtc /end AXIS_DESCR
 /begin AXIS_DESCR COM_AXIS errm_online_dummy _CNV_S_6_ERRM_DTC_R_478_CM 6 0. 5. AXIS_PTS_REF ldp_nr_2_id_err_dtc /end AXIS_DESCR
/end CHARACTERISTIC
/begin CHARACTERISTIC fmy_id_igc_ol_7.c_err_clas "Failure class number for failure XX" VALUE 0xa08039f4 _REC_VAL_20_u1 255. _CNV_A_R_LINEAR_____0_CM 0. 255. DISPLAY_IDENTIFIER C_ERR_CLAS_IGC_OL_7 FORMAT "%3.0" /end CHARACTERISTIC
/begin CHARACTERISTIC fmy_id_dur_igc_mpl.dtc "DTC table declaration for the diagnosis instance XX" MAP 0xa08034f8 _REC_MAP_20_u2_u2_u2 65535. _CNV_A_R_LINEAR_____0_CM 0. 65535. DISPLAY_IDENTIFIER ID_ERR_DTC_DUR_IGC_MPL FORMAT "%5.0"
 /begin AXIS_DESCR COM_AXIS errm_online_dummy _CNV_S_2_ERRM_DTC_R_477_CM 1 0. 1. AXIS_PTS_REF ldp_nr_1_id_err_dtc /end AXIS_DESCR
 /begin AXIS_DESCR COM_AXIS errm_online_dummy _CNV_S_6_ERRM_DTC_R_478_CM 6 0. 5. AXIS_PTS_REF ldp_nr_2_id_err_dtc /end AXIS_DESCR
/end CHARACTERISTIC
/begin CHARACTERISTIC fmy_id_dur_igc_mpl.c_err_clas "Failure class number for failure XX" VALUE 0xa0803508 _REC_VAL_20_u1 255. _CNV_A_R_LINEAR_____0_CM 0. 255. DISPLAY_IDENTIFIER C_ERR_CLAS_DUR_IGC_MPL FORMAT "%3.0" /end CHARACTERISTIC
/begin CHARACTERISTIC fmy_id_v_ref_1.dtc "DTC table declaration for the diagnosis instance XX" MAP 0xa0804d08 _REC_MAP_20_u2_u2_u2 65535. _CNV_A_R_LINEAR_____0_CM 0. 65535. DISPLAY_IDENTIFIER ID_ERR_DTC_V_REF_1 FORMAT "%5.0"
 /begin AXIS_DESCR COM_AXIS errm_online_dummy _CNV_S_2_ERRM_DTC_R_477_CM 1 0. 1. AXIS_PTS_REF ldp_nr_1_id_err_dtc /end AXIS_DESCR
 /begin AXIS_DESCR COM_AXIS errm_online_dummy _CNV_S_6_ERRM_DTC_R_478_CM 6 0. 5. AXIS_PTS_REF ldp_nr_2_id_err_dtc /end AXIS_DESCR
/end CHARACTERISTIC
/begin CHARACTERISTIC fmy_id_v_ref_1.c_err_clas "Failure class number for failure XX" VALUE 0xa0804d18 _REC_VAL_20_u1 255. _CNV_A_R_LINEAR_____0_CM 0. 255. DISPLAY_IDENTIFIER C_ERR_CLAS_V_REF_1 FORMAT "%3.0" /end CHARACTERISTIC
/begin CHARACTERISTIC fmy_id_v_ref_2.dtc "DTC table declaration for the diagnosis instance XX" MAP 0xa0804d1c _REC_MAP_20_u2_u2_u2 65535. _CNV_A_R_LINEAR_____0_CM 0. 65535. DISPLAY_IDENTIFIER ID_ERR_DTC_V_REF_2 FORMAT "%5.0"
 /begin AXIS_DESCR COM_AXIS errm_online_dummy _CNV_S_2_ERRM_DTC_R_477_CM 1 0. 1. AXIS_PTS_REF ldp_nr_1_id_err_dtc /end AXIS_DESCR
 /begin AXIS_DESCR COM_AXIS errm_online_dummy _CNV_S_6_ERRM_DTC_R_478_CM 6 0. 5. AXIS_PTS_REF ldp_nr_2_id_err_dtc /end AXIS_DESCR
/end CHARACTERISTIC
/begin CHARACTERISTIC fmy_id_v_ref_2.c_err_clas "Failure class number for failure XX" VALUE 0xa0804d2c _REC_VAL_20_u1 255. _CNV_A_R_LINEAR_____0_CM 0. 255. DISPLAY_IDENTIFIER C_ERR_CLAS_V_REF_2 FORMAT "%3.0" /end CHARACTERISTIC
/begin CHARACTERISTIC fmy_id_pvs_1.dtc "DTC table declaration for the diagnosis instance XX" MAP 0xa080440c _REC_MAP_20_u2_u2_u2 65535. _CNV_A_R_LINEAR_____0_CM 0. 65535. DISPLAY_IDENTIFIER ID_ERR_DTC_PVS_1 FORMAT "%5.0"
 /begin AXIS_DESCR COM_AXIS errm_online_dummy _CNV_S_2_ERRM_DTC_R_477_CM 1 0. 1. AXIS_PTS_REF ldp_nr_1_id_err_dtc /end AXIS_DESCR
 /begin AXIS_DESCR COM_AXIS errm_online_dummy _CNV_S_6_ERRM_DTC_R_478_CM 6 0. 5. AXIS_PTS_REF ldp_nr_2_id_err_dtc /end AXIS_DESCR
/end CHARACTERISTIC
/begin CHARACTERISTIC fmy_id_pvs_1.c_err_clas "Failure class number for failure XX" VALUE 0xa080441c _REC_VAL_20_u1 255. _CNV_A_R_LINEAR_____0_CM 0. 255. DISPLAY_IDENTIFIER C_ERR_CLAS_PVS_1 FORMAT "%3.0" /end CHARACTERISTIC
/begin CHARACTERISTIC fmy_id_pvs_2.dtc "DTC table declaration for the diagnosis instance XX" MAP 0xa0804420 _REC_MAP_20_u2_u2_u2 65535. _CNV_A_R_LINEAR_____0_CM 0. 65535. DISPLAY_IDENTIFIER ID_ERR_DTC_PVS_2 FORMAT "%5.0"
 /begin AXIS_DESCR COM_AXIS errm_online_dummy _CNV_S_2_ERRM_DTC_R_477_CM 1 0. 1. AXIS_PTS_REF ldp_nr_1_id_err_dtc /end AXIS_DESCR
 /begin AXIS_DESCR COM_AXIS errm_online_dummy _CNV_S_6_ERRM_DTC_R_478_CM 6 0. 5. AXIS_PTS_REF ldp_nr_2_id_err_dtc /end AXIS_DESCR
/end CHARACTERISTIC
/begin CHARACTERISTIC fmy_id_pvs_2.c_err_clas "Failure class number for failure XX" VALUE 0xa0804430 _REC_VAL_20_u1 255. _CNV_A_R_LINEAR_____0_CM 0. 255. DISPLAY_IDENTIFIER C_ERR_CLAS_PVS_2 FORMAT "%3.0" /end CHARACTERISTIC
/begin CHARACTERISTIC fmy_id_pvs_ratio.dtc "DTC table declaration for the diagnosis instance XX" MAP 0xa0804470 _REC_MAP_20_u2_u2_u2 65535. _CNV_A_R_LINEAR_____0_CM 0. 65535. DISPLAY_IDENTIFIER ID_ERR_DTC_PVS_RATIO FORMAT "%5.0"
 /begin AXIS_DESCR COM_AXIS errm_online_dummy _CNV_S_2_ERRM_DTC_R_477_CM 1 0. 1. AXIS_PTS_REF ldp_nr_1_id_err_dtc /end AXIS_DESCR
 /begin AXIS_DESCR COM_AXIS errm_online_dummy _CNV_S_6_ERRM_DTC_R_478_CM 6 0. 5. AXIS_PTS_REF ldp_nr_2_id_err_dtc /end AXIS_DESCR
/end CHARACTERISTIC
/begin CHARACTERISTIC fmy_id_pvs_ratio.c_err_clas "Failure class number for failure XX" VALUE 0xa0804480 _REC_VAL_20_u1 255. _CNV_A_R_LINEAR_____0_CM 0. 255. DISPLAY_IDENTIFIER C_ERR_CLAS_PVS_RATIO FORMAT "%3.0" /end CHARACTERISTIC
/begin CHARACTERISTIC fmy_id_pvs_double.dtc "DTC table declaration for the diagnosis instance XX" MAP 0xa0804448 _REC_MAP_20_u2_u2_u2 65535. _CNV_A_R_LINEAR_____0_CM 0. 65535. DISPLAY_IDENTIFIER ID_ERR_DTC_PVS_DOUBLE FORMAT "%5.0"
 /begin AXIS_DESCR COM_AXIS errm_online_dummy _CNV_S_2_ERRM_DTC_R_477_CM 1 0. 1. AXIS_PTS_REF ldp_nr_1_id_err_dtc /end AXIS_DESCR
 /begin AXIS_DESCR COM_AXIS errm_online_dummy _CNV_S_6_ERRM_DTC_R_478_CM 6 0. 5. AXIS_PTS_REF ldp_nr_2_id_err_dtc /end AXIS_DESCR
/end CHARACTERISTIC
/begin CHARACTERISTIC fmy_id_pvs_double.c_err_clas "Failure class number for failure XX" VALUE 0xa0804458 _REC_VAL_20_u1 255. _CNV_A_R_LINEAR_____0_CM 0. 255. DISPLAY_IDENTIFIER C_ERR_CLAS_PVS_DOUBLE FORMAT "%3.0" /end CHARACTERISTIC
/begin CHARACTERISTIC fmy_id_pvs_bls_not_plaus.dtc "DTC table declaration for the diagnosis instance XX" MAP 0xa0804434 _REC_MAP_20_u2_u2_u2 65535. _CNV_A_R_LINEAR_____0_CM 0. 65535. DISPLAY_IDENTIFIER ID_ERR_DTC_PVS_BLS_NOT_PLAUS FORMAT "%5.0"
 /begin AXIS_DESCR COM_AXIS errm_online_dummy _CNV_S_2_ERRM_DTC_R_477_CM 1 0. 1. AXIS_PTS_REF ldp_nr_1_id_err_dtc /end AXIS_DESCR
 /begin AXIS_DESCR COM_AXIS errm_online_dummy _CNV_S_6_ERRM_DTC_R_478_CM 6 0. 5. AXIS_PTS_REF ldp_nr_2_id_err_dtc /end AXIS_DESCR
/end CHARACTERISTIC
/begin CHARACTERISTIC fmy_id_pvs_bls_not_plaus.c_err_clas "Failure class number for failure XX" VALUE 0xa0804444 _REC_VAL_20_u1 255. _CNV_A_R_LINEAR_____0_CM 0. 255. DISPLAY_IDENTIFIER C_ERR_CLAS_PVS_BLS_NOT_PLAUS FORMAT "%3.0" /end CHARACTERISTIC
/begin CHARACTERISTIC fmy_id_mtc_ctl_1.dtc "DTC table declaration for the diagnosis instance XX" MAP 0xa08040c4 _REC_MAP_20_u2_u2_u2 65535. _CNV_A_R_LINEAR_____0_CM 0. 65535. DISPLAY_IDENTIFIER ID_ERR_DTC_MTC_CTL_1 FORMAT "%5.0"
 /begin AXIS_DESCR COM_AXIS errm_online_dummy _CNV_S_2_ERRM_DTC_R_477_CM 1 0. 1. AXIS_PTS_REF ldp_nr_1_id_err_dtc /end AXIS_DESCR
 /begin AXIS_DESCR COM_AXIS errm_online_dummy _CNV_S_6_ERRM_DTC_R_478_CM 6 0. 5. AXIS_PTS_REF ldp_nr_2_id_err_dtc /end AXIS_DESCR
/end CHARACTERISTIC
/begin CHARACTERISTIC fmy_id_mtc_ctl_1.c_err_clas "Failure class number for failure XX" VALUE 0xa08040d4 _REC_VAL_20_u1 255. _CNV_A_R_LINEAR_____0_CM 0. 255. DISPLAY_IDENTIFIER C_ERR_CLAS_MTC_CTL_1 FORMAT "%3.0" /end CHARACTERISTIC
/begin CHARACTERISTIC fmy_id_gen.dtc "DTC table declaration for the diagnosis instance XX" MAP 0xa0803868 _REC_MAP_20_u2_u2_u2 65535. _CNV_A_R_LINEAR_____0_CM 0. 65535. DISPLAY_IDENTIFIER ID_ERR_DTC_GEN FORMAT "%5.0"
 /begin AXIS_DESCR COM_AXIS errm_online_dummy _CNV_S_2_ERRM_DTC_R_477_CM 1 0. 1. AXIS_PTS_REF ldp_nr_1_id_err_dtc /end AXIS_DESCR
 /begin AXIS_DESCR COM_AXIS errm_online_dummy _CNV_S_6_ERRM_DTC_R_478_CM 6 0. 5. AXIS_PTS_REF ldp_nr_2_id_err_dtc /end AXIS_DESCR
/end CHARACTERISTIC
/begin CHARACTERISTIC fmy_id_gen.c_err_clas "Failure class number for failure XX" VALUE 0xa0803878 _REC_VAL_20_u1 255. _CNV_A_R_LINEAR_____0_CM 0. 255. DISPLAY_IDENTIFIER C_ERR_CLAS_GEN FORMAT "%3.0" /end CHARACTERISTIC
/begin CHARACTERISTIC fmy_id_gen_diag.dtc "DTC table declaration for the diagnosis instance XX" MAP 0xa08038a4 _REC_MAP_20_u2_u2_u2 65535. _CNV_A_R_LINEAR_____0_CM 0. 65535. DISPLAY_IDENTIFIER ID_ERR_DTC_GEN_DIAG FORMAT "%5.0"
 /begin AXIS_DESCR COM_AXIS errm_online_dummy _CNV_S_2_ERRM_DTC_R_477_CM 1 0. 1. AXIS_PTS_REF ldp_nr_1_id_err_dtc /end AXIS_DESCR
 /begin AXIS_DESCR COM_AXIS errm_online_dummy _CNV_S_6_ERRM_DTC_R_478_CM 6 0. 5. AXIS_PTS_REF ldp_nr_2_id_err_dtc /end AXIS_DESCR
/end CHARACTERISTIC
/begin CHARACTERISTIC fmy_id_gen_diag.c_err_clas "Failure class number for failure XX" VALUE 0xa08038b4 _REC_VAL_20_u1 255. _CNV_A_R_LINEAR_____0_CM 0. 255. DISPLAY_IDENTIFIER C_ERR_CLAS_GEN_DIAG FORMAT "%3.0" /end CHARACTERISTIC
/begin CHARACTERISTIC fmy_id_alter_bn.dtc "DTC table declaration for the diagnosis instance XX" MAP 0xa08029b8 _REC_MAP_20_u2_u2_u2 65535. _CNV_A_R_LINEAR_____0_CM 0. 65535. DISPLAY_IDENTIFIER ID_ERR_DTC_ALTER_BN FORMAT "%5.0"
 /begin AXIS_DESCR COM_AXIS errm_online_dummy _CNV_S_2_ERRM_DTC_R_477_CM 1 0. 1. AXIS_PTS_REF ldp_nr_1_id_err_dtc /end AXIS_DESCR
 /begin AXIS_DESCR COM_AXIS errm_online_dummy _CNV_S_6_ERRM_DTC_R_478_CM 6 0. 5. AXIS_PTS_REF ldp_nr_2_id_err_dtc /end AXIS_DESCR
/end CHARACTERISTIC
/begin CHARACTERISTIC fmy_id_alter_bn.c_err_clas "Failure class number for failure XX" VALUE 0xa08029c8 _REC_VAL_20_u1 255. _CNV_A_R_LINEAR_____0_CM 0. 255. DISPLAY_IDENTIFIER C_ERR_CLAS_ALTER_BN FORMAT "%3.0" /end CHARACTERISTIC
/begin CHARACTERISTIC fmy_id_alter_bn_bat.dtc "DTC table declaration for the diagnosis instance XX" MAP 0xa08029cc _REC_MAP_20_u2_u2_u2 65535. _CNV_A_R_LINEAR_____0_CM 0. 65535. DISPLAY_IDENTIFIER ID_ERR_DTC_ALTER_BN_BAT FORMAT "%5.0"
 /begin AXIS_DESCR COM_AXIS errm_online_dummy _CNV_S_2_ERRM_DTC_R_477_CM 1 0. 1. AXIS_PTS_REF ldp_nr_1_id_err_dtc /end AXIS_DESCR
 /begin AXIS_DESCR COM_AXIS errm_online_dummy _CNV_S_6_ERRM_DTC_R_478_CM 6 0. 5. AXIS_PTS_REF ldp_nr_2_id_err_dtc /end AXIS_DESCR
/end CHARACTERISTIC
/begin CHARACTERISTIC fmy_id_alter_bn_bat.c_err_clas "Failure class number for failure XX" VALUE 0xa08029dc _REC_VAL_20_u1 255. _CNV_A_R_LINEAR_____0_CM 0. 255. DISPLAY_IDENTIFIER C_ERR_CLAS_ALTER_BN_BAT FORMAT "%3.0" /end CHARACTERISTIC
/begin CHARACTERISTIC fmy_id_t_es.dtc "DTC table declaration for the diagnosis instance XX" MAP 0xa0804858 _REC_MAP_20_u2_u2_u2 65535. _CNV_A_R_LINEAR_____0_CM 0. 65535. DISPLAY_IDENTIFIER ID_ERR_DTC_T_ES FORMAT "%5.0"
 /begin AXIS_DESCR COM_AXIS errm_online_dummy _CNV_S_2_ERRM_DTC_R_477_CM 1 0. 1. AXIS_PTS_REF ldp_nr_1_id_err_dtc /end AXIS_DESCR
 /begin AXIS_DESCR COM_AXIS errm_online_dummy _CNV_S_6_ERRM_DTC_R_478_CM 6 0. 5. AXIS_PTS_REF ldp_nr_2_id_err_dtc /end AXIS_DESCR
/end CHARACTERISTIC
/begin CHARACTERISTIC fmy_id_t_es.c_err_clas "Failure class number for failure XX" VALUE 0xa0804868 _REC_VAL_20_u1 255. _CNV_A_R_LINEAR_____0_CM 0. 255. DISPLAY_IDENTIFIER C_ERR_CLAS_T_ES FORMAT "%3.0" /end CHARACTERISTIC
/begin CHARACTERISTIC fmy_id_map_dip_plaus.dtc "DTC table declaration for the diagnosis instance XX" MAP 0xa0803ee4 _REC_MAP_20_u2_u2_u2 65535. _CNV_A_R_LINEAR_____0_CM 0. 65535. DISPLAY_IDENTIFIER ID_ERR_DTC_MAP_DIP_PLAUS FORMAT "%5.0"
 /begin AXIS_DESCR COM_AXIS errm_online_dummy _CNV_S_2_ERRM_DTC_R_477_CM 1 0. 1. AXIS_PTS_REF ldp_nr_1_id_err_dtc /end AXIS_DESCR
 /begin AXIS_DESCR COM_AXIS errm_online_dummy _CNV_S_6_ERRM_DTC_R_478_CM 6 0. 5. AXIS_PTS_REF ldp_nr_2_id_err_dtc /end AXIS_DESCR
/end CHARACTERISTIC
/begin CHARACTERISTIC fmy_id_map_dip_plaus.c_err_clas "Failure class number for failure XX" VALUE 0xa0803ef4 _REC_VAL_20_u1 255. _CNV_A_R_LINEAR_____0_CM 0. 255. DISPLAY_IDENTIFIER C_ERR_CLAS_MAP_DIP_PLAUS FORMAT "%3.0" /end CHARACTERISTIC
/begin CHARACTERISTIC fmy_id_toil_level.dtc "DTC table declaration for the diagnosis instance XX" MAP 0xa0804a60 _REC_MAP_20_u2_u2_u2 65535. _CNV_A_R_LINEAR_____0_CM 0. 65535. DISPLAY_IDENTIFIER ID_ERR_DTC_TOIL_LEVEL FORMAT "%5.0"
 /begin AXIS_DESCR COM_AXIS errm_online_dummy _CNV_S_2_ERRM_DTC_R_477_CM 1 0. 1. AXIS_PTS_REF ldp_nr_1_id_err_dtc /end AXIS_DESCR
 /begin AXIS_DESCR COM_AXIS errm_online_dummy _CNV_S_6_ERRM_DTC_R_478_CM 6 0. 5. AXIS_PTS_REF ldp_nr_2_id_err_dtc /end AXIS_DESCR
/end CHARACTERISTIC
/begin CHARACTERISTIC fmy_id_toil_level.c_err_clas "Failure class number for failure XX" VALUE 0xa0804a70 _REC_VAL_20_u1 255. _CNV_A_R_LINEAR_____0_CM 0. 255. DISPLAY_IDENTIFIER C_ERR_CLAS_TOIL_LEVEL FORMAT "%3.0" /end CHARACTERISTIC
/begin CHARACTERISTIC fmy_id_alter_bn_rgn.dtc "DTC table declaration for the diagnosis instance XX" MAP 0xa08029e0 _REC_MAP_20_u2_u2_u2 65535. _CNV_A_R_LINEAR_____0_CM 0. 65535. DISPLAY_IDENTIFIER ID_ERR_DTC_ALTER_BN_RGN FORMAT "%5.0"
 /begin AXIS_DESCR COM_AXIS errm_online_dummy _CNV_S_2_ERRM_DTC_R_477_CM 1 0. 1. AXIS_PTS_REF ldp_nr_1_id_err_dtc /end AXIS_DESCR
 /begin AXIS_DESCR COM_AXIS errm_online_dummy _CNV_S_6_ERRM_DTC_R_478_CM 6 0. 5. AXIS_PTS_REF ldp_nr_2_id_err_dtc /end AXIS_DESCR
/end CHARACTERISTIC
/begin CHARACTERISTIC fmy_id_alter_bn_rgn.c_err_clas "Failure class number for failure XX" VALUE 0xa08029f0 _REC_VAL_20_u1 255. _CNV_A_R_LINEAR_____0_CM 0. 255. DISPLAY_IDENTIFIER C_ERR_CLAS_ALTER_BN_RGN FORMAT "%3.0" /end CHARACTERISTIC
/begin CHARACTERISTIC fmy_id_per_cam_in_1.dtc "DTC table declaration for the diagnosis instance XX" MAP 0xa08042a4 _REC_MAP_20_u2_u2_u2 65535. _CNV_A_R_LINEAR_____0_CM 0. 65535. DISPLAY_IDENTIFIER ID_ERR_DTC_PER_CAM_IN_1 FORMAT "%5.0"
 /begin AXIS_DESCR COM_AXIS errm_online_dummy _CNV_S_2_ERRM_DTC_R_477_CM 1 0. 1. AXIS_PTS_REF ldp_nr_1_id_err_dtc /end AXIS_DESCR
 /begin AXIS_DESCR COM_AXIS errm_online_dummy _CNV_S_6_ERRM_DTC_R_478_CM 6 0. 5. AXIS_PTS_REF ldp_nr_2_id_err_dtc /end AXIS_DESCR
/end CHARACTERISTIC
/begin CHARACTERISTIC fmy_id_per_cam_in_1.c_err_clas "Failure class number for failure XX" VALUE 0xa08042b4 _REC_VAL_20_u1 255. _CNV_A_R_LINEAR_____0_CM 0. 255. DISPLAY_IDENTIFIER C_ERR_CLAS_PER_CAM_IN_1 FORMAT "%3.0" /end CHARACTERISTIC
/begin CHARACTERISTIC fmy_id_per_cam_ex_1.dtc "DTC table declaration for the diagnosis instance XX" MAP 0xa080427c _REC_MAP_20_u2_u2_u2 65535. _CNV_A_R_LINEAR_____0_CM 0. 65535. DISPLAY_IDENTIFIER ID_ERR_DTC_PER_CAM_EX_1 FORMAT "%5.0"
 /begin AXIS_DESCR COM_AXIS errm_online_dummy _CNV_S_2_ERRM_DTC_R_477_CM 1 0. 1. AXIS_PTS_REF ldp_nr_1_id_err_dtc /end AXIS_DESCR
 /begin AXIS_DESCR COM_AXIS errm_online_dummy _CNV_S_6_ERRM_DTC_R_478_CM 6 0. 5. AXIS_PTS_REF ldp_nr_2_id_err_dtc /end AXIS_DESCR
/end CHARACTERISTIC
/begin CHARACTERISTIC fmy_id_per_cam_ex_1.c_err_clas "Failure class number for failure XX" VALUE 0xa080428c _REC_VAL_20_u1 255. _CNV_A_R_LINEAR_____0_CM 0. 255. DISPLAY_IDENTIFIER C_ERR_CLAS_PER_CAM_EX_1 FORMAT "%3.0" /end CHARACTERISTIC
/begin CHARACTERISTIC fmy_id_syn_cam_in_1.dtc "DTC table declaration for the diagnosis instance XX" MAP 0xa08047e0 _REC_MAP_20_u2_u2_u2 65535. _CNV_A_R_LINEAR_____0_CM 0. 65535. DISPLAY_IDENTIFIER ID_ERR_DTC_SYN_CAM_IN_1 FORMAT "%5.0"
 /begin AXIS_DESCR COM_AXIS errm_online_dummy _CNV_S_2_ERRM_DTC_R_477_CM 1 0. 1. AXIS_PTS_REF ldp_nr_1_id_err_dtc /end AXIS_DESCR
 /begin AXIS_DESCR COM_AXIS errm_online_dummy _CNV_S_6_ERRM_DTC_R_478_CM 6 0. 5. AXIS_PTS_REF ldp_nr_2_id_err_dtc /end AXIS_DESCR
/end CHARACTERISTIC
/begin CHARACTERISTIC fmy_id_syn_cam_in_1.c_err_clas "Failure class number for failure XX" VALUE 0xa08047f0 _REC_VAL_20_u1 255. _CNV_A_R_LINEAR_____0_CM 0. 255. DISPLAY_IDENTIFIER C_ERR_CLAS_SYN_CAM_IN_1 FORMAT "%3.0" /end CHARACTERISTIC
/begin CHARACTERISTIC fmy_id_syn_cam_ex_1.dtc "DTC table declaration for the diagnosis instance XX" MAP 0xa08047b8 _REC_MAP_20_u2_u2_u2 65535. _CNV_A_R_LINEAR_____0_CM 0. 65535. DISPLAY_IDENTIFIER ID_ERR_DTC_SYN_CAM_EX_1 FORMAT "%5.0"
 /begin AXIS_DESCR COM_AXIS errm_online_dummy _CNV_S_2_ERRM_DTC_R_477_CM 1 0. 1. AXIS_PTS_REF ldp_nr_1_id_err_dtc /end AXIS_DESCR
 /begin AXIS_DESCR COM_AXIS errm_online_dummy _CNV_S_6_ERRM_DTC_R_478_CM 6 0. 5. AXIS_PTS_REF ldp_nr_2_id_err_dtc /end AXIS_DESCR
/end CHARACTERISTIC
/begin CHARACTERISTIC fmy_id_syn_cam_ex_1.c_err_clas "Failure class number for failure XX" VALUE 0xa08047c8 _REC_VAL_20_u1 255. _CNV_A_R_LINEAR_____0_CM 0. 255. DISPLAY_IDENTIFIER C_ERR_CLAS_SYN_CAM_EX_1 FORMAT "%3.0" /end CHARACTERISTIC
/begin CHARACTERISTIC fmy_id_ref_crk_cam_in_1.dtc "DTC table declaration for the diagnosis instance XX" MAP 0xa08044d4 _REC_MAP_20_u2_u2_u2 65535. _CNV_A_R_LINEAR_____0_CM 0. 65535. DISPLAY_IDENTIFIER ID_ERR_DTC_REF_CRK_CAM_IN_1 FORMAT "%5.0"
 /begin AXIS_DESCR COM_AXIS errm_online_dummy _CNV_S_2_ERRM_DTC_R_477_CM 1 0. 1. AXIS_PTS_REF ldp_nr_1_id_err_dtc /end AXIS_DESCR
 /begin AXIS_DESCR COM_AXIS errm_online_dummy _CNV_S_6_ERRM_DTC_R_478_CM 6 0. 5. AXIS_PTS_REF ldp_nr_2_id_err_dtc /end AXIS_DESCR
/end CHARACTERISTIC
/begin CHARACTERISTIC fmy_id_ref_crk_cam_in_1.c_err_clas "Failure class number for failure XX" VALUE 0xa08044e4 _REC_VAL_20_u1 255. _CNV_A_R_LINEAR_____0_CM 0. 255. DISPLAY_IDENTIFIER C_ERR_CLAS_REF_CRK_CAM_IN_1 FORMAT "%3.0" /end CHARACTERISTIC
/begin CHARACTERISTIC fmy_id_ref_crk_cam_ex_1.dtc "DTC table declaration for the diagnosis instance XX" MAP 0xa08044ac _REC_MAP_20_u2_u2_u2 65535. _CNV_A_R_LINEAR_____0_CM 0. 65535. DISPLAY_IDENTIFIER ID_ERR_DTC_REF_CRK_CAM_EX_1 FORMAT "%5.0"
 /begin AXIS_DESCR COM_AXIS errm_online_dummy _CNV_S_2_ERRM_DTC_R_477_CM 1 0. 1. AXIS_PTS_REF ldp_nr_1_id_err_dtc /end AXIS_DESCR
 /begin AXIS_DESCR COM_AXIS errm_online_dummy _CNV_S_6_ERRM_DTC_R_478_CM 6 0. 5. AXIS_PTS_REF ldp_nr_2_id_err_dtc /end AXIS_DESCR
/end CHARACTERISTIC
/begin CHARACTERISTIC fmy_id_ref_crk_cam_ex_1.c_err_clas "Failure class number for failure XX" VALUE 0xa08044bc _REC_VAL_20_u1 255. _CNV_A_R_LINEAR_____0_CM 0. 255. DISPLAY_IDENTIFIER C_ERR_CLAS_REF_CRK_CAM_EX_1 FORMAT "%3.0" /end CHARACTERISTIC
/begin CHARACTERISTIC fmy_id_per_cam_in_2.dtc "DTC table declaration for the diagnosis instance XX" MAP 0xa08042b8 _REC_MAP_20_u2_u2_u2 65535. _CNV_A_R_LINEAR_____0_CM 0. 65535. DISPLAY_IDENTIFIER ID_ERR_DTC_PER_CAM_IN_2 FORMAT "%5.0"
 /begin AXIS_DESCR COM_AXIS errm_online_dummy _CNV_S_2_ERRM_DTC_R_477_CM 1 0. 1. AXIS_PTS_REF ldp_nr_1_id_err_dtc /end AXIS_DESCR
 /begin AXIS_DESCR COM_AXIS errm_online_dummy _CNV_S_6_ERRM_DTC_R_478_CM 6 0. 5. AXIS_PTS_REF ldp_nr_2_id_err_dtc /end AXIS_DESCR
/end CHARACTERISTIC
/begin CHARACTERISTIC fmy_id_per_cam_in_2.c_err_clas "Failure class number for failure XX" VALUE 0xa08042c8 _REC_VAL_20_u1 255. _CNV_A_R_LINEAR_____0_CM 0. 255. DISPLAY_IDENTIFIER C_ERR_CLAS_PER_CAM_IN_2 FORMAT "%3.0" /end CHARACTERISTIC
/begin CHARACTERISTIC fmy_id_per_cam_ex_2.dtc "DTC table declaration for the diagnosis instance XX" MAP 0xa0804290 _REC_MAP_20_u2_u2_u2 65535. _CNV_A_R_LINEAR_____0_CM 0. 65535. DISPLAY_IDENTIFIER ID_ERR_DTC_PER_CAM_EX_2 FORMAT "%5.0"
 /begin AXIS_DESCR COM_AXIS errm_online_dummy _CNV_S_2_ERRM_DTC_R_477_CM 1 0. 1. AXIS_PTS_REF ldp_nr_1_id_err_dtc /end AXIS_DESCR
 /begin AXIS_DESCR COM_AXIS errm_online_dummy _CNV_S_6_ERRM_DTC_R_478_CM 6 0. 5. AXIS_PTS_REF ldp_nr_2_id_err_dtc /end AXIS_DESCR
/end CHARACTERISTIC
/begin CHARACTERISTIC fmy_id_per_cam_ex_2.c_err_clas "Failure class number for failure XX" VALUE 0xa08042a0 _REC_VAL_20_u1 255. _CNV_A_R_LINEAR_____0_CM 0. 255. DISPLAY_IDENTIFIER C_ERR_CLAS_PER_CAM_EX_2 FORMAT "%3.0" /end CHARACTERISTIC
/begin CHARACTERISTIC fmy_id_syn_cam_in_2.dtc "DTC table declaration for the diagnosis instance XX" MAP 0xa08047f4 _REC_MAP_20_u2_u2_u2 65535. _CNV_A_R_LINEAR_____0_CM 0. 65535. DISPLAY_IDENTIFIER ID_ERR_DTC_SYN_CAM_IN_2 FORMAT "%5.0"
 /begin AXIS_DESCR COM_AXIS errm_online_dummy _CNV_S_2_ERRM_DTC_R_477_CM 1 0. 1. AXIS_PTS_REF ldp_nr_1_id_err_dtc /end AXIS_DESCR
 /begin AXIS_DESCR COM_AXIS errm_online_dummy _CNV_S_6_ERRM_DTC_R_478_CM 6 0. 5. AXIS_PTS_REF ldp_nr_2_id_err_dtc /end AXIS_DESCR
/end CHARACTERISTIC
/begin CHARACTERISTIC fmy_id_syn_cam_in_2.c_err_clas "Failure class number for failure XX" VALUE 0xa0804804 _REC_VAL_20_u1 255. _CNV_A_R_LINEAR_____0_CM 0. 255. DISPLAY_IDENTIFIER C_ERR_CLAS_SYN_CAM_IN_2 FORMAT "%3.0" /end CHARACTERISTIC
/begin CHARACTERISTIC fmy_id_syn_cam_ex_2.dtc "DTC table declaration for the diagnosis instance XX" MAP 0xa08047cc _REC_MAP_20_u2_u2_u2 65535. _CNV_A_R_LINEAR_____0_CM 0. 65535. DISPLAY_IDENTIFIER ID_ERR_DTC_SYN_CAM_EX_2 FORMAT "%5.0"
 /begin AXIS_DESCR COM_AXIS errm_online_dummy _CNV_S_2_ERRM_DTC_R_477_CM 1 0. 1. AXIS_PTS_REF ldp_nr_1_id_err_dtc /end AXIS_DESCR
 /begin AXIS_DESCR COM_AXIS errm_online_dummy _CNV_S_6_ERRM_DTC_R_478_CM 6 0. 5. AXIS_PTS_REF ldp_nr_2_id_err_dtc /end AXIS_DESCR
/end CHARACTERISTIC
/begin CHARACTERISTIC fmy_id_syn_cam_ex_2.c_err_clas "Failure class number for failure XX" VALUE 0xa08047dc _REC_VAL_20_u1 255. _CNV_A_R_LINEAR_____0_CM 0. 255. DISPLAY_IDENTIFIER C_ERR_CLAS_SYN_CAM_EX_2 FORMAT "%3.0" /end CHARACTERISTIC
/begin CHARACTERISTIC fmy_id_ref_crk_cam_in_2.dtc "DTC table declaration for the diagnosis instance XX" MAP 0xa08044e8 _REC_MAP_20_u2_u2_u2 65535. _CNV_A_R_LINEAR_____0_CM 0. 65535. DISPLAY_IDENTIFIER ID_ERR_DTC_REF_CRK_CAM_IN_2 FORMAT "%5.0"
 /begin AXIS_DESCR COM_AXIS errm_online_dummy _CNV_S_2_ERRM_DTC_R_477_CM 1 0. 1. AXIS_PTS_REF ldp_nr_1_id_err_dtc /end AXIS_DESCR
 /begin AXIS_DESCR COM_AXIS errm_online_dummy _CNV_S_6_ERRM_DTC_R_478_CM 6 0. 5. AXIS_PTS_REF ldp_nr_2_id_err_dtc /end AXIS_DESCR
/end CHARACTERISTIC
/begin CHARACTERISTIC fmy_id_ref_crk_cam_in_2.c_err_clas "Failure class number for failure XX" VALUE 0xa08044f8 _REC_VAL_20_u1 255. _CNV_A_R_LINEAR_____0_CM 0. 255. DISPLAY_IDENTIFIER C_ERR_CLAS_REF_CRK_CAM_IN_2 FORMAT "%3.0" /end CHARACTERISTIC
/begin CHARACTERISTIC fmy_id_ref_crk_cam_ex_2.dtc "DTC table declaration for the diagnosis instance XX" MAP 0xa08044c0 _REC_MAP_20_u2_u2_u2 65535. _CNV_A_R_LINEAR_____0_CM 0. 65535. DISPLAY_IDENTIFIER ID_ERR_DTC_REF_CRK_CAM_EX_2 FORMAT "%5.0"
 /begin AXIS_DESCR COM_AXIS errm_online_dummy _CNV_S_2_ERRM_DTC_R_477_CM 1 0. 1. AXIS_PTS_REF ldp_nr_1_id_err_dtc /end AXIS_DESCR
 /begin AXIS_DESCR COM_AXIS errm_online_dummy _CNV_S_6_ERRM_DTC_R_478_CM 6 0. 5. AXIS_PTS_REF ldp_nr_2_id_err_dtc /end AXIS_DESCR
/end CHARACTERISTIC
/begin CHARACTERISTIC fmy_id_ref_crk_cam_ex_2.c_err_clas "Failure class number for failure XX" VALUE 0xa08044d0 _REC_VAL_20_u1 255. _CNV_A_R_LINEAR_____0_CM 0. 255. DISPLAY_IDENTIFIER C_ERR_CLAS_REF_CRK_CAM_EX_2 FORMAT "%3.0" /end CHARACTERISTIC
/begin CHARACTERISTIC fmy_id_crk_tooth.dtc "DTC table declaration for the diagnosis instance XX" MAP 0xa0803200 _REC_MAP_20_u2_u2_u2 65535. _CNV_A_R_LINEAR_____0_CM 0. 65535. DISPLAY_IDENTIFIER ID_ERR_DTC_CRK_TOOTH FORMAT "%5.0"
 /begin AXIS_DESCR COM_AXIS errm_online_dummy _CNV_S_2_ERRM_DTC_R_477_CM 1 0. 1. AXIS_PTS_REF ldp_nr_1_id_err_dtc /end AXIS_DESCR
 /begin AXIS_DESCR COM_AXIS errm_online_dummy _CNV_S_6_ERRM_DTC_R_478_CM 6 0. 5. AXIS_PTS_REF ldp_nr_2_id_err_dtc /end AXIS_DESCR
/end CHARACTERISTIC
/begin CHARACTERISTIC fmy_id_crk_tooth.c_err_clas "Failure class number for failure XX" VALUE 0xa0803210 _REC_VAL_20_u1 255. _CNV_A_R_LINEAR_____0_CM 0. 255. DISPLAY_IDENTIFIER C_ERR_CLAS_CRK_TOOTH FORMAT "%3.0" /end CHARACTERISTIC
/begin CHARACTERISTIC fmy_id_crk_tooth_per.dtc "DTC table declaration for the diagnosis instance XX" MAP 0xa0803214 _REC_MAP_20_u2_u2_u2 65535. _CNV_A_R_LINEAR_____0_CM 0. 65535. DISPLAY_IDENTIFIER ID_ERR_DTC_CRK_TOOTH_PER FORMAT "%5.0"
 /begin AXIS_DESCR COM_AXIS errm_online_dummy _CNV_S_2_ERRM_DTC_R_477_CM 1 0. 1. AXIS_PTS_REF ldp_nr_1_id_err_dtc /end AXIS_DESCR
 /begin AXIS_DESCR COM_AXIS errm_online_dummy _CNV_S_6_ERRM_DTC_R_478_CM 6 0. 5. AXIS_PTS_REF ldp_nr_2_id_err_dtc /end AXIS_DESCR
/end CHARACTERISTIC
/begin CHARACTERISTIC fmy_id_crk_tooth_per.c_err_clas "Failure class number for failure XX" VALUE 0xa0803224 _REC_VAL_20_u1 255. _CNV_A_R_LINEAR_____0_CM 0. 255. DISPLAY_IDENTIFIER C_ERR_CLAS_CRK_TOOTH_PER FORMAT "%3.0" /end CHARACTERISTIC
/begin CHARACTERISTIC fmy_id_crk_syn.dtc "DTC table declaration for the diagnosis instance XX" MAP 0xa08031ec _REC_MAP_20_u2_u2_u2 65535. _CNV_A_R_LINEAR_____0_CM 0. 65535. DISPLAY_IDENTIFIER ID_ERR_DTC_CRK_SYN FORMAT "%5.0"
 /begin AXIS_DESCR COM_AXIS errm_online_dummy _CNV_S_2_ERRM_DTC_R_477_CM 1 0. 1. AXIS_PTS_REF ldp_nr_1_id_err_dtc /end AXIS_DESCR
 /begin AXIS_DESCR COM_AXIS errm_online_dummy _CNV_S_6_ERRM_DTC_R_478_CM 6 0. 5. AXIS_PTS_REF ldp_nr_2_id_err_dtc /end AXIS_DESCR
/end CHARACTERISTIC
/begin CHARACTERISTIC fmy_id_crk_syn.c_err_clas "Failure class number for failure XX" VALUE 0xa08031fc _REC_VAL_20_u1 255. _CNV_A_R_LINEAR_____0_CM 0. 255. DISPLAY_IDENTIFIER C_ERR_CLAS_CRK_SYN FORMAT "%3.0" /end CHARACTERISTIC
/begin CHARACTERISTIC fmy_id_crk_plaus.dtc "DTC table declaration for the diagnosis instance XX" MAP 0xa08031d8 _REC_MAP_20_u2_u2_u2 65535. _CNV_A_R_LINEAR_____0_CM 0. 65535. DISPLAY_IDENTIFIER ID_ERR_DTC_CRK_PLAUS FORMAT "%5.0"
 /begin AXIS_DESCR COM_AXIS errm_online_dummy _CNV_S_2_ERRM_DTC_R_477_CM 1 0. 1. AXIS_PTS_REF ldp_nr_1_id_err_dtc /end AXIS_DESCR
 /begin AXIS_DESCR COM_AXIS errm_online_dummy _CNV_S_6_ERRM_DTC_R_478_CM 6 0. 5. AXIS_PTS_REF ldp_nr_2_id_err_dtc /end AXIS_DESCR
/end CHARACTERISTIC
/begin CHARACTERISTIC fmy_id_crk_plaus.c_err_clas "Failure class number for failure XX" VALUE 0xa08031e8 _REC_VAL_20_u1 255. _CNV_A_R_LINEAR_____0_CM 0. 255. DISPLAY_IDENTIFIER C_ERR_CLAS_CRK_PLAUS FORMAT "%3.0" /end CHARACTERISTIC
/begin CHARACTERISTIC fmy_id_plaus_cam_in_1.dtc "DTC table declaration for the diagnosis instance XX" MAP 0xa08042f4 _REC_MAP_20_u2_u2_u2 65535. _CNV_A_R_LINEAR_____0_CM 0. 65535. DISPLAY_IDENTIFIER ID_ERR_DTC_PLAUS_CAM_IN_1 FORMAT "%5.0"
 /begin AXIS_DESCR COM_AXIS errm_online_dummy _CNV_S_2_ERRM_DTC_R_477_CM 1 0. 1. AXIS_PTS_REF ldp_nr_1_id_err_dtc /end AXIS_DESCR
 /begin AXIS_DESCR COM_AXIS errm_online_dummy _CNV_S_6_ERRM_DTC_R_478_CM 6 0. 5. AXIS_PTS_REF ldp_nr_2_id_err_dtc /end AXIS_DESCR
/end CHARACTERISTIC
/begin CHARACTERISTIC fmy_id_plaus_cam_in_1.c_err_clas "Failure class number for failure XX" VALUE 0xa0804304 _REC_VAL_20_u1 255. _CNV_A_R_LINEAR_____0_CM 0. 255. DISPLAY_IDENTIFIER C_ERR_CLAS_PLAUS_CAM_IN_1 FORMAT "%3.0" /end CHARACTERISTIC
/begin CHARACTERISTIC fmy_id_plaus_cam_ex_1.dtc "DTC table declaration for the diagnosis instance XX" MAP 0xa08042cc _REC_MAP_20_u2_u2_u2 65535. _CNV_A_R_LINEAR_____0_CM 0. 65535. DISPLAY_IDENTIFIER ID_ERR_DTC_PLAUS_CAM_EX_1 FORMAT "%5.0"
 /begin AXIS_DESCR COM_AXIS errm_online_dummy _CNV_S_2_ERRM_DTC_R_477_CM 1 0. 1. AXIS_PTS_REF ldp_nr_1_id_err_dtc /end AXIS_DESCR
 /begin AXIS_DESCR COM_AXIS errm_online_dummy _CNV_S_6_ERRM_DTC_R_478_CM 6 0. 5. AXIS_PTS_REF ldp_nr_2_id_err_dtc /end AXIS_DESCR
/end CHARACTERISTIC
/begin CHARACTERISTIC fmy_id_plaus_cam_ex_1.c_err_clas "Failure class number for failure XX" VALUE 0xa08042dc _REC_VAL_20_u1 255. _CNV_A_R_LINEAR_____0_CM 0. 255. DISPLAY_IDENTIFIER C_ERR_CLAS_PLAUS_CAM_EX_1 FORMAT "%3.0" /end CHARACTERISTIC
/begin CHARACTERISTIC fmy_id_syn_crk_cam_in_1.dtc "DTC table declaration for the diagnosis instance XX" MAP 0xa0804830 _REC_MAP_20_u2_u2_u2 65535. _CNV_A_R_LINEAR_____0_CM 0. 65535. DISPLAY_IDENTIFIER ID_ERR_DTC_SYN_CRK_CAM_IN_1 FORMAT "%5.0"
 /begin AXIS_DESCR COM_AXIS errm_online_dummy _CNV_S_2_ERRM_DTC_R_477_CM 1 0. 1. AXIS_PTS_REF ldp_nr_1_id_err_dtc /end AXIS_DESCR
 /begin AXIS_DESCR COM_AXIS errm_online_dummy _CNV_S_6_ERRM_DTC_R_478_CM 6 0. 5. AXIS_PTS_REF ldp_nr_2_id_err_dtc /end AXIS_DESCR
/end CHARACTERISTIC
/begin CHARACTERISTIC fmy_id_syn_crk_cam_in_1.c_err_clas "Failure class number for failure XX" VALUE 0xa0804840 _REC_VAL_20_u1 255. _CNV_A_R_LINEAR_____0_CM 0. 255. DISPLAY_IDENTIFIER C_ERR_CLAS_SYN_CRK_CAM_IN_1 FORMAT "%3.0" /end CHARACTERISTIC
/begin CHARACTERISTIC fmy_id_syn_crk_cam_ex_1.c_err_clas "Failure class number for failure XX" VALUE 0xa0804818 _REC_VAL_20_u1 255. _CNV_A_R_LINEAR_____0_CM 0. 255. DISPLAY_IDENTIFIER C_ERR_CLAS_SYN_CRK_CAM_EX_1 FORMAT "%3.0" /end CHARACTERISTIC
/begin CHARACTERISTIC fmy_id_tooth_off_in_1.c_err_clas "Failure class number for failure XX" VALUE 0xa0804aac _REC_VAL_20_u1 255. _CNV_A_R_LINEAR_____0_CM 0. 255. DISPLAY_IDENTIFIER C_ERR_CLAS_TOOTH_OFF_IN_1 FORMAT "%3.0" /end CHARACTERISTIC
/begin CHARACTERISTIC fmy_id_tooth_off_ex_1.c_err_clas "Failure class number for failure XX" VALUE 0xa0804a84 _REC_VAL_20_u1 255. _CNV_A_R_LINEAR_____0_CM 0. 255. DISPLAY_IDENTIFIER C_ERR_CLAS_TOOTH_OFF_EX_1 FORMAT "%3.0" /end CHARACTERISTIC
/begin CHARACTERISTIC fmy_id_plaus_cam_in_2.c_err_clas "Failure class number for failure XX" VALUE 0xa0804318 _REC_VAL_20_u1 255. _CNV_A_R_LINEAR_____0_CM 0. 255. DISPLAY_IDENTIFIER C_ERR_CLAS_PLAUS_CAM_IN_2 FORMAT "%3.0" /end CHARACTERISTIC
/begin CHARACTERISTIC fmy_id_plaus_cam_ex_2.c_err_clas "Failure class number for failure XX" VALUE 0xa08042f0 _REC_VAL_20_u1 255. _CNV_A_R_LINEAR_____0_CM 0. 255. DISPLAY_IDENTIFIER C_ERR_CLAS_PLAUS_CAM_EX_2 FORMAT "%3.0" /end CHARACTERISTIC
/begin CHARACTERISTIC fmy_id_syn_crk_cam_in_2.c_err_clas "Failure class number for failure XX" VALUE 0xa0804854 _REC_VAL_20_u1 255. _CNV_A_R_LINEAR_____0_CM 0. 255. DISPLAY_IDENTIFIER C_ERR_CLAS_SYN_CRK_CAM_IN_2 FORMAT "%3.0" /end CHARACTERISTIC
/begin CHARACTERISTIC fmy_id_syn_crk_cam_ex_2.c_err_clas "Failure class number for failure XX" VALUE 0xa080482c _REC_VAL_20_u1 255. _CNV_A_R_LINEAR_____0_CM 0. 255. DISPLAY_IDENTIFIER C_ERR_CLAS_SYN_CRK_CAM_EX_2 FORMAT "%3.0" /end CHARACTERISTIC
/begin CHARACTERISTIC fmy_id_tooth_off_in_2.c_err_clas "Failure class number for failure XX" VALUE 0xa0804ac0 _REC_VAL_20_u1 255. _CNV_A_R_LINEAR_____0_CM 0. 255. DISPLAY_IDENTIFIER C_ERR_CLAS_TOOTH_OFF_IN_2 FORMAT "%3.0" /end CHARACTERISTIC
/begin CHARACTERISTIC fmy_id_tooth_off_ex_2.c_err_clas "Failure class number for failure XX" VALUE 0xa0804a98 _REC_VAL_20_u1 255. _CNV_A_R_LINEAR_____0_CM 0. 255. DISPLAY_IDENTIFIER C_ERR_CLAS_TOOTH_OFF_EX_2 FORMAT "%3.0" /end CHARACTERISTIC
/begin CHARACTERISTIC fmy_id_can_boff.c_err_clas "Failure class number for failure XX" VALUE 0xa0802d4c _REC_VAL_20_u1 255. _CNV_A_R_LINEAR_____0_CM 0. 255. DISPLAY_IDENTIFIER C_ERR_CLAS_CAN_BOFF FORMAT "%3.0" /end CHARACTERISTIC
/begin CHARACTERISTIC fmy_id_rly_main.c_err_clas "Failure class number for failure XX" VALUE 0xa080455c _REC_VAL_20_u1 255. _CNV_A_R_LINEAR_____0_CM 0. 255. DISPLAY_IDENTIFIER C_ERR_CLAS_RLY_MAIN FORMAT "%3.0" /end CHARACTERISTIC
/begin CHARACTERISTIC fmy_id_rly_main_dly.c_err_clas "Failure class number for failure XX" VALUE 0xa0804570 _REC_VAL_20_u1 255. _CNV_A_R_LINEAR_____0_CM 0. 255. DISPLAY_IDENTIFIER C_ERR_CLAS_RLY_MAIN_DLY FORMAT "%3.0" /end CHARACTERISTIC
/begin CHARACTERISTIC fmy_id_rly_accout.c_err_clas "Failure class number for failure XX" VALUE 0xa0804534 _REC_VAL_20_u1 255. _CNV_A_R_LINEAR_____0_CM 0. 255. DISPLAY_IDENTIFIER C_ERR_CLAS_RLY_ACCOUT FORMAT "%3.0" /end CHARACTERISTIC
/begin CHARACTERISTIC fmy_id_isc.c_err_clas "Failure class number for failure XX" VALUE 0xa0803bc0 _REC_VAL_20_u1 255. _CNV_A_R_LINEAR_____0_CM 0. 255. DISPLAY_IDENTIFIER C_ERR_CLAS_ISC FORMAT "%3.0" /end CHARACTERISTIC
/begin CHARACTERISTIC fmy_id_isc_cst.c_err_clas "Failure class number for failure XX" VALUE 0xa0803bd4 _REC_VAL_20_u1 255. _CNV_A_R_LINEAR_____0_CM 0. 255. DISPLAY_IDENTIFIER C_ERR_CLAS_ISC_CST FORMAT "%3.0" /end CHARACTERISTIC
/begin CHARACTERISTIC fmy_id_im_bls_plaus.c_err_clas "Failure class number for failure XX" VALUE 0xa0803b48 _REC_VAL_20_u1 255. _CNV_A_R_LINEAR_____0_CM 0. 255. DISPLAY_IDENTIFIER C_ERR_CLAS_IM_BLS_PLAUS FORMAT "%3.0" /end CHARACTERISTIC
/begin CHARACTERISTIC fmy_id_im_bts_plaus.c_err_clas "Failure class number for failure XX" VALUE 0xa0803b5c _REC_VAL_20_u1 255. _CNV_A_R_LINEAR_____0_CM 0. 255. DISPLAY_IDENTIFIER C_ERR_CLAS_IM_BTS_PLAUS FORMAT "%3.0" /end CHARACTERISTIC
/begin CHARACTERISTIC fmy_id_msw_tog.c_err_clas "Failure class number for failure XX" VALUE 0xa08040c0 _REC_VAL_20_u1 255. _CNV_A_R_LINEAR_____0_CM 0. 255. DISPLAY_IDENTIFIER C_ERR_CLAS_MSW_TOG FORMAT "%3.0" /end CHARACTERISTIC
/begin CHARACTERISTIC fmy_id_msw_2.c_err_clas "Failure class number for failure XX" VALUE 0xa0804098 _REC_VAL_20_u1 255. _CNV_A_R_LINEAR_____0_CM 0. 255. DISPLAY_IDENTIFIER C_ERR_CLAS_MSW_2 FORMAT "%3.0" /end CHARACTERISTIC
/begin CHARACTERISTIC fmy_id_msw_3.c_err_clas "Failure class number for failure XX" VALUE 0xa08040ac _REC_VAL_20_u1 255. _CNV_A_R_LINEAR_____0_CM 0. 255. DISPLAY_IDENTIFIER C_ERR_CLAS_MSW_3 FORMAT "%3.0" /end CHARACTERISTIC
/begin CHARACTERISTIC fmy_id_mis_0.c_err_clas "Failure class number for failure XX" VALUE 0xa0803fbc _REC_VAL_20_u1 255. _CNV_A_R_LINEAR_____0_CM 0. 255. DISPLAY_IDENTIFIER C_ERR_CLAS_MIS_0 FORMAT "%3.0" /end CHARACTERISTIC
/begin CHARACTERISTIC fmy_id_mis_1.c_err_clas "Failure class number for failure XX" VALUE 0xa0803fd0 _REC_VAL_20_u1 255. _CNV_A_R_LINEAR_____0_CM 0. 255. DISPLAY_IDENTIFIER C_ERR_CLAS_MIS_1 FORMAT "%3.0" /end CHARACTERISTIC
/begin CHARACTERISTIC fmy_id_mis_2.c_err_clas "Failure class number for failure XX" VALUE 0xa0803fe4 _REC_VAL_20_u1 255. _CNV_A_R_LINEAR_____0_CM 0. 255. DISPLAY_IDENTIFIER C_ERR_CLAS_MIS_2 FORMAT "%3.0" /end CHARACTERISTIC
/begin CHARACTERISTIC fmy_id_mis_3.c_err_clas "Failure class number for failure XX" VALUE 0xa0803ff8 _REC_VAL_20_u1 255. _CNV_A_R_LINEAR_____0_CM 0. 255. DISPLAY_IDENTIFIER C_ERR_CLAS_MIS_3 FORMAT "%3.0" /end CHARACTERISTIC
/begin CHARACTERISTIC fmy_id_mis_4.c_err_clas "Failure class number for failure XX" VALUE 0xa080400c _REC_VAL_20_u1 255. _CNV_A_R_LINEAR_____0_CM 0. 255. DISPLAY_IDENTIFIER C_ERR_CLAS_MIS_4 FORMAT "%3.0" /end CHARACTERISTIC
/begin CHARACTERISTIC fmy_id_mis_5.c_err_clas "Failure class number for failure XX" VALUE 0xa0804020 _REC_VAL_20_u1 255. _CNV_A_R_LINEAR_____0_CM 0. 255. DISPLAY_IDENTIFIER C_ERR_CLAS_MIS_5 FORMAT "%3.0" /end CHARACTERISTIC
/begin CHARACTERISTIC fmy_id_mis_6.c_err_clas "Failure class number for failure XX" VALUE 0xa0804034 _REC_VAL_20_u1 255. _CNV_A_R_LINEAR_____0_CM 0. 255. DISPLAY_IDENTIFIER C_ERR_CLAS_MIS_6 FORMAT "%3.0" /end CHARACTERISTIC
/begin CHARACTERISTIC fmy_id_mis_7.c_err_clas "Failure class number for failure XX" VALUE 0xa0804048 _REC_VAL_20_u1 255. _CNV_A_R_LINEAR_____0_CM 0. 255. DISPLAY_IDENTIFIER C_ERR_CLAS_MIS_7 FORMAT "%3.0" /end CHARACTERISTIC
/begin CHARACTERISTIC fmy_id_mis_mpl.c_err_clas "Failure class number for failure XX" VALUE 0xa0804070 _REC_VAL_20_u1 255. _CNV_A_R_LINEAR_____0_CM 0. 255. DISPLAY_IDENTIFIER C_ERR_CLAS_MIS_MPL FORMAT "%3.0" /end CHARACTERISTIC
/begin CHARACTERISTIC fmy_id_mis_ftl_l.c_err_clas "Failure class number for failure XX" VALUE 0xa080405c _REC_VAL_20_u1 255. _CNV_A_R_LINEAR_____0_CM 0. 255. DISPLAY_IDENTIFIER C_ERR_CLAS_MIS_FTL_L FORMAT "%3.0" /end CHARACTERISTIC
/begin CHARACTERISTIC fmy_id_ef.c_err_clas "Failure class number for failure XX" VALUE 0xa0803648 _REC_VAL_20_u1 255. _CNV_A_R_LINEAR_____0_CM 0. 255. DISPLAY_IDENTIFIER C_ERR_CLAS_EF FORMAT "%3.0" /end CHARACTERISTIC
/begin CHARACTERISTIC fmy_id_tecu.c_err_clas "Failure class number for failure XX" VALUE 0xa08049a8 _REC_VAL_20_u1 255. _CNV_A_R_LINEAR_____0_CM 0. 255. DISPLAY_IDENTIFIER C_ERR_CLAS_TECU FORMAT "%3.0" /end CHARACTERISTIC
/begin CHARACTERISTIC fmy_id_ebox_cfa.c_err_clas "Failure class number for failure XX" VALUE 0xa0803544 _REC_VAL_20_u1 255. _CNV_A_R_LINEAR_____0_CM 0. 255. DISPLAY_IDENTIFIER C_ERR_CLAS_EBOX_CFA FORMAT "%3.0" /end CHARACTERISTIC
/begin CHARACTERISTIC fmy_id_ecu_ram.c_err_clas "Failure class number for failure XX" VALUE 0xa0803634 _REC_VAL_20_u1 255. _CNV_A_R_LINEAR_____0_CM 0. 255. DISPLAY_IDENTIFIER C_ERR_CLAS_ECU_RAM FORMAT "%3.0" /end CHARACTERISTIC
/begin CHARACTERISTIC fmy_id_tqi_lim.c_err_clas "Failure class number for failure XX" VALUE 0xa0804cc8 _REC_VAL_20_u1 255. _CNV_A_R_LINEAR_____0_CM 0. 255. DISPLAY_IDENTIFIER C_ERR_CLAS_TQI_LIM FORMAT "%3.0" /end CHARACTERISTIC
/begin CHARACTERISTIC fmy_id_dmtls.c_err_clas "Failure class number for failure XX" VALUE 0xa08034cc _REC_VAL_20_u1 255. _CNV_A_R_LINEAR_____0_CM 0. 255. DISPLAY_IDENTIFIER C_ERR_CLAS_DMTLS FORMAT "%3.0" /end CHARACTERISTIC
/begin CHARACTERISTIC fmy_id_dmtl_pump.c_err_clas "Failure class number for failure XX" VALUE 0xa0803490 _REC_VAL_20_u1 255. _CNV_A_R_LINEAR_____0_CM 0. 255. DISPLAY_IDENTIFIER C_ERR_CLAS_DMTL_PUMP FORMAT "%3.0" /end CHARACTERISTIC
/begin CHARACTERISTIC fmy_id_dmtlm.c_err_clas "Failure class number for failure XX" VALUE 0xa08034b8 _REC_VAL_20_u1 255. _CNV_A_R_LINEAR_____0_CM 0. 255. DISPLAY_IDENTIFIER C_ERR_CLAS_DMTLM FORMAT "%3.0" /end CHARACTERISTIC
/begin CHARACTERISTIC fmy_id_rough_leak.c_err_clas "Failure class number for failure XX" VALUE 0xa08045ac _REC_VAL_20_u1 255. _CNV_A_R_LINEAR_____0_CM 0. 255. DISPLAY_IDENTIFIER C_ERR_CLAS_ROUGH_LEAK FORMAT "%3.0" /end CHARACTERISTIC
/begin CHARACTERISTIC fmy_id_small_leak.c_err_clas "Failure class number for failure XX" VALUE 0xa0804728 _REC_VAL_20_u1 255. _CNV_A_R_LINEAR_____0_CM 0. 255. DISPLAY_IDENTIFIER C_ERR_CLAS_SMALL_LEAK FORMAT "%3.0" /end CHARACTERISTIC
/begin CHARACTERISTIC fmy_id_chk_fuc.c_err_clas "Failure class number for failure XX" VALUE 0xa0802dd8 _REC_VAL_20_u1 255. _CNV_A_R_LINEAR_____0_CM 0. 255. DISPLAY_IDENTIFIER C_ERR_CLAS_CHK_FUC FORMAT "%3.0" /end CHARACTERISTIC
/begin CHARACTERISTIC fmy_id_sof.c_err_clas "Failure class number for failure XX" VALUE 0xa080473c _REC_VAL_20_u1 255. _CNV_A_R_LINEAR_____0_CM 0. 255. DISPLAY_IDENTIFIER C_ERR_CLAS_SOF FORMAT "%3.0" /end CHARACTERISTIC
/begin CHARACTERISTIC fmy_id_sof_req.c_err_clas "Failure class number for failure XX" VALUE 0xa0804750 _REC_VAL_20_u1 255. _CNV_A_R_LINEAR_____0_CM 0. 255. DISPLAY_IDENTIFIER C_ERR_CLAS_SOF_REQ FORMAT "%3.0" /end CHARACTERISTIC
/begin CHARACTERISTIC fmy_id_rly_crcv_heat.c_err_clas "Failure class number for failure XX" VALUE 0xa0804548 _REC_VAL_20_u1 255. _CNV_A_R_LINEAR_____0_CM 0. 255. DISPLAY_IDENTIFIER C_ERR_CLAS_RLY_CRCV_HEAT FORMAT "%3.0" /end CHARACTERISTIC
/begin CHARACTERISTIC fmy_id_rly_st.c_err_clas "Failure class number for failure XX" VALUE 0xa0804584 _REC_VAL_20_u1 255. _CNV_A_R_LINEAR_____0_CM 0. 255. DISPLAY_IDENTIFIER C_ERR_CLAS_RLY_ST FORMAT "%3.0" /end CHARACTERISTIC
/begin CHARACTERISTIC fmy_id_bsd.c_err_clas "Failure class number for failure XX" VALUE 0xa0802d38 _REC_VAL_20_u1 255. _CNV_A_R_LINEAR_____0_CM 0. 255. DISPLAY_IDENTIFIER C_ERR_CLAS_BSD FORMAT "%3.0" /end CHARACTERISTIC
/begin CHARACTERISTIC fmy_id_poil_swi.c_err_clas "Failure class number for failure XX" VALUE 0xa0804354 _REC_VAL_20_u1 255. _CNV_A_R_LINEAR_____0_CM 0. 255. DISPLAY_IDENTIFIER C_ERR_CLAS_POIL_SWI FORMAT "%3.0" /end CHARACTERISTIC
/begin CHARACTERISTIC fmy_id_tout_efp_can.c_err_clas "Failure class number for failure XX" VALUE 0xa0804ad4 _REC_VAL_20_u1 255. _CNV_A_R_LINEAR_____0_CM 0. 255. DISPLAY_IDENTIFIER C_ERR_CLAS_TOUT_EFP_CAN FORMAT "%3.0" /end CHARACTERISTIC
/begin CHARACTERISTIC fmy_id_diagcps.c_err_clas "Failure class number for failure XX" VALUE 0xa080347c _REC_VAL_20_u1 255. _CNV_A_R_LINEAR_____0_CM 0. 255. DISPLAY_IDENTIFIER C_ERR_CLAS_DIAGCPS FORMAT "%3.0" /end CHARACTERISTIC
/begin CHARACTERISTIC fmy_id_dcc.c_err_clas "Failure class number for failure XX" VALUE 0xa0803440 _REC_VAL_20_u1 255. _CNV_A_R_LINEAR_____0_CM 0. 255. DISPLAY_IDENTIFIER C_ERR_CLAS_DCC FORMAT "%3.0" /end CHARACTERISTIC
/begin CHARACTERISTIC fmy_id_ldm.c_err_clas "Failure class number for failure XX" VALUE 0xa0803d8c _REC_VAL_20_u1 255. _CNV_A_R_LINEAR_____0_CM 0. 255. DISPLAY_IDENTIFIER C_ERR_CLAS_LDM FORMAT "%3.0" /end CHARACTERISTIC
/begin CHARACTERISTIC fmy_id_dmtlh.c_err_clas "Failure class number for failure XX" VALUE 0xa08034a4 _REC_VAL_20_u1 255. _CNV_A_R_LINEAR_____0_CM 0. 255. DISPLAY_IDENTIFIER C_ERR_CLAS_DMTLH FORMAT "%3.0" /end CHARACTERISTIC
/begin CHARACTERISTIC fmy_id_cs.c_err_clas "Failure class number for failure XX" VALUE 0xa080324c _REC_VAL_20_u1 255. _CNV_A_R_LINEAR_____0_CM 0. 255. DISPLAY_IDENTIFIER C_ERR_CLAS_CS FORMAT "%3.0" /end CHARACTERISTIC
/begin CHARACTERISTIC fmy_id_spi_mps.c_err_clas "Failure class number for failure XX" VALUE 0xa0804778 _REC_VAL_20_u1 255. _CNV_A_R_LINEAR_____0_CM 0. 255. DISPLAY_IDENTIFIER C_ERR_CLAS_SPI_MPS FORMAT "%3.0" /end CHARACTERISTIC
/begin CHARACTERISTIC fmy_id_spi_knk.c_err_clas "Failure class number for failure XX" VALUE 0xa0804764 _REC_VAL_20_u1 255. _CNV_A_R_LINEAR_____0_CM 0. 255. DISPLAY_IDENTIFIER C_ERR_CLAS_SPI_KNK FORMAT "%3.0" /end CHARACTERISTIC
/begin CHARACTERISTIC fmy_id_sens_poil.c_err_clas "Failure class number for failure XX" VALUE 0xa080464c _REC_VAL_20_u1 255. _CNV_A_R_LINEAR_____0_CM 0. 255. DISPLAY_IDENTIFIER C_ERR_CLAS_SENS_POIL FORMAT "%3.0" /end CHARACTERISTIC
/begin CHARACTERISTIC fmy_id_poil_dr.c_err_clas "Failure class number for failure XX" VALUE 0xa0804340 _REC_VAL_20_u1 255. _CNV_A_R_LINEAR_____0_CM 0. 255. DISPLAY_IDENTIFIER C_ERR_CLAS_POIL_DR FORMAT "%3.0" /end CHARACTERISTIC
/begin CHARACTERISTIC fmy_id_bn_tq_dcc.c_err_clas "Failure class number for failure XX" VALUE 0xa0802c98 _REC_VAL_20_u1 255. _CNV_A_R_LINEAR_____0_CM 0. 255. DISPLAY_IDENTIFIER C_ERR_CLAS_BN_TQ_DCC FORMAT "%3.0" /end CHARACTERISTIC
/begin CHARACTERISTIC fmy_id_bn_tq_pste_2.c_err_clas "Failure class number for failure XX" VALUE 0xa0802cc0 _REC_VAL_20_u1 255. _CNV_A_R_LINEAR_____0_CM 0. 255. DISPLAY_IDENTIFIER C_ERR_CLAS_BN_TQ_PSTE_2 FORMAT "%3.0" /end CHARACTERISTIC
/begin CHARACTERISTIC fmy_id_bn_tq_pste_3.c_err_clas "Failure class number for failure XX" VALUE 0xa0802cd4 _REC_VAL_20_u1 255. _CNV_A_R_LINEAR_____0_CM 0. 255. DISPLAY_IDENTIFIER C_ERR_CLAS_BN_TQ_PSTE_3 FORMAT "%3.0" /end CHARACTERISTIC
/begin CHARACTERISTIC fmy_id_bn_ars.c_err_clas "Failure class number for failure XX" VALUE 0xa0802ab8 _REC_VAL_20_u1 255. _CNV_A_R_LINEAR_____0_CM 0. 255. DISPLAY_IDENTIFIER C_ERR_CLAS_BN_ARS FORMAT "%3.0" /end CHARACTERISTIC
/begin CHARACTERISTIC fmy_id_bn_cas.c_err_clas "Failure class number for failure XX" VALUE 0xa0802acc _REC_VAL_20_u1 255. _CNV_A_R_LINEAR_____0_CM 0. 255. DISPLAY_IDENTIFIER C_ERR_CLAS_BN_CAS FORMAT "%3.0" /end CHARACTERISTIC
/begin CHARACTERISTIC fmy_id_bn_tq_tcs.c_err_clas "Failure class number for failure XX" VALUE 0xa0802ce8 _REC_VAL_20_u1 255. _CNV_A_R_LINEAR_____0_CM 0. 255. DISPLAY_IDENTIFIER C_ERR_CLAS_BN_TQ_TCS FORMAT "%3.0" /end CHARACTERISTIC
/begin CHARACTERISTIC fmy_id_bn_vs_tcs.c_err_clas "Failure class number for failure XX" VALUE 0xa0802d24 _REC_VAL_20_u1 255. _CNV_A_R_LINEAR_____0_CM 0. 255. DISPLAY_IDENTIFIER C_ERR_CLAS_BN_VS_TCS FORMAT "%3.0" /end CHARACTERISTIC
/begin CHARACTERISTIC fmy_id_bn_tcs.c_err_clas "Failure class number for failure XX" VALUE 0xa0802c70 _REC_VAL_20_u1 255. _CNV_A_R_LINEAR_____0_CM 0. 255. DISPLAY_IDENTIFIER C_ERR_CLAS_BN_TCS FORMAT "%3.0" /end CHARACTERISTIC
/begin CHARACTERISTIC fmy_id_bn_tq_etcu.c_err_clas "Failure class number for failure XX" VALUE 0xa0802cac _REC_VAL_20_u1 255. _CNV_A_R_LINEAR_____0_CM 0. 255. DISPLAY_IDENTIFIER C_ERR_CLAS_BN_TQ_ETCU FORMAT "%3.0" /end CHARACTERISTIC
/begin CHARACTERISTIC fmy_id_bn_etcu.c_err_clas "Failure class number for failure XX" VALUE 0xa0802b1c _REC_VAL_20_u1 255. _CNV_A_R_LINEAR_____0_CM 0. 255. DISPLAY_IDENTIFIER C_ERR_CLAS_BN_ETCU FORMAT "%3.0" /end CHARACTERISTIC
/begin CHARACTERISTIC fmy_id_bn_etcu_2.c_err_clas "Failure class number for failure XX" VALUE 0xa0802b30 _REC_VAL_20_u1 255. _CNV_A_R_LINEAR_____0_CM 0. 255. DISPLAY_IDENTIFIER C_ERR_CLAS_BN_ETCU_2 FORMAT "%3.0" /end CHARACTERISTIC
/begin CHARACTERISTIC fmy_id_bn_etcu_3.c_err_clas "Failure class number for failure XX" VALUE 0xa0802b44 _REC_VAL_20_u1 255. _CNV_A_R_LINEAR_____0_CM 0. 255. DISPLAY_IDENTIFIER C_ERR_CLAS_BN_ETCU_3 FORMAT "%3.0" /end CHARACTERISTIC
/begin CHARACTERISTIC fmy_id_bn_etcu_disp.c_err_clas "Failure class number for failure XX" VALUE 0xa0802b58 _REC_VAL_20_u1 255. _CNV_A_R_LINEAR_____0_CM 0. 255. DISPLAY_IDENTIFIER C_ERR_CLAS_BN_ETCU_DISP FORMAT "%3.0" /end CHARACTERISTIC
/begin CHARACTERISTIC fmy_id_bn_tq_amt.c_err_clas "Failure class number for failure XX" VALUE 0xa0802c84 _REC_VAL_20_u1 255. _CNV_A_R_LINEAR_____0_CM 0. 255. DISPLAY_IDENTIFIER C_ERR_CLAS_BN_TQ_AMT FORMAT "%3.0" /end CHARACTERISTIC
/begin CHARACTERISTIC fmy_id_bn_acc.c_err_clas "Failure class number for failure XX" VALUE 0xa0802a90 _REC_VAL_20_u1 255. _CNV_A_R_LINEAR_____0_CM 0. 255. DISPLAY_IDENTIFIER C_ERR_CLAS_BN_ACC FORMAT "%3.0" /end CHARACTERISTIC
/begin CHARACTERISTIC fmy_id_bn_t_icl.c_err_clas "Failure class number for failure XX" VALUE 0xa0802c5c _REC_VAL_20_u1 255. _CNV_A_R_LINEAR_____0_CM 0. 255. DISPLAY_IDENTIFIER C_ERR_CLAS_BN_T_ICL FORMAT "%3.0" /end CHARACTERISTIC
/begin CHARACTERISTIC fmy_id_bn_veh_mod.c_err_clas "Failure class number for failure XX" VALUE 0xa0802d10 _REC_VAL_20_u1 255. _CNV_A_R_LINEAR_____0_CM 0. 255. DISPLAY_IDENTIFIER C_ERR_CLAS_BN_VEH_MOD FORMAT "%3.0" /end CHARACTERISTIC
/begin CHARACTERISTIC fmy_id_bn_km_icl.c_err_clas "Failure class number for failure XX" VALUE 0xa0802ba8 _REC_VAL_20_u1 255. _CNV_A_R_LINEAR_____0_CM 0. 255. DISPLAY_IDENTIFIER C_ERR_CLAS_BN_KM_ICL FORMAT "%3.0" /end CHARACTERISTIC
/begin CHARACTERISTIC fmy_id_bn_icl.c_err_clas "Failure class number for failure XX" VALUE 0xa0802b94 _REC_VAL_20_u1 255. _CNV_A_R_LINEAR_____0_CM 0. 255. DISPLAY_IDENTIFIER C_ERR_CLAS_BN_ICL FORMAT "%3.0" /end CHARACTERISTIC
/begin CHARACTERISTIC fmy_id_bn_pow_vb.c_err_clas "Failure class number for failure XX" VALUE 0xa0802c20 _REC_VAL_20_u1 255. _CNV_A_R_LINEAR_____0_CM 0. 255. DISPLAY_IDENTIFIER C_ERR_CLAS_BN_POW_VB FORMAT "%3.0" /end CHARACTERISTIC
/begin CHARACTERISTIC fmy_id_bn_pow_gen.c_err_clas "Failure class number for failure XX" VALUE 0xa0802c0c _REC_VAL_20_u1 255. _CNV_A_R_LINEAR_____0_CM 0. 255. DISPLAY_IDENTIFIER C_ERR_CLAS_BN_POW_GEN FORMAT "%3.0" /end CHARACTERISTIC
/begin CHARACTERISTIC fmy_id_bn_msw.c_err_clas "Failure class number for failure XX" VALUE 0xa0802be4 _REC_VAL_20_u1 255. _CNV_A_R_LINEAR_____0_CM 0. 255. DISPLAY_IDENTIFIER C_ERR_CLAS_BN_MSW FORMAT "%3.0" /end CHARACTERISTIC
/begin CHARACTERISTIC fmy_id_bn_ang_pste.c_err_clas "Failure class number for failure XX" VALUE 0xa0802aa4 _REC_VAL_20_u1 255. _CNV_A_R_LINEAR_____0_CM 0. 255. DISPLAY_IDENTIFIER C_ERR_CLAS_BN_ANG_PSTE FORMAT "%3.0" /end CHARACTERISTIC
/begin CHARACTERISTIC fmy_id_bn_gear_rev.c_err_clas "Failure class number for failure XX" VALUE 0xa0802b6c _REC_VAL_20_u1 255. _CNV_A_R_LINEAR_____0_CM 0. 255. DISPLAY_IDENTIFIER C_ERR_CLAS_BN_GEAR_REV FORMAT "%3.0" /end CHARACTERISTIC
/begin CHARACTERISTIC fmy_id_bn_ltg_hdlp_l.c_err_clas "Failure class number for failure XX" VALUE 0xa0802bd0 _REC_VAL_20_u1 255. _CNV_A_R_LINEAR_____0_CM 0. 255. DISPLAY_IDENTIFIER C_ERR_CLAS_BN_LTG_HDLP_L FORMAT "%3.0" /end CHARACTERISTIC
/begin CHARACTERISTIC fmy_id_bn_ldm.c_err_clas "Failure class number for failure XX" VALUE 0xa0802bbc _REC_VAL_20_u1 255. _CNV_A_R_LINEAR_____0_CM 0. 255. DISPLAY_IDENTIFIER C_ERR_CLAS_BN_LDM FORMAT "%3.0" /end CHARACTERISTIC
/begin CHARACTERISTIC fmy_id_bn_trl.c_err_clas "Failure class number for failure XX" VALUE 0xa0802cfc _REC_VAL_20_u1 255. _CNV_A_R_LINEAR_____0_CM 0. 255. DISPLAY_IDENTIFIER C_ERR_CLAS_BN_TRL FORMAT "%3.0" /end CHARACTERISTIC
/begin CHARACTERISTIC fmy_id_bn_hiv.c_err_clas "Failure class number for failure XX" VALUE 0xa0802b80 _REC_VAL_20_u1 255. _CNV_A_R_LINEAR_____0_CM 0. 255. DISPLAY_IDENTIFIER C_ERR_CLAS_BN_HIV FORMAT "%3.0" /end CHARACTERISTIC
/begin CHARACTERISTIC fmy_id_bn_t_clk.c_err_clas "Failure class number for failure XX" VALUE 0xa0802c48 _REC_VAL_20_u1 255. _CNV_A_R_LINEAR_____0_CM 0. 255. DISPLAY_IDENTIFIER C_ERR_CLAS_BN_T_CLK FORMAT "%3.0" /end CHARACTERISTIC
/begin CHARACTERISTIC fmy_id_bn_efp_crash.c_err_clas "Failure class number for failure XX" VALUE 0xa0802b08 _REC_VAL_20_u1 255. _CNV_A_R_LINEAR_____0_CM 0. 255. DISPLAY_IDENTIFIER C_ERR_CLAS_BN_EFP_CRASH FORMAT "%3.0" /end CHARACTERISTIC
/begin CHARACTERISTIC fmy_id_bn_cdn_door.c_err_clas "Failure class number for failure XX" VALUE 0xa0802ae0 _REC_VAL_20_u1 255. _CNV_A_R_LINEAR_____0_CM 0. 255. DISPLAY_IDENTIFIER C_ERR_CLAS_BN_CDN_DOOR FORMAT "%3.0" /end CHARACTERISTIC
/begin CHARACTERISTIC fmy_id_bn_req_pbr.c_err_clas "Failure class number for failure XX" VALUE 0xa0802c34 _REC_VAL_20_u1 255. _CNV_A_R_LINEAR_____0_CM 0. 255. DISPLAY_IDENTIFIER C_ERR_CLAS_BN_REQ_PBR FORMAT "%3.0" /end CHARACTERISTIC
/begin CHARACTERISTIC fmy_id_bn_pbr.c_err_clas "Failure class number for failure XX" VALUE 0xa0802bf8 _REC_VAL_20_u1 255. _CNV_A_R_LINEAR_____0_CM 0. 255. DISPLAY_IDENTIFIER C_ERR_CLAS_BN_PBR FORMAT "%3.0" /end CHARACTERISTIC
/begin CHARACTERISTIC fmy_id_bn_efp.c_err_clas "Failure class number for failure XX" VALUE 0xa0802af4 _REC_VAL_20_u1 255. _CNV_A_R_LINEAR_____0_CM 0. 255. DISPLAY_IDENTIFIER C_ERR_CLAS_BN_EFP FORMAT "%3.0" /end CHARACTERISTIC
/begin CHARACTERISTIC fmy_id_load_tps_plaus.c_err_clas "Failure class number for failure XX" VALUE 0xa0803da0 _REC_VAL_20_u1 255. _CNV_A_R_LINEAR_____0_CM 0. 255. DISPLAY_IDENTIFIER C_ERR_CLAS_LOAD_TPS_PLAUS FORMAT "%3.0" /end CHARACTERISTIC
/begin CHARACTERISTIC fmy_id_egy_min.c_err_clas "Failure class number for failure XX" VALUE 0xa0803670 _REC_VAL_20_u1 255. _CNV_A_R_LINEAR_____0_CM 0. 255. DISPLAY_IDENTIFIER C_ERR_CLAS_EGY_MIN FORMAT "%3.0" /end CHARACTERISTIC
/begin CHARACTERISTIC fmy_id_locan_boff.c_err_clas "Failure class number for failure XX" VALUE 0xa0803db4 _REC_VAL_20_u1 255. _CNV_A_R_LINEAR_____0_CM 0. 255. DISPLAY_IDENTIFIER C_ERR_CLAS_LOCAN_BOFF FORMAT "%3.0" /end CHARACTERISTIC
/begin CHARACTERISTIC fmy_id_cwp_plaus.c_err_clas "Failure class number for failure XX" VALUE 0xa08032d8 _REC_VAL_20_u1 255. _CNV_A_R_LINEAR_____0_CM 0. 255. DISPLAY_IDENTIFIER C_ERR_CLAS_CWP_PLAUS FORMAT "%3.0" /end CHARACTERISTIC
/begin CHARACTERISTIC fmy_id_cwp_int_off.c_err_clas "Failure class number for failure XX" VALUE 0xa08032c4 _REC_VAL_20_u1 255. _CNV_A_R_LINEAR_____0_CM 0. 255. DISPLAY_IDENTIFIER C_ERR_CLAS_CWP_INT_OFF FORMAT "%3.0" /end CHARACTERISTIC
/begin CHARACTERISTIC fmy_id_cwp_pwr.c_err_clas "Failure class number for failure XX" VALUE 0xa08032ec _REC_VAL_20_u1 255. _CNV_A_R_LINEAR_____0_CM 0. 255. DISPLAY_IDENTIFIER C_ERR_CLAS_CWP_PWR FORMAT "%3.0" /end CHARACTERISTIC
/begin CHARACTERISTIC fmy_id_cwp_com_plaus.c_err_clas "Failure class number for failure XX" VALUE 0xa08032b0 _REC_VAL_20_u1 255. _CNV_A_R_LINEAR_____0_CM 0. 255. DISPLAY_IDENTIFIER C_ERR_CLAS_CWP_COM_PLAUS FORMAT "%3.0" /end CHARACTERISTIC
/begin CHARACTERISTIC fmy_id_qoil_sens.c_err_clas "Failure class number for failure XX" VALUE 0xa08044a8 _REC_VAL_20_u1 255. _CNV_A_R_LINEAR_____0_CM 0. 255. DISPLAY_IDENTIFIER C_ERR_CLAS_QOIL_SENS FORMAT "%3.0" /end CHARACTERISTIC
/begin CHARACTERISTIC fmy_id_bat_sens.c_err_clas "Failure class number for failure XX" VALUE 0xa0802a54 _REC_VAL_20_u1 255. _CNV_A_R_LINEAR_____0_CM 0. 255. DISPLAY_IDENTIFIER C_ERR_CLAS_BAT_SENS FORMAT "%3.0" /end CHARACTERISTIC
/begin CHARACTERISTIC fmy_id_bat_sens_it.c_err_clas "Failure class number for failure XX" VALUE 0xa0802a68 _REC_VAL_20_u1 255. _CNV_A_R_LINEAR_____0_CM 0. 255. DISPLAY_IDENTIFIER C_ERR_CLAS_BAT_SENS_IT FORMAT "%3.0" /end CHARACTERISTIC
/begin CHARACTERISTIC fmy_id_bat_sens_it_el.c_err_clas "Failure class number for failure XX" VALUE 0xa0802a7c _REC_VAL_20_u1 255. _CNV_A_R_LINEAR_____0_CM 0. 255. DISPLAY_IDENTIFIER C_ERR_CLAS_BAT_SENS_IT_EL FORMAT "%3.0" /end CHARACTERISTIC
/begin CHARACTERISTIC fmy_id_ecu_nvmy.c_err_clas "Failure class number for failure XX" VALUE 0xa0803620 _REC_VAL_20_u1 255. _CNV_A_R_LINEAR_____0_CM 0. 255. DISPLAY_IDENTIFIER C_ERR_CLAS_ECU_NVMY FORMAT "%3.0" /end CHARACTERISTIC
/begin CHARACTERISTIC fmy_id_gs.c_err_clas "Failure class number for failure XX" VALUE 0xa0803940 _REC_VAL_20_u1 255. _CNV_A_R_LINEAR_____0_CM 0. 255. DISPLAY_IDENTIFIER C_ERR_CLAS_GS FORMAT "%3.0" /end CHARACTERISTIC
/begin CHARACTERISTIC fmy_id_plaus_igk_bn.c_err_clas "Failure class number for failure XX" VALUE 0xa080432c _REC_VAL_20_u1 255. _CNV_A_R_LINEAR_____0_CM 0. 255. DISPLAY_IDENTIFIER C_ERR_CLAS_PLAUS_IGK_BN FORMAT "%3.0" /end CHARACTERISTIC
/begin CHARACTERISTIC fmy_id_tq_req_can.c_err_clas "Failure class number for failure XX" VALUE 0xa0804c8c _REC_VAL_20_u1 255. _CNV_A_R_LINEAR_____0_CM 0. 255. DISPLAY_IDENTIFIER C_ERR_CLAS_TQ_REQ_CAN FORMAT "%3.0" /end CHARACTERISTIC
/begin CHARACTERISTIC fmy_id_map_sens_1.c_err_clas "Failure class number for failure XX" VALUE 0xa0803f1c _REC_VAL_20_u1 255. _CNV_A_R_LINEAR_____0_CM 0. 255. DISPLAY_IDENTIFIER C_ERR_CLAS_MAP_SENS_1 FORMAT "%3.0" /end CHARACTERISTIC
/begin CHARACTERISTIC fmy_id_map_sens_2.c_err_clas "Failure class number for failure XX" VALUE 0xa0803f30 _REC_VAL_20_u1 255. _CNV_A_R_LINEAR_____0_CM 0. 255. DISPLAY_IDENTIFIER C_ERR_CLAS_MAP_SENS_2 FORMAT "%3.0" /end CHARACTERISTIC
/begin CHARACTERISTIC fmy_id_dtc_trm.c_err_clas "Failure class number for failure XX" VALUE 0xa08034f4 _REC_VAL_20_u1 255. _CNV_A_R_LINEAR_____0_CM 0. 255. DISPLAY_IDENTIFIER C_ERR_CLAS_DTC_TRM FORMAT "%3.0" /end CHARACTERISTIC
/begin CHARACTERISTIC fmy_id_mec_ivvt_in_1.c_err_clas "Failure class number for failure XX" VALUE 0xa0803f80 _REC_VAL_20_u1 255. _CNV_A_R_LINEAR_____0_CM 0. 255. DISPLAY_IDENTIFIER C_ERR_CLAS_MEC_IVVT_IN_1 FORMAT "%3.0" /end CHARACTERISTIC
/begin CHARACTERISTIC fmy_id_mec_ivvt_in_2.c_err_clas "Failure class number for failure XX" VALUE 0xa0803f94 _REC_VAL_20_u1 255. _CNV_A_R_LINEAR_____0_CM 0. 255. DISPLAY_IDENTIFIER C_ERR_CLAS_MEC_IVVT_IN_2 FORMAT "%3.0" /end CHARACTERISTIC
/begin CHARACTERISTIC fmy_id_mec_ivvt_ex.c_err_clas "Failure class number for failure XX" VALUE 0xa0803f6c _REC_VAL_20_u1 255. _CNV_A_R_LINEAR_____0_CM 0. 255. DISPLAY_IDENTIFIER C_ERR_CLAS_MEC_IVVT_EX FORMAT "%3.0" /end CHARACTERISTIC
/begin CHARACTERISTIC fmy_id_tout_nox_sens_1.c_err_clas "Failure class number for failure XX" VALUE 0xa0804ae8 _REC_VAL_20_u1 255. _CNV_A_R_LINEAR_____0_CM 0. 255. DISPLAY_IDENTIFIER C_ERR_CLAS_TOUT_NOX_SENS_1 FORMAT "%3.0" /end CHARACTERISTIC
/begin CHARACTERISTIC fmy_id_tout_nox_sens_2.c_err_clas "Failure class number for failure XX" VALUE 0xa0804afc _REC_VAL_20_u1 255. _CNV_A_R_LINEAR_____0_CM 0. 255. DISPLAY_IDENTIFIER C_ERR_CLAS_TOUT_NOX_SENS_2 FORMAT "%3.0" /end CHARACTERISTIC
/begin CHARACTERISTIC fmy_id_vvl_rot.c_err_clas "Failure class number for failure XX" VALUE 0xa0804de0 _REC_VAL_20_u1 255. _CNV_A_R_LINEAR_____0_CM 0. 255. DISPLAY_IDENTIFIER C_ERR_CLAS_VVL_ROT FORMAT "%3.0" /end CHARACTERISTIC
/begin CHARACTERISTIC fmy_id_rly_vvl.c_err_clas "Failure class number for failure XX" VALUE 0xa0804598 _REC_VAL_20_u1 255. _CNV_A_R_LINEAR_____0_CM 0. 255. DISPLAY_IDENTIFIER C_ERR_CLAS_RLY_VVL FORMAT "%3.0" /end CHARACTERISTIC
/begin CHARACTERISTIC fmy_id_nox_sens_1.c_err_clas "Failure class number for failure XX" VALUE 0xa0804110 _REC_VAL_20_u1 255. _CNV_A_R_LINEAR_____0_CM 0. 255. DISPLAY_IDENTIFIER C_ERR_CLAS_NOX_SENS_1 FORMAT "%3.0" /end CHARACTERISTIC
/begin CHARACTERISTIC fmy_id_ns_obd_1_1.c_err_clas "Failure class number for failure XX" VALUE 0xa0804138 _REC_VAL_20_u1 255. _CNV_A_R_LINEAR_____0_CM 0. 255. DISPLAY_IDENTIFIER C_ERR_CLAS_NS_OBD_1_1 FORMAT "%3.0" /end CHARACTERISTIC
/begin CHARACTERISTIC fmy_id_ns_obd_1_2.c_err_clas "Failure class number for failure XX" VALUE 0xa080414c _REC_VAL_20_u1 255. _CNV_A_R_LINEAR_____0_CM 0. 255. DISPLAY_IDENTIFIER C_ERR_CLAS_NS_OBD_1_2 FORMAT "%3.0" /end CHARACTERISTIC
/begin CHARACTERISTIC fmy_id_ovl_ecu_vvl.c_err_clas "Failure class number for failure XX" VALUE 0xa0804228 _REC_VAL_20_u1 255. _CNV_A_R_LINEAR_____0_CM 0. 255. DISPLAY_IDENTIFIER C_ERR_CLAS_OVL_ECU_VVL FORMAT "%3.0" /end CHARACTERISTIC
/begin CHARACTERISTIC fmy_id_dr_sc_vvl.c_err_clas "Failure class number for failure XX" VALUE 0xa08034e0 _REC_VAL_20_u1 255. _CNV_A_R_LINEAR_____0_CM 0. 255. DISPLAY_IDENTIFIER C_ERR_CLAS_DR_SC_VVL FORMAT "%3.0" /end CHARACTERISTIC
/begin CHARACTERISTIC fmy_id_crit_ovl_ecu_vvl.c_err_clas "Failure class number for failure XX" VALUE 0xa08031d4 _REC_VAL_20_u1 255. _CNV_A_R_LINEAR_____0_CM 0. 255. DISPLAY_IDENTIFIER C_ERR_CLAS_CRIT_OVL_ECU_VVL FORMAT "%3.0" /end CHARACTERISTIC
/begin CHARACTERISTIC fmy_id_nox_sens_2.c_err_clas "Failure class number for failure XX" VALUE 0xa0804124 _REC_VAL_20_u1 255. _CNV_A_R_LINEAR_____0_CM 0. 255. DISPLAY_IDENTIFIER C_ERR_CLAS_NOX_SENS_2 FORMAT "%3.0" /end CHARACTERISTIC
/begin CHARACTERISTIC fmy_id_cur_h_vvl.c_err_clas "Failure class number for failure XX" VALUE 0xa0803288 _REC_VAL_20_u1 255. _CNV_A_R_LINEAR_____0_CM 0. 255. DISPLAY_IDENTIFIER C_ERR_CLAS_CUR_H_VVL FORMAT "%3.0" /end CHARACTERISTIC
/begin CHARACTERISTIC fmy_id_teg_pcat_down.c_err_clas "Failure class number for failure XX" VALUE 0xa08049bc _REC_VAL_20_u1 255. _CNV_A_R_LINEAR_____0_CM 0. 255. DISPLAY_IDENTIFIER C_ERR_CLAS_TEG_PCAT_DOWN FORMAT "%3.0" /end CHARACTERISTIC
/begin CHARACTERISTIC fmy_id_t_seg_er.c_err_clas "Failure class number for failure XX" VALUE 0xa080487c _REC_VAL_20_u1 255. _CNV_A_R_LINEAR_____0_CM 0. 255. DISPLAY_IDENTIFIER C_ERR_CLAS_T_SEG_ER FORMAT "%3.0" /end CHARACTERISTIC
/begin CHARACTERISTIC fmy_id_seg_ad_er.c_err_clas "Failure class number for failure XX" VALUE 0xa0804610 _REC_VAL_20_u1 255. _CNV_A_R_LINEAR_____0_CM 0. 255. DISPLAY_IDENTIFIER C_ERR_CLAS_SEG_AD_ER FORMAT "%3.0" /end CHARACTERISTIC
/begin CHARACTERISTIC fmy_id_vs_plaus.c_err_clas "Failure class number for failure XX" VALUE 0xa0804dcc _REC_VAL_20_u1 255. _CNV_A_R_LINEAR_____0_CM 0. 255. DISPLAY_IDENTIFIER C_ERR_CLAS_VS_PLAUS FORMAT "%3.0" /end CHARACTERISTIC
/begin CHARACTERISTIC fmy_id_ftl_obd.c_err_clas "Failure class number for failure XX" VALUE 0xa0803800 _REC_VAL_20_u1 255. _CNV_A_R_LINEAR_____0_CM 0. 255. DISPLAY_IDENTIFIER C_ERR_CLAS_FTL_OBD FORMAT "%3.0" /end CHARACTERISTIC
/begin CHARACTERISTIC fmy_id_ftl_le_can.c_err_clas "Failure class number for failure XX" VALUE 0xa08037d8 _REC_VAL_20_u1 255. _CNV_A_R_LINEAR_____0_CM 0. 255. DISPLAY_IDENTIFIER C_ERR_CLAS_FTL_LE_CAN FORMAT "%3.0" /end CHARACTERISTIC
/begin CHARACTERISTIC fmy_id_ftl_ri_can.c_err_clas "Failure class number for failure XX" VALUE 0xa0803814 _REC_VAL_20_u1 255. _CNV_A_R_LINEAR_____0_CM 0. 255. DISPLAY_IDENTIFIER C_ERR_CLAS_FTL_RI_CAN FORMAT "%3.0" /end CHARACTERISTIC
/begin CHARACTERISTIC fmy_id_tia_plaus.c_err_clas "Failure class number for failure XX" VALUE 0xa0804a34 _REC_VAL_20_u1 255. _CNV_A_R_LINEAR_____0_CM 0. 255. DISPLAY_IDENTIFIER C_ERR_CLAS_TIA_PLAUS FORMAT "%3.0" /end CHARACTERISTIC
/begin CHARACTERISTIC fmy_id_tam_can.c_err_clas "Failure class number for failure XX" VALUE 0xa0804890 _REC_VAL_20_u1 255. _CNV_A_R_LINEAR_____0_CM 0. 255. DISPLAY_IDENTIFIER C_ERR_CLAS_TAM_CAN FORMAT "%3.0" /end CHARACTERISTIC
/begin CHARACTERISTIC fmy_id_tam_plaus.c_err_clas "Failure class number for failure XX" VALUE 0xa08048a4 _REC_VAL_20_u1 255. _CNV_A_R_LINEAR_____0_CM 0. 255. DISPLAY_IDENTIFIER C_ERR_CLAS_TAM_PLAUS FORMAT "%3.0" /end CHARACTERISTIC
/begin CHARACTERISTIC fmy_id_map_shift_1.c_err_clas "Failure class number for failure XX" VALUE 0xa0803f44 _REC_VAL_20_u1 255. _CNV_A_R_LINEAR_____0_CM 0. 255. DISPLAY_IDENTIFIER C_ERR_CLAS_MAP_SHIFT_1 FORMAT "%3.0" /end CHARACTERISTIC
/begin CHARACTERISTIC fmy_id_map_shift_2.c_err_clas "Failure class number for failure XX" VALUE 0xa0803f58 _REC_VAL_20_u1 255. _CNV_A_R_LINEAR_____0_CM 0. 255. DISPLAY_IDENTIFIER C_ERR_CLAS_MAP_SHIFT_2 FORMAT "%3.0" /end CHARACTERISTIC
/begin CHARACTERISTIC fmy_id_cat_diag_1.c_err_clas "Failure class number for failure XX" VALUE 0xa0802d60 _REC_VAL_20_u1 255. _CNV_A_R_LINEAR_____0_CM 0. 255. DISPLAY_IDENTIFIER C_ERR_CLAS_CAT_DIAG_1 FORMAT "%3.0" /end CHARACTERISTIC
/begin CHARACTERISTIC fmy_id_cat_diag_2.c_err_clas "Failure class number for failure XX" VALUE 0xa0802d74 _REC_VAL_20_u1 255. _CNV_A_R_LINEAR_____0_CM 0. 255. DISPLAY_IDENTIFIER C_ERR_CLAS_CAT_DIAG_2 FORMAT "%3.0" /end CHARACTERISTIC
/begin CHARACTERISTIC fmy_id_cat_diag_afl_1.c_err_clas "Failure class number for failure XX" VALUE 0xa0802d88 _REC_VAL_20_u1 255. _CNV_A_R_LINEAR_____0_CM 0. 255. DISPLAY_IDENTIFIER C_ERR_CLAS_CAT_DIAG_AFL_1 FORMAT "%3.0" /end CHARACTERISTIC
/begin CHARACTERISTIC fmy_id_cat_diag_afl_2.c_err_clas "Failure class number for failure XX" VALUE 0xa0802d9c _REC_VAL_20_u1 255. _CNV_A_R_LINEAR_____0_CM 0. 255. DISPLAY_IDENTIFIER C_ERR_CLAS_CAT_DIAG_AFL_2 FORMAT "%3.0" /end CHARACTERISTIC
/begin CHARACTERISTIC fmy_id_scg_ls_down_1.c_err_clas "Failure class number for failure XX" VALUE 0xa08045c0 _REC_VAL_20_u1 255. _CNV_A_R_LINEAR_____0_CM 0. 255. DISPLAY_IDENTIFIER C_ERR_CLAS_SCG_LS_DOWN_1 FORMAT "%3.0" /end CHARACTERISTIC
/begin CHARACTERISTIC fmy_id_scp_ls_down_1.c_err_clas "Failure class number for failure XX" VALUE 0xa08045e8 _REC_VAL_20_u1 255. _CNV_A_R_LINEAR_____0_CM 0. 255. DISPLAY_IDENTIFIER C_ERR_CLAS_SCP_LS_DOWN_1 FORMAT "%3.0" /end CHARACTERISTIC
/begin CHARACTERISTIC fmy_id_oc_ls_down_1.c_err_clas "Failure class number for failure XX" VALUE 0xa08041b0 _REC_VAL_20_u1 255. _CNV_A_R_LINEAR_____0_CM 0. 255. DISPLAY_IDENTIFIER C_ERR_CLAS_OC_LS_DOWN_1 FORMAT "%3.0" /end CHARACTERISTIC
/begin CHARACTERISTIC fmy_id_puc_ls_down_1.c_err_clas "Failure class number for failure XX" VALUE 0xa0804368 _REC_VAL_20_u1 255. _CNV_A_R_LINEAR_____0_CM 0. 255. DISPLAY_IDENTIFIER C_ERR_CLAS_PUC_LS_DOWN_1 FORMAT "%3.0" /end CHARACTERISTIC
/begin CHARACTERISTIC fmy_id_fl_ls_down_1.c_err_clas "Failure class number for failure XX" VALUE 0xa0803738 _REC_VAL_20_u1 255. _CNV_A_R_LINEAR_____0_CM 0. 255. DISPLAY_IDENTIFIER C_ERR_CLAS_FL_LS_DOWN_1 FORMAT "%3.0" /end CHARACTERISTIC
/begin CHARACTERISTIC fmy_id_lsl_up_if_1.c_err_clas "Failure class number for failure XX" VALUE 0xa0803e40 _REC_VAL_20_u1 255. _CNV_A_R_LINEAR_____0_CM 0. 255. DISPLAY_IDENTIFIER C_ERR_CLAS_LSL_UP_IF_1 FORMAT "%3.0" /end CHARACTERISTIC
/begin CHARACTERISTIC fmy_id_el_lsl_up_1.c_err_clas "Failure class number for failure XX" VALUE 0xa0803698 _REC_VAL_20_u1 255. _CNV_A_R_LINEAR_____0_CM 0. 255. DISPLAY_IDENTIFIER C_ERR_CLAS_EL_LSL_UP_1 FORMAT "%3.0" /end CHARACTERISTIC
/begin CHARACTERISTIC fmy_id_lsh_up_1.c_err_clas "Failure class number for failure XX" VALUE 0xa0803e18 _REC_VAL_20_u1 255. _CNV_A_R_LINEAR_____0_CM 0. 255. DISPLAY_IDENTIFIER C_ERR_CLAS_LSH_UP_1 FORMAT "%3.0" /end CHARACTERISTIC
/begin CHARACTERISTIC fmy_id_lsh_down_1.c_err_clas "Failure class number for failure XX" VALUE 0xa0803dc8 _REC_VAL_20_u1 255. _CNV_A_R_LINEAR_____0_CM 0. 255. DISPLAY_IDENTIFIER C_ERR_CLAS_LSH_DOWN_1 FORMAT "%3.0" /end CHARACTERISTIC
/begin CHARACTERISTIC fmy_id_vls_down_dif_1.c_err_clas "Failure class number for failure XX" VALUE 0xa0804d90 _REC_VAL_20_u1 255. _CNV_A_R_LINEAR_____0_CM 0. 255. DISPLAY_IDENTIFIER C_ERR_CLAS_VLS_DOWN_DIF_1 FORMAT "%3.0" /end CHARACTERISTIC
/begin CHARACTERISTIC fmy_id_lsh_lsl_up_1.c_err_clas "Failure class number for failure XX" VALUE 0xa0803df0 _REC_VAL_20_u1 255. _CNV_A_R_LINEAR_____0_CM 0. 255. DISPLAY_IDENTIFIER C_ERR_CLAS_LSH_LSL_UP_1 FORMAT "%3.0" /end CHARACTERISTIC
/begin CHARACTERISTIC fmy_id_air_lsl_up_1.c_err_clas "Failure class number for failure XX" VALUE 0xa08029a0 _REC_VAL_20_u1 255. _CNV_A_R_LINEAR_____0_CM 0. 255. DISPLAY_IDENTIFIER C_ERR_CLAS_AIR_LSL_UP_1 FORMAT "%3.0" /end CHARACTERISTIC
/begin CHARACTERISTIC fmy_id_pue_ls_down_1.c_err_clas "Failure class number for failure XX" VALUE 0xa08043b8 _REC_VAL_20_u1 255. _CNV_A_R_LINEAR_____0_CM 0. 255. DISPLAY_IDENTIFIER C_ERR_CLAS_PUE_LS_DOWN_1 FORMAT "%3.0" /end CHARACTERISTIC
/begin CHARACTERISTIC fmy_id_swt_ls_down_1.c_err_clas "Failure class number for failure XX" VALUE 0xa08047a0 _REC_VAL_20_u1 255. _CNV_A_R_LINEAR_____0_CM 0. 255. DISPLAY_IDENTIFIER C_ERR_CLAS_SWT_LS_DOWN_1 FORMAT "%3.0" /end CHARACTERISTIC
/begin CHARACTERISTIC fmy_id_obd_lsh_down_1.c_err_clas "Failure class number for failure XX" VALUE 0xa0804160 _REC_VAL_20_u1 255. _CNV_A_R_LINEAR_____0_CM 0. 255. DISPLAY_IDENTIFIER C_ERR_CLAS_OBD_LSH_DOWN_1 FORMAT "%3.0" /end CHARACTERISTIC
/begin CHARACTERISTIC fmy_id_dyn_vld_ls_up_1.c_err_clas "Failure class number for failure XX" VALUE 0xa080351c _REC_VAL_20_u1 255. _CNV_A_R_LINEAR_____0_CM 0. 255. DISPLAY_IDENTIFIER C_ERR_CLAS_DYN_VLD_LS_UP_1 FORMAT "%3.0" /end CHARACTERISTIC
/begin CHARACTERISTIC fmy_id_puc_vld_ls_up_1.c_err_clas "Failure class number for failure XX" VALUE 0xa0804390 _REC_VAL_20_u1 255. _CNV_A_R_LINEAR_____0_CM 0. 255. DISPLAY_IDENTIFIER C_ERR_CLAS_PUC_VLD_LS_UP_1 FORMAT "%3.0" /end CHARACTERISTIC
/begin CHARACTERISTIC fmy_id_obd_vld_lsh_up_1.c_err_clas "Failure class number for failure XX" VALUE 0xa0804188 _REC_VAL_20_u1 255. _CNV_A_R_LINEAR_____0_CM 0. 255. DISPLAY_IDENTIFIER C_ERR_CLAS_OBD_VLD_LSH_UP_1 FORMAT "%3.0" /end CHARACTERISTIC
/begin CHARACTERISTIC fmy_id_chk_ls_down_1.c_err_clas "Failure class number for failure XX" VALUE 0xa0802dec _REC_VAL_20_u1 255. _CNV_A_R_LINEAR_____0_CM 0. 255. DISPLAY_IDENTIFIER C_ERR_CLAS_CHK_LS_DOWN_1 FORMAT "%3.0" /end CHARACTERISTIC
/begin CHARACTERISTIC fmy_id_shift_afl_lsl_up_1.c_err_clas "Failure class number for failure XX" VALUE 0xa0804660 _REC_VAL_20_u1 255. _CNV_A_R_LINEAR_____0_CM 0. 255. DISPLAY_IDENTIFIER C_ERR_CLAS_SHIFT_AFL_LSL_UP_1 FORMAT "%3.0" /end CHARACTERISTIC
/begin CHARACTERISTIC fmy_id_shift_afr_lsl_up_1.c_err_clas "Failure class number for failure XX" VALUE 0xa0804688 _REC_VAL_20_u1 255. _CNV_A_R_LINEAR_____0_CM 0. 255. DISPLAY_IDENTIFIER C_ERR_CLAS_SHIFT_AFR_LSL_UP_1 FORMAT "%3.0" /end CHARACTERISTIC
/begin CHARACTERISTIC fmy_id_oc_lsl_up_1.c_err_clas "Failure class number for failure XX" VALUE 0xa08041d8 _REC_VAL_20_u1 255. _CNV_A_R_LINEAR_____0_CM 0. 255. DISPLAY_IDENTIFIER C_ERR_CLAS_OC_LSL_UP_1 FORMAT "%3.0" /end CHARACTERISTIC
/begin CHARACTERISTIC fmy_id_delta_i_lam_1.c_err_clas "Failure class number for failure XX" VALUE 0xa0803454 _REC_VAL_20_u1 255. _CNV_A_R_LINEAR_____0_CM 0. 255. DISPLAY_IDENTIFIER C_ERR_CLAS_DELTA_I_LAM_1 FORMAT "%3.0" /end CHARACTERISTIC
/begin CHARACTERISTIC fmy_id_ofs_lsl_up_1.c_err_clas "Failure class number for failure XX" VALUE 0xa0804200 _REC_VAL_20_u1 255. _CNV_A_R_LINEAR_____0_CM 0. 255. DISPLAY_IDENTIFIER C_ERR_CLAS_OFS_LSL_UP_1 FORMAT "%3.0" /end CHARACTERISTIC
/begin CHARACTERISTIC fmy_id_ttip_mes_lsh_up_1.c_err_clas "Failure class number for failure XX" VALUE 0xa0804cf0 _REC_VAL_20_u1 255. _CNV_A_R_LINEAR_____0_CM 0. 255. DISPLAY_IDENTIFIER C_ERR_CLAS_TTIP_MES_LSH_UP_1 FORMAT "%3.0" /end CHARACTERISTIC
/begin CHARACTERISTIC fmy_id_ctl_lsl_up_1.c_err_clas "Failure class number for failure XX" VALUE 0xa0803260 _REC_VAL_20_u1 255. _CNV_A_R_LINEAR_____0_CM 0. 255. DISPLAY_IDENTIFIER C_ERR_CLAS_CTL_LSL_UP_1 FORMAT "%3.0" /end CHARACTERISTIC
/begin CHARACTERISTIC fmy_id_chg_ls_down.c_err_clas "Failure class number for failure XX" VALUE 0xa0802db0 _REC_VAL_20_u1 255. _CNV_A_R_LINEAR_____0_CM 0. 255. DISPLAY_IDENTIFIER C_ERR_CLAS_CHG_LS_DOWN FORMAT "%3.0" /end CHARACTERISTIC
/begin CHARACTERISTIC fmy_id_scg_ls_down_2.c_err_clas "Failure class number for failure XX" VALUE 0xa08045d4 _REC_VAL_20_u1 255. _CNV_A_R_LINEAR_____0_CM 0. 255. DISPLAY_IDENTIFIER C_ERR_CLAS_SCG_LS_DOWN_2 FORMAT "%3.0" /end CHARACTERISTIC
/begin CHARACTERISTIC fmy_id_scp_ls_down_2.c_err_clas "Failure class number for failure XX" VALUE 0xa08045fc _REC_VAL_20_u1 255. _CNV_A_R_LINEAR_____0_CM 0. 255. DISPLAY_IDENTIFIER C_ERR_CLAS_SCP_LS_DOWN_2 FORMAT "%3.0" /end CHARACTERISTIC
/begin CHARACTERISTIC fmy_id_oc_ls_down_2.c_err_clas "Failure class number for failure XX" VALUE 0xa08041c4 _REC_VAL_20_u1 255. _CNV_A_R_LINEAR_____0_CM 0. 255. DISPLAY_IDENTIFIER C_ERR_CLAS_OC_LS_DOWN_2 FORMAT "%3.0" /end CHARACTERISTIC
/begin CHARACTERISTIC fmy_id_puc_ls_down_2.c_err_clas "Failure class number for failure XX" VALUE 0xa080437c _REC_VAL_20_u1 255. _CNV_A_R_LINEAR_____0_CM 0. 255. DISPLAY_IDENTIFIER C_ERR_CLAS_PUC_LS_DOWN_2 FORMAT "%3.0" /end CHARACTERISTIC
/begin CHARACTERISTIC fmy_id_fl_ls_down_2.c_err_clas "Failure class number for failure XX" VALUE 0xa080374c _REC_VAL_20_u1 255. _CNV_A_R_LINEAR_____0_CM 0. 255. DISPLAY_IDENTIFIER C_ERR_CLAS_FL_LS_DOWN_2 FORMAT "%3.0" /end CHARACTERISTIC
/begin CHARACTERISTIC fmy_id_lsl_up_if_2.c_err_clas "Failure class number for failure XX" VALUE 0xa0803e54 _REC_VAL_20_u1 255. _CNV_A_R_LINEAR_____0_CM 0. 255. DISPLAY_IDENTIFIER C_ERR_CLAS_LSL_UP_IF_2 FORMAT "%3.0" /end CHARACTERISTIC
/begin CHARACTERISTIC fmy_id_el_lsl_up_2.c_err_clas "Failure class number for failure XX" VALUE 0xa08036ac _REC_VAL_20_u1 255. _CNV_A_R_LINEAR_____0_CM 0. 255. DISPLAY_IDENTIFIER C_ERR_CLAS_EL_LSL_UP_2 FORMAT "%3.0" /end CHARACTERISTIC
/begin CHARACTERISTIC fmy_id_lsh_up_2.c_err_clas "Failure class number for failure XX" VALUE 0xa0803e2c _REC_VAL_20_u1 255. _CNV_A_R_LINEAR_____0_CM 0. 255. DISPLAY_IDENTIFIER C_ERR_CLAS_LSH_UP_2 FORMAT "%3.0" /end CHARACTERISTIC
/begin CHARACTERISTIC fmy_id_lsh_down_2.c_err_clas "Failure class number for failure XX" VALUE 0xa0803ddc _REC_VAL_20_u1 255. _CNV_A_R_LINEAR_____0_CM 0. 255. DISPLAY_IDENTIFIER C_ERR_CLAS_LSH_DOWN_2 FORMAT "%3.0" /end CHARACTERISTIC
/begin CHARACTERISTIC fmy_id_vls_down_dif_2.c_err_clas "Failure class number for failure XX" VALUE 0xa0804da4 _REC_VAL_20_u1 255. _CNV_A_R_LINEAR_____0_CM 0. 255. DISPLAY_IDENTIFIER C_ERR_CLAS_VLS_DOWN_DIF_2 FORMAT "%3.0" /end CHARACTERISTIC
/begin CHARACTERISTIC fmy_id_lsh_lsl_up_2.c_err_clas "Failure class number for failure XX" VALUE 0xa0803e04 _REC_VAL_20_u1 255. _CNV_A_R_LINEAR_____0_CM 0. 255. DISPLAY_IDENTIFIER C_ERR_CLAS_LSH_LSL_UP_2 FORMAT "%3.0" /end CHARACTERISTIC
/begin CHARACTERISTIC fmy_id_air_lsl_up_2.c_err_clas "Failure class number for failure XX" VALUE 0xa08029b4 _REC_VAL_20_u1 255. _CNV_A_R_LINEAR_____0_CM 0. 255. DISPLAY_IDENTIFIER C_ERR_CLAS_AIR_LSL_UP_2 FORMAT "%3.0" /end CHARACTERISTIC
/begin CHARACTERISTIC fmy_id_pue_ls_down_2.c_err_clas "Failure class number for failure XX" VALUE 0xa08043cc _REC_VAL_20_u1 255. _CNV_A_R_LINEAR_____0_CM 0. 255. DISPLAY_IDENTIFIER C_ERR_CLAS_PUE_LS_DOWN_2 FORMAT "%3.0" /end CHARACTERISTIC
/begin CHARACTERISTIC fmy_id_swt_ls_down_2.c_err_clas "Failure class number for failure XX" VALUE 0xa08047b4 _REC_VAL_20_u1 255. _CNV_A_R_LINEAR_____0_CM 0. 255. DISPLAY_IDENTIFIER C_ERR_CLAS_SWT_LS_DOWN_2 FORMAT "%3.0" /end CHARACTERISTIC
/begin CHARACTERISTIC fmy_id_obd_lsh_down_2.c_err_clas "Failure class number for failure XX" VALUE 0xa0804174 _REC_VAL_20_u1 255. _CNV_A_R_LINEAR_____0_CM 0. 255. DISPLAY_IDENTIFIER C_ERR_CLAS_OBD_LSH_DOWN_2 FORMAT "%3.0" /end CHARACTERISTIC
/begin CHARACTERISTIC fmy_id_dyn_vld_ls_up_2.c_err_clas "Failure class number for failure XX" VALUE 0xa0803530 _REC_VAL_20_u1 255. _CNV_A_R_LINEAR_____0_CM 0. 255. DISPLAY_IDENTIFIER C_ERR_CLAS_DYN_VLD_LS_UP_2 FORMAT "%3.0" /end CHARACTERISTIC
/begin CHARACTERISTIC fmy_id_puc_vld_ls_up_2.c_err_clas "Failure class number for failure XX" VALUE 0xa08043a4 _REC_VAL_20_u1 255. _CNV_A_R_LINEAR_____0_CM 0. 255. DISPLAY_IDENTIFIER C_ERR_CLAS_PUC_VLD_LS_UP_2 FORMAT "%3.0" /end CHARACTERISTIC
/begin CHARACTERISTIC fmy_id_obd_vld_lsh_up_2.c_err_clas "Failure class number for failure XX" VALUE 0xa080419c _REC_VAL_20_u1 255. _CNV_A_R_LINEAR_____0_CM 0. 255. DISPLAY_IDENTIFIER C_ERR_CLAS_OBD_VLD_LSH_UP_2 FORMAT "%3.0" /end CHARACTERISTIC
/begin CHARACTERISTIC fmy_id_chk_ls_down_2.c_err_clas "Failure class number for failure XX" VALUE 0xa0802e00 _REC_VAL_20_u1 255. _CNV_A_R_LINEAR_____0_CM 0. 255. DISPLAY_IDENTIFIER C_ERR_CLAS_CHK_LS_DOWN_2 FORMAT "%3.0" /end CHARACTERISTIC
/begin CHARACTERISTIC fmy_id_shift_afl_lsl_up_2.c_err_clas "Failure class number for failure XX" VALUE 0xa0804674 _REC_VAL_20_u1 255. _CNV_A_R_LINEAR_____0_CM 0. 255. DISPLAY_IDENTIFIER C_ERR_CLAS_SHIFT_AFL_LSL_UP_2 FORMAT "%3.0" /end CHARACTERISTIC
/begin CHARACTERISTIC fmy_id_shift_afr_lsl_up_2.c_err_clas "Failure class number for failure XX" VALUE 0xa080469c _REC_VAL_20_u1 255. _CNV_A_R_LINEAR_____0_CM 0. 255. DISPLAY_IDENTIFIER C_ERR_CLAS_SHIFT_AFR_LSL_UP_2 FORMAT "%3.0" /end CHARACTERISTIC
/begin CHARACTERISTIC fmy_id_oc_lsl_up_2.c_err_clas "Failure class number for failure XX" VALUE 0xa08041ec _REC_VAL_20_u1 255. _CNV_A_R_LINEAR_____0_CM 0. 255. DISPLAY_IDENTIFIER C_ERR_CLAS_OC_LSL_UP_2 FORMAT "%3.0" /end CHARACTERISTIC
/begin CHARACTERISTIC fmy_id_delta_i_lam_2.c_err_clas "Failure class number for failure XX" VALUE 0xa0803468 _REC_VAL_20_u1 255. _CNV_A_R_LINEAR_____0_CM 0. 255. DISPLAY_IDENTIFIER C_ERR_CLAS_DELTA_I_LAM_2 FORMAT "%3.0" /end CHARACTERISTIC
/begin CHARACTERISTIC fmy_id_ofs_lsl_up_2.c_err_clas "Failure class number for failure XX" VALUE 0xa0804214 _REC_VAL_20_u1 255. _CNV_A_R_LINEAR_____0_CM 0. 255. DISPLAY_IDENTIFIER C_ERR_CLAS_OFS_LSL_UP_2 FORMAT "%3.0" /end CHARACTERISTIC
/begin CHARACTERISTIC fmy_id_ttip_mes_lsh_up_2.c_err_clas "Failure class number for failure XX" VALUE 0xa0804d04 _REC_VAL_20_u1 255. _CNV_A_R_LINEAR_____0_CM 0. 255. DISPLAY_IDENTIFIER C_ERR_CLAS_TTIP_MES_LSH_UP_2 FORMAT "%3.0" /end CHARACTERISTIC
/begin CHARACTERISTIC fmy_id_ctl_lsl_up_2.c_err_clas "Failure class number for failure XX" VALUE 0xa0803274 _REC_VAL_20_u1 255. _CNV_A_R_LINEAR_____0_CM 0. 255. DISPLAY_IDENTIFIER C_ERR_CLAS_CTL_LSL_UP_2 FORMAT "%3.0" /end CHARACTERISTIC
/begin CHARACTERISTIC fmy_id_chg_ls_up.c_err_clas "Failure class number for failure XX" VALUE 0xa0802dc4 _REC_VAL_20_u1 255. _CNV_A_R_LINEAR_____0_CM 0. 255. DISPLAY_IDENTIFIER C_ERR_CLAS_CHG_LS_UP FORMAT "%3.0" /end CHARACTERISTIC
/begin CHARACTERISTIC fmy_id_alter_com.c_err_clas "Failure class number for failure XX" VALUE 0xa0802a04 _REC_VAL_20_u1 255. _CNV_A_R_LINEAR_____0_CM 0. 255. DISPLAY_IDENTIFIER C_ERR_CLAS_ALTER_COM FORMAT "%3.0" /end CHARACTERISTIC
/begin CHARACTERISTIC fmy_id_cwp_com.c_err_clas "Failure class number for failure XX" VALUE 0xa080329c _REC_VAL_20_u1 255. _CNV_A_R_LINEAR_____0_CM 0. 255. DISPLAY_IDENTIFIER C_ERR_CLAS_CWP_COM FORMAT "%3.0" /end CHARACTERISTIC
/begin CHARACTERISTIC fmy_id_qoil_com.c_err_clas "Failure class number for failure XX" VALUE 0xa0804494 _REC_VAL_20_u1 255. _CNV_A_R_LINEAR_____0_CM 0. 255. DISPLAY_IDENTIFIER C_ERR_CLAS_QOIL_COM FORMAT "%3.0" /end CHARACTERISTIC
/begin CHARACTERISTIC fmy_id_sens_bat_smt_com.c_err_clas "Failure class number for failure XX" VALUE 0xa0804638 _REC_VAL_20_u1 255. _CNV_A_R_LINEAR_____0_CM 0. 255. DISPLAY_IDENTIFIER C_ERR_CLAS_SENS_BAT_SMT_COM FORMAT "%3.0" /end CHARACTERISTIC
/begin CHARACTERISTIC fmy_id_ecraspwm_fb.c_err_clas "Failure class number for failure XX" VALUE 0xa08035e4 _REC_VAL_20_u1 255. _CNV_A_R_LINEAR_____0_CM 0. 255. DISPLAY_IDENTIFIER C_ERR_CLAS_ECRASPWM_FB FORMAT "%3.0" /end CHARACTERISTIC
/begin CHARACTERISTIC fmy_id_ecras_el.c_err_clas "Failure class number for failure XX" VALUE 0xa08035bc _REC_VAL_20_u1 255. _CNV_A_R_LINEAR_____0_CM 0. 255. DISPLAY_IDENTIFIER C_ERR_CLAS_ECRAS_EL FORMAT "%3.0" /end CHARACTERISTIC
/begin CHARACTERISTIC fmy_id_ecras_up_fb.c_err_clas "Failure class number for failure XX" VALUE 0xa08035d0 _REC_VAL_20_u1 255. _CNV_A_R_LINEAR_____0_CM 0. 255. DISPLAY_IDENTIFIER C_ERR_CLAS_ECRAS_UP_FB FORMAT "%3.0" /end CHARACTERISTIC
/begin CHARACTERISTIC fmy_id_ecras_down_fb.c_err_clas "Failure class number for failure XX" VALUE 0xa08035a8 _REC_VAL_20_u1 255. _CNV_A_R_LINEAR_____0_CM 0. 255. DISPLAY_IDENTIFIER C_ERR_CLAS_ECRAS_DOWN_FB FORMAT "%3.0" /end CHARACTERISTIC
/begin CHARACTERISTIC fmy_id_warm_rst.c_err_clas "Failure class number for failure XX" VALUE 0xa0804df4 _REC_VAL_20_u1 255. _CNV_A_R_LINEAR_____0_CM 0. 255. DISPLAY_IDENTIFIER C_ERR_CLAS_WARM_RST FORMAT "%3.0" /end CHARACTERISTIC
/begin CHARACTERISTIC fmy_id_acr_ad.c_err_clas "Failure class number for failure XX" VALUE 0xa0802964 _REC_VAL_20_u1 255. _CNV_A_R_LINEAR_____0_CM 0. 255. DISPLAY_IDENTIFIER C_ERR_CLAS_ACR_AD FORMAT "%3.0" /end CHARACTERISTIC
/begin CHARACTERISTIC fmy_id_sens_acr.c_err_clas "Failure class number for failure XX" VALUE 0xa0804624 _REC_VAL_20_u1 255. _CNV_A_R_LINEAR_____0_CM 0. 255. DISPLAY_IDENTIFIER C_ERR_CLAS_SENS_ACR FORMAT "%3.0" /end CHARACTERISTIC
/begin CHARACTERISTIC fmy_id_acr_ctl.c_err_clas "Failure class number for failure XX" VALUE 0xa0802978 _REC_VAL_20_u1 255. _CNV_A_R_LINEAR_____0_CM 0. 255. DISPLAY_IDENTIFIER C_ERR_CLAS_ACR_CTL FORMAT "%3.0" /end CHARACTERISTIC
/begin CHARACTERISTIC fmy_id_acr_dr.c_err_clas "Failure class number for failure XX" VALUE 0xa080298c _REC_VAL_20_u1 255. _CNV_A_R_LINEAR_____0_CM 0. 255. DISPLAY_IDENTIFIER C_ERR_CLAS_ACR_DR FORMAT "%3.0" /end CHARACTERISTIC
/begin CHARACTERISTIC fmy_id_var_cod.c_err_clas "Failure class number for failure XX" VALUE 0xa0804d40 _REC_VAL_20_u1 255. _CNV_A_R_LINEAR_____0_CM 0. 255. DISPLAY_IDENTIFIER C_ERR_CLAS_VAR_COD FORMAT "%3.0" /end CHARACTERISTIC
/begin CHARACTERISTIC fmy_id_veh_pow_var.c_err_clas "Failure class number for failure XX" VALUE 0xa0804d7c _REC_VAL_20_u1 255. _CNV_A_R_LINEAR_____0_CM 0. 255. DISPLAY_IDENTIFIER C_ERR_CLAS_VEH_POW_VAR FORMAT "%3.0" /end CHARACTERISTIC
/begin CHARACTERISTIC fmy_id_fup_mfp_plaus.c_err_clas "Failure class number for failure XX" VALUE 0xa0803864 _REC_VAL_20_u1 255. _CNV_A_R_LINEAR_____0_CM 0. 255. DISPLAY_IDENTIFIER C_ERR_CLAS_FUP_MFP_PLAUS FORMAT "%3.0" /end CHARACTERISTIC
/begin CHARACTERISTIC fmy_id_h_prs_sys.c_err_clas "Failure class number for failure XX" VALUE 0xa0803954 _REC_VAL_20_u1 255. _CNV_A_R_LINEAR_____0_CM 0. 255. DISPLAY_IDENTIFIER C_ERR_CLAS_H_PRS_SYS FORMAT "%3.0" /end CHARACTERISTIC
/begin CHARACTERISTIC fmy_id_fup_0.c_err_clas "Failure class number for failure XX" VALUE 0xa0803828 _REC_VAL_20_u1 255. _CNV_A_R_LINEAR_____0_CM 0. 255. DISPLAY_IDENTIFIER C_ERR_CLAS_FUP_0 FORMAT "%3.0" /end CHARACTERISTIC
/begin CHARACTERISTIC fmy_id_fup_1.c_err_clas "Failure class number for failure XX" VALUE 0xa080383c _REC_VAL_20_u1 255. _CNV_A_R_LINEAR_____0_CM 0. 255. DISPLAY_IDENTIFIER C_ERR_CLAS_FUP_1 FORMAT "%3.0" /end CHARACTERISTIC
/begin CHARACTERISTIC fmy_id_vcv_fpc_0.c_err_clas "Failure class number for failure XX" VALUE 0xa0804d54 _REC_VAL_20_u1 255. _CNV_A_R_LINEAR_____0_CM 0. 255. DISPLAY_IDENTIFIER C_ERR_CLAS_VCV_FPC_0 FORMAT "%3.0" /end CHARACTERISTIC
/begin CHARACTERISTIC fmy_id_fup_efp.c_err_clas "Failure class number for failure XX" VALUE 0xa0803850 _REC_VAL_20_u1 255. _CNV_A_R_LINEAR_____0_CM 0. 255. DISPLAY_IDENTIFIER C_ERR_CLAS_FUP_EFP FORMAT "%3.0" /end CHARACTERISTIC
/begin CHARACTERISTIC fmy_id_efppwm_plaus.c_err_clas "Failure class number for failure XX" VALUE 0xa080365c _REC_VAL_20_u1 255. _CNV_A_R_LINEAR_____0_CM 0. 255. DISPLAY_IDENTIFIER C_ERR_CLAS_EFPPWM_PLAUS FORMAT "%3.0" /end CHARACTERISTIC
/begin CHARACTERISTIC fmy_id_l_prs_sys.c_err_clas "Failure class number for failure XX" VALUE 0xa0803d78 _REC_VAL_20_u1 255. _CNV_A_R_LINEAR_____0_CM 0. 255. DISPLAY_IDENTIFIER C_ERR_CLAS_L_PRS_SYS FORMAT "%3.0" /end CHARACTERISTIC
/begin CHARACTERISTIC fmy_id_vcv_fpc_1.c_err_clas "Failure class number for failure XX" VALUE 0xa0804d68 _REC_VAL_20_u1 255. _CNV_A_R_LINEAR_____0_CM 0. 255. DISPLAY_IDENTIFIER C_ERR_CLAS_VCV_FPC_1 FORMAT "%3.0" /end CHARACTERISTIC
/begin CHARACTERISTIC fmy_id_fsd_1.c_err_clas "Failure class number for failure XX" VALUE 0xa0803760 _REC_VAL_20_u1 255. _CNV_A_R_LINEAR_____0_CM 0. 255. DISPLAY_IDENTIFIER C_ERR_CLAS_FSD_1 FORMAT "%3.0" /end CHARACTERISTIC
/begin CHARACTERISTIC fmy_id_fsd_2.c_err_clas "Failure class number for failure XX" VALUE 0xa0803774 _REC_VAL_20_u1 255. _CNV_A_R_LINEAR_____0_CM 0. 255. DISPLAY_IDENTIFIER C_ERR_CLAS_FSD_2 FORMAT "%3.0" /end CHARACTERISTIC
/begin CHARACTERISTIC fmy_id_fsd_lam_lim_1.c_err_clas "Failure class number for failure XX" VALUE 0xa08037b0 _REC_VAL_20_u1 255. _CNV_A_R_LINEAR_____0_CM 0. 255. DISPLAY_IDENTIFIER C_ERR_CLAS_FSD_LAM_LIM_1 FORMAT "%3.0" /end CHARACTERISTIC
/begin CHARACTERISTIC fmy_id_fsd_lam_lim_2.c_err_clas "Failure class number for failure XX" VALUE 0xa08037c4 _REC_VAL_20_u1 255. _CNV_A_R_LINEAR_____0_CM 0. 255. DISPLAY_IDENTIFIER C_ERR_CLAS_FSD_LAM_LIM_2 FORMAT "%3.0" /end CHARACTERISTIC
/begin CHARACTERISTIC fmy_id_fsd_h_rng_1.c_err_clas "Failure class number for failure XX" VALUE 0xa0803788 _REC_VAL_20_u1 255. _CNV_A_R_LINEAR_____0_CM 0. 255. DISPLAY_IDENTIFIER C_ERR_CLAS_FSD_H_RNG_1 FORMAT "%3.0" /end CHARACTERISTIC
/begin CHARACTERISTIC fmy_id_fsd_h_rng_2.c_err_clas "Failure class number for failure XX" VALUE 0xa080379c _REC_VAL_20_u1 255. _CNV_A_R_LINEAR_____0_CM 0. 255. DISPLAY_IDENTIFIER C_ERR_CLAS_FSD_H_RNG_2 FORMAT "%3.0" /end CHARACTERISTIC
/begin CHARACTERISTIC fmy_id_cyl_bal_lam_0.c_err_clas "Failure class number for failure XX" VALUE 0xa08033a0 _REC_VAL_20_u1 255. _CNV_A_R_LINEAR_____0_CM 0. 255. DISPLAY_IDENTIFIER C_ERR_CLAS_CYL_BAL_LAM_0 FORMAT "%3.0" /end CHARACTERISTIC
/begin CHARACTERISTIC fmy_id_cyl_bal_lam_1.c_err_clas "Failure class number for failure XX" VALUE 0xa08033b4 _REC_VAL_20_u1 255. _CNV_A_R_LINEAR_____0_CM 0. 255. DISPLAY_IDENTIFIER C_ERR_CLAS_CYL_BAL_LAM_1 FORMAT "%3.0" /end CHARACTERISTIC
/begin CHARACTERISTIC fmy_id_cyl_bal_lam_2.c_err_clas "Failure class number for failure XX" VALUE 0xa08033c8 _REC_VAL_20_u1 255. _CNV_A_R_LINEAR_____0_CM 0. 255. DISPLAY_IDENTIFIER C_ERR_CLAS_CYL_BAL_LAM_2 FORMAT "%3.0" /end CHARACTERISTIC
/begin CHARACTERISTIC fmy_id_cyl_bal_lam_3.c_err_clas "Failure class number for failure XX" VALUE 0xa08033dc _REC_VAL_20_u1 255. _CNV_A_R_LINEAR_____0_CM 0. 255. DISPLAY_IDENTIFIER C_ERR_CLAS_CYL_BAL_LAM_3 FORMAT "%3.0" /end CHARACTERISTIC
/begin CHARACTERISTIC fmy_id_cyl_bal_lam_4.c_err_clas "Failure class number for failure XX" VALUE 0xa08033f0 _REC_VAL_20_u1 255. _CNV_A_R_LINEAR_____0_CM 0. 255. DISPLAY_IDENTIFIER C_ERR_CLAS_CYL_BAL_LAM_4 FORMAT "%3.0" /end CHARACTERISTIC
/begin CHARACTERISTIC fmy_id_cyl_bal_lam_5.c_err_clas "Failure class number for failure XX" VALUE 0xa0803404 _REC_VAL_20_u1 255. _CNV_A_R_LINEAR_____0_CM 0. 255. DISPLAY_IDENTIFIER C_ERR_CLAS_CYL_BAL_LAM_5 FORMAT "%3.0" /end CHARACTERISTIC
/begin CHARACTERISTIC fmy_id_cyl_bal_lam_6.c_err_clas "Failure class number for failure XX" VALUE 0xa0803418 _REC_VAL_20_u1 255. _CNV_A_R_LINEAR_____0_CM 0. 255. DISPLAY_IDENTIFIER C_ERR_CLAS_CYL_BAL_LAM_6 FORMAT "%3.0" /end CHARACTERISTIC
/begin CHARACTERISTIC fmy_id_cyl_bal_lam_7.c_err_clas "Failure class number for failure XX" VALUE 0xa080342c _REC_VAL_20_u1 255. _CNV_A_R_LINEAR_____0_CM 0. 255. DISPLAY_IDENTIFIER C_ERR_CLAS_CYL_BAL_LAM_7 FORMAT "%3.0" /end CHARACTERISTIC
/begin CHARACTERISTIC fmy_id_cyl_bal_er_0.c_err_clas "Failure class number for failure XX" VALUE 0xa0803300 _REC_VAL_20_u1 255. _CNV_A_R_LINEAR_____0_CM 0. 255. DISPLAY_IDENTIFIER C_ERR_CLAS_CYL_BAL_ER_0 FORMAT "%3.0" /end CHARACTERISTIC
/begin CHARACTERISTIC fmy_id_cyl_bal_er_1.c_err_clas "Failure class number for failure XX" VALUE 0xa0803314 _REC_VAL_20_u1 255. _CNV_A_R_LINEAR_____0_CM 0. 255. DISPLAY_IDENTIFIER C_ERR_CLAS_CYL_BAL_ER_1 FORMAT "%3.0" /end CHARACTERISTIC
/begin CHARACTERISTIC fmy_id_cyl_bal_er_2.c_err_clas "Failure class number for failure XX" VALUE 0xa0803328 _REC_VAL_20_u1 255. _CNV_A_R_LINEAR_____0_CM 0. 255. DISPLAY_IDENTIFIER C_ERR_CLAS_CYL_BAL_ER_2 FORMAT "%3.0" /end CHARACTERISTIC
/begin CHARACTERISTIC fmy_id_cyl_bal_er_3.c_err_clas "Failure class number for failure XX" VALUE 0xa080333c _REC_VAL_20_u1 255. _CNV_A_R_LINEAR_____0_CM 0. 255. DISPLAY_IDENTIFIER C_ERR_CLAS_CYL_BAL_ER_3 FORMAT "%3.0" /end CHARACTERISTIC
/begin CHARACTERISTIC fmy_id_cyl_bal_er_4.c_err_clas "Failure class number for failure XX" VALUE 0xa0803350 _REC_VAL_20_u1 255. _CNV_A_R_LINEAR_____0_CM 0. 255. DISPLAY_IDENTIFIER C_ERR_CLAS_CYL_BAL_ER_4 FORMAT "%3.0" /end CHARACTERISTIC
/begin CHARACTERISTIC fmy_id_cyl_bal_er_5.c_err_clas "Failure class number for failure XX" VALUE 0xa0803364 _REC_VAL_20_u1 255. _CNV_A_R_LINEAR_____0_CM 0. 255. DISPLAY_IDENTIFIER C_ERR_CLAS_CYL_BAL_ER_5 FORMAT "%3.0" /end CHARACTERISTIC
/begin CHARACTERISTIC fmy_id_cyl_bal_er_6.c_err_clas "Failure class number for failure XX" VALUE 0xa0803378 _REC_VAL_20_u1 255. _CNV_A_R_LINEAR_____0_CM 0. 255. DISPLAY_IDENTIFIER C_ERR_CLAS_CYL_BAL_ER_6 FORMAT "%3.0" /end CHARACTERISTIC
/begin CHARACTERISTIC fmy_id_cyl_bal_er_7.c_err_clas "Failure class number for failure XX" VALUE 0xa080338c _REC_VAL_20_u1 255. _CNV_A_R_LINEAR_____0_CM 0. 255. DISPLAY_IDENTIFIER C_ERR_CLAS_CYL_BAL_ER_7 FORMAT "%3.0" /end CHARACTERISTIC
/begin CHARACTERISTIC fmy_id_mon_3.c_err_clas "Failure class number for failure XX" VALUE 0xa0804084 _REC_VAL_20_u1 255. _CNV_A_R_LINEAR_____0_CM 0. 255. DISPLAY_IDENTIFIER C_ERR_CLAS_MON_3 FORMAT "%3.0" /end CHARACTERISTIC
/begin CHARACTERISTIC fmy_id_maf_frq_rng_0.c_err_clas "Failure class number for failure XX" VALUE 0xa0803ecc _REC_VAL_20_u1 255. _CNV_A_R_LINEAR_____0_CM 0. 255. DISPLAY_IDENTIFIER C_ERR_CLAS_MAF_FRQ_RNG_0 FORMAT "%3.0" /end CHARACTERISTIC
/begin CHARACTERISTIC fmy_id_maf_frq_grd_0.c_err_clas "Failure class number for failure XX" VALUE 0xa0803ea4 _REC_VAL_20_u1 255. _CNV_A_R_LINEAR_____0_CM 0. 255. DISPLAY_IDENTIFIER C_ERR_CLAS_MAF_FRQ_GRD_0 FORMAT "%3.0" /end CHARACTERISTIC
/begin CHARACTERISTIC fmy_id_maf_frq_el_0.c_err_clas "Failure class number for failure XX" VALUE 0xa0803e7c _REC_VAL_20_u1 255. _CNV_A_R_LINEAR_____0_CM 0. 255. DISPLAY_IDENTIFIER C_ERR_CLAS_MAF_FRQ_EL_0 FORMAT "%3.0" /end CHARACTERISTIC
/begin CHARACTERISTIC fmy_id_maf_frq_rng_1.c_err_clas "Failure class number for failure XX" VALUE 0xa0803ee0 _REC_VAL_20_u1 255. _CNV_A_R_LINEAR_____0_CM 0. 255. DISPLAY_IDENTIFIER C_ERR_CLAS_MAF_FRQ_RNG_1 FORMAT "%3.0" /end CHARACTERISTIC
/begin CHARACTERISTIC fmy_id_maf_frq_grd_1.c_err_clas "Failure class number for failure XX" VALUE 0xa0803eb8 _REC_VAL_20_u1 255. _CNV_A_R_LINEAR_____0_CM 0. 255. DISPLAY_IDENTIFIER C_ERR_CLAS_MAF_FRQ_GRD_1 FORMAT "%3.0" /end CHARACTERISTIC
/begin CHARACTERISTIC fmy_id_maf_frq_el_1.c_err_clas "Failure class number for failure XX" VALUE 0xa0803e90 _REC_VAL_20_u1 255. _CNV_A_R_LINEAR_____0_CM 0. 255. DISPLAY_IDENTIFIER C_ERR_CLAS_MAF_FRQ_EL_1 FORMAT "%3.0" /end CHARACTERISTIC
/begin CHARACTERISTIC fmy_id_tps_1_1.c_err_clas "Failure class number for failure XX" VALUE 0xa0804b10 _REC_VAL_20_u1 255. _CNV_A_R_LINEAR_____0_CM 0. 255. DISPLAY_IDENTIFIER C_ERR_CLAS_TPS_1_1 FORMAT "%3.0" /end CHARACTERISTIC
/begin CHARACTERISTIC fmy_id_tps_1_2.c_err_clas "Failure class number for failure XX" VALUE 0xa0804b24 _REC_VAL_20_u1 255. _CNV_A_R_LINEAR_____0_CM 0. 255. DISPLAY_IDENTIFIER C_ERR_CLAS_TPS_1_2 FORMAT "%3.0" /end CHARACTERISTIC
/begin CHARACTERISTIC fmy_id_tps_2_1.c_err_clas "Failure class number for failure XX" VALUE 0xa0804b38 _REC_VAL_20_u1 255. _CNV_A_R_LINEAR_____0_CM 0. 255. DISPLAY_IDENTIFIER C_ERR_CLAS_TPS_2_1 FORMAT "%3.0" /end CHARACTERISTIC
/begin CHARACTERISTIC fmy_id_tps_2_2.c_err_clas "Failure class number for failure XX" VALUE 0xa0804b4c _REC_VAL_20_u1 255. _CNV_A_R_LINEAR_____0_CM 0. 255. DISPLAY_IDENTIFIER C_ERR_CLAS_TPS_2_2 FORMAT "%3.0" /end CHARACTERISTIC
/begin CHARACTERISTIC fmy_id_tps_maf_1_1.c_err_clas "Failure class number for failure XX" VALUE 0xa0804bb0 _REC_VAL_20_u1 255. _CNV_A_R_LINEAR_____0_CM 0. 255. DISPLAY_IDENTIFIER C_ERR_CLAS_TPS_MAF_1_1 FORMAT "%3.0" /end CHARACTERISTIC
/begin CHARACTERISTIC fmy_id_tps_maf_1_2.c_err_clas "Failure class number for failure XX" VALUE 0xa0804bc4 _REC_VAL_20_u1 255. _CNV_A_R_LINEAR_____0_CM 0. 255. DISPLAY_IDENTIFIER C_ERR_CLAS_TPS_MAF_1_2 FORMAT "%3.0" /end CHARACTERISTIC
/begin CHARACTERISTIC fmy_id_tps_maf_2_1.c_err_clas "Failure class number for failure XX" VALUE 0xa0804bd8 _REC_VAL_20_u1 255. _CNV_A_R_LINEAR_____0_CM 0. 255. DISPLAY_IDENTIFIER C_ERR_CLAS_TPS_MAF_2_1 FORMAT "%3.0" /end CHARACTERISTIC
/begin CHARACTERISTIC fmy_id_tps_maf_2_2.c_err_clas "Failure class number for failure XX" VALUE 0xa0804bec _REC_VAL_20_u1 255. _CNV_A_R_LINEAR_____0_CM 0. 255. DISPLAY_IDENTIFIER C_ERR_CLAS_TPS_MAF_2_2 FORMAT "%3.0" /end CHARACTERISTIC
/begin CHARACTERISTIC fmy_id_tps_ratio_1.c_err_clas "Failure class number for failure XX" VALUE 0xa0804c00 _REC_VAL_20_u1 255. _CNV_A_R_LINEAR_____0_CM 0. 255. DISPLAY_IDENTIFIER C_ERR_CLAS_TPS_RATIO_1 FORMAT "%3.0" /end CHARACTERISTIC
/begin CHARACTERISTIC fmy_id_tps_ratio_2.c_err_clas "Failure class number for failure XX" VALUE 0xa0804c14 _REC_VAL_20_u1 255. _CNV_A_R_LINEAR_____0_CM 0. 255. DISPLAY_IDENTIFIER C_ERR_CLAS_TPS_RATIO_2 FORMAT "%3.0" /end CHARACTERISTIC
/begin CHARACTERISTIC fmy_id_tps_ad_1.c_err_clas "Failure class number for failure XX" VALUE 0xa0804b60 _REC_VAL_20_u1 255. _CNV_A_R_LINEAR_____0_CM 0. 255. DISPLAY_IDENTIFIER C_ERR_CLAS_TPS_AD_1 FORMAT "%3.0" /end CHARACTERISTIC
/begin CHARACTERISTIC fmy_id_tps_ad_2.c_err_clas "Failure class number for failure XX" VALUE 0xa0804b74 _REC_VAL_20_u1 255. _CNV_A_R_LINEAR_____0_CM 0. 255. DISPLAY_IDENTIFIER C_ERR_CLAS_TPS_AD_2 FORMAT "%3.0" /end CHARACTERISTIC
/begin CHARACTERISTIC fmy_id_etc_pwm_1.c_err_clas "Failure class number for failure XX" VALUE 0xa0803710 _REC_VAL_20_u1 255. _CNV_A_R_LINEAR_____0_CM 0. 255. DISPLAY_IDENTIFIER C_ERR_CLAS_ETC_PWM_1 FORMAT "%3.0" /end CHARACTERISTIC
/begin CHARACTERISTIC fmy_id_etc_pwm_2.c_err_clas "Failure class number for failure XX" VALUE 0xa0803724 _REC_VAL_20_u1 255. _CNV_A_R_LINEAR_____0_CM 0. 255. DISPLAY_IDENTIFIER C_ERR_CLAS_ETC_PWM_2 FORMAT "%3.0" /end CHARACTERISTIC
/begin CHARACTERISTIC fmy_id_etc_ctl_1.c_err_clas "Failure class number for failure XX" VALUE 0xa08036c0 _REC_VAL_20_u1 255. _CNV_A_R_LINEAR_____0_CM 0. 255. DISPLAY_IDENTIFIER C_ERR_CLAS_ETC_CTL_1 FORMAT "%3.0" /end CHARACTERISTIC
/begin CHARACTERISTIC fmy_id_etc_ctl_2.c_err_clas "Failure class number for failure XX" VALUE 0xa08036d4 _REC_VAL_20_u1 255. _CNV_A_R_LINEAR_____0_CM 0. 255. DISPLAY_IDENTIFIER C_ERR_CLAS_ETC_CTL_2 FORMAT "%3.0" /end CHARACTERISTIC
/begin CHARACTERISTIC fmy_id_tps_ad_spr_1.c_err_clas "Failure class number for failure XX" VALUE 0xa0804b88 _REC_VAL_20_u1 255. _CNV_A_R_LINEAR_____0_CM 0. 255. DISPLAY_IDENTIFIER C_ERR_CLAS_TPS_AD_SPR_1 FORMAT "%3.0" /end CHARACTERISTIC
/begin CHARACTERISTIC fmy_id_tps_ad_spr_2.c_err_clas "Failure class number for failure XX" VALUE 0xa0804b9c _REC_VAL_20_u1 255. _CNV_A_R_LINEAR_____0_CM 0. 255. DISPLAY_IDENTIFIER C_ERR_CLAS_TPS_AD_SPR_2 FORMAT "%3.0" /end CHARACTERISTIC
/begin CHARACTERISTIC fmy_id_etc_dr_1.c_err_clas "Failure class number for failure XX" VALUE 0xa08036e8 _REC_VAL_20_u1 255. _CNV_A_R_LINEAR_____0_CM 0. 255. DISPLAY_IDENTIFIER C_ERR_CLAS_ETC_DR_1 FORMAT "%3.0" /end CHARACTERISTIC
/begin CHARACTERISTIC fmy_id_etc_dr_2.c_err_clas "Failure class number for failure XX" VALUE 0xa08036fc _REC_VAL_20_u1 255. _CNV_A_R_LINEAR_____0_CM 0. 255. DISPLAY_IDENTIFIER C_ERR_CLAS_ETC_DR_2 FORMAT "%3.0" /end CHARACTERISTIC
/begin CHARACTERISTIC fmy_id_tps_st_chk_1.c_err_clas "Failure class number for failure XX" VALUE 0xa0804c28 _REC_VAL_20_u1 255. _CNV_A_R_LINEAR_____0_CM 0. 255. DISPLAY_IDENTIFIER C_ERR_CLAS_TPS_ST_CHK_1 FORMAT "%3.0" /end CHARACTERISTIC
/begin CHARACTERISTIC fmy_id_tps_st_chk_2.c_err_clas "Failure class number for failure XX" VALUE 0xa0804c3c _REC_VAL_20_u1 255. _CNV_A_R_LINEAR_____0_CM 0. 255. DISPLAY_IDENTIFIER C_ERR_CLAS_TPS_ST_CHK_2 FORMAT "%3.0" /end CHARACTERISTIC
/begin CHARACTERISTIC fmy_id_com_1_tq_loss_cord.c_err_clas "Failure class number for failure XX" VALUE 0xa0802ef0 _REC_VAL_20_u1 255. _CNV_A_R_LINEAR_____0_CM 0. 255. DISPLAY_IDENTIFIER C_ERR_CLAS_COM_1_TQ_LOSS_CORD FORMAT "%3.0" /end CHARACTERISTIC
/begin CHARACTERISTIC fmy_id_com_1_swi_gear.c_err_clas "Failure class number for failure XX" VALUE 0xa0802ea0 _REC_VAL_20_u1 255. _CNV_A_R_LINEAR_____0_CM 0. 255. DISPLAY_IDENTIFIER C_ERR_CLAS_COM_1_SWI_GEAR FORMAT "%3.0" /end CHARACTERISTIC
/begin CHARACTERISTIC fmy_id_com_1_veh_mod.c_err_clas "Failure class number for failure XX" VALUE 0xa0802f40 _REC_VAL_20_u1 255. _CNV_A_R_LINEAR_____0_CM 0. 255. DISPLAY_IDENTIFIER C_ERR_CLAS_COM_1_VEH_MOD FORMAT "%3.0" /end CHARACTERISTIC
/begin CHARACTERISTIC fmy_id_com_1_brake_tcs.c_err_clas "Failure class number for failure XX" VALUE 0xa0802e78 _REC_VAL_20_u1 255. _CNV_A_R_LINEAR_____0_CM 0. 255. DISPLAY_IDENTIFIER C_ERR_CLAS_COM_1_BRAKE_TCS FORMAT "%3.0" /end CHARACTERISTIC
/begin CHARACTERISTIC fmy_id_com_1_tq_driv_asi.c_err_clas "Failure class number for failure XX" VALUE 0xa0802edc _REC_VAL_20_u1 255. _CNV_A_R_LINEAR_____0_CM 0. 255. DISPLAY_IDENTIFIER C_ERR_CLAS_COM_1_TQ_DRIV_ASI FORMAT "%3.0" /end CHARACTERISTIC
/begin CHARACTERISTIC fmy_id_com_1_tq_tcs.c_err_clas "Failure class number for failure XX" VALUE 0xa0802f18 _REC_VAL_20_u1 255. _CNV_A_R_LINEAR_____0_CM 0. 255. DISPLAY_IDENTIFIER C_ERR_CLAS_COM_1_TQ_TCS FORMAT "%3.0" /end CHARACTERISTIC
/begin CHARACTERISTIC fmy_id_com_1_tqb_tcs.c_err_clas "Failure class number for failure XX" VALUE 0xa0802f2c _REC_VAL_20_u1 255. _CNV_A_R_LINEAR_____0_CM 0. 255. DISPLAY_IDENTIFIER C_ERR_CLAS_COM_1_TQB_TCS FORMAT "%3.0" /end CHARACTERISTIC
/begin CHARACTERISTIC fmy_id_com_1_wheel_tcs.c_err_clas "Failure class number for failure XX" VALUE 0xa0802f68 _REC_VAL_20_u1 255. _CNV_A_R_LINEAR_____0_CM 0. 255. DISPLAY_IDENTIFIER C_ERR_CLAS_COM_1_WHEEL_TCS FORMAT "%3.0" /end CHARACTERISTIC
/begin CHARACTERISTIC fmy_id_com_1_req_tqdw.c_err_clas "Failure class number for failure XX" VALUE 0xa0802e8c _REC_VAL_20_u1 255. _CNV_A_R_LINEAR_____0_CM 0. 255. DISPLAY_IDENTIFIER C_ERR_CLAS_COM_1_REQ_TQDW FORMAT "%3.0" /end CHARACTERISTIC
/begin CHARACTERISTIC fmy_id_com_1_tq_pste.c_err_clas "Failure class number for failure XX" VALUE 0xa0802f04 _REC_VAL_20_u1 255. _CNV_A_R_LINEAR_____0_CM 0. 255. DISPLAY_IDENTIFIER C_ERR_CLAS_COM_1_TQ_PSTE FORMAT "%3.0" /end CHARACTERISTIC
/begin CHARACTERISTIC fmy_id_com_1_ang_pste.c_err_clas "Failure class number for failure XX" VALUE 0xa0802e3c _REC_VAL_20_u1 255. _CNV_A_R_LINEAR_____0_CM 0. 255. DISPLAY_IDENTIFIER C_ERR_CLAS_COM_1_ANG_PSTE FORMAT "%3.0" /end CHARACTERISTIC
/begin CHARACTERISTIC fmy_id_com_1_ac_trv.c_err_clas "Failure class number for failure XX" VALUE 0xa0802e28 _REC_VAL_20_u1 255. _CNV_A_R_LINEAR_____0_CM 0. 255. DISPLAY_IDENTIFIER C_ERR_CLAS_COM_1_AC_TRV FORMAT "%3.0" /end CHARACTERISTIC
/begin CHARACTERISTIC fmy_id_com_1_ac_lgt.c_err_clas "Failure class number for failure XX" VALUE 0xa0802e14 _REC_VAL_20_u1 255. _CNV_A_R_LINEAR_____0_CM 0. 255. DISPLAY_IDENTIFIER C_ERR_CLAS_COM_1_AC_LGT FORMAT "%3.0" /end CHARACTERISTIC
/begin CHARACTERISTIC fmy_id_com_1_tq_ars.c_err_clas "Failure class number for failure XX" VALUE 0xa0802ec8 _REC_VAL_20_u1 255. _CNV_A_R_LINEAR_____0_CM 0. 255. DISPLAY_IDENTIFIER C_ERR_CLAS_COM_1_TQ_ARS FORMAT "%3.0" /end CHARACTERISTIC
/begin CHARACTERISTIC fmy_id_com_1_ars.c_err_clas "Failure class number for failure XX" VALUE 0xa0802e50 _REC_VAL_20_u1 255. _CNV_A_R_LINEAR_____0_CM 0. 255. DISPLAY_IDENTIFIER C_ERR_CLAS_COM_1_ARS FORMAT "%3.0" /end CHARACTERISTIC
/begin CHARACTERISTIC fmy_id_com_1_vs.c_err_clas "Failure class number for failure XX" VALUE 0xa0802f54 _REC_VAL_20_u1 255. _CNV_A_R_LINEAR_____0_CM 0. 255. DISPLAY_IDENTIFIER C_ERR_CLAS_COM_1_VS FORMAT "%3.0" /end CHARACTERISTIC
/begin CHARACTERISTIC fmy_id_com_1_tcs.c_err_clas "Failure class number for failure XX" VALUE 0xa0802eb4 _REC_VAL_20_u1 255. _CNV_A_R_LINEAR_____0_CM 0. 255. DISPLAY_IDENTIFIER C_ERR_CLAS_COM_1_TCS FORMAT "%3.0" /end CHARACTERISTIC
/begin CHARACTERISTIC fmy_id_com_1_boff.c_err_clas "Failure class number for failure XX" VALUE 0xa0802e64 _REC_VAL_20_u1 255. _CNV_A_R_LINEAR_____0_CM 0. 255. DISPLAY_IDENTIFIER C_ERR_CLAS_COM_1_BOFF FORMAT "%3.0" /end CHARACTERISTIC
/begin CHARACTERISTIC fmy_id_com_2_efp_crash.c_err_clas "Failure class number for failure XX" VALUE 0xa0802ff4 _REC_VAL_20_u1 255. _CNV_A_R_LINEAR_____0_CM 0. 255. DISPLAY_IDENTIFIER C_ERR_CLAS_COM_2_EFP_CRASH FORMAT "%3.0" /end CHARACTERISTIC
/begin CHARACTERISTIC fmy_id_com_2_gb.c_err_clas "Failure class number for failure XX" VALUE 0xa0803030 _REC_VAL_20_u1 255. _CNV_A_R_LINEAR_____0_CM 0. 255. DISPLAY_IDENTIFIER C_ERR_CLAS_COM_2_GB FORMAT "%3.0" /end CHARACTERISTIC
/begin CHARACTERISTIC fmy_id_com_2_etcu.c_err_clas "Failure class number for failure XX" VALUE 0xa0803008 _REC_VAL_20_u1 255. _CNV_A_R_LINEAR_____0_CM 0. 255. DISPLAY_IDENTIFIER C_ERR_CLAS_COM_2_ETCU FORMAT "%3.0" /end CHARACTERISTIC
/begin CHARACTERISTIC fmy_id_com_2_tq_etcu.c_err_clas "Failure class number for failure XX" VALUE 0xa080310c _REC_VAL_20_u1 255. _CNV_A_R_LINEAR_____0_CM 0. 255. DISPLAY_IDENTIFIER C_ERR_CLAS_COM_2_TQ_ETCU FORMAT "%3.0" /end CHARACTERISTIC
/begin CHARACTERISTIC fmy_id_com_2_state_veh.c_err_clas "Failure class number for failure XX" VALUE 0xa08030a8 _REC_VAL_20_u1 255. _CNV_A_R_LINEAR_____0_CM 0. 255. DISPLAY_IDENTIFIER C_ERR_CLAS_COM_2_STATE_VEH FORMAT "%3.0" /end CHARACTERISTIC
/begin CHARACTERISTIC fmy_id_com_2_cas_2.c_err_clas "Failure class number for failure XX" VALUE 0xa0802fcc _REC_VAL_20_u1 255. _CNV_A_R_LINEAR_____0_CM 0. 255. DISPLAY_IDENTIFIER C_ERR_CLAS_COM_2_CAS_2 FORMAT "%3.0" /end CHARACTERISTIC
/begin CHARACTERISTIC fmy_id_com_2_acc.c_err_clas "Failure class number for failure XX" VALUE 0xa0802f90 _REC_VAL_20_u1 255. _CNV_A_R_LINEAR_____0_CM 0. 255. DISPLAY_IDENTIFIER C_ERR_CLAS_COM_2_ACC FORMAT "%3.0" /end CHARACTERISTIC
/begin CHARACTERISTIC fmy_id_com_2_km_icl.c_err_clas "Failure class number for failure XX" VALUE 0xa0803080 _REC_VAL_20_u1 255. _CNV_A_R_LINEAR_____0_CM 0. 255. DISPLAY_IDENTIFIER C_ERR_CLAS_COM_2_KM_ICL FORMAT "%3.0" /end CHARACTERISTIC
/begin CHARACTERISTIC fmy_id_com_2_t_icl.c_err_clas "Failure class number for failure XX" VALUE 0xa08030e4 _REC_VAL_20_u1 255. _CNV_A_R_LINEAR_____0_CM 0. 255. DISPLAY_IDENTIFIER C_ERR_CLAS_COM_2_T_ICL FORMAT "%3.0" /end CHARACTERISTIC
/begin CHARACTERISTIC fmy_id_com_2_tam_icl.c_err_clas "Failure class number for failure XX" VALUE 0xa08030f8 _REC_VAL_20_u1 255. _CNV_A_R_LINEAR_____0_CM 0. 255. DISPLAY_IDENTIFIER C_ERR_CLAS_COM_2_TAM_ICL FORMAT "%3.0" /end CHARACTERISTIC
/begin CHARACTERISTIC fmy_id_com_2_t_clk.c_err_clas "Failure class number for failure XX" VALUE 0xa08030d0 _REC_VAL_20_u1 255. _CNV_A_R_LINEAR_____0_CM 0. 255. DISPLAY_IDENTIFIER C_ERR_CLAS_COM_2_T_CLK FORMAT "%3.0" /end CHARACTERISTIC
/begin CHARACTERISTIC fmy_id_com_2_boff.c_err_clas "Failure class number for failure XX" VALUE 0xa0802fa4 _REC_VAL_20_u1 255. _CNV_A_R_LINEAR_____0_CM 0. 255. DISPLAY_IDENTIFIER C_ERR_CLAS_COM_2_BOFF FORMAT "%3.0" /end CHARACTERISTIC
/begin CHARACTERISTIC fmy_id_com_2_t_absl_icl.c_err_clas "Failure class number for failure XX" VALUE 0xa08030bc _REC_VAL_20_u1 255. _CNV_A_R_LINEAR_____0_CM 0. 255. DISPLAY_IDENTIFIER C_ERR_CLAS_COM_2_T_ABSL_ICL FORMAT "%3.0" /end CHARACTERISTIC
/begin CHARACTERISTIC fmy_id_com_2_cas.c_err_clas "Failure class number for failure XX" VALUE 0xa0802fb8 _REC_VAL_20_u1 255. _CNV_A_R_LINEAR_____0_CM 0. 255. DISPLAY_IDENTIFIER C_ERR_CLAS_COM_2_CAS FORMAT "%3.0" /end CHARACTERISTIC
/begin CHARACTERISTIC fmy_id_com_2_etcu_disp.c_err_clas "Failure class number for failure XX" VALUE 0xa080301c _REC_VAL_20_u1 255. _CNV_A_R_LINEAR_____0_CM 0. 255. DISPLAY_IDENTIFIER C_ERR_CLAS_COM_2_ETCU_DISP FORMAT "%3.0" /end CHARACTERISTIC
/begin CHARACTERISTIC fmy_id_com_2_pow_off.c_err_clas "Failure class number for failure XX" VALUE 0xa0803094 _REC_VAL_20_u1 255. _CNV_A_R_LINEAR_____0_CM 0. 255. DISPLAY_IDENTIFIER C_ERR_CLAS_COM_2_POW_OFF FORMAT "%3.0" /end CHARACTERISTIC
/begin CHARACTERISTIC fmy_id_com_2_abs_icl.c_err_clas "Failure class number for failure XX" VALUE 0xa0802f7c _REC_VAL_20_u1 255. _CNV_A_R_LINEAR_____0_CM 0. 255. DISPLAY_IDENTIFIER C_ERR_CLAS_COM_2_ABS_ICL FORMAT "%3.0" /end CHARACTERISTIC
/begin CHARACTERISTIC fmy_id_com_2_trl.c_err_clas "Failure class number for failure XX" VALUE 0xa0803120 _REC_VAL_20_u1 255. _CNV_A_R_LINEAR_____0_CM 0. 255. DISPLAY_IDENTIFIER C_ERR_CLAS_COM_2_TRL FORMAT "%3.0" /end CHARACTERISTIC
/begin CHARACTERISTIC fmy_id_com_2_hiv.c_err_clas "Failure class number for failure XX" VALUE 0xa0803058 _REC_VAL_20_u1 255. _CNV_A_R_LINEAR_____0_CM 0. 255. DISPLAY_IDENTIFIER C_ERR_CLAS_COM_2_HIV FORMAT "%3.0" /end CHARACTERISTIC
/begin CHARACTERISTIC fmy_id_com_2_icl.c_err_clas "Failure class number for failure XX" VALUE 0xa080306c _REC_VAL_20_u1 255. _CNV_A_R_LINEAR_____0_CM 0. 255. DISPLAY_IDENTIFIER C_ERR_CLAS_COM_2_ICL FORMAT "%3.0" /end CHARACTERISTIC
/begin CHARACTERISTIC fmy_id_com_2_gear_rev.c_err_clas "Failure class number for failure XX" VALUE 0xa0803044 _REC_VAL_20_u1 255. _CNV_A_R_LINEAR_____0_CM 0. 255. DISPLAY_IDENTIFIER C_ERR_CLAS_COM_2_GEAR_REV FORMAT "%3.0" /end CHARACTERISTIC
/begin CHARACTERISTIC fmy_id_com_2_cdn_door.c_err_clas "Failure class number for failure XX" VALUE 0xa0802fe0 _REC_VAL_20_u1 255. _CNV_A_R_LINEAR_____0_CM 0. 255. DISPLAY_IDENTIFIER C_ERR_CLAS_COM_2_CDN_DOOR FORMAT "%3.0" /end CHARACTERISTIC
/begin CHARACTERISTIC fmy_id_com_3_boff.c_err_clas "Failure class number for failure XX" VALUE 0xa0803134 _REC_VAL_20_u1 255. _CNV_A_R_LINEAR_____0_CM 0. 255. DISPLAY_IDENTIFIER C_ERR_CLAS_COM_3_BOFF FORMAT "%3.0" /end CHARACTERISTIC
/begin CHARACTERISTIC fmy_id_com_3_efp.c_err_clas "Failure class number for failure XX" VALUE 0xa0803148 _REC_VAL_20_u1 255. _CNV_A_R_LINEAR_____0_CM 0. 255. DISPLAY_IDENTIFIER C_ERR_CLAS_COM_3_EFP FORMAT "%3.0" /end CHARACTERISTIC
/begin CHARACTERISTIC fmy_id_com_3_tq_etcu.c_err_clas "Failure class number for failure XX" VALUE 0xa08031ac _REC_VAL_20_u1 255. _CNV_A_R_LINEAR_____0_CM 0. 255. DISPLAY_IDENTIFIER C_ERR_CLAS_COM_3_TQ_ETCU FORMAT "%3.0" /end CHARACTERISTIC
/begin CHARACTERISTIC fmy_id_com_3_etcu.c_err_clas "Failure class number for failure XX" VALUE 0xa080315c _REC_VAL_20_u1 255. _CNV_A_R_LINEAR_____0_CM 0. 255. DISPLAY_IDENTIFIER C_ERR_CLAS_COM_3_ETCU FORMAT "%3.0" /end CHARACTERISTIC
/begin CHARACTERISTIC fmy_id_com_3_etcu_disp.c_err_clas "Failure class number for failure XX" VALUE 0xa0803170 _REC_VAL_20_u1 255. _CNV_A_R_LINEAR_____0_CM 0. 255. DISPLAY_IDENTIFIER C_ERR_CLAS_COM_3_ETCU_DISP FORMAT "%3.0" /end CHARACTERISTIC
/begin CHARACTERISTIC fmy_id_com_3_etcu_obd.c_err_clas "Failure class number for failure XX" VALUE 0xa0803184 _REC_VAL_20_u1 255. _CNV_A_R_LINEAR_____0_CM 0. 255. DISPLAY_IDENTIFIER C_ERR_CLAS_COM_3_ETCU_OBD FORMAT "%3.0" /end CHARACTERISTIC
/begin CHARACTERISTIC fmy_id_com_3_gb.c_err_clas "Failure class number for failure XX" VALUE 0xa0803198 _REC_VAL_20_u1 255. _CNV_A_R_LINEAR_____0_CM 0. 255. DISPLAY_IDENTIFIER C_ERR_CLAS_COM_3_GB FORMAT "%3.0" /end CHARACTERISTIC
/begin CHARACTERISTIC fmy_id_teg_sens_1.c_err_clas "Failure class number for failure XX" VALUE 0xa08049d0 _REC_VAL_20_u1 255. _CNV_A_R_LINEAR_____0_CM 0. 255. DISPLAY_IDENTIFIER C_ERR_CLAS_TEG_SENS_1 FORMAT "%3.0" /end CHARACTERISTIC
/begin CHARACTERISTIC fmy_id_teg_sens_2.c_err_clas "Failure class number for failure XX" VALUE 0xa08049e4 _REC_VAL_20_u1 255. _CNV_A_R_LINEAR_____0_CM 0. 255. DISPLAY_IDENTIFIER C_ERR_CLAS_TEG_SENS_2 FORMAT "%3.0" /end CHARACTERISTIC
/begin CHARACTERISTIC fmy_id_amp_plaus_cus.c_err_clas "Failure class number for failure XX" VALUE 0xa0802a40 _REC_VAL_20_u1 255. _CNV_A_R_LINEAR_____0_CM 0. 255. DISPLAY_IDENTIFIER C_ERR_CLAS_AMP_PLAUS_CUS FORMAT "%3.0" /end CHARACTERISTIC
/begin CHARACTERISTIC fmy_id_tcha_prs_low.c_err_clas "Failure class number for failure XX" VALUE 0xa08048f4 _REC_VAL_20_u1 255. _CNV_A_R_LINEAR_____0_CM 0. 255. DISPLAY_IDENTIFIER C_ERR_CLAS_TCHA_PRS_LOW FORMAT "%3.0" /end CHARACTERISTIC
/begin CHARACTERISTIC fmy_id_tcha_leak.c_err_clas "Failure class number for failure XX" VALUE 0xa08048b8 _REC_VAL_20_u1 255. _CNV_A_R_LINEAR_____0_CM 0. 255. DISPLAY_IDENTIFIER C_ERR_CLAS_TCHA_LEAK FORMAT "%3.0" /end CHARACTERISTIC
/begin CHARACTERISTIC fmy_id_tcha_prs_dif.c_err_clas "Failure class number for failure XX" VALUE 0xa08048cc _REC_VAL_20_u1 255. _CNV_A_R_LINEAR_____0_CM 0. 255. DISPLAY_IDENTIFIER C_ERR_CLAS_TCHA_PRS_DIF FORMAT "%3.0" /end CHARACTERISTIC
/begin CHARACTERISTIC fmy_id_tcha_prs_high.c_err_clas "Failure class number for failure XX" VALUE 0xa08048e0 _REC_VAL_20_u1 255. _CNV_A_R_LINEAR_____0_CM 0. 255. DISPLAY_IDENTIFIER C_ERR_CLAS_TCHA_PRS_HIGH FORMAT "%3.0" /end CHARACTERISTIC
/begin CHARACTERISTIC fmy_id_put_plaus.c_err_clas "Failure class number for failure XX" VALUE 0xa0804408 _REC_VAL_20_u1 255. _CNV_A_R_LINEAR_____0_CM 0. 255. DISPLAY_IDENTIFIER C_ERR_CLAS_PUT_PLAUS FORMAT "%3.0" /end CHARACTERISTIC
/begin CHARACTERISTIC fmy_id_map_plaus.c_err_clas "Failure class number for failure XX" VALUE 0xa0803f08 _REC_VAL_20_u1 255. _CNV_A_R_LINEAR_____0_CM 0. 255. DISPLAY_IDENTIFIER C_ERR_CLAS_MAP_PLAUS FORMAT "%3.0" /end CHARACTERISTIC
/begin CHARACTERISTIC fmy_id_tq_cst.c_err_clas "Failure class number for failure XX" VALUE 0xa0804c50 _REC_VAL_20_u1 255. _CNV_A_R_LINEAR_____0_CM 0. 255. DISPLAY_IDENTIFIER C_ERR_CLAS_TQ_CST FORMAT "%3.0" /end CHARACTERISTIC
/begin CHARACTERISTIC fmy_id_gen_el.c_err_clas "Failure class number for failure XX" VALUE 0xa08038c8 _REC_VAL_20_u1 255. _CNV_A_R_LINEAR_____0_CM 0. 255. DISPLAY_IDENTIFIER C_ERR_CLAS_GEN_EL FORMAT "%3.0" /end CHARACTERISTIC
/begin CHARACTERISTIC fmy_id_gen_mec.c_err_clas "Failure class number for failure XX" VALUE 0xa0803904 _REC_VAL_20_u1 255. _CNV_A_R_LINEAR_____0_CM 0. 255. DISPLAY_IDENTIFIER C_ERR_CLAS_GEN_MEC FORMAT "%3.0" /end CHARACTERISTIC
/begin CHARACTERISTIC fmy_id_gen_h_temp.c_err_clas "Failure class number for failure XX" VALUE 0xa08038dc _REC_VAL_20_u1 255. _CNV_A_R_LINEAR_____0_CM 0. 255. DISPLAY_IDENTIFIER C_ERR_CLAS_GEN_H_TEMP FORMAT "%3.0" /end CHARACTERISTIC
/begin CHARACTERISTIC fmy_id_gen_typ_not_plaus.c_err_clas "Failure class number for failure XX" VALUE 0xa080392c _REC_VAL_20_u1 255. _CNV_A_R_LINEAR_____0_CM 0. 255. DISPLAY_IDENTIFIER C_ERR_CLAS_GEN_TYP_NOT_PLAUS FORMAT "%3.0" /end CHARACTERISTIC
/begin CHARACTERISTIC fmy_id_gen_msg_lost.c_err_clas "Failure class number for failure XX" VALUE 0xa0803918 _REC_VAL_20_u1 255. _CNV_A_R_LINEAR_____0_CM 0. 255. DISPLAY_IDENTIFIER C_ERR_CLAS_GEN_MSG_LOST FORMAT "%3.0" /end CHARACTERISTIC
/begin CHARACTERISTIC fmy_id_gen_clc_v_not_plaus.c_err_clas "Failure class number for failure XX" VALUE 0xa080388c _REC_VAL_20_u1 255. _CNV_A_R_LINEAR_____0_CM 0. 255. DISPLAY_IDENTIFIER C_ERR_CLAS_GEN_CLC_V_NOT_PLAUS FORMAT "%3.0" /end CHARACTERISTIC
/begin CHARACTERISTIC fmy_id_gen_h_temp_clc.c_err_clas "Failure class number for failure XX" VALUE 0xa08038f0 _REC_VAL_20_u1 255. _CNV_A_R_LINEAR_____0_CM 0. 255. DISPLAY_IDENTIFIER C_ERR_CLAS_GEN_H_TEMP_CLC FORMAT "%3.0" /end CHARACTERISTIC
/begin CHARACTERISTIC fmy_id_gen_ctl_not_plaus.c_err_clas "Failure class number for failure XX" VALUE 0xa08038a0 _REC_VAL_20_u1 255. _CNV_A_R_LINEAR_____0_CM 0. 255. DISPLAY_IDENTIFIER C_ERR_CLAS_GEN_CTL_NOT_PLAUS FORMAT "%3.0" /end CHARACTERISTIC
/begin CHARACTERISTIC fmy_id_slv_ivvt_in.c_err_clas "Failure class number for failure XX" VALUE 0xa08046ec _REC_VAL_20_u1 255. _CNV_A_R_LINEAR_____0_CM 0. 255. DISPLAY_IDENTIFIER C_ERR_CLAS_SLV_IVVT_IN FORMAT "%3.0" /end CHARACTERISTIC
/begin CHARACTERISTIC fmy_id_slv_ivvt_ex.c_err_clas "Failure class number for failure XX" VALUE 0xa08046b0 _REC_VAL_20_u1 255. _CNV_A_R_LINEAR_____0_CM 0. 255. DISPLAY_IDENTIFIER C_ERR_CLAS_SLV_IVVT_EX FORMAT "%3.0" /end CHARACTERISTIC
/begin CHARACTERISTIC fmy_id_conv_mon_1.c_err_clas "Failure class number for failure XX" VALUE 0xa08031c0 _REC_VAL_20_u1 255. _CNV_A_R_LINEAR_____0_CM 0. 255. DISPLAY_IDENTIFIER C_ERR_CLAS_CONV_MON_1 FORMAT "%3.0" /end CHARACTERISTIC
/begin CHARACTERISTIC fmy_id_n_32_mon_1.c_err_clas "Failure class number for failure XX" VALUE 0xa08040e8 _REC_VAL_20_u1 255. _CNV_A_R_LINEAR_____0_CM 0. 255. DISPLAY_IDENTIFIER C_ERR_CLAS_N_32_MON_1 FORMAT "%3.0" /end CHARACTERISTIC
/begin CHARACTERISTIC fmy_id_pvs_mon_1.c_err_clas "Failure class number for failure XX" VALUE 0xa080446c _REC_VAL_20_u1 255. _CNV_A_R_LINEAR_____0_CM 0. 255. DISPLAY_IDENTIFIER C_ERR_CLAS_PVS_MON_1 FORMAT "%3.0" /end CHARACTERISTIC
/begin CHARACTERISTIC fmy_id_tq_dif_isc_mon_1.c_err_clas "Failure class number for failure XX" VALUE 0xa0804c64 _REC_VAL_20_u1 255. _CNV_A_R_LINEAR_____0_CM 0. 255. DISPLAY_IDENTIFIER C_ERR_CLAS_TQ_DIF_ISC_MON_1 FORMAT "%3.0" /end CHARACTERISTIC
/begin CHARACTERISTIC fmy_id_tq_req_mon_1.c_err_clas "Failure class number for failure XX" VALUE 0xa0804ca0 _REC_VAL_20_u1 255. _CNV_A_R_LINEAR_____0_CM 0. 255. DISPLAY_IDENTIFIER C_ERR_CLAS_TQ_REQ_MON_1 FORMAT "%3.0" /end CHARACTERISTIC
/begin CHARACTERISTIC fmy_id_tq_ext_mon_1.c_err_clas "Failure class number for failure XX" VALUE 0xa0804c78 _REC_VAL_20_u1 255. _CNV_A_R_LINEAR_____0_CM 0. 255. DISPLAY_IDENTIFIER C_ERR_CLAS_TQ_EXT_MON_1 FORMAT "%3.0" /end CHARACTERISTIC
/begin CHARACTERISTIC fmy_id_tqi_av_mon_1.c_err_clas "Failure class number for failure XX" VALUE 0xa0804cb4 _REC_VAL_20_u1 255. _CNV_A_R_LINEAR_____0_CM 0. 255. DISPLAY_IDENTIFIER C_ERR_CLAS_TQI_AV_MON_1 FORMAT "%3.0" /end CHARACTERISTIC
/begin CHARACTERISTIC fmy_id_tqi_n_max_mon_1.c_err_clas "Failure class number for failure XX" VALUE 0xa0804cdc _REC_VAL_20_u1 255. _CNV_A_R_LINEAR_____0_CM 0. 255. DISPLAY_IDENTIFIER C_ERR_CLAS_TQI_N_MAX_MON_1 FORMAT "%3.0" /end CHARACTERISTIC
/begin CHARACTERISTIC fmy_id_mff_mon_1.c_err_clas "Failure class number for failure XX" VALUE 0xa0803fa8 _REC_VAL_20_u1 255. _CNV_A_R_LINEAR_____0_CM 0. 255. DISPLAY_IDENTIFIER C_ERR_CLAS_MFF_MON_1 FORMAT "%3.0" /end CHARACTERISTIC
/begin CHARACTERISTIC fmy_id_cru_inh_mon_1.c_err_clas "Failure class number for failure XX" VALUE 0xa0803238 _REC_VAL_20_u1 255. _CNV_A_R_LINEAR_____0_CM 0. 255. DISPLAY_IDENTIFIER C_ERR_CLAS_CRU_INH_MON_1 FORMAT "%3.0" /end CHARACTERISTIC
/begin CHARACTERISTIC fmy_id_swi_afs_mon.c_err_clas "Failure class number for failure XX" VALUE 0xa080478c _REC_VAL_20_u1 255. _CNV_A_R_LINEAR_____0_CM 0. 255. DISPLAY_IDENTIFIER C_ERR_CLAS_SWI_AFS_MON FORMAT "%3.0" /end CHARACTERISTIC
/begin CHARACTERISTIC fmy_id_iv_0.c_err_clas "Failure class number for failure XX" VALUE 0xa0803be8 _REC_VAL_20_u1 255. _CNV_A_R_LINEAR_____0_CM 0. 255. DISPLAY_IDENTIFIER C_ERR_CLAS_IV_0 FORMAT "%3.0" /end CHARACTERISTIC
/begin CHARACTERISTIC fmy_id_iv_1.c_err_clas "Failure class number for failure XX" VALUE 0xa0803bfc _REC_VAL_20_u1 255. _CNV_A_R_LINEAR_____0_CM 0. 255. DISPLAY_IDENTIFIER C_ERR_CLAS_IV_1 FORMAT "%3.0" /end CHARACTERISTIC
/begin CHARACTERISTIC fmy_id_iv_2.c_err_clas "Failure class number for failure XX" VALUE 0xa0803c10 _REC_VAL_20_u1 255. _CNV_A_R_LINEAR_____0_CM 0. 255. DISPLAY_IDENTIFIER C_ERR_CLAS_IV_2 FORMAT "%3.0" /end CHARACTERISTIC
/begin CHARACTERISTIC fmy_id_iv_3.c_err_clas "Failure class number for failure XX" VALUE 0xa0803c24 _REC_VAL_20_u1 255. _CNV_A_R_LINEAR_____0_CM 0. 255. DISPLAY_IDENTIFIER C_ERR_CLAS_IV_3 FORMAT "%3.0" /end CHARACTERISTIC
/begin CHARACTERISTIC fmy_id_iv_4.c_err_clas "Failure class number for failure XX" VALUE 0xa0803c38 _REC_VAL_20_u1 255. _CNV_A_R_LINEAR_____0_CM 0. 255. DISPLAY_IDENTIFIER C_ERR_CLAS_IV_4 FORMAT "%3.0" /end CHARACTERISTIC
/begin CHARACTERISTIC fmy_id_iv_5.c_err_clas "Failure class number for failure XX" VALUE 0xa0803c4c _REC_VAL_20_u1 255. _CNV_A_R_LINEAR_____0_CM 0. 255. DISPLAY_IDENTIFIER C_ERR_CLAS_IV_5 FORMAT "%3.0" /end CHARACTERISTIC
/begin CHARACTERISTIC fmy_id_iv_6.c_err_clas "Failure class number for failure XX" VALUE 0xa0803c60 _REC_VAL_20_u1 255. _CNV_A_R_LINEAR_____0_CM 0. 255. DISPLAY_IDENTIFIER C_ERR_CLAS_IV_6 FORMAT "%3.0" /end CHARACTERISTIC
/begin CHARACTERISTIC fmy_id_iv_7.c_err_clas "Failure class number for failure XX" VALUE 0xa0803c74 _REC_VAL_20_u1 255. _CNV_A_R_LINEAR_____0_CM 0. 255. DISPLAY_IDENTIFIER C_ERR_CLAS_IV_7 FORMAT "%3.0" /end CHARACTERISTIC
/begin CHARACTERISTIC fmy_id_iv_sc_0.c_err_clas "Failure class number for failure XX" VALUE 0xa0803c88 _REC_VAL_20_u1 255. _CNV_A_R_LINEAR_____0_CM 0. 255. DISPLAY_IDENTIFIER C_ERR_CLAS_IV_SC_0 FORMAT "%3.0" /end CHARACTERISTIC
/begin CHARACTERISTIC fmy_id_iv_sc_1.c_err_clas "Failure class number for failure XX" VALUE 0xa0803c9c _REC_VAL_20_u1 255. _CNV_A_R_LINEAR_____0_CM 0. 255. DISPLAY_IDENTIFIER C_ERR_CLAS_IV_SC_1 FORMAT "%3.0" /end CHARACTERISTIC
/begin CHARACTERISTIC fmy_id_iv_sc_2.c_err_clas "Failure class number for failure XX" VALUE 0xa0803cb0 _REC_VAL_20_u1 255. _CNV_A_R_LINEAR_____0_CM 0. 255. DISPLAY_IDENTIFIER C_ERR_CLAS_IV_SC_2 FORMAT "%3.0" /end CHARACTERISTIC
/begin CHARACTERISTIC fmy_id_iv_sc_3.c_err_clas "Failure class number for failure XX" VALUE 0xa0803cc4 _REC_VAL_20_u1 255. _CNV_A_R_LINEAR_____0_CM 0. 255. DISPLAY_IDENTIFIER C_ERR_CLAS_IV_SC_3 FORMAT "%3.0" /end CHARACTERISTIC
/begin CHARACTERISTIC fmy_id_iv_sc_4.c_err_clas "Failure class number for failure XX" VALUE 0xa0803cd8 _REC_VAL_20_u1 255. _CNV_A_R_LINEAR_____0_CM 0. 255. DISPLAY_IDENTIFIER C_ERR_CLAS_IV_SC_4 FORMAT "%3.0" /end CHARACTERISTIC
/begin CHARACTERISTIC fmy_id_iv_sc_5.c_err_clas "Failure class number for failure XX" VALUE 0xa0803cec _REC_VAL_20_u1 255. _CNV_A_R_LINEAR_____0_CM 0. 255. DISPLAY_IDENTIFIER C_ERR_CLAS_IV_SC_5 FORMAT "%3.0" /end CHARACTERISTIC
/begin CHARACTERISTIC fmy_id_iv_sc_6.c_err_clas "Failure class number for failure XX" VALUE 0xa0803d00 _REC_VAL_20_u1 255. _CNV_A_R_LINEAR_____0_CM 0. 255. DISPLAY_IDENTIFIER C_ERR_CLAS_IV_SC_6 FORMAT "%3.0" /end CHARACTERISTIC
/begin CHARACTERISTIC fmy_id_iv_sc_7.c_err_clas "Failure class number for failure XX" VALUE 0xa0803d14 _REC_VAL_20_u1 255. _CNV_A_R_LINEAR_____0_CM 0. 255. DISPLAY_IDENTIFIER C_ERR_CLAS_IV_SC_7 FORMAT "%3.0" /end CHARACTERISTIC
/begin CHARACTERISTIC fmy_id_pbk_iv_1.c_err_clas "Failure class number for failure XX" VALUE 0xa080423c _REC_VAL_20_u1 255. _CNV_A_R_LINEAR_____0_CM 0. 255. DISPLAY_IDENTIFIER C_ERR_CLAS_PBK_IV_1 FORMAT "%3.0" /end CHARACTERISTIC
/begin CHARACTERISTIC fmy_id_pbk_iv_2.c_err_clas "Failure class number for failure XX" VALUE 0xa0804250 _REC_VAL_20_u1 255. _CNV_A_R_LINEAR_____0_CM 0. 255. DISPLAY_IDENTIFIER C_ERR_CLAS_PBK_IV_2 FORMAT "%3.0" /end CHARACTERISTIC
/begin CHARACTERISTIC fmy_id_pbk_iv_3.c_err_clas "Failure class number for failure XX" VALUE 0xa0804264 _REC_VAL_20_u1 255. _CNV_A_R_LINEAR_____0_CM 0. 255. DISPLAY_IDENTIFIER C_ERR_CLAS_PBK_IV_3 FORMAT "%3.0" /end CHARACTERISTIC
/begin CHARACTERISTIC fmy_id_pbk_iv_4.c_err_clas "Failure class number for failure XX" VALUE 0xa0804278 _REC_VAL_20_u1 255. _CNV_A_R_LINEAR_____0_CM 0. 255. DISPLAY_IDENTIFIER C_ERR_CLAS_PBK_IV_4 FORMAT "%3.0" /end CHARACTERISTIC
/begin AXIS_PTS ldp_nr_1_id_err_dtc "" 0xa0802916 errm_online_dummy _REC_AXS_20_u2 1. _CNV_S_2_ERRM_DTC_R_477_CM 1 0. 1. /end AXIS_PTS
/begin AXIS_PTS ldp_nr_2_id_err_dtc "" 0xa080291c errm_online_dummy _REC_AXS_20_u2 5. _CNV_S_6_ERRM_DTC_R_478_CM 6 0. 5. /end AXIS_PTS
/begin MEASUREMENT fmy_ram_dyn[0].err_dtc "DTC code stored in memory for failure IDX" UWORD _CNV_A_R_LINEAR_____0_CM 1 100. 0. 65535. DISPLAY_IDENTIFIER ERR_DTC[0] ECU_ADDRESS 0xd0009318 FORMAT "%5.0" /end MEASUREMENT
/begin MEASUREMENT fmy_ram_dyn[0].err_info_dyn.err_sym_lst "Memorized the last detected symptom of the failure IDX (for the DTC building)" UWORD _CNV_S_16_RANGE_ERR__479_CM 1 100. 0. 15. DISPLAY_IDENTIFIER ERR_SYM_LST[0] ECU_ADDRESS 0xd000931c BIT_MASK 0xF /end MEASUREMENT
/begin MEASUREMENT fmy_ram_dyn[0].err_info_dyn.err_sym_mem "Memorized detected symptom of the failure IDX (for the DTC building)" UWORD _CNV_S_16_RANGE_ERR__479_CM 1 100. 0. 15. DISPLAY_IDENTIFIER ERR_SYM_MEM[0] ECU_ADDRESS 0xd000931c BIT_MASK 0xF000 /end MEASUREMENT
/begin MEASUREMENT fmy_ram_dyn[1].err_dtc "DTC code stored in memory for failure IDX" UWORD _CNV_A_R_LINEAR_____0_CM 1 100. 0. 65535. DISPLAY_IDENTIFIER ERR_DTC[1] ECU_ADDRESS 0xd0009328 FORMAT "%5.0" /end MEASUREMENT
/begin MEASUREMENT fmy_ram_dyn[1].err_info_dyn.err_sym_lst "Memorized the last detected symptom of the failure IDX (for the DTC building)" UWORD _CNV_S_16_RANGE_ERR__479_CM 1 100. 0. 15. DISPLAY_IDENTIFIER ERR_SYM_LST[1] ECU_ADDRESS 0xd000932c BIT_MASK 0xF /end MEASUREMENT
/begin MEASUREMENT fmy_ram_dyn[1].err_info_dyn.err_sym_mem "Memorized detected symptom of the failure IDX (for the DTC building)" UWORD _CNV_S_16_RANGE_ERR__479_CM 1 100. 0. 15. DISPLAY_IDENTIFIER ERR_SYM_MEM[1] ECU_ADDRESS 0xd000932c BIT_MASK 0xF000 /end MEASUREMENT
/begin MEASUREMENT fmy_ram_dyn[2].err_dtc "DTC code stored in memory for failure IDX" UWORD _CNV_A_R_LINEAR_____0_CM 1 100. 0. 65535. DISPLAY_IDENTIFIER ERR_DTC[2] ECU_ADDRESS 0xd0009338 FORMAT "%5.0" /end MEASUREMENT
/begin MEASUREMENT fmy_ram_dyn[2].err_info_dyn.err_sym_lst "Memorized the last detected symptom of the failure IDX (for the DTC building)" UWORD _CNV_S_16_RANGE_ERR__479_CM 1 100. 0. 15. DISPLAY_IDENTIFIER ERR_SYM_LST[2] ECU_ADDRESS 0xd000933c BIT_MASK 0xF /end MEASUREMENT
/begin MEASUREMENT fmy_ram_dyn[2].err_info_dyn.err_sym_mem "Memorized detected symptom of the failure IDX (for the DTC building)" UWORD _CNV_S_16_RANGE_ERR__479_CM 1 100. 0. 15. DISPLAY_IDENTIFIER ERR_SYM_MEM[2] ECU_ADDRESS 0xd000933c BIT_MASK 0xF000 /end MEASUREMENT
/begin MEASUREMENT fmy_ram_dyn[3].err_dtc "DTC code stored in memory for failure IDX" UWORD _CNV_A_R_LINEAR_____0_CM 1 100. 0. 65535. DISPLAY_IDENTIFIER ERR_DTC[3] ECU_ADDRESS 0xd0009348 FORMAT "%5.0" /end MEASUREMENT
/begin MEASUREMENT fmy_ram_dyn[3].err_info_dyn.err_sym_lst "Memorized the last detected symptom of the failure IDX (for the DTC building)" UWORD _CNV_S_16_RANGE_ERR__479_CM 1 100. 0. 15. DISPLAY_IDENTIFIER ERR_SYM_LST[3] ECU_ADDRESS 0xd000934c BIT_MASK 0xF /end MEASUREMENT
/begin MEASUREMENT fmy_ram_dyn[3].err_info_dyn.err_sym_mem "Memorized detected symptom of the failure IDX (for the DTC building)" UWORD _CNV_S_16_RANGE_ERR__479_CM 1 100. 0. 15. DISPLAY_IDENTIFIER ERR_SYM_MEM[3] ECU_ADDRESS 0xd000934c BIT_MASK 0xF000 /end MEASUREMENT
/begin MEASUREMENT fmy_ram_dyn[4].err_dtc "DTC code stored in memory for failure IDX" UWORD _CNV_A_R_LINEAR_____0_CM 1 100. 0. 65535. DISPLAY_IDENTIFIER ERR_DTC[4] ECU_ADDRESS 0xd0009358 FORMAT "%5.0" /end MEASUREMENT
/begin MEASUREMENT fmy_ram_dyn[4].err_info_dyn.err_sym_lst "Memorized the last detected symptom of the failure IDX (for the DTC building)" UWORD _CNV_S_16_RANGE_ERR__479_CM 1 100. 0. 15. DISPLAY_IDENTIFIER ERR_SYM_LST[4] ECU_ADDRESS 0xd000935c BIT_MASK 0xF /end MEASUREMENT
/begin MEASUREMENT fmy_ram_dyn[4].err_info_dyn.err_sym_mem "Memorized detected symptom of the failure IDX (for the DTC building)" UWORD _CNV_S_16_RANGE_ERR__479_CM 1 100. 0. 15. DISPLAY_IDENTIFIER ERR_SYM_MEM[4] ECU_ADDRESS 0xd000935c BIT_MASK 0xF000 /end MEASUREMENT
/begin MEASUREMENT fmy_ram_dyn[5].err_dtc "DTC code stored in memory for failure IDX" UWORD _CNV_A_R_LINEAR_____0_CM 1 100. 0. 65535. DISPLAY_IDENTIFIER ERR_DTC[5] ECU_ADDRESS 0xd0009368 FORMAT "%5.0" /end MEASUREMENT
/begin MEASUREMENT fmy_ram_dyn[5].err_info_dyn.err_sym_lst "Memorized the last detected symptom of the failure IDX (for the DTC building)" UWORD _CNV_S_16_RANGE_ERR__479_CM 1 100. 0. 15. DISPLAY_IDENTIFIER ERR_SYM_LST[5] ECU_ADDRESS 0xd000936c BIT_MASK 0xF /end MEASUREMENT
/begin MEASUREMENT fmy_ram_dyn[5].err_info_dyn.err_sym_mem "Memorized detected symptom of the failure IDX (for the DTC building)" UWORD _CNV_S_16_RANGE_ERR__479_CM 1 100. 0. 15. DISPLAY_IDENTIFIER ERR_SYM_MEM[5] ECU_ADDRESS 0xd000936c BIT_MASK 0xF000 /end MEASUREMENT
/begin MEASUREMENT fmy_ram_dyn[6].err_dtc "DTC code stored in memory for failure IDX" UWORD _CNV_A_R_LINEAR_____0_CM 1 100. 0. 65535. DISPLAY_IDENTIFIER ERR_DTC[6] ECU_ADDRESS 0xd0009378 FORMAT "%5.0" /end MEASUREMENT
/begin MEASUREMENT fmy_ram_dyn[6].err_info_dyn.err_sym_lst "Memorized the last detected symptom of the failure IDX (for the DTC building)" UWORD _CNV_S_16_RANGE_ERR__479_CM 1 100. 0. 15. DISPLAY_IDENTIFIER ERR_SYM_LST[6] ECU_ADDRESS 0xd000937c BIT_MASK 0xF /end MEASUREMENT
/begin MEASUREMENT fmy_ram_dyn[6].err_info_dyn.err_sym_mem "Memorized detected symptom of the failure IDX (for the DTC building)" UWORD _CNV_S_16_RANGE_ERR__479_CM 1 100. 0. 15. DISPLAY_IDENTIFIER ERR_SYM_MEM[6] ECU_ADDRESS 0xd000937c BIT_MASK 0xF000 /end MEASUREMENT
/begin MEASUREMENT fmy_ram_dyn[7].err_dtc "DTC code stored in memory for failure IDX" UWORD _CNV_A_R_LINEAR_____0_CM 1 100. 0. 65535. DISPLAY_IDENTIFIER ERR_DTC[7] ECU_ADDRESS 0xd0009388 FORMAT "%5.0" /end MEASUREMENT
/begin MEASUREMENT fmy_ram_dyn[7].err_info_dyn.err_sym_lst "Memorized the last detected symptom of the failure IDX (for the DTC building)" UWORD _CNV_S_16_RANGE_ERR__479_CM 1 100. 0. 15. DISPLAY_IDENTIFIER ERR_SYM_LST[7] ECU_ADDRESS 0xd000938c BIT_MASK 0xF /end MEASUREMENT
/begin MEASUREMENT fmy_ram_dyn[7].err_info_dyn.err_sym_mem "Memorized detected symptom of the failure IDX (for the DTC building)" UWORD _CNV_S_16_RANGE_ERR__479_CM 1 100. 0. 15. DISPLAY_IDENTIFIER ERR_SYM_MEM[7] ECU_ADDRESS 0xd000938c BIT_MASK 0xF000 /end MEASUREMENT
/begin MEASUREMENT fmy_ram_dyn[8].err_dtc "DTC code stored in memory for failure IDX" UWORD _CNV_A_R_LINEAR_____0_CM 1 100. 0. 65535. DISPLAY_IDENTIFIER ERR_DTC[8] ECU_ADDRESS 0xd0009398 FORMAT "%5.0" /end MEASUREMENT
/begin MEASUREMENT fmy_ram_dyn[8].err_info_dyn.err_sym_lst "Memorized the last detected symptom of the failure IDX (for the DTC building)" UWORD _CNV_S_16_RANGE_ERR__479_CM 1 100. 0. 15. DISPLAY_IDENTIFIER ERR_SYM_LST[8] ECU_ADDRESS 0xd000939c BIT_MASK 0xF /end MEASUREMENT
/begin MEASUREMENT fmy_ram_dyn[8].err_info_dyn.err_sym_mem "Memorized detected symptom of the failure IDX (for the DTC building)" UWORD _CNV_S_16_RANGE_ERR__479_CM 1 100. 0. 15. DISPLAY_IDENTIFIER ERR_SYM_MEM[8] ECU_ADDRESS 0xd000939c BIT_MASK 0xF000 /end MEASUREMENT
/begin MEASUREMENT fmy_ram_dyn[9].err_dtc "DTC code stored in memory for failure IDX" UWORD _CNV_A_R_LINEAR_____0_CM 1 100. 0. 65535. DISPLAY_IDENTIFIER ERR_DTC[9] ECU_ADDRESS 0xd00093a8 FORMAT "%5.0" /end MEASUREMENT
/begin MEASUREMENT fmy_ram_dyn[9].err_info_dyn.err_sym_lst "Memorized the last detected symptom of the failure IDX (for the DTC building)" UWORD _CNV_S_16_RANGE_ERR__479_CM 1 100. 0. 15. DISPLAY_IDENTIFIER ERR_SYM_LST[9] ECU_ADDRESS 0xd00093ac BIT_MASK 0xF /end MEASUREMENT
/begin MEASUREMENT fmy_ram_dyn[9].err_info_dyn.err_sym_mem "Memorized detected symptom of the failure IDX (for the DTC building)" UWORD _CNV_S_16_RANGE_ERR__479_CM 1 100. 0. 15. DISPLAY_IDENTIFIER ERR_SYM_MEM[9] ECU_ADDRESS 0xd00093ac BIT_MASK 0xF000 /end MEASUREMENT
/begin COMPU_METHOD _CNV_A_R_LINEAR_____0_CM "" RAT_FUNC "%6.3" "-" COEFFS 0 1. 0. 0 0 1 /end COMPU_METHOD
/begin COMPU_METHOD _CNV_S_2_RANGE__0___1_CM "" TAB_VERB "%6.3" "-" COMPU_TAB_REF _CNV_S_2_RANGE__0___1 /end COMPU_METHOD
/begin COMPU_VTAB _CNV_S_2_RANGE__0___1 "" TAB_VERB 2 0 "0" 1 "1" /end COMPU_VTAB
/begin COMPU_METHOD _CNV_A_R_LINEAR_____19_CM "" RAT_FUNC "%6.3" "s" COEFFS 0 2. 0. 0 0 1 /end COMPU_METHOD
/begin COMPU_METHOD _CNV_S_3_ERRM_RANGE_476_CM "" TAB_VERB "%6.3" "-" COMPU_TAB_REF _CNV_S_3_ERRM_RANGE_476 /end COMPU_METHOD
/begin COMPU_VTAB _CNV_S_3_ERRM_RANGE_476 "" TAB_VERB 3 0 "OFF" 1 "ON" 2 "LAMP BLINKING" /end COMPU_VTAB
/begin COMPU_METHOD _CNV_S_2_ERRM_DTC_R_477_CM "" TAB_VERB "%6.3" "-" COMPU_TAB_REF _CNV_S_2_ERRM_DTC_R_477 /end COMPU_METHOD
/begin COMPU_VTAB _CNV_S_2_ERRM_DTC_R_477 "" TAB_VERB 2 0 "OBD" 1 "CUS" /end COMPU_VTAB
/begin COMPU_METHOD _CNV_S_6_ERRM_DTC_R_478_CM "" TAB_VERB "%6.3" "-" COMPU_TAB_REF _CNV_S_6_ERRM_DTC_R_478 /end COMPU_METHOD
/begin COMPU_VTAB _CNV_S_6_ERRM_DTC_R_478 "" TAB_VERB 6 0 "SYM0" 1 "SYM1" 2 "SYM2" 3 "SYM3" 4 "GLOBAL" 5 "DTC" /end COMPU_VTAB
/begin COMPU_METHOD _CNV_S_16_RANGE_ERR__479_CM "" TAB_VERB "%6.3" "" COMPU_TAB_REF _CNV_S_16_RANGE_ERR__479 /end COMPU_METHOD
/begin COMPU_VTAB _CNV_S_16_RANGE_ERR__479 "" TAB_VERB 16 0 "NO_SYM" 1 "SYM_0" 2 "SYM_1" 3 "SYM_0, SYM_1" 4 "SYM_2" 5 "SYM_0, SYM_2" 6 "SYM_1, SYM_2" 7 "SYM_0, SYM_1, SYM_2" 8 "SYM_3" 9 "SYM_0, SYM_3" 10 "SYM_1, SYM_3" 11 "SYM_0, SYM_1,SYM_3" 12 "SYM_2, SYM_3" 13 "SYM_0, SYM_2, SYM_3" 14 "SYM_1, SYM_2, SYM_3" 15 "SYM_0, SYM_1, SYM_2, SYM_3" /end COMPU_VTAB
/begin RECORD_LAYOUT _REC_VAL_20_u1 FNC_VALUES 1 UBYTE COLUMN_DIR DIRECT /end RECORD_LAYOUT
/begin RECORD_LAYOUT _REC_AXS_20_u2 NO_AXIS_PTS_X 1 UWORD AXIS_PTS_X 2 UWORD INDEX_INCR DIRECT /end RECORD_LAYOUT
/begin RECORD_LAYOUT _REC_CUR_20_u1_u2 FNC_VALUES 1 UBYTE COLUMN_DIR DIRECT /end RECORD_LAYOUT
/begin RECORD_LAYOUT _REC_MAP_20_u2_u2_u2 FNC_VALUES 1 UWORD COLUMN_DIR DIRECT /end RECORD_LAYOUT
/begin RECORD_LAYOUT _REC_MAP_20_u1_u2_u2 FNC_VALUES 1 UBYTE COLUMN_DIR DIRECT /end RECORD_LAYOUT
/begin FUNCTION ERRM_Lamp_Management "Lamp_Management"
 /begin DEF_CHARACTERISTIC c_conf_mil c_conf_wal_1 c_conf_wal_2 c_dly_inh_iv_mis c_dly_mil_ready_2 c_dly_mil_ready_1 c_t_min_wal_st lc_t_max_wal_st_ena /end DEF_CHARACTERISTIC
 /begin OUT_MEASUREMENT state_mil lv_wal_2 state_wal_1 state_wal_2 lv_wal_1 lv_wal_st dly_mil_ready lv_mil lv_mil_wup lv_wal_1_wup lv_wal_2_wup lv_mil_fll_ready t_wal_st /end OUT_MEASUREMENT
/end FUNCTION
/begin FUNCTION ERRM_Failure_Classes "Failure_Classes"
 /begin DEF_CHARACTERISTIC id_err_clas_a_fmt id_err_clas_b_fmt ldpm_clas_a_id_clas_fmy ldp_clas_b_id_clas_fmy fmy_id_imob_0.c_err_clas fmy_id_imob_1.c_err_clas fmy_id_imob_2.c_err_clas fmy_id_imob_3.c_err_clas fmy_id_tco_el.c_err_clas fmy_id_tco_grd.c_err_clas fmy_id_tco_stuck.c_err_clas fmy_id_tco_stuck_rng.c_err_clas fmy_id_tco_plaus.c_err_clas fmy_id_tco_2_el.c_err_clas fmy_id_tco_2_grd.c_err_clas fmy_id_tco_2_plaus.c_err_clas fmy_id_ect_el.c_err_clas fmy_id_ecf_el_1.c_err_clas fmy_id_ecf_el_2.c_err_clas fmy_id_ecfpwm_fb_1.c_err_clas fmy_id_ecfpwm_fb_2.c_err_clas fmy_id_th.c_err_clas fmy_id_ftl_min.c_err_clas fmy_id_tia_el_1.c_err_clas fmy_id_tia_el_2.c_err_clas fmy_id_tia_thr_el_1.c_err_clas fmy_id_tia_thr_el_2.c_err_clas fmy_id_amp.c_err_clas fmy_id_amp_plaus.c_err_clas fmy_id_maf.c_err_clas fmy_id_el_cps.c_err_clas fmy_id_slv_ivvt_in_1.c_err_clas fmy_id_slv_ivvt_in_2.c_err_clas fmy_id_slv_ivvt_ex_1.c_err_clas fmy_id_slv_ivvt_ex_2.c_err_clas fmy_id_ecu_cks.c_err_clas fmy_id_vs.c_err_clas fmy_id_knks_1.c_err_clas fmy_id_knks_2.c_err_clas fmy_id_knks_3.c_err_clas fmy_id_knks_4.c_err_clas fmy_id_rfp_dr_1.c_err_clas fmy_id_rfp_dr_2.c_err_clas fmy_id_wg_1_dr.c_err_clas fmy_id_wg_2_dr.c_err_clas fmy_id_put_el_1.c_err_clas fmy_id_put_el_2.c_err_clas fmy_id_igc_scp_0.c_err_clas fmy_id_igc_scp_1.c_err_clas fmy_id_igc_scp_2.c_err_clas fmy_id_igc_scp_3.c_err_clas fmy_id_igc_scp_4.c_err_clas fmy_id_igc_scp_5.c_err_clas fmy_id_igc_scp_6.c_err_clas fmy_id_igc_scp_7.c_err_clas fmy_id_igc_scg_0.c_err_clas fmy_id_igc_scg_1.c_err_clas fmy_id_igc_scg_2.c_err_clas fmy_id_igc_scg_3.c_err_clas fmy_id_igc_scg_4.c_err_clas fmy_id_igc_scg_5.c_err_clas fmy_id_igc_scg_6.c_err_clas fmy_id_igc_scg_7.c_err_clas fmy_id_igc_ol_0.c_err_clas fmy_id_igc_ol_1.c_err_clas fmy_id_igc_ol_2.c_err_clas fmy_id_igc_ol_3.c_err_clas fmy_id_igc_ol_4.c_err_clas fmy_id_igc_ol_5.c_err_clas fmy_id_igc_ol_6.c_err_clas fmy_id_igc_ol_7.c_err_clas fmy_id_dur_igc_mpl.c_err_clas fmy_id_v_ref_1.c_err_clas fmy_id_v_ref_2.c_err_clas fmy_id_pvs_1.c_err_clas fmy_id_pvs_2.c_err_clas fmy_id_pvs_ratio.c_err_clas fmy_id_pvs_double.c_err_clas fmy_id_pvs_bls_not_plaus.c_err_clas fmy_id_mtc_ctl_1.c_err_clas fmy_id_gen.c_err_clas fmy_id_gen_diag.c_err_clas fmy_id_alter_bn.c_err_clas fmy_id_alter_bn_bat.c_err_clas fmy_id_t_es.c_err_clas fmy_id_map_dip_plaus.c_err_clas fmy_id_toil_level.c_err_clas fmy_id_alter_bn_rgn.c_err_clas fmy_id_per_cam_in_1.c_err_clas fmy_id_per_cam_ex_1.c_err_clas fmy_id_syn_cam_in_1.c_err_clas fmy_id_syn_cam_ex_1.c_err_clas fmy_id_ref_crk_cam_in_1.c_err_clas fmy_id_ref_crk_cam_ex_1.c_err_clas fmy_id_per_cam_in_2.c_err_clas fmy_id_per_cam_ex_2.c_err_clas fmy_id_syn_cam_in_2.c_err_clas fmy_id_syn_cam_ex_2.c_err_clas fmy_id_ref_crk_cam_in_2.c_err_clas fmy_id_ref_crk_cam_ex_2.c_err_clas fmy_id_crk_tooth.c_err_clas fmy_id_crk_tooth_per.c_err_clas fmy_id_crk_syn.c_err_clas fmy_id_crk_plaus.c_err_clas fmy_id_plaus_cam_in_1.c_err_clas fmy_id_plaus_cam_ex_1.c_err_clas fmy_id_syn_crk_cam_in_1.c_err_clas fmy_id_syn_crk_cam_ex_1.c_err_clas fmy_id_tooth_off_in_1.c_err_clas fmy_id_tooth_off_ex_1.c_err_clas fmy_id_plaus_cam_in_2.c_err_clas fmy_id_plaus_cam_ex_2.c_err_clas fmy_id_syn_crk_cam_in_2.c_err_clas fmy_id_syn_crk_cam_ex_2.c_err_clas fmy_id_tooth_off_in_2.c_err_clas fmy_id_tooth_off_ex_2.c_err_clas fmy_id_can_boff.c_err_clas fmy_id_rly_main.c_err_clas fmy_id_rly_main_dly.c_err_clas fmy_id_rly_accout.c_err_clas fmy_id_isc.c_err_clas fmy_id_isc_cst.c_err_clas fmy_id_im_bls_plaus.c_err_clas fmy_id_im_bts_plaus.c_err_clas fmy_id_msw_tog.c_err_clas fmy_id_msw_2.c_err_clas fmy_id_msw_3.c_err_clas fmy_id_mis_0.c_err_clas fmy_id_mis_1.c_err_clas fmy_id_mis_2.c_err_clas fmy_id_mis_3.c_err_clas fmy_id_mis_4.c_err_clas fmy_id_mis_5.c_err_clas fmy_id_mis_6.c_err_clas fmy_id_mis_7.c_err_clas fmy_id_mis_mpl.c_err_clas fmy_id_mis_ftl_l.c_err_clas fmy_id_ef.c_err_clas fmy_id_tecu.c_err_clas fmy_id_ebox_cfa.c_err_clas fmy_id_ecu_ram.c_err_clas fmy_id_tqi_lim.c_err_clas fmy_id_dmtls.c_err_clas fmy_id_dmtl_pump.c_err_clas fmy_id_dmtlm.c_err_clas fmy_id_rough_leak.c_err_clas fmy_id_small_leak.c_err_clas fmy_id_chk_fuc.c_err_clas fmy_id_sof.c_err_clas fmy_id_sof_req.c_err_clas fmy_id_rly_crcv_heat.c_err_clas fmy_id_rly_st.c_err_clas fmy_id_bsd.c_err_clas fmy_id_poil_swi.c_err_clas fmy_id_tout_efp_can.c_err_clas fmy_id_diagcps.c_err_clas fmy_id_dcc.c_err_clas fmy_id_ldm.c_err_clas fmy_id_dmtlh.c_err_clas fmy_id_cs.c_err_clas fmy_id_spi_mps.c_err_clas fmy_id_spi_knk.c_err_clas fmy_id_sens_poil.c_err_clas fmy_id_poil_dr.c_err_clas fmy_id_bn_tq_dcc.c_err_clas fmy_id_bn_tq_pste_2.c_err_clas fmy_id_bn_tq_pste_3.c_err_clas fmy_id_bn_ars.c_err_clas fmy_id_bn_cas.c_err_clas fmy_id_bn_tq_tcs.c_err_clas fmy_id_bn_vs_tcs.c_err_clas fmy_id_bn_tcs.c_err_clas fmy_id_bn_tq_etcu.c_err_clas fmy_id_bn_etcu.c_err_clas fmy_id_bn_etcu_2.c_err_clas fmy_id_bn_etcu_3.c_err_clas fmy_id_bn_etcu_disp.c_err_clas fmy_id_bn_tq_amt.c_err_clas fmy_id_bn_acc.c_err_clas fmy_id_bn_t_icl.c_err_clas fmy_id_bn_veh_mod.c_err_clas fmy_id_bn_km_icl.c_err_clas fmy_id_bn_icl.c_err_clas fmy_id_bn_pow_vb.c_err_clas fmy_id_bn_pow_gen.c_err_clas fmy_id_bn_msw.c_err_clas fmy_id_bn_ang_pste.c_err_clas fmy_id_bn_gear_rev.c_err_clas fmy_id_bn_ltg_hdlp_l.c_err_clas fmy_id_bn_ldm.c_err_clas fmy_id_bn_trl.c_err_clas fmy_id_bn_hiv.c_err_clas fmy_id_bn_t_clk.c_err_clas fmy_id_bn_efp_crash.c_err_clas fmy_id_bn_cdn_door.c_err_clas fmy_id_bn_req_pbr.c_err_clas fmy_id_bn_pbr.c_err_clas fmy_id_bn_efp.c_err_clas fmy_id_load_tps_plaus.c_err_clas fmy_id_egy_min.c_err_clas fmy_id_locan_boff.c_err_clas fmy_id_cwp_plaus.c_err_clas fmy_id_cwp_int_off.c_err_clas fmy_id_cwp_pwr.c_err_clas fmy_id_cwp_com_plaus.c_err_clas fmy_id_qoil_sens.c_err_clas fmy_id_bat_sens.c_err_clas fmy_id_bat_sens_it.c_err_clas fmy_id_bat_sens_it_el.c_err_clas fmy_id_ecu_nvmy.c_err_clas fmy_id_gs.c_err_clas fmy_id_plaus_igk_bn.c_err_clas fmy_id_tq_req_can.c_err_clas fmy_id_map_sens_1.c_err_clas fmy_id_map_sens_2.c_err_clas fmy_id_dtc_trm.c_err_clas fmy_id_mec_ivvt_in_1.c_err_clas fmy_id_mec_ivvt_in_2.c_err_clas fmy_id_mec_ivvt_ex.c_err_clas fmy_id_tout_nox_sens_1.c_err_clas fmy_id_tout_nox_sens_2.c_err_clas fmy_id_vvl_rot.c_err_clas fmy_id_rly_vvl.c_err_clas fmy_id_nox_sens_1.c_err_clas fmy_id_ns_obd_1_1.c_err_clas fmy_id_ns_obd_1_2.c_err_clas fmy_id_ovl_ecu_vvl.c_err_clas fmy_id_dr_sc_vvl.c_err_clas fmy_id_crit_ovl_ecu_vvl.c_err_clas fmy_id_nox_sens_2.c_err_clas fmy_id_cur_h_vvl.c_err_clas fmy_id_teg_pcat_down.c_err_clas fmy_id_t_seg_er.c_err_clas fmy_id_seg_ad_er.c_err_clas fmy_id_vs_plaus.c_err_clas fmy_id_ftl_obd.c_err_clas fmy_id_ftl_le_can.c_err_clas fmy_id_ftl_ri_can.c_err_clas fmy_id_tia_plaus.c_err_clas fmy_id_tam_can.c_err_clas fmy_id_tam_plaus.c_err_clas fmy_id_map_shift_1.c_err_clas fmy_id_map_shift_2.c_err_clas fmy_id_cat_diag_1.c_err_clas fmy_id_cat_diag_2.c_err_clas fmy_id_cat_diag_afl_1.c_err_clas fmy_id_cat_diag_afl_2.c_err_clas fmy_id_scg_ls_down_1.c_err_clas fmy_id_scp_ls_down_1.c_err_clas fmy_id_oc_ls_down_1.c_err_clas fmy_id_puc_ls_down_1.c_err_clas fmy_id_fl_ls_down_1.c_err_clas fmy_id_lsl_up_if_1.c_err_clas fmy_id_el_lsl_up_1.c_err_clas fmy_id_lsh_up_1.c_err_clas fmy_id_lsh_down_1.c_err_clas fmy_id_vls_down_dif_1.c_err_clas fmy_id_lsh_lsl_up_1.c_err_clas fmy_id_air_lsl_up_1.c_err_clas fmy_id_pue_ls_down_1.c_err_clas fmy_id_swt_ls_down_1.c_err_clas fmy_id_obd_lsh_down_1.c_err_clas fmy_id_dyn_vld_ls_up_1.c_err_clas fmy_id_puc_vld_ls_up_1.c_err_clas fmy_id_obd_vld_lsh_up_1.c_err_clas fmy_id_chk_ls_down_1.c_err_clas fmy_id_shift_afl_lsl_up_1.c_err_clas fmy_id_shift_afr_lsl_up_1.c_err_clas fmy_id_oc_lsl_up_1.c_err_clas fmy_id_delta_i_lam_1.c_err_clas fmy_id_ofs_lsl_up_1.c_err_clas fmy_id_ttip_mes_lsh_up_1.c_err_clas fmy_id_ctl_lsl_up_1.c_err_clas fmy_id_chg_ls_down.c_err_clas fmy_id_scg_ls_down_2.c_err_clas fmy_id_scp_ls_down_2.c_err_clas fmy_id_oc_ls_down_2.c_err_clas fmy_id_puc_ls_down_2.c_err_clas fmy_id_fl_ls_down_2.c_err_clas fmy_id_lsl_up_if_2.c_err_clas fmy_id_el_lsl_up_2.c_err_clas fmy_id_lsh_up_2.c_err_clas fmy_id_lsh_down_2.c_err_clas fmy_id_vls_down_dif_2.c_err_clas fmy_id_lsh_lsl_up_2.c_err_clas fmy_id_air_lsl_up_2.c_err_clas fmy_id_pue_ls_down_2.c_err_clas fmy_id_swt_ls_down_2.c_err_clas fmy_id_obd_lsh_down_2.c_err_clas fmy_id_dyn_vld_ls_up_2.c_err_clas fmy_id_puc_vld_ls_up_2.c_err_clas fmy_id_obd_vld_lsh_up_2.c_err_clas fmy_id_chk_ls_down_2.c_err_clas fmy_id_shift_afl_lsl_up_2.c_err_clas fmy_id_shift_afr_lsl_up_2.c_err_clas fmy_id_oc_lsl_up_2.c_err_clas fmy_id_delta_i_lam_2.c_err_clas fmy_id_ofs_lsl_up_2.c_err_clas fmy_id_ttip_mes_lsh_up_2.c_err_clas fmy_id_ctl_lsl_up_2.c_err_clas fmy_id_chg_ls_up.c_err_clas fmy_id_alter_com.c_err_clas fmy_id_cwp_com.c_err_clas fmy_id_qoil_com.c_err_clas fmy_id_sens_bat_smt_com.c_err_clas fmy_id_ecraspwm_fb.c_err_clas fmy_id_ecras_el.c_err_clas fmy_id_ecras_up_fb.c_err_clas fmy_id_ecras_down_fb.c_err_clas fmy_id_warm_rst.c_err_clas fmy_id_acr_ad.c_err_clas fmy_id_sens_acr.c_err_clas fmy_id_acr_ctl.c_err_clas fmy_id_acr_dr.c_err_clas fmy_id_var_cod.c_err_clas fmy_id_veh_pow_var.c_err_clas fmy_id_fup_mfp_plaus.c_err_clas fmy_id_h_prs_sys.c_err_clas fmy_id_fup_0.c_err_clas fmy_id_fup_1.c_err_clas fmy_id_vcv_fpc_0.c_err_clas fmy_id_fup_efp.c_err_clas fmy_id_efppwm_plaus.c_err_clas fmy_id_l_prs_sys.c_err_clas fmy_id_vcv_fpc_1.c_err_clas fmy_id_fsd_1.c_err_clas fmy_id_fsd_2.c_err_clas fmy_id_fsd_lam_lim_1.c_err_clas fmy_id_fsd_lam_lim_2.c_err_clas fmy_id_fsd_h_rng_1.c_err_clas fmy_id_fsd_h_rng_2.c_err_clas fmy_id_cyl_bal_lam_0.c_err_clas fmy_id_cyl_bal_lam_1.c_err_clas fmy_id_cyl_bal_lam_2.c_err_clas fmy_id_cyl_bal_lam_3.c_err_clas fmy_id_cyl_bal_lam_4.c_err_clas fmy_id_cyl_bal_lam_5.c_err_clas fmy_id_cyl_bal_lam_6.c_err_clas fmy_id_cyl_bal_lam_7.c_err_clas fmy_id_cyl_bal_er_0.c_err_clas fmy_id_cyl_bal_er_1.c_err_clas fmy_id_cyl_bal_er_2.c_err_clas fmy_id_cyl_bal_er_3.c_err_clas fmy_id_cyl_bal_er_4.c_err_clas fmy_id_cyl_bal_er_5.c_err_clas fmy_id_cyl_bal_er_6.c_err_clas fmy_id_cyl_bal_er_7.c_err_clas fmy_id_mon_3.c_err_clas fmy_id_maf_frq_rng_0.c_err_clas fmy_id_maf_frq_grd_0.c_err_clas fmy_id_maf_frq_el_0.c_err_clas fmy_id_maf_frq_rng_1.c_err_clas fmy_id_maf_frq_grd_1.c_err_clas fmy_id_maf_frq_el_1.c_err_clas fmy_id_tps_1_1.c_err_clas fmy_id_tps_1_2.c_err_clas fmy_id_tps_2_1.c_err_clas fmy_id_tps_2_2.c_err_clas fmy_id_tps_maf_1_1.c_err_clas fmy_id_tps_maf_1_2.c_err_clas fmy_id_tps_maf_2_1.c_err_clas fmy_id_tps_maf_2_2.c_err_clas fmy_id_tps_ratio_1.c_err_clas fmy_id_tps_ratio_2.c_err_clas fmy_id_tps_ad_1.c_err_clas fmy_id_tps_ad_2.c_err_clas fmy_id_etc_pwm_1.c_err_clas fmy_id_etc_pwm_2.c_err_clas fmy_id_etc_ctl_1.c_err_clas fmy_id_etc_ctl_2.c_err_clas fmy_id_tps_ad_spr_1.c_err_clas fmy_id_tps_ad_spr_2.c_err_clas fmy_id_etc_dr_1.c_err_clas fmy_id_etc_dr_2.c_err_clas fmy_id_tps_st_chk_1.c_err_clas fmy_id_tps_st_chk_2.c_err_clas fmy_id_com_1_tq_loss_cord.c_err_clas fmy_id_com_1_swi_gear.c_err_clas fmy_id_com_1_veh_mod.c_err_clas fmy_id_com_1_brake_tcs.c_err_clas fmy_id_com_1_tq_driv_asi.c_err_clas fmy_id_com_1_tq_tcs.c_err_clas fmy_id_com_1_tqb_tcs.c_err_clas fmy_id_com_1_wheel_tcs.c_err_clas fmy_id_com_1_req_tqdw.c_err_clas fmy_id_com_1_tq_pste.c_err_clas fmy_id_com_1_ang_pste.c_err_clas fmy_id_com_1_ac_trv.c_err_clas fmy_id_com_1_ac_lgt.c_err_clas fmy_id_com_1_tq_ars.c_err_clas fmy_id_com_1_ars.c_err_clas fmy_id_com_1_vs.c_err_clas fmy_id_com_1_tcs.c_err_clas fmy_id_com_1_boff.c_err_clas fmy_id_com_2_efp_crash.c_err_clas fmy_id_com_2_gb.c_err_clas fmy_id_com_2_etcu.c_err_clas fmy_id_com_2_tq_etcu.c_err_clas fmy_id_com_2_state_veh.c_err_clas fmy_id_com_2_cas_2.c_err_clas fmy_id_com_2_acc.c_err_clas fmy_id_com_2_km_icl.c_err_clas fmy_id_com_2_t_icl.c_err_clas fmy_id_com_2_tam_icl.c_err_clas fmy_id_com_2_t_clk.c_err_clas fmy_id_com_2_boff.c_err_clas fmy_id_com_2_t_absl_icl.c_err_clas fmy_id_com_2_cas.c_err_clas fmy_id_com_2_etcu_disp.c_err_clas fmy_id_com_2_pow_off.c_err_clas fmy_id_com_2_abs_icl.c_err_clas fmy_id_com_2_trl.c_err_clas fmy_id_com_2_hiv.c_err_clas fmy_id_com_2_icl.c_err_clas fmy_id_com_2_gear_rev.c_err_clas fmy_id_com_2_cdn_door.c_err_clas fmy_id_com_3_boff.c_err_clas fmy_id_com_3_efp.c_err_clas fmy_id_com_3_tq_etcu.c_err_clas fmy_id_com_3_etcu.c_err_clas fmy_id_com_3_etcu_disp.c_err_clas fmy_id_com_3_etcu_obd.c_err_clas fmy_id_com_3_gb.c_err_clas fmy_id_teg_sens_1.c_err_clas fmy_id_teg_sens_2.c_err_clas fmy_id_amp_plaus_cus.c_err_clas fmy_id_tcha_prs_low.c_err_clas fmy_id_tcha_leak.c_err_clas fmy_id_tcha_prs_dif.c_err_clas fmy_id_tcha_prs_high.c_err_clas fmy_id_put_plaus.c_err_clas fmy_id_map_plaus.c_err_clas fmy_id_tq_cst.c_err_clas fmy_id_gen_el.c_err_clas fmy_id_gen_mec.c_err_clas fmy_id_gen_h_temp.c_err_clas fmy_id_gen_typ_not_plaus.c_err_clas fmy_id_gen_msg_lost.c_err_clas fmy_id_gen_clc_v_not_plaus.c_err_clas fmy_id_gen_h_temp_clc.c_err_clas fmy_id_gen_ctl_not_plaus.c_err_clas fmy_id_slv_ivvt_in.c_err_clas fmy_id_slv_ivvt_ex.c_err_clas fmy_id_conv_mon_1.c_err_clas fmy_id_n_32_mon_1.c_err_clas fmy_id_pvs_mon_1.c_err_clas fmy_id_tq_dif_isc_mon_1.c_err_clas fmy_id_tq_req_mon_1.c_err_clas fmy_id_tq_ext_mon_1.c_err_clas fmy_id_tqi_av_mon_1.c_err_clas fmy_id_tqi_n_max_mon_1.c_err_clas fmy_id_mff_mon_1.c_err_clas fmy_id_cru_inh_mon_1.c_err_clas fmy_id_swi_afs_mon.c_err_clas fmy_id_iv_0.c_err_clas fmy_id_iv_1.c_err_clas fmy_id_iv_2.c_err_clas fmy_id_iv_3.c_err_clas fmy_id_iv_4.c_err_clas fmy_id_iv_5.c_err_clas fmy_id_iv_6.c_err_clas fmy_id_iv_7.c_err_clas fmy_id_iv_sc_0.c_err_clas fmy_id_iv_sc_1.c_err_clas fmy_id_iv_sc_2.c_err_clas fmy_id_iv_sc_3.c_err_clas fmy_id_iv_sc_4.c_err_clas fmy_id_iv_sc_5.c_err_clas fmy_id_iv_sc_6.c_err_clas fmy_id_iv_sc_7.c_err_clas fmy_id_pbk_iv_1.c_err_clas fmy_id_pbk_iv_2.c_err_clas fmy_id_pbk_iv_3.c_err_clas fmy_id_pbk_iv_4.c_err_clas /end DEF_CHARACTERISTIC
/end FUNCTION
/begin FUNCTION ERRM_Com_Interface_Appl_Inc "Com_Interface_Appl_Inc" /end FUNCTION
/begin FUNCTION ERRM_Configuration_Module "Configuration_Module" /end FUNCTION
/begin FUNCTION ERRM_DTC_Management "DTC_Management"
 /begin DEF_CHARACTERISTIC fmy_id_imob_0.dtc fmy_id_imob_1.dtc fmy_id_imob_2.dtc fmy_id_imob_3.dtc fmy_id_tco_el.dtc fmy_id_tco_grd.dtc fmy_id_tco_stuck.dtc fmy_id_tco_stuck_rng.dtc fmy_id_tco_plaus.dtc fmy_id_tco_2_el.dtc fmy_id_tco_2_grd.dtc fmy_id_tco_2_plaus.dtc fmy_id_ect_el.dtc fmy_id_ecf_el_1.dtc fmy_id_ecf_el_2.dtc fmy_id_ecfpwm_fb_1.dtc fmy_id_ecfpwm_fb_2.dtc fmy_id_th.dtc fmy_id_ftl_min.dtc fmy_id_tia_el_1.dtc fmy_id_tia_el_2.dtc fmy_id_tia_thr_el_1.dtc fmy_id_tia_thr_el_2.dtc fmy_id_amp.dtc fmy_id_amp_plaus.dtc fmy_id_maf.dtc fmy_id_el_cps.dtc fmy_id_slv_ivvt_in_1.dtc fmy_id_slv_ivvt_in_2.dtc fmy_id_slv_ivvt_ex_1.dtc fmy_id_slv_ivvt_ex_2.dtc fmy_id_ecu_cks.dtc fmy_id_vs.dtc fmy_id_knks_1.dtc fmy_id_knks_2.dtc fmy_id_knks_3.dtc fmy_id_knks_4.dtc fmy_id_rfp_dr_1.dtc fmy_id_rfp_dr_2.dtc fmy_id_wg_1_dr.dtc fmy_id_wg_2_dr.dtc fmy_id_put_el_1.dtc fmy_id_put_el_2.dtc fmy_id_igc_scp_0.dtc fmy_id_igc_scp_1.dtc fmy_id_igc_scp_2.dtc fmy_id_igc_scp_3.dtc fmy_id_igc_scp_4.dtc fmy_id_igc_scp_5.dtc fmy_id_igc_scp_6.dtc fmy_id_igc_scp_7.dtc fmy_id_igc_scg_0.dtc fmy_id_igc_scg_1.dtc fmy_id_igc_scg_2.dtc fmy_id_igc_scg_3.dtc fmy_id_igc_scg_4.dtc fmy_id_igc_scg_5.dtc fmy_id_igc_scg_6.dtc fmy_id_igc_scg_7.dtc fmy_id_igc_ol_0.dtc fmy_id_igc_ol_1.dtc fmy_id_igc_ol_2.dtc fmy_id_igc_ol_3.dtc fmy_id_igc_ol_4.dtc fmy_id_igc_ol_5.dtc fmy_id_igc_ol_6.dtc fmy_id_igc_ol_7.dtc fmy_id_dur_igc_mpl.dtc fmy_id_v_ref_1.dtc fmy_id_v_ref_2.dtc fmy_id_pvs_1.dtc fmy_id_pvs_2.dtc fmy_id_pvs_ratio.dtc fmy_id_pvs_double.dtc fmy_id_pvs_bls_not_plaus.dtc fmy_id_mtc_ctl_1.dtc fmy_id_gen.dtc fmy_id_gen_diag.dtc fmy_id_alter_bn.dtc fmy_id_alter_bn_bat.dtc fmy_id_t_es.dtc fmy_id_map_dip_plaus.dtc fmy_id_toil_level.dtc fmy_id_alter_bn_rgn.dtc fmy_id_per_cam_in_1.dtc fmy_id_per_cam_ex_1.dtc fmy_id_syn_cam_in_1.dtc fmy_id_syn_cam_ex_1.dtc fmy_id_ref_crk_cam_in_1.dtc fmy_id_ref_crk_cam_ex_1.dtc fmy_id_per_cam_in_2.dtc fmy_id_per_cam_ex_2.dtc fmy_id_syn_cam_in_2.dtc fmy_id_syn_cam_ex_2.dtc fmy_id_ref_crk_cam_in_2.dtc fmy_id_ref_crk_cam_ex_2.dtc fmy_id_crk_tooth.dtc fmy_id_crk_tooth_per.dtc fmy_id_crk_syn.dtc fmy_id_crk_plaus.dtc fmy_id_plaus_cam_in_1.dtc fmy_id_plaus_cam_ex_1.dtc fmy_id_syn_crk_cam_in_1.dtc /end DEF_CHARACTERISTIC
 /begin OUT_MEASUREMENT errm_online_dummy fmy_ram_dyn[0].err_dtc fmy_ram_dyn[0].err_info_dyn.err_sym_lst fmy_ram_dyn[0].err_info_dyn.err_sym_mem fmy_ram_dyn[1].err_dtc fmy_ram_dyn[1].err_info_dyn.err_sym_lst fmy_ram_dyn[1].err_info_dyn.err_sym_mem fmy_ram_dyn[2].err_dtc fmy_ram_dyn[2].err_info_dyn.err_sym_lst fmy_ram_dyn[2].err_info_dyn.err_sym_mem fmy_ram_dyn[3].err_dtc fmy_ram_dyn[3].err_info_dyn.err_sym_lst fmy_ram_dyn[3].err_info_dyn.err_sym_mem fmy_ram_dyn[4].err_dtc fmy_ram_dyn[4].err_info_dyn.err_sym_lst fmy_ram_dyn[4].err_info_dyn.err_sym_mem fmy_ram_dyn[5].err_dtc fmy_ram_dyn[5].err_info_dyn.err_sym_lst fmy_ram_dyn[5].err_info_dyn.err_sym_mem fmy_ram_dyn[6].err_dtc fmy_ram_dyn[6].err_info_dyn.err_sym_lst fmy_ram_dyn[6].err_info_dyn.err_sym_mem fmy_ram_dyn[7].err_dtc fmy_ram_dyn[7].err_info_dyn.err_sym_lst fmy_ram_dyn[7].err_info_dyn.err_sym_mem fmy_ram_dyn[8].err_dtc fmy_ram_dyn[8].err_info_dyn.err_sym_lst fmy_ram_dyn[8].err_info_dyn.err_sym_mem fmy_ram_dyn[9].err_dtc fmy_ram_dyn[9].err_info_dyn.err_sym_lst fmy_ram_dyn[9].err_info_dyn.err_sym_mem /end OUT_MEASUREMENT
/end FUNCTION
/end MODULE
/end PROJECT
