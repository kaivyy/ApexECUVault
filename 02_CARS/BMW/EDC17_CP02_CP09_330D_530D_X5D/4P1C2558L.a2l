ASAP2_VERSION 1 4
/begin PROJECT P_558 "EDC17_CP02"
/begin HEADER "" VERSION "V1C1" PROJECT_NO P_558 /end HEADER
/begin MODULE DIM ""
/begin MOD_COMMON "" BYTE_ORDER MSB_LAST ALIGNMENT_BYTE 1 ALIGNMENT_WORD 2 ALIGNMENT_LONG 4 ALIGNMENT_FLOAT32_IEEE 4 /end MOD_COMMON
/begin CHARACTERISTIC DFES_DTCO.DFC_AirCtlGovDvtEOMMax_C "/" VALUE 0x80074392 Val_Wu16 65535.00 DFES_OneToOne 0.00 65535.00 FORMAT "%8.2" /end CHARACTERISTIC
/begin CHARACTERISTIC DFES_DTCO.DFC_AirCtlGovDvtEOMMin_C "/" VALUE 0x80074394 Val_Wu16 65535.00 DFES_OneToOne 0.00 65535.00 FORMAT "%8.2" /end CHARACTERISTIC
/begin CHARACTERISTIC DFES_DTCO.DFC_AirCtlGovDvtMax_C "/" VALUE 0x80074396 Val_Wu16 65535.00 DFES_OneToOne 0.00 65535.00 FORMAT "%8.2" /end CHARACTERISTIC
/begin CHARACTERISTIC DFES_DTCO.DFC_AirCtlGovDvtMin_C "/" VALUE 0x80074398 Val_Wu16 65535.00 DFES_OneToOne 0.00 65535.00 FORMAT "%8.2" /end CHARACTERISTIC
/begin CHARACTERISTIC DFES_DTCO.DFC_Cj945SpiCom1_C "/" VALUE 0x8007439A Val_Wu16 65535.00 DFES_OneToOne 0.00 65535.00 FORMAT "%8.2" /end CHARACTERISTIC
/begin CHARACTERISTIC DFES_DTCO.DFC_ComButtonMSASig_C "/" VALUE 0x8007439C Val_Wu16 65535.00 DFES_OneToOne 0.00 65535.00 FORMAT "%8.2" /end CHARACTERISTIC
/begin CHARACTERISTIC DFES_DTCO.DFC_ComButtonMSATo_C "/" VALUE 0x8007439E Val_Wu16 65535.00 DFES_OneToOne 0.00 65535.00 FORMAT "%8.2" /end CHARACTERISTIC
/begin CHARACTERISTIC DFES_DTCO.DFC_ComGearboxData2Sig_C "/" VALUE 0x800743A0 Val_Wu16 65535.00 DFES_OneToOne 0.00 65535.00 FORMAT "%8.2" /end CHARACTERISTIC
/begin CHARACTERISTIC DFES_DTCO.DFC_ComGearboxData2To_C "/" VALUE 0x800743A2 Val_Wu16 65535.00 DFES_OneToOne 0.00 65535.00 FORMAT "%8.2" /end CHARACTERISTIC
/begin CHARACTERISTIC DFES_DTCO.DFC_ComGearboxDataSig_C "/" VALUE 0x800743A4 Val_Wu16 65535.00 DFES_OneToOne 0.00 65535.00 FORMAT "%8.2" /end CHARACTERISTIC
/begin CHARACTERISTIC DFES_DTCO.DFC_ComGearboxDataTo_C "/" VALUE 0x800743A6 Val_Wu16 65535.00 DFES_OneToOne 0.00 65535.00 FORMAT "%8.2" /end CHARACTERISTIC
/begin CHARACTERISTIC DFES_DTCO.DFC_ComHeatACSig_C "/" VALUE 0x800743A8 Val_Wu16 65535.00 DFES_OneToOne 0.00 65535.00 FORMAT "%8.2" /end CHARACTERISTIC
/begin CHARACTERISTIC DFES_DTCO.DFC_ComHeatACTo_C "/" VALUE 0x800743AA Val_Wu16 65535.00 DFES_OneToOne 0.00 65535.00 FORMAT "%8.2" /end CHARACTERISTIC
/begin CHARACTERISTIC DFES_DTCO.DFC_ComLenkradwinkelSig_C "/" VALUE 0x800743AC Val_Wu16 65535.00 DFES_OneToOne 0.00 65535.00 FORMAT "%8.2" /end CHARACTERISTIC
/begin CHARACTERISTIC DFES_DTCO.DFC_ComLenkradwinkelTo_C "/" VALUE 0x800743AE Val_Wu16 65535.00 DFES_OneToOne 0.00 65535.00 FORMAT "%8.2" /end CHARACTERISTIC
/begin CHARACTERISTIC DFES_DTCO.DFC_ComMileageRangeSig_C "/" VALUE 0x800743B0 Val_Wu16 65535.00 DFES_OneToOne 0.00 65535.00 FORMAT "%8.2" /end CHARACTERISTIC
/begin CHARACTERISTIC DFES_DTCO.DFC_ComMileageRangeTo_C "/" VALUE 0x800743B2 Val_Wu16 65535.00 DFES_OneToOne 0.00 65535.00 FORMAT "%8.2" /end CHARACTERISTIC
/begin CHARACTERISTIC DFES_DTCO.DFC_ComPspSig_C "/" VALUE 0x800743B4 Val_Wu16 65535.00 DFES_OneToOne 0.00 65535.00 FORMAT "%8.2" /end CHARACTERISTIC
/begin CHARACTERISTIC DFES_DTCO.DFC_ComPspTo_C "/" VALUE 0x800743B6 Val_Wu16 65535.00 DFES_OneToOne 0.00 65535.00 FORMAT "%8.2" /end CHARACTERISTIC
/begin CHARACTERISTIC DFES_DTCO.DFC_ComShutOffPSPSig_C "/" VALUE 0x800743B8 Val_Wu16 65535.00 DFES_OneToOne 0.00 65535.00 FORMAT "%8.2" /end CHARACTERISTIC
/begin CHARACTERISTIC DFES_DTCO.DFC_ComShutOffPSPTo_C "/" VALUE 0x800743BA Val_Wu16 65535.00 DFES_OneToOne 0.00 65535.00 FORMAT "%8.2" /end CHARACTERISTIC
/begin CHARACTERISTIC DFES_DTCO.DFC_ComStKombiCtr_C "/" VALUE 0x800743BC Val_Wu16 65535.00 DFES_OneToOne 0.00 65535.00 FORMAT "%8.2" /end CHARACTERISTIC
/begin CHARACTERISTIC DFES_DTCO.DFC_ComStKombiSig_C "/" VALUE 0x800743BE Val_Wu16 65535.00 DFES_OneToOne 0.00 65535.00 FORMAT "%8.2" /end CHARACTERISTIC
/begin CHARACTERISTIC DFES_DTCO.DFC_ComStKombiTo_C "/" VALUE 0x800743C0 Val_Wu16 65535.00 DFES_OneToOne 0.00 65535.00 FORMAT "%8.2" /end CHARACTERISTIC
/begin CHARACTERISTIC DFES_DTCO.DFC_ComStateARSCtr_C "/" VALUE 0x800743C2 Val_Wu16 65535.00 DFES_OneToOne 0.00 65535.00 FORMAT "%8.2" /end CHARACTERISTIC
/begin CHARACTERISTIC DFES_DTCO.DFC_ComStateARSSig_C "/" VALUE 0x800743C4 Val_Wu16 65535.00 DFES_OneToOne 0.00 65535.00 FORMAT "%8.2" /end CHARACTERISTIC
/begin CHARACTERISTIC DFES_DTCO.DFC_ComStateARSTo_C "/" VALUE 0x800743C6 Val_Wu16 65535.00 DFES_OneToOne 0.00 65535.00 FORMAT "%8.2" /end CHARACTERISTIC
/begin CHARACTERISTIC DFES_DTCO.DFC_ComStateDscSig_C "/" VALUE 0x800743C8 Val_Wu16 65535.00 DFES_OneToOne 0.00 65535.00 FORMAT "%8.2" /end CHARACTERISTIC
/begin CHARACTERISTIC DFES_DTCO.DFC_ComStateDscTo_C "/" VALUE 0x800743CA Val_Wu16 65535.00 DFES_OneToOne 0.00 65535.00 FORMAT "%8.2" /end CHARACTERISTIC
/begin CHARACTERISTIC DFES_DTCO.DFC_ComStateSeatSig_C "/" VALUE 0x800743CC Val_Wu16 65535.00 DFES_OneToOne 0.00 65535.00 FORMAT "%8.2" /end CHARACTERISTIC
/begin CHARACTERISTIC DFES_DTCO.DFC_ComStateSeatTo_C "/" VALUE 0x800743CE Val_Wu16 65535.00 DFES_OneToOne 0.00 65535.00 FORMAT "%8.2" /end CHARACTERISTIC
/begin CHARACTERISTIC DFES_DTCO.DFC_ComTempRelTimeSig_C "/" VALUE 0x800743D0 Val_Wu16 65535.00 DFES_OneToOne 0.00 65535.00 FORMAT "%8.2" /end CHARACTERISTIC
/begin CHARACTERISTIC DFES_DTCO.DFC_ComTempRelTimeTo_C "/" VALUE 0x800743D2 Val_Wu16 65535.00 DFES_OneToOne 0.00 65535.00 FORMAT "%8.2" /end CHARACTERISTIC
/begin CHARACTERISTIC DFES_DTCO.DFC_ComTerminalChk_C "/" VALUE 0x800743D4 Val_Wu16 65535.00 DFES_OneToOne 0.00 65535.00 FORMAT "%8.2" /end CHARACTERISTIC
/begin CHARACTERISTIC DFES_DTCO.DFC_ComTerminalCtr_C "/" VALUE 0x800743D6 Val_Wu16 65535.00 DFES_OneToOne 0.00 65535.00 FORMAT "%8.2" /end CHARACTERISTIC
/begin CHARACTERISTIC DFES_DTCO.DFC_ComTerminalSig_C "/" VALUE 0x800743D8 Val_Wu16 65535.00 DFES_OneToOne 0.00 65535.00 FORMAT "%8.2" /end CHARACTERISTIC
/begin CHARACTERISTIC DFES_DTCO.DFC_ComTerminalTo_C "/" VALUE 0x800743DA Val_Wu16 65535.00 DFES_OneToOne 0.00 65535.00 FORMAT "%8.2" /end CHARACTERISTIC
/begin CHARACTERISTIC DFES_DTCO.DFC_ComTimeDateSig_C "/" VALUE 0x800743DC Val_Wu16 65535.00 DFES_OneToOne 0.00 65535.00 FORMAT "%8.2" /end CHARACTERISTIC
/begin CHARACTERISTIC DFES_DTCO.DFC_ComTimeDateTo_C "/" VALUE 0x800743DE Val_Wu16 65535.00 DFES_OneToOne 0.00 65535.00 FORMAT "%8.2" /end CHARACTERISTIC
/begin CHARACTERISTIC DFES_DTCO.DFC_ComTrailerSig_C "/" VALUE 0x800743E0 Val_Wu16 65535.00 DFES_OneToOne 0.00 65535.00 FORMAT "%8.2" /end CHARACTERISTIC
/begin CHARACTERISTIC DFES_DTCO.DFC_ComTrailerTo_C "/" VALUE 0x800743E2 Val_Wu16 65535.00 DFES_OneToOne 0.00 65535.00 FORMAT "%8.2" /end CHARACTERISTIC
/begin CHARACTERISTIC DFES_DTCO.DFC_ComTrqDemandAfsChk_C "/" VALUE 0x800743E4 Val_Wu16 65535.00 DFES_OneToOne 0.00 65535.00 FORMAT "%8.2" /end CHARACTERISTIC
/begin CHARACTERISTIC DFES_DTCO.DFC_ComTrqDemandAfsCtr_C "/" VALUE 0x800743E6 Val_Wu16 65535.00 DFES_OneToOne 0.00 65535.00 FORMAT "%8.2" /end CHARACTERISTIC
/begin CHARACTERISTIC DFES_DTCO.DFC_ComTrqDemandAfsSig_C "/" VALUE 0x800743E8 Val_Wu16 65535.00 DFES_OneToOne 0.00 65535.00 FORMAT "%8.2" /end CHARACTERISTIC
/begin CHARACTERISTIC DFES_DTCO.DFC_ComTrqDemandAfsTo_C "/" VALUE 0x800743EA Val_Wu16 65535.00 DFES_OneToOne 0.00 65535.00 FORMAT "%8.2" /end CHARACTERISTIC
/begin CHARACTERISTIC DFES_DTCO.DFC_ComTrqDemandDscChk_C "/" VALUE 0x800743EC Val_Wu16 65535.00 DFES_OneToOne 0.00 65535.00 FORMAT "%8.2" /end CHARACTERISTIC
/begin CHARACTERISTIC DFES_DTCO.DFC_ComTrqDemandDscCtr_C "/" VALUE 0x800743EE Val_Wu16 65535.00 DFES_OneToOne 0.00 65535.00 FORMAT "%8.2" /end CHARACTERISTIC
/begin CHARACTERISTIC DFES_DTCO.DFC_ComTrqDemandDscSig_C "/" VALUE 0x800743F0 Val_Wu16 65535.00 DFES_OneToOne 0.00 65535.00 FORMAT "%8.2" /end CHARACTERISTIC
/begin CHARACTERISTIC DFES_DTCO.DFC_ComTrqDemandDscTo_C "/" VALUE 0x800743F2 Val_Wu16 65535.00 DFES_OneToOne 0.00 65535.00 FORMAT "%8.2" /end CHARACTERISTIC
/begin CHARACTERISTIC DFES_DTCO.DFC_ComTrqDemandGbxChk_C "/" VALUE 0x800743F4 Val_Wu16 65535.00 DFES_OneToOne 0.00 65535.00 FORMAT "%8.2" /end CHARACTERISTIC
/begin CHARACTERISTIC DFES_DTCO.DFC_ComTrqDemandGbxCtr_C "/" VALUE 0x800743F6 Val_Wu16 65535.00 DFES_OneToOne 0.00 65535.00 FORMAT "%8.2" /end CHARACTERISTIC
/begin CHARACTERISTIC DFES_DTCO.DFC_ComTrqDemandGbxSig_C "/" VALUE 0x800743F8 Val_Wu16 65535.00 DFES_OneToOne 0.00 65535.00 FORMAT "%8.2" /end CHARACTERISTIC
/begin CHARACTERISTIC DFES_DTCO.DFC_ComTrqDemandGbxTo_C "/" VALUE 0x800743FA Val_Wu16 65535.00 DFES_OneToOne 0.00 65535.00 FORMAT "%8.2" /end CHARACTERISTIC
/begin CHARACTERISTIC DFES_DTCO.DFC_ComVelocitySig_C "/" VALUE 0x800743FC Val_Wu16 65535.00 DFES_OneToOne 0.00 65535.00 FORMAT "%8.2" /end CHARACTERISTIC
/begin CHARACTERISTIC DFES_DTCO.DFC_ComVelocityTo_C "/" VALUE 0x800743FE Val_Wu16 65535.00 DFES_OneToOne 0.00 65535.00 FORMAT "%8.2" /end CHARACTERISTIC
/begin CHARACTERISTIC DFES_DTCO.DFC_ComWheelSpeedSig_C "/" VALUE 0x80074400 Val_Wu16 65535.00 DFES_OneToOne 0.00 65535.00 FORMAT "%8.2" /end CHARACTERISTIC
/begin CHARACTERISTIC DFES_DTCO.DFC_ComWheelSpeedTo_C "/" VALUE 0x80074402 Val_Wu16 65535.00 DFES_OneToOne 0.00 65535.00 FORMAT "%8.2" /end CHARACTERISTIC
/begin CHARACTERISTIC DFES_DTCO.DFC_ComZvKlappenSig_C "/" VALUE 0x80074404 Val_Wu16 65535.00 DFES_OneToOne 0.00 65535.00 FORMAT "%8.2" /end CHARACTERISTIC
/begin CHARACTERISTIC DFES_DTCO.DFC_ComZvKlappenTo_C "/" VALUE 0x80074406 Val_Wu16 65535.00 DFES_OneToOne 0.00 65535.00 FORMAT "%8.2" /end CHARACTERISTIC
/begin CHARACTERISTIC DFES_DTCO.DFC_Cy150SpiCom_C "/" VALUE 0x80074408 Val_Wu16 65535.00 DFES_OneToOne 0.00 65535.00 FORMAT "%8.2" /end CHARACTERISTIC
/begin CHARACTERISTIC DFES_DTCO.DFC_Cy320SpiCom_C "/" VALUE 0x8007440A Val_Wu16 65535.00 DFES_OneToOne 0.00 65535.00 FORMAT "%8.2" /end CHARACTERISTIC
/begin CHARACTERISTIC DFES_DTCO.DFC_ETCtlDvtInrMax_C "/" VALUE 0x8007440C Val_Wu16 65535.00 DFES_OneToOne 0.00 65535.00 FORMAT "%8.2" /end CHARACTERISTIC
/begin CHARACTERISTIC DFES_DTCO.DFC_ETCtlDvtInrMin_C "/" VALUE 0x8007440E Val_Wu16 65535.00 DFES_OneToOne 0.00 65535.00 FORMAT "%8.2" /end CHARACTERISTIC
/begin CHARACTERISTIC DFES_DTCO.DFC_ETCtlDvtOutrMax_C "/" VALUE 0x80074410 Val_Wu16 65535.00 DFES_OneToOne 0.00 65535.00 FORMAT "%8.2" /end CHARACTERISTIC
/begin CHARACTERISTIC DFES_DTCO.DFC_ETCtlDvtOutrMin_C "/" VALUE 0x80074412 Val_Wu16 65535.00 DFES_OneToOne 0.00 65535.00 FORMAT "%8.2" /end CHARACTERISTIC
/begin CHARACTERISTIC DFES_DTCO.DFC_Fan4WinErr1_C "/" VALUE 0x80074414 Val_Wu16 65535.00 DFES_OneToOne 0.00 65535.00 FORMAT "%8.2" /end CHARACTERISTIC
/begin CHARACTERISTIC DFES_DTCO.DFC_Fan4WinErr2_C "/" VALUE 0x80074416 Val_Wu16 65535.00 DFES_OneToOne 0.00 65535.00 FORMAT "%8.2" /end CHARACTERISTIC
/begin CHARACTERISTIC DFES_DTCO.DFC_Fan4WinErr3_C "/" VALUE 0x80074418 Val_Wu16 65535.00 DFES_OneToOne 0.00 65535.00 FORMAT "%8.2" /end CHARACTERISTIC
/begin CHARACTERISTIC DFES_DTCO.DFC_Fan4WinErr4_C "/" VALUE 0x8007441A Val_Wu16 65535.00 DFES_OneToOne 0.00 65535.00 FORMAT "%8.2" /end CHARACTERISTIC
/begin CHARACTERISTIC DFES_DTCO.DFC_FanSCG_C "/" VALUE 0x8007441C Val_Wu16 65535.00 DFES_OneToOne 0.00 65535.00 FORMAT "%8.2" /end CHARACTERISTIC
/begin CHARACTERISTIC DFES_DTCO.DFC_PCRGovDvtLPMax_C "/" VALUE 0x8007441E Val_Wu16 65535.00 DFES_OneToOne 0.00 65535.00 FORMAT "%8.2" /end CHARACTERISTIC
/begin CHARACTERISTIC DFES_DTCO.DFC_PCRGovDvtLPMin_C "/" VALUE 0x80074420 Val_Wu16 65535.00 DFES_OneToOne 0.00 65535.00 FORMAT "%8.2" /end CHARACTERISTIC
/begin CHARACTERISTIC DFES_DTCO.DFC_PCRGovDvtMax_C "/" VALUE 0x80074422 Val_Wu16 65535.00 DFES_OneToOne 0.00 65535.00 FORMAT "%8.2" /end CHARACTERISTIC
/begin CHARACTERISTIC DFES_DTCO.DFC_PCRGovDvtMin_C "/" VALUE 0x80074424 Val_Wu16 65535.00 DFES_OneToOne 0.00 65535.00 FORMAT "%8.2" /end CHARACTERISTIC
/begin CHARACTERISTIC DFES_DTCO.DFC_RailCPC1_C "/" VALUE 0x80074426 Val_Wu16 65535.00 DFES_OneToOne 0.00 65535.00 FORMAT "%8.2" /end CHARACTERISTIC
/begin CHARACTERISTIC DFES_DTCO.DFC_RailCPC3_C "/" VALUE 0x80074428 Val_Wu16 65535.00 DFES_OneToOne 0.00 65535.00 FORMAT "%8.2" /end CHARACTERISTIC
/begin CHARACTERISTIC DFES_DTCO.DFC_RailCPC4_C "/" VALUE 0x8007442A Val_Wu16 65535.00 DFES_OneToOne 0.00 65535.00 FORMAT "%8.2" /end CHARACTERISTIC
/begin CHARACTERISTIC DFES_DTCO.DFC_RailMeUn0_C "/" VALUE 0x8007442C Val_Wu16 65535.00 DFES_OneToOne 0.00 65535.00 FORMAT "%8.2" /end CHARACTERISTIC
/begin CHARACTERISTIC DFES_DTCO.DFC_RailMeUn1_C "/" VALUE 0x8007442E Val_Wu16 65535.00 DFES_OneToOne 0.00 65535.00 FORMAT "%8.2" /end CHARACTERISTIC
/begin CHARACTERISTIC DFES_DTCO.DFC_RailMeUn2_C "/" VALUE 0x80074430 Val_Wu16 65535.00 DFES_OneToOne 0.00 65535.00 FORMAT "%8.2" /end CHARACTERISTIC
/begin CHARACTERISTIC DFES_DTCO.DFC_RailMeUn3_C "/" VALUE 0x80074432 Val_Wu16 65535.00 DFES_OneToOne 0.00 65535.00 FORMAT "%8.2" /end CHARACTERISTIC
/begin CHARACTERISTIC DFES_DTCO.DFC_RailMeUn4_C "/" VALUE 0x80074434 Val_Wu16 65535.00 DFES_OneToOne 0.00 65535.00 FORMAT "%8.2" /end CHARACTERISTIC
/begin CHARACTERISTIC DFES_DTCO.DFC_RailPCV0_C "/" VALUE 0x80074436 Val_Wu16 65535.00 DFES_OneToOne 0.00 65535.00 FORMAT "%8.2" /end CHARACTERISTIC
/begin CHARACTERISTIC DFES_DTCO.DFC_RailPCV1_C "/" VALUE 0x80074438 Val_Wu16 65535.00 DFES_OneToOne 0.00 65535.00 FORMAT "%8.2" /end CHARACTERISTIC
/begin CHARACTERISTIC DFES_DTCO.DFC_RailPCV2_C "/" VALUE 0x8007443A Val_Wu16 65535.00 DFES_OneToOne 0.00 65535.00 FORMAT "%8.2" /end CHARACTERISTIC
/begin CHARACTERISTIC DFES_DTCO.DFC_RailPCV3_C "/" VALUE 0x8007443C Val_Wu16 65535.00 DFES_OneToOne 0.00 65535.00 FORMAT "%8.2" /end CHARACTERISTIC
/begin CHARACTERISTIC DFES_DTCO.DFC_RailPCV4_C "/" VALUE 0x8007443E Val_Wu16 65535.00 DFES_OneToOne 0.00 65535.00 FORMAT "%8.2" /end CHARACTERISTIC
/begin CHARACTERISTIC DFES_DTCO.DFC_RailPMonStrt_C "/" VALUE 0x80074440 Val_Wu16 65535.00 DFES_OneToOne 0.00 65535.00 FORMAT "%8.2" /end CHARACTERISTIC
/begin CHARACTERISTIC DFES_DTCO.DFC_SSpMon1_C "/" VALUE 0x80074442 Val_Wu16 65535.00 DFES_OneToOne 0.00 65535.00 FORMAT "%8.2" /end CHARACTERISTIC
/begin CHARACTERISTIC DFES_DTCO.DFC_SSpMon2_C "/" VALUE 0x80074444 Val_Wu16 65535.00 DFES_OneToOne 0.00 65535.00 FORMAT "%8.2" /end CHARACTERISTIC
/begin CHARACTERISTIC DFES_DTCO.DFC_SSpMon3_C "/" VALUE 0x80074446 Val_Wu16 65535.00 DFES_OneToOne 0.00 65535.00 FORMAT "%8.2" /end CHARACTERISTIC
/begin CHARACTERISTIC DFES_DTCO.DFC_Sia_E1_C "/" VALUE 0x80074448 Val_Wu16 65535.00 DFES_OneToOne 0.00 65535.00 FORMAT "%8.2" /end CHARACTERISTIC
/begin CHARACTERISTIC DFES_DTCO.DFC_Sia_E10_C "/" VALUE 0x8007444A Val_Wu16 65535.00 DFES_OneToOne 0.00 65535.00 FORMAT "%8.2" /end CHARACTERISTIC
/begin CHARACTERISTIC DFES_DTCO.DFC_Sia_E11_C "/" VALUE 0x8007444C Val_Wu16 65535.00 DFES_OneToOne 0.00 65535.00 FORMAT "%8.2" /end CHARACTERISTIC
/begin CHARACTERISTIC DFES_DTCO.DFC_Sia_E12_C "/" VALUE 0x8007444E Val_Wu16 65535.00 DFES_OneToOne 0.00 65535.00 FORMAT "%8.2" /end CHARACTERISTIC
/begin CHARACTERISTIC DFES_DTCO.DFC_Sia_E13_C "/" VALUE 0x80074450 Val_Wu16 65535.00 DFES_OneToOne 0.00 65535.00 FORMAT "%8.2" /end CHARACTERISTIC
/begin CHARACTERISTIC DFES_DTCO.DFC_Sia_E14_C "/" VALUE 0x80074452 Val_Wu16 65535.00 DFES_OneToOne 0.00 65535.00 FORMAT "%8.2" /end CHARACTERISTIC
/begin CHARACTERISTIC DFES_DTCO.DFC_Sia_E15_C "/" VALUE 0x80074454 Val_Wu16 65535.00 DFES_OneToOne 0.00 65535.00 FORMAT "%8.2" /end CHARACTERISTIC
/begin CHARACTERISTIC DFES_DTCO.DFC_Sia_E2_C "/" VALUE 0x80074456 Val_Wu16 65535.00 DFES_OneToOne 0.00 65535.00 FORMAT "%8.2" /end CHARACTERISTIC
/begin CHARACTERISTIC DFES_DTCO.DFC_Sia_E3_C "/" VALUE 0x80074458 Val_Wu16 65535.00 DFES_OneToOne 0.00 65535.00 FORMAT "%8.2" /end CHARACTERISTIC
/begin CHARACTERISTIC DFES_DTCO.DFC_Sia_E4_C "/" VALUE 0x8007445A Val_Wu16 65535.00 DFES_OneToOne 0.00 65535.00 FORMAT "%8.2" /end CHARACTERISTIC
/begin CHARACTERISTIC DFES_DTCO.DFC_Sia_E5_C "/" VALUE 0x8007445C Val_Wu16 65535.00 DFES_OneToOne 0.00 65535.00 FORMAT "%8.2" /end CHARACTERISTIC
/begin CHARACTERISTIC DFES_DTCO.DFC_Sia_E6_C "/" VALUE 0x8007445E Val_Wu16 65535.00 DFES_OneToOne 0.00 65535.00 FORMAT "%8.2" /end CHARACTERISTIC
/begin CHARACTERISTIC DFES_DTCO.DFC_Sia_E7_C "/" VALUE 0x80074460 Val_Wu16 65535.00 DFES_OneToOne 0.00 65535.00 FORMAT "%8.2" /end CHARACTERISTIC
/begin CHARACTERISTIC DFES_DTCO.DFC_Sia_E8_C "/" VALUE 0x80074462 Val_Wu16 65535.00 DFES_OneToOne 0.00 65535.00 FORMAT "%8.2" /end CHARACTERISTIC
/begin CHARACTERISTIC DFES_DTCO.DFC_Sia_E9_C "/" VALUE 0x80074464 Val_Wu16 65535.00 DFES_OneToOne 0.00 65535.00 FORMAT "%8.2" /end CHARACTERISTIC
/begin CHARACTERISTIC DFES_DTCO.DFC_ThrVlv4WinErr1_C "/" VALUE 0x80074466 Val_Wu16 65535.00 DFES_OneToOne 0.00 65535.00 FORMAT "%8.2" /end CHARACTERISTIC
/begin CHARACTERISTIC DFES_DTCO.DFC_ThrVlv4WinErr2_C "/" VALUE 0x80074468 Val_Wu16 65535.00 DFES_OneToOne 0.00 65535.00 FORMAT "%8.2" /end CHARACTERISTIC
/begin CHARACTERISTIC DFES_DTCO.DFC_ThrVlv4WinErr3_C "/" VALUE 0x8007446A Val_Wu16 65535.00 DFES_OneToOne 0.00 65535.00 FORMAT "%8.2" /end CHARACTERISTIC
/begin CHARACTERISTIC DFES_DTCO.DFC_ThrVlv4WinErr4_C "/" VALUE 0x8007446C Val_Wu16 65535.00 DFES_OneToOne 0.00 65535.00 FORMAT "%8.2" /end CHARACTERISTIC
/begin CHARACTERISTIC DFES_DTCO.DFC_ThrVlvSCG_C "/" VALUE 0x8007446E Val_Wu16 65535.00 DFES_OneToOne 0.00 65535.00 FORMAT "%8.2" /end CHARACTERISTIC
/begin CHARACTERISTIC DFES_DTCO.DFC_TrbCh4WinErr1_C "/" VALUE 0x80074470 Val_Wu16 65535.00 DFES_OneToOne 0.00 65535.00 FORMAT "%8.2" /end CHARACTERISTIC
/begin CHARACTERISTIC DFES_DTCO.DFC_TrbCh4WinErr2_C "/" VALUE 0x80074472 Val_Wu16 65535.00 DFES_OneToOne 0.00 65535.00 FORMAT "%8.2" /end CHARACTERISTIC
/begin CHARACTERISTIC DFES_DTCO.DFC_TrbCh4WinErr3_C "/" VALUE 0x80074474 Val_Wu16 65535.00 DFES_OneToOne 0.00 65535.00 FORMAT "%8.2" /end CHARACTERISTIC
/begin CHARACTERISTIC DFES_DTCO.DFC_TrbCh4WinErr4_C "/" VALUE 0x80074476 Val_Wu16 65535.00 DFES_OneToOne 0.00 65535.00 FORMAT "%8.2" /end CHARACTERISTIC
/begin CHARACTERISTIC DFES_DTCO.DFC_TrbChSCG_C "/" VALUE 0x80074478 Val_Wu16 65535.00 DFES_OneToOne 0.00 65535.00 FORMAT "%8.2" /end CHARACTERISTIC
/begin CHARACTERISTIC DFES_DTCO.DFC_TrbChSRCMax_C "/" VALUE 0x8007447A Val_Wu16 65535.00 DFES_OneToOne 0.00 65535.00 FORMAT "%8.2" /end CHARACTERISTIC
/begin CHARACTERISTIC DFES_DTCO.DFC_TrbChSRCMin_C "/" VALUE 0x8007447C Val_Wu16 65535.00 DFES_OneToOne 0.00 65535.00 FORMAT "%8.2" /end CHARACTERISTIC
/begin CHARACTERISTIC DFES_DTCO.DFC_WaHtEl4WinErr1_C "/" VALUE 0x8007447E Val_Wu16 65535.00 DFES_OneToOne 0.00 65535.00 FORMAT "%8.2" /end CHARACTERISTIC
/begin CHARACTERISTIC DFES_DTCO.DFC_WaHtEl4WinErr2_C "/" VALUE 0x80074480 Val_Wu16 65535.00 DFES_OneToOne 0.00 65535.00 FORMAT "%8.2" /end CHARACTERISTIC
/begin CHARACTERISTIC DFES_DTCO.DFC_WaHtEl4WinErr3_C "/" VALUE 0x80074482 Val_Wu16 65535.00 DFES_OneToOne 0.00 65535.00 FORMAT "%8.2" /end CHARACTERISTIC
/begin CHARACTERISTIC DFES_DTCO.DFC_WaHtEl4WinErr4_C "/" VALUE 0x80074484 Val_Wu16 65535.00 DFES_OneToOne 0.00 65535.00 FORMAT "%8.2" /end CHARACTERISTIC
/begin CHARACTERISTIC DFES_DTCO.DFC_WaHtElSCG_C "/" VALUE 0x80074486 Val_Wu16 65535.00 DFES_OneToOne 0.00 65535.00 FORMAT "%8.2" /end CHARACTERISTIC
/begin CHARACTERISTIC DFES_DTCO.DFC_ETClbETFltMax_C "/" VALUE 0x80074488 Val_Wu16 65535.00 DFES_OneToOne 0.00 65535.00 FORMAT "%8.2" /end CHARACTERISTIC
/begin CHARACTERISTIC DFES_DTCO.DFC_ETClbETFltMin_C "/" VALUE 0x8007448A Val_Wu16 65535.00 DFES_OneToOne 0.00 65535.00 FORMAT "%8.2" /end CHARACTERISTIC
/begin CHARACTERISTIC DFES_DTCO.DFC_InjCrvInjLimChrgBal_C "/" VALUE 0x8007448C Val_Wu16 65535.00 DFES_OneToOne 0.00 65535.00 FORMAT "%8.2" /end CHARACTERISTIC
/begin CHARACTERISTIC DFES_DTCO.DFC_InjCrvInjLimQntBal_C "/" VALUE 0x8007448E Val_Wu16 65535.00 DFES_OneToOne 0.00 65535.00 FORMAT "%8.2" /end CHARACTERISTIC
/begin CHARACTERISTIC DFES_DTCO.DFC_InjCrvInjLimSys_C "/" VALUE 0x80074490 Val_Wu16 65535.00 DFES_OneToOne 0.00 65535.00 FORMAT "%8.2" /end CHARACTERISTIC
/begin CHARACTERISTIC DFES_DTCO.DFC_InjCrvNumInjRtmLim_C "/" VALUE 0x80074492 Val_Wu16 65535.00 DFES_OneToOne 0.00 65535.00 FORMAT "%8.2" /end CHARACTERISTIC
/begin CHARACTERISTIC DFES_DTCO.DFC_LSUHtCoupSig_0_C "/" VALUE 0x80074494 Val_Wu16 65535.00 DFES_OneToOne 0.00 65535.00 FORMAT "%8.2" /end CHARACTERISTIC
/begin CHARACTERISTIC DFES_DTCO.DFC_LSUHtCoupSig_1_C "/" VALUE 0x80074496 Val_Wu16 65535.00 DFES_OneToOne 0.00 65535.00 FORMAT "%8.2" /end CHARACTERISTIC
/begin CHARACTERISTIC DFES_DTCO.DFC_LSUHtCoupSig_2_C "/" VALUE 0x80074498 Val_Wu16 65535.00 DFES_OneToOne 0.00 65535.00 FORMAT "%8.2" /end CHARACTERISTIC
/begin CHARACTERISTIC DFES_DTCO.DFC_LSUHtCoupSig_3_C "/" VALUE 0x8007449A Val_Wu16 65535.00 DFES_OneToOne 0.00 65535.00 FORMAT "%8.2" /end CHARACTERISTIC
/begin CHARACTERISTIC DFES_DTCO.DFC_CtT_C "/" VALUE 0x8007449C Val_Wu16 65535.00 DFES_OneToOne 0.00 65535.00 FORMAT "%8.2" /end CHARACTERISTIC
/begin CHARACTERISTIC DFES_DTCO.DFC_DSMDummy_C "/" VALUE 0x8007449E Val_Wu16 65535.00 DFES_OneToOne 0.00 65535.00 FORMAT "%8.2" /end CHARACTERISTIC
/begin CHARACTERISTIC DFES_DTCO.DFC_MeUnOL_C "/" VALUE 0x800744A0 Val_Wu16 65535.00 DFES_OneToOne 0.00 65535.00 FORMAT "%8.2" /end CHARACTERISTIC
/begin CHARACTERISTIC DFES_DTCO.DFC_MeUnSCB_C "/" VALUE 0x800744A2 Val_Wu16 65535.00 DFES_OneToOne 0.00 65535.00 FORMAT "%8.2" /end CHARACTERISTIC
/begin CHARACTERISTIC DFES_DTCO.DFC_MeUnSRCMax_C "/" VALUE 0x800744A4 Val_Wu16 65535.00 DFES_OneToOne 0.00 65535.00 FORMAT "%8.2" /end CHARACTERISTIC
/begin CHARACTERISTIC DFES_DTCO.DFC_MeUnSRCMin_C "/" VALUE 0x800744A6 Val_Wu16 65535.00 DFES_OneToOne 0.00 65535.00 FORMAT "%8.2" /end CHARACTERISTIC
/begin CHARACTERISTIC DFES_DTCO.DFC_PCVOL_C "/" VALUE 0x800744A8 Val_Wu16 65535.00 DFES_OneToOne 0.00 65535.00 FORMAT "%8.2" /end CHARACTERISTIC
/begin CHARACTERISTIC DFES_DTCO.DFC_PCVSCB_C "/" VALUE 0x800744AA Val_Wu16 65535.00 DFES_OneToOne 0.00 65535.00 FORMAT "%8.2" /end CHARACTERISTIC
/begin CHARACTERISTIC DFES_DTCO.DFC_PCVSRCMax_C "/" VALUE 0x800744AC Val_Wu16 65535.00 DFES_OneToOne 0.00 65535.00 FORMAT "%8.2" /end CHARACTERISTIC
/begin CHARACTERISTIC DFES_DTCO.DFC_PCVSRCMin_C "/" VALUE 0x800744AE Val_Wu16 65535.00 DFES_OneToOne 0.00 65535.00 FORMAT "%8.2" /end CHARACTERISTIC
/begin CHARACTERISTIC DFES_DTCO.DFC_RailPSRCMax_C "/" VALUE 0x800744B0 Val_Wu16 65535.00 DFES_OneToOne 0.00 65535.00 FORMAT "%8.2" /end CHARACTERISTIC
/begin CHARACTERISTIC DFES_DTCO.DFC_RailPSRCMin_C "/" VALUE 0x800744B2 Val_Wu16 65535.00 DFES_OneToOne 0.00 65535.00 FORMAT "%8.2" /end CHARACTERISTIC
/begin CHARACTERISTIC DFES_DTCO.DFC_IVActrVltgSRCMax_C "/" VALUE 0x800744B4 Val_Wu16 65535.00 DFES_OneToOne 0.00 65535.00 FORMAT "%8.2" /end CHARACTERISTIC
/begin CHARACTERISTIC DFES_DTCO.DFC_IVActrVltgSRCMin_C "/" VALUE 0x800744B6 Val_Wu16 65535.00 DFES_OneToOne 0.00 65535.00 FORMAT "%8.2" /end CHARACTERISTIC
/begin CHARACTERISTIC DFES_DTCO.DFC_IVPSplyDCDC_C "/" VALUE 0x800744B8 Val_Wu16 65535.00 DFES_OneToOne 0.00 65535.00 FORMAT "%8.2" /end CHARACTERISTIC
/begin CHARACTERISTIC DFES_DTCO.DFC_IVPSplyVltgSRCMax_C "/" VALUE 0x800744BA Val_Wu16 65535.00 DFES_OneToOne 0.00 65535.00 FORMAT "%8.2" /end CHARACTERISTIC
/begin CHARACTERISTIC DFES_DTCO.DFC_IVPSplyVltgSRCMin_C "/" VALUE 0x800744BC Val_Wu16 65535.00 DFES_OneToOne 0.00 65535.00 FORMAT "%8.2" /end CHARACTERISTIC
/begin CHARACTERISTIC DFES_DTCO.DFC_AFSOffsDrftMax_C "/" VALUE 0x800744BE Val_Wu16 65535.00 DFES_OneToOne 0.00 65535.00 FORMAT "%8.2" /end CHARACTERISTIC
/begin CHARACTERISTIC DFES_DTCO.DFC_AFSOffsDrftMin_C "/" VALUE 0x800744C0 Val_Wu16 65535.00 DFES_OneToOne 0.00 65535.00 FORMAT "%8.2" /end CHARACTERISTIC
/begin CHARACTERISTIC DFES_DTCO.DFC_AFSSRCCorMax_C "/" VALUE 0x800744C2 Val_Wu16 65535.00 DFES_OneToOne 0.00 65535.00 FORMAT "%8.2" /end CHARACTERISTIC
/begin CHARACTERISTIC DFES_DTCO.DFC_AFSSRCCorMin_C "/" VALUE 0x800744C4 Val_Wu16 65535.00 DFES_OneToOne 0.00 65535.00 FORMAT "%8.2" /end CHARACTERISTIC
/begin CHARACTERISTIC DFES_DTCO.DFC_AFSSRCRawMax_C "/" VALUE 0x800744C6 Val_Wu16 65535.00 DFES_OneToOne 0.00 65535.00 FORMAT "%8.2" /end CHARACTERISTIC
/begin CHARACTERISTIC DFES_DTCO.DFC_AFSSRCRawMin_C "/" VALUE 0x800744C8 Val_Wu16 65535.00 DFES_OneToOne 0.00 65535.00 FORMAT "%8.2" /end CHARACTERISTIC
/begin CHARACTERISTIC DFES_DTCO.DFC_AFSSetyDrftMax_C "/" VALUE 0x800744CA Val_Wu16 65535.00 DFES_OneToOne 0.00 65535.00 FORMAT "%8.2" /end CHARACTERISTIC
/begin CHARACTERISTIC DFES_DTCO.DFC_AFSSetyDrftMin_C "/" VALUE 0x800744CC Val_Wu16 65535.00 DFES_OneToOne 0.00 65535.00 FORMAT "%8.2" /end CHARACTERISTIC
/begin CHARACTERISTIC DFES_DTCO.DFC_AirCClntPAnaSRCMax_C "/" VALUE 0x800744CE Val_Wu16 65535.00 DFES_OneToOne 0.00 65535.00 FORMAT "%8.2" /end CHARACTERISTIC
/begin CHARACTERISTIC DFES_DTCO.DFC_AirCClntPAnaSRCMin_C "/" VALUE 0x800744D0 Val_Wu16 65535.00 DFES_OneToOne 0.00 65535.00 FORMAT "%8.2" /end CHARACTERISTIC
/begin CHARACTERISTIC DFES_DTCO.DFC_AirCClntPPerSRCMax_C "/" VALUE 0x800744D2 Val_Wu16 65535.00 DFES_OneToOne 0.00 65535.00 FORMAT "%8.2" /end CHARACTERISTIC
/begin CHARACTERISTIC DFES_DTCO.DFC_AirCClntPPerSRCMin_C "/" VALUE 0x800744D4 Val_Wu16 65535.00 DFES_OneToOne 0.00 65535.00 FORMAT "%8.2" /end CHARACTERISTIC
/begin CHARACTERISTIC DFES_DTCO.DFC_AirCClntPdcycSRCMax_C "/" VALUE 0x800744D6 Val_Wu16 65535.00 DFES_OneToOne 0.00 65535.00 FORMAT "%8.2" /end CHARACTERISTIC
/begin CHARACTERISTIC DFES_DTCO.DFC_AirCClntPdcycSRCMin_C "/" VALUE 0x800744D8 Val_Wu16 65535.00 DFES_OneToOne 0.00 65535.00 FORMAT "%8.2" /end CHARACTERISTIC
/begin CHARACTERISTIC DFES_DTCO.DFC_AirCCmprOL_C "/" VALUE 0x800744DA Val_Wu16 65535.00 DFES_OneToOne 0.00 65535.00 FORMAT "%8.2" /end CHARACTERISTIC
/begin CHARACTERISTIC DFES_DTCO.DFC_AirCCmprRedTrqOL_C "/" VALUE 0x800744DC Val_Wu16 65535.00 DFES_OneToOne 0.00 65535.00 FORMAT "%8.2" /end CHARACTERISTIC
/begin CHARACTERISTIC DFES_DTCO.DFC_AirCCmprRedTrqSCB_C "/" VALUE 0x800744DE Val_Wu16 65535.00 DFES_OneToOne 0.00 65535.00 FORMAT "%8.2" /end CHARACTERISTIC
/begin CHARACTERISTIC DFES_DTCO.DFC_AirCCmprRedTrqSCG_C "/" VALUE 0x800744E0 Val_Wu16 65535.00 DFES_OneToOne 0.00 65535.00 FORMAT "%8.2" /end CHARACTERISTIC
/begin CHARACTERISTIC DFES_DTCO.DFC_AirCCmprSCB_C "/" VALUE 0x800744E2 Val_Wu16 65535.00 DFES_OneToOne 0.00 65535.00 FORMAT "%8.2" /end CHARACTERISTIC
/begin CHARACTERISTIC DFES_DTCO.DFC_AirCCmprSCG_C "/" VALUE 0x800744E4 Val_Wu16 65535.00 DFES_OneToOne 0.00 65535.00 FORMAT "%8.2" /end CHARACTERISTIC
/begin CHARACTERISTIC DFES_DTCO.DFC_AirCSwtNpl_C "/" VALUE 0x800744E6 Val_Wu16 65535.00 DFES_OneToOne 0.00 65535.00 FORMAT "%8.2" /end CHARACTERISTIC
/begin CHARACTERISTIC DFES_DTCO.DFC_AirCSwtSig_C "/" VALUE 0x800744E8 Val_Wu16 65535.00 DFES_OneToOne 0.00 65535.00 FORMAT "%8.2" /end CHARACTERISTIC
/begin CHARACTERISTIC DFES_DTCO.DFC_BattUSRCMax_C "/" VALUE 0x800744EA Val_Wu16 65535.00 DFES_OneToOne 0.00 65535.00 FORMAT "%8.2" /end CHARACTERISTIC
/begin CHARACTERISTIC DFES_DTCO.DFC_BattUSRCMin_C "/" VALUE 0x800744EC Val_Wu16 65535.00 DFES_OneToOne 0.00 65535.00 FORMAT "%8.2" /end CHARACTERISTIC
/begin CHARACTERISTIC DFES_DTCO.DFC_BrkNpl_C "/" VALUE 0x800744EE Val_Wu16 65535.00 DFES_OneToOne 0.00 65535.00 FORMAT "%8.2" /end CHARACTERISTIC
/begin CHARACTERISTIC DFES_DTCO.DFC_BrkPSRCMax_C "/" VALUE 0x800744F0 Val_Wu16 65535.00 DFES_OneToOne 0.00 65535.00 FORMAT "%8.2" /end CHARACTERISTIC
/begin CHARACTERISTIC DFES_DTCO.DFC_BrkPSRCMin_C "/" VALUE 0x800744F2 Val_Wu16 65535.00 DFES_OneToOne 0.00 65535.00 FORMAT "%8.2" /end CHARACTERISTIC
/begin CHARACTERISTIC DFES_DTCO.DFC_BrkSig_C "/" VALUE 0x800744F4 Val_Wu16 65535.00 DFES_OneToOne 0.00 65535.00 FORMAT "%8.2" /end CHARACTERISTIC
/begin CHARACTERISTIC DFES_DTCO.DFC_CByVlvOL_C "/" VALUE 0x800744F6 Val_Wu16 65535.00 DFES_OneToOne 0.00 65535.00 FORMAT "%8.2" /end CHARACTERISTIC
/begin CHARACTERISTIC DFES_DTCO.DFC_CByVlvSCB_C "/" VALUE 0x800744F8 Val_Wu16 65535.00 DFES_OneToOne 0.00 65535.00 FORMAT "%8.2" /end CHARACTERISTIC
/begin CHARACTERISTIC DFES_DTCO.DFC_CByVlvSCG_C "/" VALUE 0x800744FA Val_Wu16 65535.00 DFES_OneToOne 0.00 65535.00 FORMAT "%8.2" /end CHARACTERISTIC
/begin CHARACTERISTIC DFES_DTCO.DFC_CEngDsTSRCMax_C "/" VALUE 0x800744FC Val_Wu16 65535.00 DFES_OneToOne 0.00 65535.00 FORMAT "%8.2" /end CHARACTERISTIC
/begin CHARACTERISTIC DFES_DTCO.DFC_CEngDsTSRCMin_C "/" VALUE 0x800744FE Val_Wu16 65535.00 DFES_OneToOne 0.00 65535.00 FORMAT "%8.2" /end CHARACTERISTIC
/begin CHARACTERISTIC DFES_DTCO.DFC_CEngDsTSig_C "/" VALUE 0x80074500 Val_Wu16 65535.00 DFES_OneToOne 0.00 65535.00 FORMAT "%8.2" /end CHARACTERISTIC
/begin CHARACTERISTIC DFES_DTCO.DFC_CEngUsTSRCMax_C "/" VALUE 0x80074502 Val_Wu16 65535.00 DFES_OneToOne 0.00 65535.00 FORMAT "%8.2" /end CHARACTERISTIC
/begin CHARACTERISTIC DFES_DTCO.DFC_CEngUsTSRCMin_C "/" VALUE 0x80074504 Val_Wu16 65535.00 DFES_OneToOne 0.00 65535.00 FORMAT "%8.2" /end CHARACTERISTIC
/begin CHARACTERISTIC DFES_DTCO.DFC_CThmstOL_C "/" VALUE 0x80074506 Val_Wu16 65535.00 DFES_OneToOne 0.00 65535.00 FORMAT "%8.2" /end CHARACTERISTIC
/begin CHARACTERISTIC DFES_DTCO.DFC_CThmstSCB_C "/" VALUE 0x80074508 Val_Wu16 65535.00 DFES_OneToOne 0.00 65535.00 FORMAT "%8.2" /end CHARACTERISTIC
/begin CHARACTERISTIC DFES_DTCO.DFC_CThmstSCG_C "/" VALUE 0x8007450A Val_Wu16 65535.00 DFES_OneToOne 0.00 65535.00 FORMAT "%8.2" /end CHARACTERISTIC
/begin CHARACTERISTIC DFES_DTCO.DFC_ClthSig_C "/" VALUE 0x8007450C Val_Wu16 65535.00 DFES_OneToOne 0.00 65535.00 FORMAT "%8.2" /end CHARACTERISTIC
/begin CHARACTERISTIC DFES_DTCO.DFC_ECBVlvOL_C "/" VALUE 0x8007450E Val_Wu16 65535.00 DFES_OneToOne 0.00 65535.00 FORMAT "%8.2" /end CHARACTERISTIC
/begin CHARACTERISTIC DFES_DTCO.DFC_ECBVlvSCB_C "/" VALUE 0x80074510 Val_Wu16 65535.00 DFES_OneToOne 0.00 65535.00 FORMAT "%8.2" /end CHARACTERISTIC
/begin CHARACTERISTIC DFES_DTCO.DFC_ECBVlvSCG_C "/" VALUE 0x80074512 Val_Wu16 65535.00 DFES_OneToOne 0.00 65535.00 FORMAT "%8.2" /end CHARACTERISTIC
/begin CHARACTERISTIC DFES_DTCO.DFC_ECBVlvSRCMax_C "/" VALUE 0x80074514 Val_Wu16 65535.00 DFES_OneToOne 0.00 65535.00 FORMAT "%8.2" /end CHARACTERISTIC
/begin CHARACTERISTIC DFES_DTCO.DFC_ECBVlvSRCMin_C "/" VALUE 0x80074516 Val_Wu16 65535.00 DFES_OneToOne 0.00 65535.00 FORMAT "%8.2" /end CHARACTERISTIC
/begin CHARACTERISTIC DFES_DTCO.DFC_EGRVlvGovDvtMax_C "/" VALUE 0x80074518 Val_Wu16 65535.00 DFES_OneToOne 0.00 65535.00 FORMAT "%8.2" /end CHARACTERISTIC
/begin CHARACTERISTIC DFES_DTCO.DFC_EGRVlvGovDvtMin_C "/" VALUE 0x8007451A Val_Wu16 65535.00 DFES_OneToOne 0.00 65535.00 FORMAT "%8.2" /end CHARACTERISTIC
/begin CHARACTERISTIC DFES_DTCO.DFC_EGRVlvOL_C "/" VALUE 0x8007451C Val_Wu16 65535.00 DFES_OneToOne 0.00 65535.00 FORMAT "%8.2" /end CHARACTERISTIC
/begin CHARACTERISTIC DFES_DTCO.DFC_EGRVlvSCB_C "/" VALUE 0x8007451E Val_Wu16 65535.00 DFES_OneToOne 0.00 65535.00 FORMAT "%8.2" /end CHARACTERISTIC
/begin CHARACTERISTIC DFES_DTCO.DFC_EGRVlvSCG_C "/" VALUE 0x80074520 Val_Wu16 65535.00 DFES_OneToOne 0.00 65535.00 FORMAT "%8.2" /end CHARACTERISTIC
/begin CHARACTERISTIC DFES_DTCO.DFC_EGRVlvSRCMax_C "/" VALUE 0x80074522 Val_Wu16 65535.00 DFES_OneToOne 0.00 65535.00 FORMAT "%8.2" /end CHARACTERISTIC
/begin CHARACTERISTIC DFES_DTCO.DFC_EGRVlvSRCMin_C "/" VALUE 0x80074524 Val_Wu16 65535.00 DFES_OneToOne 0.00 65535.00 FORMAT "%8.2" /end CHARACTERISTIC
/begin CHARACTERISTIC DFES_DTCO.DFC_EMDmpOL_0_C "/" VALUE 0x80074526 Val_Wu16 65535.00 DFES_OneToOne 0.00 65535.00 FORMAT "%8.2" /end CHARACTERISTIC
/begin CHARACTERISTIC DFES_DTCO.DFC_EMDmpOL_1_C "/" VALUE 0x80074528 Val_Wu16 65535.00 DFES_OneToOne 0.00 65535.00 FORMAT "%8.2" /end CHARACTERISTIC
/begin CHARACTERISTIC DFES_DTCO.DFC_EMDmpSCB_0_C "/" VALUE 0x8007452A Val_Wu16 65535.00 DFES_OneToOne 0.00 65535.00 FORMAT "%8.2" /end CHARACTERISTIC
/begin CHARACTERISTIC DFES_DTCO.DFC_EMDmpSCB_1_C "/" VALUE 0x8007452C Val_Wu16 65535.00 DFES_OneToOne 0.00 65535.00 FORMAT "%8.2" /end CHARACTERISTIC
/begin CHARACTERISTIC DFES_DTCO.DFC_EMDmpSCG_0_C "/" VALUE 0x8007452E Val_Wu16 65535.00 DFES_OneToOne 0.00 65535.00 FORMAT "%8.2" /end CHARACTERISTIC
/begin CHARACTERISTIC DFES_DTCO.DFC_EMDmpSCG_1_C "/" VALUE 0x80074530 Val_Wu16 65535.00 DFES_OneToOne 0.00 65535.00 FORMAT "%8.2" /end CHARACTERISTIC
/begin CHARACTERISTIC DFES_DTCO.DFC_EngStAOL_C "/" VALUE 0x80074532 Val_Wu16 65535.00 DFES_OneToOne 0.00 65535.00 FORMAT "%8.2" /end CHARACTERISTIC
/begin CHARACTERISTIC DFES_DTCO.DFC_EngStASCB_C "/" VALUE 0x80074534 Val_Wu16 65535.00 DFES_OneToOne 0.00 65535.00 FORMAT "%8.2" /end CHARACTERISTIC
/begin CHARACTERISTIC DFES_DTCO.DFC_EngStASCG_C "/" VALUE 0x80074536 Val_Wu16 65535.00 DFES_OneToOne 0.00 65535.00 FORMAT "%8.2" /end CHARACTERISTIC
/begin CHARACTERISTIC DFES_DTCO.DFC_EnvPSRCMax_C "/" VALUE 0x80074538 Val_Wu16 65535.00 DFES_OneToOne 0.00 65535.00 FORMAT "%8.2" /end CHARACTERISTIC
/begin CHARACTERISTIC DFES_DTCO.DFC_EnvPSRCMin_C "/" VALUE 0x8007453A Val_Wu16 65535.00 DFES_OneToOne 0.00 65535.00 FORMAT "%8.2" /end CHARACTERISTIC
/begin CHARACTERISTIC DFES_DTCO.DFC_EnvPSig_C "/" VALUE 0x8007453C Val_Wu16 65535.00 DFES_OneToOne 0.00 65535.00 FORMAT "%8.2" /end CHARACTERISTIC
/begin CHARACTERISTIC DFES_DTCO.DFC_EnvTSRCMax_C "/" VALUE 0x8007453E Val_Wu16 65535.00 DFES_OneToOne 0.00 65535.00 FORMAT "%8.2" /end CHARACTERISTIC
/begin CHARACTERISTIC DFES_DTCO.DFC_EnvTSRCMin_C "/" VALUE 0x80074540 Val_Wu16 65535.00 DFES_OneToOne 0.00 65535.00 FORMAT "%8.2" /end CHARACTERISTIC
/begin CHARACTERISTIC DFES_DTCO.DFC_FanOL_C "/" VALUE 0x80074542 Val_Wu16 65535.00 DFES_OneToOne 0.00 65535.00 FORMAT "%8.2" /end CHARACTERISTIC
/begin CHARACTERISTIC DFES_DTCO.DFC_FanSCB_C "/" VALUE 0x80074544 Val_Wu16 65535.00 DFES_OneToOne 0.00 65535.00 FORMAT "%8.2" /end CHARACTERISTIC
/begin CHARACTERISTIC DFES_DTCO.DFC_FlFltSig_C "/" VALUE 0x80074546 Val_Wu16 65535.00 DFES_OneToOne 0.00 65535.00 FORMAT "%8.2" /end CHARACTERISTIC
/begin CHARACTERISTIC DFES_DTCO.DFC_FuelTSRCMax_C "/" VALUE 0x80074548 Val_Wu16 65535.00 DFES_OneToOne 0.00 65535.00 FORMAT "%8.2" /end CHARACTERISTIC
/begin CHARACTERISTIC DFES_DTCO.DFC_FuelTSRCMin_C "/" VALUE 0x8007454A Val_Wu16 65535.00 DFES_OneToOne 0.00 65535.00 FORMAT "%8.2" /end CHARACTERISTIC
/begin CHARACTERISTIC DFES_DTCO.DFC_GbxNPosPPerSRCMax_C "/" VALUE 0x8007454C Val_Wu16 65535.00 DFES_OneToOne 0.00 65535.00 FORMAT "%8.2" /end CHARACTERISTIC
/begin CHARACTERISTIC DFES_DTCO.DFC_GbxNPosPPerSRCMin_C "/" VALUE 0x8007454E Val_Wu16 65535.00 DFES_OneToOne 0.00 65535.00 FORMAT "%8.2" /end CHARACTERISTIC
/begin CHARACTERISTIC DFES_DTCO.DFC_GbxNPosPdcycSRCMax_C "/" VALUE 0x80074550 Val_Wu16 65535.00 DFES_OneToOne 0.00 65535.00 FORMAT "%8.2" /end CHARACTERISTIC
/begin CHARACTERISTIC DFES_DTCO.DFC_GbxNPosPdcycSRCMin_C "/" VALUE 0x80074552 Val_Wu16 65535.00 DFES_OneToOne 0.00 65535.00 FORMAT "%8.2" /end CHARACTERISTIC
/begin CHARACTERISTIC DFES_DTCO.DFC_GbxNPosSig_C "/" VALUE 0x80074554 Val_Wu16 65535.00 DFES_OneToOne 0.00 65535.00 FORMAT "%8.2" /end CHARACTERISTIC
/begin CHARACTERISTIC DFES_DTCO.DFC_GlwPlgBSDOL_0_C "/" VALUE 0x80074556 Val_Wu16 65535.00 DFES_OneToOne 0.00 65535.00 FORMAT "%8.2" /end CHARACTERISTIC
/begin CHARACTERISTIC DFES_DTCO.DFC_GlwPlgBSDOL_1_C "/" VALUE 0x80074558 Val_Wu16 65535.00 DFES_OneToOne 0.00 65535.00 FORMAT "%8.2" /end CHARACTERISTIC
/begin CHARACTERISTIC DFES_DTCO.DFC_GlwPlgBSDOL_2_C "/" VALUE 0x8007455A Val_Wu16 65535.00 DFES_OneToOne 0.00 65535.00 FORMAT "%8.2" /end CHARACTERISTIC
/begin CHARACTERISTIC DFES_DTCO.DFC_GlwPlgBSDOL_3_C "/" VALUE 0x8007455C Val_Wu16 65535.00 DFES_OneToOne 0.00 65535.00 FORMAT "%8.2" /end CHARACTERISTIC
/begin CHARACTERISTIC DFES_DTCO.DFC_GlwPlgBSDOL_4_C "/" VALUE 0x8007455E Val_Wu16 65535.00 DFES_OneToOne 0.00 65535.00 FORMAT "%8.2" /end CHARACTERISTIC
/begin CHARACTERISTIC DFES_DTCO.DFC_GlwPlgBSDOL_5_C "/" VALUE 0x80074560 Val_Wu16 65535.00 DFES_OneToOne 0.00 65535.00 FORMAT "%8.2" /end CHARACTERISTIC
/begin CHARACTERISTIC DFES_DTCO.DFC_GlwPlgBSDOL_6_C "/" VALUE 0x80074562 Val_Wu16 65535.00 DFES_OneToOne 0.00 65535.00 FORMAT "%8.2" /end CHARACTERISTIC
/begin CHARACTERISTIC DFES_DTCO.DFC_GlwPlgBSDOL_7_C "/" VALUE 0x80074564 Val_Wu16 65535.00 DFES_OneToOne 0.00 65535.00 FORMAT "%8.2" /end CHARACTERISTIC
/begin CHARACTERISTIC DFES_DTCO.DFC_GlwPlgBSDOT_0_C "/" VALUE 0x80074566 Val_Wu16 65535.00 DFES_OneToOne 0.00 65535.00 FORMAT "%8.2" /end CHARACTERISTIC
/begin CHARACTERISTIC DFES_DTCO.DFC_GlwPlgBSDOT_1_C "/" VALUE 0x80074568 Val_Wu16 65535.00 DFES_OneToOne 0.00 65535.00 FORMAT "%8.2" /end CHARACTERISTIC
/begin CHARACTERISTIC DFES_DTCO.DFC_GlwPlgBSDOT_2_C "/" VALUE 0x8007456A Val_Wu16 65535.00 DFES_OneToOne 0.00 65535.00 FORMAT "%8.2" /end CHARACTERISTIC
/begin CHARACTERISTIC DFES_DTCO.DFC_GlwPlgBSDOT_3_C "/" VALUE 0x8007456C Val_Wu16 65535.00 DFES_OneToOne 0.00 65535.00 FORMAT "%8.2" /end CHARACTERISTIC
/begin CHARACTERISTIC DFES_DTCO.DFC_GlwPlgBSDOT_4_C "/" VALUE 0x8007456E Val_Wu16 65535.00 DFES_OneToOne 0.00 65535.00 FORMAT "%8.2" /end CHARACTERISTIC
/begin CHARACTERISTIC DFES_DTCO.DFC_GlwPlgBSDOT_5_C "/" VALUE 0x80074570 Val_Wu16 65535.00 DFES_OneToOne 0.00 65535.00 FORMAT "%8.2" /end CHARACTERISTIC
/begin CHARACTERISTIC DFES_DTCO.DFC_GlwPlgBSDOT_6_C "/" VALUE 0x80074572 Val_Wu16 65535.00 DFES_OneToOne 0.00 65535.00 FORMAT "%8.2" /end CHARACTERISTIC
/begin CHARACTERISTIC DFES_DTCO.DFC_GlwPlgBSDOT_7_C "/" VALUE 0x80074574 Val_Wu16 65535.00 DFES_OneToOne 0.00 65535.00 FORMAT "%8.2" /end CHARACTERISTIC
/begin CHARACTERISTIC DFES_DTCO.DFC_GlwPlgBSDSC_0_C "/" VALUE 0x80074576 Val_Wu16 65535.00 DFES_OneToOne 0.00 65535.00 FORMAT "%8.2" /end CHARACTERISTIC
/begin CHARACTERISTIC DFES_DTCO.DFC_GlwPlgBSDSC_1_C "/" VALUE 0x80074578 Val_Wu16 65535.00 DFES_OneToOne 0.00 65535.00 FORMAT "%8.2" /end CHARACTERISTIC
/begin CHARACTERISTIC DFES_DTCO.DFC_GlwPlgBSDSC_2_C "/" VALUE 0x8007457A Val_Wu16 65535.00 DFES_OneToOne 0.00 65535.00 FORMAT "%8.2" /end CHARACTERISTIC
/begin CHARACTERISTIC DFES_DTCO.DFC_GlwPlgBSDSC_3_C "/" VALUE 0x8007457C Val_Wu16 65535.00 DFES_OneToOne 0.00 65535.00 FORMAT "%8.2" /end CHARACTERISTIC
/begin CHARACTERISTIC DFES_DTCO.DFC_GlwPlgBSDSC_4_C "/" VALUE 0x8007457E Val_Wu16 65535.00 DFES_OneToOne 0.00 65535.00 FORMAT "%8.2" /end CHARACTERISTIC
/begin CHARACTERISTIC DFES_DTCO.DFC_GlwPlgBSDSC_5_C "/" VALUE 0x80074580 Val_Wu16 65535.00 DFES_OneToOne 0.00 65535.00 FORMAT "%8.2" /end CHARACTERISTIC
/begin CHARACTERISTIC DFES_DTCO.DFC_GlwPlgBSDSC_6_C "/" VALUE 0x80074582 Val_Wu16 65535.00 DFES_OneToOne 0.00 65535.00 FORMAT "%8.2" /end CHARACTERISTIC
/begin CHARACTERISTIC DFES_DTCO.DFC_GlwPlgBSDSC_7_C "/" VALUE 0x80074584 Val_Wu16 65535.00 DFES_OneToOne 0.00 65535.00 FORMAT "%8.2" /end CHARACTERISTIC
/begin CHARACTERISTIC DFES_DTCO.DFC_GlwPlgComErr_C "/" VALUE 0x80074586 Val_Wu16 65535.00 DFES_OneToOne 0.00 65535.00 FORMAT "%8.2" /end CHARACTERISTIC
/begin CHARACTERISTIC DFES_DTCO.DFC_InjVlvPresMin_C "/" VALUE 0x80074588 Val_Wu16 65535.00 DFES_OneToOne 0.00 65535.00 FORMAT "%8.2" /end CHARACTERISTIC
/begin CHARACTERISTIC DFES_DTCO.DFC_LSUCircNernstMax_0_C "/" VALUE 0x8007458A Val_Wu16 65535.00 DFES_OneToOne 0.00 65535.00 FORMAT "%8.2" /end CHARACTERISTIC
/begin CHARACTERISTIC DFES_DTCO.DFC_LSUCircNernstMax_1_C "/" VALUE 0x8007458C Val_Wu16 65535.00 DFES_OneToOne 0.00 65535.00 FORMAT "%8.2" /end CHARACTERISTIC
/begin CHARACTERISTIC DFES_DTCO.DFC_LSUCircNernstMax_2_C "/" VALUE 0x8007458E Val_Wu16 65535.00 DFES_OneToOne 0.00 65535.00 FORMAT "%8.2" /end CHARACTERISTIC
/begin CHARACTERISTIC DFES_DTCO.DFC_LSUCircNernstMax_3_C "/" VALUE 0x80074590 Val_Wu16 65535.00 DFES_OneToOne 0.00 65535.00 FORMAT "%8.2" /end CHARACTERISTIC
/begin CHARACTERISTIC DFES_DTCO.DFC_LSUCircNernstMin_0_C "/" VALUE 0x80074592 Val_Wu16 65535.00 DFES_OneToOne 0.00 65535.00 FORMAT "%8.2" /end CHARACTERISTIC
/begin CHARACTERISTIC DFES_DTCO.DFC_LSUCircNernstMin_1_C "/" VALUE 0x80074594 Val_Wu16 65535.00 DFES_OneToOne 0.00 65535.00 FORMAT "%8.2" /end CHARACTERISTIC
/begin CHARACTERISTIC DFES_DTCO.DFC_LSUCircNernstMin_2_C "/" VALUE 0x80074596 Val_Wu16 65535.00 DFES_OneToOne 0.00 65535.00 FORMAT "%8.2" /end CHARACTERISTIC
/begin CHARACTERISTIC DFES_DTCO.DFC_LSUCircNernstMin_3_C "/" VALUE 0x80074598 Val_Wu16 65535.00 DFES_OneToOne 0.00 65535.00 FORMAT "%8.2" /end CHARACTERISTIC
/begin CHARACTERISTIC DFES_DTCO.DFC_LSUCircNernstSig_0_C "/" VALUE 0x8007459A Val_Wu16 65535.00 DFES_OneToOne 0.00 65535.00 FORMAT "%8.2" /end CHARACTERISTIC
/begin CHARACTERISTIC DFES_DTCO.DFC_LSUCircNernstSig_1_C "/" VALUE 0x8007459C Val_Wu16 65535.00 DFES_OneToOne 0.00 65535.00 FORMAT "%8.2" /end CHARACTERISTIC
/begin CHARACTERISTIC DFES_DTCO.DFC_LSUCircNernstSig_2_C "/" VALUE 0x8007459E Val_Wu16 65535.00 DFES_OneToOne 0.00 65535.00 FORMAT "%8.2" /end CHARACTERISTIC
/begin CHARACTERISTIC DFES_DTCO.DFC_LSUCircNernstSig_3_C "/" VALUE 0x800745A0 Val_Wu16 65535.00 DFES_OneToOne 0.00 65535.00 FORMAT "%8.2" /end CHARACTERISTIC
/begin CHARACTERISTIC DFES_DTCO.DFC_LSUCircPmpCurMax_0_C "/" VALUE 0x800745A2 Val_Wu16 65535.00 DFES_OneToOne 0.00 65535.00 FORMAT "%8.2" /end CHARACTERISTIC
/begin CHARACTERISTIC DFES_DTCO.DFC_LSUCircPmpCurMax_1_C "/" VALUE 0x800745A4 Val_Wu16 65535.00 DFES_OneToOne 0.00 65535.00 FORMAT "%8.2" /end CHARACTERISTIC
/begin CHARACTERISTIC DFES_DTCO.DFC_LSUCircPmpCurMax_2_C "/" VALUE 0x800745A6 Val_Wu16 65535.00 DFES_OneToOne 0.00 65535.00 FORMAT "%8.2" /end CHARACTERISTIC
/begin CHARACTERISTIC DFES_DTCO.DFC_LSUCircPmpCurMax_3_C "/" VALUE 0x800745A8 Val_Wu16 65535.00 DFES_OneToOne 0.00 65535.00 FORMAT "%8.2" /end CHARACTERISTIC
/begin CHARACTERISTIC DFES_DTCO.DFC_LSUCircPmpCurMin_0_C "/" VALUE 0x800745AA Val_Wu16 65535.00 DFES_OneToOne 0.00 65535.00 FORMAT "%8.2" /end CHARACTERISTIC
/begin CHARACTERISTIC DFES_DTCO.DFC_LSUCircPmpCurMin_1_C "/" VALUE 0x800745AC Val_Wu16 65535.00 DFES_OneToOne 0.00 65535.00 FORMAT "%8.2" /end CHARACTERISTIC
/begin CHARACTERISTIC DFES_DTCO.DFC_LSUCircPmpCurMin_2_C "/" VALUE 0x800745AE Val_Wu16 65535.00 DFES_OneToOne 0.00 65535.00 FORMAT "%8.2" /end CHARACTERISTIC
/begin CHARACTERISTIC DFES_DTCO.DFC_LSUCircPmpCurMin_3_C "/" VALUE 0x800745B0 Val_Wu16 65535.00 DFES_OneToOne 0.00 65535.00 FORMAT "%8.2" /end CHARACTERISTIC
/begin CHARACTERISTIC DFES_DTCO.DFC_LSUCircPmpCurSig_0_C "/" VALUE 0x800745B2 Val_Wu16 65535.00 DFES_OneToOne 0.00 65535.00 FORMAT "%8.2" /end CHARACTERISTIC
/begin CHARACTERISTIC DFES_DTCO.DFC_LSUCircPmpCurSig_1_C "/" VALUE 0x800745B4 Val_Wu16 65535.00 DFES_OneToOne 0.00 65535.00 FORMAT "%8.2" /end CHARACTERISTIC
/begin CHARACTERISTIC DFES_DTCO.DFC_LSUCircPmpCurSig_2_C "/" VALUE 0x800745B6 Val_Wu16 65535.00 DFES_OneToOne 0.00 65535.00 FORMAT "%8.2" /end CHARACTERISTIC
/begin CHARACTERISTIC DFES_DTCO.DFC_LSUCircPmpCurSig_3_C "/" VALUE 0x800745B8 Val_Wu16 65535.00 DFES_OneToOne 0.00 65535.00 FORMAT "%8.2" /end CHARACTERISTIC
/begin CHARACTERISTIC DFES_DTCO.DFC_LSUCircVirtGndMax_0_C "/" VALUE 0x800745BA Val_Wu16 65535.00 DFES_OneToOne 0.00 65535.00 FORMAT "%8.2" /end CHARACTERISTIC
/begin CHARACTERISTIC DFES_DTCO.DFC_LSUCircVirtGndMax_1_C "/" VALUE 0x800745BC Val_Wu16 65535.00 DFES_OneToOne 0.00 65535.00 FORMAT "%8.2" /end CHARACTERISTIC
/begin CHARACTERISTIC DFES_DTCO.DFC_LSUCircVirtGndMax_2_C "/" VALUE 0x800745BE Val_Wu16 65535.00 DFES_OneToOne 0.00 65535.00 FORMAT "%8.2" /end CHARACTERISTIC
/begin CHARACTERISTIC DFES_DTCO.DFC_LSUCircVirtGndMax_3_C "/" VALUE 0x800745C0 Val_Wu16 65535.00 DFES_OneToOne 0.00 65535.00 FORMAT "%8.2" /end CHARACTERISTIC
/begin CHARACTERISTIC DFES_DTCO.DFC_LSUCircVirtGndMin_0_C "/" VALUE 0x800745C2 Val_Wu16 65535.00 DFES_OneToOne 0.00 65535.00 FORMAT "%8.2" /end CHARACTERISTIC
/begin CHARACTERISTIC DFES_DTCO.DFC_LSUCircVirtGndMin_1_C "/" VALUE 0x800745C4 Val_Wu16 65535.00 DFES_OneToOne 0.00 65535.00 FORMAT "%8.2" /end CHARACTERISTIC
/begin CHARACTERISTIC DFES_DTCO.DFC_LSUCircVirtGndMin_2_C "/" VALUE 0x800745C6 Val_Wu16 65535.00 DFES_OneToOne 0.00 65535.00 FORMAT "%8.2" /end CHARACTERISTIC
/begin CHARACTERISTIC DFES_DTCO.DFC_LSUCircVirtGndMin_3_C "/" VALUE 0x800745C8 Val_Wu16 65535.00 DFES_OneToOne 0.00 65535.00 FORMAT "%8.2" /end CHARACTERISTIC
/begin CHARACTERISTIC DFES_DTCO.DFC_LSUCircVirtGndSig_0_C "/" VALUE 0x800745CA Val_Wu16 65535.00 DFES_OneToOne 0.00 65535.00 FORMAT "%8.2" /end CHARACTERISTIC
/begin CHARACTERISTIC DFES_DTCO.DFC_LSUCircVirtGndSig_1_C "/" VALUE 0x800745CC Val_Wu16 65535.00 DFES_OneToOne 0.00 65535.00 FORMAT "%8.2" /end CHARACTERISTIC
/begin CHARACTERISTIC DFES_DTCO.DFC_LSUCircVirtGndSig_2_C "/" VALUE 0x800745CE Val_Wu16 65535.00 DFES_OneToOne 0.00 65535.00 FORMAT "%8.2" /end CHARACTERISTIC
/begin CHARACTERISTIC DFES_DTCO.DFC_LSUCircVirtGndSig_3_C "/" VALUE 0x800745D0 Val_Wu16 65535.00 DFES_OneToOne 0.00 65535.00 FORMAT "%8.2" /end CHARACTERISTIC
/begin CHARACTERISTIC DFES_DTCO.DFC_LSUHtrMax_0_C "/" VALUE 0x800745D2 Val_Wu16 65535.00 DFES_OneToOne 0.00 65535.00 FORMAT "%8.2" /end CHARACTERISTIC
/begin CHARACTERISTIC DFES_DTCO.DFC_LSUHtrMax_1_C "/" VALUE 0x800745D4 Val_Wu16 65535.00 DFES_OneToOne 0.00 65535.00 FORMAT "%8.2" /end CHARACTERISTIC
/begin CHARACTERISTIC DFES_DTCO.DFC_LSUHtrMax_2_C "/" VALUE 0x800745D6 Val_Wu16 65535.00 DFES_OneToOne 0.00 65535.00 FORMAT "%8.2" /end CHARACTERISTIC
/begin CHARACTERISTIC DFES_DTCO.DFC_LSUHtrMax_3_C "/" VALUE 0x800745D8 Val_Wu16 65535.00 DFES_OneToOne 0.00 65535.00 FORMAT "%8.2" /end CHARACTERISTIC
/begin CHARACTERISTIC DFES_DTCO.DFC_LSUHtrMin_0_C "/" VALUE 0x800745DA Val_Wu16 65535.00 DFES_OneToOne 0.00 65535.00 FORMAT "%8.2" /end CHARACTERISTIC
/begin CHARACTERISTIC DFES_DTCO.DFC_LSUHtrMin_1_C "/" VALUE 0x800745DC Val_Wu16 65535.00 DFES_OneToOne 0.00 65535.00 FORMAT "%8.2" /end CHARACTERISTIC
/begin CHARACTERISTIC DFES_DTCO.DFC_LSUHtrMin_2_C "/" VALUE 0x800745DE Val_Wu16 65535.00 DFES_OneToOne 0.00 65535.00 FORMAT "%8.2" /end CHARACTERISTIC
/begin CHARACTERISTIC DFES_DTCO.DFC_LSUHtrMin_3_C "/" VALUE 0x800745E0 Val_Wu16 65535.00 DFES_OneToOne 0.00 65535.00 FORMAT "%8.2" /end CHARACTERISTIC
/begin CHARACTERISTIC DFES_DTCO.DFC_LSUHtrSig_0_C "/" VALUE 0x800745E2 Val_Wu16 65535.00 DFES_OneToOne 0.00 65535.00 FORMAT "%8.2" /end CHARACTERISTIC
/begin CHARACTERISTIC DFES_DTCO.DFC_LSUHtrSig_1_C "/" VALUE 0x800745E4 Val_Wu16 65535.00 DFES_OneToOne 0.00 65535.00 FORMAT "%8.2" /end CHARACTERISTIC
/begin CHARACTERISTIC DFES_DTCO.DFC_LSUHtrSig_2_C "/" VALUE 0x800745E6 Val_Wu16 65535.00 DFES_OneToOne 0.00 65535.00 FORMAT "%8.2" /end CHARACTERISTIC
/begin CHARACTERISTIC DFES_DTCO.DFC_LSUHtrSig_3_C "/" VALUE 0x800745E8 Val_Wu16 65535.00 DFES_OneToOne 0.00 65535.00 FORMAT "%8.2" /end CHARACTERISTIC
/begin CHARACTERISTIC DFES_DTCO.DFC_LSUO2Max_0_C "/" VALUE 0x800745EA Val_Wu16 65535.00 DFES_OneToOne 0.00 65535.00 FORMAT "%8.2" /end CHARACTERISTIC
/begin CHARACTERISTIC DFES_DTCO.DFC_LSUO2Max_1_C "/" VALUE 0x800745EC Val_Wu16 65535.00 DFES_OneToOne 0.00 65535.00 FORMAT "%8.2" /end CHARACTERISTIC
/begin CHARACTERISTIC DFES_DTCO.DFC_LSUO2Max_2_C "/" VALUE 0x800745EE Val_Wu16 65535.00 DFES_OneToOne 0.00 65535.00 FORMAT "%8.2" /end CHARACTERISTIC
/begin CHARACTERISTIC DFES_DTCO.DFC_LSUO2Max_3_C "/" VALUE 0x800745F0 Val_Wu16 65535.00 DFES_OneToOne 0.00 65535.00 FORMAT "%8.2" /end CHARACTERISTIC
/begin CHARACTERISTIC DFES_DTCO.DFC_LSUO2Min_0_C "/" VALUE 0x800745F2 Val_Wu16 65535.00 DFES_OneToOne 0.00 65535.00 FORMAT "%8.2" /end CHARACTERISTIC
/begin CHARACTERISTIC DFES_DTCO.DFC_LSUO2Min_1_C "/" VALUE 0x800745F4 Val_Wu16 65535.00 DFES_OneToOne 0.00 65535.00 FORMAT "%8.2" /end CHARACTERISTIC
/begin CHARACTERISTIC DFES_DTCO.DFC_LSUO2Min_2_C "/" VALUE 0x800745F6 Val_Wu16 65535.00 DFES_OneToOne 0.00 65535.00 FORMAT "%8.2" /end CHARACTERISTIC
/begin CHARACTERISTIC DFES_DTCO.DFC_LSUO2Min_3_C "/" VALUE 0x800745F8 Val_Wu16 65535.00 DFES_OneToOne 0.00 65535.00 FORMAT "%8.2" /end CHARACTERISTIC
/begin CHARACTERISTIC DFES_DTCO.DFC_LSUSPIBattLowMin_0_C "/" VALUE 0x800745FA Val_Wu16 65535.00 DFES_OneToOne 0.00 65535.00 FORMAT "%8.2" /end CHARACTERISTIC
/begin CHARACTERISTIC DFES_DTCO.DFC_LSUSPIBattLowMin_1_C "/" VALUE 0x800745FC Val_Wu16 65535.00 DFES_OneToOne 0.00 65535.00 FORMAT "%8.2" /end CHARACTERISTIC
/begin CHARACTERISTIC DFES_DTCO.DFC_LSUSPIBattLowMin_2_C "/" VALUE 0x800745FE Val_Wu16 65535.00 DFES_OneToOne 0.00 65535.00 FORMAT "%8.2" /end CHARACTERISTIC
/begin CHARACTERISTIC DFES_DTCO.DFC_LSUSPIBattLowMin_3_C "/" VALUE 0x80074600 Val_Wu16 65535.00 DFES_OneToOne 0.00 65535.00 FORMAT "%8.2" /end CHARACTERISTIC
/begin CHARACTERISTIC DFES_DTCO.DFC_LSUSPISig_0_C "/" VALUE 0x80074602 Val_Wu16 65535.00 DFES_OneToOne 0.00 65535.00 FORMAT "%8.2" /end CHARACTERISTIC
/begin CHARACTERISTIC DFES_DTCO.DFC_LSUSPISig_1_C "/" VALUE 0x80074604 Val_Wu16 65535.00 DFES_OneToOne 0.00 65535.00 FORMAT "%8.2" /end CHARACTERISTIC
/begin CHARACTERISTIC DFES_DTCO.DFC_LSUSPISig_2_C "/" VALUE 0x80074606 Val_Wu16 65535.00 DFES_OneToOne 0.00 65535.00 FORMAT "%8.2" /end CHARACTERISTIC
/begin CHARACTERISTIC DFES_DTCO.DFC_LSUSPISig_3_C "/" VALUE 0x80074608 Val_Wu16 65535.00 DFES_OneToOne 0.00 65535.00 FORMAT "%8.2" /end CHARACTERISTIC
/begin CHARACTERISTIC DFES_DTCO.DFC_LSUtExcMax_0_C "/" VALUE 0x8007460A Val_Wu16 65535.00 DFES_OneToOne 0.00 65535.00 FORMAT "%8.2" /end CHARACTERISTIC
/begin CHARACTERISTIC DFES_DTCO.DFC_LSUtExcMax_1_C "/" VALUE 0x8007460C Val_Wu16 65535.00 DFES_OneToOne 0.00 65535.00 FORMAT "%8.2" /end CHARACTERISTIC
/begin CHARACTERISTIC DFES_DTCO.DFC_LSUtExcMax_2_C "/" VALUE 0x8007460E Val_Wu16 65535.00 DFES_OneToOne 0.00 65535.00 FORMAT "%8.2" /end CHARACTERISTIC
/begin CHARACTERISTIC DFES_DTCO.DFC_LSUtExcMax_3_C "/" VALUE 0x80074610 Val_Wu16 65535.00 DFES_OneToOne 0.00 65535.00 FORMAT "%8.2" /end CHARACTERISTIC
/begin CHARACTERISTIC DFES_DTCO.DFC_LSUtExcMin_0_C "/" VALUE 0x80074612 Val_Wu16 65535.00 DFES_OneToOne 0.00 65535.00 FORMAT "%8.2" /end CHARACTERISTIC
/begin CHARACTERISTIC DFES_DTCO.DFC_LSUtExcMin_1_C "/" VALUE 0x80074614 Val_Wu16 65535.00 DFES_OneToOne 0.00 65535.00 FORMAT "%8.2" /end CHARACTERISTIC
/begin CHARACTERISTIC DFES_DTCO.DFC_LSUtExcMin_2_C "/" VALUE 0x80074616 Val_Wu16 65535.00 DFES_OneToOne 0.00 65535.00 FORMAT "%8.2" /end CHARACTERISTIC
/begin CHARACTERISTIC DFES_DTCO.DFC_LSUtExcMin_3_C "/" VALUE 0x80074618 Val_Wu16 65535.00 DFES_OneToOne 0.00 65535.00 FORMAT "%8.2" /end CHARACTERISTIC
/begin CHARACTERISTIC DFES_DTCO.DFC_MILOL_C "/" VALUE 0x8007461A Val_Wu16 65535.00 DFES_OneToOne 0.00 65535.00 FORMAT "%8.2" /end CHARACTERISTIC
/begin CHARACTERISTIC DFES_DTCO.DFC_MILSCB_C "/" VALUE 0x8007461C Val_Wu16 65535.00 DFES_OneToOne 0.00 65535.00 FORMAT "%8.2" /end CHARACTERISTIC
/begin CHARACTERISTIC DFES_DTCO.DFC_MILSCG_C "/" VALUE 0x8007461E Val_Wu16 65535.00 DFES_OneToOne 0.00 65535.00 FORMAT "%8.2" /end CHARACTERISTIC
/begin CHARACTERISTIC DFES_DTCO.DFC_MeUnSCG_C "/" VALUE 0x80074620 Val_Wu16 65535.00 DFES_OneToOne 0.00 65535.00 FORMAT "%8.2" /end CHARACTERISTIC
/begin CHARACTERISTIC DFES_DTCO.DFC_NplHsChngPPFltDiff_C "/" VALUE 0x80074622 Val_Wu16 65535.00 DFES_OneToOne 0.00 65535.00 FORMAT "%8.2" /end CHARACTERISTIC
/begin CHARACTERISTIC DFES_DTCO.DFC_NplPAirFltDs_C "/" VALUE 0x80074624 Val_Wu16 65535.00 DFES_OneToOne 0.00 65535.00 FORMAT "%8.2" /end CHARACTERISTIC
/begin CHARACTERISTIC DFES_DTCO.DFC_NplTPFltUs_C "/" VALUE 0x80074626 Val_Wu16 65535.00 DFES_OneToOne 0.00 65535.00 FORMAT "%8.2" /end CHARACTERISTIC
/begin CHARACTERISTIC DFES_DTCO.DFC_OilComErr_C "/" VALUE 0x80074628 Val_Wu16 65535.00 DFES_OneToOne 0.00 65535.00 FORMAT "%8.2" /end CHARACTERISTIC
/begin CHARACTERISTIC DFES_DTCO.DFC_OilPLmpOL_C "/" VALUE 0x8007462A Val_Wu16 65535.00 DFES_OneToOne 0.00 65535.00 FORMAT "%8.2" /end CHARACTERISTIC
/begin CHARACTERISTIC DFES_DTCO.DFC_OilPLmpSCB_C "/" VALUE 0x8007462C Val_Wu16 65535.00 DFES_OneToOne 0.00 65535.00 FORMAT "%8.2" /end CHARACTERISTIC
/begin CHARACTERISTIC DFES_DTCO.DFC_OilPLmpSCG_C "/" VALUE 0x8007462E Val_Wu16 65535.00 DFES_OneToOne 0.00 65535.00 FORMAT "%8.2" /end CHARACTERISTIC
/begin CHARACTERISTIC DFES_DTCO.DFC_OilPNpl_C "/" VALUE 0x80074630 Val_Wu16 65535.00 DFES_OneToOne 0.00 65535.00 FORMAT "%8.2" /end CHARACTERISTIC
/begin CHARACTERISTIC DFES_DTCO.DFC_OilTNpl_C "/" VALUE 0x80074632 Val_Wu16 65535.00 DFES_OneToOne 0.00 65535.00 FORMAT "%8.2" /end CHARACTERISTIC
/begin CHARACTERISTIC DFES_DTCO.DFC_OilTSRCMax_C "/" VALUE 0x80074634 Val_Wu16 65535.00 DFES_OneToOne 0.00 65535.00 FORMAT "%8.2" /end CHARACTERISTIC
/begin CHARACTERISTIC DFES_DTCO.DFC_OilTSRCMin_C "/" VALUE 0x80074636 Val_Wu16 65535.00 DFES_OneToOne 0.00 65535.00 FORMAT "%8.2" /end CHARACTERISTIC
/begin CHARACTERISTIC DFES_DTCO.DFC_PCACDsEnvPPls_C "/" VALUE 0x80074638 Val_Wu16 65535.00 DFES_OneToOne 0.00 65535.00 FORMAT "%8.2" /end CHARACTERISTIC
/begin CHARACTERISTIC DFES_DTCO.DFC_PCACDsSRCMax_C "/" VALUE 0x8007463A Val_Wu16 65535.00 DFES_OneToOne 0.00 65535.00 FORMAT "%8.2" /end CHARACTERISTIC
/begin CHARACTERISTIC DFES_DTCO.DFC_PCACDsSRCMin_C "/" VALUE 0x8007463C Val_Wu16 65535.00 DFES_OneToOne 0.00 65535.00 FORMAT "%8.2" /end CHARACTERISTIC
/begin CHARACTERISTIC DFES_DTCO.DFC_PCVSCG_C "/" VALUE 0x8007463E Val_Wu16 65535.00 DFES_OneToOne 0.00 65535.00 FORMAT "%8.2" /end CHARACTERISTIC
/begin CHARACTERISTIC DFES_DTCO.DFC_PFltCharPDiffMin_C "/" VALUE 0x80074640 Val_Wu16 65535.00 DFES_OneToOne 0.00 65535.00 FORMAT "%8.2" /end CHARACTERISTIC
/begin CHARACTERISTIC DFES_DTCO.DFC_PFltDstrMin_C "/" VALUE 0x80074642 Val_Wu16 65535.00 DFES_OneToOne 0.00 65535.00 FORMAT "%8.2" /end CHARACTERISTIC
/begin CHARACTERISTIC DFES_DTCO.DFC_PFltEngPrt_C "/" VALUE 0x80074644 Val_Wu16 65535.00 DFES_OneToOne 0.00 65535.00 FORMAT "%8.2" /end CHARACTERISTIC
/begin CHARACTERISTIC DFES_DTCO.DFC_PFltLmpOL_C "/" VALUE 0x80074646 Val_Wu16 65535.00 DFES_OneToOne 0.00 65535.00 FORMAT "%8.2" /end CHARACTERISTIC
/begin CHARACTERISTIC DFES_DTCO.DFC_PFltLmpSCB_C "/" VALUE 0x80074648 Val_Wu16 65535.00 DFES_OneToOne 0.00 65535.00 FORMAT "%8.2" /end CHARACTERISTIC
/begin CHARACTERISTIC DFES_DTCO.DFC_PFltLmpSCG_C "/" VALUE 0x8007464A Val_Wu16 65535.00 DFES_OneToOne 0.00 65535.00 FORMAT "%8.2" /end CHARACTERISTIC
/begin CHARACTERISTIC DFES_DTCO.DFC_PFltRgnPerm_C "/" VALUE 0x8007464C Val_Wu16 65535.00 DFES_OneToOne 0.00 65535.00 FORMAT "%8.2" /end CHARACTERISTIC
/begin CHARACTERISTIC DFES_DTCO.DFC_PFltSRCMaxFlwRstn_C "/" VALUE 0x8007464E Val_Wu16 65535.00 DFES_OneToOne 0.00 65535.00 FORMAT "%8.2" /end CHARACTERISTIC
/begin CHARACTERISTIC DFES_DTCO.DFC_PFltSRCMinFlwRstn_C "/" VALUE 0x80074650 Val_Wu16 65535.00 DFES_OneToOne 0.00 65535.00 FORMAT "%8.2" /end CHARACTERISTIC
/begin CHARACTERISTIC DFES_DTCO.DFC_PFltSotMsDvtMax_C "/" VALUE 0x80074652 Val_Wu16 65535.00 DFES_OneToOne 0.00 65535.00 FORMAT "%8.2" /end CHARACTERISTIC
/begin CHARACTERISTIC DFES_DTCO.DFC_PFltSotMsDvtMin_C "/" VALUE 0x80074654 Val_Wu16 65535.00 DFES_OneToOne 0.00 65535.00 FORMAT "%8.2" /end CHARACTERISTIC
/begin CHARACTERISTIC DFES_DTCO.DFC_PFltSotMsMax_C "/" VALUE 0x80074656 Val_Wu16 65535.00 DFES_OneToOne 0.00 65535.00 FORMAT "%8.2" /end CHARACTERISTIC
/begin CHARACTERISTIC DFES_DTCO.DFC_PSPOL_C "/" VALUE 0x80074658 Val_Wu16 65535.00 DFES_OneToOne 0.00 65535.00 FORMAT "%8.2" /end CHARACTERISTIC
/begin CHARACTERISTIC DFES_DTCO.DFC_PSPSCB_C "/" VALUE 0x8007465A Val_Wu16 65535.00 DFES_OneToOne 0.00 65535.00 FORMAT "%8.2" /end CHARACTERISTIC
/begin CHARACTERISTIC DFES_DTCO.DFC_PSPSCG_C "/" VALUE 0x8007465C Val_Wu16 65535.00 DFES_OneToOne 0.00 65535.00 FORMAT "%8.2" /end CHARACTERISTIC
/begin CHARACTERISTIC DFES_DTCO.DFC_SRCHighAPP1_C "/" VALUE 0x8007465E Val_Wu16 65535.00 DFES_OneToOne 0.00 65535.00 FORMAT "%8.2" /end CHARACTERISTIC
/begin CHARACTERISTIC DFES_DTCO.DFC_SRCHighAPP2_C "/" VALUE 0x80074660 Val_Wu16 65535.00 DFES_OneToOne 0.00 65535.00 FORMAT "%8.2" /end CHARACTERISTIC
/begin CHARACTERISTIC DFES_DTCO.DFC_SRCLowAPP1_C "/" VALUE 0x80074662 Val_Wu16 65535.00 DFES_OneToOne 0.00 65535.00 FORMAT "%8.2" /end CHARACTERISTIC
/begin CHARACTERISTIC DFES_DTCO.DFC_SRCLowAPP2_C "/" VALUE 0x80074664 Val_Wu16 65535.00 DFES_OneToOne 0.00 65535.00 FORMAT "%8.2" /end CHARACTERISTIC
/begin CHARACTERISTIC DFES_DTCO.DFC_SRCMaxPAirFltDs_C "/" VALUE 0x80074666 Val_Wu16 65535.00 DFES_OneToOne 0.00 65535.00 FORMAT "%8.2" /end CHARACTERISTIC
/begin CHARACTERISTIC DFES_DTCO.DFC_SRCMaxPPFltUs_C "/" VALUE 0x80074668 Val_Wu16 65535.00 DFES_OneToOne 0.00 65535.00 FORMAT "%8.2" /end CHARACTERISTIC
/begin CHARACTERISTIC DFES_DTCO.DFC_SRCMaxTECU_C "/" VALUE 0x8007466A Val_Wu16 65535.00 DFES_OneToOne 0.00 65535.00 FORMAT "%8.2" /end CHARACTERISTIC
/begin CHARACTERISTIC DFES_DTCO.DFC_SRCMaxTOxiCatUs_C "/" VALUE 0x8007466C Val_Wu16 65535.00 DFES_OneToOne 0.00 65535.00 FORMAT "%8.2" /end CHARACTERISTIC
/begin CHARACTERISTIC DFES_DTCO.DFC_SRCMaxTPFltUs_C "/" VALUE 0x8007466E Val_Wu16 65535.00 DFES_OneToOne 0.00 65535.00 FORMAT "%8.2" /end CHARACTERISTIC
/begin CHARACTERISTIC DFES_DTCO.DFC_SRCMinPAirFltDs_C "/" VALUE 0x80074670 Val_Wu16 65535.00 DFES_OneToOne 0.00 65535.00 FORMAT "%8.2" /end CHARACTERISTIC
/begin CHARACTERISTIC DFES_DTCO.DFC_SRCMinPPFltUs_C "/" VALUE 0x80074672 Val_Wu16 65535.00 DFES_OneToOne 0.00 65535.00 FORMAT "%8.2" /end CHARACTERISTIC
/begin CHARACTERISTIC DFES_DTCO.DFC_SRCMinTECU_C "/" VALUE 0x80074674 Val_Wu16 65535.00 DFES_OneToOne 0.00 65535.00 FORMAT "%8.2" /end CHARACTERISTIC
/begin CHARACTERISTIC DFES_DTCO.DFC_SRCMinTOxiCatUs_C "/" VALUE 0x80074676 Val_Wu16 65535.00 DFES_OneToOne 0.00 65535.00 FORMAT "%8.2" /end CHARACTERISTIC
/begin CHARACTERISTIC DFES_DTCO.DFC_SRCMinTPFltUs_C "/" VALUE 0x80074678 Val_Wu16 65535.00 DFES_OneToOne 0.00 65535.00 FORMAT "%8.2" /end CHARACTERISTIC
/begin CHARACTERISTIC DFES_DTCO.DFC_SVSOL_C "/" VALUE 0x8007467A Val_Wu16 65535.00 DFES_OneToOne 0.00 65535.00 FORMAT "%8.2" /end CHARACTERISTIC
/begin CHARACTERISTIC DFES_DTCO.DFC_SVSSCB_C "/" VALUE 0x8007467C Val_Wu16 65535.00 DFES_OneToOne 0.00 65535.00 FORMAT "%8.2" /end CHARACTERISTIC
/begin CHARACTERISTIC DFES_DTCO.DFC_SVSSCG_C "/" VALUE 0x8007467E Val_Wu16 65535.00 DFES_OneToOne 0.00 65535.00 FORMAT "%8.2" /end CHARACTERISTIC
/begin CHARACTERISTIC DFES_DTCO.DFC_StrtOL_C "/" VALUE 0x80074680 Val_Wu16 65535.00 DFES_OneToOne 0.00 65535.00 FORMAT "%8.2" /end CHARACTERISTIC
/begin CHARACTERISTIC DFES_DTCO.DFC_StrtSCB_C "/" VALUE 0x80074682 Val_Wu16 65535.00 DFES_OneToOne 0.00 65535.00 FORMAT "%8.2" /end CHARACTERISTIC
/begin CHARACTERISTIC DFES_DTCO.DFC_StrtSCG_C "/" VALUE 0x80074684 Val_Wu16 65535.00 DFES_OneToOne 0.00 65535.00 FORMAT "%8.2" /end CHARACTERISTIC
/begin CHARACTERISTIC DFES_DTCO.DFC_SyncAPP_C "/" VALUE 0x80074686 Val_Wu16 65535.00 DFES_OneToOne 0.00 65535.00 FORMAT "%8.2" /end CHARACTERISTIC
/begin CHARACTERISTIC DFES_DTCO.DFC_T15Npl_C "/" VALUE 0x80074688 Val_Wu16 65535.00 DFES_OneToOne 0.00 65535.00 FORMAT "%8.2" /end CHARACTERISTIC
/begin CHARACTERISTIC DFES_DTCO.DFC_TAFSDtyCycHi_C "/" VALUE 0x8007468A Val_Wu16 65535.00 DFES_OneToOne 0.00 65535.00 FORMAT "%8.2" /end CHARACTERISTIC
/begin CHARACTERISTIC DFES_DTCO.DFC_TAFSDtyCycLo_C "/" VALUE 0x8007468C Val_Wu16 65535.00 DFES_OneToOne 0.00 65535.00 FORMAT "%8.2" /end CHARACTERISTIC
/begin CHARACTERISTIC DFES_DTCO.DFC_TAFSPerHi_C "/" VALUE 0x8007468E Val_Wu16 65535.00 DFES_OneToOne 0.00 65535.00 FORMAT "%8.2" /end CHARACTERISTIC
/begin CHARACTERISTIC DFES_DTCO.DFC_TAFSPerLo_C "/" VALUE 0x80074690 Val_Wu16 65535.00 DFES_OneToOne 0.00 65535.00 FORMAT "%8.2" /end CHARACTERISTIC
/begin CHARACTERISTIC DFES_DTCO.DFC_TCACDsSRCMax_C "/" VALUE 0x80074692 Val_Wu16 65535.00 DFES_OneToOne 0.00 65535.00 FORMAT "%8.2" /end CHARACTERISTIC
/begin CHARACTERISTIC DFES_DTCO.DFC_TCACDsSRCMin_C "/" VALUE 0x80074694 Val_Wu16 65535.00 DFES_OneToOne 0.00 65535.00 FORMAT "%8.2" /end CHARACTERISTIC
/begin CHARACTERISTIC DFES_DTCO.DFC_ThrVlvOL_C "/" VALUE 0x80074696 Val_Wu16 65535.00 DFES_OneToOne 0.00 65535.00 FORMAT "%8.2" /end CHARACTERISTIC
/begin CHARACTERISTIC DFES_DTCO.DFC_ThrVlvSCB_C "/" VALUE 0x80074698 Val_Wu16 65535.00 DFES_OneToOne 0.00 65535.00 FORMAT "%8.2" /end CHARACTERISTIC
/begin CHARACTERISTIC DFES_DTCO.DFC_ThrVlvSRCMax_C "/" VALUE 0x8007469A Val_Wu16 65535.00 DFES_OneToOne 0.00 65535.00 FORMAT "%8.2" /end CHARACTERISTIC
/begin CHARACTERISTIC DFES_DTCO.DFC_ThrVlvSRCMin_C "/" VALUE 0x8007469C Val_Wu16 65535.00 DFES_OneToOne 0.00 65535.00 FORMAT "%8.2" /end CHARACTERISTIC
/begin CHARACTERISTIC DFES_DTCO.DFC_TrbChLPOL_C "/" VALUE 0x8007469E Val_Wu16 65535.00 DFES_OneToOne 0.00 65535.00 FORMAT "%8.2" /end CHARACTERISTIC
/begin CHARACTERISTIC DFES_DTCO.DFC_TrbChLPSCB_C "/" VALUE 0x800746A0 Val_Wu16 65535.00 DFES_OneToOne 0.00 65535.00 FORMAT "%8.2" /end CHARACTERISTIC
/begin CHARACTERISTIC DFES_DTCO.DFC_TrbChLPSCG_C "/" VALUE 0x800746A2 Val_Wu16 65535.00 DFES_OneToOne 0.00 65535.00 FORMAT "%8.2" /end CHARACTERISTIC
/begin CHARACTERISTIC DFES_DTCO.DFC_TrbChOL_C "/" VALUE 0x800746A4 Val_Wu16 65535.00 DFES_OneToOne 0.00 65535.00 FORMAT "%8.2" /end CHARACTERISTIC
/begin CHARACTERISTIC DFES_DTCO.DFC_TrbChSCB_C "/" VALUE 0x800746A6 Val_Wu16 65535.00 DFES_OneToOne 0.00 65535.00 FORMAT "%8.2" /end CHARACTERISTIC
/begin CHARACTERISTIC DFES_DTCO.DFC_VSwVlvGovDvtMax_C "/" VALUE 0x800746A8 Val_Wu16 65535.00 DFES_OneToOne 0.00 65535.00 FORMAT "%8.2" /end CHARACTERISTIC
/begin CHARACTERISTIC DFES_DTCO.DFC_VSwVlvGovDvtMin_C "/" VALUE 0x800746AA Val_Wu16 65535.00 DFES_OneToOne 0.00 65535.00 FORMAT "%8.2" /end CHARACTERISTIC
/begin CHARACTERISTIC DFES_DTCO.DFC_VSwVlvOL_C "/" VALUE 0x800746AC Val_Wu16 65535.00 DFES_OneToOne 0.00 65535.00 FORMAT "%8.2" /end CHARACTERISTIC
/begin CHARACTERISTIC DFES_DTCO.DFC_VSwVlvSCB_C "/" VALUE 0x800746AE Val_Wu16 65535.00 DFES_OneToOne 0.00 65535.00 FORMAT "%8.2" /end CHARACTERISTIC
/begin CHARACTERISTIC DFES_DTCO.DFC_VSwVlvSCG_C "/" VALUE 0x800746B0 Val_Wu16 65535.00 DFES_OneToOne 0.00 65535.00 FORMAT "%8.2" /end CHARACTERISTIC
/begin CHARACTERISTIC DFES_DTCO.DFC_VSwVlvSRCMax_C "/" VALUE 0x800746B2 Val_Wu16 65535.00 DFES_OneToOne 0.00 65535.00 FORMAT "%8.2" /end CHARACTERISTIC
/begin CHARACTERISTIC DFES_DTCO.DFC_VSwVlvSRCMin_C "/" VALUE 0x800746B4 Val_Wu16 65535.00 DFES_OneToOne 0.00 65535.00 FORMAT "%8.2" /end CHARACTERISTIC
/begin CHARACTERISTIC DFES_DTCO.DFC_VehVHW_C "/" VALUE 0x800746B6 Val_Wu16 65535.00 DFES_OneToOne 0.00 65535.00 FORMAT "%8.2" /end CHARACTERISTIC
/begin CHARACTERISTIC DFES_DTCO.DFC_VehVMax_C "/" VALUE 0x800746B8 Val_Wu16 65535.00 DFES_OneToOne 0.00 65535.00 FORMAT "%8.2" /end CHARACTERISTIC
/begin CHARACTERISTIC DFES_DTCO.DFC_VehVPlaus_C "/" VALUE 0x800746BA Val_Wu16 65535.00 DFES_OneToOne 0.00 65535.00 FORMAT "%8.2" /end CHARACTERISTIC
/begin CHARACTERISTIC DFES_DTCO.DFC_VehVSig_C "/" VALUE 0x800746BC Val_Wu16 65535.00 DFES_OneToOne 0.00 65535.00 FORMAT "%8.2" /end CHARACTERISTIC
/begin CHARACTERISTIC DFES_DTCO.DFC_WaHtElOL_C "/" VALUE 0x800746BE Val_Wu16 65535.00 DFES_OneToOne 0.00 65535.00 FORMAT "%8.2" /end CHARACTERISTIC
/begin CHARACTERISTIC DFES_DTCO.DFC_WaHtElSCB_C "/" VALUE 0x800746C0 Val_Wu16 65535.00 DFES_OneToOne 0.00 65535.00 FORMAT "%8.2" /end CHARACTERISTIC
/begin CHARACTERISTIC DFES_DTCO.DFC_ClthNpl_C "/" VALUE 0x800746C2 Val_Wu16 65535.00 DFES_OneToOne 0.00 65535.00 FORMAT "%8.2" /end CHARACTERISTIC
/begin CHARACTERISTIC DFES_DTCO.DFC_ETClbETMax_0_C "/" VALUE 0x800746C4 Val_Wu16 65535.00 DFES_OneToOne 0.00 65535.00 FORMAT "%8.2" /end CHARACTERISTIC
/begin CHARACTERISTIC DFES_DTCO.DFC_ETClbETMax_1_C "/" VALUE 0x800746C6 Val_Wu16 65535.00 DFES_OneToOne 0.00 65535.00 FORMAT "%8.2" /end CHARACTERISTIC
/begin CHARACTERISTIC DFES_DTCO.DFC_ETClbETMax_2_C "/" VALUE 0x800746C8 Val_Wu16 65535.00 DFES_OneToOne 0.00 65535.00 FORMAT "%8.2" /end CHARACTERISTIC
/begin CHARACTERISTIC DFES_DTCO.DFC_ETClbETMax_3_C "/" VALUE 0x800746CA Val_Wu16 65535.00 DFES_OneToOne 0.00 65535.00 FORMAT "%8.2" /end CHARACTERISTIC
/begin CHARACTERISTIC DFES_DTCO.DFC_ETClbETMax_4_C "/" VALUE 0x800746CC Val_Wu16 65535.00 DFES_OneToOne 0.00 65535.00 FORMAT "%8.2" /end CHARACTERISTIC
/begin CHARACTERISTIC DFES_DTCO.DFC_ETClbETMax_5_C "/" VALUE 0x800746CE Val_Wu16 65535.00 DFES_OneToOne 0.00 65535.00 FORMAT "%8.2" /end CHARACTERISTIC
/begin CHARACTERISTIC DFES_DTCO.DFC_ETClbETMin_0_C "/" VALUE 0x800746D0 Val_Wu16 65535.00 DFES_OneToOne 0.00 65535.00 FORMAT "%8.2" /end CHARACTERISTIC
/begin CHARACTERISTIC DFES_DTCO.DFC_ETClbETMin_1_C "/" VALUE 0x800746D2 Val_Wu16 65535.00 DFES_OneToOne 0.00 65535.00 FORMAT "%8.2" /end CHARACTERISTIC
/begin CHARACTERISTIC DFES_DTCO.DFC_ETClbETMin_2_C "/" VALUE 0x800746D4 Val_Wu16 65535.00 DFES_OneToOne 0.00 65535.00 FORMAT "%8.2" /end CHARACTERISTIC
/begin CHARACTERISTIC DFES_DTCO.DFC_ETClbETMin_3_C "/" VALUE 0x800746D6 Val_Wu16 65535.00 DFES_OneToOne 0.00 65535.00 FORMAT "%8.2" /end CHARACTERISTIC
/begin CHARACTERISTIC DFES_DTCO.DFC_ETClbETMin_4_C "/" VALUE 0x800746D8 Val_Wu16 65535.00 DFES_OneToOne 0.00 65535.00 FORMAT "%8.2" /end CHARACTERISTIC
/begin CHARACTERISTIC DFES_DTCO.DFC_ETClbETMin_5_C "/" VALUE 0x800746DA Val_Wu16 65535.00 DFES_OneToOne 0.00 65535.00 FORMAT "%8.2" /end CHARACTERISTIC
/begin CHARACTERISTIC DFES_DTCO.DFC_IVDiaBnkShCirBSH_0_C "/" VALUE 0x800746DC Val_Wu16 65535.00 DFES_OneToOne 0.00 65535.00 FORMAT "%8.2" /end CHARACTERISTIC
/begin CHARACTERISTIC DFES_DTCO.DFC_IVDiaBnkShCirBSH_1_C "/" VALUE 0x800746DE Val_Wu16 65535.00 DFES_OneToOne 0.00 65535.00 FORMAT "%8.2" /end CHARACTERISTIC
/begin CHARACTERISTIC DFES_DTCO.DFC_IVDiaBnkShCirChSwt_0_C "/" VALUE 0x800746E0 Val_Wu16 65535.00 DFES_OneToOne 0.00 65535.00 FORMAT "%8.2" /end CHARACTERISTIC
/begin CHARACTERISTIC DFES_DTCO.DFC_IVDiaBnkShCirChSwt_1_C "/" VALUE 0x800746E2 Val_Wu16 65535.00 DFES_OneToOne 0.00 65535.00 FORMAT "%8.2" /end CHARACTERISTIC
/begin CHARACTERISTIC DFES_DTCO.DFC_IVDiaBnkShCirHSBatt_0_C "/" VALUE 0x800746E4 Val_Wu16 65535.00 DFES_OneToOne 0.00 65535.00 FORMAT "%8.2" /end CHARACTERISTIC
/begin CHARACTERISTIC DFES_DTCO.DFC_IVDiaBnkShCirHSBatt_1_C "/" VALUE 0x800746E6 Val_Wu16 65535.00 DFES_OneToOne 0.00 65535.00 FORMAT "%8.2" /end CHARACTERISTIC
/begin CHARACTERISTIC DFES_DTCO.DFC_IVDiaBnkShCirHiRstnc_0_C "/" VALUE 0x800746E8 Val_Wu16 65535.00 DFES_OneToOne 0.00 65535.00 FORMAT "%8.2" /end CHARACTERISTIC
/begin CHARACTERISTIC DFES_DTCO.DFC_IVDiaBnkShCirHiRstnc_1_C "/" VALUE 0x800746EA Val_Wu16 65535.00 DFES_OneToOne 0.00 65535.00 FORMAT "%8.2" /end CHARACTERISTIC
/begin CHARACTERISTIC DFES_DTCO.DFC_IVDiaBnkShCirLSHSGnd_0_C "/" VALUE 0x800746EC Val_Wu16 65535.00 DFES_OneToOne 0.00 65535.00 FORMAT "%8.2" /end CHARACTERISTIC
/begin CHARACTERISTIC DFES_DTCO.DFC_IVDiaBnkShCirLSHSGnd_1_C "/" VALUE 0x800746EE Val_Wu16 65535.00 DFES_OneToOne 0.00 65535.00 FORMAT "%8.2" /end CHARACTERISTIC
/begin CHARACTERISTIC DFES_DTCO.DFC_IVDiaBnkShCirTransfer_0_C "/" VALUE 0x800746F0 Val_Wu16 65535.00 DFES_OneToOne 0.00 65535.00 FORMAT "%8.2" /end CHARACTERISTIC
/begin CHARACTERISTIC DFES_DTCO.DFC_IVDiaBnkShCirTransfer_1_C "/" VALUE 0x800746F2 Val_Wu16 65535.00 DFES_OneToOne 0.00 65535.00 FORMAT "%8.2" /end CHARACTERISTIC
/begin CHARACTERISTIC DFES_DTCO.DFC_IVDiaCylNoCls_0_C "/" VALUE 0x800746F4 Val_Wu16 65535.00 DFES_OneToOne 0.00 65535.00 FORMAT "%8.2" /end CHARACTERISTIC
/begin CHARACTERISTIC DFES_DTCO.DFC_IVDiaCylNoCls_1_C "/" VALUE 0x800746F6 Val_Wu16 65535.00 DFES_OneToOne 0.00 65535.00 FORMAT "%8.2" /end CHARACTERISTIC
/begin CHARACTERISTIC DFES_DTCO.DFC_IVDiaCylNoCls_2_C "/" VALUE 0x800746F8 Val_Wu16 65535.00 DFES_OneToOne 0.00 65535.00 FORMAT "%8.2" /end CHARACTERISTIC
/begin CHARACTERISTIC DFES_DTCO.DFC_IVDiaCylNoCls_3_C "/" VALUE 0x800746FA Val_Wu16 65535.00 DFES_OneToOne 0.00 65535.00 FORMAT "%8.2" /end CHARACTERISTIC
/begin CHARACTERISTIC DFES_DTCO.DFC_IVDiaCylNoCls_4_C "/" VALUE 0x800746FC Val_Wu16 65535.00 DFES_OneToOne 0.00 65535.00 FORMAT "%8.2" /end CHARACTERISTIC
/begin CHARACTERISTIC DFES_DTCO.DFC_IVDiaCylNoCls_5_C "/" VALUE 0x800746FE Val_Wu16 65535.00 DFES_OneToOne 0.00 65535.00 FORMAT "%8.2" /end CHARACTERISTIC
/begin CHARACTERISTIC DFES_DTCO.DFC_IVDiaCylNoLd_0_C "/" VALUE 0x80074700 Val_Wu16 65535.00 DFES_OneToOne 0.00 65535.00 FORMAT "%8.2" /end CHARACTERISTIC
/begin CHARACTERISTIC DFES_DTCO.DFC_IVDiaCylNoLd_1_C "/" VALUE 0x80074702 Val_Wu16 65535.00 DFES_OneToOne 0.00 65535.00 FORMAT "%8.2" /end CHARACTERISTIC
/begin CHARACTERISTIC DFES_DTCO.DFC_IVDiaCylNoLd_2_C "/" VALUE 0x80074704 Val_Wu16 65535.00 DFES_OneToOne 0.00 65535.00 FORMAT "%8.2" /end CHARACTERISTIC
/begin CHARACTERISTIC DFES_DTCO.DFC_IVDiaCylNoLd_3_C "/" VALUE 0x80074706 Val_Wu16 65535.00 DFES_OneToOne 0.00 65535.00 FORMAT "%8.2" /end CHARACTERISTIC
/begin CHARACTERISTIC DFES_DTCO.DFC_IVDiaCylNoLd_4_C "/" VALUE 0x80074708 Val_Wu16 65535.00 DFES_OneToOne 0.00 65535.00 FORMAT "%8.2" /end CHARACTERISTIC
/begin CHARACTERISTIC DFES_DTCO.DFC_IVDiaCylNoLd_5_C "/" VALUE 0x8007470A Val_Wu16 65535.00 DFES_OneToOne 0.00 65535.00 FORMAT "%8.2" /end CHARACTERISTIC
/begin CHARACTERISTIC DFES_DTCO.DFC_IVDiaCylShCirHiRstnc_0_C "/" VALUE 0x8007470C Val_Wu16 65535.00 DFES_OneToOne 0.00 65535.00 FORMAT "%8.2" /end CHARACTERISTIC
/begin CHARACTERISTIC DFES_DTCO.DFC_IVDiaCylShCirHiRstnc_1_C "/" VALUE 0x8007470E Val_Wu16 65535.00 DFES_OneToOne 0.00 65535.00 FORMAT "%8.2" /end CHARACTERISTIC
/begin CHARACTERISTIC DFES_DTCO.DFC_IVDiaCylShCirHiRstnc_2_C "/" VALUE 0x80074710 Val_Wu16 65535.00 DFES_OneToOne 0.00 65535.00 FORMAT "%8.2" /end CHARACTERISTIC
/begin CHARACTERISTIC DFES_DTCO.DFC_IVDiaCylShCirHiRstnc_3_C "/" VALUE 0x80074712 Val_Wu16 65535.00 DFES_OneToOne 0.00 65535.00 FORMAT "%8.2" /end CHARACTERISTIC
/begin CHARACTERISTIC DFES_DTCO.DFC_IVDiaCylShCirHiRstnc_4_C "/" VALUE 0x80074714 Val_Wu16 65535.00 DFES_OneToOne 0.00 65535.00 FORMAT "%8.2" /end CHARACTERISTIC
/begin CHARACTERISTIC DFES_DTCO.DFC_IVDiaCylShCirHiRstnc_5_C "/" VALUE 0x80074716 Val_Wu16 65535.00 DFES_OneToOne 0.00 65535.00 FORMAT "%8.2" /end CHARACTERISTIC
/begin CHARACTERISTIC DFES_DTCO.DFC_IVDiaCylShCirLSBatt_0_C "/" VALUE 0x80074718 Val_Wu16 65535.00 DFES_OneToOne 0.00 65535.00 FORMAT "%8.2" /end CHARACTERISTIC
/begin CHARACTERISTIC DFES_DTCO.DFC_IVDiaCylShCirLSBatt_1_C "/" VALUE 0x8007471A Val_Wu16 65535.00 DFES_OneToOne 0.00 65535.00 FORMAT "%8.2" /end CHARACTERISTIC
/begin CHARACTERISTIC DFES_DTCO.DFC_IVDiaCylShCirLSBatt_2_C "/" VALUE 0x8007471C Val_Wu16 65535.00 DFES_OneToOne 0.00 65535.00 FORMAT "%8.2" /end CHARACTERISTIC
/begin CHARACTERISTIC DFES_DTCO.DFC_IVDiaCylShCirLSBatt_3_C "/" VALUE 0x8007471E Val_Wu16 65535.00 DFES_OneToOne 0.00 65535.00 FORMAT "%8.2" /end CHARACTERISTIC
/begin CHARACTERISTIC DFES_DTCO.DFC_IVDiaCylShCirLSBatt_4_C "/" VALUE 0x80074720 Val_Wu16 65535.00 DFES_OneToOne 0.00 65535.00 FORMAT "%8.2" /end CHARACTERISTIC
/begin CHARACTERISTIC DFES_DTCO.DFC_IVDiaCylShCirLSBatt_5_C "/" VALUE 0x80074722 Val_Wu16 65535.00 DFES_OneToOne 0.00 65535.00 FORMAT "%8.2" /end CHARACTERISTIC
/begin CHARACTERISTIC DFES_DTCO.DFC_IVDiaCylShCirLSHS_0_C "/" VALUE 0x80074724 Val_Wu16 65535.00 DFES_OneToOne 0.00 65535.00 FORMAT "%8.2" /end CHARACTERISTIC
/begin CHARACTERISTIC DFES_DTCO.DFC_IVDiaCylShCirLSHS_1_C "/" VALUE 0x80074726 Val_Wu16 65535.00 DFES_OneToOne 0.00 65535.00 FORMAT "%8.2" /end CHARACTERISTIC
/begin CHARACTERISTIC DFES_DTCO.DFC_IVDiaCylShCirLSHS_2_C "/" VALUE 0x80074728 Val_Wu16 65535.00 DFES_OneToOne 0.00 65535.00 FORMAT "%8.2" /end CHARACTERISTIC
/begin CHARACTERISTIC DFES_DTCO.DFC_IVDiaCylShCirLSHS_3_C "/" VALUE 0x8007472A Val_Wu16 65535.00 DFES_OneToOne 0.00 65535.00 FORMAT "%8.2" /end CHARACTERISTIC
/begin CHARACTERISTIC DFES_DTCO.DFC_IVDiaCylShCirLSHS_4_C "/" VALUE 0x8007472C Val_Wu16 65535.00 DFES_OneToOne 0.00 65535.00 FORMAT "%8.2" /end CHARACTERISTIC
/begin CHARACTERISTIC DFES_DTCO.DFC_IVDiaCylShCirLSHS_5_C "/" VALUE 0x8007472E Val_Wu16 65535.00 DFES_OneToOne 0.00 65535.00 FORMAT "%8.2" /end CHARACTERISTIC
/begin CHARACTERISTIC DFES_DTCO.DFC_IVDiaCylShCirLsLs_0_C "/" VALUE 0x80074730 Val_Wu16 65535.00 DFES_OneToOne 0.00 65535.00 FORMAT "%8.2" /end CHARACTERISTIC
/begin CHARACTERISTIC DFES_DTCO.DFC_IVDiaCylShCirLsLs_1_C "/" VALUE 0x80074732 Val_Wu16 65535.00 DFES_OneToOne 0.00 65535.00 FORMAT "%8.2" /end CHARACTERISTIC
/begin CHARACTERISTIC DFES_DTCO.DFC_IVDiaCylShCirLsLs_2_C "/" VALUE 0x80074734 Val_Wu16 65535.00 DFES_OneToOne 0.00 65535.00 FORMAT "%8.2" /end CHARACTERISTIC
/begin CHARACTERISTIC DFES_DTCO.DFC_IVDiaCylShCirLsLs_3_C "/" VALUE 0x80074736 Val_Wu16 65535.00 DFES_OneToOne 0.00 65535.00 FORMAT "%8.2" /end CHARACTERISTIC
/begin CHARACTERISTIC DFES_DTCO.DFC_IVDiaCylShCirLsLs_4_C "/" VALUE 0x80074738 Val_Wu16 65535.00 DFES_OneToOne 0.00 65535.00 FORMAT "%8.2" /end CHARACTERISTIC
/begin CHARACTERISTIC DFES_DTCO.DFC_IVDiaCylShCirLsLs_5_C "/" VALUE 0x8007473A Val_Wu16 65535.00 DFES_OneToOne 0.00 65535.00 FORMAT "%8.2" /end CHARACTERISTIC
/begin CHARACTERISTIC DFES_DTCO.DFC_IVDiaSPICfg_C "/" VALUE 0x8007473C Val_Wu16 65535.00 DFES_OneToOne 0.00 65535.00 FORMAT "%8.2" /end CHARACTERISTIC
/begin CHARACTERISTIC DFES_DTCO.DFC_IVDiaSPIColl_C "/" VALUE 0x8007473E Val_Wu16 65535.00 DFES_OneToOne 0.00 65535.00 FORMAT "%8.2" /end CHARACTERISTIC
/begin CHARACTERISTIC DFES_DTCO.DFC_IVDiaSPICtrl_C "/" VALUE 0x80074740 Val_Wu16 65535.00 DFES_OneToOne 0.00 65535.00 FORMAT "%8.2" /end CHARACTERISTIC
/begin CHARACTERISTIC DFES_DTCO.DFC_IVDiaSPIRam_C "/" VALUE 0x80074742 Val_Wu16 65535.00 DFES_OneToOne 0.00 65535.00 FORMAT "%8.2" /end CHARACTERISTIC
/begin CHARACTERISTIC DFES_DTCO.DFC_IVDiaSPITrans_C "/" VALUE 0x80074744 Val_Wu16 65535.00 DFES_OneToOne 0.00 65535.00 FORMAT "%8.2" /end CHARACTERISTIC
/begin CHARACTERISTIC DFES_DTCO.DFC_LSUCmpChk_0_C "/" VALUE 0x80074746 Val_Wu16 65535.00 DFES_OneToOne 0.00 65535.00 FORMAT "%8.2" /end CHARACTERISTIC
/begin CHARACTERISTIC DFES_DTCO.DFC_LSUCmpChk_1_C "/" VALUE 0x80074748 Val_Wu16 65535.00 DFES_OneToOne 0.00 65535.00 FORMAT "%8.2" /end CHARACTERISTIC
/begin CHARACTERISTIC DFES_DTCO.DFC_LSUCmpChk_2_C "/" VALUE 0x8007474A Val_Wu16 65535.00 DFES_OneToOne 0.00 65535.00 FORMAT "%8.2" /end CHARACTERISTIC
/begin CHARACTERISTIC DFES_DTCO.DFC_LSUCmpChk_3_C "/" VALUE 0x8007474C Val_Wu16 65535.00 DFES_OneToOne 0.00 65535.00 FORMAT "%8.2" /end CHARACTERISTIC
/begin CHARACTERISTIC DFES_DTCO.DFC_LSUCmpChk_4_C "/" VALUE 0x8007474E Val_Wu16 65535.00 DFES_OneToOne 0.00 65535.00 FORMAT "%8.2" /end CHARACTERISTIC
/begin CHARACTERISTIC DFES_DTCO.DFC_LSUCmpChk_5_C "/" VALUE 0x80074750 Val_Wu16 65535.00 DFES_OneToOne 0.00 65535.00 FORMAT "%8.2" /end CHARACTERISTIC
/begin CHARACTERISTIC DFES_DTCO.DFC_LSUDynChk_0_C "/" VALUE 0x80074752 Val_Wu16 65535.00 DFES_OneToOne 0.00 65535.00 FORMAT "%8.2" /end CHARACTERISTIC
/begin CHARACTERISTIC DFES_DTCO.DFC_LSUDynChk_1_C "/" VALUE 0x80074754 Val_Wu16 65535.00 DFES_OneToOne 0.00 65535.00 FORMAT "%8.2" /end CHARACTERISTIC
/begin CHARACTERISTIC DFES_DTCO.DFC_LSUDynChk_2_C "/" VALUE 0x80074756 Val_Wu16 65535.00 DFES_OneToOne 0.00 65535.00 FORMAT "%8.2" /end CHARACTERISTIC
/begin CHARACTERISTIC DFES_DTCO.DFC_LSUDynChk_3_C "/" VALUE 0x80074758 Val_Wu16 65535.00 DFES_OneToOne 0.00 65535.00 FORMAT "%8.2" /end CHARACTERISTIC
/begin CHARACTERISTIC DFES_DTCO.DFC_LSUO2ClbMax_0_C "/" VALUE 0x8007475A Val_Wu16 65535.00 DFES_OneToOne 0.00 65535.00 FORMAT "%8.2" /end CHARACTERISTIC
/begin CHARACTERISTIC DFES_DTCO.DFC_LSUO2ClbMax_1_C "/" VALUE 0x8007475C Val_Wu16 65535.00 DFES_OneToOne 0.00 65535.00 FORMAT "%8.2" /end CHARACTERISTIC
/begin CHARACTERISTIC DFES_DTCO.DFC_LSUO2ClbMax_2_C "/" VALUE 0x8007475E Val_Wu16 65535.00 DFES_OneToOne 0.00 65535.00 FORMAT "%8.2" /end CHARACTERISTIC
/begin CHARACTERISTIC DFES_DTCO.DFC_LSUO2ClbMax_3_C "/" VALUE 0x80074760 Val_Wu16 65535.00 DFES_OneToOne 0.00 65535.00 FORMAT "%8.2" /end CHARACTERISTIC
/begin CHARACTERISTIC DFES_DTCO.DFC_LSUO2ClbMin_0_C "/" VALUE 0x80074762 Val_Wu16 65535.00 DFES_OneToOne 0.00 65535.00 FORMAT "%8.2" /end CHARACTERISTIC
/begin CHARACTERISTIC DFES_DTCO.DFC_LSUO2ClbMin_1_C "/" VALUE 0x80074764 Val_Wu16 65535.00 DFES_OneToOne 0.00 65535.00 FORMAT "%8.2" /end CHARACTERISTIC
/begin CHARACTERISTIC DFES_DTCO.DFC_LSUO2ClbMin_2_C "/" VALUE 0x80074766 Val_Wu16 65535.00 DFES_OneToOne 0.00 65535.00 FORMAT "%8.2" /end CHARACTERISTIC
/begin CHARACTERISTIC DFES_DTCO.DFC_LSUO2ClbMin_3_C "/" VALUE 0x80074768 Val_Wu16 65535.00 DFES_OneToOne 0.00 65535.00 FORMAT "%8.2" /end CHARACTERISTIC
/begin CHARACTERISTIC DFES_DTCO.DFC_LSUO2PlausMax_0_C "/" VALUE 0x8007476A Val_Wu16 65535.00 DFES_OneToOne 0.00 65535.00 FORMAT "%8.2" /end CHARACTERISTIC
/begin CHARACTERISTIC DFES_DTCO.DFC_LSUO2PlausMax_1_C "/" VALUE 0x8007476C Val_Wu16 65535.00 DFES_OneToOne 0.00 65535.00 FORMAT "%8.2" /end CHARACTERISTIC
/begin CHARACTERISTIC DFES_DTCO.DFC_LSUO2PlausMax_2_C "/" VALUE 0x8007476E Val_Wu16 65535.00 DFES_OneToOne 0.00 65535.00 FORMAT "%8.2" /end CHARACTERISTIC
/begin CHARACTERISTIC DFES_DTCO.DFC_LSUO2PlausMax_3_C "/" VALUE 0x80074770 Val_Wu16 65535.00 DFES_OneToOne 0.00 65535.00 FORMAT "%8.2" /end CHARACTERISTIC
/begin CHARACTERISTIC DFES_DTCO.DFC_LSUO2PlausMin_0_C "/" VALUE 0x80074772 Val_Wu16 65535.00 DFES_OneToOne 0.00 65535.00 FORMAT "%8.2" /end CHARACTERISTIC
/begin CHARACTERISTIC DFES_DTCO.DFC_LSUO2PlausMin_1_C "/" VALUE 0x80074774 Val_Wu16 65535.00 DFES_OneToOne 0.00 65535.00 FORMAT "%8.2" /end CHARACTERISTIC
/begin CHARACTERISTIC DFES_DTCO.DFC_LSUO2PlausMin_2_C "/" VALUE 0x80074776 Val_Wu16 65535.00 DFES_OneToOne 0.00 65535.00 FORMAT "%8.2" /end CHARACTERISTIC
/begin CHARACTERISTIC DFES_DTCO.DFC_LSUO2PlausMin_3_C "/" VALUE 0x80074778 Val_Wu16 65535.00 DFES_OneToOne 0.00 65535.00 FORMAT "%8.2" /end CHARACTERISTIC
/begin CHARACTERISTIC DFES_DTCO.DFC_LSURiClbMax_0_C "/" VALUE 0x8007477A Val_Wu16 65535.00 DFES_OneToOne 0.00 65535.00 FORMAT "%8.2" /end CHARACTERISTIC
/begin CHARACTERISTIC DFES_DTCO.DFC_LSURiClbMax_1_C "/" VALUE 0x8007477C Val_Wu16 65535.00 DFES_OneToOne 0.00 65535.00 FORMAT "%8.2" /end CHARACTERISTIC
/begin CHARACTERISTIC DFES_DTCO.DFC_LSURiClbMax_2_C "/" VALUE 0x8007477E Val_Wu16 65535.00 DFES_OneToOne 0.00 65535.00 FORMAT "%8.2" /end CHARACTERISTIC
/begin CHARACTERISTIC DFES_DTCO.DFC_LSURiClbMax_3_C "/" VALUE 0x80074780 Val_Wu16 65535.00 DFES_OneToOne 0.00 65535.00 FORMAT "%8.2" /end CHARACTERISTIC
/begin CHARACTERISTIC DFES_DTCO.DFC_LSURiClbMin_0_C "/" VALUE 0x80074782 Val_Wu16 65535.00 DFES_OneToOne 0.00 65535.00 FORMAT "%8.2" /end CHARACTERISTIC
/begin CHARACTERISTIC DFES_DTCO.DFC_LSURiClbMin_1_C "/" VALUE 0x80074784 Val_Wu16 65535.00 DFES_OneToOne 0.00 65535.00 FORMAT "%8.2" /end CHARACTERISTIC
/begin CHARACTERISTIC DFES_DTCO.DFC_LSURiClbMin_2_C "/" VALUE 0x80074786 Val_Wu16 65535.00 DFES_OneToOne 0.00 65535.00 FORMAT "%8.2" /end CHARACTERISTIC
/begin CHARACTERISTIC DFES_DTCO.DFC_LSURiClbMin_3_C "/" VALUE 0x80074788 Val_Wu16 65535.00 DFES_OneToOne 0.00 65535.00 FORMAT "%8.2" /end CHARACTERISTIC
/begin CHARACTERISTIC DFES_DTCO.DFC_LSUWireIPSig_0_C "/" VALUE 0x8007478A Val_Wu16 65535.00 DFES_OneToOne 0.00 65535.00 FORMAT "%8.2" /end CHARACTERISTIC
/begin CHARACTERISTIC DFES_DTCO.DFC_LSUWireIPSig_1_C "/" VALUE 0x8007478C Val_Wu16 65535.00 DFES_OneToOne 0.00 65535.00 FORMAT "%8.2" /end CHARACTERISTIC
/begin CHARACTERISTIC DFES_DTCO.DFC_LSUWireIPSig_2_C "/" VALUE 0x8007478E Val_Wu16 65535.00 DFES_OneToOne 0.00 65535.00 FORMAT "%8.2" /end CHARACTERISTIC
/begin CHARACTERISTIC DFES_DTCO.DFC_LSUWireIPSig_3_C "/" VALUE 0x80074790 Val_Wu16 65535.00 DFES_OneToOne 0.00 65535.00 FORMAT "%8.2" /end CHARACTERISTIC
/begin CHARACTERISTIC DFES_DTCO.DFC_AFSDrftIdlAdjVal_C "/" VALUE 0x80074792 Val_Wu16 65535.00 DFES_OneToOne 0.00 65535.00 FORMAT "%8.2" /end CHARACTERISTIC
/begin CHARACTERISTIC DFES_DTCO.DFC_AFSDrftLdAdjVal_C "/" VALUE 0x80074794 Val_Wu16 65535.00 DFES_OneToOne 0.00 65535.00 FORMAT "%8.2" /end CHARACTERISTIC
/begin CHARACTERISTIC DFES_DTCO.DFC_AdcI_ADC0_Cal_C "/" VALUE 0x80074796 Val_Wu16 65535.00 DFES_OneToOne 0.00 65535.00 FORMAT "%8.2" /end CHARACTERISTIC
/begin CHARACTERISTIC DFES_DTCO.DFC_AdcI_ADC0_Conv_C "/" VALUE 0x80074798 Val_Wu16 65535.00 DFES_OneToOne 0.00 65535.00 FORMAT "%8.2" /end CHARACTERISTIC
/begin CHARACTERISTIC DFES_DTCO.DFC_CmbChbMisfireMax_0_C "/" VALUE 0x8007479A Val_Wu16 65535.00 DFES_OneToOne 0.00 65535.00 FORMAT "%8.2" /end CHARACTERISTIC
/begin CHARACTERISTIC DFES_DTCO.DFC_CmbChbMisfireMax_1_C "/" VALUE 0x8007479C Val_Wu16 65535.00 DFES_OneToOne 0.00 65535.00 FORMAT "%8.2" /end CHARACTERISTIC
/begin CHARACTERISTIC DFES_DTCO.DFC_CmbChbMisfireMax_2_C "/" VALUE 0x8007479E Val_Wu16 65535.00 DFES_OneToOne 0.00 65535.00 FORMAT "%8.2" /end CHARACTERISTIC
/begin CHARACTERISTIC DFES_DTCO.DFC_CmbChbMisfireMax_3_C "/" VALUE 0x800747A0 Val_Wu16 65535.00 DFES_OneToOne 0.00 65535.00 FORMAT "%8.2" /end CHARACTERISTIC
/begin CHARACTERISTIC DFES_DTCO.DFC_CmbChbMisfireMax_4_C "/" VALUE 0x800747A2 Val_Wu16 65535.00 DFES_OneToOne 0.00 65535.00 FORMAT "%8.2" /end CHARACTERISTIC
/begin CHARACTERISTIC DFES_DTCO.DFC_CmbChbMisfireMax_5_C "/" VALUE 0x800747A4 Val_Wu16 65535.00 DFES_OneToOne 0.00 65535.00 FORMAT "%8.2" /end CHARACTERISTIC
/begin CHARACTERISTIC DFES_DTCO.DFC_CmbChbMisfireMul_C "/" VALUE 0x800747A6 Val_Wu16 65535.00 DFES_OneToOne 0.00 65535.00 FORMAT "%8.2" /end CHARACTERISTIC
/begin CHARACTERISTIC DFES_DTCO.DFC_INJVLVBUSY_C "/" VALUE 0x800747A8 Val_Wu16 65535.00 DFES_OneToOne 0.00 65535.00 FORMAT "%8.2" /end CHARACTERISTIC
/begin CHARACTERISTIC DFES_DTCO.DFC_IVAdjIVA_0_C "/" VALUE 0x800747AA Val_Wu16 65535.00 DFES_OneToOne 0.00 65535.00 FORMAT "%8.2" /end CHARACTERISTIC
/begin CHARACTERISTIC DFES_DTCO.DFC_IVAdjIVA_1_C "/" VALUE 0x800747AC Val_Wu16 65535.00 DFES_OneToOne 0.00 65535.00 FORMAT "%8.2" /end CHARACTERISTIC
/begin CHARACTERISTIC DFES_DTCO.DFC_IVAdjIVA_2_C "/" VALUE 0x800747AE Val_Wu16 65535.00 DFES_OneToOne 0.00 65535.00 FORMAT "%8.2" /end CHARACTERISTIC
/begin CHARACTERISTIC DFES_DTCO.DFC_IVAdjIVA_3_C "/" VALUE 0x800747B0 Val_Wu16 65535.00 DFES_OneToOne 0.00 65535.00 FORMAT "%8.2" /end CHARACTERISTIC
/begin CHARACTERISTIC DFES_DTCO.DFC_IVAdjIVA_4_C "/" VALUE 0x800747B2 Val_Wu16 65535.00 DFES_OneToOne 0.00 65535.00 FORMAT "%8.2" /end CHARACTERISTIC
/begin CHARACTERISTIC DFES_DTCO.DFC_IVAdjIVA_5_C "/" VALUE 0x800747B4 Val_Wu16 65535.00 DFES_OneToOne 0.00 65535.00 FORMAT "%8.2" /end CHARACTERISTIC
/begin CHARACTERISTIC DFES_DTCO.DFC_InjCtlAdjQntEEPCS_C "/" VALUE 0x800747B6 Val_Wu16 65535.00 DFES_OneToOne 0.00 65535.00 FORMAT "%8.2" /end CHARACTERISTIC
/begin CHARACTERISTIC DFES_DTCO.DFC_InjCtlDriftEEPCS_C "/" VALUE 0x800747B8 Val_Wu16 65535.00 DFES_OneToOne 0.00 65535.00 FORMAT "%8.2" /end CHARACTERISTIC
/begin CHARACTERISTIC DFES_DTCO.DFC_MRlyErlyOpng_C "/" VALUE 0x800747BA Val_Wu16 65535.00 DFES_OneToOne 0.00 65535.00 FORMAT "%8.2" /end CHARACTERISTIC
/begin CHARACTERISTIC DFES_DTCO.DFC_MRlyStk_C "/" VALUE 0x800747BC Val_Wu16 65535.00 DFES_OneToOne 0.00 65535.00 FORMAT "%8.2" /end CHARACTERISTIC
/begin CHARACTERISTIC DFES_DTCO.DFC_SensFrzPPFltUs_C "/" VALUE 0x800747BE Val_Wu16 65535.00 DFES_OneToOne 0.00 65535.00 FORMAT "%8.2" /end CHARACTERISTIC
/begin CHARACTERISTIC DFES_DTCO.DFC_T15Sig_C "/" VALUE 0x800747C0 Val_Wu16 65535.00 DFES_OneToOne 0.00 65535.00 FORMAT "%8.2" /end CHARACTERISTIC
/begin CHARACTERISTIC DFES_DTCO.DFC_AirCtlRmpTOut_C "/" VALUE 0x800747C2 Val_Wu16 65535.00 DFES_OneToOne 0.00 65535.00 FORMAT "%8.2" /end CHARACTERISTIC
/begin CHARACTERISTIC DFES_DTCO.DFC_CEngDsTDynTst_C "/" VALUE 0x800747C4 Val_Wu16 65535.00 DFES_OneToOne 0.00 65535.00 FORMAT "%8.2" /end CHARACTERISTIC
/begin CHARACTERISTIC DFES_DTCO.DFC_EGRVlvJamVlvClsd_C "/" VALUE 0x800747C6 Val_Wu16 65535.00 DFES_OneToOne 0.00 65535.00 FORMAT "%8.2" /end CHARACTERISTIC
/begin CHARACTERISTIC DFES_DTCO.DFC_EGRVlvJamVlvOpn_C "/" VALUE 0x800747C8 Val_Wu16 65535.00 DFES_OneToOne 0.00 65535.00 FORMAT "%8.2" /end CHARACTERISTIC
/begin CHARACTERISTIC DFES_DTCO.DFC_EGRVlvLgTDrft_C "/" VALUE 0x800747CA Val_Wu16 65535.00 DFES_OneToOne 0.00 65535.00 FORMAT "%8.2" /end CHARACTERISTIC
/begin CHARACTERISTIC DFES_DTCO.DFC_EGRVlvOfsLrnJamVlv_C "/" VALUE 0x800747CC Val_Wu16 65535.00 DFES_OneToOne 0.00 65535.00 FORMAT "%8.2" /end CHARACTERISTIC
/begin CHARACTERISTIC DFES_DTCO.DFC_EGRVlvShTDrft_C "/" VALUE 0x800747CE Val_Wu16 65535.00 DFES_OneToOne 0.00 65535.00 FORMAT "%8.2" /end CHARACTERISTIC
/begin CHARACTERISTIC DFES_DTCO.DFC_EGTRgnOilDilMax_C "/" VALUE 0x800747D0 Val_Wu16 65535.00 DFES_OneToOne 0.00 65535.00 FORMAT "%8.2" /end CHARACTERISTIC
/begin CHARACTERISTIC DFES_DTCO.DFC_EngICO_C "/" VALUE 0x800747D2 Val_Wu16 65535.00 DFES_OneToOne 0.00 65535.00 FORMAT "%8.2" /end CHARACTERISTIC
/begin CHARACTERISTIC DFES_DTCO.DFC_EpmCaSI1ErrSig_C "/" VALUE 0x800747D4 Val_Wu16 65535.00 DFES_OneToOne 0.00 65535.00 FORMAT "%8.2" /end CHARACTERISTIC
/begin CHARACTERISTIC DFES_DTCO.DFC_EpmCaSI1NoSig_C "/" VALUE 0x800747D6 Val_Wu16 65535.00 DFES_OneToOne 0.00 65535.00 FORMAT "%8.2" /end CHARACTERISTIC
/begin CHARACTERISTIC DFES_DTCO.DFC_EpmCaSI1OfsErr_C "/" VALUE 0x800747D8 Val_Wu16 65535.00 DFES_OneToOne 0.00 65535.00 FORMAT "%8.2" /end CHARACTERISTIC
/begin CHARACTERISTIC DFES_DTCO.DFC_EpmCrSErrSig_C "/" VALUE 0x800747DA Val_Wu16 65535.00 DFES_OneToOne 0.00 65535.00 FORMAT "%8.2" /end CHARACTERISTIC
/begin CHARACTERISTIC DFES_DTCO.DFC_EpmCrSNoSig_C "/" VALUE 0x800747DC Val_Wu16 65535.00 DFES_OneToOne 0.00 65535.00 FORMAT "%8.2" /end CHARACTERISTIC
/begin CHARACTERISTIC DFES_DTCO.DFC_MoCADCCmp_C "/" VALUE 0x800747DE Val_Wu16 65535.00 DFES_OneToOne 0.00 65535.00 FORMAT "%8.2" /end CHARACTERISTIC
/begin CHARACTERISTIC DFES_DTCO.DFC_MoCADCTst_C "/" VALUE 0x800747E0 Val_Wu16 65535.00 DFES_OneToOne 0.00 65535.00 FORMAT "%8.2" /end CHARACTERISTIC
/begin CHARACTERISTIC DFES_DTCO.DFC_MoCADCVltgRatio_C "/" VALUE 0x800747E2 Val_Wu16 65535.00 DFES_OneToOne 0.00 65535.00 FORMAT "%8.2" /end CHARACTERISTIC
/begin CHARACTERISTIC DFES_DTCO.DFC_MoCSOPLoLi_C "/" VALUE 0x800747E4 Val_Wu16 65535.00 DFES_OneToOne 0.00 65535.00 FORMAT "%8.2" /end CHARACTERISTIC
/begin CHARACTERISTIC DFES_DTCO.DFC_MoCSOPMM_C "/" VALUE 0x800747E6 Val_Wu16 65535.00 DFES_OneToOne 0.00 65535.00 FORMAT "%8.2" /end CHARACTERISTIC
/begin CHARACTERISTIC DFES_DTCO.DFC_MoCSOPTimeOut_C "/" VALUE 0x800747E8 Val_Wu16 65535.00 DFES_OneToOne 0.00 65535.00 FORMAT "%8.2" /end CHARACTERISTIC
/begin CHARACTERISTIC DFES_DTCO.DFC_MoCSOPUpLi_C "/" VALUE 0x800747EA Val_Wu16 65535.00 DFES_OneToOne 0.00 65535.00 FORMAT "%8.2" /end CHARACTERISTIC
/begin CHARACTERISTIC DFES_DTCO.DFC_MoFAPP_C "/" VALUE 0x800747EC Val_Wu16 65535.00 DFES_OneToOne 0.00 65535.00 FORMAT "%8.2" /end CHARACTERISTIC
/begin CHARACTERISTIC DFES_DTCO.DFC_MoFESpd_C "/" VALUE 0x800747EE Val_Wu16 65535.00 DFES_OneToOne 0.00 65535.00 FORMAT "%8.2" /end CHARACTERISTIC
/begin CHARACTERISTIC DFES_DTCO.DFC_MoFInjDatPhi_C "/" VALUE 0x800747F0 Val_Wu16 65535.00 DFES_OneToOne 0.00 65535.00 FORMAT "%8.2" /end CHARACTERISTIC
/begin CHARACTERISTIC DFES_DTCO.DFC_MoFInjDatQnt_C "/" VALUE 0x800747F2 Val_Wu16 65535.00 DFES_OneToOne 0.00 65535.00 FORMAT "%8.2" /end CHARACTERISTIC
/begin CHARACTERISTIC DFES_DTCO.DFC_MoFInjQnt_C "/" VALUE 0x800747F4 Val_Wu16 65535.00 DFES_OneToOne 0.00 65535.00 FORMAT "%8.2" /end CHARACTERISTIC
/begin CHARACTERISTIC DFES_DTCO.DFC_MoFOvR_C "/" VALUE 0x800747F6 Val_Wu16 65535.00 DFES_OneToOne 0.00 65535.00 FORMAT "%8.2" /end CHARACTERISTIC
/begin CHARACTERISTIC DFES_DTCO.DFC_MoFQntCor_C "/" VALUE 0x800747F8 Val_Wu16 65535.00 DFES_OneToOne 0.00 65535.00 FORMAT "%8.2" /end CHARACTERISTIC
/begin CHARACTERISTIC DFES_DTCO.DFC_MoFTrqCmp_C "/" VALUE 0x800747FA Val_Wu16 65535.00 DFES_OneToOne 0.00 65535.00 FORMAT "%8.2" /end CHARACTERISTIC
/begin CHARACTERISTIC DFES_DTCO.DFC_NplTOxiCatUs_C "/" VALUE 0x800747FC Val_Wu16 65535.00 DFES_OneToOne 0.00 65535.00 FORMAT "%8.2" /end CHARACTERISTIC
/begin CHARACTERISTIC DFES_DTCO.DFC_PhyModNonMonMapNpl_C "/" VALUE 0x800747FE Val_Wu16 65535.00 DFES_OneToOne 0.00 65535.00 FORMAT "%8.2" /end CHARACTERISTIC
/begin CHARACTERISTIC DFES_DTCO.DFC_RailPOfsTstMax_C "/" VALUE 0x80074800 Val_Wu16 65535.00 DFES_OneToOne 0.00 65535.00 FORMAT "%8.2" /end CHARACTERISTIC
/begin CHARACTERISTIC DFES_DTCO.DFC_RailPOfsTstMin_C "/" VALUE 0x80074802 Val_Wu16 65535.00 DFES_OneToOne 0.00 65535.00 FORMAT "%8.2" /end CHARACTERISTIC
/begin CHARACTERISTIC DFES_DTCO.DFC_SWReset_0_C "/" VALUE 0x80074804 Val_Wu16 65535.00 DFES_OneToOne 0.00 65535.00 FORMAT "%8.2" /end CHARACTERISTIC
/begin CHARACTERISTIC DFES_DTCO.DFC_SWReset_1_C "/" VALUE 0x80074806 Val_Wu16 65535.00 DFES_OneToOne 0.00 65535.00 FORMAT "%8.2" /end CHARACTERISTIC
/begin CHARACTERISTIC DFES_DTCO.DFC_SWReset_2_C "/" VALUE 0x80074808 Val_Wu16 65535.00 DFES_OneToOne 0.00 65535.00 FORMAT "%8.2" /end CHARACTERISTIC
/begin CHARACTERISTIC DFES_DTCO.DFC_VSwVlvJamVlv_C "/" VALUE 0x8007480A Val_Wu16 65535.00 DFES_OneToOne 0.00 65535.00 FORMAT "%8.2" /end CHARACTERISTIC
/begin CHARACTERISTIC DFES_DTCO.DFC_VSwVlvLgTDrft_C "/" VALUE 0x8007480C Val_Wu16 65535.00 DFES_OneToOne 0.00 65535.00 FORMAT "%8.2" /end CHARACTERISTIC
/begin CHARACTERISTIC DFES_DTCO.DFC_VSwVlvOfsLrnJamVlv_C "/" VALUE 0x8007480E Val_Wu16 65535.00 DFES_OneToOne 0.00 65535.00 FORMAT "%8.2" /end CHARACTERISTIC
/begin CHARACTERISTIC DFES_DTCO.DFC_VSwVlvShTDrft_C "/" VALUE 0x80074810 Val_Wu16 65535.00 DFES_OneToOne 0.00 65535.00 FORMAT "%8.2" /end CHARACTERISTIC
/begin FUNCTION dfes_dtc_obd_auto ""
 /begin DEF_CHARACTERISTIC DFES_DTCO.DFC_AirCtlGovDvtEOMMax_C DFES_DTCO.DFC_AirCtlGovDvtEOMMin_C DFES_DTCO.DFC_AirCtlGovDvtMax_C DFES_DTCO.DFC_AirCtlGovDvtMin_C DFES_DTCO.DFC_Cj945SpiCom1_C DFES_DTCO.DFC_ComButtonMSASig_C DFES_DTCO.DFC_ComButtonMSATo_C DFES_DTCO.DFC_ComGearboxData2Sig_C DFES_DTCO.DFC_ComGearboxData2To_C DFES_DTCO.DFC_ComGearboxDataSig_C DFES_DTCO.DFC_ComGearboxDataTo_C DFES_DTCO.DFC_ComHeatACSig_C DFES_DTCO.DFC_ComHeatACTo_C DFES_DTCO.DFC_ComLenkradwinkelSig_C DFES_DTCO.DFC_ComLenkradwinkelTo_C DFES_DTCO.DFC_ComMileageRangeSig_C DFES_DTCO.DFC_ComMileageRangeTo_C DFES_DTCO.DFC_ComPspSig_C DFES_DTCO.DFC_ComPspTo_C DFES_DTCO.DFC_ComShutOffPSPSig_C DFES_DTCO.DFC_ComShutOffPSPTo_C DFES_DTCO.DFC_ComStKombiCtr_C DFES_DTCO.DFC_ComStKombiSig_C DFES_DTCO.DFC_ComStKombiTo_C DFES_DTCO.DFC_ComStateARSCtr_C DFES_DTCO.DFC_ComStateARSSig_C DFES_DTCO.DFC_ComStateARSTo_C DFES_DTCO.DFC_ComStateDscSig_C DFES_DTCO.DFC_ComStateDscTo_C DFES_DTCO.DFC_ComStateSeatSig_C DFES_DTCO.DFC_ComStateSeatTo_C DFES_DTCO.DFC_ComTempRelTimeSig_C DFES_DTCO.DFC_ComTempRelTimeTo_C DFES_DTCO.DFC_ComTerminalChk_C DFES_DTCO.DFC_ComTerminalCtr_C DFES_DTCO.DFC_ComTerminalSig_C DFES_DTCO.DFC_ComTerminalTo_C DFES_DTCO.DFC_ComTimeDateSig_C DFES_DTCO.DFC_ComTimeDateTo_C DFES_DTCO.DFC_ComTrailerSig_C DFES_DTCO.DFC_ComTrailerTo_C DFES_DTCO.DFC_ComTrqDemandAfsChk_C DFES_DTCO.DFC_ComTrqDemandAfsCtr_C DFES_DTCO.DFC_ComTrqDemandAfsSig_C DFES_DTCO.DFC_ComTrqDemandAfsTo_C DFES_DTCO.DFC_ComTrqDemandDscChk_C DFES_DTCO.DFC_ComTrqDemandDscCtr_C DFES_DTCO.DFC_ComTrqDemandDscSig_C DFES_DTCO.DFC_ComTrqDemandDscTo_C DFES_DTCO.DFC_ComTrqDemandGbxChk_C DFES_DTCO.DFC_ComTrqDemandGbxCtr_C DFES_DTCO.DFC_ComTrqDemandGbxSig_C DFES_DTCO.DFC_ComTrqDemandGbxTo_C DFES_DTCO.DFC_ComVelocitySig_C DFES_DTCO.DFC_ComVelocityTo_C DFES_DTCO.DFC_ComWheelSpeedSig_C DFES_DTCO.DFC_ComWheelSpeedTo_C DFES_DTCO.DFC_ComZvKlappenSig_C DFES_DTCO.DFC_ComZvKlappenTo_C DFES_DTCO.DFC_Cy150SpiCom_C DFES_DTCO.DFC_Cy320SpiCom_C DFES_DTCO.DFC_ETCtlDvtInrMax_C DFES_DTCO.DFC_ETCtlDvtInrMin_C DFES_DTCO.DFC_ETCtlDvtOutrMax_C DFES_DTCO.DFC_ETCtlDvtOutrMin_C DFES_DTCO.DFC_Fan4WinErr1_C DFES_DTCO.DFC_Fan4WinErr2_C DFES_DTCO.DFC_Fan4WinErr3_C DFES_DTCO.DFC_Fan4WinErr4_C DFES_DTCO.DFC_FanSCG_C DFES_DTCO.DFC_PCRGovDvtLPMax_C DFES_DTCO.DFC_PCRGovDvtLPMin_C DFES_DTCO.DFC_PCRGovDvtMax_C DFES_DTCO.DFC_PCRGovDvtMin_C DFES_DTCO.DFC_RailCPC1_C DFES_DTCO.DFC_RailCPC3_C DFES_DTCO.DFC_RailCPC4_C DFES_DTCO.DFC_RailMeUn0_C DFES_DTCO.DFC_RailMeUn1_C DFES_DTCO.DFC_RailMeUn2_C DFES_DTCO.DFC_RailMeUn3_C DFES_DTCO.DFC_RailMeUn4_C DFES_DTCO.DFC_RailPCV0_C DFES_DTCO.DFC_RailPCV1_C DFES_DTCO.DFC_RailPCV2_C DFES_DTCO.DFC_RailPCV3_C DFES_DTCO.DFC_RailPCV4_C DFES_DTCO.DFC_RailPMonStrt_C DFES_DTCO.DFC_SSpMon1_C DFES_DTCO.DFC_SSpMon2_C DFES_DTCO.DFC_SSpMon3_C DFES_DTCO.DFC_Sia_E1_C DFES_DTCO.DFC_Sia_E10_C DFES_DTCO.DFC_Sia_E11_C DFES_DTCO.DFC_Sia_E12_C DFES_DTCO.DFC_Sia_E13_C DFES_DTCO.DFC_Sia_E14_C DFES_DTCO.DFC_Sia_E15_C DFES_DTCO.DFC_Sia_E2_C DFES_DTCO.DFC_Sia_E3_C DFES_DTCO.DFC_Sia_E4_C DFES_DTCO.DFC_Sia_E5_C DFES_DTCO.DFC_Sia_E6_C DFES_DTCO.DFC_Sia_E7_C DFES_DTCO.DFC_Sia_E8_C DFES_DTCO.DFC_Sia_E9_C DFES_DTCO.DFC_ThrVlv4WinErr1_C DFES_DTCO.DFC_ThrVlv4WinErr2_C DFES_DTCO.DFC_ThrVlv4WinErr3_C DFES_DTCO.DFC_ThrVlv4WinErr4_C DFES_DTCO.DFC_ThrVlvSCG_C DFES_DTCO.DFC_TrbCh4WinErr1_C DFES_DTCO.DFC_TrbCh4WinErr2_C DFES_DTCO.DFC_TrbCh4WinErr3_C DFES_DTCO.DFC_TrbCh4WinErr4_C DFES_DTCO.DFC_TrbChSCG_C DFES_DTCO.DFC_TrbChSRCMax_C DFES_DTCO.DFC_TrbChSRCMin_C DFES_DTCO.DFC_WaHtEl4WinErr1_C DFES_DTCO.DFC_WaHtEl4WinErr2_C DFES_DTCO.DFC_WaHtEl4WinErr3_C DFES_DTCO.DFC_WaHtEl4WinErr4_C DFES_DTCO.DFC_WaHtElSCG_C DFES_DTCO.DFC_ETClbETFltMax_C DFES_DTCO.DFC_ETClbETFltMin_C DFES_DTCO.DFC_InjCrvInjLimChrgBal_C DFES_DTCO.DFC_InjCrvInjLimQntBal_C DFES_DTCO.DFC_InjCrvInjLimSys_C DFES_DTCO.DFC_InjCrvNumInjRtmLim_C DFES_DTCO.DFC_LSUHtCoupSig_0_C DFES_DTCO.DFC_LSUHtCoupSig_1_C DFES_DTCO.DFC_LSUHtCoupSig_2_C DFES_DTCO.DFC_LSUHtCoupSig_3_C DFES_DTCO.DFC_CtT_C DFES_DTCO.DFC_DSMDummy_C DFES_DTCO.DFC_MeUnOL_C DFES_DTCO.DFC_MeUnSCB_C DFES_DTCO.DFC_MeUnSRCMax_C DFES_DTCO.DFC_MeUnSRCMin_C DFES_DTCO.DFC_PCVOL_C DFES_DTCO.DFC_PCVSCB_C DFES_DTCO.DFC_PCVSRCMax_C DFES_DTCO.DFC_PCVSRCMin_C DFES_DTCO.DFC_RailPSRCMax_C DFES_DTCO.DFC_RailPSRCMin_C DFES_DTCO.DFC_IVActrVltgSRCMax_C DFES_DTCO.DFC_IVActrVltgSRCMin_C DFES_DTCO.DFC_IVPSplyDCDC_C DFES_DTCO.DFC_IVPSplyVltgSRCMax_C DFES_DTCO.DFC_IVPSplyVltgSRCMin_C DFES_DTCO.DFC_AFSOffsDrftMax_C DFES_DTCO.DFC_AFSOffsDrftMin_C DFES_DTCO.DFC_AFSSRCCorMax_C DFES_DTCO.DFC_AFSSRCCorMin_C DFES_DTCO.DFC_AFSSRCRawMax_C DFES_DTCO.DFC_AFSSRCRawMin_C DFES_DTCO.DFC_AFSSetyDrftMax_C DFES_DTCO.DFC_AFSSetyDrftMin_C DFES_DTCO.DFC_AirCClntPAnaSRCMax_C DFES_DTCO.DFC_AirCClntPAnaSRCMin_C DFES_DTCO.DFC_AirCClntPPerSRCMax_C DFES_DTCO.DFC_AirCClntPPerSRCMin_C DFES_DTCO.DFC_AirCClntPdcycSRCMax_C DFES_DTCO.DFC_AirCClntPdcycSRCMin_C DFES_DTCO.DFC_AirCCmprOL_C DFES_DTCO.DFC_AirCCmprRedTrqOL_C DFES_DTCO.DFC_AirCCmprRedTrqSCB_C DFES_DTCO.DFC_AirCCmprRedTrqSCG_C DFES_DTCO.DFC_AirCCmprSCB_C DFES_DTCO.DFC_AirCCmprSCG_C DFES_DTCO.DFC_AirCSwtNpl_C DFES_DTCO.DFC_AirCSwtSig_C DFES_DTCO.DFC_BattUSRCMax_C DFES_DTCO.DFC_BattUSRCMin_C DFES_DTCO.DFC_BrkNpl_C DFES_DTCO.DFC_BrkPSRCMax_C DFES_DTCO.DFC_BrkPSRCMin_C DFES_DTCO.DFC_BrkSig_C DFES_DTCO.DFC_CByVlvOL_C DFES_DTCO.DFC_CByVlvSCB_C DFES_DTCO.DFC_CByVlvSCG_C DFES_DTCO.DFC_CEngDsTSRCMax_C DFES_DTCO.DFC_CEngDsTSRCMin_C DFES_DTCO.DFC_CEngDsTSig_C DFES_DTCO.DFC_CEngUsTSRCMax_C DFES_DTCO.DFC_CEngUsTSRCMin_C DFES_DTCO.DFC_CThmstOL_C DFES_DTCO.DFC_CThmstSCB_C DFES_DTCO.DFC_CThmstSCG_C DFES_DTCO.DFC_ClthSig_C DFES_DTCO.DFC_ECBVlvOL_C DFES_DTCO.DFC_ECBVlvSCB_C DFES_DTCO.DFC_ECBVlvSCG_C DFES_DTCO.DFC_ECBVlvSRCMax_C DFES_DTCO.DFC_ECBVlvSRCMin_C DFES_DTCO.DFC_EGRVlvGovDvtMax_C DFES_DTCO.DFC_EGRVlvGovDvtMin_C DFES_DTCO.DFC_EGRVlvOL_C DFES_DTCO.DFC_EGRVlvSCB_C DFES_DTCO.DFC_EGRVlvSCG_C DFES_DTCO.DFC_EGRVlvSRCMax_C DFES_DTCO.DFC_EGRVlvSRCMin_C DFES_DTCO.DFC_EMDmpOL_0_C DFES_DTCO.DFC_EMDmpOL_1_C DFES_DTCO.DFC_EMDmpSCB_0_C DFES_DTCO.DFC_EMDmpSCB_1_C DFES_DTCO.DFC_EMDmpSCG_0_C DFES_DTCO.DFC_EMDmpSCG_1_C DFES_DTCO.DFC_EngStAOL_C DFES_DTCO.DFC_EngStASCB_C DFES_DTCO.DFC_EngStASCG_C DFES_DTCO.DFC_EnvPSRCMax_C DFES_DTCO.DFC_EnvPSRCMin_C DFES_DTCO.DFC_EnvPSig_C DFES_DTCO.DFC_EnvTSRCMax_C DFES_DTCO.DFC_EnvTSRCMin_C DFES_DTCO.DFC_FanOL_C DFES_DTCO.DFC_FanSCB_C DFES_DTCO.DFC_FlFltSig_C DFES_DTCO.DFC_FuelTSRCMax_C DFES_DTCO.DFC_FuelTSRCMin_C DFES_DTCO.DFC_GbxNPosPPerSRCMax_C DFES_DTCO.DFC_GbxNPosPPerSRCMin_C DFES_DTCO.DFC_GbxNPosPdcycSRCMax_C DFES_DTCO.DFC_GbxNPosPdcycSRCMin_C DFES_DTCO.DFC_GbxNPosSig_C DFES_DTCO.DFC_GlwPlgBSDOL_0_C DFES_DTCO.DFC_GlwPlgBSDOL_1_C DFES_DTCO.DFC_GlwPlgBSDOL_2_C DFES_DTCO.DFC_GlwPlgBSDOL_3_C DFES_DTCO.DFC_GlwPlgBSDOL_4_C DFES_DTCO.DFC_GlwPlgBSDOL_5_C DFES_DTCO.DFC_GlwPlgBSDOL_6_C DFES_DTCO.DFC_GlwPlgBSDOL_7_C DFES_DTCO.DFC_GlwPlgBSDOT_0_C DFES_DTCO.DFC_GlwPlgBSDOT_1_C DFES_DTCO.DFC_GlwPlgBSDOT_2_C DFES_DTCO.DFC_GlwPlgBSDOT_3_C DFES_DTCO.DFC_GlwPlgBSDOT_4_C DFES_DTCO.DFC_GlwPlgBSDOT_5_C DFES_DTCO.DFC_GlwPlgBSDOT_6_C DFES_DTCO.DFC_GlwPlgBSDOT_7_C DFES_DTCO.DFC_GlwPlgBSDSC_0_C DFES_DTCO.DFC_GlwPlgBSDSC_1_C DFES_DTCO.DFC_GlwPlgBSDSC_2_C DFES_DTCO.DFC_GlwPlgBSDSC_3_C DFES_DTCO.DFC_GlwPlgBSDSC_4_C DFES_DTCO.DFC_GlwPlgBSDSC_5_C DFES_DTCO.DFC_GlwPlgBSDSC_6_C DFES_DTCO.DFC_GlwPlgBSDSC_7_C DFES_DTCO.DFC_GlwPlgComErr_C DFES_DTCO.DFC_InjVlvPresMin_C DFES_DTCO.DFC_LSUCircNernstMax_0_C DFES_DTCO.DFC_LSUCircNernstMax_1_C DFES_DTCO.DFC_LSUCircNernstMax_2_C DFES_DTCO.DFC_LSUCircNernstMax_3_C DFES_DTCO.DFC_LSUCircNernstMin_0_C DFES_DTCO.DFC_LSUCircNernstMin_1_C DFES_DTCO.DFC_LSUCircNernstMin_2_C DFES_DTCO.DFC_LSUCircNernstMin_3_C DFES_DTCO.DFC_LSUCircNernstSig_0_C DFES_DTCO.DFC_LSUCircNernstSig_1_C DFES_DTCO.DFC_LSUCircNernstSig_2_C DFES_DTCO.DFC_LSUCircNernstSig_3_C DFES_DTCO.DFC_LSUCircPmpCurMax_0_C DFES_DTCO.DFC_LSUCircPmpCurMax_1_C DFES_DTCO.DFC_LSUCircPmpCurMax_2_C DFES_DTCO.DFC_LSUCircPmpCurMax_3_C DFES_DTCO.DFC_LSUCircPmpCurMin_0_C DFES_DTCO.DFC_LSUCircPmpCurMin_1_C DFES_DTCO.DFC_LSUCircPmpCurMin_2_C DFES_DTCO.DFC_LSUCircPmpCurMin_3_C DFES_DTCO.DFC_LSUCircPmpCurSig_0_C DFES_DTCO.DFC_LSUCircPmpCurSig_1_C DFES_DTCO.DFC_LSUCircPmpCurSig_2_C DFES_DTCO.DFC_LSUCircPmpCurSig_3_C DFES_DTCO.DFC_LSUCircVirtGndMax_0_C DFES_DTCO.DFC_LSUCircVirtGndMax_1_C DFES_DTCO.DFC_LSUCircVirtGndMax_2_C DFES_DTCO.DFC_LSUCircVirtGndMax_3_C DFES_DTCO.DFC_LSUCircVirtGndMin_0_C DFES_DTCO.DFC_LSUCircVirtGndMin_1_C DFES_DTCO.DFC_LSUCircVirtGndMin_2_C DFES_DTCO.DFC_LSUCircVirtGndMin_3_C DFES_DTCO.DFC_LSUCircVirtGndSig_0_C DFES_DTCO.DFC_LSUCircVirtGndSig_1_C DFES_DTCO.DFC_LSUCircVirtGndSig_2_C DFES_DTCO.DFC_LSUCircVirtGndSig_3_C DFES_DTCO.DFC_LSUHtrMax_0_C DFES_DTCO.DFC_LSUHtrMax_1_C DFES_DTCO.DFC_LSUHtrMax_2_C DFES_DTCO.DFC_LSUHtrMax_3_C DFES_DTCO.DFC_LSUHtrMin_0_C DFES_DTCO.DFC_LSUHtrMin_1_C DFES_DTCO.DFC_LSUHtrMin_2_C DFES_DTCO.DFC_LSUHtrMin_3_C DFES_DTCO.DFC_LSUHtrSig_0_C DFES_DTCO.DFC_LSUHtrSig_1_C DFES_DTCO.DFC_LSUHtrSig_2_C DFES_DTCO.DFC_LSUHtrSig_3_C DFES_DTCO.DFC_LSUO2Max_0_C DFES_DTCO.DFC_LSUO2Max_1_C DFES_DTCO.DFC_LSUO2Max_2_C DFES_DTCO.DFC_LSUO2Max_3_C DFES_DTCO.DFC_LSUO2Min_0_C DFES_DTCO.DFC_LSUO2Min_1_C DFES_DTCO.DFC_LSUO2Min_2_C DFES_DTCO.DFC_LSUO2Min_3_C DFES_DTCO.DFC_LSUSPIBattLowMin_0_C DFES_DTCO.DFC_LSUSPIBattLowMin_1_C DFES_DTCO.DFC_LSUSPIBattLowMin_2_C DFES_DTCO.DFC_LSUSPIBattLowMin_3_C DFES_DTCO.DFC_LSUSPISig_0_C DFES_DTCO.DFC_LSUSPISig_1_C DFES_DTCO.DFC_LSUSPISig_2_C DFES_DTCO.DFC_LSUSPISig_3_C DFES_DTCO.DFC_LSUtExcMax_0_C DFES_DTCO.DFC_LSUtExcMax_1_C DFES_DTCO.DFC_LSUtExcMax_2_C DFES_DTCO.DFC_LSUtExcMax_3_C DFES_DTCO.DFC_LSUtExcMin_0_C DFES_DTCO.DFC_LSUtExcMin_1_C DFES_DTCO.DFC_LSUtExcMin_2_C DFES_DTCO.DFC_LSUtExcMin_3_C DFES_DTCO.DFC_MILOL_C DFES_DTCO.DFC_MILSCB_C DFES_DTCO.DFC_MILSCG_C DFES_DTCO.DFC_MeUnSCG_C DFES_DTCO.DFC_NplHsChngPPFltDiff_C DFES_DTCO.DFC_NplPAirFltDs_C DFES_DTCO.DFC_NplTPFltUs_C DFES_DTCO.DFC_OilComErr_C DFES_DTCO.DFC_OilPLmpOL_C DFES_DTCO.DFC_OilPLmpSCB_C DFES_DTCO.DFC_OilPLmpSCG_C DFES_DTCO.DFC_OilPNpl_C DFES_DTCO.DFC_OilTNpl_C DFES_DTCO.DFC_OilTSRCMax_C DFES_DTCO.DFC_OilTSRCMin_C DFES_DTCO.DFC_PCACDsEnvPPls_C DFES_DTCO.DFC_PCACDsSRCMax_C DFES_DTCO.DFC_PCACDsSRCMin_C DFES_DTCO.DFC_PCVSCG_C DFES_DTCO.DFC_PFltCharPDiffMin_C DFES_DTCO.DFC_PFltDstrMin_C DFES_DTCO.DFC_PFltEngPrt_C DFES_DTCO.DFC_PFltLmpOL_C DFES_DTCO.DFC_PFltLmpSCB_C DFES_DTCO.DFC_PFltLmpSCG_C DFES_DTCO.DFC_PFltRgnPerm_C DFES_DTCO.DFC_PFltSRCMaxFlwRstn_C DFES_DTCO.DFC_PFltSRCMinFlwRstn_C DFES_DTCO.DFC_PFltSotMsDvtMax_C DFES_DTCO.DFC_PFltSotMsDvtMin_C DFES_DTCO.DFC_PFltSotMsMax_C DFES_DTCO.DFC_PSPOL_C DFES_DTCO.DFC_PSPSCB_C DFES_DTCO.DFC_PSPSCG_C DFES_DTCO.DFC_SRCHighAPP1_C DFES_DTCO.DFC_SRCHighAPP2_C DFES_DTCO.DFC_SRCLowAPP1_C DFES_DTCO.DFC_SRCLowAPP2_C DFES_DTCO.DFC_SRCMaxPAirFltDs_C DFES_DTCO.DFC_SRCMaxPPFltUs_C DFES_DTCO.DFC_SRCMaxTECU_C DFES_DTCO.DFC_SRCMaxTOxiCatUs_C DFES_DTCO.DFC_SRCMaxTPFltUs_C DFES_DTCO.DFC_SRCMinPAirFltDs_C DFES_DTCO.DFC_SRCMinPPFltUs_C DFES_DTCO.DFC_SRCMinTECU_C DFES_DTCO.DFC_SRCMinTOxiCatUs_C DFES_DTCO.DFC_SRCMinTPFltUs_C DFES_DTCO.DFC_SVSOL_C DFES_DTCO.DFC_SVSSCB_C DFES_DTCO.DFC_SVSSCG_C DFES_DTCO.DFC_StrtOL_C DFES_DTCO.DFC_StrtSCB_C DFES_DTCO.DFC_StrtSCG_C DFES_DTCO.DFC_SyncAPP_C DFES_DTCO.DFC_T15Npl_C DFES_DTCO.DFC_TAFSDtyCycHi_C DFES_DTCO.DFC_TAFSDtyCycLo_C DFES_DTCO.DFC_TAFSPerHi_C DFES_DTCO.DFC_TAFSPerLo_C DFES_DTCO.DFC_TCACDsSRCMax_C DFES_DTCO.DFC_TCACDsSRCMin_C DFES_DTCO.DFC_ThrVlvOL_C DFES_DTCO.DFC_ThrVlvSCB_C DFES_DTCO.DFC_ThrVlvSRCMax_C DFES_DTCO.DFC_ThrVlvSRCMin_C DFES_DTCO.DFC_TrbChLPOL_C DFES_DTCO.DFC_TrbChLPSCB_C DFES_DTCO.DFC_TrbChLPSCG_C DFES_DTCO.DFC_TrbChOL_C DFES_DTCO.DFC_TrbChSCB_C DFES_DTCO.DFC_VSwVlvGovDvtMax_C DFES_DTCO.DFC_VSwVlvGovDvtMin_C DFES_DTCO.DFC_VSwVlvOL_C DFES_DTCO.DFC_VSwVlvSCB_C DFES_DTCO.DFC_VSwVlvSCG_C DFES_DTCO.DFC_VSwVlvSRCMax_C DFES_DTCO.DFC_VSwVlvSRCMin_C DFES_DTCO.DFC_VehVHW_C DFES_DTCO.DFC_VehVMax_C DFES_DTCO.DFC_VehVPlaus_C DFES_DTCO.DFC_VehVSig_C DFES_DTCO.DFC_WaHtElOL_C DFES_DTCO.DFC_WaHtElSCB_C DFES_DTCO.DFC_ClthNpl_C DFES_DTCO.DFC_ETClbETMax_0_C DFES_DTCO.DFC_ETClbETMax_1_C DFES_DTCO.DFC_ETClbETMax_2_C DFES_DTCO.DFC_ETClbETMax_3_C DFES_DTCO.DFC_ETClbETMax_4_C DFES_DTCO.DFC_ETClbETMax_5_C DFES_DTCO.DFC_ETClbETMin_0_C DFES_DTCO.DFC_ETClbETMin_1_C DFES_DTCO.DFC_ETClbETMin_2_C DFES_DTCO.DFC_ETClbETMin_3_C DFES_DTCO.DFC_ETClbETMin_4_C DFES_DTCO.DFC_ETClbETMin_5_C DFES_DTCO.DFC_IVDiaBnkShCirBSH_0_C DFES_DTCO.DFC_IVDiaBnkShCirBSH_1_C DFES_DTCO.DFC_IVDiaBnkShCirChSwt_0_C DFES_DTCO.DFC_IVDiaBnkShCirChSwt_1_C DFES_DTCO.DFC_IVDiaBnkShCirHSBatt_0_C DFES_DTCO.DFC_IVDiaBnkShCirHSBatt_1_C DFES_DTCO.DFC_IVDiaBnkShCirHiRstnc_0_C DFES_DTCO.DFC_IVDiaBnkShCirHiRstnc_1_C DFES_DTCO.DFC_IVDiaBnkShCirLSHSGnd_0_C DFES_DTCO.DFC_IVDiaBnkShCirLSHSGnd_1_C DFES_DTCO.DFC_IVDiaBnkShCirTransfer_0_C DFES_DTCO.DFC_IVDiaBnkShCirTransfer_1_C DFES_DTCO.DFC_IVDiaCylNoCls_0_C DFES_DTCO.DFC_IVDiaCylNoCls_1_C DFES_DTCO.DFC_IVDiaCylNoCls_2_C DFES_DTCO.DFC_IVDiaCylNoCls_3_C DFES_DTCO.DFC_IVDiaCylNoCls_4_C DFES_DTCO.DFC_IVDiaCylNoCls_5_C DFES_DTCO.DFC_IVDiaCylNoLd_0_C DFES_DTCO.DFC_IVDiaCylNoLd_1_C DFES_DTCO.DFC_IVDiaCylNoLd_2_C DFES_DTCO.DFC_IVDiaCylNoLd_3_C DFES_DTCO.DFC_IVDiaCylNoLd_4_C DFES_DTCO.DFC_IVDiaCylNoLd_5_C DFES_DTCO.DFC_IVDiaCylShCirHiRstnc_0_C DFES_DTCO.DFC_IVDiaCylShCirHiRstnc_1_C DFES_DTCO.DFC_IVDiaCylShCirHiRstnc_2_C DFES_DTCO.DFC_IVDiaCylShCirHiRstnc_3_C DFES_DTCO.DFC_IVDiaCylShCirHiRstnc_4_C DFES_DTCO.DFC_IVDiaCylShCirHiRstnc_5_C DFES_DTCO.DFC_IVDiaCylShCirLSBatt_0_C DFES_DTCO.DFC_IVDiaCylShCirLSBatt_1_C DFES_DTCO.DFC_IVDiaCylShCirLSBatt_2_C DFES_DTCO.DFC_IVDiaCylShCirLSBatt_3_C DFES_DTCO.DFC_IVDiaCylShCirLSBatt_4_C DFES_DTCO.DFC_IVDiaCylShCirLSBatt_5_C DFES_DTCO.DFC_IVDiaCylShCirLSHS_0_C DFES_DTCO.DFC_IVDiaCylShCirLSHS_1_C DFES_DTCO.DFC_IVDiaCylShCirLSHS_2_C DFES_DTCO.DFC_IVDiaCylShCirLSHS_3_C DFES_DTCO.DFC_IVDiaCylShCirLSHS_4_C DFES_DTCO.DFC_IVDiaCylShCirLSHS_5_C DFES_DTCO.DFC_IVDiaCylShCirLsLs_0_C DFES_DTCO.DFC_IVDiaCylShCirLsLs_1_C DFES_DTCO.DFC_IVDiaCylShCirLsLs_2_C DFES_DTCO.DFC_IVDiaCylShCirLsLs_3_C DFES_DTCO.DFC_IVDiaCylShCirLsLs_4_C DFES_DTCO.DFC_IVDiaCylShCirLsLs_5_C DFES_DTCO.DFC_IVDiaSPICfg_C DFES_DTCO.DFC_IVDiaSPIColl_C DFES_DTCO.DFC_IVDiaSPICtrl_C DFES_DTCO.DFC_IVDiaSPIRam_C DFES_DTCO.DFC_IVDiaSPITrans_C DFES_DTCO.DFC_LSUCmpChk_0_C DFES_DTCO.DFC_LSUCmpChk_1_C DFES_DTCO.DFC_LSUCmpChk_2_C DFES_DTCO.DFC_LSUCmpChk_3_C DFES_DTCO.DFC_LSUCmpChk_4_C DFES_DTCO.DFC_LSUCmpChk_5_C DFES_DTCO.DFC_LSUDynChk_0_C DFES_DTCO.DFC_LSUDynChk_1_C DFES_DTCO.DFC_LSUDynChk_2_C DFES_DTCO.DFC_LSUDynChk_3_C DFES_DTCO.DFC_LSUO2ClbMax_0_C DFES_DTCO.DFC_LSUO2ClbMax_1_C DFES_DTCO.DFC_LSUO2ClbMax_2_C DFES_DTCO.DFC_LSUO2ClbMax_3_C DFES_DTCO.DFC_LSUO2ClbMin_0_C DFES_DTCO.DFC_LSUO2ClbMin_1_C DFES_DTCO.DFC_LSUO2ClbMin_2_C DFES_DTCO.DFC_LSUO2ClbMin_3_C DFES_DTCO.DFC_LSUO2PlausMax_0_C DFES_DTCO.DFC_LSUO2PlausMax_1_C DFES_DTCO.DFC_LSUO2PlausMax_2_C DFES_DTCO.DFC_LSUO2PlausMax_3_C DFES_DTCO.DFC_LSUO2PlausMin_0_C DFES_DTCO.DFC_LSUO2PlausMin_1_C DFES_DTCO.DFC_LSUO2PlausMin_2_C DFES_DTCO.DFC_LSUO2PlausMin_3_C DFES_DTCO.DFC_LSURiClbMax_0_C DFES_DTCO.DFC_LSURiClbMax_1_C DFES_DTCO.DFC_LSURiClbMax_2_C DFES_DTCO.DFC_LSURiClbMax_3_C DFES_DTCO.DFC_LSURiClbMin_0_C DFES_DTCO.DFC_LSURiClbMin_1_C DFES_DTCO.DFC_LSURiClbMin_2_C DFES_DTCO.DFC_LSURiClbMin_3_C DFES_DTCO.DFC_LSUWireIPSig_0_C DFES_DTCO.DFC_LSUWireIPSig_1_C DFES_DTCO.DFC_LSUWireIPSig_2_C DFES_DTCO.DFC_LSUWireIPSig_3_C DFES_DTCO.DFC_AFSDrftIdlAdjVal_C DFES_DTCO.DFC_AFSDrftLdAdjVal_C DFES_DTCO.DFC_AdcI_ADC0_Cal_C DFES_DTCO.DFC_AdcI_ADC0_Conv_C DFES_DTCO.DFC_CmbChbMisfireMax_0_C DFES_DTCO.DFC_CmbChbMisfireMax_1_C DFES_DTCO.DFC_CmbChbMisfireMax_2_C DFES_DTCO.DFC_CmbChbMisfireMax_3_C DFES_DTCO.DFC_CmbChbMisfireMax_4_C DFES_DTCO.DFC_CmbChbMisfireMax_5_C DFES_DTCO.DFC_CmbChbMisfireMul_C DFES_DTCO.DFC_INJVLVBUSY_C DFES_DTCO.DFC_IVAdjIVA_0_C DFES_DTCO.DFC_IVAdjIVA_1_C DFES_DTCO.DFC_IVAdjIVA_2_C DFES_DTCO.DFC_IVAdjIVA_3_C DFES_DTCO.DFC_IVAdjIVA_4_C DFES_DTCO.DFC_IVAdjIVA_5_C DFES_DTCO.DFC_InjCtlAdjQntEEPCS_C DFES_DTCO.DFC_InjCtlDriftEEPCS_C DFES_DTCO.DFC_MRlyErlyOpng_C DFES_DTCO.DFC_MRlyStk_C DFES_DTCO.DFC_SensFrzPPFltUs_C DFES_DTCO.DFC_T15Sig_C DFES_DTCO.DFC_AirCtlRmpTOut_C DFES_DTCO.DFC_CEngDsTDynTst_C DFES_DTCO.DFC_EGRVlvJamVlvClsd_C DFES_DTCO.DFC_EGRVlvJamVlvOpn_C DFES_DTCO.DFC_EGRVlvLgTDrft_C DFES_DTCO.DFC_EGRVlvOfsLrnJamVlv_C DFES_DTCO.DFC_EGRVlvShTDrft_C DFES_DTCO.DFC_EGTRgnOilDilMax_C DFES_DTCO.DFC_EngICO_C DFES_DTCO.DFC_EpmCaSI1ErrSig_C DFES_DTCO.DFC_EpmCaSI1NoSig_C DFES_DTCO.DFC_EpmCaSI1OfsErr_C DFES_DTCO.DFC_EpmCrSErrSig_C DFES_DTCO.DFC_EpmCrSNoSig_C DFES_DTCO.DFC_MoCADCCmp_C DFES_DTCO.DFC_MoCADCTst_C DFES_DTCO.DFC_MoCADCVltgRatio_C DFES_DTCO.DFC_MoCSOPLoLi_C DFES_DTCO.DFC_MoCSOPMM_C DFES_DTCO.DFC_MoCSOPTimeOut_C DFES_DTCO.DFC_MoCSOPUpLi_C DFES_DTCO.DFC_MoFAPP_C DFES_DTCO.DFC_MoFESpd_C DFES_DTCO.DFC_MoFInjDatPhi_C DFES_DTCO.DFC_MoFInjDatQnt_C DFES_DTCO.DFC_MoFInjQnt_C DFES_DTCO.DFC_MoFOvR_C DFES_DTCO.DFC_MoFQntCor_C DFES_DTCO.DFC_MoFTrqCmp_C DFES_DTCO.DFC_NplTOxiCatUs_C DFES_DTCO.DFC_PhyModNonMonMapNpl_C DFES_DTCO.DFC_RailPOfsTstMax_C DFES_DTCO.DFC_RailPOfsTstMin_C DFES_DTCO.DFC_SWReset_0_C DFES_DTCO.DFC_SWReset_1_C DFES_DTCO.DFC_SWReset_2_C DFES_DTCO.DFC_VSwVlvJamVlv_C DFES_DTCO.DFC_VSwVlvLgTDrft_C DFES_DTCO.DFC_VSwVlvOfsLrnJamVlv_C DFES_DTCO.DFC_VSwVlvShTDrft_C /end DEF_CHARACTERISTIC
/end FUNCTION
/begin COMPU_METHOD DFES_OneToOne "" RAT_FUNC "%6.2" "-" COEFFS 0 1 0 0 0 1 /end COMPU_METHOD
/begin RECORD_LAYOUT Val_Wu16 FNC_VALUES 1 UWORD COLUMN_DIR DIRECT /end RECORD_LAYOUT
/end MODULE
/end PROJECT
