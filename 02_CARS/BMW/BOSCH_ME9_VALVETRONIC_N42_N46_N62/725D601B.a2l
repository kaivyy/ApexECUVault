ASAP2_VERSION 1 3
/begin PROJECT _725D601B "725D601B"
/begin HEADER "" VERSION "_725D601B" PROJECT_NO _725D601B /end HEADER
/begin MODULE DIM ""
/begin MOD_COMMON "" BYTE_ORDER MSB_FIRST ALIGNMENT_BYTE 1 ALIGNMENT_WORD 2 ALIGNMENT_LONG 2 ALIGNMENT_FLOAT32_IEEE 4 /end MOD_COMMON
/begin CHARACTERISTIC AGANGW "Anzahl Gangwechsel f¸r Diagnose Kupplungsschalter" VALUE 0xFD0532 KwUb 255.0 dez 0.00 255.0 FORMAT "%5.1" /end CHARACTERISTIC
/begin CHARACTERISTIC AKUPPLB "Anzahl Kupplung bet‰tigt f¸r Diagnose Kupplungsschalter" VALUE 0xFD0533 KwUb 255.0 dez 0.00 255.0 FORMAT "%5.1" /end CHARACTERISTIC
/begin CHARACTERISTIC ANZDYNSH "Anzahl der Dynamikmessungen f¸r Schwingungspr¸fung Sonde hinter KAT" VALUE 0xFD034A KwUb 255.0 dez 0.00 255.0 FORMAT "%5.1" /end CHARACTERISTIC
/begin CHARACTERISTIC ANZHZKH "Anzahl der Heizer-Einkopplungen hinter KAT" VALUE 0xFC206E KwUb 255.0 dez 0.00 255.0 FORMAT "%5.1" /end CHARACTERISTIC
/begin CHARACTERISTIC ANZHZOFFH "Anzahl der Heizungsausschaltungen hinter KAT" VALUE 0xFC206F KwUb 255.0 dez 0.00 255.0 FORMAT "%5.1" /end CHARACTERISTIC
/begin CHARACTERISTIC APKTDI "Anzahl der internen Pr¸fungen bei Katdiagnose" VALUE 0xFD02FA KwWU8 254.0 dez 1.000 255.0 FORMAT "%5.1" /end CHARACTERISTIC
/begin CHARACTERISTIC APKTDIT "Anzahl der internen Pr¸fungen bei Katdiagnose bei Testerbetrieb" VALUE 0xFD02FB KwWU8 254.0 dez 1.000 255.0 FORMAT "%5.1" /end CHARACTERISTIC
/begin CHARACTERISTIC APKTDX "Maximale Anzahl der Pr¸fungen bei Katdiagnose" VALUE 0xFD02FC KwWU8 255.0 dez 0.00 255.0 FORMAT "%5.1" /end CHARACTERISTIC
/begin CHARACTERISTIC AVKATFS "Setztwert f¸r AVKATF wenn Powerfail" VALUE 0xFD02FD KwWU8 0.9961 fak_ub_b1 0.00 0.9961 /end CHARACTERISTIC
/begin CHARACTERISTIC CIDKATSP "Component ID f¸r Kat-Diagnose" VALUE 0xFD02FE KwWU8 127.0 dez 0.00 127.0 FORMAT "%5.1" /end CHARACTERISTIC
/begin CHARACTERISTIC CIDKATSP2 "Component ID f¸r Kat-Diagnose, Bank2" VALUE 0xFD02FF KwWU8 127.0 dez 0.00 127.0 FORMAT "%5.1" /end CHARACTERISTIC
/begin CHARACTERISTIC CIDKATSPI "Component ID f¸r Kat-Diagnose" VALUE 0xFD0300 KwWU8 127.0 dez 0.00 127.0 FORMAT "%5.1" /end CHARACTERISTIC
/begin CHARACTERISTIC CIDKATSPI2 "Component ID f¸r Kat-Diagnose" VALUE 0xFD0301 KwWU8 127.0 dez 0.00 127.0 FORMAT "%5.1" /end CHARACTERISTIC
/begin CHARACTERISTIC CIDKATSPT "Component ID f¸r Kat-Diagnose bei Testerbetrieb" VALUE 0xFD0302 KwWU8 127.0 dez 0.00 127.0 FORMAT "%5.1" /end CHARACTERISTIC
/begin CHARACTERISTIC CIDKATSPT2 "Component ID f¸r Kat-Diagnose bei Testerbetrieb, Bank2" VALUE 0xFD0303 KwWU8 127.0 dez 0.00 127.0 FORMAT "%5.1" /end CHARACTERISTIC
/begin CHARACTERISTIC CPLRA "Codewort f¸r Umschaltung DKVS von HFM- auf P-System" VALUE 0xFD1ABE KwUb 255.0 dez 0.00 255.0 FORMAT "%5.1" /end CHARACTERISTIC
/begin CHARACTERISTIC CWDISAPOTI "Codewort zum zur¸cksetzen von Zdiwisch und B_diwisch" VALUE 0xFC2398 KwWU8 255.0 dez 0.00 255.0 FORMAT "%5.1" /end CHARACTERISTIC
/begin CHARACTERISTIC CWDIWISCH "Codewort zum aktivieren der Wischfunktion nur im LL" VALUE 0xFC2399 KwWU8 255.0 dez 0.00 255.0 FORMAT "%5.1" /end CHARACTERISTIC
/begin CHARACTERISTIC CWDKATSP "Codewort Katalysardiagnose, funktionsintern" VALUE 0xFD0304 KwWU8 255.0 dez 0.00 255.0 FORMAT "%5.1" /end CHARACTERISTIC
/begin CHARACTERISTIC CWDKATSPEB "Internes Codewort f¸r %DKATSPEB" VALUE 0xFD0342 KwWU8 255.0 dez 0.00 255.0 FORMAT "%5.1" /end CHARACTERISTIC
/begin CHARACTERISTIC CWDKRNT "Codewort: KR-Diagnose Integratorsteigung" VALUE 0xFC8318 KwUb 255.0 dez 0.00 255.0 FORMAT "%5.1" /end CHARACTERISTIC
/begin CHARACTERISTIC CWDKROF "Codewort: KR-Diagnose Resetwert" VALUE 0xFC8319 KwUb 255.0 dez 0.00 255.0 FORMAT "%5.1" /end CHARACTERISTIC
/begin CHARACTERISTIC CWDKRTP "Codewort: KR-Diagnose Testimpuls" VALUE 0xFC8338 KwUb 255.0 dez 0.00 255.0 FORMAT "%5.1" /end CHARACTERISTIC
/begin CHARACTERISTIC CWDKS1 "Codewort: Klopfsensordiagnose Sensor1" VALUE 0xFD2DB6 KwUb 255.0 dez 0.00 255.0 FORMAT "%5.1" /end CHARACTERISTIC
/begin CHARACTERISTIC CWDKS2 "Codewort: Klopfsensordiagnose Sensor 2" VALUE 0xFD2DB7 KwUb 255.0 dez 0.00 255.0 FORMAT "%5.1" /end CHARACTERISTIC
/begin CHARACTERISTIC CWDKS3 "Codewort: Klopfsensordiagnose Sensor 3" VALUE 0xFD2DB8 KwUb 255.0 dez 0.00 255.0 FORMAT "%5.1" /end CHARACTERISTIC
/begin CHARACTERISTIC CWDKS4 "Codewort: Klopfsensordiagnose Sensor 4" VALUE 0xFD2DB9 KwUb 255.0 dez 0.00 255.0 FORMAT "%5.1" /end CHARACTERISTIC
/begin CHARACTERISTIC CWDKVSS "Codewort f¸r Error in DKVS sperren, wenn andere Fehler vorliegen" VALUE 0xFD1ABF KwUb 255.0 dez 0.00 255.0 FORMAT "%5.1" /end CHARACTERISTIC
/begin CHARACTERISTIC CWDLSAHK "Codewort CWDLSAHK f¸r Alterung Sonde hinter KAT" VALUE 0xFD034B KwUb 255.0 dez 0.00 255.0 FORMAT "%5.1" /end CHARACTERISTIC
/begin CHARACTERISTIC CWDVVT "Code Wort f¸r Diagnose DKVS bei VVT-Motoren" VALUE 0xFD1AC0 KwUb 255.0 dez 0.00 255.0 FORMAT "%5.1" /end CHARACTERISTIC
/begin CHARACTERISTIC CWKATSLK "Codewort f¸r B_lrka aktiv" VALUE 0xFD0343 KwWU8 255.0 dez 0.00 255.0 FORMAT "%5.1" /end CHARACTERISTIC
/begin CHARACTERISTIC CWPSETS "Codewort f¸r Endstufendiagnose el. Thermostat" VALUE 0xFD0572 KwWU8 255.0 dez 0.00 255.0 FORMAT "%5.1" /end CHARACTERISTIC
/begin CHARACTERISTIC CWPSKOSE "Codewort f¸r Endstufendiagnose Klimakompressorsteuerung" VALUE 0xFD0573 KwWU8 255.0 dez 0.00 255.0 FORMAT "%5.1" /end CHARACTERISTIC
/begin CHARACTERISTIC DASA "Anzahl der SAS-Phasen zur Erkennung LLS Fehler" VALUE 0xFD310C KwUb 255.0 dez 0.00 255.0 FORMAT "%5.1" /end CHARACTERISTIC
/begin CHARACTERISTIC DELTA_U_O "Hersteller-garantierter mechanischer Verstellweg" VALUE 0xFD08B8 KwUw 319.9951 spg_uw_b5 0.00 319.9951 FORMAT "%8.4" /end CHARACTERISTIC
/begin CHARACTERISTIC DELTA_U_OS "Herstellergarantierter mech. Verstellweg (Sicherheitsber. wenn noch nicht gel.)" VALUE 0xFD08BA KwUw 319.9951 spg_uw_b5 0.00 319.9951 FORMAT "%8.4" /end CHARACTERISTIC
/begin CHARACTERISTIC DFRMST "Delta frm-schwelle f¸r Erkennung der eingeschwungenen Grundadaption" VALUE 0xFD1AC1 KwUb 1.992 fak_ub_b2 0.00 1.992 FORMAT "%5.3" /end CHARACTERISTIC
/begin CHARACTERISTIC DFRZASNAMN "min. DFRZA-Schwelle zum Aktivieren der Nicht-aktiv-Pr¸fung" VALUE 0xFD0210 KwWU16 1.999969 fak_uw_b2 0.00 1.999969 FORMAT "%8.6" /end CHARACTERISTIC
/begin CHARACTERISTIC DISAERSATZ "Ersatzsollwert" VALUE 0xFD0836 KwUb 99.61 PCENT 0.00 99.61 FORMAT "%5.2" /end CHARACTERISTIC
/begin CHARACTERISTIC DISAIMN "Min. Grenzwert f¸r I-Regleranteil" VALUE 0xFD08BC KwUw 199.997 vnstv_q0p00305s32768 -100.000 99.9969 /end CHARACTERISTIC
/begin CHARACTERISTIC DISAIMX "Max. Grenzwert f¸r I-Regleranteil" VALUE 0xFD08BE KwUw 199.997 vnstv_q0p00305s32768 -100.000 99.9969 /end CHARACTERISTIC
/begin CHARACTERISTIC DISALMN "Grenzwert f¸r Erfolg von erstem Lernschritt" VALUE 0xFD08C0 KwUw 319.9951 spg_uw_b5 0.00 319.9951 FORMAT "%8.4" /end CHARACTERISTIC
/begin CHARACTERISTIC DISAMN "Min. Grenzwert f¸r P-Regleranteil" VALUE 0xFD08C2 KwSw 199.997 vnstv_q0p00305 -100.000 99.9969 FORMAT "%7.3" /end CHARACTERISTIC
/begin CHARACTERISTIC DISAMX "Max. Grenzwert f¸r P-Regleranteil" VALUE 0xFD08C4 KwSw 199.997 vnstv_q0p00305 -100.000 99.9969 FORMAT "%7.3" /end CHARACTERISTIC
/begin CHARACTERISTIC DISA_BEGR "Dynamikbegrenzung" VALUE 0xFD08C6 KwUw 199.997 vnstv_q0p00305 0.00 199.997 FORMAT "%7.3" /end CHARACTERISTIC
/begin CHARACTERISTIC DISA_KL_I "Kennlinie f¸r Regler, I-Anteil" CURVE 0xFC23A8 KlAUwSstUwWUw 199.997 vnstv_q0p00305s32768 -100.000 99.9969
 /begin AXIS_DESCR STD_AXIS D_disa_kl vnstv_q0p00305s32768 16 -100.000 99.9969 DEPOSIT ABSOLUTE /end AXIS_DESCR
/end CHARACTERISTIC
/begin CHARACTERISTIC DISA_KL_P "Kennlinie f¸r Regler, P-Anteil" CURVE 0xFC23EA KlAUwSstUwWUw 199.997 vnstv_q0p00305s32768 -100.000 99.9969
 /begin AXIS_DESCR STD_AXIS D_disa_kl vnstv_q0p00305s32768 16 -100.000 99.9969 DEPOSIT ABSOLUTE /end AXIS_DESCR
/end CHARACTERISTIC
/begin CHARACTERISTIC DISA_RAMP "Steigung der Rampe f¸r Lernen UMA" VALUE 0xFD08C8 KwUw 319.9951 spg_uw_b5 0.00 319.9951 FORMAT "%8.4" /end CHARACTERISTIC
/begin CHARACTERISTIC DISA_SAVE "Sicherheitsabstand von OMA bzw. UMA im geregelten Betrieb" VALUE 0xFD08CA KwUw 199.997 vnstv_q0p00305 0.00 199.997 FORMAT "%7.3" /end CHARACTERISTIC
/begin CHARACTERISTIC DISA_TOT "Totzone Disa-Regler" VALUE 0xFD08CC KwUw 199.997 vnstv_q0p00305 0.00 199.997 FORMAT "%7.3" /end CHARACTERISTIC
/begin CHARACTERISTIC DISA_TOTE "Totzone Disa-Regler bei Motorwicklungs¸bertemperaturwarnung" VALUE 0xFD08CE KwUw 199.997 vnstv_q0p00305 0.00 199.997 FORMAT "%7.3" /end CHARACTERISTIC
/begin CHARACTERISTIC DISA_U "Initialisierungswert f¸r Disa_Uma / unterer Anschlag" VALUE 0xFD08D0 KwUw 319.9951 spg_uw_b5 0.00 319.9951 FORMAT "%8.4" /end CHARACTERISTIC
/begin CHARACTERISTIC DISA_UMN "Minimalwert f¸r Disa_Uma / unterer Anschlag" VALUE 0xFD08D2 KwUw 319.9951 spg_uw_b5 0.00 319.9951 FORMAT "%8.4" /end CHARACTERISTIC
/begin CHARACTERISTIC DITVAUS "Tastverh‰ltnisvorgabe f¸r DISA-Ansteuerung Ausschalten" CURVE 0xFD08D4 KlAUbSstUbWUw 655.3500 di_uw_q0p01 0.00 655.3500 FORMAT "%8.4"
 /begin AXIS_DESCR STD_AXIS Di_cnt di_uw_q0p01 6 0.00 2.550 FORMAT "%5.3" DEPOSIT ABSOLUTE /end AXIS_DESCR
/end CHARACTERISTIC
/begin CHARACTERISTIC DITVEIN "Tastverh‰ltnisvorgabe f¸r DISA-Ansteuerung Einschalten" CURVE 0xFD08E8 KlAUbSstUbWUw 655.3500 di_uw_q0p01 0.00 655.3500 FORMAT "%8.4"
 /begin AXIS_DESCR STD_AXIS Di_cnt di_uw_q0p01 6 0.00 2.550 FORMAT "%5.3" DEPOSIT ABSOLUTE /end AXIS_DESCR
/end CHARACTERISTIC
/begin CHARACTERISTIC Di_dir "Umschalten der DISA Schaltrichtung" VALUE 0xFD0837 KwUb 255.0 dez 0.00 255.0 FORMAT "%5.1" /end CHARACTERISTIC
/begin CHARACTERISTIC DI_ENDE "Ende Schaltvorgang" VALUE 0xFD0838 KwUb 2.550 di_uw_q0p01 0.00 2.550 FORMAT "%5.3" /end CHARACTERISTIC
/begin CHARACTERISTIC DI_ERSATZE "Ersatzsollwert bei Fehler" VALUE 0xFD0839 KwUb 99.61 PCENT 0.00 99.61 FORMAT "%5.2" /end CHARACTERISTIC
/begin CHARACTERISTIC DI_HYST "Disa Hysterese_Schwelle" VALUE 0xFD083A KwUb 49.61 PCENT 50.00 99.61 FORMAT "%5.2" /end CHARACTERISTIC
/begin CHARACTERISTIC DI_LSTART "Sollwert f¸r ersten Lernschritt" VALUE 0xFD08FC KwUw 319.9951 spg_uw_b5 0.00 319.9951 FORMAT "%8.4" /end CHARACTERISTIC
/begin CHARACTERISTIC DI_SCHALT "DISA im Schalt- bzw. Regelmodus" VALUE 0xFD083B KwUb 255.0 dez 0.00 255.0 FORMAT "%5.1" /end CHARACTERISTIC
/begin CHARACTERISTIC DI_SMIN "Minimaler Sollwert, unterhalb dem noch gelernt werden darf" VALUE 0xFD083C KwUb 99.61 PCENT 0.00 99.61 FORMAT "%5.2" /end CHARACTERISTIC
/begin CHARACTERISTIC DI_STDELTA "Tolerierte Verstellung zwischen Abstellen und n‰chstem Start" VALUE 0xFD08FE KwUw 319.9951 spg_uw_b5 0.00 319.9951 FORMAT "%8.4" /end CHARACTERISTIC
/begin CHARACTERISTIC DI_T1 "Startwert f¸r Timer 1: Zeitdauer bis 1. Lernschritt fertig" VALUE 0xFD0900 KwUw 655.3500 t10msxs_uw_b655p35 0.00 655.3500 FORMAT "%8.4" /end CHARACTERISTIC
/begin CHARACTERISTIC DI_T2 "Startwert f¸r Timer 2: Zeitdauer bis Abbruch von 2. Lernschritt" VALUE 0xFD0902 KwUw 655.3500 t10msxs_uw_b655p35 0.00 655.3500 FORMAT "%8.4" /end CHARACTERISTIC
/begin CHARACTERISTIC DI_TANS_MN "Untere Grenze Ansaugtemp." VALUE 0xFD083D KwUb 191.3 temp_ub_q0p75_o48 -48.00 143.3 FORMAT "%5.1" /end CHARACTERISTIC
/begin CHARACTERISTIC DI_TANS_MX "Obere Grenze Ansaugtemp." VALUE 0xFD083E KwUb 191.3 temp_ub_q0p75_o48 -48.00 143.3 FORMAT "%5.1" /end CHARACTERISTIC
/begin CHARACTERISTIC DI_UB_MN "Minimale Batteriespannung" VALUE 0xFD083F KwUb 24.02 spg_ubatt 0.00 24.02 FORMAT "%5.2" /end CHARACTERISTIC
/begin CHARACTERISTIC DI_UMAMN "" VALUE 0xFD0904 KwUw 199.997 vnstv_q0p00305 0.00 199.997 FORMAT "%7.3" /end CHARACTERISTIC
/begin CHARACTERISTIC DKROFN "Grenzwert der Integratorsteigung f¸r Nulltest" CURVE 0xFC831E KlAUwSstUwWUw 6103.425 spgg_sw_b3052 0.00 6103.425 FORMAT "%8.3"
 /begin AXIS_DESCR STD_AXIS tmfln_w tus_uw_q3p2 6 0.00 209712.0 FORMAT "%8.1" DEPOSIT ABSOLUTE /end AXIS_DESCR
/end CHARACTERISTIC
/begin CHARACTERISTIC DKROKU "Untere Drehzahlschwelle f¸r Ermittlung Offsetkompensationswert" VALUE 0xFC831A KwUb 10200. nmot_ub_q40 0.00 10200. FORMAT "%5.0" /end CHARACTERISTIC
/begin CHARACTERISTIC DLAHISATO "obere Grenze f¸r dlahisa, CARB-Tester, DLSSALRS" VALUE 0xFD03A0 KwUb 0.09961 fak_ub_b0p1_o0p05 -0.05000 0.04961 FORMAT "%7.5" /end CHARACTERISTIC
/begin CHARACTERISTIC DLAHISATU "untere Grenze f¸r dlahisa, CARB-Tester, DLSSALRS" VALUE 0xFD03A1 KwUb 0.09961 fak_ub_b0p1_o0p05 -0.05000 0.04961 FORMAT "%7.5" /end CHARACTERISTIC
/begin CHARACTERISTIC DLAMELSH "Delta-Lambda-Sollwert f¸r elektrische Sonendiagnose hinter KAT (Kurztrip)" VALUE 0xFD0384 KwUw 15.99976 fak_uw_b16 0.00 15.99976 FORMAT "%8.5" /end CHARACTERISTIC
/begin CHARACTERISTIC DLAMLASHF "Delta-Lambda-Sollwert (Fett) f¸r Test Schwingungspr¸fung hinter KAT" VALUE 0xFD0358 KwUw 15.99976 fak_uw_b16 0.00 15.99976 FORMAT "%8.5" /end CHARACTERISTIC
/begin CHARACTERISTIC DLAMLASHM "Delta-Lambda-Sollwert (Mager) f¸r Test Schwingungspr¸fung hinter KAT" VALUE 0xFD035A KwUw 15.99976 fak_uw_b16 0.00 15.99976 FORMAT "%8.5" /end CHARACTERISTIC
/begin CHARACTERISTIC DLURMIN "Drehzahlabh. Laufunruhe-Referenz-Minimalwert 1" CURVE 0xFC163C GklWU16 181.8962 luquant_w 0.00 181.8962 FORMAT "%8.4"
 /begin AXIS_DESCR COM_AXIS nmot nmot_ub_q40 8 0.00 10200. FORMAT "%5.0" AXIS_PTS_REF SNM08DMUB /end AXIS_DESCR
/end CHARACTERISTIC
/begin CHARACTERISTIC DMLKTDO "Obere Schwelle ml-ƒnderung in Kat-Diagnose" VALUE 0xFD0320 KwWU16 6553.500 m_uw_b6553p5 0.00 6553.500 FORMAT "%8.3" /end CHARACTERISTIC
/begin CHARACTERISTIC DMRKTDS "Momentenreserve f¸r Katalysator-Diagnose" VALUE 0xFD02E2 KwWU16 99.99847 rel_uw_b100 0.00 99.99847 FORMAT "%8.5" /end CHARACTERISTIC
/begin CHARACTERISTIC DMRLASH "Momentenreserve f¸r Diagnose Lambdasonden-Alterungs¸berwachung hinter KAT" VALUE 0xFD035C KwUw 99.99847 rel_uw_b100 0.00 99.99847 FORMAT "%8.5" /end CHARACTERISTIC
/begin CHARACTERISTIC DMRLSH "Momentenreserve f¸r Diagnose Lambdasonden hinter KAT" VALUE 0xFD0386 KwUw 99.99847 rel_uw_b100 0.00 99.99847 FORMAT "%8.5" /end CHARACTERISTIC
/begin CHARACTERISTIC DMXRDL "Begrenzung bei max. Laufunruhe-Referenzwert-ƒnderung von dlurs" VALUE 0xFC1650 KwWR32 20000.000000000000 fak_r32_1 -10000.000000000000 10000.000000000000 FORMAT "%27.21" /end CHARACTERISTIC
/begin CHARACTERISTIC DNDLLRO "Maximale Drehzahlabweichung (Unterdrehzahl) f¸r Diagnose LLR" VALUE 0xFD310D KwUb 1270. nmot_ub_q10 0.00 1270. FORMAT "%5.0" /end CHARACTERISTIC
/begin CHARACTERISTIC DNDLLRU "Maximale Drehzahlabweichung (‹berdrehzahl) f¸r Diagnose LLR" VALUE 0xFD310E KwSb 1280. nmot_ub_q10 -1280. 0.00 FORMAT "%5.0" /end CHARACTERISTIC
/begin CHARACTERISTIC DRISIGH "Diagnoseschwelle Ri-Sonde f¸r Signalunterbrechung hinter KAT" VALUE 0xFD0388 KwUw 131070.0 r_uw_q2 0.00 131070.0 FORMAT "%8.1" /end CHARACTERISTIC
/begin CHARACTERISTIC DTKTDGRAX "Katdiagnose: Maximaler Temperaturgradient" VALUE 0xFD0322 KwWU16 1535.977 temp_q0p0234 0.00 1535.977 FORMAT "%8.3" /end CHARACTERISTIC
/begin CHARACTERISTIC DUSHKHZK "Schwelle f¸r Delta Sondensspg. zur ‹berpr. Heizereinkoppl. auf Sondensig. h. KAT" VALUE 0xFC2074 KwUw 319.9951 spg_uw_q0p00488 0.00 319.9951 FORMAT "%8.4" /end CHARACTERISTIC
/begin CHARACTERISTIC DYNLSUTO "obere Grenze f¸r dynlsusa, CARB-Tester, DLSSALRS" VALUE 0xFD03A2 KwUb 4.980 fak_q0p0195 0.00 4.980 FORMAT "%5.3" /end CHARACTERISTIC
/begin CHARACTERISTIC DYNLSUTU "untere Grenze f¸r dynlsusa, CARB-Tester, DLSSALRS" VALUE 0xFD03A3 KwUb 4.980 fak_q0p0195 0.00 4.980 FORMAT "%5.3" /end CHARACTERISTIC
/begin CHARACTERISTIC EBEN "Bypass-Hauptschalter" VALUE 0xFC14AE KwWU8 1.000 dez 0.00 1.000 FORMAT "%5.3" /end CHARACTERISTIC
/begin CHARACTERISTIC EBMISS_T "if more messages are missing, the bypass communication is switched off" VALUE 0xFC14AA KwWU16 65535.00 dez 0.00 65535.00 FORMAT "%8.2" /end CHARACTERISTIC
/begin CHARACTERISTIC EBMISS_Y "if more messages are missing, the bypass communication is switched off" VALUE 0xFC14AC KwWU16 65535.00 dez 0.00 65535.00 FORMAT "%8.2" /end CHARACTERISTIC
/begin CHARACTERISTIC FHDLLR "Hˆhenschwelle f¸r Durchf¸hrung Diagnose Leerlaufsteller" VALUE 0xFD310F KwUb 3.984 fak_ub_b4 0.00 3.984 FORMAT "%5.3" /end CHARACTERISTIC
/begin CHARACTERISTIC FIKTD "Bewertungsfaktor des Kat-Ausr‰umintegrals bei Katdiagnose" VALUE 0xFD02E4 KwWU16 15.99976 fak_uw_b16 0.00 15.99976 FORMAT "%8.5" /end CHARACTERISTIC
/begin CHARACTERISTIC FKTDAVK "Faktor avkatf-Umrechnung bei Katdiagnose" VALUE 0xFD0305 KwWU8 0.9961 fak_ub_b1 0.00 0.9961 /end CHARACTERISTIC
/begin CHARACTERISTIC FKTDFE "Faktor Fetteintrag bei Katdiagnose" VALUE 0xFD0306 KwWU8 7.969 fak_ub_b8 0.00 7.969 FORMAT "%5.3" /end CHARACTERISTIC
/begin CHARACTERISTIC FKTDFET "Faktor Fetteintrag bei Katdiagnose, Testeranforderung" VALUE 0xFD0307 KwWU8 7.969 fak_ub_b8 0.00 7.969 FORMAT "%5.3" /end CHARACTERISTIC
/begin CHARACTERISTIC FKTDGTV "Katdiagnose: Faktor f¸r Temperaturgradientenabh‰ngige Verzugszeit" VALUE 0xFD0344 KwWU8 8.000 ttemp_q0p0333 0.00 8.000 FORMAT "%5.3" /end CHARACTERISTIC
/begin CHARACTERISTIC FRAE "Delta-fra-Schwelle f¸r Erkennung der eingeschwungenen Grundadaption" VALUE 0xFD1ADE KwUw 1.999969 fak_uw_b2 0.00 1.999969 FORMAT "%8.6" /end CHARACTERISTIC
/begin CHARACTERISTIC FRAODN "untere Diagnoseschwelle des Korrekturfaktors frao" VALUE 0xFD1AE0 KwUw 1.999969 fak_uw_b2 0.00 1.999969 FORMAT "%8.6" /end CHARACTERISTIC
/begin CHARACTERISTIC FRAODX "obere Diagnoseschwelle des Korrekturfaktors frao" VALUE 0xFD1AE2 KwUw 1.999969 fak_uw_b2 0.00 1.999969 FORMAT "%8.6" /end CHARACTERISTIC
/begin CHARACTERISTIC FRAUDN "untere Diagnoseschwelle des Korrekturfaktors frau" VALUE 0xFD1AE4 KwUw 1.999969 fak_uw_b2 0.00 1.999969 FORMAT "%8.6" /end CHARACTERISTIC
/begin CHARACTERISTIC FRAUDX "obere Diagnoseschwelle des Korrekturfaktors frau" VALUE 0xFD1AE6 KwUw 1.999969 fak_uw_b2 0.00 1.999969 FORMAT "%8.6" /end CHARACTERISTIC
/begin CHARACTERISTIC FRDO "obere Diagnoseschwelle f¸r Lambdaregler" VALUE 0xFD03B2 KwUw 1.999969 fak_uw_b2 0.00 1.999969 FORMAT "%8.6" /end CHARACTERISTIC
/begin CHARACTERISTIC FRDU "untere Diagnoseschwelle f¸r Lambdaregler" VALUE 0xFD03B4 KwUw 1.999969 fak_uw_b2 0.00 1.999969 FORMAT "%8.6" /end CHARACTERISTIC
/begin CHARACTERISTIC FRMSTTDN "untere Diagnoseschwelle (short test)" CURVE 0xFD1AC2 KlAUbSstUbWUb 1.992 fak_ub_b2 0.00 1.992 FORMAT "%5.3"
 /begin AXIS_DESCR STD_AXIS tans temp_ub_q0p75_o48 4 -48.00 143.3 FORMAT "%5.1" DEPOSIT ABSOLUTE /end AXIS_DESCR
/end CHARACTERISTIC
/begin CHARACTERISTIC FRMSTTDX "obere Diagnoseschwelle (short test)" CURVE 0xFD1ACB KlAUbSstUbWUb 1.992 fak_ub_b2 0.00 1.992 FORMAT "%5.3"
 /begin AXIS_DESCR STD_AXIS tans temp_ub_q0p75_o48 4 -48.00 143.3 FORMAT "%5.1" DEPOSIT ABSOLUTE /end AXIS_DESCR
/end CHARACTERISTIC
/begin CHARACTERISTIC FRSNAMX "max. Reglerhub wenn die Lambdasonde UASNAMN<ua10mo<UASNAMX anzeigt" VALUE 0xFD0212 KwWU16 1.999969 fak_uw_b2 0.00 1.999969 FORMAT "%8.6" /end CHARACTERISTIC
/begin CHARACTERISTIC IBBSTERR1 "Entprellzeit Fehlereintrag f. keine Kommunikation" VALUE 0xFCA730 KwWU8 25.40 t100msxs_ub_b25p5 0.1000 25.50 FORMAT "%5.2" /end CHARACTERISTIC
/begin CHARACTERISTIC IBBSTERR2 "Entprellzeit Fehlereintrag Kommunikation unplausibel" VALUE 0xFCA731 KwWU8 25.40 t100msxs_ub_b25p5 0.1000 25.50 FORMAT "%5.2" /end CHARACTERISTIC
/begin CHARACTERISTIC IBBSTERR3 "Entprellzeit Fehlereintrag IBS unplausibel" VALUE 0xFCA732 KwWU8 25.40 t100msxs_ub_b25p5 0.1000 25.50 FORMAT "%5.2" /end CHARACTERISTIC
/begin CHARACTERISTIC IBBSTERR4 "Entprellzeit Fehlereintrag f.Stromfehler" VALUE 0xFCA733 KwWU8 254.0 dez 1.000 255.0 FORMAT "%5.1" /end CHARACTERISTIC
/begin CHARACTERISTIC IBBSTERR5 "Entprellzeit Fehlereintrag f. Spannungsfehler" VALUE 0xFCA734 KwWU8 254.0 dez 1.000 255.0 FORMAT "%5.1" /end CHARACTERISTIC
/begin CHARACTERISTIC IBBSTERR6 "Entprellzeit Fehlereintrag f. Temp.Fehler" VALUE 0xFCA735 KwWU8 254.0 dez 1.000 255.0 FORMAT "%5.1" /end CHARACTERISTIC
/begin CHARACTERISTIC IBBSTERR7 "Entprellzeit Fehlereintrag f. IBS Systemfehler" VALUE 0xFCA736 KwWU8 254.0 dez 1.000 255.0 FORMAT "%5.1" /end CHARACTERISTIC
/begin CHARACTERISTIC IBBSTERR8 "Entprellzeit Fehlereintrag f. KL15wu Stoerung" VALUE 0xFCA737 KwWU8 254.0 dez 1.000 255.0 FORMAT "%5.1" /end CHARACTERISTIC
/begin CHARACTERISTIC IBBSTERR9 "" VALUE 0xFCA738 KwWU8 255.0 dez 0.00 255.0 FORMAT "%5.1" /end CHARACTERISTIC
/begin CHARACTERISTIC IBBSTHEAL1 "" VALUE 0xFCA739 KwWU8 25.40 t100msxs_ub_b25p5 0.1000 25.50 FORMAT "%5.2" /end CHARACTERISTIC
/begin CHARACTERISTIC IBBSTHEAL2 "" VALUE 0xFCA73A KwWU8 255.0 dez 0.00 255.0 FORMAT "%5.1" /end CHARACTERISTIC
/begin CHARACTERISTIC IBBSTHEAL3 "" VALUE 0xFCA73B KwWU8 255.0 dez 0.00 255.0 FORMAT "%5.1" /end CHARACTERISTIC
/begin CHARACTERISTIC IMLKVSMX "Maximale Integrationsschwelle f¸r Fehlerfreigabe in DKVS (Tank leer)" VALUE 0xFD1AE8 KwUw 233.0133 m_q0p00355 0.00 233.0133 FORMAT "%8.4" /end CHARACTERISTIC
/begin CHARACTERISTIC IMLNAMN "minimale integrierte Luftmasse f¸r die Nicht-Aktiv-Pr¸fung" VALUE 0xFD0214 KwWU16 1.820417 m_q2p777Em5_kg 0.00 1.820417 FORMAT "%8.6" /end CHARACTERISTIC
/begin CHARACTERISTIC IMLNAMN2 "minimale integrierte Luftmasse f¸r die Nicht-Aktiv-Pr¸fung, Bank 2" VALUE 0xFD0216 KwWU16 1.820417 m_q2p777Em5_kg 0.00 1.820417 FORMAT "%8.6" /end CHARACTERISTIC
/begin CHARACTERISTIC KFDLUR "Kennfeld f¸r Laufunruhedifferenz dluts Referenzwert" MAP 0xFC14BC GkfWU16 181.8962 luquant_w 0.00 181.8962 FORMAT "%8.4"
 /begin AXIS_DESCR COM_AXIS midmd rel_ub_b99p6 8 0.00 99.61 FORMAT "%5.2" AXIS_PTS_REF SMI08DMUB /end AXIS_DESCR
 /begin AXIS_DESCR COM_AXIS nmot nmot_ub_q40 8 0.00 10200. FORMAT "%5.0" AXIS_PTS_REF SNM08DMUB /end AXIS_DESCR
/end CHARACTERISTIC
/begin CHARACTERISTIC KFDLUR1 "Kennfeld f¸r Laufunruhedifferenz dluts Referenzwert" MAP 0xFC153C GkfWU16 181.8962 luquant_w 0.00 181.8962 FORMAT "%8.4"
 /begin AXIS_DESCR COM_AXIS midmd rel_ub_b99p6 8 0.00 99.61 FORMAT "%5.2" AXIS_PTS_REF SMI08DMUB /end AXIS_DESCR
 /begin AXIS_DESCR COM_AXIS nmot nmot_ub_q40 8 0.00 10200. FORMAT "%5.0" AXIS_PTS_REF SNM08DMUB /end AXIS_DESCR
/end CHARACTERISTIC
/begin CHARACTERISTIC KFDLUR2 "Kennfeld f¸r Laufunruhedifferenz dluts Referenzwert" MAP 0xFC15BC GkfWU16 181.8962 luquant_w 0.00 181.8962 FORMAT "%8.4"
 /begin AXIS_DESCR COM_AXIS midmd rel_ub_b99p6 8 0.00 99.61 FORMAT "%5.2" AXIS_PTS_REF SMI08DMUB /end AXIS_DESCR
 /begin AXIS_DESCR COM_AXIS nmot nmot_ub_q40 8 0.00 10200. FORMAT "%5.0" AXIS_PTS_REF SNM08DMUB /end AXIS_DESCR
/end CHARACTERISTIC
/begin CHARACTERISTIC KFOSCTM "Kennfeld OSC des Grenzkatalysators" MAP 0xFD023E KfAxU8AyU8SstxU16SstyU16WU16 6543.500 m_q0p1_mg 10.00000 6553.500 FORMAT "%8.3"
 /begin AXIS_DESCR STD_AXIS tkihkm_w temp_q0p0234_o273 8 -273.1500 1262.827 FORMAT "%8.3" DEPOSIT ABSOLUTE /end AXIS_DESCR
 /begin AXIS_DESCR STD_AXIS msabvhk_w m_uw_b6553p5 8 0.00 6553.500 FORMAT "%8.3" DEPOSIT ABSOLUTE /end AXIS_DESCR
/end CHARACTERISTIC
/begin CHARACTERISTIC KLDISATVUB "Wichtung TV ¸ber Betriebsspannung wegen Powermanagement" CURVE 0xFC239B KlAUbSstUbWUb 1.992 fak_ub_b2 0.00 1.992 FORMAT "%5.3"
 /begin AXIS_DESCR STD_AXIS ub spg_ubatt 6 0.00 24.02 FORMAT "%5.2" DEPOSIT ABSOLUTE /end AXIS_DESCR
/end CHARACTERISTIC
/begin CHARACTERISTIC KLIMLNA "Steigungskonstante f¸r Nicht-Aktiv-Entprellung" CURVE 0xFD01FA KlAxU8SstxU16WU16 6553.4999985 zk100msxs_uw_b6553 0.10000152590 6553.6000000 FORMAT "%12.7"
 /begin AXIS_DESCR STD_AXIS lamsons_w fak_uw_b16 5 0.00 15.99976 FORMAT "%8.5" DEPOSIT ABSOLUTE /end AXIS_DESCR
/end CHARACTERISTIC
/begin CHARACTERISTIC KMXSTG "Filterkonstante f¸r Filter max. Steigung f¸r Sonde hinter KAT" VALUE 0xFD035E KwUw 0.9999847 fak_uw_b1 0.00 0.9999847 FORMAT "%9.7" /end CHARACTERISTIC
/begin CHARACTERISTIC KRFHKS "Fehlerh‰ufigkeit Klopfsensoren" VALUE 0xFD2DBA KwUb 255.0 dez 0.00 255.0 FORMAT "%5.1" /end CHARACTERISTIC
/begin CHARACTERISTIC KRFHT "Fehlerh‰ufigkeit Testimpuls" VALUE 0xFC831B KwUb 254.0 dez 1.000 255.0 FORMAT "%5.1" /end CHARACTERISTIC
/begin CHARACTERISTIC KTLAMSTEIG "I-Faktor  f¸r  Rampensteigung lamlash im Kurztrip f¸r Testfunktion hinter KAT" VALUE 0xFD0360 KwUw 0.9999847 fak_uw_b1 0.00 0.9999847 FORMAT "%9.7" /end CHARACTERISTIC
/begin CHARACTERISTIC KUSVKMX "max. Korrekturwert f¸r Offset des Ausgangsverst‰rkers des Auswerte-IC der LSU" VALUE 0xFD0218 KwWS16 31.99951 spg_q4p88Em4 -16.00000 15.99951 FORMAT "%8.5" /end CHARACTERISTIC
/begin CHARACTERISTIC LAKTDEO "Obere Schwelle f¸r Lambda eingeschwungen bei Katdiagnose" VALUE 0xFD02E6 KwWU16 15.99976 fak_uw_b16 0.00 15.99976 FORMAT "%8.5" /end CHARACTERISTIC
/begin CHARACTERISTIC LAKTDEU "Untere Schwelle f¸r Lambda eingeschwungen bei Katdiagnose" VALUE 0xFD02E8 KwWU16 15.99976 fak_uw_b16 0.00 15.99976 FORMAT "%8.5" /end CHARACTERISTIC
/begin CHARACTERISTIC LAMLASHMIN "Minimaler Lambda-Sollwert (Fett) f¸r Test Schwingungspr¸fung hinter KAT" VALUE 0xFD0362 KwUw 15.99976 fak_uw_b16 0.00 15.99976 FORMAT "%8.5" /end CHARACTERISTIC
/begin CHARACTERISTIC LAMSONSVL "Schwelle f¸r Vollast Lambda-Betrieb bei der Sondenspannung ¸berpr¸ft wird" VALUE 0xFD0364 KwUw 15.99976 fak_uw_b16 0.00 15.99976 FORMAT "%8.5" /end CHARACTERISTIC
/begin CHARACTERISTIC LAMSSAMN "untere Grenze f¸r lamsosa und lamsisa, CARB-Tester, DLSSALRS" VALUE 0xFD03A4 KwUb 1.992 fak_ub_b2 0.00 1.992 FORMAT "%5.3" /end CHARACTERISTIC
/begin CHARACTERISTIC LAMSSAMX "obere Grenze f¸r lamsosa und lamsisa, CARB-Tester, DLSSALRS" VALUE 0xFD03A5 KwUb 1.992 fak_ub_b2 0.00 1.992 FORMAT "%5.3" /end CHARACTERISTIC
/begin CHARACTERISTIC LAMSSMN "Minimales Lambdasoll f¸r  stˆchiometrischen Betrieb" VALUE 0xFD021A KwWU16 15.99976 fak_uw_b16 0.00 15.99976 FORMAT "%8.5" /end CHARACTERISTIC
/begin CHARACTERISTIC LAMSSMX "Maximales Lambdasoll f¸r  stˆchiometrischen Betrieb" VALUE 0xFD021C KwWU16 15.99976 fak_uw_b16 0.00 15.99976 FORMAT "%8.5" /end CHARACTERISTIC
/begin CHARACTERISTIC LAMSTEIG "I-Faktor  f¸r  Rampensteigung lamlash f¸r Testfunktion hinter KAT" VALUE 0xFD0366 KwUw 0.9999847 fak_uw_b1 0.00 0.9999847 FORMAT "%9.7" /end CHARACTERISTIC
/begin CHARACTERISTIC LKTDF "Lambdawert bei Kat-Diagnose, Fettsprung" VALUE 0xFD02EA KwWU16 0.2500000 fak_uw_b16 0.7500000 1.000000 FORMAT "%8.6" /end CHARACTERISTIC
/begin CHARACTERISTIC LKTDFT "Lambdawert bei Kat-Diagnose, Fettsprung, Testerbetrieb" VALUE 0xFD02EC KwWU16 0.2500000 fak_uw_b16 0.7500000 1.000000 FORMAT "%8.6" /end CHARACTERISTIC
/begin CHARACTERISTIC LKTDM "Lambdawert bei Kat-Diagnose, Magersprung" VALUE 0xFD02EE KwWU16 0.2500000 fak_uw_b16 1.000000 1.250000 FORMAT "%8.6" /end CHARACTERISTIC
/begin CHARACTERISTIC LKTDMT "Lambdawert bei Kat-Diagnose, Magersprung, Testerbetrieb" VALUE 0xFD02F0 KwWU16 0.2500000 fak_uw_b16 1.000000 1.250000 FORMAT "%8.6" /end CHARACTERISTIC
/begin CHARACTERISTIC MLDKVSF "Luftmassenschwelle f¸r Fehlerfreigabe im DKVS (Tank leer)" VALUE 0xFD1AEA KwUw 233.0133 m_q0p00355 0.00 233.0133 FORMAT "%8.4" /end CHARACTERISTIC
/begin CHARACTERISTIC MLDKVSG "Luftmassenschwelle f¸r Fehlerfreigabe Tank leer" VALUE 0xFD1AEC KwUw 233.0133 m_q0p00355 0.00 233.0133 FORMAT "%8.4" /end CHARACTERISTIC
/begin CHARACTERISTIC MLKTDO "Obere Luftmassenschwelle f¸r Kat-Diagnose" VALUE 0xFD0324 KwWU16 6553.500 m_uw_b6553p5 0.00 6553.500 FORMAT "%8.3" /end CHARACTERISTIC
/begin CHARACTERISTIC MLKTDOO "Obere Luftmassenschwelle f¸r Kat-Diagnose, oberes Band" VALUE 0xFD0326 KwWU16 6553.500 m_uw_b6553p5 0.00 6553.500 FORMAT "%8.3" /end CHARACTERISTIC
/begin CHARACTERISTIC MLKTDOT "Obere Luftmassenschwelle f¸r Kat-Diagnose bei Testerbetrieb" VALUE 0xFD0328 KwWU16 6553.500 m_uw_b6553p5 0.00 6553.500 FORMAT "%8.3" /end CHARACTERISTIC
/begin CHARACTERISTIC MLKTDU "Untere Luftmassenschwelle f¸r Kat-Diagnose" VALUE 0xFD032A KwWU16 6553.500 m_uw_b6553p5 0.00 6553.500 FORMAT "%8.3" /end CHARACTERISTIC
/begin CHARACTERISTIC MLKTDUO "Untere Luftmassenschwelle f¸r Kat-Diagnose, oberes Band" VALUE 0xFD032C KwWU16 6553.500 m_uw_b6553p5 0.00 6553.500 FORMAT "%8.3" /end CHARACTERISTIC
/begin CHARACTERISTIC MLKTDUT "Untere Luftmassenschwelle f¸r Kat-Diagnose, Testerbetrieb" VALUE 0xFD032E KwWU16 6553.500 m_uw_b6553p5 0.00 6553.500 FORMAT "%8.3" /end CHARACTERISTIC
/begin CHARACTERISTIC MLLASH "Luftmassenschwelle f¸r Schwingungspr¸fung hinter KAT" VALUE 0xFD0368 KwUw 6553.500 m_q0p1 0.00 6553.500 FORMAT "%8.3" /end CHARACTERISTIC
/begin CHARACTERISTIC MLOSTEST "obere Luftmassenschwelle f¸r Testbeginn Schwingungspr¸fung hinter KAT" VALUE 0xFD036A KwUw 6553.500 m_q0p1 0.00 6553.500 FORMAT "%8.3" /end CHARACTERISTIC
/begin CHARACTERISTIC MLUSSTG "Luftmassenschwelle f¸r Dynamikpr¸fung hinter KAT" VALUE 0xFC206A KwUw 6553.500 m_q0p1 0.00 6553.500 FORMAT "%8.3" /end CHARACTERISTIC
/begin CHARACTERISTIC MLUSTEST "untere Luftmassenschwelle f¸r Testbeginn Schwingungspr¸fung hinter KAT" VALUE 0xFD036C KwUw 6553.500 m_q0p1 0.00 6553.500 FORMAT "%8.3" /end CHARACTERISTIC
/begin CHARACTERISTIC MLUSVL "Luftmassenschwelle f¸r Vollast-Pr¸fung f¸r Sonde hinter KAT" VALUE 0xFD036E KwUw 6553.500 m_q0p1 0.00 6553.500 FORMAT "%8.3" /end CHARACTERISTIC
/begin CHARACTERISTIC MSKIBSDFP "Bitmaske Generator Fehler-> DFP" VALUE 0xFCA73C KwWU8 255.0 dez 0.00 255.0 FORMAT "%5.1" /end CHARACTERISTIC
/begin CHARACTERISTIC MSKIBSDFP2 "" VALUE 0xFCA73D KwWU8 255.0 DEZ 0.00 255.0 FORMAT "%5.1" /end CHARACTERISTIC
/begin CHARACTERISTIC MSKIBSDIAG "Test AK disable Diagnose" VALUE 0xFCA73E KwWU8 255.0 dez 0.00 255.0 FORMAT "%5.1" /end CHARACTERISTIC
/begin CHARACTERISTIC NDKSO "Obere Diagnoseschwelle f¸r Klopfsensordiagnose" VALUE 0xFC8316 KwWU8 10200. nmot_ub_q40 0.00 10200. FORMAT "%5.0" /end CHARACTERISTIC
/begin CHARACTERISTIC NDKSU "Untere Diagnoseschwelle f¸r Klopfsensordiagnose" VALUE 0xFC8317 KwWU8 10200. nmot_ub_q40 0.00 10200. FORMAT "%5.0" /end CHARACTERISTIC
/begin CHARACTERISTIC NKTDOT "Obere Drehzahlgrenze Katdiagnose bei Testerbetrieb" VALUE 0xFD0345 KwWU8 10200. nmot_ub_q40 0.00 10200. FORMAT "%5.0" /end CHARACTERISTIC
/begin CHARACTERISTIC NKTDUT "Untere Drehzahlgrenze Katdiagnose bei Testerbetrieb" VALUE 0xFD0346 KwWU8 10200. nmot_ub_q40 0.00 10200. FORMAT "%5.0" /end CHARACTERISTIC
/begin CHARACTERISTIC NMIDLU "Min. Drehzahl f¸r Ausblendung der Aussetzererkennung DMDDLU" VALUE 0xFC164C KwWU8 10200. nmot_ub_q40 0.00 10200. FORMAT "%5.0" /end CHARACTERISTIC
/begin CHARACTERISTIC OSCKTD "Schwelle Sauerstoffspeicherf‰higkeit des Kats f¸r Gut-Erkennung" VALUE 0xFD02F2 KwWU16 15.99976 fak_uw_b16 0.00 15.99976 FORMAT "%8.5" /end CHARACTERISTIC
/begin CHARACTERISTIC OSCKTDNG "Meﬂbereich  der normierten Sauerstoffspeicherf‰higkeit" VALUE 0xFD02F4 KwWU16 15.99976 fak_uw_b16 0.00 15.99976 FORMAT "%8.5" /end CHARACTERISTIC
/begin CHARACTERISTIC OSCKTDT "Schwelle Sauerstoffspeicherf‰higkeit des Kats bei Testerbetrieb" VALUE 0xFD02F6 KwWU16 15.99976 fak_uw_b16 0.00 15.99976 FORMAT "%8.5" /end CHARACTERISTIC
/begin CHARACTERISTIC RINNPH "Schwellwert zur Erkennung ""RI ist unplausibel hoch""" VALUE 0xFD021E KwWU16 2559.961 r_q0p0391 0.00 2559.961 FORMAT "%8.3" /end CHARACTERISTIC
/begin CHARACTERISTIC RISIGRESH "Schwelle f¸r Reset Signalunterbrechung mit Ri-Diagnose hinter KAT" VALUE 0xFD038A KwUw 131070.0 r_uw_q2 0.00 131070.0 FORMAT "%8.1" /end CHARACTERISTIC
/begin CHARACTERISTIC RKAE "Delta rkat- bzw. rkaz-Schwelle f¸r Erkennung der eingeschwungenen Grundadaption" VALUE 0xFD1AEE KwSw 3071.953 rel_sw_b1536 -1536.000 1535.953 FORMAT "%8.3" /end CHARACTERISTIC
/begin CHARACTERISTIC RKATDN "untere Diagnoseschwelle additive Korrektur pro Zeit" VALUE 0xFD1AF0 KwSw 3071.953 rel_sw_b1536 -1536.000 1535.953 FORMAT "%8.3" /end CHARACTERISTIC
/begin CHARACTERISTIC RKATDX "obere Diagnoseschwelle additive Korrektur pro Zeit" VALUE 0xFD1AF2 KwSw 3071.953 rel_sw_b1536 -1536.000 1535.953 FORMAT "%8.3" /end CHARACTERISTIC
/begin CHARACTERISTIC RKAZDN "untere Diagnoseschwelle additive Korrektur pro Z¸ndung" VALUE 0xFD1AF4 KwSw 3071.953 rel_sw_b1536 -1536.000 1535.953 FORMAT "%8.3" /end CHARACTERISTIC
/begin CHARACTERISTIC RKAZDX "obere Diagnoseschwelle additive Korrektur pro Z¸ndung" VALUE 0xFD1AF6 KwSw 3071.953 rel_sw_b1536 -1536.000 1535.953 FORMAT "%8.3" /end CHARACTERISTIC
/begin CHARACTERISTIC RLDLLR "F¸llungsschwelle f¸r Diagnose LLR" VALUE 0xFD3110 KwUb 99.75 rel_ub_q0p75 0.00 99.75 FORMAT "%5.2" /end CHARACTERISTIC
/begin CHARACTERISTIC SAFK1 "Filterkonstante 1 f¸r Lambdasonden-Signalausgabe" VALUE 0xFD03AE KwUw 0.9999847 fak_uw_b1 0.00 0.9999847 FORMAT "%9.7" /end CHARACTERISTIC
/begin CHARACTERISTIC SDISALERN "Schalter Start Lernvorgang UMA" VALUE 0xFD0840 KwUb 255.0 dez 0.00 255.0 FORMAT "%5.1" /end CHARACTERISTIC
/begin CHARACTERISTIC SDULSUMX "Schwelle delta Spannung max pro Rechentakt" VALUE 0xFC2064 KwWU16 31.99951 spg_q4p88Em4 0.00 31.99951 FORMAT "%8.5" /end CHARACTERISTIC
/begin AXIS_PTS SMI08DMUB "SST-Verteilung in DMD, 8 Moment-SST" 0xFC1D6C midmd SstAU8SstU8 99.61 rel_ub_b99p6 8 0.00 99.61 FORMAT "%5.2" DEPOSIT ABSOLUTE /end AXIS_PTS
/begin CHARACTERISTIC SMLDYN "Luftmassenschwelle f¸r Sondendynamik hinter KAT" VALUE 0xFD0370 KwUw 182.0417 m_q0p00277 0.00 182.0417 FORMAT "%8.4" /end CHARACTERISTIC
/begin AXIS_PTS SNM08DMUB "SST-Verteilung in DMD, 8 Drehzahl-SST" 0xFC1D75 nmot SstAU8SstU8 10200. nmot_ub_q40 8 0.00 10200. FORMAT "%5.0" DEPOSIT ABSOLUTE /end AXIS_PTS
/begin CHARACTERISTIC SRYAGR "Schwelle f¸r Readiness-Bildung Abgasr¸ckf¸hrungs-Diagnose" VALUE 0xFC14B2 KwUb 255.0 dez 0.00 255.0 FORMAT "%5.1" /end CHARACTERISTIC
/begin CHARACTERISTIC SRYHS "Schwelle f¸r Readiness-Bildung Sondenheizungs-Diagnose" VALUE 0xFC14B3 KwUb 255.0 dez 0.00 255.0 FORMAT "%5.1" /end CHARACTERISTIC
/begin CHARACTERISTIC SRYKAT "Schwelle f¸r Readiness-Bildung Katalysator-Diagnose" VALUE 0xFC14B4 KwUb 255.0 dez 0.00 255.0 FORMAT "%5.1" /end CHARACTERISTIC
/begin CHARACTERISTIC SRYLS "Schwelle f¸r Readiness-Bildung Lambdasonden-Diagnose" VALUE 0xFC14B5 KwUb 255.0 dez 0.00 255.0 FORMAT "%5.1" /end CHARACTERISTIC
/begin CHARACTERISTIC SRYSLS "Schwelle f¸r Readiness-Bildung Sekund‰rluft-Diagnose" VALUE 0xFC14B6 KwUb 255.0 dez 0.00 255.0 FORMAT "%5.1" /end CHARACTERISTIC
/begin CHARACTERISTIC SRYTES "Schwelle f¸r Readiness-Bildung Tankentl¸ftungs-Diagnose" VALUE 0xFCF93C KwUb 255.0 dez 0.00 255.0 FORMAT "%5.1" /end CHARACTERISTIC
/begin CHARACTERISTIC SULSUMN "Schwellwert f¸r Plausibilit‰tsfehler w‰hrend B_sa" VALUE 0xFD0220 KwWU16 31.99951 spg_q4p88Em4 0.00 31.99951 FORMAT "%8.5" /end CHARACTERISTIC
/begin CHARACTERISTIC TABGSTGK "Abgastemperaturschwelle f¸r Dynamik-Messung" VALUE 0xFC206C KwUw 1535.977 temp_q0p0234_o273 -273.1500 1262.827 FORMAT "%8.3" /end CHARACTERISTIC
/begin CHARACTERISTIC TADLLR "Ansauglufttemperaturschwelle f¸r Diagnose Leerlaufsteller" VALUE 0xFD3111 KwUb 191.3 temp_ub_q0p75_o48 -48.00 143.3 FORMAT "%5.1" /end CHARACTERISTIC
/begin CHARACTERISTIC TAHRLSUMN "Minimales Tastverh‰ltnis f¸r Endstufendiagnose" VALUE 0xFD056C KwUw 199.9969 rel_uw_b200 0.00 199.9969 FORMAT "%8.4" /end CHARACTERISTIC
/begin CHARACTERISTIC TALSUSMX "Maximaler Abgastemperatur-Schwellwert f¸r die Plausibilit‰tsdiagnose" VALUE 0xFD0222 KwWU16 1535.977 temp_q0p0234_o273 -273.1500 1262.827 FORMAT "%8.3" /end CHARACTERISTIC
/begin CHARACTERISTIC TAMDOGH "Modelltemperaturschwelle obere Grenze f¸r Diagnose Sonde hinter Kat" VALUE 0xFD038C KwUw 1535.977 temp_q0p0234_o273 -273.1500 1262.827 FORMAT "%8.3" /end CHARACTERISTIC
/begin CHARACTERISTIC TAMDUGH "Modelltemperaturschwelle untere Grenze f¸r Diagnose Sonde hinter Kat" VALUE 0xFD038E KwUw 1535.977 temp_q0p0234_o273 -273.1500 1262.827 FORMAT "%8.3" /end CHARACTERISTIC
/begin CHARACTERISTIC TAMSIGH "Abgastemperaturschwelle f¸r Signalunterbrechung mit Ri-Diagnose hinter KAT" VALUE 0xFD0390 KwUw 1535.977 temp_q0p0234_o273 -273.1500 1262.827 FORMAT "%8.3" /end CHARACTERISTIC
/begin CHARACTERISTIC TASIG "Zeit f¸r Ausblendung von Stˆrspitzen auﬂerhalb Band f¸r Erk. Signalunterbrechung" VALUE 0xFC2070 KwUb 5.100 t20msxs_ub_b5p1 0.00 5.100 FORMAT "%5.3" /end CHARACTERISTIC
/begin CHARACTERISTIC TAVSOVMMX "max. Abgastemperatur zur Erkennung einer Leitungsunterbrechung an VM" VALUE 0xFC2066 KwWU16 1535.977 temp_q0p0234_o273 -273.1500 1262.827 FORMAT "%8.3" /end CHARACTERISTIC
/begin CHARACTERISTIC TDCNPVVT "Zeit f¸r Fehlerrechnung (Aktiv.- oder Plaus.-fehler) VVT" VALUE 0xFC1322 KwWU8 2.550 t10msxs_ub_b2p55 0.00 2.550 FORMAT "%5.3" /end CHARACTERISTIC
/begin CHARACTERISTIC TDCVD "Zeit f¸r Timeouterkennung LOCAN-Schnittstelle VVT-SG Botschaft im 100ms Raster" VALUE 0xFC1323 KwWU8 25.50 t100msxs_ub_b25p5 0.00 25.50 FORMAT "%5.2" /end CHARACTERISTIC
/begin CHARACTERISTIC TDCVVT "Zeit f¸r Timeouterkennung LOCAN-Schnittstelle VVT-SG" VALUE 0xFC1324 KwWU8 2.550 t10msxs_ub_b2p55 0.00 2.550 FORMAT "%5.3" /end CHARACTERISTIC
/begin CHARACTERISTIC TDCVVTH "Zeit f¸r Heilung der LOCAN-Schnittstelle VVT-SG" VALUE 0xFC1325 KwWU8 2.550 t10msxs_ub_b2p55 0.00 2.550 FORMAT "%5.3" /end CHARACTERISTIC
/begin CHARACTERISTIC TDKUPNOG "Verzˆgerungszeit nach Gangwechsel bis erneute Gangwechselerk. mˆglich" VALUE 0xFD0534 KwUb 255.0 t1sxs_ub_b255 0.00 255.0 FORMAT "%5.1" /end CHARACTERISTIC
/begin CHARACTERISTIC TDLLR "Wartezeit bis setzen der Bedingung Diagnose Leerlaufsteller" VALUE 0xFD3114 KwUw 255.0000 t200msxs_ub_b51 0.00 255.0000 FORMAT "%8.4" /end CHARACTERISTIC
/begin CHARACTERISTIC TDLLRMN "Wartezeit bis Fehlereintrag Steller geschlossen" VALUE 0xFD3116 KwUw 255.0000 t200msxs_ub_b51 0.00 255.0000 FORMAT "%8.4" /end CHARACTERISTIC
/begin CHARACTERISTIC TDLLRMX "Wartezeit bis Fehlereintrag Steller offen" VALUE 0xFD3118 KwUw 255.0000 t200msxs_ub_b51 0.00 255.0000 FORMAT "%8.4" /end CHARACTERISTIC
/begin CHARACTERISTIC TDLLRNF "Wartezeit bis Meldung kein Fehler bei Leerlaufsteller" VALUE 0xFD311A KwUw 255.0000 t200msxs_ub_b51 0.00 255.0000 FORMAT "%8.4" /end CHARACTERISTIC
/begin CHARACTERISTIC TDLSVV "Entprellzeit f¸r Erkennung vertauschte Lambdasonden" VALUE 0xFD03B6 KwUw 6553.500 t100msxs_uw_b6553p5 0.00 6553.500 FORMAT "%8.3" /end CHARACTERISTIC
/begin CHARACTERISTIC TDWLSVV "Wartezeit f¸r Zyklusbit setzen Diagnose vertauschte Lambdasonden" VALUE 0xFD03B8 KwUw 6553.500 t100msxs_uw_b6553p5 0.00 6553.500 FORMAT "%8.3" /end CHARACTERISTIC
/begin CHARACTERISTIC TFDLLRO "Obere Schwelle f¸r Zeitfenster f¸r DLLR" VALUE 0xFD311C KwUw 6553.500 t100msxs_uw_b6553p5 0.00 6553.500 FORMAT "%8.3" /end CHARACTERISTIC
/begin CHARACTERISTIC TFDLLRU "Untere Schwelle f¸r Zeitfenster f¸r DLLR" VALUE 0xFD311E KwUw 6553.500 t100msxs_uw_b6553p5 0.00 6553.500 FORMAT "%8.3" /end CHARACTERISTIC
/begin CHARACTERISTIC TFRA "Erkennungszeit f¸r eingeschwungene Grundadaption von fra" VALUE 0xFD1AD4 KwUb 51.00 t200msxs_ub_b51 0.00 51.00 FORMAT "%5.2" /end CHARACTERISTIC
/begin CHARACTERISTIC TFRAOZ "Verweilzeit in FRAO f¸r Zyklusflag bei nicht eingeschw. Adaption" VALUE 0xFD1AD5 KwUb 51.00 t200msxs_ub_b51 0.00 51.00 FORMAT "%5.2" /end CHARACTERISTIC
/begin CHARACTERISTIC TFRAUZ "Verweilzeit in FRAU f¸r Zyklusflag bei nicht eingeschw. Adaption" VALUE 0xFD1AD6 KwUb 51.00 t200msxs_ub_b51 0.00 51.00 FORMAT "%5.2" /end CHARACTERISTIC
/begin CHARACTERISTIC TFRMST "Erkennungszeit f¸r eingeschwungene Grundadaption von frm" VALUE 0xFD1AD7 KwUb 51.00 t200msxs_ub_b51 0.00 51.00 FORMAT "%5.2" /end CHARACTERISTIC
/begin CHARACTERISTIC TFRMZST "Verweilzeit f¸r unplausibles frm-Signal (Kurztest)" VALUE 0xFD1AD8 KwUb 51.00 t200msxs_ub_b51 0.00 51.00 FORMAT "%5.2" /end CHARACTERISTIC
/begin CHARACTERISTIC TKTDGRA "Zeit f¸r Tempereraturgradientenmessung der Katdiagnose" VALUE 0xFD0347 KwWU8 51.00 t_q0p2 0.00 51.00 FORMAT "%5.2" /end CHARACTERISTIC
/begin CHARACTERISTIC TKTDSP "Wartezeit in der Katdiagnose auf die Schubpr¸fung" VALUE 0xFD0330 KwWU16 13107.00 t_q0p2 0.00 13107.00 FORMAT "%8.2" /end CHARACTERISTIC
/begin CHARACTERISTIC TKTDTO "Time Out bei Fettbef¸llung Katalysatordiagnose" VALUE 0xFD0308 KwWU8 51.00 t_q0p2 0.00 51.00 FORMAT "%5.2" /end CHARACTERISTIC
/begin CHARACTERISTIC TKWPWMDMN "Minimales Tastverh‰ltnis Ansteuerung Kennfeldthermostat Endst.Diag." VALUE 0xFD056E KwWS16 6553.500 fak_q0p1 -3276.800 3276.700 FORMAT "%8.3" /end CHARACTERISTIC
/begin CHARACTERISTIC TKWPWMDMX "Maximales Tastverh‰ltnis Ansteuerung Kennfeldthermostat Endst.Diag." VALUE 0xFD0570 KwWS16 6553.500 fak_q0p1 -3276.800 3276.700 FORMAT "%8.3" /end CHARACTERISTIC
/begin CHARACTERISTIC TLLASH "Verzˆg.zeit um lamlash_w zu sperren wenn lamsons_w ungleich lamlash_w ist" VALUE 0xFD034C KwUb 25.50 t100msxs_ub_b25p5 0.00 25.50 FORMAT "%5.2" /end CHARACTERISTIC
/begin CHARACTERISTIC TMAXKATA "Maximale Kat.-Temperatur f¸r Ausr‰umpr¸fung bei Katdiagnose" VALUE 0xFD02F8 KwWU16 1535.977 temp_q0p0234_o273 -273.1500 1262.827 FORMAT "%8.3" /end CHARACTERISTIC
/begin CHARACTERISTIC TMAXKATS "maximale Kat-Temperatur f¸r Kat-diagnose" VALUE 0xFD0332 KwWU16 1535.977 temp_q0p0234_o273 -273.1500 1262.827 FORMAT "%8.3" /end CHARACTERISTIC
/begin CHARACTERISTIC TMAXKATSO "maximale Kat-Temperatur f¸r Kat-diagnose, oberes Band" VALUE 0xFD0334 KwWU16 1535.977 temp_q0p0234_o273 -273.1500 1262.827 FORMAT "%8.3" /end CHARACTERISTIC
/begin CHARACTERISTIC TMDLLR "Motortemperaturschwelle f¸r Diagnose Leerlaufsteller" VALUE 0xFD3112 KwUb 191.3 temp_ub_q0p75_o48 -48.00 143.3 FORMAT "%5.1" /end CHARACTERISTIC
/begin CHARACTERISTIC TMFRST "Einschalttemperatur LR- Kurztest" VALUE 0xFD1AD9 KwUb 191.3 temp_ub_q0p75_o48 -48.00 143.3 FORMAT "%5.1" /end CHARACTERISTIC
/begin CHARACTERISTIC TMINKATS "Minimale Kat-Temperatur f¸r ‹berwachung" VALUE 0xFD0336 KwWU16 1535.977 temp_q0p0234_o273 -273.1500 1262.827 FORMAT "%8.3" /end CHARACTERISTIC
/begin CHARACTERISTIC TMINKATSO "Minimale Kat-Temperatur f¸r ‹berwachung, oberes Band" VALUE 0xFD0338 KwWU16 1535.977 temp_q0p0234_o273 -273.1500 1262.827 FORMAT "%8.3" /end CHARACTERISTIC
/begin CHARACTERISTIC TMNKATST "Minimale Kat-Temperatur f¸r ‹berwachung bei Testerbetrieb" VALUE 0xFD033A KwWU16 1535.977 temp_q0p0234_o273 -273.1500 1262.827 FORMAT "%8.3" /end CHARACTERISTIC
/begin CHARACTERISTIC TMSH "Motortemperaturschwelle f¸r Erkennung Kaltstart f¸r Messung Sonde hinter KAT" VALUE 0xFD037E KwUb 191.3 temp_ub_q0p75_o48 -48.00 143.3 FORMAT "%5.1" /end CHARACTERISTIC
/begin CHARACTERISTIC TMSHA "Motorabstelltemperaturschwelle f¸r Messung Abk¸hlung Sonde hinter KAT" VALUE 0xFD037F KwUb 191.3 temp_ub_q0p75_o48 -48.00 143.3 FORMAT "%5.1" /end CHARACTERISTIC
/begin CHARACTERISTIC TMSUKTDS "Minimale tmot-Start-Temperatur f¸r Katdiagnose" VALUE 0xFD0348 KwWU8 191.3 temp_ub_q0p75_o48 -48.00 143.3 FORMAT "%5.1" /end CHARACTERISTIC
/begin CHARACTERISTIC TMXKATST "Maximale Kat-Temperatur f¸r ‹berwachung bei Testerbetrieb" VALUE 0xFD033C KwWU16 1535.977 temp_q0p0234_o273 -273.1500 1262.827 FORMAT "%8.3" /end CHARACTERISTIC
/begin CHARACTERISTIC TNSTDNH "Zeit nach Start f¸r Diagnose Adernschluﬂ (Monoflop)" VALUE 0xFC2071 KwUb 5.100 t20msxs_ub_b5p1 0.00 5.100 FORMAT "%5.3" /end CHARACTERISTIC
/begin CHARACTERISTIC TRIPFASH "Kurztrip: Mindest Zeitdauer f¸r aktive Lamda Regelung vor KAT" VALUE 0xFD0372 KwUw 6553.500 t100msxs_uw_b6553p5 0.00 6553.500 FORMAT "%8.3" /end CHARACTERISTIC
/begin CHARACTERISTIC TRKA "Erkennungszeit f¸r eingeschwungene Grundadaption von rkat bzw. rkaz" VALUE 0xFD1ADA KwUb 51.00 t200msxs_ub_b51 0.00 51.00 FORMAT "%5.2" /end CHARACTERISTIC
/begin CHARACTERISTIC TRKATZ "Aktivierungszeit von rkat bis Setzen Zyklusflag, wenn B_gae = FALSE" VALUE 0xFD1ADB KwUb 51.00 t200msxs_ub_b51 0.00 51.00 FORMAT "%5.2" /end CHARACTERISTIC
/begin CHARACTERISTIC TRKAZZ "Aktivierungszeit von rkaz bis Setzen Zyklusflag, wenn B_gae = FALSE" VALUE 0xFD1ADC KwUb 51.00 t200msxs_ub_b51 0.00 51.00 FORMAT "%5.2" /end CHARACTERISTIC
/begin CHARACTERISTIC TRSAFA "‹berwachungszeit Kabelbruch hinter KAT: Funktions Anforderung f¸r Kurz-Trip-Test" VALUE 0xFD0392 KwUw 6553.500 t100msxs_uw_q100 0.00 6553.500 FORMAT "%8.3" /end CHARACTERISTIC
/begin CHARACTERISTIC TRSAH "‹berwachungszeit f¸r Kabelbruch (Spg. im Band) f¸r Sonde hinter KAT" VALUE 0xFD0394 KwUw 6553.500 t100msxs_uw_q100 0.00 6553.500 FORMAT "%8.3" /end CHARACTERISTIC
/begin CHARACTERISTIC TRSE "‹berwachungszeit -> Regelung ein" VALUE 0xFD0380 KwUb 25.50 t100msxs_ub_b25p5 0.00 25.50 FORMAT "%5.2" /end CHARACTERISTIC
/begin CHARACTERISTIC TSALASH "Zeit nach Schub f¸r ‹berpr¸fung Sonde hinter KAT" VALUE 0xFD034D KwUb 25.50 t100msxs_ub_b25p5 0.00 25.50 FORMAT "%5.2" /end CHARACTERISTIC
/begin CHARACTERISTIC TSKTDTK "Temperaturabh‰ngige Verzˆgerungszeit f¸r Katdiagnose" CURVE 0xFD030E KlAxU8SstxU16WU16 13107.00 t_q0p2 0.00 13107.00 FORMAT "%8.2"
 /begin AXIS_DESCR STD_AXIS tkdkthp_w temp_q0p0234 4 0.00 1535.977 FORMAT "%8.3" DEPOSIT ABSOLUTE /end AXIS_DESCR
/end CHARACTERISTIC
/begin CHARACTERISTIC TTBMH "Zeit f¸r theoretische Sondenbetriebsbereitschaft mit Heizung" VALUE 0xFD0396 KwUw 6553.500 t100msxs_uw_q100 0.00 6553.500 FORMAT "%8.3" /end CHARACTERISTIC
/begin CHARACTERISTIC TTLASH "Zeit f¸r Verweildauer der Sonde hinter KAT unter/oberhalb des Sollwertes" VALUE 0xFD0374 KwUw 6553.500 t100msxs_uw_b6553p5 0.00 6553.500 FORMAT "%8.3" /end CHARACTERISTIC
/begin CHARACTERISTIC TUSCHUB "Verzˆgerungszeit f¸r Stˆrspitzen bei Schubpr¸fung der Sonde hinter KAT" VALUE 0xFD034E KwUb 25.50 t100msxs_ub_b25p5 0.00 25.50 FORMAT "%5.2" /end CHARACTERISTIC
/begin CHARACTERISTIC TUSEHKH "Verzˆgerungszeit nach Taupunktende f¸r Enable Messung HZ-Kopplung  hinter KAT" VALUE 0xFD0398 KwUw 6553.500 t100msxs_uw_q100 0.00 6553.500 FORMAT "%8.3" /end CHARACTERISTIC
/begin CHARACTERISTIC TUSENLASH "Zeitdauer bis Sonden Mager/Fett Erkennung erlaubt hinter Kat" VALUE 0xFD0376 KwUw 6553.500 t100msxs_uw_b6553p5 0.00 6553.500 FORMAT "%8.3" /end CHARACTERISTIC
/begin CHARACTERISTIC TUSHKRFM "Zeitdauer bis zur Freig. Wiederholungsmess. Schwingungspr. (Reset F/M-Flip-Flop)" VALUE 0xFD0378 KwUw 6553.500 t100msxs_uw_b6553p5 0.00 6553.500 FORMAT "%8.3" /end CHARACTERISTIC
/begin CHARACTERISTIC TUSHKVL "Verzˆgerungszeit f¸r Stˆrspitzen bei Vollastpr¸fung der Sonde hinter KAT" VALUE 0xFD034F KwUb 25.50 t100msxs_ub_b25p5 0.00 25.50 FORMAT "%5.2" /end CHARACTERISTIC
/begin CHARACTERISTIC TUSHSMIN "Mindestdauer f¸r Steigungsmessung f¸r enable Filter hinter Kat" VALUE 0xFD0350 KwUb 25.50 t100msxs_ub_b25p5 0.00 25.50 FORMAT "%5.2" /end CHARACTERISTIC
/begin CHARACTERISTIC TUSHZFH "Zeitfenster f¸r Messung Heizertakt-Einkopplung  auf Sondensignal hinter  KAT" VALUE 0xFC2072 KwUb 2.550 t10msxs_ub_b2p55 0.00 2.550 FORMAT "%5.3" /end CHARACTERISTIC
/begin CHARACTERISTIC TUSKS "Entstˆrzeit f¸r Abschalten einzelner Funktionen Sonde hinter KAT" VALUE 0xFC2073 KwUb 5.100 t20msxs_ub_b5p1 0.00 5.100 FORMAT "%5.3" /end CHARACTERISTIC
/begin CHARACTERISTIC TUSLASH "Testzeit f¸t Dauer Anfettung/Abmagerung hinter KAT" VALUE 0xFD037A KwUw 6553.500 t100msxs_uw_b6553p5 0.00 6553.500 FORMAT "%8.3" /end CHARACTERISTIC
/begin CHARACTERISTIC TUSMAX "‹berwachungszeit f¸r Usmax" VALUE 0xFD0381 KwUb 25.50 t100msxs_ub_b25p5 0.00 25.50 FORMAT "%5.2" /end CHARACTERISTIC
/begin CHARACTERISTIC TUSMSVL "Zeit nach Vollast f¸r ‹berpr¸fung Sonde hinter KAT" VALUE 0xFD0351 KwUb 25.50 t100msxs_ub_b25p5 0.00 25.50 FORMAT "%5.2" /end CHARACTERISTIC
/begin CHARACTERISTIC TUSSA "Verzˆgerungszeit nach ‹ber/Unterschreiten der Regelschwelle hinter KAT" VALUE 0xFD0352 KwUb 25.50 t100msxs_ub_b25p5 0.00 25.50 FORMAT "%5.2" /end CHARACTERISTIC
/begin CHARACTERISTIC TUSTAL "Verzˆg.zeit f¸r Erkennung Adernschluﬂ nach ""Tank leer"" fahren f¸r Sonde h. KAT" VALUE 0xFD039A KwUw 6553.500 t100msxs_uw_q100 0.00 6553.500 FORMAT "%8.3" /end CHARACTERISTIC
/begin CHARACTERISTIC TUSTALLASH "Verzˆg.zeit f¸r Erkennung B_maxlash nach ""Tank leer"" fahren f¸r Sonde h. KAT" VALUE 0xFD037C KwUw 6553.500 t100msxs_uw_b6553p5 0.00 6553.500 FORMAT "%8.3" /end CHARACTERISTIC
/begin CHARACTERISTIC TVDESHLSU "Verz.-Zeit nach  Ablauf der Startrampe bis zum Aktivieren d. Diag. an VM/UN" VALUE 0xFD0232 KwWU8 25.50 t_q0p1 0.00 25.50 FORMAT "%5.2" /end CHARACTERISTIC
/begin CHARACTERISTIC TVDFRZAIP "Einschwingzeit w‰hrend der dfrza > DFRZASNAMN gilt" VALUE 0xFD0233 KwWU8 25.50 t_q0p1 0.00 25.50 FORMAT "%5.2" /end CHARACTERISTIC
/begin CHARACTERISTIC TVDIERR "Tastverh‰ltnis zum anfahren der Failsafestellung" VALUE 0xFD0906 KwSw 199.997 vnstv_q0p00305 -100.000 99.9969 FORMAT "%7.3" /end CHARACTERISTIC
/begin CHARACTERISTIC TVDIWISCH1 "Tastverh‰ltnis zum wichen in Richtung 1" VALUE 0xFD0908 KwSw 199.997 vnstv_q0p00305 -100.000 99.9969 FORMAT "%7.3" /end CHARACTERISTIC
/begin CHARACTERISTIC TVDIWISCH2 "Tastverh‰ltnis zum wischen in Richtung 2" VALUE 0xFD090A KwSw 199.997 vnstv_q0p00305 -100.000 99.9969 FORMAT "%7.3" /end CHARACTERISTIC
/begin CHARACTERISTIC TVKTDLE "Verzˆgerungszeit bis Lambda eingeschwungen bei Katdiagnose" VALUE 0xFD0309 KwWU8 12.75 t_q0p05 0.00 12.75 FORMAT "%5.2" /end CHARACTERISTIC
/begin CHARACTERISTIC TVKTDRX "Maximale Fettzeit f¸r hintere Sondenspannung bei Katdiagnose" VALUE 0xFD030A KwWU8 5.100 t_q0p02 0.00 5.100 FORMAT "%5.3" /end CHARACTERISTIC
/begin CHARACTERISTIC TVLSUDIP "Verzˆgerungszeit zum Setzen der Bedingung ""Sondenspannung nahe 1,5V (B_lsudip)" VALUE 0xFD0234 KwWU8 25.50 t_q0p1 0.00 25.50 FORMAT "%5.2" /end CHARACTERISTIC
/begin CHARACTERISTIC TVLSUTRIM "Verzˆgerungszeit f¸r Fehler LSU Abgleichleitung unterbrochen" VALUE 0xFD0235 KwWU8 25.50 t_q0p1 0.00 25.50 FORMAT "%5.2" /end CHARACTERISTIC
/begin CHARACTERISTIC TVLSUTRIMZ "Verzˆgerungszeit f¸r Heilung / Z-Flag LSU Abgleichleitung" VALUE 0xFD0236 KwWU8 25.50 t_q0p1 0.00 25.50 FORMAT "%5.2" /end CHARACTERISTIC
/begin CHARACTERISTIC TVLSUUMN "Verzˆgerungszeit Erkennung Fehler, Spannung im Schub zu klein" VALUE 0xFD0237 KwWU8 25.50 t_q0p1 0.00 25.50 FORMAT "%5.2" /end CHARACTERISTIC
/begin CHARACTERISTIC TVOCIPLL "Verzˆgerungszeit bis zum Setzen des Fehlers Leitungsunterbrechung IP (""frm"")" VALUE 0xFD0238 KwWU8 25.50 t_q0p1 0.00 25.50 FORMAT "%5.2" /end CHARACTERISTIC
/begin CHARACTERISTIC TVRINNPH "Verzˆgerungszeit bis zum Stoppen des 3kHz-Taktes nachd. der Ri unplaus. hoch ist" VALUE 0xFD0239 KwWU8 25.50 t_q0p1 0.00 25.50 FORMAT "%5.2" /end CHARACTERISTIC
/begin CHARACTERISTIC TVSERSL "Verzˆgerungszeit zum setzten eines Fehlers f¸r die Sondenleitungsdiangose" VALUE 0xFD023A KwWU8 25.50 t_q0p1 0.00 25.50 FORMAT "%5.2" /end CHARACTERISTIC
/begin CHARACTERISTIC TVSHEIP "Entprellzeit zum Setzen des Zyklusflags Z_lsuip" VALUE 0xFD0224 KwWU16 6553.500 t_q0p1 0.00 6553.500 FORMAT "%8.3" /end CHARACTERISTIC
/begin CHARACTERISTIC TVSHESL "Verzˆgerungszeit zum Heilen von Sondenleitungsfehlern" VALUE 0xFD023B KwWU8 25.50 t_q0p1 0.00 25.50 FORMAT "%5.2" /end CHARACTERISTIC
/begin CHARACTERISTIC TVSNPFNA "Verzˆgerungszeit in der Stˆrungen bei der Entprellung unterdr¸ckt werden" VALUE 0xFD023C KwWU8 25.50 t_q0p1 0.00 25.50 FORMAT "%5.2" /end CHARACTERISTIC
/begin CHARACTERISTIC TWDKATS "Wartezeit nach Stoppbedingung f¸r Filter und Integrator" VALUE 0xFD0349 KwWU8 12.75 t_q0p05 0.00 12.75 FORMAT "%5.2" /end CHARACTERISTIC
/begin CHARACTERISTIC TWDLSSA "Mindestpr¸fzeit f¸r DLSSA-Extremwertbestimmung" VALUE 0xFD03B0 KwUw 3276.750 t50msxs_uw_b3276p75 0.00 3276.750 FORMAT "%8.3" /end CHARACTERISTIC
/begin CHARACTERISTIC T_DIERR "Verzˆgerungszeit nach Fehler" VALUE 0xFD090C KwUw 655.3500 t10msxs_uw_b655p35 0.00 655.3500 FORMAT "%8.4" /end CHARACTERISTIC
/begin CHARACTERISTIC T_DIWISCH1 "Wischzeit f¸r 1. Richtung" VALUE 0xFD090E KwUw 655.3500 t10msxs_uw_b655p35 0.00 655.3500 FORMAT "%8.4" /end CHARACTERISTIC
/begin CHARACTERISTIC T_DIWISCH2 "Wischzeit f¸r 2. Richtung" VALUE 0xFD0910 KwUw 655.3500 t10msxs_uw_b655p35 0.00 655.3500 FORMAT "%8.4" /end CHARACTERISTIC
/begin CHARACTERISTIC UAOCUNMN "untere plausible IC-Ausgangsspannung UA zum Erkennung einer Unterbrechung an UN" VALUE 0xFD0226 KwWU16 31.99951 spg_q4p88Em4 0.00 31.99951 FORMAT "%8.5" /end CHARACTERISTIC
/begin CHARACTERISTIC UAOCUNMX "obere plausible IC-Ausgangsspannung UA zum Erkennung einer Unterbrechung an UN" VALUE 0xFD0228 KwWU16 31.99951 spg_q4p88Em4 0.00 31.99951 FORMAT "%8.5" /end CHARACTERISTIC
/begin CHARACTERISTIC UAOCVMMN "untere plausible IC-Ausgangsspannung UA zum Erkennung einer Unterbrechung an VM" VALUE 0xFD022A KwWU16 31.99951 spg_q4p88Em4 0.00 31.99951 FORMAT "%8.5" /end CHARACTERISTIC
/begin CHARACTERISTIC UAOCVMMX "obere plausible IC-Ausgangsspannung UA zum Erkennung einer Unterbrechung an VM" VALUE 0xFD022C KwWU16 31.99951 spg_q4p88Em4 0.00 31.99951 FORMAT "%8.5" /end CHARACTERISTIC
/begin CHARACTERISTIC UASNAMN "Untere Schwelle zur Erkennung Sondenleitungsunterbrechung IP" VALUE 0xFD022E KwWU16 31.99951 spg_q4p88Em4 0.00 31.99951 FORMAT "%8.5" /end CHARACTERISTIC
/begin CHARACTERISTIC UASNAMX "Obere Schwelle zur Erkennung Sondenleitungsunterbrechung IP" VALUE 0xFD0230 KwWU16 31.99951 spg_q4p88Em4 0.00 31.99951 FORMAT "%8.5" /end CHARACTERISTIC
/begin CHARACTERISTIC UBDLS "Batteriespannungsschwelle zur Freigabe der Sonden-Diagnose" VALUE 0xFD0382 KwUb 24.02 spg_ubatt 0.00 24.02 FORMAT "%5.2" /end CHARACTERISTIC
/begin CHARACTERISTIC UDKRGOFS "Spannungsschwelle f¸r DIA/KR Grundoffset Verst‰rker" VALUE 0xFC831C KwUb 4.980 spg_ub_b5 0.00 4.980 FORMAT "%5.3" /end CHARACTERISTIC
/begin CHARACTERISTIC UDKRTP "Integratorspannungsschwelle f¸r Dia KS - Auswerteschaltung Testimpuls" VALUE 0xFC8339 KwUb 4.980 spg_ub_b5 0.00 4.980 FORMAT "%5.3" /end CHARACTERISTIC
/begin CHARACTERISTIC UDKSNO "Obere Referenzspannungsschwelle DIA KS" CURVE 0xFC8292 KlAxU8SstxU16WU16 319.9813 spg_uw_b1280 0.00 319.9813 FORMAT "%8.4"
 /begin AXIS_DESCR STD_AXIS nmot nmot_ub_q40 16 0.00 10200. FORMAT "%5.0" DEPOSIT ABSOLUTE /end AXIS_DESCR
/end CHARACTERISTIC
/begin CHARACTERISTIC UDKSNU "untere Referenzspannungsschwelle DIA KS" CURVE 0xFC82D4 KlAxU8SstxU16WU16 319.9813 spg_uw_b1280 0.00 319.9813 FORMAT "%8.4"
 /begin AXIS_DESCR STD_AXIS nmot nmot_ub_q40 16 0.00 10200. FORMAT "%5.0" DEPOSIT ABSOLUTE /end AXIS_DESCR
/end CHARACTERISTIC
/begin CHARACTERISTIC USHKTDM "Magerschwelle der hinteren Sonde bei Katdiagnose" VALUE 0xFD030B KwWU8 1.330 spg_ub_q0p0052_o0p2 -0.2000 1.130 FORMAT "%5.3" /end CHARACTERISTIC
/begin CHARACTERISTIC USHKTDR "Schwelle hintere Sondenspannung f¸r Referenzmessung" VALUE 0xFD030C KwWU8 1.330 spg_ub_q0p0052_o0p2 -0.2000 1.130 FORMAT "%5.3" /end CHARACTERISTIC
/begin CHARACTERISTIC USHKTDRX "Maximalwert der hinteren Sondenspannung f¸r Referenzmessung" VALUE 0xFD030D KwWU8 1.330 spg_ub_q0p0052_o0p2 -0.2000 1.130 FORMAT "%5.3" /end CHARACTERISTIC
/begin CHARACTERISTIC USHKVL "Schwellwert f¸r Sondenspannung hinter KAT im Vollast-Betrieb" VALUE 0xFD0353 KwUb 1.330 spg_ub_q0p0052_o0p2 -0.2000 1.130 FORMAT "%5.3" /end CHARACTERISTIC
/begin CHARACTERISTIC USHLEAN "Schwelle f¸r Magerspannung f¸r Reset Dynamikmessung der Sonde hinter KAT" VALUE 0xFC2068 KwUb 1.330 spg_ub_q0p0052_o0p2 -0.2000 1.130 FORMAT "%5.3" /end CHARACTERISTIC
/begin CHARACTERISTIC USHRICH "Schwelle f¸r Fettspannung f¸r g¸ltige Dynamikmessung der Sonde hinter KAT" VALUE 0xFC2069 KwUb 1.330 spg_ub_q0p0052_o0p2 -0.2000 1.130 FORMAT "%5.3" /end CHARACTERISTIC
/begin CHARACTERISTIC USHSTGMX "Wert f¸r maximale Steigung f¸r Startwert Filter" VALUE 0xFD0354 KwUb 132.6 spgg_q0p52 0.00 132.6 FORMAT "%5.1" /end CHARACTERISTIC
/begin CHARACTERISTIC USHSTSOLL "Schwelle f¸r zul‰ssige Steigung der Sondenspannung hinter KAT" VALUE 0xFD0355 KwUb 132.6 spgg_q0p52 0.00 132.6 FORMAT "%5.1" /end CHARACTERISTIC
/begin CHARACTERISTIC USIVMAXH "Init value f¸r max.Sondenspg. hinter Kat nach Powerfail u. Fehlersp. lˆschen" VALUE 0xFD03A6 KwUb 1.330 spg_ub_b1p33 0.00 1.330 FORMAT "%5.3" /end CHARACTERISTIC
/begin CHARACTERISTIC USIVMINH "Init value f¸r min.Sondenspg. hinter Kat nach Powerfail u. Fehlersp. lˆschen" VALUE 0xFD03A7 KwUb 1.330 spg_ub_b1p33 0.00 1.330 FORMAT "%5.3" /end CHARACTERISTIC
/begin CHARACTERISTIC USMAX "Schwelle f¸r Sondenkurzschluﬂ nach Ubat" VALUE 0xFC2076 KwUw 319.9951 spg_uw_q0p00488_o1 -1.000000 318.9951 FORMAT "%8.4" /end CHARACTERISTIC
/begin CHARACTERISTIC USMIN "Schwelle f¸r Sondenkurzschluﬂ nach Masse" VALUE 0xFC2078 KwUw 319.9951 spg_uw_q0p00488_o1 -1.000000 318.9951 FORMAT "%8.4" /end CHARACTERISTIC
/begin CHARACTERISTIC USMNSHMN "min. erkannte Sondenspannung hinter Kat f¸r Signalausgabe (min. plaus. Wert)" VALUE 0xFD03A8 KwUb 1.330 spg_ub_b1p33 0.00 1.330 FORMAT "%5.3" /end CHARACTERISTIC
/begin CHARACTERISTIC USMNSHMX "min. erkannte Sondenspannung hinter Kat f¸r Signalausgabe (max. plaus. Wert)" VALUE 0xFD03A9 KwUb 1.330 spg_ub_b1p33 0.00 1.330 FORMAT "%5.3" /end CHARACTERISTIC
/begin CHARACTERISTIC USMXSHMN "max. erkannte Sondenspannung hinter Kat f¸r Signalausgabe (min. plaus. Wert)" VALUE 0xFD03AA KwUb 1.330 spg_ub_b1p33 0.00 1.330 FORMAT "%5.3" /end CHARACTERISTIC
/begin CHARACTERISTIC USMXSHMX "max. erkannte Sondenspannung hinter Kat f¸r Signalausgabe (max. plaus. Wert)" VALUE 0xFD03AB KwUb 1.330 spg_ub_b1p33 0.00 1.330 FORMAT "%5.3" /end CHARACTERISTIC
/begin CHARACTERISTIC USREFH "Schwelle f¸r Sondenbetriebsbereitschaft hinter KAT bei fettem Gemisch" VALUE 0xFD039C KwUw 319.9951 spg_uw_q0p00488_o1 -1.000000 318.9951 FORMAT "%8.4" /end CHARACTERISTIC
/begin CHARACTERISTIC USREFHKLT "Schwelle f¸r Sondenbetriebsbereitschaft h. KAT bei fettem Gemisch im Kaltbetrieb" VALUE 0xFD039E KwUw 319.9951 spg_uw_q0p00488_o1 -1.000000 318.9951 FORMAT "%8.4" /end CHARACTERISTIC
/begin CHARACTERISTIC USREMH "Schwelle f¸r Sondenbetriebsbereitschaft hinter KAT bei magerem Gemisch" VALUE 0xFC207A KwUw 319.9951 spg_uw_q0p00488_o1 -1.000000 318.9951 FORMAT "%8.4" /end CHARACTERISTIC
/begin CHARACTERISTIC USRHKSHJ "Regelschwelle f¸r Regelung hinter Kat, DLSSA-Ausgabe umgerechn. Wert" VALUE 0xFD03AC KwUb 1.330 spg_ub_b1p33 0.00 1.330 FORMAT "%5.3" /end CHARACTERISTIC
/begin CHARACTERISTIC USRJ "" VALUE 0xFD03AD KwUb 1.330 spg_ub_b1p33 0.00 1.330 FORMAT "%5.3" /end CHARACTERISTIC
/begin CHARACTERISTIC USSCHUB "Schwelle f¸r Sondenspannung hinter KAT nach Schub" VALUE 0xFD0356 KwUb 1.330 spg_ub_q0p0052_o0p2 -0.2000 1.130 FORMAT "%5.3" /end CHARACTERISTIC
/begin CHARACTERISTIC VDKUPPLMN "min. vfzg-Schwelle f¸r Diagnose Kupplungsschalter" VALUE 0xFD0535 KwUb 318.8 vfzg_ub_q1p25 0.00 318.8 FORMAT "%5.1" /end CHARACTERISTIC
/begin CHARACTERISTIC WLSU "Kennfeld Sollwert f¸r geregelten Betrieb" MAP 0xFD0841 KfAxUbAyUbSstxUbSstyUbWUb 99.61 PCENT 0.00 99.61 FORMAT "%5.2"
 /begin AXIS_DESCR STD_AXIS nmot nmot_ub_q40 8 0.00 10200. FORMAT "%5.0" DEPOSIT ABSOLUTE /end AXIS_DESCR
 /begin AXIS_DESCR STD_AXIS rl rel_ub_q0p75 12 0.00 191.3 FORMAT "%5.1" DEPOSIT ABSOLUTE /end AXIS_DESCR
/end CHARACTERISTIC
/begin CHARACTERISTIC ZDIWICNTMX "Warmupcyclen seit letztem wischen" VALUE 0xFC239A KwWU8 255.0 dez 0.00 255.0 FORMAT "%5.1" /end CHARACTERISTIC
/begin CHARACTERISTIC ZFRMST "Zeitkonstante f¸r frm-Filter (short test)" VALUE 0xFD1ADD KwUb 50.9992 zk200msxs_ub_b51p2 0.200784 51.2000 FORMAT "%7.4" /end CHARACTERISTIC
/begin CHARACTERISTIC ZHKOCVMMX "max. Anzahl von Heizereinkopplungen bei hohem Ri" VALUE 0xFD023D KwWU8 255.0 dez 0.00 255.0 FORMAT "%5.1" /end CHARACTERISTIC
/begin CHARACTERISTIC ZKTDML "Tiefpaﬂ-Filterzeitkonstante f¸r Luftmasse" VALUE 0xFD033E KwWU16 3276.7499992 zk50msxs_uw_b3276p8 0.050000762951 3276.8000000 FORMAT "%12.7" /end CHARACTERISTIC
/begin CHARACTERISTIC ZKTDTK "Tiefpaﬂ-Filterzeitkonstante f¸r Temperatur-Filterung" VALUE 0xFD0340 KwWU16 13106.800000 zk200msxs_uw_b13107 0.20000000000 13107.000000 FORMAT "%12.6" /end CHARACTERISTIC
/begin CHARACTERISTIC ZLUTSFI "Zeitkonstante f¸r Filterung Laufunruhe-Testgrˆﬂe" VALUE 0xFC1654 KwWR32 20000.000000000000 fak_r32_1 -10000.000000000000 10000.000000000000 FORMAT "%27.21" /end CHARACTERISTIC
/begin CHARACTERISTIC ZWISCHMX "Anzahl Wischvorg‰nge" VALUE 0xFD08B7 KwUb 255.0 dez 0.00 255.0 FORMAT "%5.1" /end CHARACTERISTIC
/begin MEASUREMENT anzgangw "Anzahl erkannter Gangwechsel" UBYTE dez 1 100 0 255 FORMAT "%5.1" ECU_ADDRESS 0x402BEA /end MEASUREMENT
/begin MEASUREMENT anzkupplb "Anzahl erkannter Kupplungsbet‰tigungen" UBYTE dez 1 100 0 255 FORMAT "%5.1" ECU_ADDRESS 0x402BEB /end MEASUREMENT
/begin MEASUREMENT apdkt "Anzahl der Pr¸fungen, Katdiagnose" UBYTE dez 1 100 0 255 FORMAT "%5.1" ECU_ADDRESS 0x402ACA /end MEASUREMENT
/begin MEASUREMENT apdkt2 "Anzahl der Pr¸fungen, Katdiagnose" UBYTE dez 1 100 0 255 FORMAT "%5.1" ECU_ADDRESS 0x402ACB /end MEASUREMENT
/begin MEASUREMENT apdkti "Interner Pr¸fungsanzahlz‰hler, Katdiagnose" UBYTE dez 1 100 0 255 FORMAT "%5.1" ECU_ADDRESS 0x402ACC /end MEASUREMENT
/begin MEASUREMENT apdkti2 "Interner Pr¸fungsanzahlz‰hler, Katdiagnose" UBYTE dez 1 100 0 255 FORMAT "%5.1" ECU_ADDRESS 0x402ACD /end MEASUREMENT
/begin MEASUREMENT apedkts "Anzahl der Pr¸fungen mit Fehlerergebnis bei Katdiagnose" UBYTE dez 1 100 0 255 FORMAT "%5.1" ECU_ADDRESS 0x402ACE /end MEASUREMENT
/begin MEASUREMENT apedkts2 "Anzahl der Pr¸fungen mit Fehlerergebnis bei Katdiagnose (Bank2)" UBYTE dez 1 100 0 255 FORMAT "%5.1" ECU_ADDRESS 0x402ACF /end MEASUREMENT
/begin MEASUREMENT apzdkt "Anzahl der i.O.-Pr¸fungen, Katdiagnose" UBYTE dez 1 100 0 255 FORMAT "%5.1" ECU_ADDRESS 0x402AD0 /end MEASUREMENT
/begin MEASUREMENT apzdkt2 "Anzahl der i.O.-Pr¸fungen, Katdiagnose" UBYTE dez 1 100 0 255 FORMAT "%5.1" ECU_ADDRESS 0x402AD1 /end MEASUREMENT
/begin MEASUREMENT avkatf "AmplitudenVerh‰ltnis laafh/laafv gefiltert" UBYTE fak_ub_b1 1 100 0 0.996094 ECU_ADDRESS 0x3FE08E /end MEASUREMENT
/begin MEASUREMENT avkatf2 "Amplitudenverh‰ltnis laafh/laafv gefiltert Bank2" UBYTE fak_ub_b1 1 100 0 0.996094 ECU_ADDRESS 0x3FE08F /end MEASUREMENT
/begin MEASUREMENT B_abgstg "Bedingung Modelltemperatur (tkatm od. tanhkm_w) hinter KAT ist oberhalb Schwelle" UBYTE B_TRUE 1 100 0 1 BIT_MASK 0x1 FORMAT "%13.11" ECU_ADDRESS 0x403B7D /end MEASUREMENT
/begin MEASUREMENT B_abgstg2 "Bedingung Modelltemp. (tkatm od. tanhkm_w) liegt oberhalb Schwelle Bank2" UBYTE B_TRUE 1 100 0 1 BIT_MASK 0x4 FORMAT "%13.11" ECU_ADDRESS 0x403B7D /end MEASUREMENT
/begin MEASUREMENT B_adsh "Bedingung Adernschluﬂ bei Lambdasonden hinter Kat" UBYTE B_TRUE 1 100 0 1 BIT_MASK 0x1 FORMAT "%13.11" ECU_ADDRESS 0x403B89 /end MEASUREMENT
/begin MEASUREMENT B_adsh2 "Bedingung Adernschluﬂ bei Lambdasonden hinter Kat Bank2" UBYTE B_TRUE 1 100 0 1 BIT_MASK 0x1 FORMAT "%13.11" ECU_ADDRESS 0x403B8A /end MEASUREMENT
/begin MEASUREMENT B_adshs "Bedingung Adernschluﬂ ""setzen"" bei Lambdasonden hinter Kat" UBYTE B_TRUE 1 100 0 1 BIT_MASK 0x2 FORMAT "%13.11" ECU_ADDRESS 0x403B89 /end MEASUREMENT
/begin MEASUREMENT B_adshs2 "Bedingung Adernschluﬂ ""setzen"" bei Lambdasonden hinter Kat Bank2" UBYTE B_TRUE 1 100 0 1 BIT_MASK 0x2 FORMAT "%13.11" ECU_ADDRESS 0x403B8A /end MEASUREMENT
/begin MEASUREMENT B_agrrdy "Bedingung AGR gepr¸ft f¸r 'ready-Byte'" UBYTE B_TRUE 1 100 0 1 BIT_MASK 0x80 FORMAT "%13.11" ECU_ADDRESS 0x3FDEF3 /end MEASUREMENT
/begin MEASUREMENT B_anzhzkh "Beding. Anzahl der Heizereinkoppl. zum Sonden Signal ist erreicht hinter KAT" UBYTE B_TRUE 1 100 0 1 BIT_MASK 0x1 FORMAT "%13.11" ECU_ADDRESS 0x3FC007 /end MEASUREMENT
/begin MEASUREMENT B_anzhzkh2 "Beding. Anz. der Heizereinkoppl. zum Sonden Signal ist erreicht hinter KAT Bank2" UBYTE B_TRUE 1 100 0 1 BIT_MASK 0x1 FORMAT "%13.11" ECU_ADDRESS 0x3FC008 /end MEASUREMENT
/begin MEASUREMENT B_anzhzoh "Bedingung Anzahl der Heizungs-Ausschaltungen ist erreicht hinter KAT" UBYTE B_TRUE 1 100 0 1 BIT_MASK 0x1 FORMAT "%13.11" ECU_ADDRESS 0x3FC009 /end MEASUREMENT
/begin MEASUREMENT B_anzhzoh2 "Bedingung Anzahl der Heizungs-Ausschaltungen ist erreicht hinter KAT Bank2" UBYTE B_TRUE 1 100 0 1 BIT_MASK 0x1 FORMAT "%13.11" ECU_ADDRESS 0x3FC00A /end MEASUREMENT
/begin MEASUREMENT B_binsti "Bedingung bin‰re Stoppbedingung intern, bank¸bergreifend" UBYTE B_TRUE 1 100 0 1 BIT_MASK 0x1 FORMAT "%13.11" ECU_ADDRESS 0x402AEF /end MEASUREMENT
/begin MEASUREMENT B_binstop "Bedingung bin‰re Stoppbedingung, bank¸bergreifend" UBYTE B_TRUE 1 100 0 1 BIT_MASK 0x2 FORMAT "%13.11" ECU_ADDRESS 0x402AF2 /end MEASUREMENT
/begin MEASUREMENT B_canoff "CAN Controller Zustand: BUS_OFF" UBYTE B_TRUE 1 100 0 1 BIT_MASK 0x1 FORMAT "%13.11" ECU_ADDRESS 0x40377F /end MEASUREMENT
/begin MEASUREMENT B_cdiagoff "Bedingung: CAN-Diagnose aus, bei Flashprogrammierung ¸ber CAN" UBYTE B_TRUE 1 100 0 1 BIT_MASK 0x1 FORMAT "%13.11" ECU_ADDRESS 0x403780 /end MEASUREMENT
/begin MEASUREMENT B_cldkt "Bedingung Fehlerpfad DKAT gelˆscht" UBYTE B_TRUE 1 100 0 1 BIT_MASK 0x4 FORMAT "%13.11" ECU_ADDRESS 0x402AD6 /end MEASUREMENT
/begin MEASUREMENT B_cldkt2 "Bedingung Fehlerpfad DKAT gelˆscht, Bank2" UBYTE B_TRUE 1 100 0 1 BIT_MASK 0x8 FORMAT "%13.11" ECU_ADDRESS 0x402AD6 /end MEASUREMENT
/begin MEASUREMENT B_ddylash "Bedingung Sonde hinter KAT dynamisch langsam" UBYTE B_TRUE 1 100 0 1 BIT_MASK 0x1 FORMAT "%13.11" ECU_ADDRESS 0x3FBFE1 /end MEASUREMENT
/begin MEASUREMENT B_ddylash2 "Bedingung Sonde hinter KAT dynamisch langsam `dynamisch` Bank2" UBYTE B_TRUE 1 100 0 1 BIT_MASK 0x1 FORMAT "%13.11" ECU_ADDRESS 0x3FBFE2 /end MEASUREMENT
/begin MEASUREMENT B_diagia "Diagnosebedingung Ip<|x| zur Kurzschluﬂerkennung an IA/IP ausschalten" UBYTE B_TRUE 1 100 0 1 BIT_MASK 0x4 FORMAT "%13.11" ECU_ADDRESS 0x402A75 /end MEASUREMENT
/begin MEASUREMENT B_diagia2 "Diagnosebedingung Ip<|x| zur Kurzschluﬂerkennung an IA/IP ausschalten" UBYTE B_TRUE 1 100 0 1 BIT_MASK 0x8 FORMAT "%13.11" ECU_ADDRESS 0x402A75 /end MEASUREMENT
/begin MEASUREMENT B_diagtimeout "" UBYTE B_TRUE 1 100 0 1 BIT_MASK 0x1 FORMAT "%13.11" ECU_ADDRESS 0x403781 /end MEASUREMENT
/begin MEASUREMENT B_disa "Rover" UBYTE B_TRUE 1 100 0 1 BIT_MASK 0x1 FORMAT "%13.11" ECU_ADDRESS 0x402C89 /end MEASUREMENT
/begin MEASUREMENT B_disalern "Wird gesetzt, sobald ein Lernvorgang erfolgreich war" UBYTE dez 1 100 0 255 FORMAT "%5.1" ECU_ADDRESS 0x3FE0E0 /end MEASUREMENT
/begin MEASUREMENT B_disa_ersatz "" UBYTE B_TRUE 1 100 0 1 BIT_MASK 0x1 FORMAT "%13.11" ECU_ADDRESS 0x3FC06A /end MEASUREMENT
/begin MEASUREMENT B_di_ausschalt "" UBYTE B_TRUE 1 100 0 1 BIT_MASK 0x2 FORMAT "%13.11" ECU_ADDRESS 0x402C89 /end MEASUREMENT
/begin MEASUREMENT B_di_einschalt "" UBYTE B_TRUE 1 100 0 1 BIT_MASK 0x4 FORMAT "%13.11" ECU_ADDRESS 0x402C89 /end MEASUREMENT
/begin MEASUREMENT B_dkifm "Integratorfreigabe f¸r Fett-Mager-Auswertung" UBYTE B_TRUE 1 100 0 1 BIT_MASK 0x10 FORMAT "%13.11" ECU_ADDRESS 0x402AD7 /end MEASUREMENT
/begin MEASUREMENT B_dkifm2 "Integratorfreigabe f¸r Fett-Mager-Auswertung, Bank2" UBYTE B_TRUE 1 100 0 1 BIT_MASK 0x10 FORMAT "%13.11" ECU_ADDRESS 0x402AD8 /end MEASUREMENT
/begin MEASUREMENT B_dkifma "Abbruch Integratorfreigabe f¸r Fett-Mager-Auswertung" UBYTE B_TRUE 1 100 0 1 BIT_MASK 0x2 FORMAT "%13.11" ECU_ADDRESS 0x402AD3 /end MEASUREMENT
/begin MEASUREMENT B_dkifma2 "Abbruch Integratorfreigabe f¸r Fett-Mager-Auswertung, Bank2" UBYTE B_TRUE 1 100 0 1 BIT_MASK 0x2 FORMAT "%13.11" ECU_ADDRESS 0x402AD4 /end MEASUREMENT
/begin MEASUREMENT B_dktb "Bedingung: Beginn der Katdiagnose" UBYTE B_TRUE 1 100 0 1 BIT_MASK 0x1 FORMAT "%13.11" ECU_ADDRESS 0x402AEE /end MEASUREMENT
/begin MEASUREMENT B_dktb2 "Bedingung: Beginn der Katdiagnose" UBYTE B_TRUE 1 100 0 1 BIT_MASK 0x1 FORMAT "%13.11" ECU_ADDRESS 0x402AF0 /end MEASUREMENT
/begin MEASUREMENT B_dktbi "Bedingung: Beginn der Katdiagnose, interne Bedingung" UBYTE B_TRUE 1 100 0 1 BIT_MASK 0x40 FORMAT "%13.11" ECU_ADDRESS 0x402AEE /end MEASUREMENT
/begin MEASUREMENT B_dktbi2 "Bedingung: Beginn der Katdiagnose, interne Bedingung, Bank2" UBYTE B_TRUE 1 100 0 1 BIT_MASK 0x10 FORMAT "%13.11" ECU_ADDRESS 0x402AF0 /end MEASUREMENT
/begin MEASUREMENT B_dktens "DKAT f¸r diesen Trip nicht mehr aktiv" UBYTE B_TRUE 1 100 0 1 BIT_MASK 0x2 FORMAT "%13.11" ECU_ADDRESS 0x402AD2 /end MEASUREMENT
/begin MEASUREMENT B_dktens2 "DKAT f¸r diesen Trip nicht mehr aktiv (Bank2)" UBYTE B_TRUE 1 100 0 1 BIT_MASK 0x8 FORMAT "%13.11" ECU_ADDRESS 0x402AD2 /end MEASUREMENT
/begin MEASUREMENT B_dktgtv "Katdiagnose: Bedingung Temperaturgradient-Verzˆgerungszeit" UBYTE B_TRUE 1 100 0 1 BIT_MASK 0x1 FORMAT "%13.11" ECU_ADDRESS 0x402AF1 /end MEASUREMENT
/begin MEASUREMENT B_dktgtv2 "Katdiagnose: Bedingung Temperaturgradient-Verzˆgerungszeit, Bank2" UBYTE B_TRUE 1 100 0 1 BIT_MASK 0x10 FORMAT "%13.11" ECU_ADDRESS 0x402AF1 /end MEASUREMENT
/begin MEASUREMENT B_dktkas "Kat.-Ausr‰umpr¸fung gestoppt bei Katdiagnose" UBYTE B_TRUE 1 100 0 1 BIT_MASK 0x2 FORMAT "%13.11" ECU_ADDRESS 0x402AEE /end MEASUREMENT
/begin MEASUREMENT B_dktkas2 "Kat.-Ausr‰umpr¸fung gestoppt bei Katdiagnose, Bank2" UBYTE B_TRUE 1 100 0 1 BIT_MASK 0x2 FORMAT "%13.11" ECU_ADDRESS 0x402AF0 /end MEASUREMENT
/begin MEASUREMENT B_dktlbi "Bedingung: Laufbereitschaft der Hauptkatdiagnose, interne Bedingung" UBYTE B_TRUE 1 100 0 1 BIT_MASK 0x80 FORMAT "%13.11" ECU_ADDRESS 0x402AEE /end MEASUREMENT
/begin MEASUREMENT B_dktlbi2 "Bedingung: Laufbereitschaft der Hauptkatdiagnose, interne Bedingung, Bank2" UBYTE B_TRUE 1 100 0 1 BIT_MASK 0x20 FORMAT "%13.11" ECU_ADDRESS 0x402AF0 /end MEASUREMENT
/begin MEASUREMENT B_dktle "Bedingung: Katdiagnose, Lambda eingeschwungen" UBYTE B_TRUE 1 100 0 1 BIT_MASK 0x1 FORMAT "%13.11" ECU_ADDRESS 0x402AD5 /end MEASUREMENT
/begin MEASUREMENT B_dktle2 "Bedingung: Katdiagnose, Lambda eingeschwungen" UBYTE B_TRUE 1 100 0 1 BIT_MASK 0x1 FORMAT "%13.11" ECU_ADDRESS 0x402AD9 /end MEASUREMENT
/begin MEASUREMENT B_dktm "Bedingung: Meﬂbeginn, Katdiagnose" UBYTE B_TRUE 1 100 0 1 BIT_MASK 0x8 FORMAT "%13.11" ECU_ADDRESS 0x402AD3 /end MEASUREMENT
/begin MEASUREMENT B_dktm2 "Bedingung: Meﬂbeginn, Katdiagnose" UBYTE B_TRUE 1 100 0 1 BIT_MASK 0x8 FORMAT "%13.11" ECU_ADDRESS 0x402AD4 /end MEASUREMENT
/begin MEASUREMENT B_dktme "Bedingung: Meﬂende, Katdiagnose" UBYTE B_TRUE 1 100 0 1 BIT_MASK 0x8 FORMAT "%13.11" ECU_ADDRESS 0x402AD7 /end MEASUREMENT
/begin MEASUREMENT B_dktme2 "Bedingung: Meﬂende, Katdiagnose" UBYTE B_TRUE 1 100 0 1 BIT_MASK 0x8 FORMAT "%13.11" ECU_ADDRESS 0x402AD8 /end MEASUREMENT
/begin MEASUREMENT B_dktn "Katdiagnose wegen Drehzahlgrenzen gesperrt" UBYTE B_TRUE 1 100 0 1 BIT_MASK 0x4 FORMAT "%13.11" ECU_ADDRESS 0x402AF2 /end MEASUREMENT
/begin MEASUREMENT B_dktr "Bedingung. Katdiagnose im Referenzzustand" UBYTE B_TRUE 1 100 0 1 BIT_MASK 0x4 FORMAT "%13.11" ECU_ADDRESS 0x402AD3 /end MEASUREMENT
/begin MEASUREMENT B_dktr2 "Bedingung. Katdiagnose im Referenzzustand" UBYTE B_TRUE 1 100 0 1 BIT_MASK 0x4 FORMAT "%13.11" ECU_ADDRESS 0x402AD4 /end MEASUREMENT
/begin MEASUREMENT B_dktre "Bedingung Katdiagnose: Referenzzustand erreicht" UBYTE B_TRUE 1 100 0 1 BIT_MASK 0x1 FORMAT "%13.11" ECU_ADDRESS 0x402AD7 /end MEASUREMENT
/begin MEASUREMENT B_dktre2 "Bedingung Katdiagnose: Referenzzustand erreicht" UBYTE B_TRUE 1 100 0 1 BIT_MASK 0x1 FORMAT "%13.11" ECU_ADDRESS 0x402AD8 /end MEASUREMENT
/begin MEASUREMENT B_dktrg "Bedingung. GutKat. durch NOxKat.-Regeneriersteuerung erkannt" UBYTE B_TRUE 1 100 0 1 BIT_MASK 0x80 FORMAT "%13.11" ECU_ADDRESS 0x402AD5 /end MEASUREMENT
/begin MEASUREMENT B_dktrg2 "Bedingung. GutKat. durch NOxKat.-Regeneriersteuerung erkannt, Bank2" UBYTE B_TRUE 1 100 0 1 BIT_MASK 0x80 FORMAT "%13.11" ECU_ADDRESS 0x402AD9 /end MEASUREMENT
/begin MEASUREMENT B_dktsbs "Bankspezifische Stoppbedingung" UBYTE B_TRUE 1 100 0 1 BIT_MASK 0x4 FORMAT "%13.11" ECU_ADDRESS 0x402AEE /end MEASUREMENT
/begin MEASUREMENT B_dktsbs2 "Bankspezifische Stoppbedingung (Stereo 2.Bank)" UBYTE B_TRUE 1 100 0 1 BIT_MASK 0x4 FORMAT "%13.11" ECU_ADDRESS 0x402AF0 /end MEASUREMENT
/begin MEASUREMENT B_dktsps "physikalische Stoppbedingung" UBYTE B_TRUE 1 100 0 1 BIT_MASK 0x10 FORMAT "%13.11" ECU_ADDRESS 0x402AEE /end MEASUREMENT
/begin MEASUREMENT B_dktsps2 "physikalische Stoppbedingung (Stereo 2.Bank)" UBYTE B_TRUE 1 100 0 1 BIT_MASK 0x20 FORMAT "%13.11" ECU_ADDRESS 0x402AF1 /end MEASUREMENT
/begin MEASUREMENT B_dkttks "Katdiagnose temperaturbedingt gesperrt (Kat-Temperatur)" UBYTE B_TRUE 1 100 0 1 BIT_MASK 0x4 FORMAT "%13.11" ECU_ADDRESS 0x402AF1 /end MEASUREMENT
/begin MEASUREMENT B_dkttks2 "Katdiagnose temperaturbedingt gesperrt (Kat-Temperatur)" UBYTE B_TRUE 1 100 0 1 BIT_MASK 0x40 FORMAT "%13.11" ECU_ADDRESS 0x402AF1 /end MEASUREMENT
/begin MEASUREMENT B_dktts "Katdiagnose durch Verzˆgerungszeit nach Motorstart gesperrt" UBYTE B_TRUE 1 100 0 1 BIT_MASK 0x8 FORMAT "%13.11" ECU_ADDRESS 0x402AF2 /end MEASUREMENT
/begin MEASUREMENT B_dkvsef "Errorflag in DKVS trotz weitere Fehler im System freigeben" UBYTE B_TRUE 1 100 0 1 BIT_MASK 0x1 FORMAT "%13.11" ECU_ADDRESS 0x3FC098 /end MEASUREMENT
/begin MEASUREMENT B_dkvsef2 "Erroflag in DKVS trotz weitere Fehler im System freigeben Bank 2" UBYTE B_TRUE 1 100 0 1 BIT_MASK 0x1 FORMAT "%13.11" ECU_ADDRESS 0x3FC099 /end MEASUREMENT
/begin MEASUREMENT B_dkvsf "Bedingung: Freigabe des Fehlers" UBYTE B_TRUE 1 100 0 1 BIT_MASK 0x1 FORMAT "%13.11" ECU_ADDRESS 0x3FC09A /end MEASUREMENT
/begin MEASUREMENT B_dkvsfm "Bedingung: Freigabe des Fehlers (Flipflop Ausgang)" UBYTE B_TRUE 1 100 0 1 BIT_MASK 0x1 FORMAT "%13.11" ECU_ADDRESS 0x3FE166 /end MEASUREMENT
/begin MEASUREMENT B_dkvstr "Bedingung: Integrator bei Tankleer zur¸cksetzen" UBYTE B_TRUE 1 100 0 1 BIT_MASK 0x1 FORMAT "%13.11" ECU_ADDRESS 0x3FC09B /end MEASUREMENT
/begin MEASUREMENT B_dkvszf "Zyklusflag in DKVS trotz weitere Fehler im System freigeben" UBYTE B_TRUE 1 100 0 1 BIT_MASK 0x1 FORMAT "%13.11" ECU_ADDRESS 0x402D6F /end MEASUREMENT
/begin MEASUREMENT B_dkvszf2 "Zyklusflag in DKVS trotz weitere Fehler im System freigeben (Bank 2)" UBYTE B_TRUE 1 100 0 1 BIT_MASK 0x20 FORMAT "%13.11" ECU_ADDRESS 0x402D6F /end MEASUREMENT
/begin MEASUREMENT B_dlams "Bedingung Lambdaverstellung f¸r Integrator hat max. Grenzwert erreicht." UBYTE B_TRUE 1 100 0 1 BIT_MASK 0x2 FORMAT "%13.11" ECU_ADDRESS 0x403B7E /end MEASUREMENT
/begin MEASUREMENT B_dlams2 "Bedingung Lambdaverstellung f¸r Integrator hat max. Grenzwert erreicht. Bank2" UBYTE B_TRUE 1 100 0 1 BIT_MASK 0x40 FORMAT "%13.11" ECU_ADDRESS 0x403B7E /end MEASUREMENT
/begin MEASUREMENT B_dlash "Bedingung Freigabe Schwingungspr¸fung hinter Kat." UBYTE B_TRUE 1 100 0 1 BIT_MASK 0x1 FORMAT "%13.11" ECU_ADDRESS 0x3FBFE3 /end MEASUREMENT
/begin MEASUREMENT B_dlash2 "Bedingung Freigabe Schwingungspr¸fung  hinter Kat. (Bank 2)" UBYTE B_TRUE 1 100 0 1 BIT_MASK 0x1 FORMAT "%13.11" ECU_ADDRESS 0x3FBFE4 /end MEASUREMENT
/begin MEASUREMENT B_dllr "Aktive diagnose: Leerlaufstellerdiagnose" UBYTE B_TRUE 1 100 0 1 BIT_MASK 0x1 FORMAT "%13.11" ECU_ADDRESS 0x3FC222 /end MEASUREMENT
/begin MEASUREMENT B_dllra "Bedingung DLLR Anforderung" UBYTE B_TRUE 1 100 0 1 BIT_MASK 0x1 FORMAT "%13.11" ECU_ADDRESS 0x3FC223 /end MEASUREMENT
/begin MEASUREMENT B_dluerk "Aussetzer erkannt, aus DMDDLU" UBYTE B_TRUE 1 100 0 1 BIT_MASK 0x1 FORMAT "%13.11" ECU_ADDRESS 0x403785 /end MEASUREMENT
/begin MEASUREMENT B_drvddmtl "" UBYTE B_TRUE 1 100 0 1 BIT_MASK 0x4 FORMAT "%13.11" ECU_ADDRESS 0x403B2D /end MEASUREMENT
/begin MEASUREMENT B_drvdtev "" UBYTE B_TRUE 1 100 0 1 BIT_MASK 0x1 FORMAT "%13.11" ECU_ADDRESS 0x403B2D /end MEASUREMENT
/begin MEASUREMENT B_ds "KR: Sensordiagnose aktiv" UBYTE B_TRUE 1 100 0 1 FORMAT "%13.11" ARRAY_SIZE 4 ECU_ADDRESS 0x40303A /end MEASUREMENT
/begin MEASUREMENT B_dshen "Bedingung Freigabe Sondendiagnose hinter KAT" UBYTE B_TRUE 1 100 0 1 BIT_MASK 0x1 FORMAT "%13.11" ECU_ADDRESS 0x3FC00B /end MEASUREMENT
/begin MEASUREMENT B_dshen2 "Bedingung Freigabe Sondendiagnose hinter KAT Bank2" UBYTE B_TRUE 1 100 0 1 BIT_MASK 0x1 FORMAT "%13.11" ECU_ADDRESS 0x3FC00C /end MEASUREMENT
/begin MEASUREMENT B_dshk "Bedingung Diagnosefunktion in %DLSH und %DHLS mit i.O.-Meldung h. KAT" UBYTE B_TRUE 1 100 0 1 BIT_MASK 0x1 FORMAT "%13.11" ECU_ADDRESS 0x3FBFE5 /end MEASUREMENT
/begin MEASUREMENT B_dshk2 "Bed. Diagnosefunktion in %DLSH u.%DHLS mit i.O.-Meldung h. KAT  Bank2" UBYTE B_TRUE 1 100 0 1 BIT_MASK 0x1 FORMAT "%13.11" ECU_ADDRESS 0x3FBFE6 /end MEASUREMENT
/begin MEASUREMENT B_dtimer "" UBYTE B_TRUE 1 100 0 1 BIT_MASK 0x1 FORMAT "%13.11" ECU_ADDRESS 0x403782 /end MEASUREMENT
/begin MEASUREMENT B_dushkvl "Bed. Schwelle f¸r Sonde h. KAT bei Vollast nicht ¸berschritten" UBYTE B_TRUE 1 100 0 1 BIT_MASK 0x1 FORMAT "%13.11" ECU_ADDRESS 0x403B7C /end MEASUREMENT
/begin MEASUREMENT B_dushkvl2 "Bed. Schwelle f¸r Sonde h. KAT bei Vollast nicht ¸berschritten Bank2" UBYTE B_TRUE 1 100 0 1 BIT_MASK 0x2 FORMAT "%13.11" ECU_ADDRESS 0x403B7C /end MEASUREMENT
/begin MEASUREMENT B_dushsch "Bedingung Schwelle f¸r Sonde hinter KAT im Schub nicht unterschritten" UBYTE B_TRUE 1 100 0 1 BIT_MASK 0x1 FORMAT "%13.11" ECU_ADDRESS 0x3FBFE7 /end MEASUREMENT
/begin MEASUREMENT B_dushsch2 "Bed. Schwelle f¸r Sonde hinter KAT im Schub nicht unterschritten  Bank2" UBYTE B_TRUE 1 100 0 1 BIT_MASK 0x1 FORMAT "%13.11" ECU_ADDRESS 0x3FBFE8 /end MEASUREMENT
/begin MEASUREMENT B_dylash "Bedingung Sonde hinter KAT dynamisch langsam" UBYTE B_TRUE 1 100 0 1 BIT_MASK 0x1 FORMAT "%13.11" ECU_ADDRESS 0x3FE094 /end MEASUREMENT
/begin MEASUREMENT B_dylash2 "Bedingung Sonde hinter KAT dynamisch langsam Bank2" UBYTE B_TRUE 1 100 0 1 BIT_MASK 0x2 FORMAT "%13.11" ECU_ADDRESS 0x3FE094 /end MEASUREMENT
/begin MEASUREMENT B_ebDavT "Bedingung ETK_Bypass Daten verf¸gbar" UBYTE B_TRUE 1 100 0 1 BIT_MASK 0x1 FORMAT "%13.11" ECU_ADDRESS 0x403783 /end MEASUREMENT
/begin MEASUREMENT B_ebDavY "ETK-Bypass Daten vorhanden" UBYTE B_TRUE 1 100 0 1 BIT_MASK 0x1 FORMAT "%13.11" ECU_ADDRESS 0x403784 /end MEASUREMENT
/begin MEASUREMENT B_edkt "Bedingung: Katdiagnose: Schlechtpr¸fung" UBYTE B_TRUE 1 100 0 1 BIT_MASK 0x4 FORMAT "%13.11" ECU_ADDRESS 0x402AD5 /end MEASUREMENT
/begin MEASUREMENT B_edkt2 "Bedingung: Katdiagnose: Schlechtpr¸fung" UBYTE B_TRUE 1 100 0 1 BIT_MASK 0x4 FORMAT "%13.11" ECU_ADDRESS 0x402AD9 /end MEASUREMENT
/begin MEASUREMENT B_edkvs "Bedingung Adaptionsfehlerschwellen aktuell ¸berschritten" UBYTE B_TRUE 1 100 0 1 BIT_MASK 0x1 FORMAT "%13.11" ECU_ADDRESS 0x3FC09C /end MEASUREMENT
/begin MEASUREMENT B_edkvs2 "Bedingung Adaptionsfehlerschwellen Bank 2 aktuell ¸berschritten" UBYTE B_TRUE 1 100 0 1 BIT_MASK 0x1 FORMAT "%13.11" ECU_ADDRESS 0x3FC09D /end MEASUREMENT
/begin MEASUREMENT B_efrao "Bedingung Diagnoseschwellen obere multipl. Korrektur aktuell ¸berschritten" UBYTE B_TRUE 1 100 0 1 BIT_MASK 0x1 FORMAT "%13.11" ECU_ADDRESS 0x3FC09E /end MEASUREMENT
/begin MEASUREMENT B_efrao2 "Bedingung Diagnoseschwellen obere multipl. Korr. Bank 2 aktuell ¸berschritten" UBYTE B_TRUE 1 100 0 1 BIT_MASK 0x1 FORMAT "%13.11" ECU_ADDRESS 0x3FC09F /end MEASUREMENT
/begin MEASUREMENT B_efrau "Bedingung Diagnoseschwellen untere multipl. Korrektur aktuell ¸berschritten" UBYTE B_TRUE 1 100 0 1 BIT_MASK 0x1 FORMAT "%13.11" ECU_ADDRESS 0x3FC0A0 /end MEASUREMENT
/begin MEASUREMENT B_efrau2 "Bedingung Diagnoseschwellen untere multipl. Korr. Bank 2 aktuell ¸berschritten" UBYTE B_TRUE 1 100 0 1 BIT_MASK 0x1 FORMAT "%13.11" ECU_ADDRESS 0x3FC0A1 /end MEASUREMENT
/begin MEASUREMENT B_ehsve "Bedingung Endstufenfehler an der Heizung" UBYTE B_TRUE 1 100 0 1 BIT_MASK 0x1 FORMAT "%13.11" ECU_ADDRESS 0x402BF5 /end MEASUREMENT
/begin MEASUREMENT B_ehsve2 "Bedingung Endstufenfehler an der Heizung, Bank 2" UBYTE B_TRUE 1 100 0 1 BIT_MASK 0x2 FORMAT "%13.11" ECU_ADDRESS 0x402BF5 /end MEASUREMENT
/begin MEASUREMENT B_eiclsu "Bedingung Fehler am Auswerte-IC f¸r die LSU" UBYTE B_TRUE 1 100 0 1 BIT_MASK 0x1 FORMAT "%13.11" ECU_ADDRESS 0x402A74 /end MEASUREMENT
/begin MEASUREMENT B_eiclsu2 "Bedingung Fehler am Auswerte-IC f¸r die LSU, Bank 2" UBYTE B_TRUE 1 100 0 1 BIT_MASK 0x10 FORMAT "%13.11" ECU_ADDRESS 0x402A74 /end MEASUREMENT
/begin MEASUREMENT B_ekusvk "Bedingung: Fehler beim Kennlinienabgleich f¸r Lambda des Auswerte-ICs der LSU" UBYTE B_TRUE 1 100 0 1 BIT_MASK 0x2 FORMAT "%13.11" ECU_ADDRESS 0x402A74 /end MEASUREMENT
/begin MEASUREMENT B_ekusvk2 "Bedingung: Fehler beim Kennlinienabgleich f¸r Lambda des Auswerte-ICs der LSU" UBYTE B_TRUE 1 100 0 1 BIT_MASK 0x20 FORMAT "%13.11" ECU_ADDRESS 0x402A74 /end MEASUREMENT
/begin MEASUREMENT B_elshbb "Fehler Lambda Sonde hinter Haupt Kat, Betriebsbereitschaft zur¸cksetzt." UBYTE B_TRUE 1 100 0 1 BIT_MASK 0x1 FORMAT "%13.11" ECU_ADDRESS 0x403B87 /end MEASUREMENT
/begin MEASUREMENT B_elshbb2 "Fehler Lambda Sonde hinter Haupt Kat, Betriebsbereitschaft zu¸cksetzt Bank 2" UBYTE B_TRUE 1 100 0 1 BIT_MASK 0x10 FORMAT "%13.11" ECU_ADDRESS 0x403B87 /end MEASUREMENT
/begin MEASUREMENT B_elshv "Hilfsbit zur Auswertung des Erorbits E_lshv zur Umschaltung Mono/Stereo hint KAT" UBYTE B_TRUE 1 100 0 1 BIT_MASK 0x1 FORMAT "%13.11" ECU_ADDRESS 0x403B8B /end MEASUREMENT
/begin MEASUREMENT B_elshv2 "Hilfsbit zur Auswertung des Erorbits E_lshv2 zur Umschaltung Mono/Stereo Bank2" UBYTE B_TRUE 1 100 0 1 BIT_MASK 0x1 FORMAT "%13.11" ECU_ADDRESS 0x403B8C /end MEASUREMENT
/begin MEASUREMENT B_elshvdk "Bedingung hintere Lambdasonden vertauscht" UBYTE B_TRUE 1 100 0 1 BIT_MASK 0x40 FORMAT "%13.11" ECU_ADDRESS 0x402AD5 /end MEASUREMENT
/begin MEASUREMENT B_elshvdkt "Bedingung hintere Lambdasonden vertauscht" UBYTE B_TRUE 1 100 0 1 BIT_MASK 0x10 FORMAT "%13.11" ECU_ADDRESS 0x402AF2 /end MEASUREMENT
/begin MEASUREMENT B_elsuv "Bedingung Fehler LSU vertauscht rechts/links (keine Betriebsbereitschaft)" UBYTE B_TRUE 1 100 0 1 BIT_MASK 0x1 FORMAT "%13.11" ECU_ADDRESS 0x3FC01E /end MEASUREMENT
/begin MEASUREMENT B_elsuwi "Bedingung Leitungsfehler LSU ( intern)" UBYTE B_TRUE 1 100 0 1 BIT_MASK 0x4 FORMAT "%13.11" ECU_ADDRESS 0x402A74 /end MEASUREMENT
/begin MEASUREMENT B_elsuwi2 "Bedingung Leitungsfehler LSU ( intern), Bank2" UBYTE B_TRUE 1 100 0 1 BIT_MASK 0x40 FORMAT "%13.11" ECU_ADDRESS 0x402A74 /end MEASUREMENT
/begin MEASUREMENT B_elsvdk2 "Bedingung vorderer Lambdasondenfehler" UBYTE B_TRUE 1 100 0 1 BIT_MASK 0x40 FORMAT "%13.11" ECU_ADDRESS 0x402AD9 /end MEASUREMENT
/begin MEASUREMENT B_enfmst "Bedingung Enable f¸r Filter; Maximum der Steigung ¸bernehmen hinter Kat" UBYTE B_TRUE 1 100 0 1 BIT_MASK 0x1 FORMAT "%13.11" ECU_ADDRESS 0x3FBFE9 /end MEASUREMENT
/begin MEASUREMENT B_enfmst2 "Bedingung Enable f¸r Filter Maximum der Steigung ¸bernehmen hinter Kat Bank2" UBYTE B_TRUE 1 100 0 1 BIT_MASK 0x1 FORMAT "%13.11" ECU_ADDRESS 0x3FBFEA /end MEASUREMENT
/begin MEASUREMENT B_enlash "Bedingung Test f¸r Schwingungspr¸fung abgeschlossen hinteer Kat" UBYTE B_TRUE 1 100 0 1 BIT_MASK 0x1 FORMAT "%13.11" ECU_ADDRESS 0x3FBFEB /end MEASUREMENT
/begin MEASUREMENT B_enlash2 "Bedingung Test f¸r Schwingungspr¸fung abgeschlossen hinter Kat Bank2" UBYTE B_TRUE 1 100 0 1 BIT_MASK 0x1 FORMAT "%13.11" ECU_ADDRESS 0x3FBFEC /end MEASUREMENT
/begin MEASUREMENT B_enmaxla "Bedingung enable B_maxlash ""setzen"" bei Fehler Lambdasonden hinter Kat" UBYTE B_TRUE 1 100 0 1 BIT_MASK 0x2 FORMAT "%13.11" ECU_ADDRESS 0x403B7F /end MEASUREMENT
/begin MEASUREMENT B_enmaxla2 "Bedingung enable B_maxlash ""setzen"" bei Fehler Lambdasonden hinter Kat  Bank2" UBYTE B_TRUE 1 100 0 1 BIT_MASK 0x20 FORMAT "%13.11" ECU_ADDRESS 0x403B7F /end MEASUREMENT
/begin MEASUREMENT B_enramph "Bedingung Eenable Rampentest f¸r Sonde hinter KAT" UBYTE B_TRUE 1 100 0 1 BIT_MASK 0x40 FORMAT "%13.11" ECU_ADDRESS 0x403B80 /end MEASUREMENT
/begin MEASUREMENT B_enramph2 "Bedingung Eenable Rampentest f¸r Sonde hinter KAT Bank2" UBYTE B_TRUE 1 100 0 1 BIT_MASK 0x80 FORMAT "%13.11" ECU_ADDRESS 0x403B80 /end MEASUREMENT
/begin MEASUREMENT B_entest "Bedingung Wartezeit abgeschlossen f¸r Test-‹berpr¸fung Sonde hinter KAT" UBYTE B_TRUE 1 100 0 1 BIT_MASK 0x1 FORMAT "%13.11" ECU_ADDRESS 0x3FBFED /end MEASUREMENT
/begin MEASUREMENT B_entest2 "Bedingung Wartezeit abgeschlossen f¸r Test-‹berpr¸fung Sonde hinter KAT Bank2" UBYTE B_TRUE 1 100 0 1 BIT_MASK 0x1 FORMAT "%13.11" ECU_ADDRESS 0x3FBFEE /end MEASUREMENT
/begin MEASUREMENT B_erkat "Bedingung Diagnoseschwellen additive Korr. pro Zeit aktuell ¸berschritten" UBYTE B_TRUE 1 100 0 1 BIT_MASK 0x1 FORMAT "%13.11" ECU_ADDRESS 0x3FC0A2 /end MEASUREMENT
/begin MEASUREMENT B_erkat2 "Bedingung Diagnoseschwellen additive Korr. pro Zeit Bank 2 aktuell ¸berschritten" UBYTE B_TRUE 1 100 0 1 BIT_MASK 0x1 FORMAT "%13.11" ECU_ADDRESS 0x3FC0A3 /end MEASUREMENT
/begin MEASUREMENT B_erkaz "Bedingung Diagnoseschwellen additive Korr. pro Einspr.  aktuell ¸berschritten" UBYTE B_TRUE 1 100 0 1 BIT_MASK 0x1 FORMAT "%13.11" ECU_ADDRESS 0x3FC0A4 /end MEASUREMENT
/begin MEASUREMENT B_erkaz2 "Bedingung Diagnoseschw. additive Korr. pro Einspr. Bank 2 aktuell ¸berschritten" UBYTE B_TRUE 1 100 0 1 BIT_MASK 0x1 FORMAT "%13.11" ECU_ADDRESS 0x3FC0A5 /end MEASUREMENT
/begin MEASUREMENT B_estart "Bedingung KL 50 ein" UBYTE B_TRUE 1 100 0 1 BIT_MASK 0x1 FORMAT "%13.11" ECU_ADDRESS 0x3FBED9 /end MEASUREMENT
/begin MEASUREMENT B_frste "Bedingung frm_w eingeschwungen (Kurztest)" UBYTE B_TRUE 1 100 0 1 BIT_MASK 0x1 FORMAT "%13.11" ECU_ADDRESS 0x3FC0A6 /end MEASUREMENT
/begin MEASUREMENT B_frste2 "Bedingung frm2_w eingeschwungen (Kurztest 2. Bank)" UBYTE B_TRUE 1 100 0 1 BIT_MASK 0x1 FORMAT "%13.11" ECU_ADDRESS 0x3FC0A7 /end MEASUREMENT
/begin MEASUREMENT B_gae "Bedingung Grundadaption eingeschwungen" UBYTE B_TRUE 1 100 0 1 BIT_MASK 0x1 FORMAT "%13.11" ECU_ADDRESS 0x3FC0A8 /end MEASUREMENT
/begin MEASUREMENT B_gaefra "Bedingung Grundadaption (fra-Integrator) eingeschwungen" UBYTE B_TRUE 1 100 0 1 BIT_MASK 0x1 FORMAT "%13.11" ECU_ADDRESS 0x3FC0A9 /end MEASUREMENT
/begin MEASUREMENT B_gaefra2 "Bedingung Grundadaption (fra2-Integrator) eingeschwungen" UBYTE B_TRUE 1 100 0 1 BIT_MASK 0x1 FORMAT "%13.11" ECU_ADDRESS 0x3FC0AA /end MEASUREMENT
/begin MEASUREMENT B_gaeing "Bedingung Grundadaption Bank 1 eingeschwungen" UBYTE B_TRUE 1 100 0 1 BIT_MASK 0x1 FORMAT "%13.11" ECU_ADDRESS 0x3FC0AB /end MEASUREMENT
/begin MEASUREMENT B_gaeing2 "Bedingung Grundadaption Bank 2 eingeschwungenen" UBYTE B_TRUE 1 100 0 1 BIT_MASK 0x1 FORMAT "%13.11" ECU_ADDRESS 0x3FC0AC /end MEASUREMENT
/begin MEASUREMENT B_gangok "Bedingung Gangwechselerkennung prinziell erlaubt" UBYTE B_TRUE 1 100 0 1 BIT_MASK 0x1 FORMAT "%13.11" ECU_ADDRESS 0x3FC042 /end MEASUREMENT
/begin MEASUREMENT B_helsuip "Bedingung: Heilen des Fehlerpfades LSUIP" UBYTE B_TRUE 1 100 0 1 BIT_MASK 0x10 FORMAT "%13.11" ECU_ADDRESS 0x402A75 /end MEASUREMENT
/begin MEASUREMENT B_helsuip2 "Bedingung: Heilen des Fehlerpfades LSUIP, Bank2" UBYTE B_TRUE 1 100 0 1 BIT_MASK 0x20 FORMAT "%13.11" ECU_ADDRESS 0x402A75 /end MEASUREMENT
/begin MEASUREMENT B_hshtpk "Bed. Taupuktende ¸berschritten und Sonde ausreichend heiﬂ hinter Kat" UBYTE B_TRUE 1 100 0 1 BIT_MASK 0x4 FORMAT "%13.11" ECU_ADDRESS 0x403B81 /end MEASUREMENT
/begin MEASUREMENT B_hshtpk2 "Bed. Taupuktende ¸berschritten und Sonde ausreichend heiﬂ hinter Kat Bank2" UBYTE B_TRUE 1 100 0 1 BIT_MASK 0x4 FORMAT "%13.11" ECU_ADDRESS 0x403B82 /end MEASUREMENT
/begin MEASUREMENT B_hsrdy "Bedingung Sondenheizung gepr¸ft f¸r 'ready-Byte'" UBYTE B_TRUE 1 100 0 1 BIT_MASK 0x40 FORMAT "%13.11" ECU_ADDRESS 0x3FDEF3 /end MEASUREMENT
/begin MEASUREMENT B_hsveemn "Bedingung Entprellter Min-Fehler der Heizerendstufe der LSU" UBYTE B_TRUE 1 100 0 1 BIT_MASK 0x1 FORMAT "%13.11" ECU_ADDRESS 0x402BF6 /end MEASUREMENT
/begin MEASUREMENT B_hsveemn2 "Bedingung Entprellter Min-Fehler der Heizerendstufe der LSU, Bank 2" UBYTE B_TRUE 1 100 0 1 BIT_MASK 0x10 FORMAT "%13.11" ECU_ADDRESS 0x402BF6 /end MEASUREMENT
/begin MEASUREMENT B_hsveemx "Bedingung Entprellter Max-Fehler der Heizerendstufe der LSU" UBYTE B_TRUE 1 100 0 1 BIT_MASK 0x2 FORMAT "%13.11" ECU_ADDRESS 0x402BF6 /end MEASUREMENT
/begin MEASUREMENT B_hsveemx2 "Bedingung Entprellter Max-Fehler der Heizerendstufe der LSU, Bank 2" UBYTE B_TRUE 1 100 0 1 BIT_MASK 0x20 FORMAT "%13.11" ECU_ADDRESS 0x402BF6 /end MEASUREMENT
/begin MEASUREMENT B_hsveesi "Bedingung Entprellter Sig-Fehler der Heizerendstufe der LSU" UBYTE B_TRUE 1 100 0 1 BIT_MASK 0x4 FORMAT "%13.11" ECU_ADDRESS 0x402BF6 /end MEASUREMENT
/begin MEASUREMENT B_hsveesi2 "Bedingung Entprellter Sig-Fehler der Heizerendstufe der LSU, Bank 2" UBYTE B_TRUE 1 100 0 1 BIT_MASK 0x40 FORMAT "%13.11" ECU_ADDRESS 0x402BF6 /end MEASUREMENT
/begin MEASUREMENT B_hzkfh "Bedingung Fehler Heizer-Einkopplung hinter Haupt KAT" UBYTE B_TRUE 1 100 0 1 BIT_MASK 0x1 FORMAT "%13.11" ECU_ADDRESS 0x3FC00D /end MEASUREMENT
/begin MEASUREMENT B_hzkfh2 "Bedingung Fehler Heizer-Einkopplung hinter KAT Bank2" UBYTE B_TRUE 1 100 0 1 BIT_MASK 0x1 FORMAT "%13.11" ECU_ADDRESS 0x3FC00E /end MEASUREMENT
/begin MEASUREMENT B_hzkhzyk "Bedingung Heizereinkopplung f¸r Bildung Zyklusbit  hinter Haupt KAT" UBYTE B_TRUE 1 100 0 1 BIT_MASK 0x1 FORMAT "%13.11" ECU_ADDRESS 0x3FC00F /end MEASUREMENT
/begin MEASUREMENT B_hzkhzyk2 "Bedingung Heizereinkopplung f¸r Bildung Zyklusbit  hinter Haupt KAT Bank2" UBYTE B_TRUE 1 100 0 1 BIT_MASK 0x1 FORMAT "%13.11" ECU_ADDRESS 0x3FC010 /end MEASUREMENT
/begin MEASUREMENT B_hzoffh "Bedingung Heizung ausgeschaltet  hinter Haupt KAT" UBYTE B_TRUE 1 100 0 1 BIT_MASK 0x1 FORMAT "%13.11" ECU_ADDRESS 0x3FC011 /end MEASUREMENT
/begin MEASUREMENT B_hzoffh2 "Bedingung Heizung ausgeschaltet hinter Haupt  KAT Bank2" UBYTE B_TRUE 1 100 0 1 BIT_MASK 0x1 FORMAT "%13.11" ECU_ADDRESS 0x3FC012 /end MEASUREMENT
/begin MEASUREMENT B_ildkt "Katalysator ¸ber Kat-Ausr‰umen gepr¸ft" UBYTE B_TRUE 1 100 0 1 BIT_MASK 0x8 FORMAT "%13.11" ECU_ADDRESS 0x402AD5 /end MEASUREMENT
/begin MEASUREMENT B_ildkt2 "Katalysator ¸ber Kat-Ausr‰umen gepr¸ft" UBYTE B_TRUE 1 100 0 1 BIT_MASK 0x8 FORMAT "%13.11" ECU_ADDRESS 0x402AD9 /end MEASUREMENT
/begin MEASUREMENT B_imlkvse "Bedingung Luftmassenintegral R¸cksetzen" UBYTE B_TRUE 1 100 0 1 BIT_MASK 0x2 FORMAT "%13.11" ECU_ADDRESS 0x3FE166 /end MEASUREMENT
/begin MEASUREMENT B_kathrdy "Bedingung Katalysator-Heizungen gepr¸ft f¸r 'ready-Byte'" UBYTE B_TRUE 1 100 0 1 BIT_MASK 0x2 FORMAT "%13.11" ECU_ADDRESS 0x3FDEF3 /end MEASUREMENT
/begin MEASUREMENT B_katrdy "Bedingung Katalysatoren gepr¸ft f¸r 'ready-Byte'" UBYTE B_TRUE 1 100 0 1 BIT_MASK 0x1 FORMAT "%13.11" ECU_ADDRESS 0x3FDEF3 /end MEASUREMENT
/begin MEASUREMENT B_kkrdy "Bedingung Klimak¸hlmittel gepr¸ft f¸r 'ready-Byte'" UBYTE B_TRUE 1 100 0 1 BIT_MASK 0x10 FORMAT "%13.11" ECU_ADDRESS 0x3FDEF3 /end MEASUREMENT
/begin MEASUREMENT B_krdws "Bedingung Klopfregelung Sicherheitssp‰tverstellung" UBYTE B_TRUE 1 100 0 1 BIT_MASK 0x1 FORMAT "%13.11" ECU_ADDRESS 0x3FC1A1 /end MEASUREMENT
/begin MEASUREMENT B_krntfv "KR: Fehlerverdacht Nulltest" UBYTE B_TRUE 1 100 0 1 BIT_MASK 0x1 FORMAT "%13.11" ECU_ADDRESS 0x3FC1A2 /end MEASUREMENT
/begin MEASUREMENT B_krtpfv "KR: Testimpuls Fehlerverdacht" UBYTE B_TRUE 1 100 0 1 BIT_MASK 0x1 FORMAT "%13.11" ECU_ADDRESS 0x3FC1AB /end MEASUREMENT
/begin MEASUREMENT B_ktrlash "Bedingung Kurztrip f¸r Schwingungspr¸fung durchf¸hren Sonde hinter KAT" UBYTE B_TRUE 1 100 0 1 BIT_MASK 0x4 FORMAT "%13.11" ECU_ADDRESS 0x403B7E /end MEASUREMENT
/begin MEASUREMENT B_ktrlash2 "Bedingung Kurztrip f¸r Schwingungspr¸fung durchf¸hren Sonde hinter KAT Bank2" UBYTE B_TRUE 1 100 0 1 BIT_MASK 0x20 FORMAT "%13.11" ECU_ADDRESS 0x403B7E /end MEASUREMENT
/begin MEASUREMENT B_kvsffl "Bedingung: Freigabe des Fehlers trotz Tank leer" UBYTE B_TRUE 1 100 0 1 BIT_MASK 0x1 FORMAT "%13.11" ECU_ADDRESS 0x3FC0AD /end MEASUREMENT
/begin MEASUREMENT B_lamdkt "Lambdasoll Eingriff f¸r Katdiagnose aktiv" UBYTE B_TRUE 1 100 0 1 BIT_MASK 0x1 FORMAT "%13.11" ECU_ADDRESS 0x402AD3 /end MEASUREMENT
/begin MEASUREMENT B_lamdkt2 "Lambdasoll Eingriff f¸r Katdiagnose aktiv" UBYTE B_TRUE 1 100 0 1 BIT_MASK 0x1 FORMAT "%13.11" ECU_ADDRESS 0x402AD4 /end MEASUREMENT
/begin MEASUREMENT B_lamend "Bedingung Ende der Lambdaverstellung in %LAMKO hinter Kat" UBYTE B_TRUE 1 100 0 1 BIT_MASK 0x1 FORMAT "%13.11" ECU_ADDRESS 0x3FBFEF /end MEASUREMENT
/begin MEASUREMENT B_lamend2 "Bedingung Ende der Lambdaverstellung in %LAMKO hinter Kat Bank2" UBYTE B_TRUE 1 100 0 1 BIT_MASK 0x1 FORMAT "%13.11" ECU_ADDRESS 0x3FBFF0 /end MEASUREMENT
/begin MEASUREMENT B_lamlash "Bedingung f¸r Abmagern/Anfetten in %LAMKO" UBYTE B_TRUE 1 100 0 1 BIT_MASK 0x1 FORMAT "%13.11" ECU_ADDRESS 0x3FBFF1 /end MEASUREMENT
/begin MEASUREMENT B_lamlash2 "Bedingung f¸r Abmagern in %LAMKO Bank2" UBYTE B_TRUE 1 100 0 1 BIT_MASK 0x1 FORMAT "%13.11" ECU_ADDRESS 0x3FBFF2 /end MEASUREMENT
/begin MEASUREMENT B_lamverg "Bedingung Vergleich Lambdasoll in %DLSAHK mit %LAMKO ¸bereinstimmend" UBYTE B_TRUE 1 100 0 1 BIT_MASK 0x1 FORMAT "%13.11" ECU_ADDRESS 0x3FBFF3 /end MEASUREMENT
/begin MEASUREMENT B_lamverg2 "Bedingung Vergleich Lambdasoll in %DLSAHK mit %LAMKO ¸bereinstimmend Bank2" UBYTE B_TRUE 1 100 0 1 BIT_MASK 0x1 FORMAT "%13.11" ECU_ADDRESS 0x3FBFF4 /end MEASUREMENT
/begin MEASUREMENT B_lldia "Diagnose Leerlaufregelung freigegeben" UBYTE B_TRUE 1 100 0 1 BIT_MASK 0x1 FORMAT "%13.11" ECU_ADDRESS 0x3FC224 /end MEASUREMENT
/begin MEASUREMENT B_lsahksp "allgemeine Stop-Bedingungen f¸r die DLSAHK" UBYTE B_TRUE 1 100 0 1 BIT_MASK 0x1 FORMAT "%13.11" ECU_ADDRESS 0x3FBFF5 /end MEASUREMENT
/begin MEASUREMENT B_lsahksp2 "allgemeine Stop-Bedingungen f¸r die DLSAHK Bank2" UBYTE B_TRUE 1 100 0 1 BIT_MASK 0x1 FORMAT "%13.11" ECU_ADDRESS 0x3FBFF6 /end MEASUREMENT
/begin MEASUREMENT B_lshklt "Bedingung Lambdasonde hinter Kat kalt" UBYTE B_TRUE 1 100 0 1 BIT_MASK 0x1 FORMAT "%13.11" ECU_ADDRESS 0x3FC013 /end MEASUREMENT
/begin MEASUREMENT B_lshkspe "Enable allgemeine Stop-Bedingungen f¸r die DLSAHK" UBYTE B_TRUE 1 100 0 1 BIT_MASK 0x2 FORMAT "%13.11" ECU_ADDRESS 0x403B81 /end MEASUREMENT
/begin MEASUREMENT B_lshkspe2 "Enable allgemeine Stop-Bedingungen f¸r die DLSAHK Bank2" UBYTE B_TRUE 1 100 0 1 BIT_MASK 0x2 FORMAT "%13.11" ECU_ADDRESS 0x403B82 /end MEASUREMENT
/begin MEASUREMENT B_lshswok "Bedingung Sonde hinter KAT nach Schwingungspr¸fung in Ordnung" UBYTE B_TRUE 1 100 0 1 BIT_MASK 0x1 FORMAT "%13.11" ECU_ADDRESS 0x403B7B /end MEASUREMENT
/begin MEASUREMENT B_lshswok2 "Bedingung Sonde hinter KAT nach Schwingungspr¸fung in Ordnung Bank2" UBYTE B_TRUE 1 100 0 1 BIT_MASK 0x10 FORMAT "%13.11" ECU_ADDRESS 0x403B7B /end MEASUREMENT
/begin MEASUREMENT B_lshswos "Negierte Speichergrˆﬂe:  Sonde hinter KAT nach Schwingungspr¸fung in Ordnung" UBYTE B_TRUE 1 100 0 1 BIT_MASK 0x8 FORMAT "%13.11" ECU_ADDRESS 0x402AF1 /end MEASUREMENT
/begin MEASUREMENT B_lshswos2 "Negierte Speichergrˆﬂe:  Sonde hinter KAT nach Schwingungspr¸fung in Ordnung" UBYTE B_TRUE 1 100 0 1 BIT_MASK 0x80 FORMAT "%13.11" ECU_ADDRESS 0x402AF1 /end MEASUREMENT
/begin MEASUREMENT B_lsrdy "Bedingung Lambda-Sonden gepr¸ft f¸r 'ready-Byte'" UBYTE B_TRUE 1 100 0 1 BIT_MASK 0x20 FORMAT "%13.11" ECU_ADDRESS 0x3FDEF3 /end MEASUREMENT
/begin MEASUREMENT B_lsuabgl "Bedingung Abgleichleitung stetige Lambda-Sonde LSU unterbrochen" UBYTE B_TRUE 1 100 0 1 BIT_MASK 0x1 FORMAT "%13.11" ECU_ADDRESS 0x402A76 /end MEASUREMENT
/begin MEASUREMENT B_lsuabgl2 "Bedingung Abgleichleitung stetige Lambda-Sonde LSU 2 unterbrochen" UBYTE B_TRUE 1 100 0 1 BIT_MASK 0x1 FORMAT "%13.11" ECU_ADDRESS 0x402A79 /end MEASUREMENT
/begin MEASUREMENT B_lsudip "Bedingung: Sondensignal im Band um 1 f¸r Diagnosezwecke" UBYTE B_TRUE 1 100 0 1 BIT_MASK 0x1 FORMAT "%13.11" ECU_ADDRESS 0x402A75 /end MEASUREMENT
/begin MEASUREMENT B_lsudip2 "Bedingung: Sondensignal im Band um 1 f¸r Diagnosezwecke" UBYTE B_TRUE 1 100 0 1 BIT_MASK 0x2 FORMAT "%13.11" ECU_ADDRESS 0x402A75 /end MEASUREMENT
/begin MEASUREMENT B_lsulash "Bed.Test ausf¸hren f¸r Sonde hinter KAT bei Fehlerverdacht der LSU vor KAT" UBYTE B_TRUE 1 100 0 1 BIT_MASK 0x8 FORMAT "%13.11" ECU_ADDRESS 0x403B81 /end MEASUREMENT
/begin MEASUREMENT B_lsulash2 "Bed.Test ausf¸hren f¸r Sonde hinter KAT bei Fehlerverdacht der LSU vor KAT Bank2" UBYTE B_TRUE 1 100 0 1 BIT_MASK 0x8 FORMAT "%13.11" ECU_ADDRESS 0x403B82 /end MEASUREMENT
/begin MEASUREMENT B_lsumxtk "Bedingung Max-Fehler ist mit ""Tank-Leer-Bedingung"" entprellt" UBYTE B_TRUE 1 100 0 1 BIT_MASK 0x2 FORMAT "%13.11" ECU_ADDRESS 0x402A76 /end MEASUREMENT
/begin MEASUREMENT B_lsumxtk2 "Bedingung Max-Fehler ist mit ""Tank-Leer-Bedingung"" entprellt, Bank 2" UBYTE B_TRUE 1 100 0 1 BIT_MASK 0x2 FORMAT "%13.11" ECU_ADDRESS 0x402A79 /end MEASUREMENT
/begin MEASUREMENT B_lsuna "LSU nicht aktiv, Bank1" UBYTE B_TRUE 1 100 0 1 BIT_MASK 0x4 FORMAT "%13.11" ECU_ADDRESS 0x402A76 /end MEASUREMENT
/begin MEASUREMENT B_lsuna2 "LSU nicht aktiv, Bank2" UBYTE B_TRUE 1 100 0 1 BIT_MASK 0x4 FORMAT "%13.11" ECU_ADDRESS 0x402A79 /end MEASUREMENT
/begin MEASUREMENT B_lsuocun "Bedingung Leitungsunterbrechung an der Sondenleitung UN" UBYTE B_TRUE 1 100 0 1 BIT_MASK 0x8 FORMAT "%13.11" ECU_ADDRESS 0x402A76 /end MEASUREMENT
/begin MEASUREMENT B_lsuocun2 "Bedingung Leitungsunterbrechung an der Sondenleitung UN, Bank 2" UBYTE B_TRUE 1 100 0 1 BIT_MASK 0x8 FORMAT "%13.11" ECU_ADDRESS 0x402A79 /end MEASUREMENT
/begin MEASUREMENT B_lsuocvm "Bedingung Leitungsunterbrechung an der Sondenleitung VM" UBYTE B_TRUE 1 100 0 1 BIT_MASK 0x10 FORMAT "%13.11" ECU_ADDRESS 0x402A76 /end MEASUREMENT
/begin MEASUREMENT B_lsuocvm2 "Bedingung Leitungsunterbrechung an der Sondenleitung VM, Bank 2" UBYTE B_TRUE 1 100 0 1 BIT_MASK 0x10 FORMAT "%13.11" ECU_ADDRESS 0x402A79 /end MEASUREMENT
/begin MEASUREMENT B_lsuumn "Bedingung Ausgangsspannung CJ120/125 im Schub zu klein" UBYTE B_TRUE 1 100 0 1 BIT_MASK 0x40 FORMAT "%13.11" ECU_ADDRESS 0x402A78 /end MEASUREMENT
/begin MEASUREMENT B_lsuumn2 "Bedingung Ausgangsspannung CJ120/125 im Schub zu klein, Bank 2" UBYTE B_TRUE 1 100 0 1 BIT_MASK 0x80 FORMAT "%13.11" ECU_ADDRESS 0x402A78 /end MEASUREMENT
/begin MEASUREMENT B_maxflsh "Kurzsschluﬂ nach UBatt bei Sonde hinter KAT erkannt" UBYTE B_TRUE 1 100 0 1 BIT_MASK 0x1 FORMAT "%13.11" ECU_ADDRESS 0x403B88 /end MEASUREMENT
/begin MEASUREMENT B_maxflsh2 "Kurzsschluﬂ nach UBatt bei Sonde hinter KAT erkannt, Bank 2" UBYTE B_TRUE 1 100 0 1 BIT_MASK 0x2 FORMAT "%13.11" ECU_ADDRESS 0x403B88 /end MEASUREMENT
/begin MEASUREMENT B_maxla "Maximalwert f¸r Schwingungs-Pr¸fung hinter KAT erkannt" UBYTE B_TRUE 1 100 0 1 BIT_MASK 0x4 FORMAT "%13.11" ECU_ADDRESS 0x403B7F /end MEASUREMENT
/begin MEASUREMENT B_maxla2 "Maximalwert f¸r Schwingungs-Pr¸fung hinter KAT erkannt Bank2" UBYTE B_TRUE 1 100 0 1 BIT_MASK 0x40 FORMAT "%13.11" ECU_ADDRESS 0x403B7F /end MEASUREMENT
/begin MEASUREMENT B_maxlash "Sonden-Fehler Maximalwert f¸r Schwingungs-Pr¸fung hinter KAT nicht erkannt" UBYTE B_TRUE 1 100 0 1 BIT_MASK 0x1 FORMAT "%13.11" ECU_ADDRESS 0x3FBFF7 /end MEASUREMENT
/begin MEASUREMENT B_maxlash2 "Sonden-Fehler Maximalwert f¸r Schwingungs-Pr¸fung hinter KAT nicht erkannt Bank2" UBYTE B_TRUE 1 100 0 1 BIT_MASK 0x1 FORMAT "%13.11" ECU_ADDRESS 0x3FBFF8 /end MEASUREMENT
/begin MEASUREMENT B_maxlavh "Bedingung Maximalwert f¸r Vollast-Pr¸fung hinter KAT erkannt" UBYTE B_TRUE 1 100 0 1 BIT_MASK 0x4 FORMAT "%13.11" ECU_ADDRESS 0x403B7C /end MEASUREMENT
/begin MEASUREMENT B_maxlavh2 "Bedingung Maximalwert f¸r Vollast-Pr¸fung hinter KAT erkannt Bank2" UBYTE B_TRUE 1 100 0 1 BIT_MASK 0x8 FORMAT "%13.11" ECU_ADDRESS 0x403B7C /end MEASUREMENT
/begin MEASUREMENT B_minflsh "Adernschluﬂ oder KS nach Masse bei Sonde  hinter KAT erkannt" UBYTE B_TRUE 1 100 0 1 BIT_MASK 0x4 FORMAT "%13.11" ECU_ADDRESS 0x403B88 /end MEASUREMENT
/begin MEASUREMENT B_minflsh2 "Adernschluﬂ oder KS nach Masse bei Sonde hinter KAT erkannt Bank2" UBYTE B_TRUE 1 100 0 1 BIT_MASK 0x8 FORMAT "%13.11" ECU_ADDRESS 0x403B88 /end MEASUREMENT
/begin MEASUREMENT B_minlash "Sonden Fehler Minimalwert f¸r Schwingungspr¸fung hinter KAT nicht erkannt" UBYTE B_TRUE 1 100 0 1 BIT_MASK 0x1 FORMAT "%13.11" ECU_ADDRESS 0x3FBFF9 /end MEASUREMENT
/begin MEASUREMENT B_minlash2 "Sonden-Fehler Minimalwert f¸r Schwingungspr¸fung hinter KAT nicht erkannt Bank2" UBYTE B_TRUE 1 100 0 1 BIT_MASK 0x1 FORMAT "%13.11" ECU_ADDRESS 0x3FBFFA /end MEASUREMENT
/begin MEASUREMENT B_mldkt "Bedingung Katdiagnose gesperrt wegen Motor-Luftmasse" UBYTE B_TRUE 1 100 0 1 BIT_MASK 0x20 FORMAT "%13.11" ECU_ADDRESS 0x402AF2 /end MEASUREMENT
/begin MEASUREMENT B_mldyn "Bedingung erforderliche Luftmasse im Schubbetrieb f¸r Dynamikmessung erreicht" UBYTE B_TRUE 1 100 0 1 BIT_MASK 0x1 FORMAT "%13.11" ECU_ADDRESS 0x3FBFFB /end MEASUREMENT
/begin MEASUREMENT B_mlustest "Bedingung ml ist innerhalb den Schwellen" UBYTE B_TRUE 1 100 0 1 BIT_MASK 0x1 FORMAT "%13.11" ECU_ADDRESS 0x3FBFFC /end MEASUREMENT
/begin MEASUREMENT B_noadsh "Bedingung kein Adernschluﬂ bei Lambdasonden hinter Kat" UBYTE B_TRUE 1 100 0 1 BIT_MASK 0x2 FORMAT "%13.11" ECU_ADDRESS 0x403B8B /end MEASUREMENT
/begin MEASUREMENT B_noadsh2 "Bedingung kein Adernschluﬂ bei Lambdasonden hinter Kat Bank2" UBYTE B_TRUE 1 100 0 1 BIT_MASK 0x2 FORMAT "%13.11" ECU_ADDRESS 0x403B8C /end MEASUREMENT
/begin MEASUREMENT B_nolash "Bedingung Diagnosefunktion Schwingungs-Pr¸fung. i.O.-Meldung beendet." UBYTE B_TRUE 1 100 0 1 BIT_MASK 0x1 FORMAT "%13.11" ECU_ADDRESS 0x3FBFFD /end MEASUREMENT
/begin MEASUREMENT B_nolash2 "Bedingung Diagnosefunktion Schwingungs-Pr¸fung. i.O.-Meldung beendet. Bank2" UBYTE B_TRUE 1 100 0 1 BIT_MASK 0x1 FORMAT "%13.11" ECU_ADDRESS 0x3FBFFE /end MEASUREMENT
/begin MEASUREMENT B_nolavh "Bedingung Diagnosefunktion Vollast-Pr¸f i.O.-Meldung" UBYTE B_TRUE 1 100 0 1 BIT_MASK 0x1 FORMAT "%13.11" ECU_ADDRESS 0x403B81 /end MEASUREMENT
/begin MEASUREMENT B_nolavh2 "Bedingung Diagnosefunktion Vollast-Pr¸fung i.O.-Meldung Bank2" UBYTE B_TRUE 1 100 0 1 BIT_MASK 0x1 FORMAT "%13.11" ECU_ADDRESS 0x403B82 /end MEASUREMENT
/begin MEASUREMENT B_nollrflr "Bedingung LLR-Diagnosefunktion mit i.O.-Meldung beendet." UBYTE B_TRUE 1 100 0 1 BIT_MASK 0x1 FORMAT "%13.11" ECU_ADDRESS 0x3FC225 /end MEASUREMENT
/begin MEASUREMENT B_nolsh "Bedingung Diagnosefunktion mit i.O.-Meldung hinter KAT beendet." UBYTE B_TRUE 1 100 0 1 BIT_MASK 0x1 FORMAT "%13.11" ECU_ADDRESS 0x3FC014 /end MEASUREMENT
/begin MEASUREMENT B_nolsh2 "Bedingung Diagnosefunktion mit i.O.-Meldung hinter KAT beendet Bank2" UBYTE B_TRUE 1 100 0 1 BIT_MASK 0x1 FORMAT "%13.11" ECU_ADDRESS 0x3FC015 /end MEASUREMENT
/begin MEASUREMENT B_norkam "Bedingung additive Korrektur der Adaption pro Zeit oder Z¸ndung abgeschaltet" UBYTE B_TRUE 1 100 0 1 BIT_MASK 0x1 FORMAT "%13.11" ECU_ADDRESS 0x3FC0AE /end MEASUREMENT
/begin MEASUREMENT B_nplflsh "Adernschluﬂ bei Sonde hinter KAT erkannt" UBYTE B_TRUE 1 100 0 1 BIT_MASK 0x40 FORMAT "%13.11" ECU_ADDRESS 0x403B88 /end MEASUREMENT
/begin MEASUREMENT B_nplflsh2 "Adernschluﬂ hinter KAT erkannt Bank2" UBYTE B_TRUE 1 100 0 1 BIT_MASK 0x80 FORMAT "%13.11" ECU_ADDRESS 0x403B88 /end MEASUREMENT
/begin MEASUREMENT B_npllash "Bedingung  ""nicht plausibler Wert"" f¸r Sonde hinter KAT" UBYTE B_TRUE 1 100 0 1 BIT_MASK 0x4 FORMAT "%13.11" ECU_ADDRESS 0x403B80 /end MEASUREMENT
/begin MEASUREMENT B_npllash2 "Bedingung  ""nicht plausibler Wert"" f¸r Sonde hinter KAT Bank2" UBYTE B_TRUE 1 100 0 1 BIT_MASK 0x8 FORMAT "%13.11" ECU_ADDRESS 0x403B80 /end MEASUREMENT
/begin MEASUREMENT B_npsna "Bedingung nicht plaus.: Sonde nicht aktiv" UBYTE B_TRUE 1 100 0 1 BIT_MASK 0x80 FORMAT "%13.11" ECU_ADDRESS 0x402A76 /end MEASUREMENT
/begin MEASUREMENT B_npsna2 "Bedingung nicht plaus.: Sonde nicht aktiv, Bank2" UBYTE B_TRUE 1 100 0 1 BIT_MASK 0x80 FORMAT "%13.11" ECU_ADDRESS 0x402A79 /end MEASUREMENT
/begin MEASUREMENT B_ocipll "Bedingung: Unterbrechung an IP erkannt (Pumpleitung)" UBYTE B_TRUE 1 100 0 1 BIT_MASK 0x4 FORMAT "%13.11" ECU_ADDRESS 0x402A78 /end MEASUREMENT
/begin MEASUREMENT B_ocipll2 "Bedingung: Unterbrechung an IP erkannt (Pumpleitung)" UBYTE B_TRUE 1 100 0 1 BIT_MASK 0x8 FORMAT "%13.11" ECU_ADDRESS 0x402A78 /end MEASUREMENT
/begin MEASUREMENT B_oeldr "Bedingung ÷ldruck" UBYTE B_TRUE 1 100 0 1 BIT_MASK 0x1 FORMAT "%13.11" ECU_ADDRESS 0x3FBEDA /end MEASUREMENT
/begin MEASUREMENT B_plra "Bedingung f¸r Umschaltung DKVS von HFM- auf P-System" UBYTE B_TRUE 1 100 0 1 BIT_MASK 0x1 FORMAT "%13.11" ECU_ADDRESS 0x3FC0AF /end MEASUREMENT
/begin MEASUREMENT B_predkt "Katalysatordiagnose durch Vorpr¸fung erfolgt" UBYTE B_TRUE 1 100 0 1 BIT_MASK 0x20 FORMAT "%13.11" ECU_ADDRESS 0x402AD5 /end MEASUREMENT
/begin MEASUREMENT B_predkt2 "Katalysatordiagnose durch Vorpr¸fung erfolgt, Bank2" UBYTE B_TRUE 1 100 0 1 BIT_MASK 0x20 FORMAT "%13.11" ECU_ADDRESS 0x402AD9 /end MEASUREMENT
/begin MEASUREMENT B_rdytes "Bedingung ready-Info des Tankentl¸ftungssystems  zum ‹bertrag ins  'ready-Byte'" UBYTE B_TRUE 1 100 0 1 BIT_MASK 0x1 FORMAT "%13.11" ECU_ADDRESS 0x3FDEF6 /end MEASUREMENT
/begin MEASUREMENT B_risigh "Bedingung Signalunterbrechung Sondenmasse mit Ri-Diagnose hinter KAT" UBYTE B_TRUE 1 100 0 1 BIT_MASK 0x1 FORMAT "%13.11" ECU_ADDRESS 0x3FC016 /end MEASUREMENT
/begin MEASUREMENT B_risigh2 "Bedingung Signalunterbrechung Sondenmasse mit Ri-Diagnose hinter KAT Bank2" UBYTE B_TRUE 1 100 0 1 BIT_MASK 0x1 FORMAT "%13.11" ECU_ADDRESS 0x3FC017 /end MEASUREMENT
/begin MEASUREMENT B_rkam "Bedingung einer der beiden additiven Bereiche aktiv" UBYTE B_TRUE 1 100 0 1 BIT_MASK 0x1 FORMAT "%13.11" ECU_ADDRESS 0x3FC0B0 /end MEASUREMENT
/begin MEASUREMENT B_rkamr "Bedingung rkat oder rkaz auﬂerhalb reduzierter Schwellen" UBYTE B_TRUE 1 100 0 1 BIT_MASK 0x1 FORMAT "%13.11" ECU_ADDRESS 0x3FC0B1 /end MEASUREMENT
/begin MEASUREMENT B_rkamr2 "Bedingung rkat2 oder rkaz2 auﬂerhalb reduzierter Schwellen" UBYTE B_TRUE 1 100 0 1 BIT_MASK 0x1 FORMAT "%13.11" ECU_ADDRESS 0x3FC0B2 /end MEASUREMENT
/begin MEASUREMENT B_sbbhk "Bedingung Sonde betriebsbereit hinter Kat" UBYTE B_TRUE 1 100 0 1 BIT_MASK 0x1 FORMAT "%13.11" ECU_ADDRESS 0x3FC018 /end MEASUREMENT
/begin MEASUREMENT B_sbbhk2 "Bedingung Sonde betriebsbereit hinter Kat Bank2" UBYTE B_TRUE 1 100 0 1 BIT_MASK 0x1 FORMAT "%13.11" ECU_ADDRESS 0x3FC019 /end MEASUREMENT
/begin MEASUREMENT B_sbbhkre "Bedingung Sonden Betriebsbereitschaft  hinter Kat zur¸ckgesetzt" UBYTE B_TRUE 1 100 0 1 BIT_MASK 0x4 FORMAT "%13.11" ECU_ADDRESS 0x403B8B /end MEASUREMENT
/begin MEASUREMENT B_sbbhkre2 "Bedingung Sonden Betriebsbereitschaft  hinter Kat zur¸ckgesetzt Bank2" UBYTE B_TRUE 1 100 0 1 BIT_MASK 0x4 FORMAT "%13.11" ECU_ADDRESS 0x403B8C /end MEASUREMENT
/begin MEASUREMENT B_sbbhkv "Bedingung Sonde betriebsbereit hinter Kat verzˆgert" UBYTE B_TRUE 1 100 0 1 BIT_MASK 0x2 FORMAT "%13.11" ECU_ADDRESS 0x403B7B /end MEASUREMENT
/begin MEASUREMENT B_sbbhkv2 "Bedingung Sonde betriebsbereit hinter Kat verzˆgert, Bank 2" UBYTE B_TRUE 1 100 0 1 BIT_MASK 0x20 FORMAT "%13.11" ECU_ADDRESS 0x403B7B /end MEASUREMENT
/begin MEASUREMENT B_sigflsh "Signalunterbrechung (Kabelbruch) Bei Sonde hinter KAT erkannt" UBYTE B_TRUE 1 100 0 1 BIT_MASK 0x10 FORMAT "%13.11" ECU_ADDRESS 0x403B88 /end MEASUREMENT
/begin MEASUREMENT B_sigflsh2 "Signalunterbrechung (Kabelbruch) bei Sonde hinter KAT erkannt Bank2" UBYTE B_TRUE 1 100 0 1 BIT_MASK 0x20 FORMAT "%13.11" ECU_ADDRESS 0x403B88 /end MEASUREMENT
/begin MEASUREMENT B_siglash "Bedingung Sonden-Fehler hinter KAT im Schub erkannt" UBYTE B_TRUE 1 100 0 1 BIT_MASK 0x1 FORMAT "%13.11" ECU_ADDRESS 0x403B80 /end MEASUREMENT
/begin MEASUREMENT B_siglash2 "Sonden-Fehler hinter KAT im Schub und Vollast erkannt. Bank2" UBYTE B_TRUE 1 100 0 1 BIT_MASK 0x2 FORMAT "%13.11" ECU_ADDRESS 0x403B80 /end MEASUREMENT
/begin MEASUREMENT B_slsrdy "Bedingung SLS gepr¸ft f¸r 'ready-Byte'" UBYTE B_TRUE 1 100 0 1 BIT_MASK 0x8 FORMAT "%13.11" ECU_ADDRESS 0x3FDEF3 /end MEASUREMENT
/begin MEASUREMENT B_spf3k "Bedingung: Anforderung, das 3kHz-Meﬂsignal f¸r Ri abschalten" UBYTE B_TRUE 1 100 0 1 BIT_MASK 0x8 FORMAT "%13.11" ECU_ADDRESS 0x402A74 /end MEASUREMENT
/begin MEASUREMENT B_spf3k2 "Bedingung: Anforderung, das 3kHz-Meﬂsignal f¸r Ri abschalten, Bank 2" UBYTE B_TRUE 1 100 0 1 BIT_MASK 0x80 FORMAT "%13.11" ECU_ADDRESS 0x402A74 /end MEASUREMENT
/begin MEASUREMENT B_steigm "Bedingung Steigung des Sondensignals messen hinter KAT" UBYTE B_TRUE 1 100 0 1 BIT_MASK 0x2 FORMAT "%13.11" ECU_ADDRESS 0x403B7D /end MEASUREMENT
/begin MEASUREMENT B_steigm2 "Bedingung Steigung des Sondensignals messen Bank2" UBYTE B_TRUE 1 100 0 1 BIT_MASK 0x8 FORMAT "%13.11" ECU_ADDRESS 0x403B7D /end MEASUREMENT
/begin MEASUREMENT B_su "Bedingung Saugrohrumschaltung" UBYTE B_TRUE 1 100 0 1 BIT_MASK 0x1 FORMAT "%13.11" ECU_ADDRESS 0x3FC06B /end MEASUREMENT
/begin MEASUREMENT B_teslash "Bedingung Test ausf¸hren f¸r ‹berpr¸fung Sonde hinter KAT" UBYTE B_TRUE 1 100 0 1 BIT_MASK 0x1 FORMAT "%13.11" ECU_ADDRESS 0x3FBFFF /end MEASUREMENT
/begin MEASUREMENT B_teslash2 "Bedingung Test ausf¸hren f¸r ‹berpr¸fung Sonde hinter KAT Bank2" UBYTE B_TRUE 1 100 0 1 BIT_MASK 0x1 FORMAT "%13.11" ECU_ADDRESS 0x3FC000 /end MEASUREMENT
/begin MEASUREMENT B_tesrdy "Bedingung TES gepr¸ft f¸r 'ready-Byte'" UBYTE B_TRUE 1 100 0 1 BIT_MASK 0x4 FORMAT "%13.11" ECU_ADDRESS 0x3FDEF3 /end MEASUREMENT
/begin MEASUREMENT B_tmsdkt "Bedingung Katdiagnose gesperrt wg. zu kleiner Motorstart-Temperatur" UBYTE B_TRUE 1 100 0 1 BIT_MASK 0x20 FORMAT "%13.11" ECU_ADDRESS 0x402AEE /end MEASUREMENT
/begin MEASUREMENT B_todkts "Bedingung Time out gespeichert bei Katalysatordiagnose" UBYTE B_TRUE 1 100 0 1 BIT_MASK 0x1 FORMAT "%13.11" ECU_ADDRESS 0x402AD6 /end MEASUREMENT
/begin MEASUREMENT B_todkts2 "Bedingung Time out gespeichert bei Katalysatordiagnose, Bank2" UBYTE B_TRUE 1 100 0 1 BIT_MASK 0x2 FORMAT "%13.11" ECU_ADDRESS 0x402AD6 /end MEASUREMENT
/begin MEASUREMENT B_trfash "Bedingung Kurztrip einleiten f¸r Schwingungspr¸fung Sonde hinter KAT" UBYTE B_TRUE 1 100 0 1 BIT_MASK 0x1 FORMAT "%13.11" ECU_ADDRESS 0x3FC001 /end MEASUREMENT
/begin MEASUREMENT B_trfash2 "Bedingung Kurztrip einleiten f¸r Schwingungspr¸fung Sonde hinter KAT Bank2" UBYTE B_TRUE 1 100 0 1 BIT_MASK 0x1 FORMAT "%13.11" ECU_ADDRESS 0x3FC002 /end MEASUREMENT
/begin MEASUREMENT B_trsah "Bedingung Kabelbruch f¸r Sonde hinter KAT" UBYTE B_TRUE 1 100 0 1 BIT_MASK 0x4 FORMAT "%13.11" ECU_ADDRESS 0x403B89 /end MEASUREMENT
/begin MEASUREMENT B_trsah2 "Bedingung Kabelbruch f¸r Sonde hinter KAT, Bank 2" UBYTE B_TRUE 1 100 0 1 BIT_MASK 0x4 FORMAT "%13.11" ECU_ADDRESS 0x403B8A /end MEASUREMENT
/begin MEASUREMENT B_ttbmhh "Bedingung theoretische Sondenbetriebsbereitschaft hinter KAT mit Heizung" UBYTE B_TRUE 1 100 0 1 BIT_MASK 0x1 FORMAT "%13.11" ECU_ADDRESS 0x3FC01A /end MEASUREMENT
/begin MEASUREMENT B_ttbmhh2 "Bedingung theoretische Sondenbetriebsbereitschaft hinter KAT mit Heizung Bank2" UBYTE B_TRUE 1 100 0 1 BIT_MASK 0x1 FORMAT "%13.11" ECU_ADDRESS 0x3FC01B /end MEASUREMENT
/begin MEASUREMENT B_tushzfh "Bedingung f¸r Zeitfenster Heizertakt-Einkopplung hinter KAT" UBYTE B_TRUE 1 100 0 1 BIT_MASK 0x1 FORMAT "%13.11" ECU_ADDRESS 0x3FC01C /end MEASUREMENT
/begin MEASUREMENT B_tushzfh2 "Bedingung f¸r Zeitfenster Heizertakt-Einkopplung hinter KAT Bank2" UBYTE B_TRUE 1 100 0 1 BIT_MASK 0x1 FORMAT "%13.11" ECU_ADDRESS 0x3FC01D /end MEASUREMENT
/begin MEASUREMENT B_uhsig "Bedingung Sondenspannung hinter KAT im Spannungsband f¸r Signalunterbrechung" UBYTE B_TRUE 1 100 0 1 BIT_MASK 0x8 FORMAT "%13.11" ECU_ADDRESS 0x403B8B /end MEASUREMENT
/begin MEASUREMENT B_uhsig2 "Bedingung Sondenspg. hinter KAT im Spannungsband f¸r Signalunterbrechung Bank2" UBYTE B_TRUE 1 100 0 1 BIT_MASK 0x8 FORMAT "%13.11" ECU_ADDRESS 0x403B8C /end MEASUREMENT
/begin MEASUREMENT B_uscherf "Bedingung Messung Sondenspannung hinter KAT f¸r Schubmessung erf¸llt" UBYTE B_TRUE 1 100 0 1 BIT_MASK 0x1 FORMAT "%13.11" ECU_ADDRESS 0x403B7F /end MEASUREMENT
/begin MEASUREMENT B_uscherf2 "Bedingung Messung Sondenspannung f¸r hinter Kat Schubmessung erf¸llt Bank2" UBYTE B_TRUE 1 100 0 1 BIT_MASK 0x10 FORMAT "%13.11" ECU_ADDRESS 0x403B7F /end MEASUREMENT
/begin MEASUREMENT B_ushkf "Bedingung Sondenspannung hinter Kat ""Fett"" (Sollwert ¸berschritten)" UBYTE B_TRUE 1 100 0 1 BIT_MASK 0x1 FORMAT "%13.11" ECU_ADDRESS 0x3FC003 /end MEASUREMENT
/begin MEASUREMENT B_ushkf2 "Bedingung Sondenspannung hinter KAT ""Fett"" (Sollwert ¸berschritten) Bank2" UBYTE B_TRUE 1 100 0 1 BIT_MASK 0x1 FORMAT "%13.11" ECU_ADDRESS 0x3FC004 /end MEASUREMENT
/begin MEASUREMENT B_ushkm "Bedingung Sondenspannung hinter KAT ""Mager"" (Sollwert unterschritten)" UBYTE B_TRUE 1 100 0 1 BIT_MASK 0x1 FORMAT "%13.11" ECU_ADDRESS 0x3FC005 /end MEASUREMENT
/begin MEASUREMENT B_ushkm2 "Bedingung Sondenspannung hinter KAT ""Mager"" (Sollwert unterschritten) Bank2" UBYTE B_TRUE 1 100 0 1 BIT_MASK 0x1 FORMAT "%13.11" ECU_ADDRESS 0x3FC006 /end MEASUREMENT
/begin MEASUREMENT B_ushkmf "Bedingung, Bit B_ushkf und B_ushkm gesetzt, hinter Hauptkat" UBYTE B_TRUE 1 100 0 1 BIT_MASK 0x8 FORMAT "%13.11" ECU_ADDRESS 0x403B7F /end MEASUREMENT
/begin MEASUREMENT B_ushkmf2 "Bedingung, Bit B_ushkf und B_ushkm gesetz, hinter Hauptkat, Bank2" UBYTE B_TRUE 1 100 0 1 BIT_MASK 0x80 FORMAT "%13.11" ECU_ADDRESS 0x403B7F /end MEASUREMENT
/begin MEASUREMENT B_ushkrfm "Bedingung f¸r Wiederholungsmessung Schwingungspr. h. KAT (Reset F/M -Flip-Flop)" UBYTE B_TRUE 1 100 0 1 BIT_MASK 0x8 FORMAT "%13.11" ECU_ADDRESS 0x403B7E /end MEASUREMENT
/begin MEASUREMENT B_ushkrfm2 "Bedingung f¸r Wiederholungsmessung Schwingungspr. (Reset F/M -Flip-Flop) Bank2" UBYTE B_TRUE 1 100 0 1 BIT_MASK 0x80 FORMAT "%13.11" ECU_ADDRESS 0x403B7E /end MEASUREMENT
/begin MEASUREMENT B_ushsch "Bed. Schwelle f¸r Sonde h. KAT im Schub nicht unterschritten `statichisch`" UBYTE B_TRUE 1 100 0 1 BIT_MASK 0x4 FORMAT "%13.11" ECU_ADDRESS 0x3FE094 /end MEASUREMENT
/begin MEASUREMENT B_ushsch2 "Bed. Schwelle f¸r Sonde h. KAT im Schub nicht unterschritten `statisch` Bank2" UBYTE B_TRUE 1 100 0 1 BIT_MASK 0x8 FORMAT "%13.11" ECU_ADDRESS 0x3FE094 /end MEASUREMENT
/begin MEASUREMENT B_usrhkmx "Bedingung f¸r fehlerhafte Sonden hinter KAT nach abgeschlossenem Test" UBYTE B_TRUE 1 100 0 1 BIT_MASK 0x10 FORMAT "%13.11" ECU_ADDRESS 0x3FE094 /end MEASUREMENT
/begin MEASUREMENT B_usrhkmx2 "Bedingung f¸r fehlerhafte Sonden hinter KAT nach abgeschlossenem Test Bank2" UBYTE B_TRUE 1 100 0 1 BIT_MASK 0x20 FORMAT "%13.11" ECU_ADDRESS 0x3FE094 /end MEASUREMENT
/begin MEASUREMENT B_vekat "Fehlerverdacht bei Katdiagnose" UBYTE B_TRUE 1 100 0 1 BIT_MASK 0x1 FORMAT "%13.11" ECU_ADDRESS 0x3FE090 /end MEASUREMENT
/begin MEASUREMENT B_vekat2 "Fehlerverdacht bei Katdiagnose, Bank2" UBYTE B_TRUE 1 100 0 1 BIT_MASK 0x2 FORMAT "%13.11" ECU_ADDRESS 0x3FE090 /end MEASUREMENT
/begin MEASUREMENT B_vekati "Interner Fehlerverdacht bei Katdiagnose" UBYTE B_TRUE 1 100 0 1 BIT_MASK 0x1 FORMAT "%13.11" ECU_ADDRESS 0x402AD2 /end MEASUREMENT
/begin MEASUREMENT B_vekati2 "Interner Fehlerverdacht bei Katdiagnose, Bank2" UBYTE B_TRUE 1 100 0 1 BIT_MASK 0x4 FORMAT "%13.11" ECU_ADDRESS 0x402AD2 /end MEASUREMENT
/begin MEASUREMENT B_vekatv "Fehlerverdacht bei Katdiagnose, verzˆgert" UBYTE B_TRUE 1 100 0 1 BIT_MASK 0x8 FORMAT "%13.11" ECU_ADDRESS 0x402AEE /end MEASUREMENT
/begin MEASUREMENT B_vekatv2 "Fehlerverdacht bei Katdiagnose, verzˆgert, Bank2" UBYTE B_TRUE 1 100 0 1 BIT_MASK 0x8 FORMAT "%13.11" ECU_ADDRESS 0x402AF0 /end MEASUREMENT
/begin MEASUREMENT B_vlsufm "Bed. Verdacht LSU-Fehler (Fett oder Mager). Vorbereitung zum Rampentest h. Kat" UBYTE B_TRUE 1 100 0 1 BIT_MASK 0x1 FORMAT "%13.11" ECU_ADDRESS 0x403B7E /end MEASUREMENT
/begin MEASUREMENT B_vlsufm2 "Bed. Verdacht LSU-Fehler (F oder M). Vorbereitung zum Rampentest h. Kat Bank2" UBYTE B_TRUE 1 100 0 1 BIT_MASK 0x10 FORMAT "%13.11" ECU_ADDRESS 0x403B7E /end MEASUREMENT
/begin MEASUREMENT B_wuc_di "Bedingung warmupcycle f¸r DISA" UBYTE B_TRUE 1 100 0 1 BIT_MASK 0x1 FORMAT "%13.11" ECU_ADDRESS 0x3FC06C /end MEASUREMENT
/begin MEASUREMENT B_zdkt "Bedingung: Katdiagnose: Gutpr¸fung" UBYTE B_TRUE 1 100 0 1 BIT_MASK 0x2 FORMAT "%13.11" ECU_ADDRESS 0x402AD5 /end MEASUREMENT
/begin MEASUREMENT B_zdkt2 "Bedingung: Katdiagnose: Gutpr¸fung" UBYTE B_TRUE 1 100 0 1 BIT_MASK 0x2 FORMAT "%13.11" ECU_ADDRESS 0x402AD9 /end MEASUREMENT
/begin MEASUREMENT B_zfrao "wenn gleich TRUE, dann ist FRAO gepr¸ft" UBYTE B_TRUE 1 100 0 1 BIT_MASK 0x4 FORMAT "%13.11" ECU_ADDRESS 0x402D6F /end MEASUREMENT
/begin MEASUREMENT B_zfrao2 "wenn gleich TRUE, dann ist FRAO2 gepr¸ft" UBYTE B_TRUE 1 100 0 1 BIT_MASK 0x80 FORMAT "%13.11" ECU_ADDRESS 0x402D6F /end MEASUREMENT
/begin MEASUREMENT B_zfrau "wenn gleich TRUE, dann ist FRAU gepr¸ft" UBYTE B_TRUE 1 100 0 1 BIT_MASK 0x2 FORMAT "%13.11" ECU_ADDRESS 0x402D6F /end MEASUREMENT
/begin MEASUREMENT B_zfrau2 "wenn gleich TRUE, dann ist FRAU2 gepr¸ft" UBYTE B_TRUE 1 100 0 1 BIT_MASK 0x40 FORMAT "%13.11" ECU_ADDRESS 0x402D6F /end MEASUREMENT
/begin MEASUREMENT B_zkat "Bedingung: Zyklusflag setzen, Katdiagnose" UBYTE B_TRUE 1 100 0 1 BIT_MASK 0x10 FORMAT "%13.11" ECU_ADDRESS 0x402AD5 /end MEASUREMENT
/begin MEASUREMENT B_zkat2 "Bedingung: Zyklusflag setzen, Katdiagnose" UBYTE B_TRUE 1 100 0 1 BIT_MASK 0x10 FORMAT "%13.11" ECU_ADDRESS 0x402AD9 /end MEASUREMENT
/begin MEASUREMENT B_zlshv "Hilfsbit zur Auswertung des Zyklusbits Z_lshv f¸r Vertausch. Sonde h. Kat" UBYTE B_TRUE 1 100 0 1 BIT_MASK 0x10 FORMAT "%13.11" ECU_ADDRESS 0x403B8B /end MEASUREMENT
/begin MEASUREMENT B_zlshv2 "Hilfsbit zur Auswertung des Zyklusbits Z_lshv2 f¸r vert. Sonde hinter Kat  Bank2" UBYTE B_TRUE 1 100 0 1 BIT_MASK 0x10 FORMAT "%13.11" ECU_ADDRESS 0x403B8C /end MEASUREMENT
/begin MEASUREMENT B_zlsuia "Bedingung kein Fehler bzgl. Sondenspannung w‰hrend des Schubes / Leitung IA ok" UBYTE B_TRUE 1 100 0 1 BIT_MASK 0x1 FORMAT "%13.11" ECU_ADDRESS 0x402A78 /end MEASUREMENT
/begin MEASUREMENT B_zlsuia2 "Bedingung kein Fehler bzgl. Sondenspannung w‰hrend des Schubes / Leitung IA ok" UBYTE B_TRUE 1 100 0 1 BIT_MASK 0x2 FORMAT "%13.11" ECU_ADDRESS 0x402A78 /end MEASUREMENT
/begin MEASUREMENT B_zrkat "wenn gleich TRUE, dann ist RKAT gepr¸ft" UBYTE B_TRUE 1 100 0 1 BIT_MASK 0x8 FORMAT "%13.11" ECU_ADDRESS 0x402D6F /end MEASUREMENT
/begin MEASUREMENT B_zrkat2 "wenn gleich TRUE, dann ist RKAT2 gepr¸ft" UBYTE B_TRUE 1 100 0 1 BIT_MASK 0x1 FORMAT "%13.11" ECU_ADDRESS 0x402D6E /end MEASUREMENT
/begin MEASUREMENT B_zrkaz "wenn gleich TRUE, dann ist RKAZ gepr¸ft" UBYTE B_TRUE 1 100 0 1 BIT_MASK 0x10 FORMAT "%13.11" ECU_ADDRESS 0x402D6F /end MEASUREMENT
/begin MEASUREMENT B_zrkaz2 "wenn gleich TRUE, dann ist RKAZ2 gepr¸ft" UBYTE B_TRUE 1 100 0 1 BIT_MASK 0x2 FORMAT "%13.11" ECU_ADDRESS 0x402D6E /end MEASUREMENT
/begin MEASUREMENT cryddmtl "Counter f¸r Readinessbildung Leckdiagnose DDMTL" UBYTE dez 1 100 0 255 FORMAT "%5.1" ECU_ADDRESS 0x3FDEF4 /end MEASUREMENT
/begin MEASUREMENT crydtev "Counter f¸r Readinessbildung TEV-Diagnose DTEV" UBYTE dez 1 100 0 255 FORMAT "%5.1" ECU_ADDRESS 0x3FDEF5 /end MEASUREMENT
/begin MEASUREMENT cryhs "Counter f¸r Readinessbildung Sondenheizungs-Diagnose" UBYTE dez 1 100 0 255 FORMAT "%5.1" ECU_ADDRESS 0x3FDEEE /end MEASUREMENT
/begin MEASUREMENT crykat "Counter f¸r Readinessbildung Katalysator-Diagnose" UBYTE dez 1 100 0 255 FORMAT "%5.1" ECU_ADDRESS 0x3FDEEF /end MEASUREMENT
/begin MEASUREMENT cryls "Counter f¸r Readinessbildung Lambdasonden-Diagnose" UBYTE dez 1 100 0 255 FORMAT "%5.1" ECU_ADDRESS 0x3FDEF0 /end MEASUREMENT
/begin MEASUREMENT crysls "Counter f¸r Readinessbildung Sekund‰rluft-Diagnose" UBYTE dez 1 100 0 255 FORMAT "%5.1" ECU_ADDRESS 0x3FDEF1 /end MEASUREMENT
/begin MEASUREMENT crytes "Counter f¸r Readinessbildung Tankentl¸ftungs-Diagnose" UBYTE dez 1 100 0 255 FORMAT "%5.1" ECU_ADDRESS 0x3FDEF2 /end MEASUREMENT
/begin MEASUREMENT dfrsna2_w "Lambdareglerausgangs‰nderung w‰hrend UASNAMN<ua10mo<UASNAMX" UWORD fak_uw_b2 1 100 0 1.99997 FORMAT "%8.6" ECU_ADDRESS 0x402A5C /end MEASUREMENT
/begin MEASUREMENT dfrsna_w "Lambdareglerausgangs‰nderung w‰hrend UASNAMN<ua10mo<UASNAMX" UWORD fak_uw_b2 1 100 0 1.99997 FORMAT "%8.6" ECU_ADDRESS 0x402A5E /end MEASUREMENT
/begin MEASUREMENT diagtime "" UBYTE dez 1 100 0 255 FORMAT "%5.1" ECU_ADDRESS 0x403826 /end MEASUREMENT
/begin MEASUREMENT diberrctr1 "Entprellzaehler BSD Fehler" UBYTE t100msxs_ub_b25p5 1 100 0 25.5 FORMAT "%5.2" ECU_ADDRESS 0x4031F9 /end MEASUREMENT
/begin MEASUREMENT diberrctr2 "Entprellzaehler EBSD" UBYTE t100msxs_ub_b25p5 1 100 0 25.5 FORMAT "%5.2" ECU_ADDRESS 0x4031FA /end MEASUREMENT
/begin MEASUREMENT diberrctr3 "Entprellzaehler IBS SW Fehler" UBYTE t100msxs_ub_b25p5 1 100 0 25.5 FORMAT "%5.2" ECU_ADDRESS 0x4031FB /end MEASUREMENT
/begin MEASUREMENT diberrctr4 "Entprellzaehler Stromfehler" UBYTE dez 1 100 0 255 FORMAT "%5.1" ECU_ADDRESS 0x4031FC /end MEASUREMENT
/begin MEASUREMENT diberrctr5 "Entprellzaehler Spannungsfehler" UBYTE dez 1 100 0 255 FORMAT "%5.1" ECU_ADDRESS 0x4031FD /end MEASUREMENT
/begin MEASUREMENT diberrctr6 "Entprellzaehler Temp.fehler" UBYTE dez 1 100 0 255 FORMAT "%5.1" ECU_ADDRESS 0x4031FE /end MEASUREMENT
/begin MEASUREMENT diberrctr7 "Entprellzaehler IBS Systemfehler" UBYTE dez 1 100 0 255 FORMAT "%5.1" ECU_ADDRESS 0x4031FF /end MEASUREMENT
/begin MEASUREMENT diberrctr8 "Entprellzaehler IBS KL20wu Fehler" UBYTE dez 1 100 0 255 FORMAT "%5.1" ECU_ADDRESS 0x403200 /end MEASUREMENT
/begin MEASUREMENT diberrctr9 "" UBYTE t100msxs_ub_b25p5 1 100 0 25.5 FORMAT "%5.2" ECU_ADDRESS 0x403201 /end MEASUREMENT
/begin MEASUREMENT dibhealct1 "Entprellzaehler Fehlerheilung Ort 1" UBYTE t100msxs_ub_b25p5 1 100 0 25.5 FORMAT "%5.2" ECU_ADDRESS 0x403202 /end MEASUREMENT
/begin MEASUREMENT dibhealct2 "Entprellzaehler Fehlerheilung Ort 2" UBYTE dez 1 100 0 255 FORMAT "%5.1" ECU_ADDRESS 0x403203 /end MEASUREMENT
/begin MEASUREMENT dibhealct3 "Entprellzaehler Fehlerheilung Ort 3" UBYTE dez 1 100 0 255 FORMAT "%5.1" ECU_ADDRESS 0x403204 /end MEASUREMENT
/begin MEASUREMENT diclsuAusBits1 "" UBYTE dez 1 100 0 255 FORMAT "%5.1" ECU_ADDRESS 0x402A74 /end MEASUREMENT
/begin MEASUREMENT diclsuAusBits2 "" UBYTE dez 1 100 0 255 FORMAT "%5.1" ECU_ADDRESS 0x402A75 /end MEASUREMENT
/begin MEASUREMENT diclsuLokBits1 "" UBYTE dez 1 100 0 255 FORMAT "%5.1" ECU_ADDRESS 0x402A76 /end MEASUREMENT
/begin MEASUREMENT diclsuLokBits2 "" UBYTE dez 1 100 0 255 FORMAT "%5.1" ECU_ADDRESS 0x402A77 /end MEASUREMENT
/begin MEASUREMENT diclsuLokBits3 "" UBYTE dez 1 100 0 255 FORMAT "%5.1" ECU_ADDRESS 0x402A78 /end MEASUREMENT
/begin MEASUREMENT diclsuLokBits4 "" UBYTE dez 1 100 0 255 FORMAT "%5.1" ECU_ADDRESS 0x402A79 /end MEASUREMENT
/begin MEASUREMENT Dicntlern "Z‰hler: Anzahl der Lernversuche" UBYTE dez 1 100 0 255 FORMAT "%5.1" ECU_ADDRESS 0x3FE0E1 /end MEASUREMENT
/begin MEASUREMENT Dicntlfehl "Z‰hler: Anzahl der der fehlgeschlagenen Lernversuche" UBYTE dez 1 100 0 255 FORMAT "%5.1" ECU_ADDRESS 0x3FE0E2 /end MEASUREMENT
/begin MEASUREMENT DIMCTESausbits1 "" UBYTE dez 1 100 0 255 FORMAT "%5.1" ECU_ADDRESS 0x403B2D /end MEASUREMENT
/begin MEASUREMENT DIMCTESausbitsNOV1 "" UBYTE dez 1 100 0 255 FORMAT "%5.1" ECU_ADDRESS 0x3FDEF6 /end MEASUREMENT
/begin MEASUREMENT Disaaus_i "Reglerausgang i-Regler" UWORD vnstv_q0p00305s32768 1 100 -100 99.9969 ECU_ADDRESS 0x402C8C /end MEASUREMENT
/begin MEASUREMENT Disaaus_p "Reglerausgang p-Regler" UWORD vnstv_q0p00305s32768 1 100 -100 99.9969 ECU_ADDRESS 0x402C8E /end MEASUREMENT
/begin MEASUREMENT Disaaus_w "Regelausgang" SWORD vnstv_q0p00305 1 100 -100 99.9969 FORMAT "%7.3" ECU_ADDRESS 0x4044DC /end MEASUREMENT
/begin MEASUREMENT Disa_dir "Verstellrichtung DISA" UBYTE dez 1 100 0 255 FORMAT "%5.1" ECU_ADDRESS 0x402C82 /end MEASUREMENT
/begin MEASUREMENT Disa_ist "Istwert bei geregelter Saugrohrumschaltung" UWORD vnstv_q0p00305 1 100 0 199.997 FORMAT "%7.3" ECU_ADDRESS 0x402C90 /end MEASUREMENT
/begin MEASUREMENT Disa_lern "Hilfsgrˆsse zur Disa-UMA-Erkennung" UBYTE dez 1 100 0 255 FORMAT "%5.1" ECU_ADDRESS 0x402C83 /end MEASUREMENT
/begin MEASUREMENT Disa_soll "Disa Sollwert" UBYTE PCENT 1 100 0 99.6094 FORMAT "%5.2" ECU_ADDRESS 0x402C84 /end MEASUREMENT
/begin MEASUREMENT Disa_spgnv "Letzter gemessener Ist-Spannungswert beim Abstellen" UWORD spg_uw_b5 1 100 0 319.995 FORMAT "%8.4" ECU_ADDRESS 0x3FE0E6 /end MEASUREMENT
/begin MEASUREMENT Disa_st "DISA Status Start-/Abstellstellung" UBYTE dez 1 100 0 255 FORMAT "%5.1" ECU_ADDRESS 0x402C85 /end MEASUREMENT
/begin MEASUREMENT Disa_uma "Disa UMA Lernwert" UWORD spg_uw_b5 1 100 0 319.995 FORMAT "%8.4" ECU_ADDRESS 0x3FE0E8 /end MEASUREMENT
/begin MEASUREMENT Disolakt "Sollwert f¸r DISA-Regelung" UWORD vnstv_q0p00305 1 100 0 199.997 FORMAT "%7.3" ECU_ADDRESS 0x402C92 /end MEASUREMENT
/begin MEASUREMENT Ditv_aus "Tastverh‰ltnis f¸r DISA-Stellmotor" UWORD di_uw_q0p01 1 100 0 655.35 FORMAT "%8.4" ECU_ADDRESS 0x402C94 /end MEASUREMENT
/begin MEASUREMENT Di_cnt "Z‰hler zur Bestimmung der Schaltzeit des DISA-Stellmotors" UBYTE di_uw_q0p01 1 100 0 2.55 FORMAT "%5.3" ECU_ADDRESS 0x402C86 /end MEASUREMENT
/begin MEASUREMENT di_lernst "Lernvorgang: aktuelle Lernstufe" UBYTE dez 1 100 0 255 FORMAT "%5.1" ECU_ADDRESS 0x3FE0E3 /end MEASUREMENT
/begin MEASUREMENT Di_lfehl "Fehlerflag Lernen" UBYTE dez 1 100 0 255 FORMAT "%5.1" ECU_ADDRESS 0x402C87 /end MEASUREMENT
/begin MEASUREMENT dkatspAusBits "" UBYTE dez 1 100 0 255 FORMAT "%5.1" ECU_ADDRESS 0x402AD2 /end MEASUREMENT
/begin MEASUREMENT dkatspAusBits20ms "" UBYTE dez 1 100 0 255 FORMAT "%5.1" ECU_ADDRESS 0x402AD3 /end MEASUREMENT
/begin MEASUREMENT dkatspAusBits20ms_2 "" UBYTE dez 1 100 0 255 FORMAT "%5.1" ECU_ADDRESS 0x402AD4 /end MEASUREMENT
/begin MEASUREMENT dkatspAusBitsNov "" UBYTE dez 1 100 0 255 FORMAT "%5.1" ECU_ADDRESS 0x3FE090 /end MEASUREMENT
/begin MEASUREMENT dkatspebAusBits "" UBYTE dez 1 100 0 255 FORMAT "%5.1" ECU_ADDRESS 0x402AEE /end MEASUREMENT
/begin MEASUREMENT dkatspebAusBits1 "" UBYTE dez 1 100 0 255 FORMAT "%5.1" ECU_ADDRESS 0x402AEF /end MEASUREMENT
/begin MEASUREMENT dkatspebAusBits_2 "" UBYTE dez 1 100 0 255 FORMAT "%5.1" ECU_ADDRESS 0x402AF0 /end MEASUREMENT
/begin MEASUREMENT dkatspebLokBits "" UBYTE dez 1 100 0 255 FORMAT "%5.1" ECU_ADDRESS 0x402AF1 /end MEASUREMENT
/begin MEASUREMENT dkatspebLokBits1 "" UBYTE dez 1 100 0 255 FORMAT "%5.1" ECU_ADDRESS 0x402AF2 /end MEASUREMENT
/begin MEASUREMENT dkatspLokBits "" UBYTE dez 1 100 0 255 FORMAT "%5.1" ECU_ADDRESS 0x402AD5 /end MEASUREMENT
/begin MEASUREMENT dkatspLokBits1 "" UBYTE dez 1 100 0 255 FORMAT "%5.1" ECU_ADDRESS 0x402AD6 /end MEASUREMENT
/begin MEASUREMENT dkatspLokBits20ms "" UBYTE dez 1 100 0 255 FORMAT "%5.1" ECU_ADDRESS 0x402AD7 /end MEASUREMENT
/begin MEASUREMENT dkatspLokBits20ms_2 "" UBYTE dez 1 100 0 255 FORMAT "%5.1" ECU_ADDRESS 0x402AD8 /end MEASUREMENT
/begin MEASUREMENT dkatspLokBits_2 "" UBYTE dez 1 100 0 255 FORMAT "%5.1" ECU_ADDRESS 0x402AD9 /end MEASUREMENT
/begin MEASUREMENT DKVS1lokbits "" UBYTE dez 1 100 0 255 FORMAT "%5.1" ECU_ADDRESS 0x402D6E /end MEASUREMENT
/begin MEASUREMENT DKVSbits "" UBYTE dez 1 100 0 255 FORMAT "%5.1" ECU_ADDRESS 0x3FE166 /end MEASUREMENT
/begin MEASUREMENT DKVSlokbits "" UBYTE dez 1 100 0 255 FORMAT "%5.1" ECU_ADDRESS 0x402D6F /end MEASUREMENT
/begin MEASUREMENT dlahisa "I-Anteil LRSHK Signalausgabe DLSSA (SY_STETLR := TRUE), Bank 1" UBYTE fak_ub_b0p1_o0p05 1 100 -0.05 0.0496094 FORMAT "%7.5" ECU_ADDRESS 0x402B0E /end MEASUREMENT
/begin MEASUREMENT dlahisa2 "I-Anteil LRSHK Signalausgabe DLSSA (SY_STETLR := TRUE), Bank 2" UBYTE fak_ub_b0p1_o0p05 1 100 -0.05 0.0496094 FORMAT "%7.5" ECU_ADDRESS 0x402B0F /end MEASUREMENT
/begin MEASUREMENT dlams2_w "Maximalwert Lambdasoll f¸r Test Schwingungspr¸fung hinter KAT Bank2" UWORD fak_uw_b16 1 100 0 15.9998 FORMAT "%8.5" ECU_ADDRESS 0x402AF8 /end MEASUREMENT
/begin MEASUREMENT dlams_w "Maximalwert Lambdasoll f¸r Test Schwingungspr¸fung hinter KAT" UWORD fak_uw_b16 1 100 0 15.9998 FORMAT "%8.5" ECU_ADDRESS 0x402AFA /end MEASUREMENT
/begin MEASUREMENT dlatrmi2_w "Delta Lambda aus I Anteil F¸hrungsregelung, Bank 2" SWORD fak_sw_b1 1 100 -1 0.999969 FORMAT "%8.6" ECU_ADDRESS 0x403EAE /end MEASUREMENT
/begin MEASUREMENT dlatrmi_w "Delta Lambda aus I Anteil F¸hrungsregelung" SWORD fak_sw_b1 1 100 -1 0.999969 FORMAT "%8.6" ECU_ADDRESS 0x403EB0 /end MEASUREMENT
/begin MEASUREMENT DLSHerrors "" UBYTE dez 1 100 0 255 FORMAT "%5.1" ECU_ADDRESS 0x403B88 /end MEASUREMENT
/begin MEASUREMENT dlursalt_f "" FLOAT32_IEEE fak_r32_1 1 100 -10000 10000 FORMAT "%27.21" ECU_ADDRESS 0x3FA984 /end MEASUREMENT
/begin MEASUREMENT dlurs_f "Laufunruhedifferenz-Referenzwert, signed" FLOAT32_IEEE fak_r32_1 1 100 -10000 10000 FORMAT "%27.21" ECU_ADDRESS 0x3FA988 /end MEASUREMENT
/begin MEASUREMENT dmrdkt_w "Momenten-Reserve f¸r Katalysatordiagnose" UWORD rel_uw_b100 1 100 0 99.9985 FORMAT "%8.5" ECU_ADDRESS 0x402A80 /end MEASUREMENT
/begin MEASUREMENT dmrlash_w "Momenten-Reserve f¸r Lambdasonden-Alterungs¸berwachung hinter Kat" UWORD rel_uw_b100 1 100 0 99.9985 FORMAT "%8.5" ECU_ADDRESS 0x402AFC /end MEASUREMENT
/begin MEASUREMENT dmrlsh_w "Momenten-Reserve f¸r Sondendiagnose hinter Kat" UWORD rel_uw_b100 1 100 0 99.9985 FORMAT "%8.5" ECU_ADDRESS 0x402B0C /end MEASUREMENT
/begin MEASUREMENT dulsuvm2_w "Spannungsdifferenz zwischen zwei Abtastungen von uulsuv_w, Bank 2" UWORD spg_q4p88Em4 1 100 0 31.9995 FORMAT "%8.5" ECU_ADDRESS 0x402A64 /end MEASUREMENT
/begin MEASUREMENT dulsuvm_w "Spannungsdifferenz zwischen zwei Abtastungen von uulsuv_w" UWORD spg_q4p88Em4 1 100 0 31.9995 FORMAT "%8.5" ECU_ADDRESS 0x402A66 /end MEASUREMENT
/begin MEASUREMENT dynlsusa "Dynamikwert der LSU, DLSSA" UBYTE fak_q0p0195 1 100 0 4.98047 FORMAT "%5.3" ECU_ADDRESS 0x402B10 /end MEASUREMENT
/begin MEASUREMENT dynlsusa2 "Dynamikwert der LSU, DLSSA Bank 2" UBYTE fak_q0p0195 1 100 0 4.98047 FORMAT "%5.3" ECU_ADDRESS 0x402B11 /end MEASUREMENT
/begin MEASUREMENT D_disa_kl "Delta Kennlinie" UWORD vnstv_q0p00305s32768 1 100 -100 99.9969 ECU_ADDRESS 0x402C96 /end MEASUREMENT
/begin MEASUREMENT D_disa_v "vorherige Regelabweichung" SWORD vnstv_q0p00305 1 100 -100 99.9969 FORMAT "%7.3" ECU_ADDRESS 0x402C98 /end MEASUREMENT
/begin MEASUREMENT D_disa_w "Regelabweichung" SWORD vnstv_q0p00305 1 100 -100 99.9969 FORMAT "%7.3" ECU_ADDRESS 0x402C9A /end MEASUREMENT
/begin MEASUREMENT EAS_lsp1hk "" UBYTE B_TRUE 1 100 0 1 BIT_MASK 0x1 FORMAT "%13.11" ECU_ADDRESS 0x3FBEDB /end MEASUREMENT
/begin MEASUREMENT EAS_lsp1vk "" UBYTE B_TRUE 1 100 0 1 BIT_MASK 0x1 FORMAT "%13.11" ECU_ADDRESS 0x3FBEDC /end MEASUREMENT
/begin MEASUREMENT EAS_lsp2hk "" UBYTE B_TRUE 1 100 0 1 BIT_MASK 0x1 FORMAT "%13.11" ECU_ADDRESS 0x3FBEDD /end MEASUREMENT
/begin MEASUREMENT EAS_lsp2vk "" UBYTE B_TRUE 1 100 0 1 BIT_MASK 0x1 FORMAT "%13.11" ECU_ADDRESS 0x3FBEDE /end MEASUREMENT
/begin MEASUREMENT ebCtrNewT "ETK bypass counter new, channel T" UBYTE dez 1 100 0 255 FORMAT "%5.1" ECU_ADDRESS 0x403827 /end MEASUREMENT
/begin MEASUREMENT ebCtrNewY "ETK bypass counter new, channel Y" UBYTE dez 1 100 0 255 FORMAT "%5.1" ECU_ADDRESS 0x403828 /end MEASUREMENT
/begin MEASUREMENT ebCtrOldT "ETK bypass counter old, channel T" UBYTE dez 1 100 0 255 FORMAT "%5.1" ECU_ADDRESS 0x403829 /end MEASUREMENT
/begin MEASUREMENT ebCtrOldY "ETK bypass counter old, channel Y" UBYTE dez 1 100 0 255 FORMAT "%5.1" ECU_ADDRESS 0x40382A /end MEASUREMENT
/begin MEASUREMENT ebMissT "ETK bypass counter misses, channel T" UWORD dez 1 100 0 65535 FORMAT "%8.2" ECU_ADDRESS 0x40437E /end MEASUREMENT
/begin MEASUREMENT ebMissY "ETK bypass counter misses, channel Y" UWORD dez 1 100 0 65535 FORMAT "%8.2" ECU_ADDRESS 0x404380 /end MEASUREMENT
/begin MEASUREMENT ES_lock "" UBYTE B_TRUE 1 100 0 1 BIT_MASK 0x1 FORMAT "%13.11" ECU_ADDRESS 0x3FBEDF /end MEASUREMENT
/begin MEASUREMENT ES_sfdisa "Output Status Flag DISA (H-Bridge Driver)" UBYTE B_TRUE 1 100 0 1 BIT_MASK 0x1 FORMAT "%13.11" ECU_ADDRESS 0x3FBEE0 /end MEASUREMENT
/begin MEASUREMENT ES_sfmdk "" UBYTE B_TRUE 1 100 0 1 BIT_MASK 0x1 FORMAT "%13.11" ECU_ADDRESS 0x3FBEE1 /end MEASUREMENT
/begin MEASUREMENT ES_wda "" UBYTE B_TRUE 1 100 0 1 BIT_MASK 0x1 FORMAT "%13.11" ECU_ADDRESS 0x3FBEE2 /end MEASUREMENT
/begin MEASUREMENT evsup1 "Funktionskennungsbyte f¸r Ausgabe SAE J1979 Mode2" UBYTE dez 1 100 0 255 FORMAT "%5.1" ECU_ADDRESS 0x403B2C /end MEASUREMENT
/begin MEASUREMENT E_hlpkrnt "Hilfserrorflag: Klopfregelung Nulltest" UBYTE B_TRUE 1 100 0 1 BIT_MASK 0x1 FORMAT "%13.11" ECU_ADDRESS 0x3FC1A3 /end MEASUREMENT
/begin MEASUREMENT E_hlpkrnt2 "Hilfserrorflag: Klopfregelung Nulltest (zweiter CC195)" UBYTE B_TRUE 1 100 0 1 BIT_MASK 0x1 FORMAT "%13.11" ECU_ADDRESS 0x3FC1A4 /end MEASUREMENT
/begin MEASUREMENT E_hlpkrof "Hilfserrorfleg: Klopfregelung Offset" UBYTE B_TRUE 1 100 0 1 BIT_MASK 0x1 FORMAT "%13.11" ECU_ADDRESS 0x3FC1A5 /end MEASUREMENT
/begin MEASUREMENT E_hlpkrof2 "Hilfserrorfleg: Klopfregelung Offset (zweiter CC195)" UBYTE B_TRUE 1 100 0 1 BIT_MASK 0x1 FORMAT "%13.11" ECU_ADDRESS 0x3FC1A6 /end MEASUREMENT
/begin MEASUREMENT E_hlpkrtp "Hilfserrorflag: Klopfregelung Testimpuls" UBYTE B_TRUE 1 100 0 1 BIT_MASK 0x1 FORMAT "%13.11" ECU_ADDRESS 0x3FC1AC /end MEASUREMENT
/begin MEASUREMENT E_hlpkrtp2 "Hilfserrorflag: Klopfregelung Testimpuls (zweiter CC195)" UBYTE B_TRUE 1 100 0 1 BIT_MASK 0x1 FORMAT "%13.11" ECU_ADDRESS 0x3FC1AD /end MEASUREMENT
/begin MEASUREMENT fdlurmin_f "Offset zur Differenzlaufunruhe bei unzureichender Adaption, aus DLURMIN" FLOAT32_IEEE fak_r32_1 1 100 -10000 10000 FORMAT "%27.21" ECU_ADDRESS 0x3FA98C /end MEASUREMENT
/begin MEASUREMENT fdlurs_f "" FLOAT32_IEEE fak_r32_1 1 100 -10000 10000 FORMAT "%27.21" ECU_ADDRESS 0x3FA990 /end MEASUREMENT
/begin MEASUREMENT fdlur_f "" FLOAT32_IEEE fak_r32_1 1 100 -10000 10000 FORMAT "%27.21" ECU_ADDRESS 0x3FA994 /end MEASUREMENT
/begin MEASUREMENT fgdkt2_w "Integrierte Fettgasmenge bei Katdiagnose. Bank2" UWORD m_q0p1_mg 1 100 0 6553.5 FORMAT "%8.3" ECU_ADDRESS 0x402A82 /end MEASUREMENT
/begin MEASUREMENT fgdkt_w "Integrierte Fettgasmenge bei Katdiagnose" UWORD m_q0p1_mg 1 100 0 6553.5 FORMAT "%8.3" ECU_ADDRESS 0x402A84 /end MEASUREMENT
/begin MEASUREMENT fkfdlur1_f "Basis Schwellwert f¸r Differenzlaufunruhe bei B_wk=1, Faktor aus KFDLUR1" FLOAT32_IEEE fak_r32_1 1 100 -10000 10000 FORMAT "%27.21" ECU_ADDRESS 0x3FA998 /end MEASUREMENT
/begin MEASUREMENT fkfdlur2_f "Basis Schwellwert f¸r Differenzlaufunruhe bei B_wkr=1, Faktor aus KFDLUR2" FLOAT32_IEEE fak_r32_1 1 100 -10000 10000 FORMAT "%27.21" ECU_ADDRESS 0x3FA99C /end MEASUREMENT
/begin MEASUREMENT fkfdlur_f "Basis Schwellwert f¸r Differenzlaufunruhe, Faktor aus KFDLUR" FLOAT32_IEEE fak_r32_1 1 100 -10000 10000 FORMAT "%27.21" ECU_ADDRESS 0x3FA9A0 /end MEASUREMENT
/begin MEASUREMENT frauzs2_w "multipl. Gemischadaptionsfaktor unterer mult. Bereich (Stereo)" UWORD fak_uw_b2 1 100 0 1.99997 FORMAT "%8.6" ECU_ADDRESS 0x402D70 /end MEASUREMENT
/begin MEASUREMENT frauzs_w "multiplikativer Gemischadaptionsfaktor unterer mult. Bereich (alter Wert)" UWORD fak_uw_b2 1 100 0 1.99997 FORMAT "%8.6" ECU_ADDRESS 0x402D72 /end MEASUREMENT
/begin MEASUREMENT frsnast2_w "Lambda-Reglerausgangswert  beim Eintritt in den Bereich UASNAMN<ua10mo<UASNAMX" UWORD fak_uw_b2 1 100 0 1.99997 FORMAT "%8.6" ECU_ADDRESS 0x402A68 /end MEASUREMENT
/begin MEASUREMENT frsnast_w "Lambda-Reglerausgangswert  beim Eintritt in den Bereich UASNAMN<ua10mo<UASNAMX" UWORD fak_uw_b2 1 100 0 1.99997 FORMAT "%8.6" ECU_ADDRESS 0x402A6A /end MEASUREMENT
/begin MEASUREMENT ibfehlin1 "lokale Kopie Fehlerinput" UBYTE B_TRUE 1 100 0 1 FORMAT "%13.11" ECU_ADDRESS 0x4031F0 /end MEASUREMENT
/begin MEASUREMENT ibfehlin2 "lokale Kopie Fehlerinput 2" UBYTE B_TRUE 1 100 0 1 FORMAT "%13.11" ECU_ADDRESS 0x4031F1 /end MEASUREMENT
/begin MEASUREMENT ibfehlin3 "lokale Kopie Fehlerinput 3" UBYTE B_TRUE 1 100 0 1 FORMAT "%13.11" ECU_ADDRESS 0x4031F2 /end MEASUREMENT
/begin MEASUREMENT ibfehlin4 "lokale Kopie Fehlerinput 4" UBYTE B_TRUE 1 100 0 1 FORMAT "%13.11" ECU_ADDRESS 0x4031F3 /end MEASUREMENT
/begin MEASUREMENT ibfehlin5 "lokale Kopie Fehlerinput 5" UBYTE B_TRUE 1 100 0 1 FORMAT "%13.11" ECU_ADDRESS 0x4031F4 /end MEASUREMENT
/begin MEASUREMENT ibfehlin6 "lokale Kopie Fehlerinput 6" UBYTE B_TRUE 1 100 0 1 FORMAT "%13.11" ECU_ADDRESS 0x4031F5 /end MEASUREMENT
/begin MEASUREMENT ibfehlin7 "lokale Kopie Fehlerinput 7" UBYTE B_TRUE 1 100 0 1 FORMAT "%13.11" ECU_ADDRESS 0x4031F6 /end MEASUREMENT
/begin MEASUREMENT ibfehlin8 "lokale Kopie Fehlerinput 8" UBYTE B_TRUE 1 100 0 1 FORMAT "%13.11" ECU_ADDRESS 0x4031F7 /end MEASUREMENT
/begin MEASUREMENT ibfehlin9 "" UBYTE B_TRUE 1 100 0 1 FORMAT "%13.11" ECU_ADDRESS 0x4031F8 /end MEASUREMENT
/begin MEASUREMENT ibsderrs1 "intelligenter Batteriesensor Fehler 1" UBYTE dez 1 100 0 255 FORMAT "%5.1" ECU_ADDRESS 0x3FE1F8 /end MEASUREMENT
/begin MEASUREMENT ibsderrs2 "intelligenter Batteriesensor Fehler 2" UWORD dez 1 100 0 65535 FORMAT "%8.2" ECU_ADDRESS 0x3FE1F6 /end MEASUREMENT
/begin MEASUREMENT ibserstat1 "BSD Uebertragungsfehler kodiert fuer FSPVDGEN" UBYTE DEZ 1 100 0 255 FORMAT "%5.1" ECU_ADDRESS 0x403205 /end MEASUREMENT
/begin MEASUREMENT ibserstat2 "Fehlerstatus Plausibilitaet IBS- SW" UBYTE dez 1 100 0 255 FORMAT "%5.1" ECU_ADDRESS 0x403206 /end MEASUREMENT
/begin MEASUREMENT ibserstat3 "Fehlerstatus Ort 3" UBYTE dez 1 100 0 255 FORMAT "%5.1" ECU_ADDRESS 0x403207 /end MEASUREMENT
/begin MEASUREMENT ibspreco2 "Vorteiler f¸r Ibsderrs2" UBYTE dez 1 100 0 255 FORMAT "%5.1" ECU_ADDRESS 0x403208 /end MEASUREMENT
/begin MEASUREMENT imlkvszs_w "Zwischenspeicher: Luftmasse nach Auftreten eines DKVS Fehles bei leerem Tank" UWORD m_q0p00355 1 100 0 233.013 FORMAT "%8.4" ECU_ADDRESS 0x3FE164 /end MEASUREMENT
/begin MEASUREMENT imlkvs_w "Luftmasse nach Auftreten eines DKVS Fehles bei leerem Tank" UWORD m_q0p00355 1 100 0 233.013 FORMAT "%8.4" ECU_ADDRESS 0x402D74 /end MEASUREMENT
/begin MEASUREMENT imllaki2_w "Katdiagnose: interner Wert Fettfl‰che f¸r Katalysator-Ausr‰umen, Bank2" UWORD m_uw_b291p25 1 100 0 291.267 FORMAT "%8.4" ECU_ADDRESS 0x402A86 /end MEASUREMENT
/begin MEASUREMENT imllaki_w "Katdiagnose: interner Wert Fettfl‰che f¸r Katalysator-Ausr‰umen" UWORD m_uw_b291p25 1 100 0 291.267 FORMAT "%8.4" ECU_ADDRESS 0x402A88 /end MEASUREMENT
/begin MEASUREMENT imllako2_w "Katdiagnose: interner alter Wert Fettfl‰che f¸r Katalysator-Ausr‰umen, Bank2" UWORD m_uw_b291p25 1 100 0 291.267 FORMAT "%8.4" ECU_ADDRESS 0x402A8A /end MEASUREMENT
/begin MEASUREMENT imllako_w "Katdiagnose: interner alter Wert Fettfl‰che f¸r Katalysator-Ausr‰umen" UWORD m_uw_b291p25 1 100 0 291.267 FORMAT "%8.4" ECU_ADDRESS 0x402A8C /end MEASUREMENT
/begin MEASUREMENT imlna2_w "Integrierte Luftmasse zum Setzen des Fehlers Sonde nicht aktiv, Bank 2" UWORD m_q2p777Em5_kg 1 100 0 1.82042 FORMAT "%8.6" ECU_ADDRESS 0x402A6C /end MEASUREMENT
/begin MEASUREMENT imlna_w "Integrierte Luftmasse zum Setzen des Fehlers Sonde nicht aktiv" UWORD m_q2p777Em5_kg 1 100 0 1.82042 FORMAT "%8.6" ECU_ADDRESS 0x402A6E /end MEASUREMENT
/begin MEASUREMENT intlash2_w "Integrator (Rampe) f¸r Lambdasoll Test Schwingungspr¸fung h. KAT Bank2" UWORD fak_uw_b16 1 100 0 15.9998 FORMAT "%8.5" ECU_ADDRESS 0x402AFE /end MEASUREMENT
/begin MEASUREMENT intlash_w "Integrator (Rampe) f¸r Lambdasoll Test Schwingungspr¸fung h. KAT" UWORD fak_uw_b16 1 100 0 15.9998 FORMAT "%8.5" ECU_ADDRESS 0x402B00 /end MEASUREMENT
/begin MEASUREMENT ktspcnt2_w "Counter f¸r Aktualit‰t der Mode $06 - Werte in der %DKATSP, Bank2" UWORD dez 1 100 0 65535 FORMAT "%8.2" ECU_ADDRESS 0x3FE07E /end MEASUREMENT
/begin MEASUREMENT ktspcnt_w "Counter f¸r Aktualit‰t der Mode $06 - Werte in der %DKATSP" UWORD dez 1 100 0 65535 FORMAT "%8.2" ECU_ADDRESS 0x3FE080 /end MEASUREMENT
/begin MEASUREMENT lamdkt2_w "Lambdasoll f¸r Katdiagnose" UWORD fak_uw_b16 1 100 0 15.9998 FORMAT "%8.5" ECU_ADDRESS 0x402A8E /end MEASUREMENT
/begin MEASUREMENT lamdkt_w "Lambdasoll f¸r Katdiagnose" UWORD fak_uw_b16 1 100 0 15.9998 FORMAT "%8.5" ECU_ADDRESS 0x402A90 /end MEASUREMENT
/begin MEASUREMENT lamelsh2_w "Lambdasoll f¸r elektrische Sondendiagnose hinter KAT (Kurztrip), Bank 2" UWORD fak_uw_b16 1 100 0 15.9998 FORMAT "%8.5" ECU_ADDRESS 0x403EC0 /end MEASUREMENT
/begin MEASUREMENT lamelsh_w "Lambdasoll f¸r elektrische Sondendiagnose hinter KAT (Kurztrip)" UWORD fak_uw_b16 1 100 0 15.9998 FORMAT "%8.5" ECU_ADDRESS 0x403EC2 /end MEASUREMENT
/begin MEASUREMENT lamlash2_w "Lambdasoll f¸r Test Schwingungspr¸fung hinter KAT Bank2" UWORD fak_uw_b16 1 100 0 15.9998 FORMAT "%8.5" ECU_ADDRESS 0x402B02 /end MEASUREMENT
/begin MEASUREMENT lamlash_w "Lambdasoll f¸r Test Schwingungspr¸fung hinter KAT" UWORD fak_uw_b16 1 100 0 15.9998 FORMAT "%8.5" ECU_ADDRESS 0x402B04 /end MEASUREMENT
/begin MEASUREMENT lamsisa "Lambda Ist an Sonde Signalausgabe DLSSA, Bank 1" UBYTE fak_ub_b2 1 100 0 1.99219 FORMAT "%5.3" ECU_ADDRESS 0x402B12 /end MEASUREMENT
/begin MEASUREMENT lamsisa2 "Lambda Ist an Sonde Signalausgabe DLSSA, Bank 2" UBYTE fak_ub_b2 1 100 0 1.99219 FORMAT "%5.3" ECU_ADDRESS 0x402B13 /end MEASUREMENT
/begin MEASUREMENT lamsosa "Lambda Soll an Sonde Signalausgabe DLSSA, Bank 1" UBYTE fak_ub_b2 1 100 0 1.99219 FORMAT "%5.3" ECU_ADDRESS 0x402B14 /end MEASUREMENT
/begin MEASUREMENT lamsosa2 "Lambda Soll an Sonde Signalausgabe DLSSA, Bank 2" UBYTE fak_ub_b2 1 100 0 1.99219 FORMAT "%5.3" ECU_ADDRESS 0x402B15 /end MEASUREMENT
/begin MEASUREMENT lamtrip2_w "gespeicherte Lambdaabweichung aus lamsbg_w Bank2" UWORD fak_uw_b16 1 100 0 15.9998 FORMAT "%8.5" ECU_ADDRESS 0x402B06 /end MEASUREMENT
/begin MEASUREMENT lamtrip_w "gespeicherte Lambdaabweichung aus lamsbg_w f¸r Sonde hinter KAT" UWORD fak_uw_b16 1 100 0 15.9998 FORMAT "%8.5" ECU_ADDRESS 0x402B08 /end MEASUREMENT
/begin MEASUREMENT ldktmev2_w "Lambda minus eins bei Katdiagnose, verzˆgerter Wert" SWORD fak_sw_b1 1 100 -1 0.999969 FORMAT "%8.6" ECU_ADDRESS 0x402A92 /end MEASUREMENT
/begin MEASUREMENT ldktmev_w "Lambda minus eins bei Katdiagnose, verzˆgerter Wert" SWORD fak_sw_b1 1 100 -1 0.999969 FORMAT "%8.6" ECU_ADDRESS 0x402A94 /end MEASUREMENT
/begin MEASUREMENT Lern_disa "Flag DISA lernen" UBYTE dez 1 100 0 255 FORMAT "%5.1" ECU_ADDRESS 0x402C88 /end MEASUREMENT
/begin MEASUREMENT locerr0 "Loc.Fehler0 Flankenerkennung" UBYTE B_TRUE 1 100 0 1 FORMAT "%13.11" ECU_ADDRESS 0x3FE1F4 /end MEASUREMENT
/begin MEASUREMENT locerr1 "Loc.Fehler1 Flankenerkennung" UBYTE B_TRUE 1 100 0 1 FORMAT "%13.11" ECU_ADDRESS 0x3FE1F5 /end MEASUREMENT
/begin MEASUREMENT lutsfi1_w "gefilterte Laufunruhe-Testgrˆﬂe von Zylinder 1,word" SWORD luquant_w 1 100 -90.9495 90.9467 FORMAT "%8.5" ECU_ADDRESS 0x3FDEFA /end MEASUREMENT
/begin MEASUREMENT lutsfi2_w "gefilterte Laufunruhe-Testgrˆﬂe von Zylinder 2,word" SWORD luquant_w 1 100 -90.9495 90.9467 FORMAT "%8.5" ECU_ADDRESS 0x3FDEFC /end MEASUREMENT
/begin MEASUREMENT lutsfi3_w "gefilterte Laufunruhe-Testgrˆﬂe von Zylinder 3,word" SWORD luquant_w 1 100 -90.9495 90.9467 FORMAT "%8.5" ECU_ADDRESS 0x3FDEFE /end MEASUREMENT
/begin MEASUREMENT lutsfi4_w "gefilterte Laufunruhe-Testgrˆﬂe von Zylinder 4,word" SWORD luquant_w 1 100 -90.9495 90.9467 FORMAT "%8.5" ECU_ADDRESS 0x3FDF00 /end MEASUREMENT
/begin MEASUREMENT lutsfi5_w "gefilterte Laufunruhe-Testgrˆﬂe von Zylinder 5,word" SWORD luquant_w 1 100 -90.9495 90.9467 FORMAT "%8.5" ECU_ADDRESS 0x3FDF02 /end MEASUREMENT
/begin MEASUREMENT lutsfi6_w "gefilterte Laufunruhe-Testgrˆﬂe von Zylinder 6,word" SWORD luquant_w 1 100 -90.9495 90.9467 FORMAT "%8.5" ECU_ADDRESS 0x3FDF04 /end MEASUREMENT
/begin MEASUREMENT lutsfi7_w "gefilterte Laufunruhe-Testgrˆﬂe von Zylinder 7,word" SWORD luquant_w 1 100 -90.9495 90.9467 FORMAT "%8.5" ECU_ADDRESS 0x3FDF06 /end MEASUREMENT
/begin MEASUREMENT lutsfi8_w "gefilterte Laufunruhe-Testgrˆﬂe von Zylinder 8,word" SWORD luquant_w 1 100 -90.9495 90.9467 FORMAT "%8.5" ECU_ADDRESS 0x3FDF08 /end MEASUREMENT
/begin MEASUREMENT m6aktsp "Anzahl der Ausgabe-Codes SCAN-Tool Mode6 aus Kat-Diagnose" UBYTE dez 1 100 0 255 FORMAT "%5.1" ECU_ADDRESS 0x3FE091 /end MEASUREMENT
/begin MEASUREMENT m6cktsp "Ausgabe-Code SCAN-Tool Mode 6 aus KAT-Diagnose" UBYTE dez 1 100 0 255 FORMAT "%5.1" ECU_ADDRESS 0x3FE092 /end MEASUREMENT
/begin MEASUREMENT m6cktsp2 "Ausgabe-Code SCAN-Tool Mode 6 aus KAT-Diagnose" UBYTE dez 1 100 0 255 FORMAT "%5.1" ECU_ADDRESS 0x3FE093 /end MEASUREMENT
/begin MEASUREMENT m6sktsp2_w "Ausgabe Schwellwert SCAN-Tool Mode 6 aus KAT-Diagnose" UWORD dez 1 100 0 65535 FORMAT "%8.2" ECU_ADDRESS 0x3FE082 /end MEASUREMENT
/begin MEASUREMENT m6sktsp_w "Ausgabe Schwellwert SCAN-Tool Mode 6 aus KAT-Diagnose" UWORD dez 1 100 0 65535 FORMAT "%8.2" ECU_ADDRESS 0x3FE084 /end MEASUREMENT
/begin MEASUREMENT m6wktsp2_w "Ausgabe Pr¸fwert SCAN-Tool Mode 6 aus KAT-Diagnose" UWORD dez 1 100 0 65535 FORMAT "%8.2" ECU_ADDRESS 0x3FE086 /end MEASUREMENT
/begin MEASUREMENT m6wktsp_w "Ausgabe Pr¸fwert SCAN-Tool Mode 6 aus KAT-Diagnose" UWORD dez 1 100 0 65535 FORMAT "%8.2" ECU_ADDRESS 0x3FE088 /end MEASUREMENT
/begin MEASUREMENT mldkthp_w "hochpaﬂgefilterte Luftmasse bei Katdiagnose" UWORD m_uw_b6553p5 1 100 0 6553.5 FORMAT "%8.3" ECU_ADDRESS 0x402ADC /end MEASUREMENT
/begin MEASUREMENT mldyn_w "Luftmassenintegral im Schubbetrieb f¸r Sonde hinter Kat" UWORD m_q0p00277 1 100 0 182.042 FORMAT "%8.4" ECU_ADDRESS 0x402B0A /end MEASUREMENT
/begin MEASUREMENT mlfdkt2_w "ml * lambda-Produkt bei Katdiagnose w‰hrend Fetteintrag, Bank2" UWORD m_uw_b102p4 1 100 0 102.397 FORMAT "%8.4" ECU_ADDRESS 0x402A96 /end MEASUREMENT
/begin MEASUREMENT mlfdkt_w "ml * lambda-Produkt bei Katdiagnose w‰hrend Fetteintrag" UWORD m_uw_b102p4 1 100 0 102.397 FORMAT "%8.4" ECU_ADDRESS 0x402A98 /end MEASUREMENT
/begin MEASUREMENT mlldkt2_w "ml * lambda-Produkt bei Katdiagnose" UWORD m_uw_b102p4 1 100 0 102.397 FORMAT "%8.4" ECU_ADDRESS 0x402A9A /end MEASUREMENT
/begin MEASUREMENT mlldkt_w "ml * lambda-Produkt bei Katdiagnose" UWORD m_uw_b102p4 1 100 0 102.397 FORMAT "%8.4" ECU_ADDRESS 0x402A9C /end MEASUREMENT
/begin MEASUREMENT msfabr_w "Massenstrom F¸llung der durch die Auslaﬂventile aus dem Brennraum flieﬂt" UWORD m_uw_b6553p5 1 100 0 6553.5 FORMAT "%8.3" ECU_ADDRESS 0x403EB2 /end MEASUREMENT
/begin MEASUREMENT oscdkt2_w "Sauerstoffspeichervermˆgen des Katalysators, Katdiagnose" UWORD m_q0p1_mg 1 100 0 6553.5 FORMAT "%8.3" ECU_ADDRESS 0x402A9E /end MEASUREMENT
/begin MEASUREMENT oscdkta2_w "Sauerstoffspeichervermˆgen des Katalysators, Applikations-Speicherwert, Bank2" UWORD m_q0p1_mg 1 100 0 6553.5 FORMAT "%8.3" ECU_ADDRESS 0x402AA0 /end MEASUREMENT
/begin MEASUREMENT oscdkta_w "Sauerstoffspeichervermˆgen des Katalysators, Applikations-Speicherwert" UWORD m_q0p1_mg 1 100 0 6553.5 FORMAT "%8.3" ECU_ADDRESS 0x402AA2 /end MEASUREMENT
/begin MEASUREMENT oscdktf2_w "Gefiltertes Sauerstoffspeichervermˆgen des Katalysators, Katdiagnose, Bank2" UWORD fak_uw_b16 1 100 0 15.9998 FORMAT "%8.5" ECU_ADDRESS 0x3FE08A /end MEASUREMENT
/begin MEASUREMENT oscdktf_w "Gefiltertes Sauerstoffspeichervermˆgen des Katalysators, Katdiagnose" UWORD fak_uw_b16 1 100 0 15.9998 FORMAT "%8.5" ECU_ADDRESS 0x3FE08C /end MEASUREMENT
/begin MEASUREMENT oscdktm2_w "Mittelwert des Sauerstoffspeichervermˆgens des Katalysators, Katdiagnose, Bank2" UWORD fak_uw_b16 1 100 0 15.9998 FORMAT "%8.5" ECU_ADDRESS 0x402AA4 /end MEASUREMENT
/begin MEASUREMENT oscdktm_w "Mittelwert des Sauerstoffspeichervermˆgens des Katalysators, Katdiagnose" UWORD fak_uw_b16 1 100 0 15.9998 FORMAT "%8.5" ECU_ADDRESS 0x402AA6 /end MEASUREMENT
/begin MEASUREMENT oscdktn2_w "Normierte Sauerstoffspeicherf‰higkeit, Katdiagnose" UWORD fak_uw_b16 1 100 0 15.9998 FORMAT "%8.5" ECU_ADDRESS 0x402AA8 /end MEASUREMENT
/begin MEASUREMENT oscdktn_w "Normierte Sauerstoffspeicherf‰higkeit, Katdiagnose" UWORD fak_uw_b16 1 100 0 15.9998 FORMAT "%8.5" ECU_ADDRESS 0x402AAA /end MEASUREMENT
/begin MEASUREMENT oscdktr2_w "Normierte Sauerstoffspeicherf‰higkeit, Referenzwert, Katdiagnose" UWORD fak_uw_b16 1 100 0 15.9998 FORMAT "%8.5" ECU_ADDRESS 0x402AAC /end MEASUREMENT
/begin MEASUREMENT oscdktr_w "Normierte Sauerstoffspeicherf‰higkeit, Referenzwert, Katdiagnose" UWORD fak_uw_b16 1 100 0 15.9998 FORMAT "%8.5" ECU_ADDRESS 0x402AAE /end MEASUREMENT
/begin MEASUREMENT oscdkts2_w "Sauerstoffspeichervermˆgen des Katalysators, Summenwert, Bank2" UWORD fak_uw_b128 1 100 0 127.998 FORMAT "%8.4" ECU_ADDRESS 0x402AB0 /end MEASUREMENT
/begin MEASUREMENT oscdkts_w "Sauerstoffspeichervermˆgen des Katalysators, Summenwert" UWORD fak_uw_b128 1 100 0 127.998 FORMAT "%8.4" ECU_ADDRESS 0x402AB2 /end MEASUREMENT
/begin MEASUREMENT oscdktt2_w "Sauerstoffspeichervermˆgen des Katalysators, temperaturkorrigiert, Katdiagnose" UWORD m_q0p1_mg 1 100 10 6553.5 FORMAT "%8.3" ECU_ADDRESS 0x402AB4 /end MEASUREMENT
/begin MEASUREMENT oscdktt_w "Sauerstoffspeichervermˆgen des Katalysators, temperaturkorrigiert, Katdiagnose" UWORD m_q0p1_mg 1 100 10 6553.5 FORMAT "%8.3" ECU_ADDRESS 0x402AB6 /end MEASUREMENT
/begin MEASUREMENT oscdkt_w "Sauerstoffspeichervermˆgen des Katalysators, Katdiagnose" UWORD m_q0p1_mg 1 100 0 6553.5 FORMAT "%8.3" ECU_ADDRESS 0x402AB8 /end MEASUREMENT
/begin MEASUREMENT oscmn2_w "Minimalwert des Sauerstoffspeichervermˆgens des Katalysators, Bank2" UWORD fak_uw_b16 1 100 0 15.9998 FORMAT "%8.5" ECU_ADDRESS 0x402ABA /end MEASUREMENT
/begin MEASUREMENT oscmnd2_w "Minimale Abweichung der Sauerstoffspeichervermˆgen des Katalysators, Bank2" UWORD fak_uw_b16 1 100 0 15.9998 FORMAT "%8.5" ECU_ADDRESS 0x402ABC /end MEASUREMENT
/begin MEASUREMENT oscmnd_w "Minimale Abweichung der Sauerstoffspeichervermˆgen des Katalysators" UWORD fak_uw_b16 1 100 0 15.9998 FORMAT "%8.5" ECU_ADDRESS 0x402ABE /end MEASUREMENT
/begin MEASUREMENT oscmn_w "Minimalwert des Sauerstoffspeichervermˆgens des Katalysators" UWORD fak_uw_b16 1 100 0 15.9998 FORMAT "%8.5" ECU_ADDRESS 0x402AC0 /end MEASUREMENT
/begin MEASUREMENT oscmx2_w "Maximalwert des Sauerstoffspeichervermˆgens des Katalysators, Bank2" UWORD fak_uw_b16 1 100 0 15.9998 FORMAT "%8.5" ECU_ADDRESS 0x402AC2 /end MEASUREMENT
/begin MEASUREMENT oscmxd2_w "Maximale Abweichung der Sauerstoffspeichervermˆgen des Katalysators, Bank2" UWORD fak_uw_b16 1 100 0 15.9998 FORMAT "%8.5" ECU_ADDRESS 0x402AC4 /end MEASUREMENT
/begin MEASUREMENT oscmxd_w "Maximale Abweichung der Sauerstoffspeichervermˆgen des Katalysators" UWORD fak_uw_b16 1 100 0 15.9998 FORMAT "%8.5" ECU_ADDRESS 0x402AC6 /end MEASUREMENT
/begin MEASUREMENT oscmx_w "Maximalwert des Sauerstoffspeichervermˆgens des Katalysators" UWORD fak_uw_b16 1 100 0 15.9998 FORMAT "%8.5" ECU_ADDRESS 0x402AC8 /end MEASUREMENT
/begin MEASUREMENT ready "readiness-Byte f¸r Ausgabe SAE J1979 Mode2" UBYTE dez 1 100 0 255 FORMAT "%5.1" ECU_ADDRESS 0x3FDEF3 /end MEASUREMENT
/begin MEASUREMENT rememberP3Max "" ULONG dez 1 100 0 4.29497e+009 FORMAT "%13.2" ECU_ADDRESS 0x4048C4 /end MEASUREMENT
/begin MEASUREMENT rkam2_w "Auswahl additive Gemischkorrektur der Gemischadaption f¸r Bestimmung B_gae2" SWORD rel_sw_b1536 1 100 -1536 1535.95 FORMAT "%8.3" ECU_ADDRESS 0x402D76 /end MEASUREMENT
/begin MEASUREMENT rkamzs2_w "additive Gemischkorrektur (pro Zeit oder Z¸ndung) Bank 2 (alter Wert)" SWORD rel_sw_b1536 1 100 -1536 1535.95 FORMAT "%8.3" ECU_ADDRESS 0x402D78 /end MEASUREMENT
/begin MEASUREMENT rkamzs_w "additive Gemischkorrektur (pro Zeit oder Z¸ndung); alter Wert" SWORD rel_sw_b1536 1 100 -1536 1535.95 FORMAT "%8.3" ECU_ADDRESS 0x402D7A /end MEASUREMENT
/begin MEASUREMENT rkam_w "Auswahl additive Gemischkorrektur der Gemischadaption f¸r Bestimmung B_gae" SWORD rel_sw_b1536 1 100 -1536 1535.95 FORMAT "%8.3" ECU_ADDRESS 0x402D7C /end MEASUREMENT
/begin MEASUREMENT rkats_w "additive Gemischkorrektur pro Zeit Bank 1 und 2 zusammen" SWORD rel_sw_b1536 1 100 -1536 1535.95 FORMAT "%8.3" ECU_ADDRESS 0x402D7E /end MEASUREMENT
/begin MEASUREMENT rkg2_w "relative Kraftstoffmasse gesamt, Bank2" UWORD rel_uw_b3072 1 100 0 3071.95 FORMAT "%8.3" ECU_ADDRESS 0x403EB4 /end MEASUREMENT
/begin MEASUREMENT rkg_w "relative Kraftstoffmasse gesamt" UWORD rel_uw_b3072 1 100 0 3071.95 FORMAT "%8.3" ECU_ADDRESS 0x403EB6 /end MEASUREMENT
/begin MEASUREMENT rkrn_w "normierter Referenzpegel Klopfregelung" UWORD spg_uw_b1280 1 100 0 1279.98 FORMAT "%8.3" ARRAY_SIZE 8 ECU_ADDRESS 0x40302A /end MEASUREMENT
/begin MEASUREMENT St_di "Status Disa" UBYTE dez 1 100 0 255 FORMAT "%5.1" ECU_ADDRESS 0x402C89 /end MEASUREMENT
/begin MEASUREMENT S_bls "Schalter Bremslicht" UBYTE B_TRUE 1 100 0 1 BIT_MASK 0x1 FORMAT "%13.11" ECU_ADDRESS 0x3FBEE3 /end MEASUREMENT
/begin MEASUREMENT S_brs "Schalter Bremstest" UBYTE B_TRUE 1 100 0 1 BIT_MASK 0x1 FORMAT "%13.11" ECU_ADDRESS 0x3FBEE4 /end MEASUREMENT
/begin MEASUREMENT S_kl15 "Schalter Klemme 15" UBYTE B_TRUE 1 100 0 1 BIT_MASK 0x1 FORMAT "%13.11" ECU_ADDRESS 0x3FBEE5 /end MEASUREMENT
/begin MEASUREMENT S_kupp "Schalter Kupplung" UBYTE B_TRUE 1 100 0 1 BIT_MASK 0x1 FORMAT "%13.11" ECU_ADDRESS 0x3FBEE6 /end MEASUREMENT
/begin MEASUREMENT tavhkmm2_w "Mittlere Temperatur zwischen Vor- und Hauptkatalysator, modelliert, Bank2" UWORD temp_q0p0234_o273 1 100 -273.15 1262.83 FORMAT "%8.3" ECU_ADDRESS 0x403EB8 /end MEASUREMENT
/begin MEASUREMENT tavhkmm_w "Mittlere Temperatur zwischen Vor- und Hauptkatalysator, modelliert" UWORD temp_q0p0234_o273 1 100 -273.15 1262.83 FORMAT "%8.3" ECU_ADDRESS 0x403EBA /end MEASUREMENT
/begin MEASUREMENT Tdierr "Verzˆgerungszeit nach Fehler" UWORD t10msxs_uw_b655p35 1 100 0 655.35 FORMAT "%8.4" ECU_ADDRESS 0x402C9C /end MEASUREMENT
/begin MEASUREMENT Tdiwisch1 "Wischzeit f¸r 1. Richtung" UWORD t10msxs_uw_b655p35 1 100 0 655.35 FORMAT "%8.4" ECU_ADDRESS 0x402C9E /end MEASUREMENT
/begin MEASUREMENT Tdiwisch2 "Wischzeit f¸r 2. Richtun" UWORD t10msxs_uw_b655p35 1 100 0 655.35 FORMAT "%8.4" ECU_ADDRESS 0x402CA0 /end MEASUREMENT
/begin MEASUREMENT tdktto "Timeout-Z‰hler f¸r die Katalysatordiagnose" UBYTE t_q0p2 1 100 0 51 FORMAT "%5.2" ECU_ADDRESS 0x402ADA /end MEASUREMENT
/begin MEASUREMENT tdktto2 "Timeout-Z‰hler f¸r die Katalysatordiagnose, Bank2" UBYTE t_q0p2 1 100 0 51 FORMAT "%5.2" ECU_ADDRESS 0x402ADB /end MEASUREMENT
/begin MEASUREMENT thlsuip2_w "Entprellzeit zum Heilen des Fehlerpfades LSUIP, Bank 2" UWORD t_q0p1 1 100 0 6553.5 FORMAT "%8.3" ECU_ADDRESS 0x402A70 /end MEASUREMENT
/begin MEASUREMENT thlsuip_w "Entprellzeit zum Heilen des Fehlerpfades LSUIP" UWORD t_q0p1 1 100 0 6553.5 FORMAT "%8.3" ECU_ADDRESS 0x402A72 /end MEASUREMENT
/begin MEASUREMENT tkdktg2_w "Katalysasto-Temperaturgradient bei Katdiagnose, Bank2" UWORD temp_q0p0234 1 100 0 1535.98 FORMAT "%8.3" ECU_ADDRESS 0x402ADE /end MEASUREMENT
/begin MEASUREMENT tkdktg_w "Katalysasto-Temperaturgradient bei Katdiagnose" UWORD temp_q0p0234 1 100 0 1535.98 FORMAT "%8.3" ECU_ADDRESS 0x402AE0 /end MEASUREMENT
/begin MEASUREMENT tkdkthp2_w "hochpaﬂgefilterte Katalysator-Temperatur, Bank2" UWORD temp_q0p0234 1 100 0 1535.98 FORMAT "%8.3" ECU_ADDRESS 0x402AE2 /end MEASUREMENT
/begin MEASUREMENT tkdkthp_w "hochpaﬂgefilterte Katalysator-Temperatur" UWORD temp_q0p0234 1 100 0 1535.98 FORMAT "%8.3" ECU_ADDRESS 0x402AE4 /end MEASUREMENT
/begin MEASUREMENT tkdktol2_w "Katdiagnose: alter Temperaturwert, Bank2" UWORD temp_q0p0234_o273 1 100 -273.15 1262.83 FORMAT "%8.3" ECU_ADDRESS 0x402AE6 /end MEASUREMENT
/begin MEASUREMENT tkdktol_w "Katdiagnose: alter Temperaturwert" UWORD temp_q0p0234_o273 1 100 -273.15 1262.83 FORMAT "%8.3" ECU_ADDRESS 0x402AE8 /end MEASUREMENT
/begin MEASUREMENT tsdkttk2_w "Temperaturabh‰ngige Verzˆgerungszeit, Bank2" UWORD t_q0p2 1 100 0 13107 FORMAT "%8.2" ECU_ADDRESS 0x402AEA /end MEASUREMENT
/begin MEASUREMENT tsdkttk_w "Temperaturabh‰ngige Verzˆgerungszeit" UWORD t_q0p2 1 100 0 13107 FORMAT "%8.2" ECU_ADDRESS 0x402AEC /end MEASUREMENT
/begin MEASUREMENT twdlssh2_w "Timer f¸r Mindestpr¸fzeit f¸r DLSSA-Extremwertbestimmung hinter KAT Bank2" UWORD t50msxs_uw_b3276p75 1 100 0 3276.75 FORMAT "%8.3" ECU_ADDRESS 0x402B1C /end MEASUREMENT
/begin MEASUREMENT twdlssh_w "Timer f¸r Mindestpr¸fzeit f¸r DLSSA-Extremwertbestimmung hinter KAT" UWORD t50msxs_uw_b3276p75 1 100 0 3276.75 FORMAT "%8.3" ECU_ADDRESS 0x402B1E /end MEASUREMENT
/begin MEASUREMENT t_disa1 "Timer 1" UWORD t10msxs_uw_b655p35 1 100 0 655.35 FORMAT "%8.4" ECU_ADDRESS 0x402CA2 /end MEASUREMENT
/begin MEASUREMENT t_disa2 "Timer 2" UWORD t10msxs_uw_b655p35 1 100 0 655.35 FORMAT "%8.4" ECU_ADDRESS 0x402CA4 /end MEASUREMENT
/begin MEASUREMENT ushfmxstg "Gefilterte maximale Steigung der Sondenspannung hinter KAT" UBYTE spgg_q0p52 1 100 0 132.6 FORMAT "%5.1" ECU_ADDRESS 0x3FE097 /end MEASUREMENT
/begin MEASUREMENT ushfmxstg2 "Gefilterte maximale Steigung der Sondenspannung hinter KAT Bank2" UBYTE spgg_q0p52 1 100 0 132.6 FORMAT "%5.1" ECU_ADDRESS 0x3FE098 /end MEASUREMENT
/begin MEASUREMENT ushkj "Spannung Lambdasonde hinter Kat, ohne Offset, DLSSA, Bank 1" UBYTE spg_ub_b1p33 1 100 0 1.33 FORMAT "%5.3" ECU_ADDRESS 0x402B16 /end MEASUREMENT
/begin MEASUREMENT ushkj2 "Spannung Lambdasonde hinter Kat, ohne Offset, DLSSA, Bank 2" UBYTE spg_ub_b1p33 1 100 0 1.33 FORMAT "%5.3" ECU_ADDRESS 0x402B17 /end MEASUREMENT
/begin MEASUREMENT ushkjf2_w "Gefilterte Spannung Lambdasonde hinter Kat, ohne Offset, DLSSA (Bank2)" UWORD spg_uw_b1p33 1 100 0 1.33 FORMAT "%8.6" ECU_ADDRESS 0x402B20 /end MEASUREMENT
/begin MEASUREMENT ushkjf_w "Gefilterte Spannung Lambdasonde hinter Kat, ohne Offset, DLSSA" UWORD spg_uw_b1p33 1 100 0 1.33 FORMAT "%8.6" ECU_ADDRESS 0x402B22 /end MEASUREMENT
/begin MEASUREMENT ushkmxstg "Maximale Steigung der Sondenspannung hinter KAT" UBYTE spgg_q0p52 1 100 0 132.6 FORMAT "%5.1" ECU_ADDRESS 0x403B83 /end MEASUREMENT
/begin MEASUREMENT ushkmxstg2 "Maximale Steigung der Sondenspannung hinter KAT Bank2" UBYTE spgg_q0p52 1 100 0 132.6 FORMAT "%5.1" ECU_ADDRESS 0x403B84 /end MEASUREMENT
/begin MEASUREMENT ushksteig "Steigung der Sondenspannung hinter KAT" UBYTE spgg_q0p52 1 100 0 132.6 FORMAT "%5.1" ECU_ADDRESS 0x403B85 /end MEASUREMENT
/begin MEASUREMENT ushksteig2 "Steigung der Sondenspannung hinter KAT Bank2" UBYTE spgg_q0p52 1 100 0 132.6 FORMAT "%5.1" ECU_ADDRESS 0x403B86 /end MEASUREMENT
/begin MEASUREMENT usmnsha "minimal erkannter Sondenspannungswert h.K. (alt), DLSSA, Bank 1" UBYTE spg_ub_b1p33 1 100 0 1.33 FORMAT "%5.3" ECU_ADDRESS 0x402B18 /end MEASUREMENT
/begin MEASUREMENT usmnsha2 "minimal erkannter Sondenspannungswert h.K. (alt), DLSSA, Bank 2" UBYTE spg_ub_b1p33 1 100 0 1.33 FORMAT "%5.3" ECU_ADDRESS 0x402B19 /end MEASUREMENT
/begin MEASUREMENT usmnshn "minimal erkannter Sondenspannungswert h.K. (neu), DLSSA" UBYTE spg_ub_b1p33 1 100 0 1.33 FORMAT "%5.3" ECU_ADDRESS 0x3FE099 /end MEASUREMENT
/begin MEASUREMENT usmnshn2 "minimal erkannter Sondenspannungswert h.K. (neu), DLSSA (Bank2)" UBYTE spg_ub_b1p33 1 100 0 1.33 FORMAT "%5.3" ECU_ADDRESS 0x3FE09A /end MEASUREMENT
/begin MEASUREMENT usmxsha "maximal erkannter Sondenspannungswert h.K. (alt), DLSSA, Bank 1" UBYTE spg_ub_b1p33 1 100 0 1.33 FORMAT "%5.3" ECU_ADDRESS 0x402B1A /end MEASUREMENT
/begin MEASUREMENT usmxsha2 "maximal erkannter Sondenspannungswert h.K. (alt), DLSSA, Bank 2" UBYTE spg_ub_b1p33 1 100 0 1.33 FORMAT "%5.3" ECU_ADDRESS 0x402B1B /end MEASUREMENT
/begin MEASUREMENT usmxshn "maximal erkannter Sondenspannungswert h.K. (neu), DLSSA" UBYTE spg_ub_b1p33 1 100 0 1.33 FORMAT "%5.3" ECU_ADDRESS 0x3FE09B /end MEASUREMENT
/begin MEASUREMENT usmxshn2 "maximal erkannter Sondenspannungswert h.K. (neu), DLSSA (Bank2)" UBYTE spg_ub_b1p33 1 100 0 1.33 FORMAT "%5.3" ECU_ADDRESS 0x3FE09C /end MEASUREMENT
/begin MEASUREMENT usrhkmx "maximale Regelschwelle im Fehlerfall  f¸r Sonden-Diagnose hinter KAT" UBYTE spg_ub_q0p0052_o0p2 1 100 -0.2 1.13 FORMAT "%5.3" ECU_ADDRESS 0x3FE095 /end MEASUREMENT
/begin MEASUREMENT usrhkmx2 "maximale Regelschwelle im Fehlerfall f¸r Sonden-Dignose hinter KAT Bank2" UBYTE spg_ub_q0p0052_o0p2 1 100 -0.2 1.13 FORMAT "%5.3" ECU_ADDRESS 0x3FE096 /end MEASUREMENT
/begin MEASUREMENT usrhks "aktueller Regel-Sollwert f¸r Diagnose hinter KAT" UBYTE spg_ub_q0p0052_o0p2 1 100 -0.2 1.13 FORMAT "%5.3" ECU_ADDRESS 0x402AF4 /end MEASUREMENT
/begin MEASUREMENT usrhks2 "aktueller Regel-Sollwert f¸r Diagnose hinter KAT Bank2" UBYTE spg_ub_q0p0052_o0p2 1 100 -0.2 1.13 FORMAT "%5.3" ECU_ADDRESS 0x402AF5 /end MEASUREMENT
/begin MEASUREMENT xzkrznt "Z‰hler Klopfregelung Zyklusflag Z_krnt" UBYTE dez 1 100 0 255 FORMAT "%5.1" ECU_ADDRESS 0x403C38 /end MEASUREMENT
/begin MEASUREMENT xzkrznt2 "Z‰hler Klopfregelung Zyklusflag Z_krnt2" UBYTE dez 1 100 0 255 FORMAT "%5.1" ECU_ADDRESS 0x403C39 /end MEASUREMENT
/begin MEASUREMENT xzkrzof "Z‰hler Klopfregelung Zyklusflag Z_krof" UBYTE dez 1 100 0 255 FORMAT "%5.1" ECU_ADDRESS 0x403C3A /end MEASUREMENT
/begin MEASUREMENT xzkrzof2 "Z‰hler Klopfregelung Zyklusflag Z_krof2" UBYTE dez 1 100 0 255 FORMAT "%5.1" ECU_ADDRESS 0x403C3B /end MEASUREMENT
/begin MEASUREMENT xzkrzs "Z‰hler f¸r Zyklusflag Diagnose Klopfsensor" UBYTE dez 1 100 0 255 FORMAT "%5.1" ARRAY_SIZE 4 ECU_ADDRESS 0x40301A /end MEASUREMENT
/begin MEASUREMENT xzkrzs2 "Z‰hler Klopfregelung Zyklusflag Z_ks2" UBYTE dez 1 100 0 255 FORMAT "%5.1" ARRAY_SIZE 4 ECU_ADDRESS 0x40301E /end MEASUREMENT
/begin MEASUREMENT xzkrztp "Z‰hler Klopfregelung Zyklusflag Z_krtp" UBYTE dez 1 100 0 255 FORMAT "%5.1" ECU_ADDRESS 0x403C40 /end MEASUREMENT
/begin MEASUREMENT xzkrztp2 "Z‰hler Klopfregelung Zyklusflag Z_krtp2" UBYTE dez 1 100 0 255 FORMAT "%5.1" ECU_ADDRESS 0x403C41 /end MEASUREMENT
/begin MEASUREMENT xzsen "Entprellz‰hler Diagnose Klopfsensor" UBYTE dez 1 100 0 255 FORMAT "%5.1" ARRAY_SIZE 4 ECU_ADDRESS 0x403022 /end MEASUREMENT
/begin MEASUREMENT xzsen2 "Sicherheitsz‰hler Klopfsensor 2" UBYTE dez 1 100 0 255 FORMAT "%5.1" ARRAY_SIZE 4 ECU_ADDRESS 0x403026 /end MEASUREMENT
/begin MEASUREMENT xzskrnt "Sicherheitsz‰hler Klopfregelung Nulltest" UBYTE dez 1 100 0 255 FORMAT "%5.1" ECU_ADDRESS 0x403C3C /end MEASUREMENT
/begin MEASUREMENT xzskrnt2 "Sicherheitsz‰hler Klopfregelung Nulltest (zweiter CC195)" UBYTE dez 1 100 0 255 FORMAT "%5.1" ECU_ADDRESS 0x403C3D /end MEASUREMENT
/begin MEASUREMENT xzskrof "Sicherheitsz‰hler Klopfregelung Offset" UBYTE dez 1 100 0 255 FORMAT "%5.1" ECU_ADDRESS 0x403C3E /end MEASUREMENT
/begin MEASUREMENT xzskrof2 "Sicherheitsz‰hler Klopfregelung Offset (zweiter CC195)" UBYTE dez 1 100 0 255 FORMAT "%5.1" ECU_ADDRESS 0x403C3F /end MEASUREMENT
/begin MEASUREMENT xzskrtp "Z‰hler Klopfregelung Errorflag E_krtp" UBYTE dez 1 100 0 255 FORMAT "%5.1" ECU_ADDRESS 0x403C42 /end MEASUREMENT
/begin MEASUREMENT xzskrtp2 "Z‰hler Klopfregelung Errorflag E_krtp2" UBYTE dez 1 100 0 255 FORMAT "%5.1" ECU_ADDRESS 0x403C43 /end MEASUREMENT
/begin MEASUREMENT Zdiwicnt "Warmupcyclen seit letztem wischen" UBYTE dez 1 100 0 255 FORMAT "%5.1" ECU_ADDRESS 0x3FE0E4 /end MEASUREMENT
/begin MEASUREMENT Zdiwisch "Z‰hler DISA Wischfunktion" UBYTE dez 1 100 0 255 FORMAT "%5.1" ECU_ADDRESS 0x3FE0E5 /end MEASUREMENT
/begin MEASUREMENT zhkocvm "Anzahl der Heizereinkopplungen bei hohem Ri" UBYTE dez 1 100 0 255 FORMAT "%5.1" ECU_ADDRESS 0x402A7A /end MEASUREMENT
/begin MEASUREMENT zhkocvm2 "Anzahl der Heizereinkopplungen bei hohem Ri" UBYTE dez 1 100 0 255 FORMAT "%5.1" ECU_ADDRESS 0x402A7B /end MEASUREMENT
/begin MEASUREMENT zhzkh "Z‰hler f¸r Fehler-Messungen von Heizungs-Einkopplungen hinter  Haupt KAT" UBYTE dez 1 100 0 255 FORMAT "%5.1" ECU_ADDRESS 0x403B8D /end MEASUREMENT
/begin MEASUREMENT zhzkh2 "Z‰hler f¸r Fehler-Messungen von Heizungs-Einkopplungen hinter  Haupt KAT Bank2" UBYTE dez 1 100 0 255 FORMAT "%5.1" ECU_ADDRESS 0x403B8E /end MEASUREMENT
/begin MEASUREMENT zhzoffh "Z‰hler f¸r Heizungs-Ausschaltungen hinter   Haupt KAT" UBYTE dez 1 100 0 255 FORMAT "%5.1" ECU_ADDRESS 0x403B8F /end MEASUREMENT
/begin MEASUREMENT zhzoffh2 "Z‰hler f¸r Heizungs-Ausschaltungen hinter  Haupt KAT Bank2" UBYTE dez 1 100 0 255 FORMAT "%5.1" ECU_ADDRESS 0x403B90 /end MEASUREMENT
/begin MEASUREMENT zlash2_w "Zeitz‰hler f¸r Sondenspannung hinter KAT ober/unterhalb des Sollwertes, Bank2" UWORD t100msxs_uw_b6553p5 1 100 0 6553.5 FORMAT "%8.3" ECU_ADDRESS 0x403EBC /end MEASUREMENT
/begin MEASUREMENT zlash_w "Zeitz‰hler f¸r Sondenspannung hinter KAT ober/unterhalb des Sollwertes" UWORD t100msxs_uw_b6553p5 1 100 0 6553.5 FORMAT "%8.3" ECU_ADDRESS 0x403EBE /end MEASUREMENT
/begin MEASUREMENT zwdynsh "Z‰hler f¸r Anzahl der Dynamikmessungen f¸r Sonde hinter KAT" UBYTE dez 1 100 0 255 FORMAT "%5.1" ECU_ADDRESS 0x402AF6 /end MEASUREMENT
/begin MEASUREMENT zwdynsh2 "Z‰hler f¸r Anzahl der Dynamikmessungen f¸r Sonde hinter KAT Bank2" UBYTE dez 1 100 0 255 FORMAT "%5.1" ECU_ADDRESS 0x402AF7 /end MEASUREMENT
/begin MEASUREMENT Zwisch "Anzahl Wischvorg‰nge" UBYTE dez 1 100 0 255 FORMAT "%5.1" ECU_ADDRESS 0x402C8A /end MEASUREMENT
/begin MEASUREMENT Z_hlpkrnt "Hilfszyklusflag: Klopfregelung Nulltest" UBYTE B_TRUE 1 100 0 1 BIT_MASK 0x1 FORMAT "%13.11" ECU_ADDRESS 0x3FC1A7 /end MEASUREMENT
/begin MEASUREMENT Z_hlpkrnt2 "Hilfszyklusflag: Klopfregelung Nulltest (zweiter CC195)" UBYTE B_TRUE 1 100 0 1 BIT_MASK 0x1 FORMAT "%13.11" ECU_ADDRESS 0x3FC1A8 /end MEASUREMENT
/begin MEASUREMENT Z_hlpkrof "Hilfszyklusflag: Klopfregelung Offset" UBYTE B_TRUE 1 100 0 1 BIT_MASK 0x1 FORMAT "%13.11" ECU_ADDRESS 0x3FC1A9 /end MEASUREMENT
/begin MEASUREMENT Z_hlpkrof2 "Hilfszyklusflag: Klopfregelung Offset (zweiter CC195)" UBYTE B_TRUE 1 100 0 1 BIT_MASK 0x1 FORMAT "%13.11" ECU_ADDRESS 0x3FC1AA /end MEASUREMENT
/begin MEASUREMENT Z_hlpkrtp "Hilszyklusflag: Klopfregelung Testimpuls" UBYTE B_TRUE 1 100 0 1 BIT_MASK 0x1 FORMAT "%13.11" ECU_ADDRESS 0x3FC1AE /end MEASUREMENT
/begin MEASUREMENT Z_hlpkrtp2 "Hilszyklusflag: Klopfregelung Testimpuls (zweiter CC195)" UBYTE B_TRUE 1 100 0 1 BIT_MASK 0x1 FORMAT "%13.11" ECU_ADDRESS 0x3FC1AF /end MEASUREMENT
/begin FUNCTION DHRLSUE "1.80      Diagnose Heizungs-Endstufe f¸r Systeme mit CJxxx Diagnose-ES-Baustein" /begin DEF_CHARACTERISTIC TAHRLSUMN /end DEF_CHARACTERISTIC /begin REF_CHARACTERISTIC UBHRLSUMN UBHRLSUMX /end REF_CHARACTERISTIC
 /begin IN_MEASUREMENT B_cdhrlsue B_hsvemn B_hsvemn2 B_hsvemx B_hsvemx2 B_hsvesi B_hsvesi2 B_nmot B_stend tahrlsu2_w tahrlsu_w ubsq /end IN_MEASUREMENT
 /begin OUT_MEASUREMENT B_ehsve B_ehsve2 /end OUT_MEASUREMENT
 /begin LOC_MEASUREMENT B_hsveemn B_hsveemn2 B_hsveemx B_hsveemx2 B_hsveesi B_hsveesi2 /end LOC_MEASUREMENT
/end FUNCTION
/begin FUNCTION DIAGTIME "Deaktivierung CAN-Betrieb ¸ber Tester" /begin IN_MEASUREMENT B_hwpwf B_wakeup nmot_w /end IN_MEASUREMENT
 /begin OUT_MEASUREMENT B_canoff B_cdiagoff B_diagtimeout B_dtimer diagtime rememberP3Max /end OUT_MEASUREMENT
/end FUNCTION
/begin FUNCTION DIBS "1.40"
 /begin DEF_CHARACTERISTIC IBBSTERR1 IBBSTERR2 IBBSTERR3 IBBSTERR4 IBBSTERR5 IBBSTERR6 IBBSTERR7 IBBSTERR8 IBBSTERR9 IBBSTHEAL1 IBBSTHEAL2 IBBSTHEAL3 MSKIBSDFP MSKIBSDFP2 MSKIBSDIAG /end DEF_CHARACTERISTIC
 /begin IN_MEASUREMENT B_ibfbsd B_ibfebsd B_ibsdetec B_ibunplau ComControl ibs_errors /end IN_MEASUREMENT
 /begin OUT_MEASUREMENT ibsderrs1 ibsderrs2 ibserstat1 ibserstat2 ibserstat3 /end OUT_MEASUREMENT
 /begin LOC_MEASUREMENT diberrctr1 diberrctr2 diberrctr3 diberrctr4 diberrctr5 diberrctr6 diberrctr7 diberrctr8 diberrctr9 dibhealct1 dibhealct2 dibhealct3 ibfehlin1 ibfehlin2 ibfehlin3 ibfehlin4 ibfehlin5 ibfehlin6 ibfehlin7 ibfehlin8 ibfehlin9 ibspreco2 locerr0 locerr1 /end LOC_MEASUREMENT
/end FUNCTION
/begin FUNCTION DICLSU "1.120     Dignose: Auswerte-IC f¸r Breitband-Lambdasonde LSU"
 /begin DEF_CHARACTERISTIC DFRZASNAMN FRSNAMX IMLNAMN IMLNAMN2 KLIMLNA KUSVKMX LAMSSMN LAMSSMX RINNPH SDULSUMX SULSUMN TALSUSMX TAVSOVMMX TVDESHLSU TVDFRZAIP TVLSUDIP TVLSUTRIM TVLSUTRIMZ TVLSUUMN TVOCIPLL TVRINNPH TVSERSL TVSHEIP TVSHESL TVSNPFNA UAOCUNMN UAOCUNMX UAOCVMMN UAOCVMMX UASNAMN UASNAMX ZHKOCVMMX /end DEF_CHARACTERISTIC
 /begin REF_CHARACTERISTIC SULSUMX TVHKLSUV TVTKLSU /end REF_CHARACTERISTIC
 /begin IN_MEASUREMENT B_cdiclsu B_ehsve B_ehsve2 B_eshlsu B_eshlsu2 B_frini B_frini2 B_hstlsua B_hstlsua2 B_hsve B_hsve2 B_iclsabg B_iclsabg2 B_kh B_lrhkp B_lrhkp2 B_lrmsbs B_lrmsbs2 B_lrs B_lrs2 B_lsuiamn B_lsuiamn2 B_lsuiamx B_lsuiamx2 B_lsuicif B_lsuicif2 B_lsuickf B_lsuickf2 B_lsurfc B_lsuube B_lsuube2 B_lsuunmn B_lsuunmn2 B_lsuunmx B_lsuunmx2 B_lsuvmmn B_lsuvmmn2 B_lsuvmmx B_lsuvmmx2 B_nmot B_sa B_stend B_tal B_talval B_za B_za2 dfrza2_w dfrza_w frm2_w frm_w kusvk2_w kusvkft2_w kusvkft_w kusvk_w lamsons2_w lamsons_w msabg2_w msabg_w rinlsu2_w rinlsu_w tavsom2_w tavsom_w tavvkm2_w tavvkm_w ua10mo2_w ua10mo_w ubsq_w /end IN_MEASUREMENT
 /begin OUT_MEASUREMENT B_diagia B_diagia2 B_eiclsu B_eiclsu2 B_ekusvk B_ekusvk2 B_elsuwi B_elsuwi2 B_helsuip B_helsuip2 B_lsudip B_lsudip2 B_spf3k B_spf3k2 diclsuAusBits1 diclsuAusBits2 /end OUT_MEASUREMENT
 /begin LOC_MEASUREMENT B_lsuabgl B_lsuabgl2 B_lsumxtk B_lsumxtk2 B_lsuna B_lsuna2 B_lsuocun B_lsuocun2 B_lsuocvm B_lsuocvm2 B_lsuumn B_lsuumn2 B_npsna B_npsna2 B_ocipll B_ocipll2 B_zlsuia B_zlsuia2 dfrsna2_w dfrsna_w diclsuLokBits1 diclsuLokBits2 diclsuLokBits3 diclsuLokBits4 dulsuvm2_w dulsuvm_w frsnast2_w frsnast_w imlna2_w imlna_w thlsuip2_w thlsuip_w zhkocvm zhkocvm2 /end LOC_MEASUREMENT
 /begin SUB_FUNCTION DFPM_DICLSU /end SUB_FUNCTION
/end FUNCTION
/begin FUNCTION DIGIN ""
 /begin OUT_MEASUREMENT B_estart B_oeldr EAS_lsp1hk EAS_lsp1vk EAS_lsp2hk EAS_lsp2vk ES_lock ES_sfdisa ES_sfmdk ES_wda S_bls S_brs S_kl15 S_kupp /end OUT_MEASUREMENT
/end FUNCTION
/begin FUNCTION DIGOUT ""
 /begin IN_MEASUREMENT AS_anskl AS_cantdi AS_dimdk AS_epee AS_hr AS_mar AS_nl AS_psoff AS_res AS_wp B_akr B_ausc_act B_btebl B_bthsh B_bthsh2 B_btkos B_btslp B_btsta B_dmtlmv B_dmtlpm B_ebl B_eblet B_ekp B_end421 B_hdmtlp B_hsh2et B_hshe B_hshe2 B_hshet B_hsve B_hsve2 B_koe B_koset B_slp B_slpet B_sta B_staet /end IN_MEASUREMENT
/end FUNCTION
/begin FUNCTION DIMC "28.50     OBDII; inspection/maintenance-ready" /begin DEF_CHARACTERISTIC SRYAGR SRYHS SRYKAT SRYLS SRYSLS /end DEF_CHARACTERISTIC
 /begin IN_MEASUREMENT B_cdagr B_cddmtl B_cdhsv B_cdkat B_cdldp B_cdlsv B_cdsls B_cdtes B_katfz B_pwf B_rdytes cd_bits1_w cd_bits2_w /end IN_MEASUREMENT
 /begin OUT_MEASUREMENT B_agrrdy B_hsrdy B_kathrdy B_katrdy B_kkrdy B_lsrdy B_slsrdy B_tesrdy evsup1 ready /end OUT_MEASUREMENT
 /begin LOC_MEASUREMENT cryhs crykat cryls crysls crytes /end LOC_MEASUREMENT
/end FUNCTION
/begin FUNCTION DIMCTES "5.10      Diagnose; Inspection-Maintenance Code, Tankentl¸ftungssystem" /begin DEF_CHARACTERISTIC SRYTES /end DEF_CHARACTERISTIC /begin IN_MEASUREMENT B_cddmtl B_cdtes /end IN_MEASUREMENT
 /begin OUT_MEASUREMENT B_drvddmtl B_drvdtev B_rdytes cryddmtl crydtev DIMCTESausbits1 DIMCTESausbitsNOV1 /end OUT_MEASUREMENT
/end FUNCTION
/begin FUNCTION DISA "1.130     Differentielle Sauganlage (BMW)"
 /begin DEF_CHARACTERISTIC CWDISAPOTI CWDIWISCH DELTA_U_O DELTA_U_OS DISAERSATZ DISAIMN DISAIMX DISALMN DISAMN DISAMX DISA_BEGR DISA_KL_I DISA_KL_P DISA_RAMP DISA_SAVE DISA_TOT DISA_TOTE DISA_U DISA_UMN DITVAUS DITVEIN Di_dir DI_ENDE DI_ERSATZE DI_HYST DI_LSTART DI_SCHALT DI_SMIN DI_STDELTA DI_T1 DI_T2 DI_TANS_MN DI_TANS_MX DI_UB_MN DI_UMAMN KLDISATVUB SDISALERN TVDIERR TVDIWISCH1 TVDIWISCH2 T_DIERR T_DIWISCH1 T_DIWISCH2 WLSU ZDIWICNTMX ZWISCHMX /end DEF_CHARACTERISTIC
 /begin IN_MEASUREMENT B_btdisa B_diwisch B_fadisa B_kl15 B_ll B_pwf B_st B_stend B_wuc disatst Disa_spg E_disager E_disamot E_disasch E_disawarn nmot rl startddisa tans tka ub wdkba /end IN_MEASUREMENT
 /begin OUT_MEASUREMENT B_disa B_disalern B_disa_ersatz B_di_ausschalt B_di_einschalt B_su B_wuc_di Dicntlern Dicntlfehl Disaaus_i Disaaus_p Disaaus_w Disa_dir Disa_ist Disa_lern Disa_soll Disa_spgnv Disa_st Disa_uma Disolakt Ditv_aus Di_cnt di_lernst Di_lfehl D_disa_kl D_disa_v D_disa_w Lern_disa St_di Tdierr Tdiwisch1 Tdiwisch2 t_disa1 t_disa2 Zdiwicnt Zdiwisch Zwisch /end OUT_MEASUREMENT
/end FUNCTION
/begin FUNCTION DISTAB "" /begin DEF_CHARACTERISTIC EBEN EBMISS_T EBMISS_Y /end DEF_CHARACTERISTIC
 /begin OUT_MEASUREMENT B_ebDavT B_ebDavY ebCtrNewT ebCtrNewY ebCtrOldT ebCtrOldY ebMissT ebMissY /end OUT_MEASUREMENT
/end FUNCTION
/begin FUNCTION DKATSP "9.50      Katalysatordiagnose durch Gemischsprung"
 /begin DEF_CHARACTERISTIC APKTDI APKTDIT APKTDX AVKATFS CIDKATSP CIDKATSP2 CIDKATSPI CIDKATSPI2 CIDKATSPT CIDKATSPT2 CWDKATSP DMRKTDS FIKTD FKTDAVK FKTDFE FKTDFET KFOSCTM LAKTDEO LAKTDEU LKTDF LKTDFT LKTDM LKTDMT OSCKTD OSCKTDNG OSCKTDT TKTDTO TMAXKATA TVKTDLE TVKTDRX USHKTDM USHKTDR USHKTDRX /end DEF_CHARACTERISTIC
 /begin IN_MEASUREMENT B_cdkatsp B_dktb B_dktb2 B_dktkas B_dktkas2 B_fakat B_fakat2 B_pwf B_tmsdkt B_vekatv B_vekatv2 ilmltkx2_w ilmltkx_w imllaka2_w imllaka_w lamzak2_w lamzak_w lavhkm2_w lavhkm_w msabvhk2_w msabvhk_w tkihkm2_w tkihkm_w ushk ushk2 /end IN_MEASUREMENT
 /begin OUT_MEASUREMENT avkatf avkatf2 B_dkifma B_dkifma2 B_dktens B_dktens2 B_dktm B_dktm2 B_dktr B_dktr2 B_lamdkt B_lamdkt2 B_vekat B_vekat2 B_vekati B_vekati2 dkatspAusBits dkatspAusBits20ms dkatspAusBits20ms_2 dkatspAusBitsNov dmrdkt_w ktspcnt2_w ktspcnt_w lamdkt2_w lamdkt_w m6aktsp m6cktsp m6cktsp2 m6sktsp2_w m6sktsp_w m6wktsp2_w m6wktsp_w oscdktf2_w oscdktf_w /end OUT_MEASUREMENT
 /begin LOC_MEASUREMENT apdkt apdkt2 apdkti apdkti2 apedkts apedkts2 apzdkt apzdkt2 B_cldkt B_cldkt2 B_dkifm B_dkifm2 B_dktle B_dktle2 B_dktme B_dktme2 B_dktre B_dktre2 B_dktrg B_dktrg2 B_edkt B_edkt2 B_elshvdk B_elsvdk2 B_ildkt B_ildkt2 B_predkt B_predkt2 B_todkts B_todkts2 B_zdkt B_zdkt2 B_zkat B_zkat2 dkatspLokBits dkatspLokBits1 dkatspLokBits20ms dkatspLokBits20ms_2 dkatspLokBits_2 fgdkt2_w fgdkt_w imllaki2_w imllaki_w imllako2_w imllako_w ldktmev2_w ldktmev_w mlfdkt2_w mlfdkt_w mlldkt2_w mlldkt_w oscdkt2_w oscdkta2_w oscdkta_w oscdktm2_w oscdktm_w oscdktn2_w oscdktn_w oscdktr2_w oscdktr_w oscdkts2_w oscdkts_w oscdktt2_w oscdktt_w oscdkt_w oscmn2_w oscmnd2_w oscmnd_w oscmn_w oscmx2_w oscmxd2_w oscmxd_w oscmx_w tdktto tdktto2 /end LOC_MEASUREMENT
 /begin SUB_FUNCTION DFPM_DKATSP /end SUB_FUNCTION
/end FUNCTION
/begin FUNCTION DKATSPAUX "3.10      Hilfsmodul f¸r DKATSP zur Behebung von Schnittstellenproblemen" /begin IN_MEASUREMENT dlahi2_w dlahi_w ml_w rk2_w rkte_w rk_w tavhkm2_w tavhkm_w /end IN_MEASUREMENT
 /begin OUT_MEASUREMENT dlatrmi2_w dlatrmi_w msfabr_w rkg2_w rkg_w tavhkmm2_w tavhkmm_w /end OUT_MEASUREMENT
/end FUNCTION
/begin FUNCTION DKATSPEB "3.70      Einschaltbedingungen der Katalysatordiagnose"
 /begin DEF_CHARACTERISTIC CWDKATSPEB CWKATSLK DMLKTDO DTKTDGRAX FKTDGTV MLKTDO MLKTDOO MLKTDOT MLKTDU MLKTDUO MLKTDUT NKTDOT NKTDUT TKTDGRA TKTDSP TMAXKATS TMAXKATSO TMINKATS TMINKATSO TMNKATST TMSUKTDS TMXKATST TSKTDTK TWDKATS ZKTDML ZKTDTK /end DEF_CHARACTERISTIC
 /begin IN_MEASUREMENT B_cdkatsp B_cdkatspf B_cdkatspt B_dkifma B_dkifma2 B_dktens B_dktens2 B_dsls B_dtes B_dvvtobd B_edkvs B_edkvs2 B_fa B_fakat B_fakat2 B_frmax B_frmax2 B_frmin B_frmin2 B_lamdkt B_lamdkt2 B_lr B_lr2 B_lrka B_lrka2 B_lshswok B_lshswok2 B_mdarv B_mdkat B_nswo2 B_sbbhk B_sbbhk2 B_sls B_stend B_tehb B_ukg B_vekati B_vekati2 lamdkt2_w lamdkt_w lamsbg2_w lamsbg_w msabvhk2_w msabvhk_w nmot tkihkm2_w tkihkm_w tmst /end IN_MEASUREMENT
 /begin OUT_MEASUREMENT B_binsti B_dktb B_dktb2 B_dktbi B_dktbi2 B_dktkas B_dktkas2 B_dktlbi B_dktlbi2 B_dktsbs B_dktsbs2 B_dktsps B_tmsdkt B_vekatv B_vekatv2 dkatspebAusBits dkatspebAusBits1 dkatspebAusBits_2 /end OUT_MEASUREMENT
 /begin LOC_MEASUREMENT B_binstop B_dktgtv B_dktgtv2 B_dktn B_dktsps2 B_dkttks B_dkttks2 B_dktts B_elshvdkt B_lshswos B_lshswos2 B_mldkt dkatspebLokBits dkatspebLokBits1 mldkthp_w tkdktg2_w tkdktg_w tkdkthp2_w tkdkthp_w tkdktol2_w tkdktol_w tsdkttk2_w tsdkttk_w /end LOC_MEASUREMENT
/end FUNCTION
/begin FUNCTION DKFTE "1.20      Endstufendiagnose; Kennfeldthermostat-Regelung" /begin DEF_CHARACTERISTIC CWPSETS TKWPWMDMN TKWPWMDMX /end DEF_CHARACTERISTIC /begin REF_CHARACTERISTIC TVP /end REF_CHARACTERISTIC /begin IN_MEASUREMENT B_desee tkwpwm /end IN_MEASUREMENT /begin SUB_FUNCTION DFPM_DKFTE /end SUB_FUNCTION /end FUNCTION
/begin FUNCTION DKOSE "11.10     Diagnose Klimakompressor-Endstufe" /begin DEF_CHARACTERISTIC CWPSKOSE /end DEF_CHARACTERISTIC /begin REF_CHARACTERISTIC TVP /end REF_CHARACTERISTIC /begin IN_MEASUREMENT B_desee B_koe B_kovar /end IN_MEASUREMENT /begin SUB_FUNCTION DFPM_DKOSE /end SUB_FUNCTION /end FUNCTION
/begin FUNCTION DKRNT "11.20     Diagnose; Klopfregelung, Nulltest (OBDII)" /begin DEF_CHARACTERISTIC CWDKRNT CWDKROF DKROFN DKROKU KRFHT UDKRGOFS /end DEF_CHARACTERISTIC /begin REF_CHARACTERISTIC DKROKD /end REF_CHARACTERISTIC
 /begin IN_MEASUREMENT B_dnt B_pwf B_stend igod2_w igod_w ikrma ikrma2 nmot tmfln_w tpnt_aktiv /end IN_MEASUREMENT
 /begin OUT_MEASUREMENT B_krntfv xzskrnt xzskrnt2 xzskrof xzskrof2 /end OUT_MEASUREMENT
 /begin LOC_MEASUREMENT E_hlpkrnt E_hlpkrnt2 E_hlpkrof E_hlpkrof2 xzkrznt xzkrznt2 xzkrzof xzkrzof2 Z_hlpkrnt Z_hlpkrnt2 Z_hlpkrof Z_hlpkrof2 /end LOC_MEASUREMENT
/end FUNCTION
/begin FUNCTION DKRS "33.60     Diagnose; Klopfsensor (OBDII)"
 /begin DEF_CHARACTERISTIC CWDKS1 CWDKS2 CWDKS3 CWDKS4 KRFHKS NDKSO NDKSU UDKSNO UDKSNU /end DEF_CHARACTERISTIC
 /begin REF_CHARACTERISTIC KSZA SENZZYL /end REF_CHARACTERISTIC
 /begin IN_MEASUREMENT B_kr B_krldy B_krndy B_nldg B_pwf B_synph B_tmkr E_krnt E_krnt2 E_krof E_krof2 E_krtp E_krtp2 ks_sym nmot rkr sen_c95 vkr /end IN_MEASUREMENT
 /begin OUT_MEASUREMENT B_krdws rkrn_w xzkrzs xzkrzs2 xzsen xzsen2 /end OUT_MEASUREMENT
 /begin LOC_MEASUREMENT B_ds /end LOC_MEASUREMENT
/end FUNCTION
/begin FUNCTION DKRTP "11.20     Diagnose; Klopfregelung, Testimpuls (OBDII)" /begin DEF_CHARACTERISTIC CWDKRTP UDKRTP /end DEF_CHARACTERISTIC /begin REF_CHARACTERISTIC KRFHT /end REF_CHARACTERISTIC /begin IN_MEASUREMENT B_dtp B_pwf ikrma ikrma2 ikrmet ikrmet2 tpnt_aktiv /end IN_MEASUREMENT /begin OUT_MEASUREMENT B_krtpfv xzskrtp xzskrtp2 /end OUT_MEASUREMENT /begin LOC_MEASUREMENT E_hlpkrtp E_hlpkrtp2 xzkrztp xzkrztp2 Z_hlpkrtp Z_hlpkrtp2 /end LOC_MEASUREMENT /end FUNCTION
/begin FUNCTION DKUPPL "1.50      Diagnose Kupplungsschalter" /begin DEF_CHARACTERISTIC AGANGW AKUPPLB TDKUPNOG VDKUPPLMN /end DEF_CHARACTERISTIC /begin IN_MEASUREMENT B_brems B_lsd codget gangi S_kupp vfzg /end IN_MEASUREMENT /begin OUT_MEASUREMENT anzgangw anzkupplb B_gangok /end OUT_MEASUREMENT /end FUNCTION
/begin FUNCTION DKVS "27.10     Diagnose; Plausibilit‰tspr¸fung Kraftstoffversorgungssysteme"
 /begin DEF_CHARACTERISTIC CPLRA CWDKVSS CWDVVT DFRMST FRAE FRAODN FRAODX FRAUDN FRAUDX FRMSTTDN FRMSTTDX IMLKVSMX MLDKVSF MLDKVSG RKAE RKATDN RKATDX RKAZDN RKAZDX TFRA TFRAOZ TFRAUZ TFRMST TFRMZST TMFRST TRKA TRKATZ TRKAZZ ZFRMST /end DEF_CHARACTERISTIC
 /begin IN_MEASUREMENT B_cdkvs B_fa B_fakvs B_falra B_frao B_frau B_fraur B_fraur2 B_lr B_lr2 B_lra B_lra2 B_lrare B_nofra B_norkat B_norkaz B_pwf B_rkat B_rkatr B_rkatr2 B_rkaz B_rkazr B_rkazr2 B_sa B_tal B_talval B_te cd_bits1_w frao2_w frao_w frau2_w frau_w frm2_w frm_w ml rkat2_w rkat_w rkaz2_w rkaz_w tans tmot /end IN_MEASUREMENT
 /begin OUT_MEASUREMENT B_dkvsf B_dkvstr B_edkvs B_edkvs2 B_gae B_gaefra B_gaefra2 B_gaeing B_gaeing2 B_kvsffl /end OUT_MEASUREMENT
 /begin LOC_MEASUREMENT B_dkvsef B_dkvsef2 B_dkvsfm B_dkvszf B_dkvszf2 B_efrao B_efrao2 B_efrau B_efrau2 B_erkat B_erkat2 B_erkaz B_erkaz2 B_frste B_frste2 B_imlkvse B_norkam B_plra B_rkam B_rkamr B_rkamr2 B_zfrao B_zfrao2 B_zfrau B_zfrau2 B_zrkat B_zrkat2 B_zrkaz B_zrkaz2 DKVS1lokbits DKVSbits DKVSlokbits frauzs2_w frauzs_w imlkvszs_w imlkvs_w rkam2_w rkamzs2_w rkamzs_w rkam_w rkats_w /end LOC_MEASUREMENT
/end FUNCTION
/begin FUNCTION DLLR "28.70     Diagnose: Leerlaufregelung Erkennung blockierter Steller"
 /begin DEF_CHARACTERISTIC DASA DNDLLRO DNDLLRU FHDLLR RLDLLR TADLLR TDLLR TDLLRMN TDLLRMX TDLLRNF TFDLLRO TFDLLRU TMDLLR /end DEF_CHARACTERISTIC
 /begin IN_MEASUREMENT B_cdllr B_dknolu B_dkpu B_dsls B_dtes B_ll B_llr B_lrar B_nldg B_nmot B_nswo1 B_sa B_st B_tehb dmllri_w dns fho limax_w limin_w rl tans tmot tnse_w vfzg /end IN_MEASUREMENT
 /begin OUT_MEASUREMENT B_dllr B_dllra /end OUT_MEASUREMENT
 /begin LOC_MEASUREMENT B_lldia B_nollrflr /end LOC_MEASUREMENT
/end FUNCTION
/begin FUNCTION DLOCVVT "2.10      Diagnose LOCAN VVT" /begin DEF_CHARACTERISTIC TDCNPVVT TDCVD TDCVVT TDCVVTH /end DEF_CHARACTERISTIC
 /begin IN_MEASUREMENT B_fgdcanb B_vdia1cok B_vdia1new B_vdia2cok B_vdia2new B_vvt1chso B_vvt1cok B_vvt1new B_vvt2chso B_vvt2cok B_vvt2new /end IN_MEASUREMENT
/end FUNCTION
/begin FUNCTION DLSAHK "12.140    Lambdasondenalterungs¸berwachung hinter KAT"
 /begin DEF_CHARACTERISTIC ANZDYNSH CWDLSAHK DLAMLASHF DLAMLASHM DMRLASH KMXSTG KTLAMSTEIG LAMLASHMIN LAMSONSVL LAMSTEIG MLLASH MLOSTEST MLUSSTG MLUSTEST MLUSVL SMLDYN TABGSTGK TLLASH TRIPFASH TSALASH TTLASH TUSCHUB TUSENLASH TUSHKRFM TUSHKVL TUSHSMIN TUSLASH TUSMSVL TUSSA TUSTALLASH USHKVL USHLEAN USHRICH USHSTGMX USHSTSOLL USSCHUB /end DEF_CHARACTERISTIC
 /begin IN_MEASUREMENT B_atmtpk B_atmtpk2 B_cdlash B_cwlshdyn B_cwlshsch B_cwlshvl B_dsls B_dtest B_edkvs B_edkvs2 B_evloc B_fa B_fash B_fash2 B_hsha B_hsha2 B_lr B_lr2 B_lrhk B_lrhk2 B_lrhkp B_lrhkp2 B_lsh B_lsh2 B_mdarv B_pwf B_sa B_sbbhk B_sbbhk2 B_stend B_tal B_talval B_vlsuftb B_vlsuftb2 B_vlsumrb B_vlsumrb2 cd_bits2_w lamsbg2_w lamsbg_w lamsons2_w lamsons_w ml_w tahsom2_w tahsom_w ushk ushk2 usrhk usrhk2 /end IN_MEASUREMENT
 /begin OUT_MEASUREMENT B_ddylash B_ddylash2 B_dlash B_dlash2 B_dshk B_dshk2 B_dushkvl B_dushkvl2 B_dushsch B_dushsch2 B_enfmst B_enfmst2 B_enlash B_enlash2 B_entest B_entest2 B_lamend B_lamend2 B_lamlash B_lamlash2 B_lamverg B_lamverg2 B_lsahksp B_lsahksp2 B_lshswok B_lshswok2 B_maxlavh B_maxlavh2 B_minlash B_minlash2 B_mldyn B_mlustest B_nolash B_nolash2 B_sbbhkv B_sbbhkv2 B_teslash B_teslash2 B_trfash B_trfash2 B_ushkf B_ushkf2 B_ushkm B_ushkm2 dmrlash_w lamlash2_w lamlash_w mldyn_w ushfmxstg ushfmxstg2 ushkmxstg ushkmxstg2 ushksteig zlash2_w zlash_w zwdynsh zwdynsh2 /end OUT_MEASUREMENT
 /begin LOC_MEASUREMENT B_abgstg B_abgstg2 B_dlams B_dlams2 B_dylash B_dylash2 B_enmaxla B_enmaxla2 B_enramph B_enramph2 B_hshtpk B_hshtpk2 B_ktrlash B_ktrlash2 B_lshkspe B_lshkspe2 B_lsulash B_lsulash2 B_maxla B_maxla2 B_maxlash B_maxlash2 B_nolavh B_nolavh2 B_npllash B_npllash2 B_siglash B_siglash2 B_steigm B_steigm2 B_uscherf B_uscherf2 B_ushkmf B_ushkmf2 B_ushkrfm B_ushkrfm2 B_ushsch B_ushsch2 B_usrhkmx B_usrhkmx2 B_vlsufm B_vlsufm2 dlams2_w dlams_w intlash2_w intlash_w lamtrip2_w lamtrip_w ushksteig2 usrhkmx usrhkmx2 usrhks usrhks2 /end LOC_MEASUREMENT
/end FUNCTION
/begin FUNCTION DLSH "26.220    Diagnose; Sondenbetriebsbereitschaft hinter Kat"
 /begin DEF_CHARACTERISTIC ANZHZKH ANZHZOFFH DLAMELSH DMRLSH DRISIGH DUSHKHZK RISIGRESH TAMDOGH TAMDUGH TAMSIGH TASIG TMSH TMSHA TNSTDNH TRSAFA TRSAH TRSE TTBMH TUSEHKH TUSHZFH TUSKS TUSMAX TUSTAL UBDLS USMAX USMIN USREFH USREFHKLT USREMH /end DEF_CHARACTERISTIC
 /begin IN_MEASUREMENT B_atmtpk B_atmtpk2 B_cdlsh B_dushkvl B_dushkvl2 B_fa B_falsh B_falsh2 B_hsha B_hsha2 B_hshe B_hshe2 B_lsh B_lsh2 B_nmot B_pwf B_st B_tal B_talval rinh2_w rinh_w tahsom2_w tahsom_w tmot tmotab ub ushk2_w ushk_w /end IN_MEASUREMENT
 /begin OUT_MEASUREMENT B_elshbb B_elshbb2 B_risigh B_risigh2 B_sbbhk B_sbbhk2 B_ttbmhh B_ttbmhh2 dmrlsh_w lamelsh2_w lamelsh_w zhzkh zhzkh2 zhzoffh zhzoffh2 /end OUT_MEASUREMENT
 /begin LOC_MEASUREMENT B_adsh B_adsh2 B_adshs B_adshs2 B_anzhzkh B_anzhzkh2 B_anzhzoh B_anzhzoh2 B_dshen B_dshen2 B_elshv B_elshv2 B_hzkfh B_hzkfh2 B_hzkhzyk B_hzkhzyk2 B_hzoffh B_hzoffh2 B_lshklt B_maxflsh B_maxflsh2 B_minflsh B_minflsh2 B_noadsh B_noadsh2 B_nolsh B_nolsh2 B_nplflsh B_nplflsh2 B_sbbhkre B_sbbhkre2 B_sigflsh B_sigflsh2 B_trsah B_trsah2 B_tushzfh B_tushzfh2 B_uhsig B_uhsig2 B_zlshv B_zlshv2 DLSHerrors /end LOC_MEASUREMENT
/end FUNCTION
/begin FUNCTION DLSSA "14.90     Signalausgabe Lambdasonden"
 /begin DEF_CHARACTERISTIC DLAHISATO DLAHISATU DYNLSUTO DYNLSUTU LAMSSAMN LAMSSAMX SAFK1 TWDLSSA USIVMAXH USIVMINH USMNSHMN USMNSHMX USMXSHMN USMXSHMX USRHKSHJ USRJ /end DEF_CHARACTERISTIC
 /begin IN_MEASUREMENT B_lrhk B_lrhk2 B_pwf dlahi2_w dlahi_w dynlsu2_w dynlsu_w lamsoni2_w lamsoni_w lamsons2_w lamsons_w ushk ushk2 /end IN_MEASUREMENT
 /begin OUT_MEASUREMENT dlahisa dlahisa2 dynlsusa dynlsusa2 lamsisa lamsisa2 lamsosa lamsosa2 ushkj ushkj2 usmnshn usmnshn2 usmxshn usmxshn2 /end OUT_MEASUREMENT
 /begin LOC_MEASUREMENT twdlssh2_w twdlssh_w ushkjf2_w ushkjf_w usmnsha usmnsha2 usmxsha usmxsha2 /end LOC_MEASUREMENT
/end FUNCTION
/begin FUNCTION DLSUV "2.50      Erkennung vertauschte Lambda-Sonden vor Kat" /begin DEF_CHARACTERISTIC FRDO FRDU TDLSVV TDWLSVV /end DEF_CHARACTERISTIC
 /begin IN_MEASUREMENT B_bglrdy B_cdlsvv B_cdvvnw B_dvvtobd B_enws B_lrs B_lrs2 frm2_w frm_w /end IN_MEASUREMENT
 /begin OUT_MEASUREMENT B_elsuv /end OUT_MEASUREMENT
/end FUNCTION
/begin FUNCTION DMDDLU "16.10     Diagnose Misfire Detection Differenzbildung der Laufunruhe" /begin DEF_CHARACTERISTIC DLURMIN DMXRDL KFDLUR KFDLUR1 KFDLUR2 NMIDLU /end DEF_CHARACTERISTIC /begin REF_CHARACTERISTIC SMI08DMUB SNM08DMUB /end REF_CHARACTERISTIC
 /begin IN_MEASUREMENT B_analu B_lustop B_mdstop B_wk B_wkr dlutsk_f esst_smi08dmub esst_snm08dmub flurktm_f fofstat fonstat lurminstat midmd nmot /end IN_MEASUREMENT
 /begin OUT_MEASUREMENT B_dluerk fdlurmin_f /end OUT_MEASUREMENT
 /begin LOC_MEASUREMENT dlursalt_f dlurs_f fdlurs_f fdlur_f fkfdlur1_f fkfdlur2_f fkfdlur_f /end LOC_MEASUREMENT
/end FUNCTION
/begin FUNCTION DMDFLU "3.10      Diagnose Misfire Detection Filterung der Laufunruhe" /begin DEF_CHARACTERISTIC ZLUTSFI /end DEF_CHARACTERISTIC /begin IN_MEASUREMENT B_ll B_pwf lutszyl_f luts_f zzyllfb /end IN_MEASUREMENT
 /begin OUT_MEASUREMENT lutsfi1_w lutsfi2_w lutsfi3_w lutsfi4_w lutsfi5_w lutsfi6_w lutsfi7_w lutsfi8_w /end OUT_MEASUREMENT
/end FUNCTION
/begin COMPU_METHOD B_TRUE "boolsche Zust‰nde, positive Logik" TAB_VERB "%6.3" "" COMPU_TAB_REF B_TRUE /end COMPU_METHOD
/begin COMPU_VTAB B_TRUE "boolsche Zust‰nde, positive Logik" TAB_VERB 2 0 "----" 1 "TRUE" /end COMPU_VTAB
/begin COMPU_METHOD DEZ "1 : 1 Umrechnug (dez/hex)" RAT_FUNC "%6.2" "" COEFFS 0 1 0 0 0 1 /end COMPU_METHOD
/begin COMPU_METHOD dez "1 : 1 Umrechnug (dez/hex)" RAT_FUNC "%6.2" "" COEFFS 0 1 0 0 0 1 /end COMPU_METHOD
/begin COMPU_METHOD di_uw_q0p01 "" RAT_FUNC "%6.4" "" COEFFS 0 100 0 0 0 1 /end COMPU_METHOD
/begin COMPU_METHOD fak_q0p0195 "" RAT_FUNC "%6.4" "-" COEFFS 0 256 0 0 0 5 /end COMPU_METHOD
/begin COMPU_METHOD fak_q0p1 "" RAT_FUNC "%6.3" "-" COEFFS 0 1 0 0 0 0.1 /end COMPU_METHOD
/begin COMPU_METHOD fak_r32_1 "" RAT_FUNC "%27.13" "-" COEFFS 0 1 0 0 0 1 /end COMPU_METHOD
/begin COMPU_METHOD fak_sw_b1 "" RAT_FUNC "%7.6" "-" COEFFS 0 65536 0 0 0 2 /end COMPU_METHOD
/begin COMPU_METHOD fak_ub_b0p1_o0p05 "" RAT_FUNC "%8.7" "-" COEFFS 0 256 12.8 0 0 0.1 /end COMPU_METHOD
/begin COMPU_METHOD fak_ub_b1 "" RAT_FUNC "%6.4" "-" COEFFS 0 256 0 0 0 1 /end COMPU_METHOD
/begin COMPU_METHOD fak_ub_b2 "" RAT_FUNC "%6.4" "-" COEFFS 0 256 0 0 0 2 /end COMPU_METHOD
/begin COMPU_METHOD fak_ub_b4 "" RAT_FUNC "%6.4" "-" COEFFS 0 256 0 0 0 4 /end COMPU_METHOD
/begin COMPU_METHOD fak_ub_b8 "" RAT_FUNC "%6.4" "-" COEFFS 0 256 0 0 0 8 /end COMPU_METHOD
/begin COMPU_METHOD fak_uw_b1 "" RAT_FUNC "%7.6" "-" COEFFS 0 65536 0 0 0 1 /end COMPU_METHOD
/begin COMPU_METHOD fak_uw_b128 "" RAT_FUNC "%6.4" "-" COEFFS 0 65536 0 0 0 128 /end COMPU_METHOD
/begin COMPU_METHOD fak_uw_b16 "" RAT_FUNC "%6.5" "-" COEFFS 0 65536 0 0 0 16 /end COMPU_METHOD
/begin COMPU_METHOD fak_uw_b2 "" RAT_FUNC "%7.6" "-" COEFFS 0 65536 0 0 0 2 /end COMPU_METHOD
/begin COMPU_METHOD luquant_w "Umrechnung Laufunruhe Word-Grˆﬂen in DMD" RAT_FUNC "%6.4" "(1/min/s)^2" COEFFS 0 256 0 0 0 0.710543 /end COMPU_METHOD
/begin COMPU_METHOD m_q0p00277 "" RAT_FUNC "%6.4" "g" COEFFS 0 360 0 0 0 1 /end COMPU_METHOD
/begin COMPU_METHOD m_q0p00355 "" RAT_FUNC "%6.4" "kg" COEFFS 0 1125 0 0 0 4 /end COMPU_METHOD
/begin COMPU_METHOD m_q0p1 "" RAT_FUNC "%6.3" "kg/h" COEFFS 0 10 0 0 0 1 /end COMPU_METHOD
/begin COMPU_METHOD m_q0p1_mg "" RAT_FUNC "%6.3" "mg" COEFFS 0 1 0 0 0 0.1 /end COMPU_METHOD
/begin COMPU_METHOD m_q2p777Em5_kg "" RAT_FUNC "%7.6" "kg" COEFFS 0 3600 0 0 0 0.1 /end COMPU_METHOD
/begin COMPU_METHOD m_uw_b102p4 "" RAT_FUNC "%6.4" "kg/h" COEFFS 0 65536 0 0 0 102.4 /end COMPU_METHOD
/begin COMPU_METHOD m_uw_b291p25 "" RAT_FUNC "%6.4" "g" COEFFS 0 225 0 0 0 1 /end COMPU_METHOD
/begin COMPU_METHOD m_uw_b6553p5 "" RAT_FUNC "%6.3" "kg/h" COEFFS 0 1 0 0 0 0.1 /end COMPU_METHOD
/begin COMPU_METHOD nmot_ub_q10 "" RAT_FUNC "%6.1" "1/min" COEFFS 0 1 0 0 0 10 /end COMPU_METHOD
/begin COMPU_METHOD nmot_ub_q40 "" RAT_FUNC "%6.1" "1/min" COEFFS 0 1 0 0 0 40 /end COMPU_METHOD
/begin COMPU_METHOD PCENT "Prozent" RAT_FUNC "%6.3" "%" COEFFS 0 256 0 0 0 100 /end COMPU_METHOD
/begin COMPU_METHOD rel_sw_b1536 "" RAT_FUNC "%6.4" "%" COEFFS 0 65536 0 0 0 3072 /end COMPU_METHOD
/begin COMPU_METHOD rel_ub_b99p6 "" RAT_FUNC "%6.3" "%" COEFFS 0 256 0 0 0 100 /end COMPU_METHOD
/begin COMPU_METHOD rel_ub_q0p75 "" RAT_FUNC "%6.3" "%" COEFFS 0 1 0 0 0 0.75 /end COMPU_METHOD
/begin COMPU_METHOD rel_uw_b100 "" RAT_FUNC "%6.4" "%" COEFFS 0 65536 0 0 0 100 /end COMPU_METHOD
/begin COMPU_METHOD rel_uw_b200 "" RAT_FUNC "%6.4" "%" COEFFS 0 65536 0 0 0 200 /end COMPU_METHOD
/begin COMPU_METHOD rel_uw_b3072 "" RAT_FUNC "%6.4" "%" COEFFS 0 65536 0 0 0 3072 /end COMPU_METHOD
/begin COMPU_METHOD r_q0p0391 "" RAT_FUNC "%6.4" "Ohm" COEFFS 0 65536 0 0 0 2560 /end COMPU_METHOD
/begin COMPU_METHOD r_uw_q2 "" RAT_FUNC "%6.2" "Ohm" COEFFS 0 1 0 0 0 2 /end COMPU_METHOD
/begin COMPU_METHOD spgg_q0p52 "" RAT_FUNC "%6.3" "mV/ms" COEFFS 0 1 0 0 0 0.52 /end COMPU_METHOD
/begin COMPU_METHOD spgg_sw_b3052 "" RAT_FUNC "%6.3" "V/s" COEFFS 0 1 0 0 0 0.0931323 /end COMPU_METHOD
/begin COMPU_METHOD spg_q4p88Em4 "" RAT_FUNC "%6.5" "V" COEFFS 0 2048 0 0 0 1 /end COMPU_METHOD
/begin COMPU_METHOD spg_ubatt "" RAT_FUNC "%6.3" "V" COEFFS 0 1 0 0 0 0.0942 /end COMPU_METHOD
/begin COMPU_METHOD spg_ub_b1p33 "" RAT_FUNC "%6.4" "V" COEFFS 0 255 0 0 0 1.33 /end COMPU_METHOD
/begin COMPU_METHOD spg_ub_b5 "" RAT_FUNC "%6.4" "V" COEFFS 0 256 0 0 0 5 /end COMPU_METHOD
/begin COMPU_METHOD spg_ub_q0p0052_o0p2 "" RAT_FUNC "%6.3" "V" COEFFS 0 255 51 0 0 1.33 /end COMPU_METHOD
/begin COMPU_METHOD spg_uw_b1280 "" RAT_FUNC "%6.4" "V" COEFFS 0 1000 0 0 0 19.5313 /end COMPU_METHOD
/begin COMPU_METHOD spg_uw_b1p33 "" RAT_FUNC "%7.6" "V" COEFFS 0 65535 0 0 0 1.33 /end COMPU_METHOD
/begin COMPU_METHOD spg_uw_b5 "" RAT_FUNC "%6.4" "V" COEFFS 0 1024 0 0 0 5 /end COMPU_METHOD
/begin COMPU_METHOD spg_uw_q0p00488 "" RAT_FUNC "%6.4" "V" COEFFS 0 1024 0 0 0 5 /end COMPU_METHOD
/begin COMPU_METHOD spg_uw_q0p00488_o1 "" RAT_FUNC "%6.3" "V" COEFFS 0 1024 1024 0 0 5 /end COMPU_METHOD
/begin COMPU_METHOD t100msxs_ub_b25p5 "" RAT_FUNC "%6.3" "s" COEFFS 0 1 0 0 0 0.1 /end COMPU_METHOD
/begin COMPU_METHOD t100msxs_uw_b6553p5 "" RAT_FUNC "%6.3" "s" COEFFS 0 1 0 0 0 0.1 /end COMPU_METHOD
/begin COMPU_METHOD t100msxs_uw_q100 "" RAT_FUNC "%6.3" "s" COEFFS 0 1 0 0 0 0.1 /end COMPU_METHOD
/begin COMPU_METHOD t10msxs_ub_b2p55 "" RAT_FUNC "%6.4" "s" COEFFS 0 1 0 0 0 0.01 /end COMPU_METHOD
/begin COMPU_METHOD t10msxs_uw_b655p35 "" RAT_FUNC "%6.4" "s" COEFFS 0 1 0 0 0 0.01 /end COMPU_METHOD
/begin COMPU_METHOD t1sxs_ub_b255 "" RAT_FUNC "%6.2" "s" COEFFS 0 1 0 0 0 1 /end COMPU_METHOD
/begin COMPU_METHOD t200msxs_ub_b51 "" RAT_FUNC "%6.3" "s" COEFFS 0 1 0 0 0 0.2 /end COMPU_METHOD
/begin COMPU_METHOD t20msxs_ub_b5p1 "" RAT_FUNC "%6.4" "s" COEFFS 0 1 0 0 0 0.02 /end COMPU_METHOD
/begin COMPU_METHOD t50msxs_uw_b3276p75 "" RAT_FUNC "%6.4" "s" COEFFS 0 1 0 0 0 0.05 /end COMPU_METHOD
/begin COMPU_METHOD temp_q0p0234 "" RAT_FUNC "%6.4" "K" COEFFS 0 256 0 0 0 6 /end COMPU_METHOD
/begin COMPU_METHOD temp_q0p0234_o273 "" RAT_FUNC "%6.1" "Grad C" COEFFS 0 1 273.15 0 0 0.0234375 /end COMPU_METHOD
/begin COMPU_METHOD temp_ub_q0p75_o48 "" RAT_FUNC "%6.2" "Grad C" COEFFS 0 1 48 0 0 0.75 /end COMPU_METHOD
/begin COMPU_METHOD ttemp_q0p0333 "" RAT_FUNC "%6.4" "s / K" COEFFS 0 30 0 0 0 1 /end COMPU_METHOD
/begin COMPU_METHOD tus_uw_q3p2 "" RAT_FUNC "%6.2" "us" COEFFS 0 1 0 0 0 3.2 /end COMPU_METHOD
/begin COMPU_METHOD t_q0p02 "" RAT_FUNC "%6.4" "s" COEFFS 0 100 0 0 0 2 /end COMPU_METHOD
/begin COMPU_METHOD t_q0p05 "" RAT_FUNC "%6.4" "s" COEFFS 0 100 0 0 0 5 /end COMPU_METHOD
/begin COMPU_METHOD t_q0p1 "" RAT_FUNC "%6.3" "s" COEFFS 0 10 0 0 0 1 /end COMPU_METHOD
/begin COMPU_METHOD t_q0p2 "" RAT_FUNC "%6.3" "s" COEFFS 0 10 0 0 0 2 /end COMPU_METHOD
/begin COMPU_METHOD vfzg_ub_q1p25 "" RAT_FUNC "%6.2" "km/h" COEFFS 0 1 0 0 0 1.25 /end COMPU_METHOD
/begin COMPU_METHOD vnstv_q0p00305 "" RAT_FUNC "%7.5" "%" COEFFS 0 327.68 0 0 0 1 /end COMPU_METHOD
/begin COMPU_METHOD vnstv_q0p00305s32768 "" RAT_FUNC "%7.3" "%" COEFFS 0 327.68 32768 0 0 1 /end COMPU_METHOD
/begin COMPU_METHOD zk100msxs_uw_b6553 "" RAT_FUNC "%6.1" "s" COEFFS 0 0 65536 0 10 0 /end COMPU_METHOD
/begin COMPU_METHOD zk200msxs_ub_b51p2 "" RAT_FUNC "%6.3" "s" COEFFS 0 0 51.2 0 1 0 /end COMPU_METHOD
/begin COMPU_METHOD zk200msxs_uw_b13107 "" RAT_FUNC "%6.0" "s" COEFFS 0 0 13107 0 1 0 /end COMPU_METHOD
/begin COMPU_METHOD zk50msxs_uw_b3276p8 "" RAT_FUNC "%6.1" "s" COEFFS 0 0 65536 0 20 0 /end COMPU_METHOD
/begin RECORD_LAYOUT GkfWU16 FNC_VALUES 1 UWORD COLUMN_DIR DIRECT /end RECORD_LAYOUT
/begin RECORD_LAYOUT GklWU16 FNC_VALUES 1 UWORD COLUMN_DIR DIRECT /end RECORD_LAYOUT
/begin RECORD_LAYOUT KfAxU8AyU8SstxU16SstyU16WU16 NO_AXIS_PTS_X 1 UWORD NO_AXIS_PTS_Y 2 UWORD AXIS_PTS_X 3 UWORD INDEX_INCR DIRECT AXIS_PTS_Y 4 UWORD INDEX_INCR DIRECT FNC_VALUES 5 UWORD COLUMN_DIR DIRECT /end RECORD_LAYOUT
/begin RECORD_LAYOUT KfAxUbAyUbSstxUbSstyUbWUb NO_AXIS_PTS_X 1 UBYTE NO_AXIS_PTS_Y 2 UBYTE AXIS_PTS_X 3 UBYTE INDEX_INCR DIRECT AXIS_PTS_Y 4 UBYTE INDEX_INCR DIRECT FNC_VALUES 5 UBYTE COLUMN_DIR DIRECT /end RECORD_LAYOUT
/begin RECORD_LAYOUT KlAUbSstUbWUb NO_AXIS_PTS_X 1 UBYTE AXIS_PTS_X 2 UBYTE INDEX_INCR DIRECT FNC_VALUES 3 UBYTE COLUMN_DIR DIRECT /end RECORD_LAYOUT
/begin RECORD_LAYOUT KlAUbSstUbWUw NO_AXIS_PTS_X 1 UBYTE AXIS_PTS_X 2 UBYTE INDEX_INCR DIRECT FNC_VALUES 3 UWORD COLUMN_DIR DIRECT /end RECORD_LAYOUT
/begin RECORD_LAYOUT KlAUwSstUwWUw NO_AXIS_PTS_X 1 UWORD AXIS_PTS_X 2 UWORD INDEX_INCR DIRECT FNC_VALUES 3 UWORD COLUMN_DIR DIRECT /end RECORD_LAYOUT
/begin RECORD_LAYOUT KlAxU8SstxU16WU16 NO_AXIS_PTS_X 1 UWORD AXIS_PTS_X 2 UWORD INDEX_INCR DIRECT FNC_VALUES 3 UWORD COLUMN_DIR DIRECT /end RECORD_LAYOUT
/begin RECORD_LAYOUT KwSb FNC_VALUES 1 SBYTE COLUMN_DIR DIRECT /end RECORD_LAYOUT
/begin RECORD_LAYOUT KwSw FNC_VALUES 1 SWORD COLUMN_DIR DIRECT /end RECORD_LAYOUT
/begin RECORD_LAYOUT KwUb FNC_VALUES 1 UBYTE COLUMN_DIR DIRECT /end RECORD_LAYOUT
/begin RECORD_LAYOUT KwUw FNC_VALUES 1 UWORD COLUMN_DIR DIRECT /end RECORD_LAYOUT
/begin RECORD_LAYOUT KwWR32 FNC_VALUES 1 FLOAT32_IEEE COLUMN_DIR DIRECT /end RECORD_LAYOUT
/begin RECORD_LAYOUT KwWS16 FNC_VALUES 1 SWORD COLUMN_DIR DIRECT /end RECORD_LAYOUT
/begin RECORD_LAYOUT KwWU16 FNC_VALUES 1 UWORD COLUMN_DIR DIRECT /end RECORD_LAYOUT
/begin RECORD_LAYOUT KwWU8 FNC_VALUES 1 UBYTE COLUMN_DIR DIRECT /end RECORD_LAYOUT
/begin RECORD_LAYOUT SstAU8SstU8 NO_AXIS_PTS_X 1 UBYTE AXIS_PTS_X 2 UBYTE INDEX_INCR DIRECT /end RECORD_LAYOUT
/end MODULE
/end PROJECT
