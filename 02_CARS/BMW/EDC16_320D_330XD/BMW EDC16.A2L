ASAP2_VERSION 1 3
/begin PROJECT P383 "BMW DDE6.3 8-Zylinder V9E.3 11.10.2004 CAN12H"
/begin HEADER "" VERSION "V9E.3_8Z_CAN12H" PROJECT_NO P383 /end HEADER
/begin MODULE DIM ""
/begin MOD_COMMON "" BYTE_ORDER MSB_FIRST ALIGNMENT_BYTE 1 ALIGNMENT_WORD 2 ALIGNMENT_LONG 4 ALIGNMENT_FLOAT32_IEEE 4 /end MOD_COMMON
/begin CHARACTERISTIC InjVCD_uChrgThrSRCLo_C "Untere Schwelle für die Plausibilisierung der CY370-Integrator-Ausgangsspannung" VALUE 0xEA264 Kw_Ws16 5000.000 Volt 0.00 5000.000 FORMAT "%8.3" EXTENDED_LIMITS -160156.4 160151.5 /end CHARACTERISTIC
/begin CHARACTERISTIC InjVCD_uChrgThrSRCHi_C "Obere Schwelle für die Plausibilisierung der CY370-Integrator-Ausgangsspannung" VALUE 0xEA266 Kw_Ws16 5000.000 Volt 0.00 5000.000 FORMAT "%8.3" EXTENDED_LIMITS -160156.4 160151.5 /end CHARACTERISTIC
/begin CHARACTERISTIC InjVCD_uChrgLin_CUR "Linearisierungskurve für die Ausgangsspannung des CY370-Integrators" CURVE 0xEA268 Kl_Xs16_Ws16 320307.9 Volt -160156.4 160151.5 FORMAT "%8.1"
 /begin AXIS_DESCR STD_AXIS InjVCD_uRawChgUp_mp Volt 2 0.00 5200.391 FORMAT "%8.3" EXTENDED_LIMITS -160156.4 160151.5 DEPOSIT ABSOLUTE /end AXIS_DESCR
/end CHARACTERISTIC
/begin CHARACTERISTIC InjVCD_uActrThrSRCLo_C "untere Spannungsschwelle SRC der Aktorspannung" VALUE 0xEA272 Kw_Ws16 5000.000 Volt 0.00 5000.000 FORMAT "%8.3" EXTENDED_LIMITS -160156.4 160151.5 /end CHARACTERISTIC
/begin CHARACTERISTIC InjVCD_uActrThrSRCHi_C "obere Spannungsschwelle SRC der Aktorspannung" VALUE 0xEA274 Kw_Ws16 5000.000 Volt 0.00 5000.000 FORMAT "%8.3" EXTENDED_LIMITS -160156.4 160151.5 /end CHARACTERISTIC
/begin CHARACTERISTIC InjVCD_uActrLin_CUR "Linearisierungkurve ADC-Rohwert -> Aktorspannung" CURVE 0xEA276 Kl_Xs16_Ws16 655.3500 Volt_PA -327.6800 327.6700 FORMAT "%8.4"
 /begin AXIS_DESCR STD_AXIS InjVCD_uRawUp_mp Volt 2 0.00 5200.391 FORMAT "%8.3" EXTENDED_LIMITS -160156.4 160151.5 DEPOSIT ABSOLUTE /end AXIS_DESCR
/end CHARACTERISTIC
/begin CHARACTERISTIC InjVCD_chgMaxPlaus_C "Maximale Ladung" VALUE 0xEA280 Kw_Ws16 65535.00 Charge_PA -32768.00 32767.00 FORMAT "%8.2" /end CHARACTERISTIC
/begin CHARACTERISTIC InjVCD_chgMinPlaus_C "minimale Ladung" VALUE 0xEA282 Kw_Ws16 65535.00 Charge_PA -32768.00 32767.00 FORMAT "%8.2" /end CHARACTERISTIC
/begin CHARACTERISTIC InjVCD_ctThresShOffDCDCEv_C "Zälerschwelle zu detektieren endlose ""single-event"" -Aufrufen" VALUE 0xEAA74 Kw_Wu8 255.0 OneToOne 0.00 255.0 FORMAT "%5.1" READ_ONLY /end CHARACTERISTIC
/begin CHARACTERISTIC InjVCD_uCY370ThrSRCLo_C "untere Spannungsschwelle für Integratorabgleich" VALUE 0xEA314 Kw_Ws16 5000.000 Volt 0.00 5000.000 FORMAT "%8.3" EXTENDED_LIMITS -160156.4 160151.5 /end CHARACTERISTIC
/begin CHARACTERISTIC InjVCD_uCY370ThrSRCHi_C "obere Spannungsschwelle für Integratorabgleich" VALUE 0xEA316 Kw_Ws16 5000.000 Volt 0.00 5000.000 FORMAT "%8.3" EXTENDED_LIMITS -160156.4 160151.5 /end CHARACTERISTIC
/begin CHARACTERISTIC InjVCD_uCY370Lin_CUR "Linearisierungskurve für Spannung vom Integratorabgleich" CURVE 0xEA318 Kl_Xs16_Ws16 320307.9 Volt -160156.4 160151.5 FORMAT "%8.1"
 /begin AXIS_DESCR STD_AXIS InjVCD_uRawCY370Int0_mp Volt 2 0.00 5200.391 FORMAT "%8.3" EXTENDED_LIMITS -160156.4 160151.5 DEPOSIT ABSOLUTE /end AXIS_DESCR
/end CHARACTERISTIC
/begin CHARACTERISTIC InjVCD_DebActrEnrgDef_C "Zähler für endgültig defekt" VALUE 0xEA290 Kw_Wu16 65535.00 OneToOne 0.00 65535.00 FORMAT "%8.2" /end CHARACTERISTIC
/begin CHARACTERISTIC InjVCD_DebActrEnrgOK_C "Zähler bis endgültig geheilt" VALUE 0xEA292 Kw_Wu16 65535.00 OneToOne 0.00 65535.00 FORMAT "%8.2" /end CHARACTERISTIC
/begin CHARACTERISTIC InjVCD_DebDCDCLowDef_C "Fehlerentprellung Zustandsdauerfehler DC_LOW" VALUE 0xEA324 Kw_Ws16 327670.0 Time_ms 0.00 327670.0 FORMAT "%8.1" EXTENDED_LIMITS -327680.0 327670.0 /end CHARACTERISTIC
/begin CHARACTERISTIC InjVCD_DebUBufSRCHighDef_C "Defektentprellung für SRC-High-Fehler" VALUE 0xEA9EC Kw_Wu16 65535.00 OneToOne 0.00 65535.00 FORMAT "%8.2" /end CHARACTERISTIC
/begin CHARACTERISTIC InjVCD_DebUBufSRCHighOk_C "Heilungsentprellung für SRC-High-Fehler" VALUE 0xEA9EE Kw_Wu16 65535.00 OneToOne 0.00 65535.00 FORMAT "%8.2" /end CHARACTERISTIC
/begin CHARACTERISTIC InjVCD_DebUBufSRCLowDef_C "Defektentprellung für SRC-Low-Fehler" VALUE 0xEA9F0 Kw_Wu16 65535.00 OneToOne 0.00 65535.00 FORMAT "%8.2" /end CHARACTERISTIC
/begin CHARACTERISTIC InjVCD_DebUBufSRCLowOk_C "Heilungsentprellung für SRC-Low-Fehler" VALUE 0xEA9F2 Kw_Wu16 65535.00 OneToOne 0.00 65535.00 FORMAT "%8.2" /end CHARACTERISTIC
/begin CHARACTERISTIC InjVCD_dtiEMComp_C "Dauer der Verkürzung der Einspritzung (von Flankenmanagement)" VALUE 0xC062A Kw_Ws16 32768.00 InjTime_us -1.000000 32767.00 FORMAT "%8.2" EXTENDED_LIMITS -32768.00 32767.00 /end CHARACTERISTIC
/begin CHARACTERISTIC InjVCD_duInt_C "Gradient zur Kompensation des Abfalls der Integrator-Ausgangsspannung" VALUE 0xEA300 Kw_Ws16 30.00000 Delta_Volt_INT 0.00 30.00000 FORMAT "%8.5" EXTENDED_LIMITS -32768.00 32767.00 /end CHARACTERISTIC
/begin CHARACTERISTIC InjVCD_facMonUThresHiPl_CA "Faktor fuer Schwelle fuer Spannungsplausibilisierung, Verletzung oben (index : 0=BOTT, 1=UP)" VAL_BLK 0xEAA08 Kwb_Ws16 10.00000 Fact1 0.00 10.00000 FORMAT "%8.5" EXTENDED_LIMITS -256.0000 255.9922 NUMBER 2 /end CHARACTERISTIC
/begin CHARACTERISTIC InjVCD_facMonUThresLoPl_CA "Faktor fuer Schwelle fuer Spannungsplausibilisierung, Verletzung unten (index : 0=BOTT, 1=UP)" VAL_BLK 0xEAA0C Kwb_Ws16 20.00000 Fact1 -10.00000 10.00000 FORMAT "%8.5" EXTENDED_LIMITS -256.0000 255.9922 NUMBER 2 /end CHARACTERISTIC
/begin CHARACTERISTIC InjVCD_facWActrChrgCorr_C "Korrekturfaktor für Energieberechnung aus Spannungsdifferenz und Ladung beim Laden" VALUE 0xEA294 Kw_Ws16 10.00000 Fact1 0.00 10.00000 FORMAT "%8.5" EXTENDED_LIMITS -256.0000 255.9922 /end CHARACTERISTIC
/begin CHARACTERISTIC InjVCD_facWActrCorr_C "Verstärkungsfaktor für das Verhältnis von nominalem zu korrigiertem Energieverbrauch einer Piezo-Aktor-Ansteuerung" VALUE 0xEA296 Kw_Ws16 10.00000 Fact1 0.00 10.00000 FORMAT "%8.5" EXTENDED_LIMITS -256.0000 255.9922 /end CHARACTERISTIC
/begin CHARACTERISTIC InjVCD_facWActrDisChCorr_C "Korrekturfaktor für die Energieberechnung aus Spannungsdifferenz und Ladung beim Entladen" VALUE 0xEA298 Kw_Ws16 10.00000 Fact1 0.00 10.00000 FORMAT "%8.5" EXTENDED_LIMITS -256.0000 255.9922 /end CHARACTERISTIC
/begin CHARACTERISTIC InjVCD_facWActrDvtMax_C "Maximalwertbegrenzung für das Verhrhältnis von nominalem zu korrigiertem Aktor-Energieverbrauch" VALUE 0xEA29A Kw_Ws16 9.000000 Fact1 1.000000 10.00000 FORMAT "%8.5" EXTENDED_LIMITS -256.0000 255.9922 /end CHARACTERISTIC
/begin CHARACTERISTIC InjVCD_facWActrDvtMin_C "Minimalwertbegrenzung für das Verhrhältnis von nominalem zu korrigiertem Aktor-Energieverbrauch" VALUE 0xEA29C Kw_Ws16 1.000000 Fact1 0.00 1.000000 FORMAT "%8.6" EXTENDED_LIMITS -256.0000 255.9922 /end CHARACTERISTIC
/begin CHARACTERISTIC InjVCD_facWActrMax_C "Obere Grenze des Energieverbrauchsfaktors zur Energiedrifterkennung" VALUE 0xEA29E Kw_Ws16 4.000000 Fact1 1.000000 5.000000 FORMAT "%8.6" EXTENDED_LIMITS -256.0000 255.9922 /end CHARACTERISTIC
/begin CHARACTERISTIC InjVCD_facWActrMin_C "Untere Grenze des Energieverbrauchsfaktors zur Energiedrifterkennung" VALUE 0xEA2A0 Kw_Ws16 0.7031250 Fact1 0.2968750 1.000000 FORMAT "%8.6" EXTENDED_LIMITS -256.0000 255.9922 /end CHARACTERISTIC
/begin CHARACTERISTIC InjVCD_facWActrTemp_CUR "Termpeaturkorrekurfaktor des nominalen Energieverbrauches einer Piezo-Aktor Ansteuerung" CURVE 0xEA2A2 Kl_Xs16_Ws16 10.00000 Fact1 0.00 10.00000 FORMAT "%8.5" EXTENDED_LIMITS -256.0000 255.9922
 /begin AXIS_DESCR STD_AXIS InjVCD_tActrEnrg_mp Temp_Cels 5 -50.140 899.860 FORMAT "%8.3" EXTENDED_LIMITS -3549.940 3003.560 DEPOSIT ABSOLUTE /end AXIS_DESCR
/end CHARACTERISTIC
/begin CHARACTERISTIC InjVCD_iChrgMonShCir_C "Ladenstrom der Kurzschlussunterscheidung" VALUE 0xEAA1C Kw_Ws16 30000.00 Curr 0.00 30000.00 FORMAT "%8.2" EXTENDED_LIMITS -32768.00 32767.00 /end CHARACTERISTIC
/begin CHARACTERISTIC InjVCD_iDisChMonShCir_C "Entladenstrom der Kurzschlussunterscheidung" VALUE 0xEAA1E Kw_Ws16 30000.00 Curr -30000.00 0.00 FORMAT "%8.2" EXTENDED_LIMITS -32768.00 32767.00 /end CHARACTERISTIC
/begin CHARACTERISTIC InjVCD_iPolarUp_CUR "Kennlinie für die Ladestromgrenze des Piezo-Aktors" CURVE 0xEAA2E Kl_Xs16_Ws16 30000.00 Curr 0.00 30000.00 FORMAT "%8.2" EXTENDED_LIMITS -32768.00 32767.00
 /begin AXIS_DESCR STD_AXIS InjVCD_tPolar_mp Temp_Cels 4 -50.14000 199.8600 FORMAT "%8.4" EXTENDED_LIMITS -3549.940 3003.560 DEPOSIT ABSOLUTE /end AXIS_DESCR
/end CHARACTERISTIC
/begin CHARACTERISTIC InjVCD_rCapUpTolc_C "Toleranzband für Kapazitätsverhältnis zur Erkennung von Kurzschlüssen der select-Schalter" VALUE 0xEAA10 Kw_Ws16 7.999878 Fact -4.000000 3.999878 FORMAT "%8.6" /end CHARACTERISTIC
/begin CHARACTERISTIC InjVCD_rTiChrgUpTolc_C "Toleranzband fuer Aktorladezeitverhaeltnis zum Erkennen eines Lowside Schalter Kurzschlusses" VALUE 0xEAA12 Kw_Ws16 7.999878 Fact -4.000000 3.999878 FORMAT "%8.6" /end CHARACTERISTIC
/begin CHARACTERISTIC InjVCD_mskTpuErr_C "Maske zur Deaktivierung der Aktormessung bei TPU-Fehlern" VALUE 0xEA284 Kw_Wu16 65535.00 OneToOne 0.00 65535.00 FORMAT "%8.2" /end CHARACTERISTIC
/begin CHARACTERISTIC InjVCD_nClsEng_C "Virtuelle Motordrehzahl während der Piezoaktor Klassifizierung im Steuergerätenachlauf" VALUE 0xEA304 Kw_Ws16 5000.000 EngN 0.00 5000.000 FORMAT "%8.3" EXTENDED_LIMITS -32768.00 32767.00 /end CHARACTERISTIC
/begin CHARACTERISTIC InjVCD_nEngMonShCir_C "Virtuelle Drehzahl für die Ansteuerung im Nachlauf für Kurzschlussunterscheidung" VALUE 0xEAA20 Kw_Ws16 5000.000 EngN 0.00 5000.000 FORMAT "%8.3" EXTENDED_LIMITS -32768.00 32767.00 /end CHARACTERISTIC
/begin CHARACTERISTIC InjVCD_nETMaxLim_C "Schwelle für max. Drehzahl Begrenzung Ansteuerdauer" VALUE 0xEA2FE Kw_Ws16 65535.00 EngN -32768.00 32767.00 FORMAT "%8.2" /end CHARACTERISTIC
/begin CHARACTERISTIC InjVCD_nLimBotEvMgmt_C "untere Drehzahlschranke zur Freigabe des Flankenmanagements" VALUE 0xC0634 Kw_Ws16 6000.000 EngN 0.00 6000.000 FORMAT "%8.3" EXTENDED_LIMITS -32768.00 32767.00 /end CHARACTERISTIC
/begin CHARACTERISTIC InjVCD_nLimTopEvMgmt_C "Obere Drehzahlschranke zur freigabe des Flankenmanagements" VALUE 0xC0636 Kw_Ws16 6000.000 EngN 0.00 6000.000 FORMAT "%8.3" EXTENDED_LIMITS -32768.00 32767.00 /end CHARACTERISTIC
/begin CHARACTERISTIC InjVCD_nMonShCirDel_C "Schwelle des Drehzahl für Verwerfen der Messungen für Low-Side Kurzschlusserkennung" VALUE 0xEA286 Kw_Ws16 5960.000 EngN 40.00000 6000.000 FORMAT "%8.3" EXTENDED_LIMITS -32768.00 32767.00 /end CHARACTERISTIC
/begin CHARACTERISTIC InjVCD_numBgnShrtDeb_C "Entprellwert, ab wievielen Verkürzungen die Kompensationsfunktion aktiv werden soll" VALUE 0xEA328 Kw_Wu16 65535.00 OneToOne 0.00 65535.00 FORMAT "%8.2" /end CHARACTERISTIC
/begin CHARACTERISTIC InjVCD_numCollTyp_C "Nummer des Kollisionstyps" VALUE 0xC0638 Kw_Wu8 10.00 OneToOne 0.00 10.00 FORMAT "%5.2" EXTENDED_LIMITS 0.00 255.0 /end CHARACTERISTIC
/begin CHARACTERISTIC InjVCD_numCylEMCompDispl_C "Anzeige der Messpunkte für die Zylindernummer" VALUE 0xEA32A Kw_Wu8 6.000 OneToOne 0.00 6.000 FORMAT "%5.3" EXTENDED_LIMITS 0.00 255.0 /end CHARACTERISTIC
/begin CHARACTERISTIC InjVCD_numCylTestBench_C "zu messender Zylinder im Einzylinder-Testbankbetrieb" VALUE 0xEA288 Kw_Wu8 255.0 OneToOne 0.00 255.0 FORMAT "%5.1" /end CHARACTERISTIC
/begin CHARACTERISTIC InjVCD_numFacWValidMin_C "Minimale Anzahl gültiger Werte von InjVCD_facWActrDvt_mp für die Freigabe des gemittelten Wertes InjVCD_facWActrDvt" VALUE 0xEA2B8 Kw_Ws16 100.0000 OneToOne 0.00 100.0000 FORMAT "%8.4" EXTENDED_LIMITS -32768.00 32767.00 /end CHARACTERISTIC
/begin CHARACTERISTIC InjVCD_numMonShCirDel_C "Anzahl der verwerfene Messungen für Low-Side Kurzschlusserkennung" VALUE 0xEA289 Kw_Wu8 255.0 OneToOne 0.00 255.0 FORMAT "%5.1" /end CHARACTERISTIC
/begin CHARACTERISTIC InjVCD_numPolar_C "Anzahl der Polarisierungen pro Piezo-Aktor" VALUE 0xEAA40 Kw_Wu8 10.00 OneToOne 0.00 10.00 FORMAT "%5.2" EXTENDED_LIMITS 0.00 255.0 /end CHARACTERISTIC
/begin CHARACTERISTIC InjVCD_numUBufCyclMin2_C "Min. Anz. Wartezykl. (MI-Interrupts) zw. 2 Bufferspannungsmess. wenn nur MI1 aktiv ist" VALUE 0xEA9F4 Kw_Wu8 255.0 OneToOne 0.00 255.0 FORMAT "%5.1" /end CHARACTERISTIC
/begin CHARACTERISTIC InjVCD_numUBufCyclMin_C "Min. Anz. Wartezykl. (MI-Interrupts) zw. 2 Bufferspannungsmess. bei mehr als 1 aktiven Einspritztyp" VALUE 0xEA9F5 Kw_Wu8 255.0 OneToOne 0.00 255.0 FORMAT "%5.1" /end CHARACTERISTIC
/begin CHARACTERISTIC InjVCD_numUBufTrigCall_C "Max. Anz. Versuche einen ADC-Trigger für die Bufferspannungsmessung auszulösen" VALUE 0xEA9F6 Kw_Wu8 255.0 OneToOne 0.00 255.0 FORMAT "%5.1" /end CHARACTERISTIC
/begin CHARACTERISTIC InjVCD_numUBufWaitStrt_C "Anz. Wartezyklen (MI-Interrupts) im Zustand START der Bufferspannungsmessung" VALUE 0xEA9F7 Kw_Wu8 255.0 OneToOne 0.00 255.0 FORMAT "%5.1" /end CHARACTERISTIC
/begin CHARACTERISTIC InjVCD_pClsRailMax_C "Maximal zulässiger Wert des Raildrucks während der Piezoaktor Klassifizierung im Steuergerätenachlauf" VALUE 0xEA306 Kw_Ws16 2000.000 Pres_Rail 0.00 2000.000 FORMAT "%5.3" EXTENDED_LIMITS -3276.800 3276.700 /end CHARACTERISTIC
/begin CHARACTERISTIC InjVCD_phiAccu_C "Durchgriff auf akkumulieten Sweep-Winkel (kein Durchgriff, wenn < -200)" VALUE 0xC062C Kw_Ws16 420.0000 AngleCrS -220.0078 199.9922 FORMAT "%8.4" EXTENDED_LIMITS -768.0000 767.9766 /end CHARACTERISTIC
/begin CHARACTERISTIC InjVCD_phiBckStp_C "Winkelschrittweite für Rücknahme des Verschiebewinkels" VALUE 0xC062E Kw_Ws16 10.00781 AngleCrS 0.00 10.00781 FORMAT "%8.5" EXTENDED_LIMITS -768.0000 767.9766 /end CHARACTERISTIC
/begin CHARACTERISTIC InjVCD_phiPoI1ShftLead_C "Vorhalt/Offset für Verschiebewinkelberechnung" VALUE 0xC0630 Kw_Ws16 39.98437 AngleCrS -19.99219 19.99219 FORMAT "%8.5" EXTENDED_LIMITS -768.0000 767.9766 /end CHARACTERISTIC
/begin CHARACTERISTIC InjVCD_phiPoI1Shft_C "Durchgriff auf Verschiebewinkel (kein Durchgriff, wenn < -200)" VALUE 0xC0632 Kw_Ws16 420.0000 AngleCrS -220.0078 199.9922 FORMAT "%8.4" EXTENDED_LIMITS -768.0000 767.9766 /end CHARACTERISTIC
/begin CHARACTERISTIC InjVCD_phiPoI1SweepMax_MAP "Obere (nahe OT) absolute Sweepbereich-Winkelgrenze" MAP 0xEA32C Kf_Xs16_Ys16_Ws16 60.00000 AngleCrS -100.0078 -40.00781 FORMAT "%8.4" EXTENDED_LIMITS -768.0000 767.9766
 /begin AXIS_DESCR STD_AXIS Eng_nAvrg EngN 8 0.00 6000.000 FORMAT "%8.3" EXTENDED_LIMITS -32768.00 32767.00 DEPOSIT ABSOLUTE /end AXIS_DESCR
 /begin AXIS_DESCR STD_AXIS InjCtl_qSetUnBal InjMassCyc 8 0.00 327.6700 FORMAT "%8.4" EXTENDED_LIMITS -327.6800 327.6700 DEPOSIT ABSOLUTE /end AXIS_DESCR
/end CHARACTERISTIC
/begin CHARACTERISTIC InjVCD_phiPoI1SweepMin_MAP "Untere (fern OT) absolute Sweepbereich-Winkelgrenze" MAP 0xEA3D0 Kf_Xs16_Ys16_Ws16 60.00000 AngleCrS -100.0078 -40.00781 FORMAT "%8.4" EXTENDED_LIMITS -768.0000 767.9766
 /begin AXIS_DESCR STD_AXIS Eng_nAvrg EngN 8 0.00 6000.000 FORMAT "%8.3" EXTENDED_LIMITS -32768.00 32767.00 DEPOSIT ABSOLUTE /end AXIS_DESCR
 /begin AXIS_DESCR STD_AXIS InjCtl_qSetUnBal InjMassCyc 8 0.00 327.6700 FORMAT "%8.4" EXTENDED_LIMITS -327.6800 327.6700 DEPOSIT ABSOLUTE /end AXIS_DESCR
/end CHARACTERISTIC
/begin CHARACTERISTIC InjVCD_pPolarMax_C "Maximal zulässiger Raildruck für Polarisierung" VALUE 0xEAA42 Kw_Ws16 2000.000 Pres_Rail 0.00 2000.000 FORMAT "%5.3" EXTENDED_LIMITS -3276.800 3276.700 /end CHARACTERISTIC
/begin CHARACTERISTIC InjVCD_pRailMonShCirMax_C "Maximale zulässiger Raildruck für die Ansteuerung im Nachlauf für Kurzschlussunterscheidung" VALUE 0xEAA22 Kw_Ws16 2000.000 Pres_Rail 0.00 2000.000 FORMAT "%5.3" EXTENDED_LIMITS -3276.800 3276.700 /end CHARACTERISTIC
/begin AXIS_PTS InjVCD_pRailZFCETCor_AXIS "gemeinsame Raildruck-Achse fuer ZFC Ansteuerdauerkorrektur-Kennfelder" 0xEAA78 RailCD_pAct_mp GSst_Xs16 600000.0 Pres_Rail 6 200000.0 800000.0 FORMAT "%8.1" EXTENDED_LIMITS -3276800. 3276700. DEPOSIT ABSOLUTE /end AXIS_PTS
/begin AXIS_PTS InjVCD_qZFCETCor_AXIS "Stuetzstellen der Menge fuer Korrekturfaktor-Gruppenkennfelder der Ansteuerdauerkorrektur der Nullmengenkalibrierung" 0xEAA86 InjVCD_qInZFCETGMap_mp GSst_Xs16 3.000000 InjMassInj 6 0.00 3.000000 FORMAT "%8.6" EXTENDED_LIMITS -327.6800 327.6700 DEPOSIT ABSOLUTE /end AXIS_PTS
/begin CHARACTERISTIC InjVCD_rClsVoltMin_C "Min. erlaubtes Verhältniss von (Aktorspannung-Beginn)/(Aktorspannung-Ende)" VALUE 0xEA308 Kw_Wu16 1.000000 Milli 1.000000 2.000000 FORMAT "%8.6" EXTENDED_LIMITS 0.00 65.53500 /end CHARACTERISTIC
/begin CHARACTERISTIC InjVCD_resCalcChrgShunt_C "Wert des Shunt-Widerstands zur Ladungsberechnung" VALUE 0xEA302 Kw_Ws16 0.00 Resist_mOhm 20.00000 20.00000 FORMAT "%8.5" EXTENDED_LIMITS -3276.800 3276.700 /end CHARACTERISTIC
/begin CHARACTERISTIC InjVCD_rMonShCirTiChrgUpTolc_C "Toleranzfenster für das Ladezeitverhältnis" VALUE 0xEAA24 Kw_Ws16 7.999878 Fact -4.000000 3.999878 FORMAT "%8.6" /end CHARACTERISTIC
/begin CHARACTERISTIC InjVCD_rZFCETDif0_GMAP "Gruppenkennfeld Bewertungsfaktor fuer Ansteuerdauerkorrektur durch Nullmengenkalibrierung am Raildruck-Kalibrierpunkt 0" MAP 0xEAA94 Gkf_Ws16 100.0000 Prc 0.00 100.0000 FORMAT "%8.4" EXTENDED_LIMITS -400.0000 399.9878
 /begin AXIS_DESCR COM_AXIS RailCD_pAct_mp Pres_Rail 6 200.0000 2000.0000 FORMAT "%5.4" EXTENDED_LIMITS -3276.8000 3276.7000 AXIS_PTS_REF InjVCD_pRailZFCETCor_AXIS /end AXIS_DESCR
 /begin AXIS_DESCR COM_AXIS InjVCD_qInZFCETGMap_mp InjMassInj 6 0.00 3.000000 FORMAT "%8.6" EXTENDED_LIMITS -327.6800 327.6700 AXIS_PTS_REF InjVCD_qZFCETCor_AXIS /end AXIS_DESCR
/end CHARACTERISTIC
/begin CHARACTERISTIC InjVCD_rZFCETDif1_GMAP "Gruppenkennfeld Bewertungsfaktor fuer Ansteuerdauerkorrektur durch Nullmengenkalibrierung am Raildruck-Kalibrierpunkt 1" MAP 0xEAADC Gkf_Ws16 100.0000 Prc 0.00 100.0000 FORMAT "%8.4" EXTENDED_LIMITS -400.0000 399.9878
 /begin AXIS_DESCR COM_AXIS RailCD_pAct_mp Pres_Rail 6 200.0000 2000.0000 FORMAT "%5.4" EXTENDED_LIMITS -3276.8000 3276.7000 AXIS_PTS_REF InjVCD_pRailZFCETCor_AXIS /end AXIS_DESCR
 /begin AXIS_DESCR COM_AXIS InjVCD_qInZFCETGMap_mp InjMassInj 6 0.00 3.000000 FORMAT "%8.6" EXTENDED_LIMITS -327.6800 327.6700 AXIS_PTS_REF InjVCD_qZFCETCor_AXIS /end AXIS_DESCR
/end CHARACTERISTIC
/begin CHARACTERISTIC InjVCD_rZFCETDif2_GMAP "Gruppenkennfeld Bewertungsfaktor fuer Ansteuerdauerkorrektur durch Nullmengenkalibrierung am Raildruck-Kalibrierpunkt 2" MAP 0xEAB24 Gkf_Ws16 100.0000 Prc 0.00 100.0000 FORMAT "%8.4" EXTENDED_LIMITS -400.0000 399.9878
 /begin AXIS_DESCR COM_AXIS RailCD_pAct_mp Pres_Rail 6 200.0000 2000.0000 FORMAT "%5.4" EXTENDED_LIMITS -3276.8000 3276.7000 AXIS_PTS_REF InjVCD_pRailZFCETCor_AXIS /end AXIS_DESCR
 /begin AXIS_DESCR COM_AXIS InjVCD_qInZFCETGMap_mp InjMassInj 6 0.00 3.000000 FORMAT "%8.6" EXTENDED_LIMITS -327.6800 327.6700 AXIS_PTS_REF InjVCD_qZFCETCor_AXIS /end AXIS_DESCR
/end CHARACTERISTIC
/begin CHARACTERISTIC InjVCD_rZFCETMsk_GMAP "Gruppenkennfeld Gesamtbewertungsfaktor der Ansteuerdauerkorrektur durch Nullmengenkalibrierung" MAP 0xEAB6C Gkf_Ws16 100.0000 Prc 0.00 100.0000 FORMAT "%8.4" EXTENDED_LIMITS -400.0000 399.9878
 /begin AXIS_DESCR COM_AXIS RailCD_pAct_mp Pres_Rail 6 200.0000 2000.0000 FORMAT "%5.4" EXTENDED_LIMITS -3276.8000 3276.7000 AXIS_PTS_REF InjVCD_pRailZFCETCor_AXIS /end AXIS_DESCR
 /begin AXIS_DESCR COM_AXIS InjVCD_qInZFCETGMap_mp InjMassInj 6 0.00 3.000000 FORMAT "%8.6" EXTENDED_LIMITS -327.6800 327.6700 AXIS_PTS_REF InjVCD_qZFCETCor_AXIS /end AXIS_DESCR
/end CHARACTERISTIC
/begin CHARACTERISTIC InjVCD_stCY370RcyDeb_C "Entprellzaehler fuer CY370 DriveTime-Fehler" VALUE 0xEA322 Kw_Wu8 255.0 OneToOne 0.00 255.0 FORMAT "%5.1" /end CHARACTERISTIC
/begin CHARACTERISTIC InjVCD_stCY370RcyTst_C "Testlabel zum Testen der Recoveries im InjVCD_CY370-Prozess" VALUE 0xEA323 Kw_Wu8 255.0 OneToOne 0.00 255.0 FORMAT "%5.1" /end CHARACTERISTIC
/begin CHARACTERISTIC InjVCD_stInputZFCETGMap_C "Auswahl der Menge fuer Anzeige der Gruppenkennfelder InjVCD_rZFCETDif0_GMAP, ...Dif1_GMAP, ...Msk_GMAP" VALUE 0xEABB4 Kw_Wu8 255.0 OneToOne 0.00 255.0 FORMAT "%5.1" /end CHARACTERISTIC
/begin CHARACTERISTIC InjVCD_stZFCETCorActv_C "Aktivierungsstatus der ZFC Ansteuerdauerkorrektur (0 = keine Korrektur)" VALUE 0xEABB5 Kw_Wu8 0.00 OneToOne 0.00 0.00 FORMAT "%5.2" EXTENDED_LIMITS 0.00 255.0 /end CHARACTERISTIC
/begin CHARACTERISTIC InjVCD_swtBuf2Tpu_C "Umschaltung Datentransferpuffer zur TPU während des statischen Interrupts" VALUE 0xC063A Kw_Ws16 1.000000 OneToOne 0.00 1.000000 FORMAT "%8.6" EXTENDED_LIMITS -32768.00 32767.00 /end CHARACTERISTIC
/begin CHARACTERISTIC InjVCD_swtBufClean_C "Enabled das Löschen blockierter Einspritzbuffereinträge" VALUE 0xC063C Kw_Ws16 1.000000 OneToOne 0.00 1.000000 FORMAT "%8.6" EXTENDED_LIMITS -32768.00 32767.00 /end CHARACTERISTIC
/begin CHARACTERISTIC InjVCD_swtEnaEMSweep_C "Aktivieren/Deaktivieren der Sweepfunktion (1/0)" VALUE 0xEA474 Kw_Wu8 1.000 OneToOne 0.00 1.000 FORMAT "%5.3" EXTENDED_LIMITS 0.00 255.0 /end CHARACTERISTIC
/begin CHARACTERISTIC InjVCD_swtEnaWActrCorr_C "Schalter für die Berücksichtigung des gemssenen aktorspezifischen Energieverbrauchs bei der Abschaltung von Einspritzungen" VALUE 0xEA2BA Kw_Wu8 1.000 OneToOne 0.00 1.000 FORMAT "%5.3" EXTENDED_LIMITS 0.00 255.0 /end CHARACTERISTIC
/begin CHARACTERISTIC InjVCD_swtEvMgmt_C "Freigabeschalter des Flankenmanagements" VALUE 0xC063E Kw_Ws16 1000.000 OneToOne 0.00 1000.000 FORMAT "%8.3" EXTENDED_LIMITS -32768.00 32767.00 /end CHARACTERISTIC
/begin CHARACTERISTIC InjVCD_swtInputETMAP_C "Auswahl der Eingangsgrössen zur Darstellung von InjVCD_tiET_MAP auf dem Applikationstool." VALUE 0xEA476 Kw_Wu8 15.00 OneToOne 0.00 15.00 FORMAT "%5.2" EXTENDED_LIMITS 0.00 255.0 /end CHARACTERISTIC
/begin CHARACTERISTIC InjVCD_swtOvrEval_C "beschreiben des Buffers abhängig vom  Abholzustand der OVR-daten: =1 Abhängigkeit aktiv; =0 inaktiv" VALUE 0xC0640 Kw_Ws16 1.000000 OneToOne 0.00 1.000000 FORMAT "%8.6" EXTENDED_LIMITS -32768.00 32767.00 /end CHARACTERISTIC
/begin CHARACTERISTIC InjVCD_swtOvrMonShCirDel_C "aktiviert einmalige Verzögerung der LowSide Kurzschluß-Diagnose nach Schub" VALUE 0xEA28A Kw_Wu8 1.000 OneToOne 0.00 1.000 FORMAT "%5.3" EXTENDED_LIMITS 0.00 255.0 /end CHARACTERISTIC
/begin CHARACTERISTIC InjVCD_swtSelTempVal_C "Schalterstellung zur Auswahl der Aktortemperatur" VALUE 0xEA2E8 Kw_Wu8 1.000 OneToOne 0.00 1.000 FORMAT "%5.3" EXTENDED_LIMITS 0.00 255.0 /end CHARACTERISTIC
/begin CHARACTERISTIC InjVCD_swtSelTempType_C "Schaltertyp für Aktortemperaturauswahl" VALUE 0xEA2E9 Kw_Wu8 1.000 OneToOne 1.000 2.000 FORMAT "%5.3" EXTENDED_LIMITS 0.00 255.0 /end CHARACTERISTIC
/begin CHARACTERISTIC InjVCD_swtShOffDCDCTst_C "Testschalter zum Test des Ladeschalterkurzschlusses" VALUE 0xEAA75 Kw_Wu8 255.0 OneToOne 0.00 255.0 FORMAT "%5.1" /end CHARACTERISTIC
/begin CHARACTERISTIC InjVCD_swtTiDyn_C "Berechnungsart für den dynamischen Vorhalt (0=konstant, 1=hypebolisch aus Drehzahl)" VALUE 0xC0644 Kw_Wu32 1.00000000000 OneToOne 0.00 1.00000000000 FORMAT "%13.11" EXTENDED_LIMITS 0.00 4294967295.00 /end CHARACTERISTIC
/begin CHARACTERISTIC InjVCD_swtUBufTSyncMode_C "Schalter für zeitsynchrone Bufferspannungsmessung" VALUE 0xEA9F8 Kw_Wu8 1.000 OneToOne 0.00 1.000 FORMAT "%5.3" EXTENDED_LIMITS 0.00 255.0 /end CHARACTERISTIC
/begin CHARACTERISTIC InjVCD_swtZFCCorOvrRunOn_C "Schalter zum Einschalten der ZFC-Korrektur bei aktiver Schubüberwachung (1= Korrektur auch bei aktiver Schubüberwachung)" VALUE 0xEABB6 Kw_Wu8 0.00 OneToOne 0.00 0.00 FORMAT "%5.2" EXTENDED_LIMITS 0.00 255.0 /end CHARACTERISTIC
/begin CHARACTERISTIC InjVCD_tActrDfl_C "Vorgabetemperatur der Piezo-Aktoren" VALUE 0xEA2EA Kw_Ws16 950.000 Temp_Cels -50.140 899.860 FORMAT "%8.3" EXTENDED_LIMITS -3549.940 3003.560 /end CHARACTERISTIC
/begin CHARACTERISTIC InjVCD_tActrEnrgDfl_C "Aktortemperatur-Ersatzwert für die Berechnung des nominalen Aktorenergieverbrauches" VALUE 0xEA2BC Kw_Ws16 950.000 Temp_Cels -50.140 899.860 FORMAT "%8.3" EXTENDED_LIMITS -3549.940 3003.560 /end CHARACTERISTIC
/begin CHARACTERISTIC InjVCD_tActr_CUR "Bestimmung der Aktortemperatur aus der Kühlwassertemperatur" CURVE 0xEA2EC Kl_Xs16_Ws16 250.0000 Temp_Cels -50.1400 199.8600 FORMAT "%8.4" EXTENDED_LIMITS -3549.940 3003.560
 /begin AXIS_DESCR STD_AXIS InjVCD_tActr_mp Temp_Cels 4 -50.140 899.860 FORMAT "%8.3" EXTENDED_LIMITS -3549.940 3003.560 DEPOSIT ABSOLUTE /end AXIS_DESCR
/end CHARACTERISTIC
/begin CHARACTERISTIC InjVCD_tiBegBeg_C "Additiver Vorhalt für Beginn-Beginn Kollision" VALUE 0xC0648 Kw_Wu32 5000.00000000 InjTime_us 0.00 5000.00000000 FORMAT "%13.8" EXTENDED_LIMITS 0.00 4294967295.00 /end CHARACTERISTIC
/begin CHARACTERISTIC InjVCD_tiChrgPolarPse_C "Ladestrom-Pausezeit für die Polarisierung" VALUE 0xEAA44 Kw_Ws16 400.0000 Time_Busy 0.00 400.0000 FORMAT "%8.4" EXTENDED_LIMITS -3276.800 3276.700 /end CHARACTERISTIC
/begin CHARACTERISTIC InjVCD_tiClsLead_C "Vorhaltezeit für die Ansteuerung des Piezoaktors während der Klassifizierung im Steuergerätenachlauf" VALUE 0xEA30A Kw_Wu16 5000.000 InjTime_us 0.00 5000.000 FORMAT "%8.3" EXTENDED_LIMITS 0.00 65535.00 /end CHARACTERISTIC
/begin CHARACTERISTIC InjVCD_tiClsMeasBeg_C "Aktorspannung am Beginn der Ansteuerung" VALUE 0xEA30C Kw_Wu16 5000.000 InjTime_us 0.00 5000.000 FORMAT "%8.3" EXTENDED_LIMITS 0.00 65535.00 /end CHARACTERISTIC
/begin CHARACTERISTIC InjVCD_tiClsMeasEnd_C "Aktorspannung am Ende der Ansteuerung" VALUE 0xEA30E Kw_Wu16 5000.000 InjTime_us 0.00 5000.000 FORMAT "%8.3" EXTENDED_LIMITS 0.00 65535.00 /end CHARACTERISTIC
/begin CHARACTERISTIC InjVCD_tiClsMeasure_C "Messzeit zwischen Begin- und Endspannung des Piezoaktors während der Klassifizierung im Steuergerätenachlauf" VALUE 0xEA310 Kw_Wu32 95000.0000000 InjTime_us 0.00 95000.0000000 FORMAT "%13.7" EXTENDED_LIMITS 0.00 4294967295.00 /end CHARACTERISTIC
/begin CHARACTERISTIC InjVCD_tiDebTPUErrDef_C "Zeitentprellung für Defekt-Erkennung der TPU-Fehler" VALUE 0xEAA70 Kw_Wu16 655350.0 Time_ms 0.00 655350.0 FORMAT "%8.1" /end CHARACTERISTIC
/begin CHARACTERISTIC InjVCD_tiDebTPUErrOK_C "Zeitentprellung für Heilung der TPU-Fehler" VALUE 0xEAA72 Kw_Wu16 655350.0 Time_ms 0.00 655350.0 FORMAT "%8.1" /end CHARACTERISTIC
/begin CHARACTERISTIC InjVCD_tiDisChPolarPse_C "Entladestrom-Pausezeit für die Polarisierung" VALUE 0xEAA46 Kw_Ws16 400.0000 Time_Busy 0.00 400.0000 FORMAT "%8.4" EXTENDED_LIMITS -3276.800 3276.700 /end CHARACTERISTIC
/begin CHARACTERISTIC InjVCD_tiETMax_C "Schwelle für maximal zulässige Ansteuerdauer bei Drehzahl >  InjVCD_nETMaxLim_C" VALUE 0xC0622 Kw_Ws16 65535.00 InjTime_us -32768.00 32767.00 FORMAT "%8.2" /end CHARACTERISTIC
/begin CHARACTERISTIC InjVCD_tiET_MAP "Kennfeld zur Umrechnung von Einspritzmengen in Ansteuerdauer. Gilt für alle Einspritzungen." MAP 0xEA478 Kf_Xs16_Ys16_Ws16 5000.000 InjTime_us 0.00 5000.000 FORMAT "%8.3" EXTENDED_LIMITS -32768.00 32767.00
 /begin AXIS_DESCR STD_AXIS InjVCD_pInET_mp Pres_Rail 16 0.00 2000.000 FORMAT "%5.3" EXTENDED_LIMITS -3276.800 3276.700 DEPOSIT ABSOLUTE /end AXIS_DESCR
 /begin AXIS_DESCR STD_AXIS InjVCD_volInET_mp InjQntInj 40 0.00 327.6700 FORMAT "%8.4" EXTENDED_LIMITS -327.6800 327.6700 DEPOSIT ABSOLUTE /end AXIS_DESCR
/end CHARACTERISTIC
/begin CHARACTERISTIC InjVCD_tiEvt_C "Ereignisdauer" VALUE 0xC064C Kw_Wu32 5000.00000000 InjTime_us 0.00 5000.00000000 FORMAT "%13.8" EXTENDED_LIMITS 0.00 4294967295.00 /end CHARACTERISTIC
/begin CHARACTERISTIC InjVCD_tiIntValid_C "Gültigkeitsdauer der Ladungswerte nach Integratorabgleich auf dem Endstufenbaustein" VALUE 0xEA28C Kw_Wu32 1800000.00000 Time_ms 0.00 1800000.00000 FORMAT "%13.5" EXTENDED_LIMITS 0.00 42949672950.0 /end CHARACTERISTIC
/begin CHARACTERISTIC InjVCD_tiLeadJit_C "Dynamischer Vorhalt" VALUE 0xC0650 Kw_Wu32 5000.00000000 InjTime_us 0.00 5000.00000000 FORMAT "%13.8" EXTENDED_LIMITS 0.00 4294967295.00 /end CHARACTERISTIC
/begin CHARACTERISTIC InjVCD_tiMI1ET_Vector "Bypass-Label, nicht editieren !" VALUE 0xC3986 Kw_Wu8 255.0 OneToOne 0.00 255.0 FORMAT "%5.1" /end CHARACTERISTIC
/begin CHARACTERISTIC InjVCD_tiMI1ET_Channel "Bypass-Label, nicht editieren !" VALUE 0xC3987 Kw_Wu8 255.0 OneToOne 0.00 255.0 FORMAT "%5.1" /end CHARACTERISTIC
/begin CHARACTERISTIC InjVCD_tiMi1ThresLo_C "Schwelle zur Prüfung des Meßzeitpunkts der Aktorspannung" VALUE 0xEAA14 Kw_Ws32 2147483647.00 InjTime_us 0.00 2147483647.00 FORMAT "%13.2" EXTENDED_LIMITS -2147483648.00 2147483647.00 /end CHARACTERISTIC
/begin CHARACTERISTIC InjVCD_tiMonET_C "Ansteuerdauer für Kurzschlussunterscheidung" VALUE 0xEAA26 Kw_Ws16 4850.000 InjTime_us 150.0000 5000.000 FORMAT "%8.3" EXTENDED_LIMITS -32768.00 32767.00 /end CHARACTERISTIC
/begin CHARACTERISTIC InjVCD_tiMonLead_C "Abstand zwischen Entlade- Ladezeit" VALUE 0xEAA28 Kw_Ws16 4850.000 InjTime_us 150.0000 5000.000 FORMAT "%8.3" EXTENDED_LIMITS -32768.00 32767.00 /end CHARACTERISTIC
/begin CHARACTERISTIC InjVCD_tiMonShCirPse_C "Pausezeit zwischen Laden und Entladen" VALUE 0xEAA2A Kw_Ws16 400.0000 Time_Busy 0.00 400.0000 FORMAT "%8.4" EXTENDED_LIMITS -3276.800 3276.700 /end CHARACTERISTIC
/begin CHARACTERISTIC InjVCD_tiMonThresHiPlaus_C "Maximalschwelle der Ladezeit" VALUE 0xEAA18 Kw_Ws16 3276.700 Time_Busy 0.00 3276.700 FORMAT "%8.3" EXTENDED_LIMITS -3276.800 3276.700 /end CHARACTERISTIC
/begin CHARACTERISTIC InjVCD_tiMonThresLoPlaus_C "Minimalschwelle für Ladezeit" VALUE 0xEAA1A Kw_Ws16 3276.700 Time_Busy 0.00 3276.700 FORMAT "%8.3" EXTENDED_LIMITS -3276.800 3276.700 /end CHARACTERISTIC
/begin CHARACTERISTIC InjVCD_tiPiI1ET_Vector "Bypass-Label, nicht editieren !" VALUE 0xC3988 Kw_Wu8 255.0 OneToOne 0.00 255.0 FORMAT "%5.1" /end CHARACTERISTIC
/begin CHARACTERISTIC InjVCD_tiPiI1ET_Channel "Bypass-Label, nicht editieren !" VALUE 0xC3989 Kw_Wu8 255.0 OneToOne 0.00 255.0 FORMAT "%5.1" /end CHARACTERISTIC
/begin CHARACTERISTIC InjVCD_tiPiI2ET_Vector "Bypass-Label, nicht editieren !" VALUE 0xC398A Kw_Wu8 255.0 OneToOne 0.00 255.0 FORMAT "%5.1" /end CHARACTERISTIC
/begin CHARACTERISTIC InjVCD_tiPiI2ET_Channel "Bypass-Label, nicht editieren !" VALUE 0xC398B Kw_Wu8 255.0 OneToOne 0.00 255.0 FORMAT "%5.1" /end CHARACTERISTIC
/begin CHARACTERISTIC InjVCD_tiPoI1ET_Vector "Bypass-Label, nicht editieren !" VALUE 0xC398C Kw_Wu8 255.0 OneToOne 0.00 255.0 FORMAT "%5.1" /end CHARACTERISTIC
/begin CHARACTERISTIC InjVCD_tiPoI1ET_Channel "Bypass-Label, nicht editieren !" VALUE 0xC398D Kw_Wu8 255.0 OneToOne 0.00 255.0 FORMAT "%5.1" /end CHARACTERISTIC
/begin CHARACTERISTIC InjVCD_tiPoI2ET_Vector "Bypass-Label, nicht editieren !" VALUE 0xC398E Kw_Wu8 255.0 OneToOne 0.00 255.0 FORMAT "%5.1" /end CHARACTERISTIC
/begin CHARACTERISTIC InjVCD_tiPoI2ET_Channel "Bypass-Label, nicht editieren !" VALUE 0xC398F Kw_Wu8 255.0 OneToOne 0.00 255.0 FORMAT "%5.1" /end CHARACTERISTIC
/begin CHARACTERISTIC InjVCD_tiPolarET_CUR "Ansteuerdauer der Polarisierung als Funktion der Kühlmitteltemperatur" CURVE 0xEAA48 Kl_Xs16_Ws16 7900.000 InjTime_us 0.00 7900.000 FORMAT "%8.3" EXTENDED_LIMITS -32768.00 32767.00
 /begin AXIS_DESCR STD_AXIS InjVCD_tPolar_mp Temp_Cels 4 -50.14000 199.8600 FORMAT "%8.4" EXTENDED_LIMITS -3549.940 3003.560 DEPOSIT ABSOLUTE /end AXIS_DESCR
/end CHARACTERISTIC
/begin CHARACTERISTIC InjVCD_tiPolarLead_C "Minimaler Abstand zwischen zwei Ansteuerungen (Polarisierung)" VALUE 0xEAA5A Kw_Ws16 5000.000 InjTime_us 0.00 5000.000 FORMAT "%8.3" EXTENDED_LIMITS -32768.00 32767.00 /end CHARACTERISTIC
/begin CHARACTERISTIC InjVCD_tiZFCETCorMax_C "maximale ZFC Ansteuerdauerkorrektur" VALUE 0xEABB8 Kw_Ws16 5300.0000 InjTime_us -300.0000 5000.0000 FORMAT "%8.4" EXTENDED_LIMITS -32768.00 32767.00 /end CHARACTERISTIC
/begin CHARACTERISTIC InjVCD_tiZFCETCorMin_C "minimale ZFC Ansteuerdauerkorrektur" VALUE 0xEABBA Kw_Ws16 5300.0000 InjTime_us -300.0000 5000.0000 FORMAT "%8.4" EXTENDED_LIMITS -32768.00 32767.00 /end CHARACTERISTIC
/begin CHARACTERISTIC InjVCD_tPolarMax_C "Maximal zulässige Temperatur für die Polarisierung" VALUE 0xEAA5C Kw_Ws16 250.0000 Temp_Cels -50.14000 199.8600 FORMAT "%8.4" EXTENDED_LIMITS -3549.940 3003.560 /end CHARACTERISTIC
/begin CHARACTERISTIC InjVCD_uBufCLoLim_C "Untergrenze der Pufferspannung des DC/DC-Wandlers im Normalzustand" VALUE 0xEA326 Kw_Ws16 45.00000 Volt_BUFC 215.0000 260.0000 FORMAT "%8.4" EXTENDED_LIMITS -327.6800 327.6700 /end CHARACTERISTIC
/begin CHARACTERISTIC InjVCD_uBufSRCMin_C "SRC-low-Wert der Buffer-Spannung" VALUE 0xEA9FA Kw_Ws16 5200.391 Volt 0.00 5200.391 FORMAT "%8.3" EXTENDED_LIMITS -160156.4 160151.5 /end CHARACTERISTIC
/begin CHARACTERISTIC InjVCD_uBufSRCMax_C "SRC-high-Wert der Buffer-Spannung" VALUE 0xEA9FC Kw_Ws16 5200.391 Volt 0.00 5200.391 FORMAT "%8.3" EXTENDED_LIMITS -160156.4 160151.5 /end CHARACTERISTIC
/begin CHARACTERISTIC InjVCD_uBufLin_CUR "Kennlinie zur Linearisierung der Bufferspannung" CURVE 0xEA9FE Kl_Xs16_Ws16 320.0000 Volt_BUFC 0.00 320.0000 FORMAT "%8.4" EXTENDED_LIMITS -327.6800 327.6700
 /begin AXIS_DESCR STD_AXIS InjVCD_uBufRawLast_mp Volt 2 0.00 5200.391 FORMAT "%8.3" EXTENDED_LIMITS -160156.4 160151.5 DEPOSIT ABSOLUTE /end AXIS_DESCR
/end CHARACTERISTIC
/begin CHARACTERISTIC InjVCD_uMonShCirUp_C "Ladespannung für Kurzschlussunterscheidung" VALUE 0xEAA2C Kw_Ws16 250.0000 Volt_PA 0.00 250.0000 FORMAT "%8.4" EXTENDED_LIMITS -327.6800 327.6700 /end CHARACTERISTIC
/begin CHARACTERISTIC InjVCD_uPolarUp_CUR "Aktor Up-Niveau der Polarisierung als Funktion der Kühlmitteltemperatur" CURVE 0xEAA5E Kl_Xs16_Ws16 500.0000 Volt_PA -250.0000 250.0000 FORMAT "%8.4" EXTENDED_LIMITS -327.6800 327.6700
 /begin AXIS_DESCR STD_AXIS InjVCD_tPolar_mp Temp_Cels 4 -50.14000 199.8600 FORMAT "%8.4" EXTENDED_LIMITS -3549.940 3003.560 DEPOSIT ABSOLUTE /end AXIS_DESCR
/end CHARACTERISTIC
/begin CHARACTERISTIC InjVCD_uShOffBufThres_C "Spannungsschwelle für Schutzsbschaltung des DC/DC-Wandlers bei Ladeschalterkurzschluss" VALUE 0xEAA76 Kw_Ws16 60.00000 Volt_PA 210.0000 270.0000 FORMAT "%8.4" EXTENDED_LIMITS -327.6800 327.6700 /end CHARACTERISTIC
/begin CHARACTERISTIC InjVCD_wActrChrgDfl_C "Defaultwert für die Ladeenergie" VALUE 0xEA2BE Kw_Ws16 100.0000 W_PA 0.00 100.0000 FORMAT "%8.4" EXTENDED_LIMITS -32768.00 32767.00 /end CHARACTERISTIC
/begin CHARACTERISTIC InjVCD_wActrDisChDfl_C "Defaultwert für die Entladeenergie des Piezo-Aktors" VALUE 0xEA2C0 Kw_Ws16 100.0000 W_PA 0.00 100.0000 FORMAT "%8.4" EXTENDED_LIMITS -32768.00 32767.00 /end CHARACTERISTIC
/begin CHARACTERISTIC InjVCD_wActrNom_CUR "Kennlinie für den injektorseitigen Energieverbrauch einer Piezo-Aktor-Ansteuerung" CURVE 0xEA2C2 Kl_Xs16_Ws16 100.0000 W_PA 0.00 100.0000 FORMAT "%8.4" EXTENDED_LIMITS -32768.00 32767.00
 /begin AXIS_DESCR STD_AXIS InjVCD_uSetThresActr_mp Volt_PA 8 -327.6800 327.6700 FORMAT "%8.4" DEPOSIT ABSOLUTE /end AXIS_DESCR
/end CHARACTERISTIC
/begin CHARACTERISTIC InjVCD_wActrPlausMax_C "Grenzwert über dem die bestimmten Energiewerte des Piezo-Aktors als unplausibel betrachtet werden." VALUE 0xEA2E4 Kw_Ws16 320.0000 W_PA 0.00 320.0000 FORMAT "%8.4" EXTENDED_LIMITS -32768.00 32767.00 /end CHARACTERISTIC
/begin CHARACTERISTIC InjVCD_wActrPlausMin_C "Grenzwert unter dem die bestimmten Energiewerte des Piezo-Aktors als unplausibel betrachtet werden." VALUE 0xEA2E6 Kw_Ws16 100.0000 W_PA 0.00 100.0000 FORMAT "%8.4" EXTENDED_LIMITS -32768.00 32767.00 /end CHARACTERISTIC
/begin CHARACTERISTIC InjVlv_ctMonQckThresLo_C "Zählerschwelle für Schnell-Erkennung der Kurzschlüsse nach Batterie und Masse bei niedrigen Motordrehzahlen" VALUE 0xEB15C Kw_Wu8 255.0 OneToOne 0.00 255.0 FORMAT "%5.1" /end CHARACTERISTIC
/begin CHARACTERISTIC InjVlv_ctMonQckThres_C "Zählerschwelle für Schnell-Erkennung der Kurzschlüsse nach Batterie und Masse" VALUE 0xEB15D Kw_Wu8 255.0 OneToOne 0.00 255.0 FORMAT "%5.1" /end CHARACTERISTIC
/begin CHARACTERISTIC InjVlv_DebBnkA0Def_C "Defektentprellung für A Bankfehlerpfade Bit 0" VALUE 0xEB15E Kw_Wu16 65535.00 OneToOne 0.00 65535.00 FORMAT "%8.2" /end CHARACTERISTIC
/begin CHARACTERISTIC InjVlv_DebBnkA0Ok_C "Heilungsentprellung für A Bankfehlerpfade Bit 0" VALUE 0xEB160 Kw_Wu16 65535.00 OneToOne 0.00 65535.00 FORMAT "%8.2" /end CHARACTERISTIC
/begin CHARACTERISTIC InjVlv_DebBnkA1Def_C "Defektentprellung für A Bankfehlerpfade Bit 1" VALUE 0xEB162 Kw_Wu16 65535.00 OneToOne 0.00 65535.00 FORMAT "%8.2" /end CHARACTERISTIC
/begin CHARACTERISTIC InjVlv_DebBnkA1Ok_C "Heilungsentprellung für A Bankfehlerpfade Bit 1" VALUE 0xEB164 Kw_Wu16 65535.00 OneToOne 0.00 65535.00 FORMAT "%8.2" /end CHARACTERISTIC
/begin CHARACTERISTIC InjVlv_DebBnkA2Def_C "Defektentprellung für A Bankfehlerpfade Bit 2" VALUE 0xEB166 Kw_Wu16 65535.00 OneToOne 0.00 65535.00 FORMAT "%8.2" /end CHARACTERISTIC
/begin CHARACTERISTIC InjVlv_DebBnkA2Ok_C "Heilungsentprellung für A Bankfehlerpfade Bit 2" VALUE 0xEB168 Kw_Wu16 65535.00 OneToOne 0.00 65535.00 FORMAT "%8.2" /end CHARACTERISTIC
/begin CHARACTERISTIC InjVlv_DebBnkA3Def_C "Defektentprellung für A Bankfehlerpfade Bit 3" VALUE 0xEB16A Kw_Wu16 65535.00 OneToOne 0.00 65535.00 FORMAT "%8.2" /end CHARACTERISTIC
/begin CHARACTERISTIC InjVlv_DebBnkA3Ok_C "Heilungsentprellung für A Bankfehlerpfade Bit 3" VALUE 0xEB16C Kw_Wu16 65535.00 OneToOne 0.00 65535.00 FORMAT "%8.2" /end CHARACTERISTIC
/begin CHARACTERISTIC InjVlv_DebBnkB0Def_C "Defektentprellung für B Bankfehlerpfade Bit 0" VALUE 0xEB16E Kw_Wu16 65535.00 OneToOne 0.00 65535.00 FORMAT "%8.2" /end CHARACTERISTIC
/begin CHARACTERISTIC InjVlv_DebBnkB0Ok_C "Heilungsentprellung für B Bankfehlerpfade Bit 0" VALUE 0xEB170 Kw_Wu16 65535.00 OneToOne 0.00 65535.00 FORMAT "%8.2" /end CHARACTERISTIC
/begin CHARACTERISTIC InjVlv_DebBnkB1Def_C "Defektentprellung für B Bankfehlerpfade Bit 1" VALUE 0xEB172 Kw_Wu16 65535.00 OneToOne 0.00 65535.00 FORMAT "%8.2" /end CHARACTERISTIC
/begin CHARACTERISTIC InjVlv_DebBnkB1Ok_C "Heilungsentprellung für B Bankfehlerpfade Bit 1" VALUE 0xEB174 Kw_Wu16 65535.00 OneToOne 0.00 65535.00 FORMAT "%8.2" /end CHARACTERISTIC
/begin CHARACTERISTIC InjVlv_DebBnkB2Def_C "Defektentprellung für B Bankfehlerpfade Bit 2" VALUE 0xEB176 Kw_Wu16 65535.00 OneToOne 0.00 65535.00 FORMAT "%8.2" /end CHARACTERISTIC
/begin CHARACTERISTIC InjVlv_DebBnkB2Ok_C "Heilungsentprellung für B Bankfehlerpfade Bit 2" VALUE 0xEB178 Kw_Wu16 65535.00 OneToOne 0.00 65535.00 FORMAT "%8.2" /end CHARACTERISTIC
/begin CHARACTERISTIC InjVlv_DebBnkB3Def_C "Defektentprellung für B Bankfehlerpfade Bit 3" VALUE 0xEB17A Kw_Wu16 65535.00 OneToOne 0.00 65535.00 FORMAT "%8.2" /end CHARACTERISTIC
/begin CHARACTERISTIC InjVlv_DebBnkB3Ok_C "Heilungsentprellung für B Bankfehlerpfade Bit 3" VALUE 0xEB17C Kw_Wu16 65535.00 OneToOne 0.00 65535.00 FORMAT "%8.2" /end CHARACTERISTIC
/begin CHARACTERISTIC InjVlv_DebChipA0Def_C "Defektentprellung für  A Bausteinfehlerpfade Bit 0" VALUE 0xEB17E Kw_Wu16 65535.00 OneToOne 0.00 65535.00 FORMAT "%8.2" /end CHARACTERISTIC
/begin CHARACTERISTIC InjVlv_DebChipA0Ok_C "Heilungsentprellung für  A Bausteinfehlerpfade Bit 0" VALUE 0xEB180 Kw_Wu16 65535.00 OneToOne 0.00 65535.00 FORMAT "%8.2" /end CHARACTERISTIC
/begin CHARACTERISTIC InjVlv_DebChipA1Def_C "Defektentprellung für  A Bausteinfehlerpfade Bit 1" VALUE 0xEB182 Kw_Wu16 65535.00 OneToOne 0.00 65535.00 FORMAT "%8.2" /end CHARACTERISTIC
/begin CHARACTERISTIC InjVlv_DebChipA1Ok_C "Heilungsentprellung für  A Bausteinfehlerpfade Bit 1" VALUE 0xEB184 Kw_Wu16 65535.00 OneToOne 0.00 65535.00 FORMAT "%8.2" /end CHARACTERISTIC
/begin CHARACTERISTIC InjVlv_DebChipA2Def_C "Defektentprellung für  A Bausteinfehlerpfade Bit 2" VALUE 0xEB186 Kw_Wu16 65535.00 OneToOne 0.00 65535.00 FORMAT "%8.2" /end CHARACTERISTIC
/begin CHARACTERISTIC InjVlv_DebChipA2Ok_C "Heilungsentprellung für  A Bausteinfehlerpfade Bit 2" VALUE 0xEB188 Kw_Wu16 65535.00 OneToOne 0.00 65535.00 FORMAT "%8.2" /end CHARACTERISTIC
/begin CHARACTERISTIC InjVlv_DebChipA3Def_C "Defektentprellung für  A Bausteinfehlerpfade Bit 3" VALUE 0xEB18A Kw_Wu16 65535.00 OneToOne 0.00 65535.00 FORMAT "%8.2" /end CHARACTERISTIC
/begin CHARACTERISTIC InjVlv_DebChipA3Ok_C "Heilungsentprellung für  A Bausteinfehlerpfade Bit 3" VALUE 0xEB18C Kw_Wu16 65535.00 OneToOne 0.00 65535.00 FORMAT "%8.2" /end CHARACTERISTIC
/begin CHARACTERISTIC InjVlv_DebChipB0Def_C "Defektentprellung für  B Bausteinfehlerpfade Bit 0" VALUE 0xEB18E Kw_Wu16 65535.00 OneToOne 0.00 65535.00 FORMAT "%8.2" /end CHARACTERISTIC
/begin CHARACTERISTIC InjVlv_DebChipB0Ok_C "Heilungsentprellung für  B Bausteinfehlerpfade Bit 0" VALUE 0xEB190 Kw_Wu16 65535.00 OneToOne 0.00 65535.00 FORMAT "%8.2" /end CHARACTERISTIC
/begin CHARACTERISTIC InjVlv_DebChipB1Def_C "Defektentprellung für  B Bausteinfehlerpfade Bit 1" VALUE 0xEB192 Kw_Wu16 65535.00 OneToOne 0.00 65535.00 FORMAT "%8.2" /end CHARACTERISTIC
/begin CHARACTERISTIC InjVlv_DebChipB1Ok_C "Heilungsentprellung für  B Bausteinfehlerpfade Bit 1" VALUE 0xEB194 Kw_Wu16 65535.00 OneToOne 0.00 65535.00 FORMAT "%8.2" /end CHARACTERISTIC
/begin CHARACTERISTIC InjVlv_DebChipB2Def_C "Defektentprellung für  B Bausteinfehlerpfade Bit 2" VALUE 0xEB196 Kw_Wu16 65535.00 OneToOne 0.00 65535.00 FORMAT "%8.2" /end CHARACTERISTIC
/begin CHARACTERISTIC InjVlv_DebChipB2Ok_C "Heilungsentprellung für  B Bausteinfehlerpfade Bit 2" VALUE 0xEB198 Kw_Wu16 65535.00 OneToOne 0.00 65535.00 FORMAT "%8.2" /end CHARACTERISTIC
/begin CHARACTERISTIC InjVlv_DebChipB3Def_C "Defektentprellung für  B Bausteinfehlerpfade Bit 3" VALUE 0xEB19A Kw_Wu16 65535.00 OneToOne 0.00 65535.00 FORMAT "%8.2" /end CHARACTERISTIC
/begin CHARACTERISTIC InjVlv_DebChipB3Ok_C "Heilungsentprellung für  B Bausteinfehlerpfade Bit 3" VALUE 0xEB19C Kw_Wu16 65535.00 OneToOne 0.00 65535.00 FORMAT "%8.2" /end CHARACTERISTIC
/begin CHARACTERISTIC InjVlv_DebCylA0Def_C "Defektentprellung für A Zylinderfehlerpfade Bit 0" VALUE 0xEB19E Kw_Wu16 65535.00 OneToOne 0.00 65535.00 FORMAT "%8.2" /end CHARACTERISTIC
/begin CHARACTERISTIC InjVlv_DebCylA0Ok_C "Heilungsentprellung für A Zylinderfehlerpfade Bit 0" VALUE 0xEB1A0 Kw_Wu16 65535.00 OneToOne 0.00 65535.00 FORMAT "%8.2" /end CHARACTERISTIC
/begin CHARACTERISTIC InjVlv_DebCylA1Def_C "Defektentprellung für A Zylinderfehlerpfade Bit 1" VALUE 0xEB1A2 Kw_Wu16 65535.00 OneToOne 0.00 65535.00 FORMAT "%8.2" /end CHARACTERISTIC
/begin CHARACTERISTIC InjVlv_DebCylA1Ok_C "Heilungsentprellung für A Zylinderfehlerpfade Bit 1" VALUE 0xEB1A4 Kw_Wu16 65535.00 OneToOne 0.00 65535.00 FORMAT "%8.2" /end CHARACTERISTIC
/begin CHARACTERISTIC InjVlv_DebCylA2Def_C "Defektentprellung für A Zylinderfehlerpfade Bit 2" VALUE 0xEB1A6 Kw_Wu16 65535.00 OneToOne 0.00 65535.00 FORMAT "%8.2" /end CHARACTERISTIC
/begin CHARACTERISTIC InjVlv_DebCylA2Ok_C "Heilungsentprellung für A Zylinderfehlerpfade Bit 2" VALUE 0xEB1A8 Kw_Wu16 65535.00 OneToOne 0.00 65535.00 FORMAT "%8.2" /end CHARACTERISTIC
/begin CHARACTERISTIC InjVlv_DebCylA3Def_C "Defektentprellung für A Zylinderfehlerpfade Bit 3" VALUE 0xEB1AA Kw_Wu16 65535.00 OneToOne 0.00 65535.00 FORMAT "%8.2" /end CHARACTERISTIC
/begin CHARACTERISTIC InjVlv_DebCylA3Ok_C "Heilungsentprellung für A Zylinderfehlerpfade Bit 3" VALUE 0xEB1AC Kw_Wu16 65535.00 OneToOne 0.00 65535.00 FORMAT "%8.2" /end CHARACTERISTIC
/begin CHARACTERISTIC InjVlv_DebCylB0Def_C "Defektentprellung für B Zylinderfehlerpfade Bit 0" VALUE 0xEB1AE Kw_Wu16 65535.00 OneToOne 0.00 65535.00 FORMAT "%8.2" /end CHARACTERISTIC
/begin CHARACTERISTIC InjVlv_DebCylB0Ok_C "Heilungsentprellung für B Zylinderfehlerpfade Bit 0" VALUE 0xEB1B0 Kw_Wu16 65535.00 OneToOne 0.00 65535.00 FORMAT "%8.2" /end CHARACTERISTIC
/begin CHARACTERISTIC InjVlv_DebCylB1Def_C "Defektentprellung für B Zylinderfehlerpfade Bit 1" VALUE 0xEB1B2 Kw_Wu16 65535.00 OneToOne 0.00 65535.00 FORMAT "%8.2" /end CHARACTERISTIC
/begin CHARACTERISTIC InjVlv_DebCylB1Ok_C "Heilungsentprellung für B Zylinderfehlerpfade Bit 1" VALUE 0xEB1B4 Kw_Wu16 65535.00 OneToOne 0.00 65535.00 FORMAT "%8.2" /end CHARACTERISTIC
/begin CHARACTERISTIC InjVlv_DebCylB2Def_C "Defektentprellung für B Zylinderfehlerpfade Bit 2" VALUE 0xEB1B6 Kw_Wu16 65535.00 OneToOne 0.00 65535.00 FORMAT "%8.2" /end CHARACTERISTIC
/begin CHARACTERISTIC InjVlv_DebCylB2Ok_C "Heilungsentprellung für B Zylinderfehlerpfade Bit 2" VALUE 0xEB1B8 Kw_Wu16 65535.00 OneToOne 0.00 65535.00 FORMAT "%8.2" /end CHARACTERISTIC
/begin CHARACTERISTIC InjVlv_DebCylB3Def_C "Defektentprellung für B Zylinderfehlerpfade Bit 3" VALUE 0xEB1BA Kw_Wu16 65535.00 OneToOne 0.00 65535.00 FORMAT "%8.2" /end CHARACTERISTIC
/begin CHARACTERISTIC InjVlv_DebCylB3Ok_C "Heilungsentprellung für B Zylinderfehlerpfade Bit 3" VALUE 0xEB1BC Kw_Wu16 65535.00 OneToOne 0.00 65535.00 FORMAT "%8.2" /end CHARACTERISTIC
/begin CHARACTERISTIC InjVlv_DebCylC0Def_C "Defekt-Entprellung von Bit 0 in C-Fehlerpfade der Zylinder" VALUE 0xEB1BE Kw_Wu16 65535.00 OneToOne 0.00 65535.00 FORMAT "%8.2" /end CHARACTERISTIC
/begin CHARACTERISTIC InjVlv_DebCylC0Ok_C "Heilungs-Entprellung von Bit 0 in C-Fehlerpfade der Zylinder" VALUE 0xEB1C0 Kw_Wu16 65535.00 OneToOne 0.00 65535.00 FORMAT "%8.2" /end CHARACTERISTIC
/begin CHARACTERISTIC InjVlv_DebCylC1Def_C "Defekt-Entprellung von Bit 1 in C-Fehlerpfade der Zylinder" VALUE 0xEB1C2 Kw_Wu16 65535.00 OneToOne 0.00 65535.00 FORMAT "%8.2" /end CHARACTERISTIC
/begin CHARACTERISTIC InjVlv_DebCylC1Ok_C "Heilungs-Entprellung von Bit 1 in C-Fehlerpfade der Zylinder" VALUE 0xEB1C4 Kw_Wu16 65535.00 OneToOne 0.00 65535.00 FORMAT "%8.2" /end CHARACTERISTIC
/begin CHARACTERISTIC InjVlv_DebCylC2Def_C "Defekt-Entprellung von Bit 2 in C-Fehlerpfade der Zylinder" VALUE 0xEB1C6 Kw_Wu16 65535.00 OneToOne 0.00 65535.00 FORMAT "%8.2" /end CHARACTERISTIC
/begin CHARACTERISTIC InjVlv_DebCylC2Ok_C "Heilungs-Entprellung von Bit 2 in C-Fehlerpfade der Zylinder" VALUE 0xEB1C8 Kw_Wu16 65535.00 OneToOne 0.00 65535.00 FORMAT "%8.2" /end CHARACTERISTIC
/begin CHARACTERISTIC InjVlv_DebCylC3Def_C "Defekt-Entprellung von Bit 3 in C-Fehlerpfade der Zylinder" VALUE 0xEB1CA Kw_Wu16 65535.00 OneToOne 0.00 65535.00 FORMAT "%8.2" /end CHARACTERISTIC
/begin CHARACTERISTIC InjVlv_DebCylC3Ok_C "Heilungs-Entprellung von Bit 3 in C-Fehlerpfade der Zylinder" VALUE 0xEB1CC Kw_Wu16 65535.00 OneToOne 0.00 65535.00 FORMAT "%8.2" /end CHARACTERISTIC
/begin CHARACTERISTIC InjVlv_DebNVCDef_C "Entprellparemeter für die Defekterkennung der NVC" VALUE 0xEB2D8 Kw_Wu16 65535.00 OneToOne 0.00 65535.00 FORMAT "%8.2" /end CHARACTERISTIC
/begin CHARACTERISTIC InjVlv_DebNVCOK_C "Entprellparameter für Heilung der NVC" VALUE 0xEB2DA Kw_Wu16 65535.00 OneToOne 0.00 65535.00 FORMAT "%8.2" /end CHARACTERISTIC
/begin CHARACTERISTIC InjVlv_facAddBalRls_MAP "Freigabekennfeld zur Aufrechnung der Mengenkorrektur" MAP 0xEABBC Kf_Xs16_Ys16_Ws16 1.000000 Fact 0.00 1.000000 FORMAT "%8.6" EXTENDED_LIMITS -4.000000 3.999878
 /begin AXIS_DESCR STD_AXIS RailCD_pPeak Pres_Rail 4 0.00 2000.000 FORMAT "%5.3" EXTENDED_LIMITS -3276.800 3276.700 DEPOSIT ABSOLUTE /end AXIS_DESCR
 /begin AXIS_DESCR STD_AXIS InjCtl_qSetUnBal InjMassCyc 4 0.00 327.6700 FORMAT "%8.4" EXTENDED_LIMITS -327.6800 327.6700 DEPOSIT ABSOLUTE /end AXIS_DESCR
/end CHARACTERISTIC
/begin CHARACTERISTIC InjVlv_facFTSWvCor_MAP "KF für die Berechnung des kraftstofftemperaturabhängigen Druckwellenkorrekturfaktors" MAP 0xEB6EA Kf_Xs16_Ys16_Ws16 2.000000 Fact 0.00 2.000000 FORMAT "%8.6" EXTENDED_LIMITS -4.000000 3.999878
 /begin AXIS_DESCR STD_AXIS RailCD_pPeak Pres_Rail 16 0.00 2000.000 FORMAT "%5.3" EXTENDED_LIMITS -3276.800 3276.700 DEPOSIT ABSOLUTE /end AXIS_DESCR
 /begin AXIS_DESCR STD_AXIS InjVlv_tWvCor_mp Temp_Cels 8 -50.1400 199.8600 FORMAT "%8.4" EXTENDED_LIMITS -3549.940 3003.560 DEPOSIT ABSOLUTE /end AXIS_DESCR
/end CHARACTERISTIC
/begin CHARACTERISTIC InjVlv_facNVCDflI_C "Defaultwert des NVC-Faktors" VALUE 0xEB2DC Kw_Ws16 1.000000 Fact -0.5000000 0.5000000 FORMAT "%9.7" EXTENDED_LIMITS -4.000000 3.999878 /end CHARACTERISTIC
/begin CHARACTERISTIC InjVlv_facNVCDfpMax_C "Oberer Grenzwert von InjVlv_facNVCActr[x] ab dem der Fehlerfpad der NVC gesetzt wird" VALUE 0xEB2DE Kw_Ws16 3.900024 Fact 0.00 3.900024 FORMAT "%8.6" EXTENDED_LIMITS -4.000000 3.999878 /end CHARACTERISTIC
/begin CHARACTERISTIC InjVlv_facNVCDfpMin_C "Unterer Grenzwert von InjVlv_facNVCActr[x] ab dem der Fehlerfpad der NVC gesetzt wird" VALUE 0xEB2E0 Kw_Ws16 3.900024 Fact 0.00 3.900024 FORMAT "%8.6" EXTENDED_LIMITS -4.000000 3.999878 /end CHARACTERISTIC
/begin CHARACTERISTIC InjVlv_facNVCInPI_C "Korrekturfaktor für den NVC-Reglereingang" VALUE 0xEB2E2 Kw_Ws16 2.000000 Fact -1.000000 1.000000 FORMAT "%8.6" EXTENDED_LIMITS -4.000000 3.999878 /end CHARACTERISTIC
/begin CHARACTERISTIC InjVlv_facNVCMax_C "Obere Grenze für den NVC-Reglerausgang" VALUE 0xEB2E4 Kw_Ws16 3.900024 Fact 0.00 3.900024 FORMAT "%8.6" EXTENDED_LIMITS -4.000000 3.999878 /end CHARACTERISTIC
/begin CHARACTERISTIC InjVlv_facNVCMin_C "Untere Grenze  für den NVC-Reglerausgang" VALUE 0xEB2E6 Kw_Ws16 3.900024 Fact 0.00 3.900024 FORMAT "%8.6" EXTENDED_LIMITS -4.000000 3.999878 /end CHARACTERISTIC
/begin CHARACTERISTIC InjVlv_facPCorQ_CUR "mengenabhängige Korrekturfaktor-Kennlinie für Druckwellenkorrektur" CURVE 0xEABF2 Kl_Xs16_Ws16 20.00000 Fact -10.00000 10.00000 FORMAT "%8.5" EXTENDED_LIMITS -4.000000 3.999878
 /begin AXIS_DESCR STD_AXIS InjVlv_qDes_mp InjMassInj 8 -327.6800 327.6700 FORMAT "%8.4" DEPOSIT ABSOLUTE /end AXIS_DESCR
/end CHARACTERISTIC
/begin CHARACTERISTIC InjVlv_facPCorTi_CUR "einspritzabstandsabhängige Korrekturfaktor-Kennlinie für Druckwellenkorrektur" CURVE 0xEAC14 Kl_Xs16_Ws16 20.00000 Fact -10.00000 10.00000 FORMAT "%8.5" EXTENDED_LIMITS -4.000000 3.999878
 /begin AXIS_DESCR STD_AXIS InjVlv_tiMI1PoI2Cor_mp InjTime_us 16 -32768.00 32767.00 FORMAT "%8.2" DEPOSIT ABSOLUTE /end AXIS_DESCR
/end CHARACTERISTIC
/begin CHARACTERISTIC InjVlv_facPiI2WvCor_C "Gewichtungsfaktor der Druckwellenkorrekturmenge der MI1 abhängig von PiI2" VALUE 0xEBAB6 Kw_Ws16 1.000000 Fact 0.00 1.000000 FORMAT "%8.6" EXTENDED_LIMITS -4.000000 3.999878 /end CHARACTERISTIC
/begin CHARACTERISTIC InjVlv_facVoltCorUp_MAP "temperaturabhängige Hubkorrektur für up-Niveau" MAP 0xEAC56 Kf_Xs16_Ys16_Ws16 7.999878 Fact -4.000000 3.999878 FORMAT "%8.6"
 /begin AXIS_DESCR STD_AXIS InjVlv_pCalcVolt Pres_Rail 16 -3276.800 3276.700 FORMAT "%5.3" DEPOSIT ABSOLUTE /end AXIS_DESCR
 /begin AXIS_DESCR STD_AXIS InjVlv_tActr_mp Temp_Cels 10 -50.140 899.860 FORMAT "%8.3" EXTENDED_LIMITS -3549.940 3003.560 DEPOSIT ABSOLUTE /end AXIS_DESCR
/end CHARACTERISTIC
/begin CHARACTERISTIC InjVlv_facWvCor1_MAP "KF 1 für Gewichtungsfaktor der Druckwellenkorrektur" MAP 0xEBAB8 Kf_Xs16_Ys16_Ws16 10.00000 Fact1 0.00 10.00000 FORMAT "%8.5" EXTENDED_LIMITS -256.0000 255.9922
 /begin AXIS_DESCR STD_AXIS InjCrv_qMI1Des InjMassInj 8 0.00 327.6700 FORMAT "%8.4" EXTENDED_LIMITS -327.6800 327.6700 DEPOSIT ABSOLUTE /end AXIS_DESCR
 /begin AXIS_DESCR STD_AXIS RailCD_pAct_mp Pres_Rail 16 0.00 2000.000 FORMAT "%5.3" EXTENDED_LIMITS -3276.800 3276.700 DEPOSIT ABSOLUTE /end AXIS_DESCR
/end CHARACTERISTIC
/begin CHARACTERISTIC InjVlv_facWvCor2_MAP "KF 2 für Gewichtungsfaktor der Druckwellenkorrektur" MAP 0xEBBEC Kf_Xs16_Ys16_Ws16 10.00000 Fact1 0.00 10.00000 FORMAT "%8.5" EXTENDED_LIMITS -256.0000 255.9922
 /begin AXIS_DESCR STD_AXIS InjCrv_qPoI2Des_mp InjMassInj 8 0.00 327.6700 FORMAT "%8.4" EXTENDED_LIMITS -327.6800 327.6700 DEPOSIT ABSOLUTE /end AXIS_DESCR
 /begin AXIS_DESCR STD_AXIS RailCD_pAct_mp Pres_Rail 16 0.00 2000.000 FORMAT "%5.3" EXTENDED_LIMITS -3276.800 3276.700 DEPOSIT ABSOLUTE /end AXIS_DESCR
/end CHARACTERISTIC
/begin CHARACTERISTIC InjVlv_iDCDC_CUR "DCDC Strom-Kennlinie" CURVE 0xEB134 Kl_Xs16_Ws16 11800.00 Curr 200.0000 12000.00 FORMAT "%8.2" EXTENDED_LIMITS -32768.00 32767.00
 /begin AXIS_DESCR STD_AXIS BattCD_u Volt_Batt 8 0.00 30009.78 FORMAT "%8.2" EXTENDED_LIMITS -640625.6 640606.1 DEPOSIT ABSOLUTE /end AXIS_DESCR
/end CHARACTERISTIC
/begin CHARACTERISTIC InjVlv_iMonDisChDwn_C "Schwelle des Entladestroms für Überwachung des bsh_err vom CY370" VALUE 0xEB1CE Kw_Ws16 30000.00 Curr -30000.00 0.00 FORMAT "%8.2" EXTENDED_LIMITS -32768.00 32767.00 /end CHARACTERISTIC
/begin CHARACTERISTIC InjVlv_NVCIKi_C "I-Parameter des Reglers, wenn der Eingang sich innerhalb des Kleinsignalfensters befindet" VALUE 0xEB2E8 Kw_Wu32 12207.0312472 Ki_VOLTPA2FACT 0.00 12207.0312472 FORMAT "%13.7" /end CHARACTERISTIC
/begin CHARACTERISTIC InjVlv_NVCIKiPos_C "I-Parameter des Reglers, wenn sich der Wert des Eingangs oberhalb der Kleinsignalfensters befindet" VALUE 0xEB2EC Kw_Wu32 12207.0312472 Ki_VOLTPA2FACT 0.00 12207.0312472 FORMAT "%13.7" /end CHARACTERISTIC
/begin CHARACTERISTIC InjVlv_NVCIKiNeg_C "I-Parameter der Reglers, wenn sich der Wert des Eingangs unterhalb des Kleinsignalfensters befindet" VALUE 0xEB2F0 Kw_Wu32 12207.0312472 Ki_VOLTPA2FACT 0.00 12207.0312472 FORMAT "%13.7" /end CHARACTERISTIC
/begin CHARACTERISTIC InjVlv_uNVCIWinPos_C "obere Grenze des Kleinsignalfensters für den I-Anteil" VALUE 0xEB2F4 Kw_Ws16 655.3500 Volt_PA -327.6800 327.6700 FORMAT "%8.4" /end CHARACTERISTIC
/begin CHARACTERISTIC InjVlv_uNVCIWinNeg_C "untere Grenze des Kleinsignalfensters für den I-Anteil" VALUE 0xEB2F6 Kw_Ws16 655.3500 Volt_PA -327.6800 327.6700 FORMAT "%8.4" /end CHARACTERISTIC
/begin CHARACTERISTIC InjVlv_nMonQckThresLo_C "Motordrehzahl-Schwelle zur Auswahl von InjVlv_ctMonQckThres_C bzw. InjVlv_ctMonQckThresLo_C für Schnellerkennung" VALUE 0xEB1D0 Kw_Ws16 65535.00 EngN -32768.00 32767.00 FORMAT "%8.2" /end CHARACTERISTIC
/begin CHARACTERISTIC InjVlv_numClsVltgAdjMax_C "Maximale Klasse für den Injektor Spannungsabgleich" VALUE 0xEB398 Kw_Wu8 31.00 OneToOne 0.00 31.00 FORMAT "%5.2" EXTENDED_LIMITS 0.00 255.0 /end CHARACTERISTIC
/begin CHARACTERISTIC InjVlv_numClsVltgAdjMin_C "Minimale Klasse für den Injektor Spannungsabgleich" VALUE 0xEB399 Kw_Wu8 31.00 OneToOne 0.00 31.00 FORMAT "%5.2" EXTENDED_LIMITS 0.00 255.0 /end CHARACTERISTIC
/begin CHARACTERISTIC InjVlv_numInjChrgBal_MAP "max. Anzahl an Einspritzungen aufgrund Ladungsbilanz Boosterkondensators" MAP 0xEAED2 Kf_Xs16_Ys16_Ws16 6.000000 OneToOne 0.00 6.000000 FORMAT "%8.6" EXTENDED_LIMITS -32768.00 32767.00
 /begin AXIS_DESCR STD_AXIS InjVlv_pwrInjAvrg_mp Pwr_PA 16 0.00 32000.00 FORMAT "%8.2" EXTENDED_LIMITS -32768.00 32767.00 DEPOSIT ABSOLUTE /end AXIS_DESCR
 /begin AXIS_DESCR STD_AXIS BattCD_u Volt_Batt 16 0.00 28602.15 FORMAT "%8.2" EXTENDED_LIMITS -640625.6 640606.1 DEPOSIT ABSOLUTE /end AXIS_DESCR
/end CHARACTERISTIC
/begin CHARACTERISTIC InjVlv_numNoLoadCylMax_C "maximale zulässige Anzahl von Zylindern mit Lastabfall" VALUE 0xEB1D2 Kw_Wu8 8.000 OneToOne 0.00 8.000 FORMAT "%5.3" EXTENDED_LIMITS 0.00 255.0 /end CHARACTERISTIC
/begin CHARACTERISTIC InjVlv_numSegOfs1_C "Semgentoffset für die Bestimmung der zylinderselektiven Drehzahlen für Testmodus a" VALUE 0xEB156 Kw_Wu8 11.00 OneToOne 0.00 11.00 FORMAT "%5.2" EXTENDED_LIMITS 0.00 255.0 /end CHARACTERISTIC
/begin CHARACTERISTIC InjVlv_numSegOfs2_C "Semgentoffset für die Bestimmung der zylinderselektiven Drehzahlen für Testmodus b und c" VALUE 0xEB157 Kw_Wu8 11.00 OneToOne 0.00 11.00 FORMAT "%5.2" EXTENDED_LIMITS 0.00 255.0 /end CHARACTERISTIC
/begin CHARACTERISTIC InjVlv_pCorBase_CUR "Raildruck-Korrekturgrundwert-Kennlinie für Druckwellenkorrektur" CURVE 0xEADCE Kl_Xs16_Ws16 2000.000 Pres_Rail 0.00 2000.000 FORMAT "%5.3" EXTENDED_LIMITS -3276.800 3276.700
 /begin AXIS_DESCR STD_AXIS InjVlv_pAct_mp Pres_Rail 6 -3276.800 3276.700 FORMAT "%5.3" DEPOSIT ABSOLUTE /end AXIS_DESCR
/end CHARACTERISTIC
/begin CHARACTERISTIC InjVlv_pMin_C "Injektorabhängige Druckschwelle zur Freigabe/Sperrung der Einspritzung" VALUE 0xEB374 Kw_Ws16 2000.000 Pres_Rail 0.00 2000.000 FORMAT "%5.3" EXTENDED_LIMITS -3276.800 3276.700 /end CHARACTERISTIC
/begin CHARACTERISTIC InjVlv_pMin_CUR "Kühlmitteltemperaturabhängige Druckschwelle zur Freigabe der Einspritzungen" CURVE 0xEB376 Kl_Xs16_Ws16 2000.000 Pres_Rail 0.00 2000.000 FORMAT "%5.3" EXTENDED_LIMITS -3276.800 3276.700
 /begin AXIS_DESCR STD_AXIS Eng_tEng Temp_Cels 8 -50.14000 199.8600 FORMAT "%8.4" EXTENDED_LIMITS -3549.940 3003.560 DEPOSIT ABSOLUTE /end AXIS_DESCR
/end CHARACTERISTIC
/begin CHARACTERISTIC InjVlv_pNVCMax_C "Obere Grenze des Raildrucks für die Freigabe der NVC" VALUE 0xEB2F8 Kw_Ws16 2000.000 Pres_Rail 0.00 2000.000 FORMAT "%5.3" EXTENDED_LIMITS -3276.800 3276.700 /end CHARACTERISTIC
/begin CHARACTERISTIC InjVlv_pNVCMin_C "untere Grenze des Raildrucks für die Freigabe der NVC" VALUE 0xEB2FA Kw_Ws16 2000.000 Pres_Rail 0.00 2000.000 FORMAT "%5.3" EXTENDED_LIMITS -3276.800 3276.700 /end CHARACTERISTIC
/begin CHARACTERISTIC InjVlv_pRailDfl_C "Raildruck-Ersatzwert für Sollspannungsberechnung" VALUE 0xEADE8 Kw_Ws16 6553.500 Pres_Rail -3276.800 3276.700 FORMAT "%5.3" /end CHARACTERISTIC
/begin CHARACTERISTIC InjVlv_NVCPKp_C "P-Parameter des Reglers, wenn sich der Wert des Eingangs innerhalb der Kleinsignalfensters befindet" VALUE 0xEB2FC Kw_Wu32 799.999999814 Kp_VOLTPA2FACT 0.00 799.999999814 FORMAT "%13.9" /end CHARACTERISTIC
/begin CHARACTERISTIC InjVlv_NVCPKpPos_C "P-Parameter des Reglers, wenn sich der Wert des Eingangs oberhalb des Kleinsignalfensters befindet" VALUE 0xEB300 Kw_Wu32 799.999999814 Kp_VOLTPA2FACT 0.00 799.999999814 FORMAT "%13.9" /end CHARACTERISTIC
/begin CHARACTERISTIC InjVlv_NVCPKpNeg_C "P-Parameter des Reglers, wenn sich der Wert des Eingangs unterhalb der Kleinsignalfensters befindet" VALUE 0xEB304 Kw_Wu32 799.999999814 Kp_VOLTPA2FACT 0.00 799.999999814 FORMAT "%13.9" /end CHARACTERISTIC
/begin CHARACTERISTIC InjVlv_uNVCPWinPos_C "obere Grenze des Kleinsignalfensters für den P-Anteil" VALUE 0xEB308 Kw_Ws16 655.3500 Volt_PA -327.6800 327.6700 FORMAT "%8.4" /end CHARACTERISTIC
/begin CHARACTERISTIC InjVlv_uNVCPWinNeg_C "untere Grenze der Kleinsignalfensters für den P-Anteil" VALUE 0xEB30A Kw_Ws16 655.3500 Volt_PA -327.6800 327.6700 FORMAT "%8.4" /end CHARACTERISTIC
/begin CHARACTERISTIC InjVlv_qWvCor1_MAP "Grundwerte-KF 1 der Druckwellenkorrekturmenge" MAP 0xEBD20 Kf_Xs16_Ys16_Ws16 655.3400 InjMassInj -327.6700 327.6700 FORMAT "%8.4" EXTENDED_LIMITS -327.6800 327.6700
 /begin AXIS_DESCR STD_AXIS InjVlv_tiPiI1MI1Cor_mp InjTime_us 32 0.00 13000.00 FORMAT "%8.2" EXTENDED_LIMITS -32768.00 32767.00 DEPOSIT ABSOLUTE /end AXIS_DESCR
 /begin AXIS_DESCR STD_AXIS InjCrv_qPiI1Des InjMassInj 16 0.00 327.6700 FORMAT "%8.4" EXTENDED_LIMITS -327.6800 327.6700 DEPOSIT ABSOLUTE /end AXIS_DESCR
/end CHARACTERISTIC
/begin CHARACTERISTIC InjVlv_qWvCor2_MAP "Grundwerte-KF 2 der Druckwellenkorrekturmenge" MAP 0xEC184 Kf_Xs16_Ys16_Ws16 655.3400 InjMassInj -327.6700 327.6700 FORMAT "%8.4" EXTENDED_LIMITS -327.6800 327.6700
 /begin AXIS_DESCR STD_AXIS InjVlv_tiMI1PoI2HydCor_mp InjTime_us 32 0.00 13000.00 FORMAT "%8.2" EXTENDED_LIMITS -32768.00 32767.00 DEPOSIT ABSOLUTE /end AXIS_DESCR
 /begin AXIS_DESCR STD_AXIS InjVlv_rMI1WvCorNorm_mp QntR 16 0.0009765625 24.00000 FORMAT "%8.5" EXTENDED_LIMITS -32.00000 31.99902 DEPOSIT ABSOLUTE /end AXIS_DESCR
/end CHARACTERISTIC
/begin CHARACTERISTIC InjVlv_qWvCorMax_C "maximale Begrenzungsmenge der Druckwellenkorrektur" VALUE 0xEC5E8 Kw_Ws16 20.00000 InjMassInj -10.00000 10.00000 FORMAT "%8.5" EXTENDED_LIMITS -327.6800 327.6700 /end CHARACTERISTIC
/begin CHARACTERISTIC InjVlv_qWvCorMin_C "minimale Begrenzungsmenge der Druckwellenkorrektur" VALUE 0xEC5EA Kw_Ws16 20.00000 InjMassInj -10.00000 10.00000 FORMAT "%8.5" EXTENDED_LIMITS -327.6800 327.6700 /end CHARACTERISTIC
/begin CHARACTERISTIC InjVlv_qWvCorNorm_CUR "Kennlinie für die raildruckabhängige Einspritznormierungsmenge" CURVE 0xEB81E Kl_Xs16_Ws16 327.6600 InjMassInj 0.01000000 327.6700 FORMAT "%8.4" EXTENDED_LIMITS -327.6800 327.6700
 /begin AXIS_DESCR STD_AXIS RailCD_pPeak Pres_Rail 20 0.00 2000.000 FORMAT "%5.3" EXTENDED_LIMITS -3276.800 3276.700 DEPOSIT ABSOLUTE /end AXIS_DESCR
/end CHARACTERISTIC
/begin CHARACTERISTIC InjVlv_rChrgBalPwrHys_C "Leistungs-Hystereseschwelle für max. Anzahl an Einspritzungen über Ladungsbilanz des Buffer-Kondensators" VALUE 0xEB116 Kw_Wu16 100.0000 Prc 0.00 100.0000 FORMAT "%8.4" EXTENDED_LIMITS 0.00 799.9878 /end CHARACTERISTIC
/begin CHARACTERISTIC InjVlv_rChrgBalVltgHys_C "Batteriespannungs Hystereseschwelle für Auswahl der max. Anzahl an Einspritzungen aufgrund Ladungsbilanz Boosterkondensators" VALUE 0xEB118 Kw_Wu16 100.0000 Prc 0.00 100.0000 FORMAT "%8.4" EXTENDED_LIMITS 0.00 799.9878 /end CHARACTERISTIC
/begin CHARACTERISTIC InjVlv_stErrDet_C "Status der Injektorfehlererkennung" VALUE 0xEB158 Kw_Wu8 1.000 OneToOne 0.00 1.000 FORMAT "%5.3" EXTENDED_LIMITS 0.00 255.0 /end CHARACTERISTIC
/begin CHARACTERISTIC InjVlv_stErrMskPattern_C "Pattern-Matrix zur Mustererkennung" VAL_BLK 0xEB1D4 Kwb_Wu32 4294967295.00 OneToOne 0.00 4294967295.00 FORMAT "%13.2" NUMBER 32 /end CHARACTERISTIC
/begin CHARACTERISTIC InjVlv_stErrMskSelect_C "Select-Matrix zur Mustererkennung" VAL_BLK 0xEB254 Kwb_Wu32 4294967295.00 OneToOne 0.00 4294967295.00 FORMAT "%13.2" NUMBER 32 /end CHARACTERISTIC
/begin CHARACTERISTIC InjVlv_stInputAddBalMap_C "y-Eingang des Kennfelds InjVCD_facAddBalRls_MAP auf dem Applikationswerkzeug" VALUE 0xEABF0 Kw_Wu8 255.0 OneToOne 0.00 255.0 FORMAT "%5.1" /end CHARACTERISTIC
/begin CHARACTERISTIC InjVlv_stMonQckEna_C "Schalter zur Freigabe der Schnell-Erkennung der Kurzschlüsse nach Batterie und Masse (0: gesperrt, 1: freigegeben)" VALUE 0xEB2D4 Kw_Wu8 1.000 OneToOne 0.00 1.000 FORMAT "%5.3" EXTENDED_LIMITS 0.00 255.0 /end CHARACTERISTIC
/begin CHARACTERISTIC InjVlv_stPWvCorMsk_C "Freigabemaske für Druckwellenkorrekur des Raildrucks" VALUE 0xEADEA Kw_Wu8 255.0 OneToOne 0.00 255.0 FORMAT "%5.1" /end CHARACTERISTIC
/begin CHARACTERISTIC InjVlv_stQntAdjRepl_C "Ersatzwerte für Injektormengenabgleich" VAL_BLK 0xEB460 Kwb_Wu32 4294967295.00 OneToOne 0.00 4294967295.00 FORMAT "%13.2" NUMBER 16 /end CHARACTERISTIC
/begin CHARACTERISTIC InjVlv_stQntAdj_MAP "Statuskennfeld (Index und Gewichtungsfaktor) für den Injektor-Mengenabgleich" MAP 0xEB39A Kf_Xs16_Ys16_Ws16 32767.00 OneToOne 0.00 32767.00 FORMAT "%8.2" EXTENDED_LIMITS -32768.00 32767.00
 /begin AXIS_DESCR STD_AXIS RailCD_pPeak Pres_Rail 7 0.00 2000.000 FORMAT "%5.3" EXTENDED_LIMITS -3276.800 3276.700 DEPOSIT ABSOLUTE /end AXIS_DESCR
 /begin AXIS_DESCR STD_AXIS InjUn_volMI1Cor_mp InjQntInj 7 0.00 100.0000 FORMAT "%8.4" EXTENDED_LIMITS -327.6800 327.6700 DEPOSIT ABSOLUTE /end AXIS_DESCR
/end CHARACTERISTIC
/begin CHARACTERISTIC InjVlv_stWvCorActv_C "Freigabe der Druckwellenkorrektur" VALUE 0xEB870 Kw_Wu8 1.000 OneToOne 0.00 1.000 FORMAT "%5.3" EXTENDED_LIMITS 0.00 255.0 /end CHARACTERISTIC
/begin CHARACTERISTIC InjVlv_swtAvrgEnaTiNVC_C "Aktivierung des Pfades InjVCD_stAvrgEnaTiWarn zur Freigabe des Lernens der NVC" VALUE 0xEB30C Kw_Wu8 255.0 OneToOne 0.00 255.0 FORMAT "%5.1" /end CHARACTERISTIC
/begin CHARACTERISTIC InjVlv_swtDiffHydInSel_C "Auswahl für Darstellung des Betriebspunktes im Kennfeld InjVlv_tiDiffHyd_MAP (1,2,3: Darstellung, sonst: keine Darstellung)" VALUE 0xEB4A4 Kw_Wu8 2.000 OneToOne 0.00 2.000 FORMAT "%5.3" EXTENDED_LIMITS 0.00 255.0 /end CHARACTERISTIC
/begin CHARACTERISTIC InjVlv_swtNVCStInjChar_C "Maske für die einspritztypabhängige Freigabe des Lernen der NVC" VALUE 0xEB30D Kw_Wu8 255.0 OneToOne 0.00 255.0 FORMAT "%5.1" /end CHARACTERISTIC
/begin CHARACTERISTIC InjVlv_swtNVCWrDflVal_C "Software-Schalter zum Setzen Defaultwerte für Testzwecke" VALUE 0xEB30E Kw_Wu8 1.000 OneToOne 0.00 1.000 FORMAT "%5.3" EXTENDED_LIMITS 0.00 255.0 /end CHARACTERISTIC
/begin CHARACTERISTIC InjVlv_swtQntAdj_C "Schalter zum Ersetzen der Mengenabgleichwerte (0...EEPROM, 1...Ersatzwerte)" VALUE 0xEB4A0 Kw_Wu8 1.000 OneToOne 0.00 1.000 FORMAT "%5.3" EXTENDED_LIMITS 0.00 255.0 /end CHARACTERISTIC
/begin CHARACTERISTIC InjVlv_tActrDfl_C "Ersatzwert Aktortemperatur für Sollwertspannungsberechnung" VALUE 0xEADEC Kw_Ws16 950.000 Temp_Cels -50.140 899.860 FORMAT "%8.3" EXTENDED_LIMITS -3549.940 3003.560 /end CHARACTERISTIC
/begin CHARACTERISTIC InjVlv_tiDiffHyd_MAP "Kennfeld mit Differenzzeiten zwischen hydraulischem Nadelschliessende und elektrischem Ansteuerende" MAP 0xEB4A6 Kf_Xs16_Ys16_Ws16 10000.00 InjTime_us -5000.000 5000.000 FORMAT "%8.3" EXTENDED_LIMITS -32768.00 32767.00
 /begin AXIS_DESCR STD_AXIS InjVlv_pActInDiffHyd_mp Pres_Rail 16 0.00 2000.000 FORMAT "%5.3" EXTENDED_LIMITS -3276.800 3276.700 DEPOSIT ABSOLUTE /end AXIS_DESCR
 /begin AXIS_DESCR STD_AXIS InjVlv_qDesInDiffHyd_mp InjMassInj 16 0.00 327.6700 FORMAT "%8.4" EXTENDED_LIMITS -327.6800 327.6700 DEPOSIT ABSOLUTE /end AXIS_DESCR
/end CHARACTERISTIC
/begin CHARACTERISTIC InjVlv_tiNVCDwnThres_C "Obere Grenze der Regelabweichung des Entladezeit-Reglers um die NVC freizugeben" VALUE 0xEB310 Kw_Ws16 50.00000 Time_Busy 0.00 50.00000 FORMAT "%8.5" EXTENDED_LIMITS -3276.800 3276.700 /end CHARACTERISTIC
/begin CHARACTERISTIC InjVlv_tiNVCUpThres_C "Obere Grenze der Regelabweichung des Ladezeitreglers, um die NVC freizugeben" VALUE 0xEB312 Kw_Ws16 50.00000 Time_Busy 0.00 50.00000 FORMAT "%8.5" EXTENDED_LIMITS -3276.800 3276.700 /end CHARACTERISTIC
/begin CHARACTERISTIC InjVlv_tiUSetStrtLck_C "Wartezeit für Sollspannungs-Umschaltung im Start" VALUE 0xEB314 Kw_Wu16 655350.0 Time_ms 0.00 655350.0 FORMAT "%8.1" /end CHARACTERISTIC
/begin CHARACTERISTIC InjVlv_tNVCEngMax_C "Obere Grenze der Motortemperatur zur Freigebe der NVC" VALUE 0xEB316 Kw_Ws16 250.0000 Temp_Cels -50.14000 199.8600 FORMAT "%8.4" EXTENDED_LIMITS -3549.940 3003.560 /end CHARACTERISTIC
/begin CHARACTERISTIC InjVlv_tNVCEngMin_C "untere Grenze der Motortemperatur zur Freigabe der NVC" VALUE 0xEB318 Kw_Ws16 250.0000 Temp_Cels -50.14000 199.8600 FORMAT "%8.4" EXTENDED_LIMITS -3549.940 3003.560 /end CHARACTERISTIC
/begin CHARACTERISTIC InjVlv_tWvCor_MAP "KF fuer die Eingangstemperatur der Druckwellenkorrektur" MAP 0xEB872 Kf_Xs16_Ys16_Ws16 250.0000 Temp_Cels -50.1400 199.8600 FORMAT "%8.4" EXTENDED_LIMITS -3549.940 3003.560
 /begin AXIS_DESCR STD_AXIS FTSCD_tFuel Temp_Cels 16 -50.14000 199.8600 FORMAT "%8.4" EXTENDED_LIMITS -3549.940 3003.560 DEPOSIT ABSOLUTE /end AXIS_DESCR
 /begin AXIS_DESCR STD_AXIS CTSCD_tClnt Temp_Cels 16 -50.14000 199.8600 FORMAT "%8.4" EXTENDED_LIMITS -3549.940 3003.560 DEPOSIT ABSOLUTE /end AXIS_DESCR
/end CHARACTERISTIC
/begin CHARACTERISTIC InjVlv_uBufCInjLimXLow2_C "Untere Hystereseschwelle für Bufferspannung" VALUE 0xEB11A Kw_Ws16 260.0000 Volt_BUFC 0.00 260.0000 FORMAT "%8.4" EXTENDED_LIMITS -327.6800 327.6700 /end CHARACTERISTIC
/begin CHARACTERISTIC InjVlv_uBufCInjLimXHigh2_C "Obere Hystereseschwelle für Bufferspannung" VALUE 0xEB11C Kw_Ws16 260.0000 Volt_BUFC 0.00 260.0000 FORMAT "%8.4" EXTENDED_LIMITS -327.6800 327.6700 /end CHARACTERISTIC
/begin CHARACTERISTIC InjVlv_stBufCInjLimYLow2_C "Konstante für Bufferspannung kleiner Hystereseschwelle" VALUE 0xEB11E Kw_Ws16 65535.00 OneToOne -32768.00 32767.00 FORMAT "%8.2" READ_ONLY /end CHARACTERISTIC
/begin CHARACTERISTIC InjVlv_stBufCInjLimYHigh2_C "Konstante für Bufferspannung größer Hystereseschwelle" VALUE 0xEB120 Kw_Ws16 65535.00 OneToOne -32768.00 32767.00 FORMAT "%8.2" READ_ONLY /end CHARACTERISTIC
/begin CHARACTERISTIC InjVlv_uBufCInjLimXLow_C "Untere Hystereseschwelle für Bufferspannung" VALUE 0xEB122 Kw_Ws16 260.0000 Volt_BUFC 0.00 260.0000 FORMAT "%8.4" EXTENDED_LIMITS -327.6800 327.6700 /end CHARACTERISTIC
/begin CHARACTERISTIC InjVlv_uBufCInjLimXHigh_C "Obere Hystereseschwelle für Bufferspannung" VALUE 0xEB124 Kw_Ws16 260.0000 Volt_BUFC 0.00 260.0000 FORMAT "%8.4" EXTENDED_LIMITS -327.6800 327.6700 /end CHARACTERISTIC
/begin CHARACTERISTIC InjVlv_stBufCInjLimYLow_C "Konstante für Bufferspannung kleiner Hystereseschwelle" VALUE 0xEB126 Kw_Ws16 65535.00 OneToOne -32768.00 32767.00 FORMAT "%8.2" READ_ONLY /end CHARACTERISTIC
/begin CHARACTERISTIC InjVlv_stBufCInjLimYHigh_C "Konstante für Bufferspannung größer Hystereseschwelle" VALUE 0xEB128 Kw_Ws16 65535.00 OneToOne -32768.00 32767.00 FORMAT "%8.2" READ_ONLY /end CHARACTERISTIC
/begin CHARACTERISTIC InjVlv_uDiffNVCSet_CUR "Kennlinie für die Spannungsdifferenz" CURVE 0xEB31A Kl_Xs16_Ws16 250.0000 Volt_PA 0.00 250.0000 FORMAT "%8.4" EXTENDED_LIMITS -327.6800 327.6700
 /begin AXIS_DESCR STD_AXIS InjVCD_pActInj Pres_Rail 20 -3276.800 3276.700 FORMAT "%5.3" DEPOSIT ABSOLUTE /end AXIS_DESCR
/end CHARACTERISTIC
/begin CHARACTERISTIC InjVlv_uMonBattThres_C "Schwelle zur Überwachung des DC_err von CY370" VALUE 0xEB2D6 Kw_Ws16 24007.82 Volt_Batt 0.00 24007.82 FORMAT "%8.2" EXTENDED_LIMITS -640625.6 640606.1 /end CHARACTERISTIC
/begin CHARACTERISTIC InjVlv_uNVCThres_C "Obere Grenze des Wertes des Spannungsreglereingangs für die Freigabe der NVC" VALUE 0xEB36C Kw_Ws16 50.00000 Volt_PA 0.00 50.00000 FORMAT "%8.5" EXTENDED_LIMITS -327.6800 327.6700 /end CHARACTERISTIC
/begin CHARACTERISTIC InjVlv_uOfs_C "Spannungsoffset" VALUE 0xEAED0 Kw_Ws16 15.00000 Volt_PA 0.00 15.00000 FORMAT "%8.5" EXTENDED_LIMITS -327.6800 327.6700 /end CHARACTERISTIC
/begin CHARACTERISTIC InjVlv_uSetBott_C "Vorgabewert für Piezo-Aktor bottom-level" VALUE 0xEADEE Kw_Ws16 250.0000 Volt_PA 0.00 250.0000 FORMAT "%8.4" EXTENDED_LIMITS -327.6800 327.6700 /end CHARACTERISTIC
/begin CHARACTERISTIC InjVlv_uSetUpNVCActrMax_C "obere Grenze der Stellspannung nach der NVC" VALUE 0xEB36E Kw_Ws16 250.0000 Volt_PA 0.00 250.0000 FORMAT "%8.4" EXTENDED_LIMITS -327.6800 327.6700 /end CHARACTERISTIC
/begin CHARACTERISTIC InjVlv_uSetUpNVCActrMin_C "untere Grenze der Stellspannung nach der NVC" VALUE 0xEB370 Kw_Ws16 250.0000 Volt_PA 0.00 250.0000 FORMAT "%8.4" EXTENDED_LIMITS -327.6800 327.6700 /end CHARACTERISTIC
/begin CHARACTERISTIC InjVlv_uSetUpPress0_CUR "Kennlinie zur raildruckabh. Sollspannungsbestimmung für ISA-Klasse 0" CURVE 0xEADF0 Kl_Xs16_Ws16 250.0000 Volt_PA 0.00 250.0000 FORMAT "%8.4" EXTENDED_LIMITS -327.6800 327.6700
 /begin AXIS_DESCR STD_AXIS InjVlv_pCalcVolt Pres_Rail 3 -3276.800 3276.700 FORMAT "%5.3" DEPOSIT ABSOLUTE /end AXIS_DESCR
/end CHARACTERISTIC
/begin CHARACTERISTIC InjVlv_uSetUpPress10_CUR "Kennlinie zur raildruckabh. Sollspannungsbestimmung für ISA-Klasse 10" CURVE 0xEADFE Kl_Xs16_Ws16 250.0000 Volt_PA 0.00 250.0000 FORMAT "%8.4" EXTENDED_LIMITS -327.6800 327.6700
 /begin AXIS_DESCR STD_AXIS InjVlv_pCalcVolt Pres_Rail 3 -3276.800 3276.700 FORMAT "%5.3" DEPOSIT ABSOLUTE /end AXIS_DESCR
/end CHARACTERISTIC
/begin CHARACTERISTIC InjVlv_uSetUpPress11_CUR "Kennlinie zur raildruckabh. Sollspannungsbestimmung für ISA-Klasse 11" CURVE 0xEAE0C Kl_Xs16_Ws16 250.0000 Volt_PA 0.00 250.0000 FORMAT "%8.4" EXTENDED_LIMITS -327.6800 327.6700
 /begin AXIS_DESCR STD_AXIS InjVlv_pCalcVolt Pres_Rail 3 -3276.800 3276.700 FORMAT "%5.3" DEPOSIT ABSOLUTE /end AXIS_DESCR
/end CHARACTERISTIC
/begin CHARACTERISTIC InjVlv_uSetUpPress12_CUR "Kennlinie zur raildruckabh. Sollspannungsbestimmung für ISA-Klasse 12" CURVE 0xEAE1A Kl_Xs16_Ws16 250.0000 Volt_PA 0.00 250.0000 FORMAT "%8.4" EXTENDED_LIMITS -327.6800 327.6700
 /begin AXIS_DESCR STD_AXIS InjVlv_pCalcVolt Pres_Rail 3 -3276.800 3276.700 FORMAT "%5.3" DEPOSIT ABSOLUTE /end AXIS_DESCR
/end CHARACTERISTIC
/begin CHARACTERISTIC InjVlv_uSetUpPress13_CUR "Kennlinie zur raildruckabh. Sollspannungsbestimmung für ISA-Klasse 13" CURVE 0xEAE28 Kl_Xs16_Ws16 250.0000 Volt_PA 0.00 250.0000 FORMAT "%8.4" EXTENDED_LIMITS -327.6800 327.6700
 /begin AXIS_DESCR STD_AXIS InjVlv_pCalcVolt Pres_Rail 3 -3276.800 3276.700 FORMAT "%5.3" DEPOSIT ABSOLUTE /end AXIS_DESCR
/end CHARACTERISTIC
/begin CHARACTERISTIC InjVlv_uSetUpPress14_CUR "Kennlinie zur raildruckabh. Sollspannungsbestimmung für ISA-Klasse 14" CURVE 0xEAE36 Kl_Xs16_Ws16 250.0000 Volt_PA 0.00 250.0000 FORMAT "%8.4" EXTENDED_LIMITS -327.6800 327.6700
 /begin AXIS_DESCR STD_AXIS InjVlv_pCalcVolt Pres_Rail 3 -3276.800 3276.700 FORMAT "%5.3" DEPOSIT ABSOLUTE /end AXIS_DESCR
/end CHARACTERISTIC
/begin CHARACTERISTIC InjVlv_uSetUpPress15_CUR "Kennlinie zur raildruckabh. Sollspannungsbestimmung für ISA-Klasse 15" CURVE 0xEAE44 Kl_Xs16_Ws16 250.0000 Volt_PA 0.00 250.0000 FORMAT "%8.4" EXTENDED_LIMITS -327.6800 327.6700
 /begin AXIS_DESCR STD_AXIS InjVlv_pCalcVolt Pres_Rail 3 -3276.800 3276.700 FORMAT "%5.3" DEPOSIT ABSOLUTE /end AXIS_DESCR
/end CHARACTERISTIC
/begin CHARACTERISTIC InjVlv_uSetUpPress1_CUR "Kennlinie zur raildruckabh. Sollspannungsbestimmung für ISA-Klasse 1" CURVE 0xEAE52 Kl_Xs16_Ws16 250.0000 Volt_PA 0.00 250.0000 FORMAT "%8.4" EXTENDED_LIMITS -327.6800 327.6700
 /begin AXIS_DESCR STD_AXIS InjVlv_pCalcVolt Pres_Rail 3 -3276.800 3276.700 FORMAT "%5.3" DEPOSIT ABSOLUTE /end AXIS_DESCR
/end CHARACTERISTIC
/begin CHARACTERISTIC InjVlv_uSetUpPress2_CUR "Kennlinie zur raildruckabh. Sollspannungsbestimmung für ISA-Klasse 2" CURVE 0xEAE60 Kl_Xs16_Ws16 250.0000 Volt_PA 0.00 250.0000 FORMAT "%8.4" EXTENDED_LIMITS -327.6800 327.6700
 /begin AXIS_DESCR STD_AXIS InjVlv_pCalcVolt Pres_Rail 3 -3276.800 3276.700 FORMAT "%5.3" DEPOSIT ABSOLUTE /end AXIS_DESCR
/end CHARACTERISTIC
/begin CHARACTERISTIC InjVlv_uSetUpPress3_CUR "Kennlinie zur raildruckabh. Sollspannungsbestimmung für ISA-Klasse 3" CURVE 0xEAE6E Kl_Xs16_Ws16 250.0000 Volt_PA 0.00 250.0000 FORMAT "%8.4" EXTENDED_LIMITS -327.6800 327.6700
 /begin AXIS_DESCR STD_AXIS InjVlv_pCalcVolt Pres_Rail 3 -3276.800 3276.700 FORMAT "%5.3" DEPOSIT ABSOLUTE /end AXIS_DESCR
/end CHARACTERISTIC
/begin CHARACTERISTIC InjVlv_uSetUpPress4_CUR "Kennlinie zur raildruckabh. Sollspannungsbestimmung für ISA-Klasse 4" CURVE 0xEAE7C Kl_Xs16_Ws16 250.0000 Volt_PA 0.00 250.0000 FORMAT "%8.4" EXTENDED_LIMITS -327.6800 327.6700
 /begin AXIS_DESCR STD_AXIS InjVlv_pCalcVolt Pres_Rail 3 -3276.800 3276.700 FORMAT "%5.3" DEPOSIT ABSOLUTE /end AXIS_DESCR
/end CHARACTERISTIC
/begin CHARACTERISTIC InjVlv_uSetUpPress5_CUR "Kennlinie zur raildruckabh. Sollspannungsbestimmung für ISA-Klasse 5" CURVE 0xEAE8A Kl_Xs16_Ws16 250.0000 Volt_PA 0.00 250.0000 FORMAT "%8.4" EXTENDED_LIMITS -327.6800 327.6700
 /begin AXIS_DESCR STD_AXIS InjVlv_pCalcVolt Pres_Rail 3 -3276.800 3276.700 FORMAT "%5.3" DEPOSIT ABSOLUTE /end AXIS_DESCR
/end CHARACTERISTIC
/begin CHARACTERISTIC InjVlv_uSetUpPress6_CUR "Kennlinie zur raildruckabh. Sollspannungsbestimmung für ISA-Klasse 6" CURVE 0xEAE98 Kl_Xs16_Ws16 250.0000 Volt_PA 0.00 250.0000 FORMAT "%8.4" EXTENDED_LIMITS -327.6800 327.6700
 /begin AXIS_DESCR STD_AXIS InjVlv_pCalcVolt Pres_Rail 3 -3276.800 3276.700 FORMAT "%5.3" DEPOSIT ABSOLUTE /end AXIS_DESCR
/end CHARACTERISTIC
/begin CHARACTERISTIC InjVlv_uSetUpPress7_CUR "Kennlinie zur raildruckabh. Sollspannungsbestimmung für ISA-Klasse 7" CURVE 0xEAEA6 Kl_Xs16_Ws16 250.0000 Volt_PA 0.00 250.0000 FORMAT "%8.4" EXTENDED_LIMITS -327.6800 327.6700
 /begin AXIS_DESCR STD_AXIS InjVlv_pCalcVolt Pres_Rail 3 -3276.800 3276.700 FORMAT "%5.3" DEPOSIT ABSOLUTE /end AXIS_DESCR
/end CHARACTERISTIC
/begin CHARACTERISTIC InjVlv_uSetUpPress8_CUR "Kennlinie zur raildruckabh. Sollspannungsbestimmung für ISA-Klasse 8" CURVE 0xEAEB4 Kl_Xs16_Ws16 250.0000 Volt_PA 0.00 250.0000 FORMAT "%8.4" EXTENDED_LIMITS -327.6800 327.6700
 /begin AXIS_DESCR STD_AXIS InjVlv_pCalcVolt Pres_Rail 3 -3276.800 3276.700 FORMAT "%5.3" DEPOSIT ABSOLUTE /end AXIS_DESCR
/end CHARACTERISTIC
/begin CHARACTERISTIC InjVlv_uSetUpPress9_CUR "Kennlinie zur raildruckabh. Sollspannungsbestimmung für ISA-Klasse 9" CURVE 0xEAEC2 Kl_Xs16_Ws16 250.0000 Volt_PA 0.00 250.0000 FORMAT "%8.4" EXTENDED_LIMITS -327.6800 327.6700
 /begin AXIS_DESCR STD_AXIS InjVlv_pCalcVolt Pres_Rail 3 -3276.800 3276.700 FORMAT "%5.3" DEPOSIT ABSOLUTE /end AXIS_DESCR
/end CHARACTERISTIC
/begin CHARACTERISTIC InjVlv_uSetUpStrt_C "Spannungssollwert für Motorstart" VALUE 0xEB372 Kw_Ws16 250.0000 Volt_PA 0.00 250.0000 FORMAT "%8.4" EXTENDED_LIMITS -327.6800 327.6700 /end CHARACTERISTIC
/begin CHARACTERISTIC InjVlv_volQntAdjLim_C "symmetrische Begrenzung des Mengen-Abgleichwertes" VALUE 0xEB41C Kw_Ws16 128.0000 InjQntInj 0.00 128.0000 FORMAT "%8.4" EXTENDED_LIMITS -327.6800 327.6700 /end CHARACTERISTIC
/begin CHARACTERISTIC InjVlv_volQntAdjMax0_C "obere Grenzwerte der Mengen-Abgleichwerte für die ""0""-Quantisierungsschrittweite (0d=00b)" VAL_BLK 0xEB41E Kwb_Ws16 6.300000 InjQntInj 0.00 6.300000 FORMAT "%8.6" EXTENDED_LIMITS -327.6800 327.6700 NUMBER 4 /end CHARACTERISTIC
/begin CHARACTERISTIC InjVlv_volQntAdjMax1_C "obere Grenzwerte der Mengen-Abgleichwerte für die ""1""-Quantisierungsschrittweite (1d=01b)" VAL_BLK 0xEB426 Kwb_Ws16 9.450000 InjQntInj 0.00 9.450000 FORMAT "%8.6" EXTENDED_LIMITS -327.6800 327.6700 NUMBER 4 /end CHARACTERISTIC
/begin CHARACTERISTIC InjVlv_volQntAdjMax2_C "obere Grenzwerte der Mengen-Abgleichwerte für die ""2""-Quantisierungsschrittweite (2d=10b)" VAL_BLK 0xEB42E Kwb_Ws16 15.75000 InjQntInj 0.00 15.75000 FORMAT "%8.5" EXTENDED_LIMITS -327.6800 327.6700 NUMBER 4 /end CHARACTERISTIC
/begin CHARACTERISTIC InjVlv_volQntAdjMax3_C "obere Grenzwerte der Mengen-Abgleichwerte für die ""3""-Quantisierungsschrittweite (3d=11b)" VAL_BLK 0xEB436 Kwb_Ws16 31.50000 InjQntInj 0.00 31.50000 FORMAT "%8.5" EXTENDED_LIMITS -327.6800 327.6700 NUMBER 4 /end CHARACTERISTIC
/begin CHARACTERISTIC InjVlv_volQntAdjMin0_C "untere Grenzwerte der Mengen-Abgleichwerte für die ""0""-Quantisierungsschrittweite (0d=00b)" VAL_BLK 0xEB43E Kwb_Ws16 6.400000 InjQntInj -6.400000 0.00 FORMAT "%8.6" EXTENDED_LIMITS -327.6800 327.6700 NUMBER 4 /end CHARACTERISTIC
/begin CHARACTERISTIC InjVlv_volQntAdjMin1_C "untere Grenzwerte der Mengen-Abgleichwerte für die ""1""-Quantisierungsschrittweite (1d=01b)" VAL_BLK 0xEB446 Kwb_Ws16 9.600000 InjQntInj -9.600000 0.00 FORMAT "%8.6" EXTENDED_LIMITS -327.6800 327.6700 NUMBER 4 /end CHARACTERISTIC
/begin CHARACTERISTIC InjVlv_volQntAdjMin2_C "untere Grenzwerte der Mengen-Abgleichwerte für die ""2""-Quantisierungsschrittweite (2d=10b)" VAL_BLK 0xEB44E Kwb_Ws16 16.00000 InjQntInj -16.00000 0.00 FORMAT "%8.5" EXTENDED_LIMITS -327.6800 327.6700 NUMBER 4 /end CHARACTERISTIC
/begin CHARACTERISTIC InjVlv_volQntAdjMin3_C "untere Grenzwerte der Mengen-Abgleichwerte für die ""3""-Quantisierungsschrittweite (3d=11b)" VAL_BLK 0xEB456 Kwb_Ws16 32.00000 InjQntInj -32.00000 0.00 FORMAT "%8.5" EXTENDED_LIMITS -327.6800 327.6700 NUMBER 4 /end CHARACTERISTIC
/begin CHARACTERISTIC InjVlv_wInj_CUR "Kennlinie für Energieverbrauch einer Piezo-Aktor-Ansteuerung" CURVE 0xEB12A Kl_Xs16_Ws16 100.0000 W_PA 0.00 100.0000 FORMAT "%8.4" EXTENDED_LIMITS -32768.00 32767.00
 /begin AXIS_DESCR STD_AXIS InjVlv_uSetUpAvrg_mp Volt_PA 2 -327.6800 327.6700 FORMAT "%8.4" DEPOSIT ABSOLUTE /end AXIS_DESCR
/end CHARACTERISTIC
/begin CHARACTERISTIC IVCtl_ChrgUpIKi_C "Kleinsignalverstärkung für I-Glied (Laden)" VALUE 0xEC5EC Kw_Wu32 9999999.99767 Ki_us2mA 0.00 9999999.99767 FORMAT "%13.5" /end CHARACTERISTIC
/begin CHARACTERISTIC IVCtl_ChrgUpIKiPos_C "Positive Großsignalverstärkung für I-Glied (Laden)" VALUE 0xEC5F0 Kw_Wu32 9999999.99767 Ki_us2mA 0.00 9999999.99767 FORMAT "%13.5" /end CHARACTERISTIC
/begin CHARACTERISTIC IVCtl_ChrgUpIKiNeg_C "Negative Großsignalverstärkung für I-Glied (Laden)" VALUE 0xEC5F4 Kw_Wu32 9999999.99767 Ki_us2mA 0.00 9999999.99767 FORMAT "%13.5" /end CHARACTERISTIC
/begin CHARACTERISTIC IVCtl_tiChrgUpIWinPos_C "Positives Kleinsignalfenster für I-Glied (Laden)" VALUE 0xEC5F8 Kw_Ws16 200.0000 Time_Busy -100.0000 100.0000 FORMAT "%8.4" EXTENDED_LIMITS -3276.800 3276.700 /end CHARACTERISTIC
/begin CHARACTERISTIC IVCtl_tiChrgUpIWinNeg_C "Negatives Kleinsignalfenster für I-Glied (Laden)" VALUE 0xEC5FA Kw_Ws16 200.0000 Time_Busy -100.0000 100.0000 FORMAT "%8.4" EXTENDED_LIMITS -3276.800 3276.700 /end CHARACTERISTIC
/begin CHARACTERISTIC IVCtl_ChrgUpPKp_C "Kleinsignalverstärkung für P-Glied (Laden)" VALUE 0xEC5FC Kw_Wu32 655359.999847 Kp_us2mA 0.00 655359.999847 FORMAT "%13.6" /end CHARACTERISTIC
/begin CHARACTERISTIC IVCtl_ChrgUpPKpPos_C "Positive Großsignalverstärkung für P-Glied (Laden)" VALUE 0xEC600 Kw_Wu32 655359.999847 Kp_us2mA 0.00 655359.999847 FORMAT "%13.6" /end CHARACTERISTIC
/begin CHARACTERISTIC IVCtl_ChrgUpPKpNeg_C "Negative Großsignalverstärkung für P-Glied (Laden)" VALUE 0xEC604 Kw_Wu32 655359.999847 Kp_us2mA 0.00 655359.999847 FORMAT "%13.6" /end CHARACTERISTIC
/begin CHARACTERISTIC IVCtl_tiChrgUpPWinPos_C "Positives Kleinsignalfenster für P-Glied (Laden)" VALUE 0xEC608 Kw_Ws16 200.0000 Time_Busy -100.0000 100.0000 FORMAT "%8.4" EXTENDED_LIMITS -3276.800 3276.700 /end CHARACTERISTIC
/begin CHARACTERISTIC IVCtl_tiChrgUpPWinNeg_C "Negatives Kleinsignalfenster für P-Glied (Laden)" VALUE 0xEC60A Kw_Ws16 200.0000 Time_Busy -100.0000 100.0000 FORMAT "%8.4" EXTENDED_LIMITS -3276.800 3276.700 /end CHARACTERISTIC
/begin CHARACTERISTIC IVCtl_DisChDwnIKi_C "Kleinsignalverstärkung für I-Glied (Entladen)" VALUE 0xEC60C Kw_Wu32 9999999.99767 Ki_us2mA 0.00 9999999.99767 FORMAT "%13.5" /end CHARACTERISTIC
/begin CHARACTERISTIC IVCtl_DisChDwnIKiPos_C "Positive Großsignalverstärkung für I-Glied (Entladen)" VALUE 0xEC610 Kw_Wu32 9999999.99767 Ki_us2mA 0.00 9999999.99767 FORMAT "%13.5" /end CHARACTERISTIC
/begin CHARACTERISTIC IVCtl_DisChDwnIKiNeg_C "Negative Großsignalverstärkung für I-Glied (Entladen)" VALUE 0xEC614 Kw_Wu32 9999999.99767 Ki_us2mA 0.00 9999999.99767 FORMAT "%13.5" /end CHARACTERISTIC
/begin CHARACTERISTIC IVCtl_tiDisChDwnIWinPos_C "Positives Kleinsignalfenster für I-Glied (Entladen)" VALUE 0xEC618 Kw_Ws16 200.0000 Time_Busy -100.0000 100.0000 FORMAT "%8.4" EXTENDED_LIMITS -3276.800 3276.700 /end CHARACTERISTIC
/begin CHARACTERISTIC IVCtl_tiDisChDwnIWinNeg_C "Negatives Kleinsignalfenster für I-Glied (Entladen)" VALUE 0xEC61A Kw_Ws16 200.0000 Time_Busy -100.0000 100.0000 FORMAT "%8.4" EXTENDED_LIMITS -3276.800 3276.700 /end CHARACTERISTIC
/begin CHARACTERISTIC IVCtl_DisChDwnPKp_C "Kleinsignalverstärkung für P-Glied (Entladen)" VALUE 0xEC61C Kw_Wu32 655359.999847 Kp_us2mA 0.00 655359.999847 FORMAT "%13.6" /end CHARACTERISTIC
/begin CHARACTERISTIC IVCtl_DisChDwnPKpPos_C "Positive Großsignalverstärkung für P-Glied (Entladen)" VALUE 0xEC620 Kw_Wu32 655359.999847 Kp_us2mA 0.00 655359.999847 FORMAT "%13.6" /end CHARACTERISTIC
/begin CHARACTERISTIC IVCtl_DisChDwnPKpNeg_C "Negative Großsignalverstärkung für P-Glied (Entladen)" VALUE 0xEC624 Kw_Wu32 655359.999847 Kp_us2mA 0.00 655359.999847 FORMAT "%13.6" /end CHARACTERISTIC
/begin CHARACTERISTIC IVCtl_tiDisChDwnPWinPos_C "Positives Kleinsignalfenster für P-Glied (Entladen)" VALUE 0xEC628 Kw_Ws16 200.0000 Time_Busy -100.0000 100.0000 FORMAT "%8.4" EXTENDED_LIMITS -3276.800 3276.700 /end CHARACTERISTIC
/begin CHARACTERISTIC IVCtl_tiDisChDwnPWinNeg_C "Negatives Kleinsignalfenster für P-Glied (Entladen)" VALUE 0xEC62A Kw_Ws16 200.0000 Time_Busy -100.0000 100.0000 FORMAT "%8.4" EXTENDED_LIMITS -3276.800 3276.700 /end CHARACTERISTIC
/begin CHARACTERISTIC IVCtl_iChrgUpCls_C "Vorgabewert für obere Stromgrenze (Klassifizierung)" VALUE 0xEC62C Kw_Ws16 30000.00 Curr 0.00 30000.00 FORMAT "%8.2" EXTENDED_LIMITS -32768.00 32767.00 /end CHARACTERISTIC
/begin CHARACTERISTIC IVCtl_iChrgUpGovMax_C "Maximaler Strom für Ausgang Ladezeitregler" VALUE 0xEC62E Kw_Ws16 6000.000 Curr -3000.000 3000.000 FORMAT "%8.3" EXTENDED_LIMITS -32768.00 32767.00 /end CHARACTERISTIC
/begin CHARACTERISTIC IVCtl_iChrgUpGovMin_C "Minimaler Strom für Ausgang Ladezeitregler" VALUE 0xEC630 Kw_Ws16 6000.000 Curr -3000.000 3000.000 FORMAT "%8.3" EXTENDED_LIMITS -32768.00 32767.00 /end CHARACTERISTIC
/begin CHARACTERISTIC IVCtl_iChrgUpInitI_C "Initialisierungswert für Ladezeitregler" VALUE 0xEC632 Kw_Ws16 6000.000 Curr -3000.000 3000.000 FORMAT "%8.3" EXTENDED_LIMITS -32768.00 32767.00 /end CHARACTERISTIC
/begin CHARACTERISTIC IVCtl_iChrgUpMax_C "Maximaler Ladestrom für Aktor" VALUE 0xEC634 Kw_Ws16 30000.00 Curr 0.00 30000.00 FORMAT "%8.2" EXTENDED_LIMITS -32768.00 32767.00 /end CHARACTERISTIC
/begin CHARACTERISTIC IVCtl_iChrgUpMin_C "Minimaler Ladestrom für Aktor" VALUE 0xEC636 Kw_Ws16 30000.00 Curr 0.00 30000.00 FORMAT "%8.2" EXTENDED_LIMITS -32768.00 32767.00 /end CHARACTERISTIC
/begin CHARACTERISTIC IVCtl_iChrgUp_MAP "Kennfeld zur spannungs- und raildruckabhängigen Sollwertvorgabe der Ladezeit" MAP 0xEC638 Kf_Xs16_Ys16_Ws16 30000.00 Curr 0.00 30000.00 FORMAT "%8.2" EXTENDED_LIMITS -32768.00 32767.00
 /begin AXIS_DESCR STD_AXIS IVCtl_uSetUpAvrg_mp Volt_PA 25 0.00 250.0000 FORMAT "%8.4" EXTENDED_LIMITS -327.6800 327.6700 DEPOSIT ABSOLUTE /end AXIS_DESCR
 /begin AXIS_DESCR STD_AXIS RailCD_pPeak Pres_Rail 2 -3276.800 3276.700 FORMAT "%5.3" DEPOSIT ABSOLUTE /end AXIS_DESCR
/end CHARACTERISTIC
/begin CHARACTERISTIC IVCtl_iDisChDwnCls_C "Vorgabewert für untere Stromgrenze (Klassifizierung)" VALUE 0xEC6D6 Kw_Ws16 30000.00 Curr -30000.00 0.00 FORMAT "%8.2" EXTENDED_LIMITS -32768.00 32767.00 /end CHARACTERISTIC
/begin CHARACTERISTIC IVCtl_iDisChDwnGovMax_C "Maximaler Strom für Ausgang Entladezeitregler" VALUE 0xEC6D8 Kw_Ws16 6000.000 Curr -3000.000 3000.000 FORMAT "%8.3" EXTENDED_LIMITS -32768.00 32767.00 /end CHARACTERISTIC
/begin CHARACTERISTIC IVCtl_iDisChDwnGovMin_C "Minimaler Strom für Ausgang Entladezeitregler" VALUE 0xEC6DA Kw_Ws16 6000.000 Curr -3000.000 3000.000 FORMAT "%8.3" EXTENDED_LIMITS -32768.00 32767.00 /end CHARACTERISTIC
/begin CHARACTERISTIC IVCtl_iDisChDwnInitI_C "Initialisierungswert für Entladezeitregler" VALUE 0xEC6DC Kw_Ws16 6000.000 Curr -3000.000 3000.000 FORMAT "%8.3" EXTENDED_LIMITS -32768.00 32767.00 /end CHARACTERISTIC
/begin CHARACTERISTIC IVCtl_iDisChDwnMax_C "Maximaler Entladestrom" VALUE 0xEC6DE Kw_Ws16 30000.00 Curr -30000.00 0.00 FORMAT "%8.2" EXTENDED_LIMITS -32768.00 32767.00 /end CHARACTERISTIC
/begin CHARACTERISTIC IVCtl_iDisChDwnMin_C "Minimaler Entladestrom" VALUE 0xEC6E0 Kw_Ws16 30000.00 Curr -30000.00 0.00 FORMAT "%8.2" EXTENDED_LIMITS -32768.00 32767.00 /end CHARACTERISTIC
/begin CHARACTERISTIC IVCtl_iDisChDwn_CUR "Kennlinie zu spannungsabhängigen Sollwertvorgabe der unteren Stromgrenze des Entladens" CURVE 0xEC6E2 Kl_Xs16_Ws16 30000.00 Curr -30000.00 0.00 FORMAT "%8.2" EXTENDED_LIMITS -32768.00 32767.00
 /begin AXIS_DESCR STD_AXIS IVCtl_uSetUpAvrg_mp Volt_PA 25 0.00 250.0000 FORMAT "%8.4" EXTENDED_LIMITS -327.6800 327.6700 DEPOSIT ABSOLUTE /end AXIS_DESCR
/end CHARACTERISTIC
/begin CHARACTERISTIC IVCtl_IKi_C "Integrationsbeiwert Ki für Kleinsignale" VALUE 0xEC78C Kw_Wu32 999999.999767 Ki 0.00 999999.999767 FORMAT "%13.6" /end CHARACTERISTIC
/begin CHARACTERISTIC IVCtl_IKiPos_C "Integrationsbeiwert für positive Großsignale" VALUE 0xEC790 Kw_Wu32 999999.999767 Ki 0.00 999999.999767 FORMAT "%13.6" /end CHARACTERISTIC
/begin CHARACTERISTIC IVCtl_IKiNeg_C "Integrationsbeiwert für negative Großsignale" VALUE 0xEC794 Kw_Wu32 999999.999767 Ki 0.00 999999.999767 FORMAT "%13.6" /end CHARACTERISTIC
/begin CHARACTERISTIC IVCtl_uIWinPos_C "Obere Grenze Kleinsignal zu Großsignal I-Regler" VALUE 0xEC798 Kw_Ws16 655.3500 Volt_PA -327.6800 327.6700 FORMAT "%8.4" /end CHARACTERISTIC
/begin CHARACTERISTIC IVCtl_uIWinNeg_C "Untere Grenze Kleinsignal zu Großsignal I-Regler" VALUE 0xEC79A Kw_Ws16 655.3500 Volt_PA -327.6800 327.6700 FORMAT "%8.4" /end CHARACTERISTIC
/begin CHARACTERISTIC IVCtl_PKp_C "Verstärkung Kleinsignal" VALUE 0xEC79C Kw_Wu32 65535.9999847 Kp 0.00 65535.9999847 FORMAT "%13.7" /end CHARACTERISTIC
/begin CHARACTERISTIC IVCtl_PKpPos_C "Verstärkung positives Großsignal" VALUE 0xEC7A0 Kw_Wu32 65535.9999847 Kp 0.00 65535.9999847 FORMAT "%13.7" /end CHARACTERISTIC
/begin CHARACTERISTIC IVCtl_PKpNeg_C "Verstärkung negatives Großsignal" VALUE 0xEC7A4 Kw_Wu32 65535.9999847 Kp 0.00 65535.9999847 FORMAT "%13.7" /end CHARACTERISTIC
/begin CHARACTERISTIC IVCtl_uPWinPos_C "Obere Grenze Kleinsignal zu Großsignal P-Regler" VALUE 0xEC7A8 Kw_Ws16 655.3500 Volt_PA -327.6800 327.6700 FORMAT "%8.4" /end CHARACTERISTIC
/begin CHARACTERISTIC IVCtl_uPWinNeg_C "Untere Grenze Kleinsignal zu Großsignal P-Regler" VALUE 0xEC7AA Kw_Ws16 655.3500 Volt_PA -327.6800 327.6700 FORMAT "%8.4" /end CHARACTERISTIC
/begin CHARACTERISTIC IVCtl_swtAvrgEnaTiWarnVolt_C "Zylinderspezifischer Schalter: InjVCD_stAvrgEnaTiWarn als Freigabekriterium des Spannungsreglers aktivieren" VALUE 0xEC7AC Kw_Wu8 255.0 OneToOne 0.00 255.0 FORMAT "%5.1" /end CHARACTERISTIC
/begin CHARACTERISTIC IVCtl_swtTiChrgMinMaxActr_C "Schalter zur Aktivierung der Berechnung der Min.-/Max.-Regelabweichung der Lade-/Entladezeit (aktorspezifisch)" VALUE 0xEC748 Kw_Wu8 1.000 OneToOne 0.00 1.000 FORMAT "%5.3" EXTENDED_LIMITS 0.00 255.0 /end CHARACTERISTIC
/begin CHARACTERISTIC IVCtl_swtTiChrgMinMaxRst_C "Schalter zum Rücksetzen der Berechnung Min.-/Max.-Regelabweichung von Lade-/Entladezeit" VALUE 0xEC749 Kw_Wu8 1.000 OneToOne 0.00 1.000 FORMAT "%5.3" EXTENDED_LIMITS 0.00 255.0 /end CHARACTERISTIC
/begin CHARACTERISTIC IVCtl_swtTiChrgMinMax_C "Schalter zur Aktivierung der Berechnung der Min.-/Max.-Regelabweichung der Lade-/Entladezeit (gemittelt)" VALUE 0xEC74A Kw_Wu8 1.000 OneToOne 0.00 1.000 FORMAT "%5.3" EXTENDED_LIMITS 0.00 255.0 /end CHARACTERISTIC
/begin CHARACTERISTIC IVCtl_swtUUpMinMaxActr_C "Schalter: Aktivierung der Berechnung der minimalen / maximalen Spannungsabweichung (aktorspezifisch)" VALUE 0xEC7AD Kw_Wu8 1.000 OneToOne 0.00 1.000 FORMAT "%5.3" EXTENDED_LIMITS 0.00 255.0 /end CHARACTERISTIC
/begin CHARACTERISTIC IVCtl_swtUUpMinMaxRst_C "Schalter: Rücksetzen der Berechnung Min.-/Max.-Regelabweichung der Spannung" VALUE 0xEC7AE Kw_Wu8 1.000 OneToOne 0.00 1.000 FORMAT "%5.3" EXTENDED_LIMITS 0.00 255.0 /end CHARACTERISTIC
/begin CHARACTERISTIC IVCtl_swtUUpMinMax_C "Schalter: Aktivierung der Berechnung der minimalen/maximalen Spannungsabweichung (gemittelt)" VALUE 0xEC7AF Kw_Wu8 1.000 OneToOne 0.00 1.000 FORMAT "%5.3" EXTENDED_LIMITS 0.00 255.0 /end CHARACTERISTIC
/begin CHARACTERISTIC IVCtl_tiChrgSetUp_MAP "Kennfeld zur spannungs- und raildruckabhängigen Sollwertvorgabe des Aktor-Ladestroms" MAP 0xEC74C Kf_Xs16_Ys16_Ws16 400.0000 Time_Busy 0.00 400.0000 FORMAT "%8.4" EXTENDED_LIMITS -3276.800 3276.700
 /begin AXIS_DESCR STD_AXIS IVCtl_uSetUpAvrg_mp Volt_PA 4 0.00 250.0000 FORMAT "%8.4" EXTENDED_LIMITS -327.6800 327.6700 DEPOSIT ABSOLUTE /end AXIS_DESCR
 /begin AXIS_DESCR STD_AXIS RailCD_pPeak Pres_Rail 2 -3276.800 3276.700 FORMAT "%5.3" DEPOSIT ABSOLUTE /end AXIS_DESCR
/end CHARACTERISTIC
/begin CHARACTERISTIC IVCtl_tiChrgUpPse_CUR "Kennlinie der Ladestrom-Pausezeit für Ladezeitregelung" CURVE 0xEC76C Kl_Xs16_Ws16 400.0000 Time_Busy 0.00 400.0000 FORMAT "%8.4" EXTENDED_LIMITS -3276.800 3276.700
 /begin AXIS_DESCR STD_AXIS RailCD_pPeak Pres_Rail 2 -3276.800 3276.700 FORMAT "%5.3" DEPOSIT ABSOLUTE /end AXIS_DESCR
/end CHARACTERISTIC
/begin CHARACTERISTIC IVCtl_tiDisChDwnPse_C "Vorgabewert der Pausezeit für Entladezeitregelung" VALUE 0xEC776 Kw_Ws16 400.0000 Time_Busy 0.00 400.0000 FORMAT "%8.4" EXTENDED_LIMITS -3276.800 3276.700 /end CHARACTERISTIC
/begin CHARACTERISTIC IVCtl_tiDisChSetDwn_CUR "Kennlinie zur spannungsabhängigen Sollwertvorgabe der Entladezeit" CURVE 0xEC778 Kl_Xs16_Ws16 400.0000 Time_Busy 0.00 400.0000 FORMAT "%8.4" EXTENDED_LIMITS -3276.800 3276.700
 /begin AXIS_DESCR STD_AXIS IVCtl_uSetUpAvrg_mp Volt_PA 4 -250.0000 250.0000 FORMAT "%8.4" EXTENDED_LIMITS -327.6800 327.6700 DEPOSIT ABSOLUTE /end AXIS_DESCR
/end CHARACTERISTIC
/begin CHARACTERISTIC IVCtl_uClsActrUp_C "Sollspannung für den Piezoaktor während der Klassifizierung im Steuergerätenachlauf" VALUE 0xEC7B0 Kw_Ws16 500.0000 Volt_PA -250.0000 250.0000 FORMAT "%8.4" EXTENDED_LIMITS -327.6800 327.6700 /end CHARACTERISTIC
/begin CHARACTERISTIC IVCtl_uMaxSetUp_C "Obere Begrenzung des korrigierten Spannungssollwertes (up-level)" VALUE 0xEC7B2 Kw_Ws16 250.0000 Volt_PA 0.00 250.0000 FORMAT "%8.4" EXTENDED_LIMITS -327.6800 327.6700 /end CHARACTERISTIC
/begin CHARACTERISTIC IVCtl_uMinSetUp_C "Untere Begrenzung des korrigierten Spannungssollwertes (up-level)" VALUE 0xEC7B4 Kw_Ws16 250.0000 Volt_PA 0.00 250.0000 FORMAT "%8.4" EXTENDED_LIMITS -327.6800 327.6700 /end CHARACTERISTIC
/begin CHARACTERISTIC IVCtl_uPIMax_C "Maximaler Reglerausgang Spannungssollwert" VALUE 0xEC7B6 Kw_Ws16 500.0000 Volt_PA -250.0000 250.0000 FORMAT "%8.4" EXTENDED_LIMITS -327.6800 327.6700 /end CHARACTERISTIC
/begin CHARACTERISTIC IVCtl_uPIMin_C "Minimaler Reglerausgang Spannungssollwert" VALUE 0xEC7B8 Kw_Ws16 500.0000 Volt_PA -250.0000 250.0000 FORMAT "%8.4" EXTENDED_LIMITS -327.6800 327.6700 /end CHARACTERISTIC
/begin CHARACTERISTIC IVCtl_uSetUpPreCtl_CUR "Vorsteuerkennlinie für Spannungssollwertberechnung" CURVE 0xEC7BA Kl_Xs16_Ws16 250.0000 Volt_PA 0.00 250.0000 FORMAT "%8.4" EXTENDED_LIMITS -327.6800 327.6700
 /begin AXIS_DESCR STD_AXIS InjVlv_pCalcVolt Pres_Rail 20 -3276.800 3276.700 FORMAT "%5.3" DEPOSIT ABSOLUTE /end AXIS_DESCR
/end CHARACTERISTIC
/begin CHARACTERISTIC IVCtl_uUpInitI_C "Initialisierungswert für I-Anteil des PI-Spannungsreglers (up-Niveau)" VALUE 0xEC80C Kw_Ws16 500.0000 Volt_PA -250.0000 250.0000 FORMAT "%8.4" EXTENDED_LIMITS -327.6800 327.6700 /end CHARACTERISTIC
/begin CHARACTERISTIC K2RDLI_dDataSetVer_C "Array für Datensatzversion" ASCII 0xC0654 Kwb_Wu8 255.0 defaultAscii 0.00 255.0 NUMBER 10 /end CHARACTERISTIC
/begin CHARACTERISTIC KeyCheck_Mode_C "Auswahl des key check modes" VALUE 0xEC810 Kw_Wu8 114.000000000 KeyCheckMode 57.0000000000 171.000000000 FORMAT "%13.9" /end CHARACTERISTIC
/begin MEASUREMENT InjVCD_chgUpActrCurr "geflossene Ladung beim Laden des Aktors von Bottom- auf Up-Niveau" SWORD Charge_PA 1 100 -32768.00 32767.00 FORMAT "%8.2" ARRAY_SIZE 8 ECU_ADDRESS 0x7F9624 /end MEASUREMENT
/begin MEASUREMENT InjVCD_ctBgnShrtDeb_mp "Entprellzähler für Start der Sweepfunktion" UWORD OneToOne 1 100 0.00 65535.00 FORMAT "%8.2" ECU_ADDRESS 0x8FE976 /end MEASUREMENT
/begin MEASUREMENT InjVCD_ctMI1AgDiff_mp "Zähler für Winkelverletzungen bei Programmierung des Ansteuerbeginns der MI1" UWORD OneToOne 1 100 0.00 65535.00 FORMAT "%8.2" ECU_ADDRESS 0x8FEA4E /end MEASUREMENT
/begin MEASUREMENT InjVCD_ctPiI1AgDiff_mp "Zähler für Winkelverletzungen bei Programmierung des Ansteuerbeginns der PiI1" UWORD OneToOne 1 100 0.00 65535.00 FORMAT "%8.2" ECU_ADDRESS 0x8FEA58 /end MEASUREMENT
/begin MEASUREMENT InjVCD_ctPiI2AgDiff_mp "Zähler für Winkelverletzungen bei Programmierung des Ansteuerbeginns der PiI2" UWORD OneToOne 1 100 0.00 65535.00 FORMAT "%8.2" ECU_ADDRESS 0x8FEA5E /end MEASUREMENT
/begin MEASUREMENT InjVCD_ctUBufMIIntCall "Zähler für Anzahl MI Interrupts für Bufferspannungsmessung" UBYTE OneToOne 1 100 0.00 255.0 FORMAT "%5.1" ECU_ADDRESS 0x7F8934 /end MEASUREMENT
/begin MEASUREMENT InjVCD_ctUBufTrigWait_mp "Zähler für das Warten auf Bufferspannungs-ADC-Trigger" UBYTE OneToOne 1 100 0.00 255.0 FORMAT "%5.1" ECU_ADDRESS 0x8FE9CC /end MEASUREMENT
/begin MEASUREMENT InjVCD_ctUBufTrig_mp "Zähler für Anzahl der QADC-Trigger" UBYTE OneToOne 1 100 0.00 255.0 FORMAT "%5.1" ECU_ADDRESS 0x8FE9CD /end MEASUREMENT
/begin MEASUREMENT InjVCD_cUpActrCurr "aktuelle Aktorkapazität (Laden)" SWORD Capacity_PA 1 100 -32.76800 32.76700 FORMAT "%8.5" ARRAY_SIZE 8 ECU_ADDRESS 0x7F9604 /end MEASUREMENT
/begin MEASUREMENT InjVCD_cUpActrOld "vorhergehende Aktorkapazitaet nach Laden von Bottom nach Up Niveau" SWORD Capacity_PA 1 100 -32.76800 32.76700 FORMAT "%8.5" ARRAY_SIZE 8 ECU_ADDRESS 0x7F9614 /end MEASUREMENT
/begin MEASUREMENT InjVCD_dPhiPoI1Shft_mp "Inkrementelle Winkelverschiebung für diesen Zyklus" SWORD AngleCrS 1 100 -768.0000 767.9766 FORMAT "%8.4" ECU_ADDRESS 0x8FE980 /end MEASUREMENT
/begin MEASUREMENT InjVCD_dtiEMComp "Dauer der Verkürzung der Einspritzung (von Flankenmanagement)" SWORD InjTime_us 1 100 -32768.00 32767.00 FORMAT "%8.2" ARRAY_SIZE 8 ECU_ADDRESS 0x7F9634 /end MEASUREMENT
/begin MEASUREMENT InjVCD_dtiEMComp_mp "Dauer der Verkürzung der Einspritzung (von Flankenmanagement)" SWORD InjTime_us 1 100 -32768.00 32767.00 FORMAT "%8.2" ECU_ADDRESS 0x8FE978 /end MEASUREMENT
/begin MEASUREMENT InjVCD_facAmp_mp "Stromverstärkungsfaktor des CY370-Integrators" SWORD Fact_IntAmp 1 100 -32.76800 32.76700 FORMAT "%8.5" ECU_ADDRESS 0x8FE8DC /end MEASUREMENT
/begin MEASUREMENT InjVCD_facWActrDvtActr_mp "Abweichungsfaktor des Energieverbrauches des Piezo-Aktors" SWORD Fact1 1 100 -256.0000 255.9922 FORMAT "%8.4" ARRAY_SIZE 8 ECU_ADDRESS 0x8FE8E8 /end MEASUREMENT
/begin MEASUREMENT InjVCD_facWActrDvtAvrg "Abweichungsfaktor des gemessenen Aktorenergieverbrauchs vom nominalen" SWORD Fact1 1 100 -256.0000 255.9922 FORMAT "%8.4" ECU_ADDRESS 0x7F9004 /end MEASUREMENT
/begin MEASUREMENT InjVCD_facWActrDvtCurr_mp "Korrigiertes und begrenztes Verhältnis von tatsächlichem zu normiertem Aktor-Energieverbrauch" SWORD Fact1 1 100 -256.0000 255.9922 FORMAT "%8.4" ECU_ADDRESS 0x8FE8F8 /end MEASUREMENT
/begin MEASUREMENT InjVCD_facWActrTemp_mp "Temperaturkorrektionsfaktor für den nominalen Energieverbrauch einer Piezo-Aktor Ansteuerung" SWORD Fact1 1 100 -256.0000 255.9922 FORMAT "%8.4" ECU_ADDRESS 0x8FE8FA /end MEASUREMENT
/begin MEASUREMENT InjVCD_iPolarChrg_mp "Ladestrom während der Polarisierung" SWORD Curr 1 100 -32768.00 32767.00 FORMAT "%8.2" ECU_ADDRESS 0x8FEA30 /end MEASUREMENT
/begin MEASUREMENT InjVCD_iPolarDisCh_mp "Entladestrom während der Polarisierung" SWORD Curr 1 100 -32768.00 32767.00 FORMAT "%8.2" ECU_ADDRESS 0x8FEA32 /end MEASUREMENT
/begin MEASUREMENT InjVCD_numCollPrim_mp "Beschreibung der Primärkollision" UBYTE OneToOne 1 100 0.00 255.0 FORMAT "%5.1" ECU_ADDRESS 0x8FE989 /end MEASUREMENT
/begin MEASUREMENT InjVCD_numCollScnd_mp "Beschreibung der Sekundärkollision" UBYTE OneToOne 1 100 0.00 255.0 FORMAT "%5.1" ECU_ADDRESS 0x8FE98A /end MEASUREMENT
/begin MEASUREMENT InjVCD_numCollThrd_mp "Beschreibung der Tertiärkollision" UBYTE OneToOne 1 100 0.00 255.0 FORMAT "%5.1" ECU_ADDRESS 0x8FE98B /end MEASUREMENT
/begin MEASUREMENT InjVCD_numCrntLvl_mp "ausgewähltes Stromband" SBYTE OneToOne 1 100 -128.0 127.0 FORMAT "%5.1" ECU_ADDRESS 0x8FEA68 /end MEASUREMENT
/begin MEASUREMENT InjVCD_numDCDC "Anzahl der verwendeten DCDC-Wandler" UBYTE OneToOne 1 100 0.00 255.0 FORMAT "%5.1" ECU_ADDRESS 0x7F8935 /end MEASUREMENT
/begin MEASUREMENT InjVCD_numEvMgmtStat_mp "Statusinformation des Flankenmanagement" ULONG OneToOne 1 100 0.00 4294967295.00 FORMAT "%13.2" ARRAY_SIZE 8 ECU_ADDRESS 0x8FE98C /end MEASUREMENT
/begin MEASUREMENT InjVCD_numFacWValid_mp "Anzahl gültiger Werte von InjVCD_facWActrDvt_mp" ULONG OneToOne 1 100 0.00 4294967295.00 FORMAT "%13.2" ECU_ADDRESS 0x6F81F4 /end MEASUREMENT
/begin MEASUREMENT InjVCD_numHandle "Handle des TPU-Kanals in welchem die gerade zu vermessende Einspritzung steht" UBYTE OneToOne 1 100 0.00 255.0 FORMAT "%5.1" ECU_ADDRESS 0x7F8936 /end MEASUREMENT
/begin MEASUREMENT InjVCD_numMeas "Nummer des Aktors der gerade vermessen wird" UBYTE OneToOne 1 100 0.00 255.0 FORMAT "%5.1" ECU_ADDRESS 0x7F8937 /end MEASUREMENT
/begin MEASUREMENT InjVCD_numOfsSelect "ausgewählter Spannungsoffset" SWORD OneToOne 1 100 -32768.00 32767.00 FORMAT "%8.2" ECU_ADDRESS 0x7F9006 /end MEASUREMENT
/begin MEASUREMENT InjVCD_numOfsSelect_mp "zuletzt verwendeter Spannungsoffset" UBYTE OneToOne 1 100 0.00 255.0 FORMAT "%5.1" ECU_ADDRESS 0x8FE8DE /end MEASUREMENT
/begin MEASUREMENT InjVCD_numPolarLeft_mp "Anzahl der ausstehenden Ansteuerungen für die Polarisierung" SWORD OneToOne 1 100 -32768.00 32767.00 FORMAT "%8.2" ECU_ADDRESS 0x8FEA34 /end MEASUREMENT
/begin MEASUREMENT InjVCD_numReacPrim_mp "Beschreibung der Primärreaktion" UBYTE OneToOne 1 100 0.00 255.0 FORMAT "%5.1" ECU_ADDRESS 0x8FE9AC /end MEASUREMENT
/begin MEASUREMENT InjVCD_numReacScnd_mp "Beschreibung der Sekundärreaktion" UBYTE OneToOne 1 100 0.00 255.0 FORMAT "%5.1" ECU_ADDRESS 0x8FE9AD /end MEASUREMENT
/begin MEASUREMENT InjVCD_pActInj "verwendeter Raildruck der bei letzter Aktormessung gültig war" SWORD Pres_Rail 1 100 -3276.800 3276.700 FORMAT "%5.3" ECU_ADDRESS 0x7F9008 /end MEASUREMENT
/begin MEASUREMENT InjVCD_phiAccu_mp "wie InjVCD_phiPoI1Shft_mp (doppelt, obsolet)" SWORD AngleCrS 1 100 -768.0000 767.9766 FORMAT "%8.4" ECU_ADDRESS 0x8FE97A /end MEASUREMENT
/begin MEASUREMENT InjVCD_phiInjBegMI1_mp "" SWORD AngleCrS 1 100 -768.0000 767.9766 FORMAT "%8.4" ECU_ADDRESS 0x8FEA50 /end MEASUREMENT
/begin MEASUREMENT InjVCD_phiMI1Diff_mp "Winkeldifferenz zwischen dem gewünschten Ansteuerbeginn und dem systembed. frühesten Ansteuerbeginn der MI1" SWORD AngleCrS 1 100 -768.0000 767.9766 FORMAT "%8.4" ECU_ADDRESS 0x8FEA52 /end MEASUREMENT
/begin MEASUREMENT InjVCD_phiPiI1Diff_mp "Winkeldifferenz zwischen dem gewünschten Ansteuerbeginn und dem systembed. frühesten Ansteuerbeginn der PiI1" SWORD AngleCrS 1 100 -768.0000 767.9766 FORMAT "%8.4" ECU_ADDRESS 0x8FEA5A /end MEASUREMENT
/begin MEASUREMENT InjVCD_phiPiI2Diff_mp "Winkeldifferenz zwischen dem gewünschten Ansteuerbeginn und dem systembed. frühesten Ansteuerbeginn der PiI2" SWORD AngleCrS 1 100 -768.0000 767.9766 FORMAT "%8.4" ECU_ADDRESS 0x8FEA60 /end MEASUREMENT
/begin MEASUREMENT InjVCD_phiPoI1DesShft_mp "Schlußendlich programmierter Winkel (mit Sweep) (in Modul injvcd_progpoi1)" SWORD AngleCrS 1 100 -768.0000 767.9766 FORMAT "%8.4" ECU_ADDRESS 0x8FE97C /end MEASUREMENT
/begin MEASUREMENT InjVCD_phiPoI1Shft "Von Sweepfunktion berechneter Verschiebewinkel" SWORD AngleCrS 1 100 -768.0000 767.9766 FORMAT "%8.4" ARRAY_SIZE 8 ECU_ADDRESS 0x7F9644 /end MEASUREMENT
/begin MEASUREMENT InjVCD_phiPoI1Shft_mp "Message InjVCD_phiPoI1Shft auf Meßpunkt" SWORD AngleCrS 1 100 -768.0000 767.9766 FORMAT "%8.4" ECU_ADDRESS 0x8FE97E /end MEASUREMENT
/begin MEASUREMENT InjVCD_phiPoI1ShrtAct_mp "Berechnete Winkelverschiebung, die Verkürzung verhindert hätte" SWORD AngleCrS 1 100 -768.0000 767.9766 FORMAT "%8.4" ECU_ADDRESS 0x8FE982 /end MEASUREMENT
/begin MEASUREMENT InjVCD_phiPoI1SweepMax_mp "Obere Winkelgrenze für Sweepbereich" SWORD AngleCrS 1 100 -768.0000 767.9766 FORMAT "%8.4" ECU_ADDRESS 0x8FE984 /end MEASUREMENT
/begin MEASUREMENT InjVCD_phiPoI1SweepMin_mp "Untere Winkelgrenze für Sweepbereich" SWORD AngleCrS 1 100 -768.0000 767.9766 FORMAT "%8.4" ECU_ADDRESS 0x8FE986 /end MEASUREMENT
/begin MEASUREMENT InjVCD_pInET_mp "X-Eingang des Kennfeldes InjVCD_tiET_MAP auf dem Appplikationswerkzeug" SWORD Pres_Rail 1 100 -3276.800 3276.700 FORMAT "%5.3" ECU_ADDRESS 0x8FE9C8 /end MEASUREMENT
/begin MEASUREMENT InjVCD_pMonShCir_mp "Raildruck vor der Kurzschlussunterscheidung" SWORD Pres_Rail 1 100 -3276.800 3276.700 FORMAT "%5.3" ECU_ADDRESS 0x8FEA0C /end MEASUREMENT
/begin MEASUREMENT InjVCD_pPolar_mp "Raildruck zum Zeitpunkt der Polarisierung" SWORD Pres_Rail 1 100 -3276.800 3276.700 FORMAT "%5.3" ECU_ADDRESS 0x8FEA36 /end MEASUREMENT
/begin MEASUREMENT InjVCD_PZOSWType "SW-Identifikation" ULONG OneToOne 1 100 0.00 4294967295.00 FORMAT "%13.2" ECU_ADDRESS 0x7F9424 /end MEASUREMENT
/begin MEASUREMENT InjVCD_qInZFCETGMap_mp "Menge fuer Eingangsanzeige der Gruppenkennfelder InjVCD_rZFCETMsk_GMAP, ...Dif0_GMAP, ...Dif1_GMAP" SWORD InjMassInj 1 100 -327.6800 327.6700 FORMAT "%8.4" ECU_ADDRESS 0x8FEA72 /end MEASUREMENT
/begin MEASUREMENT InjVCD_rCapThresHigh_mp "berechnetes Kapazitätsverhältnis der überwachten Aktoren (Schwelle high)" SWORD Fact 1 100 -4.000000 3.999878 FORMAT "%8.6" ECU_ADDRESS 0x8FE9FC /end MEASUREMENT
/begin MEASUREMENT InjVCD_rCapThresLow_mp "berechnetes Kapazitätsverhältnis der überwachten Aktoren (Schwelle low)" SWORD Fact 1 100 -4.000000 3.999878 FORMAT "%8.6" ECU_ADDRESS 0x8FE9FE /end MEASUREMENT
/begin MEASUREMENT InjVCD_rCapUpCurrToKx_mp "berechnetes Verhältnis der Aktorkapazitäten (aktuell zu alt)" SWORD Fact 1 100 -4.000000 3.999878 FORMAT "%8.6" ECU_ADDRESS 0x8FEA00 /end MEASUREMENT
/begin MEASUREMENT InjVCD_rCapUpKxToCurr_mp "berechnetes Verhältnis der Aktorkapazitäten (alt zu aktuell)" SWORD Fact 1 100 -4.000000 3.999878 FORMAT "%8.6" ECU_ADDRESS 0x8FEA02 /end MEASUREMENT
/begin MEASUREMENT InjVCD_rClsVolt_mp "Quotient aus Beginn- und Ende-Spannung" SLONG Milli 1 100 -2147483.64800 2147483.64700 FORMAT "%13.5" ARRAY_SIZE 8 ECU_ADDRESS 0x8FE924 /end MEASUREMENT
/begin MEASUREMENT InjVCD_regCY370Bank "Bank-selektives Register des CY370" UBYTE OneToOne 1 100 0.00 255.0 FORMAT "%5.1" ECU_ADDRESS 0x7F8938 /end MEASUREMENT
/begin MEASUREMENT InjVCD_regCY370CylISel "Zylinder-selektives Register des CY370 (ISel)" UBYTE OneToOne 1 100 0.00 255.0 FORMAT "%5.1" ECU_ADDRESS 0x7F8939 /end MEASUREMENT
/begin MEASUREMENT InjVCD_regCY370Global "Globales Register des CY370" UBYTE OneToOne 1 100 0.00 255.0 FORMAT "%5.1" ECU_ADDRESS 0x7F893A /end MEASUREMENT
/begin MEASUREMENT InjVCD_regCY370ID_mp "Chip-ID des CY370" UBYTE OneToOne 1 100 0.00 255.0 FORMAT "%5.1" ECU_ADDRESS 0x8FE966 /end MEASUREMENT
/begin MEASUREMENT InjVCD_regCY370Status "Status-Register des CY370" UBYTE OneToOne 1 100 0.00 255.0 FORMAT "%5.1" ECU_ADDRESS 0x7F893B /end MEASUREMENT
/begin MEASUREMENT InjVCD_rGlobDynTimePrio_mp "" SWORD Prc 1 100 -400.0000 399.9878 FORMAT "%8.4" ECU_ADDRESS 0x8FEA54 /end MEASUREMENT
/begin MEASUREMENT InjVCD_rTiChrgUpCurrToKx_mp "Verhaeltnis vo aktueller Ladezeit zu vorletzter Ladezeit" SWORD Fact 1 100 -4.000000 3.999878 FORMAT "%8.6" ECU_ADDRESS 0x8FEA04 /end MEASUREMENT
/begin MEASUREMENT InjVCD_rTiChrgUpKxToCurr_mp "Verhaeltnis von vorletzter Aktorladezeit zu aktueller Aktorladezeit" SWORD Fact 1 100 -4.000000 3.999878 FORMAT "%8.6" ECU_ADDRESS 0x8FEA06 /end MEASUREMENT
/begin MEASUREMENT InjVCD_rTiChrgUpThresHigh_mp "Oberes Verhaeltnis der Aktorladezeit aktuell/alt zur Erkennung eines Lowside Schalter Kurzschlusses" SWORD Fact 1 100 -4.000000 3.999878 FORMAT "%8.6" ECU_ADDRESS 0x8FEA08 /end MEASUREMENT
/begin MEASUREMENT InjVCD_rTiChrgUpThresLow_mp "Unteres Verhaeltnis der Aktorladezeit aktuell/alt zur Erkennung eines Lowside Schalter Kurzschlusses" SWORD Fact 1 100 -4.000000 3.999878 FORMAT "%8.6" ECU_ADDRESS 0x8FEA0A /end MEASUREMENT
/begin MEASUREMENT InjVCD_rZFCETCoeffDif_mp "Bewertungsfaktoren fuer Ansteuerdauerkorrektur durch Nullmengenkalibrierung" SWORD Prc 1 100 -400.0000 399.9878 FORMAT "%8.4" ARRAY_SIZE 3 ECU_ADDRESS 0x8FEA6A /end MEASUREMENT
/begin MEASUREMENT InjVCD_rZFCETCoeffMsk_mp "Gesamtbewertungsfaktor der Ansteuerdauerkorrektur durch Nullmengenkalibrierung" SWORD Prc 1 100 -400.0000 399.9878 FORMAT "%8.4" ECU_ADDRESS 0x8FEA70 /end MEASUREMENT
/begin MEASUREMENT InjVCD_stActrEnrg "Status der Aktorenergiemessung (aktorspezifisch)" UBYTE OneToOne 1 100 0.00 255.0 FORMAT "%5.1" ARRAY_SIZE 8 ECU_ADDRESS 0x7F94D6 /end MEASUREMENT
/begin MEASUREMENT InjVCD_stAvrgEna "Für Mittelwertberechnungen freigegebene Zylinder" UBYTE OneToOne 1 100 0.00 255.0 FORMAT "%5.1" ECU_ADDRESS 0x7F893C /end MEASUREMENT
/begin MEASUREMENT InjVCD_stAvrgEnaTiWarn "Warnung für geringe Zeitdifferenz" UBYTE OneToOne 1 100 0.00 255.0 FORMAT "%5.1" ECU_ADDRESS 0x7F893D /end MEASUREMENT
/begin MEASUREMENT InjVCD_stBufMon "Status Bufferspannung (Bufferspezifisch)" UBYTE OneToOne 1 100 0.00 255.0 FORMAT "%5.1" ARRAY_SIZE 1 ECU_ADDRESS 0x7F893E /end MEASUREMENT
/begin MEASUREMENT InjVCD_stCalcChrgActr "Zustand der Ladungsberechnung" UBYTE OneToOne 1 100 0.00 255.0 FORMAT "%5.1" ECU_ADDRESS 0x7F8940 /end MEASUREMENT
/begin MEASUREMENT InjVCD_stClsActr "Status der Piezoaktor-Klassifizierung" UBYTE Actr_Cls_State 1 100 0.00 4.00000000000 FORMAT "%13.11" ECU_ADDRESS 0x7F8941 /end MEASUREMENT
/begin MEASUREMENT InjVCD_stCY370Buf "Buffer(kondensator)status" UBYTE OneToOne 1 100 0.00 255.0 FORMAT "%5.1" ECU_ADDRESS 0x7F893F /end MEASUREMENT
/begin MEASUREMENT InjVCD_stCY370Event_mp "Rueckgabewert des single event (0 = kein Fehler)" UBYTE OneToOne 1 100 0.00 255.0 FORMAT "%5.1" ECU_ADDRESS 0x8FE967 /end MEASUREMENT
/begin MEASUREMENT InjVCD_stEMSweep_mp "Zustand des Zustandsautomaten" UBYTE OneToOne 1 100 0.00 255.0 FORMAT "%5.1" ECU_ADDRESS 0x8FE988 /end MEASUREMENT
/begin MEASUREMENT InjVCD_stInjBegMI1_mp "Status der Beginnprogrammierung der Haupteinspritzung" UBYTE OneToOne 1 100 0.00 255.0 FORMAT "%5.1" ECU_ADDRESS 0x8FEA4C /end MEASUREMENT
/begin MEASUREMENT InjVCD_stInjBegPiI1_mp "Status der Förderbeginnprogrammierung für die Voreinspritzung" UBYTE OneToOne 1 100 0.00 255.0 FORMAT "%5.1" ECU_ADDRESS 0x8FEA56 /end MEASUREMENT
/begin MEASUREMENT InjVCD_stInjBegPiI2_mp "Status der Einspritzbeginnprogrammierung für PiI2" UBYTE OneToOne 1 100 0.00 255.0 FORMAT "%5.1" ECU_ADDRESS 0x8FEA5C /end MEASUREMENT
/begin MEASUREMENT InjVCD_stInjBegPiI3_mp "Status der Einspritzbeginnprogrammierung PiI3" UBYTE OneToOne 1 100 0.00 255.0 FORMAT "%5.1" ECU_ADDRESS 0x8FEA62 /end MEASUREMENT
/begin MEASUREMENT InjVCD_stInjBegPoI1_mp "Status der Einspritzbeginnprogrammierung PoI1" UBYTE OneToOne 1 100 0.00 255.0 FORMAT "%5.1" ECU_ADDRESS 0x8FEA66 /end MEASUREMENT
/begin MEASUREMENT InjVCD_stInjBegPoI2_mp "Status der Förderbeginnprogrammierung der Nacheinspritzung" UBYTE OneToOne 1 100 0.00 255.0 FORMAT "%5.1" ECU_ADDRESS 0x8FEA67 /end MEASUREMENT
/begin MEASUREMENT InjVCD_stInjMI1_mp "Status der Haupteinspritzung-1-Programmierung" UBYTE OneToOne 1 100 0.00 255.0 FORMAT "%5.1" ECU_ADDRESS 0x8FEA44 /end MEASUREMENT
/begin MEASUREMENT InjVCD_stInjMI2_mp "Status der Haupteinspritzung-2-Programmierung" UBYTE OneToOne 1 100 0.00 255.0 FORMAT "%5.1" ECU_ADDRESS 0x8FEA45 /end MEASUREMENT
/begin MEASUREMENT InjVCD_stInjNotActive_mp "Status der Überprüfung auf momentan aktive Einspritzungen" UBYTE OneToOne 1 100 0.00 255.0 FORMAT "%5.1" ECU_ADDRESS 0x8FE9CE /end MEASUREMENT
/begin MEASUREMENT InjVCD_stInjPiI1_mp "Status der Voreinspritzung-1-Programmierung" UBYTE OneToOne 1 100 0.00 255.0 FORMAT "%5.1" ECU_ADDRESS 0x8FEA46 /end MEASUREMENT
/begin MEASUREMENT InjVCD_stInjPiI2_mp "Status der Voreinspritzung-2-Programmierung" UBYTE OneToOne 1 100 0.00 255.0 FORMAT "%5.1" ECU_ADDRESS 0x8FEA47 /end MEASUREMENT
/begin MEASUREMENT InjVCD_stInjPiI3_mp "Status der Voreinspritzung-3-Programmierung" UBYTE OneToOne 1 100 0.00 255.0 FORMAT "%5.1" ECU_ADDRESS 0x8FEA48 /end MEASUREMENT
/begin MEASUREMENT InjVCD_stInjPoI1_mp "Status der Nacheinspritzung-1-Programmierung" UBYTE OneToOne 1 100 0.00 255.0 FORMAT "%5.1" ECU_ADDRESS 0x8FEA49 /end MEASUREMENT
/begin MEASUREMENT InjVCD_stInjPoI2_mp "Status der Nacheinspritzung-2-Programmierung" UBYTE OneToOne 1 100 0.00 255.0 FORMAT "%5.1" ECU_ADDRESS 0x8FEA4A /end MEASUREMENT
/begin MEASUREMENT InjVCD_stInjPolarErr_mp "Zustand: Mindestens eine Einspritzung der Polarisierung fehlerhaft programmiert (zylinderspezifisch)" UBYTE OneToOne 1 100 0.00 255.0 FORMAT "%5.1" ECU_ADDRESS 0x8FEA38 /end MEASUREMENT
/begin MEASUREMENT InjVCD_stInjPolarOK_mp "Zustand: Mindestens eine Einspritzung der Polarisierung erfolgreich programmiert (zylinderspezifisch)" UBYTE OneToOne 1 100 0.00 255.0 FORMAT "%5.1" ECU_ADDRESS 0x8FEA39 /end MEASUREMENT
/begin MEASUREMENT InjVCD_stInjTPUCM_mp "Kollisionsmanagerstatus" UBYTE OneToOne 1 100 0.00 255.0 FORMAT "%5.1" ECU_ADDRESS 0x8FEA63 /end MEASUREMENT
/begin MEASUREMENT InjVCD_stInjTPUErr_mp "TPU Fehlerstatus" UBYTE OneToOne 1 100 0.00 255.0 FORMAT "%5.1" ECU_ADDRESS 0x8FEA64 /end MEASUREMENT
/begin MEASUREMENT InjVCD_stInjTPUShortDur_mp "Status zu kurze Ansteuerdauer programmiert" UBYTE OneToOne 1 100 0.00 255.0 FORMAT "%5.1" ECU_ADDRESS 0x8FEA65 /end MEASUREMENT
/begin MEASUREMENT InjVCD_stInjZFC_mp "Status der ZFC Programmierung" UBYTE OneToOne 1 100 0.00 255.0 FORMAT "%5.1" ECU_ADDRESS 0x8FEA4B /end MEASUREMENT
/begin MEASUREMENT InjVCD_stMeas "Zustand des Messkoordinators" UBYTE OneToOne 1 100 0.00 255.0 FORMAT "%5.1" ECU_ADDRESS 0x7F8942 /end MEASUREMENT
/begin MEASUREMENT InjVCD_stMeasLvl "Status des aufgetretenen Spannungsniveaus des Piezoaktors" UBYTE OneToOne 1 100 0.00 255.0 FORMAT "%5.1" ECU_ADDRESS 0x7F8943 /end MEASUREMENT
/begin MEASUREMENT InjVCD_stMeasLvlFirst "Status des aufgetretenen ersten Spannungsniveaus des Piezoaktors" UBYTE OneToOne 1 100 0.00 255.0 FORMAT "%5.1" ECU_ADDRESS 0x7F8944 /end MEASUREMENT
/begin MEASUREMENT InjVCD_stMeasUBuf "Zustand der Bufferspannungsmessung" UBYTE OneToOne 1 100 0.00 255.0 FORMAT "%5.1" ECU_ADDRESS 0x7F8945 /end MEASUREMENT
/begin MEASUREMENT InjVCD_stMon "Status Injektordiangose in der Steuergeräteinitialisierung" UBYTE OneToOne 1 100 0.00 255.0 FORMAT "%5.1" ECU_ADDRESS 0x7F8946 /end MEASUREMENT
/begin MEASUREMENT InjVCD_stMonChgActr "Status der Ladungsmessung (aktorspezifisch)" UBYTE OneToOne 1 100 0.00 255.0 FORMAT "%5.1" ARRAY_SIZE 8 ECU_ADDRESS 0x7F94DE /end MEASUREMENT
/begin MEASUREMENT InjVCD_stMonInjMI_mp "Status der Haupteinspritzung für Kurzschlussunterscheidung" UBYTE OneToOne 1 100 0.00 255.0 FORMAT "%5.1" ECU_ADDRESS 0x8FEA0E /end MEASUREMENT
/begin MEASUREMENT InjVCD_stMonShCirDel_mp "zeigt den Status der LowSide Diagnose Verzögerung" UBYTE OneToOne 1 100 0.00 255.0 FORMAT "%5.1" ECU_ADDRESS 0x8FE8DF /end MEASUREMENT
/begin MEASUREMENT InjVCD_stMonShCir_mp "Status der Kurzschlussunterscheidung" UBYTE stMonShCir 1 100 0.00 8.00000000000 FORMAT "%13.11" ECU_ADDRESS 0x8FEA0F /end MEASUREMENT
/begin MEASUREMENT InjVCD_stMonTiPlaus "Status der einspritzspezifisch gemessenen Ladezeit" UBYTE OneToOne 1 100 0.00 255.0 FORMAT "%5.1" ARRAY_SIZE 2 ECU_ADDRESS 0x7F900A /end MEASUREMENT
/begin MEASUREMENT InjVCD_stMonUBnkPlaus "Status der gemessenen Aktorspannung des Ansteuerverlaufs (Bank-spezifisch)" UBYTE OneToOne 1 100 0.00 255.0 FORMAT "%5.1" ARRAY_SIZE 2 ECU_ADDRESS 0x7F900C /end MEASUREMENT
/begin MEASUREMENT InjVCD_stMonUCylPlaus "Status der gemessenen Aktorspannung des Ansteuerverlaufs (zylinder-spezifisch)" UBYTE OneToOne 1 100 0.00 255.0 FORMAT "%5.1" ARRAY_SIZE 8 ECU_ADDRESS 0x7F94E6 /end MEASUREMENT
/begin MEASUREMENT InjVCD_stPolar "Status der Polarisierung der Piezo-Aktoren" UBYTE OneToOne 1 100 0.00 255.0 FORMAT "%5.1" ECU_ADDRESS 0x7F8947 /end MEASUREMENT
/begin MEASUREMENT InjVCD_stPolarPreCond_mp "Status: Vorbedingungen für Polarisierung erfüllt" UBYTE OneToOne 1 100 0.00 255.0 FORMAT "%5.1" ECU_ADDRESS 0x8FEA3A /end MEASUREMENT
/begin MEASUREMENT InjVCD_stShOffDCDC "Status der Schutzabschaltung des DC/DC-Wandlers" UBYTE OneToOne 1 100 0.00 255.0 FORMAT "%5.1" ECU_ADDRESS 0x7F8948 /end MEASUREMENT
/begin MEASUREMENT InjVCD_stUBufC "Status Bufferspannungsmessung" UBYTE OneToOne 1 100 0.00 255.0 FORMAT "%5.1" ARRAY_SIZE 1 ECU_ADDRESS 0x7F8949 /end MEASUREMENT
/begin MEASUREMENT InjVCD_stWaitPRailLow_mp "Status Raildruck" UBYTE OneToOne 1 100 0.00 255.0 FORMAT "%5.1" ECU_ADDRESS 0x8FE944 /end MEASUREMENT
/begin MEASUREMENT InjVCD_swtClsActr "Schalter zur Bestimmung der Aktorspannung für Piezoaktor-Klassifizierung" UBYTE Actr_Calc 1 100 0.00 1.00000000000 FORMAT "%13.11" ECU_ADDRESS 0x7F894A /end MEASUREMENT
/begin MEASUREMENT InjVCD_swtSelTemp "Message zum Zeigen der aktuellen Schalterstellung" UBYTE Actr_Temp_Sel 1 100 0.00 1.00000000000 FORMAT "%13.11" ECU_ADDRESS 0x7F894B /end MEASUREMENT
/begin MEASUREMENT InjVCD_tActr "Aktortemperatur" SWORD Temp_Cels 1 100 -50.140 899.860 FORMAT "%8.3" ECU_ADDRESS 0x7F900E /end MEASUREMENT
/begin MEASUREMENT InjVCD_tActrEnrg_mp "Aktortemperatur für die Berechnung der Aktorenergie" SWORD Temp_Cels 1 100 -50.140 899.860 FORMAT "%8.3" ECU_ADDRESS 0x8FE8FC /end MEASUREMENT
/begin MEASUREMENT InjVCD_tActr_mp "Basistemperatur zur Berechnung der Piezo-Aktortemperatur" SWORD Temp_Cels 1 100 -50.140 899.860 FORMAT "%8.3" ECU_ADDRESS 0x8FE920 /end MEASUREMENT
/begin MEASUREMENT InjVCD_tiChrgUpActr "Ladezeit vom Bottom zum Up Level" SWORD Time_Busy 1 100 -3276.800 3276.700 FORMAT "%8.3" ARRAY_SIZE 8 ECU_ADDRESS 0x7F9654 /end MEASUREMENT
/begin MEASUREMENT InjVCD_tiChrgUpActrOld "vorhergehende Aktorladezeit nach Laden von bottom nach up Niveau" SWORD Time_Busy 1 100 -3276.800 3276.700 FORMAT "%8.3" ARRAY_SIZE 8 ECU_ADDRESS 0x7F9664 /end MEASUREMENT
/begin MEASUREMENT InjVCD_tiCutAll_mp "Verkürzungszeit aller Kollisionen" SLONG InjTime_us 1 100 -2147483648.00 2147483647.00 FORMAT "%13.2" ECU_ADDRESS 0x8FE9B0 /end MEASUREMENT
/begin MEASUREMENT InjVCD_tiCutPrim_mp "Verkürzungszeit der Primärkollision" SLONG InjTime_us 1 100 -2147483648.00 2147483647.00 FORMAT "%13.2" ECU_ADDRESS 0x8FE9B4 /end MEASUREMENT
/begin MEASUREMENT InjVCD_tiCutScnd_mp "Verkürzungszeit der Sekundärkollision" SLONG InjTime_us 1 100 -2147483648.00 2147483647.00 FORMAT "%13.2" ECU_ADDRESS 0x8FE9B8 /end MEASUREMENT
/begin MEASUREMENT InjVCD_tiCY370ChrgRC "RC-Zeitkonstante vom CY370-Integrator für Ladungsberechnung" SWORD Time_Busy 1 100 -3276.800 3276.700 FORMAT "%8.3" ECU_ADDRESS 0x7F9010 /end MEASUREMENT
/begin MEASUREMENT InjVCD_tiDisChBottActr "Entladezeit vom Up zum Bottom Level" SWORD Time_Busy 1 100 -3276.800 3276.700 FORMAT "%8.3" ARRAY_SIZE 8 ECU_ADDRESS 0x7F9674 /end MEASUREMENT
/begin MEASUREMENT InjVCD_tiInjDurMi_mp "Ansteuerdauer der Haupteinspritzung" SLONG InjTime_us 1 100 -2147483648.00 2147483647.00 FORMAT "%13.2" ECU_ADDRESS 0x6F81C0 /end MEASUREMENT
/begin MEASUREMENT InjVCD_tiInjDur_mp "Einspritztyp spezifische Ansteuerdauern" SLONG InjTime_us 1 100 -2147483648.00 2147483647.00 FORMAT "%13.2" ARRAY_SIZE 8 ECU_ADDRESS 0x6F81C4 /end MEASUREMENT
/begin MEASUREMENT InjVCD_tiMeasCycl "Abtastzeit der Aktormeßwerte" ULONG TimeDT 1 100 0.00 4294967295.00 FORMAT "%13.2" ECU_ADDRESS 0x7F9428 /end MEASUREMENT
/begin MEASUREMENT InjVCD_tiMeasCyclCyl "Periodendauer der Messung aktorspezifischer Werte" ULONG TimeDT 1 100 0.00 4294967295.00 FORMAT "%13.2" ARRAY_SIZE 8 ECU_ADDRESS 0x7F9804 /end MEASUREMENT
/begin MEASUREMENT InjVCD_tiMI1ETUnLim_mp "energising time of Main Injection1" SWORD InjTime_us 1 100 -32768.00 32767.00 FORMAT "%8.2" ECU_ADDRESS 0x6F8228 /end MEASUREMENT
/begin MEASUREMENT InjVCD_tiMI1ET_mp "Ansteuerdauer der Haupteinspritzung 1" SWORD InjTime_us 1 100 -32768.00 32767.00 FORMAT "%8.2" ECU_ADDRESS 0x6F822A /end MEASUREMENT
/begin MEASUREMENT InjVCD_tiMonActrThresLo_mp "Zeitdifferenz zwischen Ladevorgang und Meßzeitpunkt" SLONG InjTime_us 1 100 -2147483648.00 2147483647.00 FORMAT "%13.2" ARRAY_SIZE 8 ECU_ADDRESS 0x8FE9D4 /end MEASUREMENT
/begin MEASUREMENT InjVCD_tiMonChrgUp_mp "Aktorladezeit im Nachlauf für Kurzschlussunterscheidung" SWORD Time_Busy 1 100 -3276.800 3276.700 FORMAT "%8.3" ARRAY_SIZE 8 ECU_ADDRESS 0x8FEA10 /end MEASUREMENT
/begin MEASUREMENT InjVCD_tiMonShCirSort_mp "sortierte Aktorladezeiten" SWORD Time_Busy 1 100 -3276.800 3276.700 FORMAT "%8.3" ARRAY_SIZE 8 ECU_ADDRESS 0x8FEA20 /end MEASUREMENT
/begin MEASUREMENT InjVCD_tiPiI1ET_mp "Ansteuerdauer der Voreinspritzung 1" SWORD InjTime_us 1 100 -32768.00 32767.00 FORMAT "%8.2" ECU_ADDRESS 0x6F822C /end MEASUREMENT
/begin MEASUREMENT InjVCD_tiPiI1ZFCETCor_mp "Ansteuerdauerkorrektur der ZFC für Voreinspritzung 1 und jeden Zylinder" SWORD InjTime_us 1 100 -32768.00 32767.00 FORMAT "%8.2" ARRAY_SIZE 8 ECU_ADDRESS 0x6F8238 /end MEASUREMENT
/begin MEASUREMENT InjVCD_tiPiI2ET_mp "Ansteuerdauer der Voreinspritzung 2" SWORD InjTime_us 1 100 -32768.00 32767.00 FORMAT "%8.2" ECU_ADDRESS 0x6F8230 /end MEASUREMENT
/begin MEASUREMENT InjVCD_tiPiI2ZFCETCor_mp "Ansteuerdauerkorrektur der ZFC für Voreinspritzung 2 und jeden Zylinder" SWORD InjTime_us 1 100 -32768.00 32767.00 FORMAT "%8.2" ARRAY_SIZE 8 ECU_ADDRESS 0x6F8248 /end MEASUREMENT
/begin MEASUREMENT InjVCD_tiPiI3ZFCETCor_mp "Ansteuerdauerkorrektur der ZFC für Voreinspritzung 3 und jeden Zylinder" SWORD InjTime_us 1 100 -32768.00 32767.00 FORMAT "%8.2" ARRAY_SIZE 8 ECU_ADDRESS 0x6F8258 /end MEASUREMENT
/begin MEASUREMENT InjVCD_tiPoI1ET_mp "Ansteuerdauer Nacheinspritzung 1" SWORD InjTime_us 1 100 -32768.00 32767.00 FORMAT "%8.2" ECU_ADDRESS 0x6F8234 /end MEASUREMENT
/begin MEASUREMENT InjVCD_tiPoI2ET_mp "Ansteuerdauer der Nacheinspritzung 2" SWORD InjTime_us 1 100 -32768.00 32767.00 FORMAT "%8.2" ECU_ADDRESS 0x6F8236 /end MEASUREMENT
/begin MEASUREMENT InjVCD_tiPolarET_mp "Ansteuerdauer der Polarisierung" SWORD InjTime_us 1 100 -32768.00 32767.00 FORMAT "%8.2" ECU_ADDRESS 0x8FEA3C /end MEASUREMENT
/begin MEASUREMENT InjVCD_tiShiftAll_mp "Verschiebezeit aller Kollisionen" SLONG InjTime_us 1 100 -2147483648.00 2147483647.00 FORMAT "%13.2" ECU_ADDRESS 0x8FE9BC /end MEASUREMENT
/begin MEASUREMENT InjVCD_tiShiftPrim_mp "Verschiebezeit der Primärkollision" SLONG InjTime_us 1 100 -2147483648.00 2147483647.00 FORMAT "%13.2" ECU_ADDRESS 0x8FE9C0 /end MEASUREMENT
/begin MEASUREMENT InjVCD_tiShiftScnd_mp "Verschiebezeit der Sekundärkollision" SLONG InjTime_us 1 100 -2147483648.00 2147483647.00 FORMAT "%13.2" ECU_ADDRESS 0x8FE9C4 /end MEASUREMENT
/begin MEASUREMENT InjVCD_tiUpOri_mp "Busy-Zeit des CY370 - Einspritzbeginn-Typ  0:VE2, 1:VE1, 2:HE, 3:NE" SWORD Time_Busy 1 100 -3276.800 3276.700 FORMAT "%8.3" ARRAY_SIZE 8 ECU_ADDRESS 0x6F81E4 /end MEASUREMENT
/begin MEASUREMENT InjVCD_tiZFCPiI1ETCor_mp "ZFC Ansteuerdauerkorrektur fuer Voreinspritzung 1" SWORD InjTime_us 1 100 -32768.00 32767.00 FORMAT "%8.2" ECU_ADDRESS 0x6F822E /end MEASUREMENT
/begin MEASUREMENT InjVCD_tiZFCPiI2ETCor_mp "ZFC Ansteuerdauerkorrektur fuer Voreinspritzung 2" SWORD InjTime_us 1 100 -32768.00 32767.00 FORMAT "%8.2" ECU_ADDRESS 0x6F8232 /end MEASUREMENT
/begin MEASUREMENT InjVCD_tPolar_mp "Kühlmitteltemperatur zum Zeitpunkt der Polarisierung" SWORD Temp_Cels 1 100 -50.140 899.860 FORMAT "%8.3" ECU_ADDRESS 0x8FEA3E /end MEASUREMENT
/begin MEASUREMENT InjVCD_uBottActr "Spannung - Bottom Position - Ventil geschlossen" SWORD Volt_PA 1 100 -327.6800 327.6700 FORMAT "%8.4" ARRAY_SIZE 8 ECU_ADDRESS 0x7F9684 /end MEASUREMENT
/begin MEASUREMENT InjVCD_uBuf "Wert der Bufferspannung" SWORD Volt_BUFC 1 100 -327.6800 327.6700 FORMAT "%8.4" ECU_ADDRESS 0x7F9012 /end MEASUREMENT
/begin MEASUREMENT InjVCD_uBufC "Bufferspannung" SWORD Volt_BUFC 1 100 -327.6800 327.6700 FORMAT "%8.4" ARRAY_SIZE 1 ECU_ADDRESS 0x7F9014 /end MEASUREMENT
/begin MEASUREMENT InjVCD_uBufRawLast_mp "Rohwert Bufferspannung" SWORD Volt 1 100 -160156.4 160151.5 FORMAT "%8.1" ECU_ADDRESS 0x8FE9D0 /end MEASUREMENT
/begin MEASUREMENT InjVCD_uBufRaw_mp "Rohwert der Bufferspannung" SWORD Volt 1 100 -160156.4 160151.5 FORMAT "%8.1" ARRAY_SIZE 1 ECU_ADDRESS 0x8FE9D2 /end MEASUREMENT
/begin MEASUREMENT InjVCD_uChgUp_mp "Integrator-Ausgangsspannung nach dem Aktor-Laden" SWORD Volt 1 100 -160156.4 160151.5 FORMAT "%8.1" ECU_ADDRESS 0x8FE8E0 /end MEASUREMENT
/begin MEASUREMENT InjVCD_uClsBegin_mp "Aktorspezifisch gemessene Beginnspannung während der Piezoaktor Klassifizierung" SWORD Volt_PA 1 100 -327.6800 327.6700 FORMAT "%8.4" ARRAY_SIZE 8 ECU_ADDRESS 0x8FE946 /end MEASUREMENT
/begin MEASUREMENT InjVCD_uClsEnd_mp "Aktorspezifisch gemessene Endspannung während der Piezoaktor Klassifizierung" SWORD Volt_PA 1 100 -327.6800 327.6700 FORMAT "%8.4" ARRAY_SIZE 8 ECU_ADDRESS 0x8FE956 /end MEASUREMENT
/begin MEASUREMENT InjVCD_uCY370ChrgIntWp "Spannungs-Arbeitspunkt vom CY370-Integrator zur Ladungsberechnung" SWORD Volt 1 100 -160156.4 160151.5 FORMAT "%8.1" ECU_ADDRESS 0x7F9016 /end MEASUREMENT
/begin MEASUREMENT InjVCD_uCY370ChrgOff "Spannungsoffset vom CY370-Integrator zur Ladungsberechnung" SWORD VoltInt 1 100 -160.1564 160.1515 FORMAT "%8.4" ECU_ADDRESS 0x7F9018 /end MEASUREMENT
/begin MEASUREMENT InjVCD_uIntComp_mp "Kompensationsspannung für Abfall der Integrator-Ausgangsspannung" SWORD Volt 1 100 -160156.4 160151.5 FORMAT "%8.1" ECU_ADDRESS 0x8FE922 /end MEASUREMENT
/begin MEASUREMENT InjVCD_uMonThresHi_mp "Schwelle fuer Spannungsplausibilisierung, Verletzung oben (index : 0=BOTT, 1=UP)" SWORD Volt_PA 1 100 -327.6800 327.6700 FORMAT "%8.4" ARRAY_SIZE 2 ECU_ADDRESS 0x8FE9F4 /end MEASUREMENT
/begin MEASUREMENT InjVCD_uMonThresLo_mp "Schwelle fuer Spannungsplausibilisierung, Verletzung unten (index : 0=BOTT, 1=UP)" SWORD Volt_PA 1 100 -327.6800 327.6700 FORMAT "%8.4" ARRAY_SIZE 2 ECU_ADDRESS 0x8FE9F8 /end MEASUREMENT
/begin MEASUREMENT InjVCD_uPolarBott_mp "Bottom-Niveau der Aktorspannung für die Polarisierung" SWORD Volt_PA 1 100 -327.6800 327.6700 FORMAT "%8.4" ECU_ADDRESS 0x8FEA40 /end MEASUREMENT
/begin MEASUREMENT InjVCD_uPolarUp_mp "Bottom-Niveau der Aktorspannung für die Polarisierung" SWORD Volt_PA 1 100 -327.6800 327.6700 FORMAT "%8.4" ECU_ADDRESS 0x8FEA42 /end MEASUREMENT
/begin MEASUREMENT InjVCD_uRawBott_mp "Aktor - Rohspannung (ADC)  - Ansteuerende (Messreihe)" SWORD Volt 1 100 -160156.4 160151.5 FORMAT "%8.1" ECU_ADDRESS 0x8FE8E2 /end MEASUREMENT
/begin MEASUREMENT InjVCD_uRawChgUp_mp "Rohspannung vom Integrator für die Injektorladung zum UP Niveau" SWORD Volt 1 100 -160156.4 160151.5 FORMAT "%8.1" ECU_ADDRESS 0x8FE8E4 /end MEASUREMENT
/begin MEASUREMENT InjVCD_uRawCY370Int0_mp "gemessene Roh-Spannung von Integratorabgleich (für INCA)" SWORD Volt 1 100 -160156.4 160151.5 FORMAT "%8.1" ECU_ADDRESS 0x8FE968 /end MEASUREMENT
/begin MEASUREMENT InjVCD_uRawCY370Int_mp "gemessene Roh-Spannungen vom Integratorabgleich" SWORD Volt 1 100 -160156.4 160151.5 FORMAT "%8.1" ARRAY_SIZE 3 ECU_ADDRESS 0x8FE96A /end MEASUREMENT
/begin MEASUREMENT InjVCD_uRawUp_mp "Aktor - Rohspannung (ADC)  - Ansteuerbeginn (Messreihe)" SWORD Volt 1 100 -160156.4 160151.5 FORMAT "%8.1" ECU_ADDRESS 0x8FE8E6 /end MEASUREMENT
/begin MEASUREMENT InjVCD_uSetThresActr "verwendete Spannungsschwelle die bei letzter Aktormessung gültig war" SWORD Volt_PA 1 100 -327.6800 327.6700 FORMAT "%8.4" ARRAY_SIZE 8 ECU_ADDRESS 0x7F9694 /end MEASUREMENT
/begin MEASUREMENT InjVCD_uSetThresActr_mp "Eingabewert für InjVCD_wActrNom_CUR" SWORD Volt_PA 1 100 -327.6800 327.6700 FORMAT "%8.4" ECU_ADDRESS 0x8FE8FE /end MEASUREMENT
/begin MEASUREMENT InjVCD_uSetUpActr "Spannungssollwert für Regler" SWORD Volt_PA 1 100 -327.6800 327.6700 FORMAT "%8.4" ARRAY_SIZE 8 ECU_ADDRESS 0x7F96A4 /end MEASUREMENT
/begin MEASUREMENT InjVCD_uUpActr "Spannung - Up Position - Ventil geöffnet" SWORD Volt_PA 1 100 -327.6800 327.6700 FORMAT "%8.4" ARRAY_SIZE 8 ECU_ADDRESS 0x7F96B4 /end MEASUREMENT
/begin MEASUREMENT InjVCD_uValCY370Int_mp "linearisierte Spannungen von Integratorabgleich" SWORD Volt 1 100 -160156.4 160151.5 FORMAT "%8.1" ARRAY_SIZE 3 ECU_ADDRESS 0x8FE970 /end MEASUREMENT
/begin MEASUREMENT InjVCD_volInET_mp "Y-Eingang des Kennfeldes InjVCD_tiET_MAP auf dem Applikationswerkzeug" SWORD InjQntInj 1 100 -327.6800 327.6700 FORMAT "%8.4" ECU_ADDRESS 0x8FE9CA /end MEASUREMENT
/begin MEASUREMENT InjVCD_wActrDiff_mp "Differenz von Lade- und Entladeenergie des Piezo-Aktors (aktorspezifisch)" SWORD W_PA 1 100 -32768.00 32767.00 FORMAT "%8.2" ARRAY_SIZE 8 ECU_ADDRESS 0x6F81F8 /end MEASUREMENT
/begin MEASUREMENT InjVCD_wActrNomCorr_mp "Temeraturkorrigierter nominaler Energieverbrauch einer Piezo-Aktor Ansteuerung" SWORD W_PA 1 100 -32768.00 32767.00 FORMAT "%8.2" ARRAY_SIZE 8 ECU_ADDRESS 0x8FE900 /end MEASUREMENT
/begin MEASUREMENT InjVCD_wActrNom_mp "Nominaler, injektorseitiger Energieverbrauch einer Piezo-Aktor-Ansteuerung" SWORD W_PA 1 100 -32768.00 32767.00 FORMAT "%8.2" ARRAY_SIZE 8 ECU_ADDRESS 0x8FE910 /end MEASUREMENT
/begin MEASUREMENT InjVCD_wChrgActrRaw_mp "Aktueller Energieverbrauch beim Laden des Aktors (aktorspezifisch)" SWORD W_PA 1 100 -32768.00 32767.00 FORMAT "%8.2" ARRAY_SIZE 8 ECU_ADDRESS 0x6F8208 /end MEASUREMENT
/begin MEASUREMENT InjVCD_wDisChActrRaw_mp "Aktuelle Energierückspeisung beim Entladen des Aktors (aktorspezifisch)" SWORD W_PA 1 100 -32768.00 32767.00 FORMAT "%8.2" ARRAY_SIZE 8 ECU_ADDRESS 0x6F8218 /end MEASUREMENT
/begin MEASUREMENT InjVlv_ctMonActrMeas "Zaehler für gemessene Aktoren" UBYTE OneToOne 1 100 0.00 255.0 FORMAT "%5.1" ECU_ADDRESS 0x7F894C /end MEASUREMENT
/begin MEASUREMENT InjVlv_ctMonQckIDiff_mp "Anzahl der IDiff-Fehler zur Schnell-Erkennung der Kurzschlüsse nach Batterie und Masse" UBYTE OneToOne 1 100 0.00 255.0 FORMAT "%5.1" ECU_ADDRESS 0x8FEACC /end MEASUREMENT
/begin MEASUREMENT InjVlv_ctMonQckISel_mp "Anzahl der ISel-Fehler zur Schnell-Erkennung der Kurzschlüsse nach Batterie und Masse" UBYTE OneToOne 1 100 0.00 255.0 FORMAT "%5.1" ECU_ADDRESS 0x8FEACD /end MEASUREMENT
/begin MEASUREMENT InjVlv_facAddBalRls "Ergebniss aus Freigabekennfeld zur Aufrechnung der Mengenkorrektur als Array (zylinderspezifisch)" SWORD Fact 1 100 -4.000000 3.999878 FORMAT "%8.6" ARRAY_SIZE 8 ECU_ADDRESS 0x7F96C4 /end MEASUREMENT
/begin MEASUREMENT InjVlv_facFTSWvCor "Faktor der Druckwellenkorrektur abhängig von der Kraftstofftemperatur" SWORD Fact 1 100 -4.000000 3.999878 FORMAT "%8.6" ECU_ADDRESS 0x7F901A /end MEASUREMENT
/begin MEASUREMENT InjVlv_facMI1PoI2WvCor_mp "Druckwellenkorrekturfaktor für PoI2" SWORD Fact1 1 100 -256.0000 255.9922 FORMAT "%8.4" ECU_ADDRESS 0x8FEB6E /end MEASUREMENT
/begin MEASUREMENT InjVlv_facNVCActr "NVC-Faktor" SWORD Fact 1 100 -4.000000 3.999878 FORMAT "%8.6" ARRAY_SIZE 8 ECU_ADDRESS 0x7F96D4 /end MEASUREMENT
/begin MEASUREMENT InjVlv_facNVCEepWrI_mp "Die I-Anteile der NVC-Regler, die im EEPROM-Spiegel geschrieben werden" SWORD Fact 1 100 -4.000000 3.999878 FORMAT "%8.6" ARRAY_SIZE 8 ECU_ADDRESS 0x8FEAF4 /end MEASUREMENT
/begin MEASUREMENT InjVlv_facNVCInitI_mp "Initialisierungswerte der I-Anteilen der NVC-Regler" SWORD Fact 1 100 -4.000000 3.999878 FORMAT "%8.6" ARRAY_SIZE 8 ECU_ADDRESS 0x8FEB04 /end MEASUREMENT
/begin MEASUREMENT InjVlv_facPCorQ_mp "mengenabhängiger Korrekturfaktor für Druckwellenkorrektur" SWORD Fact 1 100 -4.000000 3.999878 FORMAT "%8.6" ECU_ADDRESS 0x8FEA82 /end MEASUREMENT
/begin MEASUREMENT InjVlv_facPCorTi_mp "einspritzabstandsabhängiger Korrekturfaktor für Druckwellenkorrektur" SWORD Fact 1 100 -4.000000 3.999878 FORMAT "%8.6" ECU_ADDRESS 0x8FEA84 /end MEASUREMENT
/begin MEASUREMENT InjVlv_facPCor_mp "Korrekturfaktor für Druckwellenkorrektur" SWORD Fact 1 100 -4.000000 3.999878 FORMAT "%8.6" ECU_ADDRESS 0x8FEA86 /end MEASUREMENT
/begin MEASUREMENT InjVlv_facPiI2PiI1WvCor_mp "Druckwellenkorrekturfaktor der PiI1" SWORD Fact1 1 100 -256.0000 255.9922 FORMAT "%8.4" ECU_ADDRESS 0x8FEB70 /end MEASUREMENT
/begin MEASUREMENT InjVlv_facPiIMI1WvCor_mp "Druckwellenkorrekturfaktor der MI1" SWORD Fact1 1 100 -256.0000 255.9922 FORMAT "%8.4" ECU_ADDRESS 0x8FEB72 /end MEASUREMENT
/begin MEASUREMENT InjVlv_facVoltCorUp "temperaturabhängiger Korrekturfaktor für Spannungssollwert" SWORD Fact 1 100 -4.000000 3.999878 FORMAT "%8.6" ECU_ADDRESS 0x7F901C /end MEASUREMENT
/begin MEASUREMENT InjVlv_iDCDC_mp "DCDC Strom" SWORD Curr 1 100 -32768.00 32767.00 FORMAT "%8.2" ECU_ADDRESS 0x8FEACA /end MEASUREMENT
/begin MEASUREMENT InjVlv_nCyl "Zylinderspezifische Drehzahl für alle Zylinder" SWORD EngN 1 100 -32768.00 32767.00 FORMAT "%8.2" ARRAY_SIZE 8 ECU_ADDRESS 0x7F96E4 /end MEASUREMENT
/begin MEASUREMENT InjVlv_numClsVltgAdjActr "zylinderspezifische ISA-Klasse" SWORD OneToOne 1 100 -32768.00 32767.00 FORMAT "%8.2" ARRAY_SIZE 8 ECU_ADDRESS 0x7F96F4 /end MEASUREMENT
/begin MEASUREMENT InjVlv_numCodeVltgAdj_mp "Injektorspannungsabgleich Codes" UBYTE ISA_Code 1 100 0.00 31.0000000000 FORMAT "%13.10" ARRAY_SIZE 8 ECU_ADDRESS 0x8FEB48 /end MEASUREMENT
/begin MEASUREMENT InjVlv_numIdxErrCyl1_mp "Indizes erkannter Muster für Zylinder 1" ULONG OneToOne 1 100 0.00 4294967295.00 FORMAT "%13.2" ECU_ADDRESS 0x8FEAD0 /end MEASUREMENT
/begin MEASUREMENT InjVlv_numIdxErrCyl2_mp "Indizes erkannter Muster für Zylinder 2" ULONG OneToOne 1 100 0.00 4294967295.00 FORMAT "%13.2" ECU_ADDRESS 0x8FEAD4 /end MEASUREMENT
/begin MEASUREMENT InjVlv_numIdxErrCyl3_mp "Indizes erkannter Muster für Zylinder 3" ULONG OneToOne 1 100 0.00 4294967295.00 FORMAT "%13.2" ECU_ADDRESS 0x8FEAD8 /end MEASUREMENT
/begin MEASUREMENT InjVlv_numIdxErrCyl4_mp "Indizes erkannter Muster für Zylinder 4" ULONG OneToOne 1 100 0.00 4294967295.00 FORMAT "%13.2" ECU_ADDRESS 0x8FEADC /end MEASUREMENT
/begin MEASUREMENT InjVlv_numIdxErrCyl5_mp "Indizes erkannter Muster für Zylinder 5" ULONG OneToOne 1 100 0.00 4294967295.00 FORMAT "%13.2" ECU_ADDRESS 0x8FEAE0 /end MEASUREMENT
/begin MEASUREMENT InjVlv_numIdxErrCyl6_mp "Indizes erkannter Muster für Zylinder 6" ULONG OneToOne 1 100 0.00 4294967295.00 FORMAT "%13.2" ECU_ADDRESS 0x8FEAE4 /end MEASUREMENT
/begin MEASUREMENT InjVlv_numIdxErrCyl7_mp "Indizes erkannter Muster für Zylinder 7" ULONG OneToOne 1 100 0.00 4294967295.00 FORMAT "%13.2" ECU_ADDRESS 0x8FEAE8 /end MEASUREMENT
/begin MEASUREMENT InjVlv_numIdxErrCyl8_mp "Indizes erkannter Muster für Zylinder 8" ULONG OneToOne 1 100 0.00 4294967295.00 FORMAT "%13.2" ECU_ADDRESS 0x8FEAEC /end MEASUREMENT
/begin MEASUREMENT InjVlv_numInjChrgBal_mp "Maximale Anzahl an Einspritzungen aufgrund der Ladungsbilanz des Boosterkondensators" UBYTE OneToOne 1 100 0.00 255.0 FORMAT "%5.1" ECU_ADDRESS 0x8FEAC8 /end MEASUREMENT
/begin MEASUREMENT InjVlv_pActInDiffHyd_mp "Aktueller Raildruck als Eingangswert für das Kennfeld InjVlv_tiDiffHydMAP" SWORD Pres_Rail 1 100 -3276.800 3276.700 FORMAT "%5.3" ECU_ADDRESS 0x8FEB60 /end MEASUREMENT
/begin MEASUREMENT InjVlv_pAct_mp "aktueller Raildruck ermittelt in InjVlv" SWORD Pres_Rail 1 100 -3276.800 3276.700 FORMAT "%5.3" ECU_ADDRESS 0x8FEB6C /end MEASUREMENT
/begin MEASUREMENT InjVlv_pCalcVolt "für die Aktorspannungsberechnung relevanter Raildruck" SWORD Pres_Rail 1 100 -3276.800 3276.700 FORMAT "%5.3" ECU_ADDRESS 0x7F901E /end MEASUREMENT
/begin MEASUREMENT InjVlv_pCorBase_mp "Raildruck-Korrekturgrundwert für Druckwellenkorrektur" SWORD Pres_Rail 1 100 -3276.800 3276.700 FORMAT "%5.3" ECU_ADDRESS 0x8FEA88 /end MEASUREMENT
/begin MEASUREMENT InjVlv_pPoI2WvCorOfsActr_mp "zyl. spezifischer Raildruck-Offset für Druckwellenkorrektur von PoI2" SWORD Pres_Rail 1 100 -3276.800 3276.700 FORMAT "%5.3" ARRAY_SIZE 8 ECU_ADDRESS 0x8FEA8A /end MEASUREMENT
/begin MEASUREMENT InjVlv_pRailCorPoI2Actr_mp "zyl. spezifischer druckwellenkorrigierter Raildruck für PoI2" SWORD Pres_Rail 1 100 -3276.800 3276.700 FORMAT "%5.3" ARRAY_SIZE 8 ECU_ADDRESS 0x8FEA9A /end MEASUREMENT
/begin MEASUREMENT InjVlv_pwrInjAvrg_mp "durchschnittliche Ansteuer-Verlustleistung bei einer Ansteuerung pro Zylinder und Arbeitshub" SWORD Pwr_PA 1 100 -32768.00 32767.00 FORMAT "%8.2" ECU_ADDRESS 0x8FEAC0 /end MEASUREMENT
/begin MEASUREMENT InjVlv_qDesInDiffHyd_mp "Gewünschte Einspritzmenge als Eingangswert für das Kennfeld InjVlv_tiDiffHydMAP" SWORD InjMassInj 1 100 -327.6800 327.6700 FORMAT "%8.4" ECU_ADDRESS 0x8FEB62 /end MEASUREMENT
/begin MEASUREMENT InjVlv_qDes_mp "Einspritzmenge für Druckwellenkorrektur" SWORD InjMassInj 1 100 -327.6800 327.6700 FORMAT "%8.4" ECU_ADDRESS 0x8FEAAA /end MEASUREMENT
/begin MEASUREMENT InjVlv_qFBCCyl "Zylinderselektive FBC-Mengenkorrektur für alle Zylinder" SWORD InjMass 1 100 -327.6800 327.6700 FORMAT "%8.4" ARRAY_SIZE 8 ECU_ADDRESS 0x7F9704 /end MEASUREMENT
/begin MEASUREMENT InjVlv_qMI1Bal_mp "Korrekturmenge Haupteinspritzung 1" SWORD InjMassInj 1 100 -327.6800 327.6700 FORMAT "%8.4" ECU_ADDRESS 0x8FEA74 /end MEASUREMENT
/begin MEASUREMENT InjVlv_qMI1PoI2WvCor_mp "Grundwert der Druckwellenkorrekturmenge der PoI2" SWORD InjMassInj 1 100 -327.6800 327.6700 FORMAT "%8.4" ECU_ADDRESS 0x8FEB74 /end MEASUREMENT
/begin MEASUREMENT InjVlv_qMI1WvCor_mp "Druckwellenkorrekturmenge der MI1" SWORD InjMassInj 1 100 -327.6800 327.6700 FORMAT "%8.4" ECU_ADDRESS 0x8FEB76 /end MEASUREMENT
/begin MEASUREMENT InjVlv_qPiI1Bal_mp "Korrekturmenge Voreinspritzung 1" SWORD InjMassInj 1 100 -327.6800 327.6700 FORMAT "%8.4" ECU_ADDRESS 0x8FEA76 /end MEASUREMENT
/begin MEASUREMENT InjVlv_qPiI1MI1WvCor_mp "Grundwert der Druckwellenkorrekturmenge der MI1 abhängig von PiI1" SWORD InjMassInj 1 100 -327.6800 327.6700 FORMAT "%8.4" ECU_ADDRESS 0x8FEB78 /end MEASUREMENT
/begin MEASUREMENT InjVlv_qPiI1WvCor_mp "Druckwellenkorrekturmenge der PiI1" SWORD InjMassInj 1 100 -327.6800 327.6700 FORMAT "%8.4" ECU_ADDRESS 0x8FEB7A /end MEASUREMENT
/begin MEASUREMENT InjVlv_qPiI2Bal_mp "Korrekturmenge Voreinspritzung 2" SWORD InjMassInj 1 100 -327.6800 327.6700 FORMAT "%8.4" ECU_ADDRESS 0x8FEA78 /end MEASUREMENT
/begin MEASUREMENT InjVlv_qPiI2MI1WvCor_mp "Grundwert der Druckwellenkorrekturmenge der MI1 abhängig von PiI2" SWORD InjMassInj 1 100 -327.6800 327.6700 FORMAT "%8.4" ECU_ADDRESS 0x8FEB7C /end MEASUREMENT
/begin MEASUREMENT InjVlv_qPiI2PiI1WvCor_mp "Grundwert der Druckwellenkorrekturmenge der PiI1" SWORD InjMassInj 1 100 -327.6800 327.6700 FORMAT "%8.4" ECU_ADDRESS 0x8FEB7E /end MEASUREMENT
/begin MEASUREMENT InjVlv_qPiI3Bal_mp "Korrekturmenge Voreinspritzung 3" SWORD InjMassInj 1 100 -327.6800 327.6700 FORMAT "%8.4" ECU_ADDRESS 0x8FEA7A /end MEASUREMENT
/begin MEASUREMENT InjVlv_qPoI1Bal_mp "Korrekturmenge Nacheinspritzung 1" SWORD InjMassInj 1 100 -327.6800 327.6700 FORMAT "%8.4" ECU_ADDRESS 0x8FEA7C /end MEASUREMENT
/begin MEASUREMENT InjVlv_qPoI2BalEff_mp "Korrekturmenge für Nacheinspritzung 2, Moment bildender Teil" SWORD InjMassInj 1 100 -327.6800 327.6700 FORMAT "%8.4" ECU_ADDRESS 0x8FEA7E /end MEASUREMENT
/begin MEASUREMENT InjVlv_qPoI2Bal_mp "Korrekturmenge Nacheinspritzung 2" SWORD InjMassInj 1 100 -327.6800 327.6700 FORMAT "%8.4" ECU_ADDRESS 0x8FEA80 /end MEASUREMENT
/begin MEASUREMENT InjVlv_qPoI2WvCor_mp "Druckwellenkorrekturmenge der PoI2" SWORD InjMassInj 1 100 -327.6800 327.6700 FORMAT "%8.4" ECU_ADDRESS 0x8FEB80 /end MEASUREMENT
/begin MEASUREMENT InjVlv_qWvCorNorm "Einspritznormierungsmenge" SWORD InjMassInj 1 100 -327.6800 327.6700 FORMAT "%8.4" ECU_ADDRESS 0x7F9020 /end MEASUREMENT
/begin MEASUREMENT InjVlv_rMI1WvCorNorm_mp "Raildruckabhängiges normiertes MI1 Einspritzverhältnis für Druckwellenkorrektur" SWORD QntR 1 100 -32.00000 31.99902 FORMAT "%8.5" ECU_ADDRESS 0x8FEB82 /end MEASUREMENT
/begin MEASUREMENT InjVlv_stAdj_mp "Zustand der Codes für den Injektorspannungsabgleich" UBYTE VltgAdj 1 100 0.00 8.00000000000 FORMAT "%13.11" ECU_ADDRESS 0x8FEB50 /end MEASUREMENT
/begin MEASUREMENT InjVlv_stCheckSumErrVltgAdj_mp "Ckecksummenfehler der Abgleichwerte" UBYTE OneToOne 1 100 0.00 255.0 FORMAT "%5.1" ECU_ADDRESS 0x8FEB51 /end MEASUREMENT
/begin MEASUREMENT InjVlv_stCoInit "Zustand des piezospezifischen Initialisierungskoordinators" UBYTE OneToOne 1 100 0.00 255.0 FORMAT "%5.1" ECU_ADDRESS 0x7F894D /end MEASUREMENT
/begin MEASUREMENT InjVlv_stErrClctCyl1 "gesammelte Fehlermeldungen für Zylinder 1" ULONG OneToOne 1 100 0.00 4294967295.00 FORMAT "%13.2" ECU_ADDRESS 0x7F942C /end MEASUREMENT
/begin MEASUREMENT InjVlv_stErrClctCyl2 "gesammelte Fehlermeldungen für Zylinder 2" ULONG OneToOne 1 100 0.00 4294967295.00 FORMAT "%13.2" ECU_ADDRESS 0x7F9430 /end MEASUREMENT
/begin MEASUREMENT InjVlv_stErrClctCyl3 "gesammelte Fehlermeldungen für Zylinder 3" ULONG OneToOne 1 100 0.00 4294967295.00 FORMAT "%13.2" ECU_ADDRESS 0x7F9434 /end MEASUREMENT
/begin MEASUREMENT InjVlv_stErrClctCyl4 "gesammelte Fehlermeldungen für Zylinder 4" ULONG OneToOne 1 100 0.00 4294967295.00 FORMAT "%13.2" ECU_ADDRESS 0x7F9438 /end MEASUREMENT
/begin MEASUREMENT InjVlv_stErrClctCyl5 "gesammelte Fehlermeldungen für Zylinder 5" ULONG OneToOne 1 100 0.00 4294967295.00 FORMAT "%13.2" ECU_ADDRESS 0x7F943C /end MEASUREMENT
/begin MEASUREMENT InjVlv_stErrClctCyl6 "gesammelte Fehlermeldungen für Zylinder 6" ULONG OneToOne 1 100 0.00 4294967295.00 FORMAT "%13.2" ECU_ADDRESS 0x7F9440 /end MEASUREMENT
/begin MEASUREMENT InjVlv_stErrClctCyl7 "gesammelte Fehlermeldungen für Zylinder 7" ULONG OneToOne 1 100 0.00 4294967295.00 FORMAT "%13.2" ECU_ADDRESS 0x7F9444 /end MEASUREMENT
/begin MEASUREMENT InjVlv_stErrClctCyl8 "gesammelte Fehlermeldungen für Zylinder 8" ULONG OneToOne 1 100 0.00 4294967295.00 FORMAT "%13.2" ECU_ADDRESS 0x7F9448 /end MEASUREMENT
/begin MEASUREMENT InjVlv_stErrUnknown_mp "Fehlermuster des letzten nicht klassifizierbaren Fehlers" ULONG OneToOne 1 100 0.00 4294967295.00 FORMAT "%13.2" ECU_ADDRESS 0x8FEAF0 /end MEASUREMENT
/begin MEASUREMENT InjVlv_stInjValve "Zustand des Einspritzventils" UBYTE OneToOne 1 100 0.00 255.0 FORMAT "%5.1" ECU_ADDRESS 0x7F894E /end MEASUREMENT
/begin MEASUREMENT InjVlv_stMaxErrVltgAdj_mp "Aktorspezifischer Maximum Fehler im Code für den Injektorspannungsabgleich" UBYTE OneToOne 1 100 0.00 255.0 FORMAT "%5.1" ECU_ADDRESS 0x8FEB52 /end MEASUREMENT
/begin MEASUREMENT InjVlv_stMonDiag "Zustand Diagnose (0 : gesperrt, 1 : freigegeben)" UBYTE OneToOne 1 100 0.00 255.0 FORMAT "%5.1" ECU_ADDRESS 0x7F894F /end MEASUREMENT
/begin MEASUREMENT InjVlv_stMonQckErr_mp "Status der Schnell-Erkennung der Kurzschlüsse nach Batterie und Masse" UBYTE OneToOne 1 100 0.00 255.0 FORMAT "%5.1" ECU_ADDRESS 0x8FEACE /end MEASUREMENT
/begin MEASUREMENT InjVlv_stNVCCrit_mp "Statusanzeige der Kriterien für die Freigabe der NVC" UBYTE OneToOne 1 100 0.00 255.0 FORMAT "%5.1" ECU_ADDRESS 0x8FEB14 /end MEASUREMENT
/begin MEASUREMENT InjVlv_stNVCEna "zylinderspezifische Anzeige, ob die NVC aktiv ist" UBYTE OneToOne 1 100 0.00 255.0 FORMAT "%5.1" ECU_ADDRESS 0x7F8950 /end MEASUREMENT
/begin MEASUREMENT InjVlv_stNVCPI "Statusanzeige des NVC-Reglers" UBYTE OneToOne 1 100 0.00 255.0 FORMAT "%5.1" ARRAY_SIZE 8 ECU_ADDRESS 0x7F94EE /end MEASUREMENT
/begin MEASUREMENT InjVlv_stUSetStrt "Status: Sollspannungs-Umschaltung für Motorstart" UBYTE OneToOne 1 100 0.00 255.0 FORMAT "%5.1" ECU_ADDRESS 0x7F8951 /end MEASUREMENT
/begin MEASUREMENT InjVlv_stWvCor "Status der Druckwellenkorrektur" UBYTE OneToOne 1 100 0.00 255.0 FORMAT "%5.1" ECU_ADDRESS 0x7F8952 /end MEASUREMENT
/begin MEASUREMENT InjVlv_tActr_mp "Temperatur des Piezo-Aktors" SWORD Temp_Cels 1 100 -50.140 899.860 FORMAT "%8.3" ECU_ADDRESS 0x8FEAAC /end MEASUREMENT
/begin MEASUREMENT InjVlv_tiMI1DiffHydCor_mp "Differenz zwischen hydraulischem Nadelschliessende und elektrischem Ansteuerende des Injektors für die MI1" SWORD InjTime_us 1 100 -32768.00 32767.00 FORMAT "%8.2" ECU_ADDRESS 0x8FEB64 /end MEASUREMENT
/begin MEASUREMENT InjVlv_tiMI1PoI2Cor_mp "korrigierter Zeitabstand Ende MI1 bis Beginn PoI2" SWORD InjTime_us 1 100 -32768.00 32767.00 FORMAT "%8.2" ECU_ADDRESS 0x8FEB84 /end MEASUREMENT
/begin MEASUREMENT InjVlv_tiMI1PoI2HydCor_mp "hyd. korrigierter Zeitabstand Ende MI1 bis Beginn PoI2" SWORD InjTime_us 1 100 -32768.00 32767.00 FORMAT "%8.2" ECU_ADDRESS 0x8FEB86 /end MEASUREMENT
/begin MEASUREMENT InjVlv_tiMI1PoI2_mp "Zeitabstand ende MI1 bis Beginn PoI2" UWORD InjTime_us 1 100 0.00 65535.00 FORMAT "%8.2" ECU_ADDRESS 0x8FEB88 /end MEASUREMENT
/begin MEASUREMENT InjVlv_tiPiI1DiffHydCor_mp "Differenz zwischen hydraulischem Nadelschliessende und elektrischem Ansteuerende des Injektors für die PiI1" SWORD InjTime_us 1 100 -32768.00 32767.00 FORMAT "%8.2" ECU_ADDRESS 0x8FEB66 /end MEASUREMENT
/begin MEASUREMENT InjVlv_tiPiI1MI1Cor_mp "korrigierter Zeitabstand Ende PiI1 bis Beginn MI1" SWORD InjTime_us 1 100 -32768.00 32767.00 FORMAT "%8.2" ECU_ADDRESS 0x8FEB8A /end MEASUREMENT
/begin MEASUREMENT InjVlv_tiPiI1MI1_mp "korrigierter Zeitabstand Ende PiI1 bis Beginn MI1" UWORD InjTime_us 1 100 0.00 65535.00 FORMAT "%8.2" ECU_ADDRESS 0x8FEB8C /end MEASUREMENT
/begin MEASUREMENT InjVlv_tiPiI2DiffHydCor_mp "Differenz zwischen hydraulischem Nadelschliessende und elektrischem Ansteuerende des Injektors für die PiI2" SWORD InjTime_us 1 100 -32768.00 32767.00 FORMAT "%8.2" ECU_ADDRESS 0x8FEB68 /end MEASUREMENT
/begin MEASUREMENT InjVlv_tiPiI2MI1Cor_mp "korrigierter Zeitabstand Ende PiI2 bis Beginn MI1" SWORD InjTime_us 1 100 -32768.00 32767.00 FORMAT "%8.2" ECU_ADDRESS 0x8FEB8E /end MEASUREMENT
/begin MEASUREMENT InjVlv_tiPiI2MI1_mp "Zeitabstand Ende PiI2 bis Beginn MI1" UWORD InjTime_us 1 100 0.00 65535.00 FORMAT "%8.2" ECU_ADDRESS 0x8FEB90 /end MEASUREMENT
/begin MEASUREMENT InjVlv_tiPiI2PiI1Cor_mp "korrigierter Zeitabstand Ende PiI2 bis Beginn PiI1" SWORD InjTime_us 1 100 -32768.00 32767.00 FORMAT "%8.2" ECU_ADDRESS 0x8FEB92 /end MEASUREMENT
/begin MEASUREMENT InjVlv_tiPiI2PiI1_mp "Zeitabstand Ende PiI2 bis Beginn PiI1" UWORD InjTime_us 1 100 0.00 65535.00 FORMAT "%8.2" ECU_ADDRESS 0x8FEB94 /end MEASUREMENT
/begin MEASUREMENT InjVlv_tWvCor_mp "Eingangstemperatur fuer die Druckwellenkorrektur" SWORD Temp_Cels 1 100 -50.140 899.860 FORMAT "%8.3" ECU_ADDRESS 0x8FEB6A /end MEASUREMENT
/begin MEASUREMENT InjVlv_uDiffNVCActrInPI_mp "Eingangswert der NVC-Reglers" SWORD Volt_PA 1 100 -327.6800 327.6700 FORMAT "%8.4" ARRAY_SIZE 8 ECU_ADDRESS 0x8FEB16 /end MEASUREMENT
/begin MEASUREMENT InjVlv_uDiffNVCActr_mp "aktuelle Spannungsdifferenz" SWORD Volt_PA 1 100 -327.6800 327.6700 FORMAT "%8.4" ARRAY_SIZE 8 ECU_ADDRESS 0x8FEB26 /end MEASUREMENT
/begin MEASUREMENT InjVlv_uDiffNVCSet_mp "Spannungssolldifferenz" SWORD Volt_PA 1 100 -327.6800 327.6700 FORMAT "%8.4" ECU_ADDRESS 0x8FEB36 /end MEASUREMENT
/begin MEASUREMENT InjVlv_uOfsBand "Band aus Sollspannungswerten" SWORD Volt_PA 1 100 -327.6800 327.6700 FORMAT "%8.4" ARRAY_SIZE 11 ECU_ADDRESS 0x7F97B0 /end MEASUREMENT
/begin MEASUREMENT InjVlv_uSetBase_mp "Basiswert zur Ermittlung der Spannungsbänder" SWORD Volt_PA 1 100 -327.6800 327.6700 FORMAT "%8.4" ECU_ADDRESS 0x8FEABE /end MEASUREMENT
/begin MEASUREMENT InjVlv_uSetBott "Minimaler Spannungssollwert für Piezo-Aktor bottom-level" SWORD Volt_PA 1 100 -327.6800 327.6700 FORMAT "%8.4" ECU_ADDRESS 0x7F9022 /end MEASUREMENT
/begin MEASUREMENT InjVlv_uSetUpActr "Mittlerer zylinderspezifischer Spannungssollwert für Piezo-Aktor (up-level)" SWORD Volt_PA 1 100 -327.6800 327.6700 FORMAT "%8.4" ARRAY_SIZE 8 ECU_ADDRESS 0x7F9714 /end MEASUREMENT
/begin MEASUREMENT InjVlv_uSetUpActrPoI2_mp "zyl. spezifischer Piezoaktor-Spannungssollwert für PoI2 (Up-Niveau)" SWORD Volt_PA 1 100 -327.6800 327.6700 FORMAT "%8.4" ARRAY_SIZE 8 ECU_ADDRESS 0x8FEAAE /end MEASUREMENT
/begin MEASUREMENT InjVlv_uSetUpAvrg_mp "Gemittelter Spannungssollwert" SWORD Volt_PA 1 100 -327.6800 327.6700 FORMAT "%8.4" ECU_ADDRESS 0x8FEAC2 /end MEASUREMENT
/begin MEASUREMENT InjVlv_uSetUpNVCActr "Stellspannung nach der NVC" SWORD Volt_PA 1 100 -327.6800 327.6700 FORMAT "%8.4" ARRAY_SIZE 8 ECU_ADDRESS 0x7F9724 /end MEASUREMENT
/begin MEASUREMENT InjVlv_uSetUpNVCActrUnLim_mp "unbegrenzte Stellspannung nach der NVC" SWORD Volt_PA 1 100 -327.6800 327.6700 FORMAT "%8.4" ARRAY_SIZE 8 ECU_ADDRESS 0x8FEB38 /end MEASUREMENT
/begin MEASUREMENT InjVlv_uSetUpTiChrgActr "Spannungssollwert für Ladezeitberechnung" SWORD Volt_PA 1 100 -327.6800 327.6700 FORMAT "%8.4" ARRAY_SIZE 8 ECU_ADDRESS 0x7F9734 /end MEASUREMENT
/begin MEASUREMENT InjVlv_volMI1QntAdj_mp "Injektor-Abgleichmenge der Haupteinspritzung 1" SWORD InjQntInj 1 100 -327.6800 327.6700 FORMAT "%8.4" ECU_ADDRESS 0x8FEB54 /end MEASUREMENT
/begin MEASUREMENT InjVlv_volPiI1QntAdj_mp "Injektor-Abgleichmenge der Voreinspritzung 1" SWORD InjQntInj 1 100 -327.6800 327.6700 FORMAT "%8.4" ECU_ADDRESS 0x8FEB56 /end MEASUREMENT
/begin MEASUREMENT InjVlv_volPiI2QntAdj_mp "Injektor-Abgleichmenge der Voreinspritzung 2" SWORD InjQntInj 1 100 -327.6800 327.6700 FORMAT "%8.4" ECU_ADDRESS 0x8FEB58 /end MEASUREMENT
/begin MEASUREMENT InjVlv_volPiI3QntAdj_mp "Injektor-Abgleichmenge der Voreinspritzung 3" SWORD InjQntInj 1 100 -327.6800 327.6700 FORMAT "%8.4" ECU_ADDRESS 0x8FEB5A /end MEASUREMENT
/begin MEASUREMENT InjVlv_volPoI1QntAdj_mp "Injektor-Abgleichmenge der Nacheinspritzung 1" SWORD InjQntInj 1 100 -327.6800 327.6700 FORMAT "%8.4" ECU_ADDRESS 0x8FEB5C /end MEASUREMENT
/begin MEASUREMENT InjVlv_volPoI2QntAdj_mp "Injektor-Abgleichmenge der Nacheinspritzung 2" SWORD InjQntInj 1 100 -327.6800 327.6700 FORMAT "%8.4" ECU_ADDRESS 0x8FEB5E /end MEASUREMENT
/begin MEASUREMENT InjVlv_wInjCorr_mp "Korrigierter, bufferseitiger Energieverbrauch einer Piezo-Aktor-Ansteuerung" SWORD W_PA 1 100 -32768.00 32767.00 FORMAT "%8.2" ECU_ADDRESS 0x8FEAC4 /end MEASUREMENT
/begin MEASUREMENT InjVlv_wInjNom_mp "Nominaler, bufferseitiger Energieverbrauch einer Piezo-Aktor-Ansteuerung" SWORD W_PA 1 100 -32768.00 32767.00 FORMAT "%8.2" ECU_ADDRESS 0x8FEAC6 /end MEASUREMENT
/begin MEASUREMENT IVCtl_iChrgUp2_mp "Zweite obere Ladestromgrenze für Piezoaktor" SWORD Curr 1 100 -32768.00 32767.00 FORMAT "%8.2" ECU_ADDRESS 0x8FEB96 /end MEASUREMENT
/begin MEASUREMENT IVCtl_iChrgUpPI_mp "Reglerausgang des Ladezeitregler" SWORD Curr 1 100 -32768.00 32767.00 FORMAT "%8.2" ECU_ADDRESS 0x8FEB98 /end MEASUREMENT
/begin MEASUREMENT IVCtl_iChrgUp_mp "Obere Ladestromgrenze für Piezoaktor" SWORD Curr 1 100 -32768.00 32767.00 FORMAT "%8.2" ECU_ADDRESS 0x8FEB9A /end MEASUREMENT
/begin MEASUREMENT IVCtl_iDisChDwn "Untere Entladestromgrenze für Piezoaktor" SWORD Curr 1 100 -32768.00 32767.00 FORMAT "%8.2" ECU_ADDRESS 0x7F8EB8 /end MEASUREMENT
/begin MEASUREMENT IVCtl_iDisChDwn2 "Zweite untere Entladestromgrenze für Piezoaktor" SWORD Curr 1 100 -32768.00 32767.00 FORMAT "%8.2" ECU_ADDRESS 0x7F8EBA /end MEASUREMENT
/begin MEASUREMENT IVCtl_iDisChDwnPI_mp "Ausgang des Entladezeitreglers" SWORD Curr 1 100 -32768.00 32767.00 FORMAT "%8.2" ECU_ADDRESS 0x8FEB9C /end MEASUREMENT
/begin MEASUREMENT IVCtl_stAvrgEnaTiWarnVolt_mp "Status: zu geringe Zeitdifferenz Laden-Entladen für Spannungsregler" UBYTE OneToOne 1 100 0.00 255.0 FORMAT "%5.1" ECU_ADDRESS 0x8FEC16 /end MEASUREMENT
/begin MEASUREMENT IVCtl_stTiChrgPI "Status: Ladezeitregler eingefroren" UBYTE OneToOne 1 100 0.00 255.0 FORMAT "%5.1" ECU_ADDRESS 0x7F8918 /end MEASUREMENT
/begin MEASUREMENT IVCtl_stVoltPI "Status des PI-Reglers der Aktorspannungsregelung" UBYTE OneToOne 1 100 0.00 255.0 FORMAT "%5.1" ECU_ADDRESS 0x7F8919 /end MEASUREMENT
/begin MEASUREMENT IVCtl_tiChrgSetUp_mp "Ladezeit Sollwert" SWORD Time_Busy 1 100 -3276.800 3276.700 FORMAT "%8.3" ECU_ADDRESS 0x8FEB9E /end MEASUREMENT
/begin MEASUREMENT IVCtl_tiChrgUpAvrg_mp "Mittelwert der gemessenen Ladezeiten" SWORD Time_Busy 1 100 -3276.800 3276.700 FORMAT "%8.3" ECU_ADDRESS 0x8FEBA0 /end MEASUREMENT
/begin MEASUREMENT IVCtl_tiChrgUpInPI "Eingangsgröße des Ladezeitreglers" SWORD Time_Busy 1 100 -3276.800 3276.700 FORMAT "%8.3" ECU_ADDRESS 0x7F8EBC /end MEASUREMENT
/begin MEASUREMENT IVCtl_tiChrgUpInPIActr_mp "Regelabweichung der Ladezeit (aktorspezifisch)" SWORD Time_Busy 1 100 -3276.800 3276.700 FORMAT "%8.3" ARRAY_SIZE 8 ECU_ADDRESS 0x8FEBA2 /end MEASUREMENT
/begin MEASUREMENT IVCtl_tiChrgUpMaxActr_mp "Maximale Regelabweichung der Ladezeit (aktorspezifisch)" SWORD Time_Busy 1 100 -3276.800 3276.700 FORMAT "%8.3" ARRAY_SIZE 8 ECU_ADDRESS 0x8FEBB2 /end MEASUREMENT
/begin MEASUREMENT IVCtl_tiChrgUpMax_mp "Maximale Regelabweichung der Ladezeit (gemittelt)" SWORD Time_Busy 1 100 -3276.800 3276.700 FORMAT "%8.3" ECU_ADDRESS 0x8FEBC2 /end MEASUREMENT
/begin MEASUREMENT IVCtl_tiChrgUpMinActr_mp "Minimale Regelabweichung der Ladezeit (aktorspezifisch)" SWORD Time_Busy 1 100 -3276.800 3276.700 FORMAT "%8.3" ARRAY_SIZE 8 ECU_ADDRESS 0x8FEBC4 /end MEASUREMENT
/begin MEASUREMENT IVCtl_tiChrgUpMin_mp "Minimale Regelabweichung der Ladezeit (gemittelt)" SWORD Time_Busy 1 100 -3276.800 3276.700 FORMAT "%8.3" ECU_ADDRESS 0x8FEBD4 /end MEASUREMENT
/begin MEASUREMENT IVCtl_tiChrgUpPse_mp "Pausezeit für Ladezeitregler" SWORD Time_Busy 1 100 -3276.800 3276.700 FORMAT "%8.3" ECU_ADDRESS 0x8FEBD6 /end MEASUREMENT
/begin MEASUREMENT IVCtl_tiDisChBottAvrg_mp "Mittelwert der gemessenen Entladezeiten" SWORD Time_Busy 1 100 -3276.800 3276.700 FORMAT "%8.3" ECU_ADDRESS 0x8FEBD8 /end MEASUREMENT
/begin MEASUREMENT IVCtl_tiDisChDwnInPI "Eingangsgröße des Entladezeitreglers" SWORD Time_Busy 1 100 -3276.800 3276.700 FORMAT "%8.3" ECU_ADDRESS 0x7F8EBE /end MEASUREMENT
/begin MEASUREMENT IVCtl_tiDisChDwnInPIActr_mp "Regelabweichung der Entladezeit (zylinderspezifisch)" SWORD Time_Busy 1 100 -3276.800 3276.700 FORMAT "%8.3" ARRAY_SIZE 8 ECU_ADDRESS 0x8FEBDA /end MEASUREMENT
/begin MEASUREMENT IVCtl_tiDisChDwnMaxActr_mp "Maximale Regelabweichung der Entladezeit (aktorspezifisch)" SWORD Time_Busy 1 100 -3276.800 3276.700 FORMAT "%8.3" ARRAY_SIZE 8 ECU_ADDRESS 0x8FEBEA /end MEASUREMENT
/begin MEASUREMENT IVCtl_tiDisChDwnMax_mp "Maximale Regelabweichung der Entladezeit (gemittelt)" SWORD Time_Busy 1 100 -3276.800 3276.700 FORMAT "%8.3" ECU_ADDRESS 0x8FEBFA /end MEASUREMENT
/begin MEASUREMENT IVCtl_tiDisChDwnMinActr_mp "Minimale Regelabweichung der Entladezeit (aktorspezifisch)" SWORD Time_Busy 1 100 -3276.800 3276.700 FORMAT "%8.3" ARRAY_SIZE 8 ECU_ADDRESS 0x8FEBFC /end MEASUREMENT
/begin MEASUREMENT IVCtl_tiDisChDwnMin_mp "Minimale Regelabweichung der Entlladezeit (gemittelt)" SWORD Time_Busy 1 100 -3276.800 3276.700 FORMAT "%8.3" ECU_ADDRESS 0x8FEC0C /end MEASUREMENT
/begin MEASUREMENT IVCtl_tiDisChDwnPse_mp "Pausezeit für Entladezeitregler" SWORD Time_Busy 1 100 -3276.800 3276.700 FORMAT "%8.3" ECU_ADDRESS 0x8FEC0E /end MEASUREMENT
/begin MEASUREMENT IVCtl_tiDisChSetDwn_mp "Ausgang von IVCtl_tiDisChSetDwn_CUR" SWORD Time_Busy 1 100 -3276.800 3276.700 FORMAT "%8.3" ECU_ADDRESS 0x8FEC10 /end MEASUREMENT
/begin MEASUREMENT IVCtl_uClsActrUp "Spannungssollwert für Aktorklassifizierung" SWORD Volt_PA 1 100 -327.6800 327.6700 FORMAT "%8.4" ECU_ADDRESS 0x7F8EC0 /end MEASUREMENT
/begin MEASUREMENT IVCtl_uCorrUp "Reglerausgang zur Korrektur der Aktorspannung" SWORD Volt_PA 1 100 -327.6800 327.6700 FORMAT "%8.4" ECU_ADDRESS 0x7F8EC2 /end MEASUREMENT
/begin MEASUREMENT IVCtl_uSetBott "Spannungssollwert für Bottom-Level" SWORD Volt_PA 1 100 -327.6800 327.6700 FORMAT "%8.4" ECU_ADDRESS 0x7F8EC4 /end MEASUREMENT
/begin MEASUREMENT IVCtl_uSetOfsActr "Spannungssollwert fuer Spannungsoffsetberechnung" SWORD Volt_PA 1 100 -327.6800 327.6700 FORMAT "%8.4" ARRAY_SIZE 8 ECU_ADDRESS 0x7F9554 /end MEASUREMENT
/begin MEASUREMENT IVCtl_uSetUp2Avrg_mp "Piezoaktorspannung gemittelt (Differenz Bottom zu Up Niveau minus Offset)" SWORD Volt_PA 1 100 -327.6800 327.6700 FORMAT "%8.4" ECU_ADDRESS 0x8FEC12 /end MEASUREMENT
/begin MEASUREMENT IVCtl_uSetUpActr "Korrigierter aktorspezifischer Spannungssollwert für Piezoaktor (Up-Niveau)" SWORD Volt_PA 1 100 -327.6800 327.6700 FORMAT "%8.4" ARRAY_SIZE 8 ECU_ADDRESS 0x7F9564 /end MEASUREMENT
/begin MEASUREMENT IVCtl_uSetUpActrUnCorr_mp "unkorrigierter Spannungssollwert (Up-Niveau)" SWORD Volt_PA 1 100 -327.6800 327.6700 FORMAT "%8.4" ARRAY_SIZE 8 ECU_ADDRESS 0x8FEC18 /end MEASUREMENT
/begin MEASUREMENT IVCtl_uSetUpActrUnLim_mp "Nicht begrenzter, korrigierter, mittlerer, aktorspezifischer Spannungssollwert für Piezo-Aktor (Up-Niveau)" SWORD Volt_PA 1 100 -327.6800 327.6700 FORMAT "%8.4" ARRAY_SIZE 8 ECU_ADDRESS 0x8FEC28 /end MEASUREMENT
/begin MEASUREMENT IVCtl_uSetUpAvrg_mp "Gemittelter Entladespannungshub" SWORD Volt_PA 1 100 -327.6800 327.6700 FORMAT "%8.4" ECU_ADDRESS 0x8FEC14 /end MEASUREMENT
/begin MEASUREMENT IVCtl_uSetUpPreCtl_mp "Vorsteuerwert für Spannungssollwertberechnung" SWORD Volt_PA 1 100 -327.6800 327.6700 FORMAT "%8.4" ECU_ADDRESS 0x8FEC38 /end MEASUREMENT
/begin MEASUREMENT IVCtl_uSetUpTmp_mp "Über alle Zylinder des Endstufenbausteins gemittelte Spannungssollwerte (Up-Niveau)" SWORD Volt_PA 1 100 -327.6800 327.6700 FORMAT "%8.4" ECU_ADDRESS 0x8FEC3A /end MEASUREMENT
/begin MEASUREMENT IVCtl_uUpInPI "Eingangsgröße der Spannungsreglers" SWORD Volt_PA 1 100 -327.6800 327.6700 FORMAT "%8.4" ECU_ADDRESS 0x7F8EC6 /end MEASUREMENT
/begin MEASUREMENT IVCtl_uUpInPIActr_mp "Regelabweichung des Spannungsreglers (aktorspezifisch)" SWORD Volt_PA 1 100 -327.6800 327.6700 FORMAT "%8.4" ARRAY_SIZE 8 ECU_ADDRESS 0x8FEC3C /end MEASUREMENT
/begin MEASUREMENT IVCtl_uUpInPIMaxActr_mp "Maximale Regelabweichung des Spannungsreglers (aktorspezifisch)" SWORD Volt_PA 1 100 -327.6800 327.6700 FORMAT "%8.4" ARRAY_SIZE 8 ECU_ADDRESS 0x8FEC4C /end MEASUREMENT
/begin MEASUREMENT IVCtl_uUpInPIMax_mp "Maximale Regelabweichung des Spannungsreglers (Endstufenbaustein-spezifisch)" SWORD Volt_PA 1 100 -327.6800 327.6700 FORMAT "%8.4" ECU_ADDRESS 0x8FEC5C /end MEASUREMENT
/begin MEASUREMENT IVCtl_uUpInPIMinActr_mp "Minimale Regelabweichung des Spannungsreglers (aktorspezifisch)" SWORD Volt_PA 1 100 -327.6800 327.6700 FORMAT "%8.4" ARRAY_SIZE 8 ECU_ADDRESS 0x8FEC5E /end MEASUREMENT
/begin MEASUREMENT IVCtl_uUpInPIMin_mp "Minimale Regelabweichung des Spannungsreglers (Endstufenbaustein-spezifisch)" SWORD Volt_PA 1 100 -327.6800 327.6700 FORMAT "%8.4" ECU_ADDRESS 0x8FEC6E /end MEASUREMENT
/begin MEASUREMENT IVCtl_uUpTmp_mp "Gemittelte Spannungsistwerte des Piezoaktors (Up-Niveau)" SWORD Volt_PA 1 100 -327.6800 327.6700 FORMAT "%8.4" ECU_ADDRESS 0x8FEC70 /end MEASUREMENT
/begin FUNCTION injvcd_actr "Erfassung der Piezo-Aktordaten"
 /begin DEF_CHARACTERISTIC InjVCD_uChrgThrSRCLo_C InjVCD_uChrgThrSRCHi_C InjVCD_uChrgLin_CUR InjVCD_uActrThrSRCLo_C InjVCD_uActrThrSRCHi_C InjVCD_uActrLin_CUR InjVCD_chgMaxPlaus_C InjVCD_chgMinPlaus_C InjVCD_mskTpuErr_C InjVCD_nMonShCirDel_C InjVCD_numCylTestBench_C InjVCD_numMonShCirDel_C InjVCD_swtOvrMonShCirDel_C InjVCD_tiIntValid_C /end DEF_CHARACTERISTIC
 /begin OUT_MEASUREMENT InjVCD_facAmp_mp InjVCD_numOfsSelect_mp InjVCD_stMonShCirDel_mp InjVCD_tiInjDurMi_mp InjVCD_tiInjDur_mp InjVCD_tiUpOri_mp InjVCD_uChgUp_mp InjVCD_uRawBott_mp InjVCD_uRawChgUp_mp InjVCD_uRawUp_mp /end OUT_MEASUREMENT
/end FUNCTION
/begin FUNCTION injvcd_actrenrg "Berechnung des aktorspezifischen Energiebedarfs"
 /begin DEF_CHARACTERISTIC InjVCD_DebActrEnrgDef_C InjVCD_DebActrEnrgOK_C InjVCD_facWActrChrgCorr_C InjVCD_facWActrCorr_C InjVCD_facWActrDisChCorr_C InjVCD_facWActrDvtMax_C InjVCD_facWActrDvtMin_C InjVCD_facWActrMax_C InjVCD_facWActrMin_C InjVCD_facWActrTemp_CUR InjVCD_numFacWValidMin_C InjVCD_swtEnaWActrCorr_C InjVCD_tActrEnrgDfl_C InjVCD_wActrChrgDfl_C InjVCD_wActrDisChDfl_C InjVCD_wActrNom_CUR InjVCD_wActrPlausMax_C InjVCD_wActrPlausMin_C /end DEF_CHARACTERISTIC
 /begin OUT_MEASUREMENT InjVCD_facWActrDvtActr_mp InjVCD_facWActrDvtCurr_mp InjVCD_facWActrTemp_mp InjVCD_numFacWValid_mp InjVCD_tActrEnrg_mp InjVCD_uSetThresActr_mp InjVCD_wActrDiff_mp InjVCD_wActrNomCorr_mp InjVCD_wActrNom_mp InjVCD_wChrgActrRaw_mp InjVCD_wDisChActrRaw_mp /end OUT_MEASUREMENT
/end FUNCTION
/begin FUNCTION injvcd_actrenrg_msg "" /begin OUT_MEASUREMENT InjVCD_facWActrDvtAvrg InjVCD_stActrEnrg /end OUT_MEASUREMENT /end FUNCTION
/begin FUNCTION injvcd_actrtemp "Berechnung der Piezoaktortemperatur"
 /begin DEF_CHARACTERISTIC InjVCD_swtSelTempVal_C InjVCD_swtSelTempType_C InjVCD_tActrDfl_C InjVCD_tActr_CUR /end DEF_CHARACTERISTIC
 /begin OUT_MEASUREMENT InjVCD_tActr_mp /end OUT_MEASUREMENT
/end FUNCTION
/begin FUNCTION injvcd_actrtemp_msg "" /begin OUT_MEASUREMENT InjVCD_swtSelTemp InjVCD_tActr /end OUT_MEASUREMENT /end FUNCTION
/begin FUNCTION injvcd_actr_msg ""
 /begin OUT_MEASUREMENT InjVCD_chgUpActrCurr InjVCD_cUpActrCurr InjVCD_cUpActrOld InjVCD_numHandle InjVCD_numMeas InjVCD_pActInj InjVCD_stAvrgEna InjVCD_stAvrgEnaTiWarn InjVCD_stCalcChrgActr InjVCD_stMeas InjVCD_stMeasLvl InjVCD_stMeasLvlFirst InjVCD_stMonChgActr InjVCD_stMonTiPlaus InjVCD_stMonUBnkPlaus InjVCD_stMonUCylPlaus InjVCD_tiChrgUpActr InjVCD_tiChrgUpActrOld InjVCD_tiDisChBottActr InjVCD_tiMeasCycl InjVCD_tiMeasCyclCyl InjVCD_uBottActr InjVCD_uSetThresActr InjVCD_uSetUpActr InjVCD_uUpActr /end OUT_MEASUREMENT
/end FUNCTION
/begin FUNCTION injvcd_calcmi1et "Einspritzsspezifische Berechnung der Injektoransteuerdauer der ersten Haupteinspritzung" /begin DEF_CHARACTERISTIC InjVCD_nETMaxLim_C InjVCD_tiETMax_C /end DEF_CHARACTERISTIC /end FUNCTION
/begin FUNCTION injvcd_calcmi1et_uic "" /begin DEF_CHARACTERISTIC InjVCD_tiMI1ET_Vector InjVCD_tiMI1ET_Channel /end DEF_CHARACTERISTIC /begin OUT_MEASUREMENT InjVCD_tiMI1ETUnLim_mp InjVCD_tiMI1ET_mp /end OUT_MEASUREMENT /end FUNCTION
/begin FUNCTION injvcd_calcpii1et "" /end FUNCTION
/begin FUNCTION injvcd_calcpii1et_uic "" /begin DEF_CHARACTERISTIC InjVCD_tiPiI1ET_Vector InjVCD_tiPiI1ET_Channel /end DEF_CHARACTERISTIC /begin OUT_MEASUREMENT InjVCD_tiPiI1ET_mp InjVCD_tiZFCPiI1ETCor_mp /end OUT_MEASUREMENT /end FUNCTION
/begin FUNCTION injvcd_calcpii2et "" /end FUNCTION
/begin FUNCTION injvcd_calcpii2et_uic "" /begin DEF_CHARACTERISTIC InjVCD_tiPiI2ET_Vector InjVCD_tiPiI2ET_Channel /end DEF_CHARACTERISTIC /begin OUT_MEASUREMENT InjVCD_tiPiI2ET_mp InjVCD_tiZFCPiI2ETCor_mp /end OUT_MEASUREMENT /end FUNCTION
/begin FUNCTION injvcd_calcpii3et "" /end FUNCTION
/begin FUNCTION injvcd_calcpii3et_uic "" /end FUNCTION
/begin FUNCTION injvcd_calcpoi1et "" /end FUNCTION
/begin FUNCTION injvcd_calcpoi1et_uic "" /begin DEF_CHARACTERISTIC InjVCD_tiPoI1ET_Vector InjVCD_tiPoI1ET_Channel /end DEF_CHARACTERISTIC /begin OUT_MEASUREMENT InjVCD_tiPoI1ET_mp /end OUT_MEASUREMENT /end FUNCTION
/begin FUNCTION injvcd_calcpoi2et "" /end FUNCTION
/begin FUNCTION injvcd_calcpoi2et_uic "" /begin DEF_CHARACTERISTIC InjVCD_tiPoI2ET_Vector InjVCD_tiPoI2ET_Channel /end DEF_CHARACTERISTIC /begin OUT_MEASUREMENT InjVCD_tiPoI2ET_mp /end OUT_MEASUREMENT /end FUNCTION
/begin FUNCTION injvcd_chrg "Berechnung der Aktor-Ladung" /begin DEF_CHARACTERISTIC InjVCD_duInt_C InjVCD_resCalcChrgShunt_C /end DEF_CHARACTERISTIC /begin OUT_MEASUREMENT InjVCD_uIntComp_mp /end OUT_MEASUREMENT /end FUNCTION
/begin FUNCTION injvcd_cls "Klassifizierung des Piezoaktuators"
 /begin DEF_CHARACTERISTIC InjVCD_nClsEng_C InjVCD_pClsRailMax_C InjVCD_rClsVoltMin_C InjVCD_tiClsLead_C InjVCD_tiClsMeasBeg_C InjVCD_tiClsMeasEnd_C InjVCD_tiClsMeasure_C /end DEF_CHARACTERISTIC
 /begin OUT_MEASUREMENT InjVCD_rClsVolt_mp InjVCD_stWaitPRailLow_mp InjVCD_uClsBegin_mp InjVCD_uClsEnd_mp /end OUT_MEASUREMENT
/end FUNCTION
/begin FUNCTION injvcd_cls_msg "" /begin OUT_MEASUREMENT InjVCD_stClsActr InjVCD_swtClsActr /end OUT_MEASUREMENT /end FUNCTION
/begin FUNCTION injvcd_cy370 "spezielle Funktionen fuer CY370"
 /begin DEF_CHARACTERISTIC InjVCD_uCY370ThrSRCLo_C InjVCD_uCY370ThrSRCHi_C InjVCD_uCY370Lin_CUR InjVCD_stCY370RcyDeb_C InjVCD_stCY370RcyTst_C /end DEF_CHARACTERISTIC
 /begin OUT_MEASUREMENT InjVCD_regCY370ID_mp InjVCD_stCY370Event_mp InjVCD_uRawCY370Int0_mp InjVCD_uRawCY370Int_mp InjVCD_uValCY370Int_mp /end OUT_MEASUREMENT
/end FUNCTION
/begin FUNCTION injvcd_cy370_msg ""
 /begin OUT_MEASUREMENT InjVCD_PZOSWType InjVCD_regCY370Bank InjVCD_regCY370CylISel InjVCD_regCY370Global InjVCD_regCY370Status InjVCD_stCY370Buf InjVCD_tiCY370ChrgRC InjVCD_uCY370ChrgIntWp InjVCD_uCY370ChrgOff /end OUT_MEASUREMENT
/end FUNCTION
/begin FUNCTION injvcd_dcdc "Komponententreiber für DCDC-Wandler" /begin DEF_CHARACTERISTIC InjVCD_DebDCDCLowDef_C InjVCD_uBufCLoLim_C /end DEF_CHARACTERISTIC /end FUNCTION
/begin FUNCTION injvcd_dcdc_msg "" /begin OUT_MEASUREMENT InjVCD_numDCDC InjVCD_stBufMon /end OUT_MEASUREMENT /end FUNCTION
/begin FUNCTION injvcd_dcdc_uic "" /end FUNCTION
/begin FUNCTION injvcd_emcomp "Kompensation der Eingriffe des Flankenmanagements"
 /begin DEF_CHARACTERISTIC InjVCD_dtiEMComp_C InjVCD_numBgnShrtDeb_C InjVCD_numCylEMCompDispl_C InjVCD_phiAccu_C InjVCD_phiBckStp_C InjVCD_phiPoI1ShftLead_C InjVCD_phiPoI1Shft_C InjVCD_phiPoI1SweepMax_MAP InjVCD_phiPoI1SweepMin_MAP InjVCD_swtEnaEMSweep_C /end DEF_CHARACTERISTIC
 /begin IN_MEASUREMENT Eng_nAvrg InjCtl_qSetUnBal /end IN_MEASUREMENT
 /begin OUT_MEASUREMENT InjVCD_ctBgnShrtDeb_mp InjVCD_dtiEMComp_mp InjVCD_phiAccu_mp InjVCD_phiPoI1DesShft_mp InjVCD_phiPoI1Shft_mp /end OUT_MEASUREMENT
/end FUNCTION
/begin FUNCTION injvcd_emcomp_msg "" /begin OUT_MEASUREMENT InjVCD_dtiEMComp InjVCD_phiPoI1Shft /end OUT_MEASUREMENT /end FUNCTION
/begin FUNCTION injvcd_emcomp_uic ""
 /begin OUT_MEASUREMENT InjVCD_dPhiPoI1Shft_mp InjVCD_phiPoI1ShrtAct_mp InjVCD_phiPoI1SweepMax_mp InjVCD_phiPoI1SweepMin_mp InjVCD_stEMSweep_mp /end OUT_MEASUREMENT
/end FUNCTION
/begin FUNCTION injvcd_estet "" /end FUNCTION
/begin FUNCTION injvcd_estet_uic "" /end FUNCTION
/begin FUNCTION injvcd_evmgmt ""
 /begin DEF_CHARACTERISTIC InjVCD_nLimBotEvMgmt_C InjVCD_nLimTopEvMgmt_C InjVCD_numCollTyp_C InjVCD_swtBuf2Tpu_C InjVCD_swtBufClean_C InjVCD_swtEvMgmt_C InjVCD_swtOvrEval_C InjVCD_swtTiDyn_C InjVCD_tiBegBeg_C InjVCD_tiEvt_C InjVCD_tiLeadJit_C /end DEF_CHARACTERISTIC
 /begin OUT_MEASUREMENT InjVCD_numCollPrim_mp InjVCD_numCollScnd_mp InjVCD_numCollThrd_mp InjVCD_numEvMgmtStat_mp InjVCD_numReacPrim_mp InjVCD_numReacScnd_mp InjVCD_tiCutAll_mp InjVCD_tiCutPrim_mp InjVCD_tiCutScnd_mp InjVCD_tiShiftAll_mp InjVCD_tiShiftPrim_mp InjVCD_tiShiftScnd_mp /end OUT_MEASUREMENT
/end FUNCTION
/begin FUNCTION injvcd_getet "Ansteuerdauerberechnung" /begin DEF_CHARACTERISTIC InjVCD_swtInputETMAP_C InjVCD_tiET_MAP /end DEF_CHARACTERISTIC /begin IN_MEASUREMENT InjVCD_pInET_mp InjVCD_volInET_mp /end IN_MEASUREMENT /end FUNCTION
/begin FUNCTION injvcd_getet_uic "" /begin OUT_MEASUREMENT InjVCD_pInET_mp InjVCD_volInET_mp /end OUT_MEASUREMENT /end FUNCTION
/begin FUNCTION injvcd_measubuf "Messung der Bufferspannung"
 /begin DEF_CHARACTERISTIC InjVCD_DebUBufSRCHighDef_C InjVCD_DebUBufSRCHighOk_C InjVCD_DebUBufSRCLowDef_C InjVCD_DebUBufSRCLowOk_C InjVCD_numUBufCyclMin2_C InjVCD_numUBufCyclMin_C InjVCD_numUBufTrigCall_C InjVCD_numUBufWaitStrt_C InjVCD_swtUBufTSyncMode_C InjVCD_uBufSRCMin_C InjVCD_uBufSRCMax_C InjVCD_uBufLin_CUR /end DEF_CHARACTERISTIC
 /begin OUT_MEASUREMENT InjVCD_ctUBufTrigWait_mp InjVCD_ctUBufTrig_mp InjVCD_stInjNotActive_mp InjVCD_uBufRawLast_mp InjVCD_uBufRaw_mp /end OUT_MEASUREMENT
/end FUNCTION
/begin FUNCTION injvcd_measubuf_msg ""
 /begin OUT_MEASUREMENT InjVCD_ctUBufMIIntCall InjVCD_stMeasUBuf InjVCD_stUBufC InjVCD_uBuf InjVCD_uBufC /end OUT_MEASUREMENT
/end FUNCTION
/begin FUNCTION injvcd_measubuf_uic "" /end FUNCTION
/begin FUNCTION injvcd_mirmtctl_uic "" /end FUNCTION
/begin FUNCTION injvcd_mon "Überwachung des Einspritzventils im Komponententreibers"
 /begin DEF_CHARACTERISTIC InjVCD_facMonUThresHiPl_CA InjVCD_facMonUThresLoPl_CA InjVCD_rCapUpTolc_C InjVCD_rTiChrgUpTolc_C InjVCD_tiMi1ThresLo_C InjVCD_tiMonThresHiPlaus_C InjVCD_tiMonThresLoPlaus_C /end DEF_CHARACTERISTIC
 /begin OUT_MEASUREMENT InjVCD_tiMonActrThresLo_mp InjVCD_uMonThresHi_mp InjVCD_uMonThresLo_mp /end OUT_MEASUREMENT
/end FUNCTION
/begin FUNCTION injvcd_monshcir "Kurzschlussunterscheidung"
 /begin DEF_CHARACTERISTIC InjVCD_iChrgMonShCir_C InjVCD_iDisChMonShCir_C InjVCD_nEngMonShCir_C InjVCD_pRailMonShCirMax_C InjVCD_rMonShCirTiChrgUpTolc_C InjVCD_tiMonET_C InjVCD_tiMonLead_C InjVCD_tiMonShCirPse_C InjVCD_uMonShCirUp_C /end DEF_CHARACTERISTIC
 /begin OUT_MEASUREMENT InjVCD_pMonShCir_mp InjVCD_stMonInjMI_mp InjVCD_stMonShCir_mp InjVCD_tiMonChrgUp_mp InjVCD_tiMonShCirSort_mp /end OUT_MEASUREMENT
/end FUNCTION
/begin FUNCTION injvcd_monshcir_msg "" /end FUNCTION
/begin FUNCTION injvcd_mon_uic ""
 /begin OUT_MEASUREMENT InjVCD_rCapThresHigh_mp InjVCD_rCapThresLow_mp InjVCD_rCapUpCurrToKx_mp InjVCD_rCapUpKxToCurr_mp InjVCD_rTiChrgUpCurrToKx_mp InjVCD_rTiChrgUpKxToCurr_mp InjVCD_rTiChrgUpThresHigh_mp InjVCD_rTiChrgUpThresLow_mp /end OUT_MEASUREMENT
/end FUNCTION
/begin FUNCTION injvcd_pii1rmtctl_uic "" /end FUNCTION
/begin FUNCTION injvcd_pii2rmtctl_uic "" /end FUNCTION
/begin FUNCTION injvcd_pii3rmtctl_uic "" /end FUNCTION
/begin FUNCTION injvcd_poi1rmtctl_uic "" /end FUNCTION
/begin FUNCTION injvcd_poi2rmtctl_uic "" /end FUNCTION
/begin FUNCTION injvcd_polar "Polarisation des Piezo-Aktors während des Systemhochlaufs"
 /begin DEF_CHARACTERISTIC InjVCD_iPolarUp_CUR InjVCD_numPolar_C InjVCD_pPolarMax_C InjVCD_tiChrgPolarPse_C InjVCD_tiDisChPolarPse_C InjVCD_tiPolarET_CUR InjVCD_tiPolarLead_C InjVCD_tPolarMax_C InjVCD_uPolarUp_CUR /end DEF_CHARACTERISTIC
 /begin OUT_MEASUREMENT InjVCD_iPolarChrg_mp InjVCD_iPolarDisCh_mp InjVCD_numPolarLeft_mp InjVCD_pPolar_mp InjVCD_stInjPolarErr_mp InjVCD_stInjPolarOK_mp InjVCD_stPolarPreCond_mp InjVCD_tiPolarET_mp InjVCD_tPolar_mp InjVCD_uPolarBott_mp InjVCD_uPolarUp_mp /end OUT_MEASUREMENT
/end FUNCTION
/begin FUNCTION injvcd_polar_msg "" /begin OUT_MEASUREMENT InjVCD_stPolar /end OUT_MEASUREMENT /end FUNCTION
/begin FUNCTION injvcd_progetlib "" /end FUNCTION
/begin FUNCTION injvcd_progetlib_uic ""
 /begin OUT_MEASUREMENT InjVCD_stInjMI1_mp InjVCD_stInjMI2_mp InjVCD_stInjPiI1_mp InjVCD_stInjPiI2_mp InjVCD_stInjPiI3_mp InjVCD_stInjPoI1_mp InjVCD_stInjPoI2_mp /end OUT_MEASUREMENT
/end FUNCTION
/begin FUNCTION injvcd_progetzfc "" /end FUNCTION
/begin FUNCTION injvcd_progetzfc_uic "" /begin OUT_MEASUREMENT InjVCD_stInjZFC_mp /end OUT_MEASUREMENT /end FUNCTION
/begin FUNCTION injvcd_progmi "Programmierung der MI1, Initialisierung von Schnelllöschung und Haltestrom" /begin OUT_MEASUREMENT InjVCD_stInjBegMI1_mp /end OUT_MEASUREMENT /end FUNCTION
/begin FUNCTION injvcd_progmi_uic ""
 /begin OUT_MEASUREMENT InjVCD_ctMI1AgDiff_mp InjVCD_phiInjBegMI1_mp InjVCD_phiMI1Diff_mp InjVCD_rGlobDynTimePrio_mp /end OUT_MEASUREMENT
/end FUNCTION
/begin FUNCTION injvcd_progpii "Programmierung der Voreinspritzung" /begin DEF_CHARACTERISTIC InjVCD_tiDebTPUErrDef_C InjVCD_tiDebTPUErrOK_C /end DEF_CHARACTERISTIC
 /begin OUT_MEASUREMENT InjVCD_stInjTPUCM_mp InjVCD_stInjTPUErr_mp InjVCD_stInjTPUShortDur_mp /end OUT_MEASUREMENT
/end FUNCTION
/begin FUNCTION injvcd_progpii1 "" /begin OUT_MEASUREMENT InjVCD_stInjBegPiI1_mp /end OUT_MEASUREMENT /end FUNCTION
/begin FUNCTION injvcd_progpii1_uic "" /begin OUT_MEASUREMENT InjVCD_ctPiI1AgDiff_mp InjVCD_phiPiI1Diff_mp /end OUT_MEASUREMENT /end FUNCTION
/begin FUNCTION injvcd_progpii2 "" /begin OUT_MEASUREMENT InjVCD_stInjBegPiI2_mp /end OUT_MEASUREMENT /end FUNCTION
/begin FUNCTION injvcd_progpii2_uic "" /begin OUT_MEASUREMENT InjVCD_ctPiI2AgDiff_mp InjVCD_phiPiI2Diff_mp /end OUT_MEASUREMENT /end FUNCTION
/begin FUNCTION injvcd_progpii3 "" /begin OUT_MEASUREMENT InjVCD_stInjBegPiI3_mp /end OUT_MEASUREMENT /end FUNCTION
/begin FUNCTION injvcd_progpii3_uic "" /end FUNCTION
/begin FUNCTION injvcd_progpii_uic "" /end FUNCTION
/begin FUNCTION injvcd_progpoi1 "" /begin OUT_MEASUREMENT InjVCD_stInjBegPoI1_mp /end OUT_MEASUREMENT /end FUNCTION
/begin FUNCTION injvcd_progpoi1_uic "" /end FUNCTION
/begin FUNCTION injvcd_progpoi2 "" /begin OUT_MEASUREMENT InjVCD_stInjBegPoI2_mp /end OUT_MEASUREMENT /end FUNCTION
/begin FUNCTION injvcd_progpoi2_uic "" /end FUNCTION
/begin FUNCTION injvcd_progzfc "" /end FUNCTION
/begin FUNCTION injvcd_progzfc_uic "" /end FUNCTION
/begin FUNCTION injvcd_selcrnt "" /begin OUT_MEASUREMENT InjVCD_numCrntLvl_mp /end OUT_MEASUREMENT /end FUNCTION
/begin FUNCTION injvcd_selvoltoffs "" /end FUNCTION
/begin FUNCTION injvcd_selvoltoffs_msg "" /begin OUT_MEASUREMENT InjVCD_numOfsSelect /end OUT_MEASUREMENT /end FUNCTION
/begin FUNCTION injvcd_shoffdcdc "Schutzabschaltung DC/DC-Wandler bei festgestelltem Ladeschalterkurzschluss"
 /begin DEF_CHARACTERISTIC InjVCD_ctThresShOffDCDCEv_C InjVCD_swtShOffDCDCTst_C InjVCD_uShOffBufThres_C /end DEF_CHARACTERISTIC
/end FUNCTION
/begin FUNCTION injvcd_shoffdcdc_msg "" /begin OUT_MEASUREMENT InjVCD_stMon InjVCD_stShOffDCDC /end OUT_MEASUREMENT /end FUNCTION
/begin FUNCTION injvcd_zfcetcor "Ansteuerdauerkorrektur durch Nullmengenkalibrierung"
 /begin DEF_CHARACTERISTIC InjVCD_pRailZFCETCor_AXIS InjVCD_qZFCETCor_AXIS InjVCD_rZFCETDif0_GMAP InjVCD_rZFCETDif1_GMAP InjVCD_rZFCETDif2_GMAP InjVCD_rZFCETMsk_GMAP InjVCD_stInputZFCETGMap_C InjVCD_stZFCETCorActv_C InjVCD_swtZFCCorOvrRunOn_C InjVCD_tiZFCETCorMax_C InjVCD_tiZFCETCorMin_C /end DEF_CHARACTERISTIC
 /begin IN_MEASUREMENT InjVCD_qInZFCETGMap_mp RailCD_pAct_mp /end IN_MEASUREMENT
 /begin OUT_MEASUREMENT InjVCD_rZFCETCoeffDif_mp InjVCD_rZFCETCoeffMsk_mp InjVCD_tiPiI1ZFCETCor_mp InjVCD_tiPiI2ZFCETCor_mp InjVCD_tiPiI3ZFCETCor_mp /end OUT_MEASUREMENT
/end FUNCTION
/begin FUNCTION injvcd_zfcetcor_uic "" /begin OUT_MEASUREMENT InjVCD_qInZFCETGMap_mp /end OUT_MEASUREMENT /end FUNCTION
/begin FUNCTION injvlv_addbal "Korrektur Einspritzmenge aus Laufruheregler" /begin DEF_CHARACTERISTIC InjVlv_facAddBalRls_MAP /end DEF_CHARACTERISTIC /begin IN_MEASUREMENT InjCtl_qSetUnBal RailCD_pPeak /end IN_MEASUREMENT /end FUNCTION
/begin FUNCTION injvlv_addballib "" /begin DEF_CHARACTERISTIC InjVlv_stInputAddBalMap_C /end DEF_CHARACTERISTIC /end FUNCTION
/begin FUNCTION injvlv_addballib_uic ""
 /begin OUT_MEASUREMENT InjVlv_qMI1Bal_mp InjVlv_qPiI1Bal_mp InjVlv_qPiI2Bal_mp InjVlv_qPiI3Bal_mp InjVlv_qPoI1Bal_mp InjVlv_qPoI2BalEff_mp InjVlv_qPoI2Bal_mp /end OUT_MEASUREMENT
/end FUNCTION
/begin FUNCTION injvlv_addbalzfc "" /end FUNCTION
/begin FUNCTION injvlv_addbalzfc_uic "" /end FUNCTION
/begin FUNCTION injvlv_addbal_msg "" /begin OUT_MEASUREMENT InjVlv_facAddBalRls /end OUT_MEASUREMENT /end FUNCTION
/begin FUNCTION injvlv_addbal_uic "" /end FUNCTION
/begin FUNCTION injvlv_calcvolt "Spannungsberechnung für Piezo-Aktuator"
 /begin DEF_CHARACTERISTIC InjVlv_facPCorQ_CUR InjVlv_facPCorTi_CUR InjVlv_facVoltCorUp_MAP InjVlv_pCorBase_CUR InjVlv_pRailDfl_C InjVlv_stPWvCorMsk_C InjVlv_tActrDfl_C InjVlv_uSetBott_C InjVlv_uSetUpPress0_CUR InjVlv_uSetUpPress10_CUR InjVlv_uSetUpPress11_CUR InjVlv_uSetUpPress12_CUR InjVlv_uSetUpPress13_CUR InjVlv_uSetUpPress14_CUR InjVlv_uSetUpPress15_CUR InjVlv_uSetUpPress1_CUR InjVlv_uSetUpPress2_CUR InjVlv_uSetUpPress3_CUR InjVlv_uSetUpPress4_CUR InjVlv_uSetUpPress5_CUR InjVlv_uSetUpPress6_CUR InjVlv_uSetUpPress7_CUR InjVlv_uSetUpPress8_CUR InjVlv_uSetUpPress9_CUR /end DEF_CHARACTERISTIC
 /begin IN_MEASUREMENT InjVlv_pAct_mp InjVlv_pCalcVolt InjVlv_tiMI1PoI2Cor_mp /end IN_MEASUREMENT
 /begin OUT_MEASUREMENT InjVlv_facPCorQ_mp InjVlv_facPCorTi_mp InjVlv_facPCor_mp InjVlv_pCorBase_mp InjVlv_pPoI2WvCorOfsActr_mp InjVlv_pRailCorPoI2Actr_mp InjVlv_qDes_mp InjVlv_tActr_mp InjVlv_uSetUpActrPoI2_mp /end OUT_MEASUREMENT
/end FUNCTION
/begin FUNCTION injvlv_calcvoltoffs "Berechnung des Spannungsoffsets" /begin DEF_CHARACTERISTIC InjVlv_uOfs_C /end DEF_CHARACTERISTIC /begin OUT_MEASUREMENT InjVlv_uSetBase_mp /end OUT_MEASUREMENT /end FUNCTION
/begin FUNCTION injvlv_calcvoltoffs_msg "" /begin OUT_MEASUREMENT InjVlv_uOfsBand /end OUT_MEASUREMENT /end FUNCTION
/begin FUNCTION injvlv_calcvolt_msg ""
 /begin OUT_MEASUREMENT InjVlv_facVoltCorUp InjVlv_numClsVltgAdjActr InjVlv_pCalcVolt InjVlv_uSetBott InjVlv_uSetUpActr /end OUT_MEASUREMENT
/end FUNCTION
/begin FUNCTION injvlv_calcvolt_uic "" /end FUNCTION
/begin FUNCTION injvlv_chrgbalinjlim "maximale Anzahl an Einspritzungen aufgrund der Ladungsbilanz des Boosterkondensators"
 /begin DEF_CHARACTERISTIC InjVlv_numInjChrgBal_MAP InjVlv_rChrgBalPwrHys_C InjVlv_rChrgBalVltgHys_C InjVlv_uBufCInjLimXLow2_C InjVlv_uBufCInjLimXHigh2_C InjVlv_stBufCInjLimYLow2_C InjVlv_stBufCInjLimYHigh2_C InjVlv_uBufCInjLimXLow_C InjVlv_uBufCInjLimXHigh_C InjVlv_stBufCInjLimYLow_C InjVlv_stBufCInjLimYHigh_C InjVlv_wInj_CUR /end DEF_CHARACTERISTIC
 /begin IN_MEASUREMENT BattCD_u /end IN_MEASUREMENT
 /begin OUT_MEASUREMENT InjVlv_pwrInjAvrg_mp InjVlv_uSetUpAvrg_mp InjVlv_wInjCorr_mp InjVlv_wInjNom_mp /end OUT_MEASUREMENT
/end FUNCTION
/begin FUNCTION injvlv_chrgbalinjlim_uic "" /begin OUT_MEASUREMENT InjVlv_numInjChrgBal_mp /end OUT_MEASUREMENT /end FUNCTION
/begin FUNCTION injvlv_coinit_msg "" /begin OUT_MEASUREMENT InjVlv_stCoInit /end OUT_MEASUREMENT /end FUNCTION
/begin FUNCTION injvlv_coinit_uic "" /end FUNCTION
/begin FUNCTION injvlv_currdcdc "Berechnung des aktuellen DCDC-Werts" /begin DEF_CHARACTERISTIC InjVlv_iDCDC_CUR /end DEF_CHARACTERISTIC /begin IN_MEASUREMENT BattCD_u /end IN_MEASUREMENT /begin OUT_MEASUREMENT InjVlv_iDCDC_mp /end OUT_MEASUREMENT /end FUNCTION
/begin FUNCTION injvlv_currdcdc_uic "" /end FUNCTION
/begin FUNCTION injvlv_errdet "Injektorfehlererkennung" /begin DEF_CHARACTERISTIC InjVlv_numSegOfs1_C InjVlv_numSegOfs2_C InjVlv_stErrDet_C /end DEF_CHARACTERISTIC /end FUNCTION
/begin FUNCTION injvlv_errdet_msg "" /begin OUT_MEASUREMENT InjVlv_nCyl InjVlv_qFBCCyl /end OUT_MEASUREMENT /end FUNCTION
/begin FUNCTION injvlv_errdet_uic "" /end FUNCTION
/begin FUNCTION injvlv_mon "Injektordiagnose"
 /begin DEF_CHARACTERISTIC InjVlv_ctMonQckThresLo_C InjVlv_ctMonQckThres_C InjVlv_DebBnkA0Def_C InjVlv_DebBnkA0Ok_C InjVlv_DebBnkA1Def_C InjVlv_DebBnkA1Ok_C InjVlv_DebBnkA2Def_C InjVlv_DebBnkA2Ok_C InjVlv_DebBnkA3Def_C InjVlv_DebBnkA3Ok_C InjVlv_DebBnkB0Def_C InjVlv_DebBnkB0Ok_C InjVlv_DebBnkB1Def_C InjVlv_DebBnkB1Ok_C InjVlv_DebBnkB2Def_C InjVlv_DebBnkB2Ok_C InjVlv_DebBnkB3Def_C InjVlv_DebBnkB3Ok_C InjVlv_DebChipA0Def_C InjVlv_DebChipA0Ok_C InjVlv_DebChipA1Def_C InjVlv_DebChipA1Ok_C InjVlv_DebChipA2Def_C InjVlv_DebChipA2Ok_C InjVlv_DebChipA3Def_C InjVlv_DebChipA3Ok_C InjVlv_DebChipB0Def_C InjVlv_DebChipB0Ok_C InjVlv_DebChipB1Def_C InjVlv_DebChipB1Ok_C InjVlv_DebChipB2Def_C InjVlv_DebChipB2Ok_C InjVlv_DebChipB3Def_C InjVlv_DebChipB3Ok_C InjVlv_DebCylA0Def_C InjVlv_DebCylA0Ok_C InjVlv_DebCylA1Def_C InjVlv_DebCylA1Ok_C InjVlv_DebCylA2Def_C InjVlv_DebCylA2Ok_C InjVlv_DebCylA3Def_C InjVlv_DebCylA3Ok_C InjVlv_DebCylB0Def_C InjVlv_DebCylB0Ok_C InjVlv_DebCylB1Def_C InjVlv_DebCylB1Ok_C InjVlv_DebCylB2Def_C InjVlv_DebCylB2Ok_C InjVlv_DebCylB3Def_C InjVlv_DebCylB3Ok_C InjVlv_DebCylC0Def_C InjVlv_DebCylC0Ok_C InjVlv_DebCylC1Def_C InjVlv_DebCylC1Ok_C InjVlv_DebCylC2Def_C InjVlv_DebCylC2Ok_C InjVlv_DebCylC3Def_C InjVlv_DebCylC3Ok_C InjVlv_iMonDisChDwn_C InjVlv_nMonQckThresLo_C InjVlv_numNoLoadCylMax_C InjVlv_stErrMskPattern_C InjVlv_stErrMskSelect_C InjVlv_stMonQckEna_C InjVlv_uMonBattThres_C /end DEF_CHARACTERISTIC
 /begin OUT_MEASUREMENT InjVlv_ctMonQckIDiff_mp InjVlv_ctMonQckISel_mp InjVlv_stMonQckErr_mp /end OUT_MEASUREMENT
/end FUNCTION
/begin FUNCTION injvlv_mon_msg ""
 /begin OUT_MEASUREMENT InjVlv_ctMonActrMeas InjVlv_stErrClctCyl1 InjVlv_stErrClctCyl2 InjVlv_stErrClctCyl3 InjVlv_stErrClctCyl4 InjVlv_stErrClctCyl5 InjVlv_stErrClctCyl6 InjVlv_stErrClctCyl7 InjVlv_stErrClctCyl8 InjVlv_stInjValve InjVlv_stMonDiag /end OUT_MEASUREMENT
/end FUNCTION
/begin FUNCTION injvlv_mon_uic ""
 /begin OUT_MEASUREMENT InjVlv_numIdxErrCyl1_mp InjVlv_numIdxErrCyl2_mp InjVlv_numIdxErrCyl3_mp InjVlv_numIdxErrCyl4_mp InjVlv_numIdxErrCyl5_mp InjVlv_numIdxErrCyl6_mp InjVlv_numIdxErrCyl7_mp InjVlv_numIdxErrCyl8_mp InjVlv_stErrUnknown_mp /end OUT_MEASUREMENT
/end FUNCTION
/begin FUNCTION injvlv_nvc "Nominal Voltage Calibration (Spannungsadaption)"
 /begin DEF_CHARACTERISTIC InjVlv_DebNVCDef_C InjVlv_DebNVCOK_C InjVlv_facNVCDflI_C InjVlv_facNVCDfpMax_C InjVlv_facNVCDfpMin_C InjVlv_facNVCInPI_C InjVlv_facNVCMax_C InjVlv_facNVCMin_C InjVlv_NVCIKi_C InjVlv_NVCIKiPos_C InjVlv_NVCIKiNeg_C InjVlv_uNVCIWinPos_C InjVlv_uNVCIWinNeg_C InjVlv_pNVCMax_C InjVlv_pNVCMin_C InjVlv_NVCPKp_C InjVlv_NVCPKpPos_C InjVlv_NVCPKpNeg_C InjVlv_uNVCPWinPos_C InjVlv_uNVCPWinNeg_C InjVlv_swtAvrgEnaTiNVC_C InjVlv_swtNVCStInjChar_C InjVlv_swtNVCWrDflVal_C InjVlv_tiNVCDwnThres_C InjVlv_tiNVCUpThres_C InjVlv_tiUSetStrtLck_C InjVlv_tNVCEngMax_C InjVlv_tNVCEngMin_C InjVlv_uDiffNVCSet_CUR InjVlv_uNVCThres_C InjVlv_uSetUpNVCActrMax_C InjVlv_uSetUpNVCActrMin_C InjVlv_uSetUpStrt_C /end DEF_CHARACTERISTIC
 /begin IN_MEASUREMENT InjVCD_pActInj /end IN_MEASUREMENT
 /begin OUT_MEASUREMENT InjVlv_facNVCEepWrI_mp InjVlv_facNVCInitI_mp InjVlv_stNVCCrit_mp InjVlv_uDiffNVCActrInPI_mp InjVlv_uDiffNVCActr_mp InjVlv_uDiffNVCSet_mp InjVlv_uSetUpNVCActrUnLim_mp /end OUT_MEASUREMENT
/end FUNCTION
/begin FUNCTION injvlv_nvc_msg ""
 /begin OUT_MEASUREMENT InjVlv_facNVCActr InjVlv_stNVCEna InjVlv_stNVCPI InjVlv_stUSetStrt InjVlv_uSetUpNVCActr InjVlv_uSetUpTiChrgActr /end OUT_MEASUREMENT
/end FUNCTION
/begin FUNCTION injvlv_nvc_uic "" /end FUNCTION
/begin FUNCTION injvlv_presmin "Abschaltanforderung aufgrund Mindestdruck" /begin DEF_CHARACTERISTIC InjVlv_pMin_C InjVlv_pMin_CUR /end DEF_CHARACTERISTIC /begin IN_MEASUREMENT Eng_tEng /end IN_MEASUREMENT /end FUNCTION
/begin FUNCTION injvlv_qntadj "Injektor-Mengenabgleich"
 /begin DEF_CHARACTERISTIC InjVlv_numClsVltgAdjMax_C InjVlv_numClsVltgAdjMin_C InjVlv_stQntAdj_MAP InjVlv_volQntAdjLim_C InjVlv_volQntAdjMax0_C InjVlv_volQntAdjMax1_C InjVlv_volQntAdjMax2_C InjVlv_volQntAdjMax3_C InjVlv_volQntAdjMin0_C InjVlv_volQntAdjMin1_C InjVlv_volQntAdjMin2_C InjVlv_volQntAdjMin3_C /end DEF_CHARACTERISTIC
 /begin IN_MEASUREMENT InjUn_volMI1Cor_mp RailCD_pPeak /end IN_MEASUREMENT
 /begin OUT_MEASUREMENT InjVlv_numCodeVltgAdj_mp InjVlv_stAdj_mp InjVlv_stCheckSumErrVltgAdj_mp InjVlv_stMaxErrVltgAdj_mp /end OUT_MEASUREMENT
/end FUNCTION
/begin FUNCTION injvlv_qntadjrepl "" /begin DEF_CHARACTERISTIC InjVlv_stQntAdjRepl_C InjVlv_swtQntAdj_C /end DEF_CHARACTERISTIC /end FUNCTION
/begin FUNCTION injvlv_qntadj_uic ""
 /begin OUT_MEASUREMENT InjVlv_volMI1QntAdj_mp InjVlv_volPiI1QntAdj_mp InjVlv_volPiI2QntAdj_mp InjVlv_volPiI3QntAdj_mp InjVlv_volPoI1QntAdj_mp InjVlv_volPoI2QntAdj_mp /end OUT_MEASUREMENT
/end FUNCTION
/begin FUNCTION injvlv_tdiffhyd "" /begin DEF_CHARACTERISTIC InjVlv_swtDiffHydInSel_C InjVlv_tiDiffHyd_MAP /end DEF_CHARACTERISTIC /begin IN_MEASUREMENT InjVlv_pActInDiffHyd_mp InjVlv_qDesInDiffHyd_mp /end IN_MEASUREMENT /end FUNCTION
/begin FUNCTION injvlv_tdiffhyd_uic ""
 /begin OUT_MEASUREMENT InjVlv_pActInDiffHyd_mp InjVlv_qDesInDiffHyd_mp InjVlv_tiMI1DiffHydCor_mp InjVlv_tiPiI1DiffHydCor_mp InjVlv_tiPiI2DiffHydCor_mp /end OUT_MEASUREMENT
/end FUNCTION
/begin FUNCTION injvlv_wvcor "Druckwellenkorrektur"
 /begin DEF_CHARACTERISTIC InjVlv_facFTSWvCor_MAP InjVlv_qWvCorNorm_CUR InjVlv_stWvCorActv_C InjVlv_tWvCor_MAP /end DEF_CHARACTERISTIC
 /begin IN_MEASUREMENT CTSCD_tClnt FTSCD_tFuel InjVlv_tWvCor_mp RailCD_pPeak /end IN_MEASUREMENT
/end FUNCTION
/begin FUNCTION injvlv_wvcorlib "Druckwellenkorrektur Funktionsbibliothek"
 /begin DEF_CHARACTERISTIC InjVlv_facPiI2WvCor_C InjVlv_facWvCor1_MAP InjVlv_facWvCor2_MAP InjVlv_qWvCor1_MAP InjVlv_qWvCor2_MAP InjVlv_qWvCorMax_C InjVlv_qWvCorMin_C /end DEF_CHARACTERISTIC
 /begin IN_MEASUREMENT InjCrv_qMI1Des InjCrv_qPiI1Des InjCrv_qPoI2Des_mp InjVlv_rMI1WvCorNorm_mp InjVlv_tiMI1PoI2HydCor_mp InjVlv_tiPiI1MI1Cor_mp RailCD_pAct_mp /end IN_MEASUREMENT
 /begin OUT_MEASUREMENT InjVlv_pAct_mp /end OUT_MEASUREMENT
/end FUNCTION
/begin FUNCTION injvlv_wvcorlib_uic ""
 /begin OUT_MEASUREMENT InjVlv_facMI1PoI2WvCor_mp InjVlv_facPiI2PiI1WvCor_mp InjVlv_facPiIMI1WvCor_mp InjVlv_qMI1PoI2WvCor_mp InjVlv_qMI1WvCor_mp InjVlv_qPiI1MI1WvCor_mp InjVlv_qPiI1WvCor_mp InjVlv_qPiI2MI1WvCor_mp InjVlv_qPiI2PiI1WvCor_mp InjVlv_qPoI2WvCor_mp InjVlv_rMI1WvCorNorm_mp InjVlv_tiMI1PoI2Cor_mp InjVlv_tiMI1PoI2HydCor_mp InjVlv_tiMI1PoI2_mp InjVlv_tiPiI1MI1Cor_mp InjVlv_tiPiI1MI1_mp InjVlv_tiPiI2MI1Cor_mp InjVlv_tiPiI2MI1_mp InjVlv_tiPiI2PiI1Cor_mp InjVlv_tiPiI2PiI1_mp /end OUT_MEASUREMENT
/end FUNCTION
/begin FUNCTION injvlv_wvcor_msg "" /begin OUT_MEASUREMENT InjVlv_facFTSWvCor InjVlv_qWvCorNorm InjVlv_stWvCor /end OUT_MEASUREMENT /end FUNCTION
/begin FUNCTION injvlv_wvcor_uic "" /begin OUT_MEASUREMENT InjVlv_tWvCor_mp /end OUT_MEASUREMENT /end FUNCTION
/begin FUNCTION ivctl_tichrg "Ladezeitregelung des Piezoaktors"
 /begin DEF_CHARACTERISTIC IVCtl_ChrgUpIKi_C IVCtl_ChrgUpIKiPos_C IVCtl_ChrgUpIKiNeg_C IVCtl_tiChrgUpIWinPos_C IVCtl_tiChrgUpIWinNeg_C IVCtl_ChrgUpPKp_C IVCtl_ChrgUpPKpPos_C IVCtl_ChrgUpPKpNeg_C IVCtl_tiChrgUpPWinPos_C IVCtl_tiChrgUpPWinNeg_C IVCtl_DisChDwnIKi_C IVCtl_DisChDwnIKiPos_C IVCtl_DisChDwnIKiNeg_C IVCtl_tiDisChDwnIWinPos_C IVCtl_tiDisChDwnIWinNeg_C IVCtl_DisChDwnPKp_C IVCtl_DisChDwnPKpPos_C IVCtl_DisChDwnPKpNeg_C IVCtl_tiDisChDwnPWinPos_C IVCtl_tiDisChDwnPWinNeg_C IVCtl_iChrgUpCls_C IVCtl_iChrgUpGovMax_C IVCtl_iChrgUpGovMin_C IVCtl_iChrgUpInitI_C IVCtl_iChrgUpMax_C IVCtl_iChrgUpMin_C IVCtl_iChrgUp_MAP IVCtl_iDisChDwnCls_C IVCtl_iDisChDwnGovMax_C IVCtl_iDisChDwnGovMin_C IVCtl_iDisChDwnInitI_C IVCtl_iDisChDwnMax_C IVCtl_iDisChDwnMin_C IVCtl_iDisChDwn_CUR IVCtl_swtTiChrgMinMaxActr_C IVCtl_swtTiChrgMinMaxRst_C IVCtl_swtTiChrgMinMax_C IVCtl_tiChrgSetUp_MAP IVCtl_tiChrgUpPse_CUR IVCtl_tiDisChDwnPse_C IVCtl_tiDisChSetDwn_CUR /end DEF_CHARACTERISTIC
 /begin IN_MEASUREMENT RailCD_pPeak /end IN_MEASUREMENT
 /begin OUT_MEASUREMENT IVCtl_iChrgUp2_mp IVCtl_iChrgUpPI_mp IVCtl_iChrgUp_mp IVCtl_iDisChDwnPI_mp IVCtl_tiChrgSetUp_mp IVCtl_tiChrgUpAvrg_mp IVCtl_tiChrgUpInPIActr_mp IVCtl_tiChrgUpMaxActr_mp IVCtl_tiChrgUpMax_mp IVCtl_tiChrgUpMinActr_mp IVCtl_tiChrgUpMin_mp IVCtl_tiChrgUpPse_mp IVCtl_tiDisChBottAvrg_mp IVCtl_tiDisChDwnInPIActr_mp IVCtl_tiDisChDwnMaxActr_mp IVCtl_tiDisChDwnMax_mp IVCtl_tiDisChDwnMinActr_mp IVCtl_tiDisChDwnMin_mp IVCtl_tiDisChDwnPse_mp IVCtl_tiDisChSetDwn_mp IVCtl_uSetUp2Avrg_mp IVCtl_uSetUpAvrg_mp /end OUT_MEASUREMENT
/end FUNCTION
/begin FUNCTION ivctl_tichrg_msg ""
 /begin OUT_MEASUREMENT IVCtl_iDisChDwn IVCtl_iDisChDwn2 IVCtl_stTiChrgPI IVCtl_tiChrgUpInPI IVCtl_tiDisChDwnInPI /end OUT_MEASUREMENT
/end FUNCTION
/begin FUNCTION ivctl_volt "Spannungsregelung"
 /begin DEF_CHARACTERISTIC IVCtl_IKi_C IVCtl_IKiPos_C IVCtl_IKiNeg_C IVCtl_uIWinPos_C IVCtl_uIWinNeg_C IVCtl_PKp_C IVCtl_PKpPos_C IVCtl_PKpNeg_C IVCtl_uPWinPos_C IVCtl_uPWinNeg_C IVCtl_swtAvrgEnaTiWarnVolt_C IVCtl_swtUUpMinMaxActr_C IVCtl_swtUUpMinMaxRst_C IVCtl_swtUUpMinMax_C IVCtl_uClsActrUp_C IVCtl_uMaxSetUp_C IVCtl_uMinSetUp_C IVCtl_uPIMax_C IVCtl_uPIMin_C IVCtl_uSetUpPreCtl_CUR IVCtl_uUpInitI_C /end DEF_CHARACTERISTIC
 /begin IN_MEASUREMENT InjVlv_pCalcVolt /end IN_MEASUREMENT
 /begin OUT_MEASUREMENT IVCtl_stAvrgEnaTiWarnVolt_mp IVCtl_uSetUpActrUnCorr_mp IVCtl_uSetUpActrUnLim_mp IVCtl_uSetUpPreCtl_mp IVCtl_uSetUpTmp_mp IVCtl_uUpInPIActr_mp IVCtl_uUpInPIMaxActr_mp IVCtl_uUpInPIMax_mp IVCtl_uUpInPIMinActr_mp IVCtl_uUpInPIMin_mp IVCtl_uUpTmp_mp /end OUT_MEASUREMENT
/end FUNCTION
/begin FUNCTION ivctl_volt_msg ""
 /begin OUT_MEASUREMENT IVCtl_stVoltPI IVCtl_uClsActrUp IVCtl_uCorrUp IVCtl_uSetBott IVCtl_uSetOfsActr IVCtl_uSetUpActr IVCtl_uUpInPI /end OUT_MEASUREMENT
/end FUNCTION
/begin FUNCTION k2rdli "" /begin DEF_CHARACTERISTIC K2RDLI_dDataSetVer_C /end DEF_CHARACTERISTIC /end FUNCTION
/begin FUNCTION keycheck "" /begin DEF_CHARACTERISTIC KeyCheck_Mode_C /end DEF_CHARACTERISTIC /end FUNCTION
/begin COMPU_METHOD Actr_Calc "Zustände für Aktiv und Inaktiv" TAB_VERB "%6.3" "-" COMPU_TAB_REF Actr_Calc /end COMPU_METHOD
/begin COMPU_VTAB Actr_Calc "Zustände für Aktiv und Inaktiv" TAB_VERB 2 0 "Inactive" 1 "Active" /end COMPU_VTAB
/begin COMPU_METHOD Actr_Cls_State "Zustände für die Piezoaktor Klassifizierung" TAB_VERB "%6.3" "-" COMPU_TAB_REF Actr_Cls_State /end COMPU_METHOD
/begin COMPU_VTAB Actr_Cls_State "Zustände für die Piezoaktor Klassifizierung" TAB_VERB 4 0 "Wait" 1 "Energise" 2 "Measure" 4 "Done" /end COMPU_VTAB
/begin COMPU_METHOD Actr_Temp_Sel "Position des Schalters der die Basis für die Piezo-Aktortempartur auswählt" TAB_VERB "%6.3" "-" COMPU_TAB_REF Actr_Temp_Sel /end COMPU_METHOD
/begin COMPU_VTAB Actr_Temp_Sel "Position des Schalters der die Basis für die Piezo-Aktortempartur auswählt" TAB_VERB 2 0 "coolant water temperature" 1 "fuel temperature" /end COMPU_VTAB
/begin COMPU_METHOD AngleCrS "Winkel Kurbelwelle" RAT_FUNC "%6.4" "deg CrS" COEFFS 0 42.6666666666667 0 0 0 1 /end COMPU_METHOD
/begin COMPU_METHOD Capacity_PA "Kapazität der Piezo-Aktoren" RAT_FUNC "%6.5" "uF" COEFFS 0 1000 0 0 0 1 /end COMPU_METHOD
/begin COMPU_METHOD Charge_PA "Ladung der Piezo-Aktoren" RAT_FUNC "%6.2" "uC" COEFFS 0 1 0 0 0 1 /end COMPU_METHOD
/begin COMPU_METHOD Curr "Strom" RAT_FUNC "%6.2" "mA" COEFFS 0 1 0 0 0 1 /end COMPU_METHOD
/begin COMPU_METHOD Delta_Volt_INT "ADC Spannungsgradient" RAT_FUNC "%6.2" "mV/ms" COEFFS 0 1 0 0 0 1 /end COMPU_METHOD
/begin COMPU_METHOD EngN "Motordrehzahl" RAT_FUNC "%6.2" "rpm" COEFFS 0 1 0 0 0 1 /end COMPU_METHOD
/begin COMPU_METHOD Fact "Faktor mit Auflösung 1 / 8192, hauptsächlich für einen Faktorenbereich 0...1 verwendet" RAT_FUNC "%6.5" "-" COEFFS 0 8192 0 0 0 1 /end COMPU_METHOD
/begin COMPU_METHOD Fact1 "Faktor mit Auflösung 0,01 (100 mal höherer Bereich als Fact)" RAT_FUNC "%6.4" "-" COEFFS 0 128 0 0 0 1 /end COMPU_METHOD
/begin COMPU_METHOD Fact_IntAmp "Auflösungsfaktor für Stromverstärkungsfaktor des CY370-Integrators - Auflösung 0.001" RAT_FUNC "%6.5" "-" COEFFS 0 1000 0 0 0 1 /end COMPU_METHOD
/begin COMPU_METHOD InjMass "Einspritzmenge" RAT_FUNC "%6.4" "mg/hub" COEFFS 0 100 0 0 0 1 /end COMPU_METHOD
/begin COMPU_METHOD InjMassCyc "Einspritzmenge pro Zyklus (mg/Zyklus)" RAT_FUNC "%6.4" "mg/cyc" COEFFS 0 100 0 0 0 1 /end COMPU_METHOD
/begin COMPU_METHOD InjMassInj "Einspritzmenge pro Einspritzung (mg/Einspritzung)" RAT_FUNC "%6.4" "mg/inj" COEFFS 0 100 0 0 0 1 /end COMPU_METHOD
/begin COMPU_METHOD InjQntInj "Einspritzmenge der einzelnen Einspritzung" RAT_FUNC "%6.4" "mm^3/inj" COEFFS 0 100 0 0 0 1 /end COMPU_METHOD
/begin COMPU_METHOD InjTime_us "Zeit in Microsekunden für das Einspritztiming" RAT_FUNC "%6.2" "us" COEFFS 0 1 0 0 0 1 /end COMPU_METHOD
/begin COMPU_METHOD ISA_Code "ISA-Code für den Injektorspannungsabgleich" TAB_VERB "%6.3" "-" COMPU_TAB_REF ISA_Code /end COMPU_METHOD
/begin COMPU_VTAB ISA_Code "ISA-Code für den Injektorspannungsabgleich" TAB_VERB 32 0 "A" 1 "B" 2 "C" 3 "D" 4 "E" 5 "F" 6 "G" 7 "H" 8 "I" 9 "K" 10 "L" 11 "M" 12 "N" 13 "O" 14 "P" 15 "R" 16 "S" 17 "T" 18 "U" 19 "V" 20 "W" 21 "X" 22 "Y" 23 "Z" 24 "1" 25 "2" 26 "3" 27 "4" 28 "5" 29 "6" 30 "7" 31 "8" /end COMPU_VTAB
/begin COMPU_METHOD KeyCheckMode "" TAB_VERB "%6.3" "-" COMPU_TAB_REF KeyCheckMode /end COMPU_METHOD
/begin COMPU_VTAB KeyCheckMode "" TAB_VERB 2 171 "strict Key Check" 57 "empty Fingerprint allowed" /end COMPU_VTAB
/begin COMPU_METHOD Ki "Integrale Verstärkung Ki (gleiche Einheit/Umrechnungsregel an Ein- und Ausgang)" RAT_FUNC "%6.5" "1/s" COEFFS 0 4294.967296 0 0 0 1 /end COMPU_METHOD
/begin COMPU_METHOD Ki_us2mA "Umrechnung für PI-(Ent)ladezeitregler" RAT_FUNC "%6.4" "mA/(us*s)" COEFFS 0 429.4967296 0 0 0 1 /end COMPU_METHOD
/begin COMPU_METHOD Ki_VOLTPA2FACT "Integrale Verstärkung (Umrechnung von der Aktorspannung auf Faktor)" RAT_FUNC "%8.7" "1/(V*s)" COEFFS 0 351843.72088832 0 0 0 1 /end COMPU_METHOD
/begin COMPU_METHOD Kp "proportionale Verstärkung Kp (gleiche Einheit/Umrechnungsregel an Ein- und Ausgang)" RAT_FUNC "%7.6" "1/1" COEFFS 0 65536 0 0 0 1 /end COMPU_METHOD
/begin COMPU_METHOD Kp_us2mA "Umrechnung für PI-(Ent)ladezeitregler" RAT_FUNC "%6.5" "mA/us" COEFFS 0 6553.6 0 0 0 1 /end COMPU_METHOD
/begin COMPU_METHOD Kp_VOLTPA2FACT "Proportionale Verstärkung (Umrechnung von der Aktorspannung auf den Faktor)" RAT_FUNC "%9.8" "1/V" COEFFS 0 5368709.12 0 0 0 1 /end COMPU_METHOD
/begin COMPU_METHOD Milli "Milli Auflösung" RAT_FUNC "%6.5" "-" COEFFS 0 1000 0 0 0 1 /end COMPU_METHOD
/begin COMPU_METHOD OneToOne "eins zu eins (physikalischer Wert ist gleich dem internen Wert)" RAT_FUNC "%6.2" "-" COEFFS 0 1 0 0 0 1 /end COMPU_METHOD
/begin COMPU_METHOD Prc "Prozent, gleiche interne Auflösung wie Fact, aber Darstellung in Prozent (0...100%)" RAT_FUNC "%6.4" "%" COEFFS 0 81.92 0 0 0 1 /end COMPU_METHOD
/begin COMPU_METHOD PresAC_hPa "Druck (Klimatisierung) angezeigt in [hPa]" RAT_FUNC "%6.2" "hPa" COEFFS 0 0.5 0 0 0 1 /end COMPU_METHOD
/begin COMPU_METHOD Pres_AC "Druck (Klimatisierung)" RAT_FUNC "%7.2" "hPa" COEFFS 0 0.500000 0 0 0 1 /end COMPU_METHOD
/begin COMPU_METHOD Pres_Rail "Raildruck in hPa" RAT_FUNC "%4.3" "bar" COEFFS 0 10.000000 0 0 0 1 /end COMPU_METHOD
/begin COMPU_METHOD Pres_SI "Druck (angezeigt in [Pa])" RAT_FUNC "%6.0" "Pa" COEFFS 0 0.01 0 0 0 1 /end COMPU_METHOD
/begin COMPU_METHOD Pwr_PA "Leistung für Piezo-Aktor" RAT_FUNC "%6.2" "mW" COEFFS 0 1 0 0 0 1 /end COMPU_METHOD
/begin COMPU_METHOD QntR "Normierungsverhältnis Einspritzmenge / Normierungsmenge" RAT_FUNC "%6.5" "-" COEFFS 0 1024 0 0 0 1 /end COMPU_METHOD
/begin COMPU_METHOD Resist_mOhm "Widerstand mit 1/10 mOhm Auflösung" RAT_FUNC "%6.3" "mOhm" COEFFS 0 10 0 0 0 1 /end COMPU_METHOD
/begin COMPU_METHOD stMonShCir "Status des Ansteuerung im nachlauf für Kurzschlussunterscheidung" TAB_VERB "%6.3" "-" COMPU_TAB_REF stMonShCir /end COMPU_METHOD
/begin COMPU_VTAB stMonShCir "Status des Ansteuerung im nachlauf für Kurzschlussunterscheidung" TAB_VERB 4 0 "NotReleased" 2 "Energise" 4 "Gettime" 8 "Done" /end COMPU_VTAB
/begin COMPU_METHOD Temp_Cels "Temperatur dargestellt in °C (gleiche interne Darstellung wie Temp_Kelv)" RAT_FUNC "%6.1" "deg C" COEFFS 0 10 2731.4 0 0 1 /end COMPU_METHOD
/begin COMPU_METHOD TimeDT "Abtastzeit (in us) für Library Regler, Filter, etc." RAT_FUNC "%6.2" "us" COEFFS 0 1 0 0 0 1 /end COMPU_METHOD
/begin COMPU_METHOD Time_Busy "Lade-/Entladezeit der Piezosteller (us)" RAT_FUNC "%6.3" "us" COEFFS 0 10 0 0 0 1 /end COMPU_METHOD
/begin COMPU_METHOD Time_ms "Zeit in ms für Fehlerentprellung (DSM) und SW-Timer" RAT_FUNC "%6.1" "ms" COEFFS 0 0.1 0 0 0 1 /end COMPU_METHOD
/begin COMPU_METHOD VltgAdj "Zustand des Injektor Spannungsabgleichs" TAB_VERB "%6.3" "-" COMPU_TAB_REF VltgAdj /end COMPU_METHOD
/begin COMPU_VTAB VltgAdj "Zustand des Injektor Spannungsabgleichs" TAB_VERB 3 0 "EEPROM" 1 "replace values" 8 "external access" /end COMPU_VTAB
/begin COMPU_METHOD Volt "Spannung in V (von ADC)" RAT_FUNC "%6.2" "mV" COEFFS 0 0.2046 0 0 0 1 /end COMPU_METHOD
/begin COMPU_METHOD VoltInt "Spannung vom ADC zum Integratorabgleich" RAT_FUNC "%6.4" "mV" COEFFS 0 204.6 0 0 0 1 /end COMPU_METHOD
/begin COMPU_METHOD Volt_Batt "Batteriespannung" RAT_FUNC "%6.1" "mV" COEFFS 0 0.05115 0 0 0 1 /end COMPU_METHOD
/begin COMPU_METHOD Volt_BUFC "zur Berechnung der DC/DC-Wandler Pufferspannung" RAT_FUNC "%6.4" "V" COEFFS 0 100 0 0 0 1 /end COMPU_METHOD
/begin COMPU_METHOD Volt_PA "Spannung des Piezo-Aktors" RAT_FUNC "%6.4" "V" COEFFS 0 100 0 0 0 1 /end COMPU_METHOD
/begin COMPU_METHOD W_PA "Energieverbrauch des Piezo-Aktors" RAT_FUNC "%6.2" "mWs" COEFFS 0 1 0 0 0 1 /end COMPU_METHOD
/begin COMPU_METHOD defaultAscii "" RAT_FUNC "%6.2" "-" COEFFS 0 1 0 0 0 1 /end COMPU_METHOD
/begin RECORD_LAYOUT Gkf_Ws16 FNC_VALUES 1 SWORD COLUMN_DIR DIRECT /end RECORD_LAYOUT
/begin RECORD_LAYOUT GSst_Xs16 NO_AXIS_PTS_X 1 SWORD AXIS_PTS_X 2 SWORD INDEX_INCR DIRECT /end RECORD_LAYOUT
/begin RECORD_LAYOUT Kf_Xs16_Ys16_Ws16 NO_AXIS_PTS_X 1 SWORD NO_AXIS_PTS_Y 2 SWORD AXIS_PTS_X 3 SWORD INDEX_INCR DIRECT AXIS_PTS_Y 4 SWORD INDEX_INCR DIRECT FNC_VALUES 5 SWORD COLUMN_DIR DIRECT /end RECORD_LAYOUT
/begin RECORD_LAYOUT Kl_Xs16_Ws16 NO_AXIS_PTS_X 1 SWORD AXIS_PTS_X 2 SWORD INDEX_INCR DIRECT FNC_VALUES 3 SWORD COLUMN_DIR DIRECT /end RECORD_LAYOUT
/begin RECORD_LAYOUT Kwb_Ws16 FNC_VALUES 1 SWORD COLUMN_DIR DIRECT /end RECORD_LAYOUT
/begin RECORD_LAYOUT Kwb_Wu32 FNC_VALUES 1 ULONG COLUMN_DIR DIRECT /end RECORD_LAYOUT
/begin RECORD_LAYOUT Kwb_Wu8 FNC_VALUES 1 UBYTE COLUMN_DIR DIRECT /end RECORD_LAYOUT
/begin RECORD_LAYOUT Kw_Ws16 FNC_VALUES 1 SWORD COLUMN_DIR DIRECT /end RECORD_LAYOUT
/begin RECORD_LAYOUT Kw_Ws32 FNC_VALUES 1 SLONG COLUMN_DIR DIRECT /end RECORD_LAYOUT
/begin RECORD_LAYOUT Kw_Wu16 FNC_VALUES 1 UWORD COLUMN_DIR DIRECT /end RECORD_LAYOUT
/begin RECORD_LAYOUT Kw_Wu32 FNC_VALUES 1 ULONG COLUMN_DIR DIRECT /end RECORD_LAYOUT
/begin RECORD_LAYOUT Kw_Wu8 FNC_VALUES 1 UBYTE COLUMN_DIR DIRECT /end RECORD_LAYOUT
/end MODULE
/end PROJECT
