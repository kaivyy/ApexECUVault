ASAP2_VERSION 1 3
/begin PROJECT P383 "BMW DDE6.3 8-Zylinder V9E.3 11.10.2004 CAN12H"
/begin HEADER "" VERSION "V9E.3_8Z_CAN12H" PROJECT_NO P383 /end HEADER
/begin MODULE DIM ""
/begin MOD_COMMON "" BYTE_ORDER MSB_FIRST ALIGNMENT_BYTE 1 ALIGNMENT_WORD 2 ALIGNMENT_LONG 4 ALIGNMENT_FLOAT32_IEEE 4 /end MOD_COMMON
/begin CHARACTERISTIC K2REI_dCodInd_C "Kennwert Codier Index" VALUE 0xC045A Kw_Wu8 255.0 OneToOne 0.00 255.0 FORMAT "%3.0" /end CHARACTERISTIC
/begin CHARACTERISTIC K2REI_dDiaInd_C "Kennwerteblock Diagnose Index" VAL_BLK 0xC045B Kwb_Wu8 255.0 OneToOne 0.00 255.0 FORMAT "%3.0" NUMBER 2 /end CHARACTERISTIC
/begin CHARACTERISTIC K2REI_dSGFam_C "Kennwerteblock Steuergeraetefamilie/Motortype" VAL_BLK 0xC0458 Kwb_Wu8 255.0 OneToOne 0.00 255.0 FORMAT "%3.0" NUMBER 2 /end CHARACTERISTIC
/begin CHARACTERISTIC Chiste_stEnaTst_C "Schalter zum Testen des Befehlstests" VALUE 0xF8D4C Kw_Wu8 255.0 OneToOne 0.00 255.0 FORMAT "%5.1" /end CHARACTERISTIC
/begin CHARACTERISTIC K_IABGLMOT "Konstante Abgleichstrom Motor" VALUE 0x000C0AF8 TKW_VV_VV_SW 100.0 Def_i_sw_q0p001 -32.7680 32.7670 /begin FUNCTION_LIST BGCRENG /end FUNCTION_LIST FORMAT "%6.3" /end CHARACTERISTIC
/begin CHARACTERISTIC K_IABGLNL "Konstante Abgleichstrom Kl. 15" VALUE 0x000C0AFA TKW_VV_VV_SW 100.0 Def_i_sw_q0p001 -32.7680 32.7670 /begin FUNCTION_LIST BGCRENG /end FUNCTION_LIST FORMAT "%6.3" /end CHARACTERISTIC
/begin CHARACTERISTIC K_IABGLST "Konstante Abgleichstrom Start" VALUE 0x000C0AFC TKW_VV_VV_SW 100.0 Def_i_sw_q0p001 -32.7680 32.7670 /begin FUNCTION_LIST BGCRENG /end FUNCTION_LIST FORMAT "%6.3" /end CHARACTERISTIC
/begin CHARACTERISTIC K_IKEINESA "Konstante Strom wenn keine SA" VALUE 0x000C0AFE TKW_VV_VV_SW 100.0 Def_i_sw_q0p001 -32.7680 32.7670 /begin FUNCTION_LIST BGCRENG /end FUNCTION_LIST FORMAT "%6.3" /end CHARACTERISTIC
/begin CHARACTERISTIC K_CRENGOF "" VALUE 0x000C0B00 TKW_VV_VV_UW 100.0 Def_i_uw_q0p0635 0.0 4095.9375 /begin FUNCTION_LIST BGCRENG /end FUNCTION_LIST FORMAT "%6.3" /end CHARACTERISTIC
/begin CHARACTERISTIC K_CRVVTNOT "Wert vvt_iges bei vvt_es Fehlersignal" VALUE 0x000C0B02 TKW_VV_VV_UW 100.0 Def_i_uw_q0p0635 0.0 4095.9375 /begin FUNCTION_LIST BGCRENG /end FUNCTION_LIST FORMAT "%6.3" /end CHARACTERISTIC
/begin CHARACTERISTIC K_CRVVTOF "" VALUE 0x000C0B04 TKW_VV_VV_UW 100.0 Def_i_uw_q0p0635 0.0 4095.9375 /begin FUNCTION_LIST BGCRENG /end FUNCTION_LIST FORMAT "%6.3" /end CHARACTERISTIC
/begin CHARACTERISTIC KL_ELTEMP39 "Temperaturfaktor Elüfter" CURVE 0x000C0B06 TKL_SW_VV_UW 100.0 Def_f_uw_b512 0.0 511.9921 /begin FUNCTION_LIST BGCRENG /end FUNCTION_LIST
 /begin AXIS_DESCR STD_AXIS Tans Def_t_sw_q0p1 6 -3276.8000 3276.7000 FORMAT "%4.1" /end AXIS_DESCR
 FORMAT "%6.3" /end CHARACTERISTIC
/begin CHARACTERISTIC KL_ELUB60 "" CURVE 0x000C0B20 TKL_UW_VV_UW 100.0 Def_f_uw_b512 0.0 511.9921 /begin FUNCTION_LIST BGCRENG /end FUNCTION_LIST /begin AXIS_DESCR STD_AXIS Ub Def_u_uw_q0p0942 5 0.0 6173.3970 FORMAT "%4.1" /end AXIS_DESCR FORMAT "%6.3" /end CHARACTERISTIC
/begin CHARACTERISTIC KL_IABGLST "Abgleichstrom Start" CURVE 0x000C0B36 TKL_UW_VV_UB 100.0 Def_f_ub_b8 0.0 7.9687 /begin FUNCTION_LIST BGCRENG /end FUNCTION_LIST /begin AXIS_DESCR STD_AXIS Ub Def_u_uw_q0p0942 5 0.0 6173.3970 FORMAT "%4.1" /end AXIS_DESCR /end CHARACTERISTIC
/begin CHARACTERISTIC KL_IABGLMOT "Abgleichstrom Motor" CURVE 0x000C0B48 TKL_UW_VV_UB 100.0 Def_f_ub_b8 0.0 7.9687 /begin FUNCTION_LIST BGCRENG /end FUNCTION_LIST /begin AXIS_DESCR STD_AXIS Ub Def_u_uw_q0p0942 5 0.0 6173.3970 FORMAT "%4.1" /end AXIS_DESCR /end CHARACTERISTIC
/begin CHARACTERISTIC KL_ELUB39 "" CURVE 0x000C0B5A TKL_UW_VV_UW 100.0 Def_f_uw_b512 0.0 511.9921 /begin FUNCTION_LIST BGCRENG /end FUNCTION_LIST /begin AXIS_DESCR STD_AXIS Ub Def_u_uw_q0p0942 5 0.0 6173.3970 FORMAT "%4.1" /end AXIS_DESCR FORMAT "%6.3" /end CHARACTERISTIC
/begin CHARACTERISTIC KL_ELTEMP60 "Temperaturfaktor Elüfter" CURVE 0x000C0B70 TKL_SW_VV_UW 100.0 Def_f_uw_b512 0.0 511.9921 /begin FUNCTION_LIST BGCRENG /end FUNCTION_LIST
 /begin AXIS_DESCR STD_AXIS Tans Def_t_sw_q0p1 6 -3276.8000 3276.7000 FORMAT "%4.1" /end AXIS_DESCR
 FORMAT "%6.3" /end CHARACTERISTIC
/begin CHARACTERISTIC KL_ELSLS "Kennlinie E-Lüfter Strom" CURVE 0x000C0B8A TKL_UW_VV_UW 100.0 Def_i_uw_q0p0635 0.0 255.0000 /begin FUNCTION_LIST BGCRENG /end FUNCTION_LIST /begin AXIS_DESCR STD_AXIS Ub Def_u_uw_q0p0942 3 0.0 6173.3970 FORMAT "%4.1" /end AXIS_DESCR FORMAT "%6.3" /end CHARACTERISTIC
/begin CHARACTERISTIC KL_IABGLNL "Abgleichstrom Kl. 15" CURVE 0x000C0B98 TKL_UW_VV_UB 100.0 Def_f_ub_b8 0.0 7.9687 /begin FUNCTION_LIST BGCRENG /end FUNCTION_LIST /begin AXIS_DESCR STD_AXIS Ub Def_u_uw_q0p0942 5 0.0 6173.3970 FORMAT "%4.1" /end AXIS_DESCR /end CHARACTERISTIC
/begin CHARACTERISTIC KF_ELUPWM60 "Strom E-Lüfter über pwm und ub" MAP 0x000C0BAA TKF_UW_UB_UW 100.0 Def_i_uw_q0p0635 0.0 64.0000 /begin FUNCTION_LIST BGCRENG /end FUNCTION_LIST /begin AXIS_DESCR STD_AXIS L_pwmout Def_tv_ub_q0p390625 8 0.0 99.6093 /end AXIS_DESCR /begin AXIS_DESCR STD_AXIS NO_INPUT_QUANTITY Def_v_uw_q1p0 8 0.0 360.0000 /end AXIS_DESCR FORMAT "%6.3" /end CHARACTERISTIC
/begin CHARACTERISTIC KF_ELUPWM39 "Strom E-Lüfter über pwm und ub" MAP 0x000C0C44 TKF_UW_UB_UW 100.0 Def_i_uw_q0p0635 0.0 64.0000 /begin FUNCTION_LIST BGCRENG /end FUNCTION_LIST /begin AXIS_DESCR STD_AXIS L_pwmout Def_tv_ub_q0p390625 8 0.0 99.6093 /end AXIS_DESCR /begin AXIS_DESCR STD_AXIS NO_INPUT_QUANTITY Def_v_uw_q1p0 8 0.0 360.0000 /end AXIS_DESCR FORMAT "%6.3" /end CHARACTERISTIC
/begin CHARACTERISTIC K_DFRUTYP "DF-Rückschaltungstyp für LLR-Anhebung" VALUE 0x000C0CDE TKW_VV_VV_UB 100.0 Def_st_ub_q1 0.0 255.0000 /begin FUNCTION_LIST BGLLGEN_1PR /end FUNCTION_LIST /end CHARACTERISTIC
/begin CHARACTERISTIC K_IGENLLRANH "Generatorstromabstand für LL-Anhebung" VALUE 0x000C0CDF TKW_VV_VV_UB 100.0 Def_i_ub_q1 0.0 254.0000 /begin FUNCTION_LIST BGLLGEN_1PR /end FUNCTION_LIST /end CHARACTERISTIC
/begin CHARACTERISTIC K_LLRABS_DF "DF-Schwelle für LL-Absenkung" VALUE 0x000C0CE0 TKW_VV_VV_UB 100.0 Def_f_ub_b100 0.0 99.6093 /begin FUNCTION_LIST BGLLGEN_1PR /end FUNCTION_LIST /end CHARACTERISTIC
/begin CHARACTERISTIC K_LLRANH_DF "DF-Schwelle für LL-Anhebung" VALUE 0x000C0CE1 TKW_VV_VV_UB 100.0 Def_f_ub_b100 0.0 99.6093 /begin FUNCTION_LIST BGLLGEN_1PR /end FUNCTION_LIST /end CHARACTERISTIC
/begin CHARACTERISTIC K_NTWBGLLGEN "Notlaufwert Leerlaufanhebung bei Generatorfehler" VALUE 0x000C0CE2 TKW_VV_VV_UB 100.0 Def_st_ub_q1 0.0 1.0000 /begin FUNCTION_LIST BGLLGEN_1PR /end FUNCTION_LIST /end CHARACTERISTIC
/begin CHARACTERISTIC K_PRELLDFAH "Prellzeit für LLR-Anhebung" VALUE 0x000C0CE3 TKW_VV_VV_UB 100.0 Def_td_ub_q0p1 0.0 25.5000 /begin FUNCTION_LIST BGLLGEN_1PR /end FUNCTION_LIST /end CHARACTERISTIC
/begin CHARACTERISTIC K_PRELLDFRF "Prellzeit für LLR-Absenkung" VALUE 0x000C0CE4 TKW_VV_VV_UB 100.0 Def_td_ub_q0p1 0.0 25.5000 /begin FUNCTION_LIST BGLLGEN_1PR /end FUNCTION_LIST /end CHARACTERISTIC
/begin CHARACTERISTIC KF_DFIGEN2 "inv. Generator-DF-Ausgang" MAP 0x000C0CE5 TKF_UB_UB_UB 100.0 Def_f_ub_b100 0.0 99.6093 /begin FUNCTION_LIST BGLLGEN_1PR /end FUNCTION_LIST /begin AXIS_DESCR STD_AXIS NO_INPUT_QUANTITY Def_i_ub_q1 8 0.0 255.0000 /end AXIS_DESCR /begin AXIS_DESCR STD_AXIS I_genrllrah Def_i_ub_q1 8 0.0 255.0000 /end AXIS_DESCR /end CHARACTERISTIC
/begin CHARACTERISTIC KF_DFIGEN1 "inv. Generator-DF-Ausgang" MAP 0x000C0D37 TKF_UB_UB_UB 100.0 Def_f_ub_b100 0.0 99.6093 /begin FUNCTION_LIST BGLLGEN_1PR /end FUNCTION_LIST /begin AXIS_DESCR STD_AXIS NO_INPUT_QUANTITY Def_i_ub_q1 8 0.0 255.0000 /end AXIS_DESCR /begin AXIS_DESCR STD_AXIS I_genrllrah Def_i_ub_q1 8 0.0 255.0000 /end AXIS_DESCR /end CHARACTERISTIC
/begin CHARACTERISTIC KF_DFIGEN4 "inv. Generator-DF-Ausgang" MAP 0x000C0D89 TKF_UB_UB_UB 100.0 Def_f_ub_b100 0.0 99.6093 /begin FUNCTION_LIST BGLLGEN_1PR /end FUNCTION_LIST /begin AXIS_DESCR STD_AXIS NO_INPUT_QUANTITY Def_i_ub_q1 8 0.0 255.0000 /end AXIS_DESCR /begin AXIS_DESCR STD_AXIS I_genrllrah Def_i_ub_q1 8 0.0 255.0000 /end AXIS_DESCR /end CHARACTERISTIC
/begin CHARACTERISTIC KF_DFIGEN3 "inv. Generator-DF-Ausgang" MAP 0x000C0DDB TKF_UB_UB_UB 100.0 Def_f_ub_b100 0.0 99.6093 /begin FUNCTION_LIST BGLLGEN_1PR /end FUNCTION_LIST /begin AXIS_DESCR STD_AXIS NO_INPUT_QUANTITY Def_i_ub_q1 8 0.0 255.0000 /end AXIS_DESCR /begin AXIS_DESCR STD_AXIS I_genrllrah Def_i_ub_q1 8 0.0 255.0000 /end AXIS_DESCR /end CHARACTERISTIC
/begin CHARACTERISTIC K_QMIN "Minimale Einspritzmenge" VALUE 0x000C0E2E TKW_VV_VV_SW 100.0 Def_me_sw_q0p01 -327.6800 327.6700 /begin FUNCTION_LIST BRWT /end FUNCTION_LIST FORMAT "%6.3" /end CHARACTERISTIC
/begin CHARACTERISTIC K_BRWTKINT "BRWT K-Integrator" VALUE 0x000C0E30 TKW_VV_VV_UW 100.0 Def_dez_uw_q1 0.0 65535.0000 /begin FUNCTION_LIST BRWT /end FUNCTION_LIST /end CHARACTERISTIC
/begin CHARACTERISTIC K_BRWTDA "Berechnete Wandtemp oder Diff zu MAP" VALUE 0x000C0E32 TKW_VV_VV_UB 100.0 ident 0.0 255.0000 /begin FUNCTION_LIST BRWT /end FUNCTION_LIST /end CHARACTERISTIC
/begin CHARACTERISTIC K_ENGSTSTRT "Engine Status Start warten auf Startabwurf" VALUE 0x000C0E33 TKW_VV_VV_UB 100.0 Def_dez_ub_q1 0.0 255.0000 /begin FUNCTION_LIST BRWT /end FUNCTION_LIST /end CHARACTERISTIC
/begin CHARACTERISTIC S_BRWT "Aktivierung der Funktion Brennraumwandtemperatur" VALUE 0x000C0E34 TKW_VV_VV_UB 100.0 ident 0.0 255.0000 /begin FUNCTION_LIST BRWT /end FUNCTION_LIST /end CHARACTERISTIC
/begin CHARACTERISTIC KL_COOLING "KL Abkuehlverhalten" CURVE 0x000C0E36 TKL_UW_VV_UB 100.0 Def_f_ub_b1 0.0 0.9960 /begin FUNCTION_LIST BRWT /end FUNCTION_LIST /begin AXIS_DESCR STD_AXIS Tn_abstell Def_dez_uw_q1 6 0.0 65535.0000 /end AXIS_DESCR /end CHARACTERISTIC
/begin CHARACTERISTIC KF_TAIR_MHFM "KF deltaT - TWand-Tans - Ml" MAP 0x000C0E4A TKF_SW_SW_SW 100.0 Def_t_sw_q0p01 -327.6800 327.6700 /begin FUNCTION_LIST BRWT /end FUNCTION_LIST
 /begin AXIS_DESCR STD_AXIS NO_INPUT_QUANTITY Def_t_sw_q0p01 5 -327.6800 327.6700 FORMAT "%5.2" /end AXIS_DESCR
 /begin AXIS_DESCR STD_AXIS Ml Def_ml_sw_q0p1 5 -3276.8000 3276.7000 FORMAT "%5.2" /end AXIS_DESCR
 FORMAT "%5.2" /end CHARACTERISTIC
/begin CHARACTERISTIC KF_DTW_TWA "KF deltaT - Nkw - TWand-Tans" MAP 0x000C0E92 TKF_SW_SW_SW 100.0 Def_t_sw_q0p01 -327.6800 327.6700 /begin FUNCTION_LIST BRWT /end FUNCTION_LIST /begin AXIS_DESCR STD_AXIS Nkw Def_n_sw_q1p0 5 -32768.0000 32767.0000 /end AXIS_DESCR
 /begin AXIS_DESCR STD_AXIS NO_INPUT_QUANTITY Def_t_sw_q0p01 5 -327.6800 327.6700 FORMAT "%5.2" /end AXIS_DESCR
 FORMAT "%5.2" /end CHARACTERISTIC
/begin CHARACTERISTIC KF_TAIRMHFMS "KF deltaT - TWand-Tans - Ml im Schub" MAP 0x000C0EDA TKF_SW_SW_SW 100.0 Def_t_sw_q0p01 -327.6800 327.6700 /begin FUNCTION_LIST BRWT /end FUNCTION_LIST
 /begin AXIS_DESCR STD_AXIS NO_INPUT_QUANTITY Def_t_sw_q0p01 5 -327.6800 327.6700 FORMAT "%5.2" /end AXIS_DESCR
 /begin AXIS_DESCR STD_AXIS Ml Def_ml_sw_q0p1 5 -3276.8000 3276.7000 FORMAT "%5.2" /end AXIS_DESCR
 FORMAT "%5.2" /end CHARACTERISTIC
/begin CHARACTERISTIC KF_DTW_QN "KF deltaT - Me  - Nkw" MAP 0x000C0F22 TKF_SW_SW_SW 100.0 Def_t_sw_q0p01 -327.6800 327.6700 /begin FUNCTION_LIST BRWT /end FUNCTION_LIST /begin AXIS_DESCR STD_AXIS Nkw Def_n_sw_q1p0 5 -32768.0000 32767.0000 /end AXIS_DESCR
 /begin AXIS_DESCR STD_AXIS Me_ist Def_me_sw_q0p01 5 -327.6800 327.6700 FORMAT "%6.3" /end AXIS_DESCR
 FORMAT "%5.2" /end CHARACTERISTIC
/begin CHARACTERISTIC KF_TWPST_MAP "KF TWand - Nkw - Me von Prüfstand" MAP 0x000C0F6A TKF_SW_SW_SW 100.0 Def_t_sw_q0p1 -3276.8000 3276.7000 /begin FUNCTION_LIST BRWT /end FUNCTION_LIST /begin AXIS_DESCR STD_AXIS Nkw Def_n_sw_q1p0 16 -32768.0000 32767.0000 /end AXIS_DESCR
 /begin AXIS_DESCR STD_AXIS Me_ist Def_me_sw_q0p01 16 -327.6800 327.6700 FORMAT "%6.3" /end AXIS_DESCR
 FORMAT "%4.1" /end CHARACTERISTIC
/begin CHARACTERISTIC SrvPmp_facSTWAV_CUR "Korrekturkennlinie (Geschwindigkeit Lenkradwinkel) für den Momentenwunsch der Servopumpe" CURVE 0xF8770 Kl_Xs16_Ws16 10.00000 Fact 0.00 10.00000 FORMAT "%8.5" EXTENDED_LIMITS -4.000000 3.999878
 /begin AXIS_DESCR STD_AXIS SrvPmp_dphiStrg_mp AngleGradPerSec 7 -180.0192 180.0192 FORMAT "%8.4" EXTENDED_LIMITS -1440.154 1440.110 DEPOSIT ABSOLUTE /end AXIS_DESCR
/end CHARACTERISTIC
/begin CHARACTERISTIC SrvPmp_facVS_CUR "Korrekturkennlinie (Geschwindigkeit) für den Momentenwunsch der Servopumpe" CURVE 0xF878E Kl_Xs16_Ws16 10.00000 Fact 0.00 10.00000 FORMAT "%8.5" EXTENDED_LIMITS -4.000000 3.999878
 /begin AXIS_DESCR STD_AXIS VSSCD_v Vel 7 0.00 300.0000 FORMAT "%8.4" EXTENDED_LIMITS -327.6800 327.6700 DEPOSIT ABSOLUTE /end AXIS_DESCR
/end CHARACTERISTIC
/begin CHARACTERISTIC SrvPmp_rTrans_C "Transmission ratio of SrvPmp" VALUE 0xF87AC Kw_Ws16 200.0000 TransR 0.00 200.0000 FORMAT "%8.4" EXTENDED_LIMITS -327.6800 327.6700 /end CHARACTERISTIC
/begin CHARACTERISTIC SrvPmp_trqSTWABase_CUR "Basiskennlinie für dem Momentenwunsch der Servopumpe" CURVE 0xF87AE Kl_Xs16_Ws16 1500.000 Trq -500.0000 1000.000 FORMAT "%8.3" EXTENDED_LIMITS -3276.800 3276.700
 /begin AXIS_DESCR STD_AXIS FrmMng_phiStrg AngleGrad 7 -180.0192 180.0192 FORMAT "%8.4" EXTENDED_LIMITS -1440.154 1440.110 DEPOSIT ABSOLUTE /end AXIS_DESCR
/end CHARACTERISTIC
/begin CHARACTERISTIC SSpMon_DebSRCHighSplyVltgDef1_C "Fehlerentprellung SRC High für Sensorversorgungsspannung 1" VALUE 0xF87CC Kw_Wu16 655350.0 Time_ms 0.00 655350.0 FORMAT "%8.1" /end CHARACTERISTIC
/begin CHARACTERISTIC SSpMon_DebSRCHighSplyVltgOk1_C "Heilungsentprellung SRC High für Sensorversorgungsspannung 1" VALUE 0xF87CE Kw_Wu16 655350.0 Time_ms 0.00 655350.0 FORMAT "%8.1" /end CHARACTERISTIC
/begin CHARACTERISTIC SSpMon_DebSRCHighSplyVltgDef2_C "Fehlerentprellung SRC High für Sensorversorgungsspannung 2" VALUE 0xF87D0 Kw_Wu16 655350.0 Time_ms 0.00 655350.0 FORMAT "%8.1" /end CHARACTERISTIC
/begin CHARACTERISTIC SSpMon_DebSRCHighSplyVltgOk2_C "Heilungsentprellung SRC High für Sensorversorgungsspannung 2" VALUE 0xF87D2 Kw_Wu16 655350.0 Time_ms 0.00 655350.0 FORMAT "%8.1" /end CHARACTERISTIC
/begin CHARACTERISTIC SSpMon_DebSRCHighSplyVltgDef3_C "Fehlerentprellung SRC High für Sensorversorgungsspannung 3" VALUE 0xF87D4 Kw_Wu16 655350.0 Time_ms 0.00 655350.0 FORMAT "%8.1" /end CHARACTERISTIC
/begin CHARACTERISTIC SSpMon_DebSRCHighSplyVltgOk3_C "Heilungsentprellung SRC High für Sensorversorgungsspannung 3" VALUE 0xF87D6 Kw_Wu16 655350.0 Time_ms 0.00 655350.0 FORMAT "%8.1" /end CHARACTERISTIC
/begin CHARACTERISTIC SSpMon_DebSRCHighSplyVltgDef4_C "Fehlerentprellung SRC High für Sensorversorgungsspannung 4 (Slave)" VALUE 0xF87D8 Kw_Wu16 655350.0 Time_ms 0.00 655350.0 FORMAT "%8.1" /end CHARACTERISTIC
/begin CHARACTERISTIC SSpMon_DebSRCHighSplyVltgOk4_C "Heilungsentprellung SRC High für Sensorversorgungsspannung 4" VALUE 0xF87DA Kw_Wu16 655350.0 Time_ms 0.00 655350.0 FORMAT "%8.1" /end CHARACTERISTIC
/begin CHARACTERISTIC SSpMon_DebSRCHighSplyVltgDef5_C "Fehlerentprellung SRC High für Sensorversorgungsspannung 5" VALUE 0xF87DC Kw_Wu16 655350.0 Time_ms 0.00 655350.0 FORMAT "%8.1" /end CHARACTERISTIC
/begin CHARACTERISTIC SSpMon_DebSRCHighSplyVltgOk5_C "Heilungsentprellung SRC High für Sensorversorgungsspannung 5" VALUE 0xF87DE Kw_Wu16 655350.0 Time_ms 0.00 655350.0 FORMAT "%8.1" /end CHARACTERISTIC
/begin CHARACTERISTIC SSpMon_DebSRCHighSplyVltgDef6_C "Fehlerentprellung SRC High für Sensorversorgungsspannung 6" VALUE 0xF87E0 Kw_Wu16 655350.0 Time_ms 0.00 655350.0 FORMAT "%8.1" /end CHARACTERISTIC
/begin CHARACTERISTIC SSpMon_DebSRCHighSplyVltgOk6_C "Heilungsentprellung SRC High für Sensorversorgungsspannung 6" VALUE 0xF87E2 Kw_Wu16 655350.0 Time_ms 0.00 655350.0 FORMAT "%8.1" /end CHARACTERISTIC
/begin CHARACTERISTIC SSpMon_DebSRCLowSplyVltgDef1_C "Defektentprellung SRC Low für Sensorversorgungsspannung 1" VALUE 0xF87E4 Kw_Wu16 655350.0 Time_ms 0.00 655350.0 FORMAT "%8.1" /end CHARACTERISTIC
/begin CHARACTERISTIC SSpMon_DebSRCLowSplyVltgOk1_C "Heilungsentprellung SRC Low für Sensorversorgungsspannung 1" VALUE 0xF87E6 Kw_Wu16 655350.0 Time_ms 0.00 655350.0 FORMAT "%8.1" /end CHARACTERISTIC
/begin CHARACTERISTIC SSpMon_DebSRCLowSplyVltgDef2_C "Defektentprellung SRC Low für Sensorversorgungsspannung 2" VALUE 0xF87E8 Kw_Wu16 655350.0 Time_ms 0.00 655350.0 FORMAT "%8.1" /end CHARACTERISTIC
/begin CHARACTERISTIC SSpMon_DebSRCLowSplyVltgOk2_C "Heilungsentprellung SRC Low für Sensorversorgungsspannung 2" VALUE 0xF87EA Kw_Wu16 655350.0 Time_ms 0.00 655350.0 FORMAT "%8.1" /end CHARACTERISTIC
/begin CHARACTERISTIC SSpMon_DebSRCLowSplyVltgDef3_C "Defektentprellung SRC Low für Sensorversorgungsspannung 3" VALUE 0xF87EC Kw_Wu16 655350.0 Time_ms 0.00 655350.0 FORMAT "%8.1" /end CHARACTERISTIC
/begin CHARACTERISTIC SSpMon_DebSRCLowSplyVltgOk3_C "Heilungsentprellung SRC Low für Sensorversorgungsspannung 3" VALUE 0xF87EE Kw_Wu16 655350.0 Time_ms 0.00 655350.0 FORMAT "%8.1" /end CHARACTERISTIC
/begin CHARACTERISTIC SSpMon_DebSRCLowSplyVltgDef4_C "Defektentprellung SRC Low für Sensorversorgungsspannung 4" VALUE 0xF87F0 Kw_Wu16 655350.0 Time_ms 0.00 655350.0 FORMAT "%8.1" /end CHARACTERISTIC
/begin CHARACTERISTIC SSpMon_DebSRCLowSplyVltgOk4_C "Heilungsentprellung SRC Low für Sensorversorgungsspannung 4" VALUE 0xF87F2 Kw_Wu16 655350.0 Time_ms 0.00 655350.0 FORMAT "%8.1" /end CHARACTERISTIC
/begin CHARACTERISTIC SSpMon_DebSRCLowSplyVltgDef5_C "Fehlerentprellung SRC Low für Sensorversorgungsspannung 5" VALUE 0xF87F4 Kw_Wu16 655350.0 Time_ms 0.00 655350.0 FORMAT "%8.1" /end CHARACTERISTIC
/begin CHARACTERISTIC SSpMon_DebSRCLowSplyVltgOk5_C "Heilungsentprellung SRC Low für Sensorversorgungsspannung 5" VALUE 0xF87F6 Kw_Wu16 655350.0 Time_ms 0.00 655350.0 FORMAT "%8.1" /end CHARACTERISTIC
/begin CHARACTERISTIC SSpMon_DebSRCLowSplyVltgDef6_C "Fehlerentprellung SRC Low für Sensorversorgungsspannung 6" VALUE 0xF87F8 Kw_Wu16 655350.0 Time_ms 0.00 655350.0 FORMAT "%8.1" /end CHARACTERISTIC
/begin CHARACTERISTIC SSpMon_DebSRCLowSplyVltgOk6_C "Heilungsentprellung SRC Low für Sensorversorgungsspannung 6" VALUE 0xF87FA Kw_Wu16 655350.0 Time_ms 0.00 655350.0 FORMAT "%8.1" /end CHARACTERISTIC
/begin CHARACTERISTIC SSpMon_numDiaVltg1_C "Applikationsparameter für diagnose Signal von Sensorversorgungsspannung 1" VALUE 0xF87FC Kw_Wu8 33.0000000000 NumPinDia 0.00 33.0000000000 FORMAT "%13.10" /end CHARACTERISTIC
/begin CHARACTERISTIC SSpMon_numDiaVltg2_C "Applikationsparameter für diagnose Signal von Sensorversorgungsspannung 2" VALUE 0xF87FD Kw_Wu8 33.0000000000 NumPinDia 0.00 33.0000000000 FORMAT "%13.10" /end CHARACTERISTIC
/begin CHARACTERISTIC SSpMon_numDiaVltg3_C "Applikationsparameter für diagnose Signal von Sensorversorgungsspannung 3" VALUE 0xF87FE Kw_Wu8 33.0000000000 NumPinDia 0.00 33.0000000000 FORMAT "%13.10" /end CHARACTERISTIC
/begin CHARACTERISTIC SSpMon_numDiaVltg4_C "Applikationsparameter für Diagnose Signal von Sensorversorgungsspannung 4" VALUE 0xF87FF Kw_Wu8 33.0000000000 NumPinDia 0.00 33.0000000000 FORMAT "%13.10" /end CHARACTERISTIC
/begin CHARACTERISTIC SSpMon_numDiaVltg5_C "Applikationsparameter für Diagnose Signal von Sensorversorgungsspannung 5" VALUE 0xF8800 Kw_Wu8 33.0000000000 NumPinDia 0.00 33.0000000000 FORMAT "%13.10" /end CHARACTERISTIC
/begin CHARACTERISTIC SSpMon_numDiaVltg6_C "Applikationsparameter für Diagnose Signal von Sensorversorgungsspannung 6" VALUE 0xF8801 Kw_Wu8 33.0000000000 NumPinDia 0.00 33.0000000000 FORMAT "%13.10" /end CHARACTERISTIC
/begin CHARACTERISTIC StdPWM_DebExcTempDef_C "Defekerkennungszeit Übertemperatur für Standard PWM Endstufen" VALUE 0xF8802 Kw_Wu16 655350.0 Time_ms 0.00 655350.0 FORMAT "%8.1" /end CHARACTERISTIC
/begin CHARACTERISTIC StdPWM_DebExcTempOk_C "Heilzeit Übertemperatur für Standard PWM Endstufen" VALUE 0xF8804 Kw_Wu16 655350.0 Time_ms 0.00 655350.0 FORMAT "%8.1" /end CHARACTERISTIC
/begin CHARACTERISTIC StdPWM_DebNoLoadDef_C "Defekerkennungszeit Leerlauf für Standard PWM Endstufen" VALUE 0xF8806 Kw_Wu16 655350.0 Time_ms 0.00 655350.0 FORMAT "%8.1" /end CHARACTERISTIC
/begin CHARACTERISTIC StdPWM_DebNoLoadOk_C "Heilzeit Leerlauf für Standard PWM Endstufen" VALUE 0xF8808 Kw_Wu16 655350.0 Time_ms 0.00 655350.0 FORMAT "%8.1" /end CHARACTERISTIC
/begin CHARACTERISTIC StdPWM_DebShortCircBatDef_C "Defekerkennungszeit Kurzschluß Batterie für Standard PWM Endstufen" VALUE 0xF880A Kw_Wu16 655350.0 Time_ms 0.00 655350.0 FORMAT "%8.1" /end CHARACTERISTIC
/begin CHARACTERISTIC StdPWM_DebShortCircBatOk_C "Heilzeit Kurzschluß Batterie für Standard PWM Endstufen" VALUE 0xF880C Kw_Wu16 655350.0 Time_ms 0.00 655350.0 FORMAT "%8.1" /end CHARACTERISTIC
/begin CHARACTERISTIC StdPWM_DebShortCircGndDef_C "Defekerkennungszeit Kurzschluß Masse für Standard PWM Endstufen" VALUE 0xF880E Kw_Wu16 655350.0 Time_ms 0.00 655350.0 FORMAT "%8.1" /end CHARACTERISTIC
/begin CHARACTERISTIC StdPWM_DebShortCircGndOk_C "Heilzeit Kurzschluß Masse für Standard PWM Endstufen" VALUE 0xF8810 Kw_Wu16 655350.0 Time_ms 0.00 655350.0 FORMAT "%8.1" /end CHARACTERISTIC
/begin CHARACTERISTIC StdPWM_rTst_C "Testtastverhältnis im Fehlerfall für Standard PWM Endstufen" VALUE 0xF8812 Kw_Ws16 100.0000 DtyCyc 0.00 100.0000 FORMAT "%8.4" EXTENDED_LIMITS -327.6800 327.6700 /end CHARACTERISTIC
/begin CHARACTERISTIC StdPWM_tiBtwTst_C "Zeit zwischen zwei Endstufentests im Fehlerfall für Standard PWM Endstufen" VALUE 0xF8814 Kw_Wu16 29980.00 Time_ms 20.00000 30000.00 FORMAT "%8.2" EXTENDED_LIMITS 0.00 655350.0 /end CHARACTERISTIC
/begin CHARACTERISTIC StrtCD_ActrDebExcTempDef_C "Fehlerentprellzeit für Übertemperatur" VALUE 0xF8816 Kw_Wu16 655350.0 Time_ms 0.00 655350.0 FORMAT "%8.1" /end CHARACTERISTIC
/begin CHARACTERISTIC StrtCD_ActrDebExcTempOk_C "Fehlerheilzeit für Übertemperatur" VALUE 0xF8818 Kw_Wu16 655350.0 Time_ms 0.00 655350.0 FORMAT "%8.1" /end CHARACTERISTIC
/begin CHARACTERISTIC StrtCD_ActrDebNoLoadDef_C "Fehlerentprellzeit für Drahtbruch" VALUE 0xF881A Kw_Wu16 655350.0 Time_ms 0.00 655350.0 FORMAT "%8.1" /end CHARACTERISTIC
/begin CHARACTERISTIC StrtCD_ActrDebNoLoadOk_C "Fehlerheilzeit für Drahtbruch" VALUE 0xF881C Kw_Wu16 655350.0 Time_ms 0.00 655350.0 FORMAT "%8.1" /end CHARACTERISTIC
/begin CHARACTERISTIC StrtCD_ActrDebShrtCBatDef_C "Fehlerentprellzeit KS nach U_Batt" VALUE 0xF881E Kw_Wu16 655350.0 Time_ms 0.00 655350.0 FORMAT "%8.1" /end CHARACTERISTIC
/begin CHARACTERISTIC StrtCD_ActrDebShrtCBatOk_C "Fehlerheilzeit KS nach U_Batt" VALUE 0xF8820 Kw_Wu16 655350.0 Time_ms 0.00 655350.0 FORMAT "%8.1" /end CHARACTERISTIC
/begin CHARACTERISTIC StrtCD_ActrDebShrtCGndDef_C "Fehlerentprellzeit KS nach Gnd" VALUE 0xF8822 Kw_Wu16 655350.0 Time_ms 0.00 655350.0 FORMAT "%8.1" /end CHARACTERISTIC
/begin CHARACTERISTIC StrtCD_ActrDebShrtCGndOk_C "Fehlerheilzeit KS nach Gnd" VALUE 0xF8824 Kw_Wu16 655350.0 Time_ms 0.00 655350.0 FORMAT "%8.1" /end CHARACTERISTIC
/begin CHARACTERISTIC StrtCD_ctPwrStgOnMax_C "Maximaler Zähler für Powerstage On im Fehlerfall" VALUE 0xF8826 Kw_Wu16 65535.00 OneToOne 0.00 65535.00 FORMAT "%8.2" /end CHARACTERISTIC
/begin CHARACTERISTIC StrtCD_numDia_C "Auswahl des Diagnosesignals der Startrelayendstufe" VALUE 0xF8828 Kw_Wu8 33.0000000000 NumPinDia 0.00 33.0000000000 FORMAT "%13.10" /end CHARACTERISTIC
/begin CHARACTERISTIC StrtCD_numDioOut_C "Auswahl des Digitalausgangspins für Starterrelay" VALUE 0xF8829 Kw_Wu8 15.0000000000 NumPinDioOut 0.00 15.0000000000 FORMAT "%13.10" /end CHARACTERISTIC
/begin CHARACTERISTIC StrtCD_stActrInvOut_C "invertiere Starter Relais Steller Ausgang" VALUE 0xF882A Kw_Wu8 1.000 OneToOne 0.00 1.000 FORMAT "%5.3" EXTENDED_LIMITS 0.00 255.0 /end CHARACTERISTIC
/begin CHARACTERISTIC StrtCD_stPwrStgActrActv_C "Statuswort für Endstufenabschaltung durch den Motorkoordinator" VALUE 0xF882B Kw_Wu8 255.0 OneToOne 0.00 255.0 FORMAT "%5.1" /end CHARACTERISTIC
/begin CHARACTERISTIC StrtCD_stPwrStgActrDia_C "Statuswort für Endstufendiagnoseabschaltung durch den Motorkoordinator" VALUE 0xF882C Kw_Wu8 254.0 OneToOne 1.000 255.0 FORMAT "%5.1" EXTENDED_LIMITS 0.00 255.0 /end CHARACTERISTIC
/begin CHARACTERISTIC StrtCD_stSPICtl_C "Schalter ob Endstufe SPI kontrollierbar = 1 oder nicht SPI kontrollierbar = 0" VALUE 0xF882D Kw_Wu8 1.000 OneToOne 0.00 1.000 FORMAT "%5.3" EXTENDED_LIMITS 0.00 255.0 /end CHARACTERISTIC
/begin CHARACTERISTIC StrtCD_tiBtwTst_C "Zeitabstand, in dem die Endstufe im Fehlerfall getestet wird" VALUE 0xF882E Kw_Wu16 29980.00 Time_ms 20.00000 30000.00 FORMAT "%8.2" EXTENDED_LIMITS 0.00 655350.0 /end CHARACTERISTIC
/begin CHARACTERISTIC StrtCD_tiPwrStgOn_C "Zeit für welche die Endstufe im Fehlerfall eingeschalten wird (nur nicht SPI kontrolliert)" VALUE 0xF8830 Kw_Wu16 655140.0 Time_ms 0.00 655140.0 FORMAT "%8.1" EXTENDED_LIMITS 0.00 655350.0 /end CHARACTERISTIC
/begin CHARACTERISTIC StSys_DebTrqShutOffDef_C "Fehlerentprellzeit T50shutoff" VALUE 0xF8B54 Kw_Wu16 655350.0 Time_ms 0.00 655350.0 FORMAT "%8.1" /end CHARACTERISTIC
/begin CHARACTERISTIC StSys_DebTrqShutOffOk_C "Heilungsentprellzeit T50shutoff" VALUE 0xF8B56 Kw_Wu16 655350.0 Time_ms 0.00 655350.0 FORMAT "%8.1" /end CHARACTERISTIC
/begin CHARACTERISTIC StSys_facAPSCor_CUR "atmospheric pressure correction factor" CURVE 0xF8836 Kl_Xs16_Ws16 4.000000 Fact 0.00 4.000000 FORMAT "%8.6" EXTENDED_LIMITS -4.000000 3.999878
 /begin AXIS_DESCR STD_AXIS APSCD_pVal Pres_hPa 8 0.00 4000.000 FORMAT "%8.3" EXTENDED_LIMITS -32768.00 32767.00 DEPOSIT ABSOLUTE /end AXIS_DESCR
/end CHARACTERISTIC
/begin CHARACTERISTIC StSys_n2MsWhlLoLim_C "untere kritische Drehzahlgrenze (ZMS-Resonanz)" VALUE 0xF8B60 Kw_Ws16 1000.000 EngN 0.00 1000.000 FORMAT "%8.3" EXTENDED_LIMITS -32768.00 32767.00 /end CHARACTERISTIC
/begin CHARACTERISTIC StSys_n2MsWhlUpOfs_C "Offset for starting trq shutoff" VALUE 0xF8B62 Kw_Ws16 1000.000 EngN 0.00 1000.000 FORMAT "%8.3" EXTENDED_LIMITS -32768.00 32767.00 /end CHARACTERISTIC
/begin CHARACTERISTIC StSys_nAdjMax_C "Abgleichende-Drehzahl" VALUE 0xF89A6 Kw_Ws16 65535.00 EngN -32768.00 32767.00 FORMAT "%8.2" /end CHARACTERISTIC
/begin CHARACTERISTIC StSys_nDiseng_C "Anlasserabwurfdrehzahlschwelle" VALUE 0xF8A76 Kw_Ws16 6000.000 EngN 0.00 6000.000 FORMAT "%8.3" EXTENDED_LIMITS -32768.00 32767.00 /end CHARACTERISTIC
/begin CHARACTERISTIC StSys_nEngage_C "Anlassereinspurdrehzahlschwelle" VALUE 0xF8A78 Kw_Ws16 0.00 EngN 0.00 0.00 FORMAT "%8.2" EXTENDED_LIMITS -32768.00 32767.00 /end CHARACTERISTIC
/begin CHARACTERISTIC StSys_tinFltPT1_C "time constant for the engine speed low pass filter" VALUE 0xF8B64 Kw_Wu32 4294.9673 TimeDelay_s 0.0000010000000 4294.9673 FORMAT "%9.4" /end CHARACTERISTIC
/begin CHARACTERISTIC StSys_nFreezeTrqRmp_C "Rampenbegrenzungsdrehzahl" VALUE 0xF8A80 Kw_Ws16 65535.00 EngN -32768.00 32767.00 FORMAT "%8.2" /end CHARACTERISTIC
/begin CHARACTERISTIC StSys_nReleaseTrqRmp_C "Rampenfreigabedrehzahl" VALUE 0xF8A82 Kw_Ws16 65535.00 EngN -32768.00 32767.00 FORMAT "%8.2" /end CHARACTERISTIC
/begin CHARACTERISTIC StSys_nStarter_C "maximale Drehzahl für Start ohne Kl50" VALUE 0xF8B58 Kw_Ws16 6000.000 EngN 0.00 6000.000 FORMAT "%8.3" EXTENDED_LIMITS -32768.00 32767.00 /end CHARACTERISTIC
/begin CHARACTERISTIC StSys_nStrtCutOut_MAP "Kennfeld zur Bestimmung der Startabwurf-Drehzahl" MAP 0xF88FE Kf_Xs16_Ys16_Ws16 6000.000 EngN 0.00 6000.000 FORMAT "%8.3" EXTENDED_LIMITS -32768.00 32767.00
 /begin AXIS_DESCR STD_AXIS StSys_tStrt_mp Temp_Cels 8 -50.14000 899.8600 FORMAT "%8.4" EXTENDED_LIMITS -3549.940 3003.560 DEPOSIT ABSOLUTE /end AXIS_DESCR
 /begin AXIS_DESCR STD_AXIS APSCD_pVal Pres_hPa 8 0.00 3500.000 FORMAT "%8.3" EXTENDED_LIMITS -32768.00 32767.00 DEPOSIT ABSOLUTE /end AXIS_DESCR
/end CHARACTERISTIC
/begin CHARACTERISTIC StSys_nStrtTipMax_MAP "Kennfeld zur bestimmung der Maximalen Startabwurfsdrehzahl - abhängig von der Kühlmitteltemperatur und dem Luftdruck" MAP 0xF8AA4 Kf_Xs16_Ys16_Ws16 6000.000 EngN 0.00 6000.000 FORMAT "%8.3" EXTENDED_LIMITS -32768.00 32767.00
 /begin AXIS_DESCR STD_AXIS Eng_tEng Temp_Cels 8 -50.1400 899.8600 FORMAT "%8.4" EXTENDED_LIMITS -3549.940 3003.560 DEPOSIT ABSOLUTE /end AXIS_DESCR
 /begin AXIS_DESCR STD_AXIS APSCD_pVal Pres_hPa 8 0.00 3500.000 FORMAT "%8.3" EXTENDED_LIMITS -32768.00 32767.00 DEPOSIT ABSOLUTE /end AXIS_DESCR
/end CHARACTERISTIC
/begin CHARACTERISTIC StSys_nStrtTipProtCaS_C "Schwellenwert für Nockenwellensignal für Aktivierung des Blockierschutzes" VALUE 0xF8B48 Kw_Ws16 6000.000 EngN 0.00 6000.000 FORMAT "%8.3" EXTENDED_LIMITS -32768.00 32767.00 /end CHARACTERISTIC
/begin CHARACTERISTIC StSys_nStrtTipProt_C "Drehzahlschwelle für Blockierschutz" VALUE 0xF8B4A Kw_Ws16 6000.000 EngN 0.00 6000.000 FORMAT "%8.3" EXTENDED_LIMITS -32768.00 32767.00 /end CHARACTERISTIC
/begin CHARACTERISTIC StSys_numStrtAddCor_C "Selection of used engine temperature (e.g. CTSCD_tClnt, etc.)" VALUE 0xF8858 Kw_Wu8 2.00000000000 EngTempFldSel 0.00 2.00000000000 FORMAT "%13.11" /end CHARACTERISTIC
/begin CHARACTERISTIC StSys_numStrtBas_C "Auswahlparameter für das Motortemperatur-Feld Eng_tFld" VALUE 0xF89A8 Kw_Wu8 2.00000000000 EngTempFldSel 0.00 2.00000000000 FORMAT "%13.11" /end CHARACTERISTIC
/begin CHARACTERISTIC StSys_numStrtRmp_C "Parameter um die gewünschte Motortemperatur aus dem Motortemperatur-Feld Eng_tFld  zu selektieren" VALUE 0xF8A84 Kw_Wu8 2.00000000000 EngTempFldSel 0.00 2.00000000000 FORMAT "%13.11" /end CHARACTERISTIC
/begin CHARACTERISTIC StSys_numStrt_C "Parameter um die Motortemperatur für den Startabwurf aus dem Motortemperatur-Feld Eng_tFld  zu selektieren" VALUE 0xF89A2 Kw_Wu8 2.00000000000 EngTempFldSel 0.00 2.00000000000 FORMAT "%13.11" /end CHARACTERISTIC
/begin CHARACTERISTIC Stsys_swtGlwLamp_C "Schalter für Anlasserfreigabe T50 mit Status Glühanzeige (1...glow controll berücksichtigt, 0...Freigabe nur von T50 abhängig)" VALUE 0xF8A7A Kw_Wu8 1.000 OneToOne 0.00 1.000 FORMAT "%5.3" EXTENDED_LIMITS 0.00 255.0 /end CHARACTERISTIC
/begin CHARACTERISTIC StSys_swtShOffGearbxRec_C "Schalter für Aktivierung und Deaktivierung der P/N Erkennung (1: keine Erkennung --> Freigabe, 0: Erkennung)" VALUE 0xF8B4C Kw_Wu8 1.000 OneToOne 0.00 1.000 FORMAT "%5.3" EXTENDED_LIMITS 0.00 255.0 /end CHARACTERISTIC
/begin CHARACTERISTIC StSys_swtShutOff_C "Label zum Aktivieren des Tipstart-Pfades (1: aktiviert, 0: deaktiviert)" VALUE 0xF8B68 Kw_Wu8 1.000 OneToOne 0.00 1.000 FORMAT "%5.3" EXTENDED_LIMITS 0.00 255.0 /end CHARACTERISTIC
/begin CHARACTERISTIC StSys_swtStrtTipActv_C "Schalter für Tip-Start Funktion aktiviert (1...aktiviert, 0...deaktiviert)" VALUE 0xF8B4D Kw_Wu8 1.000 OneToOne 0.00 1.000 FORMAT "%5.3" EXTENDED_LIMITS 0.00 255.0 /end CHARACTERISTIC
/begin CHARACTERISTIC StSys_tClntHi_C "Temperaturschwelle Motor warm -> heiß" VALUE 0xF8A86 Kw_Ws16 950.000 Temp_Cels -50.14000 899.860 FORMAT "%8.3" EXTENDED_LIMITS -3549.940 3003.560 /end CHARACTERISTIC
/begin CHARACTERISTIC StSys_tClntLo_C "Temperaturschwelle Motor kalt -> warm" VALUE 0xF8A88 Kw_Ws16 950.000 Temp_Cels -50.14000 899.860 FORMAT "%8.3" EXTENDED_LIMITS -3549.940 3003.560 /end CHARACTERISTIC
/begin CHARACTERISTIC StSys_ti2MsWhlPrt_C "Verzögerungszeit Startmomentenabschaltung" VALUE 0xF8B6A Kw_Wu16 655350.0 Time_ms 0.00 655350.0 FORMAT "%8.1" /end CHARACTERISTIC
/begin CHARACTERISTIC StSys_tiEngageCutOut_C "Ausblendzeit nEng-ueberwachung bei Start" VALUE 0xF8B5A Kw_Wu16 655350.0 Time_ms 0.00 655350.0 FORMAT "%8.1" /end CHARACTERISTIC
/begin CHARACTERISTIC StSys_tiEngTempValid_C "Verzögerungszeit bis Motortemperatur gueltig" VALUE 0xF8A8A Kw_Wu16 655350.0 Time_ms 0.00 655350.0 FORMAT "%8.1" /end CHARACTERISTIC
/begin CHARACTERISTIC StSys_tiLckCutOut_C "ausblendzeit nEng ueberwachung bei start" VALUE 0xF8A7C Kw_Wu16 655350.0 Time_ms 0.00 655350.0 FORMAT "%8.1" /end CHARACTERISTIC
/begin CHARACTERISTIC StSys_tiStartOszilDef_C "Defect time for pulsation error" VALUE 0xF8B6C Kw_Wu16 655350.0 Time_ms 0.00 655350.0 FORMAT "%8.1" /end CHARACTERISTIC
/begin CHARACTERISTIC StSys_tiStartOszilOk_C "Healing time for pulsation error" VALUE 0xF8B6E Kw_Wu16 655350.0 Time_ms 0.00 655350.0 FORMAT "%8.1" /end CHARACTERISTIC
/begin CHARACTERISTIC StSys_tiStrtCutOut_C "Startabwurf-Sperrzeit" VALUE 0xF89A4 Kw_Wu16 655350.0 Time_ms 0.00 655350.0 FORMAT "%8.1" /end CHARACTERISTIC
/begin CHARACTERISTIC StSys_tiStrtLck_C "Anlassersperrzeit nach startabbruch" VALUE 0xF8832 Kw_Wu16 655350.0 Time_ms 0.00 655350.0 FORMAT "%8.1" /end CHARACTERISTIC
/begin CHARACTERISTIC StSys_tiStrtMax_C "max. Starterbetaetigungszeit" VALUE 0xF8834 Kw_Wu16 655350.0 Time_ms 0.00 655350.0 FORMAT "%8.1" /end CHARACTERISTIC
/begin CHARACTERISTIC StSys_tiStrtTipMin_C "min. Zeit für gedrueckten Startknopf" VALUE 0xF8B4E Kw_Wu16 655350.0 Time_ms 0.00 655350.0 FORMAT "%8.1" /end CHARACTERISTIC
/begin CHARACTERISTIC StSys_tiStrtTipNoMonitor_C "Zeitschwelle für nicht überwachte Drehzahl" VALUE 0xF8B50 Kw_Wu16 655350.0 Time_ms 0.00 655350.0 FORMAT "%8.1" /end CHARACTERISTIC
/begin CHARACTERISTIC StSys_tiStrtTipProt_C "Zeitschwelle für Drehzahl-Blockierschutz" VALUE 0xF8B52 Kw_Wu16 655350.0 Time_ms 0.00 655350.0 FORMAT "%8.1" /end CHARACTERISTIC
/begin CHARACTERISTIC StSys_trqAdjMax_C "maximales Moment fuer den Startabgleich" VALUE 0xF89AA Kw_Ws16 6553.500 Trq -3276.800 3276.700 FORMAT "%8.3" /end CHARACTERISTIC
/begin CHARACTERISTIC StSys_trqAdjVal_C "Abgleichwert fuer das Startmoment" VALUE 0xF89AC Kw_Ws16 6553.500 Trq -3276.800 3276.700 FORMAT "%8.3" /end CHARACTERISTIC
/begin CHARACTERISTIC StSys_dtrqColdInc_C "Momentinkrement fuer kalten Motor" VALUE 0xF8A8C Kw_Wu32 6553599.99847 RmpTrq 0.00 6553599.99847 FORMAT "%13.5" /end CHARACTERISTIC
/begin CHARACTERISTIC StSys_tiColdRmpLck_C "Rampensperrzeit fur kalten Motor" VALUE 0xF8A90 Kw_Wu16 655350.0 Time_ms 0.00 655350.0 FORMAT "%8.1" /end CHARACTERISTIC
/begin CHARACTERISTIC StSys_trqColdLim_C "Grenzmoment fuer kalten Motor" VALUE 0xF8A92 Kw_Ws16 3276.700 Trq 0.00 3276.700 FORMAT "%8.3" EXTENDED_LIMITS -3276.800 3276.700 /end CHARACTERISTIC
/begin CHARACTERISTIC StSys_dtrqHotInc_C "Momentinkrement fuer heißen Motor" VALUE 0xF8A94 Kw_Wu32 6553599.99847 RmpTrq 0.00 6553599.99847 FORMAT "%13.5" /end CHARACTERISTIC
/begin CHARACTERISTIC StSys_tiHotRmpLck_C "Rampensperrzeit fur heißen Motor" VALUE 0xF8A98 Kw_Wu16 655350.0 Time_ms 0.00 655350.0 FORMAT "%8.1" /end CHARACTERISTIC
/begin CHARACTERISTIC StSys_trqHotLim_C "Grenzmoment fuer heißen Motor" VALUE 0xF8A9A Kw_Ws16 3276.700 Trq 0.00 3276.700 FORMAT "%8.3" EXTENDED_LIMITS -3276.800 3276.700 /end CHARACTERISTIC
/begin CHARACTERISTIC StSys_trqStrtAPSCor_MAP " Base map for correction for starting torque" MAP 0xF885A Kf_Xs16_Ys16_Ws16 240.0000 Trq -40.10000 199.9000 FORMAT "%8.4" EXTENDED_LIMITS -3276.800 3276.700
 /begin AXIS_DESCR STD_AXIS Eng_nAvrg EngN 8 0.00 6000.000 FORMAT "%8.3" EXTENDED_LIMITS -32768.00 32767.00 DEPOSIT ABSOLUTE /end AXIS_DESCR
 /begin AXIS_DESCR STD_AXIS StSys_tStrtBas_mp Temp_Cels 8 -50.140 899.860 FORMAT "%8.3" EXTENDED_LIMITS -3549.940 3003.560 DEPOSIT ABSOLUTE /end AXIS_DESCR
/end CHARACTERISTIC
/begin CHARACTERISTIC StSys_trqStrtBas_MAP "Basismoment fuer den Start" MAP 0xF89AE Kf_Xs16_Ys16_Ws16 3276.700 Trq 0.00 3276.700 FORMAT "%8.3" EXTENDED_LIMITS -3276.800 3276.700
 /begin AXIS_DESCR STD_AXIS Eng_nAvrg EngN 8 0.00 6000.000 FORMAT "%8.3" EXTENDED_LIMITS -32768.00 32767.00 DEPOSIT ABSOLUTE /end AXIS_DESCR
 /begin AXIS_DESCR STD_AXIS CTSCD_tClnt Temp_Cels 10 -50.14000 199.8600 FORMAT "%8.4" EXTENDED_LIMITS -3549.940 3003.560 DEPOSIT ABSOLUTE /end AXIS_DESCR
/end CHARACTERISTIC
/begin CHARACTERISTIC StSys_dtrqWarmInc_C "Momentinkrement fuer warmen Motor" VALUE 0xF8A9C Kw_Wu32 6553599.99847 RmpTrq 0.00 6553599.99847 FORMAT "%13.5" /end CHARACTERISTIC
/begin CHARACTERISTIC StSys_tiWarmRmpLck_C "Rampensperrzeit fur warmen Motor" VALUE 0xF8AA0 Kw_Wu16 655350.0 Time_ms 0.00 655350.0 FORMAT "%8.1" /end CHARACTERISTIC
/begin CHARACTERISTIC StSys_trqWarmLim_C "Grenzmoment fuer warmen Motor" VALUE 0xF8AA2 Kw_Ws16 3276.700 Trq 0.00 3276.700 FORMAT "%8.3" EXTENDED_LIMITS -3276.800 3276.700 /end CHARACTERISTIC
/begin CHARACTERISTIC StSys_vThres_C "Geschw.grenze Fzg. wird angeschoben" VALUE 0xF8B5C Kw_Ws16 251.0000 Vel -1.000000 250.0000 FORMAT "%8.4" EXTENDED_LIMITS -327.6800 327.6700 /end CHARACTERISTIC
/begin CHARACTERISTIC T15CD_tiDebNeg_C "Filterzeitkonstante der Klemme 15 für fallende Flanken" VALUE 0xF8B70 Kw_Wu16 655350.0 TimeDeb 0.00 655350.0 FORMAT "%8.1" /end CHARACTERISTIC
/begin CHARACTERISTIC T15CD_tiDebPos_C "Filterzeitkonstante der Klemme 15 für steigende Flanken" VALUE 0xF8B72 Kw_Wu16 655350.0 TimeDeb 0.00 655350.0 FORMAT "%8.1" /end CHARACTERISTIC
/begin CHARACTERISTIC T15CD_DebNplDef_C "Fehlerentprellzeit für Plausibilitätsfehler" VALUE 0xF8B74 Kw_Wu16 655350.0 Time_ms 0.00 655350.0 FORMAT "%8.1" /end CHARACTERISTIC
/begin CHARACTERISTIC T15CD_DebNplOk_C "Heilungsentprellzeit für Plausibilitätsfehler" VALUE 0xF8B76 Kw_Wu16 655350.0 Time_ms 0.00 655350.0 FORMAT "%8.1" /end CHARACTERISTIC
/begin CHARACTERISTIC T15CD_numDioIn_C "Applikationsparameter fuer Klemme 15" VALUE 0xF8B78 Kw_Wu8 12.0000000000 NumPinDioIn 0.00 12.0000000000 FORMAT "%13.10" /end CHARACTERISTIC
/begin CHARACTERISTIC T15CD_stInvIn_C "Invertierungsparameter für Klemme 15 Eingangssignal" VALUE 0xF8B79 Kw_Wu8 1.000 OneToOne 0.00 1.000 FORMAT "%5.3" EXTENDED_LIMITS 0.00 255.0 READ_ONLY /end CHARACTERISTIC
/begin CHARACTERISTIC T15CD_tiDebWakeUp_C "Maximale Zeitverzögerung zwischen pos.Flankedesentprellen WakeUp Signals und Klemme15 über CAN" VALUE 0xF8B7A Kw_Wu16 655350.0 Time_ms 0.00 655350.0 FORMAT "%8.1" /end CHARACTERISTIC
/begin CHARACTERISTIC T50CD_tiDebNeg_C "Entprellzeit  fallende Flanke" VALUE 0xF8B7C Kw_Wu16 655350.0 TimeDeb 0.00 655350.0 FORMAT "%8.1" /end CHARACTERISTIC
/begin CHARACTERISTIC T50CD_tiDebPos_C "entprellzeit steigende Flanke" VALUE 0xF8B7E Kw_Wu16 655350.0 TimeDeb 0.00 655350.0 FORMAT "%8.1" /end CHARACTERISTIC
/begin CHARACTERISTIC T50CD_stDflVal_C "Vorgabewert Zustand T50" VALUE 0xF8B80 Kw_Wu8 1.000 OneToOne 0.00 1.000 FORMAT "%5.3" EXTENDED_LIMITS 0.00 255.0 /end CHARACTERISTIC
/begin CHARACTERISTIC T50CD_stInv_C "Invertierung Eingangssignal T50CD_stRawVal" VALUE 0xF8B81 Kw_Wu8 1.000 OneToOne 0.00 1.000 FORMAT "%5.3" EXTENDED_LIMITS 0.00 255.0 /end CHARACTERISTIC
/begin CHARACTERISTIC T50CD_swtSigVal_C "Signalschalter T50 (1=CAN 0=HW)" VALUE 0xF8B82 Kw_Wu8 1.000 OneToOne 0.00 1.000 FORMAT "%5.3" EXTENDED_LIMITS 0.00 255.0 /end CHARACTERISTIC
/begin CHARACTERISTIC ThrVlv_ctMonDefLimH_C "Obere Grenze für Drosselklappenfehler im Nachlauf ab der der Fehlerpfad gesetzt wird." VALUE 0xF8B84 Kw_Wu8 254.0 OneToOne 0.00 254.0 FORMAT "%5.1" EXTENDED_LIMITS 0.00 255.0 /end CHARACTERISTIC
/begin CHARACTERISTIC ThrVlv_ctMonDefLimL_C "Untere Grenze für Drosselklappenfehler im Nachlauf ab der der Fehlerpfad geheilt wird." VALUE 0xF8B85 Kw_Wu8 254.0 OneToOne 0.00 254.0 FORMAT "%5.1" EXTENDED_LIMITS 0.00 255.0 /end CHARACTERISTIC
/begin CHARACTERISTIC ThrVlv_pLimMon_C "Differenzdruck-Grenzwert für den Fall: Drosselklappe geschlossen" VALUE 0xF8B86 Kw_Ws16 3500.000 Pres_hPa 0.00 3500.000 FORMAT "%8.3" EXTENDED_LIMITS -32768.00 32767.00 /end CHARACTERISTIC
/begin CHARACTERISTIC ThrVlv_rTVA2_Vector "Konfigurationslabel für Bypass Freischnitt" VALUE 0xC39BE Kw_Wu8 255.0 OneToOne 0.00 255.0 FORMAT "%5.1" /end CHARACTERISTIC
/begin CHARACTERISTIC ThrVlv_rTVA2_Channel "Konfigurationslabel für Bypass Freischnitt" VALUE 0xC39BF Kw_Wu8 255.0 OneToOne 0.00 255.0 FORMAT "%5.1" /end CHARACTERISTIC
/begin CHARACTERISTIC ThrVlv_rTVA_Vector "Bypass-Label für ThrVlv_rTVA" VALUE 0xC39C0 Kw_Wu8 255.0 OneToOne 0.00 255.0 FORMAT "%5.1" /end CHARACTERISTIC
/begin CHARACTERISTIC ThrVlv_rTVA_Channel "Bypass-Label für ThrVlv_rTVA" VALUE 0xC39C1 Kw_Wu8 255.0 OneToOne 0.00 255.0 FORMAT "%5.1" /end CHARACTERISTIC
/begin CHARACTERISTIC ThrVlv_swtMon_C "Schalter zur Aktivierung/Deaktivierung der Drosselklappenüberwachung." VALUE 0xF8B88 Kw_Wu8 1.000 OneToOne 0.00 1.000 FORMAT "%5.3" EXTENDED_LIMITS 0.00 255.0 /end CHARACTERISTIC
/begin CHARACTERISTIC TPUMon_ctDfctLim_C "Oberer Entprellzähler Grenzwert für Defekterkennung" VALUE 0xC3CB8 Kw_Wu16 65535.00 OneToOne 0.00 65535.00 FORMAT "%8.2" /end CHARACTERISTIC
/begin CHARACTERISTIC TPUMon_ctTPU_C "Index der auf den Messpunkten dargestellten TPU" VALUE 0xC3CBA Kw_Wu8 255.0 OneToOne 0.00 255.0 FORMAT "%5.1" /end CHARACTERISTIC
/begin CHARACTERISTIC TPUMon_tiDiffMaxLimit_C "Maximal zulässige einzelne Timerdifferenz" VALUE 0xC3CBC Kw_Ws32 2147483647.00 TimeUSResolution 0.00 2147483647.00 FORMAT "%13.2" EXTENDED_LIMITS -2147483648.00 2147483647.00 /end CHARACTERISTIC
/begin CHARACTERISTIC TPUMon_tiDiffMinLimit_C "Minimal zulässige einzelne Timerdifferenz (negativer Wert)" VALUE 0xC3CC0 Kw_Ws32 2147483648.00 TimeUSResolution -2147483648.00 0.00 FORMAT "%13.2" EXTENDED_LIMITS -2147483648.00 2147483647.00 /end CHARACTERISTIC
/begin CHARACTERISTIC TPUMon_tiDiffSumLimit_C "Maximal zulässige Betragsumme Timerdifferenz" VALUE 0xC3CC4 Kw_Ws32 2147483647.00 TimeUSResolution 0.00 2147483647.00 FORMAT "%13.2" EXTENDED_LIMITS -2147483648.00 2147483647.00 /end CHARACTERISTIC
/begin CHARACTERISTIC TVACD_ctPwrStgOnMax_C "Maximaler Zähler für Powerstage On im Fehlerfall" VALUE 0xF8B8A Kw_Wu16 65535.00 OneToOne 0.00 65535.00 FORMAT "%8.2" /end CHARACTERISTIC
/begin CHARACTERISTIC TVACD_tiDebAirMonDfl8Def_C "Fehlerenprellparameter für Kurzschluss zur Batterie für throttle valve actuator PWM-Ensdstufe" VALUE 0xF8C40 Kw_Wu16 655350.0 Time_ms 0.00 655350.0 FORMAT "%8.1" /end CHARACTERISTIC
/begin CHARACTERISTIC TVACD_tiDebAirMonDfl8Ok_C "Heilenprellparameter für Kurzschluss zur Batterie für throttle valve actuator PWM-Ensdstufe" VALUE 0xF8C42 Kw_Wu16 655350.0 Time_ms 0.00 655350.0 FORMAT "%8.1" /end CHARACTERISTIC
/begin CHARACTERISTIC TVACD_tiDebAirMonDfl8BDef_C "Fehlerentprellzeit zur Fehlerheilung bei Kurzschluss zur Batterie für throttle valve actuator PWM- Endstufe" VALUE 0xF8C44 Kw_Wu16 655350.0 Time_ms 0.00 655350.0 FORMAT "%8.1" /end CHARACTERISTIC
/begin CHARACTERISTIC TVACD_tiDebAirMonDfl8BOk_C "Heilentprellzeit zur Fehlerheilung bei Kurzschluss zur battery für throttle valve actuator PWM- Endstufe" VALUE 0xF8C46 Kw_Wu16 655350.0 Time_ms 0.00 655350.0 FORMAT "%8.1" /end CHARACTERISTIC
/begin CHARACTERISTIC TVACD_DebExcTempDef_C "Fehlerentprellzeit für Übertemperatur" VALUE 0xF8B8C Kw_Wu16 655350.0 Time_ms 0.00 655350.0 FORMAT "%8.1" /end CHARACTERISTIC
/begin CHARACTERISTIC TVACD_DebExcTempOk_C "Heilungsentprellzeit für Übertemperatur" VALUE 0xF8B8E Kw_Wu16 655350.0 Time_ms 0.00 655350.0 FORMAT "%8.1" /end CHARACTERISTIC
/begin CHARACTERISTIC TVACD_DebNoLoadDef_C "Fehlerentprellzeit für Lastabfall" VALUE 0xF8B90 Kw_Wu16 655350.0 Time_ms 0.00 655350.0 FORMAT "%8.1" /end CHARACTERISTIC
/begin CHARACTERISTIC TVACD_DebNoLoadOk_C "Heilungsentprellzeit für Lastabfall" VALUE 0xF8B92 Kw_Wu16 655350.0 Time_ms 0.00 655350.0 FORMAT "%8.1" /end CHARACTERISTIC
/begin CHARACTERISTIC TVACD_DebShortCircBatDef_C "Fehlerentprellzeit für Kurzschluß nach Batterie" VALUE 0xF8B94 Kw_Wu16 655350.0 Time_ms 0.00 655350.0 FORMAT "%8.1" /end CHARACTERISTIC
/begin CHARACTERISTIC TVACD_DebShortCircBatOk_C "Heilungsentprellzeit für Kurzschluß nach Batterie" VALUE 0xF8B96 Kw_Wu16 655350.0 Time_ms 0.00 655350.0 FORMAT "%8.1" /end CHARACTERISTIC
/begin CHARACTERISTIC TVACD_DebShortCircGndDef_C "Fehlerentprellzeit für Kurzschluß nach Masse" VALUE 0xF8B98 Kw_Wu16 655350.0 Time_ms 0.00 655350.0 FORMAT "%8.1" /end CHARACTERISTIC
/begin CHARACTERISTIC TVACD_DebShortCircGndOk_C "Heilungsentprellzeit für Kurzschluß nach Masse" VALUE 0xF8B9A Kw_Wu16 655350.0 Time_ms 0.00 655350.0 FORMAT "%8.1" /end CHARACTERISTIC
/begin CHARACTERISTIC TVACD_tiDebTVADia1Def_C "Fehlerentprellzeit für Drosselklappenstellers Diagnose erstes Zeitfenster" VALUE 0xF8B9C Kw_Wu16 655350.0 Time_ms 0.00 655350.0 FORMAT "%8.1" /end CHARACTERISTIC
/begin CHARACTERISTIC TVACD_tiDebTVADia1Ok_C "Fehlerheilzeit für Drosselklappenstellers Diagnose erstes Zeitfenster" VALUE 0xF8B9E Kw_Wu16 655350.0 Time_ms 0.00 655350.0 FORMAT "%8.1" /end CHARACTERISTIC
/begin CHARACTERISTIC TVACD_tiDebTVADia2Def_C "Fehlerentprellzeit für Drosselklappenstellers Diagnose zweites Zeitfenster" VALUE 0xF8BA0 Kw_Wu16 655350.0 Time_ms 0.00 655350.0 FORMAT "%8.1" /end CHARACTERISTIC
/begin CHARACTERISTIC TVACD_tiDebTVADia2Ok_C "Fehlerheilzeit für Drosselklappenstellers Diagnose zweites Zeitfenster" VALUE 0xF8BA2 Kw_Wu16 655350.0 Time_ms 0.00 655350.0 FORMAT "%8.1" /end CHARACTERISTIC
/begin CHARACTERISTIC TVACD_tiDebTVADia3Def_C "Fehlerentprellzeit für Drosselklappenstellers Diagnose drittes Zeitfenster" VALUE 0xF8BA4 Kw_Wu16 655350.0 Time_ms 0.00 655350.0 FORMAT "%8.1" /end CHARACTERISTIC
/begin CHARACTERISTIC TVACD_tiDebTVADia3Ok_C "Fehlerheilzeit für Drosselklappenstellers Diagnose drittes Zeitfenster" VALUE 0xF8BA6 Kw_Wu16 655350.0 Time_ms 0.00 655350.0 FORMAT "%8.1" /end CHARACTERISTIC
/begin CHARACTERISTIC TVACD_tiDebTVADia4Def_C "Fehlerentprellzeit für Drosselklappensteller Diagnose viertes Zeitfenster" VALUE 0xF8BA8 Kw_Wu16 655350.0 Time_ms 0.00 655350.0 FORMAT "%8.1" /end CHARACTERISTIC
/begin CHARACTERISTIC TVACD_tiDebTVADia4Ok_C "Heilentprellzeit  für Drosselklappensteller Diagnose viertes Zeitfenster" VALUE 0xF8BAA Kw_Wu16 655350.0 Time_ms 0.00 655350.0 FORMAT "%8.1" /end CHARACTERISTIC
/begin CHARACTERISTIC TVACD_numDia2_C "Schalter zur Auswahl des Diagnose Pin für TVA2" VALUE 0xF8C38 Kw_Wu8 33.0000000000 NumPinDia 0.00 33.0000000000 FORMAT "%13.10" /end CHARACTERISTIC
/begin CHARACTERISTIC TVACD_numDia_C "Applikationsparameter fuer Diagnose-Signal von Drossel-Steller" VALUE 0xF8BAC Kw_Wu8 33.0000000000 NumPinDia 0.00 33.0000000000 FORMAT "%13.10" /end CHARACTERISTIC
/begin CHARACTERISTIC TVACD_numPwmOut2_C "Applicationsparameter für Endstufen-Pin Auswahl - Ausgang2(CJ230)" VALUE 0xF8C39 Kw_Wu8 13.0000000000 NumPinPwmOut 0.00 13.0000000000 FORMAT "%13.10" /end CHARACTERISTIC
/begin CHARACTERISTIC TVACD_numPwmOut_C "Applikationsparameter fuer Drosselwert-Steller" VALUE 0xF8BAD Kw_Wu8 13.0000000000 NumPinPwmOut 0.00 13.0000000000 FORMAT "%13.10" /end CHARACTERISTIC
/begin CHARACTERISTIC TVACD_stInvOut_C "Invertierungsparameter für das Signal der Drosselklappenstellerendstufe" VALUE 0xF8BAE Kw_Wu8 1.000 OneToOne 0.00 1.000 FORMAT "%5.3" EXTENDED_LIMITS 0.00 255.0 /end CHARACTERISTIC
/begin CHARACTERISTIC TVACD_tiPer_C "Periodendauer Drosselklappensteller" VALUE 0xF8BB0 Kw_Ws16 6553.500 Period -3276.800 3276.700 FORMAT "%8.3" /end CHARACTERISTIC
/begin CHARACTERISTIC TVACD_rCnv_CUR "Kennlinie zur konvertierung von Öffnungsgrad in Tastverhältnis" CURVE 0xF8BB2 Kl_Xs16_Ws16 100.0000 DtyCyc 0.00 100.0000 FORMAT "%8.4" EXTENDED_LIMITS -327.6800 327.6700
 /begin AXIS_DESCR STD_AXIS ThrVlv_rTVA Prc 25 -100.0000 200.0000 FORMAT "%8.4" EXTENDED_LIMITS -400.0000 399.9878 DEPOSIT ABSOLUTE /end AXIS_DESCR
/end CHARACTERISTIC
/begin CHARACTERISTIC TVACD_rOutMax2_C "Höchstgrenze für die Batteriespannung behob Ausgang zum" VALUE 0xF8C3A Kw_Ws16 655.3500 DtyCyc -327.6800 327.6700 FORMAT "%8.4" /end CHARACTERISTIC
/begin CHARACTERISTIC TVACD_rOutMax_C "Maximal auszugebendes Tastverhältnis" VALUE 0xF8C18 Kw_Ws16 655.3500 DtyCyc -327.6800 327.6700 FORMAT "%8.4" /end CHARACTERISTIC
/begin CHARACTERISTIC TVACD_rOutMin2_C "Mindestgrenzwert für die Batteriespannung behob Ausgang zum" VALUE 0xF8C3C Kw_Ws16 655.3500 DtyCyc -327.6800 327.6700 FORMAT "%8.4" /end CHARACTERISTIC
/begin CHARACTERISTIC TVACD_rOutMin_C "Minimal auszugebendes Tastverhältnis" VALUE 0xF8C1A Kw_Ws16 655.3500 DtyCyc -327.6800 327.6700 FORMAT "%8.4" /end CHARACTERISTIC
/begin CHARACTERISTIC TVACD_rTst2_C "Test-Tastverhältnis bei entprelltem Fehler" VALUE 0xF8C1C Kw_Ws16 100.0000 DtyCyc 0.00 100.0000 FORMAT "%8.4" EXTENDED_LIMITS -327.6800 327.6700 /end CHARACTERISTIC
/begin CHARACTERISTIC TVACD_rTst_C "Tastverhältnis, dass im Fehlerfall zyklisch ausgegeben wird" VALUE 0xF8C1E Kw_Ws16 100.0000 DtyCyc 0.00 100.0000 FORMAT "%8.4" EXTENDED_LIMITS -327.6800 327.6700 /end CHARACTERISTIC
/begin CHARACTERISTIC TVACD_stAirMonMskDfl8_C "Maske zum selektieren des Dfp aus der Fensterdiagnose" VALUE 0xF8C48 Kw_Wu8 255.0 OneToOne 0.00 255.0 FORMAT "%5.1" /end CHARACTERISTIC
/begin CHARACTERISTIC TVACD_stPwrStgActv2_C "activation for shut off conditions of the power stage M/V-B" VALUE 0xF8C3E Kw_Wu8 255.0 OneToOne 0.00 255.0 FORMAT "%5.1" /end CHARACTERISTIC
/begin CHARACTERISTIC TVACD_stPwrStgActv_C "Aktivierung der Abschaltbedingungen der Endstufe" VALUE 0xF8C20 Kw_Wu8 255.0 OneToOne 0.00 255.0 FORMAT "%5.1" /end CHARACTERISTIC
/begin CHARACTERISTIC TVACD_stPwrStgDia2_C "status word for deactivation of the powerstage 2" VALUE 0xF8C3F Kw_Wu8 255.0 OneToOne 0.00 255.0 FORMAT "%5.1" /end CHARACTERISTIC
/begin CHARACTERISTIC TVACD_stPwrStgDia_C "Aktivierung der Abschaltbedingungen der Endstufendiagnose" VALUE 0xF8C21 Kw_Wu8 255.0 OneToOne 0.00 255.0 FORMAT "%5.1" /end CHARACTERISTIC
/begin CHARACTERISTIC TVACD_stSPICtl_C "Parameter zur Anzeige der verwendeten Endstufenart ( 1 = SPI kontrollierbare Endstufe, 0 = nicht SPI-Endstufe )" VALUE 0xF8C22 Kw_Wu8 1.000 OneToOne 0.00 1.000 FORMAT "%5.3" EXTENDED_LIMITS 0.00 255.0 /end CHARACTERISTIC
/begin CHARACTERISTIC TVACD_swt_C "Schalter Batteriespannungskorrektur (0 = AUS, 1 = EIN)" VALUE 0xF8C23 Kw_Wu8 255.0 OneToOne 0.00 255.0 FORMAT "%5.1" /end CHARACTERISTIC
/begin CHARACTERISTIC TVACD_tiBtwTst_C "Zeitabstand, in dem im Fehlerfall die Endstufe getestet wird" VALUE 0xF8C24 Kw_Wu16 29980.00 Time_ms 20.00000 30000.00 FORMAT "%8.2" EXTENDED_LIMITS 0.00 655350.0 /end CHARACTERISTIC
/begin CHARACTERISTIC TVACD_tiDiag1Max_C "Maximum des ersten Signalfensters für Fehlersignale des Drosselklappensteller" VALUE 0xF8C26 Kw_Wu16 655350.0 Time_ms 0.00 655350.0 FORMAT "%8.1" /end CHARACTERISTIC
/begin CHARACTERISTIC TVACD_tiDiag1Min_C "Minimum des ersten Signalfensters für Fehlersignale des Drosselklappensteller" VALUE 0xF8C28 Kw_Wu16 655350.0 Time_ms 0.00 655350.0 FORMAT "%8.1" /end CHARACTERISTIC
/begin CHARACTERISTIC TVACD_tiDiag2Max_C "Maximum des zweiten Signalfensters für Fehlersignale des Drosselklappensteller" VALUE 0xF8C2A Kw_Wu16 655350.0 Time_ms 0.00 655350.0 FORMAT "%8.1" /end CHARACTERISTIC
/begin CHARACTERISTIC TVACD_tiDiag2Min_C "Minimum des zweiten Signalfensters für Fehlersignale des Drosselklappensteller" VALUE 0xF8C2C Kw_Wu16 655350.0 Time_ms 0.00 655350.0 FORMAT "%8.1" /end CHARACTERISTIC
/begin CHARACTERISTIC TVACD_tiDiag3Max_C "Maximum des dritten Signalfensters für Fehlersignale des Drosselklappensteller" VALUE 0xF8C2E Kw_Wu16 655350.0 Time_ms 0.00 655350.0 FORMAT "%8.1" /end CHARACTERISTIC
/begin CHARACTERISTIC TVACD_tiDiag3Min_C "Minimum des dritten Signalfensters für Fehlersignale des Drosselklappensteller" VALUE 0xF8C30 Kw_Wu16 655350.0 Time_ms 0.00 655350.0 FORMAT "%8.1" /end CHARACTERISTIC
/begin CHARACTERISTIC TVACD_tiDiag4Max_C "Maximum des vierten Signalfensters für Fehlersignale des Drosselklappenstellers" VALUE 0xF8C32 Kw_Wu16 655350.0 Time_ms 0.00 655350.0 FORMAT "%8.1" /end CHARACTERISTIC
/begin CHARACTERISTIC TVACD_tiDiag4Min_C "Minimum des vierten Signalfensters für Fehlersignale des Drosselklappenstellers" VALUE 0xF8C34 Kw_Wu16 655350.0 Time_ms 0.00 655350.0 FORMAT "%8.1" /end CHARACTERISTIC
/begin CHARACTERISTIC TVACD_tiPwrStgOn_C "Zeit für welche die Endstufe im Fehlerfall eingeschalten wird (nur nicht SPI kontrolliert)" VALUE 0xF8C36 Kw_Wu16 655140.0 Time_ms 0.00 655140.0 FORMAT "%8.1" EXTENDED_LIMITS 0.00 655350.0 /end CHARACTERISTIC
/begin CHARACTERISTIC UAddr_stCalibration_C "ECU Applikationszugriff (0 = unterbunden, 1 = erlaubt)" VALUE 0xC0AF6 Kw_Wu8 1.000 OneToOne 0.00 1.000 FORMAT "%5.3" EXTENDED_LIMITS 0.00 255.0 /end CHARACTERISTIC
/begin CHARACTERISTIC Uaddr_stMeasurement_C "ECU Messzugriff (0 = unterbunden, 1 = erlaubt)" VALUE 0xC0AF7 Kw_Wu8 1.000 OneToOne 0.00 1.000 FORMAT "%5.3" EXTENDED_LIMITS 0.00 255.0 /end CHARACTERISTIC
/begin CHARACTERISTIC USAp_dDataVariantIdInv_C "Identifier dieser Datensatzvariante (invertiert)" VALUE 0xF8C4C Kw_Wu32 4294967295.00 OneToOne 0.00 4294967295.00 FORMAT "%13.2" /end CHARACTERISTIC
/begin CHARACTERISTIC USAp_dDataVariantId_C "Identifier dieser Datensatzvariante" VALUE 0xF8C50 Kw_Wu32 4294967295.00 OneToOne 0.00 4294967295.00 FORMAT "%13.2" /end CHARACTERISTIC
/begin CHARACTERISTIC VehDa_lEepUpd_C "Streckenintervall zwischen zwei EEPROM Block Updates für Vehicle Data (VehDa_lSum, VehDa_tiEngOn)" VALUE 0xF8C7C Kw_Wu32 4294957295.00 Length 10000.0000000 4294967295.00 FORMAT "%13.2" EXTENDED_LIMITS 0.00 4294967295.00 /end CHARACTERISTIC
/begin CHARACTERISTIC VehDa_nLoadActv_C "Drehzahlschwelle zur Erfassung des Fahrzeugnutzungsprofils" VALUE 0xF8C60 Kw_Ws16 6000.000 EngN 0.00 6000.000 FORMAT "%8.3" EXTENDED_LIMITS -32768.00 32767.00 /end CHARACTERISTIC
/begin CHARACTERISTIC VehDa_nLoad_C "Stützstellen der x-Achse (Drehzahl) des Fahrzeugnutzungsprofils" VAL_BLK 0xF8C62 Kwb_Ws16 6000.000 EngN 0.00 6000.000 FORMAT "%8.3" EXTENDED_LIMITS -32768.00 32767.00 NUMBER 7 /end CHARACTERISTIC
/begin CHARACTERISTIC VehDa_nMaxEepUpd_C "Maximale Motordrehzahl für Update EEPROM Block (VehDa_lSum, VehDa_tiEngOn)" VALUE 0xF8C80 Kw_Ws16 6000.000 EngN 0.00 6000.000 FORMAT "%8.3" EXTENDED_LIMITS -32768.00 32767.00 /end CHARACTERISTIC
/begin CHARACTERISTIC VehDa_nMinEepUpd_C "Minimale Motordrehzahl für Update EEPROM Block (VehDa_lSum, VehDa_tiEngOn)" VALUE 0xF8C82 Kw_Ws16 5000.000 EngN 1000.000 6000.000 FORMAT "%8.3" EXTENDED_LIMITS -32768.00 32767.00 /end CHARACTERISTIC
/begin CHARACTERISTIC VehDa_rVnMax_C "maximales v/n-Verhältnis" VALUE 0xF8C54 Kw_Ws16 0.3276700 VelToN 0.00 0.3276700 FORMAT "%9.7" EXTENDED_LIMITS -0.3276800 0.3276700 /end CHARACTERISTIC
/begin CHARACTERISTIC VehDa_swtRst_C "Schalter zum Rücksetzen von VehDa_ctLoadSecRowX_mp[X], VehDa_tiLoadSec_mp und der entsprechenden EEPROM-Werte" VALUE 0xF8C70 Kw_Wu8 1.000 OneToOne 0.00 1.000 FORMAT "%5.3" EXTENDED_LIMITS 0.00 255.0 /end CHARACTERISTIC
/begin CHARACTERISTIC VehDa_tiNPT1_C "T1 Zeitkonstante zur Vorfilterung der Motordrehzahl für v/n-Verhältnis" VALUE 0xF8C58 Kw_Wu32 4294.9673 TimeDelay_s 0.0000010000000 4294.9673 FORMAT "%9.4" /end CHARACTERISTIC
/begin CHARACTERISTIC VehDa_tiVnPT1_C "T1 Zeitkonstante zur Filterung des v/n-Verhältnisses" VALUE 0xF8C5C Kw_Wu32 4294.9673 TimeDelay_s 0.0000010000000 4294.9673 FORMAT "%9.4" /end CHARACTERISTIC
/begin CHARACTERISTIC VehDa_trqLoad_C "Stützstellen der y-Achse (Drehmoment) des Fahrzeugnutzungsprofils" VAL_BLK 0xF8C72 Kwb_Ws16 1500.000 Trq -500.0000 1000.000 FORMAT "%8.3" EXTENDED_LIMITS -3276.800 3276.700 NUMBER 5 /end CHARACTERISTIC
/begin CHARACTERISTIC VSACD_ctPwrStgOnMax_C "Maximaler Zähler für Powerstage On im Fehlerfall" VALUE 0xF8C84 Kw_Wu16 65535.00 OneToOne 0.00 65535.00 FORMAT "%8.2" /end CHARACTERISTIC
/begin CHARACTERISTIC VSACD_tiDebDioInDia1Def_C "Fehlerentprellzeit für Kurzschluss nach digital eingabe für Window1" VALUE 0xF8C86 Kw_Wu16 655350.0 Time_ms 0.00 655350.0 FORMAT "%8.1" /end CHARACTERISTIC
/begin CHARACTERISTIC VSACD_tiDebDioInDia1Ok_C "Heilungsentprellzeit für kurzschluss nach digital eingabe für window1" VALUE 0xF8C88 Kw_Wu16 655350.0 Time_ms 0.00 655350.0 FORMAT "%8.1" /end CHARACTERISTIC
/begin CHARACTERISTIC VSACD_tiDebDioInDia2Def_C "Fehlerentprellzeit für Kurzschluss nach digital eingabe für Window2" VALUE 0xF8C8A Kw_Wu16 655350.0 Time_ms 0.00 655350.0 FORMAT "%8.1" /end CHARACTERISTIC
/begin CHARACTERISTIC VSACD_tiDebDioInDia2Ok_C "Heilungsentprellzeit für kurzschluss nach digital eingabe für window2" VALUE 0xF8C8C Kw_Wu16 655350.0 Time_ms 0.00 655350.0 FORMAT "%8.1" /end CHARACTERISTIC
/begin CHARACTERISTIC VSACD_tiDebDioInDia3Def_C "Fehlerentprellzeit für Kurzschluss nach digital eingabe für Window3" VALUE 0xF8C8E Kw_Wu16 655350.0 Time_ms 0.00 655350.0 FORMAT "%8.1" /end CHARACTERISTIC
/begin CHARACTERISTIC VSACD_tiDebDioInDia3Ok_C "Heilungsentprellzeit für kurzschluss nach digital eingabe für window3" VALUE 0xF8C90 Kw_Wu16 655350.0 Time_ms 0.00 655350.0 FORMAT "%8.1" /end CHARACTERISTIC
/begin CHARACTERISTIC VSACD_tiDebDioInDia4Def_C "Fehlerentprellzeit für Kurzschluss nach digital eingabe für Window4" VALUE 0xF8C92 Kw_Wu16 655350.0 Time_ms 0.00 655350.0 FORMAT "%8.1" /end CHARACTERISTIC
/begin CHARACTERISTIC VSACD_tiDebDioInDia4Ok_C "Heilungsentprellzeit für kurzschluss nach digital eingabe für window4" VALUE 0xF8C94 Kw_Wu16 655350.0 Time_ms 0.00 655350.0 FORMAT "%8.1" /end CHARACTERISTIC
/begin CHARACTERISTIC VSACD_tiDebDioInMinDef_C "Fehlerentprellzeit für digital eingabe Min fehler" VALUE 0xF8C96 Kw_Wu16 655350.0 Time_ms 0.00 655350.0 FORMAT "%8.1" /end CHARACTERISTIC
/begin CHARACTERISTIC VSACD_tiDebDioInMinOk_C "Heilungsentprellzeit für digital eingabe Min fehler" VALUE 0xF8C98 Kw_Wu16 655350.0 Time_ms 0.00 655350.0 FORMAT "%8.1" /end CHARACTERISTIC
/begin CHARACTERISTIC VSACD_DebExcTempDef_C "Fehlerentprellzeit für Übertemperatur" VALUE 0xF8C9A Kw_Wu16 655350.0 Time_ms 0.00 655350.0 FORMAT "%8.1" /end CHARACTERISTIC
/begin CHARACTERISTIC VSACD_DebExcTempOk_C "Heilungsentprellzeit für Übertemperatur" VALUE 0xF8C9C Kw_Wu16 655350.0 Time_ms 0.00 655350.0 FORMAT "%8.1" /end CHARACTERISTIC
/begin CHARACTERISTIC VSACD_DebNoLoadDef_C "Fehlerentprellzeit für Lastabfall" VALUE 0xF8C9E Kw_Wu16 655350.0 Time_ms 0.00 655350.0 FORMAT "%8.1" /end CHARACTERISTIC
/begin CHARACTERISTIC VSACD_DebNoLoadOk_C "Heilungsentprellzeit für Lastabfall" VALUE 0xF8CA0 Kw_Wu16 655350.0 Time_ms 0.00 655350.0 FORMAT "%8.1" /end CHARACTERISTIC
/begin CHARACTERISTIC VSACD_DebShortCircBatDef_C "Fehlerentprellzeit für Kurzschluß nach Batterie" VALUE 0xF8CA2 Kw_Wu16 655350.0 Time_ms 0.00 655350.0 FORMAT "%8.1" /end CHARACTERISTIC
/begin CHARACTERISTIC VSACD_DebShortCircBatOk_C "Heilungsentprellzeit für Kurzschluß nach Batterie" VALUE 0xF8CA4 Kw_Wu16 655350.0 Time_ms 0.00 655350.0 FORMAT "%8.1" /end CHARACTERISTIC
/begin CHARACTERISTIC VSACD_DebShortCircGndDef_C "Fehlerentprellzeit für Kurzschluß nach Masse" VALUE 0xF8CA6 Kw_Wu16 655350.0 Time_ms 0.00 655350.0 FORMAT "%8.1" /end CHARACTERISTIC
/begin CHARACTERISTIC VSACD_DebShortCircGndOk_C "Heilungsentprellzeit für Kurzschluß nach Masse" VALUE 0xF8CA8 Kw_Wu16 655350.0 Time_ms 0.00 655350.0 FORMAT "%8.1" /end CHARACTERISTIC
/begin CHARACTERISTIC VSACD_tiDebVSADia1Def_C "debounce duration for VSACD diagnosis error detection" VALUE 0xF8CAA Kw_Wu16 655350.0 Time_ms 0.00 655350.0 FORMAT "%8.1" /end CHARACTERISTIC
/begin CHARACTERISTIC VSACD_tiDebVSADia1Ok_C "debounce duration for VSACD diagnosis error healing" VALUE 0xF8CAC Kw_Wu16 655350.0 Time_ms 0.00 655350.0 FORMAT "%8.1" /end CHARACTERISTIC
/begin CHARACTERISTIC VSACD_tiDebVSADia2Def_C "debounce duration for VSACD diagnosis error detection" VALUE 0xF8CAE Kw_Wu16 655350.0 Time_ms 0.00 655350.0 FORMAT "%8.1" /end CHARACTERISTIC
/begin CHARACTERISTIC VSACD_tiDebVSADia2Ok_C "debounce duration for VSACD diagnosis error healing" VALUE 0xF8CB0 Kw_Wu16 655350.0 Time_ms 0.00 655350.0 FORMAT "%8.1" /end CHARACTERISTIC
/begin CHARACTERISTIC VSACD_tiDebVSADia3Def_C "debounce duration for VSACD diagnosis error detection" VALUE 0xF8CB2 Kw_Wu16 655350.0 Time_ms 0.00 655350.0 FORMAT "%8.1" /end CHARACTERISTIC
/begin CHARACTERISTIC VSACD_tiDebVSADia3Ok_C "debounce duration for VSACD diagnosis error healing" VALUE 0xF8CB4 Kw_Wu16 655350.0 Time_ms 0.00 655350.0 FORMAT "%8.1" /end CHARACTERISTIC
/begin CHARACTERISTIC VSACD_tiDebVSADia4Def_C "Fehlerentprellzeit für Drallklappensteller Diagnose viertes Zeitfenster" VALUE 0xF8CB6 Kw_Wu16 655350.0 Time_ms 0.00 655350.0 FORMAT "%8.1" /end CHARACTERISTIC
/begin CHARACTERISTIC VSACD_tiDebVSADia4Ok_C "Heilentprellzeit für Drallklappensteller Diagnose viertes Zeitfenster" VALUE 0xF8CB8 Kw_Wu16 655350.0 Time_ms 0.00 655350.0 FORMAT "%8.1" /end CHARACTERISTIC
/begin CHARACTERISTIC VSACD_numDiaImp_C "Mindest zu detektierende Impulsanzahl auf Diagnoseleitung" VALUE 0xF8CBA Kw_Wu8 9.000 OneToOne 1.000 10.00 FORMAT "%5.2" EXTENDED_LIMITS 0.00 255.0 /end CHARACTERISTIC
/begin CHARACTERISTIC VSACD_numDia_C "Applikationsparameter fuer das Diagnose-Signal von Einlasskanal-Steller" VALUE 0xF8CBB Kw_Wu8 33.0000000000 NumPinDia 0.00 33.0000000000 FORMAT "%13.10" /end CHARACTERISTIC
/begin CHARACTERISTIC VSACD_numDioIn_C "Digitaleingang für variable Swirl Position" VALUE 0xF8CBC Kw_Wu8 12.0000000000 NumPinDioIn 0.00 12.0000000000 FORMAT "%13.10" /end CHARACTERISTIC
/begin CHARACTERISTIC VSACD_numPwmOut_C "Applikationsparameter fuer Einlasskanal-Steller" VALUE 0xF8CBD Kw_Wu8 13.0000000000 NumPinPwmOut 0.00 13.0000000000 FORMAT "%13.10" /end CHARACTERISTIC
/begin CHARACTERISTIC VSACD_stInvOut_C "Invertierungsparameter für das Signal der Drallniveaustellerendstufe" VALUE 0xF8CBE Kw_Wu8 1.000 OneToOne 0.00 1.000 FORMAT "%5.3" EXTENDED_LIMITS 0.00 255.0 /end CHARACTERISTIC
/begin CHARACTERISTIC VSACD_tiPer_C "Periodendauer des Ausgangssignal für den Drallniveausteller" VALUE 0xF8CC0 Kw_Ws16 6553.500 Period -3276.800 3276.700 FORMAT "%8.3" /end CHARACTERISTIC
/begin CHARACTERISTIC VSACD_rCnv_CUR "Kennlinie zur Konvertierung von Öffnungsgrad in Tastverhältnis" CURVE 0xF8CC2 Kl_Xs16_Ws16 100.0000 DtyCyc 0.00 100.0000 FORMAT "%8.4" EXTENDED_LIMITS -327.6800 327.6700
 /begin AXIS_DESCR STD_AXIS VSA_rVSA DtyCyc 8 -100.0000 200.0000 FORMAT "%8.4" EXTENDED_LIMITS -327.6800 327.6700 DEPOSIT ABSOLUTE /end AXIS_DESCR
/end CHARACTERISTIC
/begin CHARACTERISTIC VSACD_rOutMax_C "Maximal auszugebendes Tastverhältnis" VALUE 0xF8CE4 Kw_Ws16 655.3500 DtyCyc -327.6800 327.6700 FORMAT "%8.4" /end CHARACTERISTIC
/begin CHARACTERISTIC VSACD_rOutMin_C "Minimal auszugebendes Tastverhältnis" VALUE 0xF8CE6 Kw_Ws16 655.3500 DtyCyc -327.6800 327.6700 FORMAT "%8.4" /end CHARACTERISTIC
/begin CHARACTERISTIC VSACD_rTst_C "Tastverhältnis, dass im Fehlerfall zyklisch ausgegeben wird" VALUE 0xF8CE8 Kw_Ws16 100.0000 DtyCyc 0.00 100.0000 FORMAT "%8.4" EXTENDED_LIMITS -327.6800 327.6700 /end CHARACTERISTIC
/begin CHARACTERISTIC VSACD_stPwrStgActv_C "Aktivierung der Abschaltbedingungen der Endstufe" VALUE 0xF8CEA Kw_Wu8 255.0 OneToOne 0.00 255.0 FORMAT "%5.1" /end CHARACTERISTIC
/begin CHARACTERISTIC VSACD_stPwrStgDia_C "Aktivierung der Abschaltbedingungen der Endstufendiagnose" VALUE 0xF8CEB Kw_Wu8 255.0 OneToOne 0.00 255.0 FORMAT "%5.1" /end CHARACTERISTIC
/begin CHARACTERISTIC VSACD_stSPICtl_C "Parameter zur Anzeige der verwendeten Endstufenart (1 = SPI kontrollierbar, 0 = nicht SPI kontrollierbar)" VALUE 0xF8CEC Kw_Wu8 1.000 OneToOne 0.00 1.000 FORMAT "%5.3" EXTENDED_LIMITS 0.00 255.0 /end CHARACTERISTIC
/begin CHARACTERISTIC VSACD_swtExtPinEna_C "Schalter für Drallklappensteller Diagnose mit extra Pin (1...ein, 0...aus)" VALUE 0xF8CED Kw_Wu8 255.0 OneToOne 0.00 255.0 FORMAT "%5.1" /end CHARACTERISTIC
/begin CHARACTERISTIC VSACD_swt_C "Schalter Batteriespannungskorrektur (0 = AUS, 1 = EIN)" VALUE 0xF8CEE Kw_Wu8 255.0 OneToOne 0.00 255.0 FORMAT "%5.1" /end CHARACTERISTIC
/begin CHARACTERISTIC VSACD_tiBtwTst_C "Zeitabstand, in dem im Fehlerfall die Endstufe getestet wird" VALUE 0xF8CF0 Kw_Wu16 29980.00 Time_ms 20.00000 30000.00 FORMAT "%8.2" EXTENDED_LIMITS 0.00 655350.0 /end CHARACTERISTIC
/begin CHARACTERISTIC VSACD_tiDiaDetMax_C "Zeitfenster für Impulserkennung auf Diagnoseleitung, obere Grenze" VALUE 0xF8CF2 Kw_Wu16 655350.0 Time_ms 0.00 655350.0 FORMAT "%8.1" /end CHARACTERISTIC
/begin CHARACTERISTIC VSACD_tiDiaDetMin_C "Zeitfenster für Impulserkennung auf Diagnoseleitung, untere Grenze" VALUE 0xF8CF4 Kw_Wu16 655350.0 Time_ms 0.00 655350.0 FORMAT "%8.1" /end CHARACTERISTIC
/begin CHARACTERISTIC VSACD_tiDiag1Max_C "window 1 max. time" VALUE 0xF8CF6 Kw_Wu16 655350.0 Time_ms 0.00 655350.0 FORMAT "%8.1" /end CHARACTERISTIC
/begin CHARACTERISTIC VSACD_tiDiag1Min_C "window 1 min. time" VALUE 0xF8CF8 Kw_Wu16 655350.0 Time_ms 0.00 655350.0 FORMAT "%8.1" /end CHARACTERISTIC
/begin CHARACTERISTIC VSACD_tiDiag2Max_C "window 2 min. time" VALUE 0xF8CFA Kw_Wu16 655350.0 Time_ms 0.00 655350.0 FORMAT "%8.1" /end CHARACTERISTIC
/begin CHARACTERISTIC VSACD_tiDiag2Min_C "window 2 min. time" VALUE 0xF8CFC Kw_Wu16 655350.0 Time_ms 0.00 655350.0 FORMAT "%8.1" /end CHARACTERISTIC
/begin CHARACTERISTIC VSACD_tiDiag3Max_C "window 3 max. time" VALUE 0xF8CFE Kw_Wu16 655350.0 Time_ms 0.00 655350.0 FORMAT "%8.1" /end CHARACTERISTIC
/begin CHARACTERISTIC VSACD_tiDiag3Min_C "window 3 Min. time" VALUE 0xF8D00 Kw_Wu16 655350.0 Time_ms 0.00 655350.0 FORMAT "%8.1" /end CHARACTERISTIC
/begin CHARACTERISTIC VSACD_tiDiag4Max_C "Maximum des vierten Signalfensters für Fehlersignale des Drallklappenstellers" VALUE 0xF8D02 Kw_Wu16 655350.0 Time_ms 0.00 655350.0 FORMAT "%8.1" /end CHARACTERISTIC
/begin CHARACTERISTIC VSACD_tiDiag4Min_C "Minimum des vierten Signalfensters für Fehlersignale des Drallklappenstellers" VALUE 0xF8D04 Kw_Wu16 655350.0 Time_ms 0.00 655350.0 FORMAT "%8.1" /end CHARACTERISTIC
/begin CHARACTERISTIC VSACD_tiDioInDia1Max_C "Maximum des ersten Signalfensters für Fehlersignale des Drallklappenstellers" VALUE 0xF8D06 Kw_Wu16 655350.0 Time_ms 0.00 655350.0 FORMAT "%8.1" /end CHARACTERISTIC
/begin CHARACTERISTIC VSACD_tiDioInDia1Min_C "Minimum des ersten Signalfensters für Fehlersignale des Drallklappenstellers" VALUE 0xF8D08 Kw_Wu16 655350.0 Time_ms 0.00 655350.0 FORMAT "%8.1" /end CHARACTERISTIC
/begin CHARACTERISTIC VSACD_tiDioInDia2Max_C "Maximum des zweiten Signalfensters für Fehlersignale des Drallklappenstellers" VALUE 0xF8D0A Kw_Wu16 655350.0 Time_ms 0.00 655350.0 FORMAT "%8.1" /end CHARACTERISTIC
/begin CHARACTERISTIC VSACD_tiDioInDia2Min_C "Minimum des zweiten Signalfensters für Fehlersignale des Drallklappenstellers" VALUE 0xF8D0C Kw_Wu16 655350.0 Time_ms 0.00 655350.0 FORMAT "%8.1" /end CHARACTERISTIC
/begin CHARACTERISTIC VSACD_tiDioInDia3Max_C "Maximum des dritten Signalfensters für Fehlersignale des Drallklappenstellers" VALUE 0xF8D0E Kw_Wu16 655350.0 Time_ms 0.00 655350.0 FORMAT "%8.1" /end CHARACTERISTIC
/begin CHARACTERISTIC VSACD_tiDioInDia3Min_C "Minimum des dritten Signalfensters für Fehlersignale des Drallklappenstellers" VALUE 0xF8D10 Kw_Wu16 655350.0 Time_ms 0.00 655350.0 FORMAT "%8.1" /end CHARACTERISTIC
/begin CHARACTERISTIC VSACD_tiDioInDia4Max_C "Maximum des vierten Signalfensters für Fehlersignale des Drallklappenstellers" VALUE 0xF8D12 Kw_Wu16 655350.0 Time_ms 0.00 655350.0 FORMAT "%8.1" /end CHARACTERISTIC
/begin CHARACTERISTIC VSACD_tiDioInDia4Min_C "Minimum des vierten Signalfensters für Fehlersignale des Drallklappenstellers" VALUE 0xF8D14 Kw_Wu16 655350.0 Time_ms 0.00 655350.0 FORMAT "%8.1" /end CHARACTERISTIC
/begin CHARACTERISTIC VSACD_tiPwrStgOn_C "Zeit für welche die Endstufe im Fehlerfall eingeschalten wird (nur nicht SPI kontrolliert)" VALUE 0xF8D16 Kw_Wu16 655140.0 Time_ms 0.00 655140.0 FORMAT "%8.1" EXTENDED_LIMITS 0.00 655350.0 /end CHARACTERISTIC
/begin CHARACTERISTIC VSA_rVSA_Vector "Bypass-Label für VSA_rVSA" VALUE 0xC39C2 Kw_Wu8 255.0 OneToOne 0.00 255.0 FORMAT "%5.1" /end CHARACTERISTIC
/begin CHARACTERISTIC VSA_rVSA_Channel "Bypass-Label für VSA_rVSA" VALUE 0xC39C3 Kw_Wu8 255.0 OneToOne 0.00 255.0 FORMAT "%5.1" /end CHARACTERISTIC
/begin CHARACTERISTIC VSSCD_DebCanSigDef_C "Entprellzeit CAN Signal für Fahrgeschwindigkeit defekt" VALUE 0xF8D18 Kw_Wu16 655350.0 Time_ms 0.00 655350.0 FORMAT "%8.1" /end CHARACTERISTIC
/begin CHARACTERISTIC VSSCD_DebCanSigOk_C "Entprellzeit Heilung CAN-Signal für Fahrgeschwindigkeit" VALUE 0xF8D1A Kw_Wu16 655350.0 Time_ms 0.00 655350.0 FORMAT "%8.1" /end CHARACTERISTIC
/begin CHARACTERISTIC VSSCD_DebMaxDef_C "Entprellzeit für Defekterkennung bei Maximumtest der Fahrgeschwindigkeit" VALUE 0xF8D1C Kw_Wu16 655350.0 Time_ms 0.00 655350.0 FORMAT "%8.1" /end CHARACTERISTIC
/begin CHARACTERISTIC VSSCD_DebMaxOk_C "Entprellzeit für Heilung bei Maximumtest der Fahrgeschwindigkeit" VALUE 0xF8D1E Kw_Wu16 655350.0 Time_ms 0.00 655350.0 FORMAT "%8.1" /end CHARACTERISTIC
/begin CHARACTERISTIC VSSCD_DebNegPlaMonCond_C "Vorhaltlabel, nicht applizieren" VALUE 0xF8D20 Kw_Wu16 655350.0 Time_ms 0.00 655350.0 FORMAT "%8.1" READ_ONLY /end CHARACTERISTIC
/begin CHARACTERISTIC VSSCD_DebPlaMonCond_C "Entprellzeit Überwachungsbedingungen für Plausibilitätstest der Fahrgeschwindigkeit" VALUE 0xF8D22 Kw_Wu16 655350.0 Time_ms 0.00 655350.0 FORMAT "%8.1" /end CHARACTERISTIC
/begin CHARACTERISTIC VSSCD_DebPlaDef_C "Entprellzeit für Defekterkennung bei Plausibilitätstest der Fahrgeschwindigkeit" VALUE 0xF8D24 Kw_Wu16 655350.0 Time_ms 0.00 655350.0 FORMAT "%8.1" /end CHARACTERISTIC
/begin CHARACTERISTIC VSSCD_DebPlaOk_C "Entprellzeit für Heilung bei Plausibilitätstest der Fahrgeschwindigkeit" VALUE 0xF8D26 Kw_Wu16 655350.0 Time_ms 0.00 655350.0 FORMAT "%8.1" /end CHARACTERISTIC
/begin CHARACTERISTIC VSSCD_DebSigDef_C "Entprellzeit defekt für ungültiges Eingangssignal Fahrgeschwindigkeit" VALUE 0xF8D28 Kw_Wu16 655350.0 Time_ms 0.00 655350.0 FORMAT "%8.1" /end CHARACTERISTIC
/begin CHARACTERISTIC VSSCD_DebSigOk_C "Entprellzeit für Heilung ungültiges Eingangssignal der Fahrgeschwindigkeit" VALUE 0xF8D2A Kw_Wu16 655350.0 Time_ms 0.00 655350.0 FORMAT "%8.1" /end CHARACTERISTIC
/begin CHARACTERISTIC VSSCD_ImpPerDist_C "Streckenfaktor: FGG-Impulse pro Strecke" VALUE 0xF8D48 Kw_Wu32 17.500000000000000 VSS_DistFac 2.5000000000000000 20.000000000000000 FORMAT "%20.17" EXTENDED_LIMITS 0.83819031734908711 3600000000.0000000 /end CHARACTERISTIC
/begin CHARACTERISTIC VSSCD_nThresPla_C "Drehzahschwelle für NPL-Test der Fahrgeschwindigkeit" VALUE 0xF8D2C Kw_Ws16 32767.00 EngN 0.00 32767.00 FORMAT "%8.2" EXTENDED_LIMITS -32768.00 32767.00 /end CHARACTERISTIC
/begin CHARACTERISTIC VSSCD_qThresPla_C "Einspritzschwelle für NPL-Test der Fahrgeschwindigkeit" VALUE 0xF8D2E Kw_Ws16 327.6700 InjMass 0.00 327.6700 FORMAT "%8.4" EXTENDED_LIMITS -327.6800 327.6700 /end CHARACTERISTIC
/begin CHARACTERISTIC VSSCD_swtSigVal_C "Signalquelle Fahrgeschwindigkeit, Datensatzwert für SW-Schalter VSSCD_swtSig (0: HW FGG, 1: CAN)" VALUE 0xF8D30 Kw_Wu8 1.000 OneToOne 0.00 1.000 FORMAT "%5.3" EXTENDED_LIMITS 0.00 255.0 /end CHARACTERISTIC
/begin CHARACTERISTIC VSSCD_swtSigType_C "Einlesen SW-Schalter VSSCD_swtSig aus E2PROM (1) oder VSSCD_swtSigVal_C (2) bei Ini." VALUE 0xF8D31 Kw_Wu8 1.000 OneToOne 1.000 2.000 FORMAT "%5.3" EXTENDED_LIMITS 0.00 255.0 /end CHARACTERISTIC
/begin CHARACTERISTIC VSSCD_tiAPT1_C "Zeitkonstante Filterung Fahrbeschleunigung" VALUE 0xF8D34 Kw_Wu32 4294.9673 TimeDelay_s 0.0000010000000 4294.9673 FORMAT "%9.4" /end CHARACTERISTIC
/begin CHARACTERISTIC VSSCD_tiPerMax_C "Maximale Periodendauer zwischen zwei FGG-Impulsen (VSSCD_vRaw = 0  wenn VSSCD_tiPerArvg > VSSCD_tiPerMax)" VALUE 0xF8D38 Kw_Ws32 9586980.60000 Time_PwmHigh 0.00 9586980.60000 FORMAT "%13.5" EXTENDED_LIMITS -214748364.800 214748364.700 /end CHARACTERISTIC
/begin CHARACTERISTIC VSSCD_tiVPT1_C "Zeitkonstante Filterung Fahrgeschwindigkeit" VALUE 0xF8D3C Kw_Wu32 4294.9673 TimeDelay_s 0.0000010000000 4294.9673 FORMAT "%9.4" /end CHARACTERISTIC
/begin CHARACTERISTIC VSSCD_vDfl_C "Vorgabewert Fahrgeschwindigkeit" VALUE 0xF8D40 Kw_Ws16 327.6700 Vel 0.00 327.6700 FORMAT "%8.4" EXTENDED_LIMITS -327.6800 327.6700 /end CHARACTERISTIC
/begin CHARACTERISTIC VSSCD_vMax_C "v-Schwelle für Max-Test der Fahrgeschwindigkeit" VALUE 0xF8D42 Kw_Ws16 327.6700 Vel 0.00 327.6700 FORMAT "%8.4" EXTENDED_LIMITS -327.6800 327.6700 /end CHARACTERISTIC
/begin CHARACTERISTIC VSSCD_vMin_C "Minimum-Schwelle für v=0 Erkennung" VALUE 0xF8D44 Kw_Ws16 20.00000 Vel 0.00 20.00000 FORMAT "%8.5" EXTENDED_LIMITS -327.6800 327.6700 /end CHARACTERISTIC
/begin CHARACTERISTIC VSSCD_vThresPla_C "v-Schwelle für NPL-Test der Fahrgeschwindigkeit" VALUE 0xF8D46 Kw_Ws16 327.6700 Vel 0.00 327.6700 FORMAT "%8.4" EXTENDED_LIMITS -327.6800 327.6700 /end CHARACTERISTIC
/begin CHARACTERISTIC ZFC_dBPFacNumFBCG3_CA "Bandpassverstärkungen für Schubbetrieb im 3. Gang" VAL_BLK 0xF8D84 Kwb_Wr32 30.0000000 OneToOne -15.0000000 15.0000000 FORMAT "%10.7" EXTENDED_LIMITS -1.00000000E+37 1.00000000E+37 NUMBER 4 /end CHARACTERISTIC
/begin CHARACTERISTIC ZFC_dBPFacNumFBCG4_CA "Bandpassverstärkungen für Schubbetrieb im 4. Gang" VAL_BLK 0xF8D94 Kwb_Wr32 30.0000000 OneToOne -15.0000000 15.0000000 FORMAT "%10.7" EXTENDED_LIMITS -1.00000000E+37 1.00000000E+37 NUMBER 4 /end CHARACTERISTIC
/begin CHARACTERISTIC ZFC_dBPFacNumFBCG5_CA "Bandpassverstärkungen für Schubbetrieb im 5. Gang" VAL_BLK 0xF8DA4 Kwb_Wr32 30.0000000 OneToOne -15.0000000 15.0000000 FORMAT "%10.7" EXTENDED_LIMITS -1.00000000E+37 1.00000000E+37 NUMBER 4 /end CHARACTERISTIC
/begin CHARACTERISTIC ZFC_dBPFacNumFBCG6_CA "Bandpassverstärkungen für Schubbetrieb im 6. Gang" VAL_BLK 0xF8DB4 Kwb_Wr32 30.0000000 OneToOne -15.0000000 15.0000000 FORMAT "%10.7" EXTENDED_LIMITS -1.00000000E+37 1.00000000E+37 NUMBER 4 /end CHARACTERISTIC
/begin CHARACTERISTIC ZFC_dSegFBCCaS_CA "Segmentwahl im Schubbetrieb" VAL_BLK 0xF8DC4 Kwb_Wu16 255.9961 Per_Ratio 0.00 255.9961 FORMAT "%8.4" NUMBER 4 /end CHARACTERISTIC
/begin CHARACTERISTIC ZFC_nAvrgMax_C "Maximale Drehzahl für die Nullmengenkalibrierung" VALUE 0xF8DCC Kw_Ws16 5960.000 EngN 40.00000 6000.000 FORMAT "%8.3" EXTENDED_LIMITS -32768.00 32767.00 /end CHARACTERISTIC
/begin CHARACTERISTIC ZFC_nAvrgMin_C "Minimale Drehzahl für die Nullmengenkalibrierung" VALUE 0xF8DCE Kw_Ws16 5960.000 EngN 40.00000 6000.000 FORMAT "%8.3" EXTENDED_LIMITS -32768.00 32767.00 /end CHARACTERISTIC
/begin CHARACTERISTIC ZFC_nChngPRailMax_C "Maximale Drehzahl für die eine Raildruckanforderung der Nullmengenkalibrierung erfolgt" VALUE 0xF8DD0 Kw_Ws16 5960.000 EngN 40.00000 6000.000 FORMAT "%8.3" EXTENDED_LIMITS -32768.00 32767.00 /end CHARACTERISTIC
/begin CHARACTERISTIC ZFC_nFBCThresMax_C "Obere Drehzahlschwelle für Berechnung der FBC-Bandpässe im Schubbetrieb" VALUE 0xF8DD2 Kw_Ws16 5960.000 EngN 40.00000 6000.000 FORMAT "%8.3" EXTENDED_LIMITS -32768.00 32767.00 /end CHARACTERISTIC
/begin CHARACTERISTIC ZFC_nHyst_C "Hysteresewert Drehzahl für die Nullmengenkalibrierung" VALUE 0xF8DD4 Kw_Ws16 5960.000 EngN 40.00000 6000.000 FORMAT "%8.3" EXTENDED_LIMITS -32768.00 32767.00 /end CHARACTERISTIC
/begin CHARACTERISTIC ZFC_numRatETClb_C "Anzahl der Ansteuerdauer-Kalibrierungen hintereinander" VALUE 0xF8DD6 Kw_Wu8 255.0 OneToOne 0.00 255.0 FORMAT "%5.1" /end CHARACTERISTIC
/begin CHARACTERISTIC ZFC_numRatNVClb_C "Anzahl der Ansteuerspannungs-Kalibrierungen hintereinander" VALUE 0xF8DD7 Kw_Wu8 255.0 OneToOne 0.00 255.0 FORMAT "%5.1" /end CHARACTERISTIC
/begin CHARACTERISTIC ZFC_phiSet_CUR "Ansteuerbeginn für Einspritzung der Nullmengenkalibrierung" CURVE 0xF8DF0 Kl_Xs16_Ws16 1440.000 AngleCrS -720.0000 720.0000 FORMAT "%8.4" EXTENDED_LIMITS -768.0000 767.9766
 /begin AXIS_DESCR STD_AXIS Eng_nAvrg EngN 16 40.00000 6000.000 FORMAT "%8.3" EXTENDED_LIMITS -32768.00 32767.00 DEPOSIT ABSOLUTE /end AXIS_DESCR
/end CHARACTERISTIC
/begin CHARACTERISTIC ZFC_stClthSel_C "Bitmaske zur Freigabe des Kupplungssignals für die Kalibrierung" VALUE 0xF8DD8 Kw_Wu8 255.0 OneToOne 0.00 255.0 FORMAT "%5.1" /end CHARACTERISTIC
/begin CHARACTERISTIC ZFC_stGearRls_CA "Gangabhängige freigabe der ZFC Kalibrierung" VAL_BLK 0xF8DD9 Kwb_Wu8 1.000 OneToOne 0.00 1.000 FORMAT "%5.3" EXTENDED_LIMITS 0.00 255.0 NUMBER 7 /end CHARACTERISTIC
/begin CHARACTERISTIC ZFC_swtClbActvVal_C "Applikationswert für SW-Schalter der ZFC Kalibrierung (1: Kalibrierung aktiev, 0: inaktiev)" VALUE 0xF8DE0 Kw_Wu8 1.000 OneToOne 0.00 1.000 FORMAT "%5.3" EXTENDED_LIMITS 0.00 255.0 /end CHARACTERISTIC
/begin CHARACTERISTIC ZFC_swtClbActvType_C "Typ des Softwareschalters für die ZFC Kalibrierung" VALUE 0xF8DE1 Kw_Wu8 2.000 OneToOne 0.00 2.000 FORMAT "%5.3" EXTENDED_LIMITS 0.00 255.0 /end CHARACTERISTIC
/begin CHARACTERISTIC ZFC_tAirThres_C "Minimale Ansauglufttemperatur für die Nullmengenkalibrierung" VALUE 0xF8DE2 Kw_Ws16 250.0000 Temp_Cels -50.14000 199.8600 FORMAT "%8.4" EXTENDED_LIMITS -3549.940 3003.560 /end CHARACTERISTIC
/begin CHARACTERISTIC ZFC_tEngThres_C "Minimale Motortemperatur für die Nullmengenkalibrierung" VALUE 0xF8DE4 Kw_Ws16 250.0000 Temp_Cels -50.14000 199.8600 FORMAT "%8.4" EXTENDED_LIMITS -3549.940 3003.560 /end CHARACTERISTIC
/begin CHARACTERISTIC ZFC_tFuelThresMax_C "Maximale Kraftstofftemperatur für die Nullmengenkalibrierung" VALUE 0xF8DE6 Kw_Ws16 250.0000 Temp_Cels -50.14000 199.8600 FORMAT "%8.4" EXTENDED_LIMITS -3549.940 3003.560 /end CHARACTERISTIC
/begin CHARACTERISTIC ZFC_tFuelThresMin_C "Minimale Kraftstofftemperatur für die Nullmengenkalibrierung" VALUE 0xF8DE8 Kw_Ws16 250.0000 Temp_Cels -50.14000 199.8600 FORMAT "%8.4" EXTENDED_LIMITS -3549.940 3003.560 /end CHARACTERISTIC
/begin CHARACTERISTIC ZFC_tiCldCham_CUR "Zeit bis der Brennraum für die Nullmengenkalibrierung zu stark abgekühlt ist" CURVE 0xF8D4E Kl_Xs16_Ws16 655140.0 Time_ms 0.00 655140.0 FORMAT "%8.1" EXTENDED_LIMITS -327680.0 327670.0
 /begin AXIS_DESCR STD_AXIS IATSCD_tAir Temp_Cels 12 -50.14000 199.8600 FORMAT "%8.4" EXTENDED_LIMITS -3549.940 3003.560 DEPOSIT ABSOLUTE /end AXIS_DESCR
/end CHARACTERISTIC
/begin CHARACTERISTIC ZFC_tiDelOvrRun_C "Verzögerung nach dem Einsetzen der Schubphase für die Nullmengenkalibrierung" VALUE 0xF8DEA Kw_Ws16 655140.0 Time_ms 0.00 655140.0 FORMAT "%8.1" EXTENDED_LIMITS -327680.0 327670.0 /end CHARACTERISTIC
/begin CHARACTERISTIC ZFC_tiDelpRailLim_C "Verzögerung zum Einschwingen des Raildrucks für die Nullmengenkalibrierung" VALUE 0xF8DEC Kw_Ws16 655140.0 Time_ms 0.00 655140.0 FORMAT "%8.1" EXTENDED_LIMITS -327680.0 327670.0 /end CHARACTERISTIC
/begin CHARACTERISTIC ZFC_tiHotCham_C "Zeit bis der Brennraum warm genug für die Nullmengenkalibrierung ist" VALUE 0xF8D80 Kw_Ws16 655140.0 Time_ms 0.00 655140.0 FORMAT "%8.1" EXTENDED_LIMITS -327680.0 327670.0 /end CHARACTERISTIC
/begin CHARACTERISTIC ZFC_uBattMin_C "Minimale Batteriespannung für die Nullmengenkalibrierung" VALUE 0xF8DEE Kw_Ws16 640606.1 Volt_Batt 0.00 640606.1 FORMAT "%8.1" EXTENDED_LIMITS -640625.6 640606.1 /end CHARACTERISTIC
/begin MEASUREMENT SrvPmp_dphiStrg_mp "Streeing Angle derivative" SWORD AngleGradPerSec 1 100 -1440.154 1440.110 FORMAT "%8.3" ECU_ADDRESS 0x8FF45E /end MEASUREMENT
/begin MEASUREMENT SrvPmp_pwrDes "Leistungsbedarf der Servopumpe" SWORD Pwr 1 100 -308831.1 308821.7 FORMAT "%8.1" ECU_ADDRESS 0x7F92C6 /end MEASUREMENT
/begin MEASUREMENT SrvPmp_pwrLead "Leistungsvorhalt der Servopumpe" SWORD Pwr 1 100 -308831.1 308821.7 FORMAT "%8.1" ECU_ADDRESS 0x7F92C8 /end MEASUREMENT
/begin MEASUREMENT SrvPmp_trqDes_mp "Momentenbedarf der Servopumpe" SWORD Trq 1 100 -3276.800 3276.700 FORMAT "%8.3" ECU_ADDRESS 0x8FF460 /end MEASUREMENT
/begin MEASUREMENT SSpMon_stRaw_1_mp "Rohwert der Defekterkennung der Sensorversorgungsspannung 1" SWORD OneToOne 1 100 -32768.00 32767.00 FORMAT "%8.2" ECU_ADDRESS 0x8FF462 /end MEASUREMENT
/begin MEASUREMENT SSpMon_stRaw_2_mp "Rohwert der Defekterkennung der Sensorversorgungsspannung 2" SWORD OneToOne 1 100 -32768.00 32767.00 FORMAT "%8.2" ECU_ADDRESS 0x8FF464 /end MEASUREMENT
/begin MEASUREMENT SSpMon_stRaw_3_mp "Rohwert der Defekterkennung der Sensorversorgungsspannung 3" SWORD OneToOne 1 100 -32768.00 32767.00 FORMAT "%8.2" ECU_ADDRESS 0x8FF466 /end MEASUREMENT
/begin MEASUREMENT SSpMon_stRaw_4_mp "SRC Status von Sensorversorgungsspannung 4" SWORD OneToOne 1 100 -32768.00 32767.00 FORMAT "%8.2" ECU_ADDRESS 0x8FF468 /end MEASUREMENT
/begin MEASUREMENT SSpMon_stRaw_5_mp "SRC Status für Sensorversorgungsspannung 5" SWORD OneToOne 1 100 -32768.00 32767.00 FORMAT "%8.2" ECU_ADDRESS 0x8FF46A /end MEASUREMENT
/begin MEASUREMENT SSpMon_stRaw_6_mp "SRC Status für Sensorversorgungsspannung 6" SWORD OneToOne 1 100 -32768.00 32767.00 FORMAT "%8.2" ECU_ADDRESS 0x8FF46C /end MEASUREMENT
/begin MEASUREMENT SSpMon_stSSpErr "Fehlerstatus der Sensorversorgungsspannungen" UWORD OneToOne 1 100 0.00 65535.00 FORMAT "%8.2" ECU_ADDRESS 0x7F92C2 /end MEASUREMENT
/begin MEASUREMENT SSpMon_stSSpErr2 "Fehlerstatus der Sensorversorgungsspannungen 1-3" UWORD OneToOne 1 100 0.00 65535.00 FORMAT "%8.2" ECU_ADDRESS 0x7F92C4 /end MEASUREMENT
/begin MEASUREMENT StrtCD_stHWE_mp "zu stellender Zustand an der Digitalendstufe nach der Fehlerbehandlung" UBYTE OneToOne 1 100 0.00 255.0 FORMAT "%5.1" ECU_ADDRESS 0x8FF46E /end MEASUREMENT
/begin MEASUREMENT StSys_facAPSCor_mp "factor for starting torque correction value" SWORD Fact 1 100 -4.000000 3.999878 FORMAT "%8.6" ECU_ADDRESS 0x8FF470 /end MEASUREMENT
/begin MEASUREMENT StSys_nAvrgFlt_mp "engine speed after PT1 filter" SWORD EngN 1 100 -32768.00 32767.00 FORMAT "%8.2" ECU_ADDRESS 0x8FF48A /end MEASUREMENT
/begin MEASUREMENT StSys_nThresStrtCutOut_mp "Startabwurfdrehzahl" SWORD EngN 1 100 -32768.00 32767.00 FORMAT "%8.2" ECU_ADDRESS 0x8FF478 /end MEASUREMENT
/begin MEASUREMENT StSys_stActrLck_mp "Statusregister Ausspurbedingungen" UWORD OneToOne 1 100 0.00 65535.00 FORMAT "%8.2" ECU_ADDRESS 0x8FF482 /end MEASUREMENT
/begin MEASUREMENT StSys_stActrOut "Anlasserzustand" UBYTE OneToOne 1 100 0.00 255.0 FORMAT "%5.1" ECU_ADDRESS 0x7F8A1E /end MEASUREMENT
/begin MEASUREMENT StSys_stActrRls_mp "Statusregister Einspurbedingungen" UBYTE OneToOne 1 100 0.00 255.0 FORMAT "%5.1" ECU_ADDRESS 0x8FF484 /end MEASUREMENT
/begin MEASUREMENT StSys_stNewStrt "Statusanzeige bei Neustart während eines aktiven Fahrzyklus" UBYTE OneToOne 1 100 0.00 255.0 FORMAT "%5.1" ECU_ADDRESS 0x7F8A1F /end MEASUREMENT
/begin MEASUREMENT StSys_stRmpMon "Zustand der Startmomenterhoehung" UBYTE OneToOne 1 100 0.00 255.0 FORMAT "%5.1" ECU_ADDRESS 0x7F8A20 /end MEASUREMENT
/begin MEASUREMENT StSys_stStrt "Startzustand" UBYTE OneToOne 1 100 0.00 255.0 FORMAT "%5.1" ECU_ADDRESS 0x7F8A21 /end MEASUREMENT
/begin MEASUREMENT StSys_stStrtCutOutMon "Zustand des Startabwurfs" UBYTE OneToOne 1 100 0.00 255.0 FORMAT "%5.1" ECU_ADDRESS 0x7F8A22 /end MEASUREMENT
/begin MEASUREMENT StSys_stStrtTip "Zustände der Tip-Start Funktion" UWORD OneToOne 1 100 0.00 65535.00 FORMAT "%8.2" ECU_ADDRESS 0x7F92CC /end MEASUREMENT
/begin MEASUREMENT StSys_stStrtTipOFF "Zustände der Tip-Start Abschaltung" UBYTE OneToOne 1 100 0.00 255.0 FORMAT "%5.1" ECU_ADDRESS 0x7F8A23 /end MEASUREMENT
/begin MEASUREMENT StSys_stStrtTipON "Zustände der Tip-Start Einschaltung" UBYTE OneToOne 1 100 0.00 255.0 FORMAT "%5.1" ECU_ADDRESS 0x7F8A24 /end MEASUREMENT
/begin MEASUREMENT StSys_stTrqShutOff "globales Interface fuer die Startmomentabschaltung" UBYTE OneToOne 1 100 0.00 255.0 FORMAT "%5.1" ECU_ADDRESS 0x7F8A25 /end MEASUREMENT
/begin MEASUREMENT StSys_stTrqShutOffCond_mp "bitcodierter Zustand der Abschaltbedingungen der Startmomentenabschaltung" UWORD OneToOne 1 100 0.00 65535.00 FORMAT "%8.2" ECU_ADDRESS 0x8FF48C /end MEASUREMENT
/begin MEASUREMENT StSys_stTrqShutOffErr_mp "status Fehlerursachen Start o. Kl.50" UWORD OneToOne 1 100 0.00 65535.00 FORMAT "%8.2" ECU_ADDRESS 0x8FF488 /end MEASUREMENT
/begin MEASUREMENT StSys_trqAddCor "zusaetzliches Korrekturmoment f. Startmoment" SWORD Trq 1 100 -3276.800 3276.700 FORMAT "%8.3" ECU_ADDRESS 0x7F92CE /end MEASUREMENT
/begin MEASUREMENT StSys_trqAdj_mp "Startmomentkorrektur" SWORD Trq 1 100 -3276.800 3276.700 FORMAT "%8.3" ECU_ADDRESS 0x8FF47C /end MEASUREMENT
/begin MEASUREMENT StSys_trqBas "Startbasismoment" SWORD Trq 1 100 -3276.800 3276.700 FORMAT "%8.3" ECU_ADDRESS 0x7F92D0 /end MEASUREMENT
/begin MEASUREMENT StSys_trqRmpState "Moment der Startrampe" SWORD Trq 1 100 -3276.800 3276.700 FORMAT "%8.3" ECU_ADDRESS 0x7F92D2 /end MEASUREMENT
/begin MEASUREMENT StSys_trqSetAdjVal_mp "EEPROM Abgleichwert Startmoment-Korrektur" SWORD Trq 1 100 -3276.800 3276.700 FORMAT "%8.3" ECU_ADDRESS 0x8FF47E /end MEASUREMENT
/begin MEASUREMENT StSys_trqStrt "inneres Moment Startwert" SWORD Trq 1 100 -3276.800 3276.700 FORMAT "%8.3" ECU_ADDRESS 0x7F92D4 /end MEASUREMENT
/begin MEASUREMENT StSys_trqStrtAPSCor_mp " starting torque correction" SWORD Trq 1 100 -3276.800 3276.700 FORMAT "%8.3" ECU_ADDRESS 0x8FF472 /end MEASUREMENT
/begin MEASUREMENT StSys_trqStrtAPS_mp "starting torque correction" SWORD Trq 1 100 -3276.800 3276.700 FORMAT "%8.3" ECU_ADDRESS 0x8FF474 /end MEASUREMENT
/begin MEASUREMENT StSys_trqStrtBas_mp "Basismoment fuer Start" SWORD Trq 1 100 -3276.800 3276.700 FORMAT "%8.3" ECU_ADDRESS 0x8FF480 /end MEASUREMENT
/begin MEASUREMENT StSys_tStrtBas_mp "Aus dem Motortemperaturfeld Eng_tFld ausgewählte Temperatur" SWORD Temp_Cels 1 100 -50.140 899.860 FORMAT "%8.3" ECU_ADDRESS 0x8FF476 /end MEASUREMENT
/begin MEASUREMENT StSys_tStrtRmp_mp "Aus dem Motortemperaturfeld Eng_tFld ausgewählte Temperatur" SWORD Temp_Cels 1 100 -50.140 899.860 FORMAT "%8.3" ECU_ADDRESS 0x8FF486 /end MEASUREMENT
/begin MEASUREMENT StSys_tStrt_mp "Aus dem Motortemperaturfeld Eng_tFld ausgewählte Temperatur für den Startabwurf" SWORD Temp_Cels 1 100 -50.140 899.860 FORMAT "%8.3" ECU_ADDRESS 0x8FF47A /end MEASUREMENT
/begin MEASUREMENT SWTmr_tiTmr16 "16-Bit Referenzzeit für Timer" UWORD Time_ms 1 100 0.00 655350.0 FORMAT "%8.1" ECU_ADDRESS 0x7F87A6 /end MEASUREMENT
/begin MEASUREMENT SWTmr_tiTmr32 "32-Bit Referenzzeit für Timer" ULONG Time_ms 1 100 0.00 42949672950.0 FORMAT "%13.1" ECU_ADDRESS 0x7F87A8 /end MEASUREMENT
/begin MEASUREMENT T15CD_stCondDebVal_mp "Bedingungen (Bitleiste) für Auswertung T15CD_ stDebVal" UBYTE OneToOne 1 100 0.00 255.0 FORMAT "%5.1" ECU_ADDRESS 0x8FF48E /end MEASUREMENT
/begin MEASUREMENT T15CD_stDebVal "entprellter Wert der Klemme 15" UBYTE OneToOne 1 100 0.00 255.0 FORMAT "%5.1" ECU_ADDRESS 0x7F8A26 /end MEASUREMENT
/begin MEASUREMENT T15CD_stDebWakeUpVal "entprellter Wake Up Signaleingang" UBYTE OneToOne 1 100 0.00 255.0 FORMAT "%5.1" ECU_ADDRESS 0x7F8A27 /end MEASUREMENT
/begin MEASUREMENT T15CD_stLogicT15_mp "Staatsmaschine für T15 in der neu ""Anpassung wakeup Konzept""" UBYTE OneToOne 1 100 0.00 255.0 FORMAT "%5.1" ECU_ADDRESS 0x8FF48F /end MEASUREMENT
/begin MEASUREMENT T15CD_stWakeUp "Wake Up Zustand" UBYTE OneToOne 1 100 0.00 255.0 FORMAT "%5.1" ECU_ADDRESS 0x7F8A28 /end MEASUREMENT
/begin MEASUREMENT T15CD_stWakeUpRawVal_mp "Rohwert des Wake Up Signals aus der HWE" UBYTE OneToOne 1 100 0.00 255.0 FORMAT "%5.1" ECU_ADDRESS 0x6F832C /end MEASUREMENT
/begin MEASUREMENT T50CD_stDebVal "entprellter Statuswert der Klemme 50" UBYTE OneToOne 1 100 0.00 255.0 FORMAT "%5.1" ECU_ADDRESS 0x7F8A29 /end MEASUREMENT
/begin MEASUREMENT T50CD_stRawVal "unentprellter Wert des Eingangssignals für Klemme 50" UBYTE OneToOne 1 100 0.00 255.0 FORMAT "%5.1" ECU_ADDRESS 0x7F8A2A /end MEASUREMENT
/begin MEASUREMENT T50CD_swtSig "T50 von Hardware oder CAN" UBYTE OneToOne 1 100 0.00 255.0 FORMAT "%5.1" ECU_ADDRESS 0x7F8A2B /end MEASUREMENT
/begin MEASUREMENT ThrVlv_ctMonDef_mp "Zähler für Drosselklappenfehler im Nachlauf" UBYTE OneToOne 1 100 0.00 255.0 FORMAT "%5.1" ECU_ADDRESS 0x8FF494 /end MEASUREMENT
/begin MEASUREMENT ThrVlv_pDiffMaxMon_mp "Momentanes Maximum der Druckdifferenz beim Drosselklappentest im Nachlauf." SWORD Pres_hPa 1 100 -32768.00 32767.00 FORMAT "%8.2" ECU_ADDRESS 0x8FF496 /end MEASUREMENT
/begin MEASUREMENT ThrVlv_rTVA "Stellgröße für Regelklappe (Stellerkoordinatorausgang)" SWORD Prc 1 100 -400.0000 399.9878 FORMAT "%8.4" ECU_ADDRESS 0x7F92DA /end MEASUREMENT
/begin MEASUREMENT ThrVlv_rTVA2 "Stellgröße für Regelklappe (Stellerkoordinatorausgang)" SWORD Prc 1 100 -400.0000 399.9878 FORMAT "%8.4" ECU_ADDRESS 0x7F92DC /end MEASUREMENT
/begin MEASUREMENT ThrVlv_rTVA2Byp_mp "Bypass-Label, Kopie von ThrVlv_rTVA2" SWORD Prc 1 100 -400.0000 399.9878 FORMAT "%8.4" ECU_ADDRESS 0x8FF490 /end MEASUREMENT
/begin MEASUREMENT ThrVlv_rTVAByp_mp "Bypass-Label, Kopie von ThrVlv_rTVA" SWORD Prc 1 100 -400.0000 399.9878 FORMAT "%8.4" ECU_ADDRESS 0x8FF492 /end MEASUREMENT
/begin MEASUREMENT ThrVlv_stMonAftRunDelDem "Anforderung zur Verzögerung des EEPROM-schreibens im Nachlauf." UBYTE OneToOne 1 100 0.00 255.0 FORMAT "%5.1" ECU_ADDRESS 0x7F8A30 /end MEASUREMENT
/begin MEASUREMENT ThrVlv_stMon_mp "Momentaner Status der Drosselklappenüberwachung." UBYTE OneToOne 1 100 0.00 255.0 FORMAT "%5.1" ECU_ADDRESS 0x8FF498 /end MEASUREMENT
/begin MEASUREMENT TPUMon_ctUpDwnDeb_mp "Meßpunkt für den Entprellungszähler der TPUMon Zeitabweichung" UWORD OneToOne 1 100 0.00 65535.00 FORMAT "%8.2" ECU_ADDRESS 0x8FF49A /end MEASUREMENT
/begin MEASUREMENT TPUMon_tiDiffMax_mp "Meßpunkt der maximalen Differenzen aus Timervergleich in den letzten 100 ms" SLONG TimeUSResolution 1 100 -2147483648.00 2147483647.00 FORMAT "%13.2" ECU_ADDRESS 0x8FF49C /end MEASUREMENT
/begin MEASUREMENT TPUMon_tiDiffMin_mp "Meßpunkt der minimalen (negativer Wert) Differenzen aus Timervergleich in den letzten 100 ms" SLONG TimeUSResolution 1 100 -2147483648.00 2147483647.00 FORMAT "%13.2" ECU_ADDRESS 0x8FF4A0 /end MEASUREMENT
/begin MEASUREMENT TPUMon_tiDiffSum_mp "Meßpunkt der Summe aller Differenzen aus Timervergleich in den letzten 100 ms" SLONG TimeUSResolution 1 100 -2147483648.00 2147483647.00 FORMAT "%13.2" ECU_ADDRESS 0x8FF4A4 /end MEASUREMENT
/begin MEASUREMENT TVACD_rCnv2_mp "Tastverhältnis basierend aus dem Ausgang des Abgasrückführreglers 2" SWORD DtyCyc 1 100 -327.6800 327.6700 FORMAT "%8.4" ECU_ADDRESS 0x8FF4A8 /end MEASUREMENT
/begin MEASUREMENT TVACD_rCnv_mp "Tastverhältnis basierend aus dem Ausgang des Abgasrückführreglers" SWORD DtyCyc 1 100 -327.6800 327.6700 FORMAT "%8.4" ECU_ADDRESS 0x8FF4B0 /end MEASUREMENT
/begin MEASUREMENT TVACD_rOut "Tastverhältnis zür Endstufenansteuerung" SWORD DtyCyc 1 100 -327.6800 327.6700 FORMAT "%8.4" ECU_ADDRESS 0x7F92D6 /end MEASUREMENT
/begin MEASUREMENT TVACD_rOut2 "Tastverhältnis zur Ansteuerung der 2ten Endstufe" SWORD DtyCyc 1 100 -327.6800 327.6700 FORMAT "%8.4" ECU_ADDRESS 0x7F92D8 /end MEASUREMENT
/begin MEASUREMENT TVACD_stAirMon "Status des TVACD" UBYTE OneToOne 1 100 0.00 255.0 FORMAT "%5.1" ECU_ADDRESS 0x7F8A2C /end MEASUREMENT
/begin MEASUREMENT TVACD_stAirMon1Raw_mp "" UBYTE OneToOne 1 100 0.00 255.0 FORMAT "%5.1" ECU_ADDRESS 0x8FF4AA /end MEASUREMENT
/begin MEASUREMENT TVACD_stAirMon1_mp "status des TAVCD_AirMon" UBYTE OneToOne 1 100 0.00 255.0 FORMAT "%5.1" ECU_ADDRESS 0x8FF4AB /end MEASUREMENT
/begin MEASUREMENT TVACD_stAirMon2Raw_mp "" UBYTE OneToOne 1 100 0.00 255.0 FORMAT "%5.1" ECU_ADDRESS 0x8FF4AC /end MEASUREMENT
/begin MEASUREMENT TVACD_stAirMon2_mp "" UBYTE OneToOne 1 100 0.00 255.0 FORMAT "%5.1" ECU_ADDRESS 0x8FF4AD /end MEASUREMENT
/begin MEASUREMENT TVACD_stAirMonA "Message für den Transfer der Stati zu Partner ECU" UBYTE OneToOne 1 100 0.00 255.0 FORMAT "%5.1" ECU_ADDRESS 0x7F8A2D /end MEASUREMENT
/begin MEASUREMENT TVACD_stAirMon_mp "Status von TVACD" UBYTE OneToOne 1 100 0.00 255.0 FORMAT "%5.1" ECU_ADDRESS 0x8FF4AE /end MEASUREMENT
/begin MEASUREMENT TVACD_stTVADia1 "" UBYTE OneToOne 1 100 0.00 255.0 FORMAT "%5.1" ECU_ADDRESS 0x7F8A2E /end MEASUREMENT
/begin MEASUREMENT TVACD_stTVADia2 "" UBYTE OneToOne 1 100 0.00 255.0 FORMAT "%5.1" ECU_ADDRESS 0x7F8A2F /end MEASUREMENT
/begin MEASUREMENT USAp_dDataVariant_u8 "Nummer der aktiven Datensatzvariante" UBYTE OneToOne 1 100 0.00 255.0 FORMAT "%5.1" ECU_ADDRESS 0x7FDFD6 /end MEASUREMENT
/begin MEASUREMENT USAp_stDataVariant_u8 "Statusflags der aktiven Datensatzvariante" UBYTE OneToOne 1 100 0.00 255.0 FORMAT "%5.1" ECU_ADDRESS 0x7FDFD7 /end MEASUREMENT
/begin MEASUREMENT UsrDa_stFDC "Status von FDC" UBYTE OneToOne 1 100 0.00 255.0 FORMAT "%5.1" ECU_ADDRESS 0x7F8A31 /end MEASUREMENT
/begin MEASUREMENT VehDa_ctLoadPrimRow0_mp "Primärkennfeld Fahrzeugnutzungsprofil" UWORD OneToOne 1 100 0.00 65535.00 FORMAT "%8.2" ARRAY_SIZE 8 ECU_ADDRESS 0x6F832E /end MEASUREMENT
/begin MEASUREMENT VehDa_ctLoadPrimRow1_mp "Primärkennfeld Fahrzeugnutzungsprofil" UWORD OneToOne 1 100 0.00 65535.00 FORMAT "%8.2" ARRAY_SIZE 8 ECU_ADDRESS 0x6F833E /end MEASUREMENT
/begin MEASUREMENT VehDa_ctLoadPrimRow2_mp "Primärkennfeld Fahrzeugnutzungsprofil" UWORD OneToOne 1 100 0.00 65535.00 FORMAT "%8.2" ARRAY_SIZE 8 ECU_ADDRESS 0x6F834E /end MEASUREMENT
/begin MEASUREMENT VehDa_ctLoadPrimRow3_mp "Primärkennfeld Fahrzeugnutzungsprofil" UWORD OneToOne 1 100 0.00 65535.00 FORMAT "%8.2" ARRAY_SIZE 8 ECU_ADDRESS 0x6F835E /end MEASUREMENT
/begin MEASUREMENT VehDa_ctLoadPrimRow4_mp "Primärkennfeld Fahrzeugnutzungsprofil" UWORD OneToOne 1 100 0.00 65535.00 FORMAT "%8.2" ARRAY_SIZE 8 ECU_ADDRESS 0x6F836E /end MEASUREMENT
/begin MEASUREMENT VehDa_ctLoadPrimRow5_mp "Primärkennfeld Fahrzeugnutzungsprofil" UWORD OneToOne 1 100 0.00 65535.00 FORMAT "%8.2" ARRAY_SIZE 8 ECU_ADDRESS 0x6F837E /end MEASUREMENT
/begin MEASUREMENT VehDa_ctLoadSecRow0_mp "Sekundärkennfeld Fahrzeugnutzungsprofil" UBYTE OneToOne 1 100 0.00 255.0 FORMAT "%5.1" ARRAY_SIZE 8 ECU_ADDRESS 0x6F838E /end MEASUREMENT
/begin MEASUREMENT VehDa_ctLoadSecRow1_mp "Sekundärkennfeld Fahrzeugnutzungsprofil" UBYTE OneToOne 1 100 0.00 255.0 FORMAT "%5.1" ARRAY_SIZE 8 ECU_ADDRESS 0x6F8396 /end MEASUREMENT
/begin MEASUREMENT VehDa_ctLoadSecRow2_mp "Sekundärkennfeld Fahrzeugnutzungsprofil" UBYTE OneToOne 1 100 0.00 255.0 FORMAT "%5.1" ARRAY_SIZE 8 ECU_ADDRESS 0x6F839E /end MEASUREMENT
/begin MEASUREMENT VehDa_ctLoadSecRow3_mp "Sekundärkennfeld Fahrzeugnutzungsprofil" UBYTE OneToOne 1 100 0.00 255.0 FORMAT "%5.1" ARRAY_SIZE 8 ECU_ADDRESS 0x6F83A6 /end MEASUREMENT
/begin MEASUREMENT VehDa_ctLoadSecRow4_mp "Sekundärkennfeld Fahrzeugnutzungsprofil" UBYTE OneToOne 1 100 0.00 255.0 FORMAT "%5.1" ARRAY_SIZE 8 ECU_ADDRESS 0x6F83AE /end MEASUREMENT
/begin MEASUREMENT VehDa_ctLoadSecRow5_mp "Sekundärkennfeld Fahrzeugnutzungsprofil" UBYTE OneToOne 1 100 0.00 255.0 FORMAT "%5.1" ARRAY_SIZE 8 ECU_ADDRESS 0x6F83B6 /end MEASUREMENT
/begin MEASUREMENT VehDa_lInt_mp "Hilfszähler für Kilometerzähler VehDa_lSum über Integration Fahrgeschwindigkeit VSSCD_vRaw" SLONG Dist_20ms 1 100 -119304.647111 119304.647056 FORMAT "%13.6" ECU_ADDRESS 0x8FF4B4 /end MEASUREMENT
/begin MEASUREMENT VehDa_lSum "Erfassung gefahrene Strecke" ULONG Length 1 100 0.00 4294967295.00 FORMAT "%13.2" ECU_ADDRESS 0x7F9498 /end MEASUREMENT
/begin MEASUREMENT VehDa_nEngFilt_mp "vorgefilterte Motordrehzahl für v/n Verhältnis" SWORD EngN 1 100 -32768.00 32767.00 FORMAT "%8.2" ECU_ADDRESS 0x8FF4B8 /end MEASUREMENT
/begin MEASUREMENT VehDa_rVn "Verhältnis von Fahrgeschwindigkeit zur Motordrehzahl" SWORD VelToN 1 100 0.00 0.1000000 FORMAT "%9.7" ECU_ADDRESS 0x7F92F2 /end MEASUREMENT
/begin MEASUREMENT VehDa_stTrqDem "Status der aktuellen Momentenanforderungen" UWORD OneToOne 1 100 0.00 65535.00 FORMAT "%8.2" ECU_ADDRESS 0x7F92F4 /end MEASUREMENT
/begin MEASUREMENT VehDa_tiEngOn "Erfassung der aktuellen Betriebszeit" ULONG TimeEngOn 1 100 0.00 4294967295.00 FORMAT "%13.2" ECU_ADDRESS 0x7F949C /end MEASUREMENT
/begin MEASUREMENT VehDa_tiLoadPrim_mp "Fahrzeugnutzungsprofil-Betriebsstundenzähler" UWORD OneToOne 1 100 0.00 65535.00 FORMAT "%8.2" ECU_ADDRESS 0x6F83BE /end MEASUREMENT
/begin MEASUREMENT VehDa_tiLoadSec_mp "Fahrzeugnutzungsprofil-Betriebsstundenzähler" ULONG OneToOne 1 100 0.00 4294967295.00 FORMAT "%13.2" ECU_ADDRESS 0x6F83C0 /end MEASUREMENT
/begin MEASUREMENT VehMot_nMax "Grenzdrehzahl für Fahrzeugbewegung" SWORD EngN 1 100 -32768.00 32767.00 FORMAT "%8.2" ECU_ADDRESS 0x7F92F6 /end MEASUREMENT
/begin MEASUREMENT VehMot_nMin "Leerlaufdrehzahl für Fahrzeugbewegung" SWORD EngN 1 100 -32768.00 32767.00 FORMAT "%8.2" ECU_ADDRESS 0x7F92F8 /end MEASUREMENT
/begin MEASUREMENT VehMot_pwrAcsDes "Gesamtbedarf Leistung der Nebenaggregate in der Fahrzeugbewegung" SWORD Pwr 1 100 -308831.1 308821.7 FORMAT "%8.1" ECU_ADDRESS 0x7F92FA /end MEASUREMENT
/begin MEASUREMENT VehMot_pwrAcsLead "Leistungsvorhalt der Nebenaggregate in der Fahrzeugbewegung" SWORD Pwr 1 100 -308831.1 308821.7 FORMAT "%8.1" ECU_ADDRESS 0x7F92FC /end MEASUREMENT
/begin MEASUREMENT VESGov_trq "Momentenanforderung Arbeitsdrehzahlregler" SWORD Trq 1 100 -3276.800 3276.700 FORMAT "%8.3" ECU_ADDRESS 0x7F92DE /end MEASUREMENT
/begin MEASUREMENT VSACD_numDiaImp_mp "Anzahl detektierter Impulse auf Diagnoseleitung" UBYTE OneToOne 1 100 0.00 255.0 FORMAT "%5.1" ECU_ADDRESS 0x8FF4BC /end MEASUREMENT
/begin MEASUREMENT VSACD_rCnv_mp "Tastverhältnis basierend aus dem Ausgang der Drallniveausteuerung" SWORD DtyCyc 1 100 -327.6800 327.6700 FORMAT "%8.4" ECU_ADDRESS 0x8FF4BE /end MEASUREMENT
/begin MEASUREMENT VSACD_rOut "Tastverhältnis zür Endstufenansteuerung" SWORD DtyCyc 1 100 -327.6800 327.6700 FORMAT "%8.4" ECU_ADDRESS 0x7F92E0 /end MEASUREMENT
/begin MEASUREMENT VSACD_stErr_mp "Status des PWM-einganges der Drallklappe" UBYTE OneToOne 1 100 0.00 255.0 FORMAT "%5.1" ECU_ADDRESS 0x8FF4C0 /end MEASUREMENT
/begin MEASUREMENT VSACD_stMonDiaWin "" UWORD OneToOne 1 100 0.00 65535.00 FORMAT "%8.2" ECU_ADDRESS 0x7F92E2 /end MEASUREMENT
/begin MEASUREMENT VSACD_tiDiaDet_mp "Impulserkennungszeitzeit auf Diagnoseleitung" UWORD Time_ms 1 100 0.00 655350.0 FORMAT "%8.1" ECU_ADDRESS 0x8FF4C2 /end MEASUREMENT
/begin MEASUREMENT VSA_rVSA "Stellgröße für Einlaßkanalabschaltung (Stellerkoordinatorausgang)" SWORD DtyCyc 1 100 -327.6800 327.6700 FORMAT "%8.4" ECU_ADDRESS 0x7F92E4 /end MEASUREMENT
/begin MEASUREMENT VSA_rVSAByp_mp "Bypass-Label, copie of VSA_rVSA" SWORD Prc 1 100 -400.0000 399.9878 FORMAT "%8.4" ECU_ADDRESS 0x8FF4BA /end MEASUREMENT
/begin MEASUREMENT VSSCD_a "Fahrbeschleunigung" SWORD Acc 1 100 -32.76800 32.76700 FORMAT "%8.5" ECU_ADDRESS 0x7F92E6 /end MEASUREMENT
/begin MEASUREMENT VSSCD_aRaw "Rohwert Fahrbeschleunigung" SWORD Acc 1 100 -32.76800 32.76700 FORMAT "%8.5" ECU_ADDRESS 0x7F92E8 /end MEASUREMENT
/begin MEASUREMENT VSSCD_ctImp "Impulszähler Fahrgeschwindigkeit Impulssignal" UWORD OneToOne 1 100 0.00 65535.00 FORMAT "%8.2" ECU_ADDRESS 0x7F92EA /end MEASUREMENT
/begin MEASUREMENT VSSCD_rImp_mp "Tastverhältnis Eingangssignal Fahrgeschwindigkeit (FGG)" SWORD DtyCyc 1 100 -327.6800 327.6700 FORMAT "%8.4" ECU_ADDRESS 0x8FF4C4 /end MEASUREMENT
/begin MEASUREMENT VSSCD_stInHW_mp "Statusflags Eingangssignal Fahrgeschwindigkeit (FGG)" UBYTE OneToOne 1 100 0.00 255.0 FORMAT "%5.1" ECU_ADDRESS 0x8FF4C6 /end MEASUREMENT
/begin MEASUREMENT VSSCD_swtSig "Signaleingangsschalter Fahrgeschwindigkeit" UBYTE OneToOne 1 100 0.00 255.0 FORMAT "%5.1" ECU_ADDRESS 0x7F8A33 /end MEASUREMENT
/begin MEASUREMENT VSSCD_tiPerAvrg "Mittlere Periodendauer zwischen zwei FGG-Impulsen" SLONG Time_PwmHigh 1 100 -214748364.800 214748364.700 FORMAT "%13.3" ECU_ADDRESS 0x7F9494 /end MEASUREMENT
/begin MEASUREMENT VSSCD_v "Fahrzeuggeschwindigkeit" SWORD Vel 1 100 -327.6800 327.6700 FORMAT "%8.4" ECU_ADDRESS 0x7F92EC /end MEASUREMENT
/begin MEASUREMENT VSSCD_vRaw "Rohwert Fahrgeschwindigkeit" SWORD Vel 1 100 -327.6800 327.6700 FORMAT "%8.4" ECU_ADDRESS 0x7F92EE /end MEASUREMENT
/begin MEASUREMENT VSSCD_vSensVal "Vehicle speed sensed value" SWORD Vel 1 100 -327.6800 327.6700 FORMAT "%8.4" ECU_ADDRESS 0x7F92F0 /end MEASUREMENT
/begin MEASUREMENT WDCom_dChisteResponse_u32 "Antwortbeitrag des Befehlstests" UWORD OneToOne 1 100 0.00 65535.00 FORMAT "%8.2" ECU_ADDRESS 0x7FD330 /end MEASUREMENT
/begin MEASUREMENT WDCom_dErrorCountForCntler_u8 "Kopie des überwachungsmodul-internen Fehlerzählers für den Funktionsrechner" UBYTE OneToOne 1 100 0.00 255.0 FORMAT "%5.1" ECU_ADDRESS 0x7FD376 /end MEASUREMENT
/begin MEASUREMENT WDCom_dErrorCountForSpi_u8 "Fehlerzähler für die Kommunikation zwischen Funktionsrechner und Überwachungsmodul" UBYTE OneToOne 1 100 0.00 255.0 FORMAT "%5.1" ECU_ADDRESS 0x7FD375 /end MEASUREMENT
/begin MEASUREMENT WDCom_dErrorCountForWD_u8 "Fehlerzähler für das Überwachungsmodul" UBYTE OneToOne 1 100 0.00 255.0 FORMAT "%5.1" ECU_ADDRESS 0x7FA193 /end MEASUREMENT
/begin MEASUREMENT WDCom_dRequest_u32 "Aktuelle Frage des Überwachungsmoduls" UWORD OneToOne 1 100 0.00 65535.00 FORMAT "%8.2" ECU_ADDRESS 0x7FD33C /end MEASUREMENT
/begin MEASUREMENT ZFC_dpRailLim_mp "Aktuelle max Raildruckabweichung für die Nullmengenkalibrierung" SWORD Pres_Rail 1 100 -3276.800 3276.700 FORMAT "%5.3" ECU_ADDRESS 0x8FF4C8 /end MEASUREMENT
/begin MEASUREMENT ZFC_dpRail_mp "Raildruckabweichung zum Raildruck Kalibrierungspunkt" SWORD Pres_Rail 1 100 -3276.800 3276.700 FORMAT "%5.3" ECU_ADDRESS 0x6F83C4 /end MEASUREMENT
/begin MEASUREMENT ZFC_numCylInj_mp "Aktuelle Zylindernummer für die Einspritzung der Nullmengenkalibrierung" UBYTE OneToOne 1 100 0.00 255.0 FORMAT "%5.1" ECU_ADDRESS 0x6F83E9 /end MEASUREMENT
/begin MEASUREMENT ZFC_phiInj_mp "Ansteuerbeginng der Einspritzung für die Nullmengenkalibrierung" SWORD AngleCrS 1 100 -768.0000 767.9766 FORMAT "%8.4" ECU_ADDRESS 0x8FF4D2 /end MEASUREMENT
/begin MEASUREMENT ZFC_pRailSetPointBal "Abgleichswert des aktuellen Raildruck Kalibrierungspunktes der Nullmengenkalibrierung vom Slave zum Master" SWORD Pres_Rail 1 100 -3276.800 3276.700 FORMAT "%5.3" ECU_ADDRESS 0x7F92FE /end MEASUREMENT
/begin MEASUREMENT ZFC_pRailSetPoint_mp "Angeforderter Raildrucksollwert der Nullmengenkalibrierung" SWORD Pres_Rail 1 100 -3276.800 3276.700 FORMAT "%5.3" ECU_ADDRESS 0x8FF4CA /end MEASUREMENT
/begin MEASUREMENT ZFC_SigThres_mp "Aktuelle Signalschwelle für die Nullmengenkalibrierung" SWORD OneToOne 1 100 -32768.00 32767.00 FORMAT "%8.2" ECU_ADDRESS 0x8FF4D0 /end MEASUREMENT
/begin MEASUREMENT ZFC_Sig_mp "Messwert der Kalibrierung" SLONG OneToOne 1 100 -2147483648.00 2147483647.00 FORMAT "%13.2" ARRAY_SIZE 8 ECU_ADDRESS 0x6F83C8 /end MEASUREMENT
/begin MEASUREMENT ZFC_stCldCham "Zustand des Brennraums für die Nullmengenkalibrierung" UBYTE OneToOne 1 100 0.00 255.0 FORMAT "%5.1" ECU_ADDRESS 0x7F8A34 /end MEASUREMENT
/begin MEASUREMENT ZFC_stCmbCham_mp "Zustand der Erkennung kalter Brennraum für die Nullmengenkalibrierung" UBYTE OneToOne 1 100 0.00 255.0 FORMAT "%5.1" ECU_ADDRESS 0x8FF4C7 /end MEASUREMENT
/begin MEASUREMENT ZFC_stDemBal "Abgleichswert des Nullmengenkalibrierungs Freigabestatus vom Master zum Slave SG" UBYTE OneToOne 1 100 0.00 255.0 FORMAT "%5.1" ECU_ADDRESS 0x7F8A35 /end MEASUREMENT
/begin MEASUREMENT ZFC_stDem_mp "Anforderungen der Nullmengenkalibrierung" UBYTE OneToOne 1 100 0.00 255.0 FORMAT "%5.1" ECU_ADDRESS 0x8FF4CC /end MEASUREMENT
/begin MEASUREMENT ZFC_stEvalSig_mp "Status der Auswertung des Signals der Nullmengenkalibrierung" UBYTE ZFC_EvalEngSpd_Rslt 1 100 0.00 2.00000000000 FORMAT "%13.11" ECU_ADDRESS 0x6F83E8 /end MEASUREMENT
/begin MEASUREMENT ZFC_stInj_mp "Status der Einspritzprogrammierung der Nullmengenkalibrierung" UBYTE ZFC_Inj_State 1 100 0.00 64.0000000000 FORMAT "%13.10" ECU_ADDRESS 0x6F83EA /end MEASUREMENT
/begin MEASUREMENT ZFC_st_mp "Status der Nullmengenkalibrierung" UBYTE ZFC_State 1 100 1.00000000000 16.0000000000 FORMAT "%13.10" ECU_ADDRESS 0x6F83C6 /end MEASUREMENT
/begin MEASUREMENT ZFC_swtClbActv "SW-Schalter für die Aktivierung der ZFC Kalibrierung" UBYTE OneToOne 1 100 0.00 255.0 FORMAT "%5.1" ECU_ADDRESS 0x7F8A36 /end MEASUREMENT
/begin MEASUREMENT ZFC_tiET_mp "Ansteuerdauer für die Einspritzung der Nullmengenkalibrierung" SWORD InjTime_us 1 100 -32768.00 32767.00 FORMAT "%8.2" ECU_ADDRESS 0x6F83EC /end MEASUREMENT
/begin MEASUREMENT ZFC_vStopClb_mp "Minimale Fahrzeuggeschwindigkeit der aktuellen Ansteuerdauerkalibrierung" SWORD Vel 1 100 -327.6800 327.6700 FORMAT "%8.4" ECU_ADDRESS 0x8FF4CE /end MEASUREMENT
/begin MEASUREMENT I_craweng "Strombedarf Motor" SWORD Def_i_sw_q1 0 0 -10.0000 254.0000 ECU_ADDRESS 0x00800488 /begin FUNCTION_LIST BGCRENG /end FUNCTION_LIST /end MEASUREMENT
/begin MEASUREMENT Fak_ttansel "Ansaugluftfaktor E-Lüfterstrom" UWORD Def_f_uw_b512 0 0 0.0 511.9921 ECU_ADDRESS 0x0080048A /begin FUNCTION_LIST BGCRENG /end FUNCTION_LIST /end MEASUREMENT
/begin MEASUREMENT Fak_tubel "Faktor Lüfterstrom aus Geschwindigkeit" UWORD Def_f_uw_b512 0 0 0.0 511.9921 ECU_ADDRESS 0x0080048C /begin FUNCTION_LIST BGCRENG /end FUNCTION_LIST /end MEASUREMENT
/begin MEASUREMENT I_elu_vvt "Strom E-Lüfter und VVT-System" UWORD Def_i_uw_q0p0635 0 0 0.0 4095.9375 ECU_ADDRESS 0x0080048E /begin FUNCTION_LIST BGCRENG /end FUNCTION_LIST /end MEASUREMENT
/begin MEASUREMENT I_eluefter "E-Lüfter Stromaufnahme" UWORD Def_i_uw_q0p0635 0 0 0.0 4095.9375 ECU_ADDRESS 0x00800490 /begin FUNCTION_LIST BGCRENG /end FUNCTION_LIST /end MEASUREMENT
/begin MEASUREMENT I_elupwm "Lüfterstrom ohne Temperatur- und Geschwindigkeitseinfluss" UWORD Def_i_uw_q0p0635 0 0 0.0 64.0000 ECU_ADDRESS 0x00800492 /begin FUNCTION_LIST BGCRENG /end FUNCTION_LIST /end MEASUREMENT
/begin MEASUREMENT I_eluvfzg "Lüfterstrom ohne Geschwindigkeitseinfluss" UWORD Def_i_uw_q0p0635 0 0 0.0 128.0000 ECU_ADDRESS 0x00800494 /begin FUNCTION_LIST BGCRENG /end FUNCTION_LIST /end MEASUREMENT
/begin MEASUREMENT I_gle "Glühstrom" UWORD Def_i_uw_q0p0635 0 0 0.0 4095.9375 ECU_ADDRESS 0x00800496 /begin FUNCTION_LIST BGCRENG /end FUNCTION_LIST /end MEASUREMENT
/begin MEASUREMENT I_sls "berechnete Groesse Strombedarf Sekundärluftpumpe" UWORD Def_i_uw_q0p0635 0 0 0.0 255.0000 ECU_ADDRESS 0x00800498 /begin FUNCTION_LIST BGCRENG /end FUNCTION_LIST /end MEASUREMENT
/begin MEASUREMENT Vvt_ib1_2 "Gesamtstrom VVT Bank1 bzw 4Zyl. und Bank2" UWORD Def_i_uw_q0p0635 0 0 0.0 4095.9375 ECU_ADDRESS 0x0080049A /begin FUNCTION_LIST BGCRENG /end FUNCTION_LIST /end MEASUREMENT
/begin MEASUREMENT Vvt_iges "Strombedarf des gesamten VVT-Systems" UWORD Def_i_uw_q0p0635 0 0 0.0 192.0000 ECU_ADDRESS 0x0080049C /begin FUNCTION_LIST BGCRENG /end FUNCTION_LIST /end MEASUREMENT
/begin MEASUREMENT St_bgllgen0.B_hysllrah "" UBYTE Def_bit_ub_0 0 0 0.0 255.0 ECU_ADDRESS 0x007FF000 /begin FUNCTION_LIST BGLLGEN_1PR /end FUNCTION_LIST BIT_MASK 0x1 /end MEASUREMENT
/begin MEASUREMENT St_bgllgen0 "Statuswort" UBYTE Def_st_ub_q1 0 0 0.0 255.0000 ECU_ADDRESS 0x007FF000 /begin FUNCTION_LIST BGLLGEN_1PR /end FUNCTION_LIST /end MEASUREMENT
/begin MEASUREMENT N_idlgspec "Anforderung LL-Anhebung" UBYTE Def_st_ub_q1 0 0 0.0 255.0000 ECU_ADDRESS 0x008004A0 /begin FUNCTION_LIST BGLLGEN_1PR /end FUNCTION_LIST /end MEASUREMENT
/begin MEASUREMENT N_gsllm "" SWORD Def_n_sw_q1p0 0 0 0.0 32767.0000 ECU_ADDRESS 0x0080049E /begin FUNCTION_LIST BGLLGEN_1PR /end FUNCTION_LIST /end MEASUREMENT
/begin MEASUREMENT Gen_dfvorhs "DF-Signal Vorhersage" UBYTE Def_f_ub_b100 0 0 0.0 99.6093 ECU_ADDRESS 0x008004A1 /begin FUNCTION_LIST BGLLGEN_1PR /end FUNCTION_LIST /end MEASUREMENT
/begin MEASUREMENT I_genrllrah "" UBYTE Def_i_ub_q1 0 0 0.0 255.0000 ECU_ADDRESS 0x008004A2 /begin FUNCTION_LIST BGLLGEN_1PR /end FUNCTION_LIST /end MEASUREMENT
/begin MEASUREMENT T_brw "Temp Brennraumwand" SWORD Def_t_sw_q0p1 0 0 -50.2000 899.8000 ECU_ADDRESS 0x008004A8 /begin FUNCTION_LIST BRWT /end FUNCTION_LIST /end MEASUREMENT
/begin MEASUREMENT T_brwnv "Temp Brennraumwand NV" SWORD Def_t_sw_q0p1 0 0 -50.2000 899.8000 ECU_ADDRESS 0x008004BC /begin FUNCTION_LIST BRWT /end FUNCTION_LIST /end MEASUREMENT
/begin MEASUREMENT T_brwd1 "Tempdiff aus KF QN" SWORD Def_t_sw_q0p01 0 0 -327.6800 327.6700 ECU_ADDRESS 0x008004AA /begin FUNCTION_LIST BRWT /end FUNCTION_LIST /end MEASUREMENT
/begin MEASUREMENT T_brwd2 "Tempdiff aus KF HFM" SWORD Def_t_sw_q0p01 0 0 -327.6800 327.6700 ECU_ADDRESS 0x008004AC /begin FUNCTION_LIST BRWT /end FUNCTION_LIST /end MEASUREMENT
/begin MEASUREMENT T_brwd3 "Tempdiff aus KF HFMS" SWORD Def_t_sw_q0p01 0 0 -327.6800 327.6700 ECU_ADDRESS 0x008004AE /begin FUNCTION_LIST BRWT /end FUNCTION_LIST /end MEASUREMENT
/begin MEASUREMENT T_brwd4 "Tempdiff aus KF TWA" SWORD Def_t_sw_q0p01 0 0 -327.6800 327.6700 ECU_ADDRESS 0x008004B0 /begin FUNCTION_LIST BRWT /end FUNCTION_LIST /end MEASUREMENT
/begin MEASUREMENT T_brwdg "Summe Tempdiff aus Kennfeldern" SWORD Def_t_sw_q0p01 0 0 -327.6800 327.6700 ECU_ADDRESS 0x008004B2 /begin FUNCTION_LIST BRWT /end FUNCTION_LIST /end MEASUREMENT
/begin MEASUREMENT T_brwdiff "Temperatur Brennraumwand Differenz MAP zu calc" SWORD Def_t_sw_q0p1 0 0 -50.2000 899.8000 ECU_ADDRESS 0x008004B4 /begin FUNCTION_LIST BRWT /end FUNCTION_LIST /end MEASUREMENT
/begin MEASUREMENT T_brwsd "Start Tempdiff Tmot zu T_brw" SWORD Def_t_sw_q0p1 0 0 -3276.8000 3276.7000 ECU_ADDRESS 0x008004B6 /begin FUNCTION_LIST BRWT /end FUNCTION_LIST /end MEASUREMENT
/begin MEASUREMENT T_brwsde "Abgeklungene Tempdiff Tmot zu T_brw" SWORD Def_t_sw_q0p1 0 0 -3276.8000 3276.7000 ECU_ADDRESS 0x008004B8 /begin FUNCTION_LIST BRWT /end FUNCTION_LIST /end MEASUREMENT
/begin FUNCTION srvpmp "Servopumpe"
 /begin DEF_CHARACTERISTIC SrvPmp_facSTWAV_CUR SrvPmp_facVS_CUR SrvPmp_rTrans_C SrvPmp_trqSTWABase_CUR /end DEF_CHARACTERISTIC
 /begin IN_MEASUREMENT FrmMng_phiStrg SrvPmp_dphiStrg_mp VSSCD_v /end IN_MEASUREMENT
/end FUNCTION
/begin FUNCTION srvpmp_msg "" /begin OUT_MEASUREMENT SrvPmp_pwrDes SrvPmp_pwrLead /end OUT_MEASUREMENT /end FUNCTION
/begin FUNCTION srvpmp_uic "" /begin OUT_MEASUREMENT SrvPmp_dphiStrg_mp SrvPmp_trqDes_mp /end OUT_MEASUREMENT /end FUNCTION
/begin FUNCTION sspmon "Versorgungsspannungsüberwachung"
 /begin DEF_CHARACTERISTIC SSpMon_DebSRCHighSplyVltgDef1_C SSpMon_DebSRCHighSplyVltgOk1_C SSpMon_DebSRCHighSplyVltgDef2_C SSpMon_DebSRCHighSplyVltgOk2_C SSpMon_DebSRCHighSplyVltgDef3_C SSpMon_DebSRCHighSplyVltgOk3_C SSpMon_DebSRCHighSplyVltgDef4_C SSpMon_DebSRCHighSplyVltgOk4_C SSpMon_DebSRCHighSplyVltgDef5_C SSpMon_DebSRCHighSplyVltgOk5_C SSpMon_DebSRCHighSplyVltgDef6_C SSpMon_DebSRCHighSplyVltgOk6_C SSpMon_DebSRCLowSplyVltgDef1_C SSpMon_DebSRCLowSplyVltgOk1_C SSpMon_DebSRCLowSplyVltgDef2_C SSpMon_DebSRCLowSplyVltgOk2_C SSpMon_DebSRCLowSplyVltgDef3_C SSpMon_DebSRCLowSplyVltgOk3_C SSpMon_DebSRCLowSplyVltgDef4_C SSpMon_DebSRCLowSplyVltgOk4_C SSpMon_DebSRCLowSplyVltgDef5_C SSpMon_DebSRCLowSplyVltgOk5_C SSpMon_DebSRCLowSplyVltgDef6_C SSpMon_DebSRCLowSplyVltgOk6_C SSpMon_numDiaVltg1_C SSpMon_numDiaVltg2_C SSpMon_numDiaVltg3_C SSpMon_numDiaVltg4_C SSpMon_numDiaVltg5_C SSpMon_numDiaVltg6_C /end DEF_CHARACTERISTIC
/end FUNCTION
/begin FUNCTION sspmon_msg "" /begin OUT_MEASUREMENT SSpMon_stSSpErr SSpMon_stSSpErr2 /end OUT_MEASUREMENT /end FUNCTION
/begin FUNCTION sspmon_uic ""
 /begin OUT_MEASUREMENT SSpMon_stRaw_1_mp SSpMon_stRaw_2_mp SSpMon_stRaw_3_mp SSpMon_stRaw_4_mp SSpMon_stRaw_5_mp SSpMon_stRaw_6_mp /end OUT_MEASUREMENT
/end FUNCTION
/begin FUNCTION stdpwm_pwrstg ""
 /begin DEF_CHARACTERISTIC StdPWM_DebExcTempDef_C StdPWM_DebExcTempOk_C StdPWM_DebNoLoadDef_C StdPWM_DebNoLoadOk_C StdPWM_DebShortCircBatDef_C StdPWM_DebShortCircBatOk_C StdPWM_DebShortCircGndDef_C StdPWM_DebShortCircGndOk_C StdPWM_rTst_C StdPWM_tiBtwTst_C /end DEF_CHARACTERISTIC
/end FUNCTION
/begin FUNCTION strtcd_actrout "Starterrelais Steller"
 /begin DEF_CHARACTERISTIC StrtCD_ActrDebExcTempDef_C StrtCD_ActrDebExcTempOk_C StrtCD_ActrDebNoLoadDef_C StrtCD_ActrDebNoLoadOk_C StrtCD_ActrDebShrtCBatDef_C StrtCD_ActrDebShrtCBatOk_C StrtCD_ActrDebShrtCGndDef_C StrtCD_ActrDebShrtCGndOk_C StrtCD_ctPwrStgOnMax_C StrtCD_numDia_C StrtCD_numDioOut_C StrtCD_stActrInvOut_C StrtCD_stPwrStgActrActv_C StrtCD_stPwrStgActrDia_C StrtCD_stSPICtl_C StrtCD_tiBtwTst_C StrtCD_tiPwrStgOn_C /end DEF_CHARACTERISTIC
/end FUNCTION
/begin FUNCTION strtcd_actrout_uic "" /begin OUT_MEASUREMENT StrtCD_stHWE_mp /end OUT_MEASUREMENT /end FUNCTION
/begin FUNCTION stsys "Startsystem" /begin DEF_CHARACTERISTIC StSys_tiStrtLck_C StSys_tiStrtMax_C /end DEF_CHARACTERISTIC /end FUNCTION
/begin FUNCTION stsys_addcor "Startmomentenkorrektur"
 /begin DEF_CHARACTERISTIC StSys_facAPSCor_CUR StSys_numStrtAddCor_C StSys_trqStrtAPSCor_MAP /end DEF_CHARACTERISTIC
 /begin IN_MEASUREMENT APSCD_pVal Eng_nAvrg StSys_tStrtBas_mp /end IN_MEASUREMENT
/end FUNCTION
/begin FUNCTION stsys_addcor_msg "" /begin OUT_MEASUREMENT StSys_trqAddCor /end OUT_MEASUREMENT /end FUNCTION
/begin FUNCTION stsys_addcor_uic ""
 /begin OUT_MEASUREMENT StSys_facAPSCor_mp StSys_trqStrtAPSCor_mp StSys_trqStrtAPS_mp StSys_tStrtBas_mp /end OUT_MEASUREMENT
/end FUNCTION
/begin FUNCTION stsys_strt "Startabwurf" /begin DEF_CHARACTERISTIC StSys_nStrtCutOut_MAP StSys_numStrt_C StSys_tiStrtCutOut_C /end DEF_CHARACTERISTIC /begin IN_MEASUREMENT APSCD_pVal StSys_tStrt_mp /end IN_MEASUREMENT /end FUNCTION
/begin FUNCTION stsys_strtbas "Startbasismoment"
 /begin DEF_CHARACTERISTIC StSys_nAdjMax_C StSys_numStrtBas_C StSys_trqAdjMax_C StSys_trqAdjVal_C StSys_trqStrtBas_MAP /end DEF_CHARACTERISTIC
 /begin IN_MEASUREMENT CTSCD_tClnt Eng_nAvrg /end IN_MEASUREMENT
/end FUNCTION
/begin FUNCTION stsys_strtbas_msg "" /begin OUT_MEASUREMENT StSys_trqBas /end OUT_MEASUREMENT /end FUNCTION
/begin FUNCTION stsys_strtbas_uic "" /begin OUT_MEASUREMENT StSys_trqAdj_mp StSys_trqSetAdjVal_mp StSys_trqStrtBas_mp /end OUT_MEASUREMENT /end FUNCTION
/begin FUNCTION stsys_strtctl "Startsystem Anlassersteuerung"
 /begin DEF_CHARACTERISTIC StSys_nDiseng_C StSys_nEngage_C Stsys_swtGlwLamp_C StSys_tiLckCutOut_C /end DEF_CHARACTERISTIC
/end FUNCTION
/begin FUNCTION stsys_strtctl_msg "" /begin OUT_MEASUREMENT StSys_stActrOut /end OUT_MEASUREMENT /end FUNCTION
/begin FUNCTION stsys_strtctl_uic "" /begin OUT_MEASUREMENT StSys_stActrLck_mp StSys_stActrRls_mp /end OUT_MEASUREMENT /end FUNCTION
/begin FUNCTION stsys_strtrmp "Startrampe"
 /begin DEF_CHARACTERISTIC StSys_nFreezeTrqRmp_C StSys_nReleaseTrqRmp_C StSys_numStrtRmp_C StSys_tClntHi_C StSys_tClntLo_C StSys_tiEngTempValid_C StSys_dtrqColdInc_C StSys_tiColdRmpLck_C StSys_trqColdLim_C StSys_dtrqHotInc_C StSys_tiHotRmpLck_C StSys_trqHotLim_C StSys_dtrqWarmInc_C StSys_tiWarmRmpLck_C StSys_trqWarmLim_C /end DEF_CHARACTERISTIC
/end FUNCTION
/begin FUNCTION stsys_strtrmp_msg "" /begin OUT_MEASUREMENT StSys_stRmpMon StSys_trqRmpState StSys_trqStrt /end OUT_MEASUREMENT /end FUNCTION
/begin FUNCTION stsys_strtrmp_uic "" /begin OUT_MEASUREMENT StSys_tStrtRmp_mp /end OUT_MEASUREMENT /end FUNCTION
/begin FUNCTION stsys_strttip "Tip Start (Automatik Start)"
 /begin DEF_CHARACTERISTIC StSys_nStrtTipMax_MAP StSys_nStrtTipProtCaS_C StSys_nStrtTipProt_C StSys_swtShOffGearbxRec_C StSys_swtStrtTipActv_C StSys_tiStrtTipMin_C StSys_tiStrtTipNoMonitor_C StSys_tiStrtTipProt_C /end DEF_CHARACTERISTIC
 /begin IN_MEASUREMENT APSCD_pVal Eng_tEng /end IN_MEASUREMENT
/end FUNCTION
/begin FUNCTION stsys_strttip_msg "" /begin OUT_MEASUREMENT StSys_stStrtTip StSys_stStrtTipOFF StSys_stStrtTipON /end OUT_MEASUREMENT /end FUNCTION
/begin FUNCTION stsys_strttip_uic "" /end FUNCTION
/begin FUNCTION stsys_strt_msg "" /begin OUT_MEASUREMENT StSys_stNewStrt StSys_stStrt StSys_stStrtCutOutMon /end OUT_MEASUREMENT /end FUNCTION
/begin FUNCTION stsys_strt_uic "" /begin OUT_MEASUREMENT StSys_nThresStrtCutOut_mp StSys_tStrt_mp /end OUT_MEASUREMENT /end FUNCTION
/begin FUNCTION stsys_t50shutoff ""
 /begin DEF_CHARACTERISTIC StSys_DebTrqShutOffDef_C StSys_DebTrqShutOffOk_C StSys_nStarter_C StSys_tiEngageCutOut_C StSys_vThres_C /end DEF_CHARACTERISTIC
/end FUNCTION
/begin FUNCTION stsys_t50shutoff_uic "" /begin OUT_MEASUREMENT StSys_stTrqShutOffErr_mp /end OUT_MEASUREMENT /end FUNCTION
/begin FUNCTION stsys_trqshutoff "Startmomentabschaltung"
 /begin DEF_CHARACTERISTIC StSys_n2MsWhlLoLim_C StSys_n2MsWhlUpOfs_C StSys_tinFltPT1_C StSys_swtShutOff_C StSys_ti2MsWhlPrt_C StSys_tiStartOszilDef_C StSys_tiStartOszilOk_C /end DEF_CHARACTERISTIC
/end FUNCTION
/begin FUNCTION stsys_trqshutoff_msg "" /begin OUT_MEASUREMENT StSys_stTrqShutOff /end OUT_MEASUREMENT /end FUNCTION
/begin FUNCTION stsys_trqshutoff_uic "" /begin OUT_MEASUREMENT StSys_nAvrgFlt_mp StSys_stTrqShutOffCond_mp /end OUT_MEASUREMENT /end FUNCTION
/begin FUNCTION switches_base "" /end FUNCTION
/begin FUNCTION switches_proj "" /end FUNCTION
/begin FUNCTION switches_sys "" /end FUNCTION
/begin FUNCTION swtmr_inc10ms "" /end FUNCTION
/begin FUNCTION swtmr_inc10ms_uic "" /end FUNCTION
/begin FUNCTION swtmr_msg "" /begin OUT_MEASUREMENT SWTmr_tiTmr16 SWTmr_tiTmr32 /end OUT_MEASUREMENT /end FUNCTION
/begin FUNCTION system_const_base "" /end FUNCTION
/begin FUNCTION system_const_conf "" /end FUNCTION
/begin FUNCTION system_const_proj "" /end FUNCTION
/begin FUNCTION system_const_sys "" /end FUNCTION
/begin FUNCTION t15cd "Klemme 15 Komponententreiber"
 /begin DEF_CHARACTERISTIC T15CD_tiDebNeg_C T15CD_tiDebPos_C T15CD_DebNplDef_C T15CD_DebNplOk_C T15CD_numDioIn_C T15CD_stInvIn_C T15CD_tiDebWakeUp_C /end DEF_CHARACTERISTIC
/end FUNCTION
/begin FUNCTION t15cd_msg "" /begin OUT_MEASUREMENT T15CD_stDebVal T15CD_stDebWakeUpVal T15CD_stWakeUp /end OUT_MEASUREMENT /end FUNCTION
/begin FUNCTION t15cd_uic ""
 /begin OUT_MEASUREMENT T15CD_stCondDebVal_mp T15CD_stLogicT15_mp T15CD_stWakeUpRawVal_mp /end OUT_MEASUREMENT
/end FUNCTION
/begin FUNCTION t50cd "Komponententreiber Klemme 50"
 /begin DEF_CHARACTERISTIC T50CD_tiDebNeg_C T50CD_tiDebPos_C T50CD_stDflVal_C T50CD_stInv_C T50CD_swtSigVal_C /end DEF_CHARACTERISTIC
/end FUNCTION
/begin FUNCTION t50cd_msg "" /begin OUT_MEASUREMENT T50CD_stDebVal T50CD_stRawVal T50CD_swtSig /end OUT_MEASUREMENT /end FUNCTION
/begin FUNCTION t50cd_uic "" /end FUNCTION
/begin FUNCTION thrvlv_co "actuator coordinator for Throttle Valve" /end FUNCTION
/begin FUNCTION thrvlv_co_msg "" /begin OUT_MEASUREMENT ThrVlv_rTVA ThrVlv_rTVA2 /end OUT_MEASUREMENT /end FUNCTION
/begin FUNCTION thrvlv_co_uic ""
 /begin DEF_CHARACTERISTIC ThrVlv_rTVA2_Vector ThrVlv_rTVA2_Channel ThrVlv_rTVA_Vector ThrVlv_rTVA_Channel /end DEF_CHARACTERISTIC
 /begin OUT_MEASUREMENT ThrVlv_rTVA2Byp_mp ThrVlv_rTVAByp_mp /end OUT_MEASUREMENT
/end FUNCTION
/begin FUNCTION thrvlv_mon ""
 /begin DEF_CHARACTERISTIC ThrVlv_ctMonDefLimH_C ThrVlv_ctMonDefLimL_C ThrVlv_pLimMon_C ThrVlv_swtMon_C /end DEF_CHARACTERISTIC
/end FUNCTION
/begin FUNCTION thrvlv_mon_msg "" /begin OUT_MEASUREMENT ThrVlv_stMonAftRunDelDem /end OUT_MEASUREMENT /end FUNCTION
/begin FUNCTION thrvlv_mon_uic "" /begin OUT_MEASUREMENT ThrVlv_ctMonDef_mp ThrVlv_pDiffMaxMon_mp ThrVlv_stMon_mp /end OUT_MEASUREMENT /end FUNCTION
/begin FUNCTION tpumon "Timer Überwachung"
 /begin DEF_CHARACTERISTIC TPUMon_ctDfctLim_C TPUMon_ctTPU_C TPUMon_tiDiffMaxLimit_C TPUMon_tiDiffMinLimit_C TPUMon_tiDiffSumLimit_C /end DEF_CHARACTERISTIC
/end FUNCTION
/begin FUNCTION tpumon_uic ""
 /begin OUT_MEASUREMENT TPUMon_ctUpDwnDeb_mp TPUMon_tiDiffMax_mp TPUMon_tiDiffMin_mp TPUMon_tiDiffSum_mp /end OUT_MEASUREMENT
/end FUNCTION
/begin FUNCTION tvacd "Drosselklappensteller Komponententreiber"
 /begin DEF_CHARACTERISTIC TVACD_ctPwrStgOnMax_C TVACD_DebExcTempDef_C TVACD_DebExcTempOk_C TVACD_DebNoLoadDef_C TVACD_DebNoLoadOk_C TVACD_DebShortCircBatDef_C TVACD_DebShortCircBatOk_C TVACD_DebShortCircGndDef_C TVACD_DebShortCircGndOk_C TVACD_tiDebTVADia1Def_C TVACD_tiDebTVADia1Ok_C TVACD_tiDebTVADia2Def_C TVACD_tiDebTVADia2Ok_C TVACD_tiDebTVADia3Def_C TVACD_tiDebTVADia3Ok_C TVACD_tiDebTVADia4Def_C TVACD_tiDebTVADia4Ok_C TVACD_numDia_C TVACD_numPwmOut_C TVACD_stInvOut_C TVACD_tiPer_C TVACD_rCnv_CUR TVACD_rOutMax_C TVACD_rOutMin_C TVACD_rTst2_C TVACD_rTst_C TVACD_stPwrStgActv_C TVACD_stPwrStgDia_C TVACD_stSPICtl_C TVACD_swt_C TVACD_tiBtwTst_C TVACD_tiDiag1Max_C TVACD_tiDiag1Min_C TVACD_tiDiag2Max_C TVACD_tiDiag2Min_C TVACD_tiDiag3Max_C TVACD_tiDiag3Min_C TVACD_tiDiag4Max_C TVACD_tiDiag4Min_C TVACD_tiPwrStgOn_C /end DEF_CHARACTERISTIC
 /begin IN_MEASUREMENT ThrVlv_rTVA /end IN_MEASUREMENT
/end FUNCTION
/begin FUNCTION tvacd2 ""
 /begin DEF_CHARACTERISTIC TVACD_numDia2_C TVACD_numPwmOut2_C TVACD_rOutMax2_C TVACD_rOutMin2_C TVACD_stPwrStgActv2_C TVACD_stPwrStgDia2_C /end DEF_CHARACTERISTIC
/end FUNCTION
/begin FUNCTION tvacd2_msg "" /begin OUT_MEASUREMENT TVACD_rOut2 TVACD_stTVADia2 /end OUT_MEASUREMENT /end FUNCTION
/begin FUNCTION tvacd2_uic "" /begin OUT_MEASUREMENT TVACD_rCnv2_mp /end OUT_MEASUREMENT /end FUNCTION
/begin FUNCTION tvacd_airmon "Drosselklappensteller - Monitor"
 /begin DEF_CHARACTERISTIC TVACD_tiDebAirMonDfl8Def_C TVACD_tiDebAirMonDfl8Ok_C TVACD_tiDebAirMonDfl8BDef_C TVACD_tiDebAirMonDfl8BOk_C TVACD_stAirMonMskDfl8_C /end DEF_CHARACTERISTIC
/end FUNCTION
/begin FUNCTION tvacd_airmon_msg "" /begin OUT_MEASUREMENT TVACD_stAirMon TVACD_stAirMonA /end OUT_MEASUREMENT /end FUNCTION
/begin FUNCTION tvacd_airmon_uic ""
 /begin OUT_MEASUREMENT TVACD_stAirMon1Raw_mp TVACD_stAirMon1_mp TVACD_stAirMon2Raw_mp TVACD_stAirMon2_mp TVACD_stAirMon_mp /end OUT_MEASUREMENT
/end FUNCTION
/begin FUNCTION tvacd_msg "" /begin OUT_MEASUREMENT TVACD_rOut TVACD_stTVADia1 /end OUT_MEASUREMENT /end FUNCTION
/begin FUNCTION tvacd_uic "" /begin OUT_MEASUREMENT TVACD_rCnv_mp /end OUT_MEASUREMENT /end FUNCTION
/begin FUNCTION uaddr "" /begin DEF_CHARACTERISTIC UAddr_stCalibration_C Uaddr_stMeasurement_C /end DEF_CHARACTERISTIC /end FUNCTION
/begin FUNCTION usap "Datensatzvarianten Bezeichner" /begin DEF_CHARACTERISTIC USAp_dDataVariantIdInv_C USAp_dDataVariantId_C /end DEF_CHARACTERISTIC /begin OUT_MEASUREMENT USAp_dDataVariant_u8 USAp_stDataVariant_u8 /end OUT_MEASUREMENT /end FUNCTION
/begin FUNCTION usrda "Benutzergrößen" /end FUNCTION
/begin FUNCTION usrda_msg "" /begin OUT_MEASUREMENT UsrDa_stFDC /end OUT_MEASUREMENT /end FUNCTION
/begin FUNCTION usrda_uic "" /end FUNCTION
/begin FUNCTION vehda "Fahrzeuggrößen" /begin DEF_CHARACTERISTIC VehDa_rVnMax_C VehDa_tiNPT1_C VehDa_tiVnPT1_C /end DEF_CHARACTERISTIC /end FUNCTION
/begin FUNCTION vehda_loadcalc "Ermittlung des Fahrzeugnutzungsprofil"
 /begin DEF_CHARACTERISTIC VehDa_nLoadActv_C VehDa_nLoad_C VehDa_swtRst_C VehDa_trqLoad_C /end DEF_CHARACTERISTIC
 /begin OUT_MEASUREMENT VehDa_ctLoadPrimRow0_mp VehDa_ctLoadPrimRow1_mp VehDa_ctLoadPrimRow2_mp VehDa_ctLoadPrimRow3_mp VehDa_ctLoadPrimRow4_mp VehDa_ctLoadPrimRow5_mp VehDa_ctLoadSecRow0_mp VehDa_ctLoadSecRow1_mp VehDa_ctLoadSecRow2_mp VehDa_ctLoadSecRow3_mp VehDa_ctLoadSecRow4_mp VehDa_ctLoadSecRow5_mp VehDa_tiLoadPrim_mp VehDa_tiLoadSec_mp /end OUT_MEASUREMENT
/end FUNCTION
/begin FUNCTION vehda_loadcalc_uic "" /end FUNCTION
/begin FUNCTION vehda_lsum "Erfassung gefahrene Strecke" /end FUNCTION
/begin FUNCTION vehda_lsum_msg "" /begin OUT_MEASUREMENT VehDa_lSum /end OUT_MEASUREMENT /end FUNCTION
/begin FUNCTION vehda_lsum_uic "" /begin OUT_MEASUREMENT VehDa_lInt_mp /end OUT_MEASUREMENT /end FUNCTION
/begin FUNCTION vehda_msg "" /begin OUT_MEASUREMENT VehDa_rVn VehDa_stTrqDem /end OUT_MEASUREMENT /end FUNCTION
/begin FUNCTION vehda_tiengon "Erfassung der aktuellen Betriebszeit" /begin DEF_CHARACTERISTIC VehDa_lEepUpd_C VehDa_nMaxEepUpd_C VehDa_nMinEepUpd_C /end DEF_CHARACTERISTIC /end FUNCTION
/begin FUNCTION vehda_tiengon_msg "" /begin OUT_MEASUREMENT VehDa_tiEngOn /end OUT_MEASUREMENT /end FUNCTION
/begin FUNCTION vehda_tiengon_uic "" /end FUNCTION
/begin FUNCTION vehda_uic "" /begin OUT_MEASUREMENT VehDa_nEngFilt_mp /end OUT_MEASUREMENT /end FUNCTION
/begin FUNCTION vehmot "Fahrzeugbewegung" /end FUNCTION
/begin FUNCTION vehmot_msg "" /begin OUT_MEASUREMENT VehMot_nMax VehMot_nMin VehMot_pwrAcsDes VehMot_pwrAcsLead /end OUT_MEASUREMENT /end FUNCTION
/begin FUNCTION vesgov_governor "Arbeitsdrehzahlregler" /end FUNCTION
/begin FUNCTION vesgov_governor_msg "" /begin OUT_MEASUREMENT VESGov_trq /end OUT_MEASUREMENT /end FUNCTION
/begin FUNCTION vesgov_governor_uic "" /end FUNCTION
/begin FUNCTION vsacd "Drallniveausteller Komponententreiber"
 /begin DEF_CHARACTERISTIC VSACD_ctPwrStgOnMax_C VSACD_tiDebDioInDia1Def_C VSACD_tiDebDioInDia1Ok_C VSACD_tiDebDioInDia2Def_C VSACD_tiDebDioInDia2Ok_C VSACD_tiDebDioInDia3Def_C VSACD_tiDebDioInDia3Ok_C VSACD_tiDebDioInDia4Def_C VSACD_tiDebDioInDia4Ok_C VSACD_tiDebDioInMinDef_C VSACD_tiDebDioInMinOk_C VSACD_DebExcTempDef_C VSACD_DebExcTempOk_C VSACD_DebNoLoadDef_C VSACD_DebNoLoadOk_C VSACD_DebShortCircBatDef_C VSACD_DebShortCircBatOk_C VSACD_DebShortCircGndDef_C VSACD_DebShortCircGndOk_C VSACD_tiDebVSADia1Def_C VSACD_tiDebVSADia1Ok_C VSACD_tiDebVSADia2Def_C VSACD_tiDebVSADia2Ok_C VSACD_tiDebVSADia3Def_C VSACD_tiDebVSADia3Ok_C VSACD_tiDebVSADia4Def_C VSACD_tiDebVSADia4Ok_C VSACD_numDiaImp_C VSACD_numDia_C VSACD_numDioIn_C VSACD_numPwmOut_C VSACD_stInvOut_C VSACD_tiPer_C VSACD_rCnv_CUR VSACD_rOutMax_C VSACD_rOutMin_C VSACD_rTst_C VSACD_stPwrStgActv_C VSACD_stPwrStgDia_C VSACD_stSPICtl_C VSACD_swtExtPinEna_C VSACD_swt_C VSACD_tiBtwTst_C VSACD_tiDiaDetMax_C VSACD_tiDiaDetMin_C VSACD_tiDiag1Max_C VSACD_tiDiag1Min_C VSACD_tiDiag2Max_C VSACD_tiDiag2Min_C VSACD_tiDiag3Max_C VSACD_tiDiag3Min_C VSACD_tiDiag4Max_C VSACD_tiDiag4Min_C VSACD_tiDioInDia1Max_C VSACD_tiDioInDia1Min_C VSACD_tiDioInDia2Max_C VSACD_tiDioInDia2Min_C VSACD_tiDioInDia3Max_C VSACD_tiDioInDia3Min_C VSACD_tiDioInDia4Max_C VSACD_tiDioInDia4Min_C VSACD_tiPwrStgOn_C /end DEF_CHARACTERISTIC
 /begin IN_MEASUREMENT VSA_rVSA /end IN_MEASUREMENT
/end FUNCTION
/begin FUNCTION vsacd_msg "" /begin OUT_MEASUREMENT VSACD_rOut VSACD_stMonDiaWin /end OUT_MEASUREMENT /end FUNCTION
/begin FUNCTION vsacd_uic ""
 /begin OUT_MEASUREMENT VSACD_numDiaImp_mp VSACD_rCnv_mp VSACD_stErr_mp VSACD_tiDiaDet_mp /end OUT_MEASUREMENT
/end FUNCTION
/begin FUNCTION vsacd_var "" /end FUNCTION
/begin FUNCTION vsacd_var_uic "" /end FUNCTION
/begin FUNCTION vsa_co "Stellerkoordinator für Drallnivieausteller" /end FUNCTION
/begin FUNCTION vsa_co_msg "" /begin OUT_MEASUREMENT VSA_rVSA /end OUT_MEASUREMENT /end FUNCTION
/begin FUNCTION vsa_co_uic "" /begin DEF_CHARACTERISTIC VSA_rVSA_Vector VSA_rVSA_Channel /end DEF_CHARACTERISTIC /begin OUT_MEASUREMENT VSA_rVSAByp_mp /end OUT_MEASUREMENT /end FUNCTION
/begin FUNCTION vsscd_co "Fahrgeschwindigkeitsgeber Komponententreiber"
 /begin DEF_CHARACTERISTIC VSSCD_DebCanSigDef_C VSSCD_DebCanSigOk_C VSSCD_DebMaxDef_C VSSCD_DebMaxOk_C VSSCD_DebNegPlaMonCond_C VSSCD_DebPlaMonCond_C VSSCD_DebPlaDef_C VSSCD_DebPlaOk_C VSSCD_DebSigDef_C VSSCD_DebSigOk_C VSSCD_nThresPla_C VSSCD_qThresPla_C VSSCD_swtSigVal_C VSSCD_swtSigType_C VSSCD_tiAPT1_C VSSCD_tiPerMax_C VSSCD_tiVPT1_C VSSCD_vDfl_C VSSCD_vMax_C VSSCD_vMin_C VSSCD_vThresPla_C /end DEF_CHARACTERISTIC
/end FUNCTION
/begin FUNCTION vsscd_co_distfac "" /begin DEF_CHARACTERISTIC VSSCD_ImpPerDist_C /end DEF_CHARACTERISTIC /end FUNCTION
/begin FUNCTION vsscd_co_distfac_uic "" /end FUNCTION
/begin FUNCTION vsscd_co_uic "" /begin OUT_MEASUREMENT VSSCD_rImp_mp VSSCD_stInHW_mp /end OUT_MEASUREMENT /end FUNCTION
/begin FUNCTION vsscd_co_var "" /end FUNCTION
/begin FUNCTION vsscd_co_var_msg "" /begin OUT_MEASUREMENT VSSCD_ctImp VSSCD_swtSig VSSCD_tiPerAvrg /end OUT_MEASUREMENT /end FUNCTION
/begin FUNCTION vsscd_co_var_uic "" /end FUNCTION
/begin FUNCTION vsscd_msg "" /begin OUT_MEASUREMENT VSSCD_a VSSCD_aRaw VSSCD_v VSSCD_vRaw VSSCD_vSensVal /end OUT_MEASUREMENT /end FUNCTION
/begin FUNCTION wdcom "Frage-Antwort-Kommunikation mit Überwachungsmodul" /begin DEF_CHARACTERISTIC Chiste_stEnaTst_C /end DEF_CHARACTERISTIC /end FUNCTION
/begin FUNCTION wdcom_msg ""
 /begin OUT_MEASUREMENT WDCom_dChisteResponse_u32 WDCom_dErrorCountForCntler_u8 WDCom_dErrorCountForSpi_u8 WDCom_dErrorCountForWD_u8 WDCom_dRequest_u32 /end OUT_MEASUREMENT
/end FUNCTION
/begin FUNCTION zfc_cldcmbcham "" /begin DEF_CHARACTERISTIC ZFC_tiCldCham_CUR ZFC_tiHotCham_C /end DEF_CHARACTERISTIC /begin IN_MEASUREMENT IATSCD_tAir /end IN_MEASUREMENT /end FUNCTION
/begin FUNCTION zfc_cldcmbcham_msg "" /begin OUT_MEASUREMENT ZFC_stCldCham /end OUT_MEASUREMENT /end FUNCTION
/begin FUNCTION zfc_cldcmbcham_uic "" /begin OUT_MEASUREMENT ZFC_stCmbCham_mp /end OUT_MEASUREMENT /end FUNCTION
/begin FUNCTION zfc_co ""
 /begin DEF_CHARACTERISTIC ZFC_dBPFacNumFBCG3_CA ZFC_dBPFacNumFBCG4_CA ZFC_dBPFacNumFBCG5_CA ZFC_dBPFacNumFBCG6_CA ZFC_dSegFBCCaS_CA ZFC_nAvrgMax_C ZFC_nAvrgMin_C ZFC_nChngPRailMax_C ZFC_nFBCThresMax_C ZFC_nHyst_C ZFC_numRatETClb_C ZFC_numRatNVClb_C ZFC_stClthSel_C ZFC_stGearRls_CA ZFC_swtClbActvVal_C ZFC_swtClbActvType_C ZFC_tAirThres_C ZFC_tEngThres_C ZFC_tFuelThresMax_C ZFC_tFuelThresMin_C ZFC_tiDelOvrRun_C ZFC_tiDelpRailLim_C ZFC_uBattMin_C /end DEF_CHARACTERISTIC
/end FUNCTION
/begin FUNCTION zfc_co_uic ""
 /begin OUT_MEASUREMENT ZFC_dpRailLim_mp ZFC_dpRail_mp ZFC_pRailSetPoint_mp ZFC_stDem_mp ZFC_st_mp ZFC_vStopClb_mp /end OUT_MEASUREMENT
/end FUNCTION
/begin FUNCTION zfc_evalengspd "" /begin OUT_MEASUREMENT ZFC_Sig_mp /end OUT_MEASUREMENT /end FUNCTION
/begin FUNCTION zfc_evalengspd_uic "" /begin OUT_MEASUREMENT ZFC_SigThres_mp ZFC_stEvalSig_mp /end OUT_MEASUREMENT /end FUNCTION
/begin FUNCTION zfc_inj "Einspritzberechnung der Nullmengenkalibrierung" /begin DEF_CHARACTERISTIC ZFC_phiSet_CUR /end DEF_CHARACTERISTIC /begin IN_MEASUREMENT Eng_nAvrg /end IN_MEASUREMENT /end FUNCTION
/begin FUNCTION zfc_inj_uic "" /begin OUT_MEASUREMENT ZFC_numCylInj_mp ZFC_phiInj_mp ZFC_stInj_mp ZFC_tiET_mp /end OUT_MEASUREMENT /end FUNCTION
/begin FUNCTION zfc_msg "" /begin OUT_MEASUREMENT ZFC_pRailSetPointBal ZFC_stDemBal ZFC_swtClbActv /end OUT_MEASUREMENT /end FUNCTION
/begin FUNCTION _pa_branchtab "" /end FUNCTION
/begin FUNCTION _ksd "Kundenspezifische Daten (mit #KSD gekennzeichnet)" /begin REF_CHARACTERISTIC /end REF_CHARACTERISTIC /end FUNCTION
/begin FUNCTION _ssd "Systemspezifische Daten (mit #SSD gekennzeichnet)"
 /begin REF_CHARACTERISTIC ACC_DebPlausTrqDesDef_C ACC_DebPlausTrqDesOk_C ACC_DebTrqInrDef_C ACC_DebTrqInrOk_C ACC_dtrqLimBrkDwn_C ACC_dtrqLimBrkUp_C ACC_dtrqLimDwn_C ACC_dtrqLimUp_C AccPed_drAPPUnFltLim_C AccPed_drLimDwn_C AccPed_drLimpMax_C AccPed_drLimUp_C AccPed_facAcsWghMax_C AccPed_facAcsWghMin_C AccPed_facLIOvrBehWgh_C AccPed_nErrBrk_C AccPed_nErr_CUR AccPed_nLim_C AccPed_nLimNMR_C AccPed_nPlaAPPBrk_C AccPed_pBrkHigh_C AccPed_pBrkLow_C AccPed_rLimpMax_C AccPed_rPlaMaxVal_C AccPed_rPlaMaxVal_CUR AccPed_rThPlaus_C AccPed_rThresPrp_C AccPed_rZero_C AccPed_swtAliveDetEna_C AccPed_swtPlausCheckReqd_C AccPed_swtRstCon_C AccPed_swtVehDynReqd_C AccPed_tiDebAliveDef_C AccPed_tiDebAliveOk_C AccPed_tiDebPlaDet_C AccPed_tiDebPladrLckOk_C AccPed_tiDebPlaRst_C AccPed_tiPlausBrkDebPos_C AccPed_trqDes_Channel AccPed_trqDes_Vector AccPed_trqLIOvrBehOfsL_C AccPed_trqNMRMax_C AccPed_trqPrp_MAP AccPed_vLim_C ACC_PlausTrqTmrDead_C ACC_qOvrRunZeroYHigh_C ACC_qOvrRunZeroYLow_C ACC_swtBrkPressedDel_C ACC_swtTrqDesShutOff_C ACC_tiBrkPressedDel_C ACC_tiPT1_C ACCtl_nMin_C ACC_trqReplVal_C ADCMon_DebQueueDef_C ADCMon_DebRefVltgSRCDef_C ADCMon_DebTstImpDef_C ADCMon_nQueueMon_C ADCMon_tiQueueMon_C ADCMon_tiSendTstImp_C ADCMon_uRefSRCMax_C ADCMon_uRefSRCMin_C ADCMon_uTstImpSRCMax_C AFSCD_swtAirSysType_C AFSCD_swtAirSysVal_C AirCtl_mDesValAdd_Channel AirCtl_mDesValAdd_Vector AirCtl_mDesVal_Channel AirCtl_mDesVal_Vector AirCtl_rEGRAdd_Channel AirCtl_rEGRAdd_Vector AirCtl_rEGR_Channel AirCtl_rEGR_Vector AirCtl_rTVAAdd_Channel AirCtl_rTVAAdd_Vector AirCtl_rTVA_Channel AirCtl_rTVA_Vector Alt_pwrDes_Channel Alt_pwrDes_Vector AOHtCD_numDia_C AOHtCD_numDioIn_C AOHtCD_numPwmOut_C AOHt_nMin_C AOHt_rHtgOut_Channel AOHt_rHtgOut_Vector APPCD_DebSRCHighDef_C APPCD_DebSRCHighOk_C APPCD_DebSRCLowDef_C APPCD_DebSRCLowOk_C APPCD_DebSyncDef_C APPCD_DebSyncOk_C APPCD_duLimErrPos_C APPCD_facrAPP1APP2_C APPCD_numAdcAPP1_C APPCD_numAdcAPP2_C APPCD_rLinAPP_CUR APPCD_SSpMonAPP1_C APPCD_SSpMonAPP2_C APPCD_uAPPMin_C APPCD_uAPP1_SRCMax_C APPCD_uAPP1_SRCMin_C APPCD_uAPP2_SRCMax_C APPCD_uAPP2_SRCMin_C APPCD_uMinSync_C APPCD_uRawAPP2dOff_C APPCD_uSync_CUR APSCD_numAdc_C APSCD_pDfl_C APSCD_pLin_CUR APSCD_uSRCMax_C APSCD_uSRCMin_C ASDdc_trq_Channel ASDdc_trq_Vector ASDrf_trqInr_Channel ASDrf_trqInr_Vector BattCD_numAdc_C Batt_uNrm_C BPACD_DebExcTempDef_C BPACD_DebExcTemp2Def_C BPACD_DebNoLoadDef_C BPACD_DebNoLoad2Def_C BPACD_DebShortCircBatDef_C BPACD_DebShortCircBat2Def_C BPACD_DebShortCircGndDef_C BPACD_DebShortCircGnd2Def_C BPACD_numDia_C BPACD_numDia2_C BPACD_numPwmOut_C BPACD_numPwmOut2_C BPACD_stPwrStgDia_C BPACD_stPwrStgDia2_C BPACD_tiBtwTst_C BPA_rBPACD_Channel BPA_rBPACD_Vector BPSCD_DebNplDef_C BPSCD_DebSigDef_C BPSCD_DebSRCHighDef_C BPSCD_DebSRCLowDef_C BPSCD_numAdc_C BPSCD_swtSigVal_C BPSCD_uSRCMax_C BPSCD_uSRCMin_C BrkCD_DebPlaDef_C BrkCD_DebPlaOk_C BrkCD_numDioInMn_C BrkCD_numDioInRed_C BrkCD_stMnSwtInvIn_C BrkCD_stRedSwtInvIn_C BrkCD_swtRedSwtPresent_C BrkCD_tiMnSwtDebNeg_C BrkCD_tiMnSwtDebPos_C BrkCD_tiRedSwtDebNeg_C BrkCD_tiRedSwtDebPos_C BypEtk_dNsyncStimuli16_C BypEtk_dNsyncStimuli32_C BypEtk_dNsyncStimuli64_C BypEtk_dNsyncStimuli8_C BypEtk_dTsyncStimuli16_C BypEtk_dTsyncStimuli32_C BypEtk_dTsyncStimuli64_C BypEtk_dTsyncStimuli8_C BypEtk_stAscet_C BypInt_adFunc_C BypInt_stAscet_C CaSCD_ctAddTooth_C CaSCD_ctEdgOfs_C CaSCD_ctErrSegLen2Pos_C CaSCD_ctErrSync_C CaSCD_ctMissTooth_C CaSCD_ctShftSync_C CaSCD_dSegSeries_C CaSCD_facPlausHigh_CUR CaSCD_facPlausLow_CUR CaSCD_nMinSpeed_C CaSCD_phiPosTolc_C CaSCD_phiSegLen_C CaSCD_phiSegLenTolc_C CaSCD_phiSegOfs_C CaSCD_phiSpeedCalcTolc_C CaSCD_phiSpeedSegLen_C CaSCD_phiSpeedSegOfs_C CaSCD_stCalc_C CaSCD_stEdgeTrig_C CaSCD_stPinState_C CaSCD_stTPO_C CaSCD_swtSegLenPin2Pos_C CaSCD_tiPeriodRev1Max_C CaSCD_tiPeriodRev2Max_C CaSCD_tiTimOutOfs_C Chiste_stEnaTst_C CoDT_dDT1Kd_C CoDT_swtCoTypeType_C CoDT_swtCoTypeVal_C CoDT_tiDT1_C CoDT_tiTrqDesDebDef_C CoDT_tiTrqDesDebOk_C CoDT_tiTrqLeadDebDef_C CoDT_tiTrqLeadDebOk_C CoDT_trqDiffMaxDes_CUR CoDT_trqDiffMaxLead_CUR CoDT_trqMinInit_C CoEng_dtrqLimUp_C CoEng_dtrqLimUp1_C CoEng_dtrqLimUp2_C CoEng_ExtWaitMsk_C CoEng_ExtWaitMsk2_C CoEng_facAdjMax_C CoEng_nActrRelease_C CoEng_nShOffTstMax_C CoEng_nShOffTstMin_C CoEng_rhoFuel_C CoEng_stIRevShutOff_C CoEng_stRevShutOff_C CoEng_stShOffAddReqIRev_C CoEng_stShOffAddReqRev_C CoEng_stShOffAftRun_C CoEng_stShOffAirbFrnt_C CoEng_stShOffAirbRear_C CoEng_stShOffAirbSide_C CoEng_stShOffDblCtl_C CoEng_stShOffDiaReqFI_C CoEng_stShOffExtReq_C CoEng_stShOffInit_C CoEng_stShOffInjMon_C CoEng_stShOffInjShCir_C CoEng_stShOffIRevSys1_C CoEng_stShOffIRevSys2_C CoEng_stShOffIRevVeh_C CoEng_stShOffIrrCmb_C CoEng_stShOffOvrSpd_C CoEng_stShOffPresMin_C CoEng_stShOffRevSys1_C CoEng_stShOffRevSys2_C CoEng_stShOffRevVeh_C CoEng_stShOffRlOvrBar_C CoEng_stShOffSV_C CoEng_stShOffTstSel_C CoEng_stSoftShOffAR_C CoEng_tiActrPrt_C CoEng_tiDlyT15_C CoEng_tiMinAftRun_C CoEng_tiOvrRunCoordDebPos_C CoEng_tiPwrStgDiaRdy_C CoEng_tiSoftShOff_CUR CoEng_trqOvrRunThres_C CoEng_trqSlpLim_Channel CoEng_trqSlpLim_Vector ConvCD_numDioIn_C CoVeh_trqPrpDes_Channel CoVeh_trqPrpDes_Vector CoVeh_trqPrpLead_Channel CoVeh_trqPrpLead_Vector CoVM_amMAX_C CoVM_swtPlausChkType_C CoVM_swtPlausChkVal_C CoVM_trqDecMax_C CoVM_trqIncMin_C CrCtl_stShutOffCodeMsk_C CrCtl_trqDes_Channel CrCtl_trqDes_Vector CrCtl_trqLead_Channel CrCtl_trqLead_Vector CrCtl_vTipStep_C CrSCD_ctGapIncs_C CrSCD_ctGaps_C CrSCD_ctIncs_C CrSCD_ctThresCtlMin_C CrSCD_ctTurns_C CrSCD_facGapPlausHigh_CUR CrSCD_facGapPlausLow_CUR CrSCD_facIncPlausHigh_CUR CrSCD_facIncPlausLow_CUR CrSCD_nFast_C CrSCD_nMax_C CrSCD_nMin_C CrSCD_nSlow_C CrSCD_nSlowHigh_C CrSCD_nThresCtlHigh_C CrSCD_nThresCtlLow_C CrSCD_numFBCSeg_C CrSCD_numGlFilter_C CrSCD_numShftMisf_C CrSCD_numTDCSeg_C CrSCD_numThresCtlHigh_C CrSCD_numThresCtlLow_C CrSCD_phiGap2Zero_C CrSCD_phiIncCor_CUR CrSCD_phiSegLength_C CrSCD_phiSegPhase_C CrSCD_tiPlausCalcOff_C CrS_ctMaxInjStrt_C CrS_facSegTime_CUR CrS_facSegTimeMax_C CrS_facSegTimeMin_C CrS_phiSegLengthStrtSpd_C CrS_phiSegOfsStrtSpd_C CrS_phiSegOfsStrtSpdOld_C CTSCD_DebSigDef_C CTSCD_DebSRCHighDef_C CTSCD_DebSRCLowDef_C CTSCD_numAdc_C CTSCD_stSensIDWord_C DSM_DInDfp_ADCMon_C DSM_DInDfp_EngMCaS1_C DSM_DInDfp_EngMCrS1_C DSM_DInDfp_FrmMngParkConsumer_C DSM_DInDfp_InjVlvBnk1A_C DSM_DInDfp_InjVlvBnk1B_C DSM_DInDfp_InjVlvBnk2A_C DSM_DInDfp_InjVlvBnk2B_C DSM_DInDfp_InjVlvChipA_C DSM_DInDfp_InjVlvChipB_C DSM_DInDfp_InjVlvCyl1A_C DSM_DInDfp_InjVlvCyl1B_C DSM_DInDfp_InjVlvCyl2A_C DSM_DInDfp_InjVlvCyl2B_C DSM_DInDfp_InjVlvCyl3A_C DSM_DInDfp_InjVlvCyl3B_C DSM_DInDfp_InjVlvCyl4A_C DSM_DInDfp_InjVlvCyl4B_C DSM_DInDfp_InjVlvCyl5A_C DSM_DInDfp_InjVlvCyl5B_C DSM_DInDfp_InjVlvCyl6A_C DSM_DInDfp_InjVlvCyl6B_C DSM_DInDfp_InjVlvCyl7A_C DSM_DInDfp_InjVlvCyl7B_C DSM_DInDfp_InjVlvCyl8A_C DSM_DInDfp_InjVlvCyl8B_C DSM_DInDfp_MeUnCD_ADC_C DSM_DInDfp_MeUnCDNoLoad_C DSM_DInDfp_MeUnCDSCBat_C DSM_DInDfp_MeUnCDSCGnd_C DSM_DInDfp_MeUnCD_SigTst_C DSM_DInDfp_MSidCD_Comm_C DSM_DInDfp_MSidCD_EcuMixed_C DSM_DInDfp_MSidCD_Pin_C DSM_DInDfp_MSidCD_Select_C DSM_DInDfp_MSidCD_Sel_INI_C DSM_DInDfp_MSMon_AirSys0_C DSM_DInDfp_MSMon_AirSys1_C DSM_DInDfp_MSMon_AirSys2_C DSM_DInDfp_MSMon_AirSys3_C DSM_DInDfp_MSMon_AirSys4_C DSM_DInDfp_MSMon_AirSys7_C DSM_DInDfp_MSMon_ARS_TO_C DSM_DInDfp_MSMon_CanDef_C DSM_DInDfp_MSMon_CoEng_IRevMS_C DSM_DInDfp_MSMon_CoEng_OffVeh_C DSM_DInDfp_MSMon_CoEng_RevMS_C DSM_DInDfp_MSMon_CoEng_Rev1_C DSM_DInDfp_MSMon_CoEng_Rev2_C DSM_DInDfp_MSMon_DSC_TO_C DSM_DInDfp_MSMon_EGS_TO_C DSM_DInDfp_MSMon_FrmMngCoEng_C DSM_DInDfp_MSMon_FrmMngPT_C DSM_DInDfp_MSMon_FrmMngPT2_C DSM_DInDfp_MSMon_Mil_C DSM_DInDfp_MSMon_qLimErr_C DSM_DInDfp_MSMon_stFrmMngCoEng_C DSM_DInDfp_MSMon_SysLamp_C DSM_DInDfp_MSMon_trqCoDT_C DSM_DInDfp_MSMon_trqCoVeh_C DSM_DInDfp_MSMon_trqDesExt_C DSM_DInDfp_MSMon_trqLimErr_C DSM_DInDfp_MSMon_trqLimErr1_C DSM_DInDfp_MSMon_trqLimErr2_C DSM_DInDfp_PCVCD_ADC_C DSM_DInDfp_PCVCDNoLoad_C DSM_DInDfp_PCVCDSCBat_C DSM_DInDfp_PCVCDSCGnd_C DSM_DInDfp_PCVCD_SigTst_C DSM_DInDfp_RailCD_C DSM_DInDfp_RailCD_PMonStrt_C DSM_DInDfp_RailCtlModeMeUnDiag_C DSM_DInDfp_RailCtlModePCVDiag_C DSM_DInDfp_RailMeUn0_C DSM_DInDfp_RailMeUn1_C DSM_DInDfp_RailMeUn2_C DSM_DInDfp_RailMeUn3_C DSM_DInDfp_RailMeUn4_C DSM_DInDfp_RailPCV0_C DSM_DInDfp_RailPCV1_C DSM_DInDfp_RailPCV2_C DSM_DInDfp_RailPCV3_C DSM_DInDfp_RailPCV4_C DSM_DInDfp_RailPCV5_C DSM_DInDfp_TPUMon_C DSM_InhDfp_ACC_PlausTrqDes_C DSM_InhDfp_ADCMon_C DSM_InhDfp_AFSCD_AirTempDcyc_C DSM_InhDfp_AFSCD_AirTempDcyc2_C DSM_InhDfp_AFSCDIdlAdjVal_C DSM_InhDfp_AFSCDLdAdjVal_C DSM_InhDfp_AFSCDPlAirPerCylDif_C DSM_InhDfp_AFSCD_PlOffsDrft_C DSM_InhDfp_AFSCD_PlOffsDrft2_C DSM_InhDfp_AFSCD_PlSetyDrft_C DSM_InhDfp_AFSCD_PlSetyDrft2_C DSM_InhDfp_AFSCD_SRCCorrAirm_C DSM_InhDfp_AFSCD_SRCCorrAirm2_C DSM_InhDfp_AFSCD_SRCRawAirm_C DSM_InhDfp_AFSCD_SRCRawAirm2_C DSM_InhDfp_AFSCD_SRCRefSigPer_C DSM_InhDfp_AFSCD_SRCRefSigPer2_C DSM_InhDfp_APPSync_C DSM_InhDfp_APP1_C DSM_InhDfp_APP2_C DSM_InhDfp_APSCD_C DSM_InhDfp_ARS_C DSM_InhDfp_BattCD_C DSM_InhDfp_BPACD_Min_C DSM_InhDfp_BPACD_Min2_C DSM_InhDfp_BPSCD_C DSM_InhDfp_BrkCD_C DSM_InhDfp_CBACD_C DSM_InhDfp_ConvCD_C DSM_InhDfp_CrCCDMFL_C DSM_InhDfp_CTSCD_C DSM_InhDfp_EBTSCD_C DSM_InhDfp_EGRCD_Max_C DSM_InhDfp_EGRCD_Max2_C DSM_InhDfp_EGRCD_Min_C DSM_InhDfp_EGRCD_Min2_C DSM_InhDfp_EGRCD_SigNpl_C DSM_InhDfp_EGRCD_SigNpl2_C DSM_InhDfp_EngMCaS1_C DSM_InhDfp_EngMCrS1_C DSM_InhDfp_FrmMngASC1_C DSM_InhDfp_FrmMngASC2_C DSM_InhDfp_FrmMngASC3_C DSM_InhDfp_FrmMngEGS1_C DSM_InhDfp_FrmMngGEARBX_DATA_C DSM_InhDfp_FrmMngGEARBX_DATA2_C DSM_InhDfp_FrmMngOPCRCTLACC_C DSM_InhDfp_FrmMngSSGErr_C DSM_InhDfp_FrmMngSTAT_ARS_C DSM_InhDfp_FrmMngSTAT_DSC_C DSM_InhDfp_FrmMngSTAT_KOMBI_C DSM_InhDfp_FrmMngTERMINAL_C DSM_InhDfp_FrmMngTORQUE_DSC_C DSM_InhDfp_FrmMngTORQUE_GEARBX_C DSM_InhDfp_FrmMngTrq_ReqACC_C DSM_InhDfp_FrmMngWHEEL_SPEED_C DSM_InhDfp_HWEMonCom_C DSM_InhDfp_HWEMonEEPROM_C DSM_InhDfp_HWEMonRcyLocked_C DSM_InhDfp_HWEMonRcySuppressed_C DSM_InhDfp_HWEMonRcyVisible_C DSM_InhDfp_HWEMonUMaxSupply_C DSM_InhDfp_HWEMonUMinSupply_C DSM_InhDfp_IATSCD_CATS_C DSM_InhDfp_IATSCD_CATSSec_C DSM_InhDfp_ImmCtlImmCD_C DSM_InhDfp_ImmCtlImmEep_C DSM_InhDfp_ImmCtlMpl_C DSM_InhDfp_InjCrv_InjLim_C DSM_InhDfp_InjVCDActrChrg_C DSM_InhDfp_InjVCDActrVolt_C DSM_InhDfp_InjVCD_CY370Ampl_C DSM_InhDfp_InjVCDMonCab_C DSM_InhDfp_InjVCDMonSwt_C DSM_InhDfp_InjVCDShOffDCDC_C DSM_InhDfp_InjVlvBnk1A_C DSM_InhDfp_InjVlvBnk1B_C DSM_InhDfp_InjVlvBnk2A_C DSM_InhDfp_InjVlvBnk2B_C DSM_InhDfp_InjVlvChipA_C DSM_InhDfp_InjVlvChipB_C DSM_InhDfp_InjVlvCyl1A_C DSM_InhDfp_InjVlvCyl1B_C DSM_InhDfp_InjVlvCyl1C_C DSM_InhDfp_InjVlvCyl2A_C DSM_InhDfp_InjVlvCyl2B_C DSM_InhDfp_InjVlvCyl2C_C DSM_InhDfp_InjVlvCyl3A_C DSM_InhDfp_InjVlvCyl3B_C DSM_InhDfp_InjVlvCyl3C_C DSM_InhDfp_InjVlvCyl4A_C DSM_InhDfp_InjVlvCyl4B_C DSM_InhDfp_InjVlvCyl4C_C DSM_InhDfp_InjVlvCyl5A_C DSM_InhDfp_InjVlvCyl5B_C DSM_InhDfp_InjVlvCyl5C_C DSM_InhDfp_InjVlvCyl6A_C DSM_InhDfp_InjVlvCyl6B_C DSM_InhDfp_InjVlvCyl6C_C DSM_InhDfp_InjVlvCyl7A_C DSM_InhDfp_InjVlvCyl7B_C DSM_InhDfp_InjVlvCyl7C_C DSM_InhDfp_InjVlvCyl8A_C DSM_InhDfp_InjVlvCyl8B_C DSM_InhDfp_InjVlvCyl8C_C DSM_InhDfp_LPACD_Max_C DSM_InhDfp_LPACD_Min_C DSM_InhDfp_LPACD_SigNpl_C DSM_InhDfp_MeUnCD_ADC_C DSM_InhDfp_MeUnCDNoLoad_C DSM_InhDfp_MeUnCDSCBat_C DSM_InhDfp_MeUnCDSCGnd_C DSM_InhDfp_MeUnCD_SigTst_C DSM_InhDfp_Montr_C DSM_InhDfp_MSidCD_EcuMixed_C DSM_InhDfp_MSidCD_Select_C DSM_InhDfp_MSidCD_Sel_INI_C DSM_InhDfp_MSid_SwCmp_C DSM_InhDfp_MSMon_AirCtl_C DSM_InhDfp_MSMon_AirSys0_C DSM_InhDfp_MSMon_AirSys1_C DSM_InhDfp_MSMon_AirSys2_C DSM_InhDfp_MSMon_AirSys3_C DSM_InhDfp_MSMon_AirSys4_C DSM_InhDfp_MSMon_AirSys7_C DSM_InhDfp_MSMon_ARS_TO_C DSM_InhDfp_MSMon_C DSM_InhDfp_MSMon_CanDef_C DSM_InhDfp_MSMon_CoEng_IRevMS_C DSM_InhDfp_MSMon_CoEng_RevMS_C DSM_InhDfp_MSMon_CoEng_Rev1_C DSM_InhDfp_MSMon_CoEng_Rev2_C DSM_InhDfp_MSMonConsist_C DSM_InhDfp_MSMon_DSC_TO_C DSM_InhDfp_MSMon_EGS_TO_C DSM_InhDfp_MSMon_FrmMngCoEng_C DSM_InhDfp_MSMon_FrmMngPT_C DSM_InhDfp_MSMon_qLimErr_C DSM_InhDfp_MSMon_trqCoVehLim_C DSM_InhDfp_MSMon_trqDesExt_C DSM_InhDfp_MSMon_trqDesExtRev_C DSM_InhDfp_MSMon_trqLimErr_C DSM_InhDfp_MSMon_trqLimErr1_C DSM_InhDfp_MSMon_trqLimErr2_C DSM_InhDfp_MSMon_trqLimErr3_C DSM_InhDfp_MSMon_trqLimErr4_C DSM_InhDfp_NetMngPtCan_C DSM_InhDfp_NetMngPtCanSlave_C DSM_InhDfp_OvRMon_C DSM_InhDfp_OvRMonSigA_C DSM_InhDfp_PCR_BalGvnr_C DSM_InhDfp_PCR_GovDevNeg_C DSM_InhDfp_PCR_GovDevPos_C DSM_InhDfp_PCR_LPGvnrDvtNeg_C DSM_InhDfp_PCR_LPGvnrDvtPos_C DSM_InhDfp_PCVCD_ADC_C DSM_InhDfp_PCVCDNoLoad_C DSM_InhDfp_PCVCDSCBat_C DSM_InhDfp_PCVCDSCGnd_C DSM_InhDfp_PCVCD_SigTst_C DSM_InhDfp_RailCD_C DSM_InhDfp_RailCDOfsTst_C DSM_InhDfp_RailCD_PMonStrt_C DSM_InhDfp_RailCPC1_C DSM_InhDfp_RailCPC3_C DSM_InhDfp_RailCPC4_C DSM_InhDfp_RailCtlModeMeUnDiag_C DSM_InhDfp_RailCtlModePCVDiag_C DSM_InhDfp_RailMeUn0_C DSM_InhDfp_RailMeUn1_C DSM_InhDfp_RailMeUn2_C DSM_InhDfp_RailMeUn3_C DSM_InhDfp_RailMeUn4_C DSM_InhDfp_RailPCV0_C DSM_InhDfp_RailPCV1_C DSM_InhDfp_RailPCV2_C DSM_InhDfp_RailPCV3_C DSM_InhDfp_RailPCV4_C DSM_InhDfp_SOPTst_C DSM_InhDfp_SSpMon1_C DSM_InhDfp_SSpMon2_C DSM_InhDfp_TPUMon_C DSM_InhDfp_VSSCD1_C DSM_InhDfp_VSSCD2_C DSM_InhDfp_WdCom_C DSM_SdwDfp_APP2_C DSM_SdwDfp_FrmMngASC1_C DSM_SdwDfp_FrmMngDRMANFSSG_C DSM_SdwDfp_FrmMngOPCRCTLACC_C DSM_SdwDfp_FrmMngTORQUE_DSC_C DSM_SdwDfp_FrmMngTORQUE_GEARBX_C DSM_SdwDfp_FrmMngTrq_ReqACC_C EATSCD_numAdc_C EBFCD_numDiaOut_C EBFCD_numDioOut_C EBTSCD_DebSRCHighDef_C EBTSCD_DebSRCHighOk_C EBTSCD_DebSRCLowDef_C EBTSCD_DebSRCLowOk_C EBTSCD_dtRmpSlpDwn_C EBTSCD_dtRmpSlpUp_C EBTSCD_numAdc_C EBTSCD_OvrDebSRCHighDef_C EBTSCD_OvrDebSRCHighOk_C EBTSCD_stSensIDWord_C EBTSCD_tDfl_C EBTSCD_tiTECUPT1_C EBTSCD_tLin_CUR EBTSCD_tOvrTemp_C EBTSCD_uSRCMax_C EBTSCD_uSRCMin_C ECU_vPrgThres_C EGPpCD_numDia_C EGPpCD_numDioOut_C EGRCD_DebExcTempDef_C EGRCD_DebExcTemp2Def_C EGRCD_DebNoLoadDef_C EGRCD_DebNoLoad2Def_C EGRCD_DebShortCircBatDef_C EGRCD_DebShortCircBat2Def_C EGRCD_DebShortCircGndDef_C EGRCD_DebShortCircGnd2Def_C EGRCD_numDia_C EGRCD_numDia2_C EGRCD_numPwmOut_C EGRCD_numPwmOut2_C EGRCD_stPwrStgDia_C EGRCD_stPwrStgDia2_C EGRVlv_rEGR_Channel EGRVlv_rEGR_Vector EGRVlv_rEGR2_Channel EGRVlv_rEGR2_Vector EGT_stTSync_Channel EGT_stTSync_Vector EngM_ctOfsCaSCrS_C EngM_ctPhWhlRev_C EngM_ctPostSync_C EngM_ctReSync_C EngM_ctSpdtoZero_C EngM_ctVerSync_C EngM_DebIncCaSErrSigDef_C EngM_DebIncCaSErrSigOK_C EngM_DebIncCaSNoSigDef_C EngM_DebIncCrSErrSigDef_C EngM_DebIncCrSErrSigOK_C EngM_DebIncOfsSigCaSCrSDef_C EngM_DebPhCrSErrSigDef_C EngM_dLimitCond_ASD_CA EngM_dLimitCond_Common_CA EngM_dLimitCond_FBC_CA EngM_dLimitCond_Joint_CA EngM_dLimitCond_LiGov_CA EngM_dLimitCond_Pilot_CA EngM_nLimitInj_C EngM_nLimitThresh_CA EngM_nLimitThreshHyst_CA EngM_nLimitTimeout_C EngM_nMaxFrstInj_C EngM_nMaxStrtBackUp_C EngM_nMaxStrt_C EngM_nMinDiag_C EngM_nPolling_C EngM_nSwtCoMa_C EngM_numDiaOut_C EngM_numDioOut_C EngM_numLimitInj_C EngM_numLimitTimeout_C EngM_numPin_C EngM_nWaitIncSig_C EngM_phiDelayPhNoSig_C EngM_phiDelta_C EngM_phiDeltaExtSync_C EngM_phiFrstInjInt_C EngM_phiInt_C EngM_phiIntMin_C EngM_phiMax_C EngM_phiTDC_C EngM_stBackUpVar_C EngM_stEnaBackUp_C EngM_stSyncBefGap_C EngM_swtExitOfs_C EngM_swtNumCylVal_C EngM_swtSyncViaCAN_C EngM_swtT50CDDiag_C EngM_swtUpdTDC_C EngM_tiCpuTimeOut_C EngM_tiDiffInt_C EngM_tiWaitIncSig_C EngM_trqFrc_Channel EngM_trqFrc_Vector EngPrt_nOvrSpd_C EngPrt_qPrtLim_Channel EngPrt_qPrtLim_Vector EngPrt_trqNLim_Channel EngPrt_trqNLim_Vector EngPrt_trqPrtLim_Channel EngPrt_trqPrtLim_Vector ErLpCD_numDiaErrLmp_C ErLpCD_numDiaSysLmp_C ErLpCD_numDioOutErrLmp_C ErLpCD_numDioOutSysLmp_C ESS_nBattMin_C ETClb_DebETMaxDefect_C ETClb_DebETMaxOk_C ETClb_DebETMinDefect_C ETClb_DebETMinOk_C ETClb_numCyclMeas_C ETClb_numCyclStartEnergize_C ETClb_pRailSet_CA ETClb_SigThres_CA ETClb_tiET_MAX_CA ETClb_tiET_MIN_CA ETClb_volEffectiveMin_CA ExeMon_stEnaTst_C FanCD_DebShortCircGndDef_C FanCD_numDia_C FanCD_numPwmOut_C FanCD_tiBtwTst_C FanCD_tiFanCtlr2Max_C FanCD_tiFanCtlr2Min_C FanCD_tiFanCtlr3Max_C FanCD_tiFanCtlr3Min_C FBC_AACoeff_C FBC_AAOrd_C FBC_ctSegOffset_C FBC_dBPFacDen1_CA FBC_dBPFacDen2_CA FBC_dSyn_C FBC_DXalf0_C FBC_GvrnIWinNeg_C FBC_GvrnIWinPos_C FBC_GvrnPWinNeg_C FBC_GvrnPWinPos_C FBC_lrn_Channel FBC_lrn_Vector FBC_q_Channel FBC_q_Vector FBC_TSm_C FlFCD_numDioIn_C FlSys_nDeflateMax_C FlSys_nDeflateMin_C FlSys_pDeflate_C FlSys_rhoFl_C FlSys_rhoFl_CUR FlSys_swtTempSensCfgType_C FlSys_tiDeflateDel_C FMTC_trq2qBas_MAP FMTC_trq2qRgn1_MAP FMTC_trq2qRgn2_MAP FrmMng_aSideDef_C FrmMng_cnvAccmLimTrq_Offset_C FrmMng_cnvAccmLimTrq_Slope_C FrmMng_cnvACCtrq_Offset_C FrmMng_cnvACCtrq_Slope_C FrmMng_cnvAFStrq_Offset_C FrmMng_cnvAFStrq_Slope_C FrmMng_cnvAipEng_Offset_C FrmMng_cnvAipEng_Slope_C FrmMng_cnvAngAcpd_Offset_C FrmMng_cnvAngAcpd_Slope_C FrmMng_cnvAPP_Offset_C FrmMng_cnvAPP_Slope_C FrmMng_cnvARStrq_Offset_C FrmMng_cnvARStrq_Slope_C FrmMng_cnvAVA_DSC_Offset_C FrmMng_cnvAVA_DSC_Slope_C FrmMng_cnv_BattCls_Offset_C FrmMng_cnv_BattCls_Slope_C FrmMng_cnvDCCtrq_Offset_C FrmMng_cnvDCCtrq_Slope_C FrmMng_cnvdLRADWINKStrg_Offset_C FrmMng_cnvdLRADWINKStrg_Slope_C FrmMng_cnvDSCtrq_Offset_C FrmMng_cnvDSCtrq_Slope_C FrmMng_cnvFLLV_FUTA_Offset_C FrmMng_cnvFLLV_FUTA_Slope_C FrmMng_cnv_HiLimCurr_Offset_C FrmMng_cnv_HiLimCurr_Slope_C FrmMng_cnvIjvFu_Offset_C FrmMng_cnvIjvFu_Slope_C FrmMng_cnvKOMBIv_Offset_C FrmMng_cnvKOMBIv_Slope_C FrmMng_cnvLimRpmEng_Offset_C FrmMng_cnvLimRpmEng_Slope_C FrmMng_cnvLN_DSC_Offset_C FrmMng_cnvLN_DSC_Slope_C FrmMng_cnv_LoLimCurr_Offset_C FrmMng_cnv_LoLimCurr_Slope_C FrmMng_cnvLRADWINKStrg_Offset_C FrmMng_cnvLRADWINKStrg_Slope_C FrmMng_cnvnEngRpm_Offset_C FrmMng_cnvnEngRpm_Slope_C FrmMng_cnvnPSPSpd_Offset_C FrmMng_cnvnPSPSpd_Slope_C FrmMng_cnvnSetPoint_OffSet_C FrmMng_cnvnSetPoint_Slope_C FrmMng_cnvpBrkSys_Offset_C FrmMng_cnvpBrkSys_Slope_C FrmMng_cnvrHtFlow_Offset_C FrmMng_cnvrHtFlow_Slope_C FrmMng_cnvRpmEng_Offset_C FrmMng_cnvRpmEng_Slope_C FrmMng_cnvRPM_GRB_TURB_Offset_C FrmMng_cnvRPM_GRB_TURB_Slope_C FrmMng_cnvrPSPSetPoint_Offset_C FrmMng_cnvrPSPSetPoint_Slope_C FrmMng_cnvRqamFu_Offset_C FrmMng_cnvRqamFu_Slope_C FrmMng_cnvrTransDT_Offset_C FrmMng_cnvrTransDT_Slope_C FrmMng_cnvrWaterVlv_Offset_C FrmMng_cnvrWaterVlv_Slope_C FrmMng_cnvTempEng_Offset_C FrmMng_cnvTempEng_Slope_C FrmMng_cnvTEMP_EX_Offset_C FrmMng_cnvTEMP_EX_Slope_C FrmMng_cnvtOil_Offset_C FrmMng_cnvtOil_Slope_C FrmMng_cnvTrqAvl_Offset_C FrmMng_cnvTrqAvl_Slope_C FrmMng_cnvTrqDvch_Offset_C FrmMng_cnvTrqDvch_Slope_C FrmMng_cnvtrq_Offset_C FrmMng_cnvtrq_Slope_C FrmMng_cnvtrqWheel_Offset_C FrmMng_cnvtrqWheel_Slope_C FrmMng_cnvvMrk_Offset_C FrmMng_cnvvMrk_Slope_C FrmMng_cnvvPrgNo_Offset_C FrmMng_cnvvPrgNo_Slope_C FrmMng_cnvV_VEH_Offset_C FrmMng_cnvV_VEH_Slope_C FrmMng_cnv_ZrCurrLim_Offset_C FrmMng_cnv_ZrCurrLim_Slope_C FrmMng_ctDebAlvDMANFAFSDef_C FrmMng_ctDebCsDMANFAFSDef_C FrmMng_ctDebSigDMANFAFSDef_C FrmMng_ctDebToASC1Def_C FrmMng_ctDebToDMANFAFSDef_C FrmMng_ctDebToWHEEL_SPEEDDef_C FrmMng_ctMulDDE2_C FrmMng_dCanState_C FrmMng_DebACTrqDef_C FrmMng_DebAlvDMOMENT_ACCDef_C FrmMng_DebAlvOPCRCTLACCDef_C FrmMng_DebAlvSTAT_ARSDef_C FrmMng_DebAlvSTAT_KOMBIDef_C FrmMng_DebAlvTORQUE_DSCDef_C FrmMng_DebAlvTORQUE_GEARBXDef_C FrmMng_DebCsDMOMENT_ACCDef_C FrmMng_DebCsOPCRCTLACCDef_C FrmMng_DebCsTORQUE_DSCDef_C FrmMng_DebCsTORQUE_GEARBXDef_C FrmMng_DebSigDMOMENT_ACCDef_C FrmMng_DebSigMILEAGE_RANGEDef_C FrmMng_DebSigOPCRCTLACCDef_C FrmMng_DebSigSTAT_ARSDef_C FrmMng_DebSigSTAT_DSCDef_C FrmMng_DebSigSTAT_KOMBIDef_C FrmMng_DebSigTORQUE_DSCDef_C FrmMng_DebSigTORQUE_GEARBXDef_C FrmMng_DebToDMOMENT_ACCDef_C FrmMng_DebToMILEAGE_RANGEDef_C FrmMng_DebToOPCRCTLACCDef_C FrmMng_DebToSTAT_ARSDef_C FrmMng_DebToSTAT_DSCDef_C FrmMng_DebToSTAT_KOMBIDef_C FrmMng_DebToTORQUE_DSCDef_C FrmMng_DebToTORQUE_GEARBXDef_C FrmMng_dstGear_C FrmMng_dtrqOvrRunRmpDwn_C FrmMng_fst_Offset_C FrmMng_fst_Slope_C FrmMng_kmst_Offset_C FrmMng_kmst_Slope_C FrmMng_nAvrg_Def_C FrmMng_nAvrg_Slope_C FrmMng_nDiv_Fac_C FrmMng_nLISetPoint_Offset_C FrmMng_nLISetPoint_Slope_C FrmMng_nSetSub_C FrmMng_nTSC_Offset_C FrmMng_nTSC_Slope_C FrmMng_numCCAddLevlNum_C FrmMng_numCCbtnachNum_C FrmMng_numCCGenDef2Num_C FrmMng_numCCNoCrCtlNum_C FrmMng_numCCOelLevlNum_C FrmMng_numCCOelVerbNum_C FrmMng_numCCOelVerlNum_C FrmMng_numCCOilPresNum_C FrmMng_numCCOvrTempNum_C FrmMng_numCCOvrTem2Num_C FrmMng_numCCPFltDefNum_C FrmMng_numCCpmerrNum_C FrmMng_numCCPreGlowNum_C FrmMng_numCCprioNum_C FrmMng_numCCruhverNum_C FrmMng_numCCStatMilLmpTstNum_C FrmMng_numCCStatMilNum_C FrmMng_numCCSysLampNum_C FrmMng_numErrIMMCD_C FrmMng_numErrMST8_C FrmMng_pVal_Offset_C FrmMng_pVal_Slope_C FrmMng_rFlt_Offset_C FrmMng_rFlt_Slope_C FrmMng_stClCtrDEF_C FrmMng_stConvErr_C FrmMng_stGearErr_C FrmMng_swtDMOMENT_ACC_C FrmMng_swtDRMANFSSG_C FrmMng_tEng_Offset_C FrmMng_tEng_Slope_C FrmMng_tiCCAddLevlCycle_C FrmMng_tiCCbtnachCycle_C FrmMng_tiCCbttdfkCycle_C FrmMng_tiCCbttkntCycle_C FrmMng_tiCCGenDef2Cycle_C FrmMng_tiCCNoCrCtlCycle_C FrmMng_tiCCOelLevlCycle_C FrmMng_tiCCOelVerbCycle_C FrmMng_tiCCOelVerlCycle_C FrmMng_tiCCOilPresCycle_C FrmMng_tiCCOvrTempCycle_C FrmMng_tiCCOvrTem2Cycle_C FrmMng_tiCCPFltDefCycle_C FrmMng_tiCCpmerrCycle_C FrmMng_tiCCPreGlowCycle_C FrmMng_tiCCprioCycle_C FrmMng_tiCCruhverCycle_C FrmMng_tiCCStatMilCycle_C FrmMng_tiCCStatMilLmpTstCycle_C FrmMng_tiCCSysLampCycle_C FrmMng_tiCCTxDeb_C FrmMng_trqACErr_C FrmMng_trqDesSub_C FrmMng_trqGearbxMaxSubs_C FrmMng_trqLeadSub_C FrmMng_trqNorm_C FrmMng_trq_Offset_C FrmMng_trq_Slope_C FTSCD_numAdc_C Gearbx_amMax_C Gearbx_nMinFDC_MAP Gearbx_nMin_MAP Gearbx_nRmpTSC1Delta_C Gearbx_nRmpTSC2Delta_C Gearbx_nTSCDeltaInit_C Gearbx_nTSCLimMax_C Gearbx_nTSCLimRampOff_C Gearbx_nTSCSlip_C Gearbx_rTransR_C Gearbx_rTrans1_C Gearbx_rTrans2_C Gearbx_rTrans3_C Gearbx_rTrans4_C Gearbx_rTrans5_C Gearbx_rTrans6_C Gearbx_swtNTSC_C Gearbx_swtUnplausChk_C Gearbx_trqDecMax_C Gearbx_trqIncMin_C Gearbx_trqInMax_Channel Gearbx_trqInMax_Vector GearCD_numDioIn_C HPUn_nMin_C HPUn_pRailDvtOk_C HPUn_qBalLim_CUR HPUn_qFlTempLim_MAP HWEMon_DebComDef_C HWEMon_DebComOk_C HWEMon_DebComStepDown_C HWEMon_DebComStepUp_C HWEMon_nThres_C HWEMon_numTrigRecovery_C IATSCD_DebSigDef_C IATSCD_DebSRCHighDef_C IATSCD_DebSRCLowDef_C IATSCD_numAdc_C IATSCD_numAdcCats_C IndSys_rVSAAdd_Channel IndSys_rVSAAdd_Vector IndSys_rVSA_Channel IndSys_rVSA_Vector InjCrv_DebLimDef_C InjCrv_DebLimOk_C InjCrv_numInjMaxSys_C InjCrv_phiMI1DesAdd_Channel InjCrv_phiMI1DesAdd_Vector InjCrv_phiMI1Des_Channel InjCrv_phiMI1Des_Vector InjCrv_phiMI1Max_MAP InjCrv_phiMI1Max2_MAP InjCrv_phiMI1Rgn_Channel InjCrv_phiMI1Rgn_Vector InjCrv_phiPiIMax_C InjCrv_phiPiI1DesAdd_Channel InjCrv_phiPiI1DesAdd_Vector InjCrv_phiPiI1Des_Channel InjCrv_phiPiI1Des_Vector InjCrv_phiPiI1Rgn_Channel InjCrv_phiPiI1Rgn_Vector InjCrv_phiPiI2DesAdd_Channel InjCrv_phiPiI2DesAdd_Vector InjCrv_phiPiI2Des_Channel InjCrv_phiPiI2Des_Vector InjCrv_phiPiI2Rgn_Channel InjCrv_phiPiI2Rgn_Vector InjCrv_phiPiI3DesAdd_Channel InjCrv_phiPiI3DesAdd_Vector InjCrv_phiPiI3Des_Channel InjCrv_phiPiI3Des_Vector InjCrv_phiPoI1DesAdd_Channel InjCrv_phiPoI1DesAdd_Vector InjCrv_phiPoI1Des_Channel InjCrv_phiPoI1Des_Vector InjCrv_phiPoI1Max_C InjCrv_phiPoI1Rgn_Channel InjCrv_phiPoI1Rgn_Vector InjCrv_phiPoI2_Channel InjCrv_phiPoI2Min_C InjCrv_phiPoI2Rgn_Channel InjCrv_phiPoI2Rgn_Vector InjCrv_phiPoI2Rgn2_MAP InjCrv_phiPoI2_Vector InjCrv_qMI1DesAdd_Channel InjCrv_qMI1DesAdd_Vector InjCrv_qMI1Des_Channel InjCrv_qMI1Des_Vector InjCrv_qMI1Rgn_Channel InjCrv_qMI1Rgn_Vector InjCrv_qPiI1DesAdd_Channel InjCrv_qPiI1DesAdd_Vector InjCrv_qPiI1Des_Channel InjCrv_qPiI1Des_Vector InjCrv_qPiI1Rgn_Channel InjCrv_qPiI1Rgn_Vector InjCrv_qPiI1SetByp_Channel InjCrv_qPiI1SetByp_Vector InjCrv_qPiI2DesAdd_Channel InjCrv_qPiI2DesAdd_Vector InjCrv_qPiI2Des_Channel InjCrv_qPiI2Des_Vector InjCrv_qPiI2Rgn_Channel InjCrv_qPiI2Rgn_Vector InjCrv_qPiI2SetByp_Channel InjCrv_qPiI2SetByp_Vector InjCrv_qPiI3DesAdd_Channel InjCrv_qPiI3DesAdd_Vector InjCrv_qPiI3Des_Channel InjCrv_qPiI3Des_Vector InjCrv_qPoI1DesAdd_Channel InjCrv_qPoI1DesAdd_Vector InjCrv_qPoI1Des_Channel InjCrv_qPoI1Des_Vector InjCrv_qPoI1Rgn_Channel InjCrv_qPoI1Rgn_Vector InjCrv_qPoI2Des_Channel InjCrv_qPoI2Des_Vector InjCrv_qPoI2Eff_Channel InjCrv_qPoI2Eff_Vector InjCrv_qPoI2Rgn_Channel InjCrv_qPoI2Rgn_Vector InjCrv_stInjCharSetVal_Channel InjCrv_stInjCharSetVal_Vector InjCrv_stPiIRlsBypass_Channel InjCrv_stPiIRlsBypass_Vector InjCrv_tiPiIMax_C InjCrv_tiPiI1DesAdd_Channel InjCrv_tiPiI1DesAdd_Vector InjCrv_tiPiI1Des_Channel InjCrv_tiPiI1Des_Vector InjCrv_tiPiI1Rgn_Channel InjCrv_tiPiI1Rgn_Vector InjCrv_tiPiI2DesAdd_Channel InjCrv_tiPiI2DesAdd_Vector InjCrv_tiPiI2Des_Channel InjCrv_tiPiI2Des_Vector InjCrv_tiPiI2Rgn_Channel InjCrv_tiPiI2Rgn_Vector InjCrv_tiPoI2_Channel InjCrv_tiPoI2Max_MAP InjCrv_tiPoI2Min_C InjCrv_tiPoI2Rgn_Channel InjCrv_tiPoI2Rgn_Vector InjCrv_tiPoI2_Vector InjCtl_qCurr_Channel InjCtl_qCurr_Vector InjCtl_qLimErr_CUR InjCtl_qLimErr_MAP InjCtl_qRaw_Channel InjCtl_qRaw_Vector InjCtl_qSet_Channel InjCtl_qSet_Vector InjUn_nInjLock_C InjUn_phiTstShOffPathSet_C InjUn_tiTstShOffPathET_C InjVCD_ctThresShOffDCDCEv_C InjVCD_DebActrEnrgDef_C InjVCD_DebActrEnrgOK_C InjVCD_DebDCDCLowDef_C InjVCD_DebUBufSRCHighDef_C InjVCD_DebUBufSRCHighOk_C InjVCD_DebUBufSRCLowDef_C InjVCD_DebUBufSRCLowOk_C InjVCD_dtiEMComp_C InjVCD_duInt_C InjVCD_facMonUThresHiPl_CA InjVCD_facMonUThresLoPl_CA InjVCD_facWActrChrgCorr_C InjVCD_facWActrCorr_C InjVCD_facWActrDisChCorr_C InjVCD_facWActrDvtMax_C InjVCD_facWActrDvtMin_C InjVCD_facWActrMax_C InjVCD_facWActrMin_C InjVCD_facWActrTemp_CUR InjVCD_iChrgMonShCir_C InjVCD_iDisChMonShCir_C InjVCD_iPolarUp_CUR InjVCD_mskTpuErr_C InjVCD_nClsEng_C InjVCD_nEngMonShCir_C InjVCD_nETMaxLim_C InjVCD_nMonShCirDel_C InjVCD_numBgnShrtDeb_C InjVCD_numCollTyp_C InjVCD_numCylTestBench_C InjVCD_numFacWValidMin_C InjVCD_numMonShCirDel_C InjVCD_numPolar_C InjVCD_numUBufCyclMin_C InjVCD_numUBufCyclMin2_C InjVCD_numUBufTrigCall_C InjVCD_numUBufWaitStrt_C InjVCD_pClsRailMax_C InjVCD_pPolarMax_C InjVCD_pRailMonShCirMax_C InjVCD_qZFCETCor_AXIS InjVCD_rCapUpTolc_C InjVCD_rClsVoltMin_C InjVCD_resCalcChrgShunt_C InjVCD_rMonShCirTiChrgUpTolc_C InjVCD_rTiChrgUpTolc_C InjVCD_rZFCETDif0_GMAP InjVCD_rZFCETDif1_GMAP InjVCD_rZFCETDif2_GMAP InjVCD_rZFCETMsk_GMAP InjVCD_stCY370RcyDeb_C InjVCD_stCY370RcyTst_C InjVCD_stInjMode_C InjVCD_swtBufClean_C InjVCD_swtBuf2Tpu_C InjVCD_swtEnaAgDiff_C InjVCD_swtEnaWActrCorr_C InjVCD_swtEvMgmt_C InjVCD_swtOvrEval_C InjVCD_swtSelTempType_C InjVCD_swtSelTempVal_C InjVCD_swtShOffDCDCTst_C InjVCD_swtUBufTSyncMode_C InjVCD_tActr_CUR InjVCD_tActrDfl_C InjVCD_tActrEnrgDfl_C InjVCD_tiChrgPolarPse_C InjVCD_tiClsLead_C InjVCD_tiClsMeasBeg_C InjVCD_tiClsMeasEnd_C InjVCD_tiClsMeasure_C InjVCD_tiDisChPolarPse_C InjVCD_tiET_MAP InjVCD_tiETMax_C InjVCD_tiETMinLow_C InjVCD_tiLeadJit_C InjVCD_tiMI1ET_Channel InjVCD_tiMI1ET_Vector InjVCD_tiMi1ThresLo_C InjVCD_tiMonET_C InjVCD_tiMonLead_C InjVCD_tiMonShCirPse_C InjVCD_tiMonThresHiPlaus_C InjVCD_tiMonThresLoPlaus_C InjVCD_tiPiI1ET_Channel InjVCD_tiPiI1ET_Vector InjVCD_tiPiI2ET_Channel InjVCD_tiPiI2ET_Vector InjVCD_tiPoI1ET_Channel InjVCD_tiPoI1ET_Vector InjVCD_tiPoI2ET_Channel InjVCD_tiPoI2ET_Vector InjVCD_tiPolarET_CUR InjVCD_tiPolarLead_C InjVCD_tiZFCETCorMax_C InjVCD_tiZFCETCorMin_C InjVCD_tPolarMax_C InjVCD_uActrLin_CUR InjVCD_uActrThrSRCHi_C InjVCD_uActrThrSRCLo_C InjVCD_uBufCLoLim_C InjVCD_uBufLin_CUR InjVCD_uBufSRCMax_C InjVCD_uBufSRCMin_C InjVCD_uChrgLin_CUR InjVCD_uChrgThrSRCHi_C InjVCD_uChrgThrSRCLo_C InjVCD_uCY370Lin_CUR InjVCD_uCY370ThrSRCHi_C InjVCD_uCY370ThrSRCLo_C InjVCD_uMonShCirUp_C InjVCD_uPolarUp_CUR InjVCD_uShOffBufThres_C InjVCD_wActrChrgDfl_C InjVCD_wActrDisChDfl_C InjVCD_wActrNom_CUR InjVCD_wActrPlausMax_C InjVCD_wActrPlausMin_C InjVlv_ctMonQckThres_C InjVlv_ctMonQckThresLo_C InjVlv_DebBnkA0Def_C InjVlv_DebBnkA0Ok_C InjVlv_DebBnkA1Def_C InjVlv_DebBnkA1Ok_C InjVlv_DebBnkA2Def_C InjVlv_DebBnkA2Ok_C InjVlv_DebBnkA3Def_C InjVlv_DebBnkA3Ok_C InjVlv_DebBnkB0Def_C InjVlv_DebBnkB0Ok_C InjVlv_DebBnkB1Def_C InjVlv_DebBnkB1Ok_C InjVlv_DebBnkB2Def_C InjVlv_DebBnkB2Ok_C InjVlv_DebBnkB3Def_C InjVlv_DebBnkB3Ok_C InjVlv_DebChipA0Def_C InjVlv_DebChipA0Ok_C InjVlv_DebChipA1Def_C InjVlv_DebChipA1Ok_C InjVlv_DebChipA2Def_C InjVlv_DebChipA2Ok_C InjVlv_DebChipA3Def_C InjVlv_DebChipA3Ok_C InjVlv_DebChipB0Def_C InjVlv_DebChipB0Ok_C InjVlv_DebChipB1Def_C InjVlv_DebChipB1Ok_C InjVlv_DebChipB2Def_C InjVlv_DebChipB2Ok_C InjVlv_DebChipB3Def_C InjVlv_DebChipB3Ok_C InjVlv_DebCylA0Def_C InjVlv_DebCylA0Ok_C InjVlv_DebCylA1Def_C InjVlv_DebCylA1Ok_C InjVlv_DebCylA2Def_C InjVlv_DebCylA2Ok_C InjVlv_DebCylA3Def_C InjVlv_DebCylA3Ok_C InjVlv_DebCylB0Def_C InjVlv_DebCylB0Ok_C InjVlv_DebCylB1Def_C InjVlv_DebCylB1Ok_C InjVlv_DebCylB2Def_C InjVlv_DebCylB2Ok_C InjVlv_DebCylB3Def_C InjVlv_DebCylB3Ok_C InjVlv_DebCylC0Def_C InjVlv_DebCylC0Ok_C InjVlv_DebCylC1Def_C InjVlv_DebCylC1Ok_C InjVlv_DebCylC2Def_C InjVlv_DebCylC2Ok_C InjVlv_DebCylC3Def_C InjVlv_DebCylC3Ok_C InjVlv_facNVCDflI_C InjVlv_facNVCInPI_C InjVlv_facNVCMax_C InjVlv_facNVCMin_C InjVlv_facPCorQ_CUR InjVlv_facPCorTi_CUR InjVlv_facVoltCorUp_MAP InjVlv_iDCDC_CUR InjVlv_iMonDisChDwn_C InjVlv_nMonQckThresLo_C InjVlv_numClsVltgAdjMax_C InjVlv_numClsVltgAdjMin_C InjVlv_numInjChrgBal_MAP InjVlv_numNoLoadCylMax_C InjVlv_NVCIKi_C InjVlv_NVCIKiNeg_C InjVlv_NVCIKiPos_C InjVlv_NVCPKp_C InjVlv_NVCPKpNeg_C InjVlv_NVCPKpPos_C InjVlv_pCorBase_CUR InjVlv_pMin_C InjVlv_pMin_CUR InjVlv_pNVCMax_C InjVlv_pNVCMin_C InjVlv_pRailDfl_C InjVlv_qWvCorMax_C InjVlv_qWvCorMin_C InjVlv_rChrgBalPwrHys_C InjVlv_rChrgBalVltgHys_C InjVlv_stBufCInjLimYHigh_C InjVlv_stBufCInjLimYHigh2_C InjVlv_stBufCInjLimYLow_C InjVlv_stBufCInjLimYLow2_C InjVlv_stErrMskPattern_C InjVlv_stErrMskSelect_C InjVlv_stMonQckEna_C InjVlv_stPWvCorMsk_C InjVlv_stQntAdj_MAP InjVlv_stWvCorActv_C InjVlv_swtNVCStInjChar_C InjVlv_tActrDfl_C InjVlv_tiNVCDwnThres_C InjVlv_tiNVCUpThres_C InjVlv_tiUSetStrtLck_C InjVlv_tNVCEngMax_C InjVlv_tNVCEngMin_C InjVlv_uBufCInjLimXHigh_C InjVlv_uBufCInjLimXHigh2_C InjVlv_uBufCInjLimXLow_C InjVlv_uBufCInjLimXLow2_C InjVlv_uDiffNVCSet_CUR InjVlv_uMonBattThres_C InjVlv_uNVCIWinNeg_C InjVlv_uNVCIWinPos_C InjVlv_uNVCPWinNeg_C InjVlv_uNVCPWinPos_C InjVlv_uNVCThres_C InjVlv_uOfs_C InjVlv_uSetBott_C InjVlv_uSetUpNVCActrMax_C InjVlv_uSetUpNVCActrMin_C InjVlv_uSetUpPress0_CUR InjVlv_uSetUpPress1_CUR InjVlv_uSetUpPress10_CUR InjVlv_uSetUpPress11_CUR InjVlv_uSetUpPress12_CUR InjVlv_uSetUpPress13_CUR InjVlv_uSetUpPress14_CUR InjVlv_uSetUpPress15_CUR InjVlv_uSetUpPress2_CUR InjVlv_uSetUpPress3_CUR InjVlv_uSetUpPress4_CUR InjVlv_uSetUpPress5_CUR InjVlv_uSetUpPress6_CUR InjVlv_uSetUpPress7_CUR InjVlv_uSetUpPress8_CUR InjVlv_uSetUpPress9_CUR InjVlv_uSetUpStrt_C InjVlv_volQntAdjLim_C InjVlv_wInj_CUR IVCtl_ChrgUpIKi_C IVCtl_ChrgUpIKiNeg_C IVCtl_ChrgUpIKiPos_C IVCtl_ChrgUpPKp_C IVCtl_ChrgUpPKpNeg_C IVCtl_ChrgUpPKpPos_C IVCtl_DisChDwnIKi_C IVCtl_DisChDwnIKiNeg_C IVCtl_DisChDwnIKiPos_C IVCtl_DisChDwnPKp_C IVCtl_DisChDwnPKpNeg_C IVCtl_DisChDwnPKpPos_C IVCtl_iChrgUpCls_C IVCtl_iChrgUpGovMax_C IVCtl_iChrgUpGovMin_C IVCtl_iChrgUpInitI_C IVCtl_iChrgUp_MAP IVCtl_iChrgUpMax_C IVCtl_iChrgUpMin_C IVCtl_iDisChDwnCls_C IVCtl_iDisChDwn_CUR IVCtl_iDisChDwnGovMax_C IVCtl_iDisChDwnGovMin_C IVCtl_iDisChDwnInitI_C IVCtl_iDisChDwnMax_C IVCtl_iDisChDwnMin_C IVCtl_IKi_C IVCtl_IKiNeg_C IVCtl_IKiPos_C IVCtl_PKp_C IVCtl_PKpNeg_C IVCtl_PKpPos_C IVCtl_tiChrgSetUp_MAP IVCtl_tiChrgUpIWinNeg_C IVCtl_tiChrgUpIWinPos_C IVCtl_tiChrgUpPse_CUR IVCtl_tiChrgUpPWinNeg_C IVCtl_tiChrgUpPWinPos_C IVCtl_tiDisChDwnIWinNeg_C IVCtl_tiDisChDwnIWinPos_C IVCtl_tiDisChDwnPse_C IVCtl_tiDisChDwnPWinNeg_C IVCtl_tiDisChDwnPWinPos_C IVCtl_tiDisChSetDwn_CUR IVCtl_uClsActrUp_C IVCtl_uIWinNeg_C IVCtl_uIWinPos_C IVCtl_uMaxSetUp_C IVCtl_uMinSetUp_C IVCtl_uPIMax_C IVCtl_uPIMin_C IVCtl_uPWinNeg_C IVCtl_uPWinPos_C IVCtl_uSetUpPreCtl_CUR IVCtl_uUpInitI_C LIGov_nDeltaSec_C LIGov_nDiffDelta_C LIGov_nLimHigh_C LIGov_nMSDiffMax_C LIGov_nRmpBaseDwn_C LIGov_nRmpCoEngDwn_C LIGov_nRmpGearbxDwn_C LIGov_nRmpHDCDwn_C LIGov_nRmpHDCUp_C LIGov_nRmpPwrMngDwn_C LIGov_nRmpSecDelta_C LIGov_nRmpSurgeDwn_C LIGov_nSetpoint_Channel LIGov_nSetpointTrm_C LIGov_nSetpointTrmLim_C LIGov_nSetpoint_Vector LIGov_trq_Channel LIGov_trqSetMax_C LIGov_trq_Vector LSUCD_facPresCompLean_CUR LSUCD_facPresCompRich_CUR LSUCD_facUToRi_C LSUCD_rO2_CUR LSUCD_stHtDis_C LSUCD_stPumpCtlDis_C LSUCD_stPwrStgDia_C LSUCD_stRefPumpDis_C LSUCD_tiHtPer_C LSUCD_tRi_CUR LSUCD_uBattMaxHigh_C LSUCD_uBattMaxLow_C LSUCD_uBattNominal_C LSUCD_uO2Ref_C LSUCD_uRiOfs_C LSUCtl_dcycHtMin_C LSUCtl_dcycRmpUp_C LSUCtl_dcycStrt_CUR LSUCtl_tRiSetPoint_C LSU_rLmbdRec_CUR MemMon_numErrChkRam_C MemMon_numErrChkRom_C MemMon_tiHealChkRam_C MemMon_tiHealChkRom_C MeUnCD_dcycMax_C MeUnCD_dcycMin_C MeUnCD_dcycSetValLin_CUR MeUnCD_dcycTst_C MeUnCD_DebExcTempDef_C MeUnCD_DebExcTempOk_C MeUnCD_DebNoLoadDef_C MeUnCD_DebNoLoadOk_C MeUnCD_DebShortCircBatDef_C MeUnCD_DebShortCircBatOk_C MeUnCD_DebShortCircGndDef_C MeUnCD_DebShortCircGndOk_C MeUnCD_DebSRCHighDef_C MeUnCD_DebSRCHighOk_C MeUnCD_DebSRCLowDef_C MeUnCD_DebSRCLowOk_C MeUnCD_facIGovInit_CUR MeUnCD_facIGovMax_C MeUnCD_facIGovMin_C MeUnCD_IGovDKd_C MeUnCD_IGovIKi_C MeUnCD_IGovIKiNeg_C MeUnCD_IGovIKiPos_C MeUnCD_iIGovIWinNeg_C MeUnCD_iIGovIWinPos_C MeUnCD_iLin_CUR MeUnCD_nDiffMax_C MeUnCD_numAdc_C MeUnCD_numDia1_C MeUnCD_numDia2_C MeUnCD_numPwmOut_C MeUnCD_resCoil_C MeUnCD_stInvOut_C MeUnCD_stPwrStgDia_C MeUnCD_swt_C MeUnCD_tiBtwTst_C MeUnCD_tiFltPT1Init_C MeUnCD_tiFlt1PT1_C MeUnCD_tiFlt2PT1_C MeUnCD_tiIGovDT1_C MeUnCD_tiIGovInit_C MeUnCD_tiPer_CUR MeUnCD_uSRCMax_C MeUnCD_uSRCMin_C MeUn_iCnvFlowRate_CUR MeUn_iSet_Channel MeUn_iSetMin_C MeUn_iSet_Vector MeUn_pActrPrt_C MeUn_pFlowOfFl_C MRlyCD_ctTooEarlyThres_C MRlyCD_numDioOutMnRly_C MRlyCD_numDioOutPSOFF_C MRlyCD_stInvOut_C MRlyCD_tiNotOpen_C MSCD_nEngNAvrgDev_C MSCD_swtEngNAvrgOn_C MSCD_swtInjCtlQ_C MSidCD_Comm_DebNplDef_C MSidCD_Comm_DebNplOk_C MSidCD_Mixed_DebSigDef_C MSidCD_Mixed_DebSigOk_C MSidCD_numECUS_C MSidCD_Pin_DebSigDef_C MSidCD_Pin_DebSigOk_C MSidCD_Select_DebNplDef_C MSidCD_Select_DebNplOk_C MSidCD_Sel_INI_DebNplDef_C MSidCD_Sel_INI_DebNplOk_C MSidCD_stCANprivErrMsk_C MSidCD_stErrInjOFF_C MSidCD_stInv_C MSidCD_swtCanDeb_C MSidCD_swtLearn_C MSidCD_swtMAIN_C MSidCD_tiCanDeb_C MSid_swtSwCmp_C MSMon_DebCanDefDef_C MSMon_DebCanDefOk_C MSMon_DebDef_AirSys_C MSMon_DebDefARS_TO_C MSMon_DebDef_CoEng_IRevMS_C MSMon_DebDef_CoEng_OffVeh_C MSMon_DebDef_CoEng_RevMS_C MSMon_DebDef_CoEng_Rev1_C MSMon_DebDef_CoEng_Rev2_C MSMon_DebDefDSC_TO_C MSMon_DebDefEGS_TO_C MSMon_DebDefFrmMngCoEng_C MSMon_DebDef_FrmMngPT_C MSMon_DebDefFrmMngPT2_C MSMon_DebDefMil_C MSMon_DebDef_qLimErr_C MSMon_DebDefSysLamp_C MSMon_DebDef_trqCoDT_C MSMon_DebDef_trqCoVeh_C MSMon_DebDef_trqDesExt_C MSMon_DebDef_trqLimErr_C MSMon_DebDef_trqLimErr1_C MSMon_DebDef_trqLimErr2_C MSMon_DebOK_AirSys_C MSMon_DebOK_CoEng_IRevMS_C MSMon_DebOK_CoEng_OffVeh_C MSMon_DebOK_CoEng_RevMS_C MSMon_DebOK_CoEng_Rev1_C MSMon_DebOK_CoEng_Rev2_C MSMon_DebOK_FrmMngPT_C MSMon_DebOKMil_C MSMon_DebOK_qLimErr_C MSMon_DebOKSysLamp_C MSMon_DebOK_trqCoDT_C MSMon_DebOK_trqCoVeh_C MSMon_DebOK_trqDesExt_C MSMon_DebOK_trqLimErr_C MSMon_DebOK_trqLimErr1_C MSMon_DebOK_trqLimErr2_C MSMon_stIRevMS_C MSMon_stRevMS_C MSMon_tiDefChksmCan_C MSMon_tiDefCplConsist_C MSMon_tiDefHWCan_C MSMon_tiDefRxCan_C MSMon_tiDefTaskConsist_C MSMon_tiDefTaskSlvConsist_C MSMon_tiDefTxCan_C MSMon_tiOkChksmCan_C MSMon_tiOkCplConsist_C MSMon_tiOkHWCan_C MSMon_tiOkRxCan_C MSMon_tiOkTaskConsist_C MSMon_tiOkTaskSlvConsist_C MSMon_tiOkTxCan_C MSsched_LockL_C MSsched_LockN_C MSsched_LockS_C MSsched_PerL_C MSsched_PerN_C MSsched_PerS_C MSsched_ShiftL_C MSsched_ShiftS_C MSsched_Wait_C MSsched_WaitI_C MSSigIni_tiIniCanWait_C NetMng_CANFadeOutMaskA_C NetMng_CANFadeOutMaskB_C NetMng_CANFadeOutMaskC_C NetMng_ctBusOffRetriesA_C NetMng_ctBusOffRetriesB_C NetMng_ctBusOffRetriesC_C NetMng_ctInitRetryCanA_C NetMng_ctInitRetryCanB_C NetMng_ctInitRetryCanC_C NetMng_FadeOutMaskA_C NetMng_FadeOutMaskB_C NetMng_FadeOutMaskC_C NetMng_SplyVltgHysXHigh_C NetMng_SplyVltgHysXLow_C NetMng_SplyVltgHysYHigh_C NetMng_SplyVltgHysYLow_C NetMng_swtONWM_C NetMng_tiDebNegBusMonCanA_C NetMng_tiDebNegBusMonCanB_C NetMng_tiDebNegBusMonCanC_C NetMng_tiDebNegBusOffCanA_C NetMng_tiDebNegBusOffCanB_C NetMng_tiDebNegBusOffCanC_C NetMng_tiDebNegErrCanA_C NetMng_tiDebNegErrCanB_C NetMng_tiDebNegErrCanC_C NetMng_tiDebNegMonCanA_C NetMng_tiDebNegMonCanB_C NetMng_tiDebNegMonCanC_C NetMng_tiDebPosBusMonCanA_C NetMng_tiDebPosBusMonCanB_C NetMng_tiDebPosBusMonCanC_C NetMng_tiDebPosBusOffCanA_C NetMng_tiDebPosBusOffCanB_C NetMng_tiDebPosBusOffCanC_C NetMng_tiDebPosErrCanA_C NetMng_tiDebPosErrCanB_C NetMng_tiDebPosErrCanC_C NetMng_tiDebPosMonCanA_C NetMng_tiDebPosMonCanB_C NetMng_tiDebPosMonCanC_C NetMng_tiFadeoutLowBat_C NetMng_tiFadeoutMin_C NetMng_tiRecoverA_C NetMng_tiRecoverB_C NetMng_tiRecoverC_C NetMng_tiTimeoutDNMT_C NSC_numPrio_C NSC_st_C OPSCD_DebSRCLoDef_C OPSCD_numAdc_C OPSCD_numDia_C OPSCD_numDioOut_C OPSCD_uSRCMax_C OPSCD_uSRCMin_C OTSCD_DebNplDef_C OTSCD_DebSigDef_C OTSCD_DebSRCHighDef_C OTSCD_DebSRCLowDef_C OTSCD_numAdc_C OTSCD_uSRCMax_C OTSCD_uSRCMin_C OvRMon_ctDebToTORQUE_DSCDef_C OvRMon_ctDebToTORQUE_DSCOk_C OvRMon_ctDebToTORQUE_EGSDef_C OvRMon_ctDebToTORQUE_EGSOk_C OvRMon_ctDebToTORQUE_SSGDef_C OvRMon_ctDebToTORQUE_SSGOk_C OvRMon_ctEngSpdGrad_C OvRMon_DebETDef_C OvRMon_DebSigA0Def_C OvRMon_facInjEff_MAP OvRMon_nDiffMax_C OvRMon_nLIGovLim_C OvRMon_nMin_C OvRMon_nSegMax_C OvRMon_nSegMin_C OvRMon_nStSysLim_C OvRMon_nThresNrml2Strt_C OvRMon_stIntrInit_C OvRMon_tiAPP1Flt_C OvRMon_tiASDdc_C OvRMon_tiCompAcsTemp_C OvRMon_tiCrCtlBrkRmp_C OvRMon_tiDebBrk_C OvRMon_tiDebConv_C OvRMon_tiDebT15_C OvRMon_tiEngSpdRlsBrkRmp_C OvRMon_tiErrAPP_C OvRMon_tiErrDblStorage_C OvRMon_tiLimET_MAP OvRMon_tiSegMin_C OvRMon_uAPPFull_C OvRMon_uAPP1Lim_C OvRMon_uPlaWinFull_C OvRMon_uPlaWinIdle_C PCR_nCoStart_C PCR_nCoStrtHigh_C PCR_nLIGovBase_C PCR_nSurgeMon1_C PCR_nSurgeMon2_C PCR_pBGDevMaxOffset_C PCR_pBGDevMinOffset_C PCR_pDesAdd_Channel PCR_pDesAdd_Vector PCR_pDes_Channel PCR_pDes_Vector PCR_pLPDvtMaxOffset_C PCR_pLPDvtMinOffset_C PCR_rBPACDAdd_Channel PCR_rBPACDAdd_Vector PCR_rBPACD_Channel PCR_rBPACD_Vector PCR_rSurgeHigh_MAP PCR_swtRelAbsType_C PCR_swtRelAbsVal_C PCR_tiCoStrt_CUR PCR_tiStrtDelayInit_C PCR_tiSurgeMonLIGov_C PCR_vSurgeLIGov_C PCVCD_dcycMax_C PCVCD_dcycMin_C PCVCD_DebExcTempDef_C PCVCD_DebExcTempOk_C PCVCD_DebNoLoadDef_C PCVCD_DebNoLoadOk_C PCVCD_DebShortCircBatDef_C PCVCD_DebShortCircBatOk_C PCVCD_DebShortCircGndDef_C PCVCD_DebShortCircGndOk_C PCVCD_DebSRCHighDef_C PCVCD_DebSRCHighOk_C PCVCD_DebSRCLowDef_C PCVCD_DebSRCLowOk_C PCVCD_facIGovInit_CUR PCVCD_facIGovMax_C PCVCD_facIGovMin_C PCVCD_IGovDKd_C PCVCD_IGovIKi_C PCVCD_IGovIKiNeg_C PCVCD_IGovIKiPos_C PCVCD_iIGovIWinNeg_C PCVCD_iIGovIWinPos_C PCVCD_iLin_CUR PCVCD_numAdc_C PCVCD_numDia1_C PCVCD_numDia2_C PCVCD_numPwmOut_C PCVCD_resCoil_C PCVCD_stInvOut_C PCVCD_stPwrStgDia_C PCVCD_swt_C PCVCD_swtCtlStateType_C PCVCD_swtCtlStateVal_C PCVCD_tiBtwTst_C PCVCD_tiFltPT1Init_C PCVCD_tiFlt1PT1_C PCVCD_tiFlt2PT1_C PCVCD_tiIGovDT1_C PCVCD_tiIGovInit_C PCVCD_tiPer_C PCVCD_uSRCMax_C PCVCD_uSRCMin_C PCV_dvolLeak_CUR PCV_iCnvPress_CUR PCV_iSet_Channel PCV_iSetMin_C PCV_iSet_Vector PFlt_resFlow_Channel PFlt_resFlow_Vector PFlt_st_Channel PFlt_stEngPOp_Channel PFlt_stEngPOp_Vector PFlt_st_Vector RailCD_DebSRCHighDef_C RailCD_DebSRCHighOk_C RailCD_DebSRCLowDef_C RailCD_DebSRCLowOk_C RAILCD_numAdc_C RAILCD_numAdc2_C RailCD_pLin_CUR RailCD_tiEvalDel_C RailCD_tiOfsTstAftRun_C RailCD_tiOfsTstStrt_C RailCD_uSRCMax_C RailCD_uSRCMin_C Rail_DebCPC1MaxDef_C Rail_DebCPC1MaxOk_C Rail_DebCPC3MaxDef_C Rail_DebCPC3MaxOk_C Rail_DebCPC4MaxDef_C Rail_DebCPC4MaxOk_C Rail_DebMeUn0MaxDef_C Rail_DebMeUn0MaxOk_C Rail_DebMeUn1MaxDef_C Rail_DebMeUn1MaxOk_C Rail_DebMeUn2MaxDef_C Rail_DebMeUn2MaxOk_C Rail_DebMeUn3MaxDef_C Rail_DebMeUn3MaxOk_C Rail_DebMeUn4MaxDef_C Rail_DebMeUn4MaxOk_C Rail_DebPCV0MaxDef_C Rail_DebPCV0MaxOk_C Rail_DebPCV1MaxDef_C Rail_DebPCV1MaxOk_C Rail_DebPCV2MaxDef_C Rail_DebPCV2MaxOk_C Rail_DebPCV3MaxDef_C Rail_DebPCV3MaxOk_C Rail_DebPCV4MaxDef_C Rail_DebPCV4MaxOk_C Rail_DebPCV5MaxDef_C Rail_DebPCV5MaxOk_C Rail_dpSetPointDec_C Rail_dpSetPointInc_MAP Rail_dvolMeUnCtlLoLim_C Rail_dvolMeUnCtlUpLim_CUR Rail_dvolMeUnSet_Channel Rail_dvolMeUnSetMin_C Rail_dvolMeUnSet_Vector Rail_dvolOff_C Rail_dvolPreCtlCor_Channel Rail_dvolPreCtlCor_Vector Rail_dvolPreCtlPoI1_MAP Rail_dvolPreCtlPoI2_MAP Rail_dvolRedOfsLim_C Rail_dvolStrt_C Rail_facLeakAged_C Rail_facOvrMeUnNegIncr_C Rail_facOvrPCVNegIncr_C Rail_nMonEnaMax_C Rail_nMonEnaMin_C Rail_nThresStrt_C Rail_numRevDel_C Rail_numRevPlaus_C Rail_pAbsDvtMax_C Rail_pCloseCtl_C Rail_pCPCPeakMax_C Rail_pCPCPeakMin_CUR Rail_pMeUnCtlTypeHi_C Rail_pMeUnCtlTypeLo_C Rail_pMeUnDvtMax_C Rail_pMeUnDvtMax_CUR Rail_pMeUnDvtMin_CUR Rail_pMeUnPeakMax_C Rail_pMeUnPeakMin_CUR Rail_pNIPCVMax_MAP Rail_pNIPCVMin_MAP Rail_pOpnCtl_C Rail_pOvrMeUnThresHigh_C Rail_pOvrMeUnThresLow_C Rail_pOvrPCVThresHigh_C Rail_pOvrPCVThresLow_C Rail_pPCVCloseOfs_CUR Rail_pPCVCtlLoLim_C Rail_pPCVCtlLoLimStrt_C Rail_pPCVCtlUpLimStrt_C Rail_pPCVDvtMax_C Rail_pPCVDvtMax_CUR Rail_pPCVDvtMin_C Rail_pPCVPeakMax_C Rail_pPCVPeakMin_CUR Rail_pPCVSet_Channel Rail_pPCVSetMax_CUR Rail_pPCVSetMin_C Rail_pPCVSet_Vector Rail_pPreCtlCor_Channel Rail_pPreCtlCor_Vector Rail_pRedOfsLim_C Rail_pSetMin_C Rail_pSetPoint_Channel Rail_pSetPointMax_MAP Rail_pSetPointMinDef_C Rail_pSetPointMin_MAP Rail_pSetPointRed_C Rail_pSetPointRgn_Channel Rail_pSetPointRgn_Vector Rail_pSetPoint_Vector Rail_qMeUnLoIdle_C Rail_qMonEnaMax_C Rail_stMonMeUnRls_C Rail_stMonPCVRls_C Rail_stPreCtlMeUnSel_C Rail_stSetPointSel_C Rail_swtCtlType_C Rail_tiDeflate_C Rail_tiSetPointRedMin_C Rail_tiSwtCPCMax_C Rail_tiThresMonEna_C Rail_tMeUnCtlTypeHi_C Rail_tMeUnCtlTypeLo_C Rail_tMeUnLoIdle_C Rail_tSwtCPCHi_C Rail_tSwtCPCLo_C Rail_volInjVlvCtl_C Rtmo_adStart_cu32 Rtmo_stSampleTime_cu8 SOPTst_stRcyDem_C SOPTst_stShOffPathActv_C SPMon_swtRstStackMon_C SSpMon_DebSRCHighSplyVltgDef1_C SSpMon_DebSRCHighSplyVltgDef2_C SSpMon_DebSRCHighSplyVltgDef3_C SSpMon_DebSRCHighSplyVltgDef4_C SSpMon_DebSRCHighSplyVltgDef5_C SSpMon_DebSRCHighSplyVltgDef6_C SSpMon_DebSRCHighSplyVltgOk1_C SSpMon_DebSRCHighSplyVltgOk2_C SSpMon_DebSRCHighSplyVltgOk3_C SSpMon_DebSRCHighSplyVltgOk4_C SSpMon_DebSRCHighSplyVltgOk5_C SSpMon_DebSRCHighSplyVltgOk6_C SSpMon_DebSRCLowSplyVltgDef1_C SSpMon_DebSRCLowSplyVltgDef2_C SSpMon_DebSRCLowSplyVltgDef3_C SSpMon_DebSRCLowSplyVltgDef4_C SSpMon_DebSRCLowSplyVltgDef5_C SSpMon_DebSRCLowSplyVltgDef6_C SSpMon_DebSRCLowSplyVltgOk1_C SSpMon_DebSRCLowSplyVltgOk2_C SSpMon_DebSRCLowSplyVltgOk3_C SSpMon_DebSRCLowSplyVltgOk4_C SSpMon_DebSRCLowSplyVltgOk5_C SSpMon_DebSRCLowSplyVltgOk6_C SSpMon_numDiaVltg1_C SSpMon_numDiaVltg2_C SSpMon_numDiaVltg3_C SSpMon_numDiaVltg4_C SSpMon_numDiaVltg5_C SSpMon_numDiaVltg6_C StrtCD_numDia_C StrtCD_numDioOut_C StSys_nAdjMax_C ThrVlv_rTVA_Channel ThrVlv_rTVA_Vector TPUMon_ctDfctLim_C TPUMon_ctTPU_C TPUMon_tiDiffMaxLimit_C TPUMon_tiDiffMinLimit_C TPUMon_tiDiffSumLimit_C TVACD_numDia_C TVACD_numPwmOut_C TVACD_stSPICtl_C T15CD_numDioIn_C T15CD_tiDebNeg_C T15CD_tiDebPos_C VehDa_lEepUpd_C VSACD_numDia_C VSACD_numPwmOut_C VSA_rVSA_Channel VSA_rVSA_Vector VSSCD_DebCanSigDef_C VSSCD_swtSigType_C VSSCD_swtSigVal_C ZFC_nAvrgMax_C ZFC_nAvrgMin_C ZFC_nChngPRailMax_C ZFC_nFBCThresMax_C ZFC_numRatETClb_C ZFC_numRatNVClb_C AirCtl_mDesCorBypass_Channel AirCtl_mDesCorBypass_Vector BPA_rLPACD_Channel BPA_rLPACD_Vector EGT_tInrDesInTempGvnrB1_Channel EGT_tInrDesInTempGvnrB1_Vector EGT_tInrDesInTempGvnrB2_Channel EGT_tInrDesInTempGvnrB2_Vector EGT_tOutrDesInTempGvnrB1_Channel EGT_tOutrDesInTempGvnrB1_Vector EGT_tOutrDesInTempGvnrB2_Channel EGT_tOutrDesInTempGvnrB2_Vector InjCrv_phiMI1RgnAdd_Channel InjCrv_phiMI1RgnAdd_Vector InjCrv_phiPiI1RgnAdd_Channel InjCrv_phiPiI1RgnAdd_Vector InjCrv_phiPiI2RgnAdd_Channel InjCrv_phiPiI2RgnAdd_Vector InjCrv_phiPoI1RgnAdd_Channel InjCrv_phiPoI1RgnAdd_Vector InjCrv_phiPoI2Add_Channel InjCrv_phiPoI2Add_Vector InjCrv_qMI1RgnAdd_Channel InjCrv_qMI1RgnAdd_Vector InjCrv_qPiI1RgnAdd_Channel InjCrv_qPiI1RgnAdd_Vector InjCrv_qPiI2RgnAdd_Channel InjCrv_qPiI2RgnAdd_Vector InjCrv_qPoI1RgnAdd_Channel InjCrv_qPoI1RgnAdd_Vector InjCrv_qPoI2DesAdd_Channel InjCrv_qPoI2DesAdd_Vector InjCrv_qPoI2EffAdd_Channel InjCrv_qPoI2EffAdd_Vector InjCrv_tiPiI1RgnAdd_Channel InjCrv_tiPiI1RgnAdd_Vector InjCrv_tiPiI2RgnAdd_Channel InjCrv_tiPiI2RgnAdd_Vector InjCrv_tiPoI2Add_Channel InjCrv_tiPoI2Add_Vector PFlt_mSotB1_Channel PFlt_mSotB1_Vector PFlt_mSotB2_Channel PFlt_mSotB2_Vector PFlt_resFlowB1_Channel PFlt_resFlowB1_Vector PFlt_resFlowB2_Channel PFlt_resFlowB2_Vector /end REF_CHARACTERISTIC
/end FUNCTION
/begin FUNCTION _k2rei "Applizierbare Diagnose Informationen" /begin DEF_CHARACTERISTIC K2REI_dCodInd_C K2REI_dDiaInd_C K2REI_dSGFam_C /end DEF_CHARACTERISTIC /end FUNCTION
/begin FUNCTION BGCRENG "BGCRENG" /end FUNCTION
/begin FUNCTION BGLLGEN_1PR "BGLLGEN_1PR" /end FUNCTION
/begin FUNCTION BRWT "BRWT" /end FUNCTION
/begin COMPU_METHOD Acc "Fahrzeugbeschleunigung" RAT_FUNC "%6.5" "m/s^2" COEFFS 0 1000 0 0 0 1 /end COMPU_METHOD
/begin COMPU_METHOD Def_i_sw_q1 "Def_i_sw_q1" RAT_FUNC "%8.3" "A" COEFFS 0 1 0 0 0 1 /end COMPU_METHOD
/begin COMPU_METHOD Def_f_uw_b512 "Def_f_uw_b512" RAT_FUNC "%8.3" "-" COEFFS 0 65536 0 0 0 512 /end COMPU_METHOD
/begin COMPU_METHOD Def_i_uw_q0p0635 "Def_i_uw_q0p0635" RAT_FUNC "%8.3" "A" COEFFS 0 65536 0 0 0 4096 /end COMPU_METHOD
/begin COMPU_METHOD Def_i_sw_q0p001 "Def_i_sw_q0p001" RAT_FUNC "%8.3" "A" COEFFS 0 1000 0 0 0 1 /end COMPU_METHOD
/begin COMPU_METHOD Def_t_sw_q0p1 "Def_t_sw_q0p1" RAT_FUNC "%6.1" "°C" COEFFS 0 10 0 0 0 1 /end COMPU_METHOD
/begin COMPU_METHOD Def_u_uw_q0p0942 "Def_u_uw_q0p0942" RAT_FUNC "%6.1" "V" COEFFS 0 1 0 0 0 0.0942 /end COMPU_METHOD
/begin COMPU_METHOD Def_f_ub_b8 "Def_f_ub_b8" RAT_FUNC "%5.2" "-" COEFFS 0 256 0 0 0 8 /end COMPU_METHOD
/begin COMPU_METHOD Def_v_uw_q1p0 "Def_v_uw_q1p0" RAT_FUNC "%5.0" "km/h" COEFFS 0 1 0 0 0 1 /end COMPU_METHOD
/begin COMPU_METHOD Def_tv_ub_q0p390625 "Def_tv_ub_q0p390625" RAT_FUNC "%5.2" "%" COEFFS 0 256 0 0 0 100 /end COMPU_METHOD
/begin COMPU_METHOD Def_bit_ub_0 "Def_bit_ub_0" TAB_VERB "%5.2" "-" COMPU_TAB_REF Def_bit_ub_0_VTAB /end COMPU_METHOD
/begin COMPU_METHOD Def_st_ub_q1 "Def_st_ub_q1" RAT_FUNC "%3.0" "-" COEFFS 0 1 0 0 0 1 /end COMPU_METHOD
/begin COMPU_METHOD Def_n_sw_q1p0 "Def_n_sw_q1p0" RAT_FUNC "%5.0" "Upm" COEFFS 0 1 0 0 0 1 /end COMPU_METHOD
/begin COMPU_METHOD Def_f_ub_b100 "Def_f_ub_b100" RAT_FUNC "%5.2" "%" COEFFS 0 256 0 0 0 100 /end COMPU_METHOD
/begin COMPU_METHOD Def_i_ub_q1 "Def_i_ub_q1" RAT_FUNC "%6.3" "" COEFFS 0 1 0 0 0 1 /end COMPU_METHOD
/begin COMPU_METHOD Def_td_ub_q0p1 "Def_td_ub_q0p1" RAT_FUNC "%4.1" "s" COEFFS 0 10 0 0 0 1 /end COMPU_METHOD
/begin COMPU_METHOD Def_t_sw_q0p01 "Def_t_sw_q0p01" RAT_FUNC "%7.2" "°C" COEFFS 0 100 0 0 0 1 /end COMPU_METHOD
/begin COMPU_METHOD Def_me_sw_q0p01 "Def_me_sw_q0p01" RAT_FUNC "%8.3" "mg/cyc" COEFFS 0 100 0 0 0 1 /end COMPU_METHOD
/begin COMPU_METHOD Def_dez_uw_q1 "Def_dez_uw_q1" RAT_FUNC "%5.0" "-" COEFFS 0 1 0 0 0 1 /end COMPU_METHOD
/begin COMPU_METHOD ident "ident" RAT_FUNC "%4.1" "-" COEFFS 0 1 0 0 0 1 /end COMPU_METHOD
/begin COMPU_METHOD Def_dez_ub_q1 "Def_dez_ub_q1" RAT_FUNC "%3.0" "-" COEFFS 0 1 0 0 0 1 /end COMPU_METHOD
/begin COMPU_METHOD Def_f_ub_b1 "Def_f_ub_b1" RAT_FUNC "%6.3" "-" COEFFS 0 256 0 0 0 1 /end COMPU_METHOD
/begin COMPU_METHOD Def_ml_sw_q0p1 "Def_ml_sw_q0p1" RAT_FUNC "%7.2" "mg/Hub" COEFFS 0 10 0 0 0 1 /end COMPU_METHOD
/begin COMPU_VTAB Def_bit_ub_0_VTAB "Def_bit_ub_0_VTAB" TAB_VERB 2 0 "FALSE" 1 "TRUE" /end COMPU_VTAB
/begin COMPU_METHOD AngleCrS "Winkel Kurbelwelle" RAT_FUNC "%6.4" "deg CrS" COEFFS 0 42.6666666666667 0 0 0 1 /end COMPU_METHOD
/begin COMPU_METHOD AngleGrad "Winkelanzeige in Grad" RAT_FUNC "%6.4" "Grad" COEFFS 0 22.7531285551763 0 0 0 1 /end COMPU_METHOD
/begin COMPU_METHOD AngleGradPerSec "Winkelanzeige in Grad pro Sekunde" RAT_FUNC "%6.4" "Grad/s" COEFFS 0 22.7531285551763 0 0 0 1 /end COMPU_METHOD
/begin COMPU_METHOD Dist_20ms "Entfernung durch Aufsummierung Fahrgeschwindigkeit (Vel/VelSI) im 20 ms Raster" RAT_FUNC "%7.6" "m" COEFFS 0 18000 0 0 0 1 /end COMPU_METHOD
/begin COMPU_METHOD DtyCyc "Tastverhaeltnis" RAT_FUNC "%6.4" "%" COEFFS 0 100 0 0 0 1 /end COMPU_METHOD
/begin COMPU_METHOD EngN "Motordrehzahl" RAT_FUNC "%6.2" "rpm" COEFFS 0 1 0 0 0 1 /end COMPU_METHOD
/begin COMPU_METHOD EngTempFldSel "Verbale Umrechnung für Auswahl aus dem Motortemperatur-Feld Eng_tFld" TAB_VERB "%6.3" "-" COMPU_TAB_REF EngTempFldSel /end COMPU_METHOD
/begin COMPU_VTAB EngTempFldSel "Verbale Umrechnung für Auswahl aus dem Motortemperatur-Feld Eng_tFld" TAB_VERB 3 0 "Coolant_Temperature" 1 "Oil_Temperature" 2 "Eng_tEng" /end COMPU_VTAB
/begin COMPU_METHOD Fact "Faktor mit Auflösung 1 / 8192, hauptsächlich für einen Faktorenbereich 0...1 verwendet" RAT_FUNC "%6.5" "-" COEFFS 0 8192 0 0 0 1 /end COMPU_METHOD
/begin COMPU_METHOD InjMass "Einspritzmenge" RAT_FUNC "%6.4" "mg/hub" COEFFS 0 100 0 0 0 1 /end COMPU_METHOD
/begin COMPU_METHOD InjTime_us "Zeit in Microsekunden für das Einspritztiming" RAT_FUNC "%6.2" "us" COEFFS 0 1 0 0 0 1 /end COMPU_METHOD
/begin COMPU_METHOD Length "Länge in Meter" RAT_FUNC "%6.2" "m" COEFFS 0 1 0 0 0 1 /end COMPU_METHOD
/begin COMPU_METHOD NumPinDia "Verbale Umrechnung für Diagnose Signale" TAB_VERB "%6.3" "-" COMPU_TAB_REF NumPinDia /end COMPU_METHOD
/begin COMPU_VTAB NumPinDia "Verbale Umrechnung für Diagnose Signale" TAB_VERB 34 0 "CJ945_Diagnostic_Signal" 1 "AC_Compressor_DiaSig" 2 "Fuel_Pump_DiaSig" 3 "Starter_234" 4 "Radiator_Blind_Control_Diagnostic_Signal" 5 "Engine_Bay_Air_Flaps/Compressor_Bypass_123" 6 "Glow_Relay_Diagnostic_Signal1" 7 "EngM_Bearing_Actuator_Diagnostic_Signal_124" 8 "reserved Glow_Relay_Diagnostic_Signal2" 9 "Ebox_Fan_Actuator_Diagnostic_Signal_219" 10 "Shutter_Actuator_SW_DiaSig" 11 "Twostage_TurboLoading_SW_DiaSig" 12 "DIO_OUT_DIAGNOSTIC_DUMMY_NOT_USED" 13 "1st_Pressure_Control_Valve_Diagnostic_Signal_172" 14 "2nd_Pressure_Control_Valve_Diagnostic_Signal_172" 15 "1st_Metering_Unit_Diagnostic_Signal_171" 16 "2nd_Metering_Unit_Diagnostic_Signal_171" 17 "Boost_Pressure_Actuator_Diagnostic_Signal_193" 18 "Boost_Pressure_Actuator_Diagnostic_Signal_193_2" 19 "EGR_Actuator_Diagnostic_Signal_194" 20 "EGR_Actuator_Diagnostic_Signal2" 21 "Variable_Swirl_Actuator_Diagnostic_Signal_195" 22 "Throttle_Valve_Diagnostic_Signal_196" 23 "Throttle_Valve2_Diagnostic_Signal_196" 24 "FAN_240" 25 "Add_On_Heater_244" 26 "Low pressure stage BPA_Diagnostic_Signal_117" 27 "PWM_DIAGNOSTIC_DUMMY_NOT_USED" 28 "1st_Sensor_Supply_Voltage_DiaSig" 29 "2nd_Sensor_Supply_Voltage_DiaSig" 30 "3rd_Sensor_Supply_Voltage_DiaSig" 31 "4th_Sensor_Supply_Voltage_DiaSig" 32 "5th_Sensor_Supply_Voltage_DiaSig" 33 "6th_Sensor_Supply_Voltage_DiaSig" /end COMPU_VTAB
/begin COMPU_METHOD NumPinDioIn "Verbale Umrechnung für Digitaleingang Signale" TAB_VERB "%6.3" "-" COMPU_TAB_REF NumPinDioIn /end COMPU_METHOD
/begin COMPU_VTAB NumPinDioIn "Verbale Umrechnung für Digitaleingang Signale" TAB_VERB 13 0 "Terminal_15_207" 1 "Main_Brake_Switch_236" 2 "Redundant_Brake_Switch_223" 3 "Clutch_Switch" 4 "Terminal_50_224" 5 "ECU_selection_Switch_251" 6 "Coolant-heater_212" 7 "Redundant_Terminal_15_209(118)" 8 "AC-compressor_overboost_213" 9 "1st_Lambda_Regeneration" 10 "Oil_Level_sensor_138" 11 "Diagnostic_Pin_VSA_137" 12 "DIO_IN_DUMMY_NOT_USED" /end COMPU_VTAB
/begin COMPU_METHOD NumPinDioOut "Verbale Umrechnung für Digitalausgang Signale" TAB_VERB "%6.3" "-" COMPU_TAB_REF NumPinDioOut /end COMPU_METHOD
/begin COMPU_VTAB NumPinDioOut "Verbale Umrechnung für Digitalausgang Signale" TAB_VERB 16 0 "Main_Relay_220(144)" 1 "AC_Compressor" 2 "Fuel_Pump_232" 3 "Glow_Relay" 4 "Starter_234" 5 "Radiator_Blind_Control" 6 "EBAF/Compressor_Bypass_123" 7 "Glow_Relay_1" 8 "EngM_Bearing_Actuator_124" 9 "Glow_Relay_2" 10 "Ebox_Fan_Actuator_219" 11 "STATREG_PSOFF_Bit" 12 "Shutter_Actuator_216" 13 "Twostage_TurboLoading_120" 14 "TD_Signal_253" 15 "DIO_OUT_DUMMY_NOT_USED" /end COMPU_VTAB
/begin COMPU_METHOD NumPinPwmOut "Verbale Umrechnung für PWM-Ausgang Signale" TAB_VERB "%6.3" "-" COMPU_TAB_REF NumPinPwmOut /end COMPU_METHOD
/begin COMPU_VTAB NumPinPwmOut "Verbale Umrechnung für PWM-Ausgang Signale" TAB_VERB 14 0 "PCV_Actuator_172" 1 "MeUn_Actuator_171" 2 "Boost_Pressure_Actuator_193" 3 "Boost_Pressure_Actuator_193_2" 4 "EGR_Actuator_194" 5 "EGR_Actuator_2" 6 "Variable_Swirl_Actuator_195" 7 "Throttle_Valve_196" 8 "Throttle_Valve2_196" 9 "Fan_Actuator_240" 10 "Add_On_Heater_244" 11 "LSU_Heater_PWMOutput" 12 "Low pressure stage BPA_117" 13 "PWM_DUMMY_NOT_USED" /end COMPU_VTAB
/begin COMPU_METHOD OneToOne "eins zu eins (physikalischer Wert ist gleich dem internen Wert)" RAT_FUNC "%6.2" "-" COEFFS 0 1 0 0 0 1 /end COMPU_METHOD
/begin COMPU_METHOD Period "Periodendauer" RAT_FUNC "%6.3" "ms" COEFFS 0 10 0 0 0 1 /end COMPU_METHOD
/begin COMPU_METHOD Per_Ratio "Umwandlung fuer Bereichsgewichtung" RAT_FUNC "%6.4" "-" COEFFS 0 256 0 0 0 1 /end COMPU_METHOD
/begin COMPU_METHOD Prc "Prozent, gleiche interne Auflösung wie Fact, aber Darstellung in Prozent (0...100%)" RAT_FUNC "%6.4" "%" COEFFS 0 81.92 0 0 0 1 /end COMPU_METHOD
/begin COMPU_METHOD Pres_hPa "Druck (angezeigt in [hPa])" RAT_FUNC "%6.2" "hPa" COEFFS 0 1 0 0 0 1 /end COMPU_METHOD
/begin COMPU_METHOD Pres_Rail "Raildruck in hPa" RAT_FUNC "%4.3" "bar" COEFFS 0 10.000000 0 0 0 1 /end COMPU_METHOD
/begin COMPU_METHOD Pwr "Leistung" RAT_FUNC "%6.2" "W" COEFFS 0 0.10610329539459 0 0 0 1 /end COMPU_METHOD
/begin COMPU_METHOD RmpTrq "Rampengradient für Motormoment" RAT_FUNC "%6.4" "Nm/s" COEFFS 0 655.36 0 0 0 1 /end COMPU_METHOD
/begin COMPU_METHOD Temp_Cels "Temperatur dargestellt in °C (gleiche interne Darstellung wie Temp_Kelv)" RAT_FUNC "%6.1" "deg C" COEFFS 0 10 2731.4 0 0 1 /end COMPU_METHOD
/begin COMPU_METHOD TimeDeb "Entprellzeit in Millisekunden für Libraryfunktion Debounce" RAT_FUNC "%6.1" "ms" COEFFS 0 0.1 0 0 0 1 /end COMPU_METHOD
/begin COMPU_METHOD TimeDelay_s "Zeitkonstante T1 (in s) für PT1, DT1, etc." RAT_FUNC "%9.3" "s" COEFFS 0 0 1 0 0.00023283064365387 0 /end COMPU_METHOD
/begin COMPU_METHOD TimeDT_ms "sample time (DT) des Tasks ,verwendet fuer Regler, Filter etc. ... angezeigt in [ms]" RAT_FUNC "%6.5" "ms" COEFFS 0 1000 0 0 0 1 /end COMPU_METHOD
/begin COMPU_METHOD TimeEngOn "Motorbetriebszeit in Sekunden" RAT_FUNC "%6.2" "s" COEFFS 0 1 0 0 0 1 /end COMPU_METHOD
/begin COMPU_METHOD TimeUSResolution "Zeit in Mikrosekunden für TPU Zeiten, Auflösung 1 us" RAT_FUNC "%6.2" "us" COEFFS 0 1 0 0 0 1 /end COMPU_METHOD
/begin COMPU_METHOD Time_ms "Zeit in ms für Fehlerentprellung (DSM) und SW-Timer" RAT_FUNC "%6.1" "ms" COEFFS 0 0.1 0 0 0 1 /end COMPU_METHOD
/begin COMPU_METHOD Time_PwmHigh "Periodenzeit von der HWE (Tio_PwmGetAvrg)" RAT_FUNC "%6.3" "us" COEFFS 0 10 0 0 0 1 /end COMPU_METHOD
/begin COMPU_METHOD TransR "Übersetzungsverhältnis (Getriebe etc.)" RAT_FUNC "%6.4" "-" COEFFS 0 100 0 0 0 1 /end COMPU_METHOD
/begin COMPU_METHOD Trq "Motormoment" RAT_FUNC "%6.3" "Nm" COEFFS 0 10 0 0 0 1 /end COMPU_METHOD
/begin COMPU_METHOD Vel "Fahrzeuggeschwindigkeit, gleiche interne Auflösung wie Vel_SI" RAT_FUNC "%6.4" "km/h" COEFFS 0 100 0 0 0 1 /end COMPU_METHOD
/begin COMPU_METHOD VelToN "Verhältnis Fahrzeuggeschwindigkeit zu Motordrehzahl v/n" RAT_FUNC "%8.7" "(km/h)/rpm" COEFFS 0 100000 0 0 0 1 /end COMPU_METHOD
/begin COMPU_METHOD Vel_SI "Fahrzeuggeschwindigkeit (in m/s)" RAT_FUNC "%6.4" "m/s" COEFFS 0 360 0 0 0 1 /end COMPU_METHOD
/begin COMPU_METHOD volAdd_ml_fine "feinere Auflösung des Additivvolumen [ml]" RAT_FUNC "%6.5" "ml" COEFFS 0 1000 0 0 0 1 /end COMPU_METHOD
/begin COMPU_METHOD Volt_Batt "Batteriespannung" RAT_FUNC "%6.1" "mV" COEFFS 0 0.05115 0 0 0 1 /end COMPU_METHOD
/begin COMPU_METHOD VSS_DistFac "Streckenfaktor für FGG" RAT_FUNC "%20.2" "Imp/m" COEFFS 0 0 1 0 2.77777777777778e-10 0 /end COMPU_METHOD
/begin COMPU_METHOD ZFC_EvalEngSpd_Rslt "Umrechnung für das Ergebniss der Drehzahlsignalauswertung" TAB_VERB "%6.3" "-" COMPU_TAB_REF ZFC_EvalEngSpd_Rslt /end COMPU_METHOD
/begin COMPU_VTAB ZFC_EvalEngSpd_Rslt "Umrechnung für das Ergebniss der Drehzahlsignalauswertung" TAB_VERB 3 0 "ZFC_ST_ALL_INJ_LOW" 1 "ZFC_ST_DES_INJ_MAX" 2 "ZFC_ST_ERR_INJ_MAX" /end COMPU_VTAB
/begin COMPU_METHOD ZFC_Inj_State "Umrechnung für die Ausgabe des Zustandsautomaten für die Einspritzung der Nullmengenkalibrierung" TAB_VERB "%6.3" "-" COMPU_TAB_REF ZFC_Inj_State /end COMPU_METHOD
/begin COMPU_VTAB ZFC_Inj_State "Umrechnung für die Ausgabe des Zustandsautomaten für die Einspritzung der Nullmengenkalibrierung" TAB_VERB 5 0 "ZFC_ST_INJ_IDLE" 16 "ZFC_ST_INJ_DEM" 32 "ZFC_ST_INJ_PROG" 48 "ZFC_ST_INJ_RES_OK" 64 "ZFC_ST_INJ_RES_NOK" /end COMPU_VTAB
/begin COMPU_METHOD ZFC_State "Umrechnung für Ausgabe des Nullmengenkalibrierung Statuses" TAB_VERB "%6.3" "-" COMPU_TAB_REF ZFC_State /end COMPU_METHOD
/begin COMPU_VTAB ZFC_State "Umrechnung für Ausgabe des Nullmengenkalibrierung Statuses" TAB_VERB 8 1 "ZFC_ST_BREAK" 2 "ZFC_ST_WAIT" 3 "ZFC_ST_START_OVRRUN" 4 "ZFC_ST_CHANGE_PRAIL" 5 "ZFC_ST_CHECK_PRAIL_AND_N" 6 "ZFC_ST_ETCLB" 7 "ZFC_ST_NVCLB" 16 "ZFC_ST_SUBS_FUNC" /end COMPU_VTAB
/begin RECORD_LAYOUT Kf_Xs16_Ys16_Ws16 NO_AXIS_PTS_X 1 SWORD NO_AXIS_PTS_Y 2 SWORD AXIS_PTS_X 3 SWORD INDEX_INCR DIRECT AXIS_PTS_Y 4 SWORD INDEX_INCR DIRECT FNC_VALUES 5 SWORD COLUMN_DIR DIRECT /end RECORD_LAYOUT
/begin RECORD_LAYOUT Kl_Xs16_Ws16 NO_AXIS_PTS_X 1 SWORD AXIS_PTS_X 2 SWORD INDEX_INCR DIRECT FNC_VALUES 3 SWORD COLUMN_DIR DIRECT /end RECORD_LAYOUT
/begin RECORD_LAYOUT Kwb_Wr32 FNC_VALUES 1 FLOAT32_IEEE COLUMN_DIR DIRECT /end RECORD_LAYOUT
/begin RECORD_LAYOUT Kwb_Ws16 FNC_VALUES 1 SWORD COLUMN_DIR DIRECT /end RECORD_LAYOUT
/begin RECORD_LAYOUT Kwb_Wu16 FNC_VALUES 1 UWORD COLUMN_DIR DIRECT /end RECORD_LAYOUT
/begin RECORD_LAYOUT Kwb_Wu8 FNC_VALUES 1 UBYTE COLUMN_DIR DIRECT /end RECORD_LAYOUT
/begin RECORD_LAYOUT Kw_Ws16 FNC_VALUES 1 SWORD COLUMN_DIR DIRECT /end RECORD_LAYOUT
/begin RECORD_LAYOUT Kw_Ws32 FNC_VALUES 1 SLONG COLUMN_DIR DIRECT /end RECORD_LAYOUT
/begin RECORD_LAYOUT Kw_Wu16 FNC_VALUES 1 UWORD COLUMN_DIR DIRECT /end RECORD_LAYOUT
/begin RECORD_LAYOUT Kw_Wu32 FNC_VALUES 1 ULONG COLUMN_DIR DIRECT /end RECORD_LAYOUT
/begin RECORD_LAYOUT Kw_Wu8 FNC_VALUES 1 UBYTE COLUMN_DIR DIRECT /end RECORD_LAYOUT
/begin RECORD_LAYOUT TKW_VV_VV_UW FNC_VALUES 1 UWORD COLUMN_DIR DIRECT /end RECORD_LAYOUT
/begin RECORD_LAYOUT TKW_VV_VV_SW FNC_VALUES 1 SWORD COLUMN_DIR DIRECT /end RECORD_LAYOUT
/begin RECORD_LAYOUT TKL_UW_VV_UB NO_AXIS_PTS_X 1 UBYTE RESERVED 2 BYTE AXIS_PTS_X 3 UWORD INDEX_INCR DIRECT FNC_VALUES 4 UBYTE COLUMN_DIR DIRECT /end RECORD_LAYOUT
/begin RECORD_LAYOUT TKL_UW_VV_UW NO_AXIS_PTS_X 1 UBYTE RESERVED 2 BYTE AXIS_PTS_X 3 UWORD INDEX_INCR DIRECT FNC_VALUES 4 UWORD COLUMN_DIR DIRECT /end RECORD_LAYOUT
/begin RECORD_LAYOUT TKL_SW_VV_UW NO_AXIS_PTS_X 1 UBYTE RESERVED 2 BYTE AXIS_PTS_X 3 SWORD INDEX_INCR DIRECT FNC_VALUES 4 UWORD COLUMN_DIR DIRECT /end RECORD_LAYOUT
/begin RECORD_LAYOUT TKF_UW_UB_UW NO_AXIS_PTS_X 1 UBYTE NO_AXIS_PTS_Y 2 UBYTE AXIS_PTS_X 3 UBYTE INDEX_INCR DIRECT AXIS_PTS_Y 4 UWORD INDEX_INCR DIRECT FNC_VALUES 5 UWORD COLUMN_DIR DIRECT /end RECORD_LAYOUT
/begin RECORD_LAYOUT TKW_VV_VV_UB FNC_VALUES 1 UBYTE COLUMN_DIR DIRECT /end RECORD_LAYOUT
/begin RECORD_LAYOUT TKF_UB_UB_UB NO_AXIS_PTS_X 1 UBYTE NO_AXIS_PTS_Y 2 UBYTE AXIS_PTS_X 3 UBYTE INDEX_INCR DIRECT AXIS_PTS_Y 4 UBYTE INDEX_INCR DIRECT FNC_VALUES 5 UBYTE COLUMN_DIR DIRECT /end RECORD_LAYOUT
/begin RECORD_LAYOUT TKF_SW_SW_SW NO_AXIS_PTS_X 1 UBYTE NO_AXIS_PTS_Y 2 UBYTE AXIS_PTS_X 3 SWORD INDEX_INCR DIRECT AXIS_PTS_Y 4 SWORD INDEX_INCR DIRECT FNC_VALUES 5 SWORD COLUMN_DIR DIRECT /end RECORD_LAYOUT
/end MODULE
/end PROJECT
