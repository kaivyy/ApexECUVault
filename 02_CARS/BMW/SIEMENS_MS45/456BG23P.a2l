ASAP2_VERSION 1 31
/begin PROJECT MS45 "BMW Motorsteuerung R6"
/begin HEADER "_default_HeaderComment" PROJECT_NO _56 /end HEADER
/begin MODULE _default_ModuleName "_default_ModuleLongIdentifier"
/begin MOD_COMMON "_default_ModCommonComment" DEPOSIT ABSOLUTE BYTE_ORDER MSB_FIRST ALIGNMENT_BYTE 1 ALIGNMENT_WORD 2 ALIGNMENT_LONG 4 ALIGNMENT_FLOAT32_IEEE 4 ALIGNMENT_FLOAT64_IEEE 8 /end MOD_COMMON
/begin MEASUREMENT cdn_diag_dmtlh "Diagnosis conditions forDMTL Heater" UBYTE _CNV_A_R_LINEAR_____1_CM 1 100. 0. 255. DISPLAY_IDENTIFIER CDN_DIAG_DMTLH ECU_ADDRESS 0x3fe417 FORMAT "%3.0" /end MEASUREMENT
/begin MEASUREMENT lv_err_dmtlh "Logical value for DMTL heater stage error" UBYTE _CNV_S_2_RANGE______2_R_CM 1 100. 0. 255. DISPLAY_IDENTIFIER LV_ERR_DMTLH ECU_ADDRESS 0x3fbab0 /end MEASUREMENT
/begin MEASUREMENT lv_inh_diag_dmtlh "DMTL heater diagnosis: application incidence to inhibit the diagnosis" UBYTE _CNV_S_2_RANGE______0_CM 1 100. 0. 1. DISPLAY_IDENTIFIER LV_INH_DIAG_DMTLH ECU_ADDRESS 0x3fe416 /end MEASUREMENT
/begin MEASUREMENT ctr_det_dmtlh "Diagnosis counter for checksum counter error symptom detection" UBYTE _CNV_A_R_LINEAR_____1_CM 1 100. 0. 255. DISPLAY_IDENTIFIER CTR_DET_DMTLH ECU_ADDRESS 0x3fe418 FORMAT "%3.0" /end MEASUREMENT
/begin MEASUREMENT ctr_ready_dmtlh "Counter for end of diagnosis calculation for DMTL heater" UBYTE _CNV_A_R_LINEAR_____1_CM 1 100. 0. 255. DISPLAY_IDENTIFIER CTR_READY_DMTLH ECU_ADDRESS 0x3fe419 FORMAT "%3.0" /end MEASUREMENT
/begin CHARACTERISTIC c_v_dmtl_max_diag "threshold voltage to recognise short to battery" VALUE 0x0199c _REC_VAL_20_u2 0.4995117190000001 _CNV_A_R_LINEAR_____3_CM 0. 4.99511719 DISPLAY_IDENTIFIER C_V_DMTL_MAX_DIAG FORMAT "%5.3" /end CHARACTERISTIC
/begin CHARACTERISTIC c_t_v_dmtl_max_diag "bounce time for recognise short to battery" VALUE 0x00844 _REC_VAL_20_u1 0.254 _CNV_A_R_LINEAR_____4_CM 1.e-002 2.55 DISPLAY_IDENTIFIER C_T_V_DMTL_MAX_DIAG FORMAT "%4.2" /end CHARACTERISTIC
/begin MEASUREMENT cdn_diag_dmtl_pump "Diagnosis conditions for DMTL Pump" UBYTE _CNV_A_R_LINEAR_____1_CM 1 100. 0. 255. DISPLAY_IDENTIFIER CDN_DIAG_DMTL_PUMP ECU_ADDRESS 0x3fe410 FORMAT "%3.0" /end MEASUREMENT
/begin MEASUREMENT lv_err_dmtl_pump "Error flag, DMTL pump" UBYTE _CNV_S_2_RANGE______2_R_CM 1 100. 0. 255. DISPLAY_IDENTIFIER LV_ERR_DMTL_PUMP ECU_ADDRESS 0x3fba7c /end MEASUREMENT
/begin MEASUREMENT lv_inh_diag_dmtl_pump "DMTL pump diagnosis: application incidence to inhibit the diagnosis" UBYTE _CNV_S_2_RANGE______0_CM 1 100. 0. 1. DISPLAY_IDENTIFIER LV_INH_DIAG_DMTL_PUMP ECU_ADDRESS 0x3fe40f /end MEASUREMENT
/begin MEASUREMENT ctr_det_dmtl_pump "Diagnosis counter for checksum counter error symptom detection" UBYTE _CNV_A_R_LINEAR_____1_CM 1 100. 0. 255. DISPLAY_IDENTIFIER CTR_DET_DMTL_PUMP ECU_ADDRESS 0x3fe411 FORMAT "%3.0" /end MEASUREMENT
/begin MEASUREMENT ctr_ready_dmtl_pump "Counter for end of diagnosis calculation for DMTL pump" UBYTE _CNV_A_R_LINEAR_____1_CM 1 100. 0. 255. DISPLAY_IDENTIFIER CTR_READY_DMTL_PUMP ECU_ADDRESS 0x3fe412 FORMAT "%3.0" /end MEASUREMENT
/begin MEASUREMENT t_v_dmtl_max_diag "debouince time" UBYTE _CNV_A_R_LINEAR_____4_CM 1 100. 0. 2.55 DISPLAY_IDENTIFIER T_V_DMTL_MAX_DIAG ECU_ADDRESS 0x3fe413 FORMAT "%4.2" /end MEASUREMENT
/begin MEASUREMENT cdn_diag_dmtls "Diagnosis conditions for DMTL change over  Valve" UBYTE _CNV_A_R_LINEAR_____1_CM 1 100. 0. 255. DISPLAY_IDENTIFIER CDN_DIAG_DMTLS ECU_ADDRESS 0x3fe40b FORMAT "%3.0" /end MEASUREMENT
/begin MEASUREMENT lv_inh_diag_dmtls "DMTL change-over valve diagnosis: application incidence to inhibit the diagnosis" UBYTE _CNV_S_2_RANGE______0_CM 1 100. 0. 1. DISPLAY_IDENTIFIER LV_INH_DIAG_DMTLS ECU_ADDRESS 0x3fe40a /end MEASUREMENT
/begin MEASUREMENT lv_err_dmtls "Error flag, DMTL change-over valve" UBYTE _CNV_S_2_RANGE______2_R_CM 1 100. 0. 255. DISPLAY_IDENTIFIER LV_ERR_DMTLS ECU_ADDRESS 0x3fba78 /end MEASUREMENT
/begin MEASUREMENT ctr_det_dmtls "Diagnosis counter for checksum counter error symptom detection" UBYTE _CNV_A_R_LINEAR_____1_CM 1 100. 0. 255. DISPLAY_IDENTIFIER CTR_DET_DMTLS ECU_ADDRESS 0x3fe40c FORMAT "%3.0" /end MEASUREMENT
/begin MEASUREMENT ctr_ready_dmtls "Counter for end of diagnosis calculation for DMTL change over valve" UBYTE _CNV_A_R_LINEAR_____1_CM 1 100. 0. 255. DISPLAY_IDENTIFIER CTR_READY_DMTLS ECU_ADDRESS 0x3fe40d FORMAT "%3.0" /end MEASUREMENT
/begin MEASUREMENT cdn_diag_ebox_cfa "Diagnosis conditions for E-Box Cooling FAN" UBYTE _CNV_A_R_LINEAR_____1_CM 1 100. 0. 255. DISPLAY_IDENTIFIER CDN_DIAG_EBOX_CFA ECU_ADDRESS 0x3fe406 FORMAT "%3.0" /end MEASUREMENT
/begin MEASUREMENT ctr_det_ebox_cfa "Diagnosis counter for checksum counter error symptom detection" UBYTE _CNV_A_R_LINEAR_____1_CM 1 100. 0. 255. DISPLAY_IDENTIFIER CTR_DET_EBOX_CFA ECU_ADDRESS 0x3fe407 FORMAT "%3.0" /end MEASUREMENT
/begin MEASUREMENT ctr_ready_ebox_cfa "Counter for end of diagnosis calculation for EBOX_CFA" UBYTE _CNV_A_R_LINEAR_____1_CM 1 100. 0. 255. DISPLAY_IDENTIFIER CTR_READY_EBOX_CFA ECU_ADDRESS 0x3fe408 FORMAT "%3.0" /end MEASUREMENT
/begin MEASUREMENT lv_err_ecras "Boolean for currently present on ECRAS diagnosis" UBYTE _CNV_S_2_RANGE______2_R_CM 1 100. 0. 255. DISPLAY_IDENTIFIER LV_ERR_ECRAS ECU_ADDRESS 0x3fbaac /end MEASUREMENT
/begin MEASUREMENT lv_inh_diag_ecras "ECRAS diagnosis: application incidence to inhibit the diagnosis" UBYTE _CNV_S_2_RANGE______0_CM 1 100. 0. 1. DISPLAY_IDENTIFIER LV_INH_DIAG_ECRAS ECU_ADDRESS 0x3fe432 /end MEASUREMENT
/begin MEASUREMENT cdn_diag_ecras "Diagnosis conditions for electronic. controlled radiator shutter" UBYTE _CNV_A_R_LINEAR_____1_CM 1 100. 0. 255. DISPLAY_IDENTIFIER CDN_DIAG_ECRAS ECU_ADDRESS 0x3fe433 FORMAT "%3.0" /end MEASUREMENT
/begin MEASUREMENT ctr_det_ecras "Diagnosis counter for checksum counter error symptom detection" UBYTE _CNV_A_R_LINEAR_____1_CM 1 100. 0. 255. DISPLAY_IDENTIFIER CTR_DET_ECRAS ECU_ADDRESS 0x3fe434 FORMAT "%3.0" /end MEASUREMENT
/begin MEASUREMENT ctr_ready_ecras "Counter for end of diagnosis calculation for ECRAS" UBYTE _CNV_A_R_LINEAR_____1_CM 1 100. 0. 255. DISPLAY_IDENTIFIER CTR_READY_ECRAS ECU_ADDRESS 0x3fe435 FORMAT "%3.0" /end MEASUREMENT
/begin MEASUREMENT lv_err_rly_st "Status of starter output diagnosis" UBYTE _CNV_S_2_RANGE______2_R_CM 1 100. 0. 255. DISPLAY_IDENTIFIER LV_ERR_RLY_ST ECU_ADDRESS 0x3fba90 /end MEASUREMENT
/begin MEASUREMENT cdn_diag_rly_st "Activation conditions for starter relay" UBYTE _CNV_A_R_LINEAR_____1_CM 1 100. 0. 255. DISPLAY_IDENTIFIER CDN_DIAG_RLY_ST ECU_ADDRESS 0x3fe428 FORMAT "%3.0" /end MEASUREMENT
/begin MEASUREMENT ctr_det_rly_st "Debounce counter for RLY_ST" UBYTE _CNV_A_R_LINEAR_____1_CM 1 100. 0. 255. DISPLAY_IDENTIFIER CTR_DET_RLY_ST ECU_ADDRESS 0x3fe429 FORMAT "%3.0" /end MEASUREMENT
/begin MEASUREMENT lv_inh_diag_rly_st "Inhibit diagnosis starter relay" UBYTE _CNV_S_2_RANGE______0_CM 1 100. 0. 1. DISPLAY_IDENTIFIER LV_INH_DIAG_RLY_ST ECU_ADDRESS 0x3fe427 /end MEASUREMENT
/begin MEASUREMENT ctr_ready_rly_st "Counter for end of diagnosis calculation for RLY_ST" UBYTE _CNV_A_R_LINEAR_____1_CM 1 100. 0. 255. DISPLAY_IDENTIFIER CTR_READY_RLY_ST ECU_ADDRESS 0x3fe42a FORMAT "%3.0" /end MEASUREMENT
/begin MEASUREMENT lv_err_slv_ivvt_in_1 "Error flag solenoid valve of inlet camshaft 1" UBYTE _CNV_S_2_RANGE______2_R_CM 1 100. 0. 255. DISPLAY_IDENTIFIER LV_ERR_SLV_IVVT_IN_1 ECU_ADDRESS 0x3fb880 /end MEASUREMENT
/begin MEASUREMENT lv_err_slv_ivvt_ex_1 "Error flag solenoid valve of exhaust camshaft 1" UBYTE _CNV_S_2_RANGE______2_R_CM 1 100. 0. 255. DISPLAY_IDENTIFIER LV_ERR_SLV_IVVT_EX_1 ECU_ADDRESS 0x3fb884 /end MEASUREMENT
/begin MEASUREMENT lv_inh_diag_slv_ivvt_in_1 "Diagnosis inhibition IVVT_IN" UBYTE _CNV_S_2_RANGE______0_CM 1 100. 0. 1. DISPLAY_IDENTIFIER LV_INH_DIAG_SLV_IVVT_IN_1 ECU_ADDRESS 0x3fdfd6 BIT_MASK 0x1 /end MEASUREMENT
/begin MEASUREMENT cdn_diag_slv_ivvt_ex_1 "Diagnosis condition for each symptom for IVVT_EX" UBYTE _CNV_A_R_LINEAR_____1_CM 1 100. 0. 255. DISPLAY_IDENTIFIER CDN_DIAG_SLV_IVVT_EX_1 ECU_ADDRESS 0x3fdfdc FORMAT "%3.0" /end MEASUREMENT
/begin MEASUREMENT ctr_det_slv_ivvt_ex_1 "Debounce counter for  IVVT_EX" UBYTE _CNV_A_R_LINEAR_____1_CM 1 100. 0. 255. DISPLAY_IDENTIFIER CTR_DET_SLV_IVVT_EX_1 ECU_ADDRESS 0x3fdfdb FORMAT "%3.0" /end MEASUREMENT
/begin MEASUREMENT ctr_ready_slv_ivvt_in_1 "Counter for end of diagnosis calculation for  IVVT_IN" UBYTE _CNV_A_R_LINEAR_____1_CM 1 100. 0. 255. DISPLAY_IDENTIFIER CTR_READY_SLV_IVVT_IN_1 ECU_ADDRESS 0x3fdfda FORMAT "%3.0" /end MEASUREMENT
/begin CHARACTERISTIC c_slv_ivvt_pwm_diag_min_oc "Maximum threshold for OC diagnosis window" VALUE 0x0178a _REC_VAL_20_u2 99.99847412 _CNV_A_R_LINEAR_____9_CM 0. 99.99847412 DISPLAY_IDENTIFIER C_SLV_IVVT_PWM_DIAG_MIN_OC FORMAT "%5.2" /end CHARACTERISTIC
/begin CHARACTERISTIC c_slv_ivvt_pwm_diag_min_scb "Minimum threshold for SCB diagnosis window" VALUE 0x0178c _REC_VAL_20_u2 99.99847412 _CNV_A_R_LINEAR_____9_CM 0. 99.99847412 DISPLAY_IDENTIFIER C_SLV_IVVT_PWM_DIAG_MIN_SCB FORMAT "%5.2" /end CHARACTERISTIC
/begin CHARACTERISTIC c_slv_ivvt_pwm_diag_max_scg "Maximum threshold for SCG diagnosis window" VALUE 0x01788 _REC_VAL_20_u2 99.99847412 _CNV_A_R_LINEAR_____9_CM 0. 99.99847412 DISPLAY_IDENTIFIER C_SLV_IVVT_PWM_DIAG_MAX_SCG FORMAT "%5.2" /end CHARACTERISTIC
/begin MEASUREMENT lv_inh_diag_slv_ivvt_ex_1 "Diagnosis inhibition IVVT_EX" UBYTE _CNV_S_2_RANGE______0_CM 1 100. 0. 1. DISPLAY_IDENTIFIER LV_INH_DIAG_SLV_IVVT_EX_1 ECU_ADDRESS 0x3fdfd7 BIT_MASK 0x1 /end MEASUREMENT
/begin MEASUREMENT cdn_diag_slv_ivvt_in_1 "Diagnosis condition for each symptom for IVVT_IN" UBYTE _CNV_A_R_LINEAR_____1_CM 1 100. 0. 255. DISPLAY_IDENTIFIER CDN_DIAG_SLV_IVVT_IN_1 ECU_ADDRESS 0x3fdfd9 FORMAT "%3.0" /end MEASUREMENT
/begin MEASUREMENT ctr_det_slv_ivvt_in_1 "Debounce counter for  IVVT_IN" UBYTE _CNV_A_R_LINEAR_____1_CM 1 100. 0. 255. DISPLAY_IDENTIFIER CTR_DET_SLV_IVVT_IN_1 ECU_ADDRESS 0x3fdfd8 FORMAT "%3.0" /end MEASUREMENT
/begin MEASUREMENT ctr_ready_slv_ivvt_ex_1 "Counter for end of diagnosis calculation for  IVVT_EX" UBYTE _CNV_A_R_LINEAR_____1_CM 1 100. 0. 255. DISPLAY_IDENTIFIER CTR_READY_SLV_IVVT_EX_1 ECU_ADDRESS 0x3fdfdd FORMAT "%3.0" /end MEASUREMENT
/begin CHARACTERISTIC c_t_max_ecu "time delay to switch off the ECU" VALUE 0x0185e _REC_VAL_20_u2 102.2 _CNV_A_R_LINEAR_____30_CM 1. 1023. DISPLAY_IDENTIFIER C_T_MAX_ECU FORMAT "%4.0" /end CHARACTERISTIC
/begin CHARACTERISTIC lc_sof_conf "Configuration switch for activation logic of sound flap (0 = normal,  1 = inverted)" VALUE 0x00f6f _REC_VAL_20_u1 1. _CNV_A_R_LINEAR_____22_CM 0. 1. DISPLAY_IDENTIFIER LC_SOF_CONF FORMAT "%1.0" /end CHARACTERISTIC
/begin MEASUREMENT v_tps_gain_1 "Actual value of amplified TPS-channel 1" UWORD _CNV_A_R_LINEAR_____3_CM 1 100. 0. 4.99511719 DISPLAY_IDENTIFIER V_TPS_GAIN_1 ECU_ADDRESS 0x3fd318 BYTE_ORDER MSB_LAST FORMAT "%5.3" /end MEASUREMENT
/begin CHARACTERISTIC c_t_max_rest "Time delay after switching on from LV_ST to detect LV_REST" VALUE 0x00822 _REC_VAL_20_u1 25.4 _CNV_A_R_LINEAR_____30_CM 1. 255. DISPLAY_IDENTIFIER C_T_MAX_REST FORMAT "%4.0" /end CHARACTERISTIC
/begin CHARACTERISTIC c_tco_dif_max_rest "Coolant temperature threshold to detect LV_REST" VALUE 0x00864 _REC_VAL_20_u1 0.6 _CNV_A_R_LINEAR_____13_CM 0. 60. DISPLAY_IDENTIFIER C_TCO_DIF_MAX_REST FORMAT "%4.1" /end CHARACTERISTIC
/begin MEASUREMENT t_ast "Time after start" UWORD _CNV_A_R_LINEAR_____24_CM 1 100. 0. 6553.5 DISPLAY_IDENTIFIER T_AST ECU_ADDRESS 0x3fd41a BYTE_ORDER MSB_LAST FORMAT "%6.1" /end MEASUREMENT
/begin MEASUREMENT lv_rest "Auxiliary function \"Re-start\"" UBYTE _CNV_S_2_RANGE______0_CM 1 100. 0. 1. DISPLAY_IDENTIFIER LV_REST ECU_ADDRESS 0x3fe247 BIT_MASK 0x1 /end MEASUREMENT
/begin MEASUREMENT cyc_cast "cycle counter at start and after start" UWORD _CNV_A_R_LINEAR_____1_CM 1 100. 0. 65535. DISPLAY_IDENTIFIER CYC_CAST ECU_ADDRESS 0x3fd41e BYTE_ORDER MSB_LAST FORMAT "%5.0" /end MEASUREMENT
/begin MEASUREMENT t_st_es "Time after transition from LV_ST to LV_ES" UWORD _CNV_A_R_LINEAR_____24_CM 1 100. 0.1 6553.5 DISPLAY_IDENTIFIER T_ST_ES ECU_ADDRESS 0x3fd422 BYTE_ORDER MSB_LAST FORMAT "%6.1" /end MEASUREMENT
/begin CHARACTERISTIC c_t_min_ecu_rest "Time threshold to detect new start after start-break off." VALUE 0x01874 _REC_VAL_20_u2 6553.400000000001 _CNV_A_R_LINEAR_____24_CM 0.1 6553.5 DISPLAY_IDENTIFIER C_T_MIN_ECU_REST FORMAT "%6.1" /end CHARACTERISTIC
/begin CHARACTERISTIC c_cyc_cast_min_st_es "Min value of CYC_CAST for the detection of  LV_ST_ES" VALUE 0x0151a _REC_VAL_20_u2 65535. _CNV_A_R_LINEAR_____1_CM 0. 65535. DISPLAY_IDENTIFIER C_CYC_CAST_MIN_ST_ES FORMAT "%5.0" /end CHARACTERISTIC
/begin MEASUREMENT lv_st_es "Detection of engine start break off (passive / active)" UBYTE _CNV_S_2_RANGE______0_CM 1 100. 0. 1. DISPLAY_IDENTIFIER LV_ST_ES ECU_ADDRESS 0x3fe248 /end MEASUREMENT
/begin MEASUREMENT lv_stall "Auxiliary function \"Engine Stall detected\"" UBYTE _CNV_S_2_RANGE______0_CM 1 100. 0. 1. DISPLAY_IDENTIFIER LV_STALL ECU_ADDRESS 0x3fe246 /end MEASUREMENT
/begin MEASUREMENT t_ast_rest "After start time for re-start" UWORD _CNV_A_R_LINEAR_____24_CM 1 100. 0. 6553.5 DISPLAY_IDENTIFIER T_AST_REST ECU_ADDRESS 0x3fd41c BYTE_ORDER MSB_LAST FORMAT "%6.1" /end MEASUREMENT
/begin CHARACTERISTIC c_cyc_cast_max_st_es "Max value of CYC_CAST for the beginning of  incrementation if LV_ST_ES is set" VALUE 0x01518 _REC_VAL_20_u2 65535. _CNV_A_R_LINEAR_____1_CM 0. 65535. DISPLAY_IDENTIFIER C_CYC_CAST_MAX_ST_ES FORMAT "%5.0" /end CHARACTERISTIC
/begin CHARACTERISTIC c_n_max_fl_dly "Maximum engine speed for Full load recognition" VALUE 0x00773 _REC_VAL_20_u1 8160. _CNV_A_R_LINEAR_____16_CM 0. 8160. DISPLAY_IDENTIFIER C_N_MAX_FL_DLY FORMAT "%4.0" /end CHARACTERISTIC
/begin CHARACTERISTIC c_n_min_fl_dly "Minimum engine speed for Full load recognition" VALUE 0x00781 _REC_VAL_20_u1 8160. _CNV_A_R_LINEAR_____16_CM 0. 8160. DISPLAY_IDENTIFIER C_N_MIN_FL_DLY FORMAT "%4.0" /end CHARACTERISTIC
/begin CHARACTERISTIC c_t_max_fl_dly "Time after Start- Threshold value for Full load recognition" VALUE 0x01860 _REC_VAL_20_u2 6553.5 _CNV_A_R_LINEAR_____24_CM 0. 6553.5 DISPLAY_IDENTIFIER C_T_MAX_FL_DLY FORMAT "%5.1" /end CHARACTERISTIC
/begin CHARACTERISTIC c_t_ti_dly_fl_2 "Delay time Full load" VALUE 0x018b4 _REC_VAL_20_u2 655.35 _CNV_A_R_LINEAR_____4_CM 0. 655.35 DISPLAY_IDENTIFIER C_T_TI_DLY_FL_2 FORMAT "%6.2" /end CHARACTERISTIC
/begin CHARACTERISTIC c_t_ti_dly_fl_at_1 "Delay time Full load AT" VALUE 0x018b6 _REC_VAL_20_u2 655.35 _CNV_A_R_LINEAR_____4_CM 0. 655.35 DISPLAY_IDENTIFIER C_T_TI_DLY_FL_AT_1 FORMAT "%6.2" /end CHARACTERISTIC
/begin CHARACTERISTIC c_t_ti_dly_fl_at_2 "Delay time Full load AT" VALUE 0x018b8 _REC_VAL_20_u2 655.35 _CNV_A_R_LINEAR_____4_CM 0. 655.35 DISPLAY_IDENTIFIER C_T_TI_DLY_FL_AT_2 FORMAT "%6.2" /end CHARACTERISTIC
/begin CHARACTERISTIC c_tco_min_fl "Minimum temperature for FL" VALUE 0x00887 _REC_VAL_20_u1 28.575 _CNV_A_R_LINEAR_____12_CM -48. 142.5 DISPLAY_IDENTIFIER C_TCO_MIN_FL FORMAT "%5.1" /end CHARACTERISTIC
/begin CHARACTERISTIC c_vs_min_fl "Minimum velocity for FL" VALUE 0x00959 _REC_VAL_20_u1 25.5 _CNV_A_R_LINEAR_____23_CM 0. 255. DISPLAY_IDENTIFIER C_VS_MIN_FL FORMAT "%3.0" /end CHARACTERISTIC
/begin MEASUREMENT lv_fl_raw "LV condition a) is fullfilled" UBYTE _CNV_S_2_RANGE______0_CM 1 100. 0. 1. DISPLAY_IDENTIFIER LV_FL_RAW ECU_ADDRESS 0x3fe24a /end MEASUREMENT
/begin MEASUREMENT lv_ti_ris "Basic function \"Reactivation fuel feed at idle\"" UBYTE _CNV_S_2_RANGE______5_CM 1 100. 0. 1. DISPLAY_IDENTIFIER LV_TI_RIS ECU_ADDRESS 0x3fe24c /end MEASUREMENT
/begin MEASUREMENT lv_ti_rpu "Basic function \"Reactivation fuel feed at trailing throttle\"" UBYTE _CNV_S_2_RANGE______5_CM 1 100. 0. 1. DISPLAY_IDENTIFIER LV_TI_RPU ECU_ADDRESS 0x3fe24d /end MEASUREMENT
/begin MEASUREMENT lv_ti_rpl "Basic function \"Reactivation fuel feed at part load\"" UBYTE _CNV_S_2_RANGE______5_CM 1 100. 0. 1. DISPLAY_IDENTIFIER LV_TI_RPL ECU_ADDRESS 0x3fe24e /end MEASUREMENT
/begin MEASUREMENT lv_ti_rae "Basic function \"Reactivation fuel feed at acceleration enrichment\"" UBYTE _CNV_S_2_RANGE______5_CM 1 100. 0. 1. DISPLAY_IDENTIFIER LV_TI_RAE ECU_ADDRESS 0x3fe24f /end MEASUREMENT
/begin MEASUREMENT lv_fl "Basic function FL" UBYTE _CNV_S_2_RANGE______5_CM 1 100. 0. 1. DISPLAY_IDENTIFIER LV_FL ECU_ADDRESS 0x3fe249 BIT_MASK 0x1 /end MEASUREMENT
/begin CHARACTERISTIC c_n_min_fl "Minimum engine speed for FL" VALUE 0x00780 _REC_VAL_20_u1 816. _CNV_A_R_LINEAR_____16_CM 0. 8160. DISPLAY_IDENTIFIER C_N_MIN_FL FORMAT "%4.0" /end CHARACTERISTIC
/begin CHARACTERISTIC c_t_min_fl_dly "Time after Start- Threshold for Full load recognition" VALUE 0x01876 _REC_VAL_20_u2 6553.5 _CNV_A_R_LINEAR_____24_CM 0. 6553.5 DISPLAY_IDENTIFIER C_T_MIN_FL_DLY FORMAT "%5.1" /end CHARACTERISTIC
/begin MEASUREMENT lv_inf "Basic function \" Intercept \"" UBYTE _CNV_S_2_RANGE______0_CM 1 100. 0. 1. DISPLAY_IDENTIFIER LV_INF ECU_ADDRESS 0x3fe24b BIT_MASK 0x1 /end MEASUREMENT
/begin MEASUREMENT lv_ti_reac "Basic function \"Reactivation fuel feed\"" UBYTE _CNV_S_2_RANGE______5_CM 1 100. 0. 1. DISPLAY_IDENTIFIER LV_TI_REAC ECU_ADDRESS 0x3fe251 /end MEASUREMENT
/begin CHARACTERISTIC c_t_ti_dly_fl_1 "Delay time Full load" VALUE 0x018b2 _REC_VAL_20_u2 655.35 _CNV_A_R_LINEAR_____4_CM 0. 655.35 DISPLAY_IDENTIFIER C_T_TI_DLY_FL_1 FORMAT "%6.2" /end CHARACTERISTIC
/begin CHARACTERISTIC c_n_min_cp_fl "Minimum engine speed for FL at high canister purge load" VALUE 0x0077e _REC_VAL_20_u1 8160. _CNV_A_R_LINEAR_____16_CM 0. 8160. DISPLAY_IDENTIFIER C_N_MIN_CP_FL FORMAT "%4.0" /end CHARACTERISTIC
/begin CHARACTERISTIC c_cl_mmv_thd_fl "threshold for high canister load" VALUE 0x014be _REC_VAL_20_u2 1.99996948 _CNV_A_R_LINEAR_____21_CM 0. 1.99996948 DISPLAY_IDENTIFIER C_CL_MMV_THD_FL FORMAT "%7.5" /end CHARACTERISTIC
/begin CHARACTERISTIC ip_pv_max_fl__n "PWG-demand for Full load recognition" CURVE 0x06bbb _REC_CUR_20_u1_u2 9.9609375 _CNV_A_R_LINEAR_____10_CM 0. 99.609375 DISPLAY_IDENTIFIER IP_PV_MAX_FL__N FORMAT "%5.2"
 /begin AXIS_DESCR COM_AXIS n _CNV_A_R_LINEAR_____11_CM 16 0. 8160. FORMAT "%4.0" AXIS_PTS_REF ldpm_n_2_3 /end AXIS_DESCR
/end CHARACTERISTIC
/begin AXIS_PTS ldpm_n_2_3 "" 0x118c0 n _REC_AXS_20_u2 816. _CNV_A_R_LINEAR_____11_CM 16 0. 8160. DISPLAY_IDENTIFIER LDPM_N_2_3 FORMAT "%4.0" /end AXIS_PTS
/begin CHARACTERISTIC c_n_grd_min "engine speed  gradient threshold for activating the intercept function" VALUE 0x0038e _REC_VAL_20_s1 204.8 _CNV_A_R_LINEAR_____51_CM -4096. 0. DISPLAY_IDENTIFIER C_N_GRD_MIN FORMAT "%7.0" /end CHARACTERISTIC
/begin CHARACTERISTIC id_tps_grd_bol_ae__n__tps_av "Throttle position gradient threshold" MAP 0x04086 _REC_MAP_20_u1_u1_u2 298.75 _CNV_A_R_LINEAR_____52_CM 0. 2987.5 DISPLAY_IDENTIFIER ID_TPS_GRD_BOL_AE__N__TPS_AV FORMAT "%4.0"
 /begin AXIS_DESCR COM_AXIS n_32 _CNV_A_R_LINEAR_____16_CM 6 0. 8160. FORMAT "%4.0" AXIS_PTS_REF ldp_n_23 /end AXIS_DESCR
 /begin AXIS_DESCR COM_AXIS tps_av _CNV_A_R_LINEAR_____53_CM 4 0. 119.5 FORMAT "%7.3" AXIS_PTS_REF ldp_tps_av_id_tps_grd_bol_ae /end AXIS_DESCR
/end CHARACTERISTIC
/begin AXIS_PTS ldp_n_23 "" 0x0100a n_32 _REC_AXS_20_u1 816. _CNV_A_R_LINEAR_____16_CM 6 0. 8160. DISPLAY_IDENTIFIER LDP_N_23 FORMAT "%4.0" /end AXIS_PTS
/begin AXIS_PTS ldp_tps_av_id_tps_grd_bol_ae "" 0x1125e tps_av _REC_AXS_20_u2 11.95 _CNV_A_R_LINEAR_____53_CM 4 0. 119.5 DISPLAY_IDENTIFIER LDP_TPS_AV_ID_TPS_GRD_BOL_AE FORMAT "%7.3" /end AXIS_PTS
/begin AXIS_PTS ldp_n_grd_n_max_inf "" 0x010ce n_grd _REC_AXS_20_u1 4096. _CNV_A_R_LINEAR_____54_CM 6 -4096. 0. DISPLAY_IDENTIFIER LDP_N_GRD_N_MAX_INF FORMAT "%5.0" /end AXIS_PTS
/begin CHARACTERISTIC ip_n_max_inf "Maximum engine speed for intercept function" CURVE 0x00d20 _REC_CUR_20_u1_u1 8160. _CNV_A_R_LINEAR_____16_CM 0. 8160. DISPLAY_IDENTIFIER IP_N_MAX_INF FORMAT "%4.0"
 /begin AXIS_DESCR COM_AXIS n_grd _CNV_A_R_LINEAR_____54_CM 6 -4096. 0. FORMAT "%5.0" AXIS_PTS_REF ldp_n_grd_n_max_inf /end AXIS_DESCR
/end CHARACTERISTIC
/begin MEASUREMENT lv_err_locan_boff "present error LOCAN bus off" UBYTE _CNV_S_2_RANGE______2_R_CM 1 100. 0. 255. DISPLAY_IDENTIFIER LV_ERR_LOCAN_BOFF ECU_ADDRESS 0x3fbb1c /end MEASUREMENT
/begin MEASUREMENT cyc_ctr_efp_diag "counter of not received EFP messages" UBYTE _CNV_A_R_LINEAR_____1_CM 1 100. 0. 255. DISPLAY_IDENTIFIER CYC_CTR_EFP_DIAG ECU_ADDRESS 0x3fde31 FORMAT "%3.0" /end MEASUREMENT
/begin CHARACTERISTIC c_efp_cycnr_max "maximumnumber of missing EFP messages for error debounce counter increment" VALUE 0x006b6 _REC_VAL_20_u1 254. _CNV_A_R_LINEAR_____1_CM 1. 255. DISPLAY_IDENTIFIER C_EFP_CYCNR_MAX FORMAT "%3.0" /end CHARACTERISTIC
/begin MEASUREMENT lv_err_efp "logical variable error in case of EFP self diagnosis" UBYTE _CNV_S_2_RANGE______2_R_CM 1 100. 0. 255. DISPLAY_IDENTIFIER LV_ERR_EFP ECU_ADDRESS 0x3fbb18 /end MEASUREMENT
/begin MEASUREMENT lv_err_efp_crash "logical variable error in case of crash switch off EFP" UBYTE _CNV_S_2_RANGE______2_R_CM 1 100. 0. 255. DISPLAY_IDENTIFIER LV_ERR_EFP_CRASH ECU_ADDRESS 0x3fbb14 /end MEASUREMENT
/begin MEASUREMENT lv_err_tout_efp "logical variable timeout error CAN message EKP" UBYTE _CNV_S_2_RANGE______2_R_CM 1 100. 0. 255. DISPLAY_IDENTIFIER LV_ERR_TOUT_EFP ECU_ADDRESS 0x3fba9c /end MEASUREMENT
/begin MEASUREMENT lv_ti_ch "Auxiliary Function \" Catalyst Heating Injection\"." UBYTE _CNV_S_2_RANGE______0_CM 1 100. 0. 1. DISPLAY_IDENTIFIER LV_TI_CH ECU_ADDRESS 0x3fe257 BIT_MASK 0x1 /end MEASUREMENT
/begin MEASUREMENT lv_ch "Auxiliary Function \" Catalyst Heating Spark\"." UBYTE _CNV_S_2_RANGE______5_CM 1 100. 0. 1. DISPLAY_IDENTIFIER LV_CH ECU_ADDRESS 0x3fe256 BIT_MASK 0x1 /end MEASUREMENT
/begin MEASUREMENT lv_ch_tq_add "Catalyst Heating Function \"torque reserve\" (late ignition angle)" UBYTE _CNV_S_2_RANGE______5_CM 1 100. 0. 1. DISPLAY_IDENTIFIER LV_CH_TQ_ADD ECU_ADDRESS 0x3fe252 BIT_MASK 0x1 /end MEASUREMENT
/begin MEASUREMENT lv_ch_tq_add_is "Catalyst Heating Function \"torque reserve for first idle phases\"" UBYTE _CNV_S_2_RANGE______5_CM 1 100. 0. 1. DISPLAY_IDENTIFIER LV_CH_TQ_ADD_IS ECU_ADDRESS 0x3fe253 BIT_MASK 0x1 /end MEASUREMENT
/begin MEASUREMENT lv_ch_n_sp_is "Catalyst Heating Function \"increased idle speed setpoint\"" UBYTE _CNV_S_2_RANGE______5_CM 1 100. 0. 1. DISPLAY_IDENTIFIER LV_CH_N_SP_IS ECU_ADDRESS 0x3fe254 BIT_MASK 0x1 /end MEASUREMENT
/begin MEASUREMENT lv_ch_ivvt "Catalyst Heating Function \"increased valve overlap\"" UBYTE _CNV_S_2_RANGE______5_CM 1 100. 0. 1. DISPLAY_IDENTIFIER LV_CH_IVVT ECU_ADDRESS 0x3fe255 BIT_MASK 0x1 /end MEASUREMENT
/begin CHARACTERISTIC ip_t_ch_n_sp_is "Activation time for CAT heating function 'idle speed setpoint'" MAP 0x0ddc6 _REC_MAP_20_u2_u1_u2 6553.5 _CNV_A_R_LINEAR_____24_CM 0. 6553.5 DISPLAY_IDENTIFIER IP_T_CH_N_SP_IS FORMAT "%6.1"
 /begin AXIS_DESCR COM_AXIS tco _CNV_A_R_LINEAR_____12_CM 8 -48. 142.5 FORMAT "%5.1" AXIS_PTS_REF ldpm_tco_2 /end AXIS_DESCR
 /begin AXIS_DESCR COM_AXIS ctr_km_can _CNV_A_R_LINEAR_____88_CM 4 0. 655350. FORMAT "%7.0" AXIS_PTS_REF ldpm_ctr_km_can_1 /end AXIS_DESCR
/end CHARACTERISTIC
/begin CHARACTERISTIC id_t_ch_ti "Activation time after start to switch on the injection time correction for catalyst heating" CURVE 0x089ac _REC_CUR_20_u2_u1 6553.5 _CNV_A_R_LINEAR_____24_CM 0. 6553.5 DISPLAY_IDENTIFIER ID_T_CH_TI FORMAT "%6.1"
 /begin AXIS_DESCR COM_AXIS tco _CNV_A_R_LINEAR_____12_CM 8 -48. 142.5 FORMAT "%5.1" AXIS_PTS_REF ldpm_tco_2 /end AXIS_DESCR
/end CHARACTERISTIC
/begin CHARACTERISTIC c_vs_max_ch_ivvt "Threshold for temporary abortion of CAT heating function 'VANOS'" VALUE 0x00949 _REC_VAL_20_u1 255. _CNV_A_R_LINEAR_____23_CM 0. 255. DISPLAY_IDENTIFIER C_VS_MAX_CH_IVVT FORMAT "%3.0" /end CHARACTERISTIC
/begin MEASUREMENT lv_wup "Warm up functions active" UBYTE _CNV_S_2_RANGE______5_CM 1 100. 0. 1. DISPLAY_IDENTIFIER LV_WUP ECU_ADDRESS 0x3fe258 BIT_MASK 0x1 /end MEASUREMENT
/begin CHARACTERISTIC ip_t_ch_ivvt "Activation time for CAT heating function 'VANOS'" MAP 0x0dd86 _REC_MAP_20_u2_u1_u2 6553.5 _CNV_A_R_LINEAR_____24_CM 0. 6553.5 DISPLAY_IDENTIFIER IP_T_CH_IVVT FORMAT "%6.1"
 /begin AXIS_DESCR COM_AXIS tco _CNV_A_R_LINEAR_____12_CM 8 -48. 142.5 FORMAT "%5.1" AXIS_PTS_REF ldpm_tco_2 /end AXIS_DESCR
 /begin AXIS_DESCR COM_AXIS ctr_km_can _CNV_A_R_LINEAR_____88_CM 4 0. 655350. FORMAT "%7.0" AXIS_PTS_REF ldpm_ctr_km_can_1 /end AXIS_DESCR
/end CHARACTERISTIC
/begin CHARACTERISTIC c_vs_max_ch_tq_add_is "Threshold for final abortion of CAT heating functions 'IGA at first idle phases' and 'VANOS'" VALUE 0x0094b _REC_VAL_20_u1 255. _CNV_A_R_LINEAR_____23_CM 0. 255. DISPLAY_IDENTIFIER C_VS_MAX_CH_TQ_ADD_IS FORMAT "%3.0" /end CHARACTERISTIC
/begin CHARACTERISTIC c_vs_max_ch_n_sp_is "Threshold for final abortion of CAT heating functions 'Catalyst heating increased idle speed setpoint'" VALUE 0x0094a _REC_VAL_20_u1 255. _CNV_A_R_LINEAR_____23_CM 0. 255. DISPLAY_IDENTIFIER C_VS_MAX_CH_N_SP_IS FORMAT "%3.0" /end CHARACTERISTIC
/begin AXIS_PTS ldpm_tco_2 "" 0x081ae tco _REC_AXS_20_u1 190.5 _CNV_A_R_LINEAR_____12_CM 8 -48. 142.5 DISPLAY_IDENTIFIER LDPM_TCO_2 FORMAT "%5.1" /end AXIS_PTS
/begin CHARACTERISTIC ip_t_ch_tq_add "Activation time for CAT heating function 'IGA'" MAP 0x0de06 _REC_MAP_20_u2_u1_u2 6553.5 _CNV_A_R_LINEAR_____24_CM 0. 6553.5 DISPLAY_IDENTIFIER IP_T_CH_TQ_ADD FORMAT "%6.1"
 /begin AXIS_DESCR COM_AXIS tco _CNV_A_R_LINEAR_____12_CM 8 -48. 142.5 FORMAT "%5.1" AXIS_PTS_REF ldpm_tco_2 /end AXIS_DESCR
 /begin AXIS_DESCR COM_AXIS ctr_km_can _CNV_A_R_LINEAR_____88_CM 4 0. 655350. FORMAT "%7.0" AXIS_PTS_REF ldpm_ctr_km_can_1 /end AXIS_DESCR
/end CHARACTERISTIC
/begin CHARACTERISTIC ip_t_ch_tq_add_wout_cat "Activation time for CAT heating function 'IGA', vehicle variant without catalyst" MAP 0x0dec6 _REC_MAP_20_u2_u1_u2 6553.5 _CNV_A_R_LINEAR_____24_CM 0. 6553.5 DISPLAY_IDENTIFIER IP_T_CH_TQ_ADD_WOUT_CAT FORMAT "%6.1"
 /begin AXIS_DESCR COM_AXIS tco _CNV_A_R_LINEAR_____12_CM 8 -48. 142.5 FORMAT "%5.1" AXIS_PTS_REF ldpm_tco_2 /end AXIS_DESCR
 /begin AXIS_DESCR COM_AXIS ctr_km_can _CNV_A_R_LINEAR_____88_CM 4 0. 655350. FORMAT "%7.0" AXIS_PTS_REF ldpm_ctr_km_can_1 /end AXIS_DESCR
/end CHARACTERISTIC
/begin CHARACTERISTIC ip_t_ch_tq_add_is "Activation time for CAT heating function 'IGA at first idle phases'" MAP 0x0de46 _REC_MAP_20_u2_u1_u2 6553.5 _CNV_A_R_LINEAR_____24_CM 0. 6553.5 DISPLAY_IDENTIFIER IP_T_CH_TQ_ADD_IS FORMAT "%6.1"
 /begin AXIS_DESCR COM_AXIS tco _CNV_A_R_LINEAR_____12_CM 8 -48. 142.5 FORMAT "%5.1" AXIS_PTS_REF ldpm_tco_2 /end AXIS_DESCR
 /begin AXIS_DESCR COM_AXIS ctr_km_can _CNV_A_R_LINEAR_____88_CM 4 0. 655350. FORMAT "%7.0" AXIS_PTS_REF ldpm_ctr_km_can_1 /end AXIS_DESCR
/end CHARACTERISTIC
/begin CHARACTERISTIC ip_t_ch_tq_add_is_wout_cat "Activation time for CAT heating function 'IGA at first idle phases', vehicle variant without catalyst" MAP 0x0de86 _REC_MAP_20_u2_u1_u2 6553.5 _CNV_A_R_LINEAR_____24_CM 0. 6553.5 DISPLAY_IDENTIFIER IP_T_CH_TQ_ADD_IS_WOUT_CAT FORMAT "%6.1"
 /begin AXIS_DESCR COM_AXIS tco _CNV_A_R_LINEAR_____12_CM 8 -48. 142.5 FORMAT "%5.1" AXIS_PTS_REF ldpm_tco_2 /end AXIS_DESCR
 /begin AXIS_DESCR COM_AXIS ctr_km_can _CNV_A_R_LINEAR_____88_CM 4 0. 655350. FORMAT "%7.0" AXIS_PTS_REF ldpm_ctr_km_can_1 /end AXIS_DESCR
/end CHARACTERISTIC
/begin MEASUREMENT lv_clc_2seg "" UBYTE _CNV_S_2_RANGE______5_CM 1 100. 0. 1. DISPLAY_IDENTIFIER LV_CLC_2SEG ECU_ADDRESS 0x3fe26b BIT_MASK 0x1 /end MEASUREMENT
/begin MEASUREMENT lv_clc_2seg_ena "" UBYTE _CNV_S_2_RANGE______5_CM 1 100. 0. 1. DISPLAY_IDENTIFIER LV_CLC_2SEG_ENA ECU_ADDRESS 0x3fe26a BIT_MASK 0x1 /end MEASUREMENT
/begin CHARACTERISTIC c_n_seg_2_ena "" VALUE 0x00789 _REC_VAL_20_u1 8160. _CNV_A_R_LINEAR_____16_CM 0. 8160. DISPLAY_IDENTIFIER C_N_SEG_2_ENA FORMAT "%4.0" /end CHARACTERISTIC
/begin MEASUREMENT lv_dcc_off_ecu "Irreversible DCC error" UBYTE _CNV_S_2_RANGE______0_CM 1 100. 0. 1. DISPLAY_IDENTIFIER LV_DCC_OFF_ECU ECU_ADDRESS 0x3fe4c4 /end MEASUREMENT
/begin MEASUREMENT t_dcc_brake_det "Brake delay timer" UBYTE _CNV_A_R_LINEAR_____4_CM 1 100. 0. 2.55 DISPLAY_IDENTIFIER T_DCC_BRAKE_DET ECU_ADDRESS 0x3fe4c5 FORMAT "%4.2" /end MEASUREMENT
/begin CHARACTERISTIC c_t_max_brake_det_dcc "Maximum Brake delay timer" VALUE 0x0081a _REC_VAL_20_u1 2.55 _CNV_A_R_LINEAR_____4_CM 0. 2.55 DISPLAY_IDENTIFIER C_T_MAX_BRAKE_DET_DCC FORMAT "%4.2" /end CHARACTERISTIC
/begin MEASUREMENT lv_err_dcc "DCC error" UBYTE _CNV_S_2_RANGE______2_R_CM 1 100. 0. 255. DISPLAY_IDENTIFIER LV_ERR_DCC ECU_ADDRESS 0x3fbaa8 /end MEASUREMENT
/begin CHARACTERISTIC c_maf_cs_diag "MAF threshold for error detection" VALUE 0x01640 _REC_VAL_20_u2 1389. _CNV_A_R_LINEAR_____106_CM 0. 1389. DISPLAY_IDENTIFIER C_MAF_CS_DIAG FORMAT "%7.2" /end CHARACTERISTIC
/begin CHARACTERISTIC c_n_32_cs_diag "N32 threshold for error detection" VALUE 0x0074f _REC_VAL_20_u1 8160. _CNV_A_R_LINEAR_____16_CM 0. 8160. DISPLAY_IDENTIFIER C_N_32_CS_DIAG FORMAT "%4.0" /end CHARACTERISTIC
/begin MEASUREMENT lv_err_cs "Active CS error" UBYTE _CNV_A_R_LINEAR_____22_CM 1 100. 0. 1. DISPLAY_IDENTIFIER LV_ERR_CS ECU_ADDRESS 0x3fbab4 FORMAT "%1.0" /end MEASUREMENT
/begin MEASUREMENT lv_cs_diag "Flag set when vehicle was stopped = pre-condition for diagnosis cycle" UBYTE _CNV_A_R_LINEAR_____22_CM 1 100. 0. 1. DISPLAY_IDENTIFIER LV_CS_DIAG ECU_ADDRESS 0x3fe48c FORMAT "%1.0" /end MEASUREMENT
/begin MEASUREMENT lv_cs_swi "Flag set when CS change its state" UBYTE _CNV_A_R_LINEAR_____22_CM 1 100. 0. 1. DISPLAY_IDENTIFIER LV_CS_SWI ECU_ADDRESS 0x3fe48d FORMAT "%1.0" /end MEASUREMENT
/begin MEASUREMENT t_min_maf_cs_diag "Minimum diagnosis time for MAF condition" UBYTE _CNV_A_R_LINEAR_____30_CM 1 100. 0. 255. DISPLAY_IDENTIFIER T_MIN_MAF_CS_DIAG ECU_ADDRESS 0x3fe48b FORMAT "%3.0" /end MEASUREMENT
/begin CHARACTERISTIC c_vs_cs_diag "Speed threshold for activation of diagnosis cycle" VALUE 0x0093d _REC_VAL_20_u1 255. _CNV_A_R_LINEAR_____23_CM 0. 255. DISPLAY_IDENTIFIER C_VS_CS_DIAG FORMAT "%3.0" /end CHARACTERISTIC
/begin CHARACTERISTIC c_t_min_maf_cs_diag "Minimum diagnosis time for MAF condition" VALUE 0x00829 _REC_VAL_20_u1 255. _CNV_A_R_LINEAR_____30_CM 0. 255. DISPLAY_IDENTIFIER C_T_MIN_MAF_CS_DIAG FORMAT "%3.0" /end CHARACTERISTIC
/begin MEASUREMENT iso_m6_diag_ram_com.m6_cur_dmtl_cor_fil_cid18 "" UWORD _CNV_A_R_LINEAR_____167_CM 1 100. 0. 400. DISPLAY_IDENTIFIER M6_CUR_DMTL_COR_FIL_CID18 ECU_ADDRESS 0x3fd69c BYTE_ORDER MSB_LAST FORMAT "%7.3" /end MEASUREMENT
/begin MEASUREMENT iso_m6_diag_ram_com.m6_cur_dmtl_cor_fil_cid19 "" UWORD _CNV_A_R_LINEAR_____167_CM 1 100. 0. 400. DISPLAY_IDENTIFIER M6_CUR_DMTL_COR_FIL_CID19 ECU_ADDRESS 0x3fd6a0 BYTE_ORDER MSB_LAST FORMAT "%7.3" /end MEASUREMENT
/begin MEASUREMENT iso_m6_diag_ram_com.m6_cur_dmtl_dmtls_test "" UWORD _CNV_A_R_LINEAR_____167_CM 1 100. 0. 400. DISPLAY_IDENTIFIER M6_CUR_DMTL_DMTLS_TEST ECU_ADDRESS 0x3fd6a4 BYTE_ORDER MSB_LAST FORMAT "%7.3" /end MEASUREMENT
/begin MEASUREMENT iso_m6_diag_ram_com.m6_cur_dmtl_thd_dmtls_test "" UWORD _CNV_A_R_LINEAR_____167_CM 1 100. 0. 400. DISPLAY_IDENTIFIER M6_CUR_DMTL_THD_DMTLS_TEST ECU_ADDRESS 0x3fd6a6 BYTE_ORDER MSB_LAST FORMAT "%7.3" /end MEASUREMENT
/begin MEASUREMENT iso_m6_diag_ram_com.m6_cur_dmtl_rough_leak_end "" UWORD _CNV_A_R_LINEAR_____167_CM 1 100. 0. 400. DISPLAY_IDENTIFIER M6_CUR_DMTL_ROUGH_LEAK_END ECU_ADDRESS 0x3fd6a8 BYTE_ORDER MSB_LAST FORMAT "%7.3" /end MEASUREMENT
/begin MEASUREMENT iso_m6_diag_ram_com.m6_cur_dmtl_thd_rough_leak "" UWORD _CNV_A_R_LINEAR_____167_CM 1 100. 0. 400. DISPLAY_IDENTIFIER M6_CUR_DMTL_THD_ROUGH_LEAK ECU_ADDRESS 0x3fd6aa BYTE_ORDER MSB_LAST FORMAT "%7.3" /end MEASUREMENT
/begin MEASUREMENT iso_m6_diag_ram_com.m6_cur_dmtl_small_leak_end "" UWORD _CNV_A_R_LINEAR_____167_CM 1 100. 0. 400. DISPLAY_IDENTIFIER M6_CUR_DMTL_SMALL_LEAK_END ECU_ADDRESS 0x3fd6ac BYTE_ORDER MSB_LAST FORMAT "%7.3" /end MEASUREMENT
/begin MEASUREMENT iso_m6_diag_ram_com.m6_cur_dmtl_ref_leak "" UWORD _CNV_A_R_LINEAR_____167_CM 1 100. 0. 400. DISPLAY_IDENTIFIER M6_CUR_DMTL_REF_LEAK ECU_ADDRESS 0x3fd6ae BYTE_ORDER MSB_LAST FORMAT "%7.3" /end MEASUREMENT
/begin MEASUREMENT iso_m6_diag_ram_com.m6_cur_dmtl_rough_leak_len_end "" UWORD _CNV_A_R_LINEAR_____167_CM 1 100. 0. 400. DISPLAY_IDENTIFIER M6_CUR_DMTL_ROUGH_LEAK_LEN_END ECU_ADDRESS 0x3fd6b4 BYTE_ORDER MSB_LAST FORMAT "%7.3" /end MEASUREMENT
/begin MEASUREMENT iso_m6_diag_ram_com.m6_cur_dmtl_thd_rough_leak_len "" UWORD _CNV_A_R_LINEAR_____167_CM 1 100. 0. 400. DISPLAY_IDENTIFIER M6_CUR_DMTL_THD_ROUGH_LEAK_LEN ECU_ADDRESS 0x3fd6b6 BYTE_ORDER MSB_LAST FORMAT "%7.3" /end MEASUREMENT
/begin MEASUREMENT iso_m6_diag_ram_com.m6_ctr_cnl_small_leak_mes "" UBYTE _CNV_A_R_LINEAR_____1_CM 1 100. 0. 255. DISPLAY_IDENTIFIER M6_CTR_CNL_SMALL_LEAK_MES ECU_ADDRESS 0x3fd6b0 FORMAT "%3.0" /end MEASUREMENT
/begin MEASUREMENT lv_err_ecu_ram "Present error flag ECU_RAM" UBYTE _CNV_S_2_RANGE______2_R_CM 1 100. 0. 255. DISPLAY_IDENTIFIER LV_ERR_ECU_RAM ECU_ADDRESS 0x3fba68 BIT_MASK 0x1 /end MEASUREMENT
/begin MEASUREMENT lv_err_ecu_cks "ECU_CKS error detected" UBYTE _CNV_S_2_RANGE______2_R_CM 1 100. 0. 255. DISPLAY_IDENTIFIER LV_ERR_ECU_CKS ECU_ADDRESS 0x3fb890 BIT_MASK 0x1 /end MEASUREMENT
/begin MEASUREMENT lv_err_ecu_nvmy "Present ECU NVMY error" UBYTE _CNV_S_2_RANGE______2_R_CM 1 100. 0. 255. DISPLAY_IDENTIFIER LV_ERR_ECU_NVMY ECU_ADDRESS 0x3fbb38 BIT_MASK 0x1 /end MEASUREMENT
/begin MEASUREMENT lv_mu_inh_pwl_tran_es_el "LV request to shut off MU, POINT OF NO RETURN, for ECU shut down" UBYTE _CNV_S_2_RANGE______0_CM 1 100. 0. 1. DISPLAY_IDENTIFIER LV_MU_INH_PWL_TRAN_ES_EL ECU_ADDRESS 0x3fe14a /end MEASUREMENT
/begin MEASUREMENT lv_es "Engine operating state \"Engine stopped\"" UBYTE _CNV_S_2_RANGE______0_CM 1 100. 0. 1. DISPLAY_IDENTIFIER LV_ES ECU_ADDRESS 0x3fe25d BIT_MASK 0x1 /end MEASUREMENT
/begin MEASUREMENT lv_st "Engine operating state \"Start\"" UBYTE _CNV_S_2_RANGE______5_CM 1 100. 0. 1. DISPLAY_IDENTIFIER LV_ST ECU_ADDRESS 0x3fe25e BIT_MASK 0x1 /end MEASUREMENT
/begin MEASUREMENT lv_st_end "Engine operating state \"Start\" not active" UBYTE _CNV_S_2_RANGE______0_CM 1 100. 0. 1. DISPLAY_IDENTIFIER LV_ST_END ECU_ADDRESS 0x3fe25f BIT_MASK 0x1 /end MEASUREMENT
/begin CHARACTERISTIC ip_cyc_cast__tco "Cycle counter to define the duration of the start phase characterised by LV_ST" CURVE 0x09a50 _REC_CUR_20_u2_u1 65535. _CNV_A_R_LINEAR_____1_CM 0. 65535. DISPLAY_IDENTIFIER IP_CYC_CAST__TCO FORMAT "%5.0"
 /begin AXIS_DESCR COM_AXIS tco _CNV_A_R_LINEAR_____12_CM 9 -48. 142.5 FORMAT "%5.1" AXIS_PTS_REF ldpm_tco_9 /end AXIS_DESCR
/end CHARACTERISTIC
/begin MEASUREMENT lv_is "Engine operating state \"Idle Speed\"" UBYTE _CNV_S_2_RANGE______0_CM 1 100. 0. 1. DISPLAY_IDENTIFIER LV_IS ECU_ADDRESS 0x3fe260 BIT_MASK 0x1 /end MEASUREMENT
/begin CHARACTERISTIC c_n_max_bol_st "Engine speed threshold to detect LV_ST or LV_PL from LV_IS" VALUE 0x00770 _REC_VAL_20_u1 408. _CNV_A_R_LINEAR_____16_CM 0. 8160. DISPLAY_IDENTIFIER C_N_MAX_BOL_ST FORMAT "%4.0" /end CHARACTERISTIC
/begin MEASUREMENT lv_pl "Engine operating state „Part Load\"" UBYTE _CNV_S_2_RANGE______0_CM 1 100. 0. 1. DISPLAY_IDENTIFIER LV_PL ECU_ADDRESS 0x3fe261 BIT_MASK 0x1 /end MEASUREMENT
/begin MEASUREMENT lv_pu "Engine operating state \"Trailing throttle\"" UBYTE _CNV_S_2_RANGE______0_CM 1 100. 0. 1. DISPLAY_IDENTIFIER LV_PU ECU_ADDRESS 0x3fe262 BIT_MASK 0x1 /end MEASUREMENT
/begin MEASUREMENT t_pu "Time elapsed into LV_PU" UWORD _CNV_A_R_LINEAR_____4_CM 1 100. 0. 655.35 DISPLAY_IDENTIFIER T_PU ECU_ADDRESS 0x3fd430 BYTE_ORDER MSB_LAST FORMAT "%5.2" /end MEASUREMENT
/begin CHARACTERISTIC c_t_min_pu "Minimum delay time of PUC activation after entry of PU" VALUE 0x0187a _REC_VAL_20_u2 655.35 _CNV_A_R_LINEAR_____4_CM 0. 655.35 DISPLAY_IDENTIFIER C_T_MIN_PU FORMAT "%6.2" /end CHARACTERISTIC
/begin CHARACTERISTIC c_t_max_pu "Maximum delay time of PUC activation after entry of PU" VALUE 0x01862 _REC_VAL_20_u2 655.35 _CNV_A_R_LINEAR_____4_CM 0. 655.35 DISPLAY_IDENTIFIER C_T_MAX_PU FORMAT "%6.2" /end CHARACTERISTIC
/begin CHARACTERISTIC lc_inh_dt_pu "Manual inhibition bit for deactivation drivetrain impact for controlling transition to PUC" VALUE 0x00f2d _REC_VAL_20_u1 1. _CNV_S_2_RANGE______0_CM 0. 1. DISPLAY_IDENTIFIER LC_INH_DT_PU /end CHARACTERISTIC
/begin CHARACTERISTIC c_t_min_pu_msr "Minimum delay time of PUC activation after MSR" VALUE 0x0187c _REC_VAL_20_u2 655.35 _CNV_A_R_LINEAR_____4_CM 0. 655.35 DISPLAY_IDENTIFIER C_T_MIN_PU_MSR FORMAT "%6.2" /end CHARACTERISTIC
/begin CHARACTERISTIC c_t_min_pu_rng_l "Minimum delay time of PUC activation after entry of PU for LV_RNG_L =1" VALUE 0x0187e _REC_VAL_20_u2 655.35 _CNV_A_R_LINEAR_____4_CM 0. 655.35 DISPLAY_IDENTIFIER C_T_MIN_PU_RNG_L FORMAT "%6.2" /end CHARACTERISTIC
/begin MEASUREMENT lv_puc "engine operating state \"trailing throttle fuel cut off \"" UBYTE _CNV_S_2_RANGE______0_CM 1 100. 0. 1. DISPLAY_IDENTIFIER LV_PUC ECU_ADDRESS 0x3fe263 BIT_MASK 0x1 /end MEASUREMENT
/begin CHARACTERISTIC id_n_hys_max_puc__gr_at "Engine speed hysteresis set entering LV_PUC" CURVE 0x03e14 _REC_CUR_20_u1_u1 8160. _CNV_A_R_LINEAR_____16_CM 0. 8160. DISPLAY_IDENTIFIER ID_N_HYS_MAX_PUC__GR_AT FORMAT "%4.0"
 /begin AXIS_DESCR COM_AXIS gr_at _CNV_A_R_LINEAR_____1_CM 13 0. 255. FORMAT "%3.0" AXIS_PTS_REF ldpm_gr_at_3 /end AXIS_DESCR
/end CHARACTERISTIC
/begin CHARACTERISTIC id_n_hys_max_puc__gr_mt "Engine speed hysteresis set entering LV_PUC" CURVE 0x03e21 _REC_CUR_20_u1_u1 8160. _CNV_A_R_LINEAR_____16_CM 0. 8160. DISPLAY_IDENTIFIER ID_N_HYS_MAX_PUC__GR_MT FORMAT "%4.0"
 /begin AXIS_DESCR COM_AXIS gr_mt _CNV_A_R_LINEAR_____1_CM 13 0. 255. FORMAT "%3.0" AXIS_PTS_REF ldpm_gr_mt_3 /end AXIS_DESCR
/end CHARACTERISTIC
/begin CHARACTERISTIC id_n_hys_min_puc__gr_at "Engine speed hysteresis reset when C_CYCNR_HYS_PUC_xx achieved" CURVE 0x03e2e _REC_CUR_20_u1_u1 8160. _CNV_A_R_LINEAR_____16_CM 0. 8160. DISPLAY_IDENTIFIER ID_N_HYS_MIN_PUC__GR_AT FORMAT "%4.0"
 /begin AXIS_DESCR COM_AXIS gr_at _CNV_A_R_LINEAR_____1_CM 13 0. 255. FORMAT "%3.0" AXIS_PTS_REF ldpm_gr_at_3 /end AXIS_DESCR
/end CHARACTERISTIC
/begin CHARACTERISTIC id_n_hys_min_puc__gr_mt "Engine speed hysteresis reset when C_CYCNR_HYS_PUC_xx achieved" CURVE 0x03e3b _REC_CUR_20_u1_u1 8160. _CNV_A_R_LINEAR_____16_CM 0. 8160. DISPLAY_IDENTIFIER ID_N_HYS_MIN_PUC__GR_MT FORMAT "%4.0"
 /begin AXIS_DESCR COM_AXIS gr_mt _CNV_A_R_LINEAR_____1_CM 13 0. 255. FORMAT "%3.0" AXIS_PTS_REF ldpm_gr_mt_3 /end AXIS_DESCR
/end CHARACTERISTIC
/begin CHARACTERISTIC id_n_hys_puc_st__gr_at "Engine speed hysteresis set entering LV_PUC in cold condition" CURVE 0x03e48 _REC_CUR_20_u1_u1 8160. _CNV_A_R_LINEAR_____16_CM 0. 8160. DISPLAY_IDENTIFIER ID_N_HYS_PUC_ST__GR_AT FORMAT "%4.0"
 /begin AXIS_DESCR COM_AXIS gr_at _CNV_A_R_LINEAR_____1_CM 13 0. 255. FORMAT "%3.0" AXIS_PTS_REF ldpm_gr_at_3 /end AXIS_DESCR
/end CHARACTERISTIC
/begin CHARACTERISTIC id_n_hys_puc_st__gr_mt "Engine speed hysteresis set entering LV_PUC in cold condition" CURVE 0x03e55 _REC_CUR_20_u1_u1 8160. _CNV_A_R_LINEAR_____16_CM 0. 8160. DISPLAY_IDENTIFIER ID_N_HYS_PUC_ST__GR_MT FORMAT "%4.0"
 /begin AXIS_DESCR COM_AXIS gr_mt _CNV_A_R_LINEAR_____1_CM 13 0. 255. FORMAT "%3.0" AXIS_PTS_REF ldpm_gr_mt_3 /end AXIS_DESCR
/end CHARACTERISTIC
/begin CHARACTERISTIC c_cycnr_hys_puc "Cycle counter to reset the LV_PUC engine speed hysteresis " VALUE 0x01522 _REC_VAL_20_u2 655.35 _CNV_A_R_LINEAR_____184_CM 0. 65535. DISPLAY_IDENTIFIER C_CYCNR_HYS_PUC FORMAT "%5.0" /end CHARACTERISTIC
/begin CHARACTERISTIC c_cycnr_hys_puc_st "Cycle counter to reset the LV_PUC engine speed hysteresis in cold condition" VALUE 0x01524 _REC_VAL_20_u2 655.35 _CNV_A_R_LINEAR_____184_CM 0. 65535. DISPLAY_IDENTIFIER C_CYCNR_HYS_PUC_ST FORMAT "%5.0" /end CHARACTERISTIC
/begin CHARACTERISTIC c_tco_min_puc_st "Coolant temperature to select the LV_PUC engine speed hysteresis" VALUE 0x0088e _REC_VAL_20_u1 28.575 _CNV_A_R_LINEAR_____12_CM -48. 142.5 DISPLAY_IDENTIFIER C_TCO_MIN_PUC_ST FORMAT "%5.1" /end CHARACTERISTIC
/begin MEASUREMENT lv_puc_req "Engine operating state \"Trailing throttle\" for torque structure" UBYTE _CNV_S_2_RANGE______0_CM 1 100. 0. 1. DISPLAY_IDENTIFIER LV_PUC_REQ ECU_ADDRESS 0x3fe265 BIT_MASK 0x1 /end MEASUREMENT
/begin MEASUREMENT state_eng "" UBYTE _CNV_S_6_RANGE_STAT_185_CM 1 100. 0. 5. DISPLAY_IDENTIFIER STATE_ENG ECU_ADDRESS 0x3fe25c /end MEASUREMENT
/begin CHARACTERISTIC ip_n_min_puc__tco__gr_mt "LV_PUC engine speed threshold" MAP 0x06aed _REC_MAP_20_u1_u1_u1 8160. _CNV_A_R_LINEAR_____16_CM 0. 8160. DISPLAY_IDENTIFIER IP_N_MIN_PUC__TCO__GR_MT FORMAT "%4.0"
 /begin AXIS_DESCR COM_AXIS tco _CNV_A_R_LINEAR_____12_CM 6 -48. 142.5 FORMAT "%5.1" AXIS_PTS_REF ldpm_tco_1_6 /end AXIS_DESCR
 /begin AXIS_DESCR COM_AXIS gr_mt _CNV_A_R_LINEAR_____1_CM 13 0. 255. FORMAT "%3.0" AXIS_PTS_REF ldpm_gr_mt_3 /end AXIS_DESCR
/end CHARACTERISTIC
/begin CHARACTERISTIC ip_n_accout_min_puc__tco__gr_mt "LV_PUC engine speed threshold with air conditioned compressor active" MAP 0x06a48 _REC_MAP_20_u1_u1_u1 8160. _CNV_A_R_LINEAR_____16_CM 0. 8160. DISPLAY_IDENTIFIER IP_N_ACCOUT_MIN_PUC__TCO__GR_MT FORMAT "%4.0"
 /begin AXIS_DESCR COM_AXIS tco _CNV_A_R_LINEAR_____12_CM 6 -48. 142.5 FORMAT "%5.1" AXIS_PTS_REF ldpm_tco_1_6 /end AXIS_DESCR
 /begin AXIS_DESCR COM_AXIS gr_mt _CNV_A_R_LINEAR_____1_CM 13 0. 255. FORMAT "%3.0" AXIS_PTS_REF ldpm_gr_mt_3 /end AXIS_DESCR
/end CHARACTERISTIC
/begin CHARACTERISTIC ip_n_accout_min_puc__tco__gr_at "LV_PUC engine speed threshold with air conditioned compressor active" MAP 0x069fa _REC_MAP_20_u1_u1_u1 8160. _CNV_A_R_LINEAR_____16_CM 0. 8160. DISPLAY_IDENTIFIER IP_N_ACCOUT_MIN_PUC__TCO__GR_AT FORMAT "%4.0"
 /begin AXIS_DESCR COM_AXIS tco _CNV_A_R_LINEAR_____12_CM 6 -48. 142.5 FORMAT "%5.1" AXIS_PTS_REF ldpm_tco_1_6 /end AXIS_DESCR
 /begin AXIS_DESCR COM_AXIS gr_at _CNV_A_R_LINEAR_____1_CM 13 0. 255. FORMAT "%3.0" AXIS_PTS_REF ldpm_gr_at_3 /end AXIS_DESCR
/end CHARACTERISTIC
/begin AXIS_PTS ldpm_tco_1_6 "" 0x013b3 tco _REC_AXS_20_u1 28.575 _CNV_A_R_LINEAR_____12_CM 6 -48. 142.5 DISPLAY_IDENTIFIER LDPM_TCO_1_6 FORMAT "%5.1" /end AXIS_PTS
/begin AXIS_PTS ldpm_gr_mt_3 "" 0x07f7f gr_mt _REC_AXS_20_u1 255. _CNV_A_R_LINEAR_____1_CM 13 0. 255. DISPLAY_IDENTIFIER LDPM_GR_MT_3 FORMAT "%3.0" /end AXIS_PTS
/begin AXIS_PTS ldpm_gr_at_3 "" 0x07f5a gr_at _REC_AXS_20_u1 255. _CNV_A_R_LINEAR_____1_CM 13 0. 255. DISPLAY_IDENTIFIER LDPM_GR_AT_3 FORMAT "%3.0" /end AXIS_PTS
/begin CHARACTERISTIC c_n_dif_ast "Additional engine speed hysteresis to avoid \"LV_PU\" direct after start" VALUE 0x016dc _REC_VAL_20_u2 50. _CNV_A_R_LINEAR_____11_CM 0. 1000. DISPLAY_IDENTIFIER C_N_DIF_AST FORMAT "%4.0" /end CHARACTERISTIC
/begin CHARACTERISTIC c_t_n_dif_ast "Tme after start where C_N_DIF_AST is additional calculated to engine speed hysteresis" VALUE 0x01884 _REC_VAL_20_u2 327.675 _CNV_A_R_LINEAR_____24_CM 0. 6553.5 DISPLAY_IDENTIFIER C_T_N_DIF_AST FORMAT "%6.1" /end CHARACTERISTIC
/begin AXIS_PTS ldp_tq_loss_ars_sp_can__puc "" 0x1133e tq_loss_ars_sp_can _REC_AXS_20_u2 2047.96875 _CNV_A_R_LINEAR_____186_CM 6 -1024. 1023.96875 DISPLAY_IDENTIFIER LDP_TQ_LOSS_ARS_SP_CAN__PUC FORMAT "%6.2" /end AXIS_PTS
/begin CHARACTERISTIC ip_n_min_puc__tco__gr_at "LV_PUC engine speed threshold" MAP 0x06a9f _REC_MAP_20_u1_u1_u1 8160. _CNV_A_R_LINEAR_____16_CM 0. 8160. DISPLAY_IDENTIFIER IP_N_MIN_PUC__TCO__GR_AT FORMAT "%4.0"
 /begin AXIS_DESCR COM_AXIS tco _CNV_A_R_LINEAR_____12_CM 6 -48. 142.5 FORMAT "%5.1" AXIS_PTS_REF ldpm_tco_1_6 /end AXIS_DESCR
 /begin AXIS_DESCR COM_AXIS gr_at _CNV_A_R_LINEAR_____1_CM 13 0. 255. FORMAT "%3.0" AXIS_PTS_REF ldpm_gr_at_3 /end AXIS_DESCR
/end CHARACTERISTIC
/begin CHARACTERISTIC ip_n_min_puc_add_ars "Additive term for reactivation engine speed" CURVE 0x00d26 _REC_CUR_20_u1_u2 8160. _CNV_A_R_LINEAR_____16_CM 0. 8160. DISPLAY_IDENTIFIER IP_N_MIN_PUC_ADD_ARS FORMAT "%4.0"
 /begin AXIS_DESCR COM_AXIS tq_loss_ars_sp_can _CNV_A_R_LINEAR_____186_CM 6 -1024. 1023.96875 FORMAT "%6.2" AXIS_PTS_REF ldp_tq_loss_ars_sp_can__puc /end AXIS_DESCR
/end CHARACTERISTIC
/begin AXIS_PTS ldpm_tco_9 "" 0x081b7 tco _REC_AXS_20_u1 28.575 _CNV_A_R_LINEAR_____12_CM 9 -48. 142.5 DISPLAY_IDENTIFIER LDPM_TCO_9 FORMAT "%5.1" /end AXIS_PTS
/begin MEASUREMENT lv_iga_min_puc "Conditions for IGA_MIN_PUC" UBYTE _CNV_S_2_RANGE______0_CM 1 100. 0. 1. DISPLAY_IDENTIFIER LV_IGA_MIN_PUC ECU_ADDRESS 0x3fe264 BIT_MASK 0x1 /end MEASUREMENT
/begin CHARACTERISTIC c_t_min_pu_vs "Minimum delay time of PUC activation after entry of PU" VALUE 0x01880 _REC_VAL_20_u2 655.35 _CNV_A_R_LINEAR_____4_CM 0. 655.35 DISPLAY_IDENTIFIER C_T_MIN_PU_VS FORMAT "%6.2" /end CHARACTERISTIC
/begin AXIS_PTS ldp_n__t_min_pu "" 0x10f06 n _REC_AXS_20_u2 8159. _CNV_A_R_LINEAR_____11_CM 8 1. 8160. DISPLAY_IDENTIFIER LDP_N__T_MIN_PU FORMAT "%4.0" /end AXIS_PTS
/begin AXIS_PTS ldp_tco__t_min_pu "" 0x01170 tco _REC_AXS_20_u1 190.5 _CNV_A_R_LINEAR_____12_CM 6 -48. 142.5 DISPLAY_IDENTIFIER LDP_TCO__T_MIN_PU FORMAT "%5.1" /end AXIS_PTS
/begin CHARACTERISTIC c_vs_min_pu "Threshold for vehicle speed for loading T_PU" VALUE 0x0095b _REC_VAL_20_u1 12.75 _CNV_A_R_LINEAR_____23_CM 0. 255. DISPLAY_IDENTIFIER C_VS_MIN_PU FORMAT "%3.0" /end CHARACTERISTIC
/begin CHARACTERISTIC ip_t_min_pu__n__tco "Minimum delay time of PUC activation" MAP 0x0ea52 _REC_MAP_20_u2_u2_u1 655.35 _CNV_A_R_LINEAR_____4_CM 0. 655.35 DISPLAY_IDENTIFIER IP_T_MIN_PU__N__TCO FORMAT "%6.2"
 /begin AXIS_DESCR COM_AXIS n _CNV_A_R_LINEAR_____11_CM 8 1. 8160. FORMAT "%4.0" AXIS_PTS_REF ldp_n__t_min_pu /end AXIS_DESCR
 /begin AXIS_DESCR COM_AXIS tco _CNV_A_R_LINEAR_____12_CM 6 -48. 142.5 FORMAT "%5.1" AXIS_PTS_REF ldp_tco__t_min_pu /end AXIS_DESCR
/end CHARACTERISTIC
/begin CHARACTERISTIC ip_t_min_pu_rng_l__n__tco "Minimum delay time of PUC activation" MAP 0x0eab2 _REC_MAP_20_u2_u2_u1 655.35 _CNV_A_R_LINEAR_____4_CM 0. 655.35 DISPLAY_IDENTIFIER IP_T_MIN_PU_RNG_L__N__TCO FORMAT "%6.2"
 /begin AXIS_DESCR COM_AXIS n _CNV_A_R_LINEAR_____11_CM 8 1. 8160. FORMAT "%4.0" AXIS_PTS_REF ldp_n__t_min_pu /end AXIS_DESCR
 /begin AXIS_DESCR COM_AXIS tco _CNV_A_R_LINEAR_____12_CM 6 -48. 142.5 FORMAT "%5.1" AXIS_PTS_REF ldp_tco__t_min_pu /end AXIS_DESCR
/end CHARACTERISTIC
/begin AXIS_PTS ldp_n_grd_n_dif_max_is "" 0x010c7 n_grd _REC_AXS_20_u1 8160. _CNV_A_R_LINEAR_____54_CM 6 -4096. 4064. DISPLAY_IDENTIFIER LDP_N_GRD_N_DIF_MAX_IS FORMAT "%5.0" /end AXIS_PTS
/begin CHARACTERISTIC ip_n_dif_max_is "Engine speed hysteresis before \"Idle speed\" (LV_IS)" CURVE 0x0cea6 _REC_CUR_20_u2_u1 8160. _CNV_A_R_LINEAR_____11_CM 0. 8160. DISPLAY_IDENTIFIER IP_N_DIF_MAX_IS FORMAT "%4.0"
 /begin AXIS_DESCR COM_AXIS n_grd _CNV_A_R_LINEAR_____54_CM 6 -4096. 4064. FORMAT "%5.0" AXIS_PTS_REF ldp_n_grd_n_dif_max_is /end AXIS_DESCR
/end CHARACTERISTIC
/begin MEASUREMENT state_diag_gs "Status of GS diagnosis for feedback to gearbox" UBYTE _CNV_A_R_LINEAR_____1_CM 1 100. 0. 255. DISPLAY_IDENTIFIER STATE_DIAG_GS ECU_ADDRESS 0x3fe4c6 FORMAT "%3.0" /end MEASUREMENT
/begin MEASUREMENT lv_err_gs "Boolean for error currently present on GS" UBYTE _CNV_S_2_RANGE______2_R_CM 1 100. 0. 255. DISPLAY_IDENTIFIER LV_ERR_GS ECU_ADDRESS 0x3fbb3c /end MEASUREMENT
/begin CHARACTERISTIC lc_var_gs_eobd "Logical constant for variant EOBD (=1) or US (=0)" VALUE 0x00f9d _REC_VAL_20_u1 1. _CNV_A_R_LINEAR_____1_CM 0. 1. DISPLAY_IDENTIFIER LC_VAR_GS_EOBD FORMAT "%2.0" /end CHARACTERISTIC
/begin MEASUREMENT state_cmb_ctl "States of the combustion management" UBYTE _CNV_S_9_RANGE_STAT_230_CM 1 100. 0. 8. DISPLAY_IDENTIFIER STATE_CMB_CTL ECU_ADDRESS 0x3fe1ec /end MEASUREMENT
/begin AXIS_PTS ldpm_ctr_km_can_1 "" 0x115d8 ctr_km_can _REC_AXS_20_u2 655350. _CNV_A_R_LINEAR_____88_CM 4 0. 655350. DISPLAY_IDENTIFIER LDPM_CTR_KM_CAN_1 FORMAT "%7.0" /end AXIS_PTS
/begin MEASUREMENT lv_afl_ch "LV for activation SA or catalyst heating lambda coordination" UBYTE _CNV_S_2_RANGE______5_CM 1 100. 0. 1. DISPLAY_IDENTIFIER LV_AFL_CH ECU_ADDRESS 0x3fdfe3 BIT_MASK 0x1 /end MEASUREMENT
/begin MEASUREMENT lam_bank_1.ls_up_diag.lam_p_ctr_sum "Counter indicating the number of observed p jumps reported by the lambda controller" UBYTE _CNV_A_R_LINEAR_____1_CM 1 100. 0. 255. DISPLAY_IDENTIFIER LAM_P_CTR_SUM_1 ECU_ADDRESS 0x3fc4b8 FORMAT "%3.0" /end MEASUREMENT
/begin MEASUREMENT lam_bank_1.ls_up_diag.t_dly_vls_up_min_cold "Delay time for final diagnosis activation " UWORD _CNV_A_R_LINEAR_____24_CM 1 100. 0. 6553.5 DISPLAY_IDENTIFIER T_DLY_VLS_UP_MIN_COLD_1 ECU_ADDRESS 0x3fc4a8 BYTE_ORDER MSB_LAST FORMAT "%5.1" /end MEASUREMENT
/begin MEASUREMENT lam_bank_1.ls_up_diag.t_diag_vls_up_min_cold "Maximum activation time for diagnosis activation " UWORD _CNV_A_R_LINEAR_____24_CM 1 100. 0. 6553.5 DISPLAY_IDENTIFIER T_DIAG_VLS_UP_MIN_COLD_1 ECU_ADDRESS 0x3fc4aa BYTE_ORDER MSB_LAST FORMAT "%5.1" /end MEASUREMENT
/begin MEASUREMENT lam_bank_1.ls_up_diag.t_dly_vls_up_min "Delay time for final diagnosis activation " UWORD _CNV_A_R_LINEAR_____24_CM 1 100. 0. 6553.5 DISPLAY_IDENTIFIER T_DLY_VLS_UP_MIN_1 ECU_ADDRESS 0x3fc4b0 BYTE_ORDER MSB_LAST FORMAT "%5.1" /end MEASUREMENT
/begin MEASUREMENT lam_bank_1.ls_up_diag.t_dly_lam_min_vls_up_min "Delay time for detection \"Lambda-controller limit\" " UWORD _CNV_A_R_LINEAR_____24_CM 1 100. 0. 6553.5 DISPLAY_IDENTIFIER T_DLY_LAM_MIN_VLS_UP_MIN_1 ECU_ADDRESS 0x3fc4b2 BYTE_ORDER MSB_LAST FORMAT "%5.1" /end MEASUREMENT
/begin MEASUREMENT lam_bank_1.ls_up_diag.maf_int_cps_close_vls_up_min "Integral of mass air flow since closing CPS" UWORD _CNV_A_R_LINEAR_____271_CM 1 100. 0. 1820.398 DISPLAY_IDENTIFIER MAF_INT_CPS_CLOSE_VLS_UP_MIN_1 ECU_ADDRESS 0x3fc4b4 BYTE_ORDER MSB_LAST FORMAT "%7.2" /end MEASUREMENT
/begin MEASUREMENT lam_bank_1.ls_up_diag.bf.lv_ti_lam_max_vls_up_min "Boolean flag indicating that lambda controller limited and CPS closed or inactive" ULONG _CNV_S_2_RANGE______0_CM 1 100. 0. 1. DISPLAY_IDENTIFIER LV_TI_LAM_MAX_VLS_UP_MIN_1 ECU_ADDRESS 0x3fc4a0 BYTE_ORDER MSB_LAST BIT_MASK 0x80000000 /end MEASUREMENT
/begin MEASUREMENT lam_bank_1.ls_up_diag.bf.lv_req_diag_vls_up_min "Request bit to indicate need of CPP  close for upsteam oxygen sensor SCG diagnosis" ULONG _CNV_S_2_RANGE______0_CM 1 100. 0. 1. DISPLAY_IDENTIFIER LV_REQ_DIAG_VLS_UP_MIN_1 ECU_ADDRESS 0x3fc4a0 BYTE_ORDER MSB_LAST BIT_MASK 0x40000000 /end MEASUREMENT
/begin MEASUREMENT lam_bank_1.ls_up_diag.t_err_cdn_vls_up_min "Time where the error conditions are active to detect fault" UWORD _CNV_A_R_LINEAR_____24_CM 1 100. 0. 6553.5 DISPLAY_IDENTIFIER T_ERR_CDN_VLS_UP_MIN_1 ECU_ADDRESS 0x3fc4ac BYTE_ORDER MSB_LAST FORMAT "%5.1" /end MEASUREMENT
/begin MEASUREMENT lam_bank_1.ls_up_diag.t_dly_vls_up_oc "Delay time for final diagnosis activation " UWORD _CNV_A_R_LINEAR_____24_CM 1 100. 0. 6553.5 DISPLAY_IDENTIFIER T_DLY_VLS_UP_OC_1 ECU_ADDRESS 0x3fc4b6 BYTE_ORDER MSB_LAST FORMAT "%5.1" /end MEASUREMENT
/begin MEASUREMENT lam_bank_1.ls_up_diag.t_err_cdn_vls_up_oc "Time where the error conditions are active to detect fault" UWORD _CNV_A_R_LINEAR_____24_CM 1 100. 0. 6553.5 DISPLAY_IDENTIFIER T_ERR_CDN_VLS_UP_OC_1 ECU_ADDRESS 0x3fc4a4 BYTE_ORDER MSB_LAST FORMAT "%5.1" /end MEASUREMENT
/begin MEASUREMENT lam_bank_1.ls_up_diag.t_end_diag_vls_up_min "Timer to set LV_END_DIAG_VLS_UP_MIN" UWORD _CNV_A_R_LINEAR_____24_CM 1 100. 0. 6553.5 DISPLAY_IDENTIFIER T_END_DIAG_VLS_UP_MIN_1 ECU_ADDRESS 0x3fc4ae BYTE_ORDER MSB_LAST FORMAT "%5.1" /end MEASUREMENT
/begin MEASUREMENT lam_bank_1.ls_up_diag.t_end_diag_vls_up_oc "Timer to set LV_END_DIAG_VLS_UP_OC" UWORD _CNV_A_R_LINEAR_____24_CM 1 100. 0. 6553.5 DISPLAY_IDENTIFIER T_END_DIAG_VLS_UP_OC_1 ECU_ADDRESS 0x3fc4a6 BYTE_ORDER MSB_LAST FORMAT "%5.1" /end MEASUREMENT
/begin MEASUREMENT lam_bank_1.ls_up_diag_inci.bf.lv_inh_diag_vls_up_min "Boolean flag indicating project specific application conditions for VLS_UP short to ground diagnosis not met" ULONG _CNV_S_2_RANGE______0_CM 1 100. 0. 1. DISPLAY_IDENTIFIER LV_INH_DIAG_VLS_UP_MIN_1 ECU_ADDRESS 0x3fc4bc BYTE_ORDER MSB_LAST BIT_MASK 0x80000000 /end MEASUREMENT
/begin MEASUREMENT lam_bank_1.ls_up_diag_inci.bf.lv_inh_diag_vls_up_max "Boolean flag indicating project specific application conditions for VLS_UP to plus diagnosis not met" ULONG _CNV_S_2_RANGE______0_CM 1 100. 0. 1. DISPLAY_IDENTIFIER LV_INH_DIAG_VLS_UP_MAX_1 ECU_ADDRESS 0x3fc4bc BYTE_ORDER MSB_LAST BIT_MASK 0x40000000 /end MEASUREMENT
/begin MEASUREMENT lam_bank_1.ls_up_diag_inci.bf.lv_inh_diag_vls_up_oc "Boolean flag indicating project specific application conditions for VLS_UP open line diagnosis not met" ULONG _CNV_S_2_RANGE______0_CM 1 100. 0. 1. DISPLAY_IDENTIFIER LV_INH_DIAG_VLS_UP_OC_1 ECU_ADDRESS 0x3fc4bc BYTE_ORDER MSB_LAST BIT_MASK 0x20000000 /end MEASUREMENT
/begin MEASUREMENT lam_bank_1.ls_up_diag_inci.bf.lv_inh_diag_vls_up_puc "Boolean flag indicating project specific application conditions for VLS_UP_PUC diagnosis not met" ULONG _CNV_S_2_RANGE______0_CM 1 100. 0. 1. DISPLAY_IDENTIFIER LV_INH_DIAG_VLS_UP_PUC_1 ECU_ADDRESS 0x3fc4bc BYTE_ORDER MSB_LAST BIT_MASK 0x10000000 /end MEASUREMENT
/begin MEASUREMENT lam_bank_1.ls_up_diag_inci.bf.lv_inh_diag_vls_up_stk "Boolean flag indicating project specific application conditions for VLS_UP_STK diagnosis not met" ULONG _CNV_S_2_RANGE______0_CM 1 100. 0. 1. DISPLAY_IDENTIFIER LV_INH_DIAG_VLS_UP_STK_1 ECU_ADDRESS 0x3fc4bc BYTE_ORDER MSB_LAST BIT_MASK 0x8000000 /end MEASUREMENT
/begin MEASUREMENT lam_bank_1.ls_up_diag_inci.bf.lv_inh_diag_vls_up_min_cold "Boolean flag indicating project specific application conditions for VLS_UP_MIN_COLD diagnosis not met" ULONG _CNV_S_2_RANGE______0_CM 1 100. 0. 1. DISPLAY_IDENTIFIER LV_INH_DIAG_VLS_UP_MIN_COLD_1 ECU_ADDRESS 0x3fc4bc BYTE_ORDER MSB_LAST BIT_MASK 0x4000000 /end MEASUREMENT
/begin MEASUREMENT lam_bank_1.ls_down_diag.t_dly_vls_down_min_cold "Delay time for final diagnosis activation" UWORD _CNV_A_R_LINEAR_____24_CM 1 100. 0. 6553.5 DISPLAY_IDENTIFIER T_DLY_VLS_DOWN_MIN_COLD_1 ECU_ADDRESS 0x3fc374 BYTE_ORDER MSB_LAST FORMAT "%5.1" /end MEASUREMENT
/begin MEASUREMENT lam_bank_1.ls_down_diag.t_diag_vls_down_min_cold "Maximum activation time for diagnosis activation" UWORD _CNV_A_R_LINEAR_____24_CM 1 100. 0. 6553.5 DISPLAY_IDENTIFIER T_DIAG_VLS_DOWN_MIN_COLD_1 ECU_ADDRESS 0x3fc376 BYTE_ORDER MSB_LAST FORMAT "%5.1" /end MEASUREMENT
/begin MEASUREMENT lam_bank_1.ls_down_diag.t_dly_vls_down_min "Delay time for final diagnosis activation" UWORD _CNV_A_R_LINEAR_____24_CM 1 100. 0. 6553.5 DISPLAY_IDENTIFIER T_DLY_VLS_DOWN_MIN_1 ECU_ADDRESS 0x3fc380 BYTE_ORDER MSB_LAST FORMAT "%5.1" /end MEASUREMENT
/begin MEASUREMENT lam_bank_1.ls_down_diag.t_dly_vls_down_oc "Delay time for final diagnosis activation" UWORD _CNV_A_R_LINEAR_____24_CM 1 100. 0. 6553.5 DISPLAY_IDENTIFIER T_DLY_VLS_DOWN_OC_1 ECU_ADDRESS 0x3fc382 BYTE_ORDER MSB_LAST FORMAT "%5.1" /end MEASUREMENT
/begin MEASUREMENT lam_bank_1.ls_down_diag.bf.lv_req_chk_ls_down "Request for starting the downstream sensor active plausibility check" ULONG _CNV_S_2_RANGE______0_CM 1 100. 0. 1. DISPLAY_IDENTIFIER LV_REQ_CHK_LS_DOWN_1 ECU_ADDRESS 0x3fc370 BYTE_ORDER MSB_LAST BIT_MASK 0x80000000 /end MEASUREMENT
/begin MEASUREMENT lam_bank_1.ls_down_diag.t_err_cdn_vls_down_min "Detection time for status MIN before diagnosis" UWORD _CNV_A_R_LINEAR_____24_CM 1 100. 0. 6553.5 DISPLAY_IDENTIFIER T_ERR_CDN_VLS_DOWN_MIN_1 ECU_ADDRESS 0x3fc378 BYTE_ORDER MSB_LAST FORMAT "%5.1" /end MEASUREMENT
/begin MEASUREMENT lam_bank_1.ls_down_diag.t_err_cdn_vls_down_oc "Detection time for status OC for diagnosis" UWORD _CNV_A_R_LINEAR_____24_CM 1 100. 0. 6553.5 DISPLAY_IDENTIFIER T_ERR_CDN_VLS_DOWN_OC_1 ECU_ADDRESS 0x3fc37a BYTE_ORDER MSB_LAST FORMAT "%5.1" /end MEASUREMENT
/begin MEASUREMENT lam_bank_1.ls_down_diag.t_end_diag_vls_down_min "Timer for setting LV_END_DIAG_VLS_DOWN_MIN" UWORD _CNV_A_R_LINEAR_____24_CM 1 100. 0. 6553.5 DISPLAY_IDENTIFIER T_END_DIAG_VLS_DOWN_MIN_1 ECU_ADDRESS 0x3fc37c BYTE_ORDER MSB_LAST FORMAT "%5.1" /end MEASUREMENT
/begin MEASUREMENT lam_bank_1.ls_down_diag.t_end_diag_vls_down_oc "Timer for setting LV_END_DIAG_VLS_DOWN_OC" UWORD _CNV_A_R_LINEAR_____24_CM 1 100. 0. 6553.5 DISPLAY_IDENTIFIER T_END_DIAG_VLS_DOWN_OC_1 ECU_ADDRESS 0x3fc37e BYTE_ORDER MSB_LAST FORMAT "%5.1" /end MEASUREMENT
/begin MEASUREMENT lam_bank_1.ls_down_diag_inci.bf.lv_inh_diag_vls_down_min "Boolean flag indicating project specific application conditions for downstream SCG diagnosis not met" ULONG _CNV_S_2_RANGE______0_CM 1 100. 0. 1. DISPLAY_IDENTIFIER LV_INH_DIAG_VLS_DOWN_MIN_1 ECU_ADDRESS 0x3fc384 BYTE_ORDER MSB_LAST BIT_MASK 0x80000000 /end MEASUREMENT
/begin MEASUREMENT lam_bank_1.ls_down_diag_inci.bf.lv_inh_diag_vls_down_max "Boolean flag indicating project specific application conditions for downstream short to plus diagnosis not met" ULONG _CNV_S_2_RANGE______0_CM 1 100. 0. 1. DISPLAY_IDENTIFIER LV_INH_DIAG_VLS_DOWN_MAX_1 ECU_ADDRESS 0x3fc384 BYTE_ORDER MSB_LAST BIT_MASK 0x40000000 /end MEASUREMENT
/begin MEASUREMENT lam_bank_1.ls_down_diag_inci.bf.lv_inh_diag_vls_down_oc "Boolean flag indicating project specific application conditions for downstream open line diagnosis not met" ULONG _CNV_S_2_RANGE______0_CM 1 100. 0. 1. DISPLAY_IDENTIFIER LV_INH_DIAG_VLS_DOWN_OC_1 ECU_ADDRESS 0x3fc384 BYTE_ORDER MSB_LAST BIT_MASK 0x20000000 /end MEASUREMENT
/begin MEASUREMENT lam_bank_1.ls_down_diag_inci.bf.lv_inh_diag_vls_down_min_cold "Boolean flag indicating project specific application conditions for downstream SCG (Cold test) diagnosis not met" ULONG _CNV_S_2_RANGE______0_CM 1 100. 0. 1. DISPLAY_IDENTIFIER LV_INH_DIAG_VLS_DOWN_MIN_COLD_1 ECU_ADDRESS 0x3fc384 BYTE_ORDER MSB_LAST BIT_MASK 0x10000000 /end MEASUREMENT
/begin MEASUREMENT lam_bank_2.ls_up_diag.lam_p_ctr_sum "Counter indicating the number of observed p jumps reported by the lambda controller" UBYTE _CNV_A_R_LINEAR_____1_CM 1 100. 0. 255. DISPLAY_IDENTIFIER LAM_P_CTR_SUM_2 ECU_ADDRESS 0x3fc81c FORMAT "%3.0" /end MEASUREMENT
/begin MEASUREMENT lam_bank_2.ls_up_diag.t_dly_vls_up_min_cold "Delay time for final diagnosis activation " UWORD _CNV_A_R_LINEAR_____24_CM 1 100. 0. 6553.5 DISPLAY_IDENTIFIER T_DLY_VLS_UP_MIN_COLD_2 ECU_ADDRESS 0x3fc80c BYTE_ORDER MSB_LAST FORMAT "%5.1" /end MEASUREMENT
/begin MEASUREMENT lam_bank_2.ls_up_diag.t_diag_vls_up_min_cold "Maximum activation time for diagnosis activation " UWORD _CNV_A_R_LINEAR_____24_CM 1 100. 0. 6553.5 DISPLAY_IDENTIFIER T_DIAG_VLS_UP_MIN_COLD_2 ECU_ADDRESS 0x3fc80e BYTE_ORDER MSB_LAST FORMAT "%5.1" /end MEASUREMENT
/begin MEASUREMENT lam_bank_2.ls_up_diag.t_dly_vls_up_min "Delay time for final diagnosis activation " UWORD _CNV_A_R_LINEAR_____24_CM 1 100. 0. 6553.5 DISPLAY_IDENTIFIER T_DLY_VLS_UP_MIN_2 ECU_ADDRESS 0x3fc814 BYTE_ORDER MSB_LAST FORMAT "%5.1" /end MEASUREMENT
/begin MEASUREMENT lam_bank_2.ls_up_diag.t_dly_lam_min_vls_up_min "Delay time for detection \"Lambda-controller limit\" " UWORD _CNV_A_R_LINEAR_____24_CM 1 100. 0. 6553.5 DISPLAY_IDENTIFIER T_DLY_LAM_MIN_VLS_UP_MIN_2 ECU_ADDRESS 0x3fc816 BYTE_ORDER MSB_LAST FORMAT "%5.1" /end MEASUREMENT
/begin MEASUREMENT lam_bank_2.ls_up_diag.maf_int_cps_close_vls_up_min "Integral of mass air flow since closing CPS" UWORD _CNV_A_R_LINEAR_____271_CM 1 100. 0. 1820.398 DISPLAY_IDENTIFIER MAF_INT_CPS_CLOSE_VLS_UP_MIN_2 ECU_ADDRESS 0x3fc818 BYTE_ORDER MSB_LAST FORMAT "%7.2" /end MEASUREMENT
/begin MEASUREMENT lam_bank_2.ls_up_diag.bf.lv_ti_lam_max_vls_up_min "Boolean flag indicating that lambda controller limited and CPS closed or inactive" ULONG _CNV_S_2_RANGE______0_CM 1 100. 0. 1. DISPLAY_IDENTIFIER LV_TI_LAM_MAX_VLS_UP_MIN_2 ECU_ADDRESS 0x3fc804 BYTE_ORDER MSB_LAST BIT_MASK 0x80000000 /end MEASUREMENT
/begin MEASUREMENT lam_bank_2.ls_up_diag.bf.lv_req_diag_vls_up_min "Request bit to indicate need of CPP  close for upsteam oxygen sensor SCG diagnosis" ULONG _CNV_S_2_RANGE______0_CM 1 100. 0. 1. DISPLAY_IDENTIFIER LV_REQ_DIAG_VLS_UP_MIN_2 ECU_ADDRESS 0x3fc804 BYTE_ORDER MSB_LAST BIT_MASK 0x40000000 /end MEASUREMENT
/begin MEASUREMENT lam_bank_2.ls_up_diag.t_err_cdn_vls_up_min "Time where the error conditions are active to detect fault" UWORD _CNV_A_R_LINEAR_____24_CM 1 100. 0. 6553.5 DISPLAY_IDENTIFIER T_ERR_CDN_VLS_UP_MIN_2 ECU_ADDRESS 0x3fc810 BYTE_ORDER MSB_LAST FORMAT "%5.1" /end MEASUREMENT
/begin MEASUREMENT lam_bank_2.ls_up_diag.t_dly_vls_up_oc "Delay time for final diagnosis activation " UWORD _CNV_A_R_LINEAR_____24_CM 1 100. 0. 6553.5 DISPLAY_IDENTIFIER T_DLY_VLS_UP_OC_2 ECU_ADDRESS 0x3fc81a BYTE_ORDER MSB_LAST FORMAT "%5.1" /end MEASUREMENT
/begin MEASUREMENT lam_bank_2.ls_up_diag.t_err_cdn_vls_up_oc "Time where the error conditions are active to detect fault" UWORD _CNV_A_R_LINEAR_____24_CM 1 100. 0. 6553.5 DISPLAY_IDENTIFIER T_ERR_CDN_VLS_UP_OC_2 ECU_ADDRESS 0x3fc808 BYTE_ORDER MSB_LAST FORMAT "%5.1" /end MEASUREMENT
/begin MEASUREMENT lam_bank_2.ls_up_diag.t_end_diag_vls_up_min "Timer to set LV_END_DIAG_VLS_UP_MIN" UWORD _CNV_A_R_LINEAR_____24_CM 1 100. 0. 6553.5 DISPLAY_IDENTIFIER T_END_DIAG_VLS_UP_MIN_2 ECU_ADDRESS 0x3fc812 BYTE_ORDER MSB_LAST FORMAT "%5.1" /end MEASUREMENT
/begin MEASUREMENT lam_bank_2.ls_up_diag.t_end_diag_vls_up_oc "Timer to set LV_END_DIAG_VLS_UP_OC" UWORD _CNV_A_R_LINEAR_____24_CM 1 100. 0. 6553.5 DISPLAY_IDENTIFIER T_END_DIAG_VLS_UP_OC_2 ECU_ADDRESS 0x3fc80a BYTE_ORDER MSB_LAST FORMAT "%5.1" /end MEASUREMENT
/begin MEASUREMENT lam_bank_2.ls_up_diag_inci.bf.lv_inh_diag_vls_up_min "Boolean flag indicating project specific application conditions for VLS_UP short to ground diagnosis not met" ULONG _CNV_S_2_RANGE______0_CM 1 100. 0. 1. DISPLAY_IDENTIFIER LV_INH_DIAG_VLS_UP_MIN_2 ECU_ADDRESS 0x3fc820 BYTE_ORDER MSB_LAST BIT_MASK 0x80000000 /end MEASUREMENT
/begin MEASUREMENT lam_bank_2.ls_up_diag_inci.bf.lv_inh_diag_vls_up_max "Boolean flag indicating project specific application conditions for VLS_UP to plus diagnosis not met" ULONG _CNV_S_2_RANGE______0_CM 1 100. 0. 1. DISPLAY_IDENTIFIER LV_INH_DIAG_VLS_UP_MAX_2 ECU_ADDRESS 0x3fc820 BYTE_ORDER MSB_LAST BIT_MASK 0x40000000 /end MEASUREMENT
/begin MEASUREMENT lam_bank_2.ls_up_diag_inci.bf.lv_inh_diag_vls_up_oc "Boolean flag indicating project specific application conditions for VLS_UP open line diagnosis not met" ULONG _CNV_S_2_RANGE______0_CM 1 100. 0. 1. DISPLAY_IDENTIFIER LV_INH_DIAG_VLS_UP_OC_2 ECU_ADDRESS 0x3fc820 BYTE_ORDER MSB_LAST BIT_MASK 0x20000000 /end MEASUREMENT
/begin MEASUREMENT lam_bank_2.ls_up_diag_inci.bf.lv_inh_diag_vls_up_puc "Boolean flag indicating project specific application conditions for VLS_UP_PUC diagnosis not met" ULONG _CNV_S_2_RANGE______0_CM 1 100. 0. 1. DISPLAY_IDENTIFIER LV_INH_DIAG_VLS_UP_PUC_2 ECU_ADDRESS 0x3fc820 BYTE_ORDER MSB_LAST BIT_MASK 0x10000000 /end MEASUREMENT
/begin MEASUREMENT lam_bank_2.ls_up_diag_inci.bf.lv_inh_diag_vls_up_stk "Boolean flag indicating project specific application conditions for VLS_UP_STK diagnosis not met" ULONG _CNV_S_2_RANGE______0_CM 1 100. 0. 1. DISPLAY_IDENTIFIER LV_INH_DIAG_VLS_UP_STK_2 ECU_ADDRESS 0x3fc820 BYTE_ORDER MSB_LAST BIT_MASK 0x8000000 /end MEASUREMENT
/begin MEASUREMENT lam_bank_2.ls_up_diag_inci.bf.lv_inh_diag_vls_up_min_cold "Boolean flag indicating project specific application conditions for VLS_UP_MIN_COLD diagnosis not met" ULONG _CNV_S_2_RANGE______0_CM 1 100. 0. 1. DISPLAY_IDENTIFIER LV_INH_DIAG_VLS_UP_MIN_COLD_2 ECU_ADDRESS 0x3fc820 BYTE_ORDER MSB_LAST BIT_MASK 0x4000000 /end MEASUREMENT
/begin MEASUREMENT lam_bank_2.ls_down_diag.t_dly_vls_down_min_cold "Delay time for final diagnosis activation" UWORD _CNV_A_R_LINEAR_____24_CM 1 100. 0. 6553.5 DISPLAY_IDENTIFIER T_DLY_VLS_DOWN_MIN_COLD_2 ECU_ADDRESS 0x3fc6d8 BYTE_ORDER MSB_LAST FORMAT "%5.1" /end MEASUREMENT
/begin MEASUREMENT lam_bank_2.ls_down_diag.t_diag_vls_down_min_cold "Maximum activation time for diagnosis activation" UWORD _CNV_A_R_LINEAR_____24_CM 1 100. 0. 6553.5 DISPLAY_IDENTIFIER T_DIAG_VLS_DOWN_MIN_COLD_2 ECU_ADDRESS 0x3fc6da BYTE_ORDER MSB_LAST FORMAT "%5.1" /end MEASUREMENT
/begin MEASUREMENT lam_bank_2.ls_down_diag.t_dly_vls_down_min "Delay time for final diagnosis activation" UWORD _CNV_A_R_LINEAR_____24_CM 1 100. 0. 6553.5 DISPLAY_IDENTIFIER T_DLY_VLS_DOWN_MIN_2 ECU_ADDRESS 0x3fc6e4 BYTE_ORDER MSB_LAST FORMAT "%5.1" /end MEASUREMENT
/begin MEASUREMENT lam_bank_2.ls_down_diag.t_dly_vls_down_oc "Delay time for final diagnosis activation" UWORD _CNV_A_R_LINEAR_____24_CM 1 100. 0. 6553.5 DISPLAY_IDENTIFIER T_DLY_VLS_DOWN_OC_2 ECU_ADDRESS 0x3fc6e6 BYTE_ORDER MSB_LAST FORMAT "%5.1" /end MEASUREMENT
/begin MEASUREMENT lam_bank_2.ls_down_diag.bf.lv_req_chk_ls_down "Request for starting the downstream sensor active plausibility check" ULONG _CNV_S_2_RANGE______0_CM 1 100. 0. 1. DISPLAY_IDENTIFIER LV_REQ_CHK_LS_DOWN_2 ECU_ADDRESS 0x3fc6d4 BYTE_ORDER MSB_LAST BIT_MASK 0x80000000 /end MEASUREMENT
/begin MEASUREMENT lam_bank_2.ls_down_diag.t_err_cdn_vls_down_min "Detection time for status MIN before diagnosis" UWORD _CNV_A_R_LINEAR_____24_CM 1 100. 0. 6553.5 DISPLAY_IDENTIFIER T_ERR_CDN_VLS_DOWN_MIN_2 ECU_ADDRESS 0x3fc6dc BYTE_ORDER MSB_LAST FORMAT "%5.1" /end MEASUREMENT
/begin MEASUREMENT lam_bank_2.ls_down_diag.t_err_cdn_vls_down_oc "Detection time for status OC for diagnosis" UWORD _CNV_A_R_LINEAR_____24_CM 1 100. 0. 6553.5 DISPLAY_IDENTIFIER T_ERR_CDN_VLS_DOWN_OC_2 ECU_ADDRESS 0x3fc6de BYTE_ORDER MSB_LAST FORMAT "%5.1" /end MEASUREMENT
/begin MEASUREMENT lam_bank_2.ls_down_diag.t_end_diag_vls_down_min "Timer for setting LV_END_DIAG_VLS_DOWN_MIN" UWORD _CNV_A_R_LINEAR_____24_CM 1 100. 0. 6553.5 DISPLAY_IDENTIFIER T_END_DIAG_VLS_DOWN_MIN_2 ECU_ADDRESS 0x3fc6e0 BYTE_ORDER MSB_LAST FORMAT "%5.1" /end MEASUREMENT
/begin MEASUREMENT lam_bank_2.ls_down_diag.t_end_diag_vls_down_oc "Timer for setting LV_END_DIAG_VLS_DOWN_OC" UWORD _CNV_A_R_LINEAR_____24_CM 1 100. 0. 6553.5 DISPLAY_IDENTIFIER T_END_DIAG_VLS_DOWN_OC_2 ECU_ADDRESS 0x3fc6e2 BYTE_ORDER MSB_LAST FORMAT "%5.1" /end MEASUREMENT
/begin MEASUREMENT lam_bank_2.ls_down_diag_inci.bf.lv_inh_diag_vls_down_min "Boolean flag indicating project specific application conditions for downstream SCG diagnosis not met" ULONG _CNV_S_2_RANGE______0_CM 1 100. 0. 1. DISPLAY_IDENTIFIER LV_INH_DIAG_VLS_DOWN_MIN_2 ECU_ADDRESS 0x3fc6e8 BYTE_ORDER MSB_LAST BIT_MASK 0x80000000 /end MEASUREMENT
/begin MEASUREMENT lam_bank_2.ls_down_diag_inci.bf.lv_inh_diag_vls_down_max "Boolean flag indicating project specific application conditions for downstream short to plus diagnosis not met" ULONG _CNV_S_2_RANGE______0_CM 1 100. 0. 1. DISPLAY_IDENTIFIER LV_INH_DIAG_VLS_DOWN_MAX_2 ECU_ADDRESS 0x3fc6e8 BYTE_ORDER MSB_LAST BIT_MASK 0x40000000 /end MEASUREMENT
/begin MEASUREMENT lam_bank_2.ls_down_diag_inci.bf.lv_inh_diag_vls_down_oc "Boolean flag indicating project specific application conditions for downstream open line diagnosis not met" ULONG _CNV_S_2_RANGE______0_CM 1 100. 0. 1. DISPLAY_IDENTIFIER LV_INH_DIAG_VLS_DOWN_OC_2 ECU_ADDRESS 0x3fc6e8 BYTE_ORDER MSB_LAST BIT_MASK 0x20000000 /end MEASUREMENT
/begin MEASUREMENT lam_bank_2.ls_down_diag_inci.bf.lv_inh_diag_vls_down_min_cold "Boolean flag indicating project specific application conditions for downstream SCG (Cold test) diagnosis not met" ULONG _CNV_S_2_RANGE______0_CM 1 100. 0. 1. DISPLAY_IDENTIFIER LV_INH_DIAG_VLS_DOWN_MIN_COLD_2 ECU_ADDRESS 0x3fc6e8 BYTE_ORDER MSB_LAST BIT_MASK 0x10000000 /end MEASUREMENT
/begin MEASUREMENT lv_err_vls_down_1 "General error flag for Lambda downstream sensors" UBYTE _CNV_S_2_RANGE______5_CM 1 100. 0. 1. DISPLAY_IDENTIFIER LV_ERR_VLS_DOWN_1 ECU_ADDRESS 0x3fdffe BIT_MASK 0x1 /end MEASUREMENT
/begin MEASUREMENT lv_err_vls_down_2 "General error flag for Lambda downstream sensors" UBYTE _CNV_S_2_RANGE______5_CM 1 100. 0. 1. DISPLAY_IDENTIFIER LV_ERR_VLS_DOWN_2 ECU_ADDRESS 0x3fdfff BIT_MASK 0x1 /end MEASUREMENT
/begin CHARACTERISTIC c_r_down_ls_max_vls_down_min "Maximum resistance threshold oxygen sensor internal resistance during short to ground sensor" VALUE 0x01760 _REC_VAL_20_u2 65535. _CNV_A_R_LINEAR_____279_CM 0. 65535. DISPLAY_IDENTIFIER C_R_DOWN_LS_MAX_VLS_DOWN_MIN FORMAT "%5.0" /end CHARACTERISTIC
/begin CHARACTERISTIC c_maf_kgh_min_vls_down_min "Minimum duration required for continious low VLS_DOWN_i detection" VALUE 0x01696 _REC_VAL_20_u2 2047.96875 _CNV_A_R_LINEAR_____113_CM 0. 2047.96875 DISPLAY_IDENTIFIER C_MAF_KGH_MIN_VLS_DOWN_MIN FORMAT "%7.2" /end CHARACTERISTIC
/begin CHARACTERISTIC c_vls_down_min_diag "Oxygen sensor voltage threshold under which short to GND may be present" VALUE 0x01a16 _REC_VAL_20_u2 4.99511719 _CNV_A_R_LINEAR_____3_CM 0. 4.99511719 DISPLAY_IDENTIFIER C_VLS_DOWN_MIN_DIAG FORMAT "%5.3" /end CHARACTERISTIC
/begin CHARACTERISTIC c_vls_down_max_diag "Oxygen sensor voltage threshold over which short to Vbatt present" VALUE 0x01a12 _REC_VAL_20_u2 4.99511719 _CNV_A_R_LINEAR_____3_CM 0. 4.99511719 DISPLAY_IDENTIFIER C_VLS_DOWN_MAX_DIAG FORMAT "%5.3" /end CHARACTERISTIC
/begin CHARACTERISTIC c_vls_down_afl_diag "Oxygen sensor voltage-lean mixture threshold for diagnosis" VALUE 0x019fe _REC_VAL_20_u2 4.99511719 _CNV_A_R_LINEAR_____3_CM 0. 4.99511719 DISPLAY_IDENTIFIER C_VLS_DOWN_AFL_DIAG FORMAT "%5.3" /end CHARACTERISTIC
/begin CHARACTERISTIC c_vls_down_afr_diag "Oxygen sensor voltage-rich mixture threshold for diagnosis" VALUE 0x01a02 _REC_VAL_20_u2 4.99511719 _CNV_A_R_LINEAR_____3_CM 0. 4.99511719 DISPLAY_IDENTIFIER C_VLS_DOWN_AFR_DIAG FORMAT "%5.3" /end CHARACTERISTIC
/begin CHARACTERISTIC c_r_down_min_vls_down_oc "Minimum resistance threshold oxygen sensor internal resistance during open circuit sensor" VALUE 0x01762 _REC_VAL_20_u2 65535. _CNV_A_R_LINEAR_____279_CM 0. 65535. DISPLAY_IDENTIFIER C_R_DOWN_MIN_VLS_DOWN_OC FORMAT "%5.0" /end CHARACTERISTIC
/begin CHARACTERISTIC c_t_dly_vls_down_min "Minimum duration required for low VLS_DOWN_i detection" VALUE 0x01818 _REC_VAL_20_u2 6553.5 _CNV_A_R_LINEAR_____24_CM 0. 6553.5 DISPLAY_IDENTIFIER C_T_DLY_VLS_DOWN_MIN FORMAT "%5.1" /end CHARACTERISTIC
/begin CHARACTERISTIC c_t_es_dew_vls_down_min_cold "Minimum required ES time for short to ground diagnosis (Cold - test)" VALUE 0x01842 _REC_VAL_20_u2 65535. _CNV_A_R_LINEAR_____97_CM 0. 65535. DISPLAY_IDENTIFIER C_T_ES_DEW_VLS_DOWN_MIN_COLD FORMAT "%5.0" /end CHARACTERISTIC
/begin CHARACTERISTIC c_t_diag_vls_down_min_cold "Maximum activation time for diagnosis activation (Cold - test)" VALUE 0x017dc _REC_VAL_20_u2 6553.5 _CNV_A_R_LINEAR_____24_CM 0. 6553.5 DISPLAY_IDENTIFIER C_T_DIAG_VLS_DOWN_MIN_COLD FORMAT "%5.1" /end CHARACTERISTIC
/begin CHARACTERISTIC c_t_dly_vls_down_min_cold "Minimum required delay after ST for activation of short to ground diagnosis (Cold - test)" VALUE 0x0181a _REC_VAL_20_u2 6553.5 _CNV_A_R_LINEAR_____24_CM 0. 6553.5 DISPLAY_IDENTIFIER C_T_DLY_VLS_DOWN_MIN_COLD FORMAT "%5.1" /end CHARACTERISTIC
/begin CHARACTERISTIC c_t_dly_vls_down_oc "Minimum resistance threshold oxygen sensor internal resistance during open circuit sensor" VALUE 0x0181c _REC_VAL_20_u2 6553.5 _CNV_A_R_LINEAR_____24_CM 0. 6553.5 DISPLAY_IDENTIFIER C_T_DLY_VLS_DOWN_OC FORMAT "%5.1" /end CHARACTERISTIC
/begin CHARACTERISTIC c_teg_cat_down_mdl_vls_down_oc "Minimum requested exhaust gas temperature for diagnosis" VALUE 0x018d8 _REC_VAL_20_u2 2047. _CNV_A_R_LINEAR_____7_CM 0. 2047. DISPLAY_IDENTIFIER C_TEG_CAT_DOWN_MDL_VLS_DOWN_OC FORMAT "%7.2" /end CHARACTERISTIC
/begin MEASUREMENT lv_err_vls_down_min_2 "Boolean error flag, short to ground fault currently present on downstream oxygen sensor signal" UBYTE _CNV_S_2_RANGE______5_CM 1 100. 0. 1. DISPLAY_IDENTIFIER LV_ERR_VLS_DOWN_MIN_2 ECU_ADDRESS 0x3fb834 BIT_MASK 0x1 /end MEASUREMENT
/begin MEASUREMENT lv_err_vls_down_max_2 "Boolean error flag, short to plus fault currently present on downstream oxygen sensor signal" UBYTE _CNV_S_2_RANGE______5_CM 1 100. 0. 1. DISPLAY_IDENTIFIER LV_ERR_VLS_DOWN_MAX_2 ECU_ADDRESS 0x3fb824 BIT_MASK 0x1 /end MEASUREMENT
/begin MEASUREMENT lv_err_vls_down_max_1 "Boolean error flag, short to plus fault currently present on downstream oxygen sensor signal" UBYTE _CNV_S_2_RANGE______5_CM 1 100. 0. 1. DISPLAY_IDENTIFIER LV_ERR_VLS_DOWN_MAX_1 ECU_ADDRESS 0x3fb820 BIT_MASK 0x1 /end MEASUREMENT
/begin MEASUREMENT lv_err_vls_down_oc_1 "Boolean error flag, short to ground fault currently present on downstream oxygen sensor signal" UBYTE _CNV_S_2_RANGE______5_CM 1 100. 0. 1. DISPLAY_IDENTIFIER LV_ERR_VLS_DOWN_OC_1 ECU_ADDRESS 0x3fb838 BIT_MASK 0x1 /end MEASUREMENT
/begin MEASUREMENT lv_err_vls_down_oc_2 "Boolean error flag, short to ground fault currently present on downstream oxygen sensor signal" UBYTE _CNV_S_2_RANGE______5_CM 1 100. 0. 1. DISPLAY_IDENTIFIER LV_ERR_VLS_DOWN_OC_2 ECU_ADDRESS 0x3fb83c BIT_MASK 0x1 /end MEASUREMENT
/begin MEASUREMENT lv_err_vls_down_min_1 "Boolean error flag, short to ground fault currently present on downstream oxygen sensor signal" UBYTE _CNV_S_2_RANGE______5_CM 1 100. 0. 1. DISPLAY_IDENTIFIER LV_ERR_VLS_DOWN_MIN_1 ECU_ADDRESS 0x3fb830 BIT_MASK 0x1 /end MEASUREMENT
/begin MEASUREMENT lv_err_vls_down_min_cold_1 "Boolean error flag, short to ground fault currently present on downstream oxygen sensor signal" UBYTE _CNV_S_2_RANGE______6_R_CM 1 100. 0. 255. DISPLAY_IDENTIFIER LV_ERR_VLS_DOWN_MIN_COLD_1 ECU_ADDRESS 0x3fb828 /end MEASUREMENT
/begin MEASUREMENT lv_err_vls_down_min_cold_2 "Boolean error flag, short to ground fault currently present on downstream oxygen sensor signal" UBYTE _CNV_S_2_RANGE______6_R_CM 1 100. 0. 255. DISPLAY_IDENTIFIER LV_ERR_VLS_DOWN_MIN_COLD_2 ECU_ADDRESS 0x3fb82c /end MEASUREMENT
/begin CHARACTERISTIC c_t_err_cdn_vls_down_min "Minimum duration required for continuus low VLS_DOWN_i detection" VALUE 0x01836 _REC_VAL_20_u2 6553.5 _CNV_A_R_LINEAR_____24_CM 0. 6553.5 DISPLAY_IDENTIFIER C_T_ERR_CDN_VLS_DOWN_MIN FORMAT "%5.1" /end CHARACTERISTIC
/begin CHARACTERISTIC c_t_err_cdn_vls_down_oc "Minimum required duration where voltage and resistance lie inside of the limits for operable sensor to detect fault" VALUE 0x01838 _REC_VAL_20_u2 6553.5 _CNV_A_R_LINEAR_____24_CM 0. 6553.5 DISPLAY_IDENTIFIER C_T_ERR_CDN_VLS_DOWN_OC FORMAT "%5.1" /end CHARACTERISTIC
/begin MEASUREMENT lv_err_vls_up_2 "General error flag for Lambda upstream sensors" UBYTE _CNV_S_2_RANGE______5_CM 1 100. 0. 1. DISPLAY_IDENTIFIER LV_ERR_VLS_UP_2 ECU_ADDRESS 0x3fe003 BIT_MASK 0x1 /end MEASUREMENT
/begin MEASUREMENT lv_err_vls_up_1 "General error flag for Lambda upstream sensors" UBYTE _CNV_S_2_RANGE______5_CM 1 100. 0. 1. DISPLAY_IDENTIFIER LV_ERR_VLS_UP_1 ECU_ADDRESS 0x3fe002 BIT_MASK 0x1 /end MEASUREMENT
/begin CHARACTERISTIC c_r_up_ls_max_vls_up_min "Maximum resitance threshold oxygen sensor internal resistance during short to ground sensor" VALUE 0x01766 _REC_VAL_20_u2 65535. _CNV_A_R_LINEAR_____279_CM 0. 65535. DISPLAY_IDENTIFIER C_R_UP_LS_MAX_VLS_UP_MIN FORMAT "%5.0" /end CHARACTERISTIC
/begin CHARACTERISTIC c_t_dly_lam_lim_vls_up_min "Minimum required delay for which lambda controller limited at max. value (continuous lean AFR present)" VALUE 0x017fa _REC_VAL_20_u2 6553.5 _CNV_A_R_LINEAR_____24_CM 0. 6553.5 DISPLAY_IDENTIFIER C_T_DLY_LAM_LIM_VLS_UP_MIN FORMAT "%5.1" /end CHARACTERISTIC
/begin CHARACTERISTIC c_vls_up_max_diag "Oxygen sensor voltage threshold over which short to Vbatt present" VALUE 0x01a34 _REC_VAL_20_u2 4.99511719 _CNV_A_R_LINEAR_____3_CM 0. 4.99511719 DISPLAY_IDENTIFIER C_VLS_UP_MAX_DIAG FORMAT "%5.3" /end CHARACTERISTIC
/begin CHARACTERISTIC c_vls_up_afl_diag "Oxygen sensor voltage-lean mixture threshold for diagnosis" VALUE 0x01a30 _REC_VAL_20_u2 4.99511719 _CNV_A_R_LINEAR_____3_CM 0. 4.99511719 DISPLAY_IDENTIFIER C_VLS_UP_AFL_DIAG FORMAT "%5.3" /end CHARACTERISTIC
/begin CHARACTERISTIC c_vls_up_afr_diag "Oxygen sensor voltage-rich mixture threshold for diagnosis" VALUE 0x01a32 _REC_VAL_20_u2 4.99511719 _CNV_A_R_LINEAR_____3_CM 0. 4.99511719 DISPLAY_IDENTIFIER C_VLS_UP_AFR_DIAG FORMAT "%5.3" /end CHARACTERISTIC
/begin CHARACTERISTIC c_t_vls_cyc_max_stk "Maximum cycle time to activate the diagnosis" VALUE 0x00845 _REC_VAL_20_u1 2.55 _CNV_A_R_LINEAR_____4_CM 0. 2.55 DISPLAY_IDENTIFIER C_T_VLS_CYC_MAX_STK FORMAT "%4.2" /end CHARACTERISTIC
/begin CHARACTERISTIC c_vls_up_min_diag "Oxygen sensor voltage threshold under which short to GND may be present" VALUE 0x01a36 _REC_VAL_20_u2 4.99511719 _CNV_A_R_LINEAR_____3_CM 0. 4.99511719 DISPLAY_IDENTIFIER C_VLS_UP_MIN_DIAG FORMAT "%5.3" /end CHARACTERISTIC
/begin CHARACTERISTIC c_r_up_ls_min_vls_up_oc "Minimum resitance threshold oxygen sensor internal resistance during open circuit sensor" VALUE 0x01768 _REC_VAL_20_u2 65535. _CNV_A_R_LINEAR_____279_CM 0. 65535. DISPLAY_IDENTIFIER C_R_UP_LS_MIN_VLS_UP_OC FORMAT "%5.0" /end CHARACTERISTIC
/begin CHARACTERISTIC c_vls_dif_bol_tol_min "Difference threshold of the L-mean value for error detection" VALUE 0x019fc _REC_VAL_20_u2 4.99992371 _CNV_A_R_LINEAR_____250_CM 0. 4.99992371 DISPLAY_IDENTIFIER C_VLS_DIF_BOL_TOL_MIN FORMAT "%7.5" /end CHARACTERISTIC
/begin CHARACTERISTIC c_lam_p_ctr_diag "Number of P-Jumps after LSCL=1 for diagnosis begin" VALUE 0x0071c _REC_VAL_20_u1 255. _CNV_A_R_LINEAR_____1_CM 0. 255. DISPLAY_IDENTIFIER C_LAM_P_CTR_DIAG FORMAT "%3.0" /end CHARACTERISTIC
/begin CHARACTERISTIC c_maf_kgh_min_vls_up_min "Minimum MAF_KGH threshold required to permit diagnosis to take place" VALUE 0x01698 _REC_VAL_20_u2 2047.96875 _CNV_A_R_LINEAR_____113_CM 0. 2047.96875 DISPLAY_IDENTIFIER C_MAF_KGH_MIN_VLS_UP_MIN FORMAT "%7.2" /end CHARACTERISTIC
/begin CHARACTERISTIC c_maf_int_min_vls_up_diag "Minimum threshold for MAF integral required to start upstream PUC signal plausibility" VALUE 0x0166c _REC_VAL_20_u2 1820.398 _CNV_A_R_LINEAR_____271_CM 0. 1820.398 DISPLAY_IDENTIFIER C_MAF_INT_MIN_VLS_UP_DIAG FORMAT "%7.2" /end CHARACTERISTIC
/begin CHARACTERISTIC c_maf_int_max_vls_up_diag "Maximum threshold for MAF integral required to start upstream PUC signal plausibility" VALUE 0x01660 _REC_VAL_20_u2 1820.398 _CNV_A_R_LINEAR_____271_CM 0. 1820.398 DISPLAY_IDENTIFIER C_MAF_INT_MAX_VLS_UP_DIAG FORMAT "%7.2" /end CHARACTERISTIC
/begin CHARACTERISTIC c_vls_up_min_puc "VLS voltage threshold for PUC fault detection" VALUE 0x01a38 _REC_VAL_20_u2 4.99511719 _CNV_A_R_LINEAR_____3_CM 0. 4.99511719 DISPLAY_IDENTIFIER C_VLS_UP_MIN_PUC FORMAT "%5.3" /end CHARACTERISTIC
/begin CHARACTERISTIC c_t_es_dew_vls_up_min_cold "Minimum required ES time for short to ground diagnosis (Cold - test)" VALUE 0x01844 _REC_VAL_20_u2 65535. _CNV_A_R_LINEAR_____97_CM 0. 65535. DISPLAY_IDENTIFIER C_T_ES_DEW_VLS_UP_MIN_COLD FORMAT "%5.0" /end CHARACTERISTIC
/begin CHARACTERISTIC c_teg_cat_up_mdl_vls_up_min "Minimum required exhaust gas temperature for diagnosis" VALUE 0x018de _REC_VAL_20_u2 2047. _CNV_A_R_LINEAR_____7_CM 0. 2047. DISPLAY_IDENTIFIER C_TEG_CAT_UP_MDL_VLS_UP_MIN FORMAT "%7.2" /end CHARACTERISTIC
/begin CHARACTERISTIC c_vls_down_max_vls_up_min_diag "Downstream - sensor voltage threshold for short to GND error detection" VALUE 0x01a14 _REC_VAL_20_u2 4.99511719 _CNV_A_R_LINEAR_____3_CM 0. 4.99511719 DISPLAY_IDENTIFIER C_VLS_DOWN_MAX_VLS_UP_MIN_DIAG FORMAT "%5.3" /end CHARACTERISTIC
/begin CHARACTERISTIC c_t_diag_vls_up_min_cold "Maximum activation time for diagnosis activation (Cold - test)" VALUE 0x017de _REC_VAL_20_u2 6553.5 _CNV_A_R_LINEAR_____24_CM 0. 6553.5 DISPLAY_IDENTIFIER C_T_DIAG_VLS_UP_MIN_COLD FORMAT "%5.1" /end CHARACTERISTIC
/begin CHARACTERISTIC c_t_dly_vls_up_min_cold "Minimum required delay after ST for activation of short to ground diagnosis (Cold - test)" VALUE 0x01820 _REC_VAL_20_u2 6553.5 _CNV_A_R_LINEAR_____24_CM 0. 6553.5 DISPLAY_IDENTIFIER C_T_DLY_VLS_UP_MIN_COLD FORMAT "%5.1" /end CHARACTERISTIC
/begin MEASUREMENT lv_err_vls_up_min_2 "Error flag for Lambda upstream sensors" UBYTE _CNV_S_2_RANGE______5_CM 1 100. 0. 1. DISPLAY_IDENTIFIER LV_ERR_VLS_UP_MIN_2 ECU_ADDRESS 0x3fbb68 BIT_MASK 0x1 /end MEASUREMENT
/begin MEASUREMENT lv_err_vls_up_max_1 "Boolean error flag, short to plus fault currently present on upstream oxygen sensor signal" UBYTE _CNV_S_2_RANGE______5_CM 1 100. 0. 1. DISPLAY_IDENTIFIER LV_ERR_VLS_UP_MAX_1 ECU_ADDRESS 0x3fbb6c BIT_MASK 0x1 /end MEASUREMENT
/begin MEASUREMENT lv_err_vls_up_max_2 "Boolean error flag, short to plus fault currently present on upstream oxygen sensor signal" UBYTE _CNV_S_2_RANGE______5_CM 1 100. 0. 1. DISPLAY_IDENTIFIER LV_ERR_VLS_UP_MAX_2 ECU_ADDRESS 0x3fbb70 BIT_MASK 0x1 /end MEASUREMENT
/begin MEASUREMENT lv_err_vls_up_oc_1 "Boolean error flag, OC plausibility fault currently present on upstream oxygen sensor signal" UBYTE _CNV_S_2_RANGE______5_CM 1 100. 0. 1. DISPLAY_IDENTIFIER LV_ERR_VLS_UP_OC_1 ECU_ADDRESS 0x3fbb74 BIT_MASK 0x1 /end MEASUREMENT
/begin MEASUREMENT lv_err_vls_up_oc_2 "Boolean error flag, OC plausibility fault currently present on upstream oxygen sensor signal" UBYTE _CNV_S_2_RANGE______5_CM 1 100. 0. 1. DISPLAY_IDENTIFIER LV_ERR_VLS_UP_OC_2 ECU_ADDRESS 0x3fbb78 BIT_MASK 0x1 /end MEASUREMENT
/begin MEASUREMENT lv_err_vls_up_min_1 "Error flag for Lambda upstream sensors" UBYTE _CNV_S_2_RANGE______5_CM 1 100. 0. 1. DISPLAY_IDENTIFIER LV_ERR_VLS_UP_MIN_1 ECU_ADDRESS 0x3fbb64 BIT_MASK 0x1 /end MEASUREMENT
/begin MEASUREMENT lv_err_vls_up_min_cold_1 "Error flag for Lambda upstream sensors" UBYTE _CNV_S_2_RANGE______6_R_CM 1 100. 0. 255. DISPLAY_IDENTIFIER LV_ERR_VLS_UP_MIN_COLD_1 ECU_ADDRESS 0x3fbb5c /end MEASUREMENT
/begin MEASUREMENT lv_err_vls_up_min_cold_2 "Error flag for Lambda upstream sensors" UBYTE _CNV_S_2_RANGE______6_R_CM 1 100. 0. 255. DISPLAY_IDENTIFIER LV_ERR_VLS_UP_MIN_COLD_2 ECU_ADDRESS 0x3fbb60 /end MEASUREMENT
/begin MEASUREMENT lv_err_vls_up_puc_1 "Boolean error flag, PUC plausibility fault currently present on upstream oxygen sensor signal" UBYTE _CNV_S_2_RANGE______5_CM 1 100. 0. 1. DISPLAY_IDENTIFIER LV_ERR_VLS_UP_PUC_1 ECU_ADDRESS 0x3fbb7c BIT_MASK 0x1 /end MEASUREMENT
/begin MEASUREMENT lv_err_vls_up_puc_2 "Boolean error flag, PUC plausibility fault currently present on upstream oxygen sensor signal" UBYTE _CNV_S_2_RANGE______5_CM 1 100. 0. 1. DISPLAY_IDENTIFIER LV_ERR_VLS_UP_PUC_2 ECU_ADDRESS 0x3fbb80 BIT_MASK 0x1 /end MEASUREMENT
/begin MEASUREMENT lv_err_vls_up_stk_1 "voltage excursion error, UP 1" UBYTE _CNV_S_2_RANGE______6_R_CM 1 100. 0. 255. DISPLAY_IDENTIFIER LV_ERR_VLS_UP_STK_1 ECU_ADDRESS 0x3fbb84 /end MEASUREMENT
/begin MEASUREMENT lv_err_vls_up_stk_2 "voltage excursion error, UP 2" UBYTE _CNV_S_2_RANGE______6_R_CM 1 100. 0. 255. DISPLAY_IDENTIFIER LV_ERR_VLS_UP_STK_2 ECU_ADDRESS 0x3fbb88 /end MEASUREMENT
/begin CHARACTERISTIC c_t_err_cdn_vls_up_min "Minimum required delay where the error conditions are active to detect fault" VALUE 0x0183a _REC_VAL_20_u2 6553.5 _CNV_A_R_LINEAR_____24_CM 0. 6553.5 DISPLAY_IDENTIFIER C_T_ERR_CDN_VLS_UP_MIN FORMAT "%5.1" /end CHARACTERISTIC
/begin CHARACTERISTIC c_t_err_cdn_vls_up_oc "Minimum required duration where voltage lies within voltag band to detect fault" VALUE 0x0183c _REC_VAL_20_u2 6553.5 _CNV_A_R_LINEAR_____24_CM 0. 6553.5 DISPLAY_IDENTIFIER C_T_ERR_CDN_VLS_UP_OC FORMAT "%5.1" /end CHARACTERISTIC
/begin CHARACTERISTIC c_t_dly_vls_up_min "Minimum required delay for forced activation of short to ground diagnosis" VALUE 0x0181e _REC_VAL_20_u2 6553.5 _CNV_A_R_LINEAR_____24_CM 0. 6553.5 DISPLAY_IDENTIFIER C_T_DLY_VLS_UP_MIN FORMAT "%5.1" /end CHARACTERISTIC
/begin CHARACTERISTIC c_t_dly_vls_up_oc "Minimum required delay for forced activation of open circuit diagnosis" VALUE 0x01822 _REC_VAL_20_u2 6553.5 _CNV_A_R_LINEAR_____24_CM 0. 6553.5 DISPLAY_IDENTIFIER C_T_DLY_VLS_UP_OC FORMAT "%5.1" /end CHARACTERISTIC
/begin CHARACTERISTIC c_ti_lam_cor_vls_up_oc_min "Min. threshold for lambda controller for diagnosis" VALUE 0x0046a _REC_VAL_20_s2 99.99847412 _CNV_A_R_LINEAR_____109_CM -50. 49.99847412 DISPLAY_IDENTIFIER C_TI_LAM_COR_VLS_UP_OC_MIN FORMAT "%5.4" /end CHARACTERISTIC
/begin CHARACTERISTIC c_ti_lam_cor_vls_up_oc_max "Max. threshold for lambda controller for diagnosis" VALUE 0x00468 _REC_VAL_20_s2 99.99847412 _CNV_A_R_LINEAR_____109_CM -50. 49.99847412 DISPLAY_IDENTIFIER C_TI_LAM_COR_VLS_UP_OC_MAX FORMAT "%5.4" /end CHARACTERISTIC
/begin MEASUREMENT t_min_ls "Time for the duration with open A/F control loop if the oxygen sensors are not ready" UWORD _CNV_A_R_LINEAR_____24_CM 1 100. 0.1 6553.5 DISPLAY_IDENTIFIER T_MIN_LS ECU_ADDRESS 0x3fd0cc BYTE_ORDER MSB_LAST FORMAT "%6.1" /end MEASUREMENT
/begin MEASUREMENT maf_sp_s "MAF setpoint for stratified mode" UWORD _CNV_A_R_LINEAR_____106_CM 1 100. 0. 1389. DISPLAY_IDENTIFIER MAF_SP_S ECU_ADDRESS 0x3fcf22 BYTE_ORDER MSB_LAST FORMAT "%6.2" /end MEASUREMENT
/begin MEASUREMENT fac_maf_max_s "Ratio between MAF and MAF_MAX for stratified mode" UWORD _CNV_A_R_LINEAR_____21_CM 1 100. 0. 1.99996948 DISPLAY_IDENTIFIER FAC_MAF_MAX_S ECU_ADDRESS 0x3fcf28 BYTE_ORDER MSB_LAST FORMAT "%7.5" /end MEASUREMENT
/begin MEASUREMENT maf_dif_s "Air mass flow difference in stratified combustion" UWORD _CNV_A_R_LINEAR_____350_CM 1 100. -694.5 694.5 DISPLAY_IDENTIFIER MAF_DIF_S ECU_ADDRESS 0x3fcf26 BYTE_ORDER MSB_LAST FORMAT "%7.2" /end MEASUREMENT
/begin CHARACTERISTIC ip_pq_egr_sp "MAF setpoint for stratified mode" MAP 0x0d47e _REC_MAP_20_u2_u1_u2 0.99998474 _CNV_A_R_LINEAR_____37_CM 0. 0.99998474 DISPLAY_IDENTIFIER IP_PQ_EGR_SP FORMAT "%7.5"
 /begin AXIS_DESCR COM_AXIS n_32 _CNV_A_R_LINEAR_____16_CM 8 0. 8160. FORMAT "%4.0" AXIS_PTS_REF ldp_n_32__pq_egr_sp /end AXIS_DESCR
 /begin AXIS_DESCR COM_AXIS mff_sp_s _CNV_A_R_LINEAR_____106_CM 6 0. 1389. FORMAT "%7.2" AXIS_PTS_REF ldp_mff_sp_s__pq_egr_sp /end AXIS_DESCR
/end CHARACTERISTIC
/begin CHARACTERISTIC ip_fac_maf_max_s "Ratio between MAF and MAF_MAX for stratified mode" MAP 0x0acea _REC_MAP_20_u2_u1_u2 1.99996948 _CNV_A_R_LINEAR_____21_CM 0. 1.99996948 DISPLAY_IDENTIFIER IP_FAC_MAF_MAX_S FORMAT "%7.5"
 /begin AXIS_DESCR COM_AXIS n_32 _CNV_A_R_LINEAR_____16_CM 8 0. 8160. FORMAT "%4.0" AXIS_PTS_REF ldp_n_32__fac_maf_max_s /end AXIS_DESCR
 /begin AXIS_DESCR COM_AXIS mff_sp_s _CNV_A_R_LINEAR_____106_CM 6 0. 1389. FORMAT "%7.2" AXIS_PTS_REF ldp_mff_sp_s__fac_maf_max_s /end AXIS_DESCR
/end CHARACTERISTIC
/begin CHARACTERISTIC ip_eff_maf_s "AIR efficiency in stratified combustion" CURVE 0x09cbe _REC_CUR_20_u2_u2 1.99996948 _CNV_A_R_LINEAR_____21_CM 0. 1.99996948 DISPLAY_IDENTIFIER IP_EFF_MAF_S FORMAT "%7.5"
 /begin AXIS_DESCR COM_AXIS maf_dif_s _CNV_A_R_LINEAR_____350_CM 16 -694.5 694.5 FORMAT "%7.2" AXIS_PTS_REF ldp_maf_dif_s__eff_maf_s /end AXIS_DESCR
/end CHARACTERISTIC
/begin CHARACTERISTIC lc_maf_sp_egr "Logical variable switch mass flow and partial pressure" VALUE 0x00f57 _REC_VAL_20_u1 1. _CNV_A_R_LINEAR_____22_CM 0. 1. DISPLAY_IDENTIFIER LC_MAF_SP_EGR FORMAT "%1.0" /end CHARACTERISTIC
/begin AXIS_PTS ldp_n_32__pq_egr_sp "" 0x07c49 n_32 _REC_AXS_20_u1 816. _CNV_A_R_LINEAR_____16_CM 8 0. 8160. DISPLAY_IDENTIFIER LDP_N_32__PQ_EGR_SP FORMAT "%4.0" /end AXIS_PTS
/begin AXIS_PTS ldp_n_32__fac_maf_max_s "" 0x07bcd n_32 _REC_AXS_20_u1 816. _CNV_A_R_LINEAR_____16_CM 8 0. 8160. DISPLAY_IDENTIFIER LDP_N_32__FAC_MAF_MAX_S FORMAT "%4.0" /end AXIS_PTS
/begin AXIS_PTS ldp_mff_sp_s__fac_maf_max_s "" 0x10e54 mff_sp_s _REC_AXS_20_u2 1389. _CNV_A_R_LINEAR_____106_CM 6 0. 1389. DISPLAY_IDENTIFIER LDP_MFF_SP_S__FAC_MAF_MAX_S FORMAT "%7.2" /end AXIS_PTS
/begin AXIS_PTS ldp_maf_dif_s__eff_maf_s "" 0x10c34 maf_dif_s _REC_AXS_20_u2 1389. _CNV_A_R_LINEAR_____350_CM 16 -694.5 694.5 DISPLAY_IDENTIFIER LDP_MAF_DIF_S__EFF_MAF_S FORMAT "%7.2" /end AXIS_PTS
/begin AXIS_PTS ldp_mff_sp_s__pq_egr_sp "" 0x10e62 mff_sp_s _REC_AXS_20_u2 1389. _CNV_A_R_LINEAR_____106_CM 6 0. 1389. DISPLAY_IDENTIFIER LDP_MFF_SP_S__PQ_EGR_SP FORMAT "%7.2" /end AXIS_PTS
/begin MEASUREMENT maf_sp "MAF setpoint output for inverse air path" UWORD _CNV_A_R_LINEAR_____106_CM 1 100. 0. 1389. DISPLAY_IDENTIFIER MAF_SP ECU_ADDRESS 0x3fd030 BYTE_ORDER MSB_LAST FORMAT "%6.2" /end MEASUREMENT
/begin MEASUREMENT maf_sp_isa "MAF setpoint output for inverse air path of idle speed actuator (ISA)" UWORD _CNV_A_R_LINEAR_____106_CM 1 100. 0. 1389. DISPLAY_IDENTIFIER MAF_SP_ISA ECU_ADDRESS 0x3fd032 BYTE_ORDER MSB_LAST FORMAT "%6.2" /end MEASUREMENT
/begin CHARACTERISTIC lc_isa_ena "logical constant enabled idle speed actuator (ISA)" VALUE 0x00f48 _REC_VAL_20_u1 1. _CNV_A_R_LINEAR_____1_CM 0. 1. DISPLAY_IDENTIFIER LC_ISA_ENA FORMAT "%2.0" /end CHARACTERISTIC
/begin MEASUREMENT lv_isa_ena "logical variable for enabled idle speed actuator (ISA)" UBYTE _CNV_S_2_RANGE______0_CM 1 100. 0. 1. DISPLAY_IDENTIFIER LV_ISA_ENA ECU_ADDRESS 0x3fdfa9 /end MEASUREMENT
/begin CHARACTERISTIC ip_maf_sp_isa "Setpoint mass air flow idle speed actuator (ISA)" MAP 0x0c936 _REC_MAP_20_u2_u1_u2 0.99998474 _CNV_A_R_LINEAR_____37_CM 0. 0.99998474 DISPLAY_IDENTIFIER IP_MAF_SP_ISA FORMAT "%7.5"
 /begin AXIS_DESCR COM_AXIS maf_turb_ratio_max _CNV_A_R_LINEAR_____127_CM 8 0. 3.984375 FORMAT "%4.2" AXIS_PTS_REF ldp_maf_turb_ratio__maf_sp_isa /end AXIS_DESCR
 /begin AXIS_DESCR COM_AXIS n _CNV_A_R_LINEAR_____11_CM 6 0. 8160. FORMAT "%4.0" AXIS_PTS_REF ldp_n__maf_sp_isa /end AXIS_DESCR
/end CHARACTERISTIC
/begin MEASUREMENT maf_turb_ratio_max "maximum mass air flow ratio turbolence system / total MAF" UBYTE _CNV_A_R_LINEAR_____127_CM 1 100. 0. 3.984375 DISPLAY_IDENTIFIER MAF_TURB_RATIO_MAX ECU_ADDRESS 0x3fdfaa FORMAT "%4.2" /end MEASUREMENT
/begin AXIS_PTS ldp_maf_turb_ratio__maf_sp_isa "" 0x07bae maf_turb_ratio_max _REC_AXS_20_u1 3.984375 _CNV_A_R_LINEAR_____127_CM 8 0. 3.984375 DISPLAY_IDENTIFIER LDP_MAF_TURB_RATIO__MAF_SP_ISA FORMAT "%4.2" /end AXIS_PTS
/begin AXIS_PTS ldp_n__maf_sp_isa "" 0x10ea6 n _REC_AXS_20_u2 816. _CNV_A_R_LINEAR_____11_CM 6 0. 8160. DISPLAY_IDENTIFIER LDP_N__MAF_SP_ISA FORMAT "%4.0" /end AXIS_PTS
/begin CHARACTERISTIC c_mtcpwm_i_max_pos "Limitation of I-share upwards" VALUE 0x00438 _REC_VAL_20_s2 199.99694824 _CNV_A_R_LINEAR_____298_CM -100. 99.99694824 DISPLAY_IDENTIFIER C_MTCPWM_I_MAX_POS FORMAT "%8.3" /end CHARACTERISTIC
/begin MEASUREMENT tps_dif "gradient of controller deviation" UWORD _CNV_A_R_LINEAR_____359_CM 1 100. -119.5 119.5 DISPLAY_IDENTIFIER TPS_DIF ECU_ADDRESS 0x3fd806 BYTE_ORDER MSB_LAST FORMAT "%8.3" /end MEASUREMENT
/begin CHARACTERISTIC ip_mtcpwm_d__tps_dif_grd "Position controller D-share" CURVE 0x0ce76 _REC_CUR_20_u2_u2 799.987793 _CNV_A_R_LINEAR_____360_CM -400. 399.987793 DISPLAY_IDENTIFIER IP_MTCPWM_D__TPS_DIF_GRD FORMAT "%7.2"
 /begin AXIS_DESCR COM_AXIS tps_dif_grd _CNV_A_R_LINEAR_____359_CM 8 -119.5 119.5 FORMAT "%8.3" AXIS_PTS_REF ldp_tps_dif_grd__mtcpwm_d /end AXIS_DESCR
/end CHARACTERISTIC
/begin CHARACTERISTIC ip_mtcpwm_i__tps_dif "Position controller I-share" CURVE 0x0ce86 _REC_CUR_20_u2_u2 199.99694824 _CNV_A_R_LINEAR_____361_CM -100. 99.99694824 DISPLAY_IDENTIFIER IP_MTCPWM_I__TPS_DIF FORMAT "%8.3"
 /begin AXIS_DESCR COM_AXIS tps_dif _CNV_A_R_LINEAR_____359_CM 8 -119.5 119.5 FORMAT "%8.3" AXIS_PTS_REF ldp_tps_dif__mtcpwm_i /end AXIS_DESCR
/end CHARACTERISTIC
/begin CHARACTERISTIC ip_mtcpwm_p__tps_dif "Position controller P-share" CURVE 0x0ce96 _REC_CUR_20_u2_u2 799.987793 _CNV_A_R_LINEAR_____360_CM -400. 399.987793 DISPLAY_IDENTIFIER IP_MTCPWM_P__TPS_DIF FORMAT "%7.2"
 /begin AXIS_DESCR COM_AXIS tps_dif _CNV_A_R_LINEAR_____359_CM 8 -119.5 119.5 FORMAT "%8.3" AXIS_PTS_REF ldp_tps_dif__mtcpwm_p /end AXIS_DESCR
/end CHARACTERISTIC
/begin CHARACTERISTIC ip_mtcpwm_vb_fac__vb "Battery voltage correction" CURVE 0x00cf3 _REC_CUR_20_u1_u1 1.99220002 _CNV_A_R_LINEAR_____39_CM 0. 1.99220002 DISPLAY_IDENTIFIER IP_MTCPWM_VB_FAC__VB FORMAT "%5.3"
 /begin AXIS_DESCR COM_AXIS vb _CNV_A_R_LINEAR_____34_CM 8 0. 25.8984 FORMAT "%3.1" AXIS_PTS_REF ldp_vb__mtcpwm_vb_fac /end AXIS_DESCR
/end CHARACTERISTIC
/begin MEASUREMENT mtcpwm_add "Duty cycle of the feed-forward-control" SWORD _CNV_A_R_LINEAR_____298_CM 1 100. -100. 99.99694824 DISPLAY_IDENTIFIER MTCPWM_ADD ECU_ADDRESS 0x3fd80e BYTE_ORDER MSB_LAST FORMAT "%8.3" /end MEASUREMENT
/begin MEASUREMENT mtcpwm_ctl "Duty cycle of the PID-controller" SLONG _CNV_A_R_LINEAR_____362_CM 1 100. -400. 400. DISPLAY_IDENTIFIER MTCPWM_CTL ECU_ADDRESS 0x3fcd20 BYTE_ORDER MSB_LAST FORMAT "%8.3" /end MEASUREMENT
/begin MEASUREMENT mtcpwm_d "Duty cycle of the D-share" SWORD _CNV_A_R_LINEAR_____363_CM 1 100. -400. 399.987793 DISPLAY_IDENTIFIER MTCPWM_D ECU_ADDRESS 0x3fd816 BYTE_ORDER MSB_LAST FORMAT "%7.2" /end MEASUREMENT
/begin MEASUREMENT mtcpwm_p "Duty cycle of the P-share" SWORD _CNV_A_R_LINEAR_____363_CM 1 100. -400. 399.987793 DISPLAY_IDENTIFIER MTCPWM_P ECU_ADDRESS 0x3fd812 BYTE_ORDER MSB_LAST FORMAT "%7.2" /end MEASUREMENT
/begin MEASUREMENT mtcpwm_i "Duty cycle of the I-share" SWORD _CNV_A_R_LINEAR_____298_CM 1 100. -100. 99.99694824 DISPLAY_IDENTIFIER MTCPWM_I ECU_ADDRESS 0x3fd814 BYTE_ORDER MSB_LAST FORMAT "%8.3" /end MEASUREMENT
/begin MEASUREMENT mtcpwm_i_add "Manipulated previous I-share" SWORD _CNV_A_R_LINEAR_____298_CM 1 100. -100. 99.99694824 DISPLAY_IDENTIFIER MTCPWM_I_ADD ECU_ADDRESS 0x3fd81a BYTE_ORDER MSB_LAST FORMAT "%8.3" /end MEASUREMENT
/begin MEASUREMENT tps_sp_lih_dif "Difference between TPS_SP and TPS_LIH" UWORD _CNV_A_R_LINEAR_____359_CM 1 100. -119.5 119.5 DISPLAY_IDENTIFIER TPS_SP_LIH_DIF ECU_ADDRESS 0x3fd80c BYTE_ORDER MSB_LAST FORMAT "%8.3" /end MEASUREMENT
/begin CHARACTERISTIC c_tps_sp_lih_dif_hys "Hysteresis for detection of direction change" VALUE 0x01952 _REC_VAL_20_u2 119.5 _CNV_A_R_LINEAR_____53_CM 0. 119.5 DISPLAY_IDENTIFIER C_TPS_SP_LIH_DIF_HYS FORMAT "%7.3" /end CHARACTERISTIC
/begin CHARACTERISTIC c_mtcpwm_i_max_neg "Limitation of I-share downwards" VALUE 0x00436 _REC_VAL_20_s2 199.99694824 _CNV_A_R_LINEAR_____298_CM -100. 99.99694824 DISPLAY_IDENTIFIER C_MTCPWM_I_MAX_NEG FORMAT "%8.3" /end CHARACTERISTIC
/begin CHARACTERISTIC c_mtcpwm_i_add "Init value for I-Part while TPS_SP_LIH_DIF is crossing LH" VALUE 0x00432 _REC_VAL_20_s2 199.99694824 _CNV_A_R_LINEAR_____298_CM -100. 99.99694824 DISPLAY_IDENTIFIER C_MTCPWM_I_ADD FORMAT "%8.3" /end CHARACTERISTIC
/begin CHARACTERISTIC c_mtcpwm_add_fil "Filter parameter" VALUE 0x0074e _REC_VAL_20_u1 0.9960940000000002 _CNV_A_R_LINEAR_____50_CM 0. 0.996094 DISPLAY_IDENTIFIER C_MTCPWM_ADD_FIL FORMAT "%5.3" /end CHARACTERISTIC
/begin CHARACTERISTIC ip_mtcpwm_i_fac__tps_av_lih_dif "Angle dependent I-part manipulation" CURVE 0x00ceb _REC_CUR_20_u1_u2 7.96875 _CNV_A_R_LINEAR_____235_CM 0. 7.96875 DISPLAY_IDENTIFIER IP_MTCPWM_I_FAC__TPS_AV_LIH_DIF FORMAT "%4.2"
 /begin AXIS_DESCR COM_AXIS tps_av_lih_dif _CNV_A_R_LINEAR_____359_CM 8 -119.5 119.5 FORMAT "%8.3" AXIS_PTS_REF ldp_tps_av_lih_dif_mtcpwm_i /end AXIS_DESCR
/end CHARACTERISTIC
/begin CHARACTERISTIC ip_mtcpwm_add__tps_sp_lih_dif "Setpoint dependent Feed Forward Value" CURVE 0x0ce66 _REC_CUR_20_u2_u2 199.99694824 _CNV_A_R_LINEAR_____361_CM -100. 99.99694824 DISPLAY_IDENTIFIER IP_MTCPWM_ADD__TPS_SP_LIH_DIF FORMAT "%8.3"
 /begin AXIS_DESCR COM_AXIS tps_sp_lih_dif _CNV_A_R_LINEAR_____359_CM 8 -119.5 119.5 FORMAT "%8.3" AXIS_PTS_REF ldp_tps_sp_lih_dif__mtcpwm_add /end AXIS_DESCR
/end CHARACTERISTIC
/begin MEASUREMENT mtcpwm_vb_fac "Battery voltage correction" UBYTE _CNV_A_R_LINEAR_____39_CM 1 100. 0. 1.99220002 DISPLAY_IDENTIFIER MTCPWM_VB_FAC ECU_ADDRESS 0x3fe539 FORMAT "%5.3" /end MEASUREMENT
/begin MEASUREMENT tps_dif_grd "Controller deviation" UWORD _CNV_A_R_LINEAR_____359_CM 1 100. -119.5 119.5 DISPLAY_IDENTIFIER TPS_DIF_GRD ECU_ADDRESS 0x3fd810 BYTE_ORDER MSB_LAST /end MEASUREMENT
/begin MEASUREMENT t_mtcpwm_close_act "time counter for closing condition" UWORD _CNV_A_R_LINEAR_____364_CM 1 100. 0. 5110. DISPLAY_IDENTIFIER T_MTCPWM_CLOSE_ACT ECU_ADDRESS 0x3fd808 BYTE_ORDER MSB_LAST FORMAT "%5.0" /end MEASUREMENT
/begin MEASUREMENT tps_sp_ctl "throttle position setpoint ( + or - )" SWORD _CNV_A_R_LINEAR_____365_CM 1 100. -119.5 119.5 DISPLAY_IDENTIFIER TPS_SP_CTL ECU_ADDRESS 0x3fd818 BYTE_ORDER MSB_LAST FORMAT "%8.3" /end MEASUREMENT
/begin MEASUREMENT lv_tps_sp_pos "position detection of TPS-setpoint (0: below LIH; 1: above LIH)" UBYTE _CNV_S_2_RANGE______0_CM 1 100. 0. 1. DISPLAY_IDENTIFIER LV_TPS_SP_POS ECU_ADDRESS 0x3fe53b /end MEASUREMENT
/begin MEASUREMENT lv_tps_chg_pos "detection of changed direction from LV_TPS_SP_POS" UBYTE _CNV_S_2_RANGE______0_CM 1 100. 0. 1. DISPLAY_IDENTIFIER LV_TPS_CHG_POS ECU_ADDRESS 0x3fe53c /end MEASUREMENT
/begin CHARACTERISTIC c_t_mtcpwm_close_act_max "Timer threshold for switching to closing duty cycle" VALUE 0x01882 _REC_VAL_20_u2 5. _CNV_A_R_LINEAR_____366_CM 0. 5. DISPLAY_IDENTIFIER C_T_MTCPWM_CLOSE_ACT_MAX FORMAT "%5.3" /end CHARACTERISTIC
/begin CHARACTERISTIC c_mtcpwm_close_max "duty cycle limitation at bottom mechanical limit" VALUE 0x00430 _REC_VAL_20_s2 199.99694824 _CNV_A_R_LINEAR_____298_CM -100. 99.99694824 DISPLAY_IDENTIFIER C_MTCPWM_CLOSE_MAX FORMAT "%8.3" /end CHARACTERISTIC
/begin CHARACTERISTIC c_tps_sp_stop_hys "setpoint hysteresis for closing throttle" VALUE 0x01966 _REC_VAL_20_u2 119.5 _CNV_A_R_LINEAR_____53_CM 0. 119.5 DISPLAY_IDENTIFIER C_TPS_SP_STOP_HYS FORMAT "%7.3" /end CHARACTERISTIC
/begin CHARACTERISTIC c_tps_sp_stop_max "threshold for testing duty cycle on value" VALUE 0x01968 _REC_VAL_20_u2 119.5 _CNV_A_R_LINEAR_____53_CM 0. 119.5 DISPLAY_IDENTIFIER C_TPS_SP_STOP_MAX FORMAT "%7.3" /end CHARACTERISTIC
/begin CHARACTERISTIC c_mtcpwm_i_ini "initialization of MTCPWM_I" VALUE 0x00434 _REC_VAL_20_s2 199.99694824 _CNV_A_R_LINEAR_____298_CM -100. 99.99694824 DISPLAY_IDENTIFIER C_MTCPWM_I_INI FORMAT "%8.3" /end CHARACTERISTIC
/begin CHARACTERISTIC c_tps_sp_ctl_max "limitation of TPS_SP_CTL" VALUE 0x00470 _REC_VAL_20_s2 119.5 _CNV_A_R_LINEAR_____365_CM -119.5 0. DISPLAY_IDENTIFIER C_TPS_SP_CTL_MAX FORMAT "%8.3" /end CHARACTERISTIC
/begin CHARACTERISTIC c_mtcpwm_close "closing duty cycle" VALUE 0x0042e _REC_VAL_20_s2 199.99694824 _CNV_A_R_LINEAR_____298_CM -100. 99.99694824 DISPLAY_IDENTIFIER C_MTCPWM_CLOSE FORMAT "%8.3" /end CHARACTERISTIC
/begin CHARACTERISTIC c_mtcpwm_hys "hysteresis to prevent MTCPWM-switching according to VB-changes" VALUE 0x016d0 _REC_VAL_20_u2 100. _CNV_A_R_LINEAR_____367_CM 0. 100. DISPLAY_IDENTIFIER C_MTCPWM_HYS FORMAT "%7.3" /end CHARACTERISTIC
/begin MEASUREMENT mtcpwm "Duty cycle of the ETC Position Controller" SWORD _CNV_A_R_LINEAR_____298_CM 1 100. -100. 99.99694824 DISPLAY_IDENTIFIER MTCPWM ECU_ADDRESS 0x3fd804 BYTE_ORDER MSB_LAST FORMAT "%8.3" /end MEASUREMENT
/begin MEASUREMENT lv_mtcpwm_close_act "logical variable (is set, if closing duty cycle is active" UBYTE _CNV_S_2_RANGE______0_CM 1 100. 0. 1. DISPLAY_IDENTIFIER LV_MTCPWM_CLOSE_ACT ECU_ADDRESS 0x3fe53a /end MEASUREMENT
/begin MEASUREMENT tps_av_lih_dif "Difference between TPS_AV and TPS_LIH" UWORD _CNV_A_R_LINEAR_____359_CM 1 100. -119.5 119.5 DISPLAY_IDENTIFIER TPS_AV_LIH_DIF ECU_ADDRESS 0x3fd80a BYTE_ORDER MSB_LAST FORMAT "%8.3" /end MEASUREMENT
/begin AXIS_PTS ldp_tps_dif__mtcpwm_p "" 0x1128c tps_dif _REC_AXS_20_u2 239. _CNV_A_R_LINEAR_____359_CM 8 -119.5 119.5 DISPLAY_IDENTIFIER LDP_TPS_DIF__MTCPWM_P FORMAT "%8.3" /end AXIS_PTS
/begin AXIS_PTS ldp_tps_dif__mtcpwm_i "" 0x1127a tps_dif _REC_AXS_20_u2 239. _CNV_A_R_LINEAR_____359_CM 8 -119.5 119.5 DISPLAY_IDENTIFIER LDP_TPS_DIF__MTCPWM_I FORMAT "%8.3" /end AXIS_PTS
/begin AXIS_PTS ldp_tps_av_lih_dif_mtcpwm_i "" 0x11268 tps_av_lih_dif _REC_AXS_20_u2 239. _CNV_A_R_LINEAR_____359_CM 8 -119.5 119.5 DISPLAY_IDENTIFIER LDP_TPS_AV_LIH_DIF_MTCPWM_I FORMAT "%8.3" /end AXIS_PTS
/begin AXIS_PTS ldp_tps_dif_grd__mtcpwm_d "" 0x1129e tps_dif_grd _REC_AXS_20_u2 239. _CNV_A_R_LINEAR_____359_CM 8 -119.5 119.5 DISPLAY_IDENTIFIER LDP_TPS_DIF_GRD__MTCPWM_D FORMAT "%8.3" /end AXIS_PTS
/begin AXIS_PTS ldp_tps_sp_lih_dif__mtcpwm_add "" 0x112ec tps_sp_lih_dif _REC_AXS_20_u2 239. _CNV_A_R_LINEAR_____359_CM 8 -119.5 119.5 DISPLAY_IDENTIFIER LDP_TPS_SP_LIH_DIF__MTCPWM_ADD FORMAT "%8.3" /end AXIS_PTS
/begin AXIS_PTS ldp_vb__mtcpwm_vb_fac "" 0x07ec0 vb _REC_AXS_20_u1 25.8984 _CNV_A_R_LINEAR_____34_CM 8 0. 25.8984 DISPLAY_IDENTIFIER LDP_VB__MTCPWM_VB_FAC FORMAT "%3.1" /end AXIS_PTS
/begin CHARACTERISTIC c_mtcpwm_pi_max_diag "Diagnosis threshold for MTCPWM" VALUE 0x016d2 _REC_VAL_20_u2 100. _CNV_A_R_LINEAR_____367_CM 0. 100. DISPLAY_IDENTIFIER C_MTCPWM_PI_MAX_DIAG FORMAT "%7.3" /end CHARACTERISTIC
/begin CHARACTERISTIC c_tps_dif_max_diag "Maximum permissible control variance" VALUE 0x01938 _REC_VAL_20_u2 119.5 _CNV_A_R_LINEAR_____53_CM 0. 119.5 DISPLAY_IDENTIFIER C_TPS_DIF_MAX_DIAG FORMAT "%7.3" /end CHARACTERISTIC
/begin CHARACTERISTIC c_t_tps_dif_diag "Tolerance time control variance" VALUE 0x00841 _REC_VAL_20_u1 2.55 _CNV_A_R_LINEAR_____4_CM 0. 2.55 DISPLAY_IDENTIFIER C_T_TPS_DIF_DIAG FORMAT "%4.2" /end CHARACTERISTIC
/begin CHARACTERISTIC c_t_mtcpwm_pi_diag_cur_off "Time threshold for end \"break-away\"" VALUE 0x00831 _REC_VAL_20_u1 2.55 _CNV_A_R_LINEAR_____4_CM 0. 2.55 DISPLAY_IDENTIFIER C_T_MTCPWM_PI_DIAG_CUR_OFF FORMAT "%4.2" /end CHARACTERISTIC
/begin CHARACTERISTIC c_t_mtcpwm_pi_diag "Tolerance time MTCPWM-error" VALUE 0x00830 _REC_VAL_20_u1 2.55 _CNV_A_R_LINEAR_____4_CM 0. 2.55 DISPLAY_IDENTIFIER C_T_MTCPWM_PI_DIAG FORMAT "%4.2" /end CHARACTERISTIC
/begin MEASUREMENT lv_inh_mtc_ctl "State Bit for Deactivation of the ETC Position Controller Output" UBYTE _CNV_S_2_RANGE______0_CM 1 100. 0. 1. DISPLAY_IDENTIFIER LV_INH_MTC_CTL ECU_ADDRESS 0x3fe534 /end MEASUREMENT
/begin CHARACTERISTIC ip_n_max_tol_st "upper engine speed limit for ST" CURVE 0x06a96 _REC_CUR_20_u1_u1 8160. _CNV_A_R_LINEAR_____16_CM 0. 8160. DISPLAY_IDENTIFIER IP_N_MAX_TOL_ST FORMAT "%4.0"
 /begin AXIS_DESCR COM_AXIS tco _CNV_A_R_LINEAR_____12_CM 9 -48. 142.5 FORMAT "%5.1" AXIS_PTS_REF ldpm_tco_9 /end AXIS_DESCR
/end CHARACTERISTIC
/begin MEASUREMENT t_poil_swi_pwl "Timer for oil pressure inclination after engine stop" UBYTE _CNV_A_R_LINEAR_____24_CM 1 100. 0. 6.2 DISPLAY_IDENTIFIER T_POIL_SWI_PWL ECU_ADDRESS 0x3fe242 FORMAT "%3.1" /end MEASUREMENT
/begin CHARACTERISTIC c_t_poil_swi_pwl "Time for oil pressure inclination" VALUE 0x00836 _REC_VAL_20_u1 6.2 _CNV_A_R_LINEAR_____24_CM 0. 6.2 DISPLAY_IDENTIFIER C_T_POIL_SWI_PWL FORMAT "%3.1" /end CHARACTERISTIC
/begin CHARACTERISTIC c_toil_poil_swi_max_diag "Time for oil pressure inclination" VALUE 0x008ed _REC_VAL_20_u1 200. _CNV_A_R_LINEAR_____15_CM -40. 160. DISPLAY_IDENTIFIER C_TOIL_POIL_SWI_MAX_DIAG FORMAT "%3.0" /end CHARACTERISTIC
/begin CHARACTERISTIC c_toil_poil_swi_min_diag "Minimum diagnosis threshold TOIL" VALUE 0x008ee _REC_VAL_20_u1 200. _CNV_A_R_LINEAR_____15_CM -40. 160. DISPLAY_IDENTIFIER C_TOIL_POIL_SWI_MIN_DIAG FORMAT "%3.0" /end CHARACTERISTIC
/begin MEASUREMENT lv_err_poil_swi "Error oil pressure switch" UBYTE _CNV_S_2_RANGE______2_R_CM 1 100. 0. 255. DISPLAY_IDENTIFIER LV_ERR_POIL_SWI ECU_ADDRESS 0x3fba98 /end MEASUREMENT
/begin CHARACTERISTIC c_v_sof_swi_min "Input voltage threshold min" VALUE 0x019b0 _REC_VAL_20_u2 4.99511719 _CNV_A_R_LINEAR_____3_CM 0. 4.99511719 DISPLAY_IDENTIFIER C_V_SOF_SWI_MIN FORMAT "%5.3" /end CHARACTERISTIC
/begin CHARACTERISTIC c_v_sof_swi_max "Input voltage threshold max" VALUE 0x019ae _REC_VAL_20_u2 4.99511719 _CNV_A_R_LINEAR_____3_CM 0. 4.99511719 DISPLAY_IDENTIFIER C_V_SOF_SWI_MAX FORMAT "%5.3" /end CHARACTERISTIC
/begin MEASUREMENT lv_err_sof_req "Erroflag sport-mode switch request" UBYTE _CNV_S_2_RANGE______2_R_CM 1 100. 0. 255. DISPLAY_IDENTIFIER LV_ERR_SOF_REQ ECU_ADDRESS 0x3fba8c /end MEASUREMENT
/begin MEASUREMENT lv_err_sof "Erroflag sound flap" UBYTE _CNV_S_2_RANGE______2_R_CM 1 100. 0. 255. DISPLAY_IDENTIFIER LV_ERR_SOF ECU_ADDRESS 0x3fba88 /end MEASUREMENT
/begin MEASUREMENT int_tq_gs_inc "Integrated Torque request EGS" UWORD _CNV_A_R_LINEAR_____102_CM 1 100. 0. 204.7 DISPLAY_IDENTIFIER INT_TQ_GS_INC ECU_ADDRESS 0x3fd6f2 BYTE_ORDER MSB_LAST FORMAT "%7.3" /end MEASUREMENT
/begin MEASUREMENT lv_ac_max_tq_gs_inc "GS about AC requested torque value to high and not plausible" UBYTE _CNV_S_2_RANGE______0_CM 1 100. 0. 1. DISPLAY_IDENTIFIER LV_AC_MAX_TQ_GS_INC ECU_ADDRESS 0x3fe4b8 /end MEASUREMENT
/begin MEASUREMENT lv_t_min_tq_gs_inc_deac "Minimum time between two requests to low" UBYTE _CNV_S_2_RANGE______0_CM 1 100. 0. 1. DISPLAY_IDENTIFIER LV_T_MIN_TQ_GS_INC_DEAC ECU_ADDRESS 0x3fe4b9 /end MEASUREMENT
/begin MEASUREMENT ctr_t_dif_min_tq_gs_inc "Counter Min time limit threshold time delay" UBYTE _CNV_A_R_LINEAR_____4_CM 1 100. 0. 2.55 DISPLAY_IDENTIFIER CTR_T_DIF_MIN_TQ_GS_INC ECU_ADDRESS 0x3fe4bf FORMAT "%4.2" /end MEASUREMENT
/begin MEASUREMENT state_gs_plaus "State GS torque increase not plausible" UBYTE _CNV_A_R_LINEAR_____1_CM 1 100. 0. 255. DISPLAY_IDENTIFIER STATE_GS_PLAUS ECU_ADDRESS 0x3fe4b2 FORMAT "%3.0" /end MEASUREMENT
/begin MEASUREMENT lv_vs_min_tq_gs_inc "GS about VS torque increase not plausible" UBYTE _CNV_S_2_RANGE______0_CM 1 100. 0. 1. DISPLAY_IDENTIFIER LV_VS_MIN_TQ_GS_INC ECU_ADDRESS 0x3fe4b6 /end MEASUREMENT
/begin MEASUREMENT ctr_t_vs_tq_gs_inc "Vehicle speed threshold time delay" UBYTE _CNV_A_R_LINEAR_____4_CM 1 100. 0. 2.55 DISPLAY_IDENTIFIER CTR_T_VS_TQ_GS_INC ECU_ADDRESS 0x3fe4bd FORMAT "%4.2" /end MEASUREMENT
/begin CHARACTERISTIC c_int_tq_gs_inc_rest "Minimum integrated GS intervention torque" VALUE 0x015da _REC_VAL_20_u2 204.7 _CNV_A_R_LINEAR_____102_CM 0. 204.7 DISPLAY_IDENTIFIER C_INT_TQ_GS_INC_REST FORMAT "%7.3" /end CHARACTERISTIC
/begin CHARACTERISTIC c_vs_min_tq_gs_inc "Vehicle speed threshold" VALUE 0x01a54 _REC_VAL_20_u2 511.99218 _CNV_A_R_LINEAR_____85_CM 0. 511.99218 DISPLAY_IDENTIFIER C_VS_MIN_TQ_GS_INC FORMAT "%7.3" /end CHARACTERISTIC
/begin CHARACTERISTIC c_t_dly_min_vs_tq_gs_inc "Vehicle speed threshold time delay" VALUE 0x00803 _REC_VAL_20_u1 2.55 _CNV_A_R_LINEAR_____4_CM 0. 2.55 DISPLAY_IDENTIFIER C_T_DLY_MIN_VS_TQ_GS_INC FORMAT "%4.2" /end CHARACTERISTIC
/begin CHARACTERISTIC c_crlc_tq_gs_inc_plaus "Correlation of torque request " VALUE 0x0063b _REC_VAL_20_u1 0.99610001 _CNV_A_R_LINEAR_____29_CM 0. 0.99610001 DISPLAY_IDENTIFIER C_CRLC_TQ_GS_INC_PLAUS FORMAT "%5.3" /end CHARACTERISTIC
/begin CHARACTERISTIC c_int_max_tq_gs_inc "Max value integrated torque" VALUE 0x015d6 _REC_VAL_20_u2 204.7 _CNV_A_R_LINEAR_____102_CM 0. 204.7 DISPLAY_IDENTIFIER C_INT_MAX_TQ_GS_INC FORMAT "%7.3" /end CHARACTERISTIC
/begin CHARACTERISTIC c_int_min_tq_gs_inc "Min value integrated torque" VALUE 0x015d8 _REC_VAL_20_u2 204.7 _CNV_A_R_LINEAR_____102_CM 0. 204.7 DISPLAY_IDENTIFIER C_INT_MIN_TQ_GS_INC FORMAT "%7.3" /end CHARACTERISTIC
/begin CHARACTERISTIC c_t_dly_min_ac_tq_gs_inc "AC threshold time delay" VALUE 0x00802 _REC_VAL_20_u1 2.55 _CNV_A_R_LINEAR_____4_CM 0. 2.55 DISPLAY_IDENTIFIER C_T_DLY_MIN_AC_TQ_GS_INC FORMAT "%4.2" /end CHARACTERISTIC
/begin MEASUREMENT lv_int_max_tq_gs_inc "Gs requested torque value to high and not plausible" UBYTE _CNV_S_2_RANGE______0_CM 1 100. 0. 1. DISPLAY_IDENTIFIER LV_INT_MAX_TQ_GS_INC ECU_ADDRESS 0x3fe4b7 /end MEASUREMENT
/begin MEASUREMENT ctr_t_ac_tq_gs_inc "AC counter time delay" UBYTE _CNV_A_R_LINEAR_____4_CM 1 100. 0. 2.55 DISPLAY_IDENTIFIER CTR_T_AC_TQ_GS_INC ECU_ADDRESS 0x3fe4be FORMAT "%4.2" /end MEASUREMENT
/begin CHARACTERISTIC c_t_dif_min_tq_gs_inc "Min time limit threshold time delay" VALUE 0x007ee _REC_VAL_20_u1 2.55 _CNV_A_R_LINEAR_____4_CM 0. 2.55 DISPLAY_IDENTIFIER C_T_DIF_MIN_TQ_GS_INC FORMAT "%4.2" /end CHARACTERISTIC
/begin MEASUREMENT lv_t_max_tq_gs_inc "Requesting time to long" UBYTE _CNV_S_2_RANGE______0_CM 1 100. 0. 1. DISPLAY_IDENTIFIER LV_T_MAX_TQ_GS_INC ECU_ADDRESS 0x3fe4ba /end MEASUREMENT
/begin MEASUREMENT ctr_t_max_tq_gs_inc "Counter MAX time limit threshold time" UBYTE _CNV_A_R_LINEAR_____4_CM 1 100. 0. 2.55 DISPLAY_IDENTIFIER CTR_T_MAX_TQ_GS_INC ECU_ADDRESS 0x3fe4c0 FORMAT "%4.2" /end MEASUREMENT
/begin CHARACTERISTIC ip_ac_max_tq_gs_inc "Acceleration threshold" CURVE 0x08ab4 _REC_CUR_20_u2_u2 102.35 _CNV_A_R_LINEAR_____103_CM -51.175 51.175 DISPLAY_IDENTIFIER IP_AC_MAX_TQ_GS_INC FORMAT "%7.4"
 /begin AXIS_DESCR COM_AXIS vs_fil _CNV_A_R_LINEAR_____85_CM 6 0. 511.99218 FORMAT "%7.3" AXIS_PTS_REF ldp_vs_fil__tq_gs_inc /end AXIS_DESCR
/end CHARACTERISTIC
/begin CHARACTERISTIC ip_tq_max_tq_gs_inc "Maximum requested torque EGS" CURVE 0x0ff82 _REC_CUR_20_u2_u1 1023.96875 _CNV_A_R_LINEAR_____55_CM 0. 1023.96875 DISPLAY_IDENTIFIER IP_TQ_MAX_TQ_GS_INC FORMAT "%7.2"
 /begin AXIS_DESCR COM_AXIS n_32 _CNV_A_R_LINEAR_____16_CM 6 0. 8160. FORMAT "%4.0" AXIS_PTS_REF ldp_n_32__tq_gs_inc /end AXIS_DESCR
/end CHARACTERISTIC
/begin CHARACTERISTIC c_t_max_tq_gs_inc "Min time limit threshold time delay" VALUE 0x00826 _REC_VAL_20_u1 2.55 _CNV_A_R_LINEAR_____4_CM 0. 2.55 DISPLAY_IDENTIFIER C_T_MAX_TQ_GS_INC FORMAT "%4.2" /end CHARACTERISTIC
/begin CHARACTERISTIC c_t_dly_tq_max_tq_gs_inc "Min time limit threshold time delay" VALUE 0x0080a _REC_VAL_20_u1 2.55 _CNV_A_R_LINEAR_____4_CM 0. 2.55 DISPLAY_IDENTIFIER C_T_DLY_TQ_MAX_TQ_GS_INC FORMAT "%4.2" /end CHARACTERISTIC
/begin MEASUREMENT state_err_amt_can "State of AMT Error intervention CAN 11H" UBYTE _CNV_A_R_LINEAR_____1_CM 1 100. 0. 5. DISPLAY_IDENTIFIER STATE_ERR_AMT_CAN ECU_ADDRESS 0x3fe4b4 FORMAT "%2.0" /end MEASUREMENT
/begin MEASUREMENT lv_amt_es_req "AMT request of engine stop" UBYTE _CNV_S_2_RANGE______0_CM 1 100. 0. 1. DISPLAY_IDENTIFIER LV_AMT_ES_REQ ECU_ADDRESS 0x3fe4bc /end MEASUREMENT
/begin MEASUREMENT t_state_amt_1_diag "Intervention  in shift phase 1" UWORD _CNV_A_R_LINEAR_____4_CM 1 100. 0. 655.35 DISPLAY_IDENTIFIER T_STATE_AMT_1_DIAG ECU_ADDRESS 0x3fd6f6 BYTE_ORDER MSB_LAST FORMAT "%6.2" /end MEASUREMENT
/begin MEASUREMENT t_state_amt_2_diag "Intervention  in shift phase 2" UWORD _CNV_A_R_LINEAR_____4_CM 1 100. 0. 655.35 DISPLAY_IDENTIFIER T_STATE_AMT_2_DIAG ECU_ADDRESS 0x3fd6f8 BYTE_ORDER MSB_LAST FORMAT "%6.2" /end MEASUREMENT
/begin MEASUREMENT t_state_amt_3_diag "Intervention  in shift phase 3" UWORD _CNV_A_R_LINEAR_____4_CM 1 100. 0. 655.35 DISPLAY_IDENTIFIER T_STATE_AMT_3_DIAG ECU_ADDRESS 0x3fd6fa BYTE_ORDER MSB_LAST FORMAT "%6.2" /end MEASUREMENT
/begin MEASUREMENT state_err_amt "State of AMT Error intervention" UBYTE _CNV_A_R_LINEAR_____1_CM 1 100. 0. 255. DISPLAY_IDENTIFIER STATE_ERR_AMT ECU_ADDRESS 0x3fe4b3 FORMAT "%3.0" /end MEASUREMENT
/begin MEASUREMENT state_amt_old "Previos shift phase3" UBYTE _CNV_A_R_LINEAR_____1_CM 1 100. 0. 3. DISPLAY_IDENTIFIER STATE_AMT_OLD ECU_ADDRESS 0x3fe4c2 FORMAT "%2.0" /end MEASUREMENT
/begin MEASUREMENT t_state_clu_amt_diag "Timer clutch state " UWORD _CNV_A_R_LINEAR_____4_CM 1 100. 0. 655.35 DISPLAY_IDENTIFIER T_STATE_CLU_AMT_DIAG ECU_ADDRESS 0x3fd700 BYTE_ORDER MSB_LAST FORMAT "%6.2" /end MEASUREMENT
/begin CHARACTERISTIC c_vs_fil_amt "Vehicle speed threshold  engine stop" VALUE 0x01a48 _REC_VAL_20_u2 511.99218 _CNV_A_R_LINEAR_____85_CM 0. 511.99218 DISPLAY_IDENTIFIER C_VS_FIL_AMT FORMAT "%7.3" /end CHARACTERISTIC
/begin CHARACTERISTIC c_t_max_state_amt_1_diag "Max Intervention  in shift phase 1" VALUE 0x01864 _REC_VAL_20_u2 655.35 _CNV_A_R_LINEAR_____4_CM 0. 655.35 DISPLAY_IDENTIFIER C_T_MAX_STATE_AMT_1_DIAG FORMAT "%6.2" /end CHARACTERISTIC
/begin CHARACTERISTIC c_t_max_state_amt_2_diag "Max Intervention  in shift phase 2" VALUE 0x01866 _REC_VAL_20_u2 655.35 _CNV_A_R_LINEAR_____4_CM 0. 655.35 DISPLAY_IDENTIFIER C_T_MAX_STATE_AMT_2_DIAG FORMAT "%6.2" /end CHARACTERISTIC
/begin CHARACTERISTIC c_t_max_tqi_amt_diag "Max. timer shift intervention phase 1or 3" VALUE 0x0186c _REC_VAL_20_u2 655.35 _CNV_A_R_LINEAR_____4_CM 0. 655.35 DISPLAY_IDENTIFIER C_T_MAX_TQI_AMT_DIAG FORMAT "%6.2" /end CHARACTERISTIC
/begin CHARACTERISTIC c_tqi_amt_diag "Plausibility torque intervention hysteresis" VALUE 0x0198a _REC_VAL_20_u2 1023.96875 _CNV_A_R_LINEAR_____55_CM 0. 1023.96875 DISPLAY_IDENTIFIER C_TQI_AMT_DIAG FORMAT "%7.2" /end CHARACTERISTIC
/begin CHARACTERISTIC c_tqi_amt_cond_diag "Torque at shift phase 0" VALUE 0x01988 _REC_VAL_20_u2 1023.96875 _CNV_A_R_LINEAR_____55_CM 0. 1023.96875 DISPLAY_IDENTIFIER C_TQI_AMT_COND_DIAG FORMAT "%7.2" /end CHARACTERISTIC
/begin CHARACTERISTIC c_tqi_amt_can_es "Torque at engine stop" VALUE 0x01986 _REC_VAL_20_u2 1023.96875 _CNV_A_R_LINEAR_____55_CM 0. 1023.96875 DISPLAY_IDENTIFIER C_TQI_AMT_CAN_ES FORMAT "%7.2" /end CHARACTERISTIC
/begin CHARACTERISTIC c_t_max_state_amt_3_diag "Max Intervention  in shift phase 3" VALUE 0x01868 _REC_VAL_20_u2 655.35 _CNV_A_R_LINEAR_____4_CM 0. 655.35 DISPLAY_IDENTIFIER C_T_MAX_STATE_AMT_3_DIAG FORMAT "%6.2" /end CHARACTERISTIC
/begin CHARACTERISTIC c_t_max_state_clu_amt_diag "Max. time at clutch" VALUE 0x0186a _REC_VAL_20_u2 655.35 _CNV_A_R_LINEAR_____4_CM 0. 655.35 DISPLAY_IDENTIFIER C_T_MAX_STATE_CLU_AMT_DIAG FORMAT "%6.2" /end CHARACTERISTIC
/begin MEASUREMENT lv_tq_max_tq_gs_inc "Inegrated torque to high" UBYTE _CNV_S_2_RANGE______0_CM 1 100. 0. 1. DISPLAY_IDENTIFIER LV_TQ_MAX_TQ_GS_INC ECU_ADDRESS 0x3fe4bb /end MEASUREMENT
/begin MEASUREMENT ctr_t_tq_max_tq_gs_inc "Min time limit threshold time delay" UBYTE _CNV_A_R_LINEAR_____4_CM 1 100. 0. 2.55 DISPLAY_IDENTIFIER CTR_T_TQ_MAX_TQ_GS_INC ECU_ADDRESS 0x3fe4c1 FORMAT "%4.2" /end MEASUREMENT
/begin MEASUREMENT tqi_amt_plaus "Plausibility torque" UWORD _CNV_A_R_LINEAR_____55_CM 1 100. 0. 1023.96875 DISPLAY_IDENTIFIER TQI_AMT_PLAUS ECU_ADDRESS 0x3fd6f4 BYTE_ORDER MSB_LAST FORMAT "%7.2" /end MEASUREMENT
/begin AXIS_PTS ldp_vs_fil__tq_gs_inc "" 0x1153c vs_fil _REC_AXS_20_u2 511.99218 _CNV_A_R_LINEAR_____85_CM 6 0. 511.99218 DISPLAY_IDENTIFIER LDP_VS_FIL__TQ_GS_INC FORMAT "%7.3" /end AXIS_PTS
/begin AXIS_PTS ldp_n_32__tq_gs_inc "" 0x01065 n_32 _REC_AXS_20_u1 8160. _CNV_A_R_LINEAR_____16_CM 6 0. 8160. DISPLAY_IDENTIFIER LDP_N_32__TQ_GS_INC FORMAT "%4.0" /end AXIS_PTS
/begin MEASUREMENT lv_err_tq_gs_inc_plaus "GS torque increase not plausible" UBYTE _CNV_S_2_RANGE______2_R_CM 1 100. 0. 255. DISPLAY_IDENTIFIER LV_ERR_TQ_GS_INC_PLAUS ECU_ADDRESS 0x3fbaa4 /end MEASUREMENT
/begin MEASUREMENT map_sp "Setpoint of the manifold pressure" UWORD _CNV_A_R_LINEAR_____49_CM 1 100. 0. 5434. DISPLAY_IDENTIFIER MAP_SP ECU_ADDRESS 0x3fd74a BYTE_ORDER MSB_LAST FORMAT "%7.2" /end MEASUREMENT
/begin MEASUREMENT pq_sp "Setpoint of the pressure quotient" UWORD _CNV_A_R_LINEAR_____37_CM 1 100. 0. 0.99998474 DISPLAY_IDENTIFIER PQ_SP ECU_ADDRESS 0x3fd744 BYTE_ORDER MSB_LAST FORMAT "%7.5" /end MEASUREMENT
/begin MEASUREMENT maf_sp_ratio "Setpoint of the ratio MAF_SP / MAF_MAX_COR" UWORD _CNV_A_R_LINEAR_____37_CM 1 100. 0. 0.99998474 DISPLAY_IDENTIFIER MAF_SP_RATIO ECU_ADDRESS 0x3fd756 BYTE_ORDER MSB_LAST FORMAT "%7.5" /end MEASUREMENT
/begin MEASUREMENT amp_mdl_ivs "Ambient pressure used for model adjustment inverse" UWORD _CNV_A_R_LINEAR_____49_CM 1 100. 0. 5434. DISPLAY_IDENTIFIER AMP_MDL_IVS ECU_ADDRESS 0x3fd75e BYTE_ORDER MSB_LAST FORMAT "%7.2" /end MEASUREMENT
/begin MEASUREMENT prs_up_thr_ivs "Pressure upstream the throttle inverse" UWORD _CNV_A_R_LINEAR_____49_CM 1 100. 0. 5434. DISPLAY_IDENTIFIER PRS_UP_THR_IVS ECU_ADDRESS 0x3fd760 BYTE_ORDER MSB_LAST FORMAT "%7.2" /end MEASUREMENT
/begin MEASUREMENT ar_red_sp_mmv_1 "Moving mean value of AR_RED_SP_1" UWORD _CNV_A_R_LINEAR_____333_CM 1 100. 0. 58.592855 DISPLAY_IDENTIFIER AR_RED_SP_MMV_1 ECU_ADDRESS 0x3fd764 BYTE_ORDER MSB_LAST FORMAT "%7.4" /end MEASUREMENT
/begin MEASUREMENT ar_red_sp_mmv "Moving mean value of desired reduced area" UWORD _CNV_A_R_LINEAR_____333_CM 1 100. 0. 58.592855 DISPLAY_IDENTIFIER AR_RED_SP_MMV ECU_ADDRESS 0x3fd766 BYTE_ORDER MSB_LAST FORMAT "%7.4" /end MEASUREMENT
/begin MEASUREMENT tps_sp_mdl_bas "Setpoint of the throttle position before maximum check         " UWORD _CNV_A_R_LINEAR_____53_CM 1 100. 0. 119.5 DISPLAY_IDENTIFIER TPS_SP_MDL_BAS ECU_ADDRESS 0x3fd768 BYTE_ORDER MSB_LAST FORMAT "%7.3" /end MEASUREMENT
/begin MEASUREMENT tps_sp_mdl "Setpoint throttle position" UWORD _CNV_A_R_LINEAR_____53_CM 1 100. 0. 119.5 DISPLAY_IDENTIFIER TPS_SP_MDL ECU_ADDRESS 0x3fd736 BYTE_ORDER MSB_LAST FORMAT "%7.3" /end MEASUREMENT
/begin MEASUREMENT tps_sp_mdl_max "Setpoint throttle position after limitation" UWORD _CNV_A_R_LINEAR_____53_CM 1 100. 0. 119.5 DISPLAY_IDENTIFIER TPS_SP_MDL_MAX ECU_ADDRESS 0x3fd76a BYTE_ORDER MSB_LAST FORMAT "%7.3" /end MEASUREMENT
/begin MEASUREMENT tps_sp_mdl_bas_cor "Setpoint throttle position after linear interpolation      " UWORD _CNV_A_R_LINEAR_____53_CM 1 100. 0. 119.5 DISPLAY_IDENTIFIER TPS_SP_MDL_BAS_COR ECU_ADDRESS 0x3fd76c BYTE_ORDER MSB_LAST FORMAT "%7.3" /end MEASUREMENT
/begin CHARACTERISTIC ip_amp_dec__maf_kgh_sp "pressure decrease in the air cleaner" CURVE 0x01ab2 _REC_CUR_20_u2_u2 5434. _CNV_A_R_LINEAR_____49_CM 0. 5434. DISPLAY_IDENTIFIER IP_AMP_DEC__MAF_KGH_SP FORMAT "%7.2"
 /begin AXIS_DESCR COM_AXIS maf_kgh_sp _CNV_A_R_LINEAR_____113_CM 4 0. 2047.96875 FORMAT "%6.2" AXIS_PTS_REF ldp_maf_kgh_sp__amp_dec /end AXIS_DESCR
/end CHARACTERISTIC
/begin CHARACTERISTIC ip_tps_sp_mdl_max__n_32__maf_sp "Maximum throttle position setpoint at ignition key on" MAP 0x0f762 _REC_MAP_20_u2_u1_u2 119.5 _CNV_A_R_LINEAR_____53_CM 0. 119.5 DISPLAY_IDENTIFIER IP_TPS_SP_MDL_MAX__N_32__MAF_SP FORMAT "%7.3"
 /begin AXIS_DESCR COM_AXIS n_32 _CNV_A_R_LINEAR_____16_CM 8 0. 8160. FORMAT "%4.0" AXIS_PTS_REF ldp_n_32__tps_sp_mdl_max /end AXIS_DESCR
 /begin AXIS_DESCR COM_AXIS maf_sp _CNV_A_R_LINEAR_____106_CM 4 0. 1389. FORMAT "%7.2" AXIS_PTS_REF ldp_maf_sp__tps_sp_mdl_max /end AXIS_DESCR
/end CHARACTERISTIC
/begin CHARACTERISTIC lc_ar_red_fil_ena "Logical variable enabled for reduced throttle area filter" VALUE 0x00f03 _REC_VAL_20_u1 1. _CNV_A_R_LINEAR_____22_CM 0. 1. DISPLAY_IDENTIFIER LC_AR_RED_FIL_ENA FORMAT "%1.0" /end CHARACTERISTIC
/begin CHARACTERISTIC lc_tps_fil_ena "Logical variable enabled for throttle position setpoint filter" VALUE 0x00f7b _REC_VAL_20_u1 1. _CNV_A_R_LINEAR_____22_CM 0. 1. DISPLAY_IDENTIFIER LC_TPS_FIL_ENA FORMAT "%1.0" /end CHARACTERISTIC
/begin CHARACTERISTIC ip_crlc_ar_red_sp "correlation constant for the moving mean value calculation of AR_RED_SP" CURVE 0x00a50 _REC_CUR_20_u1_u2 0.9960940000000002 _CNV_A_R_LINEAR_____50_CM 0. 0.996094 DISPLAY_IDENTIFIER IP_CRLC_AR_RED_SP FORMAT "%5.3"
 /begin AXIS_DESCR COM_AXIS pq_sp _CNV_A_R_LINEAR_____37_CM 8 0. 0.99998474 FORMAT "%7.5" AXIS_PTS_REF ldp_pq_sp__crlc_ar_red_sp /end AXIS_DESCR
/end CHARACTERISTIC
/begin CHARACTERISTIC lc_inh_isapwm_man_as "logical variable to inhibit ISAPWM setpoint by application system" VALUE 0x00f38 _REC_VAL_20_u1 1. _CNV_A_R_LINEAR_____1_CM 0. 1. DISPLAY_IDENTIFIER LC_INH_ISAPWM_MAN_AS FORMAT "%2.0" /end CHARACTERISTIC
/begin CHARACTERISTIC c_cycnr_isa_off "Number of cycles at ignition key off for ISA shakers" VALUE 0x00679 _REC_VAL_20_u1 255. _CNV_A_R_LINEAR_____1_CM 0. 255. DISPLAY_IDENTIFIER C_CYCNR_ISA_OFF FORMAT "%3.0" /end CHARACTERISTIC
/begin CHARACTERISTIC c_isapwm_off_high "ISAPWM during opening phase" VALUE 0x015ec _REC_VAL_20_u2 99.99847412 _CNV_A_R_LINEAR_____9_CM 0. 99.99847412 DISPLAY_IDENTIFIER C_ISAPWM_OFF_HIGH /end CHARACTERISTIC
/begin CHARACTERISTIC c_isapwm_off_low "ISAPWM during closing phase" VALUE 0x015ee _REC_VAL_20_u2 99.99847412 _CNV_A_R_LINEAR_____9_CM 0. 99.99847412 DISPLAY_IDENTIFIER C_ISAPWM_OFF_LOW /end CHARACTERISTIC
/begin CHARACTERISTIC c_t_isapwm_off "Delay time ISAPWM" VALUE 0x00811 _REC_VAL_20_u1 2550. _CNV_A_R_LINEAR_____31_CM 0. 2550. DISPLAY_IDENTIFIER C_T_ISAPWM_OFF FORMAT "%4.0" /end CHARACTERISTIC
/begin CHARACTERISTIC c_lgrd_isapwm_off "Change limitation during shaking" VALUE 0x01622 _REC_VAL_20_u2 99.99847412 _CNV_A_R_LINEAR_____432_CM 0. 99.99847412 DISPLAY_IDENTIFIER C_LGRD_ISAPWM_OFF /end CHARACTERISTIC
/begin MEASUREMENT maf_kgh_sp_isa_clc "maximum setpoint ISA mass air flow at PSI_SP_ISA" UWORD _CNV_A_R_LINEAR_____113_CM 1 100. 0. 2047.96875 DISPLAY_IDENTIFIER MAF_KGH_SP_ISA_CLC ECU_ADDRESS 0x3fd742 BYTE_ORDER MSB_LAST FORMAT "%7.2" /end MEASUREMENT
/begin MEASUREMENT pq_sp_isa "setpoint pressure quotient at ISA, corrected value" UWORD _CNV_A_R_LINEAR_____37_CM 1 100. 0. 0.99998474 DISPLAY_IDENTIFIER PQ_SP_ISA ECU_ADDRESS 0x3fd778 BYTE_ORDER MSB_LAST FORMAT "%7.5" /end MEASUREMENT
/begin MEASUREMENT pq_sp_isa_1 "setpoint pressure quotient at ISA, interim value" UWORD _CNV_A_R_LINEAR_____37_CM 1 100. 0. 0.99998474 DISPLAY_IDENTIFIER PQ_SP_ISA_1 ECU_ADDRESS 0x3fd776 BYTE_ORDER MSB_LAST FORMAT "%7.5" /end MEASUREMENT
/begin MEASUREMENT maf_kgh_sp_thr "setpoint throttle mass air" UWORD _CNV_A_R_LINEAR_____113_CM 1 100. 0. 2047.96875 DISPLAY_IDENTIFIER MAF_KGH_SP_THR ECU_ADDRESS 0x3fd772 BYTE_ORDER MSB_LAST FORMAT "%7.2" /end MEASUREMENT
/begin MEASUREMENT maf_kgh_sp_isa_raw "setpoint mass air flow idle speed actuator" UWORD _CNV_A_R_LINEAR_____113_CM 1 100. 0. 2047.96875 DISPLAY_IDENTIFIER MAF_KGH_SP_ISA_RAW ECU_ADDRESS 0x3fd774 BYTE_ORDER MSB_LAST FORMAT "%7.2" /end MEASUREMENT
/begin MEASUREMENT psi_sp "Setpoint air flow function rate" UWORD _CNV_A_R_LINEAR_____328_CM 1 100. 0. 8.880330000000001 DISPLAY_IDENTIFIER PSI_SP ECU_ADDRESS 0x3fd75c BYTE_ORDER MSB_LAST FORMAT "%6.4" /end MEASUREMENT
/begin MEASUREMENT psi_sp_isa "Setpoint air flow function rate ISA" UWORD _CNV_A_R_LINEAR_____328_CM 1 100. 0. 8.880330000000001 DISPLAY_IDENTIFIER PSI_SP_ISA ECU_ADDRESS 0x3fd77a BYTE_ORDER MSB_LAST FORMAT "%5.4" /end MEASUREMENT
/begin MEASUREMENT ar_red_isa_sp_mmv "filtered setpoint reduced area at ISA valve including AR_RED-controller share AR_RED_ISA_DIF_I_REL_MMV" UWORD _CNV_A_R_LINEAR_____333_CM 1 100. 0. 58.592855 DISPLAY_IDENTIFIER AR_RED_ISA_SP_MMV ECU_ADDRESS 0x3fd748 BYTE_ORDER MSB_LAST FORMAT "%7.4" /end MEASUREMENT
/begin MEASUREMENT ar_red_isa_sp_mmv_1 "filtered setpoint reduced area at ISA valve" UWORD _CNV_A_R_LINEAR_____333_CM 1 100. 0. 58.592855 DISPLAY_IDENTIFIER AR_RED_ISA_SP_MMV_1 ECU_ADDRESS 0x3fd77e BYTE_ORDER MSB_LAST FORMAT "%7.4" /end MEASUREMENT
/begin MEASUREMENT isapwm_isa_1 "idle speed actuator duty cycle coil 1 (opening)" UWORD _CNV_A_R_LINEAR_____9_CM 1 100. 0. 99.99847412 DISPLAY_IDENTIFIER ISAPWM_ISA_1 ECU_ADDRESS 0x3fd73e BYTE_ORDER MSB_LAST FORMAT "%5.2" /end MEASUREMENT
/begin MEASUREMENT isapwm_isa_2 "idle speed actuator duty cycle coil 2 (closing)" UWORD _CNV_A_R_LINEAR_____9_CM 1 100. 0. 99.99847412 DISPLAY_IDENTIFIER ISAPWM_ISA_2 ECU_ADDRESS 0x3fd740 BYTE_ORDER MSB_LAST FORMAT "%5.2" /end MEASUREMENT
/begin MEASUREMENT isapwm_mmv "moving mean value of idle speed actuator duty cycle" UWORD _CNV_A_R_LINEAR_____9_CM 1 100. 0. 99.99847412 DISPLAY_IDENTIFIER ISAPWM_MMV ECU_ADDRESS 0x3fd73c BYTE_ORDER MSB_LAST FORMAT "%5.2" /end MEASUREMENT
/begin CHARACTERISTIC ip_crlc_ar_red_isa_sp "correlation constant for the moving mean value calculation of AR_RED_ISA_SP_MMV_1" CURVE 0x00a48 _REC_CUR_20_u1_u2 0.9960940000000002 _CNV_A_R_LINEAR_____50_CM 0. 0.996094 DISPLAY_IDENTIFIER IP_CRLC_AR_RED_ISA_SP FORMAT "%5.3"
 /begin AXIS_DESCR COM_AXIS pq_sp_isa _CNV_A_R_LINEAR_____37_CM 8 0. 0.99998474 FORMAT "%7.5" AXIS_PTS_REF ldp_pq_sp_isa /end AXIS_DESCR
/end CHARACTERISTIC
/begin CHARACTERISTIC ip_isapwm_isa "ISA position setpoint" CURVE 0x0b7d6 _REC_CUR_20_u2_u2 99.99847412 _CNV_A_R_LINEAR_____9_CM 0. 99.99847412 DISPLAY_IDENTIFIER IP_ISAPWM_ISA FORMAT "%5.2"
 /begin AXIS_DESCR COM_AXIS ar_red_isa_sp_mmv _CNV_A_R_LINEAR_____333_CM 16 0. 58.592855 FORMAT "%7.4" AXIS_PTS_REF ldp_ar_red_isa_sp_mmv /end AXIS_DESCR
/end CHARACTERISTIC
/begin CHARACTERISTIC c_isapwm_man_as "maximum reduced area at full opened idle speed actuator valve" VALUE 0x015ea _REC_VAL_20_u2 99.99847412 _CNV_A_R_LINEAR_____9_CM 0. 99.99847412 DISPLAY_IDENTIFIER C_ISAPWM_MAN_AS FORMAT "%5.2" /end CHARACTERISTIC
/begin CHARACTERISTIC c_isapwm_ofs_as "additive ISAPWM offset by application system" VALUE 0x003fe _REC_VAL_20_s2 99.99847412 _CNV_A_R_LINEAR_____109_CM -50. 49.99847412 DISPLAY_IDENTIFIER C_ISAPWM_OFS_AS FORMAT "%7.3" /end CHARACTERISTIC
/begin CHARACTERISTIC c_crlc_isapwm_mmv "correlation constant for moving mean value calculation of ISAPWM_ISA" VALUE 0x0062e _REC_VAL_20_u1 0.9960940000000002 _CNV_A_R_LINEAR_____50_CM 0. 0.996094 DISPLAY_IDENTIFIER C_CRLC_ISAPWM_MMV FORMAT "%5.3" /end CHARACTERISTIC
/begin CHARACTERISTIC c_isapwm_isa_diag "diagnosis substitute value in case of  \"STATE_ISA_DIAG = error active / substitute opening\"" VALUE 0x015e4 _REC_VAL_20_u2 99.99847412 _CNV_A_R_LINEAR_____9_CM 0. 99.99847412 DISPLAY_IDENTIFIER C_ISAPWM_ISA_DIAG FORMAT "%5.2" /end CHARACTERISTIC
/begin CHARACTERISTIC ip_fac_isapwm_vb "battery voltage correction for ISAPWM duty cycle" CURVE 0x00b13 _REC_CUR_20_u1_u1 1.99220002 _CNV_A_R_LINEAR_____39_CM 0. 1.99220002 DISPLAY_IDENTIFIER IP_FAC_ISAPWM_VB FORMAT "%5.3"
 /begin AXIS_DESCR COM_AXIS vb _CNV_A_R_LINEAR_____34_CM 8 0. 25.8984 FORMAT "%3.1" AXIS_PTS_REF ldpm_vb_1 /end AXIS_DESCR
/end CHARACTERISTIC
/begin MEASUREMENT fac_isapwm_vb "battery voltage correction for idle speed actuator duty cycle" UBYTE _CNV_A_R_LINEAR_____39_CM 1 100. 0. 1.99220002 DISPLAY_IDENTIFIER FAC_ISAPWM_VB ECU_ADDRESS 0x3fe4f0 FORMAT "%5.3" /end MEASUREMENT
/begin MEASUREMENT maf_turb_ratio "mass air flow ratio of MAF_SP_ISA / MAF_SP" UBYTE _CNV_A_R_LINEAR_____50_CM 1 100. 0. 0.996094 DISPLAY_IDENTIFIER MAF_TURB_RATIO ECU_ADDRESS 0x3fe4ef FORMAT "%5.3" /end MEASUREMENT
/begin CHARACTERISTIC c_tps_max_diag "TPS_SP_MDL Limitation at TPS limp home of channel 1 or 2" VALUE 0x01942 _REC_VAL_20_u2 119.5 _CNV_A_R_LINEAR_____53_CM 0. 119.5 DISPLAY_IDENTIFIER C_TPS_MAX_DIAG FORMAT "%7.3" /end CHARACTERISTIC
/begin MEASUREMENT ar_red_isa_sp_1 "setpoint reduced area at ISA valve previous filtering" UWORD _CNV_A_R_LINEAR_____333_CM 1 100. 0. 58.592855 DISPLAY_IDENTIFIER AR_RED_ISA_SP_1 ECU_ADDRESS 0x3fd77c BYTE_ORDER MSB_LAST FORMAT "%7.4" /end MEASUREMENT
/begin MEASUREMENT maf_kgh_sp_isa_min "Minimum setpoint ISA mass air flow at PSI_SP_ISA" UWORD _CNV_A_R_LINEAR_____113_CM 1 100. 0. 2047.96875 DISPLAY_IDENTIFIER MAF_KGH_SP_ISA_MIN ECU_ADDRESS 0x3fd780 BYTE_ORDER MSB_LAST FORMAT "%7.2" /end MEASUREMENT
/begin MEASUREMENT maf_kgh_sp_thr_min "Minimum setpoint throttle mass air flow at PSI_SP" UWORD _CNV_A_R_LINEAR_____113_CM 1 100. 0. 2047.96875 DISPLAY_IDENTIFIER MAF_KGH_SP_THR_MIN ECU_ADDRESS 0x3fd784 BYTE_ORDER MSB_LAST FORMAT "%7.2" /end MEASUREMENT
/begin MEASUREMENT ar_red_isa_min "Minimum reduced area at closed ISA" UWORD _CNV_A_R_LINEAR_____333_CM 1 100. 0. 58.592855 DISPLAY_IDENTIFIER AR_RED_ISA_MIN ECU_ADDRESS 0x3fd782 BYTE_ORDER MSB_LAST FORMAT "%7.4" /end MEASUREMENT
/begin MEASUREMENT ar_red_min "Minimum reduced area at closed throttle" UWORD _CNV_A_R_LINEAR_____333_CM 1 100. 0. 58.592855 DISPLAY_IDENTIFIER AR_RED_MIN ECU_ADDRESS 0x3fd786 BYTE_ORDER MSB_LAST FORMAT "%7.4" /end MEASUREMENT
/begin MEASUREMENT maf_kgh_sp_isa "setpoint ISA mass air flow" UWORD _CNV_A_R_LINEAR_____113_CM 1 100. 0. 2047.96875 DISPLAY_IDENTIFIER MAF_KGH_SP_ISA ECU_ADDRESS 0x3fd770 BYTE_ORDER MSB_LAST FORMAT "%7.2" /end MEASUREMENT
/begin MEASUREMENT maf_kgh_sp_isa_1 "setpoint ISA mass air flow, intermediate value" UWORD _CNV_A_R_LINEAR_____113_CM 1 100. 0. 2047.96875 DISPLAY_IDENTIFIER MAF_KGH_SP_ISA_1 ECU_ADDRESS 0x3fd76e BYTE_ORDER MSB_LAST FORMAT "%7.2" /end MEASUREMENT
/begin AXIS_PTS ldp_maf_kgh_sp__amp_dec "" 0x10d88 maf_kgh_sp _REC_AXS_20_u2 2047.96875 _CNV_A_R_LINEAR_____113_CM 4 0. 2047.96875 DISPLAY_IDENTIFIER LDP_MAF_KGH_SP__AMP_DEC FORMAT "%6.2" /end AXIS_PTS
/begin AXIS_PTS ldp_maf_sp__tps_sp_mdl_max "" 0x10dae maf_sp _REC_AXS_20_u2 1389. _CNV_A_R_LINEAR_____106_CM 4 0. 1389. DISPLAY_IDENTIFIER LDP_MAF_SP__TPS_SP_MDL_MAX FORMAT "%7.2" /end AXIS_PTS
/begin AXIS_PTS ldp_n_32__tps_sp_mdl_max "" 0x07c5b n_32 _REC_AXS_20_u1 816. _CNV_A_R_LINEAR_____16_CM 8 0. 8160. DISPLAY_IDENTIFIER LDP_N_32__TPS_SP_MDL_MAX FORMAT "%4.0" /end AXIS_PTS
/begin AXIS_PTS ldp_pq_sp__crlc_ar_red_sp "" 0x110d0 pq_sp _REC_AXS_20_u2 0.99998474 _CNV_A_R_LINEAR_____37_CM 8 0. 0.99998474 DISPLAY_IDENTIFIER LDP_PQ_SP__CRLC_AR_RED_SP FORMAT "%7.5" /end AXIS_PTS
/begin AXIS_PTS ldp_pq_sp_isa "" 0x110e2 pq_sp_isa _REC_AXS_20_u2 0.99998474 _CNV_A_R_LINEAR_____37_CM 8 0. 0.99998474 DISPLAY_IDENTIFIER LDP_PQ_SP_ISA FORMAT "%7.5" /end AXIS_PTS
/begin AXIS_PTS ldp_ar_red_isa_sp_mmv "" 0x10948 ar_red_isa_sp_mmv _REC_AXS_20_u2 58.592855 _CNV_A_R_LINEAR_____333_CM 16 0. 58.592855 DISPLAY_IDENTIFIER LDP_AR_RED_ISA_SP_MMV FORMAT "%7.4" /end AXIS_PTS
/begin AXIS_PTS ldpm_vb_1 "" 0x0829e vb _REC_AXS_20_u1 25.8984 _CNV_A_R_LINEAR_____34_CM 8 0. 25.8984 DISPLAY_IDENTIFIER LDPM_VB_1 FORMAT "%3.1" /end AXIS_PTS
/begin MEASUREMENT ar_red_sp_1 "Setpoint reduced throttle area" UWORD _CNV_A_R_LINEAR_____333_CM 1 100. 0. 58.592855 DISPLAY_IDENTIFIER AR_RED_SP_1 ECU_ADDRESS 0x3fd762 BYTE_ORDER MSB_LAST FORMAT "%7.4" /end MEASUREMENT
/begin MEASUREMENT lv_h_load_tps_sp "logical value for 'very high load'" UBYTE _CNV_S_2_RANGE______0_CM 1 100. 0. 1. DISPLAY_IDENTIFIER LV_H_LOAD_TPS_SP ECU_ADDRESS 0x3fe4f4 /end MEASUREMENT
/begin CHARACTERISTIC c_pq_sp_max "Pressure quotient threshold" VALUE 0x0174a _REC_VAL_20_u2 0.99998474 _CNV_A_R_LINEAR_____37_CM 0. 0.99998474 DISPLAY_IDENTIFIER C_PQ_SP_MAX FORMAT "%7.5" /end CHARACTERISTIC
/begin CHARACTERISTIC c_pq_sp_max_hys "Hysteresis for pressure quotient threshold" VALUE 0x0174c _REC_VAL_20_u2 0.99998474 _CNV_A_R_LINEAR_____37_CM 0. 0.99998474 DISPLAY_IDENTIFIER C_PQ_SP_MAX_HYS FORMAT "%7.5" /end CHARACTERISTIC
/begin MEASUREMENT isapwm "idle speed actuator duty cycle for substitute mass air flow calculation" UWORD _CNV_A_R_LINEAR_____9_CM 1 100. 0. 99.99847412 DISPLAY_IDENTIFIER ISAPWM ECU_ADDRESS 0x3fd73a BYTE_ORDER MSB_LAST FORMAT "%5.2" /end MEASUREMENT
/begin CHARACTERISTIC ip_isapwm_isa_pwl "ISAPWM setpoint by LV_TPS_PWL" CURVE 0x01af6 _REC_CUR_20_u2_u1 99.99847412 _CNV_A_R_LINEAR_____9_CM 0. 99.99847412 DISPLAY_IDENTIFIER IP_ISAPWM_ISA_PWL
 /begin AXIS_DESCR COM_AXIS n_32 _CNV_A_R_LINEAR_____16_CM 4 0. 8160. FORMAT "%4.0" AXIS_PTS_REF ldp_n_32__isapwm_isa_pwl /end AXIS_DESCR
/end CHARACTERISTIC
/begin CHARACTERISTIC ip_isapwm_ivs_cor_isa "ISAPWM setpoint without VB correction" CURVE 0x0b7f6 _REC_CUR_20_u2_u2 99.99847412 _CNV_A_R_LINEAR_____9_CM 0. 99.99847412 DISPLAY_IDENTIFIER IP_ISAPWM_IVS_COR_ISA
 /begin AXIS_DESCR COM_AXIS isapwm_cor_isa _CNV_A_R_LINEAR_____9_CM 8 0. 99.99847412 AXIS_PTS_REF ldp_isapwm_cor_isa__isapwm_isa /end AXIS_DESCR
/end CHARACTERISTIC
/begin AXIS_PTS ldp_n_32__isapwm_isa_pwl "" 0x01031 n_32 _REC_AXS_20_u1 8160. _CNV_A_R_LINEAR_____16_CM 4 0. 8160. DISPLAY_IDENTIFIER LDP_N_32__ISAPWM_ISA_PWL FORMAT "%4.0" /end AXIS_PTS
/begin AXIS_PTS ldp_isapwm_cor_isa__isapwm_isa "" 0x10b04 isapwm_cor_isa _REC_AXS_20_u2 99.99847412 _CNV_A_R_LINEAR_____9_CM 8 0. 99.99847412 DISPLAY_IDENTIFIER LDP_ISAPWM_COR_ISA__ISAPWM_ISA /end AXIS_PTS
/begin MEASUREMENT isapwm_isa "idle speed actuator duty cycle" UWORD _CNV_A_R_LINEAR_____9_CM 1 100. 0. 99.99847412 DISPLAY_IDENTIFIER ISAPWM_ISA ECU_ADDRESS 0x3fd738 BYTE_ORDER MSB_LAST FORMAT "%5.2" /end MEASUREMENT
/begin MEASUREMENT isapwm_cor_isa "idle speed actuator duty cycle" UWORD _CNV_A_R_LINEAR_____9_CM 1 100. 0. 99.99847412 DISPLAY_IDENTIFIER ISAPWM_COR_ISA ECU_ADDRESS 0x3fd74c BYTE_ORDER MSB_LAST FORMAT "%5.2" /end MEASUREMENT
/begin MEASUREMENT maf_kgh_sp "Setpoint mass air flow into the manifold" UWORD _CNV_A_R_LINEAR_____113_CM 1 100. 0. 2047.96875 DISPLAY_IDENTIFIER MAF_KGH_SP ECU_ADDRESS 0x3fd758 BYTE_ORDER MSB_LAST FORMAT "%7.2" /end MEASUREMENT
/begin MEASUREMENT maf_sp_add_fast_load_im "additional setpoint mass air flow" SWORD _CNV_A_R_LINEAR_____433_CM 1 100. -1389. 1388.957611 DISPLAY_IDENTIFIER MAF_SP_ADD_FAST_LOAD_IM ECU_ADDRESS 0x3fd74e BYTE_ORDER MSB_LAST FORMAT "%8.2" /end MEASUREMENT
/begin MEASUREMENT fac_maf_dif_sp "factor air mass difference" UWORD _CNV_A_R_LINEAR_____21_CM 1 100. 0. 1.99996948 DISPLAY_IDENTIFIER FAC_MAF_DIF_SP ECU_ADDRESS 0x3fd754 BYTE_ORDER MSB_LAST FORMAT "%7.5" /end MEASUREMENT
/begin MEASUREMENT pq_sp_wout_maf_add "setpoint pressure quotient manifold air pressure/ambient pressure" UWORD _CNV_A_R_LINEAR_____37_CM 1 100. 0. 0.99998474 DISPLAY_IDENTIFIER PQ_SP_WOUT_MAF_ADD ECU_ADDRESS 0x3fd746 BYTE_ORDER MSB_LAST FORMAT "%7.5" /end MEASUREMENT
/begin MEASUREMENT map_sp_wout_maf_add "setpoint manifold air pressure without MAF_SP_ADD_FAST_LOAD_IM" UWORD _CNV_A_R_LINEAR_____49_CM 1 100. 0. 5434. DISPLAY_IDENTIFIER MAP_SP_WOUT_MAF_ADD ECU_ADDRESS 0x3fd75a BYTE_ORDER MSB_LAST FORMAT "%7.2" /end MEASUREMENT
/begin CHARACTERISTIC ip_tps_sp_mdl_bas "throttle position setpoint (!inverse of IP_AR_RED_THR__TPS_SEG!)" CURVE 0x0f742 _REC_CUR_20_u2_u2 119.5 _CNV_A_R_LINEAR_____53_CM 0. 119.5 DISPLAY_IDENTIFIER IP_TPS_SP_MDL_BAS FORMAT "%7.3"
 /begin AXIS_DESCR COM_AXIS ar_red_sp_mmv _CNV_A_R_LINEAR_____333_CM 16 0. 58.592855 FORMAT "%7.4" AXIS_PTS_REF ldp_ar_red_sp_mmv /end AXIS_DESCR
/end CHARACTERISTIC
/begin AXIS_PTS ldp_ar_red_sp_mmv "" 0x1096a ar_red_sp_mmv _REC_AXS_20_u2 58.592855 _CNV_A_R_LINEAR_____333_CM 16 0. 58.592855 DISPLAY_IDENTIFIER LDP_AR_RED_SP_MMV FORMAT "%7.4" /end AXIS_PTS
/begin CHARACTERISTIC ip_fac_maf_dif_sp "factor for air mass difference, raw value" MAP 0x0ac6a _REC_MAP_20_u2_u2_u2 1.99996948 _CNV_A_R_LINEAR_____21_CM 0. 1.99996948 DISPLAY_IDENTIFIER IP_FAC_MAF_DIF_SP FORMAT "%7.5"
 /begin AXIS_DESCR COM_AXIS n _CNV_A_R_LINEAR_____11_CM 8 0. 8160. FORMAT "%4.0" AXIS_PTS_REF ldp_n_ip_fac_maf_dif_sp /end AXIS_DESCR
 /begin AXIS_DESCR COM_AXIS pq_sp_wout_maf_add _CNV_A_R_LINEAR_____37_CM 8 0. 0.99998474 FORMAT "%7.6" AXIS_PTS_REF ldp_pq_sp_wout_maf_add_ip_fac /end AXIS_DESCR
/end CHARACTERISTIC
/begin CHARACTERISTIC ip_maf_sp_add_fast_load_im "additional maf setpoint for fast manifold filling" CURVE 0x0c926 _REC_CUR_20_u2_u2 2777.957611 _CNV_A_R_LINEAR_____434_CM -1389. 1388.957611 DISPLAY_IDENTIFIER IP_MAF_SP_ADD_FAST_LOAD_IM FORMAT "%8.2"
 /begin AXIS_DESCR COM_AXIS online_dummy _CNV_A_R_LINEAR_____435_CM 8 -8192. 8191.75 FORMAT "%8.2" AXIS_PTS_REF ldp_maf_dif_sp_cor_ip_maf_add /end AXIS_DESCR
/end CHARACTERISTIC
/begin AXIS_PTS ldp_n_ip_fac_maf_dif_sp "" 0x10f64 n _REC_AXS_20_u2 8160. _CNV_A_R_LINEAR_____11_CM 8 0. 8160. DISPLAY_IDENTIFIER LDP_N_IP_FAC_MAF_DIF_SP FORMAT "%4.0" /end AXIS_PTS
/begin AXIS_PTS ldp_maf_dif_sp_cor_ip_maf_add "" 0x10c56 online_dummy _REC_AXS_20_u2 16383.75 _CNV_A_R_LINEAR_____435_CM 8 -8192. 8191.75 DISPLAY_IDENTIFIER LDP_MAF_DIF_SP_COR_IP_MAF_ADD FORMAT "%8.2" /end AXIS_PTS
/begin CHARACTERISTIC lc_ar_red_isa_fil_ena "logical variable to enable reduced ISA area filter" VALUE 0x00f04 _REC_VAL_20_u1 1. _CNV_A_R_LINEAR_____1_CM 0. 1. DISPLAY_IDENTIFIER LC_AR_RED_ISA_FIL_ENA FORMAT "%2.0" /end CHARACTERISTIC
/begin CHARACTERISTIC lc_pq_sp_isa_maf_add "1: ISA actuation including MAF_SP_ADD_FAST_LOAD_IM" VALUE 0x00f66 _REC_VAL_20_u1 1. _CNV_A_R_LINEAR_____1_CM 0. 1. DISPLAY_IDENTIFIER LC_PQ_SP_ISA_MAF_ADD FORMAT "%2.0" /end CHARACTERISTIC
/begin MEASUREMENT maf_dif_sp "air mass difference, filtered value" SWORD _CNV_A_R_LINEAR_____436_CM 1 100. -8192. 8191.75 DISPLAY_IDENTIFIER MAF_DIF_SP ECU_ADDRESS 0x3fd752 BYTE_ORDER MSB_LAST FORMAT "%8.2" /end MEASUREMENT
/begin MEASUREMENT maf_dif_sp_1 "air mass difference, raw value" SWORD _CNV_A_R_LINEAR_____436_CM 1 100. -8192. 8191.75 DISPLAY_IDENTIFIER MAF_DIF_SP_1 ECU_ADDRESS 0x3fd750 BYTE_ORDER MSB_LAST FORMAT "%8.2" /end MEASUREMENT
/begin CHARACTERISTIC c_pq_sp_max_isa "Pressure quotient threshold at ISA valve" VALUE 0x0174e _REC_VAL_20_u2 0.99998474 _CNV_A_R_LINEAR_____37_CM 0. 0.99998474 DISPLAY_IDENTIFIER C_PQ_SP_MAX_ISA FORMAT "%7.5" /end CHARACTERISTIC
/begin CHARACTERISTIC c_crlc_maf_dif_sp "correction constant for MAF_DIF_SP filter" VALUE 0x014d6 _REC_VAL_20_u2 0.99998474 _CNV_A_R_LINEAR_____37_CM 0. 0.99998474 DISPLAY_IDENTIFIER C_CRLC_MAF_DIF_SP FORMAT "%7.6" /end CHARACTERISTIC
/begin AXIS_PTS ldp_pq_sp_wout_maf_add_ip_fac "" 0x110f4 pq_sp_wout_maf_add _REC_AXS_20_u2 0.99998474 _CNV_A_R_LINEAR_____37_CM 8 0. 0.99998474 DISPLAY_IDENTIFIER LDP_PQ_SP_WOUT_MAF_ADD_IP_FAC FORMAT "%7.6" /end AXIS_PTS
/begin MEASUREMENT lv_ast "Auxiliary function \"After-start\"" UBYTE _CNV_S_2_RANGE______0_CM 1 100. 0. 1. DISPLAY_IDENTIFIER LV_AST ECU_ADDRESS 0x3fe370 BIT_MASK 0x1 /end MEASUREMENT
/begin MEASUREMENT tco_rest "Coolant temperature, stored to detect a re-start" UBYTE _CNV_A_R_LINEAR_____12_CM 1 100. -48. 142.5 DISPLAY_IDENTIFIER TCO_REST ECU_ADDRESS 0x3fe245 FORMAT "%3.0" /end MEASUREMENT
/begin CHARACTERISTIC c_n_max_tps_ad "" VALUE 0x00778 _REC_VAL_20_u1 8160. _CNV_A_R_LINEAR_____16_CM 0. 8160. DISPLAY_IDENTIFIER C_N_MAX_TPS_AD FORMAT "%4.0" /end CHARACTERISTIC
/begin CHARACTERISTIC c_t_max_tps_ad "Maximum time for Adaptation of the LIH and BOL position" VALUE 0x00823 _REC_VAL_20_u1 1.275 _CNV_A_R_LINEAR_____366_CM 0. 1.275 DISPLAY_IDENTIFIER C_T_MAX_TPS_AD FORMAT "%4.3" /end CHARACTERISTIC
/begin CHARACTERISTIC c_t_max_tps_lih_chk "Maximum time for Limp Home recognition" VALUE 0x00824 _REC_VAL_20_u1 1.275 _CNV_A_R_LINEAR_____366_CM 0. 1.275 DISPLAY_IDENTIFIER C_T_MAX_TPS_LIH_CHK FORMAT "%4.3" /end CHARACTERISTIC
/begin CHARACTERISTIC c_t_max_tps_sp_rst_chk "Maximum time to reach the position C_TPS_SP_RST_CHK" VALUE 0x00825 _REC_VAL_20_u1 1.275 _CNV_A_R_LINEAR_____366_CM 0. 1.275 DISPLAY_IDENTIFIER C_T_MAX_TPS_SP_RST_CHK FORMAT "%4.3" /end CHARACTERISTIC
/begin CHARACTERISTIC c_t_tps_ad_hys "Time period for hysteresis band to Adaptation" VALUE 0x0083f _REC_VAL_20_u1 1.275 _CNV_A_R_LINEAR_____366_CM 0. 1.275 DISPLAY_IDENTIFIER C_T_TPS_AD_HYS FORMAT "%4.3" /end CHARACTERISTIC
/begin CHARACTERISTIC c_tco_max_tps_ad "" VALUE 0x0087c _REC_VAL_20_u1 190.5 _CNV_A_R_LINEAR_____12_CM -48. 142.5 DISPLAY_IDENTIFIER C_TCO_MAX_TPS_AD FORMAT "%5.1" /end CHARACTERISTIC
/begin CHARACTERISTIC c_tco_min_tps_ad "" VALUE 0x00891 _REC_VAL_20_u1 190.5 _CNV_A_R_LINEAR_____12_CM -48. 142.5 DISPLAY_IDENTIFIER C_TCO_MIN_TPS_AD FORMAT "%5.1" /end CHARACTERISTIC
/begin CHARACTERISTIC c_tia_min_tps_ad "" VALUE 0x008d6 _REC_VAL_20_u1 190.5 _CNV_A_R_LINEAR_____12_CM -48. 142.5 DISPLAY_IDENTIFIER C_TIA_MIN_TPS_AD FORMAT "%4.1" /end CHARACTERISTIC
/begin CHARACTERISTIC c_tps_sp_bol_lgrd "Change limitation for stopping the lower position" VALUE 0x008f6 _REC_VAL_20_u1 1.85271285 _CNV_A_R_LINEAR_____448_CM 7.29415e-003 1.860007 DISPLAY_IDENTIFIER C_TPS_SP_BOL_LGRD FORMAT "%4.3" /end CHARACTERISTIC
/begin CHARACTERISTIC c_tps_sp_rst_chk_bas "TPS_SP for testing the retracting spring" VALUE 0x01962 _REC_VAL_20_u2 119.5 _CNV_A_R_LINEAR_____53_CM 0. 119.5 DISPLAY_IDENTIFIER C_TPS_SP_RST_CHK_BAS /end CHARACTERISTIC
/begin CHARACTERISTIC c_tps_sp_rst_chk_hys "Hysteresis of C_TPS_SP_RST_CHK" VALUE 0x008f8 _REC_VAL_20_u1 1.85271285 _CNV_A_R_LINEAR_____449_CM 7.29415e-003 1.860007 DISPLAY_IDENTIFIER C_TPS_SP_RST_CHK_HYS FORMAT "%4.3" /end CHARACTERISTIC
/begin CHARACTERISTIC c_tps_sp_rst_chk_lgrd "Change limitation for stopping the position C_TPS_SP_RST_CHK" VALUE 0x008f9 _REC_VAL_20_u1 1.85271285 _CNV_A_R_LINEAR_____448_CM 7.29415e-003 1.860007 DISPLAY_IDENTIFIER C_TPS_SP_RST_CHK_LGRD FORMAT "%4.3" /end CHARACTERISTIC
/begin CHARACTERISTIC c_v_tps_ad_hys "Hysteresis band for Adaptation value determination" VALUE 0x00914 _REC_VAL_20_u1 1.24511719 _CNV_A_R_LINEAR_____390_CM 0. 1.24511719 DISPLAY_IDENTIFIER C_V_TPS_AD_HYS FORMAT "%4.3" /end CHARACTERISTIC
/begin CHARACTERISTIC c_v_tps_ad_win_lih "Adaptation window size (+/-) for Adaptation of the Limp Home position" VALUE 0x00917 _REC_VAL_20_u1 2.49023438 _CNV_A_R_LINEAR_____450_CM 0. 2.49023438 DISPLAY_IDENTIFIER C_V_TPS_AD_WIN_LIH FORMAT "%4.3" /end CHARACTERISTIC
/begin CHARACTERISTIC c_v_tps_sp_bol_1 "" VALUE 0x00919 _REC_VAL_20_u1 4.998 _CNV_A_R_LINEAR_____44_CM 0. 4.998 DISPLAY_IDENTIFIER C_V_TPS_SP_BOL_1 FORMAT "%3.2" /end CHARACTERISTIC
/begin CHARACTERISTIC c_v_tps_sp_bol_2 "" VALUE 0x0091a _REC_VAL_20_u1 4.998 _CNV_A_R_LINEAR_____44_CM 0. 4.998 DISPLAY_IDENTIFIER C_V_TPS_SP_BOL_2 FORMAT "%3.2" /end CHARACTERISTIC
/begin CHARACTERISTIC c_vb_min_tps_ad "" VALUE 0x00933 _REC_VAL_20_u1 25.8984 _CNV_A_R_LINEAR_____34_CM 0. 25.8984 DISPLAY_IDENTIFIER C_VB_MIN_TPS_AD FORMAT "%3.1" /end CHARACTERISTIC
/begin MEASUREMENT lv_n_lim_tps_ad "Demand security trailing throttle fuel cut off (SAS)" UBYTE _CNV_S_2_RANGE______0_CM 1 100. 0. 1. DISPLAY_IDENTIFIER LV_N_LIM_TPS_AD ECU_ADDRESS 0x3fe50d BIT_MASK 0x1 /end MEASUREMENT
/begin MEASUREMENT lv_tps_ad_cur_off "Demand ETC Limp Home" UBYTE _CNV_S_2_RANGE______0_CM 1 100. 0. 1. DISPLAY_IDENTIFIER LV_TPS_AD_CUR_OFF ECU_ADDRESS 0x3fe511 BIT_MASK 0x1 /end MEASUREMENT
/begin MEASUREMENT lv_tps_ad_diag_cur_off "Demand ETC LIMP HOME" UBYTE _CNV_S_2_RANGE______0_CM 1 100. 0. 1. DISPLAY_IDENTIFIER LV_TPS_AD_DIAG_CUR_OFF ECU_ADDRESS 0x3fe50e BIT_MASK 0x1 /end MEASUREMENT
/begin MEASUREMENT tps_sp_ad "Throttle position setpoint during Adaptation" UWORD _CNV_A_R_LINEAR_____53_CM 1 100. 0. 119.5 DISPLAY_IDENTIFIER TPS_SP_AD ECU_ADDRESS 0x3fd7d4 BYTE_ORDER MSB_LAST FORMAT "%7.3" /end MEASUREMENT
/begin MEASUREMENT v_tps_ad_el_bol_1 "Adaptation value for the lower electronic stop, TPS-channel 1" UWORD _CNV_A_R_LINEAR_____3_CM 1 100. 0. 4.99511719 DISPLAY_IDENTIFIER V_TPS_AD_EL_BOL_1 ECU_ADDRESS 0x3fd7c8 BYTE_ORDER MSB_LAST FORMAT "%5.3" /end MEASUREMENT
/begin MEASUREMENT v_tps_ad_el_bol_2 "Adaptation value for the lower electronic stop, TPS-channel 2" UWORD _CNV_A_R_LINEAR_____3_CM 1 100. 0. 4.99511719 DISPLAY_IDENTIFIER V_TPS_AD_EL_BOL_2 ECU_ADDRESS 0x3fd7ca BYTE_ORDER MSB_LAST FORMAT "%5.3" /end MEASUREMENT
/begin MEASUREMENT v_tps_ad_lih_1 "Adaptation value for the limp home position, TPS-channel 1" UWORD _CNV_A_R_LINEAR_____3_CM 1 100. 0. 4.99511719 DISPLAY_IDENTIFIER V_TPS_AD_LIH_1 ECU_ADDRESS 0x3fd7cc BYTE_ORDER MSB_LAST FORMAT "%5.3" /end MEASUREMENT
/begin MEASUREMENT v_tps_ad_lih_2 "Adaptation value for the limp home position, TPS-channel 2" UWORD _CNV_A_R_LINEAR_____3_CM 1 100. 0. 4.99511719 DISPLAY_IDENTIFIER V_TPS_AD_LIH_2 ECU_ADDRESS 0x3fd7ce BYTE_ORDER MSB_LAST FORMAT "%5.3" /end MEASUREMENT
/begin MEASUREMENT lv_tps_ad_act "TPS diagnosis/Adaptation condition is fulfilled" UBYTE _CNV_S_2_RANGE______0_CM 1 100. 0. 1. DISPLAY_IDENTIFIER LV_TPS_AD_ACT ECU_ADDRESS 0x3fe510 BIT_MASK 0x1 /end MEASUREMENT
/begin MEASUREMENT tps_ad_slop_gain_1 "Adaptation value of the amplification factor of amplified poti 1" UWORD _CNV_A_R_LINEAR_____345_CM 1 100. 0. 7.99987793 DISPLAY_IDENTIFIER TPS_AD_SLOP_GAIN_1 ECU_ADDRESS 0x3fd7d0 BYTE_ORDER MSB_LAST FORMAT "%6.4" /end MEASUREMENT
/begin MEASUREMENT tps_lih_1 "Limp home position of the throttle valve of TPS-Poti 1" UWORD _CNV_A_R_LINEAR_____53_CM 1 100. 0. 119.5 DISPLAY_IDENTIFIER TPS_LIH_1 ECU_ADDRESS 0x3fd7d6 BYTE_ORDER MSB_LAST FORMAT "%7.3" /end MEASUREMENT
/begin MEASUREMENT tps_lih_2 "Limp home position  of the throttle valve of TPS-Poti 2" UWORD _CNV_A_R_LINEAR_____53_CM 1 100. 0. 119.5 DISPLAY_IDENTIFIER TPS_LIH_2 ECU_ADDRESS 0x3fd7d8 BYTE_ORDER MSB_LAST FORMAT "%7.3" /end MEASUREMENT
/begin MEASUREMENT lv_tps_ad_req "Demand TPS-Adaptation" UBYTE _CNV_S_2_RANGE______0_CM 1 100. 0. 1. DISPLAY_IDENTIFIER LV_TPS_AD_REQ ECU_ADDRESS 0x3fe50f BIT_MASK 0x1 /end MEASUREMENT
/begin CHARACTERISTIC c_tps_sp_spr_chk_up "TPS_SP for limp home spring test on the Adaptation routine" VALUE 0x01964 _REC_VAL_20_u2 119.5 _CNV_A_R_LINEAR_____53_CM 0. 119.5 DISPLAY_IDENTIFIER C_TPS_SP_SPR_CHK_UP FORMAT "%7.3" /end CHARACTERISTIC
/begin MEASUREMENT tps_lih_ini "" UWORD _CNV_A_R_LINEAR_____53_CM 1 100. 0. 119.5 DISPLAY_IDENTIFIER TPS_LIH_INI ECU_ADDRESS 0x3fd7da BYTE_ORDER MSB_LAST FORMAT "%7.3" /end MEASUREMENT
/begin MEASUREMENT v_tps_ad_bol_gain_1 "Adaptation value for the lower mechanical stop of the amplification poti 1" UWORD _CNV_A_R_LINEAR_____3_CM 1 100. 0. 4.99511719 DISPLAY_IDENTIFIER V_TPS_AD_BOL_GAIN_1 ECU_ADDRESS 0x3fd7e0 BYTE_ORDER MSB_LAST FORMAT "%5.3" /end MEASUREMENT
/begin MEASUREMENT v_tps_ad_tol_1 "Non-amplified upper value for the Adaptation of amplified of TPS-channel 1" UWORD _CNV_A_R_LINEAR_____3_CM 1 100. 0. 4.99511719 DISPLAY_IDENTIFIER V_TPS_AD_TOL_1 ECU_ADDRESS 0x3fd7e4 BYTE_ORDER MSB_LAST FORMAT "%5.3" /end MEASUREMENT
/begin MEASUREMENT v_tps_ad_tol_gain_1 "Amplified upper value for the Adaptation of amplified of TPS-channel 1" UWORD _CNV_A_R_LINEAR_____3_CM 1 100. 0. 4.99511719 DISPLAY_IDENTIFIER V_TPS_AD_TOL_GAIN_1 ECU_ADDRESS 0x3fd7e2 BYTE_ORDER MSB_LAST FORMAT "%5.3" /end MEASUREMENT
/begin MEASUREMENT inh_iv_tps_ad "logical variable to inhibit injection and ignition during TPS Adaptation" UBYTE _CNV_S_2_RANGE______2_R_CM 1 100. 0. 255. DISPLAY_IDENTIFIER INH_IV_TPS_AD ECU_ADDRESS 0x3fe50c /end MEASUREMENT
/begin MEASUREMENT v_tps_ad_ofs_gain_1 "Adaptation value of the amplification offset of  of amplified poti 1" SWORD _CNV_A_R_LINEAR_____355_CM 1 100. -2.5 2.5 DISPLAY_IDENTIFIER V_TPS_AD_OFS_GAIN_1 ECU_ADDRESS 0x3fd7d2 BYTE_ORDER MSB_LAST /end MEASUREMENT
/begin MEASUREMENT lv_tps_ad_mec_bol "logical variable data" UBYTE _CNV_S_2_RANGE______6_R_CM 1 100. 0. 255. DISPLAY_IDENTIFIER LV_TPS_AD_MEC_BOL ECU_ADDRESS 0x3fe512 /end MEASUREMENT
/begin MEASUREMENT tps_ad_step "Steps of throttle Adaptation" ULONG _CNV_S_11_RANGE_TPS__451_CM 1 100. 0. 10. DISPLAY_IDENTIFIER TPS_AD_STEP ECU_ADDRESS 0x3fe514 BYTE_ORDER MSB_LAST /end MEASUREMENT
/begin CHARACTERISTIC c_tps_sp_rst_chk "TPS_SP for testing the retracting spring" VALUE 0x01960 _REC_VAL_20_u2 119.5 _CNV_A_R_LINEAR_____53_CM 0. 119.5 DISPLAY_IDENTIFIER C_TPS_SP_RST_CHK /end CHARACTERISTIC
/begin CHARACTERISTIC c_tps_av_rst_chk "Threshold for activation the position controller" VALUE 0x01934 _REC_VAL_20_u2 119.5 _CNV_A_R_LINEAR_____53_CM 0. 119.5 DISPLAY_IDENTIFIER C_TPS_AV_RST_CHK FORMAT "%7.3" /end CHARACTERISTIC
/begin CHARACTERISTIC c_t_tps_av_rst_chk "Time condition for deactivation the position controller" VALUE 0x00840 _REC_VAL_20_u1 1.275 _CNV_A_R_LINEAR_____366_CM 0. 1.275 DISPLAY_IDENTIFIER C_T_TPS_AV_RST_CHK FORMAT "%5.3" /end CHARACTERISTIC
/begin CHARACTERISTIC c_v_tps_ad_win_bol "Adaptation window size (+/-) for Adaptation of lower stop" VALUE 0x00916 _REC_VAL_20_u1 2.49023438 _CNV_A_R_LINEAR_____450_CM 0. 2.49023438 DISPLAY_IDENTIFIER C_V_TPS_AD_WIN_BOL FORMAT "%4.3" /end CHARACTERISTIC
/begin CHARACTERISTIC c_v_tps_ad_win_2_bol "Adaptation window size (+/-) for continously mec BOL Adaptation of lower stop" VALUE 0x00915 _REC_VAL_20_u1 2.49023438 _CNV_A_R_LINEAR_____450_CM 0. 2.49023438 DISPLAY_IDENTIFIER C_V_TPS_AD_WIN_2_BOL FORMAT "%5.3" /end CHARACTERISTIC
/begin MEASUREMENT ctr_st_chk_chk_lih_1_ready "Start check check limp home 1 passed" UWORD _CNV_A_R_LINEAR_____1_CM 1 100. 0. 65535. DISPLAY_IDENTIFIER CTR_ST_CHK_CHK_LIH_1_READY ECU_ADDRESS 0x3fd7dc BYTE_ORDER MSB_LAST FORMAT "%5.0" /end MEASUREMENT
/begin MEASUREMENT ctr_st_chk_chk_lih_1_err "Start check check limp home 1 not passed" UWORD _CNV_A_R_LINEAR_____1_CM 1 100. 0. 65535. DISPLAY_IDENTIFIER CTR_ST_CHK_CHK_LIH_1_ERR ECU_ADDRESS 0x3fd7de BYTE_ORDER MSB_LAST FORMAT "%5.0" /end MEASUREMENT
/begin MEASUREMENT lv_err_tps_st_chk_2 "TPS-error-bit (Return spring test)" UBYTE _CNV_S_2_RANGE______6_R_CM 1 100. 0. 255. DISPLAY_IDENTIFIER LV_ERR_TPS_ST_CHK_2 ECU_ADDRESS 0x3fb940 /end MEASUREMENT
/begin MEASUREMENT lv_err_tps_ad "TPS-error-bit (Adaptation)" UBYTE _CNV_S_2_RANGE______6_R_CM 1 100. 0. 255. DISPLAY_IDENTIFIER LV_ERR_TPS_AD ECU_ADDRESS 0x3fb934 /end MEASUREMENT
/begin MEASUREMENT lv_err_tps_ad_bol "Error bit" UBYTE _CNV_S_2_RANGE______6_R_CM 1 100. 0. 255. DISPLAY_IDENTIFIER LV_ERR_TPS_AD_BOL ECU_ADDRESS 0x3fb938 /end MEASUREMENT
/begin CHARACTERISTIC c_t_dyw_tps_lih_chk "Time period for Dynamic window around Limp Home" VALUE 0x0080c _REC_VAL_20_u1 1.275 _CNV_A_R_LINEAR_____366_CM 0. 1.275 DISPLAY_IDENTIFIER C_T_DYW_TPS_LIH_CHK FORMAT "%4.3" /end CHARACTERISTIC
/begin CHARACTERISTIC c_v_tps_ad_bol_ini_1 "Start value for the Adaptation value lower start (Poti 1)" VALUE 0x00912 _REC_VAL_20_u1 4.998 _CNV_A_R_LINEAR_____44_CM 0. 4.998 DISPLAY_IDENTIFIER C_V_TPS_AD_BOL_INI_1 FORMAT "%3.2" /end CHARACTERISTIC
/begin CHARACTERISTIC c_v_tps_ad_bol_ini_2 "Start value for the Adaptation value lower start (Poti 2)" VALUE 0x00913 _REC_VAL_20_u1 4.998 _CNV_A_R_LINEAR_____44_CM 0. 4.998 DISPLAY_IDENTIFIER C_V_TPS_AD_BOL_INI_2 FORMAT "%3.2" /end CHARACTERISTIC
/begin CHARACTERISTIC c_v_tps_lih_chk_hys "Voltage window around Limp Home position for recognizing a correct MTC" VALUE 0x00918 _REC_VAL_20_u1 1.24511719 _CNV_A_R_LINEAR_____390_CM 0. 1.24511719 DISPLAY_IDENTIFIER C_V_TPS_LIH_CHK_HYS FORMAT "%4.3" /end CHARACTERISTIC
/begin CHARACTERISTIC c_v_tps_sp_lih_1 "Nominal value of the TPS-voltage in Limp Home for Poti 1" VALUE 0x0091b _REC_VAL_20_u1 4.998 _CNV_A_R_LINEAR_____44_CM 0. 4.998 DISPLAY_IDENTIFIER C_V_TPS_SP_LIH_1 FORMAT "%3.2" /end CHARACTERISTIC
/begin CHARACTERISTIC c_v_tps_sp_lih_2 "Nominal value of the TPS-voltage in Limp Home for Poti 1" VALUE 0x0091c _REC_VAL_20_u1 4.998 _CNV_A_R_LINEAR_____44_CM 0. 4.998 DISPLAY_IDENTIFIER C_V_TPS_SP_LIH_2 FORMAT "%3.2" /end CHARACTERISTIC
/begin CHARACTERISTIC c_tps_ad_slop_gain_ini_1 "" VALUE 0x01930 _REC_VAL_20_u2 7.99987793 _CNV_A_R_LINEAR_____345_CM 0. 7.99987793 DISPLAY_IDENTIFIER C_TPS_AD_SLOP_GAIN_INI_1 FORMAT "%6.4" /end CHARACTERISTIC
/begin CHARACTERISTIC c_v_tps_ad_ofs_gain_ini_1 "" VALUE 0x004c4 _REC_VAL_20_s2 5. _CNV_A_R_LINEAR_____355_CM -2.5 2.5 DISPLAY_IDENTIFIER C_V_TPS_AD_OFS_GAIN_INI_1 /end CHARACTERISTIC
/begin MEASUREMENT lv_err_tps_st_chk_1 "TPS-error-bit (Return spring test)" UBYTE _CNV_S_2_RANGE______6_R_CM 1 100. 0. 255. DISPLAY_IDENTIFIER LV_ERR_TPS_ST_CHK_1 ECU_ADDRESS 0x3fb93c /end MEASUREMENT
/begin MEASUREMENT lv_tps_mtc_n_lim "LV limp home request TPS" UBYTE _CNV_S_2_RANGE______0_CM 1 100. 0. 1. DISPLAY_IDENTIFIER LV_TPS_MTC_N_LIM ECU_ADDRESS 0x3fe52b BIT_MASK 0x1 /end MEASUREMENT
/begin MEASUREMENT lv_mtc_lih_cur_off "ETC-Limp home is activ" UBYTE _CNV_S_2_RANGE______0_CM 1 100. 0. 1. DISPLAY_IDENTIFIER LV_MTC_LIH_CUR_OFF ECU_ADDRESS 0x3fe529 BIT_MASK 0x1 /end MEASUREMENT
/begin MEASUREMENT lv_err_tps "Error currently present on at least one throttle position sensor" UBYTE _CNV_S_2_RANGE______2_R_CM 1 100. 0. 255. DISPLAY_IDENTIFIER LV_ERR_TPS ECU_ADDRESS 0x3fe527 /end MEASUREMENT
/begin MEASUREMENT lv_n_lim_etc_lih "LV safety cut off" UBYTE _CNV_S_2_RANGE______0_CM 1 100. 0. 1. DISPLAY_IDENTIFIER LV_N_LIM_ETC_LIH ECU_ADDRESS 0x3fe52a BIT_MASK 0x1 /end MEASUREMENT
/begin MEASUREMENT lv_n_lim_etc_lih_rev "ETC-LIMP-HOME-3  (Reversible)" UBYTE _CNV_S_2_RANGE______0_CM 1 100. 0. 1. DISPLAY_IDENTIFIER LV_N_LIM_ETC_LIH_REV ECU_ADDRESS 0x3fe52d BIT_MASK 0x1 /end MEASUREMENT
/begin MEASUREMENT state_tps_diag "Status TPS Diagnosis" UBYTE _CNV_S_5_RANGE_STAT_452_CM 1 100. 0. 8. DISPLAY_IDENTIFIER STATE_TPS_DIAG ECU_ADDRESS 0x3fe525 /end MEASUREMENT
/begin MEASUREMENT state_etc_lih "Status ETC Limp-Home" UBYTE _CNV_S_5_RANGE_STAT_453_CM 1 100. 0. 8. DISPLAY_IDENTIFIER STATE_ETC_LIH ECU_ADDRESS 0x3fe526 /end MEASUREMENT
/begin MEASUREMENT lv_mtc_cur_off_req "ETC without power request" UBYTE _CNV_S_2_RANGE______0_CM 1 100. 0. 1. DISPLAY_IDENTIFIER LV_MTC_CUR_OFF_REQ ECU_ADDRESS 0x3fe52c /end MEASUREMENT
/begin MEASUREMENT lv_err_mtc_ctl_2 "Logical variable (set. if a MTCPWM error is present)" UBYTE _CNV_S_2_RANGE______6_R_CM 1 100. 0. 255. DISPLAY_IDENTIFIER LV_ERR_MTC_CTL_2 ECU_ADDRESS 0x3fb92c /end MEASUREMENT
/begin MEASUREMENT lv_err_mtc_ctl_3 "Logical variable (set. if a MTCPWM error is present)" UBYTE _CNV_S_2_RANGE______6_R_CM 1 100. 0. 255. DISPLAY_IDENTIFIER LV_ERR_MTC_CTL_3 ECU_ADDRESS 0x3fb930 /end MEASUREMENT
/begin MEASUREMENT lv_mtc_cur_off "Logical variable to switch off  the MTC-controller" UBYTE _CNV_S_2_RANGE______0_CM 1 100. 0. 1. DISPLAY_IDENTIFIER LV_MTC_CUR_OFF ECU_ADDRESS 0x3fe503 /end MEASUREMENT
/begin MEASUREMENT lv_tps_sp_lih "Bit collecting the requests of all 3 monitoring levels to switch off MTC" UBYTE _CNV_S_2_RANGE______0_CM 1 100. 0. 1. DISPLAY_IDENTIFIER LV_TPS_SP_LIH ECU_ADDRESS 0x3fe502 /end MEASUREMENT
/begin MEASUREMENT tps_sp_sel "selected throttle position setpoint before limitation" UWORD _CNV_A_R_LINEAR_____53_CM 1 100. 0. 119.5 DISPLAY_IDENTIFIER TPS_SP_SEL ECU_ADDRESS 0x3fd7ba BYTE_ORDER MSB_LAST FORMAT "%7.3" /end MEASUREMENT
/begin CHARACTERISTIC c_tps_av_bol "Lower limit (actual value) of the closing speed limitation of the throttle setpoint" VALUE 0x01932 _REC_VAL_20_u2 119.5 _CNV_A_R_LINEAR_____53_CM 0. 119.5 DISPLAY_IDENTIFIER C_TPS_AV_BOL FORMAT "%7.3" /end CHARACTERISTIC
/begin CHARACTERISTIC c_tps_av_tol "Upper limit (actual value) of the closing speed limitation of the throttle setpoint" VALUE 0x01936 _REC_VAL_20_u2 119.5 _CNV_A_R_LINEAR_____53_CM 0. 119.5 DISPLAY_IDENTIFIER C_TPS_AV_TOL FORMAT "%7.3" /end CHARACTERISTIC
/begin CHARACTERISTIC c_tps_sp_min "Lower limit of the throttle position setpoint" VALUE 0x01958 _REC_VAL_20_u2 119.5 _CNV_A_R_LINEAR_____53_CM 0. 119.5 DISPLAY_IDENTIFIER C_TPS_SP_MIN FORMAT "%7.3" /end CHARACTERISTIC
/begin CHARACTERISTIC c_tps_sp_min_tps_ad_req "Lower limit of the throttle position setpoint without throttle Adaptation" VALUE 0x0195a _REC_VAL_20_u2 119.5 _CNV_A_R_LINEAR_____53_CM 0. 119.5 DISPLAY_IDENTIFIER C_TPS_SP_MIN_TPS_AD_REQ FORMAT "%7.3" /end CHARACTERISTIC
/begin CHARACTERISTIC c_tps_sp_max_tps_ad_req "Upper limit of the throttle position setpoint without throttle Adaptation" VALUE 0x01956 _REC_VAL_20_u2 119.5 _CNV_A_R_LINEAR_____53_CM 0. 119.5 DISPLAY_IDENTIFIER C_TPS_SP_MAX_TPS_AD_REQ FORMAT "%7.3" /end CHARACTERISTIC
/begin CHARACTERISTIC c_tps_sp_max "Upper limit of the throttle position setpoint" VALUE 0x01954 _REC_VAL_20_u2 119.5 _CNV_A_R_LINEAR_____53_CM 0. 119.5 DISPLAY_IDENTIFIER C_TPS_SP_MAX FORMAT "%7.3" /end CHARACTERISTIC
/begin CHARACTERISTIC c_tps_sp_tol "Upper limit of opening velocity limitation the throttle position setpoint" VALUE 0x0196a _REC_VAL_20_u2 119.5 _CNV_A_R_LINEAR_____53_CM 0. 119.5 DISPLAY_IDENTIFIER C_TPS_SP_TOL FORMAT "%7.3" /end CHARACTERISTIC
/begin CHARACTERISTIC c_tps_sp_tol_tps_ad_req "Upper limit of opening velocity limitation the throttle position setpoint without throttle Adaptation" VALUE 0x0196c _REC_VAL_20_u2 119.5 _CNV_A_R_LINEAR_____53_CM 0. 119.5 DISPLAY_IDENTIFIER C_TPS_SP_TOL_TPS_AD_REQ FORMAT "%7.3" /end CHARACTERISTIC
/begin CHARACTERISTIC c_tps_sp_bol_tps_ad_req "Lower limit of opening velocity limitation the throttle position setpoint without throttle Adaptation" VALUE 0x0194c _REC_VAL_20_u2 119.5 _CNV_A_R_LINEAR_____53_CM 0. 119.5 DISPLAY_IDENTIFIER C_TPS_SP_BOL_TPS_AD_REQ FORMAT "%7.3" /end CHARACTERISTIC
/begin CHARACTERISTIC c_tps_sp_bol "Lower limit of opening velocity limitation the throttle position setpoint" VALUE 0x0194a _REC_VAL_20_u2 119.5 _CNV_A_R_LINEAR_____53_CM 0. 119.5 DISPLAY_IDENTIFIER C_TPS_SP_BOL FORMAT "%7.3" /end CHARACTERISTIC
/begin CHARACTERISTIC c_tps_sp_lgrd_tot "Threshold opening after power latch" VALUE 0x01950 _REC_VAL_20_u2 119.5 _CNV_A_R_LINEAR_____53_CM 0. 119.5 DISPLAY_IDENTIFIER C_TPS_SP_LGRD_TOT FORMAT "%7.3" /end CHARACTERISTIC
/begin MEASUREMENT tps_sp "real throttle angle setpoint for MTC-position controller" UWORD _CNV_A_R_LINEAR_____53_CM 1 100. 0. 119.5 DISPLAY_IDENTIFIER TPS_SP ECU_ADDRESS 0x3fd7b8 BYTE_ORDER MSB_LAST FORMAT "%7.3" /end MEASUREMENT
/begin MEASUREMENT tps_sp_lim "limited throttle position setpoint" UWORD _CNV_A_R_LINEAR_____53_CM 1 100. 0. 119.5 DISPLAY_IDENTIFIER TPS_SP_LIM ECU_ADDRESS 0x3fd7bc BYTE_ORDER MSB_LAST FORMAT "%7.3" /end MEASUREMENT
/begin MEASUREMENT tps_sp_lim_2 "Throttle position setpoint after gradient limitation over whole operating range" UWORD _CNV_A_R_LINEAR_____53_CM 1 100. 0. 119.5 DISPLAY_IDENTIFIER TPS_SP_LIM_2 ECU_ADDRESS 0x3fd7c0 BYTE_ORDER MSB_LAST FORMAT "%7.3" /end MEASUREMENT
/begin MEASUREMENT tps_sp_lim_1 "Throttle position setpoint after absolute value limitation" UWORD _CNV_A_R_LINEAR_____53_CM 1 100. 0. 119.5 DISPLAY_IDENTIFIER TPS_SP_LIM_1 ECU_ADDRESS 0x3fd7be BYTE_ORDER MSB_LAST FORMAT "%7.3" /end MEASUREMENT
/begin MEASUREMENT lv_tps_sp_tra_st_mdl "Logical variable indicating transient phase after start" UBYTE _CNV_S_2_RANGE______0_CM 1 100. 0. 1. DISPLAY_IDENTIFIER LV_TPS_SP_TRA_ST_MDL ECU_ADDRESS 0x3fe507 /end MEASUREMENT
/begin MEASUREMENT tps_sp_tra_st_mdl "Throttle position setpoint for transient phase after start" UWORD _CNV_A_R_LINEAR_____53_CM 1 100. 0. 119.5 DISPLAY_IDENTIFIER TPS_SP_TRA_ST_MDL ECU_ADDRESS 0x3fd7c2 BYTE_ORDER MSB_LAST FORMAT "%7.3" /end MEASUREMENT
/begin CHARACTERISTIC ip_tps_sp_lgrd_st "Admissible gradient of throttle position setpoint for transient phase after start" MAP 0x0f6c2 _REC_MAP_20_u2_u2_u1 119.492706 _CNV_A_R_LINEAR_____455_CM 7.294e-003 119.5 DISPLAY_IDENTIFIER IP_TPS_SP_LGRD_ST FORMAT "%7.3"
 /begin AXIS_DESCR COM_AXIS n _CNV_A_R_LINEAR_____11_CM 8 0. 8160. FORMAT "%4.0" AXIS_PTS_REF ldp_n_ip_tps_sp_lgrd_st /end AXIS_DESCR
 /begin AXIS_DESCR COM_AXIS tco _CNV_A_R_LINEAR_____12_CM 8 -48. 142.5 FORMAT "%5.1" AXIS_PTS_REF ldp_tco_ip_tps_sp_lgrd_st /end AXIS_DESCR
/end CHARACTERISTIC
/begin AXIS_PTS ldp_n_ip_tps_sp_lgrd_st "" 0x10f84 n _REC_AXS_20_u2 8160. _CNV_A_R_LINEAR_____11_CM 8 0. 8160. DISPLAY_IDENTIFIER LDP_N_IP_TPS_SP_LGRD_ST FORMAT "%4.0" /end AXIS_PTS
/begin AXIS_PTS ldp_tco_ip_tps_sp_lgrd_st "" 0x07e03 tco _REC_AXS_20_u1 190.5 _CNV_A_R_LINEAR_____12_CM 8 -48. 142.5 DISPLAY_IDENTIFIER LDP_TCO_IP_TPS_SP_LGRD_ST FORMAT "%5.1" /end AXIS_PTS
/begin MEASUREMENT lv_err_mtc_ctl_1 "Logical variable (set. if a MTCPWM error is present)" UBYTE _CNV_S_2_RANGE______2_R_CM 1 100. 0. 255. DISPLAY_IDENTIFIER LV_ERR_MTC_CTL_1 ECU_ADDRESS 0x3fb928 /end MEASUREMENT
/begin CHARACTERISTIC TOGMAXUNPL "" VALUE 0x1b7ab _REC_VAL_20_u1 251. _CNV_R_R_dez_498_CM 4. 255. FORMAT "%5.1" /end CHARACTERISTIC
/begin CHARACTERISTIC TOG_CNTMAX "" VALUE 0x1b7a8 _REC_VAL_20_u2 655.35 _CNV_R_R_t10msxs_ub_507_CM 0. 655.35 FORMAT "%8.4" /end CHARACTERISTIC
/begin CHARACTERISTIC DTOG_UBMIN "" VALUE 0x1b7aa _REC_VAL_20_u1 24.02 _CNV_R_R_spg_ubatt_508_CM 0. 24.02 FORMAT "%5.2" /end CHARACTERISTIC
/begin MEASUREMENT lv_err_bsd "logical variable for BSD error" UBYTE _CNV_S_2_RANGE______2_R_CM 1 100. 0. 255. DISPLAY_IDENTIFIER LV_ERR_BSD ECU_ADDRESS 0x3fba94 /end MEASUREMENT
/begin MEASUREMENT lv_err_toil_level "Error condition of TOENS" UBYTE _CNV_S_2_RANGE______2_R_CM 1 100. 0. 255. DISPLAY_IDENTIFIER LV_ERR_TOIL_LEVEL ECU_ADDRESS 0x3fb894 /end MEASUREMENT
/begin MEASUREMENT lv_err_bat_sens "Error condition of TOENS" UBYTE _CNV_S_2_RANGE______2_R_CM 1 100. 0. 255. DISPLAY_IDENTIFIER LV_ERR_BAT_SENS ECU_ADDRESS 0x3fbb2c /end MEASUREMENT
/begin MEASUREMENT lv_err_bat_sens_it "Error condition of TOENS" UBYTE _CNV_S_2_RANGE______2_R_CM 1 100. 0. 255. DISPLAY_IDENTIFIER LV_ERR_BAT_SENS_IT ECU_ADDRESS 0x3fbb30 /end MEASUREMENT
/begin MEASUREMENT lv_err_bat_sens_it_el "Error condition of TOENS" UBYTE _CNV_S_2_RANGE______2_R_CM 1 100. 0. 255. DISPLAY_IDENTIFIER LV_ERR_BAT_SENS_IT_EL ECU_ADDRESS 0x3fbb34 /end MEASUREMENT
/begin CHARACTERISTIC c_tps_sp_lgrd_stop "max. admissable gradient of throtle setpoint in the range of the top and bottom stop" VALUE 0x0194e _REC_VAL_20_u2 119.5 _CNV_A_R_LINEAR_____454_CM 0. 119.5 DISPLAY_IDENTIFIER C_TPS_SP_LGRD_STOP FORMAT "%7.3" /end CHARACTERISTIC
/begin MEASUREMENT lv_err_spi_mps "Present failure SPI-bus for Multi-powerstage" UBYTE _CNV_S_2_RANGE______2_R_CM 1 100. 0. 255. DISPLAY_IDENTIFIER LV_ERR_SPI_MPS ECU_ADDRESS 0x3fbab8 /end MEASUREMENT
/begin MEASUREMENT lv_err_spi_knk "Present failure SPI-bus diagnosis for Knock sensor" UBYTE _CNV_S_2_RANGE______2_R_CM 1 100. 0. 255. DISPLAY_IDENTIFIER LV_ERR_SPI_KNK ECU_ADDRESS 0x3fbabc /end MEASUREMENT
/begin CHARACTERISTIC c_thd_brake_prs "maximum threshold for brake pressure(erroro detection)" VALUE 0x008bb _REC_VAL_20_u1 255. _CNV_A_R_LINEAR_____86_CM 0. 255. DISPLAY_IDENTIFIER C_THD_BRAKE_PRS FORMAT "%3.0" /end CHARACTERISTIC
/begin CHARACTERISTIC c_t_dly_brake_prs "Delay time for detection of emergency braking" VALUE 0x017e0 _REC_VAL_20_u2 655.35 _CNV_A_R_LINEAR_____4_CM 0. 655.35 DISPLAY_IDENTIFIER C_T_DLY_BRAKE_PRS FORMAT "%6.2" /end CHARACTERISTIC
/begin MEASUREMENT lv_brake_prs_pvs_diag "LV indicating if brake pressure exceeds max. threshold" UBYTE _CNV_A_R_LINEAR_____22_CM 1 100. 0. 1. DISPLAY_IDENTIFIER LV_BRAKE_PRS_PVS_DIAG ECU_ADDRESS 0x3fe0c3 FORMAT "%1.0" /end MEASUREMENT
/begin MEASUREMENT t_dly_brake_prs "Delay time for detection of emergency braking" UWORD _CNV_A_R_LINEAR_____4_CM 1 100. 0. 655.35 DISPLAY_IDENTIFIER T_DLY_BRAKE_PRS ECU_ADDRESS 0x3fd214 BYTE_ORDER MSB_LAST FORMAT "%6.2" /end MEASUREMENT
/begin COMPU_METHOD _CNV_S_2_RANGE______0_CM "" TAB_VERB "%6.3" "[-]" COMPU_TAB_REF _CNV_S_2_RANGE______0 /end COMPU_METHOD
/begin COMPU_VTAB _CNV_S_2_RANGE______0 "" TAB_VERB 2 0 "0" 1 "1" /end COMPU_VTAB
/begin COMPU_METHOD _CNV_A_R_LINEAR_____1_CM "" RAT_FUNC "%6.3" "-" COEFFS 0 1. 0. 0 0 1 /end COMPU_METHOD
/begin COMPU_METHOD _CNV_S_2_RANGE______2_R_CM "" TAB_VERB "%6.3" "[-]" COMPU_TAB_REF _CNV_S_2_RANGE______2_R /end COMPU_METHOD
/begin COMPU_VTAB_RANGE _CNV_S_2_RANGE______2_R "" 2 0 0 "0" 1 255 "1" /end COMPU_VTAB_RANGE
/begin COMPU_METHOD _CNV_A_R_LINEAR_____3_CM "" RAT_FUNC "%6.3" "V" COEFFS 0 204.7999998974999 0. 0 0 1 /end COMPU_METHOD
/begin COMPU_METHOD _CNV_A_R_LINEAR_____4_CM "" RAT_FUNC "%6.3" "s" COEFFS 0 100. 0. 0 0 1 /end COMPU_METHOD
/begin COMPU_METHOD _CNV_S_2_RANGE______5_CM "" TAB_VERB "%6.3" "-" COMPU_TAB_REF _CNV_S_2_RANGE______5 /end COMPU_METHOD
/begin COMPU_VTAB _CNV_S_2_RANGE______5 "" TAB_VERB 2 0 "0" 1 "1" /end COMPU_VTAB
/begin COMPU_METHOD _CNV_S_2_RANGE______6_R_CM "" TAB_VERB "%6.3" "-" COMPU_TAB_REF _CNV_S_2_RANGE______6_R /end COMPU_METHOD
/begin COMPU_VTAB_RANGE _CNV_S_2_RANGE______6_R "" 2 0 0 "0" 1 255 "1" /end COMPU_VTAB_RANGE
/begin COMPU_METHOD _CNV_A_R_LINEAR_____7_CM "" RAT_FUNC "%6.3" "°C" COEFFS 0 16. 0. 0 0 1 /end COMPU_METHOD
/begin COMPU_METHOD _CNV_A_R_LINEAR_____9_CM "" RAT_FUNC "%6.3" "%" COEFFS 0 655.3600000071681 0. 0 0 1 /end COMPU_METHOD
/begin COMPU_METHOD _CNV_A_R_LINEAR_____10_CM "" RAT_FUNC "%6.3" "%" COEFFS 0 2.56 0. 0 0 1 /end COMPU_METHOD
/begin COMPU_METHOD _CNV_A_R_LINEAR_____11_CM "" RAT_FUNC "%6.3" "rpm" COEFFS 0 1. 0. 0 0 1 /end COMPU_METHOD
/begin COMPU_METHOD _CNV_A_R_LINEAR_____12_CM "" RAT_FUNC "%6.3" "°C" COEFFS 0 1.333333333333333 64. 0 0 1 /end COMPU_METHOD
/begin COMPU_METHOD _CNV_A_R_LINEAR_____13_CM "" RAT_FUNC "%6.3" "°C" COEFFS 0 1.333333333333333 0. 0 0 1 /end COMPU_METHOD
/begin COMPU_METHOD _CNV_A_R_LINEAR_____15_CM "" RAT_FUNC "%6.3" "°C" COEFFS 0 1. 40. 0 0 1 /end COMPU_METHOD
/begin COMPU_METHOD _CNV_A_R_LINEAR_____16_CM "" RAT_FUNC "%6.3" "rpm" COEFFS 0 3.125e-002 0. 0 0 1 /end COMPU_METHOD
/begin COMPU_METHOD _CNV_A_R_LINEAR_____21_CM "" RAT_FUNC "%6.3" "-" COEFFS 0 32768.00003968061 0. 0 0 1 /end COMPU_METHOD
/begin COMPU_METHOD _CNV_A_R_LINEAR_____22_CM "" RAT_FUNC "%6.3" "[-]" COEFFS 0 1. 0. 0 0 1 /end COMPU_METHOD
/begin COMPU_METHOD _CNV_A_R_LINEAR_____23_CM "" RAT_FUNC "%6.3" "km/h" COEFFS 0 1. 0. 0 0 1 /end COMPU_METHOD
/begin COMPU_METHOD _CNV_A_R_LINEAR_____24_CM "" RAT_FUNC "%6.3" "s" COEFFS 0 10. 0. 0 0 1 /end COMPU_METHOD
/begin COMPU_METHOD _CNV_A_R_LINEAR_____29_CM "" RAT_FUNC "%6.3" "-" COEFFS 0 255.9983911655618 0. 0 0 1 /end COMPU_METHOD
/begin COMPU_METHOD _CNV_A_R_LINEAR_____30_CM "" RAT_FUNC "%6.3" "s" COEFFS 0 1. 0. 0 0 1 /end COMPU_METHOD
/begin COMPU_METHOD _CNV_A_R_LINEAR_____31_CM "" RAT_FUNC "%6.3" "ms" COEFFS 0 0.1 0. 0 0 1 /end COMPU_METHOD
/begin COMPU_METHOD _CNV_A_R_LINEAR_____34_CM "" RAT_FUNC "%6.3" "V" COEFFS 0 9.846168103048838 0. 0 0 1 /end COMPU_METHOD
/begin COMPU_METHOD _CNV_A_R_LINEAR_____37_CM "" RAT_FUNC "%6.3" "-" COEFFS 0 65536.00007936121 0. 0 0 1 /end COMPU_METHOD
/begin COMPU_METHOD _CNV_A_R_LINEAR_____39_CM "" RAT_FUNC "%6.3" "-" COEFFS 0 127.9991955827809 0. 0 0 1 /end COMPU_METHOD
/begin COMPU_METHOD _CNV_A_R_LINEAR_____44_CM "" RAT_FUNC "%6.3" "V" COEFFS 0 51.0204081632653 0. 0 0 1 /end COMPU_METHOD
/begin COMPU_METHOD _CNV_A_R_LINEAR_____49_CM "" RAT_FUNC "%6.3" "hPa" COEFFS 0 12.06017666543982 0. 0 0 1 /end COMPU_METHOD
/begin COMPU_METHOD _CNV_A_R_LINEAR_____50_CM "" RAT_FUNC "%6.3" "[-]" COEFFS 0 255.9999357490357 0. 0 0 1 /end COMPU_METHOD
/begin COMPU_METHOD _CNV_A_R_LINEAR_____51_CM "" RAT_FUNC "%6.3" "rpm/s" COEFFS 0 3.125e-002 0. 0 0 1 /end COMPU_METHOD
/begin COMPU_METHOD _CNV_A_R_LINEAR_____52_CM "" RAT_FUNC "%6.3" "°TPS/s" COEFFS 0 8.535564853556485e-002 0. 0 0 1 /end COMPU_METHOD
/begin COMPU_METHOD _CNV_A_R_LINEAR_____53_CM "" RAT_FUNC "%6.3" "°TPS" COEFFS 0 137.0962343096234 0. 0 0 1 /end COMPU_METHOD
/begin COMPU_METHOD _CNV_A_R_LINEAR_____54_CM "" RAT_FUNC "%6.3" "rpm/s" COEFFS 0 3.125e-002 128. 0 0 1 /end COMPU_METHOD
/begin COMPU_METHOD _CNV_A_R_LINEAR_____55_CM "" RAT_FUNC "%6.3" "Nm" COEFFS 0 32. 0. 0 0 1 /end COMPU_METHOD
/begin COMPU_METHOD _CNV_A_R_LINEAR_____85_CM "" RAT_FUNC "%6.3" "km/h" COEFFS 0 128.0000018750286 0. 0 0 1 /end COMPU_METHOD
/begin COMPU_METHOD _CNV_A_R_LINEAR_____86_CM "" RAT_FUNC "%6.3" "bar" COEFFS 0 1. 0. 0 0 1 /end COMPU_METHOD
/begin COMPU_METHOD _CNV_A_R_LINEAR_____88_CM "" RAT_FUNC "%6.3" "km" COEFFS 0 0.1 0. 0 0 1 /end COMPU_METHOD
/begin COMPU_METHOD _CNV_A_R_LINEAR_____97_CM "" RAT_FUNC "%6.3" "min" COEFFS 0 1. 0. 0 0 1 /end COMPU_METHOD
/begin COMPU_METHOD _CNV_A_R_LINEAR_____102_CM "" RAT_FUNC "%6.3" "Nms" COEFFS 0 320.1514411333659 0. 0 0 1 /end COMPU_METHOD
/begin COMPU_METHOD _CNV_A_R_LINEAR_____103_CM "" RAT_FUNC "%6.3" "m/s²" COEFFS 0 640. 32768. 0 0 1 /end COMPU_METHOD
/begin COMPU_METHOD _CNV_A_R_LINEAR_____106_CM "" RAT_FUNC "%6.3" "mg/stk" COEFFS 0 47.18142548596112 0. 0 0 1 /end COMPU_METHOD
/begin COMPU_METHOD _CNV_A_R_LINEAR_____109_CM "" RAT_FUNC "%6.3" "%" COEFFS 0 655.3600000071681 3.584063961170614e-007 0 0 1 /end COMPU_METHOD
/begin COMPU_METHOD _CNV_A_R_LINEAR_____113_CM "" RAT_FUNC "%6.3" "kg/h" COEFFS 0 32. 0. 0 0 1 /end COMPU_METHOD
/begin COMPU_METHOD _CNV_A_R_LINEAR_____127_CM "" RAT_FUNC "%6.3" "[-]" COEFFS 0 64. 0. 0 0 1 /end COMPU_METHOD
/begin COMPU_METHOD _CNV_A_R_LINEAR_____167_CM "" RAT_FUNC "%6.3" "mA" COEFFS 0 163.8375 0. 0 0 1 /end COMPU_METHOD
/begin COMPU_METHOD _CNV_A_R_LINEAR_____184_CM "" RAT_FUNC "%6.3" "Seg" COEFFS 0 1. 0. 0 0 1 /end COMPU_METHOD
/begin COMPU_METHOD _CNV_S_6_RANGE_STAT_185_CM "" TAB_VERB "%6.3" "[-]" COMPU_TAB_REF _CNV_S_6_RANGE_STAT_185 /end COMPU_METHOD
/begin COMPU_VTAB _CNV_S_6_RANGE_STAT_185 "" TAB_VERB 6 0 "ES" 1 "ST" 2 "IS" 3 "PL" 4 "PU" 5 "PUC" /end COMPU_VTAB
/begin COMPU_METHOD _CNV_A_R_LINEAR_____186_CM "" RAT_FUNC "%6.3" "Nm" COEFFS 0 32. 32768. 0 0 1 /end COMPU_METHOD
/begin COMPU_METHOD _CNV_S_9_RANGE_STAT_230_CM "" TAB_VERB "%6.3" "[-]" COMPU_TAB_REF _CNV_S_9_RANGE_STAT_230 /end COMPU_METHOD
/begin COMPU_VTAB _CNV_S_9_RANGE_STAT_230 "" TAB_VERB 9 0 "HOM_AFS" 1 "AFS_TO_AFL" 2 "HOM_AFL" 3 "AFL_TO_AFS" 4 "HOM_TO_S" 5 "BACKS" 6 "S" 7 "S_TO_HOM" 8 "BACKHOM" /end COMPU_VTAB
/begin COMPU_METHOD _CNV_A_R_LINEAR_____235_CM "" RAT_FUNC "%6.3" "-" COEFFS 0 32. 0. 0 0 1 /end COMPU_METHOD
/begin COMPU_METHOD _CNV_A_R_LINEAR_____250_CM "" RAT_FUNC "%6.3" "V" COEFFS 0 13107.19998965744 0. 0 0 1 /end COMPU_METHOD
/begin COMPU_METHOD _CNV_A_R_LINEAR_____271_CM "" RAT_FUNC "%6.3" "g" COEFFS 0 36.00036915004301 0. 0 0 1 /end COMPU_METHOD
/begin COMPU_METHOD _CNV_A_R_LINEAR_____279_CM "" RAT_FUNC "%6.3" "ohm" COEFFS 0 1. 0. 0 0 1 /end COMPU_METHOD
/begin COMPU_METHOD _CNV_A_R_LINEAR_____298_CM "" RAT_FUNC "%6.3" "%" COEFFS 0 327.680000003584 3.584063961170614e-007 0 0 1 /end COMPU_METHOD
/begin COMPU_METHOD _CNV_A_R_LINEAR_____328_CM "" RAT_FUNC "%6.3" "-" COEFFS 0 7379.793318491542 0. 0 0 1 /end COMPU_METHOD
/begin COMPU_METHOD _CNV_A_R_LINEAR_____333_CM "" RAT_FUNC "%6.3" "cm²" COEFFS 0 1118.481084425738 0. 0 0 1 /end COMPU_METHOD
/begin COMPU_METHOD _CNV_A_R_LINEAR_____345_CM "" RAT_FUNC "%6.3" "-" COEFFS 0 8191.999999679995 0. 0 0 1 /end COMPU_METHOD
/begin COMPU_METHOD _CNV_A_R_LINEAR_____350_CM "" RAT_FUNC "%6.3" "mg/stk" COEFFS 0 47.18142548596112 32767.5 0 0 1 /end COMPU_METHOD
/begin COMPU_METHOD _CNV_A_R_LINEAR_____355_CM "" RAT_FUNC "%6.3" "V" COEFFS 0 204.8 0. 0 0 1 /end COMPU_METHOD
/begin COMPU_METHOD _CNV_A_R_LINEAR_____359_CM "" RAT_FUNC "%6.3" "°TPS" COEFFS 0 137.0962343096234 16383. 0 0 1 /end COMPU_METHOD
/begin COMPU_METHOD _CNV_A_R_LINEAR_____360_CM "" RAT_FUNC "%6.3" "%" COEFFS 0 81.91999999679995 32767.99999871998 0 0 1 /end COMPU_METHOD
/begin COMPU_METHOD _CNV_A_R_LINEAR_____361_CM "" RAT_FUNC "%6.3" "%" COEFFS 0 327.680000003584 32768.00000035841 0 0 1 /end COMPU_METHOD
/begin COMPU_METHOD _CNV_A_R_LINEAR_____362_CM "" RAT_FUNC "%6.3" "%" COEFFS 0 327.68 0. 0 0 1 /end COMPU_METHOD
/begin COMPU_METHOD _CNV_A_R_LINEAR_____363_CM "" RAT_FUNC "%6.3" "%" COEFFS 0 81.91999999679995 -1.280022843275219e-006 0 0 1 /end COMPU_METHOD
/begin COMPU_METHOD _CNV_A_R_LINEAR_____364_CM "" RAT_FUNC "%6.3" "ms" COEFFS 0 0.2 0. 0 0 1 /end COMPU_METHOD
/begin COMPU_METHOD _CNV_A_R_LINEAR_____365_CM "" RAT_FUNC "%6.3" "°TPS" COEFFS 0 137.0962343096234 1.818989403545857e-012 0 0 1 /end COMPU_METHOD
/begin COMPU_METHOD _CNV_A_R_LINEAR_____366_CM "" RAT_FUNC "%6.3" "s" COEFFS 0 200. 0. 0 0 1 /end COMPU_METHOD
/begin COMPU_METHOD _CNV_A_R_LINEAR_____367_CM "" RAT_FUNC "%6.3" "%" COEFFS 0 327.67 0. 0 0 1 /end COMPU_METHOD
/begin COMPU_METHOD _CNV_A_R_LINEAR_____390_CM "" RAT_FUNC "%6.3" "V" COEFFS 0 204.7999995887937 0. 0 0 1 /end COMPU_METHOD
/begin COMPU_METHOD _CNV_A_R_LINEAR_____432_CM "" RAT_FUNC "%6.3" "%/10ms" COEFFS 0 655.3600000071681 0. 0 0 1 /end COMPU_METHOD
/begin COMPU_METHOD _CNV_A_R_LINEAR_____433_CM "" RAT_FUNC "%6.3" "mg/stk" COEFFS 0 23.59107271489608 9.906580089591444e-007 0 0 1 /end COMPU_METHOD
/begin COMPU_METHOD _CNV_A_R_LINEAR_____434_CM "" RAT_FUNC "%6.3" "mg/stk" COEFFS 0 23.59107271489608 32768.00000099066 0 0 1 /end COMPU_METHOD
/begin COMPU_METHOD _CNV_A_R_LINEAR_____435_CM "" RAT_FUNC "%6.3" "mg" COEFFS 0 4. 32768. 0 0 1 /end COMPU_METHOD
/begin COMPU_METHOD _CNV_A_R_LINEAR_____436_CM "" RAT_FUNC "%6.3" "mg" COEFFS 0 4. 0. 0 0 1 /end COMPU_METHOD
/begin COMPU_METHOD _CNV_A_R_LINEAR_____448_CM "" RAT_FUNC "%6.3" "°TPS/5ms" COEFFS 0 137.0962586026216 -6.746863121520619e-007 0 0 1 /end COMPU_METHOD
/begin COMPU_METHOD _CNV_A_R_LINEAR_____449_CM "" RAT_FUNC "%6.3" "°TPS" COEFFS 0 137.0962586026216 -6.746863121520619e-007 0 0 1 /end COMPU_METHOD
/begin COMPU_METHOD _CNV_A_R_LINEAR_____450_CM "" RAT_FUNC "%6.3" "V" COEFFS 0 102.3999997943969 0. 0 0 1 /end COMPU_METHOD
/begin COMPU_METHOD _CNV_S_11_RANGE_TPS__451_CM "" TAB_VERB "%6.3" "[-]" COMPU_TAB_REF _CNV_S_11_RANGE_TPS__451 /end COMPU_METHOD
/begin COMPU_VTAB _CNV_S_11_RANGE_TPS__451 "" TAB_VERB 11 0 "ST_CHK_CHK_LIH_1" 1 "ST_CHK_GO_UPPER_POS" 2 "ST_CHK_CHK_LIH_2" 3 "ST_CHK_END" 4 "AD_CHK_LIH_1" 5 "AD_GO_UPPER_POS" 6 "AD_CHK_LIH_2" 7 "AD_GO_LOWER_STOP" 8 "AD_GO_LIH" 9 "AD_CHK_LIH_3" 10 "AD_END" /end COMPU_VTAB
/begin COMPU_METHOD _CNV_S_5_RANGE_STAT_452_CM "" TAB_VERB "%6.3" "-" COMPU_TAB_REF _CNV_S_5_RANGE_STAT_452 /end COMPU_METHOD
/begin COMPU_VTAB _CNV_S_5_RANGE_STAT_452 "" TAB_VERB 5 0 "TPS_NO_ERROR" 1 "TPS_LIH_1" 2 "TPS_LIH_2" 4 "TPS_LIH_MAX" 8 "TPS_DBL_ERROR" /end COMPU_VTAB
/begin COMPU_METHOD _CNV_S_5_RANGE_STAT_453_CM "" TAB_VERB "%6.3" "-" COMPU_TAB_REF _CNV_S_5_RANGE_STAT_453 /end COMPU_METHOD
/begin COMPU_VTAB _CNV_S_5_RANGE_STAT_453 "" TAB_VERB 5 0 "ETC_NO_LIH" 1 "ETC_LIH_1" 2 "ETC_LIH_2_REV" 4 "ETC_LIH_2" 8 "ETC_LIH_3" /end COMPU_VTAB
/begin COMPU_METHOD _CNV_A_R_LINEAR_____454_CM "" RAT_FUNC "%6.3" "°TPS/10ms" COEFFS 0 137.0962343096234 0. 0 0 1 /end COMPU_METHOD
/begin COMPU_METHOD _CNV_A_R_LINEAR_____455_CM "" RAT_FUNC "%6.3" "°TPS" COEFFS 0 137.0962341416889 2.006817052091492e-005 0 0 1 /end COMPU_METHOD
/begin COMPU_METHOD _CNV_R_R_dez_498_CM "" RAT_FUNC "%6.3" "[-]" COEFFS 0. 1. 0. 0. 0. 1. /end COMPU_METHOD
/begin COMPU_METHOD _CNV_R_R_t10msxs_ub_507_CM "" RAT_FUNC "%6.3" "s" COEFFS 0. 1. 0. 0. 0. 1.e-002 /end COMPU_METHOD
/begin COMPU_METHOD _CNV_R_R_spg_ubatt_508_CM "" RAT_FUNC "%6.3" "V" COEFFS 0. 1. 0. 0. 0. 9.420000000000001e-002 /end COMPU_METHOD
/begin RECORD_LAYOUT _REC_VAL_20_u1 FNC_VALUES 1 UBYTE COLUMN_DIR DIRECT /end RECORD_LAYOUT
/begin RECORD_LAYOUT _REC_VAL_20_u2 FNC_VALUES 1 UWORD COLUMN_DIR DIRECT /end RECORD_LAYOUT
/begin RECORD_LAYOUT _REC_CUR_20_u2_u1 FNC_VALUES 1 UWORD COLUMN_DIR DIRECT /end RECORD_LAYOUT
/begin RECORD_LAYOUT _REC_AXS_20_u1 NO_AXIS_PTS_X 1 UBYTE AXIS_PTS_X 2 UBYTE INDEX_INCR DIRECT /end RECORD_LAYOUT
/begin RECORD_LAYOUT _REC_MAP_20_u1_u1_u1 FNC_VALUES 1 UBYTE COLUMN_DIR DIRECT /end RECORD_LAYOUT
/begin RECORD_LAYOUT _REC_CUR_20_u1_u1 FNC_VALUES 1 UBYTE COLUMN_DIR DIRECT /end RECORD_LAYOUT
/begin RECORD_LAYOUT _REC_AXS_20_u2 NO_AXIS_PTS_X 1 UWORD AXIS_PTS_X 2 UWORD INDEX_INCR DIRECT /end RECORD_LAYOUT
/begin RECORD_LAYOUT _REC_MAP_20_u1_u1_u2 FNC_VALUES 1 UBYTE COLUMN_DIR DIRECT /end RECORD_LAYOUT
/begin RECORD_LAYOUT _REC_MAP_20_u2_u2_u1 FNC_VALUES 1 UWORD COLUMN_DIR DIRECT /end RECORD_LAYOUT
/begin RECORD_LAYOUT _REC_CUR_20_u1_u2 FNC_VALUES 1 UBYTE COLUMN_DIR DIRECT /end RECORD_LAYOUT
/begin RECORD_LAYOUT _REC_CUR_20_u2_u2 FNC_VALUES 1 UWORD COLUMN_DIR DIRECT /end RECORD_LAYOUT
/begin RECORD_LAYOUT _REC_VAL_20_s1 FNC_VALUES 1 SBYTE COLUMN_DIR DIRECT /end RECORD_LAYOUT
/begin RECORD_LAYOUT _REC_VAL_20_s2 FNC_VALUES 1 SWORD COLUMN_DIR DIRECT /end RECORD_LAYOUT
/begin RECORD_LAYOUT _REC_MAP_20_u2_u1_u2 FNC_VALUES 1 UWORD COLUMN_DIR DIRECT /end RECORD_LAYOUT
/begin RECORD_LAYOUT _REC_MAP_20_u2_u2_u2 FNC_VALUES 1 UWORD COLUMN_DIR DIRECT /end RECORD_LAYOUT
/begin FUNCTION DIA_Upstream_oxygen_sensor_signa "_Upstream oxygen sensor signal monitoring"
 /begin DEF_CHARACTERISTIC c_r_up_ls_max_vls_up_min c_t_dly_lam_lim_vls_up_min c_vls_up_max_diag c_vls_up_afl_diag c_vls_up_afr_diag c_t_vls_cyc_max_stk c_vls_up_min_diag c_r_up_ls_min_vls_up_oc c_vls_dif_bol_tol_min c_lam_p_ctr_diag c_maf_kgh_min_vls_up_min c_maf_int_min_vls_up_diag c_maf_int_max_vls_up_diag c_vls_up_min_puc c_t_es_dew_vls_up_min_cold c_teg_cat_up_mdl_vls_up_min c_vls_down_max_vls_up_min_diag c_t_diag_vls_up_min_cold c_t_dly_vls_up_min_cold c_t_err_cdn_vls_up_min c_t_err_cdn_vls_up_oc c_t_dly_vls_up_min c_t_dly_vls_up_oc c_ti_lam_cor_vls_up_oc_min c_ti_lam_cor_vls_up_oc_max /end DEF_CHARACTERISTIC
 /begin OUT_MEASUREMENT lam_bank_1.ls_up_diag.lam_p_ctr_sum lam_bank_1.ls_up_diag.t_dly_vls_up_min_cold lam_bank_1.ls_up_diag.t_diag_vls_up_min_cold lam_bank_1.ls_up_diag.t_dly_vls_up_min lam_bank_1.ls_up_diag.t_dly_lam_min_vls_up_min lam_bank_1.ls_up_diag.maf_int_cps_close_vls_up_min lam_bank_1.ls_up_diag.bf.lv_ti_lam_max_vls_up_min lam_bank_1.ls_up_diag.bf.lv_req_diag_vls_up_min lam_bank_1.ls_up_diag.t_err_cdn_vls_up_min lam_bank_1.ls_up_diag.t_dly_vls_up_oc lam_bank_1.ls_up_diag.t_err_cdn_vls_up_oc lam_bank_1.ls_up_diag.t_end_diag_vls_up_min lam_bank_1.ls_up_diag.t_end_diag_vls_up_oc lam_bank_2.ls_up_diag.lam_p_ctr_sum lam_bank_2.ls_up_diag.t_dly_vls_up_min_cold lam_bank_2.ls_up_diag.t_diag_vls_up_min_cold lam_bank_2.ls_up_diag.t_dly_vls_up_min lam_bank_2.ls_up_diag.t_dly_lam_min_vls_up_min lam_bank_2.ls_up_diag.maf_int_cps_close_vls_up_min lam_bank_2.ls_up_diag.bf.lv_ti_lam_max_vls_up_min lam_bank_2.ls_up_diag.bf.lv_req_diag_vls_up_min lam_bank_2.ls_up_diag.t_err_cdn_vls_up_min lam_bank_2.ls_up_diag.t_dly_vls_up_oc lam_bank_2.ls_up_diag.t_err_cdn_vls_up_oc lam_bank_2.ls_up_diag.t_end_diag_vls_up_min lam_bank_2.ls_up_diag.t_end_diag_vls_up_oc lv_err_vls_up_2 lv_err_vls_up_1 lv_err_vls_up_min_2 lv_err_vls_up_max_1 lv_err_vls_up_max_2 lv_err_vls_up_oc_1 lv_err_vls_up_oc_2 lv_err_vls_up_min_1 lv_err_vls_up_min_cold_1 lv_err_vls_up_min_cold_2 lv_err_vls_up_puc_1 lv_err_vls_up_puc_2 lv_err_vls_up_stk_1 lv_err_vls_up_stk_2 t_min_ls /end OUT_MEASUREMENT
/end FUNCTION
/begin FUNCTION DIA_Application_incidences_for_u "_Application incidences for upstream oxygen sensor signal monitoring"
 /begin OUT_MEASUREMENT lam_bank_1.ls_up_diag_inci.bf.lv_inh_diag_vls_up_min lam_bank_1.ls_up_diag_inci.bf.lv_inh_diag_vls_up_max lam_bank_1.ls_up_diag_inci.bf.lv_inh_diag_vls_up_oc lam_bank_1.ls_up_diag_inci.bf.lv_inh_diag_vls_up_puc lam_bank_1.ls_up_diag_inci.bf.lv_inh_diag_vls_up_stk lam_bank_1.ls_up_diag_inci.bf.lv_inh_diag_vls_up_min_cold lam_bank_2.ls_up_diag_inci.bf.lv_inh_diag_vls_up_min lam_bank_2.ls_up_diag_inci.bf.lv_inh_diag_vls_up_max lam_bank_2.ls_up_diag_inci.bf.lv_inh_diag_vls_up_oc lam_bank_2.ls_up_diag_inci.bf.lv_inh_diag_vls_up_puc lam_bank_2.ls_up_diag_inci.bf.lv_inh_diag_vls_up_stk lam_bank_2.ls_up_diag_inci.bf.lv_inh_diag_vls_up_min_cold /end OUT_MEASUREMENT
/end FUNCTION
/begin FUNCTION DIA_Application_incidences_for_d "_Application incidences for downstream oxygen sensor probe diagnosis"
 /begin OUT_MEASUREMENT lam_bank_1.ls_down_diag_inci.bf.lv_inh_diag_vls_down_min lam_bank_1.ls_down_diag_inci.bf.lv_inh_diag_vls_down_max lam_bank_1.ls_down_diag_inci.bf.lv_inh_diag_vls_down_oc lam_bank_1.ls_down_diag_inci.bf.lv_inh_diag_vls_down_min_cold lam_bank_2.ls_down_diag_inci.bf.lv_inh_diag_vls_down_min lam_bank_2.ls_down_diag_inci.bf.lv_inh_diag_vls_down_max lam_bank_2.ls_down_diag_inci.bf.lv_inh_diag_vls_down_oc lam_bank_2.ls_down_diag_inci.bf.lv_inh_diag_vls_down_min_cold /end OUT_MEASUREMENT
/end FUNCTION
/begin FUNCTION DIA_Downstream_oxygen_sensor_sig "_Downstream oxygen sensor signal monitoring"
 /begin DEF_CHARACTERISTIC c_r_down_ls_max_vls_down_min c_maf_kgh_min_vls_down_min c_vls_down_min_diag c_vls_down_max_diag c_vls_down_afl_diag c_vls_down_afr_diag c_r_down_min_vls_down_oc c_t_dly_vls_down_min c_t_es_dew_vls_down_min_cold c_t_diag_vls_down_min_cold c_t_dly_vls_down_min_cold c_t_dly_vls_down_oc c_teg_cat_down_mdl_vls_down_oc c_t_err_cdn_vls_down_min c_t_err_cdn_vls_down_oc /end DEF_CHARACTERISTIC
 /begin OUT_MEASUREMENT lam_bank_1.ls_down_diag.t_dly_vls_down_min_cold lam_bank_1.ls_down_diag.t_diag_vls_down_min_cold lam_bank_1.ls_down_diag.t_dly_vls_down_min lam_bank_1.ls_down_diag.t_dly_vls_down_oc lam_bank_1.ls_down_diag.bf.lv_req_chk_ls_down lam_bank_1.ls_down_diag.t_err_cdn_vls_down_min lam_bank_1.ls_down_diag.t_err_cdn_vls_down_oc lam_bank_1.ls_down_diag.t_end_diag_vls_down_min lam_bank_1.ls_down_diag.t_end_diag_vls_down_oc lam_bank_2.ls_down_diag.t_dly_vls_down_min_cold lam_bank_2.ls_down_diag.t_diag_vls_down_min_cold lam_bank_2.ls_down_diag.t_dly_vls_down_min lam_bank_2.ls_down_diag.t_dly_vls_down_oc lam_bank_2.ls_down_diag.bf.lv_req_chk_ls_down lam_bank_2.ls_down_diag.t_err_cdn_vls_down_min lam_bank_2.ls_down_diag.t_err_cdn_vls_down_oc lam_bank_2.ls_down_diag.t_end_diag_vls_down_min lam_bank_2.ls_down_diag.t_end_diag_vls_down_oc lv_err_vls_down_1 lv_err_vls_down_2 lv_err_vls_down_min_2 lv_err_vls_down_max_2 lv_err_vls_down_max_1 lv_err_vls_down_oc_1 lv_err_vls_down_oc_2 lv_err_vls_down_min_1 lv_err_vls_down_min_cold_1 lv_err_vls_down_min_cold_2 /end OUT_MEASUREMENT
/end FUNCTION
/begin FUNCTION DIA_Tank_leakage_pump_diagnosis "_Tank leakage pump diagnosis" /begin DEF_CHARACTERISTIC c_v_dmtl_max_diag c_t_v_dmtl_max_diag /end DEF_CHARACTERISTIC
 /begin OUT_MEASUREMENT cdn_diag_dmtlh lv_err_dmtlh lv_inh_diag_dmtlh ctr_det_dmtlh ctr_ready_dmtlh cdn_diag_dmtl_pump lv_err_dmtl_pump lv_inh_diag_dmtl_pump ctr_det_dmtl_pump ctr_ready_dmtl_pump t_v_dmtl_max_diag cdn_diag_dmtls lv_inh_diag_dmtls lv_err_dmtls ctr_det_dmtls ctr_ready_dmtls iso_m6_diag_ram_com.m6_cur_dmtl_cor_fil_cid18 iso_m6_diag_ram_com.m6_cur_dmtl_cor_fil_cid19 iso_m6_diag_ram_com.m6_cur_dmtl_dmtls_test iso_m6_diag_ram_com.m6_cur_dmtl_thd_dmtls_test iso_m6_diag_ram_com.m6_cur_dmtl_rough_leak_end iso_m6_diag_ram_com.m6_cur_dmtl_thd_rough_leak iso_m6_diag_ram_com.m6_cur_dmtl_small_leak_end iso_m6_diag_ram_com.m6_cur_dmtl_ref_leak iso_m6_diag_ram_com.m6_cur_dmtl_rough_leak_len_end iso_m6_diag_ram_com.m6_cur_dmtl_thd_rough_leak_len iso_m6_diag_ram_com.m6_ctr_cnl_small_leak_mes /end OUT_MEASUREMENT
/end FUNCTION
/begin FUNCTION DIA_SOF_diagnosis "_SOF diagnosis" /begin DEF_CHARACTERISTIC lc_sof_conf c_v_sof_swi_min c_v_sof_swi_max /end DEF_CHARACTERISTIC /begin OUT_MEASUREMENT lv_err_sof_req lv_err_sof /end OUT_MEASUREMENT /end FUNCTION
/begin FUNCTION DIA_Oil_pressure_switch_diagnosi "_Oil pressure switch diagnosis"
 /begin DEF_CHARACTERISTIC c_t_poil_swi_pwl c_toil_poil_swi_max_diag c_toil_poil_swi_min_diag /end DEF_CHARACTERISTIC
 /begin OUT_MEASUREMENT t_poil_swi_pwl lv_err_poil_swi /end OUT_MEASUREMENT
/end FUNCTION
/begin FUNCTION DIA_Starter_Output_Diagnosis "_Starter Output Diagnosis"
 /begin OUT_MEASUREMENT cdn_diag_ebox_cfa ctr_det_ebox_cfa ctr_ready_ebox_cfa lv_err_rly_st cdn_diag_rly_st ctr_det_rly_st lv_inh_diag_rly_st ctr_ready_rly_st /end OUT_MEASUREMENT
/end FUNCTION
/begin FUNCTION DIA_BSD_Diagnosis "_BSD Diagnosis" /begin OUT_MEASUREMENT lv_err_bsd /end OUT_MEASUREMENT /end FUNCTION
/begin FUNCTION DIA_Diagnosis_Oil_temperature_an "_Diagnosis Oil temperature and level sensor  (DTOENS)" /begin DEF_CHARACTERISTIC TOGMAXUNPL TOG_CNTMAX DTOG_UBMIN /end DEF_CHARACTERISTIC
 /begin OUT_MEASUREMENT lv_err_toil_level lv_err_bat_sens lv_err_bat_sens_it lv_err_bat_sens_it_el /end OUT_MEASUREMENT
/end FUNCTION
/begin FUNCTION DIA_CAN_diagnosis_for_EFP_contro "_CAN diagnosis for EFP control" /begin DEF_CHARACTERISTIC c_efp_cycnr_max /end DEF_CHARACTERISTIC
 /begin OUT_MEASUREMENT cyc_ctr_efp_diag lv_err_efp lv_err_efp_crash lv_err_tout_efp /end OUT_MEASUREMENT
/end FUNCTION
/begin FUNCTION DIA_TPS___ETC_Limp_Home_Manager "_TPS / ETC Limp-Home Manager"
 /begin OUT_MEASUREMENT lv_tps_mtc_n_lim lv_mtc_lih_cur_off lv_err_tps lv_n_lim_etc_lih lv_n_lim_etc_lih_rev state_tps_diag state_etc_lih lv_mtc_cur_off_req /end OUT_MEASUREMENT
/end FUNCTION
/begin FUNCTION DIA_ETC_Actuator_diagnosis_and_A "_ETC Actuator diagnosis and Adaptation"
 /begin DEF_CHARACTERISTIC c_mtcpwm_pi_max_diag c_tps_dif_max_diag c_t_tps_dif_diag c_t_mtcpwm_pi_diag_cur_off c_t_mtcpwm_pi_diag c_n_max_tps_ad c_t_max_tps_ad c_t_max_tps_lih_chk c_t_max_tps_sp_rst_chk c_t_tps_ad_hys c_tco_max_tps_ad c_tco_min_tps_ad c_tia_min_tps_ad c_tps_sp_bol_lgrd c_tps_sp_rst_chk_bas c_tps_sp_rst_chk_hys c_tps_sp_rst_chk_lgrd c_v_tps_ad_hys c_v_tps_ad_win_lih c_v_tps_sp_bol_1 c_v_tps_sp_bol_2 c_vb_min_tps_ad c_tps_sp_spr_chk_up c_tps_sp_rst_chk c_tps_av_rst_chk c_t_tps_av_rst_chk c_v_tps_ad_win_bol c_v_tps_ad_win_2_bol c_t_dyw_tps_lih_chk c_v_tps_ad_bol_ini_1 c_v_tps_ad_bol_ini_2 c_v_tps_lih_chk_hys c_v_tps_sp_lih_1 c_v_tps_sp_lih_2 c_tps_ad_slop_gain_ini_1 c_v_tps_ad_ofs_gain_ini_1 /end DEF_CHARACTERISTIC
 /begin OUT_MEASUREMENT v_tps_gain_1 lv_n_lim_tps_ad lv_tps_ad_cur_off lv_tps_ad_diag_cur_off tps_sp_ad v_tps_ad_el_bol_1 v_tps_ad_el_bol_2 v_tps_ad_lih_1 v_tps_ad_lih_2 lv_tps_ad_act tps_ad_slop_gain_1 tps_lih_1 tps_lih_2 lv_tps_ad_req tps_lih_ini v_tps_ad_bol_gain_1 v_tps_ad_tol_1 v_tps_ad_tol_gain_1 inh_iv_tps_ad v_tps_ad_ofs_gain_1 lv_tps_ad_mec_bol tps_ad_step ctr_st_chk_chk_lih_1_ready ctr_st_chk_chk_lih_1_err lv_err_tps_st_chk_2 lv_err_tps_ad lv_err_tps_ad_bol lv_err_tps_st_chk_1 lv_err_mtc_ctl_2 lv_err_mtc_ctl_3 lv_err_mtc_ctl_1 /end OUT_MEASUREMENT
/end FUNCTION
/begin FUNCTION DIA_Electric_solenoid_valve_diag "_Electric solenoid valve diagnosis"
 /begin DEF_CHARACTERISTIC c_slv_ivvt_pwm_diag_min_oc c_slv_ivvt_pwm_diag_min_scb c_slv_ivvt_pwm_diag_max_scg /end DEF_CHARACTERISTIC
 /begin OUT_MEASUREMENT lv_err_slv_ivvt_in_1 lv_err_slv_ivvt_ex_1 lv_inh_diag_slv_ivvt_in_1 cdn_diag_slv_ivvt_ex_1 ctr_det_slv_ivvt_ex_1 ctr_ready_slv_ivvt_in_1 lv_inh_diag_slv_ivvt_ex_1 cdn_diag_slv_ivvt_in_1 ctr_det_slv_ivvt_in_1 ctr_ready_slv_ivvt_ex_1 /end OUT_MEASUREMENT
/end FUNCTION
/begin FUNCTION DIA_Distance_cruise_control_diag "_Distance cruise control diagnosis" /begin DEF_CHARACTERISTIC c_t_max_brake_det_dcc /end DEF_CHARACTERISTIC /begin OUT_MEASUREMENT lv_dcc_off_ecu t_dcc_brake_det lv_err_dcc /end OUT_MEASUREMENT /end FUNCTION
/begin FUNCTION DIA_GS_intervention_plausibility "_GS intervention plausibility Diagnosis"
 /begin DEF_CHARACTERISTIC c_int_tq_gs_inc_rest c_vs_min_tq_gs_inc c_t_dly_min_vs_tq_gs_inc c_crlc_tq_gs_inc_plaus c_int_max_tq_gs_inc c_int_min_tq_gs_inc c_t_dly_min_ac_tq_gs_inc c_t_dif_min_tq_gs_inc ip_ac_max_tq_gs_inc ip_tq_max_tq_gs_inc c_t_max_tq_gs_inc c_t_dly_tq_max_tq_gs_inc /end DEF_CHARACTERISTIC
 /begin OUT_MEASUREMENT int_tq_gs_inc lv_ac_max_tq_gs_inc lv_t_min_tq_gs_inc_deac ctr_t_dif_min_tq_gs_inc state_gs_plaus lv_vs_min_tq_gs_inc ctr_t_vs_tq_gs_inc lv_int_max_tq_gs_inc ctr_t_ac_tq_gs_inc lv_t_max_tq_gs_inc ctr_t_max_tq_gs_inc lv_tq_max_tq_gs_inc ctr_t_tq_max_tq_gs_inc lv_err_tq_gs_inc_plaus /end OUT_MEASUREMENT
/end FUNCTION
/begin FUNCTION DIA_AMT_intervention_plausibilit "_AMT intervention plausibility"
 /begin DEF_CHARACTERISTIC c_vs_fil_amt c_t_max_state_amt_1_diag c_t_max_state_amt_2_diag c_t_max_tqi_amt_diag c_tqi_amt_diag c_tqi_amt_cond_diag c_tqi_amt_can_es c_t_max_state_amt_3_diag c_t_max_state_clu_amt_diag /end DEF_CHARACTERISTIC
 /begin OUT_MEASUREMENT state_err_amt_can lv_amt_es_req t_state_amt_1_diag t_state_amt_2_diag t_state_amt_3_diag state_err_amt state_amt_old t_state_clu_amt_diag tqi_amt_plaus /end OUT_MEASUREMENT
/end FUNCTION
/begin FUNCTION DIA_Electronically_controlled_ra "_Electronically controlled radiator shutter diagnosis"
 /begin OUT_MEASUREMENT lv_err_ecras lv_inh_diag_ecras cdn_diag_ecras ctr_det_ecras ctr_ready_ecras /end OUT_MEASUREMENT
/end FUNCTION
/begin FUNCTION DIA_DMTL_heater_diagnosis "_DMTL heater diagnosis" /end FUNCTION
/begin FUNCTION DIA_Application_incidences_NOx_S "_Application incidences NOx-Sensor Diagnosis - OBD I" /end FUNCTION
/begin FUNCTION DIA_NOx_Sensor_Diagnosis___OBD_I "_NOx-Sensor Diagnosis - OBD I" /end FUNCTION
/begin FUNCTION DIA_CAN_diagnosis_for_NOX_contro "_CAN diagnosis for NOX control" /begin OUT_MEASUREMENT lv_err_locan_boff /end OUT_MEASUREMENT /end FUNCTION
/begin FUNCTION DIA_ECU_selftest "_ECU-selftest" /begin OUT_MEASUREMENT lv_err_ecu_ram lv_err_ecu_cks lv_err_ecu_nvmy /end OUT_MEASUREMENT /end FUNCTION
/begin FUNCTION DIA_Clutch_switch_diagnosis "_Clutch switch diagnosis"
 /begin DEF_CHARACTERISTIC c_maf_cs_diag c_n_32_cs_diag c_vs_cs_diag c_t_min_maf_cs_diag /end DEF_CHARACTERISTIC
 /begin OUT_MEASUREMENT lv_err_cs lv_cs_diag lv_cs_swi t_min_maf_cs_diag /end OUT_MEASUREMENT
/end FUNCTION
/begin FUNCTION DIA_SPI_Bus_diagnosis "_SPI-Bus diagnosis" /begin OUT_MEASUREMENT lv_err_spi_mps lv_err_spi_knk /end OUT_MEASUREMENT /end FUNCTION
/begin FUNCTION DIA_PVS_diagnosis_application_in "_PVS diagnosis application incidences" /begin DEF_CHARACTERISTIC c_thd_brake_prs c_t_dly_brake_prs /end DEF_CHARACTERISTIC /begin OUT_MEASUREMENT lv_brake_prs_pvs_diag t_dly_brake_prs /end OUT_MEASUREMENT /end FUNCTION
/begin FUNCTION DIA_Automatic_gear_shift_signal_ "_Automatic gear shift signal diagnosis" /begin DEF_CHARACTERISTIC lc_var_gs_eobd /end DEF_CHARACTERISTIC /begin OUT_MEASUREMENT state_diag_gs lv_err_gs /end OUT_MEASUREMENT /end FUNCTION
/begin FUNCTION EOS_Engine_Operating_States "EOS"
 /begin SUB_FUNCTION EOS_General_engine_operating_sta EOS_Basic_operating_states__LV_S EOS_Basic_functions__FL__INF___R EOS_Auxiliary_start_functions EOS_Combustion_Management EOS_Catalyst_heating_functions EOS_Combustion_Mode_Switch EOS_Combustion_switch_request_to EOS_Runtime_Optimization_by_Recu /end SUB_FUNCTION
/end FUNCTION
/begin FUNCTION EOS_General_engine_operating_sta "_General engine operating states" /begin DEF_CHARACTERISTIC c_t_max_ecu ip_n_max_tol_st /end DEF_CHARACTERISTIC /begin OUT_MEASUREMENT lv_mu_inh_pwl_tran_es_el /end OUT_MEASUREMENT /end FUNCTION
/begin FUNCTION EOS_Basic_operating_states__LV_S "_Basic operating states: LV_ST, LV_IS, LV_REQ_ISC, LV_PL, LV_PU & LV_PUC"
 /begin DEF_CHARACTERISTIC ip_cyc_cast__tco c_n_max_bol_st c_t_min_pu c_t_max_pu lc_inh_dt_pu c_t_min_pu_msr c_t_min_pu_rng_l id_n_hys_max_puc__gr_at id_n_hys_max_puc__gr_mt id_n_hys_min_puc__gr_at id_n_hys_min_puc__gr_mt id_n_hys_puc_st__gr_at id_n_hys_puc_st__gr_mt c_cycnr_hys_puc c_cycnr_hys_puc_st c_tco_min_puc_st ip_n_min_puc__tco__gr_mt ip_n_accout_min_puc__tco__gr_mt ip_n_accout_min_puc__tco__gr_at c_n_dif_ast c_t_n_dif_ast ip_n_min_puc__tco__gr_at ip_n_min_puc_add_ars c_t_min_pu_vs c_vs_min_pu ip_t_min_pu__n__tco ip_t_min_pu_rng_l__n__tco ip_n_dif_max_is /end DEF_CHARACTERISTIC
 /begin OUT_MEASUREMENT lv_es lv_st lv_st_end lv_is lv_pl lv_pu t_pu lv_puc lv_puc_req state_eng lv_iga_min_puc /end OUT_MEASUREMENT
/end FUNCTION
/begin FUNCTION EOS_Basic_functions__FL__INF___R "_Basic functions: FL, INF & REACX"
 /begin DEF_CHARACTERISTIC c_n_max_fl_dly c_n_min_fl_dly c_t_max_fl_dly c_t_ti_dly_fl_2 c_t_ti_dly_fl_at_1 c_t_ti_dly_fl_at_2 c_tco_min_fl c_vs_min_fl c_n_min_fl c_t_min_fl_dly c_t_ti_dly_fl_1 c_n_min_cp_fl c_cl_mmv_thd_fl ip_pv_max_fl__n c_n_grd_min id_tps_grd_bol_ae__n__tps_av ldp_n_grd_n_max_inf ip_n_max_inf /end DEF_CHARACTERISTIC
 /begin OUT_MEASUREMENT lv_fl_raw lv_ti_ris lv_ti_rpu lv_ti_rpl lv_ti_rae lv_fl lv_inf lv_ti_reac /end OUT_MEASUREMENT
/end FUNCTION
/begin FUNCTION EOS_Auxiliary_start_functions "_Auxiliary start functions"
 /begin DEF_CHARACTERISTIC c_t_max_rest c_tco_dif_max_rest c_t_min_ecu_rest c_cyc_cast_min_st_es c_cyc_cast_max_st_es /end DEF_CHARACTERISTIC
 /begin OUT_MEASUREMENT t_ast lv_rest cyc_cast t_st_es lv_st_es lv_stall t_ast_rest lv_ast tco_rest /end OUT_MEASUREMENT
/end FUNCTION
/begin FUNCTION EOS_Combustion_Management "_Combustion_Management" /begin OUT_MEASUREMENT state_cmb_ctl /end OUT_MEASUREMENT /end FUNCTION
/begin FUNCTION EOS_Catalyst_heating_functions "_Catalyst heating functions"
 /begin DEF_CHARACTERISTIC ip_t_ch_n_sp_is id_t_ch_ti c_vs_max_ch_ivvt ip_t_ch_ivvt c_vs_max_ch_tq_add_is c_vs_max_ch_n_sp_is ip_t_ch_tq_add ip_t_ch_tq_add_wout_cat ip_t_ch_tq_add_is ip_t_ch_tq_add_is_wout_cat /end DEF_CHARACTERISTIC
 /begin OUT_MEASUREMENT lv_ti_ch lv_ch lv_ch_tq_add lv_ch_tq_add_is lv_ch_n_sp_is lv_ch_ivvt lv_wup lv_afl_ch /end OUT_MEASUREMENT
/end FUNCTION
/begin FUNCTION EOS_Combustion_Mode_Switch "_Combustion Mode Switch" /end FUNCTION
/begin FUNCTION EOS_Combustion_switch_request_to "_Combustion switch request to homogeneous stoichiometric for torque plausibility check" /end FUNCTION
/begin FUNCTION EOS_Runtime_Optimization_by_Recu "_Runtime Optimization by Recurrence Switch" /begin DEF_CHARACTERISTIC c_n_seg_2_ena /end DEF_CHARACTERISTIC /begin OUT_MEASUREMENT lv_clc_2seg lv_clc_2seg_ena /end OUT_MEASUREMENT /end FUNCTION
/begin FUNCTION ETC_Electronic_Throttle_Control "ETC"
 /begin SUB_FUNCTION ETC_Calculation_of_the_driver_de ETC_Throttle_position_setpoint_c ETC_Position_controller ETC_MAF_setpoint_for_stratified_ ETC_MAF_coordinaton_homogeneous_ ETC_Throttle_position_setpoint_s ETC_Application_incidences_throt ETC_Throttle_setpoint_calculatio ETC_Idle_speed_actuator_opening_ /end SUB_FUNCTION
/end FUNCTION
/begin FUNCTION ETC_Calculation_of_the_driver_de "_Calculation of the driver demand" /end FUNCTION
/begin FUNCTION ETC_Throttle_position_setpoint_c "_Throttle position setpoint calculation"
 /begin DEF_CHARACTERISTIC ip_amp_dec__maf_kgh_sp ip_tps_sp_mdl_max__n_32__maf_sp lc_ar_red_fil_ena lc_tps_fil_ena ip_crlc_ar_red_sp lc_inh_isapwm_man_as c_cycnr_isa_off c_isapwm_off_high c_isapwm_off_low c_t_isapwm_off c_lgrd_isapwm_off ip_crlc_ar_red_isa_sp ip_isapwm_isa c_isapwm_man_as c_isapwm_ofs_as c_crlc_isapwm_mmv c_isapwm_isa_diag ip_fac_isapwm_vb c_tps_max_diag c_pq_sp_max c_pq_sp_max_hys ip_isapwm_isa_pwl ip_isapwm_ivs_cor_isa ip_tps_sp_mdl_bas ip_fac_maf_dif_sp ip_maf_sp_add_fast_load_im lc_ar_red_isa_fil_ena lc_pq_sp_isa_maf_add c_pq_sp_max_isa c_crlc_maf_dif_sp /end DEF_CHARACTERISTIC
 /begin OUT_MEASUREMENT map_sp pq_sp maf_sp_ratio amp_mdl_ivs prs_up_thr_ivs ar_red_sp_mmv_1 ar_red_sp_mmv tps_sp_mdl_bas tps_sp_mdl tps_sp_mdl_max tps_sp_mdl_bas_cor maf_kgh_sp_isa_clc pq_sp_isa pq_sp_isa_1 maf_kgh_sp_thr maf_kgh_sp_isa_raw psi_sp psi_sp_isa ar_red_isa_sp_mmv ar_red_isa_sp_mmv_1 isapwm_isa_1 isapwm_isa_2 isapwm_mmv fac_isapwm_vb maf_turb_ratio ar_red_isa_sp_1 maf_kgh_sp_isa_min maf_kgh_sp_thr_min ar_red_isa_min ar_red_min maf_kgh_sp_isa maf_kgh_sp_isa_1 ar_red_sp_1 lv_h_load_tps_sp isapwm isapwm_isa isapwm_cor_isa maf_kgh_sp maf_sp_add_fast_load_im fac_maf_dif_sp pq_sp_wout_maf_add map_sp_wout_maf_add maf_dif_sp maf_dif_sp_1 /end OUT_MEASUREMENT
/end FUNCTION
/begin FUNCTION ETC_Position_controller "_Position controller"
 /begin DEF_CHARACTERISTIC c_mtcpwm_i_max_pos ip_mtcpwm_d__tps_dif_grd ip_mtcpwm_i__tps_dif ip_mtcpwm_p__tps_dif ip_mtcpwm_vb_fac__vb c_tps_sp_lih_dif_hys c_mtcpwm_i_max_neg c_mtcpwm_i_add c_mtcpwm_add_fil ip_mtcpwm_i_fac__tps_av_lih_dif ip_mtcpwm_add__tps_sp_lih_dif c_t_mtcpwm_close_act_max c_mtcpwm_close_max c_tps_sp_stop_hys c_tps_sp_stop_max c_mtcpwm_i_ini c_tps_sp_ctl_max c_mtcpwm_close c_mtcpwm_hys /end DEF_CHARACTERISTIC
 /begin OUT_MEASUREMENT tps_dif mtcpwm_add mtcpwm_ctl mtcpwm_d mtcpwm_p mtcpwm_i mtcpwm_i_add tps_sp_lih_dif mtcpwm_vb_fac tps_dif_grd t_mtcpwm_close_act tps_sp_ctl lv_tps_sp_pos lv_tps_chg_pos mtcpwm lv_mtcpwm_close_act tps_av_lih_dif lv_inh_mtc_ctl /end OUT_MEASUREMENT
/end FUNCTION
/begin FUNCTION ETC_MAF_setpoint_for_stratified_ "_MAF setpoint for stratified mode" /begin DEF_CHARACTERISTIC ip_pq_egr_sp ip_fac_maf_max_s ip_eff_maf_s lc_maf_sp_egr /end DEF_CHARACTERISTIC /begin OUT_MEASUREMENT maf_sp_s fac_maf_max_s maf_dif_s /end OUT_MEASUREMENT /end FUNCTION
/begin FUNCTION ETC_MAF_coordinaton_homogeneous_ "_MAF coordinaton homogeneous - stratified" /begin DEF_CHARACTERISTIC lc_isa_ena ip_maf_sp_isa /end DEF_CHARACTERISTIC /begin OUT_MEASUREMENT maf_sp maf_sp_isa lv_isa_ena maf_turb_ratio_max /end OUT_MEASUREMENT /end FUNCTION
/begin FUNCTION ETC_Throttle_position_setpoint_s "_Throttle position setpoint selection"
 /begin DEF_CHARACTERISTIC c_tps_av_bol c_tps_av_tol c_tps_sp_min c_tps_sp_min_tps_ad_req c_tps_sp_max_tps_ad_req c_tps_sp_max c_tps_sp_tol c_tps_sp_tol_tps_ad_req c_tps_sp_bol_tps_ad_req c_tps_sp_bol c_tps_sp_lgrd_tot ip_tps_sp_lgrd_st c_tps_sp_lgrd_stop /end DEF_CHARACTERISTIC
 /begin OUT_MEASUREMENT lv_mtc_cur_off lv_tps_sp_lih tps_sp_sel tps_sp tps_sp_lim tps_sp_lim_2 tps_sp_lim_1 lv_tps_sp_tra_st_mdl tps_sp_tra_st_mdl /end OUT_MEASUREMENT
/end FUNCTION
/end MODULE
/end PROJECT
