ASAP2_VERSION 1 4
/begin PROJECT P_558 "EDC17_CP02"
/begin HEADER "" VERSION "V1C1" PROJECT_NO P_558 /end HEADER
/begin MODULE DIM ""
/begin MOD_COMMON "" BYTE_ORDER MSB_LAST ALIGNMENT_BYTE 1 ALIGNMENT_WORD 2 ALIGNMENT_LONG 4 ALIGNMENT_FLOAT32_IEEE 4 /end MOD_COMMON
/begin CHARACTERISTIC DINH_FId.DFC_IVAdjIVA_4_CA "/" VAL_BLK 0x80076A8A ValA_Wu16 413. DINH_FIdVerb 0.00 413. FORMAT "%2.0" NUMBER 5 /end CHARACTERISTIC
/begin CHARACTERISTIC DINH_FId.DFC_IVAdjIVA_5_CA "/" VAL_BLK 0x80076A94 ValA_Wu16 413. DINH_FIdVerb 0.00 413. FORMAT "%2.0" NUMBER 5 /end CHARACTERISTIC
/begin CHARACTERISTIC DINH_FId.DFC_InjCtlAdjQntEEPCS_CA "/" VAL_BLK 0x80076A9E ValA_Wu16 413. DINH_FIdVerb 0.00 413. FORMAT "%2.0" NUMBER 5 /end CHARACTERISTIC
/begin CHARACTERISTIC DINH_FId.DFC_InjCtlDriftEEPCS_CA "/" VAL_BLK 0x80076AA8 ValA_Wu16 413. DINH_FIdVerb 0.00 413. FORMAT "%2.0" NUMBER 5 /end CHARACTERISTIC
/begin CHARACTERISTIC DINH_FId.DFC_MRlyErlyOpng_CA "/" VAL_BLK 0x80076AB2 ValA_Wu16 413. DINH_FIdVerb 0.00 413. FORMAT "%2.0" NUMBER 5 /end CHARACTERISTIC
/begin CHARACTERISTIC DINH_FId.DFC_MRlyStk_CA "/" VAL_BLK 0x80076ABC ValA_Wu16 413. DINH_FIdVerb 0.00 413. FORMAT "%2.0" NUMBER 5 /end CHARACTERISTIC
/begin CHARACTERISTIC DINH_FId.DFC_SensFrzPPFltUs_CA "/" VAL_BLK 0x80076AC6 ValA_Wu16 413. DINH_FIdVerb 0.00 413. FORMAT "%2.0" NUMBER 5 /end CHARACTERISTIC
/begin CHARACTERISTIC DINH_FId.DFC_T15Sig_CA "/" VAL_BLK 0x80076AD0 ValA_Wu16 413. DINH_FIdVerb 0.00 413. FORMAT "%2.0" NUMBER 5 /end CHARACTERISTIC
/begin CHARACTERISTIC DINH_FId.DFC_AirCtlRmpTOut_CA "/" VAL_BLK 0x80076ADA ValA_Wu16 413. DINH_FIdVerb 0.00 413. FORMAT "%2.0" NUMBER 5 /end CHARACTERISTIC
/begin CHARACTERISTIC DINH_FId.DFC_CEngDsTDynTst_CA "/" VAL_BLK 0x80076AE4 ValA_Wu16 413. DINH_FIdVerb 0.00 413. FORMAT "%2.0" NUMBER 5 /end CHARACTERISTIC
/begin CHARACTERISTIC DINH_FId.DFC_EGRVlvJamVlvClsd_CA "/" VAL_BLK 0x80076AEE ValA_Wu16 413. DINH_FIdVerb 0.00 413. FORMAT "%2.0" NUMBER 5 /end CHARACTERISTIC
/begin CHARACTERISTIC DINH_FId.DFC_EGRVlvJamVlvOpn_CA "/" VAL_BLK 0x80076AF8 ValA_Wu16 413. DINH_FIdVerb 0.00 413. FORMAT "%2.0" NUMBER 5 /end CHARACTERISTIC
/begin CHARACTERISTIC DINH_FId.DFC_EGRVlvLgTDrft_CA "/" VAL_BLK 0x80076B02 ValA_Wu16 413. DINH_FIdVerb 0.00 413. FORMAT "%2.0" NUMBER 6 /end CHARACTERISTIC
/begin CHARACTERISTIC DINH_FId.DFC_EGRVlvOfsLrnJamVlv_CA "/" VAL_BLK 0x80076B0E ValA_Wu16 413. DINH_FIdVerb 0.00 413. FORMAT "%2.0" NUMBER 6 /end CHARACTERISTIC
/begin CHARACTERISTIC DINH_FId.DFC_EGRVlvShTDrft_CA "/" VAL_BLK 0x80076B1A ValA_Wu16 413. DINH_FIdVerb 0.00 413. FORMAT "%2.0" NUMBER 6 /end CHARACTERISTIC
/begin CHARACTERISTIC DINH_FId.DFC_EGTRgnOilDilMax_CA "/" VAL_BLK 0x80076B26 ValA_Wu16 413. DINH_FIdVerb 0.00 413. FORMAT "%2.0" NUMBER 6 /end CHARACTERISTIC
/begin CHARACTERISTIC DINH_FId.DFC_EngICO_CA "/" VAL_BLK 0x80076B32 ValA_Wu16 413. DINH_FIdVerb 0.00 413. FORMAT "%2.0" NUMBER 5 /end CHARACTERISTIC
/begin CHARACTERISTIC DINH_FId.DFC_EpmCaSI1ErrSig_CA "/" VAL_BLK 0x80076B3C ValA_Wu16 413. DINH_FIdVerb 0.00 413. FORMAT "%2.0" NUMBER 7 /end CHARACTERISTIC
/begin CHARACTERISTIC DINH_FId.DFC_EpmCaSI1NoSig_CA "/" VAL_BLK 0x80076B4A ValA_Wu16 413. DINH_FIdVerb 0.00 413. FORMAT "%2.0" NUMBER 7 /end CHARACTERISTIC
/begin CHARACTERISTIC DINH_FId.DFC_EpmCaSI1OfsErr_CA "/" VAL_BLK 0x80076B58 ValA_Wu16 413. DINH_FIdVerb 0.00 413. FORMAT "%2.0" NUMBER 8 /end CHARACTERISTIC
/begin CHARACTERISTIC DINH_FId.DFC_EpmCrSErrSig_CA "/" VAL_BLK 0x80076B68 ValA_Wu16 413. DINH_FIdVerb 0.00 413. FORMAT "%2.0" NUMBER 10 /end CHARACTERISTIC
/begin CHARACTERISTIC DINH_FId.DFC_EpmCrSNoSig_CA "/" VAL_BLK 0x80076B7C ValA_Wu16 413. DINH_FIdVerb 0.00 413. FORMAT "%2.0" NUMBER 10 /end CHARACTERISTIC
/begin CHARACTERISTIC DINH_FId.DFC_MoCADCCmp_CA "/" VAL_BLK 0x80076B90 ValA_Wu16 413. DINH_FIdVerb 0.00 413. FORMAT "%2.0" NUMBER 5 /end CHARACTERISTIC
/begin CHARACTERISTIC DINH_FId.DFC_MoCADCTst_CA "/" VAL_BLK 0x80076B9A ValA_Wu16 413. DINH_FIdVerb 0.00 413. FORMAT "%2.0" NUMBER 5 /end CHARACTERISTIC
/begin CHARACTERISTIC DINH_FId.DFC_MoCADCVltgRatio_CA "/" VAL_BLK 0x80076BA4 ValA_Wu16 413. DINH_FIdVerb 0.00 413. FORMAT "%2.0" NUMBER 5 /end CHARACTERISTIC
/begin CHARACTERISTIC DINH_FId.DFC_MoCSOPLoLi_CA "/" VAL_BLK 0x80076BAE ValA_Wu16 413. DINH_FIdVerb 0.00 413. FORMAT "%2.0" NUMBER 5 /end CHARACTERISTIC
/begin CHARACTERISTIC DINH_FId.DFC_MoCSOPMM_CA "/" VAL_BLK 0x80076BB8 ValA_Wu16 413. DINH_FIdVerb 0.00 413. FORMAT "%2.0" NUMBER 5 /end CHARACTERISTIC
/begin CHARACTERISTIC DINH_FId.DFC_MoCSOPTimeOut_CA "/" VAL_BLK 0x80076BC2 ValA_Wu16 413. DINH_FIdVerb 0.00 413. FORMAT "%2.0" NUMBER 5 /end CHARACTERISTIC
/begin CHARACTERISTIC DINH_FId.DFC_MoCSOPUpLi_CA "/" VAL_BLK 0x80076BCC ValA_Wu16 413. DINH_FIdVerb 0.00 413. FORMAT "%2.0" NUMBER 5 /end CHARACTERISTIC
/begin CHARACTERISTIC DINH_FId.DFC_MoFAPP_CA "/" VAL_BLK 0x80076BD6 ValA_Wu16 413. DINH_FIdVerb 0.00 413. FORMAT "%2.0" NUMBER 5 /end CHARACTERISTIC
/begin CHARACTERISTIC DINH_FId.DFC_MoFESpd_CA "/" VAL_BLK 0x80076BE0 ValA_Wu16 413. DINH_FIdVerb 0.00 413. FORMAT "%2.0" NUMBER 5 /end CHARACTERISTIC
/begin CHARACTERISTIC DINH_FId.DFC_MoFInjDatPhi_CA "/" VAL_BLK 0x80076BEA ValA_Wu16 413. DINH_FIdVerb 0.00 413. FORMAT "%2.0" NUMBER 5 /end CHARACTERISTIC
/begin CHARACTERISTIC DINH_FId.DFC_MoFInjDatQnt_CA "/" VAL_BLK 0x80076BF4 ValA_Wu16 413. DINH_FIdVerb 0.00 413. FORMAT "%2.0" NUMBER 5 /end CHARACTERISTIC
/begin CHARACTERISTIC DINH_FId.DFC_MoFInjQnt_CA "/" VAL_BLK 0x80076BFE ValA_Wu16 413. DINH_FIdVerb 0.00 413. FORMAT "%2.0" NUMBER 5 /end CHARACTERISTIC
/begin CHARACTERISTIC DINH_FId.DFC_MoFOvR_CA "/" VAL_BLK 0x80076C08 ValA_Wu16 413. DINH_FIdVerb 0.00 413. FORMAT "%2.0" NUMBER 5 /end CHARACTERISTIC
/begin CHARACTERISTIC DINH_FId.DFC_MoFQntCor_CA "/" VAL_BLK 0x80076C12 ValA_Wu16 413. DINH_FIdVerb 0.00 413. FORMAT "%2.0" NUMBER 5 /end CHARACTERISTIC
/begin CHARACTERISTIC DINH_FId.DFC_MoFTrqCmp_CA "/" VAL_BLK 0x80076C1C ValA_Wu16 413. DINH_FIdVerb 0.00 413. FORMAT "%2.0" NUMBER 5 /end CHARACTERISTIC
/begin CHARACTERISTIC DINH_FId.DFC_NplTOxiCatUs_CA "/" VAL_BLK 0x80076C26 ValA_Wu16 413. DINH_FIdVerb 0.00 413. FORMAT "%2.0" NUMBER 8 /end CHARACTERISTIC
/begin CHARACTERISTIC DINH_FId.DFC_PhyModNonMonMapNpl_CA "/" VAL_BLK 0x80076C36 ValA_Wu16 413. DINH_FIdVerb 0.00 413. FORMAT "%2.0" NUMBER 5 /end CHARACTERISTIC
/begin CHARACTERISTIC DINH_FId.DFC_RailPOfsTstMax_CA "/" VAL_BLK 0x80076C40 ValA_Wu16 413. DINH_FIdVerb 0.00 413. FORMAT "%2.0" NUMBER 14 /end CHARACTERISTIC
/begin CHARACTERISTIC DINH_FId.DFC_RailPOfsTstMin_CA "/" VAL_BLK 0x80076C5C ValA_Wu16 413. DINH_FIdVerb 0.00 413. FORMAT "%2.0" NUMBER 14 /end CHARACTERISTIC
/begin CHARACTERISTIC DINH_FId.DFC_SWReset_0_CA "/" VAL_BLK 0x80076C78 ValA_Wu16 413. DINH_FIdVerb 0.00 413. FORMAT "%2.0" NUMBER 5 /end CHARACTERISTIC
/begin CHARACTERISTIC DINH_FId.DFC_SWReset_1_CA "/" VAL_BLK 0x80076C82 ValA_Wu16 413. DINH_FIdVerb 0.00 413. FORMAT "%2.0" NUMBER 5 /end CHARACTERISTIC
/begin CHARACTERISTIC DINH_FId.DFC_SWReset_2_CA "/" VAL_BLK 0x80076C8C ValA_Wu16 413. DINH_FIdVerb 0.00 413. FORMAT "%2.0" NUMBER 5 /end CHARACTERISTIC
/begin CHARACTERISTIC DINH_FId.DFC_VSwVlvJamVlv_CA "/" VAL_BLK 0x80076C96 ValA_Wu16 413. DINH_FIdVerb 0.00 413. FORMAT "%2.0" NUMBER 6 /end CHARACTERISTIC
/begin CHARACTERISTIC DINH_FId.DFC_VSwVlvLgTDrft_CA "/" VAL_BLK 0x80076CA2 ValA_Wu16 413. DINH_FIdVerb 0.00 413. FORMAT "%2.0" NUMBER 6 /end CHARACTERISTIC
/begin CHARACTERISTIC DINH_FId.DFC_VSwVlvOfsLrnJamVlv_CA "/" VAL_BLK 0x80076CAE ValA_Wu16 413. DINH_FIdVerb 0.00 413. FORMAT "%2.0" NUMBER 6 /end CHARACTERISTIC
/begin CHARACTERISTIC DINH_FId.DFC_VSwVlvShTDrft_CA "/" VAL_BLK 0x80076CBA ValA_Wu16 413. DINH_FIdVerb 0.00 413. FORMAT "%2.0" NUMBER 6 /end CHARACTERISTIC
/begin CHARACTERISTIC DINH_FId.DSQ_AFS_CA "/" VAL_BLK 0x80076CC6 ValA_Wu16 413. DINH_FIdVerb 0.00 413. FORMAT "%2.0" NUMBER 5 /end CHARACTERISTIC
/begin CHARACTERISTIC DINH_FId.DSQ_BattU_CA "/" VAL_BLK 0x80076CD0 ValA_Wu16 413. DINH_FIdVerb 0.00 413. FORMAT "%2.0" NUMBER 5 /end CHARACTERISTIC
/begin CHARACTERISTIC DINH_FId.DSQ_BrkP_CA "/" VAL_BLK 0x80076CDA ValA_Wu16 413. DINH_FIdVerb 0.00 413. FORMAT "%2.0" NUMBER 5 /end CHARACTERISTIC
/begin CHARACTERISTIC DINH_FId.DSQ_CByVlvActr_CA "/" VAL_BLK 0x80076CE4 ValA_Wu16 413. DINH_FIdVerb 0.00 413. FORMAT "%2.0" NUMBER 5 /end CHARACTERISTIC
/begin CHARACTERISTIC DINH_FId.DSQ_CEngDsT_CA "/" VAL_BLK 0x80076CEE ValA_Wu16 413. DINH_FIdVerb 0.00 413. FORMAT "%2.0" NUMBER 6 /end CHARACTERISTIC
/begin CHARACTERISTIC DINH_FId.DSQ_CEngUsT_CA "/" VAL_BLK 0x80076CFA ValA_Wu16 413. DINH_FIdVerb 0.00 413. FORMAT "%2.0" NUMBER 5 /end CHARACTERISTIC
/begin CHARACTERISTIC DINH_FId.DSQ_CThmstActr_CA "/" VAL_BLK 0x80076D04 ValA_Wu16 413. DINH_FIdVerb 0.00 413. FORMAT "%2.0" NUMBER 5 /end CHARACTERISTIC
/begin CHARACTERISTIC DINH_FId.DSQ_Com_aDirect_CA "/" VAL_BLK 0x80076D0E ValA_Wu16 413. DINH_FIdVerb 0.00 413. FORMAT "%2.0" NUMBER 5 /end CHARACTERISTIC
/begin CHARACTERISTIC DINH_FId.DSQ_Com_aSide_CA "/" VAL_BLK 0x80076D18 ValA_Wu16 413. DINH_FIdVerb 0.00 413. FORMAT "%2.0" NUMBER 5 /end CHARACTERISTIC
/begin CHARACTERISTIC DINH_FId.DSQ_Com_nTSC_CA "/" VAL_BLK 0x80076D22 ValA_Wu16 413. DINH_FIdVerb 0.00 413. FORMAT "%2.0" NUMBER 5 /end CHARACTERISTIC
/begin CHARACTERISTIC DINH_FId.DSQ_Com_pBrkSys_CA "/" VAL_BLK 0x80076D2C ValA_Wu16 413. DINH_FIdVerb 0.00 413. FORMAT "%2.0" NUMBER 6 /end CHARACTERISTIC
/begin CHARACTERISTIC DINH_FId.DSQ_Com_stButtonMSA_CA "/" VAL_BLK 0x80076D38 ValA_Wu16 413. DINH_FIdVerb 0.00 413. FORMAT "%2.0" NUMBER 5 /end CHARACTERISTIC
/begin CHARACTERISTIC DINH_FId.DSQ_Com_stClCtr_CA "/" VAL_BLK 0x80076D42 ValA_Wu16 413. DINH_FIdVerb 0.00 413. FORMAT "%2.0" NUMBER 5 /end CHARACTERISTIC
/begin CHARACTERISTIC DINH_FId.DSQ_Com_stDSC_CA "/" VAL_BLK 0x80076D4C ValA_Wu16 413. DINH_FIdVerb 0.00 413. FORMAT "%2.0" NUMBER 5 /end CHARACTERISTIC
/begin CHARACTERISTIC DINH_FId.DSQ_Com_stDecellDSC_CA "/" VAL_BLK 0x80076D56 ValA_Wu16 413. DINH_FIdVerb 0.00 413. FORMAT "%2.0" NUMBER 5 /end CHARACTERISTIC
/begin CHARACTERISTIC DINH_FId.DSQ_Com_stDrWghSeat_CA "/" VAL_BLK 0x80076D60 ValA_Wu16 413. DINH_FIdVerb 0.00 413. FORMAT "%2.0" NUMBER 5 /end CHARACTERISTIC
/begin CHARACTERISTIC DINH_FId.DSQ_Com_stGear_CA "/" VAL_BLK 0x80076D6A ValA_Wu16 413. DINH_FIdVerb 0.00 413. FORMAT "%2.0" NUMBER 5 /end CHARACTERISTIC
/begin CHARACTERISTIC DINH_FId.DSQ_Com_stKeyVld_CA "/" VAL_BLK 0x80076D74 ValA_Wu16 413. DINH_FIdVerb 0.00 413. FORMAT "%2.0" NUMBER 5 /end CHARACTERISTIC
/begin CHARACTERISTIC DINH_FId.DSQ_Com_stReqMSA_CA "/" VAL_BLK 0x80076D7E ValA_Wu16 413. DINH_FIdVerb 0.00 413. FORMAT "%2.0" NUMBER 5 /end CHARACTERISTIC
/begin CHARACTERISTIC DINH_FId.DSQ_Com_stT15_CA "/" VAL_BLK 0x80076D88 ValA_Wu16 413. DINH_FIdVerb 0.00 413. FORMAT "%2.0" NUMBER 7 /end CHARACTERISTIC
/begin CHARACTERISTIC DINH_FId.DSQ_Com_stT50_CA "/" VAL_BLK 0x80076D96 ValA_Wu16 413. DINH_FIdVerb 0.00 413. FORMAT "%2.0" NUMBER 5 /end CHARACTERISTIC
/begin CHARACTERISTIC DINH_FId.DSQ_Com_stTrqDSCDes_CA "/" VAL_BLK 0x80076DA0 ValA_Wu16 413. DINH_FIdVerb 0.00 413. FORMAT "%2.0" NUMBER 5 /end CHARACTERISTIC
/begin CHARACTERISTIC DINH_FId.DSQ_Com_swtDrBltb_CA "/" VAL_BLK 0x80076DAA ValA_Wu16 413. DINH_FIdVerb 0.00 413. FORMAT "%2.0" NUMBER 5 /end CHARACTERISTIC
/begin CHARACTERISTIC DINH_FId.DSQ_Com_tEnvT_CA "/" VAL_BLK 0x80076DB4 ValA_Wu16 413. DINH_FIdVerb 0.00 413. FORMAT "%2.0" NUMBER 5 /end CHARACTERISTIC
/begin CHARACTERISTIC DINH_FId.DSQ_Com_tGbxOil_CA "/" VAL_BLK 0x80076DBE ValA_Wu16 413. DINH_FIdVerb 0.00 413. FORMAT "%2.0" NUMBER 6 /end CHARACTERISTIC
/begin CHARACTERISTIC DINH_FId.DSQ_Com_trqAC_CA "/" VAL_BLK 0x80076DCA ValA_Wu16 413. DINH_FIdVerb 0.00 413. FORMAT "%2.0" NUMBER 5 /end CHARACTERISTIC
/begin CHARACTERISTIC DINH_FId.DSQ_Com_trqARSCur_CA "/" VAL_BLK 0x80076DD4 ValA_Wu16 413. DINH_FIdVerb 0.00 413. FORMAT "%2.0" NUMBER 5 /end CHARACTERISTIC
/begin CHARACTERISTIC DINH_FId.DSQ_Com_trqARSDes_CA "/" VAL_BLK 0x80076DDE ValA_Wu16 413. DINH_FIdVerb 0.00 413. FORMAT "%2.0" NUMBER 5 /end CHARACTERISTIC
/begin CHARACTERISTIC DINH_FId.DSQ_Com_trqAvlAFS_CA "/" VAL_BLK 0x80076DE8 ValA_Wu16 413. DINH_FIdVerb 0.00 413. FORMAT "%2.0" NUMBER 5 /end CHARACTERISTIC
/begin CHARACTERISTIC DINH_FId.DSQ_Com_trqDSCDes_CA "/" VAL_BLK 0x80076DF2 ValA_Wu16 413. DINH_FIdVerb 0.00 413. FORMAT "%2.0" NUMBER 7 /end CHARACTERISTIC
/begin CHARACTERISTIC DINH_FId.DSQ_Com_trqGbxDes_CA "/" VAL_BLK 0x80076E00 ValA_Wu16 413. DINH_FIdVerb 0.00 413. FORMAT "%2.0" NUMBER 6 /end CHARACTERISTIC
/begin CHARACTERISTIC DINH_FId.DSQ_Com_trqGbxFrc_CA "/" VAL_BLK 0x80076E0C ValA_Wu16 413. DINH_FIdVerb 0.00 413. FORMAT "%2.0" NUMBER 6 /end CHARACTERISTIC
/begin CHARACTERISTIC DINH_FId.DSQ_Com_trqGbxMax_CA "/" VAL_BLK 0x80076E18 ValA_Wu16 413. DINH_FIdVerb 0.00 413. FORMAT "%2.0" NUMBER 6 /end CHARACTERISTIC
/begin CHARACTERISTIC DINH_FId.DSQ_Com_trqTarAFS_CA "/" VAL_BLK 0x80076E24 ValA_Wu16 413. DINH_FIdVerb 0.00 413. FORMAT "%2.0" NUMBER 5 /end CHARACTERISTIC
/begin CHARACTERISTIC DINH_FId.DSQ_Com_v_CA "/" VAL_BLK 0x80076E2E ValA_Wu16 413. DINH_FIdVerb 0.00 413. FORMAT "%2.0" NUMBER 5 /end CHARACTERISTIC
/begin CHARACTERISTIC DINH_FId.DSQ_Com_vBd_CA "/" VAL_BLK 0x80076E38 ValA_Wu16 413. DINH_FIdVerb 0.00 413. FORMAT "%2.0" NUMBER 7 /end CHARACTERISTIC
/begin CHARACTERISTIC DINH_FId.DSQ_DSMInhibitAlways_CA "/" VAL_BLK 0x80076E46 ValA_Wu16 413. DINH_FIdVerb 0.00 413. FORMAT "%2.0" NUMBER 6 /end CHARACTERISTIC
/begin CHARACTERISTIC DINH_FId.DSQ_ECBVlvActr_CA "/" VAL_BLK 0x80076E52 ValA_Wu16 413. DINH_FIdVerb 0.00 413. FORMAT "%2.0" NUMBER 5 /end CHARACTERISTIC
/begin CHARACTERISTIC DINH_FId.DSQ_ECBVlvSens_CA "/" VAL_BLK 0x80076E5C ValA_Wu16 413. DINH_FIdVerb 0.00 413. FORMAT "%2.0" NUMBER 5 /end CHARACTERISTIC
/begin CHARACTERISTIC DINH_FId.DSQ_EGRVlvActr_CA "/" VAL_BLK 0x80076E66 ValA_Wu16 413. DINH_FIdVerb 0.00 413. FORMAT "%2.0" NUMBER 6 /end CHARACTERISTIC
/begin CHARACTERISTIC DINH_FId.DSQ_EGRVlvSens_CA "/" VAL_BLK 0x80076E72 ValA_Wu16 413. DINH_FIdVerb 0.00 413. FORMAT "%2.0" NUMBER 5 /end CHARACTERISTIC
/begin CHARACTERISTIC DINH_FId.DSQ_EMDmp_0_CA "/" VAL_BLK 0x80076E7C ValA_Wu16 413. DINH_FIdVerb 0.00 413. FORMAT "%2.0" NUMBER 5 /end CHARACTERISTIC
/begin CHARACTERISTIC DINH_FId.DSQ_EMDmp_1_CA "/" VAL_BLK 0x80076E86 ValA_Wu16 413. DINH_FIdVerb 0.00 413. FORMAT "%2.0" NUMBER 5 /end CHARACTERISTIC
/begin CHARACTERISTIC DINH_FId.DSQ_EngPrtFWOsc_CA "/" VAL_BLK 0x80076E90 ValA_Wu16 413. DINH_FIdVerb 0.00 413. FORMAT "%2.0" NUMBER 10 /end CHARACTERISTIC
/begin CHARACTERISTIC DINH_FId.DSQ_EnvP_CA "/" VAL_BLK 0x80076EA4 ValA_Wu16 413. DINH_FIdVerb 0.00 413. FORMAT "%2.0" NUMBER 6 /end CHARACTERISTIC
/begin CHARACTERISTIC DINH_FId.DSQ_EnvT_CA "/" VAL_BLK 0x80076EB0 ValA_Wu16 413. DINH_FIdVerb 0.00 413. FORMAT "%2.0" NUMBER 5 /end CHARACTERISTIC
/begin CHARACTERISTIC DINH_FId.DSQ_FanActr_CA "/" VAL_BLK 0x80076EBA ValA_Wu16 413. DINH_FIdVerb 0.00 413. FORMAT "%2.0" NUMBER 5 /end CHARACTERISTIC
/begin CHARACTERISTIC DINH_FId.DSQ_FuelT_CA "/" VAL_BLK 0x80076EC4 ValA_Wu16 413. DINH_FIdVerb 0.00 413. FORMAT "%2.0" NUMBER 5 /end CHARACTERISTIC
/begin CHARACTERISTIC DINH_FId.DSQ_LAYER2EDCMSAStp_CA "/" VAL_BLK 0x80076ECE ValA_Wu16 413. DINH_FIdVerb 0.00 413. FORMAT "%2.0" NUMBER 5 /end CHARACTERISTIC
/begin CHARACTERISTIC DINH_FId.DSQ_LSUO2_0_CA "/" VAL_BLK 0x80076ED8 ValA_Wu16 413. DINH_FIdVerb 0.00 413. FORMAT "%2.0" NUMBER 5 /end CHARACTERISTIC
/begin CHARACTERISTIC DINH_FId.DSQ_LSUO2_1_CA "/" VAL_BLK 0x80076EE2 ValA_Wu16 413. DINH_FIdVerb 0.00 413. FORMAT "%2.0" NUMBER 5 /end CHARACTERISTIC
/begin CHARACTERISTIC DINH_FId.DSQ_LSUO2_2_CA "/" VAL_BLK 0x80076EEC ValA_Wu16 413. DINH_FIdVerb 0.00 413. FORMAT "%2.0" NUMBER 5 /end CHARACTERISTIC
/begin CHARACTERISTIC DINH_FId.DSQ_LSUO2_3_CA "/" VAL_BLK 0x80076EF6 ValA_Wu16 413. DINH_FIdVerb 0.00 413. FORMAT "%2.0" NUMBER 5 /end CHARACTERISTIC
/begin CHARACTERISTIC DINH_FId.DSQ_MeUnActr_CA "/" VAL_BLK 0x80076F00 ValA_Wu16 413. DINH_FIdVerb 0.00 413. FORMAT "%2.0" NUMBER 5 /end CHARACTERISTIC
/begin CHARACTERISTIC DINH_FId.DSQ_NSCDsRLamO2_CA "/" VAL_BLK 0x80076F0A ValA_Wu16 413. DINH_FIdVerb 0.00 413. FORMAT "%2.0" NUMBER 5 /end CHARACTERISTIC
/begin CHARACTERISTIC DINH_FId.DSQ_OilStSens_CA "/" VAL_BLK 0x80076F14 ValA_Wu16 413. DINH_FIdVerb 0.00 413. FORMAT "%2.0" NUMBER 5 /end CHARACTERISTIC
/begin CHARACTERISTIC DINH_FId.DSQ_OilT_CA "/" VAL_BLK 0x80076F1E ValA_Wu16 413. DINH_FIdVerb 0.00 413. FORMAT "%2.0" NUMBER 5 /end CHARACTERISTIC
/begin CHARACTERISTIC DINH_FId.DSQ_PAirFltDs_CA "/" VAL_BLK 0x80076F28 ValA_Wu16 413. DINH_FIdVerb 0.00 413. FORMAT "%2.0" NUMBER 5 /end CHARACTERISTIC
/begin CHARACTERISTIC DINH_FId.DSQ_PCACDs_CA "/" VAL_BLK 0x80076F32 ValA_Wu16 413. DINH_FIdVerb 0.00 413. FORMAT "%2.0" NUMBER 6 /end CHARACTERISTIC
/begin CHARACTERISTIC DINH_FId.DSQ_PCVActr_CA "/" VAL_BLK 0x80076F3E ValA_Wu16 413. DINH_FIdVerb 0.00 413. FORMAT "%2.0" NUMBER 5 /end CHARACTERISTIC
/begin CHARACTERISTIC DINH_FId.DSQ_PPFltUs_CA "/" VAL_BLK 0x80076F48 ValA_Wu16 413. DINH_FIdVerb 0.00 413. FORMAT "%2.0" NUMBER 5 /end CHARACTERISTIC
/begin CHARACTERISTIC DINH_FId.DSQ_TAFS_CA "/" VAL_BLK 0x80076F52 ValA_Wu16 413. DINH_FIdVerb 0.00 413. FORMAT "%2.0" NUMBER 5 /end CHARACTERISTIC
/begin CHARACTERISTIC DINH_FId.DSQ_TCACDs_CA "/" VAL_BLK 0x80076F5C ValA_Wu16 413. DINH_FIdVerb 0.00 413. FORMAT "%2.0" NUMBER 6 /end CHARACTERISTIC
/begin CHARACTERISTIC DINH_FId.DSQ_TECU_CA "/" VAL_BLK 0x80076F68 ValA_Wu16 413. DINH_FIdVerb 0.00 413. FORMAT "%2.0" NUMBER 5 /end CHARACTERISTIC
/begin CHARACTERISTIC DINH_FId.DSQ_TOxiCatUs_CA "/" VAL_BLK 0x80076F72 ValA_Wu16 413. DINH_FIdVerb 0.00 413. FORMAT "%2.0" NUMBER 5 /end CHARACTERISTIC
/begin CHARACTERISTIC DINH_FId.DSQ_TPFltUs_CA "/" VAL_BLK 0x80076F7C ValA_Wu16 413. DINH_FIdVerb 0.00 413. FORMAT "%2.0" NUMBER 5 /end CHARACTERISTIC
/begin CHARACTERISTIC DINH_FId.DSQ_ThrVlvActr_CA "/" VAL_BLK 0x80076F86 ValA_Wu16 413. DINH_FIdVerb 0.00 413. FORMAT "%2.0" NUMBER 6 /end CHARACTERISTIC
/begin CHARACTERISTIC DINH_FId.DSQ_ThrVlvSens_CA "/" VAL_BLK 0x80076F92 ValA_Wu16 413. DINH_FIdVerb 0.00 413. FORMAT "%2.0" NUMBER 5 /end CHARACTERISTIC
/begin CHARACTERISTIC DINH_FId.DSQ_TrbChActr_CA "/" VAL_BLK 0x80076F9C ValA_Wu16 413. DINH_FIdVerb 0.00 413. FORMAT "%2.0" NUMBER 7 /end CHARACTERISTIC
/begin CHARACTERISTIC DINH_FId.DSQ_TrbChLPActr_CA "/" VAL_BLK 0x80076FAA ValA_Wu16 413. DINH_FIdVerb 0.00 413. FORMAT "%2.0" NUMBER 5 /end CHARACTERISTIC
/begin CHARACTERISTIC DINH_FId.DSQ_TrbChSens_CA "/" VAL_BLK 0x80076FB4 ValA_Wu16 413. DINH_FIdVerb 0.00 413. FORMAT "%2.0" NUMBER 5 /end CHARACTERISTIC
/begin CHARACTERISTIC DINH_FId.DSQ_TrbnDsRLamO2_CA "/" VAL_BLK 0x80076FBE ValA_Wu16 413. DINH_FIdVerb 0.00 413. FORMAT "%2.0" NUMBER 5 /end CHARACTERISTIC
/begin CHARACTERISTIC DINH_FId.DSQ_VSwVlvActr_CA "/" VAL_BLK 0x80076FC8 ValA_Wu16 413. DINH_FIdVerb 0.00 413. FORMAT "%2.0" NUMBER 6 /end CHARACTERISTIC
/begin CHARACTERISTIC DINH_FId.DSQ_VSwVlvSens_CA "/" VAL_BLK 0x80076FD4 ValA_Wu16 413. DINH_FIdVerb 0.00 413. FORMAT "%2.0" NUMBER 5 /end CHARACTERISTIC
/begin CHARACTERISTIC DINH_FId.DSQ_VehV_CA "/" VAL_BLK 0x80076FDE ValA_Wu16 413. DINH_FIdVerb 0.00 413. FORMAT "%2.0" NUMBER 6 /end CHARACTERISTIC
/begin CHARACTERISTIC DINH_FId.DSQ_WaHtElActr_CA "/" VAL_BLK 0x80076FEA ValA_Wu16 413. DINH_FIdVerb 0.00 413. FORMAT "%2.0" NUMBER 5 /end CHARACTERISTIC
/begin CHARACTERISTIC DINH_FId.DSQ_stAPP_CA "/" VAL_BLK 0x80076FF4 ValA_Wu16 413. DINH_FIdVerb 0.00 413. FORMAT "%2.0" NUMBER 7 /end CHARACTERISTIC
/begin CHARACTERISTIC DINH_FId.DSQ_stAPP1_CA "/" VAL_BLK 0x80077002 ValA_Wu16 413. DINH_FIdVerb 0.00 413. FORMAT "%2.0" NUMBER 10 /end CHARACTERISTIC
/begin CHARACTERISTIC DINH_FId.DSQ_stAPP2_CA "/" VAL_BLK 0x80077016 ValA_Wu16 413. DINH_FIdVerb 0.00 413. FORMAT "%2.0" NUMBER 11 /end CHARACTERISTIC
/begin CHARACTERISTIC DINH_FId.DSQ_stLSUSrvTstDem_CA "/" VAL_BLK 0x8007702C ValA_Wu16 413. DINH_FIdVerb 0.00 413. FORMAT "%2.0" NUMBER 5 /end CHARACTERISTIC
/begin CHARACTERISTIC DINH_Lim.DFC_AirCtlGovDvtEOMMax_CA "/" VAL_BLK 0x80077036 ValA_Wu16 8192. DINH_LimDFCVerb 12079. 20271. FORMAT "%2.0" NUMBER 5 /end CHARACTERISTIC
/begin CHARACTERISTIC DINH_Lim.DFC_AirCtlGovDvtEOMMin_CA "/" VAL_BLK 0x80077040 ValA_Wu16 8192. DINH_LimDFCVerb 12079. 20271. FORMAT "%2.0" NUMBER 5 /end CHARACTERISTIC
/begin CHARACTERISTIC DINH_Lim.DFC_AirCtlGovDvtMax_CA "/" VAL_BLK 0x8007704A ValA_Wu16 8192. DINH_LimDFCVerb 12079. 20271. FORMAT "%2.0" NUMBER 10 /end CHARACTERISTIC
/begin CHARACTERISTIC DINH_Lim.DFC_AirCtlGovDvtMin_CA "/" VAL_BLK 0x8007705E ValA_Wu16 8192. DINH_LimDFCVerb 12079. 20271. FORMAT "%2.0" NUMBER 6 /end CHARACTERISTIC
/begin CHARACTERISTIC DINH_Lim.DFC_Cj945SpiCom1_CA "/" VAL_BLK 0x8007706A ValA_Wu16 8192. DINH_LimDFCVerb 12079. 20271. FORMAT "%2.0" NUMBER 6 /end CHARACTERISTIC
/begin CHARACTERISTIC DINH_Lim.DFC_ComButtonMSASig_CA "/" VAL_BLK 0x80077076 ValA_Wu16 8192. DINH_LimDFCVerb 12079. 20271. FORMAT "%2.0" NUMBER 5 /end CHARACTERISTIC
/begin CHARACTERISTIC DINH_Lim.DFC_ComButtonMSATo_CA "/" VAL_BLK 0x80077080 ValA_Wu16 8192. DINH_LimDFCVerb 12079. 20271. FORMAT "%2.0" NUMBER 5 /end CHARACTERISTIC
/begin CHARACTERISTIC DINH_Lim.DFC_ComGearboxData2Sig_CA "/" VAL_BLK 0x8007708A ValA_Wu16 8192. DINH_LimDFCVerb 12079. 20271. FORMAT "%2.0" NUMBER 5 /end CHARACTERISTIC
/begin CHARACTERISTIC DINH_Lim.DFC_ComGearboxData2To_CA "/" VAL_BLK 0x80077094 ValA_Wu16 8192. DINH_LimDFCVerb 12079. 20271. FORMAT "%2.0" NUMBER 5 /end CHARACTERISTIC
/begin CHARACTERISTIC DINH_Lim.DFC_ComGearboxDataSig_CA "/" VAL_BLK 0x8007709E ValA_Wu16 8192. DINH_LimDFCVerb 12079. 20271. FORMAT "%2.0" NUMBER 5 /end CHARACTERISTIC
/begin CHARACTERISTIC DINH_Lim.DFC_ComGearboxDataTo_CA "/" VAL_BLK 0x800770A8 ValA_Wu16 8192. DINH_LimDFCVerb 12079. 20271. FORMAT "%2.0" NUMBER 5 /end CHARACTERISTIC
/begin CHARACTERISTIC DINH_Lim.DFC_ComHeatACSig_CA "/" VAL_BLK 0x800770B2 ValA_Wu16 8192. DINH_LimDFCVerb 12079. 20271. FORMAT "%2.0" NUMBER 5 /end CHARACTERISTIC
/begin CHARACTERISTIC DINH_Lim.DFC_ComHeatACTo_CA "/" VAL_BLK 0x800770BC ValA_Wu16 8192. DINH_LimDFCVerb 12079. 20271. FORMAT "%2.0" NUMBER 5 /end CHARACTERISTIC
/begin CHARACTERISTIC DINH_Lim.DFC_ComLenkradwinkelSig_CA "/" VAL_BLK 0x800770C6 ValA_Wu16 8192. DINH_LimDFCVerb 12079. 20271. FORMAT "%2.0" NUMBER 5 /end CHARACTERISTIC
/begin CHARACTERISTIC DINH_Lim.DFC_ComLenkradwinkelTo_CA "/" VAL_BLK 0x800770D0 ValA_Wu16 8192. DINH_LimDFCVerb 12079. 20271. FORMAT "%2.0" NUMBER 5 /end CHARACTERISTIC
/begin CHARACTERISTIC DINH_Lim.DFC_ComMileageRangeSig_CA "/" VAL_BLK 0x800770DA ValA_Wu16 8192. DINH_LimDFCVerb 12079. 20271. FORMAT "%2.0" NUMBER 5 /end CHARACTERISTIC
/begin CHARACTERISTIC DINH_Lim.DFC_ComMileageRangeTo_CA "/" VAL_BLK 0x800770E4 ValA_Wu16 8192. DINH_LimDFCVerb 12079. 20271. FORMAT "%2.0" NUMBER 5 /end CHARACTERISTIC
/begin CHARACTERISTIC DINH_Lim.DFC_ComPspSig_CA "/" VAL_BLK 0x800770EE ValA_Wu16 8192. DINH_LimDFCVerb 12079. 20271. FORMAT "%2.0" NUMBER 5 /end CHARACTERISTIC
/begin CHARACTERISTIC DINH_Lim.DFC_ComPspTo_CA "/" VAL_BLK 0x800770F8 ValA_Wu16 8192. DINH_LimDFCVerb 12079. 20271. FORMAT "%2.0" NUMBER 5 /end CHARACTERISTIC
/begin CHARACTERISTIC DINH_Lim.DFC_ComShutOffPSPSig_CA "/" VAL_BLK 0x80077102 ValA_Wu16 8192. DINH_LimDFCVerb 12079. 20271. FORMAT "%2.0" NUMBER 5 /end CHARACTERISTIC
/begin CHARACTERISTIC DINH_Lim.DFC_ComShutOffPSPTo_CA "/" VAL_BLK 0x8007710C ValA_Wu16 8192. DINH_LimDFCVerb 12079. 20271. FORMAT "%2.0" NUMBER 5 /end CHARACTERISTIC
/begin CHARACTERISTIC DINH_Lim.DFC_ComStKombiCtr_CA "/" VAL_BLK 0x80077116 ValA_Wu16 8192. DINH_LimDFCVerb 12079. 20271. FORMAT "%2.0" NUMBER 5 /end CHARACTERISTIC
/begin CHARACTERISTIC DINH_Lim.DFC_ComStKombiSig_CA "/" VAL_BLK 0x80077120 ValA_Wu16 8192. DINH_LimDFCVerb 12079. 20271. FORMAT "%2.0" NUMBER 5 /end CHARACTERISTIC
/begin CHARACTERISTIC DINH_Lim.DFC_ComStKombiTo_CA "/" VAL_BLK 0x8007712A ValA_Wu16 8192. DINH_LimDFCVerb 12079. 20271. FORMAT "%2.0" NUMBER 5 /end CHARACTERISTIC
/begin CHARACTERISTIC DINH_Lim.DFC_ComStateARSCtr_CA "/" VAL_BLK 0x80077134 ValA_Wu16 8192. DINH_LimDFCVerb 12079. 20271. FORMAT "%2.0" NUMBER 5 /end CHARACTERISTIC
/begin CHARACTERISTIC DINH_Lim.DFC_ComStateARSSig_CA "/" VAL_BLK 0x8007713E ValA_Wu16 8192. DINH_LimDFCVerb 12079. 20271. FORMAT "%2.0" NUMBER 5 /end CHARACTERISTIC
/begin CHARACTERISTIC DINH_Lim.DFC_ComStateARSTo_CA "/" VAL_BLK 0x80077148 ValA_Wu16 8192. DINH_LimDFCVerb 12079. 20271. FORMAT "%2.0" NUMBER 5 /end CHARACTERISTIC
/begin CHARACTERISTIC DINH_Lim.DFC_ComStateDscSig_CA "/" VAL_BLK 0x80077152 ValA_Wu16 8192. DINH_LimDFCVerb 12079. 20271. FORMAT "%2.0" NUMBER 5 /end CHARACTERISTIC
/begin CHARACTERISTIC DINH_Lim.DFC_ComStateDscTo_CA "/" VAL_BLK 0x8007715C ValA_Wu16 8192. DINH_LimDFCVerb 12079. 20271. FORMAT "%2.0" NUMBER 5 /end CHARACTERISTIC
/begin CHARACTERISTIC DINH_Lim.DFC_ComStateSeatSig_CA "/" VAL_BLK 0x80077166 ValA_Wu16 8192. DINH_LimDFCVerb 12079. 20271. FORMAT "%2.0" NUMBER 5 /end CHARACTERISTIC
/begin CHARACTERISTIC DINH_Lim.DFC_ComStateSeatTo_CA "/" VAL_BLK 0x80077170 ValA_Wu16 8192. DINH_LimDFCVerb 12079. 20271. FORMAT "%2.0" NUMBER 5 /end CHARACTERISTIC
/begin CHARACTERISTIC DINH_Lim.DFC_ComTempRelTimeSig_CA "/" VAL_BLK 0x8007717A ValA_Wu16 8192. DINH_LimDFCVerb 12079. 20271. FORMAT "%2.0" NUMBER 5 /end CHARACTERISTIC
/begin CHARACTERISTIC DINH_Lim.DFC_ComTempRelTimeTo_CA "/" VAL_BLK 0x80077184 ValA_Wu16 8192. DINH_LimDFCVerb 12079. 20271. FORMAT "%2.0" NUMBER 5 /end CHARACTERISTIC
/begin CHARACTERISTIC DINH_Lim.DFC_ComTerminalChk_CA "/" VAL_BLK 0x8007718E ValA_Wu16 8192. DINH_LimDFCVerb 12079. 20271. FORMAT "%2.0" NUMBER 5 /end CHARACTERISTIC
/begin CHARACTERISTIC DINH_Lim.DFC_ComTerminalCtr_CA "/" VAL_BLK 0x80077198 ValA_Wu16 8192. DINH_LimDFCVerb 12079. 20271. FORMAT "%2.0" NUMBER 5 /end CHARACTERISTIC
/begin CHARACTERISTIC DINH_Lim.DFC_ComTerminalSig_CA "/" VAL_BLK 0x800771A2 ValA_Wu16 8192. DINH_LimDFCVerb 12079. 20271. FORMAT "%2.0" NUMBER 5 /end CHARACTERISTIC
/begin CHARACTERISTIC DINH_Lim.DFC_ComTerminalTo_CA "/" VAL_BLK 0x800771AC ValA_Wu16 8192. DINH_LimDFCVerb 12079. 20271. FORMAT "%2.0" NUMBER 5 /end CHARACTERISTIC
/begin CHARACTERISTIC DINH_Lim.DFC_ComTimeDateSig_CA "/" VAL_BLK 0x800771B6 ValA_Wu16 8192. DINH_LimDFCVerb 12079. 20271. FORMAT "%2.0" NUMBER 5 /end CHARACTERISTIC
/begin CHARACTERISTIC DINH_Lim.DFC_ComTimeDateTo_CA "/" VAL_BLK 0x800771C0 ValA_Wu16 8192. DINH_LimDFCVerb 12079. 20271. FORMAT "%2.0" NUMBER 5 /end CHARACTERISTIC
/begin CHARACTERISTIC DINH_Lim.DFC_ComTrailerSig_CA "/" VAL_BLK 0x800771CA ValA_Wu16 8192. DINH_LimDFCVerb 12079. 20271. FORMAT "%2.0" NUMBER 5 /end CHARACTERISTIC
/begin CHARACTERISTIC DINH_Lim.DFC_ComTrailerTo_CA "/" VAL_BLK 0x800771D4 ValA_Wu16 8192. DINH_LimDFCVerb 12079. 20271. FORMAT "%2.0" NUMBER 5 /end CHARACTERISTIC
/begin CHARACTERISTIC DINH_Lim.DFC_ComTrqDemandAfsChk_CA "/" VAL_BLK 0x800771DE ValA_Wu16 8192. DINH_LimDFCVerb 12079. 20271. FORMAT "%2.0" NUMBER 5 /end CHARACTERISTIC
/begin CHARACTERISTIC DINH_Lim.DFC_ComTrqDemandAfsCtr_CA "/" VAL_BLK 0x800771E8 ValA_Wu16 8192. DINH_LimDFCVerb 12079. 20271. FORMAT "%2.0" NUMBER 5 /end CHARACTERISTIC
/begin CHARACTERISTIC DINH_Lim.DFC_ComTrqDemandAfsSig_CA "/" VAL_BLK 0x800771F2 ValA_Wu16 8192. DINH_LimDFCVerb 12079. 20271. FORMAT "%2.0" NUMBER 5 /end CHARACTERISTIC
/begin CHARACTERISTIC DINH_Lim.DFC_ComTrqDemandAfsTo_CA "/" VAL_BLK 0x800771FC ValA_Wu16 8192. DINH_LimDFCVerb 12079. 20271. FORMAT "%2.0" NUMBER 5 /end CHARACTERISTIC
/begin CHARACTERISTIC DINH_Lim.DFC_ComTrqDemandDscChk_CA "/" VAL_BLK 0x80077206 ValA_Wu16 8192. DINH_LimDFCVerb 12079. 20271. FORMAT "%2.0" NUMBER 5 /end CHARACTERISTIC
/begin CHARACTERISTIC DINH_Lim.DFC_ComTrqDemandDscCtr_CA "/" VAL_BLK 0x80077210 ValA_Wu16 8192. DINH_LimDFCVerb 12079. 20271. FORMAT "%2.0" NUMBER 5 /end CHARACTERISTIC
/begin CHARACTERISTIC DINH_Lim.DFC_ComTrqDemandDscSig_CA "/" VAL_BLK 0x8007721A ValA_Wu16 8192. DINH_LimDFCVerb 12079. 20271. FORMAT "%2.0" NUMBER 5 /end CHARACTERISTIC
/begin CHARACTERISTIC DINH_Lim.DFC_ComTrqDemandDscTo_CA "/" VAL_BLK 0x80077224 ValA_Wu16 8192. DINH_LimDFCVerb 12079. 20271. FORMAT "%2.0" NUMBER 5 /end CHARACTERISTIC
/begin CHARACTERISTIC DINH_Lim.DFC_ComTrqDemandGbxChk_CA "/" VAL_BLK 0x8007722E ValA_Wu16 8192. DINH_LimDFCVerb 12079. 20271. FORMAT "%2.0" NUMBER 5 /end CHARACTERISTIC
/begin CHARACTERISTIC DINH_Lim.DFC_ComTrqDemandGbxCtr_CA "/" VAL_BLK 0x80077238 ValA_Wu16 8192. DINH_LimDFCVerb 12079. 20271. FORMAT "%2.0" NUMBER 5 /end CHARACTERISTIC
/begin CHARACTERISTIC DINH_Lim.DFC_ComTrqDemandGbxSig_CA "/" VAL_BLK 0x80077242 ValA_Wu16 8192. DINH_LimDFCVerb 12079. 20271. FORMAT "%2.0" NUMBER 5 /end CHARACTERISTIC
/begin CHARACTERISTIC DINH_Lim.DFC_ComTrqDemandGbxTo_CA "/" VAL_BLK 0x8007724C ValA_Wu16 8192. DINH_LimDFCVerb 12079. 20271. FORMAT "%2.0" NUMBER 5 /end CHARACTERISTIC
/begin CHARACTERISTIC DINH_Lim.DFC_ComVelocitySig_CA "/" VAL_BLK 0x80077256 ValA_Wu16 8192. DINH_LimDFCVerb 12079. 20271. FORMAT "%2.0" NUMBER 5 /end CHARACTERISTIC
/begin CHARACTERISTIC DINH_Lim.DFC_ComVelocityTo_CA "/" VAL_BLK 0x80077260 ValA_Wu16 8192. DINH_LimDFCVerb 12079. 20271. FORMAT "%2.0" NUMBER 5 /end CHARACTERISTIC
/begin CHARACTERISTIC DINH_Lim.DFC_ComWheelSpeedSig_CA "/" VAL_BLK 0x8007726A ValA_Wu16 8192. DINH_LimDFCVerb 12079. 20271. FORMAT "%2.0" NUMBER 7 /end CHARACTERISTIC
/begin CHARACTERISTIC DINH_Lim.DFC_ComWheelSpeedTo_CA "/" VAL_BLK 0x80077278 ValA_Wu16 8192. DINH_LimDFCVerb 12079. 20271. FORMAT "%2.0" NUMBER 7 /end CHARACTERISTIC
/begin CHARACTERISTIC DINH_Lim.DFC_ComZvKlappenSig_CA "/" VAL_BLK 0x80077286 ValA_Wu16 8192. DINH_LimDFCVerb 12079. 20271. FORMAT "%2.0" NUMBER 5 /end CHARACTERISTIC
/begin CHARACTERISTIC DINH_Lim.DFC_ComZvKlappenTo_CA "/" VAL_BLK 0x80077290 ValA_Wu16 8192. DINH_LimDFCVerb 12079. 20271. FORMAT "%2.0" NUMBER 5 /end CHARACTERISTIC
/begin CHARACTERISTIC DINH_Lim.DFC_Cy150SpiCom_CA "/" VAL_BLK 0x8007729A ValA_Wu16 8192. DINH_LimDFCVerb 12079. 20271. FORMAT "%2.0" NUMBER 5 /end CHARACTERISTIC
/begin CHARACTERISTIC DINH_Lim.DFC_Cy320SpiCom_CA "/" VAL_BLK 0x800772A4 ValA_Wu16 8192. DINH_LimDFCVerb 12079. 20271. FORMAT "%2.0" NUMBER 5 /end CHARACTERISTIC
/begin CHARACTERISTIC DINH_Lim.DFC_ETCtlDvtInrMax_CA "/" VAL_BLK 0x800772AE ValA_Wu16 8192. DINH_LimDFCVerb 12079. 20271. FORMAT "%2.0" NUMBER 5 /end CHARACTERISTIC
/begin CHARACTERISTIC DINH_Lim.DFC_ETCtlDvtInrMin_CA "/" VAL_BLK 0x800772B8 ValA_Wu16 8192. DINH_LimDFCVerb 12079. 20271. FORMAT "%2.0" NUMBER 5 /end CHARACTERISTIC
/begin CHARACTERISTIC DINH_Lim.DFC_ETCtlDvtOutrMax_CA "/" VAL_BLK 0x800772C2 ValA_Wu16 8192. DINH_LimDFCVerb 12079. 20271. FORMAT "%2.0" NUMBER 5 /end CHARACTERISTIC
/begin CHARACTERISTIC DINH_Lim.DFC_ETCtlDvtOutrMin_CA "/" VAL_BLK 0x800772CC ValA_Wu16 8192. DINH_LimDFCVerb 12079. 20271. FORMAT "%2.0" NUMBER 5 /end CHARACTERISTIC
/begin CHARACTERISTIC DINH_Lim.DFC_Fan4WinErr1_CA "/" VAL_BLK 0x800772D6 ValA_Wu16 8192. DINH_LimDFCVerb 12079. 20271. FORMAT "%2.0" NUMBER 5 /end CHARACTERISTIC
/begin CHARACTERISTIC DINH_Lim.DFC_Fan4WinErr2_CA "/" VAL_BLK 0x800772E0 ValA_Wu16 8192. DINH_LimDFCVerb 12079. 20271. FORMAT "%2.0" NUMBER 5 /end CHARACTERISTIC
/begin CHARACTERISTIC DINH_Lim.DFC_Fan4WinErr3_CA "/" VAL_BLK 0x800772EA ValA_Wu16 8192. DINH_LimDFCVerb 12079. 20271. FORMAT "%2.0" NUMBER 5 /end CHARACTERISTIC
/begin CHARACTERISTIC DINH_Lim.DFC_Fan4WinErr4_CA "/" VAL_BLK 0x800772F4 ValA_Wu16 8192. DINH_LimDFCVerb 12079. 20271. FORMAT "%2.0" NUMBER 5 /end CHARACTERISTIC
/begin CHARACTERISTIC DINH_Lim.DFC_FanSCG_CA "/" VAL_BLK 0x800772FE ValA_Wu16 8192. DINH_LimDFCVerb 12079. 20271. FORMAT "%2.0" NUMBER 5 /end CHARACTERISTIC
/begin CHARACTERISTIC DINH_Lim.DFC_PCRGovDvtLPMax_CA "/" VAL_BLK 0x80077308 ValA_Wu16 8192. DINH_LimDFCVerb 12079. 20271. FORMAT "%2.0" NUMBER 6 /end CHARACTERISTIC
/begin CHARACTERISTIC DINH_Lim.DFC_PCRGovDvtLPMin_CA "/" VAL_BLK 0x80077314 ValA_Wu16 8192. DINH_LimDFCVerb 12079. 20271. FORMAT "%2.0" NUMBER 6 /end CHARACTERISTIC
/begin CHARACTERISTIC DINH_Lim.DFC_PCRGovDvtMax_CA "/" VAL_BLK 0x80077320 ValA_Wu16 8192. DINH_LimDFCVerb 12079. 20271. FORMAT "%2.0" NUMBER 8 /end CHARACTERISTIC
/begin CHARACTERISTIC DINH_Lim.DFC_PCRGovDvtMin_CA "/" VAL_BLK 0x80077330 ValA_Wu16 8192. DINH_LimDFCVerb 12079. 20271. FORMAT "%2.0" NUMBER 8 /end CHARACTERISTIC
/begin CHARACTERISTIC DINH_Lim.DFC_RailCPC1_CA "/" VAL_BLK 0x80077340 ValA_Wu16 8192. DINH_LimDFCVerb 12079. 20271. FORMAT "%2.0" NUMBER 6 /end CHARACTERISTIC
/begin CHARACTERISTIC DINH_Lim.DFC_RailCPC3_CA "/" VAL_BLK 0x8007734C ValA_Wu16 8192. DINH_LimDFCVerb 12079. 20271. FORMAT "%2.0" NUMBER 5 /end CHARACTERISTIC
/begin CHARACTERISTIC DINH_Lim.DFC_RailCPC4_CA "/" VAL_BLK 0x80077356 ValA_Wu16 8192. DINH_LimDFCVerb 12079. 20271. FORMAT "%2.0" NUMBER 5 /end CHARACTERISTIC
/begin CHARACTERISTIC DINH_Lim.DFC_RailMeUn0_CA "/" VAL_BLK 0x80077360 ValA_Wu16 8192. DINH_LimDFCVerb 12079. 20271. FORMAT "%2.0" NUMBER 15 /end CHARACTERISTIC
/begin CHARACTERISTIC DINH_Lim.DFC_RailMeUn1_CA "/" VAL_BLK 0x8007737E ValA_Wu16 8192. DINH_LimDFCVerb 12079. 20271. FORMAT "%2.0" NUMBER 13 /end CHARACTERISTIC
/begin CHARACTERISTIC DINH_Lim.DFC_RailMeUn2_CA "/" VAL_BLK 0x80077398 ValA_Wu16 8192. DINH_LimDFCVerb 12079. 20271. FORMAT "%2.0" NUMBER 14 /end CHARACTERISTIC
/begin CHARACTERISTIC DINH_Lim.DFC_RailMeUn3_CA "/" VAL_BLK 0x800773B4 ValA_Wu16 8192. DINH_LimDFCVerb 12079. 20271. FORMAT "%2.0" NUMBER 16 /end CHARACTERISTIC
/begin CHARACTERISTIC DINH_Lim.DFC_RailMeUn4_CA "/" VAL_BLK 0x800773D4 ValA_Wu16 8192. DINH_LimDFCVerb 12079. 20271. FORMAT "%2.0" NUMBER 14 /end CHARACTERISTIC
/begin CHARACTERISTIC DINH_Lim.DFC_RailPCV0_CA "/" VAL_BLK 0x800773F0 ValA_Wu16 8192. DINH_LimDFCVerb 12079. 20271. FORMAT "%2.0" NUMBER 17 /end CHARACTERISTIC
/begin CHARACTERISTIC DINH_Lim.DFC_RailPCV1_CA "/" VAL_BLK 0x80077412 ValA_Wu16 8192. DINH_LimDFCVerb 12079. 20271. FORMAT "%2.0" NUMBER 14 /end CHARACTERISTIC
/begin CHARACTERISTIC DINH_Lim.DFC_RailPCV2_CA "/" VAL_BLK 0x8007742E ValA_Wu16 8192. DINH_LimDFCVerb 12079. 20271. FORMAT "%2.0" NUMBER 14 /end CHARACTERISTIC
/begin CHARACTERISTIC DINH_Lim.DFC_RailPCV3_CA "/" VAL_BLK 0x8007744A ValA_Wu16 8192. DINH_LimDFCVerb 12079. 20271. FORMAT "%2.0" NUMBER 16 /end CHARACTERISTIC
/begin CHARACTERISTIC DINH_Lim.DFC_RailPCV4_CA "/" VAL_BLK 0x8007746A ValA_Wu16 8192. DINH_LimDFCVerb 12079. 20271. FORMAT "%2.0" NUMBER 14 /end CHARACTERISTIC
/begin CHARACTERISTIC DINH_Lim.DFC_RailPMonStrt_CA "/" VAL_BLK 0x80077486 ValA_Wu16 8192. DINH_LimDFCVerb 12079. 20271. FORMAT "%2.0" NUMBER 5 /end CHARACTERISTIC
/begin CHARACTERISTIC DINH_Lim.DFC_SSpMon1_CA "/" VAL_BLK 0x80077490 ValA_Wu16 8192. DINH_LimDFCVerb 12079. 20271. FORMAT "%2.0" NUMBER 10 /end CHARACTERISTIC
/begin CHARACTERISTIC DINH_Lim.DFC_SSpMon2_CA "/" VAL_BLK 0x800774A4 ValA_Wu16 8192. DINH_LimDFCVerb 12079. 20271. FORMAT "%2.0" NUMBER 8 /end CHARACTERISTIC
/begin CHARACTERISTIC DINH_Lim.DFC_SSpMon3_CA "/" VAL_BLK 0x800774B4 ValA_Wu16 8192. DINH_LimDFCVerb 12079. 20271. FORMAT "%2.0" NUMBER 8 /end CHARACTERISTIC
/begin CHARACTERISTIC DINH_Lim.DFC_Sia_E1_CA "/" VAL_BLK 0x800774C4 ValA_Wu16 8192. DINH_LimDFCVerb 12079. 20271. FORMAT "%2.0" NUMBER 5 /end CHARACTERISTIC
/begin CHARACTERISTIC DINH_Lim.DFC_Sia_E10_CA "/" VAL_BLK 0x800774CE ValA_Wu16 8192. DINH_LimDFCVerb 12079. 20271. FORMAT "%2.0" NUMBER 5 /end CHARACTERISTIC
/begin CHARACTERISTIC DINH_Lim.DFC_Sia_E11_CA "/" VAL_BLK 0x800774D8 ValA_Wu16 8192. DINH_LimDFCVerb 12079. 20271. FORMAT "%2.0" NUMBER 5 /end CHARACTERISTIC
/begin CHARACTERISTIC DINH_Lim.DFC_Sia_E12_CA "/" VAL_BLK 0x800774E2 ValA_Wu16 8192. DINH_LimDFCVerb 12079. 20271. FORMAT "%2.0" NUMBER 5 /end CHARACTERISTIC
/begin CHARACTERISTIC DINH_Lim.DFC_Sia_E13_CA "/" VAL_BLK 0x800774EC ValA_Wu16 8192. DINH_LimDFCVerb 12079. 20271. FORMAT "%2.0" NUMBER 5 /end CHARACTERISTIC
/begin CHARACTERISTIC DINH_Lim.DFC_Sia_E14_CA "/" VAL_BLK 0x800774F6 ValA_Wu16 8192. DINH_LimDFCVerb 12079. 20271. FORMAT "%2.0" NUMBER 5 /end CHARACTERISTIC
/begin CHARACTERISTIC DINH_Lim.DFC_Sia_E15_CA "/" VAL_BLK 0x80077500 ValA_Wu16 8192. DINH_LimDFCVerb 12079. 20271. FORMAT "%2.0" NUMBER 5 /end CHARACTERISTIC
/begin CHARACTERISTIC DINH_Lim.DFC_Sia_E2_CA "/" VAL_BLK 0x8007750A ValA_Wu16 8192. DINH_LimDFCVerb 12079. 20271. FORMAT "%2.0" NUMBER 5 /end CHARACTERISTIC
/begin CHARACTERISTIC DINH_Lim.DFC_Sia_E3_CA "/" VAL_BLK 0x80077514 ValA_Wu16 8192. DINH_LimDFCVerb 12079. 20271. FORMAT "%2.0" NUMBER 5 /end CHARACTERISTIC
/begin CHARACTERISTIC DINH_Lim.DFC_Sia_E4_CA "/" VAL_BLK 0x8007751E ValA_Wu16 8192. DINH_LimDFCVerb 12079. 20271. FORMAT "%2.0" NUMBER 5 /end CHARACTERISTIC
/begin CHARACTERISTIC DINH_Lim.DFC_Sia_E5_CA "/" VAL_BLK 0x80077528 ValA_Wu16 8192. DINH_LimDFCVerb 12079. 20271. FORMAT "%2.0" NUMBER 5 /end CHARACTERISTIC
/begin CHARACTERISTIC DINH_Lim.DFC_Sia_E6_CA "/" VAL_BLK 0x80077532 ValA_Wu16 8192. DINH_LimDFCVerb 12079. 20271. FORMAT "%2.0" NUMBER 5 /end CHARACTERISTIC
/begin CHARACTERISTIC DINH_Lim.DFC_Sia_E7_CA "/" VAL_BLK 0x8007753C ValA_Wu16 8192. DINH_LimDFCVerb 12079. 20271. FORMAT "%2.0" NUMBER 5 /end CHARACTERISTIC
/begin CHARACTERISTIC DINH_Lim.DFC_Sia_E8_CA "/" VAL_BLK 0x80077546 ValA_Wu16 8192. DINH_LimDFCVerb 12079. 20271. FORMAT "%2.0" NUMBER 5 /end CHARACTERISTIC
/begin CHARACTERISTIC DINH_Lim.DFC_Sia_E9_CA "/" VAL_BLK 0x80077550 ValA_Wu16 8192. DINH_LimDFCVerb 12079. 20271. FORMAT "%2.0" NUMBER 5 /end CHARACTERISTIC
/begin CHARACTERISTIC DINH_Lim.DFC_ThrVlv4WinErr1_CA "/" VAL_BLK 0x8007755A ValA_Wu16 8192. DINH_LimDFCVerb 12079. 20271. FORMAT "%2.0" NUMBER 5 /end CHARACTERISTIC
/begin CHARACTERISTIC DINH_Lim.DFC_ThrVlv4WinErr2_CA "/" VAL_BLK 0x80077564 ValA_Wu16 8192. DINH_LimDFCVerb 12079. 20271. FORMAT "%2.0" NUMBER 5 /end CHARACTERISTIC
/begin CHARACTERISTIC DINH_Lim.DFC_ThrVlv4WinErr3_CA "/" VAL_BLK 0x8007756E ValA_Wu16 8192. DINH_LimDFCVerb 12079. 20271. FORMAT "%2.0" NUMBER 5 /end CHARACTERISTIC
/begin CHARACTERISTIC DINH_Lim.DFC_ThrVlv4WinErr4_CA "/" VAL_BLK 0x80077578 ValA_Wu16 8192. DINH_LimDFCVerb 12079. 20271. FORMAT "%2.0" NUMBER 5 /end CHARACTERISTIC
/begin CHARACTERISTIC DINH_Lim.DFC_ThrVlvSCG_CA "/" VAL_BLK 0x80077582 ValA_Wu16 8192. DINH_LimDFCVerb 12079. 20271. FORMAT "%2.0" NUMBER 7 /end CHARACTERISTIC
/begin CHARACTERISTIC DINH_Lim.DFC_TrbCh4WinErr1_CA "/" VAL_BLK 0x80077590 ValA_Wu16 8192. DINH_LimDFCVerb 12079. 20271. FORMAT "%2.0" NUMBER 5 /end CHARACTERISTIC
/begin CHARACTERISTIC DINH_Lim.DFC_TrbCh4WinErr2_CA "/" VAL_BLK 0x8007759A ValA_Wu16 8192. DINH_LimDFCVerb 12079. 20271. FORMAT "%2.0" NUMBER 5 /end CHARACTERISTIC
/begin CHARACTERISTIC DINH_Lim.DFC_TrbCh4WinErr3_CA "/" VAL_BLK 0x800775A4 ValA_Wu16 8192. DINH_LimDFCVerb 12079. 20271. FORMAT "%2.0" NUMBER 5 /end CHARACTERISTIC
/begin CHARACTERISTIC DINH_Lim.DFC_TrbCh4WinErr4_CA "/" VAL_BLK 0x800775AE ValA_Wu16 8192. DINH_LimDFCVerb 12079. 20271. FORMAT "%2.0" NUMBER 5 /end CHARACTERISTIC
/begin CHARACTERISTIC DINH_Lim.DFC_TrbChSCG_CA "/" VAL_BLK 0x800775B8 ValA_Wu16 8192. DINH_LimDFCVerb 12079. 20271. FORMAT "%2.0" NUMBER 10 /end CHARACTERISTIC
/begin CHARACTERISTIC DINH_Lim.DFC_TrbChSRCMax_CA "/" VAL_BLK 0x800775CC ValA_Wu16 8192. DINH_LimDFCVerb 12079. 20271. FORMAT "%2.0" NUMBER 6 /end CHARACTERISTIC
/begin CHARACTERISTIC DINH_Lim.DFC_TrbChSRCMin_CA "/" VAL_BLK 0x800775D8 ValA_Wu16 8192. DINH_LimDFCVerb 12079. 20271. FORMAT "%2.0" NUMBER 6 /end CHARACTERISTIC
/begin CHARACTERISTIC DINH_Lim.DFC_WaHtEl4WinErr1_CA "/" VAL_BLK 0x800775E4 ValA_Wu16 8192. DINH_LimDFCVerb 12079. 20271. FORMAT "%2.0" NUMBER 5 /end CHARACTERISTIC
/begin CHARACTERISTIC DINH_Lim.DFC_WaHtEl4WinErr2_CA "/" VAL_BLK 0x800775EE ValA_Wu16 8192. DINH_LimDFCVerb 12079. 20271. FORMAT "%2.0" NUMBER 5 /end CHARACTERISTIC
/begin CHARACTERISTIC DINH_Lim.DFC_WaHtEl4WinErr3_CA "/" VAL_BLK 0x800775F8 ValA_Wu16 8192. DINH_LimDFCVerb 12079. 20271. FORMAT "%2.0" NUMBER 5 /end CHARACTERISTIC
/begin CHARACTERISTIC DINH_Lim.DFC_WaHtEl4WinErr4_CA "/" VAL_BLK 0x80077602 ValA_Wu16 8192. DINH_LimDFCVerb 12079. 20271. FORMAT "%2.0" NUMBER 5 /end CHARACTERISTIC
/begin CHARACTERISTIC DINH_Lim.DFC_WaHtElSCG_CA "/" VAL_BLK 0x8007760C ValA_Wu16 8192. DINH_LimDFCVerb 12079. 20271. FORMAT "%2.0" NUMBER 5 /end CHARACTERISTIC
/begin CHARACTERISTIC DINH_Lim.DFC_ETClbETFltMax_CA "/" VAL_BLK 0x80077616 ValA_Wu16 8192. DINH_LimDFCVerb 12079. 20271. FORMAT "%2.0" NUMBER 5 /end CHARACTERISTIC
/begin CHARACTERISTIC DINH_Lim.DFC_ETClbETFltMin_CA "/" VAL_BLK 0x80077620 ValA_Wu16 8192. DINH_LimDFCVerb 12079. 20271. FORMAT "%2.0" NUMBER 5 /end CHARACTERISTIC
/begin CHARACTERISTIC DINH_Lim.DFC_InjCrvInjLimChrgBal_CA "/" VAL_BLK 0x8007762A ValA_Wu16 8192. DINH_LimDFCVerb 12079. 20271. FORMAT "%2.0" NUMBER 5 /end CHARACTERISTIC
/begin CHARACTERISTIC DINH_Lim.DFC_InjCrvInjLimQntBal_CA "/" VAL_BLK 0x80077634 ValA_Wu16 8192. DINH_LimDFCVerb 12079. 20271. FORMAT "%2.0" NUMBER 5 /end CHARACTERISTIC
/begin CHARACTERISTIC DINH_Lim.DFC_InjCrvInjLimSys_CA "/" VAL_BLK 0x8007763E ValA_Wu16 8192. DINH_LimDFCVerb 12079. 20271. FORMAT "%2.0" NUMBER 5 /end CHARACTERISTIC
/begin CHARACTERISTIC DINH_Lim.DFC_InjCrvNumInjRtmLim_CA "/" VAL_BLK 0x80077648 ValA_Wu16 8192. DINH_LimDFCVerb 12079. 20271. FORMAT "%2.0" NUMBER 5 /end CHARACTERISTIC
/begin CHARACTERISTIC DINH_Lim.DFC_LSUHtCoupSig_0_CA "/" VAL_BLK 0x80077652 ValA_Wu16 8192. DINH_LimDFCVerb 12079. 20271. FORMAT "%2.0" NUMBER 7 /end CHARACTERISTIC
/begin CHARACTERISTIC DINH_Lim.DFC_LSUHtCoupSig_1_CA "/" VAL_BLK 0x80077660 ValA_Wu16 8192. DINH_LimDFCVerb 12079. 20271. FORMAT "%2.0" NUMBER 7 /end CHARACTERISTIC
/begin CHARACTERISTIC DINH_Lim.DFC_LSUHtCoupSig_2_CA "/" VAL_BLK 0x8007766E ValA_Wu16 8192. DINH_LimDFCVerb 12079. 20271. FORMAT "%2.0" NUMBER 5 /end CHARACTERISTIC
/begin CHARACTERISTIC DINH_Lim.DFC_LSUHtCoupSig_3_CA "/" VAL_BLK 0x80077678 ValA_Wu16 8192. DINH_LimDFCVerb 12079. 20271. FORMAT "%2.0" NUMBER 5 /end CHARACTERISTIC
/begin CHARACTERISTIC DINH_Lim.DFC_CtT_CA "/" VAL_BLK 0x80077682 ValA_Wu16 8192. DINH_LimDFCVerb 12079. 20271. FORMAT "%2.0" NUMBER 6 /end CHARACTERISTIC
/begin CHARACTERISTIC DINH_Lim.DFC_DSMDummy_CA "/" VAL_BLK 0x8007768E ValA_Wu16 8192. DINH_LimDFCVerb 12079. 20271. FORMAT "%2.0" NUMBER 5 /end CHARACTERISTIC
/begin CHARACTERISTIC DINH_Lim.DFC_MeUnOL_CA "/" VAL_BLK 0x80077698 ValA_Wu16 8192. DINH_LimDFCVerb 12079. 20271. FORMAT "%2.0" NUMBER 11 /end CHARACTERISTIC
/begin CHARACTERISTIC DINH_Lim.DFC_MeUnSCB_CA "/" VAL_BLK 0x800776AE ValA_Wu16 8192. DINH_LimDFCVerb 12079. 20271. FORMAT "%2.0" NUMBER 11 /end CHARACTERISTIC
/begin CHARACTERISTIC DINH_Lim.DFC_MeUnSRCMax_CA "/" VAL_BLK 0x800776C4 ValA_Wu16 8192. DINH_LimDFCVerb 12079. 20271. FORMAT "%2.0" NUMBER 7 /end CHARACTERISTIC
/begin CHARACTERISTIC DINH_Lim.DFC_MeUnSRCMin_CA "/" VAL_BLK 0x800776D2 ValA_Wu16 8192. DINH_LimDFCVerb 12079. 20271. FORMAT "%2.0" NUMBER 7 /end CHARACTERISTIC
/begin CHARACTERISTIC DINH_Lim.DFC_PCVOL_CA "/" VAL_BLK 0x800776E0 ValA_Wu16 8192. DINH_LimDFCVerb 12079. 20271. FORMAT "%2.0" NUMBER 11 /end CHARACTERISTIC
/begin CHARACTERISTIC DINH_Lim.DFC_PCVSCB_CA "/" VAL_BLK 0x800776F6 ValA_Wu16 8192. DINH_LimDFCVerb 12079. 20271. FORMAT "%2.0" NUMBER 11 /end CHARACTERISTIC
/begin CHARACTERISTIC DINH_Lim.DFC_PCVSRCMax_CA "/" VAL_BLK 0x8007770C ValA_Wu16 8192. DINH_LimDFCVerb 12079. 20271. FORMAT "%2.0" NUMBER 6 /end CHARACTERISTIC
/begin CHARACTERISTIC DINH_Lim.DFC_PCVSRCMin_CA "/" VAL_BLK 0x80077718 ValA_Wu16 8192. DINH_LimDFCVerb 12079. 20271. FORMAT "%2.0" NUMBER 6 /end CHARACTERISTIC
/begin CHARACTERISTIC DINH_Lim.DFC_RailPSRCMax_CA "/" VAL_BLK 0x80077724 ValA_Wu16 8192. DINH_LimDFCVerb 12079. 20271. FORMAT "%2.0" NUMBER 16 /end CHARACTERISTIC
/begin CHARACTERISTIC DINH_Lim.DFC_RailPSRCMin_CA "/" VAL_BLK 0x80077744 ValA_Wu16 8192. DINH_LimDFCVerb 12079. 20271. FORMAT "%2.0" NUMBER 16 /end CHARACTERISTIC
/begin CHARACTERISTIC DINH_Lim.DFC_IVActrVltgSRCMax_CA "/" VAL_BLK 0x80077764 ValA_Wu16 8192. DINH_LimDFCVerb 12079. 20271. FORMAT "%2.0" NUMBER 5 /end CHARACTERISTIC
/begin CHARACTERISTIC DINH_Lim.DFC_IVActrVltgSRCMin_CA "/" VAL_BLK 0x8007776E ValA_Wu16 8192. DINH_LimDFCVerb 12079. 20271. FORMAT "%2.0" NUMBER 5 /end CHARACTERISTIC
/begin CHARACTERISTIC DINH_Lim.DFC_IVPSplyDCDC_CA "/" VAL_BLK 0x80077778 ValA_Wu16 8192. DINH_LimDFCVerb 12079. 20271. FORMAT "%2.0" NUMBER 5 /end CHARACTERISTIC
/begin CHARACTERISTIC DINH_Lim.DFC_IVPSplyVltgSRCMax_CA "/" VAL_BLK 0x80077782 ValA_Wu16 8192. DINH_LimDFCVerb 12079. 20271. FORMAT "%2.0" NUMBER 5 /end CHARACTERISTIC
/begin CHARACTERISTIC DINH_Lim.DFC_IVPSplyVltgSRCMin_CA "/" VAL_BLK 0x8007778C ValA_Wu16 8192. DINH_LimDFCVerb 12079. 20271. FORMAT "%2.0" NUMBER 5 /end CHARACTERISTIC
/begin CHARACTERISTIC DINH_Lim.DFC_AFSOffsDrftMax_CA "/" VAL_BLK 0x80077796 ValA_Wu16 8192. DINH_LimDFCVerb 12079. 20271. FORMAT "%2.0" NUMBER 17 /end CHARACTERISTIC
/begin CHARACTERISTIC DINH_Lim.DFC_AFSOffsDrftMin_CA "/" VAL_BLK 0x800777B8 ValA_Wu16 8192. DINH_LimDFCVerb 12079. 20271. FORMAT "%2.0" NUMBER 17 /end CHARACTERISTIC
/begin CHARACTERISTIC DINH_Lim.DFC_AFSSRCCorMax_CA "/" VAL_BLK 0x800777DA ValA_Wu16 8192. DINH_LimDFCVerb 12079. 20271. FORMAT "%2.0" NUMBER 9 /end CHARACTERISTIC
/begin CHARACTERISTIC DINH_Lim.DFC_AFSSRCCorMin_CA "/" VAL_BLK 0x800777EC ValA_Wu16 8192. DINH_LimDFCVerb 12079. 20271. FORMAT "%2.0" NUMBER 9 /end CHARACTERISTIC
/begin CHARACTERISTIC DINH_Lim.DFC_AFSSRCRawMax_CA "/" VAL_BLK 0x800777FE ValA_Wu16 8192. DINH_LimDFCVerb 12079. 20271. FORMAT "%2.0" NUMBER 9 /end CHARACTERISTIC
/begin CHARACTERISTIC DINH_Lim.DFC_AFSSRCRawMin_CA "/" VAL_BLK 0x80077810 ValA_Wu16 8192. DINH_LimDFCVerb 12079. 20271. FORMAT "%2.0" NUMBER 9 /end CHARACTERISTIC
/begin CHARACTERISTIC DINH_Lim.DFC_AFSSetyDrftMax_CA "/" VAL_BLK 0x80077822 ValA_Wu16 8192. DINH_LimDFCVerb 12079. 20271. FORMAT "%2.0" NUMBER 18 /end CHARACTERISTIC
/begin CHARACTERISTIC DINH_Lim.DFC_AFSSetyDrftMin_CA "/" VAL_BLK 0x80077846 ValA_Wu16 8192. DINH_LimDFCVerb 12079. 20271. FORMAT "%2.0" NUMBER 18 /end CHARACTERISTIC
/begin CHARACTERISTIC DINH_Lim.DFC_AirCClntPAnaSRCMax_CA "/" VAL_BLK 0x8007786A ValA_Wu16 8192. DINH_LimDFCVerb 12079. 20271. FORMAT "%2.0" NUMBER 7 /end CHARACTERISTIC
/begin CHARACTERISTIC DINH_Lim.DFC_AirCClntPAnaSRCMin_CA "/" VAL_BLK 0x80077878 ValA_Wu16 8192. DINH_LimDFCVerb 12079. 20271. FORMAT "%2.0" NUMBER 7 /end CHARACTERISTIC
/begin CHARACTERISTIC DINH_Lim.DFC_AirCClntPPerSRCMax_CA "/" VAL_BLK 0x80077886 ValA_Wu16 8192. DINH_LimDFCVerb 12079. 20271. FORMAT "%2.0" NUMBER 6 /end CHARACTERISTIC
/begin CHARACTERISTIC DINH_Lim.DFC_AirCClntPPerSRCMin_CA "/" VAL_BLK 0x80077892 ValA_Wu16 8192. DINH_LimDFCVerb 12079. 20271. FORMAT "%2.0" NUMBER 6 /end CHARACTERISTIC
/begin CHARACTERISTIC DINH_Lim.DFC_AirCClntPdcycSRCMax_CA "/" VAL_BLK 0x8007789E ValA_Wu16 8192. DINH_LimDFCVerb 12079. 20271. FORMAT "%2.0" NUMBER 6 /end CHARACTERISTIC
/begin CHARACTERISTIC DINH_Lim.DFC_AirCClntPdcycSRCMin_CA "/" VAL_BLK 0x800778AA ValA_Wu16 8192. DINH_LimDFCVerb 12079. 20271. FORMAT "%2.0" NUMBER 6 /end CHARACTERISTIC
/begin CHARACTERISTIC DINH_Lim.DFC_AirCCmprOL_CA "/" VAL_BLK 0x800778B6 ValA_Wu16 8192. DINH_LimDFCVerb 12079. 20271. FORMAT "%2.0" NUMBER 5 /end CHARACTERISTIC
/begin CHARACTERISTIC DINH_Lim.DFC_AirCCmprRedTrqOL_CA "/" VAL_BLK 0x800778C0 ValA_Wu16 8192. DINH_LimDFCVerb 12079. 20271. FORMAT "%2.0" NUMBER 5 /end CHARACTERISTIC
/begin CHARACTERISTIC DINH_Lim.DFC_AirCCmprRedTrqSCB_CA "/" VAL_BLK 0x800778CA ValA_Wu16 8192. DINH_LimDFCVerb 12079. 20271. FORMAT "%2.0" NUMBER 5 /end CHARACTERISTIC
/begin CHARACTERISTIC DINH_Lim.DFC_AirCCmprRedTrqSCG_CA "/" VAL_BLK 0x800778D4 ValA_Wu16 8192. DINH_LimDFCVerb 12079. 20271. FORMAT "%2.0" NUMBER 5 /end CHARACTERISTIC
/begin CHARACTERISTIC DINH_Lim.DFC_AirCCmprSCB_CA "/" VAL_BLK 0x800778DE ValA_Wu16 8192. DINH_LimDFCVerb 12079. 20271. FORMAT "%2.0" NUMBER 5 /end CHARACTERISTIC
/begin CHARACTERISTIC DINH_Lim.DFC_AirCCmprSCG_CA "/" VAL_BLK 0x800778E8 ValA_Wu16 8192. DINH_LimDFCVerb 12079. 20271. FORMAT "%2.0" NUMBER 5 /end CHARACTERISTIC
/begin CHARACTERISTIC DINH_Lim.DFC_AirCSwtNpl_CA "/" VAL_BLK 0x800778F2 ValA_Wu16 8192. DINH_LimDFCVerb 12079. 20271. FORMAT "%2.0" NUMBER 6 /end CHARACTERISTIC
/begin CHARACTERISTIC DINH_Lim.DFC_AirCSwtSig_CA "/" VAL_BLK 0x800778FE ValA_Wu16 8192. DINH_LimDFCVerb 12079. 20271. FORMAT "%2.0" NUMBER 6 /end CHARACTERISTIC
/begin CHARACTERISTIC DINH_Lim.DFC_BattUSRCMax_CA "/" VAL_BLK 0x8007790A ValA_Wu16 8192. DINH_LimDFCVerb 12079. 20271. FORMAT "%2.0" NUMBER 10 /end CHARACTERISTIC
/begin CHARACTERISTIC DINH_Lim.DFC_BattUSRCMin_CA "/" VAL_BLK 0x8007791E ValA_Wu16 8192. DINH_LimDFCVerb 12079. 20271. FORMAT "%2.0" NUMBER 10 /end CHARACTERISTIC
/begin CHARACTERISTIC DINH_Lim.DFC_BrkNpl_CA "/" VAL_BLK 0x80077932 ValA_Wu16 8192. DINH_LimDFCVerb 12079. 20271. FORMAT "%2.0" NUMBER 9 /end CHARACTERISTIC
/begin CHARACTERISTIC DINH_Lim.DFC_BrkPSRCMax_CA "/" VAL_BLK 0x80077944 ValA_Wu16 8192. DINH_LimDFCVerb 12079. 20271. FORMAT "%2.0" NUMBER 8 /end CHARACTERISTIC
/begin CHARACTERISTIC DINH_Lim.DFC_BrkPSRCMin_CA "/" VAL_BLK 0x80077954 ValA_Wu16 8192. DINH_LimDFCVerb 12079. 20271. FORMAT "%2.0" NUMBER 8 /end CHARACTERISTIC
/begin CHARACTERISTIC DINH_Lim.DFC_BrkSig_CA "/" VAL_BLK 0x80077964 ValA_Wu16 8192. DINH_LimDFCVerb 12079. 20271. FORMAT "%2.0" NUMBER 8 /end CHARACTERISTIC
/begin CHARACTERISTIC DINH_Lim.DFC_CByVlvOL_CA "/" VAL_BLK 0x80077974 ValA_Wu16 8192. DINH_LimDFCVerb 12079. 20271. FORMAT "%2.0" NUMBER 5 /end CHARACTERISTIC
/begin CHARACTERISTIC DINH_Lim.DFC_CByVlvSCB_CA "/" VAL_BLK 0x8007797E ValA_Wu16 8192. DINH_LimDFCVerb 12079. 20271. FORMAT "%2.0" NUMBER 5 /end CHARACTERISTIC
/begin CHARACTERISTIC DINH_Lim.DFC_CByVlvSCG_CA "/" VAL_BLK 0x80077988 ValA_Wu16 8192. DINH_LimDFCVerb 12079. 20271. FORMAT "%2.0" NUMBER 5 /end CHARACTERISTIC
/begin CHARACTERISTIC DINH_Lim.DFC_CEngDsTSRCMax_CA "/" VAL_BLK 0x80077992 ValA_Wu16 8192. DINH_LimDFCVerb 12079. 20271. FORMAT "%2.0" NUMBER 20 /end CHARACTERISTIC
/begin CHARACTERISTIC DINH_Lim.DFC_CEngDsTSRCMin_CA "/" VAL_BLK 0x800779BA ValA_Wu16 8192. DINH_LimDFCVerb 12079. 20271. FORMAT "%2.0" NUMBER 20 /end CHARACTERISTIC
/begin CHARACTERISTIC DINH_Lim.DFC_CEngDsTSig_CA "/" VAL_BLK 0x800779E2 ValA_Wu16 8192. DINH_LimDFCVerb 12079. 20271. FORMAT "%2.0" NUMBER 7 /end CHARACTERISTIC
/begin CHARACTERISTIC DINH_Lim.DFC_CEngUsTSRCMax_CA "/" VAL_BLK 0x800779F0 ValA_Wu16 8192. DINH_LimDFCVerb 12079. 20271. FORMAT "%2.0" NUMBER 7 /end CHARACTERISTIC
/begin CHARACTERISTIC DINH_Lim.DFC_CEngUsTSRCMin_CA "/" VAL_BLK 0x800779FE ValA_Wu16 8192. DINH_LimDFCVerb 12079. 20271. FORMAT "%2.0" NUMBER 7 /end CHARACTERISTIC
/begin CHARACTERISTIC DINH_Lim.DFC_CThmstOL_CA "/" VAL_BLK 0x80077A0C ValA_Wu16 8192. DINH_LimDFCVerb 12079. 20271. FORMAT "%2.0" NUMBER 5 /end CHARACTERISTIC
/begin CHARACTERISTIC DINH_Lim.DFC_CThmstSCB_CA "/" VAL_BLK 0x80077A16 ValA_Wu16 8192. DINH_LimDFCVerb 12079. 20271. FORMAT "%2.0" NUMBER 5 /end CHARACTERISTIC
/begin CHARACTERISTIC DINH_Lim.DFC_CThmstSCG_CA "/" VAL_BLK 0x80077A20 ValA_Wu16 8192. DINH_LimDFCVerb 12079. 20271. FORMAT "%2.0" NUMBER 5 /end CHARACTERISTIC
/begin CHARACTERISTIC DINH_Lim.DFC_ClthSig_CA "/" VAL_BLK 0x80077A2A ValA_Wu16 8192. DINH_LimDFCVerb 12079. 20271. FORMAT "%2.0" NUMBER 11 /end CHARACTERISTIC
/begin CHARACTERISTIC DINH_Lim.DFC_ECBVlvOL_CA "/" VAL_BLK 0x80077A40 ValA_Wu16 8192. DINH_LimDFCVerb 12079. 20271. FORMAT "%2.0" NUMBER 5 /end CHARACTERISTIC
/begin CHARACTERISTIC DINH_Lim.DFC_ECBVlvSCB_CA "/" VAL_BLK 0x80077A4A ValA_Wu16 8192. DINH_LimDFCVerb 12079. 20271. FORMAT "%2.0" NUMBER 5 /end CHARACTERISTIC
/begin CHARACTERISTIC DINH_Lim.DFC_ECBVlvSCG_CA "/" VAL_BLK 0x80077A54 ValA_Wu16 8192. DINH_LimDFCVerb 12079. 20271. FORMAT "%2.0" NUMBER 5 /end CHARACTERISTIC
/begin CHARACTERISTIC DINH_Lim.DFC_ECBVlvSRCMax_CA "/" VAL_BLK 0x80077A5E ValA_Wu16 8192. DINH_LimDFCVerb 12079. 20271. FORMAT "%2.0" NUMBER 7 /end CHARACTERISTIC
/begin CHARACTERISTIC DINH_Lim.DFC_ECBVlvSRCMin_CA "/" VAL_BLK 0x80077A6C ValA_Wu16 8192. DINH_LimDFCVerb 12079. 20271. FORMAT "%2.0" NUMBER 7 /end CHARACTERISTIC
/begin CHARACTERISTIC DINH_Lim.DFC_EGRVlvGovDvtMax_CA "/" VAL_BLK 0x80077A7A ValA_Wu16 8192. DINH_LimDFCVerb 12079. 20271. FORMAT "%2.0" NUMBER 5 /end CHARACTERISTIC
/begin CHARACTERISTIC DINH_Lim.DFC_EGRVlvGovDvtMin_CA "/" VAL_BLK 0x80077A84 ValA_Wu16 8192. DINH_LimDFCVerb 12079. 20271. FORMAT "%2.0" NUMBER 5 /end CHARACTERISTIC
/begin CHARACTERISTIC DINH_Lim.DFC_EGRVlvOL_CA "/" VAL_BLK 0x80077A8E ValA_Wu16 8192. DINH_LimDFCVerb 12079. 20271. FORMAT "%2.0" NUMBER 9 /end CHARACTERISTIC
/begin CHARACTERISTIC DINH_Lim.DFC_EGRVlvSCB_CA "/" VAL_BLK 0x80077AA0 ValA_Wu16 8192. DINH_LimDFCVerb 12079. 20271. FORMAT "%2.0" NUMBER 9 /end CHARACTERISTIC
/begin CHARACTERISTIC DINH_Lim.DFC_EGRVlvSCG_CA "/" VAL_BLK 0x80077AB2 ValA_Wu16 8192. DINH_LimDFCVerb 12079. 20271. FORMAT "%2.0" NUMBER 13 /end CHARACTERISTIC
/begin CHARACTERISTIC DINH_Lim.DFC_EGRVlvSRCMax_CA "/" VAL_BLK 0x80077ACC ValA_Wu16 8192. DINH_LimDFCVerb 12079. 20271. FORMAT "%2.0" NUMBER 9 /end CHARACTERISTIC
/begin CHARACTERISTIC DINH_Lim.DFC_EGRVlvSRCMin_CA "/" VAL_BLK 0x80077ADE ValA_Wu16 8192. DINH_LimDFCVerb 12079. 20271. FORMAT "%2.0" NUMBER 9 /end CHARACTERISTIC
/begin CHARACTERISTIC DINH_Lim.DFC_EMDmpOL_0_CA "/" VAL_BLK 0x80077AF0 ValA_Wu16 8192. DINH_LimDFCVerb 12079. 20271. FORMAT "%2.0" NUMBER 5 /end CHARACTERISTIC
/begin CHARACTERISTIC DINH_Lim.DFC_EMDmpOL_1_CA "/" VAL_BLK 0x80077AFA ValA_Wu16 8192. DINH_LimDFCVerb 12079. 20271. FORMAT "%2.0" NUMBER 5 /end CHARACTERISTIC
/begin CHARACTERISTIC DINH_Lim.DFC_EMDmpSCB_0_CA "/" VAL_BLK 0x80077B04 ValA_Wu16 8192. DINH_LimDFCVerb 12079. 20271. FORMAT "%2.0" NUMBER 5 /end CHARACTERISTIC
/begin CHARACTERISTIC DINH_Lim.DFC_EMDmpSCB_1_CA "/" VAL_BLK 0x80077B0E ValA_Wu16 8192. DINH_LimDFCVerb 12079. 20271. FORMAT "%2.0" NUMBER 5 /end CHARACTERISTIC
/begin CHARACTERISTIC DINH_Lim.DFC_EMDmpSCG_0_CA "/" VAL_BLK 0x80077B18 ValA_Wu16 8192. DINH_LimDFCVerb 12079. 20271. FORMAT "%2.0" NUMBER 5 /end CHARACTERISTIC
/begin CHARACTERISTIC DINH_Lim.DFC_EMDmpSCG_1_CA "/" VAL_BLK 0x80077B22 ValA_Wu16 8192. DINH_LimDFCVerb 12079. 20271. FORMAT "%2.0" NUMBER 5 /end CHARACTERISTIC
/begin CHARACTERISTIC DINH_Lim.DFC_EngStAOL_CA "/" VAL_BLK 0x80077B2C ValA_Wu16 8192. DINH_LimDFCVerb 12079. 20271. FORMAT "%2.0" NUMBER 5 /end CHARACTERISTIC
/begin CHARACTERISTIC DINH_Lim.DFC_EngStASCB_CA "/" VAL_BLK 0x80077B36 ValA_Wu16 8192. DINH_LimDFCVerb 12079. 20271. FORMAT "%2.0" NUMBER 5 /end CHARACTERISTIC
/begin CHARACTERISTIC DINH_Lim.DFC_EngStASCG_CA "/" VAL_BLK 0x80077B40 ValA_Wu16 8192. DINH_LimDFCVerb 12079. 20271. FORMAT "%2.0" NUMBER 5 /end CHARACTERISTIC
/begin CHARACTERISTIC DINH_Lim.DFC_EnvPSRCMax_CA "/" VAL_BLK 0x80077B4A ValA_Wu16 8192. DINH_LimDFCVerb 12079. 20271. FORMAT "%2.0" NUMBER 17 /end CHARACTERISTIC
/begin CHARACTERISTIC DINH_Lim.DFC_EnvPSRCMin_CA "/" VAL_BLK 0x80077B6C ValA_Wu16 8192. DINH_LimDFCVerb 12079. 20271. FORMAT "%2.0" NUMBER 17 /end CHARACTERISTIC
/begin CHARACTERISTIC DINH_Lim.DFC_EnvPSig_CA "/" VAL_BLK 0x80077B8E ValA_Wu16 8192. DINH_LimDFCVerb 12079. 20271. FORMAT "%2.0" NUMBER 7 /end CHARACTERISTIC
/begin CHARACTERISTIC DINH_Lim.DFC_EnvTSRCMax_CA "/" VAL_BLK 0x80077B9C ValA_Wu16 8192. DINH_LimDFCVerb 12079. 20271. FORMAT "%2.0" NUMBER 16 /end CHARACTERISTIC
/begin CHARACTERISTIC DINH_Lim.DFC_EnvTSRCMin_CA "/" VAL_BLK 0x80077BBC ValA_Wu16 8192. DINH_LimDFCVerb 12079. 20271. FORMAT "%2.0" NUMBER 16 /end CHARACTERISTIC
/begin CHARACTERISTIC DINH_Lim.DFC_FanOL_CA "/" VAL_BLK 0x80077BDC ValA_Wu16 8192. DINH_LimDFCVerb 12079. 20271. FORMAT "%2.0" NUMBER 5 /end CHARACTERISTIC
/begin CHARACTERISTIC DINH_Lim.DFC_FanSCB_CA "/" VAL_BLK 0x80077BE6 ValA_Wu16 8192. DINH_LimDFCVerb 12079. 20271. FORMAT "%2.0" NUMBER 5 /end CHARACTERISTIC
/begin CHARACTERISTIC DINH_Lim.DFC_FlFltSig_CA "/" VAL_BLK 0x80077BF0 ValA_Wu16 8192. DINH_LimDFCVerb 12079. 20271. FORMAT "%2.0" NUMBER 5 /end CHARACTERISTIC
/begin CHARACTERISTIC DINH_Lim.DFC_FuelTSRCMax_CA "/" VAL_BLK 0x80077BFA ValA_Wu16 8192. DINH_LimDFCVerb 12079. 20271. FORMAT "%2.0" NUMBER 10 /end CHARACTERISTIC
/begin CHARACTERISTIC DINH_Lim.DFC_FuelTSRCMin_CA "/" VAL_BLK 0x80077C0E ValA_Wu16 8192. DINH_LimDFCVerb 12079. 20271. FORMAT "%2.0" NUMBER 10 /end CHARACTERISTIC
/begin CHARACTERISTIC DINH_Lim.DFC_GbxNPosPPerSRCMax_CA "/" VAL_BLK 0x80077C22 ValA_Wu16 8192. DINH_LimDFCVerb 12079. 20271. FORMAT "%2.0" NUMBER 6 /end CHARACTERISTIC
/begin CHARACTERISTIC DINH_Lim.DFC_GbxNPosPPerSRCMin_CA "/" VAL_BLK 0x80077C2E ValA_Wu16 8192. DINH_LimDFCVerb 12079. 20271. FORMAT "%2.0" NUMBER 6 /end CHARACTERISTIC
/begin CHARACTERISTIC DINH_Lim.DFC_GbxNPosPdcycSRCMax_CA "/" VAL_BLK 0x80077C3A ValA_Wu16 8192. DINH_LimDFCVerb 12079. 20271. FORMAT "%2.0" NUMBER 6 /end CHARACTERISTIC
/begin CHARACTERISTIC DINH_Lim.DFC_GbxNPosPdcycSRCMin_CA "/" VAL_BLK 0x80077C46 ValA_Wu16 8192. DINH_LimDFCVerb 12079. 20271. FORMAT "%2.0" NUMBER 6 /end CHARACTERISTIC
/begin CHARACTERISTIC DINH_Lim.DFC_GbxNPosSig_CA "/" VAL_BLK 0x80077C52 ValA_Wu16 8192. DINH_LimDFCVerb 12079. 20271. FORMAT "%2.0" NUMBER 6 /end CHARACTERISTIC
/begin CHARACTERISTIC DINH_Lim.DFC_GlwPlgBSDOL_0_CA "/" VAL_BLK 0x80077C5E ValA_Wu16 8192. DINH_LimDFCVerb 12079. 20271. FORMAT "%2.0" NUMBER 5 /end CHARACTERISTIC
/begin CHARACTERISTIC DINH_Lim.DFC_GlwPlgBSDOL_1_CA "/" VAL_BLK 0x80077C68 ValA_Wu16 8192. DINH_LimDFCVerb 12079. 20271. FORMAT "%2.0" NUMBER 5 /end CHARACTERISTIC
/begin CHARACTERISTIC DINH_Lim.DFC_GlwPlgBSDOL_2_CA "/" VAL_BLK 0x80077C72 ValA_Wu16 8192. DINH_LimDFCVerb 12079. 20271. FORMAT "%2.0" NUMBER 5 /end CHARACTERISTIC
/begin CHARACTERISTIC DINH_Lim.DFC_GlwPlgBSDOL_3_CA "/" VAL_BLK 0x80077C7C ValA_Wu16 8192. DINH_LimDFCVerb 12079. 20271. FORMAT "%2.0" NUMBER 5 /end CHARACTERISTIC
/begin CHARACTERISTIC DINH_Lim.DFC_GlwPlgBSDOL_4_CA "/" VAL_BLK 0x80077C86 ValA_Wu16 8192. DINH_LimDFCVerb 12079. 20271. FORMAT "%2.0" NUMBER 5 /end CHARACTERISTIC
/begin CHARACTERISTIC DINH_Lim.DFC_GlwPlgBSDOL_5_CA "/" VAL_BLK 0x80077C90 ValA_Wu16 8192. DINH_LimDFCVerb 12079. 20271. FORMAT "%2.0" NUMBER 5 /end CHARACTERISTIC
/begin CHARACTERISTIC DINH_Lim.DFC_GlwPlgBSDOL_6_CA "/" VAL_BLK 0x80077C9A ValA_Wu16 8192. DINH_LimDFCVerb 12079. 20271. FORMAT "%2.0" NUMBER 5 /end CHARACTERISTIC
/begin CHARACTERISTIC DINH_Lim.DFC_GlwPlgBSDOL_7_CA "/" VAL_BLK 0x80077CA4 ValA_Wu16 8192. DINH_LimDFCVerb 12079. 20271. FORMAT "%2.0" NUMBER 5 /end CHARACTERISTIC
/begin CHARACTERISTIC DINH_Lim.DFC_GlwPlgBSDOT_0_CA "/" VAL_BLK 0x80077CAE ValA_Wu16 8192. DINH_LimDFCVerb 12079. 20271. FORMAT "%2.0" NUMBER 5 /end CHARACTERISTIC
/begin CHARACTERISTIC DINH_Lim.DFC_GlwPlgBSDOT_1_CA "/" VAL_BLK 0x80077CB8 ValA_Wu16 8192. DINH_LimDFCVerb 12079. 20271. FORMAT "%2.0" NUMBER 5 /end CHARACTERISTIC
/begin CHARACTERISTIC DINH_Lim.DFC_GlwPlgBSDOT_2_CA "/" VAL_BLK 0x80077CC2 ValA_Wu16 8192. DINH_LimDFCVerb 12079. 20271. FORMAT "%2.0" NUMBER 5 /end CHARACTERISTIC
/begin CHARACTERISTIC DINH_Lim.DFC_GlwPlgBSDOT_3_CA "/" VAL_BLK 0x80077CCC ValA_Wu16 8192. DINH_LimDFCVerb 12079. 20271. FORMAT "%2.0" NUMBER 5 /end CHARACTERISTIC
/begin CHARACTERISTIC DINH_Lim.DFC_GlwPlgBSDOT_4_CA "/" VAL_BLK 0x80077CD6 ValA_Wu16 8192. DINH_LimDFCVerb 12079. 20271. FORMAT "%2.0" NUMBER 5 /end CHARACTERISTIC
/begin CHARACTERISTIC DINH_Lim.DFC_GlwPlgBSDOT_5_CA "/" VAL_BLK 0x80077CE0 ValA_Wu16 8192. DINH_LimDFCVerb 12079. 20271. FORMAT "%2.0" NUMBER 5 /end CHARACTERISTIC
/begin CHARACTERISTIC DINH_Lim.DFC_GlwPlgBSDOT_6_CA "/" VAL_BLK 0x80077CEA ValA_Wu16 8192. DINH_LimDFCVerb 12079. 20271. FORMAT "%2.0" NUMBER 5 /end CHARACTERISTIC
/begin CHARACTERISTIC DINH_Lim.DFC_GlwPlgBSDOT_7_CA "/" VAL_BLK 0x80077CF4 ValA_Wu16 8192. DINH_LimDFCVerb 12079. 20271. FORMAT "%2.0" NUMBER 5 /end CHARACTERISTIC
/begin CHARACTERISTIC DINH_Lim.DFC_GlwPlgBSDSC_0_CA "/" VAL_BLK 0x80077CFE ValA_Wu16 8192. DINH_LimDFCVerb 12079. 20271. FORMAT "%2.0" NUMBER 5 /end CHARACTERISTIC
/begin CHARACTERISTIC DINH_Lim.DFC_GlwPlgBSDSC_1_CA "/" VAL_BLK 0x80077D08 ValA_Wu16 8192. DINH_LimDFCVerb 12079. 20271. FORMAT "%2.0" NUMBER 5 /end CHARACTERISTIC
/begin CHARACTERISTIC DINH_Lim.DFC_GlwPlgBSDSC_2_CA "/" VAL_BLK 0x80077D12 ValA_Wu16 8192. DINH_LimDFCVerb 12079. 20271. FORMAT "%2.0" NUMBER 5 /end CHARACTERISTIC
/begin CHARACTERISTIC DINH_Lim.DFC_GlwPlgBSDSC_3_CA "/" VAL_BLK 0x80077D1C ValA_Wu16 8192. DINH_LimDFCVerb 12079. 20271. FORMAT "%2.0" NUMBER 5 /end CHARACTERISTIC
/begin CHARACTERISTIC DINH_Lim.DFC_GlwPlgBSDSC_4_CA "/" VAL_BLK 0x80077D26 ValA_Wu16 8192. DINH_LimDFCVerb 12079. 20271. FORMAT "%2.0" NUMBER 5 /end CHARACTERISTIC
/begin CHARACTERISTIC DINH_Lim.DFC_GlwPlgBSDSC_5_CA "/" VAL_BLK 0x80077D30 ValA_Wu16 8192. DINH_LimDFCVerb 12079. 20271. FORMAT "%2.0" NUMBER 5 /end CHARACTERISTIC
/begin CHARACTERISTIC DINH_Lim.DFC_GlwPlgBSDSC_6_CA "/" VAL_BLK 0x80077D3A ValA_Wu16 8192. DINH_LimDFCVerb 12079. 20271. FORMAT "%2.0" NUMBER 5 /end CHARACTERISTIC
/begin CHARACTERISTIC DINH_Lim.DFC_GlwPlgBSDSC_7_CA "/" VAL_BLK 0x80077D44 ValA_Wu16 8192. DINH_LimDFCVerb 12079. 20271. FORMAT "%2.0" NUMBER 5 /end CHARACTERISTIC
/begin CHARACTERISTIC DINH_Lim.DFC_GlwPlgComErr_CA "/" VAL_BLK 0x80077D4E ValA_Wu16 8192. DINH_LimDFCVerb 12079. 20271. FORMAT "%2.0" NUMBER 5 /end CHARACTERISTIC
/begin CHARACTERISTIC DINH_Lim.DFC_InjVlvPresMin_CA "/" VAL_BLK 0x80077D58 ValA_Wu16 8192. DINH_LimDFCVerb 12079. 20271. FORMAT "%2.0" NUMBER 5 /end CHARACTERISTIC
/begin CHARACTERISTIC DINH_Lim.DFC_LSUCircNernstMax_0_CA "/" VAL_BLK 0x80077D62 ValA_Wu16 8192. DINH_LimDFCVerb 12079. 20271. FORMAT "%2.0" NUMBER 10 /end CHARACTERISTIC
/begin CHARACTERISTIC DINH_Lim.DFC_LSUCircNernstMax_1_CA "/" VAL_BLK 0x80077D76 ValA_Wu16 8192. DINH_LimDFCVerb 12079. 20271. FORMAT "%2.0" NUMBER 10 /end CHARACTERISTIC
/begin CHARACTERISTIC DINH_Lim.DFC_LSUCircNernstMax_2_CA "/" VAL_BLK 0x80077D8A ValA_Wu16 8192. DINH_LimDFCVerb 12079. 20271. FORMAT "%2.0" NUMBER 5 /end CHARACTERISTIC
/begin CHARACTERISTIC DINH_Lim.DFC_LSUCircNernstMax_3_CA "/" VAL_BLK 0x80077D94 ValA_Wu16 8192. DINH_LimDFCVerb 12079. 20271. FORMAT "%2.0" NUMBER 5 /end CHARACTERISTIC
/begin CHARACTERISTIC DINH_Lim.DFC_LSUCircNernstMin_0_CA "/" VAL_BLK 0x80077D9E ValA_Wu16 8192. DINH_LimDFCVerb 12079. 20271. FORMAT "%2.0" NUMBER 10 /end CHARACTERISTIC
/begin CHARACTERISTIC DINH_Lim.DFC_LSUCircNernstMin_1_CA "/" VAL_BLK 0x80077DB2 ValA_Wu16 8192. DINH_LimDFCVerb 12079. 20271. FORMAT "%2.0" NUMBER 10 /end CHARACTERISTIC
/begin CHARACTERISTIC DINH_Lim.DFC_LSUCircNernstMin_2_CA "/" VAL_BLK 0x80077DC6 ValA_Wu16 8192. DINH_LimDFCVerb 12079. 20271. FORMAT "%2.0" NUMBER 5 /end CHARACTERISTIC
/begin CHARACTERISTIC DINH_Lim.DFC_LSUCircNernstMin_3_CA "/" VAL_BLK 0x80077DD0 ValA_Wu16 8192. DINH_LimDFCVerb 12079. 20271. FORMAT "%2.0" NUMBER 5 /end CHARACTERISTIC
/begin CHARACTERISTIC DINH_Lim.DFC_LSUCircNernstSig_0_CA "/" VAL_BLK 0x80077DDA ValA_Wu16 8192. DINH_LimDFCVerb 12079. 20271. FORMAT "%2.0" NUMBER 10 /end CHARACTERISTIC
/begin CHARACTERISTIC DINH_Lim.DFC_LSUCircNernstSig_1_CA "/" VAL_BLK 0x80077DEE ValA_Wu16 8192. DINH_LimDFCVerb 12079. 20271. FORMAT "%2.0" NUMBER 10 /end CHARACTERISTIC
/begin CHARACTERISTIC DINH_Lim.DFC_LSUCircNernstSig_2_CA "/" VAL_BLK 0x80077E02 ValA_Wu16 8192. DINH_LimDFCVerb 12079. 20271. FORMAT "%2.0" NUMBER 5 /end CHARACTERISTIC
/begin CHARACTERISTIC DINH_Lim.DFC_LSUCircNernstSig_3_CA "/" VAL_BLK 0x80077E0C ValA_Wu16 8192. DINH_LimDFCVerb 12079. 20271. FORMAT "%2.0" NUMBER 5 /end CHARACTERISTIC
/begin CHARACTERISTIC DINH_Lim.DFC_LSUCircPmpCurMax_0_CA "/" VAL_BLK 0x80077E16 ValA_Wu16 8192. DINH_LimDFCVerb 12079. 20271. FORMAT "%2.0" NUMBER 9 /end CHARACTERISTIC
/begin CHARACTERISTIC DINH_Lim.DFC_LSUCircPmpCurMax_1_CA "/" VAL_BLK 0x80077E28 ValA_Wu16 8192. DINH_LimDFCVerb 12079. 20271. FORMAT "%2.0" NUMBER 9 /end CHARACTERISTIC
/begin CHARACTERISTIC DINH_Lim.DFC_LSUCircPmpCurMax_2_CA "/" VAL_BLK 0x80077E3A ValA_Wu16 8192. DINH_LimDFCVerb 12079. 20271. FORMAT "%2.0" NUMBER 5 /end CHARACTERISTIC
/begin CHARACTERISTIC DINH_Lim.DFC_LSUCircPmpCurMax_3_CA "/" VAL_BLK 0x80077E44 ValA_Wu16 8192. DINH_LimDFCVerb 12079. 20271. FORMAT "%2.0" NUMBER 5 /end CHARACTERISTIC
/begin CHARACTERISTIC DINH_Lim.DFC_LSUCircPmpCurMin_0_CA "/" VAL_BLK 0x80077E4E ValA_Wu16 8192. DINH_LimDFCVerb 12079. 20271. FORMAT "%2.0" NUMBER 9 /end CHARACTERISTIC
/begin CHARACTERISTIC DINH_Lim.DFC_LSUCircPmpCurMin_1_CA "/" VAL_BLK 0x80077E60 ValA_Wu16 8192. DINH_LimDFCVerb 12079. 20271. FORMAT "%2.0" NUMBER 9 /end CHARACTERISTIC
/begin CHARACTERISTIC DINH_Lim.DFC_LSUCircPmpCurMin_2_CA "/" VAL_BLK 0x80077E72 ValA_Wu16 8192. DINH_LimDFCVerb 12079. 20271. FORMAT "%2.0" NUMBER 5 /end CHARACTERISTIC
/begin CHARACTERISTIC DINH_Lim.DFC_LSUCircPmpCurMin_3_CA "/" VAL_BLK 0x80077E7C ValA_Wu16 8192. DINH_LimDFCVerb 12079. 20271. FORMAT "%2.0" NUMBER 5 /end CHARACTERISTIC
/begin CHARACTERISTIC DINH_Lim.DFC_LSUCircPmpCurSig_0_CA "/" VAL_BLK 0x80077E86 ValA_Wu16 8192. DINH_LimDFCVerb 12079. 20271. FORMAT "%2.0" NUMBER 9 /end CHARACTERISTIC
/begin CHARACTERISTIC DINH_Lim.DFC_LSUCircPmpCurSig_1_CA "/" VAL_BLK 0x80077E98 ValA_Wu16 8192. DINH_LimDFCVerb 12079. 20271. FORMAT "%2.0" NUMBER 9 /end CHARACTERISTIC
/begin CHARACTERISTIC DINH_Lim.DFC_LSUCircPmpCurSig_2_CA "/" VAL_BLK 0x80077EAA ValA_Wu16 8192. DINH_LimDFCVerb 12079. 20271. FORMAT "%2.0" NUMBER 5 /end CHARACTERISTIC
/begin CHARACTERISTIC DINH_Lim.DFC_LSUCircPmpCurSig_3_CA "/" VAL_BLK 0x80077EB4 ValA_Wu16 8192. DINH_LimDFCVerb 12079. 20271. FORMAT "%2.0" NUMBER 5 /end CHARACTERISTIC
/begin CHARACTERISTIC DINH_Lim.DFC_LSUCircVirtGndMax_0_CA "/" VAL_BLK 0x80077EBE ValA_Wu16 8192. DINH_LimDFCVerb 12079. 20271. FORMAT "%2.0" NUMBER 10 /end CHARACTERISTIC
/begin CHARACTERISTIC DINH_Lim.DFC_LSUCircVirtGndMax_1_CA "/" VAL_BLK 0x80077ED2 ValA_Wu16 8192. DINH_LimDFCVerb 12079. 20271. FORMAT "%2.0" NUMBER 10 /end CHARACTERISTIC
/begin CHARACTERISTIC DINH_Lim.DFC_LSUCircVirtGndMax_2_CA "/" VAL_BLK 0x80077EE6 ValA_Wu16 8192. DINH_LimDFCVerb 12079. 20271. FORMAT "%2.0" NUMBER 5 /end CHARACTERISTIC
/begin CHARACTERISTIC DINH_Lim.DFC_LSUCircVirtGndMax_3_CA "/" VAL_BLK 0x80077EF0 ValA_Wu16 8192. DINH_LimDFCVerb 12079. 20271. FORMAT "%2.0" NUMBER 5 /end CHARACTERISTIC
/begin CHARACTERISTIC DINH_Lim.DFC_LSUCircVirtGndMin_0_CA "/" VAL_BLK 0x80077EFA ValA_Wu16 8192. DINH_LimDFCVerb 12079. 20271. FORMAT "%2.0" NUMBER 10 /end CHARACTERISTIC
/begin CHARACTERISTIC DINH_Lim.DFC_LSUCircVirtGndMin_1_CA "/" VAL_BLK 0x80077F0E ValA_Wu16 8192. DINH_LimDFCVerb 12079. 20271. FORMAT "%2.0" NUMBER 10 /end CHARACTERISTIC
/begin CHARACTERISTIC DINH_Lim.DFC_LSUCircVirtGndMin_2_CA "/" VAL_BLK 0x80077F22 ValA_Wu16 8192. DINH_LimDFCVerb 12079. 20271. FORMAT "%2.0" NUMBER 5 /end CHARACTERISTIC
/begin CHARACTERISTIC DINH_Lim.DFC_LSUCircVirtGndMin_3_CA "/" VAL_BLK 0x80077F2C ValA_Wu16 8192. DINH_LimDFCVerb 12079. 20271. FORMAT "%2.0" NUMBER 5 /end CHARACTERISTIC
/begin CHARACTERISTIC DINH_Lim.DFC_LSUCircVirtGndSig_0_CA "/" VAL_BLK 0x80077F36 ValA_Wu16 8192. DINH_LimDFCVerb 12079. 20271. FORMAT "%2.0" NUMBER 9 /end CHARACTERISTIC
/begin CHARACTERISTIC DINH_Lim.DFC_LSUCircVirtGndSig_1_CA "/" VAL_BLK 0x80077F48 ValA_Wu16 8192. DINH_LimDFCVerb 12079. 20271. FORMAT "%2.0" NUMBER 9 /end CHARACTERISTIC
/begin CHARACTERISTIC DINH_Lim.DFC_LSUCircVirtGndSig_2_CA "/" VAL_BLK 0x80077F5A ValA_Wu16 8192. DINH_LimDFCVerb 12079. 20271. FORMAT "%2.0" NUMBER 5 /end CHARACTERISTIC
/begin CHARACTERISTIC DINH_Lim.DFC_LSUCircVirtGndSig_3_CA "/" VAL_BLK 0x80077F64 ValA_Wu16 8192. DINH_LimDFCVerb 12079. 20271. FORMAT "%2.0" NUMBER 5 /end CHARACTERISTIC
/begin CHARACTERISTIC DINH_Lim.DFC_LSUHtrMax_0_CA "/" VAL_BLK 0x80077F6E ValA_Wu16 8192. DINH_LimDFCVerb 12079. 20271. FORMAT "%2.0" NUMBER 10 /end CHARACTERISTIC
/begin CHARACTERISTIC DINH_Lim.DFC_LSUHtrMax_1_CA "/" VAL_BLK 0x80077F82 ValA_Wu16 8192. DINH_LimDFCVerb 12079. 20271. FORMAT "%2.0" NUMBER 8 /end CHARACTERISTIC
/begin CHARACTERISTIC DINH_Lim.DFC_LSUHtrMax_2_CA "/" VAL_BLK 0x80077F92 ValA_Wu16 8192. DINH_LimDFCVerb 12079. 20271. FORMAT "%2.0" NUMBER 5 /end CHARACTERISTIC
/begin CHARACTERISTIC DINH_Lim.DFC_LSUHtrMax_3_CA "/" VAL_BLK 0x80077F9C ValA_Wu16 8192. DINH_LimDFCVerb 12079. 20271. FORMAT "%2.0" NUMBER 5 /end CHARACTERISTIC
/begin CHARACTERISTIC DINH_Lim.DFC_LSUHtrMin_0_CA "/" VAL_BLK 0x80077FA6 ValA_Wu16 8192. DINH_LimDFCVerb 12079. 20271. FORMAT "%2.0" NUMBER 9 /end CHARACTERISTIC
/begin CHARACTERISTIC DINH_Lim.DFC_LSUHtrMin_1_CA "/" VAL_BLK 0x80077FB8 ValA_Wu16 8192. DINH_LimDFCVerb 12079. 20271. FORMAT "%2.0" NUMBER 9 /end CHARACTERISTIC
/begin CHARACTERISTIC DINH_Lim.DFC_LSUHtrMin_2_CA "/" VAL_BLK 0x80077FCA ValA_Wu16 8192. DINH_LimDFCVerb 12079. 20271. FORMAT "%2.0" NUMBER 5 /end CHARACTERISTIC
/begin CHARACTERISTIC DINH_Lim.DFC_LSUHtrMin_3_CA "/" VAL_BLK 0x80077FD4 ValA_Wu16 8192. DINH_LimDFCVerb 12079. 20271. FORMAT "%2.0" NUMBER 5 /end CHARACTERISTIC
/begin CHARACTERISTIC DINH_Lim.DFC_LSUHtrSig_0_CA "/" VAL_BLK 0x80077FDE ValA_Wu16 8192. DINH_LimDFCVerb 12079. 20271. FORMAT "%2.0" NUMBER 9 /end CHARACTERISTIC
/begin CHARACTERISTIC DINH_Lim.DFC_LSUHtrSig_1_CA "/" VAL_BLK 0x80077FF0 ValA_Wu16 8192. DINH_LimDFCVerb 12079. 20271. FORMAT "%2.0" NUMBER 9 /end CHARACTERISTIC
/begin CHARACTERISTIC DINH_Lim.DFC_LSUHtrSig_2_CA "/" VAL_BLK 0x80078002 ValA_Wu16 8192. DINH_LimDFCVerb 12079. 20271. FORMAT "%2.0" NUMBER 5 /end CHARACTERISTIC
/begin CHARACTERISTIC DINH_Lim.DFC_LSUHtrSig_3_CA "/" VAL_BLK 0x8007800C ValA_Wu16 8192. DINH_LimDFCVerb 12079. 20271. FORMAT "%2.0" NUMBER 5 /end CHARACTERISTIC
/begin CHARACTERISTIC DINH_Lim.DFC_LSUO2Max_0_CA "/" VAL_BLK 0x80078016 ValA_Wu16 8192. DINH_LimDFCVerb 12079. 20271. FORMAT "%2.0" NUMBER 8 /end CHARACTERISTIC
/begin CHARACTERISTIC DINH_Lim.DFC_LSUO2Max_1_CA "/" VAL_BLK 0x80078026 ValA_Wu16 8192. DINH_LimDFCVerb 12079. 20271. FORMAT "%2.0" NUMBER 8 /end CHARACTERISTIC
/begin CHARACTERISTIC DINH_Lim.DFC_LSUO2Max_2_CA "/" VAL_BLK 0x80078036 ValA_Wu16 8192. DINH_LimDFCVerb 12079. 20271. FORMAT "%2.0" NUMBER 5 /end CHARACTERISTIC
/begin CHARACTERISTIC DINH_Lim.DFC_LSUO2Max_3_CA "/" VAL_BLK 0x80078040 ValA_Wu16 8192. DINH_LimDFCVerb 12079. 20271. FORMAT "%2.0" NUMBER 5 /end CHARACTERISTIC
/begin CHARACTERISTIC DINH_Lim.DFC_LSUO2Min_0_CA "/" VAL_BLK 0x8007804A ValA_Wu16 8192. DINH_LimDFCVerb 12079. 20271. FORMAT "%2.0" NUMBER 8 /end CHARACTERISTIC
/begin CHARACTERISTIC DINH_Lim.DFC_LSUO2Min_1_CA "/" VAL_BLK 0x8007805A ValA_Wu16 8192. DINH_LimDFCVerb 12079. 20271. FORMAT "%2.0" NUMBER 8 /end CHARACTERISTIC
/begin CHARACTERISTIC DINH_Lim.DFC_LSUO2Min_2_CA "/" VAL_BLK 0x8007806A ValA_Wu16 8192. DINH_LimDFCVerb 12079. 20271. FORMAT "%2.0" NUMBER 5 /end CHARACTERISTIC
/begin CHARACTERISTIC DINH_Lim.DFC_LSUO2Min_3_CA "/" VAL_BLK 0x80078074 ValA_Wu16 8192. DINH_LimDFCVerb 12079. 20271. FORMAT "%2.0" NUMBER 5 /end CHARACTERISTIC
/begin CHARACTERISTIC DINH_Lim.DFC_LSUSPIBattLowMin_0_CA "/" VAL_BLK 0x8007807E ValA_Wu16 8192. DINH_LimDFCVerb 12079. 20271. FORMAT "%2.0" NUMBER 12 /end CHARACTERISTIC
/begin CHARACTERISTIC DINH_Lim.DFC_LSUSPIBattLowMin_1_CA "/" VAL_BLK 0x80078096 ValA_Wu16 8192. DINH_LimDFCVerb 12079. 20271. FORMAT "%2.0" NUMBER 12 /end CHARACTERISTIC
/begin CHARACTERISTIC DINH_Lim.DFC_LSUSPIBattLowMin_2_CA "/" VAL_BLK 0x800780AE ValA_Wu16 8192. DINH_LimDFCVerb 12079. 20271. FORMAT "%2.0" NUMBER 5 /end CHARACTERISTIC
/begin CHARACTERISTIC DINH_Lim.DFC_LSUSPIBattLowMin_3_CA "/" VAL_BLK 0x800780B8 ValA_Wu16 8192. DINH_LimDFCVerb 12079. 20271. FORMAT "%2.0" NUMBER 5 /end CHARACTERISTIC
/begin CHARACTERISTIC DINH_Lim.DFC_LSUSPISig_0_CA "/" VAL_BLK 0x800780C2 ValA_Wu16 8192. DINH_LimDFCVerb 12079. 20271. FORMAT "%2.0" NUMBER 9 /end CHARACTERISTIC
/begin CHARACTERISTIC DINH_Lim.DFC_LSUSPISig_1_CA "/" VAL_BLK 0x800780D4 ValA_Wu16 8192. DINH_LimDFCVerb 12079. 20271. FORMAT "%2.0" NUMBER 9 /end CHARACTERISTIC
/begin CHARACTERISTIC DINH_Lim.DFC_LSUSPISig_2_CA "/" VAL_BLK 0x800780E6 ValA_Wu16 8192. DINH_LimDFCVerb 12079. 20271. FORMAT "%2.0" NUMBER 5 /end CHARACTERISTIC
/begin CHARACTERISTIC DINH_Lim.DFC_LSUSPISig_3_CA "/" VAL_BLK 0x800780F0 ValA_Wu16 8192. DINH_LimDFCVerb 12079. 20271. FORMAT "%2.0" NUMBER 5 /end CHARACTERISTIC
/begin CHARACTERISTIC DINH_Lim.DFC_LSUtExcMax_0_CA "/" VAL_BLK 0x800780FA ValA_Wu16 8192. DINH_LimDFCVerb 12079. 20271. FORMAT "%2.0" NUMBER 8 /end CHARACTERISTIC
/begin CHARACTERISTIC DINH_Lim.DFC_LSUtExcMax_1_CA "/" VAL_BLK 0x8007810A ValA_Wu16 8192. DINH_LimDFCVerb 12079. 20271. FORMAT "%2.0" NUMBER 8 /end CHARACTERISTIC
/begin CHARACTERISTIC DINH_Lim.DFC_LSUtExcMax_2_CA "/" VAL_BLK 0x8007811A ValA_Wu16 8192. DINH_LimDFCVerb 12079. 20271. FORMAT "%2.0" NUMBER 5 /end CHARACTERISTIC
/begin CHARACTERISTIC DINH_Lim.DFC_LSUtExcMax_3_CA "/" VAL_BLK 0x80078124 ValA_Wu16 8192. DINH_LimDFCVerb 12079. 20271. FORMAT "%2.0" NUMBER 5 /end CHARACTERISTIC
/begin CHARACTERISTIC DINH_Lim.DFC_LSUtExcMin_0_CA "/" VAL_BLK 0x8007812E ValA_Wu16 8192. DINH_LimDFCVerb 12079. 20271. FORMAT "%2.0" NUMBER 8 /end CHARACTERISTIC
/begin CHARACTERISTIC DINH_Lim.DFC_LSUtExcMin_1_CA "/" VAL_BLK 0x8007813E ValA_Wu16 8192. DINH_LimDFCVerb 12079. 20271. FORMAT "%2.0" NUMBER 8 /end CHARACTERISTIC
/begin CHARACTERISTIC DINH_Lim.DFC_LSUtExcMin_2_CA "/" VAL_BLK 0x8007814E ValA_Wu16 8192. DINH_LimDFCVerb 12079. 20271. FORMAT "%2.0" NUMBER 5 /end CHARACTERISTIC
/begin CHARACTERISTIC DINH_Lim.DFC_LSUtExcMin_3_CA "/" VAL_BLK 0x80078158 ValA_Wu16 8192. DINH_LimDFCVerb 12079. 20271. FORMAT "%2.0" NUMBER 5 /end CHARACTERISTIC
/begin CHARACTERISTIC DINH_Lim.DFC_MILOL_CA "/" VAL_BLK 0x80078162 ValA_Wu16 8192. DINH_LimDFCVerb 12079. 20271. FORMAT "%2.0" NUMBER 5 /end CHARACTERISTIC
/begin CHARACTERISTIC DINH_Lim.DFC_MILSCB_CA "/" VAL_BLK 0x8007816C ValA_Wu16 8192. DINH_LimDFCVerb 12079. 20271. FORMAT "%2.0" NUMBER 5 /end CHARACTERISTIC
/begin CHARACTERISTIC DINH_Lim.DFC_MILSCG_CA "/" VAL_BLK 0x80078176 ValA_Wu16 8192. DINH_LimDFCVerb 12079. 20271. FORMAT "%2.0" NUMBER 5 /end CHARACTERISTIC
/begin CHARACTERISTIC DINH_Lim.DFC_MeUnSCG_CA "/" VAL_BLK 0x80078180 ValA_Wu16 8192. DINH_LimDFCVerb 12079. 20271. FORMAT "%2.0" NUMBER 12 /end CHARACTERISTIC
/begin CHARACTERISTIC DINH_Lim.DFC_NplHsChngPPFltDiff_CA "/" VAL_BLK 0x80078198 ValA_Wu16 8192. DINH_LimDFCVerb 12079. 20271. FORMAT "%2.0" NUMBER 5 /end CHARACTERISTIC
/begin CHARACTERISTIC DINH_Lim.DFC_NplPAirFltDs_CA "/" VAL_BLK 0x800781A2 ValA_Wu16 8192. DINH_LimDFCVerb 12079. 20271. FORMAT "%2.0" NUMBER 7 /end CHARACTERISTIC
/begin CHARACTERISTIC DINH_Lim.DFC_NplTPFltUs_CA "/" VAL_BLK 0x800781B0 ValA_Wu16 8192. DINH_LimDFCVerb 12079. 20271. FORMAT "%2.0" NUMBER 6 /end CHARACTERISTIC
/begin CHARACTERISTIC DINH_Lim.DFC_OilComErr_CA "/" VAL_BLK 0x800781BC ValA_Wu16 8192. DINH_LimDFCVerb 12079. 20271. FORMAT "%2.0" NUMBER 5 /end CHARACTERISTIC
/begin CHARACTERISTIC DINH_Lim.DFC_OilPLmpOL_CA "/" VAL_BLK 0x800781C6 ValA_Wu16 8192. DINH_LimDFCVerb 12079. 20271. FORMAT "%2.0" NUMBER 5 /end CHARACTERISTIC
/begin CHARACTERISTIC DINH_Lim.DFC_OilPLmpSCB_CA "/" VAL_BLK 0x800781D0 ValA_Wu16 8192. DINH_LimDFCVerb 12079. 20271. FORMAT "%2.0" NUMBER 5 /end CHARACTERISTIC
/begin CHARACTERISTIC DINH_Lim.DFC_OilPLmpSCG_CA "/" VAL_BLK 0x800781DA ValA_Wu16 8192. DINH_LimDFCVerb 12079. 20271. FORMAT "%2.0" NUMBER 5 /end CHARACTERISTIC
/begin CHARACTERISTIC DINH_Lim.DFC_OilPNpl_CA "/" VAL_BLK 0x800781E4 ValA_Wu16 8192. DINH_LimDFCVerb 12079. 20271. FORMAT "%2.0" NUMBER 5 /end CHARACTERISTIC
/begin CHARACTERISTIC DINH_Lim.DFC_OilTNpl_CA "/" VAL_BLK 0x800781EE ValA_Wu16 8192. DINH_LimDFCVerb 12079. 20271. FORMAT "%2.0" NUMBER 8 /end CHARACTERISTIC
/begin CHARACTERISTIC DINH_Lim.DFC_OilTSRCMax_CA "/" VAL_BLK 0x800781FE ValA_Wu16 8192. DINH_LimDFCVerb 12079. 20271. FORMAT "%2.0" NUMBER 11 /end CHARACTERISTIC
/begin CHARACTERISTIC DINH_Lim.DFC_OilTSRCMin_CA "/" VAL_BLK 0x80078214 ValA_Wu16 8192. DINH_LimDFCVerb 12079. 20271. FORMAT "%2.0" NUMBER 10 /end CHARACTERISTIC
/begin CHARACTERISTIC DINH_Lim.DFC_PCACDsEnvPPls_CA "/" VAL_BLK 0x80078228 ValA_Wu16 8192. DINH_LimDFCVerb 12079. 20271. FORMAT "%2.0" NUMBER 8 /end CHARACTERISTIC
/begin CHARACTERISTIC DINH_Lim.DFC_PCACDsSRCMax_CA "/" VAL_BLK 0x80078238 ValA_Wu16 8192. DINH_LimDFCVerb 12079. 20271. FORMAT "%2.0" NUMBER 13 /end CHARACTERISTIC
/begin CHARACTERISTIC DINH_Lim.DFC_PCACDsSRCMin_CA "/" VAL_BLK 0x80078252 ValA_Wu16 8192. DINH_LimDFCVerb 12079. 20271. FORMAT "%2.0" NUMBER 13 /end CHARACTERISTIC
/begin CHARACTERISTIC DINH_Lim.DFC_PCVSCG_CA "/" VAL_BLK 0x8007826C ValA_Wu16 8192. DINH_LimDFCVerb 12079. 20271. FORMAT "%2.0" NUMBER 9 /end CHARACTERISTIC
/begin CHARACTERISTIC DINH_Lim.DFC_PFltCharPDiffMin_CA "/" VAL_BLK 0x8007827E ValA_Wu16 8192. DINH_LimDFCVerb 12079. 20271. FORMAT "%2.0" NUMBER 5 /end CHARACTERISTIC
/begin CHARACTERISTIC DINH_Lim.DFC_PFltDstrMin_CA "/" VAL_BLK 0x80078288 ValA_Wu16 8192. DINH_LimDFCVerb 12079. 20271. FORMAT "%2.0" NUMBER 5 /end CHARACTERISTIC
/begin CHARACTERISTIC DINH_Lim.DFC_PFltEngPrt_CA "/" VAL_BLK 0x80078292 ValA_Wu16 8192. DINH_LimDFCVerb 12079. 20271. FORMAT "%2.0" NUMBER 5 /end CHARACTERISTIC
/begin CHARACTERISTIC DINH_Lim.DFC_PFltLmpOL_CA "/" VAL_BLK 0x8007829C ValA_Wu16 8192. DINH_LimDFCVerb 12079. 20271. FORMAT "%2.0" NUMBER 5 /end CHARACTERISTIC
/begin CHARACTERISTIC DINH_Lim.DFC_PFltLmpSCB_CA "/" VAL_BLK 0x800782A6 ValA_Wu16 8192. DINH_LimDFCVerb 12079. 20271. FORMAT "%2.0" NUMBER 5 /end CHARACTERISTIC
/begin CHARACTERISTIC DINH_Lim.DFC_PFltLmpSCG_CA "/" VAL_BLK 0x800782B0 ValA_Wu16 8192. DINH_LimDFCVerb 12079. 20271. FORMAT "%2.0" NUMBER 5 /end CHARACTERISTIC
/begin CHARACTERISTIC DINH_Lim.DFC_PFltRgnPerm_CA "/" VAL_BLK 0x800782BA ValA_Wu16 8192. DINH_LimDFCVerb 12079. 20271. FORMAT "%2.0" NUMBER 5 /end CHARACTERISTIC
/begin CHARACTERISTIC DINH_Lim.DFC_PFltSRCMaxFlwRstn_CA "/" VAL_BLK 0x800782C4 ValA_Wu16 8192. DINH_LimDFCVerb 12079. 20271. FORMAT "%2.0" NUMBER 6 /end CHARACTERISTIC
/begin CHARACTERISTIC DINH_Lim.DFC_PFltSRCMinFlwRstn_CA "/" VAL_BLK 0x800782D0 ValA_Wu16 8192. DINH_LimDFCVerb 12079. 20271. FORMAT "%2.0" NUMBER 6 /end CHARACTERISTIC
/begin CHARACTERISTIC DINH_Lim.DFC_PFltSotMsDvtMax_CA "/" VAL_BLK 0x800782DC ValA_Wu16 8192. DINH_LimDFCVerb 12079. 20271. FORMAT "%2.0" NUMBER 5 /end CHARACTERISTIC
/begin CHARACTERISTIC DINH_Lim.DFC_PFltSotMsDvtMin_CA "/" VAL_BLK 0x800782E6 ValA_Wu16 8192. DINH_LimDFCVerb 12079. 20271. FORMAT "%2.0" NUMBER 5 /end CHARACTERISTIC
/begin CHARACTERISTIC DINH_Lim.DFC_PFltSotMsMax_CA "/" VAL_BLK 0x800782F0 ValA_Wu16 8192. DINH_LimDFCVerb 12079. 20271. FORMAT "%2.0" NUMBER 5 /end CHARACTERISTIC
/begin CHARACTERISTIC DINH_Lim.DFC_PSPOL_CA "/" VAL_BLK 0x800782FA ValA_Wu16 8192. DINH_LimDFCVerb 12079. 20271. FORMAT "%2.0" NUMBER 5 /end CHARACTERISTIC
/begin CHARACTERISTIC DINH_Lim.DFC_PSPSCB_CA "/" VAL_BLK 0x80078304 ValA_Wu16 8192. DINH_LimDFCVerb 12079. 20271. FORMAT "%2.0" NUMBER 5 /end CHARACTERISTIC
/begin CHARACTERISTIC DINH_Lim.DFC_PSPSCG_CA "/" VAL_BLK 0x8007830E ValA_Wu16 8192. DINH_LimDFCVerb 12079. 20271. FORMAT "%2.0" NUMBER 5 /end CHARACTERISTIC
/begin CHARACTERISTIC DINH_Lim.DFC_SRCHighAPP1_CA "/" VAL_BLK 0x80078318 ValA_Wu16 8192. DINH_LimDFCVerb 12079. 20271. FORMAT "%2.0" NUMBER 6 /end CHARACTERISTIC
/begin CHARACTERISTIC DINH_Lim.DFC_SRCHighAPP2_CA "/" VAL_BLK 0x80078324 ValA_Wu16 8192. DINH_LimDFCVerb 12079. 20271. FORMAT "%2.0" NUMBER 6 /end CHARACTERISTIC
/begin CHARACTERISTIC DINH_Lim.DFC_SRCLowAPP1_CA "/" VAL_BLK 0x80078330 ValA_Wu16 8192. DINH_LimDFCVerb 12079. 20271. FORMAT "%2.0" NUMBER 5 /end CHARACTERISTIC
/begin CHARACTERISTIC DINH_Lim.DFC_SRCLowAPP2_CA "/" VAL_BLK 0x8007833A ValA_Wu16 8192. DINH_LimDFCVerb 12079. 20271. FORMAT "%2.0" NUMBER 5 /end CHARACTERISTIC
/begin CHARACTERISTIC DINH_Lim.DFC_SRCMaxPAirFltDs_CA "/" VAL_BLK 0x80078344 ValA_Wu16 8192. DINH_LimDFCVerb 12079. 20271. FORMAT "%2.0" NUMBER 8 /end CHARACTERISTIC
/begin CHARACTERISTIC DINH_Lim.DFC_SRCMaxPPFltUs_CA "/" VAL_BLK 0x80078354 ValA_Wu16 8192. DINH_LimDFCVerb 12079. 20271. FORMAT "%2.0" NUMBER 11 /end CHARACTERISTIC
/begin CHARACTERISTIC DINH_Lim.DFC_SRCMaxTECU_CA "/" VAL_BLK 0x8007836A ValA_Wu16 8192. DINH_LimDFCVerb 12079. 20271. FORMAT "%2.0" NUMBER 7 /end CHARACTERISTIC
/begin CHARACTERISTIC DINH_Lim.DFC_SRCMaxTOxiCatUs_CA "/" VAL_BLK 0x80078378 ValA_Wu16 8192. DINH_LimDFCVerb 12079. 20271. FORMAT "%2.0" NUMBER 10 /end CHARACTERISTIC
/begin CHARACTERISTIC DINH_Lim.DFC_SRCMaxTPFltUs_CA "/" VAL_BLK 0x8007838C ValA_Wu16 8192. DINH_LimDFCVerb 12079. 20271. FORMAT "%2.0" NUMBER 16 /end CHARACTERISTIC
/begin CHARACTERISTIC DINH_Lim.DFC_SRCMinPAirFltDs_CA "/" VAL_BLK 0x800783AC ValA_Wu16 8192. DINH_LimDFCVerb 12079. 20271. FORMAT "%2.0" NUMBER 8 /end CHARACTERISTIC
/begin CHARACTERISTIC DINH_Lim.DFC_SRCMinPPFltUs_CA "/" VAL_BLK 0x800783BC ValA_Wu16 8192. DINH_LimDFCVerb 12079. 20271. FORMAT "%2.0" NUMBER 9 /end CHARACTERISTIC
/begin CHARACTERISTIC DINH_Lim.DFC_SRCMinTECU_CA "/" VAL_BLK 0x800783CE ValA_Wu16 8192. DINH_LimDFCVerb 12079. 20271. FORMAT "%2.0" NUMBER 7 /end CHARACTERISTIC
/begin CHARACTERISTIC DINH_Lim.DFC_SRCMinTOxiCatUs_CA "/" VAL_BLK 0x800783DC ValA_Wu16 8192. DINH_LimDFCVerb 12079. 20271. FORMAT "%2.0" NUMBER 10 /end CHARACTERISTIC
/begin CHARACTERISTIC DINH_Lim.DFC_SRCMinTPFltUs_CA "/" VAL_BLK 0x800783F0 ValA_Wu16 8192. DINH_LimDFCVerb 12079. 20271. FORMAT "%2.0" NUMBER 17 /end CHARACTERISTIC
/begin CHARACTERISTIC DINH_Lim.DFC_SVSOL_CA "/" VAL_BLK 0x80078412 ValA_Wu16 8192. DINH_LimDFCVerb 12079. 20271. FORMAT "%2.0" NUMBER 5 /end CHARACTERISTIC
/begin CHARACTERISTIC DINH_Lim.DFC_SVSSCB_CA "/" VAL_BLK 0x8007841C ValA_Wu16 8192. DINH_LimDFCVerb 12079. 20271. FORMAT "%2.0" NUMBER 5 /end CHARACTERISTIC
/begin CHARACTERISTIC DINH_Lim.DFC_SVSSCG_CA "/" VAL_BLK 0x80078426 ValA_Wu16 8192. DINH_LimDFCVerb 12079. 20271. FORMAT "%2.0" NUMBER 5 /end CHARACTERISTIC
/begin CHARACTERISTIC DINH_Lim.DFC_StrtOL_CA "/" VAL_BLK 0x80078430 ValA_Wu16 8192. DINH_LimDFCVerb 12079. 20271. FORMAT "%2.0" NUMBER 5 /end CHARACTERISTIC
/begin CHARACTERISTIC DINH_Lim.DFC_StrtSCB_CA "/" VAL_BLK 0x8007843A ValA_Wu16 8192. DINH_LimDFCVerb 12079. 20271. FORMAT "%2.0" NUMBER 5 /end CHARACTERISTIC
/begin CHARACTERISTIC DINH_Lim.DFC_StrtSCG_CA "/" VAL_BLK 0x80078444 ValA_Wu16 8192. DINH_LimDFCVerb 12079. 20271. FORMAT "%2.0" NUMBER 5 /end CHARACTERISTIC
/begin CHARACTERISTIC DINH_Lim.DFC_SyncAPP_CA "/" VAL_BLK 0x8007844E ValA_Wu16 8192. DINH_LimDFCVerb 12079. 20271. FORMAT "%2.0" NUMBER 7 /end CHARACTERISTIC
/begin CHARACTERISTIC DINH_Lim.DFC_T15Npl_CA "/" VAL_BLK 0x8007845C ValA_Wu16 8192. DINH_LimDFCVerb 12079. 20271. FORMAT "%2.0" NUMBER 5 /end CHARACTERISTIC
/begin CHARACTERISTIC DINH_Lim.DFC_TAFSDtyCycHi_CA "/" VAL_BLK 0x80078466 ValA_Wu16 8192. DINH_LimDFCVerb 12079. 20271. FORMAT "%2.0" NUMBER 7 /end CHARACTERISTIC
/begin CHARACTERISTIC DINH_Lim.DFC_TAFSDtyCycLo_CA "/" VAL_BLK 0x80078474 ValA_Wu16 8192. DINH_LimDFCVerb 12079. 20271. FORMAT "%2.0" NUMBER 7 /end CHARACTERISTIC
/begin CHARACTERISTIC DINH_Lim.DFC_TAFSPerHi_CA "/" VAL_BLK 0x80078482 ValA_Wu16 8192. DINH_LimDFCVerb 12079. 20271. FORMAT "%2.0" NUMBER 7 /end CHARACTERISTIC
/begin CHARACTERISTIC DINH_Lim.DFC_TAFSPerLo_CA "/" VAL_BLK 0x80078490 ValA_Wu16 8192. DINH_LimDFCVerb 12079. 20271. FORMAT "%2.0" NUMBER 7 /end CHARACTERISTIC
/begin CHARACTERISTIC DINH_Lim.DFC_TCACDsSRCMax_CA "/" VAL_BLK 0x8007849E ValA_Wu16 8192. DINH_LimDFCVerb 12079. 20271. FORMAT "%2.0" NUMBER 11 /end CHARACTERISTIC
/begin CHARACTERISTIC DINH_Lim.DFC_TCACDsSRCMin_CA "/" VAL_BLK 0x800784B4 ValA_Wu16 8192. DINH_LimDFCVerb 12079. 20271. FORMAT "%2.0" NUMBER 11 /end CHARACTERISTIC
/begin CHARACTERISTIC DINH_Lim.DFC_ThrVlvOL_CA "/" VAL_BLK 0x800784CA ValA_Wu16 8192. DINH_LimDFCVerb 12079. 20271. FORMAT "%2.0" NUMBER 6 /end CHARACTERISTIC
/begin CHARACTERISTIC DINH_Lim.DFC_ThrVlvSCB_CA "/" VAL_BLK 0x800784D6 ValA_Wu16 8192. DINH_LimDFCVerb 12079. 20271. FORMAT "%2.0" NUMBER 6 /end CHARACTERISTIC
/begin CHARACTERISTIC DINH_Lim.DFC_ThrVlvSRCMax_CA "/" VAL_BLK 0x800784E2 ValA_Wu16 8192. DINH_LimDFCVerb 12079. 20271. FORMAT "%2.0" NUMBER 7 /end CHARACTERISTIC
/begin CHARACTERISTIC DINH_Lim.DFC_ThrVlvSRCMin_CA "/" VAL_BLK 0x800784F0 ValA_Wu16 8192. DINH_LimDFCVerb 12079. 20271. FORMAT "%2.0" NUMBER 7 /end CHARACTERISTIC
/begin CHARACTERISTIC DINH_Lim.DFC_TrbChLPOL_CA "/" VAL_BLK 0x800784FE ValA_Wu16 8192. DINH_LimDFCVerb 12079. 20271. FORMAT "%2.0" NUMBER 5 /end CHARACTERISTIC
/begin CHARACTERISTIC DINH_Lim.DFC_TrbChLPSCB_CA "/" VAL_BLK 0x80078508 ValA_Wu16 8192. DINH_LimDFCVerb 12079. 20271. FORMAT "%2.0" NUMBER 5 /end CHARACTERISTIC
/begin CHARACTERISTIC DINH_Lim.DFC_TrbChLPSCG_CA "/" VAL_BLK 0x80078512 ValA_Wu16 8192. DINH_LimDFCVerb 12079. 20271. FORMAT "%2.0" NUMBER 5 /end CHARACTERISTIC
/begin CHARACTERISTIC DINH_Lim.DFC_TrbChOL_CA "/" VAL_BLK 0x8007851C ValA_Wu16 8192. DINH_LimDFCVerb 12079. 20271. FORMAT "%2.0" NUMBER 10 /end CHARACTERISTIC
/begin CHARACTERISTIC DINH_Lim.DFC_TrbChSCB_CA "/" VAL_BLK 0x80078530 ValA_Wu16 8192. DINH_LimDFCVerb 12079. 20271. FORMAT "%2.0" NUMBER 10 /end CHARACTERISTIC
/begin CHARACTERISTIC DINH_Lim.DFC_VSwVlvGovDvtMax_CA "/" VAL_BLK 0x80078544 ValA_Wu16 8192. DINH_LimDFCVerb 12079. 20271. FORMAT "%2.0" NUMBER 5 /end CHARACTERISTIC
/begin CHARACTERISTIC DINH_Lim.DFC_VSwVlvGovDvtMin_CA "/" VAL_BLK 0x8007854E ValA_Wu16 8192. DINH_LimDFCVerb 12079. 20271. FORMAT "%2.0" NUMBER 5 /end CHARACTERISTIC
/begin CHARACTERISTIC DINH_Lim.DFC_VSwVlvOL_CA "/" VAL_BLK 0x80078558 ValA_Wu16 8192. DINH_LimDFCVerb 12079. 20271. FORMAT "%2.0" NUMBER 8 /end CHARACTERISTIC
/begin CHARACTERISTIC DINH_Lim.DFC_VSwVlvSCB_CA "/" VAL_BLK 0x80078568 ValA_Wu16 8192. DINH_LimDFCVerb 12079. 20271. FORMAT "%2.0" NUMBER 8 /end CHARACTERISTIC
/begin CHARACTERISTIC DINH_Lim.DFC_VSwVlvSCG_CA "/" VAL_BLK 0x80078578 ValA_Wu16 8192. DINH_LimDFCVerb 12079. 20271. FORMAT "%2.0" NUMBER 8 /end CHARACTERISTIC
/begin CHARACTERISTIC DINH_Lim.DFC_VSwVlvSRCMax_CA "/" VAL_BLK 0x80078588 ValA_Wu16 8192. DINH_LimDFCVerb 12079. 20271. FORMAT "%2.0" NUMBER 9 /end CHARACTERISTIC
/begin CHARACTERISTIC DINH_Lim.DFC_VSwVlvSRCMin_CA "/" VAL_BLK 0x8007859A ValA_Wu16 8192. DINH_LimDFCVerb 12079. 20271. FORMAT "%2.0" NUMBER 9 /end CHARACTERISTIC
/begin CHARACTERISTIC DINH_Lim.DFC_VehVHW_CA "/" VAL_BLK 0x800785AC ValA_Wu16 8192. DINH_LimDFCVerb 12079. 20271. FORMAT "%2.0" NUMBER 13 /end CHARACTERISTIC
/begin CHARACTERISTIC DINH_Lim.DFC_VehVMax_CA "/" VAL_BLK 0x800785C6 ValA_Wu16 8192. DINH_LimDFCVerb 12079. 20271. FORMAT "%2.0" NUMBER 15 /end CHARACTERISTIC
/begin CHARACTERISTIC DINH_Lim.DFC_VehVPlaus_CA "/" VAL_BLK 0x800785E4 ValA_Wu16 8192. DINH_LimDFCVerb 12079. 20271. FORMAT "%2.0" NUMBER 15 /end CHARACTERISTIC
/begin CHARACTERISTIC DINH_Lim.DFC_VehVSig_CA "/" VAL_BLK 0x80078602 ValA_Wu16 8192. DINH_LimDFCVerb 12079. 20271. FORMAT "%2.0" NUMBER 13 /end CHARACTERISTIC
/begin CHARACTERISTIC DINH_Lim.DFC_WaHtElOL_CA "/" VAL_BLK 0x8007861C ValA_Wu16 8192. DINH_LimDFCVerb 12079. 20271. FORMAT "%2.0" NUMBER 5 /end CHARACTERISTIC
/begin CHARACTERISTIC DINH_Lim.DFC_WaHtElSCB_CA "/" VAL_BLK 0x80078626 ValA_Wu16 8192. DINH_LimDFCVerb 12079. 20271. FORMAT "%2.0" NUMBER 5 /end CHARACTERISTIC
/begin CHARACTERISTIC DINH_Lim.DFC_ClthNpl_CA "/" VAL_BLK 0x80078630 ValA_Wu16 8192. DINH_LimDFCVerb 12079. 20271. FORMAT "%2.0" NUMBER 12 /end CHARACTERISTIC
/begin CHARACTERISTIC DINH_Lim.DFC_ETClbETMax_0_CA "/" VAL_BLK 0x80078648 ValA_Wu16 8192. DINH_LimDFCVerb 12079. 20271. FORMAT "%2.0" NUMBER 5 /end CHARACTERISTIC
/begin CHARACTERISTIC DINH_Lim.DFC_ETClbETMax_1_CA "/" VAL_BLK 0x80078652 ValA_Wu16 8192. DINH_LimDFCVerb 12079. 20271. FORMAT "%2.0" NUMBER 5 /end CHARACTERISTIC
/begin CHARACTERISTIC DINH_Lim.DFC_ETClbETMax_2_CA "/" VAL_BLK 0x8007865C ValA_Wu16 8192. DINH_LimDFCVerb 12079. 20271. FORMAT "%2.0" NUMBER 5 /end CHARACTERISTIC
/begin CHARACTERISTIC DINH_Lim.DFC_ETClbETMax_3_CA "/" VAL_BLK 0x80078666 ValA_Wu16 8192. DINH_LimDFCVerb 12079. 20271. FORMAT "%2.0" NUMBER 5 /end CHARACTERISTIC
/begin CHARACTERISTIC DINH_Lim.DFC_ETClbETMax_4_CA "/" VAL_BLK 0x80078670 ValA_Wu16 8192. DINH_LimDFCVerb 12079. 20271. FORMAT "%2.0" NUMBER 5 /end CHARACTERISTIC
/begin CHARACTERISTIC DINH_Lim.DFC_ETClbETMax_5_CA "/" VAL_BLK 0x8007867A ValA_Wu16 8192. DINH_LimDFCVerb 12079. 20271. FORMAT "%2.0" NUMBER 5 /end CHARACTERISTIC
/begin CHARACTERISTIC DINH_Lim.DFC_ETClbETMin_0_CA "/" VAL_BLK 0x80078684 ValA_Wu16 8192. DINH_LimDFCVerb 12079. 20271. FORMAT "%2.0" NUMBER 5 /end CHARACTERISTIC
/begin CHARACTERISTIC DINH_Lim.DFC_ETClbETMin_1_CA "/" VAL_BLK 0x8007868E ValA_Wu16 8192. DINH_LimDFCVerb 12079. 20271. FORMAT "%2.0" NUMBER 5 /end CHARACTERISTIC
/begin CHARACTERISTIC DINH_Lim.DFC_ETClbETMin_2_CA "/" VAL_BLK 0x80078698 ValA_Wu16 8192. DINH_LimDFCVerb 12079. 20271. FORMAT "%2.0" NUMBER 5 /end CHARACTERISTIC
/begin CHARACTERISTIC DINH_Lim.DFC_ETClbETMin_3_CA "/" VAL_BLK 0x800786A2 ValA_Wu16 8192. DINH_LimDFCVerb 12079. 20271. FORMAT "%2.0" NUMBER 5 /end CHARACTERISTIC
/begin CHARACTERISTIC DINH_Lim.DFC_ETClbETMin_4_CA "/" VAL_BLK 0x800786AC ValA_Wu16 8192. DINH_LimDFCVerb 12079. 20271. FORMAT "%2.0" NUMBER 5 /end CHARACTERISTIC
/begin CHARACTERISTIC DINH_Lim.DFC_ETClbETMin_5_CA "/" VAL_BLK 0x800786B6 ValA_Wu16 8192. DINH_LimDFCVerb 12079. 20271. FORMAT "%2.0" NUMBER 5 /end CHARACTERISTIC
/begin CHARACTERISTIC DINH_Lim.DFC_IVDiaBnkShCirBSH_0_CA "/" VAL_BLK 0x800786C0 ValA_Wu16 8192. DINH_LimDFCVerb 12079. 20271. FORMAT "%2.0" NUMBER 5 /end CHARACTERISTIC
/begin CHARACTERISTIC DINH_Lim.DFC_IVDiaBnkShCirBSH_1_CA "/" VAL_BLK 0x800786CA ValA_Wu16 8192. DINH_LimDFCVerb 12079. 20271. FORMAT "%2.0" NUMBER 5 /end CHARACTERISTIC
/begin CHARACTERISTIC DINH_Lim.DFC_IVDiaBnkShCirChSwt_0_CA "/" VAL_BLK 0x800786D4 ValA_Wu16 8192. DINH_LimDFCVerb 12079. 20271. FORMAT "%2.0" NUMBER 5 /end CHARACTERISTIC
/begin CHARACTERISTIC DINH_Lim.DFC_IVDiaBnkShCirChSwt_1_CA "/" VAL_BLK 0x800786DE ValA_Wu16 8192. DINH_LimDFCVerb 12079. 20271. FORMAT "%2.0" NUMBER 5 /end CHARACTERISTIC
/begin CHARACTERISTIC DINH_Lim.DFC_IVDiaBnkShCirHSBatt_0_CA "/" VAL_BLK 0x800786E8 ValA_Wu16 8192. DINH_LimDFCVerb 12079. 20271. FORMAT "%2.0" NUMBER 9 /end CHARACTERISTIC
/begin CHARACTERISTIC DINH_Lim.DFC_IVDiaBnkShCirHSBatt_1_CA "/" VAL_BLK 0x800786FA ValA_Wu16 8192. DINH_LimDFCVerb 12079. 20271. FORMAT "%2.0" NUMBER 9 /end CHARACTERISTIC
/begin CHARACTERISTIC DINH_Lim.DFC_IVDiaBnkShCirHiRstnc_0_CA "/" VAL_BLK 0x8007870C ValA_Wu16 8192. DINH_LimDFCVerb 12079. 20271. FORMAT "%2.0" NUMBER 5 /end CHARACTERISTIC
/begin CHARACTERISTIC DINH_Lim.DFC_IVDiaBnkShCirHiRstnc_1_CA "/" VAL_BLK 0x80078716 ValA_Wu16 8192. DINH_LimDFCVerb 12079. 20271. FORMAT "%2.0" NUMBER 5 /end CHARACTERISTIC
/begin CHARACTERISTIC DINH_Lim.DFC_IVDiaBnkShCirLSHSGnd_0_CA "/" VAL_BLK 0x80078720 ValA_Wu16 8192. DINH_LimDFCVerb 12079. 20271. FORMAT "%2.0" NUMBER 5 /end CHARACTERISTIC
/begin CHARACTERISTIC DINH_Lim.DFC_IVDiaBnkShCirLSHSGnd_1_CA "/" VAL_BLK 0x8007872A ValA_Wu16 8192. DINH_LimDFCVerb 12079. 20271. FORMAT "%2.0" NUMBER 5 /end CHARACTERISTIC
/begin CHARACTERISTIC DINH_Lim.DFC_IVDiaBnkShCirTransfer_0_CA "/" VAL_BLK 0x80078734 ValA_Wu16 8192. DINH_LimDFCVerb 12079. 20271. FORMAT "%2.0" NUMBER 5 /end CHARACTERISTIC
/begin CHARACTERISTIC DINH_Lim.DFC_IVDiaBnkShCirTransfer_1_CA "/" VAL_BLK 0x8007873E ValA_Wu16 8192. DINH_LimDFCVerb 12079. 20271. FORMAT "%2.0" NUMBER 5 /end CHARACTERISTIC
/begin CHARACTERISTIC DINH_Lim.DFC_IVDiaCylNoCls_0_CA "/" VAL_BLK 0x80078748 ValA_Wu16 8192. DINH_LimDFCVerb 12079. 20271. FORMAT "%2.0" NUMBER 5 /end CHARACTERISTIC
/begin CHARACTERISTIC DINH_Lim.DFC_IVDiaCylNoCls_1_CA "/" VAL_BLK 0x80078752 ValA_Wu16 8192. DINH_LimDFCVerb 12079. 20271. FORMAT "%2.0" NUMBER 5 /end CHARACTERISTIC
/begin CHARACTERISTIC DINH_Lim.DFC_IVDiaCylNoCls_2_CA "/" VAL_BLK 0x8007875C ValA_Wu16 8192. DINH_LimDFCVerb 12079. 20271. FORMAT "%2.0" NUMBER 5 /end CHARACTERISTIC
/begin CHARACTERISTIC DINH_Lim.DFC_IVDiaCylNoCls_3_CA "/" VAL_BLK 0x80078766 ValA_Wu16 8192. DINH_LimDFCVerb 12079. 20271. FORMAT "%2.0" NUMBER 5 /end CHARACTERISTIC
/begin CHARACTERISTIC DINH_Lim.DFC_IVDiaCylNoCls_4_CA "/" VAL_BLK 0x80078770 ValA_Wu16 8192. DINH_LimDFCVerb 12079. 20271. FORMAT "%2.0" NUMBER 5 /end CHARACTERISTIC
/begin CHARACTERISTIC DINH_Lim.DFC_IVDiaCylNoCls_5_CA "/" VAL_BLK 0x8007877A ValA_Wu16 8192. DINH_LimDFCVerb 12079. 20271. FORMAT "%2.0" NUMBER 5 /end CHARACTERISTIC
/begin CHARACTERISTIC DINH_Lim.DFC_IVDiaCylNoLd_0_CA "/" VAL_BLK 0x80078784 ValA_Wu16 8192. DINH_LimDFCVerb 12079. 20271. FORMAT "%2.0" NUMBER 5 /end CHARACTERISTIC
/begin CHARACTERISTIC DINH_Lim.DFC_IVDiaCylNoLd_1_CA "/" VAL_BLK 0x8007878E ValA_Wu16 8192. DINH_LimDFCVerb 12079. 20271. FORMAT "%2.0" NUMBER 5 /end CHARACTERISTIC
/begin CHARACTERISTIC DINH_Lim.DFC_IVDiaCylNoLd_2_CA "/" VAL_BLK 0x80078798 ValA_Wu16 8192. DINH_LimDFCVerb 12079. 20271. FORMAT "%2.0" NUMBER 5 /end CHARACTERISTIC
/begin CHARACTERISTIC DINH_Lim.DFC_IVDiaCylNoLd_3_CA "/" VAL_BLK 0x800787A2 ValA_Wu16 8192. DINH_LimDFCVerb 12079. 20271. FORMAT "%2.0" NUMBER 5 /end CHARACTERISTIC
/begin CHARACTERISTIC DINH_Lim.DFC_IVDiaCylNoLd_4_CA "/" VAL_BLK 0x800787AC ValA_Wu16 8192. DINH_LimDFCVerb 12079. 20271. FORMAT "%2.0" NUMBER 5 /end CHARACTERISTIC
/begin CHARACTERISTIC DINH_Lim.DFC_IVDiaCylNoLd_5_CA "/" VAL_BLK 0x800787B6 ValA_Wu16 8192. DINH_LimDFCVerb 12079. 20271. FORMAT "%2.0" NUMBER 5 /end CHARACTERISTIC
/begin CHARACTERISTIC DINH_Lim.DFC_IVDiaCylShCirHiRstnc_0_CA "/" VAL_BLK 0x800787C0 ValA_Wu16 8192. DINH_LimDFCVerb 12079. 20271. FORMAT "%2.0" NUMBER 5 /end CHARACTERISTIC
/begin CHARACTERISTIC DINH_Lim.DFC_IVDiaCylShCirHiRstnc_1_CA "/" VAL_BLK 0x800787CA ValA_Wu16 8192. DINH_LimDFCVerb 12079. 20271. FORMAT "%2.0" NUMBER 5 /end CHARACTERISTIC
/begin CHARACTERISTIC DINH_Lim.DFC_IVDiaCylShCirHiRstnc_2_CA "/" VAL_BLK 0x800787D4 ValA_Wu16 8192. DINH_LimDFCVerb 12079. 20271. FORMAT "%2.0" NUMBER 5 /end CHARACTERISTIC
/begin CHARACTERISTIC DINH_Lim.DFC_IVDiaCylShCirHiRstnc_3_CA "/" VAL_BLK 0x800787DE ValA_Wu16 8192. DINH_LimDFCVerb 12079. 20271. FORMAT "%2.0" NUMBER 5 /end CHARACTERISTIC
/begin CHARACTERISTIC DINH_Lim.DFC_IVDiaCylShCirHiRstnc_4_CA "/" VAL_BLK 0x800787E8 ValA_Wu16 8192. DINH_LimDFCVerb 12079. 20271. FORMAT "%2.0" NUMBER 5 /end CHARACTERISTIC
/begin CHARACTERISTIC DINH_Lim.DFC_IVDiaCylShCirHiRstnc_5_CA "/" VAL_BLK 0x800787F2 ValA_Wu16 8192. DINH_LimDFCVerb 12079. 20271. FORMAT "%2.0" NUMBER 5 /end CHARACTERISTIC
/begin CHARACTERISTIC DINH_Lim.DFC_IVDiaCylShCirLSBatt_0_CA "/" VAL_BLK 0x800787FC ValA_Wu16 8192. DINH_LimDFCVerb 12079. 20271. FORMAT "%2.0" NUMBER 9 /end CHARACTERISTIC
/begin CHARACTERISTIC DINH_Lim.DFC_IVDiaCylShCirLSBatt_1_CA "/" VAL_BLK 0x8007880E ValA_Wu16 8192. DINH_LimDFCVerb 12079. 20271. FORMAT "%2.0" NUMBER 9 /end CHARACTERISTIC
/begin CHARACTERISTIC DINH_Lim.DFC_IVDiaCylShCirLSBatt_2_CA "/" VAL_BLK 0x80078820 ValA_Wu16 8192. DINH_LimDFCVerb 12079. 20271. FORMAT "%2.0" NUMBER 9 /end CHARACTERISTIC
/begin CHARACTERISTIC DINH_Lim.DFC_IVDiaCylShCirLSBatt_3_CA "/" VAL_BLK 0x80078832 ValA_Wu16 8192. DINH_LimDFCVerb 12079. 20271. FORMAT "%2.0" NUMBER 9 /end CHARACTERISTIC
/begin CHARACTERISTIC DINH_Lim.DFC_IVDiaCylShCirLSBatt_4_CA "/" VAL_BLK 0x80078844 ValA_Wu16 8192. DINH_LimDFCVerb 12079. 20271. FORMAT "%2.0" NUMBER 9 /end CHARACTERISTIC
/begin CHARACTERISTIC DINH_Lim.DFC_IVDiaCylShCirLSBatt_5_CA "/" VAL_BLK 0x80078856 ValA_Wu16 8192. DINH_LimDFCVerb 12079. 20271. FORMAT "%2.0" NUMBER 9 /end CHARACTERISTIC
/begin CHARACTERISTIC DINH_Lim.DFC_IVDiaCylShCirLSHS_0_CA "/" VAL_BLK 0x80078868 ValA_Wu16 8192. DINH_LimDFCVerb 12079. 20271. FORMAT "%2.0" NUMBER 9 /end CHARACTERISTIC
/begin CHARACTERISTIC DINH_Lim.DFC_IVDiaCylShCirLSHS_1_CA "/" VAL_BLK 0x8007887A ValA_Wu16 8192. DINH_LimDFCVerb 12079. 20271. FORMAT "%2.0" NUMBER 9 /end CHARACTERISTIC
/begin CHARACTERISTIC DINH_Lim.DFC_IVDiaCylShCirLSHS_2_CA "/" VAL_BLK 0x8007888C ValA_Wu16 8192. DINH_LimDFCVerb 12079. 20271. FORMAT "%2.0" NUMBER 9 /end CHARACTERISTIC
/begin CHARACTERISTIC DINH_Lim.DFC_IVDiaCylShCirLSHS_3_CA "/" VAL_BLK 0x8007889E ValA_Wu16 8192. DINH_LimDFCVerb 12079. 20271. FORMAT "%2.0" NUMBER 9 /end CHARACTERISTIC
/begin CHARACTERISTIC DINH_Lim.DFC_IVDiaCylShCirLSHS_4_CA "/" VAL_BLK 0x800788B0 ValA_Wu16 8192. DINH_LimDFCVerb 12079. 20271. FORMAT "%2.0" NUMBER 9 /end CHARACTERISTIC
/begin CHARACTERISTIC DINH_Lim.DFC_IVDiaCylShCirLSHS_5_CA "/" VAL_BLK 0x800788C2 ValA_Wu16 8192. DINH_LimDFCVerb 12079. 20271. FORMAT "%2.0" NUMBER 9 /end CHARACTERISTIC
/begin CHARACTERISTIC DINH_Lim.DFC_IVDiaCylShCirLsLs_0_CA "/" VAL_BLK 0x800788D4 ValA_Wu16 8192. DINH_LimDFCVerb 12079. 20271. FORMAT "%2.0" NUMBER 5 /end CHARACTERISTIC
/begin CHARACTERISTIC DINH_Lim.DFC_IVDiaCylShCirLsLs_1_CA "/" VAL_BLK 0x800788DE ValA_Wu16 8192. DINH_LimDFCVerb 12079. 20271. FORMAT "%2.0" NUMBER 5 /end CHARACTERISTIC
/begin CHARACTERISTIC DINH_Lim.DFC_IVDiaCylShCirLsLs_2_CA "/" VAL_BLK 0x800788E8 ValA_Wu16 8192. DINH_LimDFCVerb 12079. 20271. FORMAT "%2.0" NUMBER 5 /end CHARACTERISTIC
/begin CHARACTERISTIC DINH_Lim.DFC_IVDiaCylShCirLsLs_3_CA "/" VAL_BLK 0x800788F2 ValA_Wu16 8192. DINH_LimDFCVerb 12079. 20271. FORMAT "%2.0" NUMBER 5 /end CHARACTERISTIC
/begin CHARACTERISTIC DINH_Lim.DFC_IVDiaCylShCirLsLs_4_CA "/" VAL_BLK 0x800788FC ValA_Wu16 8192. DINH_LimDFCVerb 12079. 20271. FORMAT "%2.0" NUMBER 5 /end CHARACTERISTIC
/begin CHARACTERISTIC DINH_Lim.DFC_IVDiaCylShCirLsLs_5_CA "/" VAL_BLK 0x80078906 ValA_Wu16 8192. DINH_LimDFCVerb 12079. 20271. FORMAT "%2.0" NUMBER 5 /end CHARACTERISTIC
/begin CHARACTERISTIC DINH_Lim.DFC_IVDiaSPICfg_CA "/" VAL_BLK 0x80078910 ValA_Wu16 8192. DINH_LimDFCVerb 12079. 20271. FORMAT "%2.0" NUMBER 5 /end CHARACTERISTIC
/begin CHARACTERISTIC DINH_Lim.DFC_IVDiaSPIColl_CA "/" VAL_BLK 0x8007891A ValA_Wu16 8192. DINH_LimDFCVerb 12079. 20271. FORMAT "%2.0" NUMBER 5 /end CHARACTERISTIC
/begin CHARACTERISTIC DINH_Lim.DFC_IVDiaSPICtrl_CA "/" VAL_BLK 0x80078924 ValA_Wu16 8192. DINH_LimDFCVerb 12079. 20271. FORMAT "%2.0" NUMBER 5 /end CHARACTERISTIC
/begin CHARACTERISTIC DINH_Lim.DFC_IVDiaSPIRam_CA "/" VAL_BLK 0x8007892E ValA_Wu16 8192. DINH_LimDFCVerb 12079. 20271. FORMAT "%2.0" NUMBER 5 /end CHARACTERISTIC
/begin CHARACTERISTIC DINH_Lim.DFC_IVDiaSPITrans_CA "/" VAL_BLK 0x80078938 ValA_Wu16 8192. DINH_LimDFCVerb 12079. 20271. FORMAT "%2.0" NUMBER 5 /end CHARACTERISTIC
/begin CHARACTERISTIC DINH_Lim.DFC_LSUCmpChk_0_CA "/" VAL_BLK 0x80078942 ValA_Wu16 8192. DINH_LimDFCVerb 12079. 20271. FORMAT "%2.0" NUMBER 11 /end CHARACTERISTIC
/begin CHARACTERISTIC DINH_Lim.DFC_LSUCmpChk_1_CA "/" VAL_BLK 0x80078958 ValA_Wu16 8192. DINH_LimDFCVerb 12079. 20271. FORMAT "%2.0" NUMBER 5 /end CHARACTERISTIC
/begin CHARACTERISTIC DINH_Lim.DFC_LSUCmpChk_2_CA "/" VAL_BLK 0x80078962 ValA_Wu16 8192. DINH_LimDFCVerb 12079. 20271. FORMAT "%2.0" NUMBER 5 /end CHARACTERISTIC
/begin CHARACTERISTIC DINH_Lim.DFC_LSUCmpChk_3_CA "/" VAL_BLK 0x8007896C ValA_Wu16 8192. DINH_LimDFCVerb 12079. 20271. FORMAT "%2.0" NUMBER 5 /end CHARACTERISTIC
/begin CHARACTERISTIC DINH_Lim.DFC_LSUCmpChk_4_CA "/" VAL_BLK 0x80078976 ValA_Wu16 8192. DINH_LimDFCVerb 12079. 20271. FORMAT "%2.0" NUMBER 5 /end CHARACTERISTIC
/begin CHARACTERISTIC DINH_Lim.DFC_LSUCmpChk_5_CA "/" VAL_BLK 0x80078980 ValA_Wu16 8192. DINH_LimDFCVerb 12079. 20271. FORMAT "%2.0" NUMBER 5 /end CHARACTERISTIC
/begin CHARACTERISTIC DINH_Lim.DFC_LSUDynChk_0_CA "/" VAL_BLK 0x8007898A ValA_Wu16 8192. DINH_LimDFCVerb 12079. 20271. FORMAT "%2.0" NUMBER 8 /end CHARACTERISTIC
/begin CHARACTERISTIC DINH_Lim.DFC_LSUDynChk_1_CA "/" VAL_BLK 0x8007899A ValA_Wu16 8192. DINH_LimDFCVerb 12079. 20271. FORMAT "%2.0" NUMBER 8 /end CHARACTERISTIC
/begin CHARACTERISTIC DINH_Lim.DFC_LSUDynChk_2_CA "/" VAL_BLK 0x800789AA ValA_Wu16 8192. DINH_LimDFCVerb 12079. 20271. FORMAT "%2.0" NUMBER 5 /end CHARACTERISTIC
/begin CHARACTERISTIC DINH_Lim.DFC_LSUDynChk_3_CA "/" VAL_BLK 0x800789B4 ValA_Wu16 8192. DINH_LimDFCVerb 12079. 20271. FORMAT "%2.0" NUMBER 5 /end CHARACTERISTIC
/begin CHARACTERISTIC DINH_Lim.DFC_LSUO2ClbMax_0_CA "/" VAL_BLK 0x800789BE ValA_Wu16 8192. DINH_LimDFCVerb 12079. 20271. FORMAT "%2.0" NUMBER 8 /end CHARACTERISTIC
/begin CHARACTERISTIC DINH_Lim.DFC_LSUO2ClbMax_1_CA "/" VAL_BLK 0x800789CE ValA_Wu16 8192. DINH_LimDFCVerb 12079. 20271. FORMAT "%2.0" NUMBER 8 /end CHARACTERISTIC
/begin CHARACTERISTIC DINH_Lim.DFC_LSUO2ClbMax_2_CA "/" VAL_BLK 0x800789DE ValA_Wu16 8192. DINH_LimDFCVerb 12079. 20271. FORMAT "%2.0" NUMBER 5 /end CHARACTERISTIC
/begin CHARACTERISTIC DINH_Lim.DFC_LSUO2ClbMax_3_CA "/" VAL_BLK 0x800789E8 ValA_Wu16 8192. DINH_LimDFCVerb 12079. 20271. FORMAT "%2.0" NUMBER 5 /end CHARACTERISTIC
/begin CHARACTERISTIC DINH_Lim.DFC_LSUO2ClbMin_0_CA "/" VAL_BLK 0x800789F2 ValA_Wu16 8192. DINH_LimDFCVerb 12079. 20271. FORMAT "%2.0" NUMBER 8 /end CHARACTERISTIC
/begin CHARACTERISTIC DINH_Lim.DFC_LSUO2ClbMin_1_CA "/" VAL_BLK 0x80078A02 ValA_Wu16 8192. DINH_LimDFCVerb 12079. 20271. FORMAT "%2.0" NUMBER 8 /end CHARACTERISTIC
/begin CHARACTERISTIC DINH_Lim.DFC_LSUO2ClbMin_2_CA "/" VAL_BLK 0x80078A12 ValA_Wu16 8192. DINH_LimDFCVerb 12079. 20271. FORMAT "%2.0" NUMBER 5 /end CHARACTERISTIC
/begin CHARACTERISTIC DINH_Lim.DFC_LSUO2ClbMin_3_CA "/" VAL_BLK 0x80078A1C ValA_Wu16 8192. DINH_LimDFCVerb 12079. 20271. FORMAT "%2.0" NUMBER 5 /end CHARACTERISTIC
/begin CHARACTERISTIC DINH_Lim.DFC_LSUO2PlausMax_0_CA "/" VAL_BLK 0x80078A26 ValA_Wu16 8192. DINH_LimDFCVerb 12079. 20271. FORMAT "%2.0" NUMBER 8 /end CHARACTERISTIC
/begin CHARACTERISTIC DINH_Lim.DFC_LSUO2PlausMax_1_CA "/" VAL_BLK 0x80078A36 ValA_Wu16 8192. DINH_LimDFCVerb 12079. 20271. FORMAT "%2.0" NUMBER 8 /end CHARACTERISTIC
/begin CHARACTERISTIC DINH_Lim.DFC_LSUO2PlausMax_2_CA "/" VAL_BLK 0x80078A46 ValA_Wu16 8192. DINH_LimDFCVerb 12079. 20271. FORMAT "%2.0" NUMBER 5 /end CHARACTERISTIC
/begin CHARACTERISTIC DINH_Lim.DFC_LSUO2PlausMax_3_CA "/" VAL_BLK 0x80078A50 ValA_Wu16 8192. DINH_LimDFCVerb 12079. 20271. FORMAT "%2.0" NUMBER 5 /end CHARACTERISTIC
/begin CHARACTERISTIC DINH_Lim.DFC_LSUO2PlausMin_0_CA "/" VAL_BLK 0x80078A5A ValA_Wu16 8192. DINH_LimDFCVerb 12079. 20271. FORMAT "%2.0" NUMBER 8 /end CHARACTERISTIC
/begin CHARACTERISTIC DINH_Lim.DFC_LSUO2PlausMin_1_CA "/" VAL_BLK 0x80078A6A ValA_Wu16 8192. DINH_LimDFCVerb 12079. 20271. FORMAT "%2.0" NUMBER 8 /end CHARACTERISTIC
/begin CHARACTERISTIC DINH_Lim.DFC_LSUO2PlausMin_2_CA "/" VAL_BLK 0x80078A7A ValA_Wu16 8192. DINH_LimDFCVerb 12079. 20271. FORMAT "%2.0" NUMBER 5 /end CHARACTERISTIC
/begin CHARACTERISTIC DINH_Lim.DFC_LSUO2PlausMin_3_CA "/" VAL_BLK 0x80078A84 ValA_Wu16 8192. DINH_LimDFCVerb 12079. 20271. FORMAT "%2.0" NUMBER 5 /end CHARACTERISTIC
/begin CHARACTERISTIC DINH_Lim.DFC_LSURiClbMax_0_CA "/" VAL_BLK 0x80078A8E ValA_Wu16 8192. DINH_LimDFCVerb 12079. 20271. FORMAT "%2.0" NUMBER 10 /end CHARACTERISTIC
/begin CHARACTERISTIC DINH_Lim.DFC_LSURiClbMax_1_CA "/" VAL_BLK 0x80078AA2 ValA_Wu16 8192. DINH_LimDFCVerb 12079. 20271. FORMAT "%2.0" NUMBER 10 /end CHARACTERISTIC
/begin CHARACTERISTIC DINH_Lim.DFC_LSURiClbMax_2_CA "/" VAL_BLK 0x80078AB6 ValA_Wu16 8192. DINH_LimDFCVerb 12079. 20271. FORMAT "%2.0" NUMBER 5 /end CHARACTERISTIC
/begin CHARACTERISTIC DINH_Lim.DFC_LSURiClbMax_3_CA "/" VAL_BLK 0x80078AC0 ValA_Wu16 8192. DINH_LimDFCVerb 12079. 20271. FORMAT "%2.0" NUMBER 5 /end CHARACTERISTIC
/begin CHARACTERISTIC DINH_Lim.DFC_LSURiClbMin_0_CA "/" VAL_BLK 0x80078ACA ValA_Wu16 8192. DINH_LimDFCVerb 12079. 20271. FORMAT "%2.0" NUMBER 10 /end CHARACTERISTIC
/begin CHARACTERISTIC DINH_Lim.DFC_LSURiClbMin_1_CA "/" VAL_BLK 0x80078ADE ValA_Wu16 8192. DINH_LimDFCVerb 12079. 20271. FORMAT "%2.0" NUMBER 10 /end CHARACTERISTIC
/begin CHARACTERISTIC DINH_Lim.DFC_LSURiClbMin_2_CA "/" VAL_BLK 0x80078AF2 ValA_Wu16 8192. DINH_LimDFCVerb 12079. 20271. FORMAT "%2.0" NUMBER 5 /end CHARACTERISTIC
/begin CHARACTERISTIC DINH_Lim.DFC_LSURiClbMin_3_CA "/" VAL_BLK 0x80078AFC ValA_Wu16 8192. DINH_LimDFCVerb 12079. 20271. FORMAT "%2.0" NUMBER 5 /end CHARACTERISTIC
/begin CHARACTERISTIC DINH_Lim.DFC_LSUWireIPSig_0_CA "/" VAL_BLK 0x80078B06 ValA_Wu16 8192. DINH_LimDFCVerb 12079. 20271. FORMAT "%2.0" NUMBER 7 /end CHARACTERISTIC
/begin CHARACTERISTIC DINH_Lim.DFC_LSUWireIPSig_1_CA "/" VAL_BLK 0x80078B14 ValA_Wu16 8192. DINH_LimDFCVerb 12079. 20271. FORMAT "%2.0" NUMBER 7 /end CHARACTERISTIC
/begin CHARACTERISTIC DINH_Lim.DFC_LSUWireIPSig_2_CA "/" VAL_BLK 0x80078B22 ValA_Wu16 8192. DINH_LimDFCVerb 12079. 20271. FORMAT "%2.0" NUMBER 5 /end CHARACTERISTIC
/begin CHARACTERISTIC DINH_Lim.DFC_LSUWireIPSig_3_CA "/" VAL_BLK 0x80078B2C ValA_Wu16 8192. DINH_LimDFCVerb 12079. 20271. FORMAT "%2.0" NUMBER 5 /end CHARACTERISTIC
/begin CHARACTERISTIC DINH_Lim.DFC_AFSDrftIdlAdjVal_CA "/" VAL_BLK 0x80078B36 ValA_Wu16 8192. DINH_LimDFCVerb 12079. 20271. FORMAT "%2.0" NUMBER 6 /end CHARACTERISTIC
/begin CHARACTERISTIC DINH_Lim.DFC_AFSDrftLdAdjVal_CA "/" VAL_BLK 0x80078B42 ValA_Wu16 8192. DINH_LimDFCVerb 12079. 20271. FORMAT "%2.0" NUMBER 6 /end CHARACTERISTIC
/begin CHARACTERISTIC DINH_Lim.DFC_AdcI_ADC0_Cal_CA "/" VAL_BLK 0x80078B4E ValA_Wu16 8192. DINH_LimDFCVerb 12079. 20271. FORMAT "%2.0" NUMBER 6 /end CHARACTERISTIC
/begin CHARACTERISTIC DINH_Lim.DFC_AdcI_ADC0_Conv_CA "/" VAL_BLK 0x80078B5A ValA_Wu16 8192. DINH_LimDFCVerb 12079. 20271. FORMAT "%2.0" NUMBER 6 /end CHARACTERISTIC
/begin CHARACTERISTIC DINH_Lim.DFC_CmbChbMisfireMax_0_CA "/" VAL_BLK 0x80078B66 ValA_Wu16 8192. DINH_LimDFCVerb 12079. 20271. FORMAT "%2.0" NUMBER 5 /end CHARACTERISTIC
/begin CHARACTERISTIC DINH_Lim.DFC_CmbChbMisfireMax_1_CA "/" VAL_BLK 0x80078B70 ValA_Wu16 8192. DINH_LimDFCVerb 12079. 20271. FORMAT "%2.0" NUMBER 5 /end CHARACTERISTIC
/begin CHARACTERISTIC DINH_Lim.DFC_CmbChbMisfireMax_2_CA "/" VAL_BLK 0x80078B7A ValA_Wu16 8192. DINH_LimDFCVerb 12079. 20271. FORMAT "%2.0" NUMBER 5 /end CHARACTERISTIC
/begin CHARACTERISTIC DINH_Lim.DFC_CmbChbMisfireMax_3_CA "/" VAL_BLK 0x80078B84 ValA_Wu16 8192. DINH_LimDFCVerb 12079. 20271. FORMAT "%2.0" NUMBER 5 /end CHARACTERISTIC
/begin CHARACTERISTIC DINH_Lim.DFC_CmbChbMisfireMax_4_CA "/" VAL_BLK 0x80078B8E ValA_Wu16 8192. DINH_LimDFCVerb 12079. 20271. FORMAT "%2.0" NUMBER 5 /end CHARACTERISTIC
/begin CHARACTERISTIC DINH_Lim.DFC_CmbChbMisfireMax_5_CA "/" VAL_BLK 0x80078B98 ValA_Wu16 8192. DINH_LimDFCVerb 12079. 20271. FORMAT "%2.0" NUMBER 5 /end CHARACTERISTIC
/begin CHARACTERISTIC DINH_Lim.DFC_CmbChbMisfireMul_CA "/" VAL_BLK 0x80078BA2 ValA_Wu16 8192. DINH_LimDFCVerb 12079. 20271. FORMAT "%2.0" NUMBER 5 /end CHARACTERISTIC
/begin CHARACTERISTIC DINH_Lim.DFC_INJVLVBUSY_CA "/" VAL_BLK 0x80078BAC ValA_Wu16 8192. DINH_LimDFCVerb 12079. 20271. FORMAT "%2.0" NUMBER 5 /end CHARACTERISTIC
/begin CHARACTERISTIC DINH_Lim.DFC_IVAdjIVA_0_CA "/" VAL_BLK 0x80078BB6 ValA_Wu16 8192. DINH_LimDFCVerb 12079. 20271. FORMAT "%2.0" NUMBER 5 /end CHARACTERISTIC
/begin CHARACTERISTIC DINH_Lim.DFC_IVAdjIVA_1_CA "/" VAL_BLK 0x80078BC0 ValA_Wu16 8192. DINH_LimDFCVerb 12079. 20271. FORMAT "%2.0" NUMBER 5 /end CHARACTERISTIC
/begin CHARACTERISTIC DINH_Lim.DFC_IVAdjIVA_2_CA "/" VAL_BLK 0x80078BCA ValA_Wu16 8192. DINH_LimDFCVerb 12079. 20271. FORMAT "%2.0" NUMBER 5 /end CHARACTERISTIC
/begin CHARACTERISTIC DINH_Lim.DFC_IVAdjIVA_3_CA "/" VAL_BLK 0x80078BD4 ValA_Wu16 8192. DINH_LimDFCVerb 12079. 20271. FORMAT "%2.0" NUMBER 5 /end CHARACTERISTIC
/begin CHARACTERISTIC DINH_Lim.DFC_IVAdjIVA_4_CA "/" VAL_BLK 0x80078BDE ValA_Wu16 8192. DINH_LimDFCVerb 12079. 20271. FORMAT "%2.0" NUMBER 5 /end CHARACTERISTIC
/begin CHARACTERISTIC DINH_Lim.DFC_IVAdjIVA_5_CA "/" VAL_BLK 0x80078BE8 ValA_Wu16 8192. DINH_LimDFCVerb 12079. 20271. FORMAT "%2.0" NUMBER 5 /end CHARACTERISTIC
/begin CHARACTERISTIC DINH_Lim.DFC_InjCtlAdjQntEEPCS_CA "/" VAL_BLK 0x80078BF2 ValA_Wu16 8192. DINH_LimDFCVerb 12079. 20271. FORMAT "%2.0" NUMBER 5 /end CHARACTERISTIC
/begin CHARACTERISTIC DINH_Lim.DFC_InjCtlDriftEEPCS_CA "/" VAL_BLK 0x80078BFC ValA_Wu16 8192. DINH_LimDFCVerb 12079. 20271. FORMAT "%2.0" NUMBER 5 /end CHARACTERISTIC
/begin CHARACTERISTIC DINH_Lim.DFC_MRlyErlyOpng_CA "/" VAL_BLK 0x80078C06 ValA_Wu16 8192. DINH_LimDFCVerb 12079. 20271. FORMAT "%2.0" NUMBER 5 /end CHARACTERISTIC
/begin CHARACTERISTIC DINH_Lim.DFC_MRlyStk_CA "/" VAL_BLK 0x80078C10 ValA_Wu16 8192. DINH_LimDFCVerb 12079. 20271. FORMAT "%2.0" NUMBER 5 /end CHARACTERISTIC
/begin CHARACTERISTIC DINH_Lim.DFC_SensFrzPPFltUs_CA "/" VAL_BLK 0x80078C1A ValA_Wu16 8192. DINH_LimDFCVerb 12079. 20271. FORMAT "%2.0" NUMBER 5 /end CHARACTERISTIC
/begin CHARACTERISTIC DINH_Lim.DFC_T15Sig_CA "/" VAL_BLK 0x80078C24 ValA_Wu16 8192. DINH_LimDFCVerb 12079. 20271. FORMAT "%2.0" NUMBER 5 /end CHARACTERISTIC
/begin CHARACTERISTIC DINH_Lim.DFC_AirCtlRmpTOut_CA "/" VAL_BLK 0x80078C2E ValA_Wu16 8192. DINH_LimDFCVerb 12079. 20271. FORMAT "%2.0" NUMBER 5 /end CHARACTERISTIC
/begin CHARACTERISTIC DINH_Lim.DFC_CEngDsTDynTst_CA "/" VAL_BLK 0x80078C38 ValA_Wu16 8192. DINH_LimDFCVerb 12079. 20271. FORMAT "%2.0" NUMBER 5 /end CHARACTERISTIC
/begin CHARACTERISTIC DINH_Lim.DFC_EGRVlvJamVlvClsd_CA "/" VAL_BLK 0x80078C42 ValA_Wu16 8192. DINH_LimDFCVerb 12079. 20271. FORMAT "%2.0" NUMBER 5 /end CHARACTERISTIC
/begin CHARACTERISTIC DINH_Lim.DFC_EGRVlvJamVlvOpn_CA "/" VAL_BLK 0x80078C4C ValA_Wu16 8192. DINH_LimDFCVerb 12079. 20271. FORMAT "%2.0" NUMBER 5 /end CHARACTERISTIC
/begin CHARACTERISTIC DINH_Lim.DFC_EGRVlvLgTDrft_CA "/" VAL_BLK 0x80078C56 ValA_Wu16 8192. DINH_LimDFCVerb 12079. 20271. FORMAT "%2.0" NUMBER 6 /end CHARACTERISTIC
/begin CHARACTERISTIC DINH_Lim.DFC_EGRVlvOfsLrnJamVlv_CA "/" VAL_BLK 0x80078C62 ValA_Wu16 8192. DINH_LimDFCVerb 12079. 20271. FORMAT "%2.0" NUMBER 6 /end CHARACTERISTIC
/begin CHARACTERISTIC DINH_Lim.DFC_EGRVlvShTDrft_CA "/" VAL_BLK 0x80078C6E ValA_Wu16 8192. DINH_LimDFCVerb 12079. 20271. FORMAT "%2.0" NUMBER 6 /end CHARACTERISTIC
/begin CHARACTERISTIC DINH_Lim.DFC_EGTRgnOilDilMax_CA "/" VAL_BLK 0x80078C7A ValA_Wu16 8192. DINH_LimDFCVerb 12079. 20271. FORMAT "%2.0" NUMBER 6 /end CHARACTERISTIC
/begin CHARACTERISTIC DINH_Lim.DFC_EngICO_CA "/" VAL_BLK 0x80078C86 ValA_Wu16 8192. DINH_LimDFCVerb 12079. 20271. FORMAT "%2.0" NUMBER 5 /end CHARACTERISTIC
/begin CHARACTERISTIC DINH_Lim.DFC_EpmCaSI1ErrSig_CA "/" VAL_BLK 0x80078C90 ValA_Wu16 8192. DINH_LimDFCVerb 12079. 20271. FORMAT "%2.0" NUMBER 7 /end CHARACTERISTIC
/begin CHARACTERISTIC DINH_Lim.DFC_EpmCaSI1NoSig_CA "/" VAL_BLK 0x80078C9E ValA_Wu16 8192. DINH_LimDFCVerb 12079. 20271. FORMAT "%2.0" NUMBER 7 /end CHARACTERISTIC
/begin CHARACTERISTIC DINH_Lim.DFC_EpmCaSI1OfsErr_CA "/" VAL_BLK 0x80078CAC ValA_Wu16 8192. DINH_LimDFCVerb 12079. 20271. FORMAT "%2.0" NUMBER 8 /end CHARACTERISTIC
/begin CHARACTERISTIC DINH_Lim.DFC_EpmCrSErrSig_CA "/" VAL_BLK 0x80078CBC ValA_Wu16 8192. DINH_LimDFCVerb 12079. 20271. FORMAT "%2.0" NUMBER 10 /end CHARACTERISTIC
/begin CHARACTERISTIC DINH_Lim.DFC_EpmCrSNoSig_CA "/" VAL_BLK 0x80078CD0 ValA_Wu16 8192. DINH_LimDFCVerb 12079. 20271. FORMAT "%2.0" NUMBER 10 /end CHARACTERISTIC
/begin CHARACTERISTIC DINH_Lim.DFC_MoCADCCmp_CA "/" VAL_BLK 0x80078CE4 ValA_Wu16 8192. DINH_LimDFCVerb 12079. 20271. FORMAT "%2.0" NUMBER 5 /end CHARACTERISTIC
/begin CHARACTERISTIC DINH_Lim.DFC_MoCADCTst_CA "/" VAL_BLK 0x80078CEE ValA_Wu16 8192. DINH_LimDFCVerb 12079. 20271. FORMAT "%2.0" NUMBER 5 /end CHARACTERISTIC
/begin CHARACTERISTIC DINH_Lim.DFC_MoCADCVltgRatio_CA "/" VAL_BLK 0x80078CF8 ValA_Wu16 8192. DINH_LimDFCVerb 12079. 20271. FORMAT "%2.0" NUMBER 5 /end CHARACTERISTIC
/begin CHARACTERISTIC DINH_Lim.DFC_MoCSOPLoLi_CA "/" VAL_BLK 0x80078D02 ValA_Wu16 8192. DINH_LimDFCVerb 12079. 20271. FORMAT "%2.0" NUMBER 5 /end CHARACTERISTIC
/begin CHARACTERISTIC DINH_Lim.DFC_MoCSOPMM_CA "/" VAL_BLK 0x80078D0C ValA_Wu16 8192. DINH_LimDFCVerb 12079. 20271. FORMAT "%2.0" NUMBER 5 /end CHARACTERISTIC
/begin CHARACTERISTIC DINH_Lim.DFC_MoCSOPTimeOut_CA "/" VAL_BLK 0x80078D16 ValA_Wu16 8192. DINH_LimDFCVerb 12079. 20271. FORMAT "%2.0" NUMBER 5 /end CHARACTERISTIC
/begin CHARACTERISTIC DINH_Lim.DFC_MoCSOPUpLi_CA "/" VAL_BLK 0x80078D20 ValA_Wu16 8192. DINH_LimDFCVerb 12079. 20271. FORMAT "%2.0" NUMBER 5 /end CHARACTERISTIC
/begin CHARACTERISTIC DINH_Lim.DFC_MoFAPP_CA "/" VAL_BLK 0x80078D2A ValA_Wu16 8192. DINH_LimDFCVerb 12079. 20271. FORMAT "%2.0" NUMBER 5 /end CHARACTERISTIC
/begin CHARACTERISTIC DINH_Lim.DFC_MoFESpd_CA "/" VAL_BLK 0x80078D34 ValA_Wu16 8192. DINH_LimDFCVerb 12079. 20271. FORMAT "%2.0" NUMBER 5 /end CHARACTERISTIC
/begin CHARACTERISTIC DINH_Lim.DFC_MoFInjDatPhi_CA "/" VAL_BLK 0x80078D3E ValA_Wu16 8192. DINH_LimDFCVerb 12079. 20271. FORMAT "%2.0" NUMBER 5 /end CHARACTERISTIC
/begin CHARACTERISTIC DINH_Lim.DFC_MoFInjDatQnt_CA "/" VAL_BLK 0x80078D48 ValA_Wu16 8192. DINH_LimDFCVerb 12079. 20271. FORMAT "%2.0" NUMBER 5 /end CHARACTERISTIC
/begin CHARACTERISTIC DINH_Lim.DFC_MoFInjQnt_CA "/" VAL_BLK 0x80078D52 ValA_Wu16 8192. DINH_LimDFCVerb 12079. 20271. FORMAT "%2.0" NUMBER 5 /end CHARACTERISTIC
/begin CHARACTERISTIC DINH_Lim.DFC_MoFOvR_CA "/" VAL_BLK 0x80078D5C ValA_Wu16 8192. DINH_LimDFCVerb 12079. 20271. FORMAT "%2.0" NUMBER 5 /end CHARACTERISTIC
/begin CHARACTERISTIC DINH_Lim.DFC_MoFQntCor_CA "/" VAL_BLK 0x80078D66 ValA_Wu16 8192. DINH_LimDFCVerb 12079. 20271. FORMAT "%2.0" NUMBER 5 /end CHARACTERISTIC
/begin CHARACTERISTIC DINH_Lim.DFC_MoFTrqCmp_CA "/" VAL_BLK 0x80078D70 ValA_Wu16 8192. DINH_LimDFCVerb 12079. 20271. FORMAT "%2.0" NUMBER 5 /end CHARACTERISTIC
/begin CHARACTERISTIC DINH_Lim.DFC_NplTOxiCatUs_CA "/" VAL_BLK 0x80078D7A ValA_Wu16 8192. DINH_LimDFCVerb 12079. 20271. FORMAT "%2.0" NUMBER 8 /end CHARACTERISTIC
/begin CHARACTERISTIC DINH_Lim.DFC_PhyModNonMonMapNpl_CA "/" VAL_BLK 0x80078D8A ValA_Wu16 8192. DINH_LimDFCVerb 12079. 20271. FORMAT "%2.0" NUMBER 5 /end CHARACTERISTIC
/begin CHARACTERISTIC DINH_Lim.DFC_RailPOfsTstMax_CA "/" VAL_BLK 0x80078D94 ValA_Wu16 8192. DINH_LimDFCVerb 12079. 20271. FORMAT "%2.0" NUMBER 14 /end CHARACTERISTIC
/begin CHARACTERISTIC DINH_Lim.DFC_RailPOfsTstMin_CA "/" VAL_BLK 0x80078DB0 ValA_Wu16 8192. DINH_LimDFCVerb 12079. 20271. FORMAT "%2.0" NUMBER 14 /end CHARACTERISTIC
/begin CHARACTERISTIC DINH_Lim.DFC_SWReset_0_CA "/" VAL_BLK 0x80078DCC ValA_Wu16 8192. DINH_LimDFCVerb 12079. 20271. FORMAT "%2.0" NUMBER 5 /end CHARACTERISTIC
/begin CHARACTERISTIC DINH_Lim.DFC_SWReset_1_CA "/" VAL_BLK 0x80078DD6 ValA_Wu16 8192. DINH_LimDFCVerb 12079. 20271. FORMAT "%2.0" NUMBER 5 /end CHARACTERISTIC
/begin CHARACTERISTIC DINH_Lim.DFC_SWReset_2_CA "/" VAL_BLK 0x80078DE0 ValA_Wu16 8192. DINH_LimDFCVerb 12079. 20271. FORMAT "%2.0" NUMBER 5 /end CHARACTERISTIC
/begin CHARACTERISTIC DINH_Lim.DFC_VSwVlvJamVlv_CA "/" VAL_BLK 0x80078DEA ValA_Wu16 8192. DINH_LimDFCVerb 12079. 20271. FORMAT "%2.0" NUMBER 6 /end CHARACTERISTIC
/begin CHARACTERISTIC DINH_Lim.DFC_VSwVlvLgTDrft_CA "/" VAL_BLK 0x80078DF6 ValA_Wu16 8192. DINH_LimDFCVerb 12079. 20271. FORMAT "%2.0" NUMBER 6 /end CHARACTERISTIC
/begin CHARACTERISTIC DINH_Lim.DFC_VSwVlvOfsLrnJamVlv_CA "/" VAL_BLK 0x80078E02 ValA_Wu16 8192. DINH_LimDFCVerb 12079. 20271. FORMAT "%2.0" NUMBER 6 /end CHARACTERISTIC
/begin CHARACTERISTIC DINH_Lim.DFC_VSwVlvShTDrft_CA "/" VAL_BLK 0x80078E0E ValA_Wu16 8192. DINH_LimDFCVerb 12079. 20271. FORMAT "%2.0" NUMBER 6 /end CHARACTERISTIC
/begin CHARACTERISTIC DINH_Lim.DSQ_AFS_CA "/" VAL_BLK 0x80078E1A ValA_Wu16 15. DINH_LimDSQVerb 0.00 15. FORMAT "%2.0" NUMBER 5 /end CHARACTERISTIC
/begin CHARACTERISTIC DINH_Lim.DSQ_BattU_CA "/" VAL_BLK 0x80078E24 ValA_Wu16 15. DINH_LimDSQVerb 0.00 15. FORMAT "%2.0" NUMBER 5 /end CHARACTERISTIC
/begin CHARACTERISTIC DINH_Lim.DSQ_BrkP_CA "/" VAL_BLK 0x80078E2E ValA_Wu16 15. DINH_LimDSQVerb 0.00 15. FORMAT "%2.0" NUMBER 5 /end CHARACTERISTIC
/begin CHARACTERISTIC DINH_Lim.DSQ_CByVlvActr_CA "/" VAL_BLK 0x80078E38 ValA_Wu16 15. DINH_LimDSQVerb 0.00 15. FORMAT "%2.0" NUMBER 5 /end CHARACTERISTIC
/begin CHARACTERISTIC DINH_Lim.DSQ_CEngDsT_CA "/" VAL_BLK 0x80078E42 ValA_Wu16 15. DINH_LimDSQVerb 0.00 15. FORMAT "%2.0" NUMBER 6 /end CHARACTERISTIC
/begin CHARACTERISTIC DINH_Lim.DSQ_CEngUsT_CA "/" VAL_BLK 0x80078E4E ValA_Wu16 15. DINH_LimDSQVerb 0.00 15. FORMAT "%2.0" NUMBER 5 /end CHARACTERISTIC
/begin CHARACTERISTIC DINH_Lim.DSQ_CThmstActr_CA "/" VAL_BLK 0x80078E58 ValA_Wu16 15. DINH_LimDSQVerb 0.00 15. FORMAT "%2.0" NUMBER 5 /end CHARACTERISTIC
/begin CHARACTERISTIC DINH_Lim.DSQ_Com_aDirect_CA "/" VAL_BLK 0x80078E62 ValA_Wu16 15. DINH_LimDSQVerb 0.00 15. FORMAT "%2.0" NUMBER 5 /end CHARACTERISTIC
/begin CHARACTERISTIC DINH_Lim.DSQ_Com_aSide_CA "/" VAL_BLK 0x80078E6C ValA_Wu16 15. DINH_LimDSQVerb 0.00 15. FORMAT "%2.0" NUMBER 5 /end CHARACTERISTIC
/begin CHARACTERISTIC DINH_Lim.DSQ_Com_nTSC_CA "/" VAL_BLK 0x80078E76 ValA_Wu16 15. DINH_LimDSQVerb 0.00 15. FORMAT "%2.0" NUMBER 5 /end CHARACTERISTIC
/begin CHARACTERISTIC DINH_Lim.DSQ_Com_pBrkSys_CA "/" VAL_BLK 0x80078E80 ValA_Wu16 15. DINH_LimDSQVerb 0.00 15. FORMAT "%2.0" NUMBER 6 /end CHARACTERISTIC
/begin CHARACTERISTIC DINH_Lim.DSQ_Com_stButtonMSA_CA "/" VAL_BLK 0x80078E8C ValA_Wu16 15. DINH_LimDSQVerb 0.00 15. FORMAT "%2.0" NUMBER 5 /end CHARACTERISTIC
/begin CHARACTERISTIC DINH_Lim.DSQ_Com_stClCtr_CA "/" VAL_BLK 0x80078E96 ValA_Wu16 15. DINH_LimDSQVerb 0.00 15. FORMAT "%2.0" NUMBER 5 /end CHARACTERISTIC
/begin CHARACTERISTIC DINH_Lim.DSQ_Com_stDSC_CA "/" VAL_BLK 0x80078EA0 ValA_Wu16 15. DINH_LimDSQVerb 0.00 15. FORMAT "%2.0" NUMBER 5 /end CHARACTERISTIC
/begin CHARACTERISTIC DINH_Lim.DSQ_Com_stDecellDSC_CA "/" VAL_BLK 0x80078EAA ValA_Wu16 15. DINH_LimDSQVerb 0.00 15. FORMAT "%2.0" NUMBER 5 /end CHARACTERISTIC
/begin CHARACTERISTIC DINH_Lim.DSQ_Com_stDrWghSeat_CA "/" VAL_BLK 0x80078EB4 ValA_Wu16 15. DINH_LimDSQVerb 0.00 15. FORMAT "%2.0" NUMBER 5 /end CHARACTERISTIC
/begin CHARACTERISTIC DINH_Lim.DSQ_Com_stGear_CA "/" VAL_BLK 0x80078EBE ValA_Wu16 15. DINH_LimDSQVerb 0.00 15. FORMAT "%2.0" NUMBER 5 /end CHARACTERISTIC
/begin CHARACTERISTIC DINH_Lim.DSQ_Com_stKeyVld_CA "/" VAL_BLK 0x80078EC8 ValA_Wu16 15. DINH_LimDSQVerb 0.00 15. FORMAT "%2.0" NUMBER 5 /end CHARACTERISTIC
/begin CHARACTERISTIC DINH_Lim.DSQ_Com_stReqMSA_CA "/" VAL_BLK 0x80078ED2 ValA_Wu16 15. DINH_LimDSQVerb 0.00 15. FORMAT "%2.0" NUMBER 5 /end CHARACTERISTIC
/begin CHARACTERISTIC DINH_Lim.DSQ_Com_stT15_CA "/" VAL_BLK 0x80078EDC ValA_Wu16 15. DINH_LimDSQVerb 0.00 15. FORMAT "%2.0" NUMBER 7 /end CHARACTERISTIC
/begin CHARACTERISTIC DINH_Lim.DSQ_Com_stT50_CA "/" VAL_BLK 0x80078EEA ValA_Wu16 15. DINH_LimDSQVerb 0.00 15. FORMAT "%2.0" NUMBER 5 /end CHARACTERISTIC
/begin CHARACTERISTIC DINH_Lim.DSQ_Com_stTrqDSCDes_CA "/" VAL_BLK 0x80078EF4 ValA_Wu16 15. DINH_LimDSQVerb 0.00 15. FORMAT "%2.0" NUMBER 5 /end CHARACTERISTIC
/begin CHARACTERISTIC DINH_Lim.DSQ_Com_swtDrBltb_CA "/" VAL_BLK 0x80078EFE ValA_Wu16 15. DINH_LimDSQVerb 0.00 15. FORMAT "%2.0" NUMBER 5 /end CHARACTERISTIC
/begin CHARACTERISTIC DINH_Lim.DSQ_Com_tEnvT_CA "/" VAL_BLK 0x80078F08 ValA_Wu16 15. DINH_LimDSQVerb 0.00 15. FORMAT "%2.0" NUMBER 5 /end CHARACTERISTIC
/begin CHARACTERISTIC DINH_Lim.DSQ_Com_tGbxOil_CA "/" VAL_BLK 0x80078F12 ValA_Wu16 15. DINH_LimDSQVerb 0.00 15. FORMAT "%2.0" NUMBER 6 /end CHARACTERISTIC
/begin CHARACTERISTIC DINH_Lim.DSQ_Com_trqAC_CA "/" VAL_BLK 0x80078F1E ValA_Wu16 15. DINH_LimDSQVerb 0.00 15. FORMAT "%2.0" NUMBER 5 /end CHARACTERISTIC
/begin CHARACTERISTIC DINH_Lim.DSQ_Com_trqARSCur_CA "/" VAL_BLK 0x80078F28 ValA_Wu16 15. DINH_LimDSQVerb 0.00 15. FORMAT "%2.0" NUMBER 5 /end CHARACTERISTIC
/begin CHARACTERISTIC DINH_Lim.DSQ_Com_trqARSDes_CA "/" VAL_BLK 0x80078F32 ValA_Wu16 15. DINH_LimDSQVerb 0.00 15. FORMAT "%2.0" NUMBER 5 /end CHARACTERISTIC
/begin CHARACTERISTIC DINH_Lim.DSQ_Com_trqAvlAFS_CA "/" VAL_BLK 0x80078F3C ValA_Wu16 15. DINH_LimDSQVerb 0.00 15. FORMAT "%2.0" NUMBER 5 /end CHARACTERISTIC
/begin CHARACTERISTIC DINH_Lim.DSQ_Com_trqDSCDes_CA "/" VAL_BLK 0x80078F46 ValA_Wu16 15. DINH_LimDSQVerb 0.00 15. FORMAT "%2.0" NUMBER 7 /end CHARACTERISTIC
/begin CHARACTERISTIC DINH_Lim.DSQ_Com_trqGbxDes_CA "/" VAL_BLK 0x80078F54 ValA_Wu16 15. DINH_LimDSQVerb 0.00 15. FORMAT "%2.0" NUMBER 6 /end CHARACTERISTIC
/begin CHARACTERISTIC DINH_Lim.DSQ_Com_trqGbxFrc_CA "/" VAL_BLK 0x80078F60 ValA_Wu16 15. DINH_LimDSQVerb 0.00 15. FORMAT "%2.0" NUMBER 6 /end CHARACTERISTIC
/begin CHARACTERISTIC DINH_Lim.DSQ_Com_trqGbxMax_CA "/" VAL_BLK 0x80078F6C ValA_Wu16 15. DINH_LimDSQVerb 0.00 15. FORMAT "%2.0" NUMBER 6 /end CHARACTERISTIC
/begin CHARACTERISTIC DINH_Lim.DSQ_Com_trqTarAFS_CA "/" VAL_BLK 0x80078F78 ValA_Wu16 15. DINH_LimDSQVerb 0.00 15. FORMAT "%2.0" NUMBER 5 /end CHARACTERISTIC
/begin CHARACTERISTIC DINH_Lim.DSQ_Com_v_CA "/" VAL_BLK 0x80078F82 ValA_Wu16 15. DINH_LimDSQVerb 0.00 15. FORMAT "%2.0" NUMBER 5 /end CHARACTERISTIC
/begin CHARACTERISTIC DINH_Lim.DSQ_Com_vBd_CA "/" VAL_BLK 0x80078F8C ValA_Wu16 15. DINH_LimDSQVerb 0.00 15. FORMAT "%2.0" NUMBER 7 /end CHARACTERISTIC
/begin CHARACTERISTIC DINH_Lim.DSQ_DSMInhibitAlways_CA "/" VAL_BLK 0x80078F9A ValA_Wu16 15. DINH_LimDSQVerb 0.00 15. FORMAT "%2.0" NUMBER 6 /end CHARACTERISTIC
/begin CHARACTERISTIC DINH_Lim.DSQ_ECBVlvActr_CA "/" VAL_BLK 0x80078FA6 ValA_Wu16 15. DINH_LimDSQVerb 0.00 15. FORMAT "%2.0" NUMBER 5 /end CHARACTERISTIC
/begin CHARACTERISTIC DINH_Lim.DSQ_ECBVlvSens_CA "/" VAL_BLK 0x80078FB0 ValA_Wu16 15. DINH_LimDSQVerb 0.00 15. FORMAT "%2.0" NUMBER 5 /end CHARACTERISTIC
/begin CHARACTERISTIC DINH_Lim.DSQ_EGRVlvActr_CA "/" VAL_BLK 0x80078FBA ValA_Wu16 15. DINH_LimDSQVerb 0.00 15. FORMAT "%2.0" NUMBER 6 /end CHARACTERISTIC
/begin CHARACTERISTIC DINH_Lim.DSQ_EGRVlvSens_CA "/" VAL_BLK 0x80078FC6 ValA_Wu16 15. DINH_LimDSQVerb 0.00 15. FORMAT "%2.0" NUMBER 5 /end CHARACTERISTIC
/begin CHARACTERISTIC DINH_Lim.DSQ_EMDmp_0_CA "/" VAL_BLK 0x80078FD0 ValA_Wu16 15. DINH_LimDSQVerb 0.00 15. FORMAT "%2.0" NUMBER 5 /end CHARACTERISTIC
/begin CHARACTERISTIC DINH_Lim.DSQ_EMDmp_1_CA "/" VAL_BLK 0x80078FDA ValA_Wu16 15. DINH_LimDSQVerb 0.00 15. FORMAT "%2.0" NUMBER 5 /end CHARACTERISTIC
/begin CHARACTERISTIC DINH_Lim.DSQ_EngPrtFWOsc_CA "/" VAL_BLK 0x80078FE4 ValA_Wu16 15. DINH_LimDSQVerb 0.00 15. FORMAT "%2.0" NUMBER 10 /end CHARACTERISTIC
/begin CHARACTERISTIC DINH_Lim.DSQ_EnvP_CA "/" VAL_BLK 0x80078FF8 ValA_Wu16 15. DINH_LimDSQVerb 0.00 15. FORMAT "%2.0" NUMBER 6 /end CHARACTERISTIC
/begin CHARACTERISTIC DINH_Lim.DSQ_EnvT_CA "/" VAL_BLK 0x80079004 ValA_Wu16 15. DINH_LimDSQVerb 0.00 15. FORMAT "%2.0" NUMBER 5 /end CHARACTERISTIC
/begin CHARACTERISTIC DINH_Lim.DSQ_FanActr_CA "/" VAL_BLK 0x8007900E ValA_Wu16 15. DINH_LimDSQVerb 0.00 15. FORMAT "%2.0" NUMBER 5 /end CHARACTERISTIC
/begin CHARACTERISTIC DINH_Lim.DSQ_FuelT_CA "/" VAL_BLK 0x80079018 ValA_Wu16 15. DINH_LimDSQVerb 0.00 15. FORMAT "%2.0" NUMBER 5 /end CHARACTERISTIC
/begin CHARACTERISTIC DINH_Lim.DSQ_LAYER2EDCMSAStp_CA "/" VAL_BLK 0x80079022 ValA_Wu16 15. DINH_LimDSQVerb 0.00 15. FORMAT "%2.0" NUMBER 5 /end CHARACTERISTIC
/begin CHARACTERISTIC DINH_Lim.DSQ_LSUO2_0_CA "/" VAL_BLK 0x8007902C ValA_Wu16 15. DINH_LimDSQVerb 0.00 15. FORMAT "%2.0" NUMBER 5 /end CHARACTERISTIC
/begin CHARACTERISTIC DINH_Lim.DSQ_LSUO2_1_CA "/" VAL_BLK 0x80079036 ValA_Wu16 15. DINH_LimDSQVerb 0.00 15. FORMAT "%2.0" NUMBER 5 /end CHARACTERISTIC
/begin CHARACTERISTIC DINH_Lim.DSQ_LSUO2_2_CA "/" VAL_BLK 0x80079040 ValA_Wu16 15. DINH_LimDSQVerb 0.00 15. FORMAT "%2.0" NUMBER 5 /end CHARACTERISTIC
/begin CHARACTERISTIC DINH_Lim.DSQ_LSUO2_3_CA "/" VAL_BLK 0x8007904A ValA_Wu16 15. DINH_LimDSQVerb 0.00 15. FORMAT "%2.0" NUMBER 5 /end CHARACTERISTIC
/begin CHARACTERISTIC DINH_Lim.DSQ_MeUnActr_CA "/" VAL_BLK 0x80079054 ValA_Wu16 15. DINH_LimDSQVerb 0.00 15. FORMAT "%2.0" NUMBER 5 /end CHARACTERISTIC
/begin CHARACTERISTIC DINH_Lim.DSQ_NSCDsRLamO2_CA "/" VAL_BLK 0x8007905E ValA_Wu16 15. DINH_LimDSQVerb 0.00 15. FORMAT "%2.0" NUMBER 5 /end CHARACTERISTIC
/begin CHARACTERISTIC DINH_Lim.DSQ_OilStSens_CA "/" VAL_BLK 0x80079068 ValA_Wu16 15. DINH_LimDSQVerb 0.00 15. FORMAT "%2.0" NUMBER 5 /end CHARACTERISTIC
/begin CHARACTERISTIC DINH_Lim.DSQ_OilT_CA "/" VAL_BLK 0x80079072 ValA_Wu16 15. DINH_LimDSQVerb 0.00 15. FORMAT "%2.0" NUMBER 5 /end CHARACTERISTIC
/begin CHARACTERISTIC DINH_Lim.DSQ_PAirFltDs_CA "/" VAL_BLK 0x8007907C ValA_Wu16 15. DINH_LimDSQVerb 0.00 15. FORMAT "%2.0" NUMBER 5 /end CHARACTERISTIC
/begin CHARACTERISTIC DINH_Lim.DSQ_PCACDs_CA "/" VAL_BLK 0x80079086 ValA_Wu16 15. DINH_LimDSQVerb 0.00 15. FORMAT "%2.0" NUMBER 6 /end CHARACTERISTIC
/begin CHARACTERISTIC DINH_Lim.DSQ_PCVActr_CA "/" VAL_BLK 0x80079092 ValA_Wu16 15. DINH_LimDSQVerb 0.00 15. FORMAT "%2.0" NUMBER 5 /end CHARACTERISTIC
/begin CHARACTERISTIC DINH_Lim.DSQ_PPFltUs_CA "/" VAL_BLK 0x8007909C ValA_Wu16 15. DINH_LimDSQVerb 0.00 15. FORMAT "%2.0" NUMBER 5 /end CHARACTERISTIC
/begin CHARACTERISTIC DINH_Lim.DSQ_TAFS_CA "/" VAL_BLK 0x800790A6 ValA_Wu16 15. DINH_LimDSQVerb 0.00 15. FORMAT "%2.0" NUMBER 5 /end CHARACTERISTIC
/begin CHARACTERISTIC DINH_Lim.DSQ_TCACDs_CA "/" VAL_BLK 0x800790B0 ValA_Wu16 15. DINH_LimDSQVerb 0.00 15. FORMAT "%2.0" NUMBER 6 /end CHARACTERISTIC
/begin CHARACTERISTIC DINH_Lim.DSQ_TECU_CA "/" VAL_BLK 0x800790BC ValA_Wu16 15. DINH_LimDSQVerb 0.00 15. FORMAT "%2.0" NUMBER 5 /end CHARACTERISTIC
/begin CHARACTERISTIC DINH_Lim.DSQ_TOxiCatUs_CA "/" VAL_BLK 0x800790C6 ValA_Wu16 15. DINH_LimDSQVerb 0.00 15. FORMAT "%2.0" NUMBER 5 /end CHARACTERISTIC
/begin CHARACTERISTIC DINH_Lim.DSQ_TPFltUs_CA "/" VAL_BLK 0x800790D0 ValA_Wu16 15. DINH_LimDSQVerb 0.00 15. FORMAT "%2.0" NUMBER 5 /end CHARACTERISTIC
/begin CHARACTERISTIC DINH_Lim.DSQ_ThrVlvActr_CA "/" VAL_BLK 0x800790DA ValA_Wu16 15. DINH_LimDSQVerb 0.00 15. FORMAT "%2.0" NUMBER 6 /end CHARACTERISTIC
/begin CHARACTERISTIC DINH_Lim.DSQ_ThrVlvSens_CA "/" VAL_BLK 0x800790E6 ValA_Wu16 15. DINH_LimDSQVerb 0.00 15. FORMAT "%2.0" NUMBER 5 /end CHARACTERISTIC
/begin CHARACTERISTIC DINH_Lim.DSQ_TrbChActr_CA "/" VAL_BLK 0x800790F0 ValA_Wu16 15. DINH_LimDSQVerb 0.00 15. FORMAT "%2.0" NUMBER 7 /end CHARACTERISTIC
/begin CHARACTERISTIC DINH_Lim.DSQ_TrbChLPActr_CA "/" VAL_BLK 0x800790FE ValA_Wu16 15. DINH_LimDSQVerb 0.00 15. FORMAT "%2.0" NUMBER 5 /end CHARACTERISTIC
/begin CHARACTERISTIC DINH_Lim.DSQ_TrbChSens_CA "/" VAL_BLK 0x80079108 ValA_Wu16 15. DINH_LimDSQVerb 0.00 15. FORMAT "%2.0" NUMBER 5 /end CHARACTERISTIC
/begin CHARACTERISTIC DINH_Lim.DSQ_TrbnDsRLamO2_CA "/" VAL_BLK 0x80079112 ValA_Wu16 15. DINH_LimDSQVerb 0.00 15. FORMAT "%2.0" NUMBER 5 /end CHARACTERISTIC
/begin CHARACTERISTIC DINH_Lim.DSQ_VSwVlvActr_CA "/" VAL_BLK 0x8007911C ValA_Wu16 15. DINH_LimDSQVerb 0.00 15. FORMAT "%2.0" NUMBER 6 /end CHARACTERISTIC
/begin CHARACTERISTIC DINH_Lim.DSQ_VSwVlvSens_CA "/" VAL_BLK 0x80079128 ValA_Wu16 15. DINH_LimDSQVerb 0.00 15. FORMAT "%2.0" NUMBER 5 /end CHARACTERISTIC
/begin CHARACTERISTIC DINH_Lim.DSQ_VehV_CA "/" VAL_BLK 0x80079132 ValA_Wu16 15. DINH_LimDSQVerb 0.00 15. FORMAT "%2.0" NUMBER 6 /end CHARACTERISTIC
/begin CHARACTERISTIC DINH_Lim.DSQ_WaHtElActr_CA "/" VAL_BLK 0x8007913E ValA_Wu16 15. DINH_LimDSQVerb 0.00 15. FORMAT "%2.0" NUMBER 5 /end CHARACTERISTIC
/begin CHARACTERISTIC DINH_Lim.DSQ_stAPP_CA "/" VAL_BLK 0x80079148 ValA_Wu16 15. DINH_LimDSQVerb 0.00 15. FORMAT "%2.0" NUMBER 7 /end CHARACTERISTIC
/begin CHARACTERISTIC DINH_Lim.DSQ_stAPP1_CA "/" VAL_BLK 0x80079156 ValA_Wu16 15. DINH_LimDSQVerb 0.00 15. FORMAT "%2.0" NUMBER 10 /end CHARACTERISTIC
/begin CHARACTERISTIC DINH_Lim.DSQ_stAPP2_CA "/" VAL_BLK 0x8007916A ValA_Wu16 15. DINH_LimDSQVerb 0.00 15. FORMAT "%2.0" NUMBER 11 /end CHARACTERISTIC
/begin CHARACTERISTIC DINH_Lim.DSQ_stLSUSrvTstDem_CA "/" VAL_BLK 0x80079180 ValA_Wu16 15. DINH_LimDSQVerb 0.00 15. FORMAT "%2.0" NUMBER 5 /end CHARACTERISTIC
/begin CHARACTERISTIC Dio_idxBrkMnID_C "" VALUE 0x8007918A Val_Wu16 65535.00 OneToOne 0.00 65535.00 FORMAT "%8.2" /end CHARACTERISTIC
/begin CHARACTERISTIC Dio_idxBrkRedID_C "" VALUE 0x8007918C Val_Wu16 65535.00 OneToOne 0.00 65535.00 FORMAT "%8.2" /end CHARACTERISTIC
/begin CHARACTERISTIC DIUMPR_Check_CA "" VAL_BLK 0x8007918E ValA_Wu16 576. DFC_Verb 0.00 576. FORMAT "%2.0" NUMBER 2 /end CHARACTERISTIC
/begin CHARACTERISTIC DIUMPR_ctGen.tiIgnMin_C "Kriterien zum Inkrementieren von General Denominator und Ignition counter/minimale Startzeit für den Ignition counter" VALUE 0x8004B868 Val_Wu8 25.50 DIUMPR_ti100ms 0.00 25.50 FORMAT "%5.2" /end CHARACTERISTIC
/begin CHARACTERISTIC DIUMPR_ctGen.tiActrMin_C "Kriterien zum Inkrementieren von General Denominator und Ignition counter/minimale Aktivierungszeit für die physikalische Freigabe einer Komponente" VALUE 0x8004B869 Val_Wu8 25.50 DIUMPR_ti100ms 0.00 25.50 FORMAT "%5.2" /end CHARACTERISTIC
/begin CHARACTERISTIC DIUMPR_ctGen.tiVehSpdMin_C "Kriterien zum Inkrementieren von General Denominator und Ignition counter/minimale Betriebszeit über einer Geschwindigkeitsgrenze" VALUE 0x8004B86A Val_Ws16 6553.500 DIUMPR_ti100ms -3276.800 3276.700 FORMAT "%8.3" /end CHARACTERISTIC
/begin CHARACTERISTIC DIUMPR_ctGen.nIgnMin_C "Kriterien zum Inkrementieren von General Denominator und Ignition counter/Drehzahlgrenze für Motorstarterkennung" VALUE 0x8004B86C Val_Ws16 32767.50 EngN -16384.00 16383.50 FORMAT "%8.2" /end CHARACTERISTIC
/begin CHARACTERISTIC DIUMPR_ctGen.pEnvMin_C "Kriterien zum Inkrementieren von General Denominator und Ignition counter/max. Höhe über Meerespiegel (representiert durch Mindestumgebungsdruck)" VALUE 0x8004B86E Val_Ws16 36268.00 Pres_hPa -32768.00 3500.00 FORMAT "%8.2" EXTENDED_LIMITS -32768.00 32767.00 /end CHARACTERISTIC
/begin CHARACTERISTIC DIUMPR_ctGen.vVehMin_C "Kriterien zum Inkrementieren von General Denominator und Ignition counter/minimale Fahrzeuggeschwindigkeit" VALUE 0x8004B870 Val_Ws16 655.3500 Vel -327.6800 327.6700 FORMAT "%8.4" /end CHARACTERISTIC
/begin CHARACTERISTIC DIUMPR_ctGen.rAPPMax_C "Kriterien zum Inkrementieren von General Denominator und Ignition counter/maximaler Pedalwert in Ruhestellung" VALUE 0x8004B872 Val_Ws16 799.9878 Prc -400.0000 399.9878 FORMAT "%8.4" /end CHARACTERISTIC
/begin CHARACTERISTIC DIUMPR_ctGen.vVehIdlMax_C "Kriterien zum Inkrementieren von General Denominator und Ignition counter/maximale Fahrzeuggeschwindigkeit für die Leerlauferkennung" VALUE 0x8004B874 Val_Ws16 655.3500 Vel -327.6800 327.6700 FORMAT "%8.4" /end CHARACTERISTIC
/begin CHARACTERISTIC DIUMPR_ctGen.tEnvMin_C "Kriterien zum Inkrementieren von General Denominator und Ignition counter/minimale Umgebungstemperatur" VALUE 0x8004B876 Val_Ws16 6553.500 Temp_Cels -3549.940 3003.560 FORMAT "%8.3" /end CHARACTERISTIC
/begin CHARACTERISTIC DIUMPR_ctGen.tiIdlMin_C "Kriterien zum Inkrementieren von General Denominator und Ignition counter/minimale Betriebszeit im Leerlauf" VALUE 0x8004B878 Val_Ws16 6553.500 DIUMPR_ti100ms -3276.800 3276.700 FORMAT "%8.3" /end CHARACTERISTIC
/begin CHARACTERISTIC DIUMPR_ctGen.tiOpMin_C "Kriterien zum Inkrementieren von General Denominator und Ignition counter/minimale Betriebszeit seit Motorstart" VALUE 0x8004B87A Val_Ws16 6553.500 DIUMPR_ti100ms -3276.800 3276.700 FORMAT "%8.3" /end CHARACTERISTIC
/begin CHARACTERISTIC DIUMPR_ctRatioIdx_CA "" VAL_BLK 0x80079192 ValA_Wu8 1.000 OneToOne 0.00 1.000 FORMAT "%5.3" EXTENDED_LIMITS 0.00 255.0 NUMBER 2 /end CHARACTERISTIC
/begin CHARACTERISTIC DIUMPR_FID_CA "" VAL_BLK 0x80079194 ValA_Wu16 413. DINH_FIdVerb 0.00 413. FORMAT "%2.0" NUMBER 2 /end CHARACTERISTIC
/begin CHARACTERISTIC DIUMPR_Group_CA "" VAL_BLK 0x80079198 ValA_Wu8 8.00000000000 DIUMPR_GroupVerb 0.00 8.00000000000 FORMAT "%13.11" NUMBER 2 /end CHARACTERISTIC
/begin CHARACTERISTIC DIUMPR_numSigActv_CA "" VAL_BLK 0x8007919A ValA_Wu16 161.000000000 Signals_IntSigNumVerb 0.00 161.000000000 FORMAT "%13.9" NUMBER 2 /end CHARACTERISTIC
/begin CHARACTERISTIC DIUMPR_valSigActvMax_CA "" VAL_BLK 0x8007919E ValA_Wu16 65535.00 OneToOne 0.00 65535.00 FORMAT "%8.2" NUMBER 2 /end CHARACTERISTIC
/begin CHARACTERISTIC DIUMPR_valSigActvMin_CA "" VAL_BLK 0x800791A2 ValA_Wu16 65535.00 OneToOne 0.00 65535.00 FORMAT "%8.2" NUMBER 2 /end CHARACTERISTIC
/begin CHARACTERISTIC DSCHED_idxWTTEnd_C "" VALUE 0x8004B87C Val_Wu8 255.0000 DINH_OneToOne 0.00 255.0000 FORMAT "%8.4" /end CHARACTERISTIC
/begin CHARACTERISTIC DSCHED_idxWTTStrt_C "" VALUE 0x8004B87D Val_Wu8 255.0000 DINH_OneToOne 0.00 255.0000 FORMAT "%8.4" /end CHARACTERISTIC
/begin CHARACTERISTIC DSCHED_stMode_C "" VALUE 0x8004B87E Val_Wu8 255.0000 DINH_OneToOne 0.00 255.0000 FORMAT "%8.4" /end CHARACTERISTIC
/begin CHARACTERISTIC DSCHED_valDflOpMode_C "" VALUE 0x8004B880 Val_Wu16 65535.00 DINH_OneToOne 0.00 65535.00 FORMAT "%8.2" /end CHARACTERISTIC
/begin CHARACTERISTIC DSCHED_valOfsPrioNoTst_C "" VALUE 0x8004B882 Val_Wu16 65535.00 DINH_OneToOne 0.00 65535.00 FORMAT "%8.2" /end CHARACTERISTIC
/begin CHARACTERISTIC DSCHED_valOfsPrioOpMode_C "" VALUE 0x8004B884 Val_Wu16 65535.00 DINH_OneToOne 0.00 65535.00 FORMAT "%8.2" /end CHARACTERISTIC
/begin CHARACTERISTIC DSCHED_valOfsPrioTst_C "" VALUE 0x8004B886 Val_Wu16 65535.00 DINH_OneToOne 0.00 65535.00 FORMAT "%8.2" /end CHARACTERISTIC
/begin CHARACTERISTIC DSCHED_xFctTstFId_CA "" VAL_BLK 0x8004B888 ValA_Wu8 5. DSCHED_FIdVerb 0.00 5. FORMAT "%2.0" NUMBER 7 /end CHARACTERISTIC
/begin CHARACTERISTIC DSCHED_xSleepFId_CA "" VAL_BLK 0x8004B88F ValA_Wu8 5. DSCHED_FIdVerb 0.00 5. FORMAT "%2.0" NUMBER 5 /end CHARACTERISTIC
/begin MEASUREMENT DIUMPR_ctDenom "" UWORD OneToOne 1 100 0.00 65535.00 FORMAT "%8.2" ARRAY_SIZE 2 ECU_ADDRESS 0xD000CE86 /end MEASUREMENT
/begin MEASUREMENT DIUMPR_ctGenDenom "general denominator" UWORD DFES_OneToOne 1 100 0.00 65535.00 FORMAT "%8.2" ECU_ADDRESS 0xD000CE8A /end MEASUREMENT
/begin MEASUREMENT DIUMPR_ctIgn "ignition cycle counter" UWORD DFES_OneToOne 1 100 0.00 65535.00 FORMAT "%8.2" ECU_ADDRESS 0xD000CE8C /end MEASUREMENT
/begin MEASUREMENT DIUMPR_ctNum "" UWORD OneToOne 1 100 0.00 65535.00 FORMAT "%8.2" ARRAY_SIZE 2 ECU_ADDRESS 0xD000CE82 /end MEASUREMENT
/begin MEASUREMENT DIUMPR_numIndGrp "" UBYTE OneToOne 1 100 0.00 255.0 FORMAT "%5.1" ARRAY_SIZE 8 ECU_ADDRESS 0xD00087D6 /end MEASUREMENT
/begin MEASUREMENT DIUMPR_rMBGrp "" UWORD Fact 1 100 0.00 7.999878 FORMAT "%8.6" ARRAY_SIZE 2 ECU_ADDRESS 0xD00062E8 /end MEASUREMENT
/begin MEASUREMENT DIUMPR_rValRatMin "" UWORD Fact 1 100 0.00 7.999878 FORMAT "%8.6" ARRAY_SIZE 8 ECU_ADDRESS 0xD00062D8 /end MEASUREMENT
/begin MEASUREMENT DIUMPR_state "" UBYTE OneToOne 1 100 0.00 255.0 FORMAT "%5.1" ARRAY_SIZE 2 ECU_ADDRESS 0xD00087D2 /end MEASUREMENT
/begin MEASUREMENT DIUMPR_stEnaDenom "status von general denominator und ignition cycle counter" UBYTE DFES_OneToOne 1 100 0.00 255.0 FORMAT "%5.1" ECU_ADDRESS 0xD000955A /end MEASUREMENT
/begin MEASUREMENT DIUMPR_stFIdGenDenom_mp "FId status (Mode 7 Sichtbarkeit) des general denominator" UBYTE OneToOne 1 100 0.00 255.0 FORMAT "%5.1" ECU_ADDRESS 0xC000069A /end MEASUREMENT
/begin MEASUREMENT DIUMPR_tiEngOpCum "kumulierte Betriebszeit seit Motorstart" UWORD DIUMPR_ti100ms 1 100 0.00 6553.500 FORMAT "%8.3" ECU_ADDRESS 0xD0007FF2 /end MEASUREMENT
/begin MEASUREMENT DIUMPR_tiIdl "ununterbrochene Betriebszeit im Leerlauf" UWORD DIUMPR_ti100ms 1 100 0.00 6553.500 FORMAT "%8.3" ECU_ADDRESS 0xD0007FF4 /end MEASUREMENT
/begin MEASUREMENT DIUMPR_tiIgn "ununterbrochene Betriebszeit seit Motorstart" UBYTE DIUMPR_ti100ms 1 100 0.00 25.50 FORMAT "%5.2" ECU_ADDRESS 0xD000955B /end MEASUREMENT
/begin MEASUREMENT DIUMPR_tiSigActv "" UBYTE DIUMPR_ti100ms 1 100 0.00 25.50 FORMAT "%5.2" ARRAY_SIZE 2 ECU_ADDRESS 0xD00087D4 /end MEASUREMENT
/begin MEASUREMENT DIUMPR_tiVehSpdCum "kumulierte Beriebszeit über einer Geschwindigkeitsgrenze" UWORD DIUMPR_ti100ms 1 100 0.00 6553.500 FORMAT "%8.3" ECU_ADDRESS 0xD0007FF0 /end MEASUREMENT
/begin MEASUREMENT Dme_ctDataSetVariant "" UBYTE OneToOne 1 100 0.00 255.0 FORMAT "%5.1" ECU_ADDRESS 0xD00088DE /end MEASUREMENT
/begin MEASUREMENT Dme_numBytesAvailable "" ULONG OneToOne 1 100 0.00 4294967295.00 FORMAT "%13.2" ECU_ADDRESS 0xD0002D34 /end MEASUREMENT
/begin MEASUREMENT DSCHED_idxWTTAct "" UWORD DINH_OneToOne 1 100 0.00 65535.00 FORMAT "%8.2" ECU_ADDRESS 0xD0007FFC /end MEASUREMENT
/begin MEASUREMENT DSCHED_tiWTT "" UWORD DSCHED_Time100ms 1 100 0.00 6553.500 FORMAT "%8.3" ECU_ADDRESS 0xD0007FF6 /end MEASUREMENT
/begin FUNCTION dinh_auto ""
 /begin DEF_CHARACTERISTIC DINH_FId.DFC_IVAdjIVA_4_CA DINH_FId.DFC_IVAdjIVA_5_CA DINH_FId.DFC_InjCtlAdjQntEEPCS_CA DINH_FId.DFC_InjCtlDriftEEPCS_CA DINH_FId.DFC_MRlyErlyOpng_CA DINH_FId.DFC_MRlyStk_CA DINH_FId.DFC_SensFrzPPFltUs_CA DINH_FId.DFC_T15Sig_CA DINH_FId.DFC_AirCtlRmpTOut_CA DINH_FId.DFC_CEngDsTDynTst_CA DINH_FId.DFC_EGRVlvJamVlvClsd_CA DINH_FId.DFC_EGRVlvJamVlvOpn_CA DINH_FId.DFC_EGRVlvLgTDrft_CA DINH_FId.DFC_EGRVlvOfsLrnJamVlv_CA DINH_FId.DFC_EGRVlvShTDrft_CA DINH_FId.DFC_EGTRgnOilDilMax_CA DINH_FId.DFC_EngICO_CA DINH_FId.DFC_EpmCaSI1ErrSig_CA DINH_FId.DFC_EpmCaSI1NoSig_CA DINH_FId.DFC_EpmCaSI1OfsErr_CA DINH_FId.DFC_EpmCrSErrSig_CA DINH_FId.DFC_EpmCrSNoSig_CA DINH_FId.DFC_MoCADCCmp_CA DINH_FId.DFC_MoCADCTst_CA DINH_FId.DFC_MoCADCVltgRatio_CA DINH_FId.DFC_MoCSOPLoLi_CA DINH_FId.DFC_MoCSOPMM_CA DINH_FId.DFC_MoCSOPTimeOut_CA DINH_FId.DFC_MoCSOPUpLi_CA DINH_FId.DFC_MoFAPP_CA DINH_FId.DFC_MoFESpd_CA DINH_FId.DFC_MoFInjDatPhi_CA DINH_FId.DFC_MoFInjDatQnt_CA DINH_FId.DFC_MoFInjQnt_CA DINH_FId.DFC_MoFOvR_CA DINH_FId.DFC_MoFQntCor_CA DINH_FId.DFC_MoFTrqCmp_CA DINH_FId.DFC_NplTOxiCatUs_CA DINH_FId.DFC_PhyModNonMonMapNpl_CA DINH_FId.DFC_RailPOfsTstMax_CA DINH_FId.DFC_RailPOfsTstMin_CA DINH_FId.DFC_SWReset_0_CA DINH_FId.DFC_SWReset_1_CA DINH_FId.DFC_SWReset_2_CA DINH_FId.DFC_VSwVlvJamVlv_CA DINH_FId.DFC_VSwVlvLgTDrft_CA DINH_FId.DFC_VSwVlvOfsLrnJamVlv_CA DINH_FId.DFC_VSwVlvShTDrft_CA DINH_FId.DSQ_AFS_CA DINH_FId.DSQ_BattU_CA DINH_FId.DSQ_BrkP_CA DINH_FId.DSQ_CByVlvActr_CA DINH_FId.DSQ_CEngDsT_CA DINH_FId.DSQ_CEngUsT_CA DINH_FId.DSQ_CThmstActr_CA DINH_FId.DSQ_Com_aDirect_CA DINH_FId.DSQ_Com_aSide_CA DINH_FId.DSQ_Com_nTSC_CA DINH_FId.DSQ_Com_pBrkSys_CA DINH_FId.DSQ_Com_stButtonMSA_CA DINH_FId.DSQ_Com_stClCtr_CA DINH_FId.DSQ_Com_stDSC_CA DINH_FId.DSQ_Com_stDecellDSC_CA DINH_FId.DSQ_Com_stDrWghSeat_CA DINH_FId.DSQ_Com_stGear_CA DINH_FId.DSQ_Com_stKeyVld_CA DINH_FId.DSQ_Com_stReqMSA_CA DINH_FId.DSQ_Com_stT15_CA DINH_FId.DSQ_Com_stT50_CA DINH_FId.DSQ_Com_stTrqDSCDes_CA DINH_FId.DSQ_Com_swtDrBltb_CA DINH_FId.DSQ_Com_tEnvT_CA DINH_FId.DSQ_Com_tGbxOil_CA DINH_FId.DSQ_Com_trqAC_CA DINH_FId.DSQ_Com_trqARSCur_CA DINH_FId.DSQ_Com_trqARSDes_CA DINH_FId.DSQ_Com_trqAvlAFS_CA DINH_FId.DSQ_Com_trqDSCDes_CA DINH_FId.DSQ_Com_trqGbxDes_CA DINH_FId.DSQ_Com_trqGbxFrc_CA DINH_FId.DSQ_Com_trqGbxMax_CA DINH_FId.DSQ_Com_trqTarAFS_CA DINH_FId.DSQ_Com_v_CA DINH_FId.DSQ_Com_vBd_CA DINH_FId.DSQ_DSMInhibitAlways_CA DINH_FId.DSQ_ECBVlvActr_CA DINH_FId.DSQ_ECBVlvSens_CA DINH_FId.DSQ_EGRVlvActr_CA DINH_FId.DSQ_EGRVlvSens_CA DINH_FId.DSQ_EMDmp_0_CA DINH_FId.DSQ_EMDmp_1_CA DINH_FId.DSQ_EngPrtFWOsc_CA DINH_FId.DSQ_EnvP_CA DINH_FId.DSQ_EnvT_CA DINH_FId.DSQ_FanActr_CA DINH_FId.DSQ_FuelT_CA DINH_FId.DSQ_LAYER2EDCMSAStp_CA DINH_FId.DSQ_LSUO2_0_CA DINH_FId.DSQ_LSUO2_1_CA DINH_FId.DSQ_LSUO2_2_CA DINH_FId.DSQ_LSUO2_3_CA DINH_FId.DSQ_MeUnActr_CA DINH_FId.DSQ_NSCDsRLamO2_CA DINH_FId.DSQ_OilStSens_CA DINH_FId.DSQ_OilT_CA DINH_FId.DSQ_PAirFltDs_CA DINH_FId.DSQ_PCACDs_CA DINH_FId.DSQ_PCVActr_CA DINH_FId.DSQ_PPFltUs_CA DINH_FId.DSQ_TAFS_CA DINH_FId.DSQ_TCACDs_CA DINH_FId.DSQ_TECU_CA DINH_FId.DSQ_TOxiCatUs_CA DINH_FId.DSQ_TPFltUs_CA DINH_FId.DSQ_ThrVlvActr_CA DINH_FId.DSQ_ThrVlvSens_CA DINH_FId.DSQ_TrbChActr_CA DINH_FId.DSQ_TrbChLPActr_CA DINH_FId.DSQ_TrbChSens_CA DINH_FId.DSQ_TrbnDsRLamO2_CA DINH_FId.DSQ_VSwVlvActr_CA DINH_FId.DSQ_VSwVlvSens_CA DINH_FId.DSQ_VehV_CA DINH_FId.DSQ_WaHtElActr_CA DINH_FId.DSQ_stAPP_CA DINH_FId.DSQ_stAPP1_CA DINH_FId.DSQ_stAPP2_CA DINH_FId.DSQ_stLSUSrvTstDem_CA DINH_Lim.DFC_AirCtlGovDvtEOMMax_CA DINH_Lim.DFC_AirCtlGovDvtEOMMin_CA DINH_Lim.DFC_AirCtlGovDvtMax_CA DINH_Lim.DFC_AirCtlGovDvtMin_CA DINH_Lim.DFC_Cj945SpiCom1_CA DINH_Lim.DFC_ComButtonMSASig_CA DINH_Lim.DFC_ComButtonMSATo_CA DINH_Lim.DFC_ComGearboxData2Sig_CA DINH_Lim.DFC_ComGearboxData2To_CA DINH_Lim.DFC_ComGearboxDataSig_CA DINH_Lim.DFC_ComGearboxDataTo_CA DINH_Lim.DFC_ComHeatACSig_CA DINH_Lim.DFC_ComHeatACTo_CA DINH_Lim.DFC_ComLenkradwinkelSig_CA DINH_Lim.DFC_ComLenkradwinkelTo_CA DINH_Lim.DFC_ComMileageRangeSig_CA DINH_Lim.DFC_ComMileageRangeTo_CA DINH_Lim.DFC_ComPspSig_CA DINH_Lim.DFC_ComPspTo_CA DINH_Lim.DFC_ComShutOffPSPSig_CA DINH_Lim.DFC_ComShutOffPSPTo_CA DINH_Lim.DFC_ComStKombiCtr_CA DINH_Lim.DFC_ComStKombiSig_CA DINH_Lim.DFC_ComStKombiTo_CA DINH_Lim.DFC_ComStateARSCtr_CA DINH_Lim.DFC_ComStateARSSig_CA DINH_Lim.DFC_ComStateARSTo_CA DINH_Lim.DFC_ComStateDscSig_CA DINH_Lim.DFC_ComStateDscTo_CA DINH_Lim.DFC_ComStateSeatSig_CA DINH_Lim.DFC_ComStateSeatTo_CA DINH_Lim.DFC_ComTempRelTimeSig_CA DINH_Lim.DFC_ComTempRelTimeTo_CA DINH_Lim.DFC_ComTerminalChk_CA DINH_Lim.DFC_ComTerminalCtr_CA DINH_Lim.DFC_ComTerminalSig_CA DINH_Lim.DFC_ComTerminalTo_CA DINH_Lim.DFC_ComTimeDateSig_CA DINH_Lim.DFC_ComTimeDateTo_CA DINH_Lim.DFC_ComTrailerSig_CA DINH_Lim.DFC_ComTrailerTo_CA DINH_Lim.DFC_ComTrqDemandAfsChk_CA DINH_Lim.DFC_ComTrqDemandAfsCtr_CA DINH_Lim.DFC_ComTrqDemandAfsSig_CA DINH_Lim.DFC_ComTrqDemandAfsTo_CA DINH_Lim.DFC_ComTrqDemandDscChk_CA DINH_Lim.DFC_ComTrqDemandDscCtr_CA DINH_Lim.DFC_ComTrqDemandDscSig_CA DINH_Lim.DFC_ComTrqDemandDscTo_CA DINH_Lim.DFC_ComTrqDemandGbxChk_CA DINH_Lim.DFC_ComTrqDemandGbxCtr_CA DINH_Lim.DFC_ComTrqDemandGbxSig_CA DINH_Lim.DFC_ComTrqDemandGbxTo_CA DINH_Lim.DFC_ComVelocitySig_CA DINH_Lim.DFC_ComVelocityTo_CA DINH_Lim.DFC_ComWheelSpeedSig_CA DINH_Lim.DFC_ComWheelSpeedTo_CA DINH_Lim.DFC_ComZvKlappenSig_CA DINH_Lim.DFC_ComZvKlappenTo_CA DINH_Lim.DFC_Cy150SpiCom_CA DINH_Lim.DFC_Cy320SpiCom_CA DINH_Lim.DFC_ETCtlDvtInrMax_CA DINH_Lim.DFC_ETCtlDvtInrMin_CA DINH_Lim.DFC_ETCtlDvtOutrMax_CA DINH_Lim.DFC_ETCtlDvtOutrMin_CA DINH_Lim.DFC_Fan4WinErr1_CA DINH_Lim.DFC_Fan4WinErr2_CA DINH_Lim.DFC_Fan4WinErr3_CA DINH_Lim.DFC_Fan4WinErr4_CA DINH_Lim.DFC_FanSCG_CA DINH_Lim.DFC_PCRGovDvtLPMax_CA DINH_Lim.DFC_PCRGovDvtLPMin_CA DINH_Lim.DFC_PCRGovDvtMax_CA DINH_Lim.DFC_PCRGovDvtMin_CA DINH_Lim.DFC_RailCPC1_CA DINH_Lim.DFC_RailCPC3_CA DINH_Lim.DFC_RailCPC4_CA DINH_Lim.DFC_RailMeUn0_CA DINH_Lim.DFC_RailMeUn1_CA DINH_Lim.DFC_RailMeUn2_CA DINH_Lim.DFC_RailMeUn3_CA DINH_Lim.DFC_RailMeUn4_CA DINH_Lim.DFC_RailPCV0_CA DINH_Lim.DFC_RailPCV1_CA DINH_Lim.DFC_RailPCV2_CA DINH_Lim.DFC_RailPCV3_CA DINH_Lim.DFC_RailPCV4_CA DINH_Lim.DFC_RailPMonStrt_CA DINH_Lim.DFC_SSpMon1_CA DINH_Lim.DFC_SSpMon2_CA DINH_Lim.DFC_SSpMon3_CA DINH_Lim.DFC_Sia_E1_CA DINH_Lim.DFC_Sia_E10_CA DINH_Lim.DFC_Sia_E11_CA DINH_Lim.DFC_Sia_E12_CA DINH_Lim.DFC_Sia_E13_CA DINH_Lim.DFC_Sia_E14_CA DINH_Lim.DFC_Sia_E15_CA DINH_Lim.DFC_Sia_E2_CA DINH_Lim.DFC_Sia_E3_CA DINH_Lim.DFC_Sia_E4_CA DINH_Lim.DFC_Sia_E5_CA DINH_Lim.DFC_Sia_E6_CA DINH_Lim.DFC_Sia_E7_CA DINH_Lim.DFC_Sia_E8_CA DINH_Lim.DFC_Sia_E9_CA DINH_Lim.DFC_ThrVlv4WinErr1_CA DINH_Lim.DFC_ThrVlv4WinErr2_CA DINH_Lim.DFC_ThrVlv4WinErr3_CA DINH_Lim.DFC_ThrVlv4WinErr4_CA DINH_Lim.DFC_ThrVlvSCG_CA DINH_Lim.DFC_TrbCh4WinErr1_CA DINH_Lim.DFC_TrbCh4WinErr2_CA DINH_Lim.DFC_TrbCh4WinErr3_CA DINH_Lim.DFC_TrbCh4WinErr4_CA DINH_Lim.DFC_TrbChSCG_CA DINH_Lim.DFC_TrbChSRCMax_CA DINH_Lim.DFC_TrbChSRCMin_CA DINH_Lim.DFC_WaHtEl4WinErr1_CA DINH_Lim.DFC_WaHtEl4WinErr2_CA DINH_Lim.DFC_WaHtEl4WinErr3_CA DINH_Lim.DFC_WaHtEl4WinErr4_CA DINH_Lim.DFC_WaHtElSCG_CA DINH_Lim.DFC_ETClbETFltMax_CA DINH_Lim.DFC_ETClbETFltMin_CA DINH_Lim.DFC_InjCrvInjLimChrgBal_CA DINH_Lim.DFC_InjCrvInjLimQntBal_CA DINH_Lim.DFC_InjCrvInjLimSys_CA DINH_Lim.DFC_InjCrvNumInjRtmLim_CA DINH_Lim.DFC_LSUHtCoupSig_0_CA DINH_Lim.DFC_LSUHtCoupSig_1_CA DINH_Lim.DFC_LSUHtCoupSig_2_CA DINH_Lim.DFC_LSUHtCoupSig_3_CA DINH_Lim.DFC_CtT_CA DINH_Lim.DFC_DSMDummy_CA DINH_Lim.DFC_MeUnOL_CA DINH_Lim.DFC_MeUnSCB_CA DINH_Lim.DFC_MeUnSRCMax_CA DINH_Lim.DFC_MeUnSRCMin_CA DINH_Lim.DFC_PCVOL_CA DINH_Lim.DFC_PCVSCB_CA DINH_Lim.DFC_PCVSRCMax_CA DINH_Lim.DFC_PCVSRCMin_CA DINH_Lim.DFC_RailPSRCMax_CA DINH_Lim.DFC_RailPSRCMin_CA DINH_Lim.DFC_IVActrVltgSRCMax_CA DINH_Lim.DFC_IVActrVltgSRCMin_CA DINH_Lim.DFC_IVPSplyDCDC_CA DINH_Lim.DFC_IVPSplyVltgSRCMax_CA DINH_Lim.DFC_IVPSplyVltgSRCMin_CA DINH_Lim.DFC_AFSOffsDrftMax_CA DINH_Lim.DFC_AFSOffsDrftMin_CA DINH_Lim.DFC_AFSSRCCorMax_CA DINH_Lim.DFC_AFSSRCCorMin_CA DINH_Lim.DFC_AFSSRCRawMax_CA DINH_Lim.DFC_AFSSRCRawMin_CA DINH_Lim.DFC_AFSSetyDrftMax_CA DINH_Lim.DFC_AFSSetyDrftMin_CA DINH_Lim.DFC_AirCClntPAnaSRCMax_CA DINH_Lim.DFC_AirCClntPAnaSRCMin_CA DINH_Lim.DFC_AirCClntPPerSRCMax_CA DINH_Lim.DFC_AirCClntPPerSRCMin_CA DINH_Lim.DFC_AirCClntPdcycSRCMax_CA DINH_Lim.DFC_AirCClntPdcycSRCMin_CA DINH_Lim.DFC_AirCCmprOL_CA DINH_Lim.DFC_AirCCmprRedTrqOL_CA DINH_Lim.DFC_AirCCmprRedTrqSCB_CA DINH_Lim.DFC_AirCCmprRedTrqSCG_CA DINH_Lim.DFC_AirCCmprSCB_CA DINH_Lim.DFC_AirCCmprSCG_CA DINH_Lim.DFC_AirCSwtNpl_CA DINH_Lim.DFC_AirCSwtSig_CA DINH_Lim.DFC_BattUSRCMax_CA DINH_Lim.DFC_BattUSRCMin_CA DINH_Lim.DFC_BrkNpl_CA DINH_Lim.DFC_BrkPSRCMax_CA DINH_Lim.DFC_BrkPSRCMin_CA DINH_Lim.DFC_BrkSig_CA DINH_Lim.DFC_CByVlvOL_CA DINH_Lim.DFC_CByVlvSCB_CA DINH_Lim.DFC_CByVlvSCG_CA DINH_Lim.DFC_CEngDsTSRCMax_CA DINH_Lim.DFC_CEngDsTSRCMin_CA DINH_Lim.DFC_CEngDsTSig_CA DINH_Lim.DFC_CEngUsTSRCMax_CA DINH_Lim.DFC_CEngUsTSRCMin_CA DINH_Lim.DFC_CThmstOL_CA DINH_Lim.DFC_CThmstSCB_CA DINH_Lim.DFC_CThmstSCG_CA DINH_Lim.DFC_ClthSig_CA DINH_Lim.DFC_ECBVlvOL_CA DINH_Lim.DFC_ECBVlvSCB_CA DINH_Lim.DFC_ECBVlvSCG_CA DINH_Lim.DFC_ECBVlvSRCMax_CA DINH_Lim.DFC_ECBVlvSRCMin_CA DINH_Lim.DFC_EGRVlvGovDvtMax_CA DINH_Lim.DFC_EGRVlvGovDvtMin_CA DINH_Lim.DFC_EGRVlvOL_CA DINH_Lim.DFC_EGRVlvSCB_CA DINH_Lim.DFC_EGRVlvSCG_CA DINH_Lim.DFC_EGRVlvSRCMax_CA DINH_Lim.DFC_EGRVlvSRCMin_CA DINH_Lim.DFC_EMDmpOL_0_CA DINH_Lim.DFC_EMDmpOL_1_CA DINH_Lim.DFC_EMDmpSCB_0_CA DINH_Lim.DFC_EMDmpSCB_1_CA DINH_Lim.DFC_EMDmpSCG_0_CA DINH_Lim.DFC_EMDmpSCG_1_CA DINH_Lim.DFC_EngStAOL_CA DINH_Lim.DFC_EngStASCB_CA DINH_Lim.DFC_EngStASCG_CA DINH_Lim.DFC_EnvPSRCMax_CA DINH_Lim.DFC_EnvPSRCMin_CA DINH_Lim.DFC_EnvPSig_CA DINH_Lim.DFC_EnvTSRCMax_CA DINH_Lim.DFC_EnvTSRCMin_CA DINH_Lim.DFC_FanOL_CA DINH_Lim.DFC_FanSCB_CA DINH_Lim.DFC_FlFltSig_CA DINH_Lim.DFC_FuelTSRCMax_CA DINH_Lim.DFC_FuelTSRCMin_CA DINH_Lim.DFC_GbxNPosPPerSRCMax_CA DINH_Lim.DFC_GbxNPosPPerSRCMin_CA DINH_Lim.DFC_GbxNPosPdcycSRCMax_CA DINH_Lim.DFC_GbxNPosPdcycSRCMin_CA DINH_Lim.DFC_GbxNPosSig_CA DINH_Lim.DFC_GlwPlgBSDOL_0_CA DINH_Lim.DFC_GlwPlgBSDOL_1_CA DINH_Lim.DFC_GlwPlgBSDOL_2_CA DINH_Lim.DFC_GlwPlgBSDOL_3_CA DINH_Lim.DFC_GlwPlgBSDOL_4_CA DINH_Lim.DFC_GlwPlgBSDOL_5_CA DINH_Lim.DFC_GlwPlgBSDOL_6_CA DINH_Lim.DFC_GlwPlgBSDOL_7_CA DINH_Lim.DFC_GlwPlgBSDOT_0_CA DINH_Lim.DFC_GlwPlgBSDOT_1_CA DINH_Lim.DFC_GlwPlgBSDOT_2_CA DINH_Lim.DFC_GlwPlgBSDOT_3_CA DINH_Lim.DFC_GlwPlgBSDOT_4_CA DINH_Lim.DFC_GlwPlgBSDOT_5_CA DINH_Lim.DFC_GlwPlgBSDOT_6_CA DINH_Lim.DFC_GlwPlgBSDOT_7_CA DINH_Lim.DFC_GlwPlgBSDSC_0_CA DINH_Lim.DFC_GlwPlgBSDSC_1_CA DINH_Lim.DFC_GlwPlgBSDSC_2_CA DINH_Lim.DFC_GlwPlgBSDSC_3_CA DINH_Lim.DFC_GlwPlgBSDSC_4_CA DINH_Lim.DFC_GlwPlgBSDSC_5_CA DINH_Lim.DFC_GlwPlgBSDSC_6_CA DINH_Lim.DFC_GlwPlgBSDSC_7_CA DINH_Lim.DFC_GlwPlgComErr_CA DINH_Lim.DFC_InjVlvPresMin_CA DINH_Lim.DFC_LSUCircNernstMax_0_CA DINH_Lim.DFC_LSUCircNernstMax_1_CA DINH_Lim.DFC_LSUCircNernstMax_2_CA DINH_Lim.DFC_LSUCircNernstMax_3_CA DINH_Lim.DFC_LSUCircNernstMin_0_CA DINH_Lim.DFC_LSUCircNernstMin_1_CA DINH_Lim.DFC_LSUCircNernstMin_2_CA DINH_Lim.DFC_LSUCircNernstMin_3_CA DINH_Lim.DFC_LSUCircNernstSig_0_CA DINH_Lim.DFC_LSUCircNernstSig_1_CA DINH_Lim.DFC_LSUCircNernstSig_2_CA DINH_Lim.DFC_LSUCircNernstSig_3_CA DINH_Lim.DFC_LSUCircPmpCurMax_0_CA DINH_Lim.DFC_LSUCircPmpCurMax_1_CA DINH_Lim.DFC_LSUCircPmpCurMax_2_CA DINH_Lim.DFC_LSUCircPmpCurMax_3_CA DINH_Lim.DFC_LSUCircPmpCurMin_0_CA DINH_Lim.DFC_LSUCircPmpCurMin_1_CA DINH_Lim.DFC_LSUCircPmpCurMin_2_CA DINH_Lim.DFC_LSUCircPmpCurMin_3_CA DINH_Lim.DFC_LSUCircPmpCurSig_0_CA DINH_Lim.DFC_LSUCircPmpCurSig_1_CA DINH_Lim.DFC_LSUCircPmpCurSig_2_CA DINH_Lim.DFC_LSUCircPmpCurSig_3_CA DINH_Lim.DFC_LSUCircVirtGndMax_0_CA DINH_Lim.DFC_LSUCircVirtGndMax_1_CA DINH_Lim.DFC_LSUCircVirtGndMax_2_CA DINH_Lim.DFC_LSUCircVirtGndMax_3_CA DINH_Lim.DFC_LSUCircVirtGndMin_0_CA DINH_Lim.DFC_LSUCircVirtGndMin_1_CA DINH_Lim.DFC_LSUCircVirtGndMin_2_CA DINH_Lim.DFC_LSUCircVirtGndMin_3_CA DINH_Lim.DFC_LSUCircVirtGndSig_0_CA DINH_Lim.DFC_LSUCircVirtGndSig_1_CA DINH_Lim.DFC_LSUCircVirtGndSig_2_CA DINH_Lim.DFC_LSUCircVirtGndSig_3_CA DINH_Lim.DFC_LSUHtrMax_0_CA DINH_Lim.DFC_LSUHtrMax_1_CA DINH_Lim.DFC_LSUHtrMax_2_CA DINH_Lim.DFC_LSUHtrMax_3_CA DINH_Lim.DFC_LSUHtrMin_0_CA DINH_Lim.DFC_LSUHtrMin_1_CA DINH_Lim.DFC_LSUHtrMin_2_CA DINH_Lim.DFC_LSUHtrMin_3_CA DINH_Lim.DFC_LSUHtrSig_0_CA DINH_Lim.DFC_LSUHtrSig_1_CA DINH_Lim.DFC_LSUHtrSig_2_CA DINH_Lim.DFC_LSUHtrSig_3_CA DINH_Lim.DFC_LSUO2Max_0_CA DINH_Lim.DFC_LSUO2Max_1_CA DINH_Lim.DFC_LSUO2Max_2_CA DINH_Lim.DFC_LSUO2Max_3_CA DINH_Lim.DFC_LSUO2Min_0_CA DINH_Lim.DFC_LSUO2Min_1_CA DINH_Lim.DFC_LSUO2Min_2_CA DINH_Lim.DFC_LSUO2Min_3_CA DINH_Lim.DFC_LSUSPIBattLowMin_0_CA DINH_Lim.DFC_LSUSPIBattLowMin_1_CA DINH_Lim.DFC_LSUSPIBattLowMin_2_CA DINH_Lim.DFC_LSUSPIBattLowMin_3_CA DINH_Lim.DFC_LSUSPISig_0_CA DINH_Lim.DFC_LSUSPISig_1_CA DINH_Lim.DFC_LSUSPISig_2_CA DINH_Lim.DFC_LSUSPISig_3_CA DINH_Lim.DFC_LSUtExcMax_0_CA DINH_Lim.DFC_LSUtExcMax_1_CA DINH_Lim.DFC_LSUtExcMax_2_CA DINH_Lim.DFC_LSUtExcMax_3_CA DINH_Lim.DFC_LSUtExcMin_0_CA DINH_Lim.DFC_LSUtExcMin_1_CA DINH_Lim.DFC_LSUtExcMin_2_CA DINH_Lim.DFC_LSUtExcMin_3_CA DINH_Lim.DFC_MILOL_CA DINH_Lim.DFC_MILSCB_CA DINH_Lim.DFC_MILSCG_CA DINH_Lim.DFC_MeUnSCG_CA DINH_Lim.DFC_NplHsChngPPFltDiff_CA DINH_Lim.DFC_NplPAirFltDs_CA DINH_Lim.DFC_NplTPFltUs_CA DINH_Lim.DFC_OilComErr_CA DINH_Lim.DFC_OilPLmpOL_CA DINH_Lim.DFC_OilPLmpSCB_CA DINH_Lim.DFC_OilPLmpSCG_CA DINH_Lim.DFC_OilPNpl_CA DINH_Lim.DFC_OilTNpl_CA DINH_Lim.DFC_OilTSRCMax_CA DINH_Lim.DFC_OilTSRCMin_CA DINH_Lim.DFC_PCACDsEnvPPls_CA DINH_Lim.DFC_PCACDsSRCMax_CA DINH_Lim.DFC_PCACDsSRCMin_CA DINH_Lim.DFC_PCVSCG_CA DINH_Lim.DFC_PFltCharPDiffMin_CA DINH_Lim.DFC_PFltDstrMin_CA DINH_Lim.DFC_PFltEngPrt_CA DINH_Lim.DFC_PFltLmpOL_CA DINH_Lim.DFC_PFltLmpSCB_CA DINH_Lim.DFC_PFltLmpSCG_CA DINH_Lim.DFC_PFltRgnPerm_CA DINH_Lim.DFC_PFltSRCMaxFlwRstn_CA DINH_Lim.DFC_PFltSRCMinFlwRstn_CA DINH_Lim.DFC_PFltSotMsDvtMax_CA DINH_Lim.DFC_PFltSotMsDvtMin_CA DINH_Lim.DFC_PFltSotMsMax_CA DINH_Lim.DFC_PSPOL_CA DINH_Lim.DFC_PSPSCB_CA DINH_Lim.DFC_PSPSCG_CA DINH_Lim.DFC_SRCHighAPP1_CA DINH_Lim.DFC_SRCHighAPP2_CA DINH_Lim.DFC_SRCLowAPP1_CA DINH_Lim.DFC_SRCLowAPP2_CA DINH_Lim.DFC_SRCMaxPAirFltDs_CA DINH_Lim.DFC_SRCMaxPPFltUs_CA DINH_Lim.DFC_SRCMaxTECU_CA DINH_Lim.DFC_SRCMaxTOxiCatUs_CA DINH_Lim.DFC_SRCMaxTPFltUs_CA DINH_Lim.DFC_SRCMinPAirFltDs_CA DINH_Lim.DFC_SRCMinPPFltUs_CA DINH_Lim.DFC_SRCMinTECU_CA DINH_Lim.DFC_SRCMinTOxiCatUs_CA DINH_Lim.DFC_SRCMinTPFltUs_CA DINH_Lim.DFC_SVSOL_CA DINH_Lim.DFC_SVSSCB_CA DINH_Lim.DFC_SVSSCG_CA DINH_Lim.DFC_StrtOL_CA DINH_Lim.DFC_StrtSCB_CA DINH_Lim.DFC_StrtSCG_CA DINH_Lim.DFC_SyncAPP_CA DINH_Lim.DFC_T15Npl_CA DINH_Lim.DFC_TAFSDtyCycHi_CA DINH_Lim.DFC_TAFSDtyCycLo_CA DINH_Lim.DFC_TAFSPerHi_CA DINH_Lim.DFC_TAFSPerLo_CA DINH_Lim.DFC_TCACDsSRCMax_CA DINH_Lim.DFC_TCACDsSRCMin_CA DINH_Lim.DFC_ThrVlvOL_CA DINH_Lim.DFC_ThrVlvSCB_CA DINH_Lim.DFC_ThrVlvSRCMax_CA DINH_Lim.DFC_ThrVlvSRCMin_CA DINH_Lim.DFC_TrbChLPOL_CA DINH_Lim.DFC_TrbChLPSCB_CA DINH_Lim.DFC_TrbChLPSCG_CA DINH_Lim.DFC_TrbChOL_CA DINH_Lim.DFC_TrbChSCB_CA DINH_Lim.DFC_VSwVlvGovDvtMax_CA DINH_Lim.DFC_VSwVlvGovDvtMin_CA DINH_Lim.DFC_VSwVlvOL_CA DINH_Lim.DFC_VSwVlvSCB_CA DINH_Lim.DFC_VSwVlvSCG_CA DINH_Lim.DFC_VSwVlvSRCMax_CA DINH_Lim.DFC_VSwVlvSRCMin_CA DINH_Lim.DFC_VehVHW_CA DINH_Lim.DFC_VehVMax_CA DINH_Lim.DFC_VehVPlaus_CA DINH_Lim.DFC_VehVSig_CA DINH_Lim.DFC_WaHtElOL_CA DINH_Lim.DFC_WaHtElSCB_CA DINH_Lim.DFC_ClthNpl_CA DINH_Lim.DFC_ETClbETMax_0_CA DINH_Lim.DFC_ETClbETMax_1_CA DINH_Lim.DFC_ETClbETMax_2_CA DINH_Lim.DFC_ETClbETMax_3_CA DINH_Lim.DFC_ETClbETMax_4_CA DINH_Lim.DFC_ETClbETMax_5_CA DINH_Lim.DFC_ETClbETMin_0_CA DINH_Lim.DFC_ETClbETMin_1_CA DINH_Lim.DFC_ETClbETMin_2_CA DINH_Lim.DFC_ETClbETMin_3_CA DINH_Lim.DFC_ETClbETMin_4_CA DINH_Lim.DFC_ETClbETMin_5_CA DINH_Lim.DFC_IVDiaBnkShCirBSH_0_CA DINH_Lim.DFC_IVDiaBnkShCirBSH_1_CA DINH_Lim.DFC_IVDiaBnkShCirChSwt_0_CA DINH_Lim.DFC_IVDiaBnkShCirChSwt_1_CA DINH_Lim.DFC_IVDiaBnkShCirHSBatt_0_CA DINH_Lim.DFC_IVDiaBnkShCirHSBatt_1_CA DINH_Lim.DFC_IVDiaBnkShCirHiRstnc_0_CA DINH_Lim.DFC_IVDiaBnkShCirHiRstnc_1_CA DINH_Lim.DFC_IVDiaBnkShCirLSHSGnd_0_CA DINH_Lim.DFC_IVDiaBnkShCirLSHSGnd_1_CA DINH_Lim.DFC_IVDiaBnkShCirTransfer_0_CA DINH_Lim.DFC_IVDiaBnkShCirTransfer_1_CA DINH_Lim.DFC_IVDiaCylNoCls_0_CA DINH_Lim.DFC_IVDiaCylNoCls_1_CA DINH_Lim.DFC_IVDiaCylNoCls_2_CA DINH_Lim.DFC_IVDiaCylNoCls_3_CA DINH_Lim.DFC_IVDiaCylNoCls_4_CA DINH_Lim.DFC_IVDiaCylNoCls_5_CA DINH_Lim.DFC_IVDiaCylNoLd_0_CA DINH_Lim.DFC_IVDiaCylNoLd_1_CA DINH_Lim.DFC_IVDiaCylNoLd_2_CA DINH_Lim.DFC_IVDiaCylNoLd_3_CA DINH_Lim.DFC_IVDiaCylNoLd_4_CA DINH_Lim.DFC_IVDiaCylNoLd_5_CA DINH_Lim.DFC_IVDiaCylShCirHiRstnc_0_CA DINH_Lim.DFC_IVDiaCylShCirHiRstnc_1_CA DINH_Lim.DFC_IVDiaCylShCirHiRstnc_2_CA DINH_Lim.DFC_IVDiaCylShCirHiRstnc_3_CA DINH_Lim.DFC_IVDiaCylShCirHiRstnc_4_CA DINH_Lim.DFC_IVDiaCylShCirHiRstnc_5_CA DINH_Lim.DFC_IVDiaCylShCirLSBatt_0_CA DINH_Lim.DFC_IVDiaCylShCirLSBatt_1_CA DINH_Lim.DFC_IVDiaCylShCirLSBatt_2_CA DINH_Lim.DFC_IVDiaCylShCirLSBatt_3_CA DINH_Lim.DFC_IVDiaCylShCirLSBatt_4_CA DINH_Lim.DFC_IVDiaCylShCirLSBatt_5_CA DINH_Lim.DFC_IVDiaCylShCirLSHS_0_CA DINH_Lim.DFC_IVDiaCylShCirLSHS_1_CA DINH_Lim.DFC_IVDiaCylShCirLSHS_2_CA DINH_Lim.DFC_IVDiaCylShCirLSHS_3_CA DINH_Lim.DFC_IVDiaCylShCirLSHS_4_CA DINH_Lim.DFC_IVDiaCylShCirLSHS_5_CA DINH_Lim.DFC_IVDiaCylShCirLsLs_0_CA DINH_Lim.DFC_IVDiaCylShCirLsLs_1_CA DINH_Lim.DFC_IVDiaCylShCirLsLs_2_CA DINH_Lim.DFC_IVDiaCylShCirLsLs_3_CA DINH_Lim.DFC_IVDiaCylShCirLsLs_4_CA DINH_Lim.DFC_IVDiaCylShCirLsLs_5_CA DINH_Lim.DFC_IVDiaSPICfg_CA DINH_Lim.DFC_IVDiaSPIColl_CA DINH_Lim.DFC_IVDiaSPICtrl_CA DINH_Lim.DFC_IVDiaSPIRam_CA DINH_Lim.DFC_IVDiaSPITrans_CA DINH_Lim.DFC_LSUCmpChk_0_CA DINH_Lim.DFC_LSUCmpChk_1_CA DINH_Lim.DFC_LSUCmpChk_2_CA DINH_Lim.DFC_LSUCmpChk_3_CA DINH_Lim.DFC_LSUCmpChk_4_CA DINH_Lim.DFC_LSUCmpChk_5_CA DINH_Lim.DFC_LSUDynChk_0_CA DINH_Lim.DFC_LSUDynChk_1_CA DINH_Lim.DFC_LSUDynChk_2_CA DINH_Lim.DFC_LSUDynChk_3_CA DINH_Lim.DFC_LSUO2ClbMax_0_CA DINH_Lim.DFC_LSUO2ClbMax_1_CA DINH_Lim.DFC_LSUO2ClbMax_2_CA DINH_Lim.DFC_LSUO2ClbMax_3_CA DINH_Lim.DFC_LSUO2ClbMin_0_CA DINH_Lim.DFC_LSUO2ClbMin_1_CA DINH_Lim.DFC_LSUO2ClbMin_2_CA DINH_Lim.DFC_LSUO2ClbMin_3_CA DINH_Lim.DFC_LSUO2PlausMax_0_CA DINH_Lim.DFC_LSUO2PlausMax_1_CA DINH_Lim.DFC_LSUO2PlausMax_2_CA DINH_Lim.DFC_LSUO2PlausMax_3_CA DINH_Lim.DFC_LSUO2PlausMin_0_CA DINH_Lim.DFC_LSUO2PlausMin_1_CA DINH_Lim.DFC_LSUO2PlausMin_2_CA DINH_Lim.DFC_LSUO2PlausMin_3_CA DINH_Lim.DFC_LSURiClbMax_0_CA DINH_Lim.DFC_LSURiClbMax_1_CA DINH_Lim.DFC_LSURiClbMax_2_CA DINH_Lim.DFC_LSURiClbMax_3_CA DINH_Lim.DFC_LSURiClbMin_0_CA DINH_Lim.DFC_LSURiClbMin_1_CA DINH_Lim.DFC_LSURiClbMin_2_CA DINH_Lim.DFC_LSURiClbMin_3_CA DINH_Lim.DFC_LSUWireIPSig_0_CA DINH_Lim.DFC_LSUWireIPSig_1_CA DINH_Lim.DFC_LSUWireIPSig_2_CA DINH_Lim.DFC_LSUWireIPSig_3_CA DINH_Lim.DFC_AFSDrftIdlAdjVal_CA DINH_Lim.DFC_AFSDrftLdAdjVal_CA DINH_Lim.DFC_AdcI_ADC0_Cal_CA DINH_Lim.DFC_AdcI_ADC0_Conv_CA DINH_Lim.DFC_CmbChbMisfireMax_0_CA DINH_Lim.DFC_CmbChbMisfireMax_1_CA DINH_Lim.DFC_CmbChbMisfireMax_2_CA DINH_Lim.DFC_CmbChbMisfireMax_3_CA DINH_Lim.DFC_CmbChbMisfireMax_4_CA DINH_Lim.DFC_CmbChbMisfireMax_5_CA DINH_Lim.DFC_CmbChbMisfireMul_CA DINH_Lim.DFC_INJVLVBUSY_CA DINH_Lim.DFC_IVAdjIVA_0_CA DINH_Lim.DFC_IVAdjIVA_1_CA DINH_Lim.DFC_IVAdjIVA_2_CA DINH_Lim.DFC_IVAdjIVA_3_CA DINH_Lim.DFC_IVAdjIVA_4_CA DINH_Lim.DFC_IVAdjIVA_5_CA DINH_Lim.DFC_InjCtlAdjQntEEPCS_CA DINH_Lim.DFC_InjCtlDriftEEPCS_CA DINH_Lim.DFC_MRlyErlyOpng_CA DINH_Lim.DFC_MRlyStk_CA DINH_Lim.DFC_SensFrzPPFltUs_CA DINH_Lim.DFC_T15Sig_CA DINH_Lim.DFC_AirCtlRmpTOut_CA DINH_Lim.DFC_CEngDsTDynTst_CA DINH_Lim.DFC_EGRVlvJamVlvClsd_CA DINH_Lim.DFC_EGRVlvJamVlvOpn_CA DINH_Lim.DFC_EGRVlvLgTDrft_CA DINH_Lim.DFC_EGRVlvOfsLrnJamVlv_CA DINH_Lim.DFC_EGRVlvShTDrft_CA DINH_Lim.DFC_EGTRgnOilDilMax_CA DINH_Lim.DFC_EngICO_CA DINH_Lim.DFC_EpmCaSI1ErrSig_CA DINH_Lim.DFC_EpmCaSI1NoSig_CA DINH_Lim.DFC_EpmCaSI1OfsErr_CA DINH_Lim.DFC_EpmCrSErrSig_CA DINH_Lim.DFC_EpmCrSNoSig_CA DINH_Lim.DFC_MoCADCCmp_CA DINH_Lim.DFC_MoCADCTst_CA DINH_Lim.DFC_MoCADCVltgRatio_CA DINH_Lim.DFC_MoCSOPLoLi_CA DINH_Lim.DFC_MoCSOPMM_CA DINH_Lim.DFC_MoCSOPTimeOut_CA DINH_Lim.DFC_MoCSOPUpLi_CA DINH_Lim.DFC_MoFAPP_CA DINH_Lim.DFC_MoFESpd_CA DINH_Lim.DFC_MoFInjDatPhi_CA DINH_Lim.DFC_MoFInjDatQnt_CA DINH_Lim.DFC_MoFInjQnt_CA DINH_Lim.DFC_MoFOvR_CA DINH_Lim.DFC_MoFQntCor_CA DINH_Lim.DFC_MoFTrqCmp_CA DINH_Lim.DFC_NplTOxiCatUs_CA DINH_Lim.DFC_PhyModNonMonMapNpl_CA DINH_Lim.DFC_RailPOfsTstMax_CA DINH_Lim.DFC_RailPOfsTstMin_CA DINH_Lim.DFC_SWReset_0_CA DINH_Lim.DFC_SWReset_1_CA DINH_Lim.DFC_SWReset_2_CA DINH_Lim.DFC_VSwVlvJamVlv_CA DINH_Lim.DFC_VSwVlvLgTDrft_CA DINH_Lim.DFC_VSwVlvOfsLrnJamVlv_CA DINH_Lim.DFC_VSwVlvShTDrft_CA DINH_Lim.DSQ_AFS_CA DINH_Lim.DSQ_BattU_CA DINH_Lim.DSQ_BrkP_CA DINH_Lim.DSQ_CByVlvActr_CA DINH_Lim.DSQ_CEngDsT_CA DINH_Lim.DSQ_CEngUsT_CA DINH_Lim.DSQ_CThmstActr_CA DINH_Lim.DSQ_Com_aDirect_CA DINH_Lim.DSQ_Com_aSide_CA DINH_Lim.DSQ_Com_nTSC_CA DINH_Lim.DSQ_Com_pBrkSys_CA DINH_Lim.DSQ_Com_stButtonMSA_CA DINH_Lim.DSQ_Com_stClCtr_CA DINH_Lim.DSQ_Com_stDSC_CA DINH_Lim.DSQ_Com_stDecellDSC_CA DINH_Lim.DSQ_Com_stDrWghSeat_CA DINH_Lim.DSQ_Com_stGear_CA DINH_Lim.DSQ_Com_stKeyVld_CA DINH_Lim.DSQ_Com_stReqMSA_CA DINH_Lim.DSQ_Com_stT15_CA DINH_Lim.DSQ_Com_stT50_CA DINH_Lim.DSQ_Com_stTrqDSCDes_CA DINH_Lim.DSQ_Com_swtDrBltb_CA DINH_Lim.DSQ_Com_tEnvT_CA DINH_Lim.DSQ_Com_tGbxOil_CA DINH_Lim.DSQ_Com_trqAC_CA DINH_Lim.DSQ_Com_trqARSCur_CA DINH_Lim.DSQ_Com_trqARSDes_CA DINH_Lim.DSQ_Com_trqAvlAFS_CA DINH_Lim.DSQ_Com_trqDSCDes_CA DINH_Lim.DSQ_Com_trqGbxDes_CA DINH_Lim.DSQ_Com_trqGbxFrc_CA DINH_Lim.DSQ_Com_trqGbxMax_CA DINH_Lim.DSQ_Com_trqTarAFS_CA DINH_Lim.DSQ_Com_v_CA DINH_Lim.DSQ_Com_vBd_CA DINH_Lim.DSQ_DSMInhibitAlways_CA DINH_Lim.DSQ_ECBVlvActr_CA DINH_Lim.DSQ_ECBVlvSens_CA DINH_Lim.DSQ_EGRVlvActr_CA DINH_Lim.DSQ_EGRVlvSens_CA DINH_Lim.DSQ_EMDmp_0_CA DINH_Lim.DSQ_EMDmp_1_CA DINH_Lim.DSQ_EngPrtFWOsc_CA DINH_Lim.DSQ_EnvP_CA DINH_Lim.DSQ_EnvT_CA DINH_Lim.DSQ_FanActr_CA DINH_Lim.DSQ_FuelT_CA DINH_Lim.DSQ_LAYER2EDCMSAStp_CA DINH_Lim.DSQ_LSUO2_0_CA DINH_Lim.DSQ_LSUO2_1_CA DINH_Lim.DSQ_LSUO2_2_CA DINH_Lim.DSQ_LSUO2_3_CA DINH_Lim.DSQ_MeUnActr_CA DINH_Lim.DSQ_NSCDsRLamO2_CA DINH_Lim.DSQ_OilStSens_CA DINH_Lim.DSQ_OilT_CA DINH_Lim.DSQ_PAirFltDs_CA DINH_Lim.DSQ_PCACDs_CA DINH_Lim.DSQ_PCVActr_CA DINH_Lim.DSQ_PPFltUs_CA DINH_Lim.DSQ_TAFS_CA DINH_Lim.DSQ_TCACDs_CA DINH_Lim.DSQ_TECU_CA DINH_Lim.DSQ_TOxiCatUs_CA DINH_Lim.DSQ_TPFltUs_CA DINH_Lim.DSQ_ThrVlvActr_CA DINH_Lim.DSQ_ThrVlvSens_CA DINH_Lim.DSQ_TrbChActr_CA DINH_Lim.DSQ_TrbChLPActr_CA DINH_Lim.DSQ_TrbChSens_CA DINH_Lim.DSQ_TrbnDsRLamO2_CA DINH_Lim.DSQ_VSwVlvActr_CA DINH_Lim.DSQ_VSwVlvSens_CA DINH_Lim.DSQ_VehV_CA DINH_Lim.DSQ_WaHtElActr_CA DINH_Lim.DSQ_stAPP_CA DINH_Lim.DSQ_stAPP1_CA DINH_Lim.DSQ_stAPP2_CA DINH_Lim.DSQ_stLSUSrvTstDem_CA /end DEF_CHARACTERISTIC
/end FUNCTION
/begin FUNCTION Dio "" /end FUNCTION
/begin FUNCTION dio_auto "" /begin DEF_CHARACTERISTIC Dio_idxBrkMnID_C Dio_idxBrkRedID_C /end DEF_CHARACTERISTIC /end FUNCTION
/begin FUNCTION Distab "" /end FUNCTION
/begin FUNCTION DIUMPR ""
 /begin DEF_CHARACTERISTIC DIUMPR_ctGen.tiIgnMin_C DIUMPR_ctGen.tiActrMin_C DIUMPR_ctGen.tiVehSpdMin_C DIUMPR_ctGen.nIgnMin_C DIUMPR_ctGen.pEnvMin_C DIUMPR_ctGen.vVehMin_C DIUMPR_ctGen.rAPPMax_C DIUMPR_ctGen.vVehIdlMax_C DIUMPR_ctGen.tEnvMin_C DIUMPR_ctGen.tiIdlMin_C DIUMPR_ctGen.tiOpMin_C /end DEF_CHARACTERISTIC
 /begin OUT_MEASUREMENT DIUMPR_ctGenDenom DIUMPR_ctIgn DIUMPR_stEnaDenom DIUMPR_stFIdGenDenom_mp DIUMPR_tiEngOpCum DIUMPR_tiIdl DIUMPR_tiIgn DIUMPR_tiVehSpdCum /end OUT_MEASUREMENT
/end FUNCTION
/begin FUNCTION diumpr_auto ""
 /begin DEF_CHARACTERISTIC DIUMPR_Check_CA DIUMPR_ctRatioIdx_CA DIUMPR_FID_CA DIUMPR_Group_CA DIUMPR_numSigActv_CA DIUMPR_valSigActvMax_CA DIUMPR_valSigActvMin_CA /end DEF_CHARACTERISTIC
 /begin OUT_MEASUREMENT DIUMPR_ctDenom DIUMPR_ctNum DIUMPR_numIndGrp DIUMPR_rMBGrp DIUMPR_rValRatMin DIUMPR_state DIUMPR_tiSigActv /end OUT_MEASUREMENT
/end FUNCTION
/begin FUNCTION Dma "" /end FUNCTION
/begin FUNCTION Dme "" /begin OUT_MEASUREMENT Dme_ctDataSetVariant Dme_numBytesAvailable /end OUT_MEASUREMENT /end FUNCTION
/begin FUNCTION DSCHED ""
 /begin DEF_CHARACTERISTIC DSCHED_idxWTTEnd_C DSCHED_idxWTTStrt_C DSCHED_stMode_C DSCHED_valDflOpMode_C DSCHED_valOfsPrioNoTst_C DSCHED_valOfsPrioOpMode_C DSCHED_valOfsPrioTst_C DSCHED_xFctTstFId_CA DSCHED_xSleepFId_CA /end DEF_CHARACTERISTIC
 /begin OUT_MEASUREMENT DSCHED_tiWTT /end OUT_MEASUREMENT
 /begin LOC_MEASUREMENT DSCHED_idxWTTAct /end LOC_MEASUREMENT
/end FUNCTION
/begin COMPU_METHOD DEFAULT_FORMULA "DEFAULT_FORMULA" RAT_FUNC "%7.0" "" COEFFS 0 1 0 0 0 1 /end COMPU_METHOD
/begin COMPU_METHOD DFC_Verb "" TAB_VERB "%2.1" "-" COMPU_TAB_REF DFC_Verb /end COMPU_METHOD
/begin COMPU_VTAB DFC_Verb "" TAB_VERB 577 0 "DFC_Unused" 1 "DFC_AirCtlGovDvtEOMMax" 2 "DFC_AirCtlGovDvtEOMMin" 3 "DFC_AirCtlGovDvtMax" 4 "DFC_AirCtlGovDvtMin" 5 "DFC_Cj945SpiCom1" 6 "DFC_ComButtonMSASig" 7 "DFC_ComButtonMSATo" 8 "DFC_ComGearboxData2Sig" 9 "DFC_ComGearboxData2To" 10 "DFC_ComGearboxDataSig" 11 "DFC_ComGearboxDataTo" 12 "DFC_ComHeatACSig" 13 "DFC_ComHeatACTo" 14 "DFC_ComLenkradwinkelSig" 15 "DFC_ComLenkradwinkelTo" 16 "DFC_ComMileageRangeSig" 17 "DFC_ComMileageRangeTo" 18 "DFC_ComPspSig" 19 "DFC_ComPspTo" 20 "DFC_ComShutOffPSPSig" 21 "DFC_ComShutOffPSPTo" 22 "DFC_ComStKombiCtr" 23 "DFC_ComStKombiSig" 24 "DFC_ComStKombiTo" 25 "DFC_ComStateARSCtr" 26 "DFC_ComStateARSSig" 27 "DFC_ComStateARSTo" 28 "DFC_ComStateDscSig" 29 "DFC_ComStateDscTo" 30 "DFC_ComStateSeatSig" 31 "DFC_ComStateSeatTo" 32 "DFC_ComTempRelTimeSig" 33 "DFC_ComTempRelTimeTo" 34 "DFC_ComTerminalChk" 35 "DFC_ComTerminalCtr" 36 "DFC_ComTerminalSig" 37 "DFC_ComTerminalTo" 38 "DFC_ComTimeDateSig" 39 "DFC_ComTimeDateTo" 40 "DFC_ComTrailerSig" 41 "DFC_ComTrailerTo" 42 "DFC_ComTrqDemandAfsChk" 43 "DFC_ComTrqDemandAfsCtr" 44 "DFC_ComTrqDemandAfsSig" 45 "DFC_ComTrqDemandAfsTo" 46 "DFC_ComTrqDemandDscChk" 47 "DFC_ComTrqDemandDscCtr" 48 "DFC_ComTrqDemandDscSig" 49 "DFC_ComTrqDemandDscTo" 50 "DFC_ComTrqDemandGbxChk" 51 "DFC_ComTrqDemandGbxCtr" 52 "DFC_ComTrqDemandGbxSig" 53 "DFC_ComTrqDemandGbxTo" 54 "DFC_ComVelocitySig" 55 "DFC_ComVelocityTo" 56 "DFC_ComWheelSpeedSig" 57 "DFC_ComWheelSpeedTo" 58 "DFC_ComZvKlappenSig" 59 "DFC_ComZvKlappenTo" 60 "DFC_Cy150SpiCom" 61 "DFC_Cy320SpiCom" 62 "DFC_ETCtlDvtInrMax" 63 "DFC_ETCtlDvtInrMin" 64 "DFC_ETCtlDvtOutrMax" 65 "DFC_ETCtlDvtOutrMin" 66 "DFC_Fan4WinErr1" 67 "DFC_Fan4WinErr2" 68 "DFC_Fan4WinErr3" 69 "DFC_Fan4WinErr4" 70 "DFC_FanSCG" 71 "DFC_PCRGovDvtLPMax" 72 "DFC_PCRGovDvtLPMin" 73 "DFC_PCRGovDvtMax" 74 "DFC_PCRGovDvtMin" 75 "DFC_RailCPC1" 76 "DFC_RailCPC3" 77 "DFC_RailCPC4" 78 "DFC_RailMeUn0" 79 "DFC_RailMeUn1" 80 "DFC_RailMeUn2" 81 "DFC_RailMeUn3" 82 "DFC_RailMeUn4" 83 "DFC_RailPCV0" 84 "DFC_RailPCV1" 85 "DFC_RailPCV2" 86 "DFC_RailPCV3" 87 "DFC_RailPCV4" 88 "DFC_RailPMonStrt" 89 "DFC_SSpMon1" 90 "DFC_SSpMon2" 91 "DFC_SSpMon3" 92 "DFC_Sia_E1" 93 "DFC_Sia_E10" 94 "DFC_Sia_E11" 95 "DFC_Sia_E12" 96 "DFC_Sia_E13" 97 "DFC_Sia_E14" 98 "DFC_Sia_E15" 99 "DFC_Sia_E2" 100 "DFC_Sia_E3" 101 "DFC_Sia_E4" 102 "DFC_Sia_E5" 103 "DFC_Sia_E6" 104 "DFC_Sia_E7" 105 "DFC_Sia_E8" 106 "DFC_Sia_E9" 107 "DFC_ThrVlv4WinErr1" 108 "DFC_ThrVlv4WinErr2" 109 "DFC_ThrVlv4WinErr3" 110 "DFC_ThrVlv4WinErr4" 111 "DFC_ThrVlvSCG" 112 "DFC_TrbCh4WinErr1" 113 "DFC_TrbCh4WinErr2" 114 "DFC_TrbCh4WinErr3" 115 "DFC_TrbCh4WinErr4" 116 "DFC_TrbChSCG" 117 "DFC_TrbChSRCMax" 118 "DFC_TrbChSRCMin" 119 "DFC_WaHtEl4WinErr1" 120 "DFC_WaHtEl4WinErr2" 121 "DFC_WaHtEl4WinErr3" 122 "DFC_WaHtEl4WinErr4" 123 "DFC_WaHtElSCG" 124 "DFC_ETClbETFltMax" 125 "DFC_ETClbETFltMin" 126 "DFC_InjCrvInjLimChrgBal" 127 "DFC_InjCrvInjLimQntBal" 128 "DFC_InjCrvInjLimSys" 129 "DFC_InjCrvNumInjRtmLim" 130 "DFC_LSUHtCoupSig_0" 131 "DFC_LSUHtCoupSig_1" 132 "DFC_LSUHtCoupSig_2" 133 "DFC_LSUHtCoupSig_3" 134 "DFC_CtT" 135 "DFC_DSMDummy" 136 "DFC_MeUnOL" 137 "DFC_MeUnSCB" 138 "DFC_MeUnSRCMax" 139 "DFC_MeUnSRCMin" 140 "DFC_PCVOL" 141 "DFC_PCVSCB" 142 "DFC_PCVSRCMax" 143 "DFC_PCVSRCMin" 144 "DFC_RailPSRCMax" 145 "DFC_RailPSRCMin" 146 "DFC_IVActrVltgSRCMax" 147 "DFC_IVActrVltgSRCMin" 148 "DFC_IVPSplyDCDC" 149 "DFC_IVPSplyVltgSRCMax" 150 "DFC_IVPSplyVltgSRCMin" 151 "DFC_AFSOffsDrftMax" 152 "DFC_AFSOffsDrftMin" 153 "DFC_AFSSRCCorMax" 154 "DFC_AFSSRCCorMin" 155 "DFC_AFSSRCRawMax" 156 "DFC_AFSSRCRawMin" 157 "DFC_AFSSetyDrftMax" 158 "DFC_AFSSetyDrftMin" 159 "DFC_AirCClntPAnaSRCMax" 160 "DFC_AirCClntPAnaSRCMin" 161 "DFC_AirCClntPPerSRCMax" 162 "DFC_AirCClntPPerSRCMin" 163 "DFC_AirCClntPdcycSRCMax" 164 "DFC_AirCClntPdcycSRCMin" 165 "DFC_AirCCmprOL" 166 "DFC_AirCCmprRedTrqOL" 167 "DFC_AirCCmprRedTrqSCB" 168 "DFC_AirCCmprRedTrqSCG" 169 "DFC_AirCCmprSCB" 170 "DFC_AirCCmprSCG" 171 "DFC_AirCSwtNpl" 172 "DFC_AirCSwtSig" 173 "DFC_BattUSRCMax" 174 "DFC_BattUSRCMin" 175 "DFC_BrkNpl" 176 "DFC_BrkPSRCMax" 177 "DFC_BrkPSRCMin" 178 "DFC_BrkSig" 179 "DFC_CByVlvOL" 180 "DFC_CByVlvSCB" 181 "DFC_CByVlvSCG" 182 "DFC_CEngDsTSRCMax" 183 "DFC_CEngDsTSRCMin" 184 "DFC_CEngDsTSig" 185 "DFC_CEngUsTSRCMax" 186 "DFC_CEngUsTSRCMin" 187 "DFC_CThmstOL" 188 "DFC_CThmstSCB" 189 "DFC_CThmstSCG" 190 "DFC_ClthSig" 191 "DFC_ECBVlvOL" 192 "DFC_ECBVlvSCB" 193 "DFC_ECBVlvSCG" 194 "DFC_ECBVlvSRCMax" 195 "DFC_ECBVlvSRCMin" 196 "DFC_EGRVlvGovDvtMax" 197 "DFC_EGRVlvGovDvtMin" 198 "DFC_EGRVlvOL" 199 "DFC_EGRVlvSCB" 200 "DFC_EGRVlvSCG" 201 "DFC_EGRVlvSRCMax" 202 "DFC_EGRVlvSRCMin" 203 "DFC_EMDmpOL_0" 204 "DFC_EMDmpOL_1" 205 "DFC_EMDmpSCB_0" 206 "DFC_EMDmpSCB_1" 207 "DFC_EMDmpSCG_0" 208 "DFC_EMDmpSCG_1" 209 "DFC_EngStAOL" 210 "DFC_EngStASCB" 211 "DFC_EngStASCG" 212 "DFC_EnvPSRCMax" 213 "DFC_EnvPSRCMin" 214 "DFC_EnvPSig" 215 "DFC_EnvTSRCMax" 216 "DFC_EnvTSRCMin" 217 "DFC_FanOL" 218 "DFC_FanSCB" 219 "DFC_FlFltSig" 220 "DFC_FuelTSRCMax" 221 "DFC_FuelTSRCMin" 222 "DFC_GbxNPosPPerSRCMax" 223 "DFC_GbxNPosPPerSRCMin" 224 "DFC_GbxNPosPdcycSRCMax" 225 "DFC_GbxNPosPdcycSRCMin" 226 "DFC_GbxNPosSig" 227 "DFC_GlwPlgBSDOL_0" 228 "DFC_GlwPlgBSDOL_1" 229 "DFC_GlwPlgBSDOL_2" 230 "DFC_GlwPlgBSDOL_3" 231 "DFC_GlwPlgBSDOL_4" 232 "DFC_GlwPlgBSDOL_5" 233 "DFC_GlwPlgBSDOL_6" 234 "DFC_GlwPlgBSDOL_7" 235 "DFC_GlwPlgBSDOT_0" 236 "DFC_GlwPlgBSDOT_1" 237 "DFC_GlwPlgBSDOT_2" 238 "DFC_GlwPlgBSDOT_3" 239 "DFC_GlwPlgBSDOT_4" 240 "DFC_GlwPlgBSDOT_5" 241 "DFC_GlwPlgBSDOT_6" 242 "DFC_GlwPlgBSDOT_7" 243 "DFC_GlwPlgBSDSC_0" 244 "DFC_GlwPlgBSDSC_1" 245 "DFC_GlwPlgBSDSC_2" 246 "DFC_GlwPlgBSDSC_3" 247 "DFC_GlwPlgBSDSC_4" 248 "DFC_GlwPlgBSDSC_5" 249 "DFC_GlwPlgBSDSC_6" 250 "DFC_GlwPlgBSDSC_7" 251 "DFC_GlwPlgComErr" 252 "DFC_InjVlvPresMin" 253 "DFC_LSUCircNernstMax_0" 254 "DFC_LSUCircNernstMax_1" 255 "DFC_LSUCircNernstMax_2" 256 "DFC_LSUCircNernstMax_3" 257 "DFC_LSUCircNernstMin_0" 258 "DFC_LSUCircNernstMin_1" 259 "DFC_LSUCircNernstMin_2" 260 "DFC_LSUCircNernstMin_3" 261 "DFC_LSUCircNernstSig_0" 262 "DFC_LSUCircNernstSig_1" 263 "DFC_LSUCircNernstSig_2" 264 "DFC_LSUCircNernstSig_3" 265 "DFC_LSUCircPmpCurMax_0" 266 "DFC_LSUCircPmpCurMax_1" 267 "DFC_LSUCircPmpCurMax_2" 268 "DFC_LSUCircPmpCurMax_3" 269 "DFC_LSUCircPmpCurMin_0" 270 "DFC_LSUCircPmpCurMin_1" 271 "DFC_LSUCircPmpCurMin_2" 272 "DFC_LSUCircPmpCurMin_3" 273 "DFC_LSUCircPmpCurSig_0" 274 "DFC_LSUCircPmpCurSig_1" 275 "DFC_LSUCircPmpCurSig_2" 276 "DFC_LSUCircPmpCurSig_3" 277 "DFC_LSUCircVirtGndMax_0" 278 "DFC_LSUCircVirtGndMax_1" 279 "DFC_LSUCircVirtGndMax_2" 280 "DFC_LSUCircVirtGndMax_3" 281 "DFC_LSUCircVirtGndMin_0" 282 "DFC_LSUCircVirtGndMin_1" 283 "DFC_LSUCircVirtGndMin_2" 284 "DFC_LSUCircVirtGndMin_3" 285 "DFC_LSUCircVirtGndSig_0" 286 "DFC_LSUCircVirtGndSig_1" 287 "DFC_LSUCircVirtGndSig_2" 288 "DFC_LSUCircVirtGndSig_3" 289 "DFC_LSUHtrMax_0" 290 "DFC_LSUHtrMax_1" 291 "DFC_LSUHtrMax_2" 292 "DFC_LSUHtrMax_3" 293 "DFC_LSUHtrMin_0" 294 "DFC_LSUHtrMin_1" 295 "DFC_LSUHtrMin_2" 296 "DFC_LSUHtrMin_3" 297 "DFC_LSUHtrSig_0" 298 "DFC_LSUHtrSig_1" 299 "DFC_LSUHtrSig_2" 300 "DFC_LSUHtrSig_3" 301 "DFC_LSUO2Max_0" 302 "DFC_LSUO2Max_1" 303 "DFC_LSUO2Max_2" 304 "DFC_LSUO2Max_3" 305 "DFC_LSUO2Min_0" 306 "DFC_LSUO2Min_1" 307 "DFC_LSUO2Min_2" 308 "DFC_LSUO2Min_3" 309 "DFC_LSUSPIBattLowMin_0" 310 "DFC_LSUSPIBattLowMin_1" 311 "DFC_LSUSPIBattLowMin_2" 312 "DFC_LSUSPIBattLowMin_3" 313 "DFC_LSUSPISig_0" 314 "DFC_LSUSPISig_1" 315 "DFC_LSUSPISig_2" 316 "DFC_LSUSPISig_3" 317 "DFC_LSUtExcMax_0" 318 "DFC_LSUtExcMax_1" 319 "DFC_LSUtExcMax_2" 320 "DFC_LSUtExcMax_3" 321 "DFC_LSUtExcMin_0" 322 "DFC_LSUtExcMin_1" 323 "DFC_LSUtExcMin_2" 324 "DFC_LSUtExcMin_3" 325 "DFC_MILOL" 326 "DFC_MILSCB" 327 "DFC_MILSCG" 328 "DFC_MeUnSCG" 329 "DFC_NplHsChngPPFltDiff" 330 "DFC_NplPAirFltDs" 331 "DFC_NplTPFltUs" 332 "DFC_OilComErr" 333 "DFC_OilPLmpOL" 334 "DFC_OilPLmpSCB" 335 "DFC_OilPLmpSCG" 336 "DFC_OilPNpl" 337 "DFC_OilTNpl" 338 "DFC_OilTSRCMax" 339 "DFC_OilTSRCMin" 340 "DFC_PCACDsEnvPPls" 341 "DFC_PCACDsSRCMax" 342 "DFC_PCACDsSRCMin" 343 "DFC_PCVSCG" 344 "DFC_PFltCharPDiffMin" 345 "DFC_PFltDstrMin" 346 "DFC_PFltEngPrt" 347 "DFC_PFltLmpOL" 348 "DFC_PFltLmpSCB" 349 "DFC_PFltLmpSCG" 350 "DFC_PFltRgnPerm" 351 "DFC_PFltSRCMaxFlwRstn" 352 "DFC_PFltSRCMinFlwRstn" 353 "DFC_PFltSotMsDvtMax" 354 "DFC_PFltSotMsDvtMin" 355 "DFC_PFltSotMsMax" 356 "DFC_PSPOL" 357 "DFC_PSPSCB" 358 "DFC_PSPSCG" 359 "DFC_SRCHighAPP1" 360 "DFC_SRCHighAPP2" 361 "DFC_SRCLowAPP1" 362 "DFC_SRCLowAPP2" 363 "DFC_SRCMaxPAirFltDs" 364 "DFC_SRCMaxPPFltUs" 365 "DFC_SRCMaxTECU" 366 "DFC_SRCMaxTOxiCatUs" 367 "DFC_SRCMaxTPFltUs" 368 "DFC_SRCMinPAirFltDs" 369 "DFC_SRCMinPPFltUs" 370 "DFC_SRCMinTECU" 371 "DFC_SRCMinTOxiCatUs" 372 "DFC_SRCMinTPFltUs" 373 "DFC_SVSOL" 374 "DFC_SVSSCB" 375 "DFC_SVSSCG" 376 "DFC_StrtOL" 377 "DFC_StrtSCB" 378 "DFC_StrtSCG" 379 "DFC_SyncAPP" 380 "DFC_T15Npl" 381 "DFC_TAFSDtyCycHi" 382 "DFC_TAFSDtyCycLo" 383 "DFC_TAFSPerHi" 384 "DFC_TAFSPerLo" 385 "DFC_TCACDsSRCMax" 386 "DFC_TCACDsSRCMin" 387 "DFC_ThrVlvOL" 388 "DFC_ThrVlvSCB" 389 "DFC_ThrVlvSRCMax" 390 "DFC_ThrVlvSRCMin" 391 "DFC_TrbChLPOL" 392 "DFC_TrbChLPSCB" 393 "DFC_TrbChLPSCG" 394 "DFC_TrbChOL" 395 "DFC_TrbChSCB" 396 "DFC_VSwVlvGovDvtMax" 397 "DFC_VSwVlvGovDvtMin" 398 "DFC_VSwVlvOL" 399 "DFC_VSwVlvSCB" 400 "DFC_VSwVlvSCG" 401 "DFC_VSwVlvSRCMax" 402 "DFC_VSwVlvSRCMin" 403 "DFC_VehVHW" 404 "DFC_VehVMax" 405 "DFC_VehVPlaus" 406 "DFC_VehVSig" 407 "DFC_WaHtElOL" 408 "DFC_WaHtElSCB" 409 "DFC_ClthNpl" 410 "DFC_ETClbETMax_0" 411 "DFC_ETClbETMax_1" 412 "DFC_ETClbETMax_2" 413 "DFC_ETClbETMax_3" 414 "DFC_ETClbETMax_4" 415 "DFC_ETClbETMax_5" 416 "DFC_ETClbETMin_0" 417 "DFC_ETClbETMin_1" 418 "DFC_ETClbETMin_2" 419 "DFC_ETClbETMin_3" 420 "DFC_ETClbETMin_4" 421 "DFC_ETClbETMin_5" 422 "DFC_IVDiaBnkShCirBSH_0" 423 "DFC_IVDiaBnkShCirBSH_1" 424 "DFC_IVDiaBnkShCirChSwt_0" 425 "DFC_IVDiaBnkShCirChSwt_1" 426 "DFC_IVDiaBnkShCirHSBatt_0" 427 "DFC_IVDiaBnkShCirHSBatt_1" 428 "DFC_IVDiaBnkShCirHiRstnc_0" 429 "DFC_IVDiaBnkShCirHiRstnc_1" 430 "DFC_IVDiaBnkShCirLSHSGnd_0" 431 "DFC_IVDiaBnkShCirLSHSGnd_1" 432 "DFC_IVDiaBnkShCirTransfer_0" 433 "DFC_IVDiaBnkShCirTransfer_1" 434 "DFC_IVDiaCylNoCls_0" 435 "DFC_IVDiaCylNoCls_1" 436 "DFC_IVDiaCylNoCls_2" 437 "DFC_IVDiaCylNoCls_3" 438 "DFC_IVDiaCylNoCls_4" 439 "DFC_IVDiaCylNoCls_5" 440 "DFC_IVDiaCylNoLd_0" 441 "DFC_IVDiaCylNoLd_1" 442 "DFC_IVDiaCylNoLd_2" 443 "DFC_IVDiaCylNoLd_3" 444 "DFC_IVDiaCylNoLd_4" 445 "DFC_IVDiaCylNoLd_5" 446 "DFC_IVDiaCylShCirHiRstnc_0" 447 "DFC_IVDiaCylShCirHiRstnc_1" 448 "DFC_IVDiaCylShCirHiRstnc_2" 449 "DFC_IVDiaCylShCirHiRstnc_3" 450 "DFC_IVDiaCylShCirHiRstnc_4" 451 "DFC_IVDiaCylShCirHiRstnc_5" 452 "DFC_IVDiaCylShCirLSBatt_0" 453 "DFC_IVDiaCylShCirLSBatt_1" 454 "DFC_IVDiaCylShCirLSBatt_2" 455 "DFC_IVDiaCylShCirLSBatt_3" 456 "DFC_IVDiaCylShCirLSBatt_4" 457 "DFC_IVDiaCylShCirLSBatt_5" 458 "DFC_IVDiaCylShCirLSHS_0" 459 "DFC_IVDiaCylShCirLSHS_1" 460 "DFC_IVDiaCylShCirLSHS_2" 461 "DFC_IVDiaCylShCirLSHS_3" 462 "DFC_IVDiaCylShCirLSHS_4" 463 "DFC_IVDiaCylShCirLSHS_5" 464 "DFC_IVDiaCylShCirLsLs_0" 465 "DFC_IVDiaCylShCirLsLs_1" 466 "DFC_IVDiaCylShCirLsLs_2" 467 "DFC_IVDiaCylShCirLsLs_3" 468 "DFC_IVDiaCylShCirLsLs_4" 469 "DFC_IVDiaCylShCirLsLs_5" 470 "DFC_IVDiaSPICfg" 471 "DFC_IVDiaSPIColl" 472 "DFC_IVDiaSPICtrl" 473 "DFC_IVDiaSPIRam" 474 "DFC_IVDiaSPITrans" 475 "DFC_LSUCmpChk_0" 476 "DFC_LSUCmpChk_1" 477 "DFC_LSUCmpChk_2" 478 "DFC_LSUCmpChk_3" 479 "DFC_LSUCmpChk_4" 480 "DFC_LSUCmpChk_5" 481 "DFC_LSUDynChk_0" 482 "DFC_LSUDynChk_1" 483 "DFC_LSUDynChk_2" 484 "DFC_LSUDynChk_3" 485 "DFC_LSUO2ClbMax_0" 486 "DFC_LSUO2ClbMax_1" 487 "DFC_LSUO2ClbMax_2" 488 "DFC_LSUO2ClbMax_3" 489 "DFC_LSUO2ClbMin_0" 490 "DFC_LSUO2ClbMin_1" 491 "DFC_LSUO2ClbMin_2" 492 "DFC_LSUO2ClbMin_3" 493 "DFC_LSUO2PlausMax_0" 494 "DFC_LSUO2PlausMax_1" 495 "DFC_LSUO2PlausMax_2" 496 "DFC_LSUO2PlausMax_3" 497 "DFC_LSUO2PlausMin_0" 498 "DFC_LSUO2PlausMin_1" 499 "DFC_LSUO2PlausMin_2" 500 "DFC_LSUO2PlausMin_3" 501 "DFC_LSURiClbMax_0" 502 "DFC_LSURiClbMax_1" 503 "DFC_LSURiClbMax_2" 504 "DFC_LSURiClbMax_3" 505 "DFC_LSURiClbMin_0" 506 "DFC_LSURiClbMin_1" 507 "DFC_LSURiClbMin_2" 508 "DFC_LSURiClbMin_3" 509 "DFC_LSUWireIPSig_0" 510 "DFC_LSUWireIPSig_1" 511 "DFC_LSUWireIPSig_2" 512 "DFC_LSUWireIPSig_3" 513 "DFC_AFSDrftIdlAdjVal" 514 "DFC_AFSDrftLdAdjVal" 515 "DFC_AdcI_ADC0_Cal" 516 "DFC_AdcI_ADC0_Conv" 517 "DFC_CmbChbMisfireMax_0" 518 "DFC_CmbChbMisfireMax_1" 519 "DFC_CmbChbMisfireMax_2" 520 "DFC_CmbChbMisfireMax_3" 521 "DFC_CmbChbMisfireMax_4" 522 "DFC_CmbChbMisfireMax_5" 523 "DFC_CmbChbMisfireMul" 524 "DFC_INJVLVBUSY" 525 "DFC_IVAdjIVA_0" 526 "DFC_IVAdjIVA_1" 527 "DFC_IVAdjIVA_2" 528 "DFC_IVAdjIVA_3" 529 "DFC_IVAdjIVA_4" 530 "DFC_IVAdjIVA_5" 531 "DFC_InjCtlAdjQntEEPCS" 532 "DFC_InjCtlDriftEEPCS" 533 "DFC_MRlyErlyOpng" 534 "DFC_MRlyStk" 535 "DFC_SensFrzPPFltUs" 536 "DFC_T15Sig" 537 "DFC_AirCtlRmpTOut" 538 "DFC_CEngDsTDynTst" 539 "DFC_EGRVlvJamVlvClsd" 540 "DFC_EGRVlvJamVlvOpn" 541 "DFC_EGRVlvLgTDrft" 542 "DFC_EGRVlvOfsLrnJamVlv" 543 "DFC_EGRVlvShTDrft" 544 "DFC_EGTRgnOilDilMax" 545 "DFC_EngICO" 546 "DFC_EpmCaSI1ErrSig" 547 "DFC_EpmCaSI1NoSig" 548 "DFC_EpmCaSI1OfsErr" 549 "DFC_EpmCrSErrSig" 550 "DFC_EpmCrSNoSig" 551 "DFC_MoCADCCmp" 552 "DFC_MoCADCTst" 553 "DFC_MoCADCVltgRatio" 554 "DFC_MoCSOPLoLi" 555 "DFC_MoCSOPMM" 556 "DFC_MoCSOPTimeOut" 557 "DFC_MoCSOPUpLi" 558 "DFC_MoFAPP" 559 "DFC_MoFESpd" 560 "DFC_MoFInjDatPhi" 561 "DFC_MoFInjDatQnt" 562 "DFC_MoFInjQnt" 563 "DFC_MoFOvR" 564 "DFC_MoFQntCor" 565 "DFC_MoFTrqCmp" 566 "DFC_NplTOxiCatUs" 567 "DFC_PhyModNonMonMapNpl" 568 "DFC_RailPOfsTstMax" 569 "DFC_RailPOfsTstMin" 570 "DFC_SWReset_0" 571 "DFC_SWReset_1" 572 "DFC_SWReset_2" 573 "DFC_VSwVlvJamVlv" 574 "DFC_VSwVlvLgTDrft" 575 "DFC_VSwVlvOfsLrnJamVlv" 576 "DFC_VSwVlvShTDrft" DEFAULT_VALUE "---" /end COMPU_VTAB
/begin COMPU_METHOD DFES_OneToOne "" RAT_FUNC "%6.2" "-" COEFFS 0 1 0 0 0 1 /end COMPU_METHOD
/begin COMPU_METHOD DINH_FIdVerb "" TAB_VERB "%2.1" "-" COMPU_TAB_REF DINH_FIdVerb /end COMPU_METHOD
/begin COMPU_VTAB DINH_FIdVerb "" TAB_VERB 414 0 "FId_Unused" 1 "FId_InhibitAlways" 2 "FId_CoordALS" 3 "FId_CoordFBC" 4 "FId_CoordTAA" 5 "FId_CoordZFC" 6 "FId_ACCtlTEngErr" 7 "FId_ACCtlTGearbxErr" 8 "FId_ACCtlVehVErr" 9 "FId_ACCtl_AC" 10 "FId_ACCtl_Fan" 11 "FId_AC_pAC" 12 "FId_AFS" 13 "FId_AFSActrTst" 14 "FId_AFSDrftMaxLim" 15 "FId_AFSFrzAirMs" 16 "FId_AFSPlOffsDrft" 17 "FId_AFSPlSetyDrft" 18 "FId_AFSSRC" 19 "FId_AFSSysErr" 20 "FId_AFSTPer" 21 "FId_APP1FinalDef" 22 "FId_APP1ProvDef" 23 "FId_APP1SRCHigh" 24 "FId_APP1SigPath" 25 "FId_APP2FinalDef" 26 "FId_APP2ProvDef" 27 "FId_APP2SRCHigh" 28 "FId_APP2SigPath" 29 "FId_APPBrkDef" 30 "FId_APPBrkPres" 31 "FId_APPNTP" 32 "FId_APPSyncChk" 33 "FId_APPSyncDef" 34 "FId_APPSyncProvDef" 35 "FId_APPSyncSigProv" 36 "FId_APPVel" 37 "FId_APProvDef" 38 "FId_ASDdc" 39 "FId_ASModNSC" 40 "FId_ASModOxiC" 41 "FId_ASModPipe" 42 "FId_ASModPipeSlw" 43 "FId_ASModPresCalc" 44 "FId_ASModPresEnv" 45 "FId_ASModStrt" 46 "FId_ASModSwtOffEng" 47 "FId_ASModSwtOffIndVol" 48 "FId_ASModTrbn" 49 "FId_AccPedNMaxLim" 50 "FId_AccPedNMinLim" 51 "FId_AccPedNMinLimBrkApp" 52 "FId_AccPedTrqLim" 53 "FId_AdcI_ADC0" 54 "FId_AirCClntPFrzVal" 55 "FId_AirCClntPPwmChk" 56 "FId_AirCClntPRplVal" 57 "FId_AirCSwt" 58 "FId_AirCtl" 59 "FId_AirCtlBstPresCor" 60 "FId_AirCtlCmpntActv" 61 "FId_AirCtlEGR" 62 "FId_AirCtlGear" 63 "FId_AirCtlGovDvt" 64 "FId_AirCtlPFltEGRRed" 65 "FId_AirCtlStrg" 66 "FId_AirCtlTVA" 67 "FId_BattUFrzVal" 68 "FId_BattUReplVal" 69 "FId_BattUSRC" 70 "FId_BrkP" 71 "FId_BrkPFrzVal" 72 "FId_BrkPReplVal" 73 "FId_CEngDsTCANFrzVal" 74 "FId_CEngDsTCANRplVal" 75 "FId_CEngDsTDynTst" 76 "FId_CEngDsTFrzVal" 77 "FId_CEngDsTModel" 78 "FId_CEngDsTRdClnt" 79 "FId_CEngDsTRplVal" 80 "FId_CEngDsTSS" 81 "FId_CEngUsTFrzVal" 82 "FId_CEngUsTReplVal" 83 "FId_CEngUsTSS" 84 "FId_Clth" 85 "FId_ClthCAN" 86 "FId_CmbChb" 87 "FId_CoETM" 88 "FId_CoEngNrml2Strt" 89 "FId_CoEngPthClsEGR" 90 "FId_CoEngPthClsThr" 91 "FId_CoEngPthCylOff" 92 "FId_CoEngPthETZr" 93 "FId_CoEngPthFlQnt" 94 "FId_CoEngPthInjVlvOff" 95 "FId_CoEngPthLpSysOff" 96 "FId_CoEngPthRPMin" 97 "FId_CoTS_SwtOff" 98 "FId_CoVehPrpLimErr" 99 "FId_ComAPP" 100 "FId_ComClth" 101 "FId_ComCoEng" 102 "FId_ComDscAck1" 103 "FId_ComDscAck2" 104 "FId_ComDscAck3" 105 "FId_ComDscTrqIntv" 106 "FId_ComEngDem" 107 "FId_ComGbxAck1" 108 "FId_ComGbxAck2" 109 "FId_ComGbxAck3" 110 "FId_ComGbxTrqIntv" 111 "FId_ComInjDu1" 112 "FId_ComInjDu2" 113 "FId_ComInjVlv" 114 "FId_ComMSA" 115 "FId_ComStBrkPedal" 116 "FId_ComStTrq" 117 "FId_ComnEng" 118 "FId_ComnSetPLo" 119 "FId_CompEnv" 120 "FId_ComrWaterVlv" 121 "FId_ConvLdNTrbnCan" 122 "FId_ConvLdOilTemp" 123 "FId_ConvLdTrqLdCan" 124 "FId_ConvLdVel" 125 "FId_CoordEGT" 126 "FId_CrCtl_irrev" 127 "FId_CrCtl_rev" 128 "FId_CtTSwtOff" 129 "FId_Cy100Dev1" 130 "FId_DCSRmpShOff" 131 "FId_DCSShOff" 132 "FId_DIOnumChip1Cj945" 133 "FId_DIUMPRGenDenom1" 134 "FId_DIUMPRGenDenom2" 135 "FId_DIUMPRGenDenom3" 136 "FId_DIUMPRIgn" 137 "FId_DSMWarmUpCycle" 138 "FId_DevLibActrPrt" 139 "FId_DewDetHtgDel" 140 "FId_ECBVlvFrzVal" 141 "FId_ECBVlvReplVal" 142 "FId_ECBVlvSS" 143 "FId_EGRClg" 144 "FId_EGRVlvActr" 145 "FId_EGRVlvFrzVal" 146 "FId_EGRVlvGovOn" 147 "FId_EGRVlvOfsLrnInhib" 148 "FId_EGRVlvReplVal" 149 "FId_EGRVlvSSpMon" 150 "FId_EGTRgnLck" 151 "FId_EMCtl" 152 "FId_ETClbCorActv" 153 "FId_ETCtlAirCtl" 154 "FId_ETCtlInr" 155 "FId_ETCtlOutr" 156 "FId_EngDemPFltErr" 157 "FId_EngDemTrqLimErr" 158 "FId_EngDemTrqLimErr1" 159 "FId_EngDemTrqLimErr2" 160 "FId_EngDemTrqLimErr3" 161 "FId_EngDemTrqLimErr4" 162 "FId_EngPrtEnvP" 163 "FId_EngPrtNLimErr" 164 "FId_EnvPCANFrzVal" 165 "FId_EnvPCANRplVal" 166 "FId_EnvPFrzVal" 167 "FId_EnvPModel" 168 "FId_EnvPRplVal" 169 "FId_EnvPSS" 170 "FId_EnvTCANFrzVal" 171 "FId_EnvTCANRplVal" 172 "FId_EnvTFrzVal" 173 "FId_EnvTModel" 174 "FId_EnvTRplVal" 175 "FId_EnvTSS" 176 "FId_EpmCaSDiag" 177 "FId_EpmCaSOfsDiag_I1" 178 "FId_EpmCaSOfsDiag_I2" 179 "FId_EpmCaSOfsDiag_O1" 180 "FId_EpmCaSOfsDiag_O2" 181 "FId_EpmCaSOfsDiag_SglCaSI1" 182 "FId_EpmCaSSegCor" 183 "FId_EpmCrSDiag" 184 "FId_EpmOpMode_InjLock" 185 "FId_FBC" 186 "FId_FanCtl" 187 "FId_FanCtlCor" 188 "FId_FanCtlCor2" 189 "FId_FanTraOil" 190 "FId_FansVelCor" 191 "FId_FlSysDens" 192 "FId_FrzPrtTrqDfftl" 193 "FId_FrzValPAirFltDs" 194 "FId_FrzValPPFltUs" 195 "FId_FrzValTOxiCatUs" 196 "FId_FrzValTPFltUs" 197 "FId_FuelTCTS" 198 "FId_FuelTFlSys" 199 "FId_FuelTFrzVal" 200 "FId_FuelTReplVal" 201 "FId_GbxNPos" 202 "FId_GbxNPosPWM" 203 "FId_GlbDaLSumvXPtd" 204 "FId_GlwCtl1" 205 "FId_HLSDemDfrstI" 206 "FId_HLSDemSetPLoDrvAwy" 207 "FId_HLSDemUndrBrk" 208 "FId_ISCnTrbnMod" 209 "FId_ISCvBd" 210 "FId_IVPSplyDCDCOff" 211 "FId_InhibitNever" 212 "FId_InjCrvCoErr" 213 "FId_InjCrvDisblPoI1" 214 "FId_InjCrvDisblPoI2" 215 "FId_InjSys_qLimErr" 216 "FId_InjSysqFuelT" 217 "FId_InjUnStrtPlsBlk" 218 "FId_InjVlvPresMin" 219 "FId_LSUAllChecks0" 220 "FId_LSUAllChecks1" 221 "FId_LSUClbSched" 222 "FId_LSUCmpChk0" 223 "FId_LSUCmpChk1" 224 "FId_LSUCtl0" 225 "FId_LSUCtl1" 226 "FId_LSUMon0" 227 "FId_LSUMon1" 228 "FId_LSUO20" 229 "FId_LSUO21" 230 "FId_LSURi0" 231 "FId_LSURi1" 232 "FId_LSUactiv0" 233 "FId_LSUactiv1" 234 "FId_LSUlsu0" 235 "FId_LSUlsu1" 236 "FId_MeUnFrzI" 237 "FId_MeUnRot" 238 "FId_NplPAirFltDs" 239 "FId_NplTOxiCatUs" 240 "FId_NplTPFltUs" 241 "FId_OilTCANFrzVal" 242 "FId_OilTCANRplVal" 243 "FId_OilTFrzVal" 244 "FId_OilTModel" 245 "FId_OilTNpl" 246 "FId_OilTRplVal" 247 "FId_OilTSS" 248 "FId_PAirFltDsCANFrzVal" 249 "FId_PAirFltDsCANRplVal" 250 "FId_PCACDsCANFrzVal" 251 "FId_PCACDsCANRplVal" 252 "FId_PCACDsEnvPPls" 253 "FId_PCACDsFrzVal" 254 "FId_PCACDsModel" 255 "FId_PCACDsRplVal" 256 "FId_PCACDsSS" 257 "FId_PCR" 258 "FId_PCRCByVlvOff" 259 "FId_PCRCmpntActv" 260 "FId_PCRCmpntActvLP" 261 "FId_PCRExtnLimActr" 262 "FId_PCRGovDvt" 263 "FId_PCRGovDvtLP" 264 "FId_PCRLP" 265 "FId_PCROfsRls" 266 "FId_PCRPFltPresCor" 267 "FId_PCVFrzI" 268 "FId_PCVPwrStgTst" 269 "FId_PFltAirSysFail" 270 "FId_PFltChar" 271 "FId_PFltDstr" 272 "FId_PFltLckRgnErr" 273 "FId_PFltLckRgnFl" 274 "FId_PFltLdSimRgnThr" 275 "FId_PFltPOpBrk" 276 "FId_PFltPOpClth" 277 "FId_PFltPOpGearDet" 278 "FId_PFltPOpSpdVeh" 279 "FId_PFltPOpTempAir" 280 "FId_PFltPOpTempClnt" 281 "FId_PFltPOpVltgBatt" 282 "FId_PFltPoI1Fail" 283 "FId_PFltPoI2Fail" 284 "FId_PFltRgnChngPar" 285 "FId_PFltSimOn" 286 "FId_PFltSrvRgnRlsEng" 287 "FId_PFltSrvRgnRlsPFlt" 288 "FId_PFltSysFail" 289 "FId_PTGripDebPtd" 290 "FId_PTTrqRatCANPtd" 291 "FId_PresSensFrzPPFltUs" 292 "FId_QWCCTSDef" 293 "FId_QWCFTSDef" 294 "FId_QWCOff" 295 "FId_RadShtCTS" 296 "FId_RadShtEGS" 297 "FId_RailCPCtlMeUnMode" 298 "FId_RailCPCtlPCVMode" 299 "FId_RailCtlMode" 300 "FId_RailFuelTErr" 301 "FId_RailMeUn0Blk" 302 "FId_RailMeUn0Rls" 303 "FId_RailMeUn1Blk" 304 "FId_RailMeUn1Rls" 305 "FId_RailMeUn2Blk" 306 "FId_RailMeUn2Rls" 307 "FId_RailMeUn3Blk" 308 "FId_RailMeUn3Rls" 309 "FId_RailMeUn4Blk" 310 "FId_RailMeUn4Rls" 311 "FId_RailMeUnCtlMode" 312 "FId_RailPCV0Blk" 313 "FId_RailPCV0Rls" 314 "FId_RailPCV1Blk" 315 "FId_RailPCV1Rls" 316 "FId_RailPCV2Blk" 317 "FId_RailPCV2Rls" 318 "FId_RailPCV3Blk" 319 "FId_RailPCV3Rls" 320 "FId_RailPCV4Blk" 321 "FId_RailPCV4Rls" 322 "FId_RailPCVCtlMode" 323 "FId_RailPFrzVal" 324 "FId_RailPMonStrt" 325 "FId_RailPSS" 326 "FId_RailPSubsVal" 327 "FId_RailSetPointLim" 328 "FId_RailSetPointRed" 329 "FId_ReplValTPFltUs" 330 "FId_RplValPAirFltDs" 331 "FId_RplValPPFltUs" 332 "FId_RplValTOxiCatUs" 333 "FId_SRCFlwRstn" 334 "FId_SSEStart" 335 "FId_SSEStartAST" 336 "FId_SSEStartMTClPressed10" 337 "FId_SSEStartMTClPressed90" 338 "FId_SSEStop" 339 "FId_SSEStopAST" 340 "FId_SSEStopMT" 341 "FId_SSPAirFltDs" 342 "FId_SSTOxiCatUs" 343 "FId_SSTPFltUs" 344 "FId_SensAdapTPFltUs" 345 "FId_StAPmp" 346 "FId_StDa" 347 "FId_SubsValPrtTrqDfftl" 348 "FId_SubsValRatTrqDfftl" 349 "FId_T15" 350 "FId_T50Sig" 351 "FId_TAFSFrzVal" 352 "FId_TAFSReplVal" 353 "FId_TAFSSRC" 354 "FId_TCACDsCANFrzVal" 355 "FId_TCACDsCANRplVal" 356 "FId_TCACDsFrzVal" 357 "FId_TCACDsModel" 358 "FId_TCACDsRplVal" 359 "FId_TCACDsSS" 360 "FId_TCPrtChrgPmpCtl" 361 "FId_TCPrtChrgPmpGov" 362 "FId_TCPrtChrgPmpHLSDem" 363 "FId_TCPrt_ChrgPmpDet" 364 "FId_TCSRmpShOff" 365 "FId_TCSShOff" 366 "FId_TECUFrzVal" 367 "FId_TECURplVal" 368 "FId_TOxiCatUs" 369 "FId_TempSensFrzPPFltUs" 370 "FId_ThrVlvFrzVal" 371 "FId_ThrVlvRplVal" 372 "FId_ThrVlvSS" 373 "FId_TraAddAirCANPtd" 374 "FId_TraAddClntCANPtd" 375 "FId_TraDrvAway" 376 "FId_TraDrvAwayInactiv" 377 "FId_TraGearInfoDet" 378 "FId_TraGearInfoInfoCan" 379 "FId_TraGearInfoLevPos" 380 "FId_TraGearInfoLoRng" 381 "FId_TraGearInfoRTra" 382 "FId_TraGearInfoRevGear" 383 "FId_TraGripDeb" 384 "FId_TraOilTemp" 385 "FId_TraPrtGearCANPtd" 386 "FId_TraRtnIntfcASTIntv" 387 "FId_TraRtnIntfcIdlSetP" 388 "FId_TraTrqLimErr" 389 "FId_TraTrqLos" 390 "FId_TraTrqRedLmpHmeDec" 391 "FId_TraTrqRedLmpHmeInc" 392 "FId_TraTrqRedPlausDecIntv" 393 "FId_TraTrqRedPlausIncIntv" 394 "FId_TrbChPWMIn" 395 "FId_VSwCtl" 396 "FId_VSwVlvFrzVal" 397 "FId_VSwVlvGovOn" 398 "FId_VSwVlvOfsLrnInhib" 399 "FId_VSwVlvOpnLd" 400 "FId_VSwVlvRplVal" 401 "FId_VSwVlvSS" 402 "FId_VehMotvBd" 403 "FId_VehVCANFrzVal" 404 "FId_VehVCANReplVal" 405 "FId_VehVFrzVal" 406 "FId_VehVMon" 407 "FId_VehVReplVal" 408 "FId_ZFCClbActv" 409 "FId_ZFCCldCmbCham" 410 "FId_stAVSCoESLSU" 411 "Fid_HLSDemHDC" 412 "Fid_StSysStrtTipGbxDat" 413 "Fid_WaHtShOffErr" DEFAULT_VALUE "---" /end COMPU_VTAB
/begin COMPU_METHOD DINH_LimDFCVerb "" TAB_VERB "%2.1" "-" COMPU_TAB_REF DINH_LimDFCVerb /end COMPU_METHOD
/begin COMPU_VTAB DINH_LimDFCVerb "" TAB_VERB 19 12079 "Def0_Deb0" 12083 "Def25_Deb0" 12087 "Def50_Deb0" 12091 "Def75_Deb0" 12094 "Def100_Deb0" 12111 "NotTested" 13111 "Def50_Deb25" 13115 "Def75_Deb25" 13118 "Def100_Deb25" 14135 "Def50_Deb50" 14139 "Def75_Deb50" 14142 "Def100_Deb50" 15159 "Def50_Deb75" 15163 "Def75_Deb75" 15166 "Def100_Deb75" 15927 "Def50_Deb100" 15931 "Def75_Deb100" 15934 "Def100_Deb100" 20271 "Tested" /end COMPU_VTAB
/begin COMPU_METHOD DINH_LimDSQVerb "" TAB_VERB "%2.1" "-" COMPU_TAB_REF DINH_LimDSQVerb /end COMPU_METHOD
/begin COMPU_VTAB DINH_LimDSQVerb "" TAB_VERB 16 0 "Qual_AllOk_0" 1 "Qual_1" 2 "Qual_Meas_2" 3 "Qual_PremFrozen_3" 4 "Qual_Model_4" 5 "Qual_5" 6 "Qual_6" 7 "Qual_7" 8 "Qual_Frozen_8" 9 "Qual_9" 10 "Qual_10" 11 "Qual_Tester_11" 12 "Qual_Default_12" 13 "Qual_13" 14 "Qual_14" 15 "Qual_Invalid_15" /end COMPU_VTAB
/begin COMPU_METHOD DINH_OneToOne "" RAT_FUNC "%8.3" "-" COEFFS 0 1 0 0 0 1 /end COMPU_METHOD
/begin COMPU_METHOD DIUMPR_GroupVerb "" TAB_VERB "%6.3" "-" COMPU_TAB_REF DIUMPR_GroupVerb /end COMPU_METHOD
/begin COMPU_VTAB DIUMPR_GroupVerb "" TAB_VERB 9 0 "Catalyst_Bank1" 1 "Catalyst_Bank2" 2 "OxygenSensor_Bank1" 3 "OxygenSensor_Bank2" 4 "EGR_VVT" 5 "SecAirSys" 6 "EvpSys" 7 "Private" 8 "Unused" /end COMPU_VTAB
/begin COMPU_METHOD DIUMPR_ti100ms "" RAT_FUNC "%6.3" "s" COEFFS 0 10 0 0 0 1 /end COMPU_METHOD
/begin COMPU_METHOD DSCHED_FIdVerb "" TAB_VERB "%2.1" "-" COMPU_TAB_REF DSCHED_FIdVerb /end COMPU_METHOD
/begin COMPU_VTAB DSCHED_FIdVerb "" TAB_VERB 6 0 "FId_Unused" 1 "FId_InhibitAlways" 2 "FId_CoordALS" 3 "FId_CoordFBC" 4 "FId_CoordTAA" 5 "FId_CoordZFC" DEFAULT_VALUE "---" /end COMPU_VTAB
/begin COMPU_METHOD DSCHED_Time100ms "" RAT_FUNC "%8.4" "s" COEFFS 0 10 0 0 0 1 /end COMPU_METHOD
/begin COMPU_METHOD EngN "" RAT_FUNC "%6.3" "rpm" COEFFS 0 2 0 0 0 1 /end COMPU_METHOD
/begin COMPU_METHOD Fact "" RAT_FUNC "%6.5" "-" COEFFS 0 8192 0 0 0 1 /end COMPU_METHOD
/begin COMPU_METHOD OneToOne "" RAT_FUNC "%6.2" "-" COEFFS 0 1 0 0 0 1 /end COMPU_METHOD
/begin COMPU_METHOD Prc "" RAT_FUNC "%6.4" "%" COEFFS 0 81.92 0 0 0 1 /end COMPU_METHOD
/begin COMPU_METHOD Pres_hPa "" RAT_FUNC "%6.2" "hPa" COEFFS 0 1 0 0 0 1 /end COMPU_METHOD
/begin COMPU_METHOD Signals_IntSigNumVerb "" TAB_VERB "%6.3" "-" COMPU_TAB_REF Signals_IntSigNumVerb /end COMPU_METHOD
/begin COMPU_VTAB Signals_IntSigNumVerb "" TAB_VERB 162 0 "SIGNALS_Signals_Default" 1 "SIGNALS_ETClb_ctLrn_mp[0]" 2 "SIGNALS_ETClb_ctLrn_mp[1]" 3 "SIGNALS_ETClb_ctLrn_mp[2]" 4 "SIGNALS_ETClb_dtiETFlt0_mp[0]" 5 "SIGNALS_ETClb_dtiETFlt0_mp[1]" 6 "SIGNALS_ETClb_dtiETFlt0_mp[2]" 7 "SIGNALS_ETClb_dtiETFlt0_mp[3]" 8 "SIGNALS_ETClb_dtiETFlt0_mp[4]" 9 "SIGNALS_ETClb_dtiETFlt0_mp[5]" 10 "SIGNALS_ETClb_dtiETFlt1_mp[0]" 11 "SIGNALS_ETClb_dtiETFlt1_mp[1]" 12 "SIGNALS_ETClb_dtiETFlt1_mp[2]" 13 "SIGNALS_ETClb_dtiETFlt1_mp[3]" 14 "SIGNALS_ETClb_dtiETFlt1_mp[4]" 15 "SIGNALS_ETClb_dtiETFlt1_mp[5]" 16 "SIGNALS_ETClb_dtiETFlt2_mp[0]" 17 "SIGNALS_ETClb_dtiETFlt2_mp[1]" 18 "SIGNALS_ETClb_dtiETFlt2_mp[2]" 19 "SIGNALS_ETClb_dtiETFlt2_mp[3]" 20 "SIGNALS_ETClb_dtiETFlt2_mp[4]" 21 "SIGNALS_ETClb_dtiETFlt2_mp[5]" 22 "SIGNALS_ETClb_pRailSet[0]" 23 "SIGNALS_ETClb_pRailSet[1]" 24 "SIGNALS_ETClb_pRailSet[2]" 25 "SIGNALS_ETClb_stCor" 26 "SIGNALS_ETClb_stRlsCylCor_mp" 27 "SIGNALS_ETClb_tiETAvrg[0]" 28 "SIGNALS_ETClb_tiETAvrg[1]" 29 "SIGNALS_ETClb_tiETAvrg[2]" 30 "SIGNALS_ETClb_tiETMax[0]" 31 "SIGNALS_ETClb_tiETMax[1]" 32 "SIGNALS_ETClb_tiETMax[2]" 33 "SIGNALS_ETClb_tiETMin[0]" 34 "SIGNALS_ETClb_tiETMin[1]" 35 "SIGNALS_ETClb_tiETMin[2]" 36 "SIGNALS_InjUn_stStrt" 37 "SIGNALS_InjVlv_tiMI1ET_mp" 38 "SIGNALS_InjVlv_tiPiI1ET_mp" 39 "SIGNALS_InjVlv_volMI1_mp" 40 "SIGNALS_InjVlv_volPiI1_mp" 41 "SIGNALS_MeUn_dvolSet" 42 "SIGNALS_MeUn_iActFlt_mp" 43 "SIGNALS_MeUn_iSet_mp" 44 "SIGNALS_MeUn_uRaw_mp" 45 "SIGNALS_PCV_iActFlt_mp" 46 "SIGNALS_PCV_iSet" 47 "SIGNALS_PCV_pSet" 48 "SIGNALS_PCV_uRaw_mp" 49 "SIGNALS_PFltSrv_stCondTstr" 50 "SIGNALS_PFltSrv_stRgnTstr" 51 "SIGNALS_PID01h" 52 "SIGNALS_PSP_stPs_mp" 53 "SIGNALS_RailP_pCurr_mp" 54 "SIGNALS_RailP_pLin" 55 "SIGNALS_Rail_dvolPreCtl" 56 "SIGNALS_Rail_stCtlLoop" 57 "SIGNALS_AFS_dm" 58 "SIGNALS_AFS_dmSens" 59 "SIGNALS_AFS_mAirPerCyl" 60 "SIGNALS_APP_rFlt_mp" 61 "SIGNALS_APP_rUnFlt" 62 "SIGNALS_APP_uRaw1" 63 "SIGNALS_APP_uRaw2" 64 "SIGNALS_ASMod_dvolPFltEG" 65 "SIGNALS_Absch_korr" 66 "SIGNALS_ActMod_trq" 67 "SIGNALS_ActMod_trqInr" 68 "SIGNALS_AirCtl_mDesVal" 69 "SIGNALS_Air_pCACDs" 70 "SIGNALS_Air_pSensPCACDs" 71 "SIGNALS_Air_rRawTAFS" 72 "SIGNALS_Air_tCACDs" 73 "SIGNALS_Air_uRawPCACDs" 74 "SIGNALS_Air_uRawTCACDs" 75 "SIGNALS_AltIO_rAltLoad" 76 "SIGNALS_BattU_uSens" 77 "SIGNALS_CEngDsT_t" 78 "SIGNALS_CEngDsT_tSens" 79 "SIGNALS_CEngDsT_uRaw" 80 "SIGNALS_CoEOM_stOpModeAct" 81 "SIGNALS_CoETS_rTrq" 82 "SIGNALS_CoEng_st" 83 "SIGNALS_Com_lSum" 84 "SIGNALS_Com_nPsp" 85 "SIGNALS_Com_rPspSetPoint" 86 "SIGNALS_DSMDur_ctGlb_0" 87 "SIGNALS_DSMRdy_xPId41" 88 "SIGNALS_D_soc" 89 "SIGNALS_EGRVlv_rPs" 90 "SIGNALS_EMDmp_stPs" 91 "SIGNALS_EngDa_tiEngOn" 92 "SIGNALS_EnvP_p" 93 "SIGNALS_EnvP_uRaw" 94 "SIGNALS_EpmCaS_phiOfsCorr" 95 "SIGNALS_EpmHCrS_stSigMode" 96 "SIGNALS_Epm_nEng" 97 "SIGNALS_Epm_stOpMode" 98 "SIGNALS_Epm_stSync" 99 "SIGNALS_Exh_pAdapPPFltDiff" 100 "SIGNALS_Exh_pPFltUs" 101 "SIGNALS_Exh_tOxiCatUs" 102 "SIGNALS_Exh_tPFltUs" 103 "SIGNALS_Exh_uRawPPFltUs" 104 "SIGNALS_Exh_uRawTOxiCatUs" 105 "SIGNALS_Exh_uRawTPFltUs" 106 "SIGNALS_FBC_qDvtCylPhys_01" 107 "SIGNALS_FBC_qDvtCylPhys_02" 108 "SIGNALS_FBC_qDvtCylPhys_03" 109 "SIGNALS_FBC_qDvtCylPhys_04" 110 "SIGNALS_FBC_qDvtCylPhys_05" 111 "SIGNALS_FBC_qDvtCylPhys_06" 112 "SIGNALS_FBC_qDvtCylPhys_07" 113 "SIGNALS_FBC_qDvtCylPhys_08" 114 "SIGNALS_FBC_qDvtCylPhys_09" 115 "SIGNALS_FBC_qDvtCylPhys_10" 116 "SIGNALS_Fan_rPs" 117 "SIGNALS_FlFlt_stRaw" 118 "SIGNALS_FuelT_t" 119 "SIGNALS_FuelT_uRaw" 120 "SIGNALS_GlwPlg_numPwrOut" 121 "SIGNALS_ISC_nSetPLo" 122 "SIGNALS_ISC_trq" 123 "SIGNALS_I_batt" 124 "SIGNALS_InjCtl_qCurr" 125 "SIGNALS_InjCtl_qSetUnBal" 126 "SIGNALS_LSU_rO2Adap[0]" 127 "SIGNALS_MeUn_rPs_mp" 128 "SIGNALS_MoFInjDat_tiTDCAvrg" 129 "SIGNALS_OilPLmp_st" 130 "SIGNALS_Oil_tSwmp" 131 "SIGNALS_Oz_oelkm" 132 "SIGNALS_PCR_pDesVal" 133 "SIGNALS_PCV_rPs_mp" 134 "SIGNALS_PFltLd_mOilAshEG_mp" 135 "SIGNALS_PFltLd_mSot" 136 "SIGNALS_PFltLd_mSotSim" 137 "SIGNALS_PFltRgn_qFl_mp" 138 "SIGNALS_PFltRgn_stIntr" 139 "SIGNALS_PFltRgn_stLck" 140 "SIGNALS_PID41h" 141 "SIGNALS_PSP_dvolOut" 142 "SIGNALS_PthSet_trqInrSet" 143 "SIGNALS_RailP_pFlt" 144 "SIGNALS_RailP_uRaw" 145 "SIGNALS_Rail_pSetPoint" 146 "SIGNALS_Stat_sv_reg" 147 "SIGNALS_T2hist" 148 "SIGNALS_T3hist" 149 "SIGNALS_T4hist" 150 "SIGNALS_T_batt" 151 "SIGNALS_ThrVlv_rPs" 152 "SIGNALS_Tn_abstell" 153 "SIGNALS_Toel" 154 "SIGNALS_TrbCh_r" 155 "SIGNALS_TrbCh_rPs" 156 "SIGNALS_U_batt" 157 "SIGNALS_U_gen" 158 "SIGNALS_VSwVlv_rPs" 159 "SIGNALS_VehV_v" 160 "SIGNALS_VehV_vSens" 161 "SIGNALS_WaHtEl_rPs" /end COMPU_VTAB
/begin COMPU_METHOD Temp_Cels "" RAT_FUNC "%6.1" "deg C" COEFFS 0 10 2731.4 0 0 1 /end COMPU_METHOD
/begin COMPU_METHOD Vel "" RAT_FUNC "%6.4" "km/h" COEFFS 0 100 0 0 0 1 /end COMPU_METHOD
/begin RECORD_LAYOUT ValA_Wu16 FNC_VALUES 1 UWORD COLUMN_DIR DIRECT /end RECORD_LAYOUT
/begin RECORD_LAYOUT ValA_Wu8 FNC_VALUES 1 UBYTE COLUMN_DIR DIRECT /end RECORD_LAYOUT
/begin RECORD_LAYOUT Val_Ws16 FNC_VALUES 1 SWORD COLUMN_DIR DIRECT /end RECORD_LAYOUT
/begin RECORD_LAYOUT Val_Wu16 FNC_VALUES 1 UWORD COLUMN_DIR DIRECT /end RECORD_LAYOUT
/begin RECORD_LAYOUT Val_Wu8 FNC_VALUES 1 UBYTE COLUMN_DIR DIRECT /end RECORD_LAYOUT
/end MODULE
/end PROJECT
