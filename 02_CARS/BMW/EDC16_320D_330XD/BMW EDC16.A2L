ASAP2_VERSION 1 3
/begin PROJECT P383 "BMW DDE6.3 8-Zylinder V9E.3 11.10.2004 CAN12H"
/begin HEADER "" VERSION "V9E.3_8Z_CAN12H" PROJECT_NO P383 /end HEADER
/begin MODULE DIM ""
/begin MOD_COMMON "" BYTE_ORDER MSB_FIRST ALIGNMENT_BYTE 1 ALIGNMENT_WORD 2 ALIGNMENT_LONG 4 ALIGNMENT_FLOAT32_IEEE 4 /end MOD_COMMON
/begin CHARACTERISTIC K_Q_BILAPWF "Defaultwert für q_bila nach Powerfail" VALUE 0x000C2F3C TKW_VV_VV_UW 100.0 Def_ql_uw_q0p0182 0.0 1193.0282 /begin FUNCTION_LIST PMSOCCALC /end FUNCTION_LIST FORMAT "%6.3" /end CHARACTERISTIC
/begin CHARACTERISTIC K_SOC_BILAWA "Applikationswert soc_bila" VALUE 0x000C2F3E TKW_VV_VV_UW 100.0 Def_f_uw_b100 0.0 99.9984 /begin FUNCTION_LIST PMSOCCALC /end FUNCTION_LIST FORMAT "%6.3" /end CHARACTERISTIC
/begin CHARACTERISTIC K_SOC_QPWF "Ladezustandsqualität nach Powerfail" VALUE 0x000C2F40 TKW_VV_VV_UW 100.0 Def_ql_uw_q0p0182 0.0 1193.0282 /begin FUNCTION_LIST PMSOCCALC /end FUNCTION_LIST FORMAT "%6.3" /end CHARACTERISTIC
/begin CHARACTERISTIC K_SOC_QUALIA "Applikationswert soc_quali" VALUE 0x000C2F42 TKW_VV_VV_UW 100.0 Def_ql_uw_q0p0182 0.0 1193.0282 /begin FUNCTION_LIST PMSOCCALC /end FUNCTION_LIST FORMAT "%6.3" /end CHARACTERISTIC
/begin CHARACTERISTIC CBATT_DEF "Ersatzwert Batteriekapazität" VALUE 0x000C2F44 TKW_VV_VV_UB 100.0 Def_ql_ub_q1 1.0000 255.0000 /begin FUNCTION_LIST PMSOCCALC /end FUNCTION_LIST /end CHARACTERISTIC
/begin CHARACTERISTIC K_IB_COMMVAL "Anzahl Taskaufrufe zwischen periodischer Abfrage qlad und qelad" VALUE 0x000C2F45 TKW_VV_VV_UB 100.0 Def_dez_ub_q1 0.0 255.0000 /begin FUNCTION_LIST PMSOCCALC /end FUNCTION_LIST /end CHARACTERISTIC
/begin CHARACTERISTIC K_PMQ_UX "Ruhespannung Extrapolationsteiler" VALUE 0x000C2F46 TKW_VV_VV_UB 100.0 Def_f_ub_b8 0.0313 7.9687 /begin FUNCTION_LIST PMSOCCALC /end FUNCTION_LIST /end CHARACTERISTIC
/begin CHARACTERISTIC S_BSOCCALC "Enable Rücksetzten Ruhespannungen IBS" VALUE 0x000C2F47 TKW_VV_VV_UB 100.0 Def_dez_ub_q1 0.0 255.0000 /begin FUNCTION_LIST PMSOCCALC /end FUNCTION_LIST /end CHARACTERISTIC
/begin CHARACTERISTIC S_SOC_BILA "Schalter für Applik. soc_bila" VALUE 0x000C2F48 TKW_VV_VV_UB 100.0 Def_dez_ub_q1 0.0 255.0000 /begin FUNCTION_LIST PMSOCCALC /end FUNCTION_LIST /end CHARACTERISTIC
/begin CHARACTERISTIC S_SOC_QUAL "Schalter für Applik. soc_quali" VALUE 0x000C2F49 TKW_VV_VV_UB 100.0 Def_dez_ub_q1 0.0 255.0000 /begin FUNCTION_LIST PMSOCCALC /end FUNCTION_LIST /end CHARACTERISTIC
/begin CHARACTERISTIC KL_SOC0TEMP "Temperaturabhängige Stromkorrektur für Ruhespannungsmessung" CURVE 0x000C2F4A TKL_SW_VV_UB 100.0 Def_f_ub_b2 0.0 1.9921 /begin FUNCTION_LIST PMSOCCALC /end FUNCTION_LIST
 /begin AXIS_DESCR STD_AXIS Tsocloc Def_t_sw_q0p1 5 -3276.8000 3276.7000 FORMAT "%4.1" /end AXIS_DESCR
/end CHARACTERISTIC
/begin CHARACTERISTIC KF_SOCLF "Ladefaktor in Abhängigkeit von Temperatur und Ladezustand" MAP 0x000C2F5C TKF_UW_SW_UB 100.0 Def_f_ub_b4 0.0157 3.9843 /begin FUNCTION_LIST PMSOCCALC /end FUNCTION_LIST
 /begin AXIS_DESCR STD_AXIS T_batt Def_t_sw_q0p1 3 -3276.8000 3276.7000 FORMAT "%4.1" /end AXIS_DESCR
 /begin AXIS_DESCR STD_AXIS Soc_b_loc Def_ql_uw_q0p0182 3 0.0 1192.7502 FORMAT "%6.3" /end AXIS_DESCR
/end CHARACTERISTIC
/begin CHARACTERISTIC KF_SOC0UBIB "" MAP 0x000C2F74 TKF_SW_UW_UW 100.0 Def_ql_uw_q0p0182 0.0 1193.0282 /begin FUNCTION_LIST PMSOCCALC /end FUNCTION_LIST
 /begin AXIS_DESCR STD_AXIS Ubatt0 Def_u_uw_q0p25em3_o6 3 6.0000 22.3837 FORMAT "%7.4" /end AXIS_DESCR
 /begin AXIS_DESCR STD_AXIS Isoc0loc Def_i_sw_q0p02 5 -655.3600 655.3400 FORMAT "%6.3" /end AXIS_DESCR
 FORMAT "%6.3" /end CHARACTERISTIC
/begin CHARACTERISTIC K_I_FITAUSW "Grenzwert Fitstrom" VALUE 0x000C2FA4 TKW_VV_VV_UW 100.0 Def_i_uw_q0p08_o200 -200.0000 5042.8000 /begin FUNCTION_LIST PMSOCFIT /end FUNCTION_LIST FORMAT "%6.3" /end CHARACTERISTIC
/begin CHARACTERISTIC K_SOCFITAPP "Applikationwert Soc aus der Fitberechnung" VALUE 0x000C2FA6 TKW_VV_VV_UW 100.0 Def_f_uw_b100 0.0 99.9984 /begin FUNCTION_LIST PMSOCFIT /end FUNCTION_LIST FORMAT "%6.3" /end CHARACTERISTIC
/begin CHARACTERISTIC ZK_PMSOC "Zeitfaktor" VALUE 0x000C2FA8 TKW_VV_VV_UW 100.0 Def_f_uw_b1 0.0 9.99984741210938e-1 /begin FUNCTION_LIST PMSOCFIT /end FUNCTION_LIST /end CHARACTERISTIC
/begin CHARACTERISTIC S_PMSOCFIT "Schalter zur Applikation SoC aus der Fitberechnung" VALUE 0x000C2FAA TKW_VV_VV_UB 100.0 Def_dez_ub_q1 0.0 255.0000 /begin FUNCTION_LIST PMSOCFIT /end FUNCTION_LIST /end CHARACTERISTIC
/begin CHARACTERISTIC KL_PMSOCVU "SoC-Wert aus der Fitberechnung" CURVE 0x000C2FAC TKL_UW_VV_UW 100.0 Def_f_uw_b100 0.0 99.9984 /begin FUNCTION_LIST PMSOCFIT /end FUNCTION_LIST
 /begin AXIS_DESCR STD_AXIS Ubatts2 Def_u_uw_q0p25em3_o6 3 6.0000 22.3837 FORMAT "%7.4" /end AXIS_DESCR
 FORMAT "%6.3" /end CHARACTERISTIC
/begin CHARACTERISTIC KF_PMRIBAT8 "Kennfeld Innenwiderstand Batterie8" MAP 0x000C2FBA TKF_UW_SW_UB 100.0 Def_f_ub_q0p001 0.0 0.2550 /begin FUNCTION_LIST PMSOCFIT /end FUNCTION_LIST
 /begin AXIS_DESCR STD_AXIS T_batt Def_t_sw_q0p1 4 -3276.8000 3276.7000 FORMAT "%4.1" /end AXIS_DESCR
 /begin AXIS_DESCR STD_AXIS I_batt Def_i_uw_q0p08_o200 6 -200.0000 5042.8000 FORMAT "%6.3" /end AXIS_DESCR
/end CHARACTERISTIC
/begin CHARACTERISTIC KF_PMRIBAT6 "Kennfeld Innenwiderstand Batterie6" MAP 0x000C2FE8 TKF_UW_SW_UB 100.0 Def_f_ub_q0p001 0.0 0.2550 /begin FUNCTION_LIST PMSOCFIT /end FUNCTION_LIST
 /begin AXIS_DESCR STD_AXIS T_batt Def_t_sw_q0p1 4 -3276.8000 3276.7000 FORMAT "%4.1" /end AXIS_DESCR
 /begin AXIS_DESCR STD_AXIS I_batt Def_i_uw_q0p08_o200 6 -200.0000 5042.8000 FORMAT "%6.3" /end AXIS_DESCR
/end CHARACTERISTIC
/begin CHARACTERISTIC KF_PMRIBAT5 "Kennfeld Innenwiderstand Batterie5" MAP 0x000C3016 TKF_UW_SW_UB 100.0 Def_f_ub_q0p001 0.0 0.2550 /begin FUNCTION_LIST PMSOCFIT /end FUNCTION_LIST
 /begin AXIS_DESCR STD_AXIS T_batt Def_t_sw_q0p1 4 -3276.8000 3276.7000 FORMAT "%4.1" /end AXIS_DESCR
 /begin AXIS_DESCR STD_AXIS I_batt Def_i_uw_q0p08_o200 6 -200.0000 5042.8000 FORMAT "%6.3" /end AXIS_DESCR
/end CHARACTERISTIC
/begin CHARACTERISTIC KF_PMRIBAT3 "Kennfeld Innenwiderstand Batterie3" MAP 0x000C3044 TKF_UW_SW_UB 100.0 Def_f_ub_q0p001 0.0 0.2550 /begin FUNCTION_LIST PMSOCFIT /end FUNCTION_LIST
 /begin AXIS_DESCR STD_AXIS T_batt Def_t_sw_q0p1 4 -3276.8000 3276.7000 FORMAT "%4.1" /end AXIS_DESCR
 /begin AXIS_DESCR STD_AXIS I_batt Def_i_uw_q0p08_o200 6 -200.0000 5042.8000 FORMAT "%6.3" /end AXIS_DESCR
/end CHARACTERISTIC
/begin CHARACTERISTIC KF_PMRIBAT4 "Kennfeld Innenwiderstand Batterie4" MAP 0x000C3072 TKF_UW_SW_UB 100.0 Def_f_ub_q0p001 0.0 0.2550 /begin FUNCTION_LIST PMSOCFIT /end FUNCTION_LIST
 /begin AXIS_DESCR STD_AXIS T_batt Def_t_sw_q0p1 4 -3276.8000 3276.7000 FORMAT "%4.1" /end AXIS_DESCR
 /begin AXIS_DESCR STD_AXIS I_batt Def_i_uw_q0p08_o200 6 -200.0000 5042.8000 FORMAT "%6.3" /end AXIS_DESCR
/end CHARACTERISTIC
/begin CHARACTERISTIC KF_PMRIBAT2 "Kennfeld Innenwiderstand Batterie2" MAP 0x000C30A0 TKF_UW_SW_UB 100.0 Def_f_ub_q0p001 0.0 0.2550 /begin FUNCTION_LIST PMSOCFIT /end FUNCTION_LIST
 /begin AXIS_DESCR STD_AXIS T_batt Def_t_sw_q0p1 4 -3276.8000 3276.7000 FORMAT "%4.1" /end AXIS_DESCR
 /begin AXIS_DESCR STD_AXIS I_batt Def_i_uw_q0p08_o200 6 -200.0000 5042.8000 FORMAT "%6.3" /end AXIS_DESCR
/end CHARACTERISTIC
/begin CHARACTERISTIC KF_PMRIBAT1 "Kennfeld Innenwiderstand Batterie" MAP 0x000C30CE TKF_UW_SW_UB 100.0 Def_f_ub_q0p001 0.0 0.2550 /begin FUNCTION_LIST PMSOCFIT /end FUNCTION_LIST
 /begin AXIS_DESCR STD_AXIS T_batt Def_t_sw_q0p1 4 -3276.8000 3276.7000 FORMAT "%4.1" /end AXIS_DESCR
 /begin AXIS_DESCR STD_AXIS I_batt Def_i_uw_q0p08_o200 6 -200.0000 5042.8000 FORMAT "%6.3" /end AXIS_DESCR
/end CHARACTERISTIC
/begin CHARACTERISTIC KF_PMRIBAT7 "Kennfeld Innenwiderstand Batterie7" MAP 0x000C30FC TKF_UW_SW_UB 100.0 Def_f_ub_q0p001 0.0 0.2550 /begin FUNCTION_LIST PMSOCFIT /end FUNCTION_LIST
 /begin AXIS_DESCR STD_AXIS T_batt Def_t_sw_q0p1 4 -3276.8000 3276.7000 FORMAT "%4.1" /end AXIS_DESCR
 /begin AXIS_DESCR STD_AXIS I_batt Def_i_uw_q0p08_o200 6 -200.0000 5042.8000 FORMAT "%6.3" /end AXIS_DESCR
/end CHARACTERISTIC
/begin CHARACTERISTIC K_ABSCHKORA "Applikationswert für Korrektur Abschaltung" VALUE 0x000C312A TKW_VV_VV_SW 100.0 Def_f_sw_q0p00153 -50.0000 49.9984 /begin FUNCTION_LIST PMSOCKOR /end FUNCTION_LIST FORMAT "%6.3" /end CHARACTERISTIC
/begin CHARACTERISTIC K_DAB_KORR1 "Korrekturkonstante 1 für Abschaltung" VALUE 0x000C312C TKW_VV_VV_SW 100.0 Def_f_sw_q0p00153 -50.0000 49.9984 /begin FUNCTION_LIST PMSOCKOR /end FUNCTION_LIST FORMAT "%6.3" /end CHARACTERISTIC
/begin CHARACTERISTIC K_DAB_KORR2 "Korrekturkonstante 2 für Abschaltung" VALUE 0x000C312E TKW_VV_VV_SW 100.0 Def_f_sw_q0p00153 -50.0000 49.9984 /begin FUNCTION_LIST PMSOCKOR /end FUNCTION_LIST FORMAT "%6.3" /end CHARACTERISTIC
/begin CHARACTERISTIC K_DAB_KORR3 "Korrekturkonstante 3 für Abschaltung" VALUE 0x000C3130 TKW_VV_VV_SW 100.0 Def_f_sw_q0p00153 -50.0000 49.9984 /begin FUNCTION_LIST PMSOCKOR /end FUNCTION_LIST FORMAT "%6.3" /end CHARACTERISTIC
/begin CHARACTERISTIC K_DSOCA "Applikationsgrösse für d_soc" VALUE 0x000C3132 TKW_VV_VV_SW 100.0 Def_f_sw_b100 -100.0000 99.9969 /begin FUNCTION_LIST PMSOCKOR /end FUNCTION_LIST FORMAT "%6.3" /end CHARACTERISTIC
/begin CHARACTERISTIC K_DSOCABSCH "Applikationsgrösse für d_soc" VALUE 0x000C3134 TKW_VV_VV_SW 100.0 Def_f_sw_b100 -100.0000 99.9969 /begin FUNCTION_LIST PMSOCKOR /end FUNCTION_LIST FORMAT "%6.3" /end CHARACTERISTIC
/begin CHARACTERISTIC K_TSAISPWF "Defaultwert Saison Temp bei DME Powerfail" VALUE 0x000C3136 TKW_VV_VV_SW 100.0 Def_t_sw_q0p1 -3276.8000 3276.7000 /begin FUNCTION_LIST PMSOCKOR /end FUNCTION_LIST FORMAT "%4.1" /end CHARACTERISTIC
/begin CHARACTERISTIC K_BILA_OGRZ "Grenzwert oberhalb dessen eine Apassung durch soc_kor nicht zulässig ist" VALUE 0x000C3138 TKW_VV_VV_UW 100.0 Def_f_uw_b100 0.0 99.9984 /begin FUNCTION_LIST PMSOCKOR /end FUNCTION_LIST FORMAT "%6.3" /end CHARACTERISTIC
/begin CHARACTERISTIC K_BILA_UGRZ "" VALUE 0x000C313A TKW_VV_VV_UW 100.0 Def_f_uw_b100 0.0 99.9984 /begin FUNCTION_LIST PMSOCKOR /end FUNCTION_LIST FORMAT "%6.3" /end CHARACTERISTIC
/begin CHARACTERISTIC K_PMTIMERSQ1 "Startwert Timer für soc_quali" VALUE 0x000C313C TKW_VV_VV_UW 100.0 Def_st_uw_q1 0.0 65535.0000 /begin FUNCTION_LIST PMSOCKOR /end FUNCTION_LIST /end CHARACTERISTIC
/begin CHARACTERISTIC K_PM_TABSMN "Applikationsgrösse für Abstellzeit tabsmn_w" VALUE 0x000C313E TKW_VV_VV_UW 100.0 Def_td_uw_q1 0.0 65535.0000 /begin FUNCTION_LIST PMSOCKOR /end FUNCTION_LIST /end CHARACTERISTIC
/begin CHARACTERISTIC K_QSOCCL1 "Grenze zur Ladezustandsqualitätsklasse1" VALUE 0x000C3140 TKW_VV_VV_UW 100.0 Def_ql_uw_q0p0182 0.0 1193.0282 /begin FUNCTION_LIST PMSOCKOR /end FUNCTION_LIST FORMAT "%6.3" /end CHARACTERISTIC
/begin CHARACTERISTIC K_QSOCCL2 "Grenze zur Ladezustandsqualitätsklasse2" VALUE 0x000C3142 TKW_VV_VV_UW 100.0 Def_ql_uw_q0p0182 0.0 1193.0282 /begin FUNCTION_LIST PMSOCKOR /end FUNCTION_LIST FORMAT "%6.3" /end CHARACTERISTIC
/begin CHARACTERISTIC K_QSOCCL3 "Grenze zur Ladezustandsqualitätsklasse3" VALUE 0x000C3144 TKW_VV_VV_UW 100.0 Def_ql_uw_q0p0182 0.0 1193.0282 /begin FUNCTION_LIST PMSOCKOR /end FUNCTION_LIST FORMAT "%6.3" /end CHARACTERISTIC
/begin CHARACTERISTIC K_QSTARTFGA "Applikationswert für q_startfgk" VALUE 0x000C3146 TKW_VV_VV_UW 100.0 Def_ql_uw_q0p0182 0.0 1193.0282 /begin FUNCTION_LIST PMSOCKOR /end FUNCTION_LIST FORMAT "%6.3" /end CHARACTERISTIC
/begin CHARACTERISTIC K_SOCFITGRZ "Grenzwert für soc_fit" VALUE 0x000C3148 TKW_VV_VV_UW 100.0 Def_f_uw_b100 0.0 99.9984 /begin FUNCTION_LIST PMSOCKOR /end FUNCTION_LIST FORMAT "%6.3" /end CHARACTERISTIC
/begin CHARACTERISTIC K_SOCFITLIMH "Applikationskonstante zur Verbesserung SoC aus der Fitberechnung" VALUE 0x000C314A TKW_VV_VV_UW 100.0 Def_f_uw_b100 0.0 99.9984 /begin FUNCTION_LIST PMSOCKOR /end FUNCTION_LIST FORMAT "%6.3" /end CHARACTERISTIC
/begin CHARACTERISTIC K_SOCFITLIML "Applikationskonstante zur Abwertung SoC aus der Fitberechnung" VALUE 0x000C314C TKW_VV_VV_UW 100.0 Def_f_uw_b100 0.0 99.9984 /begin FUNCTION_LIST PMSOCKOR /end FUNCTION_LIST FORMAT "%6.3" /end CHARACTERISTIC
/begin CHARACTERISTIC K_SOC_STAFGA "Applikationswert für SoC aus der Startfähigkeit" VALUE 0x000C314E TKW_VV_VV_UW 100.0 Def_f_uw_b100 0.0 99.9984 /begin FUNCTION_LIST PMSOCKOR /end FUNCTION_LIST FORMAT "%6.3" /end CHARACTERISTIC
/begin CHARACTERISTIC K_TSAISONFIL "Filterkonstante für t_saison" VALUE 0x000C3150 TKW_VV_VV_UW 100.0 Def_dez_uw_q1 1.0000 65535.0000 /begin FUNCTION_LIST PMSOCKOR /end FUNCTION_LIST /end CHARACTERISTIC
/begin CHARACTERISTIC S_ABSCHK "Schalter für Applikationswert absch_korr" VALUE 0x000C3152 TKW_VV_VV_UB 100.0 Def_dez_ub_q1 0.0 255.0000 /begin FUNCTION_LIST PMSOCKOR /end FUNCTION_LIST /end CHARACTERISTIC
/begin CHARACTERISTIC S_DSOCS "Schalter für Applikationswert Delta SoC" VALUE 0x000C3153 TKW_VV_VV_UB 100.0 Def_dez_ub_q1 0.0 255.0000 /begin FUNCTION_LIST PMSOCKOR /end FUNCTION_LIST /end CHARACTERISTIC
/begin CHARACTERISTIC S_PMTABSMN "Schalter für Applikation der Abstellzeit tabsmn_w" VALUE 0x000C3154 TKW_VV_VV_UB 100.0 Def_dez_ub_q1 0.0 255.0000 /begin FUNCTION_LIST PMSOCKOR /end FUNCTION_LIST /end CHARACTERISTIC
/begin CHARACTERISTIC S_QSTARTFK "Schalter für Applikation q_startfgk" VALUE 0x000C3155 TKW_VV_VV_UB 100.0 Def_dez_ub_q1 0.0 255.0000 /begin FUNCTION_LIST PMSOCKOR /end FUNCTION_LIST /end CHARACTERISTIC
/begin CHARACTERISTIC S_SOCSTAFK "Schalter für Applikation SoC aus der Startfähigkeit" VALUE 0x000C3156 TKW_VV_VV_UB 100.0 Def_dez_ub_q1 0.0 255.0000 /begin FUNCTION_LIST PMSOCKOR /end FUNCTION_LIST /end CHARACTERISTIC
/begin CHARACTERISTIC KL_FITGRZ "Grenzwert für soc_fit" CURVE 0x000C3158 TKL_SW_VV_UW 100.0 Def_f_uw_b100 0.0 99.9984 /begin FUNCTION_LIST PMSOCKOR /end FUNCTION_LIST
 /begin AXIS_DESCR STD_AXIS T_saison Def_t_sw_q0p1 4 -3276.8000 3276.7000 FORMAT "%4.1" /end AXIS_DESCR
 FORMAT "%6.3" /end CHARACTERISTIC
/begin CHARACTERISTIC KL_SSOC "soc_s in Abh. von tsaison" CURVE 0x000C316A TKL_SW_VV_UW 100.0 Def_f_uw_b100 0.0 99.9984 /begin FUNCTION_LIST PMSOCKOR /end FUNCTION_LIST
 /begin AXIS_DESCR STD_AXIS T_saison Def_t_sw_q0p1 4 -3276.8000 3276.7000 FORMAT "%4.1" /end AXIS_DESCR
 FORMAT "%6.3" /end CHARACTERISTIC
/begin CHARACTERISTIC K_TIME_START "Zeittriggerschwelle nach Motorstart" VALUE 0x000C317C TKW_VV_VV_UW 100.0 Def_td_uw_q0p01 0.0 655.3500 /begin FUNCTION_LIST PMSOCSTART /end FUNCTION_LIST FORMAT "%5.2" /end CHARACTERISTIC
/begin CHARACTERISTIC K_UB_GRENZ "Grenzwert Gradient d. Bordnetzspannung" VALUE 0x000C317E TKW_VV_VV_UW 100.0 Def_u_uw_q0p0942 0.0 6173.3970 /begin FUNCTION_LIST PMSOCSTART /end FUNCTION_LIST FORMAT "%4.1" /end CHARACTERISTIC
/begin CHARACTERISTIC K_USTARTGRZ "Spannungsgrenzwert für Startauswertung " VALUE 0x000C3180 TKW_VV_VV_UW 100.0 Def_u_uw_q0p25em3_o6 6.0000 22.3837 /begin FUNCTION_LIST PMSOCSTART /end FUNCTION_LIST FORMAT "%7.4" /end CHARACTERISTIC
/begin CHARACTERISTIC K_RIN_GRENZ1 "Grenzwert Innenwiderstand Batterie1" VALUE 0x000C3182 TKW_VV_VV_UB 100.0 Def_f_ub_b32 0.0 31.8750 /begin FUNCTION_LIST PMSOCSTART /end FUNCTION_LIST /end CHARACTERISTIC
/begin CHARACTERISTIC K_RIN_GRENZ2 "Grenzwert Innenwiderstand Batterie2" VALUE 0x000C3183 TKW_VV_VV_UB 100.0 Def_f_ub_b32 0.0 31.8750 /begin FUNCTION_LIST PMSOCSTART /end FUNCTION_LIST /end CHARACTERISTIC
/begin CHARACTERISTIC K_RIN_GRENZ3 "Grenzwert Innenwiderstand Batterie3" VALUE 0x000C3184 TKW_VV_VV_UB 100.0 Def_f_ub_b32 0.0 31.8750 /begin FUNCTION_LIST PMSOCSTART /end FUNCTION_LIST /end CHARACTERISTIC
/begin CHARACTERISTIC K_RIN_GRENZ4 "Grenzwert Innenwiderstand Batterie4" VALUE 0x000C3185 TKW_VV_VV_UB 100.0 Def_f_ub_b32 0.0 31.8750 /begin FUNCTION_LIST PMSOCSTART /end FUNCTION_LIST /end CHARACTERISTIC
/begin CHARACTERISTIC K_RIN_GRENZ5 "Grenzwert Innenwiderstand Batterie5" VALUE 0x000C3186 TKW_VV_VV_UB 100.0 Def_f_ub_b32 0.0 31.8750 /begin FUNCTION_LIST PMSOCSTART /end FUNCTION_LIST /end CHARACTERISTIC
/begin CHARACTERISTIC K_RIN_GRENZ6 "Grenzwert Innenwiderstand Batterie6" VALUE 0x000C3187 TKW_VV_VV_UB 100.0 Def_f_ub_b32 0.0 31.8750 /begin FUNCTION_LIST PMSOCSTART /end FUNCTION_LIST /end CHARACTERISTIC
/begin CHARACTERISTIC K_RIN_GRENZ7 "Grenzwert Innenwiderstand Batterie7" VALUE 0x000C3188 TKW_VV_VV_UB 100.0 Def_f_ub_b32 0.0 31.8750 /begin FUNCTION_LIST PMSOCSTART /end FUNCTION_LIST /end CHARACTERISTIC
/begin CHARACTERISTIC K_RIN_GRENZ8 "Grenzwert Innenwiderstand Batterie8" VALUE 0x000C3189 TKW_VV_VV_UB 100.0 Def_f_ub_b32 0.0 31.8750 /begin FUNCTION_LIST PMSOCSTART /end FUNCTION_LIST /end CHARACTERISTIC
/begin CHARACTERISTIC S_NKWITNSTRT "0 = Nkw-Auswertung, 1=Itnstart Auswertung" VALUE 0x000C318A TKW_VV_VV_UB 100.0 Identity 0.0 1.0000 /begin FUNCTION_LIST PMSOCSTART /end FUNCTION_LIST /end CHARACTERISTIC
/begin CHARACTERISTIC S_PMSTARTQ "Applikationsschalter f. B_pmstartq" VALUE 0x000C318B TKW_VV_VV_UB 100.0 Def_dez_ub_q1 0.0 255.0000 /begin FUNCTION_LIST PMSOCSTART /end FUNCTION_LIST /end CHARACTERISTIC
/begin CHARACTERISTIC S_PM_TEST1 "Applikationsschalter um die Startberechnung zu erzwingen" VALUE 0x000C318C TKW_VV_VV_UB 100.0 Def_dez_ub_q1 0.0 255.0000 /begin FUNCTION_LIST PMSOCSTART /end FUNCTION_LIST /end CHARACTERISTIC
/begin CHARACTERISTIC S_RIN "Schalter Applikation Innenwiderstandsprüfung" VALUE 0x000C318D TKW_VV_VV_UB 100.0 Def_dez_ub_q1 0.0 255.0000 /begin FUNCTION_LIST PMSOCSTART /end FUNCTION_LIST /end CHARACTERISTIC
/begin CHARACTERISTIC S_STARTAW "Startauswertung fertig" VALUE 0x000C318E TKW_VV_VV_UB 100.0 Def_dez_ub_q1 0.0 255.0000 /begin FUNCTION_LIST PMSOCSTART /end FUNCTION_LIST /end CHARACTERISTIC
/begin CHARACTERISTIC KL_UNSTART "Startspannung abhängig v.Motordrehzahl" CURVE 0x000C3190 TKL_SW_VV_UW 100.0 Def_u_uw_q0p25em3_o6 6.0000 22.3837 /begin FUNCTION_LIST PMSOCSTART /end FUNCTION_LIST /begin AXIS_DESCR STD_AXIS Nnmstart Def_n_sw_q1p0 2 -32768.0000 32767.0000 /end AXIS_DESCR FORMAT "%7.4" /end CHARACTERISTIC
/begin CHARACTERISTIC KL_ITNSTART "Startspannung abh. vom Itnstart" CURVE 0x000C319A TKL_UB_VV_UW 100.0 Def_u_uw_q0p25em3_o6 6.0000 22.3837 /begin FUNCTION_LIST PMSOCSTART /end FUNCTION_LIST /begin AXIS_DESCR STD_AXIS NO_INPUT_QUANTITY Def_i_ub_b1000 4 0.0 996.0937 /end AXIS_DESCR FORMAT "%7.4" /end CHARACTERISTIC
/begin CHARACTERISTIC KL_UTSTART "Startspannung in Abhängigkeit von Temperatur Batterie" CURVE 0x000C31A8 TKL_SW_VV_SW 100.0 Def_u_sw_q0p00025 -8.1920 8.1917 /begin FUNCTION_LIST PMSOCSTART /end FUNCTION_LIST
 /begin AXIS_DESCR STD_AXIS T_batt Def_t_sw_q0p1 3 -3276.8000 3276.7000 FORMAT "%4.1" /end AXIS_DESCR
 FORMAT "%7.4" /end CHARACTERISTIC
/begin CHARACTERISTIC K_IGRDETEC "U_gsoll - U_ibs Max für Freeze" VALUE 0x000C31B6 TKW_VV_VV_SW 100.0 Def_u_sw_b128 -128.0000 127.9960 /begin FUNCTION_LIST PMUGENCALC /end FUNCTION_LIST FORMAT "%6.3" /end CHARACTERISTIC
/begin CHARACTERISTIC K_PMUGEN_MAX "Max zugelassene Generatorspg" VALUE 0x000C31B8 TKW_VV_VV_SW 100.0 Def_u_sw_b128 -128.0000 127.9960 /begin FUNCTION_LIST PMUGENCALC /end FUNCTION_LIST FORMAT "%6.3" /end CHARACTERISTIC
/begin CHARACTERISTIC K_PMUGEN_MIN "Min zugelassene Generatorspg" VALUE 0x000C31BA TKW_VV_VV_SW 100.0 Def_u_sw_b128 -128.0000 127.9960 /begin FUNCTION_LIST PMUGENCALC /end FUNCTION_LIST FORMAT "%6.3" /end CHARACTERISTIC
/begin CHARACTERISTIC K_UGENNORM "Generator Normspannung" VALUE 0x000C31BC TKW_VV_VV_SW 100.0 Def_u_sw_b128 -128.0000 127.9960 /begin FUNCTION_LIST PMUGENCALC /end FUNCTION_LIST FORMAT "%6.3" /end CHARACTERISTIC
/begin CHARACTERISTIC K_UIBSAPP "Manueller Applikationswert von Uibs an UGENKOR" VALUE 0x000C31BE TKW_VV_VV_SW 100.0 Def_u_sw_b128 -128.0000 127.9960 /begin FUNCTION_LIST PMUGENCALC /end FUNCTION_LIST FORMAT "%6.3" /end CHARACTERISTIC
/begin CHARACTERISTIC K_USTEPMIN "Min. Delta zw. Battsollspg und Battspg damit uibs veraendert wird." VALUE 0x000C31C0 TKW_VV_VV_SW 100.0 Def_u_sw_b128 -128.0000 127.9960 /begin FUNCTION_LIST PMUGENCALC /end FUNCTION_LIST FORMAT "%6.3" /end CHARACTERISTIC
/begin CHARACTERISTIC K_PMUBAT_MAX "Max. zugelassene Batteriespg " VALUE 0x000C31C2 TKW_VV_VV_UW 100.0 Def_u_uw_q0p25em3_o6 6.0000 22.3837 /begin FUNCTION_LIST PMUGENCALC /end FUNCTION_LIST FORMAT "%7.4" /end CHARACTERISTIC
/begin CHARACTERISTIC K_PMUBAT_MIN "Min. zugelassene Batteriespg" VALUE 0x000C31C4 TKW_VV_VV_UW 100.0 Def_u_uw_q0p25em3_o6 6.0000 22.3837 /begin FUNCTION_LIST PMUGENCALC /end FUNCTION_LIST FORMAT "%7.4" /end CHARACTERISTIC
/begin CHARACTERISTIC K_DFOVERRIDE "Schwellwert wann Generator als ueberlastet erkannt wird" VALUE 0x000C31C6 TKW_VV_VV_UB 100.0 Def_f_ub_b100 0.0 99.6093 /begin FUNCTION_LIST PMUGENCALC /end FUNCTION_LIST /end CHARACTERISTIC
/begin CHARACTERISTIC K_TD_BNMOT "Zeit nach Motorlauf, wo die stufenweise (USTEPMIN) Berechnung von uibs aktiviert wird." VALUE 0x000C31C7 TKW_VV_VV_UB 100.0 Def_td_ub_q1 0.0 255.0000 /begin FUNCTION_LIST PMUGENCALC /end FUNCTION_LIST /end CHARACTERISTIC
/begin CHARACTERISTIC K_TD_PMUGEN "Taskzeit von PMUGENCALC, = Zeit wo die stufenweise Setzung von uibs berechnet wird." VALUE 0x000C31C8 TKW_VV_VV_UB 100.0 Def_td_ub_q1 0.0 255.0000 /begin FUNCTION_LIST PMUGENCALC /end FUNCTION_LIST /end CHARACTERISTIC
/begin CHARACTERISTIC S_UIBS "Schalter für UIBS, wenn True dann uibs=UIBSAPP" VALUE 0x000C31C9 TKW_VV_VV_UB 100.0 Identity 0.0 1.0000 /begin FUNCTION_LIST PMUGENCALC /end FUNCTION_LIST /end CHARACTERISTIC
/begin CHARACTERISTIC KL_USOLL "Batteriesollspannung aufgrund von tbatt" CURVE 0x000C31CA TKL_SW_VV_UW 100.0 Def_u_uw_q0p25em3_o6 6.0000 22.3837 /begin FUNCTION_LIST PMUGENCALC /end FUNCTION_LIST
 /begin AXIS_DESCR STD_AXIS T_batt Def_t_sw_q0p1 3 -3276.8000 3276.7000 FORMAT "%4.1" /end AXIS_DESCR
 FORMAT "%7.4" /end CHARACTERISTIC
/begin CHARACTERISTIC KF_USOLL "Batteriesollspannung aufgrund der Temperatur und soc." MAP 0x000C31D8 TKF_UW_SW_UW 100.0 Def_u_uw_q0p25em3_o6 6.0000 22.3837 /begin FUNCTION_LIST PMUGENCALC /end FUNCTION_LIST
 /begin AXIS_DESCR STD_AXIS T_batt Def_t_sw_q0p1 3 -3276.8000 3276.7000 FORMAT "%4.1" /end AXIS_DESCR
 /begin AXIS_DESCR STD_AXIS Soc_rel Def_f_uw_b100 3 0.0 99.9984 FORMAT "%6.3" /end AXIS_DESCR
 FORMAT "%7.4" /end CHARACTERISTIC
/begin CHARACTERISTIC K_GENOFFTIME "maximale Generatorauszeit" VALUE 0x000C31FE TKW_VV_VV_UW 100.0 Def_td_uw_q0p1 0.0 6553.5000 /begin FUNCTION_LIST UGENKOR /end FUNCTION_LIST FORMAT "%4.1" /end CHARACTERISTIC
/begin CHARACTERISTIC K_GENUMAX "maximale Generatorspannung" VALUE 0x000C3200 TKW_VV_VV_UW 100.0 Def_u_uw_q0p1 0.0 6553.5000 /begin FUNCTION_LIST UGENKOR /end FUNCTION_LIST FORMAT "%6.3" /end CHARACTERISTIC
/begin CHARACTERISTIC K_GENURAMP "Spannungsinkrement fuer Rampe" VALUE 0x000C3202 TKW_VV_VV_UW 100.0 Def_u_uw_q0p1 0.0 6553.5000 /begin FUNCTION_LIST UGENKOR /end FUNCTION_LIST FORMAT "%6.3" /end CHARACTERISTIC
/begin CHARACTERISTIC K_GENURAMPOF "Spannungsinkrement fuer Rampe, Generator ausschalten" VALUE 0x000C3204 TKW_VV_VV_UW 100.0 Def_u_uw_q0p1 0.0 6553.5000 /begin FUNCTION_LIST UGENKOR /end FUNCTION_LIST FORMAT "%6.3" /end CHARACTERISTIC
/begin CHARACTERISTIC K_GEN_APPUG "Manuelle Generatorspannungsvorgabe" VALUE 0x000C3206 TKW_VV_VV_UW 100.0 Def_u_uw_q0p1 0.0 6553.5000 /begin FUNCTION_LIST UGENKOR /end FUNCTION_LIST FORMAT "%6.3" /end CHARACTERISTIC
/begin CHARACTERISTIC K_PMSA_RST "" VALUE 0x000C3208 TKW_VV_VV_UW 100.0 Def_dez_uw_q1 0.0 65535.0000 /begin FUNCTION_LIST UGENKOR /end FUNCTION_LIST /end CHARACTERISTIC
/begin CHARACTERISTIC K_PMSA_SET "" VALUE 0x000C320A TKW_VV_VV_UW 100.0 Def_dez_uw_q1 0.0 65535.0000 /begin FUNCTION_LIST UGENKOR /end FUNCTION_LIST /end CHARACTERISTIC
/begin CHARACTERISTIC K_T_IGRNACHL "" VALUE 0x000C320C TKW_VV_VV_UW 100.0 Def_td_uw_q0p1 0.0 6553.5000 /begin FUNCTION_LIST UGENKOR /end FUNCTION_LIST FORMAT "%4.1" /end CHARACTERISTIC
/begin CHARACTERISTIC K_UBNS "" VALUE 0x000C320E TKW_VV_VV_UW 100.0 Def_u_uw_q0p1 0.0 6553.5000 /begin FUNCTION_LIST UGENKOR /end FUNCTION_LIST FORMAT "%6.3" /end CHARACTERISTIC
/begin CHARACTERISTIC K_UGENDELTA "" VALUE 0x000C3210 TKW_VV_VV_UW 100.0 Def_u_uw_q0p1 0.0 6553.5000 /begin FUNCTION_LIST UGENKOR /end FUNCTION_LIST FORMAT "%6.3" /end CHARACTERISTIC
/begin CHARACTERISTIC K_UGENMAXE65 "" VALUE 0x000C3212 TKW_VV_VV_UW 100.0 Def_u_uw_q0p1 0.0 6553.5000 /begin FUNCTION_LIST UGENKOR /end FUNCTION_LIST FORMAT "%6.3" /end CHARACTERISTIC
/begin CHARACTERISTIC K_UGENOFF "Generatorauschaltspannung bei vfzg = 0" VALUE 0x000C3214 TKW_VV_VV_UW 100.0 Def_u_uw_q0p1 0.0 6553.5000 /begin FUNCTION_LIST UGENKOR /end FUNCTION_LIST FORMAT "%6.3" /end CHARACTERISTIC
/begin CHARACTERISTIC K_UGENOFFSTA "" VALUE 0x000C3216 TKW_VV_VV_UW 100.0 Def_u_uw_q0p1 0.0 6553.5000 /begin FUNCTION_LIST UGENKOR /end FUNCTION_LIST FORMAT "%6.3" /end CHARACTERISTIC
/begin CHARACTERISTIC K_UGENOFFV0 "Generatorauschaltspannung bei vfzg != 0" VALUE 0x000C3218 TKW_VV_VV_UW 100.0 Def_u_uw_q0p1 0.0 6553.5000 /begin FUNCTION_LIST UGENKOR /end FUNCTION_LIST FORMAT "%6.3" /end CHARACTERISTIC
/begin CHARACTERISTIC K_U_BNMAX "" VALUE 0x000C321A TKW_VV_VV_UW 100.0 Def_u_uw_q0p1 0.0 6553.5000 /begin FUNCTION_LIST UGENKOR /end FUNCTION_LIST FORMAT "%6.3" /end CHARACTERISTIC
/begin CHARACTERISTIC K_U_IGRRAMP "" VALUE 0x000C321C TKW_VV_VV_UW 100.0 Def_u_uw_q0p1 0.0 6553.5000 /begin FUNCTION_LIST UGENKOR /end FUNCTION_LIST FORMAT "%6.3" /end CHARACTERISTIC
/begin CHARACTERISTIC CW_BNSUMAX "Freischatung Berücksichtigung Bordnetzstabilität" VALUE 0x000C321E TKW_VV_VV_UB 100.0 Def_st_ub_q1 0.0 255.0000 /begin FUNCTION_LIST UGENKOR /end FUNCTION_LIST /end CHARACTERISTIC
/begin CHARACTERISTIC CW_GENOFFSLP "Codewort zum Sperren Eingriff Sekundärluftpumpe" VALUE 0x000C321F TKW_VV_VV_UB 100.0 Identity 0.0 1.0000 /begin FUNCTION_LIST UGENKOR /end FUNCTION_LIST /end CHARACTERISTIC
/begin CHARACTERISTIC K_APP_UGEN "Umschaltung auf manuelle Generatorspannungsvorgabe" VALUE 0x000C3220 TKW_VV_VV_UB 100.0 Def_st_ub_q1 0.0 255.0000 /begin FUNCTION_LIST UGENKOR /end FUNCTION_LIST /end CHARACTERISTIC
/begin CHARACTERISTIC K_ENGENTOGGL "Freigabe Generatortoggeln" VALUE 0x000C3221 TKW_VV_VV_UB 100.0 Identity 0.0 1.0000 /begin FUNCTION_LIST UGENKOR /end FUNCTION_LIST /end CHARACTERISTIC
/begin CHARACTERISTIC K_PMSA_DEC "" VALUE 0x000C3222 TKW_VV_VV_UB 100.0 Def_dez_ub_q1 0.0 255.0000 /begin FUNCTION_LIST UGENKOR /end FUNCTION_LIST /end CHARACTERISTIC
/begin CHARACTERISTIC K_PMSA_INC "" VALUE 0x000C3223 TKW_VV_VV_UB 100.0 Def_dez_ub_q1 0.0 255.0000 /begin FUNCTION_LIST UGENKOR /end FUNCTION_LIST /end CHARACTERISTIC
/begin CHARACTERISTIC K_T_VERBON "Verzugszeit Verbraucherzuschaltung nach Aufhebung Genertorreduzierung" VALUE 0x000C3224 TKW_VV_VV_UB 100.0 Def_td_ub_q0p1 0.0 25.5000 /begin FUNCTION_LIST UGENKOR /end FUNCTION_LIST /end CHARACTERISTIC
/begin CHARACTERISTIC S_ENTLENA "Schalter Generatorentlastungsrampe aktivieren" VALUE 0x000C3225 TKW_VV_VV_UB 100.0 Identity 0.0 1.0000 /begin FUNCTION_LIST UGENKOR /end FUNCTION_LIST /end CHARACTERISTIC
/begin CHARACTERISTIC S_GOFFRAMP "Schalter Sprung auf 10,6V unverzoegert" VALUE 0x000C3226 TKW_VV_VV_UB 100.0 Def_st_ub_q1 0.0 255.0000 /begin FUNCTION_LIST UGENKOR /end FUNCTION_LIST /end CHARACTERISTIC
/begin CHARACTERISTIC S_IGRLOW "" VALUE 0x000C3227 TKW_VV_VV_UB 100.0 Identity 0.0 1.0000 /begin FUNCTION_LIST UGENKOR /end FUNCTION_LIST /end CHARACTERISTIC
/begin CHARACTERISTIC S_UGENOFST "" VALUE 0x000C3228 TKW_VV_VV_UB 100.0 Def_dez_ub_q1 0.0 255.0000 /begin FUNCTION_LIST UGENKOR /end FUNCTION_LIST /end CHARACTERISTIC
/begin MEASUREMENT St_pmsoccalc.B_soc_pwf "Uo Kalibrierung durchgeführt" UBYTE Def_bit_ub_1 0 0 0.0 255.0 ECU_ADDRESS 0x007FF059 /begin FUNCTION_LIST PMSOCCALC /end FUNCTION_LIST BIT_MASK 0x2 /end MEASUREMENT
/begin MEASUREMENT St_pmsoccalc.B_soccalc "Uo Kalibrierung durchgeführt" UBYTE Def_bit_ub_2 0 0 0.0 255.0 ECU_ADDRESS 0x007FF059 /begin FUNCTION_LIST PMSOCCALC /end FUNCTION_LIST BIT_MASK 0x4 /end MEASUREMENT
/begin MEASUREMENT St_pmsoccalc "Statuswort" UBYTE Def_st_ub_q1 0 0 0.0 255.0000 ECU_ADDRESS 0x007FF059 /begin FUNCTION_LIST PMSOCCALC /end FUNCTION_LIST /end MEASUREMENT
/begin MEASUREMENT St_pmsocalc1.B_ibspwf_e "Bedingung Powerfail IBS erkannt" UBYTE Def_bit_ub_0 0 0 0.0 255.0 ECU_ADDRESS 0x008015E0 /begin FUNCTION_LIST PMSOCCALC /end FUNCTION_LIST BIT_MASK 0x1 /end MEASUREMENT
/begin MEASUREMENT St_pmsocalc1 "Statuswort" UBYTE Def_st_ub_q1 0 0 0.0 255.0000 ECU_ADDRESS 0x008015E0 /begin FUNCTION_LIST PMSOCCALC /end FUNCTION_LIST /end MEASUREMENT
/begin MEASUREMENT Isoc0loc "Batteriestrom zum Zeitpunkt der Ruhespannungsmessung (lokal)" SWORD Def_i_sw_q0p02 0 0 -655.3600 655.3400 ECU_ADDRESS 0x008015CE /begin FUNCTION_LIST PMSOCCALC /end FUNCTION_LIST /end MEASUREMENT
/begin MEASUREMENT Tsocloc "Batterietemperatur zum Zeitpunkt der Ruhespannungsmessung (lokal)" SWORD Def_t_sw_q0p1 0 0 -3276.8000 3276.7000 ECU_ADDRESS 0x008015D0 /begin FUNCTION_LIST PMSOCCALC /end FUNCTION_LIST /end MEASUREMENT
/begin MEASUREMENT D_qelad "Delta Kapazität entladen" UWORD Def_ql_uw_q0p0182 0 0 0.0 1193.0282 ECU_ADDRESS 0x008015D2 /begin FUNCTION_LIST PMSOCCALC /end FUNCTION_LIST /end MEASUREMENT
/begin MEASUREMENT D_qlad "Delta Kapazität geladen" UWORD Def_ql_uw_q0p0182 0 0 0.0 1193.0282 ECU_ADDRESS 0x008015D4 /begin FUNCTION_LIST PMSOCCALC /end FUNCTION_LIST /end MEASUREMENT
/begin MEASUREMENT Soc_bila "Ladezustand durch Bilanzierung und Ruhespannungsmessung ermittelt" UWORD Def_f_uw_b100 0 0 0.0 99.9984 ECU_ADDRESS 0x008015D6 /begin FUNCTION_LIST PMSOCCALC /end FUNCTION_LIST /end MEASUREMENT
/begin MEASUREMENT Soc_quali "Zähler Genauigkeit Ladeztustandsbestimmung" UWORD Def_ql_uw_q0p0182 0 0 0.0 1193.0282 ECU_ADDRESS 0x008015D8 /begin FUNCTION_LIST PMSOCCALC /end FUNCTION_LIST /end MEASUREMENT
/begin MEASUREMENT Ubatt0 "Aus Wertetripel ausgewählter Ruhespannungswert" UWORD Def_u_uw_q0p25em3_o6 0 0 6.0000 22.3837 ECU_ADDRESS 0x008015DA /begin FUNCTION_LIST PMSOCCALC /end FUNCTION_LIST /end MEASUREMENT
/begin MEASUREMENT Cbatt_lo "Nennkapazität Batterie, lokal" UBYTE Def_ql_ub_q1 0 0 1.0000 255.0000 ECU_ADDRESS 0x008015DC /begin FUNCTION_LIST PMSOCCALC /end FUNCTION_LIST /end MEASUREMENT
/begin MEASUREMENT Ib_commcnt "Zähler Taskaufrufe zwischen periodischer Abfrage qlad und qelad" UBYTE Def_dez_ub_q1 0 0 0.0 255.0000 ECU_ADDRESS 0x008015DD /begin FUNCTION_LIST PMSOCCALC /end FUNCTION_LIST /end MEASUREMENT
/begin MEASUREMENT Ib_commsta "Statemaschine zeiger zur Abfrage qlad und qelad" UBYTE Def_dez_ub_q1 0 0 0.0 255.0000 ECU_ADDRESS 0x008015DE /begin FUNCTION_LIST PMSOCCALC /end FUNCTION_LIST /end MEASUREMENT
/begin MEASUREMENT Kalevcnt "Anzahl der Ruhespannungsmessungen" UBYTE Def_dez_ub_q1 0 0 0.0 255.0000 ECU_ADDRESS 0x008015DF /begin FUNCTION_LIST PMSOCCALC /end FUNCTION_LIST /end MEASUREMENT
/begin MEASUREMENT Q_bila "Kapazität Batterie (long)" ULONG Def_ql_ul_q2p7Em7 0 0 0.0 1193.0464 ECU_ADDRESS 0x008015E4 /begin FUNCTION_LIST PMSOCCALC /end FUNCTION_LIST /end MEASUREMENT
/begin MEASUREMENT Qeladold "Kapazität Entladen vor Abstellen" UWORD Def_ql_uw_q0p0182 0 0 0.0 1193.0282 ECU_ADDRESS 0x008015E8 /begin FUNCTION_LIST PMSOCCALC /end FUNCTION_LIST /end MEASUREMENT
/begin MEASUREMENT Qladold "Kapazität Getladen vor Abstellen" UWORD Def_ql_uw_q0p0182 0 0 0.0 1193.0282 ECU_ADDRESS 0x008015EA /begin FUNCTION_LIST PMSOCCALC /end FUNCTION_LIST /end MEASUREMENT
/begin MEASUREMENT Soc_b_loc "lokal soc_bila f. KFSOCLF" UWORD Def_f_uw_b100 0 0 0.0 99.9984 ECU_ADDRESS 0x008015EC /begin FUNCTION_LIST PMSOCCALC /end FUNCTION_LIST /end MEASUREMENT
/begin MEASUREMENT Soc_q_loc "lokaler Zähler Genauigkeit Ladeztustandsbestimmung" UWORD Def_ql_uw_q0p0182 0 0 0.0 1193.0282 ECU_ADDRESS 0x008015EE /begin FUNCTION_LIST PMSOCCALC /end FUNCTION_LIST /end MEASUREMENT
/begin MEASUREMENT Soc_fit_temp "" UWORD Def_f_uw_b100 0 0 0.0 99.9984 ECU_ADDRESS 0x008015F0 /begin FUNCTION_LIST PMSOCFIT /end FUNCTION_LIST /end MEASUREMENT
/begin MEASUREMENT Ubatts2 "Hilfswert2 Spannung aus Fitberechnung" UWORD Def_u_uw_q0p25em3_o6 0 0 6.0000 16.0000 ECU_ADDRESS 0x008015F2 /begin FUNCTION_LIST PMSOCFIT /end FUNCTION_LIST /end MEASUREMENT
/begin MEASUREMENT Soc_fit "SoC aus der Fitformel" UWORD Def_f_uw_b100 0 0 0.0 99.9984 ECU_ADDRESS 0x008015F4 /begin FUNCTION_LIST PMSOCFIT /end FUNCTION_LIST /end MEASUREMENT
/begin MEASUREMENT St_pmsockor0.B_soc_npl "Bedingung SoC-Wert nicht plausibel" UBYTE Def_bit_ub_0 0 0 0.0 255.0 ECU_ADDRESS 0x007FF05A /begin FUNCTION_LIST PMSOCKOR /end FUNCTION_LIST BIT_MASK 0x1 /end MEASUREMENT
/begin MEASUREMENT St_pmsockor0.B_pm_fit2 "Bedingung Hilfsvariable Fit 2" UBYTE Def_bit_ub_1 0 0 0.0 255.0 ECU_ADDRESS 0x007FF05A /begin FUNCTION_LIST PMSOCKOR /end FUNCTION_LIST BIT_MASK 0x2 /end MEASUREMENT
/begin MEASUREMENT St_pmsockor0.B_pm_fit3 "Bedingung Hilfsvariable Fit 3" UBYTE Def_bit_ub_2 0 0 0.0 255.0 ECU_ADDRESS 0x007FF05A /begin FUNCTION_LIST PMSOCKOR /end FUNCTION_LIST BIT_MASK 0x4 /end MEASUREMENT
/begin MEASUREMENT St_pmsockor0.B_pmsocini "wird beim INIT wahr um den Timer zurückzusetzen" UBYTE Def_bit_ub_3 0 0 0.0 255.0 ECU_ADDRESS 0x007FF05A /begin FUNCTION_LIST PMSOCKOR /end FUNCTION_LIST BIT_MASK 0x8 /end MEASUREMENT
/begin MEASUREMENT St_pmsockor0.B_q_start "Bedingung Startqualität vollständig berechnet" UBYTE Def_bit_ub_4 0 0 0.0 255.0 ECU_ADDRESS 0x007FF05A /begin FUNCTION_LIST PMSOCKOR /end FUNCTION_LIST BIT_MASK 0x10 /end MEASUREMENT
/begin MEASUREMENT St_pmsockor0.B_abschfit "Bedingung Korrektur Startfähigkeitsgrenze durchgeführt" UBYTE Def_bit_ub_5 0 0 0.0 255.0 ECU_ADDRESS 0x007FF05A /begin FUNCTION_LIST PMSOCKOR /end FUNCTION_LIST BIT_MASK 0x20 /end MEASUREMENT
/begin MEASUREMENT St_pmsockor0 "Statuswort" UBYTE Def_st_ub_q1 0 0 0.0 255.0000 ECU_ADDRESS 0x007FF05A /begin FUNCTION_LIST PMSOCKOR /end FUNCTION_LIST /end MEASUREMENT
/begin MEASUREMENT D_socw "Delta SoC" SWORD Def_f_sw_b100 0 0 -100.0000 99.9969 ECU_ADDRESS 0x008015F6 /begin FUNCTION_LIST PMSOCKOR /end FUNCTION_LIST /end MEASUREMENT
/begin MEASUREMENT T_saisonalt "letzter Wert Saisontemperatur" SWORD Def_t_sw_q0p1 0 0 -3276.8000 3276.7000 ECU_ADDRESS 0x008015F8 /begin FUNCTION_LIST PMSOCKOR /end FUNCTION_LIST /end MEASUREMENT
/begin MEASUREMENT Soc_stfgkw "SoC Startfähigkeit" UWORD Def_f_uw_b100 0 0 0.0 99.9984 ECU_ADDRESS 0x008015FA /begin FUNCTION_LIST PMSOCKOR /end FUNCTION_LIST /end MEASUREMENT
/begin MEASUREMENT Absch_korr "Korrekturwert Abschaltung" SWORD Def_f_sw_q0p00153 0 0 -40.0000 40.0000 ECU_ADDRESS 0x00801602 /begin FUNCTION_LIST PMSOCKOR /end FUNCTION_LIST /end MEASUREMENT
/begin MEASUREMENT D_soc "Abstand zur Startfähigkeitsgrenze" SWORD Def_f_sw_b100 0 0 -100.0000 99.9969 ECU_ADDRESS 0x00801604 /begin FUNCTION_LIST PMSOCKOR /end FUNCTION_LIST /end MEASUREMENT
/begin MEASUREMENT Soc_korr "Korrekturwert soc_bila" SWORD Def_f_sw_b100 0 0 -100.0000 99.9969 ECU_ADDRESS 0x00801606 /begin FUNCTION_LIST PMSOCKOR /end FUNCTION_LIST /end MEASUREMENT
/begin MEASUREMENT T_saison "Saison -Temperatur" SWORD Def_t_sw_q0p1 0 0 -3276.8000 3276.7000 ECU_ADDRESS 0x00801608 /begin FUNCTION_LIST PMSOCKOR /end FUNCTION_LIST /end MEASUREMENT
/begin MEASUREMENT Q_startfgk "Abstand zur Startfähigkeitsgrenze" UWORD Def_ql_uw_q0p0182 0 0 0.0 1193.0282 ECU_ADDRESS 0x0080160A /begin FUNCTION_LIST PMSOCKOR /end FUNCTION_LIST /end MEASUREMENT
/begin MEASUREMENT Soc_q_kor "Korrekturwert Genauigkeit Ladezustandsbestimmung" UWORD Def_ql_uw_q0p0182 0 0 0.0 1193.0282 ECU_ADDRESS 0x0080160C /begin FUNCTION_LIST PMSOCKOR /end FUNCTION_LIST /end MEASUREMENT
/begin MEASUREMENT Soc_rel "Relativzähler für Ladezustand SoC" UWORD Def_f_uw_b100 0 0 0.0 99.9984 ECU_ADDRESS 0x0080160E /begin FUNCTION_LIST PMSOCKOR /end FUNCTION_LIST /end MEASUREMENT
/begin MEASUREMENT Soc_stfgk "Startfähigkeitsgrenze" UWORD Def_f_uw_b100 0 0 0.0 99.9984 ECU_ADDRESS 0x00801610 /begin FUNCTION_LIST PMSOCKOR /end FUNCTION_LIST /end MEASUREMENT
/begin MEASUREMENT Pm_tsrdy "Status Berechnung Tsaison" UBYTE Identity 0 0 0.0 1.0000 ECU_ADDRESS 0x00801612 /begin FUNCTION_LIST PMSOCKOR /end FUNCTION_LIST /end MEASUREMENT
/begin MEASUREMENT St_pmsocstart0.B_pmstart7 "Bed. Motorstart für Startauswertung PM" UBYTE Def_bit_ub_0 0 0 0.0 255.0 ECU_ADDRESS 0x007FF060 /begin FUNCTION_LIST PMSOCSTART /end FUNCTION_LIST BIT_MASK 0x1 /end MEASUREMENT
/begin MEASUREMENT St_pmsocstart0.B_resetsta "Bedingung Reset Startauswertung" UBYTE Def_bit_ub_1 0 0 0.0 255.0 ECU_ADDRESS 0x007FF060 /begin FUNCTION_LIST PMSOCSTART /end FUNCTION_LIST BIT_MASK 0x2 /end MEASUREMENT
/begin MEASUREMENT St_pmsocstart0.B_rstdatardy "Motor aus erkannt, Startwerte im IBS bereit zum löschen." UBYTE Def_bit_ub_2 0 0 0.0 255.0 ECU_ADDRESS 0x007FF060 /begin FUNCTION_LIST PMSOCSTART /end FUNCTION_LIST BIT_MASK 0x4 /end MEASUREMENT
/begin MEASUREMENT St_pmsocstart0 "Statuswort" UBYTE Def_st_ub_q1 0 0 0.0 255.0000 ECU_ADDRESS 0x007FF060 /begin FUNCTION_LIST PMSOCSTART /end FUNCTION_LIST /end MEASUREMENT
/begin MEASUREMENT St_pmsocstart_nv0.B_pmstartq "Bedingung Startqualität" UBYTE Def_bit_ub_0 0 0 0.0 255.0 ECU_ADDRESS 0x0080161D /begin FUNCTION_LIST PMSOCSTART /end FUNCTION_LIST BIT_MASK 0x1 /end MEASUREMENT
/begin MEASUREMENT St_pmsocstart_nv0.B_pmsqrdy "kt_ibs.dat" UBYTE Def_bit_ub_1 0 0 0.0 255.0 ECU_ADDRESS 0x0080161D /begin FUNCTION_LIST PMSOCSTART /end FUNCTION_LIST BIT_MASK 0x2 /end MEASUREMENT
/begin MEASUREMENT St_pmsocstart_nv0 "Statuswort" UBYTE Def_st_ub_q1 0 0 0.0 255.0000 ECU_ADDRESS 0x0080161D /begin FUNCTION_LIST PMSOCSTART /end FUNCTION_LIST /end MEASUREMENT
/begin MEASUREMENT U_startausw "U_tnstart - ugrenz" SWORD Def_u_sw_q0p00025 0 0 -8.1920 8.1917 ECU_ADDRESS 0x00801614 /begin FUNCTION_LIST PMSOCSTART /end FUNCTION_LIST /end MEASUREMENT
/begin MEASUREMENT Nnmstart "Motordrehzahl nach Motorstart" SWORD Def_n_sw_q1p0 0 0 -32768.0000 32767.0000 ECU_ADDRESS 0x007FF05C /begin FUNCTION_LIST PMSOCSTART /end FUNCTION_LIST /end MEASUREMENT
/begin MEASUREMENT Ideltaabs "Differenz der Startströme" UWORD Def_i_uw_q0p02 0 0 0.0200 1310.7000 ECU_ADDRESS 0x00801616 /begin FUNCTION_LIST PMSOCSTART /end FUNCTION_LIST /end MEASUREMENT
/begin MEASUREMENT U_grenz "Grenzwert Spannung" UWORD Def_u_uw_q0p25em3_o6 0 0 6.0000 22.3837 ECU_ADDRESS 0x00801618 /begin FUNCTION_LIST PMSOCSTART /end FUNCTION_LIST /end MEASUREMENT
/begin MEASUREMENT Ub_old "letzter Wert Batteriespannung" UWORD Def_u_uw_q0p0942 0 0 0.0 6173.3970 ECU_ADDRESS 0x007FF05E /begin FUNCTION_LIST PMSOCSTART /end FUNCTION_LIST /end MEASUREMENT
/begin MEASUREMENT Pmstartsta "Schalter für Ablaufsteuerung" UBYTE Def_dez_ub_q1 0 0 0.0 255.0000 ECU_ADDRESS 0x0080161A /begin FUNCTION_LIST PMSOCSTART /end FUNCTION_LIST /end MEASUREMENT
/begin MEASUREMENT Rin_grenzh "Batt.Innenwiderstand Grenze" UBYTE Def_f_ub_b32 0 0 0.0 31.8750 ECU_ADDRESS 0x0080161B /begin FUNCTION_LIST PMSOCSTART /end FUNCTION_LIST /end MEASUREMENT
/begin MEASUREMENT Rin_start "Innenwiderstand Batterie beim Start" UBYTE Def_f_ub_b32 0 0 0.0 31.8750 ECU_ADDRESS 0x0080161C /begin FUNCTION_LIST PMSOCSTART /end FUNCTION_LIST /end MEASUREMENT
/begin MEASUREMENT St_pmugencalc.B_genclcon "Wird auf true gesetzt wenn Motor und Generator bereits T_B_NMOT-Sekunden laufen." UBYTE Def_bit_ub_0 0 0 0.0 255.0 ECU_ADDRESS 0x007FF061 /begin FUNCTION_LIST PMUGENCALC /end FUNCTION_LIST BIT_MASK 0x1 /end MEASUREMENT
/begin MEASUREMENT St_pmugencalc "Statuswort" UBYTE Def_st_ub_q1 0 0 0.0 255.0000 ECU_ADDRESS 0x007FF061 /begin FUNCTION_LIST PMUGENCALC /end FUNCTION_LIST /end MEASUREMENT
/begin MEASUREMENT U_ibs "Generatorspannungsvorgabe von IBS" SWORD Def_u_sw_b128 0 0 -128.0000 127.9960 ECU_ADDRESS 0x0080161E /begin FUNCTION_LIST PMUGENCALC /end FUNCTION_LIST /end MEASUREMENT
/begin MEASUREMENT U_igrdetec "U_gsoll - U_ibs für IGRLOW Detektierung" SWORD Def_u_sw_b128 0 0 -128.0000 127.9960 ECU_ADDRESS 0x00801620 /begin FUNCTION_LIST PMUGENCALC /end FUNCTION_LIST /end MEASUREMENT
/begin MEASUREMENT Udelta "Delta zw. Battsollspg und Battspg" SWORD Def_u_sw_q0p00025 0 0 -8.1920 8.1917 ECU_ADDRESS 0x00801622 /begin FUNCTION_LIST PMUGENCALC /end FUNCTION_LIST /end MEASUREMENT
/begin MEASUREMENT Udeltaabs "Absolutwert von udelta" SWORD Def_u_sw_q0p00025 0 0 0.0 8.1917 ECU_ADDRESS 0x00801624 /begin FUNCTION_LIST PMUGENCALC /end FUNCTION_LIST /end MEASUREMENT
/begin MEASUREMENT Uibs7 "lokales uibs" SWORD Def_u_sw_b128 0 0 -128.0000 127.9960 ECU_ADDRESS 0x00801626 /begin FUNCTION_LIST PMUGENCALC /end FUNCTION_LIST /end MEASUREMENT
/begin MEASUREMENT Ubattsoll "Batteriesollspannung aufgrund Batterietemperatur und Batt.-ladezustand. Weitere Nutzung in PMPRSVCALC." UWORD Def_u_uw_q0p25em3_o6 0 0 6.0000 22.3837 ECU_ADDRESS 0x00801628 /begin FUNCTION_LIST PMUGENCALC /end FUNCTION_LIST /end MEASUREMENT
/begin MEASUREMENT Ubattsoll7 "lokales ubattsoll" UWORD Def_u_uw_q0p25em3_o6 0 0 6.0000 22.3837 ECU_ADDRESS 0x0080162A /begin FUNCTION_LIST PMUGENCALC /end FUNCTION_LIST /end MEASUREMENT
/begin MEASUREMENT T_bnmotakt "Zeit nachdem der Motor laeuft, hoert nach T_B_NMOT Sekunden auf." UBYTE Def_td_ub_q1 0 0 0.0 255.0000 ECU_ADDRESS 0x0080162C /begin FUNCTION_LIST PMUGENCALC /end FUNCTION_LIST /end MEASUREMENT
/begin MEASUREMENT T_delta "Zeit, die seit letzem Prozessaufruf verstrichen ist. Dient zur Taskkompatibilitaet." UBYTE Def_td_ub_q1 0 0 0.0 255.0000 ECU_ADDRESS 0x0080162D /begin FUNCTION_LIST PMUGENCALC /end FUNCTION_LIST /end MEASUREMENT
/begin MEASUREMENT St_ugenkor0.B_1stugen "Bedingung ctrgenutar noch nicht gueltig" UBYTE Def_bit_ub_0 0 0 0.0 255.0 ECU_ADDRESS 0x007FD31C /begin FUNCTION_LIST UGENKOR /end FUNCTION_LIST BIT_MASK 0x1 /end MEASUREMENT
/begin MEASUREMENT St_ugenkor0.B_genoffout "Bedingung Abschaltung Generator" UBYTE Def_bit_ub_1 0 0 0.0 255.0 ECU_ADDRESS 0x007FD31C /begin FUNCTION_LIST UGENKOR /end FUNCTION_LIST BIT_MASK 0x2 /end MEASUREMENT
/begin MEASUREMENT St_ugenkor0.B_ugenini "Initialisierung Generatorspannung" UBYTE Def_bit_ub_2 0 0 0.0 255.0 ECU_ADDRESS 0x007FD31C /begin FUNCTION_LIST UGENKOR /end FUNCTION_LIST BIT_MASK 0x4 /end MEASUREMENT
/begin MEASUREMENT St_ugenkor0.B_genoff "Bedingung Generator ausgeschaltet" UBYTE Def_bit_ub_3 0 0 0.0 255.0 ECU_ADDRESS 0x007FD31C /begin FUNCTION_LIST UGENKOR /end FUNCTION_LIST BIT_MASK 0x8 /end MEASUREMENT
/begin MEASUREMENT St_ugenkor0.B_genoff2 "Bedingung Generator2 ausgeschaltet" UBYTE Def_bit_ub_4 0 0 0.0 255.0 ECU_ADDRESS 0x007FD31C /begin FUNCTION_LIST UGENKOR /end FUNCTION_LIST BIT_MASK 0x10 /end MEASUREMENT
/begin MEASUREMENT St_ugenkor0.B_genoffok "Bedingung Generatorabschaltfreigabe Sicherheitstimer" UBYTE Def_bit_ub_5 0 0 0.0 255.0 ECU_ADDRESS 0x007FD31C /begin FUNCTION_LIST UGENKOR /end FUNCTION_LIST BIT_MASK 0x20 /end MEASUREMENT
/begin MEASUREMENT St_ugenkor0.B_noctrgen "Bedingung Ladespannungvorgabe ignoriert" UBYTE Def_bit_ub_6 0 0 0.0 255.0 ECU_ADDRESS 0x007FD31C /begin FUNCTION_LIST UGENKOR /end FUNCTION_LIST BIT_MASK 0x40 /end MEASUREMENT
/begin MEASUREMENT St_ugenkor0.B_verb_off "Bedingung elektr. Verbraucher AUS" UBYTE Def_bit_ub_7 0 0 0.0 255.0 ECU_ADDRESS 0x007FD31C /begin FUNCTION_LIST UGENKOR /end FUNCTION_LIST BIT_MASK 0x80 /end MEASUREMENT
/begin MEASUREMENT St_ugenkor0 "Statuswort" UBYTE Def_st_ub_q1 0 0 0.0 255.0000 ECU_ADDRESS 0x007FD31C /begin FUNCTION_LIST UGENKOR /end FUNCTION_LIST /end MEASUREMENT
/begin MEASUREMENT St_ugenkor2.B_saaktiv "Modulspezifische Bedingung für Schubabschalten" UBYTE Def_bit_ub_0 0 0 0.0 255.0 ECU_ADDRESS 0x0080164A /begin FUNCTION_LIST UGENKOR /end FUNCTION_LIST BIT_MASK 0x1 /end MEASUREMENT
/begin MEASUREMENT St_ugenkor2.B_saset "Freigabe für modulspezifisches Schubabschalten" UBYTE Def_bit_ub_1 0 0 0.0 255.0 ECU_ADDRESS 0x0080164A /begin FUNCTION_LIST UGENKOR /end FUNCTION_LIST BIT_MASK 0x2 /end MEASUREMENT
/begin MEASUREMENT St_ugenkor2 "Statuswort" UBYTE Def_st_ub_q1 0 0 0.0 255.0000 ECU_ADDRESS 0x0080164A /begin FUNCTION_LIST UGENKOR /end FUNCTION_LIST /end MEASUREMENT
/begin MEASUREMENT St_ugenkor1.B_gentoggl "Bedindung Toggel Generatorauswahl" UBYTE Def_bit_ub_0 0 0 0.0 255.0 ECU_ADDRESS 0x0080164B /begin FUNCTION_LIST UGENKOR /end FUNCTION_LIST BIT_MASK 0x1 /end MEASUREMENT
/begin MEASUREMENT St_ugenkor1 "Statuswort" UBYTE Def_st_ub_q1 0 0 0.0 255.0000 ECU_ADDRESS 0x0080164B /begin FUNCTION_LIST UGENKOR /end FUNCTION_LIST /end MEASUREMENT
/begin MEASUREMENT T_batt "Batterietemperatur" SWORD Def_t_sw_q0p1 0 0 -3276.8000 3276.7000 ECU_ADDRESS 0x007FF062 /begin FUNCTION_LIST UGENKOR /end FUNCTION_LIST /end MEASUREMENT
/begin MEASUREMENT U_gen "Sollwert Generatorspannung" UWORD Def_u_uw_q0p1 0 0 0.0 6553.5000 ECU_ADDRESS 0x00801634 /begin FUNCTION_LIST UGENKOR /end FUNCTION_LIST /end MEASUREMENT
/begin MEASUREMENT U_gen2 "Generatosspannungssollwert für Generator2" UWORD Def_u_uw_q0p1 0 0 0.0 16.0000 ECU_ADDRESS 0x00801636 /begin FUNCTION_LIST UGENKOR /end FUNCTION_LIST /end MEASUREMENT
/begin MEASUREMENT U_gsoll "Generatorsollspannung Basis" UWORD Def_u_uw_q0p1 0 0 0.0 6553.5000 ECU_ADDRESS 0x00801638 /begin FUNCTION_LIST UGENKOR /end FUNCTION_LIST /end MEASUREMENT
/begin MEASUREMENT U_gsoll_off "Generatorsollspannung Basis" UWORD Def_u_uw_q0p1 0 0 0.0 6553.5000 ECU_ADDRESS 0x0080163A /begin FUNCTION_LIST UGENKOR /end FUNCTION_LIST /end MEASUREMENT
/begin MEASUREMENT U_gsoll_tp "Generatorsollspannung Basis" UWORD Def_u_uw_q0p1 0 0 0.0 6553.5000 ECU_ADDRESS 0x0080163C /begin FUNCTION_LIST UGENKOR /end FUNCTION_LIST /end MEASUREMENT
/begin MEASUREMENT U_gsoll_tp3 "Generatorsollspannung Basis 3" UWORD Def_u_uw_q0p1 0 0 0.0 6553.5000 ECU_ADDRESS 0x0080163E /begin FUNCTION_LIST UGENKOR /end FUNCTION_LIST /end MEASUREMENT
/begin MEASUREMENT Pmigrlowctr "" UWORD Def_dez_uw_q1 0 0 0.0 65535.0000 ECU_ADDRESS 0x00801640 /begin FUNCTION_LIST UGENKOR /end FUNCTION_LIST /end MEASUREMENT
/begin MEASUREMENT U_gen_igr "" UWORD Def_u_uw_q0p1 0 0 0.0 6553.5000 ECU_ADDRESS 0x00801642 /begin FUNCTION_LIST UGENKOR /end FUNCTION_LIST /end MEASUREMENT
/begin MEASUREMENT U_gsoll_tp2 "Generatorsollspannung Basis" UWORD Def_u_uw_q0p1 0 0 0.0 6553.5000 ECU_ADDRESS 0x00801644 /begin FUNCTION_LIST UGENKOR /end FUNCTION_LIST /end MEASUREMENT
/begin MEASUREMENT U_gsollred "reduzierte Generatorsollspannung" UWORD Def_u_uw_q0p1 0 0 0.0 6553.5000 ECU_ADDRESS 0x00801646 /begin FUNCTION_LIST UGENKOR /end FUNCTION_LIST /end MEASUREMENT
/begin MEASUREMENT U_gsolltmp "reduzierte Zwischengeneratorsollspannung" UWORD Def_u_uw_q0p1 0 0 0.0 6553.5000 ECU_ADDRESS 0x00801648 /begin FUNCTION_LIST UGENKOR /end FUNCTION_LIST /end MEASUREMENT
/begin FUNCTION PMSOCCALC "PMSOCCALC" /end FUNCTION
/begin FUNCTION PMSOCFIT "PMSOCFIT" /end FUNCTION
/begin FUNCTION PMSOCKOR "PMSOCKOR" /end FUNCTION
/begin FUNCTION PMSOCSTART "PMSOCSTART" /end FUNCTION
/begin FUNCTION PMUGENCALC "PMUGENCALC" /end FUNCTION
/begin FUNCTION UGENKOR "UGENKOR" /end FUNCTION
/begin COMPU_METHOD Def_t_sw_q0p1 "Def_t_sw_q0p1" RAT_FUNC "%6.1" "°C" COEFFS 0 10 0 0 0 1 /end COMPU_METHOD
/begin COMPU_METHOD Def_u_uw_q0p0942 "Def_u_uw_q0p0942" RAT_FUNC "%6.1" "V" COEFFS 0 1 0 0 0 0.0942 /end COMPU_METHOD
/begin COMPU_METHOD Def_f_ub_b8 "Def_f_ub_b8" RAT_FUNC "%5.2" "-" COEFFS 0 256 0 0 0 8 /end COMPU_METHOD
/begin COMPU_METHOD Def_bit_ub_0 "Def_bit_ub_0" TAB_VERB "%5.2" "-" COMPU_TAB_REF Def_bit_ub_0_VTAB /end COMPU_METHOD
/begin COMPU_METHOD Def_st_ub_q1 "Def_st_ub_q1" RAT_FUNC "%3.0" "-" COEFFS 0 1 0 0 0 1 /end COMPU_METHOD
/begin COMPU_METHOD Def_n_sw_q1p0 "Def_n_sw_q1p0" RAT_FUNC "%5.0" "Upm" COEFFS 0 1 0 0 0 1 /end COMPU_METHOD
/begin COMPU_METHOD Def_f_ub_b100 "Def_f_ub_b100" RAT_FUNC "%5.2" "%" COEFFS 0 256 0 0 0 100 /end COMPU_METHOD
/begin COMPU_METHOD Def_td_ub_q0p1 "Def_td_ub_q0p1" RAT_FUNC "%4.1" "s" COEFFS 0 10 0 0 0 1 /end COMPU_METHOD
/begin COMPU_METHOD Def_dez_uw_q1 "Def_dez_uw_q1" RAT_FUNC "%5.0" "-" COEFFS 0 1 0 0 0 1 /end COMPU_METHOD
/begin COMPU_METHOD Def_dez_ub_q1 "Def_dez_ub_q1" RAT_FUNC "%3.0" "-" COEFFS 0 1 0 0 0 1 /end COMPU_METHOD
/begin COMPU_METHOD Def_bit_ub_1 "Def_bit_ub_1" TAB_VERB "%5.2" "-" COMPU_TAB_REF Def_bit_ub_1_VTAB /end COMPU_METHOD
/begin COMPU_METHOD Def_bit_ub_2 "Def_bit_ub_2" TAB_VERB "%5.2" "-" COMPU_TAB_REF Def_bit_ub_2_VTAB /end COMPU_METHOD
/begin COMPU_METHOD Def_bit_ub_3 "Def_bit_ub_3" TAB_VERB "%5.2" "-" COMPU_TAB_REF Def_bit_ub_3_VTAB /end COMPU_METHOD
/begin COMPU_METHOD Def_bit_ub_4 "Def_bit_ub_4" TAB_VERB "%5.2" "-" COMPU_TAB_REF Def_bit_ub_4_VTAB /end COMPU_METHOD
/begin COMPU_METHOD Def_bit_ub_5 "Def_bit_ub_5" TAB_VERB "%5.2" "-" COMPU_TAB_REF Def_bit_ub_5_VTAB /end COMPU_METHOD
/begin COMPU_METHOD Def_bit_ub_6 "Def_bit_ub_6" TAB_VERB "%5.2" "-" COMPU_TAB_REF Def_bit_ub_6_VTAB /end COMPU_METHOD
/begin COMPU_METHOD Def_bit_ub_7 "Def_bit_ub_7" TAB_VERB "%5.2" "-" COMPU_TAB_REF Def_bit_ub_7_VTAB /end COMPU_METHOD
/begin COMPU_METHOD Def_st_uw_q1 "Def_st_uw_q1" RAT_FUNC "%5.0" "-" COEFFS 0 1 0 0 0 1 /end COMPU_METHOD
/begin COMPU_METHOD Def_td_uw_q0p1 "Def_td_uw_q0p1" RAT_FUNC "%6.1" "s" COEFFS 0 10 0 0 0 1 /end COMPU_METHOD
/begin COMPU_METHOD Identity "Identity" RAT_FUNC "%4.1" "-" COEFFS 0 1 0 0 0 1 /end COMPU_METHOD
/begin COMPU_METHOD Def_f_uw_b100 "Def_f_uw_b100" RAT_FUNC "%8.3" "%" COEFFS 0 65536 0 0 0 100 /end COMPU_METHOD
/begin COMPU_METHOD Def_f_ub_b4 "Def_f_ub_b4" RAT_FUNC "%5.2" "-" COEFFS 0 256 0 0 0 4 /end COMPU_METHOD
/begin COMPU_METHOD Def_u_uw_q0p1 "Def_u_uw_q0p1" RAT_FUNC "%8.3" "V" COEFFS 0 10 0 0 0 1 /end COMPU_METHOD
/begin COMPU_METHOD Def_f_uw_b1 "Def_f_uw_b1" RAT_FUNC "%14.5" "-" COEFFS 0 65536 0 0 0 1 /end COMPU_METHOD
/begin COMPU_METHOD Def_td_ub_q1 "Def_td_ub_q1" RAT_FUNC "%5.2" "s" COEFFS 0 1 0 0 0 1 /end COMPU_METHOD
/begin COMPU_METHOD Def_f_ub_b2 "Def_f_ub_b2" RAT_FUNC "%6.3" "-" COEFFS 0 256 0 0 0 2 /end COMPU_METHOD
/begin COMPU_METHOD Def_i_uw_q0p08_o200 "Def_i_uw_q0p08_o200" RAT_FUNC "%8.3" "" COEFFS 0 25 5000 0 0 2 /end COMPU_METHOD
/begin COMPU_METHOD Def_u_uw_q0p25em3_o6 "Def_u_uw_q0p25em3_o6" RAT_FUNC "%9.4" "" COEFFS 0 -4000 24000 0 0 -1 /end COMPU_METHOD
/begin COMPU_METHOD Def_ql_uw_q0p0182 "Def_ql_uw_q0p0182" RAT_FUNC "%8.3" "Ah" COEFFS 0 989 0 0 0 18 /end COMPU_METHOD
/begin COMPU_METHOD Def_i_sw_q0p02 "Def_i_sw_q0p02" RAT_FUNC "%8.3" "A" COEFFS 0 50 0 0 0 1 /end COMPU_METHOD
/begin COMPU_METHOD Def_i_uw_q0p02 "Def_i_uw_q0p02" RAT_FUNC "%8.3" "A" COEFFS 0 1 0 0 0 0.02 /end COMPU_METHOD
/begin COMPU_METHOD Def_td_uw_q0p01 "Def_td_uw_q0p01" RAT_FUNC "%7.2" "s" COEFFS 0 100 0 0 0 1 /end COMPU_METHOD
/begin COMPU_METHOD Def_u_sw_b128 "Def_u_sw_b128" RAT_FUNC "%8.3" "V" COEFFS 0 256 0 0 0 1 /end COMPU_METHOD
/begin COMPU_METHOD Def_f_ub_b32 "Def_f_ub_b32" RAT_FUNC "%5.2" "-" COEFFS 0 256 0 0 0 32 /end COMPU_METHOD
/begin COMPU_METHOD Def_f_sw_b100 "Def_f_sw_b100" RAT_FUNC "%8.3" "-" COEFFS 0 32768 0 0 0 100 /end COMPU_METHOD
/begin COMPU_METHOD Def_td_uw_q1 "Def_td_uw_q1" RAT_FUNC "%5.0" "s" COEFFS 0 1 0 0 0 1 /end COMPU_METHOD
/begin COMPU_METHOD Def_ql_ub_q1 "Def_ql_ub_q1" RAT_FUNC "%4.1" "" COEFFS 0 1 0 0 0 1 /end COMPU_METHOD
/begin COMPU_METHOD Def_f_sw_q0p00153 "Def_f_sw_q0p00153" RAT_FUNC "%8.3" "-" COEFFS 0 32768 0 0 0 50 /end COMPU_METHOD
/begin COMPU_METHOD Def_u_sw_q0p00025 "Def_u_sw_q0p00025" RAT_FUNC "%9.4" "" COEFFS 0 4000 0 0 0 1 /end COMPU_METHOD
/begin COMPU_METHOD Def_ql_ul_q2p7Em7 "Def_ql_ul_q2p7Em7" RAT_FUNC "%11.4" "Ah" COEFFS 0 3600000 0 0 0 1 /end COMPU_METHOD
/begin COMPU_METHOD Def_f_ub_q0p001 "Def_f_ub_q0p001" RAT_FUNC "%6.3" "" COEFFS 0 1000 0 0 0 1 /end COMPU_METHOD
/begin COMPU_METHOD Def_i_ub_b1000 "Def_i_ub_b1000" RAT_FUNC "%6.3" "A" COEFFS 0 256 0 0 0 1000 /end COMPU_METHOD
/begin COMPU_VTAB Def_bit_ub_0_VTAB "Def_bit_ub_0_VTAB" TAB_VERB 2 0 "FALSE" 1 "TRUE" /end COMPU_VTAB
/begin COMPU_VTAB Def_bit_ub_1_VTAB "Def_bit_ub_1_VTAB" TAB_VERB 2 0 "FALSE" 1 "TRUE" /end COMPU_VTAB
/begin COMPU_VTAB Def_bit_ub_2_VTAB "Def_bit_ub_2_VTAB" TAB_VERB 2 0 "FALSE" 1 "TRUE" /end COMPU_VTAB
/begin COMPU_VTAB Def_bit_ub_3_VTAB "Def_bit_ub_3_VTAB" TAB_VERB 2 0 "FALSE" 1 "TRUE" /end COMPU_VTAB
/begin COMPU_VTAB Def_bit_ub_4_VTAB "Def_bit_ub_4_VTAB" TAB_VERB 2 0 "FALSE" 1 "TRUE" /end COMPU_VTAB
/begin COMPU_VTAB Def_bit_ub_5_VTAB "Def_bit_ub_5_VTAB" TAB_VERB 2 0 "FALSE" 1 "TRUE" /end COMPU_VTAB
/begin COMPU_VTAB Def_bit_ub_6_VTAB "Def_bit_ub_6_VTAB" TAB_VERB 2 0 "FALSE" 1 "TRUE" /end COMPU_VTAB
/begin COMPU_VTAB Def_bit_ub_7_VTAB "Def_bit_ub_7_VTAB" TAB_VERB 2 0 "FALSE" 1 "TRUE" /end COMPU_VTAB
/begin COMPU_METHOD default "" RAT_FUNC "%6.2" "-" COEFFS 0 1 0 0 0 1 /end COMPU_METHOD
/begin RECORD_LAYOUT TKW_VV_VV_UW FNC_VALUES 1 UWORD COLUMN_DIR DIRECT /end RECORD_LAYOUT
/begin RECORD_LAYOUT TKW_VV_VV_SW FNC_VALUES 1 SWORD COLUMN_DIR DIRECT /end RECORD_LAYOUT
/begin RECORD_LAYOUT TKL_UW_VV_UW NO_AXIS_PTS_X 1 UBYTE RESERVED 2 BYTE AXIS_PTS_X 3 UWORD INDEX_INCR DIRECT FNC_VALUES 4 UWORD COLUMN_DIR DIRECT /end RECORD_LAYOUT
/begin RECORD_LAYOUT TKL_SW_VV_UW NO_AXIS_PTS_X 1 UBYTE RESERVED 2 BYTE AXIS_PTS_X 3 SWORD INDEX_INCR DIRECT FNC_VALUES 4 UWORD COLUMN_DIR DIRECT /end RECORD_LAYOUT
/begin RECORD_LAYOUT TKW_VV_VV_UB FNC_VALUES 1 UBYTE COLUMN_DIR DIRECT /end RECORD_LAYOUT
/begin RECORD_LAYOUT TKL_SW_VV_UB NO_AXIS_PTS_X 1 UBYTE RESERVED 2 BYTE AXIS_PTS_X 3 SWORD INDEX_INCR DIRECT FNC_VALUES 4 UBYTE COLUMN_DIR DIRECT /end RECORD_LAYOUT
/begin RECORD_LAYOUT TKL_SW_VV_SW NO_AXIS_PTS_X 1 UBYTE RESERVED 2 BYTE AXIS_PTS_X 3 SWORD INDEX_INCR DIRECT FNC_VALUES 4 SWORD COLUMN_DIR DIRECT /end RECORD_LAYOUT
/begin RECORD_LAYOUT TKF_UW_SW_UB NO_AXIS_PTS_X 1 UBYTE NO_AXIS_PTS_Y 2 UBYTE AXIS_PTS_X 3 SWORD INDEX_INCR DIRECT AXIS_PTS_Y 4 UWORD INDEX_INCR DIRECT FNC_VALUES 5 UBYTE COLUMN_DIR DIRECT /end RECORD_LAYOUT
/begin RECORD_LAYOUT TKF_SW_UW_UW NO_AXIS_PTS_X 1 UBYTE NO_AXIS_PTS_Y 2 UBYTE AXIS_PTS_X 3 UWORD INDEX_INCR DIRECT AXIS_PTS_Y 4 SWORD INDEX_INCR DIRECT FNC_VALUES 5 UWORD COLUMN_DIR DIRECT /end RECORD_LAYOUT
/begin RECORD_LAYOUT TKL_UB_VV_UW NO_AXIS_PTS_X 1 UBYTE RESERVED 2 BYTE AXIS_PTS_X 3 UBYTE INDEX_INCR DIRECT FNC_VALUES 4 UWORD COLUMN_DIR DIRECT /end RECORD_LAYOUT
/begin RECORD_LAYOUT TKF_UW_SW_UW NO_AXIS_PTS_X 1 UBYTE NO_AXIS_PTS_Y 2 UBYTE AXIS_PTS_X 3 SWORD INDEX_INCR DIRECT AXIS_PTS_Y 4 UWORD INDEX_INCR DIRECT FNC_VALUES 5 UWORD COLUMN_DIR DIRECT /end RECORD_LAYOUT
/end MODULE
/end PROJECT
