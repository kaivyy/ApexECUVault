ASAP2_VERSION 1 31
/begin PROJECT MS45 "BMW Motorsteuerung R6"
/begin HEADER "_default_HeaderComment" PROJECT_NO _56 /end HEADER
/begin MODULE _default_ModuleName "_default_ModuleLongIdentifier"
/begin MOD_COMMON "_default_ModCommonComment" DEPOSIT ABSOLUTE BYTE_ORDER MSB_FIRST ALIGNMENT_BYTE 1 ALIGNMENT_WORD 2 ALIGNMENT_LONG 4 ALIGNMENT_FLOAT32_IEEE 4 ALIGNMENT_FLOAT64_IEEE 8 /end MOD_COMMON
/begin MEASUREMENT lv_err_bn_msw "Present error BN2000" UBYTE _CNV_S_2_RANGE______2_R_CM 1 100. 0. 255. DISPLAY_IDENTIFIER LV_ERR_BN_MSW ECU_ADDRESS 0x3fbb04 /end MEASUREMENT
/begin CHARACTERISTIC c_amp_hys "maximum value between two acquired ambient pressure values" VALUE 0x0147e _REC_VAL_20_u2 5434. _CNV_A_R_LINEAR_____49_CM 0. 5434. DISPLAY_IDENTIFIER C_AMP_HYS FORMAT "%7.2" /end CHARACTERISTIC
/begin CHARACTERISTIC ip_amp_raw_cor__vs "correlation table for the linearization of the ambient pressure with the vehicle speed" CURVE 0x08b20 _REC_CUR_20_u2_u1 5434. _CNV_A_R_LINEAR_____49_CM 0. 5434. DISPLAY_IDENTIFIER IP_AMP_RAW_COR__VS FORMAT "%7.2"
 /begin AXIS_DESCR COM_AXIS vs _CNV_A_R_LINEAR_____23_CM 8 0. 255. FORMAT "%3.0" AXIS_PTS_REF ldp_vs__amp_raw_cor /end AXIS_DESCR
/end CHARACTERISTIC
/begin MEASUREMENT amp_mes "valid ambient pressure" UWORD _CNV_A_R_LINEAR_____49_CM 1 100. 0. 5434. DISPLAY_IDENTIFIER AMP_MES ECU_ADDRESS 0x3fd352 BYTE_ORDER MSB_LAST FORMAT "%7.2" /end MEASUREMENT
/begin CHARACTERISTIC c_amp_crlc "correlation value for the compensation of the noise signal of the ambient pressure signal" VALUE 0x005e0 _REC_VAL_20_u1 0.9960940000000002 _CNV_A_R_LINEAR_____50_CM 0. 0.996094 DISPLAY_IDENTIFIER C_AMP_CRLC FORMAT "%5.3" /end CHARACTERISTIC
/begin CHARACTERISTIC c_fac_amp_min "BOT for FAC_AMP" VALUE 0x0155e _REC_VAL_20_u2 1.99996948 _CNV_A_R_LINEAR_____21_CM 0. 1.99996948 DISPLAY_IDENTIFIER C_FAC_AMP_MIN FORMAT "%7.5" /end CHARACTERISTIC
/begin CHARACTERISTIC c_fac_amp_max "TOP for FAC_AMP" VALUE 0x0155c _REC_VAL_20_u2 1.99996948 _CNV_A_R_LINEAR_____21_CM 0. 1.99996948 DISPLAY_IDENTIFIER C_FAC_AMP_MAX FORMAT "%7.5" /end CHARACTERISTIC
/begin MEASUREMENT fac_amp "factor of the ambient pressure related to the reference ambient pressure" UWORD _CNV_A_R_LINEAR_____21_CM 1 100. 0. 1.99996948 DISPLAY_IDENTIFIER FAC_AMP ECU_ADDRESS 0x3fd354 BYTE_ORDER MSB_LAST FORMAT "%7.5" /end MEASUREMENT
/begin AXIS_PTS ldp_vs__amp_raw_cor "" 0x07ef6 vs _REC_AXS_20_u1 255. _CNV_A_R_LINEAR_____23_CM 8 0. 255. DISPLAY_IDENTIFIER LDP_VS__AMP_RAW_COR FORMAT "%3.0" /end AXIS_PTS
/begin AXIS_PTS ldp_v_amp_1__amp_raw "" 0x1143a v_amp _REC_AXS_20_u2 4.99511719 _CNV_A_R_LINEAR_____3_CM 8 0. 4.99511719 DISPLAY_IDENTIFIER LDP_V_AMP_1__AMP_RAW FORMAT "%5.3" /end AXIS_PTS
/begin AXIS_PTS ldp_v_amp_2__amp_raw "" 0x1144c v_amp _REC_AXS_20_u2 4.99511719 _CNV_A_R_LINEAR_____3_CM 8 0. 4.99511719 DISPLAY_IDENTIFIER LDP_V_AMP_2__AMP_RAW FORMAT "%5.3" /end AXIS_PTS
/begin CHARACTERISTIC ip_amp_raw_2__v_amp "correlation table for the linearization of the ambient pressure value acquisition with Infineon sensor" CURVE 0x08b10 _REC_CUR_20_u2_u2 5434. _CNV_A_R_LINEAR_____49_CM 0. 5434. DISPLAY_IDENTIFIER IP_AMP_RAW_2 FORMAT "%7.2"
 /begin AXIS_DESCR COM_AXIS v_amp _CNV_A_R_LINEAR_____3_CM 8 0. 4.99511719 FORMAT "%5.3" AXIS_PTS_REF ldp_v_amp_2__amp_raw /end AXIS_DESCR
/end CHARACTERISTIC
/begin CHARACTERISTIC ip_amp_raw_1__v_amp "correlation table for the linearization of the ambient pressure value acquisition with Motorola sensor" CURVE 0x08b00 _REC_CUR_20_u2_u2 5434. _CNV_A_R_LINEAR_____49_CM 0. 5434. DISPLAY_IDENTIFIER IP_AMP_RAW_1 FORMAT "%7.2"
 /begin AXIS_DESCR COM_AXIS v_amp _CNV_A_R_LINEAR_____3_CM 8 0. 4.99511719 FORMAT "%5.3" AXIS_PTS_REF ldp_v_amp_1__amp_raw /end AXIS_DESCR
/end CHARACTERISTIC
/begin MEASUREMENT tq_loss_ars_av_can "torque loss actual value ARS from CAN" SWORD _CNV_A_R_LINEAR_____55_CM 1 100. -1024. 1023.96875 DISPLAY_IDENTIFIER TQ_LOSS_ARS_AV_CAN ECU_ADDRESS 0x3fcdb8 BYTE_ORDER MSB_LAST FORMAT "%8.2" /end MEASUREMENT
/begin MEASUREMENT tq_loss_ars_sp_can "torque loss setpoint ARS from CAN" SWORD _CNV_A_R_LINEAR_____55_CM 1 100. -1024. 1023.96875 DISPLAY_IDENTIFIER TQ_LOSS_ARS_SP_CAN ECU_ADDRESS 0x3fcdba BYTE_ORDER MSB_LAST FORMAT "%8.2" /end MEASUREMENT
/begin MEASUREMENT veh_key_nr "vehicle key number" UBYTE _CNV_A_R_LINEAR_____1_CM 1 100. 0. 15. DISPLAY_IDENTIFIER VEH_KEY_NR ECU_ADDRESS 0x3fdbd4 FORMAT "%2.0" /end MEASUREMENT
/begin MEASUREMENT state_ars_can "status anti roll stabilization via CAN" UBYTE _CNV_S_3_STATE_ARS__56_CM 1 100. 0. 3. DISPLAY_IDENTIFIER STATE_ARS_CAN ECU_ADDRESS 0x3fdba4 /end MEASUREMENT
/begin MEASUREMENT state_igk_can "status ignition key via CAN" UBYTE _CNV_S_3_STATE_IGK__57_CM 1 100. 0. 2. DISPLAY_IDENTIFIER STATE_IGK_CAN ECU_ADDRESS 0x3fdba5 /end MEASUREMENT
/begin MEASUREMENT lv_tcs_lih_can "logical variable traction control system limp home" UBYTE _CNV_S_2_RANGE______0_CM 1 100. 0. 1. DISPLAY_IDENTIFIER LV_TCS_LIH_CAN ECU_ADDRESS 0x3fdbc1 /end MEASUREMENT
/begin MEASUREMENT state_tcs_intv "status traction control system via CAN" UBYTE _CNV_S_4_STATE_TCS__58_CM 1 100. 0. 3. DISPLAY_IDENTIFIER STATE_TCS_INTV ECU_ADDRESS 0x3fdba7 /end MEASUREMENT
/begin MEASUREMENT state_wal_can "logical variable fuel reserve" UBYTE _CNV_S_3_STATE_WAL__59_CM 1 100. 0. 3. DISPLAY_IDENTIFIER STATE_WAL_CAN ECU_ADDRESS 0x3fdbf0 /end MEASUREMENT
/begin MEASUREMENT t_ctr_rel_can "relative time counter (reseted at Kl. 30 OFF)" ULONG _CNV_A_R_LINEAR_____30_CM 1 100. 0. 4294967294. DISPLAY_IDENTIFIER T_CTR_REL_CAN ECU_ADDRESS 0x3fbe8c BYTE_ORDER MSB_LAST FORMAT "%11.0" /end MEASUREMENT
/begin MEASUREMENT v_sp_gen "target generator voltage " UBYTE _CNV_A_R_LINEAR_____60_CM 1 100. 0. 26. DISPLAY_IDENTIFIER V_SP_GEN ECU_ADDRESS 0x3fdbf4 FORMAT "%4.1" /end MEASUREMENT
/begin MEASUREMENT t_can "day counter absolute (counts the days at sufficient mains voltage )" UWORD _CNV_A_R_LINEAR_____61_CM 1 100. 0. 65534. DISPLAY_IDENTIFIER T_CAN ECU_ADDRESS 0x3fcdd0 BYTE_ORDER MSB_LAST FORMAT "%5.0" /end MEASUREMENT
/begin MEASUREMENT state_tcs_ctl "status closed looped control via CAN" UBYTE _CNV_S_9_STATE_TCS__62_CM 1 100. 0. 255. DISPLAY_IDENTIFIER STATE_TCS_CTL ECU_ADDRESS 0x3fdba8 /end MEASUREMENT
/begin MEASUREMENT state_tcs_dece "status closed loop control via CAN" UBYTE _CNV_S_5_STATE_TCS__63_CM 1 100. 0. 15. DISPLAY_IDENTIFIER STATE_TCS_DECE ECU_ADDRESS 0x3fdba9 /end MEASUREMENT
/begin MEASUREMENT ac_veh_lgt_tcs "vehicle acceleration (longitudinal) TCS" SWORD _CNV_A_R_LINEAR_____64_CM 1 100. -51.175 51.175 DISPLAY_IDENTIFIER AC_VEH_LGT_TCS ECU_ADDRESS 0x3fcdc0 BYTE_ORDER MSB_LAST FORMAT "%8.3" /end MEASUREMENT
/begin MEASUREMENT ac_veh_trv_tcs "vehicle acceleration (transversal) TCS" SWORD _CNV_A_R_LINEAR_____64_CM 1 100. -51.175 51.175 DISPLAY_IDENTIFIER AC_VEH_TRV_TCS ECU_ADDRESS 0x3fcdc2 BYTE_ORDER MSB_LAST FORMAT "%8.3" /end MEASUREMENT
/begin MEASUREMENT state_mod_gb "State mode gearbox : SSC (Sleeping Starter Clutch), SBC (Stand By Control)" UBYTE _CNV_S_5_STATE_MOD__65_CM 1 100. 0. 7. DISPLAY_IDENTIFIER STATE_MOD_GB ECU_ADDRESS 0x3fdbae /end MEASUREMENT
/begin MEASUREMENT state_tcs_can "status traction control system via CAN" UBYTE _CNV_S_6_STATE_TCS__66_CM 1 100. 0. 7. DISPLAY_IDENTIFIER STATE_TCS_CAN ECU_ADDRESS 0x3fdbdd /end MEASUREMENT
/begin MEASUREMENT state_temp_gb "State overtemperature gearbox  (AT)- request for cooling (overheating protection) via ECT" UBYTE _CNV_S_4_STATE_TEMP_67_CM 1 100. 0. 3. DISPLAY_IDENTIFIER STATE_TEMP_GB ECU_ADDRESS 0x3fdbac /end MEASUREMENT
/begin MEASUREMENT temp_gb "Temperature gearbox (AT) - request for cooling (overheating protection) via ECF" UBYTE _CNV_A_R_LINEAR_____15_CM 1 100. -40. 215. DISPLAY_IDENTIFIER TEMP_GB ECU_ADDRESS 0x3fdbad FORMAT "%3.0" /end MEASUREMENT
/begin CHARACTERISTIC c_temp_gb_sub "Default temperature for automatic gearbox in case of error TEMP_GB" VALUE 0x008b7 _REC_VAL_20_u1 255. _CNV_A_R_LINEAR_____15_CM -40. 215. DISPLAY_IDENTIFIER C_TEMP_GB_SUB FORMAT "%3.0" /end CHARACTERISTIC
/begin MEASUREMENT vs_icl_disp "displayed vehicle speed (speedometer)" UWORD _CNV_A_R_LINEAR_____68_CM 1 100. 0. 409.4 DISPLAY_IDENTIFIER VS_ICL_DISP ECU_ADDRESS 0x3fcdcc BYTE_ORDER MSB_LAST FORMAT "%5.1" /end MEASUREMENT
/begin MEASUREMENT lv_dcc_lih_can "LV indicating DCC intervention limp home" UBYTE _CNV_S_2_RANGE______0_CM 1 100. 0. 1. DISPLAY_IDENTIFIER LV_DCC_LIH_CAN ECU_ADDRESS 0x3fdbbc /end MEASUREMENT
/begin MEASUREMENT lv_dcc_puc_inh "inhibitation of PUC required by DCC" UBYTE _CNV_S_2_RANGE______0_CM 1 100. 0. 1. DISPLAY_IDENTIFIER LV_DCC_PUC_INH ECU_ADDRESS 0x3fdbbe /end MEASUREMENT
/begin MEASUREMENT tq_dcc_slow_bn "torque target (slow) for DCC via CAN interface" SWORD _CNV_A_R_LINEAR_____55_CM 1 100. -1024. 1023.96875 DISPLAY_IDENTIFIER TQ_DCC_SLOW_BN ECU_ADDRESS 0x3fcdb2 BYTE_ORDER MSB_LAST FORMAT "%8.2" /end MEASUREMENT
/begin MEASUREMENT tq_dcc_fast_bn "torque target (fast) for DCC via CAN interface" SWORD _CNV_A_R_LINEAR_____55_CM 1 100. -1024. 1023.96875 DISPLAY_IDENTIFIER TQ_DCC_FAST_BN ECU_ADDRESS 0x3fcdb0 BYTE_ORDER MSB_LAST FORMAT "%8.2" /end MEASUREMENT
/begin MEASUREMENT state_etcu_intv "status traction control system via CAN" UBYTE _CNV_S_4_STATE_ETCU_69_CM 1 100. 0. 3. DISPLAY_IDENTIFIER STATE_ETCU_INTV ECU_ADDRESS 0x3fdbab /end MEASUREMENT
/begin MEASUREMENT state_dcc_intv "status torque target DCC via CAN interface" UBYTE _CNV_S_4_STATE_DCC__70_CM 1 100. 0. 3. DISPLAY_IDENTIFIER STATE_DCC_INTV ECU_ADDRESS 0x3fdb9f /end MEASUREMENT
/begin MEASUREMENT state_dcc_puc_inh "status request PUC-inhibitation via CAN interface - DCC" UBYTE _CNV_S_3_STATE_DCC__71_CM 1 100. 0. 3. DISPLAY_IDENTIFIER STATE_DCC_PUC_INH ECU_ADDRESS 0x3fdba0 /end MEASUREMENT
/begin MEASUREMENT state_dcc_off_req "status switch-off DCC" UBYTE _CNV_S_4_STATE_DCC__72_CM 1 100. 0. 3. DISPLAY_IDENTIFIER STATE_DCC_OFF_REQ ECU_ADDRESS 0x3fdba1 /end MEASUREMENT
/begin MEASUREMENT state_dcc "Status DCC" UBYTE _CNV_S_8_STATE_DCC_73_CM 1 100. 0. 7. DISPLAY_IDENTIFIER STATE_DCC ECU_ADDRESS 0x3fdba2 /end MEASUREMENT
/begin MEASUREMENT lv_dcc_off_ack "Acknowledge bit for switch-off DCC" UBYTE _CNV_S_2_RANGE______0_CM 1 100. 0. 1. DISPLAY_IDENTIFIER LV_DCC_OFF_ACK ECU_ADDRESS 0x3fdbbd /end MEASUREMENT
/begin MEASUREMENT lv_err_tq_loss_ars_av_can "interface bit for TQ_LOSS_ARS calculation in case of error via CAN" UBYTE _CNV_S_2_RANGE______0_CM 1 100. 0. 1. DISPLAY_IDENTIFIER LV_ERR_TQ_LOSS_ARS_AV_CAN ECU_ADDRESS 0x3fdbc0 /end MEASUREMENT
/begin MEASUREMENT lv_err_tq_loss_ars_sp_can "interface bit for TQ_LOSS_ARS calculation in case of error via CAN" UBYTE _CNV_S_2_RANGE______0_CM 1 100. 0. 1. DISPLAY_IDENTIFIER LV_ERR_TQ_LOSS_ARS_SP_CAN ECU_ADDRESS 0x3fdbbf /end MEASUREMENT
/begin MEASUREMENT lv_rly_st_can "status starter relay" UBYTE _CNV_S_2_RANGE______0_CM 1 100. 0. 1. DISPLAY_IDENTIFIER LV_RLY_ST_CAN ECU_ADDRESS 0x3fdbff /end MEASUREMENT
/begin MEASUREMENT lv_key_aux "status Kl. R" UBYTE _CNV_S_2_RANGE______0_CM 1 100. 0. 1. DISPLAY_IDENTIFIER LV_KEY_AUX ECU_ADDRESS 0x3fdc00 /end MEASUREMENT
/begin MEASUREMENT tcc_can_cas "free running test cycle counter CAS (alive counter)" UBYTE _CNV_A_R_LINEAR_____22_CM 1 100. 0. 14. DISPLAY_IDENTIFIER TCC_CAN_CAS ECU_ADDRESS 0x3fdbd7 FORMAT "%2.0" /end MEASUREMENT
/begin MEASUREMENT tq_tcs_fast_bn "torque target (fast) due to TCS via CAN" SWORD _CNV_A_R_LINEAR_____55_CM 1 100. -1024. 1023.96875 DISPLAY_IDENTIFIER TQ_TCS_FAST_BN ECU_ADDRESS 0x3fcdbc BYTE_ORDER MSB_LAST FORMAT "%8.2" /end MEASUREMENT
/begin MEASUREMENT tcc_can_tq_dcc "free running test cycle counter TQ_DCC (alive counter)" UBYTE _CNV_A_R_LINEAR_____22_CM 1 100. 0. 14. DISPLAY_IDENTIFIER TCC_CAN_TQ_DCC ECU_ADDRESS 0x3fdbcc FORMAT "%2.0" /end MEASUREMENT
/begin MEASUREMENT tq_tcs_slow_bn "torque target (slow) due to TCS via CAN" SWORD _CNV_A_R_LINEAR_____55_CM 1 100. -1024. 1023.96875 DISPLAY_IDENTIFIER TQ_TCS_SLOW_BN ECU_ADDRESS 0x3fcdbe BYTE_ORDER MSB_LAST FORMAT "%8.2" /end MEASUREMENT
/begin MEASUREMENT tq_gs_slow_bn "torque target (slow) for GS via CAN interface" SWORD _CNV_A_R_LINEAR_____55_CM 1 100. -1024. 1023.96875 DISPLAY_IDENTIFIER TQ_GS_SLOW_BN ECU_ADDRESS 0x3fcdc6 BYTE_ORDER MSB_LAST FORMAT "%8.2" /end MEASUREMENT
/begin MEASUREMENT tcc_can_tq_tcs "free running test cycle counter TQ_TCS (alive counter)" UBYTE _CNV_A_R_LINEAR_____22_CM 1 100. 0. 14. DISPLAY_IDENTIFIER TCC_CAN_TQ_TCS ECU_ADDRESS 0x3fdbe0 FORMAT "%2.0" /end MEASUREMENT
/begin MEASUREMENT lv_tq_dcc_inc_req "LV indicating torque increse required by DCC" UBYTE _CNV_S_2_RANGE______0_CM 1 100. 0. 1. DISPLAY_IDENTIFIER LV_TQ_DCC_INC_REQ ECU_ADDRESS 0x3fdbba /end MEASUREMENT
/begin MEASUREMENT tq_gs_fast_bn "torque target (fast) for GS via CAN interface " SWORD _CNV_A_R_LINEAR_____55_CM 1 100. -1024. 1023.96875 DISPLAY_IDENTIFIER TQ_GS_FAST_BN ECU_ADDRESS 0x3fcdc4 BYTE_ORDER MSB_LAST FORMAT "%8.2" /end MEASUREMENT
/begin MEASUREMENT tq_amt_fast_bn "torque target (fast) for AMT via CAN interface " SWORD _CNV_A_R_LINEAR_____55_CM 1 100. -1024. 1023.96875 DISPLAY_IDENTIFIER TQ_AMT_FAST_BN ECU_ADDRESS 0x3fcdc8 BYTE_ORDER MSB_LAST FORMAT "%8.2" /end MEASUREMENT
/begin MEASUREMENT tq_amt_slow_bn "torque target (slow) for AMT via CAN interface " SWORD _CNV_A_R_LINEAR_____55_CM 1 100. -1024. 1023.96875 DISPLAY_IDENTIFIER TQ_AMT_SLOW_BN ECU_ADDRESS 0x3fcdca BYTE_ORDER MSB_LAST FORMAT "%8.2" /end MEASUREMENT
/begin MEASUREMENT tcc_can_tq_etcu "free running test cycle counter TQ_ETCU (alive counter)" UBYTE _CNV_A_R_LINEAR_____22_CM 1 100. 0. 14. DISPLAY_IDENTIFIER TCC_CAN_TQ_ETCU ECU_ADDRESS 0x3fdbe4 FORMAT "%2.0" /end MEASUREMENT
/begin MEASUREMENT state_etcu_obd_err "status OBD-relevamt error - ETCU" UBYTE _CNV_S_3_STATE_ETCU_74_CM 1 100. 0. 2. DISPLAY_IDENTIFIER STATE_ETCU_OBD_ERR ECU_ADDRESS 0x3fdbaa /end MEASUREMENT
/begin MEASUREMENT state_amt_intv "status torque target AMT via CAN" UBYTE _CNV_S_4_STATE_ETCU_69_CM 1 100. 0. 3. DISPLAY_IDENTIFIER STATE_AMT_INTV ECU_ADDRESS 0x3fdbb0 /end MEASUREMENT
/begin MEASUREMENT state_acin_can "state air-conditioning request signal CAN" UBYTE _CNV_A_R_LINEAR_____1_CM 1 100. 0. 7. DISPLAY_IDENTIFIER STATE_ACIN_CAN ECU_ADDRESS 0x3fdbef FORMAT "%1.0" /end MEASUREMENT
/begin MEASUREMENT ctr_km_bn "vehicle kilometer BN reading from Kombi - for OBD" ULONG _CNV_A_R_LINEAR_____75_CM 1 100. 0. 16777215. DISPLAY_IDENTIFIER CTR_KM_BN ECU_ADDRESS 0x3fbe88 BYTE_ORDER MSB_LAST FORMAT "%8.0" /end MEASUREMENT
/begin MEASUREMENT tcc_can_tq_amt "free running test cycle counter TQ_AMT (alive counter)" UBYTE _CNV_A_R_LINEAR_____22_CM 1 100. 0. 14. DISPLAY_IDENTIFIER TCC_CAN_TQ_AMT ECU_ADDRESS 0x3fdbe8 FORMAT "%2.0" /end MEASUREMENT
/begin MEASUREMENT t_ctr_swi_off_vb "shutdown counter battery-main-switch" UBYTE _CNV_A_R_LINEAR_____30_CM 1 100. 0. 255. DISPLAY_IDENTIFIER T_CTR_SWI_OFF_VB ECU_ADDRESS 0x3fdbb9 FORMAT "%3.0" /end MEASUREMENT
/begin MEASUREMENT ctrgenms "target generator voltage " UBYTE _CNV_R_R_spg_gencan_76_CM 1 100. 10.6 16.975 ECU_ADDRESS 0x3fdbb5 FORMAT "%8.4" /end MEASUREMENT
/begin MEASUREMENT n_idlms "request IS-increase" UBYTE _CNV_A_R_LINEAR_____1_CM 1 100. 0. 255. ECU_ADDRESS 0x3fdbb4 FORMAT "%3.0" /end MEASUREMENT
/begin CHARACTERISTIC c_t_ctr_swi_off_vb_min "Threshold shutdown counter battery-main-switch" VALUE 0x007e3 _REC_VAL_20_u1 255. _CNV_A_R_LINEAR_____30_CM 0. 255. DISPLAY_IDENTIFIER C_T_CTR_SWI_OFF_VB_MIN FORMAT "%3.0" /end CHARACTERISTIC
/begin CHARACTERISTIC c_v_sp_gen "Generator voltage (substitute value in case of  invalid signal from CAN)" VALUE 0x00911 _REC_VAL_20_u1 6.375000000000003 _CNV_R_R_spg_gencan_76_CM 10.6 16.975 DISPLAY_IDENTIFIER C_V_SP_GEN FORMAT "%8.4" /end CHARACTERISTIC
/begin MEASUREMENT tcc_can_icl "free running test cycle counter instrument cluster (alive counter)" UBYTE _CNV_A_R_LINEAR_____22_CM 1 100. 0. 14. DISPLAY_IDENTIFIER TCC_CAN_ICL ECU_ADDRESS 0x3fdbf1 FORMAT "%2.0" /end MEASUREMENT
/begin MEASUREMENT tcc_can_msw "alive counter MSW - SZL" UBYTE _CNV_A_R_LINEAR_____22_CM 1 100. 0. 14. DISPLAY_IDENTIFIER TCC_CAN_MSW ECU_ADDRESS 0x3fdbec FORMAT "%2.0" /end MEASUREMENT
/begin MEASUREMENT state_bn_msw "Status MSW BN (CAN)" UBYTE _CNV_S_13_STATE_BN_M_77_CM 1 100. 0. 127. DISPLAY_IDENTIFIER STATE_BN_MSW ECU_ADDRESS 0x3fdbb2 /end MEASUREMENT
/begin MEASUREMENT lv_err_ang_pste_can "interface bit for TQ_LOSS_PSTE calculation in case of error via CAN" UBYTE _CNV_S_2_RANGE______0_CM 1 100. 0. 1. DISPLAY_IDENTIFIER LV_ERR_ANG_PSTE_CAN ECU_ADDRESS 0x3fdbc4 /end MEASUREMENT
/begin MEASUREMENT tcc_can_ars "free running test cycle counter ARS (alive counter)" UBYTE _CNV_A_R_LINEAR_____22_CM 1 100. 0. 14. DISPLAY_IDENTIFIER TCC_CAN_ARS ECU_ADDRESS 0x3fdbd2 FORMAT "%2.0" /end MEASUREMENT
/begin MEASUREMENT lv_etcu_lih_can "logical variable ETCU gear shift intervention limp home" UBYTE _CNV_S_2_RANGE______0_CM 1 100. 0. 1. DISPLAY_IDENTIFIER LV_ETCU_LIH_CAN ECU_ADDRESS 0x3fdbc2 /end MEASUREMENT
/begin MEASUREMENT lv_amt_lih_can "logical variable AMT intervention limp home" UBYTE _CNV_S_2_RANGE______0_CM 1 100. 0. 1. DISPLAY_IDENTIFIER LV_AMT_LIH_CAN ECU_ADDRESS 0x3fdbc3 /end MEASUREMENT
/begin MEASUREMENT state_st_tq_lim_gs "State starting torque limitation" UBYTE _CNV_S_3_STATE_ST_T_79_CM 1 100. 0. 3. DISPLAY_IDENTIFIER STATE_ST_TQ_LIM_GS ECU_ADDRESS 0x3fdbaf /end MEASUREMENT
/begin MEASUREMENT state_st_tq_lim_amt "State starting torque limitation for AMT" UBYTE _CNV_S_3_STATE_ST_T_79_CM 1 100. 0. 3. DISPLAY_IDENTIFIER STATE_ST_TQ_LIM_AMT ECU_ADDRESS 0x3fdbb1 /end MEASUREMENT
/begin MEASUREMENT lv_var_etcu "BN(SSG or EGS)-transmission recognized" UBYTE _CNV_S_2_RANGE______0_CM 1 100. 0. 1. DISPLAY_IDENTIFIER LV_VAR_ETCU ECU_ADDRESS 0x3fe1b6 /end MEASUREMENT
/begin MEASUREMENT lv_var_bn_msw "LV cruise control detected - BN2000" UBYTE _CNV_S_2_RANGE______0_CM 1 100. 0. 1. DISPLAY_IDENTIFIER LV_VAR_BN_MSW ECU_ADDRESS 0x3fe1b4 /end MEASUREMENT
/begin MEASUREMENT lv_var_dcc "LV distance cruise control detected - BN2000" UBYTE _CNV_S_2_RANGE______0_CM 1 100. 0. 1. DISPLAY_IDENTIFIER LV_VAR_DCC ECU_ADDRESS 0x3fe1b5 /end MEASUREMENT
/begin MEASUREMENT lv_var_ars "LV anti-roll-stabilisation detected - BN2000" UBYTE _CNV_S_2_RANGE______0_CM 1 100. 0. 1. DISPLAY_IDENTIFIER LV_VAR_ARS ECU_ADDRESS 0x3fe1b3 /end MEASUREMENT
/begin MEASUREMENT state_veh_mod "vehicle mode" UBYTE _CNV_A_R_LINEAR_____1_CM 1 100. 0. 15. DISPLAY_IDENTIFIER STATE_VEH_MOD ECU_ADDRESS 0x3fdba6 FORMAT "%2.0" /end MEASUREMENT
/begin MEASUREMENT state_vs_icl_disp "status scaling of speedometer (displayed vehicle speed)" UBYTE _CNV_S_3_STATE_VS_I_80_CM 1 100. 0. 3. DISPLAY_IDENTIFIER STATE_VS_ICL_DISP ECU_ADDRESS 0x3fdb9d /end MEASUREMENT
/begin MEASUREMENT tcc_can_veh_mod "free running test cycle counter VEH_MOD (alive counter)" UBYTE _CNV_A_R_LINEAR_____22_CM 1 100. 0. 14. DISPLAY_IDENTIFIER TCC_CAN_VEH_MOD ECU_ADDRESS 0x3fdbdb FORMAT "%2.0" /end MEASUREMENT
/begin MEASUREMENT state_if_icl_bn_msw "status interface ICL/cruise control" UBYTE _CNV_A_R_LINEAR_____1_CM 1 100. 0. 7. DISPLAY_IDENTIFIER STATE_IF_ICL_BN_MSW ECU_ADDRESS 0x3fdb9e FORMAT "%1.0" /end MEASUREMENT
/begin CHARACTERISTIC c_tq_accin "Minimum torque ACCIN" VALUE 0x008fa _REC_VAL_20_u1 127. _CNV_A_R_LINEAR_____78_CM 0. 127. DISPLAY_IDENTIFIER C_TQ_ACCIN FORMAT "%5.1" /end CHARACTERISTIC
/begin MEASUREMENT tcc_can_tq_pste_2 "free running test cycle counter TQ_PSTE_2 (alive counter)" UBYTE _CNV_A_R_LINEAR_____22_CM 1 100. 0. 14. DISPLAY_IDENTIFIER TCC_CAN_TQ_PSTE_2 ECU_ADDRESS 0x3fdbd0 FORMAT "%2.0" /end MEASUREMENT
/begin MEASUREMENT state_pste_2_intv "status torque target PSTE_2 via CAN interface" UBYTE _CNV_S_4_STATE_PSTE_81_CM 1 100. 0. 3. DISPLAY_IDENTIFIER STATE_PSTE_2_INTV ECU_ADDRESS 0x3fdba3 /end MEASUREMENT
/begin MEASUREMENT tq_loss_pste_2_av_can "torque loss actual value PSTE_2 from CAN" SWORD _CNV_A_R_LINEAR_____55_CM 1 100. -1024. 1023.96875 DISPLAY_IDENTIFIER TQ_LOSS_PSTE_2_AV_CAN ECU_ADDRESS 0x3fcdb4 BYTE_ORDER MSB_LAST FORMAT "%8.2" /end MEASUREMENT
/begin MEASUREMENT tq_loss_pste_2_sp_can "torque loss setpoint PSTE_2 from CAN" SWORD _CNV_A_R_LINEAR_____55_CM 1 100. -1024. 1023.96875 DISPLAY_IDENTIFIER TQ_LOSS_PSTE_2_SP_CAN ECU_ADDRESS 0x3fcdb6 BYTE_ORDER MSB_LAST FORMAT "%8.2" /end MEASUREMENT
/begin MEASUREMENT lv_pste_2_err "LV indicating AFS error (sent by AFS via CAN)" UBYTE _CNV_S_2_RANGE______0_CM 1 100. 0. 1. DISPLAY_IDENTIFIER LV_PSTE_2_ERR ECU_ADDRESS 0x3fdbc6 /end MEASUREMENT
/begin MEASUREMENT state_brake_prs "status brake pressure via CAN" UBYTE _CNV_A_R_LINEAR_____1_CM 1 100. 0. 3. DISPLAY_IDENTIFIER STATE_BRAKE_PRS ECU_ADDRESS 0x3fdbb3 FORMAT "%1.0" /end MEASUREMENT
/begin MEASUREMENT lv_var_pste_2 "LV power steering detected - BN2000" UBYTE _CNV_S_2_RANGE______0_CM 1 100. 0. 1. DISPLAY_IDENTIFIER LV_VAR_PSTE_2 ECU_ADDRESS 0x3fe1b7 /end MEASUREMENT
/begin MEASUREMENT state_cru_bn "Status of Cruise Control for BN-CAN" UBYTE _CNV_A_R_LINEAR_____1_CM 1 100. 0. 255. DISPLAY_IDENTIFIER STATE_CRU_BN ECU_ADDRESS 0x3fdbfc FORMAT "%3.0" /end MEASUREMENT
/begin MEASUREMENT ctr_diag_tcc_can_cas "Diagnosis counter for alive counter error symptom detection" UBYTE _CNV_A_R_LINEAR_____1_CM 1 100. 0. 255. DISPLAY_IDENTIFIER CTR_DIAG_TCC_CAN_CAS ECU_ADDRESS 0x3fdc3d FORMAT "%3.0" /end MEASUREMENT
/begin MEASUREMENT ctr_diag_tcc_can_tq_tcs "Diagnosis counter for alive counter error symptom detection" UBYTE _CNV_A_R_LINEAR_____1_CM 1 100. 0. 255. DISPLAY_IDENTIFIER CTR_DIAG_TCC_CAN_TQ_TCS ECU_ADDRESS 0x3fdc22 FORMAT "%3.0" /end MEASUREMENT
/begin MEASUREMENT ctr_diag_tcc_can_tq_etcu "Diagnosis counter for alive counter error symptom detection" UBYTE _CNV_A_R_LINEAR_____1_CM 1 100. 0. 255. DISPLAY_IDENTIFIER CTR_DIAG_TCC_CAN_TQ_ETCU ECU_ADDRESS 0x3fdc25 FORMAT "%3.0" /end MEASUREMENT
/begin MEASUREMENT ctr_diag_tcc_can_tq_amt "Diagnosis counter for alive counter error symptom detection" UBYTE _CNV_A_R_LINEAR_____1_CM 1 100. 0. 255. DISPLAY_IDENTIFIER CTR_DIAG_TCC_CAN_TQ_AMT ECU_ADDRESS 0x3fdc31 FORMAT "%3.0" /end MEASUREMENT
/begin MEASUREMENT ctr_diag_tcc_can_icl "Diagnosis counter for alive counter error symptom detection" UBYTE _CNV_A_R_LINEAR_____1_CM 1 100. 0. 255. DISPLAY_IDENTIFIER CTR_DIAG_TCC_CAN_ICL ECU_ADDRESS 0x3fdc43 FORMAT "%3.0" /end MEASUREMENT
/begin MEASUREMENT ctr_diag_tcc_can_ars "Diagnosis counter for alive counter error symptom detection" UBYTE _CNV_A_R_LINEAR_____1_CM 1 100. 0. 255. DISPLAY_IDENTIFIER CTR_DIAG_TCC_CAN_ARS ECU_ADDRESS 0x3fdc34 FORMAT "%3.0" /end MEASUREMENT
/begin MEASUREMENT ctr_diag_tcc_can_msw "Diagnosis counter for alive counter error symptom detection" UBYTE _CNV_A_R_LINEAR_____1_CM 1 100. 0. 255. DISPLAY_IDENTIFIER CTR_DIAG_TCC_CAN_MSW ECU_ADDRESS 0x3fdc40 FORMAT "%3.0" /end MEASUREMENT
/begin MEASUREMENT ctr_diag_tcc_can_tq_dcc "Diagnosis counter for alive counter error symptom detection" UBYTE _CNV_A_R_LINEAR_____1_CM 1 100. 0. 255. DISPLAY_IDENTIFIER CTR_DIAG_TCC_CAN_TQ_DCC ECU_ADDRESS 0x3fdc1c FORMAT "%3.0" /end MEASUREMENT
/begin MEASUREMENT ctr_diag_cks_cas "Diagnosis counter for checksum counter error symptom detection" UBYTE _CNV_A_R_LINEAR_____1_CM 1 100. 0. 255. DISPLAY_IDENTIFIER CTR_DIAG_CKS_CAS ECU_ADDRESS 0x3fdc3e FORMAT "%3.0" /end MEASUREMENT
/begin MEASUREMENT ctr_diag_cks_tq_tcs "Diagnosis counter for checksum counter error symptom detection" UBYTE _CNV_A_R_LINEAR_____1_CM 1 100. 0. 255. DISPLAY_IDENTIFIER CTR_DIAG_CKS_TQ_TCS ECU_ADDRESS 0x3fdc23 FORMAT "%3.0" /end MEASUREMENT
/begin MEASUREMENT ctr_diag_cks_tq_etcu "Diagnosis counter for checksum counter error symptom detection" UBYTE _CNV_A_R_LINEAR_____1_CM 1 100. 0. 255. DISPLAY_IDENTIFIER CTR_DIAG_CKS_TQ_ETCU ECU_ADDRESS 0x3fdc26 FORMAT "%3.0" /end MEASUREMENT
/begin MEASUREMENT ctr_diag_cks_tq_amt "Diagnosis counter for checksum counter error symptom detection" UBYTE _CNV_A_R_LINEAR_____1_CM 1 100. 0. 255. DISPLAY_IDENTIFIER CTR_DIAG_CKS_TQ_AMT ECU_ADDRESS 0x3fdc32 FORMAT "%3.0" /end MEASUREMENT
/begin MEASUREMENT ctr_diag_cks_msw "Diagnosis counter for checksum counter error symptom detection" UBYTE _CNV_A_R_LINEAR_____1_CM 1 100. 0. 255. DISPLAY_IDENTIFIER CTR_DIAG_CKS_MSW ECU_ADDRESS 0x3fdc41 FORMAT "%3.0" /end MEASUREMENT
/begin MEASUREMENT ctr_diag_cks_tq_dcc "Diagnosis counter for checksum counter error symptom detection" UBYTE _CNV_A_R_LINEAR_____1_CM 1 100. 0. 255. DISPLAY_IDENTIFIER CTR_DIAG_CKS_TQ_DCC ECU_ADDRESS 0x3fdc1d FORMAT "%3.0" /end MEASUREMENT
/begin MEASUREMENT ctr_diag_tout_ars "Diagnosis counter for timeout counter error symptom detection" UBYTE _CNV_A_R_LINEAR_____1_CM 1 100. 0. 255. DISPLAY_IDENTIFIER CTR_DIAG_TOUT_ARS ECU_ADDRESS 0x3fdc36 FORMAT "%3.0" /end MEASUREMENT
/begin MEASUREMENT ctr_diag_tout_cas "Diagnosis counter for timeout counter error symptom detection" UBYTE _CNV_A_R_LINEAR_____1_CM 1 100. 0. 255. DISPLAY_IDENTIFIER CTR_DIAG_TOUT_CAS ECU_ADDRESS 0x3fdc3f FORMAT "%3.0" /end MEASUREMENT
/begin MEASUREMENT ctr_diag_tout_tq_tcs "Diagnosis counter for timeout counter error symptom detection" UBYTE _CNV_A_R_LINEAR_____1_CM 1 100. 0. 255. DISPLAY_IDENTIFIER CTR_DIAG_TOUT_TQ_TCS ECU_ADDRESS 0x3fdc24 FORMAT "%3.0" /end MEASUREMENT
/begin MEASUREMENT ctr_diag_tout_vs_tcs "Diagnosis counter for timeout counter error symptom detection" UBYTE _CNV_A_R_LINEAR_____1_CM 1 100. 0. 255. DISPLAY_IDENTIFIER CTR_DIAG_TOUT_VS_TCS ECU_ADDRESS 0x3fdc30 FORMAT "%3.0" /end MEASUREMENT
/begin MEASUREMENT ctr_diag_tout_tcs "Diagnosis counter for timeout counter error symptom detection" UBYTE _CNV_A_R_LINEAR_____1_CM 1 100. 0. 255. DISPLAY_IDENTIFIER CTR_DIAG_TOUT_TCS ECU_ADDRESS 0x3fdc39 FORMAT "%3.0" /end MEASUREMENT
/begin MEASUREMENT ctr_diag_tout_tq_etcu "Diagnosis counter for timeout counter error symptom detection" UBYTE _CNV_A_R_LINEAR_____1_CM 1 100. 0. 255. DISPLAY_IDENTIFIER CTR_DIAG_TOUT_TQ_ETCU ECU_ADDRESS 0x3fdc27 FORMAT "%3.0" /end MEASUREMENT
/begin MEASUREMENT ctr_diag_tout_etcu "Diagnosis counter for timeout counter error symptom detection" UBYTE _CNV_A_R_LINEAR_____1_CM 1 100. 0. 255. DISPLAY_IDENTIFIER CTR_DIAG_TOUT_ETCU ECU_ADDRESS 0x3fdc2a FORMAT "%3.0" /end MEASUREMENT
/begin MEASUREMENT ctr_diag_tout_tq_amt "Diagnosis counter for timeout counter error symptom detection" UBYTE _CNV_A_R_LINEAR_____1_CM 1 100. 0. 255. DISPLAY_IDENTIFIER CTR_DIAG_TOUT_TQ_AMT ECU_ADDRESS 0x3fdc33 FORMAT "%3.0" /end MEASUREMENT
/begin MEASUREMENT ctr_diag_tout_tq_dcc "Diagnosis counter for timeout counter error symptom detection" UBYTE _CNV_A_R_LINEAR_____1_CM 1 100. 0. 255. DISPLAY_IDENTIFIER CTR_DIAG_TOUT_TQ_DCC ECU_ADDRESS 0x3fdc1e FORMAT "%3.0" /end MEASUREMENT
/begin MEASUREMENT ctr_diag_tout_acc "Diagnosis counter for timeout counter error symptom detection" UBYTE _CNV_A_R_LINEAR_____1_CM 1 100. 0. 255. DISPLAY_IDENTIFIER CTR_DIAG_TOUT_ACC ECU_ADDRESS 0x3fdc48 FORMAT "%3.0" /end MEASUREMENT
/begin MEASUREMENT ctr_diag_tout_km_icl "Diagnosis counter for timeout counter error symptom detection" UBYTE _CNV_A_R_LINEAR_____1_CM 1 100. 0. 255. DISPLAY_IDENTIFIER CTR_DIAG_TOUT_KM_ICL ECU_ADDRESS 0x3fdc51 FORMAT "%3.0" /end MEASUREMENT
/begin MEASUREMENT ctr_diag_tout_icl "Diagnosis counter for timeout counter error symptom detection" UBYTE _CNV_A_R_LINEAR_____1_CM 1 100. 0. 255. DISPLAY_IDENTIFIER CTR_DIAG_TOUT_ICL ECU_ADDRESS 0x3fdc45 FORMAT "%3.0" /end MEASUREMENT
/begin MEASUREMENT ctr_diag_tout_pow_vb "Diagnosis counter for timeout counter error symptom detection" UBYTE _CNV_A_R_LINEAR_____1_CM 1 100. 0. 255. DISPLAY_IDENTIFIER CTR_DIAG_TOUT_POW_VB ECU_ADDRESS 0x3fdc5a FORMAT "%3.0" /end MEASUREMENT
/begin MEASUREMENT ctr_diag_tout_pow_gen "Diagnosis counter for timeout counter error symptom detection" UBYTE _CNV_A_R_LINEAR_____1_CM 1 100. 0. 255. DISPLAY_IDENTIFIER CTR_DIAG_TOUT_POW_GEN ECU_ADDRESS 0x3fdc54 FORMAT "%3.0" /end MEASUREMENT
/begin MEASUREMENT ctr_diag_tout_msw "Diagnosis counter for timeout counter error symptom detection" UBYTE _CNV_A_R_LINEAR_____1_CM 1 100. 0. 255. DISPLAY_IDENTIFIER CTR_DIAG_TOUT_MSW ECU_ADDRESS 0x3fdc42 FORMAT "%3.0" /end MEASUREMENT
/begin MEASUREMENT ctr_diag_tout_t_icl "Diagnosis counter for timeout counter error symptom detection" UBYTE _CNV_A_R_LINEAR_____1_CM 1 100. 0. 255. DISPLAY_IDENTIFIER CTR_DIAG_TOUT_T_ICL ECU_ADDRESS 0x3fdc4b FORMAT "%3.0" /end MEASUREMENT
/begin MEASUREMENT ctr_diag_tout_ang_pste "Diagnosis counter for timeout counter error symptom detection" UBYTE _CNV_A_R_LINEAR_____1_CM 1 100. 0. 255. DISPLAY_IDENTIFIER CTR_DIAG_TOUT_ANG_PSTE ECU_ADDRESS 0x3fdc2d FORMAT "%3.0" /end MEASUREMENT
/begin MEASUREMENT ctr_diag_tcc_can_veh_mod "Diagnosis counter for alive counter error symptom detection" UBYTE _CNV_A_R_LINEAR_____1_CM 1 100. 0. 255. DISPLAY_IDENTIFIER CTR_DIAG_TCC_CAN_VEH_MOD ECU_ADDRESS 0x3fdc4c FORMAT "%3.0" /end MEASUREMENT
/begin MEASUREMENT ctr_diag_cks_veh_mod "Diagnosis counter for checksum counter error symptom detection" UBYTE _CNV_A_R_LINEAR_____1_CM 1 100. 0. 255. DISPLAY_IDENTIFIER CTR_DIAG_CKS_VEH_MOD ECU_ADDRESS 0x3fdc4d FORMAT "%3.0" /end MEASUREMENT
/begin MEASUREMENT ctr_diag_tout_veh_mod "Diagnosis counter for timeout counter error symptom detection" UBYTE _CNV_A_R_LINEAR_____1_CM 1 100. 0. 255. DISPLAY_IDENTIFIER CTR_DIAG_TOUT_VEH_MOD ECU_ADDRESS 0x3fdc4e FORMAT "%3.0" /end MEASUREMENT
/begin MEASUREMENT ctr_diag_tcc_can_tq_pste_2 "Diagnosis counter for alive counter error symptom detection" UBYTE _CNV_A_R_LINEAR_____1_CM 1 100. 0. 255. DISPLAY_IDENTIFIER CTR_DIAG_TCC_CAN_TQ_PSTE_2 ECU_ADDRESS 0x3fdc1f FORMAT "%3.0" /end MEASUREMENT
/begin MEASUREMENT ctr_diag_cks_tq_pste_2 "Diagnosis counter for checksum counter error symptom detection" UBYTE _CNV_A_R_LINEAR_____1_CM 1 100. 0. 255. DISPLAY_IDENTIFIER CTR_DIAG_CKS_TQ_PSTE_2 ECU_ADDRESS 0x3fdc20 FORMAT "%3.0" /end MEASUREMENT
/begin MEASUREMENT ctr_diag_tout_tq_pste_2 "Diagnosis counter for timeout counter error symptom detection" UBYTE _CNV_A_R_LINEAR_____1_CM 1 100. 0. 255. DISPLAY_IDENTIFIER CTR_DIAG_TOUT_TQ_PSTE_2 ECU_ADDRESS 0x3fdc21 FORMAT "%3.0" /end MEASUREMENT
/begin MEASUREMENT ctr_diag_tout_efp "Diagnosis counter for timeout counter error symptom detection" UBYTE _CNV_A_R_LINEAR_____1_CM 1 100. 0. 255. DISPLAY_IDENTIFIER CTR_DIAG_TOUT_EFP ECU_ADDRESS 0x3fdc57 FORMAT "%3.0" /end MEASUREMENT
/begin MEASUREMENT lv_err_bn_acc "Present error BN2000" UBYTE _CNV_S_2_RANGE______2_R_CM 1 100. 0. 255. DISPLAY_IDENTIFIER LV_ERR_BN_ACC ECU_ADDRESS 0x3fbae8 /end MEASUREMENT
/begin MEASUREMENT lv_err_bn_cas "Present error BN2000" UBYTE _CNV_S_2_RANGE______2_R_CM 1 100. 0. 255. DISPLAY_IDENTIFIER LV_ERR_BN_CAS ECU_ADDRESS 0x3fbacc /end MEASUREMENT
/begin MEASUREMENT lv_err_bn_icl "Present error BN2000" UBYTE _CNV_S_2_RANGE______2_R_CM 1 100. 0. 255. DISPLAY_IDENTIFIER LV_ERR_BN_ICL ECU_ADDRESS 0x3fbaf8 /end MEASUREMENT
/begin MEASUREMENT lv_err_bn_km_icl "Present error BN2000" UBYTE _CNV_S_2_RANGE______2_R_CM 1 100. 0. 255. DISPLAY_IDENTIFIER LV_ERR_BN_KM_ICL ECU_ADDRESS 0x3fbaf4 /end MEASUREMENT
/begin MEASUREMENT lv_err_bn_pow_gen "Present error BN2000" UBYTE _CNV_S_2_RANGE______2_R_CM 1 100. 0. 255. DISPLAY_IDENTIFIER LV_ERR_BN_POW_GEN ECU_ADDRESS 0x3fbb00 /end MEASUREMENT
/begin MEASUREMENT lv_err_bn_pow_vb "Present error BN2000" UBYTE _CNV_S_2_RANGE______2_R_CM 1 100. 0. 255. DISPLAY_IDENTIFIER LV_ERR_BN_POW_VB ECU_ADDRESS 0x3fbafc /end MEASUREMENT
/begin MEASUREMENT lv_err_bn_t_icl "Present error BN2000" UBYTE _CNV_S_2_RANGE______2_R_CM 1 100. 0. 255. DISPLAY_IDENTIFIER LV_ERR_BN_T_ICL ECU_ADDRESS 0x3fbaec /end MEASUREMENT
/begin MEASUREMENT lv_err_bn_tq_pste_2 "Present error BN2000" UBYTE _CNV_S_2_RANGE______2_R_CM 1 100. 0. 255. DISPLAY_IDENTIFIER LV_ERR_BN_TQ_PSTE_2 ECU_ADDRESS 0x3fbac4 /end MEASUREMENT
/begin MEASUREMENT lv_err_bn_efp "Present error BN2000" UBYTE _CNV_S_2_RANGE______2_R_CM 1 100. 0. 255. DISPLAY_IDENTIFIER LV_ERR_BN_EFP ECU_ADDRESS 0x3fbb0c /end MEASUREMENT
/begin MEASUREMENT tqi_msr_can "relative indicated engine torque requested by MSR" UBYTE _CNV_A_R_LINEAR_____10_CM 1 100. 0. 99.609375 DISPLAY_IDENTIFIER TQI_MSR_CAN ECU_ADDRESS 0x3fddfd FORMAT "%5.1" /end MEASUREMENT
/begin MEASUREMENT vs_can "vehicle speed signal from CAN" UBYTE _CNV_A_R_LINEAR_____23_CM 1 100. 0. 255. DISPLAY_IDENTIFIER VS_CAN ECU_ADDRESS 0x3fddff FORMAT "%3.0" /end MEASUREMENT
/begin MEASUREMENT wheel "vehicle speed signal from CAN for cruise control" UWORD _CNV_A_R_LINEAR_____85_CM 1 100. 0. 511.99218 DISPLAY_IDENTIFIER WHEEL ECU_ADDRESS 0x3fce12 BYTE_ORDER MSB_LAST FORMAT "%7.3" /end MEASUREMENT
/begin MEASUREMENT lv_plaus_asr_ctl "logical variable for ASR intervention is active" UBYTE _CNV_S_2_RANGE______0_CM 1 100. 0. 1. DISPLAY_IDENTIFIER LV_PLAUS_ASR_CTL ECU_ADDRESS 0x3fde04 /end MEASUREMENT
/begin MEASUREMENT lv_plaus_esp_ctl "logical variable for DSC intervention is active" UBYTE _CNV_S_2_RANGE______0_CM 1 100. 0. 1. DISPLAY_IDENTIFIER LV_PLAUS_ESP_CTL ECU_ADDRESS 0x3fde06 /end MEASUREMENT
/begin MEASUREMENT tqi_asr_fast_can "relative indicated engine torque requested by ASR (fast path)" UBYTE _CNV_A_R_LINEAR_____10_CM 1 100. 0. 99.609375 DISPLAY_IDENTIFIER TQI_ASR_FAST_CAN ECU_ADDRESS 0x3fddfc FORMAT "%5.1" /end MEASUREMENT
/begin MEASUREMENT lv_err_vs_can "logical variable for VS_CAN error" UBYTE _CNV_S_2_RANGE______2_R_CM 1 100. 0. 255. DISPLAY_IDENTIFIER LV_ERR_VS_CAN ECU_ADDRESS 0x3fde03 /end MEASUREMENT
/begin MEASUREMENT tqi_asr_fast_req_can "Relative indicated engine torque request by ASR (fast path)" SWORD _CNV_A_R_LINEAR_____55_CM 1 100. -1024. 1023.96875 DISPLAY_IDENTIFIER TQI_ASR_FAST_REQ_CAN ECU_ADDRESS 0x3fce0c BYTE_ORDER MSB_LAST FORMAT "%8.2" /end MEASUREMENT
/begin MEASUREMENT tqi_msr_req_can "Relative indicated engine torque request by MSR" SWORD _CNV_A_R_LINEAR_____55_CM 1 100. -1024. 1023.96875 DISPLAY_IDENTIFIER TQI_MSR_REQ_CAN ECU_ADDRESS 0x3fce0e BYTE_ORDER MSB_LAST FORMAT "%8.2" /end MEASUREMENT
/begin MEASUREMENT tqi_asr_slow_can "relative indicated engine torque requested by ASR (slow path)" UBYTE _CNV_A_R_LINEAR_____10_CM 1 100. 0. 99.609375 DISPLAY_IDENTIFIER TQI_ASR_SLOW_CAN ECU_ADDRESS 0x3fddfe FORMAT "%5.1" /end MEASUREMENT
/begin MEASUREMENT tqi_asr_slow_req_can "Relative indicated engine torque request by ASR (slow path)" SWORD _CNV_A_R_LINEAR_____55_CM 1 100. -1024. 1023.96875 DISPLAY_IDENTIFIER TQI_ASR_SLOW_REQ_CAN ECU_ADDRESS 0x3fce10 BYTE_ORDER MSB_LAST FORMAT "%8.2" /end MEASUREMENT
/begin MEASUREMENT lv_tq_asr_req "logical variable for ASR request" UBYTE _CNV_S_2_RANGE______0_CM 1 100. 0. 1. DISPLAY_IDENTIFIER LV_TQ_ASR_REQ ECU_ADDRESS 0x3fde01 /end MEASUREMENT
/begin MEASUREMENT lv_tq_msr_req "logical variable for MSR request" UBYTE _CNV_S_2_RANGE______0_CM 1 100. 0. 1. DISPLAY_IDENTIFIER LV_TQ_MSR_REQ ECU_ADDRESS 0x3fde02 /end MEASUREMENT
/begin MEASUREMENT brake_prs "Brake pressure" UBYTE _CNV_A_R_LINEAR_____86_CM 1 100. 0. 255. DISPLAY_IDENTIFIER BRAKE_PRS ECU_ADDRESS 0x3fde00 FORMAT "%3.0" /end MEASUREMENT
/begin MEASUREMENT gear_sel_disp "Gear stick position" UBYTE _CNV_A_R_LINEAR_____1_CM 1 100. 0. 15. DISPLAY_IDENTIFIER GEAR_SEL_DISP ECU_ADDRESS 0x3fde3d FORMAT "%2.0" /end MEASUREMENT
/begin MEASUREMENT tqi_gs_req_can "Relative torque request during gearshift intervention" UBYTE _CNV_A_R_LINEAR_____50_CM 1 100. 0. 0.996094 DISPLAY_IDENTIFIER TQI_GS_REQ_CAN ECU_ADDRESS 0x3fde35 FORMAT "%5.3" /end MEASUREMENT
/begin MEASUREMENT tq_gear_can "Torque from ETCU" UBYTE _CNV_A_R_LINEAR_____50_CM 1 100. 0. 0.996094 DISPLAY_IDENTIFIER TQ_GEAR_CAN ECU_ADDRESS 0x3fde38 FORMAT "%5.3" /end MEASUREMENT
/begin MEASUREMENT tqi_gs_req "Absolute torque request during gearshift intervention" SWORD _CNV_A_R_LINEAR_____55_CM 1 100. -1024. 1023.96875 DISPLAY_IDENTIFIER TQI_GS_REQ ECU_ADDRESS 0x3fce18 BYTE_ORDER MSB_LAST FORMAT "%8.2" /end MEASUREMENT
/begin MEASUREMENT lv_tq_gs_inc_req "logical variable indicating torque increase due to gear shift intervention" UBYTE _CNV_S_2_RANGE______0_CM 1 100. 0. 1. DISPLAY_IDENTIFIER LV_TQ_GS_INC_REQ ECU_ADDRESS 0x3fde3b /end MEASUREMENT
/begin MEASUREMENT lv_tq_gs_dec_req "logical variable indicating torque decrese due to gear shift intervention " UBYTE _CNV_S_2_RANGE______0_CM 1 100. 0. 1. DISPLAY_IDENTIFIER LV_TQ_GS_DEC_REQ ECU_ADDRESS 0x3fde3a /end MEASUREMENT
/begin CHARACTERISTIC c_tq_stnd "Standard torque" VALUE 0x004aa _REC_VAL_20_s2 2047.96875 _CNV_A_R_LINEAR_____55_CM -1024. 1023.96875 DISPLAY_IDENTIFIER C_TQ_STND FORMAT "%8.2" /end CHARACTERISTIC
/begin MEASUREMENT gear_info "Gear information from EGS-ECU" UBYTE _CNV_A_R_LINEAR_____1_CM 1 100. 0. 7. DISPLAY_IDENTIFIER GEAR_INFO ECU_ADDRESS 0x3fde36 FORMAT "%2.0" /end MEASUREMENT
/begin MEASUREMENT tq_conv_can "converter torque from ETCU" SWORD _CNV_A_R_LINEAR_____55_CM 1 100. -1024. 1023.96875 DISPLAY_IDENTIFIER TQ_CONV_CAN ECU_ADDRESS 0x3fce16 BYTE_ORDER MSB_LAST FORMAT "%6.2" /end MEASUREMENT
/begin MEASUREMENT state_cc "state of converter clutch (CC)" UBYTE _CNV_S_4_RANGE_STAT_92_CM 1 100. 0. 3. DISPLAY_IDENTIFIER STATE_CC ECU_ADDRESS 0x3fde37 /end MEASUREMENT
/begin MEASUREMENT state_etcu_obd "status OBD gearbox" UBYTE _CNV_S_9_STATE_ETCU_93_CM 1 100. 0. 15. DISPLAY_IDENTIFIER STATE_ETCU_OBD ECU_ADDRESS 0x3fde39 /end MEASUREMENT
/begin MEASUREMENT n_gb "input shaft speed turbine/gearbox (AT) " UWORD _CNV_A_R_LINEAR_____94_CM 1 100. 0. 8191.75 DISPLAY_IDENTIFIER N_GB ECU_ADDRESS 0x3fce1a BYTE_ORDER MSB_LAST FORMAT "%7.2" /end MEASUREMENT
/begin MEASUREMENT tq_accin_can "ACC-torque from CAN" UBYTE _CNV_A_R_LINEAR_____95_CM 1 100. 0. 31. DISPLAY_IDENTIFIER TQ_ACCIN_CAN ECU_ADDRESS 0x3fde4a FORMAT "%3.0" /end MEASUREMENT
/begin MEASUREMENT state_efp_crash_can "Request for switch off fuel pump after crash" UBYTE _CNV_A_R_LINEAR_____1_CM 1 100. 0. 3. DISPLAY_IDENTIFIER STATE_EFP_CRASH_CAN ECU_ADDRESS 0x3fde49 FORMAT "%2.0" /end MEASUREMENT
/begin MEASUREMENT lv_req_heat "LV increased heater power request" UBYTE _CNV_S_2_RANGE______5_CM 1 100. 0. 1. DISPLAY_IDENTIFIER LV_REQ_HEAT ECU_ADDRESS 0x3fde57 BIT_MASK 0x1 /end MEASUREMENT
/begin MEASUREMENT lv_ltg_swi_can "logical variable for day- (0)or night lighting (1)" UBYTE _CNV_S_2_RANGE______0_CM 1 100. 0. 1. DISPLAY_IDENTIFIER LV_LTG_SWI_CAN ECU_ADDRESS 0x3fde55 /end MEASUREMENT
/begin MEASUREMENT lv_tam_can_err "logical variable for erroneous ambient temperature signal" UBYTE _CNV_S_2_RANGE______0_CM 1 100. 0. 1. DISPLAY_IDENTIFIER LV_TAM_CAN_ERR ECU_ADDRESS 0x3fde50 /end MEASUREMENT
/begin MEASUREMENT state_gear_rev_can "state reverse gear: 0 inactiv, 1 activ" UBYTE _CNV_S_2_RANGE______0_CM 1 100. 0. 1. DISPLAY_IDENTIFIER STATE_GEAR_REV_CAN ECU_ADDRESS 0x3fde56 /end MEASUREMENT
/begin MEASUREMENT ftl "fuel tank level" UBYTE _CNV_A_R_LINEAR_____96_CM 1 100. 0. 127. DISPLAY_IDENTIFIER FTL ECU_ADDRESS 0x3fde46 FORMAT "%3.0" /end MEASUREMENT
/begin MEASUREMENT lv_ftl_can_err "logical value erroneous fuel tank level signal" UBYTE _CNV_S_2_RANGE______0_CM 1 100. 0. 1. DISPLAY_IDENTIFIER LV_FTL_CAN_ERR ECU_ADDRESS 0x3fde52 /end MEASUREMENT
/begin CHARACTERISTIC c_tam_sub "substitute TAM-temperature in case of TAM-failure" VALUE 0x00853 _REC_VAL_20_u1 190.5 _CNV_A_R_LINEAR_____12_CM -48. 142.5 DISPLAY_IDENTIFIER C_TAM_SUB FORMAT "%5.1" /end CHARACTERISTIC
/begin CHARACTERISTIC lc_tam_man_as "Logical constant switch TAM from CAN or application system" VALUE 0x00f79 _REC_VAL_20_u1 1. _CNV_A_R_LINEAR_____22_CM 0. 1. DISPLAY_IDENTIFIER LC_TAM_MAN_AS FORMAT "%1.0" /end CHARACTERISTIC
/begin CHARACTERISTIC c_tam_man_as "Ambient temperature TAM by application system" VALUE 0x0084b _REC_VAL_20_u1 190.5 _CNV_A_R_LINEAR_____12_CM -48. 142.5 DISPLAY_IDENTIFIER C_TAM_MAN_AS FORMAT "%5.1" /end CHARACTERISTIC
/begin MEASUREMENT n_ecf "Setpoint step of electric cooling fan speed" UBYTE _CNV_A_R_LINEAR_____1_CM 1 100. 0. 15. DISPLAY_IDENTIFIER N_ECF ECU_ADDRESS 0x3fde45 FORMAT "%2.0" /end MEASUREMENT
/begin MEASUREMENT lv_req_tco_l "LV requirement for low coolant temperature" UBYTE _CNV_S_2_RANGE______5_CM 1 100. 0. 1. DISPLAY_IDENTIFIER LV_REQ_TCO_L ECU_ADDRESS 0x3fde4f BIT_MASK 0x1 /end MEASUREMENT
/begin MEASUREMENT lv_accin "LV ACC request" UBYTE _CNV_S_2_RANGE______5_CM 1 100. 0. 1. DISPLAY_IDENTIFIER LV_ACCIN ECU_ADDRESS 0x3fde4e BIT_MASK 0x1 /end MEASUREMENT
/begin MEASUREMENT ctr_km_can "vehicle kilometer reading from CAN message INSTR2" UWORD _CNV_A_R_LINEAR_____88_CM 1 100. 0. 655350. DISPLAY_IDENTIFIER CTR_KM_CAN ECU_ADDRESS 0x3fce1c BYTE_ORDER MSB_LAST FORMAT "%7.0" /end MEASUREMENT
/begin MEASUREMENT t_rel_can "relative time counter" UWORD _CNV_A_R_LINEAR_____97_CM 1 100. 0. 65535. DISPLAY_IDENTIFIER T_REL_CAN ECU_ADDRESS 0x3fce1e BYTE_ORDER MSB_LAST FORMAT "%5.0" /end MEASUREMENT
/begin MEASUREMENT tam "Ambient temperature" UBYTE _CNV_A_R_LINEAR_____12_CM 1 100. -48. 142.5 DISPLAY_IDENTIFIER TAM ECU_ADDRESS 0x3fde44 FORMAT "%5.1" /end MEASUREMENT
/begin MEASUREMENT lv_acin "LV switch ACC readiness" UBYTE _CNV_S_2_RANGE______5_CM 1 100. 0. 1. DISPLAY_IDENTIFIER LV_ACIN ECU_ADDRESS 0x3fde4d BIT_MASK 0x1 /end MEASUREMENT
/begin MEASUREMENT lv_ftl_le_can_err "logical variable erroneous fuel tank level (left) signal" UBYTE _CNV_S_2_RANGE______0_CM 1 100. 0. 1. DISPLAY_IDENTIFIER LV_FTL_LE_CAN_ERR ECU_ADDRESS 0x3fde53 /end MEASUREMENT
/begin MEASUREMENT lv_ftl_ri_can_err "logical variable erroneous fuel tank level (right) signal" UBYTE _CNV_S_2_RANGE______0_CM 1 100. 0. 1. DISPLAY_IDENTIFIER LV_FTL_RI_CAN_ERR ECU_ADDRESS 0x3fde54 /end MEASUREMENT
/begin MEASUREMENT lv_ftl_obd_inh_l "logical variable fuel reserve" UBYTE _CNV_S_2_RANGE______0_CM 1 100. 0. 1. DISPLAY_IDENTIFIER LV_FTL_OBD_INH_L ECU_ADDRESS 0x3fde51 /end MEASUREMENT
/begin MEASUREMENT ftl_le "fuel tank level left" UBYTE _CNV_A_R_LINEAR_____96_CM 1 100. 0. 127. DISPLAY_IDENTIFIER FTL_LE ECU_ADDRESS 0x3fde47 FORMAT "%3.0" /end MEASUREMENT
/begin MEASUREMENT ftl_ri "fuel tank level right" UBYTE _CNV_A_R_LINEAR_____96_CM 1 100. 0. 127. DISPLAY_IDENTIFIER FTL_RI ECU_ADDRESS 0x3fde48 FORMAT "%3.0" /end MEASUREMENT
/begin CHARACTERISTIC c_tout_efp_crash "" VALUE 0x008f4 _REC_VAL_20_u1 51. _CNV_A_R_LINEAR_____98_CM 0. 51. DISPLAY_IDENTIFIER C_TOUT_EFP_CRASH FORMAT "%4.1" /end CHARACTERISTIC
/begin MEASUREMENT vel_ang_pste "sttering wheel sensor velocity" SWORD _CNV_A_R_LINEAR_____99_CM 1 100. -1439.98976 1439.945815 DISPLAY_IDENTIFIER VEL_ANG_PSTE ECU_ADDRESS 0x3fce28 BYTE_ORDER MSB_LAST FORMAT "%8.3" /end MEASUREMENT
/begin MEASUREMENT state_sens_ang_pste "status of wheel sensor" UBYTE _CNV_A_R_LINEAR_____1_CM 1 100. 0. 7. DISPLAY_IDENTIFIER STATE_SENS_ANG_PSTE ECU_ADDRESS 0x3fde5d FORMAT "%2.0" /end MEASUREMENT
/begin MEASUREMENT lv_var_pste "LV power steering detected - BN2000" UBYTE _CNV_S_2_RANGE______0_CM 1 100. 0. 1. DISPLAY_IDENTIFIER LV_VAR_PSTE ECU_ADDRESS 0x3fde5f /end MEASUREMENT
/begin MEASUREMENT ang_pste "sttering wheel sensor angle" SWORD _CNV_A_R_LINEAR_____100_CM 1 100. -1439.98976 1439.945815 DISPLAY_IDENTIFIER ANG_PSTE ECU_ADDRESS 0x3fce26 BYTE_ORDER MSB_LAST FORMAT "%8.3" /end MEASUREMENT
/begin MEASUREMENT lv_city "sttering wheel sensor angle" UBYTE _CNV_S_2_RANGE______0_CM 1 100. 0. 1. DISPLAY_IDENTIFIER LV_CITY ECU_ADDRESS 0x3fde6b /end MEASUREMENT
/begin MEASUREMENT tqi_slow_amt_req_can "torque request (slow) SSG via CAN" UBYTE _CNV_A_R_LINEAR_____10_CM 1 100. 0. 99.609375 DISPLAY_IDENTIFIER TQI_SLOW_AMT_REQ_CAN ECU_ADDRESS 0x3fde67 FORMAT "%5.1" /end MEASUREMENT
/begin MEASUREMENT tqi_amt_req " torque request SSG" SWORD _CNV_A_R_LINEAR_____55_CM 1 100. -1024. 1023.96875 DISPLAY_IDENTIFIER TQI_AMT_REQ ECU_ADDRESS 0x3fce34 BYTE_ORDER MSB_LAST FORMAT "%8.2" /end MEASUREMENT
/begin MEASUREMENT tqi_slow_amt_req " torque request (slow) SSG" SWORD _CNV_A_R_LINEAR_____55_CM 1 100. -1024. 1023.96875 DISPLAY_IDENTIFIER TQI_SLOW_AMT_REQ ECU_ADDRESS 0x3fce36 BYTE_ORDER MSB_LAST FORMAT "%8.2" /end MEASUREMENT
/begin MEASUREMENT tqi_amt_req_can "torque requested SSG via CAN" UBYTE _CNV_A_R_LINEAR_____10_CM 1 100. 0. 99.609375 DISPLAY_IDENTIFIER TQI_AMT_REQ_CAN ECU_ADDRESS 0x3fde66 FORMAT "%5.1" /end MEASUREMENT
/begin MEASUREMENT tqi_amt_cpl_can "complement SSG via CAN" UBYTE _CNV_A_R_LINEAR_____10_CM 1 100. 0. 99.609375 DISPLAY_IDENTIFIER TQI_AMT_CPL_CAN ECU_ADDRESS 0x3fde68 FORMAT "%5.1" /end MEASUREMENT
/begin MEASUREMENT tcc_can_amt_1 "alive counter SSG" UBYTE _CNV_A_R_LINEAR_____22_CM 1 100. 0. 14. DISPLAY_IDENTIFIER TCC_CAN_AMT_1 ECU_ADDRESS 0x3fde6a FORMAT "%2.0" /end MEASUREMENT
/begin MEASUREMENT state_amt_obd_err "status OBD-relevant error - AMT" UBYTE _CNV_S_3_STATE_ETCU_74_CM 1 100. 0. 2. DISPLAY_IDENTIFIER STATE_AMT_OBD_ERR ECU_ADDRESS 0x3fde63 /end MEASUREMENT
/begin MEASUREMENT state_amt "status shift-process AMT via CAN" UBYTE _CNV_S_5_STATE_AMT_104_CM 1 100. 0. 7. DISPLAY_IDENTIFIER STATE_AMT ECU_ADDRESS 0x3fde65 /end MEASUREMENT
/begin MEASUREMENT state_clu_amt "status shift-process AMT via CAN" UBYTE _CNV_S_5_STATE_CLU__105_CM 1 100. 0. 7. DISPLAY_IDENTIFIER STATE_CLU_AMT ECU_ADDRESS 0x3fde69 /end MEASUREMENT
/begin MEASUREMENT lv_tq_amt_dec_req "logical variable indicating torque decrease due to AMT intervention" UBYTE _CNV_S_2_RANGE______0_CM 1 100. 0. 1. DISPLAY_IDENTIFIER LV_TQ_AMT_DEC_REQ ECU_ADDRESS 0x3fde70 /end MEASUREMENT
/begin MEASUREMENT lv_tq_amt_inc_req "logical variable indicating torque increase due to AMT intervention" UBYTE _CNV_S_2_RANGE______0_CM 1 100. 0. 1. DISPLAY_IDENTIFIER LV_TQ_AMT_INC_REQ ECU_ADDRESS 0x3fde71 /end MEASUREMENT
/begin MEASUREMENT n_max_amt_can "engine speed limit AMT via CAN" UWORD _CNV_A_R_LINEAR_____11_CM 1 100. 0. 8160. DISPLAY_IDENTIFIER N_MAX_AMT_CAN ECU_ADDRESS 0x3fce38 BYTE_ORDER MSB_LAST FORMAT "%4.0" /end MEASUREMENT
/begin MEASUREMENT lv_amt_es "LV indicating engine stop via CAN" UBYTE _CNV_S_2_RANGE______0_CM 1 100. 0. 1. DISPLAY_IDENTIFIER LV_AMT_ES ECU_ADDRESS 0x3fde6d /end MEASUREMENT
/begin MEASUREMENT lv_gs "LV indicating GS - AMT" UBYTE _CNV_S_2_RANGE______0_CM 1 100. 0. 1. DISPLAY_IDENTIFIER LV_GS ECU_ADDRESS 0x3fde6c /end MEASUREMENT
/begin MEASUREMENT lv_gp "LV  indicating mode gearbox - AMT" UBYTE _CNV_S_2_RANGE______0_CM 1 100. 0. 1. DISPLAY_IDENTIFIER LV_GP ECU_ADDRESS 0x3fde6e /end MEASUREMENT
/begin MEASUREMENT state_amt_obd "status OBD gearbox" UBYTE _CNV_S_9_STATE_ETCU_93_CM 1 100. 0. 15. DISPLAY_IDENTIFIER STATE_AMT_OBD ECU_ADDRESS 0x3fde64 /end MEASUREMENT
/begin MEASUREMENT lv_pump_amt_on "LV  indicating status of hydraulic pump - AMT" UBYTE _CNV_S_2_RANGE______0_CM 1 100. 0. 1. DISPLAY_IDENTIFIER LV_PUMP_AMT_ON ECU_ADDRESS 0x3fde6f /end MEASUREMENT
/begin MEASUREMENT lv_var_amt "SSG transmission recognized" UBYTE _CNV_S_2_RANGE______0_CM 1 100. 0. 1. DISPLAY_IDENTIFIER LV_VAR_AMT ECU_ADDRESS 0x3fde72 /end MEASUREMENT
/begin MEASUREMENT state_txu_cr "Current range state" UBYTE _CNV_A_R_LINEAR_____1_CM 1 100. 0. 7. DISPLAY_IDENTIFIER STATE_TXU_CR ECU_ADDRESS 0x3fde79 FORMAT "%2.0" /end MEASUREMENT
/begin MEASUREMENT state_txu_tr "Target range state" UBYTE _CNV_A_R_LINEAR_____1_CM 1 100. 0. 7. DISPLAY_IDENTIFIER STATE_TXU_TR ECU_ADDRESS 0x3fde7b FORMAT "%2.0" /end MEASUREMENT
/begin MEASUREMENT state_txu_err "TXU error status" UBYTE _CNV_A_R_LINEAR_____1_CM 1 100. 0. 15. DISPLAY_IDENTIFIER STATE_TXU_ERR ECU_ADDRESS 0x3fde7c FORMAT "%2.0" /end MEASUREMENT
/begin MEASUREMENT state_txu "TXU status" UBYTE _CNV_A_R_LINEAR_____1_CM 1 100. 0. 15. DISPLAY_IDENTIFIER STATE_TXU ECU_ADDRESS 0x3fde7d FORMAT "%2.0" /end MEASUREMENT
/begin MEASUREMENT state_txu_mt "status manual transmission" UBYTE _CNV_A_R_LINEAR_____1_CM 1 100. 0. 1. DISPLAY_IDENTIFIER STATE_TXU_MT ECU_ADDRESS 0x3fde7f FORMAT "%2.0" /end MEASUREMENT
/begin MEASUREMENT txu_wal "Warning light transfer case control unit" UBYTE _CNV_A_R_LINEAR_____1_CM 1 100. 0. 1. DISPLAY_IDENTIFIER TXU_WAL ECU_ADDRESS 0x3fde80 FORMAT "%2.0" /end MEASUREMENT
/begin MEASUREMENT txu_disp_cogs_sum "Display transfer case cogs" UBYTE _CNV_A_R_LINEAR_____1_CM 1 100. 0. 3. DISPLAY_IDENTIFIER TXU_DISP_COGS_SUM ECU_ADDRESS 0x3fde81 FORMAT "%2.0" /end MEASUREMENT
/begin MEASUREMENT txu_disp_rng_sum "Display transfer case range" UBYTE _CNV_A_R_LINEAR_____1_CM 1 100. 0. 3. DISPLAY_IDENTIFIER TXU_DISP_RNG_SUM ECU_ADDRESS 0x3fde82 FORMAT "%2.0" /end MEASUREMENT
/begin MEASUREMENT txu_disp_gear_sum "Display transfer case gear" UBYTE _CNV_A_R_LINEAR_____1_CM 1 100. 0. 15. DISPLAY_IDENTIFIER TXU_DISP_GEAR_SUM ECU_ADDRESS 0x3fde83 FORMAT "%2.0" /end MEASUREMENT
/begin MEASUREMENT tqi_txu "Torque override for TXU function" UBYTE _CNV_A_R_LINEAR_____10_CM 1 100. 0. 99.609375 DISPLAY_IDENTIFIER TQI_TXU ECU_ADDRESS 0x3fde7e FORMAT "%5.2" /end MEASUREMENT
/begin MEASUREMENT lv_cs "Boolean for clutch switch detection" UBYTE _CNV_S_2_RANGE______0_CM 1 100. 0. 1. DISPLAY_IDENTIFIER LV_CS ECU_ADDRESS 0x3fe210 BIT_MASK 0x1 /end MEASUREMENT
/begin MEASUREMENT lv_ct "Logical variable detection of driver passive" UBYTE _CNV_S_2_RANGE______0_CM 1 100. 0. 1. DISPLAY_IDENTIFIER LV_CT ECU_ADDRESS 0x3fe212 BIT_MASK 0x1 /end MEASUREMENT
/begin CHARACTERISTIC c_fac_tq_req_clu_is_hys "Hysteresis on threshold on FAC_TQ_REQ_CLU_for IS detection" VALUE 0x015a8 _REC_VAL_20_u2 1.99996948 _CNV_A_R_LINEAR_____21_CM 0. 1.99996948 DISPLAY_IDENTIFIER C_FAC_TQ_REQ_CLU_IS_HYS FORMAT "%7.5" /end CHARACTERISTIC
/begin CHARACTERISTIC ip_fac_tq_req_clu_is__n_32 "Threshold on FAC_TQ_REQ_CLU for IS detection" CURVE 0x01ad8 _REC_CUR_20_u2_u1 1.99996948 _CNV_A_R_LINEAR_____21_CM 0. 1.99996948 DISPLAY_IDENTIFIER IP_FAC_TQ_REQ_CLU_IS__N_32 FORMAT "%7.5"
 /begin AXIS_DESCR COM_AXIS n_32 _CNV_A_R_LINEAR_____16_CM 3 0. 8160. FORMAT "%4.0" AXIS_PTS_REF ldp_n_32__fac_tq_req_clu_is /end AXIS_DESCR
/end CHARACTERISTIC
/begin AXIS_PTS ldp_n_32__fac_tq_req_clu_is "" 0x0102a n_32 _REC_AXS_20_u1 8160. _CNV_A_R_LINEAR_____16_CM 3 0. 8160. DISPLAY_IDENTIFIER LDP_N_32__FAC_TQ_REQ_CLU_IS FORMAT "%4.0" /end AXIS_PTS
/begin MEASUREMENT lv_dt "Logical variable drive train engaged" UBYTE _CNV_S_2_RANGE______0_CM 1 100. 0. 1. DISPLAY_IDENTIFIER LV_DT ECU_ADDRESS 0x3fe211 BIT_MASK 0x1 /end MEASUREMENT
/begin CHARACTERISTIC c_vs_min_dt "Threshold for vehicle running and drive-train closed detection " VALUE 0x00955 _REC_VAL_20_u1 255. _CNV_A_R_LINEAR_____23_CM 0. 255. DISPLAY_IDENTIFIER C_VS_MIN_DT FORMAT "%3.0" /end CHARACTERISTIC
/begin MEASUREMENT fast_ecu_tran_pwl_ctr "fast transition counter for transition from SYN_ENG_IGK_OFF to PWL despite engine running" UWORD _CNV_A_R_LINEAR_____4_CM 1 100. 0. 655.35 DISPLAY_IDENTIFIER FAST_ECU_TRAN_PWL_CTR ECU_ADDRESS 0x3fd334 BYTE_ORDER MSB_LAST FORMAT "%6.2" /end MEASUREMENT
/begin MEASUREMENT lv_ebr_det_act "Engine back rotation detection active" UBYTE _CNV_S_2_RANGE______0_CM 1 100. 0. 1. DISPLAY_IDENTIFIER LV_EBR_DET_ACT ECU_ADDRESS 0x3fe143 BIT_MASK 0x1 /end MEASUREMENT
/begin MEASUREMENT lv_ebr_det_cam "Engine back rotation detected by CAM_0" UBYTE _CNV_S_2_RANGE______0_CM 1 100. 0. 1. DISPLAY_IDENTIFIER LV_EBR_DET_CAM ECU_ADDRESS 0x3fe14e BIT_MASK 0x1 /end MEASUREMENT
/begin MEASUREMENT lv_ebr_det_tooth "Engine back rotation detected by tooth duration check" UBYTE _CNV_S_2_RANGE______0_CM 1 100. 0. 1. DISPLAY_IDENTIFIER LV_EBR_DET_TOOTH ECU_ADDRESS 0x3fe14f BIT_MASK 0x1 /end MEASUREMENT
/begin MEASUREMENT ctr_ebr_det_cam "Counter EBR detected by CAM_0" UBYTE _CNV_A_R_LINEAR_____1_CM 1 100. 0. 255. DISPLAY_IDENTIFIER CTR_EBR_DET_CAM ECU_ADDRESS 0x3fe144 FORMAT "%3.0" /end MEASUREMENT
/begin MEASUREMENT ctr_cam_plaus_fail "Counter CAM not plausible at synchronizations" UBYTE _CNV_A_R_LINEAR_____1_CM 1 100. 0. 255. DISPLAY_IDENTIFIER CTR_CAM_PLAUS_FAIL ECU_ADDRESS 0x3fe146 FORMAT "%3.0" /end MEASUREMENT
/begin MEASUREMENT ctr_ebr_det_tooth "Counter EBR detected by tooth duration check" UBYTE _CNV_A_R_LINEAR_____1_CM 1 100. 0. 255. DISPLAY_IDENTIFIER CTR_EBR_DET_TOOTH ECU_ADDRESS 0x3fe145 FORMAT "%3.0" /end MEASUREMENT
/begin MEASUREMENT t_ebr_sync_lock "Synchronization lock time caused by engine back rotation detection (CAM/TOOTH)" UBYTE _CNV_A_R_LINEAR_____4_CM 1 100. 0. 2.55 DISPLAY_IDENTIFIER T_EBR_SYNC_LOCK ECU_ADDRESS 0x3fe14b FORMAT "%4.2" /end MEASUREMENT
/begin MEASUREMENT t_ebr_tooth_max "Maximum allowed tooth time for detection of engine back rotation" UBYTE _CNV_A_R_LINEAR_____140_CM 1 100. 0. 255. DISPLAY_IDENTIFIER T_EBR_TOOTH_MAX ECU_ADDRESS 0x3fe148 FORMAT "%3.0" /end MEASUREMENT
/begin MEASUREMENT t_ebr_tooth_per "Calculated tooth time by sampling algorithm" UBYTE _CNV_A_R_LINEAR_____140_CM 1 100. 0. 255. DISPLAY_IDENTIFIER T_EBR_TOOTH_PER ECU_ADDRESS 0x3fe147 FORMAT "%3.0" /end MEASUREMENT
/begin MEASUREMENT t_ebr_es_sync_max "Engine stop time after EBR detection (CAM/TOOTH)" UWORD _CNV_A_R_LINEAR_____4_CM 1 100. 0. 655.35 DISPLAY_IDENTIFIER T_EBR_ES_SYNC_MAX ECU_ADDRESS 0x3fd336 BYTE_ORDER MSB_LAST FORMAT "%6.2" /end MEASUREMENT
/begin CHARACTERISTIC c_t_sync_lock_tooth "Synchronization lock time caused by engine back rotation (TOOTH)" VALUE 0x0083d _REC_VAL_20_u1 2.55 _CNV_A_R_LINEAR_____4_CM 0. 2.55 DISPLAY_IDENTIFIER C_T_SYNC_LOCK_TOOTH FORMAT "%4.2" /end CHARACTERISTIC
/begin CHARACTERISTIC c_crk_vld_tooth_sync_lock "Delay synchronization for this number of teeth after EBR is detected (CAM/TOOTH)" VALUE 0x0061f _REC_VAL_20_u1 52. _CNV_A_R_LINEAR_____1_CM 4. 56. DISPLAY_IDENTIFIER C_CRK_VLD_TOOTH_SYNC_LOCK FORMAT "%2.0" /end CHARACTERISTIC
/begin CHARACTERISTIC c_t_es_sync_max "Maximum engine stop time after EBR detection (CAM/TOOTH) then switching to default  sync parameters" VALUE 0x0184e _REC_VAL_20_u2 655.35 _CNV_A_R_LINEAR_____4_CM 0. 655.35 DISPLAY_IDENTIFIER C_T_ES_SYNC_MAX FORMAT "%5.2" /end CHARACTERISTIC
/begin CHARACTERISTIC lc_ebr_det_tooth "Detection of engine back rotation with tooth time (0 = inactive, 1 = active)" VALUE 0x00f10 _REC_VAL_20_u1 1. _CNV_A_R_LINEAR_____1_CM 0. 1. DISPLAY_IDENTIFIER LC_EBR_DET_TOOTH FORMAT "%2.0" /end CHARACTERISTIC
/begin CHARACTERISTIC lc_ebr_det_cam "Detection of engine back rotation with crk/cam plausibility (0 = inactive, 1 = active)" VALUE 0x00f0f _REC_VAL_20_u1 1. _CNV_A_R_LINEAR_____1_CM 0. 1. DISPLAY_IDENTIFIER LC_EBR_DET_CAM FORMAT "%2.0" /end CHARACTERISTIC
/begin CHARACTERISTIC c_t_sync_lock_cam "Synchronization lock time caused by engine back rotation (CAM)" VALUE 0x0083c _REC_VAL_20_u1 2.55 _CNV_A_R_LINEAR_____4_CM 0. 2.55 DISPLAY_IDENTIFIER C_T_SYNC_LOCK_CAM FORMAT "%4.2" /end CHARACTERISTIC
/begin CHARACTERISTIC c_cam_plaus_fail_max "MAx. trials for synchronization in case of wrong cam-level" VALUE 0x005fd _REC_VAL_20_u1 255. _CNV_A_R_LINEAR_____1_CM 0. 255. DISPLAY_IDENTIFIER C_CAM_PLAUS_FAIL_MAX FORMAT "%3.0" /end CHARACTERISTIC
/begin AXIS_PTS ldp_tco__t_tooth_max "" 0x01177 tco _REC_AXS_20_u1 190.5 _CNV_A_R_LINEAR_____12_CM 6 -48. 142.5 DISPLAY_IDENTIFIER LDP_TCO__T_TOOTH_MAX FORMAT "%5.1" /end AXIS_PTS
/begin AXIS_PTS ldp_vb__t_tooth_max "" 0x01265 tco _REC_AXS_20_u1 26. _CNV_A_R_LINEAR_____60_CM 6 0. 26. DISPLAY_IDENTIFIER LDP_VB__T_TOOTH_MAX FORMAT "%4.1" /end AXIS_PTS
/begin CHARACTERISTIC ip_t_tooth_max__vb_tco "Max. tooth-time for EBR detection" MAP 0x074db _REC_MAP_20_u1_u1_u1 255. _CNV_A_R_LINEAR_____140_CM 0. 255. DISPLAY_IDENTIFIER IP_T_TOOTH_MAX__VB_TCO FORMAT "%3.0"
 /begin AXIS_DESCR COM_AXIS tco _CNV_A_R_LINEAR_____60_CM 6 0. 26. FORMAT "%4.1" AXIS_PTS_REF ldp_vb__t_tooth_max /end AXIS_DESCR
 /begin AXIS_DESCR COM_AXIS tco _CNV_A_R_LINEAR_____12_CM 6 -48. 142.5 FORMAT "%5.1" AXIS_PTS_REF ldp_tco__t_tooth_max /end AXIS_DESCR
/end CHARACTERISTIC
/begin MEASUREMENT fup "fuel pressure value" UWORD _CNV_A_R_LINEAR_____199_CM 1 100. 0. 173888. DISPLAY_IDENTIFIER FUP ECU_ADDRESS 0x3fcf20 BYTE_ORDER MSB_LAST FORMAT "%6.0" /end MEASUREMENT
/begin CHARACTERISTIC c_fup_nom "Nominal fuel pressure" VALUE 0x015ce _REC_VAL_20_u2 5434. _CNV_A_R_LINEAR_____49_CM 0. 5434. DISPLAY_IDENTIFIER C_FUP_NOM FORMAT "%7.2" /end CHARACTERISTIC
/begin CHARACTERISTIC c_min_vs_ratio "Minimum engine speed / vehicle speed ratio calculation" VALUE 0x00730 _REC_VAL_20_u1 255. _CNV_A_R_LINEAR_____23_CM 0. 255. DISPLAY_IDENTIFIER C_MIN_VS_RATIO FORMAT "%3.0" /end CHARACTERISTIC
/begin CHARACTERISTIC id_gr_mt__n_vs_ratio "Index table for Gear Ratio detection" CURVE 0x03d63 _REC_CUR_20_u1_u1 255. _CNV_A_R_LINEAR_____1_CM 0. 255. DISPLAY_IDENTIFIER ID_GR_MT FORMAT "%3.0"
 /begin AXIS_DESCR COM_AXIS n_vs_ratio _CNV_A_R_LINEAR_____1_CM 13 0. 255. FORMAT "%3.0" AXIS_PTS_REF ldp_n_vs_ratio_gr_mt /end AXIS_DESCR
/end CHARACTERISTIC
/begin AXIS_PTS ldp_n_vs_ratio_gr_mt "" 0x07d23 n_vs_ratio _REC_AXS_20_u1 255. _CNV_A_R_LINEAR_____1_CM 13 0. 255. DISPLAY_IDENTIFIER LDP_N_VS_RATIO_GR_MT FORMAT "%3.0" /end AXIS_PTS
/begin CHARACTERISTIC lc_rng_l "Manual switch for low range detection" VALUE 0x00f6a _REC_VAL_20_u1 1. _CNV_A_R_LINEAR_____22_CM 0. 1. DISPLAY_IDENTIFIER LC_RNG_L FORMAT "%1.0" /end CHARACTERISTIC
/begin MEASUREMENT gr_mt "Manual transmission gear ratio" UBYTE _CNV_A_R_LINEAR_____1_CM 1 100. 0. 255. DISPLAY_IDENTIFIER GR_MT ECU_ADDRESS 0x3fe207 FORMAT "%3.0" /end MEASUREMENT
/begin MEASUREMENT gr_at "Automatic transmission gear ratio" UBYTE _CNV_A_R_LINEAR_____1_CM 1 100. 0. 255. DISPLAY_IDENTIFIER GR_AT ECU_ADDRESS 0x3fe208 FORMAT "%3.0" /end MEASUREMENT
/begin MEASUREMENT lv_rng_l "Logical variable for engaged low range" UBYTE _CNV_S_2_RANGE______0_CM 1 100. 0. 1. DISPLAY_IDENTIFIER LV_RNG_L ECU_ADDRESS 0x3fe20c /end MEASUREMENT
/begin MEASUREMENT lv_dri "Logical variable for engaged drive" UBYTE _CNV_S_2_RANGE______0_CM 1 100. 0. 1. DISPLAY_IDENTIFIER LV_DRI ECU_ADDRESS 0x3fe20d BIT_MASK 0x1 /end MEASUREMENT
/begin MEASUREMENT gear "" UBYTE _CNV_A_R_LINEAR_____1_CM 1 100. 0. 255. DISPLAY_IDENTIFIER GEAR ECU_ADDRESS 0x3fe209 FORMAT "%3.0" /end MEASUREMENT
/begin MEASUREMENT gear_ef "Gear ratio used for exhaust flap functionality" UBYTE _CNV_A_R_LINEAR_____1_CM 1 100. 0. 255. DISPLAY_IDENTIFIER GEAR_EF ECU_ADDRESS 0x3fe20a FORMAT "%3.0" /end MEASUREMENT
/begin MEASUREMENT state_gear_rev_at_amt "AT/AMT reverse gear (activ = 1, inactive = 0)" UBYTE _CNV_S_2_RANGE______0_CM 1 100. 0. 1. DISPLAY_IDENTIFIER STATE_GEAR_REV_AT_AMT ECU_ADDRESS 0x3fe20b /end MEASUREMENT
/begin MEASUREMENT n_vs_ratio "Engine speed / vehicle speed ratio" UBYTE _CNV_A_R_LINEAR_____200_CM 1 100. 0. 255. DISPLAY_IDENTIFIER N_VS_RATIO ECU_ADDRESS 0x3fe20e FORMAT "%3.0" /end MEASUREMENT
/begin MEASUREMENT fac_gr "Factor for setpoint/actual reduction ratio of rear axle" UWORD _CNV_A_R_LINEAR_____21_CM 1 100. 0. 1.99996948 DISPLAY_IDENTIFIER FAC_GR ECU_ADDRESS 0x3fd35c BYTE_ORDER MSB_LAST FORMAT "%7.5" /end MEASUREMENT
/begin MEASUREMENT fac_gr_mmv_av "Rear axle ratio adaptation value" UWORD _CNV_A_R_LINEAR_____21_CM 1 100. 0. 1.99996948 DISPLAY_IDENTIFIER FAC_GR_MMV_AV ECU_ADDRESS 0x3fd35a BYTE_ORDER MSB_LAST FORMAT "%7.5" /end MEASUREMENT
/begin MEASUREMENT gr_rax_av "Current rear axle ratio" UWORD _CNV_A_R_LINEAR_____123_CM 1 100. 0. 255.996094 DISPLAY_IDENTIFIER GR_RAX_AV ECU_ADDRESS 0x3fd35e BYTE_ORDER MSB_LAST FORMAT "%7.3" /end MEASUREMENT
/begin CHARACTERISTIC c_gr_rax_sp "Rear axle ratio of standard rear axle" VALUE 0x015d0 _REC_VAL_20_u2 255.996094 _CNV_A_R_LINEAR_____123_CM 0. 255.996094 DISPLAY_IDENTIFIER C_GR_RAX_SP FORMAT "%7.3" /end CHARACTERISTIC
/begin CHARACTERISTIC c_crlc_fac_gr "Correlation constant for adaptation of the rear axle" VALUE 0x0062a _REC_VAL_20_u1 0.9960940000000002 _CNV_A_R_LINEAR_____50_CM 0. 0.996094 DISPLAY_IDENTIFIER C_CRLC_FAC_GR FORMAT "%5.3" /end CHARACTERISTIC
/begin CHARACTERISTIC c_n_vs_cru_gear2_puc_sp "N/VS ratio in case of PUC in 2nd gear with standard rear axle" VALUE 0x0078f _REC_VAL_20_u1 255. _CNV_A_R_LINEAR_____200_CM 0. 255. DISPLAY_IDENTIFIER C_N_VS_CRU_GEAR2_PUC_SP FORMAT "%3.0" /end CHARACTERISTIC
/begin CHARACTERISTIC c_n_vs_cru_grd_fac_gr_max "Gradient of N/VS ratio below which FAC_GR is adapted" VALUE 0x00790 _REC_VAL_20_u1 255. _CNV_A_R_LINEAR_____200_CM 0. 255. DISPLAY_IDENTIFIER C_N_VS_CRU_GRD_FAC_GR_MAX FORMAT "%3.0" /end CHARACTERISTIC
/begin MEASUREMENT lv_err_bn_tq_etcu "Present error BN2000" UBYTE _CNV_S_2_RANGE______2_R_CM 1 100. 0. 255. DISPLAY_IDENTIFIER LV_ERR_BN_TQ_ETCU ECU_ADDRESS 0x3fbadc /end MEASUREMENT
/begin CHARACTERISTIC ip_fac_ivvt__vo "relative wave overlap" CURVE 0x00b1b _REC_CUR_20_u1_u1 3.984375 _CNV_A_R_LINEAR_____127_CM 0. 3.984375 DISPLAY_IDENTIFIER IP_FAC_IVVT__VO FORMAT "%4.2"
 /begin AXIS_DESCR COM_AXIS vo _CNV_A_R_LINEAR_____82_CM 8 0. 95.625 FORMAT "%5.2" AXIS_PTS_REF ldp_vo_fac_ivvt /end AXIS_DESCR
/end CHARACTERISTIC
/begin MEASUREMENT vo_min "valve overlap minimum" UBYTE _CNV_A_R_LINEAR_____82_CM 1 100. 0. 95.625 DISPLAY_IDENTIFIER VO_MIN ECU_ADDRESS 0x3fdfc8 FORMAT "%5.2" /end MEASUREMENT
/begin MEASUREMENT vo_max "valve overlap maximum" UBYTE _CNV_A_R_LINEAR_____82_CM 1 100. 0. 95.625 DISPLAY_IDENTIFIER VO_MAX ECU_ADDRESS 0x3fdfc9 FORMAT "%5.2" /end MEASUREMENT
/begin MEASUREMENT cam_av_mv_in "Average value inlet-CAM position" SWORD _CNV_A_R_LINEAR_____227_CM 1 100. -768. 767.9765625 DISPLAY_IDENTIFIER CAM_AV_MV_IN ECU_ADDRESS 0x3fd044 BYTE_ORDER MSB_LAST FORMAT "%7.2" /end MEASUREMENT
/begin MEASUREMENT maf_ivvt "Feedback free engine load for IVVT setpoint calculation - filtered" UWORD _CNV_A_R_LINEAR_____106_CM 1 100. 0. 1389. DISPLAY_IDENTIFIER MAF_IVVT ECU_ADDRESS 0x3fd042 BYTE_ORDER MSB_LAST FORMAT "%7.2" /end MEASUREMENT
/begin MEASUREMENT fac_ivvt "value representing the relative valve overlap" UBYTE _CNV_A_R_LINEAR_____157_CM 1 100. 0. 3.984375 DISPLAY_IDENTIFIER FAC_IVVT ECU_ADDRESS 0x3fdfcc FORMAT "%4.2" /end MEASUREMENT
/begin MEASUREMENT vo_sp "valve overlap setpoint" UBYTE _CNV_A_R_LINEAR_____82_CM 1 100. 0. 95.625 DISPLAY_IDENTIFIER VO_SP ECU_ADDRESS 0x3fdfca FORMAT "%5.2" /end MEASUREMENT
/begin MEASUREMENT vo_sp_ref "valve overlap setpoint at reference conditions (warm engine)" UBYTE _CNV_A_R_LINEAR_____82_CM 1 100. 0. 95.625 DISPLAY_IDENTIFIER VO_SP_REF ECU_ADDRESS 0x3fdfcb FORMAT "%5.2" /end MEASUREMENT
/begin AXIS_PTS ldp_vo_fac_ivvt "" 0x07eed vo _REC_AXS_20_u1 95.625 _CNV_A_R_LINEAR_____82_CM 8 0. 95.625 DISPLAY_IDENTIFIER LDP_VO_FAC_IVVT FORMAT "%5.2" /end AXIS_PTS
/begin AXIS_PTS ldp_n_32__crlc_maf_ivvt "" 0x01016 n_32 _REC_AXS_20_u1 816. _CNV_A_R_LINEAR_____16_CM 6 0. 8160. DISPLAY_IDENTIFIER LDP_N_32__CRLC_MAF_IVVT FORMAT "%4.0" /end AXIS_PTS
/begin AXIS_PTS ldp_maf_sp__crlc_maf_ivvt "" 0x10da0 maf_sp_tqi _REC_AXS_20_u2 1389. _CNV_A_R_LINEAR_____106_CM 6 0. 1389. DISPLAY_IDENTIFIER LDP_MAF_SP__CRLC_MAF_IVVT FORMAT "%7.2" /end AXIS_PTS
/begin CHARACTERISTIC ip_crlc_maf_ivvt__n__maf_sp "Correlation constant for filtering of MAF_IVVT" MAP 0x04a2a _REC_MAP_20_u1_u1_u2 0.9960940000000002 _CNV_A_R_LINEAR_____50_CM 0. 0.996094 DISPLAY_IDENTIFIER IP_CRLC_MAF_IVVT__N__MAF_SP FORMAT "%5.3"
 /begin AXIS_DESCR COM_AXIS n_32 _CNV_A_R_LINEAR_____16_CM 6 0. 8160. FORMAT "%4.0" AXIS_PTS_REF ldp_n_32__crlc_maf_ivvt /end AXIS_DESCR
 /begin AXIS_DESCR COM_AXIS maf_sp_tqi _CNV_A_R_LINEAR_____106_CM 6 0. 1389. FORMAT "%7.2" AXIS_PTS_REF ldp_maf_sp__crlc_maf_ivvt /end AXIS_DESCR
/end CHARACTERISTIC
/begin CHARACTERISTIC c_cam_op_ex "outlet valves total opening angle" VALUE 0x005fb _REC_VAL_20_u1 95.625 _CNV_A_R_LINEAR_____247_CM 175. 270.625 DISPLAY_IDENTIFIER C_CAM_OP_EX FORMAT "%5.1" /end CHARACTERISTIC
/begin CHARACTERISTIC c_cam_op_in "inlet valves total opening angle" VALUE 0x005fc _REC_VAL_20_u1 95.625 _CNV_A_R_LINEAR_____247_CM 175. 270.625 DISPLAY_IDENTIFIER C_CAM_OP_IN FORMAT "%5.1" /end CHARACTERISTIC
/begin CHARACTERISTIC c_cam_adj_rng_max_in "adjustment range of inlet camshaft" VALUE 0x005eb _REC_VAL_20_u1 60. _CNV_A_R_LINEAR_____82_CM 0. 60. DISPLAY_IDENTIFIER C_CAM_ADJ_RNG_MAX_IN FORMAT "%4.1" /end CHARACTERISTIC
/begin CHARACTERISTIC c_cam_adj_rng_max_ex "adjustment range of exhaust camshaft" VALUE 0x005ea _REC_VAL_20_u1 60. _CNV_A_R_LINEAR_____82_CM 0. 60. DISPLAY_IDENTIFIER C_CAM_ADJ_RNG_MAX_EX FORMAT "%4.1" /end CHARACTERISTIC
/begin MEASUREMENT vo "moving mean value of actual valve overlap" UBYTE _CNV_A_R_LINEAR_____82_CM 1 100. 0. 95.625 DISPLAY_IDENTIFIER VO ECU_ADDRESS 0x3fdfc7 FORMAT "%5.2" /end MEASUREMENT
/begin MEASUREMENT vo_bas "actual valve overlap" UBYTE _CNV_A_R_LINEAR_____82_CM 1 100. 0. 95.625 DISPLAY_IDENTIFIER VO_BAS ECU_ADDRESS 0x3fdfc6 FORMAT "%5.2" /end MEASUREMENT
/begin CHARACTERISTIC c_crlc_vo_mmv "Correlation constant for filtering VO" VALUE 0x00644 _REC_VAL_20_u1 0.9960940000000002 _CNV_A_R_LINEAR_____50_CM 0. 0.996094 DISPLAY_IDENTIFIER C_CRLC_VO_MMV FORMAT "%5.3" /end CHARACTERISTIC
/begin MEASUREMENT lam_bank_1.ls_up.vls_up "Upstream oxygen sensor voltage" UWORD _CNV_A_R_LINEAR_____3_CM 1 100. 0. 4.99511719 DISPLAY_IDENTIFIER VLS_UP_1 ECU_ADDRESS 0x3fc418 BYTE_ORDER MSB_LAST FORMAT "%5.3" /end MEASUREMENT
/begin MEASUREMENT lam_bank_2.ls_up.vls_up "Upstream oxygen sensor voltage" UWORD _CNV_A_R_LINEAR_____3_CM 1 100. 0. 4.99511719 DISPLAY_IDENTIFIER VLS_UP_2 ECU_ADDRESS 0x3fc77c BYTE_ORDER MSB_LAST FORMAT "%5.3" /end MEASUREMENT
/begin MEASUREMENT maf_mdl "Deviation of model air mass flow" UWORD _CNV_A_R_LINEAR_____113_CM 1 100. 0. 2047.96875 DISPLAY_IDENTIFIER MAF_MDL ECU_ADDRESS 0x3fcfce BYTE_ORDER MSB_LAST FORMAT "%7.2" /end MEASUREMENT
/begin MEASUREMENT map_mdl "Deviation between measured and callculated manifold pressure" UWORD _CNV_A_R_LINEAR_____49_CM 1 100. 0. 5434. DISPLAY_IDENTIFIER MAP_MDL ECU_ADDRESS 0x3fcfd0 BYTE_ORDER MSB_LAST FORMAT "%7.2" /end MEASUREMENT
/begin CHARACTERISTIC c_crlc_amp_ad "Correlation constants for the ambient pressure Adaptation" VALUE 0x00620 _REC_VAL_20_u1 0.9960940000000002 _CNV_A_R_LINEAR_____50_CM 0. 0.996094 DISPLAY_IDENTIFIER C_CRLC_AMP_AD FORMAT "%5.3" /end CHARACTERISTIC
/begin CHARACTERISTIC c_tco_thd_amp_ad "Threshold of TCO in case of no working load sensor" VALUE 0x008a9 _REC_VAL_20_u1 190.5 _CNV_A_R_LINEAR_____12_CM -48. 142.5 DISPLAY_IDENTIFIER C_TCO_THD_AMP_AD FORMAT "%5.1" /end CHARACTERISTIC
/begin MEASUREMENT amp "Ambient pressure (measured or adapted)" UWORD _CNV_A_R_LINEAR_____49_CM 1 100. 0. 5434. DISPLAY_IDENTIFIER AMP ECU_ADDRESS 0x3fcfb0 BYTE_ORDER MSB_LAST FORMAT "%7.2" /end MEASUREMENT
/begin MEASUREMENT amp_mdl_dif_i_mmv "Moving mean I-value of the closed loop control of ambient pressure" SWORD _CNV_A_R_LINEAR_____108_CM 1 100. -2717.04 2716.96 DISPLAY_IDENTIFIER AMP_MDL_DIF_I_MMV ECU_ADDRESS 0x3fcfb6 BYTE_ORDER MSB_LAST FORMAT "%8.2" /end MEASUREMENT
/begin MEASUREMENT amp_mdl_dif_i "I-value of the closed loop control of ambient pressure" SWORD _CNV_A_R_LINEAR_____334_CM 1 100. -339.625 339.614635 DISPLAY_IDENTIFIER AMP_MDL_DIF_I ECU_ADDRESS 0x3fcfb4 BYTE_ORDER MSB_LAST FORMAT "%7.2" /end MEASUREMENT
/begin MEASUREMENT amp_mdl_dif_p "P-value of the closed loop control of ambient pressure" SWORD _CNV_A_R_LINEAR_____108_CM 1 100. -2717.04 2716.96 DISPLAY_IDENTIFIER AMP_MDL_DIF_P ECU_ADDRESS 0x3fcfe0 BYTE_ORDER MSB_LAST FORMAT "%8.2" /end MEASUREMENT
/begin MEASUREMENT amp_estim "Estimated ambient pressure" UWORD _CNV_A_R_LINEAR_____49_CM 1 100. 0. 5434. DISPLAY_IDENTIFIER AMP_ESTIM ECU_ADDRESS 0x3fcfde BYTE_ORDER MSB_LAST FORMAT "%7.2" /end MEASUREMENT
/begin MEASUREMENT amp_ad_dif "Change of the adapted ambient pressure" SWORD _CNV_A_R_LINEAR_____108_CM 1 100. -2717.04 2716.96 DISPLAY_IDENTIFIER AMP_AD_DIF ECU_ADDRESS 0x3fcfdc BYTE_ORDER MSB_LAST FORMAT "%8.2" /end MEASUREMENT
/begin MEASUREMENT amp_ad "Adapted ambient pressure" UWORD _CNV_A_R_LINEAR_____49_CM 1 100. 0. 5434. DISPLAY_IDENTIFIER AMP_AD ECU_ADDRESS 0x3fcfb8 BYTE_ORDER MSB_LAST FORMAT "%7.2" /end MEASUREMENT
/begin MEASUREMENT ar_red_bas_mmv "Moving mean value of the basic reduced area" UWORD _CNV_A_R_LINEAR_____333_CM 1 100. 0. 58.592855 DISPLAY_IDENTIFIER AR_RED_BAS_MMV ECU_ADDRESS 0x3fcfe6 BYTE_ORDER MSB_LAST FORMAT "%7.4" /end MEASUREMENT
/begin MEASUREMENT maf_kgh_mmv "Moving mean value of the mass air flow" UWORD _CNV_A_R_LINEAR_____113_CM 1 100. 0. 2047.96875 DISPLAY_IDENTIFIER MAF_KGH_MMV ECU_ADDRESS 0x3fcfe8 BYTE_ORDER MSB_LAST FORMAT "%7.2" /end MEASUREMENT
/begin MEASUREMENT seg_ctr_amp_ad_pl "Segment counter for ambient pressure Adaptation during part load" UWORD _CNV_A_R_LINEAR_____1_CM 1 100. 0. 65535. DISPLAY_IDENTIFIER SEG_CTR_AMP_AD_PL ECU_ADDRESS 0x3fcfe2 BYTE_ORDER MSB_LAST FORMAT "%5.0" /end MEASUREMENT
/begin CHARACTERISTIC c_amp_ad_pl_hys "hyteresis for ambient pressure Adaptation during part load" VALUE 0x0147a _REC_VAL_20_u2 5434. _CNV_A_R_LINEAR_____49_CM 0. 5434. DISPLAY_IDENTIFIER C_AMP_AD_PL_HYS FORMAT "%7.2" /end CHARACTERISTIC
/begin CHARACTERISTIC c_amp_ad_dif_neg "Negative correction of the ambient pressure Adaptation during part load" VALUE 0x003a0 _REC_VAL_20_s2 5434. _CNV_A_R_LINEAR_____108_CM -2717.04 2716.96 DISPLAY_IDENTIFIER C_AMP_AD_DIF_NEG FORMAT "%8.2" /end CHARACTERISTIC
/begin CHARACTERISTIC c_amp_ad_dif_pos "Positive correction of the ambient pressure Adaptation during part load" VALUE 0x003a2 _REC_VAL_20_s2 5434. _CNV_A_R_LINEAR_____108_CM -2717.04 2716.96 DISPLAY_IDENTIFIER C_AMP_AD_DIF_POS FORMAT "%8.2" /end CHARACTERISTIC
/begin CHARACTERISTIC c_amp_dif_ti_lam_pos "positive correction of the ambient pressure Adaptation with lambda controller" VALUE 0x003a6 _REC_VAL_20_s2 5434. _CNV_A_R_LINEAR_____108_CM -2717.04 2716.96 DISPLAY_IDENTIFIER C_AMP_DIF_TI_LAM_POS FORMAT "%8.2" /end CHARACTERISTIC
/begin CHARACTERISTIC c_amp_max "maximum value for ambient pressure" VALUE 0x01486 _REC_VAL_20_u2 5434. _CNV_A_R_LINEAR_____49_CM 0. 5434. DISPLAY_IDENTIFIER C_AMP_MAX FORMAT "%7.2" /end CHARACTERISTIC
/begin CHARACTERISTIC c_amp_min " minimum value for ambient pressure" VALUE 0x01488 _REC_VAL_20_u2 5434. _CNV_A_R_LINEAR_____49_CM 0. 5434. DISPLAY_IDENTIFIER C_AMP_MIN FORMAT "%7.2" /end CHARACTERISTIC
/begin CHARACTERISTIC c_amp_ini "initial value for the ambient pressure" VALUE 0x01484 _REC_VAL_20_u2 5434. _CNV_A_R_LINEAR_____49_CM 0. 5434. DISPLAY_IDENTIFIER C_AMP_INI FORMAT "%7.2" /end CHARACTERISTIC
/begin CHARACTERISTIC c_amp_i_1 "I -value for the ambient pressure correction (LV_MAF_CTL = 1)" VALUE 0x01480 _REC_VAL_20_u2 7293750. _CNV_A_R_LINEAR_____335_CM 0. 7293750. DISPLAY_IDENTIFIER C_AMP_I_1 FORMAT "%8.0" /end CHARACTERISTIC
/begin CHARACTERISTIC c_amp_dif_ti_lam_neg "Negative correction of the ambient pressure Adaptation with lambda controller" VALUE 0x003a4 _REC_VAL_20_s2 5434. _CNV_A_R_LINEAR_____108_CM -2717.04 2716.96 DISPLAY_IDENTIFIER C_AMP_DIF_TI_LAM_NEG FORMAT "%8.2" /end CHARACTERISTIC
/begin CHARACTERISTIC c_amp_mdl_dif_i_min "Lower threshold of integral part of pressure controller" VALUE 0x003aa _REC_VAL_20_s2 679.239635 _CNV_A_R_LINEAR_____334_CM -339.625 339.614635 DISPLAY_IDENTIFIER C_AMP_MDL_DIF_I_MIN FORMAT "%7.2" /end CHARACTERISTIC
/begin CHARACTERISTIC c_amp_p_1 "P - Value for ambient pressure control (LV_MAF_CTL = 1)" VALUE 0x01490 _REC_VAL_20_u2 42.51956000000001 _CNV_A_R_LINEAR_____336_CM 0. 42.51956 DISPLAY_IDENTIFIER C_AMP_P_1 FORMAT "%8.5" /end CHARACTERISTIC
/begin CHARACTERISTIC c_amp_p_2 "P - Value for ambient pressure control (LV_MAP_CTL = 1)" VALUE 0x01492 _REC_VAL_20_u2 0.99998474 _CNV_A_R_LINEAR_____37_CM 0. 0.99998474 DISPLAY_IDENTIFIER C_AMP_P_2 FORMAT "%7.5" /end CHARACTERISTIC
/begin CHARACTERISTIC c_crlc_maf_kgh_amp_ad_pl "correlation constant for moving mean value calculation of MAF_KGH" VALUE 0x00631 _REC_VAL_20_u1 0.9960940000000002 _CNV_A_R_LINEAR_____50_CM 0. 0.996094 DISPLAY_IDENTIFIER C_CRLC_MAF_KGH_AMP_AD_PL FORMAT "%5.3" /end CHARACTERISTIC
/begin CHARACTERISTIC c_crlc_amp_mdl_dif_i_mmv "Correlation constant for moving mean value calculation of AMP_MDL_DIF_I" VALUE 0x00621 _REC_VAL_20_u1 0.9960940000000002 _CNV_A_R_LINEAR_____50_CM 0. 0.996094 DISPLAY_IDENTIFIER C_CRLC_AMP_MDL_DIF_I_MMV FORMAT "%5.3" /end CHARACTERISTIC
/begin CHARACTERISTIC c_map_drv1_max_amp_ad_pl "maximum value of the first derivative of manifold pressure for ambient pressure Adaptation part load" VALUE 0x016be _REC_VAL_20_u2 82.91626000000001 _CNV_A_R_LINEAR_____337_CM 0. 82.91625999999999 DISPLAY_IDENTIFIER C_MAP_DRV1_MAX_AMP_AD_PL FORMAT "%5.3" /end CHARACTERISTIC
/begin CHARACTERISTIC c_n_amp_ad_min "Minimum engine speed for ambient pressure learning" VALUE 0x00756 _REC_VAL_20_u1 8160. _CNV_A_R_LINEAR_____16_CM 0. 8160. DISPLAY_IDENTIFIER C_N_AMP_AD_MIN FORMAT "%4.0" /end CHARACTERISTIC
/begin CHARACTERISTIC c_n_amp_ad_max "Maximum engine speed for ambient pressure learning" VALUE 0x00755 _REC_VAL_20_u1 8160. _CNV_A_R_LINEAR_____16_CM 0. 8160. DISPLAY_IDENTIFIER C_N_AMP_AD_MAX FORMAT "%4.0" /end CHARACTERISTIC
/begin CHARACTERISTIC c_n_min_amp_ad_pl "minimum value of the engine speed for ambient pressure Adaptation part load" VALUE 0x0077d _REC_VAL_20_u1 8160. _CNV_A_R_LINEAR_____16_CM 0. 8160. DISPLAY_IDENTIFIER C_N_MIN_AMP_AD_PL FORMAT "%4.0" /end CHARACTERISTIC
/begin CHARACTERISTIC c_pq_amp_ad "pressure quotient for Adaptation ambient pressure" VALUE 0x01732 _REC_VAL_20_u2 0.99998474 _CNV_A_R_LINEAR_____37_CM 0. 0.99998474 DISPLAY_IDENTIFIER C_PQ_AMP_AD FORMAT "%7.5" /end CHARACTERISTIC
/begin CHARACTERISTIC c_pq_amp_ad_pl "pressure quotient for Adaptation ambient pressure at PL" VALUE 0x01734 _REC_VAL_20_u2 0.99998474 _CNV_A_R_LINEAR_____37_CM 0. 0.99998474 DISPLAY_IDENTIFIER C_PQ_AMP_AD_PL FORMAT "%7.5" /end CHARACTERISTIC
/begin CHARACTERISTIC c_seg_ctr_amp_ad "Segment counter of waiting time before allowing Adaptation of ambient pressure (typical value ³ 200)" VALUE 0x01782 _REC_VAL_20_u2 65535. _CNV_A_R_LINEAR_____1_CM 0. 65535. DISPLAY_IDENTIFIER C_SEG_CTR_AMP_AD FORMAT "%5.0" /end CHARACTERISTIC
/begin CHARACTERISTIC c_seg_ctr_amp_ad_pl "segment counter for moving mean value calculation of AR_RED_BAS, MAF_KGH_MMV" VALUE 0x01784 _REC_VAL_20_u2 65535. _CNV_A_R_LINEAR_____1_CM 0. 65535. DISPLAY_IDENTIFIER C_SEG_CTR_AMP_AD_PL FORMAT "%5.0" /end CHARACTERISTIC
/begin CHARACTERISTIC c_t_ast_amp_ctl_deac "Time for deactivation of pressure control after start" VALUE 0x017b0 _REC_VAL_20_u2 6553.5 _CNV_A_R_LINEAR_____24_CM 0. 6553.5 DISPLAY_IDENTIFIER C_T_AST_AMP_CTL_DEAC FORMAT "%6.1" /end CHARACTERISTIC
/begin CHARACTERISTIC c_ti_lam_maf_puls_max "positive threshold of the ambient pressure Adaptation in pulsation" VALUE 0x0046c _REC_VAL_20_s2 99.99847412 _CNV_A_R_LINEAR_____109_CM -50. 49.99847412 DISPLAY_IDENTIFIER C_TI_LAM_MAF_PULS_MAX FORMAT "%6.2" /end CHARACTERISTIC
/begin CHARACTERISTIC c_ti_lam_maf_puls_min "negative threshold of the ambient pressure Adaptation in pulsation" VALUE 0x0046e _REC_VAL_20_s2 99.99847412 _CNV_A_R_LINEAR_____109_CM -50. 49.99847412 DISPLAY_IDENTIFIER C_TI_LAM_MAF_PULS_MIN FORMAT "%6.2" /end CHARACTERISTIC
/begin CHARACTERISTIC c_tps_min_amp_ad_pl "minimum value of the throttle position for ambient pressure Adaptation part load" VALUE 0x01944 _REC_VAL_20_u2 119.5 _CNV_A_R_LINEAR_____53_CM 0. 119.5 DISPLAY_IDENTIFIER C_TPS_MIN_AMP_AD_PL /end CHARACTERISTIC
/begin MEASUREMENT ar_red_dif_i_rel_mmv "Moving mean I-value (relative) of the closed loop control reduced throttle area" SWORD _CNV_A_R_LINEAR_____109_CM 1 100. -50. 49.99847412 DISPLAY_IDENTIFIER AR_RED_DIF_I_REL_MMV ECU_ADDRESS 0x3fcf96 BYTE_ORDER MSB_LAST FORMAT "%7.3" /end MEASUREMENT
/begin MEASUREMENT ar_red_dif_p_rel "P-value (relative) of the closed loop control reduced throttle area" SWORD _CNV_A_R_LINEAR_____109_CM 1 100. -50. 49.99847412 DISPLAY_IDENTIFIER AR_RED_DIF_P_REL ECU_ADDRESS 0x3fcfd2 BYTE_ORDER MSB_LAST FORMAT "%7.3" /end MEASUREMENT
/begin MEASUREMENT map_mdl_mv "Mean value of the model manifold pressure" UWORD _CNV_A_R_LINEAR_____49_CM 1 100. 0. 5434. DISPLAY_IDENTIFIER MAP_MDL_MV ECU_ADDRESS 0x3fcfac BYTE_ORDER MSB_LAST FORMAT "%7.2" /end MEASUREMENT
/begin MEASUREMENT map_mdl_dif "Deviation between measured and callculated manifold pressure" SWORD _CNV_A_R_LINEAR_____108_CM 1 100. -2717.04 2716.96 DISPLAY_IDENTIFIER MAP_MDL_DIF ECU_ADDRESS 0x3fcfae BYTE_ORDER MSB_LAST FORMAT "%8.2" /end MEASUREMENT
/begin MEASUREMENT maf_mdl_mv "Model air mass flow mean value" UWORD _CNV_A_R_LINEAR_____113_CM 1 100. 0. 2047.96875 DISPLAY_IDENTIFIER MAF_MDL_MV ECU_ADDRESS 0x3fcfa6 BYTE_ORDER MSB_LAST FORMAT "%7.2" /end MEASUREMENT
/begin MEASUREMENT maf_mdl_dif "Deviation of model air mass flow" SWORD _CNV_A_R_LINEAR_____113_CM 1 100. -1024. 1023.96875 DISPLAY_IDENTIFIER MAF_MDL_DIF ECU_ADDRESS 0x3fcfaa BYTE_ORDER MSB_LAST FORMAT "%6.2" /end MEASUREMENT
/begin CHARACTERISTIC c_amp_i_2 "I - Value for the ambient pressure correction(LV_MAF_CTL = 1)" VALUE 0x01482 _REC_VAL_20_u2 61.034223 _CNV_A_R_LINEAR_____338_CM 0. 61.034223 DISPLAY_IDENTIFIER C_AMP_I_2 FORMAT "%7.4" /end CHARACTERISTIC
/begin CHARACTERISTIC c_ar_red_ad_add_min "Minimum allowed value for additive reduced area Adaptation" VALUE 0x003b2 _REC_VAL_20_s2 58.59285547 _CNV_A_R_LINEAR_____339_CM -29.296875 29.29598047 DISPLAY_IDENTIFIER C_AR_RED_AD_ADD_MIN FORMAT "%8.4" /end CHARACTERISTIC
/begin CHARACTERISTIC c_ar_red_ad_fac_max "Maximum allowed value for multiplicative reduced area Adaptation" VALUE 0x003b4 _REC_VAL_20_s2 99.99847412 _CNV_A_R_LINEAR_____109_CM -50. 49.99847412 DISPLAY_IDENTIFIER C_AR_RED_AD_FAC_MAX FORMAT "%7.3" /end CHARACTERISTIC
/begin CHARACTERISTIC c_ar_red_ad_fac_min "Minimum allowed value for multiplicative reduced area Adaptation" VALUE 0x003b6 _REC_VAL_20_s2 99.99847412 _CNV_A_R_LINEAR_____109_CM -50. 49.99847412 DISPLAY_IDENTIFIER C_AR_RED_AD_FAC_MIN FORMAT "%7.3" /end CHARACTERISTIC
/begin CHARACTERISTIC c_ar_red_dif_i_rel_min "Minimum value for AR_RED_ DIF_I_REL" VALUE 0x003be _REC_VAL_20_s2 99.99847412 _CNV_A_R_LINEAR_____109_CM -50. 49.99847412 DISPLAY_IDENTIFIER C_AR_RED_DIF_I_REL_MIN FORMAT "%7.3" /end CHARACTERISTIC
/begin CHARACTERISTIC c_crlc_ar_red_bas_amp_ad_pl "correlation constant for moving mean value calculation of AR_RED_BAS" VALUE 0x00624 _REC_VAL_20_u1 0.9960940000000002 _CNV_A_R_LINEAR_____50_CM 0. 0.996094 DISPLAY_IDENTIFIER C_CRLC_AR_RED_BAS_AMP_AD_PL FORMAT "%5.3" /end CHARACTERISTIC
/begin CHARACTERISTIC c_crlc_ar_red_dif_i_rel_mmv "Correlation constant for the moving mean value calculation of AR_RED_DIF_I_REL" VALUE 0x00625 _REC_VAL_20_u1 0.9960940000000002 _CNV_A_R_LINEAR_____50_CM 0. 0.996094 DISPLAY_IDENTIFIER C_CRLC_AR_RED_DIF_I_REL_MMV FORMAT "%5.3" /end CHARACTERISTIC
/begin CHARACTERISTIC c_n_ar_red_ad_add_max "Maximum engine speed for learning of additive Adaptation value" VALUE 0x00757 _REC_VAL_20_u1 8160. _CNV_A_R_LINEAR_____16_CM 0. 8160. DISPLAY_IDENTIFIER C_N__AR_RED__AD_ADD_MAX FORMAT "%4.0" /end CHARACTERISTIC
/begin CHARACTERISTIC c_n_ar_red_ad_fac_min "Minimum engine speed for learning of multiplicative Adaptation value" VALUE 0x0075a _REC_VAL_20_u1 8160. _CNV_A_R_LINEAR_____16_CM 0. 8160. DISPLAY_IDENTIFIER C_N__AR_RED__AD_FAC_MIN FORMAT "%4.0" /end CHARACTERISTIC
/begin CHARACTERISTIC c_n_ar_red_ad_fac_max "Maximum engine speed for learning of multiplicative Adaptation value" VALUE 0x00759 _REC_VAL_20_u1 8160. _CNV_A_R_LINEAR_____16_CM 0. 8160. DISPLAY_IDENTIFIER C_N__AR_RED__AD_FAC_MAX FORMAT "%4.0" /end CHARACTERISTIC
/begin CHARACTERISTIC c_pq_ar_red_ad_fac_max "Maximum pressure quotient for learning of multiplicative Adaptation value" VALUE 0x0173c _REC_VAL_20_u2 0.99998474 _CNV_A_R_LINEAR_____37_CM 0. 0.99998474 DISPLAY_IDENTIFIER C_PQ__AR_RED__AD_FAC_MAX FORMAT "%7.5" /end CHARACTERISTIC
/begin CHARACTERISTIC c_pq_ar_red_ad_fac_min "Minimum pressure quotient for learning of multiplicative Adaptation value" VALUE 0x0173e _REC_VAL_20_u2 0.99998474 _CNV_A_R_LINEAR_____37_CM 0. 0.99998474 DISPLAY_IDENTIFIER C_PQ__AR_RED__AD_FAC_MIN FORMAT "%7.5" /end CHARACTERISTIC
/begin CHARACTERISTIC c_pq_ar_red_ad_add_max "Maximum pressure quotient for learning of additive Adaptation value" VALUE 0x0173a _REC_VAL_20_u2 0.99998474 _CNV_A_R_LINEAR_____37_CM 0. 0.99998474 DISPLAY_IDENTIFIER C_PQ__AR_RED__AD_ADD_MAX FORMAT "%7.5" /end CHARACTERISTIC
/begin CHARACTERISTIC c_t_ast_ar_red_ctl_deac "Time to deactivate reduced area control after engine start" VALUE 0x017b2 _REC_VAL_20_u2 6553.5 _CNV_A_R_LINEAR_____24_CM 0. 6553.5 DISPLAY_IDENTIFIER C_T_AST_AR_RED_CTL_DEAC FORMAT "%6.1" /end CHARACTERISTIC
/begin CHARACTERISTIC ip_ar_red_i_rel_1__n__pq "I-value (relative) reduced throttle area (MAF-controlled)" MAP 0x08ba8 _REC_MAP_20_u2_u1_u2 171660. _CNV_A_R_LINEAR_____340_CM 0. 171660. DISPLAY_IDENTIFIER IP_AR_RED_I_REL_1__N__PQ FORMAT "%6.0"
 /begin AXIS_DESCR COM_AXIS n_32 _CNV_A_R_LINEAR_____16_CM 6 0. 8160. FORMAT "%4.0" AXIS_PTS_REF ldpm_n_ar_red /end AXIS_DESCR
 /begin AXIS_DESCR COM_AXIS pq _CNV_A_R_LINEAR_____37_CM 4 0. 0.99998474 FORMAT "%7.5" AXIS_PTS_REF ldpm_pq_ar_red /end AXIS_DESCR
/end CHARACTERISTIC
/begin CHARACTERISTIC ip_ar_red_i_rel_2__n__pq "I-value reduced throttle area (MAP-controlled)" MAP 0x08bd8 _REC_MAP_20_u2_u1_u2 2.24636 _CNV_A_R_LINEAR_____341_CM 0. 2.24636 DISPLAY_IDENTIFIER IP_AR_RED_I_REL_2__N__PQ FORMAT "%6.4"
 /begin AXIS_DESCR COM_AXIS n_32 _CNV_A_R_LINEAR_____16_CM 6 0. 8160. FORMAT "%4.0" AXIS_PTS_REF ldpm_n_ar_red /end AXIS_DESCR
 /begin AXIS_DESCR COM_AXIS pq _CNV_A_R_LINEAR_____37_CM 4 0. 0.99998474 FORMAT "%7.5" AXIS_PTS_REF ldpm_pq_ar_red /end AXIS_DESCR
/end CHARACTERISTIC
/begin CHARACTERISTIC ip_ar_red_p_rel_2__n__pq "P-value reduced throttle area (MAP-controlled)" MAP 0x08c58 _REC_MAP_20_u2_u1_u2 0.5888600000000001 _CNV_A_R_LINEAR_____342_CM 0. 0.5888600000000001 DISPLAY_IDENTIFIER IP_AR_RED_P_REL_2__N__PQ FORMAT "%7.5"
 /begin AXIS_DESCR COM_AXIS n_32 _CNV_A_R_LINEAR_____16_CM 6 0. 8160. FORMAT "%4.0" AXIS_PTS_REF ldpm_n_ar_red /end AXIS_DESCR
 /begin AXIS_DESCR COM_AXIS pq _CNV_A_R_LINEAR_____37_CM 4 0. 0.99998474 FORMAT "%7.5" AXIS_PTS_REF ldpm_pq_ar_red /end AXIS_DESCR
/end CHARACTERISTIC
/begin CHARACTERISTIC ip_t_1_hfm__maf_kgh "time constant hot film air mass meter" CURVE 0x01b34 _REC_CUR_20_u2_u2 65.535 _CNV_A_R_LINEAR_____343_CM 0. 65.535 DISPLAY_IDENTIFIER IP_T_1_HFM
 /begin AXIS_DESCR COM_AXIS maf_kgh _CNV_A_R_LINEAR_____113_CM 4 0. 2047.96875 FORMAT "%7.2" AXIS_PTS_REF ldpm_maf_kgh_t_1_hfm /end AXIS_DESCR
/end CHARACTERISTIC
/begin CHARACTERISTIC c_lgrd_amp_mdl_dif_tra "Linear negative gradient of ambient pressure control during reduced area control" VALUE 0x0161a _REC_VAL_20_u2 5434. _CNV_A_R_LINEAR_____49_CM 0. 5434. DISPLAY_IDENTIFIER C_LGRD_AMP_MDL_DIF_TRA FORMAT "%7.2" /end CHARACTERISTIC
/begin CHARACTERISTIC c_lgrd_ar_red_dif_tra "Linear negative gradient of reduced area control during ambient pressure control" VALUE 0x0161c _REC_VAL_20_u2 99.99847412 _CNV_A_R_LINEAR_____9_CM 0. 99.99847412 DISPLAY_IDENTIFIER C_LGRD_AR_RED_DIF_TRA /end CHARACTERISTIC
/begin CHARACTERISTIC c_crlc_ar_red_ad_add "Factor for the additive reduced area Adaptation" VALUE 0x00622 _REC_VAL_20_u1 0.9960940000000002 _CNV_A_R_LINEAR_____50_CM 0. 0.996094 DISPLAY_IDENTIFIER C_CRLC_AR_RED_AD_ADD FORMAT "%5.3" /end CHARACTERISTIC
/begin CHARACTERISTIC c_crlc_ar_red_ad_fac "Factor for the multiplicative reduced area Adaptation" VALUE 0x00623 _REC_VAL_20_u1 0.9960940000000002 _CNV_A_R_LINEAR_____50_CM 0. 0.996094 DISPLAY_IDENTIFIER C_CRLC_AR_RED_AD_FAC FORMAT "%5.3" /end CHARACTERISTIC
/begin CHARACTERISTIC c_ar_red_dif_i_rel_max "Maximum value for AR_RED_ DIF_I_REL" VALUE 0x003bc _REC_VAL_20_s2 99.99847412 _CNV_A_R_LINEAR_____109_CM -50. 49.99847412 DISPLAY_IDENTIFIER C_AR_RED_DIF_I_REL_MAX FORMAT "%7.3" /end CHARACTERISTIC
/begin CHARACTERISTIC c_ar_red_ad_add_max "Maximum allowed value for additive reduced area Adaptation" VALUE 0x003b0 _REC_VAL_20_s2 58.59285547 _CNV_A_R_LINEAR_____339_CM -29.296875 29.29598047 DISPLAY_IDENTIFIER C_AR_RED_AD_ADD_MAX FORMAT "%8.4" /end CHARACTERISTIC
/begin CHARACTERISTIC lc_ar_red_ad_ena "Logical variable enabled for permission of adaptive values for PUC" VALUE 0x00f01 _REC_VAL_20_u1 1. _CNV_A_R_LINEAR_____22_CM 0. 1. DISPLAY_IDENTIFIER LC_AR_RED_AD_ENA FORMAT "%1.0" /end CHARACTERISTIC
/begin MEASUREMENT ar_red "Reduced area at the throttle" UWORD _CNV_A_R_LINEAR_____333_CM 1 100. 0. 58.592855 DISPLAY_IDENTIFIER AR_RED ECU_ADDRESS 0x3fcf90 BYTE_ORDER MSB_LAST FORMAT "%7.4" /end MEASUREMENT
/begin CHARACTERISTIC ip_ar_red_p_rel_1__n__pq "P-value reduced throttle area (MAF-controlled)" MAP 0x08c28 _REC_MAP_20_u2_u1_u2 12.5005 _CNV_A_R_LINEAR_____344_CM 0. 12.5005 DISPLAY_IDENTIFIER IP_AR_RED_P_REL_1__N__PQ FORMAT "%7.4"
 /begin AXIS_DESCR COM_AXIS n_32 _CNV_A_R_LINEAR_____16_CM 6 0. 8160. FORMAT "%4.0" AXIS_PTS_REF ldpm_n_ar_red /end AXIS_DESCR
 /begin AXIS_DESCR COM_AXIS pq _CNV_A_R_LINEAR_____37_CM 4 0. 0.99998474 FORMAT "%7.5" AXIS_PTS_REF ldpm_pq_ar_red /end AXIS_DESCR
/end CHARACTERISTIC
/begin MEASUREMENT ar_red_dif_i_rel "I-value (relative) of the closed loop control reduced throttle area" SWORD _CNV_A_R_LINEAR_____109_CM 1 100. -50. 49.99847412 DISPLAY_IDENTIFIER AR_RED_DIF_I_REL ECU_ADDRESS 0x3fcf94 BYTE_ORDER MSB_LAST FORMAT "%7.3" /end MEASUREMENT
/begin MEASUREMENT ar_red_dif_rel "Correction of reduced throttle area" SWORD _CNV_A_R_LINEAR_____109_CM 1 100. -50. 49.99847412 DISPLAY_IDENTIFIER AR_RED_DIF_REL ECU_ADDRESS 0x3fcf92 BYTE_ORDER MSB_LAST FORMAT "%7.3" /end MEASUREMENT
/begin MEASUREMENT ar_red_isa_dif_rel "Correction of reduced throttle area" SWORD _CNV_A_R_LINEAR_____109_CM 1 100. -50. 49.99847412 DISPLAY_IDENTIFIER AR_RED_ISA_DIF_REL ECU_ADDRESS 0x3fcfc0 BYTE_ORDER MSB_LAST FORMAT "%7.3" /end MEASUREMENT
/begin MEASUREMENT amp_mdl_dif "Value of the closed loop control of ambient pressure (sum of I and P part)" SWORD _CNV_A_R_LINEAR_____108_CM 1 100. -2717.04 2716.96 DISPLAY_IDENTIFIER AMP_MDL_DIF ECU_ADDRESS 0x3fcfba BYTE_ORDER MSB_LAST FORMAT "%8.2" /end MEASUREMENT
/begin CHARACTERISTIC c_crlc_map_mdl "correlation constant for model manifold pressure" VALUE 0x00632 _REC_VAL_20_u1 0.9960940000000002 _CNV_A_R_LINEAR_____50_CM 0. 0.996094 DISPLAY_IDENTIFIER C_CRLC_MAP_MDL FORMAT "%5.3" /end CHARACTERISTIC
/begin MEASUREMENT ar_red_isa_ad_add "Additive adaptive factor for ISA" SWORD _CNV_A_R_LINEAR_____339_CM 1 100. -29.296875 29.29598047 DISPLAY_IDENTIFIER AR_RED_ISA_AD_ADD ECU_ADDRESS 0x3fcfca BYTE_ORDER MSB_LAST FORMAT "%8.4" /end MEASUREMENT
/begin MEASUREMENT ar_red_ad_fac "Multiplicative adaptive factor" SWORD _CNV_A_R_LINEAR_____109_CM 1 100. -50. 49.99847412 DISPLAY_IDENTIFIER AR_RED_AD_FAC ECU_ADDRESS 0x3fcf9a BYTE_ORDER MSB_LAST FORMAT "%7.3" /end MEASUREMENT
/begin MEASUREMENT ar_red_isa_ad_fac "Multiplicative adaptive factor for ISA" SWORD _CNV_A_R_LINEAR_____109_CM 1 100. -50. 49.99847412 DISPLAY_IDENTIFIER AR_RED_ISA_AD_FAC ECU_ADDRESS 0x3fcfcc BYTE_ORDER MSB_LAST FORMAT "%7.3" /end MEASUREMENT
/begin MEASUREMENT ar_red_ad_fac_cor "Correction factor for entire adaptive factor" SWORD _CNV_A_R_LINEAR_____109_CM 1 100. -50. 49.99847412 DISPLAY_IDENTIFIER AR_RED_AD_FAC_COR ECU_ADDRESS 0x3fcf9c BYTE_ORDER MSB_LAST FORMAT "%7.3" /end MEASUREMENT
/begin MEASUREMENT ar_red_isa_ad_fac_cor "Correction factor for entire adaptive factor for ISA" SWORD _CNV_A_R_LINEAR_____109_CM 1 100. -50. 49.99847412 DISPLAY_IDENTIFIER AR_RED_ISA_AD_FAC_COR ECU_ADDRESS 0x3fcfc8 BYTE_ORDER MSB_LAST FORMAT "%7.3" /end MEASUREMENT
/begin CHARACTERISTIC c_n_ar_red_ad_add_min "Minimum engine speed for learning of additive Adaptation value" VALUE 0x00758 _REC_VAL_20_u1 8160. _CNV_A_R_LINEAR_____16_CM 0. 8160. DISPLAY_IDENTIFIER C_N__AR_RED__AD_ADD_MIN FORMAT "%4.0" /end CHARACTERISTIC
/begin CHARACTERISTIC c_n_ar_red_isa_ad_add_min "Minimum engine speed for learning of additive Adaptation value of ISA" VALUE 0x0075c _REC_VAL_20_u1 8160. _CNV_A_R_LINEAR_____16_CM 0. 8160. DISPLAY_IDENTIFIER C_N_AR_RED_ISA_AD_ADD_MIN FORMAT "%4.0" /end CHARACTERISTIC
/begin CHARACTERISTIC c_n_ar_red_isa_ad_add_max "Maximum engine speed for learning of additive Adaptation value of ISA" VALUE 0x0075b _REC_VAL_20_u1 8160. _CNV_A_R_LINEAR_____16_CM 0. 8160. DISPLAY_IDENTIFIER C_N_AR_RED_ISA_AD_ADD_MAX FORMAT "%4.0" /end CHARACTERISTIC
/begin CHARACTERISTIC c_ar_red_bas_ad_add_max "Maximum AR_RED_BAS for learning of additive Adaptation value of THR" VALUE 0x01496 _REC_VAL_20_u2 58.592855 _CNV_A_R_LINEAR_____333_CM 0. 58.592855 DISPLAY_IDENTIFIER C_AR_RED_BAS_AD_ADD_MAX FORMAT "%7.4" /end CHARACTERISTIC
/begin CHARACTERISTIC c_ar_red_bas_isa_ad_add_max "Maximum AR_RED_BAS for learning of additive Adaptation value of ISA" VALUE 0x01498 _REC_VAL_20_u2 58.592855 _CNV_A_R_LINEAR_____333_CM 0. 58.592855 DISPLAY_IDENTIFIER C_AR_RED_BAS_ISA_AD_ADD_MAX FORMAT "%7.4" /end CHARACTERISTIC
/begin CHARACTERISTIC c_crlc_ar_red_isa_ad_add "Filter factor for the addidive reduced area Adaptation of ISA" VALUE 0x00626 _REC_VAL_20_u1 0.9960940000000002 _CNV_A_R_LINEAR_____50_CM 0. 0.996094 DISPLAY_IDENTIFIER C_CRLC_AR_RED_ISA_AD_ADD FORMAT "%5.3" /end CHARACTERISTIC
/begin CHARACTERISTIC c_ar_red_isa_ad_add_min "Minimum allowed value for additive reduced area Adaptation of ISA" VALUE 0x003c2 _REC_VAL_20_s2 58.59285547 _CNV_A_R_LINEAR_____339_CM -29.296875 29.29598047 DISPLAY_IDENTIFIER C_AR_RED_ISA_AD_ADD_MIN FORMAT "%8.4" /end CHARACTERISTIC
/begin CHARACTERISTIC c_ar_red_isa_ad_add_max "Maximum allowed value for additive reduced area Adaptation of ISA" VALUE 0x003c0 _REC_VAL_20_s2 58.59285547 _CNV_A_R_LINEAR_____339_CM -29.296875 29.29598047 DISPLAY_IDENTIFIER C_AR_RED_ISA_AD_ADD_MAX FORMAT "%8.4" /end CHARACTERISTIC
/begin CHARACTERISTIC c_n_ar_red_isa_ad_fac_min "Minimum engine speed for learning of multiplicative Adaptation value of ISA" VALUE 0x0075e _REC_VAL_20_u1 8160. _CNV_A_R_LINEAR_____16_CM 0. 8160. DISPLAY_IDENTIFIER C_N_AR_RED_ISA_AD_FAC_MIN FORMAT "%4.0" /end CHARACTERISTIC
/begin CHARACTERISTIC c_n_ar_red_isa_ad_fac_max "Maximum engine speed for learning of multiplicative Adaptation value of ISA" VALUE 0x0075d _REC_VAL_20_u1 8160. _CNV_A_R_LINEAR_____16_CM 0. 8160. DISPLAY_IDENTIFIER C_N_AR_RED_ISA_AD_FAC_MAX FORMAT "%4.0" /end CHARACTERISTIC
/begin CHARACTERISTIC c_pq_ar_red_isa_ad_add_max "Maximum pressure quotient for learning of additive Adaptation value of ISA" VALUE 0x01740 _REC_VAL_20_u2 0.99998474 _CNV_A_R_LINEAR_____37_CM 0. 0.99998474 DISPLAY_IDENTIFIER C_PQ_AR_RED_ISA_AD_ADD_MAX FORMAT "%7.5" /end CHARACTERISTIC
/begin CHARACTERISTIC c_pq_ar_red_isa_ad_fac_min "Minimum pressure quotient for learning of multiplicative Adaptation value of ISA" VALUE 0x01744 _REC_VAL_20_u2 0.99998474 _CNV_A_R_LINEAR_____37_CM 0. 0.99998474 DISPLAY_IDENTIFIER C_PQ_AR_RED_ISA_AD_FAC_MIN FORMAT "%7.5" /end CHARACTERISTIC
/begin CHARACTERISTIC c_pq_ar_red_isa_ad_fac_max "Maximum pressure quotient for learning of multiplicative Adaptation value of ISA" VALUE 0x01742 _REC_VAL_20_u2 0.99998474 _CNV_A_R_LINEAR_____37_CM 0. 0.99998474 DISPLAY_IDENTIFIER C_PQ_AR_RED_ISA_AD_FAC_MAX FORMAT "%7.5" /end CHARACTERISTIC
/begin CHARACTERISTIC c_ar_red_bas_ad_fac_min "Minimum AR_RED_BAS for learning of multiplicative Adaptation value of THR" VALUE 0x003ba _REC_VAL_20_s2 58.59285547 _CNV_A_R_LINEAR_____339_CM -29.296875 29.29598047 DISPLAY_IDENTIFIER C_AR_RED_BAS_AD_FAC_MIN FORMAT "%8.4" /end CHARACTERISTIC
/begin CHARACTERISTIC c_ar_red_bas_ad_fac_max "Maximum AR_RED_BAS for learning of multiplicative Adaptation value of ISA" VALUE 0x003b8 _REC_VAL_20_s2 58.59285547 _CNV_A_R_LINEAR_____339_CM -29.296875 29.29598047 DISPLAY_IDENTIFIER C_AR_RED_BAS_AD_FAC_MAX FORMAT "%8.4" /end CHARACTERISTIC
/begin CHARACTERISTIC c_crlc_ar_red_isa_ad_fac "Filter factor for the multiplicative reduced area Adaptation of THR" VALUE 0x00627 _REC_VAL_20_u1 0.9960940000000002 _CNV_A_R_LINEAR_____50_CM 0. 0.996094 DISPLAY_IDENTIFIER C_CRLC_AR_RED_ISA_AD_FAC FORMAT "%5.3" /end CHARACTERISTIC
/begin CHARACTERISTIC c_ar_red_isa_bas_ad_min "Minimum AR_RED_ISA_BAS for learning of multiplicative Adaptation value of ISA" VALUE 0x003ca _REC_VAL_20_s2 58.59285547 _CNV_A_R_LINEAR_____339_CM -29.296875 29.29598047 DISPLAY_IDENTIFIER C_AR_RED_ISA_BAS_AD_MIN FORMAT "%8.4" /end CHARACTERISTIC
/begin CHARACTERISTIC c_ar_red_isa_bas_ad_max "Maximum AR_RED_ISA_BAS for learning of multiplicative Adaptation value of ISA" VALUE 0x003c8 _REC_VAL_20_s2 58.59285547 _CNV_A_R_LINEAR_____339_CM -29.296875 29.29598047 DISPLAY_IDENTIFIER C_AR_RED_ISA_BAS_AD_MAX FORMAT "%8.4" /end CHARACTERISTIC
/begin CHARACTERISTIC c_ar_red_isa_ad_fac_min "Minimum allowed value for multiplicative reduced area Adaptation of ISA" VALUE 0x003c6 _REC_VAL_20_s2 99.99847412 _CNV_A_R_LINEAR_____109_CM -50. 49.99847412 DISPLAY_IDENTIFIER C_AR_RED_ISA_AD_FAC_MIN FORMAT "%7.3" /end CHARACTERISTIC
/begin CHARACTERISTIC c_ar_red_isa_ad_fac_max "Maximum allowed value for multiplicative reduced area Adaptation of ISA" VALUE 0x003c4 _REC_VAL_20_s2 99.99847412 _CNV_A_R_LINEAR_____109_CM -50. 49.99847412 DISPLAY_IDENTIFIER C_AR_RED_ISA_AD_FAC_MAX FORMAT "%7.3" /end CHARACTERISTIC
/begin CHARACTERISTIC ip_fac_ar_red_cor__pq "Weighting function for decreasing multiplicative learning controller value during PQ>C_PQ_AMP_CTL" CURVE 0x00aa0 _REC_CUR_20_u1_u2 0.9960940000000002 _CNV_A_R_LINEAR_____50_CM 0. 0.996094 DISPLAY_IDENTIFIER IP_FAC_AR_RED_COR__PQ FORMAT "%5.3"
 /begin AXIS_DESCR COM_AXIS pq _CNV_A_R_LINEAR_____37_CM 8 0. 0.99998474 FORMAT "%7.5" AXIS_PTS_REF ldpm_pq__fac_ar_red_cor /end AXIS_DESCR
/end CHARACTERISTIC
/begin CHARACTERISTIC ip_fac_ar_red_isa_cor__pq "Weighting function for decreasing multiplicative Adaptation of ISA during PQ>C_PQ_AMP_CTL" CURVE 0x00ab0 _REC_CUR_20_u1_u2 0.9960940000000002 _CNV_A_R_LINEAR_____50_CM 0. 0.996094 DISPLAY_IDENTIFIER IP_FAC_AR_RED_ISA_COR__PQ FORMAT "%5.3"
 /begin AXIS_DESCR COM_AXIS pq _CNV_A_R_LINEAR_____37_CM 8 0. 0.99998474 FORMAT "%7.5" AXIS_PTS_REF ldpm_pq__fac_ar_red_cor /end AXIS_DESCR
/end CHARACTERISTIC
/begin CHARACTERISTIC ip_crlc_hfm__t_seg_t_1_ratio "correlation constant for the first order time delay of the calculated air mass flow at the throttle" CURVE 0x08ce4 _REC_CUR_20_u2_u2 0.99998474 _CNV_A_R_LINEAR_____37_CM 0. 0.99998474 DISPLAY_IDENTIFIER IP_CRLC_HFM FORMAT "%7.5"
 /begin AXIS_DESCR COM_AXIS online_dummy _CNV_A_R_LINEAR_____345_CM 6 0. 7.99987793 FORMAT "%6.4" AXIS_PTS_REF ldp_t_seg_t_1_ratio_crlc_hfm /end AXIS_DESCR
/end CHARACTERISTIC
/begin CHARACTERISTIC ip_crlc_ar_red_ad_add_mmv "Averaging constant for the calculation of the mean value AR_RED_AD_ADD_MMV" CURVE 0x00a44 _REC_CUR_20_u1_u2 0.9960940000000002 _CNV_A_R_LINEAR_____50_CM 0. 0.996094 DISPLAY_IDENTIFIER IP_CRLC_AR_RED_AD_ADD_MMV FORMAT "%5.3"
 /begin AXIS_DESCR COM_AXIS ar_red_ad_add_dif _CNV_A_R_LINEAR_____333_CM 4 0. 58.592855 FORMAT "%7.4" AXIS_PTS_REF ldp_ar_red_ad_add_dif /end AXIS_DESCR
/end CHARACTERISTIC
/begin MEASUREMENT ar_red_ad_add "Additive adaptive factor" SWORD _CNV_A_R_LINEAR_____339_CM 1 100. -29.296875 29.29598047 DISPLAY_IDENTIFIER AR_RED_AD_ADD ECU_ADDRESS 0x3fcf98 BYTE_ORDER MSB_LAST FORMAT "%8.4" /end MEASUREMENT
/begin MEASUREMENT ar_red_ad_add_mmv "Moving mean value of the addirive adaptive parameter" SWORD _CNV_A_R_LINEAR_____339_CM 1 100. -29.296875 29.29598047 DISPLAY_IDENTIFIER AR_RED_AD_ADD_MMV ECU_ADDRESS 0x3fcfa0 BYTE_ORDER MSB_LAST FORMAT "%8.4" /end MEASUREMENT
/begin MEASUREMENT ar_red_ad_add_dif "Adaptation demand during current driving cycle" UWORD _CNV_A_R_LINEAR_____333_CM 1 100. 0. 58.592855 DISPLAY_IDENTIFIER AR_RED_AD_ADD_DIF ECU_ADDRESS 0x3fcfa2 BYTE_ORDER MSB_LAST FORMAT "%7.4" /end MEASUREMENT
/begin MEASUREMENT lv_act_ar_red_ad_add "Conditions for reduced throttle area adaptation are fullfilled" UBYTE _CNV_S_2_RANGE______0_CM 1 100. 0. 1. DISPLAY_IDENTIFIER LV_ACT_AR_RED_AD_ADD ECU_ADDRESS 0x3fdf9c /end MEASUREMENT
/begin MEASUREMENT ar_red_isa_dif_i_rel_mmv "moving mean I-value (relative) of the closed loop control reduced ISA valve area" SWORD _CNV_A_R_LINEAR_____109_CM 1 100. -50. 49.99847412 DISPLAY_IDENTIFIER AR_RED_ISA_DIF_I_REL_MMV ECU_ADDRESS 0x3fcfc4 BYTE_ORDER MSB_LAST FORMAT "%7.3" /end MEASUREMENT
/begin MEASUREMENT ar_red_thr_dif_i_rel_mmv "moving mean I-value (relative) of the closed loop control reduced throttle area" SWORD _CNV_A_R_LINEAR_____109_CM 1 100. -50. 49.99847412 DISPLAY_IDENTIFIER AR_RED_THR_DIF_I_REL_MMV ECU_ADDRESS 0x3fcfc2 BYTE_ORDER MSB_LAST FORMAT "%7.3" /end MEASUREMENT
/begin MEASUREMENT ar_red_isa "Reduced area at the ISA" UWORD _CNV_A_R_LINEAR_____333_CM 1 100. 0. 58.592855 DISPLAY_IDENTIFIER AR_RED_ISA ECU_ADDRESS 0x3fcfbe BYTE_ORDER MSB_LAST FORMAT "%7.4" /end MEASUREMENT
/begin MEASUREMENT ar_red_isa_max "Maximum reduced area at the ISA, with AR_RED-controller and -Adaptation" UWORD _CNV_A_R_LINEAR_____333_CM 1 100. 0. 58.592855 DISPLAY_IDENTIFIER AR_RED_ISA_MAX ECU_ADDRESS 0x3fcfc6 BYTE_ORDER MSB_LAST FORMAT "%7.4" /end MEASUREMENT
/begin AXIS_PTS ldpm_pq_ar_red "" 0x11a6e pq _REC_AXS_20_u2 0.99998474 _CNV_A_R_LINEAR_____37_CM 4 0. 0.99998474 DISPLAY_IDENTIFIER LDPM_PQ_AR_RED FORMAT "%7.5" /end AXIS_PTS
/begin AXIS_PTS ldpm_maf_kgh_t_1_hfm "" 0x117d6 maf_kgh _REC_AXS_20_u2 204.796875 _CNV_A_R_LINEAR_____113_CM 4 0. 2047.96875 DISPLAY_IDENTIFIER LDPM_MAF_KGH_T_1_HFM FORMAT "%7.2" /end AXIS_PTS
/begin AXIS_PTS ldpm_n_ar_red "" 0x01383 n_32 _REC_AXS_20_u1 8160. _CNV_A_R_LINEAR_____16_CM 6 0. 8160. DISPLAY_IDENTIFIER LDPM_N_AR_RED FORMAT "%4.0" /end AXIS_PTS
/begin AXIS_PTS ldpm_pq__fac_ar_red_cor "" 0x11a5c pq _REC_AXS_20_u2 0.99998474 _CNV_A_R_LINEAR_____37_CM 8 0. 0.99998474 DISPLAY_IDENTIFIER LDPM_PQ__FAC_AR_RED_COR FORMAT "%7.5" /end AXIS_PTS
/begin AXIS_PTS ldp_t_seg_t_1_ratio_crlc_hfm "" 0x111ac online_dummy _REC_AXS_20_u2 7.99987793 _CNV_A_R_LINEAR_____345_CM 6 0. 7.99987793 DISPLAY_IDENTIFIER LDP_T_SEG_T_1_RATIO_CRLC_HFM FORMAT "%6.4" /end AXIS_PTS
/begin AXIS_PTS ldp_ar_red_ad_add_dif "" 0x1093e ar_red_ad_add_dif _REC_AXS_20_u2 58.592855 _CNV_A_R_LINEAR_____333_CM 4 0. 58.592855 DISPLAY_IDENTIFIER LDP_AR_RED_AD_ADD_DIF FORMAT "%7.4" /end AXIS_PTS
/begin MEASUREMENT amp_mdl "Ambient pressure used for model adjustment (virtual value)" UWORD _CNV_A_R_LINEAR_____49_CM 1 100. 0. 5434. DISPLAY_IDENTIFIER AMP_MDL ECU_ADDRESS 0x3fcfb2 BYTE_ORDER MSB_LAST FORMAT "%7.2" /end MEASUREMENT
/begin MEASUREMENT ar_red_dif_i_rel_ini "Initial value for integral value of closed loop control during part load" SWORD _CNV_A_R_LINEAR_____109_CM 1 100. -50. 49.99847412 DISPLAY_IDENTIFIER AR_RED_DIF_I_REL_INI ECU_ADDRESS 0x3fcfbc BYTE_ORDER MSB_LAST FORMAT "%7.3" /end MEASUREMENT
/begin CHARACTERISTIC c_amp_mdl_dif_i_max "Upper threshold of integral part of pressure controller" VALUE 0x003a8 _REC_VAL_20_s2 679.239635 _CNV_A_R_LINEAR_____334_CM -339.625 339.614635 DISPLAY_IDENTIFIER C_AMP_MDL_DIF_I_MAX FORMAT "%7.2" /end CHARACTERISTIC
/begin CHARACTERISTIC c_fac_ar_red_dif_i_rel_ini "Scalling factor for part of AMP_MDL_DIF_I which is transformed to AR_RED_DIF_I_REL_INI" VALUE 0x006c1 _REC_VAL_20_u1 1.9921875 _CNV_A_R_LINEAR_____115_CM 0. 1.9921875 DISPLAY_IDENTIFIER C_FAC_AR_RED_DIF_I_REL_INI FORMAT "%5.3" /end CHARACTERISTIC
/begin MEASUREMENT fac_ar_red_dif "Weighting factor for reduced area share to THR and ISA" UBYTE _CNV_A_R_LINEAR_____50_CM 1 100. 0. 0.996094 DISPLAY_IDENTIFIER FAC_AR_RED_DIF ECU_ADDRESS 0x3fdf9a FORMAT "%5.3" /end MEASUREMENT
/begin MEASUREMENT amp_mdl_dif_i_ini "Initialization value for integral part of pressure controller" SWORD _CNV_A_R_LINEAR_____334_CM 1 100. -339.625 339.614635 DISPLAY_IDENTIFIER AMP_MDL_DIF_I_INI ECU_ADDRESS 0x3fcfa8 BYTE_ORDER MSB_LAST FORMAT "%7.2" /end MEASUREMENT
/begin CHARACTERISTIC c_ar_red_isa_max "maximum reduced area at full opened idle speed actuator valve" VALUE 0x0149a _REC_VAL_20_u2 58.592855 _CNV_A_R_LINEAR_____333_CM 0. 58.592855 DISPLAY_IDENTIFIER C_AR_RED_ISA_MAX FORMAT "%7.4" /end CHARACTERISTIC
/begin CHARACTERISTIC lc_ar_red_dif_tra "Logical variable for enable initialization of integral controller part" VALUE 0x00f02 _REC_VAL_20_u1 1. _CNV_A_R_LINEAR_____1_CM 0. 1. DISPLAY_IDENTIFIER LC_AR_RED_DIF_TRA FORMAT "%2.0" /end CHARACTERISTIC
/begin CHARACTERISTIC c_amp_ad_cor_clrc "Correlation constant for ambient pressure learning" VALUE 0x005df _REC_VAL_20_u1 0.9960940000000002 _CNV_A_R_LINEAR_____50_CM 0. 0.996094 DISPLAY_IDENTIFIER C_AMP_AD_COR_CLRC FORMAT "%5.3" /end CHARACTERISTIC
/begin CHARACTERISTIC ip_ar_red_egr__n_32__stk_av_egr "reduced area at the EGR-valve" MAP 0x08b48 _REC_MAP_20_u2_u1_u1 58.592855 _CNV_A_R_LINEAR_____333_CM 0. 58.592855 DISPLAY_IDENTIFIER IP_AR_RED_EGR__N_32__STK_AV_EGR FORMAT "%7.4"
 /begin AXIS_DESCR COM_AXIS n_32 _CNV_A_R_LINEAR_____16_CM 6 0. 8160. FORMAT "%4.0" AXIS_PTS_REF ldp_n_32_ar_red_egr /end AXIS_DESCR
 /begin AXIS_DESCR COM_AXIS stk_av_egr _CNV_A_R_LINEAR_____10_CM 8 0. 99.609375 FORMAT "%5.2" AXIS_PTS_REF ldp_stk_av_egr_ar_red_egr /end AXIS_DESCR
/end CHARACTERISTIC
/begin MEASUREMENT prs_ex "Pressure in the exhaust system" UWORD _CNV_A_R_LINEAR_____49_CM 1 100. 0. 5434. DISPLAY_IDENTIFIER PRS_EX ECU_ADDRESS 0x3fcff0 BYTE_ORDER MSB_LAST FORMAT "%7.2" /end MEASUREMENT
/begin MEASUREMENT prs_ex_inc "increase of exhaust pressure in comparison to ambient pressure" UWORD _CNV_A_R_LINEAR_____49_CM 1 100. 0. 5434. DISPLAY_IDENTIFIER PRS_EX_INC ECU_ADDRESS 0x3fcff2 BYTE_ORDER MSB_LAST FORMAT "%7.2" /end MEASUREMENT
/begin CHARACTERISTIC ip_prs_ex_inc "pressure increase in the exhaust pipe" CURVE 0x0d5ea _REC_CUR_20_u2_u2 5434. _CNV_A_R_LINEAR_____49_CM 0. 5434. DISPLAY_IDENTIFIER IP_PRS_EX_INC FORMAT "%7.2"
 /begin AXIS_DESCR COM_AXIS maf_cyl _CNV_A_R_LINEAR_____113_CM 8 0. 2047.96875 FORMAT "%6.2" AXIS_PTS_REF ldpm_maf_cyl_ex /end AXIS_DESCR
/end CHARACTERISTIC
/begin CHARACTERISTIC ip_teg_egr__maf_cyl "Temperature on the exhaust side of the EGR-Valve" CURVE 0x0ede6 _REC_CUR_20_u2_u2 2047. _CNV_A_R_LINEAR_____7_CM 0. 2047. DISPLAY_IDENTIFIER IP_TEG_EGR__MAF_CYL FORMAT "%7.2"
 /begin AXIS_DESCR COM_AXIS maf_cyl _CNV_A_R_LINEAR_____113_CM 8 0. 2047.96875 FORMAT "%6.2" AXIS_PTS_REF ldpm_maf_cyl_ex /end AXIS_DESCR
/end CHARACTERISTIC
/begin MEASUREMENT teg_egr "Temperature on the exhaust side of the EGR-valve" UWORD _CNV_A_R_LINEAR_____7_CM 1 100. 0. 2047. DISPLAY_IDENTIFIER TEG_EGR ECU_ADDRESS 0x3fcff4 BYTE_ORDER MSB_LAST FORMAT "%7.2" /end MEASUREMENT
/begin MEASUREMENT ar_red_egr "Reduced area at the EGR - valve (is only calculated if NC_EGR_CONF = 1)" UWORD _CNV_A_R_LINEAR_____333_CM 1 100. 0. 58.592855 DISPLAY_IDENTIFIER AR_RED_EGR ECU_ADDRESS 0x3fcfee BYTE_ORDER MSB_LAST FORMAT "%7.4" /end MEASUREMENT
/begin AXIS_PTS ldp_n_32_ar_red_egr "" 0x0107f n_32 _REC_AXS_20_u1 816. _CNV_A_R_LINEAR_____16_CM 6 0. 8160. DISPLAY_IDENTIFIER LDP_N_32_AR_RED_EGR FORMAT "%4.0" /end AXIS_PTS
/begin AXIS_PTS ldp_stk_av_egr_ar_red_egr "" 0x07d4d stk_av_egr _REC_AXS_20_u1 99.609375 _CNV_A_R_LINEAR_____10_CM 8 0. 99.609375 DISPLAY_IDENTIFIER LDP_STK_AV_EGR_AR_RED_EGR FORMAT "%5.2" /end AXIS_PTS
/begin AXIS_PTS ldpm_maf_cyl_ex "" 0x11746 maf_cyl _REC_AXS_20_u2 2047.96875 _CNV_A_R_LINEAR_____113_CM 8 0. 2047.96875 DISPLAY_IDENTIFIER LDPM_MAF_CYL_EX FORMAT "%6.2" /end AXIS_PTS
/begin MEASUREMENT lv_amp_ad_stop "Adaptation of ambient pressure is stopped" UBYTE _CNV_S_2_RANGE______0_CM 1 100. 0. 1. DISPLAY_IDENTIFIER LV_AMP_AD_STOP ECU_ADDRESS 0x3fdfa1 BIT_MASK 0x1 /end MEASUREMENT
/begin MEASUREMENT lv_amp_ctl_stop "Ambient pressure controller is stopped" UBYTE _CNV_S_2_RANGE______0_CM 1 100. 0. 1. DISPLAY_IDENTIFIER LV_AMP_CTL_STOP ECU_ADDRESS 0x3fdf9f BIT_MASK 0x1 /end MEASUREMENT
/begin MEASUREMENT lv_ar_red_ad_rst "Adaptation of reduced area is reseted to \"0\"" UBYTE _CNV_S_2_RANGE______0_CM 1 100. 0. 1. DISPLAY_IDENTIFIER LV_AR_RED_AD_RST ECU_ADDRESS 0x3fdfa4 BIT_MASK 0x1 /end MEASUREMENT
/begin MEASUREMENT lv_ar_red_ad_stop "Adaptation of reduced area is stopped" UBYTE _CNV_S_2_RANGE______0_CM 1 100. 0. 1. DISPLAY_IDENTIFIER LV_AR_RED_AD_STOP ECU_ADDRESS 0x3fdfa3 BIT_MASK 0x1 /end MEASUREMENT
/begin MEASUREMENT lv_ar_red_ctl_stop "Reduced area controller is stopped" UBYTE _CNV_S_2_RANGE______0_CM 1 100. 0. 1. DISPLAY_IDENTIFIER LV_AR_RED_CTL_STOP ECU_ADDRESS 0x3fdfa0 BIT_MASK 0x1 /end MEASUREMENT
/begin MEASUREMENT maf_kgh_mes_fac "Correction factor for MAF_KGH_MES" UBYTE _CNV_A_R_LINEAR_____39_CM 1 100. 0. 1.99220002 DISPLAY_IDENTIFIER MAF_KGH_MES_FAC ECU_ADDRESS 0x3fdf9d FORMAT "%5.3" /end MEASUREMENT
/begin CHARACTERISTIC ip_fac_maf_kgh_cor "Correction for MAF_KGH_MES depending on MAF_KGH_MES_BAS" CURVE 0x04fc6 _REC_CUR_20_u1_u2 1.9921875 _CNV_A_R_LINEAR_____115_CM 0. 1.9921875 DISPLAY_IDENTIFIER IP_FAC_MAF_KGH_COR FORMAT "%5.3"
 /begin AXIS_DESCR COM_AXIS maf_kgh_mes_bas _CNV_A_R_LINEAR_____113_CM 16 0. 2047.96875 FORMAT "%7.2" AXIS_PTS_REF ldp_maf_kgh_mes_bas /end AXIS_DESCR
/end CHARACTERISTIC
/begin MEASUREMENT ar_red_bas "Basic reduced opening area" UWORD _CNV_A_R_LINEAR_____333_CM 1 100. 0. 58.592855 DISPLAY_IDENTIFIER AR_RED_BAS ECU_ADDRESS 0x3fcff6 BYTE_ORDER MSB_LAST FORMAT "%7.4" /end MEASUREMENT
/begin MEASUREMENT lv_map_ctl "MAP controlled system" UBYTE _CNV_S_2_RANGE______0_CM 1 100. 0. 1. DISPLAY_IDENTIFIER LV_MAP_CTL ECU_ADDRESS 0x3fdfa6 BIT_MASK 0x1 /end MEASUREMENT
/begin MEASUREMENT lv_amp_ad_rst "Adaptation of ambient pressure is reseted to \"0\"" UBYTE _CNV_S_2_RANGE______0_CM 1 100. 0. 1. DISPLAY_IDENTIFIER LV_AMP_AD_RST ECU_ADDRESS 0x3fdfa2 BIT_MASK 0x1 /end MEASUREMENT
/begin MEASUREMENT lv_maf_ctl "MAF controlled system" UBYTE _CNV_S_2_RANGE______0_CM 1 100. 0. 1. DISPLAY_IDENTIFIER LV_MAF_CTL ECU_ADDRESS 0x3fdfa5 BIT_MASK 0x1 /end MEASUREMENT
/begin MEASUREMENT ar_red_isa_bas "Basic reduced opening area at the idle speed actuator" UWORD _CNV_A_R_LINEAR_____333_CM 1 100. 0. 58.592855 DISPLAY_IDENTIFIER AR_RED_ISA_BAS ECU_ADDRESS 0x3fd008 BYTE_ORDER MSB_LAST FORMAT "%7.4" /end MEASUREMENT
/begin AXIS_PTS ldp_maf_kgh_mes_bas "" 0x10d66 maf_kgh_mes_bas _REC_AXS_20_u2 2047.96875 _CNV_A_R_LINEAR_____113_CM 16 0. 2047.96875 DISPLAY_IDENTIFIER LDP_MAF_KGH_MES_BAS FORMAT "%7.2" /end AXIS_PTS
/begin MEASUREMENT map_mes "measured manifold air pressure" UWORD _CNV_A_R_LINEAR_____49_CM 1 100. 0. 5434. DISPLAY_IDENTIFIER MAP_MES ECU_ADDRESS 0x3fd00a BYTE_ORDER MSB_LAST FORMAT "%7.2" /end MEASUREMENT
/begin MEASUREMENT state_ctl_insy "State_of intake manifold model adaption" UBYTE _CNV_S_3_STATE_CTL__349_CM 1 100. 0. 2. DISPLAY_IDENTIFIER STATE_CTL_INSY ECU_ADDRESS 0x3fdf9e /end MEASUREMENT
/begin CHARACTERISTIC c_pq_amp_ctl "Pressure quotient to switch from area to pressure control" VALUE 0x01736 _REC_VAL_20_u2 0.99998474 _CNV_A_R_LINEAR_____37_CM 0. 0.99998474 DISPLAY_IDENTIFIER C_PQ_AMP_CTL FORMAT "%7.5" /end CHARACTERISTIC
/begin CHARACTERISTIC c_pq_amp_ctl_hys "Hysteresis around pressure ratio to switch from area to pressure control" VALUE 0x01738 _REC_VAL_20_u2 0.99998474 _CNV_A_R_LINEAR_____37_CM 0. 0.99998474 DISPLAY_IDENTIFIER C_PQ_AMP_CTL_HYS FORMAT "%7.5" /end CHARACTERISTIC
/begin CHARACTERISTIC ip_ar_red_thr "reduced area at the throttle" CURVE 0x08c88 _REC_CUR_20_u2_u2 58.592855 _CNV_A_R_LINEAR_____333_CM 0. 58.592855 DISPLAY_IDENTIFIER IP_AR_RED_THR FORMAT "%7.4"
 /begin AXIS_DESCR COM_AXIS tps_seg _CNV_A_R_LINEAR_____53_CM 16 0. 119.5 AXIS_PTS_REF ldp_tps_seg_ar_red_thr /end AXIS_DESCR
/end CHARACTERISTIC
/begin AXIS_PTS ldp_tps_seg_ar_red_thr "" 0x112ca tps_seg _REC_AXS_20_u2 119.5 _CNV_A_R_LINEAR_____53_CM 16 0. 119.5 DISPLAY_IDENTIFIER LDP_TPS_SEG_AR_RED_THR /end AXIS_PTS
/begin CHARACTERISTIC ip_ar_red_isa "reduced area at the idle speed actuator" CURVE 0x08c08 _REC_CUR_20_u2_u2 58.592855 _CNV_A_R_LINEAR_____333_CM 0. 58.592855 DISPLAY_IDENTIFIER IP_AR_RED_ISA FORMAT "%7.4"
 /begin AXIS_DESCR COM_AXIS isapwm_mmv _CNV_A_R_LINEAR_____9_CM 16 0. 99.99847412 AXIS_PTS_REF ldp_isapwm_mmv /end AXIS_DESCR
/end CHARACTERISTIC
/begin AXIS_PTS ldp_isapwm_mmv "" 0x10b16 isapwm_mmv _REC_AXS_20_u2 99.99847412 _CNV_A_R_LINEAR_____9_CM 16 0. 99.99847412 DISPLAY_IDENTIFIER LDP_ISAPWM_MMV /end AXIS_PTS
/begin MEASUREMENT v_map "Voltage of the intake manifold pressure sensor (for diagnosis)" UWORD _CNV_A_R_LINEAR_____355_CM 1 100. 0. 5. DISPLAY_IDENTIFIER V_MAP ECU_ADDRESS 0x3fd036 BYTE_ORDER MSB_LAST FORMAT "%5.3" /end MEASUREMENT
/begin CHARACTERISTIC ip_map_mes_bas__v_map "Conversion characteristic for MAP_MES_BAS" CURVE 0x01afe _REC_CUR_20_u2_u2 5434. _CNV_A_R_LINEAR_____49_CM 0. 5434. DISPLAY_IDENTIFIER IP_MAP_MES_BAS__V_MAP FORMAT "%7.2"
 /begin AXIS_DESCR COM_AXIS v_map _CNV_A_R_LINEAR_____355_CM 2 0. 5. FORMAT "%5.3" AXIS_PTS_REF ldp_v_map_map_mes_bas /end AXIS_DESCR
/end CHARACTERISTIC
/begin MEASUREMENT map_mes_bas "Intake manifold air pressure per segment measured" UWORD _CNV_A_R_LINEAR_____49_CM 1 100. 0. 5434. DISPLAY_IDENTIFIER MAP_MES_BAS ECU_ADDRESS 0x3fd034 BYTE_ORDER MSB_LAST FORMAT "%7.2" /end MEASUREMENT
/begin AXIS_PTS ldp_v_map_map_mes_bas "" 0x01b9a v_map _REC_AXS_20_u2 4.5 _CNV_A_R_LINEAR_____355_CM 2 0. 5. DISPLAY_IDENTIFIER LDP_V_MAP_MAP_MES_BAS FORMAT "%5.3" /end AXIS_PTS
/begin MEASUREMENT n_32 "engine speed with a resolution of 32rpm" UBYTE _CNV_A_R_LINEAR_____16_CM 1 100. 0. 8160. DISPLAY_IDENTIFIER N_32 ECU_ADDRESS 0x3fe081 FORMAT "%4.0" /end MEASUREMENT
/begin MEASUREMENT t_seg_av "Current segment-time" UWORD _CNV_A_R_LINEAR_____198_CM 1 100. 0. 262.14 DISPLAY_IDENTIFIER T_SEG_AV ECU_ADDRESS 0x3fd18c BYTE_ORDER MSB_LAST FORMAT "%7.3" /end MEASUREMENT
/begin MEASUREMENT n_grd "Engine speed gradient" SBYTE _CNV_A_R_LINEAR_____368_CM 1 100. -4096. 4064. DISPLAY_IDENTIFIER N_GRD ECU_ADDRESS 0x3fe082 FORMAT "%4.0" /end MEASUREMENT
/begin MEASUREMENT n "engine speed with a resolution of 1rpm" UWORD _CNV_A_R_LINEAR_____11_CM 1 100. 0. 8160. DISPLAY_IDENTIFIER N ECU_ADDRESS 0x3fd188 BYTE_ORDER MSB_LAST FORMAT "%4.0" /end MEASUREMENT
/begin MEASUREMENT n_tooth "Engine speed during start (calculated at every tooth period" UWORD _CNV_A_R_LINEAR_____11_CM 1 100. 0. 8160. DISPLAY_IDENTIFIER N_TOOTH ECU_ADDRESS 0x3fd18a BYTE_ORDER MSB_LAST FORMAT "%4.0" /end MEASUREMENT
/begin MEASUREMENT lv_load_ratio_chk "" UBYTE _CNV_S_2_RANGE______5_CM 1 100. 0. 1. DISPLAY_IDENTIFIER LV_LOAD_RATIO_CHK ECU_ADDRESS 0x3fe1e8 /end MEASUREMENT
/begin CHARACTERISTIC c_pv_grd_lih_max "Max. (positive) pedal gradient in case of an error" VALUE 0x0175e _REC_VAL_20_u2 99.99847412 _CNV_A_R_LINEAR_____9_CM 0. 99.99847412 DISPLAY_IDENTIFIER C_PV_GRD_LIH_MAX /end CHARACTERISTIC
/begin CHARACTERISTIC c_v_pvs_hys_fil "Area of the dejitter-filters" VALUE 0x0090c _REC_VAL_20_u1 1.24511719 _CNV_A_R_LINEAR_____390_CM 0. 1.24511719 DISPLAY_IDENTIFIER C_V_PVS_HYS_FIL FORMAT "%4.3" /end CHARACTERISTIC
/begin MEASUREMENT v_pvs_fil_1 "Filtered PVS-voltage value for channel 1" UWORD _CNV_A_R_LINEAR_____3_CM 1 100. 0. 4.99511719 DISPLAY_IDENTIFIER V_PVS_FIL_1 ECU_ADDRESS 0x3fd200 BYTE_ORDER MSB_LAST FORMAT "%5.3" /end MEASUREMENT
/begin MEASUREMENT v_pvs_fil_2 "Filtered PVS-voltage value for channel 2" UWORD _CNV_A_R_LINEAR_____3_CM 1 100. 0. 4.99511719 DISPLAY_IDENTIFIER V_PVS_FIL_2 ECU_ADDRESS 0x3fd202 BYTE_ORDER MSB_LAST FORMAT "%5.3" /end MEASUREMENT
/begin CHARACTERISTIC c_pvs_slop_1 "Slope value of  the pedal value 1" VALUE 0x007b1 _REC_VAL_20_u1 79.6875 _CNV_A_R_LINEAR_____391_CM 0. 79.6875 DISPLAY_IDENTIFIER C_PVS_SLOP_1 FORMAT "%4.1" /end CHARACTERISTIC
/begin CHARACTERISTIC c_pvs_slop_2 "Slope value of  the pedal value 2" VALUE 0x007b2 _REC_VAL_20_u1 79.6875 _CNV_A_R_LINEAR_____391_CM 0. 79.6875 DISPLAY_IDENTIFIER C_PVS_SLOP_2 FORMAT "%4.1" /end CHARACTERISTIC
/begin MEASUREMENT lv_kd "Flag for Kick-Down-Recognition (internally recognized from both PVS-voltages)" UBYTE _CNV_S_2_RANGE______5_CM 1 100. 0. 1. DISPLAY_IDENTIFIER LV_KD ECU_ADDRESS 0x3fe0ad BIT_MASK 0x1 /end MEASUREMENT
/begin CHARACTERISTIC c_v_pvs_ofs_1 "Offset of the pedal value 1" VALUE 0x0090d _REC_VAL_20_u1 1.24511719 _CNV_A_R_LINEAR_____390_CM 0. 1.24511719 DISPLAY_IDENTIFIER C_V_PVS_OFS_1 FORMAT "%5.3" /end CHARACTERISTIC
/begin CHARACTERISTIC c_v_pvs_ofs_2 "Offset of the pedal value 2" VALUE 0x0090e _REC_VAL_20_u1 1.24511719 _CNV_A_R_LINEAR_____390_CM 0. 1.24511719 DISPLAY_IDENTIFIER C_V_PVS_OFS_2 FORMAT "%5.3" /end CHARACTERISTIC
/begin MEASUREMENT pv_av "Global degree of activation of the accelerator pedal" UBYTE _CNV_A_R_LINEAR_____10_CM 1 100. 0. 99.609375 DISPLAY_IDENTIFIER PV_AV ECU_ADDRESS 0x3fe0a7 FORMAT "%3.1" /end MEASUREMENT
/begin CHARACTERISTIC c_pv_av_bls_not_plaus_lgrd "Change limitation of pedal position in case of an PV_AV/Brake implausibility" VALUE 0x01754 _REC_VAL_20_u2 99.99847412 _CNV_A_R_LINEAR_____9_CM 0. 99.99847412 DISPLAY_IDENTIFIER C_PV_AV_BLS_NOT_PLAUS_LGRD /end CHARACTERISTIC
/begin CHARACTERISTIC c_pv_av_bls_not_plaus_hys "Hysteresis in case of an PV_AV/Brake implausibility" VALUE 0x007a2 _REC_VAL_20_u1 99.609375 _CNV_A_R_LINEAR_____10_CM 0. 99.609375 DISPLAY_IDENTIFIER C_PV_AV_BLS_NOT_PLAUS_HYS FORMAT "%4.1" /end CHARACTERISTIC
/begin MEASUREMENT pv_av_2 "degree of activation of the accelerator pedal from PVS-channel 2" UBYTE _CNV_A_R_LINEAR_____10_CM 1 100. 0. 99.609375 DISPLAY_IDENTIFIER PV_AV_2 ECU_ADDRESS 0x3fe0a9 FORMAT "%3.1" /end MEASUREMENT
/begin MEASUREMENT pv_max "Maximum selection of pedal value interpretation" UBYTE _CNV_A_R_LINEAR_____10_CM 1 100. 0. 99.609375 DISPLAY_IDENTIFIER PV_MAX ECU_ADDRESS 0x3fe0ac FORMAT "%3.1" /end MEASUREMENT
/begin MEASUREMENT pv_av_grd "Throttle position gradient before correction" UBYTE _CNV_A_R_LINEAR_____40_CM 1 100. -1250. 1240.234 DISPLAY_IDENTIFIER PV_AV_GRD ECU_ADDRESS 0x3fe0a6 FORMAT "%6.1" /end MEASUREMENT
/begin CHARACTERISTIC c_pv_av_bls_not_plaus "Pedal position in case of an PV_AV/Brake implausibility" VALUE 0x007a1 _REC_VAL_20_u1 99.609375 _CNV_A_R_LINEAR_____10_CM 0. 99.609375 DISPLAY_IDENTIFIER C_PV_AV_BLS_NOT_PLAUS FORMAT "%4.1" /end CHARACTERISTIC
/begin MEASUREMENT pv_av_1 "degree of activation of the accelerator pedal from PVS-channel 1" UBYTE _CNV_A_R_LINEAR_____10_CM 1 100. 0. 99.609375 DISPLAY_IDENTIFIER PV_AV_1 ECU_ADDRESS 0x3fe0a8 FORMAT "%3.1" /end MEASUREMENT
/begin MEASUREMENT fac_pv_cs_cor "Starting  correction" SWORD _CNV_A_R_LINEAR_____392_CM 1 100. -1. 0.99996948 DISPLAY_IDENTIFIER FAC_PV_CS_COR ECU_ADDRESS 0x3fd204 BYTE_ORDER MSB_LAST FORMAT "%8.5" /end MEASUREMENT
/begin MEASUREMENT fac_pv_gs_cor "Gear shift correction" SWORD _CNV_A_R_LINEAR_____392_CM 1 100. -1. 0.99996948 DISPLAY_IDENTIFIER FAC_PV_GS_COR ECU_ADDRESS 0x3fd206 BYTE_ORDER MSB_LAST FORMAT "%8.5" /end MEASUREMENT
/begin MEASUREMENT fac_pv_bas_cor "basic correction" SWORD _CNV_A_R_LINEAR_____392_CM 1 100. -1. 0.99996948 DISPLAY_IDENTIFIER FAC_PV_BAS_COR ECU_ADDRESS 0x3fd208 BYTE_ORDER MSB_LAST FORMAT "%8.5" /end MEASUREMENT
/begin MEASUREMENT fac_pv_cor "Summation of corrections" UWORD _CNV_A_R_LINEAR_____174_CM 1 100. 0. 0.99997 DISPLAY_IDENTIFIER FAC_PV_COR ECU_ADDRESS 0x3fd20a BYTE_ORDER MSB_LAST FORMAT "%8.6" /end MEASUREMENT
/begin MEASUREMENT pv_av_raw "Global degree of activation of the gas pedal" UBYTE _CNV_A_R_LINEAR_____10_CM 1 100. 0. 99.609375 DISPLAY_IDENTIFIER PV_AV_RAW ECU_ADDRESS 0x3fe0aa FORMAT "%3.1" /end MEASUREMENT
/begin CHARACTERISTIC ip_pv_lih_max "Max. pedal position in case of an error" CURVE 0x00d6a _REC_CUR_20_u1_u1 99.609375 _CNV_A_R_LINEAR_____10_CM 0. 99.609375 DISPLAY_IDENTIFIER IP_PV_LIH_MAX FORMAT "%4.1"
 /begin AXIS_DESCR COM_AXIS n_32 _CNV_A_R_LINEAR_____16_CM 6 0. 8160. FORMAT "%4.0" AXIS_PTS_REF ldp_n_32__pv_lih_max /end AXIS_DESCR
/end CHARACTERISTIC
/begin CHARACTERISTIC ip_fac_pv_bas_cor_mt "Basic correction" MAP 0x0ae32 _REC_MAP_20_u2_u2_u1 1.99996948 _CNV_A_R_LINEAR_____393_CM -1. 0.99996948 DISPLAY_IDENTIFIER IP_FAC_PV_BAS_COR_MT FORMAT "%8.5"
 /begin AXIS_DESCR COM_AXIS n _CNV_A_R_LINEAR_____11_CM 6 1. 8160. FORMAT "%4.0" AXIS_PTS_REF ldpm_n__pv_fac_cor /end AXIS_DESCR
 /begin AXIS_DESCR COM_AXIS pv_av_raw _CNV_A_R_LINEAR_____10_CM 6 0. 99.609375 FORMAT "%4.1" AXIS_PTS_REF ldpm_pv_av_raw__pv_fac_cor /end AXIS_DESCR
/end CHARACTERISTIC
/begin CHARACTERISTIC ip_fac_pv_bas_cor_at "Basic correction" MAP 0x0adea _REC_MAP_20_u2_u2_u1 1.99996948 _CNV_A_R_LINEAR_____393_CM -1. 0.99996948 DISPLAY_IDENTIFIER IP_FAC_PV_BAS_COR_AT FORMAT "%8.5"
 /begin AXIS_DESCR COM_AXIS n _CNV_A_R_LINEAR_____11_CM 6 1. 8160. FORMAT "%4.0" AXIS_PTS_REF ldpm_n__pv_fac_cor /end AXIS_DESCR
 /begin AXIS_DESCR COM_AXIS pv_av_raw _CNV_A_R_LINEAR_____10_CM 6 0. 99.609375 FORMAT "%4.1" AXIS_PTS_REF ldpm_pv_av_raw__pv_fac_cor /end AXIS_DESCR
/end CHARACTERISTIC
/begin CHARACTERISTIC ip_fac_pv_bas_cor_amt "Basic correction" MAP 0x0ada2 _REC_MAP_20_u2_u2_u1 1.99996948 _CNV_A_R_LINEAR_____393_CM -1. 0.99996948 DISPLAY_IDENTIFIER IP_FAC_PV_BAS_COR_AMT FORMAT "%8.5"
 /begin AXIS_DESCR COM_AXIS n _CNV_A_R_LINEAR_____11_CM 6 1. 8160. FORMAT "%4.0" AXIS_PTS_REF ldpm_n__pv_fac_cor /end AXIS_DESCR
 /begin AXIS_DESCR COM_AXIS pv_av_raw _CNV_A_R_LINEAR_____10_CM 6 0. 99.609375 FORMAT "%4.1" AXIS_PTS_REF ldpm_pv_av_raw__pv_fac_cor /end AXIS_DESCR
/end CHARACTERISTIC
/begin CHARACTERISTIC ip_fac_pv_cs_cor_amt "Clutch  intervention correction" MAP 0x0ae7a _REC_MAP_20_u2_u2_u1 1.99996948 _CNV_A_R_LINEAR_____393_CM -1. 0.99996948 DISPLAY_IDENTIFIER IP_FAC_PV_CS_COR_AMT FORMAT "%8.5"
 /begin AXIS_DESCR COM_AXIS n_dif _CNV_A_R_LINEAR_____206_CM 6 -32768. 32767. FORMAT "%6.0" AXIS_PTS_REF ldpm_n_dif__pv_fac_cor /end AXIS_DESCR
 /begin AXIS_DESCR COM_AXIS pv_av_raw _CNV_A_R_LINEAR_____10_CM 6 0. 99.609375 FORMAT "%4.1" AXIS_PTS_REF ldpm_pv_av_raw__pv_fac_cor /end AXIS_DESCR
/end CHARACTERISTIC
/begin CHARACTERISTIC ip_fac_pv_cs_cor_mt "Clutch  intervention correction" MAP 0x0aec2 _REC_MAP_20_u2_u2_u1 1.99996948 _CNV_A_R_LINEAR_____393_CM -1. 0.99996948 DISPLAY_IDENTIFIER IP_FAC_PV_CS_COR_MT FORMAT "%8.5"
 /begin AXIS_DESCR COM_AXIS n_dif _CNV_A_R_LINEAR_____206_CM 6 -32768. 32767. FORMAT "%6.0" AXIS_PTS_REF ldpm_n_dif__pv_fac_cor /end AXIS_DESCR
 /begin AXIS_DESCR COM_AXIS pv_av_raw _CNV_A_R_LINEAR_____10_CM 6 0. 99.609375 FORMAT "%4.1" AXIS_PTS_REF ldpm_pv_av_raw__pv_fac_cor /end AXIS_DESCR
/end CHARACTERISTIC
/begin CHARACTERISTIC ip_fac_pv_gs_cor_amt "Gear shift intervention correction" MAP 0x0af0a _REC_MAP_20_u2_u2_u1 1.99996948 _CNV_A_R_LINEAR_____393_CM -1. 0.99996948 DISPLAY_IDENTIFIER IP_FAC_PV_GS_COR_AMT FORMAT "%8.5"
 /begin AXIS_DESCR COM_AXIS n _CNV_A_R_LINEAR_____11_CM 6 1. 8160. FORMAT "%4.0" AXIS_PTS_REF ldpm_n__pv_fac_cor /end AXIS_DESCR
 /begin AXIS_DESCR COM_AXIS pv_av_raw _CNV_A_R_LINEAR_____10_CM 6 0. 99.609375 FORMAT "%4.1" AXIS_PTS_REF ldpm_pv_av_raw__pv_fac_cor /end AXIS_DESCR
/end CHARACTERISTIC
/begin CHARACTERISTIC ip_fac_pv_gs_cor_mt "Gear shift intervention correction" MAP 0x0af52 _REC_MAP_20_u2_u2_u1 1.99996948 _CNV_A_R_LINEAR_____393_CM -1. 0.99996948 DISPLAY_IDENTIFIER IP_FAC_PV_GS_COR_MT FORMAT "%8.5"
 /begin AXIS_DESCR COM_AXIS n _CNV_A_R_LINEAR_____11_CM 6 1. 8160. FORMAT "%4.0" AXIS_PTS_REF ldpm_n__pv_fac_cor /end AXIS_DESCR
 /begin AXIS_DESCR COM_AXIS pv_av_raw _CNV_A_R_LINEAR_____10_CM 6 0. 99.609375 FORMAT "%4.1" AXIS_PTS_REF ldpm_pv_av_raw__pv_fac_cor /end AXIS_DESCR
/end CHARACTERISTIC
/begin CHARACTERISTIC ip_fac_vs_pv_gs_cor_amt "Vehicle speed correction" CURVE 0x0b77c _REC_CUR_20_u2_u2 1.99996948 _CNV_A_R_LINEAR_____393_CM -1. 0.99996948 DISPLAY_IDENTIFIER IP_FAC_VS_PV_GS_COR_AMT FORMAT "%8.5"
 /begin AXIS_DESCR COM_AXIS vs_fil _CNV_A_R_LINEAR_____394_CM 8 0. 511.99218 FORMAT "%7.3" AXIS_PTS_REF ldpm_vs_fil__pv_fac_cor /end AXIS_DESCR
/end CHARACTERISTIC
/begin CHARACTERISTIC ip_fac_vs_pv_gs_cor_mt "Vehicle speed correction" CURVE 0x0b78c _REC_CUR_20_u2_u2 1.99996948 _CNV_A_R_LINEAR_____393_CM -1. 0.99996948 DISPLAY_IDENTIFIER IP_FAC_VS_PV_GS_COR_MT FORMAT "%8.5"
 /begin AXIS_DESCR COM_AXIS vs_fil _CNV_A_R_LINEAR_____394_CM 8 0. 511.99218 FORMAT "%7.3" AXIS_PTS_REF ldpm_vs_fil__pv_fac_cor /end AXIS_DESCR
/end CHARACTERISTIC
/begin CHARACTERISTIC ip_fac_vs_pv_bas_cor_mt "Vehicle speed correction" CURVE 0x0b76c _REC_CUR_20_u2_u2 1.99996948 _CNV_A_R_LINEAR_____393_CM -1. 0.99996948 DISPLAY_IDENTIFIER IP_FAC_VS_PV_BAS_COR_MT FORMAT "%8.5"
 /begin AXIS_DESCR COM_AXIS vs_fil _CNV_A_R_LINEAR_____394_CM 8 0. 511.99218 FORMAT "%7.3" AXIS_PTS_REF ldpm_vs_fil__pv_fac_cor /end AXIS_DESCR
/end CHARACTERISTIC
/begin CHARACTERISTIC ip_fac_vs_pv_bas_cor_at "Vehicle speed correction" CURVE 0x0b75c _REC_CUR_20_u2_u2 1.99996948 _CNV_A_R_LINEAR_____393_CM -1. 0.99996948 DISPLAY_IDENTIFIER IP_FAC_VS_PV_BAS_COR_AT FORMAT "%8.5"
 /begin AXIS_DESCR COM_AXIS vs_fil _CNV_A_R_LINEAR_____394_CM 8 0. 511.99218 FORMAT "%7.3" AXIS_PTS_REF ldpm_vs_fil__pv_fac_cor /end AXIS_DESCR
/end CHARACTERISTIC
/begin CHARACTERISTIC ip_fac_vs_pv_bas_cor_amt "Vehicle speed correction" CURVE 0x0b74c _REC_CUR_20_u2_u2 1.99996948 _CNV_A_R_LINEAR_____393_CM -1. 0.99996948 DISPLAY_IDENTIFIER IP_FAC_VS_PV_BAS_COR_AMT FORMAT "%8.5"
 /begin AXIS_DESCR COM_AXIS vs_fil _CNV_A_R_LINEAR_____394_CM 8 0. 511.99218 FORMAT "%7.3" AXIS_PTS_REF ldpm_vs_fil__pv_fac_cor /end AXIS_DESCR
/end CHARACTERISTIC
/begin CHARACTERISTIC c_add_fac_pv_bas_mt "Additve correction at reverse gear" VALUE 0x01476 _REC_VAL_20_u2 1.99996948 _CNV_A_R_LINEAR_____393_CM -1. 0.99996948 DISPLAY_IDENTIFIER C_ADD_FAC_PV_BAS_MT FORMAT "%8.5" /end CHARACTERISTIC
/begin CHARACTERISTIC c_add_fac_pv_bas_at "Additve correction at reverse gear" VALUE 0x01474 _REC_VAL_20_u2 1.99996948 _CNV_A_R_LINEAR_____393_CM -1. 0.99996948 DISPLAY_IDENTIFIER C_ADD_FAC_PV_BAS_AT FORMAT "%8.5" /end CHARACTERISTIC
/begin CHARACTERISTIC c_add_fac_pv_bas_amt "Additve correction at reverse gear" VALUE 0x01472 _REC_VAL_20_u2 1.99996948 _CNV_A_R_LINEAR_____393_CM -1. 0.99996948 DISPLAY_IDENTIFIER C_ADD_FAC_PV_BAS_AMT FORMAT "%8.5" /end CHARACTERISTIC
/begin CHARACTERISTIC c_t_fac_pv_gs "Timer switch off GS correction" VALUE 0x01856 _REC_VAL_20_u2 655.34 _CNV_A_R_LINEAR_____4_CM 1.e-002 655.35 DISPLAY_IDENTIFIER C_T_FAC_PV_GS FORMAT "%6.2" /end CHARACTERISTIC
/begin CHARACTERISTIC c_t_fac_pv_cs "Timer switch off CS correction" VALUE 0x01854 _REC_VAL_20_u2 655.34 _CNV_A_R_LINEAR_____4_CM 1.e-002 655.35 DISPLAY_IDENTIFIER C_T_FAC_PV_CS FORMAT "%6.2" /end CHARACTERISTIC
/begin CHARACTERISTIC c_vs_max_fac_pv_cor "Timer switch off CS correction" VALUE 0x0094d _REC_VAL_20_u1 255. _CNV_A_R_LINEAR_____23_CM 0. 255. DISPLAY_IDENTIFIER C_VS_MAX_FAC_PV_COR FORMAT "%3.0" /end CHARACTERISTIC
/begin CHARACTERISTIC c_v_pvs_thd_kd_hys "Hysteresis of kick down recognition Channel 1" VALUE 0x00910 _REC_VAL_20_u1 4.998 _CNV_A_R_LINEAR_____44_CM 0. 4.998 DISPLAY_IDENTIFIER C_V_PVS_THD_KD_HYS FORMAT "%6.4" /end CHARACTERISTIC
/begin CHARACTERISTIC c_v_pvs_thd_kd "Difference between C_V_PVS_SP_FL_1 and kick-down-recognition (Channel 1)" VALUE 0x0090f _REC_VAL_20_u1 4.998 _CNV_A_R_LINEAR_____44_CM 0. 4.998 DISPLAY_IDENTIFIER C_V_PVS_THD_KD FORMAT "%6.4" /end CHARACTERISTIC
/begin MEASUREMENT pv_cru "CRU control variable" UBYTE _CNV_A_R_LINEAR_____10_CM 1 100. 0. 99.609375 DISPLAY_IDENTIFIER PV_CRU ECU_ADDRESS 0x3fe0ab FORMAT "%4.1" /end MEASUREMENT
/begin CHARACTERISTIC ip_pv_cru_rng_l "Scaling factor for requested torque at clutch from driver in low range mode" MAP 0x06b7b _REC_MAP_20_u1_u1_u2 99.609375 _CNV_A_R_LINEAR_____10_CM 0. 99.609375 DISPLAY_IDENTIFIER IP_PV_CRU_RNG_L FORMAT "%4.1"
 /begin AXIS_DESCR COM_AXIS n_32 _CNV_A_R_LINEAR_____16_CM 8 0. 8160. FORMAT "%4.0" AXIS_PTS_REF ldpm_n_32__fac_tq_req_driv /end AXIS_DESCR
 /begin AXIS_DESCR COM_AXIS fac_tq_req_cru _CNV_A_R_LINEAR_____21_CM 8 0. 1.99996948 FORMAT "%7.5" AXIS_PTS_REF ldpm_fac_tq_cru_dcc /end AXIS_DESCR
/end CHARACTERISTIC
/begin CHARACTERISTIC ip_pv_cru "Scaling factor for requested torque at clutch from driver" MAP 0x06b3b _REC_MAP_20_u1_u1_u2 99.609375 _CNV_A_R_LINEAR_____10_CM 0. 99.609375 DISPLAY_IDENTIFIER IP_PV_CRU FORMAT "%4.1"
 /begin AXIS_DESCR COM_AXIS n_32 _CNV_A_R_LINEAR_____16_CM 8 0. 8160. FORMAT "%4.0" AXIS_PTS_REF ldpm_n_32__fac_tq_req_driv /end AXIS_DESCR
 /begin AXIS_DESCR COM_AXIS fac_tq_req_cru _CNV_A_R_LINEAR_____21_CM 8 0. 1.99996948 FORMAT "%7.5" AXIS_PTS_REF ldpm_fac_tq_cru_dcc /end AXIS_DESCR
/end CHARACTERISTIC
/begin AXIS_PTS ldp_n_32__pv_lih_max "" 0x01044 n_32 _REC_AXS_20_u1 816. _CNV_A_R_LINEAR_____16_CM 6 0. 8160. DISPLAY_IDENTIFIER LDP_N_32__PV_LIH_MAX FORMAT "%4.0" /end AXIS_PTS
/begin AXIS_PTS ldpm_vs_fil__pv_fac_cor "" 0x11ce6 vs_fil _REC_AXS_20_u2 51.199218 _CNV_A_R_LINEAR_____394_CM 8 0. 511.99218 DISPLAY_IDENTIFIER LDPM_VS_FIL__PV_FAC_COR FORMAT "%7.3" /end AXIS_PTS
/begin AXIS_PTS ldpm_n_dif__pv_fac_cor "" 0x11946 n_dif _REC_AXS_20_u2 6553.5 _CNV_A_R_LINEAR_____206_CM 6 -32768. 32767. DISPLAY_IDENTIFIER LDPM_N_DIF__PV_FAC_COR FORMAT "%6.0" /end AXIS_PTS
/begin AXIS_PTS ldpm_n__pv_fac_cor "" 0x11938 n _REC_AXS_20_u2 815.9 _CNV_A_R_LINEAR_____11_CM 6 1. 8160. DISPLAY_IDENTIFIER LDPM_N__PV_FAC_COR FORMAT "%4.0" /end AXIS_PTS
/begin AXIS_PTS ldpm_pv_av_raw__pv_fac_cor "" 0x0139b pv_av_raw _REC_AXS_20_u1 9.9609375 _CNV_A_R_LINEAR_____10_CM 6 0. 99.609375 DISPLAY_IDENTIFIER LDPM_PV_AV_RAW__PV_FAC_COR FORMAT "%4.1" /end AXIS_PTS
/begin AXIS_PTS ldpm_n_32__fac_tq_req_driv "" 0x08073 n_32 _REC_AXS_20_u1 8160. _CNV_A_R_LINEAR_____16_CM 8 0. 8160. DISPLAY_IDENTIFIER LDPM_N_32__FAC_TQ_REQ_DRIV FORMAT "%4.0" /end AXIS_PTS
/begin AXIS_PTS ldpm_fac_tq_cru_dcc "" 0x11652 fac_tq_req_cru _REC_AXS_20_u2 1.99996948 _CNV_A_R_LINEAR_____21_CM 8 0. 1.99996948 DISPLAY_IDENTIFIER LDPM_FAC_TQ_CRU_DCC FORMAT "%7.5" /end AXIS_PTS
/begin CHARACTERISTIC c_t_es_tco_plaus_max "Threshold for maximum T_ES time" VALUE 0x01850 _REC_VAL_20_u2 65535. _CNV_A_R_LINEAR_____97_CM 0. 65535. DISPLAY_IDENTIFIER C_T_ES_TCO_PLAUS_MAX FORMAT "%5.0" /end CHARACTERISTIC
/begin CHARACTERISTIC c_t_es_tco_plaus_min "Threshold for minimum T_ES time" VALUE 0x01852 _REC_VAL_20_u2 65535. _CNV_A_R_LINEAR_____97_CM 0. 65535. DISPLAY_IDENTIFIER C_T_ES_TCO_PLAUS_MIN FORMAT "%5.0" /end CHARACTERISTIC
/begin CHARACTERISTIC c_tco_stop_t_es_plaus_min "Threshold for minimum differences of cooling temperature " VALUE 0x0089e _REC_VAL_20_u1 190.5 _CNV_A_R_LINEAR_____13_CM 0. 190.5 DISPLAY_IDENTIFIER C_TCO_STOP_T_ES_PLAUS_MIN FORMAT "%5.1" /end CHARACTERISTIC
/begin CHARACTERISTIC c_t_es_sub "substitute value of T_ES" VALUE 0x0184a _REC_VAL_20_u2 65535. _CNV_A_R_LINEAR_____97_CM 0. 65535. DISPLAY_IDENTIFIER C_T_ES_SUB FORMAT "%5.0" /end CHARACTERISTIC
/begin CHARACTERISTIC c_tco_stop_t_es_plaus_max "Threshold for maximum differences of cooling temperature" VALUE 0x0089d _REC_VAL_20_u1 190.5 _CNV_A_R_LINEAR_____13_CM 0. 190.5 DISPLAY_IDENTIFIER C_TCO_STOP_T_ES_PLAUS_MAX FORMAT "%5.1" /end CHARACTERISTIC
/begin CHARACTERISTIC c_tco_stop_t_es_min "Threshold for minimum cooling temperature at engine stop" VALUE 0x0089c _REC_VAL_20_u1 190.5 _CNV_A_R_LINEAR_____12_CM -48. 142.5 DISPLAY_IDENTIFIER C_TCO_STOP_T_ES_MIN FORMAT "%5.1" /end CHARACTERISTIC
/begin MEASUREMENT t_es "Engine off duration" UWORD _CNV_A_R_LINEAR_____97_CM 1 100. 0. 65535. DISPLAY_IDENTIFIER T_ES ECU_ADDRESS 0x3fd3f6 BYTE_ORDER MSB_LAST FORMAT "%5.0" /end MEASUREMENT
/begin MEASUREMENT t_rel_can_es "Time counter value at the start of engine off phase" UWORD _CNV_A_R_LINEAR_____97_CM 1 100. 0. 65535. DISPLAY_IDENTIFIER T_REL_CAN_ES ECU_ADDRESS 0x3fd3f8 BYTE_ORDER MSB_LAST FORMAT "%5.0" /end MEASUREMENT
/begin MEASUREMENT t_rel_can_st "Time counter value at the end of engine off phase" UWORD _CNV_A_R_LINEAR_____97_CM 1 100. 0. 65535. DISPLAY_IDENTIFIER T_REL_CAN_ST ECU_ADDRESS 0x3fd3fa BYTE_ORDER MSB_LAST FORMAT "%5.0" /end MEASUREMENT
/begin MEASUREMENT lv_t_rel_can_reg "T_REL_CAN receiving of INSTR2 message" UBYTE _CNV_S_2_RANGE______0_CM 1 100. 0. 1. DISPLAY_IDENTIFIER LV_T_REL_CAN_REG ECU_ADDRESS 0x3fe22e /end MEASUREMENT
/begin MEASUREMENT lv_t_es_not_plaus "T_ES not plausible" UBYTE _CNV_S_2_RANGE______0_CM 1 100. 0. 1. DISPLAY_IDENTIFIER LV_T_ES_NOT_PLAUS ECU_ADDRESS 0x3fe22f /end MEASUREMENT
/begin CHARACTERISTIC c_t_tco_sub_is_2 "interrupt time TCO model during IS" VALUE 0x018ae _REC_VAL_20_u2 65535. _CNV_A_R_LINEAR_____30_CM 0. 65535. DISPLAY_IDENTIFIER C_T_TCO_SUB_IS_2 FORMAT "%5.0" /end CHARACTERISTIC
/begin CHARACTERISTIC c_t_tco_sub_puc "interrupt time TCO model during PUC" VALUE 0x018b0 _REC_VAL_20_u2 65535. _CNV_A_R_LINEAR_____30_CM 0. 65535. DISPLAY_IDENTIFIER C_T_TCO_SUB_PUC FORMAT "%5.0" /end CHARACTERISTIC
/begin CHARACTERISTIC c_tco_sub_bol_2 "TCO substitute temperature 1 " VALUE 0x008a0 _REC_VAL_20_u1 28.575 _CNV_A_R_LINEAR_____12_CM -48. 142.5 DISPLAY_IDENTIFIER C_TCO_SUB_BOL_2 FORMAT "%5.1" /end CHARACTERISTIC
/begin CHARACTERISTIC c_tco_sub_tol "upper limit TCO substitute temperature" VALUE 0x008a1 _REC_VAL_20_u1 28.575 _CNV_A_R_LINEAR_____12_CM -48. 142.5 DISPLAY_IDENTIFIER C_TCO_SUB_TOL FORMAT "%5.1" /end CHARACTERISTIC
/begin CHARACTERISTIC c_tia_diag "TIA threshold - TCO diagnosis" VALUE 0x008c8 _REC_VAL_20_u1 28.575 _CNV_A_R_LINEAR_____12_CM -48. 142.5 DISPLAY_IDENTIFIER C_TIA_DIAG FORMAT "%5.1" /end CHARACTERISTIC
/begin CHARACTERISTIC ip_tco_sub_inc__maf_kgh "TCO increment" CURVE 0x00e43 _REC_CUR_20_u1_u2 37.95 _CNV_A_R_LINEAR_____411_CM 0.75 190.5 DISPLAY_IDENTIFIER IP_TCO_SUB_INC__MAF_KGH FORMAT "%6.2"
 /begin AXIS_DESCR COM_AXIS maf_kgh _CNV_A_R_LINEAR_____113_CM 4 0. 2047.96875 FORMAT "%7.2" AXIS_PTS_REF ldp_maf_kgh__tco_sub_inc /end AXIS_DESCR
/end CHARACTERISTIC
/begin MEASUREMENT tco_sub "Substitute calculated TCO value" UBYTE _CNV_A_R_LINEAR_____12_CM 1 100. -48. 142.5 DISPLAY_IDENTIFIER TCO_SUB ECU_ADDRESS 0x3fe106 FORMAT "%5.1" /end MEASUREMENT
/begin MEASUREMENT tco_stop "Coolant temperature at transition to ES" UBYTE _CNV_A_R_LINEAR_____12_CM 1 100. -48. 142.5 DISPLAY_IDENTIFIER TCO_STOP ECU_ADDRESS 0x3fe107 FORMAT "%5.1" /end MEASUREMENT
/begin CHARACTERISTIC c_tco_sub_bol_1 "TCO substitute temperature 1 " VALUE 0x0089f _REC_VAL_20_u1 28.575 _CNV_A_R_LINEAR_____12_CM -48. 142.5 DISPLAY_IDENTIFIER C_TCO_SUB_BOL_1 FORMAT "%5.1" /end CHARACTERISTIC
/begin MEASUREMENT tco "coolant temperature" UBYTE _CNV_A_R_LINEAR_____12_CM 1 100. -48. 142.5 DISPLAY_IDENTIFIER TCO ECU_ADDRESS 0x3fe104 FORMAT "%5.1" /end MEASUREMENT
/begin MEASUREMENT tco_mes "measured coolant temperature" UBYTE _CNV_A_R_LINEAR_____12_CM 1 100. -48. 142.5 DISPLAY_IDENTIFIER TCO_MES ECU_ADDRESS 0x3fe105 FORMAT "%5.1" /end MEASUREMENT
/begin MEASUREMENT tco_st "coolant temperature at engine start" UBYTE _CNV_A_R_LINEAR_____12_CM 1 100. -48. 142.5 DISPLAY_IDENTIFIER TCO_ST ECU_ADDRESS 0x3fe108 FORMAT "%5.1" /end MEASUREMENT
/begin AXIS_PTS ldp_maf_kgh__tco_sub_inc "" 0x10cee maf_kgh _REC_AXS_20_u2 2047.96875 _CNV_A_R_LINEAR_____113_CM 4 0. 2047.96875 DISPLAY_IDENTIFIER LDP_MAF_KGH__TCO_SUB_INC FORMAT "%7.2" /end AXIS_PTS
/begin CHARACTERISTIC c_tco_ex_dif_diag "Difference between TCO and TCO - TCO_EX diagnosis" VALUE 0x00869 _REC_VAL_20_u1 190.5 _CNV_A_R_LINEAR_____12_CM -48. 142.5 DISPLAY_IDENTIFIER C_TCO_EX_DIF_DIAG FORMAT "%5.1" /end CHARACTERISTIC
/begin MEASUREMENT tco_ex_st "Radiator outlet coolant temperature at engine start" UBYTE _CNV_A_R_LINEAR_____12_CM 1 100. -48. 142.5 DISPLAY_IDENTIFIER TCO_EX_ST ECU_ADDRESS 0x3fe10b FORMAT "%5.1" /end MEASUREMENT
/begin MEASUREMENT tco_ex "Radiator outlet temperature" UBYTE _CNV_A_R_LINEAR_____12_CM 1 100. -48. 142.5 DISPLAY_IDENTIFIER TCO_EX ECU_ADDRESS 0x3fe109 FORMAT "%5.1" /end MEASUREMENT
/begin MEASUREMENT tco_ex_mes "Radiator outlet temperature" UBYTE _CNV_A_R_LINEAR_____12_CM 1 100. -48. 142.5 DISPLAY_IDENTIFIER TCO_EX_MES ECU_ADDRESS 0x3fe10a FORMAT "%5.1" /end MEASUREMENT
/begin CHARACTERISTIC ip_tco__v_tco "Conversion table for linearization of TCO value acquisition" CURVE 0x074ff _REC_CUR_20_u1_u2 28.575 _CNV_A_R_LINEAR_____12_CM -48. 142.5 DISPLAY_IDENTIFIER IP_TCO__V_TCO FORMAT "%5.1"
 /begin AXIS_DESCR COM_AXIS online_dummy _CNV_A_R_LINEAR_____412_CM 16 7.8125e-002 4.99511719 FORMAT "%5.3" AXIS_PTS_REF ldp_v_tco__tco /end AXIS_DESCR
/end CHARACTERISTIC
/begin AXIS_PTS ldp_v_tco__tco "" 0x1145e online_dummy _REC_AXS_20_u2 4.425292971 _CNV_A_R_LINEAR_____412_CM 16 7.8125e-002 4.99511719 DISPLAY_IDENTIFIER LDP_V_TCO__TCO FORMAT "%5.3" /end AXIS_PTS
/begin CHARACTERISTIC c_t_tco_sub_is_1 "max. time in IS before interrupt of TCO model" VALUE 0x018ac _REC_VAL_20_u2 65535. _CNV_A_R_LINEAR_____30_CM 0. 65535. DISPLAY_IDENTIFIER C_T_TCO_SUB_IS_1 FORMAT "%5.0" /end CHARACTERISTIC
/begin CHARACTERISTIC c_t_dly_tco_sub "Delay time before TCO_SUB calculation is started" VALUE 0x00809 _REC_VAL_20_u1 255. _CNV_A_R_LINEAR_____30_CM 0. 255. DISPLAY_IDENTIFIER C_T_DLY_TCO_SUB FORMAT "%3.0" /end CHARACTERISTIC
/begin MEASUREMENT ctr_stc_tecu_1 "statistic counter 1 for TECU monitoring" UWORD _CNV_A_R_LINEAR_____1_CM 1 100. 0. 65535. DISPLAY_IDENTIFIER CTR_STC_TECU_1 ECU_ADDRESS 0x3fd2f8 BYTE_ORDER MSB_LAST FORMAT "%5.0" /end MEASUREMENT
/begin MEASUREMENT ctr_stc_tecu_2 "statistic counter 2 for TECU monitoring" UWORD _CNV_A_R_LINEAR_____1_CM 1 100. 0. 65535. DISPLAY_IDENTIFIER CTR_STC_TECU_2 ECU_ADDRESS 0x3fd2fa BYTE_ORDER MSB_LAST FORMAT "%5.0" /end MEASUREMENT
/begin MEASUREMENT ctr_stc_tecu_3 "statistic counter 3 for TECU monitoring" UWORD _CNV_A_R_LINEAR_____1_CM 1 100. 0. 65535. DISPLAY_IDENTIFIER CTR_STC_TECU_3 ECU_ADDRESS 0x3fd2fc BYTE_ORDER MSB_LAST FORMAT "%5.0" /end MEASUREMENT
/begin CHARACTERISTIC ip_tecu "NTC characteristic" CURVE 0x0750f _REC_CUR_20_u1_u2 190.5 _CNV_A_R_LINEAR_____12_CM -48. 142.5 DISPLAY_IDENTIFIER IP_TECU FORMAT "%5.1"
 /begin AXIS_DESCR COM_AXIS v_tecu _CNV_A_R_LINEAR_____3_CM 16 0. 4.99511719 FORMAT "%5.3" AXIS_PTS_REF ldp_v_tecu__tecu /end AXIS_DESCR
/end CHARACTERISTIC
/begin CHARACTERISTIC c_tecu_sub "TECU substitute value" VALUE 0x008b2 _REC_VAL_20_u1 190.5 _CNV_A_R_LINEAR_____12_CM -48. 142.5 DISPLAY_IDENTIFIER C_TECU_SUB FORMAT "%5.1" /end CHARACTERISTIC
/begin CHARACTERISTIC c_tecu_thd_1 "ETCU threshold 1" VALUE 0x018ce _REC_VAL_20_u2 65535. _CNV_A_R_LINEAR_____1_CM 0. 65535. DISPLAY_IDENTIFIER C_TECU_THD_1 FORMAT "%5.0" /end CHARACTERISTIC
/begin CHARACTERISTIC c_tecu_thd_2 "ETCU threshold 2" VALUE 0x018d0 _REC_VAL_20_u2 65535. _CNV_A_R_LINEAR_____1_CM 0. 65535. DISPLAY_IDENTIFIER C_TECU_THD_2 FORMAT "%5.0" /end CHARACTERISTIC
/begin CHARACTERISTIC c_tecu_thd_3 "ETCU threshold 3" VALUE 0x018d2 _REC_VAL_20_u2 65535. _CNV_A_R_LINEAR_____1_CM 0. 65535. DISPLAY_IDENTIFIER C_TECU_THD_3 FORMAT "%5.0" /end CHARACTERISTIC
/begin CHARACTERISTIC c_trt_dif_tecu "TRT difference for ETCU statistic" VALUE 0x01444 _REC_VAL_20_u4 119304.6471 _CNV_A_R_LINEAR_____171_CM 0. 119304.6471 DISPLAY_IDENTIFIER C_TRT_DIF_TECU FORMAT "%12.5" /end CHARACTERISTIC
/begin MEASUREMENT tecu "ECU temperature" UBYTE _CNV_A_R_LINEAR_____12_CM 1 100. -48. 142.5 DISPLAY_IDENTIFIER TECU ECU_ADDRESS 0x3fe12e FORMAT "%5.1" /end MEASUREMENT
/begin MEASUREMENT tecu_mes "???" UBYTE _CNV_A_R_LINEAR_____12_CM 1 100. -48. 142.5 DISPLAY_IDENTIFIER TECU_MES ECU_ADDRESS 0x3fe12f FORMAT "%5.1" /end MEASUREMENT
/begin AXIS_PTS ldp_v_tecu__tecu "" 0x11480 v_tecu _REC_AXS_20_u2 4.495605471 _CNV_A_R_LINEAR_____3_CM 16 0. 4.99511719 DISPLAY_IDENTIFIER LDP_V_TECU__TECU FORMAT "%5.3" /end AXIS_PTS
/begin MEASUREMENT teg_pcat_down_1 "exhaust gas temperature of precat" UWORD _CNV_A_R_LINEAR_____413_CM 1 100. 0. 1023.984375 DISPLAY_IDENTIFIER TEG_PCAT_DOWN_1 ECU_ADDRESS 0x3fd290 BYTE_ORDER MSB_LAST FORMAT "%6.1" /end MEASUREMENT
/begin MEASUREMENT teg_pcat_down_2 "exhaust gas temperature of precat" UWORD _CNV_A_R_LINEAR_____413_CM 1 100. 0. 1023.984375 DISPLAY_IDENTIFIER TEG_PCAT_DOWN_2 ECU_ADDRESS 0x3fd294 BYTE_ORDER MSB_LAST FORMAT "%6.1" /end MEASUREMENT
/begin MEASUREMENT teg_pcat_down_raw_2 "exhaust gas temperature of precat,raw value i.e. not replaced by substitde value" UWORD _CNV_A_R_LINEAR_____413_CM 1 100. 0. 1023.984375 DISPLAY_IDENTIFIER TEG_PCAT_DOWN_RAW_2 ECU_ADDRESS 0x3fd296 BYTE_ORDER MSB_LAST FORMAT "%6.1" /end MEASUREMENT
/begin MEASUREMENT teg_pcat_down_raw_1 "exhaust gas temperature of precat,raw value i.e. not replaced by substitde value" UWORD _CNV_A_R_LINEAR_____413_CM 1 100. 0. 1023.984375 DISPLAY_IDENTIFIER TEG_PCAT_DOWN_RAW_1 ECU_ADDRESS 0x3fd292 BYTE_ORDER MSB_LAST FORMAT "%6.1" /end MEASUREMENT
/begin CHARACTERISTIC ip_teg__v_teg "convertion table of exhaust gas temperature" CURVE 0x0ebf2 _REC_CUR_20_u2_u2 1023.984375 _CNV_A_R_LINEAR_____413_CM 0. 1023.984375 DISPLAY_IDENTIFIER IP_TEG__V_TEG FORMAT "%6.1"
 /begin AXIS_DESCR COM_AXIS online_dummy _CNV_A_R_LINEAR_____3_CM 16 0. 4.99511719 FORMAT "%5.3" AXIS_PTS_REF ldp_v_teg__teg /end AXIS_DESCR
/end CHARACTERISTIC
/begin AXIS_PTS ldp_v_teg__teg "" 0x114a2 online_dummy _REC_AXS_20_u2 4.99511719 _CNV_A_R_LINEAR_____3_CM 16 0. 4.99511719 DISPLAY_IDENTIFIER LDP_V_TEG__TEG FORMAT "%5.3" /end AXIS_PTS
/begin CHARACTERISTIC ip_fac_ar_red_dif "P-value reduced throttle area (MAF-controlled)" CURVE 0x00aa8 _REC_CUR_20_u1_u1 0.99610001 _CNV_A_R_LINEAR_____29_CM 0. 0.99610001 DISPLAY_IDENTIFIER IP_FAC_AR_RED_DIF FORMAT "%5.3"
 /begin AXIS_DESCR COM_AXIS maf_turb_ratio _CNV_A_R_LINEAR_____29_CM 8 0. 0.99610001 FORMAT "%5.3" AXIS_PTS_REF ldp_maf_turb_ratio /end AXIS_DESCR
/end CHARACTERISTIC
/begin AXIS_PTS ldp_maf_turb_ratio "" 0x07ba5 maf_turb_ratio _REC_AXS_20_u1 0.99610001 _CNV_A_R_LINEAR_____29_CM 8 0. 0.99610001 DISPLAY_IDENTIFIER LDP_MAF_TURB_RATIO FORMAT "%5.3" /end AXIS_PTS
/begin CHARACTERISTIC c_tia_grd_max_diag "Maximum permissible gradient for TIA" VALUE 0x008cb _REC_VAL_20_u1 38.1 _CNV_A_R_LINEAR_____442_CM 0. 190.5 DISPLAY_IDENTIFIER C_TIA_GRD_MAX_DIAG FORMAT "%4.1" /end CHARACTERISTIC
/begin CHARACTERISTIC ip_tia__v_tia "NTC characteristic" CURVE 0x0798b _REC_CUR_20_u1_u1 28.575 _CNV_A_R_LINEAR_____12_CM -48. 142.5 DISPLAY_IDENTIFIER IP_TIA__V_TIA FORMAT "%5.1"
 /begin AXIS_DESCR COM_AXIS v_tia _CNV_A_R_LINEAR_____443_CM 16 3.90625e-002 4.98046875 FORMAT "%5.3" AXIS_PTS_REF ldp_v_tia_tia /end AXIS_DESCR
/end CHARACTERISTIC
/begin MEASUREMENT tia_sub "" UBYTE _CNV_A_R_LINEAR_____12_CM 1 100. -48. 142.5 DISPLAY_IDENTIFIER TIA_SUB ECU_ADDRESS 0x3fe11d FORMAT "%3.0" /end MEASUREMENT
/begin MEASUREMENT tia "Intake air temperature" UBYTE _CNV_A_R_LINEAR_____12_CM 1 100. -48. 142.5 DISPLAY_IDENTIFIER TIA ECU_ADDRESS 0x3fe11c FORMAT "%5.1" /end MEASUREMENT
/begin MEASUREMENT tia_mes "???" UBYTE _CNV_A_R_LINEAR_____12_CM 1 100. -48. 142.5 DISPLAY_IDENTIFIER TIA_MES ECU_ADDRESS 0x3fe11e FORMAT "%5.1" /end MEASUREMENT
/begin AXIS_PTS ldp_v_tia_tia "" 0x07e9e v_tia _REC_AXS_20_u1 4.447265625 _CNV_A_R_LINEAR_____443_CM 16 3.90625e-002 4.98046875 DISPLAY_IDENTIFIER LDP_V_TIA_TIA FORMAT "%5.3" /end AXIS_PTS
/begin CHARACTERISTIC c_tco_diag "TCO threshold for calculation of substitutes" VALUE 0x00863 _REC_VAL_20_u1 28.575 _CNV_A_R_LINEAR_____12_CM -48. 142.5 DISPLAY_IDENTIFIER C_TCO_DIAG FORMAT "%5.1" /end CHARACTERISTIC
/begin CHARACTERISTIC c_tia_sub_tol "Intake air substitute temperature" VALUE 0x008d9 _REC_VAL_20_u1 28.575 _CNV_A_R_LINEAR_____12_CM -48. 142.5 DISPLAY_IDENTIFIER C_TIA_SUB_TOL FORMAT "%5.1" /end CHARACTERISTIC
/begin CHARACTERISTIC c_tia_sub_bol "Intake air substitute temperature" VALUE 0x008d8 _REC_VAL_20_u1 28.575 _CNV_A_R_LINEAR_____12_CM -48. 142.5 DISPLAY_IDENTIFIER C_TIA_SUB_BOL FORMAT "%5.1" /end CHARACTERISTIC
/begin MEASUREMENT tps_av_1 "Opening angle of the throttle valve of TPS-Poti 1" UWORD _CNV_A_R_LINEAR_____53_CM 1 100. 0. 119.5 DISPLAY_IDENTIFIER TPS_AV_1 ECU_ADDRESS 0x3fd78c BYTE_ORDER MSB_LAST FORMAT "%7.3" /end MEASUREMENT
/begin MEASUREMENT tps_av_2 "Opening angle of the throttle valve of TPS-Poti 2" UWORD _CNV_A_R_LINEAR_____53_CM 1 100. 0. 119.5 DISPLAY_IDENTIFIER TPS_AV_2 ECU_ADDRESS 0x3fd78e BYTE_ORDER MSB_LAST FORMAT "%7.3" /end MEASUREMENT
/begin MEASUREMENT tps_grd "Throttle position gradient, absolute value" UBYTE _CNV_A_R_LINEAR_____52_CM 1 100. 0. 2987.5 DISPLAY_IDENTIFIER TPS_GRD ECU_ADDRESS 0x3fe4f5 FORMAT "%4.0" /end MEASUREMENT
/begin MEASUREMENT tps_seg "Segment synchronous measured throttle valve position" UWORD _CNV_A_R_LINEAR_____53_CM 1 100. 0. 119.5 DISPLAY_IDENTIFIER TPS_SEG ECU_ADDRESS 0x3fd794 BYTE_ORDER MSB_LAST FORMAT "%7.3" /end MEASUREMENT
/begin MEASUREMENT tps_seg_1 "Segment synchronous measured throttle valve position channel 1" UWORD _CNV_A_R_LINEAR_____53_CM 1 100. 0. 119.5 DISPLAY_IDENTIFIER TPS_SEG_1 ECU_ADDRESS 0x3fd796 BYTE_ORDER MSB_LAST FORMAT "%7.3" /end MEASUREMENT
/begin MEASUREMENT tps_seg_2 "Segment synchronous measured throttle valve position channel 2" UWORD _CNV_A_R_LINEAR_____53_CM 1 100. 0. 119.5 DISPLAY_IDENTIFIER TPS_SEG_2 ECU_ADDRESS 0x3fd798 BYTE_ORDER MSB_LAST FORMAT "%7.3" /end MEASUREMENT
/begin MEASUREMENT tps_seg_gain_1 "Segment synchronous measured throttle valve position amplified channel 1" UWORD _CNV_A_R_LINEAR_____53_CM 1 100. 0. 119.5 DISPLAY_IDENTIFIER TPS_SEG_GAIN_1 ECU_ADDRESS 0x3fd79a BYTE_ORDER MSB_LAST FORMAT "%7.3" /end MEASUREMENT
/begin MEASUREMENT tps_av_gain_1 "Opening angle of the throttle valve of amplified TPS-Poti 1" UWORD _CNV_A_R_LINEAR_____53_CM 1 100. 0. 119.5 DISPLAY_IDENTIFIER TPS_AV_GAIN_1 ECU_ADDRESS 0x3fd7a0 BYTE_ORDER MSB_LAST FORMAT "%7.3" /end MEASUREMENT
/begin MEASUREMENT v_tps_gain_tol_ena_1 "TPS1-voltage to switch from amplified to non-amplified sensor signal" UWORD _CNV_A_R_LINEAR_____3_CM 1 100. 0. 4.99511719 DISPLAY_IDENTIFIER V_TPS_GAIN_TOL_ENA_1 ECU_ADDRESS 0x3fd7a2 BYTE_ORDER MSB_LAST FORMAT "%5.3" /end MEASUREMENT
/begin MEASUREMENT v_tps_gain_bol_ena_1 "TPS1-voltage to switch from non-amplified to amplified sensor signal" UWORD _CNV_A_R_LINEAR_____3_CM 1 100. 0. 4.99511719 DISPLAY_IDENTIFIER V_TPS_GAIN_BOL_ENA_1 ECU_ADDRESS 0x3fd7a4 BYTE_ORDER MSB_LAST FORMAT "%5.3" /end MEASUREMENT
/begin CHARACTERISTIC c_v_tps_swi_gain_1 "" VALUE 0x019ca _REC_VAL_20_u2 4.99511719 _CNV_A_R_LINEAR_____3_CM 0. 4.99511719 DISPLAY_IDENTIFIER C_V_TPS_SWI_GAIN_1 FORMAT "%5.3" /end CHARACTERISTIC
/begin CHARACTERISTIC c_v_tps_hys_gain_1 "" VALUE 0x019be _REC_VAL_20_u2 4.99511719 _CNV_A_R_LINEAR_____3_CM 0. 4.99511719 DISPLAY_IDENTIFIER C_V_TPS_HYS_GAIN_1 FORMAT "%5.3" /end CHARACTERISTIC
/begin MEASUREMENT tps_lih "Limp home position of the throttle valve" UWORD _CNV_A_R_LINEAR_____53_CM 1 100. 0. 119.5 DISPLAY_IDENTIFIER TPS_LIH ECU_ADDRESS 0x3fd792 BYTE_ORDER MSB_LAST FORMAT "%7.3" /end MEASUREMENT
/begin MEASUREMENT tps_av "Opening angle of the throttle valve" UWORD _CNV_A_R_LINEAR_____53_CM 1 100. 0. 119.5 DISPLAY_IDENTIFIER TPS_AV ECU_ADDRESS 0x3fd78a BYTE_ORDER MSB_LAST FORMAT "%7.3" /end MEASUREMENT
/begin MEASUREMENT tps_av_ctl "Control opening angle of the throttle valve" SWORD _CNV_A_R_LINEAR_____365_CM 1 100. -119.5 119.5 DISPLAY_IDENTIFIER TPS_AV_CTL ECU_ADDRESS 0x3fd790 BYTE_ORDER MSB_LAST FORMAT "%8.3" /end MEASUREMENT
/begin MEASUREMENT tps_av_ctl_1 "Control opening angle of the throttle valve of TPS-Poti 1" SWORD _CNV_A_R_LINEAR_____365_CM 1 100. -119.5 119.5 DISPLAY_IDENTIFIER TPS_AV_CTL_1 ECU_ADDRESS 0x3fd79c BYTE_ORDER MSB_LAST FORMAT "%8.3" /end MEASUREMENT
/begin MEASUREMENT tps_av_ctl_2 "Control opening angle of the throttle valve of TPS-Poti 2" SWORD _CNV_A_R_LINEAR_____365_CM 1 100. -119.5 119.5 DISPLAY_IDENTIFIER TPS_AV_CTL_2 ECU_ADDRESS 0x3fd79e BYTE_ORDER MSB_LAST FORMAT "%8.3" /end MEASUREMENT
/begin MEASUREMENT tps_av_ctl_gain_1 "Control opening angle of the throttle valve of amplified TPS-Poti 1" SWORD _CNV_A_R_LINEAR_____365_CM 1 100. -119.5 119.5 DISPLAY_IDENTIFIER TPS_AV_CTL_GAIN_1 ECU_ADDRESS 0x3fd7ac BYTE_ORDER MSB_LAST FORMAT "%8.3" /end MEASUREMENT
/begin CHARACTERISTIC c_v_tps_grd_max "" VALUE 0x019bc _REC_VAL_20_u2 4.99511719 _CNV_A_R_LINEAR_____3_CM 0. 4.99511719 DISPLAY_IDENTIFIER C_V_TPS_GRD_MAX FORMAT "%5.3" /end CHARACTERISTIC
/begin CHARACTERISTIC c_v_tps_gain_grd_max "TPS voltage gradient limitation" VALUE 0x019ba _REC_VAL_20_u2 4.99511719 _CNV_A_R_LINEAR_____3_CM 0. 4.99511719 DISPLAY_IDENTIFIER C_V_TPS_GAIN_GRD_MAX FORMAT "%5.3" /end CHARACTERISTIC
/begin MEASUREMENT lv_tps_gain_act_1 "Logical variable for TPS_AV based on amplified TPS 1 " UBYTE _CNV_S_2_RANGE______0_CM 1 100. 0. 1. DISPLAY_IDENTIFIER LV_TPS_GAIN_ACT_1 ECU_ADDRESS 0x3fe4f6 BIT_MASK 0x1 /end MEASUREMENT
/begin MEASUREMENT lv_tps_grd_up "Logical variable for throttle position gradient direction" UBYTE _CNV_S_2_RANGE______0_CM 1 100. 0. 1. DISPLAY_IDENTIFIER LV_TPS_GRD_UP ECU_ADDRESS 0x3fe4f7 /end MEASUREMENT
/begin CHARACTERISTIC c_tps_slop "" VALUE 0x01946 _REC_VAL_20_u2 48. _CNV_A_R_LINEAR_____446_CM 0. 48. DISPLAY_IDENTIFIER C_TPS_SLOP FORMAT "%7.4" /end CHARACTERISTIC
/begin CHARACTERISTIC c_tps_max "Maximum mechanical opening angle of the throttle valve in degree" VALUE 0x01940 _REC_VAL_20_u2 119.5 _CNV_A_R_LINEAR_____53_CM 0. 119.5 DISPLAY_IDENTIFIER C_TPS_MAX /end CHARACTERISTIC
/begin CHARACTERISTIC ip_tq_loss_acc_inp "ACC torque loss due to engine-speed and ACC torque demand" MAP 0x0fc2a _REC_MAP_20_u2_u1_u1 2047.96875 _CNV_A_R_LINEAR_____186_CM -1024. 1023.96875 DISPLAY_IDENTIFIER IP_TQ_LOSS_ACC_INP FORMAT "%6.2"
 /begin AXIS_DESCR COM_AXIS n_32 _CNV_A_R_LINEAR_____16_CM 6 0. 8160. FORMAT "%4.0" AXIS_PTS_REF ldp_n_32__tq_loss_acc /end AXIS_DESCR
 /begin AXIS_DESCR COM_AXIS tq_accin_can _CNV_A_R_LINEAR_____95_CM 6 0. 31. FORMAT "%3.0" AXIS_PTS_REF ldp_tq_accin_can__tq_loss_acc /end AXIS_DESCR
/end CHARACTERISTIC
/begin AXIS_PTS ldp_n_32__tq_loss_acc "" 0x0106c n_32 _REC_AXS_20_u1 8160. _CNV_A_R_LINEAR_____16_CM 6 0. 8160. DISPLAY_IDENTIFIER LDP_N_32__TQ_LOSS_ACC FORMAT "%4.0" /end AXIS_PTS
/begin AXIS_PTS ldp_tq_accin_can__tq_loss_acc "" 0x01255 tq_accin_can _REC_AXS_20_u1 31. _CNV_A_R_LINEAR_____95_CM 6 0. 31. DISPLAY_IDENTIFIER LDP_TQ_ACCIN_CAN__TQ_LOSS_ACC FORMAT "%3.0" /end AXIS_PTS
/begin MEASUREMENT lv_err_bn_etcu "Present error BN2000" UBYTE _CNV_S_2_RANGE______2_R_CM 1 100. 0. 255. DISPLAY_IDENTIFIER LV_ERR_BN_ETCU ECU_ADDRESS 0x3fbae0 /end MEASUREMENT
/begin MEASUREMENT lv_err_bn_tq_amt "Present error BN2000" UBYTE _CNV_S_2_RANGE______2_R_CM 1 100. 0. 255. DISPLAY_IDENTIFIER LV_ERR_BN_TQ_AMT ECU_ADDRESS 0x3fbae4 /end MEASUREMENT
/begin MEASUREMENT lv_err_bn_ars "Present error BN2000" UBYTE _CNV_S_2_RANGE______2_R_CM 1 100. 0. 255. DISPLAY_IDENTIFIER LV_ERR_BN_ARS ECU_ADDRESS 0x3fbac8 /end MEASUREMENT
/begin MEASUREMENT lv_err_bn_tq_dcc "Present error BN2000" UBYTE _CNV_S_2_RANGE______2_R_CM 1 100. 0. 255. DISPLAY_IDENTIFIER LV_ERR_BN_TQ_DCC ECU_ADDRESS 0x3fbac0 /end MEASUREMENT
/begin MEASUREMENT lv_err_bn_tq_tcs "Present error BN2000" UBYTE _CNV_S_2_RANGE______2_R_CM 1 100. 0. 255. DISPLAY_IDENTIFIER LV_ERR_BN_TQ_TCS ECU_ADDRESS 0x3fbad0 /end MEASUREMENT
/begin MEASUREMENT lv_err_bn_vs_tcs "Present error BN2000" UBYTE _CNV_S_2_RANGE______2_R_CM 1 100. 0. 255. DISPLAY_IDENTIFIER LV_ERR_BN_VS_TCS ECU_ADDRESS 0x3fbad4 /end MEASUREMENT
/begin MEASUREMENT lv_err_bn_tcs "Present error BN2000" UBYTE _CNV_S_2_RANGE______2_R_CM 1 100. 0. 255. DISPLAY_IDENTIFIER LV_ERR_BN_TCS ECU_ADDRESS 0x3fbad8 /end MEASUREMENT
/begin MEASUREMENT lv_err_bn_ang_pste "Present error BN2000" UBYTE _CNV_S_2_RANGE______2_R_CM 1 100. 0. 255. DISPLAY_IDENTIFIER LV_ERR_BN_ANG_PSTE ECU_ADDRESS 0x3fbb08 /end MEASUREMENT
/begin MEASUREMENT trt "total running time" ULONG _CNV_A_R_LINEAR_____171_CM 1 100. 0. 119304.6471 DISPLAY_IDENTIFIER TRT ECU_ADDRESS 0x3fcc80 BYTE_ORDER MSB_LAST FORMAT "%12.5" /end MEASUREMENT
/begin MEASUREMENT lv_var_bn "BN2000 recognized" UBYTE _CNV_S_2_RANGE______0_CM 1 100. 0. 1. DISPLAY_IDENTIFIER LV_VAR_BN ECU_ADDRESS 0x3fe1b2 /end MEASUREMENT
/begin MEASUREMENT lv_var_bn_efp "EFP via CAN recognized (BN2000 only)" UBYTE _CNV_S_2_RANGE______0_CM 1 100. 0. 1. DISPLAY_IDENTIFIER LV_VAR_BN_EFP ECU_ADDRESS 0x3fe1b8 /end MEASUREMENT
/begin MEASUREMENT lv_var_veh "LV Vehicle Variant (E60/E65) recognized - BN2000" UBYTE _CNV_S_2_RANGE______0_CM 1 100. 0. 1. DISPLAY_IDENTIFIER LV_VAR_VEH ECU_ADDRESS 0x3fe1b9 /end MEASUREMENT
/begin MEASUREMENT lv_vb_jump "Boolean for  over voltage - ( Passive / Active )" UBYTE _CNV_S_2_RANGE______0_CM 1 100. 0. 1. DISPLAY_IDENTIFIER LV_VB_JUMP ECU_ADDRESS 0x3fe234 BIT_MASK 0x1 /end MEASUREMENT
/begin CHARACTERISTIC c_crlc_vb "Low pass filter constant for VB_MMV" VALUE 0x00643 _REC_VAL_20_u1 0.9960940000000002 _CNV_A_R_LINEAR_____50_CM 0. 0.996094 DISPLAY_IDENTIFIER C_CRLC_VB FORMAT "%5.3" /end CHARACTERISTIC
/begin MEASUREMENT vb_mmv "???" UBYTE _CNV_A_R_LINEAR_____60_CM 1 100. 0. 26. DISPLAY_IDENTIFIER VB_MMV ECU_ADDRESS 0x3fe232 FORMAT "%4.1" /end MEASUREMENT
/begin MEASUREMENT lv_cdn_vb_obd1 "Boolean for battery voltage condition fullfilled for OBD-I diagnosis" UBYTE _CNV_S_2_RANGE______0_CM 1 100. 0. 1. DISPLAY_IDENTIFIER LV_CDN_VB_OBD1 ECU_ADDRESS 0x3fe235 /end MEASUREMENT
/begin MEASUREMENT lv_cdn_vb_obd2 "Boolean for battery voltage condition fullfilled for OBD-II diagnosis" UBYTE _CNV_S_2_RANGE______0_CM 1 100. 0. 1. DISPLAY_IDENTIFIER LV_CDN_VB_OBD2 ECU_ADDRESS 0x3fe236 /end MEASUREMENT
/begin CHARACTERISTIC c_vb_min_jump "Battery voltage threshold for over voltage detection" VALUE 0x0092e _REC_VAL_20_u1 7.8 _CNV_A_R_LINEAR_____60_CM 0. 26. DISPLAY_IDENTIFIER C_VB_MIN_JUMP FORMAT "%4.1" /end CHARACTERISTIC
/begin CHARACTERISTIC c_vb_min_obd2 "Battery voltage threshold for low voltage detection for OBD-II Variante" VALUE 0x00931 _REC_VAL_20_u1 7.8 _CNV_A_R_LINEAR_____60_CM 0. 26. DISPLAY_IDENTIFIER C_VB_MIN_OBD2 FORMAT "%4.1" /end CHARACTERISTIC
/begin CHARACTERISTIC c_vb_min_can_diag "VB time condition - diagnosis of timeout CAN messages" VALUE 0x0092b _REC_VAL_20_u1 26. _CNV_A_R_LINEAR_____60_CM 0. 26. DISPLAY_IDENTIFIER C_VB_MIN_CAN_DIAG FORMAT "%4.1" /end CHARACTERISTIC
/begin MEASUREMENT lv_igk "Boolean for ignition key status - ( Passive / Active )" UBYTE _CNV_S_2_RANGE______0_CM 1 100. 0. 1. DISPLAY_IDENTIFIER LV_IGK ECU_ADDRESS 0x3fe233 BIT_MASK 0x1 /end MEASUREMENT
/begin MEASUREMENT vb "battery voltage" UBYTE _CNV_A_R_LINEAR_____60_CM 1 100. 0. 26. DISPLAY_IDENTIFIER VB ECU_ADDRESS 0x3fe230 FORMAT "%4.1" /end MEASUREMENT
/begin MEASUREMENT vb_secu "battery voltage secured for dwell computation" UBYTE _CNV_A_R_LINEAR_____60_CM 1 100. 0. 26. DISPLAY_IDENTIFIER VB_SECU ECU_ADDRESS 0x3fe23b FORMAT "%4.1" /end MEASUREMENT
/begin MEASUREMENT v_igk "Key-battery voltage" UBYTE _CNV_A_R_LINEAR_____60_CM 1 100. 0. 26. DISPLAY_IDENTIFIER V_IGK ECU_ADDRESS 0x3fe231 FORMAT "%4.1" /end MEASUREMENT
/begin MEASUREMENT lv_cdn_vb_min_diag "Boolean for battery voltage condition fullfilled for remaining diagnosis" UBYTE _CNV_S_2_RANGE______0_CM 1 100. 0. 1. DISPLAY_IDENTIFIER LV_CDN_VB_MIN_DIAG ECU_ADDRESS 0x3fe239 /end MEASUREMENT
/begin CHARACTERISTIC c_vb_max_obd1 "Battery voltage threshold for maximum permissible battery voltage for OBD diagnosis" VALUE 0x00927 _REC_VAL_20_u1 7.8 _CNV_A_R_LINEAR_____60_CM 0. 26. DISPLAY_IDENTIFIER C_VB_MAX_OBD1 FORMAT "%4.1" /end CHARACTERISTIC
/begin CHARACTERISTIC c_vb_min_obd1 "Battery voltage threshold for low voltage detection for OBD-I Variante" VALUE 0x00930 _REC_VAL_20_u1 7.8 _CNV_A_R_LINEAR_____60_CM 0. 26. DISPLAY_IDENTIFIER C_VB_MIN_OBD1 FORMAT "%4.1" /end CHARACTERISTIC
/begin CHARACTERISTIC c_vb_max_obd2 "Battery voltage threshold for maximum permissible battery voltage for OBD diagnosis" VALUE 0x00928 _REC_VAL_20_u1 7.8 _CNV_A_R_LINEAR_____60_CM 0. 26. DISPLAY_IDENTIFIER C_VB_MAX_OBD2 FORMAT "%4.1" /end CHARACTERISTIC
/begin CHARACTERISTIC c_t_min_can_diag "VB time condition - diagnosis of timeout CAN messages" VALUE 0x00827 _REC_VAL_20_u1 2550. _CNV_A_R_LINEAR_____31_CM 0. 2550. DISPLAY_IDENTIFIER C_T_MIN_CAN_DIAG FORMAT "%4.0" /end CHARACTERISTIC
/begin CHARACTERISTIC c_vb_min_diag "Battery voltage threshold for low voltage detection for remaining diagnosis" VALUE 0x0092c _REC_VAL_20_u1 7.8 _CNV_A_R_LINEAR_____60_CM 0. 26. DISPLAY_IDENTIFIER C_VB_MIN_DIAG FORMAT "%4.1" /end CHARACTERISTIC
/begin MEASUREMENT lv_cdn_vb_can_diag "Boolean for battery voltage condition fullfilled for CAN diagnosis" UBYTE _CNV_S_2_RANGE______0_CM 1 100. 0. 1. DISPLAY_IDENTIFIER LV_CDN_VB_CAN_DIAG ECU_ADDRESS 0x3fe237 /end MEASUREMENT
/begin MEASUREMENT lv_wake_up "Wake up signal detected" UBYTE _CNV_S_2_RANGE______0_CM 1 100. 0. 1. DISPLAY_IDENTIFIER LV_WAKE_UP ECU_ADDRESS 0x3fe23a /end MEASUREMENT
/begin CHARACTERISTIC c_vb_min_bn_diag "Battery voltage threshold for low voltage detection for BN2000 diagnosis" VALUE 0x00929 _REC_VAL_20_u1 7.8 _CNV_A_R_LINEAR_____60_CM 0. 26. DISPLAY_IDENTIFIER C_VB_MIN_BN_DIAG FORMAT "%4.1" /end CHARACTERISTIC
/begin MEASUREMENT lv_cdn_vb_bn_diag "Boolean for battery voltage condition fullfilled for BN2000 diagnosis" UBYTE _CNV_S_2_RANGE______0_CM 1 100. 0. 1. DISPLAY_IDENTIFIER LV_CDN_VB_BN_DIAG ECU_ADDRESS 0x3fe238 /end MEASUREMENT
/begin CHARACTERISTIC GEN_APP_TLR "generator load response time setpoint" VALUE 0x004f6 _REC_VAL_20_u1 25.5 _CNV_A_R_LINEAR_____24_CM 0. 25.5 FORMAT "%4.1" /end CHARACTERISTIC
/begin CHARACTERISTIC c_maf_ref "reference air mass flow for rl" VALUE 0x016b8 _REC_VAL_20_u2 1389. _CNV_A_R_LINEAR_____106_CM 0. 1389. DISPLAY_IDENTIFIER C_MAF_REF FORMAT "%7.2" /end CHARACTERISTIC
/begin CHARACTERISTIC lc_gen_clu "Generator clutch" VALUE 0x00f27 _REC_VAL_20_u1 1. _CNV_A_R_LINEAR_____1_CM 0. 1. DISPLAY_IDENTIFIER LC_GEN_CLU FORMAT "%2.0" /end CHARACTERISTIC
/begin MEASUREMENT lv_gen_err_plaus "Typ of alternator not  plausible" UBYTE _CNV_S_2_RANGE______2_R_CM 1 100. 0. 255. DISPLAY_IDENTIFIER LV_GEN_ERR_PLAUS ECU_ADDRESS 0x3fdf10 /end MEASUREMENT
/begin MEASUREMENT lv_gen_err_el "Electrical alternator error output out of powermanagement" UBYTE _CNV_S_2_RANGE______2_R_CM 1 100. 0. 255. DISPLAY_IDENTIFIER LV_GEN_ERR_EL ECU_ADDRESS 0x3fdf11 /end MEASUREMENT
/begin MEASUREMENT lv_gen_err_mec "mechanical alternator error output out of powermanagement" UBYTE _CNV_S_2_RANGE______2_R_CM 1 100. 0. 255. DISPLAY_IDENTIFIER LV_GEN_ERR_MEC ECU_ADDRESS 0x3fdf12 /end MEASUREMENT
/begin MEASUREMENT lv_gen_err_temp "High temperature run at  alternator output out of powermanagement" UBYTE _CNV_S_2_RANGE______2_R_CM 1 100. 0. 255. DISPLAY_IDENTIFIER LV_GEN_ERR_TEMP ECU_ADDRESS 0x3fdf13 /end MEASUREMENT
/begin MEASUREMENT lv_gen_err_tout "Alternator comunication interupted" UBYTE _CNV_S_2_RANGE______2_R_CM 1 100. 0. 255. DISPLAY_IDENTIFIER LV_GEN_ERR_TOUT ECU_ADDRESS 0x3fdf14 /end MEASUREMENT
/begin MEASUREMENT state_gen_err "Conditions of alternator error output out of powermanagement" UBYTE _CNV_A_R_LINEAR_____1_CM 1 100. 0. 255. DISPLAY_IDENTIFIER STATE_GEN_ERR ECU_ADDRESS 0x3fdef9 FORMAT "%3.0" /end MEASUREMENT
/begin MEASUREMENT state_gen_err_if "Conditions of BSD interface alternator error output out of powermanagement" UBYTE _CNV_A_R_LINEAR_____1_CM 1 100. 0. 255. DISPLAY_IDENTIFIER STATE_GEN_ERR_IF ECU_ADDRESS 0x3fdefa FORMAT "%3.0" /end MEASUREMENT
/begin MEASUREMENT B_master "" UBYTE _CNV_A_R_LINEAR_____22_CM 1 100. 0. 255. DISPLAY_IDENTIFIER B_MASTER ECU_ADDRESS 0x3fdef4 BIT_MASK 0x1 /end MEASUREMENT
/begin MEASUREMENT taml "Tastverhältnis E-Lüfter" UBYTE _CNV_R_R_rel_ub_b10_522_CM 1 100. 0. 100. ECU_ADDRESS 0x3fdee7 FORMAT "%8.4" /end MEASUREMENT
/begin MEASUREMENT vvt_es "VVT-Strom Bank 1 bzw. 4 Zylinder" UBYTE _CNV_R_R_i_vvt_ub_q_490_CM 1 100. -63.5 64. ECU_ADDRESS 0x3fdeec FORMAT "%8.4" /end MEASUREMENT
/begin MEASUREMENT vvt_es2 "VVT-Strom Bank2" UBYTE _CNV_R_R_i_vvt_ub_q_490_CM 1 100. -63.5 64. ECU_ADDRESS 0x3fdeed FORMAT "%8.4" /end MEASUREMENT
/begin MEASUREMENT nsllm "Normdrehzahl" UBYTE _CNV_R_R_nmot_ub_q1_566_CM 1 100. 0. 2550. ECU_ADDRESS 0x3fdeeb FORMAT "%8.4" /end MEASUREMENT
/begin MEASUREMENT tq_loss_alter_1 "Torque losses by alternator" SWORD _CNV_A_R_LINEAR_____55_CM 1 100. -1024. 1023.96875 DISPLAY_IDENTIFIER TQ_LOSS_ALTER_1 ECU_ADDRESS 0x3fcefc BYTE_ORDER MSB_LAST FORMAT "%8.2" /end MEASUREMENT
/begin MEASUREMENT state_alter "Status of alternator diagnosis" UBYTE _CNV_A_R_LINEAR_____1_CM 1 100. 0. 3. DISPLAY_IDENTIFIER STATE_ALTER ECU_ADDRESS 0x3fdef5 FORMAT "%2.0" /end MEASUREMENT
/begin MEASUREMENT n_sp_is_pow_1 "nominal idle speed setpoint by powermanagement" UWORD _CNV_A_R_LINEAR_____11_CM 1 100. 0. 8160. DISPLAY_IDENTIFIER N_SP_IS_POW_1 ECU_ADDRESS 0x3fcef8 BYTE_ORDER MSB_LAST FORMAT "%4.0" /end MEASUREMENT
/begin MEASUREMENT MDNORM "Maximales indiziertes Motormoment für Moment-Normierung" UBYTE _CNV_R_R_md_ub_q16_567_CM 1 100. 16. 1008. DISPLAY_IDENTIFIER mdnorm ECU_ADDRESS 0x3fdeee FORMAT "%4.0" /end MEASUREMENT
/begin MEASUREMENT lv_n_sp_is_pow_act "nominal idle speed setpoint by powermanagement" UBYTE _CNV_S_2_RANGE______0_CM 1 100. 0. 1. DISPLAY_IDENTIFIER LV_N_SP_IS_POW_ACT ECU_ADDRESS 0x3fdef8 /end MEASUREMENT
/begin MEASUREMENT B_gfhtak "High temperature run at  alternator output out of powermanagement active" UBYTE _CNV_S_2_RANGE______0_CM 1 100. 0. 1. DISPLAY_IDENTIFIER B_GFHTAK ECU_ADDRESS 0x3fdefe /end MEASUREMENT
/begin MEASUREMENT B_ifbsak "lv_err_bat_sens error active and in FMY due to BSD" UBYTE _CNV_S_2_RANGE______0_CM 1 100. 0. 1. DISPLAY_IDENTIFIER B_IFBSAK ECU_ADDRESS 0x3fdf21 /end MEASUREMENT
/begin MEASUREMENT B_ifebsak "lv_err_bat_sens error active and in FMY due to EBSD" UBYTE _CNV_S_2_RANGE______0_CM 1 100. 0. 1. DISPLAY_IDENTIFIER B_IFEBSAK ECU_ADDRESS 0x3fdf22 /end MEASUREMENT
/begin MEASUREMENT B_ibsfprl "lv_err_bat_sens error active and in FMY" UBYTE _CNV_S_2_RANGE______0_CM 1 100. 0. 1. DISPLAY_IDENTIFIER B_IBSFPRL ECU_ADDRESS 0x3fdf24 /end MEASUREMENT
/begin MEASUREMENT B_iftempak "lv_err_bat_sens_it error active and in FMY due to temperature" UBYTE _CNV_S_2_RANGE______0_CM 1 100. 0. 1. DISPLAY_IDENTIFIER B_IFTEMPAK ECU_ADDRESS 0x3fdf25 /end MEASUREMENT
/begin MEASUREMENT B_ifuplak "lv_err_bat_sens error active and in FMY due to IBS-plausibility" UBYTE _CNV_S_2_RANGE______0_CM 1 100. 0. 1. DISPLAY_IDENTIFIER B_IFUPLAK ECU_ADDRESS 0x3fdf23 /end MEASUREMENT
/begin MEASUREMENT B_ifusak "lv_err_bat_sens_it error active and in FMY due to voltage" UBYTE _CNV_S_2_RANGE______0_CM 1 100. 0. 1. DISPLAY_IDENTIFIER B_IFUSAK ECU_ADDRESS 0x3fdf27 /end MEASUREMENT
/begin MEASUREMENT B_ifisak "lv_err_bat_sens_it error active and in FMY due to current" UBYTE _CNV_S_2_RANGE______0_CM 1 100. 0. 1. DISPLAY_IDENTIFIER B_IFISAK ECU_ADDRESS 0x3fdf26 /end MEASUREMENT
/begin MEASUREMENT B_ifkl15ak "lv_err_bat_sens_it_el error active and in FMY due to shortcut" UBYTE _CNV_S_2_RANGE______0_CM 1 100. 0. 1. DISPLAY_IDENTIFIER B_IFKL15AK ECU_ADDRESS 0x3fdf28 /end MEASUREMENT
/begin MEASUREMENT B_ifsysak "lv_err_bat_sens_it_el error active and in FMY due to system" UBYTE _CNV_S_2_RANGE______0_CM 1 100. 0. 1. DISPLAY_IDENTIFIER B_IFSYSAK ECU_ADDRESS 0x3fdf29 /end MEASUREMENT
/begin MEASUREMENT B_slp "Condition secondary air pump" UBYTE _CNV_S_2_RANGE______0_CM 1 100. 0. 1. DISPLAY_IDENTIFIER B_SLP ECU_ADDRESS 0x3fdf05 /end MEASUREMENT
/begin MEASUREMENT B_genfprl "Alternator error active" UBYTE _CNV_S_2_RANGE______0_CM 1 100. 0. 1. DISPLAY_IDENTIFIER B_GENFPRL ECU_ADDRESS 0x3fdf00 /end MEASUREMENT
/begin MEASUREMENT B_ll "Logic idle" UBYTE _CNV_S_2_RANGE______0_CM 1 100. 0. 1. DISPLAY_IDENTIFIER B_LL ECU_ADDRESS 0x3fdee6 /end MEASUREMENT
/begin MEASUREMENT B_kl15 "Logic ignition key" UBYTE _CNV_S_2_RANGE______0_CM 1 100. 0. 1. DISPLAY_IDENTIFIER B_KL15 ECU_ADDRESS 0x3fdee9 /end MEASUREMENT
/begin MEASUREMENT B_nmot "LV detected engine speed" UBYTE _CNV_S_2_RANGE______0_CM 1 100. 0. 1. DISPLAY_IDENTIFIER B_NMOT ECU_ADDRESS 0x3fdedd /end MEASUREMENT
/begin MEASUREMENT B_sta "Condition after start" UBYTE _CNV_S_2_RANGE______0_CM 1 100. 0. 1. DISPLAY_IDENTIFIER B_STA ECU_ADDRESS 0x3fdf04 /end MEASUREMENT
/begin MEASUREMENT B_pwf "LV powerfail, loss of adapted values" UBYTE _CNV_S_2_RANGE______0_CM 1 100. 0. 1. DISPLAY_IDENTIFIER B_PWF ECU_ADDRESS 0x3fdede /end MEASUREMENT
/begin MEASUREMENT toil "Oil temperature" UBYTE _CNV_A_R_LINEAR_____15_CM 1 100. -40. 160. DISPLAY_IDENTIFIER TOIL ECU_ADDRESS 0x3fe121 FORMAT "%3.0" /end MEASUREMENT
/begin MEASUREMENT toil_mes "???" UBYTE _CNV_A_R_LINEAR_____15_CM 1 100. -40. 160. DISPLAY_IDENTIFIER TOIL_MES ECU_ADDRESS 0x3fe122 FORMAT "%3.0" /end MEASUREMENT
/begin MEASUREMENT toil_stop "Oil temperature at transition to ES" UBYTE _CNV_A_R_LINEAR_____15_CM 1 100. -40. 160. DISPLAY_IDENTIFIER TOIL_STOP ECU_ADDRESS 0x3fe123 FORMAT "%3.0" /end MEASUREMENT
/begin CHARACTERISTIC ip_toil__v_toil "Conversion table for linearization of TOIL value acquisition" CURVE 0x079ff _REC_CUR_20_u1_u1 200. _CNV_A_R_LINEAR_____15_CM -40. 160. DISPLAY_IDENTIFIER IP_TOIL FORMAT "%3.0"
 /begin AXIS_DESCR COM_AXIS v_toil _CNV_A_R_LINEAR_____44_CM 16 0. 4.998 FORMAT "%6.4" AXIS_PTS_REF ldp_v_toil__toil /end AXIS_DESCR
/end CHARACTERISTIC
/begin AXIS_PTS ldp_v_toil__toil "" 0x07eaf v_toil _REC_AXS_20_u1 4.998 _CNV_A_R_LINEAR_____44_CM 16 0. 4.998 DISPLAY_IDENTIFIER LDP_V_TOIL__TOIL FORMAT "%6.4" /end AXIS_PTS
/begin CHARACTERISTIC c_toil_sub_diag "Substitude value for TOIL" VALUE 0x008ef _REC_VAL_20_u1 200. _CNV_A_R_LINEAR_____15_CM -40. 160. DISPLAY_IDENTIFIER C_TOIL_SUB_DIAG FORMAT "%3.0" /end CHARACTERISTIC
/begin CHARACTERISTIC c_toil_grd_max_diag "Max. permissible oil temperature gradient" VALUE 0x008dd _REC_VAL_20_u1 255. _CNV_A_R_LINEAR_____568_CM 0. 255. DISPLAY_IDENTIFIER C_TOIL_GRD_MAX_DIAG FORMAT "%3.0" /end CHARACTERISTIC
/begin MEASUREMENT dist "Distance accumulation [100m]" ULONG _CNV_A_R_LINEAR_____17_CM 1 100. 0. 429496729500. DISPLAY_IDENTIFIER DIST ECU_ADDRESS 0x3fcc74 BYTE_ORDER MSB_LAST FORMAT "%13.0" /end MEASUREMENT
/begin MEASUREMENT ecu_state "Information on ECU state" UBYTE _CNV_S_6_RANGE_ECU__619_CM 1 100. 0. 5. DISPLAY_IDENTIFIER ECU_STATE ECU_ADDRESS 0x3f9c43 /end MEASUREMENT
/begin COMPU_METHOD _CNV_S_2_RANGE______0_CM "" TAB_VERB "%6.3" "[-]" COMPU_TAB_REF _CNV_S_2_RANGE______0 /end COMPU_METHOD
/begin COMPU_VTAB _CNV_S_2_RANGE______0 "" TAB_VERB 2 0 "0" 1 "1" /end COMPU_VTAB
/begin COMPU_METHOD _CNV_A_R_LINEAR_____1_CM "" RAT_FUNC "%6.3" "-" COEFFS 0 1. 0. 0 0 1 /end COMPU_METHOD
/begin COMPU_METHOD _CNV_S_2_RANGE______2_R_CM "" TAB_VERB "%6.3" "[-]" COMPU_TAB_REF _CNV_S_2_RANGE______2_R /end COMPU_METHOD
/begin COMPU_VTAB_RANGE _CNV_S_2_RANGE______2_R "" 2 0 0 "0" 1 255 "1" /end COMPU_VTAB_RANGE
/begin COMPU_METHOD _CNV_A_R_LINEAR_____3_CM "" RAT_FUNC "%6.3" "V" COEFFS 0 204.7999998974999 0. 0 0 1 /end COMPU_METHOD
/begin COMPU_METHOD _CNV_A_R_LINEAR_____4_CM "" RAT_FUNC "%6.3" "s" COEFFS 0 100. 0. 0 0 1 /end COMPU_METHOD
/begin COMPU_METHOD _CNV_S_2_RANGE______5_CM "" TAB_VERB "%6.3" "-" COMPU_TAB_REF _CNV_S_2_RANGE______5 /end COMPU_METHOD
/begin COMPU_VTAB _CNV_S_2_RANGE______5 "" TAB_VERB 2 0 "0" 1 "1" /end COMPU_VTAB
/begin COMPU_METHOD _CNV_A_R_LINEAR_____7_CM "" RAT_FUNC "%6.3" "°C" COEFFS 0 16. 0. 0 0 1 /end COMPU_METHOD
/begin COMPU_METHOD _CNV_A_R_LINEAR_____9_CM "" RAT_FUNC "%6.3" "%" COEFFS 0 655.3600000071681 0. 0 0 1 /end COMPU_METHOD
/begin COMPU_METHOD _CNV_A_R_LINEAR_____10_CM "" RAT_FUNC "%6.3" "%" COEFFS 0 2.56 0. 0 0 1 /end COMPU_METHOD
/begin COMPU_METHOD _CNV_A_R_LINEAR_____11_CM "" RAT_FUNC "%6.3" "rpm" COEFFS 0 1. 0. 0 0 1 /end COMPU_METHOD
/begin COMPU_METHOD _CNV_A_R_LINEAR_____12_CM "" RAT_FUNC "%6.3" "°C" COEFFS 0 1.333333333333333 64. 0 0 1 /end COMPU_METHOD
/begin COMPU_METHOD _CNV_A_R_LINEAR_____13_CM "" RAT_FUNC "%6.3" "°C" COEFFS 0 1.333333333333333 0. 0 0 1 /end COMPU_METHOD
/begin COMPU_METHOD _CNV_A_R_LINEAR_____15_CM "" RAT_FUNC "%6.3" "°C" COEFFS 0 1. 40. 0 0 1 /end COMPU_METHOD
/begin COMPU_METHOD _CNV_A_R_LINEAR_____16_CM "" RAT_FUNC "%6.3" "rpm" COEFFS 0 3.125e-002 0. 0 0 1 /end COMPU_METHOD
/begin COMPU_METHOD _CNV_A_R_LINEAR_____17_CM "" RAT_FUNC "%6.3" "m" COEFFS 0 1.e-002 0. 0 0 1 /end COMPU_METHOD
/begin COMPU_METHOD _CNV_A_R_LINEAR_____21_CM "" RAT_FUNC "%6.3" "-" COEFFS 0 32768.00003968061 0. 0 0 1 /end COMPU_METHOD
/begin COMPU_METHOD _CNV_A_R_LINEAR_____22_CM "" RAT_FUNC "%6.3" "[-]" COEFFS 0 1. 0. 0 0 1 /end COMPU_METHOD
/begin COMPU_METHOD _CNV_A_R_LINEAR_____23_CM "" RAT_FUNC "%6.3" "km/h" COEFFS 0 1. 0. 0 0 1 /end COMPU_METHOD
/begin COMPU_METHOD _CNV_A_R_LINEAR_____24_CM "" RAT_FUNC "%6.3" "s" COEFFS 0 10. 0. 0 0 1 /end COMPU_METHOD
/begin COMPU_METHOD _CNV_A_R_LINEAR_____29_CM "" RAT_FUNC "%6.3" "-" COEFFS 0 255.9983911655618 0. 0 0 1 /end COMPU_METHOD
/begin COMPU_METHOD _CNV_A_R_LINEAR_____30_CM "" RAT_FUNC "%6.3" "s" COEFFS 0 1. 0. 0 0 1 /end COMPU_METHOD
/begin COMPU_METHOD _CNV_A_R_LINEAR_____31_CM "" RAT_FUNC "%6.3" "ms" COEFFS 0 0.1 0. 0 0 1 /end COMPU_METHOD
/begin COMPU_METHOD _CNV_A_R_LINEAR_____37_CM "" RAT_FUNC "%6.3" "-" COEFFS 0 65536.00007936121 0. 0 0 1 /end COMPU_METHOD
/begin COMPU_METHOD _CNV_A_R_LINEAR_____39_CM "" RAT_FUNC "%6.3" "-" COEFFS 0 127.9991955827809 0. 0 0 1 /end COMPU_METHOD
/begin COMPU_METHOD _CNV_A_R_LINEAR_____40_CM "" RAT_FUNC "%6.3" "%/s" COEFFS 0 0.1024000154202376 128.000019275297 0 0 1 /end COMPU_METHOD
/begin COMPU_METHOD _CNV_A_R_LINEAR_____44_CM "" RAT_FUNC "%6.3" "V" COEFFS 0 51.0204081632653 0. 0 0 1 /end COMPU_METHOD
/begin COMPU_METHOD _CNV_A_R_LINEAR_____49_CM "" RAT_FUNC "%6.3" "hPa" COEFFS 0 12.06017666543982 0. 0 0 1 /end COMPU_METHOD
/begin COMPU_METHOD _CNV_A_R_LINEAR_____50_CM "" RAT_FUNC "%6.3" "[-]" COEFFS 0 255.9999357490357 0. 0 0 1 /end COMPU_METHOD
/begin COMPU_METHOD _CNV_A_R_LINEAR_____52_CM "" RAT_FUNC "%6.3" "°TPS/s" COEFFS 0 8.535564853556485e-002 0. 0 0 1 /end COMPU_METHOD
/begin COMPU_METHOD _CNV_A_R_LINEAR_____53_CM "" RAT_FUNC "%6.3" "°TPS" COEFFS 0 137.0962343096234 0. 0 0 1 /end COMPU_METHOD
/begin COMPU_METHOD _CNV_A_R_LINEAR_____55_CM "" RAT_FUNC "%6.3" "Nm" COEFFS 0 32. 0. 0 0 1 /end COMPU_METHOD
/begin COMPU_METHOD _CNV_S_3_STATE_ARS__56_CM "" TAB_VERB "%6.3" "[-]" COMPU_TAB_REF _CNV_S_3_STATE_ARS__56 /end COMPU_METHOD
/begin COMPU_VTAB _CNV_S_3_STATE_ARS__56 "" TAB_VERB 3 0 "INACTIVE" 1 "ACTIVE" 3 "INVALID SIGNAL" /end COMPU_VTAB
/begin COMPU_METHOD _CNV_S_3_STATE_IGK__57_CM "" TAB_VERB "%6.3" "[-]" COMPU_TAB_REF _CNV_S_3_STATE_IGK__57 /end COMPU_METHOD
/begin COMPU_VTAB _CNV_S_3_STATE_IGK__57 "" TAB_VERB 3 0 "IGK OFF" 1 "IGK ON" 2 "INVALID SIGNAL" /end COMPU_VTAB
/begin COMPU_METHOD _CNV_S_4_STATE_TCS__58_CM "" TAB_VERB "%6.3" "[-]" COMPU_TAB_REF _CNV_S_4_STATE_TCS__58 /end COMPU_METHOD
/begin COMPU_VTAB _CNV_S_4_STATE_TCS__58 "" TAB_VERB 4 0 "NO INTERVENTION" 1 "MSR INTERVENTION" 2 "ASR INTERVENTION" 3 "INTERFACE LOCKED" /end COMPU_VTAB
/begin COMPU_METHOD _CNV_S_3_STATE_WAL__59_CM "" TAB_VERB "%6.3" "[-]" COMPU_TAB_REF _CNV_S_3_STATE_WAL__59 /end COMPU_METHOD
/begin COMPU_VTAB _CNV_S_3_STATE_WAL__59 "" TAB_VERB 3 0 "OFF" 1 "YELLOW" 3 "signal invalid" /end COMPU_VTAB
/begin COMPU_METHOD _CNV_A_R_LINEAR_____60_CM "" RAT_FUNC "%6.3" "V" COEFFS 0 9.807692307692308 0. 0 0 1 /end COMPU_METHOD
/begin COMPU_METHOD _CNV_A_R_LINEAR_____61_CM "" RAT_FUNC "%6.3" "Day" COEFFS 0 1. 0. 0 0 1 /end COMPU_METHOD
/begin COMPU_METHOD _CNV_S_9_STATE_TCS__62_CM "" TAB_VERB "%6.3" "[-]" COMPU_TAB_REF _CNV_S_9_STATE_TCS__62 /end COMPU_METHOD
/begin COMPU_VTAB _CNV_S_9_STATE_TCS__62 "" TAB_VERB 9 0 "NO_CONTROL" 1 "ABS_CONTROL" 2 "ASR_CONTROL" 4 "TCS_CONTROL" 8 "HBA_CONTROL" 16 "MSR_CONTROL" 32 "EBV_CONTROL" 64 "DYNO_ACTIVE" 255 "SIGNAL INVALID" /end COMPU_VTAB
/begin COMPU_METHOD _CNV_S_5_STATE_TCS__63_CM "" TAB_VERB "%6.3" "[-]" COMPU_TAB_REF _CNV_S_5_STATE_TCS__63 /end COMPU_METHOD
/begin COMPU_VTAB _CNV_S_5_STATE_TCS__63 "" TAB_VERB 5 0 "NO_INTERVENTION" 1 "DCC_INTV_ACCEPTED" 2 "EMF_INTV_ACCEPTED" 3 "HBA_INTV_ACCEPTED" 15 "SIGNAL INVALID" /end COMPU_VTAB
/begin COMPU_METHOD _CNV_A_R_LINEAR_____64_CM "" RAT_FUNC "%6.3" "m/s²" COEFFS 0 640. 0. 0 0 1 /end COMPU_METHOD
/begin COMPU_METHOD _CNV_S_5_STATE_MOD__65_CM "" TAB_VERB "%6.3" "[-]" COMPU_TAB_REF _CNV_S_5_STATE_MOD__65 /end COMPU_METHOD
/begin COMPU_VTAB _CNV_S_5_STATE_MOD__65 "" TAB_VERB 5 0 "SSC_SBC_OFF" 1 "SSC_ON" 2 "SBC_ON" 3 "SSC_SBC_ON" 7 "INVALID_SIGNAL" /end COMPU_VTAB
/begin COMPU_METHOD _CNV_S_6_STATE_TCS__66_CM "" TAB_VERB "%6.3" "[-]" COMPU_TAB_REF _CNV_S_6_STATE_TCS__66 /end COMPU_METHOD
/begin COMPU_VTAB _CNV_S_6_STATE_TCS__66 "" TAB_VERB 6 0 "VALID" 1 "PASSIV" 2 "DEFECTIVE" 4 "TRACTION MODE" 6 "UNDERVOLTAGE_TCS" 7 "INVALID SIGNAL" /end COMPU_VTAB
/begin COMPU_METHOD _CNV_S_4_STATE_TEMP_67_CM "" TAB_VERB "%6.3" "[-]" COMPU_TAB_REF _CNV_S_4_STATE_TEMP_67 /end COMPU_METHOD
/begin COMPU_VTAB _CNV_S_4_STATE_TEMP_67 "" TAB_VERB 4 0 "NO_REQUEST" 1 "ACTIVE_STEP_1" 2 "ACTIVE_STEP_2" 3 "INVALID_SIGNAL" /end COMPU_VTAB
/begin COMPU_METHOD _CNV_A_R_LINEAR_____68_CM "" RAT_FUNC "%6.3" "km/h" COEFFS 0 10. 0. 0 0 1 /end COMPU_METHOD
/begin COMPU_METHOD _CNV_S_4_STATE_ETCU_69_CM "" TAB_VERB "%6.3" "[-]" COMPU_TAB_REF _CNV_S_4_STATE_ETCU_69 /end COMPU_METHOD
/begin COMPU_VTAB _CNV_S_4_STATE_ETCU_69 "" TAB_VERB 4 0 "NO INTERVENTION" 1 "TORQUE_INCREASE" 2 "TORQUE_DECREASE" 3 "INTERFACE LOCKED" /end COMPU_VTAB
/begin COMPU_METHOD _CNV_S_4_STATE_DCC__70_CM "" TAB_VERB "%6.3" "[-]" COMPU_TAB_REF _CNV_S_4_STATE_DCC__70 /end COMPU_METHOD
/begin COMPU_VTAB _CNV_S_4_STATE_DCC__70 "" TAB_VERB 4 0 "NO_INTERVENTION" 1 "TORQUE_INCREASE" 2 "INVALID_SIGNAL" 3 "INVALID_SIGNAL" /end COMPU_VTAB
/begin COMPU_METHOD _CNV_S_3_STATE_DCC__71_CM "" TAB_VERB "%6.3" "[-]" COMPU_TAB_REF _CNV_S_3_STATE_DCC__71 /end COMPU_METHOD
/begin COMPU_VTAB _CNV_S_3_STATE_DCC__71 "" TAB_VERB 3 0 "NO_REQUEST" 1 "INHIBIT_PUC" 3 "INVALID_SIGNAL" /end COMPU_VTAB
/begin COMPU_METHOD _CNV_S_4_STATE_DCC__72_CM "" TAB_VERB "%6.3" "[-]" COMPU_TAB_REF _CNV_S_4_STATE_DCC__72 /end COMPU_METHOD
/begin COMPU_VTAB _CNV_S_4_STATE_DCC__72 "" TAB_VERB 4 0 "reserved" 1 "SYS_OFF" 2 "SYS_OK" 3 "INVALID_SIGNAL" /end COMPU_VTAB
/begin COMPU_METHOD _CNV_S_8_STATE_DCC_73_CM "" TAB_VERB "%6.3" "[-]" COMPU_TAB_REF _CNV_S_8_STATE_DCC_73 /end COMPU_METHOD
/begin COMPU_VTAB _CNV_S_8_STATE_DCC_73 "" TAB_VERB 8 0 "INACTIVE" 1 "STAND_BY" 2 "NORMAL" 3 "RESERVE" 4 "BRAKE_ACTIVE" 5 "DRIVER_ACTIVE" 6 "RESERVE" 7 "INVALID_SIGNAL" /end COMPU_VTAB
/begin COMPU_METHOD _CNV_S_3_STATE_ETCU_74_CM "" TAB_VERB "%6.3" "[-]" COMPU_TAB_REF _CNV_S_3_STATE_ETCU_74 /end COMPU_METHOD
/begin COMPU_VTAB _CNV_S_3_STATE_ETCU_74 "" TAB_VERB 3 0 "NO_OBD_ERROR" 1 "OBD_ERROR" 2 "INVALID_SIGNAL" /end COMPU_VTAB
/begin COMPU_METHOD _CNV_A_R_LINEAR_____75_CM "" RAT_FUNC "%6.3" "km" COEFFS 0 1. 0. 0 0 1 /end COMPU_METHOD
/begin COMPU_METHOD _CNV_R_R_spg_gencan_76_CM "" RAT_FUNC "%6.3" "V" COEFFS 0. 40. -424. 0. 0. 1. /end COMPU_METHOD
/begin COMPU_METHOD _CNV_S_13_STATE_BN_M_77_CM "" TAB_VERB "%6.3" "[-]" COMPU_TAB_REF _CNV_S_13_STATE_BN_M_77 /end COMPU_METHOD
/begin COMPU_VTAB _CNV_S_13_STATE_BN_M_77 "" TAB_VERB 13 0 "NO_ACTION" 1 "TIP_PRE" 2 "TIP_POST" 4 "PRESS_PRE" 8 "PRESS_POST" 16 "TIP UP or DOWN" 64 "TIP_AXIAL" 65 "TIP_AXIAL" 66 "TIP_AXIAL" 68 "TIP_POST" 72 "PRESS_POST" 80 "TIP UP or DOWN" 127 "INVALID SIGNAL" /end COMPU_VTAB
/begin COMPU_METHOD _CNV_A_R_LINEAR_____78_CM "" RAT_FUNC "%6.3" "Nm" COEFFS 0 2. 0. 0 0 1 /end COMPU_METHOD
/begin COMPU_METHOD _CNV_S_3_STATE_ST_T_79_CM "" TAB_VERB "%6.3" "[-]" COMPU_TAB_REF _CNV_S_3_STATE_ST_T_79 /end COMPU_METHOD
/begin COMPU_VTAB _CNV_S_3_STATE_ST_T_79 "" TAB_VERB 3 0 "NO_INTERVENTION" 1 "INTERVENTION" 3 "INVALID_SIGNAL" /end COMPU_VTAB
/begin COMPU_METHOD _CNV_S_3_STATE_VS_I_80_CM "" TAB_VERB "%6.3" "[-]" COMPU_TAB_REF _CNV_S_3_STATE_VS_I_80 /end COMPU_METHOD
/begin COMPU_VTAB _CNV_S_3_STATE_VS_I_80 "" TAB_VERB 3 0 "km/h" 1 "mph" 3 "INVALID SIGNAL" /end COMPU_VTAB
/begin COMPU_METHOD _CNV_S_4_STATE_PSTE_81_CM "" TAB_VERB "%6.3" "[-]" COMPU_TAB_REF _CNV_S_4_STATE_PSTE_81 /end COMPU_METHOD
/begin COMPU_VTAB _CNV_S_4_STATE_PSTE_81 "" TAB_VERB 4 0 "NO INTERVENTION" 1 "TORQUE INCREASE" 2 "TORQUE DECREASE" 3 "INVALID SIGNAL" /end COMPU_VTAB
/begin COMPU_METHOD _CNV_A_R_LINEAR_____82_CM "" RAT_FUNC "%6.3" "°CRK" COEFFS 0 2.666666666666667 0. 0 0 1 /end COMPU_METHOD
/begin COMPU_METHOD _CNV_A_R_LINEAR_____85_CM "" RAT_FUNC "%6.3" "km/h" COEFFS 0 128.0000018750286 0. 0 0 1 /end COMPU_METHOD
/begin COMPU_METHOD _CNV_A_R_LINEAR_____86_CM "" RAT_FUNC "%6.3" "bar" COEFFS 0 1. 0. 0 0 1 /end COMPU_METHOD
/begin COMPU_METHOD _CNV_A_R_LINEAR_____88_CM "" RAT_FUNC "%6.3" "km" COEFFS 0 0.1 0. 0 0 1 /end COMPU_METHOD
/begin COMPU_METHOD _CNV_S_4_RANGE_STAT_92_CM "" TAB_VERB "%6.3" "[-]" COMPU_TAB_REF _CNV_S_4_RANGE_STAT_92 /end COMPU_METHOD
/begin COMPU_VTAB _CNV_S_4_RANGE_STAT_92 "" TAB_VERB 4 0 "CC open" 1 "CC controlled" 2 "CC closed" 3 "not defined" /end COMPU_VTAB
/begin COMPU_METHOD _CNV_S_9_STATE_ETCU_93_CM "" TAB_VERB "%6.3" "[-]" COMPU_TAB_REF _CNV_S_9_STATE_ETCU_93 /end COMPU_METHOD
/begin COMPU_VTAB _CNV_S_9_STATE_ETCU_93 "" TAB_VERB 9 0 "MIL_OFF" 2 "MIL_OFF" 4 "MIL_ON" 6 "MIL_ON" 8 "MIL_FLL" 10 "MIL_FLL" 12 "IDLE" 14 "INI_VALUE" 15 "INVALID_SIGNAL" /end COMPU_VTAB
/begin COMPU_METHOD _CNV_A_R_LINEAR_____94_CM "" RAT_FUNC "%6.3" "rpm" COEFFS 0 8. 0. 0 0 1 /end COMPU_METHOD
/begin COMPU_METHOD _CNV_A_R_LINEAR_____95_CM "" RAT_FUNC "%6.3" "Nm" COEFFS 0 1. 0. 0 0 1 /end COMPU_METHOD
/begin COMPU_METHOD _CNV_A_R_LINEAR_____96_CM "" RAT_FUNC "%6.3" "l" COEFFS 0 1. 0. 0 0 1 /end COMPU_METHOD
/begin COMPU_METHOD _CNV_A_R_LINEAR_____97_CM "" RAT_FUNC "%6.3" "min" COEFFS 0 1. 0. 0 0 1 /end COMPU_METHOD
/begin COMPU_METHOD _CNV_A_R_LINEAR_____98_CM "" RAT_FUNC "%6.3" "s" COEFFS 0 5. 0. 0 0 1 /end COMPU_METHOD
/begin COMPU_METHOD _CNV_A_R_LINEAR_____99_CM "" RAT_FUNC "%6.3" "°STW/s" COEFFS 0 22.75571737399022 0. 0 0 1 /end COMPU_METHOD
/begin COMPU_METHOD _CNV_A_R_LINEAR_____100_CM "" RAT_FUNC "%6.3" "°STW" COEFFS 0 22.75571737399022 0. 0 0 1 /end COMPU_METHOD
/begin COMPU_METHOD _CNV_S_5_STATE_AMT_104_CM "" TAB_VERB "%6.3" "[-]" COMPU_TAB_REF _CNV_S_5_STATE_AMT_104 /end COMPU_METHOD
/begin COMPU_VTAB _CNV_S_5_STATE_AMT_104 "" TAB_VERB 5 0 "NO INTERVENTION" 1 "TORQUE_DECREASE" 2 "N_REGULATION" 3 "TORQUE_INCREASE" 7 "INVALID_SIGNAL" /end COMPU_VTAB
/begin COMPU_METHOD _CNV_S_5_STATE_CLU__105_CM "" TAB_VERB "%6.3" "[-]" COMPU_TAB_REF _CNV_S_5_STATE_CLU__105 /end COMPU_METHOD
/begin COMPU_VTAB _CNV_S_5_STATE_CLU__105 "" TAB_VERB 5 0 "CLU_OPEN" 1 "CREEPING" 2 "DRIVE_OFF" 3 "CLU_CLOSED" 7 "INVALID_SIGNAL" /end COMPU_VTAB
/begin COMPU_METHOD _CNV_A_R_LINEAR_____106_CM "" RAT_FUNC "%6.3" "mg/stk" COEFFS 0 47.18142548596112 0. 0 0 1 /end COMPU_METHOD
/begin COMPU_METHOD _CNV_A_R_LINEAR_____108_CM "" RAT_FUNC "%6.3" "hPa" COEFFS 0 12.06017666543982 -1.759293338545831e-002 0 0 1 /end COMPU_METHOD
/begin COMPU_METHOD _CNV_A_R_LINEAR_____109_CM "" RAT_FUNC "%6.3" "%" COEFFS 0 655.3600000071681 3.584063961170614e-007 0 0 1 /end COMPU_METHOD
/begin COMPU_METHOD _CNV_A_R_LINEAR_____113_CM "" RAT_FUNC "%6.3" "kg/h" COEFFS 0 32. 0. 0 0 1 /end COMPU_METHOD
/begin COMPU_METHOD _CNV_A_R_LINEAR_____115_CM "" RAT_FUNC "%6.3" "-" COEFFS 0 128. 0. 0 0 1 /end COMPU_METHOD
/begin COMPU_METHOD _CNV_A_R_LINEAR_____123_CM "" RAT_FUNC "%6.3" "-" COEFFS 0 255.9999997499962 0. 0 0 1 /end COMPU_METHOD
/begin COMPU_METHOD _CNV_A_R_LINEAR_____127_CM "" RAT_FUNC "%6.3" "[-]" COEFFS 0 64. 0. 0 0 1 /end COMPU_METHOD
/begin COMPU_METHOD _CNV_A_R_LINEAR_____140_CM "" RAT_FUNC "%6.3" "ms" COEFFS 0 1. 0. 0 0 1 /end COMPU_METHOD
/begin COMPU_METHOD _CNV_A_R_LINEAR_____157_CM "" RAT_FUNC "%6.3" "-" COEFFS 0 64. 0. 0 0 1 /end COMPU_METHOD
/begin COMPU_METHOD _CNV_A_R_LINEAR_____171_CM "" RAT_FUNC "%6.3" "h" COEFFS 0 35999.99999497086 0. 0 0 1 /end COMPU_METHOD
/begin COMPU_METHOD _CNV_A_R_LINEAR_____174_CM "" RAT_FUNC "%6.3" "-" COEFFS 0 32767.98303949118 0. 0 0 1 /end COMPU_METHOD
/begin COMPU_METHOD _CNV_A_R_LINEAR_____186_CM "" RAT_FUNC "%6.3" "Nm" COEFFS 0 32. 32768. 0 0 1 /end COMPU_METHOD
/begin COMPU_METHOD _CNV_A_R_LINEAR_____198_CM "" RAT_FUNC "%6.3" "ms" COEFFS 0 250. 0. 0 0 1 /end COMPU_METHOD
/begin COMPU_METHOD _CNV_A_R_LINEAR_____199_CM "" RAT_FUNC "%6.3" "hPa" COEFFS 0 0.3768805207949945 0. 0 0 1 /end COMPU_METHOD
/begin COMPU_METHOD _CNV_A_R_LINEAR_____200_CM "" RAT_FUNC "%6.3" "h/(km*min)" COEFFS 0 1. 0. 0 0 1 /end COMPU_METHOD
/begin COMPU_METHOD _CNV_A_R_LINEAR_____206_CM "" RAT_FUNC "%6.3" "rpm" COEFFS 0 1. 32768. 0 0 1 /end COMPU_METHOD
/begin COMPU_METHOD _CNV_A_R_LINEAR_____227_CM "" RAT_FUNC "%6.3" "°CRK" COEFFS 0 42.66666666666666 0. 0 0 1 /end COMPU_METHOD
/begin COMPU_METHOD _CNV_A_R_LINEAR_____247_CM "" RAT_FUNC "%6.3" "°CRK" COEFFS 0 2.666666666666667 -466.6666666666666 0 0 1 /end COMPU_METHOD
/begin COMPU_METHOD _CNV_A_R_LINEAR_____333_CM "" RAT_FUNC "%6.3" "cm²" COEFFS 0 1118.481084425738 0. 0 0 1 /end COMPU_METHOD
/begin COMPU_METHOD _CNV_A_R_LINEAR_____334_CM "" RAT_FUNC "%6.3" "hPa" COEFFS 0 96.48288560192751 2.255463186884299e-005 0 0 1 /end COMPU_METHOD
/begin COMPU_METHOD _CNV_A_R_LINEAR_____335_CM "" RAT_FUNC "%6.3" "Pa/kg" COEFFS 0 8.985089974293059e-003 0. 0 0 1 /end COMPU_METHOD
/begin COMPU_METHOD _CNV_A_R_LINEAR_____336_CM "" RAT_FUNC "%6.3" "hPa" COEFFS 0 1541.2906436473 0. 0 0 1 /end COMPU_METHOD
/begin COMPU_METHOD _CNV_A_R_LINEAR_____337_CM "" RAT_FUNC "%6.3" "hPa/ms" COEFFS 0 395.1818376757466 0. 0 0 1 /end COMPU_METHOD
/begin COMPU_METHOD _CNV_A_R_LINEAR_____338_CM "" RAT_FUNC "%6.3" "1/s" COEFFS 0 1073.741857908145 0. 0 0 1 /end COMPU_METHOD
/begin COMPU_METHOD _CNV_A_R_LINEAR_____339_CM "" RAT_FUNC "%6.3" "cm²" COEFFS 0 1118.481075453891 2.574382087914273e-004 0 0 1 /end COMPU_METHOD
/begin COMPU_METHOD _CNV_A_R_LINEAR_____340_CM "" RAT_FUNC "%6.3" "%/kg" COEFFS 0 0.3817721076546662 0. 0 0 1 /end COMPU_METHOD
/begin COMPU_METHOD _CNV_A_R_LINEAR_____341_CM "" RAT_FUNC "%6.3" "%/(hPa*s)" COEFFS 0 29173.86349472035 0. 0 0 1 /end COMPU_METHOD
/begin COMPU_METHOD _CNV_A_R_LINEAR_____342_CM "" RAT_FUNC "%6.3" "%/hPa" COEFFS 0 111291.3086302347 0. 0 0 1 /end COMPU_METHOD
/begin COMPU_METHOD _CNV_A_R_LINEAR_____343_CM "" RAT_FUNC "%6.3" "ms" COEFFS 0 1000. 0. 0 0 1 /end COMPU_METHOD
/begin COMPU_METHOD _CNV_A_R_LINEAR_____344_CM "" RAT_FUNC "%6.3" "(%*h)/kg" COEFFS 0 5242.590296388145 0. 0 0 1 /end COMPU_METHOD
/begin COMPU_METHOD _CNV_A_R_LINEAR_____345_CM "" RAT_FUNC "%6.3" "-" COEFFS 0 8191.999999679995 0. 0 0 1 /end COMPU_METHOD
/begin COMPU_METHOD _CNV_S_3_STATE_CTL__349_CM "" TAB_VERB "%6.3" "[-]" COMPU_TAB_REF _CNV_S_3_STATE_CTL__349 /end COMPU_METHOD
/begin COMPU_VTAB _CNV_S_3_STATE_CTL__349 "" TAB_VERB 3 0 "INSY_OPL" 1 "INSY_AR_CTL" 2 "INSY_AMP_CTL" /end COMPU_VTAB
/begin COMPU_METHOD _CNV_A_R_LINEAR_____355_CM "" RAT_FUNC "%6.3" "V" COEFFS 0 204.8 0. 0 0 1 /end COMPU_METHOD
/begin COMPU_METHOD _CNV_A_R_LINEAR_____365_CM "" RAT_FUNC "%6.3" "°TPS" COEFFS 0 137.0962343096234 1.818989403545857e-012 0 0 1 /end COMPU_METHOD
/begin COMPU_METHOD _CNV_A_R_LINEAR_____368_CM "" RAT_FUNC "%6.3" "1/min/s" COEFFS 0 3.125e-002 0. 0 0 1 /end COMPU_METHOD
/begin COMPU_METHOD _CNV_A_R_LINEAR_____390_CM "" RAT_FUNC "%6.3" "V" COEFFS 0 204.7999995887937 0. 0 0 1 /end COMPU_METHOD
/begin COMPU_METHOD _CNV_A_R_LINEAR_____391_CM "" RAT_FUNC "%6.3" "%/V" COEFFS 0 3.2 0. 0 0 1 /end COMPU_METHOD
/begin COMPU_METHOD _CNV_A_R_LINEAR_____392_CM "" RAT_FUNC "%6.3" "-" COEFFS 0 32768.00003968061 3.96806062781252e-005 0 0 1 /end COMPU_METHOD
/begin COMPU_METHOD _CNV_A_R_LINEAR_____393_CM "" RAT_FUNC "%6.3" "-" COEFFS 0 32768.00003968061 32768.00003968061 0 0 1 /end COMPU_METHOD
/begin COMPU_METHOD _CNV_A_R_LINEAR_____394_CM "" RAT_FUNC "%6.3" "kg/h" COEFFS 0 128.0000018750286 0. 0 0 1 /end COMPU_METHOD
/begin COMPU_METHOD _CNV_A_R_LINEAR_____411_CM "" RAT_FUNC "%6.3" "°C/10s" COEFFS 0 1.333333333333333 0. 0 0 1 /end COMPU_METHOD
/begin COMPU_METHOD _CNV_A_R_LINEAR_____412_CM "" RAT_FUNC "%6.3" "V" COEFFS 0 204.7999998958713 8.135057072422569e-009 0 0 1 /end COMPU_METHOD
/begin COMPU_METHOD _CNV_A_R_LINEAR_____413_CM "" RAT_FUNC "%6.3" "°C" COEFFS 0 64. 0. 0 0 1 /end COMPU_METHOD
/begin COMPU_METHOD _CNV_A_R_LINEAR_____442_CM "" RAT_FUNC "%6.3" "°C/500ms" COEFFS 0 1.333333333333333 0. 0 0 1 /end COMPU_METHOD
/begin COMPU_METHOD _CNV_A_R_LINEAR_____443_CM "" RAT_FUNC "%6.3" "V" COEFFS 0 51.2 0. 0 0 1 /end COMPU_METHOD
/begin COMPU_METHOD _CNV_A_R_LINEAR_____446_CM "" RAT_FUNC "%6.3" "°TPS/V" COEFFS 0 1365.3125 0. 0 0 1 /end COMPU_METHOD
/begin COMPU_METHOD _CNV_R_R_i_vvt_ub_q_490_CM "" RAT_FUNC "%6.3" "A" COEFFS 0. 1. 63.5 0. 0. 0.5 /end COMPU_METHOD
/begin COMPU_METHOD _CNV_R_R_rel_ub_b10_522_CM "" RAT_FUNC "%6.3" "%" COEFFS 0. 255. 0. 0. 0. 100. /end COMPU_METHOD
/begin COMPU_METHOD _CNV_R_R_nmot_ub_q1_566_CM "" RAT_FUNC "%6.3" "rpm" COEFFS 0. 1. 0. 0. 0. 10. /end COMPU_METHOD
/begin COMPU_METHOD _CNV_R_R_md_ub_q16_567_CM "" RAT_FUNC "%6.3" "Nm" COEFFS 0. 1. 0. 0. 0. 16. /end COMPU_METHOD
/begin COMPU_METHOD _CNV_A_R_LINEAR_____568_CM "" RAT_FUNC "%6.3" "°C/s" COEFFS 0 1. 0. 0 0 1 /end COMPU_METHOD
/begin COMPU_METHOD _CNV_S_6_RANGE_ECU__619_CM "" TAB_VERB "%6.3" "[-]" COMPU_TAB_REF _CNV_S_6_RANGE_ECU__619 /end COMPU_METHOD
/begin COMPU_VTAB _CNV_S_6_RANGE_ECU__619 "" TAB_VERB 6 0 "ENG_STOP" 1 "RUN_ENG" 2 "SYN_ENG_IGK_ON" 3 "SYN_ENG_IGK_OFF" 4 "PWL" 5 "ENG_LOCK" /end COMPU_VTAB
/begin RECORD_LAYOUT _REC_VAL_20_u1 FNC_VALUES 1 UBYTE COLUMN_DIR DIRECT /end RECORD_LAYOUT
/begin RECORD_LAYOUT _REC_VAL_20_u2 FNC_VALUES 1 UWORD COLUMN_DIR DIRECT /end RECORD_LAYOUT
/begin RECORD_LAYOUT _REC_CUR_20_u2_u1 FNC_VALUES 1 UWORD COLUMN_DIR DIRECT /end RECORD_LAYOUT
/begin RECORD_LAYOUT _REC_AXS_20_u1 NO_AXIS_PTS_X 1 UBYTE AXIS_PTS_X 2 UBYTE INDEX_INCR DIRECT /end RECORD_LAYOUT
/begin RECORD_LAYOUT _REC_MAP_20_u1_u1_u1 FNC_VALUES 1 UBYTE COLUMN_DIR DIRECT /end RECORD_LAYOUT
/begin RECORD_LAYOUT _REC_CUR_20_u1_u1 FNC_VALUES 1 UBYTE COLUMN_DIR DIRECT /end RECORD_LAYOUT
/begin RECORD_LAYOUT _REC_AXS_20_u2 NO_AXIS_PTS_X 1 UWORD AXIS_PTS_X 2 UWORD INDEX_INCR DIRECT /end RECORD_LAYOUT
/begin RECORD_LAYOUT _REC_MAP_20_u1_u1_u2 FNC_VALUES 1 UBYTE COLUMN_DIR DIRECT /end RECORD_LAYOUT
/begin RECORD_LAYOUT _REC_MAP_20_u2_u2_u1 FNC_VALUES 1 UWORD COLUMN_DIR DIRECT /end RECORD_LAYOUT
/begin RECORD_LAYOUT _REC_CUR_20_u1_u2 FNC_VALUES 1 UBYTE COLUMN_DIR DIRECT /end RECORD_LAYOUT
/begin RECORD_LAYOUT _REC_MAP_20_u2_u1_u1 FNC_VALUES 1 UWORD COLUMN_DIR DIRECT /end RECORD_LAYOUT
/begin RECORD_LAYOUT _REC_CUR_20_u2_u2 FNC_VALUES 1 UWORD COLUMN_DIR DIRECT /end RECORD_LAYOUT
/begin RECORD_LAYOUT _REC_VAL_20_u4 FNC_VALUES 1 ULONG COLUMN_DIR DIRECT /end RECORD_LAYOUT
/begin RECORD_LAYOUT _REC_VAL_20_s2 FNC_VALUES 1 SWORD COLUMN_DIR DIRECT /end RECORD_LAYOUT
/begin RECORD_LAYOUT _REC_MAP_20_u2_u1_u2 FNC_VALUES 1 UWORD COLUMN_DIR DIRECT /end RECORD_LAYOUT
/begin FUNCTION SYS_Battery_voltage "_Battery voltage"
 /begin DEF_CHARACTERISTIC c_crlc_vb c_vb_min_jump c_vb_min_obd2 c_vb_min_can_diag c_vb_max_obd1 c_vb_min_obd1 c_vb_max_obd2 c_t_min_can_diag c_vb_min_diag c_vb_min_bn_diag /end DEF_CHARACTERISTIC
 /begin OUT_MEASUREMENT lv_vb_jump vb_mmv lv_cdn_vb_obd1 lv_cdn_vb_obd2 lv_igk vb vb_secu v_igk lv_cdn_vb_min_diag lv_cdn_vb_can_diag lv_cdn_vb_bn_diag /end OUT_MEASUREMENT
/end FUNCTION
/begin FUNCTION SYS_Coolant_temperature "_Coolant temperature"
 /begin DEF_CHARACTERISTIC c_t_tco_sub_is_2 c_t_tco_sub_puc c_tco_sub_bol_2 c_tco_sub_tol c_tia_diag ip_tco_sub_inc__maf_kgh c_tco_sub_bol_1 c_tco_ex_dif_diag ip_tco__v_tco c_t_tco_sub_is_1 c_t_dly_tco_sub /end DEF_CHARACTERISTIC
 /begin OUT_MEASUREMENT tco_sub tco_stop tco tco_mes tco_st tco_ex_st tco_ex tco_ex_mes /end OUT_MEASUREMENT
/end FUNCTION
/begin FUNCTION SYS_Air_temperature "_Air temperature"
 /begin DEF_CHARACTERISTIC c_tia_grd_max_diag ip_tia__v_tia c_tco_diag c_tia_sub_tol c_tia_sub_bol /end DEF_CHARACTERISTIC
 /begin OUT_MEASUREMENT tia_sub tia tia_mes /end OUT_MEASUREMENT
/end FUNCTION
/begin FUNCTION SYS_Exhaust_temperature_variable "_Exhaust temperature variables" /begin DEF_CHARACTERISTIC ip_teg__v_teg /end DEF_CHARACTERISTIC
 /begin OUT_MEASUREMENT teg_pcat_down_1 teg_pcat_down_2 teg_pcat_down_raw_2 teg_pcat_down_raw_1 /end OUT_MEASUREMENT
/end FUNCTION
/begin FUNCTION SYS_Determination_of_accelerator "_Determination of accelerator pedal value"
 /begin DEF_CHARACTERISTIC c_pv_grd_lih_max c_v_pvs_hys_fil c_pvs_slop_1 c_pvs_slop_2 c_v_pvs_ofs_1 c_v_pvs_ofs_2 c_pv_av_bls_not_plaus_lgrd c_pv_av_bls_not_plaus_hys c_pv_av_bls_not_plaus ip_pv_lih_max ip_fac_pv_bas_cor_mt ip_fac_pv_bas_cor_at ip_fac_pv_bas_cor_amt ip_fac_pv_cs_cor_amt ip_fac_pv_cs_cor_mt ip_fac_pv_gs_cor_amt ip_fac_pv_gs_cor_mt ip_fac_vs_pv_gs_cor_amt ip_fac_vs_pv_gs_cor_mt ip_fac_vs_pv_bas_cor_mt ip_fac_vs_pv_bas_cor_at ip_fac_vs_pv_bas_cor_amt c_add_fac_pv_bas_mt c_add_fac_pv_bas_at c_add_fac_pv_bas_amt c_t_fac_pv_gs c_t_fac_pv_cs c_vs_max_fac_pv_cor c_v_pvs_thd_kd_hys c_v_pvs_thd_kd ip_pv_cru_rng_l ip_pv_cru /end DEF_CHARACTERISTIC
 /begin OUT_MEASUREMENT v_pvs_fil_1 v_pvs_fil_2 lv_kd pv_av pv_av_2 pv_max pv_av_grd pv_av_1 fac_pv_cs_cor fac_pv_gs_cor fac_pv_bas_cor fac_pv_cor pv_av_raw pv_cru /end OUT_MEASUREMENT
/end FUNCTION
/begin FUNCTION SYS_IVVT_Variables "_IVVT Variables"
 /begin DEF_CHARACTERISTIC ip_fac_ivvt__vo ip_crlc_maf_ivvt__n__maf_sp c_cam_op_ex c_cam_op_in c_cam_adj_rng_max_in c_cam_adj_rng_max_ex c_crlc_vo_mmv /end DEF_CHARACTERISTIC
 /begin OUT_MEASUREMENT vo_min vo_max cam_av_mv_in maf_ivvt fac_ivvt vo_sp vo_sp_ref vo vo_bas /end OUT_MEASUREMENT
/end FUNCTION
/begin FUNCTION SYS_Gear_ratio_detection "_Gear ratio detection"
 /begin DEF_CHARACTERISTIC c_min_vs_ratio id_gr_mt__n_vs_ratio lc_rng_l c_gr_rax_sp c_crlc_fac_gr c_n_vs_cru_gear2_puc_sp c_n_vs_cru_grd_fac_gr_max /end DEF_CHARACTERISTIC
 /begin OUT_MEASUREMENT gr_mt gr_at lv_rng_l lv_dri gear_ef state_gear_rev_at_amt n_vs_ratio fac_gr fac_gr_mmv_av gr_rax_av /end OUT_MEASUREMENT
/end FUNCTION
/begin FUNCTION SYS_Drive_train_engaged "_Drive train engaged" /begin DEF_CHARACTERISTIC c_vs_min_dt /end DEF_CHARACTERISTIC /begin OUT_MEASUREMENT lv_dt lam_bank_1.ls_up.vls_up lam_bank_2.ls_up.vls_up /end OUT_MEASUREMENT /end FUNCTION
/begin FUNCTION SYS_Clutch_switch_detection "_Clutch switch detection" /begin OUT_MEASUREMENT lv_cs /end OUT_MEASUREMENT /end FUNCTION
/begin FUNCTION SYS_Input_messages "_Input messages"
 /begin DEF_CHARACTERISTIC c_temp_gb_sub c_t_ctr_swi_off_vb_min c_v_sp_gen c_tq_accin c_tq_stnd c_tam_sub lc_tam_man_as c_tam_man_as c_tout_efp_crash ip_tq_loss_acc_inp /end DEF_CHARACTERISTIC
 /begin OUT_MEASUREMENT lv_err_bn_msw tq_loss_ars_av_can tq_loss_ars_sp_can veh_key_nr state_ars_can state_igk_can lv_tcs_lih_can state_tcs_intv state_wal_can t_ctr_rel_can v_sp_gen t_can state_tcs_ctl state_tcs_dece ac_veh_lgt_tcs ac_veh_trv_tcs state_mod_gb state_tcs_can state_temp_gb temp_gb vs_icl_disp lv_dcc_lih_can lv_dcc_puc_inh tq_dcc_slow_bn tq_dcc_fast_bn state_etcu_intv state_dcc_intv state_dcc_puc_inh state_dcc_off_req state_dcc lv_dcc_off_ack lv_err_tq_loss_ars_av_can lv_err_tq_loss_ars_sp_can lv_rly_st_can lv_key_aux tcc_can_cas tq_tcs_fast_bn tcc_can_tq_dcc tq_tcs_slow_bn tq_gs_slow_bn tcc_can_tq_tcs lv_tq_dcc_inc_req tq_gs_fast_bn tq_amt_fast_bn tq_amt_slow_bn tcc_can_tq_etcu state_etcu_obd_err state_amt_intv state_acin_can ctr_km_bn tcc_can_tq_amt t_ctr_swi_off_vb ctrgenms n_idlms tcc_can_icl tcc_can_msw state_bn_msw lv_err_ang_pste_can tcc_can_ars lv_etcu_lih_can lv_amt_lih_can state_st_tq_lim_gs state_st_tq_lim_amt lv_var_etcu lv_var_bn_msw lv_var_dcc lv_var_ars state_veh_mod state_vs_icl_disp tcc_can_veh_mod state_if_icl_bn_msw tcc_can_tq_pste_2 state_pste_2_intv tq_loss_pste_2_av_can tq_loss_pste_2_sp_can lv_pste_2_err state_brake_prs lv_var_pste_2 state_cru_bn ctr_diag_tcc_can_cas ctr_diag_tcc_can_tq_tcs ctr_diag_tcc_can_tq_etcu ctr_diag_tcc_can_tq_amt ctr_diag_tcc_can_icl ctr_diag_tcc_can_ars ctr_diag_tcc_can_msw ctr_diag_tcc_can_tq_dcc ctr_diag_cks_cas ctr_diag_cks_tq_tcs ctr_diag_cks_tq_etcu ctr_diag_cks_tq_amt ctr_diag_cks_msw ctr_diag_cks_tq_dcc ctr_diag_tout_ars ctr_diag_tout_cas ctr_diag_tout_tq_tcs ctr_diag_tout_vs_tcs ctr_diag_tout_tcs ctr_diag_tout_tq_etcu ctr_diag_tout_etcu ctr_diag_tout_tq_amt ctr_diag_tout_tq_dcc ctr_diag_tout_acc ctr_diag_tout_km_icl ctr_diag_tout_icl ctr_diag_tout_pow_vb ctr_diag_tout_pow_gen ctr_diag_tout_msw ctr_diag_tout_t_icl ctr_diag_tout_ang_pste ctr_diag_tcc_can_veh_mod ctr_diag_cks_veh_mod ctr_diag_tout_veh_mod ctr_diag_tcc_can_tq_pste_2 ctr_diag_cks_tq_pste_2 ctr_diag_tout_tq_pste_2 ctr_diag_tout_efp lv_err_bn_acc lv_err_bn_cas lv_err_bn_icl lv_err_bn_km_icl lv_err_bn_pow_gen lv_err_bn_pow_vb lv_err_bn_t_icl lv_err_bn_tq_pste_2 lv_err_bn_efp tqi_msr_can vs_can wheel lv_plaus_asr_ctl lv_plaus_esp_ctl tqi_asr_fast_can lv_err_vs_can tqi_asr_fast_req_can tqi_msr_req_can tqi_asr_slow_can tqi_asr_slow_req_can lv_tq_asr_req lv_tq_msr_req brake_prs gear_sel_disp tqi_gs_req_can tq_gear_can tqi_gs_req lv_tq_gs_inc_req lv_tq_gs_dec_req gear_info tq_conv_can state_cc state_etcu_obd n_gb tq_accin_can state_efp_crash_can lv_req_heat lv_ltg_swi_can lv_tam_can_err state_gear_rev_can ftl lv_ftl_can_err n_ecf lv_req_tco_l lv_accin ctr_km_can t_rel_can tam lv_acin lv_ftl_le_can_err lv_ftl_ri_can_err lv_ftl_obd_inh_l ftl_le ftl_ri vel_ang_pste state_sens_ang_pste lv_var_pste ang_pste lv_city tqi_slow_amt_req_can tqi_amt_req tqi_slow_amt_req tqi_amt_req_can tqi_amt_cpl_can tcc_can_amt_1 state_amt_obd_err state_amt state_clu_amt lv_tq_amt_dec_req lv_tq_amt_inc_req n_max_amt_can lv_amt_es lv_gs lv_gp state_amt_obd lv_pump_amt_on lv_var_amt state_txu_cr state_txu_tr state_txu_err state_txu state_txu_mt txu_wal txu_disp_cogs_sum txu_disp_rng_sum txu_disp_gear_sum tqi_txu gear lv_err_bn_tq_etcu lv_err_bn_etcu lv_err_bn_tq_amt lv_err_bn_ars lv_err_bn_tq_dcc lv_err_bn_tq_tcs lv_err_bn_vs_tcs lv_err_bn_tcs lv_err_bn_ang_pste lv_var_bn lv_var_bn_efp lv_var_veh lv_wake_up dist /end OUT_MEASUREMENT
/end FUNCTION
/begin FUNCTION SYS_Oil_temperature "_Oil temperature" /begin DEF_CHARACTERISTIC ip_toil__v_toil c_toil_sub_diag c_toil_grd_max_diag /end DEF_CHARACTERISTIC /begin OUT_MEASUREMENT toil toil_mes toil_stop /end OUT_MEASUREMENT /end FUNCTION
/begin FUNCTION SYS_Ambient_pressure_variables "_Ambient pressure variables"
 /begin DEF_CHARACTERISTIC c_amp_hys ip_amp_raw_cor__vs c_amp_crlc c_fac_amp_min c_fac_amp_max ip_amp_raw_2__v_amp ip_amp_raw_1__v_amp /end DEF_CHARACTERISTIC
 /begin OUT_MEASUREMENT amp_mes fac_amp /end OUT_MEASUREMENT
/end FUNCTION
/begin FUNCTION SYS_System_variables_in_the_exha "_System variables in the exhaust pipe"
 /begin DEF_CHARACTERISTIC ip_ar_red_egr__n_32__stk_av_egr ip_prs_ex_inc ip_teg_egr__maf_cyl /end DEF_CHARACTERISTIC
 /begin OUT_MEASUREMENT prs_ex prs_ex_inc teg_egr ar_red_egr /end OUT_MEASUREMENT
/end FUNCTION
/begin FUNCTION SYS_Reduced_area_controller "_Reduced area controller"
 /begin DEF_CHARACTERISTIC c_ar_red_ad_add_min c_ar_red_ad_fac_max c_ar_red_ad_fac_min c_ar_red_dif_i_rel_min c_crlc_ar_red_dif_i_rel_mmv c_n_ar_red_ad_add_max c_n_ar_red_ad_fac_min c_n_ar_red_ad_fac_max c_pq_ar_red_ad_fac_max c_pq_ar_red_ad_fac_min c_pq_ar_red_ad_add_max c_t_ast_ar_red_ctl_deac ip_ar_red_i_rel_1__n__pq ip_ar_red_i_rel_2__n__pq ip_ar_red_p_rel_2__n__pq ip_t_1_hfm__maf_kgh c_lgrd_ar_red_dif_tra c_crlc_ar_red_ad_add c_crlc_ar_red_ad_fac c_ar_red_dif_i_rel_max c_ar_red_ad_add_max ip_ar_red_p_rel_1__n__pq c_crlc_map_mdl c_n_ar_red_ad_add_min c_n_ar_red_isa_ad_add_min c_n_ar_red_isa_ad_add_max c_ar_red_bas_ad_add_max c_ar_red_bas_isa_ad_add_max c_crlc_ar_red_isa_ad_add c_ar_red_isa_ad_add_min c_ar_red_isa_ad_add_max c_n_ar_red_isa_ad_fac_min c_n_ar_red_isa_ad_fac_max c_pq_ar_red_isa_ad_add_max c_pq_ar_red_isa_ad_fac_min c_pq_ar_red_isa_ad_fac_max c_ar_red_bas_ad_fac_min c_ar_red_bas_ad_fac_max c_crlc_ar_red_isa_ad_fac c_ar_red_isa_bas_ad_min c_ar_red_isa_bas_ad_max c_ar_red_isa_ad_fac_min c_ar_red_isa_ad_fac_max ip_fac_ar_red_cor__pq ip_fac_ar_red_isa_cor__pq ip_crlc_hfm__t_seg_t_1_ratio ip_crlc_ar_red_ad_add_mmv c_ar_red_isa_max lc_ar_red_dif_tra ip_fac_ar_red_dif /end DEF_CHARACTERISTIC
 /begin OUT_MEASUREMENT maf_mdl map_mdl ar_red_dif_i_rel_mmv ar_red_dif_p_rel map_mdl_mv map_mdl_dif maf_mdl_mv maf_mdl_dif ar_red ar_red_dif_i_rel ar_red_dif_rel ar_red_isa_dif_rel ar_red_isa_ad_add ar_red_ad_fac ar_red_isa_ad_fac ar_red_ad_fac_cor ar_red_isa_ad_fac_cor ar_red_ad_add ar_red_ad_add_mmv ar_red_ad_add_dif lv_act_ar_red_ad_add ar_red_isa_dif_i_rel_mmv ar_red_thr_dif_i_rel_mmv ar_red_isa ar_red_isa_max fac_ar_red_dif amp_mdl_dif_i_ini /end OUT_MEASUREMENT
/end FUNCTION
/begin FUNCTION SYS_Ambient_Pressure_Control "_Ambient Pressure Control"
 /begin DEF_CHARACTERISTIC c_crlc_amp_ad c_tco_thd_amp_ad c_amp_ad_pl_hys c_amp_ad_dif_neg c_amp_ad_dif_pos c_amp_dif_ti_lam_pos c_amp_max c_amp_min c_amp_ini c_amp_i_1 c_amp_dif_ti_lam_neg c_amp_mdl_dif_i_min c_amp_p_1 c_amp_p_2 c_crlc_maf_kgh_amp_ad_pl c_crlc_amp_mdl_dif_i_mmv c_map_drv1_max_amp_ad_pl c_n_amp_ad_min c_n_amp_ad_max c_n_min_amp_ad_pl c_pq_amp_ad c_pq_amp_ad_pl c_seg_ctr_amp_ad c_seg_ctr_amp_ad_pl c_t_ast_amp_ctl_deac c_ti_lam_maf_puls_max c_ti_lam_maf_puls_min c_tps_min_amp_ad_pl c_amp_i_2 c_crlc_ar_red_bas_amp_ad_pl c_lgrd_amp_mdl_dif_tra lc_ar_red_ad_ena c_amp_mdl_dif_i_max c_fac_ar_red_dif_i_rel_ini c_amp_ad_cor_clrc /end DEF_CHARACTERISTIC
 /begin OUT_MEASUREMENT amp amp_mdl_dif_i_mmv amp_mdl_dif_i amp_mdl_dif_p amp_estim amp_ad_dif amp_ad ar_red_bas_mmv maf_kgh_mmv seg_ctr_amp_ad_pl amp_mdl_dif amp_mdl ar_red_dif_i_rel_ini /end OUT_MEASUREMENT
/end FUNCTION
/begin FUNCTION SYS_Engine_speed_calculation "_Engine speed calculation" /begin OUT_MEASUREMENT n_32 t_seg_av n_grd n n_tooth /end OUT_MEASUREMENT /end FUNCTION
/begin FUNCTION SYS_Fuel_pressure_acquisition "_Fuel pressure acquisition" /begin DEF_CHARACTERISTIC c_fup_nom /end DEF_CHARACTERISTIC /begin OUT_MEASUREMENT fup /end OUT_MEASUREMENT /end FUNCTION
/begin FUNCTION SYS_Detection_of_Driver_Passive "_Detection of Driver Passive" /begin DEF_CHARACTERISTIC c_fac_tq_req_clu_is_hys ip_fac_tq_req_clu_is__n_32 /end DEF_CHARACTERISTIC /begin OUT_MEASUREMENT lv_ct /end OUT_MEASUREMENT /end FUNCTION
/begin FUNCTION SYS_System_variables_for_and_fro "_System variables for and from CUS" /begin DEF_CHARACTERISTIC GEN_APP_TLR c_maf_ref lc_gen_clu /end DEF_CHARACTERISTIC
 /begin OUT_MEASUREMENT lv_gen_err_plaus lv_gen_err_el lv_gen_err_mec lv_gen_err_temp lv_gen_err_tout state_gen_err state_gen_err_if B_master taml vvt_es vvt_es2 nsllm tq_loss_alter_1 state_alter n_sp_is_pow_1 MDNORM lv_n_sp_is_pow_act B_gfhtak B_ifbsak B_ifebsak B_ibsfprl B_iftempak B_ifuplak B_ifusak B_ifisak B_ifkl15ak B_ifsysak B_slp B_genfprl B_ll B_kl15 B_nmot B_sta B_pwf /end OUT_MEASUREMENT
/end FUNCTION
/begin FUNCTION SYS_ECU_state "_ECU state"
 /begin DEF_CHARACTERISTIC c_t_sync_lock_tooth c_crk_vld_tooth_sync_lock c_t_es_sync_max lc_ebr_det_tooth lc_ebr_det_cam c_t_sync_lock_cam c_cam_plaus_fail_max ip_t_tooth_max__vb_tco /end DEF_CHARACTERISTIC
 /begin OUT_MEASUREMENT fast_ecu_tran_pwl_ctr lv_ebr_det_act lv_ebr_det_cam lv_ebr_det_tooth ctr_ebr_det_cam ctr_cam_plaus_fail ctr_ebr_det_tooth t_ebr_sync_lock t_ebr_tooth_max t_ebr_tooth_per t_ebr_es_sync_max ecu_state /end OUT_MEASUREMENT
/end FUNCTION
/begin FUNCTION SYS_Pressure_Variables "_Pressure Variables" /begin DEF_CHARACTERISTIC ip_map_mes_bas__v_map /end DEF_CHARACTERISTIC /begin OUT_MEASUREMENT v_map map_mes_bas lv_load_ratio_chk /end OUT_MEASUREMENT /end FUNCTION
/begin FUNCTION SYS_Engine_off_duration "_Engine off duration"
 /begin DEF_CHARACTERISTIC c_t_es_tco_plaus_max c_t_es_tco_plaus_min c_tco_stop_t_es_plaus_min c_t_es_sub c_tco_stop_t_es_plaus_max c_tco_stop_t_es_min /end DEF_CHARACTERISTIC
 /begin OUT_MEASUREMENT t_es t_rel_can_es t_rel_can_st lv_t_rel_can_reg lv_t_es_not_plaus /end OUT_MEASUREMENT
/end FUNCTION
/begin FUNCTION SYS_Calculation_of_the_basic_red "_Calculation of the basic reduced area" /begin DEF_CHARACTERISTIC ip_ar_red_thr ip_ar_red_isa /end DEF_CHARACTERISTIC /begin OUT_MEASUREMENT ar_red_bas ar_red_isa_bas /end OUT_MEASUREMENT /end FUNCTION
/begin FUNCTION SYS_Total_running_time "_Total running time" /begin OUT_MEASUREMENT trt /end OUT_MEASUREMENT /end FUNCTION
/begin FUNCTION SYS_Determination_of_Throttle_Po "_Determination of Throttle Position"
 /begin DEF_CHARACTERISTIC c_v_tps_swi_gain_1 c_v_tps_hys_gain_1 c_v_tps_grd_max c_v_tps_gain_grd_max c_tps_slop c_tps_max /end DEF_CHARACTERISTIC
 /begin OUT_MEASUREMENT tps_av_1 tps_av_2 tps_grd tps_seg tps_seg_1 tps_seg_2 tps_seg_gain_1 tps_av_gain_1 v_tps_gain_tol_ena_1 v_tps_gain_bol_ena_1 tps_lih tps_av tps_av_ctl tps_av_ctl_1 tps_av_ctl_2 tps_av_ctl_gain_1 lv_tps_gain_act_1 lv_tps_grd_up /end OUT_MEASUREMENT
/end FUNCTION
/begin FUNCTION _Intake_manifold_model "_Appl. Inc. Intake manifold model" /begin DEF_CHARACTERISTIC ip_fac_maf_kgh_cor c_pq_amp_ctl c_pq_amp_ctl_hys /end DEF_CHARACTERISTIC
 /begin OUT_MEASUREMENT lv_amp_ad_stop lv_amp_ctl_stop lv_ar_red_ad_rst lv_ar_red_ad_stop lv_ar_red_ctl_stop maf_kgh_mes_fac lv_map_ctl lv_amp_ad_rst lv_maf_ctl map_mes state_ctl_insy /end OUT_MEASUREMENT
/end FUNCTION
/begin FUNCTION SYS_Vol_Eff_Cor_due_to_VIM_Influ "_Vol Eff Cor due to VIM Influences" /end FUNCTION
/begin FUNCTION SYS_ECU_Temperature "_ECU Temperature"
 /begin DEF_CHARACTERISTIC ip_tecu c_tecu_sub c_tecu_thd_1 c_tecu_thd_2 c_tecu_thd_3 c_trt_dif_tecu /end DEF_CHARACTERISTIC
 /begin OUT_MEASUREMENT ctr_stc_tecu_1 ctr_stc_tecu_2 ctr_stc_tecu_3 tecu tecu_mes /end OUT_MEASUREMENT
/end FUNCTION
/begin FUNCTION SYS_Vol_Eff_Cor_due_to_Port_Flap "_Vol Eff Cor due to Port Flap Influences" /end FUNCTION
/end MODULE
/end PROJECT
