ASAP2_VERSION 1 31
/begin PROJECT MS45 "BMW Motorsteuerung R6"
/begin HEADER "_default_HeaderComment" PROJECT_NO _56 /end HEADER
/begin MODULE _default_ModuleName "_default_ModuleLongIdentifier"
/begin MOD_COMMON "_default_ModCommonComment" DEPOSIT ABSOLUTE BYTE_ORDER MSB_FIRST ALIGNMENT_BYTE 1 ALIGNMENT_WORD 2 ALIGNMENT_LONG 4 ALIGNMENT_FLOAT32_IEEE 4 ALIGNMENT_FLOAT64_IEEE 8 /end MOD_COMMON
/begin CHARACTERISTIC id_pat_ind__nr_pat "Cylinder shut-off patterns" CURVE 0x08746 _REC_CUR_20_u2_u1 65535. _CNV_A_R_LINEAR_____1_CM 0. 65535. DISPLAY_IDENTIFIER ID_PAT_IND__NR_PAT FORMAT "%5.0"
 /begin AXIS_DESCR COM_AXIS online_dummy _CNV_A_R_LINEAR_____1_CM 7 0. 255. FORMAT "%3.0" AXIS_PTS_REF ldp_nr_pat__pat_ind /end AXIS_DESCR
/end CHARACTERISTIC
/begin MEASUREMENT lv_scc "Logical value for single cylinder cut off" UBYTE _CNV_S_2_RANGE______0_CM 1 100. 0. 1. DISPLAY_IDENTIFIER LV_SCC ECU_ADDRESS 0x3fe381 /end MEASUREMENT
/begin MEASUREMENT inh_cyc_iv "Shut off request for cylinder x (individual)" UBYTE _CNV_A_R_LINEAR_____1_CM 1 100. 0. 255. DISPLAY_IDENTIFIER INH_CYC_IV ECU_ADDRESS 0x3fe37e FORMAT "%3.0" /end MEASUREMENT
/begin MEASUREMENT inh_iv_igk "Shut off sequence of IGK (off) " UBYTE _CNV_A_R_LINEAR_____1_CM 1 100. 0. 255. DISPLAY_IDENTIFIER INH_IV_IGK ECU_ADDRESS 0x3fe382 FORMAT "%3.0" /end MEASUREMENT
/begin MEASUREMENT inh_swi_iv "Shut off sequence of coordinated pattern " UWORD _CNV_A_R_LINEAR_____1_CM 1 100. 0. 65535. DISPLAY_IDENTIFIER INH_SWI_IV ECU_ADDRESS 0x3fd5b8 BYTE_ORDER MSB_LAST FORMAT "%5.0" /end MEASUREMENT
/begin MEASUREMENT lv_inj_cut "All cylinders are shut off" UBYTE _CNV_S_2_RANGE______0_CM 1 100. 0. 1. DISPLAY_IDENTIFIER LV_INJ_CUT ECU_ADDRESS 0x3fe380 BIT_MASK 0x1 /end MEASUREMENT
/begin MEASUREMENT lv_ind_fcut "At least 1 Cyl. is shut off" UBYTE _CNV_S_2_RANGE______5_CM 1 100. 0. 1. DISPLAY_IDENTIFIER LV_IND_FCUT ECU_ADDRESS 0x3fe37f BIT_MASK 0x1 /end MEASUREMENT
/begin MEASUREMENT inh_iv_fcut "Shut off sequence of pull fuel cut off " UBYTE _CNV_A_R_LINEAR_____1_CM 1 100. 0. 255. DISPLAY_IDENTIFIER INH_IV_FCUT ECU_ADDRESS 0x3fe383 FORMAT "%3.0" /end MEASUREMENT
/begin AXIS_PTS ldp_nr_pat__pat_ind "" 0x010dc online_dummy _REC_AXS_20_u1 255. _CNV_A_R_LINEAR_____1_CM 7 0. 255. DISPLAY_IDENTIFIER LDP_NR_PAT__PAT_IND FORMAT "%3.0" /end AXIS_PTS
/begin MEASUREMENT inh_iv "" UWORD _CNV_A_R_LINEAR_____1_CM 1 100. 0. 65535. DISPLAY_IDENTIFIER INH_IV ECU_ADDRESS 0x3fd5b6 BYTE_ORDER MSB_LAST FORMAT "%5.0" /end MEASUREMENT
/begin MEASUREMENT inh_iv_mon_cut_off "Shut off sequence of monitoring" UBYTE _CNV_A_R_LINEAR_____1_CM 1 100. 0. 255. DISPLAY_IDENTIFIER INH_IV_MON_CUT_OFF ECU_ADDRESS 0x3fe669 FORMAT "%3.0" /end MEASUREMENT
/begin MEASUREMENT inh_iv_kwp "shut off request for cylinder x ------ 0=enabled / 1=disabled" UBYTE _CNV_A_R_LINEAR_____1_CM 1 100. 0. 63. ECU_ADDRESS 0x3fe84d FORMAT "%2.0" /end MEASUREMENT
/begin CHARACTERISTIC c_lam_fac_i "Scale factor for TI_LAM integral component" VALUE 0x00718 _REC_VAL_20_u1 0.9960940000000002 _CNV_A_R_LINEAR_____50_CM 0. 0.996094 DISPLAY_IDENTIFIER C_LAM_FAC_I FORMAT "%5.3" /end CHARACTERISTIC
/begin CHARACTERISTIC c_lam_fac_p "Scale factor for TI_LAM proportional component" VALUE 0x00719 _REC_VAL_20_u1 0.9960940000000002 _CNV_A_R_LINEAR_____50_CM 0. 0.996094 DISPLAY_IDENTIFIER C_LAM_FAC_P FORMAT "%4.3" /end CHARACTERISTIC
/begin CHARACTERISTIC c_lam_ini_min "Minimum TI_LAM_i value" VALUE 0x00408 _REC_VAL_20_s2 99.99847412 _CNV_A_R_LINEAR_____109_CM -50. 49.99847412 DISPLAY_IDENTIFIER C_LAM_INI_MIN FORMAT "%6.2" /end CHARACTERISTIC
/begin CHARACTERISTIC c_lam_min "Minimum TI_LAM_i value" VALUE 0x0040e _REC_VAL_20_s2 99.99847412 _CNV_A_R_LINEAR_____109_CM -50. 49.99847412 DISPLAY_IDENTIFIER C_LAM_MIN FORMAT "%6.2" /end CHARACTERISTIC
/begin CHARACTERISTIC c_lam_max "Maximum TI_LAM_i value" VALUE 0x0040a _REC_VAL_20_s2 99.99847412 _CNV_A_R_LINEAR_____109_CM -50. 49.99847412 DISPLAY_IDENTIFIER C_LAM_MAX FORMAT "%6.2" /end CHARACTERISTIC
/begin CHARACTERISTIC c_lam_ini_max "Maximum TI_LAM_i value" VALUE 0x00406 _REC_VAL_20_s2 99.99847412 _CNV_A_R_LINEAR_____109_CM -50. 49.99847412 DISPLAY_IDENTIFIER C_LAM_INI_MAX FORMAT "%6.2" /end CHARACTERISTIC
/begin CHARACTERISTIC c_lam_mv_lpf_crlc "correlation constant for the calculation of LAM_MV_LPF" VALUE 0x0071a _REC_VAL_20_u1 0.9960940000000002 _CNV_A_R_LINEAR_____50_CM 0. 0.996094 DISPLAY_IDENTIFIER C_LAM_MV_LPF_CRLC FORMAT "%5.3" /end CHARACTERISTIC
/begin CHARACTERISTIC ip_lam_neg_p "Basic value of TI_LAM proportional component out of idle during transition from lambda > 1 to lambda < 1" MAP 0x06824 _REC_MAP_20_u1_u1_u2 0.49609375 _CNV_A_R_LINEAR_____260_CM 0. 0.49609375 DISPLAY_IDENTIFIER IP_LAM_NEG_P FORMAT "%4.3"
 /begin AXIS_DESCR COM_AXIS n_32 _CNV_A_R_LINEAR_____16_CM 8 0. 8160. FORMAT "%4.0" AXIS_PTS_REF ldpm_n_32_1_lamb_ctl /end AXIS_DESCR
 /begin AXIS_DESCR COM_AXIS maf _CNV_A_R_LINEAR_____106_CM 8 0. 1389. FORMAT "%7.2" AXIS_PTS_REF ldpm_maf_1_lamb_ctl /end AXIS_DESCR
/end CHARACTERISTIC
/begin CHARACTERISTIC c_lam_sum_p_is "Lambda controller P jump delay to have idle P/I values " VALUE 0x0071d _REC_VAL_20_u1 255. _CNV_A_R_LINEAR_____1_CM 0. 255. DISPLAY_IDENTIFIER C_LAM_SUM_P_IS FORMAT "%3.0" /end CHARACTERISTIC
/begin CHARACTERISTIC c_cl_max_lam_is "Maximum canister load of  previous MAX_PURGE to switch to idle parameter" VALUE 0x014b0 _REC_VAL_20_u2 1.99996948 _CNV_A_R_LINEAR_____21_CM 0. 1.99996948 DISPLAY_IDENTIFIER C_CL_MAX_LAM_IS FORMAT "%7.5" /end CHARACTERISTIC
/begin CHARACTERISTIC ip_lam_pos_p "Basic value of TI_LAM proportional component out of idle during transition from lambda < 1 to lambda > 1" MAP 0x068a4 _REC_MAP_20_u1_u1_u2 0.49609375 _CNV_A_R_LINEAR_____260_CM 0. 0.49609375 DISPLAY_IDENTIFIER IP_LAM_POS_P FORMAT "%4.3"
 /begin AXIS_DESCR COM_AXIS n_32 _CNV_A_R_LINEAR_____16_CM 8 0. 8160. FORMAT "%4.0" AXIS_PTS_REF ldpm_n_32_1_lamb_ctl /end AXIS_DESCR
 /begin AXIS_DESCR COM_AXIS maf _CNV_A_R_LINEAR_____106_CM 8 0. 1389. FORMAT "%7.2" AXIS_PTS_REF ldpm_maf_1_lamb_ctl /end AXIS_DESCR
/end CHARACTERISTIC
/begin CHARACTERISTIC ip_lam_pos_p_is "Basic value of TI_LAM_COR proportional component in idle during transition from lambda < 1 to lambda > 1" MAP 0x068e4 _REC_MAP_20_u1_u1_u2 0.49609375 _CNV_A_R_LINEAR_____260_CM 0. 0.49609375 DISPLAY_IDENTIFIER IP_LAM_POS_P_IS FORMAT "%4.3"
 /begin AXIS_DESCR COM_AXIS n_32 _CNV_A_R_LINEAR_____16_CM 8 0. 8160. FORMAT "%4.0" AXIS_PTS_REF ldpm_n_32_2_lamb_ctl /end AXIS_DESCR
 /begin AXIS_DESCR COM_AXIS maf _CNV_A_R_LINEAR_____106_CM 8 0. 1389. FORMAT "%7.2" AXIS_PTS_REF ldpm_maf_1_lamb_ctl /end AXIS_DESCR
/end CHARACTERISTIC
/begin CHARACTERISTIC ip_lam_neg_p_is "Basic value of TI_LAM_COR proportional component in idle during transition from lambda > 1 to lambda < 1" MAP 0x06864 _REC_MAP_20_u1_u1_u2 0.49609375 _CNV_A_R_LINEAR_____260_CM 0. 0.49609375 DISPLAY_IDENTIFIER IP_LAM_NEG_P_IS FORMAT "%4.3"
 /begin AXIS_DESCR COM_AXIS n_32 _CNV_A_R_LINEAR_____16_CM 8 0. 8160. FORMAT "%4.0" AXIS_PTS_REF ldpm_n_32_2_lamb_ctl /end AXIS_DESCR
 /begin AXIS_DESCR COM_AXIS maf _CNV_A_R_LINEAR_____106_CM 8 0. 1389. FORMAT "%7.2" AXIS_PTS_REF ldpm_maf_1_lamb_ctl /end AXIS_DESCR
/end CHARACTERISTIC
/begin CHARACTERISTIC ip_lam_i_is_2 "Basic value of TI_LAM_COR integral component in idle, cylinderbankspecific" MAP 0x067e4 _REC_MAP_20_u1_u1_u2 0.49609375 _CNV_A_R_LINEAR_____260_CM 0. 0.49609375 DISPLAY_IDENTIFIER IP_LAM_I_IS_2 FORMAT "%4.3"
 /begin AXIS_DESCR COM_AXIS n_32 _CNV_A_R_LINEAR_____16_CM 8 0. 8160. FORMAT "%4.0" AXIS_PTS_REF ldpm_n_32_2_lamb_ctl /end AXIS_DESCR
 /begin AXIS_DESCR COM_AXIS maf _CNV_A_R_LINEAR_____106_CM 8 0. 1389. FORMAT "%7.2" AXIS_PTS_REF ldpm_maf_1_lamb_ctl /end AXIS_DESCR
/end CHARACTERISTIC
/begin CHARACTERISTIC ip_lam_i_is_1 "Basic value of TI_LAM_COR integral component in idle, cylinderbankspecific" MAP 0x067a4 _REC_MAP_20_u1_u1_u2 0.49609375 _CNV_A_R_LINEAR_____260_CM 0. 0.49609375 DISPLAY_IDENTIFIER IP_LAM_I_IS_1 FORMAT "%4.3"
 /begin AXIS_DESCR COM_AXIS n_32 _CNV_A_R_LINEAR_____16_CM 8 0. 8160. FORMAT "%4.0" AXIS_PTS_REF ldpm_n_32_2_lamb_ctl /end AXIS_DESCR
 /begin AXIS_DESCR COM_AXIS maf _CNV_A_R_LINEAR_____106_CM 8 0. 1389. FORMAT "%7.2" AXIS_PTS_REF ldpm_maf_1_lamb_ctl /end AXIS_DESCR
/end CHARACTERISTIC
/begin CHARACTERISTIC ip_lam_i_1 "Basic value of TI_LAM_COR integral component in idle, cylinderbankspecific" MAP 0x06724 _REC_MAP_20_u1_u1_u2 0.49609375 _CNV_A_R_LINEAR_____260_CM 0. 0.49609375 DISPLAY_IDENTIFIER IP_LAM_I_1 FORMAT "%4.3"
 /begin AXIS_DESCR COM_AXIS n_32 _CNV_A_R_LINEAR_____16_CM 8 0. 8160. FORMAT "%4.0" AXIS_PTS_REF ldpm_n_32_1_lamb_ctl /end AXIS_DESCR
 /begin AXIS_DESCR COM_AXIS maf _CNV_A_R_LINEAR_____106_CM 8 0. 1389. FORMAT "%7.2" AXIS_PTS_REF ldpm_maf_1_lamb_ctl /end AXIS_DESCR
/end CHARACTERISTIC
/begin CHARACTERISTIC ip_lam_i_2 "Basic value of TI_LAM_COR integral component in idle, cylinderbankspecific" MAP 0x06764 _REC_MAP_20_u1_u1_u2 0.49609375 _CNV_A_R_LINEAR_____260_CM 0. 0.49609375 DISPLAY_IDENTIFIER IP_LAM_I_2 FORMAT "%4.3"
 /begin AXIS_DESCR COM_AXIS n_32 _CNV_A_R_LINEAR_____16_CM 8 0. 8160. FORMAT "%4.0" AXIS_PTS_REF ldpm_n_32_1_lamb_ctl /end AXIS_DESCR
 /begin AXIS_DESCR COM_AXIS maf _CNV_A_R_LINEAR_____106_CM 8 0. 1389. FORMAT "%7.2" AXIS_PTS_REF ldpm_maf_1_lamb_ctl /end AXIS_DESCR
/end CHARACTERISTIC
/begin CHARACTERISTIC ip_t_lam_dly_pos_at_2 "Basic LAM -P-jump delay time from lean to rich transition, cylinderbank i, (Automatic shifted transmission) " MAP 0x0e6ae _REC_MAP_20_u2_u1_u2 1279.9 _CNV_A_R_LINEAR_____261_CM 0. 1279.9 DISPLAY_IDENTIFIER IP_T_LAM_DLY_POS_AT_2 FORMAT "%7.2"
 /begin AXIS_DESCR COM_AXIS n_32 _CNV_A_R_LINEAR_____16_CM 8 0. 8160. FORMAT "%4.0" AXIS_PTS_REF ldpm_n_32_1_lamb_ctl /end AXIS_DESCR
 /begin AXIS_DESCR COM_AXIS maf _CNV_A_R_LINEAR_____106_CM 8 0. 1389. FORMAT "%7.2" AXIS_PTS_REF ldpm_maf_1_lamb_ctl /end AXIS_DESCR
/end CHARACTERISTIC
/begin CHARACTERISTIC ip_t_lam_dly_neg_at_2 "Basic LAM -P-jump delay time from rich to lean transition, cylinderbank i, (Automatic shifted transmission)" MAP 0x0e296 _REC_MAP_20_u2_u1_u2 1279.9 _CNV_A_R_LINEAR_____261_CM 0. 1279.9 DISPLAY_IDENTIFIER IP_T_LAM_DLY_NEG_AT_2 FORMAT "%7.2"
 /begin AXIS_DESCR COM_AXIS n_32 _CNV_A_R_LINEAR_____16_CM 8 0. 8160. FORMAT "%4.0" AXIS_PTS_REF ldpm_n_32_1_lamb_ctl /end AXIS_DESCR
 /begin AXIS_DESCR COM_AXIS maf _CNV_A_R_LINEAR_____106_CM 8 0. 1389. FORMAT "%7.2" AXIS_PTS_REF ldpm_maf_1_lamb_ctl /end AXIS_DESCR
/end CHARACTERISTIC
/begin CHARACTERISTIC ip_t_lam_dly_neg_at_1 "Basic LAM -P-jump delay time from rich to lean transition, cylinderbank i, (Automatic shifted transmission)" MAP 0x0e216 _REC_MAP_20_u2_u1_u2 1279.9 _CNV_A_R_LINEAR_____261_CM 0. 1279.9 DISPLAY_IDENTIFIER IP_T_LAM_DLY_NEG_AT_1 FORMAT "%7.2"
 /begin AXIS_DESCR COM_AXIS n_32 _CNV_A_R_LINEAR_____16_CM 8 0. 8160. FORMAT "%4.0" AXIS_PTS_REF ldpm_n_32_1_lamb_ctl /end AXIS_DESCR
 /begin AXIS_DESCR COM_AXIS maf _CNV_A_R_LINEAR_____106_CM 8 0. 1389. FORMAT "%7.2" AXIS_PTS_REF ldpm_maf_1_lamb_ctl /end AXIS_DESCR
/end CHARACTERISTIC
/begin CHARACTERISTIC ip_t_lam_dly_pos_mt_1 "Basic LAM -P-jump delay time from lean to rich transition, cylinderbank i, (Manual shifted transmission)" MAP 0x0e92e _REC_MAP_20_u2_u1_u2 1279.9 _CNV_A_R_LINEAR_____261_CM 0. 1279.9 DISPLAY_IDENTIFIER IP_T_LAM_DLY_POS_MT_1 FORMAT "%7.2"
 /begin AXIS_DESCR COM_AXIS n_32 _CNV_A_R_LINEAR_____16_CM 8 0. 8160. FORMAT "%4.0" AXIS_PTS_REF ldpm_n_32_1_lamb_ctl /end AXIS_DESCR
 /begin AXIS_DESCR COM_AXIS maf _CNV_A_R_LINEAR_____106_CM 8 0. 1389. FORMAT "%7.2" AXIS_PTS_REF ldpm_maf_1_lamb_ctl /end AXIS_DESCR
/end CHARACTERISTIC
/begin CHARACTERISTIC ip_t_lam_dly_pos_mt_2 "Basic LAM -P-jump delay time from lean to rich transition, cylinderbank i, (Manual shifted transmission)" MAP 0x0e9ae _REC_MAP_20_u2_u1_u2 1279.9 _CNV_A_R_LINEAR_____261_CM 0. 1279.9 DISPLAY_IDENTIFIER IP_T_LAM_DLY_POS_MT_2 FORMAT "%7.2"
 /begin AXIS_DESCR COM_AXIS n_32 _CNV_A_R_LINEAR_____16_CM 8 0. 8160. FORMAT "%4.0" AXIS_PTS_REF ldpm_n_32_1_lamb_ctl /end AXIS_DESCR
 /begin AXIS_DESCR COM_AXIS maf _CNV_A_R_LINEAR_____106_CM 8 0. 1389. FORMAT "%7.2" AXIS_PTS_REF ldpm_maf_1_lamb_ctl /end AXIS_DESCR
/end CHARACTERISTIC
/begin CHARACTERISTIC ip_t_lam_dly_neg_mt_2 "Basic LAM -P-jump delay time from rich to lean transition, cylinderbank i, (Manual shifted transmission)" MAP 0x0e596 _REC_MAP_20_u2_u1_u2 1279.9 _CNV_A_R_LINEAR_____261_CM 0. 1279.9 DISPLAY_IDENTIFIER IP_T_LAM_DLY_NEG_MT_2 FORMAT "%7.2"
 /begin AXIS_DESCR COM_AXIS n_32 _CNV_A_R_LINEAR_____16_CM 8 0. 8160. FORMAT "%4.0" AXIS_PTS_REF ldpm_n_32_1_lamb_ctl /end AXIS_DESCR
 /begin AXIS_DESCR COM_AXIS maf _CNV_A_R_LINEAR_____106_CM 8 0. 1389. FORMAT "%7.2" AXIS_PTS_REF ldpm_maf_1_lamb_ctl /end AXIS_DESCR
/end CHARACTERISTIC
/begin CHARACTERISTIC ip_t_lam_dly_neg_mt_1 "Basic LAM -P-jump delay time from rich to lean transition, cylinderbank i, (Manual shifted transmission)" MAP 0x0e516 _REC_MAP_20_u2_u1_u2 1279.9 _CNV_A_R_LINEAR_____261_CM 0. 1279.9 DISPLAY_IDENTIFIER IP_T_LAM_DLY_NEG_MT_1 FORMAT "%7.2"
 /begin AXIS_DESCR COM_AXIS n_32 _CNV_A_R_LINEAR_____16_CM 8 0. 8160. FORMAT "%4.0" AXIS_PTS_REF ldpm_n_32_1_lamb_ctl /end AXIS_DESCR
 /begin AXIS_DESCR COM_AXIS maf _CNV_A_R_LINEAR_____106_CM 8 0. 1389. FORMAT "%7.2" AXIS_PTS_REF ldpm_maf_1_lamb_ctl /end AXIS_DESCR
/end CHARACTERISTIC
/begin CHARACTERISTIC ip_t_lam_dly_pos_at_1 "Basic LAM -P-jump delay time from lean to rich transition, cylinderbank i, (Automatic shifted transmission) " MAP 0x0e62e _REC_MAP_20_u2_u1_u2 1279.9 _CNV_A_R_LINEAR_____261_CM 0. 1279.9 DISPLAY_IDENTIFIER IP_T_LAM_DLY_POS_AT_1 FORMAT "%7.2"
 /begin AXIS_DESCR COM_AXIS n_32 _CNV_A_R_LINEAR_____16_CM 8 0. 8160. FORMAT "%4.0" AXIS_PTS_REF ldpm_n_32_1_lamb_ctl /end AXIS_DESCR
 /begin AXIS_DESCR COM_AXIS maf _CNV_A_R_LINEAR_____106_CM 8 0. 1389. FORMAT "%7.2" AXIS_PTS_REF ldpm_maf_1_lamb_ctl /end AXIS_DESCR
/end CHARACTERISTIC
/begin CHARACTERISTIC ip_t_lam_dly_pos_is_at_2 "Basic LAM -P-jump delay time from lean to rich transition in idle, cylinderbank i, (Automatic shifted transmission)" MAP 0x0e7ae _REC_MAP_20_u2_u1_u2 1279.9 _CNV_A_R_LINEAR_____261_CM 0. 1279.9 DISPLAY_IDENTIFIER IP_T_LAM_DLY_POS_IS_AT_2 FORMAT "%7.2"
 /begin AXIS_DESCR COM_AXIS n_32 _CNV_A_R_LINEAR_____16_CM 8 0. 8160. FORMAT "%4.0" AXIS_PTS_REF ldpm_n_32_2_lamb_ctl /end AXIS_DESCR
 /begin AXIS_DESCR COM_AXIS maf _CNV_A_R_LINEAR_____106_CM 8 0. 1389. FORMAT "%7.2" AXIS_PTS_REF ldpm_maf_2_lamb_ctl /end AXIS_DESCR
/end CHARACTERISTIC
/begin CHARACTERISTIC ip_t_lam_dly_neg_is_at_2 "Basic LAM -P-jump delay time from rich to lean transition in idle, cylinderbank i, (Automatic shifted transmission)" MAP 0x0e396 _REC_MAP_20_u2_u1_u2 1279.9 _CNV_A_R_LINEAR_____261_CM 0. 1279.9 DISPLAY_IDENTIFIER IP_T_LAM_DLY_NEG_IS_AT_2 FORMAT "%7.2"
 /begin AXIS_DESCR COM_AXIS n_32 _CNV_A_R_LINEAR_____16_CM 8 0. 8160. FORMAT "%4.0" AXIS_PTS_REF ldpm_n_32_2_lamb_ctl /end AXIS_DESCR
 /begin AXIS_DESCR COM_AXIS maf _CNV_A_R_LINEAR_____106_CM 8 0. 1389. FORMAT "%7.2" AXIS_PTS_REF ldpm_maf_2_lamb_ctl /end AXIS_DESCR
/end CHARACTERISTIC
/begin CHARACTERISTIC ip_t_lam_dly_neg_is_at_1 "Basic LAM -P-jump delay time from rich to lean transition in idle, cylinderbank i, (Automatic shifted transmission)" MAP 0x0e316 _REC_MAP_20_u2_u1_u2 1279.9 _CNV_A_R_LINEAR_____261_CM 0. 1279.9 DISPLAY_IDENTIFIER IP_T_LAM_DLY_NEG_IS_AT_1 FORMAT "%7.2"
 /begin AXIS_DESCR COM_AXIS n_32 _CNV_A_R_LINEAR_____16_CM 8 0. 8160. FORMAT "%4.0" AXIS_PTS_REF ldpm_n_32_2_lamb_ctl /end AXIS_DESCR
 /begin AXIS_DESCR COM_AXIS maf _CNV_A_R_LINEAR_____106_CM 8 0. 1389. FORMAT "%7.2" AXIS_PTS_REF ldpm_maf_2_lamb_ctl /end AXIS_DESCR
/end CHARACTERISTIC
/begin CHARACTERISTIC ip_t_lam_dly_pos_is_at_1 "Basic LAM -P-jump delay time from lean to rich transition in idle, cylinderbank i, (Automatic shifted transmission)" MAP 0x0e72e _REC_MAP_20_u2_u1_u2 1279.9 _CNV_A_R_LINEAR_____261_CM 0. 1279.9 DISPLAY_IDENTIFIER IP_T_LAM_DLY_POS_IS_AT_1 FORMAT "%7.2"
 /begin AXIS_DESCR COM_AXIS n_32 _CNV_A_R_LINEAR_____16_CM 8 0. 8160. FORMAT "%4.0" AXIS_PTS_REF ldpm_n_32_2_lamb_ctl /end AXIS_DESCR
 /begin AXIS_DESCR COM_AXIS maf _CNV_A_R_LINEAR_____106_CM 8 0. 1389. FORMAT "%7.2" AXIS_PTS_REF ldpm_maf_2_lamb_ctl /end AXIS_DESCR
/end CHARACTERISTIC
/begin CHARACTERISTIC ip_t_lam_dly_pos_is_mt_1 "Basic LAM -P-jump delay time from lean to rich transition in idle, cylinderbank i, (Manual shifted transmission)" MAP 0x0e82e _REC_MAP_20_u2_u1_u2 1279.9 _CNV_A_R_LINEAR_____261_CM 0. 1279.9 DISPLAY_IDENTIFIER IP_T_LAM_DLY_POS_IS_MT_1 FORMAT "%7.2"
 /begin AXIS_DESCR COM_AXIS n_32 _CNV_A_R_LINEAR_____16_CM 8 0. 8160. FORMAT "%4.0" AXIS_PTS_REF ldpm_n_32_2_lamb_ctl /end AXIS_DESCR
 /begin AXIS_DESCR COM_AXIS maf _CNV_A_R_LINEAR_____106_CM 8 0. 1389. FORMAT "%7.2" AXIS_PTS_REF ldpm_maf_2_lamb_ctl /end AXIS_DESCR
/end CHARACTERISTIC
/begin CHARACTERISTIC ip_t_lam_dly_pos_is_mt_2 "Basic LAM -P-jump delay time from lean to rich transition in idle, cylinderbank i, (Manual shifted transmission)" MAP 0x0e8ae _REC_MAP_20_u2_u1_u2 1279.9 _CNV_A_R_LINEAR_____261_CM 0. 1279.9 DISPLAY_IDENTIFIER IP_T_LAM_DLY_POS_IS_MT_2 FORMAT "%7.2"
 /begin AXIS_DESCR COM_AXIS n_32 _CNV_A_R_LINEAR_____16_CM 8 0. 8160. FORMAT "%4.0" AXIS_PTS_REF ldpm_n_32_2_lamb_ctl /end AXIS_DESCR
 /begin AXIS_DESCR COM_AXIS maf _CNV_A_R_LINEAR_____106_CM 8 0. 1389. FORMAT "%7.2" AXIS_PTS_REF ldpm_maf_2_lamb_ctl /end AXIS_DESCR
/end CHARACTERISTIC
/begin CHARACTERISTIC ip_t_lam_dly_neg_is_mt_2 "Basic LAM -P-jump delay time from rich to lean transition in idle, cylinderbank i, (Manual shifted transmission)" MAP 0x0e496 _REC_MAP_20_u2_u1_u2 1279.9 _CNV_A_R_LINEAR_____261_CM 0. 1279.9 DISPLAY_IDENTIFIER IP_T_LAM_DLY_NEG_IS_MT_2 FORMAT "%7.2"
 /begin AXIS_DESCR COM_AXIS n_32 _CNV_A_R_LINEAR_____16_CM 8 0. 8160. FORMAT "%4.0" AXIS_PTS_REF ldpm_n_32_2_lamb_ctl /end AXIS_DESCR
 /begin AXIS_DESCR COM_AXIS maf _CNV_A_R_LINEAR_____106_CM 8 0. 1389. FORMAT "%7.2" AXIS_PTS_REF ldpm_maf_2_lamb_ctl /end AXIS_DESCR
/end CHARACTERISTIC
/begin CHARACTERISTIC ip_t_lam_dly_neg_is_mt_1 "Basic LAM -P-jump delay time from rich to lean transition in idle, cylinderbank i, (Manual shifted transmission)" MAP 0x0e416 _REC_MAP_20_u2_u1_u2 1279.9 _CNV_A_R_LINEAR_____261_CM 0. 1279.9 DISPLAY_IDENTIFIER IP_T_LAM_DLY_NEG_IS_MT_1 FORMAT "%7.2"
 /begin AXIS_DESCR COM_AXIS n_32 _CNV_A_R_LINEAR_____16_CM 8 0. 8160. FORMAT "%4.0" AXIS_PTS_REF ldpm_n_32_2_lamb_ctl /end AXIS_DESCR
 /begin AXIS_DESCR COM_AXIS maf _CNV_A_R_LINEAR_____106_CM 8 0. 1389. FORMAT "%7.2" AXIS_PTS_REF ldpm_maf_2_lamb_ctl /end AXIS_DESCR
/end CHARACTERISTIC
/begin CHARACTERISTIC ip_t_lam_dly_neg_tco "Offset P-jump delay negativ TCO dependant" CURVE 0x0e616 _REC_CUR_20_u2_u1 1279.9 _CNV_A_R_LINEAR_____261_CM 0. 1279.9 DISPLAY_IDENTIFIER IP_T_LAM_DLY_NEG_TCO FORMAT "%7.2"
 /begin AXIS_DESCR COM_AXIS tco _CNV_A_R_LINEAR_____12_CM 6 -48. 142.5 FORMAT "%5.1" AXIS_PTS_REF ldpm_tco_1_lam /end AXIS_DESCR
/end CHARACTERISTIC
/begin CHARACTERISTIC ip_t_lam_dly_pos_tco "Offset P-jump delay positiv TCO dependant" CURVE 0x0ea2e _REC_CUR_20_u2_u1 1279.9 _CNV_A_R_LINEAR_____261_CM 0. 1279.9 DISPLAY_IDENTIFIER IP_T_LAM_DLY_POS_TCO FORMAT "%7.2"
 /begin AXIS_DESCR COM_AXIS tco _CNV_A_R_LINEAR_____12_CM 6 -48. 142.5 FORMAT "%5.1" AXIS_PTS_REF ldpm_tco_1_lam /end AXIS_DESCR
/end CHARACTERISTIC
/begin CHARACTERISTIC ip_t_lam_dly_pos_teg_cat "Offset P-jump delay positiv CAT temperature dependant" CURVE 0x0ea3a _REC_CUR_20_u2_u2 1279.9 _CNV_A_R_LINEAR_____261_CM 0. 1279.9 DISPLAY_IDENTIFIER IP_T_LAM_DLY_POS_TEG_CAT FORMAT "%7.2"
 /begin AXIS_DESCR COM_AXIS teg_cat_up_mdl_max _CNV_A_R_LINEAR_____262_CM 6 -48. 1459.3 FORMAT "%7.2" AXIS_PTS_REF ldpm_teg_cat_down_mdl_1_lam /end AXIS_DESCR
/end CHARACTERISTIC
/begin CHARACTERISTIC ip_t_lam_dly_neg_teg_cat "Offset P-jump delay negativ CAT temperature dependant" CURVE 0x0e622 _REC_CUR_20_u2_u2 1279.9 _CNV_A_R_LINEAR_____261_CM 0. 1279.9 DISPLAY_IDENTIFIER IP_T_LAM_DLY_NEG_TEG_CAT FORMAT "%7.2"
 /begin AXIS_DESCR COM_AXIS teg_cat_up_mdl_max _CNV_A_R_LINEAR_____262_CM 6 -48. 1459.3 FORMAT "%7.2" AXIS_PTS_REF ldpm_teg_cat_down_mdl_1_lam /end AXIS_DESCR
/end CHARACTERISTIC
/begin CHARACTERISTIC ip_crlc_lam_mv_lpf_cp "Damping constant of the low pass filter used by canister purge" CURVE 0x00a5e _REC_CUR_20_u1_u2 0.99610001 _CNV_A_R_LINEAR_____29_CM 0. 0.99610001 DISPLAY_IDENTIFIER IP_CRLC_LAM_MV_LPF_CP FORMAT "%5.3"
 /begin AXIS_DESCR COM_AXIS maf_cyl _CNV_A_R_LINEAR_____113_CM 6 0. 2047.96875 FORMAT "%7.2" AXIS_PTS_REF ldp_maf_cyl_ip_crlc_lam_mv_lpf /end AXIS_DESCR
/end CHARACTERISTIC
/begin CHARACTERISTIC c_maf_dyw "MAF window for limited dynamics." VALUE 0x00722 _REC_VAL_20_u1 1389. _CNV_A_R_LINEAR_____27_CM 0. 1389. DISPLAY_IDENTIFIER C_MAF_DYW FORMAT "%4.0" /end CHARACTERISTIC
/begin CHARACTERISTIC c_n_dyw "N window for limited dynamics." VALUE 0x016e4 _REC_VAL_20_u2 8160. _CNV_A_R_LINEAR_____11_CM 0. 8160. DISPLAY_IDENTIFIER C_N_DYW FORMAT "%4.0" /end CHARACTERISTIC
/begin CHARACTERISTIC c_lam_mv_dyw "LAM_MV_i window for limited dynamics." VALUE 0x015f6 _REC_VAL_20_u2 99.99847412 _CNV_A_R_LINEAR_____9_CM 0. 99.99847412 DISPLAY_IDENTIFIER C_LAM_MV_DYW /end CHARACTERISTIC
/begin AXIS_PTS ldpm_n_32_1_lamb_ctl "" 0x08016 n_32 _REC_AXS_20_u1 8160. _CNV_A_R_LINEAR_____16_CM 8 0. 8160. DISPLAY_IDENTIFIER LDPM_N_32_1_LAMB_CTL FORMAT "%4.0" /end AXIS_PTS
/begin AXIS_PTS ldpm_maf_1_lamb_ctl "" 0x116bc maf _REC_AXS_20_u2 1389. _CNV_A_R_LINEAR_____106_CM 8 0. 1389. DISPLAY_IDENTIFIER LDPM_MAF_1_LAMB_CTL FORMAT "%7.2" /end AXIS_PTS
/begin AXIS_PTS ldpm_maf_2_lamb_ctl "" 0x11702 maf _REC_AXS_20_u2 1389. _CNV_A_R_LINEAR_____106_CM 8 0. 1389. DISPLAY_IDENTIFIER LDPM_MAF_2_LAMB_CTL FORMAT "%7.2" /end AXIS_PTS
/begin AXIS_PTS ldpm_tco_1_lam "" 0x013ba tco _REC_AXS_20_u1 190.5 _CNV_A_R_LINEAR_____12_CM 6 -48. 142.5 DISPLAY_IDENTIFIER LDPM_TCO_1_LAM FORMAT "%5.1" /end AXIS_PTS
/begin AXIS_PTS ldpm_n_32_2_lamb_ctl "" 0x08050 n_32 _REC_AXS_20_u1 8160. _CNV_A_R_LINEAR_____16_CM 8 0. 8160. DISPLAY_IDENTIFIER LDPM_N_32_2_LAMB_CTL FORMAT "%4.0" /end AXIS_PTS
/begin AXIS_PTS ldp_maf_cyl_ip_crlc_lam_mv_lpf "" 0x10c14 maf_cyl _REC_AXS_20_u2 2047.96875 _CNV_A_R_LINEAR_____113_CM 6 0. 2047.96875 DISPLAY_IDENTIFIER LDP_MAF_CYL_IP_CRLC_LAM_MV_LPF FORMAT "%7.2" /end AXIS_PTS
/begin AXIS_PTS ldpm_teg_cat_down_mdl_1_lam "" 0x11b64 teg_cat_up_mdl_max _REC_AXS_20_u2 1507.3 _CNV_A_R_LINEAR_____262_CM 6 -48. 1459.3 DISPLAY_IDENTIFIER LDPM_TEG_CAT_DOWN_MDL_1_LAM FORMAT "%7.2" /end AXIS_PTS
/begin MEASUREMENT lamb_hom_afl "lambda setpoint for homogeneous lean combustion" UWORD _CNV_A_R_LINEAR_____164_CM 1 100. 0. 31.99902344 DISPLAY_IDENTIFIER LAMB_HOM_AFL ECU_ADDRESS 0x3fd0b2 BYTE_ORDER MSB_LAST FORMAT "%7.4" /end MEASUREMENT
/begin CHARACTERISTIC ip_lamb_bas_wup_cor "Warm-up correction of basic lambda" MAP 0x0be46 _REC_MAP_20_u2_u1_u1 4. _CNV_A_R_LINEAR_____264_CM -2. 2. DISPLAY_IDENTIFIER IP_LAMB_BAS_WUP_COR FORMAT "%8.5"
 /begin AXIS_DESCR COM_AXIS tco _CNV_A_R_LINEAR_____12_CM 8 -48. 142.5 FORMAT "%5.1" AXIS_PTS_REF ldp_tco_ip_lamb_bas_wup_cor /end AXIS_DESCR
 /begin AXIS_DESCR COM_AXIS tco_st _CNV_A_R_LINEAR_____12_CM 8 -48. 142.5 FORMAT "%5.1" AXIS_PTS_REF ldp_tco_st_ip_lamb_bas_wup_cor /end AXIS_DESCR
/end CHARACTERISTIC
/begin CHARACTERISTIC ip_lamb_hom_afl "lambda setpoint for homogeneous lean combustion" MAP 0x0c01e _REC_MAP_20_u2_u1_u2 31.99902344 _CNV_A_R_LINEAR_____164_CM 0. 31.99902344 DISPLAY_IDENTIFIER IP_LAMB_HOM_AFL FORMAT "%7.4"
 /begin AXIS_DESCR COM_AXIS n_32 _CNV_A_R_LINEAR_____16_CM 8 0. 8160. FORMAT "%4.0" AXIS_PTS_REF ldp_n_32_ip_lamb_hom_afl /end AXIS_DESCR
 /begin AXIS_DESCR COM_AXIS tqi_req_slow _CNV_A_R_LINEAR_____186_CM 8 -1024. 1023.96875 FORMAT "%6.2" AXIS_PTS_REF ldp_tqi_req_slow_ip_lamb_hom_afl /end AXIS_DESCR
/end CHARACTERISTIC
/begin MEASUREMENT lamb_afl_1 "lambda setpoint for homogeneous lean step value" UWORD _CNV_A_R_LINEAR_____164_CM 1 100. 0. 31.99902344 DISPLAY_IDENTIFIER LAMB_AFL_1 ECU_ADDRESS 0x3fd0b4 BYTE_ORDER MSB_LAST FORMAT "%7.4" /end MEASUREMENT
/begin CHARACTERISTIC ip_lamb_bas_1 "basic lambda setpoint" MAP 0x0bd46 _REC_MAP_20_u2_u1_u2 4. _CNV_A_R_LINEAR_____125_CM 0. 4. DISPLAY_IDENTIFIER IP_LAMB_BAS_1 FORMAT "%6.4"
 /begin AXIS_DESCR COM_AXIS n_32 _CNV_A_R_LINEAR_____16_CM 8 0. 8160. FORMAT "%4.0" AXIS_PTS_REF ldpm_n_32_1_lasp /end AXIS_DESCR
 /begin AXIS_DESCR COM_AXIS maf _CNV_A_R_LINEAR_____106_CM 8 0. 1389. FORMAT "%7.2" AXIS_PTS_REF ldpm_maf_1_lasp /end AXIS_DESCR
/end CHARACTERISTIC
/begin CHARACTERISTIC ip_lamb_bas_2 "basic lambda setpoint" MAP 0x0bdc6 _REC_MAP_20_u2_u1_u2 4. _CNV_A_R_LINEAR_____125_CM 0. 4. DISPLAY_IDENTIFIER IP_LAMB_BAS_2 FORMAT "%6.4"
 /begin AXIS_DESCR COM_AXIS n_32 _CNV_A_R_LINEAR_____16_CM 8 0. 8160. FORMAT "%4.0" AXIS_PTS_REF ldpm_n_32_1_lasp /end AXIS_DESCR
 /begin AXIS_DESCR COM_AXIS maf _CNV_A_R_LINEAR_____106_CM 8 0. 1389. FORMAT "%7.2" AXIS_PTS_REF ldpm_maf_1_lasp /end AXIS_DESCR
/end CHARACTERISTIC
/begin MEASUREMENT lamb_hom_afs "stociometric lambda setpoint  " UWORD _CNV_A_R_LINEAR_____164_CM 1 100. 0. 31.99902344 DISPLAY_IDENTIFIER LAMB_HOM_AFS ECU_ADDRESS 0x3fd0b6 BYTE_ORDER MSB_LAST FORMAT "%7.4" /end MEASUREMENT
/begin MEASUREMENT lamb_bas "basic lambda setpoint" UWORD _CNV_A_R_LINEAR_____164_CM 1 100. 0. 31.99902344 DISPLAY_IDENTIFIER LAMB_BAS ECU_ADDRESS 0x3fd0b0 BYTE_ORDER MSB_LAST FORMAT "%7.4" /end MEASUREMENT
/begin CHARACTERISTIC c_lamb_bas_ofs_cat_diag "Offset for lambda setpoint" VALUE 0x00412 _REC_VAL_20_s2 3.999938965 _CNV_A_R_LINEAR_____265_CM -2. 1.999938965 DISPLAY_IDENTIFIER C_LAMB_BAS_OFS_CAT_DIAG FORMAT "%8.4" /end CHARACTERISTIC
/begin CHARACTERISTIC ip_lamb_afl_1 "lambda setpoint for homogeneous lean step value" MAP 0x0bcc6 _REC_MAP_20_u2_u1_u2 31.99902344 _CNV_A_R_LINEAR_____164_CM 0. 31.99902344 DISPLAY_IDENTIFIER IP_LAMB_AFL_1 FORMAT "%7.4"
 /begin AXIS_DESCR COM_AXIS n_32 _CNV_A_R_LINEAR_____16_CM 8 0. 8160. FORMAT "%4.0" AXIS_PTS_REF ldp_n_32_ip_lamb_afl_1 /end AXIS_DESCR
 /begin AXIS_DESCR COM_AXIS tqi_req_slow _CNV_A_R_LINEAR_____186_CM 8 -1024. 1023.96875 FORMAT "%6.2" AXIS_PTS_REF ldp_tqi_req_slow_ip_lamb_afl_1 /end AXIS_DESCR
/end CHARACTERISTIC
/begin CHARACTERISTIC ip_fac_lamb_wup "correction factor for basic lambda warm-up" MAP 0x04f96 _REC_MAP_20_u1_u1_u2 1.9921875 _CNV_A_R_LINEAR_____115_CM 0. 1.9921875 DISPLAY_IDENTIFIER IP_FAC_LAMB_WUP FORMAT "%5.3"
 /begin AXIS_DESCR COM_AXIS n_32 _CNV_A_R_LINEAR_____16_CM 6 0. 8160. FORMAT "%4.0" AXIS_PTS_REF ldp_n_32_ip_fac_lamb_wup /end AXIS_DESCR
 /begin AXIS_DESCR COM_AXIS maf _CNV_A_R_LINEAR_____106_CM 6 0. 1389. FORMAT "%7.2" AXIS_PTS_REF ldp_maf_ip_fac_lamb_wup /end AXIS_DESCR
/end CHARACTERISTIC
/begin CHARACTERISTIC ip_fac_lamb_wup_is "correction factor for basic lambda warm-up during idle" MAP 0x04fba _REC_MAP_20_u1_u1_u2 1.9921875 _CNV_A_R_LINEAR_____115_CM 0. 1.9921875 DISPLAY_IDENTIFIER IP_FAC_LAMB_WUP_IS FORMAT "%5.3"
 /begin AXIS_DESCR COM_AXIS n_32 _CNV_A_R_LINEAR_____16_CM 3 0. 8160. FORMAT "%4.0" AXIS_PTS_REF ldp_n_32_ip_fac_lamb_wup_is /end AXIS_DESCR
 /begin AXIS_DESCR COM_AXIS maf _CNV_A_R_LINEAR_____106_CM 4 0. 1389. FORMAT "%7.2" AXIS_PTS_REF ldp_maf_ip_fac_lamb_wup_is /end AXIS_DESCR
/end CHARACTERISTIC
/begin AXIS_PTS ldpm_maf_1_lasp "" 0x116ce maf _REC_AXS_20_u2 1389. _CNV_A_R_LINEAR_____106_CM 8 0. 1389. DISPLAY_IDENTIFIER LDPM_MAF_1_LASP FORMAT "%7.2" /end AXIS_PTS
/begin AXIS_PTS ldpm_n_32_1_lasp "" 0x0801f n_32 _REC_AXS_20_u1 8160. _CNV_A_R_LINEAR_____16_CM 8 0. 8160. DISPLAY_IDENTIFIER LDPM_N_32_1_LASP FORMAT "%4.0" /end AXIS_PTS
/begin AXIS_PTS ldp_n_32_ip_lamb_afl_1 "" 0x07c76 n_32 _REC_AXS_20_u1 8160. _CNV_A_R_LINEAR_____16_CM 8 0. 8160. DISPLAY_IDENTIFIER LDP_N_32_IP_LAMB_AFL_1 FORMAT "%4.0" /end AXIS_PTS
/begin AXIS_PTS ldp_tqi_req_slow_ip_lamb_afl_1 "" 0x113b4 tqi_req_slow _REC_AXS_20_u2 2047.96875 _CNV_A_R_LINEAR_____186_CM 8 -1024. 1023.96875 DISPLAY_IDENTIFIER LDP_TQI_REQ_SLOW_IP_LAMB_AFL_1 FORMAT "%6.2" /end AXIS_PTS
/begin AXIS_PTS ldp_tco_st_ip_lamb_bas_wup_cor "" 0x07e30 tco_st _REC_AXS_20_u1 190.5 _CNV_A_R_LINEAR_____12_CM 8 -48. 142.5 DISPLAY_IDENTIFIER LDP_TCO_ST_IP_LAMB_BAS_WUP_COR FORMAT "%5.1" /end AXIS_PTS
/begin AXIS_PTS ldp_n_32_ip_lamb_hom_afl "" 0x07c7f n_32 _REC_AXS_20_u1 8160. _CNV_A_R_LINEAR_____16_CM 8 0. 8160. DISPLAY_IDENTIFIER LDP_N_32_IP_LAMB_HOM_AFL FORMAT "%4.0" /end AXIS_PTS
/begin AXIS_PTS ldp_tqi_req_slow_ip_lamb_hom_afl "" 0x113c6 tqi_req_slow _REC_AXS_20_u2 2047.96875 _CNV_A_R_LINEAR_____186_CM 8 -1024. 1023.96875 DISPLAY_IDENTIFIER LDP_TQI_REQ_SLOW_IP_LAMB_HOM_AFL FORMAT "%6.2" /end AXIS_PTS
/begin AXIS_PTS ldp_tco_ip_lamb_bas_wup_cor "" 0x07de6 tco _REC_AXS_20_u1 190.5 _CNV_A_R_LINEAR_____12_CM 8 -48. 142.5 DISPLAY_IDENTIFIER LDP_TCO_IP_LAMB_BAS_WUP_COR FORMAT "%5.1" /end AXIS_PTS
/begin AXIS_PTS ldp_n_32_ip_fac_lamb_wup "" 0x0108d n_32 _REC_AXS_20_u1 8160. _CNV_A_R_LINEAR_____16_CM 6 0. 8160. DISPLAY_IDENTIFIER LDP_N_32_IP_FAC_LAMB_WUP FORMAT "%4.0" /end AXIS_PTS
/begin AXIS_PTS ldp_n_32_ip_fac_lamb_wup_is "" 0x01094 n_32 _REC_AXS_20_u1 8160. _CNV_A_R_LINEAR_____16_CM 3 0. 8160. DISPLAY_IDENTIFIER LDP_N_32_IP_FAC_LAMB_WUP_IS FORMAT "%4.0" /end AXIS_PTS
/begin AXIS_PTS ldp_maf_ip_fac_lamb_wup "" 0x10c88 maf _REC_AXS_20_u2 1389. _CNV_A_R_LINEAR_____106_CM 6 0. 1389. DISPLAY_IDENTIFIER LDP_MAF_IP_FAC_LAMB_WUP FORMAT "%7.2" /end AXIS_PTS
/begin AXIS_PTS ldp_maf_ip_fac_lamb_wup_is "" 0x10c96 maf _REC_AXS_20_u2 1389. _CNV_A_R_LINEAR_____106_CM 4 0. 1389. DISPLAY_IDENTIFIER LDP_MAF_IP_FAC_LAMB_WUP_IS FORMAT "%7.2" /end AXIS_PTS
/begin MEASUREMENT lamb_ch "Lambda catalyst heating" UWORD _CNV_A_R_LINEAR_____164_CM 1 100. 0. 31.99902344 DISPLAY_IDENTIFIER LAMB_CH ECU_ADDRESS 0x3fd050 BYTE_ORDER MSB_LAST FORMAT "%7.4" /end MEASUREMENT
/begin MEASUREMENT lamb_afl_ch "Lambda catalyst heating with lean strategy" UWORD _CNV_A_R_LINEAR_____164_CM 1 100. 0. 31.99902344 DISPLAY_IDENTIFIER LAMB_AFL_CH ECU_ADDRESS 0x3fd052 BYTE_ORDER MSB_LAST FORMAT "%7.4" /end MEASUREMENT
/begin CHARACTERISTIC ip_lamb_add_afl_ch "additive correction of the basic lambda heating correction" MAP 0x0bbc6 _REC_MAP_20_u2_u2_u1 63.99902344 _CNV_A_R_LINEAR_____266_CM -32. 31.99902344 DISPLAY_IDENTIFIER IP_LAMB_ADD_AFL_CH FORMAT "%8.4"
 /begin AXIS_DESCR COM_AXIS t_ast _CNV_A_R_LINEAR_____24_CM 8 0. 6553.5 FORMAT "%5.1" AXIS_PTS_REF ldp_t_ast__lamb_add_afl_ch /end AXIS_DESCR
 /begin AXIS_DESCR COM_AXIS tco _CNV_A_R_LINEAR_____12_CM 8 -48. 142.5 FORMAT "%5.1" AXIS_PTS_REF ldp_tco__lamb_add_afl_ch /end AXIS_DESCR
/end CHARACTERISTIC
/begin CHARACTERISTIC ip_lamb_ch_rgl "basic lambda correction for lean catalyst heating" MAP 0x0bf46 _REC_MAP_20_u2_u2_u1 31.99902344 _CNV_A_R_LINEAR_____164_CM 0. 31.99902344 DISPLAY_IDENTIFIER IP_LAMB_CH_RGL FORMAT "%7.4"
 /begin AXIS_DESCR COM_AXIS tqi_req_slow _CNV_A_R_LINEAR_____186_CM 8 -1024. 1023.96875 FORMAT "%6.2" AXIS_PTS_REF ldp_tqi_req_slow__lamb_ch_rgl /end AXIS_DESCR
 /begin AXIS_DESCR COM_AXIS n_32 _CNV_A_R_LINEAR_____16_CM 8 0. 8160. FORMAT "%4.0" AXIS_PTS_REF ldp_n_32__lamb_ch_rgl /end AXIS_DESCR
/end CHARACTERISTIC
/begin CHARACTERISTIC ip_lamb_ch_is "basic lambda correction for lean catalyst heating during idle" MAP 0x0bec6 _REC_MAP_20_u2_u2_u1 31.99902344 _CNV_A_R_LINEAR_____164_CM 0. 31.99902344 DISPLAY_IDENTIFIER IP_LAMB_CH_IS FORMAT "%7.4"
 /begin AXIS_DESCR COM_AXIS tqi_req_slow _CNV_A_R_LINEAR_____186_CM 8 -1024. 1023.96875 FORMAT "%6.2" AXIS_PTS_REF ldp_tqi_req_slow__lamb_ch_is /end AXIS_DESCR
 /begin AXIS_DESCR COM_AXIS n_32 _CNV_A_R_LINEAR_____16_CM 8 0. 8160. FORMAT "%4.0" AXIS_PTS_REF ldp_n_32__lamb_ch_is /end AXIS_DESCR
/end CHARACTERISTIC
/begin AXIS_PTS ldp_tco__lamb_add_afl_ch "" 0x07d8c tco _REC_AXS_20_u1 190.5 _CNV_A_R_LINEAR_____12_CM 8 -48. 142.5 DISPLAY_IDENTIFIER LDP_TCO__LAMB_ADD_AFL_CH FORMAT "%5.1" /end AXIS_PTS
/begin AXIS_PTS ldp_t_ast__lamb_add_afl_ch "" 0x11156 t_ast _REC_AXS_20_u2 983.025 _CNV_A_R_LINEAR_____24_CM 8 0. 6553.5 DISPLAY_IDENTIFIER LDP_T_AST__LAMB_ADD_AFL_CH FORMAT "%5.1" /end AXIS_PTS
/begin AXIS_PTS ldp_tqi_req_slow__lamb_ch_rgl "" 0x1137e tqi_req_slow _REC_AXS_20_u2 2047.96875 _CNV_A_R_LINEAR_____186_CM 8 -1024. 1023.96875 DISPLAY_IDENTIFIER LDP_TQI_REQ_SLOW__LAMB_CH_RGL FORMAT "%6.2" /end AXIS_PTS
/begin AXIS_PTS ldp_n_32__lamb_ch_rgl "" 0x07c03 n_32 _REC_AXS_20_u1 8160. _CNV_A_R_LINEAR_____16_CM 8 0. 8160. DISPLAY_IDENTIFIER LDP_N_32__LAMB_CH_RGL FORMAT "%4.0" /end AXIS_PTS
/begin AXIS_PTS ldp_tqi_req_slow__lamb_ch_is "" 0x1136c tqi_req_slow _REC_AXS_20_u2 2047.96875 _CNV_A_R_LINEAR_____186_CM 8 -1024. 1023.96875 DISPLAY_IDENTIFIER LDP_TQI_REQ_SLOW__LAMB_CH_IS FORMAT "%6.2" /end AXIS_PTS
/begin AXIS_PTS ldp_n_32__lamb_ch_is "" 0x07bfa n_32 _REC_AXS_20_u1 8160. _CNV_A_R_LINEAR_____16_CM 8 0. 8160. DISPLAY_IDENTIFIER LDP_N_32__LAMB_CH_IS FORMAT "%4.0" /end AXIS_PTS
/begin CHARACTERISTIC ip_teg_cop_sp_dif "Temperature offset launching overheat protection" CURVE 0x0ec5a _REC_CUR_20_u2_u1 753.641 _CNV_A_R_LINEAR_____267_CM 0. 753.641 DISPLAY_IDENTIFIER IP_TEG_COP_SP_DIF FORMAT "%7.3"
 /begin AXIS_DESCR COM_AXIS online_dummy _CNV_A_R_LINEAR_____268_CM 6 0. 127.5 FORMAT "%5.1" AXIS_PTS_REF ldp_t_cop_i__teg_cop /end AXIS_DESCR
/end CHARACTERISTIC
/begin CHARACTERISTIC ip_lamb_cop "Lambda setpoint for overheat protection" CURVE 0x0bfc6 _REC_CUR_20_u2_u2 31.99902344 _CNV_A_R_LINEAR_____164_CM 0. 31.99902344 DISPLAY_IDENTIFIER IP_LAMB_COP FORMAT "%7.4"
 /begin AXIS_DESCR COM_AXIS online_dummy _CNV_A_R_LINEAR_____21_CM 16 0. 1.99996948 FORMAT "%7.5" AXIS_PTS_REF ldp_fac_cop_i__teg_cop /end AXIS_DESCR
/end CHARACTERISTIC
/begin CHARACTERISTIC ip_teg_cop_sp "Catalyst overheat protection setpoint" CURVE 0x01b44 _REC_CUR_20_u2_u2 1507.3 _CNV_A_R_LINEAR_____262_CM -48. 1459.3 DISPLAY_IDENTIFIER IP_TEG_COP_SP FORMAT "%7.2"
 /begin AXIS_DESCR COM_AXIS online_dummy _CNV_A_R_LINEAR_____21_CM 4 0. 1.99996948 FORMAT "%7.5" AXIS_PTS_REF ldpm_eff_iga_av_teg_i__teg_cop /end AXIS_DESCR
/end CHARACTERISTIC
/begin CHARACTERISTIC c_lgrd_lamb_cop_inc "Change limitation for the lambda catalyst overheating prevention" VALUE 0x01626 _REC_VAL_20_u2 31.99902344 _CNV_A_R_LINEAR_____164_CM 0. 31.99902344 DISPLAY_IDENTIFIER C_LGRD_LAMB_COP_INC FORMAT "%7.4" /end CHARACTERISTIC
/begin CHARACTERISTIC c_lgrd_lamb_cop_dec "Decrementation for the lambda catalyst overheating prevention" VALUE 0x01624 _REC_VAL_20_u2 31.99902344 _CNV_A_R_LINEAR_____164_CM 0. 31.99902344 DISPLAY_IDENTIFIER C_LGRD_LAMB_COP_DEC FORMAT "%7.4" /end CHARACTERISTIC
/begin CHARACTERISTIC ip_teg_cop_sp_lim "Catalyst overheat protection at ewrror" CURVE 0x01b4c _REC_CUR_20_u2_u2 1507.3 _CNV_A_R_LINEAR_____262_CM -48. 1459.3 DISPLAY_IDENTIFIER IP_TEG_COP_SP_LIM FORMAT "%7.2"
 /begin AXIS_DESCR COM_AXIS online_dummy _CNV_A_R_LINEAR_____21_CM 4 0. 1.99996948 FORMAT "%7.5" AXIS_PTS_REF ldpm_eff_iga_av_teg_i__teg_cop /end AXIS_DESCR
/end CHARACTERISTIC
/begin AXIS_PTS ldp_t_cop_i__teg_cop "" 0x0112f online_dummy _REC_AXS_20_u1 127.5 _CNV_A_R_LINEAR_____268_CM 6 0. 127.5 DISPLAY_IDENTIFIER LDP_T_COP_I__TEG_COP FORMAT "%5.1" /end AXIS_PTS
/begin AXIS_PTS ldp_fac_cop_i__teg_cop "" 0x10a98 online_dummy _REC_AXS_20_u2 1.99996948 _CNV_A_R_LINEAR_____21_CM 16 0. 1.99996948 DISPLAY_IDENTIFIER LDP_FAC_COP_I__TEG_COP FORMAT "%7.5" /end AXIS_PTS
/begin AXIS_PTS ldpm_eff_iga_av_teg_i__teg_cop "" 0x1162c online_dummy _REC_AXS_20_u2 1.99996948 _CNV_A_R_LINEAR_____21_CM 4 0. 1.99996948 DISPLAY_IDENTIFIER LDPM_EFF_IGA_AV_TEG_I__TEG_COP FORMAT "%7.5" /end AXIS_PTS
/begin CHARACTERISTIC c_lamb_cop_sp_pas "passive value for the lambda catalyst overheating prevention" VALUE 0x01600 _REC_VAL_20_u2 31.99902344 _CNV_A_R_LINEAR_____164_CM 0. 31.99902344 DISPLAY_IDENTIFIER C_LAMB_COP_SP_PAS FORMAT "%7.4" /end CHARACTERISTIC
/begin CHARACTERISTIC c_teg_cop_dif_lim "offset for cat overheat protection in error limitation" VALUE 0x018e0 _REC_VAL_20_u2 753.641 _CNV_A_R_LINEAR_____267_CM 0. 753.641 DISPLAY_IDENTIFIER C_TEG_COP_DIF_LIM FORMAT "%7.3" /end CHARACTERISTIC
/begin MEASUREMENT lam_bank_1.ls_ready.bf.lv_up_ls "Logical variable for recognized operability of the lambda probe" ULONG _CNV_S_2_RANGE______0_CM 1 100. 0. 1. DISPLAY_IDENTIFIER LV_UP_LS_1 ECU_ADDRESS 0x3fc408 BYTE_ORDER MSB_LAST BIT_MASK 0x80000000 /end MEASUREMENT
/begin MEASUREMENT lam_bank_1.ls_ready.bf.lv_up_ls_cdn "Logical variable for recognized limited operability of the lambda probe" ULONG _CNV_S_2_RANGE______0_CM 1 100. 0. 1. DISPLAY_IDENTIFIER LV_UP_LS_CDN_1 ECU_ADDRESS 0x3fc408 BYTE_ORDER MSB_LAST BIT_MASK 0x40000000 /end MEASUREMENT
/begin MEASUREMENT lam_bank_1.lam_dly.bf.lv_delta_lamb "Boolean for I-share of downstream fuel trim regulation active" ULONG _CNV_S_2_RANGE______0_CM 1 100. 0. 1. DISPLAY_IDENTIFIER LV_DELTA_LAMB_1 ECU_ADDRESS 0x3fc28c BYTE_ORDER MSB_LAST BIT_MASK 0x40000000 /end MEASUREMENT
/begin MEASUREMENT lam_bank_1.lam_dly.bf.lv_lam_dly_per_vld "internal state variable for the monitoring of the controller difference (sign)" ULONG _CNV_S_2_RANGE______0_CM 1 100. 0. 1. DISPLAY_IDENTIFIER LV_LAM_DLY_PER_VLD_1 ECU_ADDRESS 0x3fc28c BYTE_ORDER MSB_LAST BIT_MASK 0x20000000 /end MEASUREMENT
/begin MEASUREMENT lam_bank_1.lam_dly.bf.lv_delta_lamb_act "Boolean for downstream fuel trim regulation active" ULONG _CNV_S_2_RANGE______0_CM 1 100. 0. 1. DISPLAY_IDENTIFIER LV_DELTA_LAMB_ACT_1 ECU_ADDRESS 0x3fc28c BYTE_ORDER MSB_LAST BIT_MASK 0x80000000 /end MEASUREMENT
/begin MEASUREMENT lam_bank_1.lam_dly.fac_cat_dly "weight factor for P-share regarding catalyst conversion capability" UWORD _CNV_A_R_LINEAR_____37_CM 1 100. 0. 0.99998474 DISPLAY_IDENTIFIER FAC_CAT_DLY_1 ECU_ADDRESS 0x3fc29e BYTE_ORDER MSB_LAST FORMAT "%7.5" /end MEASUREMENT
/begin MEASUREMENT lam_bank_1.lam_dly.maf_int_dly "integral of air mass flow since LAM activation" UWORD _CNV_A_R_LINEAR_____271_CM 1 100. 0. 1820.398 DISPLAY_IDENTIFIER MAF_INT_DLY_1 ECU_ADDRESS 0x3fc2a0 BYTE_ORDER MSB_LAST FORMAT "%7.2" /end MEASUREMENT
/begin MEASUREMENT lam_bank_1.lam_dly.t_dly_i "LAM -P-jump delay time from I-share" SWORD _CNV_A_R_LINEAR_____272_CM 1 100. -640. 639.9804688 DISPLAY_IDENTIFIER T_DLY_I_1 ECU_ADDRESS 0x3fc294 BYTE_ORDER MSB_LAST FORMAT "%7.2" /end MEASUREMENT
/begin MEASUREMENT lam_bank_1.lam_dly.t_dly_i_ad "initial value for the I-share (Adaptation value)" SWORD _CNV_A_R_LINEAR_____272_CM 1 100. -640. 639.9804688 DISPLAY_IDENTIFIER T_DLY_I_AD_1 ECU_ADDRESS 0x3fc29a BYTE_ORDER MSB_LAST FORMAT "%7.2" /end MEASUREMENT
/begin MEASUREMENT lam_bank_1.lam_dly.t_dly_p "LAM -P-jump delay time from P-share" SWORD _CNV_A_R_LINEAR_____273_CM 1 100. -2560. 2559.921875 DISPLAY_IDENTIFIER T_DLY_P_1 ECU_ADDRESS 0x3fc292 BYTE_ORDER MSB_LAST FORMAT "%7.2" /end MEASUREMENT
/begin MEASUREMENT lam_bank_1.lam_dly.t_lam_dly "LAM -P-jump delay time from downstream trim controller" SWORD _CNV_A_R_LINEAR_____274_CM 1 100. -15360. 15359.53125 DISPLAY_IDENTIFIER T_LAM_DLY_1 ECU_ADDRESS 0x3fc29c BYTE_ORDER MSB_LAST FORMAT "%8.1" /end MEASUREMENT
/begin MEASUREMENT lam_bank_1.lam_dly.vls_dif_dly "difference between setpoint and actual downstream LS signal" SWORD _CNV_A_R_LINEAR_____3_CM 1 100. -4.99511719 4.99511719 DISPLAY_IDENTIFIER VLS_DIF_DLY_1 ECU_ADDRESS 0x3fc290 BYTE_ORDER MSB_LAST FORMAT "%4.3" /end MEASUREMENT
/begin MEASUREMENT lam_bank_1.lam_dly.t_dly_i_mv "I-share-mean-value" SWORD _CNV_A_R_LINEAR_____272_CM 1 100. -640. 639.9804688 DISPLAY_IDENTIFIER T_DLY_I_MV_1 ECU_ADDRESS 0x3fc298 BYTE_ORDER MSB_LAST FORMAT "%7.2" /end MEASUREMENT
/begin MEASUREMENT lam_bank_1.lam_up.bf.lv_lam_lim_max "lambda controller value is limited to TI_LAM_MAX" ULONG _CNV_S_2_RANGE______0_CM 1 100. 0. 1. DISPLAY_IDENTIFIER LV_LAM_LIM_MAX_1 ECU_ADDRESS 0x3fc2ec BYTE_ORDER MSB_LAST BIT_MASK 0x40000000 /end MEASUREMENT
/begin MEASUREMENT lam_bank_1.lam_up.bf.lv_lam_lim_min "lambda controller value is limited to TI_LAM_MIN" ULONG _CNV_S_2_RANGE______0_CM 1 100. 0. 1. DISPLAY_IDENTIFIER LV_LAM_LIM_MIN_1 ECU_ADDRESS 0x3fc2ec BYTE_ORDER MSB_LAST BIT_MASK 0x80000000 /end MEASUREMENT
/begin MEASUREMENT lam_bank_1.lam_up.bf.lv_lscl "Close loop enable" ULONG _CNV_S_2_RANGE______0_CM 1 100. 0. 1. DISPLAY_IDENTIFIER LV_LSCL_1 ECU_ADDRESS 0x3fc2ec BYTE_ORDER MSB_LAST BIT_MASK 0x20000000 /end MEASUREMENT
/begin MEASUREMENT lam_bank_1.lam_up.bf.lv_lscl_cat_purge "Conditions for closed loop except cat purge cylinder bank i" ULONG _CNV_S_2_RANGE______0_CM 1 100. 0. 1. DISPLAY_IDENTIFIER LV_LSCL_CAT_PURGE_1 ECU_ADDRESS 0x3fc2ec BYTE_ORDER MSB_LAST BIT_MASK 0x400000 /end MEASUREMENT
/begin MEASUREMENT lam_bank_1.lam_up.bf.lv_lam_once_act " closed loop has been enabled" ULONG _CNV_S_2_RANGE______0_CM 1 100. 0. 1. DISPLAY_IDENTIFIER LV_LAM_ONCE_ACT_1 ECU_ADDRESS 0x3fc2ec BYTE_ORDER MSB_LAST BIT_MASK 0x200000 /end MEASUREMENT
/begin MEASUREMENT lam_bank_1.lam_up.bf.lv_lam_dyw "Limited dynamic conditions recognised for LAM_i" ULONG _CNV_S_2_RANGE______0_CM 1 100. 0. 1. DISPLAY_IDENTIFIER LV_LAM_DYW_1 ECU_ADDRESS 0x3fc2ec BYTE_ORDER MSB_LAST BIT_MASK 0x10000000 /end MEASUREMENT
/begin MEASUREMENT lam_bank_1.lam_up.bf.lv_n_maf_dyw "Limited dynamic conditions recognised for N and MAF" ULONG _CNV_S_2_RANGE______0_CM 1 100. 0. 1. DISPLAY_IDENTIFIER LV_N_MAF_DYW_1 ECU_ADDRESS 0x3fc2ec BYTE_ORDER MSB_LAST BIT_MASK 0x80000 /end MEASUREMENT
/begin MEASUREMENT lam_bank_1.lam_up.bf.lv_lam_adj_ad_end "Controller shift by lambda adaptation was carried out" ULONG _CNV_S_2_RANGE______0_CM 1 100. 0. 1. DISPLAY_IDENTIFIER LV_LAM_ADJ_AD_END_1 ECU_ADDRESS 0x3fc2ec BYTE_ORDER MSB_LAST BIT_MASK 0x100000 /end MEASUREMENT
/begin MEASUREMENT lam_bank_1.lam_up.bf.lv_lscl_inh_err "Closed is disabled due to some existent error" ULONG _CNV_S_2_RANGE______0_CM 1 100. 0. 1. DISPLAY_IDENTIFIER LV_LSCL_INH_ERR_1 ECU_ADDRESS 0x3fc2ec BYTE_ORDER MSB_LAST BIT_MASK 0x1000 /end MEASUREMENT
/begin MEASUREMENT lam_bank_1.lam_up.lam "TI_LAM_i value after a P jump" SWORD _CNV_A_R_LINEAR_____109_CM 1 100. -50. 49.99847412 DISPLAY_IDENTIFIER LAM_1 ECU_ADDRESS 0x3fc30e BYTE_ORDER MSB_LAST FORMAT "%7.3" /end MEASUREMENT
/begin MEASUREMENT lam_bank_1.lam_up.lam_mv "TI_LAM_i average value" SWORD _CNV_A_R_LINEAR_____109_CM 1 100. -50. 49.99847412 DISPLAY_IDENTIFIER LAM_MV_1 ECU_ADDRESS 0x3fc310 BYTE_ORDER MSB_LAST FORMAT "%7.3" /end MEASUREMENT
/begin MEASUREMENT lam_bank_1.lam_up.lam_mv_lpf "LAM_MV_1 average value" SWORD _CNV_A_R_LINEAR_____109_CM 1 100. -50. 49.99847412 DISPLAY_IDENTIFIER LAM_MV_LPF_1 ECU_ADDRESS 0x3fc312 BYTE_ORDER MSB_LAST FORMAT "%7.3" /end MEASUREMENT
/begin MEASUREMENT lam_bank_1.lam_up.lam_p_ctr "P-jump-counter, shows the number of executed jumps" UBYTE _CNV_A_R_LINEAR_____1_CM 1 100. 0. 255. DISPLAY_IDENTIFIER LAM_P_CTR_1 ECU_ADDRESS 0x3fc308 FORMAT "%3.0" /end MEASUREMENT
/begin MEASUREMENT lam_bank_1.lam_up.t_lam_dly_neg "total LAM -P-jump delay time from rich to lean transition  " UWORD _CNV_A_R_LINEAR_____274_CM 1 100. 0. 15359.53125 DISPLAY_IDENTIFIER T_LAM_DLY_NEG_1 ECU_ADDRESS 0x3fc2fe BYTE_ORDER MSB_LAST FORMAT "%8.1" /end MEASUREMENT
/begin MEASUREMENT lam_bank_1.lam_up.t_lam_dly_pos "total LAM -P-jump delay time from lean to rich transition  " UWORD _CNV_A_R_LINEAR_____274_CM 1 100. 0. 15359.53125 DISPLAY_IDENTIFIER T_LAM_DLY_POS_1 ECU_ADDRESS 0x3fc2fc BYTE_ORDER MSB_LAST FORMAT "%8.1" /end MEASUREMENT
/begin MEASUREMENT lam_bank_1.lam_up.ti_lam_max "maximum of lambda control injection time correction" SWORD _CNV_A_R_LINEAR_____109_CM 1 100. -50. 49.99847412 DISPLAY_IDENTIFIER TI_LAM_MAX_1 ECU_ADDRESS 0x3fc30c BYTE_ORDER MSB_LAST FORMAT "%7.3" /end MEASUREMENT
/begin MEASUREMENT lam_bank_1.lam_up.ti_lam_min "minimum of lambda control injection time correction" SWORD _CNV_A_R_LINEAR_____109_CM 1 100. -50. 49.99847412 DISPLAY_IDENTIFIER TI_LAM_MIN_1 ECU_ADDRESS 0x3fc30a BYTE_ORDER MSB_LAST FORMAT "%7.3" /end MEASUREMENT
/begin MEASUREMENT lam_bank_1.lam_up.ti_lam_cor "Lambda control uncorrect injection time correction" SWORD _CNV_A_R_LINEAR_____109_CM 1 100. -50. 49.99847412 DISPLAY_IDENTIFIER TI_LAM_COR_1 ECU_ADDRESS 0x3fc2fa BYTE_ORDER MSB_LAST FORMAT "%7.3" /end MEASUREMENT
/begin MEASUREMENT lam_bank_1.lam_up.t_lam_dly_pos_bas "Positive basic LAM -P-jump delay time" UWORD _CNV_A_R_LINEAR_____261_CM 1 100. 0. 1279.9 DISPLAY_IDENTIFIER T_LAM_DLY_POS_BAS_1 ECU_ADDRESS 0x3fc304 BYTE_ORDER MSB_LAST FORMAT "%7.2" /end MEASUREMENT
/begin MEASUREMENT lam_bank_1.lam_up.t_lam_dly_neg_bas "Negative basic LAM -P-jump delay time" UWORD _CNV_A_R_LINEAR_____261_CM 1 100. 0. 1279.9 DISPLAY_IDENTIFIER T_LAM_DLY_NEG_BAS_1 ECU_ADDRESS 0x3fc306 BYTE_ORDER MSB_LAST FORMAT "%7.2" /end MEASUREMENT
/begin MEASUREMENT lam_bank_1.lam_up.lam_mv_lpf_cp "Mean value of the controller output, used by canister purge" SWORD _CNV_A_R_LINEAR_____109_CM 1 100. -50. 49.99847412 DISPLAY_IDENTIFIER LAM_MV_LPF_CP_1 ECU_ADDRESS 0x3fc314 BYTE_ORDER MSB_LAST FORMAT "%7.3" /end MEASUREMENT
/begin MEASUREMENT lam_bank_1.lam_up.maf_dyw "MAF average value for limited dynamics recognition" UBYTE _CNV_A_R_LINEAR_____27_CM 1 100. 0. 1389. DISPLAY_IDENTIFIER MAF_DYW_1 ECU_ADDRESS 0x3fc318 FORMAT "%4.0" /end MEASUREMENT
/begin MEASUREMENT lam_bank_1.lam_up.n_dyw "N average value for limited dynamics recognition" UWORD _CNV_A_R_LINEAR_____11_CM 1 100. 0. 8160. DISPLAY_IDENTIFIER N_DYW_1 ECU_ADDRESS 0x3fc31a BYTE_ORDER MSB_LAST FORMAT "%4.0" /end MEASUREMENT
/begin MEASUREMENT lam_bank_1.lam_up.lam_mv_dyw "LAM_MV_i average value for limited dynamics recognition" SWORD _CNV_A_R_LINEAR_____109_CM 1 100. -50. 49.99847412 DISPLAY_IDENTIFIER LAM_MV_DYW_1 ECU_ADDRESS 0x3fc316 BYTE_ORDER MSB_LAST FORMAT "%7.3" /end MEASUREMENT
/begin MEASUREMENT lam_bank_1.ls_down_cur.r_down_ls "Internal resistance of downstream oxygen sensor" UWORD _CNV_A_R_LINEAR_____279_CM 1 100. 0. 65535. DISPLAY_IDENTIFIER R_DOWN_LS_1 ECU_ADDRESS 0x3fc396 BYTE_ORDER MSB_LAST FORMAT "%5.0" /end MEASUREMENT
/begin MEASUREMENT lam_bank_1.ls_up.bf.lv_afl "" ULONG _CNV_S_2_RANGE______0_CM 1 100. 0. 1. DISPLAY_IDENTIFIER LV_AFL_1 ECU_ADDRESS 0x3fc414 BYTE_ORDER MSB_LAST BIT_MASK 0x80000000 /end MEASUREMENT
/begin MEASUREMENT lam_bank_1.ls_up.bf.lv_vls_up_mmv_lmt "Boolean flag indicating VLS_MMV_xxx_i signals being limited when set" ULONG _CNV_S_2_RANGE______0_CM 1 100. 0. 1. DISPLAY_IDENTIFIER LV_VLS_UP_MMV_LMT_1 ECU_ADDRESS 0x3fc414 BYTE_ORDER MSB_LAST BIT_MASK 0x10000000 /end MEASUREMENT
/begin MEASUREMENT lam_bank_1.ls_up.bf.lv_vls_up_mmv_stk_vld "Boolean flag indicating VLS_MMV_xxx_i signals valid when set" ULONG _CNV_S_2_RANGE______0_CM 1 100. 0. 1. DISPLAY_IDENTIFIER LV_VLS_UP_MMV_STK_VLD_1 ECU_ADDRESS 0x3fc414 BYTE_ORDER MSB_LAST BIT_MASK 0x8000000 /end MEASUREMENT
/begin MEASUREMENT lam_bank_1.ls_up.ctr_vls_afl_cyc "Denotes number of AF cycles since lambda controller last activated" UWORD _CNV_A_R_LINEAR_____1_CM 1 100. 0. 65535. DISPLAY_IDENTIFIER CTR_VLS_AFL_CYC_1 ECU_ADDRESS 0x3fc41e BYTE_ORDER MSB_LAST FORMAT "%5.0" /end MEASUREMENT
/begin MEASUREMENT lam_bank_1.ls_up.drv1_vls_up_abs_max "Absolute maximum value within buffer containing 1st derivative of VLS_UP_i signal" UWORD _CNV_A_R_LINEAR_____277_CM 1 100. 0. 4.9999237 DISPLAY_IDENTIFIER DRV1_VLS_UP_ABS_MAX_1 ECU_ADDRESS 0x3fc42e BYTE_ORDER MSB_LAST FORMAT "%6.4" /end MEASUREMENT
/begin MEASUREMENT lam_bank_1.ls_up.drv1_vls_up_mmv "Mean of buffer containing 1st derivative of VLS_UP_i signal" SWORD _CNV_A_R_LINEAR_____276_CM 1 100. -2.5 2.4999 DISPLAY_IDENTIFIER DRV1_VLS_UP_MMV_1 ECU_ADDRESS 0x3fc42a BYTE_ORDER MSB_LAST FORMAT "%7.4" /end MEASUREMENT
/begin MEASUREMENT lam_bank_1.ls_up.drv1_vls_up_mmv_min "Minimum value of mean of buffer containing 1st derivative of VLS_UP_i signal in lean phase" SWORD _CNV_A_R_LINEAR_____276_CM 1 100. -2.5 2.4999 DISPLAY_IDENTIFIER DRV1_VLS_UP_MMV_MIN_1 ECU_ADDRESS 0x3fc42c BYTE_ORDER MSB_LAST FORMAT "%7.4" /end MEASUREMENT
/begin MEASUREMENT lam_bank_1.ls_up.t_afl_lock "Timer indicating duration of LV_AFL lock" UBYTE _CNV_A_R_LINEAR_____4_CM 1 100. 0. 2.55 DISPLAY_IDENTIFIER T_AFL_LOCK_1 ECU_ADDRESS 0x3fc441 FORMAT "%4.2" /end MEASUREMENT
/begin MEASUREMENT lam_bank_1.ls_up.t_vls_cyc_afl "Lean mixture cycle time" UBYTE _CNV_A_R_LINEAR_____4_CM 1 100. 0. 2.55 DISPLAY_IDENTIFIER T_VLS_CYC_AFL_1 ECU_ADDRESS 0x3fc41b FORMAT "%4.2" /end MEASUREMENT
/begin MEASUREMENT lam_bank_1.ls_up.t_vls_cyc_afl_hld "Lean mixture cycle time, held until next new value available" UBYTE _CNV_A_R_LINEAR_____4_CM 1 100. 0. 2.55 DISPLAY_IDENTIFIER T_VLS_CYC_AFL_HLD_1 ECU_ADDRESS 0x3fc41c FORMAT "%4.2" /end MEASUREMENT
/begin MEASUREMENT lam_bank_1.ls_up.t_vls_cyc_afr "Rich mixture cycle time" UBYTE _CNV_A_R_LINEAR_____4_CM 1 100. 0. 2.55 DISPLAY_IDENTIFIER T_VLS_CYC_AFR_1 ECU_ADDRESS 0x3fc41a FORMAT "%4.2" /end MEASUREMENT
/begin MEASUREMENT lam_bank_1.ls_up.vls_bol "Corrected VLS_MMV_MIN" UWORD _CNV_A_R_LINEAR_____3_CM 1 100. 0. 4.99511719 DISPLAY_IDENTIFIER VLS_BOL_1 ECU_ADDRESS 0x3fc424 BYTE_ORDER MSB_LAST FORMAT "%5.3" /end MEASUREMENT
/begin MEASUREMENT lam_bank_1.ls_up.vls_mmv_max "Mean maximum sensor voltage" UWORD _CNV_A_R_LINEAR_____250_CM 1 100. 0. 4.99992371 DISPLAY_IDENTIFIER VLS_MMV_MAX_1 ECU_ADDRESS 0x3fc420 BYTE_ORDER MSB_LAST FORMAT "%7.5" /end MEASUREMENT
/begin MEASUREMENT lam_bank_1.ls_up.vls_mmv_min "Mean minimum sensor voltage" UWORD _CNV_A_R_LINEAR_____250_CM 1 100. 0. 4.99992371 DISPLAY_IDENTIFIER VLS_MMV_MIN_1 ECU_ADDRESS 0x3fc422 BYTE_ORDER MSB_LAST FORMAT "%7.5" /end MEASUREMENT
/begin MEASUREMENT lam_bank_1.ls_up.vls_tol "Corrected VLS_MMV_MAX" UWORD _CNV_A_R_LINEAR_____3_CM 1 100. 0. 4.99511719 DISPLAY_IDENTIFIER VLS_TOL_1 ECU_ADDRESS 0x3fc426 BYTE_ORDER MSB_LAST FORMAT "%5.3" /end MEASUREMENT
/begin MEASUREMENT lam_bank_1.ls_up.vls_up_mmv_hys "Variable switching threshold for calculation of VLS_DOWN_MMV_MIN_i" UWORD _CNV_A_R_LINEAR_____275_CM 1 100. 0. 1. DISPLAY_IDENTIFIER VLS_UP_MMV_HYS_1 ECU_ADDRESS 0x3fc428 BYTE_ORDER MSB_LAST FORMAT "%7.5" /end MEASUREMENT
/begin MEASUREMENT lam_bank_1.lsh_down.lshpwm_down "" UBYTE _CNV_A_R_LINEAR_____10_CM 1 100. 0. 99.609375 DISPLAY_IDENTIFIER LSHPWM_DOWN_1 ECU_ADDRESS 0x3fc33c FORMAT "%4.1" /end MEASUREMENT
/begin MEASUREMENT lam_bank_1.lsh_down.t_lsh_down "Timer to determine the duration of heating phase" UBYTE _CNV_A_R_LINEAR_____30_CM 1 100. 0. 255. DISPLAY_IDENTIFIER T_LSH_DOWN_1 ECU_ADDRESS 0x3fc33d FORMAT "%3.0" /end MEASUREMENT
/begin MEASUREMENT lam_bank_1.lsh_down.v_efc_lsh_down "Effective value of heater voltage" UBYTE _CNV_A_R_LINEAR_____34_CM 1 100. 0. 25.8984 DISPLAY_IDENTIFIER V_EFC_LSH_DOWN_1 ECU_ADDRESS 0x3fc33e FORMAT "%3.1" /end MEASUREMENT
/begin MEASUREMENT lam_bank_1.lsh_down.t_lsh_down_tol "Timer to determine the duration of high voltage phases" UBYTE _CNV_A_R_LINEAR_____30_CM 1 100. 0. 255. DISPLAY_IDENTIFIER T_LSH_DOWN_TOL_1 ECU_ADDRESS 0x3fc33f FORMAT "%3.0" /end MEASUREMENT
/begin MEASUREMENT lam_bank_1.lsh_down.t_lsh_down_lim "Timer to determine the duration of heating phases after a high voltage phase" UBYTE _CNV_A_R_LINEAR_____30_CM 1 100. 0. 255. DISPLAY_IDENTIFIER T_LSH_DOWN_LIM_1 ECU_ADDRESS 0x3fc340 FORMAT "%3.0" /end MEASUREMENT
/begin MEASUREMENT lam_bank_1.lsh_down.state_lsh_down "Heating state recognition" ULONG _CNV_S_6_STATE_LSH__284_CM 1 100. 0. 5. DISPLAY_IDENTIFIER STATE_LSH_DOWN_1 ECU_ADDRESS 0x3fc338 BYTE_ORDER MSB_LAST /end MEASUREMENT
/begin MEASUREMENT lam_bank_1.lsh_up_inci.lv_inh_lsh_up "Boolean flag indicating project specific application conditions for heating not met" UBYTE _CNV_S_2_RANGE______0_CM 1 100. 0. 1. DISPLAY_IDENTIFIER LV_INH_LSH_UP_1 ECU_ADDRESS 0x3fc368 /end MEASUREMENT
/begin MEASUREMENT lam_bank_1.lsh_up_inci.lv_inh_lsh_up_cll_ctl "Boolean flag indicating project specific application conditions closed loop heater control not met" UBYTE _CNV_S_2_RANGE______0_CM 1 100. 0. 1. DISPLAY_IDENTIFIER LV_INH_LSH_UP_CLL_CTL_1 ECU_ADDRESS 0x3fc369 /end MEASUREMENT
/begin MEASUREMENT lam_bank_1.lsh_up_inci.lv_ttip_ls_up_mes_vld "Boolean flag indicating validity of oxygen sensor ceramic temperature TTIP_LS_UP_MES_i" UBYTE _CNV_S_2_RANGE______0_CM 1 100. 0. 1. DISPLAY_IDENTIFIER LV_TTIP_LS_UP_MES_VLD_1 ECU_ADDRESS 0x3fc36a /end MEASUREMENT
/begin MEASUREMENT lam_bank_1.lsh_up_inci.lv_v_temp_ls_up_ref_vld "Boolean flag indicating internal resistance determination circuit references valid" UBYTE _CNV_S_2_RANGE______0_CM 1 100. 0. 1. DISPLAY_IDENTIFIER LV_V_TEMP_LS_UP_REF_VLD_1 ECU_ADDRESS 0x3fc36b /end MEASUREMENT
/begin MEASUREMENT lam_bank_1.lsh_up_inci.temp_ls_ini "Oxygen sensor temperature at engine start for the oxygen sensor heating management" SWORD _CNV_A_R_LINEAR_____280_CM 1 100. -2048. 2047.938 DISPLAY_IDENTIFIER TEMP_LS_INI_1 ECU_ADDRESS 0x3fc36c BYTE_ORDER MSB_LAST FORMAT "%8.2" /end MEASUREMENT
/begin MEASUREMENT lam_bank_1.lsh_up.bf.lv_lsh_up_cll_ctl "Boolean variable indicating closed loop control mode active" ULONG _CNV_S_2_RANGE______0_CM 1 100. 0. 1. DISPLAY_IDENTIFIER LV_LSH_UP_CLL_CTL_1 ECU_ADDRESS 0x3fc34c BYTE_ORDER MSB_LAST BIT_MASK 0x80000000 /end MEASUREMENT
/begin MEASUREMENT lam_bank_1.lsh_up.bf.lv_v_efc_lsh_up_lim_bol "Boolean flag indicating effective heater voltage limited due to sum of voltage components falling below zero." ULONG _CNV_S_2_RANGE______0_CM 1 100. 0. 1. DISPLAY_IDENTIFIER LV_V_EFC_LSH_UP_LIM_BOL_1 ECU_ADDRESS 0x3fc34c BYTE_ORDER MSB_LAST BIT_MASK 0x40000000 /end MEASUREMENT
/begin MEASUREMENT lam_bank_1.lsh_up.bf.lv_v_efc_lsh_up_lim_tol "Boolean flag indicating effective heater voltage limited due to exceeding threshold for period of time." ULONG _CNV_S_2_RANGE______0_CM 1 100. 0. 1. DISPLAY_IDENTIFIER LV_V_EFC_LSH_UP_LIM_TOL_1 ECU_ADDRESS 0x3fc34c BYTE_ORDER MSB_LAST BIT_MASK 0x20000000 /end MEASUREMENT
/begin MEASUREMENT lam_bank_1.lsh_up.bf.lv_v_efc_lsh_up_lim_max "Boolean flag indicating effective heater voltage limited due to exceeding absolute maximum voltage spec." ULONG _CNV_S_2_RANGE______0_CM 1 100. 0. 1. DISPLAY_IDENTIFIER LV_V_EFC_LSH_UP_LIM_MAX_1 ECU_ADDRESS 0x3fc34c BYTE_ORDER MSB_LAST BIT_MASK 0x10000000 /end MEASUREMENT
/begin MEASUREMENT lam_bank_1.lsh_up.bf.lv_pow_ctl_act "???" ULONG _CNV_S_2_RANGE______0_CM 1 100. 0. 1. DISPLAY_IDENTIFIER LV_POW_CTL_ACT_1 ECU_ADDRESS 0x3fc34c BYTE_ORDER MSB_LAST BIT_MASK 0x8000000 /end MEASUREMENT
/begin MEASUREMENT lam_bank_1.lsh_up.t_lsh_up "Timer to determine the duration of heating phase" UBYTE _CNV_A_R_LINEAR_____24_CM 1 100. 0. 25.5 DISPLAY_IDENTIFIER T_LSH_UP_1 ECU_ADDRESS 0x3fc355 FORMAT "%4.1" /end MEASUREMENT
/begin MEASUREMENT lam_bank_1.lsh_up.lshpwm_up "" UBYTE _CNV_A_R_LINEAR_____10_CM 1 100. 0. 99.609375 DISPLAY_IDENTIFIER LSHPWM_UP_1 ECU_ADDRESS 0x3fc354 FORMAT "%4.1" /end MEASUREMENT
/begin MEASUREMENT lam_bank_1.lsh_up.v_efc_lsh_up "Effective value of heater voltage" UBYTE _CNV_A_R_LINEAR_____34_CM 1 100. 0. 25.8984 DISPLAY_IDENTIFIER V_EFC_LSH_UP_1 ECU_ADDRESS 0x3fc356 FORMAT "%3.1" /end MEASUREMENT
/begin MEASUREMENT lam_bank_1.lsh_up.t_lsh_up_tol "Timer to determine the duration of high voltage phases" UBYTE _CNV_A_R_LINEAR_____24_CM 1 100. 0. 25.5 DISPLAY_IDENTIFIER T_LSH_UP_TOL_1 ECU_ADDRESS 0x3fc35a FORMAT "%4.1" /end MEASUREMENT
/begin MEASUREMENT lam_bank_1.lsh_up.t_lsh_up_lim "Timer to determine the duration of heating phases after a high voltage phase" UBYTE _CNV_A_R_LINEAR_____24_CM 1 100. 0. 25.5 DISPLAY_IDENTIFIER T_LSH_UP_LIM_1 ECU_ADDRESS 0x3fc35b FORMAT "%4.1" /end MEASUREMENT
/begin MEASUREMENT lam_bank_1.lsh_up.state_lsh_up "Heating state recognition" ULONG _CNV_S_7_STATE_LSH__293_CM 1 100. 0. 6. DISPLAY_IDENTIFIER STATE_LSH_UP_1 ECU_ADDRESS 0x3fc350 BYTE_ORDER MSB_LAST /end MEASUREMENT
/begin MEASUREMENT lam_bank_1.lsh_up.v_efc_lsh_up_clc "Effective calculated heater voltage value prior to overvoltage protection" UWORD _CNV_A_R_LINEAR_____294_CM 1 100. 0. 25.999603 DISPLAY_IDENTIFIER V_EFC_LSH_UP_CLC_1 ECU_ADDRESS 0x3fc358 BYTE_ORDER MSB_LAST FORMAT "%7.4" /end MEASUREMENT
/begin MEASUREMENT lam_bank_1.lsh_up.v_efc_lsh_up_ctl_add "Additive effective heater voltage from closed loop controller" SBYTE _CNV_A_R_LINEAR_____295_CM 1 100. -13.05 12.95 DISPLAY_IDENTIFIER V_EFC_LSH_UP_CTL_ADD_1 ECU_ADDRESS 0x3fc35c FORMAT "%5.1" /end MEASUREMENT
/begin MEASUREMENT lam_bank_1.lsh_up.v_efc_lsh_up_ctl_p_add "Additive effective heater voltage from closed loop controller, P term" SWORD _CNV_A_R_LINEAR_____296_CM 1 100. -13.05 13.05 DISPLAY_IDENTIFIER V_EFC_LSH_UP_CTL_P_ADD_1 ECU_ADDRESS 0x3fc35e BYTE_ORDER MSB_LAST FORMAT "%8.4" /end MEASUREMENT
/begin MEASUREMENT lam_bank_1.lsh_up.v_efc_lsh_up_ctl_i_add "Additive effective heater voltage from closed loop controller, I term" SWORD _CNV_A_R_LINEAR_____296_CM 1 100. -13.05 13.05 DISPLAY_IDENTIFIER V_EFC_LSH_UP_CTL_I_ADD_1 ECU_ADDRESS 0x3fc360 BYTE_ORDER MSB_LAST FORMAT "%8.4" /end MEASUREMENT
/begin MEASUREMENT lam_bank_1.lsh_up.ttip_ls_up_dif_set_mes "Difference between actual and set oxygen sensor tip temperature" SWORD _CNV_A_R_LINEAR_____280_CM 1 100. -2048. 2047.938 DISPLAY_IDENTIFIER TTIP_LS_UP_DIF_SET_MES_1 ECU_ADDRESS 0x3fc362 BYTE_ORDER MSB_LAST FORMAT "%8.2" /end MEASUREMENT
/begin MEASUREMENT lam_bank_1.lam_bas_sp.lamb_bas_h_res "bank selektive basic lambda setpoint with high resolution" ULONG _CNV_A_R_LINEAR_____297_CM 1 100. 0. 32. DISPLAY_IDENTIFIER LAMB_BAS_H_RES_1 ECU_ADDRESS 0x3fc27c BYTE_ORDER MSB_LAST FORMAT "%8.5" /end MEASUREMENT
/begin MEASUREMENT lam_bank_1.lam_bas_sp.lamb_hom_afs_h_res "stoichiometric lambda setpoint with high resolution" ULONG _CNV_A_R_LINEAR_____297_CM 1 100. 0. 32. DISPLAY_IDENTIFIER LAMB_HOM_AFS_H_RES_1 ECU_ADDRESS 0x3fc280 BYTE_ORDER MSB_LAST FORMAT "%8.5" /end MEASUREMENT
/begin MEASUREMENT lam_bank_1.lam_bas_sp.lamb_bas "bank selektive basic lambda setpoint" UWORD _CNV_A_R_LINEAR_____164_CM 1 100. 0. 31.99902344 DISPLAY_IDENTIFIER LAMB_BAS_1 ECU_ADDRESS 0x3fc284 BYTE_ORDER MSB_LAST FORMAT "%7.4" /end MEASUREMENT
/begin MEASUREMENT lam_bank_1.lam_bas_sp.lamb_hom_afs "stoichiometric lambda setpoint" UWORD _CNV_A_R_LINEAR_____164_CM 1 100. 0. 31.99902344 DISPLAY_IDENTIFIER LAMB_HOM_AFS_1 ECU_ADDRESS 0x3fc286 BYTE_ORDER MSB_LAST FORMAT "%7.4" /end MEASUREMENT
/begin MEASUREMENT lam_bank_1.lam_bas_sp.lv_lamb_bas_ofs_cat_diag "flag_to indicate lambda offset" UBYTE _CNV_S_2_RANGE______0_CM 1 100. 0. 1. DISPLAY_IDENTIFIER LV_LAMB_BAS_OFS_CAT_DIAG_1 ECU_ADDRESS 0x3fc288 /end MEASUREMENT
/begin MEASUREMENT lam_bank_1.lamb_sp.lamb_bas_cor "lambda output for TQI_SP_MAF calculation" UWORD _CNV_A_R_LINEAR_____164_CM 1 100. 0. 31.99902344 DISPLAY_IDENTIFIER LAMB_BAS_COR_1 ECU_ADDRESS 0x3fc2e0 BYTE_ORDER MSB_LAST FORMAT "%7.4" /end MEASUREMENT
/begin MEASUREMENT lam_bank_1.lamb_sp.lamb_sp "lambda setpoint" UWORD _CNV_A_R_LINEAR_____164_CM 1 100. 0. 31.99902344 DISPLAY_IDENTIFIER LAMB_SP_1 ECU_ADDRESS 0x3fc2e4 BYTE_ORDER MSB_LAST FORMAT "%7.4" /end MEASUREMENT
/begin MEASUREMENT lam_bank_1.lamb_sp.lamb_sp_bas "lambda feedback for basic torque calculation" UWORD _CNV_A_R_LINEAR_____164_CM 1 100. 0. 31.99902344 DISPLAY_IDENTIFIER LAMB_SP_BAS_1 ECU_ADDRESS 0x3fc2e6 BYTE_ORDER MSB_LAST FORMAT "%7.4" /end MEASUREMENT
/begin MEASUREMENT lam_bank_1.lamb_sp.lamb_bas_cor_1_h_res "lambda setpoint used for lambda = 1 detection" ULONG _CNV_A_R_LINEAR_____297_CM 1 100. 0. 32. DISPLAY_IDENTIFIER LAMB_BAS_COR_1_H_RES_1 ECU_ADDRESS 0x3fc2cc BYTE_ORDER MSB_LAST FORMAT "%8.5" /end MEASUREMENT
/begin MEASUREMENT lam_bank_1.lamb_sp.lamb_sp_h_res "lambda setpoint with high resolution" ULONG _CNV_A_R_LINEAR_____297_CM 1 100. 0. 32. DISPLAY_IDENTIFIER LAMB_SP_H_RES_1 ECU_ADDRESS 0x3fc2dc BYTE_ORDER MSB_LAST FORMAT "%8.5" /end MEASUREMENT
/begin MEASUREMENT lam_bank_1.lamb_sp.lv_lamb_sp_1 "boolean to inicate if lambda setpoint is identical to 1" UBYTE _CNV_S_2_RANGE______0_CM 1 100. 0. 1. DISPLAY_IDENTIFIER LV_LAMB_SP_1_1 ECU_ADDRESS 0x3fc2e8 /end MEASUREMENT
/begin MEASUREMENT lam_bank_1.lamb_rgn.lamb_rgn "lambda setpoint for catalyst regeneration" UWORD _CNV_A_R_LINEAR_____164_CM 1 100. 0. 31.99902344 DISPLAY_IDENTIFIER LAMB_RGN_1 ECU_ADDRESS 0x3fc2c8 BYTE_ORDER MSB_LAST FORMAT "%7.4" /end MEASUREMENT
/begin MEASUREMENT lam_bank_1.inj_iv_cut.lv_scc "Logical value for single cylinder cut off, cylinder bank 1/2" UBYTE _CNV_S_2_RANGE______0_CM 1 100. 0. 1. DISPLAY_IDENTIFIER LV_SCC_1 ECU_ADDRESS 0x3fc234 /end MEASUREMENT
/begin MEASUREMENT lam_bank_1.cat_prev.lamb_cop "lambda for catalyst overheating prevention" UWORD _CNV_A_R_LINEAR_____164_CM 1 100. 0. 31.99902344 DISPLAY_IDENTIFIER LAMB_COP_1 ECU_ADDRESS 0x3fc228 BYTE_ORDER MSB_LAST FORMAT "%7.4" /end MEASUREMENT
/begin MEASUREMENT lam_bank_1.cat_prev.lv_lamb_cop "boolean for catalyst overheating prevention" UBYTE _CNV_S_2_RANGE______0_CM 1 100. 0. 1. DISPLAY_IDENTIFIER LV_LAMB_COP_1 ECU_ADDRESS 0x3fc22a /end MEASUREMENT
/begin MEASUREMENT lam_bank_1.cat_prev.fac_cop "Inverse lambda depency of exhaust gas temperature model" UWORD _CNV_A_R_LINEAR_____21_CM 1 100. 0. 1.99996948 DISPLAY_IDENTIFIER FAC_COP_1 ECU_ADDRESS 0x3fc22c BYTE_ORDER MSB_LAST FORMAT "%7.5" /end MEASUREMENT
/begin MEASUREMENT lam_bank_1.cat_prev.teg_cop_sp "Temperature threshold for overhea protection" UWORD _CNV_A_R_LINEAR_____262_CM 1 100. -48. 1459.3 DISPLAY_IDENTIFIER TEG_COP_SP_1 ECU_ADDRESS 0x3fc230 BYTE_ORDER MSB_LAST FORMAT "%7.2" /end MEASUREMENT
/begin MEASUREMENT lam_bank_1.cat_prev.t_cop "Time catalyst overheat protection active" UBYTE _CNV_A_R_LINEAR_____268_CM 1 100. 0. 127.5 DISPLAY_IDENTIFIER T_COP_1 ECU_ADDRESS 0x3fc232 FORMAT "%5.1" /end MEASUREMENT
/begin MEASUREMENT lam_bank_1.lam_dlyl.bf.lv_ldc_dly "status limited dynamic" ULONG _CNV_S_2_RANGE______0_CM 1 100. 0. 1. DISPLAY_IDENTIFIER LV_LDC_DLY_1 ECU_ADDRESS 0x3fc444 BYTE_ORDER MSB_LAST BIT_MASK 0x80000000 /end MEASUREMENT
/begin MEASUREMENT lam_bank_1.lam_dlyl.bf.lv_lam_mv_ldc_dly "status limited dynamic LAM_MV_i" ULONG _CNV_S_2_RANGE______0_CM 1 100. 0. 1. DISPLAY_IDENTIFIER LV_LAM_MV_LDC_DLY_1 ECU_ADDRESS 0x3fc444 BYTE_ORDER MSB_LAST BIT_MASK 0x40000000 /end MEASUREMENT
/begin MEASUREMENT lam_bank_1.lam_dlyl.lam_mv_mmv_dly "floating mean value for limited lambda deviation" SWORD _CNV_A_R_LINEAR_____109_CM 1 100. -50. 49.99847412 DISPLAY_IDENTIFIER LAM_MV_MMV_DLY_1 ECU_ADDRESS 0x3fc448 BYTE_ORDER MSB_LAST FORMAT "%7.3" /end MEASUREMENT
/begin MEASUREMENT lam_bank_1.lam_dlyl.maf_int_ldc_dly "integral of mass air flow since limited dynamic conditions are fulfilled" UWORD _CNV_A_R_LINEAR_____271_CM 1 100. 0. 1820.398 DISPLAY_IDENTIFIER MAF_INT_LDC_DLY_1 ECU_ADDRESS 0x3fc44c BYTE_ORDER MSB_LAST FORMAT "%7.2" /end MEASUREMENT
/begin MEASUREMENT lam_bank_1.lam_dlyl.pv_av_grd_sum_dly "sum. value for limited lambda deviation" UWORD _CNV_A_R_LINEAR_____301_CM 1 100. 0. 639990.2340000001 DISPLAY_IDENTIFIER PV_AV_GRD_SUM_DLY_1 ECU_ADDRESS 0x3fc44a BYTE_ORDER MSB_LAST FORMAT "%8.1" /end MEASUREMENT
/begin MEASUREMENT lam_bank_2.ls_ready.bf.lv_up_ls "Logical variable for recognized operability of the lambda probe" ULONG _CNV_S_2_RANGE______0_CM 1 100. 0. 1. DISPLAY_IDENTIFIER LV_UP_LS_2 ECU_ADDRESS 0x3fc76c BYTE_ORDER MSB_LAST BIT_MASK 0x80000000 /end MEASUREMENT
/begin MEASUREMENT lam_bank_2.ls_ready.bf.lv_up_ls_cdn "Logical variable for recognized limited operability of the lambda probe" ULONG _CNV_S_2_RANGE______0_CM 1 100. 0. 1. DISPLAY_IDENTIFIER LV_UP_LS_CDN_2 ECU_ADDRESS 0x3fc76c BYTE_ORDER MSB_LAST BIT_MASK 0x40000000 /end MEASUREMENT
/begin MEASUREMENT lam_bank_2.lam_dly.bf.lv_delta_lamb "Boolean for I-share of downstream fuel trim regulation active" ULONG _CNV_S_2_RANGE______0_CM 1 100. 0. 1. DISPLAY_IDENTIFIER LV_DELTA_LAMB_2 ECU_ADDRESS 0x3fc5f0 BYTE_ORDER MSB_LAST BIT_MASK 0x40000000 /end MEASUREMENT
/begin MEASUREMENT lam_bank_2.lam_dly.bf.lv_lam_dly_per_vld "internal state variable for the monitoring of the controller difference (sign)" ULONG _CNV_S_2_RANGE______0_CM 1 100. 0. 1. DISPLAY_IDENTIFIER LV_LAM_DLY_PER_VLD_2 ECU_ADDRESS 0x3fc5f0 BYTE_ORDER MSB_LAST BIT_MASK 0x20000000 /end MEASUREMENT
/begin MEASUREMENT lam_bank_2.lam_dly.bf.lv_delta_lamb_act "Boolean for downstream fuel trim regulation active" ULONG _CNV_S_2_RANGE______0_CM 1 100. 0. 1. DISPLAY_IDENTIFIER LV_DELTA_LAMB_ACT_2 ECU_ADDRESS 0x3fc5f0 BYTE_ORDER MSB_LAST BIT_MASK 0x80000000 /end MEASUREMENT
/begin MEASUREMENT lam_bank_2.lam_dly.fac_cat_dly "weight factor for P-share regarding catalyst conversion capability" UWORD _CNV_A_R_LINEAR_____37_CM 1 100. 0. 0.99998474 DISPLAY_IDENTIFIER FAC_CAT_DLY_2 ECU_ADDRESS 0x3fc602 BYTE_ORDER MSB_LAST FORMAT "%7.5" /end MEASUREMENT
/begin MEASUREMENT lam_bank_2.lam_dly.maf_int_dly "integral of air mass flow since LAM activation" UWORD _CNV_A_R_LINEAR_____271_CM 1 100. 0. 1820.398 DISPLAY_IDENTIFIER MAF_INT_DLY_2 ECU_ADDRESS 0x3fc604 BYTE_ORDER MSB_LAST FORMAT "%7.2" /end MEASUREMENT
/begin MEASUREMENT lam_bank_2.lam_dly.t_dly_i "LAM -P-jump delay time from I-share" SWORD _CNV_A_R_LINEAR_____272_CM 1 100. -640. 639.9804688 DISPLAY_IDENTIFIER T_DLY_I_2 ECU_ADDRESS 0x3fc5f8 BYTE_ORDER MSB_LAST FORMAT "%7.2" /end MEASUREMENT
/begin MEASUREMENT lam_bank_2.lam_dly.t_dly_i_ad "initial value for the I-share (Adaptation value)" SWORD _CNV_A_R_LINEAR_____272_CM 1 100. -640. 639.9804688 DISPLAY_IDENTIFIER T_DLY_I_AD_2 ECU_ADDRESS 0x3fc5fe BYTE_ORDER MSB_LAST FORMAT "%7.2" /end MEASUREMENT
/begin MEASUREMENT lam_bank_2.lam_dly.t_dly_p "LAM -P-jump delay time from P-share" SWORD _CNV_A_R_LINEAR_____273_CM 1 100. -2560. 2559.921875 DISPLAY_IDENTIFIER T_DLY_P_2 ECU_ADDRESS 0x3fc5f6 BYTE_ORDER MSB_LAST FORMAT "%7.2" /end MEASUREMENT
/begin MEASUREMENT lam_bank_2.lam_dly.t_lam_dly "LAM -P-jump delay time from downstream trim controller" SWORD _CNV_A_R_LINEAR_____274_CM 1 100. -15360. 15359.53125 DISPLAY_IDENTIFIER T_LAM_DLY_2 ECU_ADDRESS 0x3fc600 BYTE_ORDER MSB_LAST FORMAT "%8.1" /end MEASUREMENT
/begin MEASUREMENT lam_bank_2.lam_dly.vls_dif_dly "difference between setpoint and actual downstream LS signal" SWORD _CNV_A_R_LINEAR_____3_CM 1 100. -4.99511719 4.99511719 DISPLAY_IDENTIFIER VLS_DIF_DLY_2 ECU_ADDRESS 0x3fc5f4 BYTE_ORDER MSB_LAST FORMAT "%4.3" /end MEASUREMENT
/begin MEASUREMENT lam_bank_2.lam_dly.t_dly_i_mv "I-share-mean-value" SWORD _CNV_A_R_LINEAR_____272_CM 1 100. -640. 639.9804688 DISPLAY_IDENTIFIER T_DLY_I_MV_2 ECU_ADDRESS 0x3fc5fc BYTE_ORDER MSB_LAST FORMAT "%7.2" /end MEASUREMENT
/begin MEASUREMENT lam_bank_2.lam_up.bf.lv_lam_lim_max "lambda controller value is limited to TI_LAM_MAX" ULONG _CNV_S_2_RANGE______0_CM 1 100. 0. 1. DISPLAY_IDENTIFIER LV_LAM_LIM_MAX_2 ECU_ADDRESS 0x3fc650 BYTE_ORDER MSB_LAST BIT_MASK 0x40000000 /end MEASUREMENT
/begin MEASUREMENT lam_bank_2.lam_up.bf.lv_lam_lim_min "lambda controller value is limited to TI_LAM_MIN" ULONG _CNV_S_2_RANGE______0_CM 1 100. 0. 1. DISPLAY_IDENTIFIER LV_LAM_LIM_MIN_2 ECU_ADDRESS 0x3fc650 BYTE_ORDER MSB_LAST BIT_MASK 0x80000000 /end MEASUREMENT
/begin MEASUREMENT lam_bank_2.lam_up.bf.lv_lscl "Close loop enable" ULONG _CNV_S_2_RANGE______0_CM 1 100. 0. 1. DISPLAY_IDENTIFIER LV_LSCL_2 ECU_ADDRESS 0x3fc650 BYTE_ORDER MSB_LAST BIT_MASK 0x20000000 /end MEASUREMENT
/begin MEASUREMENT lam_bank_2.lam_up.bf.lv_lscl_cat_purge "Conditions for closed loop except cat purge cylinder bank i" ULONG _CNV_S_2_RANGE______0_CM 1 100. 0. 1. DISPLAY_IDENTIFIER LV_LSCL_CAT_PURGE_2 ECU_ADDRESS 0x3fc650 BYTE_ORDER MSB_LAST BIT_MASK 0x400000 /end MEASUREMENT
/begin MEASUREMENT lam_bank_2.lam_up.bf.lv_lam_once_act " closed loop has been enabled" ULONG _CNV_S_2_RANGE______0_CM 1 100. 0. 1. DISPLAY_IDENTIFIER LV_LAM_ONCE_ACT_2 ECU_ADDRESS 0x3fc650 BYTE_ORDER MSB_LAST BIT_MASK 0x200000 /end MEASUREMENT
/begin MEASUREMENT lam_bank_2.lam_up.bf.lv_lam_dyw "Limited dynamic conditions recognised for LAM_i" ULONG _CNV_S_2_RANGE______0_CM 1 100. 0. 1. DISPLAY_IDENTIFIER LV_LAM_DYW_2 ECU_ADDRESS 0x3fc650 BYTE_ORDER MSB_LAST BIT_MASK 0x10000000 /end MEASUREMENT
/begin MEASUREMENT lam_bank_2.lam_up.bf.lv_n_maf_dyw "Limited dynamic conditions recognised for N and MAF" ULONG _CNV_S_2_RANGE______0_CM 1 100. 0. 1. DISPLAY_IDENTIFIER LV_N_MAF_DYW_2 ECU_ADDRESS 0x3fc650 BYTE_ORDER MSB_LAST BIT_MASK 0x80000 /end MEASUREMENT
/begin MEASUREMENT lam_bank_2.lam_up.bf.lv_lam_adj_ad_end "Controller shift by lambda adaptation was carried out" ULONG _CNV_S_2_RANGE______0_CM 1 100. 0. 1. DISPLAY_IDENTIFIER LV_LAM_ADJ_AD_END_2 ECU_ADDRESS 0x3fc650 BYTE_ORDER MSB_LAST BIT_MASK 0x100000 /end MEASUREMENT
/begin MEASUREMENT lam_bank_2.lam_up.bf.lv_lscl_inh_err "Closed is disabled due to some existent error" ULONG _CNV_S_2_RANGE______0_CM 1 100. 0. 1. DISPLAY_IDENTIFIER LV_LSCL_INH_ERR_2 ECU_ADDRESS 0x3fc650 BYTE_ORDER MSB_LAST BIT_MASK 0x1000 /end MEASUREMENT
/begin MEASUREMENT lam_bank_2.lam_up.lam "TI_LAM_i value after a P jump" SWORD _CNV_A_R_LINEAR_____109_CM 1 100. -50. 49.99847412 DISPLAY_IDENTIFIER LAM_2 ECU_ADDRESS 0x3fc672 BYTE_ORDER MSB_LAST FORMAT "%7.3" /end MEASUREMENT
/begin MEASUREMENT lam_bank_2.lam_up.lam_mv "TI_LAM_i average value" SWORD _CNV_A_R_LINEAR_____109_CM 1 100. -50. 49.99847412 DISPLAY_IDENTIFIER LAM_MV_2 ECU_ADDRESS 0x3fc674 BYTE_ORDER MSB_LAST FORMAT "%7.3" /end MEASUREMENT
/begin MEASUREMENT lam_bank_2.lam_up.lam_mv_lpf "LAM_MV_1 average value" SWORD _CNV_A_R_LINEAR_____109_CM 1 100. -50. 49.99847412 DISPLAY_IDENTIFIER LAM_MV_LPF_2 ECU_ADDRESS 0x3fc676 BYTE_ORDER MSB_LAST FORMAT "%7.3" /end MEASUREMENT
/begin MEASUREMENT lam_bank_2.lam_up.lam_p_ctr "P-jump-counter, shows the number of executed jumps" UBYTE _CNV_A_R_LINEAR_____1_CM 1 100. 0. 255. DISPLAY_IDENTIFIER LAM_P_CTR_2 ECU_ADDRESS 0x3fc66c FORMAT "%3.0" /end MEASUREMENT
/begin MEASUREMENT lam_bank_2.lam_up.t_lam_dly_neg "total LAM -P-jump delay time from rich to lean transition  " UWORD _CNV_A_R_LINEAR_____274_CM 1 100. 0. 15359.53125 DISPLAY_IDENTIFIER T_LAM_DLY_NEG_2 ECU_ADDRESS 0x3fc662 BYTE_ORDER MSB_LAST FORMAT "%8.1" /end MEASUREMENT
/begin MEASUREMENT lam_bank_2.lam_up.t_lam_dly_pos "total LAM -P-jump delay time from lean to rich transition  " UWORD _CNV_A_R_LINEAR_____274_CM 1 100. 0. 15359.53125 DISPLAY_IDENTIFIER T_LAM_DLY_POS_2 ECU_ADDRESS 0x3fc660 BYTE_ORDER MSB_LAST FORMAT "%8.1" /end MEASUREMENT
/begin MEASUREMENT lam_bank_2.lam_up.ti_lam_max "maximum of lambda control injection time correction" SWORD _CNV_A_R_LINEAR_____109_CM 1 100. -50. 49.99847412 DISPLAY_IDENTIFIER TI_LAM_MAX_2 ECU_ADDRESS 0x3fc670 BYTE_ORDER MSB_LAST FORMAT "%7.3" /end MEASUREMENT
/begin MEASUREMENT lam_bank_2.lam_up.ti_lam_min "minimum of lambda control injection time correction" SWORD _CNV_A_R_LINEAR_____109_CM 1 100. -50. 49.99847412 DISPLAY_IDENTIFIER TI_LAM_MIN_2 ECU_ADDRESS 0x3fc66e BYTE_ORDER MSB_LAST FORMAT "%7.3" /end MEASUREMENT
/begin MEASUREMENT lam_bank_2.lam_up.ti_lam_cor "Lambda control uncorrect injection time correction" SWORD _CNV_A_R_LINEAR_____109_CM 1 100. -50. 49.99847412 DISPLAY_IDENTIFIER TI_LAM_COR_2 ECU_ADDRESS 0x3fc65e BYTE_ORDER MSB_LAST FORMAT "%7.3" /end MEASUREMENT
/begin MEASUREMENT lam_bank_2.lam_up.t_lam_dly_pos_bas "Positive basic LAM -P-jump delay time" UWORD _CNV_A_R_LINEAR_____261_CM 1 100. 0. 1279.9 DISPLAY_IDENTIFIER T_LAM_DLY_POS_BAS_2 ECU_ADDRESS 0x3fc668 BYTE_ORDER MSB_LAST FORMAT "%7.2" /end MEASUREMENT
/begin MEASUREMENT lam_bank_2.lam_up.t_lam_dly_neg_bas "Negative basic LAM -P-jump delay time" UWORD _CNV_A_R_LINEAR_____261_CM 1 100. 0. 1279.9 DISPLAY_IDENTIFIER T_LAM_DLY_NEG_BAS_2 ECU_ADDRESS 0x3fc66a BYTE_ORDER MSB_LAST FORMAT "%7.2" /end MEASUREMENT
/begin MEASUREMENT lam_bank_2.lam_up.lam_mv_lpf_cp "Mean value of the controller output, used by canister purge" SWORD _CNV_A_R_LINEAR_____109_CM 1 100. -50. 49.99847412 DISPLAY_IDENTIFIER LAM_MV_LPF_CP_2 ECU_ADDRESS 0x3fc678 BYTE_ORDER MSB_LAST FORMAT "%7.3" /end MEASUREMENT
/begin MEASUREMENT lam_bank_2.lam_up.maf_dyw "MAF average value for limited dynamics recognition" UBYTE _CNV_A_R_LINEAR_____27_CM 1 100. 0. 1389. DISPLAY_IDENTIFIER MAF_DYW_2 ECU_ADDRESS 0x3fc67c FORMAT "%4.0" /end MEASUREMENT
/begin MEASUREMENT lam_bank_2.lam_up.n_dyw "N average value for limited dynamics recognition" UWORD _CNV_A_R_LINEAR_____11_CM 1 100. 0. 8160. DISPLAY_IDENTIFIER N_DYW_2 ECU_ADDRESS 0x3fc67e BYTE_ORDER MSB_LAST FORMAT "%4.0" /end MEASUREMENT
/begin MEASUREMENT lam_bank_2.lam_up.lam_mv_dyw "LAM_MV_i average value for limited dynamics recognition" SWORD _CNV_A_R_LINEAR_____109_CM 1 100. -50. 49.99847412 DISPLAY_IDENTIFIER LAM_MV_DYW_2 ECU_ADDRESS 0x3fc67a BYTE_ORDER MSB_LAST FORMAT "%7.3" /end MEASUREMENT
/begin MEASUREMENT lam_bank_2.ls_down_cur.r_down_ls "Internal resistance of downstream oxygen sensor" UWORD _CNV_A_R_LINEAR_____279_CM 1 100. 0. 65535. DISPLAY_IDENTIFIER R_DOWN_LS_2 ECU_ADDRESS 0x3fc6fa BYTE_ORDER MSB_LAST FORMAT "%5.0" /end MEASUREMENT
/begin MEASUREMENT lam_bank_2.ls_up.bf.lv_afl "" ULONG _CNV_S_2_RANGE______0_CM 1 100. 0. 1. DISPLAY_IDENTIFIER LV_AFL_2 ECU_ADDRESS 0x3fc778 BYTE_ORDER MSB_LAST BIT_MASK 0x80000000 /end MEASUREMENT
/begin MEASUREMENT lam_bank_2.ls_up.bf.lv_vls_up_mmv_lmt "Boolean flag indicating VLS_MMV_xxx_i signals being limited when set" ULONG _CNV_S_2_RANGE______0_CM 1 100. 0. 1. DISPLAY_IDENTIFIER LV_VLS_UP_MMV_LMT_2 ECU_ADDRESS 0x3fc778 BYTE_ORDER MSB_LAST BIT_MASK 0x10000000 /end MEASUREMENT
/begin MEASUREMENT lam_bank_2.ls_up.bf.lv_vls_up_mmv_stk_vld "Boolean flag indicating VLS_MMV_xxx_i signals valid when set" ULONG _CNV_S_2_RANGE______0_CM 1 100. 0. 1. DISPLAY_IDENTIFIER LV_VLS_UP_MMV_STK_VLD_2 ECU_ADDRESS 0x3fc778 BYTE_ORDER MSB_LAST BIT_MASK 0x8000000 /end MEASUREMENT
/begin MEASUREMENT lam_bank_2.ls_up.ctr_vls_afl_cyc "Denotes number of AF cycles since lambda controller last activated" UWORD _CNV_A_R_LINEAR_____1_CM 1 100. 0. 65535. DISPLAY_IDENTIFIER CTR_VLS_AFL_CYC_2 ECU_ADDRESS 0x3fc782 BYTE_ORDER MSB_LAST FORMAT "%5.0" /end MEASUREMENT
/begin MEASUREMENT lam_bank_2.ls_up.drv1_vls_up_abs_max "Absolute maximum value within buffer containing 1st derivative of VLS_UP_i signal" UWORD _CNV_A_R_LINEAR_____277_CM 1 100. 0. 4.9999237 DISPLAY_IDENTIFIER DRV1_VLS_UP_ABS_MAX_2 ECU_ADDRESS 0x3fc792 BYTE_ORDER MSB_LAST FORMAT "%6.4" /end MEASUREMENT
/begin MEASUREMENT lam_bank_2.ls_up.drv1_vls_up_mmv "Mean of buffer containing 1st derivative of VLS_UP_i signal" SWORD _CNV_A_R_LINEAR_____276_CM 1 100. -2.5 2.4999 DISPLAY_IDENTIFIER DRV1_VLS_UP_MMV_2 ECU_ADDRESS 0x3fc78e BYTE_ORDER MSB_LAST FORMAT "%7.4" /end MEASUREMENT
/begin MEASUREMENT lam_bank_2.ls_up.drv1_vls_up_mmv_min "Minimum value of mean of buffer containing 1st derivative of VLS_UP_i signal in lean phase" SWORD _CNV_A_R_LINEAR_____276_CM 1 100. -2.5 2.4999 DISPLAY_IDENTIFIER DRV1_VLS_UP_MMV_MIN_2 ECU_ADDRESS 0x3fc790 BYTE_ORDER MSB_LAST FORMAT "%7.4" /end MEASUREMENT
/begin MEASUREMENT lam_bank_2.ls_up.t_afl_lock "Timer indicating duration of LV_AFL lock" UBYTE _CNV_A_R_LINEAR_____4_CM 1 100. 0. 2.55 DISPLAY_IDENTIFIER T_AFL_LOCK_2 ECU_ADDRESS 0x3fc7a5 FORMAT "%4.2" /end MEASUREMENT
/begin MEASUREMENT lam_bank_2.ls_up.t_vls_cyc_afl "Lean mixture cycle time" UBYTE _CNV_A_R_LINEAR_____4_CM 1 100. 0. 2.55 DISPLAY_IDENTIFIER T_VLS_CYC_AFL_2 ECU_ADDRESS 0x3fc77f FORMAT "%4.2" /end MEASUREMENT
/begin MEASUREMENT lam_bank_2.ls_up.t_vls_cyc_afl_hld "Lean mixture cycle time, held until next new value available" UBYTE _CNV_A_R_LINEAR_____4_CM 1 100. 0. 2.55 DISPLAY_IDENTIFIER T_VLS_CYC_AFL_HLD_2 ECU_ADDRESS 0x3fc780 FORMAT "%4.2" /end MEASUREMENT
/begin MEASUREMENT lam_bank_2.ls_up.t_vls_cyc_afr "Rich mixture cycle time" UBYTE _CNV_A_R_LINEAR_____4_CM 1 100. 0. 2.55 DISPLAY_IDENTIFIER T_VLS_CYC_AFR_2 ECU_ADDRESS 0x3fc77e FORMAT "%4.2" /end MEASUREMENT
/begin MEASUREMENT lam_bank_2.ls_up.vls_bol "Corrected VLS_MMV_MIN" UWORD _CNV_A_R_LINEAR_____3_CM 1 100. 0. 4.99511719 DISPLAY_IDENTIFIER VLS_BOL_2 ECU_ADDRESS 0x3fc788 BYTE_ORDER MSB_LAST FORMAT "%5.3" /end MEASUREMENT
/begin MEASUREMENT lam_bank_2.ls_up.vls_mmv_max "Mean maximum sensor voltage" UWORD _CNV_A_R_LINEAR_____250_CM 1 100. 0. 4.99992371 DISPLAY_IDENTIFIER VLS_MMV_MAX_2 ECU_ADDRESS 0x3fc784 BYTE_ORDER MSB_LAST FORMAT "%7.5" /end MEASUREMENT
/begin MEASUREMENT lam_bank_2.ls_up.vls_mmv_min "Mean minimum sensor voltage" UWORD _CNV_A_R_LINEAR_____250_CM 1 100. 0. 4.99992371 DISPLAY_IDENTIFIER VLS_MMV_MIN_2 ECU_ADDRESS 0x3fc786 BYTE_ORDER MSB_LAST FORMAT "%7.5" /end MEASUREMENT
/begin MEASUREMENT lam_bank_2.ls_up.vls_tol "Corrected VLS_MMV_MAX" UWORD _CNV_A_R_LINEAR_____3_CM 1 100. 0. 4.99511719 DISPLAY_IDENTIFIER VLS_TOL_2 ECU_ADDRESS 0x3fc78a BYTE_ORDER MSB_LAST FORMAT "%5.3" /end MEASUREMENT
/begin MEASUREMENT lam_bank_2.ls_up.vls_up_mmv_hys "Variable switching threshold for calculation of VLS_DOWN_MMV_MIN_i" UWORD _CNV_A_R_LINEAR_____275_CM 1 100. 0. 1. DISPLAY_IDENTIFIER VLS_UP_MMV_HYS_2 ECU_ADDRESS 0x3fc78c BYTE_ORDER MSB_LAST FORMAT "%7.5" /end MEASUREMENT
/begin MEASUREMENT lam_bank_2.lsh_down.lshpwm_down "" UBYTE _CNV_A_R_LINEAR_____10_CM 1 100. 0. 99.609375 DISPLAY_IDENTIFIER LSHPWM_DOWN_2 ECU_ADDRESS 0x3fc6a0 FORMAT "%4.1" /end MEASUREMENT
/begin MEASUREMENT lam_bank_2.lsh_down.t_lsh_down "Timer to determine the duration of heating phase" UBYTE _CNV_A_R_LINEAR_____30_CM 1 100. 0. 255. DISPLAY_IDENTIFIER T_LSH_DOWN_2 ECU_ADDRESS 0x3fc6a1 FORMAT "%3.0" /end MEASUREMENT
/begin MEASUREMENT lam_bank_2.lsh_down.v_efc_lsh_down "Effective value of heater voltage" UBYTE _CNV_A_R_LINEAR_____34_CM 1 100. 0. 25.8984 DISPLAY_IDENTIFIER V_EFC_LSH_DOWN_2 ECU_ADDRESS 0x3fc6a2 FORMAT "%3.1" /end MEASUREMENT
/begin MEASUREMENT lam_bank_2.lsh_down.t_lsh_down_tol "Timer to determine the duration of high voltage phases" UBYTE _CNV_A_R_LINEAR_____30_CM 1 100. 0. 255. DISPLAY_IDENTIFIER T_LSH_DOWN_TOL_2 ECU_ADDRESS 0x3fc6a3 FORMAT "%3.0" /end MEASUREMENT
/begin MEASUREMENT lam_bank_2.lsh_down.t_lsh_down_lim "Timer to determine the duration of heating phases after a high voltage phase" UBYTE _CNV_A_R_LINEAR_____30_CM 1 100. 0. 255. DISPLAY_IDENTIFIER T_LSH_DOWN_LIM_2 ECU_ADDRESS 0x3fc6a4 FORMAT "%3.0" /end MEASUREMENT
/begin MEASUREMENT lam_bank_2.lsh_down.state_lsh_down "Heating state recognition" ULONG _CNV_S_6_STATE_LSH__284_CM 1 100. 0. 5. DISPLAY_IDENTIFIER STATE_LSH_DOWN_2 ECU_ADDRESS 0x3fc69c BYTE_ORDER MSB_LAST /end MEASUREMENT
/begin MEASUREMENT lam_bank_2.lsh_up_inci.lv_inh_lsh_up "Boolean flag indicating project specific application conditions for heating not met" UBYTE _CNV_S_2_RANGE______0_CM 1 100. 0. 1. DISPLAY_IDENTIFIER LV_INH_LSH_UP_2 ECU_ADDRESS 0x3fc6cc /end MEASUREMENT
/begin MEASUREMENT lam_bank_2.lsh_up_inci.lv_inh_lsh_up_cll_ctl "Boolean flag indicating project specific application conditions closed loop heater control not met" UBYTE _CNV_S_2_RANGE______0_CM 1 100. 0. 1. DISPLAY_IDENTIFIER LV_INH_LSH_UP_CLL_CTL_2 ECU_ADDRESS 0x3fc6cd /end MEASUREMENT
/begin MEASUREMENT lam_bank_2.lsh_up_inci.lv_ttip_ls_up_mes_vld "Boolean flag indicating validity of oxygen sensor ceramic temperature TTIP_LS_UP_MES_i" UBYTE _CNV_S_2_RANGE______0_CM 1 100. 0. 1. DISPLAY_IDENTIFIER LV_TTIP_LS_UP_MES_VLD_2 ECU_ADDRESS 0x3fc6ce /end MEASUREMENT
/begin MEASUREMENT lam_bank_2.lsh_up_inci.lv_v_temp_ls_up_ref_vld "Boolean flag indicating internal resistance determination circuit references valid" UBYTE _CNV_S_2_RANGE______0_CM 1 100. 0. 1. DISPLAY_IDENTIFIER LV_V_TEMP_LS_UP_REF_VLD_2 ECU_ADDRESS 0x3fc6cf /end MEASUREMENT
/begin MEASUREMENT lam_bank_2.lsh_up_inci.temp_ls_ini "Oxygen sensor temperature at engine start for the oxygen sensor heating management" SWORD _CNV_A_R_LINEAR_____280_CM 1 100. -2048. 2047.938 DISPLAY_IDENTIFIER TEMP_LS_INI_2 ECU_ADDRESS 0x3fc6d0 BYTE_ORDER MSB_LAST FORMAT "%8.2" /end MEASUREMENT
/begin MEASUREMENT lam_bank_2.lsh_up.bf.lv_lsh_up_cll_ctl "Boolean variable indicating closed loop control mode active" ULONG _CNV_S_2_RANGE______0_CM 1 100. 0. 1. DISPLAY_IDENTIFIER LV_LSH_UP_CLL_CTL_2 ECU_ADDRESS 0x3fc6b0 BYTE_ORDER MSB_LAST BIT_MASK 0x80000000 /end MEASUREMENT
/begin MEASUREMENT lam_bank_2.lsh_up.bf.lv_v_efc_lsh_up_lim_bol "Boolean flag indicating effective heater voltage limited due to sum of voltage components falling below zero." ULONG _CNV_S_2_RANGE______0_CM 1 100. 0. 1. DISPLAY_IDENTIFIER LV_V_EFC_LSH_UP_LIM_BOL_2 ECU_ADDRESS 0x3fc6b0 BYTE_ORDER MSB_LAST BIT_MASK 0x40000000 /end MEASUREMENT
/begin MEASUREMENT lam_bank_2.lsh_up.bf.lv_v_efc_lsh_up_lim_tol "Boolean flag indicating effective heater voltage limited due to exceeding threshold for period of time." ULONG _CNV_S_2_RANGE______0_CM 1 100. 0. 1. DISPLAY_IDENTIFIER LV_V_EFC_LSH_UP_LIM_TOL_2 ECU_ADDRESS 0x3fc6b0 BYTE_ORDER MSB_LAST BIT_MASK 0x20000000 /end MEASUREMENT
/begin MEASUREMENT lam_bank_2.lsh_up.bf.lv_v_efc_lsh_up_lim_max "Boolean flag indicating effective heater voltage limited due to exceeding absolute maximum voltage spec." ULONG _CNV_S_2_RANGE______0_CM 1 100. 0. 1. DISPLAY_IDENTIFIER LV_V_EFC_LSH_UP_LIM_MAX_2 ECU_ADDRESS 0x3fc6b0 BYTE_ORDER MSB_LAST BIT_MASK 0x10000000 /end MEASUREMENT
/begin MEASUREMENT lam_bank_2.lsh_up.bf.lv_pow_ctl_act "???" ULONG _CNV_S_2_RANGE______0_CM 1 100. 0. 1. DISPLAY_IDENTIFIER LV_POW_CTL_ACT_2 ECU_ADDRESS 0x3fc6b0 BYTE_ORDER MSB_LAST BIT_MASK 0x8000000 /end MEASUREMENT
/begin MEASUREMENT lam_bank_2.lsh_up.t_lsh_up "Timer to determine the duration of heating phase" UBYTE _CNV_A_R_LINEAR_____24_CM 1 100. 0. 25.5 DISPLAY_IDENTIFIER T_LSH_UP_2 ECU_ADDRESS 0x3fc6b9 FORMAT "%4.1" /end MEASUREMENT
/begin MEASUREMENT lam_bank_2.lsh_up.lshpwm_up "" UBYTE _CNV_A_R_LINEAR_____10_CM 1 100. 0. 99.609375 DISPLAY_IDENTIFIER LSHPWM_UP_2 ECU_ADDRESS 0x3fc6b8 FORMAT "%4.1" /end MEASUREMENT
/begin MEASUREMENT lam_bank_2.lsh_up.v_efc_lsh_up "Effective value of heater voltage" UBYTE _CNV_A_R_LINEAR_____34_CM 1 100. 0. 25.8984 DISPLAY_IDENTIFIER V_EFC_LSH_UP_2 ECU_ADDRESS 0x3fc6ba FORMAT "%3.1" /end MEASUREMENT
/begin MEASUREMENT lam_bank_2.lsh_up.t_lsh_up_tol "Timer to determine the duration of high voltage phases" UBYTE _CNV_A_R_LINEAR_____24_CM 1 100. 0. 25.5 DISPLAY_IDENTIFIER T_LSH_UP_TOL_2 ECU_ADDRESS 0x3fc6be FORMAT "%4.1" /end MEASUREMENT
/begin MEASUREMENT lam_bank_2.lsh_up.t_lsh_up_lim "Timer to determine the duration of heating phases after a high voltage phase" UBYTE _CNV_A_R_LINEAR_____24_CM 1 100. 0. 25.5 DISPLAY_IDENTIFIER T_LSH_UP_LIM_2 ECU_ADDRESS 0x3fc6bf FORMAT "%4.1" /end MEASUREMENT
/begin MEASUREMENT lam_bank_2.lsh_up.state_lsh_up "Heating state recognition" ULONG _CNV_S_7_STATE_LSH__293_CM 1 100. 0. 6. DISPLAY_IDENTIFIER STATE_LSH_UP_2 ECU_ADDRESS 0x3fc6b4 BYTE_ORDER MSB_LAST /end MEASUREMENT
/begin MEASUREMENT lam_bank_2.lsh_up.v_efc_lsh_up_clc "Effective calculated heater voltage value prior to overvoltage protection" UWORD _CNV_A_R_LINEAR_____294_CM 1 100. 0. 25.999603 DISPLAY_IDENTIFIER V_EFC_LSH_UP_CLC_2 ECU_ADDRESS 0x3fc6bc BYTE_ORDER MSB_LAST FORMAT "%7.4" /end MEASUREMENT
/begin MEASUREMENT lam_bank_2.lsh_up.v_efc_lsh_up_ctl_add "Additive effective heater voltage from closed loop controller" SBYTE _CNV_A_R_LINEAR_____295_CM 1 100. -13.05 12.95 DISPLAY_IDENTIFIER V_EFC_LSH_UP_CTL_ADD_2 ECU_ADDRESS 0x3fc6c0 FORMAT "%5.1" /end MEASUREMENT
/begin MEASUREMENT lam_bank_2.lsh_up.v_efc_lsh_up_ctl_p_add "Additive effective heater voltage from closed loop controller, P term" SWORD _CNV_A_R_LINEAR_____296_CM 1 100. -13.05 13.05 DISPLAY_IDENTIFIER V_EFC_LSH_UP_CTL_P_ADD_2 ECU_ADDRESS 0x3fc6c2 BYTE_ORDER MSB_LAST FORMAT "%8.4" /end MEASUREMENT
/begin MEASUREMENT lam_bank_2.lsh_up.v_efc_lsh_up_ctl_i_add "Additive effective heater voltage from closed loop controller, I term" SWORD _CNV_A_R_LINEAR_____296_CM 1 100. -13.05 13.05 DISPLAY_IDENTIFIER V_EFC_LSH_UP_CTL_I_ADD_2 ECU_ADDRESS 0x3fc6c4 BYTE_ORDER MSB_LAST FORMAT "%8.4" /end MEASUREMENT
/begin MEASUREMENT lam_bank_2.lsh_up.ttip_ls_up_dif_set_mes "Difference between actual and set oxygen sensor tip temperature" SWORD _CNV_A_R_LINEAR_____280_CM 1 100. -2048. 2047.938 DISPLAY_IDENTIFIER TTIP_LS_UP_DIF_SET_MES_2 ECU_ADDRESS 0x3fc6c6 BYTE_ORDER MSB_LAST FORMAT "%8.2" /end MEASUREMENT
/begin MEASUREMENT lam_bank_2.lam_bas_sp.lamb_bas_h_res "bank selektive basic lambda setpoint with high resolution" ULONG _CNV_A_R_LINEAR_____297_CM 1 100. 0. 32. DISPLAY_IDENTIFIER LAMB_BAS_H_RES_2 ECU_ADDRESS 0x3fc5e0 BYTE_ORDER MSB_LAST FORMAT "%8.5" /end MEASUREMENT
/begin MEASUREMENT lam_bank_2.lam_bas_sp.lamb_hom_afs_h_res "stoichiometric lambda setpoint with high resolution" ULONG _CNV_A_R_LINEAR_____297_CM 1 100. 0. 32. DISPLAY_IDENTIFIER LAMB_HOM_AFS_H_RES_2 ECU_ADDRESS 0x3fc5e4 BYTE_ORDER MSB_LAST FORMAT "%8.5" /end MEASUREMENT
/begin MEASUREMENT lam_bank_2.lam_bas_sp.lamb_bas "bank selektive basic lambda setpoint" UWORD _CNV_A_R_LINEAR_____164_CM 1 100. 0. 31.99902344 DISPLAY_IDENTIFIER LAMB_BAS_2 ECU_ADDRESS 0x3fc5e8 BYTE_ORDER MSB_LAST FORMAT "%7.4" /end MEASUREMENT
/begin MEASUREMENT lam_bank_2.lam_bas_sp.lamb_hom_afs "stoichiometric lambda setpoint" UWORD _CNV_A_R_LINEAR_____164_CM 1 100. 0. 31.99902344 DISPLAY_IDENTIFIER LAMB_HOM_AFS_2 ECU_ADDRESS 0x3fc5ea BYTE_ORDER MSB_LAST FORMAT "%7.4" /end MEASUREMENT
/begin MEASUREMENT lam_bank_2.lam_bas_sp.lv_lamb_bas_ofs_cat_diag "flag_to indicate lambda offset" UBYTE _CNV_S_2_RANGE______0_CM 1 100. 0. 1. DISPLAY_IDENTIFIER LV_LAMB_BAS_OFS_CAT_DIAG_2 ECU_ADDRESS 0x3fc5ec /end MEASUREMENT
/begin MEASUREMENT lam_bank_2.lamb_sp.lamb_bas_cor "lambda output for TQI_SP_MAF calculation" UWORD _CNV_A_R_LINEAR_____164_CM 1 100. 0. 31.99902344 DISPLAY_IDENTIFIER LAMB_BAS_COR_2 ECU_ADDRESS 0x3fc644 BYTE_ORDER MSB_LAST FORMAT "%7.4" /end MEASUREMENT
/begin MEASUREMENT lam_bank_2.lamb_sp.lamb_sp "lambda setpoint" UWORD _CNV_A_R_LINEAR_____164_CM 1 100. 0. 31.99902344 DISPLAY_IDENTIFIER LAMB_SP_2 ECU_ADDRESS 0x3fc648 BYTE_ORDER MSB_LAST FORMAT "%7.4" /end MEASUREMENT
/begin MEASUREMENT lam_bank_2.lamb_sp.lamb_sp_bas "lambda feedback for basic torque calculation" UWORD _CNV_A_R_LINEAR_____164_CM 1 100. 0. 31.99902344 DISPLAY_IDENTIFIER LAMB_SP_BAS_2 ECU_ADDRESS 0x3fc64a BYTE_ORDER MSB_LAST FORMAT "%7.4" /end MEASUREMENT
/begin MEASUREMENT lam_bank_2.lamb_sp.lamb_bas_cor_1_h_res "lambda setpoint used for lambda = 1 detection" ULONG _CNV_A_R_LINEAR_____297_CM 1 100. 0. 32. DISPLAY_IDENTIFIER LAMB_BAS_COR_1_H_RES_2 ECU_ADDRESS 0x3fc630 BYTE_ORDER MSB_LAST FORMAT "%8.5" /end MEASUREMENT
/begin MEASUREMENT lam_bank_2.lamb_sp.lamb_sp_h_res "lambda setpoint with high resolution" ULONG _CNV_A_R_LINEAR_____297_CM 1 100. 0. 32. DISPLAY_IDENTIFIER LAMB_SP_H_RES_2 ECU_ADDRESS 0x3fc640 BYTE_ORDER MSB_LAST FORMAT "%8.5" /end MEASUREMENT
/begin MEASUREMENT lam_bank_2.lamb_sp.lv_lamb_sp_1 "boolean to inicate if lambda setpoint is identical to 1" UBYTE _CNV_S_2_RANGE______0_CM 1 100. 0. 1. DISPLAY_IDENTIFIER LV_LAMB_SP_1_2 ECU_ADDRESS 0x3fc64c /end MEASUREMENT
/begin MEASUREMENT lam_bank_2.lamb_rgn.lamb_rgn "lambda setpoint for catalyst regeneration" UWORD _CNV_A_R_LINEAR_____164_CM 1 100. 0. 31.99902344 DISPLAY_IDENTIFIER LAMB_RGN_2 ECU_ADDRESS 0x3fc62c BYTE_ORDER MSB_LAST FORMAT "%7.4" /end MEASUREMENT
/begin MEASUREMENT lam_bank_2.inj_iv_cut.lv_scc "Logical value for single cylinder cut off, cylinder bank 1/2" UBYTE _CNV_S_2_RANGE______0_CM 1 100. 0. 1. DISPLAY_IDENTIFIER LV_SCC_2 ECU_ADDRESS 0x3fc598 /end MEASUREMENT
/begin MEASUREMENT lam_bank_2.cat_prev.lamb_cop "lambda for catalyst overheating prevention" UWORD _CNV_A_R_LINEAR_____164_CM 1 100. 0. 31.99902344 DISPLAY_IDENTIFIER LAMB_COP_2 ECU_ADDRESS 0x3fc58c BYTE_ORDER MSB_LAST FORMAT "%7.4" /end MEASUREMENT
/begin MEASUREMENT lam_bank_2.cat_prev.lv_lamb_cop "boolean for catalyst overheating prevention" UBYTE _CNV_S_2_RANGE______0_CM 1 100. 0. 1. DISPLAY_IDENTIFIER LV_LAMB_COP_2 ECU_ADDRESS 0x3fc58e /end MEASUREMENT
/begin MEASUREMENT lam_bank_2.cat_prev.fac_cop "Inverse lambda depency of exhaust gas temperature model" UWORD _CNV_A_R_LINEAR_____21_CM 1 100. 0. 1.99996948 DISPLAY_IDENTIFIER FAC_COP_2 ECU_ADDRESS 0x3fc590 BYTE_ORDER MSB_LAST FORMAT "%7.5" /end MEASUREMENT
/begin MEASUREMENT lam_bank_2.cat_prev.teg_cop_sp "Temperature threshold for overhea protection" UWORD _CNV_A_R_LINEAR_____262_CM 1 100. -48. 1459.3 DISPLAY_IDENTIFIER TEG_COP_SP_2 ECU_ADDRESS 0x3fc594 BYTE_ORDER MSB_LAST FORMAT "%7.2" /end MEASUREMENT
/begin MEASUREMENT lam_bank_2.cat_prev.t_cop "Time catalyst overheat protection active" UBYTE _CNV_A_R_LINEAR_____268_CM 1 100. 0. 127.5 DISPLAY_IDENTIFIER T_COP_2 ECU_ADDRESS 0x3fc596 FORMAT "%5.1" /end MEASUREMENT
/begin MEASUREMENT lam_bank_2.lam_dlyl.bf.lv_ldc_dly "status limited dynamic" ULONG _CNV_S_2_RANGE______0_CM 1 100. 0. 1. DISPLAY_IDENTIFIER LV_LDC_DLY_2 ECU_ADDRESS 0x3fc7a8 BYTE_ORDER MSB_LAST BIT_MASK 0x80000000 /end MEASUREMENT
/begin MEASUREMENT lam_bank_2.lam_dlyl.bf.lv_lam_mv_ldc_dly "status limited dynamic LAM_MV_i" ULONG _CNV_S_2_RANGE______0_CM 1 100. 0. 1. DISPLAY_IDENTIFIER LV_LAM_MV_LDC_DLY_2 ECU_ADDRESS 0x3fc7a8 BYTE_ORDER MSB_LAST BIT_MASK 0x40000000 /end MEASUREMENT
/begin MEASUREMENT lam_bank_2.lam_dlyl.lam_mv_mmv_dly "floating mean value for limited lambda deviation" SWORD _CNV_A_R_LINEAR_____109_CM 1 100. -50. 49.99847412 DISPLAY_IDENTIFIER LAM_MV_MMV_DLY_2 ECU_ADDRESS 0x3fc7ac BYTE_ORDER MSB_LAST FORMAT "%7.3" /end MEASUREMENT
/begin MEASUREMENT lam_bank_2.lam_dlyl.maf_int_ldc_dly "integral of mass air flow since limited dynamic conditions are fulfilled" UWORD _CNV_A_R_LINEAR_____271_CM 1 100. 0. 1820.398 DISPLAY_IDENTIFIER MAF_INT_LDC_DLY_2 ECU_ADDRESS 0x3fc7b0 BYTE_ORDER MSB_LAST FORMAT "%7.2" /end MEASUREMENT
/begin MEASUREMENT lam_bank_2.lam_dlyl.pv_av_grd_sum_dly "sum. value for limited lambda deviation" UWORD _CNV_A_R_LINEAR_____301_CM 1 100. 0. 639990.2340000001 DISPLAY_IDENTIFIER PV_AV_GRD_SUM_DLY_2 ECU_ADDRESS 0x3fc7ae BYTE_ORDER MSB_LAST FORMAT "%8.1" /end MEASUREMENT
/begin MEASUREMENT lamb_fl "Lambda Requirement for Full Load Enrichment" UWORD _CNV_A_R_LINEAR_____164_CM 1 100. 0. 31.99902344 DISPLAY_IDENTIFIER LAMB_FL ECU_ADDRESS 0x3fd054 BYTE_ORDER MSB_LAST FORMAT "%7.4" /end MEASUREMENT
/begin CHARACTERISTIC c_lamb_fl_pas "Passive value for full load enrichment" VALUE 0x01602 _REC_VAL_20_u2 31.99902344 _CNV_A_R_LINEAR_____164_CM 0. 31.99902344 DISPLAY_IDENTIFIER C_LAMB_FL_PAS FORMAT "%7.4" /end CHARACTERISTIC
/begin CHARACTERISTIC ip_lamb_fl__n "Lambda full load enrichment" CURVE 0x0c006 _REC_CUR_20_u2_u1 31.99902344 _CNV_A_R_LINEAR_____164_CM 0. 31.99902344 DISPLAY_IDENTIFIER IP_LAMB_FL__N FORMAT "%7.4"
 /begin AXIS_DESCR COM_AXIS n_32 _CNV_A_R_LINEAR_____16_CM 12 0. 8160. FORMAT "%4.0" AXIS_PTS_REF ldp_n__lamb_fl /end AXIS_DESCR
/end CHARACTERISTIC
/begin AXIS_PTS ldp_n__lamb_fl "" 0x07cc6 n_32 _REC_AXS_20_u1 8160. _CNV_A_R_LINEAR_____16_CM 12 0. 8160. DISPLAY_IDENTIFIER LDP_N__LAMB_FL FORMAT "%4.0" /end AXIS_PTS
/begin CHARACTERISTIC c_lam_n_min "Minimum engine speed to close the A/F-loop" VALUE 0x0071b _REC_VAL_20_u1 8160. _CNV_A_R_LINEAR_____16_CM 0. 8160. DISPLAY_IDENTIFIER C_LAM_N_MIN FORMAT "%4.0" /end CHARACTERISTIC
/begin CHARACTERISTIC c_lam_cycnr "delay after PUC before reenabling Lambda control" VALUE 0x015f0 _REC_VAL_20_u2 6.553500000000001 _CNV_A_R_LINEAR_____305_CM 0. 655.35 DISPLAY_IDENTIFIER C_LAM_CYCNR FORMAT "%6.2" /end CHARACTERISTIC
/begin CHARACTERISTIC id_tco_lam_min_is__tco_st "Minimum coolant temperature to close the A/F-loop in idle" CURVE 0x00a14 _REC_CUR_20_u1_u1 190.5 _CNV_A_R_LINEAR_____12_CM -48. 142.5 DISPLAY_IDENTIFIER ID_TCO_LAM_MIN_IS__TCO_ST FORMAT "%5.1"
 /begin AXIS_DESCR COM_AXIS tco_st _CNV_A_R_LINEAR_____12_CM 6 -48. 142.5 FORMAT "%5.1" AXIS_PTS_REF ldpm_tco_st_tco_lam_min /end AXIS_DESCR
/end CHARACTERISTIC
/begin CHARACTERISTIC id_tco_lam_min__tco_st "Minimum coolant temperature to close the A/F-loop out of idle" CURVE 0x00a0e _REC_CUR_20_u1_u1 190.5 _CNV_A_R_LINEAR_____12_CM -48. 142.5 DISPLAY_IDENTIFIER ID_TCO_LAM_MIN__TCO_ST FORMAT "%5.1"
 /begin AXIS_DESCR COM_AXIS tco_st _CNV_A_R_LINEAR_____12_CM 6 -48. 142.5 FORMAT "%5.1" AXIS_PTS_REF ldpm_tco_st_tco_lam_min /end AXIS_DESCR
/end CHARACTERISTIC
/begin CHARACTERISTIC id_t_min_lscl "Minimum time to close the A/F-loop" CURVE 0x08a08 _REC_CUR_20_u2_u1 6553.5 _CNV_A_R_LINEAR_____24_CM 0. 6553.5 DISPLAY_IDENTIFIER ID_T_MIN_LSCL FORMAT "%6.1"
 /begin AXIS_DESCR COM_AXIS tco_st _CNV_A_R_LINEAR_____12_CM 6 -48. 142.5 FORMAT "%5.1" AXIS_PTS_REF ldpm_tco_st_t_min_lscl /end AXIS_DESCR
/end CHARACTERISTIC
/begin AXIS_PTS ldpm_tco_st_tco_lam_min "" 0x01400 tco_st _REC_AXS_20_u1 190.5 _CNV_A_R_LINEAR_____12_CM 6 -48. 142.5 DISPLAY_IDENTIFIER LDPM_TCO_ST_TCO_LAM_MIN FORMAT "%5.1" /end AXIS_PTS
/begin AXIS_PTS ldpm_tco_st_t_min_lscl "" 0x013f9 tco_st _REC_AXS_20_u1 190.5 _CNV_A_R_LINEAR_____12_CM 6 -48. 142.5 DISPLAY_IDENTIFIER LDPM_TCO_ST_T_MIN_LSCL FORMAT "%5.1" /end AXIS_PTS
/begin MEASUREMENT lv_lam_tco_lscl "Temperature conditions for close loop fulfilled" UBYTE _CNV_S_2_RANGE______5_CM 1 100. 0. 1. DISPLAY_IDENTIFIER LV_LAM_TCO_LSCL ECU_ADDRESS 0x3fe012 BIT_MASK 0x1 /end MEASUREMENT
/begin MEASUREMENT lv_t_min_lscl "Minimum time to close the A/F-loop" UBYTE _CNV_S_2_RANGE______5_CM 1 100. 0. 1. DISPLAY_IDENTIFIER LV_T_MIN_LSCL ECU_ADDRESS 0x3fe013 BIT_MASK 0x1 /end MEASUREMENT
/begin MEASUREMENT lv_lamb_rgn_fac_sens "Flag determining the mode of lambda variation" UBYTE _CNV_S_2_RANGE______5_CM 1 100. 0. 1. DISPLAY_IDENTIFIER LV_LAMB_RGN_FAC_SENS ECU_ADDRESS 0x3fe017 BIT_MASK 0x1 /end MEASUREMENT
/begin CHARACTERISTIC lc_lamb_rgn_fac_sens "Logical constant determining the mode of lambda correction" VALUE 0x00f4e _REC_VAL_20_u1 1. _CNV_S_2_RANGE______0_CM 0. 1. DISPLAY_IDENTIFIER LC_LAMB_RGN_FAC_SENS /end CHARACTERISTIC
/begin CHARACTERISTIC ip_lamb_rgn_afr__maf__n_32 "lambda setpoint for catalyst regeneration" MAP 0x0c272 _REC_MAP_20_u2_u1_u1 31.99902344 _CNV_A_R_LINEAR_____164_CM 0. 31.99902344 DISPLAY_IDENTIFIER IP_LAMB_RGN_AFR__MAF__N_32 FORMAT "%7.4"
 /begin AXIS_DESCR COM_AXIS maf _CNV_A_R_LINEAR_____27_CM 8 0. 1389. FORMAT "%4.0" AXIS_PTS_REF ldp_maf_ip_lamb_rgn_afr /end AXIS_DESCR
 /begin AXIS_DESCR COM_AXIS n_32 _CNV_A_R_LINEAR_____16_CM 8 0. 8160. FORMAT "%4.0" AXIS_PTS_REF ldp_n_32_ip_lamb_rgn_afr /end AXIS_DESCR
/end CHARACTERISTIC
/begin CHARACTERISTIC ip_lamb_rgn_fac_sens "lambda setpoint correction factor depending on sensor signal" CURVE 0x0c302 _REC_CUR_20_u2_u2 0.99 _CNV_A_R_LINEAR_____307_CM 1. 1.99 DISPLAY_IDENTIFIER IP_LAMB_RGN_FAC_SENS FORMAT "%6.4"
 /begin AXIS_DESCR COM_AXIS online_dummy _CNV_A_R_LINEAR_____3_CM 8 0. 4.99511719 FORMAT "%5.3" AXIS_PTS_REF ldp_vls_down_ip_lamb_rgn /end AXIS_DESCR
/end CHARACTERISTIC
/begin CHARACTERISTIC ip_lamb_rgn_fac_mdl "lambda setpoint correction factor depending on remaining modelled loading" CURVE 0x0c2f2 _REC_CUR_20_u2_u2 0.99 _CNV_A_R_LINEAR_____307_CM 1. 1.99 DISPLAY_IDENTIFIER IP_LAMB_RGN_FAC_MDL FORMAT "%6.4"
 /begin AXIS_DESCR COM_AXIS ntl _CNV_A_R_LINEAR_____308_CM 8 0. 10485.6 FORMAT "%7.1" AXIS_PTS_REF ldp_ntl_ip_lamb_rgn_fac_mdl /end AXIS_DESCR
/end CHARACTERISTIC
/begin CHARACTERISTIC c_lamb_rgn_pas "passive value for catalyst regeneration" VALUE 0x01608 _REC_VAL_20_u2 31.99902344 _CNV_A_R_LINEAR_____164_CM 0. 31.99902344 DISPLAY_IDENTIFIER C_LAMB_RGN_PAS FORMAT "%7.4" /end CHARACTERISTIC
/begin CHARACTERISTIC c_lamb_rgn_max "maximum value for regeneration lambda value" VALUE 0x01606 _REC_VAL_20_u2 31.99902344 _CNV_A_R_LINEAR_____164_CM 0. 31.99902344 DISPLAY_IDENTIFIER C_LAMB_RGN_MAX FORMAT "%7.4" /end CHARACTERISTIC
/begin CHARACTERISTIC c_t_rgn_lamb_con "time to stay on base map lambda value" VALUE 0x0189e _REC_VAL_20_u2 655.35 _CNV_A_R_LINEAR_____4_CM 0. 655.35 DISPLAY_IDENTIFIER C_T_RGN_LAMB_CON FORMAT "%6.2" /end CHARACTERISTIC
/begin MEASUREMENT t_rgn "Time counter for active regeneration" UWORD _CNV_A_R_LINEAR_____4_CM 1 100. 0. 655.35 DISPLAY_IDENTIFIER T_RGN ECU_ADDRESS 0x3fd0bc BYTE_ORDER MSB_LAST FORMAT "%5.2" /end MEASUREMENT
/begin AXIS_PTS ldp_ntl_ip_lamb_rgn_fac_mdl "" 0x11034 ntl _REC_AXS_20_u2 10485.6 _CNV_A_R_LINEAR_____308_CM 8 0. 10485.6 DISPLAY_IDENTIFIER LDP_NTL_IP_LAMB_RGN_FAC_MDL FORMAT "%7.1" /end AXIS_PTS
/begin AXIS_PTS ldp_vls_down_ip_lamb_rgn "" 0x11512 online_dummy _REC_AXS_20_u2 4.99511719 _CNV_A_R_LINEAR_____3_CM 8 0. 4.99511719 DISPLAY_IDENTIFIER LDP_VLS_DOWN_IP_LAMB_RGN FORMAT "%5.3" /end AXIS_PTS
/begin AXIS_PTS ldp_n_32_ip_lamb_rgn_afr "" 0x07c88 n_32 _REC_AXS_20_u1 8160. _CNV_A_R_LINEAR_____16_CM 8 0. 8160. DISPLAY_IDENTIFIER LDP_N_32_IP_LAMB_RGN_AFR FORMAT "%4.0" /end AXIS_PTS
/begin AXIS_PTS ldp_maf_ip_lamb_rgn_afr "" 0x07b93 maf _REC_AXS_20_u1 1389. _CNV_A_R_LINEAR_____27_CM 8 0. 1389. DISPLAY_IDENTIFIER LDP_MAF_IP_LAMB_RGN_AFR FORMAT "%4.0" /end AXIS_PTS
/begin CHARACTERISTIC c_lamb_sp_1_hys "Hysteresis for lambda = 1 detection" VALUE 0x0160a _REC_VAL_20_u2 31.99902344 _CNV_A_R_LINEAR_____164_CM 0. 31.99902344 DISPLAY_IDENTIFIER C_LAMB_SP_1_HYS FORMAT "%7.4" /end CHARACTERISTIC
/begin CHARACTERISTIC c_lamb_sp_ofs_as "manual lambda setpoint for application" VALUE 0x01612 _REC_VAL_20_u2 31.999023 _CNV_A_R_LINEAR_____310_CM -16. 15.999023 DISPLAY_IDENTIFIER C_LAMB_SP_OFS_AS FORMAT "%8.4" /end CHARACTERISTIC
/begin CHARACTERISTIC lc_lamb_sp_man_act "Logical variable switch to manual lambda setpoint" VALUE 0x00f4f _REC_VAL_20_u1 1. _CNV_S_2_RANGE______5_CM 0. 1. DISPLAY_IDENTIFIER LC_LAMB_SP_MAN_ACT /end CHARACTERISTIC
/begin MEASUREMENT lamb_bas_cor "Corrected basic lambda mean value" UWORD _CNV_A_R_LINEAR_____164_CM 1 100. 0. 31.99902344 DISPLAY_IDENTIFIER LAMB_BAS_COR ECU_ADDRESS 0x3fd0c8 BYTE_ORDER MSB_LAST FORMAT "%7.4" /end MEASUREMENT
/begin CHARACTERISTIC c_lamb_bas_cor_min "Minimum value for lambda setpoint" VALUE 0x015fe _REC_VAL_20_u2 31.99902344 _CNV_A_R_LINEAR_____164_CM 0. 31.99902344 DISPLAY_IDENTIFIER C_LAMB_BAS_COR_MIN FORMAT "%7.4" /end CHARACTERISTIC
/begin CHARACTERISTIC c_lamb_sp_man "manual lambda setpoint" VALUE 0x01610 _REC_VAL_20_u2 31.99902344 _CNV_A_R_LINEAR_____164_CM 0. 31.99902344 DISPLAY_IDENTIFIER C_LAMB_SP_MAN FORMAT "%7.4" /end CHARACTERISTIC
/begin MEASUREMENT lamb_sp "lambda setpoint" UWORD _CNV_A_R_LINEAR_____164_CM 1 100. 0. 31.99902344 DISPLAY_IDENTIFIER LAMB_SP ECU_ADDRESS 0x3fd0c6 BYTE_ORDER MSB_LAST FORMAT "%7.4" /end MEASUREMENT
/begin MEASUREMENT lamb_sp_bas "-mean value of LAMB_SP_BAS_i" UWORD _CNV_A_R_LINEAR_____164_CM 1 100. 0. 31.99902344 DISPLAY_IDENTIFIER LAMB_SP_BAS ECU_ADDRESS 0x3fd0ca BYTE_ORDER MSB_LAST FORMAT "%7.4" /end MEASUREMENT
/begin CHARACTERISTIC c_maf_mff_ad_max "Maximum MAF for adaptive learning" VALUE 0x016b0 _REC_VAL_20_u2 2047.96875 _CNV_A_R_LINEAR_____113_CM 0. 2047.96875 DISPLAY_IDENTIFIER C_MAF_MFF_AD_MAX FORMAT "%7.2" /end CHARACTERISTIC
/begin CHARACTERISTIC c_tia_mff_ad_max "Maximum air temperature for adaptive learning" VALUE 0x008d2 _REC_VAL_20_u1 190.5 _CNV_A_R_LINEAR_____12_CM -48. 142.5 DISPLAY_IDENTIFIER C_TIA_MFF_AD_MAX FORMAT "%5.1" /end CHARACTERISTIC
/begin MEASUREMENT lv_mff_ad_act_1 "Boolean for MFF Adaptation activation" UBYTE _CNV_S_2_RANGE______0_CM 1 100. 0. 1. DISPLAY_IDENTIFIER LV_MFF_AD_ACT_1 ECU_ADDRESS 0x3fdffa /end MEASUREMENT
/begin MEASUREMENT lv_mff_ad_act_2 "Boolean for MFF Adaptation activation" UBYTE _CNV_S_2_RANGE______0_CM 1 100. 0. 1. DISPLAY_IDENTIFIER LV_MFF_AD_ACT_2 ECU_ADDRESS 0x3fdffc /end MEASUREMENT
/begin CHARACTERISTIC c_tco_mff_ad_min "Minimum coolant temperature for adaptive learning" VALUE 0x0087d _REC_VAL_20_u1 190.5 _CNV_A_R_LINEAR_____12_CM -48. 142.5 DISPLAY_IDENTIFIER C_TCO_MFF_AD_MIN FORMAT "%5.1" /end CHARACTERISTIC
/begin CHARACTERISTIC c_cat_diag_max_dly "threshold of catalyst conversion capability for activation" VALUE 0x00604 _REC_VAL_20_u1 1.984375 _CNV_A_R_LINEAR_____157_CM 0. 1.984375 DISPLAY_IDENTIFIER C_CAT_DIAG_MAX_DLY FORMAT "%3.2" /end CHARACTERISTIC
/begin CHARACTERISTIC c_maf_int_min_dly "MAF integral after setting limited dynamic conditions LV_LDC_DLY_i before starting the monitoring cycle" VALUE 0x01664 _REC_VAL_20_u2 1820.398 _CNV_A_R_LINEAR_____271_CM 0. 1820.398 DISPLAY_IDENTIFIER C_MAF_INT_MIN_DLY FORMAT "%7.2" /end CHARACTERISTIC
/begin CHARACTERISTIC c_lam_temp_min_cat_dly "min. TEMP_ CAT threshold for activation" VALUE 0x0071e _REC_VAL_20_u1 1020. _CNV_A_R_LINEAR_____177_CM -33. 987. DISPLAY_IDENTIFIER C_LAM_TEMP_MIN_CAT_DLY FORMAT "%4.1" /end CHARACTERISTIC
/begin CHARACTERISTIC c_n_lam_dly_p_max "max N threshold for activation P-share" VALUE 0x0076d _REC_VAL_20_u1 8160. _CNV_A_R_LINEAR_____16_CM 0. 8160. DISPLAY_IDENTIFIER C_N_LAM_DLY_P_MAX FORMAT "%4.0" /end CHARACTERISTIC
/begin CHARACTERISTIC c_n_lam_dly_p_min "min N threshold for activation P-share" VALUE 0x0076e _REC_VAL_20_u1 8160. _CNV_A_R_LINEAR_____16_CM 0. 8160. DISPLAY_IDENTIFIER C_N_LAM_DLY_P_MIN FORMAT "%4.0" /end CHARACTERISTIC
/begin CHARACTERISTIC c_maf_lam_dly_p_max "max MAF threshold for activation P-share" VALUE 0x0169e _REC_VAL_20_u2 1389. _CNV_A_R_LINEAR_____106_CM 0. 1389. DISPLAY_IDENTIFIER C_MAF_LAM_DLY_P_MAX FORMAT "%7.2" /end CHARACTERISTIC
/begin CHARACTERISTIC c_maf_lam_dly_p_min "min MAF threshold for activation P-share" VALUE 0x016a0 _REC_VAL_20_u2 1389. _CNV_A_R_LINEAR_____106_CM 0. 1389. DISPLAY_IDENTIFIER C_MAF_LAM_DLY_P_MIN FORMAT "%7.2" /end CHARACTERISTIC
/begin CHARACTERISTIC ip_fac_dly_p__maf_kgh "weight factor for P-share regarding engine load and speed conditions" CURVE 0x0abde _REC_CUR_20_u2_u2 4. _CNV_A_R_LINEAR_____125_CM 0. 4. DISPLAY_IDENTIFIER IP_FAC_DLY_P__MAF_KGH FORMAT "%6.4"
 /begin AXIS_DESCR COM_AXIS maf_kgh _CNV_A_R_LINEAR_____113_CM 6 0. 2047.96875 FORMAT "%6.2" AXIS_PTS_REF ldp_maf_kgh_ip_fac_dly_p /end AXIS_DESCR
/end CHARACTERISTIC
/begin CHARACTERISTIC ip_maf_lam_dly_i_min__n "min MAF threshold for calculation I-share-mean-value" CURVE 0x0c69e _REC_CUR_20_u2_u1 1389. _CNV_A_R_LINEAR_____106_CM 0. 1389. DISPLAY_IDENTIFIER IP_MAF_LAM_DLY_I_MIN__N FORMAT "%7.2"
 /begin AXIS_DESCR COM_AXIS n_32 _CNV_A_R_LINEAR_____16_CM 6 0. 8160. FORMAT "%4.0" AXIS_PTS_REF ldpm_n_32 /end AXIS_DESCR
/end CHARACTERISTIC
/begin CHARACTERISTIC ip_fac_lam_dly__n__maf "normalization factor for total LAM -P-jump delay time regarding engine load and speed conditions" MAP 0x0abea _REC_MAP_20_u2_u1_u1 3.999939 _CNV_A_R_LINEAR_____309_CM 0. 3.999939 DISPLAY_IDENTIFIER IP_FAC_LAM_DLY__N__MAF FORMAT "%7.5"
 /begin AXIS_DESCR COM_AXIS n_32 _CNV_A_R_LINEAR_____16_CM 8 0. 8160. FORMAT "%4.0" AXIS_PTS_REF ldp_n_ip_fac_lam_dly /end AXIS_DESCR
 /begin AXIS_DESCR COM_AXIS maf _CNV_A_R_LINEAR_____27_CM 8 0. 1389. FORMAT "%4.0" AXIS_PTS_REF ldp_maf_ip_fac_lam_dly /end AXIS_DESCR
/end CHARACTERISTIC
/begin CHARACTERISTIC ip_crlc_dly_i__maf_kgh "correlation constant for I-share calculation" CURVE 0x08cd8 _REC_CUR_20_u2_u2 0.99998474 _CNV_A_R_LINEAR_____37_CM 0. 0.99998474 DISPLAY_IDENTIFIER IP_CRLC_DLY_I__MAF_KGH FORMAT "%7.5"
 /begin AXIS_DESCR COM_AXIS maf_kgh _CNV_A_R_LINEAR_____113_CM 6 0. 2047.96875 FORMAT "%6.2" AXIS_PTS_REF ldp_maf_kgh_ip_crlc_dly_i /end AXIS_DESCR
/end CHARACTERISTIC
/begin CHARACTERISTIC ip_maf_lam_dly_i_max__n "max MAF threshold for calculation I-share-mean-value" CURVE 0x0c692 _REC_CUR_20_u2_u1 1389. _CNV_A_R_LINEAR_____106_CM 0. 1389. DISPLAY_IDENTIFIER IP_MAF_LAM_DLY_I_MAX__N FORMAT "%7.2"
 /begin AXIS_DESCR COM_AXIS n_32 _CNV_A_R_LINEAR_____16_CM 6 0. 8160. FORMAT "%4.0" AXIS_PTS_REF ldpm_n_32 /end AXIS_DESCR
/end CHARACTERISTIC
/begin CHARACTERISTIC ip_vls_sp_dly__n__maf "setpoint for downstream fuel trim controller" MAP 0x10656 _REC_MAP_20_u2_u1_u1 4.99511719 _CNV_A_R_LINEAR_____3_CM 0. 4.99511719 DISPLAY_IDENTIFIER IP_VLS_SP_DLY__N__MAF FORMAT "%5.3"
 /begin AXIS_DESCR COM_AXIS n_32 _CNV_A_R_LINEAR_____16_CM 8 0. 8160. FORMAT "%4.0" AXIS_PTS_REF ldp_n_ip_vls_sp_dly /end AXIS_DESCR
 /begin AXIS_DESCR COM_AXIS maf _CNV_A_R_LINEAR_____27_CM 8 0. 1389. FORMAT "%4.0" AXIS_PTS_REF ldp_maf_ip_vls_sp_dly /end AXIS_DESCR
/end CHARACTERISTIC
/begin CHARACTERISTIC ip_t_dly_i_1__vls_dif_dly "LAM - P - jump delay time from I-share" CURVE 0x0df9e _REC_CUR_20_u2_u2 1279.980469 _CNV_A_R_LINEAR_____311_CM -640. 639.980469 DISPLAY_IDENTIFIER IP_T_DLY_I_1__VLS_DIF_DLY FORMAT "%5.2"
 /begin AXIS_DESCR COM_AXIS online_dummy _CNV_A_R_LINEAR_____312_CM 12 -4.99517 4.99517 FORMAT "%5.3" AXIS_PTS_REF ldpm_vls_dif_dly /end AXIS_DESCR
/end CHARACTERISTIC
/begin CHARACTERISTIC ip_t_dly_i_2__vls_dif_dly "LAM - P - jump delay time from I-share" CURVE 0x0dfb6 _REC_CUR_20_u2_u2 1279.980469 _CNV_A_R_LINEAR_____311_CM -640. 639.980469 DISPLAY_IDENTIFIER IP_T_DLY_I_2__VLS_DIF_DLY FORMAT "%5.2"
 /begin AXIS_DESCR COM_AXIS online_dummy _CNV_A_R_LINEAR_____312_CM 12 -4.99517 4.99517 FORMAT "%5.3" AXIS_PTS_REF ldpm_vls_dif_dly /end AXIS_DESCR
/end CHARACTERISTIC
/begin CHARACTERISTIC c_crlc_dly_ad "correlation constant for AD-share calculation" VALUE 0x014ce _REC_VAL_20_u2 0.99998474 _CNV_A_R_LINEAR_____37_CM 0. 0.99998474 DISPLAY_IDENTIFIER C_CRLC_DLY_AD FORMAT "%7.5" /end CHARACTERISTIC
/begin CHARACTERISTIC c_crlc_dly_i_mv "correlation constant for I-share mean value calculation" VALUE 0x014d0 _REC_VAL_20_u2 0.99998474 _CNV_A_R_LINEAR_____37_CM 0. 0.99998474 DISPLAY_IDENTIFIER C_CRLC_DLY_I_MV FORMAT "%7.5" /end CHARACTERISTIC
/begin CHARACTERISTIC ip_fac_cat_dly_1__cat_diag "weight factor for P-share regarding catalyst conversion capability" CURVE 0x0aa36 _REC_CUR_20_u2_u1 0.99998474 _CNV_A_R_LINEAR_____37_CM 0. 0.99998474 DISPLAY_IDENTIFIER IP_FAC_CAT_DLY_1__CAT_DIAG FORMAT "%7.5"
 /begin AXIS_DESCR COM_AXIS online_dummy _CNV_A_R_LINEAR_____313_CM 6 0. 1.9968 FORMAT "%4.2" AXIS_PTS_REF ldpm_cat_ip_fac_cat_dly /end AXIS_DESCR
/end CHARACTERISTIC
/begin CHARACTERISTIC ip_fac_cat_dly_2__cat_diag "weight factor for P-share regarding catalyst conversion capability" CURVE 0x0aa42 _REC_CUR_20_u2_u1 0.99998474 _CNV_A_R_LINEAR_____37_CM 0. 0.99998474 DISPLAY_IDENTIFIER IP_FAC_CAT_DLY_2__CAT_DIAG FORMAT "%7.5"
 /begin AXIS_DESCR COM_AXIS online_dummy _CNV_A_R_LINEAR_____313_CM 6 0. 1.9968 FORMAT "%4.2" AXIS_PTS_REF ldpm_cat_ip_fac_cat_dly /end AXIS_DESCR
/end CHARACTERISTIC
/begin CHARACTERISTIC c_t_dly_i_mv_upd_cyc "update recurrence for I-share mean value" VALUE 0x007f5 _REC_VAL_20_u1 254. _CNV_A_R_LINEAR_____30_CM 1. 255. DISPLAY_IDENTIFIER C_T_DLY_I_MV_UPD_CYC FORMAT "%3.0" /end CHARACTERISTIC
/begin CHARACTERISTIC ip_t_dly_p_1__vls_dif_dly "LAM - P - jump delay time from P-share" CURVE 0x0dfce _REC_CUR_20_u2_u2 1279.980469 _CNV_A_R_LINEAR_____311_CM -640. 639.980469 DISPLAY_IDENTIFIER IP_T_DLY_P_1__VLS_DIF_DLY FORMAT "%5.2"
 /begin AXIS_DESCR COM_AXIS online_dummy _CNV_A_R_LINEAR_____312_CM 12 -4.99517 4.99517 FORMAT "%5.3" AXIS_PTS_REF ldpm_vls_dif_dly /end AXIS_DESCR
/end CHARACTERISTIC
/begin CHARACTERISTIC ip_t_dly_p_2__vls_dif_dly "LAM - P - jump delay time from P-share" CURVE 0x0dfe6 _REC_CUR_20_u2_u2 1279.980469 _CNV_A_R_LINEAR_____311_CM -640. 639.980469 DISPLAY_IDENTIFIER IP_T_DLY_P_2__VLS_DIF_DLY FORMAT "%5.2"
 /begin AXIS_DESCR COM_AXIS online_dummy _CNV_A_R_LINEAR_____312_CM 12 -4.99517 4.99517 FORMAT "%5.3" AXIS_PTS_REF ldpm_vls_dif_dly /end AXIS_DESCR
/end CHARACTERISTIC
/begin AXIS_PTS ldpm_n_32 "" 0x0130f n_32 _REC_AXS_20_u1 8160. _CNV_A_R_LINEAR_____16_CM 6 0. 8160. DISPLAY_IDENTIFIER LDPM_N_32 FORMAT "%4.0" /end AXIS_PTS
/begin AXIS_PTS ldp_n_ip_vls_sp_dly "" 0x07d08 n_32 _REC_AXS_20_u1 8160. _CNV_A_R_LINEAR_____16_CM 8 0. 8160. DISPLAY_IDENTIFIER LDP_N_IP_VLS_SP_DLY FORMAT "%4.0" /end AXIS_PTS
/begin AXIS_PTS ldp_maf_ip_vls_sp_dly "" 0x07b9c maf _REC_AXS_20_u1 1389. _CNV_A_R_LINEAR_____27_CM 8 0. 1389. DISPLAY_IDENTIFIER LDP_MAF_IP_VLS_SP_DLY FORMAT "%4.0" /end AXIS_PTS
/begin AXIS_PTS ldp_n_ip_fac_lam_dly "" 0x07cff n_32 _REC_AXS_20_u1 8160. _CNV_A_R_LINEAR_____16_CM 8 0. 8160. DISPLAY_IDENTIFIER LDP_N_IP_FAC_LAM_DLY FORMAT "%4.0" /end AXIS_PTS
/begin AXIS_PTS ldp_maf_ip_fac_lam_dly "" 0x07b8a maf _REC_AXS_20_u1 1389. _CNV_A_R_LINEAR_____27_CM 8 0. 1389. DISPLAY_IDENTIFIER LDP_MAF_IP_FAC_LAM_DLY FORMAT "%4.0" /end AXIS_PTS
/begin AXIS_PTS ldp_maf_kgh_ip_fac_dly_p "" 0x10d3c maf_kgh _REC_AXS_20_u2 2047.96875 _CNV_A_R_LINEAR_____113_CM 6 0. 2047.96875 DISPLAY_IDENTIFIER LDP_MAF_KGH_IP_FAC_DLY_P FORMAT "%6.2" /end AXIS_PTS
/begin AXIS_PTS ldpm_vls_dif_dly "" 0x11c9e online_dummy _REC_AXS_20_u2 9.99034 _CNV_A_R_LINEAR_____312_CM 12 -4.99517 4.99517 DISPLAY_IDENTIFIER LDPM_VLS_DIF_DLY FORMAT "%5.3" /end AXIS_PTS
/begin AXIS_PTS ldpm_cat_ip_fac_cat_dly "" 0x012cf online_dummy _REC_AXS_20_u1 1.9968 _CNV_A_R_LINEAR_____313_CM 6 0. 1.9968 DISPLAY_IDENTIFIER LDPM_CAT_IP_FAC_CAT_DLY FORMAT "%4.2" /end AXIS_PTS
/begin AXIS_PTS ldp_maf_kgh_ip_crlc_dly_i "" 0x10d2e maf_kgh _REC_AXS_20_u2 2047.96875 _CNV_A_R_LINEAR_____113_CM 6 0. 2047.96875 DISPLAY_IDENTIFIER LDP_MAF_KGH_IP_CRLC_DLY_I FORMAT "%6.2" /end AXIS_PTS
/begin CHARACTERISTIC c_t_dly_i_min "min limit of I-share" VALUE 0x0045e _REC_VAL_20_s2 1279.9804688 _CNV_A_R_LINEAR_____272_CM -640. 639.9804688 DISPLAY_IDENTIFIER C_T_DLY_I_MIN FORMAT "%7.2" /end CHARACTERISTIC
/begin CHARACTERISTIC c_t_dly_ad_min "min limit of adaptation value" VALUE 0x0045a _REC_VAL_20_s2 1279.9804688 _CNV_A_R_LINEAR_____272_CM -640. 639.9804688 DISPLAY_IDENTIFIER C_T_DLY_AD_MIN FORMAT "%7.2" /end CHARACTERISTIC
/begin CHARACTERISTIC c_t_dly_i_max "max limit of I-share" VALUE 0x0045c _REC_VAL_20_s2 1279.9804688 _CNV_A_R_LINEAR_____272_CM -640. 639.9804688 DISPLAY_IDENTIFIER C_T_DLY_I_MAX FORMAT "%7.2" /end CHARACTERISTIC
/begin CHARACTERISTIC c_t_dly_ad_max "max limit of adaptation value" VALUE 0x00458 _REC_VAL_20_s2 1279.9804688 _CNV_A_R_LINEAR_____272_CM -640. 639.9804688 DISPLAY_IDENTIFIER C_T_DLY_AD_MAX FORMAT "%7.2" /end CHARACTERISTIC
/begin CHARACTERISTIC c_maf_int_min_dly_puc "threshold for MAF integral while restart of LAM after PUC " VALUE 0x01666 _REC_VAL_20_u2 1820.398 _CNV_A_R_LINEAR_____271_CM 0. 1820.398 DISPLAY_IDENTIFIER C_MAF_INT_MIN_DLY_PUC FORMAT "%7.2" /end CHARACTERISTIC
/begin MEASUREMENT maf_mmv_dly "floating mean value for limited MAF" UWORD _CNV_A_R_LINEAR_____106_CM 1 100. 0. 1389. DISPLAY_IDENTIFIER MAF_MMV_DLY ECU_ADDRESS 0x3fd0a8 BYTE_ORDER MSB_LAST FORMAT "%7.2" /end MEASUREMENT
/begin CHARACTERISTIC c_maf_crlc_dly "floating mean value calculation MAF" VALUE 0x0163e _REC_VAL_20_u2 0.99998474 _CNV_A_R_LINEAR_____37_CM 0. 0.99998474 DISPLAY_IDENTIFIER C_MAF_CRLC_DLY FORMAT "%7.5" /end CHARACTERISTIC
/begin CHARACTERISTIC c_lam_mv_crlc_dly "floating mean value calculation lambda " VALUE 0x015f4 _REC_VAL_20_u2 0.99998474 _CNV_A_R_LINEAR_____37_CM 0. 0.99998474 DISPLAY_IDENTIFIER C_LAM_MV_CRLC_DLY FORMAT "%7.5" /end CHARACTERISTIC
/begin CHARACTERISTIC c_n_dyw_dly "threshold limited dynamic engine speed" VALUE 0x016ea _REC_VAL_20_u2 8159. _CNV_A_R_LINEAR_____11_CM 1. 8160. DISPLAY_IDENTIFIER C_N_DYW_DLY FORMAT "%4.0" /end CHARACTERISTIC
/begin CHARACTERISTIC c_maf_dyw_dly "threshold limited dynamic engine MAF " VALUE 0x01652 _REC_VAL_20_u2 1389. _CNV_A_R_LINEAR_____106_CM 0. 1389. DISPLAY_IDENTIFIER C_MAF_DYW_DLY FORMAT "%7.2" /end CHARACTERISTIC
/begin CHARACTERISTIC c_lam_mv_dyw_dly "threshold limited dynamic lambda " VALUE 0x015fa _REC_VAL_20_u2 99.99847412 _CNV_A_R_LINEAR_____9_CM 0. 99.99847412 DISPLAY_IDENTIFIER C_LAM_MV_DYW_DLY /end CHARACTERISTIC
/begin MEASUREMENT n_mmv_dly "floating mean value for limited engine speed" UWORD _CNV_A_R_LINEAR_____11_CM 1 100. 0. 8160. DISPLAY_IDENTIFIER N_MMV_DLY ECU_ADDRESS 0x3fd0a6 BYTE_ORDER MSB_LAST FORMAT "%4.0" /end MEASUREMENT
/begin MEASUREMENT lv_n_ldc_dly "status limited dynamic N" UBYTE _CNV_S_2_RANGE______0_CM 1 100. 0. 1. DISPLAY_IDENTIFIER LV_N_LDC_DLY ECU_ADDRESS 0x3fe000 /end MEASUREMENT
/begin MEASUREMENT lv_maf_ldc_dly "status limited dynamic MAF" UBYTE _CNV_S_2_RANGE______0_CM 1 100. 0. 1. DISPLAY_IDENTIFIER LV_MAF_LDC_DLY ECU_ADDRESS 0x3fe001 /end MEASUREMENT
/begin CHARACTERISTIC c_n_crlc_dly "floating mean value calculation engine speed" VALUE 0x016d6 _REC_VAL_20_u2 0.99998474 _CNV_A_R_LINEAR_____37_CM 0. 0.99998474 DISPLAY_IDENTIFIER C_N_CRLC_DLY FORMAT "%7.5" /end CHARACTERISTIC
/begin CHARACTERISTIC c_pv_av_grd_dec_dly "decrement for calculation PV_AV gradient" VALUE 0x007a5 _REC_VAL_20_u1 2490.234 _CNV_A_R_LINEAR_____314_CM 0. 2490.234 DISPLAY_IDENTIFIER C_PV_AV_GRD_DEC_DLY FORMAT "%6.1" /end CHARACTERISTIC
/begin CHARACTERISTIC c_pv_av_grd_sum_max_dly "max. threshold limited dynamic PV_AV gradient" VALUE 0x01758 _REC_VAL_20_u2 639990.2340000001 _CNV_A_R_LINEAR_____301_CM 0. 639990.2340000001 DISPLAY_IDENTIFIER C_PV_AV_GRD_SUM_MAX_DLY FORMAT "%8.1" /end CHARACTERISTIC
/begin CHARACTERISTIC c_pv_av_grd_sum_min_dly "min. threshold limited dynamic PV_AV gradient" VALUE 0x0175c _REC_VAL_20_u2 639990.2340000001 _CNV_A_R_LINEAR_____301_CM 0. 639990.2340000001 DISPLAY_IDENTIFIER C_PV_AV_GRD_SUM_MIN_DLY FORMAT "%8.1" /end CHARACTERISTIC
/begin CHARACTERISTIC c_t_pv_av_grd_dec_sum_dly "time periods for calculation limited dynamic PV_AV gradient" VALUE 0x00839 _REC_VAL_20_u1 5.1 _CNV_A_R_LINEAR_____197_CM 0. 5.1 DISPLAY_IDENTIFIER C_T_PV_AV_GRD_DEC_SUM_DLY FORMAT "%4.2" /end CHARACTERISTIC
/begin CHARACTERISTIC c_pv_av_grd_min_sum_dly "minimum value of PV_AV gradient to increment PV_AV_GRD_SUM_DLY" VALUE 0x007a7 _REC_VAL_20_u1 1240.2 _CNV_A_R_LINEAR_____315_CM 0. 1240.2 DISPLAY_IDENTIFIER C_PV_AV_GRD_MIN_SUM_DLY FORMAT "%6.1" /end CHARACTERISTIC
/begin CHARACTERISTIC c_maf_int_min_ldc_dly "threshold for MAF integral while restart of LAM after inactive " VALUE 0x01668 _REC_VAL_20_u2 1820.398 _CNV_A_R_LINEAR_____271_CM 0. 1820.398 DISPLAY_IDENTIFIER C_MAF_INT_MIN_LDC_DLY FORMAT "%7.2" /end CHARACTERISTIC
/begin CHARACTERISTIC ip_t_lsh_temp_thd "Duration until critical water splash sensor temperature reached" CURVE 0x00e07 _REC_CUR_20_u1_u2 25.5 _CNV_A_R_LINEAR_____24_CM 0. 25.5 DISPLAY_IDENTIFIER IP_T_LSH_TEMP_THD FORMAT "%4.1"
 /begin AXIS_DESCR COM_AXIS online_dummy _CNV_A_R_LINEAR_____321_CM 6 -2048. 2047.938 FORMAT "%8.2" AXIS_PTS_REF ldpm_temp_ls_ini_1_egcp /end AXIS_DESCR
/end CHARACTERISTIC
/begin CHARACTERISTIC ip_fac_neg_p_lsh_up_ctl "Closed loop controller P-term factor for temperature too high; decrease heater voltage" MAP 0x0509a _REC_MAP_20_u1_u1_u2 0.255 _CNV_A_R_LINEAR_____322_CM 0. 0.255 DISPLAY_IDENTIFIER IP_FAC_NEG_P_LSH_UP_CTL FORMAT "%5.3"
 /begin AXIS_DESCR COM_AXIS n_32 _CNV_A_R_LINEAR_____16_CM 6 0. 8160. FORMAT "%4.0" AXIS_PTS_REF ldpm_n_32_1_egcp /end AXIS_DESCR
 /begin AXIS_DESCR COM_AXIS teg_cat_up_mdl_max _CNV_A_R_LINEAR_____7_CM 6 0. 2047. FORMAT "%7.2" AXIS_PTS_REF ldpm_teg_cat_up_mdl_1_egcp /end AXIS_DESCR
/end CHARACTERISTIC
/begin CHARACTERISTIC ip_fac_pos_p_lsh_up_ctl "Closed loop controller P-term factor for temperature too low; increase heater voltage" MAP 0x05106 _REC_MAP_20_u1_u1_u2 0.255 _CNV_A_R_LINEAR_____322_CM 0. 0.255 DISPLAY_IDENTIFIER IP_FAC_POS_P_LSH_UP_CTL FORMAT "%5.3"
 /begin AXIS_DESCR COM_AXIS n_32 _CNV_A_R_LINEAR_____16_CM 6 0. 8160. FORMAT "%4.0" AXIS_PTS_REF ldpm_n_32_1_egcp /end AXIS_DESCR
 /begin AXIS_DESCR COM_AXIS teg_cat_up_mdl_max _CNV_A_R_LINEAR_____7_CM 6 0. 2047. FORMAT "%7.2" AXIS_PTS_REF ldpm_teg_cat_up_mdl_1_egcp /end AXIS_DESCR
/end CHARACTERISTIC
/begin CHARACTERISTIC ip_fac_neg_i_lsh_up_ctl "Closed loop controller I-term factor for temperature too high; decrease heater voltage" MAP 0x05076 _REC_MAP_20_u1_u1_u2 0.255 _CNV_A_R_LINEAR_____322_CM 0. 0.255 DISPLAY_IDENTIFIER IP_FAC_NEG_I_LSH_UP_CTL FORMAT "%5.3"
 /begin AXIS_DESCR COM_AXIS n_32 _CNV_A_R_LINEAR_____16_CM 6 0. 8160. FORMAT "%4.0" AXIS_PTS_REF ldpm_n_32_1_egcp /end AXIS_DESCR
 /begin AXIS_DESCR COM_AXIS teg_cat_up_mdl_max _CNV_A_R_LINEAR_____7_CM 6 0. 2047. FORMAT "%7.2" AXIS_PTS_REF ldpm_teg_cat_up_mdl_1_egcp /end AXIS_DESCR
/end CHARACTERISTIC
/begin CHARACTERISTIC ip_fac_pos_i_lsh_up_ctl "Closed loop controller I-term factor for temperature too low; increase heater voltage" MAP 0x050e2 _REC_MAP_20_u1_u1_u2 0.255 _CNV_A_R_LINEAR_____322_CM 0. 0.255 DISPLAY_IDENTIFIER IP_FAC_POS_I_LSH_UP_CTL FORMAT "%5.3"
 /begin AXIS_DESCR COM_AXIS n_32 _CNV_A_R_LINEAR_____16_CM 6 0. 8160. FORMAT "%4.0" AXIS_PTS_REF ldpm_n_32_1_egcp /end AXIS_DESCR
 /begin AXIS_DESCR COM_AXIS teg_cat_up_mdl_max _CNV_A_R_LINEAR_____7_CM 6 0. 2047. FORMAT "%7.2" AXIS_PTS_REF ldpm_teg_cat_up_mdl_1_egcp /end AXIS_DESCR
/end CHARACTERISTIC
/begin CHARACTERISTIC ip_fac_v_efc_teg "Coorection factor for the assumtion of the heat transfer exclusive for bank 2" CURVE 0x00c08 _REC_CUR_20_u1_u1 3.984375 _CNV_A_R_LINEAR_____127_CM 0. 3.984375 DISPLAY_IDENTIFIER IP_FAC_V_EFC_TEG FORMAT "%4.2"
 /begin AXIS_DESCR COM_AXIS vs _CNV_A_R_LINEAR_____23_CM 6 0. 255. FORMAT "%3.0" AXIS_PTS_REF ldp_vs_fac_v_efc_teg /end AXIS_DESCR
/end CHARACTERISTIC
/begin CHARACTERISTIC c_v_efc_lsh_up_tol "voltage threshold to the higher voltage range of the heater" VALUE 0x00909 _REC_VAL_20_u1 25.8984 _CNV_A_R_LINEAR_____34_CM 0. 25.8984 DISPLAY_IDENTIFIER C_V_EFC_LSH_UP_TOL FORMAT "%3.1" /end CHARACTERISTIC
/begin CHARACTERISTIC c_v_efc_red "Reduced heater voltage during danger of water splash damage" VALUE 0x0090a _REC_VAL_20_u1 25.8984 _CNV_A_R_LINEAR_____34_CM 0. 25.8984 DISPLAY_IDENTIFIER C_V_EFC_RED FORMAT "%3.1" /end CHARACTERISTIC
/begin CHARACTERISTIC c_v_efc_lsh_up_prot "heater voltage in the case of overvoltage conditions" VALUE 0x00908 _REC_VAL_20_u1 25.8984 _CNV_A_R_LINEAR_____34_CM 0. 25.8984 DISPLAY_IDENTIFIER C_V_EFC_LSH_UP_PROT FORMAT "%3.1" /end CHARACTERISTIC
/begin CHARACTERISTIC c_t_lsh_up_tol "maximum of the tolerable heating time with in a higher voltage range " VALUE 0x00818 _REC_VAL_20_u1 25.5 _CNV_A_R_LINEAR_____24_CM 0. 25.5 DISPLAY_IDENTIFIER C_T_LSH_UP_TOL FORMAT "%4.1" /end CHARACTERISTIC
/begin CHARACTERISTIC c_v_efc_lsh_up_lim "limited voltage range of the heater" VALUE 0x00905 _REC_VAL_20_u1 25.8984 _CNV_A_R_LINEAR_____34_CM 0. 25.8984 DISPLAY_IDENTIFIER C_V_EFC_LSH_UP_LIM FORMAT "%3.1" /end CHARACTERISTIC
/begin CHARACTERISTIC c_vb_prot_max "maximum battery voltage threshold for the detection of overvoltage" VALUE 0x00935 _REC_VAL_20_u1 25.8984 _CNV_A_R_LINEAR_____34_CM 0. 25.8984 DISPLAY_IDENTIFIER C_VB_PROT_MAX FORMAT "%3.1" /end CHARACTERISTIC
/begin CHARACTERISTIC c_t_lsh_rise "Total heating time with increasing heater power" VALUE 0x00815 _REC_VAL_20_u1 25.5 _CNV_A_R_LINEAR_____24_CM 0. 25.5 DISPLAY_IDENTIFIER C_T_LSH_RISE FORMAT "%4.1" /end CHARACTERISTIC
/begin CHARACTERISTIC c_inc_v_efc "Heater voltage increment to raise temperature" VALUE 0x0070d _REC_VAL_20_u1 1.625 _CNV_A_R_LINEAR_____323_CM 0. 1.625 DISPLAY_IDENTIFIER C_INC_V_EFC FORMAT "%5.3" /end CHARACTERISTIC
/begin CHARACTERISTIC c_fac_v_efc_lsh_up_as "Multiplicative correction factor to effective heater voltage" VALUE 0x006e3 _REC_VAL_20_u1 1.9921875 _CNV_A_R_LINEAR_____115_CM 0. 1.9921875 DISPLAY_IDENTIFIER C_FAC_V_EFC_LSH_UP_AS FORMAT "%5.3" /end CHARACTERISTIC
/begin CHARACTERISTIC c_dec_v_efc "Heater voltage decrement to lower temperature" VALUE 0x0067b _REC_VAL_20_u1 1.625 _CNV_A_R_LINEAR_____323_CM 0. 1.625 DISPLAY_IDENTIFIER C_DEC_V_EFC FORMAT "%5.3" /end CHARACTERISTIC
/begin CHARACTERISTIC ip_v_efc_lsh_up_ini "Initial effective heater voltage" CURVE 0x00e8e _REC_CUR_20_u1_u2 25.8984 _CNV_A_R_LINEAR_____34_CM 0. 25.8984 DISPLAY_IDENTIFIER IP_V_EFC_LSH_UP_INI FORMAT "%3.1"
 /begin AXIS_DESCR COM_AXIS online_dummy _CNV_A_R_LINEAR_____321_CM 6 -2048. 2047.938 FORMAT "%8.2" AXIS_PTS_REF ldpm_temp_ls_ini_1_egcp /end AXIS_DESCR
/end CHARACTERISTIC
/begin CHARACTERISTIC c_v_efc_lsh_up_step "Additional effective heater voltage step on transition from LSH_POW_RED to LSH_POW_RISE" VALUE 0x0039f _REC_VAL_20_s1 26. _CNV_A_R_LINEAR_____295_CM -13.05 12.95 DISPLAY_IDENTIFIER C_V_EFC_LSH_UP_STEP FORMAT "%5.1" /end CHARACTERISTIC
/begin CHARACTERISTIC c_v_efc_lsh_up_as "Effective heater voltage calibration system additive factor" VALUE 0x0039e _REC_VAL_20_s1 26. _CNV_A_R_LINEAR_____295_CM -13.05 12.95 DISPLAY_IDENTIFIER C_V_EFC_LSH_UP_AS FORMAT "%5.1" /end CHARACTERISTIC
/begin CHARACTERISTIC c_t_lsh_up_lim "time after a heating phase with a higher voltage range" VALUE 0x00816 _REC_VAL_20_u1 25.5 _CNV_A_R_LINEAR_____24_CM 0. 25.5 DISPLAY_IDENTIFIER C_T_LSH_UP_LIM FORMAT "%4.1" /end CHARACTERISTIC
/begin CHARACTERISTIC c_t_lsh_up_max_step "time after at which step in max effective heater voltage applied" VALUE 0x00817 _REC_VAL_20_u1 25.5 _CNV_A_R_LINEAR_____24_CM 0. 25.5 DISPLAY_IDENTIFIER C_T_LSH_UP_MAX_STEP FORMAT "%4.1" /end CHARACTERISTIC
/begin CHARACTERISTIC c_v_efc_lsh_up_max "maximum allowed heater voltage " VALUE 0x00906 _REC_VAL_20_u1 25.8984 _CNV_A_R_LINEAR_____34_CM 0. 25.8984 DISPLAY_IDENTIFIER C_V_EFC_LSH_UP_MAX FORMAT "%3.1" /end CHARACTERISTIC
/begin CHARACTERISTIC c_v_efc_lsh_up_max_st "absolute maximum permitted effective heater voltage during initial phase; threshold & limit" VALUE 0x00907 _REC_VAL_20_u1 25.8984 _CNV_A_R_LINEAR_____34_CM 0. 25.8984 DISPLAY_IDENTIFIER C_V_EFC_LSH_UP_MAX_ST FORMAT "%3.1" /end CHARACTERISTIC
/begin CHARACTERISTIC c_ttip_ls_up_set_1 "Oxygen sensor set temperature for closed loop control" VALUE 0x004c0 _REC_VAL_20_s2 4095.938 _CNV_A_R_LINEAR_____280_CM -2048. 2047.938 DISPLAY_IDENTIFIER C_TTIP_LS_UP_SET_1 FORMAT "%8.2" /end CHARACTERISTIC
/begin CHARACTERISTIC c_ttip_ls_up_set_2 "Oxygen sensor set temperature for closed loop control" VALUE 0x004c2 _REC_VAL_20_s2 4095.938 _CNV_A_R_LINEAR_____280_CM -2048. 2047.938 DISPLAY_IDENTIFIER C_TTIP_LS_UP_SET_2 FORMAT "%8.2" /end CHARACTERISTIC
/begin CHARACTERISTIC c_ttip_ls_up_dif_min_p_add "Minimum required temperature difference in order to calculate P-term of controller" VALUE 0x01996 _REC_VAL_20_u2 2047.96875 _CNV_A_R_LINEAR_____283_CM 0. 2047.96875 DISPLAY_IDENTIFIER C_TTIP_LS_UP_DIF_MIN_P_ADD FORMAT "%7.2" /end CHARACTERISTIC
/begin CHARACTERISTIC c_fac_p_lsh_up_ctl "Multiplicative scaling factor for closed loop P-term" VALUE 0x006cf _REC_VAL_20_u1 6.348 _CNV_A_R_LINEAR_____324_CM 0. 6.348 DISPLAY_IDENTIFIER C_FAC_P_LSH_UP_CTL FORMAT "%4.2" /end CHARACTERISTIC
/begin CHARACTERISTIC c_fac_i_lsh_up_ctl "Multiplicative scaling factor for closed loop I-term" VALUE 0x006cd _REC_VAL_20_u1 6.348 _CNV_A_R_LINEAR_____324_CM 0. 6.348 DISPLAY_IDENTIFIER C_FAC_I_LSH_UP_CTL FORMAT "%4.2" /end CHARACTERISTIC
/begin CHARACTERISTIC c_teg_cat_up_mdl_max_lsh_up "Maximum permited exhaust gas temperature above which LSH switched off" VALUE 0x018da _REC_VAL_20_u2 2047. _CNV_A_R_LINEAR_____7_CM 0. 2047. DISPLAY_IDENTIFIER C_TEG_CAT_UP_MDL_MAX_LSH_UP FORMAT "%7.2" /end CHARACTERISTIC
/begin CHARACTERISTIC lc_inh_lsh_up_cll_ctl_1 "Boolean constant to permit suspension of closed loop heater control" VALUE 0x00f3b _REC_VAL_20_u1 1. _CNV_A_R_LINEAR_____1_CM 0. 1. DISPLAY_IDENTIFIER LC_INH_LSH_UP_CLL_CTL_1 FORMAT "%2.0" /end CHARACTERISTIC
/begin CHARACTERISTIC lc_inh_lsh_up_cll_ctl_2 "Boolean constant to permit suspension of closed loop heater control" VALUE 0x00f3c _REC_VAL_20_u1 1. _CNV_A_R_LINEAR_____1_CM 0. 1. DISPLAY_IDENTIFIER LC_INH_LSH_UP_CLL_CTL_2 FORMAT "%2.0" /end CHARACTERISTIC
/begin MEASUREMENT lv_v_efc_lsh_up_prot "Boolean variable indicating effective heater voltage limited due to excessive battery voltage level" UBYTE _CNV_S_2_RANGE______0_CM 1 100. 0. 1. DISPLAY_IDENTIFIER LV_V_EFC_LSH_UP_PROT ECU_ADDRESS 0x3fe032 /end MEASUREMENT
/begin AXIS_PTS ldpm_temp_ls_ini_1_egcp "" 0x11c28 online_dummy _REC_AXS_20_u2 4095.938 _CNV_A_R_LINEAR_____321_CM 6 -2048. 2047.938 DISPLAY_IDENTIFIER LDPM_TEMP_LS_INI_1_EGCP FORMAT "%8.2" /end AXIS_PTS
/begin AXIS_PTS ldp_vs_fac_v_efc_teg "" 0x012a8 vs _REC_AXS_20_u1 255. _CNV_A_R_LINEAR_____23_CM 6 0. 255. DISPLAY_IDENTIFIER LDP_VS_FAC_V_EFC_TEG FORMAT "%3.0" /end AXIS_PTS
/begin CHARACTERISTIC ip_v_efc_lsh_up_ctl "Open loop control effective heater voltage" MAP 0x07a73 _REC_MAP_20_u1_u1_u2 25.8984 _CNV_A_R_LINEAR_____34_CM 0. 25.8984 DISPLAY_IDENTIFIER IP_V_EFC_LSH_UP_CTL FORMAT "%3.1"
 /begin AXIS_DESCR COM_AXIS n_32 _CNV_A_R_LINEAR_____16_CM 6 0. 8160. FORMAT "%4.0" AXIS_PTS_REF ldpm_n_32_1_egcp /end AXIS_DESCR
 /begin AXIS_DESCR COM_AXIS teg_cat_up_mdl_max _CNV_A_R_LINEAR_____7_CM 6 0. 2047. FORMAT "%7.2" AXIS_PTS_REF ldpm_teg_cat_up_mdl_1_egcp /end AXIS_DESCR
/end CHARACTERISTIC
/begin AXIS_PTS ldpm_n_32_1_egcp "" 0x01316 n_32 _REC_AXS_20_u1 8160. _CNV_A_R_LINEAR_____16_CM 6 0. 8160. DISPLAY_IDENTIFIER LDPM_N_32_1_EGCP FORMAT "%4.0" /end AXIS_PTS
/begin AXIS_PTS ldpm_teg_cat_up_mdl_1_egcp "" 0x11b72 teg_cat_up_mdl_max _REC_AXS_20_u2 2047. _CNV_A_R_LINEAR_____7_CM 6 0. 2047. DISPLAY_IDENTIFIER LDPM_TEG_CAT_UP_MDL_1_EGCP FORMAT "%7.2" /end AXIS_PTS
/begin CHARACTERISTIC c_v_efc_lsh_down_tol "voltage threshold to the higher voltage range of the heater" VALUE 0x00904 _REC_VAL_20_u1 25.8984 _CNV_A_R_LINEAR_____34_CM 0. 25.8984 DISPLAY_IDENTIFIER C_V_EFC_LSH_DOWN_TOL FORMAT "%3.1" /end CHARACTERISTIC
/begin CHARACTERISTIC c_v_efc_lsh_down_max "maximum allowed heater voltage " VALUE 0x00902 _REC_VAL_20_u1 25.8984 _CNV_A_R_LINEAR_____34_CM 0. 25.8984 DISPLAY_IDENTIFIER C_V_EFC_LSH_DOWN_MAX FORMAT "%3.1" /end CHARACTERISTIC
/begin CHARACTERISTIC c_v_efc_lsh_down_prot "heater voltage in the case of overvoltage conditions" VALUE 0x00903 _REC_VAL_20_u1 25.8984 _CNV_A_R_LINEAR_____34_CM 0. 25.8984 DISPLAY_IDENTIFIER C_V_EFC_LSH_DOWN_PROT FORMAT "%3.1" /end CHARACTERISTIC
/begin CHARACTERISTIC c_t_lsh_down_tol "maximum of the tolerable heating time with in a higher voltage range " VALUE 0x00814 _REC_VAL_20_u1 255. _CNV_A_R_LINEAR_____30_CM 0. 255. DISPLAY_IDENTIFIER C_T_LSH_DOWN_TOL FORMAT "%3.0" /end CHARACTERISTIC
/begin CHARACTERISTIC c_v_efc_lsh_down_lim "limited voltage range of the heater" VALUE 0x00901 _REC_VAL_20_u1 25.8984 _CNV_A_R_LINEAR_____34_CM 0. 25.8984 DISPLAY_IDENTIFIER C_V_EFC_LSH_DOWN_LIM FORMAT "%3.1" /end CHARACTERISTIC
/begin CHARACTERISTIC c_v_efc_lsh_down_as "Additive correction to effective heater voltage" VALUE 0x0039c _REC_VAL_20_s1 26. _CNV_A_R_LINEAR_____295_CM -13.05 12.95 DISPLAY_IDENTIFIER C_V_EFC_LSH_DOWN_AS FORMAT "%5.1" /end CHARACTERISTIC
/begin CHARACTERISTIC ip_v_efc_lsh_down_ctl "Heater voltage effective value after completion of the heating phase" MAP 0x07a4f _REC_MAP_20_u1_u1_u2 25.8984 _CNV_A_R_LINEAR_____34_CM 0. 25.8984 DISPLAY_IDENTIFIER IP_V_EFC_LSH_DOWN_CTL FORMAT "%3.1"
 /begin AXIS_DESCR COM_AXIS n_32 _CNV_A_R_LINEAR_____16_CM 6 0. 8160. FORMAT "%4.0" AXIS_PTS_REF ldp_n_32_ip_v_efc_lsh_down_ctl /end AXIS_DESCR
 /begin AXIS_DESCR COM_AXIS online_dummy _CNV_A_R_LINEAR_____7_CM 6 0. 2047. FORMAT "%7.2" AXIS_PTS_REF ldpm_teg_cat_down_mdl_1_egcp /end AXIS_DESCR
/end CHARACTERISTIC
/begin CHARACTERISTIC ip_v_efc_lsh_down_ini "Initial heater voltage value" CURVE 0x00e88 _REC_CUR_20_u1_u2 25.8984 _CNV_A_R_LINEAR_____34_CM 0. 25.8984 DISPLAY_IDENTIFIER IP_V_EFC_LSH_DOWN_INI FORMAT "%3.1"
 /begin AXIS_DESCR COM_AXIS online_dummy _CNV_A_R_LINEAR_____321_CM 6 -2048. 2047.938 FORMAT "%8.2" AXIS_PTS_REF ldpm_temp_ls_down_ini_1_egcp /end AXIS_DESCR
/end CHARACTERISTIC
/begin CHARACTERISTIC ip_t_lsh_down_temp_thd "Duration until critical water splash sensor temperature reached" CURVE 0x00e01 _REC_CUR_20_u1_u2 255. _CNV_A_R_LINEAR_____30_CM 0. 255. DISPLAY_IDENTIFIER IP_T_LSH_DOWN_TEMP_THD FORMAT "%3.0"
 /begin AXIS_DESCR COM_AXIS online_dummy _CNV_A_R_LINEAR_____321_CM 6 -2048. 2047.938 FORMAT "%8.2" AXIS_PTS_REF ldpm_temp_ls_down_ini_1_egcp /end AXIS_DESCR
/end CHARACTERISTIC
/begin CHARACTERISTIC ip_fac_v_efc_down_teg "Coorection factor for the assumtion of the heat transfer exclusive for bank 2" CURVE 0x00c02 _REC_CUR_20_u1_u1 3.984375 _CNV_A_R_LINEAR_____127_CM 0. 3.984375 DISPLAY_IDENTIFIER IP_FAC_V_EFC_DOWN_TEG FORMAT "%4.2"
 /begin AXIS_DESCR COM_AXIS vs _CNV_A_R_LINEAR_____23_CM 6 0. 255. FORMAT "%3.0" AXIS_PTS_REF ldp_vs_ip_fac_v_efc_down_teg /end AXIS_DESCR
/end CHARACTERISTIC
/begin CHARACTERISTIC c_dec_v_efc_down "Heater voltage decrement to lower temperature" VALUE 0x0067c _REC_VAL_20_u1 25.8984 _CNV_A_R_LINEAR_____34_CM 0. 25.8984 DISPLAY_IDENTIFIER C_DEC_V_EFC_DOWN FORMAT "%3.1" /end CHARACTERISTIC
/begin CHARACTERISTIC c_inc_v_efc_down "Heater voltage increment to raise temperature" VALUE 0x0070e _REC_VAL_20_u1 25.8984 _CNV_A_R_LINEAR_____34_CM 0. 25.8984 DISPLAY_IDENTIFIER C_INC_V_EFC_DOWN FORMAT "%3.1" /end CHARACTERISTIC
/begin CHARACTERISTIC c_v_efc_down_red "Reduced heater voltage during danger of water splash damage" VALUE 0x00900 _REC_VAL_20_u1 25.8984 _CNV_A_R_LINEAR_____34_CM 0. 25.8984 DISPLAY_IDENTIFIER C_V_EFC_DOWN_RED FORMAT "%3.1" /end CHARACTERISTIC
/begin CHARACTERISTIC c_t_lsh_down_lim "time after a heating phase with a higher voltage range" VALUE 0x00812 _REC_VAL_20_u1 255. _CNV_A_R_LINEAR_____30_CM 0. 255. DISPLAY_IDENTIFIER C_T_LSH_DOWN_LIM FORMAT "%3.0" /end CHARACTERISTIC
/begin CHARACTERISTIC c_t_lsh_down_rise "Duration of open loop heating in PREHEATING" VALUE 0x00813 _REC_VAL_20_u1 255. _CNV_A_R_LINEAR_____30_CM 0. 255. DISPLAY_IDENTIFIER C_T_LSH_DOWN_RISE FORMAT "%3.0" /end CHARACTERISTIC
/begin CHARACTERISTIC c_vb_prot_down_max "maximum battery voltage threshold for the detection of overvoltage" VALUE 0x00934 _REC_VAL_20_u1 25.8984 _CNV_A_R_LINEAR_____34_CM 0. 25.8984 DISPLAY_IDENTIFIER C_VB_PROT_DOWN_MAX FORMAT "%3.1" /end CHARACTERISTIC
/begin CHARACTERISTIC c_v_efc_lsh_down_step "Additional effective heater voltage step on transition from LSH_POW_RED to LSH_POW_RISE" VALUE 0x0039d _REC_VAL_20_s1 26. _CNV_A_R_LINEAR_____295_CM -13.05 12.95 DISPLAY_IDENTIFIER C_V_EFC_LSH_DOWN_STEP FORMAT "%5.1" /end CHARACTERISTIC
/begin CHARACTERISTIC c_t_lshpwm_down_fast_vb_cor "Additional effective heater voltage step on transition from LSH_POW_RED to LSH_POW_RISE" VALUE 0x00819 _REC_VAL_20_u1 2.55 _CNV_A_R_LINEAR_____4_CM 0. 2.55 DISPLAY_IDENTIFIER C_T_LSHPWM_DOWN_FAST_VB_COR FORMAT "%4.2" /end CHARACTERISTIC
/begin CHARACTERISTIC c_fac_v_efc_lsh_down_as "Multiplicative correction factor to effective heater voltage" VALUE 0x006e2 _REC_VAL_20_u1 1.9921875 _CNV_A_R_LINEAR_____115_CM 0. 1.9921875 DISPLAY_IDENTIFIER C_FAC_V_EFC_LSH_DOWN_AS FORMAT "%5.3" /end CHARACTERISTIC
/begin AXIS_PTS ldpm_teg_cat_down_mdl_1_egcp "" 0x11b56 online_dummy _REC_AXS_20_u2 2047. _CNV_A_R_LINEAR_____7_CM 6 0. 2047. DISPLAY_IDENTIFIER LDPM_TEG_CAT_DOWN_MDL_1_EGCP FORMAT "%7.2" /end AXIS_PTS
/begin AXIS_PTS ldpm_temp_ls_down_ini_1_egcp "" 0x11c1a online_dummy _REC_AXS_20_u2 4095.938 _CNV_A_R_LINEAR_____321_CM 6 -2048. 2047.938 DISPLAY_IDENTIFIER LDPM_TEMP_LS_DOWN_INI_1_EGCP FORMAT "%8.2" /end AXIS_PTS
/begin AXIS_PTS ldp_n_32_ip_v_efc_lsh_down_ctl "" 0x010a6 n_32 _REC_AXS_20_u1 8160. _CNV_A_R_LINEAR_____16_CM 6 0. 8160. DISPLAY_IDENTIFIER LDP_N_32_IP_V_EFC_LSH_DOWN_CTL FORMAT "%4.0" /end AXIS_PTS
/begin AXIS_PTS ldp_vs_ip_fac_v_efc_down_teg "" 0x012af vs _REC_AXS_20_u1 255. _CNV_A_R_LINEAR_____23_CM 6 0. 255. DISPLAY_IDENTIFIER LDP_VS_IP_FAC_V_EFC_DOWN_TEG FORMAT "%3.0" /end AXIS_PTS
/begin CHARACTERISTIC lc_lsh_up_cll_ctl_2 "Boolean constant to permit suspension of closed loop heater control" VALUE 0x00f55 _REC_VAL_20_u1 1. _CNV_A_R_LINEAR_____22_CM 0. 1. DISPLAY_IDENTIFIER LC_LSH_UP_CLL_CTL_2 FORMAT "%1.0" /end CHARACTERISTIC
/begin CHARACTERISTIC lc_ttip_ls_up_mes_vld_1 "Boolean constant for the validity of oxygen sensor ceramic temperature TTIP_LS_UP_MES_i" VALUE 0x00f99 _REC_VAL_20_u1 1. _CNV_A_R_LINEAR_____22_CM 0. 1. DISPLAY_IDENTIFIER LC_TTIP_LS_UP_MES_VLD_1 FORMAT "%1.0" /end CHARACTERISTIC
/begin CHARACTERISTIC lc_ttip_ls_up_mes_vld_2 "Boolean constant for the validity of oxygen sensor ceramic temperature TTIP_LS_UP_MES_i" VALUE 0x00f9a _REC_VAL_20_u1 1. _CNV_A_R_LINEAR_____22_CM 0. 1. DISPLAY_IDENTIFIER LC_TTIP_LS_UP_MES_VLD_2 FORMAT "%1.0" /end CHARACTERISTIC
/begin CHARACTERISTIC lc_lsh_up_cll_ctl_1 "Boolean constant to permit suspension of closed loop heater control" VALUE 0x00f54 _REC_VAL_20_u1 1. _CNV_A_R_LINEAR_____22_CM 0. 1. DISPLAY_IDENTIFIER LC_LSH_UP_CLL_CTL_1 FORMAT "%1.0" /end CHARACTERISTIC
/begin CHARACTERISTIC c_maf_int_puc_up_ls "Upperlimit of air mass flow integral while puc active" VALUE 0x0167a _REC_VAL_20_u2 1820.398 _CNV_A_R_LINEAR_____271_CM 0. 1820.398 DISPLAY_IDENTIFIER C_MAF_INT_PUC_UP_LS FORMAT "%7.2" /end CHARACTERISTIC
/begin CHARACTERISTIC id_t_max_ls "maximum duration with open A/F control loop if the O2 sensors are not ready" CURVE 0x089cc _REC_CUR_20_u2_u1 6553.400000000001 _CNV_A_R_LINEAR_____24_CM 0.1 6553.5 DISPLAY_IDENTIFIER ID_T_MAX_LS FORMAT "%6.1"
 /begin AXIS_DESCR COM_AXIS tco_st _CNV_A_R_LINEAR_____12_CM 6 -48. 142.5 FORMAT "%5.1" AXIS_PTS_REF ldpm_tco_st_1_laco /end AXIS_DESCR
/end CHARACTERISTIC
/begin AXIS_PTS ldpm_tco_st_1_laco "" 0x013eb tco_st _REC_AXS_20_u1 190.5 _CNV_A_R_LINEAR_____12_CM 6 -48. 142.5 DISPLAY_IDENTIFIER LDPM_TCO_ST_1_LACO FORMAT "%5.1" /end AXIS_PTS
/begin CHARACTERISTIC c_vls_afl_ready "Lean VLS_xxxx_i threshold for operative readiness detection" VALUE 0x019ea _REC_VAL_20_u2 4.99511719 _CNV_A_R_LINEAR_____3_CM 0. 4.99511719 DISPLAY_IDENTIFIER C_VLS_AFL_READY FORMAT "%5.3" /end CHARACTERISTIC
/begin CHARACTERISTIC c_vls_afr_ready "Rich VLS_xxxx_i threshold for operative readiness detection" VALUE 0x019f4 _REC_VAL_20_u2 4.99511719 _CNV_A_R_LINEAR_____3_CM 0. 4.99511719 DISPLAY_IDENTIFIER C_VLS_AFR_READY FORMAT "%5.3" /end CHARACTERISTIC
/begin CHARACTERISTIC c_vls_afr "Minimum duration for Full load after which VLS_TOL_i is effected" VALUE 0x019ee _REC_VAL_20_u2 4.99511719 _CNV_A_R_LINEAR_____3_CM 0. 4.99511719 DISPLAY_IDENTIFIER C_VLS_AFR FORMAT "%5.3" /end CHARACTERISTIC
/begin CHARACTERISTIC c_vls_ini_max "Upper initialization value for VLS_TOL_i, VLS_MMV_MAX_i" VALUE 0x01a24 _REC_VAL_20_u2 4.99511719 _CNV_A_R_LINEAR_____3_CM 0. 4.99511719 DISPLAY_IDENTIFIER C_VLS_INI_MAX FORMAT "%5.3" /end CHARACTERISTIC
/begin CHARACTERISTIC c_vls_ini_min "Lower initialization value for VLS_BOL_i, VLS_MMV_MIN_i" VALUE 0x01a26 _REC_VAL_20_u2 4.99511719 _CNV_A_R_LINEAR_____3_CM 0. 4.99511719 DISPLAY_IDENTIFIER C_VLS_INI_MIN FORMAT "%5.3" /end CHARACTERISTIC
/begin CHARACTERISTIC c_vls_crlc_off "Filter constant for determination of VLS_MMV_xxx_i values when respective threshold not passed" VALUE 0x019fa _REC_VAL_20_u2 0.99998474 _CNV_A_R_LINEAR_____37_CM 0. 0.99998474 DISPLAY_IDENTIFIER C_VLS_CRLC_OFF FORMAT "%7.5" /end CHARACTERISTIC
/begin CHARACTERISTIC c_ctr_vls_up_afl_cyc_min "Minimum number of AF cycles after lambda controller activation prior to validating VLS_MMV_xxx_i signals" VALUE 0x01506 _REC_VAL_20_u2 65535. _CNV_A_R_LINEAR_____1_CM 0. 65535. DISPLAY_IDENTIFIER C_CTR_VLS_UP_AFL_CYC_MIN FORMAT "%5.0" /end CHARACTERISTIC
/begin CHARACTERISTIC ip_t_afl_lock "LV_AFL transition lock-out time after transition of AF mixture" MAP 0x06bdb _REC_MAP_20_u1_u1_u2 2.55 _CNV_A_R_LINEAR_____4_CM 0. 2.55 DISPLAY_IDENTIFIER IP_T_AFL_LOCK FORMAT "%4.2"
 /begin AXIS_DESCR COM_AXIS n_32 _CNV_A_R_LINEAR_____16_CM 8 0. 8160. FORMAT "%4.0" AXIS_PTS_REF ldpm_n_32__ti_lam /end AXIS_DESCR
 /begin AXIS_DESCR COM_AXIS maf _CNV_A_R_LINEAR_____106_CM 8 0. 1389. FORMAT "%7.2" AXIS_PTS_REF ldpm_maf__ti_lam /end AXIS_DESCR
/end CHARACTERISTIC
/begin CHARACTERISTIC c_fac_vls_up_mmv_hys "Multiplicative factor governing amplitude of hysteresis" VALUE 0x006e7 _REC_VAL_20_u1 0.99610001 _CNV_A_R_LINEAR_____29_CM 0. 0.99610001 DISPLAY_IDENTIFIER C_FAC_VLS_UP_MMV_HYS FORMAT "%5.3" /end CHARACTERISTIC
/begin CHARACTERISTIC c_vls_up_mmv_hys_min "Minimum hysteresis for the computation of the thresholds VLS_TOL_i and VLS_BOL_i" VALUE 0x01a3a _REC_VAL_20_u2 1. _CNV_A_R_LINEAR_____275_CM 0. 1. DISPLAY_IDENTIFIER C_VLS_UP_MMV_HYS_MIN FORMAT "%7.5" /end CHARACTERISTIC
/begin AXIS_PTS ldpm_n_32__ti_lam "" 0x0809b n_32 _REC_AXS_20_u1 8160. _CNV_A_R_LINEAR_____16_CM 8 0. 8160. DISPLAY_IDENTIFIER LDPM_N_32__TI_LAM FORMAT "%4.0" /end AXIS_PTS
/begin AXIS_PTS ldpm_maf__ti_lam "" 0x11734 maf _REC_AXS_20_u2 1389. _CNV_A_R_LINEAR_____106_CM 8 0. 1389. DISPLAY_IDENTIFIER LDPM_MAF__TI_LAM FORMAT "%7.2" /end AXIS_PTS
/begin CHARACTERISTIC c_vls_crlc "Averaging constant for finding the values VLS_MMV_MIN_i resp. VLS_MMV_MAX_i" VALUE 0x019f8 _REC_VAL_20_u2 0.99998474 _CNV_A_R_LINEAR_____37_CM 0. 0.99998474 DISPLAY_IDENTIFIER C_VLS_CRLC FORMAT "%7.5" /end CHARACTERISTIC
/begin CHARACTERISTIC c_vls_afl "Threshold for detection of lean mixture" VALUE 0x019e4 _REC_VAL_20_u2 4.99511719 _CNV_A_R_LINEAR_____3_CM 0. 4.99511719 DISPLAY_IDENTIFIER C_VLS_AFL FORMAT "%5.3" /end CHARACTERISTIC
/begin CHARACTERISTIC c_mff_sp_man "manual setpoint for fuel mass in homogeneous mode" VALUE 0x016c6 _REC_VAL_20_u2 1389. _CNV_A_R_LINEAR_____106_CM 0. 1389. DISPLAY_IDENTIFIER C_MFF_SP_MAN FORMAT "%7.2" /end CHARACTERISTIC
/begin CHARACTERISTIC c_mff_sp_hom_ofs_as "additive mass fuel offset value for application" VALUE 0x016c4 _REC_VAL_20_u2 1389. _CNV_A_R_LINEAR_____106_CM 0. 1389. DISPLAY_IDENTIFIER C_MFF_SP_HOM_OFS_AS FORMAT "%7.2" /end CHARACTERISTIC
/begin MEASUREMENT mff_sp_clc_1 "Calculated mass fuel flow setpoint for homogenious charge" UWORD _CNV_A_R_LINEAR_____106_CM 1 100. 0. 1389. DISPLAY_IDENTIFIER MFF_SP_CLC_1 ECU_ADDRESS 0x3fd4d2 BYTE_ORDER MSB_LAST FORMAT "%7.2" /end MEASUREMENT
/begin MEASUREMENT mff_sp_clc_2 "Calculated mass fuel flow setpoint for homogenious charge" UWORD _CNV_A_R_LINEAR_____106_CM 1 100. 0. 1389. DISPLAY_IDENTIFIER MFF_SP_CLC_2 ECU_ADDRESS 0x3fd4d4 BYTE_ORDER MSB_LAST FORMAT "%7.2" /end MEASUREMENT
/begin MEASUREMENT mff_sp_hom_eng_1 "Calculated mass fuel flow output for canister purge" UWORD _CNV_A_R_LINEAR_____106_CM 1 100. 0. 1389. DISPLAY_IDENTIFIER MFF_SP_HOM_ENG_1 ECU_ADDRESS 0x3fd4ce BYTE_ORDER MSB_LAST FORMAT "%7.2" /end MEASUREMENT
/begin MEASUREMENT mff_sp_hom_eng_2 "Calculated mass fuel flow output for canister purge" UWORD _CNV_A_R_LINEAR_____106_CM 1 100. 0. 1389. DISPLAY_IDENTIFIER MFF_SP_HOM_ENG_2 ECU_ADDRESS 0x3fd4d0 BYTE_ORDER MSB_LAST FORMAT "%7.2" /end MEASUREMENT
/begin CHARACTERISTIC ip_mff_cor_2 "Operating point correction of the basic injection fuel nass" MAP 0x0cb16 _REC_MAP_20_u2_u2_u2 1.99996948 _CNV_A_R_LINEAR_____21_CM 0. 1.99996948 DISPLAY_IDENTIFIER IP_MFF_COR_2 FORMAT "%7.5"
 /begin AXIS_DESCR COM_AXIS maf _CNV_A_R_LINEAR_____106_CM 12 0. 1389. FORMAT "%7.2" AXIS_PTS_REF ldp_maf__mff_cor_2 /end AXIS_DESCR
 /begin AXIS_DESCR COM_AXIS n _CNV_A_R_LINEAR_____11_CM 16 0. 8160. FORMAT "%4.0" AXIS_PTS_REF ldp_n__mff_cor_2 /end AXIS_DESCR
/end CHARACTERISTIC
/begin CHARACTERISTIC ip_mff_cor_1 "Operating point correction of the basic injection fuel nass" MAP 0x0c996 _REC_MAP_20_u2_u2_u2 1.99996948 _CNV_A_R_LINEAR_____21_CM 0. 1.99996948 DISPLAY_IDENTIFIER IP_MFF_COR_1 FORMAT "%7.5"
 /begin AXIS_DESCR COM_AXIS maf _CNV_A_R_LINEAR_____106_CM 12 0. 1389. FORMAT "%7.2" AXIS_PTS_REF ldp_maf__mff_cor_1 /end AXIS_DESCR
 /begin AXIS_DESCR COM_AXIS n _CNV_A_R_LINEAR_____11_CM 16 0. 8160. FORMAT "%4.0" AXIS_PTS_REF ldp_n__mff_cor_1 /end AXIS_DESCR
/end CHARACTERISTIC
/begin CHARACTERISTIC lc_mff_sp_hom_man_act "switch for manual setpoint for fuel mass in homogeneous mode" VALUE 0x00f5b _REC_VAL_20_u1 1. _CNV_S_2_RANGE______5_CM 0. 1. DISPLAY_IDENTIFIER LC_MFF_SP_HOM_MAN_ACT /end CHARACTERISTIC
/begin MEASUREMENT mff_sp_hom[0] "Mass fuel flow setpoint for homogeneous charge (output)" UWORD _CNV_A_R_LINEAR_____106_CM 1 100. 0. 1389. DISPLAY_IDENTIFIER MFF_SP_HOM_1 ECU_ADDRESS 0x3fd4ca BYTE_ORDER MSB_LAST FORMAT "%7.2" /end MEASUREMENT
/begin MEASUREMENT mff_sp_hom[1] "Mass fuel flow setpoint for homogeneous charge (output)" UWORD _CNV_A_R_LINEAR_____106_CM 1 100. 0. 1389. DISPLAY_IDENTIFIER MFF_SP_HOM_2 ECU_ADDRESS 0x3fd4cc BYTE_ORDER MSB_LAST FORMAT "%7.2" /end MEASUREMENT
/begin AXIS_PTS ldp_maf__mff_cor_1 "" 0x10b9a maf _REC_AXS_20_u2 138.9 _CNV_A_R_LINEAR_____106_CM 12 0. 1389. DISPLAY_IDENTIFIER LDP_MAF__MFF_COR_1 FORMAT "%7.2" /end AXIS_PTS
/begin AXIS_PTS ldp_maf__mff_cor_2 "" 0x10bb4 maf _REC_AXS_20_u2 138.9 _CNV_A_R_LINEAR_____106_CM 12 0. 1389. DISPLAY_IDENTIFIER LDP_MAF__MFF_COR_2 FORMAT "%7.2" /end AXIS_PTS
/begin AXIS_PTS ldp_n__mff_cor_1 "" 0x10eb4 n _REC_AXS_20_u2 816. _CNV_A_R_LINEAR_____11_CM 16 0. 8160. DISPLAY_IDENTIFIER LDP_N__MFF_COR_1 FORMAT "%4.0" /end AXIS_PTS
/begin AXIS_PTS ldp_n__mff_cor_2 "" 0x10ed6 n _REC_AXS_20_u2 816. _CNV_A_R_LINEAR_____11_CM 16 0. 8160. DISPLAY_IDENTIFIER LDP_N__MFF_COR_2 FORMAT "%4.0" /end AXIS_PTS
/begin MEASUREMENT inh_iv_amt "Shut off sequence of AMT transmission" UBYTE _CNV_A_R_LINEAR_____1_CM 1 100. 0. 255. DISPLAY_IDENTIFIER INH_IV_AMT ECU_ADDRESS 0x3fe4b5 FORMAT "%3.0" /end MEASUREMENT
/begin MEASUREMENT ti_hom_2 "fuel injection time for homogeneous mode" UWORD _CNV_A_R_LINEAR_____198_CM 1 100. 0. 262.14 DISPLAY_IDENTIFIER TI_HOM_2 ECU_ADDRESS 0x3fd4e4 BYTE_ORDER MSB_LAST FORMAT "%7.3" /end MEASUREMENT
/begin CHARACTERISTIC c_ti_hom_man "manual setpoint for injection time in homogeneous mode" VALUE 0x01924 _REC_VAL_20_u2 262.14 _CNV_A_R_LINEAR_____198_CM 0. 262.14 DISPLAY_IDENTIFIER C_TI_HOM_MAN FORMAT "%7.3" /end CHARACTERISTIC
/begin CHARACTERISTIC lc_ti_hom_man_act "switch for manual setpoint for injection time in homogeneous mode" VALUE 0x00f7a _REC_VAL_20_u1 1. _CNV_S_2_RANGE______5_CM 0. 1. DISPLAY_IDENTIFIER LC_TI_HOM_MAN_ACT /end CHARACTERISTIC
/begin MEASUREMENT ti_hom_1 "fuel injection time for homogeneous mode" UWORD _CNV_A_R_LINEAR_____198_CM 1 100. 0. 262.14 DISPLAY_IDENTIFIER TI_HOM_1 ECU_ADDRESS 0x3fd4e2 BYTE_ORDER MSB_LAST FORMAT "%7.3" /end MEASUREMENT
/begin MEASUREMENT lv_ti_lim_min "boolean variable for injection time limitation" UBYTE _CNV_S_2_RANGE______0_CM 1 100. 0. 1. DISPLAY_IDENTIFIER LV_TI_LIM_MIN ECU_ADDRESS 0x3fe359 /end MEASUREMENT
/begin MEASUREMENT fac_ti_prs[0] "factor  for correction of fuel injection time due to a change of pressure decrease at the injector" UWORD _CNV_A_R_LINEAR_____437_CM 1 100. 0. 15.99975586 DISPLAY_IDENTIFIER FAC_TI_PRS_1 ECU_ADDRESS 0x3fd4e6 BYTE_ORDER MSB_LAST /end MEASUREMENT
/begin MEASUREMENT fac_ti_prs[1] "factor  for correction of fuel injection time due to a change of pressure decrease at the injector" UWORD _CNV_A_R_LINEAR_____437_CM 1 100. 0. 15.99975586 DISPLAY_IDENTIFIER FAC_TI_PRS_2 ECU_ADDRESS 0x3fd4e8 BYTE_ORDER MSB_LAST /end MEASUREMENT
/begin MEASUREMENT prs_inj_mv[0] "mean cylinder pressure during injection " UWORD _CNV_A_R_LINEAR_____199_CM 1 100. 0. 173888. DISPLAY_IDENTIFIER PRS_INJ_MV_1 ECU_ADDRESS 0x3fd4ea BYTE_ORDER MSB_LAST FORMAT "%6.0" /end MEASUREMENT
/begin MEASUREMENT prs_inj_mv[1] "mean cylinder pressure during injection " UWORD _CNV_A_R_LINEAR_____199_CM 1 100. 0. 173888. DISPLAY_IDENTIFIER PRS_INJ_MV_2 ECU_ADDRESS 0x3fd4ec BYTE_ORDER MSB_LAST FORMAT "%6.0" /end MEASUREMENT
/begin MEASUREMENT prs_dec_inj[0] "pressure decrease at the injector " UWORD _CNV_A_R_LINEAR_____199_CM 1 100. 0. 173888. DISPLAY_IDENTIFIER PRS_DEC_INJ_1 ECU_ADDRESS 0x3fd4f2 BYTE_ORDER MSB_LAST FORMAT "%6.0" /end MEASUREMENT
/begin MEASUREMENT prs_dec_inj[1] "pressure decrease at the injector " UWORD _CNV_A_R_LINEAR_____199_CM 1 100. 0. 173888. DISPLAY_IDENTIFIER PRS_DEC_INJ_2 ECU_ADDRESS 0x3fd4f4 BYTE_ORDER MSB_LAST FORMAT "%6.0" /end MEASUREMENT
/begin MEASUREMENT ti_stnd_hom[0] "fuel injection time without fuel pressure correction for homogeneous mode" UWORD _CNV_A_R_LINEAR_____198_CM 1 100. 0. 262.14 DISPLAY_IDENTIFIER TI_STND_HOM_1 ECU_ADDRESS 0x3fd4f6 BYTE_ORDER MSB_LAST FORMAT "%7.3" /end MEASUREMENT
/begin MEASUREMENT ti_stnd_hom[1] "fuel injection time without fuel pressure correction for homogeneous mode" UWORD _CNV_A_R_LINEAR_____198_CM 1 100. 0. 262.14 DISPLAY_IDENTIFIER TI_STND_HOM_2 ECU_ADDRESS 0x3fd4f8 BYTE_ORDER MSB_LAST FORMAT "%7.3" /end MEASUREMENT
/begin MEASUREMENT ti_hom_clc[0] "calculated fuel injection time for homogeneous mode" UWORD _CNV_A_R_LINEAR_____198_CM 1 100. 0. 262.14 DISPLAY_IDENTIFIER TI_HOM_CLC_1 ECU_ADDRESS 0x3fd4fa BYTE_ORDER MSB_LAST FORMAT "%7.3" /end MEASUREMENT
/begin MEASUREMENT ti_hom_clc[1] "calculated fuel injection time for homogeneous mode" UWORD _CNV_A_R_LINEAR_____198_CM 1 100. 0. 262.14 DISPLAY_IDENTIFIER TI_HOM_CLC_2 ECU_ADDRESS 0x3fd4fc BYTE_ORDER MSB_LAST FORMAT "%7.3" /end MEASUREMENT
/begin MEASUREMENT crk_inj[0] "rough value for injection angle (EOI-SOI) " UWORD _CNV_A_R_LINEAR_____82_CM 1 100. 0. 600. DISPLAY_IDENTIFIER CRK_INJ_1 ECU_ADDRESS 0x3fd4ee BYTE_ORDER MSB_LAST FORMAT "%5.1" /end MEASUREMENT
/begin MEASUREMENT crk_inj[1] "rough value for injection angle (EOI-SOI) " UWORD _CNV_A_R_LINEAR_____82_CM 1 100. 0. 600. DISPLAY_IDENTIFIER CRK_INJ_2 ECU_ADDRESS 0x3fd4f0 BYTE_ORDER MSB_LAST FORMAT "%5.1" /end MEASUREMENT
/begin CHARACTERISTIC c_ti_min_thd "minimum threshold of the injection time limitation" VALUE 0x0192e _REC_VAL_20_u2 262.14 _CNV_A_R_LINEAR_____198_CM 0. 262.14 DISPLAY_IDENTIFIER C_TI_MIN_THD FORMAT "%7.3" /end CHARACTERISTIC
/begin CHARACTERISTIC c_ti_min "minimum injection time limitation" VALUE 0x01928 _REC_VAL_20_u2 262.14 _CNV_A_R_LINEAR_____198_CM 0. 262.14 DISPLAY_IDENTIFIER C_TI_MIN FORMAT "%7.3" /end CHARACTERISTIC
/begin CHARACTERISTIC ip_prs_inc_cmp "mean pressure increase in cylinder due to compression" MAP 0x0d5fa _REC_MAP_20_u2_u2_u2 31.99951171875 _CNV_A_R_LINEAR_____378_CM 0. 31.99951171875 DISPLAY_IDENTIFIER IP_PRS_INC_CMP FORMAT "%7.4"
 /begin AXIS_DESCR COM_AXIS online_dummy _CNV_A_R_LINEAR_____82_CM 12 0. 720. FORMAT "%6.2" AXIS_PTS_REF ldp_eoi__prs_inc_cmp /end AXIS_DESCR
 /begin AXIS_DESCR COM_AXIS online_dummy _CNV_A_R_LINEAR_____82_CM 16 0. 600. FORMAT "%5.1" AXIS_PTS_REF ldp_crk_inj__prs_inc_cmp /end AXIS_DESCR
/end CHARACTERISTIC
/begin AXIS_PTS ldp_eoi__prs_inc_cmp "" 0x10a7e online_dummy _REC_AXS_20_u2 36. _CNV_A_R_LINEAR_____82_CM 12 0. 720. DISPLAY_IDENTIFIER LDP_EOI__PRS_INC_CMP FORMAT "%6.2" /end AXIS_PTS
/begin AXIS_PTS ldp_crk_inj__prs_inc_cmp "" 0x109c0 online_dummy _REC_AXS_20_u2 30. _CNV_A_R_LINEAR_____82_CM 16 0. 600. DISPLAY_IDENTIFIER LDP_CRK_INJ__PRS_INC_CMP FORMAT "%5.1" /end AXIS_PTS
/begin CHARACTERISTIC ip_fac_ti_prs "Factor for correction of fuel injection due to pressure decrease at the injector" CURVE 0x0b30e _REC_CUR_20_u2_u2 31.99951171875 _CNV_A_R_LINEAR_____378_CM 0. 31.99951171875 DISPLAY_IDENTIFIER IP_FAC_TI_PRS FORMAT "%7.4"
 /begin AXIS_DESCR COM_AXIS fup _CNV_A_R_LINEAR_____199_CM 12 0. 173888. FORMAT "%6.0" AXIS_PTS_REF ldpm_prs_dec_inj__fac_ti_prs /end AXIS_DESCR
/end CHARACTERISTIC
/begin AXIS_PTS ldpm_prs_dec_inj__fac_ti_prs "" 0x11ab4 fup _REC_AXS_20_u2 173888. _CNV_A_R_LINEAR_____199_CM 12 0. 173888. DISPLAY_IDENTIFIER LDPM_PRS_DEC_INJ__FAC_TI_PRS FORMAT "%6.0" /end AXIS_PTS
/begin MEASUREMENT ti_st_amp "Injection correction at start upon AMP " UBYTE _CNV_A_R_LINEAR_____39_CM 1 100. 0. 1.99220002 DISPLAY_IDENTIFIER TI_ST_AMP ECU_ADDRESS 0x3fe356 FORMAT "%5.3" /end MEASUREMENT
/begin CHARACTERISTIC ip_mff_lgrd_ast "Injection time change limitation after Start" CURVE 0x0ccc6 _REC_CUR_20_u2_u1 1389. _CNV_A_R_LINEAR_____106_CM 0. 1389. DISPLAY_IDENTIFIER IP_MFF_LGRD_AST FORMAT "%7.2"
 /begin AXIS_DESCR COM_AXIS tco _CNV_A_R_LINEAR_____12_CM 8 -48. 142.5 FORMAT "%5.1" AXIS_PTS_REF ldp_tco__mff_lgrd_ast /end AXIS_DESCR
/end CHARACTERISTIC
/begin AXIS_PTS ldp_tco__mff_lgrd_ast "" 0x07d9e tco _REC_AXS_20_u1 190.5 _CNV_A_R_LINEAR_____12_CM 8 -48. 142.5 DISPLAY_IDENTIFIER LDP_TCO__MFF_LGRD_AST FORMAT "%5.1" /end AXIS_PTS
/begin MEASUREMENT tib "Basic injection time - equivalent to MFF_BAS (interface to wall film compensation function)" UWORD _CNV_A_R_LINEAR_____198_CM 1 100. 0. 262.14 DISPLAY_IDENTIFIER TIB ECU_ADDRESS 0x3fd548 BYTE_ORDER MSB_LAST FORMAT "%7.3" /end MEASUREMENT
/begin MEASUREMENT mff_add_wf "Fuel mass flow for wall film compensation - equivalent to TI_ADD_WF (interface to total injection formula)" SWORD _CNV_A_R_LINEAR_____255_CM 1 100. -694.5 694.478806 DISPLAY_IDENTIFIER MFF_ADD_WF ECU_ADDRESS 0x3fd546 BYTE_ORDER MSB_LAST FORMAT "%7.2" /end MEASUREMENT
/begin MEASUREMENT ti_add_reac[0] "Reactivation fuel feed injection time correction" UWORD _CNV_A_R_LINEAR_____198_CM 1 100. 0. 262.14 DISPLAY_IDENTIFIER TI_ADD_REAC_0 ECU_ADDRESS 0x3fd53a BYTE_ORDER MSB_LAST FORMAT "%7.3" /end MEASUREMENT
/begin MEASUREMENT ti_add_reac[1] "Reactivation fuel feed injection time correction" UWORD _CNV_A_R_LINEAR_____198_CM 1 100. 0. 262.14 DISPLAY_IDENTIFIER TI_ADD_REAC_1 ECU_ADDRESS 0x3fd53c BYTE_ORDER MSB_LAST FORMAT "%7.3" /end MEASUREMENT
/begin MEASUREMENT ti_add_reac[2] "Reactivation fuel feed injection time correction" UWORD _CNV_A_R_LINEAR_____198_CM 1 100. 0. 262.14 DISPLAY_IDENTIFIER TI_ADD_REAC_2 ECU_ADDRESS 0x3fd53e BYTE_ORDER MSB_LAST FORMAT "%7.3" /end MEASUREMENT
/begin MEASUREMENT ti_add_reac[3] "Reactivation fuel feed injection time correction" UWORD _CNV_A_R_LINEAR_____198_CM 1 100. 0. 262.14 DISPLAY_IDENTIFIER TI_ADD_REAC_3 ECU_ADDRESS 0x3fd540 BYTE_ORDER MSB_LAST FORMAT "%7.3" /end MEASUREMENT
/begin MEASUREMENT ti_add_reac[4] "Reactivation fuel feed injection time correction" UWORD _CNV_A_R_LINEAR_____198_CM 1 100. 0. 262.14 DISPLAY_IDENTIFIER TI_ADD_REAC_4 ECU_ADDRESS 0x3fd542 BYTE_ORDER MSB_LAST FORMAT "%7.3" /end MEASUREMENT
/begin MEASUREMENT ti_add_reac[5] "Reactivation fuel feed injection time correction" UWORD _CNV_A_R_LINEAR_____198_CM 1 100. 0. 262.14 DISPLAY_IDENTIFIER TI_ADD_REAC_5 ECU_ADDRESS 0x3fd544 BYTE_ORDER MSB_LAST FORMAT "%7.3" /end MEASUREMENT
/begin CHARACTERISTIC c_fac_mff_ti_stnd_2 "Injectionvalve characteristic for fuel mass flow to injection time at standard conditions" VALUE 0x01582 _REC_VAL_20_u2 0.37745 _CNV_A_R_LINEAR_____440_CM 0. 0.37745 DISPLAY_IDENTIFIER C_FAC_MFF_TI_STND_2 FORMAT "%7.5" /end CHARACTERISTIC
/begin CHARACTERISTIC c_fac_wf_puc "transposition factor for PUC" VALUE 0x006eb _REC_VAL_20_u1 0.9960940000000002 _CNV_A_R_LINEAR_____50_CM 0. 0.996094 DISPLAY_IDENTIFIER C_FAC_WF_PUC FORMAT "%5.3" /end CHARACTERISTIC
/begin CHARACTERISTIC c_ti_crlc_fast_wf_is "fast correlation constant for idle speed" VALUE 0x01920 _REC_VAL_20_u2 0.99998474 _CNV_A_R_LINEAR_____37_CM 0. 0.99998474 DISPLAY_IDENTIFIER C_TI_CRLC_FAST_WF_IS FORMAT "%7.6" /end CHARACTERISTIC
/begin MEASUREMENT seg_ctr_wf "wall film segment counter running down after engine start" UWORD _CNV_A_R_LINEAR_____184_CM 1 100. 0. 65535. DISPLAY_IDENTIFIER SEG_CTR_WF ECU_ADDRESS 0x3fd5aa BYTE_ORDER MSB_LAST FORMAT "%5.0" /end MEASUREMENT
/begin CHARACTERISTIC ip_seg_ctr_fac_wf__seg_ctr_wf "number of segments depending factor for first tip in" CURVE 0x00dbf _REC_CUR_20_u1_u2 0.9960940000000002 _CNV_A_R_LINEAR_____50_CM 0. 0.996094 DISPLAY_IDENTIFIER IP_SEG_CTR_FAC_WF__SEG_CTR_WF FORMAT "%5.3"
 /begin AXIS_DESCR COM_AXIS seg_ctr_wf _CNV_A_R_LINEAR_____184_CM 4 0. 65535. FORMAT "%5.0" AXIS_PTS_REF ldp_seg_ctr_fac_wf /end AXIS_DESCR
/end CHARACTERISTIC
/begin CHARACTERISTIC ip_ti_dif_wf_thd__tco "threshold for suppressing small variations of tib" CURVE 0x01b54 _REC_CUR_20_u2_u1 262.14 _CNV_A_R_LINEAR_____198_CM 0. 262.14 DISPLAY_IDENTIFIER IP_TI_DIF_WF_THD__TCO FORMAT "%7.3"
 /begin AXIS_DESCR COM_AXIS tco _CNV_A_R_LINEAR_____12_CM 4 -48. 142.5 FORMAT "%5.1" AXIS_PTS_REF ldp_tco_ti_wf_thd /end AXIS_DESCR
/end CHARACTERISTIC
/begin CHARACTERISTIC ip_ti_fac_neg_fast_wf__n__maf "load correction fast wall film negative" MAP 0x076cf _REC_MAP_20_u1_u1_u1 1.9921875 _CNV_A_R_LINEAR_____115_CM 0. 1.9921875 DISPLAY_IDENTIFIER IP_TI_FAC_NEG_FAST_WF__N__MAF FORMAT "%5.3"
 /begin AXIS_DESCR COM_AXIS n_32 _CNV_A_R_LINEAR_____16_CM 8 0. 8160. FORMAT "%4.0" AXIS_PTS_REF ldpm_n_29 /end AXIS_DESCR
 /begin AXIS_DESCR COM_AXIS maf _CNV_A_R_LINEAR_____27_CM 8 0. 1389. FORMAT "%4.0" AXIS_PTS_REF ldpm_maf_6 /end AXIS_DESCR
/end CHARACTERISTIC
/begin CHARACTERISTIC ip_ti_fac_neg_slow_wf__n__maf "load correction slow wall film negative" MAP 0x0770f _REC_MAP_20_u1_u1_u1 1.9921875 _CNV_A_R_LINEAR_____115_CM 0. 1.9921875 DISPLAY_IDENTIFIER IP_TI_FAC_NEG_SLOW_WF__N__MAF FORMAT "%5.3"
 /begin AXIS_DESCR COM_AXIS n_32 _CNV_A_R_LINEAR_____16_CM 8 0. 8160. FORMAT "%4.0" AXIS_PTS_REF ldpm_n_29 /end AXIS_DESCR
 /begin AXIS_DESCR COM_AXIS maf _CNV_A_R_LINEAR_____27_CM 8 0. 1389. FORMAT "%4.0" AXIS_PTS_REF ldpm_maf_6 /end AXIS_DESCR
/end CHARACTERISTIC
/begin CHARACTERISTIC ip_ti_fac_pos_slow_wf__n__maf "load correction slow wall film positive" MAP 0x0778f _REC_MAP_20_u1_u1_u1 1.9921875 _CNV_A_R_LINEAR_____115_CM 0. 1.9921875 DISPLAY_IDENTIFIER IP_TI_FAC_POS_SLOW_WF__N__MAF FORMAT "%5.3"
 /begin AXIS_DESCR COM_AXIS n_32 _CNV_A_R_LINEAR_____16_CM 8 0. 8160. FORMAT "%4.0" AXIS_PTS_REF ldpm_n_29 /end AXIS_DESCR
 /begin AXIS_DESCR COM_AXIS maf _CNV_A_R_LINEAR_____27_CM 8 0. 1389. FORMAT "%4.0" AXIS_PTS_REF ldpm_maf_6 /end AXIS_DESCR
/end CHARACTERISTIC
/begin CHARACTERISTIC ip_ti_fast_wf_thd__tib "threshold for fast wall film correction" CURVE 0x01b5c _REC_CUR_20_u2_u2 262.14 _CNV_A_R_LINEAR_____198_CM 0. 262.14 DISPLAY_IDENTIFIER IP_TI_FAST_WF_THD__TIB FORMAT "%7.3"
 /begin AXIS_DESCR COM_AXIS tib _CNV_A_R_LINEAR_____198_CM 4 0. 262.14 FORMAT "%7.3" AXIS_PTS_REF ldpm_tib_ti_wf_thd /end AXIS_DESCR
/end CHARACTERISTIC
/begin CHARACTERISTIC ip_ti_slow_wf_thd__tib "threshold for slow wall film correction" CURVE 0x01b64 _REC_CUR_20_u2_u2 262.14 _CNV_A_R_LINEAR_____198_CM 0. 262.14 DISPLAY_IDENTIFIER IP_TI_SLOW_WF_THD__TIB FORMAT "%7.3"
 /begin AXIS_DESCR COM_AXIS tib _CNV_A_R_LINEAR_____198_CM 4 0. 262.14 FORMAT "%7.3" AXIS_PTS_REF ldpm_tib_ti_wf_thd /end AXIS_DESCR
/end CHARACTERISTIC
/begin CHARACTERISTIC ip_ti_tco_neg_fast_wf__n__tco "fast negative wall film factor" MAP 0x077f3 _REC_MAP_20_u1_u1_u1 127.5 _CNV_A_R_LINEAR_____388_CM 0. 127.5 DISPLAY_IDENTIFIER IP_TI_TCO_NEG_FAST_WF__N__TCO FORMAT "%5.1"
 /begin AXIS_DESCR COM_AXIS n_32 _CNV_A_R_LINEAR_____16_CM 8 0. 8160. FORMAT "%4.0" AXIS_PTS_REF ldpm_n_29 /end AXIS_DESCR
 /begin AXIS_DESCR COM_AXIS tco _CNV_A_R_LINEAR_____12_CM 8 -48. 142.5 FORMAT "%5.1" AXIS_PTS_REF ldpm_tco_15 /end AXIS_DESCR
/end CHARACTERISTIC
/begin CHARACTERISTIC ip_ti_tco_neg_slow_wf__n__tco "total negativewall film factor" MAP 0x07833 _REC_MAP_20_u1_u1_u1 510. _CNV_A_R_LINEAR_____489_CM 0. 510. DISPLAY_IDENTIFIER IP_TI_TCO_NEG_SLOW_WF__N__TCO FORMAT "%5.1"
 /begin AXIS_DESCR COM_AXIS n_32 _CNV_A_R_LINEAR_____16_CM 8 0. 8160. FORMAT "%4.0" AXIS_PTS_REF ldpm_n_29 /end AXIS_DESCR
 /begin AXIS_DESCR COM_AXIS tco _CNV_A_R_LINEAR_____12_CM 8 -48. 142.5 FORMAT "%5.1" AXIS_PTS_REF ldpm_tco_15 /end AXIS_DESCR
/end CHARACTERISTIC
/begin CHARACTERISTIC ip_ti_tco_pos_fast_wf__n__tco "fast positive wall film factor" MAP 0x07873 _REC_MAP_20_u1_u1_u1 127.5 _CNV_A_R_LINEAR_____388_CM 0. 127.5 DISPLAY_IDENTIFIER IP_TI_TCO_POS_FAST_WF__N__TCO FORMAT "%5.1"
 /begin AXIS_DESCR COM_AXIS n_32 _CNV_A_R_LINEAR_____16_CM 8 0. 8160. FORMAT "%4.0" AXIS_PTS_REF ldpm_n_29 /end AXIS_DESCR
 /begin AXIS_DESCR COM_AXIS tco _CNV_A_R_LINEAR_____12_CM 8 -48. 142.5 FORMAT "%5.1" AXIS_PTS_REF ldpm_tco_15 /end AXIS_DESCR
/end CHARACTERISTIC
/begin CHARACTERISTIC ip_ti_tco_pos_slow_wf__n__tco "total positive wall film factor" MAP 0x078b3 _REC_MAP_20_u1_u1_u1 510. _CNV_A_R_LINEAR_____489_CM 0. 510. DISPLAY_IDENTIFIER IP_TI_TCO_POS_SLOW_WF__N__TCO FORMAT "%5.1"
 /begin AXIS_DESCR COM_AXIS n_32 _CNV_A_R_LINEAR_____16_CM 8 0. 8160. FORMAT "%4.0" AXIS_PTS_REF ldpm_n_29 /end AXIS_DESCR
 /begin AXIS_DESCR COM_AXIS tco _CNV_A_R_LINEAR_____12_CM 8 -48. 142.5 FORMAT "%5.1" AXIS_PTS_REF ldpm_tco_15 /end AXIS_DESCR
/end CHARACTERISTIC
/begin CHARACTERISTIC ip_ti_tco_st_fac_wf__tco_st "TCO_ST depending factor for first tip in" CURVE 0x00e5e _REC_CUR_20_u1_u1 0.9960940000000002 _CNV_A_R_LINEAR_____50_CM 0. 0.996094 DISPLAY_IDENTIFIER IP_TI_TCO_ST_FAC_WF__TCO_ST FORMAT "%5.3"
 /begin AXIS_DESCR COM_AXIS tco_st _CNV_A_R_LINEAR_____12_CM 4 -48. 142.5 FORMAT "%5.1" AXIS_PTS_REF ldp_tco_st_ti_fac_wf /end AXIS_DESCR
/end CHARACTERISTIC
/begin CHARACTERISTIC ip_ti_vo_fast_wf__vo "VO-dependent wall film amount correction factor for fast compensation" CURVE 0x00e62 _REC_CUR_20_u1_u1 1.99220002 _CNV_A_R_LINEAR_____39_CM 0. 1.99220002 DISPLAY_IDENTIFIER IP_TI_VO_FAST_WF__VO FORMAT "%5.3"
 /begin AXIS_DESCR COM_AXIS vo _CNV_A_R_LINEAR_____82_CM 8 0. 95.625 FORMAT "%4.1" AXIS_PTS_REF ldpm_vo_1 /end AXIS_DESCR
/end CHARACTERISTIC
/begin MEASUREMENT ti_add_wf "Total amount of wall film compensation" SWORD _CNV_A_R_LINEAR_____198_CM 1 100. -131.072 131.068 DISPLAY_IDENTIFIER TI_ADD_WF ECU_ADDRESS 0x3fd59a BYTE_ORDER MSB_LAST /end MEASUREMENT
/begin MEASUREMENT ti_fast_wf_post_thd "Fast term of wall film compensation" SWORD _CNV_A_R_LINEAR_____198_CM 1 100. -131.072 131.068 DISPLAY_IDENTIFIER TI_FAST_WF_POST_THD ECU_ADDRESS 0x3fd5ae BYTE_ORDER MSB_LAST FORMAT "%8.3" /end MEASUREMENT
/begin CHARACTERISTIC c_fac_wf_pu "transposition factor for PU" VALUE 0x006ea _REC_VAL_20_u1 0.9960940000000002 _CNV_A_R_LINEAR_____50_CM 0. 0.996094 DISPLAY_IDENTIFIER C_FAC_WF_PU FORMAT "%5.3" /end CHARACTERISTIC
/begin CHARACTERISTIC ip_ti_fac_pos_fast_wf__n__maf "load correction fast wall film positive" MAP 0x0774f _REC_MAP_20_u1_u1_u1 1.9921875 _CNV_A_R_LINEAR_____115_CM 0. 1.9921875 DISPLAY_IDENTIFIER IP_TI_FAC_POS_FAST_WF__N__MAF FORMAT "%5.3"
 /begin AXIS_DESCR COM_AXIS n_32 _CNV_A_R_LINEAR_____16_CM 8 0. 8160. FORMAT "%4.0" AXIS_PTS_REF ldpm_n_29 /end AXIS_DESCR
 /begin AXIS_DESCR COM_AXIS maf _CNV_A_R_LINEAR_____27_CM 8 0. 1389. FORMAT "%4.0" AXIS_PTS_REF ldpm_maf_6 /end AXIS_DESCR
/end CHARACTERISTIC
/begin CHARACTERISTIC c_seg_ctr_wf_ini "initial value for number of segments after start with increased pos. wall film compensation" VALUE 0x01786 _REC_VAL_20_u2 65535. _CNV_A_R_LINEAR_____1_CM 0. 65535. DISPLAY_IDENTIFIER C_SEG_CTR_WF_INI FORMAT "%5.0" /end CHARACTERISTIC
/begin AXIS_PTS ldp_seg_ctr_fac_wf "" 0x1113e seg_ctr_wf _REC_AXS_20_u2 65535. _CNV_A_R_LINEAR_____184_CM 4 0. 65535. DISPLAY_IDENTIFIER LDP_SEG_CTR_FAC_WF FORMAT "%5.0" /end AXIS_PTS
/begin AXIS_PTS ldp_tco_st_ti_fac_wf "" 0x011b7 tco_st _REC_AXS_20_u1 190.5 _CNV_A_R_LINEAR_____12_CM 4 -48. 142.5 DISPLAY_IDENTIFIER LDP_TCO_ST_TI_FAC_WF FORMAT "%5.1" /end AXIS_PTS
/begin AXIS_PTS ldp_tco_ti_wf_thd "" 0x011c3 tco _REC_AXS_20_u1 28.575 _CNV_A_R_LINEAR_____12_CM 4 -48. 142.5 DISPLAY_IDENTIFIER LDP_TCO_TI_WF_THD FORMAT "%5.1" /end AXIS_PTS
/begin AXIS_PTS ldpm_maf_6 "" 0x07f96 maf _REC_AXS_20_u1 1389. _CNV_A_R_LINEAR_____27_CM 8 0. 1389. DISPLAY_IDENTIFIER LDPM_MAF_6 FORMAT "%4.0" /end AXIS_PTS
/begin AXIS_PTS ldpm_n_29 "" 0x07fe2 n_32 _REC_AXS_20_u1 8160. _CNV_A_R_LINEAR_____16_CM 8 0. 8160. DISPLAY_IDENTIFIER LDPM_N_29 FORMAT "%4.0" /end AXIS_PTS
/begin AXIS_PTS ldpm_tib_ti_wf_thd "" 0x11c68 tib _REC_AXS_20_u2 262.14 _CNV_A_R_LINEAR_____198_CM 4 0. 262.14 DISPLAY_IDENTIFIER LDPM_TIB_TI_WF_THD FORMAT "%7.3" /end AXIS_PTS
/begin AXIS_PTS ldpm_vo_1 "" 0x082b0 vo _REC_AXS_20_u1 95.625 _CNV_A_R_LINEAR_____82_CM 8 0. 95.625 DISPLAY_IDENTIFIER LDPM_VO_1 FORMAT "%4.1" /end AXIS_PTS
/begin MEASUREMENT ti_slow_wf_post_thd "Slow term of wall film compensation" SWORD _CNV_A_R_LINEAR_____198_CM 1 100. -131.072 131.068 DISPLAY_IDENTIFIER TI_SLOW_WF_POST_THD ECU_ADDRESS 0x3fd5b2 BYTE_ORDER MSB_LAST FORMAT "%8.3" /end MEASUREMENT
/begin MEASUREMENT ti_maf_sp_wf "Air mass flow setpoint term of wall film compensation" SWORD _CNV_A_R_LINEAR_____198_CM 1 100. -131.072 131.068 DISPLAY_IDENTIFIER TI_MAF_SP_WF ECU_ADDRESS 0x3fd5b0 BYTE_ORDER MSB_LAST FORMAT "%8.3" /end MEASUREMENT
/begin CHARACTERISTIC ip_ti_vo_slow_wf__vo "VO-dependent wall film amount correction factor for slow compensation" CURVE 0x00e72 _REC_CUR_20_u1_u1 1.99220002 _CNV_A_R_LINEAR_____39_CM 0. 1.99220002 DISPLAY_IDENTIFIER IP_TI_VO_SLOW_WF__VO FORMAT "%5.3"
 /begin AXIS_DESCR COM_AXIS vo _CNV_A_R_LINEAR_____82_CM 8 0. 95.625 FORMAT "%4.1" AXIS_PTS_REF ldpm_vo_1 /end AXIS_DESCR
/end CHARACTERISTIC
/begin CHARACTERISTIC ip_ti_vo_maf_sp_wf__vo "VO-dependent wall film amount correction factor for air mass flow setpoint triggered compensation" CURVE 0x00e6a _REC_CUR_20_u1_u1 1.99220002 _CNV_A_R_LINEAR_____39_CM 0. 1.99220002 DISPLAY_IDENTIFIER IP_TI_VO_MAF_SP_WF__VO FORMAT "%5.3"
 /begin AXIS_DESCR COM_AXIS vo _CNV_A_R_LINEAR_____82_CM 8 0. 95.625 FORMAT "%4.1" AXIS_PTS_REF ldpm_vo_1 /end AXIS_DESCR
/end CHARACTERISTIC
/begin AXIS_PTS ldp_maf_sp_tqi "" 0x10db8 maf_sp_tqi _REC_AXS_20_u2 1389. _CNV_A_R_LINEAR_____106_CM 8 0. 1389. DISPLAY_IDENTIFIER LDP_MAF_SP_TQI FORMAT "%7.2" /end AXIS_PTS
/begin CHARACTERISTIC ip_ti_cor_maf_sp_wf "injection correction due to air mass flow setpoint triggered wallfilm" MAP 0x0f44e _REC_MAP_20_u2_u1_u2 262.14 _CNV_A_R_LINEAR_____439_CM -131.072 131.068 DISPLAY_IDENTIFIER IP_TI_COR_MAF_SP_WF FORMAT "%6.2"
 /begin AXIS_DESCR COM_AXIS n_32 _CNV_A_R_LINEAR_____16_CM 8 0. 8160. FORMAT "%4.0" AXIS_PTS_REF ldpm_n_29 /end AXIS_DESCR
 /begin AXIS_DESCR COM_AXIS maf_sp_tqi _CNV_A_R_LINEAR_____106_CM 8 0. 1389. FORMAT "%7.2" AXIS_PTS_REF ldp_maf_sp_tqi /end AXIS_DESCR
/end CHARACTERISTIC
/begin CHARACTERISTIC ip_fac_ti_cor_maf_sp_wf_pos "coolant temperature correction for air mass flow setpoint triggered wallfilm - positive (MAF_SP increasing)" CURVE 0x00bca _REC_CUR_20_u1_u1 1.99220002 _CNV_A_R_LINEAR_____39_CM 0. 1.99220002 DISPLAY_IDENTIFIER IP_FAC_TI_COR_MAF_SP_WF_POS FORMAT "%5.3"
 /begin AXIS_DESCR COM_AXIS tco _CNV_A_R_LINEAR_____12_CM 8 -48. 142.5 FORMAT "%5.1" AXIS_PTS_REF ldpm_tco_15 /end AXIS_DESCR
/end CHARACTERISTIC
/begin CHARACTERISTIC ip_fac_ti_cor_maf_sp_wf_neg "coolant temperature correction for air mass flow setpoint triggered wallfilm - negative (MAF_SP decreasing)" CURVE 0x00bc2 _REC_CUR_20_u1_u1 1.99220002 _CNV_A_R_LINEAR_____39_CM 0. 1.99220002 DISPLAY_IDENTIFIER IP_FAC_TI_COR_MAF_SP_WF_NEG FORMAT "%5.3"
 /begin AXIS_DESCR COM_AXIS tco _CNV_A_R_LINEAR_____12_CM 8 -48. 142.5 FORMAT "%5.1" AXIS_PTS_REF ldpm_tco_15 /end AXIS_DESCR
/end CHARACTERISTIC
/begin CHARACTERISTIC ip_crlc_pos_maf_sp_wf "correlation constant for air mass flow setpoint triggered wallfilm - positive (MAF_SP increasing)" MAP 0x08d20 _REC_MAP_20_u2_u1_u1 0.99998474 _CNV_A_R_LINEAR_____37_CM 0. 0.99998474 DISPLAY_IDENTIFIER IP_CRLC_POS_MAF_SP_WF FORMAT "%7.6"
 /begin AXIS_DESCR COM_AXIS n_32 _CNV_A_R_LINEAR_____16_CM 8 0. 8160. FORMAT "%4.0" AXIS_PTS_REF ldpm_n_29 /end AXIS_DESCR
 /begin AXIS_DESCR COM_AXIS tco _CNV_A_R_LINEAR_____12_CM 3 -48. 142.5 FORMAT "%5.1" AXIS_PTS_REF ldpm_tco_16 /end AXIS_DESCR
/end CHARACTERISTIC
/begin CHARACTERISTIC ip_crlc_neg_maf_sp_wf "correlation constant for air mass flow setpoint triggered wallfilm - negative (MAF_SP decreasing)" MAP 0x08cf0 _REC_MAP_20_u2_u1_u1 0.99998474 _CNV_A_R_LINEAR_____37_CM 0. 0.99998474 DISPLAY_IDENTIFIER IP_CRLC_NEG_MAF_SP_WF FORMAT "%7.6"
 /begin AXIS_DESCR COM_AXIS n_32 _CNV_A_R_LINEAR_____16_CM 8 0. 8160. FORMAT "%4.0" AXIS_PTS_REF ldpm_n_29 /end AXIS_DESCR
 /begin AXIS_DESCR COM_AXIS tco _CNV_A_R_LINEAR_____12_CM 3 -48. 142.5 FORMAT "%5.1" AXIS_PTS_REF ldpm_tco_16 /end AXIS_DESCR
/end CHARACTERISTIC
/begin CHARACTERISTIC ip_fac_ti_wf "temperature correction for total wallfilm" MAP 0x0550c _REC_MAP_20_u1_u1_u1 1.99220002 _CNV_A_R_LINEAR_____39_CM 0. 1.99220002 DISPLAY_IDENTIFIER IP_FAC_TI_WF FORMAT "%5.3"
 /begin AXIS_DESCR COM_AXIS tco _CNV_A_R_LINEAR_____12_CM 4 -48. 142.5 FORMAT "%5.1" AXIS_PTS_REF ldp_tco__fac_ti_wf /end AXIS_DESCR
 /begin AXIS_DESCR COM_AXIS tia _CNV_A_R_LINEAR_____12_CM 4 -48. 142.5 FORMAT "%5.1" AXIS_PTS_REF ldp_tia__fac_ti_wf /end AXIS_DESCR
/end CHARACTERISTIC
/begin CHARACTERISTIC c_t_ti_tra_pas "time before activation of wall film correction" VALUE 0x018ba _REC_VAL_20_u2 655.35 _CNV_A_R_LINEAR_____4_CM 0. 655.35 DISPLAY_IDENTIFIER C_T_TI_TRA_PAS FORMAT "%6.2" /end CHARACTERISTIC
/begin CHARACTERISTIC c_thd_maf_sp_wf "activation treshold for air mass flow setpoint triggered wallfilm" VALUE 0x0190c _REC_VAL_20_u2 1389. _CNV_A_R_LINEAR_____106_CM 0. 1389. DISPLAY_IDENTIFIER C_THD_MAF_SP_WF FORMAT "%7.2" /end CHARACTERISTIC
/begin AXIS_PTS ldp_tia__fac_ti_wf "" 0x011e7 tia _REC_AXS_20_u1 190.5 _CNV_A_R_LINEAR_____12_CM 4 -48. 142.5 DISPLAY_IDENTIFIER LDP_TIA__FAC_TI_WF FORMAT "%5.1" /end AXIS_PTS
/begin AXIS_PTS ldp_tco__fac_ti_wf "" 0x01145 tco _REC_AXS_20_u1 190.5 _CNV_A_R_LINEAR_____12_CM 4 -48. 142.5 DISPLAY_IDENTIFIER LDP_TCO__FAC_TI_WF FORMAT "%5.1" /end AXIS_PTS
/begin AXIS_PTS ldpm_tco_15 "" 0x0818a tco _REC_AXS_20_u1 190.5 _CNV_A_R_LINEAR_____12_CM 8 -48. 142.5 DISPLAY_IDENTIFIER LDPM_TCO_15 FORMAT "%5.1" /end AXIS_PTS
/begin AXIS_PTS ldpm_tco_16 "" 0x013af tco _REC_AXS_20_u1 190.5 _CNV_A_R_LINEAR_____12_CM 3 -48. 142.5 DISPLAY_IDENTIFIER LDPM_TCO_16 FORMAT "%5.1" /end AXIS_PTS
/begin CHARACTERISTIC ip_ti_crlc_pos_slow_wf__n__tco "slow positive correlation constant" MAP 0x0f55e _REC_MAP_20_u2_u1_u1 0.99998474 _CNV_A_R_LINEAR_____37_CM 0. 0.99998474 DISPLAY_IDENTIFIER IP_TI_CRLC_POS_SLOW_WF__N__TCO FORMAT "%7.6"
 /begin AXIS_DESCR COM_AXIS n_32 _CNV_A_R_LINEAR_____16_CM 8 0. 8160. FORMAT "%4.0" AXIS_PTS_REF ldpm_n_29 /end AXIS_DESCR
 /begin AXIS_DESCR COM_AXIS tco _CNV_A_R_LINEAR_____12_CM 3 -48. 142.5 FORMAT "%5.1" AXIS_PTS_REF ldpm_tco_16 /end AXIS_DESCR
/end CHARACTERISTIC
/begin CHARACTERISTIC ip_ti_crlc_neg_slow_wf__n__tco "slow negative correlation constant" MAP 0x0f4fe _REC_MAP_20_u2_u1_u1 0.99998474 _CNV_A_R_LINEAR_____37_CM 0. 0.99998474 DISPLAY_IDENTIFIER IP_TI_CRLC_NEG_SLOW_WF__N__TCO FORMAT "%7.6"
 /begin AXIS_DESCR COM_AXIS n_32 _CNV_A_R_LINEAR_____16_CM 8 0. 8160. FORMAT "%4.0" AXIS_PTS_REF ldpm_n_29 /end AXIS_DESCR
 /begin AXIS_DESCR COM_AXIS tco _CNV_A_R_LINEAR_____12_CM 3 -48. 142.5 FORMAT "%5.1" AXIS_PTS_REF ldpm_tco_16 /end AXIS_DESCR
/end CHARACTERISTIC
/begin CHARACTERISTIC ip_ti_crlc_pos_fast_wf__n__tco "fast positive correlation constant" MAP 0x0f52e _REC_MAP_20_u2_u1_u1 0.99998474 _CNV_A_R_LINEAR_____37_CM 0. 0.99998474 DISPLAY_IDENTIFIER IP_TI_CRLC_POS_FAST_WF__N__TCO FORMAT "%7.6"
 /begin AXIS_DESCR COM_AXIS n_32 _CNV_A_R_LINEAR_____16_CM 8 0. 8160. FORMAT "%4.0" AXIS_PTS_REF ldpm_n_29 /end AXIS_DESCR
 /begin AXIS_DESCR COM_AXIS tco _CNV_A_R_LINEAR_____12_CM 3 -48. 142.5 FORMAT "%5.1" AXIS_PTS_REF ldpm_tco_16 /end AXIS_DESCR
/end CHARACTERISTIC
/begin CHARACTERISTIC ip_ti_crlc_neg_fast_wf__n__tco "fast negative correlation constant" MAP 0x0f4ce _REC_MAP_20_u2_u1_u1 0.99998474 _CNV_A_R_LINEAR_____37_CM 0. 0.99998474 DISPLAY_IDENTIFIER IP_TI_CRLC_NEG_FAST_WF__N__TCO FORMAT "%7.6"
 /begin AXIS_DESCR COM_AXIS n_32 _CNV_A_R_LINEAR_____16_CM 8 0. 8160. FORMAT "%4.0" AXIS_PTS_REF ldpm_n_29 /end AXIS_DESCR
 /begin AXIS_DESCR COM_AXIS tco _CNV_A_R_LINEAR_____12_CM 3 -48. 142.5 FORMAT "%5.1" AXIS_PTS_REF ldpm_tco_16 /end AXIS_DESCR
/end CHARACTERISTIC
/begin CHARACTERISTIC c_fac_mff_ti_stnd_1 "Injectionvalve characteristic for fuel mass flow to injection time at standard conditions" VALUE 0x01580 _REC_VAL_20_u2 0.37745 _CNV_A_R_LINEAR_____440_CM 0. 0.37745 DISPLAY_IDENTIFIER C_FAC_MFF_TI_STND_1 FORMAT "%7.5" /end CHARACTERISTIC
/begin CHARACTERISTIC c_vls_down_mmv_hys_min "Minimum hysteresis for the computation of the thresholds VLS_DOWN_TOL_i and VLS_DOWN_BOL_i" VALUE 0x01a1a _REC_VAL_20_u2 1. _CNV_A_R_LINEAR_____275_CM 0. 1. DISPLAY_IDENTIFIER C_VLS_DOWN_MMV_HYS_MIN FORMAT "%7.5" /end CHARACTERISTIC
/begin CHARACTERISTIC c_vls_down_ini_min "Lower initialisation value for VLS_DOWN_TOL_i. VLS_DOWN_MMV_MIN_i" VALUE 0x01a10 _REC_VAL_20_u2 4.99511719 _CNV_A_R_LINEAR_____3_CM 0. 4.99511719 DISPLAY_IDENTIFIER C_VLS_DOWN_INI_MIN FORMAT "%5.3" /end CHARACTERISTIC
/begin CHARACTERISTIC c_vls_down_ini_max "Upper initialisation value for VLS_DOWN_BOL_i. VLS_DOWN_MMV_MAX_i" VALUE 0x01a0e _REC_VAL_20_u2 4.99511719 _CNV_A_R_LINEAR_____3_CM 0. 4.99511719 DISPLAY_IDENTIFIER C_VLS_DOWN_INI_MAX FORMAT "%5.3" /end CHARACTERISTIC
/begin CHARACTERISTIC c_vls_down_crlc "Filter constant for determination of VLS_DOWN_MMV_xxx_i values when respective threshold passed" VALUE 0x01a06 _REC_VAL_20_u2 0.99998474 _CNV_A_R_LINEAR_____620_CM 0. 0.99998474 DISPLAY_IDENTIFIER C_VLS_DOWN_CRLC FORMAT "%7.5" /end CHARACTERISTIC
/begin CHARACTERISTIC c_vls_down_crlc_off "Filter constant for determination of VLS_DOWN_MMV_xxx_i values when respective threshold not passed" VALUE 0x01a08 _REC_VAL_20_u2 0.99998474 _CNV_A_R_LINEAR_____620_CM 0. 0.99998474 DISPLAY_IDENTIFIER C_VLS_DOWN_CRLC_OFF FORMAT "%7.5" /end CHARACTERISTIC
/begin CHARACTERISTIC c_fac_vls_down_mmv_hys "Multiplicative factor governing amplitude of hysteresis" VALUE 0x006e6 _REC_VAL_20_u1 0.99610001 _CNV_A_R_LINEAR_____621_CM 0. 0.99610001 DISPLAY_IDENTIFIER C_FAC_VLS_DOWN_MMV_HYS FORMAT "%5.3" /end CHARACTERISTIC
/begin CHARACTERISTIC c_t_dly_puc_end_vls_down "Delay between completion of engine state PUC and computation of VLS_DOWN_MMV_xxx_i" VALUE 0x00806 _REC_VAL_20_u1 25.5 _CNV_A_R_LINEAR_____24_CM 0. 25.5 DISPLAY_IDENTIFIER C_T_DLY_PUC_END_VLS_DOWN FORMAT "%4.1" /end CHARACTERISTIC
/begin COMPU_METHOD _CNV_S_2_RANGE______0_CM "" TAB_VERB "%6.3" "[-]" COMPU_TAB_REF _CNV_S_2_RANGE______0 /end COMPU_METHOD
/begin COMPU_VTAB _CNV_S_2_RANGE______0 "" TAB_VERB 2 0 "0" 1 "1" /end COMPU_VTAB
/begin COMPU_METHOD _CNV_A_R_LINEAR_____1_CM "" RAT_FUNC "%6.3" "-" COEFFS 0 1. 0. 0 0 1 /end COMPU_METHOD
/begin COMPU_METHOD _CNV_A_R_LINEAR_____3_CM "" RAT_FUNC "%6.3" "V" COEFFS 0 204.7999998974999 0. 0 0 1 /end COMPU_METHOD
/begin COMPU_METHOD _CNV_A_R_LINEAR_____4_CM "" RAT_FUNC "%6.3" "s" COEFFS 0 100. 0. 0 0 1 /end COMPU_METHOD
/begin COMPU_METHOD _CNV_S_2_RANGE______5_CM "" TAB_VERB "%6.3" "-" COMPU_TAB_REF _CNV_S_2_RANGE______5 /end COMPU_METHOD
/begin COMPU_VTAB _CNV_S_2_RANGE______5 "" TAB_VERB 2 0 "0" 1 "1" /end COMPU_VTAB
/begin COMPU_METHOD _CNV_A_R_LINEAR_____7_CM "" RAT_FUNC "%6.3" "°C" COEFFS 0 16. 0. 0 0 1 /end COMPU_METHOD
/begin COMPU_METHOD _CNV_A_R_LINEAR_____9_CM "" RAT_FUNC "%6.3" "%" COEFFS 0 655.3600000071681 0. 0 0 1 /end COMPU_METHOD
/begin COMPU_METHOD _CNV_A_R_LINEAR_____10_CM "" RAT_FUNC "%6.3" "%" COEFFS 0 2.56 0. 0 0 1 /end COMPU_METHOD
/begin COMPU_METHOD _CNV_A_R_LINEAR_____11_CM "" RAT_FUNC "%6.3" "rpm" COEFFS 0 1. 0. 0 0 1 /end COMPU_METHOD
/begin COMPU_METHOD _CNV_A_R_LINEAR_____12_CM "" RAT_FUNC "%6.3" "°C" COEFFS 0 1.333333333333333 64. 0 0 1 /end COMPU_METHOD
/begin COMPU_METHOD _CNV_A_R_LINEAR_____16_CM "" RAT_FUNC "%6.3" "rpm" COEFFS 0 3.125e-002 0. 0 0 1 /end COMPU_METHOD
/begin COMPU_METHOD _CNV_A_R_LINEAR_____21_CM "" RAT_FUNC "%6.3" "-" COEFFS 0 32768.00003968061 0. 0 0 1 /end COMPU_METHOD
/begin COMPU_METHOD _CNV_A_R_LINEAR_____22_CM "" RAT_FUNC "%6.3" "[-]" COEFFS 0 1. 0. 0 0 1 /end COMPU_METHOD
/begin COMPU_METHOD _CNV_A_R_LINEAR_____23_CM "" RAT_FUNC "%6.3" "km/h" COEFFS 0 1. 0. 0 0 1 /end COMPU_METHOD
/begin COMPU_METHOD _CNV_A_R_LINEAR_____24_CM "" RAT_FUNC "%6.3" "s" COEFFS 0 10. 0. 0 0 1 /end COMPU_METHOD
/begin COMPU_METHOD _CNV_A_R_LINEAR_____27_CM "" RAT_FUNC "%6.3" "mg/stk" COEFFS 0 0.183585313174946 0. 0 0 1 /end COMPU_METHOD
/begin COMPU_METHOD _CNV_A_R_LINEAR_____29_CM "" RAT_FUNC "%6.3" "-" COEFFS 0 255.9983911655618 0. 0 0 1 /end COMPU_METHOD
/begin COMPU_METHOD _CNV_A_R_LINEAR_____30_CM "" RAT_FUNC "%6.3" "s" COEFFS 0 1. 0. 0 0 1 /end COMPU_METHOD
/begin COMPU_METHOD _CNV_A_R_LINEAR_____34_CM "" RAT_FUNC "%6.3" "V" COEFFS 0 9.846168103048838 0. 0 0 1 /end COMPU_METHOD
/begin COMPU_METHOD _CNV_A_R_LINEAR_____37_CM "" RAT_FUNC "%6.3" "-" COEFFS 0 65536.00007936121 0. 0 0 1 /end COMPU_METHOD
/begin COMPU_METHOD _CNV_A_R_LINEAR_____39_CM "" RAT_FUNC "%6.3" "-" COEFFS 0 127.9991955827809 0. 0 0 1 /end COMPU_METHOD
/begin COMPU_METHOD _CNV_A_R_LINEAR_____50_CM "" RAT_FUNC "%6.3" "[-]" COEFFS 0 255.9999357490357 0. 0 0 1 /end COMPU_METHOD
/begin COMPU_METHOD _CNV_A_R_LINEAR_____82_CM "" RAT_FUNC "%6.3" "°CRK" COEFFS 0 2.666666666666667 0. 0 0 1 /end COMPU_METHOD
/begin COMPU_METHOD _CNV_A_R_LINEAR_____106_CM "" RAT_FUNC "%6.3" "mg/stk" COEFFS 0 47.18142548596112 0. 0 0 1 /end COMPU_METHOD
/begin COMPU_METHOD _CNV_A_R_LINEAR_____109_CM "" RAT_FUNC "%6.3" "%" COEFFS 0 655.3600000071681 3.584063961170614e-007 0 0 1 /end COMPU_METHOD
/begin COMPU_METHOD _CNV_A_R_LINEAR_____113_CM "" RAT_FUNC "%6.3" "kg/h" COEFFS 0 32. 0. 0 0 1 /end COMPU_METHOD
/begin COMPU_METHOD _CNV_A_R_LINEAR_____115_CM "" RAT_FUNC "%6.3" "-" COEFFS 0 128. 0. 0 0 1 /end COMPU_METHOD
/begin COMPU_METHOD _CNV_A_R_LINEAR_____125_CM "" RAT_FUNC "%6.3" "-" COEFFS 0 16383.75 0. 0 0 1 /end COMPU_METHOD
/begin COMPU_METHOD _CNV_A_R_LINEAR_____127_CM "" RAT_FUNC "%6.3" "[-]" COEFFS 0 64. 0. 0 0 1 /end COMPU_METHOD
/begin COMPU_METHOD _CNV_A_R_LINEAR_____157_CM "" RAT_FUNC "%6.3" "-" COEFFS 0 64. 0. 0 0 1 /end COMPU_METHOD
/begin COMPU_METHOD _CNV_A_R_LINEAR_____164_CM "" RAT_FUNC "%6.3" "-" COEFFS 0 1023.999999919998 0. 0 0 1 /end COMPU_METHOD
/begin COMPU_METHOD _CNV_A_R_LINEAR_____177_CM "" RAT_FUNC "%6.3" "°C" COEFFS 0 0.25 8.25 0 0 1 /end COMPU_METHOD
/begin COMPU_METHOD _CNV_A_R_LINEAR_____184_CM "" RAT_FUNC "%6.3" "Seg" COEFFS 0 1. 0. 0 0 1 /end COMPU_METHOD
/begin COMPU_METHOD _CNV_A_R_LINEAR_____186_CM "" RAT_FUNC "%6.3" "Nm" COEFFS 0 32. 32768. 0 0 1 /end COMPU_METHOD
/begin COMPU_METHOD _CNV_A_R_LINEAR_____197_CM "" RAT_FUNC "%6.3" "s" COEFFS 0 50. 0. 0 0 1 /end COMPU_METHOD
/begin COMPU_METHOD _CNV_A_R_LINEAR_____198_CM "" RAT_FUNC "%6.3" "ms" COEFFS 0 250. 0. 0 0 1 /end COMPU_METHOD
/begin COMPU_METHOD _CNV_A_R_LINEAR_____199_CM "" RAT_FUNC "%6.3" "hPa" COEFFS 0 0.3768805207949945 0. 0 0 1 /end COMPU_METHOD
/begin COMPU_METHOD _CNV_A_R_LINEAR_____250_CM "" RAT_FUNC "%6.3" "V" COEFFS 0 13107.19998965744 0. 0 0 1 /end COMPU_METHOD
/begin COMPU_METHOD _CNV_A_R_LINEAR_____255_CM "" RAT_FUNC "%6.3" "mg/stk" COEFFS 0 47.18214541280769 -1.080506262951531e-005 0 0 1 /end COMPU_METHOD
/begin COMPU_METHOD _CNV_A_R_LINEAR_____260_CM "" RAT_FUNC "%6.3" "-" COEFFS 0 256. 0. 0 0 1 /end COMPU_METHOD
/begin COMPU_METHOD _CNV_A_R_LINEAR_____261_CM "" RAT_FUNC "%6.3" "ms" COEFFS 0 51.20321900148448 0. 0 0 1 /end COMPU_METHOD
/begin COMPU_METHOD _CNV_A_R_LINEAR_____262_CM "" RAT_FUNC "%6.3" "°C" COEFFS 0 43.47840509520334 2086.96344456976 0 0 1 /end COMPU_METHOD
/begin COMPU_METHOD _CNV_A_R_LINEAR_____264_CM "" RAT_FUNC "%6.3" "-" COEFFS 0 16383.75 32767.5 0 0 1 /end COMPU_METHOD
/begin COMPU_METHOD _CNV_A_R_LINEAR_____265_CM "" RAT_FUNC "%6.3" "-" COEFFS 0 16383.99999935999 -1.280019205296412e-006 0 0 1 /end COMPU_METHOD
/begin COMPU_METHOD _CNV_A_R_LINEAR_____266_CM "" RAT_FUNC "%6.3" "[-]" COEFFS 0 1023.999999959999 32767.99999871998 0 0 1 /end COMPU_METHOD
/begin COMPU_METHOD _CNV_A_R_LINEAR_____267_CM "" RAT_FUNC "%6.3" "°C" COEFFS 0 43.47826086956522 0. 0 0 1 /end COMPU_METHOD
/begin COMPU_METHOD _CNV_A_R_LINEAR_____268_CM "" RAT_FUNC "%6.3" "s" COEFFS 0 2. 0. 0 0 1 /end COMPU_METHOD
/begin COMPU_METHOD _CNV_A_R_LINEAR_____271_CM "" RAT_FUNC "%6.3" "g" COEFFS 0 36.00036915004301 0. 0 0 1 /end COMPU_METHOD
/begin COMPU_METHOD _CNV_A_R_LINEAR_____272_CM "" RAT_FUNC "%6.3" "ms" COEFFS 0 51.19999999799997 -1.280015567317605e-006 0 0 1 /end COMPU_METHOD
/begin COMPU_METHOD _CNV_A_R_LINEAR_____273_CM "" RAT_FUNC "%6.3" "ms" COEFFS 0 12.8 0. 0 0 1 /end COMPU_METHOD
/begin COMPU_METHOD _CNV_A_R_LINEAR_____274_CM "" RAT_FUNC "%6.3" "ms" COEFFS 0 2.133333333333333 0. 0 0 1 /end COMPU_METHOD
/begin COMPU_METHOD _CNV_A_R_LINEAR_____275_CM "" RAT_FUNC "%6.3" "V" COEFFS 0 13107. 0. 0 0 1 /end COMPU_METHOD
/begin COMPU_METHOD _CNV_A_R_LINEAR_____276_CM "" RAT_FUNC "%6.3" "V/10ms" COEFFS 0 13107.26214524291 0.1553631072602002 0 0 1 /end COMPU_METHOD
/begin COMPU_METHOD _CNV_A_R_LINEAR_____277_CM "" RAT_FUNC "%6.3" "V/10ms" COEFFS 0 13107.20001587224 0. 0 0 1 /end COMPU_METHOD
/begin COMPU_METHOD _CNV_A_R_LINEAR_____279_CM "" RAT_FUNC "%6.3" "ohm" COEFFS 0 1. 0. 0 0 1 /end COMPU_METHOD
/begin COMPU_METHOD _CNV_A_R_LINEAR_____280_CM "" RAT_FUNC "%6.3" "°C" COEFFS 0 15.99999804684544 -4.000060547696194e-003 0 0 1 /end COMPU_METHOD
/begin COMPU_METHOD _CNV_A_R_LINEAR_____283_CM "" RAT_FUNC "%6.3" "°C" COEFFS 0 15.99975585564965 0. 0 0 1 /end COMPU_METHOD
/begin COMPU_METHOD _CNV_S_6_STATE_LSH__284_CM "" TAB_VERB "%6.3" "[-]" COMPU_TAB_REF _CNV_S_6_STATE_LSH__284 /end COMPU_METHOD
/begin COMPU_VTAB _CNV_S_6_STATE_LSH__284 "" TAB_VERB 6 0 "LSH_OFF_DOWN" 1 "PREHEATING_DOWN" 2 "LSH_POW_RED_DOWN" 3 "HEATING_GRD_DOWN" 4 "HEATING_DOWN" 5 "VB_PROTECTION_DOWN" /end COMPU_VTAB
/begin COMPU_METHOD _CNV_S_7_STATE_LSH__293_CM "" TAB_VERB "%6.3" "[-]" COMPU_TAB_REF _CNV_S_7_STATE_LSH__293 /end COMPU_METHOD
/begin COMPU_VTAB _CNV_S_7_STATE_LSH__293 "" TAB_VERB 7 0 "LSH_OFF" 1 "LSH_POW_RISE" 2 "LSH_POW_RED" 3 "LSH_POW_FALL" 4 "LSH_POW_CTL" 5 "LSH_VB_PROT" 6 "LSH_TEMP_PROT" /end COMPU_VTAB
/begin COMPU_METHOD _CNV_A_R_LINEAR_____294_CM "" RAT_FUNC "%6.3" "V" COEFFS 0 2520.615410935313 0. 0 0 1 /end COMPU_METHOD
/begin COMPU_METHOD _CNV_A_R_LINEAR_____295_CM "" RAT_FUNC "%6.3" "V" COEFFS 0 9.807692307692308 -9.615384615372591e-003 0 0 1 /end COMPU_METHOD
/begin COMPU_METHOD _CNV_A_R_LINEAR_____296_CM "" RAT_FUNC "%6.3" "V" COEFFS 0 2510.919540229885 -0.499999999996362 0 0 1 /end COMPU_METHOD
/begin COMPU_METHOD _CNV_A_R_LINEAR_____297_CM "" RAT_FUNC "%6.3" "-" COEFFS 0 16383.96875 0. 0 0 1 /end COMPU_METHOD
/begin COMPU_METHOD _CNV_A_R_LINEAR_____301_CM "" RAT_FUNC "%6.3" "%/s" COEFFS 0 0.1024000000600009 0. 0 0 1 /end COMPU_METHOD
/begin COMPU_METHOD _CNV_A_R_LINEAR_____305_CM "" RAT_FUNC "%6.3" "-" COEFFS 0 100. 0. 0 0 1 /end COMPU_METHOD
/begin COMPU_METHOD _CNV_A_R_LINEAR_____307_CM "" RAT_FUNC "%6.3" "-" COEFFS 0 33097.9797979798 -329.979797979795 0 0 1 /end COMPU_METHOD
/begin COMPU_METHOD _CNV_A_R_LINEAR_____308_CM "" RAT_FUNC "%6.3" "mg" COEFFS 0 6.25 0. 0 0 1 /end COMPU_METHOD
/begin COMPU_METHOD _CNV_A_R_LINEAR_____309_CM "" RAT_FUNC "%6.3" "-" COEFFS 0 16383.99985599781 0. 0 0 1 /end COMPU_METHOD
/begin COMPU_METHOD _CNV_A_R_LINEAR_____310_CM "" RAT_FUNC "%6.3" "[-]" COEFFS 0 1024.000014000427 16384.00022400684 0 0 1 /end COMPU_METHOD
/begin COMPU_METHOD _CNV_A_R_LINEAR_____311_CM "" RAT_FUNC "%6.3" "ms" COEFFS 0 51.19999998999985 32767.9999935999 0 0 1 /end COMPU_METHOD
/begin COMPU_METHOD _CNV_A_R_LINEAR_____312_CM "" RAT_FUNC "%6.3" "V" COEFFS 0 204.8979314017341 1023.5 0 0 1 /end COMPU_METHOD
/begin COMPU_METHOD _CNV_A_R_LINEAR_____313_CM "" RAT_FUNC "%6.3" "-" COEFFS 0 63.60176282051283 0. 0 0 1 /end COMPU_METHOD
/begin COMPU_METHOD _CNV_A_R_LINEAR_____314_CM "" RAT_FUNC "%6.3" "%/s" COEFFS 0 0.1024000154202376 0. 0 0 1 /end COMPU_METHOD
/begin COMPU_METHOD _CNV_A_R_LINEAR_____315_CM "" RAT_FUNC "%6.3" "%/s" COEFFS 0 0.1024028382518949 128. 0 0 1 /end COMPU_METHOD
/begin COMPU_METHOD _CNV_A_R_LINEAR_____321_CM "" RAT_FUNC "%6.3" "°C" COEFFS 0 15.99999804684544 32767.99599993945 0 0 1 /end COMPU_METHOD
/begin COMPU_METHOD _CNV_A_R_LINEAR_____322_CM "" RAT_FUNC "%6.3" "V/K" COEFFS 0 1000. 0. 0 0 1 /end COMPU_METHOD
/begin COMPU_METHOD _CNV_A_R_LINEAR_____323_CM "" RAT_FUNC "%6.3" "V/100ms" COEFFS 0 156.9230769230769 0. 0 0 1 /end COMPU_METHOD
/begin COMPU_METHOD _CNV_A_R_LINEAR_____324_CM "" RAT_FUNC "%6.3" "-" COEFFS 0 40.17013232514178 0. 0 0 1 /end COMPU_METHOD
/begin COMPU_METHOD _CNV_A_R_LINEAR_____378_CM "" RAT_FUNC "%6.3" "-" COEFFS 0 2048. 0. 0 0 1 /end COMPU_METHOD
/begin COMPU_METHOD _CNV_A_R_LINEAR_____388_CM "" RAT_FUNC "%6.3" "-" COEFFS 0 2. 0. 0 0 1 /end COMPU_METHOD
/begin COMPU_METHOD _CNV_A_R_LINEAR_____437_CM "" RAT_FUNC "%6.3" "-" COEFFS 0 4095.999999839998 0. 0 0 1 /end COMPU_METHOD
/begin COMPU_METHOD _CNV_A_R_LINEAR_____439_CM "" RAT_FUNC "%6.3" "ms" COEFFS 0 250. 32768. 0 0 1 /end COMPU_METHOD
/begin COMPU_METHOD _CNV_A_R_LINEAR_____440_CM "" RAT_FUNC "%6.3" "ms/(mg/stk)" COEFFS 0 173625.6457808981 0. 0 0 1 /end COMPU_METHOD
/begin COMPU_METHOD _CNV_A_R_LINEAR_____489_CM "" RAT_FUNC "%6.3" "-" COEFFS 0 0.5 0. 0 0 1 /end COMPU_METHOD
/begin COMPU_METHOD _CNV_A_R_LINEAR_____620_CM "" RAT_FUNC "%6.3" "V" COEFFS 0 65536.00007936121 0. 0 0 1 /end COMPU_METHOD
/begin COMPU_METHOD _CNV_A_R_LINEAR_____621_CM "" RAT_FUNC "%6.3" "V" COEFFS 0 255.9983911655618 0. 0 0 1 /end COMPU_METHOD
/begin RECORD_LAYOUT _REC_VAL_20_u1 FNC_VALUES 1 UBYTE COLUMN_DIR DIRECT /end RECORD_LAYOUT
/begin RECORD_LAYOUT _REC_VAL_20_u2 FNC_VALUES 1 UWORD COLUMN_DIR DIRECT /end RECORD_LAYOUT
/begin RECORD_LAYOUT _REC_CUR_20_u2_u1 FNC_VALUES 1 UWORD COLUMN_DIR DIRECT /end RECORD_LAYOUT
/begin RECORD_LAYOUT _REC_AXS_20_u1 NO_AXIS_PTS_X 1 UBYTE AXIS_PTS_X 2 UBYTE INDEX_INCR DIRECT /end RECORD_LAYOUT
/begin RECORD_LAYOUT _REC_MAP_20_u1_u1_u1 FNC_VALUES 1 UBYTE COLUMN_DIR DIRECT /end RECORD_LAYOUT
/begin RECORD_LAYOUT _REC_CUR_20_u1_u1 FNC_VALUES 1 UBYTE COLUMN_DIR DIRECT /end RECORD_LAYOUT
/begin RECORD_LAYOUT _REC_AXS_20_u2 NO_AXIS_PTS_X 1 UWORD AXIS_PTS_X 2 UWORD INDEX_INCR DIRECT /end RECORD_LAYOUT
/begin RECORD_LAYOUT _REC_MAP_20_u1_u1_u2 FNC_VALUES 1 UBYTE COLUMN_DIR DIRECT /end RECORD_LAYOUT
/begin RECORD_LAYOUT _REC_MAP_20_u2_u2_u1 FNC_VALUES 1 UWORD COLUMN_DIR DIRECT /end RECORD_LAYOUT
/begin RECORD_LAYOUT _REC_CUR_20_u1_u2 FNC_VALUES 1 UBYTE COLUMN_DIR DIRECT /end RECORD_LAYOUT
/begin RECORD_LAYOUT _REC_MAP_20_u2_u1_u1 FNC_VALUES 1 UWORD COLUMN_DIR DIRECT /end RECORD_LAYOUT
/begin RECORD_LAYOUT _REC_CUR_20_u2_u2 FNC_VALUES 1 UWORD COLUMN_DIR DIRECT /end RECORD_LAYOUT
/begin RECORD_LAYOUT _REC_VAL_20_s1 FNC_VALUES 1 SBYTE COLUMN_DIR DIRECT /end RECORD_LAYOUT
/begin RECORD_LAYOUT _REC_VAL_20_s2 FNC_VALUES 1 SWORD COLUMN_DIR DIRECT /end RECORD_LAYOUT
/begin RECORD_LAYOUT _REC_MAP_20_u2_u1_u2 FNC_VALUES 1 UWORD COLUMN_DIR DIRECT /end RECORD_LAYOUT
/begin RECORD_LAYOUT _REC_MAP_20_u2_u2_u2 FNC_VALUES 1 UWORD COLUMN_DIR DIRECT /end RECORD_LAYOUT
/begin FUNCTION INJ_Catalyst_heating_correction "_Catalyst heating correction" /begin DEF_CHARACTERISTIC ip_lamb_add_afl_ch ip_lamb_ch_rgl ip_lamb_ch_is /end DEF_CHARACTERISTIC /begin OUT_MEASUREMENT lamb_ch lamb_afl_ch /end OUT_MEASUREMENT /end FUNCTION
/begin FUNCTION INJ_High_torque_request_enrichme "_High torque request enrichment" /begin DEF_CHARACTERISTIC c_lamb_fl_pas ip_lamb_fl__n /end DEF_CHARACTERISTIC /begin OUT_MEASUREMENT lamb_fl /end OUT_MEASUREMENT /end FUNCTION
/begin FUNCTION INJ_Wall_film_correction_TI_ADD_ "_Wall film correction TI_ADD_WF"
 /begin DEF_CHARACTERISTIC c_fac_wf_puc c_ti_crlc_fast_wf_is ip_seg_ctr_fac_wf__seg_ctr_wf ip_ti_dif_wf_thd__tco ip_ti_fac_neg_fast_wf__n__maf ip_ti_fac_neg_slow_wf__n__maf ip_ti_fac_pos_slow_wf__n__maf ip_ti_fast_wf_thd__tib ip_ti_slow_wf_thd__tib ip_ti_tco_neg_fast_wf__n__tco ip_ti_tco_neg_slow_wf__n__tco ip_ti_tco_pos_fast_wf__n__tco ip_ti_tco_pos_slow_wf__n__tco ip_ti_tco_st_fac_wf__tco_st ip_ti_vo_fast_wf__vo c_fac_wf_pu ip_ti_fac_pos_fast_wf__n__maf c_seg_ctr_wf_ini ip_ti_vo_slow_wf__vo ip_ti_vo_maf_sp_wf__vo ip_ti_cor_maf_sp_wf ip_fac_ti_cor_maf_sp_wf_pos ip_fac_ti_cor_maf_sp_wf_neg ip_crlc_pos_maf_sp_wf ip_crlc_neg_maf_sp_wf ip_fac_ti_wf c_t_ti_tra_pas c_thd_maf_sp_wf ip_ti_crlc_pos_slow_wf__n__tco ip_ti_crlc_neg_slow_wf__n__tco ip_ti_crlc_pos_fast_wf__n__tco ip_ti_crlc_neg_fast_wf__n__tco /end DEF_CHARACTERISTIC
 /begin OUT_MEASUREMENT tib mff_add_wf ti_add_reac[0] ti_add_reac[1] ti_add_reac[2] ti_add_reac[3] ti_add_reac[4] ti_add_reac[5] seg_ctr_wf ti_add_wf ti_fast_wf_post_thd ti_slow_wf_post_thd ti_maf_sp_wf /end OUT_MEASUREMENT
/end FUNCTION
/begin FUNCTION INJ_Cylinder_shut_off "_Cylinder shut off" /begin DEF_CHARACTERISTIC id_pat_ind__nr_pat /end DEF_CHARACTERISTIC
 /begin OUT_MEASUREMENT lv_scc inh_cyc_iv inh_iv_igk inh_swi_iv lv_inj_cut lv_ind_fcut inh_iv_fcut inh_iv inh_iv_mon_cut_off inh_iv_kwp lam_bank_1.inj_iv_cut.lv_scc lam_bank_2.inj_iv_cut.lv_scc inh_iv_amt /end OUT_MEASUREMENT
/end FUNCTION
/begin FUNCTION INJ_Upstream_oxygen_sensor_signa "_Upstream oxygen sensor signal voltage VLS"
 /begin DEF_CHARACTERISTIC c_maf_int_puc_up_ls id_t_max_ls c_vls_afr c_vls_ini_max c_vls_ini_min c_vls_crlc_off c_ctr_vls_up_afl_cyc_min ip_t_afl_lock c_fac_vls_up_mmv_hys c_vls_up_mmv_hys_min c_vls_crlc c_vls_afl /end DEF_CHARACTERISTIC
 /begin OUT_MEASUREMENT lam_bank_1.ls_ready.bf.lv_up_ls lam_bank_1.ls_ready.bf.lv_up_ls_cdn lam_bank_1.ls_up.bf.lv_afl lam_bank_1.ls_up.bf.lv_vls_up_mmv_lmt lam_bank_1.ls_up.bf.lv_vls_up_mmv_stk_vld lam_bank_1.ls_up.ctr_vls_afl_cyc lam_bank_1.ls_up.drv1_vls_up_abs_max lam_bank_1.ls_up.drv1_vls_up_mmv lam_bank_1.ls_up.drv1_vls_up_mmv_min lam_bank_1.ls_up.t_afl_lock lam_bank_1.ls_up.t_vls_cyc_afl lam_bank_1.ls_up.t_vls_cyc_afl_hld lam_bank_1.ls_up.t_vls_cyc_afr lam_bank_1.ls_up.vls_bol lam_bank_1.ls_up.vls_mmv_max lam_bank_1.ls_up.vls_mmv_min lam_bank_1.ls_up.vls_tol lam_bank_2.ls_ready.bf.lv_up_ls lam_bank_2.ls_ready.bf.lv_up_ls_cdn lam_bank_2.ls_up.bf.lv_afl lam_bank_2.ls_up.bf.lv_vls_up_mmv_lmt lam_bank_2.ls_up.bf.lv_vls_up_mmv_stk_vld lam_bank_2.ls_up.ctr_vls_afl_cyc lam_bank_2.ls_up.drv1_vls_up_abs_max lam_bank_2.ls_up.drv1_vls_up_mmv lam_bank_2.ls_up.drv1_vls_up_mmv_min lam_bank_2.ls_up.t_afl_lock lam_bank_2.ls_up.t_vls_cyc_afl lam_bank_2.ls_up.t_vls_cyc_afl_hld lam_bank_2.ls_up.t_vls_cyc_afr lam_bank_2.ls_up.vls_bol lam_bank_2.ls_up.vls_mmv_max lam_bank_2.ls_up.vls_mmv_min lam_bank_2.ls_up.vls_tol /end OUT_MEASUREMENT
/end FUNCTION
/begin FUNCTION INJ_Upstream_oxygen_sensor_heate "_Upstream oxygen sensor heater managment LSH"
 /begin DEF_CHARACTERISTIC ip_t_lsh_temp_thd ip_fac_neg_p_lsh_up_ctl ip_fac_pos_p_lsh_up_ctl ip_fac_neg_i_lsh_up_ctl ip_fac_pos_i_lsh_up_ctl ip_fac_v_efc_teg c_v_efc_lsh_up_tol c_v_efc_red c_v_efc_lsh_up_prot c_t_lsh_up_tol c_v_efc_lsh_up_lim c_vb_prot_max c_t_lsh_rise c_inc_v_efc c_fac_v_efc_lsh_up_as c_dec_v_efc ip_v_efc_lsh_up_ini c_v_efc_lsh_up_step c_v_efc_lsh_up_as c_t_lsh_up_lim c_t_lsh_up_max_step c_v_efc_lsh_up_max c_v_efc_lsh_up_max_st c_ttip_ls_up_set_1 c_ttip_ls_up_set_2 c_ttip_ls_up_dif_min_p_add c_fac_p_lsh_up_ctl c_fac_i_lsh_up_ctl c_teg_cat_up_mdl_max_lsh_up lc_inh_lsh_up_cll_ctl_1 lc_inh_lsh_up_cll_ctl_2 ip_v_efc_lsh_up_ctl lc_lsh_up_cll_ctl_2 lc_ttip_ls_up_mes_vld_1 lc_ttip_ls_up_mes_vld_2 lc_lsh_up_cll_ctl_1 /end DEF_CHARACTERISTIC
 /begin OUT_MEASUREMENT lam_bank_1.lsh_up_inci.lv_inh_lsh_up lam_bank_1.lsh_up_inci.lv_inh_lsh_up_cll_ctl lam_bank_1.lsh_up_inci.lv_ttip_ls_up_mes_vld lam_bank_1.lsh_up_inci.lv_v_temp_ls_up_ref_vld lam_bank_1.lsh_up_inci.temp_ls_ini lam_bank_1.lsh_up.bf.lv_lsh_up_cll_ctl lam_bank_1.lsh_up.bf.lv_v_efc_lsh_up_lim_bol lam_bank_1.lsh_up.bf.lv_v_efc_lsh_up_lim_tol lam_bank_1.lsh_up.bf.lv_v_efc_lsh_up_lim_max lam_bank_1.lsh_up.bf.lv_pow_ctl_act lam_bank_1.lsh_up.t_lsh_up lam_bank_1.lsh_up.lshpwm_up lam_bank_1.lsh_up.v_efc_lsh_up lam_bank_1.lsh_up.t_lsh_up_tol lam_bank_1.lsh_up.t_lsh_up_lim lam_bank_1.lsh_up.state_lsh_up lam_bank_1.lsh_up.v_efc_lsh_up_clc lam_bank_1.lsh_up.v_efc_lsh_up_ctl_add lam_bank_1.lsh_up.v_efc_lsh_up_ctl_p_add lam_bank_1.lsh_up.v_efc_lsh_up_ctl_i_add lam_bank_1.lsh_up.ttip_ls_up_dif_set_mes lam_bank_2.lsh_up_inci.lv_inh_lsh_up lam_bank_2.lsh_up_inci.lv_inh_lsh_up_cll_ctl lam_bank_2.lsh_up_inci.lv_ttip_ls_up_mes_vld lam_bank_2.lsh_up_inci.lv_v_temp_ls_up_ref_vld lam_bank_2.lsh_up_inci.temp_ls_ini lam_bank_2.lsh_up.bf.lv_lsh_up_cll_ctl lam_bank_2.lsh_up.bf.lv_v_efc_lsh_up_lim_bol lam_bank_2.lsh_up.bf.lv_v_efc_lsh_up_lim_tol lam_bank_2.lsh_up.bf.lv_v_efc_lsh_up_lim_max lam_bank_2.lsh_up.bf.lv_pow_ctl_act lam_bank_2.lsh_up.t_lsh_up lam_bank_2.lsh_up.lshpwm_up lam_bank_2.lsh_up.v_efc_lsh_up lam_bank_2.lsh_up.t_lsh_up_tol lam_bank_2.lsh_up.t_lsh_up_lim lam_bank_2.lsh_up.state_lsh_up lam_bank_2.lsh_up.v_efc_lsh_up_clc lam_bank_2.lsh_up.v_efc_lsh_up_ctl_add lam_bank_2.lsh_up.v_efc_lsh_up_ctl_p_add lam_bank_2.lsh_up.v_efc_lsh_up_ctl_i_add lam_bank_2.lsh_up.ttip_ls_up_dif_set_mes lv_v_efc_lsh_up_prot /end OUT_MEASUREMENT
/end FUNCTION
/begin FUNCTION INJ_Lambda_control_A_F_Feedback_ "_Lambda control A/F Feedback Loop"
 /begin DEF_CHARACTERISTIC c_lam_n_min id_tco_lam_min_is__tco_st id_tco_lam_min__tco_st id_t_min_lscl /end DEF_CHARACTERISTIC
 /begin OUT_MEASUREMENT lam_bank_1.lam_up.bf.lv_lscl lam_bank_1.lam_up.bf.lv_lscl_cat_purge lam_bank_1.lam_up.bf.lv_lam_once_act lam_bank_2.lam_up.bf.lv_lscl lam_bank_2.lam_up.bf.lv_lscl_cat_purge lam_bank_2.lam_up.bf.lv_lam_once_act lv_lam_tco_lscl lv_t_min_lscl /end OUT_MEASUREMENT
/end FUNCTION
/begin FUNCTION INJ_Lambda_control_correction_TI "_Lambda control correction TI_LAM_COR"
 /begin DEF_CHARACTERISTIC c_lam_fac_i c_lam_fac_p c_lam_ini_min c_lam_min c_lam_max c_lam_ini_max c_lam_mv_lpf_crlc ip_lam_neg_p c_lam_sum_p_is c_cl_max_lam_is ip_lam_pos_p ip_lam_pos_p_is ip_lam_neg_p_is ip_lam_i_is_2 ip_lam_i_is_1 ip_lam_i_1 ip_lam_i_2 ip_t_lam_dly_pos_at_2 ip_t_lam_dly_neg_at_2 ip_t_lam_dly_neg_at_1 ip_t_lam_dly_pos_mt_1 ip_t_lam_dly_pos_mt_2 ip_t_lam_dly_neg_mt_2 ip_t_lam_dly_neg_mt_1 ip_t_lam_dly_pos_at_1 ip_t_lam_dly_pos_is_at_2 ip_t_lam_dly_neg_is_at_2 ip_t_lam_dly_neg_is_at_1 ip_t_lam_dly_pos_is_at_1 ip_t_lam_dly_pos_is_mt_1 ip_t_lam_dly_pos_is_mt_2 ip_t_lam_dly_neg_is_mt_2 ip_t_lam_dly_neg_is_mt_1 ip_t_lam_dly_neg_tco ip_t_lam_dly_pos_tco ip_t_lam_dly_pos_teg_cat ip_t_lam_dly_neg_teg_cat ip_crlc_lam_mv_lpf_cp c_maf_dyw c_n_dyw c_lam_mv_dyw c_lam_cycnr /end DEF_CHARACTERISTIC
 /begin OUT_MEASUREMENT lam_bank_1.lam_up.bf.lv_lam_lim_max lam_bank_1.lam_up.bf.lv_lam_lim_min lam_bank_1.lam_up.bf.lv_lam_dyw lam_bank_1.lam_up.bf.lv_n_maf_dyw lam_bank_1.lam_up.bf.lv_lam_adj_ad_end lam_bank_1.lam_up.bf.lv_lscl_inh_err lam_bank_1.lam_up.lam lam_bank_1.lam_up.lam_mv lam_bank_1.lam_up.lam_mv_lpf lam_bank_1.lam_up.lam_p_ctr lam_bank_1.lam_up.t_lam_dly_neg lam_bank_1.lam_up.t_lam_dly_pos lam_bank_1.lam_up.ti_lam_max lam_bank_1.lam_up.ti_lam_min lam_bank_1.lam_up.ti_lam_cor lam_bank_1.lam_up.t_lam_dly_pos_bas lam_bank_1.lam_up.t_lam_dly_neg_bas lam_bank_1.lam_up.lam_mv_lpf_cp lam_bank_1.lam_up.maf_dyw lam_bank_1.lam_up.n_dyw lam_bank_1.lam_up.lam_mv_dyw lam_bank_2.lam_up.bf.lv_lam_lim_max lam_bank_2.lam_up.bf.lv_lam_lim_min lam_bank_2.lam_up.bf.lv_lam_dyw lam_bank_2.lam_up.bf.lv_n_maf_dyw lam_bank_2.lam_up.bf.lv_lam_adj_ad_end lam_bank_2.lam_up.bf.lv_lscl_inh_err lam_bank_2.lam_up.lam lam_bank_2.lam_up.lam_mv lam_bank_2.lam_up.lam_mv_lpf lam_bank_2.lam_up.lam_p_ctr lam_bank_2.lam_up.t_lam_dly_neg lam_bank_2.lam_up.t_lam_dly_pos lam_bank_2.lam_up.ti_lam_max lam_bank_2.lam_up.ti_lam_min lam_bank_2.lam_up.ti_lam_cor lam_bank_2.lam_up.t_lam_dly_pos_bas lam_bank_2.lam_up.t_lam_dly_neg_bas lam_bank_2.lam_up.lam_mv_lpf_cp lam_bank_2.lam_up.maf_dyw lam_bank_2.lam_up.n_dyw lam_bank_2.lam_up.lam_mv_dyw /end OUT_MEASUREMENT
/end FUNCTION
/begin FUNCTION INJ_Application_incidence_for_th "_Application incidence for the lambda Adaptation" /begin DEF_CHARACTERISTIC c_maf_mff_ad_max c_tia_mff_ad_max c_tco_mff_ad_min /end DEF_CHARACTERISTIC /begin OUT_MEASUREMENT lv_mff_ad_act_1 lv_mff_ad_act_2 /end OUT_MEASUREMENT /end FUNCTION
/begin FUNCTION INJ_Downstream_fuel_trim_regulat "_Downstream fuel trim regulation by LAM - P - Jump delay time"
 /begin DEF_CHARACTERISTIC c_cat_diag_max_dly c_maf_int_min_dly c_lam_temp_min_cat_dly c_n_lam_dly_p_max c_n_lam_dly_p_min c_maf_lam_dly_p_max c_maf_lam_dly_p_min ip_fac_dly_p__maf_kgh ip_maf_lam_dly_i_min__n ip_fac_lam_dly__n__maf ip_crlc_dly_i__maf_kgh ip_maf_lam_dly_i_max__n ip_vls_sp_dly__n__maf ip_t_dly_i_1__vls_dif_dly ip_t_dly_i_2__vls_dif_dly c_crlc_dly_ad c_crlc_dly_i_mv ip_fac_cat_dly_1__cat_diag ip_fac_cat_dly_2__cat_diag c_t_dly_i_mv_upd_cyc ip_t_dly_p_1__vls_dif_dly ip_t_dly_p_2__vls_dif_dly c_t_dly_i_min c_t_dly_ad_min c_t_dly_i_max c_t_dly_ad_max c_maf_int_min_dly_puc /end DEF_CHARACTERISTIC
 /begin OUT_MEASUREMENT lam_bank_1.lam_dly.bf.lv_delta_lamb lam_bank_1.lam_dly.bf.lv_lam_dly_per_vld lam_bank_1.lam_dly.bf.lv_delta_lamb_act lam_bank_1.lam_dly.fac_cat_dly lam_bank_1.lam_dly.maf_int_dly lam_bank_1.lam_dly.t_dly_i lam_bank_1.lam_dly.t_dly_i_ad lam_bank_1.lam_dly.t_dly_p lam_bank_1.lam_dly.t_lam_dly lam_bank_1.lam_dly.vls_dif_dly lam_bank_1.lam_dly.t_dly_i_mv lam_bank_2.lam_dly.bf.lv_delta_lamb lam_bank_2.lam_dly.bf.lv_lam_dly_per_vld lam_bank_2.lam_dly.bf.lv_delta_lamb_act lam_bank_2.lam_dly.fac_cat_dly lam_bank_2.lam_dly.maf_int_dly lam_bank_2.lam_dly.t_dly_i lam_bank_2.lam_dly.t_dly_i_ad lam_bank_2.lam_dly.t_dly_p lam_bank_2.lam_dly.t_lam_dly lam_bank_2.lam_dly.vls_dif_dly lam_bank_2.lam_dly.t_dly_i_mv /end OUT_MEASUREMENT
/end FUNCTION
/begin FUNCTION INJ_Detection_of_limited_dynamic "_Detection of limited dynamic condition for dynamic fuel trim"
 /begin DEF_CHARACTERISTIC c_maf_crlc_dly c_lam_mv_crlc_dly c_n_dyw_dly c_maf_dyw_dly c_lam_mv_dyw_dly c_n_crlc_dly c_pv_av_grd_dec_dly c_pv_av_grd_sum_max_dly c_pv_av_grd_sum_min_dly c_t_pv_av_grd_dec_sum_dly c_pv_av_grd_min_sum_dly c_maf_int_min_ldc_dly /end DEF_CHARACTERISTIC
 /begin OUT_MEASUREMENT lam_bank_1.lam_dlyl.bf.lv_ldc_dly lam_bank_1.lam_dlyl.bf.lv_lam_mv_ldc_dly lam_bank_1.lam_dlyl.lam_mv_mmv_dly lam_bank_1.lam_dlyl.maf_int_ldc_dly lam_bank_1.lam_dlyl.pv_av_grd_sum_dly lam_bank_2.lam_dlyl.bf.lv_ldc_dly lam_bank_2.lam_dlyl.bf.lv_lam_mv_ldc_dly lam_bank_2.lam_dlyl.lam_mv_mmv_dly lam_bank_2.lam_dlyl.maf_int_ldc_dly lam_bank_2.lam_dlyl.pv_av_grd_sum_dly maf_mmv_dly n_mmv_dly lv_n_ldc_dly lv_maf_ldc_dly /end OUT_MEASUREMENT
/end FUNCTION
/begin FUNCTION INJ_Downstream_oxygen_sensor_sig "_Downstream oxygen sensor signal voltage"
 /begin DEF_CHARACTERISTIC c_vls_afl_ready c_vls_afr_ready c_vls_down_mmv_hys_min c_vls_down_ini_min c_vls_down_ini_max c_vls_down_crlc c_vls_down_crlc_off c_fac_vls_down_mmv_hys c_t_dly_puc_end_vls_down /end DEF_CHARACTERISTIC
 /begin OUT_MEASUREMENT lam_bank_1.ls_down_cur.r_down_ls lam_bank_1.ls_up.vls_up_mmv_hys lam_bank_2.ls_down_cur.r_down_ls lam_bank_2.ls_up.vls_up_mmv_hys /end OUT_MEASUREMENT
/end FUNCTION
/begin FUNCTION INJ_Downstream_oxygen_sensor_hea "_Downstream oxygen sensor heater managment LSH_DOWN"
 /begin DEF_CHARACTERISTIC c_v_efc_lsh_down_tol c_v_efc_lsh_down_max c_v_efc_lsh_down_prot c_t_lsh_down_tol c_v_efc_lsh_down_lim c_v_efc_lsh_down_as ip_v_efc_lsh_down_ctl ip_v_efc_lsh_down_ini ip_t_lsh_down_temp_thd ip_fac_v_efc_down_teg c_dec_v_efc_down c_inc_v_efc_down c_v_efc_down_red c_t_lsh_down_lim c_t_lsh_down_rise c_vb_prot_down_max c_v_efc_lsh_down_step c_t_lshpwm_down_fast_vb_cor c_fac_v_efc_lsh_down_as /end DEF_CHARACTERISTIC
 /begin OUT_MEASUREMENT lam_bank_1.lsh_down.lshpwm_down lam_bank_1.lsh_down.t_lsh_down lam_bank_1.lsh_down.v_efc_lsh_down lam_bank_1.lsh_down.t_lsh_down_tol lam_bank_1.lsh_down.t_lsh_down_lim lam_bank_1.lsh_down.state_lsh_down lam_bank_2.lsh_down.lshpwm_down lam_bank_2.lsh_down.t_lsh_down lam_bank_2.lsh_down.v_efc_lsh_down lam_bank_2.lsh_down.t_lsh_down_tol lam_bank_2.lsh_down.t_lsh_down_lim lam_bank_2.lsh_down.state_lsh_down /end OUT_MEASUREMENT
/end FUNCTION
/begin FUNCTION INJ_Injection_fuel_setpoint_for_ "_Injection fuel setpoint for homogeneous mode"
 /begin DEF_CHARACTERISTIC c_mff_sp_man c_mff_sp_hom_ofs_as ip_mff_cor_2 ip_mff_cor_1 lc_mff_sp_hom_man_act ip_mff_lgrd_ast /end DEF_CHARACTERISTIC
 /begin OUT_MEASUREMENT mff_sp_clc_1 mff_sp_clc_2 mff_sp_hom_eng_1 mff_sp_hom_eng_2 mff_sp_hom[0] mff_sp_hom[1] ti_st_amp /end OUT_MEASUREMENT
/end FUNCTION
/begin FUNCTION INJ_Injection_pressure_correctio "_Injection pressure correction" /begin DEF_CHARACTERISTIC c_ti_hom_man lc_ti_hom_man_act /end DEF_CHARACTERISTIC
 /begin OUT_MEASUREMENT ti_hom_2 ti_hom_1 lv_ti_lim_min fac_ti_prs[0] fac_ti_prs[1] prs_inj_mv[0] prs_inj_mv[1] prs_dec_inj[0] prs_dec_inj[1] ti_stnd_hom[0] ti_stnd_hom[1] ti_hom_clc[0] ti_hom_clc[1] crk_inj[0] crk_inj[1] /end OUT_MEASUREMENT
/end FUNCTION
/begin FUNCTION INJ_Lambda_coordination "_Lambda coordination"
 /begin DEF_CHARACTERISTIC c_lamb_sp_1_hys c_lamb_sp_ofs_as lc_lamb_sp_man_act c_lamb_bas_cor_min c_lamb_sp_man /end DEF_CHARACTERISTIC
 /begin OUT_MEASUREMENT lam_bank_1.lamb_sp.lamb_bas_cor lam_bank_1.lamb_sp.lamb_sp lam_bank_1.lamb_sp.lamb_sp_bas lam_bank_1.lamb_sp.lamb_bas_cor_1_h_res lam_bank_1.lamb_sp.lamb_sp_h_res lam_bank_1.lamb_sp.lv_lamb_sp_1 lam_bank_2.lamb_sp.lamb_bas_cor lam_bank_2.lamb_sp.lamb_sp lam_bank_2.lamb_sp.lamb_sp_bas lam_bank_2.lamb_sp.lamb_bas_cor_1_h_res lam_bank_2.lamb_sp.lamb_sp_h_res lam_bank_2.lamb_sp.lv_lamb_sp_1 lamb_bas_cor lamb_sp lamb_sp_bas /end OUT_MEASUREMENT
/end FUNCTION
/begin FUNCTION INJ_Lambda_Catalyst_overheating_ "_Lambda Catalyst overheating prevention"
 /begin DEF_CHARACTERISTIC ip_teg_cop_sp_dif ip_lamb_cop ip_teg_cop_sp c_lgrd_lamb_cop_inc c_lgrd_lamb_cop_dec ip_teg_cop_sp_lim c_lamb_cop_sp_pas c_teg_cop_dif_lim /end DEF_CHARACTERISTIC
 /begin OUT_MEASUREMENT lam_bank_1.cat_prev.lamb_cop lam_bank_1.cat_prev.lv_lamb_cop lam_bank_1.cat_prev.fac_cop lam_bank_1.cat_prev.teg_cop_sp lam_bank_1.cat_prev.t_cop lam_bank_2.cat_prev.lamb_cop lam_bank_2.cat_prev.lv_lamb_cop lam_bank_2.cat_prev.fac_cop lam_bank_2.cat_prev.teg_cop_sp lam_bank_2.cat_prev.t_cop /end OUT_MEASUREMENT
/end FUNCTION
/begin FUNCTION INJ_Conversion_MFF_to_TI "_Conversion MFF to TI" /end FUNCTION
/begin FUNCTION INJ_Basic_Lambda_Setpoint_includ "_Basic Lambda Setpoint including Homogeneous Lean Mode"
 /begin DEF_CHARACTERISTIC ip_lamb_bas_wup_cor ip_lamb_hom_afl ip_lamb_bas_1 ip_lamb_bas_2 c_lamb_bas_ofs_cat_diag ip_lamb_afl_1 ip_fac_lamb_wup ip_fac_lamb_wup_is /end DEF_CHARACTERISTIC
 /begin OUT_MEASUREMENT lamb_hom_afl lamb_afl_1 lamb_hom_afs lamb_bas lam_bank_1.lam_bas_sp.lamb_bas_h_res lam_bank_1.lam_bas_sp.lamb_hom_afs_h_res lam_bank_1.lam_bas_sp.lamb_bas lam_bank_1.lam_bas_sp.lamb_hom_afs lam_bank_1.lam_bas_sp.lv_lamb_bas_ofs_cat_diag lam_bank_2.lam_bas_sp.lamb_bas_h_res lam_bank_2.lam_bas_sp.lamb_hom_afs_h_res lam_bank_2.lam_bas_sp.lamb_bas lam_bank_2.lam_bas_sp.lamb_hom_afs lam_bank_2.lam_bas_sp.lv_lamb_bas_ofs_cat_diag /end OUT_MEASUREMENT
/end FUNCTION
/begin FUNCTION INJ_Ambient_pressure_correction "_Ambient pressure correction" /end FUNCTION
/begin FUNCTION INJ_Lambda_setpoint_for_catalyst "_Lambda setpoint for catalyst regeneration"
 /begin DEF_CHARACTERISTIC lc_lamb_rgn_fac_sens ip_lamb_rgn_afr__maf__n_32 ip_lamb_rgn_fac_sens ip_lamb_rgn_fac_mdl c_lamb_rgn_pas c_lamb_rgn_max c_t_rgn_lamb_con /end DEF_CHARACTERISTIC
 /begin OUT_MEASUREMENT lam_bank_1.lamb_rgn.lamb_rgn lam_bank_2.lamb_rgn.lamb_rgn lv_lamb_rgn_fac_sens t_rgn /end OUT_MEASUREMENT
/end FUNCTION
/begin FUNCTION INJ_Injection_Pressure_Correctio "_Injection Pressure Correction for Stratified Charge"
 /begin DEF_CHARACTERISTIC c_ti_min_thd c_ti_min ip_prs_inc_cmp ip_fac_ti_prs c_fac_mff_ti_stnd_2 c_fac_mff_ti_stnd_1 /end DEF_CHARACTERISTIC
/end FUNCTION
/begin FUNCTION INJ_Injection_setpoint_for_strat "_Injection setpoint for stratified mode" /end FUNCTION
/end MODULE
/end PROJECT
