ASAP2_VERSION 1 30
/begin PROJECT MSS65-inj "Generiert am 14.10.05 um 11:34:36"
/begin HEADER "" VERSION "R341" /end HEADER
/begin MODULE _MSS65-inj "Generiert am 14.10.05 um 11:34:36"
/begin MOD_COMMON "" BYTE_ORDER MSB_FIRST ALIGNMENT_BYTE 1 ALIGNMENT_WORD 2 ALIGNMENT_LONG 4 ALIGNMENT_FLOAT32_IEEE 4 ALIGNMENT_FLOAT64_IEEE 8 /end MOD_COMMON
/begin CHARACTERISTIC K_HFM_DIAG_ML_MAX "MAX ML fuer Diagnose " VALUE 0x7230E TKW_VV_VV_SW 100.0 FORMULA_0103 -50.0 1400.0 FORMAT "%4.1" /end CHARACTERISTIC
/begin CHARACTERISTIC K_HFM_DIAG_ML_MIN "MAX ML fuer Diagnose " VALUE 0x72310 TKW_VV_VV_SW 100.0 FORMULA_0103 -50.0 1400.0 FORMAT "%4.1" /end CHARACTERISTIC
/begin CHARACTERISTIC K_HFM_ERSATZ "Ersatzwert fuer HFM" VALUE 0x72312 TKW_VV_VV_SW 100.0 FORMULA_0103 -50.0 1400.0 FORMAT "%4.1" /end CHARACTERISTIC
/begin CHARACTERISTIC K_HFM_FIL_FC "Verhaeltniss Grenzfrequenz zur KW-Frequenz" VALUE 0x7231B TKW_VV_VV_UB 100.0 FORMULA_0720 0.0 255.0 /end CHARACTERISTIC
/begin CHARACTERISTIC K_HFM_KL_CFG "Auswahl HFM KL" VALUE 0x72314 TKW_VV_VV_UB 100.0 FORMULA_0717 0.0 255.0 /end CHARACTERISTIC
/begin CHARACTERISTIC K_HFM_MVAC_CFG "Konfig fuer Einrechnung MVAC" VALUE 0x7231A TKW_VV_VV_UB 100.0 FORMULA_0719 0.0 255.0 /end CHARACTERISTIC
/begin CHARACTERISTIC K_HFM_N_RF_KORR_CFG "HFM Popel KF Aktivierung" VALUE 0x72315 TKW_VV_VV_UB 100.0 FORMULA_0718 0.0 255.0 /end CHARACTERISTIC
/begin CHARACTERISTIC K_HFM_OBD_DYN_DELTA_RF "rf Differnez fuer Dynamikerkennung" VALUE 0x72316 TKW_VV_VV_SW 100.0 FORMULA_0007 0.0 2.0 FORMAT "%6.3" /end CHARACTERISTIC
/begin CHARACTERISTIC K_HFM_OBD_DYN_RF_T "Sperrzeit fuer Ruecknahme rf-Dynamik" VALUE 0x72318 TKW_VV_VV_UW 100.0 FORMULA_0021 0.0 655.3499755859375 FORMAT "%5.2" /end CHARACTERISTIC
/begin CHARACTERISTIC K_ITB_CFG "Konfiguration" VALUE 0x72E42 TKW_VV_VV_UB 100.0 FORMULA_0725 0.0 255.0 /end CHARACTERISTIC
/begin CHARACTERISTIC KF_HFM_AEB "Aenderungsbegrenzung HFM" MAP 0x7249A TKF_SW_SW_UW 100.0 FORMULA_0721 0.0 3000.0 FORMAT "%4.1" /begin AXIS_DESCR STD_AXIS n FORMULA_0006 8 0.0 10000.0 MAX_GRAD 0.0 /end AXIS_DESCR
 /begin AXIS_DESCR STD_AXIS egas_aq_soll_grad_b1 FORMULA_0020 8 -30000.0 30000.0 MAX_GRAD 0.0 /end AXIS_DESCR
/end CHARACTERISTIC
/begin CHARACTERISTIC KF_HFM_DYN_SW "Schwelle fuer Dynamikerkennung aus aq" MAP 0x72436 TKF_UW_UW_SW 100.0 FORMULA_0020 -30000.0 30000.0 /begin AXIS_DESCR STD_AXIS n FORMULA_0006 4 0.0 10000.0 MAX_GRAD 0.0 /end AXIS_DESCR
 /begin AXIS_DESCR STD_AXIS egas_aq_soll_b1 FORMULA_0143 4 0.0 6500.0 MAX_GRAD 0.0 FORMAT "%4.1" /end AXIS_DESCR
/end CHARACTERISTIC
/begin CHARACTERISTIC KF_HFM_DYN_VZ "Verweilzeit in der HFM-Dynamik" MAP 0x72468 TKF_UW_UW_UW 100.0 FORMULA_0109 0.0 325.0 FORMAT "%5.2" /begin AXIS_DESCR STD_AXIS n FORMULA_0006 4 0.0 10000.0 MAX_GRAD 0.0 /end AXIS_DESCR
 /begin AXIS_DESCR STD_AXIS egas_aq_soll_b1 FORMULA_0143 4 0.0 6500.0 MAX_GRAD 0.0 FORMAT "%4.1" /end AXIS_DESCR
/end CHARACTERISTIC
/begin CHARACTERISTIC KF_HFM_FAK_S65_B1 "Aufteilung des HFM-Signals auf die Baenke" MAP 0x723D4 TKF_SW_SW_UW 100.0 FORMULA_0073 0.0 4.0 FORMAT "%6.3" /begin AXIS_DESCR STD_AXIS n FORMULA_0006 6 0.0 10000.0 MAX_GRAD 0.0 /end AXIS_DESCR
 /begin AXIS_DESCR STD_AXIS dr_rel_b1 FORMULA_0106 6 0.0 199.9938049316406 MAX_GRAD 0.0 FORMAT "%5.2" /end AXIS_DESCR
/end CHARACTERISTIC
/begin CHARACTERISTIC KF_HFM_KORR_ML_TAN "ml Korrektur ueber TAN und ml" MAP 0x72340 TKF_SW_SW_UW 100.0 FORMULA_0073 0.0 4.0 FORMAT "%6.3"
 /begin AXIS_DESCR STD_AXIS ml FORMULA_0103 4 -100.0 1400.0 MAX_GRAD 0.0 FORMAT "%4.1" /end AXIS_DESCR
 /begin AXIS_DESCR STD_AXIS temperatur FORMULA_0023 4 -50.0 170.0 MAX_GRAD 0.0 FORMAT "%4.1" /end AXIS_DESCR
/end CHARACTERISTIC
/begin CHARACTERISTIC KF_HFM_KORR_N_RF "HFM Popel KF" MAP 0x72372 TKF_SW_SW_UW 100.0 FORMULA_0073 0.0 3.0 FORMAT "%6.3" /begin AXIS_DESCR STD_AXIS n FORMULA_0006 6 0.0 10000.0 MAX_GRAD 0.0 /end AXIS_DESCR
 /begin AXIS_DESCR STD_AXIS rf_ml_ges FORMULA_0007 6 0.0 2.0 MAX_GRAD 0.0 FORMAT "%6.3" /end AXIS_DESCR
/end CHARACTERISTIC
/begin CHARACTERISTIC KL_HFM_ANZ_SEG_N "Anzahl der Seg. fuer die MW" CURVE 0x7231C TKL_SW_VV_UW 100.0 FORMULA_0080 1.0 16.0 FORMAT "%5.2" /begin AXIS_DESCR STD_AXIS n FORMULA_0006 4 0.0 10000.0 MAX_GRAD 0.0 /end AXIS_DESCR /end CHARACTERISTIC
/begin CHARACTERISTIC KL_HFM_AQ_GRAD_WICHT "Wichtung der der egas_aq_soll_grad" CURVE 0x7232E TKL_SW_VV_UW 100.0 FORMULA_0073 0.0 4.0 FORMAT "%6.3"
 /begin AXIS_DESCR STD_AXIS egas_aq_soll_grad_b1 FORMULA_0020 4 -30000.0 30000.0 MAX_GRAD 0.0 /end AXIS_DESCR
/end CHARACTERISTIC
/begin MEASUREMENT aq_eingeregelt_st "Status AQ eingeregelt" UBYTE FORMULA_0003 0 0.0 0.0 255.0 READ_WRITE ECU_ADDRESS 0x3F85FE /end MEASUREMENT
/begin MEASUREMENT aq_rel "relative Oeffnungsquerschnitt" UWORD FORMULA_0106 0 0.0 0.0 200.0 READ_WRITE ARRAY_SIZE 2 ECU_ADDRESS 0x3F85D4 MATRIX_DIM 2 1 1 /end MEASUREMENT
/begin MEASUREMENT aq_rf_b1 "Fuellung aus inv. Ipol gefiltert mit alle korrekturen" SWORD FORMULA_0007 0 0.0 0.0 2.0 READ_WRITE ECU_ADDRESS 0x3F85CA /end MEASUREMENT
/begin MEASUREMENT aq_rf_b2 "Fuellung aus inv. Ipol gefiltert mit alle korrekturen" SWORD FORMULA_0007 0 0.0 0.0 2.0 READ_WRITE ECU_ADDRESS 0x3F85CC /end MEASUREMENT
/begin MEASUREMENT aq_rf_roh_b1 "Fuellung aus Inv. Ipol nicht gefiltert und rg korregiert" SWORD FORMULA_0007 0 0.0 0.0 2.0 READ_WRITE ECU_ADDRESS 0x3F85D8 /end MEASUREMENT
/begin MEASUREMENT aq_rf_roh_b2 "Fuellung aus Inv. Ipol nicht gefiltert und rg korregiert" SWORD FORMULA_0007 0 0.0 0.0 2.0 READ_WRITE ECU_ADDRESS 0x3F85DA /end MEASUREMENT
/begin MEASUREMENT at_sa_sperre "Anti-Trampeln Schubabschaltungssperre" UBYTE FORMULA_0275 0 0.0 0.0 255.0 READ_WRITE ECU_ADDRESS 0x3F8624 /end MEASUREMENT
/begin MEASUREMENT auss_erk "Zustandsvariable Aussetzererkennung." UWORD FORMULA_0232 0 0.0 0.0 1023.0 READ_WRITE ECU_ADDRESS 0x3F854C /end MEASUREMENT
/begin MEASUREMENT auss_erk_zyl1 "Aussetzererkennung Zylinder 1." UWORD FORMULA_0233 0 0 0.0 255.0 READ_WRITE BIT_MASK 0x1 ECU_ADDRESS 0x3F854C /end MEASUREMENT
/begin MEASUREMENT auss_erk_zyl10 "Aussetzererkennung Zylinder 10." UWORD FORMULA_0242 0 0 0.0 255.0 READ_WRITE BIT_MASK 0x200 ECU_ADDRESS 0x3F854C /end MEASUREMENT
/begin MEASUREMENT auss_erk_zyl2 "Aussetzererkennung Zylinder 2." UWORD FORMULA_0234 0 0 0.0 255.0 READ_WRITE BIT_MASK 0x2 ECU_ADDRESS 0x3F854C /end MEASUREMENT
/begin MEASUREMENT auss_erk_zyl3 "Aussetzererkennung Zylinder 3." UWORD FORMULA_0235 0 0 0.0 255.0 READ_WRITE BIT_MASK 0x4 ECU_ADDRESS 0x3F854C /end MEASUREMENT
/begin MEASUREMENT auss_erk_zyl4 "Aussetzererkennung Zylinder 4." UWORD FORMULA_0236 0 0 0.0 255.0 READ_WRITE BIT_MASK 0x8 ECU_ADDRESS 0x3F854C /end MEASUREMENT
/begin MEASUREMENT auss_erk_zyl5 "Aussetzererkennung Zylinder 5." UWORD FORMULA_0237 0 0 0.0 255.0 READ_WRITE BIT_MASK 0x10 ECU_ADDRESS 0x3F854C /end MEASUREMENT
/begin MEASUREMENT auss_erk_zyl6 "Aussetzererkennung Zylinder 6." UWORD FORMULA_0238 0 0 0.0 255.0 READ_WRITE BIT_MASK 0x20 ECU_ADDRESS 0x3F854C /end MEASUREMENT
/begin MEASUREMENT auss_erk_zyl7 "Aussetzererkennung Zylinder 7." UWORD FORMULA_0239 0 0 0.0 255.0 READ_WRITE BIT_MASK 0x40 ECU_ADDRESS 0x3F854C /end MEASUREMENT
/begin MEASUREMENT auss_erk_zyl8 "Aussetzererkennung Zylinder 8." UWORD FORMULA_0240 0 0 0.0 255.0 READ_WRITE BIT_MASK 0x80 ECU_ADDRESS 0x3F854C /end MEASUREMENT
/begin MEASUREMENT auss_erk_zyl9 "Aussetzererkennung Zylinder 9." UWORD FORMULA_0241 0 0 0.0 255.0 READ_WRITE BIT_MASK 0x100 ECU_ADDRESS 0x3F854C /end MEASUREMENT
/begin MEASUREMENT auss_lp_int_sum_b1 "Summe TP-Integral-Leitwert im Aussetzerfenster." SWORD FORMULA_0227 0 0.0 0.0 20.0 READ_WRITE ECU_ADDRESS 0x3F8536 /end MEASUREMENT
/begin MEASUREMENT auss_lp_int_sum_b2 "Summe TP-Integral-Leitwert im Aussetzerfenster." SWORD FORMULA_0227 0 0.0 0.0 20.0 READ_WRITE ECU_ADDRESS 0x3F8538 /end MEASUREMENT
/begin MEASUREMENT auss_nw_sync_b1 "Zaehler NW Sync Ok ueber Ionenstrom." UBYTE FORMULA_0003 0 0.0 0.0 255.0 READ_WRITE ECU_ADDRESS 0x3F853E /end MEASUREMENT
/begin MEASUREMENT auss_nw_sync_b2 "Zaehler NW Sync Ok ueber Ionenstrom." UBYTE FORMULA_0003 0 0.0 0.0 255.0 READ_WRITE ECU_ADDRESS 0x3F853F /end MEASUREMENT
/begin MEASUREMENT auss_obd_zyl_off "Abgeschaltene Zylinder." UWORD FORMULA_0347 0 0.0 0.0 65535.0 READ_WRITE ECU_ADDRESS 0x3F86F0 /end MEASUREMENT
/begin MEASUREMENT auss_st_b1 "Zustandsvariable Aussetzererkennung." UWORD FORMULA_0228 0 0.0 0.0 65535.0 READ_WRITE BIT_MASK 0x187 ECU_ADDRESS 0x3F853A /end MEASUREMENT
/begin MEASUREMENT auss_st_b2 "Zustandsvariable Aussetzererkennung." UWORD FORMULA_0228 0 0.0 0.0 65535.0 READ_WRITE BIT_MASK 0x187 ECU_ADDRESS 0x3F853C /end MEASUREMENT
/begin MEASUREMENT auss_st_ns_b1 "Zustandsvariable Nebenschlusserkennung." UWORD FORMULA_0230 0 0.0 0.0 65535.0 READ_WRITE BIT_MASK 0x5DFF ECU_ADDRESS 0x3F853A /end MEASUREMENT
/begin MEASUREMENT auss_st_ns_b2 "Zustandsvariable Nebenschlusserkennung." UWORD FORMULA_0230 0 0.0 0.0 65535.0 READ_WRITE BIT_MASK 0x5DFF ECU_ADDRESS 0x3F853C /end MEASUREMENT
/begin MEASUREMENT auss_st_ti_b1 "Zustandsvariable Verbrennungsaussetzererkennung." UWORD FORMULA_0229 0 0.0 0.0 65535.0 READ_WRITE BIT_MASK 0x7BFF ECU_ADDRESS 0x3F853A /end MEASUREMENT
/begin MEASUREMENT auss_st_ti_b2 "Zustandsvariable Verbrennungsaussetzererkennung." UWORD FORMULA_0229 0 0.0 0.0 65535.0 READ_WRITE BIT_MASK 0x7BFF ECU_ADDRESS 0x3F853C /end MEASUREMENT
/begin MEASUREMENT B_CAN_ANHAENGER "Anhaenger" UBYTE FORMULA_0198 0 0 0.0 255.0 READ_WRITE BIT_MASK 0x8 ECU_ADDRESS 0x3F89E3 /end MEASUREMENT
/begin MEASUREMENT B_CAN_HBR "Handbremse" UBYTE FORMULA_0197 0 0 0.0 255.0 READ_WRITE BIT_MASK 0x4 ECU_ADDRESS 0x3F89E3 /end MEASUREMENT
/begin MEASUREMENT B_CAN_KOMBI_MIL "HMIL-Info vom Kombi" UBYTE FORMULA_0196 0 0 0.0 255.0 READ_WRITE BIT_MASK 0x2 ECU_ADDRESS 0x3F89E3 /end MEASUREMENT
/begin MEASUREMENT B_genoff_copy "Kopie von (St_ugenkor0 & 0x08)" UBYTE FORMULA_0037 0 0.0 0.0 255.0 READ_WRITE ECU_ADDRESS 0x3F888A /end MEASUREMENT
/begin MEASUREMENT B_LLR_EINGEREGELT "Status eingeregelt" UBYTE FORMULA_0244 0 0 0.0 255.0 READ_WRITE BIT_MASK 0x1 ECU_ADDRESS 0x3F857D /end MEASUREMENT
/begin MEASUREMENT B_LLR_GRUNDDREHZAHL "Grunddrehzahl aktiv" UBYTE FORMULA_0246 0 0 0.0 255.0 READ_WRITE BIT_MASK 0x4 ECU_ADDRESS 0x3F857D /end MEASUREMENT
/begin MEASUREMENT B_LLR_MIN_BEGR "Begrenzung Min-Moment" UBYTE FORMULA_0245 0 0 0.0 255.0 READ_WRITE BIT_MASK 0x2 ECU_ADDRESS 0x3F857D /end MEASUREMENT
/begin MEASUREMENT B_oztemp_bsd_ok "Status FI_QLT (vorh. j/n)" UBYTE FORMULA_0037 0 0.0 0.0 255.0 READ_WRITE ECU_ADDRESS 0x3F888B /end MEASUREMENT
/begin MEASUREMENT B_oztemp_copy "QLT-Temperatur gemessen" UBYTE FORMULA_0112 0 0.0 0.0 255.0 READ_WRITE ECU_ADDRESS 0x3F888C /end MEASUREMENT
/begin MEASUREMENT B_TE_OBD_ABBRUCH "Abbruch der LL-Messung" UBYTE FORMULA_0203 0 0 0.0 255.0 READ_WRITE BIT_MASK 0x8 ECU_ADDRESS 0x3F89EC /end MEASUREMENT
/begin MEASUREMENT B_TE_OBD_CHECK "TEV-Check laeuft" UBYTE FORMULA_0202 0 0 0.0 255.0 READ_WRITE BIT_MASK 0x4 ECU_ADDRESS 0x3F89EC /end MEASUREMENT
/begin MEASUREMENT B_TE_OBD_KKOS_ABSCH "Abwurf KKOS wegen Fehlmessung TE_OBD" UBYTE FORMULA_0205 0 0 0.0 255.0 READ_WRITE BIT_MASK 0x20 ECU_ADDRESS 0x3F89EC /end MEASUREMENT
/begin MEASUREMENT B_TE_OBD_KKOS_FAIL "Merker Fehler mit KKOS" UBYTE FORMULA_0207 0 0 0.0 255.0 READ_WRITE BIT_MASK 0x80 ECU_ADDRESS 0x3F89EC /end MEASUREMENT
/begin MEASUREMENT B_TE_OBD_LAM_REG_OFF "Abwurf Lambda Regler wegen TE_OBD" UBYTE FORMULA_0206 0 0 0.0 255.0 READ_WRITE BIT_MASK 0x40 ECU_ADDRESS 0x3F89EC /end MEASUREMENT
/begin MEASUREMENT B_TE_OBD_PRE_CHECK "TEV-Check laeuft (bald)" UBYTE FORMULA_0201 0 0 0.0 255.0 READ_WRITE BIT_MASK 0x2 ECU_ADDRESS 0x3F89EC /end MEASUREMENT
/begin MEASUREMENT B_TE_OBD_S_BLS_OLD "Merker Bremslichtschalter" UBYTE FORMULA_0204 0 0 0.0 255.0 READ_WRITE BIT_MASK 0x10 ECU_ADDRESS 0x3F89EC /end MEASUREMENT
/begin MEASUREMENT B_TE_OBD_START_EXD "Start ueber Tester" UBYTE FORMULA_0200 0 0 0.0 255.0 READ_WRITE BIT_MASK 0x1 ECU_ADDRESS 0x3F89EC /end MEASUREMENT
/begin MEASUREMENT B_VAN_NICHT_NORM "Vanos Fehler oder ext. Diag" UBYTE FORMULA_0210 0 0.0 0.0 255.0 READ_WRITE ECU_ADDRESS 0x3F8A12 /end MEASUREMENT
/begin MEASUREMENT B_VAN_SK "Notprogramm wegen Vanos" UBYTE FORMULA_0212 0 0 0.0 255.0 READ_WRITE BIT_MASK 0x1 ECU_ADDRESS 0x3F8A13 /end MEASUREMENT
/begin MEASUREMENT can_a_st "A-Status" UBYTE FORMULA_0124 0 0.0 0.0 255.0 READ_WRITE ECU_ADDRESS 0x3F88E6 /end MEASUREMENT
/begin MEASUREMENT can_ax "Laengsbeschleunigung (roh)" SWORD FORMULA_0123 0 0.0 -20.0 20.0 READ_WRITE ECU_ADDRESS 0x3F88DE /end MEASUREMENT
/begin MEASUREMENT can_ax_mess "gem .Laengsbeschleunigung (roh)" SWORD FORMULA_0123 0 0.0 -20.0 20.0 READ_WRITE ECU_ADDRESS 0x3F88E2 /end MEASUREMENT
/begin MEASUREMENT can_ax_offs "Offset aLaengs" SWORD FORMULA_0123 0 0.0 -20.0 20.0 READ_WRITE ECU_ADDRESS 0x3F88E4 /end MEASUREMENT
/begin MEASUREMENT can_ay "Querbeschleunigung (roh)" SWORD FORMULA_0123 0 0.0 -20.0 20.0 READ_WRITE ECU_ADDRESS 0x3F88E0 /end MEASUREMENT
/begin MEASUREMENT can_bedfgr "FGR-Taster" UBYTE FORMULA_0140 0 0.0 0.0 255.0 READ_WRITE ECU_ADDRESS 0x3F8916 /end MEASUREMENT
/begin MEASUREMENT can_brp "Bremsdruck" UBYTE FORMULA_0129 0 0.0 0.0 200.0 READ_WRITE ECU_ADDRESS 0x3F88EF /end MEASUREMENT
/begin MEASUREMENT can_brp_grad "Gradient Bremsdruck" SWORD FORMULA_0131 0 0.0 -5000.0 5000.0 READ_WRITE ECU_ADDRESS 0x3F88F2 /end MEASUREMENT
/begin MEASUREMENT can_brp_st "Bremsdruck-Status" UBYTE FORMULA_0128 0 0.0 0.0 255.0 READ_WRITE ECU_ADDRESS 0x3F88EE /end MEASUREMENT
/begin MEASUREMENT can_crash_ctr "Crash-Kontrolle" UBYTE FORMULA_0223 0 0.0 0.0 255.0 READ_WRITE ECU_ADDRESS 0x3F8A24 /end MEASUREMENT
/begin MEASUREMENT can_dkg_eingr "DKG-Eingriff" UBYTE FORMULA_0136 0 0.0 0.0 255.0 READ_WRITE ECU_ADDRESS 0x3F88FB /end MEASUREMENT
/begin MEASUREMENT can_dkg_getr_st "Status Getriebe" UBYTE FORMULA_0003 0 0.0 0.0 255.0 READ_WRITE ECU_ADDRESS 0x3F890B /end MEASUREMENT
/begin MEASUREMENT can_dkg_i_strang "Strangverstaerkung" UWORD FORMULA_0138 0 0.0 0.0 512.0 READ_WRITE ECU_ADDRESS 0x3F8908 /end MEASUREMENT
/begin MEASUREMENT can_dkg_istgang "DKG-Istgang" SBYTE FORMULA_0135 0 0.0 -1.0 10.0 READ_WRITE ECU_ADDRESS 0x3F88FA /end MEASUREMENT
/begin MEASUREMENT can_dkg_kupp_ist "Kupplungsmoment" SWORD FORMULA_0120 0 0.0 -100.0 1000.0 READ_WRITE ECU_ADDRESS 0x3F8900 /end MEASUREMENT
/begin MEASUREMENT can_dkg_kupp_st "Status Kupplung" UBYTE FORMULA_0139 0 0.0 0.0 255.0 READ_WRITE ECU_ADDRESS 0x3F890A /end MEASUREMENT
/begin MEASUREMENT can_dkg_md_soll "DKG-Sollmoment" SWORD FORMULA_0120 0 0.0 -100.0 1000.0 READ_WRITE ECU_ADDRESS 0x3F88FE /end MEASUREMENT
/begin MEASUREMENT can_dkg_md_soll_pos "DKG-Sollmoment positiv" SWORD FORMULA_0120 0 0.0 -100.0 1000.0 READ_WRITE ECU_ADDRESS 0x3F88FC /end MEASUREMENT
/begin MEASUREMENT can_dkg_n_getr_ein "Getriebeeingang" SWORD FORMULA_0006 0 0.0 0.0 10000.0 READ_WRITE ECU_ADDRESS 0x3F8904 /end MEASUREMENT
/begin MEASUREMENT can_dkg_n_llr "Leerlaufdrehzahl" SWORD FORMULA_0006 0 0.0 0.0 10000.0 READ_WRITE ECU_ADDRESS 0x3F8906 /end MEASUREMENT
/begin MEASUREMENT can_dkg_n_soll "Solldrehzahl" SWORD FORMULA_0137 0 0.0 0.0 10000.0 READ_WRITE ECU_ADDRESS 0x3F8902 /end MEASUREMENT
/begin MEASUREMENT can_dsc_eingr "DSC-Eingriff" UBYTE FORMULA_0125 0 0.0 0.0 255.0 READ_WRITE ECU_ADDRESS 0x3F88E7 /end MEASUREMENT
/begin MEASUREMENT can_dsc_md_soll "DSC-Sollmoment" SWORD FORMULA_0120 0 0.0 -100.0 1000.0 READ_WRITE ECU_ADDRESS 0x3F88EA /end MEASUREMENT
/begin MEASUREMENT can_dsc_md_soll_pos "DSC-Sollmoment positiv" SWORD FORMULA_0120 0 0.0 -100.0 1000.0 READ_WRITE ECU_ADDRESS 0x3F88E8 /end MEASUREMENT
/begin MEASUREMENT can_dsc_reg "Regelungs-Status" UBYTE FORMULA_0127 0 0.0 0.0 255.0 READ_WRITE ECU_ADDRESS 0x3F88ED /end MEASUREMENT
/begin MEASUREMENT can_dsc_st "DSC-Status" UBYTE FORMULA_0126 0 0.0 0.0 255.0 READ_WRITE ECU_ADDRESS 0x3F88EC /end MEASUREMENT
/begin MEASUREMENT can_flags "Allg. CAN-Flags" UBYTE FORMULA_0003 0 0.0 0.0 255.0 READ_WRITE ECU_ADDRESS 0x3F8975 /end MEASUREMENT
/begin MEASUREMENT can_fzg_st "Fzg-Zustand" UBYTE FORMULA_0122 0 0.0 0.0 255.0 READ_WRITE ECU_ADDRESS 0x3F88DC /end MEASUREMENT
/begin MEASUREMENT can_gang_r "Empfangsstatus StatR" UBYTE FORMULA_0222 0 0.0 0.0 255.0 READ_WRITE ECU_ADDRESS 0x3F8A23 /end MEASUREMENT
/begin MEASUREMENT can_idx_fil "Index Md-Filter" UBYTE FORMULA_0003 0 0.0 0.0 5.0 READ_WRITE ECU_ADDRESS 0x3F890F /end MEASUREMENT
/begin MEASUREMENT can_idx_fp "Index Fahrpedal" UBYTE FORMULA_0003 0 0.0 0.0 5.0 READ_WRITE ECU_ADDRESS 0x3F890E /end MEASUREMENT
/begin MEASUREMENT can_kkos_md "Md-Aufnahme KKOS" SWORD FORMULA_0120 0 0.0 -100.0 1000.0 READ_WRITE ECU_ADDRESS 0x3F88CC /end MEASUREMENT
/begin MEASUREMENT can_kkos_st "Stati KKOS" UBYTE FORMULA_0003 0 0.0 0.0 255.0 READ_WRITE ECU_ADDRESS 0x3F88CA /end MEASUREMENT
/begin MEASUREMENT can_kkos_st_nll "Stati KKOS - n_ll" UBYTE FORMULA_0118 0 0.0 0.0 255.0 READ_WRITE BIT_MASK 0x7 ECU_ADDRESS 0x3F88CA /end MEASUREMENT
/begin MEASUREMENT can_kkos_st_zh "Stati KKOS - ZH" UBYTE FORMULA_0119 0 0.0 0.0 255.0 READ_WRITE BIT_MASK 0x60 ECU_ADDRESS 0x3F88CA /end MEASUREMENT
/begin MEASUREMENT can_klst_s "Klemmenstatus" UBYTE FORMULA_0134 0 0.0 0.0 255.0 READ_WRITE ECU_ADDRESS 0x3F88F8 /end MEASUREMENT
/begin MEASUREMENT can_kmst_st "Status km-Stand" UBYTE FORMULA_0191 0 0.0 0.0 255.0 READ_WRITE ECU_ADDRESS 0x3F89DA /end MEASUREMENT
/begin MEASUREMENT can_lrw "Lenkradwinkel" SWORD FORMULA_0132 0 0.0 -1440.153564453125 1440.109619140625 READ_WRITE ECU_ADDRESS 0x3F88F4 /end MEASUREMENT
/begin MEASUREMENT can_lrw_st "Lenkradwinkel Status" UBYTE FORMULA_0130 0 0.0 0.0 255.0 READ_WRITE ECU_ADDRESS 0x3F88F0 /end MEASUREMENT
/begin MEASUREMENT can_lrw_v "Lenkradwinkel-Geschw" SWORD FORMULA_0133 0 0.0 -1440.153564453125 1440.109619140625 READ_WRITE ECU_ADDRESS 0x3F88F6 /end MEASUREMENT
/begin MEASUREMENT can_md_rad_steigung "Steigungsverluste" SWORD FORMULA_0009 0 0.0 -3200.0 3200.0 READ_WRITE ECU_ADDRESS 0x3F890C /end MEASUREMENT
/begin MEASUREMENT can_no_key "Schluesselnummer" UBYTE FORMULA_0003 0 0.0 0.0 255.0 READ_WRITE ECU_ADDRESS 0x3F88F9 /end MEASUREMENT
/begin MEASUREMENT can_s_tns "Schalter Tag/Nachtbeleuchtung" UBYTE FORMULA_0003 0 0.0 0.0 255.0 READ_WRITE ECU_ADDRESS 0x3F88AE /end MEASUREMENT
/begin MEASUREMENT can_st_atemp "Empfangsstatus ATemp" UWORD FORMULA_0116 0 0.0 0.0 65535.0 READ_WRITE ECU_ADDRESS 0x3F88B0 /end MEASUREMENT
/begin MEASUREMENT can_st_bedfgr "Empfangsstatus BedFgr" UWORD FORMULA_0116 0 0.0 0.0 65535.0 READ_WRITE ECU_ADDRESS 0x3F8914 /end MEASUREMENT
/begin MEASUREMENT can_st_dsc "Empfangsstatus DSC" UWORD FORMULA_0116 0 0.0 0.0 65535.0 READ_WRITE ECU_ADDRESS 0x3F88B8 /end MEASUREMENT
/begin MEASUREMENT can_st_empf "Empfangsstatus aktuell" UWORD FORMULA_0010 0 0.0 0.0 65535.0 READ_WRITE ECU_ADDRESS 0x3F88B2 /end MEASUREMENT
/begin MEASUREMENT can_st_empf_hys "Empfangsstatus pro SG-Zyklus" UWORD FORMULA_0010 0 0.0 0.0 65535.0 READ_WRITE ECU_ADDRESS 0x3F88B4 /end MEASUREMENT
/begin MEASUREMENT can_st_grb "Empfangsstatus Getriebe" UWORD FORMULA_0116 0 0.0 0.0 65535.0 READ_WRITE ECU_ADDRESS 0x3F88C4 /end MEASUREMENT
/begin MEASUREMENT can_st_grb2 "Empfangsstatus Getriebe 2" UWORD FORMULA_0116 0 0.0 0.0 65535.0 READ_WRITE ECU_ADDRESS 0x3F88C6 /end MEASUREMENT
/begin MEASUREMENT can_st_kkos "Empfangsstatus KKOS" UBYTE FORMULA_0117 0 0.0 0.0 255.0 READ_WRITE ECU_ADDRESS 0x3F88C9 /end MEASUREMENT
/begin MEASUREMENT can_st_klst "Empfangsstatus Klemmenstatus" UWORD FORMULA_0116 0 0.0 0.0 65535.0 READ_WRITE ECU_ADDRESS 0x3F88BC /end MEASUREMENT
/begin MEASUREMENT can_st_stgrb "Empfangsstatus Status Getriebe" UBYTE FORMULA_0117 0 0.0 0.0 255.0 READ_WRITE ECU_ADDRESS 0x3F88C8 /end MEASUREMENT
/begin MEASUREMENT can_st_stkombi "Empfangsstatus StatusKombi" UWORD FORMULA_0116 0 0.0 0.0 65535.0 READ_WRITE ECU_ADDRESS 0x3F88C0 /end MEASUREMENT
/begin MEASUREMENT can_st_torqdkg "Empfangsstatus DKG" UWORD FORMULA_0116 0 0.0 0.0 65535.0 READ_WRITE ECU_ADDRESS 0x3F88C2 /end MEASUREMENT
/begin MEASUREMENT can_st_torqdsc "Empfangsstatus TorqDSC" UWORD FORMULA_0116 0 0.0 0.0 65535.0 READ_WRITE ECU_ADDRESS 0x3F88B6 /end MEASUREMENT
/begin MEASUREMENT can_st_vehmod "Empfangsstatus VehMode" UWORD FORMULA_0116 0 0.0 0.0 65535.0 READ_WRITE ECU_ADDRESS 0x3F8910 /end MEASUREMENT
/begin MEASUREMENT can_st_vfzg "Empfangsstatus vFzg" UWORD FORMULA_0116 0 0.0 0.0 65535.0 READ_WRITE ECU_ADDRESS 0x3F88BE /end MEASUREMENT
/begin MEASUREMENT can_st_vrad "Empfangsstatus vRad" UWORD FORMULA_0116 0 0.0 0.0 65535.0 READ_WRITE ECU_ADDRESS 0x3F88BA /end MEASUREMENT
/begin MEASUREMENT can_stkombi_fgr "FGR-Info vom Kombi" UBYTE FORMULA_0195 0 0.0 0.0 255.0 READ_WRITE ECU_ADDRESS 0x3F89E2 /end MEASUREMENT
/begin MEASUREMENT can_stkombi_s "Schalter-Infos vom Kombi" UBYTE FORMULA_0003 0 0.0 0.0 255.0 READ_WRITE ECU_ADDRESS 0x3F89E3 /end MEASUREMENT
/begin MEASUREMENT can_v_st "v-CAN-Status" UWORD FORMULA_0121 0 0.0 0.0 65535.0 READ_WRITE ECU_ADDRESS 0x3F88DA /end MEASUREMENT
/begin MEASUREMENT can_vehmod "VehMode" UBYTE FORMULA_0003 0 0.0 0.0 255.0 READ_WRITE ECU_ADDRESS 0x3F8912 /end MEASUREMENT
/begin MEASUREMENT cbs_reset_st "Erkennung CBS-Reset" UBYTE FORMULA_0115 0 0 0.0 255.0 READ_WRITE BIT_MASK 0x1 ECU_ADDRESS 0x3F88AF /end MEASUREMENT
/begin MEASUREMENT ccp_fp_st_ign "Status CCP-FP" UBYTE FORMULA_0213 0 0.0 0.0 255.0 READ_WRITE ECU_ADDRESS 0x3F86F2 /end MEASUREMENT
/begin MEASUREMENT ccp_fp_st_inj "Status CCP-FP" UBYTE FORMULA_0213 0 0.0 0.0 255.0 READ_WRITE ECU_ADDRESS 0x3F8A14 /end MEASUREMENT
/begin MEASUREMENT diag_ev_tz_st "Bankabschaltung bei EV-/TZ-Fehlern" UWORD FORMULA_0010 0 0.0 0.0 65535.0 READ_WRITE ECU_ADDRESS 0x3F87CC /end MEASUREMENT
/begin MEASUREMENT dkg_freig_st "DKG-Freigabe" UBYTE FORMULA_0273 0 0.0 0.0 255.0 READ_WRITE ECU_ADDRESS 0x3F861C /end MEASUREMENT
/begin MEASUREMENT dr_rel_b1 "relative Drosselung" SWORD FORMULA_0106 0 0.0 0.0 199.9938049316406 READ_WRITE ECU_ADDRESS 0x3F85D0 /end MEASUREMENT
/begin MEASUREMENT dr_rel_b2 "relative Drosselung" SWORD FORMULA_0106 0 0.0 0.0 199.9938049316406 READ_WRITE ECU_ADDRESS 0x3F85D2 /end MEASUREMENT
/begin MEASUREMENT dr_rel_grad_b1 "dr_rel gradient" SWORD FORMULA_0260 0 0.0 -655000.0 655000.0 READ_WRITE ECU_ADDRESS 0x3F85DE /end MEASUREMENT
/begin MEASUREMENT dr_rel_grad_b2 "dr_rel gradient" SWORD FORMULA_0260 0 0.0 -655000.0 655000.0 READ_WRITE ECU_ADDRESS 0x3F85E0 /end MEASUREMENT
/begin MEASUREMENT dwf_n_orange "oranger Drehzahlbereich" UBYTE FORMULA_0166 0 0.0 0.0 12750.0 READ_WRITE ECU_ADDRESS 0x3F8979 /end MEASUREMENT
/begin MEASUREMENT egas_aq_soll_b1 "AQ-Soll mit Fuellungsadaption und sek. Einfluessen" UWORD FORMULA_0143 0 0.0 0.0 6500.0 READ_WRITE ECU_ADDRESS 0x3F8604 /end MEASUREMENT
/begin MEASUREMENT egas_aq_soll_b2 "AQ-Soll mit Fuellungsadaption und sek. Einfluessen" UWORD FORMULA_0143 0 0.0 0.0 6500.0 READ_WRITE ECU_ADDRESS 0x3F8606 /end MEASUREMENT
/begin MEASUREMENT egas_aq_soll_grad_b1 "Gradient AQ-Soll" SWORD FORMULA_0020 0 0.0 -30000.0 30000.0 READ_WRITE ECU_ADDRESS 0x3F8600 /end MEASUREMENT
/begin MEASUREMENT egas_aq_soll_grad_b2 "Gradient AQ-Soll" SWORD FORMULA_0020 0 0.0 -30000.0 30000.0 READ_WRITE ECU_ADDRESS 0x3F8602 /end MEASUREMENT
/begin MEASUREMENT egas_aq_soll_roh_b1 "AQ-Soll Rohwert" UWORD FORMULA_0143 0 0.0 0.0 6500.0 READ_WRITE ECU_ADDRESS 0x3F85C6 /end MEASUREMENT
/begin MEASUREMENT egas_aq_soll_roh_b2 "AQ-Soll Rohwert" UWORD FORMULA_0143 0 0.0 0.0 6500.0 READ_WRITE ECU_ADDRESS 0x3F85C8 /end MEASUREMENT
/begin MEASUREMENT egas_ist_dk_b1 "Istwert (CAN)" SWORD FORMULA_0001 0 0.0 -10.0 120.0 READ_WRITE ECU_ADDRESS 0x3F85B8 /end MEASUREMENT
/begin MEASUREMENT egas_ist_dk_b2 "Istwert (CAN)" SWORD FORMULA_0001 0 0.0 -10.0 120.0 READ_WRITE ECU_ADDRESS 0x3F85BA /end MEASUREMENT
/begin MEASUREMENT egas_ist_lls_b1 "Istwert (CAN)" SWORD FORMULA_0001 0 0.0 -10.0 120.0 READ_WRITE ECU_ADDRESS 0x3F85BC /end MEASUREMENT
/begin MEASUREMENT egas_ist_lls_b2 "Istwert (CAN)" SWORD FORMULA_0001 0 0.0 -10.0 120.0 READ_WRITE ECU_ADDRESS 0x3F85BE /end MEASUREMENT
/begin MEASUREMENT egas_ist_wdk_b1 "Istwert (analog)" SWORD FORMULA_0001 0 0.0 -10.0 120.0 READ_WRITE ECU_ADDRESS 0x3F85F6 /end MEASUREMENT
/begin MEASUREMENT egas_ist_wdk_b2 "Istwert (analog)" SWORD FORMULA_0001 0 0.0 -10.0 120.0 READ_WRITE ECU_ADDRESS 0x3F85F8 /end MEASUREMENT
/begin MEASUREMENT egas_rec_dk_r_hw_vers_b1 "HW-Version" UWORD FORMULA_0010 0 0.0 0.0 65535.0 READ_WRITE ECU_ADDRESS 0x3F86F4 /end MEASUREMENT
/begin MEASUREMENT egas_rec_dk_r_hw_vers_b2 "HW-Version" UWORD FORMULA_0010 0 0.0 0.0 65535.0 READ_WRITE ECU_ADDRESS 0x3F86F6 /end MEASUREMENT
/begin MEASUREMENT egas_sk_mode "SK-Mode Egas" UBYTE FORMULA_0012 0 0.0 0.0 255.0 READ_WRITE ECU_ADDRESS 0x3F8663 /end MEASUREMENT
/begin MEASUREMENT egas_sk_ti_st "SK-Ausblendmaske vom Egas" UWORD FORMULA_0010 0 0.0 0.0 65535.0 READ_WRITE ECU_ADDRESS 0x3F85C4 /end MEASUREMENT
/begin MEASUREMENT egas_soll_dk_b1 "DK-Sollwert" SWORD FORMULA_0001 0 0.0 -10.0 120.0 READ_WRITE ECU_ADDRESS 0x3F85B0 /end MEASUREMENT
/begin MEASUREMENT egas_soll_dk_b2 "DK-Sollwert" SWORD FORMULA_0001 0 0.0 -10.0 120.0 READ_WRITE ECU_ADDRESS 0x3F85B2 /end MEASUREMENT
/begin MEASUREMENT egas_soll_lls_b1 "LLS-Sollwert" SWORD FORMULA_0001 0 0.0 -10.0 120.0 READ_WRITE ECU_ADDRESS 0x3F85B4 /end MEASUREMENT
/begin MEASUREMENT egas_soll_lls_b2 "LLS-Sollwert" SWORD FORMULA_0001 0 0.0 -10.0 120.0 READ_WRITE ECU_ADDRESS 0x3F85B6 /end MEASUREMENT
/begin MEASUREMENT egas_st_b1 "DPR-Status" UBYTE FORMULA_0003 0 0.0 0.0 255.0 READ_WRITE ECU_ADDRESS 0x3F85C1 /end MEASUREMENT
/begin MEASUREMENT egas_st_b2 "DPR-Status" UBYTE FORMULA_0003 0 0.0 0.0 255.0 READ_WRITE ECU_ADDRESS 0x3F85C2 /end MEASUREMENT
/begin MEASUREMENT egas_st_dk_b1 "Status Klappen" UBYTE FORMULA_0258 0 0.0 0.0 255.0 READ_WRITE BIT_MASK 0xC ECU_ADDRESS 0x3F85C1 /end MEASUREMENT
/begin MEASUREMENT egas_st_dk_b2 "Status Klappen" UBYTE FORMULA_0258 0 0.0 0.0 255.0 READ_WRITE BIT_MASK 0xC ECU_ADDRESS 0x3F85C2 /end MEASUREMENT
/begin MEASUREMENT egas_st_ft_b1 "Status Federntest" UBYTE FORMULA_0257 0 0 0.0 255.0 READ_WRITE BIT_MASK 0x1 ECU_ADDRESS 0x3F85C1 /end MEASUREMENT
/begin MEASUREMENT egas_st_ft_b2 "Status Federntest" UBYTE FORMULA_0257 0 0 0.0 255.0 READ_WRITE BIT_MASK 0x1 ECU_ADDRESS 0x3F85C2 /end MEASUREMENT
/begin MEASUREMENT egas_wdk_adapt_b1 "Adaptionsstatus" UBYTE FORMULA_0266 0 0.0 0.0 255.0 READ_WRITE ECU_ADDRESS 0x3F85FA /end MEASUREMENT
/begin MEASUREMENT egas_wdk_adapt_b2 "Adaptionsstatus" UBYTE FORMULA_0266 0 0.0 0.0 255.0 READ_WRITE ECU_ADDRESS 0x3F85FB /end MEASUREMENT
/begin MEASUREMENT elup_ed_st "ELUP-Fehler" UBYTE FORMULA_0146 0 0.0 0.0 255.0 READ_WRITE ECU_ADDRESS 0x3F8A00 /end MEASUREMENT
/begin MEASUREMENT elup_st "Status ELUP" UBYTE FORMULA_0184 0 0.0 0.0 255.0 READ_WRITE ECU_ADDRESS 0x3F8992 /end MEASUREMENT
/begin MEASUREMENT evap_wdk_ist_b1 "Istwert-EVAP" SWORD FORMULA_0001 0 0.0 -10.0 120.0 READ_WRITE ECU_ADDRESS 0x3F85E2 /end MEASUREMENT
/begin MEASUREMENT evap_wdk_ist_b2 "Istwert-EVAP" SWORD FORMULA_0001 0 0.0 -10.0 120.0 READ_WRITE ECU_ADDRESS 0x3F85E4 /end MEASUREMENT
/begin MEASUREMENT exd_tester_timeout "Testertimeout" UBYTE FORMULA_0214 0 0.0 0.0 255.0 READ_WRITE ECU_ADDRESS 0x3F8A16 /end MEASUREMENT
/begin MEASUREMENT fgr_anzeige_kombi "FGR Anzeige im Kombi ein-/ausschalten" UBYTE FORMULA_0315 0 0.0 0.0 255.0 READ_WRITE ECU_ADDRESS 0x3F866D /end MEASUREMENT
/begin MEASUREMENT fgr_cc_message "Fgr CC-Message senden " UBYTE FORMULA_0346 0 0.0 0.0 255.0 READ_WRITE ECU_ADDRESS 0x3F86D6 /end MEASUREMENT
/begin MEASUREMENT fgr_sa_sperre "Fgr SA Sperre" UBYTE FORMULA_0319 0 0.0 0.0 255.0 READ_WRITE ECU_ADDRESS 0x3F8676 /end MEASUREMENT
/begin MEASUREMENT fgr_status "Fgr Status" UBYTE FORMULA_0318 0 0.0 0.0 255.0 READ_WRITE ECU_ADDRESS 0x3F8672 /end MEASUREMENT
/begin MEASUREMENT fgr_status_hud "FGR Status HUD" UBYTE FORMULA_0316 0 0.0 0.0 255.0 READ_WRITE ECU_ADDRESS 0x3F866E /end MEASUREMENT
/begin MEASUREMENT fgr_status_kombi "FGR Status zum Kombi" UBYTE FORMULA_0314 0 0.0 0.0 255.0 READ_WRITE ECU_ADDRESS 0x3F866C /end MEASUREMENT
/begin MEASUREMENT fgr_v_kombi "FGR Geschwindigkeit zum Kombi" SWORD FORMULA_0317 0 0.0 0.0 360.0 READ_WRITE ECU_ADDRESS 0x3F8670 /end MEASUREMENT
/begin MEASUREMENT fr_einger_st "Status FR eingeregelt" UBYTE FORMULA_0320 0 0.0 0.0 255.0 READ_WRITE ECU_ADDRESS 0x3F8680 /end MEASUREMENT
/begin MEASUREMENT fr_ramp_st "diverse Aktivierung Bits fuer Fr-Rampen" ULONG FORMULA_0000 0 0.0 0.0 4294967295.0 READ_WRITE ECU_ADDRESS 0x3F8684 /end MEASUREMENT
/begin MEASUREMENT fr_ramp_st.aq_grad "Aktivierung fuer FR-Abrampen aus aq_grad" ULONG FORMULA_0333 0 0 0.0 255.0 READ_WRITE BIT_MASK 0x800 ECU_ADDRESS 0x3F8684 /end MEASUREMENT
/begin MEASUREMENT fr_ramp_st.dkfail "Aktivierung fuer FR-Abrampen aus dkfail" ULONG FORMULA_0337 0 0 0.0 255.0 READ_WRITE BIT_MASK 0x8000 ECU_ADDRESS 0x3F8684 /end MEASUREMENT
/begin MEASUREMENT fr_ramp_st.egasdif "Aktivierung fuer FR-Abrampen aus egasdif" ULONG FORMULA_0335 0 0 0.0 255.0 READ_WRITE BIT_MASK 0x2000 ECU_ADDRESS 0x3F8684 /end MEASUREMENT
/begin MEASUREMENT fr_ramp_st.lamreg_off "Aktivierung fuer FR-Abrampen aus lamreg" ULONG FORMULA_0332 0 0 0.0 255.0 READ_WRITE BIT_MASK 0x400 ECU_ADDRESS 0x3F8684 /end MEASUREMENT
/begin MEASUREMENT fr_ramp_st.llsfail "Aktivierung fuer FR-Abrampen aus llsfail" ULONG FORMULA_0338 0 0 0.0 255.0 READ_WRITE BIT_MASK 0x10000 ECU_ADDRESS 0x3F8684 /end MEASUREMENT
/begin MEASUREMENT fr_ramp_st.pumgmax "Aktivierung fuer FR-Abrampen aus pumgmax" ULONG FORMULA_0327 0 0 0.0 255.0 READ_WRITE BIT_MASK 0x20 ECU_ADDRESS 0x3F8684 /end MEASUREMENT
/begin MEASUREMENT fr_ramp_st.pumgmin "Aktivierung fuer FR-Abrampen aus pumgmin" ULONG FORMULA_0326 0 0 0.0 255.0 READ_WRITE BIT_MASK 0x10 ECU_ADDRESS 0x3F8684 /end MEASUREMENT
/begin MEASUREMENT fr_ramp_st.rfmax "Aktivierung fuer FR-Abrampen aus md_rf_soll_max" ULONG FORMULA_0322 0 0 0.0 255.0 READ_WRITE BIT_MASK 0x1 ECU_ADDRESS 0x3F8684 /end MEASUREMENT
/begin MEASUREMENT fr_ramp_st.sasb "Aktivierung fuer FR-Abrampen aus SA bzw. SB" ULONG FORMULA_0323 0 0 0.0 255.0 READ_WRITE BIT_MASK 0x2 ECU_ADDRESS 0x3F8684 /end MEASUREMENT
/begin MEASUREMENT fr_ramp_st.start_delay "Aktivierung fuer FR-Abrampen aus Start-Delay" ULONG FORMULA_0340 0 0 0.0 255.0 READ_WRITE BIT_MASK 0x40000 ECU_ADDRESS 0x3F8684 /end MEASUREMENT
/begin MEASUREMENT fr_ramp_st.tanmax "Aktivierung fuer FR-Abrampen aus tanmax" ULONG FORMULA_0328 0 0 0.0 255.0 READ_WRITE BIT_MASK 0x40 ECU_ADDRESS 0x3F8684 /end MEASUREMENT
/begin MEASUREMENT fr_ramp_st.tanmin "Aktivierung fuer FR-Abrampen aus tanmin" ULONG FORMULA_0329 0 0 0.0 255.0 READ_WRITE BIT_MASK 0x80 ECU_ADDRESS 0x3F8684 /end MEASUREMENT
/begin MEASUREMENT fr_ramp_st.te_c_akf "Aktivierung fuer FR-Abrampen aus te_c_akf" ULONG FORMULA_0339 0 0 0.0 255.0 READ_WRITE BIT_MASK 0x20000 ECU_ADDRESS 0x3F8684 /end MEASUREMENT
/begin MEASUREMENT fr_ramp_st.te_mvac "Aktivierung fuer FR-Abrampen aus te_mvac" ULONG FORMULA_0334 0 0 0.0 255.0 READ_WRITE BIT_MASK 0x1000 ECU_ADDRESS 0x3F8684 /end MEASUREMENT
/begin MEASUREMENT fr_ramp_st.tevc_on "Aktivierung fuer FR-Abrampen aus tevcheck" ULONG FORMULA_0336 0 0 0.0 255.0 READ_WRITE BIT_MASK 0x4000 ECU_ADDRESS 0x3F8684 /end MEASUREMENT
/begin MEASUREMENT fr_ramp_st.tkasmmin "Aktivierung fuer FR-Abrampen aus tksmmin" ULONG FORMULA_0331 0 0 0.0 255.0 READ_WRITE BIT_MASK 0x200 ECU_ADDRESS 0x3F8684 /end MEASUREMENT
/begin MEASUREMENT fr_ramp_st.tksmmax "Aktivierung fuer FR-Abrampen aus tksmmax" ULONG FORMULA_0330 0 0 0.0 255.0 READ_WRITE BIT_MASK 0x100 ECU_ADDRESS 0x3F8684 /end MEASUREMENT
/begin MEASUREMENT fr_ramp_st.tmotmax "Aktivierung fuer FR-Abrampen aus tmotmax" ULONG FORMULA_0324 0 0 0.0 255.0 READ_WRITE BIT_MASK 0x4 ECU_ADDRESS 0x3F8684 /end MEASUREMENT
/begin MEASUREMENT fr_ramp_st.tmotmin "Aktivierung fuer FR-Abrampen aus tmotmin" ULONG FORMULA_0325 0 0 0.0 255.0 READ_WRITE BIT_MASK 0x8 ECU_ADDRESS 0x3F8684 /end MEASUREMENT
/begin MEASUREMENT fr_ramp_st.zust_ml "Aktivierung fuer FR-Abrampen aus ZUST_ML" ULONG FORMULA_0341 0 0 0.0 255.0 READ_WRITE BIT_MASK 0x80000 ECU_ADDRESS 0x3F8684 /end MEASUREMENT
/begin MEASUREMENT gang "Gang" SBYTE FORMULA_0135 0 0.0 -1.0 10.0 READ_WRITE ECU_ADDRESS 0x3F8660 /end MEASUREMENT
/begin MEASUREMENT gang_berech "berechneter Gang inkl. R und N" SBYTE FORMULA_0135 0 0.0 -1.0 10.0 READ_WRITE ECU_ADDRESS 0x3F8658 /end MEASUREMENT
/begin MEASUREMENT gang_berech_kl_i "Getriebeuebersetzungsverhaeltnis aus Kennlinie" SWORD FORMULA_0073 0 0.0 -32.0 31.99900054931641 READ_WRITE ECU_ADDRESS 0x3F865C /end MEASUREMENT
/begin MEASUREMENT gang_berech_kl_i_dist "Abstand Getriebeuebersetzungsverhaeltnis naechster Gang" SWORD FORMULA_0073 0 0.0 -32.0 31.99900054931641 READ_WRITE ECU_ADDRESS 0x3F865E /end MEASUREMENT
/begin MEASUREMENT gang_berech_st "Status berechneter Gang" UWORD FORMULA_0080 0 0.0 0.0 65535.0 READ_WRITE ECU_ADDRESS 0x3F865A /end MEASUREMENT
/begin MEASUREMENT gang_berech_st_aktion "Aktion am Schalthebel" UWORD FORMULA_0310 0 0 0.0 255.0 READ_WRITE BIT_MASK 0x8 ECU_ADDRESS 0x3F865A /end MEASUREMENT
/begin MEASUREMENT gang_berech_st_gerade "berechneter Gang gerade" UWORD FORMULA_0309 0 0 0.0 255.0 READ_WRITE BIT_MASK 0x4 ECU_ADDRESS 0x3F865A /end MEASUREMENT
/begin MEASUREMENT gang_berech_st_neu "Gang neu berechnen" UWORD FORMULA_0312 0 0 0.0 255.0 READ_WRITE BIT_MASK 0x20 ECU_ADDRESS 0x3F865A /end MEASUREMENT
/begin MEASUREMENT gang_berech_st_plaus "berechneter Gang plausibel" UWORD FORMULA_0311 0 0 0.0 255.0 READ_WRITE BIT_MASK 0x10 ECU_ADDRESS 0x3F865A /end MEASUREMENT
/begin MEASUREMENT gang_berech_st_uebern "Gang neu berechnen" UWORD FORMULA_0313 0 0 0.0 255.0 READ_WRITE BIT_MASK 0x40 ECU_ADDRESS 0x3F865A /end MEASUREMENT
/begin MEASUREMENT gang_berech_st_unbek "berechneter Gang unbekannt" UWORD FORMULA_0307 0 0 0.0 255.0 READ_WRITE BIT_MASK 0x1 ECU_ADDRESS 0x3F865A /end MEASUREMENT
/begin MEASUREMENT gang_berech_st_ungerade "berechneter Gang ungerade" UWORD FORMULA_0308 0 0 0.0 255.0 READ_WRITE BIT_MASK 0x2 ECU_ADDRESS 0x3F865A /end MEASUREMENT
/begin MEASUREMENT gang_can "Gang CAN Botschaftswert fuer Kombi" SBYTE FORMULA_0135 0 0.0 -1.0 10.0 READ_WRITE ECU_ADDRESS 0x3F8662 /end MEASUREMENT
/begin MEASUREMENT gang_ks "Gang mit Kraftschluss" SBYTE FORMULA_0135 0 0.0 -1.0 10.0 READ_WRITE ECU_ADDRESS 0x3F8661 /end MEASUREMENT
/begin MEASUREMENT gang_n_verh "Getriebeeingangsdrehzahl / Getriebeabtriebsdrehzahl" SWORD FORMULA_0073 0 0.0 -32.0 31.99900054931641 READ_WRITE ECU_ADDRESS 0x3F8656 /end MEASUREMENT
/begin MEASUREMENT hdw_ign "" ULONG FORMULA_0000 0 0.0 0.0 4294967295.0 READ_WRITE ECU_ADDRESS 0x3F86CC /end MEASUREMENT
/begin MEASUREMENT hdw_ign_st "" UBYTE FORMULA_0003 0 0.0 0.0 255.0 READ_WRITE ECU_ADDRESS 0x3F86CA /end MEASUREMENT
/begin MEASUREMENT hdw_inj "" ULONG FORMULA_0000 0 0.0 0.0 4294967295.0 READ_WRITE ECU_ADDRESS 0x3F89F8 /end MEASUREMENT
/begin MEASUREMENT hdw_inj_st "" UBYTE FORMULA_0003 0 0.0 0.0 255.0 READ_WRITE ECU_ADDRESS 0x3F89F6 /end MEASUREMENT
/begin MEASUREMENT hfm_5ms_ad "Eingelesener Spannungswert 5ms" SWORD FORMULA_0114 0 0.0 0.0 1023.0 READ_WRITE ARRAY_SIZE 2 ECU_ADDRESS 0x3FBF9E MATRIX_DIM 2 1 1 /end MEASUREMENT
/begin MEASUREMENT hfm_dyn_vz "Zaehler Verweilzeit in der HFM-Dynamik" UBYTE FORMULA_0357 0 0.0 0.0 1.274999976158142 READ_WRITE ECU_ADDRESS 0x3FBFA9 /end MEASUREMENT
/begin MEASUREMENT hfm_fak_b1 "Aufteilung B1/B2 fuer S65" UWORD FORMULA_0073 0 0.0 0.0 4.0 READ_WRITE ECU_ADDRESS 0x3FBFC8 /end MEASUREMENT
/begin MEASUREMENT hfm_fil_koe_a2 "IIR Filterkoef. a2" FLOAT32_IEEE FORMULA_0716 0 0.0 -3.402823466385289e+038 3.402823466385289e+038 READ_WRITE ECU_ADDRESS 0x3FBFB0 /end MEASUREMENT
/begin MEASUREMENT hfm_fil_koe_a3 "IIR Filterkoef. a3" FLOAT32_IEEE FORMULA_0716 0 0.0 -3.402823466385289e+038 3.402823466385289e+038 READ_WRITE ECU_ADDRESS 0x3FBFB4 /end MEASUREMENT
/begin MEASUREMENT hfm_fil_koe_b1 "IIR Filterkoef. b1" FLOAT32_IEEE FORMULA_0716 0 0.0 -3.402823466385289e+038 3.402823466385289e+038 READ_WRITE ECU_ADDRESS 0x3FBFB8 /end MEASUREMENT
/begin MEASUREMENT hfm_fil_koe_b2 "IIR Filterkoef. b2" FLOAT32_IEEE FORMULA_0716 0 0.0 -3.402823466385289e+038 3.402823466385289e+038 READ_WRITE ECU_ADDRESS 0x3FBFBC /end MEASUREMENT
/begin MEASUREMENT hfm_iir_n "IIR-Tiefpass-Zeitelemnte" FLOAT32_IEEE FORMULA_0000 0 0.0 -3.402823466385289e+038 3.402823466385289e+038 READ_WRITE ARRAY_SIZE 2 ECU_ADDRESS 0x3FBFC0 MATRIX_DIM 2 1 1 /end MEASUREMENT
/begin MEASUREMENT hfm_ml_5ms_b1 "Luftmassenstrom aus HFM" SWORD FORMULA_0103 0 0.0 -100.0 1400.0 READ_WRITE ECU_ADDRESS 0x3FBFA2 /end MEASUREMENT
/begin MEASUREMENT hfm_ml_5ms_b2 "Luftmassenstrom aus HFM" SWORD FORMULA_0103 0 0.0 -100.0 1400.0 READ_WRITE ECU_ADDRESS 0x3FBFA4 /end MEASUREMENT
/begin MEASUREMENT hfm_mw "Mittelwerte der letzten x-Segmente" SWORD FORMULA_0103 0 0.0 -100.0 1400.0 READ_WRITE ARRAY_SIZE 16 ECU_ADDRESS 0x3FBF70 MATRIX_DIM 16 1 1 /end MEASUREMENT
/begin MEASUREMENT hfm_mw_1seg "Mittelwert HFM ueber 1 Segment" SWORD FORMULA_0103 0 0.0 -100.0 1400.0 READ_WRITE ECU_ADDRESS 0x3FBF90 /end MEASUREMENT
/begin MEASUREMENT hfm_mw_aeb "Luftmasse ML nach der Aenderungsbegrenzung" SWORD FORMULA_0103 0 0.0 -100.0 1400.0 READ_WRITE ECU_ADDRESS 0x3FBFAE /end MEASUREMENT
/begin MEASUREMENT hfm_mw_idx "Indexpointer in die HFM/MW-Queue" SBYTE FORMULA_0037 0 0.0 -128.0 127.0 READ_WRITE ECU_ADDRESS 0x3FBFA8 /end MEASUREMENT
/begin MEASUREMENT hfm_mw_korr "Mittelwert HFM nach Korrektur ueber KF" SWORD FORMULA_0103 0 0.0 -100.0 1400.0 READ_WRITE ECU_ADDRESS 0x3FBF96 /end MEASUREMENT
/begin MEASUREMENT hfm_mw_tan "Mittelwert HFM nach TAN Korrektur" SWORD FORMULA_0103 0 0.0 -100.0 1400.0 READ_WRITE ECU_ADDRESS 0x3FBF94 /end MEASUREMENT
/begin MEASUREMENT hfm_mw_xseg "Mittelwert HFM ueber x Segmente" SWORD FORMULA_0103 0 0.0 -100.0 1400.0 READ_WRITE ECU_ADDRESS 0x3FBF92 /end MEASUREMENT
/begin MEASUREMENT hfm_qadc_trig_error "Summe Fehltriggerungen read QADC" SBYTE FORMULA_0037 0 0.0 -128.0 127.0 READ_WRITE ECU_ADDRESS 0x3FBFA7 /end MEASUREMENT
/begin MEASUREMENT hfm_roh "HFM Wert nach der Bankaufteilung, ohne sek. Einfluesse" SWORD FORMULA_0103 0 0.0 -100.0 1400.0 READ_WRITE ARRAY_SIZE 2 ECU_ADDRESS 0x3FBF98 MATRIX_DIM 2 1 1 /end MEASUREMENT
/begin MEASUREMENT hfm_sek_ml_mvac "Luftmassenstrom aus MVAC" SWORD FORMULA_0103 0 0.0 -100.0 1400.0 READ_WRITE ARRAY_SIZE 2 ECU_ADDRESS 0x3FBFAA MATRIX_DIM 2 1 1 /end MEASUREMENT
/begin MEASUREMENT hfm_tan_korr "TAN Korrektur" UWORD FORMULA_0073 0 0.0 0.0 4.0 READ_WRITE ECU_ADDRESS 0x3FBF9C /end MEASUREMENT
/begin MEASUREMENT hfm_tpu_trig_error "Summe Fehltriggerungen TPU -> QADC" SBYTE FORMULA_0037 0 0.0 -128.0 127.0 READ_WRITE ECU_ADDRESS 0x3FBFA6 /end MEASUREMENT
/begin MEASUREMENT injt_freq "Frequenz" UWORD FORMULA_0724 0 0.0 0.0 65535.0 READ_WRITE ECU_ADDRESS 0x3FC02A /end MEASUREMENT
/begin MEASUREMENT injt_mask "Zylindermaske" UWORD FORMULA_0010 0 0.0 0.0 65535.0 READ_WRITE ECU_ADDRESS 0x3FC048 /end MEASUREMENT
/begin MEASUREMENT injt_pf_avg "gem. Druck" SWORD FORMULA_0110 0 0.0 0.0 10.0 READ_WRITE ECU_ADDRESS 0x3FC030 /end MEASUREMENT
/begin MEASUREMENT injt_pf_dev "Std-Abw. Druck" SWORD FORMULA_0110 0 0.0 0.0 10.0 READ_WRITE ECU_ADDRESS 0x3FC036 /end MEASUREMENT
/begin MEASUREMENT injt_pf_max "max. Druck" SWORD FORMULA_0110 0 0.0 0.0 10.0 READ_WRITE ECU_ADDRESS 0x3FC034 /end MEASUREMENT
/begin MEASUREMENT injt_pf_min "min. Druck" SWORD FORMULA_0110 0 0.0 0.0 10.0 READ_WRITE ECU_ADDRESS 0x3FC032 /end MEASUREMENT
/begin MEASUREMENT injt_pulse_count "Sollanzahl der Impulse" UWORD FORMULA_0010 0 0.0 0.0 65535.0 READ_WRITE ECU_ADDRESS 0x3FC02C /end MEASUREMENT
/begin MEASUREMENT injt_pulse_rem "Istanzahl der Impulse" UWORD FORMULA_0010 0 0.0 0.0 65535.0 READ_WRITE ECU_ADDRESS 0x3FC02E /end MEASUREMENT
/begin MEASUREMENT injt_run "Run-Bit" UBYTE FORMULA_0003 0 0.0 0.0 255.0 READ_WRITE ECU_ADDRESS 0x3FC026 /end MEASUREMENT
/begin MEASUREMENT injt_sample_cnt "Sampling Counter" UWORD FORMULA_0010 0 0.0 0.0 65535.0 READ_WRITE ECU_ADDRESS 0x3FC04A /end MEASUREMENT
/begin MEASUREMENT injt_status_mc "Status" UBYTE FORMULA_0003 0 0.0 0.0 255.0 READ_WRITE ECU_ADDRESS 0x3FC024 /end MEASUREMENT
/begin MEASUREMENT injt_status_tb "Status" UBYTE FORMULA_0722 0 0.0 0.0 255.0 READ_WRITE ECU_ADDRESS 0x3FC025 /end MEASUREMENT
/begin MEASUREMENT injt_tf_avg "gem. Temperatur" SWORD FORMULA_0023 0 0.0 -50.0 170.0 READ_WRITE ECU_ADDRESS 0x3FC038 /end MEASUREMENT
/begin MEASUREMENT injt_tf_dev "Std-Abw. Temperatur" SWORD FORMULA_0074 0 0.0 -1000.0 1000.0 READ_WRITE ECU_ADDRESS 0x3FC03E /end MEASUREMENT
/begin MEASUREMENT injt_tf_max "gem. Temperatur" SWORD FORMULA_0023 0 0.0 -50.0 170.0 READ_WRITE ECU_ADDRESS 0x3FC03C /end MEASUREMENT
/begin MEASUREMENT injt_tf_min "min. Temperatur" SWORD FORMULA_0023 0 0.0 -50.0 170.0 READ_WRITE ECU_ADDRESS 0x3FC03A /end MEASUREMENT
/begin MEASUREMENT injt_time "Injection Time" UWORD FORMULA_0723 0 0.0 0.0 655350.0 READ_WRITE ECU_ADDRESS 0x3FC028 /end MEASUREMENT
/begin MEASUREMENT injt_timeout "Timeout" UWORD FORMULA_0109 0 0.0 0.0 325.0 READ_WRITE ECU_ADDRESS 0x3FC04C /end MEASUREMENT
/begin MEASUREMENT injt_ub_avg "gem. Ub" SWORD FORMULA_0008 0 0.0 0.0 28.0 READ_WRITE ECU_ADDRESS 0x3FC040 /end MEASUREMENT
/begin MEASUREMENT injt_ub_dev "Std-Abw. Ub" SWORD FORMULA_0008 0 0.0 0.0 28.0 READ_WRITE ECU_ADDRESS 0x3FC046 /end MEASUREMENT
/begin MEASUREMENT injt_ub_max "max. Ub" SWORD FORMULA_0008 0 0.0 0.0 28.0 READ_WRITE ECU_ADDRESS 0x3FC044 /end MEASUREMENT
/begin MEASUREMENT injt_ub_min "min. Ub" SWORD FORMULA_0008 0 0.0 0.0 28.0 READ_WRITE ECU_ADDRESS 0x3FC042 /end MEASUREMENT
/begin MEASUREMENT j_gesamt "ges. Trägheitsmoment" UWORD FORMULA_0276 0 0.0 0.0 120.0 READ_WRITE ECU_ADDRESS 0x3F862A /end MEASUREMENT
/begin MEASUREMENT k2KB_bytes_ign "KWP" UWORD FORMULA_0010 0 0.0 0.0 65535.0 READ_WRITE ECU_ADDRESS 0x3F8702 /end MEASUREMENT
/begin MEASUREMENT k2KB_req_inj "KWP" UBYTE FORMULA_0003 0 0.0 0.0 255.0 READ_WRITE ECU_ADDRESS 0x3F8A3C /end MEASUREMENT
/begin MEASUREMENT k2KB_resp_ign "KWP" UBYTE FORMULA_0350 0 0.0 0.0 255.0 READ_WRITE ECU_ADDRESS 0x3F8700 /end MEASUREMENT
/begin MEASUREMENT k2KB_sid_ign "KWP" UBYTE FORMULA_0003 0 0.0 0.0 255.0 READ_WRITE ECU_ADDRESS 0x3F8701 /end MEASUREMENT
/begin MEASUREMENT ka_dtz_sum_all "Summenzuendwinkelverstellung KA" SWORD FORMULA_0102 0 0.0 -100.0 100.0 READ_WRITE ECU_ADDRESS 0x3F851A /end MEASUREMENT
/begin MEASUREMENT ka_dtz_sum_b1 "Summenzuendwinkelverstellung KA pro Bank" SWORD FORMULA_0102 0 0.0 -100.0 100.0 READ_WRITE ECU_ADDRESS 0x3F851C /end MEASUREMENT
/begin MEASUREMENT ka_dtz_sum_b2 "Summenzuendwinkelverstellung KA pro Bank" SWORD FORMULA_0102 0 0.0 -100.0 100.0 READ_WRITE ECU_ADDRESS 0x3F851E /end MEASUREMENT
/begin MEASUREMENT ka_tz_nv_sum_all "Summenklopfadaptionrueckziehwinkel KA" SLONG FORMULA_0225 0 0.0 -100.0 100.0 READ_WRITE ECU_ADDRESS 0x3F8520 /end MEASUREMENT
/begin MEASUREMENT ka_tz_nv_sum_b1 "Summenklopfadaptionrueckziehwinkel KA pro Bank" SLONG FORMULA_0225 0 0.0 -100.0 100.0 READ_WRITE ECU_ADDRESS 0x3F8524 /end MEASUREMENT
/begin MEASUREMENT ka_tz_nv_sum_b2 "Summenklopfadaptionrueckziehwinkel KA pro Bank" SLONG FORMULA_0225 0 0.0 -100.0 100.0 READ_WRITE ECU_ADDRESS 0x3F8528 /end MEASUREMENT
/begin MEASUREMENT kh_lam_soll_b1 "SOLL-Lambda - KAT-Heizen" UWORD FORMULA_0025 0 0.0 0.0 3.999000072479248 READ_WRITE ECU_ADDRESS 0x3F854E /end MEASUREMENT
/begin MEASUREMENT kh_lam_soll_b2 "SOLL-Lambda - KAT-Heizen" UWORD FORMULA_0025 0 0.0 0.0 3.999000072479248 READ_WRITE ECU_ADDRESS 0x3F8550 /end MEASUREMENT
/begin MEASUREMENT kh_st "Katheizstatus Aktiv bzw. Inaktiv" UWORD FORMULA_0281 0 0.0 0.0 65535.0 READ_WRITE BIT_MASK 0x3FF ECU_ADDRESS 0x3F864A /end MEASUREMENT
/begin MEASUREMENT kh_st_ed "KH Sperrstatus wegen ED(Fehlermatrix)" UWORD FORMULA_0290 0 0 0.0 255.0 READ_WRITE BIT_MASK 0x100 ECU_ADDRESS 0x3F864A /end MEASUREMENT
/begin MEASUREMENT kh_st_eingriff "aktive, KH Eingriffe" UWORD FORMULA_0293 0 0 0.0 255.0 READ_WRITE BIT_MASK 0x800 ECU_ADDRESS 0x3F864A /end MEASUREMENT
/begin MEASUREMENT kh_st_n "KH Sperrstatus wegen Drehzahlschwelle" UWORD FORMULA_0284 0 0 0.0 255.0 READ_WRITE BIT_MASK 0x4 ECU_ADDRESS 0x3F864A /end MEASUREMENT
/begin MEASUREMENT kh_st_pksrpl "KH Sperrstatus wegen pksr PL" UWORD FORMULA_0291 0 0 0.0 255.0 READ_WRITE BIT_MASK 0x200 ECU_ADDRESS 0x3F864A /end MEASUREMENT
/begin MEASUREMENT kh_st_pumg "KH Sperrstatus wegen pumg" UWORD FORMULA_0289 0 0 0.0 255.0 READ_WRITE BIT_MASK 0x80 ECU_ADDRESS 0x3F864A /end MEASUREMENT
/begin MEASUREMENT kh_st_rf "KH Sperrstatus wegen rf-Schwelle" UWORD FORMULA_0283 0 0 0.0 255.0 READ_WRITE BIT_MASK 0x2 ECU_ADDRESS 0x3F864A /end MEASUREMENT
/begin MEASUREMENT kh_st_sk "KH Sperrstatus wegen SK" UWORD FORMULA_0286 0 0 0.0 255.0 READ_WRITE BIT_MASK 0x10 ECU_ADDRESS 0x3F864A /end MEASUREMENT
/begin MEASUREMENT kh_st_sl "KH Sperrstatus SL" UWORD FORMULA_0292 0 0 0.0 255.0 READ_WRITE BIT_MASK 0x400 ECU_ADDRESS 0x3F864A /end MEASUREMENT
/begin MEASUREMENT kh_st_smg "KH BIT fuer SMG" UWORD FORMULA_0297 0 0 0.0 255.0 READ_WRITE BIT_MASK 0x8000 ECU_ADDRESS 0x3F864A /end MEASUREMENT
/begin MEASUREMENT kh_st_t_ml "KH Sperrstatus wegen Zeit seit Motor laeuft" UWORD FORMULA_0285 0 0 0.0 255.0 READ_WRITE BIT_MASK 0x8 ECU_ADDRESS 0x3F864A /end MEASUREMENT
/begin MEASUREMENT kh_st_tan "KH Sperrstatus wegen tan" UWORD FORMULA_0288 0 0 0.0 255.0 READ_WRITE BIT_MASK 0x40 ECU_ADDRESS 0x3F864A /end MEASUREMENT
/begin MEASUREMENT kh_st_tkat "KH Sperrstatus wegen tkat" UWORD FORMULA_0282 0 0 0.0 255.0 READ_WRITE BIT_MASK 0x1 ECU_ADDRESS 0x3F864A /end MEASUREMENT
/begin MEASUREMENT kh_st_tkat_zyklus "KH Zyklusflag fuer TKAT Schwelle erreicht" UWORD FORMULA_0296 0 0 0.0 255.0 READ_WRITE BIT_MASK 0x4000 ECU_ADDRESS 0x3F864A /end MEASUREMENT
/begin MEASUREMENT kh_st_van "KH Sperrstatus, Vanos Katheizen" UWORD FORMULA_0294 0 0 0.0 255.0 READ_WRITE BIT_MASK 0x1000 ECU_ADDRESS 0x3F864A /end MEASUREMENT
/begin MEASUREMENT kh_st_vtkat "KH Sperrstatus wegen v" UWORD FORMULA_0287 0 0 0.0 255.0 READ_WRITE BIT_MASK 0x20 ECU_ADDRESS 0x3F864A /end MEASUREMENT
/begin MEASUREMENT kh_st_vtkat_zyklus "KH Zyklusflag fuer v ungleich 0 und TKAT erreicht" UWORD FORMULA_0295 0 0 0.0 255.0 READ_WRITE BIT_MASK 0x2000 ECU_ADDRESS 0x3F864A /end MEASUREMENT
/begin MEASUREMENT kh_st_xx "Alle Statusflags vom kh_st" UWORD FORMULA_0010 0 0.0 0.0 65535.0 READ_WRITE ECU_ADDRESS 0x3F864A /end MEASUREMENT
/begin MEASUREMENT kh_van_fakt_kf_Auslass "Gewichtungsfaktor Kennfeld-KH" UWORD FORMULA_0199 0 0.0 0.0 2.0 READ_WRITE ECU_ADDRESS 0x3F8648 /end MEASUREMENT
/begin MEASUREMENT kh_van_fakt_kf_Einlass "Gewichtungsfaktor Kennfeld-KH" UWORD FORMULA_0199 0 0.0 0.0 2.0 READ_WRITE ECU_ADDRESS 0x3F8646 /end MEASUREMENT
/begin MEASUREMENT kl87_st "KL87-Status" UBYTE FORMULA_0141 0 0.0 0.0 255.0 READ_WRITE ECU_ADDRESS 0x3F8917 /end MEASUREMENT
/begin MEASUREMENT kr_dtz_sum_b1 "Bankselektiver Klopfregelungseingriffsumme." SLONG FORMULA_0226 0 0.0 -100.0 100.0 READ_WRITE ECU_ADDRESS 0x3F852C /end MEASUREMENT
/begin MEASUREMENT kr_dtz_sum_b2 "Bankselektiver Klopfregelungseingriffsumme." SLONG FORMULA_0226 0 0.0 -100.0 100.0 READ_WRITE ECU_ADDRESS 0x3F8530 /end MEASUREMENT
/begin MEASUREMENT kva_can "Letzter Kraftstoffverbrauch in ul (0xFFFF = Fehler)" UWORD FORMULA_0144 0 0.0 0.0 65.53500366210938 READ_WRITE ECU_ADDRESS 0x3F892C /end MEASUREMENT
/begin MEASUREMENT kw_diag "AD-Wert Kurbelwellendiagnose" SWORD FORMULA_0114 0 0.0 0.0 1023.0 READ_WRITE ECU_ADDRESS 0x3F86D4 /end MEASUREMENT
/begin MEASUREMENT kwp_fp_st_ign "Status KWP-FP" UBYTE FORMULA_0003 0 0.0 0.0 255.0 READ_WRITE ECU_ADDRESS 0x3F86F3 /end MEASUREMENT
/begin MEASUREMENT kwp_fp_st_inj "Status KWP-FP" UBYTE FORMULA_0003 0 0.0 0.0 255.0 READ_WRITE ECU_ADDRESS 0x3F8A15 /end MEASUREMENT
/begin MEASUREMENT lam_delta_lim_b1 "begrenzte Regelabweichung" SWORD FORMULA_0025 0 0.0 -2.0 1.999899983406067 READ_WRITE ECU_ADDRESS 0x3F87BA /end MEASUREMENT
/begin MEASUREMENT lam_delta_lim_b2 "begrenzte Regelabweichung" SWORD FORMULA_0025 0 0.0 -2.0 1.999899983406067 READ_WRITE ECU_ADDRESS 0x3F87BC /end MEASUREMENT
/begin MEASUREMENT lam_ist_ers_b1 "LAM-IST - Ersatz" UWORD FORMULA_0025 0 0.0 0.0 3.999000072479248 READ_WRITE ECU_ADDRESS 0x3F87AC /end MEASUREMENT
/begin MEASUREMENT lam_ist_ers_b2 "LAM-IST - Ersatz" UWORD FORMULA_0025 0 0.0 0.0 3.999000072479248 READ_WRITE ECU_ADDRESS 0x3F87AE /end MEASUREMENT
/begin MEASUREMENT lam_ist_mw_b1 "Mittelwert IST-Lambda" UWORD FORMULA_0025 0 0.0 0.0 3.999000072479248 READ_WRITE ECU_ADDRESS 0x3F87A8 /end MEASUREMENT
/begin MEASUREMENT lam_ist_mw_b2 "Mittelwert IST-Lambda" UWORD FORMULA_0025 0 0.0 0.0 3.999000072479248 READ_WRITE ECU_ADDRESS 0x3F87AA /end MEASUREMENT
/begin MEASUREMENT lam_reg_f_b1 "Regeleingriff" UWORD FORMULA_0024 0 0.0 0.0 1.998999953269959 READ_WRITE ECU_ADDRESS 0x3F87A0 /end MEASUREMENT
/begin MEASUREMENT lam_reg_f_b2 "Regeleingriff" UWORD FORMULA_0024 0 0.0 0.0 1.998999953269959 READ_WRITE ECU_ADDRESS 0x3F87A2 /end MEASUREMENT
/begin MEASUREMENT lam_reg_max_b1 "max. Reglereingriff" UWORD FORMULA_0086 0 0 0.0 255.0 READ_WRITE BIT_MASK 0x80 ECU_ADDRESS 0x3F87A4 /end MEASUREMENT
/begin MEASUREMENT lam_reg_max_b2 "max. Reglereingriff" UWORD FORMULA_0086 0 0 0.0 255.0 READ_WRITE BIT_MASK 0x80 ECU_ADDRESS 0x3F87A6 /end MEASUREMENT
/begin MEASUREMENT lam_reg_min_b1 "min. Reglereingriff" UWORD FORMULA_0085 0 0 0.0 255.0 READ_WRITE BIT_MASK 0x40 ECU_ADDRESS 0x3F87A4 /end MEASUREMENT
/begin MEASUREMENT lam_reg_min_b2 "min. Reglereingriff" UWORD FORMULA_0085 0 0 0.0 255.0 READ_WRITE BIT_MASK 0x40 ECU_ADDRESS 0x3F87A6 /end MEASUREMENT
/begin MEASUREMENT lam_reg_reset_sa_b1 "LA-Regler RESET - SA" UWORD FORMULA_0087 0 0 0.0 255.0 READ_WRITE BIT_MASK 0x100 ECU_ADDRESS 0x3F87A4 /end MEASUREMENT
/begin MEASUREMENT lam_reg_reset_sa_b2 "LA-Regler RESET - SA" UWORD FORMULA_0087 0 0 0.0 255.0 READ_WRITE BIT_MASK 0x100 ECU_ADDRESS 0x3F87A6 /end MEASUREMENT
/begin MEASUREMENT lam_reg_reset_slp_b1 "LA-Regler-RESET - SLP" UWORD FORMULA_0088 0 0 0.0 255.0 READ_WRITE BIT_MASK 0x200 ECU_ADDRESS 0x3F87A4 /end MEASUREMENT
/begin MEASUREMENT lam_reg_reset_slp_b2 "LA-Regler-RESET - SLP" UWORD FORMULA_0088 0 0 0.0 255.0 READ_WRITE BIT_MASK 0x200 ECU_ADDRESS 0x3F87A6 /end MEASUREMENT
/begin MEASUREMENT lam_reg_st_b1 "LA-Regler-Status" UWORD FORMULA_0080 0 0.0 0.0 65535.0 READ_WRITE ECU_ADDRESS 0x3F87A4 /end MEASUREMENT
/begin MEASUREMENT lam_reg_st_b2 "LA-Regler-Status" UWORD FORMULA_0080 0 0.0 0.0 65535.0 READ_WRITE ECU_ADDRESS 0x3F87A6 /end MEASUREMENT
/begin MEASUREMENT lam_reg_stat_b1 "LA-Regler Position" UWORD FORMULA_0082 0 0 0.0 255.0 READ_WRITE BIT_MASK 0x8 ECU_ADDRESS 0x3F87A4 /end MEASUREMENT
/begin MEASUREMENT lam_reg_stat_b2 "LA-Regler Position" UWORD FORMULA_0082 0 0 0.0 255.0 READ_WRITE BIT_MASK 0x8 ECU_ADDRESS 0x3F87A6 /end MEASUREMENT
/begin MEASUREMENT lam_reg_stat_trim_b1 "LA-Regler Position fuer TRIM-Regelung" UWORD FORMULA_0089 0 0 0.0 255.0 READ_WRITE BIT_MASK 0x400 ECU_ADDRESS 0x3F87A4 /end MEASUREMENT
/begin MEASUREMENT lam_reg_stat_trim_b2 "LA-Regler Position fuer TRIM-Regelung" UWORD FORMULA_0089 0 0 0.0 255.0 READ_WRITE BIT_MASK 0x400 ECU_ADDRESS 0x3F87A6 /end MEASUREMENT
/begin MEASUREMENT lam_regler_st_b1 "LA-Regler-Status" UWORD FORMULA_0081 0 0.0 0.0 65535.0 READ_WRITE BIT_MASK 0x7 ECU_ADDRESS 0x3F87A4 /end MEASUREMENT
/begin MEASUREMENT lam_regler_st_b2 "LA-Regler-Status" UWORD FORMULA_0081 0 0.0 0.0 65535.0 READ_WRITE BIT_MASK 0x7 ECU_ADDRESS 0x3F87A6 /end MEASUREMENT
/begin MEASUREMENT lam_soll_b1 "ausgegebenes SOLL-Lambda" UWORD FORMULA_0025 0 0.0 0.0 3.999000072479248 READ_WRITE ECU_ADDRESS 0x3F879C /end MEASUREMENT
/begin MEASUREMENT lam_soll_b2 "ausgegebenes SOLL-Lambda" UWORD FORMULA_0025 0 0.0 0.0 3.999000072479248 READ_WRITE ECU_ADDRESS 0x3F879E /end MEASUREMENT
/begin MEASUREMENT lam_soll_ms_kat_b1 "gespeicherte Sauerstoffmasse im KAT" SWORD FORMULA_0090 0 0.0 -3276.800048828125 3276.699951171875 READ_WRITE ECU_ADDRESS 0x3F87B2 /end MEASUREMENT
/begin MEASUREMENT lam_soll_ms_kat_b2 "gespeicherte Sauerstoffmasse im KAT" SWORD FORMULA_0090 0 0.0 -3276.800048828125 3276.699951171875 READ_WRITE ECU_ADDRESS 0x3F87B4 /end MEASUREMENT
/begin MEASUREMENT lam_soll_puls_adapt_fett_b1 "Adaption FETT" UWORD FORMULA_0092 0 0 0.0 255.0 READ_WRITE BIT_MASK 0x2 ECU_ADDRESS 0x3F87B6 /end MEASUREMENT
/begin MEASUREMENT lam_soll_puls_adapt_fett_b2 "Adaption FETT" UWORD FORMULA_0092 0 0 0.0 255.0 READ_WRITE BIT_MASK 0x2 ECU_ADDRESS 0x3F87B8 /end MEASUREMENT
/begin MEASUREMENT lam_soll_puls_adapt_mager_b1 "Adaption MAGER" UWORD FORMULA_0091 0 0 0.0 255.0 READ_WRITE BIT_MASK 0x1 ECU_ADDRESS 0x3F87B6 /end MEASUREMENT
/begin MEASUREMENT lam_soll_puls_adapt_mager_b2 "Adaption MAGER" UWORD FORMULA_0091 0 0 0.0 255.0 READ_WRITE BIT_MASK 0x1 ECU_ADDRESS 0x3F87B8 /end MEASUREMENT
/begin MEASUREMENT lam_soll_puls_ausr_b1 "O2-Ausraeumfunktion" UWORD FORMULA_0097 0 0 0.0 255.0 READ_WRITE BIT_MASK 0x80 ECU_ADDRESS 0x3F87B6 /end MEASUREMENT
/begin MEASUREMENT lam_soll_puls_ausr_b2 "O2-Ausraeumfunktion" UWORD FORMULA_0097 0 0 0.0 255.0 READ_WRITE BIT_MASK 0x80 ECU_ADDRESS 0x3F87B8 /end MEASUREMENT
/begin MEASUREMENT lam_soll_puls_ausr_sl_b1 "O2-Ausraeumfunktion nach SLP" UWORD FORMULA_0098 0 0 0.0 255.0 READ_WRITE BIT_MASK 0x100 ECU_ADDRESS 0x3F87B6 /end MEASUREMENT
/begin MEASUREMENT lam_soll_puls_ausr_sl_b2 "O2-Ausraeumfunktion nach SLP" UWORD FORMULA_0098 0 0 0.0 255.0 READ_WRITE BIT_MASK 0x100 ECU_ADDRESS 0x3F87B8 /end MEASUREMENT
/begin MEASUREMENT lam_soll_puls_ausr_sl_trig_b1 "Trigger O2-Ausraeumfunktion nach SLP" UWORD FORMULA_0099 0 0 0.0 255.0 READ_WRITE BIT_MASK 0x200 ECU_ADDRESS 0x3F87B6 /end MEASUREMENT
/begin MEASUREMENT lam_soll_puls_ausr_sl_trig_b2 "Trigger O2-Ausraeumfunktion nach SLP" UWORD FORMULA_0099 0 0 0.0 255.0 READ_WRITE BIT_MASK 0x200 ECU_ADDRESS 0x3F87B8 /end MEASUREMENT
/begin MEASUREMENT lam_soll_puls_b1 "Pulsgenerator" UWORD FORMULA_0093 0 0 0.0 255.0 READ_WRITE BIT_MASK 0x4 ECU_ADDRESS 0x3F87B6 /end MEASUREMENT
/begin MEASUREMENT lam_soll_puls_b2 "Pulsgenerator" UWORD FORMULA_0093 0 0 0.0 255.0 READ_WRITE BIT_MASK 0x4 ECU_ADDRESS 0x3F87B8 /end MEASUREMENT
/begin MEASUREMENT lam_soll_puls_fett_betrieb_b1 "FETT-Betrieb" UWORD FORMULA_0095 0 0 0.0 255.0 READ_WRITE BIT_MASK 0x20 ECU_ADDRESS 0x3F87B6 /end MEASUREMENT
/begin MEASUREMENT lam_soll_puls_fett_betrieb_b2 "FETT-Betrieb" UWORD FORMULA_0095 0 0 0.0 255.0 READ_WRITE BIT_MASK 0x20 ECU_ADDRESS 0x3F87B8 /end MEASUREMENT
/begin MEASUREMENT lam_soll_puls_freigabe_b1 "Freigabe Pulsgenerator" UWORD FORMULA_0094 0 0 0.0 255.0 READ_WRITE BIT_MASK 0x8 ECU_ADDRESS 0x3F87B6 /end MEASUREMENT
/begin MEASUREMENT lam_soll_puls_freigabe_b2 "Freigabe Pulsgenerator" UWORD FORMULA_0094 0 0 0.0 255.0 READ_WRITE BIT_MASK 0x8 ECU_ADDRESS 0x3F87B8 /end MEASUREMENT
/begin MEASUREMENT lam_soll_puls_lam_filt_b1 "LAM-SOLL-Filterung" UWORD FORMULA_0096 0 0 0.0 255.0 READ_WRITE BIT_MASK 0x40 ECU_ADDRESS 0x3F87B6 /end MEASUREMENT
/begin MEASUREMENT lam_soll_puls_lam_filt_b2 "LAM-SOLL-Filterung" UWORD FORMULA_0096 0 0 0.0 255.0 READ_WRITE BIT_MASK 0x40 ECU_ADDRESS 0x3F87B8 /end MEASUREMENT
/begin MEASUREMENT lam_soll_puls_st_b1 "Status-Pulsgenerator" UWORD FORMULA_0080 0 0.0 0.0 65535.0 READ_WRITE ECU_ADDRESS 0x3F87B6 /end MEASUREMENT
/begin MEASUREMENT lam_soll_puls_st_b2 "Status-Pulsgenerator" UWORD FORMULA_0080 0 0.0 0.0 65535.0 READ_WRITE ECU_ADDRESS 0x3F87B8 /end MEASUREMENT
/begin MEASUREMENT lam_soll_vl_max "Soll-Lambda bei max VL" UWORD FORMULA_0025 0 0.0 0.0 3.999000072479248 READ_WRITE ECU_ADDRESS 0x3F8804 /end MEASUREMENT
/begin MEASUREMENT lam_soll_wl "SOLL-Lambda - Warmlauf" UWORD FORMULA_0025 0 0.0 0.0 3.999000072479248 READ_WRITE ECU_ADDRESS 0x3F87B0 /end MEASUREMENT
/begin MEASUREMENT lam_ti_min_b1 "min. TI fuer LA-Regelung" UWORD FORMULA_0084 0 0 0.0 255.0 READ_WRITE BIT_MASK 0x20 ECU_ADDRESS 0x3F87A4 /end MEASUREMENT
/begin MEASUREMENT lam_ti_min_b2 "min. TI fuer LA-Regelung" UWORD FORMULA_0084 0 0 0.0 255.0 READ_WRITE BIT_MASK 0x20 ECU_ADDRESS 0x3F87A6 /end MEASUREMENT
/begin MEASUREMENT lam_wf_verz_b1 "WF-Verzoegerung" UWORD FORMULA_0083 0 0 0.0 255.0 READ_WRITE BIT_MASK 0x10 ECU_ADDRESS 0x3F87A4 /end MEASUREMENT
/begin MEASUREMENT lam_wf_verz_b2 "WF-Verzoegerung" UWORD FORMULA_0083 0 0 0.0 255.0 READ_WRITE BIT_MASK 0x10 ECU_ADDRESS 0x3F87A6 /end MEASUREMENT
/begin MEASUREMENT lavk_obd_act_exd_n_soll "Prueflauf - angeforderte Drehzahl" SWORD FORMULA_0006 0 0.0 0.0 10000.0 READ_WRITE ECU_ADDRESS 0x3F89F2 /end MEASUREMENT
/begin MEASUREMENT lavk_obd_dyn_kat_exd_n_soll "Prueflauf - angeforderte Drehzahl" SWORD FORMULA_0006 0 0.0 0.0 10000.0 READ_WRITE ECU_ADDRESS 0x3F89F4 /end MEASUREMENT
/begin MEASUREMENT lavk_obd_error "Status LAMBDA-FEHLER im System" UWORD FORMULA_0010 0 0.0 0.0 65535.0 READ_WRITE ARRAY_SIZE 2 ECU_ADDRESS 0x3F89EE MATRIX_DIM 2 1 1 /end MEASUREMENT
/begin MEASUREMENT laz_ti_mks_roh "LAZ-Einspritzmasse ohne WL" UWORD FORMULA_0111 0 0.0 0.0 1023.984313964844 READ_WRITE ARRAY_SIZE 2 ECU_ADDRESS 0x3F857E MATRIX_DIM 2 1 1 /end MEASUREMENT
/begin MEASUREMENT llr_flags "LLR-Flags" UBYTE FORMULA_0003 0 0.0 0.0 255.0 READ_WRITE ECU_ADDRESS 0x3F857D /end MEASUREMENT
/begin MEASUREMENT llr_n_soll "Leerlaufdrehzahl" SWORD FORMULA_0006 0 0.0 0.0 10000.0 READ_WRITE ECU_ADDRESS 0x3F86C8 /end MEASUREMENT
/begin MEASUREMENT llr_state "LLR-Zustand" UBYTE FORMULA_0243 0 0.0 0.0 255.0 READ_WRITE ECU_ADDRESS 0x3F857C /end MEASUREMENT
/begin MEASUREMENT md_can_begr_st "MD-Begrenzungen" UBYTE FORMULA_0252 0 0.0 0.0 255.0 READ_WRITE ECU_ADDRESS 0x3F85A8 /end MEASUREMENT
/begin MEASUREMENT md_can_kkos_max "max. Moment fuer KKOS" SWORD FORMULA_0009 0 0.0 -100.0 1000.0 READ_WRITE ECU_ADDRESS 0x3F85AA /end MEASUREMENT
/begin MEASUREMENT md_dsc_freig_st "DSC-Freigabe" UBYTE FORMULA_0259 0 0.0 0.0 255.0 READ_WRITE ECU_ADDRESS 0x3F85CE /end MEASUREMENT
/begin MEASUREMENT md_dsc_sperr_st "Sperre DSC-Eingriff" UBYTE FORMULA_0253 0 0.0 0.0 255.0 READ_WRITE ECU_ADDRESS 0x3F85A9 /end MEASUREMENT
/begin MEASUREMENT md_fw_bls "Eingriff BLS-Fahrerwunsch" UBYTE FORMULA_0256 0 0.0 0.0 255.0 READ_WRITE ECU_ADDRESS 0x3F85AE /end MEASUREMENT
/begin MEASUREMENT md_fw_rel "rel. Wunschmoment" SWORD FORMULA_0001 0 0.0 0.0 100.0 READ_WRITE ECU_ADDRESS 0x3F8596 /end MEASUREMENT
/begin MEASUREMENT Md_gennm_copy "gefiltertes Generatormoment absolut" SWORD FORMULA_0113 0 0.0 -3276.800048828125 3276.699951171875 READ_WRITE ECU_ADDRESS 0x3F888E /end MEASUREMENT
/begin MEASUREMENT md_ind_ml_st "Status Sollmoment-Luft" UBYTE FORMULA_0274 0 0.0 0.0 255.0 READ_WRITE ECU_ADDRESS 0x3F861E /end MEASUREMENT
/begin MEASUREMENT md_ind_ne "ind. Moment nach Eingriff" SWORD FORMULA_0009 0 0.0 -100.0 1000.0 READ_WRITE ECU_ADDRESS 0x3F8548 /end MEASUREMENT
/begin MEASUREMENT md_ind_opt_la_rg_zw_min "Moment mit LA/RG bei min. ZW" SWORD FORMULA_0009 0 0.0 -100.0 1000.0 READ_WRITE ECU_ADDRESS 0x3F86E2 /end MEASUREMENT
/begin MEASUREMENT md_ind_schlepp_ist "Schleppmoment (aktuell)" SWORD FORMULA_0009 0 0.0 -100.0 1000.0 READ_WRITE ECU_ADDRESS 0x3F86DE /end MEASUREMENT
/begin MEASUREMENT md_ind_schlepp_min "Schleppmoment bei MIN" SWORD FORMULA_0009 0 0.0 -100.0 1000.0 READ_WRITE ECU_ADDRESS 0x3F86E0 /end MEASUREMENT
/begin MEASUREMENT md_ind_tz_st "Status Sollmoment-TZ" UBYTE FORMULA_0274 0 0.0 0.0 255.0 READ_WRITE ECU_ADDRESS 0x3F861D /end MEASUREMENT
/begin MEASUREMENT md_kupp_ist "Moment an der Kupplung" SWORD FORMULA_0009 0 0.0 -100.0 1000.0 READ_WRITE ECU_ADDRESS 0x3F8546 /end MEASUREMENT
/begin MEASUREMENT md_kupp_ist_ve "Moment an der Kupplung vor Eingriff" SWORD FORMULA_0009 0 0.0 -100.0 1000.0 READ_WRITE ECU_ADDRESS 0x3F8544 /end MEASUREMENT
/begin MEASUREMENT md_kupp_max "Maximalmoment an der Kupplung" SWORD FORMULA_0009 0 0.0 -100.0 1000.0 READ_WRITE ECU_ADDRESS 0x3F86DA /end MEASUREMENT
/begin MEASUREMENT md_kupp_max_can "CAN-Maximalmoment an der Kupplung" SWORD FORMULA_0009 0 0.0 -100.0 1000.0 READ_WRITE ECU_ADDRESS 0x3F86DC /end MEASUREMENT
/begin MEASUREMENT md_kupp_min "Minimalmoment an der Kupplung" SWORD FORMULA_0009 0 0.0 -100.0 1000.0 READ_WRITE ECU_ADDRESS 0x3F8638 /end MEASUREMENT
/begin MEASUREMENT md_kupp_min_filter "SAWE-Filter bei min Moment" SWORD FORMULA_0009 0 0.0 -100.0 1000.0 READ_WRITE ECU_ADDRESS 0x3F8622 /end MEASUREMENT
/begin MEASUREMENT md_kupp_wunsch "Wunschmoment" SWORD FORMULA_0009 0 0.0 -100.0 1000.0 READ_WRITE ECU_ADDRESS 0x3F859A /end MEASUREMENT
/begin MEASUREMENT md_kupp_wunsch_begr "begrenztes Wunschmoment fuer CAN" SWORD FORMULA_0009 0 0.0 -100.0 1000.0 READ_WRITE ECU_ADDRESS 0x3F859C /end MEASUREMENT
/begin MEASUREMENT md_kupp_wunsch_filter_rel "gefiltertes Wunschmoment" SWORD FORMULA_0001 0 0.0 0.0 100.0 READ_WRITE ECU_ADDRESS 0x3F859E /end MEASUREMENT
/begin MEASUREMENT md_kupp_wunsch_ml "Wunschmoment fuer den Luftpfad" SWORD FORMULA_0009 0 0.0 -100.0 1000.0 READ_WRITE ECU_ADDRESS 0x3F8620 /end MEASUREMENT
/begin MEASUREMENT md_kupp_wunsch_tz "Wunschmoment fuer den Zuendwinkelpfad" SWORD FORMULA_0009 0 0.0 -100.0 1000.0 READ_WRITE ECU_ADDRESS 0x3F85A0 /end MEASUREMENT
/begin MEASUREMENT md_max_fak_power "Powerfaktor" UWORD FORMULA_0073 0 0.0 0.0 4.0 READ_WRITE ECU_ADDRESS 0x3F85A2 /end MEASUREMENT
/begin MEASUREMENT md_ml_soll "Soll-Luftmasse" SWORD FORMULA_0103 0 0.0 -100.0 1400.0 READ_WRITE ECU_ADDRESS 0x3F85DC /end MEASUREMENT
/begin MEASUREMENT md_nbegr_st "Status n-Begrenzung" UBYTE FORMULA_0255 0 0.0 0.0 255.0 READ_WRITE ECU_ADDRESS 0x3F85AD /end MEASUREMENT
/begin MEASUREMENT md_nbegr_t "Zeit im Begrenzer" UWORD FORMULA_0109 0 0.0 0.0 325.0 READ_WRITE ECU_ADDRESS 0x3F85A6 /end MEASUREMENT
/begin MEASUREMENT md_rad_can_mdrv "max. Radmoment" SLONG FORMULA_0272 0 0.0 -1500.0 10000.0 READ_WRITE ECU_ADDRESS 0x3F8610 /end MEASUREMENT
/begin MEASUREMENT md_rad_ist "Radistmoment" SLONG FORMULA_0272 0 0.0 -1500.0 10000.0 READ_WRITE ECU_ADDRESS 0x3F8618 /end MEASUREMENT
/begin MEASUREMENT md_rad_min "min. Radmoment" SLONG FORMULA_0272 0 0.0 -1500.0 10000.0 READ_WRITE ECU_ADDRESS 0x3F8608 /end MEASUREMENT
/begin MEASUREMENT md_rad_schlepp_ist "min. Radschleppmoment" SLONG FORMULA_0272 0 0.0 -1500.0 10000.0 READ_WRITE ECU_ADDRESS 0x3F860C /end MEASUREMENT
/begin MEASUREMENT md_rad_soll "Radsollmoment" SLONG FORMULA_0272 0 0.0 -1500.0 10000.0 READ_WRITE ECU_ADDRESS 0x3F8614 /end MEASUREMENT
/begin MEASUREMENT md_rf_max "rf_max mit pt-Korr" SWORD FORMULA_0007 0 0.0 0.0 2.0 READ_WRITE ECU_ADDRESS 0x3F86E4 /end MEASUREMENT
/begin MEASUREMENT md_rf_max_roh "rf_max" SWORD FORMULA_0007 0 0.0 0.0 2.0 READ_WRITE ECU_ADDRESS 0x3F86E6 /end MEASUREMENT
/begin MEASUREMENT md_rf_min_pt "rf_min mit Komp." SWORD FORMULA_0007 0 0.0 0.0 2.0 READ_WRITE ECU_ADDRESS 0x3F86E8 /end MEASUREMENT
/begin MEASUREMENT md_rf_soll "Soll-rf" SWORD FORMULA_0007 0 0.0 0.0 2.0 READ_WRITE ECU_ADDRESS 0x3F8632 /end MEASUREMENT
/begin MEASUREMENT md_rf_soll_pt_fr_wicht "Soll-rf mit pt-,fr,fra-Korr und Wichtung" SWORD FORMULA_0007 0 0.0 0.0 2.0 READ_WRITE ARRAY_SIZE 2 ECU_ADDRESS 0x3F86EA MATRIX_DIM 2 1 1 /end MEASUREMENT
/begin MEASUREMENT md_rf_soll_pt_roh "Soll-rf mit pt-Korr" SWORD FORMULA_0007 0 0.0 0.0 2.0 READ_WRITE ECU_ADDRESS 0x3F86EE /end MEASUREMENT
/begin MEASUREMENT md_sk_mode "SK-Mode Momentenmanager" UBYTE FORMULA_0012 0 0.0 0.0 255.0 READ_WRITE ECU_ADDRESS 0x3F8655 /end MEASUREMENT
/begin MEASUREMENT md_sk_ti_st "Freigabemaske fuer Einspritzkanaele" UWORD FORMULA_0010 0 0.0 0.0 65535.0 READ_WRITE ECU_ADDRESS 0x3F867A /end MEASUREMENT
/begin MEASUREMENT md_st "MD-Stati" UWORD FORMULA_0010 0 0.0 0.0 65535.0 READ_WRITE ECU_ADDRESS 0x3F85A4 /end MEASUREMENT
/begin MEASUREMENT md_tz_soll_mittel "mittlerer Soll-TZ" SWORD FORMULA_0102 0 0.0 -50.0 60.0 READ_WRITE ECU_ADDRESS 0x3F854A /end MEASUREMENT
/begin MEASUREMENT md_vbegr_st "Status v-Begrenzung" UBYTE FORMULA_0254 0 0.0 0.0 255.0 READ_WRITE ECU_ADDRESS 0x3F85AC /end MEASUREMENT
/begin MEASUREMENT md_wunsch_rel "Ergebnis der Max-Auswahl" SWORD FORMULA_0001 0 0.0 0.0 100.0 READ_WRITE ECU_ADDRESS 0x3F8598 /end MEASUREMENT
/begin MEASUREMENT mdrv_st "MDRV-Status (CAN)" UBYTE FORMULA_0163 0 0.0 0.0 255.0 READ_WRITE ECU_ADDRESS 0x3F8976 /end MEASUREMENT
/begin MEASUREMENT mdrv_st_dme "MDRV-Status" UBYTE FORMULA_0164 0 0.0 0.0 255.0 READ_WRITE ECU_ADDRESS 0x3F8977 /end MEASUREMENT
/begin MEASUREMENT mdrv_st_dsc_akt "MDRV-Status DSC (CAN)" UBYTE FORMULA_0215 0 0.0 0.0 255.0 READ_WRITE ECU_ADDRESS 0x3F8A17 /end MEASUREMENT
/begin MEASUREMENT mdrv_st_mod_albv_akt "MDRV-Status aLBV (CAN)" UBYTE FORMULA_0219 0 0.0 0.0 255.0 READ_WRITE ECU_ADDRESS 0x3F8A1C /end MEASUREMENT
/begin MEASUREMENT mdrv_st_mod_edck_akt "MDRV-Status EDCK (CAN)" UBYTE FORMULA_0219 0 0.0 0.0 255.0 READ_WRITE ECU_ADDRESS 0x3F8A1B /end MEASUREMENT
/begin MEASUREMENT mdrv_st_mod_eng_akt "MDRV-Status Motor (CAN)" UBYTE FORMULA_0218 0 0.0 0.0 255.0 READ_WRITE ECU_ADDRESS 0x3F8A1A /end MEASUREMENT
/begin MEASUREMENT mdrv_st_mod_hud_akt "MDRV-Status HUD (CAN)" UBYTE FORMULA_0220 0 0.0 0.0 255.0 READ_WRITE ECU_ADDRESS 0x3F8A1D /end MEASUREMENT
/begin MEASUREMENT mdrv_st_mod_smg_akt "MDRV-Status SMG (CAN)" UBYTE FORMULA_0216 0 0.0 0.0 255.0 READ_WRITE ECU_ADDRESS 0x3F8A18 /end MEASUREMENT
/begin MEASUREMENT mdrv_st_stg_smg_akt "MDRV-Status Drivelogic (CAN)" UBYTE FORMULA_0217 0 0.0 0.0 255.0 READ_WRITE ECU_ADDRESS 0x3F8A19 /end MEASUREMENT
/begin MEASUREMENT ml_b1 "Luftmassenstrom" SWORD FORMULA_0103 0 0.0 -100.0 1400.0 READ_WRITE ECU_ADDRESS 0x3F87EA /end MEASUREMENT
/begin MEASUREMENT ml_b2 "Luftmassenstrom" SWORD FORMULA_0103 0 0.0 -100.0 1400.0 READ_WRITE ECU_ADDRESS 0x3F87EC /end MEASUREMENT
/begin MEASUREMENT ml_ges "Luftmassenstrom Bank 1 und 2" SWORD FORMULA_0103 0 0.0 -100.0 1400.0 READ_WRITE ECU_ADDRESS 0x3F87F4 /end MEASUREMENT
/begin MEASUREMENT ml_hfm_b1 "Luftmassenstrom HFM inkl. aller Korr" SWORD FORMULA_0103 0 0.0 -100.0 1400.0 READ_WRITE ECU_ADDRESS 0x3FBF68 /end MEASUREMENT
/begin MEASUREMENT ml_hfm_b2 "Luftmassenstrom HFM inkl. aller Korr" SWORD FORMULA_0103 0 0.0 -100.0 1400.0 READ_WRITE ECU_ADDRESS 0x3FBF6C /end MEASUREMENT
/begin MEASUREMENT msg_rec_cc "Status" UBYTE FORMULA_0003 0 0.0 0.0 255.0 READ_WRITE ECU_ADDRESS 0x3F8A3A /end MEASUREMENT
/begin MEASUREMENT msg_rec_cc_dsc "Status - DSC" UBYTE FORMULA_0224 0 0 0.0 255.0 READ_WRITE BIT_MASK 0x1 ECU_ADDRESS 0x3F8A3A /end MEASUREMENT
/begin MEASUREMENT mvac_aq_bre "AQ-Offset LL-Steller Bank 2" UWORD FORMULA_0143 0 0.0 0.0 6500.0 READ_WRITE ECU_ADDRESS 0x3F8922 /end MEASUREMENT
/begin MEASUREMENT mvac_ed_st "MVAC-Fehler" UBYTE FORMULA_0146 0 0.0 0.0 255.0 READ_WRITE ECU_ADDRESS 0x3F8940 /end MEASUREMENT
/begin MEASUREMENT mvac_p "gemessener Differenzdruck(Senor) Mastervac/Umgebung" SWORD FORMULA_0075 0 0.0 -1100.0 200.0 READ_WRITE ECU_ADDRESS 0x3F893E /end MEASUREMENT
/begin MEASUREMENT mvac_p_mess "berechneter Absolutdruck(Sensor) im Mastervac" SWORD FORMULA_0075 0 0.0 0.0 1200.0 READ_WRITE ECU_ADDRESS 0x3F893C /end MEASUREMENT
/begin MEASUREMENT mvac_p_modell "Absolutdruck(Modell) im Mastervac" SWORD FORMULA_0075 0 0.0 0.0 1200.0 READ_WRITE ECU_ADDRESS 0x3F8938 /end MEASUREMENT
/begin MEASUREMENT mvac_pdiff_um "Differenzdruck(Modell) Mastervac/Umgebung" SWORD FORMULA_0075 0 0.0 -1100.0 200.0 READ_WRITE ECU_ADDRESS 0x3F893A /end MEASUREMENT
/begin MEASUREMENT mvac_rf_sr "Fuellung MVAC" SWORD FORMULA_0007 0 0.0 0.0 2.0 READ_WRITE ECU_ADDRESS 0x3F8926 /end MEASUREMENT
/begin MEASUREMENT mvac_rf_sr_b_b1 "Fuellung MVAC bankspezifisch" SWORD FORMULA_0007 0 0.0 0.0 2.0 READ_WRITE ECU_ADDRESS 0x3F8928 /end MEASUREMENT
/begin MEASUREMENT mvac_rf_sr_b_b2 "Fuellung MVAC bankspezifisch" SWORD FORMULA_0007 0 0.0 0.0 2.0 READ_WRITE ECU_ADDRESS 0x3F892A /end MEASUREMENT
/begin MEASUREMENT mzyl_hfm_b1 "Ges.masse Zyl" SWORD FORMULA_0104 0 0.0 -500.0 1500.0 READ_WRITE ECU_ADDRESS 0x3FBF6A /end MEASUREMENT
/begin MEASUREMENT mzyl_hfm_b2 "Ges.masse Zyl" SWORD FORMULA_0104 0 0.0 -500.0 1500.0 READ_WRITE ECU_ADDRESS 0x3FBF6E /end MEASUREMENT
/begin MEASUREMENT mzyl_ml_b1 "Luftmassenstrom" SWORD FORMULA_0104 0 0.0 -500.0 1500.0 READ_WRITE ECU_ADDRESS 0x3F8942 /end MEASUREMENT
/begin MEASUREMENT mzyl_ml_b2 "Luftmassenstrom" SWORD FORMULA_0104 0 0.0 -500.0 1500.0 READ_WRITE ECU_ADDRESS 0x3F8944 /end MEASUREMENT
/begin MEASUREMENT n "Motordrehzahl" SWORD FORMULA_0006 0 0.0 0.0 10000.0 READ_WRITE ECU_ADDRESS 0x3F87FE /end MEASUREMENT
/begin MEASUREMENT n_begr_egas "Drehzahlbegrenzung ueber Momenteneingriff" SWORD FORMULA_0006 0 0.0 0.0 10000.0 READ_WRITE ECU_ADDRESS 0x3F8964 /end MEASUREMENT
/begin MEASUREMENT n_begr_st "Statusvariable Drehzahlbegrenzung" UBYTE FORMULA_0148 0 0.0 0.0 8.0 READ_WRITE ECU_ADDRESS 0x3F8966 /end MEASUREMENT
/begin MEASUREMENT n_dyn_st "Statusvariable Drehzahldynamik" UBYTE FORMULA_0149 0 0.0 0.0 8.0 READ_WRITE ECU_ADDRESS 0x3F8967 /end MEASUREMENT
/begin MEASUREMENT n_e2 "Motordrehzahl der Ebene 2." SWORD FORMULA_0006 0 0.0 0.0 10000.0 READ_WRITE ECU_ADDRESS 0x3F867C /end MEASUREMENT
/begin MEASUREMENT n_getr_abtrieb "Getriebeabtriebsdrehzahl" SWORD FORMULA_0006 0 0.0 0.0 12000.0 READ_WRITE ECU_ADDRESS 0x3F8628 /end MEASUREMENT
/begin MEASUREMENT n_getr_ein "Getriebeeingangsdrehzahl" SWORD FORMULA_0006 0 0.0 0.0 12000.0 READ_WRITE ECU_ADDRESS 0x3F8626 /end MEASUREMENT
/begin MEASUREMENT n_grad_asp "Drehzahlgradient (Arbeitsspiel)" SWORD FORMULA_0105 0 0.0 -10000.0 10000.0 READ_WRITE ECU_ADDRESS 0x3F8802 /end MEASUREMENT
/begin MEASUREMENT n_grad_segment "Drehzahlgradient" SWORD FORMULA_0105 0 0.0 -10000.0 10000.0 READ_WRITE ECU_ADDRESS 0x3F8800 /end MEASUREMENT
/begin MEASUREMENT N_idlgspec_copy "Anforderung LL-Anhebung" UBYTE FORMULA_0003 0 0.0 0.0 255.0 READ_WRITE ECU_ADDRESS 0x3F8890 /end MEASUREMENT
/begin MEASUREMENT n_lw_b1 "Ladungswechseldrehzahloffset." SWORD FORMULA_0006 0 0.0 0.0 10000.0 READ_WRITE ECU_ADDRESS 0x3F862E /end MEASUREMENT
/begin MEASUREMENT n_lw_b2 "Ladungswechseldrehzahloffset." SWORD FORMULA_0006 0 0.0 0.0 10000.0 READ_WRITE ECU_ADDRESS 0x3F8630 /end MEASUREMENT
/begin MEASUREMENT n_lw_m "Mittelwert Ladungswechseldrehzahloffset." SWORD FORMULA_0006 0 0.0 0.0 10000.0 READ_WRITE ECU_ADDRESS 0x3F862C /end MEASUREMENT
/begin MEASUREMENT Nslb_copy "N_soll Korrektur von Ladebilanz Batterie" SWORD FORMULA_0006 0 0.0 -32768.0 32767.0 READ_WRITE ECU_ADDRESS 0x3F8892 /end MEASUREMENT
/begin MEASUREMENT nw_asp_cnt "720° Arbeitsspielzaehler." ULONG FORMULA_0000 0 0.0 0.0 4294967295.0 READ_WRITE ECU_ADDRESS 0x3F880C /end MEASUREMENT
/begin MEASUREMENT nw_asp_cnt_ml "720° Arbeitsspielzaehler seit Motorstart." ULONG FORMULA_0000 0 0.0 0.0 4294967295.0 READ_WRITE ECU_ADDRESS 0x3F8808 /end MEASUREMENT
/begin MEASUREMENT nw_st "Synchronisationsstatus Nockenwelle" UBYTE FORMULA_0101 0 0.0 0.0 255.0 READ_WRITE ECU_ADDRESS 0x3F87CA /end MEASUREMENT
/begin MEASUREMENT nwm_state "Zustand vom NWM" UBYTE FORMULA_0162 0 0.0 0.0 255.0 READ_WRITE ECU_ADDRESS 0x3F8974 /end MEASUREMENT
/begin MEASUREMENT Oz_tempr "Rohwert Öltemperaturmessung vom Sensor" UBYTE FORMULA_0192 0 0.0 -54.29999923706055 173.39990234375 READ_WRITE ECU_ADDRESS 0x3F89DB /end MEASUREMENT
/begin MEASUREMENT pctrl_t_ign "Werte fuer die Prozessorkontrolle" ULONG FORMULA_0000 0 0.0 0.0 4294967295.0 READ_WRITE ECU_ADDRESS 0x3F863C /end MEASUREMENT
/begin MEASUREMENT pctrl_t_inj "Werte fuer die Prozessorkontrolle" ULONG FORMULA_0000 0 0.0 0.0 4294967295.0 READ_WRITE ECU_ADDRESS 0x3F8970 /end MEASUREMENT
/begin MEASUREMENT pks_can_diag_st "PKS-Diagnosestatus" UBYTE FORMULA_0003 0 0.0 0.0 255.0 READ_WRITE ECU_ADDRESS 0x3F86FC /end MEASUREMENT
/begin MEASUREMENT pks_can_i "PKS-Strom" UBYTE FORMULA_0349 0 0.0 0.0 25.0 READ_WRITE ECU_ADDRESS 0x3F86FE /end MEASUREMENT
/begin MEASUREMENT pks_can_n "PKS-Drehzahl" SWORD FORMULA_0006 0 0.0 0.0 10000.0 READ_WRITE ECU_ADDRESS 0x3F86FA /end MEASUREMENT
/begin MEASUREMENT pks_can_st "Empfangsstatus PKS" UWORD FORMULA_0116 0 0.0 0.0 65535.0 READ_WRITE ECU_ADDRESS 0x3F86F8 /end MEASUREMENT
/begin MEASUREMENT pks_can_u_kl30 "PKS-Klemme 30" UBYTE FORMULA_0348 0 0.0 0.0 25.0 READ_WRITE ECU_ADDRESS 0x3F86FD /end MEASUREMENT
/begin MEASUREMENT pks_ist "Kraftstoffdruck, absolut, gefiltert" SWORD FORMULA_0110 0 0.0 0.0 10.0 READ_WRITE ECU_ADDRESS 0x3F887A /end MEASUREMENT
/begin MEASUREMENT pks_rel "Kraftstoffdruck, relativ" SWORD FORMULA_0110 0 0.0 0.0 10.0 READ_WRITE ECU_ADDRESS 0x3F887C /end MEASUREMENT
/begin MEASUREMENT pksr_b_ekp2 "Einschaltzustand EKP2" UBYTE FORMULA_0159 0 0.0 0.0 255.0 READ_WRITE ECU_ADDRESS 0x3F896C /end MEASUREMENT
/begin MEASUREMENT pksr_ekp_ansteuerung_cfg "Configuration EKP Ansteuerung" UBYTE FORMULA_0160 0 0.0 0.0 255.0 READ_WRITE ECU_ADDRESS 0x3F896D /end MEASUREMENT
/begin MEASUREMENT pksr_exd_md_fw_st "100Proz FW-Anforderungsstatus von PKSR" UWORD FORMULA_0010 0 0.0 0.0 65535.0 READ_WRITE ECU_ADDRESS 0x3F89FC /end MEASUREMENT
/begin MEASUREMENT pksr_exd_zust_pl "Zustand Statemaschine Prueflauf" UWORD FORMULA_0185 0 0.0 0.0 65535.0 READ_WRITE ECU_ADDRESS 0x3F8994 /end MEASUREMENT
/begin MEASUREMENT pksr_tv_ekp "auszugebendes TV inkl. Hardware-Anpassung" SWORD FORMULA_0161 0 0.0 -100.0 100.0 READ_WRITE ECU_ADDRESS 0x3F896E /end MEASUREMENT
/begin MEASUREMENT psau_rel_b1 "relativer Saugrohrdruck Bank" SWORD FORMULA_0106 0 0.0 0.0 120.0 READ_WRITE ECU_ADDRESS 0x3F8810 /end MEASUREMENT
/begin MEASUREMENT psau_rel_b2 "relativer Saugrohrdruck Bank" SWORD FORMULA_0106 0 0.0 0.0 120.0 READ_WRITE ECU_ADDRESS 0x3F8812 /end MEASUREMENT
/begin MEASUREMENT pumg "Gefilterter Messwert" SWORD FORMULA_0075 0 0.0 400.0 1200.0 READ_WRITE ECU_ADDRESS 0x3F89C4 /end MEASUREMENT
/begin MEASUREMENT pwg_kd_st "Kickdown-Status" UBYTE FORMULA_0003 0 0 0.0 255.0 READ_WRITE BIT_MASK 0x1 ECU_ADDRESS 0x3F858A /end MEASUREMENT
/begin MEASUREMENT pwg_kd_st_kickdown "Kickdown-Status" UBYTE FORMULA_0248 0 0 0.0 255.0 READ_WRITE BIT_MASK 0x1 ECU_ADDRESS 0x3F858A /end MEASUREMENT
/begin MEASUREMENT pwg_mode "Ausgabezustand der Pedalwertgebererfassung" UBYTE FORMULA_0249 0 0.0 0.0 255.0 READ_WRITE ECU_ADDRESS 0x3F858B /end MEASUREMENT
/begin MEASUREMENT pwg_soll "Ausgegebener Pedalwert fuer andere Module" SWORD FORMULA_0001 0 0.0 -10.0 120.0 READ_WRITE ECU_ADDRESS 0x3F858C /end MEASUREMENT
/begin MEASUREMENT pwg1_abs_roh "Ungefilterter mit UEXT-korrigierter Messwert PWG1" SWORD FORMULA_0250 0 0.0 0.0 5.0 READ_WRITE ECU_ADDRESS 0x3F858E /end MEASUREMENT
/begin MEASUREMENT pwg2_abs_roh "Ungefilterter mit UEXT-korrigierter Messwert PWG2" SWORD FORMULA_0251 0 0.0 0.0 5.0 READ_WRITE ECU_ADDRESS 0x3F8590 /end MEASUREMENT
/begin MEASUREMENT rf_aq_b1 "rf aus aq bestimmt" SWORD FORMULA_0007 0 0.0 0.0 2.0 READ_WRITE ECU_ADDRESS 0x3F8818 /end MEASUREMENT
/begin MEASUREMENT rf_aq_b2 "rf aus aq bestimmt" SWORD FORMULA_0007 0 0.0 0.0 2.0 READ_WRITE ECU_ADDRESS 0x3F881A /end MEASUREMENT
/begin MEASUREMENT rf_b1 "relative Fuellung" SWORD FORMULA_0007 0 0.0 0.0 2.0 READ_WRITE ECU_ADDRESS 0x3F87BE /end MEASUREMENT
/begin MEASUREMENT rf_b2 "relative Fuellung" SWORD FORMULA_0007 0 0.0 0.0 2.0 READ_WRITE ECU_ADDRESS 0x3F87C0 /end MEASUREMENT
/begin MEASUREMENT rf_dyn "PT1 gefilterter Wert fuer dir rf Dynamik Erkennung" SWORD FORMULA_0007 0 0.0 0.0 2.0 READ_WRITE ECU_ADDRESS 0x3F89B8 /end MEASUREMENT
/begin MEASUREMENT rf_dyn_delta "Delta gefiltert zum ungefiltertem" SWORD FORMULA_0186 0 0.0 -3.276799917221069 3.276700019836426 READ_WRITE ECU_ADDRESS 0x3F89BA /end MEASUREMENT
/begin MEASUREMENT rf_e2_b1 "relative Fuellung Ebene 2" SWORD FORMULA_0007 0 0.0 0.0 2.0 READ_WRITE ECU_ADDRESS 0x3F8826 /end MEASUREMENT
/begin MEASUREMENT rf_e2_b2 "relative Fuellung Ebene 2" SWORD FORMULA_0007 0 0.0 0.0 2.0 READ_WRITE ECU_ADDRESS 0x3F8828 /end MEASUREMENT
/begin MEASUREMENT rf_e2_m "relative Fuellung Ebene 2 Mittelwert" SWORD FORMULA_0007 0 0.0 0.0 2.0 READ_WRITE ECU_ADDRESS 0x3F882A /end MEASUREMENT
/begin MEASUREMENT rf_fil_b1 "PT1 gefiltertes rf." SWORD FORMULA_0007 0 0.0 0.0 2.0 READ_WRITE ECU_ADDRESS 0x3F89BC /end MEASUREMENT
/begin MEASUREMENT rf_fil_b2 "PT1 gefiltertes rf." SWORD FORMULA_0007 0 0.0 0.0 2.0 READ_WRITE ECU_ADDRESS 0x3F89BE /end MEASUREMENT
/begin MEASUREMENT rf_grad_b1 "Rf Gradient." SWORD FORMULA_0187 0 0.0 -200.0 200.0 READ_WRITE ECU_ADDRESS 0x3F89C0 /end MEASUREMENT
/begin MEASUREMENT rf_grad_b2 "Rf Gradient." SWORD FORMULA_0187 0 0.0 -200.0 200.0 READ_WRITE ECU_ADDRESS 0x3F89C2 /end MEASUREMENT
/begin MEASUREMENT rf_hfm_b1 "relative Fuellung aus HFM" SWORD FORMULA_0007 0 0.0 0.0 2.0 READ_WRITE ECU_ADDRESS 0x3F881C /end MEASUREMENT
/begin MEASUREMENT rf_hfm_b2 "relative Fuellung aus HFM" SWORD FORMULA_0007 0 0.0 0.0 2.0 READ_WRITE ECU_ADDRESS 0x3F881E /end MEASUREMENT
/begin MEASUREMENT rf_lam_b1 "Wirksames rf aus Lambda" SWORD FORMULA_0007 0 0.0 0.0 2.0 READ_WRITE ECU_ADDRESS 0x3F898E /end MEASUREMENT
/begin MEASUREMENT rf_lam_b2 "Wirksames rf aus Lambda" SWORD FORMULA_0007 0 0.0 0.0 2.0 READ_WRITE ECU_ADDRESS 0x3F8990 /end MEASUREMENT
/begin MEASUREMENT rf_m "relative Fuellung Mittel zwischen Bank 1 und 2" SWORD FORMULA_0007 0 0.0 0.0 2.0 READ_WRITE ECU_ADDRESS 0x3F87F2 /end MEASUREMENT
/begin MEASUREMENT rf_psau_b1 "relative Fuellung aus PSAU" SWORD FORMULA_0007 0 0.0 0.0 2.0 READ_WRITE ECU_ADDRESS 0x3F8820 /end MEASUREMENT
/begin MEASUREMENT rf_psau_b2 "relative Fuellung aus PSAU" SWORD FORMULA_0007 0 0.0 0.0 2.0 READ_WRITE ECU_ADDRESS 0x3F8822 /end MEASUREMENT
/begin MEASUREMENT rf_pt_korr "Korrektur der relativen Fuellung" UWORD FORMULA_0073 0 0.0 0.0 4.0 READ_WRITE ECU_ADDRESS 0x3F8A0C /end MEASUREMENT
/begin MEASUREMENT rf_pt_korr_e2 "Korrektur der relativen Fuellung" UWORD FORMULA_0073 0 0.0 0.0 4.0 READ_WRITE ECU_ADDRESS 0x3F8824 /end MEASUREMENT
/begin MEASUREMENT rf_pt_korr_zyl "Korrektur der relativen Fuellung im Zylinder" UWORD FORMULA_0073 0 0.0 0.0 4.0 READ_WRITE ECU_ADDRESS 0x3F8A0E /end MEASUREMENT
/begin MEASUREMENT rg_m_delta_ist_stat_b1 "Differenz Ist zu Stat" SWORD FORMULA_0104 0 0.0 -500.0 1500.0 READ_WRITE ECU_ADDRESS 0x3F87EE /end MEASUREMENT
/begin MEASUREMENT rg_m_delta_ist_stat_b2 "Differenz Ist zu Stat" SWORD FORMULA_0104 0 0.0 -500.0 1500.0 READ_WRITE ECU_ADDRESS 0x3F87F0 /end MEASUREMENT
/begin MEASUREMENT rg_x_b1 "Restgasgehalt" SWORD FORMULA_0100 0 0.0 -0.5 0.5 READ_WRITE ECU_ADDRESS 0x3F87C2 /end MEASUREMENT
/begin MEASUREMENT rg_x_b2 "Restgasgehalt" SWORD FORMULA_0100 0 0.0 -0.5 0.5 READ_WRITE ECU_ADDRESS 0x3F87C4 /end MEASUREMENT
/begin MEASUREMENT rg_x_delta_b1 "Differenz zwischen Stat. Restgmasse und Modell" SWORD FORMULA_0100 0 0.0 -0.5 0.5 READ_WRITE ECU_ADDRESS 0x3F8814 /end MEASUREMENT
/begin MEASUREMENT rg_x_delta_b2 "Differenz zwischen Stat. Restgmasse und Modell" SWORD FORMULA_0100 0 0.0 -0.5 0.5 READ_WRITE ECU_ADDRESS 0x3F8816 /end MEASUREMENT
/begin MEASUREMENT rg_x_m "gem. Restgasgehalt" SWORD FORMULA_0100 0 0.0 -0.5 0.5 READ_WRITE ECU_ADDRESS 0x3F87C6 /end MEASUREMENT
/begin MEASUREMENT rg_x_m_stat "gem. Restgasgehalt" SWORD FORMULA_0100 0 0.0 -0.5 0.5 READ_WRITE ECU_ADDRESS 0x3F87C8 /end MEASUREMENT
/begin MEASUREMENT rps_auss_st "Status Aussetzer-RPS" UWORD FORMULA_0010 0 0.0 0.0 65535.0 READ_WRITE ECU_ADDRESS 0x3F87FC /end MEASUREMENT
/begin MEASUREMENT rps_cfg "Auswahl RPS-Modell" UBYTE FORMULA_0003 0 0.0 0.0 255.0 READ_WRITE ECU_ADDRESS 0x3F8894 /end MEASUREMENT
/begin MEASUREMENT rps_dyn_fil_st "RPS-Status Dynamikfilter" UWORD FORMULA_0010 0 0.0 0.0 65535.0 READ_WRITE ECU_ADDRESS 0x3F88A8 /end MEASUREMENT
/begin MEASUREMENT rps_evap_tv "RPS-Tastverhältnis" SWORD FORMULA_0022 0 0.0 -100.0 100.0 READ_WRITE ECU_ADDRESS 0x3F88AA /end MEASUREMENT
/begin MEASUREMENT rps_ionen_st "Status Ionen-RPS" UWORD FORMULA_0010 0 0.0 0.0 65535.0 READ_WRITE ECU_ADDRESS 0x3F87F8 /end MEASUREMENT
/begin MEASUREMENT rps_ionen_stufe "Stufe Ionen-RPS" UWORD FORMULA_0010 0 0.0 0.0 65535.0 READ_WRITE ECU_ADDRESS 0x3F87FA /end MEASUREMENT
/begin MEASUREMENT rps_kupp_min_filter "RPS-Minimalmoment gefiltert" SWORD FORMULA_0009 0 0.0 -100.0 1000.0 READ_WRITE ECU_ADDRESS 0x3F88A2 /end MEASUREMENT
/begin MEASUREMENT rps_kupp_wunsch_fil_roh "RPS-Wunschmoment gefiltert-roh" SWORD FORMULA_0009 0 0.0 -100.0 1000.0 READ_WRITE ECU_ADDRESS 0x3F88A6 /end MEASUREMENT
/begin MEASUREMENT rps_kupp_wunsch_filter "RPS-Wunschmoment gefiltert" SWORD FORMULA_0009 0 0.0 -100.0 1000.0 READ_WRITE ECU_ADDRESS 0x3F88A4 /end MEASUREMENT
/begin MEASUREMENT rps_llr_md_ad "Adaptionswert LLR-RPS" SWORD FORMULA_0009 0 0.0 -100.0 1000.0 READ_WRITE ECU_ADDRESS 0x3F889E /end MEASUREMENT
/begin MEASUREMENT rps_llr_md_i "I-Anteil LLR-RPS" SWORD FORMULA_0009 0 0.0 -100.0 1000.0 READ_WRITE ECU_ADDRESS 0x3F889A /end MEASUREMENT
/begin MEASUREMENT rps_llr_md_p "P-Anteil LLR-RPS" SWORD FORMULA_0009 0 0.0 -100.0 1000.0 READ_WRITE ECU_ADDRESS 0x3F8898 /end MEASUREMENT
/begin MEASUREMENT rps_llr_md_tz "TZ-Anteil LLR-RPS" SWORD FORMULA_0009 0 0.0 -100.0 1000.0 READ_WRITE ECU_ADDRESS 0x3F889C /end MEASUREMENT
/begin MEASUREMENT rps_llr_n_soll "Sollwert LLR-RPS" SWORD FORMULA_0006 0 0.0 0.0 10000.0 READ_WRITE ECU_ADDRESS 0x3F88A0 /end MEASUREMENT
/begin MEASUREMENT rps_llr_st "Status LLR-RPS" UBYTE FORMULA_0003 0 0.0 0.0 255.0 READ_WRITE ECU_ADDRESS 0x3F8897 /end MEASUREMENT
/begin MEASUREMENT rps_rec1_cnt "Rec1-Fehlerzaehler" UBYTE FORMULA_0003 0 0.0 0.0 255.0 READ_WRITE ECU_ADDRESS 0x3F8895 /end MEASUREMENT
/begin MEASUREMENT rps_rec2_cnt "Rec2-Fehlerzaehler" UBYTE FORMULA_0003 0 0.0 0.0 255.0 READ_WRITE ECU_ADDRESS 0x3F8896 /end MEASUREMENT
/begin MEASUREMENT rps_tz_offs "RPS-TZ-Offset" SWORD FORMULA_0102 0 0.0 -50.0 60.0 READ_WRITE ARRAY_SIZE 10 ECU_ADDRESS 0x3F8A26 MATRIX_DIM 10 1 1 /end MEASUREMENT
/begin MEASUREMENT rps_zyl_nr "Zylinder-RPS" UBYTE FORMULA_0003 0 0.0 0.0 255.0 READ_WRITE ECU_ADDRESS 0x3F87F6 /end MEASUREMENT
/begin MEASUREMENT s_kraftschluss_smg "Kraftschluss beim SMG" UWORD FORMULA_0280 0 0 0.0 255.0 READ_WRITE BIT_MASK 0x20 ECU_ADDRESS 0x3F8634 /end MEASUREMENT
/begin MEASUREMENT s_kraftschluss_smg_e2 "Kraftschluss beim SMG Ebene 2" UWORD FORMULA_0280 0 0 0.0 255.0 READ_WRITE BIT_MASK 0x20 ECU_ADDRESS 0x3F8636 /end MEASUREMENT
/begin MEASUREMENT sa_aktive_time "SA aktive Zeit" UWORD FORMULA_0109 0 0.0 0.0 325.0 READ_WRITE ECU_ADDRESS 0x3F8878 /end MEASUREMENT
/begin MEASUREMENT sa_n_we "Drehzahlschwelle fuer Wiedereinsetzdrehzahl" SWORD FORMULA_0006 0 0.0 0.0 10000.0 READ_WRITE ECU_ADDRESS 0x3F8876 /end MEASUREMENT
/begin MEASUREMENT sa_we_st "SAWE-Status" UBYTE FORMULA_0108 0 0.0 0.0 255.0 READ_WRITE ECU_ADDRESS 0x3F8874 /end MEASUREMENT
/begin MEASUREMENT schalter_bls_ign "Schalterstatus" UWORD FORMULA_0150 0 0 0.0 255.0 READ_WRITE BIT_MASK 0x1 ECU_ADDRESS 0x3F8634 /end MEASUREMENT
/begin MEASUREMENT schalter_bls_ign_e2 "Schalterstatus Ebene 2" UWORD FORMULA_0150 0 0 0.0 255.0 READ_WRITE BIT_MASK 0x1 ECU_ADDRESS 0x3F8636 /end MEASUREMENT
/begin MEASUREMENT schalter_bls_inj "Schalterstatus" UWORD FORMULA_0150 0 0 0.0 255.0 READ_WRITE BIT_MASK 0x1 ECU_ADDRESS 0x3F8968 /end MEASUREMENT
/begin MEASUREMENT schalter_bls_inj_e2 "Schalterstatus Ebene 2" UWORD FORMULA_0150 0 0 0.0 255.0 READ_WRITE BIT_MASK 0x1 ECU_ADDRESS 0x3F896A /end MEASUREMENT
/begin MEASUREMENT schalter_blts "Schalterstatus" UWORD FORMULA_0277 0 0 0.0 255.0 READ_WRITE BIT_MASK 0x2 ECU_ADDRESS 0x3F8634 /end MEASUREMENT
/begin MEASUREMENT schalter_blts_e2 "Schalterstatus Ebene 2" UWORD FORMULA_0277 0 0 0.0 255.0 READ_WRITE BIT_MASK 0x2 ECU_ADDRESS 0x3F8636 /end MEASUREMENT
/begin MEASUREMENT schalter_getriebe "Schalterstatus" UWORD FORMULA_0152 0 0.0 0.0 65535.0 READ_WRITE BIT_MASK 0x24 ECU_ADDRESS 0x3F8968 /end MEASUREMENT
/begin MEASUREMENT schalter_getriebe_e2 "Schalterstatus Ebene 2" UWORD FORMULA_0152 0 0.0 0.0 65535.0 READ_WRITE BIT_MASK 0x24 ECU_ADDRESS 0x3F896A /end MEASUREMENT
/begin MEASUREMENT schalter_kl87 "Schalterstatus" UWORD FORMULA_0279 0 0 0.0 255.0 READ_WRITE BIT_MASK 0x8 ECU_ADDRESS 0x3F8634 /end MEASUREMENT
/begin MEASUREMENT schalter_kl87_e2 "Schalterstatus Ebene 2" UWORD FORMULA_0279 0 0 0.0 255.0 READ_WRITE BIT_MASK 0x8 ECU_ADDRESS 0x3F8636 /end MEASUREMENT
/begin MEASUREMENT schalter_kraft_hs "Kraftschluss beim Handschalter" UWORD FORMULA_0158 0 0 0.0 255.0 READ_WRITE BIT_MASK 0x200 ECU_ADDRESS 0x3F8968 /end MEASUREMENT
/begin MEASUREMENT schalter_kraft_hs_e2 "Kraftschluss beim Handschalter Ebene 2" UWORD FORMULA_0158 0 0 0.0 255.0 READ_WRITE BIT_MASK 0x200 ECU_ADDRESS 0x3F896A /end MEASUREMENT
/begin MEASUREMENT schalter_kupplung "Schalterstatus" UWORD FORMULA_0151 0 0 0.0 255.0 READ_WRITE BIT_MASK 0x2 ECU_ADDRESS 0x3F8968 /end MEASUREMENT
/begin MEASUREMENT schalter_kupplung_e2 "Schalterstatus Ebene 2" UWORD FORMULA_0151 0 0 0.0 255.0 READ_WRITE BIT_MASK 0x2 ECU_ADDRESS 0x3F896A /end MEASUREMENT
/begin MEASUREMENT schalter_poel "Schalterstatus" UWORD FORMULA_0156 0 0 0.0 255.0 READ_WRITE BIT_MASK 0x80 ECU_ADDRESS 0x3F8968 /end MEASUREMENT
/begin MEASUREMENT schalter_poel_e2 "Schalterstatus Ebene 2" UWORD FORMULA_0156 0 0 0.0 255.0 READ_WRITE BIT_MASK 0x80 ECU_ADDRESS 0x3F896A /end MEASUREMENT
/begin MEASUREMENT schalter_power "Schalterstatus" UWORD FORMULA_0154 0 0 0.0 255.0 READ_WRITE BIT_MASK 0x10 ECU_ADDRESS 0x3F8968 /end MEASUREMENT
/begin MEASUREMENT schalter_power_e2 "Schalterstatus Ebene 2" UWORD FORMULA_0154 0 0 0.0 255.0 READ_WRITE BIT_MASK 0x10 ECU_ADDRESS 0x3F896A /end MEASUREMENT
/begin MEASUREMENT schalter_schaltung "Schalterstatus" UWORD FORMULA_0155 0 0 0.0 255.0 READ_WRITE BIT_MASK 0x40 ECU_ADDRESS 0x3F8968 /end MEASUREMENT
/begin MEASUREMENT schalter_schaltung_e2 "Schalterstatus Ebene 2" UWORD FORMULA_0155 0 0 0.0 255.0 READ_WRITE BIT_MASK 0x40 ECU_ADDRESS 0x3F896A /end MEASUREMENT
/begin MEASUREMENT schalter_st_ign "Schalterstatus" UWORD FORMULA_0080 0 0.0 0.0 65535.0 READ_WRITE ECU_ADDRESS 0x3F8634 /end MEASUREMENT
/begin MEASUREMENT schalter_st_ign_e2 "Schalterstatus Ebene 2" UWORD FORMULA_0080 0 0.0 0.0 65535.0 READ_WRITE ECU_ADDRESS 0x3F8636 /end MEASUREMENT
/begin MEASUREMENT schalter_st_inj "Schalterstatus" UWORD FORMULA_0080 0 0.0 0.0 65535.0 READ_WRITE ECU_ADDRESS 0x3F8968 /end MEASUREMENT
/begin MEASUREMENT schalter_st_inj_e2 "Schalterstatus Ebene 2" UWORD FORMULA_0080 0 0.0 0.0 65535.0 READ_WRITE ECU_ADDRESS 0x3F896A /end MEASUREMENT
/begin MEASUREMENT schalter_wakeup_ign "Schalterstatus" UWORD FORMULA_0278 0 0 0.0 255.0 READ_WRITE BIT_MASK 0x4 ECU_ADDRESS 0x3F8634 /end MEASUREMENT
/begin MEASUREMENT schalter_wakeup_ign_e2 "Schalterstatus Ebene 2" UWORD FORMULA_0278 0 0 0.0 255.0 READ_WRITE BIT_MASK 0x4 ECU_ADDRESS 0x3F8636 /end MEASUREMENT
/begin MEASUREMENT schalter_wakeup_inj "Schalterstatus" UWORD FORMULA_0153 0 0 0.0 255.0 READ_WRITE BIT_MASK 0x8 ECU_ADDRESS 0x3F8968 /end MEASUREMENT
/begin MEASUREMENT schalter_wakeup_inj_e2 "Schalterstatus Ebene 2" UWORD FORMULA_0153 0 0 0.0 255.0 READ_WRITE BIT_MASK 0x8 ECU_ADDRESS 0x3F896A /end MEASUREMENT
/begin MEASUREMENT schalter_zustand_poel "Schalterstatus" UWORD FORMULA_0157 0 0 0.0 255.0 READ_WRITE BIT_MASK 0x100 ECU_ADDRESS 0x3F8968 /end MEASUREMENT
/begin MEASUREMENT schalter_zustand_poel_e2 "Schalterstatus Ebene 2" UWORD FORMULA_0157 0 0 0.0 255.0 READ_WRITE BIT_MASK 0x100 ECU_ADDRESS 0x3F896A /end MEASUREMENT
/begin MEASUREMENT servo_stat "Status Servotronic" UBYTE FORMULA_0321 0 0.0 0.0 255.0 READ_WRITE ECU_ADDRESS 0x3F8681 /end MEASUREMENT
/begin MEASUREMENT sk_egas_off_ign "SK-Egasstufe" UBYTE FORMULA_0167 0 0.0 0.0 255.0 READ_WRITE ECU_ADDRESS 0x3F8664 /end MEASUREMENT
/begin MEASUREMENT sk_egas_off_inj "SK-Egasstufe" UBYTE FORMULA_0167 0 0.0 0.0 255.0 READ_WRITE ECU_ADDRESS 0x3F897A /end MEASUREMENT
/begin MEASUREMENT sk_eingr_st_ign "SK-Eingriff" UBYTE FORMULA_0003 0 0.0 0.0 255.0 READ_WRITE ECU_ADDRESS 0x3F8669 /end MEASUREMENT
/begin MEASUREMENT sk_eingr_st_inj "SK-Eingriff" UBYTE FORMULA_0003 0 0.0 0.0 255.0 READ_WRITE ECU_ADDRESS 0x3F897F /end MEASUREMENT
/begin MEASUREMENT sk_fr_st_ign "SK-Eingriff FR" UBYTE FORMULA_0178 0 0 0.0 255.0 READ_WRITE BIT_MASK 0x40 ECU_ADDRESS 0x3F8669 /end MEASUREMENT
/begin MEASUREMENT sk_fr_st_inj "SK-Eingriff FR" UBYTE FORMULA_0178 0 0 0.0 255.0 READ_WRITE BIT_MASK 0x40 ECU_ADDRESS 0x3F897F /end MEASUREMENT
/begin MEASUREMENT sk_fra_st_ign "SK-Eingriff FRA" UBYTE FORMULA_0175 0 0 0.0 255.0 READ_WRITE BIT_MASK 0x4 ECU_ADDRESS 0x3F8669 /end MEASUREMENT
/begin MEASUREMENT sk_fra_st_inj "SK-Eingriff FRA" UBYTE FORMULA_0175 0 0 0.0 255.0 READ_WRITE BIT_MASK 0x4 ECU_ADDRESS 0x3F897F /end MEASUREMENT
/begin MEASUREMENT sk_hw_pwg1s_ad "AD-Wandlerwert PWG1 des Slaveprozessors" SWORD FORMULA_0114 0 0.0 0.0 1023.0 READ_WRITE ECU_ADDRESS 0x3F88AC /end MEASUREMENT
/begin MEASUREMENT sk_kh_st_ign "SK-Eingriff KH" UBYTE FORMULA_0176 0 0 0.0 255.0 READ_WRITE BIT_MASK 0x8 ECU_ADDRESS 0x3F8669 /end MEASUREMENT
/begin MEASUREMENT sk_kh_st_inj "SK-Eingriff KH" UBYTE FORMULA_0176 0 0 0.0 255.0 READ_WRITE BIT_MASK 0x8 ECU_ADDRESS 0x3F897F /end MEASUREMENT
/begin MEASUREMENT sk_lam_st_ign_b1 "SK-LAM-Eingriff" UBYTE FORMULA_0170 0 0.0 0.0 255.0 READ_WRITE ECU_ADDRESS 0x3F8667 /end MEASUREMENT
/begin MEASUREMENT sk_lam_st_ign_b2 "SK-LAM-Eingriff" UBYTE FORMULA_0171 0 0.0 0.0 255.0 READ_WRITE ECU_ADDRESS 0x3F8667 /end MEASUREMENT
/begin MEASUREMENT sk_lam_st_inj_b1 "SK-LAM-Eingriff" UBYTE FORMULA_0170 0 0.0 0.0 255.0 READ_WRITE ECU_ADDRESS 0x3F897D /end MEASUREMENT
/begin MEASUREMENT sk_lam_st_inj_b2 "SK-LAM-Eingriff" UBYTE FORMULA_0171 0 0.0 0.0 255.0 READ_WRITE ECU_ADDRESS 0x3F897D /end MEASUREMENT
/begin MEASUREMENT sk_llra_st_ign "SK-Eingriff LLRA" UBYTE FORMULA_0174 0 0 0.0 255.0 READ_WRITE BIT_MASK 0x2 ECU_ADDRESS 0x3F8669 /end MEASUREMENT
/begin MEASUREMENT sk_llra_st_inj "SK-Eingriff LLRA" UBYTE FORMULA_0174 0 0 0.0 255.0 READ_WRITE BIT_MASK 0x2 ECU_ADDRESS 0x3F897F /end MEASUREMENT
/begin MEASUREMENT sk_md_begr_ign "SK-Begrenzungsstufe" UBYTE FORMULA_0167 0 0.0 0.0 255.0 READ_WRITE ECU_ADDRESS 0x3F8665 /end MEASUREMENT
/begin MEASUREMENT sk_md_begr_inj "SK-Begrenzungsstufe" UBYTE FORMULA_0167 0 0.0 0.0 255.0 READ_WRITE ECU_ADDRESS 0x3F897B /end MEASUREMENT
/begin MEASUREMENT sk_md_eingr_ign "SK-Md-Eingriff" UBYTE FORMULA_0003 0 0.0 0.0 255.0 READ_WRITE ECU_ADDRESS 0x3F8666 /end MEASUREMENT
/begin MEASUREMENT sk_md_eingr_inj "SK-Md-Eingriff" UBYTE FORMULA_0003 0 0.0 0.0 255.0 READ_WRITE ECU_ADDRESS 0x3F897C /end MEASUREMENT
/begin MEASUREMENT sk_mzyl_st_ign "SK-Eingriff MZYL" UBYTE FORMULA_0177 0 0.0 0.0 255.0 READ_WRITE BIT_MASK 0x30 ECU_ADDRESS 0x3F8669 /end MEASUREMENT
/begin MEASUREMENT sk_mzyl_st_inj "SK-Eingriff MZYL" UBYTE FORMULA_0177 0 0.0 0.0 255.0 READ_WRITE BIT_MASK 0x30 ECU_ADDRESS 0x3F897F /end MEASUREMENT
/begin MEASUREMENT sk_pks_st_ign "SK-Eingriff PKS" UBYTE FORMULA_0173 0 0 0.0 255.0 READ_WRITE BIT_MASK 0x1 ECU_ADDRESS 0x3F8669 /end MEASUREMENT
/begin MEASUREMENT sk_pks_st_inj "SK-Eingriff PKS" UBYTE FORMULA_0173 0 0 0.0 255.0 READ_WRITE BIT_MASK 0x1 ECU_ADDRESS 0x3F897F /end MEASUREMENT
/begin MEASUREMENT sk_ti_eingr_ign "SK-TI-Eingriff" UBYTE FORMULA_0169 0 0 0.0 255.0 READ_WRITE BIT_MASK 0x2 ECU_ADDRESS 0x3F8666 /end MEASUREMENT
/begin MEASUREMENT sk_ti_eingr_inj "SK-TI-Eingriff" UBYTE FORMULA_0169 0 0 0.0 255.0 READ_WRITE BIT_MASK 0x2 ECU_ADDRESS 0x3F897C /end MEASUREMENT
/begin MEASUREMENT sk_ti_zyl_off_ign "SK-Ausblendungen" UWORD FORMULA_0179 0 0.0 0.0 65535.0 READ_WRITE ECU_ADDRESS 0x3F866A /end MEASUREMENT
/begin MEASUREMENT sk_ti_zyl_off_inj "SK-Ausblendungen" UWORD FORMULA_0179 0 0.0 0.0 65535.0 READ_WRITE ECU_ADDRESS 0x3F8980 /end MEASUREMENT
/begin MEASUREMENT sk_tr_req "Angefragte Testrechnung vom INJ" UBYTE FORMULA_0003 0 0.0 0.0 255.0 READ_WRITE ECU_ADDRESS 0x3F89FE /end MEASUREMENT
/begin MEASUREMENT sk_tr_resp "Beantwortete Testrechnung vom IGN" UBYTE FORMULA_0003 0 0.0 0.0 255.0 READ_WRITE ECU_ADDRESS 0x3F8677 /end MEASUREMENT
/begin MEASUREMENT sk_tr_result "Ergebnis vom IGN" UWORD FORMULA_0010 0 0.0 0.0 65535.0 READ_WRITE ECU_ADDRESS 0x3F8678 /end MEASUREMENT
/begin MEASUREMENT sk_tz_eingr_ign "SK-TZ-Eingriff" UBYTE FORMULA_0168 0 0 0.0 255.0 READ_WRITE BIT_MASK 0x1 ECU_ADDRESS 0x3F8666 /end MEASUREMENT
/begin MEASUREMENT sk_tz_eingr_inj "SK-TZ-Eingriff" UBYTE FORMULA_0168 0 0 0.0 255.0 READ_WRITE BIT_MASK 0x1 ECU_ADDRESS 0x3F897C /end MEASUREMENT
/begin MEASUREMENT sk_van_st_ign "SK-Vanos-Eingriff" UBYTE FORMULA_0172 0 0.0 0.0 255.0 READ_WRITE ECU_ADDRESS 0x3F8668 /end MEASUREMENT
/begin MEASUREMENT sk_van_st_inj "SK-Vanos-Eingriff" UBYTE FORMULA_0172 0 0.0 0.0 255.0 READ_WRITE ECU_ADDRESS 0x3F897E /end MEASUREMENT
/begin MEASUREMENT sl_ml_hfm "gefilterter SLP-Luftmassenstrom" SWORD FORMULA_0103 0 0.0 -100.0 1400.0 READ_WRITE ECU_ADDRESS 0x3F8930 /end MEASUREMENT
/begin MEASUREMENT sl_zwd_tv "Tastverh. LLS fuer SL" SWORD FORMULA_0142 0 0.0 0.0 100.0 READ_WRITE ECU_ADDRESS 0x3F8920 /end MEASUREMENT
/begin MEASUREMENT slp_dauer "Laufzeit der SLP, abh. von tmot_start und kat_obd_wert_nv" UWORD FORMULA_0071 0 0.0 0.0 6553.5 READ_WRITE ECU_ADDRESS 0x3F8A08 /end MEASUREMENT
/begin MEASUREMENT slp_st "SLP Status" UWORD FORMULA_0193 0 0.0 0.0 65535.0 READ_WRITE ECU_ADDRESS 0x3F89DC /end MEASUREMENT
/begin MEASUREMENT sls_obdh_st "Status des SL-Systems" UWORD FORMULA_0181 0 0.0 0.0 65535.0 READ_WRITE ECU_ADDRESS 0x3F8984 /end MEASUREMENT
/begin MEASUREMENT slv_st "SLV Status" UBYTE FORMULA_0194 0 0.0 0.0 255.0 READ_WRITE ECU_ADDRESS 0x3F89DE /end MEASUREMENT
/begin MEASUREMENT smg_ax_berg "Steigung" SWORD FORMULA_0123 0 0.0 -20.0 20.0 READ_WRITE ECU_ADDRESS 0x3F867E /end MEASUREMENT
/begin MEASUREMENT smg_ax_mess_filter "ax_mess gefiltert" SWORD FORMULA_0123 0 0.0 -20.0 20.0 READ_WRITE ECU_ADDRESS 0x3F85EC /end MEASUREMENT
/begin MEASUREMENT smg_can_error "Fehlerbits" UBYTE FORMULA_0262 0 0.0 0.0 255.0 READ_WRITE ECU_ADDRESS 0x3F85EE /end MEASUREMENT
/begin MEASUREMENT smg_can_flags "Allg. CAN-Flags" UBYTE FORMULA_0003 0 0.0 0.0 255.0 READ_WRITE ECU_ADDRESS 0x3F85F5 /end MEASUREMENT
/begin MEASUREMENT smg_can_flags_kl87 "KL87 durch SMG ein" UBYTE FORMULA_0264 0 0 0.0 255.0 READ_WRITE BIT_MASK 0x1 ECU_ADDRESS 0x3F85F5 /end MEASUREMENT
/begin MEASUREMENT smg_can_flags_mm "Status MM-SMG" UBYTE FORMULA_0265 0 0 0.0 255.0 READ_WRITE BIT_MASK 0x2 ECU_ADDRESS 0x3F85F5 /end MEASUREMENT
/begin MEASUREMENT smg_can_modul "Modulstatus" UBYTE FORMULA_0271 0 0.0 0.0 255.0 READ_WRITE ECU_ADDRESS 0x3F85FD /end MEASUREMENT
/begin MEASUREMENT smg_can_n_getr_ein "Getriebeeingangsdrehzahl" SWORD FORMULA_0006 0 0.0 0.0 10000.0 READ_WRITE ECU_ADDRESS 0x3F85F2 /end MEASUREMENT
/begin MEASUREMENT smg_can_n_getr_ziel "Getriebezieldrehzahl" SWORD FORMULA_0006 0 0.0 0.0 10000.0 READ_WRITE ECU_ADDRESS 0x3F85F0 /end MEASUREMENT
/begin MEASUREMENT smg_can_prog_info "Programminfo" UBYTE FORMULA_0263 0 0.0 0.0 255.0 READ_WRITE ECU_ADDRESS 0x3F85F4 /end MEASUREMENT
/begin MEASUREMENT smg_n_getr_anschluss "gerechnete Ziel-Drehzahl am Getriebeeingang im naechsten Gang" SWORD FORMULA_0006 0 0.0 0.0 10000.0 READ_WRITE ECU_ADDRESS 0x3F8650 /end MEASUREMENT
/begin MEASUREMENT smg_schaltart "Schaltart" UWORD FORMULA_0010 0 0.0 0.0 65535.0 READ_WRITE ECU_ADDRESS 0x3F864E /end MEASUREMENT
/begin MEASUREMENT smg_schaltart_aks "Schaltart (AKS)" UWORD FORMULA_0303 0 0 0.0 255.0 READ_WRITE BIT_MASK 0x40 ECU_ADDRESS 0x3F864E /end MEASUREMENT
/begin MEASUREMENT smg_schaltart_automat "Schaltart (Automat)" UWORD FORMULA_0301 0 0 0.0 255.0 READ_WRITE BIT_MASK 0x8 ECU_ADDRESS 0x3F864E /end MEASUREMENT
/begin MEASUREMENT smg_schaltart_eingr "Schaltart (Eingriff)" UWORD FORMULA_0302 0 0 0.0 255.0 READ_WRITE BIT_MASK 0x20 ECU_ADDRESS 0x3F864E /end MEASUREMENT
/begin MEASUREMENT smg_schaltart_hr "Schaltart (Zug-Schub-Hoch)" UWORD FORMULA_0300 0 0.0 0.0 65535.0 READ_WRITE BIT_MASK 0x6 ECU_ADDRESS 0x3F864E /end MEASUREMENT
/begin MEASUREMENT smg_schaltart_lw "Schaltart (Lastwechsel)" UWORD FORMULA_0305 0 0 0.0 255.0 READ_WRITE BIT_MASK 0x200 ECU_ADDRESS 0x3F864E /end MEASUREMENT
/begin MEASUREMENT smg_schaltart_rs "Schaltart (Rennstart)" UWORD FORMULA_0304 0 0 0.0 255.0 READ_WRITE BIT_MASK 0x80 ECU_ADDRESS 0x3F864E /end MEASUREMENT
/begin MEASUREMENT smg_schaltart_zs "Schaltart (Zug-Schub-Hoch)" UWORD FORMULA_0299 0 0 0.0 255.0 READ_WRITE BIT_MASK 0x1 ECU_ADDRESS 0x3F864E /end MEASUREMENT
/begin MEASUREMENT smg_sk_mode "SK-Mode SMG" UBYTE FORMULA_0012 0 0.0 0.0 255.0 READ_WRITE ECU_ADDRESS 0x3F8654 /end MEASUREMENT
/begin MEASUREMENT smg_st_dme "DME-Status" UBYTE FORMULA_0298 0 0.0 0.0 255.0 READ_WRITE ECU_ADDRESS 0x3F864C /end MEASUREMENT
/begin MEASUREMENT smg_st_mot "SMG-Motoreingriff" UBYTE FORMULA_0267 0 0.0 0.0 255.0 READ_WRITE BIT_MASK 0xF ECU_ADDRESS 0x3F85FC /end MEASUREMENT
/begin MEASUREMENT smg_st_mot_sa "SMG-SA-Sperre" UBYTE FORMULA_0270 0 0 0.0 255.0 READ_WRITE BIT_MASK 0x80 ECU_ADDRESS 0x3F85FC /end MEASUREMENT
/begin MEASUREMENT smg_st_mot_ti "SMG-TI-Eingriff" UBYTE FORMULA_0268 0 0 0.0 255.0 READ_WRITE BIT_MASK 0x20 ECU_ADDRESS 0x3F85FC /end MEASUREMENT
/begin MEASUREMENT smg_st_mot_tl "SMG-TL-Eingriff" UBYTE FORMULA_0269 0 0 0.0 255.0 READ_WRITE BIT_MASK 0x40 ECU_ADDRESS 0x3F85FC /end MEASUREMENT
/begin MEASUREMENT smg_t_abregel "Abregelzeit" UBYTE FORMULA_0306 0 0.0 0.0 2.549999952316284 READ_WRITE ECU_ADDRESS 0x3F8652 /end MEASUREMENT
/begin MEASUREMENT smg_t_aufregel "Aufregelzeit" UBYTE FORMULA_0306 0 0.0 0.0 2.549999952316284 READ_WRITE ECU_ADDRESS 0x3F8653 /end MEASUREMENT
/begin MEASUREMENT start_rl_atic39_dpr "Treiberinfo vom Startrelais" UBYTE FORMULA_0209 0 0.0 0.0 15.0 READ_WRITE BIT_MASK 0xF ECU_ADDRESS 0x3F8A0A /end MEASUREMENT
/begin MEASUREMENT start_rl_diag_dpr "Bestaetigung der Treiberinfo" UBYTE FORMULA_0003 0 0.0 0.0 255.0 READ_WRITE ECU_ADDRESS 0x3F86D8 /end MEASUREMENT
/begin MEASUREMENT sw_confg_betriebsmode_exd "vom Tester eingestellter Betriebsmode" UBYTE FORMULA_0208 0 0.0 0.0 255.0 READ_WRITE ECU_ADDRESS 0x3F89FF /end MEASUREMENT
/begin MEASUREMENT tabg_filter_b1 "Gefilterter Messwert der Abgastemperatur" SWORD FORMULA_0342 0 0.0 -50.0 1250.0 READ_WRITE ECU_ADDRESS 0x3F868C /end MEASUREMENT
/begin MEASUREMENT tabg_filter_b2 "Gefilterter Messwert der Abgastemperatur" SWORD FORMULA_0342 0 0.0 -50.0 1250.0 READ_WRITE ECU_ADDRESS 0x3F868E /end MEASUREMENT
/begin MEASUREMENT tabg_kat_b1 "Abgastemperatur im Kat" SWORD FORMULA_0023 0 0.0 -50.0 1250.0 READ_WRITE ECU_ADDRESS 0x3F869C /end MEASUREMENT
/begin MEASUREMENT tabg_kat_b2 "Abgastemperatur im Kat" SWORD FORMULA_0023 0 0.0 -50.0 1250.0 READ_WRITE ECU_ADDRESS 0x3F869E /end MEASUREMENT
/begin MEASUREMENT tabg_lw_b1 "Abgastemperatur Ladungswechsel" SWORD FORMULA_0023 0 0.0 -50.0 1250.0 READ_WRITE ECU_ADDRESS 0x3F8690 /end MEASUREMENT
/begin MEASUREMENT tabg_lw_b2 "Abgastemperatur Ladungswechsel" SWORD FORMULA_0023 0 0.0 -50.0 1250.0 READ_WRITE ECU_ADDRESS 0x3F8692 /end MEASUREMENT
/begin MEASUREMENT tabg_lw_verh_b1 "Verhaeltnis der Ladungswechseltemperaturen" UWORD FORMULA_0073 0 0.0 0.0 4.0 READ_WRITE ECU_ADDRESS 0x3F86A0 /end MEASUREMENT
/begin MEASUREMENT tabg_lw_verh_b2 "Verhaeltnis der Ladungswechseltemperaturen" UWORD FORMULA_0073 0 0.0 0.0 4.0 READ_WRITE ECU_ADDRESS 0x3F86A2 /end MEASUREMENT
/begin MEASUREMENT tabg_lw_verh_wurzel_b1 "Wurzel-Verhaeltnis der Ladungswechseltemperaturen" UWORD FORMULA_0073 0 0.0 0.0 4.0 READ_WRITE ECU_ADDRESS 0x3F86A4 /end MEASUREMENT
/begin MEASUREMENT tabg_lw_verh_wurzel_b2 "Wurzel-Verhaeltnis der Ladungswechseltemperaturen" UWORD FORMULA_0073 0 0.0 0.0 4.0 READ_WRITE ECU_ADDRESS 0x3F86A6 /end MEASUREMENT
/begin MEASUREMENT tabg_nkat_b1 "Abgastemperatur nach dem Kat" SWORD FORMULA_0023 0 0.0 -50.0 1250.0 READ_WRITE ECU_ADDRESS 0x3F8698 /end MEASUREMENT
/begin MEASUREMENT tabg_nkat_b2 "Abgastemperatur nach dem Kat" SWORD FORMULA_0023 0 0.0 -50.0 1250.0 READ_WRITE ECU_ADDRESS 0x3F869A /end MEASUREMENT
/begin MEASUREMENT tabg_nkat_modell_b1 "Abgastemperaturmodell nach dem Kat" SWORD FORMULA_0023 0 0.0 -50.0 1250.0 READ_WRITE ECU_ADDRESS 0x3F86D0 /end MEASUREMENT
/begin MEASUREMENT tabg_nkat_modell_b2 "Abgastemperaturmodell nach dem Kat" SWORD FORMULA_0023 0 0.0 -50.0 1250.0 READ_WRITE ECU_ADDRESS 0x3F86D2 /end MEASUREMENT
/begin MEASUREMENT tabg_vkat_b1 "Abgastemperatur vorm Kat" SWORD FORMULA_0023 0 0.0 -50.0 1250.0 READ_WRITE ECU_ADDRESS 0x3F8694 /end MEASUREMENT
/begin MEASUREMENT tabg_vkat_b2 "Abgastemperatur vorm Kat" SWORD FORMULA_0023 0 0.0 -50.0 1250.0 READ_WRITE ECU_ADDRESS 0x3F8696 /end MEASUREMENT
/begin MEASUREMENT tan_b1 "Ansauglufttemperatur" SWORD FORMULA_0023 0 0.0 -50.0 170.0 READ_WRITE ECU_ADDRESS 0x3F86A8 /end MEASUREMENT
/begin MEASUREMENT tan_b2 "Ansauglufttemperatur" SWORD FORMULA_0023 0 0.0 -50.0 170.0 READ_WRITE ECU_ADDRESS 0x3F86AA /end MEASUREMENT
/begin MEASUREMENT tan_e2 "Ansauglufttemperatur Ebene 2" SWORD FORMULA_0023 0 0.0 -50.0 170.0 READ_WRITE ECU_ADDRESS 0x3F86AE /end MEASUREMENT
/begin MEASUREMENT tan_mw "Mittelwert der Ansauglufttemperatur" SWORD FORMULA_0023 0 0.0 -50.0 170.0 READ_WRITE ECU_ADDRESS 0x3F86AC /end MEASUREMENT
/begin MEASUREMENT tanzyl "Ansaugtemperatur im Zylinder vom Modell" SWORD FORMULA_0023 0 0.0 -50.0 170.0 READ_WRITE ECU_ADDRESS 0x3F8A04 /end MEASUREMENT
/begin MEASUREMENT tdme "Steuergeraetetemperatur" SWORD FORMULA_0023 0 0.0 -50.0 170.0 READ_WRITE ECU_ADDRESS 0x3F86B0 /end MEASUREMENT
/begin MEASUREMENT te_c_akf "Konzentration - AKF" UWORD FORMULA_0199 0 0.0 0.0 2.0 READ_WRITE ECU_ADDRESS 0x3F89EA /end MEASUREMENT
/begin MEASUREMENT te_obd_flags "Flags der TE_OBD" UBYTE FORMULA_0003 0 0.0 0.0 255.0 READ_WRITE ECU_ADDRESS 0x3F89EC /end MEASUREMENT
/begin MEASUREMENT te_rf_ist_b1 "Fuellung aus Tankentlueftung" SWORD FORMULA_0007 0 0.0 0.0 2.0 READ_WRITE ECU_ADDRESS 0x3F898A /end MEASUREMENT
/begin MEASUREMENT te_rf_ist_b2 "Fuellung aus Tankentlueftung" SWORD FORMULA_0007 0 0.0 0.0 2.0 READ_WRITE ECU_ADDRESS 0x3F898C /end MEASUREMENT
/begin MEASUREMENT te_tv_b1 "auszugebendes TE-Tastverhaeltnis" UWORD FORMULA_0107 0 0.0 0.0 100.0 READ_WRITE ECU_ADDRESS 0x3F882C /end MEASUREMENT
/begin MEASUREMENT te_tv_b2 "auszugebendes TE-Tastverhaeltnis" UWORD FORMULA_0107 0 0.0 0.0 100.0 READ_WRITE ECU_ADDRESS 0x3F882E /end MEASUREMENT
/begin MEASUREMENT te_x_ml_soll_b1 "ausgegebener Spuelluftanteil" UWORD FORMULA_0024 0 0.0 0.0 0.1000000014901161 READ_WRITE ECU_ADDRESS 0x3F89E6 /end MEASUREMENT
/begin MEASUREMENT te_x_ml_soll_b2 "ausgegebener Spuelluftanteil" UWORD FORMULA_0024 0 0.0 0.0 0.1000000014901161 READ_WRITE ECU_ADDRESS 0x3F89E8 /end MEASUREMENT
/begin MEASUREMENT te_zust_st "TE-Zustandsautomat" UBYTE FORMULA_0180 0 0.0 0.0 255.0 READ_WRITE ECU_ADDRESS 0x3F8982 /end MEASUREMENT
/begin MEASUREMENT tgetr "Getriebetemperatur" SWORD FORMULA_0023 0 0.0 -50.0 170.0 READ_WRITE ECU_ADDRESS 0x3F8A02 /end MEASUREMENT
/begin MEASUREMENT ti_ausblend_ist_b1 "Zyl-Ausblendung pro Bank" UBYTE FORMULA_0003 0 0.0 0.0 255.0 READ_WRITE ECU_ADDRESS 0x3F8884 /end MEASUREMENT
/begin MEASUREMENT ti_ausblend_ist_b2 "Zyl-Ausblendung pro Bank" UBYTE FORMULA_0003 0 0.0 0.0 255.0 READ_WRITE ECU_ADDRESS 0x3F8885 /end MEASUREMENT
/begin MEASUREMENT ti_ev_ed_b1 "EV-Treiberdiag." UWORD FORMULA_0010 0 0.0 0.0 65535.0 READ_WRITE ECU_ADDRESS 0x3F87CE /end MEASUREMENT
/begin MEASUREMENT ti_ev_ed_b2 "EV-Treiberdiag." UWORD FORMULA_0010 0 0.0 0.0 65535.0 READ_WRITE ECU_ADDRESS 0x3F87D0 /end MEASUREMENT
/begin MEASUREMENT ti_mks_roh_b1 "Einspritzmasse ohne WL" UWORD FORMULA_0111 0 0.0 0.0 1023.984313964844 READ_WRITE ECU_ADDRESS 0x3F887E /end MEASUREMENT
/begin MEASUREMENT ti_mks_roh_b2 "Einspritzmasse ohne WL" UWORD FORMULA_0111 0 0.0 0.0 1023.984313964844 READ_WRITE ECU_ADDRESS 0x3F8880 /end MEASUREMENT
/begin MEASUREMENT ti_pks_up_st "TI-PKS-UP-Status" UWORD FORMULA_0080 0 0.0 0.0 65535.0 READ_WRITE ECU_ADDRESS 0x3F8888 /end MEASUREMENT
/begin MEASUREMENT ti_rf_max "max. rf aus TI" SWORD FORMULA_0007 0 0.0 0.0 2.0 READ_WRITE ECU_ADDRESS 0x3F8886 /end MEASUREMENT
/begin MEASUREMENT ti_tpu_st "TI-TPU-Status" UWORD FORMULA_0010 0 0.0 0.0 65535.0 READ_WRITE ECU_ADDRESS 0x3F8882 /end MEASUREMENT
/begin MEASUREMENT ti_zyl_tz "Zylinder selektive Abschaltung von TI und TZ" UWORD FORMULA_0080 0 0.0 0.0 65535.0 READ_WRITE ECU_ADDRESS 0x3F8A10 /end MEASUREMENT
/begin MEASUREMENT time_abs "Absolutzeit seit 1.1.2000" UWORD FORMULA_0190 0 0.0 0.0 65535.0 READ_WRITE ECU_ADDRESS 0x3F89D8 /end MEASUREMENT
/begin MEASUREMENT time_kl15_off "Zeit seit Kl15 aus" ULONG FORMULA_0147 0 0.0 0.0 655.0 READ_WRITE ECU_ADDRESS 0x3F8958 /end MEASUREMENT
/begin MEASUREMENT time_kl15_on "Zeit seit Kl15 an" ULONG FORMULA_0147 0 0.0 0.0 655.0 READ_WRITE ECU_ADDRESS 0x3F8954 /end MEASUREMENT
/begin MEASUREMENT time_ll "Zeit seit Eintritt LL" ULONG FORMULA_0147 0 0.0 0.0 655.0 READ_WRITE ECU_ADDRESS 0x3F8950 /end MEASUREMENT
/begin MEASUREMENT time_ml "3HaxenSchnurrZeit" ULONG FORMULA_0147 0 0.0 0.0 655.0 READ_WRITE ECU_ADDRESS 0x3F894C /end MEASUREMENT
/begin MEASUREMENT time_ms "Zeit seit Motor steht" ULONG FORMULA_0145 0 0.0 0.0 71582788.25 READ_WRITE ECU_ADDRESS 0x3F8934 /end MEASUREMENT
/begin MEASUREMENT time_rel "Relativzeit" ULONG FORMULA_0145 0 0.0 0.0 71582788.25 READ_WRITE ECU_ADDRESS 0x3F89D4 /end MEASUREMENT
/begin MEASUREMENT time_sa "Zeit seit SA" ULONG FORMULA_0147 0 0.0 0.0 655.0 READ_WRITE ECU_ADDRESS 0x3F895C /end MEASUREMENT
/begin MEASUREMENT time_st "Status Zeiten" UBYTE FORMULA_0189 0 0.0 0.0 255.0 READ_WRITE ECU_ADDRESS 0x3F89D3 /end MEASUREMENT
/begin MEASUREMENT time_vl "Zeit seit Eintritt in VL" ULONG FORMULA_0147 0 0.0 0.0 655.0 READ_WRITE ECU_ADDRESS 0x3F8960 /end MEASUREMENT
/begin MEASUREMENT tka "Kuehlwasseraustrittstemperatur" SWORD FORMULA_0023 0 0.0 -50.0 170.0 READ_WRITE ECU_ADDRESS 0x3F86B2 /end MEASUREMENT
/begin MEASUREMENT tksm "Kraftstofftemperatur vom Modell" SWORD FORMULA_0023 0 0.0 -50.0 170.0 READ_WRITE ECU_ADDRESS 0x3F8A06 /end MEASUREMENT
/begin MEASUREMENT tmot "Motortemperatur-Kuehlwasser" SWORD FORMULA_0023 0 0.0 -50.0 170.0 READ_WRITE ECU_ADDRESS 0x3F86B4 /end MEASUREMENT
/begin MEASUREMENT tmot_modell "OBD-Modelltemperatur" SLONG FORMULA_0343 0 0.0 -50.0 170.0 READ_WRITE ECU_ADDRESS 0x3F86B8 /end MEASUREMENT
/begin MEASUREMENT tmot_sta "Status Uebertemperaturanzeige" UBYTE FORMULA_0344 0 0.0 0.0 255.0 READ_WRITE BIT_MASK 0x3 ECU_ADDRESS 0x3F86BC /end MEASUREMENT
/begin MEASUREMENT tmot_sta_zws "Status Zwangsschaltung" UBYTE FORMULA_0345 0 0 0.0 255.0 READ_WRITE BIT_MASK 0x4 ECU_ADDRESS 0x3F86BC /end MEASUREMENT
/begin MEASUREMENT toel "Temperatur am Oelfilterkopf" SWORD FORMULA_0023 0 0.0 -50.0 170.0 READ_WRITE ECU_ADDRESS 0x3F86BE /end MEASUREMENT
/begin MEASUREMENT toel_can "gefilterte Motoroeltemperatur (0xFF = Fehler)." UBYTE FORMULA_0165 0 0.0 -48.0 170.0 READ_WRITE ECU_ADDRESS 0x3F8978 /end MEASUREMENT
/begin MEASUREMENT toel_start_ok "Bedingung Oeltemperatur gemessen" UBYTE FORMULA_0003 0 0.0 0.0 255.0 READ_WRITE ECU_ADDRESS 0x3F8640 /end MEASUREMENT
/begin MEASUREMENT tsgrw_b1 "Saugrohrwandtemperatur" SWORD FORMULA_0023 0 0.0 -50.0 170.0 READ_WRITE ECU_ADDRESS 0x3F86C2 /end MEASUREMENT
/begin MEASUREMENT tsgrw_b2 "Saugrohrwandtemperatur" SWORD FORMULA_0023 0 0.0 -50.0 170.0 READ_WRITE ECU_ADDRESS 0x3F86C4 /end MEASUREMENT
/begin MEASUREMENT tsgrw_m "Mittelwert Saugrohrwandtemperatur" SWORD FORMULA_0023 0 0.0 -50.0 170.0 READ_WRITE ECU_ADDRESS 0x3F86C0 /end MEASUREMENT
/begin MEASUREMENT tumg "Umgebungstemperatur" SWORD FORMULA_0023 0 0.0 -50.0 170.0 READ_WRITE ECU_ADDRESS 0x3F89D0 /end MEASUREMENT
/begin MEASUREMENT tumg_ersatz "Ersatzwert der Umgebungstemperatur" SWORD FORMULA_0023 0 0.0 -50.0 170.0 READ_WRITE ECU_ADDRESS 0x3F86C6 /end MEASUREMENT
/begin MEASUREMENT tumg_st "Status Umgebungstemperatur" UBYTE FORMULA_0188 0 0.0 0.0 255.0 READ_WRITE ECU_ADDRESS 0x3F89D2 /end MEASUREMENT
/begin MEASUREMENT tz_diag_tpu_err "Tigger fuer Fehleranfilterung bei TPU Dauerbestromung." UWORD FORMULA_0010 0 0.0 0.0 65535.0 READ_WRITE ECU_ADDRESS 0x3F8552 /end MEASUREMENT
/begin MEASUREMENT tz_grad_b1 "Zuendwinkelgradient pro Bank" SWORD FORMULA_0231 0 0.0 -100.0 100.0 READ_WRITE ECU_ADDRESS 0x3F8540 /end MEASUREMENT
/begin MEASUREMENT tz_grad_b2 "Zuendwinkelgradient pro Bank" SWORD FORMULA_0231 0 0.0 -100.0 100.0 READ_WRITE ECU_ADDRESS 0x3F8542 /end MEASUREMENT
/begin MEASUREMENT tz_min_b1 "minimal zulaessiger Zuendwinkel" SWORD FORMULA_0102 0 0.0 -50.0 60.0 READ_WRITE ECU_ADDRESS 0x3F8642 /end MEASUREMENT
/begin MEASUREMENT tz_min_b2 "minimal zulaessiger Zuendwinkel" SWORD FORMULA_0102 0 0.0 -50.0 60.0 READ_WRITE ECU_ADDRESS 0x3F8644 /end MEASUREMENT
/begin MEASUREMENT tz_ve_mw "mittlerer Zuendwinkel ohne Momenteneingriff" SWORD FORMULA_0102 0 0.0 -50.0 60.0 READ_WRITE ECU_ADDRESS 0x3F8534 /end MEASUREMENT
/begin MEASUREMENT tz_zyl_ti "Zylinder selektive Abschaltung der Einspritzung" UWORD FORMULA_0080 0 0.0 0.0 65535.0 READ_WRITE ECU_ADDRESS 0x3F8518 /end MEASUREMENT
/begin MEASUREMENT u_wakeup "Spannungswert Wakeup" SWORD FORMULA_0008 0 0.0 0.0 28.0 READ_WRITE ECU_ADDRESS 0x3F85EA /end MEASUREMENT
/begin MEASUREMENT ub "Spannungswert U_KL87" SWORD FORMULA_0008 0 0.0 0.0 28.0 READ_WRITE ECU_ADDRESS 0x3F85E6 /end MEASUREMENT
/begin MEASUREMENT ub_roh "Rohwert der U_KL87-Erfassung" SWORD FORMULA_0261 0 0.0 0.0 28.0 READ_WRITE ECU_ADDRESS 0x3F85E8 /end MEASUREMENT
/begin MEASUREMENT uext_korr_pin_111_219_514 "Korrekturfaktor fuer UEXT" UWORD FORMULA_0073 0 0.0 0.0 4.0 READ_WRITE ECU_ADDRESS 0x3F8586 /end MEASUREMENT
/begin MEASUREMENT uext_korr_pin_124_512 "Korrekturfaktor fuer UEXT" UWORD FORMULA_0073 0 0.0 0.0 4.0 READ_WRITE ECU_ADDRESS 0x3F8588 /end MEASUREMENT
/begin MEASUREMENT uext_pin_111_219_514 "Versorgungsspannung" UWORD FORMULA_0247 0 0.0 0.0 6.666500091552734 READ_WRITE ECU_ADDRESS 0x3F8582 /end MEASUREMENT
/begin MEASUREMENT uext_pin_124_512 "Versorgungsspannung" UWORD FORMULA_0247 0 0.0 0.0 6.666500091552734 READ_WRITE ECU_ADDRESS 0x3F8584 /end MEASUREMENT
/begin MEASUREMENT v_direkt "diskrete Geschwindigkeit" SWORD FORMULA_0076 0 0.0 -80.0 360.0 READ_WRITE ECU_ADDRESS 0x3F8674 /end MEASUREMENT
/begin MEASUREMENT v_hinten "v-Hinterachse" SWORD FORMULA_0076 0 0.0 -80.0 360.0 READ_WRITE ECU_ADDRESS 0x3F88D8 /end MEASUREMENT
/begin MEASUREMENT v_max_anh_st "Status v_max-Anhebung durch CAS bzw. BMW-Nachruestung" UBYTE FORMULA_0221 0 0.0 0.0 255.0 READ_WRITE ECU_ADDRESS 0x3F8A22 /end MEASUREMENT
/begin MEASUREMENT v_max_delta "Delta zur Maximalgeschwindigkeit" SWORD FORMULA_0076 0 0.0 -80.0 360.0 READ_WRITE ECU_ADDRESS 0x3F892E /end MEASUREMENT
/begin MEASUREMENT v_max_schw_can "Maximalgeschwindigkeit" SWORD FORMULA_0076 0 0.0 -80.0 360.0 READ_WRITE ECU_ADDRESS 0x3F8A20 /end MEASUREMENT
/begin MEASUREMENT v_max_schw_direkt "Maximalgeschwindigkeit" SWORD FORMULA_0076 0 0.0 -80.0 360.0 READ_WRITE ECU_ADDRESS 0x3F8A1E /end MEASUREMENT
/begin MEASUREMENT v_rad_hl "v-Rad hinten-links" SWORD FORMULA_0076 0 0.0 -80.0 360.0 READ_WRITE ECU_ADDRESS 0x3F88D2 /end MEASUREMENT
/begin MEASUREMENT v_rad_hr "v-Rad hinten-rechts" SWORD FORMULA_0076 0 0.0 -80.0 360.0 READ_WRITE ECU_ADDRESS 0x3F88D4 /end MEASUREMENT
/begin MEASUREMENT v_rad_vl "v-Rad vorne-links" SWORD FORMULA_0076 0 0.0 -80.0 360.0 READ_WRITE ECU_ADDRESS 0x3F88CE /end MEASUREMENT
/begin MEASUREMENT v_rad_vr "v-Rad vorne-rechts" SWORD FORMULA_0076 0 0.0 -80.0 360.0 READ_WRITE ECU_ADDRESS 0x3F88D0 /end MEASUREMENT
/begin MEASUREMENT v_tacho "Tachogeschwindigkeit" SWORD FORMULA_0076 0 0.0 -80.0 360.0 READ_WRITE ECU_ADDRESS 0x3F89E0 /end MEASUREMENT
/begin MEASUREMENT v_vorne "v-Vorderachse" SWORD FORMULA_0076 0 0.0 -80.0 360.0 READ_WRITE ECU_ADDRESS 0x3F88D6 /end MEASUREMENT
/begin MEASUREMENT van_exd_n_soll "Van Prueflauf LLR-Sollwert" SWORD FORMULA_0006 0 0.0 0.0 10000.0 READ_WRITE ECU_ADDRESS 0x3F89E4 /end MEASUREMENT
/begin MEASUREMENT van_exd_st "Diagnosestatus Vanos" UBYTE FORMULA_0211 0 0.0 0.0 255.0 READ_WRITE ECU_ADDRESS 0x3F8A12 /end MEASUREMENT
/begin MEASUREMENT van_ist_A1 "Istposition" SWORD FORMULA_0102 0 0.0 50.0 160.0 READ_WRITE ECU_ADDRESS 0x3F87D4 /end MEASUREMENT
/begin MEASUREMENT van_ist_A2 "Istposition" SWORD FORMULA_0102 0 0.0 50.0 160.0 READ_WRITE ECU_ADDRESS 0x3F87D8 /end MEASUREMENT
/begin MEASUREMENT van_ist_E1 "Istposition" SWORD FORMULA_0102 0 0.0 50.0 160.0 READ_WRITE ECU_ADDRESS 0x3F87D2 /end MEASUREMENT
/begin MEASUREMENT van_ist_E2 "Istposition" SWORD FORMULA_0102 0 0.0 50.0 160.0 READ_WRITE ECU_ADDRESS 0x3F87D6 /end MEASUREMENT
/begin MEASUREMENT van_ist_filt_A1 "gefilterte Istposition" SWORD FORMULA_0102 0 0.0 50.0 160.0 READ_WRITE ECU_ADDRESS 0x3F87DC /end MEASUREMENT
/begin MEASUREMENT van_ist_filt_A2 "gefilterte Istposition" SWORD FORMULA_0102 0 0.0 50.0 160.0 READ_WRITE ECU_ADDRESS 0x3F87E0 /end MEASUREMENT
/begin MEASUREMENT van_ist_filt_E1 "gefilterte Istposition" SWORD FORMULA_0102 0 0.0 50.0 160.0 READ_WRITE ECU_ADDRESS 0x3F87DA /end MEASUREMENT
/begin MEASUREMENT van_ist_filt_E2 "gefilterte Istposition" SWORD FORMULA_0102 0 0.0 50.0 160.0 READ_WRITE ECU_ADDRESS 0x3F87DE /end MEASUREMENT
/begin MEASUREMENT van_sk_st "Status Notprogramm wegen Vanos" UBYTE FORMULA_0003 0 0.0 0.0 255.0 READ_WRITE ECU_ADDRESS 0x3F8A13 /end MEASUREMENT
/begin MEASUREMENT van_soll_A1 "Sollwert" SWORD FORMULA_0102 0 0.0 50.0 160.0 READ_WRITE ECU_ADDRESS 0x3F87E4 /end MEASUREMENT
/begin MEASUREMENT van_soll_A2 "Sollwert" SWORD FORMULA_0102 0 0.0 50.0 160.0 READ_WRITE ECU_ADDRESS 0x3F87E8 /end MEASUREMENT
/begin MEASUREMENT van_soll_E1 "Sollwert" SWORD FORMULA_0102 0 0.0 50.0 160.0 READ_WRITE ECU_ADDRESS 0x3F87E2 /end MEASUREMENT
/begin MEASUREMENT van_soll_E2 "Sollwert" SWORD FORMULA_0102 0 0.0 50.0 160.0 READ_WRITE ECU_ADDRESS 0x3F87E6 /end MEASUREMENT
/begin MEASUREMENT zust_md_rel_tl_vl "rel. Übergangsmoment TL-VL" SWORD FORMULA_0001 0 0.0 0.0 100.0 READ_WRITE ECU_ADDRESS 0x3F8948 /end MEASUREMENT
/begin MEASUREMENT zust_time_st "Zustandsstatus fuer CAN Zeiten" UBYTE FORMULA_0183 0 0.0 0.0 255.0 READ_WRITE ECU_ADDRESS 0x3F8988 /end MEASUREMENT
/begin MEASUREMENT zust_tka_start "tka im Zustand START" SWORD FORMULA_0023 0 0.0 -50.0 170.0 READ_WRITE ECU_ADDRESS 0x3F891A /end MEASUREMENT
/begin MEASUREMENT zust_tmot_start "tmot im Zustand START" SWORD FORMULA_0023 0 0.0 -50.0 170.0 READ_WRITE ECU_ADDRESS 0x3F8918 /end MEASUREMENT
/begin MEASUREMENT zustand_fahrzeug "Fahrzeugzustand" UWORD FORMULA_0182 0 0.0 0.0 65535.0 READ_WRITE ECU_ADDRESS 0x3F8986 /end MEASUREMENT
/begin MEASUREMENT zustand_motor "Betriebszustand der Motorsteuerung" UWORD FORMULA_0019 0 0.0 0.0 65535.0 READ_WRITE ECU_ADDRESS 0x3F891C /end MEASUREMENT
/begin COMPU_METHOD FORMULA_0000 "FORMULA_0000" RAT_FUNC "%7.0" "-" COEFFS 0 1 0 0 0 1 /end COMPU_METHOD
/begin COMPU_METHOD FORMULA_0001 "FORMULA_0001" RAT_FUNC "%6.1" "%" COEFFS 0 10.0 0.0 0 0.0 1.0 /end COMPU_METHOD
/begin COMPU_METHOD FORMULA_0003 "FORMULA_0003" RAT_FUNC "%3.0" "-" COEFFS 0 1 0 0 0 1 /end COMPU_METHOD
/begin COMPU_METHOD FORMULA_0006 "FORMULA_0006" RAT_FUNC "%5.0" "Upm" COEFFS 0 1 0 0 0 1 /end COMPU_METHOD
/begin COMPU_METHOD FORMULA_0007 "FORMULA_0007" RAT_FUNC "%8.3" "-" COEFFS 0 10000.0 0.0 0 0.0 1.0 /end COMPU_METHOD
/begin COMPU_METHOD FORMULA_0008 "FORMULA_0008" RAT_FUNC "%6.1" "V" COEFFS 0 10.0 0.0 0 0.0 1.0 /end COMPU_METHOD
/begin COMPU_METHOD FORMULA_0009 "FORMULA_0009" RAT_FUNC "%6.1" "Nm" COEFFS 0 10.0 0.0 0 0.0 1.0 /end COMPU_METHOD
/begin COMPU_METHOD FORMULA_0010 "FORMULA_0010" RAT_FUNC "%5.0" "-" COEFFS 0 1 0 0 0 1 /end COMPU_METHOD
/begin COMPU_METHOD FORMULA_0012 "FORMULA_0012" TAB_VERB "%3.0" "-" COMPU_TAB_REF FORMULA_0012_VTAB /end COMPU_METHOD
/begin COMPU_METHOD FORMULA_0019 "FORMULA_0019" TAB_VERB "%7.2" "-" COMPU_TAB_REF FORMULA_0019_VTAB /end COMPU_METHOD
/begin COMPU_METHOD FORMULA_0020 "FORMULA_0020" RAT_FUNC "%5.0" "qmm/s" COEFFS 0 5.e-002 0.0 0 0.0 1.0 /end COMPU_METHOD
/begin COMPU_METHOD FORMULA_0021 "FORMULA_0021" RAT_FUNC "%7.2" "s" COEFFS 0 100.0 0.0 0 0.0 1.0 /end COMPU_METHOD
/begin COMPU_METHOD FORMULA_0022 "FORMULA_0022" RAT_FUNC "%7.2" "%" COEFFS 0 100.0 0.0 0 0.0 1.0 /end COMPU_METHOD
/begin COMPU_METHOD FORMULA_0023 "FORMULA_0023" RAT_FUNC "%6.1" "°C" COEFFS 0 10.0 2732.0 0 0.0 1.0 /end COMPU_METHOD
/begin COMPU_METHOD FORMULA_0024 "FORMULA_0024" RAT_FUNC "%9.4" "-" COEFFS 0 32768.0 0.0 0 0.0 1.0 /end COMPU_METHOD
/begin COMPU_METHOD FORMULA_0025 "FORMULA_0025" RAT_FUNC "%8.3" "-" COEFFS 0 16384.0 0.0 0 0.0 1.0 /end COMPU_METHOD
/begin COMPU_METHOD FORMULA_0037 "FORMULA_0037" RAT_FUNC "%5.2" "-" COEFFS 0 1 0 0 0 1 /end COMPU_METHOD
/begin COMPU_METHOD FORMULA_0071 "FORMULA_0071" RAT_FUNC "%6.1" "s" COEFFS 0 10.0 0.0 0 0.0 1.0 /end COMPU_METHOD
/begin COMPU_METHOD FORMULA_0073 "FORMULA_0073" RAT_FUNC "%8.3" "-" COEFFS 0 1024.0 0.0 0 0.0 1.0 /end COMPU_METHOD
/begin COMPU_METHOD FORMULA_0074 "FORMULA_0074" RAT_FUNC "%6.1" "Kelvin" COEFFS 0 10.0 0.0 0 0.0 1.0 /end COMPU_METHOD
/begin COMPU_METHOD FORMULA_0075 "FORMULA_0075" RAT_FUNC "%6.1" "mbar" COEFFS 0 16.0 0.0 0 0.0 1.0 /end COMPU_METHOD
/begin COMPU_METHOD FORMULA_0076 "FORMULA_0076" RAT_FUNC "%6.1" "km/h" COEFFS 0 16.0 0.0 0 0.0 1.0 /end COMPU_METHOD
/begin COMPU_METHOD FORMULA_0080 "FORMULA_0080" RAT_FUNC "%7.2" "-" COEFFS 0 1 0 0 0 1 /end COMPU_METHOD
/begin COMPU_METHOD FORMULA_0081 "FORMULA_0081" TAB_VERB "%7.2" "-" COMPU_TAB_REF FORMULA_0081_VTAB /end COMPU_METHOD
/begin COMPU_METHOD FORMULA_0082 "FORMULA_0082" TAB_VERB "%7.2" "-" COMPU_TAB_REF FORMULA_0082_VTAB /end COMPU_METHOD
/begin COMPU_METHOD FORMULA_0083 "FORMULA_0083" TAB_VERB "%7.2" "-" COMPU_TAB_REF FORMULA_0083_VTAB /end COMPU_METHOD
/begin COMPU_METHOD FORMULA_0084 "FORMULA_0084" TAB_VERB "%7.2" "-" COMPU_TAB_REF FORMULA_0084_VTAB /end COMPU_METHOD
/begin COMPU_METHOD FORMULA_0085 "FORMULA_0085" TAB_VERB "%7.2" "-" COMPU_TAB_REF FORMULA_0085_VTAB /end COMPU_METHOD
/begin COMPU_METHOD FORMULA_0086 "FORMULA_0086" TAB_VERB "%7.2" "-" COMPU_TAB_REF FORMULA_0086_VTAB /end COMPU_METHOD
/begin COMPU_METHOD FORMULA_0087 "FORMULA_0087" TAB_VERB "%7.2" "-" COMPU_TAB_REF FORMULA_0087_VTAB /end COMPU_METHOD
/begin COMPU_METHOD FORMULA_0088 "FORMULA_0088" TAB_VERB "%7.2" "-" COMPU_TAB_REF FORMULA_0088_VTAB /end COMPU_METHOD
/begin COMPU_METHOD FORMULA_0089 "FORMULA_0089" TAB_VERB "%7.2" "-" COMPU_TAB_REF FORMULA_0089_VTAB /end COMPU_METHOD
/begin COMPU_METHOD FORMULA_0090 "FORMULA_0090" RAT_FUNC "%7.2" "mg" COEFFS 0 10.0 0.0 0 0.0 1.0 /end COMPU_METHOD
/begin COMPU_METHOD FORMULA_0091 "FORMULA_0091" TAB_VERB "%7.2" "-" COMPU_TAB_REF FORMULA_0091_VTAB /end COMPU_METHOD
/begin COMPU_METHOD FORMULA_0092 "FORMULA_0092" TAB_VERB "%7.2" "-" COMPU_TAB_REF FORMULA_0092_VTAB /end COMPU_METHOD
/begin COMPU_METHOD FORMULA_0093 "FORMULA_0093" TAB_VERB "%7.2" "-" COMPU_TAB_REF FORMULA_0093_VTAB /end COMPU_METHOD
/begin COMPU_METHOD FORMULA_0094 "FORMULA_0094" TAB_VERB "%7.2" "-" COMPU_TAB_REF FORMULA_0094_VTAB /end COMPU_METHOD
/begin COMPU_METHOD FORMULA_0095 "FORMULA_0095" TAB_VERB "%7.2" "-" COMPU_TAB_REF FORMULA_0095_VTAB /end COMPU_METHOD
/begin COMPU_METHOD FORMULA_0096 "FORMULA_0096" TAB_VERB "%7.2" "-" COMPU_TAB_REF FORMULA_0096_VTAB /end COMPU_METHOD
/begin COMPU_METHOD FORMULA_0097 "FORMULA_0097" TAB_VERB "%7.2" "-" COMPU_TAB_REF FORMULA_0097_VTAB /end COMPU_METHOD
/begin COMPU_METHOD FORMULA_0098 "FORMULA_0098" TAB_VERB "%7.2" "-" COMPU_TAB_REF FORMULA_0098_VTAB /end COMPU_METHOD
/begin COMPU_METHOD FORMULA_0099 "FORMULA_0099" TAB_VERB "%7.2" "-" COMPU_TAB_REF FORMULA_0099_VTAB /end COMPU_METHOD
/begin COMPU_METHOD FORMULA_0100 "FORMULA_0100" RAT_FUNC "%7.2" "-" COEFFS 0 10000.0 0.0 0 0.0 1.0 /end COMPU_METHOD
/begin COMPU_METHOD FORMULA_0101 "FORMULA_0101" TAB_VERB "%3.0" "-" COMPU_TAB_REF FORMULA_0101_VTAB /end COMPU_METHOD
/begin COMPU_METHOD FORMULA_0102 "FORMULA_0102" RAT_FUNC "%6.1" "°KW" COEFFS 0 10.0 0.0 0 0.0 1.0 /end COMPU_METHOD
/begin COMPU_METHOD FORMULA_0103 "FORMULA_0103" RAT_FUNC "%6.1" "kg/h" COEFFS 0 10.0 0.0 0 0.0 1.0 /end COMPU_METHOD
/begin COMPU_METHOD FORMULA_0104 "FORMULA_0104" RAT_FUNC "%6.1" "mg/asp" COEFFS 0 10.0 0.0 0 0.0 1.0 /end COMPU_METHOD
/begin COMPU_METHOD FORMULA_0105 "FORMULA_0105" RAT_FUNC "%5.0" "Upm/s" COEFFS 0 1 0 0 0 1 /end COMPU_METHOD
/begin COMPU_METHOD FORMULA_0106 "FORMULA_0106" RAT_FUNC "%7.2" "%" COEFFS 0 163.84 0.0 0 0.0 1.0 /end COMPU_METHOD
/begin COMPU_METHOD FORMULA_0107 "FORMULA_0107" RAT_FUNC "%6.1" "%" COEFFS 0 10.24 0.0 0 0.0 1.0 /end COMPU_METHOD
/begin COMPU_METHOD FORMULA_0108 "FORMULA_0108" TAB_VERB "%5.2" "-" COMPU_TAB_REF FORMULA_0108_VTAB /end COMPU_METHOD
/begin COMPU_METHOD FORMULA_0109 "FORMULA_0109" RAT_FUNC "%7.2" "s" COEFFS 0 200.0 0.0 0 0.0 1.0 /end COMPU_METHOD
/begin COMPU_METHOD FORMULA_0110 "FORMULA_0110" RAT_FUNC "%8.3" "bar" COEFFS 0 1000.0 0.0 0 0.0 1.0 /end COMPU_METHOD
/begin COMPU_METHOD FORMULA_0111 "FORMULA_0111" RAT_FUNC "%7.2" "mg" COEFFS 0 64.0 0.0 0 0.0 1.0 /end COMPU_METHOD
/begin COMPU_METHOD FORMULA_0112 "FORMULA_0112" TAB_VERB "%5.2" "-" COMPU_TAB_REF FORMULA_0112_VTAB /end COMPU_METHOD
/begin COMPU_METHOD FORMULA_0113 "FORMULA_0113" RAT_FUNC "%7.2" "Nm" COEFFS 0 10.0 0.0 0 0.0 1.0 /end COMPU_METHOD
/begin COMPU_METHOD FORMULA_0114 "FORMULA_0114" RAT_FUNC "%5.0" "digit" COEFFS 0 1 0 0 0 1 /end COMPU_METHOD
/begin COMPU_METHOD FORMULA_0115 "FORMULA_0115" TAB_VERB "%3.0" "-" COMPU_TAB_REF FORMULA_0115_VTAB /end COMPU_METHOD
/begin COMPU_METHOD FORMULA_0116 "FORMULA_0116" TAB_VERB "%5.0" "-" COMPU_TAB_REF FORMULA_0116_VTAB /end COMPU_METHOD
/begin COMPU_METHOD FORMULA_0117 "FORMULA_0117" TAB_VERB "%3.0" "-" COMPU_TAB_REF FORMULA_0117_VTAB /end COMPU_METHOD
/begin COMPU_METHOD FORMULA_0118 "FORMULA_0118" TAB_VERB "%3.0" "-" COMPU_TAB_REF FORMULA_0118_VTAB /end COMPU_METHOD
/begin COMPU_METHOD FORMULA_0119 "FORMULA_0119" TAB_VERB "%3.0" "-" COMPU_TAB_REF FORMULA_0119_VTAB /end COMPU_METHOD
/begin COMPU_METHOD FORMULA_0120 "FORMULA_0120" RAT_FUNC "%6.1" "Nm" COEFFS 0 2.0 0.0 0 0.0 1.0 /end COMPU_METHOD
/begin COMPU_METHOD FORMULA_0121 "FORMULA_0121" TAB_VERB "%7.2" "-" COMPU_TAB_REF FORMULA_0121_VTAB /end COMPU_METHOD
/begin COMPU_METHOD FORMULA_0122 "FORMULA_0122" TAB_VERB "%5.2" "-" COMPU_TAB_REF FORMULA_0122_VTAB /end COMPU_METHOD
/begin COMPU_METHOD FORMULA_0123 "FORMULA_0123" RAT_FUNC "%7.2" "m/(s*s)" COEFFS 0 40.0 0.0 0 0.0 1.0 /end COMPU_METHOD
/begin COMPU_METHOD FORMULA_0124 "FORMULA_0124" TAB_VERB "%5.2" "-" COMPU_TAB_REF FORMULA_0124_VTAB /end COMPU_METHOD
/begin COMPU_METHOD FORMULA_0125 "FORMULA_0125" TAB_VERB "%5.2" "-" COMPU_TAB_REF FORMULA_0125_VTAB /end COMPU_METHOD
/begin COMPU_METHOD FORMULA_0126 "FORMULA_0126" TAB_VERB "%3.0" "-" COMPU_TAB_REF FORMULA_0126_VTAB /end COMPU_METHOD
/begin COMPU_METHOD FORMULA_0127 "FORMULA_0127" TAB_VERB "%3.0" "-" COMPU_TAB_REF FORMULA_0127_VTAB /end COMPU_METHOD
/begin COMPU_METHOD FORMULA_0128 "FORMULA_0128" TAB_VERB "%3.0" "-" COMPU_TAB_REF FORMULA_0128_VTAB /end COMPU_METHOD
/begin COMPU_METHOD FORMULA_0129 "FORMULA_0129" RAT_FUNC "%3.0" "bar" COEFFS 0 1 0 0 0 1 /end COMPU_METHOD
/begin COMPU_METHOD FORMULA_0130 "FORMULA_0130" TAB_VERB "%5.2" "-" COMPU_TAB_REF FORMULA_0130_VTAB /end COMPU_METHOD
/begin COMPU_METHOD FORMULA_0131 "FORMULA_0131" RAT_FUNC "%5.0" "bar/s" COEFFS 0 2.e-002 0.0 0 0.0 1.0 /end COMPU_METHOD
/begin COMPU_METHOD FORMULA_0132 "FORMULA_0132" RAT_FUNC "%7.2" "Grad" COEFFS 0 22.75312855517634 0.0 0 0.0 1.0 /end COMPU_METHOD
/begin COMPU_METHOD FORMULA_0133 "FORMULA_0133" RAT_FUNC "%7.2" "Grad/s" COEFFS 0 22.75312855517634 0.0 0 0.0 1.0 /end COMPU_METHOD
/begin COMPU_METHOD FORMULA_0134 "FORMULA_0134" TAB_VERB "%3.0" "-" COMPU_TAB_REF FORMULA_0134_VTAB /end COMPU_METHOD
/begin COMPU_METHOD FORMULA_0135 "FORMULA_0135" RAT_FUNC "%3.0" ".Gang" COEFFS 0 1 0 0 0 1 /end COMPU_METHOD
/begin COMPU_METHOD FORMULA_0136 "FORMULA_0136" TAB_VERB "%5.2" "-" COMPU_TAB_REF FORMULA_0136_VTAB /end COMPU_METHOD
/begin COMPU_METHOD FORMULA_0137 "FORMULA_0137" RAT_FUNC "%5.0" "Upm" COEFFS 0 0.1 0.0 0 0.0 1.0 /end COMPU_METHOD
/begin COMPU_METHOD FORMULA_0138 "FORMULA_0138" RAT_FUNC "%7.2" "-" COEFFS 0 8.0 0.0 0 0.0 1.0 /end COMPU_METHOD
/begin COMPU_METHOD FORMULA_0139 "FORMULA_0139" TAB_VERB "%3.0" "-" COMPU_TAB_REF FORMULA_0139_VTAB /end COMPU_METHOD
/begin COMPU_METHOD FORMULA_0140 "FORMULA_0140" TAB_VERB "%3.0" "-" COMPU_TAB_REF FORMULA_0140_VTAB /end COMPU_METHOD
/begin COMPU_METHOD FORMULA_0141 "FORMULA_0141" TAB_VERB "%5.2" "-" COMPU_TAB_REF FORMULA_0141_VTAB /end COMPU_METHOD
/begin COMPU_METHOD FORMULA_0142 "FORMULA_0142" RAT_FUNC "%6.1" "%" COEFFS 0 16.67 0.0 0 0.0 1.0 /end COMPU_METHOD
/begin COMPU_METHOD FORMULA_0143 "FORMULA_0143" RAT_FUNC "%6.1" "qmm" COEFFS 0 10.0 0.0 0 0.0 1.0 /end COMPU_METHOD
/begin COMPU_METHOD FORMULA_0144 "FORMULA_0144" RAT_FUNC "%8.3" "ml" COEFFS 0 1000.0 0.0 0 0.0 1.0 /end COMPU_METHOD
/begin COMPU_METHOD FORMULA_0145 "FORMULA_0145" RAT_FUNC "%9.2" "min" COEFFS 0 60.0 0.0 0 0.0 1.0 /end COMPU_METHOD
/begin COMPU_METHOD FORMULA_0146 "FORMULA_0146" TAB_VERB "%5.2" "-" COMPU_TAB_REF FORMULA_0146_VTAB /end COMPU_METHOD
/begin COMPU_METHOD FORMULA_0147 "FORMULA_0147" RAT_FUNC "%9.2" "s" COEFFS 0 100.0 0.0 0 0.0 1.0 /end COMPU_METHOD
/begin COMPU_METHOD FORMULA_0148 "FORMULA_0148" TAB_VERB "%5.2" "-" COMPU_TAB_REF FORMULA_0148_VTAB /end COMPU_METHOD
/begin COMPU_METHOD FORMULA_0149 "FORMULA_0149" TAB_VERB "%5.2" "-" COMPU_TAB_REF FORMULA_0149_VTAB /end COMPU_METHOD
/begin COMPU_METHOD FORMULA_0150 "FORMULA_0150" TAB_VERB "%7.2" "-" COMPU_TAB_REF FORMULA_0150_VTAB /end COMPU_METHOD
/begin COMPU_METHOD FORMULA_0151 "FORMULA_0151" TAB_VERB "%7.2" "-" COMPU_TAB_REF FORMULA_0151_VTAB /end COMPU_METHOD
/begin COMPU_METHOD FORMULA_0152 "FORMULA_0152" TAB_VERB "%7.2" "-" COMPU_TAB_REF FORMULA_0152_VTAB /end COMPU_METHOD
/begin COMPU_METHOD FORMULA_0153 "FORMULA_0153" TAB_VERB "%7.2" "-" COMPU_TAB_REF FORMULA_0153_VTAB /end COMPU_METHOD
/begin COMPU_METHOD FORMULA_0154 "FORMULA_0154" TAB_VERB "%7.2" "-" COMPU_TAB_REF FORMULA_0154_VTAB /end COMPU_METHOD
/begin COMPU_METHOD FORMULA_0155 "FORMULA_0155" TAB_VERB "%7.2" "-" COMPU_TAB_REF FORMULA_0155_VTAB /end COMPU_METHOD
/begin COMPU_METHOD FORMULA_0156 "FORMULA_0156" TAB_VERB "%7.2" "-" COMPU_TAB_REF FORMULA_0156_VTAB /end COMPU_METHOD
/begin COMPU_METHOD FORMULA_0157 "FORMULA_0157" TAB_VERB "%7.2" "-" COMPU_TAB_REF FORMULA_0157_VTAB /end COMPU_METHOD
/begin COMPU_METHOD FORMULA_0158 "FORMULA_0158" TAB_VERB "%7.2" "-" COMPU_TAB_REF FORMULA_0158_VTAB /end COMPU_METHOD
/begin COMPU_METHOD FORMULA_0159 "FORMULA_0159" TAB_VERB "%5.2" "-" COMPU_TAB_REF FORMULA_0159_VTAB /end COMPU_METHOD
/begin COMPU_METHOD FORMULA_0160 "FORMULA_0160" TAB_VERB "%5.2" "-" COMPU_TAB_REF FORMULA_0160_VTAB /end COMPU_METHOD
/begin COMPU_METHOD FORMULA_0161 "FORMULA_0161" RAT_FUNC "%6.1" "%" COEFFS 0 10.24 0.0 0 0.0 1.0 /end COMPU_METHOD
/begin COMPU_METHOD FORMULA_0162 "FORMULA_0162" TAB_VERB "%3.0" "-" COMPU_TAB_REF FORMULA_0162_VTAB /end COMPU_METHOD
/begin COMPU_METHOD FORMULA_0163 "FORMULA_0163" TAB_VERB "%3.0" "-" COMPU_TAB_REF FORMULA_0163_VTAB /end COMPU_METHOD
/begin COMPU_METHOD FORMULA_0164 "FORMULA_0164" TAB_VERB "%3.0" "-" COMPU_TAB_REF FORMULA_0164_VTAB /end COMPU_METHOD
/begin COMPU_METHOD FORMULA_0165 "FORMULA_0165" RAT_FUNC "%6.3" "°C" COEFFS 0 1.0 48.0 0 0.0 1.0 /end COMPU_METHOD
/begin COMPU_METHOD FORMULA_0166 "FORMULA_0166" RAT_FUNC "%3.0" "Upm" COEFFS 0 2.e-002 0.0 0 0.0 1.0 /end COMPU_METHOD
/begin COMPU_METHOD FORMULA_0167 "FORMULA_0167" TAB_VERB "%3.0" "-" COMPU_TAB_REF FORMULA_0167_VTAB /end COMPU_METHOD
/begin COMPU_METHOD FORMULA_0168 "FORMULA_0168" TAB_VERB "%3.0" "-" COMPU_TAB_REF FORMULA_0168_VTAB /end COMPU_METHOD
/begin COMPU_METHOD FORMULA_0169 "FORMULA_0169" TAB_VERB "%3.0" "-" COMPU_TAB_REF FORMULA_0169_VTAB /end COMPU_METHOD
/begin COMPU_METHOD FORMULA_0170 "FORMULA_0170" TAB_VERB "%3.0" "-" COMPU_TAB_REF FORMULA_0170_VTAB /end COMPU_METHOD
/begin COMPU_METHOD FORMULA_0171 "FORMULA_0171" TAB_VERB "%3.0" "-" COMPU_TAB_REF FORMULA_0171_VTAB /end COMPU_METHOD
/begin COMPU_METHOD FORMULA_0172 "FORMULA_0172" TAB_VERB "%3.0" "-" COMPU_TAB_REF FORMULA_0172_VTAB /end COMPU_METHOD
/begin COMPU_METHOD FORMULA_0173 "FORMULA_0173" TAB_VERB "%3.0" "-" COMPU_TAB_REF FORMULA_0173_VTAB /end COMPU_METHOD
/begin COMPU_METHOD FORMULA_0174 "FORMULA_0174" TAB_VERB "%3.0" "-" COMPU_TAB_REF FORMULA_0174_VTAB /end COMPU_METHOD
/begin COMPU_METHOD FORMULA_0175 "FORMULA_0175" TAB_VERB "%3.0" "-" COMPU_TAB_REF FORMULA_0175_VTAB /end COMPU_METHOD
/begin COMPU_METHOD FORMULA_0176 "FORMULA_0176" TAB_VERB "%3.0" "-" COMPU_TAB_REF FORMULA_0176_VTAB /end COMPU_METHOD
/begin COMPU_METHOD FORMULA_0177 "FORMULA_0177" TAB_VERB "%3.0" "-" COMPU_TAB_REF FORMULA_0177_VTAB /end COMPU_METHOD
/begin COMPU_METHOD FORMULA_0178 "FORMULA_0178" TAB_VERB "%3.0" "-" COMPU_TAB_REF FORMULA_0178_VTAB /end COMPU_METHOD
/begin COMPU_METHOD FORMULA_0179 "FORMULA_0179" TAB_VERB "%5.0" "-" COMPU_TAB_REF FORMULA_0179_VTAB /end COMPU_METHOD
/begin COMPU_METHOD FORMULA_0180 "FORMULA_0180" TAB_VERB "%5.2" "-" COMPU_TAB_REF FORMULA_0180_VTAB /end COMPU_METHOD
/begin COMPU_METHOD FORMULA_0181 "FORMULA_0181" TAB_VERB "%7.2" "-" COMPU_TAB_REF FORMULA_0181_VTAB /end COMPU_METHOD
/begin COMPU_METHOD FORMULA_0182 "FORMULA_0182" TAB_VERB "%5.0" "-" COMPU_TAB_REF FORMULA_0182_VTAB /end COMPU_METHOD
/begin COMPU_METHOD FORMULA_0183 "FORMULA_0183" TAB_VERB "%5.2" "-" COMPU_TAB_REF FORMULA_0183_VTAB /end COMPU_METHOD
/begin COMPU_METHOD FORMULA_0184 "FORMULA_0184" TAB_VERB "%3.0" "-" COMPU_TAB_REF FORMULA_0184_VTAB /end COMPU_METHOD
/begin COMPU_METHOD FORMULA_0185 "FORMULA_0185" TAB_VERB "%5.0" "-" COMPU_TAB_REF FORMULA_0185_VTAB /end COMPU_METHOD
/begin COMPU_METHOD FORMULA_0186 "FORMULA_0186" RAT_FUNC "%8.3" "-/10ms" COEFFS 0 10000.0 0.0 0 0.0 1.0 /end COMPU_METHOD
/begin COMPU_METHOD FORMULA_0187 "FORMULA_0187" RAT_FUNC "%8.3" "100/10ms" COEFFS 0 100.0 0.0 0 0.0 1.0 /end COMPU_METHOD
/begin COMPU_METHOD FORMULA_0188 "FORMULA_0188" TAB_VERB "%5.2" "-" COMPU_TAB_REF FORMULA_0188_VTAB /end COMPU_METHOD
/begin COMPU_METHOD FORMULA_0189 "FORMULA_0189" TAB_VERB "%5.2" "-" COMPU_TAB_REF FORMULA_0189_VTAB /end COMPU_METHOD
/begin COMPU_METHOD FORMULA_0190 "FORMULA_0190" RAT_FUNC "%5.0" "Tage" COEFFS 0 1 0 0 0 1 /end COMPU_METHOD
/begin COMPU_METHOD FORMULA_0191 "FORMULA_0191" TAB_VERB "%5.2" "-" COMPU_TAB_REF FORMULA_0191_VTAB /end COMPU_METHOD
/begin COMPU_METHOD FORMULA_0192 "FORMULA_0192" RAT_FUNC "%3.0" "°C" COEFFS 0 1.111111111111111 61.33333333333334 0 0.0 1.0 /end COMPU_METHOD
/begin COMPU_METHOD FORMULA_0193 "FORMULA_0193" TAB_VERB "%7.2" "-" COMPU_TAB_REF FORMULA_0193_VTAB /end COMPU_METHOD
/begin COMPU_METHOD FORMULA_0194 "FORMULA_0194" TAB_VERB "%5.2" "-" COMPU_TAB_REF FORMULA_0194_VTAB /end COMPU_METHOD
/begin COMPU_METHOD FORMULA_0195 "FORMULA_0195" TAB_VERB "%3.0" "-" COMPU_TAB_REF FORMULA_0195_VTAB /end COMPU_METHOD
/begin COMPU_METHOD FORMULA_0196 "FORMULA_0196" TAB_VERB "%3.0" "-" COMPU_TAB_REF FORMULA_0196_VTAB /end COMPU_METHOD
/begin COMPU_METHOD FORMULA_0197 "FORMULA_0197" TAB_VERB "%3.0" "-" COMPU_TAB_REF FORMULA_0197_VTAB /end COMPU_METHOD
/begin COMPU_METHOD FORMULA_0198 "FORMULA_0198" TAB_VERB "%3.0" "-" COMPU_TAB_REF FORMULA_0198_VTAB /end COMPU_METHOD
/begin COMPU_METHOD FORMULA_0199 "FORMULA_0199" RAT_FUNC "%9.4" "-" COEFFS 0 16384.0 0.0 0 0.0 1.0 /end COMPU_METHOD
/begin COMPU_METHOD FORMULA_0200 "FORMULA_0200" TAB_VERB "%5.2" "-" COMPU_TAB_REF FORMULA_0200_VTAB /end COMPU_METHOD
/begin COMPU_METHOD FORMULA_0201 "FORMULA_0201" TAB_VERB "%5.2" "-" COMPU_TAB_REF FORMULA_0201_VTAB /end COMPU_METHOD
/begin COMPU_METHOD FORMULA_0202 "FORMULA_0202" TAB_VERB "%5.2" "-" COMPU_TAB_REF FORMULA_0202_VTAB /end COMPU_METHOD
/begin COMPU_METHOD FORMULA_0203 "FORMULA_0203" TAB_VERB "%5.2" "-" COMPU_TAB_REF FORMULA_0203_VTAB /end COMPU_METHOD
/begin COMPU_METHOD FORMULA_0204 "FORMULA_0204" TAB_VERB "%5.2" "-" COMPU_TAB_REF FORMULA_0204_VTAB /end COMPU_METHOD
/begin COMPU_METHOD FORMULA_0205 "FORMULA_0205" TAB_VERB "%5.2" "-" COMPU_TAB_REF FORMULA_0205_VTAB /end COMPU_METHOD
/begin COMPU_METHOD FORMULA_0206 "FORMULA_0206" TAB_VERB "%5.2" "-" COMPU_TAB_REF FORMULA_0206_VTAB /end COMPU_METHOD
/begin COMPU_METHOD FORMULA_0207 "FORMULA_0207" TAB_VERB "%5.2" "-" COMPU_TAB_REF FORMULA_0207_VTAB /end COMPU_METHOD
/begin COMPU_METHOD FORMULA_0208 "FORMULA_0208" TAB_VERB "%3.0" "-" COMPU_TAB_REF FORMULA_0208_VTAB /end COMPU_METHOD
/begin COMPU_METHOD FORMULA_0209 "FORMULA_0209" TAB_VERB "%5.2" "-" COMPU_TAB_REF FORMULA_0209_VTAB /end COMPU_METHOD
/begin COMPU_METHOD FORMULA_0210 "FORMULA_0210" TAB_VERB "%5.2" "-" COMPU_TAB_REF FORMULA_0210_VTAB /end COMPU_METHOD
/begin COMPU_METHOD FORMULA_0211 "FORMULA_0211" TAB_VERB "%3.0" "-" COMPU_TAB_REF FORMULA_0211_VTAB /end COMPU_METHOD
/begin COMPU_METHOD FORMULA_0212 "FORMULA_0212" TAB_VERB "%5.2" "-" COMPU_TAB_REF FORMULA_0212_VTAB /end COMPU_METHOD
/begin COMPU_METHOD FORMULA_0213 "FORMULA_0213" TAB_VERB "%3.0" "-" COMPU_TAB_REF FORMULA_0213_VTAB /end COMPU_METHOD
/begin COMPU_METHOD FORMULA_0214 "FORMULA_0214" RAT_FUNC "%3.0" "s" COEFFS 0 1 0 0 0 1 /end COMPU_METHOD
/begin COMPU_METHOD FORMULA_0215 "FORMULA_0215" TAB_VERB "%3.0" "-" COMPU_TAB_REF FORMULA_0215_VTAB /end COMPU_METHOD
/begin COMPU_METHOD FORMULA_0216 "FORMULA_0216" TAB_VERB "%3.0" "-" COMPU_TAB_REF FORMULA_0216_VTAB /end COMPU_METHOD
/begin COMPU_METHOD FORMULA_0217 "FORMULA_0217" TAB_VERB "%3.0" "-" COMPU_TAB_REF FORMULA_0217_VTAB /end COMPU_METHOD
/begin COMPU_METHOD FORMULA_0218 "FORMULA_0218" TAB_VERB "%3.0" "-" COMPU_TAB_REF FORMULA_0218_VTAB /end COMPU_METHOD
/begin COMPU_METHOD FORMULA_0219 "FORMULA_0219" TAB_VERB "%3.0" "-" COMPU_TAB_REF FORMULA_0219_VTAB /end COMPU_METHOD
/begin COMPU_METHOD FORMULA_0220 "FORMULA_0220" TAB_VERB "%3.0" "-" COMPU_TAB_REF FORMULA_0220_VTAB /end COMPU_METHOD
/begin COMPU_METHOD FORMULA_0221 "FORMULA_0221" TAB_VERB "%3.0" "-" COMPU_TAB_REF FORMULA_0221_VTAB /end COMPU_METHOD
/begin COMPU_METHOD FORMULA_0222 "FORMULA_0222" TAB_VERB "%3.0" "-" COMPU_TAB_REF FORMULA_0222_VTAB /end COMPU_METHOD
/begin COMPU_METHOD FORMULA_0223 "FORMULA_0223" TAB_VERB "%5.2" "-" COMPU_TAB_REF FORMULA_0223_VTAB /end COMPU_METHOD
/begin COMPU_METHOD FORMULA_0224 "FORMULA_0224" TAB_VERB "%5.2" "-" COMPU_TAB_REF FORMULA_0224_VTAB /end COMPU_METHOD
/begin COMPU_METHOD FORMULA_0225 "FORMULA_0225" RAT_FUNC "%10.3" "°KW" COEFFS 0 81920.0 0.0 0 0.0 1.0 /end COMPU_METHOD
/begin COMPU_METHOD FORMULA_0226 "FORMULA_0226" RAT_FUNC "%8.1" "°KW" COEFFS 0 10.0 0.0 0 0.0 1.0 /end COMPU_METHOD
/begin COMPU_METHOD FORMULA_0227 "FORMULA_0227" RAT_FUNC "%7.2" "nSs" COEFFS 0 51.22410237444204 0.0 0 0.0 1.0 /end COMPU_METHOD
/begin COMPU_METHOD FORMULA_0228 "FORMULA_0228" TAB_VERB "%5.0" "-" COMPU_TAB_REF FORMULA_0228_VTAB /end COMPU_METHOD
/begin COMPU_METHOD FORMULA_0229 "FORMULA_0229" TAB_VERB "%5.0" "-" COMPU_TAB_REF FORMULA_0229_VTAB /end COMPU_METHOD
/begin COMPU_METHOD FORMULA_0230 "FORMULA_0230" TAB_VERB "%5.0" "-" COMPU_TAB_REF FORMULA_0230_VTAB /end COMPU_METHOD
/begin COMPU_METHOD FORMULA_0231 "FORMULA_0231" RAT_FUNC "%8.3" "°KW/Segm" COEFFS 0 10.0 0.0 0 0.0 1.0 /end COMPU_METHOD
/begin COMPU_METHOD FORMULA_0232 "FORMULA_0232" TAB_VERB "%5.0" "-" COMPU_TAB_REF FORMULA_0232_VTAB /end COMPU_METHOD
/begin COMPU_METHOD FORMULA_0233 "FORMULA_0233" TAB_VERB "%5.0" "-" COMPU_TAB_REF FORMULA_0233_VTAB /end COMPU_METHOD
/begin COMPU_METHOD FORMULA_0234 "FORMULA_0234" TAB_VERB "%5.0" "-" COMPU_TAB_REF FORMULA_0234_VTAB /end COMPU_METHOD
/begin COMPU_METHOD FORMULA_0235 "FORMULA_0235" TAB_VERB "%5.0" "-" COMPU_TAB_REF FORMULA_0235_VTAB /end COMPU_METHOD
/begin COMPU_METHOD FORMULA_0236 "FORMULA_0236" TAB_VERB "%5.0" "-" COMPU_TAB_REF FORMULA_0236_VTAB /end COMPU_METHOD
/begin COMPU_METHOD FORMULA_0237 "FORMULA_0237" TAB_VERB "%5.0" "-" COMPU_TAB_REF FORMULA_0237_VTAB /end COMPU_METHOD
/begin COMPU_METHOD FORMULA_0238 "FORMULA_0238" TAB_VERB "%5.0" "-" COMPU_TAB_REF FORMULA_0238_VTAB /end COMPU_METHOD
/begin COMPU_METHOD FORMULA_0239 "FORMULA_0239" TAB_VERB "%5.0" "-" COMPU_TAB_REF FORMULA_0239_VTAB /end COMPU_METHOD
/begin COMPU_METHOD FORMULA_0240 "FORMULA_0240" TAB_VERB "%5.0" "-" COMPU_TAB_REF FORMULA_0240_VTAB /end COMPU_METHOD
/begin COMPU_METHOD FORMULA_0241 "FORMULA_0241" TAB_VERB "%5.0" "-" COMPU_TAB_REF FORMULA_0241_VTAB /end COMPU_METHOD
/begin COMPU_METHOD FORMULA_0242 "FORMULA_0242" TAB_VERB "%5.0" "-" COMPU_TAB_REF FORMULA_0242_VTAB /end COMPU_METHOD
/begin COMPU_METHOD FORMULA_0243 "FORMULA_0243" TAB_VERB "%3.0" "-" COMPU_TAB_REF FORMULA_0243_VTAB /end COMPU_METHOD
/begin COMPU_METHOD FORMULA_0244 "FORMULA_0244" TAB_VERB "%5.2" "-" COMPU_TAB_REF FORMULA_0244_VTAB /end COMPU_METHOD
/begin COMPU_METHOD FORMULA_0245 "FORMULA_0245" TAB_VERB "%5.2" "-" COMPU_TAB_REF FORMULA_0245_VTAB /end COMPU_METHOD
/begin COMPU_METHOD FORMULA_0246 "FORMULA_0246" TAB_VERB "%5.2" "-" COMPU_TAB_REF FORMULA_0246_VTAB /end COMPU_METHOD
/begin COMPU_METHOD FORMULA_0247 "FORMULA_0247" RAT_FUNC "%7.2" "V" COEFFS 0 9830.4 0.0 0 0.0 1.0 /end COMPU_METHOD
/begin COMPU_METHOD FORMULA_0248 "FORMULA_0248" TAB_VERB "%5.2" "-" COMPU_TAB_REF FORMULA_0248_VTAB /end COMPU_METHOD
/begin COMPU_METHOD FORMULA_0249 "FORMULA_0249" TAB_VERB "%3.0" "-" COMPU_TAB_REF FORMULA_0249_VTAB /end COMPU_METHOD
/begin COMPU_METHOD FORMULA_0250 "FORMULA_0250" RAT_FUNC "%8.3" "V" COEFFS 0 204.8 0.0 0 0.0 1.0 /end COMPU_METHOD
/begin COMPU_METHOD FORMULA_0251 "FORMULA_0251" RAT_FUNC "%8.3" "V" COEFFS 0 409.6 0.0 0 0.0 1.0 /end COMPU_METHOD
/begin COMPU_METHOD FORMULA_0252 "FORMULA_0252" TAB_VERB "%3.0" "-" COMPU_TAB_REF FORMULA_0252_VTAB /end COMPU_METHOD
/begin COMPU_METHOD FORMULA_0253 "FORMULA_0253" TAB_VERB "%3.0" "-" COMPU_TAB_REF FORMULA_0253_VTAB /end COMPU_METHOD
/begin COMPU_METHOD FORMULA_0254 "FORMULA_0254" TAB_VERB "%5.2" "-" COMPU_TAB_REF FORMULA_0254_VTAB /end COMPU_METHOD
/begin COMPU_METHOD FORMULA_0255 "FORMULA_0255" TAB_VERB "%5.2" "-" COMPU_TAB_REF FORMULA_0255_VTAB /end COMPU_METHOD
/begin COMPU_METHOD FORMULA_0256 "FORMULA_0256" TAB_VERB "%5.2" "-" COMPU_TAB_REF FORMULA_0256_VTAB /end COMPU_METHOD
/begin COMPU_METHOD FORMULA_0257 "FORMULA_0257" TAB_VERB "%5.2" "-" COMPU_TAB_REF FORMULA_0257_VTAB /end COMPU_METHOD
/begin COMPU_METHOD FORMULA_0258 "FORMULA_0258" TAB_VERB "%5.2" "-" COMPU_TAB_REF FORMULA_0258_VTAB /end COMPU_METHOD
/begin COMPU_METHOD FORMULA_0259 "FORMULA_0259" TAB_VERB "%5.2" "-" COMPU_TAB_REF FORMULA_0259_VTAB /end COMPU_METHOD
/begin COMPU_METHOD FORMULA_0260 "FORMULA_0260" RAT_FUNC "%5.0" "%/s" COEFFS 0 5.e-002 0.0 0 0.0 1.0 /end COMPU_METHOD
/begin COMPU_METHOD FORMULA_0261 "FORMULA_0261" RAT_FUNC "%8.3" "V" COEFFS 0 641.469735457881 0.0 0 0.0 1.0 /end COMPU_METHOD
/begin COMPU_METHOD FORMULA_0262 "FORMULA_0262" TAB_VERB "%3.0" "-" COMPU_TAB_REF FORMULA_0262_VTAB /end COMPU_METHOD
/begin COMPU_METHOD FORMULA_0263 "FORMULA_0263" RAT_FUNC "%3.0" ".Prog" COEFFS 0 1 0 0 0 1 /end COMPU_METHOD
/begin COMPU_METHOD FORMULA_0264 "FORMULA_0264" TAB_VERB "%5.2" "-" COMPU_TAB_REF FORMULA_0264_VTAB /end COMPU_METHOD
/begin COMPU_METHOD FORMULA_0265 "FORMULA_0265" TAB_VERB "%5.2" "-" COMPU_TAB_REF FORMULA_0265_VTAB /end COMPU_METHOD
/begin COMPU_METHOD FORMULA_0266 "FORMULA_0266" TAB_VERB "%3.0" "-" COMPU_TAB_REF FORMULA_0266_VTAB /end COMPU_METHOD
/begin COMPU_METHOD FORMULA_0267 "FORMULA_0267" TAB_VERB "%5.2" "-" COMPU_TAB_REF FORMULA_0267_VTAB /end COMPU_METHOD
/begin COMPU_METHOD FORMULA_0268 "FORMULA_0268" TAB_VERB "%5.2" "-" COMPU_TAB_REF FORMULA_0268_VTAB /end COMPU_METHOD
/begin COMPU_METHOD FORMULA_0269 "FORMULA_0269" TAB_VERB "%5.2" "-" COMPU_TAB_REF FORMULA_0269_VTAB /end COMPU_METHOD
/begin COMPU_METHOD FORMULA_0270 "FORMULA_0270" TAB_VERB "%5.2" "-" COMPU_TAB_REF FORMULA_0270_VTAB /end COMPU_METHOD
/begin COMPU_METHOD FORMULA_0271 "FORMULA_0271" TAB_VERB "%3.0" "-" COMPU_TAB_REF FORMULA_0271_VTAB /end COMPU_METHOD
/begin COMPU_METHOD FORMULA_0272 "FORMULA_0272" RAT_FUNC "%8.1" "Nm" COEFFS 0 10.0 0.0 0 0.0 1.0 /end COMPU_METHOD
/begin COMPU_METHOD FORMULA_0273 "FORMULA_0273" TAB_VERB "%3.0" "-" COMPU_TAB_REF FORMULA_0273_VTAB /end COMPU_METHOD
/begin COMPU_METHOD FORMULA_0274 "FORMULA_0274" TAB_VERB "%5.2" "-" COMPU_TAB_REF FORMULA_0274_VTAB /end COMPU_METHOD
/begin COMPU_METHOD FORMULA_0275 "FORMULA_0275" TAB_VERB "%3.0" "-" COMPU_TAB_REF FORMULA_0275_VTAB /end COMPU_METHOD
/begin COMPU_METHOD FORMULA_0276 "FORMULA_0276" RAT_FUNC "%7.2" "Nms2" COEFFS 0 512.0 0.0 0 0.0 1.0 /end COMPU_METHOD
/begin COMPU_METHOD FORMULA_0277 "FORMULA_0277" TAB_VERB "%7.2" "-" COMPU_TAB_REF FORMULA_0277_VTAB /end COMPU_METHOD
/begin COMPU_METHOD FORMULA_0278 "FORMULA_0278" TAB_VERB "%7.2" "-" COMPU_TAB_REF FORMULA_0278_VTAB /end COMPU_METHOD
/begin COMPU_METHOD FORMULA_0279 "FORMULA_0279" TAB_VERB "%7.2" "-" COMPU_TAB_REF FORMULA_0279_VTAB /end COMPU_METHOD
/begin COMPU_METHOD FORMULA_0280 "FORMULA_0280" TAB_VERB "%7.2" "-" COMPU_TAB_REF FORMULA_0280_VTAB /end COMPU_METHOD
/begin COMPU_METHOD FORMULA_0281 "FORMULA_0281" TAB_VERB "%7.2" "-" COMPU_TAB_REF FORMULA_0281_VTAB /end COMPU_METHOD
/begin COMPU_METHOD FORMULA_0282 "FORMULA_0282" TAB_VERB "%7.2" "-" COMPU_TAB_REF FORMULA_0282_VTAB /end COMPU_METHOD
/begin COMPU_METHOD FORMULA_0283 "FORMULA_0283" TAB_VERB "%7.2" "-" COMPU_TAB_REF FORMULA_0283_VTAB /end COMPU_METHOD
/begin COMPU_METHOD FORMULA_0284 "FORMULA_0284" TAB_VERB "%7.2" "-" COMPU_TAB_REF FORMULA_0284_VTAB /end COMPU_METHOD
/begin COMPU_METHOD FORMULA_0285 "FORMULA_0285" TAB_VERB "%7.2" "-" COMPU_TAB_REF FORMULA_0285_VTAB /end COMPU_METHOD
/begin COMPU_METHOD FORMULA_0286 "FORMULA_0286" TAB_VERB "%7.2" "-" COMPU_TAB_REF FORMULA_0286_VTAB /end COMPU_METHOD
/begin COMPU_METHOD FORMULA_0287 "FORMULA_0287" TAB_VERB "%7.2" "-" COMPU_TAB_REF FORMULA_0287_VTAB /end COMPU_METHOD
/begin COMPU_METHOD FORMULA_0288 "FORMULA_0288" TAB_VERB "%7.2" "-" COMPU_TAB_REF FORMULA_0288_VTAB /end COMPU_METHOD
/begin COMPU_METHOD FORMULA_0289 "FORMULA_0289" TAB_VERB "%7.2" "-" COMPU_TAB_REF FORMULA_0289_VTAB /end COMPU_METHOD
/begin COMPU_METHOD FORMULA_0290 "FORMULA_0290" TAB_VERB "%7.2" "-" COMPU_TAB_REF FORMULA_0290_VTAB /end COMPU_METHOD
/begin COMPU_METHOD FORMULA_0291 "FORMULA_0291" TAB_VERB "%7.2" "-" COMPU_TAB_REF FORMULA_0291_VTAB /end COMPU_METHOD
/begin COMPU_METHOD FORMULA_0292 "FORMULA_0292" TAB_VERB "%7.2" "-" COMPU_TAB_REF FORMULA_0292_VTAB /end COMPU_METHOD
/begin COMPU_METHOD FORMULA_0293 "FORMULA_0293" TAB_VERB "%7.2" "-" COMPU_TAB_REF FORMULA_0293_VTAB /end COMPU_METHOD
/begin COMPU_METHOD FORMULA_0294 "FORMULA_0294" TAB_VERB "%7.2" "-" COMPU_TAB_REF FORMULA_0294_VTAB /end COMPU_METHOD
/begin COMPU_METHOD FORMULA_0295 "FORMULA_0295" TAB_VERB "%7.2" "-" COMPU_TAB_REF FORMULA_0295_VTAB /end COMPU_METHOD
/begin COMPU_METHOD FORMULA_0296 "FORMULA_0296" TAB_VERB "%7.2" "-" COMPU_TAB_REF FORMULA_0296_VTAB /end COMPU_METHOD
/begin COMPU_METHOD FORMULA_0297 "FORMULA_0297" TAB_VERB "%7.2" "-" COMPU_TAB_REF FORMULA_0297_VTAB /end COMPU_METHOD
/begin COMPU_METHOD FORMULA_0298 "FORMULA_0298" TAB_VERB "%5.2" "-" COMPU_TAB_REF FORMULA_0298_VTAB /end COMPU_METHOD
/begin COMPU_METHOD FORMULA_0299 "FORMULA_0299" TAB_VERB "%7.2" "-" COMPU_TAB_REF FORMULA_0299_VTAB /end COMPU_METHOD
/begin COMPU_METHOD FORMULA_0300 "FORMULA_0300" TAB_VERB "%7.2" "-" COMPU_TAB_REF FORMULA_0300_VTAB /end COMPU_METHOD
/begin COMPU_METHOD FORMULA_0301 "FORMULA_0301" TAB_VERB "%7.2" "-" COMPU_TAB_REF FORMULA_0301_VTAB /end COMPU_METHOD
/begin COMPU_METHOD FORMULA_0302 "FORMULA_0302" TAB_VERB "%7.2" "-" COMPU_TAB_REF FORMULA_0302_VTAB /end COMPU_METHOD
/begin COMPU_METHOD FORMULA_0303 "FORMULA_0303" TAB_VERB "%7.2" "-" COMPU_TAB_REF FORMULA_0303_VTAB /end COMPU_METHOD
/begin COMPU_METHOD FORMULA_0304 "FORMULA_0304" TAB_VERB "%7.2" "-" COMPU_TAB_REF FORMULA_0304_VTAB /end COMPU_METHOD
/begin COMPU_METHOD FORMULA_0305 "FORMULA_0305" TAB_VERB "%7.2" "-" COMPU_TAB_REF FORMULA_0305_VTAB /end COMPU_METHOD
/begin COMPU_METHOD FORMULA_0306 "FORMULA_0306" RAT_FUNC "%5.2" "s" COEFFS 0 100.0 0.0 0 0.0 1.0 /end COMPU_METHOD
/begin COMPU_METHOD FORMULA_0307 "FORMULA_0307" TAB_VERB "%7.2" "-" COMPU_TAB_REF FORMULA_0307_VTAB /end COMPU_METHOD
/begin COMPU_METHOD FORMULA_0308 "FORMULA_0308" TAB_VERB "%7.2" "-" COMPU_TAB_REF FORMULA_0308_VTAB /end COMPU_METHOD
/begin COMPU_METHOD FORMULA_0309 "FORMULA_0309" TAB_VERB "%7.2" "-" COMPU_TAB_REF FORMULA_0309_VTAB /end COMPU_METHOD
/begin COMPU_METHOD FORMULA_0310 "FORMULA_0310" TAB_VERB "%7.2" "-" COMPU_TAB_REF FORMULA_0310_VTAB /end COMPU_METHOD
/begin COMPU_METHOD FORMULA_0311 "FORMULA_0311" TAB_VERB "%7.2" "-" COMPU_TAB_REF FORMULA_0311_VTAB /end COMPU_METHOD
/begin COMPU_METHOD FORMULA_0312 "FORMULA_0312" TAB_VERB "%7.2" "-" COMPU_TAB_REF FORMULA_0312_VTAB /end COMPU_METHOD
/begin COMPU_METHOD FORMULA_0313 "FORMULA_0313" TAB_VERB "%7.2" "-" COMPU_TAB_REF FORMULA_0313_VTAB /end COMPU_METHOD
/begin COMPU_METHOD FORMULA_0314 "FORMULA_0314" TAB_VERB "%3.0" "-" COMPU_TAB_REF FORMULA_0314_VTAB /end COMPU_METHOD
/begin COMPU_METHOD FORMULA_0315 "FORMULA_0315" TAB_VERB "%3.0" "-" COMPU_TAB_REF FORMULA_0315_VTAB /end COMPU_METHOD
/begin COMPU_METHOD FORMULA_0316 "FORMULA_0316" TAB_VERB "%3.0" "-" COMPU_TAB_REF FORMULA_0316_VTAB /end COMPU_METHOD
/begin COMPU_METHOD FORMULA_0317 "FORMULA_0317" RAT_FUNC "%6.1" "km/h" COEFFS 0 10.0 0.0 0 0.0 1.0 /end COMPU_METHOD
/begin COMPU_METHOD FORMULA_0318 "FORMULA_0318" TAB_VERB "%3.0" "-" COMPU_TAB_REF FORMULA_0318_VTAB /end COMPU_METHOD
/begin COMPU_METHOD FORMULA_0319 "FORMULA_0319" TAB_VERB "%4.1" "-" COMPU_TAB_REF FORMULA_0319_VTAB /end COMPU_METHOD
/begin COMPU_METHOD FORMULA_0320 "FORMULA_0320" TAB_VERB "%3.0" "-" COMPU_TAB_REF FORMULA_0320_VTAB /end COMPU_METHOD
/begin COMPU_METHOD FORMULA_0321 "FORMULA_0321" TAB_VERB "%3.0" "-" COMPU_TAB_REF FORMULA_0321_VTAB /end COMPU_METHOD
/begin COMPU_METHOD FORMULA_0322 "FORMULA_0322" TAB_VERB "%9.2" "-" COMPU_TAB_REF FORMULA_0322_VTAB /end COMPU_METHOD
/begin COMPU_METHOD FORMULA_0323 "FORMULA_0323" TAB_VERB "%9.2" "-" COMPU_TAB_REF FORMULA_0323_VTAB /end COMPU_METHOD
/begin COMPU_METHOD FORMULA_0324 "FORMULA_0324" TAB_VERB "%9.2" "-" COMPU_TAB_REF FORMULA_0324_VTAB /end COMPU_METHOD
/begin COMPU_METHOD FORMULA_0325 "FORMULA_0325" TAB_VERB "%9.2" "-" COMPU_TAB_REF FORMULA_0325_VTAB /end COMPU_METHOD
/begin COMPU_METHOD FORMULA_0326 "FORMULA_0326" TAB_VERB "%9.2" "-" COMPU_TAB_REF FORMULA_0326_VTAB /end COMPU_METHOD
/begin COMPU_METHOD FORMULA_0327 "FORMULA_0327" TAB_VERB "%9.2" "-" COMPU_TAB_REF FORMULA_0327_VTAB /end COMPU_METHOD
/begin COMPU_METHOD FORMULA_0328 "FORMULA_0328" TAB_VERB "%9.2" "-" COMPU_TAB_REF FORMULA_0328_VTAB /end COMPU_METHOD
/begin COMPU_METHOD FORMULA_0329 "FORMULA_0329" TAB_VERB "%9.2" "-" COMPU_TAB_REF FORMULA_0329_VTAB /end COMPU_METHOD
/begin COMPU_METHOD FORMULA_0330 "FORMULA_0330" TAB_VERB "%9.2" "-" COMPU_TAB_REF FORMULA_0330_VTAB /end COMPU_METHOD
/begin COMPU_METHOD FORMULA_0331 "FORMULA_0331" TAB_VERB "%9.2" "-" COMPU_TAB_REF FORMULA_0331_VTAB /end COMPU_METHOD
/begin COMPU_METHOD FORMULA_0332 "FORMULA_0332" TAB_VERB "%9.2" "-" COMPU_TAB_REF FORMULA_0332_VTAB /end COMPU_METHOD
/begin COMPU_METHOD FORMULA_0333 "FORMULA_0333" TAB_VERB "%9.2" "-" COMPU_TAB_REF FORMULA_0333_VTAB /end COMPU_METHOD
/begin COMPU_METHOD FORMULA_0334 "FORMULA_0334" TAB_VERB "%9.2" "-" COMPU_TAB_REF FORMULA_0334_VTAB /end COMPU_METHOD
/begin COMPU_METHOD FORMULA_0335 "FORMULA_0335" TAB_VERB "%9.2" "-" COMPU_TAB_REF FORMULA_0335_VTAB /end COMPU_METHOD
/begin COMPU_METHOD FORMULA_0336 "FORMULA_0336" TAB_VERB "%9.2" "-" COMPU_TAB_REF FORMULA_0336_VTAB /end COMPU_METHOD
/begin COMPU_METHOD FORMULA_0337 "FORMULA_0337" TAB_VERB "%9.2" "-" COMPU_TAB_REF FORMULA_0337_VTAB /end COMPU_METHOD
/begin COMPU_METHOD FORMULA_0338 "FORMULA_0338" TAB_VERB "%9.2" "-" COMPU_TAB_REF FORMULA_0338_VTAB /end COMPU_METHOD
/begin COMPU_METHOD FORMULA_0339 "FORMULA_0339" TAB_VERB "%9.2" "-" COMPU_TAB_REF FORMULA_0339_VTAB /end COMPU_METHOD
/begin COMPU_METHOD FORMULA_0340 "FORMULA_0340" TAB_VERB "%9.2" "-" COMPU_TAB_REF FORMULA_0340_VTAB /end COMPU_METHOD
/begin COMPU_METHOD FORMULA_0341 "FORMULA_0341" TAB_VERB "%9.2" "-" COMPU_TAB_REF FORMULA_0341_VTAB /end COMPU_METHOD
/begin COMPU_METHOD FORMULA_0342 "FORMULA_0342" RAT_FUNC "%7.2" "°C" COEFFS 0 20.0 5463.0 0 0.0 1.0 /end COMPU_METHOD
/begin COMPU_METHOD FORMULA_0343 "FORMULA_0343" RAT_FUNC "%11.4" "°C" COEFFS 0 10240.0 2797056.0 0 0.0 1.0 /end COMPU_METHOD
/begin COMPU_METHOD FORMULA_0344 "FORMULA_0344" TAB_VERB "%3.0" "-" COMPU_TAB_REF FORMULA_0344_VTAB /end COMPU_METHOD
/begin COMPU_METHOD FORMULA_0345 "FORMULA_0345" TAB_VERB "%3.0" "-" COMPU_TAB_REF FORMULA_0345_VTAB /end COMPU_METHOD
/begin COMPU_METHOD FORMULA_0346 "FORMULA_0346" TAB_VERB "%4.1" "-" COMPU_TAB_REF FORMULA_0346_VTAB /end COMPU_METHOD
/begin COMPU_METHOD FORMULA_0347 "FORMULA_0347" TAB_VERB "%5.0" "-" COMPU_TAB_REF FORMULA_0347_VTAB /end COMPU_METHOD
/begin COMPU_METHOD FORMULA_0348 "FORMULA_0348" RAT_FUNC "%4.1" "V" COEFFS 0 10.0 0.0 0 0.0 1.0 /end COMPU_METHOD
/begin COMPU_METHOD FORMULA_0349 "FORMULA_0349" RAT_FUNC "%4.1" "A" COEFFS 0 10.0 0.0 0 0.0 1.0 /end COMPU_METHOD
/begin COMPU_METHOD FORMULA_0350 "FORMULA_0350" TAB_VERB "%3.0" "-" COMPU_TAB_REF FORMULA_0350_VTAB /end COMPU_METHOD
/begin COMPU_METHOD FORMULA_0357 "FORMULA_0357" RAT_FUNC "%5.2" "s" COEFFS 0 200.0 0.0 0 0.0 1.0 /end COMPU_METHOD
/begin COMPU_METHOD FORMULA_0716 "FORMULA_0716" RAT_FUNC "%11.4" "-" COEFFS 0 1 0 0 0 1 /end COMPU_METHOD
/begin COMPU_METHOD FORMULA_0717 "FORMULA_0717" TAB_VERB "%5.2" "-" COMPU_TAB_REF FORMULA_0717_VTAB /end COMPU_METHOD
/begin COMPU_METHOD FORMULA_0718 "FORMULA_0718" TAB_VERB "%5.2" "-" COMPU_TAB_REF FORMULA_0718_VTAB /end COMPU_METHOD
/begin COMPU_METHOD FORMULA_0719 "FORMULA_0719" TAB_VERB "%5.2" "-" COMPU_TAB_REF FORMULA_0719_VTAB /end COMPU_METHOD
/begin COMPU_METHOD FORMULA_0720 "FORMULA_0720" TAB_VERB "%5.2" "-" COMPU_TAB_REF FORMULA_0720_VTAB /end COMPU_METHOD
/begin COMPU_METHOD FORMULA_0721 "FORMULA_0721" RAT_FUNC "%6.1" "(kg/h)/seg" COEFFS 0 10.0 0.0 0 0.0 1.0 /end COMPU_METHOD
/begin COMPU_METHOD FORMULA_0722 "FORMULA_0722" TAB_VERB "%3.0" "-" COMPU_TAB_REF FORMULA_0722_VTAB /end COMPU_METHOD
/begin COMPU_METHOD FORMULA_0723 "FORMULA_0723" RAT_FUNC "%5.0" "us" COEFFS 0 0.1 0.0 0 0.0 1.0 /end COMPU_METHOD
/begin COMPU_METHOD FORMULA_0724 "FORMULA_0724" RAT_FUNC "%5.0" "Hz" COEFFS 0 1 0 0 0 1 /end COMPU_METHOD
/begin COMPU_METHOD FORMULA_0725 "FORMULA_0725" TAB_VERB "%5.2" "-" COMPU_TAB_REF FORMULA_0725_VTAB /end COMPU_METHOD
/begin COMPU_VTAB FORMULA_0012_VTAB "FORMULA_0012_VTAB" TAB_VERB 1 0 "iO" DEFAULT_VALUE "Fehler" /end COMPU_VTAB
/begin COMPU_VTAB FORMULA_0019_VTAB "FORMULA_0019_VTAB" TAB_VERB 13 1 "Motor steht" 2 "Motor presync" 4 "Start" 8 "LLOKS" 16 "LLMKS" 32 "TL" 64 "VL" 128 "SA" 256 "NL" 512 "Abgew." 1024 "Kl15 aus" 2048 "Wakeup" 4096 "Schub" DEFAULT_VALUE "undefiniert" /end COMPU_VTAB
/begin COMPU_VTAB FORMULA_0081_VTAB "FORMULA_0081_VTAB" TAB_VERB 3 1 "Regler-RESET" 2 "Regler aktiv" 4 "Regler inaktiv" /end COMPU_VTAB
/begin COMPU_VTAB FORMULA_0082_VTAB "FORMULA_0082_VTAB" TAB_VERB 2 0 "nicht einger." 1 "einger." /end COMPU_VTAB
/begin COMPU_VTAB FORMULA_0083_VTAB "FORMULA_0083_VTAB" TAB_VERB 2 0 "inaktiv" 1 "aktiv" /end COMPU_VTAB
/begin COMPU_VTAB FORMULA_0084_VTAB "FORMULA_0084_VTAB" TAB_VERB 2 0 "i.O." 1 "ti_min" /end COMPU_VTAB
/begin COMPU_VTAB FORMULA_0085_VTAB "FORMULA_0085_VTAB" TAB_VERB 2 0 "i.O." 1 "MIN" /end COMPU_VTAB
/begin COMPU_VTAB FORMULA_0086_VTAB "FORMULA_0086_VTAB" TAB_VERB 2 0 "i.O." 1 "MAX" /end COMPU_VTAB
/begin COMPU_VTAB FORMULA_0087_VTAB "FORMULA_0087_VTAB" TAB_VERB 2 0 "-" 1 "SA-Verz." /end COMPU_VTAB
/begin COMPU_VTAB FORMULA_0088_VTAB "FORMULA_0088_VTAB" TAB_VERB 2 0 "-" 1 "SLP-Verz." /end COMPU_VTAB
/begin COMPU_VTAB FORMULA_0089_VTAB "FORMULA_0089_VTAB" TAB_VERB 2 0 "nicht einger." 1 "einger." /end COMPU_VTAB
/begin COMPU_VTAB FORMULA_0091_VTAB "FORMULA_0091_VTAB" TAB_VERB 2 0 "inaktiv" 1 "aktiv" /end COMPU_VTAB
/begin COMPU_VTAB FORMULA_0092_VTAB "FORMULA_0092_VTAB" TAB_VERB 2 0 "inaktiv" 1 "aktiv" /end COMPU_VTAB
/begin COMPU_VTAB FORMULA_0093_VTAB "FORMULA_0093_VTAB" TAB_VERB 2 0 "inaktiv" 1 "aktiv" /end COMPU_VTAB
/begin COMPU_VTAB FORMULA_0094_VTAB "FORMULA_0094_VTAB" TAB_VERB 2 0 "inaktiv" 1 "aktiv" /end COMPU_VTAB
/begin COMPU_VTAB FORMULA_0095_VTAB "FORMULA_0095_VTAB" TAB_VERB 2 0 "nein" 1 "ja" /end COMPU_VTAB
/begin COMPU_VTAB FORMULA_0096_VTAB "FORMULA_0096_VTAB" TAB_VERB 2 0 "inaktiv" 1 "aktiv" /end COMPU_VTAB
/begin COMPU_VTAB FORMULA_0097_VTAB "FORMULA_0097_VTAB" TAB_VERB 2 0 "inaktiv" 1 "aktiv" /end COMPU_VTAB
/begin COMPU_VTAB FORMULA_0098_VTAB "FORMULA_0098_VTAB" TAB_VERB 2 0 "inaktiv" 1 "aktiv" /end COMPU_VTAB
/begin COMPU_VTAB FORMULA_0099_VTAB "FORMULA_0099_VTAB" TAB_VERB 2 0 "no" 1 "yes" /end COMPU_VTAB
/begin COMPU_VTAB FORMULA_0101_VTAB "FORMULA_0101_VTAB" TAB_VERB 5 1 "warte Sync." 2 "Sync. laeuft" 4 "synchronisiert" 8 "nicht sync." 20 "Sync. vio Ionenstrom" DEFAULT_VALUE "gibts nicht" /end COMPU_VTAB
/begin COMPU_VTAB FORMULA_0108_VTAB "FORMULA_0108_VTAB" TAB_VERB 7 0 "Inaktiv" 1 "Trigger" 2 "Bereit" 3 "Tr+Be" 4 "Aktiv" 7 "Tr+Be+Aktiv" 8 "WE" DEFAULT_VALUE "undef" /end COMPU_VTAB
/begin COMPU_VTAB FORMULA_0112_VTAB "FORMULA_0112_VTAB" TAB_VERB 2 0 "QLT-Temp.fehler" 1 "QLT-Temp.OK" DEFAULT_VALUE "undef." /end COMPU_VTAB
/begin COMPU_VTAB FORMULA_0115_VTAB "FORMULA_0115_VTAB" TAB_VERB 2 0 "CBS-RESET nicht ausgef." 1 "CBS-RESET ausgefuehrt" /end COMPU_VTAB
/begin COMPU_VTAB FORMULA_0116_VTAB "FORMULA_0116_VTAB" TAB_VERB 8 0 "O.K." 1 "BusOff" 2 "DPR" 4 "Timeout" 5 "BusOff+Timeout" 8 "Overflow" 16 "Chksum" 32 "Alive" DEFAULT_VALUE "Mehrfachfehler" /end COMPU_VTAB
/begin COMPU_VTAB FORMULA_0117_VTAB "FORMULA_0117_VTAB" TAB_VERB 8 0 "O.K." 1 "BusOff" 2 "DPR" 4 "Timeout" 5 "BusOff+Timeout" 8 "Overflow" 16 "Chksum" 32 "Alive" DEFAULT_VALUE "Mehrfachfehler" /end COMPU_VTAB
/begin COMPU_VTAB FORMULA_0118_VTAB "FORMULA_0118_VTAB" TAB_VERB 4 0 "aus" 1 "ein" 2 "Stufe 1" 4 "Stufe 2" DEFAULT_VALUE "ungueltig" /end COMPU_VTAB
/begin COMPU_VTAB FORMULA_0119_VTAB "FORMULA_0119_VTAB" TAB_VERB 3 0 "aus" 1 "ZH" 2 "NTKW" DEFAULT_VALUE "ungueltig" /end COMPU_VTAB
/begin COMPU_VTAB FORMULA_0121_VTAB "FORMULA_0121_VTAB" TAB_VERB 7 0 "iO" 1 "VL defekt" 2 "VR defekt" 4 "HL defekt" 8 "HR defekt" 16 "vVorne" 20 "vTacho" DEFAULT_VALUE "Mehrfach" /end COMPU_VTAB
/begin COMPU_VTAB FORMULA_0122_VTAB "FORMULA_0122_VTAB" TAB_VERB 4 0 "steht" 1 "vorwaerts" 2 "rueckwaerts" 3 "faehrt" DEFAULT_VALUE "ungueltig" /end COMPU_VTAB
/begin COMPU_VTAB FORMULA_0124_VTAB "FORMULA_0124_VTAB" TAB_VERB 5 0 "iO" 1 "ax" 2 "ay" 4 "ax-Mess" 8 "ax-Offs" DEFAULT_VALUE "Mehrfach" /end COMPU_VTAB
/begin COMPU_VTAB FORMULA_0125_VTAB "FORMULA_0125_VTAB" TAB_VERB 3 0 "Inaktiv" 1 "MSR" 2 "ASC" DEFAULT_VALUE "ungueltig" /end COMPU_VTAB
/begin COMPU_VTAB FORMULA_0126_VTAB "FORMULA_0126_VTAB" TAB_VERB 8 0 "iO" 1 "passiv" 2 "defekt" 3 "reserviert" 4 "MDM" 5 "reserviert" 6 "Unterspannung" 7 "ungueltig" /end COMPU_VTAB
/begin COMPU_VTAB FORMULA_0127_VTAB "FORMULA_0127_VTAB" TAB_VERB 11 0 "keine" 1 "ABS" 2 "ASC" 3 "ABS/ASC" 4 "DSC" 5 "ABS/DSC" 8 "HBA" 16 "MSR" 17 "ABS/MSR" 32 "EBV" 255 "ungueltig" DEFAULT_VALUE "selbstrechnen" /end COMPU_VTAB
/begin COMPU_VTAB FORMULA_0128_VTAB "FORMULA_0128_VTAB" TAB_VERB 4 0 "keiner" 1 "vorhanden" 2 "???" 3 "ungueltig" /end COMPU_VTAB
/begin COMPU_VTAB FORMULA_0130_VTAB "FORMULA_0130_VTAB" TAB_VERB 4 0 "iO" 1 "Verifikation" 2 "Fehler" 3 "ungueltig" /end COMPU_VTAB
/begin COMPU_VTAB FORMULA_0134_VTAB "FORMULA_0134_VTAB" TAB_VERB 8 0 "alle aus" 1 "Kl R" 2 "Kl 15" 3 "Kl R+15" 4 "Kl 50" 5 "Kl R+50" 6 "Kl 15+50" 7 "Kl R+15+50" /end COMPU_VTAB
/begin COMPU_VTAB FORMULA_0136_VTAB "FORMULA_0136_VTAB" TAB_VERB 8 0 "Inaktiv" 2 "Kriechen" 3 "Md-Red" 4 "Md-Erh" 6 "nReg" 12 "MdBegr" 13 "Stop" 15 "ungueltig" /end COMPU_VTAB
/begin COMPU_VTAB FORMULA_0139_VTAB "FORMULA_0139_VTAB" TAB_VERB 6 0 "Offen" 1 "Kriechen" 2 "Anfahren" 3 "Geschlossen" 4 "Dauerschlupf" 5 "Dynamik" DEFAULT_VALUE "undef" /end COMPU_VTAB
/begin COMPU_VTAB FORMULA_0140_VTAB "FORMULA_0140_VTAB" TAB_VERB 8 0 "keine" 1 "T vo" 2 "UeT vo" 4 "T hi" 8 "UeT hi" 16 "T ob/un" 64 "T ax" 255 "ungueltig" /end COMPU_VTAB
/begin COMPU_VTAB FORMULA_0141_VTAB "FORMULA_0141_VTAB" TAB_VERB 4 0 "aus" 1 "an" 2 "Anf aus" 4 "Anf aus rec" DEFAULT_VALUE "ungueltig" /end COMPU_VTAB
/begin COMPU_VTAB FORMULA_0146_VTAB "FORMULA_0146_VTAB" TAB_VERB 2 0 "Ok" 1 "Fehler" /end COMPU_VTAB
/begin COMPU_VTAB FORMULA_0148_VTAB "FORMULA_0148_VTAB" TAB_VERB 4 0 "inaktiv" 1 "Momenteneingriff" 2 "Einspritzausblendung" 3 "Md + TT-Eingriff" /end COMPU_VTAB
/begin COMPU_VTAB FORMULA_0149_VTAB "FORMULA_0149_VTAB" TAB_VERB 2 0 "inaktiv" 1 "N-Dynamik aktiv" /end COMPU_VTAB
/begin COMPU_VTAB FORMULA_0150_VTAB "FORMULA_0150_VTAB" TAB_VERB 2 0 "BLS aus" 1 "BLS ein" /end COMPU_VTAB
/begin COMPU_VTAB FORMULA_0151_VTAB "FORMULA_0151_VTAB" TAB_VERB 2 0 "offen" 1 "geschlossen" /end COMPU_VTAB
/begin COMPU_VTAB FORMULA_0152_VTAB "FORMULA_0152_VTAB" TAB_VERB 4 0 "Leergasse" 1 "Gerader Gang" 8 "Leergasse" 9 "Ungerader Gang" /end COMPU_VTAB
/begin COMPU_VTAB FORMULA_0153_VTAB "FORMULA_0153_VTAB" TAB_VERB 2 0 "Sleep" 1 "Wakeup" /end COMPU_VTAB
/begin COMPU_VTAB FORMULA_0154_VTAB "FORMULA_0154_VTAB" TAB_VERB 2 0 "aus" 1 "ein" /end COMPU_VTAB
/begin COMPU_VTAB FORMULA_0155_VTAB "FORMULA_0155_VTAB" TAB_VERB 2 0 "keine Schaltung" 1 "Schaltung" /end COMPU_VTAB
/begin COMPU_VTAB FORMULA_0156_VTAB "FORMULA_0156_VTAB" TAB_VERB 2 0 "kein Druck" 1 "Oeldruck" /end COMPU_VTAB
/begin COMPU_VTAB FORMULA_0157_VTAB "FORMULA_0157_VTAB" TAB_VERB 2 0 "Motor abstellen" 1 "O.K." /end COMPU_VTAB
/begin COMPU_VTAB FORMULA_0158_VTAB "FORMULA_0158_VTAB" TAB_VERB 2 0 "offen" 1 "Kraftschluss" /end COMPU_VTAB
/begin COMPU_VTAB FORMULA_0159_VTAB "FORMULA_0159_VTAB" TAB_VERB 2 0 "AUS" 1 "EIN" DEFAULT_VALUE "ungueltig" /end COMPU_VTAB
/begin COMPU_VTAB FORMULA_0160_VTAB "FORMULA_0160_VTAB" TAB_VERB 2 1 "CAN" 2 "PWM" /end COMPU_VTAB
/begin COMPU_VTAB FORMULA_0162_VTAB "FORMULA_0162_VTAB" TAB_VERB 5 1 "Init" 2 "Awake" 3 "Ring" 4 "GoSleep" 5 "BusSleep" /end COMPU_VTAB
/begin COMPU_VTAB FORMULA_0163_VTAB "FORMULA_0163_VTAB" TAB_VERB 3 0 "Konfigmodus" 1 "Aus" 2 "Ein" DEFAULT_VALUE "undef" /end COMPU_VTAB
/begin COMPU_VTAB FORMULA_0164_VTAB "FORMULA_0164_VTAB" TAB_VERB 3 0 "Komfort" 1 "Normal" 2 "Sport" DEFAULT_VALUE "undef" /end COMPU_VTAB
/begin COMPU_VTAB FORMULA_0167_VTAB "FORMULA_0167_VTAB" TAB_VERB 1 0 "kein Fehler" /end COMPU_VTAB
/begin COMPU_VTAB FORMULA_0168_VTAB "FORMULA_0168_VTAB" TAB_VERB 2 0 "inaktiv" 1 "aktiv" /end COMPU_VTAB
/begin COMPU_VTAB FORMULA_0169_VTAB "FORMULA_0169_VTAB" TAB_VERB 2 0 "inaktiv" 1 "aktiv" /end COMPU_VTAB
/begin COMPU_VTAB FORMULA_0170_VTAB "FORMULA_0170_VTAB" TAB_VERB 8 0 "iO" 1 "LA" 4 "LAA" 5 "LA+LAA" 16 "Mager" 17 "LA+Mager" 20 "LAA+Mager" 21 "LA+LAA+Mager" /end COMPU_VTAB
/begin COMPU_VTAB FORMULA_0171_VTAB "FORMULA_0171_VTAB" TAB_VERB 8 0 "iO" 2 "LA" 8 "LAA" 10 "LA+LAA" 32 "Mager" 34 "LA+Mager" 40 "LAA+Mager" 42 "LA+LAA+Mager" /end COMPU_VTAB
/begin COMPU_VTAB FORMULA_0172_VTAB "FORMULA_0172_VTAB" TAB_VERB 4 0 "iO" 1 "B1-Notl" 2 "B2-Notl" 3 "B1+B2-Notl" /end COMPU_VTAB
/begin COMPU_VTAB FORMULA_0173_VTAB "FORMULA_0173_VTAB" TAB_VERB 2 0 "iO" 1 "PKS-Notlauf" /end COMPU_VTAB
/begin COMPU_VTAB FORMULA_0174_VTAB "FORMULA_0174_VTAB" TAB_VERB 2 0 "iO" 1 "LLRA-Sperre" /end COMPU_VTAB
/begin COMPU_VTAB FORMULA_0175_VTAB "FORMULA_0175_VTAB" TAB_VERB 2 0 "iO" 1 "FRA-Sperre" /end COMPU_VTAB
/begin COMPU_VTAB FORMULA_0176_VTAB "FORMULA_0176_VTAB" TAB_VERB 2 0 "iO" 1 "KH-Sperre" /end COMPU_VTAB
/begin COMPU_VTAB FORMULA_0177_VTAB "FORMULA_0177_VTAB" TAB_VERB 3 0 "iO" 1 "HFM" 2 "AQ" /end COMPU_VTAB
/begin COMPU_VTAB FORMULA_0178_VTAB "FORMULA_0178_VTAB" TAB_VERB 2 0 "iO" 1 "FR-Sperre" /end COMPU_VTAB
/begin COMPU_VTAB FORMULA_0179_VTAB "FORMULA_0179_VTAB" TAB_VERB 1 0 "alle ein" /end COMPU_VTAB
/begin COMPU_VTAB FORMULA_0180_VTAB "FORMULA_0180_VTAB" TAB_VERB 7 0 "RESET" 1 "SPUELEN_INI" 2 "LAA_INI" 4 "SPUELEN_KURZ" 8 "SPUELEN_LANG" 16 "SPUELEN_WARTE_LAA" 32 "LAA" DEFAULT_VALUE "undef" /end COMPU_VTAB
/begin COMPU_VTAB FORMULA_0181_VTAB "FORMULA_0181_VTAB" TAB_VERB 14 0 "AUS" 1 "WAIT" 2 "HFM-DIAG" 4 "ML-PLAUS" 8 "MDF-WAIT" 16 "MDF-DIAG" 32 "ZWD-100" 64 "ZWD-0" 128 "ZWD-OFF" 256 "SLV-DIAG" 512 "Abgas Lambda" 8192 "DIAG Ende Abbruch" 16384 "DIAG Ende IO" 32768 "DIAG Ende NIO" DEFAULT_VALUE "Ende mit Fehler" /end COMPU_VTAB
/begin COMPU_VTAB FORMULA_0182_VTAB "FORMULA_0182_VTAB" TAB_VERB 13 0 "Motor steht" 1 "Normalbetrieb" 2 "Notlauf" 5 "Normal/Warmlauf" 8 "nBegr" 12 "nBegr/Warmlauf" 16 "vBegr" 20 "vBegr/Warmlauf" 32 "DSC" 36 "DSC/Warmlauf" 64 "SMG" 68 "SMG/Warmlauf" 128 "Rollenbetrieb" DEFAULT_VALUE "undef" /end COMPU_VTAB
/begin COMPU_VTAB FORMULA_0183_VTAB "FORMULA_0183_VTAB" TAB_VERB 1 1 "time_ms Ok" DEFAULT_VALUE "aus" /end COMPU_VTAB
/begin COMPU_VTAB FORMULA_0184_VTAB "FORMULA_0184_VTAB" TAB_VERB 3 0 "ATIC39-Treiber aus [ELUP aus]" 1 "ATIC39-Treiber an [ELUP an]" 2 "wg. SHT_TO_UB ATIC39-Treiber+ELUP aus" DEFAULT_VALUE "undef" /end COMPU_VTAB
/begin COMPU_VTAB FORMULA_0185_VTAB "FORMULA_0185_VTAB" TAB_VERB 10 0 "AUS" 1 "Ger 2.5" 2 "Ger 5.5" 4 "Ger" 8 "Rampe" 16 "TV 100%" 32 "TV 65%" 64 "TV 65% FW 100%" 16384 "Abbruch" 32768 "Ende" /end COMPU_VTAB
/begin COMPU_VTAB FORMULA_0188_VTAB "FORMULA_0188_VTAB" TAB_VERB 4 0 "in Ordnung" 1 "kein Wert empf." 128 "Err/TUMG" 129 "Fehler/TAN" /end COMPU_VTAB
/begin COMPU_VTAB FORMULA_0189_VTAB "FORMULA_0189_VTAB" TAB_VERB 4 0 "in Ordnung" 1 "Abs-Err" 2 "Rel-Err" 3 "Abs-Rel-Err" /end COMPU_VTAB
/begin COMPU_VTAB FORMULA_0191_VTAB "FORMULA_0191_VTAB" TAB_VERB 7 0 "in Ordnung" 1 "Range" 2 "Reserve" 4 "Fst links" 8 "Fst rechts" 16 "Fst Summe" 32 "km-Stand" DEFAULT_VALUE "selbstrechnen" /end COMPU_VTAB
/begin COMPU_VTAB FORMULA_0193_VTAB "FORMULA_0193_VTAB" TAB_VERB 10 0 "init" 1 "an" 2 "Bauteilschutz" 4 "an OBD" 8 "aus ED" 16 "Abbruch" 32 "aus" 64 "aus Restlaufzeit" 128 "an Restlaufzeit" 256 "an Prueflauf" DEFAULT_VALUE "undef" /end COMPU_VTAB
/begin COMPU_VTAB FORMULA_0194_VTAB "FORMULA_0194_VTAB" TAB_VERB 4 0 "aus" 1 "an" 2 "an OBD" 4 "aus ED" DEFAULT_VALUE "ungueltig" /end COMPU_VTAB
/begin COMPU_VTAB FORMULA_0195_VTAB "FORMULA_0195_VTAB" TAB_VERB 4 0 "iO" 1 "Kombi-Err" 2 "ACC-Err" 4 "FGR-Err" DEFAULT_VALUE "Mehrfach" /end COMPU_VTAB
/begin COMPU_VTAB FORMULA_0196_VTAB "FORMULA_0196_VTAB" TAB_VERB 2 0 "Aus" 1 "Ein" /end COMPU_VTAB
/begin COMPU_VTAB FORMULA_0197_VTAB "FORMULA_0197_VTAB" TAB_VERB 2 0 "Aus" 1 "Ein" /end COMPU_VTAB
/begin COMPU_VTAB FORMULA_0198_VTAB "FORMULA_0198_VTAB" TAB_VERB 2 0 "Nein" 1 "Ja" /end COMPU_VTAB
/begin COMPU_VTAB FORMULA_0200_VTAB "FORMULA_0200_VTAB" TAB_VERB 2 0 "nein" 1 "ja" /end COMPU_VTAB
/begin COMPU_VTAB FORMULA_0201_VTAB "FORMULA_0201_VTAB" TAB_VERB 2 0 "nein" 1 "ja" /end COMPU_VTAB
/begin COMPU_VTAB FORMULA_0202_VTAB "FORMULA_0202_VTAB" TAB_VERB 2 0 "nein" 1 "ja" /end COMPU_VTAB
/begin COMPU_VTAB FORMULA_0203_VTAB "FORMULA_0203_VTAB" TAB_VERB 2 0 "nein" 1 "ja" /end COMPU_VTAB
/begin COMPU_VTAB FORMULA_0204_VTAB "FORMULA_0204_VTAB" TAB_VERB 2 0 "nein" 1 "ja" /end COMPU_VTAB
/begin COMPU_VTAB FORMULA_0205_VTAB "FORMULA_0205_VTAB" TAB_VERB 2 0 "nein" 1 "ja" /end COMPU_VTAB
/begin COMPU_VTAB FORMULA_0206_VTAB "FORMULA_0206_VTAB" TAB_VERB 2 0 "nein" 1 "ja" /end COMPU_VTAB
/begin COMPU_VTAB FORMULA_0207_VTAB "FORMULA_0207_VTAB" TAB_VERB 2 0 "nein" 1 "ja" /end COMPU_VTAB
/begin COMPU_VTAB FORMULA_0208_VTAB "FORMULA_0208_VTAB" TAB_VERB 3 0 "Fahrzeugbetrieb" 1 "Pruefstandbetrieb" 2 "Rollenbetrieb" DEFAULT_VALUE "undef" /end COMPU_VTAB
/begin COMPU_VTAB FORMULA_0209_VTAB "FORMULA_0209_VTAB" TAB_VERB 16 0 "O.K." 1 "SH_TO_UB" 2 "SH_TO_GND" 3 "UB+GND" 4 "OPENLOAD" 5 "UB+OL" 6 "GND+OL" 7 "UB+GND+OL" 8 "UNPLAUSI" 9 "UB+UP" 10 "GND+UP" 11 "UB+GND+UP" 12 "OL+UP" 13 "UB+OL+UP" 14 "GND+OL+UP" 15 "UB+GND+OL+UP" /end COMPU_VTAB
/begin COMPU_VTAB FORMULA_0210_VTAB "FORMULA_0210_VTAB" TAB_VERB 1 0 "alles i.O" DEFAULT_VALUE "Fehler oder Ansteuerung" /end COMPU_VTAB
/begin COMPU_VTAB FORMULA_0211_VTAB "FORMULA_0211_VTAB" TAB_VERB 1 0 "alles i.O" DEFAULT_VALUE "Fehler oder Ansteuerung" /end COMPU_VTAB
/begin COMPU_VTAB FORMULA_0212_VTAB "FORMULA_0212_VTAB" TAB_VERB 2 0 "nein" 1 "ja" /end COMPU_VTAB
/begin COMPU_VTAB FORMULA_0213_VTAB "FORMULA_0213_VTAB" TAB_VERB 6 17 "FP im RAM" 51 "FP warten" 119 "FP fertig" 136 "Rueckflashen" 170 "RF warten" 238 "RF fertig" /end COMPU_VTAB
/begin COMPU_VTAB FORMULA_0215_VTAB "FORMULA_0215_VTAB" TAB_VERB 4 0 "k. Aenderung" 1 "Aus" 2 "Ein" 4 "Sport" DEFAULT_VALUE "undef" /end COMPU_VTAB
/begin COMPU_VTAB FORMULA_0216_VTAB "FORMULA_0216_VTAB" TAB_VERB 3 0 "k. Aenderung" 1 "Automat" 2 "Sequentiell" DEFAULT_VALUE "undef" /end COMPU_VTAB
/begin COMPU_VTAB FORMULA_0217_VTAB "FORMULA_0217_VTAB" TAB_VERB 1 0 "k. Aenderung" /end COMPU_VTAB
/begin COMPU_VTAB FORMULA_0218_VTAB "FORMULA_0218_VTAB" TAB_VERB 4 0 "k. Aenderung" 1 "Komfort" 2 "Normal" 3 "Sport" DEFAULT_VALUE "undef" /end COMPU_VTAB
/begin COMPU_VTAB FORMULA_0219_VTAB "FORMULA_0219_VTAB" TAB_VERB 4 0 "k. Aenderung" 1 "KL1" 2 "KL2" 3 "KL3" DEFAULT_VALUE "undef" /end COMPU_VTAB
/begin COMPU_VTAB FORMULA_0220_VTAB "FORMULA_0220_VTAB" TAB_VERB 2 0 "k. Aenderung" 1 "M-Cfg" DEFAULT_VALUE "undef" /end COMPU_VTAB
/begin COMPU_VTAB FORMULA_0221_VTAB "FORMULA_0221_VTAB" TAB_VERB 2 0 "nicht angehoben" 1 "angehoben" DEFAULT_VALUE "undef" /end COMPU_VTAB
/begin COMPU_VTAB FORMULA_0222_VTAB "FORMULA_0222_VTAB" TAB_VERB 3 0 "kein R" 1 "R" 2 "Fehler" /end COMPU_VTAB
/begin COMPU_VTAB FORMULA_0223_VTAB "FORMULA_0223_VTAB" TAB_VERB 3 5 "EKP an" 10 "EKP aus" 15 "ungueltig" DEFAULT_VALUE "undef" /end COMPU_VTAB
/begin COMPU_VTAB FORMULA_0224_VTAB "FORMULA_0224_VTAB" TAB_VERB 2 0 "aus" 1 "ein" /end COMPU_VTAB
/begin COMPU_VTAB FORMULA_0228_VTAB "FORMULA_0228_VTAB" TAB_VERB 13 0 "Aus" 391 "Aktiv" 389 "Einspr. aus" 385 "Zuendung aus" 263 "Doppelzuendung" 261 "Doppelzuendung" 257 "Doppelzuendung" 135 "Fehlerspeicher" 133 "Fehlerspeicher" 129 "Fehlerspeicher" 7 "Fehlerspeicher" 5 "Fehlerspeicher" 1 "Fehlerspeicher" DEFAULT_VALUE "Idle" /end COMPU_VTAB
/begin COMPU_VTAB FORMULA_0229_VTAB "FORMULA_0229_VTAB" TAB_VERB 15 0 "Aus" 15871 "Aktiv" 23551 "Lambda" 29693 "Einspr. aus" 31741 "Einspr. aus" 29686 "Zuendung aus" 31734 "Zuendung aus" 29687 "N Schwelle" 29679 "RF Schwelle" 29663 "Pos. Dynamik" 29647 "Neg. Dynamik" 29599 "Dynamik" 31615 "Doppelzuendung" 27647 "TZ Gradient" 15359 "FeTraWe" DEFAULT_VALUE "Idle" /end COMPU_VTAB
/begin COMPU_VTAB FORMULA_0230_VTAB "FORMULA_0230_VTAB" TAB_VERB 15 0 "Aus" 24063 "Aktiv" 22013 "Einspr. aus" 24061 "Einspr. aus" 22006 "Zuendung aus" 24054 "Zuendung aus" 22007 "N Schwelle" 21999 "RF Schwelle" 21983 "Pos. Dynamik" 21967 "Neg. Dynamik" 21919 "Dynamik" 23935 "Doppelzuendung" 20479 "TZ Gradient" 23039 "Nach Start" 7679 "FeTraWe" DEFAULT_VALUE "Idle" /end COMPU_VTAB
/begin COMPU_VTAB FORMULA_0232_VTAB "FORMULA_0232_VTAB" TAB_VERB 1 0 "Kein Aussetzer" DEFAULT_VALUE "Aussetzer erkannt" /end COMPU_VTAB
/begin COMPU_VTAB FORMULA_0233_VTAB "FORMULA_0233_VTAB" TAB_VERB 1 0 "Zyl. 1 ok." DEFAULT_VALUE "Auss. Zyl. 1." /end COMPU_VTAB
/begin COMPU_VTAB FORMULA_0234_VTAB "FORMULA_0234_VTAB" TAB_VERB 1 0 "Zyl. 2 ok." DEFAULT_VALUE "Auss. Zyl. 2." /end COMPU_VTAB
/begin COMPU_VTAB FORMULA_0235_VTAB "FORMULA_0235_VTAB" TAB_VERB 1 0 "Zyl. 3 ok." DEFAULT_VALUE "Auss. Zyl. 3." /end COMPU_VTAB
/begin COMPU_VTAB FORMULA_0236_VTAB "FORMULA_0236_VTAB" TAB_VERB 1 0 "Zyl. 4 ok." DEFAULT_VALUE "Auss. Zyl. 4." /end COMPU_VTAB
/begin COMPU_VTAB FORMULA_0237_VTAB "FORMULA_0237_VTAB" TAB_VERB 1 0 "Zyl. 5 ok." DEFAULT_VALUE "Auss. Zyl. 5." /end COMPU_VTAB
/begin COMPU_VTAB FORMULA_0238_VTAB "FORMULA_0238_VTAB" TAB_VERB 1 0 "Zyl. 6 ok." DEFAULT_VALUE "Auss. Zyl. 6." /end COMPU_VTAB
/begin COMPU_VTAB FORMULA_0239_VTAB "FORMULA_0239_VTAB" TAB_VERB 1 0 "Zyl. 7 ok." DEFAULT_VALUE "Auss. Zyl. 7." /end COMPU_VTAB
/begin COMPU_VTAB FORMULA_0240_VTAB "FORMULA_0240_VTAB" TAB_VERB 1 0 "Zyl. 8 ok." DEFAULT_VALUE "Auss. Zyl. 8." /end COMPU_VTAB
/begin COMPU_VTAB FORMULA_0241_VTAB "FORMULA_0241_VTAB" TAB_VERB 1 0 "Zyl. 9 ok." DEFAULT_VALUE "Auss. Zyl. 9." /end COMPU_VTAB
/begin COMPU_VTAB FORMULA_0242_VTAB "FORMULA_0242_VTAB" TAB_VERB 1 0 "Zyl. 10 ok." DEFAULT_VALUE "Auss. Zyl. 10." /end COMPU_VTAB
/begin COMPU_VTAB FORMULA_0243_VTAB "FORMULA_0243_VTAB" TAB_VERB 8 0 "Reset" 1 "Inaktiv" 2 "LLR oKS" 3 "LLR mKS" 4 "Abst. B1" 5 "Abst. B2" 6 "Stop" 7 "Fehler" DEFAULT_VALUE "undef" /end COMPU_VTAB
/begin COMPU_VTAB FORMULA_0244_VTAB "FORMULA_0244_VTAB" TAB_VERB 2 0 "Nein" 1 "Ja" /end COMPU_VTAB
/begin COMPU_VTAB FORMULA_0245_VTAB "FORMULA_0245_VTAB" TAB_VERB 2 0 "Inaktiv" 1 "Aktiv" /end COMPU_VTAB
/begin COMPU_VTAB FORMULA_0246_VTAB "FORMULA_0246_VTAB" TAB_VERB 2 0 "Inaktiv" 1 "Aktiv" /end COMPU_VTAB
/begin COMPU_VTAB FORMULA_0248_VTAB "FORMULA_0248_VTAB" TAB_VERB 2 0 "kein Kickdown" 1 "Kickdown" /end COMPU_VTAB
/begin COMPU_VTAB FORMULA_0249_VTAB "FORMULA_0249_VTAB" TAB_VERB 6 0 "O.K." 1 "Kanalfilter" 2 "Kanalfehler" 3 "PWG2_Fehler" 4 "PWG1_Fehler" 5 "Totalausfall" DEFAULT_VALUE "undefiniert" /end COMPU_VTAB
/begin COMPU_VTAB FORMULA_0252_VTAB "FORMULA_0252_VTAB" TAB_VERB 5 0 "unbegrenzt" 1 "TZ-Begr" 2 "DK-Begr" 3 "TZ-DK-Begr" 15 "ungueltig" /end COMPU_VTAB
/begin COMPU_VTAB FORMULA_0253_VTAB "FORMULA_0253_VTAB" TAB_VERB 6 0 "frei" 1 "CAN sperrt" 2 "DME sperrt" 3 "CAN/DME" 4 "DSC sperrt" 6 "DME/DSC" DEFAULT_VALUE "Mehrfach" /end COMPU_VTAB
/begin COMPU_VTAB FORMULA_0254_VTAB "FORMULA_0254_VTAB" TAB_VERB 4 0 "Inaktiv" 1 "Bereit" 2 "Aktiv" 3 "Aktiv" /end COMPU_VTAB
/begin COMPU_VTAB FORMULA_0255_VTAB "FORMULA_0255_VTAB" TAB_VERB 4 0 "Inaktiv" 1 "Trigger" 2 "Aktiv" 3 "Aktiv" /end COMPU_VTAB
/begin COMPU_VTAB FORMULA_0256_VTAB "FORMULA_0256_VTAB" TAB_VERB 4 0 "Inaktiv" 1 "CUF" 2 "VMA" 3 "CUF+VMA" DEFAULT_VALUE "undef" /end COMPU_VTAB
/begin COMPU_VTAB FORMULA_0257_VTAB "FORMULA_0257_VTAB" TAB_VERB 2 0 "not ready" 1 "ready" /end COMPU_VTAB
/begin COMPU_VTAB FORMULA_0258_VTAB "FORMULA_0258_VTAB" TAB_VERB 3 0 "iO" 1 "Spalt" 2 "Klemmen" /end COMPU_VTAB
/begin COMPU_VTAB FORMULA_0259_VTAB "FORMULA_0259_VTAB" TAB_VERB 4 0 "Inaktiv" 1 "MSR" 2 "ASC" 130 "ASC+SA" DEFAULT_VALUE "undef" /end COMPU_VTAB
/begin COMPU_VTAB FORMULA_0262_VTAB "FORMULA_0262_VTAB" TAB_VERB 9 0 "kein Fehler" 1 "nGetr" 2 "nZiel" 4 "nAnfahr" 8 "mKupp" 16 "axMess" 32 "KuppSt" 64 "GetrSt" 128 "Modul" /end COMPU_VTAB
/begin COMPU_VTAB FORMULA_0264_VTAB "FORMULA_0264_VTAB" TAB_VERB 2 0 "KL87 aus" 1 "KL87 ein" /end COMPU_VTAB
/begin COMPU_VTAB FORMULA_0265_VTAB "FORMULA_0265_VTAB" TAB_VERB 2 0 "MM aus" 1 "MM ein" /end COMPU_VTAB
/begin COMPU_VTAB FORMULA_0266_VTAB "FORMULA_0266_VTAB" TAB_VERB 4 0 "kein Fehler" 1 "SAT-Err" 2 "Differenz" 4 "Bereich" DEFAULT_VALUE "Mehrfach" /end COMPU_VTAB
/begin COMPU_VTAB FORMULA_0267_VTAB "FORMULA_0267_VTAB" TAB_VERB 6 0 "Inaktiv" 1 "Aktiv" 3 "Aktiv+SA" 4 "TZ frei" 5 "Aktiv+TZ" 7 "Aktiv+TZ+SA" DEFAULT_VALUE "undef" /end COMPU_VTAB
/begin COMPU_VTAB FORMULA_0268_VTAB "FORMULA_0268_VTAB" TAB_VERB 2 0 "Inaktiv" 1 "Aktiv" /end COMPU_VTAB
/begin COMPU_VTAB FORMULA_0269_VTAB "FORMULA_0269_VTAB" TAB_VERB 2 0 "LL-Eingr" 1 "TL-Eingr" /end COMPU_VTAB
/begin COMPU_VTAB FORMULA_0270_VTAB "FORMULA_0270_VTAB" TAB_VERB 2 0 "Inaktiv" 1 "Aktiv" /end COMPU_VTAB
/begin COMPU_VTAB FORMULA_0271_VTAB "FORMULA_0271_VTAB" TAB_VERB 13 0 "undef" 1 "Anfahren" 2 "Anfahren-KD" 3 "Wait-RS" 4 "Anfahren-RS" 5 "Schalten" 6 "Einkuppeln" 7 "Anhalten" 8 "Abwuergen" 9 "Radabriss" 11 "ABS-Eingr" 12 "Trampeln" 15 "Fehler" /end COMPU_VTAB
/begin COMPU_VTAB FORMULA_0273_VTAB "FORMULA_0273_VTAB" TAB_VERB 8 0 "Inaktiv" 1 "Md-Red" 2 "Md-Erh" 3 "Md-Eingr" 7 "nRegler" 129 "Red+TI" 131 "Md+TI" 135 "nReg+TI" DEFAULT_VALUE "undef" /end COMPU_VTAB
/begin COMPU_VTAB FORMULA_0274_VTAB "FORMULA_0274_VTAB" TAB_VERB 22 0 "Fahrer" 1 "SMG" 2 "ASC" 3 "MSR" 4 "Schub" 5 "MCS" 16 "Fahrer+LLR" 17 "SMG+LLR" 18 "ASC+LLR" 19 "MSR+LLR" 32 "Fahrer+AR" 33 "SMG+AR" 34 "ASC+AR" 35 "MSR+AR" 64 "Fahrer+Begr" 65 "SMG+Begr" 66 "ASC+Begr" 67 "MSR+Begr" 128 "Fahrer+SK" 129 "SMG+SK" 130 "ASC+SK" 131 "MSR+SK" DEFAULT_VALUE "Mehrfach" /end COMPU_VTAB
/begin COMPU_VTAB FORMULA_0275_VTAB "FORMULA_0275_VTAB" TAB_VERB 2 0 "Sperre Aus" 1 "Sperre Ein" /end COMPU_VTAB
/begin COMPU_VTAB FORMULA_0277_VTAB "FORMULA_0277_VTAB" TAB_VERB 2 0 "BLTS aus" 1 "BLTS ein" /end COMPU_VTAB
/begin COMPU_VTAB FORMULA_0278_VTAB "FORMULA_0278_VTAB" TAB_VERB 2 0 "Sleep" 1 "Wakeup" /end COMPU_VTAB
/begin COMPU_VTAB FORMULA_0279_VTAB "FORMULA_0279_VTAB" TAB_VERB 2 0 "Kl87 aus" 1 "Kl87 ein" /end COMPU_VTAB
/begin COMPU_VTAB FORMULA_0280_VTAB "FORMULA_0280_VTAB" TAB_VERB 2 0 "offen" 1 "Kraftschluss" /end COMPU_VTAB
/begin COMPU_VTAB FORMULA_0281_VTAB "FORMULA_0281_VTAB" TAB_VERB 1 0 "aktiv" DEFAULT_VALUE "nicht aktiv" /end COMPU_VTAB
/begin COMPU_VTAB FORMULA_0282_VTAB "FORMULA_0282_VTAB" TAB_VERB 2 0 "FALSE" 1 "TRUE" DEFAULT_VALUE "TRUE" /end COMPU_VTAB
/begin COMPU_VTAB FORMULA_0283_VTAB "FORMULA_0283_VTAB" TAB_VERB 2 0 "FALSE" 1 "TRUE" DEFAULT_VALUE "TRUE" /end COMPU_VTAB
/begin COMPU_VTAB FORMULA_0284_VTAB "FORMULA_0284_VTAB" TAB_VERB 2 0 "FALSE" 1 "TRUE" DEFAULT_VALUE "TRUE" /end COMPU_VTAB
/begin COMPU_VTAB FORMULA_0285_VTAB "FORMULA_0285_VTAB" TAB_VERB 2 0 "FALSE" 1 "TRUE" DEFAULT_VALUE "TRUE" /end COMPU_VTAB
/begin COMPU_VTAB FORMULA_0286_VTAB "FORMULA_0286_VTAB" TAB_VERB 2 0 "FALSE" 1 "TRUE" DEFAULT_VALUE "TRUE" /end COMPU_VTAB
/begin COMPU_VTAB FORMULA_0287_VTAB "FORMULA_0287_VTAB" TAB_VERB 2 0 "FALSE" 1 "TRUE" DEFAULT_VALUE "TRUE" /end COMPU_VTAB
/begin COMPU_VTAB FORMULA_0288_VTAB "FORMULA_0288_VTAB" TAB_VERB 2 0 "FALSE" 1 "TRUE" DEFAULT_VALUE "TRUE" /end COMPU_VTAB
/begin COMPU_VTAB FORMULA_0289_VTAB "FORMULA_0289_VTAB" TAB_VERB 2 0 "FALSE" 1 "TRUE" DEFAULT_VALUE "TRUE" /end COMPU_VTAB
/begin COMPU_VTAB FORMULA_0290_VTAB "FORMULA_0290_VTAB" TAB_VERB 2 0 "FALSE" 1 "TRUE" DEFAULT_VALUE "TRUE" /end COMPU_VTAB
/begin COMPU_VTAB FORMULA_0291_VTAB "FORMULA_0291_VTAB" TAB_VERB 2 0 "FALSE" 1 "TRUE" DEFAULT_VALUE "TRUE" /end COMPU_VTAB
/begin COMPU_VTAB FORMULA_0292_VTAB "FORMULA_0292_VTAB" TAB_VERB 2 0 "FALSE" 1 "TRUE" DEFAULT_VALUE "TRUE" /end COMPU_VTAB
/begin COMPU_VTAB FORMULA_0293_VTAB "FORMULA_0293_VTAB" TAB_VERB 2 0 "FALSE" 1 "TRUE" DEFAULT_VALUE "TRUE" /end COMPU_VTAB
/begin COMPU_VTAB FORMULA_0294_VTAB "FORMULA_0294_VTAB" TAB_VERB 2 0 "FALSE" 1 "TRUE" DEFAULT_VALUE "TRUE" /end COMPU_VTAB
/begin COMPU_VTAB FORMULA_0295_VTAB "FORMULA_0295_VTAB" TAB_VERB 2 0 "FALSE" 1 "TRUE" DEFAULT_VALUE "TRUE" /end COMPU_VTAB
/begin COMPU_VTAB FORMULA_0296_VTAB "FORMULA_0296_VTAB" TAB_VERB 2 0 "FALSE" 1 "TRUE" DEFAULT_VALUE "TRUE" /end COMPU_VTAB
/begin COMPU_VTAB FORMULA_0297_VTAB "FORMULA_0297_VTAB" TAB_VERB 2 0 "FALSE" 1 "TRUE" DEFAULT_VALUE "TRUE" /end COMPU_VTAB
/begin COMPU_VTAB FORMULA_0298_VTAB "FORMULA_0298_VTAB" TAB_VERB 6 0 "Inaktiv" 1 "Abregeln" 2 "Schalten" 3 "Aufregeln" 4 "Ende" 15 "Error" /end COMPU_VTAB
/begin COMPU_VTAB FORMULA_0299_VTAB "FORMULA_0299_VTAB" TAB_VERB 2 0 "Schubbetrieb" 1 "Zugbetrieb" /end COMPU_VTAB
/begin COMPU_VTAB FORMULA_0300_VTAB "FORMULA_0300_VTAB" TAB_VERB 3 0 "keine Schaltung" 1 "Hochschaltung" 2 "Rueckschaltung" DEFAULT_VALUE "undef" /end COMPU_VTAB
/begin COMPU_VTAB FORMULA_0301_VTAB "FORMULA_0301_VTAB" TAB_VERB 2 0 "Manuell" 1 "Automat" /end COMPU_VTAB
/begin COMPU_VTAB FORMULA_0302_VTAB "FORMULA_0302_VTAB" TAB_VERB 2 0 "mit Eingriff" 1 "ohne Eingriff" /end COMPU_VTAB
/begin COMPU_VTAB FORMULA_0303_VTAB "FORMULA_0303_VTAB" TAB_VERB 2 0 "nein" 1 "ja" /end COMPU_VTAB
/begin COMPU_VTAB FORMULA_0304_VTAB "FORMULA_0304_VTAB" TAB_VERB 2 0 "nein" 1 "ja" /end COMPU_VTAB
/begin COMPU_VTAB FORMULA_0305_VTAB "FORMULA_0305_VTAB" TAB_VERB 2 0 "nein" 1 "ja" /end COMPU_VTAB
/begin COMPU_VTAB FORMULA_0307_VTAB "FORMULA_0307_VTAB" TAB_VERB 2 0 "bekannt" 1 "unbekannt" /end COMPU_VTAB
/begin COMPU_VTAB FORMULA_0308_VTAB "FORMULA_0308_VTAB" TAB_VERB 2 0 "nicht ungerade" 1 "ungerade" /end COMPU_VTAB
/begin COMPU_VTAB FORMULA_0309_VTAB "FORMULA_0309_VTAB" TAB_VERB 2 0 "nicht gerade" 1 "gerade" /end COMPU_VTAB
/begin COMPU_VTAB FORMULA_0310_VTAB "FORMULA_0310_VTAB" TAB_VERB 2 0 "keine Aktion" 1 "Aktion" /end COMPU_VTAB
/begin COMPU_VTAB FORMULA_0311_VTAB "FORMULA_0311_VTAB" TAB_VERB 2 0 "nicht plausibel" 1 "plausibel" /end COMPU_VTAB
/begin COMPU_VTAB FORMULA_0312_VTAB "FORMULA_0312_VTAB" TAB_VERB 2 0 "nicht berechnen" 1 "neu berechnen" /end COMPU_VTAB
/begin COMPU_VTAB FORMULA_0313_VTAB "FORMULA_0313_VTAB" TAB_VERB 2 0 "Gang halten" 1 "Gang uebernehmen" /end COMPU_VTAB
/begin COMPU_VTAB FORMULA_0314_VTAB "FORMULA_0314_VTAB" TAB_VERB 3 0 "aus" 1 "inaktiv" 2 "aktiv" /end COMPU_VTAB
/begin COMPU_VTAB FORMULA_0315_VTAB "FORMULA_0315_VTAB" TAB_VERB 2 0 "aus" 1 "ein" /end COMPU_VTAB
/begin COMPU_VTAB FORMULA_0316_VTAB "FORMULA_0316_VTAB" TAB_VERB 4 0 "Inaktiv" 1 "HUD ein" 2 "NotAcpt" 3 "Ein+NotAcpt" /end COMPU_VTAB
/begin COMPU_VTAB FORMULA_0318_VTAB "FORMULA_0318_VTAB" TAB_VERB 13 0 "Verriegelt" 1 "Aus" 2 "Ein / Aus" 3 "Passiv" 4 "Abschalt Rampe" 5 "Wiederaufnahme" 6 "Set" 7 "Konstantfahrt" 8 "Tipp plus" 9 "Tipp minus" 10 "Beschleunigung" 11 "Verzoegern" 12 "Ueberholen" DEFAULT_VALUE "undef" /end COMPU_VTAB
/begin COMPU_VTAB FORMULA_0319_VTAB "FORMULA_0319_VTAB" TAB_VERB 2 0 "SA freigegeben" 1 "SA gesperrt" /end COMPU_VTAB
/begin COMPU_VTAB FORMULA_0320_VTAB "FORMULA_0320_VTAB" TAB_VERB 4 0 "keine" 1 "Bank1" 2 "Bank2" 3 "Bank1+2" /end COMPU_VTAB
/begin COMPU_VTAB FORMULA_0321_VTAB "FORMULA_0321_VTAB" TAB_VERB 6 0 "NEUSTART" 1 "REGLER_EIN" 2 "ERSATZWERT" 4 "NOTAUS" 8 "DIAGNOSE" 16 "AUS" DEFAULT_VALUE "undef" /end COMPU_VTAB
/begin COMPU_VTAB FORMULA_0322_VTAB "FORMULA_0322_VTAB" TAB_VERB 2 0 "FALSE" 1 "TRUE" DEFAULT_VALUE "TRUE" /end COMPU_VTAB
/begin COMPU_VTAB FORMULA_0323_VTAB "FORMULA_0323_VTAB" TAB_VERB 2 0 "FALSE" 1 "TRUE" DEFAULT_VALUE "TRUE" /end COMPU_VTAB
/begin COMPU_VTAB FORMULA_0324_VTAB "FORMULA_0324_VTAB" TAB_VERB 2 0 "FALSE" 1 "TRUE" DEFAULT_VALUE "TRUE" /end COMPU_VTAB
/begin COMPU_VTAB FORMULA_0325_VTAB "FORMULA_0325_VTAB" TAB_VERB 2 0 "FALSE" 1 "TRUE" DEFAULT_VALUE "TRUE" /end COMPU_VTAB
/begin COMPU_VTAB FORMULA_0326_VTAB "FORMULA_0326_VTAB" TAB_VERB 2 0 "FALSE" 1 "TRUE" DEFAULT_VALUE "TRUE" /end COMPU_VTAB
/begin COMPU_VTAB FORMULA_0327_VTAB "FORMULA_0327_VTAB" TAB_VERB 2 0 "FALSE" 1 "TRUE" DEFAULT_VALUE "TRUE" /end COMPU_VTAB
/begin COMPU_VTAB FORMULA_0328_VTAB "FORMULA_0328_VTAB" TAB_VERB 2 0 "FALSE" 1 "TRUE" DEFAULT_VALUE "TRUE" /end COMPU_VTAB
/begin COMPU_VTAB FORMULA_0329_VTAB "FORMULA_0329_VTAB" TAB_VERB 2 0 "FALSE" 1 "TRUE" DEFAULT_VALUE "TRUE" /end COMPU_VTAB
/begin COMPU_VTAB FORMULA_0330_VTAB "FORMULA_0330_VTAB" TAB_VERB 2 0 "FALSE" 1 "TRUE" DEFAULT_VALUE "TRUE" /end COMPU_VTAB
/begin COMPU_VTAB FORMULA_0331_VTAB "FORMULA_0331_VTAB" TAB_VERB 2 0 "FALSE" 1 "TRUE" DEFAULT_VALUE "TRUE" /end COMPU_VTAB
/begin COMPU_VTAB FORMULA_0332_VTAB "FORMULA_0332_VTAB" TAB_VERB 2 0 "FALSE" 1 "TRUE" DEFAULT_VALUE "TRUE" /end COMPU_VTAB
/begin COMPU_VTAB FORMULA_0333_VTAB "FORMULA_0333_VTAB" TAB_VERB 2 0 "FALSE" 1 "TRUE" DEFAULT_VALUE "TRUE" /end COMPU_VTAB
/begin COMPU_VTAB FORMULA_0334_VTAB "FORMULA_0334_VTAB" TAB_VERB 2 0 "FALSE" 1 "TRUE" DEFAULT_VALUE "TRUE" /end COMPU_VTAB
/begin COMPU_VTAB FORMULA_0335_VTAB "FORMULA_0335_VTAB" TAB_VERB 2 0 "FALSE" 1 "TRUE" DEFAULT_VALUE "TRUE" /end COMPU_VTAB
/begin COMPU_VTAB FORMULA_0336_VTAB "FORMULA_0336_VTAB" TAB_VERB 2 0 "FALSE" 1 "TRUE" DEFAULT_VALUE "TRUE" /end COMPU_VTAB
/begin COMPU_VTAB FORMULA_0337_VTAB "FORMULA_0337_VTAB" TAB_VERB 2 0 "FALSE" 1 "TRUE" DEFAULT_VALUE "TRUE" /end COMPU_VTAB
/begin COMPU_VTAB FORMULA_0338_VTAB "FORMULA_0338_VTAB" TAB_VERB 2 0 "FALSE" 1 "TRUE" DEFAULT_VALUE "TRUE" /end COMPU_VTAB
/begin COMPU_VTAB FORMULA_0339_VTAB "FORMULA_0339_VTAB" TAB_VERB 2 0 "FALSE" 1 "TRUE" DEFAULT_VALUE "TRUE" /end COMPU_VTAB
/begin COMPU_VTAB FORMULA_0340_VTAB "FORMULA_0340_VTAB" TAB_VERB 2 0 "FALSE" 1 "TRUE" DEFAULT_VALUE "TRUE" /end COMPU_VTAB
/begin COMPU_VTAB FORMULA_0341_VTAB "FORMULA_0341_VTAB" TAB_VERB 2 0 "FALSE" 1 "TRUE" DEFAULT_VALUE "TRUE" /end COMPU_VTAB
/begin COMPU_VTAB FORMULA_0344_VTAB "FORMULA_0344_VTAB" TAB_VERB 4 0 "Lampe aus" 1 "Lampe gelb" 2 "Lampe rot" 3 "Lampe rot" /end COMPU_VTAB
/begin COMPU_VTAB FORMULA_0345_VTAB "FORMULA_0345_VTAB" TAB_VERB 2 0 "Inaktiv" 1 "Aktiv" /end COMPU_VTAB
/begin COMPU_VTAB FORMULA_0346_VTAB "FORMULA_0346_VTAB" TAB_VERB 2 0 "gesperrt" 1 "senden" /end COMPU_VTAB
/begin COMPU_VTAB FORMULA_0347_VTAB "FORMULA_0347_VTAB" TAB_VERB 1 0 "keine aus" DEFAULT_VALUE "Mind. eine abgesch." /end COMPU_VTAB
/begin COMPU_VTAB FORMULA_0350_VTAB "FORMULA_0350_VTAB" TAB_VERB 3 0 "nichts" 1 "postiv" 2 "negativ" /end COMPU_VTAB
/begin COMPU_VTAB FORMULA_0717_VTAB "FORMULA_0717_VTAB" TAB_VERB 2 1 "S65-RES" 2 "S65" DEFAULT_VALUE "ungueltig" /end COMPU_VTAB
/begin COMPU_VTAB FORMULA_0718_VTAB "FORMULA_0718_VTAB" TAB_VERB 2 0 "Keine Popelung" 1 "Mit Popelung" DEFAULT_VALUE "ungueltig" /end COMPU_VTAB
/begin COMPU_VTAB FORMULA_0719_VTAB "FORMULA_0719_VTAB" TAB_VERB 1 1 "aus mvac_ml_sr" DEFAULT_VALUE "ungueltig" /end COMPU_VTAB
/begin COMPU_VTAB FORMULA_0720_VTAB "FORMULA_0720_VTAB" TAB_VERB 6 0 "0.18fc/fn" 1 "0.3fc/fn" 2 "0.42fc/fn" 3 "0.6fc/fn" 4 "0.9fc/fn" 5 "1.0fc/fn" /end COMPU_VTAB
/begin COMPU_VTAB FORMULA_0722_VTAB "FORMULA_0722_VTAB" TAB_VERB 5 0 "Inaktiv" 1 "Aktiv" 2 "TPU-Stop" 4 "ECU-Stop" 8 "Trig-Stop" /end COMPU_VTAB
/begin COMPU_VTAB FORMULA_0725_VTAB "FORMULA_0725_VTAB" TAB_VERB 2 0 "ITB aus" 1 "ITB ein" DEFAULT_VALUE "undef" /end COMPU_VTAB
/begin FUNCTION Global ""
 /begin OUT_MEASUREMENT aq_eingeregelt_st aq_rel aq_rf_b1 aq_rf_b2 aq_rf_roh_b1 aq_rf_roh_b2 at_sa_sperre auss_erk auss_erk_zyl1 auss_erk_zyl10 auss_erk_zyl2 auss_erk_zyl3 auss_erk_zyl4 auss_erk_zyl5 auss_erk_zyl6 auss_erk_zyl7 auss_erk_zyl8 auss_erk_zyl9 auss_lp_int_sum_b1 auss_lp_int_sum_b2 auss_nw_sync_b1 auss_nw_sync_b2 auss_obd_zyl_off auss_st_b1 auss_st_b2 auss_st_ns_b1 auss_st_ns_b2 auss_st_ti_b1 auss_st_ti_b2 B_CAN_ANHAENGER B_CAN_HBR B_CAN_KOMBI_MIL B_genoff_copy B_LLR_EINGEREGELT B_LLR_GRUNDDREHZAHL B_LLR_MIN_BEGR B_oztemp_bsd_ok B_oztemp_copy B_TE_OBD_ABBRUCH B_TE_OBD_CHECK B_TE_OBD_KKOS_ABSCH B_TE_OBD_KKOS_FAIL B_TE_OBD_LAM_REG_OFF B_TE_OBD_PRE_CHECK B_TE_OBD_S_BLS_OLD B_TE_OBD_START_EXD B_VAN_NICHT_NORM B_VAN_SK can_a_st can_ax can_ax_mess can_ax_offs can_ay can_bedfgr can_brp can_brp_grad can_brp_st can_crash_ctr can_dkg_eingr can_dkg_getr_st can_dkg_i_strang can_dkg_istgang can_dkg_kupp_ist can_dkg_kupp_st can_dkg_md_soll can_dkg_md_soll_pos can_dkg_n_getr_ein can_dkg_n_llr can_dkg_n_soll can_dsc_eingr can_dsc_md_soll can_dsc_md_soll_pos can_dsc_reg can_dsc_st can_flags can_fzg_st can_gang_r can_idx_fil can_idx_fp can_kkos_md can_kkos_st can_kkos_st_nll can_kkos_st_zh can_klst_s can_kmst_st can_lrw can_lrw_st can_lrw_v can_md_rad_steigung can_no_key can_s_tns can_st_atemp can_st_bedfgr can_st_dsc can_st_empf can_st_empf_hys can_st_grb can_st_grb2 can_st_kkos can_st_klst can_st_stgrb can_st_stkombi can_st_torqdkg can_st_torqdsc can_st_vehmod can_st_vfzg can_st_vrad can_stkombi_fgr can_stkombi_s can_v_st can_vehmod cbs_reset_st ccp_fp_st_ign ccp_fp_st_inj diag_ev_tz_st dkg_freig_st dr_rel_b1 dr_rel_b2 dr_rel_grad_b1 dr_rel_grad_b2 dwf_n_orange egas_aq_soll_b1 egas_aq_soll_b2 egas_aq_soll_grad_b1 egas_aq_soll_grad_b2 egas_aq_soll_roh_b1 egas_aq_soll_roh_b2 egas_ist_dk_b1 egas_ist_dk_b2 egas_ist_lls_b1 egas_ist_lls_b2 egas_ist_wdk_b1 egas_ist_wdk_b2 egas_rec_dk_r_hw_vers_b1 egas_rec_dk_r_hw_vers_b2 egas_sk_mode egas_sk_ti_st egas_soll_dk_b1 egas_soll_dk_b2 egas_soll_lls_b1 egas_soll_lls_b2 egas_st_b1 egas_st_b2 egas_st_dk_b1 egas_st_dk_b2 egas_st_ft_b1 egas_st_ft_b2 egas_wdk_adapt_b1 egas_wdk_adapt_b2 elup_ed_st elup_st evap_wdk_ist_b1 evap_wdk_ist_b2 exd_tester_timeout fgr_anzeige_kombi fgr_cc_message fgr_sa_sperre fgr_status fgr_status_hud fgr_status_kombi fgr_v_kombi fr_einger_st fr_ramp_st fr_ramp_st.aq_grad fr_ramp_st.dkfail fr_ramp_st.egasdif fr_ramp_st.lamreg_off fr_ramp_st.llsfail fr_ramp_st.pumgmax fr_ramp_st.pumgmin fr_ramp_st.rfmax fr_ramp_st.sasb fr_ramp_st.start_delay fr_ramp_st.tanmax fr_ramp_st.tanmin fr_ramp_st.te_c_akf fr_ramp_st.te_mvac fr_ramp_st.tevc_on fr_ramp_st.tkasmmin fr_ramp_st.tksmmax fr_ramp_st.tmotmax fr_ramp_st.tmotmin fr_ramp_st.zust_ml gang gang_berech gang_berech_kl_i gang_berech_kl_i_dist gang_berech_st gang_berech_st_aktion gang_berech_st_gerade gang_berech_st_neu gang_berech_st_plaus gang_berech_st_uebern gang_berech_st_unbek gang_berech_st_ungerade gang_can gang_ks gang_n_verh hdw_ign hdw_ign_st hdw_inj hdw_inj_st j_gesamt k2KB_bytes_ign k2KB_req_inj k2KB_resp_ign k2KB_sid_ign ka_dtz_sum_all ka_dtz_sum_b1 ka_dtz_sum_b2 ka_tz_nv_sum_all ka_tz_nv_sum_b1 ka_tz_nv_sum_b2 kh_lam_soll_b1 kh_lam_soll_b2 kh_st kh_st_ed kh_st_eingriff kh_st_n kh_st_pksrpl kh_st_pumg kh_st_rf kh_st_sk kh_st_sl kh_st_smg kh_st_t_ml kh_st_tan kh_st_tkat kh_st_tkat_zyklus kh_st_van kh_st_vtkat kh_st_vtkat_zyklus kh_st_xx kh_van_fakt_kf_Auslass kh_van_fakt_kf_Einlass kl87_st kr_dtz_sum_b1 kr_dtz_sum_b2 kva_can kw_diag kwp_fp_st_ign kwp_fp_st_inj lam_delta_lim_b1 lam_delta_lim_b2 lam_ist_ers_b1 lam_ist_ers_b2 lam_ist_mw_b1 lam_ist_mw_b2 lam_reg_f_b1 lam_reg_f_b2 lam_reg_max_b1 lam_reg_max_b2 lam_reg_min_b1 lam_reg_min_b2 lam_reg_reset_sa_b1 lam_reg_reset_sa_b2 lam_reg_reset_slp_b1 lam_reg_reset_slp_b2 lam_reg_st_b1 lam_reg_st_b2 lam_reg_stat_b1 lam_reg_stat_b2 lam_reg_stat_trim_b1 lam_reg_stat_trim_b2 lam_regler_st_b1 lam_regler_st_b2 lam_soll_b1 lam_soll_b2 lam_soll_ms_kat_b1 lam_soll_ms_kat_b2 lam_soll_puls_adapt_fett_b1 lam_soll_puls_adapt_fett_b2 lam_soll_puls_adapt_mager_b1 lam_soll_puls_adapt_mager_b2 lam_soll_puls_ausr_b1 lam_soll_puls_ausr_b2 lam_soll_puls_ausr_sl_b1 lam_soll_puls_ausr_sl_b2 lam_soll_puls_ausr_sl_trig_b1 lam_soll_puls_ausr_sl_trig_b2 lam_soll_puls_b1 lam_soll_puls_b2 lam_soll_puls_fett_betrieb_b1 lam_soll_puls_fett_betrieb_b2 lam_soll_puls_freigabe_b1 lam_soll_puls_freigabe_b2 lam_soll_puls_lam_filt_b1 lam_soll_puls_lam_filt_b2 lam_soll_puls_st_b1 lam_soll_puls_st_b2 lam_soll_vl_max lam_soll_wl lam_ti_min_b1 lam_ti_min_b2 lam_wf_verz_b1 lam_wf_verz_b2 lavk_obd_act_exd_n_soll lavk_obd_dyn_kat_exd_n_soll lavk_obd_error laz_ti_mks_roh llr_flags llr_n_soll llr_state md_can_begr_st md_can_kkos_max md_dsc_freig_st md_dsc_sperr_st md_fw_bls md_fw_rel Md_gennm_copy md_ind_ml_st md_ind_ne md_ind_opt_la_rg_zw_min md_ind_schlepp_ist md_ind_schlepp_min md_ind_tz_st md_kupp_ist md_kupp_ist_ve md_kupp_max md_kupp_max_can md_kupp_min md_kupp_min_filter md_kupp_wunsch md_kupp_wunsch_begr md_kupp_wunsch_filter_rel md_kupp_wunsch_ml md_kupp_wunsch_tz md_max_fak_power md_ml_soll md_nbegr_st md_nbegr_t md_rad_can_mdrv md_rad_ist md_rad_min md_rad_schlepp_ist md_rad_soll md_rf_max md_rf_max_roh md_rf_min_pt md_rf_soll md_rf_soll_pt_fr_wicht md_rf_soll_pt_roh md_sk_mode md_sk_ti_st md_st md_tz_soll_mittel md_vbegr_st md_wunsch_rel mdrv_st mdrv_st_dme mdrv_st_dsc_akt mdrv_st_mod_albv_akt mdrv_st_mod_edck_akt mdrv_st_mod_eng_akt mdrv_st_mod_hud_akt mdrv_st_mod_smg_akt mdrv_st_stg_smg_akt ml_b1 ml_b2 ml_ges msg_rec_cc msg_rec_cc_dsc mvac_aq_bre mvac_ed_st mvac_p mvac_p_mess mvac_p_modell mvac_pdiff_um mvac_rf_sr mvac_rf_sr_b_b1 mvac_rf_sr_b_b2 mzyl_ml_b1 mzyl_ml_b2 n n_begr_egas n_begr_st n_dyn_st n_e2 n_getr_abtrieb n_getr_ein n_grad_asp n_grad_segment N_idlgspec_copy n_lw_b1 n_lw_b2 n_lw_m Nslb_copy nw_asp_cnt nw_asp_cnt_ml nw_st nwm_state Oz_tempr pctrl_t_ign pctrl_t_inj pks_can_diag_st pks_can_i pks_can_n pks_can_st pks_can_u_kl30 pks_ist pks_rel pksr_b_ekp2 pksr_ekp_ansteuerung_cfg pksr_exd_md_fw_st pksr_exd_zust_pl pksr_tv_ekp psau_rel_b1 psau_rel_b2 pumg pwg_kd_st pwg_kd_st_kickdown pwg_mode pwg_soll pwg1_abs_roh pwg2_abs_roh rf_aq_b1 rf_aq_b2 rf_b1 rf_b2 rf_dyn rf_dyn_delta rf_e2_b1 rf_e2_b2 rf_e2_m rf_fil_b1 rf_fil_b2 rf_grad_b1 rf_grad_b2 rf_hfm_b1 rf_hfm_b2 rf_lam_b1 rf_lam_b2 rf_m rf_psau_b1 rf_psau_b2 rf_pt_korr rf_pt_korr_e2 rf_pt_korr_zyl rg_m_delta_ist_stat_b1 rg_m_delta_ist_stat_b2 rg_x_b1 rg_x_b2 rg_x_delta_b1 rg_x_delta_b2 rg_x_m rg_x_m_stat rps_auss_st rps_cfg rps_dyn_fil_st rps_evap_tv rps_ionen_st rps_ionen_stufe rps_kupp_min_filter rps_kupp_wunsch_fil_roh rps_kupp_wunsch_filter rps_llr_md_ad rps_llr_md_i rps_llr_md_p rps_llr_md_tz rps_llr_n_soll rps_llr_st rps_rec1_cnt rps_rec2_cnt rps_tz_offs rps_zyl_nr s_kraftschluss_smg s_kraftschluss_smg_e2 sa_aktive_time sa_n_we sa_we_st schalter_bls_ign schalter_bls_ign_e2 schalter_bls_inj schalter_bls_inj_e2 schalter_blts schalter_blts_e2 schalter_getriebe schalter_getriebe_e2 schalter_kl87 schalter_kl87_e2 schalter_kraft_hs schalter_kraft_hs_e2 schalter_kupplung schalter_kupplung_e2 schalter_poel schalter_poel_e2 schalter_power schalter_power_e2 schalter_schaltung schalter_schaltung_e2 schalter_st_ign schalter_st_ign_e2 schalter_st_inj schalter_st_inj_e2 schalter_wakeup_ign schalter_wakeup_ign_e2 schalter_wakeup_inj schalter_wakeup_inj_e2 schalter_zustand_poel schalter_zustand_poel_e2 servo_stat sk_egas_off_ign sk_egas_off_inj sk_eingr_st_ign sk_eingr_st_inj sk_fr_st_ign sk_fr_st_inj sk_fra_st_ign sk_fra_st_inj sk_hw_pwg1s_ad sk_kh_st_ign sk_kh_st_inj sk_lam_st_ign_b1 sk_lam_st_ign_b2 sk_lam_st_inj_b1 sk_lam_st_inj_b2 sk_llra_st_ign sk_llra_st_inj sk_md_begr_ign sk_md_begr_inj sk_md_eingr_ign sk_md_eingr_inj sk_mzyl_st_ign sk_mzyl_st_inj sk_pks_st_ign sk_pks_st_inj sk_ti_eingr_ign sk_ti_eingr_inj sk_ti_zyl_off_ign sk_ti_zyl_off_inj sk_tr_req sk_tr_resp sk_tr_result sk_tz_eingr_ign sk_tz_eingr_inj sk_van_st_ign sk_van_st_inj sl_ml_hfm sl_zwd_tv slp_dauer slp_st sls_obdh_st slv_st smg_ax_berg smg_ax_mess_filter smg_can_error smg_can_flags smg_can_flags_kl87 smg_can_flags_mm smg_can_modul smg_can_n_getr_ein smg_can_n_getr_ziel smg_can_prog_info smg_n_getr_anschluss smg_schaltart smg_schaltart_aks smg_schaltart_automat smg_schaltart_eingr smg_schaltart_hr smg_schaltart_lw smg_schaltart_rs smg_schaltart_zs smg_sk_mode smg_st_dme smg_st_mot smg_st_mot_sa smg_st_mot_ti smg_st_mot_tl smg_t_abregel smg_t_aufregel start_rl_atic39_dpr start_rl_diag_dpr sw_confg_betriebsmode_exd tabg_filter_b1 tabg_filter_b2 tabg_kat_b1 tabg_kat_b2 tabg_lw_b1 tabg_lw_b2 tabg_lw_verh_b1 tabg_lw_verh_b2 tabg_lw_verh_wurzel_b1 tabg_lw_verh_wurzel_b2 tabg_nkat_b1 tabg_nkat_b2 tabg_nkat_modell_b1 tabg_nkat_modell_b2 tabg_vkat_b1 tabg_vkat_b2 tan_b1 tan_b2 tan_e2 tan_mw tanzyl tdme te_c_akf te_obd_flags te_rf_ist_b1 te_rf_ist_b2 te_tv_b1 te_tv_b2 te_x_ml_soll_b1 te_x_ml_soll_b2 te_zust_st tgetr ti_ausblend_ist_b1 ti_ausblend_ist_b2 ti_ev_ed_b1 ti_ev_ed_b2 ti_mks_roh_b1 ti_mks_roh_b2 ti_pks_up_st ti_rf_max ti_tpu_st ti_zyl_tz time_abs time_kl15_off time_kl15_on time_ll time_ml time_ms time_rel time_sa time_st time_vl tka tksm tmot tmot_modell tmot_sta tmot_sta_zws toel toel_can toel_start_ok tsgrw_b1 tsgrw_b2 tsgrw_m tumg tumg_ersatz tumg_st tz_diag_tpu_err tz_grad_b1 tz_grad_b2 tz_min_b1 tz_min_b2 tz_ve_mw tz_zyl_ti u_wakeup ub ub_roh uext_korr_pin_111_219_514 uext_korr_pin_124_512 uext_pin_111_219_514 uext_pin_124_512 v_direkt v_hinten v_max_anh_st v_max_delta v_max_schw_can v_max_schw_direkt v_rad_hl v_rad_hr v_rad_vl v_rad_vr v_tacho v_vorne van_exd_n_soll van_exd_st van_ist_A1 van_ist_A2 van_ist_E1 van_ist_E2 van_ist_filt_A1 van_ist_filt_A2 van_ist_filt_E1 van_ist_filt_E2 van_sk_st van_soll_A1 van_soll_A2 van_soll_E1 van_soll_E2 zust_md_rel_tl_vl zust_time_st zust_tka_start zust_tmot_start zustand_fahrzeug zustand_motor /end OUT_MEASUREMENT
/end FUNCTION
/begin FUNCTION HFM ""
 /begin DEF_CHARACTERISTIC K_HFM_DIAG_ML_MAX K_HFM_DIAG_ML_MIN K_HFM_ERSATZ K_HFM_FIL_FC K_HFM_KL_CFG K_HFM_MVAC_CFG K_HFM_N_RF_KORR_CFG K_HFM_OBD_DYN_DELTA_RF K_HFM_OBD_DYN_RF_T KF_HFM_AEB KF_HFM_DYN_SW KF_HFM_DYN_VZ KF_HFM_FAK_S65_B1 KF_HFM_KORR_ML_TAN KF_HFM_KORR_N_RF KL_HFM_ANZ_SEG_N KL_HFM_AQ_GRAD_WICHT /end DEF_CHARACTERISTIC
 /begin OUT_MEASUREMENT hfm_5ms_ad hfm_dyn_vz hfm_fak_b1 hfm_fil_koe_a2 hfm_fil_koe_a3 hfm_fil_koe_b1 hfm_fil_koe_b2 hfm_iir_n hfm_ml_5ms_b1 hfm_ml_5ms_b2 hfm_mw hfm_mw_1seg hfm_mw_aeb hfm_mw_idx hfm_mw_korr hfm_mw_tan hfm_mw_xseg hfm_qadc_trig_error hfm_roh hfm_sek_ml_mvac hfm_tan_korr hfm_tpu_trig_error ml_hfm_b1 ml_hfm_b2 mzyl_hfm_b1 mzyl_hfm_b2 /end OUT_MEASUREMENT
/end FUNCTION
/begin FUNCTION INJ-TB "" /begin DEF_CHARACTERISTIC K_ITB_CFG /end DEF_CHARACTERISTIC
 /begin OUT_MEASUREMENT injt_freq injt_mask injt_pf_avg injt_pf_dev injt_pf_max injt_pf_min injt_pulse_count injt_pulse_rem injt_run injt_sample_cnt injt_status_mc injt_status_tb injt_tf_avg injt_tf_dev injt_tf_max injt_tf_min injt_time injt_timeout injt_ub_avg injt_ub_dev injt_ub_max injt_ub_min /end OUT_MEASUREMENT
/end FUNCTION
/begin RECORD_LAYOUT TKF_SW_SW_UW FNC_VALUES 5 UWORD COLUMN_DIR DIRECT AXIS_PTS_X 3 SWORD INDEX_INCR DIRECT AXIS_PTS_Y 4 SWORD INDEX_INCR DIRECT NO_AXIS_PTS_X 1 UBYTE NO_AXIS_PTS_Y 2 UBYTE /end RECORD_LAYOUT
/begin RECORD_LAYOUT TKF_UW_UW_SW FNC_VALUES 5 SWORD COLUMN_DIR DIRECT AXIS_PTS_X 3 UWORD INDEX_INCR DIRECT AXIS_PTS_Y 4 UWORD INDEX_INCR DIRECT NO_AXIS_PTS_X 1 UBYTE NO_AXIS_PTS_Y 2 UBYTE /end RECORD_LAYOUT
/begin RECORD_LAYOUT TKF_UW_UW_UW FNC_VALUES 5 UWORD COLUMN_DIR DIRECT AXIS_PTS_X 3 UWORD INDEX_INCR DIRECT AXIS_PTS_Y 4 UWORD INDEX_INCR DIRECT NO_AXIS_PTS_X 1 UBYTE NO_AXIS_PTS_Y 2 UBYTE /end RECORD_LAYOUT
/begin RECORD_LAYOUT TKL_SW_VV_UW FNC_VALUES 4 UWORD COLUMN_DIR DIRECT AXIS_PTS_X 3 SWORD INDEX_INCR DIRECT NO_AXIS_PTS_X 1 UBYTE RESERVED 2 BYTE /end RECORD_LAYOUT
/begin RECORD_LAYOUT TKW_VV_VV_SW FNC_VALUES 1 SWORD COLUMN_DIR DIRECT /end RECORD_LAYOUT
/begin RECORD_LAYOUT TKW_VV_VV_UB FNC_VALUES 1 UBYTE COLUMN_DIR DIRECT /end RECORD_LAYOUT
/begin RECORD_LAYOUT TKW_VV_VV_UW FNC_VALUES 1 UWORD COLUMN_DIR DIRECT /end RECORD_LAYOUT
/end MODULE
/end PROJECT
