ASAP2_VERSION 1 3
/begin PROJECT P383 "BMW DDE6.3 8-Zylinder V9E.3 11.10.2004 CAN12H"
/begin HEADER "" VERSION "V9E.3_8Z_CAN12H" PROJECT_NO P383 /end HEADER
/begin MODULE DIM ""
/begin MOD_COMMON "" BYTE_ORDER MSB_FIRST ALIGNMENT_BYTE 1 ALIGNMENT_WORD 2 ALIGNMENT_LONG 4 ALIGNMENT_FLOAT32_IEEE 4 /end MOD_COMMON
/begin CHARACTERISTIC Dmd_gen_C "Applikationswert für Dmd_gen" VALUE 0xEC814 Kw_Ws16 65535.00 OneToOne -32768.00 32767.00 FORMAT "%8.2" /end CHARACTERISTIC
/begin CHARACTERISTIC Layer_ctDebBSDStep_C "Schrittweite für Entprellzähler für BSD Fehler" VALUE 0xEC850 Kw_Wu8 255.0 OneToOne 0.00 255.0 FORMAT "%5.1" /end CHARACTERISTIC
/begin CHARACTERISTIC Layer_ctDebGENStep_C "Schrittweite für Entprellzähler für GEN Fehler" VALUE 0xEC851 Kw_Wu8 255.0 OneToOne 0.00 255.0 FORMAT "%5.1" /end CHARACTERISTIC
/begin CHARACTERISTIC Layer_ctDebIBS1Step_C "Schrittweite für Entprellzähler für IBS1 Fehler" VALUE 0xEC852 Kw_Wu8 255.0 OneToOne 0.00 255.0 FORMAT "%5.1" /end CHARACTERISTIC
/begin CHARACTERISTIC Layer_ctDebIBS2Step_C "Schrittweite für Entprellzähler für IBS2 Fehler" VALUE 0xEC853 Kw_Wu8 255.0 OneToOne 0.00 255.0 FORMAT "%5.1" /end CHARACTERISTIC
/begin CHARACTERISTIC Layer_ctDebIBS3Step_C "Schrittweite für Entprellzähler für IBS3 Fehler" VALUE 0xEC854 Kw_Wu8 255.0 OneToOne 0.00 255.0 FORMAT "%5.1" /end CHARACTERISTIC
/begin CHARACTERISTIC Layer_ctDebMANHYDRStep_C "Schrittweite für Entprellzähler für MANHYDR Fehler" VALUE 0xEC855 Kw_Wu8 255.0 OneToOne 0.00 255.0 FORMAT "%5.1" /end CHARACTERISTIC
/begin CHARACTERISTIC Layer_ctDebMANLUFTStep_C "Schrittweite für Entprellzähler für MANLUFT Fehler" VALUE 0xEC856 Kw_Wu8 255.0 OneToOne 0.00 255.0 FORMAT "%5.1" /end CHARACTERISTIC
/begin CHARACTERISTIC Layer_ctDebPMBATTStep_C "Schrittweite für Entprellzähler für PMBATT Fehler" VALUE 0xEC857 Kw_Wu8 255.0 OneToOne 0.00 255.0 FORMAT "%5.1" /end CHARACTERISTIC
/begin CHARACTERISTIC Layer_ctDebPMBNStep_C "Schrittweite für Entprellzähler für PMBN Fehler" VALUE 0xEC858 Kw_Wu8 255.0 OneToOne 0.00 255.0 FORMAT "%5.1" /end CHARACTERISTIC
/begin CHARACTERISTIC Layer_ctDebPMRUHVERLStep_C "Schrittweite für Entprellzähler für PMRUHVERL Fehler" VALUE 0xEC859 Kw_Wu8 255.0 OneToOne 0.00 255.0 FORMAT "%5.1" /end CHARACTERISTIC
/begin CHARACTERISTIC Layer_ctDebQLTStep_C "Schrittweite für Entprellzähler für QLT Fehler" VALUE 0xEC85A Kw_Wu8 255.0 OneToOne 0.00 255.0 FORMAT "%5.1" /end CHARACTERISTIC
/begin CHARACTERISTIC Layer_ctDebTANSStep_C "Schrittweite für Entprellzähler für TANS Fehler" VALUE 0xEC85B Kw_Wu8 255.0 OneToOne 0.00 255.0 FORMAT "%5.1" /end CHARACTERISTIC
/begin CHARACTERISTIC Layer_ctDebTOENSStep_C "Schrittweite für Entprellzähler für TOENS Fehler" VALUE 0xEC85C Kw_Wu8 255.0 OneToOne 0.00 255.0 FORMAT "%5.1" /end CHARACTERISTIC
/begin CHARACTERISTIC Layer_ctDebTUMGStep_C "Schrittweite für Entprellzähler für TUMG Fehler" VALUE 0xEC85D Kw_Wu8 255.0 OneToOne 0.00 255.0 FORMAT "%5.1" /end CHARACTERISTIC
/begin CHARACTERISTIC Layer_ctDebBSDDef_C "Fehlerentprellzeit für Layer BSD" VALUE 0xEC85E Kw_Wu16 65535.00 OneToOne 0.00 65535.00 FORMAT "%8.2" /end CHARACTERISTIC
/begin CHARACTERISTIC Layer_ctDebBSDOk_C "Fehlerheilzeit für Layer BSD" VALUE 0xEC860 Kw_Wu16 65535.00 OneToOne 0.00 65535.00 FORMAT "%8.2" /end CHARACTERISTIC
/begin CHARACTERISTIC Layer_ctDebGENDef_C "Fehlerentprellzeit für Layer GEN" VALUE 0xEC862 Kw_Wu16 65535.00 OneToOne 0.00 65535.00 FORMAT "%8.2" /end CHARACTERISTIC
/begin CHARACTERISTIC Layer_ctDebGENOk_C "Fehlerheilzeit für Layer GEN" VALUE 0xEC864 Kw_Wu16 65535.00 OneToOne 0.00 65535.00 FORMAT "%8.2" /end CHARACTERISTIC
/begin CHARACTERISTIC Layer_ctDebIBS1Def_C "Fehlerentprellzeit für Layer IBS1" VALUE 0xEC866 Kw_Wu16 65535.00 OneToOne 0.00 65535.00 FORMAT "%8.2" /end CHARACTERISTIC
/begin CHARACTERISTIC Layer_ctDebIBS1Ok_C "Fehlerheilzeit für Layer IBS1" VALUE 0xEC868 Kw_Wu16 65535.00 OneToOne 0.00 65535.00 FORMAT "%8.2" /end CHARACTERISTIC
/begin CHARACTERISTIC Layer_ctDebIBS2Def_C "Fehlerentprellzeit für Layer IBS2" VALUE 0xEC86A Kw_Wu16 65535.00 OneToOne 0.00 65535.00 FORMAT "%8.2" /end CHARACTERISTIC
/begin CHARACTERISTIC Layer_ctDebIBS2Ok_C "Fehlerheilzeit für Layer IBS2" VALUE 0xEC86C Kw_Wu16 65535.00 OneToOne 0.00 65535.00 FORMAT "%8.2" /end CHARACTERISTIC
/begin CHARACTERISTIC Layer_ctDebIBS3Def_C "Fehlerentprellzeit für Layer IBS3" VALUE 0xEC86E Kw_Wu16 65535.00 OneToOne 0.00 65535.00 FORMAT "%8.2" /end CHARACTERISTIC
/begin CHARACTERISTIC Layer_ctDebIBS3Ok_C "Fehlerheilzeit für Layer IBS3" VALUE 0xEC870 Kw_Wu16 65535.00 OneToOne 0.00 65535.00 FORMAT "%8.2" /end CHARACTERISTIC
/begin CHARACTERISTIC Layer_ctDebMANHYDRDef_C "Fehlerentprellzeit für Layer MANHYDR" VALUE 0xEC872 Kw_Wu16 65535.00 OneToOne 0.00 65535.00 FORMAT "%8.2" /end CHARACTERISTIC
/begin CHARACTERISTIC Layer_ctDebMANHYDROk_C "Fehlerheilzeit für Layer MANHYDR" VALUE 0xEC874 Kw_Wu16 65535.00 OneToOne 0.00 65535.00 FORMAT "%8.2" /end CHARACTERISTIC
/begin CHARACTERISTIC Layer_ctDebMANLUFTDef_C "Fehlerentprellzeit für Layer MANLUFT" VALUE 0xEC876 Kw_Wu16 65535.00 OneToOne 0.00 65535.00 FORMAT "%8.2" /end CHARACTERISTIC
/begin CHARACTERISTIC Layer_ctDebMANLUFTOk_C "Fehlerheilzeit für Layer MANLUFT" VALUE 0xEC878 Kw_Wu16 65535.00 OneToOne 0.00 65535.00 FORMAT "%8.2" /end CHARACTERISTIC
/begin CHARACTERISTIC Layer_ctDebPMBATTDef_C "Fehlerentprellzeit für Layer PMBATT" VALUE 0xEC87A Kw_Wu16 65535.00 OneToOne 0.00 65535.00 FORMAT "%8.2" /end CHARACTERISTIC
/begin CHARACTERISTIC Layer_ctDebPMBATTOk_C "Fehlerheilzeit für Layer PMBATT" VALUE 0xEC87C Kw_Wu16 65535.00 OneToOne 0.00 65535.00 FORMAT "%8.2" /end CHARACTERISTIC
/begin CHARACTERISTIC Layer_ctDebPMBNDef_C "Fehlerentprellzeit für Layer PMBN" VALUE 0xEC87E Kw_Wu16 65535.00 OneToOne 0.00 65535.00 FORMAT "%8.2" /end CHARACTERISTIC
/begin CHARACTERISTIC Layer_ctDebPMBNOk_C "Fehlerheilzeit für Layer PMBN" VALUE 0xEC880 Kw_Wu16 65535.00 OneToOne 0.00 65535.00 FORMAT "%8.2" /end CHARACTERISTIC
/begin CHARACTERISTIC Layer_ctDebPMRUHVERLDef_C "Fehlerentprellzeit für Layer PMRUHVERL" VALUE 0xEC882 Kw_Wu16 65535.00 OneToOne 0.00 65535.00 FORMAT "%8.2" /end CHARACTERISTIC
/begin CHARACTERISTIC Layer_ctDebPMRUHVERLOk_C "Fehlerheilzeit für Layer PMRUHVERL" VALUE 0xEC884 Kw_Wu16 65535.00 OneToOne 0.00 65535.00 FORMAT "%8.2" /end CHARACTERISTIC
/begin CHARACTERISTIC Layer_ctDebQLTDef_C "Fehlerentprellzeit für Layer QLT" VALUE 0xEC886 Kw_Wu16 65535.00 OneToOne 0.00 65535.00 FORMAT "%8.2" /end CHARACTERISTIC
/begin CHARACTERISTIC Layer_ctDebQLTOk_C "Fehlerheilzeit für Layer QLT" VALUE 0xEC888 Kw_Wu16 65535.00 OneToOne 0.00 65535.00 FORMAT "%8.2" /end CHARACTERISTIC
/begin CHARACTERISTIC Layer_ctDebTANSDef_C "Fehlerentprellzeit für Layer TANS" VALUE 0xEC88A Kw_Wu16 65535.00 OneToOne 0.00 65535.00 FORMAT "%8.2" /end CHARACTERISTIC
/begin CHARACTERISTIC Layer_ctDebTANSOk_C "Fehlerheilzeit für Layer TANS" VALUE 0xEC88C Kw_Wu16 65535.00 OneToOne 0.00 65535.00 FORMAT "%8.2" /end CHARACTERISTIC
/begin CHARACTERISTIC Layer_ctDebTOENSDef_C "Fehlerentprellzeit für Layer TOENS" VALUE 0xEC88E Kw_Wu16 65535.00 OneToOne 0.00 65535.00 FORMAT "%8.2" /end CHARACTERISTIC
/begin CHARACTERISTIC Layer_ctDebTOENSOk_C "Fehlerheilzeit für Layer TOENS" VALUE 0xEC890 Kw_Wu16 65535.00 OneToOne 0.00 65535.00 FORMAT "%8.2" /end CHARACTERISTIC
/begin CHARACTERISTIC Layer_ctDebTUMGDef_C "Fehlerentprellzeit für Layer TUMG" VALUE 0xEC892 Kw_Wu16 65535.00 OneToOne 0.00 65535.00 FORMAT "%8.2" /end CHARACTERISTIC
/begin CHARACTERISTIC Layer_ctDebTUMGOk_C "Fehlerheilzeit für Layer TUMG" VALUE 0xEC894 Kw_Wu16 65535.00 OneToOne 0.00 65535.00 FORMAT "%8.2" /end CHARACTERISTIC
/begin CHARACTERISTIC Layer_stAirCtlBits_C "Bitmaske für AirCtl_stAirCtlBits" VALUE 0xEC818 Kw_Wu32 4294967295.00 OneToOne 0.00 4294967295.00 FORMAT "%13.2" /end CHARACTERISTIC
/begin CHARACTERISTIC Layer_stPCR_C "Bitmaske für PCR_stPCR" VALUE 0xEC81C Kw_Wu16 65535.00 OneToOne 0.00 65535.00 FORMAT "%8.2" /end CHARACTERISTIC
/begin CHARACTERISTIC Layer_swtB_bsdprot "Schalter für BSD Protokoll" VALUE 0xEC81E Kw_Wu8 255.0 OneToOne 0.00 255.0 FORMAT "%5.1" /end CHARACTERISTIC
/begin CHARACTERISTIC Layer_tiDefWrEep_C "Maximalzeit für Layer EEPROM schreiben" VALUE 0xEC820 Kw_Wu16 10000.00 Time_ms 0.00 10000.00 FORMAT "%8.2" EXTENDED_LIMITS 0.00 655350.0 /end CHARACTERISTIC
/begin CHARACTERISTIC LIGov_tiCldCltchDT1_C "Koeffizient D-Glied (T)" VALUE 0xECD10 Kw_Wu32 4294.9673 TimeDelay_s 0.0000010000000 4294.9673 FORMAT "%9.4" /end CHARACTERISTIC
/begin CHARACTERISTIC LIGov_CldCltchDKd_C "Koeffizient D-Glied (K)" VALUE 0xECD14 Kw_Ws32 6553.59999847 Kd_rpm2Nm -3276.80000000 3276.79999847 FORMAT "%13.8" /end CHARACTERISTIC
/begin CHARACTERISTIC LIGov_CldCltchFlt1T1_C "T1 Komponente für erstes PDT1-Glied wenn ausgekuppelt und Motor kalt" VALUE 0xEC898 Kw_Wu32 4294.9673 TimeDelay_s 0.0000010000000 4294.9673 FORMAT "%9.4" /end CHARACTERISTIC
/begin CHARACTERISTIC LIGov_CldCltchFlt2T1_C "T1 Komponente für zweites PDT1-Glied wenn ausgekuppelt und Motor kalt" VALUE 0xEC89C Kw_Wu32 4294.9673 TimeDelay_s 0.0000010000000 4294.9673 FORMAT "%9.4" /end CHARACTERISTIC
/begin CHARACTERISTIC LIGov_CldCltchIKi_C "Kleinsignalverstärkung" VALUE 0xEC8A0 Kw_Wu32 799999.999814 Ki_rpm2Nm 0.00 799999.999814 FORMAT "%13.6" /end CHARACTERISTIC
/begin CHARACTERISTIC LIGov_CldCltchIKiPos_C "Verstärkung für positive Großsignale" VALUE 0xEC8A4 Kw_Wu32 799999.999814 Ki_rpm2Nm 0.00 799999.999814 FORMAT "%13.6" /end CHARACTERISTIC
/begin CHARACTERISTIC LIGov_CldCltchIKiNeg_C "Verstärkung für negative Großsignale" VALUE 0xEC8A8 Kw_Wu32 799999.999814 Ki_rpm2Nm 0.00 799999.999814 FORMAT "%13.6" /end CHARACTERISTIC
/begin CHARACTERISTIC LIGov_CldCltchIWinPos_C "Kleinsignalfenster positiv" VALUE 0xEC8AC Kw_Ws16 8191.875 EngN_HiRes -4096.000 4095.875 FORMAT "%8.3" /end CHARACTERISTIC
/begin CHARACTERISTIC LIGov_CldCltchIWinNeg_C "Kleinsignalfenster negativ" VALUE 0xEC8AE Kw_Ws16 8191.875 EngN_HiRes -4096.000 4095.875 FORMAT "%8.3" /end CHARACTERISTIC
/begin CHARACTERISTIC LIGov_CldCltchPredef_C "Einschrittmoment Vorsteuerung" VALUE 0xEC8B0 Kw_Ws16 6553.500 Trq -3276.800 3276.700 FORMAT "%8.3" /end CHARACTERISTIC
/begin CHARACTERISTIC LIGov_CldCltchPKp_C "Kleinsignalverstärkung" VALUE 0xEC8B4 Kw_Wu32 52428.7999878 Kp_rpm2Nm 0.00 52428.7999878 FORMAT "%13.7" /end CHARACTERISTIC
/begin CHARACTERISTIC LIGov_CldCltchPKpPos_C "Verstärkung für positive Großsignale" VALUE 0xEC8B8 Kw_Wu32 52428.7999878 Kp_rpm2Nm 0.00 52428.7999878 FORMAT "%13.7" /end CHARACTERISTIC
/begin CHARACTERISTIC LIGov_CldCltchPKpNeg_C "Verstärkung für negative Großsignale" VALUE 0xEC8BC Kw_Wu32 52428.7999878 Kp_rpm2Nm 0.00 52428.7999878 FORMAT "%13.7" /end CHARACTERISTIC
/begin CHARACTERISTIC LIGov_CldCltchPWinPos_C "Kleinsignalfenster positiv" VALUE 0xEC8C0 Kw_Ws16 8191.875 EngN_HiRes -4096.000 4095.875 FORMAT "%8.3" /end CHARACTERISTIC
/begin CHARACTERISTIC LIGov_CldCltchPWinNeg_C "Kleinsignalfenster negativ" VALUE 0xEC8C2 Kw_Ws16 8191.875 EngN_HiRes -4096.000 4095.875 FORMAT "%8.3" /end CHARACTERISTIC
/begin CHARACTERISTIC LIGov_tiCldGearDT1_C "Koeffizient D-Glied (T)" VALUE 0xEC8C4 Kw_Wu32 4294.9673 TimeDelay_s 0.0000010000000 4294.9673 FORMAT "%9.4" /end CHARACTERISTIC
/begin CHARACTERISTIC LIGov_CldGearDKd_C "Koeffizient D-Glied (K)" VALUE 0xEC8C8 Kw_Ws32 6553.59999847 Kd_rpm2Nm -3276.80000000 3276.79999847 FORMAT "%13.8" /end CHARACTERISTIC
/begin CHARACTERISTIC LIGov_CldGearIKi_C "Kleinsignalverstärkung" VALUE 0xEC8CC Kw_Wu32 799999.999814 Ki_rpm2Nm 0.00 799999.999814 FORMAT "%13.6" /end CHARACTERISTIC
/begin CHARACTERISTIC LIGov_CldGearIKiPos_C "Verstärkung für positive Großsignale" VALUE 0xEC8D0 Kw_Wu32 799999.999814 Ki_rpm2Nm 0.00 799999.999814 FORMAT "%13.6" /end CHARACTERISTIC
/begin CHARACTERISTIC LIGov_CldGearIKiNeg_C "Verstärkung für negative Großsignale" VALUE 0xEC8D4 Kw_Wu32 799999.999814 Ki_rpm2Nm 0.00 799999.999814 FORMAT "%13.6" /end CHARACTERISTIC
/begin CHARACTERISTIC LIGov_CldGearIWinPos_C "Kleinsignalfenster positiv" VALUE 0xEC8D8 Kw_Ws16 8191.875 EngN_HiRes -4096.000 4095.875 FORMAT "%8.3" /end CHARACTERISTIC
/begin CHARACTERISTIC LIGov_CldGearIWinNeg_C "Kleinsignalfenster negativ" VALUE 0xEC8DA Kw_Ws16 8191.875 EngN_HiRes -4096.000 4095.875 FORMAT "%8.3" /end CHARACTERISTIC
/begin CHARACTERISTIC LIGov_CldGearPredef_C "Einschrittmoment Vorsteuerung" VALUE 0xEC8DC Kw_Ws16 6553.500 Trq -3276.800 3276.700 FORMAT "%8.3" /end CHARACTERISTIC
/begin CHARACTERISTIC LIGov_CldGearPKp_C "Kleinsignalverstärkung" VALUE 0xEC8E0 Kw_Wu32 52428.7999878 Kp_rpm2Nm 0.00 52428.7999878 FORMAT "%13.7" /end CHARACTERISTIC
/begin CHARACTERISTIC LIGov_CldGearPKpPos_C "Verstärkung für positive Großsignale" VALUE 0xEC8E4 Kw_Wu32 52428.7999878 Kp_rpm2Nm 0.00 52428.7999878 FORMAT "%13.7" /end CHARACTERISTIC
/begin CHARACTERISTIC LIGov_CldGearPKpNeg_C "Verstärkung für negative Großsignale" VALUE 0xEC8E8 Kw_Wu32 52428.7999878 Kp_rpm2Nm 0.00 52428.7999878 FORMAT "%13.7" /end CHARACTERISTIC
/begin CHARACTERISTIC LIGov_CldGearPWinPos_C "Kleinsignalfenster positiv" VALUE 0xEC8EC Kw_Ws16 8191.875 EngN_HiRes -4096.000 4095.875 FORMAT "%8.3" /end CHARACTERISTIC
/begin CHARACTERISTIC LIGov_CldGearPWinNeg_C "Kleinsignalfenster negativ" VALUE 0xEC8EE Kw_Ws16 8191.875 EngN_HiRes -4096.000 4095.875 FORMAT "%8.3" /end CHARACTERISTIC
/begin CHARACTERISTIC LIGov_ctNoSyncAfterPreCtrl_C "Zähler für die Sperre des M/S Abgleichs des LIGov I-Anteils nach Zustandsübergang Precontrol not locked -> locked" VALUE 0xEC8F0 Kw_Wu8 255.0 OneToOne 0.00 255.0 FORMAT "%5.1" /end CHARACTERISTIC
/begin CHARACTERISTIC LIGov_dnLimHighTrm_C "obere dn-Grenze für Abgleich" VALUE 0xECADC Kw_Ws16 65535.00 EngN -32768.00 32767.00 FORMAT "%8.2" /end CHARACTERISTIC
/begin CHARACTERISTIC LIGov_dnLimLowTrm_C "untere dn-Grenze für Abgleich" VALUE 0xECADE Kw_Ws16 65535.00 EngN -32768.00 32767.00 FORMAT "%8.2" /end CHARACTERISTIC
/begin CHARACTERISTIC LIGov_tiGear1DT1_C "Koeffizient D-Glied (T)" VALUE 0xEC8F4 Kw_Wu32 4294.9673 TimeDelay_s 0.0000010000000 4294.9673 FORMAT "%9.4" /end CHARACTERISTIC
/begin CHARACTERISTIC LIGov_Gear1DKd_C "Koeffizient D-Glied (K)" VALUE 0xEC8F8 Kw_Ws32 6553.59999847 Kd_rpm2Nm -3276.80000000 3276.79999847 FORMAT "%13.8" /end CHARACTERISTIC
/begin CHARACTERISTIC LIGov_Gear1Flt1T1_C "T1 Komponente für erstes PDT1-Glied bei Verwendung des ersten Ganges" VALUE 0xEC8FC Kw_Wu32 4294.9673 TimeDelay_s 0.0000010000000 4294.9673 FORMAT "%9.4" /end CHARACTERISTIC
/begin CHARACTERISTIC LIGov_Gear1Flt2T1_C "T1 Komponente für zweites PDT1-Glied bei Verwendung des ersten Ganges" VALUE 0xEC900 Kw_Wu32 4294.9673 TimeDelay_s 0.0000010000000 4294.9673 FORMAT "%9.4" /end CHARACTERISTIC
/begin CHARACTERISTIC LIGov_Gear1IKi_C "Kleinsignalverstärkung" VALUE 0xEC904 Kw_Wu32 799999.999814 Ki_rpm2Nm 0.00 799999.999814 FORMAT "%13.6" /end CHARACTERISTIC
/begin CHARACTERISTIC LIGov_Gear1IKiPos_C "Verstärkung für positive Großsignale" VALUE 0xEC908 Kw_Wu32 799999.999814 Ki_rpm2Nm 0.00 799999.999814 FORMAT "%13.6" /end CHARACTERISTIC
/begin CHARACTERISTIC LIGov_Gear1IKiNeg_C "Verstärkung für negative Großsignale" VALUE 0xEC90C Kw_Wu32 799999.999814 Ki_rpm2Nm 0.00 799999.999814 FORMAT "%13.6" /end CHARACTERISTIC
/begin CHARACTERISTIC LIGov_Gear1IWinPos_C "Kleinsignalfenster positiv" VALUE 0xEC910 Kw_Ws16 8191.875 EngN_HiRes -4096.000 4095.875 FORMAT "%8.3" /end CHARACTERISTIC
/begin CHARACTERISTIC LIGov_Gear1IWinNeg_C "Kleinsignalfenster negativ" VALUE 0xEC912 Kw_Ws16 8191.875 EngN_HiRes -4096.000 4095.875 FORMAT "%8.3" /end CHARACTERISTIC
/begin CHARACTERISTIC LIGov_Gear1Predef_C "Einschrittmoment Vorsteuerung" VALUE 0xEC914 Kw_Ws16 6553.500 Trq -3276.800 3276.700 FORMAT "%8.3" /end CHARACTERISTIC
/begin CHARACTERISTIC LIGov_Gear1PKp_C "Kleinsignalverstärkung" VALUE 0xEC918 Kw_Wu32 52428.7999878 Kp_rpm2Nm 0.00 52428.7999878 FORMAT "%13.7" /end CHARACTERISTIC
/begin CHARACTERISTIC LIGov_Gear1PKpPos_C "Verstärkung für positive Großsignale" VALUE 0xEC91C Kw_Wu32 52428.7999878 Kp_rpm2Nm 0.00 52428.7999878 FORMAT "%13.7" /end CHARACTERISTIC
/begin CHARACTERISTIC LIGov_Gear1PKpNeg_C "Verstärkung für negative Großsignale" VALUE 0xEC920 Kw_Wu32 52428.7999878 Kp_rpm2Nm 0.00 52428.7999878 FORMAT "%13.7" /end CHARACTERISTIC
/begin CHARACTERISTIC LIGov_Gear1PWinPos_C "Kleinsignalfenster positiv" VALUE 0xEC924 Kw_Ws16 8191.875 EngN_HiRes -4096.000 4095.875 FORMAT "%8.3" /end CHARACTERISTIC
/begin CHARACTERISTIC LIGov_Gear1PWinNeg_C "Kleinsignalfenster negativ" VALUE 0xEC926 Kw_Ws16 8191.875 EngN_HiRes -4096.000 4095.875 FORMAT "%8.3" /end CHARACTERISTIC
/begin CHARACTERISTIC LIGov_tiGear2DT1_C "Koeffizient D-Glied (T)" VALUE 0xEC928 Kw_Wu32 4294.9673 TimeDelay_s 0.0000010000000 4294.9673 FORMAT "%9.4" /end CHARACTERISTIC
/begin CHARACTERISTIC LIGov_Gear2DKd_C "Koeffizient D-Glied (K)" VALUE 0xEC92C Kw_Ws32 6553.59999847 Kd_rpm2Nm -3276.80000000 3276.79999847 FORMAT "%13.8" /end CHARACTERISTIC
/begin CHARACTERISTIC LIGov_Gear2Flt1T1_C "T1 Komponente für erstes PDT1-Glied bei Verwendung des zweiten Ganges" VALUE 0xEC930 Kw_Wu32 4294.9673 TimeDelay_s 0.0000010000000 4294.9673 FORMAT "%9.4" /end CHARACTERISTIC
/begin CHARACTERISTIC LIGov_Gear2Flt2T1_C "T1 Komponente für zweites PDT1-Glied bei Verwendung des zweiten Ganges" VALUE 0xEC934 Kw_Wu32 4294.9673 TimeDelay_s 0.0000010000000 4294.9673 FORMAT "%9.4" /end CHARACTERISTIC
/begin CHARACTERISTIC LIGov_Gear2IKi_C "Kleinsignalverstärkung" VALUE 0xEC938 Kw_Wu32 799999.999814 Ki_rpm2Nm 0.00 799999.999814 FORMAT "%13.6" /end CHARACTERISTIC
/begin CHARACTERISTIC LIGov_Gear2IKiPos_C "Verstärkung für positive Großsignale" VALUE 0xEC93C Kw_Wu32 799999.999814 Ki_rpm2Nm 0.00 799999.999814 FORMAT "%13.6" /end CHARACTERISTIC
/begin CHARACTERISTIC LIGov_Gear2IKiNeg_C "Verstärkung für negative Großsignale" VALUE 0xEC940 Kw_Wu32 799999.999814 Ki_rpm2Nm 0.00 799999.999814 FORMAT "%13.6" /end CHARACTERISTIC
/begin CHARACTERISTIC LIGov_Gear2IWinPos_C "Kleinsignalfenster positiv" VALUE 0xEC944 Kw_Ws16 8191.875 EngN_HiRes -4096.000 4095.875 FORMAT "%8.3" /end CHARACTERISTIC
/begin CHARACTERISTIC LIGov_Gear2IWinNeg_C "Kleinsignalfenster negativ" VALUE 0xEC946 Kw_Ws16 8191.875 EngN_HiRes -4096.000 4095.875 FORMAT "%8.3" /end CHARACTERISTIC
/begin CHARACTERISTIC LIGov_Gear2Predef_C "Einschrittmoment Vorsteuerung" VALUE 0xEC948 Kw_Ws16 6553.500 Trq -3276.800 3276.700 FORMAT "%8.3" /end CHARACTERISTIC
/begin CHARACTERISTIC LIGov_Gear2PKp_C "Kleinsignalverstärkung" VALUE 0xEC94C Kw_Wu32 52428.7999878 Kp_rpm2Nm 0.00 52428.7999878 FORMAT "%13.7" /end CHARACTERISTIC
/begin CHARACTERISTIC LIGov_Gear2PKpPos_C "Verstärkung für positive Großsignale" VALUE 0xEC950 Kw_Wu32 52428.7999878 Kp_rpm2Nm 0.00 52428.7999878 FORMAT "%13.7" /end CHARACTERISTIC
/begin CHARACTERISTIC LIGov_Gear2PKpNeg_C "Verstärkung für negative Großsignale" VALUE 0xEC954 Kw_Wu32 52428.7999878 Kp_rpm2Nm 0.00 52428.7999878 FORMAT "%13.7" /end CHARACTERISTIC
/begin CHARACTERISTIC LIGov_Gear2PWinPos_C "Kleinsignalfenster positiv" VALUE 0xEC958 Kw_Ws16 8191.875 EngN_HiRes -4096.000 4095.875 FORMAT "%8.3" /end CHARACTERISTIC
/begin CHARACTERISTIC LIGov_Gear2PWinNeg_C "Kleinsignalfenster negativ" VALUE 0xEC95A Kw_Ws16 8191.875 EngN_HiRes -4096.000 4095.875 FORMAT "%8.3" /end CHARACTERISTIC
/begin CHARACTERISTIC LIGov_tiGear3DT1_C "Koeffizient D-Glied (T)" VALUE 0xEC95C Kw_Wu32 4294.9673 TimeDelay_s 0.0000010000000 4294.9673 FORMAT "%9.4" /end CHARACTERISTIC
/begin CHARACTERISTIC LIGov_Gear3DKd_C "Koeffizient D-Glied (K)" VALUE 0xEC960 Kw_Ws32 6553.59999847 Kd_rpm2Nm -3276.80000000 3276.79999847 FORMAT "%13.8" /end CHARACTERISTIC
/begin CHARACTERISTIC LIGov_Gear3Flt1T1_C "T1 Komponente für erstes PDT1-Glied bei Verwendung des dritten Ganges" VALUE 0xEC964 Kw_Wu32 4294.9673 TimeDelay_s 0.0000010000000 4294.9673 FORMAT "%9.4" /end CHARACTERISTIC
/begin CHARACTERISTIC LIGov_Gear3Flt2T1_C "T1 Komponente für zweites PDT1-Glied bei Verwendung des dritten Ganges" VALUE 0xEC968 Kw_Wu32 4294.9673 TimeDelay_s 0.0000010000000 4294.9673 FORMAT "%9.4" /end CHARACTERISTIC
/begin CHARACTERISTIC LIGov_Gear3IKi_C "Kleinsignalverstärkung" VALUE 0xEC96C Kw_Wu32 799999.999814 Ki_rpm2Nm 0.00 799999.999814 FORMAT "%13.6" /end CHARACTERISTIC
/begin CHARACTERISTIC LIGov_Gear3IKiPos_C "Verstärkung für positive Großsignale" VALUE 0xEC970 Kw_Wu32 799999.999814 Ki_rpm2Nm 0.00 799999.999814 FORMAT "%13.6" /end CHARACTERISTIC
/begin CHARACTERISTIC LIGov_Gear3IKiNeg_C "Verstärkung für negative Großsignale" VALUE 0xEC974 Kw_Wu32 799999.999814 Ki_rpm2Nm 0.00 799999.999814 FORMAT "%13.6" /end CHARACTERISTIC
/begin CHARACTERISTIC LIGov_Gear3IWinPos_C "Kleinsignalfenster positiv" VALUE 0xEC978 Kw_Ws16 8191.875 EngN_HiRes -4096.000 4095.875 FORMAT "%8.3" /end CHARACTERISTIC
/begin CHARACTERISTIC LIGov_Gear3IWinNeg_C "Kleinsignalfenster negativ" VALUE 0xEC97A Kw_Ws16 8191.875 EngN_HiRes -4096.000 4095.875 FORMAT "%8.3" /end CHARACTERISTIC
/begin CHARACTERISTIC LIGov_Gear3Predef_C "Einschrittmoment Vorsteuerung" VALUE 0xEC97C Kw_Ws16 6553.500 Trq -3276.800 3276.700 FORMAT "%8.3" /end CHARACTERISTIC
/begin CHARACTERISTIC LIGov_Gear3PKp_C "Kleinsignalverstärkung" VALUE 0xEC980 Kw_Wu32 52428.7999878 Kp_rpm2Nm 0.00 52428.7999878 FORMAT "%13.7" /end CHARACTERISTIC
/begin CHARACTERISTIC LIGov_Gear3PKpPos_C "Verstärkung für positive Großsignale" VALUE 0xEC984 Kw_Wu32 52428.7999878 Kp_rpm2Nm 0.00 52428.7999878 FORMAT "%13.7" /end CHARACTERISTIC
/begin CHARACTERISTIC LIGov_Gear3PKpNeg_C "Verstärkung für negative Großsignale" VALUE 0xEC988 Kw_Wu32 52428.7999878 Kp_rpm2Nm 0.00 52428.7999878 FORMAT "%13.7" /end CHARACTERISTIC
/begin CHARACTERISTIC LIGov_Gear3PWinPos_C "Kleinsignalfenster positiv" VALUE 0xEC98C Kw_Ws16 8191.875 EngN_HiRes -4096.000 4095.875 FORMAT "%8.3" /end CHARACTERISTIC
/begin CHARACTERISTIC LIGov_Gear3PWinNeg_C "Kleinsignalfenster negativ" VALUE 0xEC98E Kw_Ws16 8191.875 EngN_HiRes -4096.000 4095.875 FORMAT "%8.3" /end CHARACTERISTIC
/begin CHARACTERISTIC LIGov_tiGear4DT1_C "Koeffizient D-Glied (T)" VALUE 0xEC990 Kw_Wu32 4294.9673 TimeDelay_s 0.0000010000000 4294.9673 FORMAT "%9.4" /end CHARACTERISTIC
/begin CHARACTERISTIC LIGov_Gear4DKd_C "Koeffizient D-Glied (K)" VALUE 0xEC994 Kw_Ws32 6553.59999847 Kd_rpm2Nm -3276.80000000 3276.79999847 FORMAT "%13.8" /end CHARACTERISTIC
/begin CHARACTERISTIC LIGov_Gear4Flt1T1_C "T1 Komponente für erstes PDT1-Glied bei Verwendung des vierte Ganges" VALUE 0xEC998 Kw_Wu32 4294.9673 TimeDelay_s 0.0000010000000 4294.9673 FORMAT "%9.4" /end CHARACTERISTIC
/begin CHARACTERISTIC LIGov_Gear4Flt2T1_C "T1 Komponente für zweites PDT1-Glied bei Verwendung des vierte Ganges" VALUE 0xEC99C Kw_Wu32 4294.9673 TimeDelay_s 0.0000010000000 4294.9673 FORMAT "%9.4" /end CHARACTERISTIC
/begin CHARACTERISTIC LIGov_Gear4IKi_C "Kleinsignalverstärkung" VALUE 0xEC9A0 Kw_Wu32 799999.999814 Ki_rpm2Nm 0.00 799999.999814 FORMAT "%13.6" /end CHARACTERISTIC
/begin CHARACTERISTIC LIGov_Gear4IKiPos_C "Verstärkung für positive Großsignale" VALUE 0xEC9A4 Kw_Wu32 799999.999814 Ki_rpm2Nm 0.00 799999.999814 FORMAT "%13.6" /end CHARACTERISTIC
/begin CHARACTERISTIC LIGov_Gear4IKiNeg_C "Verstärkung für negative Großsignale" VALUE 0xEC9A8 Kw_Wu32 799999.999814 Ki_rpm2Nm 0.00 799999.999814 FORMAT "%13.6" /end CHARACTERISTIC
/begin CHARACTERISTIC LIGov_Gear4IWinPos_C "Kleinsignalfenster positiv" VALUE 0xEC9AC Kw_Ws16 8191.875 EngN_HiRes -4096.000 4095.875 FORMAT "%8.3" /end CHARACTERISTIC
/begin CHARACTERISTIC LIGov_Gear4IWinNeg_C "Kleinsignalfenster negativ" VALUE 0xEC9AE Kw_Ws16 8191.875 EngN_HiRes -4096.000 4095.875 FORMAT "%8.3" /end CHARACTERISTIC
/begin CHARACTERISTIC LIGov_Gear4Predef_C "Einschrittmoment Vorsteuerung" VALUE 0xEC9B0 Kw_Ws16 6553.500 Trq -3276.800 3276.700 FORMAT "%8.3" /end CHARACTERISTIC
/begin CHARACTERISTIC LIGov_Gear4PKp_C "Kleinsignalverstärkung" VALUE 0xEC9B4 Kw_Wu32 52428.7999878 Kp_rpm2Nm 0.00 52428.7999878 FORMAT "%13.7" /end CHARACTERISTIC
/begin CHARACTERISTIC LIGov_Gear4PKpPos_C "Verstärkung für positive Großsignale" VALUE 0xEC9B8 Kw_Wu32 52428.7999878 Kp_rpm2Nm 0.00 52428.7999878 FORMAT "%13.7" /end CHARACTERISTIC
/begin CHARACTERISTIC LIGov_Gear4PKpNeg_C "Verstärkung für negative Großsignale" VALUE 0xEC9BC Kw_Wu32 52428.7999878 Kp_rpm2Nm 0.00 52428.7999878 FORMAT "%13.7" /end CHARACTERISTIC
/begin CHARACTERISTIC LIGov_Gear4PWinPos_C "Kleinsignalfenster positiv" VALUE 0xEC9C0 Kw_Ws16 8191.875 EngN_HiRes -4096.000 4095.875 FORMAT "%8.3" /end CHARACTERISTIC
/begin CHARACTERISTIC LIGov_Gear4PWinNeg_C "Kleinsignalfenster negativ" VALUE 0xEC9C2 Kw_Ws16 8191.875 EngN_HiRes -4096.000 4095.875 FORMAT "%8.3" /end CHARACTERISTIC
/begin CHARACTERISTIC LIGov_tiGear5DT1_C "Koeffizient D-Glied (T)" VALUE 0xEC9C4 Kw_Wu32 4294.9673 TimeDelay_s 0.0000010000000 4294.9673 FORMAT "%9.4" /end CHARACTERISTIC
/begin CHARACTERISTIC LIGov_Gear5DKd_C "Koeffizient D-Glied (K)" VALUE 0xEC9C8 Kw_Ws32 6553.59999847 Kd_rpm2Nm -3276.80000000 3276.79999847 FORMAT "%13.8" /end CHARACTERISTIC
/begin CHARACTERISTIC LIGov_Gear5Flt1T1_C "T1 Komponente für erstes PDT1-Glied bei Verwendung des fünften Ganges" VALUE 0xEC9CC Kw_Wu32 4294.9673 TimeDelay_s 0.0000010000000 4294.9673 FORMAT "%9.4" /end CHARACTERISTIC
/begin CHARACTERISTIC LIGov_Gear5Flt2T1_C "T1 Komponente für zweites PDT1-Glied bei Verwendung des fünften Ganges" VALUE 0xEC9D0 Kw_Wu32 4294.9673 TimeDelay_s 0.0000010000000 4294.9673 FORMAT "%9.4" /end CHARACTERISTIC
/begin CHARACTERISTIC LIGov_Gear5IKi_C "Kleinsignalverstärkung" VALUE 0xEC9D4 Kw_Wu32 799999.999814 Ki_rpm2Nm 0.00 799999.999814 FORMAT "%13.6" /end CHARACTERISTIC
/begin CHARACTERISTIC LIGov_Gear5IKiPos_C "Verstärkung für positive Großsignale" VALUE 0xEC9D8 Kw_Wu32 799999.999814 Ki_rpm2Nm 0.00 799999.999814 FORMAT "%13.6" /end CHARACTERISTIC
/begin CHARACTERISTIC LIGov_Gear5IKiNeg_C "Verstärkung für negative Großsignale" VALUE 0xEC9DC Kw_Wu32 799999.999814 Ki_rpm2Nm 0.00 799999.999814 FORMAT "%13.6" /end CHARACTERISTIC
/begin CHARACTERISTIC LIGov_Gear5IWinPos_C "Kleinsignalfenster positiv" VALUE 0xEC9E0 Kw_Ws16 8191.875 EngN_HiRes -4096.000 4095.875 FORMAT "%8.3" /end CHARACTERISTIC
/begin CHARACTERISTIC LIGov_Gear5IWinNeg_C "Kleinsignalfenster negativ" VALUE 0xEC9E2 Kw_Ws16 8191.875 EngN_HiRes -4096.000 4095.875 FORMAT "%8.3" /end CHARACTERISTIC
/begin CHARACTERISTIC LIGov_Gear5Predef_C "Einschrittmoment Vorsteuerung" VALUE 0xEC9E4 Kw_Ws16 6553.500 Trq -3276.800 3276.700 FORMAT "%8.3" /end CHARACTERISTIC
/begin CHARACTERISTIC LIGov_Gear5PKp_C "Kleinsignalverstärkung" VALUE 0xEC9E8 Kw_Wu32 52428.7999878 Kp_rpm2Nm 0.00 52428.7999878 FORMAT "%13.7" /end CHARACTERISTIC
/begin CHARACTERISTIC LIGov_Gear5PKpPos_C "Verstärkung für positive Großsignale" VALUE 0xEC9EC Kw_Wu32 52428.7999878 Kp_rpm2Nm 0.00 52428.7999878 FORMAT "%13.7" /end CHARACTERISTIC
/begin CHARACTERISTIC LIGov_Gear5PKpNeg_C "Verstärkung für negative Großsignale" VALUE 0xEC9F0 Kw_Wu32 52428.7999878 Kp_rpm2Nm 0.00 52428.7999878 FORMAT "%13.7" /end CHARACTERISTIC
/begin CHARACTERISTIC LIGov_Gear5PWinPos_C "Kleinsignalfenster positiv" VALUE 0xEC9F4 Kw_Ws16 8191.875 EngN_HiRes -4096.000 4095.875 FORMAT "%8.3" /end CHARACTERISTIC
/begin CHARACTERISTIC LIGov_Gear5PWinNeg_C "Kleinsignalfenster negativ" VALUE 0xEC9F6 Kw_Ws16 8191.875 EngN_HiRes -4096.000 4095.875 FORMAT "%8.3" /end CHARACTERISTIC
/begin CHARACTERISTIC LIGov_tiGear6DT1_C "Koeffizient D-Glied (T)" VALUE 0xEC9F8 Kw_Wu32 4294.9673 TimeDelay_s 0.0000010000000 4294.9673 FORMAT "%9.4" /end CHARACTERISTIC
/begin CHARACTERISTIC LIGov_Gear6DKd_C "Koeffizient D-Glied (K)" VALUE 0xEC9FC Kw_Ws32 6553.59999847 Kd_rpm2Nm -3276.80000000 3276.79999847 FORMAT "%13.8" /end CHARACTERISTIC
/begin CHARACTERISTIC LIGov_Gear6Flt1T1_C "T1 Komponente für erstes PDT1-Glied bei Verwendung des sechsten Ganges" VALUE 0xECA00 Kw_Wu32 4294.9673 TimeDelay_s 0.0000010000000 4294.9673 FORMAT "%9.4" /end CHARACTERISTIC
/begin CHARACTERISTIC LIGov_Gear6Flt2T1_C "T1 Komponente für zweites PDT1-Glied bei Verwendung des sechsten Ganges" VALUE 0xECA04 Kw_Wu32 4294.9673 TimeDelay_s 0.0000010000000 4294.9673 FORMAT "%9.4" /end CHARACTERISTIC
/begin CHARACTERISTIC LIGov_Gear6IKi_C "Kleinsignalverstärkung" VALUE 0xECA08 Kw_Wu32 799999.999814 Ki_rpm2Nm 0.00 799999.999814 FORMAT "%13.6" /end CHARACTERISTIC
/begin CHARACTERISTIC LIGov_Gear6IKiPos_C "Verstärkung für positie Großsingnale" VALUE 0xECA0C Kw_Wu32 799999.999814 Ki_rpm2Nm 0.00 799999.999814 FORMAT "%13.6" /end CHARACTERISTIC
/begin CHARACTERISTIC LIGov_Gear6IKiNeg_C "Verstärkung für negative Großsignale" VALUE 0xECA10 Kw_Wu32 799999.999814 Ki_rpm2Nm 0.00 799999.999814 FORMAT "%13.6" /end CHARACTERISTIC
/begin CHARACTERISTIC LIGov_Gear6IWinPos_C "Kleinsignalfenster positiv" VALUE 0xECA14 Kw_Ws16 8191.875 EngN_HiRes -4096.000 4095.875 FORMAT "%8.3" /end CHARACTERISTIC
/begin CHARACTERISTIC LIGov_Gear6IWinNeg_C "Kleinsignalfenster negativ" VALUE 0xECA16 Kw_Ws16 8191.875 EngN_HiRes -4096.000 4095.875 FORMAT "%8.3" /end CHARACTERISTIC
/begin CHARACTERISTIC LIGov_Gear6Predef_C "Einschrittmoment Vorsteuerung" VALUE 0xECA18 Kw_Ws16 6553.500 Trq -3276.800 3276.700 FORMAT "%8.3" /end CHARACTERISTIC
/begin CHARACTERISTIC LIGov_Gear6PKp_C "Kleinsignalverstärkung" VALUE 0xECA1C Kw_Wu32 52428.7999878 Kp_rpm2Nm 0.00 52428.7999878 FORMAT "%13.7" /end CHARACTERISTIC
/begin CHARACTERISTIC LIGov_Gear6PKpPos_C "Verstärkung für positive Großsignale" VALUE 0xECA20 Kw_Wu32 52428.7999878 Kp_rpm2Nm 0.00 52428.7999878 FORMAT "%13.7" /end CHARACTERISTIC
/begin CHARACTERISTIC LIGov_Gear6PKpNeg_C "Verstärkung für negative Großsignale" VALUE 0xECA24 Kw_Wu32 52428.7999878 Kp_rpm2Nm 0.00 52428.7999878 FORMAT "%13.7" /end CHARACTERISTIC
/begin CHARACTERISTIC LIGov_Gear6PWinPos_C "Kleinsignalfenster positiv" VALUE 0xECA28 Kw_Ws16 8191.875 EngN_HiRes -4096.000 4095.875 FORMAT "%8.3" /end CHARACTERISTIC
/begin CHARACTERISTIC LIGov_Gear6PWinNeg_C "Kleinsignalfenster negativ" VALUE 0xECA2A Kw_Ws16 8191.875 EngN_HiRes -4096.000 4095.875 FORMAT "%8.3" /end CHARACTERISTIC
/begin CHARACTERISTIC LIGov_nDeltaSec_C "Delta allgemein zu Drehzahlschwelle Sicherheitsrampe" VALUE 0xECAE0 Kw_Ws16 32767.00 EngN 0.00 32767.00 FORMAT "%8.2" EXTENDED_LIMITS -32768.00 32767.00 /end CHARACTERISTIC
/begin CHARACTERISTIC LIGov_nDflTrmVal_C "Datensatz-Abgleichwert" VALUE 0xECA2C Kw_Ws16 65535.00 EngN -32768.00 32767.00 FORMAT "%8.2" /end CHARACTERISTIC
/begin CHARACTERISTIC LIGov_nDHypDenom_C "Nennerparameter für Hyperbel zur Aufschaltung LLR D-Anteil" VALUE 0xECA2E Kw_Ws16 32766.00 EngN 1.000000 32767.00 FORMAT "%8.2" EXTENDED_LIMITS -32768.00 32767.00 /end CHARACTERISTIC
/begin CHARACTERISTIC LIGov_nDHypNum_C "Zählerparameter für Hyperbel zur Aufschaltung LLR D-Anteil" VALUE 0xECA30 Kw_Ws16 65535.00 EngN -32768.00 32767.00 FORMAT "%8.2" /end CHARACTERISTIC
/begin CHARACTERISTIC LIGov_nDiffDelta_C "Delta zur Drehzahlschwelle Sicherheitsrampe" VALUE 0xECAE2 Kw_Ws16 32767.00 EngN 0.00 32767.00 FORMAT "%8.2" EXTENDED_LIMITS -32768.00 32767.00 /end CHARACTERISTIC
/begin CHARACTERISTIC LIGov_nHDC_C "Applizierbare LL-Solldrehzahl aufgrund HDC" VALUE 0xECAE4 Kw_Ws16 32767.00 EngN 0.00 32767.00 FORMAT "%8.2" EXTENDED_LIMITS -32768.00 32767.00 /end CHARACTERISTIC
/begin CHARACTERISTIC LIGov_nLimHighOfs_C "Offset from the high engine speed limit for low-idle governor" VALUE 0xECAE6 Kw_Ws16 32767.00 EngN 0.00 32767.00 FORMAT "%8.2" EXTENDED_LIMITS -32768.00 32767.00 /end CHARACTERISTIC
/begin CHARACTERISTIC LIGov_nLimHighPrst_C "Obere Begrenzung auf die niedrige Leerlaufdrehzahl Standardwert für Energieeinsparung-Transportmodus" VALUE 0xECAE8 Kw_Ws16 65535.00 EngN -32768.00 32767.00 FORMAT "%8.2" /end CHARACTERISTIC
/begin CHARACTERISTIC LIGov_nLimHighTrmAct_C "Überdrehzahllimit Trimmung für den Leerlaufregler" VALUE 0xECAEA Kw_Ws16 65535.00 EngN -32768.00 32767.00 FORMAT "%8.2" /end CHARACTERISTIC
/begin CHARACTERISTIC LIGov_nLimHigh_C "obere Drehzahlgrenze für LLR" VALUE 0xECA32 Kw_Ws16 65535.00 EngN -32768.00 32767.00 FORMAT "%8.2" /end CHARACTERISTIC
/begin CHARACTERISTIC LIGov_nLimLowPrst_C "Unterere Grenze auf die niedrige Leerlaufdrehzahl Standardwert für Energieeinsparung-Transportmodus" VALUE 0xECAEC Kw_Ws16 65535.00 EngN -32768.00 32767.00 FORMAT "%8.2" /end CHARACTERISTIC
/begin CHARACTERISTIC LIGov_nLimLow_C "untere Drehzahlgrenze für LLR" VALUE 0xECA34 Kw_Ws16 65535.00 EngN -32768.00 32767.00 FORMAT "%8.2" /end CHARACTERISTIC
/begin CHARACTERISTIC LIGov_nMSDiffMax_C "Max zulässige Differenz zwischen Master Solldrehzahl und der vom Slave berechneten Solldrehzahl" VALUE 0xECA36 Kw_Ws16 5960.000 EngN 40.00000 6000.000 FORMAT "%8.3" EXTENDED_LIMITS -32768.00 32767.00 /end CHARACTERISTIC
/begin CHARACTERISTIC LIGov_nOffsetPreCtrltrqDem_C "Vorsteuerung aktiv n-Offset auf Basisdrehzahl und Momentenwunsch" VALUE 0xECA38 Kw_Ws16 65535.00 EngN -32768.00 32767.00 FORMAT "%8.2" /end CHARACTERISTIC
/begin CHARACTERISTIC LIGov_nOffsetPreCtrl_C "Vorsteuerung aktiv n-Offset auf Basisdrehzahl" VALUE 0xECA3A Kw_Ws16 65535.00 EngN -32768.00 32767.00 FORMAT "%8.2" /end CHARACTERISTIC
/begin CHARACTERISTIC LIGov_nOffsetPredef_C "Einschrittmoment aktiv n-Offset auf Basisdrehzahl" VALUE 0xECA3C Kw_Ws16 65535.00 EngN -32768.00 32767.00 FORMAT "%8.2" /end CHARACTERISTIC
/begin CHARACTERISTIC LIGov_nOffsetUbr_C "Drehzahlschwelle für Erkennung für Leerlaufregler-Zustand Unterbremsen" VALUE 0xECA3E Kw_Ws16 65535.00 EngN -32768.00 32767.00 FORMAT "%8.2" /end CHARACTERISTIC
/begin CHARACTERISTIC LIGov_nRmpBaseDwn_C "Schrittweite der Rampe bei Absenkung LL-Solldrehzahl aus LL-Grundfunktion" VALUE 0xECAEE Kw_Ws16 32767.00 dn_dZfine 0.00 32767.00 FORMAT "%8.2" EXTENDED_LIMITS -32768.00 32767.00 /end CHARACTERISTIC
/begin CHARACTERISTIC LIGov_nRmpBaseUp_C "Schrittweite der Rampe bei Erhöhung LL-Solldrehzahl aus LL-Grundfunktion" VALUE 0xECAF0 Kw_Ws16 32767.00 dn_dZfine 0.00 32767.00 FORMAT "%8.2" EXTENDED_LIMITS -32768.00 32767.00 /end CHARACTERISTIC
/begin CHARACTERISTIC LIGov_nRmpCoEngDwn_C "Schrittweite der Rampe bei Absenkung LL-Solldrehzahl aus CoEng_nMin" VALUE 0xECAF2 Kw_Ws16 32767.00 dn_dZfine 0.00 32767.00 FORMAT "%8.2" EXTENDED_LIMITS -32768.00 32767.00 /end CHARACTERISTIC
/begin CHARACTERISTIC LIGov_nRmpCoEngUp_C "Schrittweite der Rampe bei Erhöhung LL-Solldrehzahl aus CoEng_nMin" VALUE 0xECAF4 Kw_Ws16 32767.00 dn_dZfine 0.00 32767.00 FORMAT "%8.2" EXTENDED_LIMITS -32768.00 32767.00 /end CHARACTERISTIC
/begin CHARACTERISTIC LIGov_nRmpCutOutUp_C "Ramp by raising setpoint" VALUE 0xECAF8 Kw_Wu32 65535999.9847 RmpEngN 0.00 65535999.9847 FORMAT "%13.4" /end CHARACTERISTIC
/begin CHARACTERISTIC LIGov_nRmpCutOutDwn_C "Ramp by lowing setpoint" VALUE 0xECAFC Kw_Wu32 65535999.9847 RmpEngN 0.00 65535999.9847 FORMAT "%13.4" /end CHARACTERISTIC
/begin CHARACTERISTIC LIGov_nRmpGearbxDwn_C "Schrittweite der Rampe bei Absenkung LL-Solldrehzahl aus Getriebe" VALUE 0xECB00 Kw_Ws16 32767.00 dn_dZfine 0.00 32767.00 FORMAT "%8.2" EXTENDED_LIMITS -32768.00 32767.00 /end CHARACTERISTIC
/begin CHARACTERISTIC LIGov_nRmpGearbxUp_C "Schrittweite der Rampe bei Absenkung LL-Solldrehzahl aus Getriebe" VALUE 0xECB02 Kw_Ws16 32767.00 dn_dZfine 0.00 32767.00 FORMAT "%8.2" EXTENDED_LIMITS -32768.00 32767.00 /end CHARACTERISTIC
/begin CHARACTERISTIC LIGov_nRmpHDCDwn_C "Drehzahl Rampenschritt für HDC Eingriff - fallende Drehzahl" VALUE 0xECB04 Kw_Ws16 32767.00 dn_dZfine 0.00 32767.00 FORMAT "%8.2" EXTENDED_LIMITS -32768.00 32767.00 /end CHARACTERISTIC
/begin CHARACTERISTIC LIGov_nRmpHDCUp_C "Drehzahl Rampenschrittweite des HDC-Eingriffes - steigende Drehzahl" VALUE 0xECB06 Kw_Ws16 32767.00 dn_dZfine 0.00 32767.00 FORMAT "%8.2" EXTENDED_LIMITS -32768.00 32767.00 /end CHARACTERISTIC
/begin CHARACTERISTIC LIGov_nRmpPwrMngDwn_C "Schrittweite der Rampe bei Absenkung LL-Solldrehzahl aus Getriebe" VALUE 0xECB08 Kw_Ws16 32767.00 dn_dZfine 0.00 32767.00 FORMAT "%8.2" EXTENDED_LIMITS -32768.00 32767.00 /end CHARACTERISTIC
/begin CHARACTERISTIC LIGov_nRmpPwrMngUp_C "Schrittweite der Rampe bei Absenkung LL-Solldrehzahl aus PwrMng" VALUE 0xECB0A Kw_Ws16 32767.00 dn_dZfine 0.00 32767.00 FORMAT "%8.2" EXTENDED_LIMITS -32768.00 32767.00 /end CHARACTERISTIC
/begin CHARACTERISTIC LIGov_nRmpSecDelta_C "Schrittweite der SicherheitsRampe bei Erhöhung LL-Solldrehzahl" VALUE 0xECB0C Kw_Ws16 32767.00 dn_dZfine 0.00 32767.00 FORMAT "%8.2" EXTENDED_LIMITS -32768.00 32767.00 /end CHARACTERISTIC
/begin CHARACTERISTIC LIGov_nRmpSurgeDwn_C "Schrittweite der Rampe bei Absenkung LL-Solldrehzahl aus AntiSurge" VALUE 0xECB0E Kw_Ws16 32767.00 dn_dZfine 0.00 32767.00 FORMAT "%8.2" EXTENDED_LIMITS -32768.00 32767.00 /end CHARACTERISTIC
/begin CHARACTERISTIC LIGov_nRmpSurgeUp_C "Schrittweite der Rampe bei Erhöhung LL-Solldrehzahl aus AntiSurge" VALUE 0xECB10 Kw_Ws16 32767.00 dn_dZfine 0.00 32767.00 FORMAT "%8.2" EXTENDED_LIMITS -32768.00 32767.00 /end CHARACTERISTIC
/begin CHARACTERISTIC LIGov_nSetpointDia_C "Sollwert des LLR über Diagnoseschnittstelle" VALUE 0xECB12 Kw_Ws16 32767.00 EngN 0.00 32767.00 FORMAT "%8.2" EXTENDED_LIMITS -32768.00 32767.00 /end CHARACTERISTIC
/begin CHARACTERISTIC LIGov_nSetpointDriveAway_C "LL-Solldrehzahl Fahrzeug fährt (V > 0)" VALUE 0xECB14 Kw_Ws16 65535.00 EngN -32768.00 32767.00 FORMAT "%8.2" /end CHARACTERISTIC
/begin CHARACTERISTIC LIGov_nSetpointInit2_MAP "Initialisierungskennfeld des Leerlaufreglers - abhängig von der Kühlmitteltemperatur und dem Atmosphärendruck" MAP 0xECB16 Kf_Xs16_Ys16_Ws16 6000.000 EngN 0.00 6000.000 FORMAT "%8.3" EXTENDED_LIMITS -32768.00 32767.00
 /begin AXIS_DESCR STD_AXIS CTSCD_tClnt Temp_Cels 8 -50.1400 199.8600 FORMAT "%8.4" EXTENDED_LIMITS -3549.940 3003.560 DEPOSIT ABSOLUTE /end AXIS_DESCR
 /begin AXIS_DESCR STD_AXIS APSCD_pVal Pres_hPa 8 0.00 3500.0000 FORMAT "%8.4" EXTENDED_LIMITS -32768.00 32767.00 DEPOSIT ABSOLUTE /end AXIS_DESCR
/end CHARACTERISTIC
/begin CHARACTERISTIC LIGov_nSetpointInit_MAP "Initialisierungskennfeld zur Berechnung der Leerlaufsolldrehzahl" MAP 0xECBBA Kf_Xs16_Ys16_Ws16 6000.000 EngN 0.00 6000.000 FORMAT "%8.3" EXTENDED_LIMITS -32768.00 32767.00
 /begin AXIS_DESCR STD_AXIS CTSCD_tClnt Temp_Cels 8 -50.1400 199.8600 FORMAT "%8.4" EXTENDED_LIMITS -3549.940 3003.560 DEPOSIT ABSOLUTE /end AXIS_DESCR
 /begin AXIS_DESCR STD_AXIS APSCD_pVal Pres_hPa 8 0.00 3500.0000 FORMAT "%8.4" EXTENDED_LIMITS -32768.00 32767.00 DEPOSIT ABSOLUTE /end AXIS_DESCR
/end CHARACTERISTIC
/begin CHARACTERISTIC LIGov_nSetpointTrmLim_C "Schwelle für LL-Drehzahlanhebungserkennung" VALUE 0xECC5E Kw_Ws16 65535.00 EngN -32768.00 32767.00 FORMAT "%8.2" /end CHARACTERISTIC
/begin CHARACTERISTIC LIGov_nSetpointTrm_C "Ersatzwert für LL-Drehzahlanhebung" VALUE 0xECC60 Kw_Ws16 65535.00 EngN -32768.00 32767.00 FORMAT "%8.2" /end CHARACTERISTIC
/begin CHARACTERISTIC LIGov_nSetPointWarm_C "LL-Solldrehzahl Fahrzeug steht / warmer Motor" VALUE 0xECC62 Kw_Ws16 65535.00 EngN -32768.00 32767.00 FORMAT "%8.2" /end CHARACTERISTIC
/begin CHARACTERISTIC LIGov_nSetpoint_Vector "Bypass label, nicht editieren" VALUE 0xC3990 Kw_Wu8 255.0 OneToOne 0.00 255.0 FORMAT "%5.1" /end CHARACTERISTIC
/begin CHARACTERISTIC LIGov_nSetpoint_Channel "Bypass Label, nicht editieren!" VALUE 0xC3991 Kw_Wu8 255.0 OneToOne 0.00 255.0 FORMAT "%5.1" /end CHARACTERISTIC
/begin CHARACTERISTIC LIGov_rAPPThresFreezeI_C "Schwelle für PWG-Wert zum Rücksetzen des LLR Status ""freezeI""" VALUE 0xECA40 Kw_Ws16 100.0000 Prc 0.00 100.0000 FORMAT "%8.4" EXTENDED_LIMITS -400.0000 399.9878 /end CHARACTERISTIC
/begin CHARACTERISTIC LIGov_rAPPThresTrqDem_C "Schwelle für PWG-Wert zum Rücksetzen des LLR Status ""torque demand""" VALUE 0xECA42 Kw_Ws16 100.0000 Prc 0.00 100.0000 FORMAT "%8.4" EXTENDED_LIMITS -400.0000 399.9878 /end CHARACTERISTIC
/begin CHARACTERISTIC LIGov_stActiveHDC_C "Applizierbarer Zustand für aktivierte LL-Solldrehzahl aufgrund HDC" VALUE 0xECC64 Kw_Wu8 3.000 OneToOne 0.00 3.000 FORMAT "%5.3" EXTENDED_LIMITS 0.00 255.0 /end CHARACTERISTIC
/begin CHARACTERISTIC LIGov_stPsRev_C "Wählt Paramtersatz für Rückwärtsgang (1 entspricht PS 1.Gang, 2 entspricht PS 2.Gang)" VALUE 0xECA44 Kw_Ws8 1.000 OneToOne 1.000 2.000 FORMAT "%5.3" EXTENDED_LIMITS -128.0 127.0 /end CHARACTERISTIC
/begin CHARACTERISTIC LIGov_stReleaseHDC_C "Bitweises Freischalten der LL-Solldrehzahl aufgrund HDC über CAN" VALUE 0xECC65 Kw_Wu8 127.0 OneToOne 0.00 127.0 FORMAT "%5.1" EXTENDED_LIMITS 0.00 255.0 /end CHARACTERISTIC
/begin CHARACTERISTIC LIGov_swtAPPFreezeI_C "Schalter für die Auswahl gefilterter (0) oder ungefilterter (1) PWG-Wert für die Entscheidung des LLR-Status ""freezeI""" VALUE 0xECA45 Kw_Wu8 1.000 OneToOne 0.00 1.000 FORMAT "%5.3" EXTENDED_LIMITS 0.00 255.0 /end CHARACTERISTIC
/begin CHARACTERISTIC LIGov_swtAPPTrqDem_C "Schalter für die Auswahl gefilterter (0) oder ungefilterter (1) PWG-Wert für die Entscheidung des LLR-Status ""torque demanded""" VALUE 0xECA46 Kw_Wu8 1.000 OneToOne 0.00 1.000 FORMAT "%5.3" EXTENDED_LIMITS 0.00 255.0 /end CHARACTERISTIC
/begin CHARACTERISTIC LIGov_swtGear_C "Konstante zur Auswahl des Initialisierungsfeldes der Leerlaufdrehzahl" VALUE 0xECC66 Kw_Wu8 255.0 OneToOne 0.00 255.0 FORMAT "%5.1" /end CHARACTERISTIC
/begin CHARACTERISTIC LIGov_swtInitPreCtrlNotLck_C "Startzustand des LLR Zustands ""Vorsteuerung nicht gesperrt"" (0: nicht gesperrt, 1: gesperrt)" VALUE 0xECA47 Kw_Wu8 1.000 OneToOne 0.00 1.000 FORMAT "%5.3" EXTENDED_LIMITS 0.00 255.0 /end CHARACTERISTIC
/begin CHARACTERISTIC LIGov_tClntXLow_C "Schwelle 1 für Wassertemperaturhysterese" VALUE 0xECA48 Kw_Ws16 250.0000 Temp_Cels -50.14000 199.8600 FORMAT "%8.4" EXTENDED_LIMITS -3549.940 3003.560 /end CHARACTERISTIC
/begin CHARACTERISTIC LIGov_tClntXHigh_C "Schwelle 2 für Wassertemperaturhysterese" VALUE 0xECA4A Kw_Ws16 250.0000 Temp_Cels -50.14000 199.8600 FORMAT "%8.4" EXTENDED_LIMITS -3549.940 3003.560 /end CHARACTERISTIC
/begin CHARACTERISTIC LIGov_stCold_C "Konstante für LiGov Status kalt" VALUE 0xECA4C Kw_Ws16 65535.00 OneToOne -32768.00 32767.00 FORMAT "%8.2" READ_ONLY /end CHARACTERISTIC
/begin CHARACTERISTIC LIGov_stWarm_C "Konstante für LIGov Status warm" VALUE 0xECA4E Kw_Ws16 65535.00 OneToOne -32768.00 32767.00 FORMAT "%8.2" READ_ONLY /end CHARACTERISTIC
/begin CHARACTERISTIC LIGov_tiDelCutOut_C "delay time after CoEng_stEng moves from status COENG_STSTART to COENG_STNORMAL" VALUE 0xECA50 Kw_Wu16 2000.000 Time_ms 0.00 2000.000 FORMAT "%8.3" EXTENDED_LIMITS 0.00 655350.0 /end CHARACTERISTIC
/begin CHARACTERISTIC LIGov_tiPT1_CUR "Kennlinie der Zeitkonstanten für die PT1 Flterung über der Drehzahl" CURVE 0xECA52 Kl_Xs16_Ws16 5.000000 TimeDelay_s_Lin_16 0.00 5.000000 FORMAT "%8.6" EXTENDED_LIMITS -5.000153 5.000000
 /begin AXIS_DESCR STD_AXIS LIGov_nDiff_mp EngN 8 -5000.000 1000.000 FORMAT "%8.3" EXTENDED_LIMITS -32768.00 32767.00 DEPOSIT ABSOLUTE /end AXIS_DESCR
/end CHARACTERISTIC
/begin CHARACTERISTIC LIGov_tiTW_C "Zeit nach Start für T_W-abh. LL-Solldrehzahl" VALUE 0xECC68 Kw_Wu16 655.3500 Time_s 0.00 655.3500 FORMAT "%8.4" /end CHARACTERISTIC
/begin CHARACTERISTIC LIGov_trqInitI_MAP "Kennfeld zur integrator Initialisierung" MAP 0xECC6A Kf_Xs16_Ys16_Ws16 400.0000 Trq 0.00 400.0000 FORMAT "%8.4" EXTENDED_LIMITS -3276.800 3276.700
 /begin AXIS_DESCR STD_AXIS CTSCD_tClnt Temp_Cels 8 -50.1400 899.8600 FORMAT "%8.4" EXTENDED_LIMITS -3549.940 3003.560 DEPOSIT ABSOLUTE /end AXIS_DESCR
 /begin AXIS_DESCR STD_AXIS APSCD_pVal Pres_hPa 8 0.00 3500.000 FORMAT "%8.3" EXTENDED_LIMITS -32768.00 32767.00 DEPOSIT ABSOLUTE /end AXIS_DESCR
/end CHARACTERISTIC
/begin CHARACTERISTIC LIGov_trqMax_CUR "Wassertemperaturabhängiges Begrenzungsmoment für den LLR" CURVE 0xECA74 Kl_Xs16_Ws16 400.0000 Trq 0.00 400.0000 FORMAT "%8.4" EXTENDED_LIMITS -3276.800 3276.700
 /begin AXIS_DESCR STD_AXIS Eng_nAvrg EngN 8 -32768.00 32767.00 FORMAT "%8.2" DEPOSIT ABSOLUTE /end AXIS_DESCR
/end CHARACTERISTIC
/begin CHARACTERISTIC LIGov_trqSetMax_C "Maximale begrenze fuer Moment anforderung über Diagnose für NMK Schnellernen" VALUE 0xECA96 Kw_Ws16 70.00000 Trq 0.00 70.00000 FORMAT "%8.5" EXTENDED_LIMITS -3276.800 3276.700 /end CHARACTERISTIC
/begin CHARACTERISTIC LIGov_trqThresDefrostI_C "Mengenschwelle Integrator einfrieren/auftauen" VALUE 0xECA98 Kw_Ws16 6553.500 Trq -3276.800 3276.700 FORMAT "%8.3" /end CHARACTERISTIC
/begin CHARACTERISTIC LIGov_trq_Vector "Bypasslabel, nicht editieren!" VALUE 0xC3992 Kw_Wu8 255.0 OneToOne 0.00 255.0 FORMAT "%5.1" /end CHARACTERISTIC
/begin CHARACTERISTIC LIGov_trq_Channel "Bypasslabel, nicht editieren!" VALUE 0xC3993 Kw_Wu8 255.0 OneToOne 0.00 255.0 FORMAT "%5.1" /end CHARACTERISTIC
/begin CHARACTERISTIC LIGov_UbrPKp_C "Kleinsignalverstärkung" VALUE 0xECA9C Kw_Wu32 52428.7999878 Kp_rpm2Nm 0.00 52428.7999878 FORMAT "%13.7" /end CHARACTERISTIC
/begin CHARACTERISTIC LIGov_UbrPKpPos_C "Verstärkung für positive Großsignale" VALUE 0xECAA0 Kw_Wu32 52428.7999878 Kp_rpm2Nm 0.00 52428.7999878 FORMAT "%13.7" /end CHARACTERISTIC
/begin CHARACTERISTIC LIGov_UbrPKpNeg_C "Verstärkung für negative Großsignale" VALUE 0xECAA4 Kw_Wu32 52428.7999878 Kp_rpm2Nm 0.00 52428.7999878 FORMAT "%13.7" /end CHARACTERISTIC
/begin CHARACTERISTIC LIGov_UbrPWinPos_C "Kleinsignalfenster positiv" VALUE 0xECAA8 Kw_Ws16 8191.875 EngN_HiRes -4096.000 4095.875 FORMAT "%8.3" /end CHARACTERISTIC
/begin CHARACTERISTIC LIGov_UbrPWinNeg_C "Kleinsignalfenster negativ" VALUE 0xECAAA Kw_Ws16 8191.875 EngN_HiRes -4096.000 4095.875 FORMAT "%8.3" /end CHARACTERISTIC
/begin CHARACTERISTIC LIGov_vThresUbr_C "Schwellgeschwindigkeit bei Unterbremsen" VALUE 0xECAAC Kw_Ws16 655.3500 Vel -327.6800 327.6700 FORMAT "%8.4" /end CHARACTERISTIC
/begin CHARACTERISTIC LIGov_tiWrmCltchDT1_C "Koeffizient D-Glied (T)" VALUE 0xECD18 Kw_Wu32 4294.9673 TimeDelay_s 0.0000010000000 4294.9673 FORMAT "%9.4" /end CHARACTERISTIC
/begin CHARACTERISTIC LIGov_WrmCltchDKd_C "Koeffizient D-Glied (K)" VALUE 0xECD1C Kw_Ws32 6553.59999847 Kd_rpm2Nm -3276.80000000 3276.79999847 FORMAT "%13.8" /end CHARACTERISTIC
/begin CHARACTERISTIC LIGov_WrmCltchFlt1T1_C "T1 Komponente für erstes PDT1-Glied wenn ausgekuppelt und Motor warm" VALUE 0xECAB0 Kw_Wu32 4294.9673 TimeDelay_s 0.0000010000000 4294.9673 FORMAT "%9.4" /end CHARACTERISTIC
/begin CHARACTERISTIC LIGov_WrmCltchFlt2T1_C "T1 Komponente für zweites PDT1-Glied wenn ausgekuppelt und Motor warm" VALUE 0xECAB4 Kw_Wu32 4294.9673 TimeDelay_s 0.0000010000000 4294.9673 FORMAT "%9.4" /end CHARACTERISTIC
/begin CHARACTERISTIC LIGov_WrmCltchIKi_C "Kleinsignalverstärkung" VALUE 0xECAB8 Kw_Wu32 799999.999814 Ki_rpm2Nm 0.00 799999.999814 FORMAT "%13.6" /end CHARACTERISTIC
/begin CHARACTERISTIC LIGov_WrmCltchIKiPos_C "Verstärkung für positive Großsignale" VALUE 0xECABC Kw_Wu32 799999.999814 Ki_rpm2Nm 0.00 799999.999814 FORMAT "%13.6" /end CHARACTERISTIC
/begin CHARACTERISTIC LIGov_WrmCltchIKiNeg_C "Verstärkung für negative Großsignale" VALUE 0xECAC0 Kw_Wu32 799999.999814 Ki_rpm2Nm 0.00 799999.999814 FORMAT "%13.6" /end CHARACTERISTIC
/begin CHARACTERISTIC LIGov_WrmCltchIWinPos_C "Kleinsignalfenster positiv" VALUE 0xECAC4 Kw_Ws16 8191.875 EngN_HiRes -4096.000 4095.875 FORMAT "%8.3" /end CHARACTERISTIC
/begin CHARACTERISTIC LIGov_WrmCltchIWinNeg_C "Kleinsignalfenster negativ" VALUE 0xECAC6 Kw_Ws16 8191.875 EngN_HiRes -4096.000 4095.875 FORMAT "%8.3" /end CHARACTERISTIC
/begin CHARACTERISTIC LIGov_WrmCltchPredef_C "Einschrittmoment Vorsteuerung" VALUE 0xECAC8 Kw_Ws16 6553.500 Trq -3276.800 3276.700 FORMAT "%8.3" /end CHARACTERISTIC
/begin CHARACTERISTIC LIGov_WrmCltchPKp_C "Kleinsignalverstärkung" VALUE 0xECACC Kw_Wu32 52428.7999878 Kp_rpm2Nm 0.00 52428.7999878 FORMAT "%13.7" /end CHARACTERISTIC
/begin CHARACTERISTIC LIGov_WrmCltchPKpPos_C "Verstärkung für positive Großsignale" VALUE 0xECAD0 Kw_Wu32 52428.7999878 Kp_rpm2Nm 0.00 52428.7999878 FORMAT "%13.7" /end CHARACTERISTIC
/begin CHARACTERISTIC LIGov_WrmCltchPKpNeg_C "Verstärkung für negative Großsignale" VALUE 0xECAD4 Kw_Wu32 52428.7999878 Kp_rpm2Nm 0.00 52428.7999878 FORMAT "%13.7" /end CHARACTERISTIC
/begin CHARACTERISTIC LIGov_WrmCltchPWinPos_C "Kleinsignalfenster positiv" VALUE 0xECAD8 Kw_Ws16 8191.875 EngN_HiRes -4096.000 4095.875 FORMAT "%8.3" /end CHARACTERISTIC
/begin CHARACTERISTIC LIGov_WrmCltchPWinNeg_C "Kleinsignalfenster negativ" VALUE 0xECADA Kw_Ws16 8191.875 EngN_HiRes -4096.000 4095.875 FORMAT "%8.3" /end CHARACTERISTIC
/begin CHARACTERISTIC LPACD_ctPwrStgOnMax_C "Maximale Anzahl der Endstufenaktivierung im Fehlerfall" VALUE 0xECD20 Kw_Wu16 65535.00 OneToOne 0.00 65535.00 FORMAT "%8.2" /end CHARACTERISTIC
/begin CHARACTERISTIC LPACD_DebExcTempDef_C "Fehlerentprellzeit fuer Uebertemperatur" VALUE 0xECD22 Kw_Wu16 655350.0 Time_ms 0.00 655350.0 FORMAT "%8.1" /end CHARACTERISTIC
/begin CHARACTERISTIC LPACD_DebExcTempOk_C "Heilungsentprellzeit fuer Uebertemperatur" VALUE 0xECD24 Kw_Wu16 655350.0 Time_ms 0.00 655350.0 FORMAT "%8.1" /end CHARACTERISTIC
/begin CHARACTERISTIC LPACD_DebNoLoadDef_C "Fehlerentprellzeit fuer Lastabfall" VALUE 0xECD26 Kw_Wu16 655350.0 Time_ms 0.00 655350.0 FORMAT "%8.1" /end CHARACTERISTIC
/begin CHARACTERISTIC LPACD_DebNoLoadOk_C "Heilungsentprellzeit fuer Lastabfall" VALUE 0xECD28 Kw_Wu16 655350.0 Time_ms 0.00 655350.0 FORMAT "%8.1" /end CHARACTERISTIC
/begin CHARACTERISTIC LPACD_DebShortCircBatDef_C "Fehlerentprellzeit fuer Kurzschluss nach Batteriespannung" VALUE 0xECD2A Kw_Wu16 655350.0 Time_ms 0.00 655350.0 FORMAT "%8.1" /end CHARACTERISTIC
/begin CHARACTERISTIC LPACD_DebShortCircBatOk_C "Heilungsentprellzeit fuer Kurzschluss nach Batteriespannung" VALUE 0xECD2C Kw_Wu16 655350.0 Time_ms 0.00 655350.0 FORMAT "%8.1" /end CHARACTERISTIC
/begin CHARACTERISTIC LPACD_DebShortCircGndDef_C "Fehlerentprellzeit fuer Kurzschluss nach Masse" VALUE 0xECD2E Kw_Wu16 655350.0 Time_ms 0.00 655350.0 FORMAT "%8.1" /end CHARACTERISTIC
/begin CHARACTERISTIC LPACD_DebShortCircGndOk_C "Heilungsentprellzeit fuer Kurzschluss nach Masse" VALUE 0xECD30 Kw_Wu16 655350.0 Time_ms 0.00 655350.0 FORMAT "%8.1" /end CHARACTERISTIC
/begin CHARACTERISTIC LPACD_numDia_C "Parameter fuer Hardware Diagnose-Pin Auswahl" VALUE 0xECD32 Kw_Wu8 33.0000000000 NumPinDia 0.00 33.0000000000 FORMAT "%13.10" /end CHARACTERISTIC
/begin CHARACTERISTIC LPACD_numPwmOut_C "Parameter fuer Hardware Endstufen-Pin Auswahl" VALUE 0xECD33 Kw_Wu8 13.0000000000 NumPinPwmOut 0.00 13.0000000000 FORMAT "%13.10" /end CHARACTERISTIC
/begin CHARACTERISTIC LPACD_stInvOut_C "Invertierungsparameter fuer das Signal der Ladedruckstellerendstufe" VALUE 0xECD34 Kw_Wu8 1.000 OneToOne 0.00 1.000 FORMAT "%5.3" EXTENDED_LIMITS 0.00 255.0 /end CHARACTERISTIC
/begin CHARACTERISTIC LPACD_tiPer_C "Periodendauer des Ladedruckstellers" VALUE 0xECD36 Kw_Ws16 6553.500 Period -3276.800 3276.700 FORMAT "%8.3" /end CHARACTERISTIC
/begin CHARACTERISTIC LPACD_rCnv_CUR "Kennlinie zur Konvertierung von Oeffnungsgrad in Tastverhaeltnis" CURVE 0xECD38 Kl_Xs16_Ws16 100.0000 DtyCyc 0.00 100.0000 FORMAT "%8.4" EXTENDED_LIMITS -327.6800 327.6700
 /begin AXIS_DESCR STD_AXIS BPA_rLPACD Prc 25 -100.0000 200.0000 FORMAT "%8.4" EXTENDED_LIMITS -400.0000 399.9878 DEPOSIT ABSOLUTE /end AXIS_DESCR
/end CHARACTERISTIC
/begin CHARACTERISTIC LPACD_rOutMax_C "Maximal auszugebendes Tastverhaeltnis" VALUE 0xECD9E Kw_Ws16 655.3500 DtyCyc -327.6800 327.6700 FORMAT "%8.4" /end CHARACTERISTIC
/begin CHARACTERISTIC LPACD_rOutMin_C "Minimal auszugebendes Tastverhaeltnis" VALUE 0xECDA0 Kw_Ws16 655.3500 DtyCyc -327.6800 327.6700 FORMAT "%8.4" /end CHARACTERISTIC
/begin CHARACTERISTIC LPACD_stPwrStgActv_C "Aktivierung der Abschaltbedingungen der Endstufe" VALUE 0xECDA2 Kw_Wu8 255.0 OneToOne 0.00 255.0 FORMAT "%5.1" /end CHARACTERISTIC
/begin CHARACTERISTIC LPACD_stPwrStgDia_C "Aktivierung der Abschaltbedingungen der Endstufendiagnose" VALUE 0xECDA3 Kw_Wu8 255.0 OneToOne 0.00 255.0 FORMAT "%5.1" /end CHARACTERISTIC
/begin CHARACTERISTIC LPACD_stSPICtl_C "Status ob Endstufe SPI = 1 oder nicht SPI = 0 ist" VALUE 0xECDA4 Kw_Wu8 1.000 OneToOne 0.00 1.000 FORMAT "%5.3" EXTENDED_LIMITS 0.00 255.0 /end CHARACTERISTIC
/begin CHARACTERISTIC LPACD_swt_C "Schalter fuer Batteriespannungskorrektur (0 = AUS, 1 = EIN)" VALUE 0xECDA5 Kw_Wu8 255.0 OneToOne 0.00 255.0 FORMAT "%5.1" /end CHARACTERISTIC
/begin CHARACTERISTIC LPACD_tiBtwTst_C "Zeitabstand, in dem im Fehlerfall die Endstufe getestet wird" VALUE 0xECDA6 Kw_Wu16 29980.00 Time_ms 20.00000 30000.00 FORMAT "%8.2" EXTENDED_LIMITS 0.00 655350.0 /end CHARACTERISTIC
/begin CHARACTERISTIC LPACD_tiPwrStgOn_C "Zeit für die Endstufe aktiviert wird, wenn keine SPI Endstufe" VALUE 0xECDA8 Kw_Wu16 655140.0 Time_ms 0.00 655140.0 FORMAT "%8.1" EXTENDED_LIMITS 0.00 655350.0 /end CHARACTERISTIC
/begin CHARACTERISTIC LSUCD_tiAdptFltInit_C "Zeitkonstante Adaptionsfilter für nicht adaptierten Zustand" VALUE 0xECE84 Kw_Wu32 4294.9673 TimeDelay_s 0.0000010000000 4294.9673 FORMAT "%9.4" /end CHARACTERISTIC
/begin CHARACTERISTIC LSUCD_tiAdptFlt_C "Zeitkonstante Adaptionsfilter für adaptierten Zustand" VALUE 0xECE88 Kw_Wu32 4294.9673 TimeDelay_s 0.0000010000000 4294.9673 FORMAT "%9.4" /end CHARACTERISTIC
/begin CHARACTERISTIC LSUCD_d2rInit_C "Initialisierungswert Bewertungsfilter" VALUE 0xECE8C Kw_Ws16 0.6553500 O2 -0.3276800 0.3276700 FORMAT "%9.7" /end CHARACTERISTIC
/begin CHARACTERISTIC LSUCD_dcycMinGrad_C "Minimale Änderung des Tastverhältnisses zur Freigabe der Diagnose der Heizungskopplung" VALUE 0xED004 Kw_Ws16 655.3500 DtyCyc -327.6800 327.6700 FORMAT "%8.4" /end CHARACTERISTIC
/begin CHARACTERISTIC LSUCD_DebHtCoupDef_C "Fehlerentprellzeit für Heizungskopplung" VALUE 0xED006 Kw_Wu16 65535.00 OneToOne 0.00 65535.00 FORMAT "%8.2" /end CHARACTERISTIC
/begin CHARACTERISTIC LSUCD_DebHtCoupOk_C "Fehlerheilungszeit für Heizungskopplung" VALUE 0xED008 Kw_Wu16 65535.00 OneToOne 0.00 65535.00 FORMAT "%8.2" /end CHARACTERISTIC
/begin CHARACTERISTIC LSUCD_DebO2ClbDef_C "Defektentprellzähler für O2-Kalibrierungsfehler" VALUE 0xECED8 Kw_Wu16 65535.00 OneToOne 0.00 65535.00 FORMAT "%8.2" /end CHARACTERISTIC
/begin CHARACTERISTIC LSUCD_DebO2ClbOk_C "Heilungsentprellzähler für O2-Kalibrierungsfehler" VALUE 0xECEDA Kw_Wu16 65535.00 OneToOne 0.00 65535.00 FORMAT "%8.2" /end CHARACTERISTIC
/begin CHARACTERISTIC LSUCD_DebRiClbDef_C "Defektentprellzähler des Ri-Kalibrierungsfehlers" VALUE 0xECF9C Kw_Wu16 65535.00 OneToOne 0.00 65535.00 FORMAT "%8.2" /end CHARACTERISTIC
/begin CHARACTERISTIC LSUCD_DebRiClbOk_C "Heilungsentprellzähler des Ri-Kalibrierungsfehlers" VALUE 0xECF9E Kw_Wu16 65535.00 OneToOne 0.00 65535.00 FORMAT "%8.2" /end CHARACTERISTIC
/begin CHARACTERISTIC LSUCD_DebWireIpDef_C "Defektentprellzähler der Nebenschlusserkennung" VALUE 0xED00A Kw_Wu16 65535.00 OneToOne 0.00 65535.00 FORMAT "%8.2" /end CHARACTERISTIC
/begin CHARACTERISTIC LSUCD_DebWireIpOk_C "Heilungsentprellzähler der Nebenschlusserkennung" VALUE 0xED00C Kw_Wu16 65535.00 OneToOne 0.00 65535.00 FORMAT "%8.2" /end CHARACTERISTIC
/begin CHARACTERISTIC LSUCD_dmAirIKi_C "Verstärkung I-Regler bei Kleinsignalen" VALUE 0xECE90 Kw_Wu32 5.00003807247 Ki 0.00 5.00003807247 FORMAT "%13.11" EXTENDED_LIMITS 0.00 999999.999767 READ_ONLY /end CHARACTERISTIC
/begin CHARACTERISTIC LSUCD_dmAirIKiPos_C "Verstärkung I-Regler bei positiven Großsignalen" VALUE 0xECE94 Kw_Wu32 5.00003807247 Ki 0.00 5.00003807247 FORMAT "%13.11" EXTENDED_LIMITS 0.00 999999.999767 READ_ONLY /end CHARACTERISTIC
/begin CHARACTERISTIC LSUCD_dmAirIKiNeg_C "Verstärkung I-Regler bei negativen Großsignalen" VALUE 0xECE98 Kw_Wu32 5.00003807247 Ki 0.00 5.00003807247 FORMAT "%13.11" EXTENDED_LIMITS 0.00 999999.999767 READ_ONLY /end CHARACTERISTIC
/begin CHARACTERISTIC LSUCD_dmAirIWinPos_C "Obere Kleinsignalgrenze für  den I-Regler" VALUE 0xECE9C Kw_Ws16 250.0000 AirMassPerTime 223.0000 473.0000 FORMAT "%8.4" EXTENDED_LIMITS -3276.800 3276.700 READ_ONLY /end CHARACTERISTIC
/begin CHARACTERISTIC LSUCD_dmAirIWinNeg_C "Untere Kleinsignalgrenze für den I-Regler" VALUE 0xECE9E Kw_Ws16 250.0000 AirMassPerTime 223.0000 473.0000 FORMAT "%8.4" EXTENDED_LIMITS -3276.800 3276.700 READ_ONLY /end CHARACTERISTIC
/begin CHARACTERISTIC LSUCD_dNumHtCoup_C "Anzahl der für ein signifikantes Resultat notwendigen Aktivierungen der Heizungskoplungsprüfung" VALUE 0xED00E Kw_Wu16 65535.00 OneToOne 0.00 65535.00 FORMAT "%8.2" /end CHARACTERISTIC
/begin CHARACTERISTIC LSUCD_EvalMaxVal_C "Oberer Grenzwert für Lernfortschrittsbewertung" VALUE 0xECEA0 Kw_Ws16 0.6553500 O2 -0.3276800 0.3276700 FORMAT "%9.7" /end CHARACTERISTIC
/begin CHARACTERISTIC LSUCD_EvalMinVal_C "Unterer Grenzwert für Lernfortschrittsbewertung" VALUE 0xECEA2 Kw_Ws16 0.6553500 O2 -0.3276800 0.3276700 FORMAT "%9.7" /end CHARACTERISTIC
/begin CHARACTERISTIC LSUCD_tiEvalFltInit_C "Zeitkonstante Bewertungsfilter für nicht adaptierten Zustand" VALUE 0xECEA4 Kw_Wu32 4294.9673 TimeDelay_s 0.0000010000000 4294.9673 FORMAT "%9.4" /end CHARACTERISTIC
/begin CHARACTERISTIC LSUCD_tiEvalFlt_C "Zeitkonstante Bewertungsfilter für adaptierten Zustand" VALUE 0xECEA8 Kw_Wu32 4294.9673 TimeDelay_s 0.0000010000000 4294.9673 FORMAT "%9.4" /end CHARACTERISTIC
/begin CHARACTERISTIC LSUCD_facPresCompLean_CUR "Kennlinie für Druckkorrekturfaktor bei magerem Luft-Kraftstoff-Gemisch" CURVE 0xECF44 Kl_Xs16_Ws16 7.999878 Fact -4.000000 3.999878 FORMAT "%8.6"
 /begin AXIS_DESCR STD_AXIS LSUCD_pExhGasLstVal_mp Pres_hPa 10 -32768.00 32767.00 FORMAT "%8.2" DEPOSIT ABSOLUTE /end AXIS_DESCR
/end CHARACTERISTIC
/begin CHARACTERISTIC LSUCD_facPresCompRich_CUR "Kennlinie für Druckkorrekturfaktor bei fettem Luft-Kraftstoff-Gemisch" CURVE 0xECF6E Kl_Xs16_Ws16 7.999878 Fact -4.000000 3.999878 FORMAT "%8.6"
 /begin AXIS_DESCR STD_AXIS LSUCD_pExhGasLstVal_mp Pres_hPa 10 -32768.00 32767.00 FORMAT "%8.2" DEPOSIT ABSOLUTE /end AXIS_DESCR
/end CHARACTERISTIC
/begin CHARACTERISTIC LSUCD_mAirAdptActv_C "Minimalwert für Integral über Luftmassenstrom seit Schubbeginn für Aktivierung der Adaption" VAL_BLK 0xECEAC Kwb_Ws16 6553.500 AirMass_2 -3276.800 3276.700 FORMAT "%8.3" NUMBER 1 /end CHARACTERISTIC
/begin CHARACTERISTIC LSUCD_stHtInvOut_C "Lambdas Sensor Heizerendstufe Invertierungsstatus" VALUE 0xECEB4 Kw_Wu8 1.000 OneToOne 0.00 1.000 FORMAT "%5.3" EXTENDED_LIMITS 0.00 255.0 /end CHARACTERISTIC
/begin CHARACTERISTIC LSUCD_tiHtPer_C "Periodendauer PWM Signal Heizwiderstand Ansteuerung" VALUE 0xECEB6 Kw_Ws16 6553.500 Period -3276.800 3276.700 FORMAT "%8.3" /end CHARACTERISTIC
/begin CHARACTERISTIC LSUCD_resRiMaxGrad_C "Maximale Änderung des Innenwiderstands zur Freigabe der Diagnose der Heizungskopplung" VALUE 0xED010 Kw_Ws16 6553.500 Resist -3276.800 3276.700 FORMAT "%8.3" /end CHARACTERISTIC
/begin CHARACTERISTIC LSUCD_rO2IsolChkMax_C "Maximal zulässige Sauerstoffanzeige für kalte Sonde" VALUE 0xED012 Kw_Ws16 0.6553500 O2 -0.3276800 0.3276700 FORMAT "%9.7" /end CHARACTERISTIC
/begin CHARACTERISTIC LSUCD_rO2IsolChkMin_C "Minimal zulässige Sauerstoffanzeige für kalte Sonde" VALUE 0xED014 Kw_Ws16 0.6553500 O2 -0.3276800 0.3276700 FORMAT "%9.7" /end CHARACTERISTIC
/begin CHARACTERISTIC LSUCD_rO2SwtPresComp_C "Sauerstoffkonzentrationsgrenzwert für Umschaltung zwischen Druckkompensation für mageres und fettes Luft-Ktraftstoff-Gemisch" VALUE 0xECF98 Kw_Ws16 0.6553500 O2 -0.3276800 0.3276700 FORMAT "%9.7" /end CHARACTERISTIC
/begin CHARACTERISTIC LSUCD_rO2_CUR "Kennlinie zur Umrechnung von Spannung in Sauerstoffkonzentration" CURVE 0xECEDC Kl_Xs16_Ws16 0.6000000 O2 -0.3000000 0.3000000 FORMAT "%9.7" EXTENDED_LIMITS -0.3276800 0.3276700
 /begin AXIS_DESCR STD_AXIS LSUCD_uO2OfsCor_mp Volt 15 -1598.240 3998.045 FORMAT "%8.3" EXTENDED_LIMITS -160156.4 160151.5 DEPOSIT ABSOLUTE /end AXIS_DESCR
/end CHARACTERISTIC
/begin CHARACTERISTIC LSUCD_stCJChpSel_C "Applikationskonstante zur Auswahl von CJ120 (=0) oder CJ125 (=1)" VALUE 0xECDD4 Kw_Wu16 1.000000 OneToOne 0.00 1.000000 FORMAT "%8.6" EXTENDED_LIMITS 0.00 65535.00 /end CHARACTERISTIC
/begin CHARACTERISTIC LSUCD_stPumpCtlDis_C "Maske zur Auswahl der Betriebsart abhängigen Abschaltbedingungen für den Pumpstromregler" VALUE 0xECF9A Kw_Wu8 255.0 OneToOne 0.00 255.0 FORMAT "%5.1" /end CHARACTERISTIC
/begin CHARACTERISTIC LSUCD_stRefCurHigh_C "Applikationskonstante zur Konfiguration des hohen Referenzpumpstroms von 0 bis 150uA" VALUE 0xED000 Kw_Wu8 15.0000000000 CurRefPump 0.00 15.0000000000 FORMAT "%13.10" /end CHARACTERISTIC
/begin CHARACTERISTIC LSUCD_stRefCurNormal_C "Applikationskonstante zur Konfiguration des normalen Referenzpumpstroms von 0 bis 150uA" VALUE 0xED001 Kw_Wu8 15.0000000000 CurRefPump 0.00 15.0000000000 FORMAT "%13.10" /end CHARACTERISTIC
/begin CHARACTERISTIC LSUCD_stRgnEna_C "Applikationskonstante zur Aktivierung oder Deaktivierung der Regeneration" VALUE 0xECDD6 Kw_Wu8 1.000 OneToOne 0.00 1.000 FORMAT "%5.3" EXTENDED_LIMITS 0.00 255.0 /end CHARACTERISTIC
/begin CHARACTERISTIC LSUCD_stWireDiaActv_C "Ansteuerungsflags für Diagnoseroutinen" VALUE 0xED016 Kw_Wu16 65535.00 OneToOne 0.00 65535.00 FORMAT "%8.2" /end CHARACTERISTIC
/begin CHARACTERISTIC LSUCD_swtAdptVal_C "Schalterwert für Adaption der Lambda-Sonde (0= keine Adaption/ 1=Adaption)" VALUE 0xECEAE Kw_Wu8 1.000 OneToOne 0.00 1.000 FORMAT "%5.3" EXTENDED_LIMITS 0.00 255.0 /end CHARACTERISTIC
/begin CHARACTERISTIC LSUCD_swtAdptType_C "SW-Schaltertyp für Adaption der Lambda-Sonde (0=Datensatzwert, nicht applizierbar/1=EEPROM-Wert/2=Datensatzwert)" VALUE 0xECEAF Kw_Wu8 0.00 OneToOne 2.000 2.000 FORMAT "%5.3" EXTENDED_LIMITS 0.00 255.0 /end CHARACTERISTIC
/begin CHARACTERISTIC LSUCD_swtMSSeparate_C "Schalter zur Auswahl der Berechnung des Lambdainizes 0 von Master/Slave-Systemen" VALUE 0xECE80 Kw_Wu8 2.000 OneToOne 0.00 2.000 FORMAT "%5.3" EXTENDED_LIMITS 0.00 255.0 /end CHARACTERISTIC
/begin CHARACTERISTIC LSUCD_tAirAdptActv_C "Maximale Lufttemperatur für Aktivierung der Adaption" VALUE 0xECEB0 Kw_Ws16 950.000 Temp_Cels -50.140 899.860 FORMAT "%8.3" EXTENDED_LIMITS -3549.940 3003.560 /end CHARACTERISTIC
/begin CHARACTERISTIC LSUCD_tiHtCoupChk_C "Zeitdauer der Heizungsabschaltung für Diagnose der Heizungskopplung" VALUE 0xED018 Kw_Wu16 655.3500 Time_s 0.00 655.3500 FORMAT "%8.4" /end CHARACTERISTIC
/begin CHARACTERISTIC LSUCD_tiHtCoupPer_C "Zeitspanne zur Ansteuerung der Diagnose der Heizungskopplung" VALUE 0xED01A Kw_Wu16 655.3500 Time_s 0.00 655.3500 FORMAT "%8.4" /end CHARACTERISTIC
/begin CHARACTERISTIC LSUCD_tiIsolChkErr_C "Maximale Abkühlzeit LSU" VALUE 0xED01C Kw_Wu16 655.3500 Time_s 0.00 655.3500 FORMAT "%8.4" /end CHARACTERISTIC
/begin CHARACTERISTIC LSUCD_tiIsolChkPer_C "Periodendauer zur Einschaltung des Pumpstroms zur Nebenschlusserkennung" VALUE 0xED01E Kw_Wu16 655.3500 Time_s 0.00 655.3500 FORMAT "%8.4" /end CHARACTERISTIC
/begin CHARACTERISTIC LSUCD_tiIsolChkPump_C "Einschaltdauer für Pumpstrom bei Nebenschlusserkennung" VALUE 0xED020 Kw_Wu16 655.3500 Time_s 0.00 655.3500 FORMAT "%8.4" /end CHARACTERISTIC
/begin CHARACTERISTIC LSUCD_tiO2ClbPT1_C "Filterzeitkonstante für Lernen Abgleichwert" VALUE 0xECF1C Kw_Wu32 4294.9673 TimeDelay_s 0.0000010000000 4294.9673 FORMAT "%9.4" /end CHARACTERISTIC
/begin CHARACTERISTIC LSUCD_tiO2PT1_C "Filterzeitkonstante für O2 Rohwertfilterung" VALUE 0xECF20 Kw_Wu32 4294.9673 TimeDelay_s 0.0000010000000 4294.9673 FORMAT "%9.4" /end CHARACTERISTIC
/begin CHARACTERISTIC LSUCD_tiOpnLdTstActv_C "Zeitdauer der Kabelunterbrechungsdiagnose am Anschluss Nernst-Zelle(UN) und virtuelle Masse(VM)" VALUE 0xED02C Kw_Wu16 655.3500 Time_s 0.00 655.3500 FORMAT "%8.4" /end CHARACTERISTIC
/begin CHARACTERISTIC LSUCD_tiRiClbPT1_C "Zeitkonstante Ri Abgleichfilter" VALUE 0xECFA0 Kw_Wu32 4294.9673 TimeDelay_s 0.0000010000000 4294.9673 FORMAT "%9.4" /end CHARACTERISTIC
/begin CHARACTERISTIC LSUCD_tiRiMeasDisa_C "Zeitdauer der Abschaltung der Ri-Messfrequenz" VALUE 0xED02E Kw_Wu16 655.3500 Time_s 0.00 655.3500 FORMAT "%8.4" /end CHARACTERISTIC
/begin CHARACTERISTIC LSUCD_tiRiPT1_C "Zeitkonstante Ri Filter" VALUE 0xECFA4 Kw_Wu32 4294.9673 TimeDelay_s 0.0000010000000 4294.9673 FORMAT "%9.4" /end CHARACTERISTIC
/begin CHARACTERISTIC LSUCD_tRi_CUR "Kennlinie zur Umrechnung des Innenwiderstands auf Äquivalenztemperatur" CURVE 0xECFA8 Kl_Xs16_Ws16 950.000 Temp_Cels -50.140 899.860 FORMAT "%8.3" EXTENDED_LIMITS -3549.940 3003.560
 /begin AXIS_DESCR STD_AXIS LSUCD_resRi_mp Resist 16 0.00 3000.000 FORMAT "%8.3" EXTENDED_LIMITS -3276.800 3276.700 DEPOSIT ABSOLUTE /end AXIS_DESCR
/end CHARACTERISTIC
/begin CHARACTERISTIC LSUCD_tiHtCoupFlt_C "Zeitkonstante Glättungsfilter in Diagnose der Heizungskopplung" VALUE 0xED024 Kw_Wu32 4294.9673 TimeDelay_s 0.0000010000000 4294.9673 FORMAT "%9.4" /end CHARACTERISTIC
/begin CHARACTERISTIC LSUCD_uO2MaxGrad_C "Maximale Änderung des Sauerstoff-Spannungssignals zur Freigabe der Diagnose der Heizungskopplung" VALUE 0xED028 Kw_Ws16 320307.9 Volt -160156.4 160151.5 FORMAT "%8.1" /end CHARACTERISTIC
/begin CHARACTERISTIC LSUCD_uO2MaxRippel_C "Maximal zulässige Änderung des Sauerstoff-Spannungssignals zur Abschaltung der Heizung" VALUE 0xED02A Kw_Ws16 320307.9 Volt -160156.4 160151.5 FORMAT "%8.1" /end CHARACTERISTIC
/begin CHARACTERISTIC LSUCD_uO2OpnLdNernstMax_C "Maximalspannung der Kabelunterbrechungsdiagnose am Anschluss Nerns-Zelle (UN)" VALUE 0xED030 Kw_Ws16 5000.000 Volt 0.00 5000.000 FORMAT "%8.3" EXTENDED_LIMITS -160156.4 160151.5 /end CHARACTERISTIC
/begin CHARACTERISTIC LSUCD_uO2OpnLdNernstMin_C "Minimalspannung der Kabelunterbrechungsdiagnose am Anschluss Nerns-Zelle (UN)" VALUE 0xED032 Kw_Ws16 6999.022 Volt -1999.022 5000.000 FORMAT "%8.3" EXTENDED_LIMITS -160156.4 160151.5 /end CHARACTERISTIC
/begin CHARACTERISTIC LSUCD_uO2OpnLdVirtGndMax_C "SRC-Maximalwert der Kabelunterbrechungsdiagnose am Anschluss virtuelle Masse (VM)" VALUE 0xED034 Kw_Ws16 5097.752 Volt -97.75171 5000.000 FORMAT "%8.3" EXTENDED_LIMITS -160156.4 160151.5 /end CHARACTERISTIC
/begin CHARACTERISTIC LSUCD_uO2OpnLdVirtGndMin_C "SRC-Minimalwert der Kabelunterbrechungsdiagnose am Anschluss virtuelle Masse (VM)" VALUE 0xED036 Kw_Ws16 5498.534 Volt -498.5337 5000.000 FORMAT "%8.3" EXTENDED_LIMITS -160156.4 160151.5 /end CHARACTERISTIC
/begin CHARACTERISTIC LSUCD_uRiOpnLdTstMax_C "Maximalwert der Ri-Spannung für Kabelunterbrechungsdiagnose am Anschluss Nernst-Zelle und virtuelle Masse" VALUE 0xED038 Kw_Ws16 5200.391 Volt 0.00 5200.391 FORMAT "%8.3" EXTENDED_LIMITS -160156.4 160151.5 /end CHARACTERISTIC
/begin CHARACTERISTIC LSUCtl_tUpLim_C "Obere Widerstandsgrenze für eingeregelten Zustand" VALUE 0xED058 Kw_Ws16 950.000 Temp_Cels -50.140 899.860 FORMAT "%8.3" EXTENDED_LIMITS -3549.940 3003.560 /end CHARACTERISTIC
/begin CHARACTERISTIC LSUCtl_tLowLim_C "Untere Widerstandsgrenze für eingeregelten Zustand" VALUE 0xED05A Kw_Ws16 950.000 Temp_Cels -50.140 899.860 FORMAT "%8.3" EXTENDED_LIMITS -3549.940 3003.560 /end CHARACTERISTIC
/begin CHARACTERISTIC LSUCtl_tRiSetPoint_C "Sollwert der LSU-Heizungsregelung" VALUE 0xED05C Kw_Ws16 950.000 Temp_Cels -50.140 899.860 FORMAT "%8.3" EXTENDED_LIMITS -3549.940 3003.560 /end CHARACTERISTIC
/begin CHARACTERISTIC LSUCtl_tHtCtlEna_C "Temperaturminimalwert für Freigabe der Regelung" VALUE 0xED05E Kw_Ws16 950.000 Temp_Cels -50.140 899.860 FORMAT "%8.3" EXTENDED_LIMITS -3549.940 3003.560 /end CHARACTERISTIC
/begin CHARACTERISTIC LSUCtl_nHtCtlEna_C "Mindestdrehzahl für Freigabe Aufheizrampe" VALUE 0xED060 Kw_Ws16 32767.00 EngN 0.00 32767.00 FORMAT "%8.2" EXTENDED_LIMITS -32768.00 32767.00 /end CHARACTERISTIC
/begin CHARACTERISTIC LSUCtl_dcycHtMin_C "Tastverhältnis Heizeransteuerung vor Taupunktende (Vorwärmen)" VALUE 0xED062 Kw_Ws16 100.0000 DtyCyc 0.00 100.0000 FORMAT "%8.4" EXTENDED_LIMITS -327.6800 327.6700 /end CHARACTERISTIC
/begin CHARACTERISTIC LSUCtl_tExcMax_C "Grenzwert zur Erkennung von ""obere Schwelle bleibend überschritten""" VALUE 0xED064 Kw_Ws16 950.000 Temp_Cels -50.140 899.860 FORMAT "%8.3" EXTENDED_LIMITS -3549.940 3003.560 /end CHARACTERISTIC
/begin CHARACTERISTIC LSUCtl_tExcMin_C "Grenzwert zur Erkennung von ""untere Schwelle bleibend nicht erreicht""" VALUE 0xED066 Kw_Ws16 950.000 Temp_Cels -50.140 899.860 FORMAT "%8.3" EXTENDED_LIMITS -3549.940 3003.560 /end CHARACTERISTIC
/begin CHARACTERISTIC LSUCtl_tiDelIniVal_C "Verzögerungszeit für die Erfassung der initialen Ansauglufttemperatur" VALUE 0xED068 Kw_Wu16 655350.0 Time_ms 0.00 655350.0 FORMAT "%8.1" /end CHARACTERISTIC
/begin CHARACTERISTIC LSUCtl_dcycRmpUp_C "Anstiegsgeschwindigkeit Aufheizkurvenrampe" VALUE 0xED06C Kw_Wu32 655359.999847 RmpDtyCyc 0.00 655359.999847 FORMAT "%13.6" /end CHARACTERISTIC
/begin CHARACTERISTIC LSUCtl_dcycRmpDwn_C "Fallgeschwindigkeit Aufheizrampe" VALUE 0xED070 Kw_Wu32 655359.999847 RmpDtyCyc 0.00 655359.999847 FORMAT "%13.6" /end CHARACTERISTIC
/begin CHARACTERISTIC LSUCtl_dcycStrt_CUR "Kennlinie Anfangsheizungs Tastverhältnis in Abhängigkeit von Ansauglufttemperatur bei Start" CURVE 0xED074 Kl_Xs16_Ws16 100.0000 DtyCyc 0.00 100.0000 FORMAT "%8.4" EXTENDED_LIMITS -327.6800 327.6700
 /begin AXIS_DESCR STD_AXIS LSUCtl_tAirStrt_mp Temp_Cels 5 -50.1400 199.8600 FORMAT "%8.4" EXTENDED_LIMITS -3549.940 3003.560 DEPOSIT ABSOLUTE /end AXIS_DESCR
/end CHARACTERISTIC
/begin CHARACTERISTIC LSUCtl_tiDebRiExcMaxDef_C "Defekterkennungszeit bleibend obere Ri Schwelle überschritten" VALUE 0xED08A Kw_Wu16 655350.0 Time_ms 0.00 655350.0 FORMAT "%8.1" /end CHARACTERISTIC
/begin CHARACTERISTIC LSUCtl_tiDebRiExcMaxOk_C "Heilungszeit bleibend obere Ri Schwelle überschritten" VALUE 0xED08C Kw_Wu16 655350.0 Time_ms 0.00 655350.0 FORMAT "%8.1" /end CHARACTERISTIC
/begin CHARACTERISTIC LSUCtl_tiDebRiExcMinDef_C "Defekterkennungszeit bleibend untere Ri Schwelle unterschritten" VALUE 0xED08E Kw_Wu16 655350.0 Time_ms 0.00 655350.0 FORMAT "%8.1" /end CHARACTERISTIC
/begin CHARACTERISTIC LSUCtl_tiDebRiExcMinOk_C "Heilungszeit bleibend untere Ri Schwelle unterschritten" VALUE 0xED090 Kw_Wu16 655350.0 Time_ms 0.00 655350.0 FORMAT "%8.1" /end CHARACTERISTIC
/begin CHARACTERISTIC LSUCtl_tiSens1HtDT1_C "Verzugszeit T1 des D-Gliedes der LSU Heizungsregelung Sensoren vor Katalysator" VALUE 0xED094 Kw_Wu32 4294.9673 TimeDelay_s 0.0000010000000 4294.9673 FORMAT "%9.4" /end CHARACTERISTIC
/begin CHARACTERISTIC LSUCtl_Sens1HtDT1Kd_C "Kd Parameter der Heizungsregelung für die Sensoren vor Katalysator" VALUE 0xED098 Kw_Ws32 6553.59999847 Kd_Temp_Kelv2Dcyc -3276.80000000 3276.79999847 FORMAT "%13.8" /end CHARACTERISTIC
/begin CHARACTERISTIC LSUCtl_Sens1HtIKi_C "Ki Parameter der Heizungsregelung für die Sensoren vor Katalysator (Kleinsignalbereich)" VALUE 0xED09C Kw_Wu32 99999.9999767 Ki_Temp_Kelv2Dcyc 0.00 99999.9999767 FORMAT "%13.7" /end CHARACTERISTIC
/begin CHARACTERISTIC LSUCtl_Sens1HtIKiPos_C "Ki Parameter der Heizungsregelung für die Sensoren vor Katalysator (positiver Großsignalbereich)" VALUE 0xED0A0 Kw_Wu32 99999.9999767 Ki_Temp_Kelv2Dcyc 0.00 99999.9999767 FORMAT "%13.7" /end CHARACTERISTIC
/begin CHARACTERISTIC LSUCtl_Sens1HtIKiNeg_C "Ki Parameter der Heizungsregelung für die Sensoren vor Katalysator (negativer Großsignalbereich)" VALUE 0xED0A4 Kw_Wu32 99999.9999767 Ki_Temp_Kelv2Dcyc 0.00 99999.9999767 FORMAT "%13.7" /end CHARACTERISTIC
/begin CHARACTERISTIC LSUCtl_tSens1HtIWinPos_C "Obere Fenstergrenze des I-Anteils der LSU-Heizungsregelung (Sensoren vor Katalysator)" VALUE 0xED0A8 Kw_Ws16 6553.500 TempDiff_Cels -3276.800 3276.700 FORMAT "%8.3" /end CHARACTERISTIC
/begin CHARACTERISTIC LSUCtl_tSens1HtIWinNeg_C "Untere Fenstergrenze des I-Anteils der LSU-Heizungsregelung (Sensoren vor Katalysator)" VALUE 0xED0AA Kw_Ws16 6553.500 TempDiff_Cels -3276.800 3276.700 FORMAT "%8.3" /end CHARACTERISTIC
/begin CHARACTERISTIC LSUCtl_Sens1HtPKp_C "Kp Parameter der Heizungsregelung für die Sensoren vor Katalysator (Kleinsignalbereich)" VALUE 0xED0AC Kw_Wu32 6553.59999847 Kp_Temp_Kelv2Dcyc 0.00 6553.59999847 FORMAT "%13.8" /end CHARACTERISTIC
/begin CHARACTERISTIC LSUCtl_Sens1HtPKpPos_C "Kp Parameter der Heizungsregelung für die Sensoren vor Katalysator (positiver Großsignalbereich)" VALUE 0xED0B0 Kw_Wu32 6553.59999847 Kp_Temp_Kelv2Dcyc 0.00 6553.59999847 FORMAT "%13.8" /end CHARACTERISTIC
/begin CHARACTERISTIC LSUCtl_Sens1HtPKpNeg_C "Kp Parameter der Heizungsregelung für die Sensoren vor Katalysator (negativer Großsignalbereich)" VALUE 0xED0B4 Kw_Wu32 6553.59999847 Kp_Temp_Kelv2Dcyc 0.00 6553.59999847 FORMAT "%13.8" /end CHARACTERISTIC
/begin CHARACTERISTIC LSUCtl_tSens1HtPWinPos_C "Obere Fenstergrenze des P-Anteils der LSU-Heizungsregelung (Sensoren vor Katalysator)" VALUE 0xED0B8 Kw_Ws16 6553.500 TempDiff_Cels -3276.800 3276.700 FORMAT "%8.3" /end CHARACTERISTIC
/begin CHARACTERISTIC LSUCtl_tSens1HtPWinNeg_C "Untere Fenstergrenze des P-Anteils der LSU-Heizungsregelung (Sensoren vor Katalysator)" VALUE 0xED0BA Kw_Ws16 6553.500 TempDiff_Cels -3276.800 3276.700 FORMAT "%8.3" /end CHARACTERISTIC
/begin CHARACTERISTIC LSUCtl_tiSens2HtDT1_C "Verzugszeit T1 des D-Gliedes der LSU Heizungsregelung Sensoren nach Katalysator" VALUE 0xED0BC Kw_Wu32 4294.9673 TimeDelay_s 0.0000010000000 4294.9673 FORMAT "%9.4" /end CHARACTERISTIC
/begin CHARACTERISTIC LSUCtl_Sens2HtDT1Kd_C "Kd Parameter der Heizungsregelung für die Sensoren nach Katalysator" VALUE 0xED0C0 Kw_Ws32 6553.59999847 Kd_Temp_Kelv2Dcyc -3276.80000000 3276.79999847 FORMAT "%13.8" /end CHARACTERISTIC
/begin CHARACTERISTIC LSUCtl_Sens2HtIKi_C "Ki Parameter der Heizungsregelung für die Sensoren nach Katalysator (Kleinsignalbereich)" VALUE 0xED0C4 Kw_Wu32 99999.9999767 Ki_Temp_Kelv2Dcyc 0.00 99999.9999767 FORMAT "%13.7" /end CHARACTERISTIC
/begin CHARACTERISTIC LSUCtl_Sens2HtIKiPos_C "Ki Parameter der Heizungsregelung für die Sensoren nach Katalysator (positiver Großsignalbereich)" VALUE 0xED0C8 Kw_Wu32 99999.9999767 Ki_Temp_Kelv2Dcyc 0.00 99999.9999767 FORMAT "%13.7" /end CHARACTERISTIC
/begin CHARACTERISTIC LSUCtl_Sens2HtIKiNeg_C "Ki Parameter der Heizungsregelung für die Sensoren nach Katalysator (negativer Großsignalbereich)" VALUE 0xED0CC Kw_Wu32 99999.9999767 Ki_Temp_Kelv2Dcyc 0.00 99999.9999767 FORMAT "%13.7" /end CHARACTERISTIC
/begin CHARACTERISTIC LSUCtl_tSens2HtIWinPos_C "Obere Fenstergrenze des I-Anteils der LSU-Heizungsregelung (Sensoren nach Katalysator)" VALUE 0xED0D0 Kw_Ws16 6553.500 TempDiff_Cels -3276.800 3276.700 FORMAT "%8.3" /end CHARACTERISTIC
/begin CHARACTERISTIC LSUCtl_tSens2HtIWinNeg_C "Untere Fenstergrenze des I-Anteils der LSU-Heizungsregelung (Sensoren nach Katalysator)" VALUE 0xED0D2 Kw_Ws16 6553.500 TempDiff_Cels -3276.800 3276.700 FORMAT "%8.3" /end CHARACTERISTIC
/begin CHARACTERISTIC LSUCtl_Sens2HtPKp_C "Kp Parameter der Heizungsregelung für die Sensoren nach Katalysator (Kleinsignalbereich)" VALUE 0xED0D4 Kw_Wu32 6553.59999847 Kp_Temp_Kelv2Dcyc 0.00 6553.59999847 FORMAT "%13.8" /end CHARACTERISTIC
/begin CHARACTERISTIC LSUCtl_Sens2HtPKpPos_C "Kp Parameter der Heizungsregelung für die Sensoren nach Katalysator (positiver Großsignalbereich)" VALUE 0xED0D8 Kw_Wu32 6553.59999847 Kp_Temp_Kelv2Dcyc 0.00 6553.59999847 FORMAT "%13.8" /end CHARACTERISTIC
/begin CHARACTERISTIC LSUCtl_Sens2HtPKpNeg_C "Kp Parameter der Heizungsregelung für die Sensoren nach Katalysator (negativer Großsignalbereich)" VALUE 0xED0DC Kw_Wu32 6553.59999847 Kp_Temp_Kelv2Dcyc 0.00 6553.59999847 FORMAT "%13.8" /end CHARACTERISTIC
/begin CHARACTERISTIC LSUCtl_tSens2HtPWinPos_C "Obere Fenstergrenze des P-Anteils der LSU-Heizungsregelung (Sensoren nach Katalysator)" VALUE 0xED0E0 Kw_Ws16 6553.500 TempDiff_Cels -3276.800 3276.700 FORMAT "%8.3" /end CHARACTERISTIC
/begin CHARACTERISTIC LSUCtl_tSens2HtPWinNeg_C "Untere Fenstergrenze des P-Anteils der LSU-Heizungsregelung (Sensoren nach Katalysator)" VALUE 0xED0E2 Kw_Ws16 6553.500 TempDiff_Cels -3276.800 3276.700 FORMAT "%8.3" /end CHARACTERISTIC
/begin CHARACTERISTIC LSU_ctRgnEna_C "Zahl von Kalibrierungs-Zyklen, nach der Regeneration vorkommen soll" VALUE 0xECDAC Kw_Wu8 255.0 OneToOne 0.00 255.0 FORMAT "%5.1" /end CHARACTERISTIC
/begin CHARACTERISTIC LSU_dcycMax_C "minimale Tastverhältnis-Änderung für Aktivierung Heizereinkopplungs-Diagnose" VALUE 0xECDD8 Kw_Ws16 655.3500 DtyCyc -327.6800 327.6700 FORMAT "%8.4" /end CHARACTERISTIC
/begin CHARACTERISTIC LSU_tiBattHighDebNeg_C "Entprellzeit (Übergang von high nach low) der Batteriespannungsüberwachung" VALUE 0xECDDA Kw_Wu16 655350.0 TimeDeb 0.00 655350.0 FORMAT "%8.1" /end CHARACTERISTIC
/begin CHARACTERISTIC LSU_tiBattHighDebPos_C "Entprellzeit (Übergang von low nach high) der Batteriespannungsüberwachung" VALUE 0xECDDC Kw_Wu16 655350.0 TimeDeb 0.00 655350.0 FORMAT "%8.1" /end CHARACTERISTIC
/begin CHARACTERISTIC LSU_DebDynErrDef_C "Zählerstand zur Defektentprellung Dynamikfehler" VALUE 0xECE14 Kw_Wu16 65535.00 OneToOne 0.00 65535.00 FORMAT "%8.2" /end CHARACTERISTIC
/begin CHARACTERISTIC LSU_DebDynErrOk_C "Zählerstand zur Heilungsentprellung Dynamikfehler" VALUE 0xECE16 Kw_Wu16 65535.00 OneToOne 0.00 65535.00 FORMAT "%8.2" /end CHARACTERISTIC
/begin CHARACTERISTIC LSUCD_tiDebNoLdErrIPDef_C "Defekterkennungszeit der Kabelunterbrechungsdiagnose am Anschluss Pumpzelle (IP)" VALUE 0xED03A Kw_Wu16 655350.0 Time_ms 0.00 655350.0 FORMAT "%8.1" /end CHARACTERISTIC
/begin CHARACTERISTIC LSUCD_tiDebNoLdErrIPOk_C "Heilungsdauer der Kabelunterbrechungsdiagnose am Anschluss Pumpzelle (IP)" VALUE 0xED03C Kw_Wu16 655350.0 Time_ms 0.00 655350.0 FORMAT "%8.1" /end CHARACTERISTIC
/begin CHARACTERISTIC LSUCD_DebOpnLdVirtGndDef_C "Defektentprellzeit der Kabelabfallerkennung am Pin Virtuelle Masse" VALUE 0xED03E Kw_Wu16 655350.0 Time_ms 0.00 655350.0 FORMAT "%8.1" /end CHARACTERISTIC
/begin CHARACTERISTIC LSUCD_DebOpnLdVirtGndOk_C "Heilungsentprellzeit der Kabelabfallerkennung am Pin Virtuelle Masse" VALUE 0xED040 Kw_Wu16 655350.0 Time_ms 0.00 655350.0 FORMAT "%8.1" /end CHARACTERISTIC
/begin CHARACTERISTIC LSUCD_DebOpnLdNernstDef_C "Defektentprellzeit der Kabelabfallerkennung am Pin UN" VALUE 0xED042 Kw_Wu16 655350.0 Time_ms 0.00 655350.0 FORMAT "%8.1" /end CHARACTERISTIC
/begin CHARACTERISTIC LSUCD_DebOpnLdNernstOk_C "Heilungsentprellzeit der Kabelabfallerkennung am Pin UN" VALUE 0xED044 Kw_Wu16 655350.0 Time_ms 0.00 655350.0 FORMAT "%8.1" /end CHARACTERISTIC
/begin CHARACTERISTIC LSU_DebO2ConcHighDef_C "Zählerstand zur Defektentprellung unplausibel hohe O2-Konzentration" VALUE 0xECE18 Kw_Wu16 65535.00 OneToOne 0.00 65535.00 FORMAT "%8.2" /end CHARACTERISTIC
/begin CHARACTERISTIC LSU_DebO2ConcHighOk_C "Zählerstand zur Heilungsentprellung unplausibel hohe O2-Konzentration" VALUE 0xECE1A Kw_Wu16 65535.00 OneToOne 0.00 65535.00 FORMAT "%8.2" /end CHARACTERISTIC
/begin CHARACTERISTIC LSU_DebO2ConcLowDef_C "Zählerstand zur Defektentprellung unplausibel niedrige O2-Konzentration" VALUE 0xECE1C Kw_Wu16 65535.00 OneToOne 0.00 65535.00 FORMAT "%8.2" /end CHARACTERISTIC
/begin CHARACTERISTIC LSU_DebO2ConcLowOk_C "Zählerstand zur Heilungsentprellung unplausibel niedrige O2-Konzentration" VALUE 0xECE1E Kw_Wu16 65535.00 OneToOne 0.00 65535.00 FORMAT "%8.2" /end CHARACTERISTIC
/begin CHARACTERISTIC LSU_tiOvrRunDebNeg_C "Entprellzeit (Übergang von high nach low) der Schuberkennung" VALUE 0xECDDE Kw_Wu16 655350.0 TimeDeb 0.00 655350.0 FORMAT "%8.1" /end CHARACTERISTIC
/begin CHARACTERISTIC LSU_tiOvrRunDebPos_C "Entprellzeit (Übergang von low nach high) der Schuberkennung" VALUE 0xECDE0 Kw_Wu16 655350.0 TimeDeb 0.00 655350.0 FORMAT "%8.1" /end CHARACTERISTIC
/begin CHARACTERISTIC LSUCD_tiDebHeaterDef_C "Defektentprellung Lambdasonden Heizerendstufe" VALUE 0xECEB8 Kw_Wu16 655350.0 Time_ms 0.00 655350.0 FORMAT "%8.1" /end CHARACTERISTIC
/begin CHARACTERISTIC LSUCD_tiDebHeaterOk_C "Heilungsentprellung der Heizerendstufe Lambdasensor" VALUE 0xECEBA Kw_Wu16 655350.0 Time_ms 0.00 655350.0 FORMAT "%8.1" /end CHARACTERISTIC
/begin CHARACTERISTIC LSUCD_uBattNominal_C "Nominale Batteriespannung für Heizleistungskorrektur (= Spannung die 100 % entspricht)" VALUE 0xECEBC Kw_Wu16 15992.18 Volt_Batt 0.00 15992.18 FORMAT "%8.2" EXTENDED_LIMITS 0.00 1281232. /end CHARACTERISTIC
/begin CHARACTERISTIC LSUCD_uBattMaxHigh_C "Schwelle für Abschaltung Heizeransteuern aufgrund zu hoher Batteriespannung" VALUE 0xECEBE Kw_Ws16 665630.5 Volt_Batt -640625.6 25004.89 FORMAT "%8.1" EXTENDED_LIMITS -640625.6 640606.1 /end CHARACTERISTIC
/begin CHARACTERISTIC LSUCD_uBattMaxLow_C "Schwelle für Rücknahme Abschaltung Heizeransteuern aufgrund zu hoher Batteriespannung" VALUE 0xECEC0 Kw_Ws16 665630.5 Volt_Batt -640625.6 25004.89 FORMAT "%8.1" EXTENDED_LIMITS -640625.6 640606.1 /end CHARACTERISTIC
/begin CHARACTERISTIC LSUCD_stPwrStgDia_C "Verriegelungsmaske für Heizer Endstufen Diagnose" VALUE 0xECEC2 Kw_Wu8 255.0 OneToOne 0.00 255.0 FORMAT "%5.1" /end CHARACTERISTIC
/begin CHARACTERISTIC LSUCD_dcycTstPowerStage_C "Tastverhältnis zum Einschalten der nicht-SPI-steuerbare Endstufe bei einem SCB-Fehler" VALUE 0xECEC4 Kw_Ws16 50.00000 DtyCyc 0.00 50.00000 FORMAT "%8.5" EXTENDED_LIMITS -327.6800 327.6700 /end CHARACTERISTIC
/begin CHARACTERISTIC LSUCD_tiDebReset_C "Zeitverzögerung für zurücksetzen PWM Fehlerentprellung bei nicht aktiver Ansteuerung" VALUE 0xECEC6 Kw_Wu16 655350.0 Time_ms 0.00 655350.0 FORMAT "%8.1" /end CHARACTERISTIC
/begin CHARACTERISTIC LSUCD_stHtDis_C "Maske zur Auswahl der Betriebsmode abhängigen Abschaltbedingungen der Heizer Endstufe" VALUE 0xECEC8 Kw_Wu8 255.0 OneToOne 0.00 255.0 FORMAT "%5.1" /end CHARACTERISTIC
/begin CHARACTERISTIC LSUCD_stHeaterPwrStgSel_C "Applikationsparameter für die Heizerendstufe (1 für TLE6232)" VALUE 0xECEC9 Kw_Wu8 255.0 OneToOne 0.00 255.0 FORMAT "%5.1" /end CHARACTERISTIC
/begin CHARACTERISTIC LSUCD_tiHeaterBattDefDelay_C "Zeitverzögerung der Heizerdiagnose nachdem der Heizungsregeler aktiv ist" VALUE 0xECECA Kw_Wu16 655350.0 Time_ms 0.00 655350.0 FORMAT "%8.1" /end CHARACTERISTIC
/begin CHARACTERISTIC LSUCD_stRefPumpDis_C "Maske zur Auswahl der Betriebsart abhängigen Abschaltbedingungen für den Referenzpumpstrom" VALUE 0xECECC Kw_Wu8 255.0 OneToOne 0.00 255.0 FORMAT "%5.1" /end CHARACTERISTIC
/begin CHARACTERISTIC LSUCD_tiRefPumpHigh_C "Zeit für Regeneration Referenzzelle mit erhöhtem Pumpstrom" VALUE 0xECECE Kw_Wu16 655350.0 Time_ms 0.00 655350.0 FORMAT "%8.1" /end CHARACTERISTIC
/begin CHARACTERISTIC LSUCD_tiRefTransLow_C "Verzögerungszeit bis zum Setzen des Bits in LSUCD_stRefPmp nach Übergang von hohem zu niedrigem Referenzpumpstrom" VALUE 0xECED0 Kw_Wu16 655350.0 Time_ms 0.00 655350.0 FORMAT "%8.1" /end CHARACTERISTIC
/begin CHARACTERISTIC LSUCD_tiRgnEna_C "Zeit-Periode für Regeneration" VALUE 0xECED2 Kw_Wu16 655350.0 Time_ms 0.00 655350.0 FORMAT "%8.1" /end CHARACTERISTIC
/begin CHARACTERISTIC LSUCD_tiRgnIpSettle_C "Zeitdauer zum Ausregeln des Pumpstroms nach Regeneration (nur für CJ125)" VALUE 0xECED4 Kw_Wu16 655350.0 Time_ms 0.00 655350.0 FORMAT "%8.1" /end CHARACTERISTIC
/begin CHARACTERISTIC LSUCD_swtRgnChngCirct_C "Schalter der geänderten Hardware für die Pumpstromumkehr (T1120-->1, sonst-->0)" VALUE 0xECED6 Kw_Wu8 255.0 OneToOne 0.00 255.0 FORMAT "%5.1" /end CHARACTERISTIC
/begin CHARACTERISTIC LSUCD_tiDebLowBattErrDef_C "Defekterkennungszeit für Fehler niedrige Batteriespannung" VALUE 0xED046 Kw_Wu16 655350.0 Time_ms 0.00 655350.0 FORMAT "%8.1" /end CHARACTERISTIC
/begin CHARACTERISTIC LSUCD_tiDebLowBattErrOk_C "Heilungszeit für Fehler niedrige Batteriespannung" VALUE 0xED048 Kw_Wu16 655350.0 Time_ms 0.00 655350.0 FORMAT "%8.1" /end CHARACTERISTIC
/begin CHARACTERISTIC LSU_mAirMaxClb1_C "upper air mass threshold for calibration/regeneration of  CJ120/125 (for operating point1)" VALUE 0xECDAE Kw_Ws16 6553.500 AirMassPerCyl -3276.800 3276.700 FORMAT "%8.3" /end CHARACTERISTIC
/begin CHARACTERISTIC LSU_mAirMaxClb2_C "upper air mass threshold for calibration/regeneration of CJ120/125 (for operating point2)" VALUE 0xECDB0 Kw_Ws16 6553.500 AirMassPerCyl -3276.800 3276.700 FORMAT "%8.3" /end CHARACTERISTIC
/begin CHARACTERISTIC LSU_mAirMax_C "obere Luftmassen-Schwelle für Plausibilitätscheck (0 - Vollast, 1 - Teillast, 2 - Schub)" VAL_BLK 0xECE20 Kwb_Ws16 6553.500 AirMassPerCyl -3276.800 3276.700 FORMAT "%8.3" NUMBER 3 /end CHARACTERISTIC
/begin CHARACTERISTIC LSU_mAirMinClb1_C "lower air mass threshold for calibration/regeneration of CJ120/125 (for operating point1)" VALUE 0xECDB2 Kw_Ws16 6553.500 AirMassPerCyl -3276.800 3276.700 FORMAT "%8.3" /end CHARACTERISTIC
/begin CHARACTERISTIC LSU_mAirMinClb2_C "lower air mass threshold for calibration/regeneration of  CJ120/125 (for operating point2)" VALUE 0xECDB4 Kw_Ws16 6553.500 AirMassPerCyl -3276.800 3276.700 FORMAT "%8.3" /end CHARACTERISTIC
/begin CHARACTERISTIC LSU_mAirMin_C "untere Luftmassenschwelle für Plausibilitäts-Check (0 - Vollast, 1 - Teillast, 2 - Schub)" VAL_BLK 0xECE26 Kwb_Ws16 6553.500 AirMassPerCyl -3276.800 3276.700 FORMAT "%8.3" NUMBER 3 /end CHARACTERISTIC
/begin CHARACTERISTIC LSUCD_tiDebO2MaxTstDef_C "Defekt Entprellung der oberen Grenze  Sauerstoffsignal mit reduzierter Verstärkung" VALUE 0xECF24 Kw_Wu16 655350.0 Time_ms 0.00 655350.0 FORMAT "%8.1" /end CHARACTERISTIC
/begin CHARACTERISTIC LSUCD_tiDebO2MaxTstOk_C "Heilungs Entprellung der oberen Grenze  Sauerstoffsignal mit reduzierter Verstärkung" VALUE 0xECF26 Kw_Wu16 655350.0 Time_ms 0.00 655350.0 FORMAT "%8.1" /end CHARACTERISTIC
/begin CHARACTERISTIC LSUCD_tiDebO2MinDef_C "Defekt Entprellung der unteren Genze Sauerstoffsignal" VALUE 0xECF28 Kw_Wu16 655350.0 Time_ms 0.00 655350.0 FORMAT "%8.1" /end CHARACTERISTIC
/begin CHARACTERISTIC LSUCD_tiDebO2MinOk_C "Heilungsentprellung untere Grenze Sauerstoffsignal" VALUE 0xECF2A Kw_Wu16 655350.0 Time_ms 0.00 655350.0 FORMAT "%8.1" /end CHARACTERISTIC
/begin CHARACTERISTIC LSUCD_tiDebCircNernstDef_C "Defekt Entprellung des Nernst Anschlusses der Lambdasonde" VALUE 0xED04A Kw_Wu16 655350.0 Time_ms 0.00 655350.0 FORMAT "%8.1" /end CHARACTERISTIC
/begin CHARACTERISTIC LSUCD_tiDebCircNernstOk_C "Heilungsentprellung des Nernst Anschlusses Lambdasensor" VALUE 0xED04C Kw_Wu16 655350.0 Time_ms 0.00 655350.0 FORMAT "%8.1" /end CHARACTERISTIC
/begin CHARACTERISTIC LSU_nMaxClb1_C "obere Drehzahlschwelle für Kalibrierung/Regeneration des  CJ120/125 (für Betriebspunkt 1)" VALUE 0xECDB6 Kw_Ws16 65535.00 EngN -32768.00 32767.00 FORMAT "%8.2" /end CHARACTERISTIC
/begin CHARACTERISTIC LSU_nMaxClb2_C "obere Drehzahlschwelle für Kalibrierung/Regeneration des  CJ120/125 (für Betriebspunkt 2)" VALUE 0xECDB8 Kw_Ws16 65535.00 EngN -32768.00 32767.00 FORMAT "%8.2" /end CHARACTERISTIC
/begin CHARACTERISTIC LSU_nMax_C "obere Drehzahlschwelle für Plausibilitäts-Check (0 - Vollast, 1 - Teillast, 2 - Schub)" VAL_BLK 0xECE2C Kwb_Ws16 65535.00 EngN -32768.00 32767.00 FORMAT "%8.2" NUMBER 3 /end CHARACTERISTIC
/begin CHARACTERISTIC LSU_nMinChkDyn_C "minimale Drehzahl zur Aktivierung Dynamiküberwachung" VALUE 0xECE32 Kw_Ws16 65535.00 EngN -32768.00 32767.00 FORMAT "%8.2" /end CHARACTERISTIC
/begin CHARACTERISTIC LSU_nMinClb1_C "untere Drehzahlschwelle für Kalibrierung/Regeneration des  CJ120/125 (für Betriebspunkt 1)" VALUE 0xECDBA Kw_Ws16 65535.00 EngN -32768.00 32767.00 FORMAT "%8.2" /end CHARACTERISTIC
/begin CHARACTERISTIC LSU_nMinClb2_C "untere Drehzahlschwelle für Kalibrierung/Regeneration des  CJ120/125 (für Betriebspunkt 2)" VALUE 0xECDBC Kw_Ws16 65535.00 EngN -32768.00 32767.00 FORMAT "%8.2" /end CHARACTERISTIC
/begin CHARACTERISTIC LSU_nMin_C "untere Drehzahlschwelle für Plausibilitäts-Check (0 - Vollast, 1 - Teillast, 2 - Schub)" VAL_BLK 0xECE34 Kwb_Ws16 65535.00 EngN -32768.00 32767.00 FORMAT "%8.2" NUMBER 3 /end CHARACTERISTIC
/begin CHARACTERISTIC LSUCD_tiDelO2Clb_C "Wartezeit auf Einschwingen O2 Abgleichwert" VALUE 0xECF2C Kw_Wu16 100.0000 Time_ms 0.00 100.0000 FORMAT "%8.4" EXTENDED_LIMITS 0.00 655350.0 /end CHARACTERISTIC
/begin CHARACTERISTIC LSUCD_tiO2Clb_C "Lernzeit O2 Abgleichwert" VALUE 0xECF2E Kw_Wu16 100.0000 Time_ms 0.00 100.0000 FORMAT "%8.4" EXTENDED_LIMITS 0.00 655350.0 /end CHARACTERISTIC
/begin CHARACTERISTIC LSUCD_tiDelO2Val_C "Wartezeit auf Einschwingen O2 Meßwert nach Abgleich" VALUE 0xECF30 Kw_Wu16 100.0000 Time_ms 0.00 100.0000 FORMAT "%8.4" EXTENDED_LIMITS 0.00 655350.0 /end CHARACTERISTIC
/begin CHARACTERISTIC LSUCD_uO2Ref_C "Sollspannung Auswerteschaltung bei Lambda = 1" VALUE 0xECF32 Kw_Ws16 5000.000 Volt 0.00 5000.000 FORMAT "%8.3" EXTENDED_LIMITS -160156.4 160151.5 /end CHARACTERISTIC
/begin CHARACTERISTIC LSUCD_uO2ClbMax_C "Maximal zulässiger O2 Spannungskorrekturwert" VALUE 0xECF34 Kw_Ws16 320307.9 Volt -160156.4 160151.5 FORMAT "%8.1" /end CHARACTERISTIC
/begin CHARACTERISTIC LSUCD_uO2ClbMin_C "Minimal zulässiger O2 Spannungskorrekturwert" VALUE 0xECF36 Kw_Ws16 320307.9 Volt -160156.4 160151.5 FORMAT "%8.1" /end CHARACTERISTIC
/begin CHARACTERISTIC LSUCD_swtO2Filter_C "Schalter zur aktivierung der O2 Rohspannungs Filterung (0= Filter aus, 1 = Filter an)" VALUE 0xECF38 Kw_Wu8 1.000 OneToOne 0.00 1.000 FORMAT "%5.3" EXTENDED_LIMITS 0.00 255.0 /end CHARACTERISTIC
/begin CHARACTERISTIC LSUCD_uO2MaxNorm_C "Zulässige obere Spannungsgrenze für Normalkennlinie" VALUE 0xECF3A Kw_Ws16 5000.000 Volt 0.00 5000.000 FORMAT "%8.3" EXTENDED_LIMITS -160156.4 160151.5 /end CHARACTERISTIC
/begin CHARACTERISTIC LSUCD_uO2MaxTst_C "Zulässige obere Spannungsgrenze für Fettkennlinie (Nur für Test verwendet)" VALUE 0xECF3C Kw_Ws16 5000.000 Volt 0.00 5000.000 FORMAT "%8.3" EXTENDED_LIMITS -160156.4 160151.5 /end CHARACTERISTIC
/begin CHARACTERISTIC LSUCD_uO2Min_C "Unter Grenze Signalbereich" VALUE 0xECF3E Kw_Ws16 5000.000 Volt 0.00 5000.000 FORMAT "%8.3" EXTENDED_LIMITS -160156.4 160151.5 /end CHARACTERISTIC
/begin CHARACTERISTIC LSUCD_swtSensDrftComp_C "Schalter zur Driftkompensation bei Auswahl eines Sensors hoher Empfindlichkeit[-]" VALUE 0xECF40 Kw_Wu8 1.000 OneToOne 0.00 1.000 FORMAT "%5.3" EXTENDED_LIMITS 0.00 255.0 /end CHARACTERISTIC
/begin CHARACTERISTIC LSUCD_tiDebCircPumpDef_C "Defekt Entrpellung des Pumpstromanschlusses der Lambdasonde" VALUE 0xED04E Kw_Wu16 655350.0 Time_ms 0.00 655350.0 FORMAT "%8.1" /end CHARACTERISTIC
/begin CHARACTERISTIC LSUCD_tiDebCircPumpOk_C "Heilungsentprellung des Pumpstromanschlusses Lambdasensor" VALUE 0xED050 Kw_Wu16 655350.0 Time_ms 0.00 655350.0 FORMAT "%8.1" /end CHARACTERISTIC
/begin CHARACTERISTIC LSU_qDiffMax_C "Toleranzband Einspritzmenge für Stationärerkennung" VALUE 0xECE3A Kw_Ws16 655.3500 InjMass -327.6800 327.6700 FORMAT "%8.4" /end CHARACTERISTIC
/begin CHARACTERISTIC LSU_qMaxClb1_C "obere Mengenschwelle für Kalibrierung/Regeneration des  CJ120/125 (für Betriebspunkt 1)" VALUE 0xECDBE Kw_Ws16 655.3500 InjMass -327.6800 327.6700 FORMAT "%8.4" /end CHARACTERISTIC
/begin CHARACTERISTIC LSU_qMaxClb2_C "obere Mengenschwelle für Kalibrierung/Regeneration des  CJ120/125 (für Betriebspunkt 2)" VALUE 0xECDC0 Kw_Ws16 655.3500 InjMass -327.6800 327.6700 FORMAT "%8.4" /end CHARACTERISTIC
/begin CHARACTERISTIC LSU_qMax_C "obere Mengenschwelle für Plausibilitäts-Check (0 - Vollast, 1 - Teillast, 2 - Schub)" VAL_BLK 0xECE3C Kwb_Ws16 655.3500 InjMass -327.6800 327.6700 FORMAT "%8.4" NUMBER 3 /end CHARACTERISTIC
/begin CHARACTERISTIC LSU_qMinClb1_C "untere Mengenschwelle für Kalibrierung/Regeneration des  CJ120/125 (für Betriebspunkt 1)" VALUE 0xECDC2 Kw_Ws16 655.3500 InjMass -327.6800 327.6700 FORMAT "%8.4" /end CHARACTERISTIC
/begin CHARACTERISTIC LSU_qMinClb2_C "untere Mengenschwelle für Kalibrierung/Regeneration des  CJ120/125 (für Betriebspunkt 2)" VALUE 0xECDC4 Kw_Ws16 655.3500 InjMass -327.6800 327.6700 FORMAT "%8.4" /end CHARACTERISTIC
/begin CHARACTERISTIC LSU_qMin_C "untere Mengenschwelle für Plausibilitäts-Check (0 - Vollast, 1 - Teillast, 2 - Schub)" VAL_BLK 0xECE42 Kwb_Ws16 655.3500 InjMass -327.6800 327.6700 FORMAT "%8.4" NUMBER 3 /end CHARACTERISTIC
/begin CHARACTERISTIC LSU_qThresChkDyn_C "minimale Kraftstoffmenge für Aktivierung Dynamiküberwachung" VALUE 0xECE48 Kw_Ws16 655.3500 InjMass -327.6800 327.6700 FORMAT "%8.4" /end CHARACTERISTIC
/begin CHARACTERISTIC LSU_qThresOvrRun_C "Mengenschwelle zur Schuberkennung" VALUE 0xECE4A Kw_Ws16 655.3500 InjMass -327.6800 327.6700 FORMAT "%8.4" /end CHARACTERISTIC
/begin CHARACTERISTIC LSUCD_tiDelRiClb_C "Wartezeit auf Einschwingen Ri Abgleichwert" VALUE 0xECFEA Kw_Wu16 100.0000 Time_ms 0.00 100.0000 FORMAT "%8.4" EXTENDED_LIMITS 0.00 655350.0 /end CHARACTERISTIC
/begin CHARACTERISTIC LSUCD_tiRiClb_C "Lernzeit Ri Abgleichwert" VALUE 0xECFEC Kw_Wu16 150.0000 Time_ms 0.00 150.0000 FORMAT "%8.4" EXTENDED_LIMITS 0.00 655350.0 /end CHARACTERISTIC
/begin CHARACTERISTIC LSUCD_tiDelRiVal_C "Wartezeit auf Einschwingen Ri Meßwert nach Abgleich" VALUE 0xECFEE Kw_Wu16 100.0000 Time_ms 0.00 100.0000 FORMAT "%8.4" EXTENDED_LIMITS 0.00 655350.0 /end CHARACTERISTIC
/begin CHARACTERISTIC LSUCD_tiRiFltSettle_C "Maximale Zeitdauer zur Deaktivierung der Störungsunterdrückung" VALUE 0xECFF0 Kw_Wu16 3000.000 Time_ms 0.00 3000.000 FORMAT "%8.3" EXTENDED_LIMITS 0.00 655350.0 /end CHARACTERISTIC
/begin CHARACTERISTIC LSUCD_resRiMaxJmp_C "Maximal zulässige Ri-Änderung zwischen gemessenem und zuletzt gefiltertem Wert" VALUE 0xECFF2 Kw_Wu16 6553.500 Resist 0.00 6553.500 FORMAT "%8.3" /end CHARACTERISTIC
/begin CHARACTERISTIC LSUCD_uRiOfs_C "Sollspannung während Ri Offsetabgleich" VALUE 0xECFF4 Kw_Ws16 5000.000 Volt 0.00 5000.000 FORMAT "%8.3" EXTENDED_LIMITS -160156.4 160151.5 /end CHARACTERISTIC
/begin CHARACTERISTIC LSUCD_facUToRi_C "Umrechnungsfaktor Meßspannung in Ri" VALUE 0xECFF6 Kw_Ws16 1.289275 VoltToRes -0.6446474 0.6446277 FORMAT "%9.7" /end CHARACTERISTIC
/begin CHARACTERISTIC LSUCD_resRiClbRef_C "Wert Ri Referenzwiderstand" VALUE 0xECFF8 Kw_Ws16 6553.500 Resist -3276.800 3276.700 FORMAT "%8.3" /end CHARACTERISTIC
/begin CHARACTERISTIC LSUCD_resRiClbMax_C "Maximal zulässiger Ri Korrekturwert" VALUE 0xECFFA Kw_Ws16 6553.500 Resist -3276.800 3276.700 FORMAT "%8.3" /end CHARACTERISTIC
/begin CHARACTERISTIC LSUCD_resRiClbMin_C "Minimal zulässiger Ri Korrekturwert" VALUE 0xECFFC Kw_Ws16 6553.500 Resist -3276.800 3276.700 FORMAT "%8.3" /end CHARACTERISTIC
/begin CHARACTERISTIC LSUCD_numRiDistSupp_C "Anzahl der aufeinanderfolgenden Zyklen zur Störungsunterdrückung" VALUE 0xECFFE Kw_Wu8 255.0 OneToOne 0.00 255.0 FORMAT "%5.1" /end CHARACTERISTIC
/begin CHARACTERISTIC LSU_rLmbdRec_CUR "Kennlinie für Kehrwert von Lambda" CURVE 0xECDE6 Kl_Xs16_Ws16 65.53500 lambdaRecVal -32.76800 32.76700 FORMAT "%8.5"
 /begin AXIS_DESCR STD_AXIS LSU_rO2AdptLastLSU_mp O2 11 -0.3276800 0.3276700 FORMAT "%9.7" DEPOSIT ABSOLUTE /end AXIS_DESCR
/end CHARACTERISTIC
/begin CHARACTERISTIC LSU_rO2ConstVal_C "Mitte Toleranzband für Lambda-1-Erkennung" VALUE 0xECE4C Kw_Ws16 0.6553500 O2 -0.3276800 0.3276700 FORMAT "%9.7" /end CHARACTERISTIC
/begin CHARACTERISTIC LSU_tiDvtFlt_C "Filterzeitkonstante Lambda-1-Erkennung" VALUE 0xECE50 Kw_Wu32 4294.9673 TimeDelay_s 0.0000010000000 4294.9673 FORMAT "%9.4" /end CHARACTERISTIC
/begin CHARACTERISTIC LSU_rO2Lmbd1Thres_C "Toleranzband für Lambda-1-Erkennung" VALUE 0xECE54 Kw_Ws16 0.6553500 O2 -0.3276800 0.3276700 FORMAT "%9.7" /end CHARACTERISTIC
/begin CHARACTERISTIC LSU_rO2MaxVar_C "Breite des Toleranzbands für O2-Stationärerkennung" VALUE 0xECE56 Kw_Ws16 0.6553500 O2 -0.3276800 0.3276700 FORMAT "%9.7" /end CHARACTERISTIC
/begin CHARACTERISTIC LSU_rO2Min_C "minimaler O2-Sollwert für Aktivierung der Lambda-1-Erkennung" VALUE 0xECE58 Kw_Ws16 0.6553500 O2 -0.3276800 0.3276700 FORMAT "%9.7" /end CHARACTERISTIC
/begin CHARACTERISTIC LSU_rO2NegDvt_C "negative O2-Toleranz (0 - Vollast, 1 - Teillast, 2 - Schub)" VAL_BLK 0xECE5A Kwb_Ws16 0.6553500 O2 -0.3276800 0.3276700 FORMAT "%9.7" NUMBER 3 /end CHARACTERISTIC
/begin CHARACTERISTIC LSU_rO2PosDvt_C "positive O2-Toleranz (0 - Vollast, 1 - Teillast, 2 - Schub)" VAL_BLK 0xECE60 Kwb_Ws16 0.6553500 O2 -0.3276800 0.3276700 FORMAT "%9.7" NUMBER 3 /end CHARACTERISTIC
/begin CHARACTERISTIC LSU_stChpClbActv_C "Aktivierungsflags für O2- und Ri-Kalibrierung" VALUE 0xECDC6 Kw_Wu8 3.000 OneToOne 0.00 3.000 FORMAT "%5.3" EXTENDED_LIMITS 0.00 255.0 /end CHARACTERISTIC
/begin CHARACTERISTIC LSU_stEGTClbOff_C "Bitmaske zur Unterdrückung der CJ12x-Kalibrierung bei Regenerationsanforderung Abgasnachbehandlung" VALUE 0xECDC8 Kw_Wu32 4294967295.00 OneToOne 0.00 4294967295.00 FORMAT "%13.2" /end CHARACTERISTIC
/begin CHARACTERISTIC LSU_stMonActv_C "Aktivierungsflags für Diagnoseroutinen" VALUE 0xECE66 Kw_Wu16 65535.00 OneToOne 0.00 65535.00 FORMAT "%8.2" /end CHARACTERISTIC
/begin CHARACTERISTIC LSU_stMonMsk_C "Bitmaske zur Unterdrückung der Diagnosen im Fall einer Regenerationsanforderung der Abgasnachbehandlung" VALUE 0xECE68 Kw_Wu32 4294967295.00 OneToOne 0.00 4294967295.00 FORMAT "%13.2" /end CHARACTERISTIC
/begin CHARACTERISTIC LSU_stSelPlausChkSig_C "Auswahl O2-Signal für Plausibilisierung" VALUE 0xECE6C Kw_Wu16 65535.00 OneToOne 0.00 65535.00 FORMAT "%8.2" /end CHARACTERISTIC
/begin CHARACTERISTIC LSU_swtVal_C "Freigabe oder Sperren der LSU-Funktionen - 1: ON,  0: OFF" VALUE 0xECDE2 Kw_Wu8 1.000 OneToOne 0.00 1.000 FORMAT "%5.3" EXTENDED_LIMITS 0.00 255.0 /end CHARACTERISTIC
/begin CHARACTERISTIC LSU_swtType_C "Datensatz oder EEPROM-Wert Freigabe LSU Funktion" VALUE 0xECDE3 Kw_Wu8 0.00 OneToOne 2.000 2.000 FORMAT "%5.3" EXTENDED_LIMITS 0.00 255.0 /end CHARACTERISTIC
/begin CHARACTERISTIC LSU_ti1stClb_C "Zeitdauer von SG-Start bis zu erster Kalibrierung CJ120" VALUE 0xECDCC Kw_Wu16 655.3500 Time_s 0.00 655.3500 FORMAT "%8.4" /end CHARACTERISTIC
/begin CHARACTERISTIC LSU_tiDvt1Flt_C "Filterzeitkonstante für Lambda-1-Erkennung" VALUE 0xECE6E Kw_Wu16 655.3500 Time_s 0.00 655.3500 FORMAT "%8.4" /end CHARACTERISTIC
/begin CHARACTERISTIC LSU_tiO2CalcFlt_C "Filterzeitkonstante für berechneten O2-Wert" VAL_BLK 0xECE70 Kwb_Wu32 4294.9673 TimeDelay_s 0.0000010000000 4294.9673 FORMAT "%9.4" NUMBER 1 /end CHARACTERISTIC
/begin CHARACTERISTIC LSU_tiO2Eval_C "erforderliche Dauer für O2-Stationärerkennung" VALUE 0xECE74 Kw_Wu16 655.3500 Time_s 0.00 655.3500 FORMAT "%8.4" /end CHARACTERISTIC
/begin CHARACTERISTIC LSU_tiPerClb_C "Periodendauer CJ120-Kalibrierung" VALUE 0xECDCE Kw_Wu16 655.3500 Time_s 0.00 655.3500 FORMAT "%8.4" /end CHARACTERISTIC
/begin CHARACTERISTIC LSU_tiSwitch_CA "maximal zulässige Werte für Flankenzeit Last->Schub" VAL_BLK 0xECE76 Kwb_Wu16 655.3500 Time_s 0.00 655.3500 FORMAT "%8.4" NUMBER 1 /end CHARACTERISTIC
/begin CHARACTERISTIC LSU_tiWait1_CA "Zeitdauer für Stationärerkennung Dynamiküberwachung" VAL_BLK 0xECE78 Kwb_Wu16 655.3500 Time_s 0.00 655.3500 FORMAT "%8.4" NUMBER 1 /end CHARACTERISTIC
/begin CHARACTERISTIC LSU_tiWait2_CA "maximale Zeitdauer zum Erreichen der oberen O2-Schwelle in Dynamiküberwachung" VAL_BLK 0xECE7A Kwb_Wu16 655.3500 Time_s 0.00 655.3500 FORMAT "%8.4" NUMBER 1 /end CHARACTERISTIC
/begin CHARACTERISTIC LSU_tiWait3_CA "maximale Zeitdauer zum Erreichen der oberen O2-Schwelle in Dynamiküberwachung" VAL_BLK 0xECE7C Kwb_Wu16 655.3500 Time_s 0.00 655.3500 FORMAT "%8.4" NUMBER 1 /end CHARACTERISTIC
/begin CHARACTERISTIC LSU_uBattMin_C "minimale Batteriespannung" VALUE 0xECDE4 Kw_Wu16 15992.18 Volt_Batt 0.00 15992.18 FORMAT "%8.2" EXTENDED_LIMITS 0.00 1281232. /end CHARACTERISTIC
/begin CHARACTERISTIC LSU_uMinClb_C "Minimalwert zur Erkennung einer niedrigen Batteriespannung" VALUE 0xECDD0 Kw_Wu16 15992.18 Volt_Batt 0.00 15992.18 FORMAT "%8.2" EXTENDED_LIMITS 0.00 1281232. /end CHARACTERISTIC
/begin CHARACTERISTIC LSUCD_tiDebCircVirtGndDef_C "Defekt Entprellung der virtuellen Masse Lambdasensor" VALUE 0xED052 Kw_Wu16 655350.0 Time_ms 0.00 655350.0 FORMAT "%8.1" /end CHARACTERISTIC
/begin CHARACTERISTIC LSUCD_tiDebCircVirtGndOk_C "Heilungsentprellung der virtuellen Masse Lambdasensor" VALUE 0xED054 Kw_Wu16 655350.0 Time_ms 0.00 655350.0 FORMAT "%8.1" /end CHARACTERISTIC
/begin CHARACTERISTIC LSU_volMinFl_C "Minimales Kraftstoffvolumen im Tank" VALUE 0xECE7E Kw_Ws16 300.0000 Fl_Half_L 0.00 300.0000 FORMAT "%8.4" EXTENDED_LIMITS -1638.400 1638.350 /end CHARACTERISTIC
/begin CHARACTERISTIC PwrMng_B_ulcp_C "Applikationslabel fuer Powermanagement" VALUE 0xEC822 Kw_Wu8 255.0 OneToOne 0.00 255.0 FORMAT "%5.1" /end CHARACTERISTIC
/begin CHARACTERISTIC PwrMng_dmAirPerTimeCor_C "correction factor for air mass per time" VALUE 0xEC824 Kw_Ws16 1500.000 SlopeRes10000 0.00 1500.000 FORMAT "%8.3" EXTENDED_LIMITS -3.276800 3.276700 /end CHARACTERISTIC
/begin CHARACTERISTIC PwrMng_dmAirPerTimeIMax_C "Maximum integrated air mass" VALUE 0xEC826 Kw_Wu8 1500. AirMassPerTime 0.00 1500. FORMAT "%5.0" EXTENDED_LIMITS 0.00 25.50 /end CHARACTERISTIC
/begin CHARACTERISTIC PwrMng_dmAirPerTimeIMin_C "Integrated air mass minimum value" VALUE 0xEC827 Kw_Wu8 1500. AirMassPerTime 0.00 1500. FORMAT "%5.0" EXTENDED_LIMITS 0.00 25.50 /end CHARACTERISTIC
/begin CHARACTERISTIC PwrMng_dmAirPerTimeIKi_C "I-governor gain, deviation is within small signal bounds" VALUE 0xEC828 Kw_Wu32 5.00003807247 Ki 0.00 5.00003807247 FORMAT "%13.11" EXTENDED_LIMITS 0.00 999999.999767 /end CHARACTERISTIC
/begin CHARACTERISTIC PwrMng_dmAirPerTimeIKiPos_C "I-governor gain, deviation is greater than small signal bound" VALUE 0xEC82C Kw_Wu32 5.00003807247 Ki 0.00 5.00003807247 FORMAT "%13.11" EXTENDED_LIMITS 0.00 999999.999767 /end CHARACTERISTIC
/begin CHARACTERISTIC PwrMng_dmAirPerTimeIKiNeg_C "I-governor gain, deviation is less than small signal bound" VALUE 0xEC830 Kw_Wu32 5.00003807247 Ki 0.00 5.00003807247 FORMAT "%13.11" EXTENDED_LIMITS 0.00 999999.999767 /end CHARACTERISTIC
/begin CHARACTERISTIC PwrMng_dmAirPerTimeIWinPos_C "I-governor positive window border" VALUE 0xEC834 Kw_Ws16 1500.000 AirMassPerTime 0.00 1500.000 FORMAT "%8.3" EXTENDED_LIMITS -3276.800 3276.700 /end CHARACTERISTIC
/begin CHARACTERISTIC PwrMng_dmAirPerTimeIWinNeg_C "I-governor negative window border" VALUE 0xEC836 Kw_Ws16 1500.000 AirMassPerTime 0.00 1500.000 FORMAT "%8.3" EXTENDED_LIMITS -3276.800 3276.700 /end CHARACTERISTIC
/begin CHARACTERISTIC PwrMng_nB_kwdrehtHi_C "obere Hystereseschwelle für B_kwdreht" VALUE 0xEC838 Kw_Ws16 6000.000 EngN 0.00 6000.000 FORMAT "%8.3" EXTENDED_LIMITS -32768.00 32767.00 /end CHARACTERISTIC
/begin CHARACTERISTIC PwrMng_nB_kwdrehtLo_C "untere Hystereseschwelle für B_kwdreht" VALUE 0xEC83A Kw_Ws16 6000.000 EngN 0.00 6000.000 FORMAT "%8.3" EXTENDED_LIMITS -32768.00 32767.00 /end CHARACTERISTIC
/begin CHARACTERISTIC PwrMng_nB_llHigh_C "High threshold for condition low idle" VALUE 0xEC83C Kw_Ws16 6000.000 EngN 0.00 6000.000 FORMAT "%8.3" EXTENDED_LIMITS -32768.00 32767.00 /end CHARACTERISTIC
/begin CHARACTERISTIC PwrMng_nB_llLow_C "Low threshold for condition low idle" VALUE 0xEC83E Kw_Ws16 6000.000 EngN 0.00 6000.000 FORMAT "%8.3" EXTENDED_LIMITS -32768.00 32767.00 /end CHARACTERISTIC
/begin CHARACTERISTIC PwrMng_rLoadMax_C "Threshold for condition maximum load" VALUE 0xEC840 Kw_Ws16 100.0000 Prc 0.00 100.0000 FORMAT "%8.4" EXTENDED_LIMITS -400.0000 399.9878 /end CHARACTERISTIC
/begin CHARACTERISTIC PwrMng_rLoadMin_C "Minimumschwelle für Volllast Hysterese (B_vl)" VALUE 0xEC842 Kw_Ws16 100.0000 Prc 0.00 100.0000 FORMAT "%8.4" EXTENDED_LIMITS -400.0000 399.9878 /end CHARACTERISTIC
/begin CHARACTERISTIC PwrMng_stIdlingDefVal_C "defect value for n_idlms" VALUE 0xEC844 Kw_Wu8 255.0 OneToOne 0.00 255.0 FORMAT "%5.1" /end CHARACTERISTIC
/begin CHARACTERISTIC PwrMng_swtnmot_w_C "switch for nmot_w (Eng_nAvrg/CrSCD_nCurr)" VALUE 0xEC845 Kw_Wu8 1.000 OneToOne 0.00 1.000 FORMAT "%5.3" EXTENDED_LIMITS 0.00 255.0 /end CHARACTERISTIC
/begin CHARACTERISTIC PwrMng_swtPmsvActiv_C "Applikationslabel fuer Powermanagement" VALUE 0xEC846 Kw_Wu8 1.000 OneToOne 0.00 1.000 FORMAT "%5.3" EXTENDED_LIMITS 0.00 255.0 /end CHARACTERISTIC
/begin CHARACTERISTIC PwrMng_swttumg_C "switch for tumg (IATSCD_tAir/EATSCD_tAir)" VALUE 0xEC847 Kw_Wu8 1.000 OneToOne 0.00 1.000 FORMAT "%5.3" EXTENDED_LIMITS 0.00 255.0 /end CHARACTERISTIC
/begin CHARACTERISTIC PwrMng_tiChgBatt_C "Applikationslabel fuer Powermanagement" VALUE 0xEC848 Kw_Wu16 10000.00 Time_ms 0.00 10000.00 FORMAT "%8.2" EXTENDED_LIMITS 0.00 655350.0 /end CHARACTERISTIC
/begin CHARACTERISTIC PwrMng_tiHisRst_C "Applikationslabel fuer Powermanagement" VALUE 0xEC84A Kw_Wu16 10000.00 Time_ms 0.00 10000.00 FORMAT "%8.2" EXTENDED_LIMITS 0.00 655350.0 /end CHARACTERISTIC
/begin CHARACTERISTIC PwrMng_Tkat_mod_C "Applikationswert für Tkat_mod" VALUE 0xEC84C Kw_Ws16 327675.0 temp_ub_q5_o50 -163890.0 163785.0 FORMAT "%8.1" /end CHARACTERISTIC
/begin CHARACTERISTIC PwrMng_uAltTargetDefVal_C "defect value for ctrgnms" VALUE 0xEC84E Kw_Ws16 65535.00 OneToOne -32768.00 32767.00 FORMAT "%8.2" /end CHARACTERISTIC
/begin MEASUREMENT BD_BSD "Flag Diagnosebedingung aktiv/nicht aktiv für BSD-Fehler" UBYTE OneToOne 1 100 0.00 255.0 FORMAT "%5.1" ECU_ADDRESS 0x8FEC72 /end MEASUREMENT
/begin MEASUREMENT BD_GEN "Flag Diagnosebedingung aktiv/nicht aktiv für GEN-Fehler" UBYTE OneToOne 1 100 0.00 255.0 FORMAT "%5.1" ECU_ADDRESS 0x8FEC73 /end MEASUREMENT
/begin MEASUREMENT BD_IBS1 "Flag Diagnosebedingung aktiv/nicht aktiv für IBS1-Fehler" UBYTE OneToOne 1 100 0.00 255.0 FORMAT "%5.1" ECU_ADDRESS 0x8FEC74 /end MEASUREMENT
/begin MEASUREMENT BD_IBS2 "Flag Diagnosebedingung aktiv/nicht aktiv für IBS2-Fehler" UBYTE OneToOne 1 100 0.00 255.0 FORMAT "%5.1" ECU_ADDRESS 0x8FEC75 /end MEASUREMENT
/begin MEASUREMENT BD_IBS3 "Flag Diagnosebedingung aktiv/nicht aktiv für IBS3-Fehler" UBYTE OneToOne 1 100 0.00 255.0 FORMAT "%5.1" ECU_ADDRESS 0x8FEC76 /end MEASUREMENT
/begin MEASUREMENT BD_MANHYDR "Flag Diagnosebedingung aktiv/nicht aktiv für MANHYDR-Fehler" UBYTE OneToOne 1 100 0.00 255.0 FORMAT "%5.1" ECU_ADDRESS 0x8FEC77 /end MEASUREMENT
/begin MEASUREMENT BD_MANLUFT "Flag Diagnosebedingung aktiv/nicht aktiv für MANLUFT-Fehler" UBYTE OneToOne 1 100 0.00 255.0 FORMAT "%5.1" ECU_ADDRESS 0x8FEC78 /end MEASUREMENT
/begin MEASUREMENT BD_PMBATT "Flag Diagnosebedingung aktiv/nicht aktiv für PMBATT-Fehler" UBYTE OneToOne 1 100 0.00 255.0 FORMAT "%5.1" ECU_ADDRESS 0x8FEC79 /end MEASUREMENT
/begin MEASUREMENT BD_PMBN "Flag Diagnosebedingung aktiv/nicht aktiv für PMBN-Fehler" UBYTE OneToOne 1 100 0.00 255.0 FORMAT "%5.1" ECU_ADDRESS 0x8FEC7A /end MEASUREMENT
/begin MEASUREMENT BD_PMRUHVERL "Flag Diagnosebedingung aktiv/nicht aktiv für PMRUHVERL-Fehler" UBYTE OneToOne 1 100 0.00 255.0 FORMAT "%5.1" ECU_ADDRESS 0x8FEC7B /end MEASUREMENT
/begin MEASUREMENT BD_QLT "Flag Diagnosebedingung aktiv/nicht aktiv für QLT-Fehler" UBYTE OneToOne 1 100 0.00 255.0 FORMAT "%5.1" ECU_ADDRESS 0x8FEC7C /end MEASUREMENT
/begin MEASUREMENT BD_TANS "Flag Diagnosebedingung aktiv/nicht aktiv für TANS-Fehler" UBYTE OneToOne 1 100 0.00 255.0 FORMAT "%5.1" ECU_ADDRESS 0x8FEC7D /end MEASUREMENT
/begin MEASUREMENT BD_TOENS "Flag Diagnosebedingung aktiv/nicht aktiv für TOENS-Fehler" UBYTE OneToOne 1 100 0.00 255.0 FORMAT "%5.1" ECU_ADDRESS 0x8FEC7E /end MEASUREMENT
/begin MEASUREMENT BD_TUMG "Flag Diagnosebedingung aktiv/nicht aktiv für TUMG-Fehler" UBYTE OneToOne 1 100 0.00 255.0 FORMAT "%5.1" ECU_ADDRESS 0x8FEC7F /end MEASUREMENT
/begin MEASUREMENT Counter_Layer_fp1000_mp "Zähler für Layer Zustandautomat Fahrprogramm 1000ms" UBYTE OneToOne 1 100 0.00 255.0 FORMAT "%5.1" ECU_ADDRESS 0x8FECAA /end MEASUREMENT
/begin MEASUREMENT Counter_Layer_fp100_mp "Zähler für Layer Zustandautomat Fahrprogramm 100ms" UBYTE OneToOne 1 100 0.00 255.0 FORMAT "%5.1" ECU_ADDRESS 0x8FECAB /end MEASUREMENT
/begin MEASUREMENT Counter_Layer_fp10_mp "Zähler für Layer Zustandautomat Fahrprogramm 10ms" UBYTE OneToOne 1 100 0.00 255.0 FORMAT "%5.1" ECU_ADDRESS 0x8FECAC /end MEASUREMENT
/begin MEASUREMENT Counter_Layer_fp200_mp "Zähler für Layer Zustandautomat Fahrprogramm 200ms" UBYTE OneToOne 1 100 0.00 255.0 FORMAT "%5.1" ECU_ADDRESS 0x8FECAD /end MEASUREMENT
/begin MEASUREMENT Counter_Layer_fp20_mp "" UBYTE OneToOne 1 100 0.00 255.0 FORMAT "%5.1" ECU_ADDRESS 0x8FECAE /end MEASUREMENT
/begin MEASUREMENT Counter_Layer_ini_mp "Zähler für Layer Zustandautomat Initialisierung" UBYTE OneToOne 1 100 0.00 255.0 FORMAT "%5.1" ECU_ADDRESS 0x8FECAF /end MEASUREMENT
/begin MEASUREMENT Counter_Layer_nl1000_mp "Zähler für Layer Zustandautomat Nachlauf 1000ms" UBYTE OneToOne 1 100 0.00 255.0 FORMAT "%5.1" ECU_ADDRESS 0x8FECB0 /end MEASUREMENT
/begin MEASUREMENT Counter_Layer_nl100_mp "Zähler für Layer Zustandautomat Nachlauf 100ms" UBYTE OneToOne 1 100 0.00 255.0 FORMAT "%5.1" ECU_ADDRESS 0x8FECB1 /end MEASUREMENT
/begin MEASUREMENT Counter_Layer_nl10_mp "Zähler für Layer Zustandautomat Nachlauf 10ms" UBYTE OneToOne 1 100 0.00 255.0 FORMAT "%5.1" ECU_ADDRESS 0x8FECB2 /end MEASUREMENT
/begin MEASUREMENT Counter_Layer_nl200_mp "Zähler für Layer Zustandautomat Nachlauf 200ms" UBYTE OneToOne 1 100 0.00 255.0 FORMAT "%5.1" ECU_ADDRESS 0x8FECB3 /end MEASUREMENT
/begin MEASUREMENT Counter_Layer_nl20_mp "" UBYTE OneToOne 1 100 0.00 255.0 FORMAT "%5.1" ECU_ADDRESS 0x8FECB4 /end MEASUREMENT
/begin MEASUREMENT Counter_Layer_wakeup1000_mp "Zähler für Layer Zustandautomat Wakeup 1000ms" UBYTE OneToOne 1 100 0.00 255.0 FORMAT "%5.1" ECU_ADDRESS 0x8FECB5 /end MEASUREMENT
/begin MEASUREMENT Counter_Layer_wakeup100_mp "Zähler für Layer Zustandautomat Wakeup 100ms" UBYTE OneToOne 1 100 0.00 255.0 FORMAT "%5.1" ECU_ADDRESS 0x8FECB6 /end MEASUREMENT
/begin MEASUREMENT Counter_Layer_wakeup10_mp "Zähler für Layer Zustandautomat Wakeup 10ms" UBYTE OneToOne 1 100 0.00 255.0 FORMAT "%5.1" ECU_ADDRESS 0x8FECB7 /end MEASUREMENT
/begin MEASUREMENT Counter_Layer_wakeup200_mp "Zähler für Layer Zustandautomat Wakeup 200ms" UBYTE OneToOne 1 100 0.00 255.0 FORMAT "%5.1" ECU_ADDRESS 0x8FECB8 /end MEASUREMENT
/begin MEASUREMENT Counter_Layer_wakeup20_mp "" UBYTE OneToOne 1 100 0.00 255.0 FORMAT "%5.1" ECU_ADDRESS 0x8FECB9 /end MEASUREMENT
/begin MEASUREMENT E_BSD "Flag Fehler momentan vorhanden/nicht vorhanden für BSD-Fehler" UBYTE OneToOne 1 100 0.00 255.0 FORMAT "%5.1" ECU_ADDRESS 0x8FEC80 /end MEASUREMENT
/begin MEASUREMENT E_GEN "Flag Fehler momentan vorhanden/nicht vorhanden für GEN-Fehler" UBYTE OneToOne 1 100 0.00 255.0 FORMAT "%5.1" ECU_ADDRESS 0x8FEC81 /end MEASUREMENT
/begin MEASUREMENT E_IBS1 "Flag Fehler momentan vorhanden/nicht vorhanden für IBS1-Fehler" UBYTE OneToOne 1 100 0.00 255.0 FORMAT "%5.1" ECU_ADDRESS 0x8FEC82 /end MEASUREMENT
/begin MEASUREMENT E_IBS2 "Flag Fehler momentan vorhanden/nicht vorhanden für IBS2-Fehler" UBYTE OneToOne 1 100 0.00 255.0 FORMAT "%5.1" ECU_ADDRESS 0x8FEC83 /end MEASUREMENT
/begin MEASUREMENT E_IBS3 "Flag Fehler momentan vorhanden/nicht vorhanden für IBS3-Fehler" UBYTE OneToOne 1 100 0.00 255.0 FORMAT "%5.1" ECU_ADDRESS 0x8FEC84 /end MEASUREMENT
/begin MEASUREMENT E_MANHYDR "Flag Fehler momentan vorhanden/nicht vorhanden für MANHYDR-Fehler" UBYTE OneToOne 1 100 0.00 255.0 FORMAT "%5.1" ECU_ADDRESS 0x8FEC85 /end MEASUREMENT
/begin MEASUREMENT E_MANLUFT "Flag Fehler momentan vorhanden/nicht vorhanden für MANLUFT-Fehler" UBYTE OneToOne 1 100 0.00 255.0 FORMAT "%5.1" ECU_ADDRESS 0x8FEC86 /end MEASUREMENT
/begin MEASUREMENT E_PMBATT "Flag Fehler momentan vorhanden/nicht vorhanden für PMBATT-Fehler" UBYTE OneToOne 1 100 0.00 255.0 FORMAT "%5.1" ECU_ADDRESS 0x8FEC87 /end MEASUREMENT
/begin MEASUREMENT E_PMBN "Flag Fehler momentan vorhanden/nicht vorhanden für PMBN-Fehler" UBYTE OneToOne 1 100 0.00 255.0 FORMAT "%5.1" ECU_ADDRESS 0x8FEC88 /end MEASUREMENT
/begin MEASUREMENT E_PMRUHVERL "Flag Fehler momentan vorhanden/nicht vorhanden für PMRUHVERL-Fehler" UBYTE OneToOne 1 100 0.00 255.0 FORMAT "%5.1" ECU_ADDRESS 0x8FEC89 /end MEASUREMENT
/begin MEASUREMENT E_QLT "Flag Fehler momentan vorhanden/nicht vorhanden für QLT-Fehler" UBYTE OneToOne 1 100 0.00 255.0 FORMAT "%5.1" ECU_ADDRESS 0x8FEC8A /end MEASUREMENT
/begin MEASUREMENT E_TANS "Flag Fehler momentan vorhanden/nicht vorhanden für TANS-Fehler" UBYTE OneToOne 1 100 0.00 255.0 FORMAT "%5.1" ECU_ADDRESS 0x8FEC8B /end MEASUREMENT
/begin MEASUREMENT E_TOENS "Flag Fehler momentan vorhanden/nicht vorhanden für TOENS-Fehler" UBYTE OneToOne 1 100 0.00 255.0 FORMAT "%5.1" ECU_ADDRESS 0x8FEC8C /end MEASUREMENT
/begin MEASUREMENT E_TUMG "Flag Fehler momentan vorhanden/nicht vorhanden für TUMG-Fehler" UBYTE OneToOne 1 100 0.00 255.0 FORMAT "%5.1" ECU_ADDRESS 0x8FEC8D /end MEASUREMENT
/begin MEASUREMENT Layer_bos01_w "Layer Grösse Bosrlsm" SWORD km_sw_q10 1 100 -327680.0 327670.0 FORMAT "%8.1" ECU_ADDRESS 0x7F909C /end MEASUREMENT
/begin MEASUREMENT Layer_bosbtvfbk "Layer Grösse Bosbtvfbk" UBYTE rel_ub_q1 1 100 0.00 255.0 FORMAT "%5.1" ECU_ADDRESS 0x7F8981 /end MEASUREMENT
/begin MEASUREMENT Layer_bosstate "Layer Grösse Bosstate" UBYTE DEZ 1 100 0.00 255.0 FORMAT "%5.1" ECU_ADDRESS 0x7F8982 /end MEASUREMENT
/begin MEASUREMENT Layer_bosvalue_DIAG "Layer Grösse bosvalue_DIAG" UBYTE OneToOne 1 100 0.00 255.0 FORMAT "%5.1" ARRAY_SIZE 6 ECU_ADDRESS 0x7F94D0 /end MEASUREMENT
/begin MEASUREMENT Layer_FRC_INTM_T_BOS2 "BOS Prognose Intervall Zeit" UBYTE DEZ 1 100 0.00 255.0 FORMAT "%5.1" ECU_ADDRESS 0x7F897C /end MEASUREMENT
/begin MEASUREMENT Layer_FRC_INTM_WAY_BOS2 "BOS Prognose Intervall Weg" UBYTE DEZ 1 100 0.00 255.0 FORMAT "%5.1" ECU_ADDRESS 0x7F897D /end MEASUREMENT
/begin MEASUREMENT Layer_ID2_BOS2 "BOS ID" UBYTE DEZ 1 100 0.00 255.0 FORMAT "%5.1" ECU_ADDRESS 0x7F897E /end MEASUREMENT
/begin MEASUREMENT Layer_idbosmsg "Layer Grösse Id_bosmsg" UBYTE DEZ 1 100 0.00 255.0 FORMAT "%5.1" ECU_ADDRESS 0x7F8983 /end MEASUREMENT
/begin MEASUREMENT Layer_idfbosmg_w "Layer Grösse Id_bosmg" UWORD DEZ 1 100 0.00 65535.00 FORMAT "%8.2" ECU_ADDRESS 0x7F909E /end MEASUREMENT
/begin MEASUREMENT Layer_ID_FN_BOS2 "ID Funktion" SWORD DEZ 1 100 -32768.00 32767.00 FORMAT "%8.2" ECU_ADDRESS 0x7F909A /end MEASUREMENT
/begin MEASUREMENT Layer_stB_oelwech "Zustand des Ölwechsel" UBYTE OneToOne 1 100 0.00 255.0 FORMAT "%5.1" ECU_ADDRESS 0x7F8984 /end MEASUREMENT
/begin MEASUREMENT Layer_stExtWaitRdy "Bedingung EEPROM schreiben beendet" UBYTE DEZ 1 100 0.00 255.0 FORMAT "%5.1" ECU_ADDRESS 0x7F8985 /end MEASUREMENT
/begin MEASUREMENT Layer_stLayer "Layer Motorzustand" UWORD OneToOne 1 100 0.00 65535.00 FORMAT "%8.2" ECU_ADDRESS 0x7F90A0 /end MEASUREMENT
/begin MEASUREMENT Layer_stOelTog "Layer QLT Status" UBYTE DEZ 1 100 0.00 255.0 FORMAT "%5.1" ECU_ADDRESS 0x7F8986 /end MEASUREMENT
/begin MEASUREMENT Layer_stOelVerb "Layer QLT Status" UBYTE DEZ 1 100 0.00 255.0 FORMAT "%5.1" ECU_ADDRESS 0x7F8987 /end MEASUREMENT
/begin MEASUREMENT Layer_stOelVerl "Layer QLT Status" UBYTE DEZ 1 100 0.00 255.0 FORMAT "%5.1" ECU_ADDRESS 0x7F8988 /end MEASUREMENT
/begin MEASUREMENT Layer_stProcess_u8_mp "Messpunkt für Layer Status EEPROM schreiben+E33" UBYTE OneToOne 1 100 0.00 255.0 FORMAT "%5.1" ECU_ADDRESS 0x8FECBA /end MEASUREMENT
/begin MEASUREMENT Layer_st_entlast_loc "" UBYTE OneToOne 1 100 0.00 255.0 FORMAT "%5.1" ECU_ADDRESS 0x7F898A /end MEASUREMENT
/begin MEASUREMENT Layer_TARD_MON_BOS2 "Zieltermin Monat BOS" UBYTE DEZ 1 100 0.00 255.0 FORMAT "%5.1" ECU_ADDRESS 0x7F897F /end MEASUREMENT
/begin MEASUREMENT Layer_TARD_YR_BOS2 "Zieltermin Monat Jahr" UBYTE DEZ 1 100 0.00 255.0 FORMAT "%5.1" ECU_ADDRESS 0x7F8980 /end MEASUREMENT
/begin MEASUREMENT Layer_tChamWll "Brennraumwandtemperatur" SWORD Temp_Cels 1 100 -50.140 899.860 FORMAT "%8.3" ECU_ADDRESS 0x7F90A2 /end MEASUREMENT
/begin MEASUREMENT Layer_tiAbstell "Abstellzeit des Motors in Sekunde" UWORD OneToOne 1 100 0.00 65535.00 FORMAT "%8.2" ECU_ADDRESS 0x7F90A6 /end MEASUREMENT
/begin MEASUREMENT Layer_tOilEng "Motoröltemperatur" SWORD Temp_Cels 1 100 -50.140 899.860 FORMAT "%8.3" ECU_ADDRESS 0x7F90A4 /end MEASUREMENT
/begin MEASUREMENT Layer_volOil "OZ Ölqualität" UBYTE DEZ 1 100 0.00 255.0 FORMAT "%5.1" ECU_ADDRESS 0x7F898B /end MEASUREMENT
/begin MEASUREMENT Layer_volOilRefill "OZ Ölniveau" UBYTE DEZ 1 100 0.00 255.0 FORMAT "%5.1" ECU_ADDRESS 0x7F898C /end MEASUREMENT
/begin MEASUREMENT Layer_zrbosmld "anzuzeigender Zähler für durchgeführten Ölservice" UBYTE DEZ 1 100 0.00 255.0 FORMAT "%5.1" ECU_ADDRESS 0x7F898D /end MEASUREMENT
/begin MEASUREMENT LIGov_CurrDKd_mp "Aktueller Parametersatzwert kp für den D-Anteil" SLONG Kd_rpm2Nm 1 100 -3276.80000000 3276.79999847 FORMAT "%13.8" ECU_ADDRESS 0x8FECE4 /end MEASUREMENT
/begin MEASUREMENT LIGov_CurrDT1_mp "Aktueller Parametersatzwert T1 für den D-Anteil" ULONG TimeDelay_s 1 100 0.0000010000000 4294.9673 FORMAT "%9.4" ECU_ADDRESS 0x8FECE8 /end MEASUREMENT
/begin MEASUREMENT LIGov_CurrFlt1T1_mp "Aktueller Parametersatzwert T1 für erstes PT1-Filter (n-Filterung)" ULONG TimeDelay_s 1 100 0.0000010000000 4294.9673 FORMAT "%9.4" ECU_ADDRESS 0x8FECEC /end MEASUREMENT
/begin MEASUREMENT LIGov_CurrFlt2T1_mp "Aktueller Parametersatzwert T1 für zweites PT1-Filter (n-Filterung)" ULONG TimeDelay_s 1 100 0.0000010000000 4294.9673 FORMAT "%9.4" ECU_ADDRESS 0x8FECF0 /end MEASUREMENT
/begin MEASUREMENT LIGov_CurrIKiNeg_mp "Aktueller Parametersatzwert ki (negatives Großsignal) für den I-Anteil" SLONG Ki_rpm2Nm 1 100 -400000.000000 399999.999814 FORMAT "%13.6" ECU_ADDRESS 0x8FECF4 /end MEASUREMENT
/begin MEASUREMENT LIGov_CurrIKiPos_mp "Aktueller Parametersatzwert ki (positives Großsignal) für den I-Anteil" SLONG Ki_rpm2Nm 1 100 -400000.000000 399999.999814 FORMAT "%13.6" ECU_ADDRESS 0x8FECF8 /end MEASUREMENT
/begin MEASUREMENT LIGov_CurrIKi_mp "Aktueller Parametersatzwert ki (Kleinsignal) für den I-Anteil" SLONG Ki_rpm2Nm 1 100 -400000.000000 399999.999814 FORMAT "%13.6" ECU_ADDRESS 0x8FECFC /end MEASUREMENT
/begin MEASUREMENT LIGov_CurrIWinNeg_mp "Aktueller Parametersatzwert Fensterbreite (negatives Großsignal) für den I-Anteil" SWORD EngN_HiRes 1 100 -4096.000 4095.875 FORMAT "%8.3" ECU_ADDRESS 0x8FED00 /end MEASUREMENT
/begin MEASUREMENT LIGov_CurrIWinPos_mp "Aktueller Parametersatzwert Fensterbreite (positives Großsignal) für den I-Anteil" SWORD EngN_HiRes 1 100 -4096.000 4095.875 FORMAT "%8.3" ECU_ADDRESS 0x8FED02 /end MEASUREMENT
/begin MEASUREMENT LIGov_CurrPKpNeg_mp "Aktueller Parametersatzwert kp (negatives Großsignal) für den P-Anteil" SLONG Kp_rpm2Nm 1 100 -26214.4000000 26214.3999878 FORMAT "%13.7" ECU_ADDRESS 0x8FED04 /end MEASUREMENT
/begin MEASUREMENT LIGov_CurrPKpPos_mp "Aktueller Parametersatzwert kp (positives Großsignal) für den P-Anteil" SLONG Kp_rpm2Nm 1 100 -26214.4000000 26214.3999878 FORMAT "%13.7" ECU_ADDRESS 0x8FED08 /end MEASUREMENT
/begin MEASUREMENT LIGov_CurrPKp_mp "Aktueller Parametersatzwert kp (Kleinsignal) für P-Anteil" SLONG Kp_rpm2Nm 1 100 -26214.4000000 26214.3999878 FORMAT "%13.7" ECU_ADDRESS 0x8FED0C /end MEASUREMENT
/begin MEASUREMENT LIGov_CurrPWinNeg_mp "Aktueller Parametersatzwert Fensterbreite (negatives Großsignal) für den P-Anteil" SWORD EngN_HiRes 1 100 -4096.000 4095.875 FORMAT "%8.3" ECU_ADDRESS 0x8FED10 /end MEASUREMENT
/begin MEASUREMENT LIGov_CurrPWinPos_mp "Aktueller Parametersatzwert Fensterbreite (positives Großsignal) für den P-Anteil" SWORD EngN_HiRes 1 100 -4096.000 4095.875 FORMAT "%8.3" ECU_ADDRESS 0x8FED12 /end MEASUREMENT
/begin MEASUREMENT LIGov_nAvrg_mp "OLDA-Größe für Eng_nAvrg" SWORD EngN 1 100 -32768.00 32767.00 FORMAT "%8.2" ECU_ADDRESS 0x8FED14 /end MEASUREMENT
/begin MEASUREMENT LIGov_nDiffDelta_mp "Delta zur Drehzahlschwelle Sicherheitsrampe" SWORD EngN 1 100 -32768.00 32767.00 FORMAT "%8.2" ECU_ADDRESS 0x8FECBE /end MEASUREMENT
/begin MEASUREMENT LIGov_nDiffFlt1_mp "Regelabweichung hinter dem ersten PT1-Filter" SWORD EngN_HiRes 1 100 -4096.000 4095.875 FORMAT "%8.3" ECU_ADDRESS 0x8FED16 /end MEASUREMENT
/begin MEASUREMENT LIGov_nDiffFlt2_mp "Regelabweichung hinter zweitem PT1-Filter" SWORD EngN_HiRes 1 100 -4096.000 4095.875 FORMAT "%8.3" ECU_ADDRESS 0x8FED18 /end MEASUREMENT
/begin MEASUREMENT LIGov_nDiff_mp "n Regelabweichung" SWORD EngN 1 100 -32768.00 32767.00 FORMAT "%8.2" ECU_ADDRESS 0x8FED1A /end MEASUREMENT
/begin MEASUREMENT LIGov_nHDC_mp "LL-Solldrehzahl aufgrund HDC" SWORD EngN 1 100 -32768.00 32767.00 FORMAT "%8.2" ECU_ADDRESS 0x8FECC0 /end MEASUREMENT
/begin MEASUREMENT LIGov_nLimHigh "Sollgrenze des Leerlaufreglers" SWORD EngN 1 100 -32768.00 32767.00 FORMAT "%8.2" ECU_ADDRESS 0x7F9024 /end MEASUREMENT
/begin MEASUREMENT LIGov_nMaxTrq "Drehzahldifferenz zur Vermeidung von Momentensprüngen aufgrund sprungförmiger LL-Solldrehzahl" SWORD EngN 1 100 -32768.00 32767.00 FORMAT "%8.2" ECU_ADDRESS 0x7F9026 /end MEASUREMENT
/begin MEASUREMENT LIGov_nSetCoEng "Leerlaufsolldrehzahl-Anforderung vom Motor-Koordinator" SWORD EngN 1 100 -32768.00 32767.00 FORMAT "%8.2" ECU_ADDRESS 0x7F9028 /end MEASUREMENT
/begin MEASUREMENT LIGov_nSetCoEngOld_mp "Vorhergehende LL-Solldrehzahl aus CoEng_nMin (nach Rampe)" SWORD EngN 1 100 -32768.00 32767.00 FORMAT "%8.2" ECU_ADDRESS 0x8FECC2 /end MEASUREMENT
/begin MEASUREMENT LIGov_nSetGearbxOld_mp "Vorhergehende LL-Solldrehzahl aus Gearbx_nMin (nach Rampe)" SWORD EngN 1 100 -32768.00 32767.00 FORMAT "%8.2" ECU_ADDRESS 0x8FECC4 /end MEASUREMENT
/begin MEASUREMENT LIGov_nSetGearbx_mp "LL-Solldrehzahl aus Gearbx_nMin (nach Rampe)" SWORD EngN 1 100 -32768.00 32767.00 FORMAT "%8.2" ECU_ADDRESS 0x8FECC6 /end MEASUREMENT
/begin MEASUREMENT LIGov_nSetHDCOld_mp "Vorhergehende LL-Solldrehzahl aufgrund HDC (nach Rampe)" SWORD EngN 1 100 -32768.00 32767.00 FORMAT "%8.2" ECU_ADDRESS 0x8FECC8 /end MEASUREMENT
/begin MEASUREMENT LIGov_nSetHDC_mp "LL-Solldrehzahl aufgrund HDC (nach Rampe)" SWORD EngN 1 100 -32768.00 32767.00 FORMAT "%8.2" ECU_ADDRESS 0x8FECCA /end MEASUREMENT
/begin MEASUREMENT LIGov_nSetLocal0_mp "LIGov set point before adding trimming setpoint" SWORD EngN 1 100 -32768.00 32767.00 FORMAT "%8.2" ECU_ADDRESS 0x8FECCC /end MEASUREMENT
/begin MEASUREMENT LIGov_nSetLocal2 "LL-Solldrehzahl aus ""langsamen' Anforderem"" (Startabwurf, temp.abhängig, Diagnoseabgleich)" SWORD EngN 1 100 -32768.00 32767.00 FORMAT "%8.2" ECU_ADDRESS 0x7F902A /end MEASUREMENT
/begin MEASUREMENT LIGov_nSetLocalRamp "Leerlaufsolldrehzahl von langsamen Anforderungen (Diagnose, Temperatur Abhängigkeiten)" SWORD EngN 1 100 -32768.00 32767.00 FORMAT "%8.2" ECU_ADDRESS 0x7F902C /end MEASUREMENT
/begin MEASUREMENT LIGov_nSetLocalRampOld_mp "Vorhergegangene LL-Solldrehzahl aus ""langsamen Anforderern"" (nach Rampe)" SWORD EngN 1 100 -32768.00 32767.00 FORMAT "%8.2" ECU_ADDRESS 0x8FECCE /end MEASUREMENT
/begin MEASUREMENT LIGov_nSetpoint "Leerlaufsolldrehzahl" SWORD EngN 1 100 -32768.00 32767.00 FORMAT "%8.2" ECU_ADDRESS 0x7F9030 /end MEASUREMENT
/begin MEASUREMENT LIGov_nSetpointOld_mp "Vorhergegangene LL-Solldrehzahl" SWORD EngN 1 100 -32768.00 32767.00 FORMAT "%8.2" ECU_ADDRESS 0x8FECD0 /end MEASUREMENT
/begin MEASUREMENT LIGov_nSetpointPrst "Niedrige Leerlaufdrehzahl Standardwert für Energieeinsparung-Transportmodus" SWORD EngN 1 100 -32768.00 32767.00 FORMAT "%8.2" ECU_ADDRESS 0x7F9032 /end MEASUREMENT
/begin MEASUREMENT LIGov_nSetpointTemp_mp "Sollwert Leerlaufregler temperaturabhängig" SWORD EngN 1 100 -32768.00 32767.00 FORMAT "%8.2" ECU_ADDRESS 0x8FECD2 /end MEASUREMENT
/begin MEASUREMENT LIGov_nSetpointTrm "Abgleich LLR-Solldrehzahl" SWORD EngN 1 100 -32768.00 32767.00 FORMAT "%8.2" ECU_ADDRESS 0x7F9034 /end MEASUREMENT
/begin MEASUREMENT LIGov_nSetpointTrm_mp "Meßpunkt zeigt den Leerlaufsollwert nach der Korrektur mit dem Abgleichwert" SWORD EngN 1 100 -32768.00 32767.00 FORMAT "%8.2" ECU_ADDRESS 0x8FECD4 /end MEASUREMENT
/begin MEASUREMENT LIGov_nSetpoint_mp "low idle setpoint speed; normal mode" SWORD EngN 1 100 -32768.00 32767.00 FORMAT "%8.2" ECU_ADDRESS 0x8FECD6 /end MEASUREMENT
/begin MEASUREMENT LIGov_nSetPwrMng "Leerlaufsolldrehzahl-Anforderung vom Energie-Management" SWORD EngN 1 100 -32768.00 32767.00 FORMAT "%8.2" ECU_ADDRESS 0x7F902E /end MEASUREMENT
/begin MEASUREMENT LIGov_nSetPwrMngOld_mp "Vorhergegangene LL-Solldrehzahl aus PwrMng_nMin (nach Rampe)" SWORD EngN 1 100 -32768.00 32767.00 FORMAT "%8.2" ECU_ADDRESS 0x8FECD8 /end MEASUREMENT
/begin MEASUREMENT LIGov_nSetSec1_mp "Erster Sicherheitswert zur Begrenzung der LL-Solldrehzahl" SWORD EngN 1 100 -32768.00 32767.00 FORMAT "%8.2" ECU_ADDRESS 0x8FECDA /end MEASUREMENT
/begin MEASUREMENT LIGov_nSetSec2_mp "Zweiter Sicherheitswert zur Begrenzung der LL-Solldrehzahl" SWORD EngN 1 100 -32768.00 32767.00 FORMAT "%8.2" ECU_ADDRESS 0x8FECDC /end MEASUREMENT
/begin MEASUREMENT LIGov_nSetSec4_mp "Viertter Sicherheitswert zur Begrenzung der LL-Solldrehzahl" SWORD EngN 1 100 -32768.00 32767.00 FORMAT "%8.2" ECU_ADDRESS 0x8FECDE /end MEASUREMENT
/begin MEASUREMENT LIGov_nSetSurgeOld_mp "Vorhergegangene LL-Solldrehzahl aus PCR_nSetPointSurge (nach Rampe)" SWORD EngN 1 100 -32768.00 32767.00 FORMAT "%8.2" ECU_ADDRESS 0x8FECE0 /end MEASUREMENT
/begin MEASUREMENT LIGov_nSetSurge_mp "LL-Solldrehzahl aus PCR_nSetPointSurge (nach Rampe)" SWORD EngN 1 100 -32768.00 32767.00 FORMAT "%8.2" ECU_ADDRESS 0x8FECE2 /end MEASUREMENT
/begin MEASUREMENT LIGov_st "Zustand des Leerlaufreglers" UWORD OneToOne 1 100 0.00 65535.00 FORMAT "%8.2" ECU_ADDRESS 0x7F9036 /end MEASUREMENT
/begin MEASUREMENT LIGov_stActiveHDC "Zustand für aktivierte LL-Solldrehzahl aufgrund HDC" UBYTE OneToOne 1 100 0.00 255.0 FORMAT "%5.1" ECU_ADDRESS 0x7F8953 /end MEASUREMENT
/begin MEASUREMENT LIGov_stSetPoint "Status Leerlauf-Solldrehzahl-Anforderung" UWORD OneToOne 1 100 0.00 65535.00 FORMAT "%8.2" ECU_ADDRESS 0x7F9038 /end MEASUREMENT
/begin MEASUREMENT LIGov_stSetpointPrst "Status der niedrigen Leerlaufdrehzahl Standardwert für Energieeinsparung-Transportmodus" UBYTE OneToOne 1 100 0.00 255.0 FORMAT "%5.1" ECU_ADDRESS 0x7F8955 /end MEASUREMENT
/begin MEASUREMENT LIGov_stSetpointTrmActive "Bergabstatus" UBYTE OneToOne 1 100 0.00 255.0 FORMAT "%5.1" ECU_ADDRESS 0x7F8956 /end MEASUREMENT
/begin MEASUREMENT LIGov_stSetTrqActive "Status zum Moment anforderung über Diagnose für NMK Schnellernen" UBYTE OneToOne 1 100 0.00 255.0 FORMAT "%5.1" ECU_ADDRESS 0x7F8954 /end MEASUREMENT
/begin MEASUREMENT LIGov_stSetTrqAlw_mp "Status zum Erlauben oder nicht Erlauben der Moment anforderung über Diagnose für NMK Schnellernen" UBYTE OneToOne 1 100 0.00 255.0 FORMAT "%5.1" ECU_ADDRESS 0x8FED1C /end MEASUREMENT
/begin MEASUREMENT LIGov_tiPT1_mp "aktuelle PT1 Zeitkonstante für PT1 filtern des LLR Ausgangs" SWORD TimeDelay_s_Lin_16 1 100 -5.000153 5.000000 FORMAT "%8.6" ECU_ADDRESS 0x8FED1E /end MEASUREMENT
/begin MEASUREMENT LIGov_trq "Leerlaufreglermoment" SWORD Trq 1 100 -3276.800 3276.700 FORMAT "%8.3" ECU_ADDRESS 0x7F903A /end MEASUREMENT
/begin MEASUREMENT LIGov_trqCurrPredef "aktuell verwendetes Einsschrittmoment" SWORD Trq 1 100 -3276.800 3276.700 FORMAT "%8.3" ECU_ADDRESS 0x7F903C /end MEASUREMENT
/begin MEASUREMENT LIGov_trqDRaw_mp "LLR D-Anteil Rohwert (ohne Gewichtsfaktor)" SWORD Trq 1 100 -3276.800 3276.700 FORMAT "%8.3" ECU_ADDRESS 0x8FED20 /end MEASUREMENT
/begin MEASUREMENT LIGov_trqD_mp "Messpunkt für den Wert des D-Anteils des LLR" SWORD Trq 1 100 -3276.800 3276.700 FORMAT "%8.3" ECU_ADDRESS 0x8FED22 /end MEASUREMENT
/begin MEASUREMENT LIGov_trqFlt "Leerlaufreglermoment PT1 gefiltert" SWORD Trq 1 100 -3276.800 3276.700 FORMAT "%8.3" ECU_ADDRESS 0x7F903E /end MEASUREMENT
/begin MEASUREMENT LIGov_trqI "Wert des I-Anteils des LLR" SWORD Trq 1 100 -3276.800 3276.700 FORMAT "%8.3" ECU_ADDRESS 0x7F9040 /end MEASUREMENT
/begin MEASUREMENT LIGov_trqInitI "Initialisierungsmoment für I-Anteil nach Start" SWORD Trq 1 100 -3276.800 3276.700 FORMAT "%8.3" ECU_ADDRESS 0x7F9042 /end MEASUREMENT
/begin MEASUREMENT LIGov_trqIState "LIGov Status des I-Anteils" SLONG Trq 1 100 -214748364.800 214748364.700 FORMAT "%13.3" ECU_ADDRESS 0x7F9460 /end MEASUREMENT
/begin MEASUREMENT LIGov_trqLISetRdDIAG_mp "Begrenzt Moment anforderung über Diagnose für NMK Schnellernen" SWORD Trq 1 100 -3276.800 3276.700 FORMAT "%8.3" ECU_ADDRESS 0x8FED24 /end MEASUREMENT
/begin MEASUREMENT LIGov_trqMax_mp "aktueller LLR Begrenzungswert" SWORD Trq 1 100 -3276.800 3276.700 FORMAT "%8.3" ECU_ADDRESS 0x8FED26 /end MEASUREMENT
/begin MEASUREMENT LIGov_trqP "Wert des P-Anteils des LLR" SWORD Trq 1 100 -3276.800 3276.700 FORMAT "%8.3" ECU_ADDRESS 0x7F9044 /end MEASUREMENT
/begin MEASUREMENT LIGov_trqPILimMem "demanded torque of Low Idle Governor" SLONG Trq 1 100 -214748364.800 214748364.700 FORMAT "%13.3" ECU_ADDRESS 0x7F9464 /end MEASUREMENT
/begin MEASUREMENT LIGov_trqPreInitI_mp "Initialisierungswert für Integrator als Ergebnis der Integrator-Rückrechnung" SLONG Trq32 1 100 -3276.80000000 3276.79999847 FORMAT "%13.8" ECU_ADDRESS 0x8FED28 /end MEASUREMENT
/begin MEASUREMENT LIGov_trqSetDIAG "Moment anforderung über Diagnose für NMK Schnellernen" SWORD Trq 1 100 -3276.800 3276.700 FORMAT "%8.3" ECU_ADDRESS 0x7F9046 /end MEASUREMENT
/begin MEASUREMENT LIGov_trqSet_mp "Begrenzt Moment anforderung über Diagnose für NMK Schnellernen" SWORD Trq 1 100 -3276.800 3276.700 FORMAT "%8.3" ECU_ADDRESS 0x8FED2C /end MEASUREMENT
/begin MEASUREMENT LIGov_trq_mp "Instrumente für segmentsynchronen Prozess" SWORD Trq 1 100 -3276.800 3276.700 FORMAT "%8.3" ECU_ADDRESS 0x8FED2E /end MEASUREMENT
/begin MEASUREMENT LPACD_rCnv_mp "TV on steller" SWORD DtyCyc 1 100 -327.6800 327.6700 FORMAT "%8.4" ECU_ADDRESS 0x8FED30 /end MEASUREMENT
/begin MEASUREMENT LPACD_rOut "Ausgabewert on PWM-EST nach batteriespannung korrectur" SWORD DtyCyc 1 100 -327.6800 327.6700 FORMAT "%8.4" ECU_ADDRESS 0x7F9048 /end MEASUREMENT
/begin MEASUREMENT LSUCD_ctHtCoup "Zähler für LSU Diagnose Heizerkopplung" UWORD OneToOne 1 100 0.00 65535.00 FORMAT "%8.2" ARRAY_SIZE 1 ECU_ADDRESS 0x7F904A /end MEASUREMENT
/begin MEASUREMENT LSUCD_d2rO2Eval_mp "Bewertungsgröße für Lernfortschritt" SWORD O2 1 100 -0.3276800 0.3276700 FORMAT "%9.7" ARRAY_SIZE 1 ECU_ADDRESS 0x8FED52 /end MEASUREMENT
/begin MEASUREMENT LSUCD_d2rO2_mp "Eingangsgröße des Bewertungsfilters" SWORD O2 1 100 -0.3276800 0.3276700 FORMAT "%9.7" ARRAY_SIZE 1 ECU_ADDRESS 0x8FED54 /end MEASUREMENT
/begin MEASUREMENT LSUCD_dcycHtCor "Tastverhältnis Heizer Endstufe nach Batteriespannungs Korrektur" SWORD DtyCyc 1 100 -327.6800 327.6700 FORMAT "%8.4" ARRAY_SIZE 1 ECU_ADDRESS 0x7F904C /end MEASUREMENT
/begin MEASUREMENT LSUCD_dcycHtCoupStep1 "Heizungs-Aufgabe fährt im ersten Signalerwerbungs-Zyklus rad" SWORD DtyCyc 1 100 -327.6800 327.6700 FORMAT "%8.4" ARRAY_SIZE 1 ECU_ADDRESS 0x7F904E /end MEASUREMENT
/begin MEASUREMENT LSUCD_dcycHtCoupStep2 "Heizungs-Aufgabe fährt im zweiten Signalerwerbungs-Zyklus rad" SWORD DtyCyc 1 100 -327.6800 327.6700 FORMAT "%8.4" ARRAY_SIZE 1 ECU_ADDRESS 0x7F9050 /end MEASUREMENT
/begin MEASUREMENT LSUCD_dcycHtCoupStep3 "Heizungs-Aufgabe fährt im dritten Signalerwerbungs-Zyklus rad" SWORD DtyCyc 1 100 -327.6800 327.6700 FORMAT "%8.4" ARRAY_SIZE 1 ECU_ADDRESS 0x7F9052 /end MEASUREMENT
/begin MEASUREMENT LSUCD_dcycLimActHt "Aktuelle Tastverhältnisgrenze Heizeransteuerung für nominales Tastverhältnis (vor Korrektur)" SWORD DtyCyc 1 100 -327.6800 327.6700 FORMAT "%8.4" ECU_ADDRESS 0x7F9054 /end MEASUREMENT
/begin MEASUREMENT LSUCD_dcycRippel_mp "Änderung des Heizungs-Tastverhältnisses bei Diagnose der Heizungskopplung" SWORD DtyCyc 1 100 -327.6800 327.6700 FORMAT "%8.4" ARRAY_SIZE 1 ECU_ADDRESS 0x8FED76 /end MEASUREMENT
/begin MEASUREMENT LSUCD_dHtCoupStep "Schieberegister für die Aufzeichnung der Werte" UBYTE OneToOne 1 100 0.00 255.0 FORMAT "%5.1" ECU_ADDRESS 0x7F8957 /end MEASUREMENT
/begin MEASUREMENT LSUCD_dHtCoupStepLast "Letzter Wert des Schieberegisters" UBYTE OneToOne 1 100 0.00 255.0 FORMAT "%5.1" ECU_ADDRESS 0x7F8958 /end MEASUREMENT
/begin MEASUREMENT LSUCD_drO2Adpt "Eingelernter absoluter Messfehler der Sauerstoffkonzentration" SWORD O2 1 100 -0.3276800 0.3276700 FORMAT "%9.7" ARRAY_SIZE 1 ECU_ADDRESS 0x7F9056 /end MEASUREMENT
/begin MEASUREMENT LSUCD_drO2Flt_mp "Ausgangsgröße des Adaptionsfilters" SWORD O2 1 100 -0.3276800 0.3276700 FORMAT "%9.7" ARRAY_SIZE 1 ECU_ADDRESS 0x8FED56 /end MEASUREMENT
/begin MEASUREMENT LSUCD_facO2Corr_mp "Aktueller Korrekturfaktor der Adaption" SWORD Fact 1 100 -4.000000 3.999878 FORMAT "%8.6" ARRAY_SIZE 1 ECU_ADDRESS 0x6F8268 /end MEASUREMENT
/begin MEASUREMENT LSUCD_facPresComp_mp "Druckkorrekturfaktor" SWORD Fact 1 100 -4.000000 3.999878 FORMAT "%8.6" ARRAY_SIZE 1 ECU_ADDRESS 0x8FED6A /end MEASUREMENT
/begin MEASUREMENT LSUCD_facUCor_mp "Korrektur Faktor für Heizeranforderung" SWORD Fact 1 100 -4.000000 3.999878 FORMAT "%8.6" ECU_ADDRESS 0x8FED5E /end MEASUREMENT
/begin MEASUREMENT LSUCD_mAirAftOvrRun_mp "Integral über Luftmassenstrom seit Beginn der Schubphase" SWORD AirMass_2 1 100 -3276.800 3276.700 FORMAT "%8.3" ECU_ADDRESS 0x8FED58 /end MEASUREMENT
/begin MEASUREMENT LSUCD_pExhGasLstVal_mp "Abgas-Wert des letzten geschätzten Sensors" SWORD Pres_hPa 1 100 -32768.00 32767.00 FORMAT "%8.2" ECU_ADDRESS 0x8FED6C /end MEASUREMENT
/begin MEASUREMENT LSUCD_resRi "Ri Meßwert (gefiltert und korrigiert)" SWORD Resist 1 100 -3276.800 3276.700 FORMAT "%8.3" ARRAY_SIZE 1 ECU_ADDRESS 0x7F9060 /end MEASUREMENT
/begin MEASUREMENT LSUCD_resRiChange_mp "Betrag der Ri-Änderung mit dem letzten gefilterten Wert" SWORD Resist 1 100 -3276.800 3276.700 FORMAT "%8.3" ARRAY_SIZE 1 ECU_ADDRESS 0x8FED6E /end MEASUREMENT
/begin MEASUREMENT LSUCD_resRiClb "Korrekturwert Ri Offset" SWORD Resist 1 100 -3276.800 3276.700 FORMAT "%8.3" ARRAY_SIZE 1 ECU_ADDRESS 0x7F9062 /end MEASUREMENT
/begin MEASUREMENT LSUCD_resRiClbRaw_mp "Rohwert Ri Korrektur ohne Filterung" SWORD Resist 1 100 -3276.800 3276.700 FORMAT "%8.3" ARRAY_SIZE 1 ECU_ADDRESS 0x8FED70 /end MEASUREMENT
/begin MEASUREMENT LSUCD_resRiHtCoupStep1 "Innerer Wiederstand im ersten Datenakquisitionszyklus" SWORD Resist 1 100 -3276.800 3276.700 FORMAT "%8.3" ARRAY_SIZE 1 ECU_ADDRESS 0x7F9064 /end MEASUREMENT
/begin MEASUREMENT LSUCD_resRiHtCoupStep2 "Innerer Wiederstand im zweiten Datenakquisitionszyklus" SWORD Resist 1 100 -3276.800 3276.700 FORMAT "%8.3" ARRAY_SIZE 1 ECU_ADDRESS 0x7F9066 /end MEASUREMENT
/begin MEASUREMENT LSUCD_resRiHtCoupStep3 "Innerer Wiederstand im dritten Datenakquisitionszyklus" SWORD Resist 1 100 -3276.800 3276.700 FORMAT "%8.3" ARRAY_SIZE 1 ECU_ADDRESS 0x7F9068 /end MEASUREMENT
/begin MEASUREMENT LSUCD_resRiRaw "Ri Meßwert ohne Korrektur" SWORD Resist 1 100 -3276.800 3276.700 FORMAT "%8.3" ARRAY_SIZE 1 ECU_ADDRESS 0x7F906A /end MEASUREMENT
/begin MEASUREMENT LSUCD_resRiRippel_mp "Änderung des Innenwiderstands bei Freigabe der Heizung" SWORD Resist 1 100 -3276.800 3276.700 FORMAT "%8.3" ARRAY_SIZE 1 ECU_ADDRESS 0x8FED78 /end MEASUREMENT
/begin MEASUREMENT LSUCD_resRi_mp "Ri-Messwert gefiltert und korrigiert" SWORD Resist 1 100 -3276.800 3276.700 FORMAT "%8.3" ECU_ADDRESS 0x8FED72 /end MEASUREMENT
/begin MEASUREMENT LSUCD_rO2Act "Aktueller O2 Meßwert ohne Ausblendung Abgleichvorgang" SWORD O2 1 100 -0.3276800 0.3276700 FORMAT "%9.7" ARRAY_SIZE 1 ECU_ADDRESS 0x7F9058 /end MEASUREMENT
/begin MEASUREMENT LSUCD_rO2Adpt "Adaptierte Sauerstoffkonzentration" SWORD O2 1 100 -0.3276800 0.3276700 FORMAT "%9.7" ARRAY_SIZE 1 ECU_ADDRESS 0x7F905A /end MEASUREMENT
/begin MEASUREMENT LSUCD_rO2PresComp "Druckkompensierte Sauerstoffkonzentration" SWORD O2 1 100 -0.3276800 0.3276700 FORMAT "%9.7" ARRAY_SIZE 1 ECU_ADDRESS 0x7F905C /end MEASUREMENT
/begin MEASUREMENT LSUCD_rO2Raw "O2 Wert ohne Druck- und Empfindlichkeitskorrektur" SWORD O2 1 100 -0.3276800 0.3276700 FORMAT "%9.7" ARRAY_SIZE 1 ECU_ADDRESS 0x7F905E /end MEASUREMENT
/begin MEASUREMENT LSUCD_rOutHWE_mp "Tastverhältnis Heizerendstufe nach Stellertest Anforderung und Endstufen Diagnose." SWORD DtyCyc 1 100 -327.6800 327.6700 FORMAT "%8.4" ARRAY_SIZE 1 ECU_ADDRESS 0x8FED60 /end MEASUREMENT
/begin MEASUREMENT LSUCD_stAdpt "Zustandsgröße der Adaption (adaptiert / nicht adaptiert)" UBYTE OneToOne 1 100 0.00 255.0 FORMAT "%5.1" ARRAY_SIZE 1 ECU_ADDRESS 0x7F8959 /end MEASUREMENT
/begin MEASUREMENT LSUCD_stAdptActv_mp "Zustand der Lernphase (aktiv / nicht aktiv)" UBYTE OneToOne 1 100 0.00 255.0 FORMAT "%5.1" ARRAY_SIZE 1 ECU_ADDRESS 0x8FED5A /end MEASUREMENT
/begin MEASUREMENT LSUCD_stChange_mp "Neues Lernergebnis im aktuellen Fahrzyklus" UBYTE OneToOne 1 100 0.00 255.0 FORMAT "%5.1" ARRAY_SIZE 1 ECU_ADDRESS 0x8FED5B /end MEASUREMENT
/begin MEASUREMENT LSUCD_stCircModeNew "Aktueller Wert des Auswerteschaltungs Modes (CJ 120 Konfiguration)" UWORD OneToOne 1 100 0.00 65535.00 FORMAT "%8.2" ARRAY_SIZE 1 ECU_ADDRESS 0x7F906C /end MEASUREMENT
/begin MEASUREMENT LSUCD_stDiaIAEna "Message um die Erkennung von IA oder IP Kurzschluss nach Masse freizugeben" UBYTE OneToOne 1 100 0.00 255.0 FORMAT "%5.1" ARRAY_SIZE 1 ECU_ADDRESS 0x7F895A /end MEASUREMENT
/begin MEASUREMENT LSUCD_stHold_mp "Zustandsgröße der Adaption (gestört / nicht gestört)" UBYTE OneToOne 1 100 0.00 255.0 FORMAT "%5.1" ARRAY_SIZE 1 ECU_ADDRESS 0x8FED5C /end MEASUREMENT
/begin MEASUREMENT LSUCD_stHtCoupActv "Statusbotschaft für Heizungskopplung aktiv" UBYTE OneToOne 1 100 0.00 255.0 FORMAT "%5.1" ECU_ADDRESS 0x7F895B /end MEASUREMENT
/begin MEASUREMENT LSUCD_stHtDis "Zustand Heizerabschaltung wegen Batteriespannung oder Betriebsmodus" UBYTE OneToOne 1 100 0.00 255.0 FORMAT "%5.1" ECU_ADDRESS 0x7F895C /end MEASUREMENT
/begin MEASUREMENT LSUCD_stInitClb "Erste CJ120-Kalibrierung wurde angefordert" UBYTE OneToOne 1 100 0.00 255.0 FORMAT "%5.1" ECU_ADDRESS 0x7F895D /end MEASUREMENT
/begin MEASUREMENT LSUCD_stIpHighCurEna "Status-Message für hohen (0 bis 150ua) Referenzpumpstrom für CJ125" UBYTE OneToOne 1 100 0.00 255.0 FORMAT "%5.1" ARRAY_SIZE 1 ECU_ADDRESS 0x7F895E /end MEASUREMENT
/begin MEASUREMENT LSUCD_stIpNormCurEna "Status-Message für normalen (0 bis 150ua) Referenzpumpstrom für CJ125" UBYTE OneToOne 1 100 0.00 255.0 FORMAT "%5.1" ARRAY_SIZE 1 ECU_ADDRESS 0x7F895F /end MEASUREMENT
/begin MEASUREMENT LSUCD_stIsolChkActv "Nebenschlußerkennung ist momentan aktiv" UBYTE OneToOne 1 100 0.00 255.0 FORMAT "%5.1" ARRAY_SIZE 1 ECU_ADDRESS 0x7F8960 /end MEASUREMENT
/begin MEASUREMENT LSUCD_stIsolChkO2Last "Status ob die O2 Konzentration im letzten Zyklus innerhalb des vorgegebenen Fensters war" UBYTE OneToOne 1 100 0.00 255.0 FORMAT "%5.1" ARRAY_SIZE 1 ECU_ADDRESS 0x7F8961 /end MEASUREMENT
/begin MEASUREMENT LSUCD_stIsolChkStrt "Statusmessage zum Starten der Nebenschlusserkennung" UBYTE OneToOne 1 100 0.00 255.0 FORMAT "%5.1" ARRAY_SIZE 1 ECU_ADDRESS 0x7F8962 /end MEASUREMENT
/begin MEASUREMENT LSUCD_stO2Act "Gültigkeitsstatus des aktuellen O2 Signals (0 = ungültig, 1 = gültig)" UBYTE OneToOne 1 100 0.00 255.0 FORMAT "%5.1" ARRAY_SIZE 1 ECU_ADDRESS 0x7F8963 /end MEASUREMENT
/begin MEASUREMENT LSUCD_stO2ClbEna "Auslösesignal für O2 Offsetspannung Kalibriersequenz" UBYTE OneToOne 1 100 0.00 255.0 FORMAT "%5.1" ECU_ADDRESS 0x7F8964 /end MEASUREMENT
/begin MEASUREMENT LSUCD_stO2Clb_mp "Zusatands Bits der O2 Offset Abgleich Sequenz" UBYTE OneToOne 1 100 0.00 255.0 FORMAT "%5.1" ECU_ADDRESS 0x8FED63 /end MEASUREMENT
/begin MEASUREMENT LSUCD_stO2IntValid "Status des internen O2-Rohsignals (gültig/ungültig)" UBYTE OneToOne 1 100 0.00 255.0 FORMAT "%5.1" ARRAY_SIZE 1 ECU_ADDRESS 0x7F8965 /end MEASUREMENT
/begin MEASUREMENT LSUCD_stO2SPICalDem "SPI Status-Message um die Schaltung in den Kalibriermodus zu versetzen" UBYTE OneToOne 1 100 0.00 255.0 FORMAT "%5.1" ECU_ADDRESS 0x7F8966 /end MEASUREMENT
/begin MEASUREMENT LSUCD_stO2SPISens "Modus-Bits zum Setzen der Empfindlichkeit der O2-Auswertung" UWORD OneToOne 1 100 0.00 65535.00 FORMAT "%8.2" ARRAY_SIZE 1 ECU_ADDRESS 0x7F906E /end MEASUREMENT
/begin MEASUREMENT LSUCD_stO2Valid "Zustand O2 Signal (0 = ungültig, 1 = gültig)" UBYTE OneToOne 1 100 0.00 255.0 FORMAT "%5.1" ARRAY_SIZE 3 ECU_ADDRESS 0x7F931F /end MEASUREMENT
/begin MEASUREMENT LSUCD_stOpnErrIP "Status Leerlauf-Fehler Pumpstrom Pin (IP)" UBYTE OneToOne 1 100 0.00 255.0 FORMAT "%5.1" ARRAY_SIZE 1 ECU_ADDRESS 0x7F8967 /end MEASUREMENT
/begin MEASUREMENT LSUCD_stOpnLdTstActv "Message von LSU_WireDiagnosis, die anzeigt, ob die Kabelunterbrechungsdiagnose für Nernst-Zelle und virtuelle Masse aktiv ist" UBYTE OneToOne 1 100 0.00 255.0 FORMAT "%5.1" ARRAY_SIZE 1 ECU_ADDRESS 0x7F8968 /end MEASUREMENT
/begin MEASUREMENT LSUCD_stPumpCtl "Status der Pumpensteuerung (ein/aus)" UBYTE OneToOne 1 100 0.00 255.0 FORMAT "%5.1" ARRAY_SIZE 1 ECU_ADDRESS 0x7F8969 /end MEASUREMENT
/begin MEASUREMENT LSUCD_stPumpDemRef "externe Anforderung Referenzpumpströme" UBYTE OneToOne 1 100 0.00 255.0 FORMAT "%5.1" ARRAY_SIZE 1 ECU_ADDRESS 0x7F896A /end MEASUREMENT
/begin MEASUREMENT LSUCD_stPumpEna "Zustand der CJ 120 Pumpstromregelung (0 = abgeschaltet, 1 = aktiv = Strom angeschaltet)" UBYTE OneToOne 1 100 0.00 255.0 FORMAT "%5.1" ARRAY_SIZE 1 ECU_ADDRESS 0x7F896B /end MEASUREMENT
/begin MEASUREMENT LSUCD_stRecValEval_mp "Messpunkt für den Status der Auswertung erfasster Werte in der Heizungskopplung" UBYTE OneToOne 1 100 0.00 255.0 FORMAT "%5.1" ARRAY_SIZE 1 ECU_ADDRESS 0x8FED7A /end MEASUREMENT
/begin MEASUREMENT LSUCD_stRefCurTrans_mp "Status des Übergangs von hohem zu niedrigem Strom" UBYTE OneToOne 1 100 0.00 255.0 FORMAT "%5.1" ARRAY_SIZE 1 ECU_ADDRESS 0x8FED62 /end MEASUREMENT
/begin MEASUREMENT LSUCD_stRefPump "Status der Referenz Pumpströme (0 = off, 1 = 20 uA, 2 = 40 uA, 3 = 60 uA)" UBYTE OneToOne 1 100 0.00 255.0 FORMAT "%5.1" ARRAY_SIZE 1 ECU_ADDRESS 0x7F896C /end MEASUREMENT
/begin MEASUREMENT LSUCD_stRgnEna "Nachricht, um Regeneration zu befähigen" UBYTE OneToOne 1 100 0.00 255.0 FORMAT "%5.1" ECU_ADDRESS 0x7F896D /end MEASUREMENT
/begin MEASUREMENT LSUCD_stRgnIpSettle "Status des Pumpe-Stromes, der nach Regeneration setzt" UBYTE OneToOne 1 100 0.00 255.0 FORMAT "%5.1" ECU_ADDRESS 0x7F896E /end MEASUREMENT
/begin MEASUREMENT LSUCD_stRiClb "Status der Ri-Kalibrierungssequenz" UBYTE OneToOne 1 100 0.00 255.0 FORMAT "%5.1" ECU_ADDRESS 0x7F896F /end MEASUREMENT
/begin MEASUREMENT LSUCD_stRiClbEna "Auslöser für Ri Abgleichsequenz" UBYTE OneToOne 1 100 0.00 255.0 FORMAT "%5.1" ECU_ADDRESS 0x7F8970 /end MEASUREMENT
/begin MEASUREMENT LSUCD_stRiFltAct_mp "Messpunkt für den Status der Filteraktivierung" UBYTE OneToOne 1 100 0.00 255.0 FORMAT "%5.1" ARRAY_SIZE 1 ECU_ADDRESS 0x8FED74 /end MEASUREMENT
/begin MEASUREMENT LSUCD_stRiLimSlp_mp "Zustand der Ri Störungsunterdrückung" UBYTE OneToOne 1 100 0.00 255.0 FORMAT "%5.1" ARRAY_SIZE 1 ECU_ADDRESS 0x8FED75 /end MEASUREMENT
/begin MEASUREMENT LSUCD_stRiSPICalDem "Anforderung der Ri-Regelung Einschaltung des Lern- oder Messmodus" UBYTE OneToOne 1 100 0.00 255.0 FORMAT "%5.1" ECU_ADDRESS 0x7F8971 /end MEASUREMENT
/begin MEASUREMENT LSUCD_stRiValid "Zustand Ri Signals (0 = ungültig, 1 = gültig)" UBYTE OneToOne 1 100 0.00 255.0 FORMAT "%5.1" ARRAY_SIZE 1 ECU_ADDRESS 0x7F8972 /end MEASUREMENT
/begin MEASUREMENT LSUCD_stSPIDiaInfo "Status der SPI Chip Diagnose" UWORD OneToOne 1 100 0.00 65535.00 FORMAT "%8.2" ARRAY_SIZE 1 ECU_ADDRESS 0x7F9070 /end MEASUREMENT
/begin MEASUREMENT LSUCD_stSPIInitVal "Wert des CJ12x Initialisierungsregisters" UWORD OneToOne 1 100 0.00 65535.00 FORMAT "%8.2" ARRAY_SIZE 1 ECU_ADDRESS 0x7F9072 /end MEASUREMENT
/begin MEASUREMENT LSUCD_stSRCState_mp "Status der SRC Überwachung des O2 Rohsignales" UBYTE OneToOne 1 100 0.00 255.0 FORMAT "%5.1" ARRAY_SIZE 1 ECU_ADDRESS 0x8FED64 /end MEASUREMENT
/begin MEASUREMENT LSUCD_stTstTrigger_mp "Messpunkt für den Status zur Auslösung des Tests der Nebenschlusserkennung" UBYTE OneToOne 1 100 0.00 255.0 FORMAT "%5.1" ARRAY_SIZE 1 ECU_ADDRESS 0x8FED7B /end MEASUREMENT
/begin MEASUREMENT LSUCD_stWireDiaChk_mp "Bitfeld: Unterdiagnosen ausgeführt" UBYTE OneToOne 1 100 0.00 255.0 FORMAT "%5.1" ARRAY_SIZE 1 ECU_ADDRESS 0x8FED7C /end MEASUREMENT
/begin MEASUREMENT LSUCD_stWireDiaErr_mp "Status des Fehlers Nebenschlusserkennung" UBYTE OneToOne 1 100 0.00 255.0 FORMAT "%5.1" ARRAY_SIZE 1 ECU_ADDRESS 0x8FED7D /end MEASUREMENT
/begin MEASUREMENT LSUCD_swtAdpt "Schalter für Adaption der Lambda-Sonde" UBYTE OneToOne 1 100 0.00 255.0 FORMAT "%5.1" ECU_ADDRESS 0x7F8973 /end MEASUREMENT
/begin MEASUREMENT LSUCD_tRi "Äquivalenztemperatur des gemessenen Ri-Werts" SWORD Temp_Cels 1 100 -50.140 899.860 FORMAT "%8.3" ARRAY_SIZE 1 ECU_ADDRESS 0x7F9074 /end MEASUREMENT
/begin MEASUREMENT LSUCD_uO2Clb "Offsetspannungs Korrekturwert für Lambda Spannungswert" SWORD Volt 1 100 -160156.4 160151.5 FORMAT "%8.1" ARRAY_SIZE 1 ECU_ADDRESS 0x7F9076 /end MEASUREMENT
/begin MEASUREMENT LSUCD_uO2FltRippel_mp "Gefilterte, überlagerte Sauerstoff-Wechselspannung bei Diagnose der Heizungskopplung" SWORD Volt 1 100 -160156.4 160151.5 FORMAT "%8.1" ARRAY_SIZE 1 ECU_ADDRESS 0x8FED7E /end MEASUREMENT
/begin MEASUREMENT LSUCD_uO2Grad_mp "Gradient der Sauerstoff-Spannung bei Diagnose der Heizungskopplung" SWORD Volt 1 100 -160156.4 160151.5 FORMAT "%8.1" ARRAY_SIZE 1 ECU_ADDRESS 0x8FED80 /end MEASUREMENT
/begin MEASUREMENT LSUCD_uO2HtCoupStep1 "O2 Konzentration im ersten Datenakquisitionszyklus" SWORD Volt 1 100 -160156.4 160151.5 FORMAT "%8.1" ARRAY_SIZE 1 ECU_ADDRESS 0x7F9078 /end MEASUREMENT
/begin MEASUREMENT LSUCD_uO2HtCoupStep2 "O2 Konzentration im zweiten Datenakquisitionszyklus" SWORD Volt 1 100 -160156.4 160151.5 FORMAT "%8.1" ARRAY_SIZE 1 ECU_ADDRESS 0x7F907A /end MEASUREMENT
/begin MEASUREMENT LSUCD_uO2HtCoupStep3 "O2 Konzentration im dritten Datenakquisitionszyklus" SWORD Volt 1 100 -160156.4 160151.5 FORMAT "%8.1" ARRAY_SIZE 1 ECU_ADDRESS 0x7F907C /end MEASUREMENT
/begin MEASUREMENT LSUCD_uO2OfsCor_mp "O2 Spannungswert nach Offset Kompensation" SWORD Volt 1 100 -160156.4 160151.5 FORMAT "%8.1" ECU_ADDRESS 0x8FED66 /end MEASUREMENT
/begin MEASUREMENT LSUCD_uO2Raw "Spannungsrohwert Lambdasignal nach Mittelung und Subtraktion Referenzwert" SWORD Volt 1 100 -160156.4 160151.5 FORMAT "%8.1" ARRAY_SIZE 1 ECU_ADDRESS 0x7F907E /end MEASUREMENT
/begin MEASUREMENT LSUCD_uO2Raw_mp "O2 Spannung nach Mittelwertbildung" SWORD Volt 1 100 -160156.4 160151.5 FORMAT "%8.1" ARRAY_SIZE 1 ECU_ADDRESS 0x8FED68 /end MEASUREMENT
/begin MEASUREMENT LSUCD_uO2Rippel_mp "Sauerstoff-Wechselspannung bei Diagnose der Heizungskopplung" SWORD Volt 1 100 -160156.4 160151.5 FORMAT "%8.1" ARRAY_SIZE 1 ECU_ADDRESS 0x8FED82 /end MEASUREMENT
/begin MEASUREMENT LSUCD_uRiRaw "Spannungsrohwert Ri nach Mittelung" SWORD Volt 1 100 -160156.4 160151.5 FORMAT "%8.1" ARRAY_SIZE 1 ECU_ADDRESS 0x7F9080 /end MEASUREMENT
/begin MEASUREMENT LSUCtl_dcycDT1_mp "DT1 Anteil der Heizungsregler Tastverhältnisanforderung" SWORD DtyCyc 1 100 -327.6800 327.6700 FORMAT "%8.4" ARRAY_SIZE 1 ECU_ADDRESS 0x8FED84 /end MEASUREMENT
/begin MEASUREMENT LSUCtl_dcycHt "Heizertastverhältnis Anforderung durch Ri Regelung" SWORD DtyCyc 1 100 -327.6800 327.6700 FORMAT "%8.4" ARRAY_SIZE 1 ECU_ADDRESS 0x7F9082 /end MEASUREMENT
/begin MEASUREMENT LSUCtl_dcycHtIniRamp "Startwert für Aufheizkurven Rampe" SWORD DtyCyc 1 100 -327.6800 327.6700 FORMAT "%8.4" ECU_ADDRESS 0x7F9084 /end MEASUREMENT
/begin MEASUREMENT LSUCtl_dcycHtStrt "Tastverhältnisvorgabe Heizung durch Aufheizstrategie" SWORD DtyCyc 1 100 -327.6800 327.6700 FORMAT "%8.4" ARRAY_SIZE 1 ECU_ADDRESS 0x7F9086 /end MEASUREMENT
/begin MEASUREMENT LSUCtl_dcycPI_mp "Tastverhältnisforderung aus dem P I Regelglied" SWORD DtyCyc 1 100 -327.6800 327.6700 FORMAT "%8.4" ARRAY_SIZE 1 ECU_ADDRESS 0x8FED86 /end MEASUREMENT
/begin MEASUREMENT LSUCtl_stHtCtl "Statusbits Zustand Heizungsregelung" UBYTE OneToOne 1 100 0.00 255.0 FORMAT "%5.1" ARRAY_SIZE 1 ECU_ADDRESS 0x7F8974 /end MEASUREMENT
/begin MEASUREMENT LSUCtl_stHtDisable "High level Diagnose Anforderung Heizungsregelungsabschaltung (0 = nicht abgeschaltet, >0 Ausgang = 0 %)" UBYTE OneToOne 1 100 0.00 255.0 FORMAT "%5.1" ARRAY_SIZE 1 ECU_ADDRESS 0x7F8975 /end MEASUREMENT
/begin MEASUREMENT LSUCtl_stRmp_mp "Ansteuerstatus für geschaltete Rampe" UBYTE OneToOne 1 100 0.00 255.0 FORMAT "%5.1" ARRAY_SIZE 1 ECU_ADDRESS 0x8FED88 /end MEASUREMENT
/begin MEASUREMENT LSUCtl_stSCUNEna "Message um Test für Erkennung von Kurzschluss nach Vbat bei UNI freizugeben" UBYTE OneToOne 1 100 0.00 255.0 FORMAT "%5.1" ARRAY_SIZE 1 ECU_ADDRESS 0x7F8976 /end MEASUREMENT
/begin MEASUREMENT LSUCtl_tAirStrt_mp "Ansauglufttemperatur nach Zündung an (mit Verzögerung erfasst!)" SWORD Temp_Cels 1 100 -50.140 899.860 FORMAT "%8.3" ECU_ADDRESS 0x8FED8A /end MEASUREMENT
/begin MEASUREMENT LSUCtl_tDvt_mp "Regelabweichung Sensortemperatur" SWORD TempDiff_Cels 1 100 -3276.800 3276.700 FORMAT "%8.3" ARRAY_SIZE 1 ECU_ADDRESS 0x8FED8C /end MEASUREMENT
/begin MEASUREMENT LSU_bpPlausSetPoint_mp "Bitposition für Zugriff auf LSU_stO2Err(_mp)" UBYTE OneToOne 1 100 0.00 255.0 FORMAT "%5.1" ECU_ADDRESS 0x8FED48 /end MEASUREMENT
/begin MEASUREMENT LSU_qStrt_mp "anfängliche Kraftstoffmenge in Dynamik-Überwachung" SWORD InjMass 1 100 -327.6800 327.6700 FORMAT "%8.4" ECU_ADDRESS 0x8FED4A /end MEASUREMENT
/begin MEASUREMENT LSU_rLmbd "Lambda" SWORD lambda 1 100 -32.76800 32.76700 FORMAT "%8.5" ARRAY_SIZE 3 ECU_ADDRESS 0x7F94BE /end MEASUREMENT
/begin MEASUREMENT LSU_rLmbdRec "Kehrwert von Lambda" SWORD lambdaRecVal 1 100 -32.76800 32.76700 FORMAT "%8.5" ARRAY_SIZE 3 ECU_ADDRESS 0x7F94C4 /end MEASUREMENT
/begin MEASUREMENT LSU_rO2ActVal "Aktuell von Plausibilisierung verwendete O2-Konzentration" SWORD O2 1 100 -0.3276800 0.3276700 FORMAT "%9.7" ARRAY_SIZE 1 ECU_ADDRESS 0x7F9088 /end MEASUREMENT
/begin MEASUREMENT LSU_rO2Adpt "Adaptierte Sauerstoffkonzentration die an externe Module übertragen wird" SWORD O2 1 100 -0.3276800 0.3276700 FORMAT "%9.7" ARRAY_SIZE 3 ECU_ADDRESS 0x7F94CA /end MEASUREMENT
/begin MEASUREMENT LSU_rO2AdptLastLSU_mp "Adaptierte Sauerstoffkonzentration des Sensors mit der höchsten Nummer" SWORD O2 1 100 -0.3276800 0.3276700 FORMAT "%9.7" ECU_ADDRESS 0x8FED36 /end MEASUREMENT
/begin MEASUREMENT LSU_rO2Calc_mp "aktuelle O2-Konzentration aus Luftmasse und Einspritzmenge" SWORD O2 1 100 -0.3276800 0.3276700 FORMAT "%9.7" ECU_ADDRESS 0x8FED4C /end MEASUREMENT
/begin MEASUREMENT LSU_rO2DiffCmpChk "O2-Unterscheid eines Sondenpaars" SWORD O2 1 100 -0.3276800 0.3276700 FORMAT "%9.7" ECU_ADDRESS 0x7FF698 /end MEASUREMENT
/begin MEASUREMENT LSU_rO2DvtNeg_mp "Minustoleranz für Plausibilisierung O2-Signal LSU" SWORD O2 1 100 -0.3276800 0.3276700 FORMAT "%9.7" ECU_ADDRESS 0x8FED4E /end MEASUREMENT
/begin MEASUREMENT LSU_rO2DvtPos_mp "Plustoleranz für Plausibilisierung O2-Signal LSU" SWORD O2 1 100 -0.3276800 0.3276700 FORMAT "%9.7" ECU_ADDRESS 0x8FED50 /end MEASUREMENT
/begin MEASUREMENT LSU_rO2Lmbd1Thres "Message: Toleranzband für Lambda-1-Erkennung" SWORD O2 1 100 -0.3276800 0.3276700 FORMAT "%9.7" ECU_ADDRESS 0x7F908A /end MEASUREMENT
/begin MEASUREMENT LSU_rO2MaxDiff "Maximale O2 Differenz zwischen ausgewählten Lambdasonden" SWORD O2 1 100 -0.3276800 0.3276700 FORMAT "%9.7" ECU_ADDRESS 0x7FF698 /end MEASUREMENT
/begin MEASUREMENT LSU_rO2MaxVal "Oberer Grenzwert der Plausibilisierung" SWORD O2 1 100 -0.3276800 0.3276700 FORMAT "%9.7" ARRAY_SIZE 1 ECU_ADDRESS 0x7F908C /end MEASUREMENT
/begin MEASUREMENT LSU_rO2MinVal "Unterer Grenzwert der Plausibilisierung" SWORD O2 1 100 -0.3276800 0.3276700 FORMAT "%9.7" ARRAY_SIZE 1 ECU_ADDRESS 0x7F908E /end MEASUREMENT
/begin MEASUREMENT LSU_rO2RawFlt "Gefilterte O2Raw-Sauerstoffkonzentration in Lambda-1-Erkennung" SWORD O2 1 100 -0.3276800 0.3276700 FORMAT "%9.7" ARRAY_SIZE 1 ECU_ADDRESS 0x7F9090 /end MEASUREMENT
/begin MEASUREMENT LSU_rO2Stat_mp "gefilterte O2-Konzentration aus Luftmasse und Einspritzmenge" SWORD O2 1 100 -0.3276800 0.3276700 FORMAT "%9.7" ARRAY_SIZE 1 ECU_ADDRESS 0x8FED38 /end MEASUREMENT
/begin MEASUREMENT LSU_rO2Thres1_mp "untere O2-Schwelle für Messung der Anstiegszeit" SWORD O2 1 100 -0.3276800 0.3276700 FORMAT "%9.7" ARRAY_SIZE 1 ECU_ADDRESS 0x8FED3A /end MEASUREMENT
/begin MEASUREMENT LSU_rO2Thres2_mp "obere O2-Schwelle für Messung der Anstiegszeit" SWORD O2 1 100 -0.3276800 0.3276700 FORMAT "%9.7" ARRAY_SIZE 1 ECU_ADDRESS 0x8FED3C /end MEASUREMENT
/begin MEASUREMENT LSU_stChkDyn_mp "Nummer der zuletzt erreichten O2-Schwelle" UBYTE OneToOne 1 100 0.00 255.0 FORMAT "%5.1" ARRAY_SIZE 1 ECU_ADDRESS 0x8FED3E /end MEASUREMENT
/begin MEASUREMENT LSU_stClbDisable "Disable-Signal für CJ120-Kalibrierung" UBYTE OneToOne 1 100 0.00 255.0 FORMAT "%5.1" ECU_ADDRESS 0x7F8977 /end MEASUREMENT
/begin MEASUREMENT LSU_stClbTrg_mp "CJ125-Kalibrierung bzw. Pumpstromumkehr ist freigegeben" UBYTE OneToOne 1 100 0.00 255.0 FORMAT "%5.1" ECU_ADDRESS 0x8FED32 /end MEASUREMENT
/begin MEASUREMENT LSU_stConstPOp "Statusmessage konstanter Betriebspunkt" UBYTE OneToOne 1 100 0.00 255.0 FORMAT "%5.1" ECU_ADDRESS 0x7F8978 /end MEASUREMENT
/begin MEASUREMENT LSU_stNotOpPoint1_mp "Messen des Punktes für Status des Betriebsgebiets 1" UBYTE OneToOne 1 100 0.00 255.0 FORMAT "%5.1" ECU_ADDRESS 0x8FED33 /end MEASUREMENT
/begin MEASUREMENT LSU_stNotOpPoint2_mp "Messen des Punktes für Status des Betriebsgebiets 2" UBYTE OneToOne 1 100 0.00 255.0 FORMAT "%5.1" ECU_ADDRESS 0x8FED34 /end MEASUREMENT
/begin MEASUREMENT LSU_stO2Chk_mp "Bitfeld :: Teildiagnosen durchgeführt" UWORD OneToOne 1 100 0.00 65535.00 FORMAT "%8.2" ARRAY_SIZE 1 ECU_ADDRESS 0x8FED40 /end MEASUREMENT
/begin MEASUREMENT LSU_stO2Err_mp "Statuswort :: Diagnoseergebnisse" UWORD OneToOne 1 100 0.00 65535.00 FORMAT "%8.2" ARRAY_SIZE 1 ECU_ADDRESS 0x8FED42 /end MEASUREMENT
/begin MEASUREMENT LSU_stPlausChkCon_mp "Statuswort Zustand der Voraussetzungen für Plausibilitätscheck" UBYTE OneToOne 1 100 0.00 255.0 FORMAT "%5.1" ECU_ADDRESS 0x8FED44 /end MEASUREMENT
/begin MEASUREMENT LSU_stPlausChk_mp "Statuswort Zustand Plausibilitäts-Check" UBYTE OneToOne 1 100 0.00 255.0 FORMAT "%5.1" ARRAY_SIZE 1 ECU_ADDRESS 0x8FED45 /end MEASUREMENT
/begin MEASUREMENT LSU_stStrtClb "Hilfsvariable für Kalibrierungs-Scheduler" UBYTE OneToOne 1 100 0.00 255.0 FORMAT "%5.1" ECU_ADDRESS 0x7F8979 /end MEASUREMENT
/begin MEASUREMENT LSU_stTmrClbPerRun "Status des Kalibrier-Timers" UBYTE OneToOne 1 100 0.00 255.0 FORMAT "%5.1" ECU_ADDRESS 0x7F897A /end MEASUREMENT
/begin MEASUREMENT LSU_swtEna "Status-Message zu Freigabe oder Sperren der gesamten LSU-Funktionen" UBYTE OneToOne 1 100 0.00 255.0 FORMAT "%5.1" ECU_ADDRESS 0x7F897B /end MEASUREMENT
/begin MEASUREMENT LSU_tiState1_mp "Timervariable: Kraftstoffmenge liegt innerhalb Toleranzband" UWORD Time_s 1 100 0.00 655.3500 FORMAT "%8.4" ARRAY_SIZE 1 ECU_ADDRESS 0x8FED46 /end MEASUREMENT
/begin MEASUREMENT LSU_tiState2 "Message: Anstiegszeit O2-Signal beim Übergang Last-Schub (Dynamiküberwachung)" UWORD Time_s 1 100 0.00 655.3500 FORMAT "%8.4" ARRAY_SIZE 1 ECU_ADDRESS 0x7F9092 /end MEASUREMENT
/begin MEASUREMENT LSU_tiState3 "Message: Zeitdauer bis zum Erreichen des Schubs (Kraftstoffmenge kleiner als Schwellwert)" UWORD Time_s 1 100 0.00 655.3500 FORMAT "%8.4" ARRAY_SIZE 1 ECU_ADDRESS 0x7F9094 /end MEASUREMENT
/begin MEASUREMENT LSU_tiSwitch "Message: Maximal zulässiger Wert für O2-Flankenzeit Last -> Schub" UWORD Time_s 1 100 0.00 655.3500 FORMAT "%8.4" ARRAY_SIZE 1 ECU_ADDRESS 0x7F9096 /end MEASUREMENT
/begin MEASUREMENT LSU_tiWait3 "Message: maximale Zeitdauer zum erreichen der oberen O2-Schwelle in Dynamiküberwachung" UWORD Time_s 1 100 0.00 655.3500 FORMAT "%8.4" ARRAY_SIZE 1 ECU_ADDRESS 0x7F9098 /end MEASUREMENT
/begin MEASUREMENT PwrMng_absch_korr "correction value shut off" UWORD OneToOne 1 100 0.00 65535.00 FORMAT "%8.2" ECU_ADDRESS 0x7F9256 /end MEASUREMENT
/begin MEASUREMENT PwrMng_dmAirPerTimeI_mp "integrated air mass" SWORD AirMassPerTime 1 100 -3276.800 3276.700 FORMAT "%8.3" ECU_ADDRESS 0x8FECBC /end MEASUREMENT
/begin MEASUREMENT PwrMng_d_soc "battery load state" UWORD OneToOne 1 100 0.00 65535.00 FORMAT "%8.2" ECU_ADDRESS 0x7F9258 /end MEASUREMENT
/begin MEASUREMENT PwrMng_iEngine "engine current" SWORD igen_ub_q1 1 100 -32768.00 32767.00 FORMAT "%8.2" ECU_ADDRESS 0x7F925A /end MEASUREMENT
/begin MEASUREMENT PwrMng_iGen "Alternator current" UBYTE igen_ub_q1 1 100 0.00 255.0 FORMAT "%5.1" ECU_ADDRESS 0x7F89F9 /end MEASUREMENT
/begin MEASUREMENT PwrMng_nMin "low idle demand from PwrMng" SWORD EngN 1 100 -32768.00 32767.00 FORMAT "%8.2" ECU_ADDRESS 0x7F925C /end MEASUREMENT
/begin MEASUREMENT PwrMng_nnnstart "start rpm engine" SWORD OneToOne 1 100 -32768.00 32767.00 FORMAT "%8.2" ECU_ADDRESS 0x7F925E /end MEASUREMENT
/begin MEASUREMENT PwrMng_pwrDes "alternator power" SWORD Pwr 1 100 -308831.1 308821.7 FORMAT "%8.1" ECU_ADDRESS 0x7F9260 /end MEASUREMENT
/begin MEASUREMENT PwrMng_pwrPTC "dummy power management message" SWORD DtyCyc 1 100 -327.6800 327.6700 FORMAT "%8.4" ECU_ADDRESS 0x7F9262 /end MEASUREMENT
/begin MEASUREMENT PwrMng_rCtrPwrSpCos "controlling power extra-consumers" UBYTE fak_q0p5 1 100 0.00 127.5 FORMAT "%5.1" ECU_ADDRESS 0x7F89FA /end MEASUREMENT
/begin MEASUREMENT PwrMng_rdffgen "DF-signal in GS-resolution for CAN" UBYTE PCENT 1 100 0.00 99.61 FORMAT "%5.2" ECU_ADDRESS 0x7F89FB /end MEASUREMENT
/begin MEASUREMENT PwrMng_stB_ccbtnach "Powermanagement value" UBYTE OneToOne 1 100 0.00 255.0 FORMAT "%5.1" ECU_ADDRESS 0x7F89FC /end MEASUREMENT
/begin MEASUREMENT PwrMng_stB_ccbttdfk "Powermanagement value" UBYTE OneToOne 1 100 0.00 255.0 FORMAT "%5.1" ECU_ADDRESS 0x7F89FD /end MEASUREMENT
/begin MEASUREMENT PwrMng_stB_ccbttknt "Powermanagement value" UBYTE OneToOne 1 100 0.00 255.0 FORMAT "%5.1" ECU_ADDRESS 0x7F89FE /end MEASUREMENT
/begin MEASUREMENT PwrMng_stB_ccpmerr "Powermanagement value" UBYTE OneToOne 1 100 0.00 255.0 FORMAT "%5.1" ECU_ADDRESS 0x7F89FF /end MEASUREMENT
/begin MEASUREMENT PwrMng_stB_ccprio "Powermanagement value" UBYTE OneToOne 1 100 0.00 255.0 FORMAT "%5.1" ECU_ADDRESS 0x7F8A00 /end MEASUREMENT
/begin MEASUREMENT PwrMng_stB_ccruhver "Powermanagement value" UBYTE OneToOne 1 100 0.00 255.0 FORMAT "%5.1" ECU_ADDRESS 0x7F8A01 /end MEASUREMENT
/begin MEASUREMENT PwrMng_stB_codierpm "Powermanagement value" UBYTE OneToOne 1 100 0.00 255.0 FORMAT "%5.1" ECU_ADDRESS 0x7F8A02 /end MEASUREMENT
/begin MEASUREMENT PwrMng_stCtrCbr "controlling current branch" UBYTE DEZ 1 100 0.00 255.0 FORMAT "%5.1" ECU_ADDRESS 0x7F8A03 /end MEASUREMENT
/begin MEASUREMENT PwrMng_stCtrPCos "controlling stand-consumers" UBYTE DEZ 1 100 0.00 255.0 FORMAT "%5.1" ECU_ADDRESS 0x7F8A04 /end MEASUREMENT
/begin MEASUREMENT PwrMng_stCtrPrio "controlling priority peak decreasing" UBYTE DEZ 1 100 0.00 255.0 FORMAT "%5.1" ECU_ADDRESS 0x7F8A05 /end MEASUREMENT
/begin MEASUREMENT PwrMng_stCtrPrioCf "controlling priority peak decreasing" UBYTE DEZ 1 100 0.00 255.0 FORMAT "%5.1" ECU_ADDRESS 0x7F8A06 /end MEASUREMENT
/begin MEASUREMENT PwrMng_stCtrPwrCos "controlling power consumers bit-coded" UWORD DEZ 1 100 0.00 65535.00 FORMAT "%8.2" ECU_ADDRESS 0x7F9264 /end MEASUREMENT
/begin MEASUREMENT PwrMng_stGen "State alternator" UBYTE OneToOne 1 100 0.00 255.0 FORMAT "%5.1" ECU_ADDRESS 0x7F8A07 /end MEASUREMENT
/begin MEASUREMENT PwrMng_stLdstGen "alternator load state" UBYTE OneToOne 1 100 0.00 255.0 FORMAT "%5.1" ECU_ADDRESS 0x7F8A09 /end MEASUREMENT
/begin MEASUREMENT PwrMng_stLIGov "State of low idle governor" UWORD OneToOne 1 100 0.00 65535.00 FORMAT "%8.2" ECU_ADDRESS 0x7F8A08 /end MEASUREMENT
/begin MEASUREMENT PwrMng_stPCos "state stand-consumers" UBYTE DEZ 1 100 0.00 255.0 FORMAT "%5.1" ECU_ADDRESS 0x7F8A0A /end MEASUREMENT
/begin MEASUREMENT PwrMng_stRqPCos "Demand stand-consumers" UBYTE DEZ 1 100 0.00 255.0 FORMAT "%5.1" ECU_ADDRESS 0x7F8A0B /end MEASUREMENT
/begin MEASUREMENT PwrMng_stSelSpCos "status extra-consumers detection" UBYTE DEZ 1 100 0.00 255.0 FORMAT "%5.1" ECU_ADDRESS 0x7F8A0C /end MEASUREMENT
/begin MEASUREMENT PwrMng_stTerminal61 "Status Klemme 61" UBYTE OneToOne 1 100 0.00 255.0 FORMAT "%5.1" ECU_ADDRESS 0x7F8A0D /end MEASUREMENT
/begin MEASUREMENT PwrMng_stULev "voltage level" UBYTE DEZ 1 100 0.00 255.0 FORMAT "%5.1" ECU_ADDRESS 0x7F8A0E /end MEASUREMENT
/begin MEASUREMENT PwrMng_tiLRGen "Load-Response Zeit" UWORD Time_s 1 100 0.00 655.3500 FORMAT "%8.4" ECU_ADDRESS 0x7F9266 /end MEASUREMENT
/begin MEASUREMENT PwrMng_ubt "Battery voltage" UWORD spg_uw_q0p015 1 100 0.00 983.02500 ECU_ADDRESS 0x7F926C /end MEASUREMENT
/begin MEASUREMENT PwrMng_uGen "Sollwert Generatorspannung" UWORD Volt_Batt 1 100 0.00 1281232. FORMAT "%8.0" ECU_ADDRESS 0x7F9268 /end MEASUREMENT
/begin MEASUREMENT PwrMng_uGen2 "Sollwert Generatorspannung 2" UWORD Volt_Batt 1 100 0.00 1281232. FORMAT "%8.0" ECU_ADDRESS 0x7F926A /end MEASUREMENT
/begin MEASUREMENT RF_BSD "Readinessflag für BSD-Fehler" UBYTE OneToOne 1 100 0.00 255.0 FORMAT "%5.1" ECU_ADDRESS 0x8FEC8E /end MEASUREMENT
/begin MEASUREMENT RF_GEN "Readinessflag für GEN-Fehler" UBYTE OneToOne 1 100 0.00 255.0 FORMAT "%5.1" ECU_ADDRESS 0x8FEC8F /end MEASUREMENT
/begin MEASUREMENT RF_IBS1 "Readinessflag für IBS1-Fehler" UBYTE OneToOne 1 100 0.00 255.0 FORMAT "%5.1" ECU_ADDRESS 0x8FEC90 /end MEASUREMENT
/begin MEASUREMENT RF_IBS2 "Readinessflag für IBS2-Fehler" UBYTE OneToOne 1 100 0.00 255.0 FORMAT "%5.1" ECU_ADDRESS 0x8FEC91 /end MEASUREMENT
/begin MEASUREMENT RF_IBS3 "Readinessflag für IBS3-Fehler" UBYTE OneToOne 1 100 0.00 255.0 FORMAT "%5.1" ECU_ADDRESS 0x8FEC92 /end MEASUREMENT
/begin MEASUREMENT RF_MANHYDR "Readinessflag für MANHYDR-Fehler" UBYTE OneToOne 1 100 0.00 255.0 FORMAT "%5.1" ECU_ADDRESS 0x8FEC93 /end MEASUREMENT
/begin MEASUREMENT RF_MANLUFT "Readinessflag für MANLUFT-Fehler" UBYTE OneToOne 1 100 0.00 255.0 FORMAT "%5.1" ECU_ADDRESS 0x8FEC94 /end MEASUREMENT
/begin MEASUREMENT RF_PMBATT "Readinessflag für PMBATT-Fehler" UBYTE OneToOne 1 100 0.00 255.0 FORMAT "%5.1" ECU_ADDRESS 0x8FEC95 /end MEASUREMENT
/begin MEASUREMENT RF_PMBN "Readinessflag für PMBN-Fehler" UBYTE OneToOne 1 100 0.00 255.0 FORMAT "%5.1" ECU_ADDRESS 0x8FEC96 /end MEASUREMENT
/begin MEASUREMENT RF_PMRUHVERL "Readinessflag für PMRUHVERL-Fehler" UBYTE OneToOne 1 100 0.00 255.0 FORMAT "%5.1" ECU_ADDRESS 0x8FEC97 /end MEASUREMENT
/begin MEASUREMENT RF_QLT "Readinessflag für QLT-Fehler" UBYTE OneToOne 1 100 0.00 255.0 FORMAT "%5.1" ECU_ADDRESS 0x8FEC98 /end MEASUREMENT
/begin MEASUREMENT RF_TANS "Readinessflag für TANS-Fehler" UBYTE OneToOne 1 100 0.00 255.0 FORMAT "%5.1" ECU_ADDRESS 0x8FEC99 /end MEASUREMENT
/begin MEASUREMENT RF_TOENS "Readinessflag für TOENS-Fehler" UBYTE OneToOne 1 100 0.00 255.0 FORMAT "%5.1" ECU_ADDRESS 0x8FEC9A /end MEASUREMENT
/begin MEASUREMENT RF_TUMG "Readinessflag für TUMG-Fehler" UBYTE OneToOne 1 100 0.00 255.0 FORMAT "%5.1" ECU_ADDRESS 0x8FEC9B /end MEASUREMENT
/begin MEASUREMENT ZF_BSD "Zyklusflag für BSD-Fehler" UBYTE OneToOne 1 100 0.00 255.0 FORMAT "%5.1" ECU_ADDRESS 0x8FEC9C /end MEASUREMENT
/begin MEASUREMENT ZF_GEN "Zyklusflag für GEN-Fehler" UBYTE OneToOne 1 100 0.00 255.0 FORMAT "%5.1" ECU_ADDRESS 0x8FEC9D /end MEASUREMENT
/begin MEASUREMENT ZF_IBS1 "Zyklusflag für IBS1-Fehler" UBYTE OneToOne 1 100 0.00 255.0 FORMAT "%5.1" ECU_ADDRESS 0x8FEC9E /end MEASUREMENT
/begin MEASUREMENT ZF_IBS2 "Zyklusflag für IBS2-Fehler" UBYTE OneToOne 1 100 0.00 255.0 FORMAT "%5.1" ECU_ADDRESS 0x8FEC9F /end MEASUREMENT
/begin MEASUREMENT ZF_IBS3 "Zyklusflag für IBS3-Fehler" UBYTE OneToOne 1 100 0.00 255.0 FORMAT "%5.1" ECU_ADDRESS 0x8FECA0 /end MEASUREMENT
/begin MEASUREMENT ZF_MANHYDR "Zyklusflag für MANHYDR-Fehler" UBYTE OneToOne 1 100 0.00 255.0 FORMAT "%5.1" ECU_ADDRESS 0x8FECA1 /end MEASUREMENT
/begin MEASUREMENT ZF_MANLUFT "Zyklusflag für MANLUFT-Fehler" UBYTE OneToOne 1 100 0.00 255.0 FORMAT "%5.1" ECU_ADDRESS 0x8FECA2 /end MEASUREMENT
/begin MEASUREMENT ZF_PMBATT "Zyklusflag für PMBATT-Fehler" UBYTE OneToOne 1 100 0.00 255.0 FORMAT "%5.1" ECU_ADDRESS 0x8FECA3 /end MEASUREMENT
/begin MEASUREMENT ZF_PMBN "Zyklusflag für PMBN-Fehler" UBYTE OneToOne 1 100 0.00 255.0 FORMAT "%5.1" ECU_ADDRESS 0x8FECA4 /end MEASUREMENT
/begin MEASUREMENT ZF_PMRUHVERL "Zyklusflag für PMRUHVERL-Fehler" UBYTE OneToOne 1 100 0.00 255.0 FORMAT "%5.1" ECU_ADDRESS 0x8FECA5 /end MEASUREMENT
/begin MEASUREMENT ZF_QLT "Zyklusflag für QLT-Fehler" UBYTE OneToOne 1 100 0.00 255.0 FORMAT "%5.1" ECU_ADDRESS 0x8FECA6 /end MEASUREMENT
/begin MEASUREMENT ZF_TANS "Zyklusflag für TANS-Fehler" UBYTE OneToOne 1 100 0.00 255.0 FORMAT "%5.1" ECU_ADDRESS 0x8FECA7 /end MEASUREMENT
/begin MEASUREMENT ZF_TOENS "Zyklusflag für TOENS-Fehler" UBYTE OneToOne 1 100 0.00 255.0 FORMAT "%5.1" ECU_ADDRESS 0x8FECA8 /end MEASUREMENT
/begin MEASUREMENT ZF_TUMG "Zyklusflag für TUMG-Fehler" UBYTE OneToOne 1 100 0.00 255.0 FORMAT "%5.1" ECU_ADDRESS 0x8FECA9 /end MEASUREMENT
/begin FUNCTION layer "Interface function to customer code"
 /begin DEF_CHARACTERISTIC Dmd_gen_C Layer_stAirCtlBits_C Layer_stPCR_C Layer_swtB_bsdprot Layer_tiDefWrEep_C PwrMng_B_ulcp_C PwrMng_dmAirPerTimeCor_C PwrMng_dmAirPerTimeIMax_C PwrMng_dmAirPerTimeIMin_C PwrMng_dmAirPerTimeIKi_C PwrMng_dmAirPerTimeIKiPos_C PwrMng_dmAirPerTimeIKiNeg_C PwrMng_dmAirPerTimeIWinPos_C PwrMng_dmAirPerTimeIWinNeg_C PwrMng_nB_kwdrehtHi_C PwrMng_nB_kwdrehtLo_C PwrMng_nB_llHigh_C PwrMng_nB_llLow_C PwrMng_rLoadMax_C PwrMng_rLoadMin_C PwrMng_stIdlingDefVal_C PwrMng_swtnmot_w_C PwrMng_swtPmsvActiv_C PwrMng_swttumg_C PwrMng_tiChgBatt_C PwrMng_tiHisRst_C PwrMng_Tkat_mod_C PwrMng_uAltTargetDefVal_C /end DEF_CHARACTERISTIC
/end FUNCTION
/begin FUNCTION layer_fltmng ""
 /begin DEF_CHARACTERISTIC Layer_ctDebBSDStep_C Layer_ctDebGENStep_C Layer_ctDebIBS1Step_C Layer_ctDebIBS2Step_C Layer_ctDebIBS3Step_C Layer_ctDebMANHYDRStep_C Layer_ctDebMANLUFTStep_C Layer_ctDebPMBATTStep_C Layer_ctDebPMBNStep_C Layer_ctDebPMRUHVERLStep_C Layer_ctDebQLTStep_C Layer_ctDebTANSStep_C Layer_ctDebTOENSStep_C Layer_ctDebTUMGStep_C Layer_ctDebBSDDef_C Layer_ctDebBSDOk_C Layer_ctDebGENDef_C Layer_ctDebGENOk_C Layer_ctDebIBS1Def_C Layer_ctDebIBS1Ok_C Layer_ctDebIBS2Def_C Layer_ctDebIBS2Ok_C Layer_ctDebIBS3Def_C Layer_ctDebIBS3Ok_C Layer_ctDebMANHYDRDef_C Layer_ctDebMANHYDROk_C Layer_ctDebMANLUFTDef_C Layer_ctDebMANLUFTOk_C Layer_ctDebPMBATTDef_C Layer_ctDebPMBATTOk_C Layer_ctDebPMBNDef_C Layer_ctDebPMBNOk_C Layer_ctDebPMRUHVERLDef_C Layer_ctDebPMRUHVERLOk_C Layer_ctDebQLTDef_C Layer_ctDebQLTOk_C Layer_ctDebTANSDef_C Layer_ctDebTANSOk_C Layer_ctDebTOENSDef_C Layer_ctDebTOENSOk_C Layer_ctDebTUMGDef_C Layer_ctDebTUMGOk_C /end DEF_CHARACTERISTIC
/end FUNCTION
/begin FUNCTION layer_fltmng_uic ""
 /begin OUT_MEASUREMENT BD_BSD BD_GEN BD_IBS1 BD_IBS2 BD_IBS3 BD_MANHYDR BD_MANLUFT BD_PMBATT BD_PMBN BD_PMRUHVERL BD_QLT BD_TANS BD_TOENS BD_TUMG E_BSD E_GEN E_IBS1 E_IBS2 E_IBS3 E_MANHYDR E_MANLUFT E_PMBATT E_PMBN E_PMRUHVERL E_QLT E_TANS E_TOENS E_TUMG RF_BSD RF_GEN RF_IBS1 RF_IBS2 RF_IBS3 RF_MANHYDR RF_MANLUFT RF_PMBATT RF_PMBN RF_PMRUHVERL RF_QLT RF_TANS RF_TOENS RF_TUMG ZF_BSD ZF_GEN ZF_IBS1 ZF_IBS2 ZF_IBS3 ZF_MANHYDR ZF_MANLUFT ZF_PMBATT ZF_PMBN ZF_PMRUHVERL ZF_QLT ZF_TANS ZF_TOENS ZF_TUMG /end OUT_MEASUREMENT
/end FUNCTION
/begin FUNCTION layer_msg ""
 /begin OUT_MEASUREMENT Layer_bos01_w Layer_bosbtvfbk Layer_bosstate Layer_bosvalue_DIAG Layer_FRC_INTM_T_BOS2 Layer_FRC_INTM_WAY_BOS2 Layer_ID2_BOS2 Layer_idbosmsg Layer_idfbosmg_w Layer_ID_FN_BOS2 Layer_stB_oelwech Layer_stExtWaitRdy Layer_stLayer Layer_stOelTog Layer_stOelVerb Layer_stOelVerl Layer_st_entlast_loc Layer_TARD_MON_BOS2 Layer_TARD_YR_BOS2 Layer_tChamWll Layer_tiAbstell Layer_tOilEng Layer_volOil Layer_volOilRefill Layer_zrbosmld PwrMng_absch_korr PwrMng_d_soc PwrMng_iEngine PwrMng_iGen PwrMng_nMin PwrMng_nnnstart PwrMng_pwrDes PwrMng_pwrPTC PwrMng_rCtrPwrSpCos PwrMng_rdffgen PwrMng_stB_ccbtnach PwrMng_stB_ccbttdfk PwrMng_stB_ccbttknt PwrMng_stB_ccpmerr PwrMng_stB_ccprio PwrMng_stB_ccruhver PwrMng_stB_codierpm PwrMng_stCtrCbr PwrMng_stCtrPCos PwrMng_stCtrPrio PwrMng_stCtrPrioCf PwrMng_stCtrPwrCos PwrMng_stGen PwrMng_stLdstGen PwrMng_stLIGov PwrMng_stPCos PwrMng_stRqPCos PwrMng_stSelSpCos PwrMng_stTerminal61 PwrMng_stULev PwrMng_tiLRGen PwrMng_ubt PwrMng_uGen PwrMng_uGen2 /end OUT_MEASUREMENT
/end FUNCTION
/begin FUNCTION layer_uic ""
 /begin OUT_MEASUREMENT Counter_Layer_fp1000_mp Counter_Layer_fp100_mp Counter_Layer_fp10_mp Counter_Layer_fp200_mp Counter_Layer_fp20_mp Counter_Layer_ini_mp Counter_Layer_nl1000_mp Counter_Layer_nl100_mp Counter_Layer_nl10_mp Counter_Layer_nl200_mp Counter_Layer_nl20_mp Counter_Layer_wakeup1000_mp Counter_Layer_wakeup100_mp Counter_Layer_wakeup10_mp Counter_Layer_wakeup200_mp Counter_Layer_wakeup20_mp Layer_stProcess_u8_mp PwrMng_dmAirPerTimeI_mp /end OUT_MEASUREMENT
/end FUNCTION
/begin FUNCTION ligov "Leerlaufregler"
 /begin DEF_CHARACTERISTIC LIGov_CldCltchFlt1T1_C LIGov_CldCltchFlt2T1_C LIGov_CldCltchIKi_C LIGov_CldCltchIKiPos_C LIGov_CldCltchIKiNeg_C LIGov_CldCltchIWinPos_C LIGov_CldCltchIWinNeg_C LIGov_CldCltchPredef_C LIGov_CldCltchPKp_C LIGov_CldCltchPKpPos_C LIGov_CldCltchPKpNeg_C LIGov_CldCltchPWinPos_C LIGov_CldCltchPWinNeg_C LIGov_tiCldGearDT1_C LIGov_CldGearDKd_C LIGov_CldGearIKi_C LIGov_CldGearIKiPos_C LIGov_CldGearIKiNeg_C LIGov_CldGearIWinPos_C LIGov_CldGearIWinNeg_C LIGov_CldGearPredef_C LIGov_CldGearPKp_C LIGov_CldGearPKpPos_C LIGov_CldGearPKpNeg_C LIGov_CldGearPWinPos_C LIGov_CldGearPWinNeg_C LIGov_ctNoSyncAfterPreCtrl_C LIGov_tiGear1DT1_C LIGov_Gear1DKd_C LIGov_Gear1Flt1T1_C LIGov_Gear1Flt2T1_C LIGov_Gear1IKi_C LIGov_Gear1IKiPos_C LIGov_Gear1IKiNeg_C LIGov_Gear1IWinPos_C LIGov_Gear1IWinNeg_C LIGov_Gear1Predef_C LIGov_Gear1PKp_C LIGov_Gear1PKpPos_C LIGov_Gear1PKpNeg_C LIGov_Gear1PWinPos_C LIGov_Gear1PWinNeg_C LIGov_tiGear2DT1_C LIGov_Gear2DKd_C LIGov_Gear2Flt1T1_C LIGov_Gear2Flt2T1_C LIGov_Gear2IKi_C LIGov_Gear2IKiPos_C LIGov_Gear2IKiNeg_C LIGov_Gear2IWinPos_C LIGov_Gear2IWinNeg_C LIGov_Gear2Predef_C LIGov_Gear2PKp_C LIGov_Gear2PKpPos_C LIGov_Gear2PKpNeg_C LIGov_Gear2PWinPos_C LIGov_Gear2PWinNeg_C LIGov_tiGear3DT1_C LIGov_Gear3DKd_C LIGov_Gear3Flt1T1_C LIGov_Gear3Flt2T1_C LIGov_Gear3IKi_C LIGov_Gear3IKiPos_C LIGov_Gear3IKiNeg_C LIGov_Gear3IWinPos_C LIGov_Gear3IWinNeg_C LIGov_Gear3Predef_C LIGov_Gear3PKp_C LIGov_Gear3PKpPos_C LIGov_Gear3PKpNeg_C LIGov_Gear3PWinPos_C LIGov_Gear3PWinNeg_C LIGov_tiGear4DT1_C LIGov_Gear4DKd_C LIGov_Gear4Flt1T1_C LIGov_Gear4Flt2T1_C LIGov_Gear4IKi_C LIGov_Gear4IKiPos_C LIGov_Gear4IKiNeg_C LIGov_Gear4IWinPos_C LIGov_Gear4IWinNeg_C LIGov_Gear4Predef_C LIGov_Gear4PKp_C LIGov_Gear4PKpPos_C LIGov_Gear4PKpNeg_C LIGov_Gear4PWinPos_C LIGov_Gear4PWinNeg_C LIGov_tiGear5DT1_C LIGov_Gear5DKd_C LIGov_Gear5Flt1T1_C LIGov_Gear5Flt2T1_C LIGov_Gear5IKi_C LIGov_Gear5IKiPos_C LIGov_Gear5IKiNeg_C LIGov_Gear5IWinPos_C LIGov_Gear5IWinNeg_C LIGov_Gear5Predef_C LIGov_Gear5PKp_C LIGov_Gear5PKpPos_C LIGov_Gear5PKpNeg_C LIGov_Gear5PWinPos_C LIGov_Gear5PWinNeg_C LIGov_tiGear6DT1_C LIGov_Gear6DKd_C LIGov_Gear6Flt1T1_C LIGov_Gear6Flt2T1_C LIGov_Gear6IKi_C LIGov_Gear6IKiPos_C LIGov_Gear6IKiNeg_C LIGov_Gear6IWinPos_C LIGov_Gear6IWinNeg_C LIGov_Gear6Predef_C LIGov_Gear6PKp_C LIGov_Gear6PKpPos_C LIGov_Gear6PKpNeg_C LIGov_Gear6PWinPos_C LIGov_Gear6PWinNeg_C LIGov_nDflTrmVal_C LIGov_nDHypDenom_C LIGov_nDHypNum_C LIGov_nLimHigh_C LIGov_nLimLow_C LIGov_nMSDiffMax_C LIGov_nOffsetPreCtrltrqDem_C LIGov_nOffsetPreCtrl_C LIGov_nOffsetPredef_C LIGov_nOffsetUbr_C LIGov_rAPPThresFreezeI_C LIGov_rAPPThresTrqDem_C LIGov_stPsRev_C LIGov_swtAPPFreezeI_C LIGov_swtAPPTrqDem_C LIGov_swtInitPreCtrlNotLck_C LIGov_tClntXLow_C LIGov_tClntXHigh_C LIGov_stCold_C LIGov_stWarm_C LIGov_tiDelCutOut_C LIGov_tiPT1_CUR LIGov_trqMax_CUR LIGov_trqSetMax_C LIGov_trqThresDefrostI_C LIGov_UbrPKp_C LIGov_UbrPKpPos_C LIGov_UbrPKpNeg_C LIGov_UbrPWinPos_C LIGov_UbrPWinNeg_C LIGov_vThresUbr_C LIGov_WrmCltchFlt1T1_C LIGov_WrmCltchFlt2T1_C LIGov_WrmCltchIKi_C LIGov_WrmCltchIKiPos_C LIGov_WrmCltchIKiNeg_C LIGov_WrmCltchIWinPos_C LIGov_WrmCltchIWinNeg_C LIGov_WrmCltchPredef_C LIGov_WrmCltchPKp_C LIGov_WrmCltchPKpPos_C LIGov_WrmCltchPKpNeg_C LIGov_WrmCltchPWinPos_C LIGov_WrmCltchPWinNeg_C /end DEF_CHARACTERISTIC
 /begin IN_MEASUREMENT Eng_nAvrg LIGov_nDiff_mp /end IN_MEASUREMENT
/end FUNCTION
/begin FUNCTION ligov_msg ""
 /begin OUT_MEASUREMENT LIGov_st LIGov_stSetTrqActive LIGov_trq LIGov_trqCurrPredef LIGov_trqFlt LIGov_trqI LIGov_trqP LIGov_trqSetDIAG /end OUT_MEASUREMENT
/end FUNCTION
/begin FUNCTION ligov_ms_msg "" /begin OUT_MEASUREMENT LIGov_trqIState LIGov_trqPILimMem /end OUT_MEASUREMENT /end FUNCTION
/begin FUNCTION ligov_setpoint ""
 /begin DEF_CHARACTERISTIC LIGov_dnLimHighTrm_C LIGov_dnLimLowTrm_C LIGov_nDeltaSec_C LIGov_nDiffDelta_C LIGov_nHDC_C LIGov_nLimHighOfs_C LIGov_nLimHighPrst_C LIGov_nLimHighTrmAct_C LIGov_nLimLowPrst_C LIGov_nRmpBaseDwn_C LIGov_nRmpBaseUp_C LIGov_nRmpCoEngDwn_C LIGov_nRmpCoEngUp_C LIGov_nRmpCutOutUp_C LIGov_nRmpCutOutDwn_C LIGov_nRmpGearbxDwn_C LIGov_nRmpGearbxUp_C LIGov_nRmpHDCDwn_C LIGov_nRmpHDCUp_C LIGov_nRmpPwrMngDwn_C LIGov_nRmpPwrMngUp_C LIGov_nRmpSecDelta_C LIGov_nRmpSurgeDwn_C LIGov_nRmpSurgeUp_C LIGov_nSetpointDia_C LIGov_nSetpointDriveAway_C LIGov_nSetpointInit2_MAP LIGov_nSetpointInit_MAP LIGov_nSetpointTrmLim_C LIGov_nSetpointTrm_C LIGov_nSetPointWarm_C LIGov_stActiveHDC_C LIGov_stReleaseHDC_C LIGov_swtGear_C LIGov_tiTW_C LIGov_trqInitI_MAP /end DEF_CHARACTERISTIC
 /begin IN_MEASUREMENT APSCD_pVal CTSCD_tClnt /end IN_MEASUREMENT
/end FUNCTION
/begin FUNCTION ligov_setpoint_msg ""
 /begin OUT_MEASUREMENT LIGov_nLimHigh LIGov_nMaxTrq LIGov_nSetCoEng LIGov_nSetLocal2 LIGov_nSetLocalRamp LIGov_nSetpoint LIGov_nSetpointPrst LIGov_nSetpointTrm LIGov_nSetPwrMng LIGov_stActiveHDC LIGov_stSetPoint LIGov_stSetpointPrst LIGov_stSetpointTrmActive LIGov_trqInitI /end OUT_MEASUREMENT
/end FUNCTION
/begin FUNCTION ligov_setpoint_uic "" /begin DEF_CHARACTERISTIC LIGov_nSetpoint_Vector LIGov_nSetpoint_Channel /end DEF_CHARACTERISTIC
 /begin OUT_MEASUREMENT LIGov_nDiffDelta_mp LIGov_nHDC_mp LIGov_nSetCoEngOld_mp LIGov_nSetGearbxOld_mp LIGov_nSetGearbx_mp LIGov_nSetHDCOld_mp LIGov_nSetHDC_mp LIGov_nSetLocal0_mp LIGov_nSetLocalRampOld_mp LIGov_nSetpointOld_mp LIGov_nSetpointTemp_mp LIGov_nSetpointTrm_mp LIGov_nSetpoint_mp LIGov_nSetPwrMngOld_mp LIGov_nSetSec1_mp LIGov_nSetSec2_mp LIGov_nSetSec4_mp LIGov_nSetSurgeOld_mp LIGov_nSetSurge_mp /end OUT_MEASUREMENT
/end FUNCTION
/begin FUNCTION ligov_tsync_ps_conv ""
 /begin DEF_CHARACTERISTIC LIGov_tiCldCltchDT1_C LIGov_CldCltchDKd_C LIGov_tiWrmCltchDT1_C LIGov_WrmCltchDKd_C /end DEF_CHARACTERISTIC
/end FUNCTION
/begin FUNCTION ligov_uic "" /begin DEF_CHARACTERISTIC LIGov_trq_Vector LIGov_trq_Channel /end DEF_CHARACTERISTIC
 /begin OUT_MEASUREMENT LIGov_CurrDKd_mp LIGov_CurrDT1_mp LIGov_CurrFlt1T1_mp LIGov_CurrFlt2T1_mp LIGov_CurrIKiNeg_mp LIGov_CurrIKiPos_mp LIGov_CurrIKi_mp LIGov_CurrIWinNeg_mp LIGov_CurrIWinPos_mp LIGov_CurrPKpNeg_mp LIGov_CurrPKpPos_mp LIGov_CurrPKp_mp LIGov_CurrPWinNeg_mp LIGov_CurrPWinPos_mp LIGov_nAvrg_mp LIGov_nDiffFlt1_mp LIGov_nDiffFlt2_mp LIGov_nDiff_mp LIGov_stSetTrqAlw_mp LIGov_tiPT1_mp LIGov_trqDRaw_mp LIGov_trqD_mp LIGov_trqLISetRdDIAG_mp LIGov_trqMax_mp LIGov_trqPreInitI_mp LIGov_trqSet_mp LIGov_trq_mp /end OUT_MEASUREMENT
/end FUNCTION
/begin FUNCTION lpacd ""
 /begin DEF_CHARACTERISTIC LPACD_ctPwrStgOnMax_C LPACD_DebExcTempDef_C LPACD_DebExcTempOk_C LPACD_DebNoLoadDef_C LPACD_DebNoLoadOk_C LPACD_DebShortCircBatDef_C LPACD_DebShortCircBatOk_C LPACD_DebShortCircGndDef_C LPACD_DebShortCircGndOk_C LPACD_numDia_C LPACD_numPwmOut_C LPACD_stInvOut_C LPACD_tiPer_C LPACD_rCnv_CUR LPACD_rOutMax_C LPACD_rOutMin_C LPACD_stPwrStgActv_C LPACD_stPwrStgDia_C LPACD_stSPICtl_C LPACD_swt_C LPACD_tiBtwTst_C LPACD_tiPwrStgOn_C /end DEF_CHARACTERISTIC
 /begin IN_MEASUREMENT BPA_rLPACD /end IN_MEASUREMENT
/end FUNCTION
/begin FUNCTION lpacd_msg "" /begin OUT_MEASUREMENT LPACD_rOut /end OUT_MEASUREMENT /end FUNCTION
/begin FUNCTION lpacd_uic "" /begin OUT_MEASUREMENT LPACD_rCnv_mp /end OUT_MEASUREMENT /end FUNCTION
/begin FUNCTION lsucd_adaption "Adaption des Lambdasondensignals"
 /begin DEF_CHARACTERISTIC LSUCD_tiAdptFltInit_C LSUCD_tiAdptFlt_C LSUCD_d2rInit_C LSUCD_dmAirIKi_C LSUCD_dmAirIKiPos_C LSUCD_dmAirIKiNeg_C LSUCD_dmAirIWinPos_C LSUCD_dmAirIWinNeg_C LSUCD_EvalMaxVal_C LSUCD_EvalMinVal_C LSUCD_tiEvalFltInit_C LSUCD_tiEvalFlt_C LSUCD_mAirAdptActv_C LSUCD_swtAdptVal_C LSUCD_swtAdptType_C LSUCD_tAirAdptActv_C /end DEF_CHARACTERISTIC
 /begin OUT_MEASUREMENT LSUCD_d2rO2Eval_mp LSUCD_d2rO2_mp LSUCD_drO2Flt_mp LSUCD_facO2Corr_mp LSUCD_mAirAftOvrRun_mp LSUCD_stAdptActv_mp LSUCD_stChange_mp LSUCD_stHold_mp /end OUT_MEASUREMENT
/end FUNCTION
/begin FUNCTION lsucd_adaption_msg "" /begin OUT_MEASUREMENT LSUCD_drO2Adpt LSUCD_rO2Adpt LSUCD_stAdpt LSUCD_swtAdpt /end OUT_MEASUREMENT /end FUNCTION
/begin FUNCTION lsucd_adaption_uic "" /end FUNCTION
/begin FUNCTION lsucd_heater "Heizung der Lambdasonde"
 /begin DEF_CHARACTERISTIC LSUCD_stHtInvOut_C LSUCD_tiHtPer_C LSUCD_tiDebHeaterDef_C LSUCD_tiDebHeaterOk_C LSUCD_uBattNominal_C LSUCD_uBattMaxHigh_C LSUCD_uBattMaxLow_C LSUCD_stPwrStgDia_C LSUCD_dcycTstPowerStage_C LSUCD_tiDebReset_C LSUCD_stHtDis_C LSUCD_stHeaterPwrStgSel_C LSUCD_tiHeaterBattDefDelay_C /end DEF_CHARACTERISTIC
 /begin OUT_MEASUREMENT LSUCD_facUCor_mp LSUCD_rOutHWE_mp /end OUT_MEASUREMENT
/end FUNCTION
/begin FUNCTION lsucd_heater_msg "" /begin OUT_MEASUREMENT LSUCD_dcycHtCor LSUCD_dcycLimActHt LSUCD_stHtDis /end OUT_MEASUREMENT /end FUNCTION
/begin FUNCTION lsucd_iprefctl "Controlling of the reference pump current"
 /begin DEF_CHARACTERISTIC LSUCD_stRefPumpDis_C LSUCD_tiRefPumpHigh_C LSUCD_tiRefTransLow_C LSUCD_tiRgnEna_C LSUCD_tiRgnIpSettle_C LSUCD_swtRgnChngCirct_C /end DEF_CHARACTERISTIC
 /begin OUT_MEASUREMENT LSUCD_stRefCurTrans_mp /end OUT_MEASUREMENT
/end FUNCTION
/begin FUNCTION lsucd_iprefctl_msg ""
 /begin OUT_MEASUREMENT LSUCD_stIpHighCurEna LSUCD_stIpNormCurEna LSUCD_stPumpDemRef LSUCD_stRefPump LSUCD_stRgnEna LSUCD_stRgnIpSettle /end OUT_MEASUREMENT
/end FUNCTION
/begin FUNCTION lsucd_iprefctl_uic "" /end FUNCTION
/begin FUNCTION lsucd_o2raw "Sauerstoffrohwert der Lambdasonde"
 /begin DEF_CHARACTERISTIC LSUCD_DebO2ClbDef_C LSUCD_DebO2ClbOk_C LSUCD_rO2_CUR LSUCD_tiO2ClbPT1_C LSUCD_tiO2PT1_C LSUCD_tiDebO2MaxTstDef_C LSUCD_tiDebO2MaxTstOk_C LSUCD_tiDebO2MinDef_C LSUCD_tiDebO2MinOk_C LSUCD_tiDelO2Clb_C LSUCD_tiO2Clb_C LSUCD_tiDelO2Val_C LSUCD_uO2Ref_C LSUCD_uO2ClbMax_C LSUCD_uO2ClbMin_C LSUCD_swtO2Filter_C LSUCD_uO2MaxNorm_C LSUCD_uO2MaxTst_C LSUCD_uO2Min_C LSUCD_swtSensDrftComp_C /end DEF_CHARACTERISTIC
 /begin OUT_MEASUREMENT LSUCD_stO2Clb_mp LSUCD_stSRCState_mp LSUCD_uO2OfsCor_mp LSUCD_uO2Raw_mp /end OUT_MEASUREMENT
/end FUNCTION
/begin FUNCTION lsucd_o2raw_msg ""
 /begin OUT_MEASUREMENT LSUCD_rO2Act LSUCD_rO2Raw LSUCD_stO2Act LSUCD_stO2ClbEna LSUCD_stO2IntValid LSUCD_stO2SPICalDem LSUCD_stO2SPISens LSUCD_uO2Clb LSUCD_uO2Raw LSU_swtEna /end OUT_MEASUREMENT
/end FUNCTION
/begin FUNCTION lsucd_o2raw_msg_var "" /begin OUT_MEASUREMENT LSUCD_stO2Valid /end OUT_MEASUREMENT /end FUNCTION
/begin FUNCTION lsucd_prescomp "Druckkompensation der mit Lambdasonde gemessenen Sauerstoffkonzentration"
 /begin DEF_CHARACTERISTIC LSUCD_facPresCompLean_CUR LSUCD_facPresCompRich_CUR LSUCD_rO2SwtPresComp_C /end DEF_CHARACTERISTIC
 /begin OUT_MEASUREMENT LSUCD_facPresComp_mp LSUCD_pExhGasLstVal_mp /end OUT_MEASUREMENT
/end FUNCTION
/begin FUNCTION lsucd_prescomp_msg "" /begin OUT_MEASUREMENT LSUCD_rO2PresComp /end OUT_MEASUREMENT /end FUNCTION
/begin FUNCTION lsucd_prescomp_uic "" /end FUNCTION
/begin FUNCTION lsucd_pumpctl "Pump current control" /begin DEF_CHARACTERISTIC LSUCD_stPumpCtlDis_C /end DEF_CHARACTERISTIC /end FUNCTION
/begin FUNCTION lsucd_pumpctl_msg "" /begin OUT_MEASUREMENT LSUCD_stPumpCtl /end OUT_MEASUREMENT /end FUNCTION
/begin FUNCTION lsucd_pumpctl_uic "" /end FUNCTION
/begin FUNCTION lsucd_ri "Ri der Lambdasonde"
 /begin DEF_CHARACTERISTIC LSUCD_DebRiClbDef_C LSUCD_DebRiClbOk_C LSUCD_tiRiClbPT1_C LSUCD_tiRiPT1_C LSUCD_tRi_CUR LSUCD_tiDelRiClb_C LSUCD_tiRiClb_C LSUCD_tiDelRiVal_C LSUCD_tiRiFltSettle_C LSUCD_resRiMaxJmp_C LSUCD_uRiOfs_C LSUCD_facUToRi_C LSUCD_resRiClbRef_C LSUCD_resRiClbMax_C LSUCD_resRiClbMin_C LSUCD_numRiDistSupp_C /end DEF_CHARACTERISTIC
 /begin OUT_MEASUREMENT LSUCD_resRiChange_mp LSUCD_resRiClbRaw_mp LSUCD_resRi_mp LSUCD_stRiFltAct_mp LSUCD_stRiLimSlp_mp /end OUT_MEASUREMENT
/end FUNCTION
/begin FUNCTION lsucd_ri_msg ""
 /begin OUT_MEASUREMENT LSUCD_resRi LSUCD_resRiClb LSUCD_resRiRaw LSUCD_stRiClb LSUCD_stRiClbEna LSUCD_stRiSPICalDem LSUCD_stRiValid LSUCD_tRi LSUCD_uRiRaw /end OUT_MEASUREMENT
/end FUNCTION
/begin FUNCTION lsucd_spictl "SPI Chip control" /begin DEF_CHARACTERISTIC LSUCD_stRefCurHigh_C LSUCD_stRefCurNormal_C /end DEF_CHARACTERISTIC /end FUNCTION
/begin FUNCTION lsucd_spictl_msg "" /begin OUT_MEASUREMENT LSUCD_stCircModeNew LSUCD_stSPIDiaInfo LSUCD_stSPIInitVal /end OUT_MEASUREMENT /end FUNCTION
/begin FUNCTION lsucd_spictl_uic "" /end FUNCTION
/begin FUNCTION lsucd_wiredia "Überwachung und Fehlererkennung von Kabel"
 /begin DEF_CHARACTERISTIC LSUCD_dcycMinGrad_C LSUCD_DebHtCoupDef_C LSUCD_DebHtCoupOk_C LSUCD_DebWireIpDef_C LSUCD_DebWireIpOk_C LSUCD_dNumHtCoup_C LSUCD_resRiMaxGrad_C LSUCD_rO2IsolChkMax_C LSUCD_rO2IsolChkMin_C LSUCD_stWireDiaActv_C LSUCD_tiHtCoupChk_C LSUCD_tiHtCoupPer_C LSUCD_tiIsolChkErr_C LSUCD_tiIsolChkPer_C LSUCD_tiIsolChkPump_C LSUCD_tiHtCoupFlt_C LSUCD_uO2MaxGrad_C LSUCD_uO2MaxRippel_C /end DEF_CHARACTERISTIC
 /begin OUT_MEASUREMENT LSUCD_dcycRippel_mp LSUCD_resRiRippel_mp LSUCD_stRecValEval_mp LSUCD_stTstTrigger_mp LSUCD_stWireDiaChk_mp LSUCD_stWireDiaErr_mp LSUCD_uO2FltRippel_mp LSUCD_uO2Grad_mp LSUCD_uO2Rippel_mp /end OUT_MEASUREMENT
/end FUNCTION
/begin FUNCTION lsucd_wiredia_100ms ""
 /begin DEF_CHARACTERISTIC LSUCD_tiOpnLdTstActv_C LSUCD_tiRiMeasDisa_C LSUCD_uO2OpnLdNernstMax_C LSUCD_uO2OpnLdNernstMin_C LSUCD_uO2OpnLdVirtGndMax_C LSUCD_uO2OpnLdVirtGndMin_C LSUCD_uRiOpnLdTstMax_C LSUCD_tiDebNoLdErrIPDef_C LSUCD_tiDebNoLdErrIPOk_C LSUCD_DebOpnLdVirtGndDef_C LSUCD_DebOpnLdVirtGndOk_C LSUCD_DebOpnLdNernstDef_C LSUCD_DebOpnLdNernstOk_C LSUCD_tiDebLowBattErrDef_C LSUCD_tiDebLowBattErrOk_C LSUCD_tiDebCircNernstDef_C LSUCD_tiDebCircNernstOk_C LSUCD_tiDebCircPumpDef_C LSUCD_tiDebCircPumpOk_C LSUCD_tiDebCircVirtGndDef_C LSUCD_tiDebCircVirtGndOk_C /end DEF_CHARACTERISTIC
/end FUNCTION
/begin FUNCTION lsucd_wiredia_100ms_msg "" /begin OUT_MEASUREMENT LSUCD_stOpnErrIP LSUCD_stOpnLdTstActv /end OUT_MEASUREMENT /end FUNCTION
/begin FUNCTION lsucd_wiredia_msg ""
 /begin OUT_MEASUREMENT LSUCD_ctHtCoup LSUCD_dcycHtCoupStep1 LSUCD_dcycHtCoupStep2 LSUCD_dcycHtCoupStep3 LSUCD_dHtCoupStep LSUCD_dHtCoupStepLast LSUCD_resRiHtCoupStep1 LSUCD_resRiHtCoupStep2 LSUCD_resRiHtCoupStep3 LSUCD_stDiaIAEna LSUCD_stHtCoupActv LSUCD_stInitClb LSUCD_stIsolChkActv LSUCD_stIsolChkO2Last LSUCD_stIsolChkStrt LSUCD_stPumpEna LSUCD_uO2HtCoupStep1 LSUCD_uO2HtCoupStep2 LSUCD_uO2HtCoupStep3 /end OUT_MEASUREMENT
/end FUNCTION
/begin FUNCTION lsucd_wiredia_uic "" /end FUNCTION
/begin FUNCTION lsuctl "Regelung zur Lambdaerfassung"
 /begin DEF_CHARACTERISTIC LSUCtl_tUpLim_C LSUCtl_tLowLim_C LSUCtl_tRiSetPoint_C LSUCtl_tHtCtlEna_C LSUCtl_nHtCtlEna_C LSUCtl_dcycHtMin_C LSUCtl_tExcMax_C LSUCtl_tExcMin_C LSUCtl_tiDelIniVal_C LSUCtl_dcycRmpUp_C LSUCtl_dcycRmpDwn_C LSUCtl_dcycStrt_CUR LSUCtl_tiDebRiExcMaxDef_C LSUCtl_tiDebRiExcMaxOk_C LSUCtl_tiDebRiExcMinDef_C LSUCtl_tiDebRiExcMinOk_C LSUCtl_tiSens1HtDT1_C LSUCtl_Sens1HtDT1Kd_C LSUCtl_Sens1HtIKi_C LSUCtl_Sens1HtIKiPos_C LSUCtl_Sens1HtIKiNeg_C LSUCtl_tSens1HtIWinPos_C LSUCtl_tSens1HtIWinNeg_C LSUCtl_Sens1HtPKp_C LSUCtl_Sens1HtPKpPos_C LSUCtl_Sens1HtPKpNeg_C LSUCtl_tSens1HtPWinPos_C LSUCtl_tSens1HtPWinNeg_C LSUCtl_tiSens2HtDT1_C LSUCtl_Sens2HtDT1Kd_C LSUCtl_Sens2HtIKi_C LSUCtl_Sens2HtIKiPos_C LSUCtl_Sens2HtIKiNeg_C LSUCtl_tSens2HtIWinPos_C LSUCtl_tSens2HtIWinNeg_C LSUCtl_Sens2HtPKp_C LSUCtl_Sens2HtPKpPos_C LSUCtl_Sens2HtPKpNeg_C LSUCtl_tSens2HtPWinPos_C LSUCtl_tSens2HtPWinNeg_C /end DEF_CHARACTERISTIC
 /begin OUT_MEASUREMENT LSUCtl_dcycDT1_mp LSUCtl_dcycPI_mp LSUCtl_stRmp_mp LSUCtl_tAirStrt_mp LSUCtl_tDvt_mp /end OUT_MEASUREMENT
/end FUNCTION
/begin FUNCTION lsuctl_msg ""
 /begin OUT_MEASUREMENT LSUCtl_dcycHt LSUCtl_dcycHtIniRamp LSUCtl_dcycHtStrt LSUCtl_stHtCtl LSUCtl_stHtDisable LSUCtl_stSCUNEna /end OUT_MEASUREMENT
/end FUNCTION
/begin FUNCTION lsu_clbsched "Lambda-Sensor Universal-Kalibrierungs-Scheduler"
 /begin DEF_CHARACTERISTIC LSU_ctRgnEna_C LSU_mAirMaxClb1_C LSU_mAirMaxClb2_C LSU_mAirMinClb1_C LSU_mAirMinClb2_C LSU_nMaxClb1_C LSU_nMaxClb2_C LSU_nMinClb1_C LSU_nMinClb2_C LSU_qMaxClb1_C LSU_qMaxClb2_C LSU_qMinClb1_C LSU_qMinClb2_C LSU_stChpClbActv_C LSU_stEGTClbOff_C LSU_ti1stClb_C LSU_tiPerClb_C LSU_uMinClb_C /end DEF_CHARACTERISTIC
 /begin OUT_MEASUREMENT LSU_stClbTrg_mp LSU_stNotOpPoint1_mp LSU_stNotOpPoint2_mp /end OUT_MEASUREMENT
/end FUNCTION
/begin FUNCTION lsu_clbsched_msg "" /begin OUT_MEASUREMENT LSU_stClbDisable LSU_stStrtClb LSU_stTmrClbPerRun /end OUT_MEASUREMENT /end FUNCTION
/begin FUNCTION lsu_conf ""
 /begin DEF_CHARACTERISTIC LSUCD_stCJChpSel_C LSUCD_stRgnEna_C LSU_dcycMax_C LSU_tiBattHighDebNeg_C LSU_tiBattHighDebPos_C LSU_tiOvrRunDebNeg_C LSU_tiOvrRunDebPos_C LSU_swtVal_C LSU_swtType_C LSU_uBattMin_C /end DEF_CHARACTERISTIC
/end FUNCTION
/begin FUNCTION lsu_lmbdcalc "Berechnung Lambda und 1/Lambda" /begin DEF_CHARACTERISTIC LSU_rLmbdRec_CUR /end DEF_CHARACTERISTIC /begin OUT_MEASUREMENT LSU_rO2AdptLastLSU_mp /end OUT_MEASUREMENT /end FUNCTION
/begin FUNCTION lsu_lmbdcalc_msg "" /end FUNCTION
/begin FUNCTION lsu_lmbdcalc_msg_var "" /begin OUT_MEASUREMENT LSU_rLmbd LSU_rLmbdRec LSU_rO2Adpt /end OUT_MEASUREMENT /end FUNCTION
/begin FUNCTION lsu_lmbdcalc_uic "" /end FUNCTION
/begin FUNCTION lsu_mon "Lambda-Sensor Universal-Diagnosefunktion"
 /begin DEF_CHARACTERISTIC LSU_DebDynErrDef_C LSU_DebDynErrOk_C LSU_DebO2ConcHighDef_C LSU_DebO2ConcHighOk_C LSU_DebO2ConcLowDef_C LSU_DebO2ConcLowOk_C LSU_mAirMax_C LSU_mAirMin_C LSU_nMax_C LSU_nMinChkDyn_C LSU_nMin_C LSU_qDiffMax_C LSU_qMax_C LSU_qMin_C LSU_qThresChkDyn_C LSU_qThresOvrRun_C LSU_rO2ConstVal_C LSU_tiDvtFlt_C LSU_rO2Lmbd1Thres_C LSU_rO2MaxVar_C LSU_rO2Min_C LSU_rO2NegDvt_C LSU_rO2PosDvt_C LSU_stMonActv_C LSU_stMonMsk_C LSU_stSelPlausChkSig_C LSU_tiDvt1Flt_C LSU_tiO2CalcFlt_C LSU_tiO2Eval_C LSU_tiSwitch_CA LSU_tiWait1_CA LSU_tiWait2_CA LSU_tiWait3_CA LSU_volMinFl_C /end DEF_CHARACTERISTIC
 /begin OUT_MEASUREMENT LSU_rO2Stat_mp LSU_rO2Thres1_mp LSU_rO2Thres2_mp LSU_stChkDyn_mp LSU_stO2Chk_mp LSU_stO2Err_mp LSU_stPlausChkCon_mp LSU_stPlausChk_mp LSU_tiState1_mp /end OUT_MEASUREMENT
/end FUNCTION
/begin FUNCTION lsu_mon_msg ""
 /begin OUT_MEASUREMENT LSU_rO2ActVal LSU_rO2DiffCmpChk LSU_rO2Lmbd1Thres LSU_rO2MaxDiff LSU_rO2MaxVal LSU_rO2MinVal LSU_rO2RawFlt LSU_stConstPOp LSU_tiState2 LSU_tiState3 LSU_tiSwitch LSU_tiWait3 /end OUT_MEASUREMENT
/end FUNCTION
/begin FUNCTION lsu_mon_uic ""
 /begin OUT_MEASUREMENT LSU_bpPlausSetPoint_mp LSU_qStrt_mp LSU_rO2Calc_mp LSU_rO2DvtNeg_mp LSU_rO2DvtPos_mp /end OUT_MEASUREMENT
/end FUNCTION
/begin FUNCTION lsu_ms_conf "" /begin DEF_CHARACTERISTIC LSUCD_swtMSSeparate_C /end DEF_CHARACTERISTIC /end FUNCTION
/begin COMPU_METHOD AirMassPerCyl "Luftmasse pro Zylinder" RAT_FUNC "%6.3" "mg/Hub" COEFFS 0 10 0 0 0 1 /end COMPU_METHOD
/begin COMPU_METHOD AirMassPerTime "Luftmasse pro Zeit" RAT_FUNC "%6.3" "Kg/h" COEFFS 0 10 0 0 0 1 /end COMPU_METHOD
/begin COMPU_METHOD AirMass_2 "Luftmasse (geringere Auflösung)" RAT_FUNC "%6.3" "g" COEFFS 0 10 0 0 0 1 /end COMPU_METHOD
/begin COMPU_METHOD CurRefPump "Applizierbarer Pumpreferenzstrom" TAB_VERB "%6.3" "-" COMPU_TAB_REF CurRefPump /end COMPU_METHOD
/begin COMPU_VTAB CurRefPump "Applizierbarer Pumpreferenzstrom" TAB_VERB 16 0 "0 uA" 1 "10 uA" 2 "20 uA" 3 "30 uA" 4 "40 uA" 5 "50 uA" 6 "60 uA" 7 "70 uA" 8 "80 uA" 9 "90 uA" 10 "100 uA" 11 "110 uA" 12 "120 uA" 13 "130 uA" 14 "140 uA" 15 "150 uA" /end COMPU_VTAB
/begin COMPU_METHOD DEZ "K3 Umwandlungen" RAT_FUNC "%6.2" "-" COEFFS 0 1 0 0 0 1 /end COMPU_METHOD
/begin COMPU_METHOD dn_dZfine "Engine acceleration per time (dn/dt) fine resolution" RAT_FUNC "%6.2" "rpm/s" COEFFS 0 1 0 0 0 1 /end COMPU_METHOD
/begin COMPU_METHOD DtyCyc "Tastverhaeltnis" RAT_FUNC "%6.4" "%" COEFFS 0 100 0 0 0 1 /end COMPU_METHOD
/begin COMPU_METHOD EngN "Motordrehzahl" RAT_FUNC "%6.2" "rpm" COEFFS 0 1 0 0 0 1 /end COMPU_METHOD
/begin COMPU_METHOD EngN_HiRes "Motordrehzahl, höhere Auflösung als EngM" RAT_FUNC "%6.3" "rpm" COEFFS 0 8 0 0 0 1 /end COMPU_METHOD
/begin COMPU_METHOD Fact "Faktor mit Auflösung 1 / 8192, hauptsächlich für einen Faktorenbereich 0...1 verwendet" RAT_FUNC "%6.5" "-" COEFFS 0 8192 0 0 0 1 /end COMPU_METHOD
/begin COMPU_METHOD fak_q0p5 "K3 Umwandlungen" RAT_FUNC "%6.3" "-" COEFFS 0 1 0 0 0 0.5 /end COMPU_METHOD
/begin COMPU_METHOD Fl_Half_L "Kraftstoffverbrauchsintegral" RAT_FUNC "%6.4" "l" COEFFS 0 20 0 0 0 1 /end COMPU_METHOD
/begin COMPU_METHOD igen_ub_q1 "K3 Umwandlungen" RAT_FUNC "%6.2" "-" COEFFS 0 1 0 0 0 1 /end COMPU_METHOD
/begin COMPU_METHOD InjMass "Einspritzmenge" RAT_FUNC "%6.4" "mg/hub" COEFFS 0 100 0 0 0 1 /end COMPU_METHOD
/begin COMPU_METHOD Kd_rpm2Nm "Differentialverstärkung Kd (Motordrehzahl EngN zu Motormoment Trq)" RAT_FUNC "%8.7" "Nm/rpm" COEFFS 0 655360 0 0 0 1 /end COMPU_METHOD
/begin COMPU_METHOD Kd_Temp_Kelv2Dcyc "Differentialverstärkung Kd (Temperatur zu Tastverhältnis)" RAT_FUNC "%8.7" "%/(K)" COEFFS 0 655360 0 0 0 1 /end COMPU_METHOD
/begin COMPU_METHOD Ki "Integrale Verstärkung Ki (gleiche Einheit/Umrechnungsregel an Ein- und Ausgang)" RAT_FUNC "%6.5" "1/s" COEFFS 0 4294.967296 0 0 0 1 /end COMPU_METHOD
/begin COMPU_METHOD Ki_rpm2Nm "Integralverstärkung Ki (Motordrehzahl EngN zu Motormoment Trq)" RAT_FUNC "%6.5" "Nm/(rpm*s)" COEFFS 0 5368.70912 0 0 0 1 /end COMPU_METHOD
/begin COMPU_METHOD Ki_Temp_Kelv2Dcyc "Integralverstärkung (Temperatur zu Tastverhältnis)" RAT_FUNC "%7.6" "%/(K)" COEFFS 0 42949.67296 0 0 0 1 /end COMPU_METHOD
/begin COMPU_METHOD km_sw_q10 "K3 Umwandlungen" RAT_FUNC "%6.1" "km" COEFFS 0 0.1 0 0 0 1 /end COMPU_METHOD
/begin COMPU_METHOD Kp_rpm2Nm "Proportionale Verstärkung Kp (Motordrehzahl EngN zu Moment Trq)" RAT_FUNC "%7.6" "Nm/rpm" COEFFS 0 81920 0 0 0 1 /end COMPU_METHOD
/begin COMPU_METHOD Kp_Temp_Kelv2Dcyc "Proportionalverstärkung (Temperatur zu Tastverhältnis)" RAT_FUNC "%8.7" "%/(K)" COEFFS 0 655360 0 0 0 1 /end COMPU_METHOD
/begin COMPU_METHOD lambda "Lambda" RAT_FUNC "%6.5" "-" COEFFS 0 1000 0 0 0 1 /end COMPU_METHOD
/begin COMPU_METHOD lambdaRecVal "Reziproker Lambda Wert" RAT_FUNC "%6.5" "-" COEFFS 0 1000 0 0 0 1 /end COMPU_METHOD
/begin COMPU_METHOD NumPinDia "Verbale Umrechnung für Diagnose Signale" TAB_VERB "%6.3" "-" COMPU_TAB_REF NumPinDia /end COMPU_METHOD
/begin COMPU_VTAB NumPinDia "Verbale Umrechnung für Diagnose Signale" TAB_VERB 34 0 "CJ945_Diagnostic_Signal" 1 "AC_Compressor_DiaSig" 2 "Fuel_Pump_DiaSig" 3 "Starter_234" 4 "Radiator_Blind_Control_Diagnostic_Signal" 5 "Engine_Bay_Air_Flaps/Compressor_Bypass_123" 6 "Glow_Relay_Diagnostic_Signal1" 7 "EngM_Bearing_Actuator_Diagnostic_Signal_124" 8 "reserved Glow_Relay_Diagnostic_Signal2" 9 "Ebox_Fan_Actuator_Diagnostic_Signal_219" 10 "Shutter_Actuator_SW_DiaSig" 11 "Twostage_TurboLoading_SW_DiaSig" 12 "DIO_OUT_DIAGNOSTIC_DUMMY_NOT_USED" 13 "1st_Pressure_Control_Valve_Diagnostic_Signal_172" 14 "2nd_Pressure_Control_Valve_Diagnostic_Signal_172" 15 "1st_Metering_Unit_Diagnostic_Signal_171" 16 "2nd_Metering_Unit_Diagnostic_Signal_171" 17 "Boost_Pressure_Actuator_Diagnostic_Signal_193" 18 "Boost_Pressure_Actuator_Diagnostic_Signal_193_2" 19 "EGR_Actuator_Diagnostic_Signal_194" 20 "EGR_Actuator_Diagnostic_Signal2" 21 "Variable_Swirl_Actuator_Diagnostic_Signal_195" 22 "Throttle_Valve_Diagnostic_Signal_196" 23 "Throttle_Valve2_Diagnostic_Signal_196" 24 "FAN_240" 25 "Add_On_Heater_244" 26 "Low pressure stage BPA_Diagnostic_Signal_117" 27 "PWM_DIAGNOSTIC_DUMMY_NOT_USED" 28 "1st_Sensor_Supply_Voltage_DiaSig" 29 "2nd_Sensor_Supply_Voltage_DiaSig" 30 "3rd_Sensor_Supply_Voltage_DiaSig" 31 "4th_Sensor_Supply_Voltage_DiaSig" 32 "5th_Sensor_Supply_Voltage_DiaSig" 33 "6th_Sensor_Supply_Voltage_DiaSig" /end COMPU_VTAB
/begin COMPU_METHOD NumPinPwmOut "Verbale Umrechnung für PWM-Ausgang Signale" TAB_VERB "%6.3" "-" COMPU_TAB_REF NumPinPwmOut /end COMPU_METHOD
/begin COMPU_VTAB NumPinPwmOut "Verbale Umrechnung für PWM-Ausgang Signale" TAB_VERB 14 0 "PCV_Actuator_172" 1 "MeUn_Actuator_171" 2 "Boost_Pressure_Actuator_193" 3 "Boost_Pressure_Actuator_193_2" 4 "EGR_Actuator_194" 5 "EGR_Actuator_2" 6 "Variable_Swirl_Actuator_195" 7 "Throttle_Valve_196" 8 "Throttle_Valve2_196" 9 "Fan_Actuator_240" 10 "Add_On_Heater_244" 11 "LSU_Heater_PWMOutput" 12 "Low pressure stage BPA_117" 13 "PWM_DUMMY_NOT_USED" /end COMPU_VTAB
/begin COMPU_METHOD O2 "Sauerstoffkonzentration" RAT_FUNC "%8.7" "-" COEFFS 0 100000 0 0 0 1 /end COMPU_METHOD
/begin COMPU_METHOD OneToOne "eins zu eins (physikalischer Wert ist gleich dem internen Wert)" RAT_FUNC "%6.2" "-" COEFFS 0 1 0 0 0 1 /end COMPU_METHOD
/begin COMPU_METHOD PCENT "K3 Umwandlungen" RAT_FUNC "%6.3" "%" COEFFS 0 256 0 0 0 100 /end COMPU_METHOD
/begin COMPU_METHOD Period "Periodendauer" RAT_FUNC "%6.3" "ms" COEFFS 0 10 0 0 0 1 /end COMPU_METHOD
/begin COMPU_METHOD Prc "Prozent, gleiche interne Auflösung wie Fact, aber Darstellung in Prozent (0...100%)" RAT_FUNC "%6.4" "%" COEFFS 0 81.92 0 0 0 1 /end COMPU_METHOD
/begin COMPU_METHOD Pres_hPa "Druck (angezeigt in [hPa])" RAT_FUNC "%6.2" "hPa" COEFFS 0 1 0 0 0 1 /end COMPU_METHOD
/begin COMPU_METHOD Pwr "Leistung" RAT_FUNC "%6.2" "W" COEFFS 0 0.10610329539459 0 0 0 1 /end COMPU_METHOD
/begin COMPU_METHOD Pwr_kW "Leistung in kW" RAT_FUNC "%6.4" "kW" COEFFS 0 100 0 0 0 1 /end COMPU_METHOD
/begin COMPU_METHOD rel_ub_q1 "K3 Umwandlungen" RAT_FUNC "%6.2" "%" COEFFS 0 1 0 0 0 1 /end COMPU_METHOD
/begin COMPU_METHOD Resist "Widerstand" RAT_FUNC "%6.3" "Ohm" COEFFS 0 10 0 0 0 1 /end COMPU_METHOD
/begin COMPU_METHOD RmpDtyCyc "Rampengradient für Tastverhältnis" RAT_FUNC "%6.5" "%/s" COEFFS 0 6553.6 0 0 0 1 /end COMPU_METHOD
/begin COMPU_METHOD RmpEngN "Rampengradient für Motordrehzahl" RAT_FUNC "%6.4" "rpm/s" COEFFS 0 65.536 0 0 0 1 /end COMPU_METHOD
/begin COMPU_METHOD SlopeRes10000 "Umrechnung für Slope: Slopewert mit Verhältnis 0,0001" RAT_FUNC "%7.6" "-" COEFFS 0 10000 0 0 0 1 /end COMPU_METHOD
/begin COMPU_METHOD spg_uw_q0p015 "K3 Umwandlungen" RAT_FUNC "%9.5" "V" COEFFS 0 1 0 0 0 0.015 /end COMPU_METHOD
/begin COMPU_METHOD TempDiff_Cels "difference/offset temperature displayed in degree celcius" RAT_FUNC "%6.3" "deg C" COEFFS 0 10 0 0 0 1 /end COMPU_METHOD
/begin COMPU_METHOD Temp_Cels "Temperatur dargestellt in °C (gleiche interne Darstellung wie Temp_Kelv)" RAT_FUNC "%6.1" "deg C" COEFFS 0 10 2731.4 0 0 1 /end COMPU_METHOD
/begin COMPU_METHOD temp_ub_q5_o50 "K3 Umwandlungen" RAT_FUNC "%6.2" "Grad C" COEFFS 0 1 50 0 0 5 /end COMPU_METHOD
/begin COMPU_METHOD TimeDeb "Entprellzeit in Millisekunden für Libraryfunktion Debounce" RAT_FUNC "%6.1" "ms" COEFFS 0 0.1 0 0 0 1 /end COMPU_METHOD
/begin COMPU_METHOD TimeDelay_s "Zeitkonstante T1 (in s) für PT1, DT1, etc." RAT_FUNC "%9.3" "s" COEFFS 0 0 1 0 0.00023283064365387 0 /end COMPU_METHOD
/begin COMPU_METHOD TimeDelay_s_Lin_16 "Zeitkonstante T1 (in s) für PT1, DT1, etc. für SINT16, kein Kehrwert" RAT_FUNC "%6.5" "s" COEFFS 0 6553.4 0 0 0 1 /end COMPU_METHOD
/begin COMPU_METHOD Time_ms "Zeit in ms für Fehlerentprellung (DSM) und SW-Timer" RAT_FUNC "%6.1" "ms" COEFFS 0 0.1 0 0 0 1 /end COMPU_METHOD
/begin COMPU_METHOD Time_s "Zeit in s für Fehlerentprellung (DSM) und SW-Timer" RAT_FUNC "%6.4" "s" COEFFS 0 100 0 0 0 1 /end COMPU_METHOD
/begin COMPU_METHOD Trq "Motormoment" RAT_FUNC "%6.3" "Nm" COEFFS 0 10 0 0 0 1 /end COMPU_METHOD
/begin COMPU_METHOD Trq32 "Umrechungsformel für inneres Moment in 32bit Zahlendarstellung" RAT_FUNC "%8.7" "Nm" COEFFS 0 655360 0 0 0 1 /end COMPU_METHOD
/begin COMPU_METHOD Vel "Fahrzeuggeschwindigkeit, gleiche interne Auflösung wie Vel_SI" RAT_FUNC "%6.4" "km/h" COEFFS 0 100 0 0 0 1 /end COMPU_METHOD
/begin COMPU_METHOD Volt "Spannung in V (von ADC)" RAT_FUNC "%6.2" "mV" COEFFS 0 0.2046 0 0 0 1 /end COMPU_METHOD
/begin COMPU_METHOD VoltToRes "Umrechnung für Faktor Spannung zu Widerstand" RAT_FUNC "%7.6" "Ohm/mV" COEFFS 0 50830.889540567 0 0 0 1 /end COMPU_METHOD
/begin COMPU_METHOD Volt_Batt "Batteriespannung" RAT_FUNC "%6.1" "mV" COEFFS 0 0.05115 0 0 0 1 /end COMPU_METHOD
/begin RECORD_LAYOUT Kf_Xs16_Ys16_Ws16 NO_AXIS_PTS_X 1 SWORD NO_AXIS_PTS_Y 2 SWORD AXIS_PTS_X 3 SWORD INDEX_INCR DIRECT AXIS_PTS_Y 4 SWORD INDEX_INCR DIRECT FNC_VALUES 5 SWORD COLUMN_DIR DIRECT /end RECORD_LAYOUT
/begin RECORD_LAYOUT Kl_Xs16_Ws16 NO_AXIS_PTS_X 1 SWORD AXIS_PTS_X 2 SWORD INDEX_INCR DIRECT FNC_VALUES 3 SWORD COLUMN_DIR DIRECT /end RECORD_LAYOUT
/begin RECORD_LAYOUT Kwb_Ws16 FNC_VALUES 1 SWORD COLUMN_DIR DIRECT /end RECORD_LAYOUT
/begin RECORD_LAYOUT Kwb_Wu16 FNC_VALUES 1 UWORD COLUMN_DIR DIRECT /end RECORD_LAYOUT
/begin RECORD_LAYOUT Kwb_Wu32 FNC_VALUES 1 ULONG COLUMN_DIR DIRECT /end RECORD_LAYOUT
/begin RECORD_LAYOUT Kw_Ws16 FNC_VALUES 1 SWORD COLUMN_DIR DIRECT /end RECORD_LAYOUT
/begin RECORD_LAYOUT Kw_Ws32 FNC_VALUES 1 SLONG COLUMN_DIR DIRECT /end RECORD_LAYOUT
/begin RECORD_LAYOUT Kw_Ws8 FNC_VALUES 1 SBYTE COLUMN_DIR DIRECT /end RECORD_LAYOUT
/begin RECORD_LAYOUT Kw_Wu16 FNC_VALUES 1 UWORD COLUMN_DIR DIRECT /end RECORD_LAYOUT
/begin RECORD_LAYOUT Kw_Wu32 FNC_VALUES 1 ULONG COLUMN_DIR DIRECT /end RECORD_LAYOUT
/begin RECORD_LAYOUT Kw_Wu8 FNC_VALUES 1 UBYTE COLUMN_DIR DIRECT /end RECORD_LAYOUT
/end MODULE
/end PROJECT
