ASAP2_VERSION 1 41
/begin PROJECT MSD70 "Spray Guided DI-System with Piezo Injectors for 6-Cylinder"
/begin HEADER "_default_HeaderComment" PROJECT_NO _0B /end HEADER
/begin MODULE _default_ModuleName "_default_ModuleLongIdentifier"
/begin MOD_COMMON "_default_ModCommonComment" DEPOSIT ABSOLUTE BYTE_ORDER MSB_LAST ALIGNMENT_BYTE 1 ALIGNMENT_WORD 2 ALIGNMENT_LONG 2 ALIGNMENT_FLOAT32_IEEE 2 ALIGNMENT_FLOAT64_IEEE 4 /end MOD_COMMON
/begin MEASUREMENT lv_cs_cus "Boolean for clutch switch detection" UBYTE _CNV_S_2_RANGE__0___1_CM 1 100. 0. 1. DISPLAY_IDENTIFIER LV_CS_CUS ECU_ADDRESS 0xd0003c7c BIT_MASK 0x1 /end MEASUREMENT
/begin MEASUREMENT lv_dt "Logical variable drive train engaged" UBYTE _CNV_S_2_RANGE__0___1_CM 1 100. 0. 1. DISPLAY_IDENTIFIER LV_DT ECU_ADDRESS 0xd0003c80 BIT_MASK 0x1 /end MEASUREMENT
/begin CHARACTERISTIC c_vs_min_dt "Threshold for vehicle running and drive-train closed detection " VALUE 0xa1029cb6 _REC_VAL_20_u1 255. _CNV_A_R_LINEAR_____6_CM 0. 255. DISPLAY_IDENTIFIER C_VS_MIN_DT FORMAT "%3.0" /end CHARACTERISTIC
/begin CHARACTERISTIC c_min_vs_ratio "Minimum engine speed / vehicle speed ratio calculation" VALUE 0xa10295a8 _REC_VAL_20_u1 255. _CNV_A_R_LINEAR_____6_CM 0. 255. DISPLAY_IDENTIFIER C_MIN_VS_RATIO FORMAT "%3.0" /end CHARACTERISTIC
/begin CHARACTERISTIC id_gr_mt__n_vs_ratio "Index table for Gear Ratio detection" CURVE 0xa1022774 _REC_CUR_20_u1_u1 255. _CNV_A_R_LINEAR_____0_CM 0. 255. DISPLAY_IDENTIFIER ID_GR_MT FORMAT "%3.0"
 /begin AXIS_DESCR COM_AXIS n_vs_ratio _CNV_A_R_LINEAR_____0_CM 13 0. 255. FORMAT "%3.0" AXIS_PTS_REF ldp_n_vs_ratio_gr_mt /end AXIS_DESCR
/end CHARACTERISTIC
/begin AXIS_PTS ldp_n_vs_ratio_gr_mt "" 0xa1021038 n_vs_ratio _REC_AXS_20_u1 255. _CNV_A_R_LINEAR_____0_CM 13 0. 255. FORMAT "%3.0" /end AXIS_PTS
/begin CHARACTERISTIC lc_rng_l "Manual switch for low range detection" VALUE 0xa1029dc5 _REC_VAL_20_u1 1. _CNV_A_R_LINEAR_____0_CM 0. 1. DISPLAY_IDENTIFIER LC_RNG_L FORMAT "%1.0" /end CHARACTERISTIC
/begin MEASUREMENT gr_mt "Manual transmission gear ratio" UBYTE _CNV_A_R_LINEAR_____0_CM 1 100. 0. 255. DISPLAY_IDENTIFIER GR_MT ECU_ADDRESS 0xd0003c74 FORMAT "%3.0" /end MEASUREMENT
/begin MEASUREMENT gr_at "Automatic transmission gear ratio" UBYTE _CNV_A_R_LINEAR_____0_CM 1 100. 0. 255. DISPLAY_IDENTIFIER GR_AT ECU_ADDRESS 0xd0003c75 FORMAT "%3.0" /end MEASUREMENT
/begin MEASUREMENT lv_rng_l "Logical variable for engaged low range" UBYTE _CNV_S_2_RANGE__0___1_CM 1 100. 0. 1. DISPLAY_IDENTIFIER LV_RNG_L ECU_ADDRESS 0xd0003c79 BIT_MASK 0x1 /end MEASUREMENT
/begin MEASUREMENT lv_dri "Logical variable for engaged drive" UBYTE _CNV_S_2_RANGE__0___1_CM 1 100. 0. 1. DISPLAY_IDENTIFIER LV_DRI ECU_ADDRESS 0xd0003c7b BIT_MASK 0x1 /end MEASUREMENT
/begin MEASUREMENT gear_ef "Gear ratio used for exhaust flap functionality" UBYTE _CNV_A_R_LINEAR_____0_CM 1 100. 0. 255. DISPLAY_IDENTIFIER GEAR_EF ECU_ADDRESS 0xd0003c77 FORMAT "%3.0" /end MEASUREMENT
/begin MEASUREMENT state_gear_rev_at_amt "AT/AMT reverse gear (activ = 1, inactive = 0)" UBYTE _CNV_S_2_RANGE______75_CM 1 100. 0. 1. DISPLAY_IDENTIFIER STATE_GEAR_REV_AT_AMT ECU_ADDRESS 0xd0003c78 /end MEASUREMENT
/begin MEASUREMENT n_vs_ratio "Engine speed / vehicle speed ratio" UBYTE _CNV_A_R_LINEAR_____163_CM 1 100. 0. 255. DISPLAY_IDENTIFIER N_VS_RATIO ECU_ADDRESS 0xc00006e8 FORMAT "%3.0" /end MEASUREMENT
/begin MEASUREMENT fac_gr "Factor for setpoint/actual reduction ratio of rear axle" UWORD _CNV_A_R_LINEAR_____8_CM 1 100. 0. 1.99996948242188 DISPLAY_IDENTIFIER FAC_GR ECU_ADDRESS 0xc00006e4 FORMAT "%7.5" /end MEASUREMENT
/begin MEASUREMENT fac_gr_mmv_av "Rear axle ratio adaptation value" UWORD _CNV_A_R_LINEAR_____8_CM 1 100. 0. 1.99996948242188 DISPLAY_IDENTIFIER FAC_GR_MMV_AV ECU_ADDRESS 0xd0005094 FORMAT "%7.5" /end MEASUREMENT
/begin MEASUREMENT gr_rax_av "Current rear axle ratio" UWORD _CNV_A_R_LINEAR_____27_CM 1 100. 0. 255.99609375 DISPLAY_IDENTIFIER GR_RAX_AV ECU_ADDRESS 0xc00006e6 FORMAT "%7.3" /end MEASUREMENT
/begin CHARACTERISTIC c_gr_rax_sp "Rear axle ratio of standard rear axle" VALUE 0xa1029492 _REC_VAL_20_u2 255.99609375 _CNV_A_R_LINEAR_____27_CM 0. 255.99609375 DISPLAY_IDENTIFIER C_GR_RAX_SP FORMAT "%7.3" /end CHARACTERISTIC
/begin CHARACTERISTIC c_crlc_fac_gr "Correlation constant for adaptation of the rear axle" VALUE 0xa10291f4 _REC_VAL_20_u1 0.99609375 _CNV_A_R_LINEAR_____71_CM 0. 0.99609375 DISPLAY_IDENTIFIER C_CRLC_FAC_GR FORMAT "%5.3" /end CHARACTERISTIC
/begin CHARACTERISTIC c_n_vs_cru_gear2_puc_sp "N/VS ratio in case of PUC in 2nd gear with standard rear axle" VALUE 0xa1029676 _REC_VAL_20_u1 255. _CNV_A_R_LINEAR_____163_CM 0. 255. DISPLAY_IDENTIFIER C_N_VS_CRU_GEAR2_PUC_SP FORMAT "%3.0" /end CHARACTERISTIC
/begin CHARACTERISTIC c_n_vs_cru_grd_fac_gr_max "Gradient of N/VS ratio below which FAC_GR is adapted" VALUE 0xa1029677 _REC_VAL_20_u1 255. _CNV_A_R_LINEAR_____163_CM 0. 255. DISPLAY_IDENTIFIER C_N_VS_CRU_GRD_FAC_GR_MAX FORMAT "%3.0" /end CHARACTERISTIC
/begin MEASUREMENT lv_rng_l_at "Logical variable for engaged low range AT" UBYTE _CNV_S_2_RANGE__0___1_CM 1 100. 0. 1. DISPLAY_IDENTIFIER LV_RNG_L_AT ECU_ADDRESS 0xd0003c7a BIT_MASK 0x1 /end MEASUREMENT
/begin CHARACTERISTIC c_state_etcu_prog_info "manual switch for activating low range AT detection" VALUE 0xa10297af _REC_VAL_20_u1 15. _CNV_A_R_LINEAR_____0_CM 0. 15. DISPLAY_IDENTIFIER C_STATE_ETCU_PROG_INFO FORMAT "%2.0" /end CHARACTERISTIC
/begin MEASUREMENT rls_mpl_value_prog "Release of multiple start value programming" UBYTE _CNV_A_R_LINEAR_____0_CM 1 100. 0. 255. DISPLAY_IDENTIFIER RLS_MPL_VALUE_PROG ECU_ADDRESS 0xd0003f56 FORMAT "%3.0" /end MEASUREMENT
/begin MEASUREMENT state_imob "State of the immobilizer" UBYTE _CNV_A_R_LINEAR_____0_CM 1 100. 0. 255. DISPLAY_IDENTIFIER STATE_IMOB ECU_ADDRESS 0xd0003f57 FORMAT "%3.0" /end MEASUREMENT
/begin MEASUREMENT nr_free_startvalues "Number of free startvalues bit codet and a release bit" UBYTE _CNV_A_R_LINEAR_____0_CM 1 100. 0. 255. DISPLAY_IDENTIFIER NR_FREE_STARTVALUES ECU_ADDRESS 0xd0003f55 FORMAT "%3.0" /end MEASUREMENT
/begin MEASUREMENT maf_kgh_mes_bas "Raw air-mass flow measured (without correction, to be used for diagnosis only)" UWORD _CNV_A_R_LINEAR_____207_CM 1 100. 0. 2047.96875 DISPLAY_IDENTIFIER MAF_KGH_MES_BAS ECU_ADDRESS 0xd0004d7a FORMAT "%7.2" /end MEASUREMENT
/begin MEASUREMENT maf_mes "Mass air flow per segment" UWORD _CNV_A_R_LINEAR_____108_CM 1 100. 0. 1389. DISPLAY_IDENTIFIER MAF_MES ECU_ADDRESS 0xd0004d7c FORMAT "%7.2" /end MEASUREMENT
/begin MEASUREMENT maf_kgh_mes "Mass air flow per segment measured" UWORD _CNV_A_R_LINEAR_____207_CM 1 100. 0. 2047.96875 DISPLAY_IDENTIFIER MAF_KGH_MES ECU_ADDRESS 0xd0004d78 FORMAT "%7.2" /end MEASUREMENT
/begin AXIS_PTS ldp_n__pq_sp_puls "" 0xa1020ea4 n _REC_AXS_20_u2 816. _CNV_A_R_LINEAR_____13_CM 6 0. 8160. FORMAT "%4.0" /end AXIS_PTS
/begin CHARACTERISTIC ip_pq_sp_puls "PQ-threshold for LV_MAF_PULS" CURVE 0xa10276c8 _REC_CUR_20_u2_u2 0.9999847412109381 _CNV_A_R_LINEAR_____68_CM 0. 0.9999847412109381 DISPLAY_IDENTIFIER IP_PQ_SP_PULS FORMAT "%7.5"
 /begin AXIS_DESCR COM_AXIS n _CNV_A_R_LINEAR_____13_CM 6 0. 8160. FORMAT "%4.0" AXIS_PTS_REF ldp_n__pq_sp_puls /end AXIS_DESCR
/end CHARACTERISTIC
/begin CHARACTERISTIC c_pq_sp_hys_puls "Hysteresis for PQ-threshold for LV_MAF_PULS" VALUE 0xa102971c _REC_VAL_20_u2 0.9999847412109381 _CNV_A_R_LINEAR_____68_CM 0. 0.9999847412109381 DISPLAY_IDENTIFIER C_PQ_SP_HYS_PULS FORMAT "%7.5" /end CHARACTERISTIC
/begin MEASUREMENT lv_maf_puls "Boolean for wrong air flow acquisition" UBYTE _CNV_S_2_RANGE__0___1_CM 1 100. 0. 1. DISPLAY_IDENTIFIER LV_MAF_PULS ECU_ADDRESS 0xd0003a08 BIT_MASK 0x1 /end MEASUREMENT
/begin CHARACTERISTIC ip_fac_maf_kgh_cor "Correction for MAF_KGH_MES depending on MAF_KGH_MES_BAS" MAP 0xa1023af4 _REC_MAP_20_u1_u2_u1 1.9921875 _CNV_A_R_LINEAR_____100_CM 0. 1.9921875 DISPLAY_IDENTIFIER IP_FAC_MAF_KGH_COR FORMAT "%5.3"
 /begin AXIS_DESCR COM_AXIS maf_kgh_mes_bas _CNV_A_R_LINEAR_____207_CM 6 0. 2047.96875 FORMAT "%7.2" AXIS_PTS_REF ldp_maf_kgh_mes_bas /end AXIS_DESCR
 /begin AXIS_DESCR COM_AXIS tia _CNV_A_R_LINEAR_____16_CM 6 -48. 142.5 FORMAT "%6.2" AXIS_PTS_REF ldp_tia_ip_fac_maf_kgh_cor /end AXIS_DESCR
/end CHARACTERISTIC
/begin AXIS_PTS ldp_maf_kgh_mes_bas "" 0xa1020cbc maf_kgh_mes_bas _REC_AXS_20_u2 2047.96875 _CNV_A_R_LINEAR_____207_CM 6 0. 2047.96875 FORMAT "%7.2" /end AXIS_PTS
/begin AXIS_PTS ldp_tia_ip_fac_maf_kgh_cor "" 0xa1021376 tia _REC_AXS_20_u1 190.5 _CNV_A_R_LINEAR_____16_CM 6 -48. 142.5 FORMAT "%6.2" /end AXIS_PTS
/begin MEASUREMENT maf_kgh_mes_tcha "corrected mass air flow up turbo charger, measured per segment" UWORD _CNV_A_R_LINEAR_____207_CM 1 100. 0. 2047.96875 DISPLAY_IDENTIFIER MAF_KGH_MES_TCHA ECU_ADDRESS 0xd0004d7e FORMAT "%7.2" /end MEASUREMENT
/begin MEASUREMENT maf_kgh_mes_bas_tcha "Raw air-mass flow up turbo chager measured (without correction, to be used for diagnosis only)" UWORD _CNV_A_R_LINEAR_____207_CM 1 100. 0. 2047.96875 DISPLAY_IDENTIFIER MAF_KGH_MES_BAS_TCHA ECU_ADDRESS 0xd0004d80 FORMAT "%7.2" /end MEASUREMENT
/begin CHARACTERISTIC c_maf_mmv_dif_crlc "MAF moving mean value filtering factor" VALUE 0xa1029564 _REC_VAL_20_u1 9.9609375e-002 _CNV_A_R_LINEAR_____27_CM 0. 0.99609375 DISPLAY_IDENTIFIER C_MAF_MMV_DIF_CRLC FORMAT "%5.3" /end CHARACTERISTIC
/begin MEASUREMENT maf_kgh "Mass air flow per segment" UWORD _CNV_A_R_LINEAR_____207_CM 1 100. 0. 2047.96875 DISPLAY_IDENTIFIER MAF_KGH ECU_ADDRESS 0xd0004d84 FORMAT "%7.2" /end MEASUREMENT
/begin MEASUREMENT maf_dif "Mass air flow difference per segment" SWORD _CNV_A_R_LINEAR_____192_CM 1 100. -694.5 694.478806 DISPLAY_IDENTIFIER MAF_DIF ECU_ADDRESS 0xd0004d86 FORMAT "%7.2" /end MEASUREMENT
/begin CHARACTERISTIC c_maf_mmv_hys "Threshold for detecting raising MAF_MMV" VALUE 0xa1029566 _REC_VAL_20_u2 694.5 _CNV_A_R_LINEAR_____219_CM 0. 694.5 DISPLAY_IDENTIFIER C_MAF_MMV_HYS FORMAT "%6.2" /end CHARACTERISTIC
/begin MEASUREMENT maf_mmv "MAF moving mean value" UWORD _CNV_A_R_LINEAR_____108_CM 1 100. 0. 1389. DISPLAY_IDENTIFIER MAF_MMV ECU_ADDRESS 0xd0004d88 FORMAT "%6.2" /end MEASUREMENT
/begin MEASUREMENT maf_flow_ex "air mass flow out of the exhaust manifold" UWORD _CNV_A_R_LINEAR_____207_CM 1 100. 0. 2047.96875 DISPLAY_IDENTIFIER MAF_FLOW_EX ECU_ADDRESS 0xd0004d98 FORMAT "%7.2" /end MEASUREMENT
/begin CHARACTERISTIC c_tcyl_stnd "standard temperature in cylinder" VALUE 0xa10299f6 _REC_VAL_20_u1 28.575 _CNV_A_R_LINEAR_____16_CM -48. 142.5 DISPLAY_IDENTIFIER C_TCYL_STND FORMAT "%5.1" /end CHARACTERISTIC
/begin CHARACTERISTIC c_tco_stnd "standard coolant temperature" VALUE 0xa10299f0 _REC_VAL_20_u1 28.575 _CNV_A_R_LINEAR_____16_CM -48. 142.5 DISPLAY_IDENTIFIER C_TCO_STND FORMAT "%5.1" /end CHARACTERISTIC
/begin CHARACTERISTIC c_tia_im_stnd "standard intake air temperature" VALUE 0xa1029a4f _REC_VAL_20_u1 28.575 _CNV_A_R_LINEAR_____16_CM -48. 142.5 DISPLAY_IDENTIFIER C_TIA_IM_STND FORMAT "%5.1" /end CHARACTERISTIC
/begin MEASUREMENT eff_vol_temp_cor "volumetric efficiency correction factor due to temperature effects" UWORD _CNV_A_R_LINEAR_____8_CM 1 100. 0. 1.99996948242188 DISPLAY_IDENTIFIER EFF_VOL_TEMP_COR ECU_ADDRESS 0xc0000894 FORMAT "%7.5" /end MEASUREMENT
/begin MEASUREMENT eff_vol_temp_cor_mmv "filtered volumetric efficiency correction factor due to temperature effects" UWORD _CNV_A_R_LINEAR_____8_CM 1 100. 0. 1.99996948242188 DISPLAY_IDENTIFIER EFF_VOL_TEMP_COR_MMV ECU_ADDRESS 0xd0004da2 FORMAT "%7.5" /end MEASUREMENT
/begin CHARACTERISTIC ip_crlc_eff_vol_temp_cor "Volumetric efficiency filtering" CURVE 0xa1023190 _REC_CUR_20_u1_u1 0.99609375 _CNV_A_R_LINEAR_____27_CM 0. 0.99609375 DISPLAY_IDENTIFIER IP_CRLC_EFF_VOL_TEMP_COR FORMAT "%5.3"
 /begin AXIS_DESCR COM_AXIS n_32 _CNV_A_R_LINEAR_____9_CM 6 0. 8160. FORMAT "%4.0" AXIS_PTS_REF ldp_n_32_ip_crlc_eff_vol_temp /end AXIS_DESCR
/end CHARACTERISTIC
/begin CHARACTERISTIC ip_eff_tco_fac__n_32__maf "Volumetric efficiency weighting factor versus cooling temperature" MAP 0xa10232c0 _REC_MAP_20_u1_u1_u2 0.99609375 _CNV_A_R_LINEAR_____27_CM 0. 0.99609375 DISPLAY_IDENTIFIER IP_EFF_TCO_FAC__N_32__MAF FORMAT "%5.3"
 /begin AXIS_DESCR COM_AXIS n_32 _CNV_A_R_LINEAR_____9_CM 8 0. 8160. FORMAT "%4.0" AXIS_PTS_REF ldpm_n_32__eff_vol_cor /end AXIS_DESCR
 /begin AXIS_DESCR COM_AXIS maf _CNV_A_R_LINEAR_____108_CM 8 0. 1389. FORMAT "%7.2" AXIS_PTS_REF ldpm_maf__eff_vol_cor /end AXIS_DESCR
/end CHARACTERISTIC
/begin CHARACTERISTIC ip_eff_tia_im_fac__n_32__maf "Volumetric effiency weighting factor versus intake manifold gas temperature" MAP 0xa1023300 _REC_MAP_20_u1_u1_u2 0.99609375 _CNV_A_R_LINEAR_____27_CM 0. 0.99609375 DISPLAY_IDENTIFIER IP_EFF_TIA_IM_FAC__N_32__MAF FORMAT "%5.3"
 /begin AXIS_DESCR COM_AXIS n_32 _CNV_A_R_LINEAR_____9_CM 8 0. 8160. FORMAT "%4.0" AXIS_PTS_REF ldpm_n_32__eff_vol_cor /end AXIS_DESCR
 /begin AXIS_DESCR COM_AXIS maf _CNV_A_R_LINEAR_____108_CM 8 0. 1389. FORMAT "%7.2" AXIS_PTS_REF ldpm_maf__eff_vol_cor /end AXIS_DESCR
/end CHARACTERISTIC
/begin AXIS_PTS ldp_n_32_ip_crlc_eff_vol_temp "" 0xa1020dea n_32 _REC_AXS_20_u1 8160. _CNV_A_R_LINEAR_____9_CM 6 0. 8160. FORMAT "%4.0" /end AXIS_PTS
/begin AXIS_PTS ldpm_n_32__eff_vol_cor "" 0xa1021e04 n_32 _REC_AXS_20_u1 8160. _CNV_A_R_LINEAR_____9_CM 8 0. 8160. FORMAT "%4.0" /end AXIS_PTS
/begin AXIS_PTS ldpm_maf__eff_vol_cor "" 0xa1021be8 maf _REC_AXS_20_u2 1389. _CNV_A_R_LINEAR_____108_CM 8 0. 1389. FORMAT "%7.2" /end AXIS_PTS
/begin CHARACTERISTIC c_n_dif_crlc "Correlation factor for N_DIF_MMV calculation" VALUE 0xa10295dc _REC_VAL_20_u1 0.99609375 _CNV_A_R_LINEAR_____27_CM 0. 0.99609375 DISPLAY_IDENTIFIER C_N_DIF_CRLC FORMAT "%5.3" /end CHARACTERISTIC
/begin CHARACTERISTIC c_n_dif_min_mmv "Minimum filtering constant" VALUE 0xa10295ee _REC_VAL_20_s2 408. _CNV_A_R_LINEAR_____13_CM -4080. 0. DISPLAY_IDENTIFIER C_N_DIF_MIN_MMV FORMAT "%6.0" /end CHARACTERISTIC
/begin MEASUREMENT n_dif_cor "Idle speed control value" SWORD _CNV_A_R_LINEAR_____13_CM 1 100. -4096. 4064. DISPLAY_IDENTIFIER N_DIF_COR ECU_ADDRESS 0xd0004f5c FORMAT "%4.0" /end MEASUREMENT
/begin MEASUREMENT n_dif_mmv "N_DIF moving mean value" SWORD _CNV_A_R_LINEAR_____13_CM 1 100. -8160. 8160. DISPLAY_IDENTIFIER N_DIF_MMV ECU_ADDRESS 0xd0004f60 FORMAT "%4.0" /end MEASUREMENT
/begin MEASUREMENT n_max_tol_st "Top level end of start engine speed" UBYTE _CNV_A_R_LINEAR_____9_CM 1 100. 0. 8160. DISPLAY_IDENTIFIER N_MAX_TOL_ST ECU_ADDRESS 0xd0003b34 FORMAT "%4.0" /end MEASUREMENT
/begin CHARACTERISTIC c_n_dif_fac "Weighting factor for the idle speed variable controller" VALUE 0xa10295e4 _REC_VAL_20_u1 0.99609375 _CNV_A_R_LINEAR_____27_CM 0. 0.99609375 DISPLAY_IDENTIFIER C_N_DIF_FAC FORMAT "%5.3" /end CHARACTERISTIC
/begin CHARACTERISTIC ip_dri_acin_n_sp_is "Nominal idle speed with DRIVE (A/T) engaged and air conditioner switched on" CURVE 0xa1023270 _REC_CUR_20_u2_u1 8160. _CNV_A_R_LINEAR_____13_CM 0. 8160. DISPLAY_IDENTIFIER IP_DRI_ACIN_N_SP_IS FORMAT "%4.0"
 /begin AXIS_DESCR COM_AXIS tco _CNV_A_R_LINEAR_____16_CM 8 -48. 142.5 FORMAT "%5.1" AXIS_PTS_REF ldpm_tco_n_sp_1 /end AXIS_DESCR
/end CHARACTERISTIC
/begin MEASUREMENT n_dif_st "Engine speed deviation N_MAX_TOL_ST - N" SWORD _CNV_A_R_LINEAR_____13_CM 1 100. -32768. 32767. DISPLAY_IDENTIFIER N_DIF_ST ECU_ADDRESS 0xd0004f5e FORMAT "%6.0" /end MEASUREMENT
/begin MEASUREMENT n_sp_is_ratio "Ratio actual engine speed versus engine speed setpoint at idle" UWORD _CNV_A_R_LINEAR_____113_CM 1 100. 0. 7.9998779296875 DISPLAY_IDENTIFIER N_SP_IS_RATIO ECU_ADDRESS 0xd0004f62 FORMAT "%6.4" /end MEASUREMENT
/begin CHARACTERISTIC ip_n_sp_is_lih "Idle speed setpoint in case of limp home" CURVE 0xa1026450 _REC_CUR_20_u2_u1 8160. _CNV_A_R_LINEAR_____13_CM 0. 8160. DISPLAY_IDENTIFIER IP_N_SP_IS_LIH FORMAT "%4.0"
 /begin AXIS_DESCR COM_AXIS tco _CNV_A_R_LINEAR_____16_CM 8 -48. 142.5 FORMAT "%5.1" AXIS_PTS_REF ldpm_tco_n_sp_1 /end AXIS_DESCR
/end CHARACTERISTIC
/begin CHARACTERISTIC ip_dri_n_sp_is_lih "Idle speed setpoint in case of limp home and engaged drivetrain" CURVE 0xa1023290 _REC_CUR_20_u2_u1 8160. _CNV_A_R_LINEAR_____13_CM 0. 8160. DISPLAY_IDENTIFIER IP_DRI_N_SP_IS_LIH FORMAT "%4.0"
 /begin AXIS_DESCR COM_AXIS tco _CNV_A_R_LINEAR_____16_CM 8 -48. 142.5 FORMAT "%5.1" AXIS_PTS_REF ldpm_tco_n_sp_1 /end AXIS_DESCR
/end CHARACTERISTIC
/begin CHARACTERISTIC ip_n_sp_is "Nominal idle speed without additional load on the engine" CURVE 0xa1026418 _REC_CUR_20_u2_u1 8160. _CNV_A_R_LINEAR_____13_CM 0. 8160. DISPLAY_IDENTIFIER IP_N_SP_IS FORMAT "%4.0"
 /begin AXIS_DESCR COM_AXIS tco _CNV_A_R_LINEAR_____16_CM 8 -48. 142.5 FORMAT "%5.1" AXIS_PTS_REF ldpm_tco_n_sp_1 /end AXIS_DESCR
/end CHARACTERISTIC
/begin MEASUREMENT n_dif "Engine speed deviation N_SP_IS_N" SWORD _CNV_A_R_LINEAR_____13_CM 1 100. -4096. 4064. DISPLAY_IDENTIFIER N_DIF ECU_ADDRESS 0xd0004f5a FORMAT "%4.0" /end MEASUREMENT
/begin MEASUREMENT n_sp_is_pow "Active nominal idle speed setpoint by power management active" UWORD _CNV_A_R_LINEAR_____13_CM 1 100. 0. 8160. DISPLAY_IDENTIFIER N_SP_IS_POW ECU_ADDRESS 0xc000095c FORMAT "%4.0" /end MEASUREMENT
/begin MEASUREMENT n_sp_is_2 "basis idle speed setpoint" UWORD _CNV_A_R_LINEAR_____13_CM 1 100. 0. 8160. DISPLAY_IDENTIFIER N_SP_IS_2 ECU_ADDRESS 0xd0004f56 FORMAT "%4.0" /end MEASUREMENT
/begin MEASUREMENT n_sp_is_3 "greatest of all idle speed setpoints" UWORD _CNV_A_R_LINEAR_____13_CM 1 100. 0. 8160. DISPLAY_IDENTIFIER N_SP_IS_3 ECU_ADDRESS 0xd0004f58 FORMAT "%4.0" /end MEASUREMENT
/begin MEASUREMENT lv_req_heat_n_sp_is "LV Idle Speed setpoint required from heating control unit" UBYTE _CNV_S_2_RANGE__0___1_CM 1 100. 0. 1. DISPLAY_IDENTIFIER LV_REQ_HEAT_N_SP_IS ECU_ADDRESS 0xc0000984 BIT_MASK 0x1 /end MEASUREMENT
/begin CHARACTERISTIC ip_acin_n_sp_is "Nominal idle speed with air conditioner switched on" CURVE 0xa1023050 _REC_CUR_20_u2_u1 8160. _CNV_A_R_LINEAR_____13_CM 0. 8160. DISPLAY_IDENTIFIER IP_ACIN_N_SP_IS FORMAT "%4.0"
 /begin AXIS_DESCR COM_AXIS tco _CNV_A_R_LINEAR_____16_CM 8 -48. 142.5 FORMAT "%5.1" AXIS_PTS_REF ldpm_tco_n_sp_1 /end AXIS_DESCR
/end CHARACTERISTIC
/begin CHARACTERISTIC ip_fac_n_sp_ofs_kwp "TCO factor for N_SP_OFS_KWP" CURVE 0xa1023b70 _REC_CUR_20_u1_u1 0.99610001 _CNV_A_R_LINEAR_____17_CM 0. 0.99610001 DISPLAY_IDENTIFIER IP_FAC_N_SP_OFS_KWP FORMAT "%5.3"
 /begin AXIS_DESCR COM_AXIS tco _CNV_A_R_LINEAR_____16_CM 8 -48. 142.5 FORMAT "%5.1" AXIS_PTS_REF ldpm_tco_n_sp_1 /end AXIS_DESCR
/end CHARACTERISTIC
/begin CHARACTERISTIC ip_t_ast_min_n_sp_is_cs "Minimum delay time after start for drive-off-support idle speed" CURVE 0xa1027a0c _REC_CUR_20_u2_u1 6553.5 _CNV_A_R_LINEAR_____4_CM 0. 6553.5 DISPLAY_IDENTIFIER IP_T_AST_MIN_N_SP_IS_CS FORMAT "%6.1"
 /begin AXIS_DESCR COM_AXIS tco _CNV_A_R_LINEAR_____16_CM 8 -48. 142.5 FORMAT "%5.1" AXIS_PTS_REF ldpm_tco_n_sp_1 /end AXIS_DESCR
/end CHARACTERISTIC
/begin CHARACTERISTIC c_n_sp_ofs_kwp_max "Upper threshold for tester offset" VALUE 0xa1029664 _REC_VAL_20_u2 32767. _CNV_A_R_LINEAR_____13_CM 0. 32767. DISPLAY_IDENTIFIER C_N_SP_OFS_KWP_MAX FORMAT "%5.0" /end CHARACTERISTIC
/begin CHARACTERISTIC c_tam_n_sp_heat "Ambient temperature threshold idle speed at heater request" VALUE 0xa10299c5 _REC_VAL_20_u1 190.5 _CNV_A_R_LINEAR_____16_CM -48. 142.5 DISPLAY_IDENTIFIER C_TAM_N_SP_HEAT FORMAT "%5.1" /end CHARACTERISTIC
/begin CHARACTERISTIC c_tam_hys "Ambient temperature threshold idle speed at heater request" VALUE 0xa10299bb _REC_VAL_20_u1 48. _CNV_A_R_LINEAR_____24_CM 0. 48. DISPLAY_IDENTIFIER C_TAM_HYS FORMAT "%4.1" /end CHARACTERISTIC
/begin CHARACTERISTIC c_n_sp_heat_mt "Idle speed at heater request, manual transmission vehicle" VALUE 0xa1029650 _REC_VAL_20_u2 8160. _CNV_A_R_LINEAR_____13_CM 0. 8160. DISPLAY_IDENTIFIER C_N_SP_HEAT_MT FORMAT "%4.0" /end CHARACTERISTIC
/begin CHARACTERISTIC c_n_sp_heat_at "Idle speed at heater request, automatic transmission vehicle" VALUE 0xa102964e _REC_VAL_20_u2 8160. _CNV_A_R_LINEAR_____13_CM 0. 8160. DISPLAY_IDENTIFIER C_N_SP_HEAT_AT FORMAT "%4.0" /end CHARACTERISTIC
/begin CHARACTERISTIC c_n_sp_dec_cs "Decrement engine speed setpoint for drive-off-support" VALUE 0xa102964b _REC_VAL_20_u1 15.875 _CNV_A_R_LINEAR_____234_CM 6.25e-002 15.9375 DISPLAY_IDENTIFIER C_N_SP_DEC_CS FORMAT "%7.4" /end CHARACTERISTIC
/begin CHARACTERISTIC c_n_sp_lgrd_is_lih "Nominal idle speed change limitation with active limp home" VALUE 0xa1029663 _REC_VAL_20_u1 12.7 _CNV_A_R_LINEAR_____235_CM 0.25 63.75 DISPLAY_IDENTIFIER C_N_SP_LGRD_IS_LIH FORMAT "%5.2" /end CHARACTERISTIC
/begin CHARACTERISTIC c_n_sp_is_sa_eol "Idle speed setpoint during the \"secondary air function end of line test'" VALUE 0xa102965e _REC_VAL_20_u2 8160. _CNV_A_R_LINEAR_____13_CM 0. 8160. DISPLAY_IDENTIFIER C_N_SP_IS_SA_EOL FORMAT "%4.0" /end CHARACTERISTIC
/begin CHARACTERISTIC c_n_sp_lgrd_is "Nominal idle speed change limitation" VALUE 0xa1029662 _REC_VAL_20_u1 3.175 _CNV_A_R_LINEAR_____234_CM 6.25e-002 15.9375 DISPLAY_IDENTIFIER C_N_SP_LGRD_IS FORMAT "%7.4" /end CHARACTERISTIC
/begin MEASUREMENT n_sp_is "resulting idle speed setpoint" UWORD _CNV_A_R_LINEAR_____13_CM 1 100. 0. 8160. DISPLAY_IDENTIFIER N_SP_IS ECU_ADDRESS 0xd0004f54 FORMAT "%4.0" /end MEASUREMENT
/begin CHARACTERISTIC c_dri_vs_min_vb "Minimum vehicle speed for activating battery charging in case LV_DRI = 1" VALUE 0xa1029310 _REC_VAL_20_u1 255. _CNV_A_R_LINEAR_____6_CM 0. 255. DISPLAY_IDENTIFIER C_DRI_VS_MIN_VB FORMAT "%3.0" /end CHARACTERISTIC
/begin CHARACTERISTIC c_vs_max_n_sp_cs "Maximum vehicle speed for drive-off-support" VALUE 0xa1029cb0 _REC_VAL_20_u1 255. _CNV_A_R_LINEAR_____6_CM 0. 255. DISPLAY_IDENTIFIER C_VS_MAX_N_SP_CS FORMAT "%3.0" /end CHARACTERISTIC
/begin CHARACTERISTIC c_vs_hys_n_sp_cs "vehicle speed hysteresis for VS threshold drive off support" VALUE 0xa1029c9c _REC_VAL_20_u1 255. _CNV_A_R_LINEAR_____6_CM 0. 255. DISPLAY_IDENTIFIER C_VS_HYS_N_SP_CS FORMAT "%3.0" /end CHARACTERISTIC
/begin CHARACTERISTIC lc_is_n_sp_cs_dis "LC to switch on/off LV_IS  condition for drive off support" VALUE 0xa1029d6a _REC_VAL_20_u1 1. _CNV_A_R_LINEAR_____0_CM 0. 1. DISPLAY_IDENTIFIER LC_IS_N_SP_CS_DIS FORMAT "%2.0" /end CHARACTERISTIC
/begin CHARACTERISTIC c_n_sp_is_pste_2_at "Idle speed setpoint PSTE_2, automatic transmission vehicle" VALUE 0xa102965a _REC_VAL_20_u2 8160. _CNV_A_R_LINEAR_____13_CM 0. 8160. DISPLAY_IDENTIFIER C_N_SP_IS_PSTE_2_AT FORMAT "%4.0" /end CHARACTERISTIC
/begin CHARACTERISTIC c_n_sp_is_pste_2_mt "Idle speed setpoint PSTE_2, manual  transmission vehicle" VALUE 0xa102965c _REC_VAL_20_u2 8160. _CNV_A_R_LINEAR_____13_CM 0. 8160. DISPLAY_IDENTIFIER C_N_SP_IS_PSTE_2_MT FORMAT "%4.0" /end CHARACTERISTIC
/begin CHARACTERISTIC c_n_sp_is_ars_mt "Idle speed setpoint ARS, manual  transmission vehicle" VALUE 0xa1029658 _REC_VAL_20_u2 8160. _CNV_A_R_LINEAR_____13_CM 0. 8160. DISPLAY_IDENTIFIER C_N_SP_IS_ARS_MT FORMAT "%4.0" /end CHARACTERISTIC
/begin CHARACTERISTIC c_n_sp_is_ars_at "Idle speed setpoint ARS, automatic  transmission vehicle" VALUE 0xa1029656 _REC_VAL_20_u2 8160. _CNV_A_R_LINEAR_____13_CM 0. 8160. DISPLAY_IDENTIFIER C_N_SP_IS_ARS_AT FORMAT "%4.0" /end CHARACTERISTIC
/begin CHARACTERISTIC c_vs_max_n_sp_is_ars "Maximum vehicle speed for  N_SP_IS_ARS" VALUE 0xa1029cb1 _REC_VAL_20_u1 255. _CNV_A_R_LINEAR_____6_CM 0. 255. DISPLAY_IDENTIFIER C_VS_MAX_N_SP_IS_ARS FORMAT "%3.0" /end CHARACTERISTIC
/begin CHARACTERISTIC c_vs_min_n_sp_is_ars "Minimum vehicle speed for  N_SP_IS_ARS" VALUE 0xa1029cbb _REC_VAL_20_u1 255. _CNV_A_R_LINEAR_____6_CM 0. 255. DISPLAY_IDENTIFIER C_VS_MIN_N_SP_IS_ARS FORMAT "%3.0" /end CHARACTERISTIC
/begin MEASUREMENT lv_n_sp_is_cs "1: conditions for increased idle speed / torque reserve for drive-off-support fulfilled" UBYTE _CNV_S_2_RANGE__0___1_CM 1 100. 0. 1. DISPLAY_IDENTIFIER LV_N_SP_IS_CS ECU_ADDRESS 0xd0003b35 BIT_MASK 0x1 /end MEASUREMENT
/begin MEASUREMENT lv_n_sp_is_pste "1: conditions for increased idle speed / torque reserve for power steering" UBYTE _CNV_S_2_RANGE__0___1_CM 1 100. 0. 1. DISPLAY_IDENTIFIER LV_N_SP_IS_PSTE ECU_ADDRESS 0xd0003b36 BIT_MASK 0x1 /end MEASUREMENT
/begin MEASUREMENT lv_n_sp_is_pste_2 "1: conditions for increased idle speed / torque reserve for power steering for second VS threshold" UBYTE _CNV_S_2_RANGE__0___1_CM 1 100. 0. 1. DISPLAY_IDENTIFIER LV_N_SP_IS_PSTE_2 ECU_ADDRESS 0xd0003b37 BIT_MASK 0x1 /end MEASUREMENT
/begin AXIS_PTS ldpm_tco_n_sp_1 "" 0xa10222a0 tco _REC_AXS_20_u1 190.5 _CNV_A_R_LINEAR_____16_CM 8 -48. 142.5 FORMAT "%5.1" /end AXIS_PTS
/begin CHARACTERISTIC ip_dri_n_sp_is "Nominal idle speed with DRIVE  (A/T) engaged" CURVE 0xa1023280 _REC_CUR_20_u2_u1 8160. _CNV_A_R_LINEAR_____13_CM 0. 8160. DISPLAY_IDENTIFIER IP_DRI_N_SP_IS FORMAT "%4.0"
 /begin AXIS_DESCR COM_AXIS tco _CNV_A_R_LINEAR_____16_CM 8 -48. 142.5 FORMAT "%5.1" AXIS_PTS_REF ldpm_tco_n_sp_1 /end AXIS_DESCR
/end CHARACTERISTIC
/begin CHARACTERISTIC ip_n_sp_is_toil_at "Minimum idle speed for TOIL with AT" CURVE 0xa1026548 _REC_CUR_20_u2_u1 8160. _CNV_A_R_LINEAR_____13_CM 0. 8160. DISPLAY_IDENTIFIER IP_N_SP_IS_TOIL_AT FORMAT "%4.0"
 /begin AXIS_DESCR COM_AXIS toil _CNV_A_R_LINEAR_____25_CM 4 -40. 160. FORMAT "%3.0" AXIS_PTS_REF ldpm_toil_n_sp_is_toil /end AXIS_DESCR
/end CHARACTERISTIC
/begin AXIS_PTS ldpm_tco_n_sp_is_pste "" 0xa10222aa tco _REC_AXS_20_u1 190.5 _CNV_A_R_LINEAR_____16_CM 6 -48. 142.5 FORMAT "%6.2" /end AXIS_PTS
/begin AXIS_PTS ldpm_toil_n_sp_is_toil "" 0xa102235e toil _REC_AXS_20_u1 200. _CNV_A_R_LINEAR_____25_CM 4 -40. 160. FORMAT "%3.0" /end AXIS_PTS
/begin CHARACTERISTIC ip_n_sp_is_pste_2 "Idle speed setpoint for power steering for VS >= C_VS_MIN_N_SP_PSTE_2" CURVE 0xa102653c _REC_CUR_20_u2_u1 8160. _CNV_A_R_LINEAR_____13_CM 0. 8160. DISPLAY_IDENTIFIER IP_N_SP_IS_PSTE_2 FORMAT "%4.0"
 /begin AXIS_DESCR COM_AXIS tco _CNV_A_R_LINEAR_____16_CM 6 -48. 142.5 FORMAT "%6.2" AXIS_PTS_REF ldpm_tco_n_sp_is_pste /end AXIS_DESCR
/end CHARACTERISTIC
/begin CHARACTERISTIC ip_n_sp_is_pste "Idle speed setpoint for power steering" CURVE 0xa1026530 _REC_CUR_20_u2_u1 8160. _CNV_A_R_LINEAR_____13_CM 0. 8160. DISPLAY_IDENTIFIER IP_N_SP_IS_PSTE FORMAT "%4.0"
 /begin AXIS_DESCR COM_AXIS tco _CNV_A_R_LINEAR_____16_CM 6 -48. 142.5 FORMAT "%6.2" AXIS_PTS_REF ldpm_tco_n_sp_is_pste /end AXIS_DESCR
/end CHARACTERISTIC
/begin CHARACTERISTIC c_n_sp_ofs_kwp_min "Lower threshold for tester offset" VALUE 0xa1029666 _REC_VAL_20_u2 32767. _CNV_A_R_LINEAR_____236_CM -32768. -1. DISPLAY_IDENTIFIER C_N_SP_OFS_KWP_MIN FORMAT "%6.0" /end CHARACTERISTIC
/begin CHARACTERISTIC c_n_sp_inc_cs "Increment engine speed setpoint for drive-off-support" VALUE 0xa1029652 _REC_VAL_20_u1 15.875 _CNV_A_R_LINEAR_____234_CM 6.25e-002 15.9375 DISPLAY_IDENTIFIER C_N_SP_INC_CS FORMAT "%7.4" /end CHARACTERISTIC
/begin CHARACTERISTIC c_n_sp_inc_pste "Increment engine speed setpoint for power steering" VALUE 0xa1029654 _REC_VAL_20_u1 15.875 _CNV_A_R_LINEAR_____234_CM 6.25e-002 15.9375 DISPLAY_IDENTIFIER C_N_SP_INC_PSTE FORMAT "%7.4" /end CHARACTERISTIC
/begin CHARACTERISTIC c_n_sp_dec_pste "Decrement engine speed setpoint for power steering" VALUE 0xa102964d _REC_VAL_20_u1 15.875 _CNV_A_R_LINEAR_____234_CM 6.25e-002 15.9375 DISPLAY_IDENTIFIER C_N_SP_DEC_PSTE FORMAT "%7.4" /end CHARACTERISTIC
/begin CHARACTERISTIC c_dly_n_sp_dec_pste "Delay time for decrement engine speed setpoint for power steering" VALUE 0xa102930f _REC_VAL_20_u1 24.5 _CNV_A_R_LINEAR_____4_CM 1. 25.5 DISPLAY_IDENTIFIER C_DLY_N_SP_DEC_PSTE FORMAT "%4.1" /end CHARACTERISTIC
/begin CHARACTERISTIC c_vs_min_n_sp_pste "Minimum vehicle speed threshould for N_SP_PSTE" VALUE 0xa1029cbc _REC_VAL_20_u1 255. _CNV_A_R_LINEAR_____6_CM 0. 255. DISPLAY_IDENTIFIER C_VS_MIN_N_SP_PSTE FORMAT "%3.0" /end CHARACTERISTIC
/begin CHARACTERISTIC c_vs_min_n_sp_pste_2 "Minimum vehicle speed threshould for N_SP_PSTE_2" VALUE 0xa1029cbd _REC_VAL_20_u1 255. _CNV_A_R_LINEAR_____6_CM 0. 255. DISPLAY_IDENTIFIER C_VS_MIN_N_SP_PSTE_2 FORMAT "%3.0" /end CHARACTERISTIC
/begin CHARACTERISTIC c_ang_pste_isc "Minimum ANG_PSTE for N_SP_PSTE" VALUE 0xa10291a8 _REC_VAL_20_u2 1439.945815 _CNV_A_R_LINEAR_____80_CM 0. 1439.945815 DISPLAY_IDENTIFIER C_ANG_PSTE_ISC FORMAT "%8.2" /end CHARACTERISTIC
/begin CHARACTERISTIC c_vel_ang_pste_isc "Minimum VEL_ANG_PSTE for N_SP_PSTE" VALUE 0xa1029be8 _REC_VAL_20_u2 1439.945815 _CNV_A_R_LINEAR_____80_CM 0. 1439.945815 DISPLAY_IDENTIFIER C_VEL_ANG_PSTE_ISC FORMAT "%8.2" /end CHARACTERISTIC
/begin CHARACTERISTIC c_n_sp_inc_pl "Increment idle speed setpoint for part load" VALUE 0xa1029653 _REC_VAL_20_u1 15.875 _CNV_A_R_LINEAR_____234_CM 6.25e-002 15.9375 DISPLAY_IDENTIFIER C_N_SP_INC_PL FORMAT "%7.4" /end CHARACTERISTIC
/begin CHARACTERISTIC c_n_sp_dec_pl "Decrement idle speed setpoint for part load" VALUE 0xa102964c _REC_VAL_20_u1 15.875 _CNV_A_R_LINEAR_____234_CM 6.25e-002 15.9375 DISPLAY_IDENTIFIER C_N_SP_DEC_PL FORMAT "%7.4" /end CHARACTERISTIC
/begin CHARACTERISTIC ip_n_sp_is_toil_mt "Minimum idle speed for TOIL with MT" CURVE 0xa1026550 _REC_CUR_20_u2_u1 8160. _CNV_A_R_LINEAR_____13_CM 0. 8160. DISPLAY_IDENTIFIER IP_N_SP_IS_TOIL_MT FORMAT "%4.0"
 /begin AXIS_DESCR COM_AXIS toil _CNV_A_R_LINEAR_____25_CM 4 -40. 160. FORMAT "%3.0" AXIS_PTS_REF ldpm_toil_n_sp_is_toil /end AXIS_DESCR
/end CHARACTERISTIC
/begin CHARACTERISTIC c_toil_thd_n_sp_is "TOIL threshold for idle speed setpoint" VALUE 0xa1029a8a _REC_VAL_20_u1 200. _CNV_A_R_LINEAR_____25_CM -40. 160. DISPLAY_IDENTIFIER C_TOIL_THD_N_SP_IS FORMAT "%3.0" /end CHARACTERISTIC
/begin CHARACTERISTIC c_toil_hys_n_sp_is "TOIL hysteresis for idle speed setpoint" VALUE 0xa1029a82 _REC_VAL_20_u1 200. _CNV_A_R_LINEAR_____25_CM -40. 160. DISPLAY_IDENTIFIER C_TOIL_HYS_N_SP_IS FORMAT "%3.0" /end CHARACTERISTIC
/begin CHARACTERISTIC ip_n_sp_is_knk_at "Minimum idle speed for spark retard due to knocking with AT" CURVE 0xa1026440 _REC_CUR_20_u2_u1 8160. _CNV_A_R_LINEAR_____13_CM 0. 8160. DISPLAY_IDENTIFIER IP_N_SP_IS_KNK_AT FORMAT "%4.0"
 /begin AXIS_DESCR COM_AXIS iga_mv_adj_knk_cus _CNV_A_R_LINEAR_____171_CM 4 -48. 0. FORMAT "%7.3" AXIS_PTS_REF ldpm_iga_n_sp_is_knk /end AXIS_DESCR
/end CHARACTERISTIC
/begin AXIS_PTS ldpm_iga_n_sp_is_knk "" 0xa1021b34 iga_mv_adj_knk_cus _REC_AXS_20_u1 48. _CNV_A_R_LINEAR_____171_CM 4 -48. 0. FORMAT "%7.3" /end AXIS_PTS
/begin CHARACTERISTIC ip_n_sp_is_knk_mt "Minimum idle speed for spark retard due to knocking with MT" CURVE 0xa1026448 _REC_CUR_20_u2_u1 8160. _CNV_A_R_LINEAR_____13_CM 0. 8160. DISPLAY_IDENTIFIER IP_N_SP_IS_KNK_MT FORMAT "%4.0"
 /begin AXIS_DESCR COM_AXIS iga_mv_adj_knk_cus _CNV_A_R_LINEAR_____171_CM 4 -48. 0. FORMAT "%7.3" AXIS_PTS_REF ldpm_iga_n_sp_is_knk /end AXIS_DESCR
/end CHARACTERISTIC
/begin CHARACTERISTIC c_iga_adj_thd_n_sp_is "Spark retard threshold for activating idle speed setpoint N_SP_IS_KNK" VALUE 0xa10294a0 _REC_VAL_20_u1 9.6 _CNV_A_R_LINEAR_____171_CM -48. 0. DISPLAY_IDENTIFIER C_IGA_ADJ_THD_N_SP_IS FORMAT "%7.3" /end CHARACTERISTIC
/begin CHARACTERISTIC c_iga_adj_hys_n_sp_is "Spark retard hystersis for idle speed setpoint N_SP_IS_KNK" VALUE 0xa102949f _REC_VAL_20_u1 9.6 _CNV_A_R_LINEAR_____171_CM -48. 0. DISPLAY_IDENTIFIER C_IGA_ADJ_HYS_N_SP_IS FORMAT "%7.3" /end CHARACTERISTIC
/begin CHARACTERISTIC ip_n_sp_is_cs_opm_1 "Idle speed setpoint for drive-off-support - manual transmission in operation mode 1" CURVE 0xa1026428 _REC_CUR_20_u2_u1 8160. _CNV_A_R_LINEAR_____13_CM 0. 8160. DISPLAY_IDENTIFIER IP_N_SP_IS_CS_OPM_1 FORMAT "%4.0"
 /begin AXIS_DESCR COM_AXIS toil _CNV_A_R_LINEAR_____25_CM 8 -40. 160. FORMAT "%3.0" AXIS_PTS_REF ldp_toil_ip_n_sp_is_cs_opm_1 /end AXIS_DESCR
/end CHARACTERISTIC
/begin CHARACTERISTIC ip_n_sp_is_cs_opm_2 "Idle speed setpoint for drive-off-support - manual transmission in operation mode 2" CURVE 0xa1026438 _REC_CUR_20_u2_u1 8160. _CNV_A_R_LINEAR_____13_CM 0. 8160. DISPLAY_IDENTIFIER IP_N_SP_IS_CS_OPM_2 FORMAT "%4.0"
 /begin AXIS_DESCR COM_AXIS toil _CNV_A_R_LINEAR_____25_CM 4 -40. 160. FORMAT "%3.0" AXIS_PTS_REF ldp_toil_ip_n_sp_is_cs_opm_2 /end AXIS_DESCR
/end CHARACTERISTIC
/begin AXIS_PTS ldp_toil_ip_n_sp_is_cs_opm_1 "" 0xa1021410 toil _REC_AXS_20_u1 200. _CNV_A_R_LINEAR_____25_CM 8 -40. 160. FORMAT "%3.0" /end AXIS_PTS
/begin AXIS_PTS ldp_toil_ip_n_sp_is_cs_opm_2 "" 0xa102141a toil _REC_AXS_20_u1 200. _CNV_A_R_LINEAR_____25_CM 4 -40. 160. FORMAT "%3.0" /end AXIS_PTS
/begin CHARACTERISTIC ip_n_sp_is_pl_opm_1 "Nominal idle speed at part load in operation mode 1" MAP 0xa10264c8 _REC_MAP_20_u2_u2_u2 8160. _CNV_A_R_LINEAR_____13_CM 0. 8160. DISPLAY_IDENTIFIER IP_N_SP_IS_PL_OPM_1 FORMAT "%4.0"
 /begin AXIS_DESCR COM_AXIS n _CNV_A_R_LINEAR_____13_CM 6 0. 8160. FORMAT "%4.0" AXIS_PTS_REF ldp_n_n_sp_is_pl_opm_1 /end AXIS_DESCR
 /begin AXIS_DESCR COM_AXIS tq_loss _CNV_A_R_LINEAR_____65_CM 6 -1024. 1023.96875 FORMAT "%6.2" AXIS_PTS_REF ldp_tq_loss_n_sp_is_pl_opm_1 /end AXIS_DESCR
/end CHARACTERISTIC
/begin CHARACTERISTIC ip_n_sp_is_pl_opm_2 "Nominal idle speed at part load in operation mode 2" MAP 0xa1026510 _REC_MAP_20_u2_u2_u2 8160. _CNV_A_R_LINEAR_____13_CM 0. 8160. DISPLAY_IDENTIFIER IP_N_SP_IS_PL_OPM_2 FORMAT "%4.0"
 /begin AXIS_DESCR COM_AXIS n _CNV_A_R_LINEAR_____13_CM 4 0. 8160. FORMAT "%4.0" AXIS_PTS_REF ldp_n_n_sp_is_pl_opm_2 /end AXIS_DESCR
 /begin AXIS_DESCR COM_AXIS tq_loss _CNV_A_R_LINEAR_____65_CM 4 -1024. 1023.96875 FORMAT "%6.2" AXIS_PTS_REF ldp_tq_loss_n_sp_is_pl_opm_2 /end AXIS_DESCR
/end CHARACTERISTIC
/begin CHARACTERISTIC ip_n_sp_is_pl_amt_opm_1 "Nominal idle speed at PL variant AMT in operation mode 1" MAP 0xa1026460 _REC_MAP_20_u2_u2_u2 8160. _CNV_A_R_LINEAR_____13_CM 0. 8160. DISPLAY_IDENTIFIER IP_N_SP_IS_PL_AMT_OPM_1 FORMAT "%4.0"
 /begin AXIS_DESCR COM_AXIS n _CNV_A_R_LINEAR_____13_CM 6 0. 8160. FORMAT "%4.0" AXIS_PTS_REF ldp_n_n_sp_is_pl_amt_opm_1 /end AXIS_DESCR
 /begin AXIS_DESCR COM_AXIS tq_loss _CNV_A_R_LINEAR_____65_CM 6 -1024. 1023.96875 FORMAT "%6.2" AXIS_PTS_REF ldp_tq_loss_n_sp_is_pl_amt_opm_1 /end AXIS_DESCR
/end CHARACTERISTIC
/begin CHARACTERISTIC ip_n_sp_is_pl_amt_opm_2 "Nominal idle speed at PL variant AMT in operation mode 2" MAP 0xa10264a8 _REC_MAP_20_u2_u2_u2 8160. _CNV_A_R_LINEAR_____13_CM 0. 8160. DISPLAY_IDENTIFIER IP_N_SP_IS_PL_AMT_OPM_2 FORMAT "%4.0"
 /begin AXIS_DESCR COM_AXIS n _CNV_A_R_LINEAR_____13_CM 4 0. 8160. FORMAT "%4.0" AXIS_PTS_REF ldp_n_n_sp_is_pl_amt_opm_2 /end AXIS_DESCR
 /begin AXIS_DESCR COM_AXIS tq_loss _CNV_A_R_LINEAR_____65_CM 4 -1024. 1023.96875 FORMAT "%6.2" AXIS_PTS_REF ldp_tq_loss_n_sp_is_pl_amt_opm_2 /end AXIS_DESCR
/end CHARACTERISTIC
/begin AXIS_PTS ldp_n_n_sp_is_pl_opm_1 "" 0xa1020fcc n _REC_AXS_20_u2 8160. _CNV_A_R_LINEAR_____13_CM 6 0. 8160. FORMAT "%4.0" /end AXIS_PTS
/begin AXIS_PTS ldp_n_n_sp_is_pl_opm_2 "" 0xa1020fdc n _REC_AXS_20_u2 8160. _CNV_A_R_LINEAR_____13_CM 4 0. 8160. FORMAT "%4.0" /end AXIS_PTS
/begin AXIS_PTS ldp_n_n_sp_is_pl_amt_opm_1 "" 0xa1020fb0 n _REC_AXS_20_u2 8160. _CNV_A_R_LINEAR_____13_CM 6 0. 8160. FORMAT "%4.0" /end AXIS_PTS
/begin AXIS_PTS ldp_n_n_sp_is_pl_amt_opm_2 "" 0xa1020fc0 n _REC_AXS_20_u2 8160. _CNV_A_R_LINEAR_____13_CM 4 0. 8160. FORMAT "%4.0" /end AXIS_PTS
/begin AXIS_PTS ldp_tq_loss_n_sp_is_pl_opm_1 "" 0xa1021594 tq_loss _REC_AXS_20_u2 2047.96875 _CNV_A_R_LINEAR_____65_CM 6 -1024. 1023.96875 FORMAT "%6.2" /end AXIS_PTS
/begin AXIS_PTS ldp_tq_loss_n_sp_is_pl_opm_2 "" 0xa10215a4 tq_loss _REC_AXS_20_u2 2047.96875 _CNV_A_R_LINEAR_____65_CM 4 -1024. 1023.96875 FORMAT "%6.2" /end AXIS_PTS
/begin AXIS_PTS ldp_tq_loss_n_sp_is_pl_amt_opm_1 "" 0xa1021578 tq_loss _REC_AXS_20_u2 2047.96875 _CNV_A_R_LINEAR_____65_CM 6 -1024. 1023.96875 FORMAT "%6.2" /end AXIS_PTS
/begin AXIS_PTS ldp_tq_loss_n_sp_is_pl_amt_opm_2 "" 0xa1021588 tq_loss _REC_AXS_20_u2 2047.96875 _CNV_A_R_LINEAR_____65_CM 4 -1024. 1023.96875 FORMAT "%6.2" /end AXIS_PTS
/begin CHARACTERISTIC c_n_ofs_acc_dri_min "idle speed setpoint offset minimum threshold at LV_ACIN = 1 and LV_DRI = 1" VALUE 0xa102963b _REC_VAL_20_s1 510. _CNV_A_R_LINEAR_____237_CM -256. 254. DISPLAY_IDENTIFIER C_N_OFS_ACC_DRI_MIN FORMAT "%4.0" /end CHARACTERISTIC
/begin CHARACTERISTIC c_n_ofs_dri_max "idle speed setpoint offset maximum threshold at LV_ACIN = 0 and LV_DRI = 1" VALUE 0xa102963e _REC_VAL_20_s1 510. _CNV_A_R_LINEAR_____237_CM -256. 254. DISPLAY_IDENTIFIER C_N_OFS_DRI_MAX FORMAT "%4.0" /end CHARACTERISTIC
/begin CHARACTERISTIC c_n_ofs_dri_min "idle speed setpoint offset minimum threshold at LV_ACIN = 0 and LV_DRI = 1" VALUE 0xa102963f _REC_VAL_20_s1 510. _CNV_A_R_LINEAR_____237_CM -256. 254. DISPLAY_IDENTIFIER C_N_OFS_DRI_MIN FORMAT "%4.0" /end CHARACTERISTIC
/begin CHARACTERISTIC c_n_ofs_max "idle speed setpoint offset maximum threshold at LV_ACIN = 0 and LV_DRI = 0" VALUE 0xa1029640 _REC_VAL_20_s1 510. _CNV_A_R_LINEAR_____237_CM -256. 254. DISPLAY_IDENTIFIER C_N_OFS_MAX FORMAT "%4.0" /end CHARACTERISTIC
/begin CHARACTERISTIC c_n_ofs_min "idle speed setpoint offset minimum threshold at LV_ACIN = 0 and LV_DRI = 0" VALUE 0xa1029641 _REC_VAL_20_s1 510. _CNV_A_R_LINEAR_____237_CM -256. 254. DISPLAY_IDENTIFIER C_N_OFS_MIN FORMAT "%4.0" /end CHARACTERISTIC
/begin CHARACTERISTIC c_n_ofs_acc_max "idle speed setpoint offset maximum threshold at LV_ACIN = 1 and LV_DRI = 0" VALUE 0xa102963c _REC_VAL_20_s1 510. _CNV_A_R_LINEAR_____237_CM -256. 254. DISPLAY_IDENTIFIER C_N_OFS_ACC_MAX FORMAT "%4.0" /end CHARACTERISTIC
/begin CHARACTERISTIC c_n_ofs_acc_min "idle speed setpoint offset minimum threshold at LV_ACIN = 1 and LV_DRI = 0" VALUE 0xa102963d _REC_VAL_20_s1 510. _CNV_A_R_LINEAR_____237_CM -256. 254. DISPLAY_IDENTIFIER C_N_OFS_ACC_MIN FORMAT "%4.0" /end CHARACTERISTIC
/begin CHARACTERISTIC c_n_ofs_vb_max "idle speed setpoint offset maximum threshold at battery charging is active" VALUE 0xa1029642 _REC_VAL_20_s1 510. _CNV_A_R_LINEAR_____237_CM -256. 254. DISPLAY_IDENTIFIER C_N_OFS_VB_MAX FORMAT "%4.0" /end CHARACTERISTIC
/begin MEASUREMENT n_kwp_ofs_acc "idle speed setpoint offset at LV_ACIN = 1 and LV_DRI = 0" SBYTE _CNV_A_R_LINEAR_____237_CM 1 100. -256. 254. DISPLAY_IDENTIFIER N_KWP_OFS_ACC ECU_ADDRESS 0xd0003f60 FORMAT "%4.0" /end MEASUREMENT
/begin MEASUREMENT n_kwp_ofs "idle speed setpoint offset at LV_ACIN = 0 and LV_DRI = 0" SBYTE _CNV_A_R_LINEAR_____237_CM 1 100. -256. 254. DISPLAY_IDENTIFIER N_KWP_OFS ECU_ADDRESS 0xd0003f5f FORMAT "%4.0" /end MEASUREMENT
/begin MEASUREMENT n_kwp_ofs_vb_nvmy "idle speed setpoint offset at battery charging is active stored in non volatile memory" SBYTE _CNV_A_R_LINEAR_____237_CM 1 100. -256. 254. DISPLAY_IDENTIFIER N_KWP_OFS_VB_NVMY ECU_ADDRESS 0xd0003f5c FORMAT "%4.0" /end MEASUREMENT
/begin MEASUREMENT n_kwp_ofs_acc_nvmy "idle speed setpoint offset at LV_ACIN = 1 and LV_DRI = 0 stored in non volatile memory" SBYTE _CNV_A_R_LINEAR_____237_CM 1 100. -256. 254. DISPLAY_IDENTIFIER N_KWP_OFS_ACC_NVMY ECU_ADDRESS 0xd0003f5b FORMAT "%4.0" /end MEASUREMENT
/begin MEASUREMENT n_kwp_ofs_nvmy "idle speed setpoint offset at LV_ACIN = 0 and LV_DRI = 0 stored in non volatile memory" SBYTE _CNV_A_R_LINEAR_____237_CM 1 100. -256. 254. DISPLAY_IDENTIFIER N_KWP_OFS_NVMY ECU_ADDRESS 0xd0003f5a FORMAT "%4.0" /end MEASUREMENT
/begin MEASUREMENT n_kwp_ofs_dri_nvmy "idle speed setpoint offset at LV_ACIN = 0 and LV_DRI = 1 stored in non volatile memory" SBYTE _CNV_A_R_LINEAR_____237_CM 1 100. -256. 254. DISPLAY_IDENTIFIER N_KWP_OFS_DRI_NVMY ECU_ADDRESS 0xd0003f59 FORMAT "%4.0" /end MEASUREMENT
/begin MEASUREMENT n_kwp_ofs_acc_dri_nvmy "idle speed setpoint offset at LV_ACIN = 1 and LV_DRI = 1 stored in non volatile memory" SBYTE _CNV_A_R_LINEAR_____237_CM 1 100. -256. 254. DISPLAY_IDENTIFIER N_KWP_OFS_ACC_DRI_NVMY ECU_ADDRESS 0xd0003f58 FORMAT "%4.0" /end MEASUREMENT
/begin CHARACTERISTIC c_n_ofs_vb_min "idle speed setpoint offset minimum threshold at battery charging is active" VALUE 0xa1029643 _REC_VAL_20_s1 510. _CNV_A_R_LINEAR_____237_CM -256. 254. DISPLAY_IDENTIFIER C_N_OFS_VB_MIN FORMAT "%4.0" /end CHARACTERISTIC
/begin CHARACTERISTIC c_tco_min_n_ofs_kwp "minimum TCO threshold for idle speed setpoint offset by tester" VALUE 0xa10299e5 _REC_VAL_20_u1 190.5 _CNV_A_R_LINEAR_____16_CM -48. 142.5 DISPLAY_IDENTIFIER C_TCO_MIN_N_OFS_KWP FORMAT "%5.1" /end CHARACTERISTIC
/begin CHARACTERISTIC lc_n_ofs_kwp_disable "disable bit for idle speed setpoint offset by tester" VALUE 0xa1029d81 _REC_VAL_20_u1 1. _CNV_A_R_LINEAR_____0_CM 0. 1. DISPLAY_IDENTIFIER LC_N_OFS_KWP_DISABLE FORMAT "%2.0" /end CHARACTERISTIC
/begin CHARACTERISTIC c_cha_cdn_bat_kwp_min "minimum threshold for active battery charging due to enable conditions of idle speed offset by tester" VALUE 0xa10291b3 _REC_VAL_20_u1 127. _CNV_A_R_LINEAR_____238_CM 0. 127. DISPLAY_IDENTIFIER C_CHA_CDN_BAT_KWP_MIN FORMAT "%5.1" /end CHARACTERISTIC
/begin CHARACTERISTIC c_n_ofs_acc_dri_max "idle speed setpoint offset maximum threshold at LV_ACIN = 1 and LV_DRI = 1" VALUE 0xa102963a _REC_VAL_20_s1 510. _CNV_A_R_LINEAR_____237_CM -256. 254. DISPLAY_IDENTIFIER C_N_OFS_ACC_DRI_MAX FORMAT "%4.0" /end CHARACTERISTIC
/begin MEASUREMENT lv_kwp_ena "logical variable for idle speed setpoint offset by tester enabled" UBYTE _CNV_S_2_RANGE__0___1_CM 1 100. 0. 1. DISPLAY_IDENTIFIER LV_KWP_ENA ECU_ADDRESS 0xd0003f63 BIT_MASK 0x1 /end MEASUREMENT
/begin MEASUREMENT n_sp_ofs_kwp "idle speed setpoint offset by tester" SBYTE _CNV_A_R_LINEAR_____237_CM 1 100. -256. 254. DISPLAY_IDENTIFIER N_SP_OFS_KWP ECU_ADDRESS 0xd0003f62 FORMAT "%4.0" /end MEASUREMENT
/begin MEASUREMENT n_kwp_ofs_acc_dri "idle speed setpoint offset at LV_ACIN = 1 and LV_DRI = 1" SBYTE _CNV_A_R_LINEAR_____237_CM 1 100. -256. 254. DISPLAY_IDENTIFIER N_KWP_OFS_ACC_DRI ECU_ADDRESS 0xd0003f5d FORMAT "%4.0" /end MEASUREMENT
/begin MEASUREMENT n_kwp_ofs_dri "idle speed setpoint offset at LV_ACIN = 0 and LV_DRI = 1" SBYTE _CNV_A_R_LINEAR_____237_CM 1 100. -256. 254. DISPLAY_IDENTIFIER N_KWP_OFS_DRI ECU_ADDRESS 0xd0003f5e FORMAT "%4.0" /end MEASUREMENT
/begin MEASUREMENT n_kwp_ofs_vb "idle speed setpoint offset at battery charging is active" SBYTE _CNV_A_R_LINEAR_____237_CM 1 100. -256. 254. DISPLAY_IDENTIFIER N_KWP_OFS_VB ECU_ADDRESS 0xd0003f61 FORMAT "%4.0" /end MEASUREMENT
/begin MEASUREMENT lv_act_n_sp_is_bas_ext_adj "switch off idle speed uplift - function active = 1" UBYTE _CNV_S_2_RANGE__0___1_CM 1 100. 0. 1. DISPLAY_IDENTIFIER LV_ACT_N_SP_IS_BAS_EXT_ADJ ECU_ADDRESS 0xd0003f64 BIT_MASK 0x1 /end MEASUREMENT
/begin AXIS_PTS ldpm_gear "" 0xa1021acc gear _REC_AXS_20_u1 255. _CNV_A_R_LINEAR_____0_CM 9 0. 255. FORMAT "%3.0" /end AXIS_PTS
/begin MEASUREMENT n_max_thd_1 "Actual engine speed limit depending on TCO-orange area (BN2000)" UWORD _CNV_A_R_LINEAR_____13_CM 1 100. 0. 8160. DISPLAY_IDENTIFIER N_MAX_THD_1 ECU_ADDRESS 0xd0004f6a FORMAT "%4.0" /end MEASUREMENT
/begin MEASUREMENT n_max_thd_2 "Actual engine speed limit depending on TCO-red area (BN2000)" UWORD _CNV_A_R_LINEAR_____13_CM 1 100. 0. 8160. DISPLAY_IDENTIFIER N_MAX_THD_2 ECU_ADDRESS 0xd0004f6c FORMAT "%4.0" /end MEASUREMENT
/begin MEASUREMENT lv_vs_max "Boolean for vehicle speed limitation active" UBYTE _CNV_S_2_RANGE__0___1_CM 1 100. 0. 1. DISPLAY_IDENTIFIER LV_VS_MAX ECU_ADDRESS 0xd0003b3c BIT_MASK 0x1 /end MEASUREMENT
/begin MEASUREMENT vs_ratio "Ratio between vehicle speed limit and actual vehicle speed" UWORD _CNV_A_R_LINEAR_____243_CM 1 100. 0. 31.99951171875 DISPLAY_IDENTIFIER VS_RATIO ECU_ADDRESS 0xc00009ae FORMAT "%7.4" /end MEASUREMENT
/begin CHARACTERISTIC ip_n_max_mtc_cur_off__pv_av "Engine speed limit for limp home modus due MTC error" CURVE 0xa1026358 _REC_CUR_20_u2_u1 8160. _CNV_A_R_LINEAR_____13_CM 0. 8160. DISPLAY_IDENTIFIER IP_N_MAX_MTC_CUR_OFF__PV_AV FORMAT "%4.0"
 /begin AXIS_DESCR COM_AXIS pv_av _CNV_A_R_LINEAR_____5_CM 4 0. 99.609375 FORMAT "%5.2" AXIS_PTS_REF ldp_pv_av__n_max_mtc_cur_off /end AXIS_DESCR
/end CHARACTERISTIC
/begin CHARACTERISTIC c_n_max_mtc_lih "Engine speed limitation in case of fault detected by throttle monitoring or ETC safety concept" VALUE 0xa102962a _REC_VAL_20_u2 8160. _CNV_A_R_LINEAR_____13_CM 0. 8160. DISPLAY_IDENTIFIER C_N_MAX_MTC_LIH FORMAT "%4.0" /end CHARACTERISTIC
/begin CHARACTERISTIC c_n_max_thd_min "Minimum allowed engine speed threshold" VALUE 0xa102962c _REC_VAL_20_u2 8160. _CNV_A_R_LINEAR_____13_CM 0. 8160. DISPLAY_IDENTIFIER C_N_MAX_THD_MIN FORMAT "%4.0" /end CHARACTERISTIC
/begin MEASUREMENT n_max_vs_max "Engine speed limit in case of vehicle speed limitation" UWORD _CNV_A_R_LINEAR_____13_CM 1 100. 0. 8160. DISPLAY_IDENTIFIER N_MAX_VS_MAX ECU_ADDRESS 0xc00009ac FORMAT "%4.0" /end MEASUREMENT
/begin CHARACTERISTIC c_vs_max_amt "Vehicle speed limitation threshold - SSG" VALUE 0xa1029ca3 _REC_VAL_20_u1 255. _CNV_A_R_LINEAR_____6_CM 0. 255. DISPLAY_IDENTIFIER C_VS_MAX_AMT FORMAT "%3.0" /end CHARACTERISTIC
/begin CHARACTERISTIC c_n_max_amt_add "offset for engine speed limit during gear shift phase 1 and 2" VALUE 0xa102960c _REC_VAL_20_u2 979.2000000000001 _CNV_A_R_LINEAR_____13_CM 0. 8160. DISPLAY_IDENTIFIER C_N_MAX_AMT_ADD FORMAT "%4.0" /end CHARACTERISTIC
/begin CHARACTERISTIC c_n_max_amt_gp "engine speed limit in case of SSG-error (gear protection active, LV_GP=1)" VALUE 0xa102960e _REC_VAL_20_u2 979.2000000000001 _CNV_A_R_LINEAR_____13_CM 0. 8160. DISPLAY_IDENTIFIER C_N_MAX_AMT_GP FORMAT "%4.0" /end CHARACTERISTIC
/begin AXIS_PTS ldp_pv_av__n_max_mtc_cur_off "" 0xa102114e pv_av _REC_AXS_20_u1 99.609375 _CNV_A_R_LINEAR_____5_CM 4 0. 99.609375 FORMAT "%5.2" /end AXIS_PTS
/begin CHARACTERISTIC id_n_max_mt "Basic Engine speed limit MT-Vehicle" CURVE 0xa1022e74 _REC_CUR_20_u2_u1 8160. _CNV_A_R_LINEAR_____13_CM 0. 8160. DISPLAY_IDENTIFIER ID_N_MAX_MT FORMAT "%4.0"
 /begin AXIS_DESCR COM_AXIS gear _CNV_A_R_LINEAR_____0_CM 9 0. 255. FORMAT "%3.0" AXIS_PTS_REF ldpm_gear /end AXIS_DESCR
/end CHARACTERISTIC
/begin CHARACTERISTIC id_n_max_amt "Basic Engine speed limit AMT-Vehicle" CURVE 0xa1022e10 _REC_CUR_20_u2_u1 8160. _CNV_A_R_LINEAR_____13_CM 0. 8160. DISPLAY_IDENTIFIER ID_N_MAX_AMT FORMAT "%4.0"
 /begin AXIS_DESCR COM_AXIS gear _CNV_A_R_LINEAR_____0_CM 9 0. 255. FORMAT "%3.0" AXIS_PTS_REF ldpm_gear /end AXIS_DESCR
/end CHARACTERISTIC
/begin CHARACTERISTIC id_n_max_at "Basic Engine speed limit AT-Vehicle" CURVE 0xa1022e24 _REC_CUR_20_u2_u1 8160. _CNV_A_R_LINEAR_____13_CM 0. 8160. DISPLAY_IDENTIFIER ID_N_MAX_AT FORMAT "%4.0"
 /begin AXIS_DESCR COM_AXIS gear _CNV_A_R_LINEAR_____0_CM 9 0. 255. FORMAT "%3.0" AXIS_PTS_REF ldpm_gear /end AXIS_DESCR
/end CHARACTERISTIC
/begin CHARACTERISTIC id_n_max_h_mt "Increased engine speed limit MT-vehicle" CURVE 0xa1022e60 _REC_CUR_20_u2_u1 8160. _CNV_A_R_LINEAR_____13_CM 0. 8160. DISPLAY_IDENTIFIER ID_N_MAX_H_MT FORMAT "%4.0"
 /begin AXIS_DESCR COM_AXIS gear _CNV_A_R_LINEAR_____0_CM 9 0. 255. FORMAT "%3.0" AXIS_PTS_REF ldpm_gear /end AXIS_DESCR
/end CHARACTERISTIC
/begin CHARACTERISTIC id_n_max_h_amt "Increased engine speed limit AMT-vehicle" CURVE 0xa1022e38 _REC_CUR_20_u2_u1 8160. _CNV_A_R_LINEAR_____13_CM 0. 8160. DISPLAY_IDENTIFIER ID_N_MAX_H_AMT FORMAT "%4.0"
 /begin AXIS_DESCR COM_AXIS gear _CNV_A_R_LINEAR_____0_CM 9 0. 255. FORMAT "%3.0" AXIS_PTS_REF ldpm_gear /end AXIS_DESCR
/end CHARACTERISTIC
/begin CHARACTERISTIC id_n_max_h_at "Increased engine speed limit AT-vehicle" CURVE 0xa1022e4c _REC_CUR_20_u2_u1 8160. _CNV_A_R_LINEAR_____13_CM 0. 8160. DISPLAY_IDENTIFIER ID_N_MAX_H_AT FORMAT "%4.0"
 /begin AXIS_DESCR COM_AXIS gear _CNV_A_R_LINEAR_____0_CM 9 0. 255. FORMAT "%3.0" AXIS_PTS_REF ldpm_gear /end AXIS_DESCR
/end CHARACTERISTIC
/begin CHARACTERISTIC id_t_n_max_h_amt "Time for increased engine speed limit,AMT vehicle" CURVE 0xa1022f40 _REC_CUR_20_u2_u1 6553.5 _CNV_A_R_LINEAR_____4_CM 0. 6553.5 DISPLAY_IDENTIFIER ID_T_N_MAX_H_AMT FORMAT "%5.1"
 /begin AXIS_DESCR COM_AXIS gear _CNV_A_R_LINEAR_____0_CM 9 0. 255. FORMAT "%3.0" AXIS_PTS_REF ldpm_gear /end AXIS_DESCR
/end CHARACTERISTIC
/begin CHARACTERISTIC id_t_n_max_h_mt "Time for increased engine speed limit, MT vehicle" CURVE 0xa1022f68 _REC_CUR_20_u2_u1 6553.5 _CNV_A_R_LINEAR_____4_CM 0. 6553.5 DISPLAY_IDENTIFIER ID_T_N_MAX_H_MT FORMAT "%5.1"
 /begin AXIS_DESCR COM_AXIS gear _CNV_A_R_LINEAR_____0_CM 9 0. 255. FORMAT "%3.0" AXIS_PTS_REF ldpm_gear /end AXIS_DESCR
/end CHARACTERISTIC
/begin CHARACTERISTIC id_t_n_max_h_at "Time for increased engine speed limit, AT vehicle" CURVE 0xa1022f54 _REC_CUR_20_u2_u1 6553.5 _CNV_A_R_LINEAR_____4_CM 0. 6553.5 DISPLAY_IDENTIFIER ID_T_N_MAX_H_AT FORMAT "%5.1"
 /begin AXIS_DESCR COM_AXIS gear _CNV_A_R_LINEAR_____0_CM 9 0. 255. FORMAT "%3.0" AXIS_PTS_REF ldpm_gear /end AXIS_DESCR
/end CHARACTERISTIC
/begin CHARACTERISTIC id_n_dec_n_max_h_mt "Stepwidth to basic engine speed limit, MT vehicle" CURVE 0xa1022d94 _REC_CUR_20_u2_u1 8160. _CNV_A_R_LINEAR_____13_CM 0. 8160. DISPLAY_IDENTIFIER ID_N_DEC_N_MAX_H_MT FORMAT "%4.0"
 /begin AXIS_DESCR COM_AXIS gear _CNV_A_R_LINEAR_____0_CM 9 0. 255. FORMAT "%3.0" AXIS_PTS_REF ldpm_gear /end AXIS_DESCR
/end CHARACTERISTIC
/begin CHARACTERISTIC id_n_dec_n_max_h_amt "Stepwidth to basic engine speed limit, AMT vehicle" CURVE 0xa1022d6c _REC_CUR_20_u2_u1 8160. _CNV_A_R_LINEAR_____13_CM 0. 8160. DISPLAY_IDENTIFIER ID_N_DEC_N_MAX_H_AMT FORMAT "%4.0"
 /begin AXIS_DESCR COM_AXIS gear _CNV_A_R_LINEAR_____0_CM 9 0. 255. FORMAT "%3.0" AXIS_PTS_REF ldpm_gear /end AXIS_DESCR
/end CHARACTERISTIC
/begin CHARACTERISTIC id_n_dec_n_max_h_at "Stepwidth to basic engine speed limit, AT vehicle" CURVE 0xa1022d80 _REC_CUR_20_u2_u1 8160. _CNV_A_R_LINEAR_____13_CM 0. 8160. DISPLAY_IDENTIFIER ID_N_DEC_N_MAX_H_AT FORMAT "%4.0"
 /begin AXIS_DESCR COM_AXIS gear _CNV_A_R_LINEAR_____0_CM 9 0. 255. FORMAT "%3.0" AXIS_PTS_REF ldpm_gear /end AXIS_DESCR
/end CHARACTERISTIC
/begin CHARACTERISTIC c_n_max_dri_rvl "Engine speed limit AT-vehicle in reverse gear" VALUE 0xa1029616 _REC_VAL_20_u2 8160. _CNV_A_R_LINEAR_____13_CM 0. 8160. DISPLAY_IDENTIFIER C_N_MAX_DRI_RVL FORMAT "%4.0" /end CHARACTERISTIC
/begin CHARACTERISTIC c_vs_thd_n_max_h_mt "VS threshold for increased engine speed limit, MT vehicle" VALUE 0xa1029cda _REC_VAL_20_u1 255. _CNV_A_R_LINEAR_____6_CM 0. 255. DISPLAY_IDENTIFIER C_VS_THD_N_MAX_H_MT FORMAT "%3.0" /end CHARACTERISTIC
/begin CHARACTERISTIC c_vs_thd_n_max_h_amt "VS threshold for increased engine speed limit, AMT vehicle" VALUE 0xa1029cd8 _REC_VAL_20_u1 255. _CNV_A_R_LINEAR_____6_CM 0. 255. DISPLAY_IDENTIFIER C_VS_THD_N_MAX_H_AMT FORMAT "%3.0" /end CHARACTERISTIC
/begin CHARACTERISTIC c_vs_thd_n_max_h_at "VS threshold for increased engine speed limit, AT vehicle" VALUE 0xa1029cd9 _REC_VAL_20_u1 255. _CNV_A_R_LINEAR_____6_CM 0. 255. DISPLAY_IDENTIFIER C_VS_THD_N_MAX_H_AT FORMAT "%3.0" /end CHARACTERISTIC
/begin CHARACTERISTIC c_t_max_n_max_h_amt "Maximum time after exceeding the VS threshold, AMT vehicle" VALUE 0xa10298c5 _REC_VAL_20_u1 25.5 _CNV_A_R_LINEAR_____4_CM 0. 25.5 DISPLAY_IDENTIFIER C_T_MAX_N_MAX_H_AMT FORMAT "%4.1" /end CHARACTERISTIC
/begin CHARACTERISTIC c_t_max_n_max_h_at "Maximum time after exceeding the VS threshold, AT vehicle" VALUE 0xa10298c6 _REC_VAL_20_u1 25.5 _CNV_A_R_LINEAR_____4_CM 0. 25.5 DISPLAY_IDENTIFIER C_T_MAX_N_MAX_H_AT FORMAT "%4.1" /end CHARACTERISTIC
/begin MEASUREMENT lv_n_max_h "Boolean for Increased Engine speed limitation active" UBYTE _CNV_S_2_RANGE__0___1_CM 1 100. 0. 1. DISPLAY_IDENTIFIER LV_N_MAX_H ECU_ADDRESS 0xc00009be BIT_MASK 0x1 /end MEASUREMENT
/begin MEASUREMENT lv_n_max_etc_lih "Engine speed limitation active" UBYTE _CNV_S_2_RANGE__0___1_CM 1 100. 0. 1. DISPLAY_IDENTIFIER LV_N_MAX_ETC_LIH ECU_ADDRESS 0xd0003b3d BIT_MASK 0x1 /end MEASUREMENT
/begin MEASUREMENT n_max_thd "Actual engine speed limit" UWORD _CNV_A_R_LINEAR_____13_CM 1 100. 0. 8160. DISPLAY_IDENTIFIER N_MAX_THD ECU_ADDRESS 0xd0004f68 FORMAT "%4.0" /end MEASUREMENT
/begin MEASUREMENT t_gear_vs_max "Time since the last gear shift." UBYTE _CNV_A_R_LINEAR_____4_CM 1 100. 0. 25.5 DISPLAY_IDENTIFIER T_GEAR_VS_MAX ECU_ADDRESS 0xc00009b8 FORMAT "%4.1" /end MEASUREMENT
/begin CHARACTERISTIC c_t_max_n_max_h_mt "Maximum time after exceeding the VS threshold, MT vehicle" VALUE 0xa10298c7 _REC_VAL_20_u1 25.5 _CNV_A_R_LINEAR_____4_CM 0. 25.5 DISPLAY_IDENTIFIER C_T_MAX_N_MAX_H_MT FORMAT "%4.1" /end CHARACTERISTIC
/begin CHARACTERISTIC c_t_gear_vs_max_at "Time for calculating N_MAX_VS_MAX after a gear shift with AT." VALUE 0xa10298a8 _REC_VAL_20_u1 25.5 _CNV_A_R_LINEAR_____4_CM 0. 25.5 DISPLAY_IDENTIFIER C_T_GEAR_VS_MAX_AT FORMAT "%4.1" /end CHARACTERISTIC
/begin CHARACTERISTIC c_t_gear_vs_max_mt "Time for calculating N_MAX_VS_MAX after a gear shift with MT." VALUE 0xa10298a9 _REC_VAL_20_u1 25.5 _CNV_A_R_LINEAR_____4_CM 0. 25.5 DISPLAY_IDENTIFIER C_T_GEAR_VS_MAX_MT FORMAT "%4.1" /end CHARACTERISTIC
/begin CHARACTERISTIC c_vs_max_hys "Hysteresis of vehicle speed limitation " VALUE 0xa1029cad _REC_VAL_20_u1 255. _CNV_A_R_LINEAR_____6_CM 0. 255. DISPLAY_IDENTIFIER C_VS_MAX_HYS FORMAT "%3.0" /end CHARACTERISTIC
/begin CHARACTERISTIC c_vs_max_0_dft "Vehicle speed limitation threshold 0 - default value" VALUE 0xa1029c9e _REC_VAL_20_u1 255. _CNV_A_R_LINEAR_____6_CM 0. 255. DISPLAY_IDENTIFIER C_VS_MAX_0_DFT FORMAT "%3.0" /end CHARACTERISTIC
/begin CHARACTERISTIC c_vs_max_1 "Vehicle speed limitation threshold 1" VALUE 0xa1029c9f _REC_VAL_20_u1 255. _CNV_A_R_LINEAR_____6_CM 0. 255. DISPLAY_IDENTIFIER C_VS_MAX_1 FORMAT "%3.0" /end CHARACTERISTIC
/begin CHARACTERISTIC c_vs_max_2 "Vehicle speed limitation threshold 2" VALUE 0xa1029ca0 _REC_VAL_20_u1 255. _CNV_A_R_LINEAR_____6_CM 0. 255. DISPLAY_IDENTIFIER C_VS_MAX_2 FORMAT "%3.0" /end CHARACTERISTIC
/begin CHARACTERISTIC c_vs_max_3 "Vehicle speed limitation threshold 3" VALUE 0xa1029ca1 _REC_VAL_20_u1 255. _CNV_A_R_LINEAR_____6_CM 0. 255. DISPLAY_IDENTIFIER C_VS_MAX_3 FORMAT "%3.0" /end CHARACTERISTIC
/begin CHARACTERISTIC ip_n_max_1__tco "engine speed limit (orange area) depending on TOIL - BN2000" CURVE 0xa1026340 _REC_CUR_20_u2_u1 8160. _CNV_A_R_LINEAR_____13_CM 0. 8160. DISPLAY_IDENTIFIER IP_N_MAX_1__TCO FORMAT "%4.0"
 /begin AXIS_DESCR COM_AXIS tco _CNV_A_R_LINEAR_____16_CM 4 -48. 142.5 FORMAT "%6.2" AXIS_PTS_REF ldp_tco__n_max_1 /end AXIS_DESCR
/end CHARACTERISTIC
/begin CHARACTERISTIC ip_n_max_2__tco "engine speed limit (red area) depending on TOIL - BN2000" CURVE 0xa1026348 _REC_CUR_20_u2_u1 8160. _CNV_A_R_LINEAR_____13_CM 0. 8160. DISPLAY_IDENTIFIER IP_N_MAX_2__TCO FORMAT "%4.0"
 /begin AXIS_DESCR COM_AXIS tco _CNV_A_R_LINEAR_____16_CM 4 -48. 142.5 FORMAT "%6.2" AXIS_PTS_REF ldp_tco__n_max_2 /end AXIS_DESCR
/end CHARACTERISTIC
/begin AXIS_PTS ldp_tco__n_max_1 "" 0xa1021288 tco _REC_AXS_20_u1 190.5 _CNV_A_R_LINEAR_____16_CM 4 -48. 142.5 FORMAT "%6.2" /end AXIS_PTS
/begin AXIS_PTS ldp_tco__n_max_2 "" 0xa102128e tco _REC_AXS_20_u1 190.5 _CNV_A_R_LINEAR_____16_CM 4 -48. 142.5 FORMAT "%6.2" /end AXIS_PTS
/begin CHARACTERISTIC c_n_max_egy_1 "Engine speed limit in case of production energy spare mode (Fertigungsmodus)" VALUE 0xa102961a _REC_VAL_20_u2 8160. _CNV_A_R_LINEAR_____13_CM 0. 8160. DISPLAY_IDENTIFIER C_N_MAX_EGY_1 FORMAT "%4.0" /end CHARACTERISTIC
/begin CHARACTERISTIC c_n_max_egy_2 "Engine speed limit in case of transportation energy spare mode (Transportmodus)" VALUE 0xa102961c _REC_VAL_20_u2 8160. _CNV_A_R_LINEAR_____13_CM 0. 8160. DISPLAY_IDENTIFIER C_N_MAX_EGY_2 FORMAT "%4.0" /end CHARACTERISTIC
/begin CHARACTERISTIC c_n_max_egy_3 "Engine speed limit in case of garage energy spare mode (Werkstattmodus)" VALUE 0xa102961e _REC_VAL_20_u2 8160. _CNV_A_R_LINEAR_____13_CM 0. 8160. DISPLAY_IDENTIFIER C_N_MAX_EGY_3 FORMAT "%4.0" /end CHARACTERISTIC
/begin CHARACTERISTIC c_pv_grd_lih_max "Max. (positive) pedal gradient in case of an error" VALUE 0xa1029732 _REC_VAL_20_u2 99.99847412109381 _CNV_A_R_LINEAR_____7_CM 0. 99.99847412109381 DISPLAY_IDENTIFIER C_PV_GRD_LIH_MAX /end CHARACTERISTIC
/begin CHARACTERISTIC c_v_pvs_hys_fil "Area of the dejitter-filters" VALUE 0xa1029b78 _REC_VAL_20_u1 1.24511719 _CNV_A_R_LINEAR_____245_CM 0. 1.24511719 DISPLAY_IDENTIFIER C_V_PVS_HYS_FIL FORMAT "%4.3" /end CHARACTERISTIC
/begin MEASUREMENT v_pvs_fil_1 "Filtered PVS-voltage value for channel 1" UWORD _CNV_A_R_LINEAR_____2_CM 1 100. 0. 4.9951171875 DISPLAY_IDENTIFIER V_PVS_FIL_1 ECU_ADDRESS 0xc0000b64 FORMAT "%5.3" /end MEASUREMENT
/begin MEASUREMENT v_pvs_fil_2 "Filtered PVS-voltage value for channel 2" UWORD _CNV_A_R_LINEAR_____2_CM 1 100. 0. 4.9951171875 DISPLAY_IDENTIFIER V_PVS_FIL_2 ECU_ADDRESS 0xc0000b66 FORMAT "%5.3" /end MEASUREMENT
/begin CHARACTERISTIC c_pvs_slop_1 "Slope value of  the pedal value 1" VALUE 0xa1029739 _REC_VAL_20_u1 79.6875 _CNV_A_R_LINEAR_____246_CM 0. 79.6875 DISPLAY_IDENTIFIER C_PVS_SLOP_1 FORMAT "%4.1" /end CHARACTERISTIC
/begin CHARACTERISTIC c_pvs_slop_2 "Slope value of  the pedal value 2" VALUE 0xa102973a _REC_VAL_20_u1 79.6875 _CNV_A_R_LINEAR_____246_CM 0. 79.6875 DISPLAY_IDENTIFIER C_PVS_SLOP_2 FORMAT "%4.1" /end CHARACTERISTIC
/begin MEASUREMENT lv_kd "Flag for Kick-Down-Recognition (internally recognized from both PVS-voltages)" UBYTE _CNV_S_2_RANGE__0___1_CM 1 100. 0. 1. DISPLAY_IDENTIFIER LV_KD ECU_ADDRESS 0xd0003b4f BIT_MASK 0x1 /end MEASUREMENT
/begin CHARACTERISTIC c_v_pvs_ofs_1 "Offset of the pedal value 1" VALUE 0xa1029b86 _REC_VAL_20_u1 1.24511719 _CNV_A_R_LINEAR_____245_CM 0. 1.24511719 DISPLAY_IDENTIFIER C_V_PVS_OFS_1 FORMAT "%5.3" /end CHARACTERISTIC
/begin CHARACTERISTIC c_v_pvs_ofs_2 "Offset of the pedal value 2" VALUE 0xa1029b87 _REC_VAL_20_u1 1.24511719 _CNV_A_R_LINEAR_____245_CM 0. 1.24511719 DISPLAY_IDENTIFIER C_V_PVS_OFS_2 FORMAT "%5.3" /end CHARACTERISTIC
/begin MEASUREMENT pv_av "Global degree of activation of the accelerator pedal" UBYTE _CNV_A_R_LINEAR_____5_CM 1 100. 0. 99.609375 DISPLAY_IDENTIFIER PV_AV ECU_ADDRESS 0xd0003b49 FORMAT "%3.1" /end MEASUREMENT
/begin CHARACTERISTIC c_pv_av_bls_not_plaus_lgrd "Change limitation of pedal position in case of an PV_AV/Brake implausibility" VALUE 0xa1029722 _REC_VAL_20_u2 99.99847412109381 _CNV_A_R_LINEAR_____7_CM 0. 99.99847412109381 DISPLAY_IDENTIFIER C_PV_AV_BLS_NOT_PLAUS_LGRD /end CHARACTERISTIC
/begin CHARACTERISTIC c_pv_av_bls_not_plaus_hys "Hysteresis in case of an PV_AV/Brake implausibility" VALUE 0xa1029720 _REC_VAL_20_u1 99.609375 _CNV_A_R_LINEAR_____5_CM 0. 99.609375 DISPLAY_IDENTIFIER C_PV_AV_BLS_NOT_PLAUS_HYS FORMAT "%4.1" /end CHARACTERISTIC
/begin MEASUREMENT pv_av_2 "degree of activation of the accelerator pedal from PVS-channel 2" UBYTE _CNV_A_R_LINEAR_____5_CM 1 100. 0. 99.609375 DISPLAY_IDENTIFIER PV_AV_2 ECU_ADDRESS 0xd0003b4b FORMAT "%3.1" /end MEASUREMENT
/begin MEASUREMENT pv_max "Maximum selection of pedal value interpretation" UBYTE _CNV_A_R_LINEAR_____5_CM 1 100. 0. 99.609375 DISPLAY_IDENTIFIER PV_MAX ECU_ADDRESS 0xd0003b4e FORMAT "%3.1" /end MEASUREMENT
/begin MEASUREMENT pv_av_grd "Throttle position gradient before correction" UBYTE _CNV_A_R_LINEAR_____247_CM 1 100. -1250. 1240.234 DISPLAY_IDENTIFIER PV_AV_GRD ECU_ADDRESS 0xd0003b48 FORMAT "%6.1" /end MEASUREMENT
/begin CHARACTERISTIC c_pv_av_bls_not_plaus "Pedal position in case of an PV_AV/Brake implausibility" VALUE 0xa102971f _REC_VAL_20_u1 99.609375 _CNV_A_R_LINEAR_____5_CM 0. 99.609375 DISPLAY_IDENTIFIER C_PV_AV_BLS_NOT_PLAUS FORMAT "%4.1" /end CHARACTERISTIC
/begin MEASUREMENT pv_av_1 "degree of activation of the accelerator pedal from PVS-channel 1" UBYTE _CNV_A_R_LINEAR_____5_CM 1 100. 0. 99.609375 DISPLAY_IDENTIFIER PV_AV_1 ECU_ADDRESS 0xd0003b4a FORMAT "%3.1" /end MEASUREMENT
/begin MEASUREMENT fac_pv_cs_cor "Starting  correction" SWORD _CNV_A_R_LINEAR_____200_CM 1 100. -1. 0.99996948 DISPLAY_IDENTIFIER FAC_PV_CS_COR ECU_ADDRESS 0xc0000b68 FORMAT "%8.5" /end MEASUREMENT
/begin MEASUREMENT fac_pv_gs_cor "Gear shift correction" SWORD _CNV_A_R_LINEAR_____200_CM 1 100. -1. 0.99996948 DISPLAY_IDENTIFIER FAC_PV_GS_COR ECU_ADDRESS 0xc0000b6a FORMAT "%8.5" /end MEASUREMENT
/begin MEASUREMENT fac_pv_bas_cor "basic correction" SWORD _CNV_A_R_LINEAR_____200_CM 1 100. -1. 0.99996948 DISPLAY_IDENTIFIER FAC_PV_BAS_COR ECU_ADDRESS 0xc0000b6c FORMAT "%8.5" /end MEASUREMENT
/begin MEASUREMENT fac_pv_cor "Summation of corrections" UWORD _CNV_A_R_LINEAR_____248_CM 1 100. 0. 0.99997 DISPLAY_IDENTIFIER FAC_PV_COR ECU_ADDRESS 0xc0000b6e FORMAT "%8.6" /end MEASUREMENT
/begin MEASUREMENT pv_av_raw "Global degree of activation of the gas pedal" UBYTE _CNV_A_R_LINEAR_____5_CM 1 100. 0. 99.609375 DISPLAY_IDENTIFIER PV_AV_RAW ECU_ADDRESS 0xd0003b4c FORMAT "%3.1" /end MEASUREMENT
/begin CHARACTERISTIC ip_pv_lih_max "Max. pedal position in case of an error" CURVE 0xa102778c _REC_CUR_20_u1_u1 99.609375 _CNV_A_R_LINEAR_____5_CM 0. 99.609375 DISPLAY_IDENTIFIER IP_PV_LIH_MAX FORMAT "%4.1"
 /begin AXIS_DESCR COM_AXIS n_32 _CNV_A_R_LINEAR_____9_CM 6 0. 8160. FORMAT "%4.0" AXIS_PTS_REF ldp_n_32__pv_lih_max /end AXIS_DESCR
/end CHARACTERISTIC
/begin CHARACTERISTIC ip_fac_pv_bas_cor_mt "Basic correction" MAP 0xa1023d38 _REC_MAP_20_u2_u2_u1 1.99996948 _CNV_A_R_LINEAR_____249_CM -1. 0.99996948 DISPLAY_IDENTIFIER IP_FAC_PV_BAS_COR_MT FORMAT "%8.5"
 /begin AXIS_DESCR COM_AXIS n _CNV_A_R_LINEAR_____13_CM 6 1. 8160. FORMAT "%4.0" AXIS_PTS_REF ldpm_n__pv_fac_cor /end AXIS_DESCR
 /begin AXIS_DESCR COM_AXIS pv_av_raw _CNV_A_R_LINEAR_____5_CM 6 0. 99.609375 FORMAT "%4.1" AXIS_PTS_REF ldpm_pv_av_raw__pv_fac_cor /end AXIS_DESCR
/end CHARACTERISTIC
/begin CHARACTERISTIC ip_fac_pv_bas_cor_at "Basic correction" MAP 0xa1023cf0 _REC_MAP_20_u2_u2_u1 1.99996948 _CNV_A_R_LINEAR_____249_CM -1. 0.99996948 DISPLAY_IDENTIFIER IP_FAC_PV_BAS_COR_AT FORMAT "%8.5"
 /begin AXIS_DESCR COM_AXIS n _CNV_A_R_LINEAR_____13_CM 6 1. 8160. FORMAT "%4.0" AXIS_PTS_REF ldpm_n__pv_fac_cor /end AXIS_DESCR
 /begin AXIS_DESCR COM_AXIS pv_av_raw _CNV_A_R_LINEAR_____5_CM 6 0. 99.609375 FORMAT "%4.1" AXIS_PTS_REF ldpm_pv_av_raw__pv_fac_cor /end AXIS_DESCR
/end CHARACTERISTIC
/begin CHARACTERISTIC ip_fac_pv_bas_cor_amt "Basic correction" MAP 0xa1023ca8 _REC_MAP_20_u2_u2_u1 1.99996948 _CNV_A_R_LINEAR_____249_CM -1. 0.99996948 DISPLAY_IDENTIFIER IP_FAC_PV_BAS_COR_AMT FORMAT "%8.5"
 /begin AXIS_DESCR COM_AXIS n _CNV_A_R_LINEAR_____13_CM 6 1. 8160. FORMAT "%4.0" AXIS_PTS_REF ldpm_n__pv_fac_cor /end AXIS_DESCR
 /begin AXIS_DESCR COM_AXIS pv_av_raw _CNV_A_R_LINEAR_____5_CM 6 0. 99.609375 FORMAT "%4.1" AXIS_PTS_REF ldpm_pv_av_raw__pv_fac_cor /end AXIS_DESCR
/end CHARACTERISTIC
/begin CHARACTERISTIC ip_fac_pv_cs_cor_amt "Clutch  intervention correction" MAP 0xa1023d80 _REC_MAP_20_u2_u2_u1 1.99996948 _CNV_A_R_LINEAR_____249_CM -1. 0.99996948 DISPLAY_IDENTIFIER IP_FAC_PV_CS_COR_AMT FORMAT "%8.5"
 /begin AXIS_DESCR COM_AXIS n_dif _CNV_A_R_LINEAR_____172_CM 6 -32768. 32767. FORMAT "%6.0" AXIS_PTS_REF ldpm_n_dif__pv_fac_cor /end AXIS_DESCR
 /begin AXIS_DESCR COM_AXIS pv_av_raw _CNV_A_R_LINEAR_____5_CM 6 0. 99.609375 FORMAT "%4.1" AXIS_PTS_REF ldpm_pv_av_raw__pv_fac_cor /end AXIS_DESCR
/end CHARACTERISTIC
/begin CHARACTERISTIC ip_fac_pv_gs_cor_amt "Gear shift intervention correction" MAP 0xa1023e58 _REC_MAP_20_u2_u2_u1 1.99996948 _CNV_A_R_LINEAR_____249_CM -1. 0.99996948 DISPLAY_IDENTIFIER IP_FAC_PV_GS_COR_AMT FORMAT "%8.5"
 /begin AXIS_DESCR COM_AXIS n _CNV_A_R_LINEAR_____13_CM 6 1. 8160. FORMAT "%4.0" AXIS_PTS_REF ldpm_n__pv_fac_cor /end AXIS_DESCR
 /begin AXIS_DESCR COM_AXIS pv_av_raw _CNV_A_R_LINEAR_____5_CM 6 0. 99.609375 FORMAT "%4.1" AXIS_PTS_REF ldpm_pv_av_raw__pv_fac_cor /end AXIS_DESCR
/end CHARACTERISTIC
/begin CHARACTERISTIC ip_fac_pv_gs_cor_mt "Gear shift intervention correction" MAP 0xa1023ea0 _REC_MAP_20_u2_u2_u1 1.99996948 _CNV_A_R_LINEAR_____249_CM -1. 0.99996948 DISPLAY_IDENTIFIER IP_FAC_PV_GS_COR_MT FORMAT "%8.5"
 /begin AXIS_DESCR COM_AXIS n _CNV_A_R_LINEAR_____13_CM 6 1. 8160. FORMAT "%4.0" AXIS_PTS_REF ldpm_n__pv_fac_cor /end AXIS_DESCR
 /begin AXIS_DESCR COM_AXIS pv_av_raw _CNV_A_R_LINEAR_____5_CM 6 0. 99.609375 FORMAT "%4.1" AXIS_PTS_REF ldpm_pv_av_raw__pv_fac_cor /end AXIS_DESCR
/end CHARACTERISTIC
/begin CHARACTERISTIC ip_fac_vs_pv_gs_cor_amt "Vehicle speed correction" CURVE 0xa10249a0 _REC_CUR_20_u2_u2 1.99996948 _CNV_A_R_LINEAR_____249_CM -1. 0.99996948 DISPLAY_IDENTIFIER IP_FAC_VS_PV_GS_COR_AMT FORMAT "%8.5"
 /begin AXIS_DESCR COM_AXIS vs_fil _CNV_A_R_LINEAR_____250_CM 8 0. 511.99218 FORMAT "%7.3" AXIS_PTS_REF ldpm_vs_fil__pv_fac_cor /end AXIS_DESCR
/end CHARACTERISTIC
/begin CHARACTERISTIC ip_fac_vs_pv_gs_cor_mt "Vehicle speed correction" CURVE 0xa10249b0 _REC_CUR_20_u2_u2 1.99996948 _CNV_A_R_LINEAR_____249_CM -1. 0.99996948 DISPLAY_IDENTIFIER IP_FAC_VS_PV_GS_COR_MT FORMAT "%8.5"
 /begin AXIS_DESCR COM_AXIS vs_fil _CNV_A_R_LINEAR_____250_CM 8 0. 511.99218 FORMAT "%7.3" AXIS_PTS_REF ldpm_vs_fil__pv_fac_cor /end AXIS_DESCR
/end CHARACTERISTIC
/begin CHARACTERISTIC ip_fac_vs_pv_bas_cor_mt "Vehicle speed correction" CURVE 0xa1024990 _REC_CUR_20_u2_u2 1.99996948 _CNV_A_R_LINEAR_____249_CM -1. 0.99996948 DISPLAY_IDENTIFIER IP_FAC_VS_PV_BAS_COR_MT FORMAT "%8.5"
 /begin AXIS_DESCR COM_AXIS vs_fil _CNV_A_R_LINEAR_____250_CM 8 0. 511.99218 FORMAT "%7.3" AXIS_PTS_REF ldpm_vs_fil__pv_fac_cor /end AXIS_DESCR
/end CHARACTERISTIC
/begin CHARACTERISTIC ip_fac_vs_pv_bas_cor_at "Vehicle speed correction" CURVE 0xa1024980 _REC_CUR_20_u2_u2 1.99996948 _CNV_A_R_LINEAR_____249_CM -1. 0.99996948 DISPLAY_IDENTIFIER IP_FAC_VS_PV_BAS_COR_AT FORMAT "%8.5"
 /begin AXIS_DESCR COM_AXIS vs_fil _CNV_A_R_LINEAR_____250_CM 8 0. 511.99218 FORMAT "%7.3" AXIS_PTS_REF ldpm_vs_fil__pv_fac_cor /end AXIS_DESCR
/end CHARACTERISTIC
/begin CHARACTERISTIC ip_fac_vs_pv_bas_cor_amt "Vehicle speed correction" CURVE 0xa1024970 _REC_CUR_20_u2_u2 1.99996948 _CNV_A_R_LINEAR_____249_CM -1. 0.99996948 DISPLAY_IDENTIFIER IP_FAC_VS_PV_BAS_COR_AMT FORMAT "%8.5"
 /begin AXIS_DESCR COM_AXIS vs_fil _CNV_A_R_LINEAR_____250_CM 8 0. 511.99218 FORMAT "%7.3" AXIS_PTS_REF ldpm_vs_fil__pv_fac_cor /end AXIS_DESCR
/end CHARACTERISTIC
/begin CHARACTERISTIC c_add_fac_pv_bas_mt "Additve correction at reverse gear" VALUE 0xa1029184 _REC_VAL_20_u2 1.99996948 _CNV_A_R_LINEAR_____249_CM -1. 0.99996948 DISPLAY_IDENTIFIER C_ADD_FAC_PV_BAS_MT FORMAT "%8.5" /end CHARACTERISTIC
/begin CHARACTERISTIC c_add_fac_pv_bas_at "Additve correction at reverse gear" VALUE 0xa1029182 _REC_VAL_20_u2 1.99996948 _CNV_A_R_LINEAR_____249_CM -1. 0.99996948 DISPLAY_IDENTIFIER C_ADD_FAC_PV_BAS_AT FORMAT "%8.5" /end CHARACTERISTIC
/begin CHARACTERISTIC c_add_fac_pv_bas_amt "Additve correction at reverse gear" VALUE 0xa1029180 _REC_VAL_20_u2 1.99996948 _CNV_A_R_LINEAR_____249_CM -1. 0.99996948 DISPLAY_IDENTIFIER C_ADD_FAC_PV_BAS_AMT FORMAT "%8.5" /end CHARACTERISTIC
/begin CHARACTERISTIC c_t_fac_pv_gs "Timer switch off GS correction" VALUE 0xa102989e _REC_VAL_20_u2 655.34 _CNV_A_R_LINEAR_____3_CM 1.e-002 655.35 DISPLAY_IDENTIFIER C_T_FAC_PV_GS FORMAT "%6.2" /end CHARACTERISTIC
/begin CHARACTERISTIC c_v_pvs_thd_kd_hys "Hysteresis of kick down recognition Channel 1" VALUE 0xa1029b89 _REC_VAL_20_u1 4.998 _CNV_A_R_LINEAR_____189_CM 0. 4.998 DISPLAY_IDENTIFIER C_V_PVS_THD_KD_HYS FORMAT "%6.4" /end CHARACTERISTIC
/begin CHARACTERISTIC c_v_pvs_thd_kd "Difference between C_V_PVS_SP_FL_1 and kick-down-recognition (Channel 1)" VALUE 0xa1029b88 _REC_VAL_20_u1 4.998 _CNV_A_R_LINEAR_____189_CM 0. 4.998 DISPLAY_IDENTIFIER C_V_PVS_THD_KD FORMAT "%6.4" /end CHARACTERISTIC
/begin MEASUREMENT pv_cru "CRU control variable" UBYTE _CNV_A_R_LINEAR_____5_CM 1 100. 0. 99.609375 DISPLAY_IDENTIFIER PV_CRU ECU_ADDRESS 0xd0003b4d FORMAT "%4.1" /end MEASUREMENT
/begin CHARACTERISTIC ip_pv_cru_rng_l "Scaling factor for requested torque at clutch from driver in low range mode" MAP 0xa102774c _REC_MAP_20_u1_u1_u2 99.609375 _CNV_A_R_LINEAR_____5_CM 0. 99.609375 DISPLAY_IDENTIFIER IP_PV_CRU_RNG_L FORMAT "%4.1"
 /begin AXIS_DESCR COM_AXIS n_32 _CNV_A_R_LINEAR_____9_CM 8 0. 8160. FORMAT "%4.0" AXIS_PTS_REF ldpm_n_32__fac_tq_req_driv /end AXIS_DESCR
 /begin AXIS_DESCR COM_AXIS fac_tq_req_cru _CNV_A_R_LINEAR_____8_CM 8 0. 1.99996948242188 FORMAT "%7.5" AXIS_PTS_REF ldpm_fac_tq_cru_dcc /end AXIS_DESCR
/end CHARACTERISTIC
/begin CHARACTERISTIC ip_pv_cru "Scaling factor for requested torque at clutch from driver" MAP 0xa102770c _REC_MAP_20_u1_u1_u2 99.609375 _CNV_A_R_LINEAR_____5_CM 0. 99.609375 DISPLAY_IDENTIFIER IP_PV_CRU FORMAT "%4.1"
 /begin AXIS_DESCR COM_AXIS n_32 _CNV_A_R_LINEAR_____9_CM 8 0. 8160. FORMAT "%4.0" AXIS_PTS_REF ldpm_n_32__fac_tq_req_driv /end AXIS_DESCR
 /begin AXIS_DESCR COM_AXIS fac_tq_req_cru _CNV_A_R_LINEAR_____8_CM 8 0. 1.99996948242188 FORMAT "%7.5" AXIS_PTS_REF ldpm_fac_tq_cru_dcc /end AXIS_DESCR
/end CHARACTERISTIC
/begin AXIS_PTS ldp_n_32__pv_lih_max "" 0xa1020da0 n_32 _REC_AXS_20_u1 816. _CNV_A_R_LINEAR_____9_CM 6 0. 8160. FORMAT "%4.0" /end AXIS_PTS
/begin AXIS_PTS ldpm_vs_fil__pv_fac_cor "" 0xa10223d4 vs_fil _REC_AXS_20_u2 51.199218 _CNV_A_R_LINEAR_____250_CM 8 0. 511.99218 FORMAT "%7.3" /end AXIS_PTS
/begin AXIS_PTS ldpm_n_dif__pv_fac_cor "" 0xa1021e98 n_dif _REC_AXS_20_u2 6553.5 _CNV_A_R_LINEAR_____172_CM 6 -32768. 32767. FORMAT "%6.0" /end AXIS_PTS
/begin AXIS_PTS ldpm_n__pv_fac_cor "" 0xa1021e88 n _REC_AXS_20_u2 815.9 _CNV_A_R_LINEAR_____13_CM 6 1. 8160. FORMAT "%4.0" /end AXIS_PTS
/begin AXIS_PTS ldpm_pv_av_raw__pv_fac_cor "" 0xa10221b6 pv_av_raw _REC_AXS_20_u1 9.9609375 _CNV_A_R_LINEAR_____5_CM 6 0. 99.609375 FORMAT "%4.1" /end AXIS_PTS
/begin AXIS_PTS ldpm_n_32__fac_tq_req_driv "" 0xa1021e10 n_32 _REC_AXS_20_u1 8160. _CNV_A_R_LINEAR_____9_CM 8 0. 8160. FORMAT "%4.0" /end AXIS_PTS
/begin AXIS_PTS ldpm_fac_tq_cru_dcc "" 0xa1021a80 fac_tq_req_cru _REC_AXS_20_u2 1.99996948242188 _CNV_A_R_LINEAR_____8_CM 8 0. 1.99996948242188 FORMAT "%7.5" /end AXIS_PTS
/begin MEASUREMENT pv_cus "Corrected pedal value interpretation with higher resolution for customer purpose" UWORD _CNV_A_R_LINEAR_____7_CM 1 100. 0. 99.99847412109381 DISPLAY_IDENTIFIER PV_CUS ECU_ADDRESS 0xd0004f82 /end MEASUREMENT
/begin MEASUREMENT pv_cus_1 "degree of activation of the accelerator pedal from PVS-channel 1 with higher resolution for customer purposes" UWORD _CNV_A_R_LINEAR_____7_CM 1 100. 0. 99.99847412109381 DISPLAY_IDENTIFIER PV_CUS_1 ECU_ADDRESS 0xd0004f7c /end MEASUREMENT
/begin MEASUREMENT pv_cus_2 "degree of activation of the accelerator pedal from PVS-channel 2 with higher resolution for customer purposes" UWORD _CNV_A_R_LINEAR_____7_CM 1 100. 0. 99.99847412109381 DISPLAY_IDENTIFIER PV_CUS_2 ECU_ADDRESS 0xd0004f7e /end MEASUREMENT
/begin MEASUREMENT pv_cus_raw "Global degree of activation of the gas pedal with higher resolution for customer purpose" UWORD _CNV_A_R_LINEAR_____7_CM 1 100. 0. 99.99847412109381 DISPLAY_IDENTIFIER PV_CUS_RAW ECU_ADDRESS 0xd0004f80 /end MEASUREMENT
/begin MEASUREMENT pv_cru_1 "Pedal value interpretation of Cruise control temporary" UBYTE _CNV_A_R_LINEAR_____5_CM 1 100. 0. 99.609375 DISPLAY_IDENTIFIER PV_CRU_1 ECU_ADDRESS 0xc0000b74 FORMAT "%4.1" /end MEASUREMENT
/begin MEASUREMENT pv_cru_raw "Pedal value interpretation of Cruise control rawsignal" UBYTE _CNV_A_R_LINEAR_____5_CM 1 100. 0. 99.609375 DISPLAY_IDENTIFIER PV_CRU_RAW ECU_ADDRESS 0xc0000b75 FORMAT "%4.1" /end MEASUREMENT
/begin CHARACTERISTIC ip_fac_pv_cs_cor_mt "Clutch  intervention correction" MAP 0xa1023e10 _REC_MAP_20_u2_u2_u1 1.99996948 _CNV_A_R_LINEAR_____249_CM -1. 0.99996948 DISPLAY_IDENTIFIER IP_FAC_PV_CS_COR_MT FORMAT "%8.5"
 /begin AXIS_DESCR COM_AXIS n_dif _CNV_A_R_LINEAR_____172_CM 6 -32768. 32767. FORMAT "%6.0" AXIS_PTS_REF ldpm_n_dif__pv_fac_cor /end AXIS_DESCR
 /begin AXIS_DESCR COM_AXIS pv_av_raw _CNV_A_R_LINEAR_____5_CM 6 0. 99.609375 FORMAT "%4.1" AXIS_PTS_REF ldpm_pv_av_raw__pv_fac_cor /end AXIS_DESCR
/end CHARACTERISTIC
/begin CHARACTERISTIC ip_fac_pv_cs_cor_at "Clutch  intervention correction" MAP 0xa1023dc8 _REC_MAP_20_u2_u2_u1 1.99996948 _CNV_A_R_LINEAR_____249_CM -1. 0.99996948 DISPLAY_IDENTIFIER IP_FAC_PV_CS_COR_AT FORMAT "%8.5"
 /begin AXIS_DESCR COM_AXIS n_dif _CNV_A_R_LINEAR_____172_CM 6 -32768. 32767. FORMAT "%6.0" AXIS_PTS_REF ldpm_n_dif__pv_fac_cor /end AXIS_DESCR
 /begin AXIS_DESCR COM_AXIS pv_av_raw _CNV_A_R_LINEAR_____5_CM 6 0. 99.609375 FORMAT "%4.1" AXIS_PTS_REF ldpm_pv_av_raw__pv_fac_cor /end AXIS_DESCR
/end CHARACTERISTIC
/begin CHARACTERISTIC c_t_fac_pv_cs_at "Timer switch off CS correction for AT" VALUE 0xa102989a _REC_VAL_20_u2 655.34 _CNV_A_R_LINEAR_____3_CM 1.e-002 655.35 DISPLAY_IDENTIFIER C_T_FAC_PV_CS_AT FORMAT "%6.2" /end CHARACTERISTIC
/begin CHARACTERISTIC c_t_fac_pv_cs_mt "Timer switch off CS correction for MT and AMT" VALUE 0xa102989c _REC_VAL_20_u2 655.34 _CNV_A_R_LINEAR_____3_CM 1.e-002 655.35 DISPLAY_IDENTIFIER C_T_FAC_PV_CS_MT FORMAT "%6.2" /end CHARACTERISTIC
/begin CHARACTERISTIC c_vs_max_fac_pv_cor "Timer switch off CS correction" VALUE 0xa1029ca8 _REC_VAL_20_u2 511.99218 _CNV_A_R_LINEAR_____66_CM 0. 511.99218 DISPLAY_IDENTIFIER C_VS_MAX_FAC_PV_COR FORMAT "%7.3" /end CHARACTERISTIC
/begin CHARACTERISTIC c_vs_max_fac_pv_cor_at "Starting or gear shift detection threshold for AT" VALUE 0xa1029caa _REC_VAL_20_u2 511.99218 _CNV_A_R_LINEAR_____66_CM 0. 511.99218 DISPLAY_IDENTIFIER C_VS_MAX_FAC_PV_COR_AT FORMAT "%7.3" /end CHARACTERISTIC
/begin MEASUREMENT lv_err_prel_teg_pcat_down_2 "Temp. after precatalyst antibounce flag" UBYTE _CNV_S_2_RANGE______254_R_CM 1 100. 0. 255. DISPLAY_IDENTIFIER LV_ERR_PREL_TEG_PCAT_DOWN_2 ECU_ADDRESS 0xd0003b71 BIT_MASK 0x1 /end MEASUREMENT
/begin MEASUREMENT lv_err_prel_teg_pcat_down_1 "Temp. after precatalyst antibounce flag" UBYTE _CNV_S_2_RANGE______254_R_CM 1 100. 0. 255. DISPLAY_IDENTIFIER LV_ERR_PREL_TEG_PCAT_DOWN_1 ECU_ADDRESS 0xd0003b70 BIT_MASK 0x1 /end MEASUREMENT
/begin CHARACTERISTIC c_v_teg_pcat_down_diag_min "minimum voltage threshold for erroe detection" VALUE 0xa1029b9e _REC_VAL_20_u2 4.9951171875 _CNV_A_R_LINEAR_____2_CM 0. 4.9951171875 DISPLAY_IDENTIFIER C_V_TEG_PCAT_DOWN_DIAG_MIN FORMAT "%5.3" /end CHARACTERISTIC
/begin CHARACTERISTIC c_v_teg_pcat_down_diag_max "maximum voltage threshold for erroe detection" VALUE 0xa1029b9c _REC_VAL_20_u2 4.9951171875 _CNV_A_R_LINEAR_____2_CM 0. 4.9951171875 DISPLAY_IDENTIFIER C_V_TEG_PCAT_DOWN_DIAG_MAX FORMAT "%5.3" /end CHARACTERISTIC
/begin CHARACTERISTIC c_v_teg_mes_grd_max "maximum voltage gradient threshold for error detection" VALUE 0xa1029b9a _REC_VAL_20_u2 4.9951171875 _CNV_A_R_LINEAR_____2_CM 0. 4.9951171875 DISPLAY_IDENTIFIER C_V_TEG_MES_GRD_MAX FORMAT "%5.3" /end CHARACTERISTIC
/begin MEASUREMENT lv_err_teg_pcat_down_1 "Temp. after precatalyst error flag" UBYTE _CNV_S_2_RANGE______254_R_CM 1 100. 0. 255. DISPLAY_IDENTIFIER LV_ERR_TEG_PCAT_DOWN_1 ECU_ADDRESS 0xd0003483 BIT_MASK 0x1 /end MEASUREMENT
/begin MEASUREMENT lv_err_teg_pcat_down_2 "Temp. after precatalyst error flag" UBYTE _CNV_S_2_RANGE______254_R_CM 1 100. 0. 255. DISPLAY_IDENTIFIER LV_ERR_TEG_PCAT_DOWN_2 ECU_ADDRESS 0xd0003484 BIT_MASK 0x1 /end MEASUREMENT
/begin CHARACTERISTIC c_cam_op_in "inlet valves total opening angle" VALUE 0xa10291b1 _REC_VAL_20_u1 95.625 _CNV_A_R_LINEAR_____257_CM 175. 270.625 DISPLAY_IDENTIFIER C_CAM_OP_IN FORMAT "%5.1" /end CHARACTERISTIC
/begin CHARACTERISTIC c_cam_op_ex "outlet valves total opening angle" VALUE 0xa10291b0 _REC_VAL_20_u1 95.625 _CNV_A_R_LINEAR_____257_CM 175. 270.625 DISPLAY_IDENTIFIER C_CAM_OP_EX FORMAT "%5.1" /end CHARACTERISTIC
/begin CHARACTERISTIC c_tia_grd_max_diag "Maximum permissible gradient for TIA" VALUE 0xa1029a4c _REC_VAL_20_u1 38.1 _CNV_A_R_LINEAR_____258_CM 0. 190.5 DISPLAY_IDENTIFIER C_TIA_GRD_MAX_DIAG FORMAT "%4.1" /end CHARACTERISTIC
/begin CHARACTERISTIC ip_tia__v_tia "NTC characteristic" CURVE 0xa1028124 _REC_CUR_20_u1_u1 28.575 _CNV_A_R_LINEAR_____16_CM -48. 142.5 DISPLAY_IDENTIFIER IP_TIA__V_TIA FORMAT "%5.1"
 /begin AXIS_DESCR COM_AXIS v_tia _CNV_A_R_LINEAR_____195_CM 16 3.90625e-002 4.98046875 FORMAT "%5.3" AXIS_PTS_REF ldp_v_tia_tia /end AXIS_DESCR
/end CHARACTERISTIC
/begin MEASUREMENT tia_sub "" UBYTE _CNV_A_R_LINEAR_____16_CM 1 100. -48. 142.5 DISPLAY_IDENTIFIER TIA_SUB ECU_ADDRESS 0xd0003b61 FORMAT "%3.0" /end MEASUREMENT
/begin MEASUREMENT tia_mes "???" UBYTE _CNV_A_R_LINEAR_____16_CM 1 100. -48. 142.5 DISPLAY_IDENTIFIER TIA_MES ECU_ADDRESS 0xd0003b62 FORMAT "%5.1" /end MEASUREMENT
/begin AXIS_PTS ldp_v_tia_tia "" 0xa10216ec v_tia _REC_AXS_20_u1 4.447265625 _CNV_A_R_LINEAR_____195_CM 16 3.90625e-002 4.98046875 FORMAT "%5.3" /end AXIS_PTS
/begin CHARACTERISTIC c_tco_diag "TCO threshold for calculation of substitutes" VALUE 0xa10299cc _REC_VAL_20_u1 28.575 _CNV_A_R_LINEAR_____16_CM -48. 142.5 DISPLAY_IDENTIFIER C_TCO_DIAG FORMAT "%5.1" /end CHARACTERISTIC
/begin CHARACTERISTIC c_tia_sub_tol "Intake air substitute temperature" VALUE 0xa1029a56 _REC_VAL_20_u1 28.575 _CNV_A_R_LINEAR_____16_CM -48. 142.5 DISPLAY_IDENTIFIER C_TIA_SUB_TOL FORMAT "%5.1" /end CHARACTERISTIC
/begin CHARACTERISTIC c_tia_sub_bol "Intake air substitute temperature" VALUE 0xa1029a55 _REC_VAL_20_u1 28.575 _CNV_A_R_LINEAR_____16_CM -48. 142.5 DISPLAY_IDENTIFIER C_TIA_SUB_BOL FORMAT "%5.1" /end CHARACTERISTIC
/begin MEASUREMENT tia "Intake air temperature" UBYTE _CNV_A_R_LINEAR_____16_CM 1 100. -48. 142.5 DISPLAY_IDENTIFIER TIA ECU_ADDRESS 0xd0003b60 FORMAT "%5.1" /end MEASUREMENT
/begin MEASUREMENT tia_st "Intake air temperature at ST" UBYTE _CNV_A_R_LINEAR_____16_CM 1 100. -48. 142.5 DISPLAY_IDENTIFIER TIA_ST ECU_ADDRESS 0xd0003b63 FORMAT "%5.1" /end MEASUREMENT
/begin MEASUREMENT tia_tcha "Air temperature up turbo charger" UBYTE _CNV_A_R_LINEAR_____16_CM 1 100. -48. 142.5 DISPLAY_IDENTIFIER TIA_TCHA ECU_ADDRESS 0xd0003b64 FORMAT "%5.1" /end MEASUREMENT
/begin CHARACTERISTIC ip_tia_tcha__v_tia_tcha "NTC characteristic up turbo charger" CURVE 0xa1028134 _REC_CUR_20_u1_u1 28.575 _CNV_A_R_LINEAR_____16_CM -48. 142.5 DISPLAY_IDENTIFIER IP_TIA_TCHA__V_TIA_TCHA FORMAT "%5.1"
 /begin AXIS_DESCR COM_AXIS v_tia_tcha _CNV_A_R_LINEAR_____189_CM 16 0. 4.998 FORMAT "%6.4" AXIS_PTS_REF ldp_v_tia_tcha /end AXIS_DESCR
/end CHARACTERISTIC
/begin AXIS_PTS ldp_v_tia_tcha "" 0xa10216d8 v_tia_tcha _REC_AXS_20_u1 4.998 _CNV_A_R_LINEAR_____189_CM 16 0. 4.998 FORMAT "%6.4" /end AXIS_PTS
/begin MEASUREMENT lv_vb_jump "Boolean for  over voltage - ( Passive / Active )" UBYTE _CNV_S_2_RANGE__0___1_CM 1 100. 0. 1. DISPLAY_IDENTIFIER LV_VB_JUMP ECU_ADDRESS 0xd0003c91 BIT_MASK 0x1 /end MEASUREMENT
/begin CHARACTERISTIC c_crlc_vb "Low pass filter constant for VB_MMV" VALUE 0xa102923c _REC_VAL_20_u1 0.99609375 _CNV_A_R_LINEAR_____27_CM 0. 0.99609375 DISPLAY_IDENTIFIER C_CRLC_VB FORMAT "%5.3" /end CHARACTERISTIC
/begin MEASUREMENT vb_mmv "Moving mean value of battery voltage VB" UBYTE _CNV_A_R_LINEAR_____289_CM 1 100. 0. 25.8984375 DISPLAY_IDENTIFIER VB_MMV ECU_ADDRESS 0xd0003c8e FORMAT "%9.6" /end MEASUREMENT
/begin MEASUREMENT lv_cdn_vb_obd1 "Boolean for battery voltage condition fullfilled for OBD-I diagnosis" UBYTE _CNV_S_2_RANGE__0___1_CM 1 100. 0. 1. DISPLAY_IDENTIFIER LV_CDN_VB_OBD1 ECU_ADDRESS 0xd0003c92 BIT_MASK 0x1 /end MEASUREMENT
/begin MEASUREMENT lv_cdn_vb_obd2 "Boolean for battery voltage condition fullfilled for OBD-II diagnosis" UBYTE _CNV_S_2_RANGE__0___1_CM 1 100. 0. 1. DISPLAY_IDENTIFIER LV_CDN_VB_OBD2 ECU_ADDRESS 0xd0003c93 BIT_MASK 0x1 /end MEASUREMENT
/begin CHARACTERISTIC c_vb_min_jump "VB-threshold for maximium permissible battery voltage" VALUE 0xa1029bdd _REC_VAL_20_u1 7.76953125 _CNV_A_R_LINEAR_____289_CM 0. 25.8984375 DISPLAY_IDENTIFIER C_VB_MIN_JUMP FORMAT "%9.6" /end CHARACTERISTIC
/begin CHARACTERISTIC c_vb_min_obd2 "VB-threshold for minimum permissible battery voltage for OBD2-diagnosis" VALUE 0xa1029be1 _REC_VAL_20_u1 7.76953125 _CNV_A_R_LINEAR_____289_CM 0. 25.8984375 DISPLAY_IDENTIFIER C_VB_MIN_OBD2 FORMAT "%9.6" /end CHARACTERISTIC
/begin CHARACTERISTIC c_vb_min_can_diag "Battery Voltage threshold for CAN diagnosis" VALUE 0xa1029bda _REC_VAL_20_u1 25.8984375 _CNV_A_R_LINEAR_____289_CM 0. 25.8984375 DISPLAY_IDENTIFIER C_VB_MIN_CAN_DIAG FORMAT "%9.6" /end CHARACTERISTIC
/begin MEASUREMENT vb "Relay - Battery Voltage" UBYTE _CNV_A_R_LINEAR_____289_CM 1 100. 0. 25.8984375 DISPLAY_IDENTIFIER VB ECU_ADDRESS 0xd0003c8c FORMAT "%9.6" /end MEASUREMENT
/begin MEASUREMENT vb_secu "Battery Voltage secured for dwell computation" UBYTE _CNV_A_R_LINEAR_____289_CM 1 100. 0. 25.8984375 DISPLAY_IDENTIFIER VB_SECU ECU_ADDRESS 0xc0000df4 FORMAT "%9.6" /end MEASUREMENT
/begin MEASUREMENT v_igk "Key - Battery Voltage" UBYTE _CNV_A_R_LINEAR_____289_CM 1 100. 0. 25.8984375 DISPLAY_IDENTIFIER V_IGK ECU_ADDRESS 0xd0003c8d FORMAT "%9.6" /end MEASUREMENT
/begin MEASUREMENT lv_cdn_vb_min_diag "Boolean for battery voltage condition fullfilled for remaining diagnosis" UBYTE _CNV_S_2_RANGE__0___1_CM 1 100. 0. 1. DISPLAY_IDENTIFIER LV_CDN_VB_MIN_DIAG ECU_ADDRESS 0xd0003c96 BIT_MASK 0x1 /end MEASUREMENT
/begin CHARACTERISTIC c_vb_max_obd1 "VB-threshold for maximium permissible battery voltage for OBD1-diagnosis" VALUE 0xa1029bd0 _REC_VAL_20_u1 7.76953125 _CNV_A_R_LINEAR_____289_CM 0. 25.8984375 DISPLAY_IDENTIFIER C_VB_MAX_OBD1 FORMAT "%9.6" /end CHARACTERISTIC
/begin CHARACTERISTIC c_vb_min_obd1 "VB-threshold for minimum permissible battery voltage for OBD1-diagnosis" VALUE 0xa1029be0 _REC_VAL_20_u1 7.76953125 _CNV_A_R_LINEAR_____289_CM 0. 25.8984375 DISPLAY_IDENTIFIER C_VB_MIN_OBD1 FORMAT "%9.6" /end CHARACTERISTIC
/begin CHARACTERISTIC c_vb_max_obd2 "VB-threshold for maximium permissible battery voltage for OBD2-diagnosis" VALUE 0xa1029bd1 _REC_VAL_20_u1 7.76953125 _CNV_A_R_LINEAR_____289_CM 0. 25.8984375 DISPLAY_IDENTIFIER C_VB_MAX_OBD2 FORMAT "%9.6" /end CHARACTERISTIC
/begin CHARACTERISTIC c_t_min_can_diag "VB time condition - diagnosis of timeout CAN messages" VALUE 0xa10298e2 _REC_VAL_20_u1 2550. _CNV_A_R_LINEAR_____18_CM 0. 2550. DISPLAY_IDENTIFIER C_T_MIN_CAN_DIAG FORMAT "%4.0" /end CHARACTERISTIC
/begin CHARACTERISTIC c_vb_min_diag "Battery Voltage threshold for low voltage detection for remaining diagnosis" VALUE 0xa1029bdc _REC_VAL_20_u1 7.76953125 _CNV_A_R_LINEAR_____289_CM 0. 25.8984375 DISPLAY_IDENTIFIER C_VB_MIN_DIAG FORMAT "%9.6" /end CHARACTERISTIC
/begin MEASUREMENT lv_cdn_vb_can_diag "Boolean for battery voltage condition fullfilled for CAN diagnosis" UBYTE _CNV_S_2_RANGE__0___1_CM 1 100. 0. 1. DISPLAY_IDENTIFIER LV_CDN_VB_CAN_DIAG ECU_ADDRESS 0xd0003c94 BIT_MASK 0x1 /end MEASUREMENT
/begin CHARACTERISTIC c_vb_min_bn_diag "Battery Voltage threshold for BN2000 diagnosis" VALUE 0xa1029bd8 _REC_VAL_20_u1 7.76953125 _CNV_A_R_LINEAR_____289_CM 0. 25.8984375 DISPLAY_IDENTIFIER C_VB_MIN_BN_DIAG FORMAT "%9.6" /end CHARACTERISTIC
/begin MEASUREMENT lv_cdn_vb_bn_diag "Boolean for battery voltage condition fullfilled for BN2000 diagnosis" UBYTE _CNV_S_2_RANGE__0___1_CM 1 100. 0. 1. DISPLAY_IDENTIFIER LV_CDN_VB_BN_DIAG ECU_ADDRESS 0xd0003c95 BIT_MASK 0x1 /end MEASUREMENT
/begin MEASUREMENT lv_igk "Boolean for ignition key status - ( Passive / Active )" UBYTE _CNV_S_2_RANGE__0___1_CM 1 100. 0. 1. DISPLAY_IDENTIFIER LV_IGK ECU_ADDRESS 0xd0003c90 BIT_MASK 0x1 /end MEASUREMENT
/begin MEASUREMENT state_plaus_igk_bn "state plausibility IGK - signal via CAN/via HW  (BN2000 only)" UBYTE _CNV_A_R_LINEAR_____0_CM 1 100. 0. 8. DISPLAY_IDENTIFIER STATE_PLAUS_IGK_BN ECU_ADDRESS 0xd0003c8f FORMAT "%2.0" /end MEASUREMENT
/begin MEASUREMENT lv_igk_prel "Preliminary ignition flag for ignition switch off" UBYTE _CNV_S_2_RANGE__0___1_CM 1 100. 0. 1. DISPLAY_IDENTIFIER LV_IGK_PREL ECU_ADDRESS 0xd0003c99 BIT_MASK 0x1 /end MEASUREMENT
/begin MEASUREMENT lv_cdn_vb_can_tq_diag "Boolean for battery voltage condition fullfilled for BN2000 diagnosis" UBYTE _CNV_S_2_RANGE__0___1_CM 1 100. 0. 1. DISPLAY_IDENTIFIER LV_CDN_VB_CAN_TQ_DIAG ECU_ADDRESS 0xd0003c97 BIT_MASK 0x1 /end MEASUREMENT
/begin CHARACTERISTIC c_vb_min_can_tq_diag "Battery Voltage threshold for CAN_TQ interfaces" VALUE 0xa1029bdb _REC_VAL_20_u1 25.8984375 _CNV_A_R_LINEAR_____289_CM 0. 25.8984375 DISPLAY_IDENTIFIER C_VB_MIN_CAN_TQ_DIAG FORMAT "%9.6" /end CHARACTERISTIC
/begin MEASUREMENT vs_edge_av.edge_ctr "actual value of vehicle speed tooth counter" UWORD _CNV_A_R_LINEAR_____0_CM 1 100. 0. 65535. DISPLAY_IDENTIFIER VS_EDGE_CTR_AV ECU_ADDRESS 0xd00050b0 FORMAT "%5.0" /end MEASUREMENT
/begin MEASUREMENT vs_edge_av.edge_t "actual timestamp of last tooth" UWORD _CNV_A_R_LINEAR_____291_CM 1 100. 0. 524.28 DISPLAY_IDENTIFIER VS_EDGE_T_AV ECU_ADDRESS 0xd00050b2 FORMAT "%7.3" /end MEASUREMENT
/begin CHARACTERISTIC c_vs_min_run "minimum vehicle speed for detection of running vehicle" VALUE 0xa1029cc6 _REC_VAL_20_u1 25.5 _CNV_A_R_LINEAR_____6_CM 0. 255. DISPLAY_IDENTIFIER C_VS_MIN_RUN FORMAT "%3.0" /end CHARACTERISTIC
/begin MEASUREMENT lv_vs_run "Boolean for running vehicle" UBYTE _CNV_S_2_RANGE__0___1_CM 1 100. 0. 1. DISPLAY_IDENTIFIER LV_VS_RUN ECU_ADDRESS 0xd0003c9d BIT_MASK 0x1 /end MEASUREMENT
/begin CHARACTERISTIC c_t_vst "Time delay for detection of vehicle speed" VALUE 0xa10299b2 _REC_VAL_20_u1 19. _CNV_A_R_LINEAR_____18_CM 10. 200. DISPLAY_IDENTIFIER C_T_VST FORMAT "%3.0" /end CHARACTERISTIC
/begin CHARACTERISTIC c_vs_edge_sum_min "Minimum number of wheel segments for evaluation of vehicle speedy gonzales" VALUE 0xa1029c91 _REC_VAL_20_u1 25.4 _CNV_A_R_LINEAR_____0_CM 1. 255. DISPLAY_IDENTIFIER C_VS_EDGE_SUM_MIN FORMAT "%3.0" /end CHARACTERISTIC
/begin MEASUREMENT vs_sens "vehicle speed calculated from vehicle speed sensor" UWORD _CNV_A_R_LINEAR_____66_CM 1 100. 0. 511.99218 DISPLAY_IDENTIFIER VS_SENS ECU_ADDRESS 0xd00050b6 FORMAT "%7.3" /end MEASUREMENT
/begin MEASUREMENT vs_sens_grd "Vehicle speed gradient calculated from VS_SENS" SWORD _CNV_A_R_LINEAR_____292_CM 1 100. -256. 255.9921875 DISPLAY_IDENTIFIER VS_SENS_GRD ECU_ADDRESS 0xc0000e26 FORMAT "%8.3" /end MEASUREMENT
/begin MEASUREMENT lv_vst "boolean for stopped vehicle" UBYTE _CNV_S_2_RANGE__0___1_CM 1 100. 0. 1. DISPLAY_IDENTIFIER LV_VST ECU_ADDRESS 0xc0000e2c BIT_MASK 0x1 /end MEASUREMENT
/begin CHARACTERISTIC c_vs_fac "" VALUE 0xa1029c94 _REC_VAL_20_u4 0.291271 _CNV_A_R_LINEAR_____293_CM 0. 0.291271 DISPLAY_IDENTIFIER C_VS_FAC FORMAT "%10.9" /end CHARACTERISTIC
/begin MEASUREMENT vs "vehicle speed" UBYTE _CNV_A_R_LINEAR_____6_CM 1 100. 0. 255. DISPLAY_IDENTIFIER VS ECU_ADDRESS 0xd0003c9c FORMAT "%3.0" /end MEASUREMENT
/begin MEASUREMENT fac_fco_kwp "correction factor for consumption" SBYTE _CNV_A_R_LINEAR_____437_CM 1 100. -0.128 0.127 DISPLAY_IDENTIFIER FAC_FCO_KWP ECU_ADDRESS 0xd000334d FORMAT "%5.3" /end MEASUREMENT
/begin MEASUREMENT eol_ram[0] "State variable for EOL - CPS_CHECK" UBYTE _CNV_S_10_STATE_EOL__438_CM 1 100. 0. 9. DISPLAY_IDENTIFIER STATE_EOL_KWP_CPS ECU_ADDRESS 0xd0004054 /end MEASUREMENT
/begin MEASUREMENT eol_ram[1] "State variable for EOL - DMTL" UBYTE _CNV_S_10_STATE_EOL__438_CM 1 100. 0. 9. DISPLAY_IDENTIFIER STATE_EOL_KWP_DMTL ECU_ADDRESS 0xd0004055 /end MEASUREMENT
/begin MEASUREMENT eol_ram[2] "State variable for EOL - lambda sensors wrong wired/confused" UBYTE _CNV_S_10_STATE_EOL__438_CM 1 100. 0. 9. DISPLAY_IDENTIFIER STATE_EOL_KWP_VLS ECU_ADDRESS 0xd0004056 /end MEASUREMENT
/begin MEASUREMENT eol_ram[3] "State variable for EOL - displace N_SP_IS" UBYTE _CNV_S_10_STATE_EOL__438_CM 1 100. 0. 9. DISPLAY_IDENTIFIER STATE_EOL_KWP_N_SP_IS ECU_ADDRESS 0xd0004057 /end MEASUREMENT
/begin MEASUREMENT eol_ram[4] "State variable for EOL - SA diagnosis" UBYTE _CNV_S_10_STATE_EOL__438_CM 1 100. 0. 9. DISPLAY_IDENTIFIER STATE_EOL_KWP_SA ECU_ADDRESS 0xd0004058 /end MEASUREMENT
/begin MEASUREMENT eol_ram[5] "State variable for EOL - VVL adaptation" UBYTE _CNV_S_10_STATE_EOL__438_CM 1 100. 0. 9. DISPLAY_IDENTIFIER STATE_EOL_KWP_VVL_AD ECU_ADDRESS 0xd0004059 /end MEASUREMENT
/begin MEASUREMENT n_sp_is_ext_adj "idle speed setpoint from the tester" UWORD _CNV_A_R_LINEAR_____13_CM 1 100. 0. 8160. DISPLAY_IDENTIFIER N_SP_IS_EXT_ADJ ECU_ADDRESS 0xd00040de FORMAT "%4.0" /end MEASUREMENT
/begin MEASUREMENT lv_act_n_sp_is_ext_adj "LV for displace N_SP_IS" UBYTE _CNV_S_2_RANGE__0___1_CM 1 100. 0. 1. DISPLAY_IDENTIFIER LV_ACT_N_SP_IS_EXT_ADJ ECU_ADDRESS 0xd000405a BIT_MASK 0x1 /end MEASUREMENT
/begin MEASUREMENT lv_eol_cps "LV for the end of line test CPS" UBYTE _CNV_S_2_RANGE__0___1_CM 1 100. 0. 1. DISPLAY_IDENTIFIER LV_EOL_CPS ECU_ADDRESS 0xd000405b BIT_MASK 0x1 /end MEASUREMENT
/begin MEASUREMENT lv_act_vls_eol_ext_adj "Activation bit for lambda sensor EOL diagnos confused wired" UBYTE _CNV_S_2_RANGE__0___1_CM 1 100. 0. 1. DISPLAY_IDENTIFIER LV_ACT_VLS_EOL_EXT_ADJ ECU_ADDRESS 0xd000405c BIT_MASK 0x1 /end MEASUREMENT
/begin MEASUREMENT lv_pow_mng_mes_mod "set default values PM for BN-SS - set default vaule=01h" UBYTE _CNV_S_2_RANGE__0___1_CM 1 100. 0. 1. DISPLAY_IDENTIFIER LV_POW_MNG_MES_MOD ECU_ADDRESS 0xd0004062 BIT_MASK 0x1 /end MEASUREMENT
/begin MEASUREMENT lv_pow_mng_his_rst "conditions for function request  parking power (for MSx70)" UBYTE _CNV_S_2_RANGE__0___1_CM 1 100. 0. 1. DISPLAY_IDENTIFIER LV_POW_MNG_HIS_RST ECU_ADDRESS 0xd0003349 BIT_MASK 0x1 /end MEASUREMENT
/begin MEASUREMENT lv_pow_mng_bat_chg "condition for  function requested of powermanagement register" UBYTE _CNV_S_2_RANGE__0___1_CM 1 100. 0. 1. DISPLAY_IDENTIFIER LV_POW_MNG_BAT_CHG ECU_ADDRESS 0xd0003348 BIT_MASK 0x1 /end MEASUREMENT
/begin CHARACTERISTIC id_idx_act_ds_conf "" MAP 0xa1022784 _REC_MAP_20_u2_u1_u1 65535. _CNV_A_R_LINEAR_____0_CM 0. 65535. DISPLAY_IDENTIFIER ID_IDX_ACT_DS_CONF FORMAT "%5.0"
 /begin AXIS_DESCR COM_AXIS online_dummy _CNV_A_R_LINEAR_____0_CM 70 0. 255. FORMAT "%3.0" AXIS_PTS_REF ldp_idx_ds_id_idx_act_ds_conf /end AXIS_DESCR
 /begin AXIS_DESCR COM_AXIS online_dummy _CNV_A_R_LINEAR_____0_CM 4 0. 255. FORMAT "%3.0" AXIS_PTS_REF ldp_idx_envd_id_idx_act_ds_conf /end AXIS_DESCR
/end CHARACTERISTIC
/begin AXIS_PTS ldp_idx_envd_id_idx_act_ds_conf "" 0xa1020bd4 online_dummy _REC_AXS_20_u1 255. _CNV_A_R_LINEAR_____0_CM 4 0. 255. FORMAT "%3.0" /end AXIS_PTS
/begin AXIS_PTS ldp_idx_ds_id_idx_act_ds_conf "" 0xa1020b8c online_dummy _REC_AXS_20_u1 255. _CNV_A_R_LINEAR_____0_CM 70 0. 255. FORMAT "%3.0" /end AXIS_PTS
/begin CHARACTERISTIC c_n_max_kwp "max engine speed for accepting a KWP2000(*) service" VALUE 0xa1029628 _REC_VAL_20_u2 8160. _CNV_A_R_LINEAR_____13_CM 0. 8160. DISPLAY_IDENTIFIER C_N_MAX_KWP FORMAT "%4.0" /end CHARACTERISTIC
/begin CHARACTERISTIC c_n_min_kwp "min engine speed for accepting a KWP2000(*) service" VALUE 0xa1029636 _REC_VAL_20_u2 8160. _CNV_A_R_LINEAR_____13_CM 0. 8160. DISPLAY_IDENTIFIER C_N_MIN_KWP FORMAT "%4.0" /end CHARACTERISTIC
/begin CHARACTERISTIC c_tco_max_kwp "maximum TCO threshold for activation of external adjustment" VALUE 0xa10299d5 _REC_VAL_20_u1 190.5 _CNV_A_R_LINEAR_____16_CM -48. 142.5 DISPLAY_IDENTIFIER C_TCO_MAX_KWP FORMAT "%5.1" /end CHARACTERISTIC
/begin CHARACTERISTIC c_tco_min_kwp "minimum TCO threshold for activation of external adjustment" VALUE 0xa10299e4 _REC_VAL_20_u1 190.5 _CNV_A_R_LINEAR_____16_CM -48. 142.5 DISPLAY_IDENTIFIER C_TCO_MIN_KWP FORMAT "%5.1" /end CHARACTERISTIC
/begin CHARACTERISTIC c_vs_max_kwp "maximum vehicle speed for accepting the service" VALUE 0xa1029caf _REC_VAL_20_u1 255. _CNV_A_R_LINEAR_____6_CM 0. 255. DISPLAY_IDENTIFIER C_VS_MAX_KWP FORMAT "%3.0" /end CHARACTERISTIC
/begin CHARACTERISTIC c_vb_min_kwp "Battery Voltage" VALUE 0xa1029bde _REC_VAL_20_u1 25.8984375 _CNV_A_R_LINEAR_____289_CM 0. 25.8984375 DISPLAY_IDENTIFIER C_VB_MIN_KWP FORMAT "%9.6" /end CHARACTERISTIC
/begin MEASUREMENT lv_fhw_rst "boolean for reset of wrong used pedal unit" UBYTE _CNV_S_2_RANGE__0___1_CM 1 100. 0. 1. DISPLAY_IDENTIFIER LV_FHW_RST ECU_ADDRESS 0xd00040d5 BIT_MASK 0x1 /end MEASUREMENT
/begin MEASUREMENT lv_poil_sp_ext_adj "activation of external adjustment by InputOutputControl" UBYTE _CNV_S_2_RANGE__0___1_CM 1 100. 0. 1. DISPLAY_IDENTIFIER LV_POIL_SP_EXT_ADJ ECU_ADDRESS 0xd0004072 BIT_MASK 0x1 /end MEASUREMENT
/begin MEASUREMENT lv_poil_pwm_ext_adj "activation of external adjustment by InputOutputControl" UBYTE _CNV_S_2_RANGE__0___1_CM 1 100. 0. 1. DISPLAY_IDENTIFIER LV_POIL_PWM_EXT_ADJ ECU_ADDRESS 0xd0004073 BIT_MASK 0x1 /end MEASUREMENT
/begin MEASUREMENT lv_rly_crcv_heat_ext_adj "Request of tester for external adjustment of crankcase ventilation heater relay" UBYTE _CNV_S_2_RANGE__0___1_CM 1 100. 0. 1. DISPLAY_IDENTIFIER LV_RLY_CRCV_HEAT_EXT_ADJ ECU_ADDRESS 0xd0004075 BIT_MASK 0x1 /end MEASUREMENT
/begin MEASUREMENT lv_act_rly_crcv_heat_ext_adj "Command from tester for switching crankcase ventilation heater relay (0 = off, 1 = on)" UBYTE _CNV_S_2_RANGE__0___1_CM 1 100. 0. 1. DISPLAY_IDENTIFIER LV_ACT_RLY_CRCV_HEAT_EXT_ADJ ECU_ADDRESS 0xd0004076 BIT_MASK 0x1 /end MEASUREMENT
/begin MEASUREMENT lv_rly_main_ext_adj "Request of tester for main relay adjustment" UBYTE _CNV_S_2_RANGE__0___1_CM 1 100. 0. 1. DISPLAY_IDENTIFIER LV_RLY_MAIN_EXT_ADJ ECU_ADDRESS 0xd000406d BIT_MASK 0x1 /end MEASUREMENT
/begin MEASUREMENT lv_act_rly_main_ext_adj "Command from tester for switching main relay (0 = off, 1 = on)" UBYTE _CNV_S_2_RANGE__0___1_CM 1 100. 0. 1. DISPLAY_IDENTIFIER LV_ACT_RLY_MAIN_EXT_ADJ ECU_ADDRESS 0xd000406e BIT_MASK 0x1 /end MEASUREMENT
/begin MEASUREMENT lv_v_alter_sp_ext_adj "activation of external adjustment by InputOutputControl" UBYTE _CNV_S_2_RANGE__0___1_CM 1 100. 0. 1. DISPLAY_IDENTIFIER LV_V_ALTER_SP_EXT_ADJ ECU_ADDRESS 0xd0004071 BIT_MASK 0x1 /end MEASUREMENT
/begin MEASUREMENT v_alter_sp_ext_adj "adjustment value for alternator voltage setpoint" UWORD _CNV_A_R_LINEAR_____440_CM 1 100. 0. 6553.5 DISPLAY_IDENTIFIER V_ALTER_SP_EXT_ADJ ECU_ADDRESS 0xd0005484 FORMAT "%6.1" /end MEASUREMENT
/begin MEASUREMENT lv_vim_2_ext_adj "activation of external adjustment by InputOutputControl" UBYTE _CNV_S_2_RANGE__0___1_CM 1 100. 0. 1. DISPLAY_IDENTIFIER LV_VIM_2_EXT_ADJ ECU_ADDRESS 0xd0004077 BIT_MASK 0x1 /end MEASUREMENT
/begin MEASUREMENT lv_act_vim_2_ext_adj "adjustment value for DISA2  0 = closed, 1 = open" UBYTE _CNV_S_2_RANGE__0___1_CM 1 100. 0. 1. DISPLAY_IDENTIFIER LV_ACT_VIM_2_EXT_ADJ ECU_ADDRESS 0xd0004078 BIT_MASK 0x1 /end MEASUREMENT
/begin MEASUREMENT lv_n_rel_cwp_sp_ext_adj "activation of external adjustment by InputOutputControl" UBYTE _CNV_S_2_RANGE__0___1_CM 1 100. 0. 1. DISPLAY_IDENTIFIER LV_N_REL_CWP_SP_EXT_ADJ ECU_ADDRESS 0xd0004079 BIT_MASK 0x1 /end MEASUREMENT
/begin MEASUREMENT n_rel_cwp_sp_ext_adj "adjustment value for speed of electrical water pump" UBYTE _CNV_A_R_LINEAR_____5_CM 1 100. 0. 99.609375 DISPLAY_IDENTIFIER N_REL_CWP_SP_EXT_ADJ ECU_ADDRESS 0xd000407a FORMAT "%5.1" /end MEASUREMENT
/begin MEASUREMENT lv_ef_ext_adj "Activation of external adjustment by InputOutputControl" UBYTE _CNV_S_2_RANGE__0___1_CM 1 100. 0. 1. DISPLAY_IDENTIFIER LV_EF_EXT_ADJ ECU_ADDRESS 0xd000407b BIT_MASK 0x1 /end MEASUREMENT
/begin MEASUREMENT lv_act_ef_ext_adj "adjustment value for Exhaust Flap 0=off, 1=on" UBYTE _CNV_S_2_RANGE__0___1_CM 1 100. 0. 1. DISPLAY_IDENTIFIER LV_ACT_EF_EXT_ADJ ECU_ADDRESS 0xd000407c BIT_MASK 0x1 /end MEASUREMENT
/begin MEASUREMENT lv_sof_ext_adj "activation of external adjustment by InputOutputControl" UBYTE _CNV_S_2_RANGE__0___1_CM 1 100. 0. 1. DISPLAY_IDENTIFIER LV_SOF_EXT_ADJ ECU_ADDRESS 0xd000407d BIT_MASK 0x1 /end MEASUREMENT
/begin MEASUREMENT lv_act_sof_ext_adj "adjustment value for sound flap 0 = off, 1 = on" UBYTE _CNV_S_2_RANGE__0___1_CM 1 100. 0. 1. DISPLAY_IDENTIFIER LV_ACT_SOF_EXT_ADJ ECU_ADDRESS 0xd000407e BIT_MASK 0x1 /end MEASUREMENT
/begin MEASUREMENT lv_ecras_ext_adj "activation of external adjustment by InputOutputControl" UBYTE _CNV_S_2_RANGE__0___1_CM 1 100. 0. 1. DISPLAY_IDENTIFIER LV_ECRAS_EXT_ADJ ECU_ADDRESS 0xd000407f BIT_MASK 0x1 /end MEASUREMENT
/begin MEASUREMENT lv_act_ecras_ext_adj "adjustment value for radiator shutters 0 = off, 1 = on" UBYTE _CNV_S_2_RANGE__0___1_CM 1 100. 0. 1. DISPLAY_IDENTIFIER LV_ACT_ECRAS_EXT_ADJ ECU_ADDRESS 0xd0004080 BIT_MASK 0x1 /end MEASUREMENT
/begin MEASUREMENT lv_rly_st_ext_adj "activation of external adjustment by InputOutputControl" UBYTE _CNV_S_2_RANGE__0___1_CM 1 100. 0. 1. DISPLAY_IDENTIFIER LV_RLY_ST_EXT_ADJ ECU_ADDRESS 0xd0004081 BIT_MASK 0x1 /end MEASUREMENT
/begin MEASUREMENT lv_act_rly_st_ext_adj "adjustment value for starter relay 0 = off, 1 = on" UBYTE _CNV_S_2_RANGE__0___1_CM 1 100. 0. 1. DISPLAY_IDENTIFIER LV_ACT_RLY_ST_EXT_ADJ ECU_ADDRESS 0xd0004082 BIT_MASK 0x1 /end MEASUREMENT
/begin MEASUREMENT lv_vim_1_ext_adj "activation of external adjustment by InputOutputControl" UBYTE _CNV_S_2_RANGE__0___1_CM 1 100. 0. 1. DISPLAY_IDENTIFIER LV_VIM_1_EXT_ADJ ECU_ADDRESS 0xd0004083 BIT_MASK 0x1 /end MEASUREMENT
/begin MEASUREMENT lv_act_vim_1_ext_adj "adjustment value for DISA1  0 = closed, 1 = open" UBYTE _CNV_S_2_RANGE__0___1_CM 1 100. 0. 1. DISPLAY_IDENTIFIER LV_ACT_VIM_1_EXT_ADJ ECU_ADDRESS 0xd0004084 BIT_MASK 0x1 /end MEASUREMENT
/begin MEASUREMENT lv_accout_rly_ext_adj "activation of external adjustment by InputOutputControl" UBYTE _CNV_S_2_RANGE__0___1_CM 1 100. 0. 1. DISPLAY_IDENTIFIER LV_ACCOUT_RLY_EXT_ADJ ECU_ADDRESS 0xd0004085 BIT_MASK 0x1 /end MEASUREMENT
/begin MEASUREMENT lv_act_accout_rly_ext_adj "adjustment value for ACC-Relay  0=off, 1=on" UBYTE _CNV_S_2_RANGE__0___1_CM 1 100. 0. 1. DISPLAY_IDENTIFIER LV_ACT_ACCOUT_RLY_EXT_ADJ ECU_ADDRESS 0xd0004086 BIT_MASK 0x1 /end MEASUREMENT
/begin MEASUREMENT lv_ebox_cfa_ext_adj "activation of external adjustment by InputOutputControl" UBYTE _CNV_S_2_RANGE__0___1_CM 1 100. 0. 1. DISPLAY_IDENTIFIER LV_EBOX_CFA_EXT_ADJ ECU_ADDRESS 0xd0004087 BIT_MASK 0x1 /end MEASUREMENT
/begin MEASUREMENT lv_act_ebox_cfa_ext_adj "adjustment value for ebox cooling fan  0 = off, 1 = on" UBYTE _CNV_S_2_RANGE__0___1_CM 1 100. 0. 1. DISPLAY_IDENTIFIER LV_ACT_EBOX_CFA_EXT_ADJ ECU_ADDRESS 0xd0004088 BIT_MASK 0x1 /end MEASUREMENT
/begin MEASUREMENT lv_ectpwm_ext_adj "activation of  the external adjustment by InputOutputControl" UBYTE _CNV_S_2_RANGE__0___1_CM 1 100. 0. 1. DISPLAY_IDENTIFIER LV_ECTPWM_EXT_ADJ ECU_ADDRESS 0xd0004089 BIT_MASK 0x1 /end MEASUREMENT
/begin MEASUREMENT ectpwm_ext_adj "PWM output signal for the electronic controlled thermostat in case of external adjustment" UBYTE _CNV_A_R_LINEAR_____5_CM 1 100. 0. 99.609375 DISPLAY_IDENTIFIER ECTPWM_EXT_ADJ ECU_ADDRESS 0xd000408a FORMAT "%5.1" /end MEASUREMENT
/begin MEASUREMENT lv_sav_ext_adj "activation of external adjustment by InputOutputControl" UBYTE _CNV_S_2_RANGE__0___1_CM 1 100. 0. 1. DISPLAY_IDENTIFIER LV_SAV_EXT_ADJ ECU_ADDRESS 0xd000408b BIT_MASK 0x1 /end MEASUREMENT
/begin MEASUREMENT lv_act_sav_ext_adj "adjustment value for SAV  0 = off, 1 = on" UBYTE _CNV_S_2_RANGE__0___1_CM 1 100. 0. 1. DISPLAY_IDENTIFIER LV_ACT_SAV_EXT_ADJ ECU_ADDRESS 0xd000408c BIT_MASK 0x1 /end MEASUREMENT
/begin MEASUREMENT lv_sap_ext_adj "activation of external adjustment by InputOutputControl" UBYTE _CNV_S_2_RANGE__0___1_CM 1 100. 0. 1. DISPLAY_IDENTIFIER LV_SAP_EXT_ADJ ECU_ADDRESS 0xd000408d BIT_MASK 0x1 /end MEASUREMENT
/begin MEASUREMENT lv_act_sap_ext_adj "adjustment value for SAP  0 = off, 1 = on" UBYTE _CNV_S_2_RANGE__0___1_CM 1 100. 0. 1. DISPLAY_IDENTIFIER LV_ACT_SAP_EXT_ADJ ECU_ADDRESS 0xd000408e BIT_MASK 0x1 /end MEASUREMENT
/begin MEASUREMENT lv_dmtl_pump_ext_adj "activation of external adjustment by InputOutputControl" UBYTE _CNV_S_2_RANGE__0___1_CM 1 100. 0. 1. DISPLAY_IDENTIFIER LV_DMTL_PUMP_EXT_ADJ ECU_ADDRESS 0xd000408f BIT_MASK 0x1 /end MEASUREMENT
/begin MEASUREMENT lv_act_dmtl_pump_ext_adj "adjustment value for DMTL pump  0 = off, 1 = on" UBYTE _CNV_S_2_RANGE__0___1_CM 1 100. 0. 1. DISPLAY_IDENTIFIER LV_ACT_DMTL_PUMP_EXT_ADJ ECU_ADDRESS 0xd0004090 BIT_MASK 0x1 /end MEASUREMENT
/begin MEASUREMENT lv_dmtls_ext_adj "activation of external adjustment by InputOutputControl" UBYTE _CNV_S_2_RANGE__0___1_CM 1 100. 0. 1. DISPLAY_IDENTIFIER LV_DMTLS_EXT_ADJ ECU_ADDRESS 0xd0004091 BIT_MASK 0x1 /end MEASUREMENT
/begin MEASUREMENT lv_act_dmtls_ext_adj "adjustment value for DMTL solenoid  0 = off, 1 = on" UBYTE _CNV_S_2_RANGE__0___1_CM 1 100. 0. 1. DISPLAY_IDENTIFIER LV_ACT_DMTLS_EXT_ADJ ECU_ADDRESS 0xd0004092 BIT_MASK 0x1 /end MEASUREMENT
/begin MEASUREMENT lv_dmtlh_ext_adj "activation of external adjustment by InputOutputControl" UBYTE _CNV_S_2_RANGE__0___1_CM 1 100. 0. 1. DISPLAY_IDENTIFIER LV_DMTLH_EXT_ADJ ECU_ADDRESS 0xd0004093 BIT_MASK 0x1 /end MEASUREMENT
/begin MEASUREMENT lv_act_dmtlh_ext_adj "adjustment value for DMTL heater  0 = off, 1 = on" UBYTE _CNV_S_2_RANGE__0___1_CM 1 100. 0. 1. DISPLAY_IDENTIFIER LV_ACT_DMTLH_EXT_ADJ ECU_ADDRESS 0xd0004094 BIT_MASK 0x1 /end MEASUREMENT
/begin MEASUREMENT lv_cppwm_ext_adj "activation of external adjustment by InputOutputControl" UBYTE _CNV_S_2_RANGE__0___1_CM 1 100. 0. 1. DISPLAY_IDENTIFIER LV_CPPWM_EXT_ADJ ECU_ADDRESS 0xd0004095 BIT_MASK 0x1 /end MEASUREMENT
/begin MEASUREMENT cppwm_ext_adj "adjustment value for canister purge valve" UBYTE _CNV_A_R_LINEAR_____5_CM 1 100. 0. 99.609375 DISPLAY_IDENTIFIER CPPWM_EXT_ADJ ECU_ADDRESS 0xd0004096 FORMAT "%5.1" /end MEASUREMENT
/begin MEASUREMENT lv_lshpwm_up_ext_adj[0] "activation of external adjustment by InputOutputControl" UBYTE _CNV_S_2_RANGE__0___1_CM 1 100. 0. 1. DISPLAY_IDENTIFIER LV_LSHPWM_UP_EXT_ADJ[1] ECU_ADDRESS 0xd0004098 /end MEASUREMENT
/begin MEASUREMENT lv_lshpwm_up_ext_adj[1] "activation of external adjustment by InputOutputControl" UBYTE _CNV_S_2_RANGE__0___1_CM 1 100. 0. 1. DISPLAY_IDENTIFIER LV_LSHPWM_UP_EXT_ADJ[2] ECU_ADDRESS 0xd0004099 /end MEASUREMENT
/begin MEASUREMENT lshpwm_up_ext_adj[0] "adjustment value for Lambda" UBYTE _CNV_A_R_LINEAR_____5_CM 1 100. 0. 99.609375 DISPLAY_IDENTIFIER LSHPWM_UP_EXT_ADJ[1] ECU_ADDRESS 0xd000409a FORMAT "%5.1" /end MEASUREMENT
/begin MEASUREMENT lshpwm_up_ext_adj[1] "adjustment value for Lambda" UBYTE _CNV_A_R_LINEAR_____5_CM 1 100. 0. 99.609375 DISPLAY_IDENTIFIER LSHPWM_UP_EXT_ADJ[2] ECU_ADDRESS 0xd000409b FORMAT "%5.1" /end MEASUREMENT
/begin MEASUREMENT lv_lshpwm_down_ext_adj[0] "activation of external adjustment by InputOutputControl" UBYTE _CNV_S_2_RANGE__0___1_CM 1 100. 0. 1. DISPLAY_IDENTIFIER LV_LSHPWM_DOWN_EXT_ADJ[1] ECU_ADDRESS 0xd000409c /end MEASUREMENT
/begin MEASUREMENT lv_lshpwm_down_ext_adj[1] "activation of external adjustment by InputOutputControl" UBYTE _CNV_S_2_RANGE__0___1_CM 1 100. 0. 1. DISPLAY_IDENTIFIER LV_LSHPWM_DOWN_EXT_ADJ[2] ECU_ADDRESS 0xd000409d /end MEASUREMENT
/begin MEASUREMENT lshpwm_down_ext_adj[0] "adjustment value for Lambda" UBYTE _CNV_A_R_LINEAR_____5_CM 1 100. 0. 99.609375 DISPLAY_IDENTIFIER LSHPWM_DOWN_EXT_ADJ[1] ECU_ADDRESS 0xd000409e FORMAT "%5.1" /end MEASUREMENT
/begin MEASUREMENT lshpwm_down_ext_adj[1] "adjustment value for Lambda" UBYTE _CNV_A_R_LINEAR_____5_CM 1 100. 0. 99.609375 DISPLAY_IDENTIFIER LSHPWM_DOWN_EXT_ADJ[2] ECU_ADDRESS 0xd000409f FORMAT "%5.1" /end MEASUREMENT
/begin MEASUREMENT lv_mil_ext_adj "activation of external adjustment by InputOutputControl" UBYTE _CNV_S_2_RANGE__0___1_CM 1 100. 0. 1. DISPLAY_IDENTIFIER LV_MIL_EXT_ADJ ECU_ADDRESS 0xd0003560 BIT_MASK 0x1 /end MEASUREMENT
/begin MEASUREMENT lv_act_mil_ext_adj "adjustment value for MIL  1 = active 0 = inactive" UBYTE _CNV_S_2_RANGE__0___1_CM 1 100. 0. 1. DISPLAY_IDENTIFIER LV_ACT_MIL_EXT_ADJ ECU_ADDRESS 0xd0003561 BIT_MASK 0x1 /end MEASUREMENT
/begin MEASUREMENT lv_cru_ext_adj "activation of external adjustment by InputOutputControl" UBYTE _CNV_S_2_RANGE__0___1_CM 1 100. 0. 1. DISPLAY_IDENTIFIER LV_CRU_EXT_ADJ ECU_ADDRESS 0xd00040a0 BIT_MASK 0x1 /end MEASUREMENT
/begin MEASUREMENT lv_act_cru_ext_adj "switch for the function InputOutputControl 1 = active 0 = deactive" UBYTE _CNV_S_2_RANGE__0___1_CM 1 100. 0. 1. DISPLAY_IDENTIFIER LV_ACT_CRU_EXT_ADJ ECU_ADDRESS 0xd00040a1 BIT_MASK 0x1 /end MEASUREMENT
/begin MEASUREMENT lv_wal_1_ext_adj "activation of external adjustment by InputOutputControl" UBYTE _CNV_S_2_RANGE__0___1_CM 1 100. 0. 1. DISPLAY_IDENTIFIER LV_WAL_1_EXT_ADJ ECU_ADDRESS 0xd00040a2 BIT_MASK 0x1 /end MEASUREMENT
/begin MEASUREMENT lv_act_wal_1_ext_adj "adjustment value for SAP  0 = off, 1 = on" UBYTE _CNV_S_2_RANGE__0___1_CM 1 100. 0. 1. DISPLAY_IDENTIFIER LV_ACT_WAL_1_EXT_ADJ ECU_ADDRESS 0xd00040a3 BIT_MASK 0x1 /end MEASUREMENT
/begin MEASUREMENT lv_efp_ext_adj "activation of external adjustment by InputOutputControl" UBYTE _CNV_S_2_RANGE__0___1_CM 1 100. 0. 1. DISPLAY_IDENTIFIER LV_EFP_EXT_ADJ ECU_ADDRESS 0xd00040a4 BIT_MASK 0x1 /end MEASUREMENT
/begin MEASUREMENT efppwm_ext_adj "Electric fuel pump PWM-signal for the function InputOutputControl" UBYTE _CNV_A_R_LINEAR_____5_CM 1 100. 0. 99.609375 DISPLAY_IDENTIFIER EFPPWM_EXT_ADJ ECU_ADDRESS 0xd00040a5 FORMAT "%5.1" /end MEASUREMENT
/begin MEASUREMENT lv_ecfpwm_ecf_ext_adj "activation of external adjustment by InputOutputControl" UBYTE _CNV_S_2_RANGE__0___1_CM 1 100. 0. 1. DISPLAY_IDENTIFIER LV_ECFPWM_ECF_EXT_ADJ ECU_ADDRESS 0xd00040a6 BIT_MASK 0x1 /end MEASUREMENT
/begin MEASUREMENT ecfpwm_ecf_ext_adj "Electric fan control PWM-signal for the function InputOutputControl" UBYTE _CNV_A_R_LINEAR_____5_CM 1 100. 0. 99.609375 DISPLAY_IDENTIFIER ECFPWM_ECF_EXT_ADJ ECU_ADDRESS 0xd00040a7 FORMAT "%5.1" /end MEASUREMENT
/begin MEASUREMENT lv_rly_vvl_ext_adj "activation of external adjustment by InputOutputControl" UBYTE _CNV_S_2_RANGE__0___1_CM 1 100. 0. 1. DISPLAY_IDENTIFIER LV_RLY_VVL_EXT_ADJ ECU_ADDRESS 0xd00040a8 BIT_MASK 0x1 /end MEASUREMENT
/begin MEASUREMENT lv_act_rly_vvl_ext_adj "adjustment value for VVL relay  0 = off, 1 = on" UBYTE _CNV_S_2_RANGE__0___1_CM 1 100. 0. 1. DISPLAY_IDENTIFIER LV_ACT_RLY_VVL_EXT_ADJ ECU_ADDRESS 0xd00040a9 BIT_MASK 0x1 /end MEASUREMENT
/begin MEASUREMENT lv_iv_ext_adj[0] "activation of external adjustment by InputOutputControl" UBYTE _CNV_S_2_RANGE__0___1_CM 1 100. 0. 1. DISPLAY_IDENTIFIER LV_IV_EXT_ADJ[0] ECU_ADDRESS 0xd00040ac BIT_MASK 0x1 /end MEASUREMENT
/begin MEASUREMENT lv_iv_ext_adj[1] "activation of external adjustment by InputOutputControl" UBYTE _CNV_S_2_RANGE__0___1_CM 1 100. 0. 1. DISPLAY_IDENTIFIER LV_IV_EXT_ADJ[1] ECU_ADDRESS 0xd00040ad BIT_MASK 0x1 /end MEASUREMENT
/begin MEASUREMENT lv_iv_ext_adj[2] "activation of external adjustment by InputOutputControl" UBYTE _CNV_S_2_RANGE__0___1_CM 1 100. 0. 1. DISPLAY_IDENTIFIER LV_IV_EXT_ADJ[2] ECU_ADDRESS 0xd00040ae BIT_MASK 0x1 /end MEASUREMENT
/begin MEASUREMENT lv_iv_ext_adj[3] "activation of external adjustment by InputOutputControl" UBYTE _CNV_S_2_RANGE__0___1_CM 1 100. 0. 1. DISPLAY_IDENTIFIER LV_IV_EXT_ADJ[3] ECU_ADDRESS 0xd00040af BIT_MASK 0x1 /end MEASUREMENT
/begin MEASUREMENT lv_iv_ext_adj[4] "activation of external adjustment by InputOutputControl" UBYTE _CNV_S_2_RANGE__0___1_CM 1 100. 0. 1. DISPLAY_IDENTIFIER LV_IV_EXT_ADJ[4] ECU_ADDRESS 0xd00040b0 BIT_MASK 0x1 /end MEASUREMENT
/begin MEASUREMENT lv_iv_ext_adj[5] "activation of external adjustment by InputOutputControl" UBYTE _CNV_S_2_RANGE__0___1_CM 1 100. 0. 1. DISPLAY_IDENTIFIER LV_IV_EXT_ADJ[5] ECU_ADDRESS 0xd00040b1 BIT_MASK 0x1 /end MEASUREMENT
/begin MEASUREMENT iv_per_ext_adj[0] "Injection time cylinder individual at external adjustment" UBYTE _CNV_A_R_LINEAR_____18_CM 1 100. 0. 2550. DISPLAY_IDENTIFIER IV_PER_EXT_ADJ[0] ECU_ADDRESS 0xd00040b2 FORMAT "%4.0" /end MEASUREMENT
/begin MEASUREMENT iv_per_ext_adj[1] "Injection time cylinder individual at external adjustment" UBYTE _CNV_A_R_LINEAR_____18_CM 1 100. 0. 2550. DISPLAY_IDENTIFIER IV_PER_EXT_ADJ[1] ECU_ADDRESS 0xd00040b3 FORMAT "%4.0" /end MEASUREMENT
/begin MEASUREMENT iv_per_ext_adj[2] "Injection time cylinder individual at external adjustment" UBYTE _CNV_A_R_LINEAR_____18_CM 1 100. 0. 2550. DISPLAY_IDENTIFIER IV_PER_EXT_ADJ[2] ECU_ADDRESS 0xd00040b4 FORMAT "%4.0" /end MEASUREMENT
/begin MEASUREMENT iv_per_ext_adj[3] "Injection time cylinder individual at external adjustment" UBYTE _CNV_A_R_LINEAR_____18_CM 1 100. 0. 2550. DISPLAY_IDENTIFIER IV_PER_EXT_ADJ[3] ECU_ADDRESS 0xd00040b5 FORMAT "%4.0" /end MEASUREMENT
/begin MEASUREMENT iv_per_ext_adj[4] "Injection time cylinder individual at external adjustment" UBYTE _CNV_A_R_LINEAR_____18_CM 1 100. 0. 2550. DISPLAY_IDENTIFIER IV_PER_EXT_ADJ[4] ECU_ADDRESS 0xd00040b6 FORMAT "%4.0" /end MEASUREMENT
/begin MEASUREMENT iv_per_ext_adj[5] "Injection time cylinder individual at external adjustment" UBYTE _CNV_A_R_LINEAR_____18_CM 1 100. 0. 2550. DISPLAY_IDENTIFIER IV_PER_EXT_ADJ[5] ECU_ADDRESS 0xd00040b7 FORMAT "%4.0" /end MEASUREMENT
/begin MEASUREMENT iv_ext_adj[0] "Injection time cylinder individual at external adjustment" UBYTE _CNV_A_R_LINEAR_____441_CM 1 100. 0. 20.4 DISPLAY_IDENTIFIER IV_EXT_ADJ[0] ECU_ADDRESS 0xd00040b8 FORMAT "%5.2" /end MEASUREMENT
/begin MEASUREMENT iv_ext_adj[1] "Injection time cylinder individual at external adjustment" UBYTE _CNV_A_R_LINEAR_____441_CM 1 100. 0. 20.4 DISPLAY_IDENTIFIER IV_EXT_ADJ[1] ECU_ADDRESS 0xd00040b9 FORMAT "%5.2" /end MEASUREMENT
/begin MEASUREMENT iv_ext_adj[2] "Injection time cylinder individual at external adjustment" UBYTE _CNV_A_R_LINEAR_____441_CM 1 100. 0. 20.4 DISPLAY_IDENTIFIER IV_EXT_ADJ[2] ECU_ADDRESS 0xd00040ba FORMAT "%5.2" /end MEASUREMENT
/begin MEASUREMENT iv_ext_adj[3] "Injection time cylinder individual at external adjustment" UBYTE _CNV_A_R_LINEAR_____441_CM 1 100. 0. 20.4 DISPLAY_IDENTIFIER IV_EXT_ADJ[3] ECU_ADDRESS 0xd00040bb FORMAT "%5.2" /end MEASUREMENT
/begin MEASUREMENT iv_ext_adj[4] "Injection time cylinder individual at external adjustment" UBYTE _CNV_A_R_LINEAR_____441_CM 1 100. 0. 20.4 DISPLAY_IDENTIFIER IV_EXT_ADJ[4] ECU_ADDRESS 0xd00040bc FORMAT "%5.2" /end MEASUREMENT
/begin MEASUREMENT iv_ext_adj[5] "Injection time cylinder individual at external adjustment" UBYTE _CNV_A_R_LINEAR_____441_CM 1 100. 0. 20.4 DISPLAY_IDENTIFIER IV_EXT_ADJ[5] ECU_ADDRESS 0xd00040bd FORMAT "%5.2" /end MEASUREMENT
/begin MEASUREMENT lv_cam_sp_in_ext_adj "activation of external adjustment by InputOutputControl" UBYTE _CNV_S_2_RANGE__0___1_CM 1 100. 0. 1. DISPLAY_IDENTIFIER LV_CAM_SP_IN_EXT_ADJ ECU_ADDRESS 0xd00040be BIT_MASK 0x1 /end MEASUREMENT
/begin MEASUREMENT cam_sp_in_ext_adj "Output signal from the module actuator diagnosis to the function" UWORD _CNV_A_R_LINEAR_____442_CM 1 100. -128. 52300. DISPLAY_IDENTIFIER CAM_SP_IN_EXT_ADJ ECU_ADDRESS 0xd0005486 FORMAT "%7.1" /end MEASUREMENT
/begin MEASUREMENT lv_cam_sp_ex_ext_adj "activation of external adjustment by InputOutputControl" UBYTE _CNV_S_2_RANGE__0___1_CM 1 100. 0. 1. DISPLAY_IDENTIFIER LV_CAM_SP_EX_EXT_ADJ ECU_ADDRESS 0xd00040bf BIT_MASK 0x1 /end MEASUREMENT
/begin MEASUREMENT cam_sp_ex_ext_adj "Output signal from the module actuator diagnosis to the function" UWORD _CNV_A_R_LINEAR_____442_CM 1 100. -128. 52300. DISPLAY_IDENTIFIER CAM_SP_EX_EXT_ADJ ECU_ADDRESS 0xd0005488 FORMAT "%7.1" /end MEASUREMENT
/begin MEASUREMENT lv_ad_dis_ext_adj "boolean for disable adaptions while active external adjust" UBYTE _CNV_S_2_RANGE__0___1_CM 1 100. 0. 1. DISPLAY_IDENTIFIER LV_AD_DIS_EXT_ADJ ECU_ADDRESS 0xd000406c BIT_MASK 0x1 /end MEASUREMENT
/begin MEASUREMENT lv_inh_lam_kwp "Switch off condition for lambda control via KWP2000  /  01= disabled 00=enabled" UBYTE _CNV_S_2_RANGE__0___1_CM 1 100. 0. 1. DISPLAY_IDENTIFIER LV_INH_LAM_KWP ECU_ADDRESS 0xd0004064 BIT_MASK 0x1 /end MEASUREMENT
/begin MEASUREMENT qoil_ds_rst_kwp_1 "Reset oil quality via tester" UBYTE _CNV_A_R_LINEAR_____0_CM 1 100. 0. 255. DISPLAY_IDENTIFIER QOIL_DS_RST_KWP_1 ECU_ADDRESS 0xd00040cc FORMAT "%3.0" /end MEASUREMENT
/begin MEASUREMENT qoil_ds_rst_kwp_2 "Reset availability via tester" UBYTE _CNV_A_R_LINEAR_____0_CM 1 100. 0. 255. DISPLAY_IDENTIFIER QOIL_DS_RST_KWP_2 ECU_ADDRESS 0xd00040cd FORMAT "%3.0" /end MEASUREMENT
/begin MEASUREMENT qoil_ds_rst_kwp_3 "Reset number of services via tester" UBYTE _CNV_A_R_LINEAR_____0_CM 1 100. 0. 255. DISPLAY_IDENTIFIER QOIL_DS_RST_KWP_3 ECU_ADDRESS 0xd00040ce FORMAT "%3.0" /end MEASUREMENT
/begin MEASUREMENT qoil_ds_rst_kwp_4 "Reset rest distance via tester" SWORD _CNV_R_R_Def_km_sw__64_CM 1 100. -327680. 327670. DISPLAY_IDENTIFIER QOIL_DS_RST_KWP_4 ECU_ADDRESS 0xd0005490 FORMAT "%6.1" /end MEASUREMENT
/begin MEASUREMENT qoil_ds_rst_kwp_5 "Reset forecast way clearance via tester" UBYTE _CNV_R_R_Def_km_ub__443_CM 1 100. 0. 255000. DISPLAY_IDENTIFIER QOIL_DS_RST_KWP_5 ECU_ADDRESS 0xd00040cf FORMAT "%3.0" /end MEASUREMENT
/begin MEASUREMENT qoil_ds_rst_kwp_6 "Reset target month via tester" UBYTE _CNV_A_R_LINEAR_____0_CM 1 100. 0. 255. DISPLAY_IDENTIFIER QOIL_DS_RST_KWP_6 ECU_ADDRESS 0xd00040d0 FORMAT "%3.0" /end MEASUREMENT
/begin MEASUREMENT qoil_ds_rst_kwp_7 "Reset target year via tester" UBYTE _CNV_A_R_LINEAR_____0_CM 1 100. 0. 255. DISPLAY_IDENTIFIER QOIL_DS_RST_KWP_7 ECU_ADDRESS 0xd00040d1 FORMAT "%3.0" /end MEASUREMENT
/begin MEASUREMENT qoil_ds_rst_kwp_8 "Reset forecast time clearance via tester" UBYTE _CNV_A_R_LINEAR_____0_CM 1 100. 0. 255. DISPLAY_IDENTIFIER QOIL_DS_RST_KWP_8 ECU_ADDRESS 0xd00040d2 FORMAT "%3.0" /end MEASUREMENT
/begin MEASUREMENT fac_oil_ext_req_1 "Country dependant factor for oil change intervall via tester" UBYTE _CNV_A_R_LINEAR_____404_CM 1 100. 0. 2.55 DISPLAY_IDENTIFIER FAC_OIL_EXT_REQ_1 ECU_ADDRESS 0xd00040d3 /end MEASUREMENT
/begin MEASUREMENT fac_oil_ext_req_2 "Country dependant factor for oil change intervall via tester" UBYTE _CNV_A_R_LINEAR_____404_CM 1 100. 0. 2.55 DISPLAY_IDENTIFIER FAC_OIL_EXT_REQ_2 ECU_ADDRESS 0xd00040d4 /end MEASUREMENT
/begin MEASUREMENT state_cmb_ctl_kwp "carrier byte state combustion control" UBYTE _CNV_A_R_LINEAR_____0_CM 1 100. 0. 255. DISPLAY_IDENTIFIER STATE_CMB_CTL_KWP ECU_ADDRESS 0xd00040c7 FORMAT "%3.0" /end MEASUREMENT
/begin MEASUREMENT state_cmb_ctl_nvmy_kwp "carrier byte state combustion control non volatile saved" UBYTE _CNV_A_R_LINEAR_____0_CM 1 100. 0. 255. DISPLAY_IDENTIFIER STATE_CMB_CTL_NVMY_KWP ECU_ADDRESS 0xd00040c8 FORMAT "%3.0" /end MEASUREMENT
/begin AXIS_PTS ldp_maf_cyl__amp_dec "" 0xa1020c60 maf_cyl _REC_AXS_20_u2 2047.96875 _CNV_A_R_LINEAR_____207_CM 4 0. 2047.96875 FORMAT "%6.2" /end AXIS_PTS
/begin MEASUREMENT put "Pressure upstream the throttle (Turbo)" UWORD _CNV_A_R_LINEAR_____26_CM 1 100. 0. 5434. DISPLAY_IDENTIFIER PUT ECU_ADDRESS 0xd0004da4 FORMAT "%7.2" /end MEASUREMENT
/begin MEASUREMENT put_max "Maximum pressure upstream the throttle (Turbo)" UWORD _CNV_A_R_LINEAR_____26_CM 1 100. 0. 5434. DISPLAY_IDENTIFIER PUT_MAX ECU_ADDRESS 0xd0004da6 FORMAT "%7.2" /end MEASUREMENT
/begin CHARACTERISTIC ip_amp_dec "pressure decrease in the air cleaner" CURVE 0xa1023060 _REC_CUR_20_u2_u2 5434. _CNV_A_R_LINEAR_____26_CM 0. 5434. DISPLAY_IDENTIFIER IP_AMP_DEC FORMAT "%7.2"
 /begin AXIS_DESCR COM_AXIS maf_cyl _CNV_A_R_LINEAR_____207_CM 4 0. 2047.96875 FORMAT "%6.2" AXIS_PTS_REF ldp_maf_cyl__amp_dec /end AXIS_DESCR
/end CHARACTERISTIC
/begin MEASUREMENT egr_ratio "MAF_EGR/MAF_CYL" UWORD _CNV_A_R_LINEAR_____7_CM 1 100. 0. 99.99847412109381 DISPLAY_IDENTIFIER EGR_RATIO ECU_ADDRESS 0xd0002c62 /end MEASUREMENT
/begin MEASUREMENT maf_cyl "Mass air flow out of intake manifold" UWORD _CNV_A_R_LINEAR_____207_CM 1 100. 0. 2047.96875 DISPLAY_IDENTIFIER MAF_CYL ECU_ADDRESS 0xd0002c6a FORMAT "%7.2" /end MEASUREMENT
/begin MEASUREMENT map "Manifold air pressure" UWORD _CNV_A_R_LINEAR_____26_CM 1 100. 0. 5434. DISPLAY_IDENTIFIER MAP ECU_ADDRESS 0xd0002c6e FORMAT "%7.2" /end MEASUREMENT
/begin MEASUREMENT maf "Air mass (predicted) for calculation of basic fuel injection" UWORD _CNV_A_R_LINEAR_____108_CM 1 100. 0. 1389. DISPLAY_IDENTIFIER MAF ECU_ADDRESS 0xd0002c7e FORMAT "%6.2" /end MEASUREMENT
/begin CHARACTERISTIC lc_maf_tcha_mes "Switch for calculation of Mshfm_ist/m by model (0) or by sensor (1), only for N54" VALUE 0xa1029d75 _REC_VAL_20_u1 1. _CNV_A_R_LINEAR_____0_CM 0. 1. DISPLAY_IDENTIFIER LC_MAF_TCHA_MES FORMAT "%1.0" /end CHARACTERISTIC
/begin CHARACTERISTIC c_fac_maf_tcha "Factor for conversion of mass air flow from one to two banks" VALUE 0xa102938c _REC_VAL_20_u2 3.99993896484375 _CNV_A_R_LINEAR_____23_CM 0. 3.99993896484375 DISPLAY_IDENTIFIER C_FAC_MAF_TCHA FORMAT "%7.5" /end CHARACTERISTIC
/begin MEASUREMENT maf_thr "theoretical value of air mass flow [kg/h]" UWORD _CNV_A_R_LINEAR_____207_CM 1 100. 0. 2047.96875 DISPLAY_IDENTIFIER MAF_THR ECU_ADDRESS 0xd0002c80 FORMAT "%7.2" /end MEASUREMENT
/begin MEASUREMENT cat_max_diag_mod_6 "Actually threshold for Scantool Mod 6 Output" UBYTE _CNV_A_R_LINEAR_____283_CM 1 100. 0. 1.984375 DISPLAY_IDENTIFIER CAT_MAX_DIAG_MOD_6 ECU_ADDRESS 0xd000384a FORMAT "%8.6" /end MEASUREMENT
/begin MEASUREMENT lv_inh_fup_mfp_plaus "Boolean flag to stop the plausibility check of FUP/MFP" UBYTE _CNV_S_2_RANGE__0___1_CM 1 100. 0. 1. DISPLAY_IDENTIFIER LV_INH_FUP_MFP_PLAUS ECU_ADDRESS 0xd00039e9 BIT_MASK 0x1 /end MEASUREMENT
/begin MEASUREMENT lv_inh_h_prs_sys "Boolean flag to stop the high pressure system monitoring" UBYTE _CNV_S_2_RANGE__0___1_CM 1 100. 0. 1. DISPLAY_IDENTIFIER LV_INH_H_PRS_SYS ECU_ADDRESS 0xd00039e8 BIT_MASK 0x1 /end MEASUREMENT
/begin MEASUREMENT lv_inh_vcv_plaus "Boolean flag to stop the VCV_PLAUS check" UBYTE _CNV_S_2_RANGE__0___1_CM 1 100. 0. 1. DISPLAY_IDENTIFIER LV_INH_VCV_PLAUS ECU_ADDRESS 0xd00039ea BIT_MASK 0x1 /end MEASUREMENT
/begin CHARACTERISTIC c_t_ast_h_prs_diag_inh "Inhibit time for deactivation of the high pressure system diagnosis" VALUE 0xa102980e _REC_VAL_20_u2 6553.5 _CNV_A_R_LINEAR_____4_CM 0. 6553.5 DISPLAY_IDENTIFIER C_T_AST_H_PRS_DIAG_INH FORMAT "%6.1" /end CHARACTERISTIC
/begin CHARACTERISTIC c_abc_inc_fup_mfp_plaus "Increment of the plausibility check of FUP/MFP anti-bounce counter" VALUE 0xa1029088 _REC_VAL_20_u1 255. _CNV_A_R_LINEAR_____0_CM 0. 255. DISPLAY_IDENTIFIER C_ABC_INC_FUP_MFP_PLAUS FORMAT "%3.0" /end CHARACTERISTIC
/begin CHARACTERISTIC c_abc_inc_h_prs_sys "Increment of high pressure system monitoring anti-bounce counter" VALUE 0xa102908b _REC_VAL_20_u1 255. _CNV_A_R_LINEAR_____0_CM 0. 255. DISPLAY_IDENTIFIER C_ABC_INC_H_PRS_SYS FORMAT "%3.0" /end CHARACTERISTIC
/begin CHARACTERISTIC c_abc_inc_vcv_plaus "Increment of the VCV adaptation check anti-bounce counter" VALUE 0xa10290d2 _REC_VAL_20_u1 255. _CNV_A_R_LINEAR_____0_CM 0. 255. DISPLAY_IDENTIFIER C_ABC_INC_VCV_PLAUS FORMAT "%3.0" /end CHARACTERISTIC
/begin CHARACTERISTIC c_abc_max_vcv_plaus "Threshold to be reached, before VCV adaptation check error" VALUE 0xa102915e _REC_VAL_20_u1 254. _CNV_A_R_LINEAR_____0_CM 1. 255. DISPLAY_IDENTIFIER C_ABC_MAX_VCV_PLAUS FORMAT "%3.0" /end CHARACTERISTIC
/begin CHARACTERISTIC c_abc_max_fup_mfp_plaus "Threshold to be reached, before plausibility check error of FUP/MFP" VALUE 0xa1029113 _REC_VAL_20_u1 254. _CNV_A_R_LINEAR_____0_CM 1. 255. DISPLAY_IDENTIFIER C_ABC_MAX_FUP_MFP_PLAUS FORMAT "%3.0" /end CHARACTERISTIC
/begin CHARACTERISTIC c_abc_max_h_prs_sys "Threshold to be reached, before permanently activating high pressure system monitoring error" VALUE 0xa1029116 _REC_VAL_20_u1 254. _CNV_A_R_LINEAR_____0_CM 1. 255. DISPLAY_IDENTIFIER C_ABC_MAX_H_PRS_SYS FORMAT "%3.0" /end CHARACTERISTIC
/begin MEASUREMENT lv_err_fup_mfp_plaus "Boolean that indicates inconsistencies between fuel pressure and mass fuel pump" UBYTE _CNV_S_2_RANGE__0___1_CM 1 100. 0. 1. DISPLAY_IDENTIFIER LV_ERR_FUP_MFP_PLAUS ECU_ADDRESS 0xd00034d1 BIT_MASK 0x1 /end MEASUREMENT
/begin MEASUREMENT lv_err_h_prs_sys "Boolean that indicates abnormal fuel pressure value in fuel system" UBYTE _CNV_S_2_RANGE__0___1_CM 1 100. 0. 1. DISPLAY_IDENTIFIER LV_ERR_H_PRS_SYS ECU_ADDRESS 0xd00034d2 BIT_MASK 0x1 /end MEASUREMENT
/begin MEASUREMENT lv_err_vcv_plaus "Boolean that indicates abnormal value of the  VCV adaptation" UBYTE _CNV_S_2_RANGE__0___1_CM 1 100. 0. 1. DISPLAY_IDENTIFIER LV_ERR_VCV_PLAUS ECU_ADDRESS 0xd00034d3 BIT_MASK 0x1 /end MEASUREMENT
/begin CHARACTERISTIC c_fup_bol_1 "Bottom fuel pressure threshold 1" VALUE 0xa1029412 _REC_VAL_20_u2 347776. _CNV_A_R_LINEAR_____152_CM 0. 347776. DISPLAY_IDENTIFIER C_FUP_BOL_1 FORMAT "%6.0" /end CHARACTERISTIC
/begin CHARACTERISTIC c_fup_tol_1 "Top fuel pressure threshold 1" VALUE 0xa1029486 _REC_VAL_20_u2 347776. _CNV_A_R_LINEAR_____152_CM 0. 347776. DISPLAY_IDENTIFIER C_FUP_TOL_1 FORMAT "%6.0" /end CHARACTERISTIC
/begin CHARACTERISTIC c_fup_tol_2 "Top fuel pressure threshold 2" VALUE 0xa1029488 _REC_VAL_20_u2 347776. _CNV_A_R_LINEAR_____152_CM 0. 347776. DISPLAY_IDENTIFIER C_FUP_TOL_2 FORMAT "%6.0" /end CHARACTERISTIC
/begin CHARACTERISTIC c_n_32_fup_diag "Minimum engine speed for FUP/FPAPWM plausibility check (Default value 800)" VALUE 0xa10295bc _REC_VAL_20_u1 8160. _CNV_A_R_LINEAR_____9_CM 0. 8160. DISPLAY_IDENTIFIER C_N_32_FUP_DIAG FORMAT "%4.0" /end CHARACTERISTIC
/begin CHARACTERISTIC c_n_32_fup_mfp_plaus_min "Minimum engine speed for the plausibility check" VALUE 0xa10295c0 _REC_VAL_20_u1 8160. _CNV_A_R_LINEAR_____9_CM 0. 8160. DISPLAY_IDENTIFIER C_N_32_FUP_MFP_PLAUS_MIN FORMAT "%4.0" /end CHARACTERISTIC
/begin CHARACTERISTIC c_fuel_mass_ad_plaus_min "Minimum threshold for FUEL_MASS_AD" VALUE 0xa1029406 _REC_VAL_20_s2 1389. _CNV_A_R_LINEAR_____797_CM -694.510597390707 694.4894026092931 DISPLAY_IDENTIFIER C_FUEL_MASS_AD_PLAUS_MIN FORMAT "%7.2" /end CHARACTERISTIC
/begin CHARACTERISTIC c_fuel_mass_ad_plaus_max "Maximum threshold for FUEL_MASS_AD" VALUE 0xa1029404 _REC_VAL_20_s2 1389. _CNV_A_R_LINEAR_____797_CM -694.510597390707 694.4894026092931 DISPLAY_IDENTIFIER C_FUEL_MASS_AD_PLAUS_MAX FORMAT "%7.2" /end CHARACTERISTIC
/begin CHARACTERISTIC c_fuel_mass_ad_dif_plaus_min "Minimum threshold for FUEL_MASS_AD_DIF (controller excitation)" VALUE 0xa10293fe _REC_VAL_20_s2 1389. _CNV_A_R_LINEAR_____797_CM -694.510597390707 694.4894026092931 DISPLAY_IDENTIFIER C_FUEL_MASS_AD_DIF_PLAUS_MIN FORMAT "%7.2" /end CHARACTERISTIC
/begin CHARACTERISTIC c_fuel_mass_ad_dif_plaus_max "Maximum threshold for FUEL_MASS_AD_DIF (controller excitation)" VALUE 0xa10293fc _REC_VAL_20_s2 1389. _CNV_A_R_LINEAR_____797_CM -694.510597390707 694.4894026092931 DISPLAY_IDENTIFIER C_FUEL_MASS_AD_DIF_PLAUS_MAX FORMAT "%7.2" /end CHARACTERISTIC
/begin CHARACTERISTIC c_fuel_mass_req_i_ctl_diag_min "Minimum threshold for integral part of the controller" VALUE 0xa102940a _REC_VAL_20_s2 1389. _CNV_A_R_LINEAR_____797_CM -694.510597390707 694.4894026092931 DISPLAY_IDENTIFIER C_FUEL_MASS_REQ_I_CTL_DIAG_MIN FORMAT "%7.2" /end CHARACTERISTIC
/begin CHARACTERISTIC c_fuel_mass_req_i_ctl_diag_max "Maximum threshold for integral part of the controller" VALUE 0xa1029408 _REC_VAL_20_s2 1389. _CNV_A_R_LINEAR_____797_CM -694.510597390707 694.4894026092931 DISPLAY_IDENTIFIER C_FUEL_MASS_REQ_I_CTL_DIAG_MAX FORMAT "%7.2" /end CHARACTERISTIC
/begin CHARACTERISTIC c_pwm_vcv_bas_ad_vcv_plaus_min "Minimum threshold for VCV_PLAUS in flow control" VALUE 0xa1029750 _REC_VAL_20_s2 99.99847412109381 _CNV_A_R_LINEAR_____110_CM -50. 49.9984741210938 DISPLAY_IDENTIFIER C_PWM_VCV_BAS_AD_VCV_PLAUS_MIN FORMAT "%7.3" /end CHARACTERISTIC
/begin CHARACTERISTIC c_pwm_vcv_bas_ad_vcv_plaus_max "Maximum threshold for VCV_PLAUS in flow control" VALUE 0xa102974e _REC_VAL_20_s2 99.99847412109381 _CNV_A_R_LINEAR_____110_CM -50. 49.9984741210938 DISPLAY_IDENTIFIER C_PWM_VCV_BAS_AD_VCV_PLAUS_MAX FORMAT "%7.3" /end CHARACTERISTIC
/begin CHARACTERISTIC c_pwm_vcv_min_ad_vcv_plaus_min "Minimum threshold for VCV_PLAUS in pressure control" VALUE 0xa102976c _REC_VAL_20_s2 99.99847412109381 _CNV_A_R_LINEAR_____110_CM -50. 49.9984741210938 DISPLAY_IDENTIFIER C_PWM_VCV_MIN_AD_VCV_PLAUS_MIN FORMAT "%7.3" /end CHARACTERISTIC
/begin CHARACTERISTIC c_pwm_vcv_min_ad_vcv_plaus_max "Maximum threshold for VCV_PLAUS in pressure control" VALUE 0xa102976a _REC_VAL_20_s2 99.99847412109381 _CNV_A_R_LINEAR_____110_CM -50. 49.9984741210938 DISPLAY_IDENTIFIER C_PWM_VCV_MIN_AD_VCV_PLAUS_MAX FORMAT "%7.3" /end CHARACTERISTIC
/begin CHARACTERISTIC c_tfu_vcv_plaus_max "Maximum threshold for the VCV adaptation plausibility check" VALUE 0xa1029a28 _REC_VAL_20_u1 190.5 _CNV_A_R_LINEAR_____16_CM -48. 142.5 DISPLAY_IDENTIFIER C_TFU_VCV_PLAUS_MAX FORMAT "%6.2" /end CHARACTERISTIC
/begin CHARACTERISTIC c_tfu_vcv_plaus_min "Minimum threshold for the VCV adaptation plausibility check" VALUE 0xa1029a29 _REC_VAL_20_u1 190.5 _CNV_A_R_LINEAR_____16_CM -48. 142.5 DISPLAY_IDENTIFIER C_TFU_VCV_PLAUS_MIN FORMAT "%6.2" /end CHARACTERISTIC
/begin CHARACTERISTIC c_n_32_fup_mfp_plaus_max "Maximum engine speed for the plausibility check" VALUE 0xa10295bf _REC_VAL_20_u1 8160. _CNV_A_R_LINEAR_____9_CM 0. 8160. DISPLAY_IDENTIFIER C_N_32_FUP_MFP_PLAUS_MAX FORMAT "%4.0" /end CHARACTERISTIC
/begin CHARACTERISTIC c_n_32_vcv_plaus_max "Maximum engine speed for the VCV adaptation plausibility check" VALUE 0xa10295d2 _REC_VAL_20_u1 8160. _CNV_A_R_LINEAR_____9_CM 0. 8160. DISPLAY_IDENTIFIER C_N_32_VCV_PLAUS_MAX FORMAT "%4.0" /end CHARACTERISTIC
/begin CHARACTERISTIC c_n_32_vcv_plaus_min "Minimum engine speed for the VCV adaptation plausibility check" VALUE 0xa10295d3 _REC_VAL_20_u1 8160. _CNV_A_R_LINEAR_____9_CM 0. 8160. DISPLAY_IDENTIFIER C_N_32_VCV_PLAUS_MIN FORMAT "%4.0" /end CHARACTERISTIC
/begin MEASUREMENT vs_max_sel_ext_req "Selected maximum vehicle speed code via tester" UBYTE _CNV_A_R_LINEAR_____0_CM 1 100. 0. 3. DISPLAY_IDENTIFIER VS_MAX_SEL_EXT_REQ ECU_ADDRESS 0xd0003c1b FORMAT "%2.0" /end MEASUREMENT
/begin MEASUREMENT lv_err_efppwm_plaus "Boolean that indicates inconsistencies of the EFPPWM signal" UBYTE _CNV_S_2_RANGE__0___1_CM 1 100. 0. 1. DISPLAY_IDENTIFIER LV_ERR_EFPPWM_PLAUS ECU_ADDRESS 0xd00034d7 BIT_MASK 0x1 /end MEASUREMENT
/begin MEASUREMENT lv_err_l_prs_sys "Boolean that indicates abnormal fuel pressure value in low pressure fuel system" UBYTE _CNV_S_2_RANGE__0___1_CM 1 100. 0. 1. DISPLAY_IDENTIFIER LV_ERR_L_PRS_SYS ECU_ADDRESS 0xd00034d8 BIT_MASK 0x1 /end MEASUREMENT
/begin CHARACTERISTIC c_n_32_fup_efp_diag "Minimum engine speed for EFPPWM plausibility check (Default value 800)" VALUE 0xa10295be _REC_VAL_20_u1 8160. _CNV_A_R_LINEAR_____9_CM 0. 8160. DISPLAY_IDENTIFIER C_N_32_FUP_EFP_DIAG FORMAT "%4.0" /end CHARACTERISTIC
/begin CHARACTERISTIC c_fup_efp_bol_1 "Bottom fuel pressure threshold 1 " VALUE 0xa102941c _REC_VAL_20_u2 173888. _CNV_A_R_LINEAR_____153_CM 0. 173888. DISPLAY_IDENTIFIER C_FUP_EFP_BOL_1 FORMAT "%8.1" /end CHARACTERISTIC
/begin CHARACTERISTIC c_fup_efp_tol_1 "Top fuel pressure threshold 1" VALUE 0xa1029438 _REC_VAL_20_u2 173888. _CNV_A_R_LINEAR_____153_CM 0. 173888. DISPLAY_IDENTIFIER C_FUP_EFP_TOL_1 FORMAT "%8.1" /end CHARACTERISTIC
/begin CHARACTERISTIC c_fup_efp_tol_2 "Top fuel pressure threshold 2" VALUE 0xa102943a _REC_VAL_20_u2 173888. _CNV_A_R_LINEAR_____153_CM 0. 173888. DISPLAY_IDENTIFIER C_FUP_EFP_TOL_2 FORMAT "%8.1" /end CHARACTERISTIC
/begin CHARACTERISTIC c_n_32_max_efppwm_plaus "Maximum engine speed for the plausibility check" VALUE 0xa10295c1 _REC_VAL_20_u1 8160. _CNV_A_R_LINEAR_____9_CM 0. 8160. DISPLAY_IDENTIFIER C_N_32_MAX_EFPPWM_PLAUS FORMAT "%4.0" /end CHARACTERISTIC
/begin CHARACTERISTIC c_n_32_min_efppwm_plaus "Minimum engine speed for the plausibility check" VALUE 0xa10295c7 _REC_VAL_20_u1 8160. _CNV_A_R_LINEAR_____9_CM 0. 8160. DISPLAY_IDENTIFIER C_N_32_MIN_EFPPWM_PLAUS FORMAT "%4.0" /end CHARACTERISTIC
/begin CHARACTERISTIC c_n_32_max_l_prs_sys "Maximum engine speed for the plausibility check" VALUE 0xa10295c4 _REC_VAL_20_u1 8160. _CNV_A_R_LINEAR_____9_CM 0. 8160. DISPLAY_IDENTIFIER C_N_32_MAX_L_PRS_SYS FORMAT "%4.0" /end CHARACTERISTIC
/begin CHARACTERISTIC c_n_32_min_l_prs_sys "Minimum engine speed for the plausibility check" VALUE 0xa10295ca _REC_VAL_20_u1 8160. _CNV_A_R_LINEAR_____9_CM 0. 8160. DISPLAY_IDENTIFIER C_N_32_MIN_L_PRS_SYS FORMAT "%4.0" /end CHARACTERISTIC
/begin CHARACTERISTIC c_efppwm_i_diag_min "Minimum threshold for I-part of the EFPPWM" VALUE 0xa1029336 _REC_VAL_20_s2 99.99847412109381 _CNV_A_R_LINEAR_____110_CM -50. 49.9984741210938 DISPLAY_IDENTIFIER C_EFPPWM_I_DIAG_MIN FORMAT "%7.3" /end CHARACTERISTIC
/begin CHARACTERISTIC c_efppwm_i_diag_max "Maximum threshold for I-part of the EFPPWM" VALUE 0xa1029334 _REC_VAL_20_s2 99.99847412109381 _CNV_A_R_LINEAR_____110_CM -50. 49.9984741210938 DISPLAY_IDENTIFIER C_EFPPWM_I_DIAG_MAX FORMAT "%7.3" /end CHARACTERISTIC
/begin CHARACTERISTIC c_efppwm_i_ad_diag_min "Minimum threshold for adaptive I-part of the EFPPWM" VALUE 0xa102932e _REC_VAL_20_s2 99.99847412109381 _CNV_A_R_LINEAR_____110_CM -50. 49.9984741210938 DISPLAY_IDENTIFIER C_EFPPWM_I_AD_DIAG_MIN FORMAT "%7.3" /end CHARACTERISTIC
/begin CHARACTERISTIC c_efppwm_i_ad_diag_max "Maximum threshold for adaptive I-part of the EFPPWM" VALUE 0xa102932c _REC_VAL_20_s2 99.99847412109381 _CNV_A_R_LINEAR_____110_CM -50. 49.9984741210938 DISPLAY_IDENTIFIER C_EFPPWM_I_AD_DIAG_MAX FORMAT "%7.3" /end CHARACTERISTIC
/begin CHARACTERISTIC c_efppwm_min_ad_diag_min "Minimum threshold for adaptive minimum EFPPWM" VALUE 0xa1029348 _REC_VAL_20_u2 99.99847412109381 _CNV_A_R_LINEAR_____7_CM 0. 99.99847412109381 DISPLAY_IDENTIFIER C_EFPPWM_MIN_AD_DIAG_MIN /end CHARACTERISTIC
/begin CHARACTERISTIC c_efppwm_min_ad_diag_max "Minimum threshold for adaptive minimum EFPPWM" VALUE 0xa1029346 _REC_VAL_20_u2 99.99847412109381 _CNV_A_R_LINEAR_____7_CM 0. 99.99847412109381 DISPLAY_IDENTIFIER C_EFPPWM_MIN_AD_DIAG_MAX /end CHARACTERISTIC
/begin CHARACTERISTIC lc_efppwm_min_ena "Logical constant for enabling of the minimum EFPPWM" VALUE 0xa1029d22 _REC_VAL_20_u1 1. _CNV_A_R_LINEAR_____0_CM 0. 1. DISPLAY_IDENTIFIER LC_EFPPWM_MIN_ENA FORMAT "%1.0" /end CHARACTERISTIC
/begin CHARACTERISTIC lc_efppwm_i_ad_ena "Logical constant for enabling of the I-Part adaptive" VALUE 0xa1029d20 _REC_VAL_20_u1 1. _CNV_A_R_LINEAR_____0_CM 0. 1. DISPLAY_IDENTIFIER LC_EFPPWM_I_AD_ENA FORMAT "%1.0" /end CHARACTERISTIC
/begin CHARACTERISTIC c_tco_max_efppwm_plaus "Maximum temperature for the plausibility check" VALUE 0xa10299d4 _REC_VAL_20_u1 190.5 _CNV_A_R_LINEAR_____16_CM -48. 142.5 DISPLAY_IDENTIFIER C_TCO_MAX_EFPPWM_PLAUS FORMAT "%6.2" /end CHARACTERISTIC
/begin CHARACTERISTIC c_tco_min_efppwm_plaus "Minimum temperature for the plausibility check" VALUE 0xa10299dc _REC_VAL_20_u1 190.5 _CNV_A_R_LINEAR_____16_CM -48. 142.5 DISPLAY_IDENTIFIER C_TCO_MIN_EFPPWM_PLAUS FORMAT "%6.2" /end CHARACTERISTIC
/begin CHARACTERISTIC c_t_ast_fup_efp_diag "Time for inhibit diagnosis for the low pressure system" VALUE 0xa1029808 _REC_VAL_20_u2 6553.5 _CNV_A_R_LINEAR_____4_CM 0. 6553.5 DISPLAY_IDENTIFIER C_T_AST_FUP_EFP_DIAG FORMAT "%6.1" /end CHARACTERISTIC
/begin CHARACTERISTIC c_ftl_min_efppwm_plaus_diag "Minimum fuel tank level for the EFPPWM plausibility diagnosis" VALUE 0xa10293f8 _REC_VAL_20_u1 127. _CNV_A_R_LINEAR_____76_CM 0. 127. DISPLAY_IDENTIFIER C_FTL_MIN_EFPPWM_PLAUS_DIAG FORMAT "%3.0" /end CHARACTERISTIC
/begin CHARACTERISTIC c_ftl_min_l_prs_sys_diag "Minimum fuel tank level for the low pressure system diagnosis" VALUE 0xa10293f9 _REC_VAL_20_u1 127. _CNV_A_R_LINEAR_____76_CM 0. 127. DISPLAY_IDENTIFIER C_FTL_MIN_L_PRS_SYS_DIAG FORMAT "%3.0" /end CHARACTERISTIC
/begin CHARACTERISTIC c_abc_inc_efppwm_plaus "Increment of the plausibility check of EFPPWM anti-bounce counter" VALUE 0xa1029083 _REC_VAL_20_u1 255. _CNV_A_R_LINEAR_____0_CM 0. 255. DISPLAY_IDENTIFIER C_ABC_INC_EFPPWM_PLAUS FORMAT "%3.0" /end CHARACTERISTIC
/begin CHARACTERISTIC c_abc_inc_l_prs_sys "Increment of low pressure system monitoring anti-bounce counter" VALUE 0xa1029092 _REC_VAL_20_u1 255. _CNV_A_R_LINEAR_____0_CM 0. 255. DISPLAY_IDENTIFIER C_ABC_INC_L_PRS_SYS FORMAT "%3.0" /end CHARACTERISTIC
/begin CHARACTERISTIC c_abc_max_efppwm_plaus "Threshold to be reached, before plausibility check error of EFPPWM" VALUE 0xa102910e _REC_VAL_20_u1 254. _CNV_A_R_LINEAR_____0_CM 1. 255. DISPLAY_IDENTIFIER C_ABC_MAX_EFPPWM_PLAUS FORMAT "%3.0" /end CHARACTERISTIC
/begin CHARACTERISTIC c_abc_max_l_prs_sys "Threshold to be reached, before permanently activating low pressure system monitoring error " VALUE 0xa102911d _REC_VAL_20_u1 254. _CNV_A_R_LINEAR_____0_CM 1. 255. DISPLAY_IDENTIFIER C_ABC_MAX_L_PRS_SYS FORMAT "%3.0" /end CHARACTERISTIC
/begin MEASUREMENT fac_maf_max "Ratio between MAF und MAX_COR" UWORD _CNV_A_R_LINEAR_____8_CM 1 100. 0. 1.99996948242188 DISPLAY_IDENTIFIER FAC_MAF_MAX ECU_ADDRESS 0xd0004d8c FORMAT "%7.5" /end MEASUREMENT
/begin MEASUREMENT pq_egr "Pressure quotient at the EGR - valve" UWORD _CNV_A_R_LINEAR_____68_CM 1 100. 0. 0.9999847412109381 DISPLAY_IDENTIFIER PQ_EGR ECU_ADDRESS 0xd0004d8e FORMAT "%7.5" /end MEASUREMENT
/begin MEASUREMENT maf_fg_cyl "Fresh air mass flow in the cylinder" UWORD _CNV_A_R_LINEAR_____207_CM 1 100. 0. 2047.96875 DISPLAY_IDENTIFIER MAF_FG_CYL ECU_ADDRESS 0xd0004d90 FORMAT "%7.2" /end MEASUREMENT
/begin COMPU_METHOD _CNV_A_R_LINEAR_____0_CM "" RAT_FUNC "%6.3" "-" COEFFS 0 1. 0. 0 0 1 /end COMPU_METHOD
/begin COMPU_METHOD _CNV_S_2_RANGE__0___1_CM "" TAB_VERB "%6.3" "-" COMPU_TAB_REF _CNV_S_2_RANGE__0___1 /end COMPU_METHOD
/begin COMPU_VTAB _CNV_S_2_RANGE__0___1 "" TAB_VERB 2 0 "0" 1 "1" /end COMPU_VTAB
/begin COMPU_METHOD _CNV_A_R_LINEAR_____2_CM "" RAT_FUNC "%6.3" "V" COEFFS 0 204.8 0. 0 0 1 /end COMPU_METHOD
/begin COMPU_METHOD _CNV_A_R_LINEAR_____3_CM "" RAT_FUNC "%6.3" "s" COEFFS 0 100. 0. 0 0 1 /end COMPU_METHOD
/begin COMPU_METHOD _CNV_A_R_LINEAR_____4_CM "" RAT_FUNC "%6.3" "s" COEFFS 0 10. 0. 0 0 1 /end COMPU_METHOD
/begin COMPU_METHOD _CNV_A_R_LINEAR_____5_CM "" RAT_FUNC "%6.3" "%" COEFFS 0 2.56 0. 0 0 1 /end COMPU_METHOD
/begin COMPU_METHOD _CNV_A_R_LINEAR_____6_CM "" RAT_FUNC "%6.3" "km/h" COEFFS 0 1. 0. 0 0 1 /end COMPU_METHOD
/begin COMPU_METHOD _CNV_A_R_LINEAR_____7_CM "" RAT_FUNC "%6.3" "%" COEFFS 0 655.3599999999997 0. 0 0 1 /end COMPU_METHOD
/begin COMPU_METHOD _CNV_A_R_LINEAR_____8_CM "" RAT_FUNC "%6.3" "-" COEFFS 0 32767.99999999992 0. 0 0 1 /end COMPU_METHOD
/begin COMPU_METHOD _CNV_A_R_LINEAR_____9_CM "" RAT_FUNC "%6.3" "rpm" COEFFS 0 3.125e-002 0. 0 0 1 /end COMPU_METHOD
/begin COMPU_METHOD _CNV_A_R_LINEAR_____13_CM "" RAT_FUNC "%6.3" "rpm" COEFFS 0 1. 0. 0 0 1 /end COMPU_METHOD
/begin COMPU_METHOD _CNV_A_R_LINEAR_____16_CM "" RAT_FUNC "%6.3" "°C" COEFFS 0 1.333333333333333 64. 0 0 1 /end COMPU_METHOD
/begin COMPU_METHOD _CNV_A_R_LINEAR_____17_CM "" RAT_FUNC "%6.3" "-" COEFFS 0 255.9983911655618 0. 0 0 1 /end COMPU_METHOD
/begin COMPU_METHOD _CNV_A_R_LINEAR_____18_CM "" RAT_FUNC "%6.3" "ms" COEFFS 0 0.1 0. 0 0 1 /end COMPU_METHOD
/begin COMPU_METHOD _CNV_A_R_LINEAR_____23_CM "" RAT_FUNC "%6.3" "-" COEFFS 0 16384. 0. 0 0 1 /end COMPU_METHOD
/begin COMPU_METHOD _CNV_A_R_LINEAR_____24_CM "" RAT_FUNC "%6.3" "°C" COEFFS 0 1.333333333333333 0. 0 0 1 /end COMPU_METHOD
/begin COMPU_METHOD _CNV_A_R_LINEAR_____25_CM "" RAT_FUNC "%6.3" "°C" COEFFS 0 1. 40. 0 0 1 /end COMPU_METHOD
/begin COMPU_METHOD _CNV_A_R_LINEAR_____26_CM "" RAT_FUNC "%6.3" "hPa" COEFFS 0 12.06017666543982 0. 0 0 1 /end COMPU_METHOD
/begin COMPU_METHOD _CNV_A_R_LINEAR_____27_CM "" RAT_FUNC "%6.3" "-" COEFFS 0 256. 0. 0 0 1 /end COMPU_METHOD
/begin COMPU_METHOD _CNV_R_R_Def_km_sw__64_CM "Def_km_sw_q10" RAT_FUNC "%6.3" "km" COEFFS 0. 1. 0. 0. 0. 10. /end COMPU_METHOD
/begin COMPU_METHOD _CNV_A_R_LINEAR_____65_CM "" RAT_FUNC "%6.3" "Nm" COEFFS 0 32. 32768. 0 0 1 /end COMPU_METHOD
/begin COMPU_METHOD _CNV_A_R_LINEAR_____66_CM "" RAT_FUNC "%6.3" "km/h" COEFFS 0 128.0000018750286 0. 0 0 1 /end COMPU_METHOD
/begin COMPU_METHOD _CNV_A_R_LINEAR_____68_CM "" RAT_FUNC "%6.3" "-" COEFFS 0 65535.99999999996 0. 0 0 1 /end COMPU_METHOD
/begin COMPU_METHOD _CNV_A_R_LINEAR_____71_CM "" RAT_FUNC "%6.3" "" COEFFS 0 256. 0. 0 0 1 /end COMPU_METHOD
/begin COMPU_METHOD _CNV_S_2_RANGE______75_CM "" TAB_VERB "%6.3" "" COMPU_TAB_REF _CNV_S_2_RANGE______75 /end COMPU_METHOD
/begin COMPU_VTAB _CNV_S_2_RANGE______75 "" TAB_VERB 2 0 "0" 1 "1" /end COMPU_VTAB
/begin COMPU_METHOD _CNV_A_R_LINEAR_____76_CM "" RAT_FUNC "%6.3" "l" COEFFS 0 1. 0. 0 0 1 /end COMPU_METHOD
/begin COMPU_METHOD _CNV_A_R_LINEAR_____80_CM "" RAT_FUNC "%6.3" "°STW" COEFFS 0 22.75571737399022 0. 0 0 1 /end COMPU_METHOD
/begin COMPU_METHOD _CNV_A_R_LINEAR_____100_CM "" RAT_FUNC "%6.3" "-" COEFFS 0 128. 0. 0 0 1 /end COMPU_METHOD
/begin COMPU_METHOD _CNV_A_R_LINEAR_____108_CM "" RAT_FUNC "%6.3" "mg/stk" COEFFS 0 47.18142548596112 0. 0 0 1 /end COMPU_METHOD
/begin COMPU_METHOD _CNV_A_R_LINEAR_____110_CM "" RAT_FUNC "%6.3" "%" COEFFS 0 655.3599999999997 -1.455191522836685e-011 0 0 1 /end COMPU_METHOD
/begin COMPU_METHOD _CNV_A_R_LINEAR_____113_CM "" RAT_FUNC "%6.3" "-" COEFFS 0 8192. 0. 0 0 1 /end COMPU_METHOD
/begin COMPU_METHOD _CNV_A_R_LINEAR_____152_CM "" RAT_FUNC "%6.3" "hPa" COEFFS 0 0.1884402603974972 0. 0 0 1 /end COMPU_METHOD
/begin COMPU_METHOD _CNV_A_R_LINEAR_____153_CM "" RAT_FUNC "%6.3" "hPa" COEFFS 0 0.3768805207949945 0. 0 0 1 /end COMPU_METHOD
/begin COMPU_METHOD _CNV_A_R_LINEAR_____163_CM "" RAT_FUNC "%6.3" "h/(km*min)" COEFFS 0 1. 0. 0 0 1 /end COMPU_METHOD
/begin COMPU_METHOD _CNV_A_R_LINEAR_____171_CM "" RAT_FUNC "%6.3" "°CRK" COEFFS 0 2.666666666666667 128. 0 0 1 /end COMPU_METHOD
/begin COMPU_METHOD _CNV_A_R_LINEAR_____172_CM "" RAT_FUNC "%6.3" "rpm" COEFFS 0 1. 32768. 0 0 1 /end COMPU_METHOD
/begin COMPU_METHOD _CNV_A_R_LINEAR_____189_CM "" RAT_FUNC "%6.3" "V" COEFFS 0 51.0204081632653 0. 0 0 1 /end COMPU_METHOD
/begin COMPU_METHOD _CNV_A_R_LINEAR_____192_CM "" RAT_FUNC "%6.3" "mg/stk" COEFFS 0 47.18214541280769 -1.080506262951531e-005 0 0 1 /end COMPU_METHOD
/begin COMPU_METHOD _CNV_A_R_LINEAR_____195_CM "" RAT_FUNC "%6.3" "V" COEFFS 0 51.2 0. 0 0 1 /end COMPU_METHOD
/begin COMPU_METHOD _CNV_A_R_LINEAR_____200_CM "" RAT_FUNC "%6.3" "-" COEFFS 0 32768.00003968061 3.96806062781252e-005 0 0 1 /end COMPU_METHOD
/begin COMPU_METHOD _CNV_A_R_LINEAR_____207_CM "" RAT_FUNC "%6.3" "kg/h" COEFFS 0 32. 0. 0 0 1 /end COMPU_METHOD
/begin COMPU_METHOD _CNV_A_R_LINEAR_____219_CM "" RAT_FUNC "%6.3" "mg/stk" COEFFS 0 47.18070554355651 0. 0 0 1 /end COMPU_METHOD
/begin COMPU_METHOD _CNV_A_R_LINEAR_____234_CM "" RAT_FUNC "%6.3" "rpm/10ms" COEFFS 0 16. 0. 0 0 1 /end COMPU_METHOD
/begin COMPU_METHOD _CNV_A_R_LINEAR_____235_CM "" RAT_FUNC "%6.3" "rpm/10ms" COEFFS 0 4. 0. 0 0 1 /end COMPU_METHOD
/begin COMPU_METHOD _CNV_A_R_LINEAR_____236_CM "" RAT_FUNC "%6.3" "rpm" COEFFS 0 1. 65536. 0 0 1 /end COMPU_METHOD
/begin COMPU_METHOD _CNV_A_R_LINEAR_____237_CM "" RAT_FUNC "%6.3" "rpm" COEFFS 0 0.5 0. 0 0 1 /end COMPU_METHOD
/begin COMPU_METHOD _CNV_A_R_LINEAR_____238_CM "" RAT_FUNC "%6.3" "Ah" COEFFS 0 2.007874015748032 0. 0 0 1 /end COMPU_METHOD
/begin COMPU_METHOD _CNV_A_R_LINEAR_____243_CM "" RAT_FUNC "%6.3" "-" COEFFS 0 2048. 0. 0 0 1 /end COMPU_METHOD
/begin COMPU_METHOD _CNV_A_R_LINEAR_____245_CM "" RAT_FUNC "%6.3" "V" COEFFS 0 204.7999995887937 0. 0 0 1 /end COMPU_METHOD
/begin COMPU_METHOD _CNV_A_R_LINEAR_____246_CM "" RAT_FUNC "%6.3" "%/V" COEFFS 0 3.2 0. 0 0 1 /end COMPU_METHOD
/begin COMPU_METHOD _CNV_A_R_LINEAR_____247_CM "" RAT_FUNC "%6.3" "%/s" COEFFS 0 0.1024000154202376 128.000019275297 0 0 1 /end COMPU_METHOD
/begin COMPU_METHOD _CNV_A_R_LINEAR_____248_CM "" RAT_FUNC "%6.3" "-" COEFFS 0 32767.98303949118 0. 0 0 1 /end COMPU_METHOD
/begin COMPU_METHOD _CNV_A_R_LINEAR_____249_CM "" RAT_FUNC "%6.3" "-" COEFFS 0 32768.00003968061 32768.00003968061 0 0 1 /end COMPU_METHOD
/begin COMPU_METHOD _CNV_A_R_LINEAR_____250_CM "" RAT_FUNC "%6.3" "kg/h" COEFFS 0 128.0000018750286 0. 0 0 1 /end COMPU_METHOD
/begin COMPU_METHOD _CNV_S_2_RANGE______254_R_CM "" TAB_VERB "%6.3" "-" COMPU_TAB_REF _CNV_S_2_RANGE______254_R /end COMPU_METHOD
/begin COMPU_VTAB_RANGE _CNV_S_2_RANGE______254_R "" 2 0 0 "0" 1 255 "1" /end COMPU_VTAB_RANGE
/begin COMPU_METHOD _CNV_A_R_LINEAR_____257_CM "" RAT_FUNC "%6.3" "°CRK" COEFFS 0 2.666666666666667 -466.6666666666666 0 0 1 /end COMPU_METHOD
/begin COMPU_METHOD _CNV_A_R_LINEAR_____258_CM "" RAT_FUNC "%6.3" "°C/500ms" COEFFS 0 1.333333333333333 0. 0 0 1 /end COMPU_METHOD
/begin COMPU_METHOD _CNV_A_R_LINEAR_____283_CM "" RAT_FUNC "%6.3" "-" COEFFS 0 64. 0. 0 0 1 /end COMPU_METHOD
/begin COMPU_METHOD _CNV_A_R_LINEAR_____289_CM "Battery voltage" RAT_FUNC "%6.3" "V" COEFFS 0 9.846153846153847 0. 0 0 1 /end COMPU_METHOD
/begin COMPU_METHOD _CNV_A_R_LINEAR_____291_CM "" RAT_FUNC "%6.3" "ms" COEFFS 0 125. 0. 0 0 1 /end COMPU_METHOD
/begin COMPU_METHOD _CNV_A_R_LINEAR_____292_CM "" RAT_FUNC "%6.3" "(km/h)/10ms" COEFFS 0 128. 0. 0 0 1 /end COMPU_METHOD
/begin COMPU_METHOD _CNV_A_R_LINEAR_____293_CM "" RAT_FUNC "%6.3" "m" COEFFS 0 57600021.97266463 0. 0 0 1 /end COMPU_METHOD
/begin COMPU_METHOD _CNV_A_R_LINEAR_____404_CM "" RAT_FUNC "%6.3" "-" COEFFS 0 100. 0. 0 0 1 /end COMPU_METHOD
/begin COMPU_METHOD _CNV_A_R_LINEAR_____437_CM "" RAT_FUNC "%6.3" "-" COEFFS 0 1000. 0. 0 0 1 /end COMPU_METHOD
/begin COMPU_METHOD _CNV_S_10_STATE_EOL__438_CM "" TAB_VERB "%6.3" "" COMPU_TAB_REF _CNV_S_10_STATE_EOL__438 /end COMPU_METHOD
/begin COMPU_VTAB _CNV_S_10_STATE_EOL__438 "" TAB_VERB 10 0 "ACT" 1 "ST_INH" 2 "PAR_NOT_PLAUS" 3 "WAIT_REL" 4 "UNDEF" 5 "NOT_START" 6 "END_WOUT_RESULT" 7 "ABORTED" 8 "END_WOUT_ERR" 9 "END_WITH_ERR" /end COMPU_VTAB
/begin COMPU_METHOD _CNV_A_R_LINEAR_____440_CM "" RAT_FUNC "%6.3" "V" COEFFS 0 10. 0. 0 0 1 /end COMPU_METHOD
/begin COMPU_METHOD _CNV_A_R_LINEAR_____441_CM "" RAT_FUNC "%6.3" "ms" COEFFS 0 12.5 0. 0 0 1 /end COMPU_METHOD
/begin COMPU_METHOD _CNV_A_R_LINEAR_____442_CM "" RAT_FUNC "%6.3" "°CRK" COEFFS 0 1.25 160. 0 0 1 /end COMPU_METHOD
/begin COMPU_METHOD _CNV_R_R_Def_km_ub__443_CM "Def_km_ub_q1000" RAT_FUNC "%6.3" "km" COEFFS 0. 1. 0. 0. 0. 1000. /end COMPU_METHOD
/begin COMPU_METHOD _CNV_A_R_LINEAR_____797_CM "" RAT_FUNC "%6.3" "mg" COEFFS 0 47.18142548596112 -1.455191522836685e-011 0 0 1 /end COMPU_METHOD
/begin RECORD_LAYOUT _REC_VAL_20_u1 FNC_VALUES 1 UBYTE COLUMN_DIR DIRECT /end RECORD_LAYOUT
/begin RECORD_LAYOUT _REC_VAL_20_u2 FNC_VALUES 1 UWORD COLUMN_DIR DIRECT /end RECORD_LAYOUT
/begin RECORD_LAYOUT _REC_AXS_20_u1 NO_AXIS_PTS_X 1 UBYTE AXIS_PTS_X 2 UBYTE INDEX_INCR DIRECT /end RECORD_LAYOUT
/begin RECORD_LAYOUT _REC_MAP_20_u2_u1_u1 FNC_VALUES 1 UWORD COLUMN_DIR DIRECT /end RECORD_LAYOUT
/begin RECORD_LAYOUT _REC_CUR_20_u1_u1 FNC_VALUES 1 UBYTE COLUMN_DIR DIRECT /end RECORD_LAYOUT
/begin RECORD_LAYOUT _REC_VAL_20_s2 FNC_VALUES 1 SWORD COLUMN_DIR DIRECT /end RECORD_LAYOUT
/begin RECORD_LAYOUT _REC_MAP_20_u2_u2_u1 FNC_VALUES 1 UWORD COLUMN_DIR DIRECT /end RECORD_LAYOUT
/begin RECORD_LAYOUT _REC_AXS_20_u2 NO_AXIS_PTS_X 1 UWORD AXIS_PTS_X 2 UWORD INDEX_INCR DIRECT /end RECORD_LAYOUT
/begin RECORD_LAYOUT _REC_CUR_20_u2_u1 FNC_VALUES 1 UWORD COLUMN_DIR DIRECT /end RECORD_LAYOUT
/begin RECORD_LAYOUT _REC_CUR_20_u2_u2 FNC_VALUES 1 UWORD COLUMN_DIR DIRECT /end RECORD_LAYOUT
/begin RECORD_LAYOUT _REC_VAL_20_s1 FNC_VALUES 1 SBYTE COLUMN_DIR DIRECT /end RECORD_LAYOUT
/begin RECORD_LAYOUT _REC_MAP_20_u2_u2_u2 FNC_VALUES 1 UWORD COLUMN_DIR DIRECT /end RECORD_LAYOUT
/begin RECORD_LAYOUT _REC_VAL_20_u4 FNC_VALUES 1 ULONG COLUMN_DIR DIRECT /end RECORD_LAYOUT
/begin RECORD_LAYOUT _REC_MAP_20_u1_u2_u1 FNC_VALUES 1 UBYTE COLUMN_DIR DIRECT /end RECORD_LAYOUT
/begin RECORD_LAYOUT _REC_MAP_20_u1_u1_u2 FNC_VALUES 1 UBYTE COLUMN_DIR DIRECT /end RECORD_LAYOUT
/begin FUNCTION OBD_Fuel_sys_pres_diag "_Fuel_sys_pres_diag"
 /begin DEF_CHARACTERISTIC c_fup_bol_1 c_fup_tol_1 c_fup_tol_2 c_n_32_fup_diag c_n_32_fup_mfp_plaus_min c_fuel_mass_ad_plaus_min c_fuel_mass_ad_plaus_max c_fuel_mass_ad_dif_plaus_min c_fuel_mass_ad_dif_plaus_max c_fuel_mass_req_i_ctl_diag_min c_fuel_mass_req_i_ctl_diag_max c_pwm_vcv_bas_ad_vcv_plaus_min c_pwm_vcv_bas_ad_vcv_plaus_max c_pwm_vcv_min_ad_vcv_plaus_min c_pwm_vcv_min_ad_vcv_plaus_max c_tfu_vcv_plaus_max c_tfu_vcv_plaus_min c_n_32_fup_mfp_plaus_max c_n_32_vcv_plaus_max c_n_32_vcv_plaus_min /end DEF_CHARACTERISTIC
 /begin OUT_MEASUREMENT lv_err_fup_mfp_plaus lv_err_h_prs_sys lv_err_vcv_plaus /end OUT_MEASUREMENT
/end FUNCTION
/begin FUNCTION OBD_Fuel_sys_pres_diag_AI "_Fuel_sys_pres_diag_AI"
 /begin DEF_CHARACTERISTIC c_t_ast_h_prs_diag_inh c_abc_inc_fup_mfp_plaus c_abc_inc_h_prs_sys c_abc_inc_vcv_plaus c_abc_max_vcv_plaus c_abc_max_fup_mfp_plaus c_abc_max_h_prs_sys /end DEF_CHARACTERISTIC
 /begin OUT_MEASUREMENT lv_inh_fup_mfp_plaus lv_inh_h_prs_sys lv_inh_vcv_plaus /end OUT_MEASUREMENT
/end FUNCTION
/begin FUNCTION OBD_FUP_EFP_Diag ""
 /begin DEF_CHARACTERISTIC c_n_32_fup_efp_diag c_fup_efp_bol_1 c_fup_efp_tol_1 c_fup_efp_tol_2 c_n_32_max_efppwm_plaus c_n_32_min_efppwm_plaus c_n_32_max_l_prs_sys c_n_32_min_l_prs_sys c_efppwm_i_diag_min c_efppwm_i_diag_max c_efppwm_i_ad_diag_min c_efppwm_i_ad_diag_max c_efppwm_min_ad_diag_min c_efppwm_min_ad_diag_max lc_efppwm_min_ena lc_efppwm_i_ad_ena c_tco_max_efppwm_plaus c_tco_min_efppwm_plaus c_t_ast_fup_efp_diag c_ftl_min_efppwm_plaus_diag c_ftl_min_l_prs_sys_diag /end DEF_CHARACTERISTIC
 /begin OUT_MEASUREMENT lv_err_efppwm_plaus lv_err_l_prs_sys /end OUT_MEASUREMENT
/end FUNCTION
/begin FUNCTION OBD_FUP_EFP_Diag__AI ""
 /begin DEF_CHARACTERISTIC c_abc_inc_efppwm_plaus c_abc_inc_l_prs_sys c_abc_max_efppwm_plaus c_abc_max_l_prs_sys /end DEF_CHARACTERISTIC
/end FUNCTION
/begin FUNCTION C_I_SEC "C_I_SEC"
 /begin SUB_FUNCTION SEC_Idle_Speed_Setpoint_offset_by_tester__KWP_ SEC_Input_Output_Control SEC_Constants_for_EOBD SEC_Immobilizer /end SUB_FUNCTION
/end FUNCTION
/begin FUNCTION SEC_Idle_Speed_Setpoint_offset_by_tester__KWP_ "_Idle Speed Setpoint offset by tester (KWP)"
 /begin DEF_CHARACTERISTIC c_n_ofs_acc_dri_min c_n_ofs_dri_max c_n_ofs_dri_min c_n_ofs_max c_n_ofs_min c_n_ofs_acc_max c_n_ofs_acc_min c_n_ofs_vb_max c_n_ofs_vb_min c_tco_min_n_ofs_kwp lc_n_ofs_kwp_disable c_cha_cdn_bat_kwp_min c_n_ofs_acc_dri_max /end DEF_CHARACTERISTIC
 /begin OUT_MEASUREMENT n_kwp_ofs_acc n_kwp_ofs n_kwp_ofs_vb_nvmy n_kwp_ofs_acc_nvmy n_kwp_ofs_nvmy n_kwp_ofs_dri_nvmy n_kwp_ofs_acc_dri_nvmy lv_kwp_ena n_sp_ofs_kwp n_kwp_ofs_acc_dri n_kwp_ofs_dri n_kwp_ofs_vb lv_act_n_sp_is_bas_ext_adj /end OUT_MEASUREMENT
/end FUNCTION
/begin FUNCTION SEC_Input_Output_Control "_Input Output Control"
 /begin DEF_CHARACTERISTIC id_idx_act_ds_conf ldp_idx_envd_id_idx_act_ds_conf ldp_idx_ds_id_idx_act_ds_conf c_n_max_kwp c_n_min_kwp c_tco_max_kwp c_tco_min_kwp c_vs_max_kwp c_vb_min_kwp /end DEF_CHARACTERISTIC
 /begin OUT_MEASUREMENT fac_fco_kwp eol_ram[0] eol_ram[1] eol_ram[2] eol_ram[3] eol_ram[4] eol_ram[5] n_sp_is_ext_adj lv_act_n_sp_is_ext_adj lv_eol_cps lv_act_vls_eol_ext_adj lv_pow_mng_mes_mod lv_pow_mng_his_rst lv_pow_mng_bat_chg lv_fhw_rst lv_poil_sp_ext_adj lv_poil_pwm_ext_adj lv_rly_crcv_heat_ext_adj lv_act_rly_crcv_heat_ext_adj lv_rly_main_ext_adj lv_act_rly_main_ext_adj lv_v_alter_sp_ext_adj v_alter_sp_ext_adj lv_vim_2_ext_adj lv_act_vim_2_ext_adj lv_n_rel_cwp_sp_ext_adj n_rel_cwp_sp_ext_adj lv_ef_ext_adj lv_act_ef_ext_adj lv_sof_ext_adj lv_act_sof_ext_adj lv_ecras_ext_adj lv_act_ecras_ext_adj lv_rly_st_ext_adj lv_act_rly_st_ext_adj lv_vim_1_ext_adj lv_act_vim_1_ext_adj lv_accout_rly_ext_adj lv_act_accout_rly_ext_adj lv_ebox_cfa_ext_adj lv_act_ebox_cfa_ext_adj lv_ectpwm_ext_adj ectpwm_ext_adj lv_sav_ext_adj lv_act_sav_ext_adj lv_sap_ext_adj lv_act_sap_ext_adj lv_dmtl_pump_ext_adj lv_act_dmtl_pump_ext_adj lv_dmtls_ext_adj lv_act_dmtls_ext_adj lv_dmtlh_ext_adj lv_act_dmtlh_ext_adj lv_cppwm_ext_adj cppwm_ext_adj lv_lshpwm_up_ext_adj[0] lv_lshpwm_up_ext_adj[1] lshpwm_up_ext_adj[0] lshpwm_up_ext_adj[1] lv_lshpwm_down_ext_adj[0] lv_lshpwm_down_ext_adj[1] lshpwm_down_ext_adj[0] lshpwm_down_ext_adj[1] lv_mil_ext_adj lv_act_mil_ext_adj lv_cru_ext_adj lv_act_cru_ext_adj lv_wal_1_ext_adj lv_act_wal_1_ext_adj lv_efp_ext_adj efppwm_ext_adj lv_ecfpwm_ecf_ext_adj ecfpwm_ecf_ext_adj lv_rly_vvl_ext_adj lv_act_rly_vvl_ext_adj lv_iv_ext_adj[0] lv_iv_ext_adj[1] lv_iv_ext_adj[2] lv_iv_ext_adj[3] lv_iv_ext_adj[4] lv_iv_ext_adj[5] iv_per_ext_adj[0] iv_per_ext_adj[1] iv_per_ext_adj[2] iv_per_ext_adj[3] iv_per_ext_adj[4] iv_per_ext_adj[5] iv_ext_adj[0] iv_ext_adj[1] iv_ext_adj[2] iv_ext_adj[3] iv_ext_adj[4] iv_ext_adj[5] lv_cam_sp_in_ext_adj cam_sp_in_ext_adj lv_cam_sp_ex_ext_adj cam_sp_ex_ext_adj lv_ad_dis_ext_adj lv_inh_lam_kwp qoil_ds_rst_kwp_1 qoil_ds_rst_kwp_2 qoil_ds_rst_kwp_3 qoil_ds_rst_kwp_4 qoil_ds_rst_kwp_5 qoil_ds_rst_kwp_6 qoil_ds_rst_kwp_7 qoil_ds_rst_kwp_8 fac_oil_ext_req_1 fac_oil_ext_req_2 state_cmb_ctl_kwp state_cmb_ctl_nvmy_kwp vs_max_sel_ext_req /end OUT_MEASUREMENT
/end FUNCTION
/begin FUNCTION SEC_Constants_for_EOBD "_Constants for EOBD" /begin OUT_MEASUREMENT cat_max_diag_mod_6 /end OUT_MEASUREMENT /end FUNCTION
/begin FUNCTION SEC_Immobilizer "_Immobilizer" /begin OUT_MEASUREMENT rls_mpl_value_prog state_imob nr_free_startvalues /end OUT_MEASUREMENT /end FUNCTION
/begin FUNCTION C_4_SYS "C_4_SYS"
 /begin SUB_FUNCTION SYS_Engine_speed_setpoint_calculation SYS_Engine_speed_limit_coordination SYS_Mass_airflow_variables SYS_Intake_manifold_model SYS_Pressure_decrease_in_the_air_filter SYS_Volumetric_efficiency SYS_Vehicle_speed_variables SYS_Battery_voltage SYS_Air_temperature SYS_Exhaust_temperature_variables SYS_Determination_of_accelerator_pedal_value SYS_Infinitely_Variable_Valve_Timing_IVVT_Variables SYS_Gear_ratio_detection SYS_Drive_train_engaged SYS_Clutch_switch_detection SYS_Input_messages SYS_Oil_temperature SYS_Ambient_pressure_variables SYS_System_variables_in_the_exhaust_pipe SYS_Detection_of_Driver_Passive SYS_System_variables_for_and_from_CUS SYS_ECU_state SYS_Pressure_Variables SYS_Engine_off_duration SYS_Total_running_time SYS_Determination_of_Throttle_Position _Intake_manifold_model SYS_ECU_Temperature SYS_Output_signals_of_the_DME_to_the_CAN_bus SYS_Check_Sum_Calculation SYS_Multiplexed_segment_synchronous_output_variables SYS_NOx_Sensor_Interface SYS_Application_Incidences_NOx_Sensor_Interface SYS_BN2000_interface_torque_distribution SYS_Driving_off_assistance SYS_Power_Steering_acquisition_variable SYS_Acquisition_of_exhaust_gas_temperature_downstream_of_pre_catalyst SYS_Fuel_pressure SYS_Modeled_Fuel_Temperature SYS_Fuel_pres_acq_ele_fuel_pump /end SUB_FUNCTION
/end FUNCTION
/begin FUNCTION SYS_Engine_speed_setpoint_calculation "_Engine speed setpoint calculation"
 /begin DEF_CHARACTERISTIC c_n_dif_crlc c_n_dif_min_mmv c_n_dif_fac ip_dri_acin_n_sp_is ip_n_sp_is_lih ip_dri_n_sp_is_lih ip_n_sp_is ip_acin_n_sp_is ip_fac_n_sp_ofs_kwp ip_t_ast_min_n_sp_is_cs c_n_sp_ofs_kwp_max c_tam_n_sp_heat c_tam_hys c_n_sp_heat_mt c_n_sp_heat_at c_n_sp_dec_cs c_n_sp_lgrd_is_lih c_n_sp_is_sa_eol c_n_sp_lgrd_is c_dri_vs_min_vb c_vs_max_n_sp_cs c_vs_hys_n_sp_cs lc_is_n_sp_cs_dis c_n_sp_is_pste_2_at c_n_sp_is_pste_2_mt c_n_sp_is_ars_mt c_n_sp_is_ars_at c_vs_max_n_sp_is_ars c_vs_min_n_sp_is_ars ip_dri_n_sp_is ip_n_sp_is_toil_at ip_n_sp_is_pste_2 ip_n_sp_is_pste c_n_sp_ofs_kwp_min c_n_sp_inc_cs c_n_sp_inc_pste c_n_sp_dec_pste c_dly_n_sp_dec_pste c_vs_min_n_sp_pste c_vs_min_n_sp_pste_2 c_ang_pste_isc c_vel_ang_pste_isc c_n_sp_inc_pl c_n_sp_dec_pl ip_n_sp_is_toil_mt c_toil_thd_n_sp_is c_toil_hys_n_sp_is ip_n_sp_is_knk_at ip_n_sp_is_knk_mt c_iga_adj_thd_n_sp_is c_iga_adj_hys_n_sp_is ip_n_sp_is_cs_opm_1 ip_n_sp_is_cs_opm_2 ip_n_sp_is_pl_opm_1 ip_n_sp_is_pl_opm_2 ip_n_sp_is_pl_amt_opm_1 ip_n_sp_is_pl_amt_opm_2 /end DEF_CHARACTERISTIC
 /begin OUT_MEASUREMENT n_dif_cor n_dif_mmv n_max_tol_st n_dif_st n_sp_is_ratio n_dif n_sp_is_pow n_sp_is_2 n_sp_is_3 lv_req_heat_n_sp_is n_sp_is lv_n_sp_is_cs lv_n_sp_is_pste lv_n_sp_is_pste_2 /end OUT_MEASUREMENT
/end FUNCTION
/begin FUNCTION SYS_Engine_speed_limit_coordination "_Engine speed limit coordination"
 /begin DEF_CHARACTERISTIC ip_n_max_mtc_cur_off__pv_av c_n_max_mtc_lih c_n_max_thd_min c_vs_max_amt c_n_max_amt_add c_n_max_amt_gp id_n_max_mt id_n_max_amt id_n_max_at id_n_max_h_mt id_n_max_h_amt id_n_max_h_at id_t_n_max_h_amt id_t_n_max_h_mt id_t_n_max_h_at id_n_dec_n_max_h_mt id_n_dec_n_max_h_amt id_n_dec_n_max_h_at c_n_max_dri_rvl c_vs_thd_n_max_h_mt c_vs_thd_n_max_h_amt c_vs_thd_n_max_h_at c_t_max_n_max_h_amt c_t_max_n_max_h_at c_t_max_n_max_h_mt c_t_gear_vs_max_at c_t_gear_vs_max_mt c_vs_max_hys c_vs_max_0_dft c_vs_max_1 c_vs_max_2 c_vs_max_3 ip_n_max_1__tco ip_n_max_2__tco c_n_max_egy_1 c_n_max_egy_2 c_n_max_egy_3 /end DEF_CHARACTERISTIC
 /begin OUT_MEASUREMENT n_max_thd_1 n_max_thd_2 lv_vs_max vs_ratio n_max_vs_max lv_n_max_h lv_n_max_etc_lih n_max_thd t_gear_vs_max /end OUT_MEASUREMENT
/end FUNCTION
/begin FUNCTION SYS_Mass_airflow_variables "_Mass airflow variables"
 /begin DEF_CHARACTERISTIC ip_pq_sp_puls c_pq_sp_hys_puls ip_fac_maf_kgh_cor c_maf_mmv_dif_crlc c_maf_mmv_hys /end DEF_CHARACTERISTIC
 /begin OUT_MEASUREMENT maf_kgh_mes_bas maf_mes maf_kgh_mes lv_maf_puls maf_kgh_mes_tcha maf_kgh_mes_bas_tcha maf_kgh maf_dif maf_mmv /end OUT_MEASUREMENT
/end FUNCTION
/begin FUNCTION SYS_Intake_manifold_model "_Intake manifold model" /begin DEF_CHARACTERISTIC lc_maf_tcha_mes c_fac_maf_tcha /end DEF_CHARACTERISTIC
 /begin OUT_MEASUREMENT maf_flow_ex egr_ratio maf_cyl map maf maf_thr fac_maf_max pq_egr maf_fg_cyl /end OUT_MEASUREMENT
/end FUNCTION
/begin FUNCTION SYS_Pressure_decrease_in_the_air_filter "_Pressure decrease in the air filter" /begin DEF_CHARACTERISTIC ip_amp_dec /end DEF_CHARACTERISTIC /begin OUT_MEASUREMENT put put_max /end OUT_MEASUREMENT /end FUNCTION
/begin FUNCTION SYS_Volumetric_efficiency "_Volumetric efficiency"
 /begin DEF_CHARACTERISTIC c_tcyl_stnd c_tco_stnd c_tia_im_stnd ip_crlc_eff_vol_temp_cor ip_eff_tco_fac__n_32__maf ip_eff_tia_im_fac__n_32__maf /end DEF_CHARACTERISTIC
 /begin OUT_MEASUREMENT eff_vol_temp_cor eff_vol_temp_cor_mmv /end OUT_MEASUREMENT
/end FUNCTION
/begin FUNCTION SYS_Vehicle_speed_variables "_Vehicle speed variables" /begin DEF_CHARACTERISTIC c_vs_min_run c_t_vst c_vs_edge_sum_min c_vs_fac /end DEF_CHARACTERISTIC
 /begin OUT_MEASUREMENT vs_edge_av.edge_ctr vs_edge_av.edge_t lv_vs_run vs_sens vs_sens_grd lv_vst vs /end OUT_MEASUREMENT
/end FUNCTION
/begin FUNCTION SYS_Battery_voltage "_Battery voltage"
 /begin DEF_CHARACTERISTIC c_crlc_vb c_vb_min_jump c_vb_min_obd2 c_vb_min_can_diag c_vb_max_obd1 c_vb_min_obd1 c_vb_max_obd2 c_t_min_can_diag c_vb_min_diag c_vb_min_bn_diag c_vb_min_can_tq_diag /end DEF_CHARACTERISTIC
 /begin OUT_MEASUREMENT lv_vb_jump vb_mmv lv_cdn_vb_obd1 lv_cdn_vb_obd2 vb vb_secu v_igk lv_cdn_vb_min_diag lv_cdn_vb_can_diag lv_cdn_vb_bn_diag lv_igk state_plaus_igk_bn lv_igk_prel lv_cdn_vb_can_tq_diag /end OUT_MEASUREMENT
/end FUNCTION
/begin FUNCTION SYS_Air_temperature "_Air temperature"
 /begin DEF_CHARACTERISTIC c_tia_grd_max_diag ip_tia__v_tia c_tco_diag c_tia_sub_tol c_tia_sub_bol ip_tia_tcha__v_tia_tcha /end DEF_CHARACTERISTIC
 /begin OUT_MEASUREMENT tia_sub tia_mes tia tia_st tia_tcha /end OUT_MEASUREMENT
/end FUNCTION
/begin FUNCTION SYS_Exhaust_temperature_variables "_Exhaust temperature variables"
 /begin DEF_CHARACTERISTIC c_v_teg_pcat_down_diag_min c_v_teg_pcat_down_diag_max c_v_teg_mes_grd_max /end DEF_CHARACTERISTIC
 /begin OUT_MEASUREMENT lv_err_prel_teg_pcat_down_2 lv_err_prel_teg_pcat_down_1 lv_err_teg_pcat_down_1 lv_err_teg_pcat_down_2 /end OUT_MEASUREMENT
/end FUNCTION
/begin FUNCTION SYS_Determination_of_accelerator_pedal_value "_Determination of accelerator pedal value"
 /begin DEF_CHARACTERISTIC c_pv_grd_lih_max c_v_pvs_hys_fil c_pvs_slop_1 c_pvs_slop_2 c_v_pvs_ofs_1 c_v_pvs_ofs_2 c_pv_av_bls_not_plaus_lgrd c_pv_av_bls_not_plaus_hys c_pv_av_bls_not_plaus ip_pv_lih_max ip_fac_pv_bas_cor_mt ip_fac_pv_bas_cor_at ip_fac_pv_bas_cor_amt ip_fac_pv_cs_cor_amt ip_fac_pv_gs_cor_amt ip_fac_pv_gs_cor_mt ip_fac_vs_pv_gs_cor_amt ip_fac_vs_pv_gs_cor_mt ip_fac_vs_pv_bas_cor_mt ip_fac_vs_pv_bas_cor_at ip_fac_vs_pv_bas_cor_amt c_add_fac_pv_bas_mt c_add_fac_pv_bas_at c_add_fac_pv_bas_amt c_t_fac_pv_gs c_v_pvs_thd_kd_hys c_v_pvs_thd_kd ip_pv_cru_rng_l ip_pv_cru ip_fac_pv_cs_cor_mt ip_fac_pv_cs_cor_at c_t_fac_pv_cs_at c_t_fac_pv_cs_mt c_vs_max_fac_pv_cor c_vs_max_fac_pv_cor_at /end DEF_CHARACTERISTIC
 /begin OUT_MEASUREMENT v_pvs_fil_1 v_pvs_fil_2 lv_kd pv_av pv_av_2 pv_max pv_av_grd pv_av_1 fac_pv_cs_cor fac_pv_gs_cor fac_pv_bas_cor fac_pv_cor pv_av_raw pv_cru pv_cus pv_cus_1 pv_cus_2 pv_cus_raw pv_cru_1 pv_cru_raw /end OUT_MEASUREMENT
/end FUNCTION
/begin FUNCTION SYS_Infinitely_Variable_Valve_Timing_IVVT_Variables "_Infinitely Variable Valve Timing IVVT Variables" /begin DEF_CHARACTERISTIC c_cam_op_in c_cam_op_ex /end DEF_CHARACTERISTIC /end FUNCTION
/begin FUNCTION SYS_Gear_ratio_detection "_Gear ratio detection"
 /begin DEF_CHARACTERISTIC c_min_vs_ratio id_gr_mt__n_vs_ratio lc_rng_l c_gr_rax_sp c_crlc_fac_gr c_n_vs_cru_gear2_puc_sp c_n_vs_cru_grd_fac_gr_max c_state_etcu_prog_info /end DEF_CHARACTERISTIC
 /begin OUT_MEASUREMENT gr_mt gr_at lv_rng_l lv_dri gear_ef state_gear_rev_at_amt n_vs_ratio fac_gr fac_gr_mmv_av gr_rax_av lv_rng_l_at /end OUT_MEASUREMENT
/end FUNCTION
/begin FUNCTION SYS_Drive_train_engaged "_Drive train engaged" /begin DEF_CHARACTERISTIC c_vs_min_dt /end DEF_CHARACTERISTIC /begin OUT_MEASUREMENT lv_dt /end OUT_MEASUREMENT /end FUNCTION
/begin FUNCTION SYS_Clutch_switch_detection "_Clutch switch detection" /begin OUT_MEASUREMENT lv_cs_cus /end OUT_MEASUREMENT /end FUNCTION
/end MODULE
/end PROJECT
