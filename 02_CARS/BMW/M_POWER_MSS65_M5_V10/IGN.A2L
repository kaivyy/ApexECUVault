/begin PROJECT MSS65-ign "Generiert am 05.06.02 um 07:49:27"
/begin HEADER "" VERSION "R341" /end HEADER
/begin MODULE _MSS65-ign "Generiert am 05.06.02 um 07:49:27"
/begin COMPU_METHOD FORMULA_USER1 "FORMULA_USER1" RAT_FUNC "" "-" COEFFS 0 1 0 0 0 1 /end COMPU_METHOD
/begin MEASUREMENT sys_sypcr "Watchdog-Register" ULONG FORMULA_USER1 0 0 0.0000 4294967295.0000 IF_DATA DIM 0x2FC004 INTERN LONG ECU_ADDRESS 0x2FC004 /begin FUNCTION_LIST sys_zust /end FUNCTION_LIST /end MEASUREMENT
/*----------------------------Kurbelwelle----------------------------------------------------------*/
/begin MEASUREMENT tpu_kw_zz_720 "TPUB_ParameterRam" UBYTE FORMULA_USER1 0 0 0.0000 200.0000 IF_DATA DIM 0x304101 INTERN LONG ECU_ADDRESS 0x304101 /begin FUNCTION_LIST tpu_ram /end FUNCTION_LIST /end MEASUREMENT
/begin MEASUREMENT tpu_kw_zz_360 "TPUB_ParameterRam" UBYTE FORMULA_USER1 0 0 0.0000 200.0000 IF_DATA DIM 0x304103 INTERN LONG ECU_ADDRESS 0x304103 /begin FUNCTION_LIST tpu_ram /end FUNCTION_LIST /end MEASUREMENT
/begin MOD_COMMON "" BYTE_ORDER MSB_FIRST /* Default byteorder (Motorola) */ /end MOD_COMMON
/begin COMPU_METHOD DEFAULT_FORMULA "DEFAULT_FORMULA" RAT_FUNC "%7.0" "" COEFFS 0 1 0 0 0 1 /end COMPU_METHOD
/* ------------------ Abschnitt erzeugt aus debug.dat ------------------ */
/begin COMPU_METHOD FORMULA_0000 "FORMULA_0000" RAT_FUNC "%5.0" "-" COEFFS 0 1 0 0 0 1 /end COMPU_METHOD
/begin COMPU_METHOD FORMULA_0001 "FORMULA_0001" RAT_FUNC "%7.0" "-" COEFFS 0 1 0 0 0 1 /end COMPU_METHOD
/* ------------------ Abschnitt erzeugt aus glob.dat ------------------ */
/begin COMPU_METHOD FORMULA_0004 "FORMULA_0004" RAT_FUNC "%8.3" "-" COEFFS 0 16384 0 0 0 1 /end COMPU_METHOD
/begin COMPU_METHOD FORMULA_0006 "FORMULA_0006" RAT_FUNC "%8.3" "-" COEFFS 0 10000 0 0 0 1 /end COMPU_METHOD
/begin COMPU_METHOD FORMULA_0008 "FORMULA_0008" RAT_FUNC "%3.0" "-" COEFFS 0 1 0 0 0 1 /end COMPU_METHOD
/begin COMPU_METHOD FORMULA_0010 "FORMULA_0010" RAT_FUNC "%6.1" "kg/h" COEFFS 0 10 0 0 0 1 /end COMPU_METHOD
/begin COMPU_METHOD FORMULA_0011 "FORMULA_0011" RAT_FUNC "%5.0" "Upm" COEFFS 0 1 0 0 0 1 /end COMPU_METHOD
/begin COMPU_METHOD FORMULA_0012 "FORMULA_0012" RAT_FUNC "%5.0" "Upm/s" COEFFS 0 1 0 0 0 1 /end COMPU_METHOD
/begin COMPU_METHOD FORMULA_0017 "FORMULA_0017" TAB_VERB "%7.2" "-" COMPU_TAB_REF FORMULA_0017_VTAB /end COMPU_METHOD
/begin COMPU_VTAB FORMULA_0017_VTAB "FORMULA_0017_VTAB" TAB_VERB 15 0 "O.K." 1 "SH_TO_UB" 2 "SH_TO_GND" 4 "OPENLOAD" 8 "UNPLAUSIBEL" 32 "FILTER" 33 "FILTER/SH_TO_UB" 34 "FILTER/SH_TO_GND" 36 "FILTER/OPENLOAD" 40 "FILTER/UNPLAUSIBEL" 96 "FEHLER" 97 "FEHLER/SH_TO_UB" 98 "FEHLER/SH_TO_GND" 100 "FEHLER/OPENLOAD" 104 "FEHLER/UNPLAUSIBEL" /end COMPU_VTAB
/begin COMPU_METHOD FORMULA_0018 "FORMULA_0018" RAT_FUNC "%6.1" "Nm" COEFFS 0 10 0 0 0 1 /end COMPU_METHOD
/begin COMPU_METHOD FORMULA_0019 "FORMULA_0019" RAT_FUNC "%6.1" "øC" COEFFS 0 10 2732 0 0 1 /end COMPU_METHOD
/begin COMPU_METHOD FORMULA_0021 "FORMULA_0021" TAB_VERB "%7.2" "-" COMPU_TAB_REF FORMULA_0021_VTAB /end COMPU_METHOD
/begin COMPU_VTAB FORMULA_0021_VTAB "FORMULA_0021_VTAB" TAB_VERB 11 1 "Motor steht" 2 "Motor presync" 4 "Start" 8 "LLOKS" 16 "LLMKS" 32 "TL" 64 "VL" 128 "SA" 256 "NL" 512 "Abgew." 1024 "Kl15 aus" DEFAULT_VALUE "undefiniert" /end COMPU_VTAB
/begin COMPU_METHOD FORMULA_0022 "FORMULA_0022" RAT_FUNC "%6.1" "%" COEFFS 0 10 0 0 0 1 /end COMPU_METHOD
/begin COMPU_METHOD FORMULA_0024 "FORMULA_0024" RAT_FUNC "%7.2" "-" COEFFS 0 1 0 0 0 1 /end COMPU_METHOD
/begin COMPU_METHOD FORMULA_0031 "FORMULA_0031" RAT_FUNC "%6.1" "mbar" COEFFS 0 16 0 0 0 1 /end COMPU_METHOD
/begin COMPU_METHOD FORMULA_0035 "FORMULA_0035" RAT_FUNC "%8.3" "-" COEFFS 0 1024 0 0 0 1 /end COMPU_METHOD
/begin COMPU_METHOD FORMULA_0037 "FORMULA_0037" RAT_FUNC "%6.1" "ø" COEFFS 0 10 0 0 0 1 /end COMPU_METHOD
/begin COMPU_METHOD FORMULA_0045 "FORMULA_0045" RAT_FUNC "%6.1" "V" COEFFS 0 10 0 0 0 1 /end COMPU_METHOD
/begin COMPU_METHOD FORMULA_0046 "FORMULA_0046" RAT_FUNC "%7.2" "V" COEFFS 0 1966080 0 0 0 200 /end COMPU_METHOD
/begin COMPU_METHOD FORMULA_0047 "FORMULA_0047" RAT_FUNC "%5.2" "-" COEFFS 0 1 0 0 0 1 /end COMPU_METHOD
/* ------------------ Abschnitt erzeugt aus pctrl.dat ------------------ */
/begin COMPU_METHOD FORMULA_0068 "FORMULA_0068" RAT_FUNC "%3.0" "ms" COEFFS 0 1 0 0 0 10 /end COMPU_METHOD
/* ------------------ Abschnitt erzeugt aus spi.dat ------------------ */
/begin COMPU_METHOD FORMULA_0069 "FORMULA_0069" TAB_VERB "%3.0" "-" COMPU_TAB_REF FORMULA_0069_VTAB /end COMPU_METHOD
/begin COMPU_VTAB FORMULA_0069_VTAB "FORMULA_0069_VTAB" TAB_VERB 2 0 "frei" 128 "Belegt" DEFAULT_VALUE "undefiniert" /end COMPU_VTAB
/begin COMPU_METHOD FORMULA_0070 "FORMULA_0070" TAB_VERB "%3.0" "-" COMPU_TAB_REF FORMULA_0070_VTAB /end COMPU_METHOD
/begin COMPU_VTAB FORMULA_0070_VTAB "FORMULA_0070_VTAB" TAB_VERB 4 0 "in Ordnung" 128 "queue full" 64 "queue fehler" 32 "IRQ illegal" DEFAULT_VALUE "undefiniert" /end COMPU_VTAB
/* ------------------ Abschnitt erzeugt aus sw_confg.dat ------------------ */
/begin COMPU_METHOD FORMULA_0071 "FORMULA_0071" TAB_VERB "%7.2" "-" COMPU_TAB_REF FORMULA_0071_VTAB /end COMPU_METHOD
/begin COMPU_VTAB FORMULA_0071_VTAB "FORMULA_0071_VTAB" TAB_VERB 5 8192 "S65" 8448 "S65FLACH" 8704 "S65V" 256 "S15" 16384 "S85" DEFAULT_VALUE "undefiniert" /end COMPU_VTAB
/begin COMPU_METHOD FORMULA_0072 "FORMULA_0072" TAB_VERB "%5.2" "-" COMPU_TAB_REF FORMULA_0072_VTAB /end COMPU_METHOD
/begin COMPU_VTAB FORMULA_0072_VTAB "FORMULA_0072_VTAB" TAB_VERB 7 16 "E60" 17 "E63" 18 "E64" 32 "E65" 64 "E85" 128 "E90" 129 "E91" DEFAULT_VALUE "undefiniert" /end COMPU_VTAB
/begin COMPU_METHOD FORMULA_0073 "FORMULA_0073" TAB_VERB "%5.2" "-" COMPU_TAB_REF FORMULA_0073_VTAB /end COMPU_METHOD
/begin COMPU_VTAB FORMULA_0073_VTAB "FORMULA_0073_VTAB" TAB_VERB 2 16 "HS" 64 "SMG" DEFAULT_VALUE "undefiniert" /end COMPU_VTAB
/begin COMPU_METHOD FORMULA_0074 "FORMULA_0074" TAB_VERB "%5.2" "-" COMPU_TAB_REF FORMULA_0074_VTAB /end COMPU_METHOD
/begin COMPU_VTAB FORMULA_0074_VTAB "FORMULA_0074_VTAB" TAB_VERB 5 1 "ECE" 2 "US" 4 "Golfstaaten" 8 "ZA" 16 "JAPAN" DEFAULT_VALUE "undefiniert" /end COMPU_VTAB
/begin COMPU_METHOD FORMULA_0075 "FORMULA_0075" TAB_VERB "%5.2" "-" COMPU_TAB_REF FORMULA_0075_VTAB /end COMPU_METHOD
/begin COMPU_VTAB FORMULA_0075_VTAB "FORMULA_0075_VTAB" TAB_VERB 6 16 "EU3" 17 "EU4" 1 "D4" 32 "LEV" 33 "LEV2" 34 "ULEV" DEFAULT_VALUE "undefiniert" /end COMPU_VTAB
/begin COMPU_METHOD FORMULA_0076 "FORMULA_0076" TAB_VERB "%5.2" "-" COMPU_TAB_REF FORMULA_0076_VTAB /end COMPU_METHOD
/begin COMPU_VTAB FORMULA_0076_VTAB "FORMULA_0076_VTAB" TAB_VERB 3 1 "MIL_OFF" 2 "MIL_FSP" 4 "MIL_ON" DEFAULT_VALUE "undefiniert" /end COMPU_VTAB
/begin COMPU_METHOD FORMULA_0077 "FORMULA_0077" TAB_VERB "%5.2" "-" COMPU_TAB_REF FORMULA_0077_VTAB /end COMPU_METHOD
/begin COMPU_VTAB FORMULA_0077_VTAB "FORMULA_0077_VTAB" TAB_VERB 4 128 "Serienstand" 16 "A-Muster" 32 "B-Muster" 64 "C-Muster" DEFAULT_VALUE "undefiniert" /end COMPU_VTAB
/begin COMPU_METHOD FORMULA_0078 "FORMULA_0078" TAB_VERB "%5.2" "-" COMPU_TAB_REF FORMULA_0078_VTAB /end COMPU_METHOD
/begin COMPU_VTAB FORMULA_0078_VTAB "FORMULA_0078_VTAB" TAB_VERB 2 1 "CAN 11H" 2 "CAN 12H" DEFAULT_VALUE "undefiniert" /end COMPU_VTAB
/begin COMPU_METHOD FORMULA_0079 "FORMULA_0079" TAB_VERB "%5.2" "-" COMPU_TAB_REF FORMULA_0079_VTAB /end COMPU_METHOD
/begin COMPU_VTAB FORMULA_0079_VTAB "FORMULA_0079_VTAB" TAB_VERB 3 0 "Fz-Betrieb" 1 "Pruefstand" 2 "Rolle" /end COMPU_VTAB
/begin COMPU_METHOD FORMULA_0080 "FORMULA_0080" TAB_VERB "%5.2" "-" COMPU_TAB_REF FORMULA_0080_VTAB /end COMPU_METHOD
/begin COMPU_VTAB FORMULA_0080_VTAB "FORMULA_0080_VTAB" TAB_VERB 2 0 "aus RAM" 1 "aus Flash" /end COMPU_VTAB
/* ------------------ Abschnitt erzeugt aus sys_zust.dat ------------------ */
/begin COMPU_METHOD FORMULA_0081 "FORMULA_0081" TAB_VERB "%7.2" "-" COMPU_TAB_REF FORMULA_0081_VTAB /end COMPU_METHOD
/begin COMPU_VTAB FORMULA_0081_VTAB "FORMULA_0081_VTAB" TAB_VERB 0 /end COMPU_VTAB
/* ------------------ Abschnitt erzeugt aus version.dat ------------------ */
/begin COMPU_METHOD FORMULA_0082 "FORMULA_0082" TAB_VERB "%5.2" "-" COMPU_TAB_REF FORMULA_0082_VTAB /end COMPU_METHOD
/begin COMPU_VTAB FORMULA_0082_VTAB "FORMULA_0082_VTAB" TAB_VERB 2 1 "INJ" 2 "IGN" DEFAULT_VALUE "undefiniert" /end COMPU_VTAB
/begin COMPU_METHOD FORMULA_0083 "FORMULA_0083" TAB_VERB "%5.2" "-" COMPU_TAB_REF FORMULA_0083_VTAB /end COMPU_METHOD
/begin COMPU_VTAB FORMULA_0083_VTAB "FORMULA_0083_VTAB" TAB_VERB 23 0 "Labordaten" 1 "EE24" 2 "Ast" 3 "Prerauer" 4 "Gerum" 5 "Heiss" 6 "Lutz" 7 "Maier" 8 "Menn" 9 "Neumann" 10 "Wilke" 11 "Scherer" 12 "Scherrer" 13 "Fischer" 14 "May" 15 "ECE" 16 "US" 17 "Habermann" 18 "Moesbauer" 19 "Hartke" 20 "Renner" 21 "Stoll" 22 "Schaefer" DEFAULT_VALUE "unbekannt" /end COMPU_VTAB
/begin COMPU_METHOD FORMULA_0088 "FORMULA_0088" RAT_FUNC "%8.3" "V" COEFFS 0 1024 0 0 0 5 /end COMPU_METHOD
/begin COMPU_METHOD FORMULA_0089 "FORMULA_0089" RAT_FUNC "%8.3" "V" COEFFS 0 2048 0 0 0 5 /end COMPU_METHOD
/begin COMPU_METHOD FORMULA_0090 "FORMULA_0090" RAT_FUNC "%6.1" "Kelvin" COEFFS 0 10 0 0 0 1 /end COMPU_METHOD
/begin COMPU_METHOD FORMULA_0104 "FORMULA_0104" RAT_FUNC "%9.2" "-" COEFFS 0 1 0 0 0 1 /end COMPU_METHOD
/begin COMPU_METHOD FORMULA_0126 "FORMULA_0126" RAT_FUNC "%7.2" "s" COEFFS 0 100 0 0 0 1 /end COMPU_METHOD
/begin COMPU_METHOD FORMULA_0135 "FORMULA_0135" RAT_FUNC "%6.1" "s" COEFFS 0 10 0 0 0 1 /end COMPU_METHOD
/* ------------------ Abschnitt erzeugt aus km.dat ------------------ */
/begin COMPU_METHOD FORMULA_0153 "FORMULA_0153" RAT_FUNC "%6.1" "°KW" COEFFS 0 65536 0 0 0 720 /end COMPU_METHOD
/* ------------------ Abschnitt erzeugt aus lfr.dat ------------------ */
/begin COMPU_METHOD FORMULA_0167 "FORMULA_0167" RAT_FUNC "%8.3" "Nm" COEFFS 0 80 0 0 0 1 /end COMPU_METHOD
/begin COMPU_METHOD FORMULA_0168 "FORMULA_0168" RAT_FUNC "%6.1" "Nm" COEFFS 0 160 0 0 0 1 /end COMPU_METHOD
/begin COMPU_METHOD FORMULA_0169 "FORMULA_0169" TAB_VERB "%7.2" "-" COMPU_TAB_REF FORMULA_0169_VTAB /end COMPU_METHOD
/begin COMPU_VTAB FORMULA_0169_VTAB "FORMULA_0169_VTAB" TAB_VERB 5 1 "Integratorstop" 2 "Leerlaufregelung" 4 "Anfahrregelung" 8 "Absteuerung B1" 16 "Absteuern B2" DEFAULT_VALUE "ERROR" /end COMPU_VTAB
/begin COMPU_METHOD FORMULA_0170 "FORMULA_0170" TAB_VERB "%5.2" "-" COMPU_TAB_REF FORMULA_0170_VTAB /end COMPU_METHOD
/begin COMPU_VTAB FORMULA_0170_VTAB "FORMULA_0170_VTAB" TAB_VERB 4 3 "PI-aktiv." 7 "PI+Adapt aktiv" 15 "PID+Adapt.aktiv" 31 "PID+Adapt+TZ" DEFAULT_VALUE "ERROR" /end COMPU_VTAB
/begin COMPU_METHOD FORMULA_0171 "FORMULA_0171" RAT_FUNC "%3.0" "Upm/s" COEFFS 0 1 0 0 0 1 /end COMPU_METHOD
/begin COMPU_METHOD FORMULA_0172 "FORMULA_0172" RAT_FUNC "%4.1" "km/h" COEFFS 0 16 0 0 0 1 /end COMPU_METHOD
/begin COMPU_METHOD FORMULA_0173 "FORMULA_0173" RAT_FUNC "%3.0" "Upm" COEFFS 0 1 0 0 0 1 /end COMPU_METHOD
/begin COMPU_METHOD FORMULA_0174 "FORMULA_0174" RAT_FUNC "%7.2" "Nm" COEFFS 0 160 0 0 0 1 /end COMPU_METHOD
/begin COMPU_METHOD FORMULA_0175 "FORMULA_0175" RAT_FUNC "%7.2" "-" COEFFS 0 0 5.12 0 1 0 /end COMPU_METHOD
/begin COMPU_METHOD FORMULA_0176 "FORMULA_0176" RAT_FUNC "%8.3" "Nm" COEFFS 0 160 0 0 0 1 /end COMPU_METHOD
/begin COMPU_METHOD FORMULA_0177 "FORMULA_0177" RAT_FUNC "%9.4" "Nm" COEFFS 0 160 0 0 0 1 /end COMPU_METHOD
/* ------------------ Abschnitt erzeugt aus md_basis.dat ------------------ */
/begin COMPU_METHOD FORMULA_0178 "FORMULA_0178" RAT_FUNC "%5.2" "-" COEFFS 0 128 0 0 0 1 /end COMPU_METHOD
/begin COMPU_METHOD FORMULA_0179 "FORMULA_0179" RAT_FUNC "%6.1" "Nm" COEFFS 0 100 0 0 0 1 /end COMPU_METHOD
/begin COMPU_METHOD FORMULA_0180 "FORMULA_0180" RAT_FUNC "%7.2" "Nm/s" COEFFS 0 10 0 0 0 1 /end COMPU_METHOD
/begin COMPU_METHOD FORMULA_0181 "FORMULA_0181" RAT_FUNC "%6.1" "%" COEFFS 0 32768 0 0 0 100 /end COMPU_METHOD
/begin COMPU_METHOD FORMULA_0182 "FORMULA_0182" RAT_FUNC "%7.2" "10E-4" COEFFS 0 100 0 0 0 1 /end COMPU_METHOD
/begin COMPU_METHOD FORMULA_0183 "FORMULA_0183" RAT_FUNC "%5.2" "s" COEFFS 0 0 2.56 0 1 0 /end COMPU_METHOD
/begin COMPU_METHOD FORMULA_0184 "FORMULA_0184" TAB_VERB "%3.0" "-" COMPU_TAB_REF FORMULA_0184_VTAB /end COMPU_METHOD
/begin COMPU_VTAB FORMULA_0184_VTAB "FORMULA_0184_VTAB" TAB_VERB 2 0 "aus" 1 "KKOS" /end COMPU_VTAB
/begin COMPU_METHOD FORMULA_0185 "FORMULA_0185" TAB_VERB "%3.0" "-" COMPU_TAB_REF FORMULA_0185_VTAB /end COMPU_METHOD
/begin COMPU_VTAB FORMULA_0185_VTAB "FORMULA_0185_VTAB" TAB_VERB 2 0 "ohne RG" 1 "mit RG" /end COMPU_VTAB
/begin COMPU_METHOD FORMULA_0186 "FORMULA_0186" RAT_FUNC "%6.1" "ms" COEFFS 0 10 0 0 0 1 /end COMPU_METHOD
/* ------------------ Abschnitt erzeugt aus md_filter.dat ------------------ */
/begin COMPU_METHOD FORMULA_0187 "FORMULA_0187" TAB_VERB "%3.0" "-" COMPU_TAB_REF FORMULA_0187_VTAB /end COMPU_METHOD
/begin COMPU_VTAB FORMULA_0187_VTAB "FORMULA_0187_VTAB" TAB_VERB 2 0 "Inaktiv" 1 "SA aktiv" /end COMPU_VTAB
/begin COMPU_METHOD FORMULA_0188 "FORMULA_0188" RAT_FUNC "%6.1" "Nm/5ms" COEFFS 0 10 0 0 0 1 /end COMPU_METHOD
/* ------------------ Abschnitt erzeugt aus md_sk.dat ------------------ */
/begin COMPU_METHOD FORMULA_0189 "FORMULA_0189" TAB_VERB "%3.0" "-" COMPU_TAB_REF FORMULA_0189_VTAB /end COMPU_METHOD
/begin COMPU_VTAB FORMULA_0189_VTAB "FORMULA_0189_VTAB" TAB_VERB 7 0 "kein Fehler" 1 "Md-Chk0" 2 "Md-Chk" 4 "MDmin-Chk" 8 "Rf-Chk" 16 "Eta-Chk" 32 "LLR-Chk" DEFAULT_VALUE "Mehrfach" /end COMPU_VTAB
/begin COMPU_METHOD FORMULA_0190 "FORMULA_0190" TAB_VERB "%5.2" "-" COMPU_TAB_REF FORMULA_0190_VTAB /end COMPU_METHOD
/begin COMPU_VTAB FORMULA_0190_VTAB "FORMULA_0190_VTAB" TAB_VERB 2 0 "SK aus" 1 "SK aktiv" /end COMPU_VTAB
/begin COMPU_METHOD FORMULA_0191 "FORMULA_0191" RAT_FUNC "%4.1" "%" COEFFS 0 10 0 0 0 1 /end COMPU_METHOD
/* ------------------ Abschnitt erzeugt aus md_soll.dat ------------------ */
/begin COMPU_METHOD FORMULA_0192 "FORMULA_0192" TAB_VERB "%5.2" "-" COMPU_TAB_REF FORMULA_0192_VTAB /end COMPU_METHOD
/begin COMPU_VTAB FORMULA_0192_VTAB "FORMULA_0192_VTAB" TAB_VERB 2 0 "Inaktiv" 1 "Aktiv" /end COMPU_VTAB
/begin COMPU_METHOD FORMULA_0193 "FORMULA_0193" TAB_VERB "%5.2" "-" COMPU_TAB_REF FORMULA_0193_VTAB /end COMPU_METHOD
/begin COMPU_VTAB FORMULA_0193_VTAB "FORMULA_0193_VTAB" TAB_VERB 2 0 "Bezug=Sollmoment" 1 "Bezug=Istmoment" /end COMPU_VTAB
/begin COMPU_METHOD FORMULA_0194 "FORMULA_0194" TAB_VERB "%5.2" "-" COMPU_TAB_REF FORMULA_0194_VTAB /end COMPU_METHOD
/begin COMPU_VTAB FORMULA_0194_VTAB "FORMULA_0194_VTAB" TAB_VERB 2 0 "Inaktiv" 17 "Aktiv" /end COMPU_VTAB
/* ------------------ Abschnitt erzeugt aus pwg.dat ------------------ */
/begin COMPU_METHOD FORMULA_0197 "FORMULA_0197" TAB_VERB "%5.2" "-" COMPU_TAB_REF FORMULA_0197_VTAB /end COMPU_METHOD
/begin COMPU_VTAB FORMULA_0197_VTAB "FORMULA_0197_VTAB" TAB_VERB 2 0 "O.K." 1 "Filter" /end COMPU_VTAB
/begin COMPU_METHOD FORMULA_0198 "FORMULA_0198" TAB_VERB "%5.2" "-" COMPU_TAB_REF FORMULA_0198_VTAB /end COMPU_METHOD
/begin COMPU_VTAB FORMULA_0198_VTAB "FORMULA_0198_VTAB" TAB_VERB 2 0 "O.K." 2 "Fehler" /end COMPU_VTAB
/begin COMPU_METHOD FORMULA_0199 "FORMULA_0199" TAB_VERB "%5.2" "-" COMPU_TAB_REF FORMULA_0199_VTAB /end COMPU_METHOD
/begin COMPU_VTAB FORMULA_0199_VTAB "FORMULA_0199_VTAB" TAB_VERB 2 0 "O.K." 4 "Fehler" /end COMPU_VTAB
/begin COMPU_METHOD FORMULA_0200 "FORMULA_0200" TAB_VERB "%5.2" "-" COMPU_TAB_REF FORMULA_0200_VTAB /end COMPU_METHOD
/begin COMPU_VTAB FORMULA_0200_VTAB "FORMULA_0200_VTAB" TAB_VERB 2 0 "O.K." 8 "Fehler" /end COMPU_VTAB
/begin COMPU_METHOD FORMULA_0201 "FORMULA_0201" TAB_VERB "%5.2" "-" COMPU_TAB_REF FORMULA_0201_VTAB /end COMPU_METHOD
/begin COMPU_VTAB FORMULA_0201_VTAB "FORMULA_0201_VTAB" TAB_VERB 2 0 "O.K." 16 "Fehler" /end COMPU_VTAB
/begin COMPU_METHOD FORMULA_0202 "FORMULA_0202" TAB_VERB "%5.2" "-" COMPU_TAB_REF FORMULA_0202_VTAB /end COMPU_METHOD
/begin COMPU_VTAB FORMULA_0202_VTAB "FORMULA_0202_VTAB" TAB_VERB 2 0 "O.K." 32 "Fehler" /end COMPU_VTAB
/begin COMPU_METHOD FORMULA_0203 "FORMULA_0203" TAB_VERB "%5.2" "-" COMPU_TAB_REF FORMULA_0203_VTAB /end COMPU_METHOD
/begin COMPU_VTAB FORMULA_0203_VTAB "FORMULA_0203_VTAB" TAB_VERB 2 0 "O.K." 1 "Bremse" /end COMPU_VTAB
/begin COMPU_METHOD FORMULA_0204 "FORMULA_0204" TAB_VERB "%5.2" "-" COMPU_TAB_REF FORMULA_0204_VTAB /end COMPU_METHOD
/begin COMPU_VTAB FORMULA_0204_VTAB "FORMULA_0204_VTAB" TAB_VERB 2 0 "O.K." 2 "Sperre" /end COMPU_VTAB
/begin COMPU_METHOD FORMULA_0205 "FORMULA_0205" RAT_FUNC "%9.4" "-" COEFFS 0 65536 0 0 0 1 /end COMPU_METHOD
/begin COMPU_METHOD FORMULA_0206 "FORMULA_0206" RAT_FUNC "%5.0" "digit" COEFFS 0 1 0 0 0 1 /end COMPU_METHOD
/begin COMPU_METHOD FORMULA_0207 "FORMULA_0207" RAT_FUNC "%8.3" "%" COEFFS 0 640 0 0 0 1 /end COMPU_METHOD
/begin COMPU_METHOD FORMULA_0208 "FORMULA_0208" RAT_FUNC "%5.0" "%/s" COEFFS 0 1 0 0 0 50 /end COMPU_METHOD
/begin COMPU_METHOD FORMULA_0209 "FORMULA_0209" RAT_FUNC "%8.3" "%/V" COEFFS 0 100 0 0 0 1 /end COMPU_METHOD
/begin COMPU_METHOD FORMULA_0210 "FORMULA_0210" RAT_FUNC "%5.2" "s" COEFFS 0 0 25.6 0 1 0 /end COMPU_METHOD
/begin COMPU_METHOD FORMULA_0211 "FORMULA_0211" RAT_FUNC "%7.2" "s" COEFFS 0 0 655.35 0 1 0 /end COMPU_METHOD
/* ------------------ Abschnitt erzeugt aus start_rl.dat ------------------ */
/begin COMPU_METHOD FORMULA_0212 "FORMULA_0212" TAB_VERB "%3.0" "-" COMPU_TAB_REF FORMULA_0212_VTAB /end COMPU_METHOD
/begin COMPU_VTAB FORMULA_0212_VTAB "FORMULA_0212_VTAB" TAB_VERB 2 0 "Startrelais aus" 64 "Startrelais ein" /end COMPU_VTAB
/* ------------------ Abschnitt erzeugt aus tan.dat ------------------ */
/begin COMPU_METHOD FORMULA_0223 "FORMULA_0223" RAT_FUNC "%8.3" "øC" COEFFS 0 40 10926 0 0 1 /end COMPU_METHOD
/* ------------------ Abschnitt erzeugt aus tmot.dat ------------------ */
/begin COMPU_METHOD FORMULA_0225 "FORMULA_0225" RAT_FUNC "%11.4" "øC" COEFFS 0 163840 44752896 0 0 1 /end COMPU_METHOD
/begin COMPU_METHOD FORMULA_0226 "FORMULA_0226" RAT_FUNC "%5.0" "s" COEFFS 0 1000 0 0 0 1 /end COMPU_METHOD
/begin COMPU_METHOD FORMULA_0227 "FORMULA_0227" RAT_FUNC "%8.3" "Kelvin" COEFFS 0 40 0 0 0 1 /end COMPU_METHOD
/begin COMPU_METHOD FORMULA_0228 "FORMULA_0228" RAT_FUNC "%8.3" "Kelvin/s" COEFFS 0 16384 0 0 0 1 /end COMPU_METHOD
/* ------------------ Abschnitt erzeugt aus tm_ign.dat ------------------ */
/begin COMPU_METHOD FORMULA_0229 "FORMULA_0229" RAT_FUNC "%9.2" "ms" COEFFS 0 2500 0 0 0 1 /end COMPU_METHOD
/* ------------------ Abschnitt erzeugt aus tpu_ign.dat ------------------ */
/begin COMPU_METHOD FORMULA_0230 "FORMULA_0230" TAB_VERB "%3.0" "-" COMPU_TAB_REF FORMULA_0230_VTAB /end COMPU_METHOD
/begin COMPU_VTAB FORMULA_0230_VTAB "FORMULA_0230_VTAB" TAB_VERB 5 0 "sync - 720° Mode" 1 "sync - 360° Mode" 129 "suche Luecke" 161 "Zahnentprellung laeuft" 225 "nicht sync." /end COMPU_VTAB
/begin COMPU_METHOD FORMULA_0231 "FORMULA_0231" TAB_VERB "%3.0" "-" COMPU_TAB_REF FORMULA_0231_VTAB /end COMPU_METHOD
/begin COMPU_VTAB FORMULA_0231_VTAB "FORMULA_0231_VTAB" TAB_VERB 6 2 "krititischer Fehler" 4 "unkritischer Fehler" 8 "Unterdrehzahl" 16 "Zahninterrupt" 32 "Segmentinterrupt" 64 "Sync-Interrupt" /end COMPU_VTAB
/begin COMPU_METHOD FORMULA_0232 "FORMULA_0232" TAB_VERB "%3.0" "-" COMPU_TAB_REF FORMULA_0232_VTAB /end COMPU_METHOD
/begin COMPU_VTAB FORMULA_0232_VTAB "FORMULA_0232_VTAB" TAB_VERB 4 1 "warte Sync." 2 "Sync. laeuft" 4 "synchronisiert" 8 "nicht sync." DEFAULT_VALUE "gibts nicht" /end COMPU_VTAB
/begin COMPU_METHOD FORMULA_0233 "FORMULA_0233" TAB_VERB "%3.0" "-" COMPU_TAB_REF FORMULA_0233_VTAB /end COMPU_METHOD
/begin COMPU_VTAB FORMULA_0233_VTAB "FORMULA_0233_VTAB" TAB_VERB 2 0 "low" 2 "high" /end COMPU_VTAB
/begin COMPU_METHOD FORMULA_0234 "FORMULA_0234" TAB_VERB "%3.0" "-" COMPU_TAB_REF FORMULA_0234_VTAB /end COMPU_METHOD
/begin COMPU_VTAB FORMULA_0234_VTAB "FORMULA_0234_VTAB" TAB_VERB 2 0 "Schnellsync." 1 "sichere Sync." /end COMPU_VTAB
/begin COMPU_METHOD FORMULA_0235 "FORMULA_0235" RAT_FUNC "%3.0" "µs" COEFFS 0 10 0 0 0 8 /end COMPU_METHOD
/* ------------------ Abschnitt erzeugt aus tsgrw.dat ------------------ */
/begin COMPU_METHOD FORMULA_0236 "FORMULA_0236" RAT_FUNC "%9.4" "-" COEFFS 0 32768 0 0 0 1 /end COMPU_METHOD
/begin COMPU_METHOD FORMULA_0237 "FORMULA_0237" TAB_VERB "%3.0" "-" COMPU_TAB_REF FORMULA_0237_VTAB /end COMPU_METHOD
/begin COMPU_VTAB FORMULA_0237_VTAB "FORMULA_0237_VTAB" TAB_VERB 2 0 "Konstante" 1 "Modell" /end COMPU_VTAB
/* ------------------ Abschnitt erzeugt aus tz.dat ------------------ */
/begin COMPU_METHOD FORMULA_0238 "FORMULA_0238" RAT_FUNC "%7.2" "ms" COEFFS 0 10000 0 0 0 8 /end COMPU_METHOD
/begin COMPU_METHOD FORMULA_0239 "FORMULA_0239" RAT_FUNC "%7.2" "Grad/10ms" COEFFS 0 160 0 0 0 1 /end COMPU_METHOD
/begin COMPU_METHOD FORMULA_0240 "FORMULA_0240" TAB_VERB "%3.0" "-" COMPU_TAB_REF FORMULA_0240_VTAB /end COMPU_METHOD
/begin COMPU_VTAB FORMULA_0240_VTAB "FORMULA_0240_VTAB" TAB_VERB 2 0 "inaktiv" 1 "aktiv" DEFAULT_VALUE "ungueltig" /end COMPU_VTAB
/begin COMPU_METHOD FORMULA_0241 "FORMULA_0241" RAT_FUNC "%6.1" "ø/Segment" COEFFS 0 10 0 0 0 1 /end COMPU_METHOD
/begin COMPU_METHOD FORMULA_0242 "FORMULA_0242" RAT_FUNC "%3.0" "segm" COEFFS 0 1 0 0 0 1 /end COMPU_METHOD
/* ------------------ Abschnitt erzeugt aus uext.dat ------------------ */
/begin COMPU_METHOD FORMULA_0245 "FORMULA_0245" RAT_FUNC "%7.2" "V" COEFFS 0 30720 0 0 0 200 /end COMPU_METHOD
/* ------------------ Abschnitt erzeugt aus debug.dat ------------------ */
/begin MEASUREMENT hwTaskCtr "Counter" UWORD FORMULA_0000 0 0 0.0 65535.0000 ECU_ADDRESS 0x3FB800 /begin FUNCTION_LIST debug /end FUNCTION_LIST /end MEASUREMENT
/begin MEASUREMENT syncTaskCtr "Counter" UWORD FORMULA_0000 0 0 0.0 65535.0000 ECU_ADDRESS 0x3FB802 /begin FUNCTION_LIST debug /end FUNCTION_LIST /end MEASUREMENT
/begin MEASUREMENT r1msTaskCtr "Counter" UWORD FORMULA_0000 0 0 0.0 65535.0000 ECU_ADDRESS 0x3FB804 /begin FUNCTION_LIST debug /end FUNCTION_LIST /end MEASUREMENT
/begin MEASUREMENT r5msTaskCtr "Counter" UWORD FORMULA_0000 0 0 0.0 65535.0000 ECU_ADDRESS 0x3FB806 /begin FUNCTION_LIST debug /end FUNCTION_LIST /end MEASUREMENT
/begin MEASUREMENT r10msTaskCtr "Counter" ULONG FORMULA_0001 0 0 0.0 2147483647.0000 ECU_ADDRESS 0x3FB808 /begin FUNCTION_LIST debug /end FUNCTION_LIST /end MEASUREMENT
/begin MEASUREMENT r100msTaskCtr "Counter" UWORD FORMULA_0000 0 0 0.0 65535.0000 ECU_ADDRESS 0x3FB80C /begin FUNCTION_LIST debug /end FUNCTION_LIST /end MEASUREMENT
/begin MEASUREMENT r1sTaskCtr "Counter" UWORD FORMULA_0000 0 0 0.0 65535.0000 ECU_ADDRESS 0x3FB80E /begin FUNCTION_LIST debug /end FUNCTION_LIST /end MEASUREMENT
/begin MEASUREMENT bgTaskCtr "Counter" UWORD FORMULA_0000 0 0 0.0 65535.0000 ECU_ADDRESS 0x3FB810 /begin FUNCTION_LIST debug /end FUNCTION_LIST /end MEASUREMENT
/* ------------------ Abschnitt erzeugt aus os.dat ------------------ */
/begin MEASUREMENT os_err.id.cnt "OS-Err: ID" UWORD FORMULA_0000 0 0 0.0 65535.0000 ECU_ADDRESS 0x3FBEE6 /begin FUNCTION_LIST os /end FUNCTION_LIST /end MEASUREMENT
/begin MEASUREMENT os_err.id.task "OS-Err: ID" UWORD FORMULA_0000 0 0 0.0 65535.0000 ECU_ADDRESS 0x3FBEE8 /begin FUNCTION_LIST os /end FUNCTION_LIST /end MEASUREMENT
/begin MEASUREMENT os_err.limit.cnt "OS-Err: Limit" UWORD FORMULA_0000 0 0 0.0 65535.0000 ECU_ADDRESS 0x3FBEEA /begin FUNCTION_LIST os /end FUNCTION_LIST /end MEASUREMENT
/begin MEASUREMENT os_err.limit.task "OS-Err: Limit" UWORD FORMULA_0000 0 0 0.0 65535.0000 ECU_ADDRESS 0x3FBEEC /begin FUNCTION_LIST os /end FUNCTION_LIST /end MEASUREMENT
/begin MEASUREMENT os_err.tt_act.cnt "OS-Err: TT aktiv" UWORD FORMULA_0000 0 0 0.0 65535.0000 ECU_ADDRESS 0x3FBEEE /begin FUNCTION_LIST os /end FUNCTION_LIST /end MEASUREMENT
/begin MEASUREMENT os_err.tt_act.task "OS-Err: TT aktiv" UWORD FORMULA_0000 0 0 0.0 65535.0000 ECU_ADDRESS 0x3FBEF0 /begin FUNCTION_LIST os /end FUNCTION_LIST /end MEASUREMENT
/begin MEASUREMENT os_err.no_fnc.cnt "OS-Err: No Fkt" UWORD FORMULA_0000 0 0 0.0 65535.0000 ECU_ADDRESS 0x3FBEF2 /begin FUNCTION_LIST os /end FUNCTION_LIST /end MEASUREMENT
/begin MEASUREMENT os_err.no_fnc.task "OS-Err: No Fkt" UWORD FORMULA_0000 0 0 0.0 65535.0000 ECU_ADDRESS 0x3FBEF4 /begin FUNCTION_LIST os /end FUNCTION_LIST /end MEASUREMENT
/begin MEASUREMENT os_err.tt_miss.cnt "OS-Err: TT missing" UWORD FORMULA_0000 0 0 0.0 65535.0000 ECU_ADDRESS 0x3FBEF6 /begin FUNCTION_LIST os /end FUNCTION_LIST /end MEASUREMENT
/begin MEASUREMENT os_err.tt_miss.task "OS-Err: TT missing" UWORD FORMULA_0000 0 0 0.0 65535.0000 ECU_ADDRESS 0x3FBEF8 /begin FUNCTION_LIST os /end FUNCTION_LIST /end MEASUREMENT
/begin MEASUREMENT os_err.stack.cnt "OS-Err: Stack" UWORD FORMULA_0000 0 0 0.0 65535.0000 ECU_ADDRESS 0x3FBEFA /begin FUNCTION_LIST os /end FUNCTION_LIST /end MEASUREMENT
/begin MEASUREMENT os_err.stack.task "OS-Err: Stack" UWORD FORMULA_0000 0 0 0.0 65535.0000 ECU_ADDRESS 0x3FBEFC /begin FUNCTION_LIST os /end FUNCTION_LIST /end MEASUREMENT
/begin MEASUREMENT os_err.fifo.cnt "OS-Err: FIFO full" UWORD FORMULA_0000 0 0 0.0 65535.0000 ECU_ADDRESS 0x3FBEFE /begin FUNCTION_LIST os /end FUNCTION_LIST /end MEASUREMENT
/begin MEASUREMENT os_err.fifo.task "OS-Err: FIFO full" UWORD FORMULA_0000 0 0 0.0 65535.0000 ECU_ADDRESS 0x3FBF00 /begin FUNCTION_LIST os /end FUNCTION_LIST /end MEASUREMENT
/begin MEASUREMENT os_err.value.cnt "OS-Err: Value" UWORD FORMULA_0000 0 0 0.0 65535.0000 ECU_ADDRESS 0x3FBF02 /begin FUNCTION_LIST os /end FUNCTION_LIST /end MEASUREMENT
/begin MEASUREMENT os_err.value.task "OS-Err: Value" UWORD FORMULA_0000 0 0 0.0 65535.0000 ECU_ADDRESS 0x3FBF04 /begin FUNCTION_LIST os /end FUNCTION_LIST /end MEASUREMENT
/begin MEASUREMENT os_err.deadline.cnt "OS-Err: Deadline" UWORD FORMULA_0000 0 0 0.0 65535.0000 ECU_ADDRESS 0x3FBF06 /begin FUNCTION_LIST os /end FUNCTION_LIST /end MEASUREMENT
/begin MEASUREMENT os_err.deadline.task "OS-Err: Deadline" UWORD FORMULA_0000 0 0 0.0 65535.0000 ECU_ADDRESS 0x3FBF08 /begin FUNCTION_LIST os /end FUNCTION_LIST /end MEASUREMENT
/begin MEASUREMENT os_err.dflt.cnt "OS-Err: Default" UWORD FORMULA_0000 0 0 0.0 65535.0000 ECU_ADDRESS 0x3FBF0A /begin FUNCTION_LIST os /end FUNCTION_LIST /end MEASUREMENT
/begin MEASUREMENT os_err.dflt.task "OS-Err: Default" UWORD FORMULA_0000 0 0 0.0 65535.0000 ECU_ADDRESS 0x3FBF0C /begin FUNCTION_LIST os /end FUNCTION_LIST /end MEASUREMENT
/begin MEASUREMENT os_err.sum_cnt "OS-Err: Summe" UWORD FORMULA_0000 0 0 0.0 65535.0000 ECU_ADDRESS 0x3FBF0E /begin FUNCTION_LIST os /end FUNCTION_LIST /end MEASUREMENT
/* ------------------ Abschnitt erzeugt aus pctrl.dat ------------------ */
/begin CHARACTERISTIC K_PCTRL_TIMEOUT "Timeout der Prozessorueberwachung" VALUE 0x62247 TKW_VV_VV_UB 100.0 FORMULA_0068 0.0 2550.0000 /begin FUNCTION_LIST PCTRL /end FUNCTION_LIST /end CHARACTERISTIC
/begin MEASUREMENT pctrl_tout "Timeout Zaehler" UBYTE FORMULA_0068 0 0 0.0 2550.0000 ECU_ADDRESS 0x3FBF10 /begin FUNCTION_LIST PCTRL /end FUNCTION_LIST /end MEASUREMENT
/begin MEASUREMENT pctrl_ed "PCTRL Diagnose Variable" UWORD FORMULA_0017 0 0 0.0 111.0 ECU_ADDRESS 0x3FBF12 /begin FUNCTION_LIST PCTRL /end FUNCTION_LIST BIT_MASK 0x6F /end MEASUREMENT
/* ------------------ Abschnitt erzeugt aus spi.dat ------------------ */
/begin MEASUREMENT spim_errorcounter "Fehlerzaehler der Spi" UBYTE FORMULA_0008 0 0 0.0 255.0000 ECU_ADDRESS 0x3FBF4A /begin FUNCTION_LIST spi /end FUNCTION_LIST /end MEASUREMENT
/begin MEASUREMENT spim_reqcounter "Anzahl der Auftraege in der Queue" UBYTE FORMULA_0008 0 0 0.0 255.0000 ECU_ADDRESS 0x3FBF4B /begin FUNCTION_LIST spi /end FUNCTION_LIST /end MEASUREMENT
/begin MEASUREMENT spim_status "Statusvariable der SPI" UBYTE FORMULA_0069 0 0 0.0 255.0 ECU_ADDRESS 0x3FBF4C /begin FUNCTION_LIST spi /end FUNCTION_LIST /end MEASUREMENT
/begin MEASUREMENT spim_errorcode "Statusvariable der SPI" UBYTE FORMULA_0070 0 0 0.0 255.0 ECU_ADDRESS 0x3FBF4D /begin FUNCTION_LIST spi /end FUNCTION_LIST /end MEASUREMENT
/* ------------------ Abschnitt erzeugt aus sw_confg.dat ------------------ */
/begin CHARACTERISTIC cfg.motortyp "Konfigurationsparameter: Motortyp" VALUE 0x6230A TKW_VV_VV_UW 100.0 FORMULA_0071 0.0 65535.0 /begin FUNCTION_LIST SG-Konfiguration /end FUNCTION_LIST FORMAT "%5.2" /end CHARACTERISTIC
/begin CHARACTERISTIC cfg.baureihe "Konfigurationsparameter: Fz Baureihe" VALUE 0x6230C TKW_VV_VV_UB 100.0 FORMULA_0072 0.0 255.0 /begin FUNCTION_LIST SG-Konfiguration /end FUNCTION_LIST /end CHARACTERISTIC
/begin CHARACTERISTIC cfg.getriebetyp "Konfigurationsparameter: Getriebetyp" VALUE 0x6230D TKW_VV_VV_UB 100.0 FORMULA_0073 0.0 255.0 /begin FUNCTION_LIST SG-Konfiguration /end FUNCTION_LIST /end CHARACTERISTIC
/begin CHARACTERISTIC cfg.la_variante "Konfigurationsparameter: LA-Variante" VALUE 0x6230E TKW_VV_VV_UB 100.0 FORMULA_0074 0.0 255.0 /begin FUNCTION_LIST SG-Konfiguration /end FUNCTION_LIST /end CHARACTERISTIC
/begin CHARACTERISTIC cfg.abgas "Konfigurationsparameter: ABGAS-Variante" VALUE 0x6230F TKW_VV_VV_UB 100.0 FORMULA_0075 0.0 255.0 /begin FUNCTION_LIST SG-Konfiguration /end FUNCTION_LIST /end CHARACTERISTIC
/begin CHARACTERISTIC cfg.diagnose "Konfigurationsparameter: Diagnose" VALUE 0x62310 TKW_VV_VV_UB 100.0 FORMULA_0076 0.0 255.0 /begin FUNCTION_LIST SG-Konfiguration /end FUNCTION_LIST /end CHARACTERISTIC
/begin CHARACTERISTIC cfg.status "Konfigurationsparameter: SG Status" VALUE 0x62311 TKW_VV_VV_UB 100.0 FORMULA_0077 0.0 255.0 /begin FUNCTION_LIST SG-Konfiguration /end FUNCTION_LIST /end CHARACTERISTIC
/begin CHARACTERISTIC cfg.canstand "Konfigurationsparameter: CAN Stand" VALUE 0x62312 TKW_VV_VV_UB 100.0 FORMULA_0078 0.0 255.0 /begin FUNCTION_LIST SG-Konfiguration /end FUNCTION_LIST /end CHARACTERISTIC
/begin CHARACTERISTIC cfg.betriebsmode "Konfigurationsparameter: SG Typ" VALUE 0x62313 TKW_VV_VV_UB 100.0 FORMULA_0079 0.0 255.0 /begin FUNCTION_LIST SG-Konfiguration /end FUNCTION_LIST /end CHARACTERISTIC
/begin CHARACTERISTIC cfg.appldaten "Konfigurationsparameter: ApplDaten" VALUE 0x62314 TKW_VV_VV_UB 100.0 FORMULA_0080 0.0 255.0 /begin FUNCTION_LIST SG-Konfiguration /end FUNCTION_LIST /end CHARACTERISTIC
/begin CHARACTERISTIC cfg.peripherie "Konfigurationsparameter: Motorperipherie" VALUE 0x62315 TKW_VV_VV_UB 100.0 FORMULA_0047 0.0 255.0000 /begin FUNCTION_LIST SG-Konfiguration /end FUNCTION_LIST /end CHARACTERISTIC
/begin MEASUREMENT cfg_boot_st "Bootstaus" ULONG FORMULA_0001 0 0 0.0 2147483647.0000 ECU_ADDRESS 0x3F9810 /begin FUNCTION_LIST SG-Konfiguration /end FUNCTION_LIST /end MEASUREMENT
/begin MEASUREMENT vers_boot "Booterversion" UWORD FORMULA_0000 0 0 0.0 65535.0000 ECU_ADDRESS 0x3F9814 /begin FUNCTION_LIST SG-Konfiguration /end FUNCTION_LIST /end MEASUREMENT
/begin MEASUREMENT vers_boot_index "Booterversionsindex" UWORD FORMULA_0000 0 0 0.0 65535.0000 ECU_ADDRESS 0x3F9816 /begin FUNCTION_LIST SG-Konfiguration /end FUNCTION_LIST /end MEASUREMENT
/* ------------------ Abschnitt erzeugt aus sys_zust.dat ------------------ */
/begin MEASUREMENT sys_zust "Betriebszustand des Systems" UWORD FORMULA_0081 0 0 0.0 65535.0 ECU_ADDRESS 0x3FBF58 /begin FUNCTION_LIST sys_zust /end FUNCTION_LIST /end MEASUREMENT
/begin MEASUREMENT sys_rsr "Reset Status Register" UWORD FORMULA_0000 0 0 0.0 65535.0000 ECU_ADDRESS 0x3FC8D4 /begin FUNCTION_LIST sys_zust /end FUNCTION_LIST /end MEASUREMENT
/begin MEASUREMENT sys_rsr_cnt.ehrs "ExtHardReset" UBYTE FORMULA_0008 0 0 0.0 255.0000 ECU_ADDRESS 0x3FC8D8 /begin FUNCTION_LIST sys_zust /end FUNCTION_LIST /end MEASUREMENT
/begin MEASUREMENT sys_rsr_cnt.esrs "ExtSoftReset" UBYTE FORMULA_0008 0 0 0.0 255.0000 ECU_ADDRESS 0x3FC8D9 /begin FUNCTION_LIST sys_zust /end FUNCTION_LIST /end MEASUREMENT
/begin MEASUREMENT sys_rsr_cnt.llrs "LossOfClockReset" UBYTE FORMULA_0008 0 0 0.0 255.0000 ECU_ADDRESS 0x3FC8DA /begin FUNCTION_LIST sys_zust /end FUNCTION_LIST /end MEASUREMENT
/begin MEASUREMENT sys_rsr_cnt.swrs "WatchdogReset" UBYTE FORMULA_0008 0 0 0.0 255.0000 ECU_ADDRESS 0x3FC8DB /begin FUNCTION_LIST sys_zust /end FUNCTION_LIST /end MEASUREMENT
/begin MEASUREMENT sys_rsr_cnt.csrs "ChkstopReset" UBYTE FORMULA_0008 0 0 0.0 255.0000 ECU_ADDRESS 0x3FC8DC /begin FUNCTION_LIST sys_zust /end FUNCTION_LIST /end MEASUREMENT
/begin MEASUREMENT sys_rsr_cnt.dbhrs "DebugHardReset" UBYTE FORMULA_0008 0 0 0.0 255.0000 ECU_ADDRESS 0x3FC8DD /begin FUNCTION_LIST sys_zust /end FUNCTION_LIST /end MEASUREMENT
/begin MEASUREMENT sys_rsr_cnt.dbsrs "DebugSoftReset" UBYTE FORMULA_0008 0 0 0.0 255.0000 ECU_ADDRESS 0x3FC8DE /begin FUNCTION_LIST sys_zust /end FUNCTION_LIST /end MEASUREMENT
/begin MEASUREMENT sys_rsr_cnt.jtrs "JTAGReset" UBYTE FORMULA_0008 0 0 0.0 255.0000 ECU_ADDRESS 0x3FC8DF /begin FUNCTION_LIST sys_zust /end FUNCTION_LIST /end MEASUREMENT
/begin MEASUREMENT sys_rsr_cnt.ocrs "OnChipReset" UBYTE FORMULA_0008 0 0 0.0 255.0000 ECU_ADDRESS 0x3FC8E0 /begin FUNCTION_LIST sys_zust /end FUNCTION_LIST /end MEASUREMENT
/begin MEASUREMENT sys_rsr_cnt.ilbc "IllegalBitChangeReset" UBYTE FORMULA_0008 0 0 0.0 255.0000 ECU_ADDRESS 0x3FC8E1 /begin FUNCTION_LIST sys_zust /end FUNCTION_LIST /end MEASUREMENT
/begin MEASUREMENT sys_rsr_cnt.gpor "GlitchPowerOnReset" UBYTE FORMULA_0008 0 0 0.0 255.0000 ECU_ADDRESS 0x3FC8E2 /begin FUNCTION_LIST sys_zust /end FUNCTION_LIST /end MEASUREMENT
/begin MEASUREMENT sys_rsr_cnt.ghrst "GlitchHPinReset" UBYTE FORMULA_0008 0 0 0.0 255.0000 ECU_ADDRESS 0x3FC8E3 /begin FUNCTION_LIST sys_zust /end FUNCTION_LIST /end MEASUREMENT
/begin MEASUREMENT sys_rsr_cnt.gsrst "GlitchSPinReset" UBYTE FORMULA_0008 0 0 0.0 255.0000 ECU_ADDRESS 0x3FC8E4 /begin FUNCTION_LIST sys_zust /end FUNCTION_LIST /end MEASUREMENT
/* ------------------ Abschnitt erzeugt aus tpu_code.dat ------------------ */
/begin MEASUREMENT tpu_code_status "TPU MicroCode Status." UWORD FORMULA_0000 0 0 0.0 65535.0000 ECU_ADDRESS 0x3FBFE2 /begin FUNCTION_LIST TPU /end FUNCTION_LIST /end MEASUREMENT
/* ------------------ Abschnitt erzeugt aus version.dat ------------------ */
/begin CHARACTERISTIC K_VERS_PROG "Programmversion" VALUE 0x60000 TKW_VV_VV_UW 100.0 FORMULA_0000 0.0 65535.0000 /begin FUNCTION_LIST Version /end FUNCTION_LIST /end CHARACTERISTIC
/begin CHARACTERISTIC K_VERS_PROZ "Prozessorkennung" VALUE 0x60002 TKW_VV_VV_UB 100.0 FORMULA_0082 0.0 255.0 /begin FUNCTION_LIST Version /end FUNCTION_LIST /end CHARACTERISTIC
/begin CHARACTERISTIC K_VERS_NAME "Applikateur" VALUE 0x60003 TKW_VV_VV_UB 100.0 FORMULA_0083 0.0 255.0 /begin FUNCTION_LIST Version /end FUNCTION_LIST /end CHARACTERISTIC
/begin CHARACTERISTIC K_VERS_DATEN "Datenversion" VALUE 0x60004 TKW_VV_VV_UW 100.0 FORMULA_0000 0.0 65535.0000 /begin FUNCTION_LIST Version /end FUNCTION_LIST /end CHARACTERISTIC
/begin MEASUREMENT vers_prog "Programmversion" UWORD FORMULA_0000 0 0 0.0 65535.0000 ECU_ADDRESS 0x3FC0E4 /begin FUNCTION_LIST Version /end FUNCTION_LIST /end MEASUREMENT
/begin MEASUREMENT vers_index "Programmindex" UBYTE FORMULA_0008 0 0 0.0 255.0000 ECU_ADDRESS 0x3FC0E6 /begin FUNCTION_LIST Version /end FUNCTION_LIST /end MEASUREMENT
/* ------------------ Abschnitt erzeugt aus diag_tr_ign.dat ------------------ */
/begin MEASUREMENT diag_tr_spi0_st_1of16_ "Treiberdiagnose fuer SPI Chain 0" UBYTE FORMULA_0047 0 0 0.0 255.0000 ECU_ADDRESS 0x3FB814 /begin FUNCTION_LIST diag_tr_ign /end FUNCTION_LIST /end MEASUREMENT
/begin MEASUREMENT diag_tr_spi0_st_2of16_ "Treiberdiagnose fuer SPI Chain 0" UBYTE FORMULA_0047 0 0 0.0 255.0000 ECU_ADDRESS 0x3FB815 /begin FUNCTION_LIST diag_tr_ign /end FUNCTION_LIST /end MEASUREMENT
/begin MEASUREMENT diag_tr_spi0_st_3of16_ "Treiberdiagnose fuer SPI Chain 0" UBYTE FORMULA_0047 0 0 0.0 255.0000 ECU_ADDRESS 0x3FB816 /begin FUNCTION_LIST diag_tr_ign /end FUNCTION_LIST /end MEASUREMENT
/begin MEASUREMENT diag_tr_spi0_st_4of16_ "Treiberdiagnose fuer SPI Chain 0" UBYTE FORMULA_0047 0 0 0.0 255.0000 ECU_ADDRESS 0x3FB817 /begin FUNCTION_LIST diag_tr_ign /end FUNCTION_LIST /end MEASUREMENT
/begin MEASUREMENT diag_tr_spi0_st_5of16_ "Treiberdiagnose fuer SPI Chain 0" UBYTE FORMULA_0047 0 0 0.0 255.0000 ECU_ADDRESS 0x3FB818 /begin FUNCTION_LIST diag_tr_ign /end FUNCTION_LIST /end MEASUREMENT
/begin MEASUREMENT diag_tr_spi0_st_6of16_ "Treiberdiagnose fuer SPI Chain 0" UBYTE FORMULA_0047 0 0 0.0 255.0000 ECU_ADDRESS 0x3FB819 /begin FUNCTION_LIST diag_tr_ign /end FUNCTION_LIST /end MEASUREMENT
/begin MEASUREMENT diag_tr_spi0_st_7of16_ "Treiberdiagnose fuer SPI Chain 0" UBYTE FORMULA_0047 0 0 0.0 255.0000 ECU_ADDRESS 0x3FB81A /begin FUNCTION_LIST diag_tr_ign /end FUNCTION_LIST /end MEASUREMENT
/begin MEASUREMENT diag_tr_spi0_st_8of16_ "Treiberdiagnose fuer SPI Chain 0" UBYTE FORMULA_0047 0 0 0.0 255.0000 ECU_ADDRESS 0x3FB81B /begin FUNCTION_LIST diag_tr_ign /end FUNCTION_LIST /end MEASUREMENT
/begin MEASUREMENT diag_tr_spi0_st_9of16_ "Treiberdiagnose fuer SPI Chain 0" UBYTE FORMULA_0047 0 0 0.0 255.0000 ECU_ADDRESS 0x3FB81C /begin FUNCTION_LIST diag_tr_ign /end FUNCTION_LIST /end MEASUREMENT
/begin MEASUREMENT diag_tr_spi0_st_10of16_ "Treiberdiagnose fuer SPI Chain 0" UBYTE FORMULA_0047 0 0 0.0 255.0000 ECU_ADDRESS 0x3FB81D /begin FUNCTION_LIST diag_tr_ign /end FUNCTION_LIST /end MEASUREMENT
/begin MEASUREMENT diag_tr_spi0_st_11of16_ "Treiberdiagnose fuer SPI Chain 0" UBYTE FORMULA_0047 0 0 0.0 255.0000 ECU_ADDRESS 0x3FB81E /begin FUNCTION_LIST diag_tr_ign /end FUNCTION_LIST /end MEASUREMENT
/begin MEASUREMENT diag_tr_spi0_st_12of16_ "Treiberdiagnose fuer SPI Chain 0" UBYTE FORMULA_0047 0 0 0.0 255.0000 ECU_ADDRESS 0x3FB81F /begin FUNCTION_LIST diag_tr_ign /end FUNCTION_LIST /end MEASUREMENT
/begin MEASUREMENT diag_tr_spi0_st_13of16_ "Treiberdiagnose fuer SPI Chain 0" UBYTE FORMULA_0047 0 0 0.0 255.0000 ECU_ADDRESS 0x3FB820 /begin FUNCTION_LIST diag_tr_ign /end FUNCTION_LIST /end MEASUREMENT
/begin MEASUREMENT diag_tr_spi0_st_14of16_ "Treiberdiagnose fuer SPI Chain 0" UBYTE FORMULA_0047 0 0 0.0 255.0000 ECU_ADDRESS 0x3FB821 /begin FUNCTION_LIST diag_tr_ign /end FUNCTION_LIST /end MEASUREMENT
/begin MEASUREMENT diag_tr_spi0_st_15of16_ "Treiberdiagnose fuer SPI Chain 0" UBYTE FORMULA_0047 0 0 0.0 255.0000 ECU_ADDRESS 0x3FB822 /begin FUNCTION_LIST diag_tr_ign /end FUNCTION_LIST /end MEASUREMENT
/begin MEASUREMENT diag_tr_spi0_st_16of16_ "Treiberdiagnose fuer SPI Chain 0" UBYTE FORMULA_0047 0 0 0.0 255.0000 ECU_ADDRESS 0x3FB823 /begin FUNCTION_LIST diag_tr_ign /end FUNCTION_LIST /end MEASUREMENT
/* ------------------ Abschnitt erzeugt aus lfr.dat ------------------ */
/begin CHARACTERISTIC K_LLR_CONTROL "" VALUE 0x61420 TKW_VV_VV_UB 100.0 FORMULA_0170 0.0 255.0 /begin FUNCTION_LIST Leerlaufregler /end FUNCTION_LIST /end CHARACTERISTIC
/begin CHARACTERISTIC K_LLR_DN_HYS "Drehzahl" VALUE 0x61421 TKW_VV_VV_UB 100.0 FORMULA_0171 0.0 255.0000 /begin FUNCTION_LIST Leerlaufregler /end FUNCTION_LIST /end CHARACTERISTIC
/begin CHARACTERISTIC K_LLR_V_MAX "Geschw." VALUE 0x61422 TKW_VV_VV_UB 100.0 FORMULA_0172 0.0 0.9375 /begin FUNCTION_LIST Leerlaufregler /end FUNCTION_LIST /end CHARACTERISTIC
/begin CHARACTERISTIC K_LLR_NDIFF_RESET "Reset I-Regler dn > 0" VALUE 0x61424 TKW_VV_VV_SW 100.0 FORMULA_0011 0.0 2000.0000 /begin FUNCTION_LIST Leerlaufregler /end FUNCTION_LIST /end CHARACTERISTIC
/begin CHARACTERISTIC K_LLR_NDIFF_POS "Reset I-Regler dn < 0" VALUE 0x61426 TKW_VV_VV_SW 100.0 FORMULA_0011 -2000.0000 0.0 /begin FUNCTION_LIST Leerlaufregler /end FUNCTION_LIST /end CHARACTERISTIC
/begin CHARACTERISTIC K_LLR_NDIFF_AUF "Reglerdifferenz für I Aufziehen" VALUE 0x61428 TKW_VV_VV_UB 100.0 FORMULA_0173 0.0 255.0000 /begin FUNCTION_LIST Leerlaufregler /end FUNCTION_LIST /end CHARACTERISTIC
/begin CHARACTERISTIC K_LLR_TAU_IA1 "Zeitkonst." VALUE 0x61429 TKW_VV_VV_UB 100.0 FORMULA_0047 1.0000 255.0000 /begin FUNCTION_LIST Leerlaufregler /end FUNCTION_LIST /end CHARACTERISTIC
/begin CHARACTERISTIC K_LLR_DIAFR_ABR "Abreg.wert" VALUE 0x6142A TKW_VV_VV_SW 100.0 FORMULA_0174 -50.0000 50.0000 /begin FUNCTION_LIST Leerlaufregler /end FUNCTION_LIST FORMAT "%5.2" /end CHARACTERISTIC
/begin CHARACTERISTIC K_LLR_UEW_MAX "Abreg.wert" VALUE 0x6142C TKW_VV_VV_SW 100.0 FORMULA_0174 -50.0000 50.0000 /begin FUNCTION_LIST Leerlaufregler /end FUNCTION_LIST FORMAT "%5.2" /end CHARACTERISTIC
/begin CHARACTERISTIC K_LLR_TAU_IA2_KS "Zeitkonst." VALUE 0x6142E TKW_VV_VV_UB 100.0 FORMULA_0047 1.0000 255.0000 /begin FUNCTION_LIST Leerlaufregler /end FUNCTION_LIST /end CHARACTERISTIC
/begin CHARACTERISTIC K_LLR_TAU_IA2_KKS "Zeitkonst." VALUE 0x6142F TKW_VV_VV_UB 100.0 FORMULA_0047 1.0000 255.0000 /begin FUNCTION_LIST Leerlaufregler /end FUNCTION_LIST /end CHARACTERISTIC
/begin CHARACTERISTIC K_LLR_MDREG_MIN "untere Grenze" VALUE 0x61430 TKW_VV_VV_SW 100.0 FORMULA_0174 -100.0000 0.0 /begin FUNCTION_LIST Leerlaufregler /end FUNCTION_LIST FORMAT "%5.2" /end CHARACTERISTIC
/begin CHARACTERISTIC K_LLR_MDREG_MAX "obere Grenze" VALUE 0x61432 TKW_VV_VV_SW 100.0 FORMULA_0174 0.0 100.0000 /begin FUNCTION_LIST Leerlaufregler /end FUNCTION_LIST FORMAT "%5.2" /end CHARACTERISTIC
/begin CHARACTERISTIC K_LLR_MDAFR_MAX "obere Grenze" VALUE 0x61434 TKW_VV_VV_SW 100.0 FORMULA_0174 0.0 100.0000 /begin FUNCTION_LIST Leerlaufregler /end FUNCTION_LIST FORMAT "%5.2" /end CHARACTERISTIC
/begin CHARACTERISTIC K_LLR_MD_REG_MIN "Moment" VALUE 0x61436 TKW_VV_VV_SW 100.0 FORMULA_0018 -100.0000 1000.0000 /begin FUNCTION_LIST Leerlaufregler /end FUNCTION_LIST FORMAT "%4.1" /end CHARACTERISTIC
/begin CHARACTERISTIC K_LLR_MD_REG_MAX "Moment" VALUE 0x61438 TKW_VV_VV_SW 100.0 FORMULA_0018 -100.0000 1000.0000 /begin FUNCTION_LIST Leerlaufregler /end FUNCTION_LIST FORMAT "%4.1" /end CHARACTERISTIC
/begin CHARACTERISTIC KL_LLR_RF_MIN "-" CURVE 0x6143A TKL_SW_VV_UW 100.0 FORMULA_0006 0.0 2.0000 /begin FUNCTION_LIST Leerlaufregler /end FUNCTION_LIST
 /begin AXIS_DESCR STD_AXIS tmot FORMULA_0019 4 -50.0000 150.0000 FORMAT "%4.1" /end AXIS_DESCR
 FORMAT "%6.3" /end CHARACTERISTIC
/begin CHARACTERISTIC KL_LLR_TAU_NSOLL "-" CURVE 0x6144C TKL_SW_VV_UW 100.0 FORMULA_0175 0.0001 5.1200 /begin FUNCTION_LIST Leerlaufregler /end FUNCTION_LIST
 /begin AXIS_DESCR STD_AXIS tmot FORMULA_0019 4 -50.0000 150.0000 FORMAT "%4.1" /end AXIS_DESCR
 FORMAT "%5.2" /end CHARACTERISTIC
/begin CHARACTERISTIC KL_LLR_NSOLL_START "-" CURVE 0x6145E TKL_SW_VV_SW 100.0 FORMULA_0011 0.0 10000.0000 /begin FUNCTION_LIST Leerlaufregler /end FUNCTION_LIST
 /begin AXIS_DESCR STD_AXIS tmot FORMULA_0019 4 -50.0000 150.0000 FORMAT "%4.1" /end AXIS_DESCR
/end CHARACTERISTIC
/begin CHARACTERISTIC KL_LLR_NSOLL_GRUND "-" CURVE 0x61470 TKL_SW_VV_SW 100.0 FORMULA_0011 0.0 10000.0000 /begin FUNCTION_LIST Leerlaufregler /end FUNCTION_LIST
 /begin AXIS_DESCR STD_AXIS tmot FORMULA_0019 4 -50.0000 150.0000 FORMAT "%4.1" /end AXIS_DESCR
/end CHARACTERISTIC
/begin CHARACTERISTIC KL_LLR_DQP_POS "-" CURVE 0x61482 TKL_UW_VV_UW 100.0 FORMULA_0167 0.0 50.0000 /begin FUNCTION_LIST Leerlaufregler /end FUNCTION_LIST /begin AXIS_DESCR STD_AXIS llr.dn FORMULA_0011 16 0.0 500.0000 /end AXIS_DESCR FORMAT "%6.3" /end CHARACTERISTIC
/begin CHARACTERISTIC KL_LLR_TZ_POS "-" CURVE 0x614C4 TKL_UW_VV_UW 100.0 FORMULA_0167 0.0 50.0000 /begin FUNCTION_LIST Leerlaufregler /end FUNCTION_LIST /begin AXIS_DESCR STD_AXIS llr.dn FORMULA_0011 16 0.0 500.0000 /end AXIS_DESCR FORMAT "%6.3" /end CHARACTERISTIC
/begin CHARACTERISTIC KL_LLR_TZ_NEG "-" CURVE 0x61506 TKL_UW_VV_UW 100.0 FORMULA_0167 0.0 50.0000 /begin FUNCTION_LIST Leerlaufregler /end FUNCTION_LIST /begin AXIS_DESCR STD_AXIS llr.dn FORMULA_0011 16 0.0 500.0000 /end AXIS_DESCR FORMAT "%6.3" /end CHARACTERISTIC
/begin CHARACTERISTIC KL_LLR_DI_AFR "-" CURVE 0x61548 TKL_SW_VV_SW 100.0 FORMULA_0176 -50.0000 50.0000 /begin FUNCTION_LIST Leerlaufregler /end FUNCTION_LIST /begin AXIS_DESCR STD_AXIS llr.dn FORMULA_0011 16 0.0 500.0000 /end AXIS_DESCR FORMAT "%6.3" /end CHARACTERISTIC
/begin CHARACTERISTIC KL_LLR_DABR_AFR "-" CURVE 0x6158A TKL_SW_VV_SW 100.0 FORMULA_0176 -50.0000 50.0000 /begin FUNCTION_LIST Leerlaufregler /end FUNCTION_LIST /begin AXIS_DESCR STD_AXIS llr.dn FORMULA_0011 16 0.0 500.0000 /end AXIS_DESCR FORMAT "%6.3" /end CHARACTERISTIC
/begin CHARACTERISTIC KL_LLR_I_AUF "-" CURVE 0x615CC TKL_SW_VV_SW 100.0 FORMULA_0177 0.0 100.0000 /begin FUNCTION_LIST Leerlaufregler /end FUNCTION_LIST
 /begin AXIS_DESCR STD_AXIS Drehzahlgradient FORMULA_0012 4 -10000.0000 10000.0000 /end AXIS_DESCR
 FORMAT "%7.4" /end CHARACTERISTIC
/begin CHARACTERISTIC KF_LLR_DQI "I-Regler" MAP 0x615DE TKF_SW_SW_SW 100.0 FORMULA_0018 -100.0000 1000.0000 /begin FUNCTION_LIST Leerlaufregler /end FUNCTION_LIST
 /begin AXIS_DESCR STD_AXIS Drehzahlgradient FORMULA_0012 8 -10000.0000 10000.0000 /end AXIS_DESCR
 /begin AXIS_DESCR STD_AXIS Reglerdifferemz FORMULA_0011 16 -500.0000 500.0000 /end AXIS_DESCR
 FORMAT "%4.1" /end CHARACTERISTIC
/begin MEASUREMENT llr_kat_heizen "Status KAT-Heizen" UBYTE FORMULA_0008 0 0 0.0 255.0000 ECU_ADDRESS 0x3FBD9E /begin FUNCTION_LIST Leerlaufregler /end FUNCTION_LIST /end MEASUREMENT
/begin MEASUREMENT llr.mdd "D-Anteil" SWORD FORMULA_0167 0 0 -409.6000 409.5875 ECU_ADDRESS 0x3FBDA0 /begin FUNCTION_LIST Leerlaufregler /end FUNCTION_LIST /end MEASUREMENT
/begin MEASUREMENT llr.n_grad "Motordrehzahl" SWORD FORMULA_0011 0 0 0.0 10000.0000 ECU_ADDRESS 0x3FBDA2 /begin FUNCTION_LIST Leerlaufregler /end FUNCTION_LIST /end MEASUREMENT
/begin MEASUREMENT llr.n_pre "Motordrehzahl" SWORD FORMULA_0011 0 0 0.0 10000.0000 ECU_ADDRESS 0x3FBDA4 /begin FUNCTION_LIST Leerlaufregler /end FUNCTION_LIST /end MEASUREMENT
/begin MEASUREMENT llr.md_adaption "Moment" SWORD FORMULA_0018 0 0 -100.0000 1000.0000 ECU_ADDRESS 0x3FBDA6 /begin FUNCTION_LIST Leerlaufregler /end FUNCTION_LIST /end MEASUREMENT
/begin MEASUREMENT llr.mdp "P-Anteil" SWORD FORMULA_0167 0 0 -409.6000 409.5875 ECU_ADDRESS 0x3FBDA8 /begin FUNCTION_LIST Leerlaufregler /end FUNCTION_LIST /end MEASUREMENT
/begin MEASUREMENT llr.mdi "" SWORD FORMULA_0168 0 0 -204.8000 204.7937 ECU_ADDRESS 0x3FBDAA /begin FUNCTION_LIST Leerlaufregler /end FUNCTION_LIST /end MEASUREMENT
/begin MEASUREMENT llr.md_tz "" SWORD FORMULA_0167 0 0 -409.6000 409.5875 ECU_ADDRESS 0x3FBDAC /begin FUNCTION_LIST Leerlaufregler /end FUNCTION_LIST /end MEASUREMENT
/begin MEASUREMENT llr.dn "Drehzahlgradient pro Sekunde" SWORD FORMULA_0012 0 0 -10000.0000 10000.0000 ECU_ADDRESS 0x3FBDAE /begin FUNCTION_LIST Leerlaufregler /end FUNCTION_LIST /end MEASUREMENT
/begin MEASUREMENT llr.zustand "" UWORD FORMULA_0169 0 0 0.0 65535.0 ECU_ADDRESS 0x3FBDB0 /begin FUNCTION_LIST Leerlaufregler /end FUNCTION_LIST /end MEASUREMENT
/begin MEASUREMENT llr.flags "" UWORD FORMULA_0000 0 0 0.0 65535.0000 ECU_ADDRESS 0x3FBDB2 /begin FUNCTION_LIST Leerlaufregler /end FUNCTION_LIST /end MEASUREMENT
/begin MEASUREMENT llr_n.n_kat "Motordrehzahl" SWORD FORMULA_0011 0 0 0.0 10000.0000 ECU_ADDRESS 0x3FBDB4 /begin FUNCTION_LIST Leerlaufregler /end FUNCTION_LIST /end MEASUREMENT
/begin MEASUREMENT llr_n.n_stat "Motordrehzahl" SWORD FORMULA_0011 0 0 0.0 10000.0000 ECU_ADDRESS 0x3FBDB6 /begin FUNCTION_LIST Leerlaufregler /end FUNCTION_LIST /end MEASUREMENT
/begin MEASUREMENT llr_n.n_offset "Motordrehzahl" SWORD FORMULA_0011 0 0 0.0 10000.0000 ECU_ADDRESS 0x3FBDB8 /begin FUNCTION_LIST Leerlaufregler /end FUNCTION_LIST /end MEASUREMENT
/begin MEASUREMENT llr_n.n_soll "Motordrehzahl" SWORD FORMULA_0011 0 0 0.0 10000.0000 ECU_ADDRESS 0x3FBDBA /begin FUNCTION_LIST Leerlaufregler /end FUNCTION_LIST /end MEASUREMENT
/begin MEASUREMENT llr_n.tau_nsoll "" UBYTE FORMULA_0047 0 0 0.0 255.0000 ECU_ADDRESS 0x3FBDBC /begin FUNCTION_LIST Leerlaufregler /end FUNCTION_LIST /end MEASUREMENT
/begin MEASUREMENT llr_i_afr "" SWORD FORMULA_0168 0 0 -204.8000 204.7937 ECU_ADDRESS 0x3FBDC2 /begin FUNCTION_LIST Leerlaufregler /end FUNCTION_LIST /end MEASUREMENT
/begin MEASUREMENT llr_i_auf "" SWORD FORMULA_0168 0 0 -204.8000 204.7937 ECU_ADDRESS 0x3FBDC4 /begin FUNCTION_LIST Leerlaufregler /end FUNCTION_LIST /end MEASUREMENT
/* ------------------ Abschnitt erzeugt aus md_basis.dat ------------------ */
/begin CHARACTERISTIC K_MD_HYP_VERH_START "Begrenzung Hyperbel ausserhalb Motor laeuft" VALUE 0x61710 TKW_VV_VV_UB 100.0 FORMULA_0178 0.0 1.9921 /begin FUNCTION_LIST Momentenmanager /end FUNCTION_LIST /end CHARACTERISTIC
/begin CHARACTERISTIC K_MD_HYP_VERH_KRAFTS "Best. Schnittpunkt Brenngrenze mit Hyp.bei Krafts." VALUE 0x61711 TKW_VV_VV_UB 100.0 FORMULA_0178 0.0 1.9921 /begin FUNCTION_LIST Momentenmanager /end FUNCTION_LIST /end CHARACTERISTIC
/begin CHARACTERISTIC K_MD_HYP_VERH_NO_KRAFTS "Best. Schnittpunkt Brenngrenze mit Hyp.bei NO_Krafts." VALUE 0x61712 TKW_VV_VV_UB 100.0 FORMULA_0178 0.0 1.9921 /begin FUNCTION_LIST Momentenmanager /end FUNCTION_LIST /end CHARACTERISTIC
/begin CHARACTERISTIC K_MD_POLYNOM_A_LL "A-Polynom fuer LL" VALUE 0x61714 TKW_VV_VV_SW 100.0 FORMULA_0182 -320.0000 320.0000 /begin FUNCTION_LIST Momentenmanager /end FUNCTION_LIST FORMAT "%5.2" /end CHARACTERISTIC
/begin CHARACTERISTIC K_MD_POLYNOM_B_LL "B-Polynom fuer LL" VALUE 0x61716 TKW_VV_VV_SW 100.0 FORMULA_0182 -320.0000 320.0000 /begin FUNCTION_LIST Momentenmanager /end FUNCTION_LIST FORMAT "%5.2" /end CHARACTERISTIC
/begin CHARACTERISTIC K_MD_TAU_START_OFF "Filter fuer Startoffset" VALUE 0x61718 TKW_VV_VV_UB 100.0 FORMULA_0183 0.0101 2.5600 /begin FUNCTION_LIST Momentenmanager /end FUNCTION_LIST /end CHARACTERISTIC
/begin CHARACTERISTIC K_MD_TAU_KKOS "Filter fuer KKOS" VALUE 0x61719 TKW_VV_VV_UB 100.0 FORMULA_0183 0.0101 2.5600 /begin FUNCTION_LIST Momentenmanager /end FUNCTION_LIST /end CHARACTERISTIC
/begin CHARACTERISTIC K_MD_CFG_LM "Cfg fuer Lastmomente" VALUE 0x6171A TKW_VV_VV_UB 100.0 FORMULA_0184 0.0 255.0 /begin FUNCTION_LIST Momentenmanager /end FUNCTION_LIST /end CHARACTERISTIC
/begin CHARACTERISTIC K_MD_CFG_RG_KORR "Cfg fuer RG-Korrektur" VALUE 0x6171B TKW_VV_VV_UB 100.0 FORMULA_0185 0.0 255.0 /begin FUNCTION_LIST Momentenmanager /end FUNCTION_LIST /end CHARACTERISTIC
/begin CHARACTERISTIC KL_MD_RF_MAX_ROH "maximale rel. Füllung" CURVE 0x6171C TKL_SW_VV_SW 100.0 FORMULA_0006 0.0 2.0000 /begin FUNCTION_LIST Momentenmanager /end FUNCTION_LIST /begin AXIS_DESCR STD_AXIS n FORMULA_0011 18 0.0 10000.0000 /end AXIS_DESCR FORMAT "%6.3" /end CHARACTERISTIC
/begin CHARACTERISTIC KL_MD_HYP_DN "Drehzahloffset fuer MD_MIN-Hyperbelast" CURVE 0x61766 TKL_SW_VV_SW 100.0 FORMULA_0011 0.0 10000.0000 /begin FUNCTION_LIST Momentenmanager /end FUNCTION_LIST
 /begin AXIS_DESCR STD_AXIS tmot FORMULA_0019 3 -50.0000 150.0000 FORMAT "%4.1" /end AXIS_DESCR
/end CHARACTERISTIC
/begin CHARACTERISTIC KL_MD_ETA_LA "LA-Wirkungsgrad" CURVE 0x61774 TKL_UW_VV_UW 100.0 FORMULA_0181 0.0 150.0000 /begin FUNCTION_LIST Momentenmanager /end FUNCTION_LIST /begin AXIS_DESCR STD_AXIS la FORMULA_0004 8 0.0 3.9990 FORMAT "%6.3" /end AXIS_DESCR FORMAT "%4.1" /end CHARACTERISTIC
/begin CHARACTERISTIC KL_MD_ZW_OPT_LL "optimaler ZW fuer Leerlauf" CURVE 0x61796 TKL_SW_VV_SW 100.0 FORMULA_0037 -50.0000 60.0000 /begin FUNCTION_LIST Momentenmanager /end FUNCTION_LIST /begin AXIS_DESCR STD_AXIS n FORMULA_0011 6 0.0 10000.0000 /end AXIS_DESCR FORMAT "%4.1" /end CHARACTERISTIC
/begin CHARACTERISTIC KL_MD_ZW_LA "ZW-Einfluss durch Lambda" CURVE 0x617B0 TKL_SW_VV_SW 100.0 FORMULA_0037 -50.0000 60.0000 /begin FUNCTION_LIST Momentenmanager /end FUNCTION_LIST /begin AXIS_DESCR STD_AXIS Lambda FORMULA_0004 6 0.0 1.9990 FORMAT "%6.3" /end AXIS_DESCR FORMAT "%4.1" /end CHARACTERISTIC
/begin CHARACTERISTIC KL_MD_ZW_TMOT "ZW-Einfluss durch tmot" CURVE 0x617CA TKL_SW_VV_SW 100.0 FORMULA_0037 -50.0000 60.0000 /begin FUNCTION_LIST Momentenmanager /end FUNCTION_LIST
 /begin AXIS_DESCR STD_AXIS tmot FORMULA_0019 6 -50.0000 150.0000 FORMAT "%4.1" /end AXIS_DESCR
 FORMAT "%4.1" /end CHARACTERISTIC
/begin CHARACTERISTIC KL_MD_IND_REIB_OFFSET "Offset fuer Reibmoment nach Start" CURVE 0x617E4 TKL_SW_VV_SW 100.0 FORMULA_0179 0.0 320.0000 /begin FUNCTION_LIST Momentenmanager /end FUNCTION_LIST
 /begin AXIS_DESCR STD_AXIS tmot FORMULA_0019 4 -50.0000 150.0000 FORMAT "%4.1" /end AXIS_DESCR
 FORMAT "%4.1" /end CHARACTERISTIC
/begin CHARACTERISTIC KL_MD_IND_REIB_ABREG "Abregelrampe fuer Reibmoment nach Start" CURVE 0x617F6 TKL_SW_VV_SW 100.0 FORMULA_0180 -100.0000 1000.0000 /begin FUNCTION_LIST Momentenmanager /end FUNCTION_LIST
 /begin AXIS_DESCR STD_AXIS tmot FORMULA_0019 4 -50.0000 150.0000 FORMAT "%4.1" /end AXIS_DESCR
 FORMAT "%5.2" /end CHARACTERISTIC
/begin CHARACTERISTIC KF_MD_RF_MIN "minimale rel. Füllung" MAP 0x61808 TKF_SW_SW_SW 100.0 FORMULA_0006 0.0 2.0000 /begin FUNCTION_LIST Momentenmanager /end FUNCTION_LIST /begin AXIS_DESCR STD_AXIS n FORMULA_0011 8 0.0 10000.0000 /end AXIS_DESCR
 /begin AXIS_DESCR STD_AXIS tmot FORMULA_0019 6 -50.0000 150.0000 FORMAT "%4.1" /end AXIS_DESCR
 FORMAT "%6.3" /end CHARACTERISTIC
/begin CHARACTERISTIC KF_MD_IND_OPT "optimales Moment bei LA 1" MAP 0x61886 TKF_SW_SW_SW 100.0 FORMULA_0018 -100.0000 1000.0000 /begin FUNCTION_LIST Momentenmanager /end FUNCTION_LIST /begin AXIS_DESCR STD_AXIS n FORMULA_0011 18 0.0 10000.0000 /end AXIS_DESCR /begin AXIS_DESCR STD_AXIS rf_m FORMULA_0006 12 0.0 2.0000 FORMAT "%6.3" /end AXIS_DESCR FORMAT "%4.1" /end CHARACTERISTIC
/begin CHARACTERISTIC KF_MD_IND_BRENNGRENZE "Brenngrenze" MAP 0x61A74 TKF_SW_SW_SW 100.0 FORMULA_0018 -100.0000 1000.0000 /begin FUNCTION_LIST Momentenmanager /end FUNCTION_LIST /begin AXIS_DESCR STD_AXIS n FORMULA_0011 8 0.0 10000.0000 /end AXIS_DESCR
 /begin AXIS_DESCR STD_AXIS tmot FORMULA_0019 6 -50.0000 150.0000 FORMAT "%4.1" /end AXIS_DESCR
 FORMAT "%4.1" /end CHARACTERISTIC
/begin CHARACTERISTIC KF_MD_IND_REIB "Reibmoment" MAP 0x61AF2 TKF_SW_SW_SW 100.0 FORMULA_0018 -100.0000 1000.0000 /begin FUNCTION_LIST Momentenmanager /end FUNCTION_LIST
 /begin AXIS_DESCR STD_AXIS tmot FORMULA_0019 8 -50.0000 150.0000 FORMAT "%4.1" /end AXIS_DESCR
 /begin AXIS_DESCR STD_AXIS toel FORMULA_0019 8 -50.0000 150.0000 FORMAT "%4.1" /end AXIS_DESCR
 FORMAT "%4.1" /end CHARACTERISTIC
/begin CHARACTERISTIC KF_MD_IND_LW_VERLUSTE "Ladungswechselverluste" MAP 0x61B94 TKF_SW_SW_SW 100.0 FORMULA_0018 -100.0000 1000.0000 /begin FUNCTION_LIST Momentenmanager /end FUNCTION_LIST /begin AXIS_DESCR STD_AXIS n FORMULA_0011 10 0.0 10000.0000 /end AXIS_DESCR /begin AXIS_DESCR STD_AXIS rf_m FORMULA_0006 8 0.0 2.0000 FORMAT "%6.3" /end AXIS_DESCR FORMAT "%4.1" /end CHARACTERISTIC
/begin CHARACTERISTIC KF_MD_ZW_OPT "Optimaler Zündhaken" MAP 0x61C5A TKF_SW_SW_SW 100.0 FORMULA_0037 -50.0000 60.0000 /begin FUNCTION_LIST Momentenmanager /end FUNCTION_LIST /begin AXIS_DESCR STD_AXIS n FORMULA_0011 18 0.0 10000.0000 /end AXIS_DESCR /begin AXIS_DESCR STD_AXIS rf_m FORMULA_0006 12 0.0 2.0000 FORMAT "%6.3" /end AXIS_DESCR FORMAT "%4.1" /end CHARACTERISTIC
/begin CHARACTERISTIC KF_MD_ZW_RG "Restgaseinfluss auf opt. Zündwinkel" MAP 0x61E48 TKF_SW_SW_SW 100.0 FORMULA_0186 0.0 100.0000 /begin FUNCTION_LIST Momentenmanager /end FUNCTION_LIST /begin AXIS_DESCR STD_AXIS n FORMULA_0011 8 0.0 10000.0000 /end AXIS_DESCR /begin AXIS_DESCR STD_AXIS rf_m FORMULA_0006 6 0.0 2.0000 FORMAT "%6.3" /end AXIS_DESCR FORMAT "%4.1" /end CHARACTERISTIC
/begin CHARACTERISTIC KF_MD_POLYNOM_A "A-Paramter Polynom für Zündhaken" MAP 0x61EC6 TKF_SW_SW_SW 100.0 FORMULA_0182 -320.0000 320.0000 /begin FUNCTION_LIST Momentenmanager /end FUNCTION_LIST /begin AXIS_DESCR STD_AXIS n FORMULA_0011 18 0.0 10000.0000 /end AXIS_DESCR /begin AXIS_DESCR STD_AXIS rf_m FORMULA_0006 12 0.0 2.0000 FORMAT "%6.3" /end AXIS_DESCR FORMAT "%5.2" /end CHARACTERISTIC
/begin CHARACTERISTIC KF_MD_POLYNOM_B "B-Paramter Polynom für Zündhaken" MAP 0x620B4 TKF_SW_SW_SW 100.0 FORMULA_0182 -320.0000 320.0000 /begin FUNCTION_LIST Momentenmanager /end FUNCTION_LIST /begin AXIS_DESCR STD_AXIS n FORMULA_0011 6 0.0 10000.0000 /end AXIS_DESCR /begin AXIS_DESCR STD_AXIS rf_m FORMULA_0006 4 0.0 2.0000 FORMAT "%6.3" /end AXIS_DESCR FORMAT "%5.2" /end CHARACTERISTIC
/begin CHARACTERISTIC KF_MD_START_OFFSET "Vorsteuerung für Start" MAP 0x620FA TKF_SW_SW_SW 100.0 FORMULA_0018 -100.0000 1000.0000 /begin FUNCTION_LIST Momentenmanager /end FUNCTION_LIST /begin AXIS_DESCR STD_AXIS n FORMULA_0011 8 0.0 10000.0000 /end AXIS_DESCR
 /begin AXIS_DESCR STD_AXIS tmot FORMULA_0019 6 -50.0000 150.0000 FORMAT "%4.1" /end AXIS_DESCR
 FORMAT "%4.1" /end CHARACTERISTIC
/begin MEASUREMENT md_rf_min "rf_min mit Komp." SWORD FORMULA_0006 0 0 0.0 2.0000 ECU_ADDRESS 0x3FBE26 /begin FUNCTION_LIST Momentenmanager /end FUNCTION_LIST /end MEASUREMENT
/begin MEASUREMENT md_rf_max_roh "rf_max" SWORD FORMULA_0006 0 0 0.0 2.0000 ECU_ADDRESS 0x3FBE28 /begin FUNCTION_LIST Momentenmanager /end FUNCTION_LIST /end MEASUREMENT
/begin MEASUREMENT md_rf_tl_vl "rf_max" SWORD FORMULA_0006 0 0 0.0 2.0000 ECU_ADDRESS 0x3FBE2A /begin FUNCTION_LIST Momentenmanager /end FUNCTION_LIST /end MEASUREMENT
/begin MEASUREMENT md_hyp_faktor "Hyp-Faktor" UBYTE FORMULA_0178 0 0 0.0 1.9921 ECU_ADDRESS 0x3FBE2C /begin FUNCTION_LIST Momentenmanager /end FUNCTION_LIST /end MEASUREMENT
/begin MEASUREMENT md_ind_brenngrenze "Brenngrenze" SWORD FORMULA_0018 0 0 -100.0000 1000.0000 ECU_ADDRESS 0x3FBE2E /begin FUNCTION_LIST Momentenmanager /end FUNCTION_LIST /end MEASUREMENT
/begin MEASUREMENT md_ind_reib_roh "Reibverluste (Rohwert)" SWORD FORMULA_0018 0 0 -100.0000 1000.0000 ECU_ADDRESS 0x3FBE30 /begin FUNCTION_LIST Momentenmanager /end FUNCTION_LIST /end MEASUREMENT
/begin MEASUREMENT md_ind_reib_offset "Reibverluste (Offset)" SWORD FORMULA_0179 0 0 -100.0000 200.0000 ECU_ADDRESS 0x3FBE32 /begin FUNCTION_LIST Momentenmanager /end FUNCTION_LIST /end MEASUREMENT
/begin MEASUREMENT md_ind_reib_abreg "Reibverluste (Abregelung nach Start)" SWORD FORMULA_0180 0 0 -100.0000 1000.0000 ECU_ADDRESS 0x3FBE34 /begin FUNCTION_LIST Momentenmanager /end FUNCTION_LIST /end MEASUREMENT
/begin MEASUREMENT md_ind_reib "Reibverluste (Summe)" SWORD FORMULA_0018 0 0 -100.0000 1000.0000 ECU_ADDRESS 0x3FBE36 /begin FUNCTION_LIST Momentenmanager /end FUNCTION_LIST /end MEASUREMENT
/begin MEASUREMENT md_ind_lw_min "LW-Verluste bei MIN" SWORD FORMULA_0018 0 0 -100.0000 1000.0000 ECU_ADDRESS 0x3FBE38 /begin FUNCTION_LIST Momentenmanager /end FUNCTION_LIST /end MEASUREMENT
/begin MEASUREMENT md_ind_lw_max "LW-Verluste bei MAX" SWORD FORMULA_0018 0 0 -100.0000 1000.0000 ECU_ADDRESS 0x3FBE3A /begin FUNCTION_LIST Momentenmanager /end FUNCTION_LIST /end MEASUREMENT
/begin MEASUREMENT md_ind_schlepp_min "Schleppmoment bei MIN" SWORD FORMULA_0018 0 0 -100.0000 1000.0000 ECU_ADDRESS 0x3FBE3C /begin FUNCTION_LIST Momentenmanager /end FUNCTION_LIST /end MEASUREMENT
/begin MEASUREMENT md_ind_schlepp_max "Schleppmoment bei MAX" SWORD FORMULA_0018 0 0 -100.0000 1000.0000 ECU_ADDRESS 0x3FBE3E /begin FUNCTION_LIST Momentenmanager /end FUNCTION_LIST /end MEASUREMENT
/begin MEASUREMENT md_lm_kkos "Lastmoment Klima" SWORD FORMULA_0018 0 0 -100.0000 1000.0000 ECU_ADDRESS 0x3FBE40 /begin FUNCTION_LIST Momentenmanager /end FUNCTION_LIST /end MEASUREMENT
/begin MEASUREMENT md_verbraucher "Verbraucher" SWORD FORMULA_0018 0 0 -100.0000 1000.0000 ECU_ADDRESS 0x3FBE42 /begin FUNCTION_LIST Momentenmanager /end FUNCTION_LIST /end MEASUREMENT
/begin MEASUREMENT md_start_offset "Offset beim Start" SWORD FORMULA_0018 0 0 -100.0000 1000.0000 ECU_ADDRESS 0x3FBE44 /begin FUNCTION_LIST Momentenmanager /end FUNCTION_LIST /end MEASUREMENT
/begin MEASUREMENT md_ind_min_roh "indiziertes Minimalmoment ohne Verbraucher" SWORD FORMULA_0018 0 0 -100.0000 1000.0000 ECU_ADDRESS 0x3FBE46 /begin FUNCTION_LIST Momentenmanager /end FUNCTION_LIST /end MEASUREMENT
/begin MEASUREMENT md_ind_min "indiziertes Minimalmoment" SWORD FORMULA_0018 0 0 -100.0000 1000.0000 ECU_ADDRESS 0x3FBE48 /begin FUNCTION_LIST Momentenmanager /end FUNCTION_LIST /end MEASUREMENT
/begin MEASUREMENT md_ind_max_roh "ind. Maximalmoment" SWORD FORMULA_0018 0 0 -100.0000 1000.0000 ECU_ADDRESS 0x3FBE4A /begin FUNCTION_LIST Momentenmanager /end FUNCTION_LIST /end MEASUREMENT
/begin MEASUREMENT md_ind_max "ind. Maximalmoment mit LA-Korr" SWORD FORMULA_0018 0 0 -100.0000 1000.0000 ECU_ADDRESS 0x3FBE4C /begin FUNCTION_LIST Momentenmanager /end FUNCTION_LIST /end MEASUREMENT
/begin MEASUREMENT md_ind_opt "Indiziertes Istmoment" SWORD FORMULA_0018 0 0 -100.0000 1000.0000 ECU_ADDRESS 0x3FBE4E /begin FUNCTION_LIST Momentenmanager /end FUNCTION_LIST /end MEASUREMENT
/begin MEASUREMENT md_ind_opt_la "ind. Istmoment mit LA-Einfluss" SWORD FORMULA_0018 0 0 -100.0000 1000.0000 ECU_ADDRESS 0x3FBE50 /begin FUNCTION_LIST Momentenmanager /end FUNCTION_LIST /end MEASUREMENT
/begin MEASUREMENT md_ind_opt_la_rg "ind. Istmoment mit LA-/RG-Einfluss" SWORD FORMULA_0018 0 0 -100.0000 1000.0000 ECU_ADDRESS 0x3FBE52 /begin FUNCTION_LIST Momentenmanager /end FUNCTION_LIST /end MEASUREMENT
/begin MEASUREMENT md_ind_ve "ind. Moment vor Eingriff" SWORD FORMULA_0018 0 0 -100.0000 1000.0000 ECU_ADDRESS 0x3FBE54 /begin FUNCTION_LIST Momentenmanager /end FUNCTION_LIST /end MEASUREMENT
/begin MEASUREMENT md_eta_la_vl "ETA-Lambda-VL" UWORD FORMULA_0181 0 0 0.0 150.0000 ECU_ADDRESS 0x3FBE56 /begin FUNCTION_LIST Momentenmanager /end FUNCTION_LIST /end MEASUREMENT
/begin MEASUREMENT md_eta_la_ist "ETA-Lambda-Ist" UWORD FORMULA_0181 0 0 0.0 150.0000 ECU_ADDRESS 0x3FBE58 /begin FUNCTION_LIST Momentenmanager /end FUNCTION_LIST /end MEASUREMENT
/begin MEASUREMENT md_eta_rg_lw "ETA-Restgas-Lastwechsel" UWORD FORMULA_0181 0 0 0.0 150.0000 ECU_ADDRESS 0x3FBE5A /begin FUNCTION_LIST Momentenmanager /end FUNCTION_LIST /end MEASUREMENT
/begin MEASUREMENT md_eta_rg_brenn "ETA-Restgas-Verbrennung" UWORD FORMULA_0181 0 0 0.0 150.0000 ECU_ADDRESS 0x3FBE5C /begin FUNCTION_LIST Momentenmanager /end FUNCTION_LIST /end MEASUREMENT
/begin MEASUREMENT md_eta_zw_min "min. ETA-TZ" UWORD FORMULA_0181 0 0 0.0 150.0000 ECU_ADDRESS 0x3FBE5E /begin FUNCTION_LIST Momentenmanager /end FUNCTION_LIST /end MEASUREMENT
/begin MEASUREMENT md_eta_zw_ve "ETA-TZ vor Eingriff" UWORD FORMULA_0181 0 0 0.0 150.0000 ECU_ADDRESS 0x3FBE60 /begin FUNCTION_LIST Momentenmanager /end FUNCTION_LIST /end MEASUREMENT
/begin MEASUREMENT md_eta_zw_ne "ETA-TZ nach Eingriff" UWORD FORMULA_0181 0 0 0.0 150.0000 ECU_ADDRESS 0x3FBE62 /begin FUNCTION_LIST Momentenmanager /end FUNCTION_LIST /end MEASUREMENT
/begin MEASUREMENT md_eta_ausblend "ETA-Ausblend" UWORD FORMULA_0181 0 0 0.0 150.0000 ECU_ADDRESS 0x3FBE64 /begin FUNCTION_LIST Momentenmanager /end FUNCTION_LIST /end MEASUREMENT
/begin MEASUREMENT md_eta_zw_soll "Sollwirkungsgrad" UWORD FORMULA_0181 0 0 0.0 150.0000 ECU_ADDRESS 0x3FBE66 /begin FUNCTION_LIST Momentenmanager /end FUNCTION_LIST /end MEASUREMENT
/begin MEASUREMENT md_llrp "P-Anteil v. LLR" SWORD FORMULA_0018 0 0 -100.0000 1000.0000 ECU_ADDRESS 0x3FBE68 /begin FUNCTION_LIST Momentenmanager /end FUNCTION_LIST /end MEASUREMENT
/begin MEASUREMENT md_llri "I-Anteil v. LLR" SWORD FORMULA_0018 0 0 -100.0000 1000.0000 ECU_ADDRESS 0x3FBE6A /begin FUNCTION_LIST Momentenmanager /end FUNCTION_LIST /end MEASUREMENT
/begin MEASUREMENT md_llra "Adaptions-Anteil v. LLR" SWORD FORMULA_0018 0 0 -100.0000 1000.0000 ECU_ADDRESS 0x3FBE6C /begin FUNCTION_LIST Momentenmanager /end FUNCTION_LIST /end MEASUREMENT
/begin MEASUREMENT md_llr_tz "TZ-Anteil v. LLR" SWORD FORMULA_0018 0 0 -100.0000 1000.0000 ECU_ADDRESS 0x3FBE6E /begin FUNCTION_LIST Momentenmanager /end FUNCTION_LIST /end MEASUREMENT
/begin MEASUREMENT md_zw_opt "opt. Zündwinkel" SWORD FORMULA_0037 0 0 -50.0000 60.0000 ECU_ADDRESS 0x3FBE70 /begin FUNCTION_LIST Momentenmanager /end FUNCTION_LIST /end MEASUREMENT
/begin MEASUREMENT md_zw_rg_delta "RG-Delta" SWORD FORMULA_0037 0 0 -50.0000 60.0000 ECU_ADDRESS 0x3FBE72 /begin FUNCTION_LIST Momentenmanager /end FUNCTION_LIST /end MEASUREMENT
/begin MEASUREMENT md_zw_opt_rg "opt. ZW mit RG" SWORD FORMULA_0037 0 0 -50.0000 60.0000 ECU_ADDRESS 0x3FBE74 /begin FUNCTION_LIST Momentenmanager /end FUNCTION_LIST /end MEASUREMENT
/begin MEASUREMENT md_zw_opt_rg_tmot "opt. ZW mit RG Tmot" SWORD FORMULA_0037 0 0 -50.0000 60.0000 ECU_ADDRESS 0x3FBE76 /begin FUNCTION_LIST Momentenmanager /end FUNCTION_LIST /end MEASUREMENT
/begin MEASUREMENT md_zw_opt_rg_tmot_la "opt. ZW mit RG Tmot LA" SWORD FORMULA_0037 0 0 -50.0000 60.0000 ECU_ADDRESS 0x3FBE78 /begin FUNCTION_LIST Momentenmanager /end FUNCTION_LIST /end MEASUREMENT
/begin MEASUREMENT md_polynom_a "Polynom_a" SWORD FORMULA_0182 0 0 -320.0000 320.0000 ECU_ADDRESS 0x3FBE7A /begin FUNCTION_LIST Momentenmanager /end FUNCTION_LIST /end MEASUREMENT
/begin MEASUREMENT md_polynom_b "Polynom_b" SWORD FORMULA_0182 0 0 -320.0000 320.0000 ECU_ADDRESS 0x3FBE7C /begin FUNCTION_LIST Momentenmanager /end FUNCTION_LIST /end MEASUREMENT
/* ------------------ Abschnitt erzeugt aus md_filter.dat ------------------ */
/begin CHARACTERISTIC K_MD_DELTA_SA "SA-Delta zum Schleppmoment" VALUE 0x62178 TKW_VV_VV_SW 100.0 FORMULA_0188 -100.0000 0.0 /begin FUNCTION_LIST Momentenmanager /end FUNCTION_LIST FORMAT "%4.1" /end CHARACTERISTIC
/begin CHARACTERISTIC K_MD_DELTA_WE "WE-Delta zum Reibmoment" VALUE 0x6217A TKW_VV_VV_SW 100.0 FORMULA_0188 0.0 100.0000 /begin FUNCTION_LIST Momentenmanager /end FUNCTION_LIST FORMAT "%4.1" /end CHARACTERISTIC
/begin MEASUREMENT md_dyn_st "Filterstatus" UBYTE FORMULA_0187 0 0 0.0 255.0 ECU_ADDRESS 0x3FBE7E /begin FUNCTION_LIST Momentenmanager /end FUNCTION_LIST /end MEASUREMENT
/* ------------------ Abschnitt erzeugt aus md_sk.dat ------------------ */
/begin CHARACTERISTIC K_MD_SK_CFG "SK-Cfg" VALUE 0x6217C TKW_VV_VV_UB 100.0 FORMULA_0190 0.0 255.0 /begin FUNCTION_LIST Momentenmanager /end FUNCTION_LIST /end CHARACTERISTIC
/begin CHARACTERISTIC K_MD_SK_PWGMIN "PWG-Schwelle fuer pwg=0" VALUE 0x6217D TKW_VV_VV_UB 100.0 FORMULA_0191 0.0 25.0000 /begin FUNCTION_LIST Momentenmanager /end FUNCTION_LIST /end CHARACTERISTIC
/begin CHARACTERISTIC K_MD_SK_NHYS "n_llr-Offset bei pwg=0" VALUE 0x6217E TKW_VV_VV_SW 100.0 FORMULA_0011 0.0 10000.0000 /begin FUNCTION_LIST Momentenmanager /end FUNCTION_LIST /end CHARACTERISTIC
/begin CHARACTERISTIC K_MD_SK_FWMAX "max. Moment bei pwg=0" VALUE 0x62180 TKW_VV_VV_SW 100.0 FORMULA_0018 -100.0000 1000.0000 /begin FUNCTION_LIST Momentenmanager /end FUNCTION_LIST FORMAT "%4.1" /end CHARACTERISTIC
/begin CHARACTERISTIC K_MD_SK_GEWICHTUNG "Gewichtungsfaktor bei pwg>0" VALUE 0x62182 TKW_VV_VV_UW 100.0 FORMULA_0035 0.0 4.0000 /begin FUNCTION_LIST Momentenmanager /end FUNCTION_LIST FORMAT "%6.3" /end CHARACTERISTIC
/begin CHARACTERISTIC K_MD_SK_OFFSET "max. Abweichung bei pwg>0" VALUE 0x62184 TKW_VV_VV_SW 100.0 FORMULA_0018 -100.0000 1000.0000 /begin FUNCTION_LIST Momentenmanager /end FUNCTION_LIST FORMAT "%4.1" /end CHARACTERISTIC
/begin CHARACTERISTIC K_MD_SK_TIMER_0 "max. Timer fuer pwg=0" VALUE 0x62186 TKW_VV_VV_UW 100.0 FORMULA_0126 0.0 655.3500 /begin FUNCTION_LIST Momentenmanager /end FUNCTION_LIST FORMAT "%5.2" /end CHARACTERISTIC
/begin CHARACTERISTIC K_MD_SK_TIMER_1 "max. Timer fuer pwg>0" VALUE 0x62188 TKW_VV_VV_UW 100.0 FORMULA_0126 0.0 655.3500 /begin FUNCTION_LIST Momentenmanager /end FUNCTION_LIST FORMAT "%5.2" /end CHARACTERISTIC
/begin CHARACTERISTIC K_MD_SK_N_MDMIN "Drehzahlschwelle fuer Momentenueberwachung MDmin" VALUE 0x6218A TKW_VV_VV_SW 100.0 FORMULA_0011 0.0 10000.0000 /begin FUNCTION_LIST Momentenmanager /end FUNCTION_LIST /end CHARACTERISTIC
/begin CHARACTERISTIC K_MD_SK_MAX_MDMIN "maximal zulaessiges MDmin" VALUE 0x6218C TKW_VV_VV_SW 100.0 FORMULA_0018 -100.0000 1000.0000 /begin FUNCTION_LIST Momentenmanager /end FUNCTION_LIST FORMAT "%4.1" /end CHARACTERISTIC
/begin CHARACTERISTIC K_MD_SK_RF_MAX "max. rf zur Absicherung Momentenberechnung" VALUE 0x6218E TKW_VV_VV_SW 100.0 FORMULA_0006 0.0 2.0000 /begin FUNCTION_LIST Momentenmanager /end FUNCTION_LIST FORMAT "%6.3" /end CHARACTERISTIC
/begin CHARACTERISTIC K_MD_SK_ETA_MIN "minimales ETA zur Absicherung Momentenberechnung" VALUE 0x62190 TKW_VV_VV_UW 100.0 FORMULA_0181 0.0 150.0000 /begin FUNCTION_LIST Momentenmanager /end FUNCTION_LIST FORMAT "%4.1" /end CHARACTERISTIC
/begin CHARACTERISTIC K_MD_SK_LLR_MAX "maximaler LLR-Anteil" VALUE 0x62192 TKW_VV_VV_SW 100.0 FORMULA_0018 -100.0000 1000.0000 /begin FUNCTION_LIST Momentenmanager /end FUNCTION_LIST FORMAT "%4.1" /end CHARACTERISTIC
/begin CHARACTERISTIC KL_MD_SK_WDK "Max. WDK-Position bei PWG = 0" CURVE 0x62194 TKL_SW_VV_SW 100.0 FORMULA_0022 -10.0000 120.0000 /begin FUNCTION_LIST Momentenmanager /end FUNCTION_LIST /begin AXIS_DESCR STD_AXIS n FORMULA_0011 3 0.0 10000.0000 /end AXIS_DESCR FORMAT "%4.1" /end CHARACTERISTIC
/begin MEASUREMENT md_sk_timer_0 "SK-Timer bei pwg=0" UWORD FORMULA_0126 0 0 0.0 655.3500 ECU_ADDRESS 0x3FBE80 /begin FUNCTION_LIST Momentenmanager /end FUNCTION_LIST /end MEASUREMENT
/begin MEASUREMENT md_sk_timer_1 "SK-Timer bei pwg>0" UWORD FORMULA_0126 0 0 0.0 655.3500 ECU_ADDRESS 0x3FBE82 /begin FUNCTION_LIST Momentenmanager /end FUNCTION_LIST /end MEASUREMENT
/begin MEASUREMENT md_sk_fehler "SK-Fehlerinfo" UBYTE FORMULA_0189 0 0 0.0 255.0 ECU_ADDRESS 0x3FBE84 /begin FUNCTION_LIST Momentenmanager /end FUNCTION_LIST /end MEASUREMENT
/begin MEASUREMENT md_sk_wdkmax "zulaesssiger DK-Winkel bei pwg=0" SWORD FORMULA_0022 0 0 -10.0000 120.0000 ECU_ADDRESS 0x3FBE86 /begin FUNCTION_LIST Momentenmanager /end FUNCTION_LIST /end MEASUREMENT
/begin MEASUREMENT md_sk_vergl_ist "Vergleichsistmoment" SWORD FORMULA_0018 0 0 -100.0000 1000.0000 ECU_ADDRESS 0x3FBE88 /begin FUNCTION_LIST Momentenmanager /end FUNCTION_LIST /end MEASUREMENT
/begin MEASUREMENT md_sk_vergl_soll "Vergleichssollmoment" SWORD FORMULA_0018 0 0 -100.0000 1000.0000 ECU_ADDRESS 0x3FBE8A /begin FUNCTION_LIST Momentenmanager /end FUNCTION_LIST /end MEASUREMENT
/* ------------------ Abschnitt erzeugt aus md_soll.dat ------------------ */
/begin CHARACTERISTIC K_MD_CFG_RF_MCS "RF-Vorgaben per MCS" VALUE 0x621A2 TKW_VV_VV_UB 100.0 FORMULA_0194 0.0 255.0 /begin FUNCTION_LIST Momentenmanager /end FUNCTION_LIST /end CHARACTERISTIC
/begin CHARACTERISTIC K_MD_CFG_ZW_BEZUG "Kontrollbyte ZW-Eingriffe" VALUE 0x621A3 TKW_VV_VV_UB 100.0 FORMULA_0193 0.0 255.0 /begin FUNCTION_LIST Momentenmanager /end FUNCTION_LIST /end CHARACTERISTIC
/begin CHARACTERISTIC K_MD_ETA_EINGRIFF "ETA-Grenze" VALUE 0x621A4 TKW_VV_VV_UW 100.0 FORMULA_0181 0.0 150.0000 /begin FUNCTION_LIST Momentenmanager /end FUNCTION_LIST FORMAT "%4.1" /end CHARACTERISTIC
/begin CHARACTERISTIC K_MD_RESERVE_TST "Test-Reserve" VALUE 0x621A6 TKW_VV_VV_SW 100.0 FORMULA_0018 -100.0000 1000.0000 /begin FUNCTION_LIST Momentenmanager /end FUNCTION_LIST FORMAT "%4.1" /end CHARACTERISTIC
/begin CHARACTERISTIC K_MD_RF_SOLL_MCS "RF-Sollvorgabe" VALUE 0x621A8 TKW_VV_VV_SW 100.0 FORMULA_0006 0.0 2.0000 /begin FUNCTION_LIST Momentenmanager /end FUNCTION_LIST FORMAT "%6.3" /end CHARACTERISTIC
/begin CHARACTERISTIC KF_MD_FAHRER "relatives Sollmoment aus pwg und n" MAP 0x621AA TKF_SW_SW_SW 100.0 FORMULA_0022 0.0 100.0000 /begin FUNCTION_LIST Momentenmanager /end FUNCTION_LIST /begin AXIS_DESCR STD_AXIS n FORMULA_0011 8 0.0 10000.0000 /end AXIS_DESCR
 /begin AXIS_DESCR STD_AXIS pwg FORMULA_0022 6 -10.0000 120.0000 FORMAT "%4.1" /end AXIS_DESCR
 FORMAT "%4.1" /end CHARACTERISTIC
/begin MEASUREMENT md_fw_fgr "rel. Wunschmoment vom FGR" SWORD FORMULA_0022 0 0 0.0 100.0000 ECU_ADDRESS 0x3FBE8C /begin FUNCTION_LIST Momentenmanager /end FUNCTION_LIST /end MEASUREMENT
/begin MEASUREMENT md_kupp_min_filter "SAWE-Filter bei min Moment" SWORD FORMULA_0018 0 0 -100.0000 1000.0000 ECU_ADDRESS 0x3FBE8E /begin FUNCTION_LIST Momentenmanager /end FUNCTION_LIST /end MEASUREMENT
/begin MEASUREMENT md_kupp_wunsch "Wunschmoment direkt vom Fahrer/FGR" SWORD FORMULA_0018 0 0 -100.0000 1000.0000 ECU_ADDRESS 0x3FBE90 /begin FUNCTION_LIST Momentenmanager /end FUNCTION_LIST /end MEASUREMENT
/begin MEASUREMENT md_kupp_wunsch_fil_roh "Wunschmoment nach Dynamikfilter" SWORD FORMULA_0018 0 0 -100.0000 1000.0000 ECU_ADDRESS 0x3FBE92 /begin FUNCTION_LIST Momentenmanager /end FUNCTION_LIST /end MEASUREMENT
/begin MEASUREMENT md_kupp_wunsch_filter "Wunschmoment nach Dynamikfilter + LL-Regler" SWORD FORMULA_0018 0 0 -100.0000 1000.0000 ECU_ADDRESS 0x3FBE94 /begin FUNCTION_LIST Momentenmanager /end FUNCTION_LIST /end MEASUREMENT
/begin MEASUREMENT md_kupp_wunsch_ml "Wunschmoment fuer den Luftpfad" SWORD FORMULA_0018 0 0 -100.0000 1000.0000 ECU_ADDRESS 0x3FBE96 /begin FUNCTION_LIST Momentenmanager /end FUNCTION_LIST /end MEASUREMENT
/begin MEASUREMENT md_kupp_wunsch_tz "Wunschmoment fuer den Zuendwinkelpfad" SWORD FORMULA_0018 0 0 -100.0000 1000.0000 ECU_ADDRESS 0x3FBE98 /begin FUNCTION_LIST Momentenmanager /end FUNCTION_LIST /end MEASUREMENT
/begin MEASUREMENT md_ind_wunsch_ml "ind. Wunschmoment fuer den Luftpfad" SWORD FORMULA_0018 0 0 -100.0000 1000.0000 ECU_ADDRESS 0x3FBE9A /begin FUNCTION_LIST Momentenmanager /end FUNCTION_LIST /end MEASUREMENT
/begin MEASUREMENT md_ind_wunsch_tz "ind. Wunschmoment fuer den Zuendwinkelpfad" SWORD FORMULA_0018 0 0 -100.0000 1000.0000 ECU_ADDRESS 0x3FBE9C /begin FUNCTION_LIST Momentenmanager /end FUNCTION_LIST /end MEASUREMENT
/begin MEASUREMENT md_rf_soll "Soll-rf" SWORD FORMULA_0006 0 0 0.0 2.0000 ECU_ADDRESS 0x3FBE9E /begin FUNCTION_LIST Momentenmanager /end FUNCTION_LIST /end MEASUREMENT
/begin MEASUREMENT md_rf_soll_pt "Soll-rf mit pt-Korr" SWORD FORMULA_0006 0 0 0.0 2.0000 ECU_ADDRESS 0x3FBEA0 /begin FUNCTION_LIST Momentenmanager /end FUNCTION_LIST /end MEASUREMENT
/begin MEASUREMENT md_rf_soll_pt_fr_b1 "Soll-rf mit pt-/fr-Korr" SWORD FORMULA_0006 0 0 0.0 2.0000 ECU_ADDRESS 0x3FBEA2 /begin FUNCTION_LIST Momentenmanager /end FUNCTION_LIST /end MEASUREMENT
/begin MEASUREMENT md_rf_soll_pt_fr_b2 "Soll-rf mit pt-/fr-Korr" SWORD FORMULA_0006 0 0 0.0 2.0000 ECU_ADDRESS 0x3FBEA4 /begin FUNCTION_LIST Momentenmanager /end FUNCTION_LIST /end MEASUREMENT
/begin MEASUREMENT md_tz_eingr_aktiv "TZ-Eingriff" UBYTE FORMULA_0192 0 0 0.0 255.0 ECU_ADDRESS 0x3FBEA6 /begin FUNCTION_LIST Momentenmanager /end FUNCTION_LIST BIT_MASK 0x1 /end MEASUREMENT
/begin MEASUREMENT md_tz_eingr_bezug "TZ-Bezugsmoment" UBYTE FORMULA_0193 0 0 0.0 255.0 ECU_ADDRESS 0x3FBEA7 /begin FUNCTION_LIST Momentenmanager /end FUNCTION_LIST /end MEASUREMENT
/begin MEASUREMENT md_tz_st "TZ-Status" UWORD FORMULA_0000 0 0 0.0 65535.0000 ECU_ADDRESS 0x3FBEA8 /begin FUNCTION_LIST Momentenmanager /end FUNCTION_LIST /end MEASUREMENT
/begin MEASUREMENT md_tz_soll_zyl1 "Soll-TZ" SWORD FORMULA_0037 0 0 -50.0000 60.0000 ECU_ADDRESS 0x3FBEAA /begin FUNCTION_LIST Momentenmanager /end FUNCTION_LIST /end MEASUREMENT
/begin MEASUREMENT md_tz_soll_zyl2 "Soll-TZ" SWORD FORMULA_0037 0 0 -50.0000 60.0000 ECU_ADDRESS 0x3FBEAC /begin FUNCTION_LIST Momentenmanager /end FUNCTION_LIST /end MEASUREMENT
/begin MEASUREMENT md_tz_soll_zyl3 "Soll-TZ" SWORD FORMULA_0037 0 0 -50.0000 60.0000 ECU_ADDRESS 0x3FBEAE /begin FUNCTION_LIST Momentenmanager /end FUNCTION_LIST /end MEASUREMENT
/begin MEASUREMENT md_tz_soll_zyl4 "Soll-TZ" SWORD FORMULA_0037 0 0 -50.0000 60.0000 ECU_ADDRESS 0x3FBEB0 /begin FUNCTION_LIST Momentenmanager /end FUNCTION_LIST /end MEASUREMENT
/begin MEASUREMENT md_tz_soll_zyl5 "Soll-TZ" SWORD FORMULA_0037 0 0 -50.0000 60.0000 ECU_ADDRESS 0x3FBEB2 /begin FUNCTION_LIST Momentenmanager /end FUNCTION_LIST /end MEASUREMENT
/begin MEASUREMENT md_tz_soll_zyl6 "Soll-TZ" SWORD FORMULA_0037 0 0 -50.0000 60.0000 ECU_ADDRESS 0x3FBEB4 /begin FUNCTION_LIST Momentenmanager /end FUNCTION_LIST /end MEASUREMENT
/begin MEASUREMENT md_tz_soll_zyl7 "Soll-TZ" SWORD FORMULA_0037 0 0 -50.0000 60.0000 ECU_ADDRESS 0x3FBEB6 /begin FUNCTION_LIST Momentenmanager /end FUNCTION_LIST /end MEASUREMENT
/begin MEASUREMENT md_tz_soll_zyl8 "Soll-TZ" SWORD FORMULA_0037 0 0 -50.0000 60.0000 ECU_ADDRESS 0x3FBEB8 /begin FUNCTION_LIST Momentenmanager /end FUNCTION_LIST /end MEASUREMENT
/begin MEASUREMENT md_tz_soll_zyl9 "Soll-TZ" SWORD FORMULA_0037 0 0 -50.0000 60.0000 ECU_ADDRESS 0x3FBEBA /begin FUNCTION_LIST Momentenmanager /end FUNCTION_LIST /end MEASUREMENT
/begin MEASUREMENT md_tz_soll_zyl10 "Soll-TZ" SWORD FORMULA_0037 0 0 -50.0000 60.0000 ECU_ADDRESS 0x3FBEBC /begin FUNCTION_LIST Momentenmanager /end FUNCTION_LIST /end MEASUREMENT
/begin MEASUREMENT md_tz_soll_zyl11 "Soll-TZ" SWORD FORMULA_0037 0 0 -50.0000 60.0000 ECU_ADDRESS 0x3FBEBE /begin FUNCTION_LIST Momentenmanager /end FUNCTION_LIST /end MEASUREMENT
/begin MEASUREMENT md_tz_soll_zyl12 "Soll-TZ" SWORD FORMULA_0037 0 0 -50.0000 60.0000 ECU_ADDRESS 0x3FBEC0 /begin FUNCTION_LIST Momentenmanager /end FUNCTION_LIST /end MEASUREMENT
/* ------------------ Abschnitt erzeugt aus ml_soll.dat ------------------ */
/begin CHARACTERISTIC K_ML_SOLL_DK_MAX "max. Füllung für DK-Steller" VALUE 0x62228 TKW_VV_VV_SW 100.0 FORMULA_0010 -100.0000 1400.0000 /begin FUNCTION_LIST Luftmasse /end FUNCTION_LIST FORMAT "%4.1" /end CHARACTERISTIC
/begin CHARACTERISTIC KL_ML_SOLL_LLS_MAX "-" CURVE 0x6222A TKL_SW_VV_SW 100.0 FORMULA_0010 -100.0000 1400.0000 /begin FUNCTION_LIST Luftmasse /end FUNCTION_LIST /begin AXIS_DESCR STD_AXIS n FORMULA_0011 6 0.0 10000.0000 /end AXIS_DESCR FORMAT "%4.1" /end CHARACTERISTIC
/begin MEASUREMENT ml_soll_b1 "ml-soll fuer LLS" SWORD FORMULA_0010 0 0 -100.0000 1400.0000 ECU_ADDRESS 0x3FBEC2 /begin FUNCTION_LIST Luftmasse /end FUNCTION_LIST /end MEASUREMENT
/begin MEASUREMENT ml_soll_b2 "ml-soll fuer LLS" SWORD FORMULA_0010 0 0 -100.0000 1400.0000 ECU_ADDRESS 0x3FBEC4 /begin FUNCTION_LIST Luftmasse /end FUNCTION_LIST /end MEASUREMENT
/begin MEASUREMENT ml_soll_lls_b1 "ml-soll fuer LLS" SWORD FORMULA_0010 0 0 -100.0000 1400.0000 ECU_ADDRESS 0x3FBEC6 /begin FUNCTION_LIST Luftmasse /end FUNCTION_LIST /end MEASUREMENT
/begin MEASUREMENT ml_soll_lls_b2 "ml-soll fuer LLS" SWORD FORMULA_0010 0 0 -100.0000 1400.0000 ECU_ADDRESS 0x3FBEC8 /begin FUNCTION_LIST Luftmasse /end FUNCTION_LIST /end MEASUREMENT
/begin MEASUREMENT ml_soll_lls_max "max. ml-soll fuer LLS" SWORD FORMULA_0010 0 0 -100.0000 1400.0000 ECU_ADDRESS 0x3FBECA /begin FUNCTION_LIST Luftmasse /end FUNCTION_LIST /end MEASUREMENT
/begin MEASUREMENT ml_soll_dk_b1 "ml-soll fuer dk" SWORD FORMULA_0010 0 0 -100.0000 1400.0000 ECU_ADDRESS 0x3FBECC /begin FUNCTION_LIST Luftmasse /end FUNCTION_LIST /end MEASUREMENT
/begin MEASUREMENT ml_soll_dk_b2 "ml-soll fuer dk" SWORD FORMULA_0010 0 0 -100.0000 1400.0000 ECU_ADDRESS 0x3FBECE /begin FUNCTION_LIST Luftmasse /end FUNCTION_LIST /end MEASUREMENT
/begin MEASUREMENT ml_soll_dk_max "max. ml-soll fuer dk" SWORD FORMULA_0010 0 0 -100.0000 1400.0000 ECU_ADDRESS 0x3FBED0 /begin FUNCTION_LIST Luftmasse /end FUNCTION_LIST /end MEASUREMENT
/begin MEASUREMENT rf_soll_lls_b1 "max. ml-soll fuer dk" SWORD FORMULA_0006 0 0 0.0 2.0000 ECU_ADDRESS 0x3FBED2 /begin FUNCTION_LIST Luftmasse /end FUNCTION_LIST /end MEASUREMENT
/begin MEASUREMENT rf_soll_lls_b2 "max. ml-soll fuer dk" SWORD FORMULA_0006 0 0 0.0 2.0000 ECU_ADDRESS 0x3FBED4 /begin FUNCTION_LIST Luftmasse /end FUNCTION_LIST /end MEASUREMENT
/begin MEASUREMENT rf_soll_dk_b1 "max. ml-soll fuer dk" SWORD FORMULA_0006 0 0 0.0 2.0000 ECU_ADDRESS 0x3FBED6 /begin FUNCTION_LIST Luftmasse /end FUNCTION_LIST /end MEASUREMENT
/begin MEASUREMENT rf_soll_dk_b2 "max. ml-soll fuer dk" SWORD FORMULA_0006 0 0 0.0 2.0000 ECU_ADDRESS 0x3FBED8 /begin FUNCTION_LIST Luftmasse /end FUNCTION_LIST /end MEASUREMENT
/* ------------------ Abschnitt erzeugt aus pwg.dat ------------------ */
/begin CHARACTERISTIC K_PWG1_DIAG_MIN "Unter Diagnoseschwelle-Pedalwertgeber 1" VALUE 0x62248 TKW_VV_VV_SW 100.0 FORMULA_0088 0.0 5.0000 /begin FUNCTION_LIST Pedalwertgeber /end FUNCTION_LIST FORMAT "%6.3" /end CHARACTERISTIC
/begin CHARACTERISTIC K_PWG1_DIAG_MAX "Obere Diagnoseschwelle-Pedalwertgeber 1" VALUE 0x6224A TKW_VV_VV_SW 100.0 FORMULA_0088 0.0 5.0000 /begin FUNCTION_LIST Pedalwertgeber /end FUNCTION_LIST FORMAT "%6.3" /end CHARACTERISTIC
/begin CHARACTERISTIC K_PWG1_NORM "Normierung Potentiometerspannung - %-Pedalwert 1" VALUE 0x6224C TKW_VV_VV_SW 100.0 FORMULA_0209 0.0 100.0000 /begin FUNCTION_LIST Pedalwertgeber /end FUNCTION_LIST FORMAT "%6.3" /end CHARACTERISTIC
/begin CHARACTERISTIC K_PWG_TAU "Filterkonstante fuer den absoluten Spannungswert" VALUE 0x6224E TKW_VV_VV_UB 100.0 FORMULA_0183 0.0101 2.5600 /begin FUNCTION_LIST Pedalwertgeber /end FUNCTION_LIST /end CHARACTERISTIC
/begin CHARACTERISTIC K_PWG_TAU_FEHLER "Filterkonstante fuer den absoluten Spannungswert im Fehlerfall" VALUE 0x6224F TKW_VV_VV_UB 100.0 FORMULA_0183 0.0101 2.5600 /begin FUNCTION_LIST Pedalwertgeber /end FUNCTION_LIST /end CHARACTERISTIC
/begin CHARACTERISTIC K_PWG1_A0_MIN "Unter Adaptionschwelle Pedalwertgeber 1" VALUE 0x62250 TKW_VV_VV_SW 100.0 FORMULA_0088 0.0 5.0000 /begin FUNCTION_LIST Pedalwertgeber /end FUNCTION_LIST FORMAT "%6.3" /end CHARACTERISTIC
/begin CHARACTERISTIC K_PWG1_A0_MAX "Obere Adaptionschwelle Pedalwertgeber 1" VALUE 0x62252 TKW_VV_VV_SW 100.0 FORMULA_0088 0.0 5.0000 /begin FUNCTION_LIST Pedalwertgeber /end FUNCTION_LIST FORMAT "%6.3" /end CHARACTERISTIC
/begin CHARACTERISTIC K_PWG_A0_TAU "Filterkonstante fuer die LL-Winkel Abwaertsadaption 1" VALUE 0x62254 TKW_VV_VV_UB 100.0 FORMULA_0210 0.1004 25.6000 /begin FUNCTION_LIST Pedalwertgeber /end FUNCTION_LIST /end CHARACTERISTIC
/begin CHARACTERISTIC K_PWG1_INC_A0_ADAPT "Freischalten der Aufwaertsadaption" VALUE 0x62256 TKW_VV_VV_SW 100.0 FORMULA_0088 0.0 5.0000 /begin FUNCTION_LIST Pedalwertgeber /end FUNCTION_LIST FORMAT "%6.3" /end CHARACTERISTIC
/begin CHARACTERISTIC K_PWG_A0_ZAEHLER "Zaehler fuer die Aufwaertsadaption" VALUE 0x62258 TKW_VV_VV_UB 100.0 FORMULA_0008 1.0000 255.0000 /begin FUNCTION_LIST Pedalwertgeber /end FUNCTION_LIST /end CHARACTERISTIC
/begin CHARACTERISTIC K_PWG1_A0_INITINC "Aufwertsadaption der LL-Potentiometerspannung beim Start" VALUE 0x6225A TKW_VV_VV_SW 100.0 FORMULA_0088 0.0 5.0000 /begin FUNCTION_LIST Pedalwertgeber /end FUNCTION_LIST FORMAT "%6.3" /end CHARACTERISTIC
/begin CHARACTERISTIC K_PWG_AB_RAMPE "Dauer der Abregelrampe bei Leistungsbegrenzung" VALUE 0x6225C TKW_VV_VV_UW 100.0 FORMULA_0211 0.0100 655.3500 /begin FUNCTION_LIST Pedalwertgeber /end FUNCTION_LIST FORMAT "%5.2" /end CHARACTERISTIC
/begin CHARACTERISTIC K_PWG_SK_NULLAGE "Diagnose Schwelle" VALUE 0x6225E TKW_VV_VV_SW 100.0 FORMULA_0022 -10.0000 120.0000 /begin FUNCTION_LIST Pedalwertgeber /end FUNCTION_LIST FORMAT "%4.1" /end CHARACTERISTIC
/begin CHARACTERISTIC K_PWG_KD "Pedalwert fuer Kick Down" VALUE 0x62260 TKW_VV_VV_SW 100.0 FORMULA_0022 -10.0000 150.0000 /begin FUNCTION_LIST Pedalwertgeber /end FUNCTION_LIST FORMAT "%4.1" /end CHARACTERISTIC
/begin CHARACTERISTIC KL_PWG_MAX_DIFF "MAX PWG-Abweichung" CURVE 0x62262 TKL_SW_VV_SW 100.0 FORMULA_0022 0.0 120.0000 /begin FUNCTION_LIST Pedalwertgeber /end FUNCTION_LIST /begin AXIS_DESCR STD_AXIS pwg1_2 FORMULA_0022 3 0.0 120.0000 FORMAT "%4.1" /end AXIS_DESCR FORMAT "%4.1" /end CHARACTERISTIC
/begin CHARACTERISTIC KL_PWG_SOLL_NOTLAUF "Pedalwert im Fehlerfall" CURVE 0x62270 TKL_SW_VV_SW 100.0 FORMULA_0022 0.0 100.0000 /begin FUNCTION_LIST Pedalwertgeber /end FUNCTION_LIST /begin AXIS_DESCR STD_AXIS pwg FORMULA_0022 10 0.0 120.0000 FORMAT "%4.1" /end AXIS_DESCR FORMAT "%4.1" /end CHARACTERISTIC
/begin CHARACTERISTIC KL_PWG_SOLL_KOMFORT "Pedalwert fuer Fahrdynamik-Komfort" CURVE 0x6229A TKL_SW_VV_SW 100.0 FORMULA_0022 0.0 100.0000 /begin FUNCTION_LIST Pedalwertgeber /end FUNCTION_LIST /begin AXIS_DESCR STD_AXIS pwg FORMULA_0022 10 0.0 120.0000 FORMAT "%4.1" /end AXIS_DESCR FORMAT "%4.1" /end CHARACTERISTIC
/begin CHARACTERISTIC KL_PWG_SOLL_SPORT "Pedalwert fuer Fahrdynamik-Sport" CURVE 0x622C4 TKL_SW_VV_SW 100.0 FORMULA_0022 0.0 100.0000 /begin FUNCTION_LIST Pedalwertgeber /end FUNCTION_LIST /begin AXIS_DESCR STD_AXIS pwg FORMULA_0022 10 0.0 120.0000 FORMAT "%4.1" /end AXIS_DESCR FORMAT "%4.1" /end CHARACTERISTIC
/begin MEASUREMENT pwg1_ed "Eigendiagnose Pedalwertgeber 1" UWORD FORMULA_0017 0 0 0.0 111.0 ECU_ADDRESS 0x3FBF1E /begin FUNCTION_LIST Pedalwertgeber /end FUNCTION_LIST BIT_MASK 0x6F /end MEASUREMENT
/begin MEASUREMENT pwg2_ed "Eigendiagnose Pedalwertgeber 2" UWORD FORMULA_0017 0 0 0.0 111.0 ECU_ADDRESS 0x3FBF20 /begin FUNCTION_LIST Pedalwertgeber /end FUNCTION_LIST BIT_MASK 0x6F /end MEASUREMENT
/begin MEASUREMENT pwg_vgl_ed "Kanalvergleichsfehler der Pedalwertgeber" UWORD FORMULA_0017 0 0 0.0 111.0 ECU_ADDRESS 0x3FBF22 /begin FUNCTION_LIST Pedalwertgeber /end FUNCTION_LIST BIT_MASK 0x6F /end MEASUREMENT
/begin MEASUREMENT pwg_st_ed "Fehler-Status der PWG-Erfassung" UBYTE FORMULA_0008 0 0 0.0 255.0000 ECU_ADDRESS 0x3FBF24 /begin FUNCTION_LIST Pedalwertgeber /end FUNCTION_LIST BIT_MASK 0x3F /end MEASUREMENT
/begin MEASUREMENT pwg_st_ed_kanal_filter "Fehler-Status der PWG-Erfassung" UBYTE FORMULA_0197 0 0 0.0 255.0 ECU_ADDRESS 0x3FBF24 /begin FUNCTION_LIST Pedalwertgeber /end FUNCTION_LIST BIT_MASK 0x1 /end MEASUREMENT
/begin MEASUREMENT pwg_st_ed_kanal_fehler "Fehler-Status der PWG-Erfassung" UBYTE FORMULA_0198 0 0 0.0 255.0 ECU_ADDRESS 0x3FBF24 /begin FUNCTION_LIST Pedalwertgeber /end FUNCTION_LIST BIT_MASK 0x2 /end MEASUREMENT
/begin MEASUREMENT pwg_st_ed_pwg2_fehler "Fehler-Status der PWG-Erfassung" UBYTE FORMULA_0199 0 0 0.0 255.0 ECU_ADDRESS 0x3FBF24 /begin FUNCTION_LIST Pedalwertgeber /end FUNCTION_LIST BIT_MASK 0x4 /end MEASUREMENT
/begin MEASUREMENT pwg_st_ed_pwg1_fehler "Fehler-Status der PWG-Erfassung" UBYTE FORMULA_0200 0 0 0.0 255.0 ECU_ADDRESS 0x3FBF24 /begin FUNCTION_LIST Pedalwertgeber /end FUNCTION_LIST BIT_MASK 0x8 /end MEASUREMENT
/begin MEASUREMENT pwg_st_ed_uext2_fehler "Fehler-Status der PWG-Erfassung" UBYTE FORMULA_0201 0 0 0.0 255.0 ECU_ADDRESS 0x3FBF24 /begin FUNCTION_LIST Pedalwertgeber /end FUNCTION_LIST BIT_MASK 0x10 /end MEASUREMENT
/begin MEASUREMENT pwg_st_ed_uext1_fehler "Fehler-Status der PWG-Erfassung" UBYTE FORMULA_0202 0 0 0.0 255.0 ECU_ADDRESS 0x3FBF24 /begin FUNCTION_LIST Pedalwertgeber /end FUNCTION_LIST BIT_MASK 0x20 /end MEASUREMENT
/begin MEASUREMENT pwg_abschalt "Im Fehlerfall Abschaltung durch die Bremse" UBYTE FORMULA_0008 0 0 0.0 255.0000 ECU_ADDRESS 0x3FBF25 /begin FUNCTION_LIST Pedalwertgeber /end FUNCTION_LIST BIT_MASK 0x3 /end MEASUREMENT
/begin MEASUREMENT pwg_abschalt_bremse "Status der Sicherheitsabschaltung" UBYTE FORMULA_0203 0 0 0.0 255.0 ECU_ADDRESS 0x3FBF25 /begin FUNCTION_LIST Pedalwertgeber /end FUNCTION_LIST BIT_MASK 0x1 /end MEASUREMENT
/begin MEASUREMENT pwg_abschalt_sperre "Status der Sicherheitsabschaltung" UBYTE FORMULA_0204 0 0 0.0 255.0 ECU_ADDRESS 0x3FBF25 /begin FUNCTION_LIST Pedalwertgeber /end FUNCTION_LIST BIT_MASK 0x2 /end MEASUREMENT
/begin MEASUREMENT pwg_ab_rampe "Abregelrampe im Fehlerfall" UWORD FORMULA_0205 0 0 0.0 0.9999 ECU_ADDRESS 0x3FBF26 /begin FUNCTION_LIST Pedalwertgeber /end FUNCTION_LIST /end MEASUREMENT
/begin MEASUREMENT pwg_max_diff "Maximal zulaessige Differenz der Pedalwertgeber" SWORD FORMULA_0022 0 0 0.0 120.0000 ECU_ADDRESS 0x3FBF28 /begin FUNCTION_LIST Pedalwertgeber /end FUNCTION_LIST /end MEASUREMENT
/begin MEASUREMENT pwg1_ad "Eingelesener AD-Wert fuer Pedalwertgeber 1" SWORD FORMULA_0206 0 0 0.0 1023.0000 ECU_ADDRESS 0x3FBF2A /begin FUNCTION_LIST Pedalwertgeber /end FUNCTION_LIST /end MEASUREMENT
/begin MEASUREMENT pwg2_ad "Eingelesener AD-Wert fuer Pedalwertgeber 2" SWORD FORMULA_0206 0 0 0.0 1023.0000 ECU_ADDRESS 0x3FBF2C /begin FUNCTION_LIST Pedalwertgeber /end FUNCTION_LIST /end MEASUREMENT
/begin MEASUREMENT pwg1_abs_roh "Ungefilterter mit UEXT-korrigierter Messwert PWG1" SWORD FORMULA_0088 0 0 0.0 5.0000 ECU_ADDRESS 0x3FBF2E /begin FUNCTION_LIST Pedalwertgeber /end FUNCTION_LIST /end MEASUREMENT
/begin MEASUREMENT pwg2_abs_roh "Ungefilterter mit UEXT-korrigierter Messwert PWG2" SWORD FORMULA_0089 0 0 0.0 5.0000 ECU_ADDRESS 0x3FBF30 /begin FUNCTION_LIST Pedalwertgeber /end FUNCTION_LIST /end MEASUREMENT
/begin MEASUREMENT pwg1_roh "Relativer Rohwert PWG1" SWORD FORMULA_0022 0 0 -10.0000 120.0000 ECU_ADDRESS 0x3FBF32 /begin FUNCTION_LIST Pedalwertgeber /end FUNCTION_LIST /end MEASUREMENT
/begin MEASUREMENT pwg2_roh "Relativer Rohwert PWG2" SWORD FORMULA_0022 0 0 -10.0000 120.0000 ECU_ADDRESS 0x3FBF34 /begin FUNCTION_LIST Pedalwertgeber /end FUNCTION_LIST /end MEASUREMENT
/begin MEASUREMENT pwg_filter "Gefilterter Messwert der Pedalwerterfassung" UWORD FORMULA_0207 0 0 0.0 102.3984 ECU_ADDRESS 0x3FBF36 /begin FUNCTION_LIST Pedalwertgeber /end FUNCTION_LIST /end MEASUREMENT
/begin MEASUREMENT pwg "Erfasster gefilterter relativer Pedalwert" SWORD FORMULA_0022 0 0 -10.0000 120.0000 ECU_ADDRESS 0x3FBF38 /begin FUNCTION_LIST Pedalwertgeber /end FUNCTION_LIST /end MEASUREMENT
/begin MEASUREMENT pwg_soll "Ausgegebener Pedalwert fuer andere Module" SWORD FORMULA_0022 0 0 -10.0000 120.0000 ECU_ADDRESS 0x3FBF3A /begin FUNCTION_LIST Pedalwertgeber /end FUNCTION_LIST /end MEASUREMENT
/begin MEASUREMENT pwg_gradient "Pedalwert Gradient" SWORD FORMULA_0208 0 0 -2000.0000 2000.0000 ECU_ADDRESS 0x3FBF3C /begin FUNCTION_LIST Pedalwertgeber /end FUNCTION_LIST /end MEASUREMENT
/begin MEASUREMENT pwg1_a0_zaehler "Zaehlervariable fuer die Aufwaertsadaption 1" UBYTE FORMULA_0008 0 0 0.0 255.0000 ECU_ADDRESS 0x3FBF3E /begin FUNCTION_LIST Pedalwertgeber /end FUNCTION_LIST /end MEASUREMENT
/begin MEASUREMENT pwg2_a0_zaehler "Zaehlervariable fuer die Aufwaertsadaption 2" UBYTE FORMULA_0008 0 0 0.0 255.0000 ECU_ADDRESS 0x3FBF3F /begin FUNCTION_LIST Pedalwertgeber /end FUNCTION_LIST /end MEASUREMENT
/* ------------------ Abschnitt erzeugt aus schalter_ign.dat ------------------ */
/begin MEASUREMENT schalter_st_ign_old_1of2_ "schalter_st_ign_old" UWORD FORMULA_0024 0 0 0.0 65535.0000 ECU_ADDRESS 0x3FBF40 /begin FUNCTION_LIST Schalter /end FUNCTION_LIST /end MEASUREMENT
/begin MEASUREMENT schalter_st_ign_old_2of2_ "schalter_st_ign_old" UWORD FORMULA_0024 0 0 0.0 65535.0000 ECU_ADDRESS 0x3FBF42 /begin FUNCTION_LIST Schalter /end FUNCTION_LIST /end MEASUREMENT
/begin MEASUREMENT schalter_kl15_ad_ign "Eingelesener Spannungswert Klemme 15" SWORD FORMULA_0206 0 0 0.0 1023.0000 ECU_ADDRESS 0x3FBF44 /begin FUNCTION_LIST Schalter /end FUNCTION_LIST /end MEASUREMENT
/begin MEASUREMENT schalter_kl87_ad "Eingelesener Spannungswert Klemme 87" SWORD FORMULA_0206 0 0 0.0 1023.0000 ECU_ADDRESS 0x3FBF46 /begin FUNCTION_LIST Schalter /end FUNCTION_LIST /end MEASUREMENT
/begin MEASUREMENT schalter_kl50_ad "Eingelesener Spannungswert Klemme 50" SWORD FORMULA_0206 0 0 0.0 1023.0000 ECU_ADDRESS 0x3FBF48 /begin FUNCTION_LIST Schalter /end FUNCTION_LIST /end MEASUREMENT
/* ------------------ Abschnitt erzeugt aus start_rl.dat ------------------ */
/begin CHARACTERISTIC K_START_RL_BEGINN "Maximale Motordrehzahl beim Anlassbeginn" VALUE 0x622EE TKW_VV_VV_SW 100.0 FORMULA_0011 0.0 10000.0000 /begin FUNCTION_LIST Startrelais /end FUNCTION_LIST /end CHARACTERISTIC
/begin CHARACTERISTIC KL_START_RL_ENDE "Kennlinie Startendedrehzahl erreicht" CURVE 0x622F0 TKL_SW_VV_SW 100.0 FORMULA_0011 0.0 10000.0000 /begin FUNCTION_LIST Startrelais /end FUNCTION_LIST
 /begin AXIS_DESCR STD_AXIS tmot FORMULA_0019 6 -50.0000 150.0000 FORMAT "%4.1" /end AXIS_DESCR
/end CHARACTERISTIC
/begin MEASUREMENT start_rl_st "Status Startrelais" UBYTE FORMULA_0212 0 0 0.0 255.0 ECU_ADDRESS 0x3FBF50 /begin FUNCTION_LIST Startrelais /end FUNCTION_LIST BIT_MASK 0x40 /end MEASUREMENT
/* ------------------ Abschnitt erzeugt aus tdme.dat ------------------ */
/begin CHARACTERISTIC K_TDME_DIAG_MIN "Unter Grenze Steuergeraetetemperatur" VALUE 0x624E2 TKW_VV_VV_SW 100.0 FORMULA_0223 -50.0000 150.0000 /begin FUNCTION_LIST Steuergeraetetemperatur /end FUNCTION_LIST FORMAT "%6.3" /end CHARACTERISTIC
/begin CHARACTERISTIC K_TDME_DIAG_MAX "Obere Grenze Steuergeraetetemperatur" VALUE 0x624E4 TKW_VV_VV_SW 100.0 FORMULA_0223 -50.0000 150.0000 /begin FUNCTION_LIST Steuergeraetetemperatur /end FUNCTION_LIST FORMAT "%6.3" /end CHARACTERISTIC
/begin CHARACTERISTIC K_TDME_SCHWELLE_ZAEHLER "Schwelle fuer Langzeitueberwachung" VALUE 0x624E6 TKW_VV_VV_SW 100.0 FORMULA_0019 -50.0000 150.0000 /begin FUNCTION_LIST Steuergeraetetemperatur /end FUNCTION_LIST FORMAT "%4.1" /end CHARACTERISTIC
/begin CHARACTERISTIC K_TDME_TAU "Filterkonstante fuer die Steuergeraetetemperatur" VALUE 0x624E8 TKW_VV_VV_UB 100.0 FORMULA_0210 0.1004 25.6000 /begin FUNCTION_LIST Steuergeraetetemperatur /end FUNCTION_LIST /end CHARACTERISTIC
/begin CHARACTERISTIC KL_TDME_NTC "Kennlinie Steuergeraetetemperatur" CURVE 0x624EA TKL_SW_VV_SW 100.0 FORMULA_0223 -50.0000 150.0000 /begin FUNCTION_LIST Steuergeraetetemperatur /end FUNCTION_LIST /begin AXIS_DESCR STD_AXIS tdme_ad FORMULA_0206 8 0.0 1023.0000 /end AXIS_DESCR FORMAT "%6.3" /end CHARACTERISTIC
/begin MEASUREMENT tdme_ad "Eingelesener Spannungswert fuer Steuergeraetetemperatur" SWORD FORMULA_0206 0 0 0.0 1023.0000 ECU_ADDRESS 0x3FBFB8 /begin FUNCTION_LIST Steuergeraetetemperatur /end FUNCTION_LIST /end MEASUREMENT
/begin MEASUREMENT tdme_roh "Ungefilterter Messwert der Steuergeraetetemperatur" SWORD FORMULA_0223 0 0 -50.0000 150.0000 ECU_ADDRESS 0x3FBFBA /begin FUNCTION_LIST Steuergeraetetemperatur /end FUNCTION_LIST /end MEASUREMENT
/begin MEASUREMENT tdme_filter "Gefilterter Messwert der Steuergeraetetemperatur" SWORD FORMULA_0223 0 0 -50.0000 150.0000 ECU_ADDRESS 0x3FBFBC /begin FUNCTION_LIST Steuergeraetetemperatur /end FUNCTION_LIST /end MEASUREMENT
/* ------------------ Abschnitt erzeugt aus tka.dat ------------------ */
/begin CHARACTERISTIC K_TKA_DIAG_MIN "Unter Grenze Kuehlwasseraustrittstemperatur" VALUE 0x6250C TKW_VV_VV_SW 100.0 FORMULA_0223 -50.0000 150.0000 /begin FUNCTION_LIST Kuehleraustrittstemperatur /end FUNCTION_LIST FORMAT "%6.3" /end CHARACTERISTIC
/begin CHARACTERISTIC K_TKA_DIAG_MAX "Obere Grenze Kuehlwasseraustrittstemperatur" VALUE 0x6250E TKW_VV_VV_SW 100.0 FORMULA_0223 -50.0000 150.0000 /begin FUNCTION_LIST Kuehleraustrittstemperatur /end FUNCTION_LIST FORMAT "%6.3" /end CHARACTERISTIC
/begin CHARACTERISTIC K_TKA_TAU "Filterkonstante fuer die Kuehlwasseraustrittstemperatur" VALUE 0x62510 TKW_VV_VV_UB 100.0 FORMULA_0210 0.1004 25.6000 /begin FUNCTION_LIST Kuehleraustrittstemperatur /end FUNCTION_LIST /end CHARACTERISTIC
/begin CHARACTERISTIC KL_TKA_NTC "Kennlinie Kuehleraustrittstemperatur" CURVE 0x62512 TKL_SW_VV_SW 100.0 FORMULA_0223 -50.0000 150.0000 /begin FUNCTION_LIST Kuehleraustrittstemperatur /end FUNCTION_LIST /begin AXIS_DESCR STD_AXIS tka_ad FORMULA_0206 8 0.0 1023.0000 /end AXIS_DESCR FORMAT "%6.3" /end CHARACTERISTIC
/begin MEASUREMENT tka_ad "Eingelesener Spannungswert fuer Kuehlwasseraustrittstemperatur" SWORD FORMULA_0206 0 0 0.0 1023.0000 ECU_ADDRESS 0x3FBFBE /begin FUNCTION_LIST Kuehleraustrittstemperatur /end FUNCTION_LIST /end MEASUREMENT
/begin MEASUREMENT tka_roh "Ungefilterter Messwert der Kuehlwasseraustrittstemperatur" SWORD FORMULA_0223 0 0 -50.0000 150.0000 ECU_ADDRESS 0x3FBFC0 /begin FUNCTION_LIST Kuehleraustrittstemperatur /end FUNCTION_LIST /end MEASUREMENT
/begin MEASUREMENT tka_filter "Gefilterter Messwert der Kuehlwasseraustrittstemperatur" SWORD FORMULA_0223 0 0 -50.0000 150.0000 ECU_ADDRESS 0x3FBFC2 /begin FUNCTION_LIST Kuehleraustrittstemperatur /end FUNCTION_LIST /end MEASUREMENT
/* ------------------ Abschnitt erzeugt aus tmot.dat ------------------ */
/begin CHARACTERISTIC K_TMOT_STA "Schwelle fuer Uebertemperaturanzeige" VALUE 0x62534 TKW_VV_VV_SW 100.0 FORMULA_0019 -50.0000 150.0000 /begin FUNCTION_LIST Motortemperatur /end FUNCTION_LIST FORMAT "%4.1" /end CHARACTERISTIC
/begin CHARACTERISTIC K_TMOT_STA_HYS "Hysteres fuer Uebertemperaturanzeige" VALUE 0x62536 TKW_VV_VV_SW 100.0 FORMULA_0090 -20.0000 0.0 /begin FUNCTION_LIST Motortemperatur /end FUNCTION_LIST FORMAT "%4.1" /end CHARACTERISTIC
/begin CHARACTERISTIC K_TMOT_STA_TIME "Zerzoegerungszeit bei Uebertemperatur" VALUE 0x62538 TKW_VV_VV_UW 100.0 FORMULA_0226 0.0 65.5350 /begin FUNCTION_LIST Motortemperatur /end FUNCTION_LIST /end CHARACTERISTIC
/begin CHARACTERISTIC K_TMOT_DIAG_MIN "Unter Grenze Motortemperatur" VALUE 0x6253A TKW_VV_VV_SW 100.0 FORMULA_0223 -50.0000 150.0000 /begin FUNCTION_LIST Motortemperatur /end FUNCTION_LIST FORMAT "%6.3" /end CHARACTERISTIC
/begin CHARACTERISTIC K_TMOT_DIAG_MAX "Obere Grenze Motortemperatur" VALUE 0x6253C TKW_VV_VV_SW 100.0 FORMULA_0223 -50.0000 150.0000 /begin FUNCTION_LIST Motortemperatur /end FUNCTION_LIST FORMAT "%6.3" /end CHARACTERISTIC
/begin CHARACTERISTIC K_TMOT_DIAG_TAN "TAN-Schwelle zur Plausibilitaetsueberpruefung" VALUE 0x6253E TKW_VV_VV_SW 100.0 FORMULA_0019 -50.0000 150.0000 /begin FUNCTION_LIST Motortemperatur /end FUNCTION_LIST FORMAT "%4.1" /end CHARACTERISTIC
/begin CHARACTERISTIC K_TMOT_DIAG_TKA "TKA-Schwelle zur Plausibilitaetsueberpruefung" VALUE 0x62540 TKW_VV_VV_SW 100.0 FORMULA_0019 -50.0000 150.0000 /begin FUNCTION_LIST Motortemperatur /end FUNCTION_LIST FORMAT "%4.1" /end CHARACTERISTIC
/begin CHARACTERISTIC K_TMOT_DIAG_WL "Schwelle die im WL erreicht werden muss" VALUE 0x62542 TKW_VV_VV_SW 100.0 FORMULA_0019 -50.0000 150.0000 /begin FUNCTION_LIST Motortemperatur /end FUNCTION_LIST FORMAT "%4.1" /end CHARACTERISTIC
/begin CHARACTERISTIC K_TMOT_THERMO_DELTA "Max. Delta zwischen tmot und tka bei offenem Thermostat" VALUE 0x62544 TKW_VV_VV_SW 100.0 FORMULA_0090 0.0 1000.0000 /begin FUNCTION_LIST Motortemperatur /end FUNCTION_LIST FORMAT "%4.1" /end CHARACTERISTIC
/begin CHARACTERISTIC K_TMOT_STEP1_DELTA "Minimales Delta von tmot fuer einen Thermostatfehler" VALUE 0x62546 TKW_VV_VV_SW 100.0 FORMULA_0090 0.0 1000.0000 /begin FUNCTION_LIST Motortemperatur /end FUNCTION_LIST FORMAT "%4.1" /end CHARACTERISTIC
/begin CHARACTERISTIC K_TMOT_TKA_STEP1_DELTA "Minimales Delta fuer einen Thermostatfehler" VALUE 0x62548 TKW_VV_VV_SW 100.0 FORMULA_0090 0.0 1000.0000 /begin FUNCTION_LIST Motortemperatur /end FUNCTION_LIST FORMAT "%4.1" /end CHARACTERISTIC
/begin CHARACTERISTIC K_TMOT_TKA_DELTA "Delta zum Kuehleraustritt ergibt Ersatzwert" VALUE 0x6254A TKW_VV_VV_SW 100.0 FORMULA_0090 0.0 1000.0000 /begin FUNCTION_LIST Motortemperatur /end FUNCTION_LIST FORMAT "%4.1" /end CHARACTERISTIC
/begin CHARACTERISTIC K_TMOT_DELTA_TKA "Kuehleraustrittsdelta seit Start" VALUE 0x6254C TKW_VV_VV_SW 100.0 FORMULA_0090 0.0 1000.0000 /begin FUNCTION_LIST Motortemperatur /end FUNCTION_LIST FORMAT "%4.1" /end CHARACTERISTIC
/begin CHARACTERISTIC K_TMOT_BLOCKHEATER "Delta zur Starttemperatur" VALUE 0x6254E TKW_VV_VV_SW 100.0 FORMULA_0227 0.0 100.0000 /begin FUNCTION_LIST Motortemperatur /end FUNCTION_LIST FORMAT "%6.3" /end CHARACTERISTIC
/begin CHARACTERISTIC K_TMOT_ERSATZ "Ersatzwert Motortemperatur" VALUE 0x62550 TKW_VV_VV_SW 100.0 FORMULA_0019 -50.0000 150.0000 /begin FUNCTION_LIST Motortemperatur /end FUNCTION_LIST FORMAT "%4.1" /end CHARACTERISTIC
/begin CHARACTERISTIC K_TMOT_DIAG_TIME "Ansprechzeit der Plausibilitaet gegenueber Masse" VALUE 0x62552 TKW_VV_VV_UW 100.0 FORMULA_0135 0.0 6553.5000 /begin FUNCTION_LIST Motortemperatur /end FUNCTION_LIST FORMAT "%4.1" /end CHARACTERISTIC
/begin CHARACTERISTIC K_TMOT_DIAG_SPERR_ZEIT "Sperrzeit fuer Fehlereintrag der TMOT-Plausi" VALUE 0x62554 TKW_VV_VV_UW 100.0 FORMULA_0135 0.0 6553.5000 /begin FUNCTION_LIST Motortemperatur /end FUNCTION_LIST FORMAT "%4.1" /end CHARACTERISTIC
/begin CHARACTERISTIC K_TMOT_DIAG_SA_ABBRUCH "Abbruch falls zu lange Schubabschalten" VALUE 0x62556 TKW_VV_VV_UW 100.0 FORMULA_0135 0.0 6553.5000 /begin FUNCTION_LIST Motortemperatur /end FUNCTION_LIST FORMAT "%4.1" /end CHARACTERISTIC
/begin CHARACTERISTIC K_TMOT_DIAG_LL_MAX "Zeitdauer in B_LL fuehrt zum Anhalten der Diagnose" VALUE 0x62558 TKW_VV_VV_UW 100.0 FORMULA_0135 0.0 6553.5000 /begin FUNCTION_LIST Motortemperatur /end FUNCTION_LIST FORMAT "%4.1" /end CHARACTERISTIC
/begin CHARACTERISTIC K_TMOT_DIAG_LL_WAIT "Anhaltedauer der Diagnose bei B_LL" VALUE 0x6255A TKW_VV_VV_UW 100.0 FORMULA_0135 0.0 6553.5000 /begin FUNCTION_LIST Motortemperatur /end FUNCTION_LIST FORMAT "%4.1" /end CHARACTERISTIC
/begin CHARACTERISTIC K_TMOT_DIAG_PLAUS_MIN "Mindest. Motortemperatur fuer Plausi-Check" VALUE 0x6255C TKW_VV_VV_SW 100.0 FORMULA_0019 -50.0000 150.0000 /begin FUNCTION_LIST Motortemperatur /end FUNCTION_LIST FORMAT "%4.1" /end CHARACTERISTIC
/begin CHARACTERISTIC K_TMOT_THERMO_MAX "Max. Motortemperatur fuer Thermostatdiagnose" VALUE 0x6255E TKW_VV_VV_SW 100.0 FORMULA_0019 -50.0000 150.0000 /begin FUNCTION_LIST Motortemperatur /end FUNCTION_LIST FORMAT "%4.1" /end CHARACTERISTIC
/begin CHARACTERISTIC K_TMOT_TKA_STEP1_MAX "Maximale Temperatur fuer Step1 von tka beim Start" VALUE 0x62560 TKW_VV_VV_SW 100.0 FORMULA_0019 -50.0000 150.0000 /begin FUNCTION_LIST Motortemperatur /end FUNCTION_LIST FORMAT "%4.1" /end CHARACTERISTIC
/begin CHARACTERISTIC K_TMOT_MODELL_OFFSET "Offset beim Start des OBD-Temperaturmodells" VALUE 0x62562 TKW_VV_VV_SW 100.0 FORMULA_0090 -50.0000 0.0 /begin FUNCTION_LIST Motortemperatur /end FUNCTION_LIST FORMAT "%4.1" /end CHARACTERISTIC
/begin CHARACTERISTIC K_TMOT_TAU "Filterkonstante fuer die Kuehlwassererfassung" VALUE 0x62564 TKW_VV_VV_UB 100.0 FORMULA_0210 0.1004 25.6000 /begin FUNCTION_LIST Motortemperatur /end FUNCTION_LIST /end CHARACTERISTIC
/begin CHARACTERISTIC KL_TMOT_MODELL_ML "Ersatztemperaturmodell" CURVE 0x62566 TKL_SW_VV_UW 100.0 FORMULA_0228 0.0 3.9999 /begin FUNCTION_LIST Motortemperatur /end FUNCTION_LIST
 /begin AXIS_DESCR STD_AXIS ml FORMULA_0010 6 -100.0000 1400.0000 FORMAT "%4.1" /end AXIS_DESCR
 FORMAT "%6.3" /end CHARACTERISTIC
/begin CHARACTERISTIC KL_TMOT_NTC "Kennlinie Motortemperatur" CURVE 0x62580 TKL_SW_VV_SW 100.0 FORMULA_0223 -50.0000 150.0000 /begin FUNCTION_LIST Motortemperatur /end FUNCTION_LIST /begin AXIS_DESCR STD_AXIS tmot_ad FORMULA_0206 10 0.0 1023.0000 /end AXIS_DESCR FORMAT "%6.3" /end CHARACTERISTIC
/begin MEASUREMENT tmot_obd_ed "TMOT-Plausi Diagnose" UWORD FORMULA_0017 0 0 0.0 111.0 ECU_ADDRESS 0x3FBFC4 /begin FUNCTION_LIST Motortemperatur /end FUNCTION_LIST BIT_MASK 0x6F /end MEASUREMENT
/begin MEASUREMENT tmot_ad "Eingelesener Spannungswert fuer Kuehlwassertemperatur" SWORD FORMULA_0206 0 0 0.0 1023.0000 ECU_ADDRESS 0x3FBFC6 /begin FUNCTION_LIST Motortemperatur /end FUNCTION_LIST /end MEASUREMENT
/begin MEASUREMENT tmot_roh "Ungefilterter Messwert der Kuehlwassertemperatur" SWORD FORMULA_0223 0 0 -50.0000 150.0000 ECU_ADDRESS 0x3FBFC8 /begin FUNCTION_LIST Motortemperatur /end FUNCTION_LIST /end MEASUREMENT
/begin MEASUREMENT tmot_filter "Gefilterter Messwert der Kuehlwassertemperatur" SWORD FORMULA_0223 0 0 -50.0000 150.0000 ECU_ADDRESS 0x3FBFCA /begin FUNCTION_LIST Motortemperatur /end FUNCTION_LIST /end MEASUREMENT
/begin MEASUREMENT tmot_modell "OBD-Modelltemperatur" SLONG FORMULA_0225 0 0 -50.0000 150.0000 ECU_ADDRESS 0x3FBFCC /begin FUNCTION_LIST Motortemperatur /end FUNCTION_LIST /end MEASUREMENT
/begin MEASUREMENT tmot_modell_start "OBD-Modelltemperatur" SLONG FORMULA_0225 0 0 -50.0000 150.0000 ECU_ADDRESS 0x3FBFD0 /begin FUNCTION_LIST Motortemperatur /end FUNCTION_LIST /end MEASUREMENT
/begin MEASUREMENT tmot_ersatz "OBD-Modelltemperatur" SLONG FORMULA_0225 0 0 -50.0000 150.0000 ECU_ADDRESS 0x3FBFD4 /begin FUNCTION_LIST Motortemperatur /end FUNCTION_LIST /end MEASUREMENT
/begin MEASUREMENT tmot_tka_start "tka beim Start" SWORD FORMULA_0019 0 0 -50.0000 150.0000 ECU_ADDRESS 0x3FBFD8 /begin FUNCTION_LIST Motortemperatur /end FUNCTION_LIST /end MEASUREMENT
/begin MEASUREMENT tmot_diag_sa_time "Zeitdauer in B_SA fuehrt zum Diagnoseabbruch" UWORD FORMULA_0135 0 0 0.0 6553.5000 ECU_ADDRESS 0x3FBFDA /begin FUNCTION_LIST Motortemperatur /end FUNCTION_LIST /end MEASUREMENT
/begin MEASUREMENT tmot_diag_ll_max "Zeitdauer in B_LL fuehrt zum Anhalten der Diagnose" UWORD FORMULA_0135 0 0 0.0 6553.5000 ECU_ADDRESS 0x3FBFDC /begin FUNCTION_LIST Motortemperatur /end FUNCTION_LIST /end MEASUREMENT
/begin MEASUREMENT tmot_diag_ll_wait "Anhaltezeit der Diagnose" UWORD FORMULA_0135 0 0 0.0 6553.5000 ECU_ADDRESS 0x3FBFDE /begin FUNCTION_LIST Motortemperatur /end FUNCTION_LIST /end MEASUREMENT
/begin MEASUREMENT tmot_time_fehler_min "Diagnoseverzoegerungszeit bei extremen Aussentemperaturen" UWORD FORMULA_0135 0 0 0.0 6553.5000 ECU_ADDRESS 0x3FBFE0 /begin FUNCTION_LIST Motortemperatur /end FUNCTION_LIST /end MEASUREMENT
/* ------------------ Abschnitt erzeugt aus tm_ign.dat ------------------ */
/begin MEASUREMENT tm_Sync1.netTime "Maxzeit" ULONG FORMULA_0229 0 0 0.0 1000.0000 ECU_ADDRESS 0x3F9E74 /begin FUNCTION_LIST Taskmonitor /end FUNCTION_LIST /end MEASUREMENT
/begin MEASUREMENT tm_Sync1.maxTime "Maxzeit" ULONG FORMULA_0229 0 0 0.0 1000.0000 ECU_ADDRESS 0x3F9E7C /begin FUNCTION_LIST Taskmonitor /end FUNCTION_LIST /end MEASUREMENT
/begin MEASUREMENT tm_Sync1.dT "Maxzeit" ULONG FORMULA_0229 0 0 0.0 1000.0000 ECU_ADDRESS 0x3F9E80 /begin FUNCTION_LIST Taskmonitor /end FUNCTION_LIST /end MEASUREMENT
/begin MEASUREMENT tm_Sync1.lastTask "Maxzeit" ULONG FORMULA_0001 0 0 0.0 1000.0000 ECU_ADDRESS 0x3F9E88 /begin FUNCTION_LIST Taskmonitor /end FUNCTION_LIST /end MEASUREMENT
/begin MEASUREMENT tm_Sync2.netTime "Maxzeit" ULONG FORMULA_0229 0 0 0.0 1000.0000 ECU_ADDRESS 0x3F9E9C /begin FUNCTION_LIST Taskmonitor /end FUNCTION_LIST /end MEASUREMENT
/begin MEASUREMENT tm_Sync2.maxTime "Maxzeit" ULONG FORMULA_0229 0 0 0.0 1000.0000 ECU_ADDRESS 0x3F9EA4 /begin FUNCTION_LIST Taskmonitor /end FUNCTION_LIST /end MEASUREMENT
/begin MEASUREMENT tm_Sync2.dT "Maxzeit" ULONG FORMULA_0229 0 0 0.0 1000.0000 ECU_ADDRESS 0x3F9EA8 /begin FUNCTION_LIST Taskmonitor /end FUNCTION_LIST /end MEASUREMENT
/begin MEASUREMENT tm_Sync2.lastTask "Maxzeit" ULONG FORMULA_0001 0 0 0.0 1000.0000 ECU_ADDRESS 0x3F9EB0 /begin FUNCTION_LIST Taskmonitor /end FUNCTION_LIST /end MEASUREMENT
/begin MEASUREMENT tm_5ms.netTime "Maxzeit" ULONG FORMULA_0229 0 0 0.0 1000.0000 ECU_ADDRESS 0x3F9F14 /begin FUNCTION_LIST Taskmonitor /end FUNCTION_LIST /end MEASUREMENT
/begin MEASUREMENT tm_5ms.maxTime "Maxzeit" ULONG FORMULA_0229 0 0 0.0 1000.0000 ECU_ADDRESS 0x3F9F1C /begin FUNCTION_LIST Taskmonitor /end FUNCTION_LIST /end MEASUREMENT
/begin MEASUREMENT tm_5ms.dT "Maxzeit" ULONG FORMULA_0229 0 0 0.0 1000.0000 ECU_ADDRESS 0x3F9F20 /begin FUNCTION_LIST Taskmonitor /end FUNCTION_LIST /end MEASUREMENT
/begin MEASUREMENT tm_5ms.lastTask "Maxzeit" ULONG FORMULA_0001 0 0 0.0 1000.0000 ECU_ADDRESS 0x3F9F28 /begin FUNCTION_LIST Taskmonitor /end FUNCTION_LIST /end MEASUREMENT
/begin MEASUREMENT tm_10ms.netTime "Maxzeit" ULONG FORMULA_0229 0 0 0.0 1000.0000 ECU_ADDRESS 0x3F9F3C /begin FUNCTION_LIST Taskmonitor /end FUNCTION_LIST /end MEASUREMENT
/begin MEASUREMENT tm_10ms.maxTime "Maxzeit" ULONG FORMULA_0229 0 0 0.0 1000.0000 ECU_ADDRESS 0x3F9F44 /begin FUNCTION_LIST Taskmonitor /end FUNCTION_LIST /end MEASUREMENT
/begin MEASUREMENT tm_10ms.dT "Maxzeit" ULONG FORMULA_0229 0 0 0.0 1000.0000 ECU_ADDRESS 0x3F9F48 /begin FUNCTION_LIST Taskmonitor /end FUNCTION_LIST /end MEASUREMENT
/begin MEASUREMENT tm_10ms.lastTask "Maxzeit" ULONG FORMULA_0001 0 0 0.0 1000.0000 ECU_ADDRESS 0x3F9F50 /begin FUNCTION_LIST Taskmonitor /end FUNCTION_LIST /end MEASUREMENT
/begin MEASUREMENT tm_100ms.netTime "Maxzeit" ULONG FORMULA_0229 0 0 0.0 1000.0000 ECU_ADDRESS 0x3F9F64 /begin FUNCTION_LIST Taskmonitor /end FUNCTION_LIST /end MEASUREMENT
/begin MEASUREMENT tm_100ms.maxTime "Maxzeit" ULONG FORMULA_0229 0 0 0.0 1000.0000 ECU_ADDRESS 0x3F9F6C /begin FUNCTION_LIST Taskmonitor /end FUNCTION_LIST /end MEASUREMENT
/begin MEASUREMENT tm_100ms.dT "Maxzeit" ULONG FORMULA_0229 0 0 0.0 1000.0000 ECU_ADDRESS 0x3F9F70 /begin FUNCTION_LIST Taskmonitor /end FUNCTION_LIST /end MEASUREMENT
/begin MEASUREMENT tm_100ms.lastTask "Maxzeit" ULONG FORMULA_0001 0 0 0.0 1000.0000 ECU_ADDRESS 0x3F9F78 /begin FUNCTION_LIST Taskmonitor /end FUNCTION_LIST /end MEASUREMENT
/begin MEASUREMENT tm_bgnd.netTime "Maxzeit" ULONG FORMULA_0229 0 0 0.0 1000.0000 ECU_ADDRESS 0x3F9FB4 /begin FUNCTION_LIST Taskmonitor /end FUNCTION_LIST /end MEASUREMENT
/begin MEASUREMENT tm_bgnd.maxTime "Maxzeit" ULONG FORMULA_0229 0 0 0.0 1000.0000 ECU_ADDRESS 0x3F9FBC /begin FUNCTION_LIST Taskmonitor /end FUNCTION_LIST /end MEASUREMENT
/begin MEASUREMENT tm_bgnd.dT "Maxzeit" ULONG FORMULA_0229 0 0 0.0 1000.0000 ECU_ADDRESS 0x3F9FC0 /begin FUNCTION_LIST Taskmonitor /end FUNCTION_LIST /end MEASUREMENT
/begin MEASUREMENT tm_bgnd.lastTask "Maxzeit" ULONG FORMULA_0001 0 0 0.0 1000.0000 ECU_ADDRESS 0x3F9FC8 /begin FUNCTION_LIST Taskmonitor /end FUNCTION_LIST /end MEASUREMENT
/* ------------------ Abschnitt erzeugt aus tpu_ign.dat ------------------ */
/begin CHARACTERISTIC K_TPU_NW_SYNC_ZAHN_IGN "Zahn bei der die NW-Synchronisation erfolgt" VALUE 0x625AA TKW_VV_VV_UB 100.0 FORMULA_0008 0.0 59.0000 /begin FUNCTION_LIST TPU_Interface /end FUNCTION_LIST /end CHARACTERISTIC
/begin CHARACTERISTIC K_NW_CONFIG_IGN "Konfigurationsparameter fuer NW-Synchronisation" VALUE 0x625AB TKW_VV_VV_UB 100.0 FORMULA_0234 0.0 255.0 /begin FUNCTION_LIST TPU_Interface /end FUNCTION_LIST /end CHARACTERISTIC
/begin CHARACTERISTIC K_TPU_IGN_MISS_FIRE_TIME "Ini Schliesszeit fuer die Ausgabe von Fehlzuendungen." VALUE 0x625AC TKW_VV_VV_UB 100.0 FORMULA_0235 0.0 204.0000 /begin FUNCTION_LIST TPU_Interface /end FUNCTION_LIST /end CHARACTERISTIC
/begin CHARACTERISTIC K_TPU_IGN_MIN_SCI_POS "Ini minimalen Winkelabstand vorm Zuendwinkel." VALUE 0x625AE TKW_VV_VV_SW 100.0 FORMULA_0153 -360.0000 359.9000 /begin FUNCTION_LIST TPU_Interface /end FUNCTION_LIST FORMAT "%4.1" /end CHARACTERISTIC
/begin MEASUREMENT tpu_st "Status TPU Synchronisation Einspritzprozessor" UBYTE FORMULA_0230 0 0 0.0 255.0 ECU_ADDRESS 0x3FA9D0 /begin FUNCTION_LIST TPU_Interface /end FUNCTION_LIST /end MEASUREMENT
/begin MEASUREMENT tpub_st "Status TPU-B Synchronisation Einspritzprozessor" UBYTE FORMULA_0230 0 0 0.0 255.0 ECU_ADDRESS 0x3FBFE4 /begin FUNCTION_LIST TPU_Interface /end FUNCTION_LIST /end MEASUREMENT
/begin MEASUREMENT tpu_zyl "aktueller Zylinder" UBYTE FORMULA_0008 0 0 0.0 12.0000 ECU_ADDRESS 0x3FBFE5 /begin FUNCTION_LIST TPU_Interface /end FUNCTION_LIST /end MEASUREMENT
/begin MEASUREMENT tpu_zyl_p2 "zwei Zylinder in der Zukunft" UBYTE FORMULA_0008 0 0 0.0 12.0000 ECU_ADDRESS 0x3FBFE6 /begin FUNCTION_LIST TPU_Interface /end FUNCTION_LIST /end MEASUREMENT
/begin MEASUREMENT tpu_index "Segmentindex fuer den Gesamtmotor" UBYTE FORMULA_0008 0 0 0.0 12.0000 ECU_ADDRESS 0x3FBFE7 /begin FUNCTION_LIST TPU_Interface /end FUNCTION_LIST /end MEASUREMENT
/begin MEASUREMENT tpua_index "Segmentindex fuer TPU-A" UBYTE FORMULA_0008 0 0 0.0 12.0000 ECU_ADDRESS 0x3FBFE8 /begin FUNCTION_LIST TPU_Interface /end FUNCTION_LIST /end MEASUREMENT
/begin MEASUREMENT tpub_index "Segmentindex fuer TPU-B" UBYTE FORMULA_0008 0 0 0.0 12.0000 ECU_ADDRESS 0x3FBFE9 /begin FUNCTION_LIST TPU_Interface /end FUNCTION_LIST /end MEASUREMENT
/begin MEASUREMENT tpu_irqzahn_ign "Zahnnummer TPU Interrupt" UBYTE FORMULA_0008 0 0 0.0 255.0000 ECU_ADDRESS 0x3FBFEA /begin FUNCTION_LIST TPU_Interface /end FUNCTION_LIST /end MEASUREMENT
/begin MEASUREMENT tpub_irqzahn_ign "Zahnnummer TPU-B Interrupt" UBYTE FORMULA_0008 0 0 0.0 255.0000 ECU_ADDRESS 0x3FBFEB /begin FUNCTION_LIST TPU_Interface /end FUNCTION_LIST /end MEASUREMENT
/begin MEASUREMENT tpu_irqz_ign "TPU Interruptzaehler" UWORD FORMULA_0000 0 0 0.0 65535.0000 ECU_ADDRESS 0x3FBFEC /begin FUNCTION_LIST TPU_Interface /end FUNCTION_LIST /end MEASUREMENT
/begin MEASUREMENT tpub_irqz_ign "TPU-B Interruptzaehler" UWORD FORMULA_0000 0 0 0.0 65535.0000 ECU_ADDRESS 0x3FBFEE /begin FUNCTION_LIST TPU_Interface /end FUNCTION_LIST /end MEASUREMENT
/begin MEASUREMENT tpu_irqart_ign "Art des TPU Interrupt" UBYTE FORMULA_0231 0 0 0.0 255.0 ECU_ADDRESS 0x3FBFF0 /begin FUNCTION_LIST TPU_Interface /end FUNCTION_LIST /end MEASUREMENT
/begin MEASUREMENT tpub_irqart_ign "Art des TPU-B Interrupt" UBYTE FORMULA_0231 0 0 0.0 255.0 ECU_ADDRESS 0x3FBFF1 /begin FUNCTION_LIST TPU_Interface /end FUNCTION_LIST /end MEASUREMENT
/begin MEASUREMENT tpu_error_count "Anzahl Fehlerinterrupts der TPU" UWORD FORMULA_0000 0 0 0.0 65535.0000 ECU_ADDRESS 0x3FBFF2 /begin FUNCTION_LIST TPU_Interface /end FUNCTION_LIST /end MEASUREMENT
/begin MEASUREMENT tpub_error_count "Anzahl Fehlerinterrupts der TPU-B" UWORD FORMULA_0000 0 0 0.0 65535.0000 ECU_ADDRESS 0x3FBFF4 /begin FUNCTION_LIST TPU_Interface /end FUNCTION_LIST /end MEASUREMENT
/begin MEASUREMENT tpu_bsirq_count "Anzahl Segmentinterrupts der TPU" UWORD FORMULA_0000 0 0 0.0 65535.0000 ECU_ADDRESS 0x3FBFF6 /begin FUNCTION_LIST TPU_Interface /end FUNCTION_LIST /end MEASUREMENT
/begin MEASUREMENT tpub_bsirq_count "Anzahl Segmentinterrupts der TPU-B" UWORD FORMULA_0000 0 0 0.0 65535.0000 ECU_ADDRESS 0x3FBFF8 /begin FUNCTION_LIST TPU_Interface /end FUNCTION_LIST /end MEASUREMENT
/begin MEASUREMENT nw_zaehler "Nockenwellenzaehler" ULONG FORMULA_0001 0 0 0.0 2147483647.0000 ECU_ADDRESS 0x3FBFFC /begin FUNCTION_LIST TPU_Interface /end FUNCTION_LIST /end MEASUREMENT
/begin MEASUREMENT nw_st "Synchronisationsstatus Nockenwelle" UBYTE FORMULA_0232 0 0 0.0 255.0 ECU_ADDRESS 0x3FC000 /begin FUNCTION_LIST TPU_Interface /end FUNCTION_LIST /end MEASUREMENT
/begin MEASUREMENT nw_st_signal_ign "Signalpegel auf NW-Syncleitung" UBYTE FORMULA_0233 0 0 0.0 16.0 ECU_ADDRESS 0x3FC001 /begin FUNCTION_LIST TPU_Interface /end FUNCTION_LIST /end MEASUREMENT
/* ------------------ Abschnitt erzeugt aus tsgrw.dat ------------------ */
/begin CHARACTERISTIC K_TSGRW_TU "Tuning Saugrohrwandtemperatur" VALUE 0x625B0 TKW_VV_VV_SW 100.0 FORMULA_0019 -50.0000 150.0000 /begin FUNCTION_LIST Saugrohtwandtemperatur /end FUNCTION_LIST FORMAT "%4.1" /end CHARACTERISTIC
/begin CHARACTERISTIC K_TSGRW_F "Verhaeltnisfaktor TSGRW" VALUE 0x625B2 TKW_VV_VV_UW 100.0 FORMULA_0236 0.0 1.9999 /begin FUNCTION_LIST Saugrohtwandtemperatur /end FUNCTION_LIST FORMAT "%7.4" /end CHARACTERISTIC
/begin CHARACTERISTIC K_TSGRW_CFG "Schalter welches TSGRW" VALUE 0x625B4 TKW_VV_VV_UB 100.0 FORMULA_0237 0.0 255.0 /begin FUNCTION_LIST Saugrohtwandtemperatur /end FUNCTION_LIST BIT_MASK 0x1 /end CHARACTERISTIC
/* ------------------ Abschnitt erzeugt aus tz.dat ------------------ */
/begin CHARACTERISTIC K_TZ_SZ_CONTROL "Kontrollbyte Schliesszeit Berechnung (1:Ionenstrom 0:Normal)" VALUE 0x625B6 TKW_VV_VV_UW 100.0 FORMULA_0024 0.0 65535.0000 /begin FUNCTION_LIST Zuendung /end FUNCTION_LIST FORMAT "%5.2" /end CHARACTERISTIC
/begin CHARACTERISTIC K_TZ_MAX "fruehester Zuendwinkel" VALUE 0x625B8 TKW_VV_VV_SW 100.0 FORMULA_0037 -50.0000 60.0000 /begin FUNCTION_LIST Zuendung /end FUNCTION_LIST FORMAT "%4.1" /end CHARACTERISTIC
/begin CHARACTERISTIC K_TZ_ZWB_B1 "Aenderungsbegrenzung Bereich 1" VALUE 0x625BA TKW_VV_VV_SW 100.0 FORMULA_0241 0.0 50.0000 /begin FUNCTION_LIST Zuendung /end FUNCTION_LIST FORMAT "%4.1" /end CHARACTERISTIC
/begin CHARACTERISTIC K_TZ_ZWB_B2 "Aenderungsbegrenzung Bereich 2" VALUE 0x625BC TKW_VV_VV_SW 100.0 FORMULA_0241 0.0 50.0000 /begin FUNCTION_LIST Zuendung /end FUNCTION_LIST FORMAT "%4.1" /end CHARACTERISTIC
/begin CHARACTERISTIC K_TZ_ZWB_B3 "Aenderungsbegrenzung Bereich 3" VALUE 0x625BE TKW_VV_VV_SW 100.0 FORMULA_0241 0.0 50.0000 /begin FUNCTION_LIST Zuendung /end FUNCTION_LIST FORMAT "%4.1" /end CHARACTERISTIC
/begin CHARACTERISTIC K_TZ_RF_ZWB "RF Umschaltschwelle fuer ZWB" VALUE 0x625C0 TKW_VV_VV_SW 100.0 FORMULA_0006 0.0 2.0000 /begin FUNCTION_LIST Zuendung /end FUNCTION_LIST FORMAT "%6.3" /end CHARACTERISTIC
/begin CHARACTERISTIC K_TZ_DN_ZWB "Drehzahl Hysterese fuer ZWB" VALUE 0x625C2 TKW_VV_VV_SW 100.0 FORMULA_0011 0.0 10000.0000 /begin FUNCTION_LIST Zuendung /end FUNCTION_LIST /end CHARACTERISTIC
/begin CHARACTERISTIC K_TZ_MCS "Zuendwinkelkorrektur ueber MCS" VALUE 0x625C4 TKW_VV_VV_SW 100.0 FORMULA_0037 -50.0000 60.0000 /begin FUNCTION_LIST Zuendung /end FUNCTION_LIST FORMAT "%4.1" /end CHARACTERISTIC
/begin CHARACTERISTIC K_TZ_MCS_Z_ZYL1 "zyl.selektive Zuendwinkelkorrektur ueber MCS" VALUE 0x625C6 TKW_VV_VV_SW 100.0 FORMULA_0037 -50.0000 60.0000 /begin FUNCTION_LIST Zuendung /end FUNCTION_LIST FORMAT "%4.1" /end CHARACTERISTIC
/begin CHARACTERISTIC K_TZ_MCS_Z_ZYL2 "zyl.selektive Zuendwinkelkorrektur ueber MCS" VALUE 0x625C8 TKW_VV_VV_SW 100.0 FORMULA_0037 -50.0000 60.0000 /begin FUNCTION_LIST Zuendung /end FUNCTION_LIST FORMAT "%4.1" /end CHARACTERISTIC
/begin CHARACTERISTIC K_TZ_MCS_Z_ZYL3 "zyl.selektive Zuendwinkelkorrektur ueber MCS" VALUE 0x625CA TKW_VV_VV_SW 100.0 FORMULA_0037 -50.0000 60.0000 /begin FUNCTION_LIST Zuendung /end FUNCTION_LIST FORMAT "%4.1" /end CHARACTERISTIC
/begin CHARACTERISTIC K_TZ_MCS_Z_ZYL4 "zyl.selektive Zuendwinkelkorrektur ueber MCS" VALUE 0x625CC TKW_VV_VV_SW 100.0 FORMULA_0037 -50.0000 60.0000 /begin FUNCTION_LIST Zuendung /end FUNCTION_LIST FORMAT "%4.1" /end CHARACTERISTIC
/begin CHARACTERISTIC K_TZ_MCS_Z_ZYL5 "zyl.selektive Zuendwinkelkorrektur ueber MCS" VALUE 0x625CE TKW_VV_VV_SW 100.0 FORMULA_0037 -50.0000 60.0000 /begin FUNCTION_LIST Zuendung /end FUNCTION_LIST FORMAT "%4.1" /end CHARACTERISTIC
/begin CHARACTERISTIC K_TZ_MCS_Z_ZYL6 "zyl.selektive Zuendwinkelkorrektur ueber MCS" VALUE 0x625D0 TKW_VV_VV_SW 100.0 FORMULA_0037 -50.0000 60.0000 /begin FUNCTION_LIST Zuendung /end FUNCTION_LIST FORMAT "%4.1" /end CHARACTERISTIC
/begin CHARACTERISTIC K_TZ_MCS_Z_ZYL7 "zyl.selektive Zuendwinkelkorrektur ueber MCS" VALUE 0x625D2 TKW_VV_VV_SW 100.0 FORMULA_0037 -50.0000 60.0000 /begin FUNCTION_LIST Zuendung /end FUNCTION_LIST FORMAT "%4.1" /end CHARACTERISTIC
/begin CHARACTERISTIC K_TZ_MCS_Z_ZYL8 "zyl.selektive Zuendwinkelkorrektur ueber MCS" VALUE 0x625D4 TKW_VV_VV_SW 100.0 FORMULA_0037 -50.0000 60.0000 /begin FUNCTION_LIST Zuendung /end FUNCTION_LIST FORMAT "%4.1" /end CHARACTERISTIC
/begin CHARACTERISTIC K_TZ_MCS_Z_ZYL9 "zyl.selektive Zuendwinkelkorrektur ueber MCS" VALUE 0x625D6 TKW_VV_VV_SW 100.0 FORMULA_0037 -50.0000 60.0000 /begin FUNCTION_LIST Zuendung /end FUNCTION_LIST FORMAT "%4.1" /end CHARACTERISTIC
/begin CHARACTERISTIC K_TZ_MCS_Z_ZYL10 "zyl.selektive Zuendwinkelkorrektur ueber MCS" VALUE 0x625D8 TKW_VV_VV_SW 100.0 FORMULA_0037 -50.0000 60.0000 /begin FUNCTION_LIST Zuendung /end FUNCTION_LIST FORMAT "%4.1" /end CHARACTERISTIC
/begin CHARACTERISTIC K_TZ_MCS_Z_ZYL11 "zyl.selektive Zuendwinkelkorrektur ueber MCS" VALUE 0x625DA TKW_VV_VV_SW 100.0 FORMULA_0037 -50.0000 60.0000 /begin FUNCTION_LIST Zuendung /end FUNCTION_LIST FORMAT "%4.1" /end CHARACTERISTIC
/begin CHARACTERISTIC K_TZ_MCS_Z_ZYL12 "zyl.selektive Zuendwinkelkorrektur ueber MCS" VALUE 0x625DC TKW_VV_VV_SW 100.0 FORMULA_0037 -50.0000 60.0000 /begin FUNCTION_LIST Zuendung /end FUNCTION_LIST FORMAT "%4.1" /end CHARACTERISTIC
/begin CHARACTERISTIC K_TZ_NMIN_KL50ON "N-Einschaltschwelle der Zuendung bei S_KL50" VALUE 0x625DE TKW_VV_VV_SW 100.0 FORMULA_0011 0.0 10000.0000 /begin FUNCTION_LIST Zuendung /end FUNCTION_LIST /end CHARACTERISTIC
/begin CHARACTERISTIC K_TZ_NMIN_KL50OFF "N-Einschaltschwelle der Zuendung bei !S_KL50" VALUE 0x625E0 TKW_VV_VV_SW 100.0 FORMULA_0011 0.0 10000.0000 /begin FUNCTION_LIST Zuendung /end FUNCTION_LIST /end CHARACTERISTIC
/begin CHARACTERISTIC K_TZ_UB_ERSATZ "Ub-Ersatzwert fuer Schliesszeitberechnung" VALUE 0x625E2 TKW_VV_VV_SW 100.0 FORMULA_0045 0.0 28.0000 /begin FUNCTION_LIST Zuendung /end FUNCTION_LIST FORMAT "%4.1" /end CHARACTERISTIC
/begin CHARACTERISTIC K_TZ_KL15_NACHLAUF "Kl15 Nachlauf der Zuendung" VALUE 0x625E4 TKW_VV_VV_UB 100.0 FORMULA_0242 0.0 255.0000 /begin FUNCTION_LIST Zuendung /end FUNCTION_LIST /end CHARACTERISTIC
/begin CHARACTERISTIC K_TZ_ION_COIL "Auswahl integrierte Ionen-Zuendspulen (." VALUE 0x625E6 TKW_VV_VV_UW 100.0 FORMULA_0024 0.0 65535.0000 /begin FUNCTION_LIST Zuendung /end FUNCTION_LIST FORMAT "%5.2" /end CHARACTERISTIC
/begin CHARACTERISTIC KL_TZ_START_N "Start Zuendwinkel = f{ n }" CURVE 0x625E8 TKL_SW_VV_SW 100.0 FORMULA_0037 -50.0000 60.0000 /begin FUNCTION_LIST Zuendung /end FUNCTION_LIST /begin AXIS_DESCR STD_AXIS n FORMULA_0011 3 0.0 10000.0000 /end AXIS_DESCR FORMAT "%4.1" /end CHARACTERISTIC
/begin CHARACTERISTIC KL_TZ_START_TMOT "Offset Start Zuendwinkel = f{ tmot }" CURVE 0x625F6 TKL_SW_VV_SW 100.0 FORMULA_0037 -50.0000 60.0000 /begin FUNCTION_LIST Zuendung /end FUNCTION_LIST
 /begin AXIS_DESCR STD_AXIS tmot FORMULA_0019 3 -50.0000 150.0000 FORMAT "%4.1" /end AXIS_DESCR
 FORMAT "%4.1" /end CHARACTERISTIC
/begin CHARACTERISTIC KF_TZ_LL "Leerlauf Zuendwinkel = f{n,rf}" MAP 0x62604 TKF_SW_SW_SW 100.0 FORMULA_0037 -50.0000 60.0000 /begin FUNCTION_LIST Zuendung /end FUNCTION_LIST /begin AXIS_DESCR STD_AXIS n FORMULA_0011 6 0.0 10000.0000 /end AXIS_DESCR /begin AXIS_DESCR STD_AXIS rf FORMULA_0006 2 0.0 2.0000 FORMAT "%6.3" /end AXIS_DESCR FORMAT "%4.1" /end CHARACTERISTIC
/begin CHARACTERISTIC KF_TZ_GRUND "Grundkennfeld Zuendwinkel fuer TL" MAP 0x6262E TKF_SW_SW_SW 100.0 FORMULA_0037 -50.0000 60.0000 /begin FUNCTION_LIST Zuendung /end FUNCTION_LIST /begin AXIS_DESCR STD_AXIS n FORMULA_0011 18 0.0 10000.0000 /end AXIS_DESCR /begin AXIS_DESCR STD_AXIS rf FORMULA_0006 12 0.0 2.0000 FORMAT "%6.3" /end AXIS_DESCR FORMAT "%4.1" /end CHARACTERISTIC
/begin CHARACTERISTIC KF_TZ_VL "Vollast Zuendwinkel" MAP 0x6281C TKF_SW_SW_SW 100.0 FORMULA_0037 -50.0000 60.0000 /begin FUNCTION_LIST Zuendung /end FUNCTION_LIST /begin AXIS_DESCR STD_AXIS n FORMULA_0011 18 0.0 10000.0000 /end AXIS_DESCR
 /begin AXIS_DESCR STD_AXIS pumg FORMULA_0031 3 400.0000 1200.0000 FORMAT "%4.1" /end AXIS_DESCR
 FORMAT "%4.1" /end CHARACTERISTIC
/begin CHARACTERISTIC KL_TZ_TKORR_LL "tmot-Zuendwinkelkorrektur fuer LL" CURVE 0x628B4 TKL_SW_VV_SW 100.0 FORMULA_0037 -50.0000 60.0000 /begin FUNCTION_LIST Zuendung /end FUNCTION_LIST
 /begin AXIS_DESCR STD_AXIS tmot FORMULA_0019 6 -50.0000 150.0000 FORMAT "%4.1" /end AXIS_DESCR
 FORMAT "%4.1" /end CHARACTERISTIC
/begin CHARACTERISTIC KL_TZ_TKORR_TL "tmot-Zuendwinkelkorrektur fuer TL" CURVE 0x628CE TKL_SW_VV_SW 100.0 FORMULA_0037 -50.0000 60.0000 /begin FUNCTION_LIST Zuendung /end FUNCTION_LIST
 /begin AXIS_DESCR STD_AXIS tmot FORMULA_0019 6 -50.0000 150.0000 FORMAT "%4.1" /end AXIS_DESCR
 FORMAT "%4.1" /end CHARACTERISTIC
/begin CHARACTERISTIC KL_TZ_PHASE "Zuendwinkel Schaubabschaltern = f{ n }" CURVE 0x628E8 TKL_SW_VV_SW 100.0 FORMULA_0037 -50.0000 60.0000 /begin FUNCTION_LIST Zuendung /end FUNCTION_LIST /begin AXIS_DESCR STD_AXIS n FORMULA_0011 4 0.0 10000.0000 /end AXIS_DESCR FORMAT "%4.1" /end CHARACTERISTIC
/begin CHARACTERISTIC KL_TZ_SZ_IONSTR_UB "Schliesszeitkorrektur Ionenstromsp. ueber UB = f{ ub }" CURVE 0x628FA TKL_SW_VV_UW 100.0 FORMULA_0035 0.0 4.0000 /begin FUNCTION_LIST Zuendung /end FUNCTION_LIST /begin AXIS_DESCR STD_AXIS ub FORMULA_0045 7 0.0 28.0000 FORMAT "%4.1" /end AXIS_DESCR FORMAT "%6.3" /end CHARACTERISTIC
/begin CHARACTERISTIC KF_TZ_SZ "Schliesszeit Kennfeld" MAP 0x62918 TKF_SW_SW_SW 100.0 FORMULA_0238 0.0 26.2136 /begin FUNCTION_LIST Zuendung /end FUNCTION_LIST /begin AXIS_DESCR STD_AXIS n FORMULA_0011 5 0.0 10000.0000 /end AXIS_DESCR /begin AXIS_DESCR STD_AXIS ub FORMULA_0045 7 0.0 28.0000 FORMAT "%4.1" /end AXIS_DESCR FORMAT "%5.2" /end CHARACTERISTIC
/begin CHARACTERISTIC KF_TZ_SZ_IONSTR "Schliesszeit Kennfeld Ionenstromspulen" MAP 0x62978 TKF_SW_SW_SW 100.0 FORMULA_0238 0.0 26.2136 /begin FUNCTION_LIST Zuendung /end FUNCTION_LIST /begin AXIS_DESCR STD_AXIS n FORMULA_0011 5 0.0 10000.0000 /end AXIS_DESCR /begin AXIS_DESCR STD_AXIS rf FORMULA_0006 6 0.0 2.0000 FORMAT "%6.3" /end AXIS_DESCR FORMAT "%5.2" /end CHARACTERISTIC
/begin CHARACTERISTIC KF_TZ_MIN "spaetest zulaessiger Zuendwinkel" MAP 0x629CC TKF_SW_SW_SW 100.0 FORMULA_0037 -50.0000 60.0000 /begin FUNCTION_LIST Zuendung /end FUNCTION_LIST /begin AXIS_DESCR STD_AXIS n FORMULA_0011 8 0.0 10000.0000 /end AXIS_DESCR /begin AXIS_DESCR STD_AXIS rf FORMULA_0006 6 0.0 2.0000 FORMAT "%6.3" /end AXIS_DESCR FORMAT "%4.1" /end CHARACTERISTIC
/begin CHARACTERISTIC KL_TZ_MIN_TMOT "Offset spaetest zulaessiger Zuendwinkel" CURVE 0x62A4A TKL_SW_VV_SW 100.0 FORMULA_0037 -50.0000 60.0000 /begin FUNCTION_LIST Zuendung /end FUNCTION_LIST
 /begin AXIS_DESCR STD_AXIS tmot FORMULA_0019 4 -50.0000 150.0000 FORMAT "%4.1" /end AXIS_DESCR
 FORMAT "%4.1" /end CHARACTERISTIC
/begin MEASUREMENT tz_ausg_muster_zyl1 "Muster fuer Aussetzgenerierung" ULONG FORMULA_0104 0 0 0.0 2147483647.0000 ECU_ADDRESS 0x3FC004 /begin FUNCTION_LIST Zuendung /end FUNCTION_LIST /end MEASUREMENT
/begin MEASUREMENT tz_ausg_muster_zyl2 "Muster fuer Aussetzgenerierung" ULONG FORMULA_0104 0 0 0.0 2147483647.0000 ECU_ADDRESS 0x3FC008 /begin FUNCTION_LIST Zuendung /end FUNCTION_LIST /end MEASUREMENT
/begin MEASUREMENT tz_ausg_muster_zyl3 "Muster fuer Aussetzgenerierung" ULONG FORMULA_0104 0 0 0.0 2147483647.0000 ECU_ADDRESS 0x3FC00C /begin FUNCTION_LIST Zuendung /end FUNCTION_LIST /end MEASUREMENT
/begin MEASUREMENT tz_ausg_muster_zyl4 "Muster fuer Aussetzgenerierung" ULONG FORMULA_0104 0 0 0.0 2147483647.0000 ECU_ADDRESS 0x3FC010 /begin FUNCTION_LIST Zuendung /end FUNCTION_LIST /end MEASUREMENT
/begin MEASUREMENT tz_ausg_muster_zyl5 "Muster fuer Aussetzgenerierung" ULONG FORMULA_0104 0 0 0.0 2147483647.0000 ECU_ADDRESS 0x3FC014 /begin FUNCTION_LIST Zuendung /end FUNCTION_LIST /end MEASUREMENT
/begin MEASUREMENT tz_ausg_muster_zyl6 "Muster fuer Aussetzgenerierung" ULONG FORMULA_0104 0 0 0.0 2147483647.0000 ECU_ADDRESS 0x3FC018 /begin FUNCTION_LIST Zuendung /end FUNCTION_LIST /end MEASUREMENT
/begin MEASUREMENT tz_ausg_muster_zyl7 "Muster fuer Aussetzgenerierung" ULONG FORMULA_0104 0 0 0.0 2147483647.0000 ECU_ADDRESS 0x3FC01C /begin FUNCTION_LIST Zuendung /end FUNCTION_LIST /end MEASUREMENT
/begin MEASUREMENT tz_ausg_muster_zyl8 "Muster fuer Aussetzgenerierung" ULONG FORMULA_0104 0 0 0.0 2147483647.0000 ECU_ADDRESS 0x3FC020 /begin FUNCTION_LIST Zuendung /end FUNCTION_LIST /end MEASUREMENT
/begin MEASUREMENT tz_ausg_muster_zyl9 "Muster fuer Aussetzgenerierung" ULONG FORMULA_0104 0 0 0.0 2147483647.0000 ECU_ADDRESS 0x3FC024 /begin FUNCTION_LIST Zuendung /end FUNCTION_LIST /end MEASUREMENT
/begin MEASUREMENT tz_ausg_muster_zyl10 "Muster fuer Aussetzgenerierung" ULONG FORMULA_0104 0 0 0.0 2147483647.0000 ECU_ADDRESS 0x3FC028 /begin FUNCTION_LIST Zuendung /end FUNCTION_LIST /end MEASUREMENT
/begin MEASUREMENT tz_ausg_muster_zyl11 "Muster fuer Aussetzgenerierung" ULONG FORMULA_0104 0 0 0.0 2147483647.0000 ECU_ADDRESS 0x3FC02C /begin FUNCTION_LIST Zuendung /end FUNCTION_LIST /end MEASUREMENT
/begin MEASUREMENT tz_ausg_muster_zyl12 "Muster fuer Aussetzgenerierung" ULONG FORMULA_0104 0 0 0.0 2147483647.0000 ECU_ADDRESS 0x3FC030 /begin FUNCTION_LIST Zuendung /end FUNCTION_LIST /end MEASUREMENT
/begin MEASUREMENT tz_ausg_pause "Pause nach Ablauf Muster" UBYTE FORMULA_0047 0 0 0.0 255.0000 ECU_ADDRESS 0x3FC034 /begin FUNCTION_LIST Zuendung /end FUNCTION_LIST /end MEASUREMENT
/begin MEASUREMENT tz_ausg_anz_seq "Anzahl wie oft Muster und Pause ablaufen sollen" UBYTE FORMULA_0047 0 0 0.0 255.0000 ECU_ADDRESS 0x3FC036 /begin FUNCTION_LIST Zuendung /end FUNCTION_LIST /end MEASUREMENT
/begin MEASUREMENT tz_ausg_maskmust "Maske auf aktuelle Musterposition" ULONG FORMULA_0104 0 0 0.0 2147483647.0000 ECU_ADDRESS 0x3FC038 /begin FUNCTION_LIST Zuendung /end FUNCTION_LIST /end MEASUREMENT
/begin MEASUREMENT tz_zyl1 "Zuendwinkel" SWORD FORMULA_0037 0 0 -50.0000 60.0000 ECU_ADDRESS 0x3FC03C /begin FUNCTION_LIST Zuendung /end FUNCTION_LIST /end MEASUREMENT
/begin MEASUREMENT tz_zyl2 "Zuendwinkel" SWORD FORMULA_0037 0 0 -50.0000 60.0000 ECU_ADDRESS 0x3FC03E /begin FUNCTION_LIST Zuendung /end FUNCTION_LIST /end MEASUREMENT
/begin MEASUREMENT tz_zyl3 "Zuendwinkel" SWORD FORMULA_0037 0 0 -50.0000 60.0000 ECU_ADDRESS 0x3FC040 /begin FUNCTION_LIST Zuendung /end FUNCTION_LIST /end MEASUREMENT
/begin MEASUREMENT tz_zyl4 "Zuendwinkel" SWORD FORMULA_0037 0 0 -50.0000 60.0000 ECU_ADDRESS 0x3FC042 /begin FUNCTION_LIST Zuendung /end FUNCTION_LIST /end MEASUREMENT
/begin MEASUREMENT tz_zyl5 "Zuendwinkel" SWORD FORMULA_0037 0 0 -50.0000 60.0000 ECU_ADDRESS 0x3FC044 /begin FUNCTION_LIST Zuendung /end FUNCTION_LIST /end MEASUREMENT
/begin MEASUREMENT tz_zyl6 "Zuendwinkel" SWORD FORMULA_0037 0 0 -50.0000 60.0000 ECU_ADDRESS 0x3FC046 /begin FUNCTION_LIST Zuendung /end FUNCTION_LIST /end MEASUREMENT
/begin MEASUREMENT tz_zyl7 "Zuendwinkel" SWORD FORMULA_0037 0 0 -50.0000 60.0000 ECU_ADDRESS 0x3FC048 /begin FUNCTION_LIST Zuendung /end FUNCTION_LIST /end MEASUREMENT
/begin MEASUREMENT tz_zyl8 "Zuendwinkel" SWORD FORMULA_0037 0 0 -50.0000 60.0000 ECU_ADDRESS 0x3FC04A /begin FUNCTION_LIST Zuendung /end FUNCTION_LIST /end MEASUREMENT
/begin MEASUREMENT tz_zyl9 "Zuendwinkel" SWORD FORMULA_0037 0 0 -50.0000 60.0000 ECU_ADDRESS 0x3FC04C /begin FUNCTION_LIST Zuendung /end FUNCTION_LIST /end MEASUREMENT
/begin MEASUREMENT tz_zyl10 "Zuendwinkel" SWORD FORMULA_0037 0 0 -50.0000 60.0000 ECU_ADDRESS 0x3FC04E /begin FUNCTION_LIST Zuendung /end FUNCTION_LIST /end MEASUREMENT
/begin MEASUREMENT tz_zyl11 "Zuendwinkel" SWORD FORMULA_0037 0 0 -50.0000 60.0000 ECU_ADDRESS 0x3FC050 /begin FUNCTION_LIST Zuendung /end FUNCTION_LIST /end MEASUREMENT
/begin MEASUREMENT tz_zyl12 "Zuendwinkel" SWORD FORMULA_0037 0 0 -50.0000 60.0000 ECU_ADDRESS 0x3FC052 /begin FUNCTION_LIST Zuendung /end FUNCTION_LIST /end MEASUREMENT
/begin MEASUREMENT tz_ve_zyl1 "Zuendwinkel ohne Momenteneingriff" SWORD FORMULA_0037 0 0 -50.0000 60.0000 ECU_ADDRESS 0x3FC054 /begin FUNCTION_LIST Zuendung /end FUNCTION_LIST /end MEASUREMENT
/begin MEASUREMENT tz_ve_zyl2 "Zuendwinkel ohne Momenteneingriff" SWORD FORMULA_0037 0 0 -50.0000 60.0000 ECU_ADDRESS 0x3FC056 /begin FUNCTION_LIST Zuendung /end FUNCTION_LIST /end MEASUREMENT
/begin MEASUREMENT tz_ve_zyl3 "Zuendwinkel ohne Momenteneingriff" SWORD FORMULA_0037 0 0 -50.0000 60.0000 ECU_ADDRESS 0x3FC058 /begin FUNCTION_LIST Zuendung /end FUNCTION_LIST /end MEASUREMENT
/begin MEASUREMENT tz_ve_zyl4 "Zuendwinkel ohne Momenteneingriff" SWORD FORMULA_0037 0 0 -50.0000 60.0000 ECU_ADDRESS 0x3FC05A /begin FUNCTION_LIST Zuendung /end FUNCTION_LIST /end MEASUREMENT
/begin MEASUREMENT tz_ve_zyl5 "Zuendwinkel ohne Momenteneingriff" SWORD FORMULA_0037 0 0 -50.0000 60.0000 ECU_ADDRESS 0x3FC05C /begin FUNCTION_LIST Zuendung /end FUNCTION_LIST /end MEASUREMENT
/begin MEASUREMENT tz_ve_zyl6 "Zuendwinkel ohne Momenteneingriff" SWORD FORMULA_0037 0 0 -50.0000 60.0000 ECU_ADDRESS 0x3FC05E /begin FUNCTION_LIST Zuendung /end FUNCTION_LIST /end MEASUREMENT
/begin MEASUREMENT tz_ve_zyl7 "Zuendwinkel ohne Momenteneingriff" SWORD FORMULA_0037 0 0 -50.0000 60.0000 ECU_ADDRESS 0x3FC060 /begin FUNCTION_LIST Zuendung /end FUNCTION_LIST /end MEASUREMENT
/begin MEASUREMENT tz_ve_zyl8 "Zuendwinkel ohne Momenteneingriff" SWORD FORMULA_0037 0 0 -50.0000 60.0000 ECU_ADDRESS 0x3FC062 /begin FUNCTION_LIST Zuendung /end FUNCTION_LIST /end MEASUREMENT
/begin MEASUREMENT tz_ve_zyl9 "Zuendwinkel ohne Momenteneingriff" SWORD FORMULA_0037 0 0 -50.0000 60.0000 ECU_ADDRESS 0x3FC064 /begin FUNCTION_LIST Zuendung /end FUNCTION_LIST /end MEASUREMENT
/begin MEASUREMENT tz_ve_zyl10 "Zuendwinkel ohne Momenteneingriff" SWORD FORMULA_0037 0 0 -50.0000 60.0000 ECU_ADDRESS 0x3FC066 /begin FUNCTION_LIST Zuendung /end FUNCTION_LIST /end MEASUREMENT
/begin MEASUREMENT tz_ve_zyl11 "Zuendwinkel ohne Momenteneingriff" SWORD FORMULA_0037 0 0 -50.0000 60.0000 ECU_ADDRESS 0x3FC068 /begin FUNCTION_LIST Zuendung /end FUNCTION_LIST /end MEASUREMENT
/begin MEASUREMENT tz_ve_zyl12 "Zuendwinkel ohne Momenteneingriff" SWORD FORMULA_0037 0 0 -50.0000 60.0000 ECU_ADDRESS 0x3FC06A /begin FUNCTION_LIST Zuendung /end FUNCTION_LIST /end MEASUREMENT
/begin MEASUREMENT tz_eta_basis "Basiszuendwinkel fuer ZW-Wirkungsgrad" SWORD FORMULA_0037 0 0 -50.0000 60.0000 ECU_ADDRESS 0x3FC06C /begin FUNCTION_LIST Zuendung /end FUNCTION_LIST /end MEASUREMENT
/begin MEASUREMENT tz_grund "Grundzuendwinkel" SWORD FORMULA_0037 0 0 -50.0000 60.0000 ECU_ADDRESS 0x3FC086 /begin FUNCTION_LIST Zuendung /end FUNCTION_LIST /end MEASUREMENT
/begin MEASUREMENT tz_stat "stationaer Zuendwinkel" SWORD FORMULA_0037 0 0 -50.0000 60.0000 ECU_ADDRESS 0x3FC088 /begin FUNCTION_LIST Zuendung /end FUNCTION_LIST /end MEASUREMENT
/begin MEASUREMENT tz_zwb "Zuendwinkel nach ZWB" SWORD FORMULA_0037 0 0 -50.0000 60.0000 ECU_ADDRESS 0x3FC08A /begin FUNCTION_LIST Zuendung /end FUNCTION_LIST /end MEASUREMENT
/begin MEASUREMENT tz_zwb_incr "Delta Zuendwinkel fuer ZWB" SWORD FORMULA_0037 0 0 -50.0000 60.0000 ECU_ADDRESS 0x3FC08C /begin FUNCTION_LIST Zuendung /end FUNCTION_LIST /end MEASUREMENT
/begin MEASUREMENT tz_tkorr "Korrekturoffset Temperatureinfluss" SWORD FORMULA_0037 0 0 -50.0000 60.0000 ECU_ADDRESS 0x3FC08E /begin FUNCTION_LIST Zuendung /end FUNCTION_LIST /end MEASUREMENT
/begin MEASUREMENT tz_sz "Schliesszeit der Zuendspulen" SWORD FORMULA_0238 0 0 0.0 26.2136 ECU_ADDRESS 0x3FC090 /begin FUNCTION_LIST Zuendung /end FUNCTION_LIST /end MEASUREMENT
/begin MEASUREMENT tz_sz_ionstr "Schliesszeit der Ionenstrom-Zuendspulen" SWORD FORMULA_0238 0 0 0.0 26.2136 ECU_ADDRESS 0x3FC092 /begin FUNCTION_LIST Zuendung /end FUNCTION_LIST /end MEASUREMENT
/begin MEASUREMENT tz_phase "Phasenkorrektur des Induktivgebers" SWORD FORMULA_0037 0 0 -50.0000 60.0000 ECU_ADDRESS 0x3FC094 /begin FUNCTION_LIST Zuendung /end FUNCTION_LIST /end MEASUREMENT
/begin MEASUREMENT tz_sa_offset "ZW-Eingriff von SA/WE" SWORD FORMULA_0037 0 0 -50.0000 60.0000 ECU_ADDRESS 0x3FC096 /begin FUNCTION_LIST Zuendung /end FUNCTION_LIST /end MEASUREMENT
/begin MEASUREMENT tz_sa_delta "" SWORD FORMULA_0239 0 0 -100.0000 0.0 ECU_ADDRESS 0x3FC098 /begin FUNCTION_LIST Zuendung /end FUNCTION_LIST /end MEASUREMENT
/begin MEASUREMENT tz_status "Status Zuendung" UBYTE FORMULA_0240 0 0 0.0 255.0 ECU_ADDRESS 0x3FC09B /begin FUNCTION_LIST Zuendung /end FUNCTION_LIST /end MEASUREMENT
/begin MEASUREMENT tz_kl15aus_count "Kl15 Nachlauf" UBYTE FORMULA_0047 0 0 0.0 255.0000 ECU_ADDRESS 0x3FC09C /begin FUNCTION_LIST Zuendung /end FUNCTION_LIST /end MEASUREMENT
/begin MEASUREMENT tz_sz_ub_ionstr_korr "Korrekturfaktor Schliesszeit ueber ub fuer Ionenstr. " UWORD FORMULA_0035 0 0 0.0 4.0000 ECU_ADDRESS 0x3FC09E /begin FUNCTION_LIST Zuendung /end FUNCTION_LIST /end MEASUREMENT
/begin MEASUREMENT tz_tl_vl_fak "Faktor fuer Offset TL->VL Kennfeld" UWORD FORMULA_0035 0 0 0.0 4.0000 ECU_ADDRESS 0x3FC0A0 /begin FUNCTION_LIST Zuendung /end FUNCTION_LIST /end MEASUREMENT
/begin MEASUREMENT tz_vl_offs "Zuendwinkeloffset zum Grundkennfeld" SWORD FORMULA_0037 0 0 -50.0000 60.0000 ECU_ADDRESS 0x3FC0A2 /begin FUNCTION_LIST Zuendung /end FUNCTION_LIST /end MEASUREMENT
/* ------------------ Abschnitt erzeugt aus tz_diag.dat ------------------ */
/begin MEASUREMENT tz_diag_spi_ret "Diag-Return vom ATIC29 Treiberbaustein" ULONG FORMULA_0104 0 0 0.0 2147483647.0000 ECU_ADDRESS 0x3FC0A4 /begin FUNCTION_LIST Zuendung /end FUNCTION_LIST /end MEASUREMENT
/begin MEASUREMENT tz_ed_ZYL1 "Eigendiagnose Zuendungsansteuerung" UWORD FORMULA_0017 0 0 0.0 111.0 ECU_ADDRESS 0x3FC0A8 /begin FUNCTION_LIST Zuendung /end FUNCTION_LIST BIT_MASK 0x6F /end MEASUREMENT
/begin MEASUREMENT tz_ed_ZYL2 "Eigendiagnose Zuendungsansteuerung" UWORD FORMULA_0017 0 0 0.0 111.0 ECU_ADDRESS 0x3FC0AA /begin FUNCTION_LIST Zuendung /end FUNCTION_LIST BIT_MASK 0x6F /end MEASUREMENT
/begin MEASUREMENT tz_ed_ZYL3 "Eigendiagnose Zuendungsansteuerung" UWORD FORMULA_0017 0 0 0.0 111.0 ECU_ADDRESS 0x3FC0AC /begin FUNCTION_LIST Zuendung /end FUNCTION_LIST BIT_MASK 0x6F /end MEASUREMENT
/begin MEASUREMENT tz_ed_ZYL4 "Eigendiagnose Zuendungsansteuerung" UWORD FORMULA_0017 0 0 0.0 111.0 ECU_ADDRESS 0x3FC0AE /begin FUNCTION_LIST Zuendung /end FUNCTION_LIST BIT_MASK 0x6F /end MEASUREMENT
/begin MEASUREMENT tz_ed_ZYL5 "Eigendiagnose Zuendungsansteuerung" UWORD FORMULA_0017 0 0 0.0 111.0 ECU_ADDRESS 0x3FC0B0 /begin FUNCTION_LIST Zuendung /end FUNCTION_LIST BIT_MASK 0x6F /end MEASUREMENT
/begin MEASUREMENT tz_ed_ZYL6 "Eigendiagnose Zuendungsansteuerung" UWORD FORMULA_0017 0 0 0.0 111.0 ECU_ADDRESS 0x3FC0B2 /begin FUNCTION_LIST Zuendung /end FUNCTION_LIST BIT_MASK 0x6F /end MEASUREMENT
/begin MEASUREMENT tz_ed_ZYL7 "Eigendiagnose Zuendungsansteuerung" UWORD FORMULA_0017 0 0 0.0 111.0 ECU_ADDRESS 0x3FC0B4 /begin FUNCTION_LIST Zuendung /end FUNCTION_LIST BIT_MASK 0x6F /end MEASUREMENT
/begin MEASUREMENT tz_ed_ZYL8 "Eigendiagnose Zuendungsansteuerung" UWORD FORMULA_0017 0 0 0.0 111.0 ECU_ADDRESS 0x3FC0B6 /begin FUNCTION_LIST Zuendung /end FUNCTION_LIST BIT_MASK 0x6F /end MEASUREMENT
/begin MEASUREMENT tz_ed_ZYL9 "Eigendiagnose Zuendungsansteuerung" UWORD FORMULA_0017 0 0 0.0 111.0 ECU_ADDRESS 0x3FC0B8 /begin FUNCTION_LIST Zuendung /end FUNCTION_LIST BIT_MASK 0x6F /end MEASUREMENT
/begin MEASUREMENT tz_ed_ZYL10 "Eigendiagnose Zuendungsansteuerung" UWORD FORMULA_0017 0 0 0.0 111.0 ECU_ADDRESS 0x3FC0BA /begin FUNCTION_LIST Zuendung /end FUNCTION_LIST BIT_MASK 0x6F /end MEASUREMENT
/begin MEASUREMENT tz_ed_ZYL11 "Eigendiagnose Zuendungsansteuerung" UWORD FORMULA_0017 0 0 0.0 111.0 ECU_ADDRESS 0x3FC0BC /begin FUNCTION_LIST Zuendung /end FUNCTION_LIST BIT_MASK 0x6F /end MEASUREMENT
/begin MEASUREMENT tz_ed_ZYL12 "Eigendiagnose Zuendungsansteuerung" UWORD FORMULA_0017 0 0 0.0 111.0 ECU_ADDRESS 0x3FC0BE /begin FUNCTION_LIST Zuendung /end FUNCTION_LIST BIT_MASK 0x6F /end MEASUREMENT
/begin MEASUREMENT tz_ed_IONVERST_B1 "Eigendiagnose Zuendungsansteuerung" UWORD FORMULA_0017 0 0 0.0 111.0 ECU_ADDRESS 0x3FC0C0 /begin FUNCTION_LIST Zuendung /end FUNCTION_LIST BIT_MASK 0x6F /end MEASUREMENT
/begin MEASUREMENT tz_ed_IONSPG_B1 "Eigendiagnose Zuendungsansteuerung" UWORD FORMULA_0017 0 0 0.0 111.0 ECU_ADDRESS 0x3FC0C2 /begin FUNCTION_LIST Zuendung /end FUNCTION_LIST BIT_MASK 0x6F /end MEASUREMENT
/begin MEASUREMENT tz_ed_IONVERST_B2 "Eigendiagnose Zuendungsansteuerung" UWORD FORMULA_0017 0 0 0.0 111.0 ECU_ADDRESS 0x3FC0C4 /begin FUNCTION_LIST Zuendung /end FUNCTION_LIST BIT_MASK 0x6F /end MEASUREMENT
/begin MEASUREMENT tz_ed_IONSPG_B2 "Eigendiagnose Zuendungsansteuerung" UWORD FORMULA_0017 0 0 0.0 111.0 ECU_ADDRESS 0x3FC0C6 /begin FUNCTION_LIST Zuendung /end FUNCTION_LIST BIT_MASK 0x6F /end MEASUREMENT
/* ------------------ Abschnitt erzeugt aus uext.dat ------------------ */
/begin CHARACTERISTIC K_UEXT_TAU "Filterkonstante Versorgungsspannung" VALUE 0x62A68 TKW_VV_VV_UB 100.0 FORMULA_0183 0.0101 2.5600 /begin FUNCTION_LIST Versorgungsspannungen /end FUNCTION_LIST /end CHARACTERISTIC
/begin CHARACTERISTIC K_UEXT_DIAG_MIN "Untere Grenze Versorgungsspannung" VALUE 0x62A6A TKW_VV_VV_UW 100.0 FORMULA_0245 4.0000 5.0000 /begin FUNCTION_LIST Versorgungsspannungen /end FUNCTION_LIST FORMAT "%5.2" /end CHARACTERISTIC
/begin CHARACTERISTIC K_UEXT_DIAG_MAX "Obere Grenze Versorgungsspannung" VALUE 0x62A6C TKW_VV_VV_UW 100.0 FORMULA_0245 5.0000 6.0000 /begin FUNCTION_LIST Versorgungsspannungen /end FUNCTION_LIST FORMAT "%5.2" /end CHARACTERISTIC
/begin CHARACTERISTIC K_UEXT_ERSATZ "Ersatzwert Versorgungsspannung" VALUE 0x62A6E TKW_VV_VV_UW 100.0 FORMULA_0245 4.0000 6.0000 /begin FUNCTION_LIST Versorgungsspannungen /end FUNCTION_LIST FORMAT "%5.2" /end CHARACTERISTIC
/begin MEASUREMENT uext_ad_pin_m18 "AD-Wert Versorgungsspannungen" SWORD FORMULA_0206 0 0 0.0 1023.0000 ECU_ADDRESS 0x3FC0D4 /begin FUNCTION_LIST Versorgungsspannungen /end FUNCTION_LIST /end MEASUREMENT
/begin MEASUREMENT uext_ad_pin_m66 "AD-Wert Versorgungsspannungen" SWORD FORMULA_0206 0 0 0.0 1023.0000 ECU_ADDRESS 0x3FC0D6 /begin FUNCTION_LIST Versorgungsspannungen /end FUNCTION_LIST /end MEASUREMENT
/begin MEASUREMENT uext_ad_pin_f43 "AD-Wert Versorgungsspannungen" SWORD FORMULA_0206 0 0 0.0 1023.0000 ECU_ADDRESS 0x3FC0D8 /begin FUNCTION_LIST Versorgungsspannungen /end FUNCTION_LIST /end MEASUREMENT
/begin MEASUREMENT uext_ad_pin_f56 "AD-Wert Versorgungsspannungen" SWORD FORMULA_0206 0 0 0.0 1023.0000 ECU_ADDRESS 0x3FC0DA /begin FUNCTION_LIST Versorgungsspannungen /end FUNCTION_LIST /end MEASUREMENT
/begin MEASUREMENT uext_roh_pin_m18 "Roh-Wert d. Versorgungsspannungen" UWORD FORMULA_0046 0 0 0.0 6.6665 ECU_ADDRESS 0x3FC0DC /begin FUNCTION_LIST Versorgungsspannungen /end FUNCTION_LIST /end MEASUREMENT
/begin MEASUREMENT uext_roh_pin_m66 "Roh-Wert d. Versorgungsspannungen" UWORD FORMULA_0046 0 0 0.0 6.6665 ECU_ADDRESS 0x3FC0DE /begin FUNCTION_LIST Versorgungsspannungen /end FUNCTION_LIST /end MEASUREMENT
/begin MEASUREMENT uext_roh_pin_f43 "Roh-Wert d. Versorgungsspannungen" UWORD FORMULA_0046 0 0 0.0 6.6665 ECU_ADDRESS 0x3FC0E0 /begin FUNCTION_LIST Versorgungsspannungen /end FUNCTION_LIST /end MEASUREMENT
/begin MEASUREMENT uext_roh_pin_f56 "Roh-Wert d. Versorgungsspannungen" UWORD FORMULA_0046 0 0 0.0 6.6665 ECU_ADDRESS 0x3FC0E2 /begin FUNCTION_LIST Versorgungsspannungen /end FUNCTION_LIST /end MEASUREMENT
/* ------------------ Abschnitt erzeugt aus zust_ign.dat ------------------ */
/begin MEASUREMENT zustand_motor_ign "Betriebszustand der Motorsteuerung" UWORD FORMULA_0021 0 0 0.0 65535.0 ECU_ADDRESS 0x3FC0E8 /begin FUNCTION_LIST Zustand /end FUNCTION_LIST /end MEASUREMENT
/begin FUNCTION Kuehleraustrittstemperatur "Kuehleraustrittstemperatur" /end FUNCTION
/begin FUNCTION Leerlaufregler "Leerlaufregler" /end FUNCTION
/begin FUNCTION Luftmasse "Luftmasse" /end FUNCTION
/begin FUNCTION Momentenmanager "Momentenmanager" /end FUNCTION
/begin FUNCTION Motortemperatur "Motortemperatur" /end FUNCTION
/begin FUNCTION PCTRL "PCTRL" /end FUNCTION
/begin FUNCTION Pedalwertgeber "Pedalwertgeber" /end FUNCTION
/begin FUNCTION SG-Konfiguration "SG-Konfiguration" /end FUNCTION
/begin FUNCTION Saugrohtwandtemperatur "Saugrohtwandtemperatur" /end FUNCTION
/begin FUNCTION Schalter "Schalter" /end FUNCTION
/begin FUNCTION Startrelais "Startrelais" /end FUNCTION
/begin FUNCTION Steuergeraetetemperatur "Steuergeraetetemperatur" /end FUNCTION
/begin FUNCTION TPU "TPU" /end FUNCTION
/begin FUNCTION TPU_Interface "TPU_Interface" /end FUNCTION
/begin FUNCTION Taskmonitor "Taskmonitor" /end FUNCTION
/begin FUNCTION Version "Version" /end FUNCTION
/begin FUNCTION Versorgungsspannungen "Versorgungsspannungen" /end FUNCTION
/begin FUNCTION Zuendung "Zuendung" /end FUNCTION
/begin FUNCTION Zustand "Zustand" /end FUNCTION
/begin FUNCTION debug "debug" /end FUNCTION
/begin FUNCTION diag_tr_ign "diag_tr_ign" /end FUNCTION
/begin FUNCTION os "os" /end FUNCTION
/begin FUNCTION spi "spi" /end FUNCTION
/begin FUNCTION sys_zust "sys_zust" /end FUNCTION
/begin RECORD_LAYOUT TKW_VV_VV_UB FNC_VALUES 1 UBYTE COLUMN_DIR DIRECT /end RECORD_LAYOUT
/begin RECORD_LAYOUT TKW_VV_VV_UW FNC_VALUES 1 UWORD COLUMN_DIR DIRECT /end RECORD_LAYOUT
/begin RECORD_LAYOUT TKW_VV_VV_SW FNC_VALUES 1 SWORD COLUMN_DIR DIRECT /end RECORD_LAYOUT
/begin RECORD_LAYOUT TKL_UW_VV_UW NO_AXIS_PTS_X 1 UBYTE RESERVED 2 BYTE AXIS_PTS_X 3 UWORD INDEX_INCR DIRECT FNC_VALUES 4 UWORD COLUMN_DIR DIRECT /end RECORD_LAYOUT
/begin RECORD_LAYOUT TKL_SW_VV_UW NO_AXIS_PTS_X 1 UBYTE RESERVED 2 BYTE AXIS_PTS_X 3 SWORD INDEX_INCR DIRECT FNC_VALUES 4 UWORD COLUMN_DIR DIRECT /end RECORD_LAYOUT
/begin RECORD_LAYOUT TKL_SW_VV_SW NO_AXIS_PTS_X 1 UBYTE RESERVED 2 BYTE AXIS_PTS_X 3 SWORD INDEX_INCR DIRECT FNC_VALUES 4 SWORD COLUMN_DIR DIRECT /end RECORD_LAYOUT
/begin RECORD_LAYOUT TKF_SW_SW_SW NO_AXIS_PTS_X 1 UBYTE NO_AXIS_PTS_Y 2 UBYTE AXIS_PTS_X 3 SWORD INDEX_INCR DIRECT AXIS_PTS_Y 4 SWORD INDEX_INCR DIRECT FNC_VALUES 5 SWORD COLUMN_DIR DIRECT /end RECORD_LAYOUT
/end MODULE
/end PROJECT
