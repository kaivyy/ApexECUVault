ASAP2_VERSION 1 41
/begin PROJECT MSD70 "Spray Guided DI-System with Piezo Injectors for 6-Cylinder"
/begin HEADER "_default_HeaderComment" PROJECT_NO _0B /end HEADER
/begin MODULE _default_ModuleName "_default_ModuleLongIdentifier"
/begin MOD_COMMON "_default_ModCommonComment" DEPOSIT ABSOLUTE BYTE_ORDER MSB_LAST ALIGNMENT_BYTE 1 ALIGNMENT_WORD 2 ALIGNMENT_LONG 2 ALIGNMENT_FLOAT32_IEEE 2 ALIGNMENT_FLOAT64_IEEE 4 /end MOD_COMMON
/begin CHARACTERISTIC c_abc_max_dmtlh "Maximum value of the anti - bounce counter" VALUE 0xa1029109 _REC_VAL_20_u1 254. _CNV_A_R_LINEAR_____0_CM 1. 255. DISPLAY_IDENTIFIER C_ABC_MAX_DMTLH FORMAT "%3.0" /end CHARACTERISTIC
/begin CHARACTERISTIC c_abc_inc_dmtlh "Anti - bounce counter increment" VALUE 0xa102907e _REC_VAL_20_u1 255. _CNV_A_R_LINEAR_____0_CM 0. 255. DISPLAY_IDENTIFIER C_ABC_INC_DMTLH FORMAT "%3.0" /end CHARACTERISTIC
/begin MEASUREMENT cdn_diag_dmtlh "Diagnosis conditions forDMTL Heater" UBYTE _CNV_A_R_LINEAR_____0_CM 1 100. 0. 255. DISPLAY_IDENTIFIER CDN_DIAG_DMTLH ECU_ADDRESS 0xc0000580 FORMAT "%3.0" /end MEASUREMENT
/begin MEASUREMENT lv_err_dmtlh "Logical value for DMTL heater stage error" UBYTE _CNV_S_2_RANGE__0___1_CM 1 100. 0. 1. DISPLAY_IDENTIFIER LV_ERR_DMTLH ECU_ADDRESS 0xd0003444 BIT_MASK 0x1 /end MEASUREMENT
/begin MEASUREMENT lv_inh_diag_dmtlh "DMTL heater diagnosis: application incidence to inhibit the diagnosis" UBYTE _CNV_S_2_RANGE__0___1_CM 1 100. 0. 1. DISPLAY_IDENTIFIER LV_INH_DIAG_DMTLH ECU_ADDRESS 0xd0003e04 BIT_MASK 0x1 /end MEASUREMENT
/begin CHARACTERISTIC c_abc_inc_dmtl_pump "Anti - bounce counter increment" VALUE 0xa102907d _REC_VAL_20_u1 255. _CNV_A_R_LINEAR_____0_CM 0. 255. DISPLAY_IDENTIFIER C_ABC_INC_DMTL_PUMP FORMAT "%3.0" /end CHARACTERISTIC
/begin CHARACTERISTIC c_v_dmtl_max_diag "threshold voltage to recognise short to battery" VALUE 0xa1029b5a _REC_VAL_20_u2 0.49951171875 _CNV_A_R_LINEAR_____2_CM 0. 4.9951171875 DISPLAY_IDENTIFIER C_V_DMTL_MAX_DIAG FORMAT "%5.3" /end CHARACTERISTIC
/begin CHARACTERISTIC c_abc_max_dmtl_pump "Debounce counter maximum value" VALUE 0xa1029108 _REC_VAL_20_u1 254. _CNV_A_R_LINEAR_____0_CM 1. 255. DISPLAY_IDENTIFIER C_ABC_MAX_DMTL_PUMP FORMAT "%3.0" /end CHARACTERISTIC
/begin CHARACTERISTIC c_t_v_dmtl_max_diag "bounce time for recognise short to battery" VALUE 0xa102998f _REC_VAL_20_u1 0.254 _CNV_A_R_LINEAR_____3_CM 1.e-002 2.55 DISPLAY_IDENTIFIER C_T_V_DMTL_MAX_DIAG FORMAT "%4.2" /end CHARACTERISTIC
/begin MEASUREMENT cdn_diag_dmtl_pump "Diagnosis conditions for DMTL Pump" UBYTE _CNV_A_R_LINEAR_____0_CM 1 100. 0. 255. DISPLAY_IDENTIFIER CDN_DIAG_DMTL_PUMP ECU_ADDRESS 0xc0000584 FORMAT "%3.0" /end MEASUREMENT
/begin MEASUREMENT lv_err_dmtl_pump "Error flag, DMTL pump" UBYTE _CNV_S_2_RANGE__0___1_CM 1 100. 0. 1. DISPLAY_IDENTIFIER LV_ERR_DMTL_PUMP ECU_ADDRESS 0xd0003435 BIT_MASK 0x1 /end MEASUREMENT
/begin MEASUREMENT lv_inh_diag_dmtl_pump "DMTL pump diagnosis: application incidence to inhibit the diagnosis" UBYTE _CNV_S_2_RANGE__0___1_CM 1 100. 0. 1. DISPLAY_IDENTIFIER LV_INH_DIAG_DMTL_PUMP ECU_ADDRESS 0xd0003e00 BIT_MASK 0x1 /end MEASUREMENT
/begin MEASUREMENT t_v_dmtl_max_diag "debouince time" UBYTE _CNV_A_R_LINEAR_____3_CM 1 100. 0. 2.55 DISPLAY_IDENTIFIER T_V_DMTL_MAX_DIAG ECU_ADDRESS 0xc0000586 FORMAT "%4.2" /end MEASUREMENT
/begin CHARACTERISTIC c_abc_inc_dmtls "Anti - bounce counter increment" VALUE 0xa102907f _REC_VAL_20_u1 255. _CNV_A_R_LINEAR_____0_CM 0. 255. DISPLAY_IDENTIFIER C_ABC_INC_DMTLS FORMAT "%3.0" /end CHARACTERISTIC
/begin CHARACTERISTIC c_abc_max_dmtls "Debounce counter maximum value" VALUE 0xa102910a _REC_VAL_20_u1 254. _CNV_A_R_LINEAR_____0_CM 1. 255. DISPLAY_IDENTIFIER C_ABC_MAX_DMTLS FORMAT "%3.0" /end CHARACTERISTIC
/begin MEASUREMENT cdn_diag_dmtls "Diagnosis conditions for DMTL change over  Valve" UBYTE _CNV_A_R_LINEAR_____0_CM 1 100. 0. 255. DISPLAY_IDENTIFIER CDN_DIAG_DMTLS ECU_ADDRESS 0xc0000588 FORMAT "%3.0" /end MEASUREMENT
/begin MEASUREMENT lv_inh_diag_dmtls "DMTL change-over valve diagnosis: application incidence to inhibit the diagnosis" UBYTE _CNV_S_2_RANGE__0___1_CM 1 100. 0. 1. DISPLAY_IDENTIFIER LV_INH_DIAG_DMTLS ECU_ADDRESS 0xd0003dfc BIT_MASK 0x1 /end MEASUREMENT
/begin MEASUREMENT lv_err_dmtls "Error flag, DMTL change-over valve" UBYTE _CNV_S_2_RANGE__0___1_CM 1 100. 0. 1. DISPLAY_IDENTIFIER LV_ERR_DMTLS ECU_ADDRESS 0xd0003434 BIT_MASK 0x1 /end MEASUREMENT
/begin CHARACTERISTIC c_abc_inc_rly_accout "Debounce counter increment- RLY_ACCOUT diagnosis" VALUE 0xa10290ac _REC_VAL_20_u1 255. _CNV_A_R_LINEAR_____0_CM 0. 255. DISPLAY_IDENTIFIER C_ABC_INC_RLY_ACCOUT FORMAT "%3.0" /end CHARACTERISTIC
/begin CHARACTERISTIC c_abc_max_rly_accout "Debounce counter maximum value - RLY_ACCOUT diagnosis" VALUE 0xa1029138 _REC_VAL_20_u1 254. _CNV_A_R_LINEAR_____0_CM 1. 255. DISPLAY_IDENTIFIER C_ABC_MAX_RLY_ACCOUT FORMAT "%3.0" /end CHARACTERISTIC
/begin MEASUREMENT cdn_diag_rly_accout "Diagnosis conditions for ACC Relay" UBYTE _CNV_A_R_LINEAR_____0_CM 1 100. 0. 255. DISPLAY_IDENTIFIER CDN_DIAG_RLY_ACCOUT ECU_ADDRESS 0xc0000064 FORMAT "%3.0" /end MEASUREMENT
/begin MEASUREMENT lv_err_rly_accout "Status air condition compressor relay diagnosis" UBYTE _CNV_S_2_RANGE__0___1_CM 1 100. 0. 1. DISPLAY_IDENTIFIER LV_ERR_RLY_ACCOUT ECU_ADDRESS 0xd000341c BIT_MASK 0x1 /end MEASUREMENT
/begin MEASUREMENT lv_inh_diag_rly_accout "Diagnosis inhibition RLY_ACCOUT_diagnosis" UBYTE _CNV_S_2_RANGE__0___1_CM 1 100. 0. 1. DISPLAY_IDENTIFIER LV_INH_DIAG_RLY_ACCOUT ECU_ADDRESS 0xd0003e0c BIT_MASK 0x1 /end MEASUREMENT
/begin CHARACTERISTIC c_abc_max_ebox_cfa "Debounce counter maximum value" VALUE 0xa102910b _REC_VAL_20_u1 254. _CNV_A_R_LINEAR_____0_CM 1. 255. DISPLAY_IDENTIFIER C_ABC_MAX_EBOX_CFA FORMAT "%3.0" /end CHARACTERISTIC
/begin CHARACTERISTIC c_abc_inc_ebox_cfa "Debounce counter increment" VALUE 0xa1029080 _REC_VAL_20_u1 255. _CNV_A_R_LINEAR_____0_CM 0. 255. DISPLAY_IDENTIFIER C_ABC_INC_EBOX_CFA FORMAT "%3.0" /end CHARACTERISTIC
/begin MEASUREMENT cdn_diag_ebox_cfa "Diagnosis conditions for E-Box Cooling FAN" UBYTE _CNV_A_R_LINEAR_____0_CM 1 100. 0. 255. DISPLAY_IDENTIFIER CDN_DIAG_EBOX_CFA ECU_ADDRESS 0xc0000598 FORMAT "%3.0" /end MEASUREMENT
/begin MEASUREMENT lv_err_ebox_cfa "Logical value for EBOX CFA error" UBYTE _CNV_S_2_RANGE__0___1_CM 1 100. 0. 1. DISPLAY_IDENTIFIER LV_ERR_EBOX_CFA ECU_ADDRESS 0xd000342f BIT_MASK 0x1 /end MEASUREMENT
/begin CHARACTERISTIC c_abc_max_ef "Debounce counter maximum value" VALUE 0xa102910d _REC_VAL_20_u1 254. _CNV_A_R_LINEAR_____0_CM 1. 255. DISPLAY_IDENTIFIER C_ABC_MAX_EF FORMAT "%3.0" /end CHARACTERISTIC
/begin CHARACTERISTIC c_abc_inc_ef "Debounce counter increment" VALUE 0xa1029082 _REC_VAL_20_u1 255. _CNV_A_R_LINEAR_____0_CM 0. 255. DISPLAY_IDENTIFIER C_ABC_INC_EF FORMAT "%3.0" /end CHARACTERISTIC
/begin MEASUREMENT cdn_diag_ef "Diagnosis conditions for Exhaust Flap" UBYTE _CNV_A_R_LINEAR_____0_CM 1 100. 0. 255. DISPLAY_IDENTIFIER CDN_DIAG_EF ECU_ADDRESS 0xc00005f0 FORMAT "%3.0" /end MEASUREMENT
/begin MEASUREMENT lv_err_ef "Logical value for exhaust flap power stage error" UBYTE _CNV_S_2_RANGE__0___1_CM 1 100. 0. 1. DISPLAY_IDENTIFIER LV_ERR_EF ECU_ADDRESS 0xd000342d BIT_MASK 0x1 /end MEASUREMENT
/begin MEASUREMENT lv_inh_diag_ef "Exhaust Flap diagnosis: application incidence to inhibit the diagnosis" UBYTE _CNV_S_2_RANGE__0___1_CM 1 100. 0. 1. DISPLAY_IDENTIFIER LV_INH_DIAG_EF ECU_ADDRESS 0xd0003df4 BIT_MASK 0x1 /end MEASUREMENT
/begin CHARACTERISTIC c_abc_inc_ecras_el "Antibounce counter increment" VALUE 0xa1029081 _REC_VAL_20_u1 255. _CNV_A_R_LINEAR_____0_CM 0. 255. DISPLAY_IDENTIFIER C_ABC_INC_ECRAS_EL FORMAT "%3.0" /end CHARACTERISTIC
/begin CHARACTERISTIC c_abc_max_ecras_el "Maximum value for antibounce counter" VALUE 0xa102910c _REC_VAL_20_u1 254. _CNV_A_R_LINEAR_____0_CM 1. 255. DISPLAY_IDENTIFIER C_ABC_MAX_ECRAS_EL FORMAT "%3.0" /end CHARACTERISTIC
/begin MEASUREMENT lv_err_rly_st "Status of starter output diagnosis" UBYTE _CNV_S_2_RANGE__0___1_CM 1 100. 0. 1. DISPLAY_IDENTIFIER LV_ERR_RLY_ST ECU_ADDRESS 0xd000343d BIT_MASK 0x1 /end MEASUREMENT
/begin CHARACTERISTIC c_abc_inc_rly_st "anti-bounce increment value" VALUE 0xa10290b0 _REC_VAL_20_u1 255. _CNV_A_R_LINEAR_____0_CM 0. 255. DISPLAY_IDENTIFIER C_ABC_INC_RLY_ST FORMAT "%3.0" /end CHARACTERISTIC
/begin CHARACTERISTIC c_abc_max_rly_st "anti-bounce maximum value" VALUE 0xa102913c _REC_VAL_20_u1 254. _CNV_A_R_LINEAR_____0_CM 1. 255. DISPLAY_IDENTIFIER C_ABC_MAX_RLY_ST FORMAT "%3.0" /end CHARACTERISTIC
/begin MEASUREMENT cdn_diag_rly_st "Activation conditions for starter relay" UBYTE _CNV_A_R_LINEAR_____0_CM 1 100. 0. 255. DISPLAY_IDENTIFIER CDN_DIAG_RLY_ST ECU_ADDRESS 0xc0000b9c FORMAT "%3.0" /end MEASUREMENT
/begin MEASUREMENT lv_inh_diag_rly_st "Inhibit diagnosis starter relay" UBYTE _CNV_S_2_RANGE__0___1_CM 1 100. 0. 1. DISPLAY_IDENTIFIER LV_INH_DIAG_RLY_ST ECU_ADDRESS 0xd0003e08 BIT_MASK 0x1 /end MEASUREMENT
/begin CHARACTERISTIC c_abc_max_slv_ivvt "Debounce counter maximum value - VANOS diagnosis magnetic valves" VALUE 0xa102913e _REC_VAL_20_u1 254. _CNV_A_R_LINEAR_____0_CM 1. 255. DISPLAY_IDENTIFIER C_ABC_MAX_SLV_IVVT FORMAT "%3.0" /end CHARACTERISTIC
/begin CHARACTERISTIC c_abc_inc_slv_ivvt "Debounce counter increment - VANOS diagnosis magnetic valve CAM_IN" VALUE 0xa10290b2 _REC_VAL_20_u1 255. _CNV_A_R_LINEAR_____0_CM 0. 255. DISPLAY_IDENTIFIER C_ABC_INC_SLV_IVVT FORMAT "%3.0" /end CHARACTERISTIC
/begin MEASUREMENT lv_err_rly_efp "Boolean for error currently present on RLY_EFP" UBYTE _CNV_S_2_RANGE__0___1_CM 1 100. 0. 1. DISPLAY_IDENTIFIER LV_ERR_RLY_EFP ECU_ADDRESS 0xd00033c6 BIT_MASK 0x1 /end MEASUREMENT
/begin CHARACTERISTIC c_abc_inc_rly_efp "Debounce counter increment RLY_EFP" VALUE 0xa10290ae _REC_VAL_20_u1 255. _CNV_A_R_LINEAR_____0_CM 0. 255. DISPLAY_IDENTIFIER C_ABC_INC_RLY_EFP FORMAT "%3.0" /end CHARACTERISTIC
/begin CHARACTERISTIC c_abc_max_rly_efp "Debounce counter maximum value RLY_EFP" VALUE 0xa102913a _REC_VAL_20_u1 254. _CNV_A_R_LINEAR_____0_CM 1. 255. DISPLAY_IDENTIFIER C_ABC_MAX_RLY_EFP FORMAT "%3.0" /end CHARACTERISTIC
/begin MEASUREMENT cdn_diag_rly_efp "Activation conditions for fuel pump relay" UBYTE _CNV_A_R_LINEAR_____0_CM 1 100. 0. 255. DISPLAY_IDENTIFIER CDN_DIAG_RLY_EFP ECU_ADDRESS 0xc00005ec FORMAT "%3.0" /end MEASUREMENT
/begin MEASUREMENT lv_inh_diag_rly_efp "Inhibit diagnosis fuel pump relay" UBYTE _CNV_S_2_RANGE__0___1_CM 1 100. 0. 1. DISPLAY_IDENTIFIER LV_INH_DIAG_RLY_EFP ECU_ADDRESS 0xd0003df0 BIT_MASK 0x1 /end MEASUREMENT
/begin MEASUREMENT er_mmv_is_diag[0] "Filtered engine roughness value cylinder individual" SWORD _CNV_A_R_LINEAR_____11_CM 1 100. -8. 7.99975586 DISPLAY_IDENTIFIER ER_MMV_IS_DIAG[0] ECU_ADDRESS 0xd000509c FORMAT "%7.4" /end MEASUREMENT
/begin MEASUREMENT er_mmv_is_diag[1] "Filtered engine roughness value cylinder individual" SWORD _CNV_A_R_LINEAR_____11_CM 1 100. -8. 7.99975586 DISPLAY_IDENTIFIER ER_MMV_IS_DIAG[1] ECU_ADDRESS 0xd000509e FORMAT "%7.4" /end MEASUREMENT
/begin MEASUREMENT er_mmv_is_diag[2] "Filtered engine roughness value cylinder individual" SWORD _CNV_A_R_LINEAR_____11_CM 1 100. -8. 7.99975586 DISPLAY_IDENTIFIER ER_MMV_IS_DIAG[2] ECU_ADDRESS 0xd00050a0 FORMAT "%7.4" /end MEASUREMENT
/begin MEASUREMENT er_mmv_is_diag[3] "Filtered engine roughness value cylinder individual" SWORD _CNV_A_R_LINEAR_____11_CM 1 100. -8. 7.99975586 DISPLAY_IDENTIFIER ER_MMV_IS_DIAG[3] ECU_ADDRESS 0xd00050a2 FORMAT "%7.4" /end MEASUREMENT
/begin MEASUREMENT er_mmv_is_diag[4] "Filtered engine roughness value cylinder individual" SWORD _CNV_A_R_LINEAR_____11_CM 1 100. -8. 7.99975586 DISPLAY_IDENTIFIER ER_MMV_IS_DIAG[4] ECU_ADDRESS 0xd00050a4 FORMAT "%7.4" /end MEASUREMENT
/begin MEASUREMENT er_mmv_is_diag[5] "Filtered engine roughness value cylinder individual" SWORD _CNV_A_R_LINEAR_____11_CM 1 100. -8. 7.99975586 DISPLAY_IDENTIFIER ER_MMV_IS_DIAG[5] ECU_ADDRESS 0xd00050a6 FORMAT "%7.4" /end MEASUREMENT
/begin CHARACTERISTIC ip_thd_is_er_diag__n__maf "ER reference value for ER diagnosis" MAP 0xa1027e64 _REC_MAP_20_u2_u2_u1 -32766. _CNV_A_R_LINEAR_____12_CM -1. -32767. DISPLAY_IDENTIFIER IP_THD_IS_ER_DIAG__N__MAF FORMAT "%7.0"
 /begin AXIS_DESCR COM_AXIS n _CNV_A_R_LINEAR_____13_CM 4 0. 8160. FORMAT "%4.0" AXIS_PTS_REF ldp_n__thd_is_er_diag /end AXIS_DESCR
 /begin AXIS_DESCR COM_AXIS maf _CNV_A_R_LINEAR_____14_CM 4 0. 1389. FORMAT "%4.0" AXIS_PTS_REF ldp_maf__thd_is_er_diag /end AXIS_DESCR
/end CHARACTERISTIC
/begin CHARACTERISTIC ip_fac_thd_is_er_diag__tco "TCO-dependent reference value correction" CURVE 0xa10240f4 _REC_CUR_20_u1_u1 0.9922 _CNV_A_R_LINEAR_____15_CM 1. 1.9922 DISPLAY_IDENTIFIER IP_FAC_THD_IS_ER_DIAG__TCO FORMAT "%5.3"
 /begin AXIS_DESCR COM_AXIS tco _CNV_A_R_LINEAR_____16_CM 8 -48. 142.5 FORMAT "%5.1" AXIS_PTS_REF ldp_tco__fac_thd_is_er_diag /end AXIS_DESCR
/end CHARACTERISTIC
/begin CHARACTERISTIC c_crlc_is_er_diag "Correlation constant for calculating the ER diagnostic values" VALUE 0xa1029200 _REC_VAL_20_u1 0.99610001 _CNV_A_R_LINEAR_____17_CM 0. 0.99610001 DISPLAY_IDENTIFIER C_CRLC_IS_ER_DIAG FORMAT "%5.3" /end CHARACTERISTIC
/begin AXIS_PTS ldp_maf__thd_is_er_diag "" 0xa1020c5a maf _REC_AXS_20_u1 1389. _CNV_A_R_LINEAR_____14_CM 4 0. 1389. FORMAT "%4.0" /end AXIS_PTS
/begin AXIS_PTS ldp_n__thd_is_er_diag "" 0xa1020ec8 n _REC_AXS_20_u2 816. _CNV_A_R_LINEAR_____13_CM 4 0. 8160. FORMAT "%4.0" /end AXIS_PTS
/begin AXIS_PTS ldp_tco__fac_thd_is_er_diag "" 0xa1021278 tco _REC_AXS_20_u1 190.5 _CNV_A_R_LINEAR_____16_CM 8 -48. 142.5 FORMAT "%5.1" /end AXIS_PTS
/begin CHARACTERISTIC c_tout_imob "" VALUE 0xa1029a8c _REC_VAL_20_u1 25.4 _CNV_A_R_LINEAR_____4_CM 0.1 25.5 DISPLAY_IDENTIFIER C_TOUT_IMOB FORMAT "%4.1" /end CHARACTERISTIC
/begin CHARACTERISTIC c_abc_inc_imob_2 "" VALUE 0xa102908f _REC_VAL_20_u1 254. _CNV_A_R_LINEAR_____0_CM 1. 255. DISPLAY_IDENTIFIER C_ABC_INC_IMOB_2 FORMAT "%3.0" /end CHARACTERISTIC
/begin CHARACTERISTIC c_abc_inc_imob_1 "" VALUE 0xa102908e _REC_VAL_20_u1 254. _CNV_A_R_LINEAR_____0_CM 1. 255. DISPLAY_IDENTIFIER C_ABC_INC_IMOB_1 FORMAT "%3.0" /end CHARACTERISTIC
/begin CHARACTERISTIC c_abc_max_imob_2 "" VALUE 0xa102911a _REC_VAL_20_u1 254. _CNV_A_R_LINEAR_____0_CM 1. 255. DISPLAY_IDENTIFIER C_ABC_MAX_IMOB_2 FORMAT "%3.0" /end CHARACTERISTIC
/begin CHARACTERISTIC c_abc_max_imob_1 "" VALUE 0xa1029119 _REC_VAL_20_u1 254. _CNV_A_R_LINEAR_____0_CM 1. 255. DISPLAY_IDENTIFIER C_ABC_MAX_IMOB_1 FORMAT "%3.0" /end CHARACTERISTIC
/begin MEASUREMENT lv_err_imob_2 "" UBYTE _CNV_S_2_RANGE__0___1_CM 1 100. 0. 1. DISPLAY_IDENTIFIER LV_ERR_IMOB_2 ECU_ADDRESS 0xd00033ae BIT_MASK 0x1 /end MEASUREMENT
/begin MEASUREMENT lv_err_imob_1 "" UBYTE _CNV_S_2_RANGE__0___1_CM 1 100. 0. 1. DISPLAY_IDENTIFIER LV_ERR_IMOB_1 ECU_ADDRESS 0xd00033ad BIT_MASK 0x1 /end MEASUREMENT
/begin MEASUREMENT lv_err_imob_3 "" UBYTE _CNV_S_2_RANGE__0___1_CM 1 100. 0. 1. DISPLAY_IDENTIFIER LV_ERR_IMOB_3 ECU_ADDRESS 0xd00033af BIT_MASK 0x1 /end MEASUREMENT
/begin MEASUREMENT lv_lock_imob "Locking of ign and inj by imob" UBYTE _CNV_S_2_RANGE__0___1_CM 1 100. 0. 1. DISPLAY_IDENTIFIER LV_LOCK_IMOB ECU_ADDRESS 0xd0003a28 BIT_MASK 0x1 /end MEASUREMENT
/begin MEASUREMENT inh_iv_imob "Locking request for inj by imob" UBYTE _CNV_A_R_LINEAR_____0_CM 1 100. 0. 255. DISPLAY_IDENTIFIER INH_IV_IMOB ECU_ADDRESS 0xd0003a1e FORMAT "%3.0" BIT_MASK 0x1 /end MEASUREMENT
/begin MEASUREMENT ctr_err_imob_2 "Error counter of diagnosis imob_2 diagnosis" UBYTE _CNV_A_R_LINEAR_____0_CM 1 100. 0. 255. DISPLAY_IDENTIFIER CTR_ERR_IMOB_2 ECU_ADDRESS 0xd0003a16 FORMAT "%3.0" /end MEASUREMENT
/begin MEASUREMENT ctr_err_imob_1 "Error counter of diagnosis imob_1 diagnosis" UBYTE _CNV_A_R_LINEAR_____0_CM 1 100. 0. 255. DISPLAY_IDENTIFIER CTR_ERR_IMOB_1 ECU_ADDRESS 0xd0003a15 FORMAT "%3.0" /end MEASUREMENT
/begin CHARACTERISTIC c_vb_min_msw_diag "Min. battery voltage for MSW diagnosis" VALUE 0xa1029bdf _REC_VAL_20_u1 25.8984 _CNV_A_R_LINEAR_____21_CM 0. 25.8984 DISPLAY_IDENTIFIER C_VB_MIN_MSW_DIAG FORMAT "%3.1" /end CHARACTERISTIC
/begin CHARACTERISTIC c_amp_ref "reference value of the ambient pressure" VALUE 0xa102919a _REC_VAL_20_u2 5434. _CNV_A_R_LINEAR_____26_CM 0. 5434. DISPLAY_IDENTIFIER C_AMP_REF FORMAT "%7.2" /end CHARACTERISTIC
/begin CHARACTERISTIC c_v_amp_max_diag "maximum diagnostic value for the ambient pressure value" VALUE 0xa1029b52 _REC_VAL_20_u2 4.9951171875 _CNV_A_R_LINEAR_____2_CM 0. 4.9951171875 DISPLAY_IDENTIFIER C_V_AMP_MAX_DIAG FORMAT "%5.3" /end CHARACTERISTIC
/begin CHARACTERISTIC c_v_amp_min_diag "minimum diagnostic value for the ambient pressure value" VALUE 0xa1029b54 _REC_VAL_20_u2 4.9951171875 _CNV_A_R_LINEAR_____2_CM 0. 4.9951171875 DISPLAY_IDENTIFIER C_V_AMP_MIN_DIAG FORMAT "%5.3" /end CHARACTERISTIC
/begin CHARACTERISTIC c_abc_inc_amp "Anti - bounce counter increment" VALUE 0xa1029052 _REC_VAL_20_u1 255. _CNV_A_R_LINEAR_____0_CM 0. 255. DISPLAY_IDENTIFIER C_ABC_INC_AMP FORMAT "%3.0" /end CHARACTERISTIC
/begin CHARACTERISTIC c_abc_max_amp "Maximum value of the anti - bounce counter" VALUE 0xa10290dd _REC_VAL_20_u1 254. _CNV_A_R_LINEAR_____0_CM 1. 255. DISPLAY_IDENTIFIER C_ABC_MAX_AMP FORMAT "%3.0" /end CHARACTERISTIC
/begin MEASUREMENT lv_err_amp "AMP error present" UBYTE _CNV_S_2_RANGE__0___1_CM 1 100. 0. 1. DISPLAY_IDENTIFIER LV_ERR_AMP ECU_ADDRESS 0xd00033bd BIT_MASK 0x1 /end MEASUREMENT
/begin MEASUREMENT lv_brake_det "LV_IM_BLS or _BTS detected" UBYTE _CNV_S_2_RANGE__0___1_CM 1 100. 0. 1. DISPLAY_IDENTIFIER LV_BRAKE_DET ECU_ADDRESS 0xd0003b5d BIT_MASK 0x1 /end MEASUREMENT
/begin CHARACTERISTIC c_t_bts_plaus_max "Maximum value of the time counter for debounce  " VALUE 0xa1029818 _REC_VAL_20_u2 6553.5 _CNV_A_R_LINEAR_____4_CM 0. 6553.5 DISPLAY_IDENTIFIER C_T_BTS_PLAUS_MAX FORMAT "%6.1" /end CHARACTERISTIC
/begin MEASUREMENT lv_err_bls_plaus "BLS plausibility error flag" UBYTE _CNV_S_2_RANGE__0___1_CM 1 100. 0. 1. DISPLAY_IDENTIFIER LV_ERR_BLS_PLAUS ECU_ADDRESS 0xd0003b5c BIT_MASK 0x1 /end MEASUREMENT
/begin CHARACTERISTIC c_abc_inc_im_bts_plaus "BTS debounce counter increment  " VALUE 0xa102908d _REC_VAL_20_u1 255. _CNV_A_R_LINEAR_____0_CM 0. 255. DISPLAY_IDENTIFIER C_ABC_INC_IM_BTS_PLAUS FORMAT "%3.0" /end CHARACTERISTIC
/begin CHARACTERISTIC c_abc_inc_im_bls_plaus "BLS debounce counter increment  " VALUE 0xa102908c _REC_VAL_20_u1 255. _CNV_A_R_LINEAR_____0_CM 0. 255. DISPLAY_IDENTIFIER C_ABC_INC_IM_BLS_PLAUS FORMAT "%3.0" /end CHARACTERISTIC
/begin CHARACTERISTIC c_abc_max_im_bts_plaus "BTS debounce counter maximum value, error debounce" VALUE 0xa1029118 _REC_VAL_20_u1 254. _CNV_A_R_LINEAR_____0_CM 1. 255. DISPLAY_IDENTIFIER C_ABC_MAX_IM_BTS_PLAUS FORMAT "%3.0" /end CHARACTERISTIC
/begin CHARACTERISTIC c_abc_max_im_bls_plaus "BLS debounce counter maximum value" VALUE 0xa1029117 _REC_VAL_20_u1 254. _CNV_A_R_LINEAR_____0_CM 1. 255. DISPLAY_IDENTIFIER C_ABC_MAX_IM_BLS_PLAUS FORMAT "%3.0" /end CHARACTERISTIC
/begin MEASUREMENT lv_err_im_bls_plaus "BLS plausibility error flag" UBYTE _CNV_S_2_RANGE__0___1_CM 1 100. 0. 1. DISPLAY_IDENTIFIER LV_ERR_IM_BLS_PLAUS ECU_ADDRESS 0xd000341e BIT_MASK 0x1 /end MEASUREMENT
/begin MEASUREMENT lv_err_im_bts_plaus "BTS plausibility error flag" UBYTE _CNV_S_2_RANGE__0___1_CM 1 100. 0. 1. DISPLAY_IDENTIFIER LV_ERR_IM_BTS_PLAUS ECU_ADDRESS 0xd000341f BIT_MASK 0x1 /end MEASUREMENT
/begin MEASUREMENT lv_bts_edge "rising or falling edge of lv_im_bts" UBYTE _CNV_S_2_RANGE__0___1_CM 1 100. 0. 1. DISPLAY_IDENTIFIER LV_BTS_EDGE ECU_ADDRESS 0xc00000a2 BIT_MASK 0x1 /end MEASUREMENT
/begin MEASUREMENT lv_bls_edge "rising or falling edge of lv_im_bls" UBYTE _CNV_S_2_RANGE__0___1_CM 1 100. 0. 1. DISPLAY_IDENTIFIER LV_BLS_EDGE ECU_ADDRESS 0xc00000a1 BIT_MASK 0x1 /end MEASUREMENT
/begin MEASUREMENT t_bts_plaus "timer for debounce by error managment" UWORD _CNV_A_R_LINEAR_____4_CM 1 100. 0. 6553.5 DISPLAY_IDENTIFIER T_BTS_PLAUS ECU_ADDRESS 0xc0000098 FORMAT "%6.1" /end MEASUREMENT
/begin CHARACTERISTIC c_abc_inc_bn_tq_dcc "Anti - bounce counter increment BN2000 Diagnosis" VALUE 0xa102906d _REC_VAL_20_u1 255. _CNV_A_R_LINEAR_____0_CM 0. 255. DISPLAY_IDENTIFIER C_ABC_INC_BN_TQ_DCC FORMAT "%3.0" /end CHARACTERISTIC
/begin CHARACTERISTIC c_abc_inc_bn_tq_tcs "Anti - bounce counter increment BN2000 Diagnosis" VALUE 0xa1029070 _REC_VAL_20_u1 255. _CNV_A_R_LINEAR_____0_CM 0. 255. DISPLAY_IDENTIFIER C_ABC_INC_BN_TQ_TCS FORMAT "%3.0" /end CHARACTERISTIC
/begin CHARACTERISTIC c_abc_inc_bn_vs_tcs "Anti - bounce counter increment BN2000 Diagnosis" VALUE 0xa1029073 _REC_VAL_20_u1 255. _CNV_A_R_LINEAR_____0_CM 0. 255. DISPLAY_IDENTIFIER C_ABC_INC_BN_VS_TCS FORMAT "%3.0" /end CHARACTERISTIC
/begin CHARACTERISTIC c_abc_inc_bn_tcs "Anti - bounce counter increment BN2000 Diagnosis" VALUE 0xa102906b _REC_VAL_20_u1 255. _CNV_A_R_LINEAR_____0_CM 0. 255. DISPLAY_IDENTIFIER C_ABC_INC_BN_TCS FORMAT "%3.0" /end CHARACTERISTIC
/begin CHARACTERISTIC c_abc_inc_bn_tq_etcu "Anti - bounce counter increment BN2000 Diagnosis" VALUE 0xa102906e _REC_VAL_20_u1 255. _CNV_A_R_LINEAR_____0_CM 0. 255. DISPLAY_IDENTIFIER C_ABC_INC_BN_TQ_ETCU FORMAT "%3.0" /end CHARACTERISTIC
/begin CHARACTERISTIC c_abc_inc_bn_cas "Anti - bounce counter increment BN2000 Diagnosis" VALUE 0xa102905a _REC_VAL_20_u1 255. _CNV_A_R_LINEAR_____0_CM 0. 255. DISPLAY_IDENTIFIER C_ABC_INC_BN_CAS FORMAT "%3.0" /end CHARACTERISTIC
/begin CHARACTERISTIC c_abc_inc_bn_etcu "Anti - bounce counter increment BN2000 Diagnosis" VALUE 0xa102905d _REC_VAL_20_u1 255. _CNV_A_R_LINEAR_____0_CM 0. 255. DISPLAY_IDENTIFIER C_ABC_INC_BN_ETCU FORMAT "%3.0" /end CHARACTERISTIC
/begin CHARACTERISTIC c_abc_inc_bn_etcu_2 "Anti - bounce counter increment BN2000 Diagnosis" VALUE 0xa102905e _REC_VAL_20_u1 255. _CNV_A_R_LINEAR_____0_CM 0. 255. DISPLAY_IDENTIFIER C_ABC_INC_BN_ETCU_2 FORMAT "%3.0" /end CHARACTERISTIC
/begin CHARACTERISTIC c_abc_inc_bn_etcu_disp "Anti - bounce counter increment BN2000 Diagnosis" VALUE 0xa102905f _REC_VAL_20_u1 255. _CNV_A_R_LINEAR_____0_CM 0. 255. DISPLAY_IDENTIFIER C_ABC_INC_BN_ETCU_DISP FORMAT "%3.0" /end CHARACTERISTIC
/begin CHARACTERISTIC c_abc_inc_bn_tq_amt "Anti - bounce counter increment BN2000 Diagnosis" VALUE 0xa102906c _REC_VAL_20_u1 255. _CNV_A_R_LINEAR_____0_CM 0. 255. DISPLAY_IDENTIFIER C_ABC_INC_BN_TQ_AMT FORMAT "%3.0" /end CHARACTERISTIC
/begin CHARACTERISTIC c_abc_inc_bn_acc "Anti - bounce counter increment BN2000 Diagnosis" VALUE 0xa1029057 _REC_VAL_20_u1 255. _CNV_A_R_LINEAR_____0_CM 0. 255. DISPLAY_IDENTIFIER C_ABC_INC_BN_ACC FORMAT "%3.0" /end CHARACTERISTIC
/begin CHARACTERISTIC c_abc_inc_bn_icl "Anti - bounce counter increment BN2000 Diagnosis" VALUE 0xa1029062 _REC_VAL_20_u1 255. _CNV_A_R_LINEAR_____0_CM 0. 255. DISPLAY_IDENTIFIER C_ABC_INC_BN_ICL FORMAT "%3.0" /end CHARACTERISTIC
/begin CHARACTERISTIC c_abc_inc_bn_km_icl "Anti - bounce counter increment BN2000 Diagnosis" VALUE 0xa1029063 _REC_VAL_20_u1 255. _CNV_A_R_LINEAR_____0_CM 0. 255. DISPLAY_IDENTIFIER C_ABC_INC_BN_KM_ICL FORMAT "%3.0" /end CHARACTERISTIC
/begin CHARACTERISTIC c_abc_inc_bn_veh_mod "Anti - bounce counter increment BN2000 Diagnosis" VALUE 0xa1029072 _REC_VAL_20_u1 255. _CNV_A_R_LINEAR_____0_CM 0. 255. DISPLAY_IDENTIFIER C_ABC_INC_BN_VEH_MOD FORMAT "%3.0" /end CHARACTERISTIC
/begin CHARACTERISTIC c_abc_inc_bn_t_icl "Anti - bounce counter increment BN2000 Diagnosis" VALUE 0xa102906a _REC_VAL_20_u1 255. _CNV_A_R_LINEAR_____0_CM 0. 255. DISPLAY_IDENTIFIER C_ABC_INC_BN_T_ICL FORMAT "%3.0" /end CHARACTERISTIC
/begin CHARACTERISTIC c_abc_inc_bn_pow_vb "Anti - bounce counter increment BN2000 Diagnosis" VALUE 0xa1029068 _REC_VAL_20_u1 255. _CNV_A_R_LINEAR_____0_CM 0. 255. DISPLAY_IDENTIFIER C_ABC_INC_BN_POW_VB FORMAT "%3.0" /end CHARACTERISTIC
/begin CHARACTERISTIC c_abc_inc_bn_pow_gen "Anti - bounce counter increment BN2000 Diagnosis" VALUE 0xa1029067 _REC_VAL_20_u1 255. _CNV_A_R_LINEAR_____0_CM 0. 255. DISPLAY_IDENTIFIER C_ABC_INC_BN_POW_GEN FORMAT "%3.0" /end CHARACTERISTIC
/begin CHARACTERISTIC c_abc_inc_bn_msw "Anti - bounce counter increment BN2000 Diagnosis" VALUE 0xa1029066 _REC_VAL_20_u1 255. _CNV_A_R_LINEAR_____0_CM 0. 255. DISPLAY_IDENTIFIER C_ABC_INC_BN_MSW FORMAT "%3.0" /end CHARACTERISTIC
/begin CHARACTERISTIC c_abc_inc_bn_ang_pste "Anti - bounce counter increment BN2000 Diagnosis" VALUE 0xa1029058 _REC_VAL_20_u1 255. _CNV_A_R_LINEAR_____0_CM 0. 255. DISPLAY_IDENTIFIER C_ABC_INC_BN_ANG_PSTE FORMAT "%3.0" /end CHARACTERISTIC
/begin CHARACTERISTIC c_abc_max_bn_cas "Maximum value of the anti - bounce counter BN2000 diagnosis" VALUE 0xa10290e5 _REC_VAL_20_u1 254. _CNV_A_R_LINEAR_____0_CM 1. 255. DISPLAY_IDENTIFIER C_ABC_MAX_BN_CAS FORMAT "%3.0" /end CHARACTERISTIC
/begin CHARACTERISTIC c_abc_max_bn_tq_tcs "Maximum value of the anti - bounce counter BN2000 diagnosis" VALUE 0xa10290fb _REC_VAL_20_u1 254. _CNV_A_R_LINEAR_____0_CM 1. 255. DISPLAY_IDENTIFIER C_ABC_MAX_BN_TQ_TCS FORMAT "%3.0" /end CHARACTERISTIC
/begin CHARACTERISTIC c_abc_max_bn_vs_tcs "Maximum value of the anti - bounce counter BN2000 diagnosis" VALUE 0xa10290fe _REC_VAL_20_u1 254. _CNV_A_R_LINEAR_____0_CM 1. 255. DISPLAY_IDENTIFIER C_ABC_MAX_BN_VS_TCS FORMAT "%3.0" /end CHARACTERISTIC
/begin CHARACTERISTIC c_abc_max_bn_tcs "Maximum value of the anti - bounce counter BN2000 diagnosis" VALUE 0xa10290f6 _REC_VAL_20_u1 254. _CNV_A_R_LINEAR_____0_CM 1. 255. DISPLAY_IDENTIFIER C_ABC_MAX_BN_TCS FORMAT "%3.0" /end CHARACTERISTIC
/begin CHARACTERISTIC c_abc_max_bn_tq_etcu "Maximum value of the anti - bounce counter BN2000 diagnosis" VALUE 0xa10290f9 _REC_VAL_20_u1 254. _CNV_A_R_LINEAR_____0_CM 1. 255. DISPLAY_IDENTIFIER C_ABC_MAX_BN_TQ_ETCU FORMAT "%3.0" /end CHARACTERISTIC
/begin CHARACTERISTIC c_abc_max_bn_etcu "Maximum value of the anti - bounce counter BN2000 diagnosis" VALUE 0xa10290e8 _REC_VAL_20_u1 254. _CNV_A_R_LINEAR_____0_CM 1. 255. DISPLAY_IDENTIFIER C_ABC_MAX_BN_ETCU FORMAT "%3.0" /end CHARACTERISTIC
/begin CHARACTERISTIC c_abc_max_bn_etcu_2 "Maximum value of the anti - bounce counter BN2000 diagnosis" VALUE 0xa10290e9 _REC_VAL_20_u1 254. _CNV_A_R_LINEAR_____0_CM 1. 255. DISPLAY_IDENTIFIER C_ABC_MAX_BN_ETCU_2 FORMAT "%3.0" /end CHARACTERISTIC
/begin CHARACTERISTIC c_abc_max_bn_etcu_disp "Maximum value of the anti - bounce counter BN2000 diagnosis" VALUE 0xa10290ea _REC_VAL_20_u1 254. _CNV_A_R_LINEAR_____0_CM 1. 255. DISPLAY_IDENTIFIER C_ABC_MAX_BN_ETCU_DISP FORMAT "%3.0" /end CHARACTERISTIC
/begin CHARACTERISTIC c_abc_max_bn_tq_amt "Maximum value of the anti - bounce counter BN2000 diagnosis" VALUE 0xa10290f7 _REC_VAL_20_u1 254. _CNV_A_R_LINEAR_____0_CM 1. 255. DISPLAY_IDENTIFIER C_ABC_MAX_BN_TQ_AMT FORMAT "%3.0" /end CHARACTERISTIC
/begin CHARACTERISTIC c_abc_max_bn_acc "Maximum value of the anti - bounce counter BN2000 diagnosis" VALUE 0xa10290e2 _REC_VAL_20_u1 254. _CNV_A_R_LINEAR_____0_CM 1. 255. DISPLAY_IDENTIFIER C_ABC_MAX_BN_ACC FORMAT "%3.0" /end CHARACTERISTIC
/begin CHARACTERISTIC c_abc_max_bn_t_icl "Maximum value of the anti - bounce counter BN2000 diagnosis" VALUE 0xa10290f5 _REC_VAL_20_u1 254. _CNV_A_R_LINEAR_____0_CM 1. 255. DISPLAY_IDENTIFIER C_ABC_MAX_BN_T_ICL FORMAT "%3.0" /end CHARACTERISTIC
/begin CHARACTERISTIC c_abc_max_bn_km_icl "Maximum value of the anti - bounce counter BN2000 diagnosis" VALUE 0xa10290ee _REC_VAL_20_u1 254. _CNV_A_R_LINEAR_____0_CM 1. 255. DISPLAY_IDENTIFIER C_ABC_MAX_BN_KM_ICL FORMAT "%3.0" /end CHARACTERISTIC
/begin CHARACTERISTIC c_abc_max_bn_veh_mod "Maximum value of the anti - bounce counter BN2000 diagnosis" VALUE 0xa10290fd _REC_VAL_20_u1 254. _CNV_A_R_LINEAR_____0_CM 1. 255. DISPLAY_IDENTIFIER C_ABC_MAX_BN_VEH_MOD FORMAT "%3.0" /end CHARACTERISTIC
/begin CHARACTERISTIC c_abc_max_bn_icl "Maximum value of the anti - bounce counter BN2000 diagnosis" VALUE 0xa10290ed _REC_VAL_20_u1 254. _CNV_A_R_LINEAR_____0_CM 1. 255. DISPLAY_IDENTIFIER C_ABC_MAX_BN_ICL FORMAT "%3.0" /end CHARACTERISTIC
/begin CHARACTERISTIC c_abc_max_bn_pow_vb "Maximum value of the anti - bounce counter BN2000 diagnosis" VALUE 0xa10290f3 _REC_VAL_20_u1 254. _CNV_A_R_LINEAR_____0_CM 1. 255. DISPLAY_IDENTIFIER C_ABC_MAX_BN_POW_VB FORMAT "%3.0" /end CHARACTERISTIC
/begin CHARACTERISTIC c_abc_max_bn_pow_gen "Maximum value of the anti - bounce counter BN2000 diagnosis" VALUE 0xa10290f2 _REC_VAL_20_u1 254. _CNV_A_R_LINEAR_____0_CM 1. 255. DISPLAY_IDENTIFIER C_ABC_MAX_BN_POW_GEN FORMAT "%3.0" /end CHARACTERISTIC
/begin CHARACTERISTIC c_abc_max_bn_msw "Maximum value of the anti - bounce counter BN2000 diagnosis" VALUE 0xa10290f1 _REC_VAL_20_u1 254. _CNV_A_R_LINEAR_____0_CM 1. 255. DISPLAY_IDENTIFIER C_ABC_MAX_BN_MSW FORMAT "%3.0" /end CHARACTERISTIC
/begin CHARACTERISTIC c_abc_max_bn_tq_dcc "Maximum value of the anti - bounce counter BN2000 diagnosis" VALUE 0xa10290f8 _REC_VAL_20_u1 254. _CNV_A_R_LINEAR_____0_CM 1. 255. DISPLAY_IDENTIFIER C_ABC_MAX_BN_TQ_DCC FORMAT "%3.0" /end CHARACTERISTIC
/begin CHARACTERISTIC c_abc_max_bn_ang_pste "Maximum value of the anti - bounce counter BN2000 diagnosis" VALUE 0xa10290e3 _REC_VAL_20_u1 254. _CNV_A_R_LINEAR_____0_CM 1. 255. DISPLAY_IDENTIFIER C_ABC_MAX_BN_ANG_PSTE FORMAT "%3.0" /end CHARACTERISTIC
/begin CHARACTERISTIC c_ctr_diag_tcc_can_max_ars "Maximum number of wrong ATCC_CAN count events before error detection of BN2000 message" VALUE 0xa1029269 _REC_VAL_20_u1 255. _CNV_A_R_LINEAR_____0_CM 0. 255. DISPLAY_IDENTIFIER C_CTR_DIAG_TCC_CAN_MAX_ARS FORMAT "%3.0" /end CHARACTERISTIC
/begin CHARACTERISTIC c_ctr_diag_tcc_can_max_cas "Maximum number of wrong ATCC_CAN count events before error detection of BN2000 message" VALUE 0xa102926a _REC_VAL_20_u1 255. _CNV_A_R_LINEAR_____0_CM 0. 255. DISPLAY_IDENTIFIER C_CTR_DIAG_TCC_CAN_MAX_CAS FORMAT "%3.0" /end CHARACTERISTIC
/begin CHARACTERISTIC c_ctr_diag_tcc_can_max_tq_tcs "Maximum number of wrong ATCC_CAN count events before error detection of BN2000 message" VALUE 0xa1029272 _REC_VAL_20_u1 255. _CNV_A_R_LINEAR_____0_CM 0. 255. DISPLAY_IDENTIFIER C_CTR_DIAG_TCC_CAN_MAX_TQ_TCS FORMAT "%3.0" /end CHARACTERISTIC
/begin CHARACTERISTIC c_ctr_diag_tcc_can_max_tq_etcu "Maximum number of wrong ATCC_CAN count events before error detection of BN2000 message" VALUE 0xa1029270 _REC_VAL_20_u1 255. _CNV_A_R_LINEAR_____0_CM 0. 255. DISPLAY_IDENTIFIER C_CTR_DIAG_TCC_CAN_MAX_TQ_ETCU FORMAT "%3.0" /end CHARACTERISTIC
/begin CHARACTERISTIC c_ctr_diag_tcc_can_max_tq_amt "Maximum number of wrong ATCC_CAN count events before error detection of BN2000 message" VALUE 0xa102926e _REC_VAL_20_u1 255. _CNV_A_R_LINEAR_____0_CM 0. 255. DISPLAY_IDENTIFIER C_CTR_DIAG_TCC_CAN_MAX_TQ_AMT FORMAT "%3.0" /end CHARACTERISTIC
/begin CHARACTERISTIC c_ctr_diag_tcc_can_max_veh_mod "Maximum number of wrong ATCC_CAN count events before error detection of BN2000 message" VALUE 0xa1029273 _REC_VAL_20_u1 255. _CNV_A_R_LINEAR_____0_CM 0. 255. DISPLAY_IDENTIFIER C_CTR_DIAG_TCC_CAN_MAX_VEH_MOD FORMAT "%3.0" /end CHARACTERISTIC
/begin CHARACTERISTIC c_ctr_diag_tcc_can_max_icl "Maximum number of wrong ATCC_CAN count events before error detection of BN2000 message" VALUE 0xa102926b _REC_VAL_20_u1 255. _CNV_A_R_LINEAR_____0_CM 0. 255. DISPLAY_IDENTIFIER C_CTR_DIAG_TCC_CAN_MAX_ICL FORMAT "%3.0" /end CHARACTERISTIC
/begin CHARACTERISTIC c_ctr_diag_tcc_can_max_msw "Maximum number of wrong ATCC_CAN count events before error detection of BN2000 message" VALUE 0xa102926d _REC_VAL_20_u1 255. _CNV_A_R_LINEAR_____0_CM 0. 255. DISPLAY_IDENTIFIER C_CTR_DIAG_TCC_CAN_MAX_MSW FORMAT "%3.0" /end CHARACTERISTIC
/begin CHARACTERISTIC c_ctr_diag_tcc_can_max_tq_dcc "Maximum number of wrong ATCC_CAN count events before error detection of BN2000 message" VALUE 0xa102926f _REC_VAL_20_u1 255. _CNV_A_R_LINEAR_____0_CM 0. 255. DISPLAY_IDENTIFIER C_CTR_DIAG_TCC_CAN_MAX_TQ_DCC FORMAT "%3.0" /end CHARACTERISTIC
/begin CHARACTERISTIC c_ctr_diag_cks_max_cas "Maximum number of wrong checksum calculation events before error detection of BN2000 message" VALUE 0xa102925e _REC_VAL_20_u1 255. _CNV_A_R_LINEAR_____0_CM 0. 255. DISPLAY_IDENTIFIER C_CTR_DIAG_CKS_MAX_CAS FORMAT "%3.0" /end CHARACTERISTIC
/begin CHARACTERISTIC c_ctr_diag_cks_max_tq_tcs "Maximum number of wrong checksum calculation events before error detection of BN2000 message" VALUE 0xa1029265 _REC_VAL_20_u1 255. _CNV_A_R_LINEAR_____0_CM 0. 255. DISPLAY_IDENTIFIER C_CTR_DIAG_CKS_MAX_TQ_TCS FORMAT "%3.0" /end CHARACTERISTIC
/begin CHARACTERISTIC c_ctr_diag_cks_max_tq_etcu "Maximum number of wrong checksum calculation events before error detection of BN2000 message" VALUE 0xa1029263 _REC_VAL_20_u1 255. _CNV_A_R_LINEAR_____0_CM 0. 255. DISPLAY_IDENTIFIER C_CTR_DIAG_CKS_MAX_TQ_ETCU FORMAT "%3.0" /end CHARACTERISTIC
/begin CHARACTERISTIC c_ctr_diag_cks_max_tq_amt "Maximum number of wrong checksum calculation events before error detection of BN2000 message" VALUE 0xa1029261 _REC_VAL_20_u1 255. _CNV_A_R_LINEAR_____0_CM 0. 255. DISPLAY_IDENTIFIER C_CTR_DIAG_CKS_MAX_TQ_AMT FORMAT "%3.0" /end CHARACTERISTIC
/begin CHARACTERISTIC c_ctr_diag_cks_max_veh_mod "Maximum number of wrong checksum calculation events before error detection of BN2000 message" VALUE 0xa1029266 _REC_VAL_20_u1 255. _CNV_A_R_LINEAR_____0_CM 0. 255. DISPLAY_IDENTIFIER C_CTR_DIAG_CKS_MAX_VEH_MOD FORMAT "%3.0" /end CHARACTERISTIC
/begin CHARACTERISTIC c_ctr_diag_cks_max_msw "Maximum number of wrong checksum calculation events before error detection of BN2000 message" VALUE 0xa1029260 _REC_VAL_20_u1 255. _CNV_A_R_LINEAR_____0_CM 0. 255. DISPLAY_IDENTIFIER C_CTR_DIAG_CKS_MAX_MSW FORMAT "%3.0" /end CHARACTERISTIC
/begin CHARACTERISTIC c_ctr_diag_cks_max_tq_dcc "Maximum number of wrong checksum calculation events before error detection of BN2000 message" VALUE 0xa1029262 _REC_VAL_20_u1 255. _CNV_A_R_LINEAR_____0_CM 0. 255. DISPLAY_IDENTIFIER C_CTR_DIAG_CKS_MAX_TQ_DCC FORMAT "%3.0" /end CHARACTERISTIC
/begin CHARACTERISTIC c_ctr_diag_tout_max_ars "Maximum number of missing message events before error detection of BN2000 message" VALUE 0xa1029276 _REC_VAL_20_u1 255. _CNV_A_R_LINEAR_____0_CM 0. 255. DISPLAY_IDENTIFIER C_CTR_DIAG_TOUT_MAX_ARS FORMAT "%3.0" /end CHARACTERISTIC
/begin CHARACTERISTIC c_ctr_diag_tout_max_cas "Maximum number of missing message events before error detection of BN2000 message" VALUE 0xa1029277 _REC_VAL_20_u1 255. _CNV_A_R_LINEAR_____0_CM 0. 255. DISPLAY_IDENTIFIER C_CTR_DIAG_TOUT_MAX_CAS FORMAT "%3.0" /end CHARACTERISTIC
/begin CHARACTERISTIC c_ctr_diag_tout_max_tq_tcs "Maximum number of missing message events before error detection of BN2000 message" VALUE 0xa102928d _REC_VAL_20_u1 255. _CNV_A_R_LINEAR_____0_CM 0. 255. DISPLAY_IDENTIFIER C_CTR_DIAG_TOUT_MAX_TQ_TCS FORMAT "%3.0" /end CHARACTERISTIC
/begin CHARACTERISTIC c_ctr_diag_tout_max_vs_tcs "Maximum number of missing message events before error detection of BN2000 message" VALUE 0xa1029290 _REC_VAL_20_u1 255. _CNV_A_R_LINEAR_____0_CM 0. 255. DISPLAY_IDENTIFIER C_CTR_DIAG_TOUT_MAX_VS_TCS FORMAT "%3.0" /end CHARACTERISTIC
/begin CHARACTERISTIC c_ctr_diag_tout_max_tcs "Maximum number of missing message events before error detection of BN2000 message" VALUE 0xa1029288 _REC_VAL_20_u1 255. _CNV_A_R_LINEAR_____0_CM 0. 255. DISPLAY_IDENTIFIER C_CTR_DIAG_TOUT_MAX_TCS FORMAT "%3.0" /end CHARACTERISTIC
/begin CHARACTERISTIC c_ctr_diag_tout_max_tq_etcu "Maximum number of missing message events before error detection of BN2000 message" VALUE 0xa102928b _REC_VAL_20_u1 255. _CNV_A_R_LINEAR_____0_CM 0. 255. DISPLAY_IDENTIFIER C_CTR_DIAG_TOUT_MAX_TQ_ETCU FORMAT "%3.0" /end CHARACTERISTIC
/begin CHARACTERISTIC c_ctr_diag_tout_max_tq_dcc "Maximum number of missing message events before error detection of BN2000 message" VALUE 0xa102928a _REC_VAL_20_u1 255. _CNV_A_R_LINEAR_____0_CM 0. 255. DISPLAY_IDENTIFIER C_CTR_DIAG_TOUT_MAX_TQ_DCC FORMAT "%3.0" /end CHARACTERISTIC
/begin CHARACTERISTIC c_ctr_diag_tout_max_tq_amt "Maximum number of missing message events before error detection of BN2000 message" VALUE 0xa1029289 _REC_VAL_20_u1 255. _CNV_A_R_LINEAR_____0_CM 0. 255. DISPLAY_IDENTIFIER C_CTR_DIAG_TOUT_MAX_TQ_AMT FORMAT "%3.0" /end CHARACTERISTIC
/begin CHARACTERISTIC c_ctr_diag_tout_max_acc "Maximum number of missing message events before error detection of BN2000 message" VALUE 0xa1029274 _REC_VAL_20_u1 255. _CNV_A_R_LINEAR_____0_CM 0. 255. DISPLAY_IDENTIFIER C_CTR_DIAG_TOUT_MAX_ACC FORMAT "%3.0" /end CHARACTERISTIC
/begin CHARACTERISTIC c_ctr_diag_tout_max_t_icl "Maximum number of missing message events before error detection of BN2000 message" VALUE 0xa1029287 _REC_VAL_20_u1 255. _CNV_A_R_LINEAR_____0_CM 0. 255. DISPLAY_IDENTIFIER C_CTR_DIAG_TOUT_MAX_T_ICL FORMAT "%3.0" /end CHARACTERISTIC
/begin CHARACTERISTIC c_ctr_diag_tout_max_veh_mod "Maximum number of missing message events before error detection of BN2000 message" VALUE 0xa102928f _REC_VAL_20_u1 255. _CNV_A_R_LINEAR_____0_CM 0. 255. DISPLAY_IDENTIFIER C_CTR_DIAG_TOUT_MAX_VEH_MOD FORMAT "%3.0" /end CHARACTERISTIC
/begin CHARACTERISTIC c_ctr_diag_tout_max_km_icl "Maximum number of missing message events before error detection of BN2000 message" VALUE 0xa1029280 _REC_VAL_20_u1 255. _CNV_A_R_LINEAR_____0_CM 0. 255. DISPLAY_IDENTIFIER C_CTR_DIAG_TOUT_MAX_KM_ICL FORMAT "%3.0" /end CHARACTERISTIC
/begin CHARACTERISTIC c_ctr_diag_tout_max_icl "Maximum number of missing message events before error detection of BN2000 message" VALUE 0xa102927f _REC_VAL_20_u1 255. _CNV_A_R_LINEAR_____0_CM 0. 255. DISPLAY_IDENTIFIER C_CTR_DIAG_TOUT_MAX_ICL FORMAT "%3.0" /end CHARACTERISTIC
/begin CHARACTERISTIC c_ctr_diag_tout_max_pow_vb "Maximum number of missing message events before error detection of BN2000 message" VALUE 0xa1029285 _REC_VAL_20_u1 255. _CNV_A_R_LINEAR_____0_CM 0. 255. DISPLAY_IDENTIFIER C_CTR_DIAG_TOUT_MAX_POW_VB FORMAT "%3.0" /end CHARACTERISTIC
/begin CHARACTERISTIC c_ctr_diag_tout_max_pow_gen "Maximum number of missing message events before error detection of BN2000 message" VALUE 0xa1029284 _REC_VAL_20_u1 255. _CNV_A_R_LINEAR_____0_CM 0. 255. DISPLAY_IDENTIFIER C_CTR_DIAG_TOUT_MAX_POW_GEN FORMAT "%3.0" /end CHARACTERISTIC
/begin CHARACTERISTIC c_ctr_diag_tout_max_msw "Maximum number of missing message events before error detection of BN2000 message" VALUE 0xa1029283 _REC_VAL_20_u1 255. _CNV_A_R_LINEAR_____0_CM 0. 255. DISPLAY_IDENTIFIER C_CTR_DIAG_TOUT_MAX_MSW FORMAT "%3.0" /end CHARACTERISTIC
/begin CHARACTERISTIC c_ctr_diag_tout_max_etcu "Maximum number of missing message events before error detection of BN2000 message" VALUE 0xa102927a _REC_VAL_20_u1 255. _CNV_A_R_LINEAR_____0_CM 0. 255. DISPLAY_IDENTIFIER C_CTR_DIAG_TOUT_MAX_ETCU FORMAT "%3.0" /end CHARACTERISTIC
/begin CHARACTERISTIC c_ctr_diag_tout_max_etcu_2 "Maximum number of missing message events before error detection of BN2000 message" VALUE 0xa102927b _REC_VAL_20_u1 255. _CNV_A_R_LINEAR_____0_CM 0. 255. DISPLAY_IDENTIFIER C_CTR_DIAG_TOUT_MAX_ETCU_2 FORMAT "%3.0" /end CHARACTERISTIC
/begin CHARACTERISTIC c_ctr_diag_tout_max_etcu_disp "Maximum number of missing message events before error detection of BN2000 message" VALUE 0xa102927c _REC_VAL_20_u1 255. _CNV_A_R_LINEAR_____0_CM 0. 255. DISPLAY_IDENTIFIER C_CTR_DIAG_TOUT_MAX_ETCU_DISP FORMAT "%3.0" /end CHARACTERISTIC
/begin CHARACTERISTIC c_ctr_diag_tout_max_ang_pste "Maximum number of missing message events before error detection of BN2000 message" VALUE 0xa1029275 _REC_VAL_20_u1 255. _CNV_A_R_LINEAR_____0_CM 0. 255. DISPLAY_IDENTIFIER C_CTR_DIAG_TOUT_MAX_ANG_PSTE FORMAT "%3.0" /end CHARACTERISTIC
/begin CHARACTERISTIC c_abc_max_bn_ars "Maximum value of the anti - bounce counter BN2000 diagnosis" VALUE 0xa10290e4 _REC_VAL_20_u1 254. _CNV_A_R_LINEAR_____0_CM 1. 255. DISPLAY_IDENTIFIER C_ABC_MAX_BN_ARS FORMAT "%3.0" /end CHARACTERISTIC
/begin CHARACTERISTIC c_abc_inc_bn_ars "Anti - bounce counter increment BN2000 Diagnosis" VALUE 0xa1029059 _REC_VAL_20_u1 255. _CNV_A_R_LINEAR_____0_CM 0. 255. DISPLAY_IDENTIFIER C_ABC_INC_BN_ARS FORMAT "%3.0" /end CHARACTERISTIC
/begin CHARACTERISTIC c_abc_dec_bn_tq_dcc "Anti - bounce counter increment BN2000 Diagnosis" VALUE 0xa1029042 _REC_VAL_20_u1 255. _CNV_A_R_LINEAR_____0_CM 0. 255. DISPLAY_IDENTIFIER C_ABC_DEC_BN_TQ_DCC FORMAT "%3.0" /end CHARACTERISTIC
/begin CHARACTERISTIC c_abc_dec_bn_ars "Anti - bounce counter increment BN2000 Diagnosis" VALUE 0xa102902e _REC_VAL_20_u1 255. _CNV_A_R_LINEAR_____0_CM 0. 255. DISPLAY_IDENTIFIER C_ABC_DEC_BN_ARS FORMAT "%3.0" /end CHARACTERISTIC
/begin CHARACTERISTIC c_abc_dec_bn_cas "Anti - bounce counter increment BN2000 Diagnosis" VALUE 0xa102902f _REC_VAL_20_u1 255. _CNV_A_R_LINEAR_____0_CM 0. 255. DISPLAY_IDENTIFIER C_ABC_DEC_BN_CAS FORMAT "%3.0" /end CHARACTERISTIC
/begin CHARACTERISTIC c_abc_dec_bn_tq_tcs "Anti - bounce counter increment BN2000 Diagnosis" VALUE 0xa1029045 _REC_VAL_20_u1 255. _CNV_A_R_LINEAR_____0_CM 0. 255. DISPLAY_IDENTIFIER C_ABC_DEC_BN_TQ_TCS FORMAT "%3.0" /end CHARACTERISTIC
/begin CHARACTERISTIC c_abc_dec_bn_vs_tcs "Anti - bounce counter increment BN2000 Diagnosis" VALUE 0xa1029048 _REC_VAL_20_u1 255. _CNV_A_R_LINEAR_____0_CM 0. 255. DISPLAY_IDENTIFIER C_ABC_DEC_BN_VS_TCS FORMAT "%3.0" /end CHARACTERISTIC
/begin CHARACTERISTIC c_abc_dec_bn_tcs "Anti - bounce counter increment BN2000 Diagnosis" VALUE 0xa1029040 _REC_VAL_20_u1 255. _CNV_A_R_LINEAR_____0_CM 0. 255. DISPLAY_IDENTIFIER C_ABC_DEC_BN_TCS FORMAT "%3.0" /end CHARACTERISTIC
/begin CHARACTERISTIC c_abc_dec_bn_tq_etcu "Anti - bounce counter increment BN2000 Diagnosis" VALUE 0xa1029043 _REC_VAL_20_u1 255. _CNV_A_R_LINEAR_____0_CM 0. 255. DISPLAY_IDENTIFIER C_ABC_DEC_BN_TQ_ETCU FORMAT "%3.0" /end CHARACTERISTIC
/begin CHARACTERISTIC c_abc_dec_bn_etcu "Anti - bounce counter increment BN2000 Diagnosis" VALUE 0xa1029032 _REC_VAL_20_u1 255. _CNV_A_R_LINEAR_____0_CM 0. 255. DISPLAY_IDENTIFIER C_ABC_DEC_BN_ETCU FORMAT "%3.0" /end CHARACTERISTIC
/begin CHARACTERISTIC c_abc_dec_bn_etcu_2 "Anti - bounce counter increment BN2000 Diagnosis" VALUE 0xa1029033 _REC_VAL_20_u1 255. _CNV_A_R_LINEAR_____0_CM 0. 255. DISPLAY_IDENTIFIER C_ABC_DEC_BN_ETCU_2 FORMAT "%3.0" /end CHARACTERISTIC
/begin CHARACTERISTIC c_abc_dec_bn_tq_amt "Anti - bounce counter increment BN2000 Diagnosis" VALUE 0xa1029041 _REC_VAL_20_u1 255. _CNV_A_R_LINEAR_____0_CM 0. 255. DISPLAY_IDENTIFIER C_ABC_DEC_BN_TQ_AMT FORMAT "%3.0" /end CHARACTERISTIC
/begin CHARACTERISTIC c_abc_dec_bn_acc "Anti - bounce counter increment BN2000 Diagnosis" VALUE 0xa102902c _REC_VAL_20_u1 255. _CNV_A_R_LINEAR_____0_CM 0. 255. DISPLAY_IDENTIFIER C_ABC_DEC_BN_ACC FORMAT "%3.0" /end CHARACTERISTIC
/begin CHARACTERISTIC c_abc_dec_bn_icl "Anti - bounce counter increment BN2000 Diagnosis" VALUE 0xa1029037 _REC_VAL_20_u1 255. _CNV_A_R_LINEAR_____0_CM 0. 255. DISPLAY_IDENTIFIER C_ABC_DEC_BN_ICL FORMAT "%3.0" /end CHARACTERISTIC
/begin CHARACTERISTIC c_abc_dec_bn_km_icl "Anti - bounce counter increment BN2000 Diagnosis" VALUE 0xa1029038 _REC_VAL_20_u1 255. _CNV_A_R_LINEAR_____0_CM 0. 255. DISPLAY_IDENTIFIER C_ABC_DEC_BN_KM_ICL FORMAT "%3.0" /end CHARACTERISTIC
/begin CHARACTERISTIC c_abc_dec_bn_t_icl "Anti - bounce counter increment BN2000 Diagnosis" VALUE 0xa102903f _REC_VAL_20_u1 255. _CNV_A_R_LINEAR_____0_CM 0. 255. DISPLAY_IDENTIFIER C_ABC_DEC_BN_T_ICL FORMAT "%3.0" /end CHARACTERISTIC
/begin CHARACTERISTIC c_abc_dec_bn_pow_vb "Anti - bounce counter increment BN2000 Diagnosis" VALUE 0xa102903d _REC_VAL_20_u1 255. _CNV_A_R_LINEAR_____0_CM 0. 255. DISPLAY_IDENTIFIER C_ABC_DEC_BN_POW_VB FORMAT "%3.0" /end CHARACTERISTIC
/begin CHARACTERISTIC c_abc_dec_bn_pow_gen "Anti - bounce counter increment BN2000 Diagnosis" VALUE 0xa102903c _REC_VAL_20_u1 255. _CNV_A_R_LINEAR_____0_CM 0. 255. DISPLAY_IDENTIFIER C_ABC_DEC_BN_POW_GEN FORMAT "%3.0" /end CHARACTERISTIC
/begin CHARACTERISTIC c_abc_dec_bn_msw "Anti - bounce counter increment BN2000 Diagnosis" VALUE 0xa102903b _REC_VAL_20_u1 255. _CNV_A_R_LINEAR_____0_CM 0. 255. DISPLAY_IDENTIFIER C_ABC_DEC_BN_MSW FORMAT "%3.0" /end CHARACTERISTIC
/begin CHARACTERISTIC c_abc_dec_bn_ang_pste "Anti - bounce counter increment BN2000 Diagnosis" VALUE 0xa102902d _REC_VAL_20_u1 255. _CNV_A_R_LINEAR_____0_CM 0. 255. DISPLAY_IDENTIFIER C_ABC_DEC_BN_ANG_PSTE FORMAT "%3.0" /end CHARACTERISTIC
/begin CHARACTERISTIC c_abc_dec_bn_veh_mod "Anti - bounce counter increment BN2000 Diagnosis" VALUE 0xa1029047 _REC_VAL_20_u1 255. _CNV_A_R_LINEAR_____0_CM 0. 255. DISPLAY_IDENTIFIER C_ABC_DEC_BN_VEH_MOD FORMAT "%3.0" /end CHARACTERISTIC
/begin CHARACTERISTIC c_abc_inc_bn_tq_pste_2 "Anti - bounce counter increment BN2000 Diagnosis" VALUE 0xa102906f _REC_VAL_20_u1 255. _CNV_A_R_LINEAR_____0_CM 0. 255. DISPLAY_IDENTIFIER C_ABC_INC_BN_TQ_PSTE_2 FORMAT "%3.0" /end CHARACTERISTIC
/begin CHARACTERISTIC c_abc_max_bn_tq_pste_2 "Maximum value of the anti - bounce counter BN2000 diagnosis" VALUE 0xa10290fa _REC_VAL_20_u1 254. _CNV_A_R_LINEAR_____0_CM 1. 255. DISPLAY_IDENTIFIER C_ABC_MAX_BN_TQ_PSTE_2 FORMAT "%3.0" /end CHARACTERISTIC
/begin CHARACTERISTIC c_abc_dec_bn_tq_pste_2 "Anti - bounce counter increment BN2000 Diagnosis" VALUE 0xa1029044 _REC_VAL_20_u1 255. _CNV_A_R_LINEAR_____0_CM 0. 255. DISPLAY_IDENTIFIER C_ABC_DEC_BN_TQ_PSTE_2 FORMAT "%3.0" /end CHARACTERISTIC
/begin CHARACTERISTIC c_ctr_diag_tcc_can_max_tq_pste_2 "Maximum number of wrong ATCC_CAN count events before error detection of BN2000 message" VALUE 0xa1029271 _REC_VAL_20_u1 255. _CNV_A_R_LINEAR_____0_CM 0. 255. DISPLAY_IDENTIFIER C_CTR_DIAG_TCC_CAN_MAX_TQ_PSTE_2 FORMAT "%3.0" /end CHARACTERISTIC
/begin CHARACTERISTIC c_ctr_diag_cks_max_tq_pste_2 "Maximum number of wrong checksum calculation events before error detection of BN2000 message" VALUE 0xa1029264 _REC_VAL_20_u1 255. _CNV_A_R_LINEAR_____0_CM 0. 255. DISPLAY_IDENTIFIER C_CTR_DIAG_CKS_MAX_TQ_PSTE_2 FORMAT "%3.0" /end CHARACTERISTIC
/begin CHARACTERISTIC c_ctr_diag_tout_max_tq_pste_2 "Maximum number of missing message events before error detection of BN2000 message" VALUE 0xa102928c _REC_VAL_20_u1 255. _CNV_A_R_LINEAR_____0_CM 0. 255. DISPLAY_IDENTIFIER C_CTR_DIAG_TOUT_MAX_TQ_PSTE_2 FORMAT "%3.0" /end CHARACTERISTIC
/begin CHARACTERISTIC c_abc_inc_bn_efp "Anti - bounce counter increment BN2000 Diagnosis" VALUE 0xa102905b _REC_VAL_20_u1 255. _CNV_A_R_LINEAR_____0_CM 0. 255. DISPLAY_IDENTIFIER C_ABC_INC_BN_EFP FORMAT "%3.0" /end CHARACTERISTIC
/begin CHARACTERISTIC c_abc_inc_bn_efp_crash "Anti - bounce counter increment BN2000 Diagnosis" VALUE 0xa102905c _REC_VAL_20_u1 255. _CNV_A_R_LINEAR_____0_CM 0. 255. DISPLAY_IDENTIFIER C_ABC_INC_BN_EFP_CRASH FORMAT "%3.0" /end CHARACTERISTIC
/begin CHARACTERISTIC c_abc_max_bn_efp "Maximum value of the anti - bounce counter BN2000 diagnosis" VALUE 0xa10290e6 _REC_VAL_20_u1 254. _CNV_A_R_LINEAR_____0_CM 1. 255. DISPLAY_IDENTIFIER C_ABC_MAX_BN_EFP FORMAT "%3.0" /end CHARACTERISTIC
/begin CHARACTERISTIC c_abc_max_bn_efp_crash "Maximum value of the anti - bounce counter BN2000 diagnosis" VALUE 0xa10290e7 _REC_VAL_20_u1 254. _CNV_A_R_LINEAR_____0_CM 1. 255. DISPLAY_IDENTIFIER C_ABC_MAX_BN_EFP_CRASH FORMAT "%3.0" /end CHARACTERISTIC
/begin CHARACTERISTIC c_abc_dec_bn_efp "Anti - bounce counter increment BN2000 Diagnosis" VALUE 0xa1029030 _REC_VAL_20_u1 255. _CNV_A_R_LINEAR_____0_CM 0. 255. DISPLAY_IDENTIFIER C_ABC_DEC_BN_EFP FORMAT "%3.0" /end CHARACTERISTIC
/begin CHARACTERISTIC c_abc_dec_bn_efp_crash "Anti - bounce counter increment BN2000 Diagnosis" VALUE 0xa1029031 _REC_VAL_20_u1 255. _CNV_A_R_LINEAR_____0_CM 0. 255. DISPLAY_IDENTIFIER C_ABC_DEC_BN_EFP_CRASH FORMAT "%3.0" /end CHARACTERISTIC
/begin CHARACTERISTIC c_ctr_diag_tout_max_efp "Maximum number of missing message events before error detection of BN2000 message" VALUE 0xa1029278 _REC_VAL_20_u1 255. _CNV_A_R_LINEAR_____0_CM 0. 255. DISPLAY_IDENTIFIER C_CTR_DIAG_TOUT_MAX_EFP FORMAT "%3.0" /end CHARACTERISTIC
/begin CHARACTERISTIC c_ctr_diag_tout_max_efp_crash "Maximum number of missing message events before error detection of BN2000 message" VALUE 0xa1029279 _REC_VAL_20_u1 255. _CNV_A_R_LINEAR_____0_CM 0. 255. DISPLAY_IDENTIFIER C_CTR_DIAG_TOUT_MAX_EFP_CRASH FORMAT "%3.0" /end CHARACTERISTIC
/begin CHARACTERISTIC c_abc_inc_bn_gear_rev "Anti - bounce counter increment BN2000 Diagnosis" VALUE 0xa1029060 _REC_VAL_20_u1 255. _CNV_A_R_LINEAR_____0_CM 0. 255. DISPLAY_IDENTIFIER C_ABC_INC_BN_GEAR_REV FORMAT "%3.0" /end CHARACTERISTIC
/begin CHARACTERISTIC c_abc_max_bn_gear_rev "Maximum value of the anti - bounce counter BN2000 diagnosis" VALUE 0xa10290eb _REC_VAL_20_u1 254. _CNV_A_R_LINEAR_____0_CM 1. 255. DISPLAY_IDENTIFIER C_ABC_MAX_BN_GEAR_REV FORMAT "%3.0" /end CHARACTERISTIC
/begin CHARACTERISTIC c_abc_dec_bn_gear_rev "Anti - bounce counter increment BN2000 Diagnosis" VALUE 0xa1029035 _REC_VAL_20_u1 255. _CNV_A_R_LINEAR_____0_CM 0. 255. DISPLAY_IDENTIFIER C_ABC_DEC_BN_GEAR_REV FORMAT "%3.0" /end CHARACTERISTIC
/begin CHARACTERISTIC c_ctr_diag_tout_max_gear_rev "Maximum number of missing message events before error detection of BN2000 message" VALUE 0xa102927d _REC_VAL_20_u1 255. _CNV_A_R_LINEAR_____0_CM 0. 255. DISPLAY_IDENTIFIER C_CTR_DIAG_TOUT_MAX_GEAR_REV FORMAT "%3.0" /end CHARACTERISTIC
/begin CHARACTERISTIC c_abc_inc_bn_ltg_hdlp_l "Anti - bounce counter increment BN2000 Diagnosis" VALUE 0xa1029065 _REC_VAL_20_u1 255. _CNV_A_R_LINEAR_____0_CM 0. 255. DISPLAY_IDENTIFIER C_ABC_INC_BN_LTG_HDLP_L FORMAT "%3.0" /end CHARACTERISTIC
/begin CHARACTERISTIC c_abc_max_bn_ltg_hdlp_l "Maximum value of the anti - bounce counter BN2000 diagnosis" VALUE 0xa10290f0 _REC_VAL_20_u1 254. _CNV_A_R_LINEAR_____0_CM 1. 255. DISPLAY_IDENTIFIER C_ABC_MAX_BN_LTG_HDLP_L FORMAT "%3.0" /end CHARACTERISTIC
/begin CHARACTERISTIC c_abc_dec_bn_ltg_hdlp_l "Anti - bounce counter increment BN2000 Diagnosis" VALUE 0xa102903a _REC_VAL_20_u1 255. _CNV_A_R_LINEAR_____0_CM 0. 255. DISPLAY_IDENTIFIER C_ABC_DEC_BN_LTG_HDLP_L FORMAT "%3.0" /end CHARACTERISTIC
/begin CHARACTERISTIC c_ctr_diag_tout_max_ltg_hdlp_l "Maximum number of missing message events before error detection of BN2000 message" VALUE 0xa1029282 _REC_VAL_20_u1 255. _CNV_A_R_LINEAR_____0_CM 0. 255. DISPLAY_IDENTIFIER C_CTR_DIAG_TOUT_MAX_LTG_HDLP_L FORMAT "%3.0" /end CHARACTERISTIC
/begin CHARACTERISTIC c_abc_inc_bn_ldm "Anti - bounce counter increment BN2000 Diagnosis" VALUE 0xa1029064 _REC_VAL_20_u1 255. _CNV_A_R_LINEAR_____0_CM 0. 255. DISPLAY_IDENTIFIER C_ABC_INC_BN_LDM FORMAT "%3.0" /end CHARACTERISTIC
/begin CHARACTERISTIC c_abc_max_bn_ldm "Maximum value of the anti - bounce counter BN2000 diagnosis" VALUE 0xa10290ef _REC_VAL_20_u1 254. _CNV_A_R_LINEAR_____0_CM 1. 255. DISPLAY_IDENTIFIER C_ABC_MAX_BN_LDM FORMAT "%3.0" /end CHARACTERISTIC
/begin CHARACTERISTIC c_ctr_diag_tcc_can_max_ldm "Maximum number of wrong ATCC_CAN count events before error detection of BN2000 message" VALUE 0xa102926c _REC_VAL_20_u1 255. _CNV_A_R_LINEAR_____0_CM 0. 255. DISPLAY_IDENTIFIER C_CTR_DIAG_TCC_CAN_MAX_LDM FORMAT "%3.0" /end CHARACTERISTIC
/begin CHARACTERISTIC c_ctr_diag_cks_max_ldm "Maximum number of wrong checksum calculation events before error detection of BN2000 message" VALUE 0xa102925f _REC_VAL_20_u1 255. _CNV_A_R_LINEAR_____0_CM 0. 255. DISPLAY_IDENTIFIER C_CTR_DIAG_CKS_MAX_LDM FORMAT "%3.0" /end CHARACTERISTIC
/begin CHARACTERISTIC c_ctr_diag_tout_max_ldm "Maximum number of missing message events before error detection of BN2000 message" VALUE 0xa1029281 _REC_VAL_20_u1 255. _CNV_A_R_LINEAR_____0_CM 0. 255. DISPLAY_IDENTIFIER C_CTR_DIAG_TOUT_MAX_LDM FORMAT "%3.0" /end CHARACTERISTIC
/begin CHARACTERISTIC c_abc_dec_bn_ldm "Anti - bounce counter increment BN2000 Diagnosis" VALUE 0xa1029039 _REC_VAL_20_u1 255. _CNV_A_R_LINEAR_____0_CM 0. 255. DISPLAY_IDENTIFIER C_ABC_DEC_BN_LDM FORMAT "%3.0" /end CHARACTERISTIC
/begin CHARACTERISTIC c_abc_inc_bn_hiv "Anti - bounce counter increment BN2000 Diagnosis" VALUE 0xa1029061 _REC_VAL_20_u1 255. _CNV_A_R_LINEAR_____0_CM 0. 255. DISPLAY_IDENTIFIER C_ABC_INC_BN_HIV FORMAT "%3.0" /end CHARACTERISTIC
/begin CHARACTERISTIC c_abc_max_bn_hiv "Maximum value of the anti - bounce counter BN2000 diagnosis" VALUE 0xa10290ec _REC_VAL_20_u1 254. _CNV_A_R_LINEAR_____0_CM 1. 255. DISPLAY_IDENTIFIER C_ABC_MAX_BN_HIV FORMAT "%3.0" /end CHARACTERISTIC
/begin CHARACTERISTIC c_ctr_diag_tout_max_hiv "Maximum number of missing message events before error detection of BN2000 message" VALUE 0xa102927e _REC_VAL_20_u1 255. _CNV_A_R_LINEAR_____0_CM 0. 255. DISPLAY_IDENTIFIER C_CTR_DIAG_TOUT_MAX_HIV FORMAT "%3.0" /end CHARACTERISTIC
/begin CHARACTERISTIC c_abc_dec_bn_hiv "Anti - bounce counter increment BN2000 Diagnosis" VALUE 0xa1029036 _REC_VAL_20_u1 255. _CNV_A_R_LINEAR_____0_CM 0. 255. DISPLAY_IDENTIFIER C_ABC_DEC_BN_HIV FORMAT "%3.0" /end CHARACTERISTIC
/begin CHARACTERISTIC c_abc_inc_bn_trl "Anti - bounce counter increment BN2000 Diagnosis" VALUE 0xa1029071 _REC_VAL_20_u1 255. _CNV_A_R_LINEAR_____0_CM 0. 255. DISPLAY_IDENTIFIER C_ABC_INC_BN_TRL FORMAT "%3.0" /end CHARACTERISTIC
/begin CHARACTERISTIC c_abc_max_bn_trl "Maximum value of the anti - bounce counter BN2000 diagnosis" VALUE 0xa10290fc _REC_VAL_20_u1 254. _CNV_A_R_LINEAR_____0_CM 1. 255. DISPLAY_IDENTIFIER C_ABC_MAX_BN_TRL FORMAT "%3.0" /end CHARACTERISTIC
/begin CHARACTERISTIC c_ctr_diag_tout_max_trl "Maximum number of missing message events before error detection of BN2000 message" VALUE 0xa102928e _REC_VAL_20_u1 255. _CNV_A_R_LINEAR_____0_CM 0. 255. DISPLAY_IDENTIFIER C_CTR_DIAG_TOUT_MAX_TRL FORMAT "%3.0" /end CHARACTERISTIC
/begin CHARACTERISTIC c_abc_dec_bn_trl "Anti - bounce counter increment BN2000 Diagnosis" VALUE 0xa1029046 _REC_VAL_20_u1 255. _CNV_A_R_LINEAR_____0_CM 0. 255. DISPLAY_IDENTIFIER C_ABC_DEC_BN_TRL FORMAT "%3.0" /end CHARACTERISTIC
/begin CHARACTERISTIC c_abc_inc_bn_t_clk "Anti - bounce counter increment BN2000 Diagnosis" VALUE 0xa1029069 _REC_VAL_20_u1 255. _CNV_A_R_LINEAR_____0_CM 0. 255. DISPLAY_IDENTIFIER C_ABC_INC_BN_T_CLK FORMAT "%3.0" /end CHARACTERISTIC
/begin CHARACTERISTIC c_abc_max_bn_t_clk "Maximum value of the anti - bounce counter BN2000 diagnosis" VALUE 0xa10290f4 _REC_VAL_20_u1 254. _CNV_A_R_LINEAR_____0_CM 1. 255. DISPLAY_IDENTIFIER C_ABC_MAX_BN_T_CLK FORMAT "%3.0" /end CHARACTERISTIC
/begin CHARACTERISTIC c_ctr_diag_tout_max_t_clk "Maximum number of missing message events before error detection of BN2000 message" VALUE 0xa1029286 _REC_VAL_20_u1 255. _CNV_A_R_LINEAR_____0_CM 0. 255. DISPLAY_IDENTIFIER C_CTR_DIAG_TOUT_MAX_T_CLK FORMAT "%3.0" /end CHARACTERISTIC
/begin CHARACTERISTIC c_abc_dec_bn_t_clk "Anti - bounce counter increment BN2000 Diagnosis" VALUE 0xa102903e _REC_VAL_20_u1 255. _CNV_A_R_LINEAR_____0_CM 0. 255. DISPLAY_IDENTIFIER C_ABC_DEC_BN_T_CLK FORMAT "%3.0" /end CHARACTERISTIC
/begin CHARACTERISTIC c_abc_dec_bn_etcu_disp "Anti - bounce counter increment BN2000 Diagnosis" VALUE 0xa1029034 _REC_VAL_20_u1 255. _CNV_A_R_LINEAR_____0_CM 0. 255. DISPLAY_IDENTIFIER C_ABC_DEC_BN_ETCU_DISP FORMAT "%3.0" /end CHARACTERISTIC
/begin MEASUREMENT lv_err_alter_com "Logical variable for alternator BSD communication error" UBYTE _CNV_S_2_RANGE__0___1_CM 1 100. 0. 1. DISPLAY_IDENTIFIER LV_ERR_ALTER_COM ECU_ADDRESS 0xd00034c4 BIT_MASK 0x1 /end MEASUREMENT
/begin MEASUREMENT lv_err_cwp_com "Logical variable for electrical coolant water pump BSD communication error" UBYTE _CNV_S_2_RANGE__0___1_CM 1 100. 0. 1. DISPLAY_IDENTIFIER LV_ERR_CWP_COM ECU_ADDRESS 0xd00034c5 BIT_MASK 0x1 /end MEASUREMENT
/begin MEASUREMENT lv_err_qoil_com "Logical variable for oil quality sensor (QLT) BSD communication error" UBYTE _CNV_S_2_RANGE__0___1_CM 1 100. 0. 1. DISPLAY_IDENTIFIER LV_ERR_QOIL_COM ECU_ADDRESS 0xd00034c6 BIT_MASK 0x1 /end MEASUREMENT
/begin MEASUREMENT lv_err_sens_bat_smt_com "Logical variable for intelligent battery sensor (IBS) BSD communication error" UBYTE _CNV_S_2_RANGE__0___1_CM 1 100. 0. 1. DISPLAY_IDENTIFIER LV_ERR_SENS_BAT_SMT_COM ECU_ADDRESS 0xd00034c7 BIT_MASK 0x1 /end MEASUREMENT
/begin MEASUREMENT ctr_msg_alter_com_diag "Counter of faulty alternator transmitting slots " UBYTE _CNV_A_R_LINEAR_____0_CM 1 100. 0. 255. DISPLAY_IDENTIFIER CTR_MSG_ALTER_COM_DIAG ECU_ADDRESS 0xc0000154 FORMAT "%3.0" /end MEASUREMENT
/begin MEASUREMENT ctr_msg_cwp_com_diag "Counter of faulty electrical coolant water pump transmitting slots " UBYTE _CNV_A_R_LINEAR_____0_CM 1 100. 0. 255. DISPLAY_IDENTIFIER CTR_MSG_CWP_COM_DIAG ECU_ADDRESS 0xc0000155 FORMAT "%3.0" /end MEASUREMENT
/begin MEASUREMENT ctr_msg_qoil_com_diag "Counter of faulty oil quality sensor (QLT) transmitting slots " UBYTE _CNV_A_R_LINEAR_____0_CM 1 100. 0. 255. DISPLAY_IDENTIFIER CTR_MSG_QOIL_COM_DIAG ECU_ADDRESS 0xc0000156 FORMAT "%3.0" /end MEASUREMENT
/begin MEASUREMENT ctr_msg_sens_bat_smt_com_diag "Counter of faulty intelligent battery sensor (IBS) transmitting slots " UBYTE _CNV_A_R_LINEAR_____0_CM 1 100. 0. 255. DISPLAY_IDENTIFIER CTR_MSG_SENS_BAT_SMT_COM_DIAG ECU_ADDRESS 0xd0003e19 FORMAT "%3.0" /end MEASUREMENT
/begin MEASUREMENT ctr_msg_sens_bat_smt_com_stop "Interrupt counter to stop the communictation to the intelligent battery sensor (IBS)" UWORD _CNV_A_R_LINEAR_____0_CM 1 100. 0. 65535. DISPLAY_IDENTIFIER CTR_MSG_SENS_BAT_SMT_COM_STOP ECU_ADDRESS 0xd000522a FORMAT "%5.0" /end MEASUREMENT
/begin MEASUREMENT ctr_msg_qoil_com_stop "Interrupt counter to stop the communictation to the oil quality sensor (QLT)  " UWORD _CNV_A_R_LINEAR_____0_CM 1 100. 0. 65535. DISPLAY_IDENTIFIER CTR_MSG_QOIL_COM_STOP ECU_ADDRESS 0xd0005228 FORMAT "%5.0" /end MEASUREMENT
/begin MEASUREMENT ctr_msg_cwp_com_stop "Interrupt counter to stop the communictation to the electrical coolant water pump" UWORD _CNV_A_R_LINEAR_____0_CM 1 100. 0. 65535. DISPLAY_IDENTIFIER CTR_MSG_CWP_COM_STOP ECU_ADDRESS 0xd0005226 FORMAT "%5.0" /end MEASUREMENT
/begin MEASUREMENT ctr_msg_alter_com_stop "Interrupt counter to stop the communictation to the alternator " UWORD _CNV_A_R_LINEAR_____0_CM 1 100. 0. 65535. DISPLAY_IDENTIFIER CTR_MSG_ALTER_COM_STOP ECU_ADDRESS 0xd0005224 FORMAT "%5.0" /end MEASUREMENT
/begin MEASUREMENT state_bsd_msg_com_stop "Status of the communication STOP counter to the BSD devices" UBYTE _CNV_A_R_LINEAR_____0_CM 1 100. 0. 255. DISPLAY_IDENTIFIER STATE_BSD_MSG_COM_STOP ECU_ADDRESS 0xd0003e18 FORMAT "%3.0" /end MEASUREMENT
/begin MEASUREMENT lv_err_bsd "logical variable for BSD error" UBYTE _CNV_S_2_RANGE__0___1_CM 1 100. 0. 1. DISPLAY_IDENTIFIER LV_ERR_BSD ECU_ADDRESS 0xd000343e BIT_MASK 0x1 /end MEASUREMENT
/begin MEASUREMENT lv_inh_cwp_diag "Flag to freeze the CWP diagnosis in case a non-acknowledge of the BSD component CWP occurred" UBYTE _CNV_S_2_RANGE__0___1_CM 1 100. 0. 1. DISPLAY_IDENTIFIER LV_INH_CWP_DIAG ECU_ADDRESS 0xd0003e1b BIT_MASK 0x1 /end MEASUREMENT
/begin MEASUREMENT lv_msg_alter_com_stop "Flag indication that the communication stop counter of the device alternator <>0" UBYTE _CNV_S_2_RANGE__0___1_CM 1 100. 0. 1. DISPLAY_IDENTIFIER LV_MSG_ALTER_COM_STOP ECU_ADDRESS 0xc000015a BIT_MASK 0x1 /end MEASUREMENT
/begin MEASUREMENT lv_msg_cwp_com_stop "Flag indication that the communication stop counter of the device el. Coolant water pump <>0" UBYTE _CNV_S_2_RANGE__0___1_CM 1 100. 0. 1. DISPLAY_IDENTIFIER LV_MSG_CWP_COM_STOP ECU_ADDRESS 0xc000015b BIT_MASK 0x1 /end MEASUREMENT
/begin MEASUREMENT lv_msg_qoil_com_stop "Flag indication that the communication stop counter of the device oil quality sensor <>0" UBYTE _CNV_S_2_RANGE__0___1_CM 1 100. 0. 1. DISPLAY_IDENTIFIER LV_MSG_QOIL_COM_STOP ECU_ADDRESS 0xc000015c BIT_MASK 0x1 /end MEASUREMENT
/begin MEASUREMENT lv_msg_sens_bat_smt_com_stop "Flag indication that the communication stop counter of the device intelligent battery sensor <>0" UBYTE _CNV_S_2_RANGE__0___1_CM 1 100. 0. 1. DISPLAY_IDENTIFIER LV_MSG_SENS_BAT_SMT_COM_STOP ECU_ADDRESS 0xc000015d BIT_MASK 0x1 /end MEASUREMENT
/begin CHARACTERISTIC c_abc_inc_bsd "Anti - bounce counter increment" VALUE 0xa1029074 _REC_VAL_20_u1 255. _CNV_A_R_LINEAR_____0_CM 0. 255. DISPLAY_IDENTIFIER C_ABC_INC_BSD FORMAT "%3.0" /end CHARACTERISTIC
/begin CHARACTERISTIC c_abc_inc_qoil_com "Anti-bounce counter increment  - diagnosis BSD communication to oil quality sensor" VALUE 0xa10290aa _REC_VAL_20_u1 255. _CNV_A_R_LINEAR_____0_CM 0. 255. DISPLAY_IDENTIFIER C_ABC_INC_QOIL_COM FORMAT "%3.0" /end CHARACTERISTIC
/begin CHARACTERISTIC c_abc_inc_cwp_com "Anti-bounce counter increment  - diagnosis BSD communication to electrical coolant water pump" VALUE 0xa1029079 _REC_VAL_20_u1 255. _CNV_A_R_LINEAR_____0_CM 0. 255. DISPLAY_IDENTIFIER C_ABC_INC_CWP_COM FORMAT "%3.0" /end CHARACTERISTIC
/begin CHARACTERISTIC c_abc_inc_sens_bat_smt_com "Anti-bounce counter increment  - diagnosis BSD communication to intelligent battery sensor" VALUE 0xa10290b1 _REC_VAL_20_u1 255. _CNV_A_R_LINEAR_____0_CM 0. 255. DISPLAY_IDENTIFIER C_ABC_INC_SENS_BAT_SMT_COM FORMAT "%3.0" /end CHARACTERISTIC
/begin CHARACTERISTIC c_abc_inc_alter_com "Anti-bounce counter increment  - diagnosis BSD communication to alternater" VALUE 0xa1029051 _REC_VAL_20_u1 255. _CNV_A_R_LINEAR_____0_CM 0. 255. DISPLAY_IDENTIFIER C_ABC_INC_ALTER_COM FORMAT "%3.0" /end CHARACTERISTIC
/begin CHARACTERISTIC c_ctr_max_msg_cwp_com "Threshold for counter of faulty electrical coolant water pump transmitting slots" VALUE 0xa10292a5 _REC_VAL_20_u1 255. _CNV_A_R_LINEAR_____0_CM 0. 255. DISPLAY_IDENTIFIER C_CTR_MAX_MSG_CWP_COM FORMAT "%3.0" /end CHARACTERISTIC
/begin CHARACTERISTIC c_ctr_max_msg_qoil_com "Threshold for counter of faulty oil quality sensor transmitting slots" VALUE 0xa10292a6 _REC_VAL_20_u1 255. _CNV_A_R_LINEAR_____0_CM 0. 255. DISPLAY_IDENTIFIER C_CTR_MAX_MSG_QOIL_COM FORMAT "%3.0" /end CHARACTERISTIC
/begin CHARACTERISTIC c_ctr_max_msg_sens_bat_smt_com "Threshold for counter of faulty intelligent battery sensor transmitting slots" VALUE 0xa10292a7 _REC_VAL_20_u1 255. _CNV_A_R_LINEAR_____0_CM 0. 255. DISPLAY_IDENTIFIER C_CTR_MAX_MSG_SENS_BAT_SMT_COM FORMAT "%3.0" /end CHARACTERISTIC
/begin CHARACTERISTIC c_ctr_thd_msg_cwp_com_diag "Threshold to disable the functional CWP diagnosis in case a problem with the interface BSD is present" VALUE 0xa10292c7 _REC_VAL_20_u1 255. _CNV_A_R_LINEAR_____0_CM 0. 255. DISPLAY_IDENTIFIER C_CTR_THD_MSG_CWP_COM_DIAG FORMAT "%3.0" /end CHARACTERISTIC
/begin CHARACTERISTIC c_abc_max_bsd "Debounce counter maximum value" VALUE 0xa10290ff _REC_VAL_20_u1 254. _CNV_A_R_LINEAR_____0_CM 1. 255. DISPLAY_IDENTIFIER C_ABC_MAX_BSD FORMAT "%3.0" /end CHARACTERISTIC
/begin CHARACTERISTIC c_abc_max_alter_com "Anti-bounce counter maximum value  - diagnosis BSD communication to alternater" VALUE 0xa10290dc _REC_VAL_20_u1 254. _CNV_A_R_LINEAR_____0_CM 1. 255. DISPLAY_IDENTIFIER C_ABC_MAX_ALTER_COM FORMAT "%3.0" /end CHARACTERISTIC
/begin CHARACTERISTIC c_abc_max_cwp_com "Anti-bounce counter maximum value  - diagnosis BSD communication to electrical coolant water pump" VALUE 0xa1029104 _REC_VAL_20_u1 254. _CNV_A_R_LINEAR_____0_CM 1. 255. DISPLAY_IDENTIFIER C_ABC_MAX_CWP_COM FORMAT "%3.0" /end CHARACTERISTIC
/begin CHARACTERISTIC c_abc_max_qoil_com "Anti-bounce counter maximum value  - diagnosis BSD communication to oil quality sensor" VALUE 0xa1029136 _REC_VAL_20_u1 254. _CNV_A_R_LINEAR_____0_CM 1. 255. DISPLAY_IDENTIFIER C_ABC_MAX_QOIL_COM FORMAT "%3.0" /end CHARACTERISTIC
/begin CHARACTERISTIC c_abc_max_sens_bat_smt_com "Anti-bounce counter maximum value  - diagnosis BSD communication to intelligent battery sensor" VALUE 0xa102913d _REC_VAL_20_u1 254. _CNV_A_R_LINEAR_____0_CM 1. 255. DISPLAY_IDENTIFIER C_ABC_MAX_SENS_BAT_SMT_COM FORMAT "%3.0" /end CHARACTERISTIC
/begin CHARACTERISTIC c_ctr_max_msg_alter_com "Threshold for counter of faulty alternator transmitting slots " VALUE 0xa10292a4 _REC_VAL_20_u1 255. _CNV_A_R_LINEAR_____0_CM 0. 255. DISPLAY_IDENTIFIER C_CTR_MAX_MSG_ALTER_COM FORMAT "%3.0" /end CHARACTERISTIC
/begin CHARACTERISTIC c_ctr_max_alter_com_stop "Time out threshold for counter of alternator transmitting slots " VALUE 0xa10292a0 _REC_VAL_20_u2 65535. _CNV_A_R_LINEAR_____0_CM 0. 65535. DISPLAY_IDENTIFIER C_CTR_MAX_ALTER_COM_STOP FORMAT "%5.0" /end CHARACTERISTIC
/begin CHARACTERISTIC c_ctr_max_cwp_com_stop "Number of time out transmitting slots for electrical coolant water pump " VALUE 0xa10292a2 _REC_VAL_20_u2 65535. _CNV_A_R_LINEAR_____0_CM 0. 65535. DISPLAY_IDENTIFIER C_CTR_MAX_CWP_COM_STOP FORMAT "%5.0" /end CHARACTERISTIC
/begin CHARACTERISTIC c_ctr_max_qoil_com_stop "Number of time out transmitting slots for oil quality sensor" VALUE 0xa10292a8 _REC_VAL_20_u2 65535. _CNV_A_R_LINEAR_____0_CM 0. 65535. DISPLAY_IDENTIFIER C_CTR_MAX_QOIL_COM_STOP FORMAT "%5.0" /end CHARACTERISTIC
/begin CHARACTERISTIC c_ctr_max_sens_bat_smt_com_stop "Number of time out transmitting slots for intelligent battery sensor " VALUE 0xa10292aa _REC_VAL_20_u2 65535. _CNV_A_R_LINEAR_____0_CM 0. 65535. DISPLAY_IDENTIFIER C_CTR_MAX_SENS_BAT_SMT_COM_STOP FORMAT "%5.0" /end CHARACTERISTIC
/begin MEASUREMENT ctr_abc_alter_com "Anti-bounce counter for alternator BSD communication error" UBYTE _CNV_A_R_LINEAR_____0_CM 1 100. 0. 255. DISPLAY_IDENTIFIER CTR_ABC_ALTER_COM ECU_ADDRESS 0xc0000157 FORMAT "%3.0" /end MEASUREMENT
/begin MEASUREMENT ctr_abc_cwp_com "Anti-bounce counter for electrical coolant water pump BSD communication error" UBYTE _CNV_A_R_LINEAR_____0_CM 1 100. 0. 255. DISPLAY_IDENTIFIER CTR_ABC_CWP_COM ECU_ADDRESS 0xc0000158 FORMAT "%3.0" /end MEASUREMENT
/begin MEASUREMENT ctr_abc_qoil_com "Anti-bounce counter for oil quality sensor (QLT) BSD communication error" UBYTE _CNV_A_R_LINEAR_____0_CM 1 100. 0. 255. DISPLAY_IDENTIFIER CTR_ABC_QOIL_COM ECU_ADDRESS 0xc0000159 FORMAT "%3.0" /end MEASUREMENT
/begin MEASUREMENT ctr_abc_sens_bat_smt_com "Anti-bounce counter for intelligent battery sensor (IBS) BSD communication error" UBYTE _CNV_A_R_LINEAR_____0_CM 1 100. 0. 255. DISPLAY_IDENTIFIER CTR_ABC_SENS_BAT_SMT_COM ECU_ADDRESS 0xd0003e1a FORMAT "%3.0" /end MEASUREMENT
/begin MEASUREMENT ctr_end_diag_alter_com "Counter for End of diagnosis condition detection for alternator BSD communication error" UBYTE _CNV_A_R_LINEAR_____0_CM 1 100. 0. 255. DISPLAY_IDENTIFIER CTR_END_DIAG_ALTER_COM ECU_ADDRESS 0xc0000150 FORMAT "%3.0" /end MEASUREMENT
/begin MEASUREMENT ctr_end_diag_cwp_com "Counter for End of diagnosis condition detection for electrical coolant water pump BSD communication error" UBYTE _CNV_A_R_LINEAR_____0_CM 1 100. 0. 255. DISPLAY_IDENTIFIER CTR_END_DIAG_CWP_COM ECU_ADDRESS 0xc0000151 FORMAT "%3.0" /end MEASUREMENT
/begin MEASUREMENT ctr_end_diag_qoil_com "Counter for End of diagnosis condition detection for oil quality sensor (QLT) BSD communication error" UBYTE _CNV_A_R_LINEAR_____0_CM 1 100. 0. 255. DISPLAY_IDENTIFIER CTR_END_DIAG_QOIL_COM ECU_ADDRESS 0xc0000152 FORMAT "%3.0" /end MEASUREMENT
/begin MEASUREMENT ctr_end_diag_sens_bat_smt_com "Counter for End of diagnosis condition detection for intelligent battery sensor (IBS) BSD communication error" UBYTE _CNV_A_R_LINEAR_____0_CM 1 100. 0. 255. DISPLAY_IDENTIFIER CTR_END_DIAG_SENS_BAT_SMT_COM ECU_ADDRESS 0xc0000153 FORMAT "%3.0" /end MEASUREMENT
/begin MEASUREMENT cyc_ctr_efp_diag "counter of not received EFP messages" UBYTE _CNV_A_R_LINEAR_____0_CM 1 100. 0. 255. DISPLAY_IDENTIFIER CYC_CTR_EFP_DIAG ECU_ADDRESS 0xc00001bc FORMAT "%3.0" /end MEASUREMENT
/begin CHARACTERISTIC c_efp_cycnr_max "maximumnumber of missing EFP messages for error debounce counter increment" VALUE 0xa1029325 _REC_VAL_20_u1 254. _CNV_A_R_LINEAR_____0_CM 1. 255. DISPLAY_IDENTIFIER C_EFP_CYCNR_MAX FORMAT "%3.0" /end CHARACTERISTIC
/begin CHARACTERISTIC c_abc_inc_tout_efp "anti bounce counter increment  - diagnosis of timeout CAN message EFP" VALUE 0xa10290c2 _REC_VAL_20_u1 255. _CNV_A_R_LINEAR_____0_CM 0. 255. DISPLAY_IDENTIFIER C_ABC_INC_TOUT_EFP FORMAT "%3.0" /end CHARACTERISTIC
/begin CHARACTERISTIC c_abc_max_tout_efp "anti bounce counter maximum value  - diagnosis of timeout CAN message EFP" VALUE 0xa102914e _REC_VAL_20_u1 254. _CNV_A_R_LINEAR_____0_CM 1. 255. DISPLAY_IDENTIFIER C_ABC_MAX_TOUT_EFP FORMAT "%3.0" /end CHARACTERISTIC
/begin MEASUREMENT lv_err_efp "logical variable error in case of EFP self diagnosis" UBYTE _CNV_S_2_RANGE__0___1_CM 1 100. 0. 1. DISPLAY_IDENTIFIER LV_ERR_EFP ECU_ADDRESS 0xd0003468 BIT_MASK 0x1 /end MEASUREMENT
/begin MEASUREMENT lv_err_efp_crash "logical variable error in case of crash switch off EFP" UBYTE _CNV_S_2_RANGE__0___1_CM 1 100. 0. 1. DISPLAY_IDENTIFIER LV_ERR_EFP_CRASH ECU_ADDRESS 0xd0003467 BIT_MASK 0x1 /end MEASUREMENT
/begin MEASUREMENT cyc_ctr_asr_3_diag "counter of not received ASC3 messages" UBYTE _CNV_A_R_LINEAR_____0_CM 1 100. 0. 255. DISPLAY_IDENTIFIER CYC_CTR_ASR_3_DIAG ECU_ADDRESS 0xc00001c1 FORMAT "%3.0" /end MEASUREMENT
/begin MEASUREMENT cyc_ctr_efp_can_diag "counter of not received EKP messages" UBYTE _CNV_A_R_LINEAR_____0_CM 1 100. 0. 255. DISPLAY_IDENTIFIER CYC_CTR_EFP_CAN_DIAG ECU_ADDRESS 0xc00001d7 FORMAT "%3.0" /end MEASUREMENT
/begin CHARACTERISTIC c_asr_3_cycnr_max "maximum number of missing ASC3 messages for error debounce counter increment" VALUE 0xa10291ab _REC_VAL_20_u1 254. _CNV_A_R_LINEAR_____0_CM 1. 255. DISPLAY_IDENTIFIER C_ASR_3_CYCNR_MAX FORMAT "%3.0" /end CHARACTERISTIC
/begin CHARACTERISTIC c_abc_inc_tout_asr_3 "anti bounce counter increment  - diagnosis of timeout CAN message ASC3" VALUE 0xa10290c0 _REC_VAL_20_u1 255. _CNV_A_R_LINEAR_____0_CM 0. 255. DISPLAY_IDENTIFIER C_ABC_INC_TOUT_ASR_3 FORMAT "%3.0" /end CHARACTERISTIC
/begin CHARACTERISTIC c_abc_max_tout_asr_3 "anti bounce counter maximum value  - diagnosis of timeout CAN message ASC3 " VALUE 0xa102914c _REC_VAL_20_u1 254. _CNV_A_R_LINEAR_____0_CM 1. 255. DISPLAY_IDENTIFIER C_ABC_MAX_TOUT_ASR_3 FORMAT "%3.0" /end CHARACTERISTIC
/begin CHARACTERISTIC c_asr_1_cycnr_max "maximum number of missing ASC1 messages for error debounce counter increment" VALUE 0xa10291aa _REC_VAL_20_u1 254. _CNV_A_R_LINEAR_____0_CM 1. 255. DISPLAY_IDENTIFIER C_ASR_1_CYCNR_MAX FORMAT "%3.0" /end CHARACTERISTIC
/begin MEASUREMENT cyc_ctr_asr_1_diag "counter of not received ASC1 messages" UBYTE _CNV_A_R_LINEAR_____0_CM 1 100. 0. 255. DISPLAY_IDENTIFIER CYC_CTR_ASR_1_DIAG ECU_ADDRESS 0xc00001c0 FORMAT "%3.0" /end MEASUREMENT
/begin CHARACTERISTIC c_abc_inc_tout_asr_1 "anti bounce counter increment  - diagnosis of timeout CAN message ASC1" VALUE 0xa10290bf _REC_VAL_20_u1 255. _CNV_A_R_LINEAR_____0_CM 0. 255. DISPLAY_IDENTIFIER C_ABC_INC_TOUT_ASR_1 FORMAT "%3.0" /end CHARACTERISTIC
/begin CHARACTERISTIC c_abc_max_tout_asr_1 "anti bounce counter maximum value  - diagnosis of timeout CAN message ASC1 " VALUE 0xa102914b _REC_VAL_20_u1 254. _CNV_A_R_LINEAR_____0_CM 1. 255. DISPLAY_IDENTIFIER C_ABC_MAX_TOUT_ASR_1 FORMAT "%3.0" /end CHARACTERISTIC
/begin MEASUREMENT lv_err_tout_asr_1 "logical variable timeout error CAN message ASC1" UBYTE _CNV_S_2_RANGE__0___1_CM 1 100. 0. 1. DISPLAY_IDENTIFIER LV_ERR_TOUT_ASR_1 ECU_ADDRESS 0xd00033cf BIT_MASK 0x1 /end MEASUREMENT
/begin MEASUREMENT lv_err_tout_asr_3 "logical variable timeout error CAN message ASC3 " UBYTE _CNV_S_2_RANGE__0___1_CM 1 100. 0. 1. DISPLAY_IDENTIFIER LV_ERR_TOUT_ASR_3 ECU_ADDRESS 0xd00033d0 BIT_MASK 0x1 /end MEASUREMENT
/begin MEASUREMENT cyc_ctr_asr_4_diag "counter of not received ASC4 messages" UBYTE _CNV_A_R_LINEAR_____0_CM 1 100. 0. 255. DISPLAY_IDENTIFIER CYC_CTR_ASR_4_DIAG ECU_ADDRESS 0xc00001c2 FORMAT "%3.0" /end MEASUREMENT
/begin CHARACTERISTIC c_asr_4_cycnr_max "maximum number of missing ASC messages for error debounce counter increment" VALUE 0xa10291ac _REC_VAL_20_u1 254. _CNV_A_R_LINEAR_____0_CM 1. 255. DISPLAY_IDENTIFIER C_ASR_4_CYCNR_MAX FORMAT "%3.0" /end CHARACTERISTIC
/begin CHARACTERISTIC c_abc_inc_tout_asr_4 "anti bounce counter increment  - diagnosis of timeout CAN message ASC4" VALUE 0xa10290c1 _REC_VAL_20_u1 255. _CNV_A_R_LINEAR_____0_CM 0. 255. DISPLAY_IDENTIFIER C_ABC_INC_TOUT_ASR_4 FORMAT "%3.0" /end CHARACTERISTIC
/begin CHARACTERISTIC c_abc_max_tout_asr_4 "anti bounce counter maximum value  - diagnosis of timeout CAN message ASC4 " VALUE 0xa102914d _REC_VAL_20_u1 254. _CNV_A_R_LINEAR_____0_CM 1. 255. DISPLAY_IDENTIFIER C_ABC_MAX_TOUT_ASR_4 FORMAT "%3.0" /end CHARACTERISTIC
/begin MEASUREMENT lv_err_tout_asr_4 "logical variable timeout error CAN message ASC3 " UBYTE _CNV_S_2_RANGE__0___1_CM 1 100. 0. 1. DISPLAY_IDENTIFIER LV_ERR_TOUT_ASR_4 ECU_ADDRESS 0xd00033d1 BIT_MASK 0x1 /end MEASUREMENT
/begin CHARACTERISTIC c_abc_inc_tout_etcu_1 "anti bounce counter increment  - diagnosis of timeout CAN message EGS1" VALUE 0xa10290c4 _REC_VAL_20_u1 255. _CNV_A_R_LINEAR_____0_CM 0. 255. DISPLAY_IDENTIFIER C_ABC_INC_TOUT_ETCU_1 FORMAT "%3.0" /end CHARACTERISTIC
/begin CHARACTERISTIC c_abc_inc_tout_efp_can "anti bounce counter increment  - diagnosis of timeout CAN message EKP" VALUE 0xa10290c3 _REC_VAL_20_u1 255. _CNV_A_R_LINEAR_____0_CM 0. 255. DISPLAY_IDENTIFIER C_ABC_INC_TOUT_EFP_CAN FORMAT "%3.0" /end CHARACTERISTIC
/begin CHARACTERISTIC c_abc_inc_tout_etcu_2 "anti bounce counter increment  - diagnosis of timeout CAN message EGS2" VALUE 0xa10290c5 _REC_VAL_20_u1 255. _CNV_A_R_LINEAR_____0_CM 0. 255. DISPLAY_IDENTIFIER C_ABC_INC_TOUT_ETCU_2 FORMAT "%3.0" /end CHARACTERISTIC
/begin CHARACTERISTIC c_abc_max_tout_efp_can "anti bounce counter maximum value  - diagnosis of timeout CAN message EKP " VALUE 0xa102914f _REC_VAL_20_u1 254. _CNV_A_R_LINEAR_____0_CM 1. 255. DISPLAY_IDENTIFIER C_ABC_MAX_TOUT_EFP_CAN FORMAT "%3.0" /end CHARACTERISTIC
/begin CHARACTERISTIC c_abc_max_tout_etcu_1 "anti bounce counter maximum value  - diagnosis of timeout CAN message EGS1 " VALUE 0xa1029150 _REC_VAL_20_u1 254. _CNV_A_R_LINEAR_____0_CM 1. 255. DISPLAY_IDENTIFIER C_ABC_MAX_TOUT_ETCU_1 FORMAT "%3.0" /end CHARACTERISTIC
/begin CHARACTERISTIC c_abc_max_tout_etcu_2 "anti bounce counter maximum value  - diagnosis of timeout CAN message EGS2" VALUE 0xa1029151 _REC_VAL_20_u1 254. _CNV_A_R_LINEAR_____0_CM 1. 255. DISPLAY_IDENTIFIER C_ABC_MAX_TOUT_ETCU_2 FORMAT "%3.0" /end CHARACTERISTIC
/begin CHARACTERISTIC c_efp_can_cycnr_max "maximum number of missing EFP messages for error debounce counter increment" VALUE 0xa1029324 _REC_VAL_20_u1 254. _CNV_A_R_LINEAR_____0_CM 1. 255. DISPLAY_IDENTIFIER C_EFP_CAN_CYCNR_MAX FORMAT "%3.0" /end CHARACTERISTIC
/begin CHARACTERISTIC c_etcu_1_cycnr_max "maximum number of missing EGS1 messages for error debounce counter increment" VALUE 0xa102936d _REC_VAL_20_u1 254. _CNV_A_R_LINEAR_____0_CM 1. 255. DISPLAY_IDENTIFIER C_ETCU_1_CYCNR_MAX FORMAT "%3.0" /end CHARACTERISTIC
/begin CHARACTERISTIC c_etcu_2_cycnr_max "maximum number of missing EGS2 messages for error debounce counter increment" VALUE 0xa102936f _REC_VAL_20_u1 254. _CNV_A_R_LINEAR_____0_CM 1. 255. DISPLAY_IDENTIFIER C_ETCU_2_CYCNR_MAX FORMAT "%3.0" /end CHARACTERISTIC
/begin MEASUREMENT cyc_ctr_etcu_1_diag "counter of not received EGS1 messages" UBYTE _CNV_A_R_LINEAR_____0_CM 1 100. 0. 255. DISPLAY_IDENTIFIER CYC_CTR_ETCU_1_DIAG ECU_ADDRESS 0xc00001c6 FORMAT "%3.0" /end MEASUREMENT
/begin MEASUREMENT cyc_ctr_etcu_2_diag "counter of not received EGS2 messages" UBYTE _CNV_A_R_LINEAR_____0_CM 1 100. 0. 255. DISPLAY_IDENTIFIER CYC_CTR_ETCU_2_DIAG ECU_ADDRESS 0xc00001c7 FORMAT "%3.0" /end MEASUREMENT
/begin MEASUREMENT cyc_ctr_etcu_2_tcc_diag "counter for wrong alive counter" UBYTE _CNV_A_R_LINEAR_____0_CM 1 100. 0. 255. DISPLAY_IDENTIFIER CYC_CTR_ETCU_2_TCC_DIAG ECU_ADDRESS 0xc00001c8 FORMAT "%3.0" /end MEASUREMENT
/begin MEASUREMENT cyc_ctr_etcu_2_cks_diag "counter for wrong checksum" UBYTE _CNV_A_R_LINEAR_____0_CM 1 100. 0. 255. DISPLAY_IDENTIFIER CYC_CTR_ETCU_2_CKS_DIAG ECU_ADDRESS 0xc00001c9 FORMAT "%3.0" /end MEASUREMENT
/begin MEASUREMENT cyc_ctr_icl_2_diag "counter of not received INSTR2 messages" UBYTE _CNV_A_R_LINEAR_____0_CM 1 100. 0. 255. DISPLAY_IDENTIFIER CYC_CTR_ICL_2_DIAG ECU_ADDRESS 0xc00001cc FORMAT "%3.0" /end MEASUREMENT
/begin CHARACTERISTIC c_icl_2_cycnr_max "maximum number of missing INSTR2 messages for error debounce counter increment" VALUE 0xa102949c _REC_VAL_20_u1 254. _CNV_A_R_LINEAR_____0_CM 1. 255. DISPLAY_IDENTIFIER C_ICL_2_CYCNR_MAX FORMAT "%3.0" /end CHARACTERISTIC
/begin CHARACTERISTIC c_abc_inc_tout_icl_2 "anti bounce counter increment  - diagnosis of timeout CAN message INSTR2" VALUE 0xa10290c6 _REC_VAL_20_u1 255. _CNV_A_R_LINEAR_____0_CM 0. 255. DISPLAY_IDENTIFIER C_ABC_INC_TOUT_ICL_2_ FORMAT "%3.0" /end CHARACTERISTIC
/begin CHARACTERISTIC c_abc_max_tout_icl_2 "anti bounce counter maximum value  - diagnosis of timeout CAN message INSTR2" VALUE 0xa1029152 _REC_VAL_20_u1 254. _CNV_A_R_LINEAR_____0_CM 1. 255. DISPLAY_IDENTIFIER C_ABC_MAX_TOUT_ICL_2 FORMAT "%3.0" /end CHARACTERISTIC
/begin MEASUREMENT cyc_ctr_icl_3_diag "counter of not received INSTR3 messages" UBYTE _CNV_A_R_LINEAR_____0_CM 1 100. 0. 255. DISPLAY_IDENTIFIER CYC_CTR_ICL_3_DIAG ECU_ADDRESS 0xc00001cd FORMAT "%3.0" /end MEASUREMENT
/begin CHARACTERISTIC c_icl_3_cycnr_max "maximum number of missing INSTR3 messages for error debounce counter increment" VALUE 0xa102949d _REC_VAL_20_u1 254. _CNV_A_R_LINEAR_____0_CM 1. 255. DISPLAY_IDENTIFIER C_ICL_3_CYCNR_MAX FORMAT "%3.0" /end CHARACTERISTIC
/begin CHARACTERISTIC c_abc_inc_tout_icl_3 "anti bounce counter increment  - diagnosis of timeout CAN message INSTR3" VALUE 0xa10290c7 _REC_VAL_20_u1 255. _CNV_A_R_LINEAR_____0_CM 0. 255. DISPLAY_IDENTIFIER C_ABC_INC_TOUT_ICL_3_ FORMAT "%3.0" /end CHARACTERISTIC
/begin CHARACTERISTIC c_abc_max_tout_icl_3 "anti bounce counter maximum value  - diagnosis of timeout CAN message INSTR3" VALUE 0xa1029153 _REC_VAL_20_u1 254. _CNV_A_R_LINEAR_____0_CM 1. 255. DISPLAY_IDENTIFIER C_ABC_MAX_TOUT_ICL_3 FORMAT "%3.0" /end CHARACTERISTIC
/begin MEASUREMENT cyc_ctr_pste_1_diag "counter of not received LWS1 messages" UBYTE _CNV_A_R_LINEAR_____0_CM 1 100. 0. 255. DISPLAY_IDENTIFIER CYC_CTR_PSTE_1_DIAG ECU_ADDRESS 0xc00001d0 FORMAT "%3.0" /end MEASUREMENT
/begin CHARACTERISTIC c_pste_1_cycnr_max "maximum number of missing LWS1 messages for error debounce counter increment" VALUE 0xa102971e _REC_VAL_20_u1 254. _CNV_A_R_LINEAR_____0_CM 1. 255. DISPLAY_IDENTIFIER C_PSTE_1_CYCNR_MAX FORMAT "%3.0" /end CHARACTERISTIC
/begin CHARACTERISTIC c_abc_inc_tout_pste_1 "anti bounce counter increment  - diagnosis of timeout CAN message EGS2" VALUE 0xa10290c9 _REC_VAL_20_u1 255. _CNV_A_R_LINEAR_____0_CM 0. 255. DISPLAY_IDENTIFIER C_ABC_INC_TOUT_PSTE_1 FORMAT "%3.0" /end CHARACTERISTIC
/begin CHARACTERISTIC c_abc_max_tout_pste_1 "anti bounce counter maximum value  - diagnosis of timeout CAN message LWS1" VALUE 0xa1029155 _REC_VAL_20_u1 254. _CNV_A_R_LINEAR_____0_CM 1. 255. DISPLAY_IDENTIFIER C_ABC_MAX_TOUT_PSTE_1 FORMAT "%3.0" /end CHARACTERISTIC
/begin CHARACTERISTIC c_ctr_diag_tcc_can_max_amt_1 "maximum number of wrong alive counter events for error debounce counter increment" VALUE 0xa1029268 _REC_VAL_20_u1 255. _CNV_A_R_LINEAR_____0_CM 0. 255. DISPLAY_IDENTIFIER C_CTR_DIAG_TCC_CAN_MAX_AMT_1 FORMAT "%3.0" /end CHARACTERISTIC
/begin CHARACTERISTIC c_ctr_diag_cpl_can_max_amt_1 "maximum number of wrong complement messages for error debounce counter increment" VALUE 0xa1029267 _REC_VAL_20_u1 255. _CNV_A_R_LINEAR_____0_CM 0. 255. DISPLAY_IDENTIFIER C_CTR_DIAG_CPL_CAN_MAX_AMT_1 FORMAT "%3.0" /end CHARACTERISTIC
/begin MEASUREMENT cyc_ctr_amt_1_diag "counter of not received SSG1 messages" UBYTE _CNV_A_R_LINEAR_____0_CM 1 100. 0. 255. DISPLAY_IDENTIFIER CYC_CTR_AMT_1_DIAG ECU_ADDRESS 0xc00001d5 FORMAT "%3.0" /end MEASUREMENT
/begin CHARACTERISTIC c_amt_1_cycnr_max "maximum number of missing SSG1 messages for error debounce counter increment" VALUE 0xa102919c _REC_VAL_20_u1 254. _CNV_A_R_LINEAR_____0_CM 1. 255. DISPLAY_IDENTIFIER C_AMT_1_CYCNR_MAX FORMAT "%3.0" /end CHARACTERISTIC
/begin CHARACTERISTIC c_abc_inc_tout_amt_1 "anti bounce counter increment  - diagnosis of timeout CAN message SSG1" VALUE 0xa10290be _REC_VAL_20_u1 255. _CNV_A_R_LINEAR_____0_CM 0. 255. DISPLAY_IDENTIFIER C_ABC_INC_TOUT_AMT_1 FORMAT "%3.0" /end CHARACTERISTIC
/begin CHARACTERISTIC c_abc_max_tout_amt_1 "anti bounce counter maximum value  - diagnosis of timeout CAN message SSG1 " VALUE 0xa102914a _REC_VAL_20_u1 254. _CNV_A_R_LINEAR_____0_CM 1. 255. DISPLAY_IDENTIFIER C_ABC_MAX_TOUT_AMT_1 FORMAT "%3.0" /end CHARACTERISTIC
/begin MEASUREMENT lv_err_tout_icl_2 "logical variable timeout error CAN message INSTR2" UBYTE _CNV_S_2_RANGE__0___1_CM 1 100. 0. 1. DISPLAY_IDENTIFIER LV_ERR_TOUT_ICL_2 ECU_ADDRESS 0xd00033cd BIT_MASK 0x1 /end MEASUREMENT
/begin MEASUREMENT lv_err_tout_icl_3 "logical variable timeout error CAN message INSTR3" UBYTE _CNV_S_2_RANGE__0___1_CM 1 100. 0. 1. DISPLAY_IDENTIFIER LV_ERR_TOUT_ICL_3 ECU_ADDRESS 0xd00033ce BIT_MASK 0x1 /end MEASUREMENT
/begin MEASUREMENT lv_err_tout_efp_can "logical variable timeout error CAN message EFP" UBYTE _CNV_S_2_RANGE__0___1_CM 1 100. 0. 1. DISPLAY_IDENTIFIER LV_ERR_TOUT_EFP_CAN ECU_ADDRESS 0xd0003440 BIT_MASK 0x1 /end MEASUREMENT
/begin CHARACTERISTIC c_etcu_2_tcc_cycnr_max "maximum number of wrong alive counter events for error debounce counter increment" VALUE 0xa1029370 _REC_VAL_20_u1 255. _CNV_A_R_LINEAR_____0_CM 0. 255. DISPLAY_IDENTIFIER C_ETCU_2_TCC_CYCNR_MAX FORMAT "%3.0" /end CHARACTERISTIC
/begin CHARACTERISTIC c_etcu_2_cks_cycnr_max "maximum number of wrong complement messages for error debounce counter increment" VALUE 0xa102936e _REC_VAL_20_u1 255. _CNV_A_R_LINEAR_____0_CM 0. 255. DISPLAY_IDENTIFIER C_ETCU_2_CKS_CYCNR_MAX FORMAT "%3.0" /end CHARACTERISTIC
/begin MEASUREMENT lv_err_can_boff "logical variable CAN bus off in bus off mode" UBYTE _CNV_S_2_RANGE__0___1_CM 1 100. 0. 1. DISPLAY_IDENTIFIER LV_ERR_CAN_BOFF ECU_ADDRESS 0xd0003758 BIT_MASK 0x1 /end MEASUREMENT
/begin MEASUREMENT lv_err_can_boff_B "logical variable CAN B in bus off mode" UBYTE _CNV_S_2_RANGE__0___1_CM 1 100. 0. 1. DISPLAY_IDENTIFIER LV_ERR_CAN_BOFF_B ECU_ADDRESS 0xd0003418 BIT_MASK 0x1 /end MEASUREMENT
/begin MEASUREMENT lv_err_can_boff_C "logical variable CAN C in bus off mode" UBYTE _CNV_S_2_RANGE__0___1_CM 1 100. 0. 1. DISPLAY_IDENTIFIER LV_ERR_CAN_BOFF_C ECU_ADDRESS 0xd0003419 BIT_MASK 0x1 /end MEASUREMENT
/begin CHARACTERISTIC c_abc_inc_can_boff_B "anti bounce counter increment  - diagnosis of CAN bus on / off" VALUE 0xa1029075 _REC_VAL_20_u1 255. _CNV_A_R_LINEAR_____0_CM 0. 255. DISPLAY_IDENTIFIER C_ABC_INC_CAN_BOFF_B FORMAT "%3.0" /end CHARACTERISTIC
/begin CHARACTERISTIC c_abc_max_can_boff_B "anti bounce counter maximum value  - diagnosis of CAN bus on / off" VALUE 0xa1029100 _REC_VAL_20_u1 254. _CNV_A_R_LINEAR_____0_CM 1. 255. DISPLAY_IDENTIFIER C_ABC_MAX_CAN_BOFF_B FORMAT "%3.0" /end CHARACTERISTIC
/begin CHARACTERISTIC c_abc_inc_can_boff_C "anti bounce counter increment  - diagnosis of CAN bus on / off" VALUE 0xa1029076 _REC_VAL_20_u1 255. _CNV_A_R_LINEAR_____0_CM 0. 255. DISPLAY_IDENTIFIER C_ABC_INC_CAN_BOFF_C FORMAT "%3.0" /end CHARACTERISTIC
/begin CHARACTERISTIC c_abc_max_can_boff_C "anti bounce counter maximum value  - diagnosis of CAN bus on / off" VALUE 0xa1029101 _REC_VAL_20_u1 254. _CNV_A_R_LINEAR_____0_CM 1. 255. DISPLAY_IDENTIFIER C_ABC_MAX_CAN_BOFF_C FORMAT "%3.0" /end CHARACTERISTIC
/begin CHARACTERISTIC c_abc_inc_locan_boff "Debounce counter increment - diagnosis of LOCAN bus on / off" VALUE 0xa1029096 _REC_VAL_20_u1 255. _CNV_A_R_LINEAR_____0_CM 0. 255. DISPLAY_IDENTIFIER C_ABC_INC_LOCAN_BOFF FORMAT "%3.0" /end CHARACTERISTIC
/begin CHARACTERISTIC c_abc_max_locan_boff "debounce counter maximum value - diagnosis of LOCAN bus on / off" VALUE 0xa1029121 _REC_VAL_20_u1 254. _CNV_A_R_LINEAR_____0_CM 1. 255. DISPLAY_IDENTIFIER C_ABC_MAX_LOCAN_BOFF FORMAT "%3.0" /end CHARACTERISTIC
/begin CHARACTERISTIC c_abc_inc_dcc "Increment counter" VALUE 0xa102907c _REC_VAL_20_u1 255. _CNV_A_R_LINEAR_____0_CM 0. 255. DISPLAY_IDENTIFIER C_ABC_INC_DCC FORMAT "%3.0" /end CHARACTERISTIC
/begin CHARACTERISTIC c_abc_max_dcc "Maximum counter" VALUE 0xa1029107 _REC_VAL_20_u1 254. _CNV_A_R_LINEAR_____0_CM 1. 255. DISPLAY_IDENTIFIER C_ABC_MAX_DCC FORMAT "%3.0" /end CHARACTERISTIC
/begin CHARACTERISTIC c_abc_inc_cs "Anti bounce increment CS diagnosis" VALUE 0xa1029077 _REC_VAL_20_u1 255. _CNV_A_R_LINEAR_____0_CM 0. 255. DISPLAY_IDENTIFIER C_ABC_INC_CS FORMAT "%3.0" /end CHARACTERISTIC
/begin CHARACTERISTIC c_abc_max_cs "Anti bounce maximum CS diagnosis" VALUE 0xa1029102 _REC_VAL_20_u1 254. _CNV_A_R_LINEAR_____0_CM 1. 255. DISPLAY_IDENTIFIER C_ABC_MAX_CS FORMAT "%3.0" /end CHARACTERISTIC
/begin MEASUREMENT iso_m6_diag_ram_com.m6_cur_dmtl_cor_fil_cid18 "" UWORD _CNV_A_R_LINEAR_____133_CM 1 100. 0. 400. DISPLAY_IDENTIFIER M6_CUR_DMTL_COR_FIL_CID18 ECU_ADDRESS 0xd000522c FORMAT "%7.3" /end MEASUREMENT
/begin MEASUREMENT iso_m6_diag_ram_com.m6_cur_dmtl_cor_fil_cid19 "" UWORD _CNV_A_R_LINEAR_____133_CM 1 100. 0. 400. DISPLAY_IDENTIFIER M6_CUR_DMTL_COR_FIL_CID19 ECU_ADDRESS 0xd0005230 FORMAT "%7.3" /end MEASUREMENT
/begin MEASUREMENT iso_m6_diag_ram_com.m6_cur_dmtl_dmtls_test "" UWORD _CNV_A_R_LINEAR_____133_CM 1 100. 0. 400. DISPLAY_IDENTIFIER M6_CUR_DMTL_DMTLS_TEST ECU_ADDRESS 0xd0005234 FORMAT "%7.3" /end MEASUREMENT
/begin MEASUREMENT iso_m6_diag_ram_com.m6_cur_dmtl_thd_dmtls_test "" UWORD _CNV_A_R_LINEAR_____133_CM 1 100. 0. 400. DISPLAY_IDENTIFIER M6_CUR_DMTL_THD_DMTLS_TEST ECU_ADDRESS 0xd0005236 FORMAT "%7.3" /end MEASUREMENT
/begin MEASUREMENT iso_m6_diag_ram_com.m6_cur_dmtl_rough_leak_end "" UWORD _CNV_A_R_LINEAR_____133_CM 1 100. 0. 400. DISPLAY_IDENTIFIER M6_CUR_DMTL_ROUGH_LEAK_END ECU_ADDRESS 0xd0005238 FORMAT "%7.3" /end MEASUREMENT
/begin MEASUREMENT iso_m6_diag_ram_com.m6_cur_dmtl_thd_rough_leak "" UWORD _CNV_A_R_LINEAR_____133_CM 1 100. 0. 400. DISPLAY_IDENTIFIER M6_CUR_DMTL_THD_ROUGH_LEAK ECU_ADDRESS 0xd000523a FORMAT "%7.3" /end MEASUREMENT
/begin MEASUREMENT iso_m6_diag_ram_com.m6_cur_dmtl_small_leak_end "" UWORD _CNV_A_R_LINEAR_____133_CM 1 100. 0. 400. DISPLAY_IDENTIFIER M6_CUR_DMTL_SMALL_LEAK_END ECU_ADDRESS 0xd000523c FORMAT "%7.3" /end MEASUREMENT
/begin MEASUREMENT iso_m6_diag_ram_com.m6_cur_dmtl_ref_leak "" UWORD _CNV_A_R_LINEAR_____133_CM 1 100. 0. 400. DISPLAY_IDENTIFIER M6_CUR_DMTL_REF_LEAK ECU_ADDRESS 0xd000523e FORMAT "%7.3" /end MEASUREMENT
/begin MEASUREMENT iso_m6_diag_ram_com.m6_cur_dmtl_rough_leak_len_end "" UWORD _CNV_A_R_LINEAR_____133_CM 1 100. 0. 400. DISPLAY_IDENTIFIER M6_CUR_DMTL_ROUGH_LEAK_LEN_END ECU_ADDRESS 0xd0005242 FORMAT "%7.3" /end MEASUREMENT
/begin MEASUREMENT iso_m6_diag_ram_com.m6_cur_dmtl_thd_rough_leak_len "" UWORD _CNV_A_R_LINEAR_____133_CM 1 100. 0. 400. DISPLAY_IDENTIFIER M6_CUR_DMTL_THD_ROUGH_LEAK_LEN ECU_ADDRESS 0xd0005244 FORMAT "%7.3" /end MEASUREMENT
/begin MEASUREMENT iso_m6_diag_ram_com.m6_ctr_cnl_small_leak_mes "" UBYTE _CNV_A_R_LINEAR_____0_CM 1 100. 0. 255. DISPLAY_IDENTIFIER M6_CTR_CNL_SMALL_LEAK_MES ECU_ADDRESS 0xd0005240 FORMAT "%3.0" /end MEASUREMENT
/begin MEASUREMENT lv_err_tout_etcu_2 "logical variable timeout error CAN message EGS2" UBYTE _CNV_S_2_RANGE__0___1_CM 1 100. 0. 1. DISPLAY_IDENTIFIER LV_ERR_TOUT_ETCU_2 ECU_ADDRESS 0xd00033cc BIT_MASK 0x1 /end MEASUREMENT
/begin MEASUREMENT lv_inh_diag_isc "Flag for inhibitation of the idle speed control diagnosis" UBYTE _CNV_S_2_RANGE__0___1_CM 1 100. 0. 1. DISPLAY_IDENTIFIER LV_INH_DIAG_ISC ECU_ADDRESS 0xd0003db5 BIT_MASK 0x1 /end MEASUREMENT
/begin MEASUREMENT lv_inh_diag_rbm_isc "Flag for inhibitation of the Idle Speed Control Diagnosis if there is a OBD failure" UBYTE _CNV_S_2_RANGE__0___1_CM 1 100. 0. 1. DISPLAY_IDENTIFIER LV_INH_DIAG_RBM_ISC ECU_ADDRESS 0xd0003db6 BIT_MASK 0x1 /end MEASUREMENT
/begin MEASUREMENT state_rbm_isc "Interface of ISC monitor with the Rate-Based Monitoring statistics" UBYTE _CNV_A_R_LINEAR_____0_CM 1 100. 0. 7. DISPLAY_IDENTIFIER STATE_RBM_ISC ECU_ADDRESS 0xd0003db4 FORMAT "%1.0" /end MEASUREMENT
/begin MEASUREMENT maf_sp_tqi_mmv_diag_isc "Moving mean value of MAF_SP_TQI (RAM cell) - functional check ISC" UWORD _CNV_A_R_LINEAR_____108_CM 1 100. 0. 1389. DISPLAY_IDENTIFIER MAF_SP_TQI_MMV_DIAG_ISC ECU_ADDRESS 0xd0005210 FORMAT "%7.2" /end MEASUREMENT
/begin MEASUREMENT lv_maf_sp_tqi_dyw_diag_isc "Indication for limited dynamic condition - functional check ISC" UBYTE _CNV_S_2_RANGE__0___1_CM 1 100. 0. 1. DISPLAY_IDENTIFIER LV_MAF_SP_TQI_DYW_DIAG_ISC ECU_ADDRESS 0xd0003db7 BIT_MASK 0x1 /end MEASUREMENT
/begin CHARACTERISTIC c_crlc_maf_sp_tqi_diagisc "Correlation constant for calculation of MAF_SP_TQI_MMV_DIAG_ISC" VALUE 0xa102920a _REC_VAL_20_u2 0.9999847 _CNV_A_R_LINEAR_____181_CM 0. 0.9999847 DISPLAY_IDENTIFIER C_CRLC_MAF_SP_TQI_DIAGISC FORMAT "%7.5" /end CHARACTERISTIC
/begin CHARACTERISTIC c_maf_sp_tqi_dyw_diagisc "Dynamic window around MAF_SP_TQI_MMV_DIAG_ISC" VALUE 0xa102956c _REC_VAL_20_u2 1389. _CNV_A_R_LINEAR_____108_CM 0. 1389. DISPLAY_IDENTIFIER C_MAF_SP_TQI_DYW_DIAGISC FORMAT "%7.2" /end CHARACTERISTIC
/begin MEASUREMENT dyw_knks_diag[0] "Bandweite Klopfsensor 1" UWORD _CNV_A_R_LINEAR_____2_CM 1 100. 0. 4.9951171875 DISPLAY_IDENTIFIER DYW_KNKS_DIAG[0] ECU_ADDRESS 0xc0000860 FORMAT "%5.3" /end MEASUREMENT
/begin MEASUREMENT dyw_knks_diag[1] "Bandweite Klopfsensor 2" UWORD _CNV_A_R_LINEAR_____2_CM 1 100. 0. 4.9951171875 DISPLAY_IDENTIFIER DYW_KNKS_DIAG[1] ECU_ADDRESS 0xc0000862 FORMAT "%5.3" /end MEASUREMENT
/begin MEASUREMENT cycnr_dyw_knks_diag[0] "Zyklenzähler 'Master'-Algorithmus für Sensor 1" UBYTE _CNV_A_R_LINEAR_____0_CM 1 100. 0. 255. DISPLAY_IDENTIFIER CYCNR_DYW_KNKS_DIAG[0] ECU_ADDRESS 0xc000086a FORMAT "%3.0" /end MEASUREMENT
/begin MEASUREMENT cycnr_dyw_knks_diag[1] "Zyklenzähler 'Master'-Algorithmus für Sensor 2" UBYTE _CNV_A_R_LINEAR_____0_CM 1 100. 0. 255. DISPLAY_IDENTIFIER CYCNR_DYW_KNKS_DIAG[1] ECU_ADDRESS 0xc000086b FORMAT "%3.0" /end MEASUREMENT
/begin MEASUREMENT v_int_knks_diag[0] "Integralwert der Sensorausgangsspannung des Sensors 1" UWORD _CNV_A_R_EGCP_LINEA_194_CM 1 100. 0. 319.995117 DISPLAY_IDENTIFIER V_INT_KNKS_DIAG[0] ECU_ADDRESS 0xc0000864 FORMAT "%7.3" /end MEASUREMENT
/begin MEASUREMENT v_int_knks_diag[1] "Integralwert der Sensorausgangsspannung des Sensors 2" UWORD _CNV_A_R_EGCP_LINEA_194_CM 1 100. 0. 319.995117 DISPLAY_IDENTIFIER V_INT_KNKS_DIAG[1] ECU_ADDRESS 0xc0000866 FORMAT "%7.3" /end MEASUREMENT
/begin MEASUREMENT cycnr_int_knks_diag[0] "Zyklenzähler 'Slave'-Algorithmus für Sensor 1" UBYTE _CNV_A_R_LINEAR_____145_CM 1 100. 0. 255. DISPLAY_IDENTIFIER CYCNR_INT_KNKS_DIAG[0] ECU_ADDRESS 0xc0000868 FORMAT "%3.0" /end MEASUREMENT
/begin MEASUREMENT cycnr_int_knks_diag[1] "Zyklenzähler 'Slave'-Algorithmus für Sensor 2" UBYTE _CNV_A_R_LINEAR_____145_CM 1 100. 0. 255. DISPLAY_IDENTIFIER CYCNR_INT_KNKS_DIAG[1] ECU_ADDRESS 0xc0000869 FORMAT "%3.0" /end MEASUREMENT
/begin MEASUREMENT lv_err_knks_1 "Fehler Klopfsensor 1 entprellt" UBYTE _CNV_S_2_RANGE__0___1_CM 1 100. 0. 1. DISPLAY_IDENTIFIER LV_ERR_KNKS_1 ECU_ADDRESS 0xd00033d5 BIT_MASK 0x1 /end MEASUREMENT
/begin MEASUREMENT lv_err_knks_2 "Fehler Klopfsensor 2 entprellt" UBYTE _CNV_S_2_RANGE__0___1_CM 1 100. 0. 1. DISPLAY_IDENTIFIER LV_ERR_KNKS_2 ECU_ADDRESS 0xd00033d6 BIT_MASK 0x1 /end MEASUREMENT
/begin CHARACTERISTIC c_nl_min_diag "minimale Geraeuschwertschwelle fuer 'Range Check'" VALUE 0xa1029682 _REC_VAL_20_u1 4.98046875 _CNV_A_R_LINEAR_____195_CM 0. 4.98046875 DISPLAY_IDENTIFIER C_NL_MIN_DIAG FORMAT "%4.2" /end CHARACTERISTIC
/begin CHARACTERISTIC c_dyw_min_knks_diag "Bandweiten-Schwellwert fuer Fehlererkennung durch 'Master Algorithm'" VALUE 0xa1029312 _REC_VAL_20_u2 4.9951171875 _CNV_A_R_LINEAR_____2_CM 0. 4.9951171875 DISPLAY_IDENTIFIER C_DYW_MIN_KNKS_DIAG FORMAT "%5.3" /end CHARACTERISTIC
/begin CHARACTERISTIC c_v_int_knks_diag "Spannungs-Schwellwert fuer Fehlererkennung durch 'Slave Algorithm'" VALUE 0xa1029b66 _REC_VAL_20_u2 319.995117 _CNV_A_R_EGCP_LINEA_194_CM 0. 319.995117 DISPLAY_IDENTIFIER C_V_INT_KNKS_DIAG FORMAT "%7.3" /end CHARACTERISTIC
/begin CHARACTERISTIC c_cycnr_knks_diag "Anzahl der Diagnosezyklen" VALUE 0xa10292e6 _REC_VAL_20_u1 255. _CNV_A_R_LINEAR_____145_CM 0. 255. DISPLAY_IDENTIFIER C_CYCNR_KNKS_DIAG FORMAT "%3.0" /end CHARACTERISTIC
/begin CHARACTERISTIC c_nl_max_diag "maximale Geraeuschwertschwelle fuer 'Range Check'" VALUE 0xa1029680 _REC_VAL_20_u1 4.98046875 _CNV_A_R_LINEAR_____195_CM 0. 4.98046875 DISPLAY_IDENTIFIER C_NL_MAX_DIAG FORMAT "%4.2" /end CHARACTERISTIC
/begin CHARACTERISTIC c_maf_min_knks_diag "MAF-Schwelle zur Aktivierung der Klopfsensor-Diagnose" VALUE 0xa102955c _REC_VAL_20_u2 1389. _CNV_A_R_LINEAR_____108_CM 0. 1389. DISPLAY_IDENTIFIER C_MAF_MIN_KNKS_DIAG FORMAT "%7.2" /end CHARACTERISTIC
/begin CHARACTERISTIC c_n_min_knks_diag "Drehzahl-Schwelle zur Aktivierung der Klopfsensor-Diagnose" VALUE 0xa1029635 _REC_VAL_20_u1 8140. _CNV_A_R_LINEAR_____9_CM 20. 8160. DISPLAY_IDENTIFIER C_N_MIN_KNKS_DIAG FORMAT "%4.0" /end CHARACTERISTIC
/begin CHARACTERISTIC c_abc_max_knks "Maximalwert Entprellzaehler" VALUE 0xa102911c _REC_VAL_20_u1 254. _CNV_A_R_LINEAR_____0_CM 1. 255. DISPLAY_IDENTIFIER C_ABC_MAX_KNKS FORMAT "%3.0" /end CHARACTERISTIC
/begin CHARACTERISTIC c_abc_inc_knks "Inkrement Entprellzaehler" VALUE 0xa1029091 _REC_VAL_20_u1 255. _CNV_A_R_LINEAR_____0_CM 0. 255. DISPLAY_IDENTIFIER C_ABC_INC_KNKS FORMAT "%3.0" /end CHARACTERISTIC
/begin CHARACTERISTIC c_abc_inc_maf "Debounce counter increment, mass air flow meter diagnosis" VALUE 0xa1029097 _REC_VAL_20_u1 255. _CNV_A_R_LINEAR_____0_CM 0. 255. DISPLAY_IDENTIFIER C_ABC_INC_MAF FORMAT "%3.0" /end CHARACTERISTIC
/begin CHARACTERISTIC c_abc_max_maf "Debounce counter maximum value, mass air flow meter diagnosis" VALUE 0xa1029122 _REC_VAL_20_u1 254. _CNV_A_R_LINEAR_____0_CM 1. 255. DISPLAY_IDENTIFIER C_ABC_MAX_MAF FORMAT "%3.0" /end CHARACTERISTIC
/begin CHARACTERISTIC c_abc_max_msw_2 "Debounce counter maximum value - MSW diagnosis" VALUE 0xa1029128 _REC_VAL_20_u1 254. _CNV_A_R_LINEAR_____0_CM 1. 255. DISPLAY_IDENTIFIER C_ABC_MAX_MSW_2 FORMAT "%3.0" /end CHARACTERISTIC
/begin CHARACTERISTIC c_abc_inc_msw_2 "Debounce counter increment - MSW diagnosis" VALUE 0xa102909d _REC_VAL_20_u1 255. _CNV_A_R_LINEAR_____0_CM 0. 255. DISPLAY_IDENTIFIER C_ABC_INC_MSW_2 FORMAT "%3.0" /end CHARACTERISTIC
/begin CHARACTERISTIC c_t_min_msw_bit_diag "Min. diagnostic threshold - Toggle bit monitoring" VALUE 0xa10298fb _REC_VAL_20_u1 2550. _CNV_A_R_LINEAR_____18_CM 0. 2550. DISPLAY_IDENTIFIER C_T_MIN_MSW_BIT_DIAG FORMAT "%4.0" /end CHARACTERISTIC
/begin CHARACTERISTIC c_t_max_msw_bit_diag "Max. diagnostic threshold - Toggle bit monitoring" VALUE 0xa10298c4 _REC_VAL_20_u1 2550. _CNV_A_R_LINEAR_____18_CM 0. 2550. DISPLAY_IDENTIFIER C_T_MAX_MSW_BIT_DIAG FORMAT "%4.0" /end CHARACTERISTIC
/begin CHARACTERISTIC c_abc_inc_msw_tog "Debounce counter increment - Toggle bit monitoring" VALUE 0xa102909f _REC_VAL_20_u1 255. _CNV_A_R_LINEAR_____0_CM 0. 255. DISPLAY_IDENTIFIER C_ABC_INC_MSW_TOG FORMAT "%3.0" /end CHARACTERISTIC
/begin CHARACTERISTIC c_abc_max_msw_tog "Debounce counter maximum value - Toggle bit monitoring" VALUE 0xa102912a _REC_VAL_20_u1 254. _CNV_A_R_LINEAR_____0_CM 1. 255. DISPLAY_IDENTIFIER C_ABC_MAX_MSW_TOG FORMAT "%3.0" /end CHARACTERISTIC
/begin CHARACTERISTIC c_abc_inc_msw_3 "Debounce counter increment - MSW diagnosis" VALUE 0xa102909e _REC_VAL_20_u1 255. _CNV_A_R_LINEAR_____0_CM 0. 255. DISPLAY_IDENTIFIER C_ABC_INC_MSW_3 FORMAT "%3.0" /end CHARACTERISTIC
/begin CHARACTERISTIC c_abc_max_msw_3 "Debounce counter maximum value - MSW diagnosis" VALUE 0xa1029129 _REC_VAL_20_u1 254. _CNV_A_R_LINEAR_____0_CM 1. 255. DISPLAY_IDENTIFIER C_ABC_MAX_MSW_3 FORMAT "%3.0" /end CHARACTERISTIC
/begin MEASUREMENT lv_err_msw_3 "???" UBYTE _CNV_S_2_RANGE__0___1_CM 1 100. 0. 1. DISPLAY_IDENTIFIER LV_ERR_MSW_3 ECU_ADDRESS 0xd0003422 BIT_MASK 0x1 /end MEASUREMENT
/begin MEASUREMENT lv_err_msw_tog "???" UBYTE _CNV_S_2_RANGE__0___1_CM 1 100. 0. 1. DISPLAY_IDENTIFIER LV_ERR_MSW_TOG ECU_ADDRESS 0xd0003420 BIT_MASK 0x1 /end MEASUREMENT
/begin MEASUREMENT lv_err_msw_2 "???" UBYTE _CNV_S_2_RANGE__0___1_CM 1 100. 0. 1. DISPLAY_IDENTIFIER LV_ERR_MSW_2 ECU_ADDRESS 0xd0003421 BIT_MASK 0x1 /end MEASUREMENT
/begin MEASUREMENT t_poil_swi_pwl "Timer for oil pressure inclination after engine stop" UBYTE _CNV_A_R_LINEAR_____4_CM 1 100. 0. 6.2 DISPLAY_IDENTIFIER T_POIL_SWI_PWL ECU_ADDRESS 0xd0003ca8 FORMAT "%3.1" /end MEASUREMENT
/begin CHARACTERISTIC c_abc_inc_poil_swi "Anti bounce increment value, POIL_SWI" VALUE 0xa10290a5 _REC_VAL_20_u1 255. _CNV_A_R_LINEAR_____0_CM 0. 255. DISPLAY_IDENTIFIER C_ABC_INC_POIL_SWI FORMAT "%3.0" /end CHARACTERISTIC
/begin CHARACTERISTIC c_abc_max_poil_swi "Anti-bounce max. value, POIL_SWI" VALUE 0xa1029130 _REC_VAL_20_u1 254. _CNV_A_R_LINEAR_____0_CM 1. 255. DISPLAY_IDENTIFIER C_ABC_MAX_POIL_SWI FORMAT "%3.0" /end CHARACTERISTIC
/begin CHARACTERISTIC c_t_poil_swi_pwl "Time for oil pressure inclination" VALUE 0xa1029937 _REC_VAL_20_u1 6.2 _CNV_A_R_LINEAR_____4_CM 0. 6.2 DISPLAY_IDENTIFIER C_T_POIL_SWI_PWL FORMAT "%3.1" /end CHARACTERISTIC
/begin CHARACTERISTIC c_toil_poil_swi_max_diag "Time for oil pressure inclination" VALUE 0xa1029a87 _REC_VAL_20_u1 200. _CNV_A_R_LINEAR_____25_CM -40. 160. DISPLAY_IDENTIFIER C_TOIL_POIL_SWI_MAX_DIAG FORMAT "%3.0" /end CHARACTERISTIC
/begin CHARACTERISTIC c_toil_poil_swi_min_diag "Minimum diagnosis threshold TOIL" VALUE 0xa1029a88 _REC_VAL_20_u1 200. _CNV_A_R_LINEAR_____25_CM -40. 160. DISPLAY_IDENTIFIER C_TOIL_POIL_SWI_MIN_DIAG FORMAT "%3.0" /end CHARACTERISTIC
/begin MEASUREMENT lv_err_poil_swi "Error oil pressure switch" UBYTE _CNV_S_2_RANGE__0___1_CM 1 100. 0. 1. DISPLAY_IDENTIFIER LV_ERR_POIL_SWI ECU_ADDRESS 0xd000343f BIT_MASK 0x1 /end MEASUREMENT
/begin MEASUREMENT lv_deac_diag_poil_swi "deactivation of  diagnosis oil pressure switch" UBYTE _CNV_S_2_RANGE__0___1_CM 1 100. 0. 1. DISPLAY_IDENTIFIER LV_DEAC_DIAG_POIL_SWI ECU_ADDRESS 0xd0003ca9 BIT_MASK 0x1 /end MEASUREMENT
/begin CHARACTERISTIC c_abc_inc_pvs_ratio "Increment debounce counter" VALUE 0xa10290a9 _REC_VAL_20_u1 255. _CNV_A_R_LINEAR_____0_CM 0. 255. DISPLAY_IDENTIFIER C_ABC_INC_PVS_RATIO FORMAT "%3.0" /end CHARACTERISTIC
/begin CHARACTERISTIC c_abc_max_pvs_ratio "Maximum value debounce counter " VALUE 0xa1029135 _REC_VAL_20_u1 254. _CNV_A_R_LINEAR_____0_CM 1. 255. DISPLAY_IDENTIFIER C_ABC_MAX_PVS_RATIO FORMAT "%3.0" /end CHARACTERISTIC
/begin CHARACTERISTIC c_v_pvs_min_diag_2 "lower diagnosis-threshold channel 2" VALUE 0xa1029b80 _REC_VAL_20_u2 4.9951171875 _CNV_A_R_LINEAR_____2_CM 0. 4.9951171875 DISPLAY_IDENTIFIER C_V_PVS_MIN_DIAG_2 FORMAT "%5.3" /end CHARACTERISTIC
/begin CHARACTERISTIC c_t_is_pvs_err "Minimum idle dwell time in error cases" VALUE 0xa10298ac _REC_VAL_20_u1 2.55 _CNV_A_R_LINEAR_____3_CM 0. 2.55 DISPLAY_IDENTIFIER C_T_IS_PVS_ERR FORMAT "%4.2" /end CHARACTERISTIC
/begin CHARACTERISTIC ip_pvs_ratio_hys "permissible variance of the PVS-values" CURVE 0xa1027792 _REC_CUR_20_u2_u2 4.9951171875 _CNV_A_R_LINEAR_____2_CM 0. 4.9951171875 DISPLAY_IDENTIFIER IP_PVS_RATIO_HYS FORMAT "%5.3"
 /begin AXIS_DESCR COM_AXIS online_dummy _CNV_A_R_LINEAR_____2_CM 2 0. 4.9951171875 FORMAT "%5.3" AXIS_PTS_REF ldp_v_pvs_min /end AXIS_DESCR
/end CHARACTERISTIC
/begin MEASUREMENT lv_err_pvs_1 "Logical value (set, if PVS - Channel 1 has debounced a range error)" UBYTE _CNV_S_2_RANGE__0___1_CM 1 100. 0. 1. DISPLAY_IDENTIFIER LV_ERR_PVS_1 ECU_ADDRESS 0xd00033f0 BIT_MASK 0x1 /end MEASUREMENT
/begin MEASUREMENT lv_err_pvs_2 "Logical value (set, if PVS - Channel 2 has debounced a range error)" UBYTE _CNV_S_2_RANGE__0___1_CM 1 100. 0. 1. DISPLAY_IDENTIFIER LV_ERR_PVS_2 ECU_ADDRESS 0xd00033f1 BIT_MASK 0x1 /end MEASUREMENT
/begin MEASUREMENT lv_dyn_lim_1_act "Limited dynamic 1 is  active / passive" UBYTE _CNV_S_2_RANGE__0___1_CM 1 100. 0. 1. DISPLAY_IDENTIFIER LV_DYN_LIM_1_ACT ECU_ADDRESS 0xd0003b55 BIT_MASK 0x1 /end MEASUREMENT
/begin MEASUREMENT lv_dyn_lim_2_act "Limited dynamic 2 is  active / passive" UBYTE _CNV_S_2_RANGE__0___1_CM 1 100. 0. 1. DISPLAY_IDENTIFIER LV_DYN_LIM_2_ACT ECU_ADDRESS 0xd0003b56 BIT_MASK 0x1 /end MEASUREMENT
/begin MEASUREMENT state_pvs_diag "Status of PVS-diagnosis" UBYTE _CNV_S_9_RANGE_STAT_251_CM 1 100. 0. 128. DISPLAY_IDENTIFIER STATE_PVS_DIAG ECU_ADDRESS 0xd0003b50 /end MEASUREMENT
/begin MEASUREMENT lv_n_sp_is_lih_act "LIH idle speed setpoint" UBYTE _CNV_S_2_RANGE__0___1_CM 1 100. 0. 1. DISPLAY_IDENTIFIER LV_N_SP_IS_LIH_ACT ECU_ADDRESS 0xd0003b58 BIT_MASK 0x1 /end MEASUREMENT
/begin MEASUREMENT lv_err_pvs "Logical value (set, if a PVS -error is debounced)" UBYTE _CNV_S_2_RANGE__0___1_CM 1 100. 0. 1. DISPLAY_IDENTIFIER LV_ERR_PVS ECU_ADDRESS 0xd0003b52 BIT_MASK 0x1 /end MEASUREMENT
/begin MEASUREMENT lv_det_not_plaus_act "PV_AV / Brake signal current not plausible" UBYTE _CNV_S_2_RANGE__0___1_CM 1 100. 0. 1. DISPLAY_IDENTIFIER LV_DET_NOT_PLAUS_ACT ECU_ADDRESS 0xd0003b54 BIT_MASK 0x1 /end MEASUREMENT
/begin CHARACTERISTIC c_abc_max_pvs_bls_not_plaus "PVS_BLS_BTS_PLAUS counter maximum value" VALUE 0xa1029134 _REC_VAL_20_u1 254. _CNV_A_R_LINEAR_____0_CM 1. 255. DISPLAY_IDENTIFIER C_ABC_MAX_PVS_BLS_NOT_PLAUS FORMAT "%3.0" /end CHARACTERISTIC
/begin CHARACTERISTIC c_abc_inc_pvs_bls_not_plaus "PVS_BLS_BTS_PLAUS counter increment value" VALUE 0xa10290a8 _REC_VAL_20_u1 255. _CNV_A_R_LINEAR_____0_CM 0. 255. DISPLAY_IDENTIFIER C_ABC_INC_PVS_BLS_NOT_PLAUS FORMAT "%3.0" /end CHARACTERISTIC
/begin CHARACTERISTIC c_abc_inc_v_ref_1 "Anti bounce increment value for V_REF_1" VALUE 0xa10290cf _REC_VAL_20_u1 255. _CNV_A_R_LINEAR_____0_CM 0. 255. DISPLAY_IDENTIFIER C_ABC_INC_V_REF_1 FORMAT "%3.0" /end CHARACTERISTIC
/begin CHARACTERISTIC c_abc_inc_v_ref_2 "Anti bounce increment value for V_REF_2" VALUE 0xa10290d0 _REC_VAL_20_u1 255. _CNV_A_R_LINEAR_____0_CM 0. 255. DISPLAY_IDENTIFIER C_ABC_INC_V_REF_2 FORMAT "%3.0" /end CHARACTERISTIC
/begin CHARACTERISTIC c_abc_max_v_ref_1 "Anti-bounce maximum value (x=1,2)" VALUE 0xa102915b _REC_VAL_20_u1 254. _CNV_A_R_LINEAR_____0_CM 1. 255. DISPLAY_IDENTIFIER C_ABC_MAX_V_REF_1 FORMAT "%3.0" /end CHARACTERISTIC
/begin CHARACTERISTIC c_abc_max_v_ref_2 "Anti-bounce maximum value (x=1,2)" VALUE 0xa102915c _REC_VAL_20_u1 254. _CNV_A_R_LINEAR_____0_CM 1. 255. DISPLAY_IDENTIFIER C_ABC_MAX_V_REF_2 FORMAT "%3.0" /end CHARACTERISTIC
/begin CHARACTERISTIC c_abc_inc_pvs_1 "Anti-bounce increment value, PVS 1" VALUE 0xa10290a6 _REC_VAL_20_u1 255. _CNV_A_R_LINEAR_____0_CM 0. 255. DISPLAY_IDENTIFIER C_ABC_INC_PVS_1 FORMAT "%3.0" /end CHARACTERISTIC
/begin CHARACTERISTIC c_abc_inc_pvs_2 "Anti-bounce increment value, PVS 2" VALUE 0xa10290a7 _REC_VAL_20_u1 255. _CNV_A_R_LINEAR_____0_CM 0. 255. DISPLAY_IDENTIFIER C_ABC_INC_PVS_2 FORMAT "%3.0" /end CHARACTERISTIC
/begin CHARACTERISTIC c_abc_max_pvs_1 "Anti-bounce maximum value, PVS 1" VALUE 0xa1029132 _REC_VAL_20_u1 254. _CNV_A_R_LINEAR_____0_CM 1. 255. DISPLAY_IDENTIFIER C_ABC_MAX_PVS_1 FORMAT "%3.0" /end CHARACTERISTIC
/begin CHARACTERISTIC c_abc_max_pvs_2 "Anti-bounce maximum value, PVS 2" VALUE 0xa1029133 _REC_VAL_20_u1 254. _CNV_A_R_LINEAR_____0_CM 1. 255. DISPLAY_IDENTIFIER C_ABC_MAX_PVS_2 FORMAT "%3.0" /end CHARACTERISTIC
/begin MEASUREMENT lv_pvs_bls_not_plaus_act "Plausibility error PVS recognized without error entry" UBYTE _CNV_S_2_RANGE__0___1_CM 1 100. 0. 1. DISPLAY_IDENTIFIER LV_PVS_BLS_NOT_PLAUS_ACT ECU_ADDRESS 0xd0003b53 BIT_MASK 0x1 /end MEASUREMENT
/begin MEASUREMENT ctr_pvs_bls_not_plaus_act "Counter plausibility error PVS recognized without error entry" UBYTE _CNV_A_R_LINEAR_____0_CM 1 100. 0. 255. DISPLAY_IDENTIFIER CTR_PVS_BLS_NOT_PLAUS_ACT ECU_ADDRESS 0xc0000b80 FORMAT "%3.0" /end MEASUREMENT
/begin CHARACTERISTIC c_pvs_bls_bts_plaus_conf "Enable bit for plausibility check" VALUE 0xa1029737 _REC_VAL_20_u1 2. _CNV_A_R_LINEAR_____0_CM 0. 2. DISPLAY_IDENTIFIER C_PVS_BLS_BTS_PLAUS_CONF FORMAT "%2.0" /end CHARACTERISTIC
/begin AXIS_PTS ldp_v_pvs_min "" 0xa1021676 online_dummy _REC_AXS_20_u2 4.9951171875 _CNV_A_R_LINEAR_____2_CM 2 0. 4.9951171875 FORMAT "%5.3" /end AXIS_PTS
/begin MEASUREMENT lv_err_v_ref_2 "Logical value (set, if supply voltage PVS- Channel 2 debounced)" UBYTE _CNV_S_2_RANGE__0___1_CM 1 100. 0. 1. DISPLAY_IDENTIFIER LV_ERR_V_REF_2 ECU_ADDRESS 0xd00033ef BIT_MASK 0x1 /end MEASUREMENT
/begin MEASUREMENT lv_err_pvs_double "Logical value (set, if a PVS double error is present)" UBYTE _CNV_S_2_RANGE__0___1_CM 1 100. 0. 1. DISPLAY_IDENTIFIER LV_ERR_PVS_DOUBLE ECU_ADDRESS 0xd00033f3 BIT_MASK 0x1 /end MEASUREMENT
/begin MEASUREMENT lv_err_v_ref_1 "Logical value (set, if supply voltage PVS- Channel 1  debounced)" UBYTE _CNV_S_2_RANGE__0___1_CM 1 100. 0. 1. DISPLAY_IDENTIFIER LV_ERR_V_REF_1 ECU_ADDRESS 0xd00033ee BIT_MASK 0x1 /end MEASUREMENT
/begin MEASUREMENT lv_err_pvs_bls_not_plaus "Plausibility error PVS / Brake recognized" UBYTE _CNV_S_2_RANGE__0___1_CM 1 100. 0. 1. DISPLAY_IDENTIFIER LV_ERR_PVS_BLS_NOT_PLAUS ECU_ADDRESS 0xd00033f4 BIT_MASK 0x1 /end MEASUREMENT
/begin MEASUREMENT lv_det_err_pvs "Logical value (set, if a PVS-error is present)" UBYTE _CNV_S_2_RANGE__0___1_CM 1 100. 0. 1. DISPLAY_IDENTIFIER LV_DET_ERR_PVS ECU_ADDRESS 0xc0000b83 BIT_MASK 0x1 /end MEASUREMENT
/begin CHARACTERISTIC c_vcc_dif_pvs "max. permissible variance of the supply voltage of 10V" VALUE 0xa1029be6 _REC_VAL_20_u2 9.9902 _CNV_A_R_LINEAR_____252_CM 0. 9.9902 DISPLAY_IDENTIFIER C_VCC_DIF_PVS FORMAT "%5.3" /end CHARACTERISTIC
/begin CHARACTERISTIC c_v_pvs_min_diag_1 "lower diagnosis-threshold channel 1" VALUE 0xa1029b7e _REC_VAL_20_u2 4.9951171875 _CNV_A_R_LINEAR_____2_CM 0. 4.9951171875 DISPLAY_IDENTIFIER C_V_PVS_MIN_DIAG_1 FORMAT "%5.3" /end CHARACTERISTIC
/begin CHARACTERISTIC c_v_pvs_min_diag_min_1 "Upper diagnosis threshold for switching from faulty channel to error-free" VALUE 0xa1029b82 _REC_VAL_20_u2 4.9951171875 _CNV_A_R_LINEAR_____2_CM 0. 4.9951171875 DISPLAY_IDENTIFIER C_V_PVS_MIN_DIAG_MIN_1 FORMAT "%5.3" /end CHARACTERISTIC
/begin CHARACTERISTIC c_v_pvs_min_diag_min_2 "Upper diagnosis threshold for switching from faulty channel to error-free" VALUE 0xa1029b84 _REC_VAL_20_u2 4.9951171875 _CNV_A_R_LINEAR_____2_CM 0. 4.9951171875 DISPLAY_IDENTIFIER C_V_PVS_MIN_DIAG_MIN_2 FORMAT "%5.3" /end CHARACTERISTIC
/begin CHARACTERISTIC c_v_pvs_max_diag_1 "Upper diagnosis threshold channel 1" VALUE 0xa1029b7a _REC_VAL_20_u2 4.9951171875 _CNV_A_R_LINEAR_____2_CM 0. 4.9951171875 DISPLAY_IDENTIFIER C_V_PVS_MAX_DIAG_1 FORMAT "%5.3" /end CHARACTERISTIC
/begin CHARACTERISTIC c_v_pvs_max_diag_2 "Upper diagnosis threshold channel 2" VALUE 0xa1029b7c _REC_VAL_20_u2 4.9951171875 _CNV_A_R_LINEAR_____2_CM 0. 4.9951171875 DISPLAY_IDENTIFIER C_V_PVS_MAX_DIAG_2 FORMAT "%5.3" /end CHARACTERISTIC
/begin AXIS_PTS ldp_vs_ip_pv_av_max_brake "" 0xa10218bc vs _REC_AXS_20_u1 255. _CNV_A_R_LINEAR_____6_CM 5 0. 255. FORMAT "%3.0" /end AXIS_PTS
/begin AXIS_PTS ldp_brake_prs_ip_pv_av_max "" 0xa102087a brake_prs _REC_AXS_20_u1 255. _CNV_A_R_LINEAR_____67_CM 5 0. 255. FORMAT "%3.0" /end AXIS_PTS
/begin CHARACTERISTIC ip_pv_av_max_brake_vs "PV_AV limit for VS" CURVE 0xa1027706 _REC_CUR_20_u1_u1 99.609375 _CNV_A_R_LINEAR_____5_CM 0. 99.609375 DISPLAY_IDENTIFIER IP_PV_AV_MAX_BRAKE_VS FORMAT "%9.6"
 /begin AXIS_DESCR COM_AXIS vs _CNV_A_R_LINEAR_____6_CM 5 0. 255. FORMAT "%3.0" AXIS_PTS_REF ldp_vs_ip_pv_av_max_brake /end AXIS_DESCR
/end CHARACTERISTIC
/begin CHARACTERISTIC ip_pv_av_max_brake_prs "PV_AV limit for brake pressure" CURVE 0xa1027700 _REC_CUR_20_u1_u1 99.609375 _CNV_A_R_LINEAR_____5_CM 0. 99.609375 DISPLAY_IDENTIFIER IP_PV_AV_MAX_BRAKE_PRS FORMAT "%9.6"
 /begin AXIS_DESCR COM_AXIS brake_prs _CNV_A_R_LINEAR_____67_CM 5 0. 255. FORMAT "%3.0" AXIS_PTS_REF ldp_brake_prs_ip_pv_av_max /end AXIS_DESCR
/end CHARACTERISTIC
/begin CHARACTERISTIC lc_brake_prs "Switch to enable brake pressure monitoring for plausibility check" VALUE 0xa1029d0e _REC_VAL_20_u1 1. _CNV_S_2_RANGE__0___1_CM 0. 1. DISPLAY_IDENTIFIER LC_BRAKE_PRS /end CHARACTERISTIC
/begin MEASUREMENT ctr_c_t_vs_brake_max "Delay timer for vehicle speed in PVS_BLS_BTS_PLAUS" UBYTE _CNV_A_R_LINEAR_____3_CM 1 100. 0. 2.55 DISPLAY_IDENTIFIER CTR_C_T_VS_BRAKE_MAX ECU_ADDRESS 0xc0000b81 FORMAT "%4.2" /end MEASUREMENT
/begin CHARACTERISTIC c_t_thd_vs_brake_max "Delay timer threshold for vehicle speed in PVS_BLS_BTS_PLAUS" VALUE 0xa1029979 _REC_VAL_20_u1 2.55 _CNV_A_R_LINEAR_____3_CM 0. 2.55 DISPLAY_IDENTIFIER C_T_THD_VS_BRAKE_MAX FORMAT "%4.2" /end CHARACTERISTIC
/begin MEASUREMENT pv_av_max_brake_det "PV_AV_MAX_BRAKE_DET" UBYTE _CNV_A_R_LINEAR_____5_CM 1 100. 0. 99.609375 DISPLAY_IDENTIFIER PV_AV_MAX_BRAKE_DET ECU_ADDRESS 0xd0003b51 FORMAT "%9.6" /end MEASUREMENT
/begin CHARACTERISTIC c_pv_av_brake_max "Maximum PV_AV threshold for PVS_BLS_BTS_PLAUS" VALUE 0xa1029724 _REC_VAL_20_u1 99.609375 _CNV_A_R_LINEAR_____5_CM 0. 99.609375 DISPLAY_IDENTIFIER C_PV_AV_BRAKE_MAX FORMAT "%9.6" /end CHARACTERISTIC
/begin CHARACTERISTIC c_pv_av_brake_min "Minimum PV_AV threshold for PVS_BLS_BTS_PLAUS" VALUE 0xa1029725 _REC_VAL_20_u1 99.609375 _CNV_A_R_LINEAR_____5_CM 0. 99.609375 DISPLAY_IDENTIFIER C_PV_AV_BRAKE_MIN FORMAT "%9.6" /end CHARACTERISTIC
/begin CHARACTERISTIC c_vs_brake_max "Maximum VS threshold for PVS_BLS_BTS_PLAUS" VALUE 0xa1029c60 _REC_VAL_20_u1 255. _CNV_A_R_LINEAR_____6_CM 0. 255. DISPLAY_IDENTIFIER C_VS_BRAKE_MAX FORMAT "%3.0" /end CHARACTERISTIC
/begin CHARACTERISTIC c_vs_brake_min "Minimum VS threshold for PVS_BLS_BTS_PLAUS" VALUE 0xa1029c61 _REC_VAL_20_u1 255. _CNV_A_R_LINEAR_____6_CM 0. 255. DISPLAY_IDENTIFIER C_VS_BRAKE_MIN FORMAT "%3.0" /end CHARACTERISTIC
/begin CHARACTERISTIC c_vs_max_brake "Maximum VS threshold for PVS_BLS_BTS_PLAUS" VALUE 0xa1029ca4 _REC_VAL_20_u1 255. _CNV_A_R_LINEAR_____6_CM 0. 255. DISPLAY_IDENTIFIER C_VS_MAX_BRAKE FORMAT "%3.0" /end CHARACTERISTIC
/begin CHARACTERISTIC c_n_max_brake "Engine speed threshold for ABC in PVS_BLS_BTS_PLAUS" VALUE 0xa1029612 _REC_VAL_20_u2 8160. _CNV_A_R_LINEAR_____13_CM 0. 8160. DISPLAY_IDENTIFIER C_N_MAX_BRAKE FORMAT "%4.0" /end CHARACTERISTIC
/begin MEASUREMENT lv_pv_av_lim_act "Logical value for PV_AV over threshold for PVS_BLS_BTS_PLAUS" UBYTE _CNV_S_2_RANGE__0___1_CM 1 100. 0. 1. DISPLAY_IDENTIFIER LV_PV_AV_LIM_ACT ECU_ADDRESS 0xd0003b59 BIT_MASK 0x1 /end MEASUREMENT
/begin MEASUREMENT lv_cdn_vs_vld_1 "Logical value for VS condition for PVS_BLS_BTS_PLAUS" UBYTE _CNV_S_2_RANGE__0___1_CM 1 100. 0. 1. DISPLAY_IDENTIFIER LV_CDN_VS_VLD_1 ECU_ADDRESS 0xc0000b84 BIT_MASK 0x1 /end MEASUREMENT
/begin MEASUREMENT lv_cdn_vs_vld_2 "Logical value for brake pressure condition for PVS_BLS_BTS_PLAUS" UBYTE _CNV_S_2_RANGE__0___1_CM 1 100. 0. 1. DISPLAY_IDENTIFIER LV_CDN_VS_VLD_2 ECU_ADDRESS 0xc0000b85 BIT_MASK 0x1 /end MEASUREMENT
/begin CHARACTERISTIC c_v_sof_swi_min "Input voltage threshold min" VALUE 0xa1029b8e _REC_VAL_20_u2 4.9951171875 _CNV_A_R_LINEAR_____2_CM 0. 4.9951171875 DISPLAY_IDENTIFIER C_V_SOF_SWI_MIN FORMAT "%5.3" /end CHARACTERISTIC
/begin CHARACTERISTIC c_abc_inc_sof_req "Anti - bounce counter increment" VALUE 0xa10290b4 _REC_VAL_20_u1 255. _CNV_A_R_LINEAR_____0_CM 0. 255. DISPLAY_IDENTIFIER C_ABC_INC_SOF_REQ FORMAT "%3.0" /end CHARACTERISTIC
/begin CHARACTERISTIC c_abc_max_sof_req "Debounce counter maximum value" VALUE 0xa1029140 _REC_VAL_20_u1 254. _CNV_A_R_LINEAR_____0_CM 1. 255. DISPLAY_IDENTIFIER C_ABC_MAX_SOF_REQ FORMAT "%3.0" /end CHARACTERISTIC
/begin CHARACTERISTIC c_v_sof_swi_max "Input voltage threshold max" VALUE 0xa1029b8c _REC_VAL_20_u2 4.9951171875 _CNV_A_R_LINEAR_____2_CM 0. 4.9951171875 DISPLAY_IDENTIFIER C_V_SOF_SWI_MAX FORMAT "%5.3" /end CHARACTERISTIC
/begin MEASUREMENT lv_err_sof_req "Erroflag sport-mode switch request" UBYTE _CNV_S_2_RANGE__0___1_CM 1 100. 0. 1. DISPLAY_IDENTIFIER LV_ERR_SOF_REQ ECU_ADDRESS 0xd000343b BIT_MASK 0x1 /end MEASUREMENT
/begin MEASUREMENT lv_err_tecu "TECU error flag" UBYTE _CNV_S_2_RANGE__0___1_CM 1 100. 0. 1. DISPLAY_IDENTIFIER LV_ERR_TECU ECU_ADDRESS 0xd000342e BIT_MASK 0x1 /end MEASUREMENT
/begin CHARACTERISTIC c_tia_max_tecu_diag "TIA threshold - TECU diagnosis" VALUE 0xa1029a51 _REC_VAL_20_u1 190.5 _CNV_A_R_LINEAR_____16_CM -48. 142.5 DISPLAY_IDENTIFIER C_TIA_MAX_TECU_DIAG FORMAT "%5.1" /end CHARACTERISTIC
/begin CHARACTERISTIC c_abc_max_tecu "Maximum value of the anti - bounce counter" VALUE 0xa1029145 _REC_VAL_20_u1 254. _CNV_A_R_LINEAR_____0_CM 1. 255. DISPLAY_IDENTIFIER C_ABC_MAX_TECU FORMAT "%3.0" /end CHARACTERISTIC
/begin CHARACTERISTIC c_abc_inc_tecu "Anti - bounce counter increment" VALUE 0xa10290b9 _REC_VAL_20_u1 255. _CNV_A_R_LINEAR_____0_CM 0. 255. DISPLAY_IDENTIFIER C_ABC_INC_TECU FORMAT "%3.0" /end CHARACTERISTIC
/begin CHARACTERISTIC c_v_tecu_min_diag "V_TECU threshold for short to ground - TECU diagnosis" VALUE 0xa1029b98 _REC_VAL_20_u2 4.9951171875 _CNV_A_R_LINEAR_____2_CM 0. 4.9951171875 DISPLAY_IDENTIFIER C_V_TECU_MIN_DIAG FORMAT "%5.3" /end CHARACTERISTIC
/begin CHARACTERISTIC c_v_tecu_max_diag "V_TECU threshold for short to VB or line break - TECU diagnosis" VALUE 0xa1029b96 _REC_VAL_20_u2 4.9951171875 _CNV_A_R_LINEAR_____2_CM 0. 4.9951171875 DISPLAY_IDENTIFIER C_V_TECU_MAX_DIAG FORMAT "%5.3" /end CHARACTERISTIC
/begin CHARACTERISTIC c_t_dly_tecu_diag "Delay time for diagnosis activation" VALUE 0xa1029878 _REC_VAL_20_u2 32767.5 _CNV_A_R_LINEAR_____253_CM 0. 32767.5 DISPLAY_IDENTIFIER C_T_DLY_TECU_DIAG FORMAT "%6.1" /end CHARACTERISTIC
/begin CHARACTERISTIC c_abc_inc_teg_pcat_down "debounce counter increment-TEG diagnosis" VALUE 0xa10290ba _REC_VAL_20_u1 255. _CNV_A_R_LINEAR_____0_CM 0. 255. DISPLAY_IDENTIFIER C_ABC_INC_TEG_PCAT_DOWN FORMAT "%3.0" /end CHARACTERISTIC
/begin CHARACTERISTIC c_abc_max_teg_pcat_down "debounce counter maximumt-TEG diagnosis" VALUE 0xa1029146 _REC_VAL_20_u1 254. _CNV_A_R_LINEAR_____0_CM 1. 255. DISPLAY_IDENTIFIER C_ABC_MAX_TEG_PCAT_DOWN FORMAT "%3.0" /end CHARACTERISTIC
/begin CHARACTERISTIC c_abc_inc_tia_el "Debounce counter increment - TIA diagnosis" VALUE 0xa10290bb _REC_VAL_20_u1 255. _CNV_A_R_LINEAR_____0_CM 0. 255. DISPLAY_IDENTIFIER C_ABC_INC_TIA_EL FORMAT "%3.0" /end CHARACTERISTIC
/begin CHARACTERISTIC c_abc_inc_tia_plaus "Anti - bounce increment TIA_PLAUS diagnosis" VALUE 0xa10290bc _REC_VAL_20_u1 255. _CNV_A_R_LINEAR_____0_CM 0. 255. DISPLAY_IDENTIFIER C_ABC_INC_TIA_PLAUS FORMAT "%3.0" /end CHARACTERISTIC
/begin CHARACTERISTIC c_abc_max_tia_el "Debounce counter maximum value - TIA diagnosis" VALUE 0xa1029147 _REC_VAL_20_u1 254. _CNV_A_R_LINEAR_____0_CM 1. 255. DISPLAY_IDENTIFIER C_ABC_MAX_TIA_EL FORMAT "%3.0" /end CHARACTERISTIC
/begin CHARACTERISTIC c_abc_max_tia_plaus "Anti - bounce maximum TIA_PLAUS diagnosis" VALUE 0xa1029148 _REC_VAL_20_u1 254. _CNV_A_R_LINEAR_____0_CM 1. 255. DISPLAY_IDENTIFIER C_ABC_MAX_TIA_PLAUS FORMAT "%3.0" /end CHARACTERISTIC
/begin CHARACTERISTIC c_toil_chk_ctl_1 "warning threshold 1 for TOIL overtemperature (appl. suggestion: 156°C)" VALUE 0xa1029a80 _REC_VAL_20_u1 255. _CNV_A_R_LINEAR_____25_CM -40. 215. DISPLAY_IDENTIFIER C_TOIL_CHK_CTL_1 FORMAT "%3.0" /end CHARACTERISTIC
/begin CHARACTERISTIC c_toil_chk_ctl_2 "warning threshold 2 for TOIL overtemperature (appl. suggestion: 159°C)" VALUE 0xa1029a81 _REC_VAL_20_u1 255. _CNV_A_R_LINEAR_____25_CM -40. 215. DISPLAY_IDENTIFIER C_TOIL_CHK_CTL_2 FORMAT "%3.0" /end CHARACTERISTIC
/begin MEASUREMENT lv_tps_mtc_n_lim "LV limp home request TPS" UBYTE _CNV_S_2_RANGE__0___1_CM 1 100. 0. 1. DISPLAY_IDENTIFIER LV_TPS_MTC_N_LIM ECU_ADDRESS 0xd0003ea5 BIT_MASK 0x1 /end MEASUREMENT
/begin CHARACTERISTIC c_abc_inc_tps_2 "Debounce counter Increment, TPS diagnosis, Channel 2" VALUE 0xa10290cb _REC_VAL_20_u1 255. _CNV_A_R_LINEAR_____0_CM 0. 255. DISPLAY_IDENTIFIER C_ABC_INC_TPS_2 FORMAT "%3.0" /end CHARACTERISTIC
/begin CHARACTERISTIC c_abc_max_tps_2 "Debounce counter maximum value, TPS diagnosis, Channel 2" VALUE 0xa1029157 _REC_VAL_20_u1 254. _CNV_A_R_LINEAR_____0_CM 1. 255. DISPLAY_IDENTIFIER C_ABC_MAX_TPS_2 FORMAT "%3.0" /end CHARACTERISTIC
/begin CHARACTERISTIC c_v_tps_min_diag_1 "lower diagnostic voltage, pot  1" VALUE 0xa1029bb8 _REC_VAL_20_u2 4.9951171875 _CNV_A_R_LINEAR_____2_CM 0. 4.9951171875 DISPLAY_IDENTIFIER C_V_TPS_MIN_DIAG_1 FORMAT "%5.3" /end CHARACTERISTIC
/begin CHARACTERISTIC c_v_tps_min_diag_2 "lower diagnostic voltage, pot  2" VALUE 0xa1029bba _REC_VAL_20_u2 4.9951171875 _CNV_A_R_LINEAR_____2_CM 0. 4.9951171875 DISPLAY_IDENTIFIER C_V_TPS_MIN_DIAG_2 FORMAT "%5.3" /end CHARACTERISTIC
/begin CHARACTERISTIC c_v_tps_max_diag_2 "upper diagnostic voltage, pot  2" VALUE 0xa1029bb6 _REC_VAL_20_u2 4.9951171875 _CNV_A_R_LINEAR_____2_CM 0. 4.9951171875 DISPLAY_IDENTIFIER C_V_TPS_MAX_DIAG_2 FORMAT "%5.3" /end CHARACTERISTIC
/begin MEASUREMENT lv_err_tps_ratio "Logic variable (set if TPS ratio has been identified as faulty)" UBYTE _CNV_S_2_RANGE__0___1_CM 1 100. 0. 1. DISPLAY_IDENTIFIER LV_ERR_TPS_RATIO ECU_ADDRESS 0xd00033ed BIT_MASK 0x1 /end MEASUREMENT
/begin MEASUREMENT lv_mtc_lih_cur_off "ETC-Limp home is activ" UBYTE _CNV_S_2_RANGE__0___1_CM 1 100. 0. 1. DISPLAY_IDENTIFIER LV_MTC_LIH_CUR_OFF ECU_ADDRESS 0xd0003ea3 BIT_MASK 0x1 /end MEASUREMENT
/begin CHARACTERISTIC c_v_tps_max_diag_1 "upper diagnostic voltage, pot  1" VALUE 0xa1029bb4 _REC_VAL_20_u2 4.9951171875 _CNV_A_R_LINEAR_____2_CM 0. 4.9951171875 DISPLAY_IDENTIFIER C_V_TPS_MAX_DIAG_1 FORMAT "%5.3" /end CHARACTERISTIC
/begin CHARACTERISTIC c_v_tps_ratio_hys "Admissible deviation of DK angle" VALUE 0xa1029bbc _REC_VAL_20_u2 4.9951171875 _CNV_A_R_LINEAR_____2_CM 0. 4.9951171875 DISPLAY_IDENTIFIER C_V_TPS_RATIO_HYS FORMAT "%5.3" /end CHARACTERISTIC
/begin MEASUREMENT lv_err_tps "Error currently present on at least one throttle position sensor" UBYTE _CNV_S_2_RANGE__0___1_CM 1 100. 0. 1. DISPLAY_IDENTIFIER LV_ERR_TPS ECU_ADDRESS 0xd0003ea2 BIT_MASK 0x1 /end MEASUREMENT
/begin MEASUREMENT lv_n_lim_etc_lih "LV safety cut off" UBYTE _CNV_S_2_RANGE__0___1_CM 1 100. 0. 1. DISPLAY_IDENTIFIER LV_N_LIM_ETC_LIH ECU_ADDRESS 0xd0003ea4 BIT_MASK 0x1 /end MEASUREMENT
/begin MEASUREMENT lv_n_lim_etc_lih_rev "ETC-LIMP-HOME-3  (Reversible)" UBYTE _CNV_S_2_RANGE__0___1_CM 1 100. 0. 1. DISPLAY_IDENTIFIER LV_N_LIM_ETC_LIH_REV ECU_ADDRESS 0xd0003ea7 BIT_MASK 0x1 /end MEASUREMENT
/begin MEASUREMENT state_tps_diag "Status TPS Diagnosis" UBYTE _CNV_S_5_RANGE_STAT_267_CM 1 100. 0. 8. DISPLAY_IDENTIFIER STATE_TPS_DIAG ECU_ADDRESS 0xd0003ea0 /end MEASUREMENT
/begin CHARACTERISTIC c_t_tps_dif_int "Integration time for deviation between measured and calculated DK value" VALUE 0xa1029985 _REC_VAL_20_u1 1.275 _CNV_A_R_LINEAR_____230_CM 0. 1.275 DISPLAY_IDENTIFIER C_T_TPS_DIF_INT FORMAT "%5.3" /end CHARACTERISTIC
/begin MEASUREMENT state_etc_lih "Status ETC Limp-Home" UBYTE _CNV_S_6_RANGE_STAT_268_CM 1 100. 0. 16. DISPLAY_IDENTIFIER STATE_ETC_LIH ECU_ADDRESS 0xd0003ea1 /end MEASUREMENT
/begin MEASUREMENT lv_mtc_cur_off_req "ETC without power request" UBYTE _CNV_S_2_RANGE__0___1_CM 1 100. 0. 1. DISPLAY_IDENTIFIER LV_MTC_CUR_OFF_REQ ECU_ADDRESS 0xd0003ea6 BIT_MASK 0x1 /end MEASUREMENT
/begin MEASUREMENT lv_err_tps_2 "Logic variable  (set if  TPS_2 is being identified as errored)" UBYTE _CNV_S_2_RANGE__0___1_CM 1 100. 0. 1. DISPLAY_IDENTIFIER LV_ERR_TPS_2 ECU_ADDRESS 0xd00033ea BIT_MASK 0x1 /end MEASUREMENT
/begin MEASUREMENT lv_err_tps_maf_1 "Logic variable (set if TPS_1 has been identified as faulty by the ratio check)" UBYTE _CNV_S_2_RANGE__0___1_CM 1 100. 0. 1. DISPLAY_IDENTIFIER LV_ERR_TPS_MAF_1 ECU_ADDRESS 0xd00033eb BIT_MASK 0x1 /end MEASUREMENT
/begin MEASUREMENT lv_err_tps_maf_2 "Logic variable(set if TPS_2 has been identified as faulty by the ratio check)" UBYTE _CNV_S_2_RANGE__0___1_CM 1 100. 0. 1. DISPLAY_IDENTIFIER LV_ERR_TPS_MAF_2 ECU_ADDRESS 0xd00033ec BIT_MASK 0x1 /end MEASUREMENT
/begin MEASUREMENT lv_err_tps_1 "Logic variable  (set if  TPS_1 is being identified as errored)" UBYTE _CNV_S_2_RANGE__0___1_CM 1 100. 0. 1. DISPLAY_IDENTIFIER LV_ERR_TPS_1 ECU_ADDRESS 0xd00033e9 BIT_MASK 0x1 /end MEASUREMENT
/begin MEASUREMENT lv_err_mtc_dr "MTC_DR-error is present" UBYTE _CNV_S_2_RANGE__0___1_CM 1 100. 0. 1. DISPLAY_IDENTIFIER LV_ERR_MTC_DR ECU_ADDRESS 0xd00033f5 BIT_MASK 0x1 /end MEASUREMENT
/begin CHARACTERISTIC lc_use_tps_maf_diag "Locical value to switch off TPS_MAF diagnosis ( MSV70 = 0, MSD70 = 1)" VALUE 0xa1029e0a _REC_VAL_20_u1 1. _CNV_S_2_RANGE__0___1_CM 0. 1. DISPLAY_IDENTIFIER LC_USE_TPS_MAF_DIAG /end CHARACTERISTIC
/begin CHARACTERISTIC c_abc_inc_tps_1 "Debounce counter Increment, TPS diagnosis, Channel 1" VALUE 0xa10290ca _REC_VAL_20_u1 255. _CNV_A_R_LINEAR_____0_CM 0. 255. DISPLAY_IDENTIFIER C_ABC_INC_TPS_1 FORMAT "%3.0" /end CHARACTERISTIC
/begin CHARACTERISTIC c_abc_inc_tps_ratio "Debounce counter Increment, TPS diagnosis, Channel 1" VALUE 0xa10290cc _REC_VAL_20_u1 255. _CNV_A_R_LINEAR_____0_CM 0. 255. DISPLAY_IDENTIFIER C_ABC_INC_TPS_RATIO FORMAT "%3.0" /end CHARACTERISTIC
/begin CHARACTERISTIC c_abc_max_tps_1 "Debounce counter maximum value, TPS diagnosis, Channel 1" VALUE 0xa1029156 _REC_VAL_20_u1 254. _CNV_A_R_LINEAR_____0_CM 1. 255. DISPLAY_IDENTIFIER C_ABC_MAX_TPS_1 FORMAT "%3.0" /end CHARACTERISTIC
/begin CHARACTERISTIC c_abc_max_tps_ratio "Debounce counter maximum value, TPS diagnosis, Channel 1" VALUE 0xa1029158 _REC_VAL_20_u1 254. _CNV_A_R_LINEAR_____0_CM 1. 255. DISPLAY_IDENTIFIER C_ABC_MAX_TPS_RATIO FORMAT "%3.0" /end CHARACTERISTIC
/begin MEASUREMENT lv_det_err_tps_ratio "Logic variable  set if  TPS_RATIO error is detected" UBYTE _CNV_S_2_RANGE__0___1_CM 1 100. 0. 1. DISPLAY_IDENTIFIER LV_DET_ERR_TPS_RATIO ECU_ADDRESS 0xc0000cfa /end MEASUREMENT
/begin MEASUREMENT lv_tps_sng_err "TPS single Error" UBYTE _CNV_S_2_RANGE__0___1_CM 1 100. 0. 1. DISPLAY_IDENTIFIER LV_TPS_SNG_ERR ECU_ADDRESS 0xc0000cfb BIT_MASK 0x1 /end MEASUREMENT
/begin CHARACTERISTIC c_t_dly_etc_lih "Max. time to check OPM_AV and switch to ETC_LIH_4" VALUE 0xa102984d _REC_VAL_20_u1 1.275 _CNV_A_R_LINEAR_____230_CM 0. 1.275 DISPLAY_IDENTIFIER C_T_DLY_ETC_LIH FORMAT "%5.3" /end CHARACTERISTIC
/begin CHARACTERISTIC c_tps_sub_crlc_dif "Correlation constant for filtering of error (second error)" VALUE 0xa1029ad0 _REC_VAL_20_u2 0.9999847412109381 _CNV_A_R_LINEAR_____68_CM 0. 0.9999847412109381 DISPLAY_IDENTIFIER C_TPS_SUB_CRLC_DIF FORMAT "%7.5" /end CHARACTERISTIC
/begin CHARACTERISTIC c_tps_dif_diag_cor_mmv_max "Threshold of max. deviation of filtered TPS difference value" VALUE 0xa1029a96 _REC_VAL_20_u2 119.5 _CNV_A_R_LINEAR_____221_CM 0. 119.5 DISPLAY_IDENTIFIER C_TPS_DIF_DIAG_COR_MMV_MAX FORMAT "%7.3" /end CHARACTERISTIC
/begin CHARACTERISTIC c_tps_sum_dif_diag_cor_max "Threshold of integrated corrected max. difference of measured and modelled TPS value" VALUE 0xa1029ad2 _REC_VAL_20_u2 32767.5 _CNV_A_R_LINEAR_____270_CM 0. 32767.5 DISPLAY_IDENTIFIER C_TPS_SUM_DIF_DIAG_COR_MAX FORMAT "%6.1" /end CHARACTERISTIC
/begin AXIS_PTS ldp_n_ip_fac_tps_dif_1 "" 0xa1020f5c n _REC_AXS_20_u2 8160. _CNV_A_R_LINEAR_____13_CM 8 0. 8160. FORMAT "%4.0" /end AXIS_PTS
/begin AXIS_PTS ldp_maf_sp_tqi_ip_fac_tps_dif_1 "" 0xa1020cdc maf_sp _REC_AXS_20_u2 1389. _CNV_A_R_LINEAR_____108_CM 8 0. 1389. FORMAT "%7.2" /end AXIS_PTS
/begin AXIS_PTS ldp_pq_sp_ip_fac_tps_dif_2 "" 0xa1021140 pq _REC_AXS_20_u2 0.9999847412109381 _CNV_A_R_LINEAR_____68_CM 6 0. 0.9999847412109381 FORMAT "%7.5" /end AXIS_PTS
/begin CHARACTERISTIC ip_fac_tps_dif_1 "Factor 1 for TPS_DIF_DIAG calculation" MAP 0xa1024300 _REC_MAP_20_u1_u2_u2 1.9921875 _CNV_A_R_LINEAR_____100_CM 0. 1.9921875 DISPLAY_IDENTIFIER IP_FAC_TPS_DIF_1 FORMAT "%5.3"
 /begin AXIS_DESCR COM_AXIS n _CNV_A_R_LINEAR_____13_CM 8 0. 8160. FORMAT "%4.0" AXIS_PTS_REF ldp_n_ip_fac_tps_dif_1 /end AXIS_DESCR
 /begin AXIS_DESCR COM_AXIS maf_sp _CNV_A_R_LINEAR_____108_CM 8 0. 1389. FORMAT "%7.2" AXIS_PTS_REF ldp_maf_sp_tqi_ip_fac_tps_dif_1 /end AXIS_DESCR
/end CHARACTERISTIC
/begin CHARACTERISTIC ip_fac_tps_dif_2 "Factor 2 for TPS_DIF_DIAG calculation" CURVE 0xa1024340 _REC_CUR_20_u1_u2 1.9921875 _CNV_A_R_LINEAR_____100_CM 0. 1.9921875 DISPLAY_IDENTIFIER IP_FAC_TPS_DIF_2 FORMAT "%5.3"
 /begin AXIS_DESCR COM_AXIS pq _CNV_A_R_LINEAR_____68_CM 6 0. 0.9999847412109381 FORMAT "%7.5" AXIS_PTS_REF ldp_pq_sp_ip_fac_tps_dif_2 /end AXIS_DESCR
/end CHARACTERISTIC
/begin MEASUREMENT tps_dif_diag_2 "Difference between measured TPS_AV_2 and modelled TPS_SUB_DIAG" UWORD _CNV_A_R_LINEAR_____221_CM 1 100. 0. 119.5 DISPLAY_IDENTIFIER TPS_DIF_DIAG_2 ECU_ADDRESS 0xc0000cde FORMAT "%7.3" /end MEASUREMENT
/begin MEASUREMENT tps_dif_diag_cor_1 "Corrected value of TPS_SUM_DIF_DIAG_1" UWORD _CNV_A_R_LINEAR_____221_CM 1 100. 0. 119.5 DISPLAY_IDENTIFIER TPS_DIF_DIAG_COR_1 ECU_ADDRESS 0xc0000ce0 FORMAT "%7.3" /end MEASUREMENT
/begin MEASUREMENT tps_dif_diag_cor_2 "Corrected value of TPS_SUM_DIF_DIAG_2" UWORD _CNV_A_R_LINEAR_____221_CM 1 100. 0. 119.5 DISPLAY_IDENTIFIER TPS_DIF_DIAG_COR_2 ECU_ADDRESS 0xc0000ce2 FORMAT "%7.3" /end MEASUREMENT
/begin MEASUREMENT tps_sum_dif_diag_cor_1 "Integrated value of TPS_SUB_DIAG_1" UWORD _CNV_A_R_LINEAR_____270_CM 1 100. 0. 32767.5 DISPLAY_IDENTIFIER TPS_SUM_DIF_DIAG_COR_1 ECU_ADDRESS 0xc0000ce4 FORMAT "%6.1" /end MEASUREMENT
/begin MEASUREMENT tps_sum_dif_diag_cor_2 "Integrated value of TPS_SUB_DIAG_2" UWORD _CNV_A_R_LINEAR_____270_CM 1 100. 0. 32767.5 DISPLAY_IDENTIFIER TPS_SUM_DIF_DIAG_COR_2 ECU_ADDRESS 0xc0000ce6 FORMAT "%6.1" /end MEASUREMENT
/begin MEASUREMENT tps_dif_diag_1 "Difference between measured TPS_AV_1 and modelled TPS_SUB_DIAG" UWORD _CNV_A_R_LINEAR_____221_CM 1 100. 0. 119.5 DISPLAY_IDENTIFIER TPS_DIF_DIAG_1 ECU_ADDRESS 0xc0000cdc FORMAT "%7.3" /end MEASUREMENT
/begin MEASUREMENT tps_dif_diag_cor_mmv_1 "Filtered corrected value of TPS_DIF_DIAG_COR_1" UWORD _CNV_A_R_LINEAR_____221_CM 1 100. 0. 119.5 DISPLAY_IDENTIFIER TPS_DIF_DIAG_COR_MMV_1 ECU_ADDRESS 0xc0000ce8 FORMAT "%7.3" /end MEASUREMENT
/begin MEASUREMENT tps_dif_diag_cor_mmv_2 "Filtered corrected value of TPS_DIF_DIAG_COR_2" UWORD _CNV_A_R_LINEAR_____221_CM 1 100. 0. 119.5 DISPLAY_IDENTIFIER TPS_DIF_DIAG_COR_MMV_2 ECU_ADDRESS 0xc0000cea FORMAT "%7.3" /end MEASUREMENT
/begin MEASUREMENT lv_err_tout_amt_1 "logical variable timeout error CAN message SSG1" UBYTE _CNV_S_2_RANGE__0___1_CM 1 100. 0. 1. DISPLAY_IDENTIFIER LV_ERR_TOUT_AMT_1 ECU_ADDRESS 0xd00033d3 BIT_MASK 0x1 /end MEASUREMENT
/begin MEASUREMENT lv_err_tout_etcu_1 "logical variable timeout error CAN message EGS1" UBYTE _CNV_S_2_RANGE__0___1_CM 1 100. 0. 1. DISPLAY_IDENTIFIER LV_ERR_TOUT_ETCU_1 ECU_ADDRESS 0xd00033cb BIT_MASK 0x1 /end MEASUREMENT
/begin CHARACTERISTIC c_abc_inc_tq_req_can "Anti bounce increment value, TQ-plausibility via CAN" VALUE 0xa10290cd _REC_VAL_20_u1 255. _CNV_A_R_LINEAR_____0_CM 0. 255. DISPLAY_IDENTIFIER C_ABC_INC_TQ_REQ_CAN FORMAT "%3.0" /end CHARACTERISTIC
/begin CHARACTERISTIC c_abc_max_tq_req_can "Anti-bounce max. value, TQ-plausibility via CAN" VALUE 0xa1029159 _REC_VAL_20_u1 254. _CNV_A_R_LINEAR_____0_CM 1. 255. DISPLAY_IDENTIFIER C_ABC_MAX_TQ_REQ_CAN FORMAT "%3.0" /end CHARACTERISTIC
/begin CHARACTERISTIC c_abc_inc_tqi_lim "Increment counter for torque request for safety" VALUE 0xa10290ce _REC_VAL_20_u1 255. _CNV_A_R_LINEAR_____0_CM 0. 255. DISPLAY_IDENTIFIER C_ABC_INC_TQI_LIM FORMAT "%3.0" /end CHARACTERISTIC
/begin CHARACTERISTIC c_abc_max_tqi_lim "Maximum counter for torque request for safety" VALUE 0xa102915a _REC_VAL_20_u1 254. _CNV_A_R_LINEAR_____0_CM 1. 255. DISPLAY_IDENTIFIER C_ABC_MAX_TQI_LIM FORMAT "%3.0" /end CHARACTERISTIC
/begin MEASUREMENT lv_err_tqi_lim "Error flag torque request for safety is active" UBYTE _CNV_S_2_RANGE__0___1_CM 1 100. 0. 1. DISPLAY_IDENTIFIER LV_ERR_TQI_LIM ECU_ADDRESS 0xd0003431 BIT_MASK 0x1 /end MEASUREMENT
/begin MEASUREMENT lv_err_tout_pste_1 "logical variable timeout error CAN message LWS1" UBYTE _CNV_S_2_RANGE__0___1_CM 1 100. 0. 1. DISPLAY_IDENTIFIER LV_ERR_TOUT_PSTE_1 ECU_ADDRESS 0xd00033d2 BIT_MASK 0x1 /end MEASUREMENT
/begin CHARACTERISTIC c_maf_vs_min_diag_mt "MAF condition - vehicle speed diagnosis, MT vehicle" VALUE 0xa102956f _REC_VAL_20_u1 1389. _CNV_A_R_LINEAR_____14_CM 0. 1389. DISPLAY_IDENTIFIER C_MAF_VS_MIN_DIAG_MT FORMAT "%4.0" /end CHARACTERISTIC
/begin CHARACTERISTIC c_maf_vs_min_diag_at "MAF condition - vehicle speed diagnosis, AT vehicle" VALUE 0xa102956e _REC_VAL_20_u1 1389. _CNV_A_R_LINEAR_____14_CM 0. 1389. DISPLAY_IDENTIFIER C_MAF_VS_MIN_DIAG_AT FORMAT "%4.0" /end CHARACTERISTIC
/begin CHARACTERISTIC c_n_vs_min_diag_mt "Engine speed condition - vehicle speed diagnosis, MT vehicle" VALUE 0xa102967c _REC_VAL_20_u2 8160. _CNV_A_R_LINEAR_____13_CM 0. 8160. DISPLAY_IDENTIFIER C_N_VS_MIN_DIAG_MT FORMAT "%4.0" /end CHARACTERISTIC
/begin CHARACTERISTIC c_n_vs_min_diag_at "Engine speed condition - vehicle speed diagnosis, AT vehicle" VALUE 0xa102967a _REC_VAL_20_u2 8160. _CNV_A_R_LINEAR_____13_CM 0. 8160. DISPLAY_IDENTIFIER C_N_VS_MIN_DIAG_AT FORMAT "%4.0" /end CHARACTERISTIC
/begin CHARACTERISTIC c_t_vs_min_diag "Time condition - vehicle speed diagnosis" VALUE 0xa10299ac _REC_VAL_20_u2 6553.5 _CNV_A_R_LINEAR_____4_CM 0. 6553.5 DISPLAY_IDENTIFIER C_T_VS_MIN_DIAG FORMAT "%6.1" /end CHARACTERISTIC
/begin MEASUREMENT t_vs_diag "Time counter for error detection" UWORD _CNV_A_R_LINEAR_____4_CM 1 100. 0. 6553.5 DISPLAY_IDENTIFIER T_VS_DIAG ECU_ADDRESS 0xc0000e30 FORMAT "%6.1" /end MEASUREMENT
/begin MEASUREMENT t_vs_end_diag "Time counter for end of diagnosis" UWORD _CNV_A_R_LINEAR_____4_CM 1 100. 0. 6553.5 DISPLAY_IDENTIFIER T_VS_END_DIAG ECU_ADDRESS 0xc0000e32 FORMAT "%6.1" /end MEASUREMENT
/begin CHARACTERISTIC c_abc_max_vs "ABC maximum value for VS diagnosis" VALUE 0xa1029164 _REC_VAL_20_u1 254. _CNV_A_R_LINEAR_____0_CM 1. 255. DISPLAY_IDENTIFIER C_ABC_MAX_VS FORMAT "%3.0" /end CHARACTERISTIC
/begin CHARACTERISTIC c_abc_inc_vs "ABC increment value for VS diagnosis" VALUE 0xa10290d8 _REC_VAL_20_u1 255. _CNV_A_R_LINEAR_____0_CM 0. 255. DISPLAY_IDENTIFIER C_ABC_INC_VS FORMAT "%3.0" /end CHARACTERISTIC
/begin MEASUREMENT lv_err_vs_plaus "VS plaus sensor error bit" UBYTE _CNV_S_2_RANGE__0___1_CM 1 100. 0. 1. DISPLAY_IDENTIFIER LV_ERR_VS_PLAUS ECU_ADDRESS 0xd0003487 BIT_MASK 0x1 /end MEASUREMENT
/begin MEASUREMENT lv_err_vs "VS sensor error bit" UBYTE _CNV_S_2_RANGE__0___1_CM 1 100. 0. 1. DISPLAY_IDENTIFIER LV_ERR_VS ECU_ADDRESS 0xd00033d4 BIT_MASK 0x1 /end MEASUREMENT
/begin CHARACTERISTIC c_abc_inc_mtc_dr "Debounce counter increment,MTC driver diagnosis" VALUE 0xa10290a0 _REC_VAL_20_u1 255. _CNV_A_R_LINEAR_____0_CM 0. 255. DISPLAY_IDENTIFIER C_ABC_INC_MTC_DR FORMAT "%3.0" /end CHARACTERISTIC
/begin CHARACTERISTIC c_abc_max_mtc_dr "Debounce counter maximum value, MTC driver diagnosis" VALUE 0xa102912b _REC_VAL_20_u1 254. _CNV_A_R_LINEAR_____0_CM 1. 255. DISPLAY_IDENTIFIER C_ABC_MAX_MTC_DR FORMAT "%3.0" /end CHARACTERISTIC
/begin CHARACTERISTIC c_abc_max_cwp_int_off "Debounce threshold for internal shut off errors CWP" VALUE 0xa1029105 _REC_VAL_20_u1 254. _CNV_A_R_LINEAR_____0_CM 1. 255. DISPLAY_IDENTIFIER C_ABC_MAX_CWP_INT_OFF FORMAT "%3.0" /end CHARACTERISTIC
/begin CHARACTERISTIC c_abc_inc_cwp_pwr "CWP internal Diagnosis increment" VALUE 0xa102907b _REC_VAL_20_u1 255. _CNV_A_R_LINEAR_____447_CM 0. 255. DISPLAY_IDENTIFIER C_ABC_INC_CWP_PWR FORMAT "%3.0" /end CHARACTERISTIC
/begin CHARACTERISTIC c_abc_max_cwp_pwr "Diagnosis increment" VALUE 0xa1029106 _REC_VAL_20_u1 254. _CNV_A_R_LINEAR_____0_CM 1. 255. DISPLAY_IDENTIFIER C_ABC_MAX_CWP_PWR FORMAT "%3.0" /end CHARACTERISTIC
/begin CHARACTERISTIC c_abc_inc_cwp_int_off "CWP internal Diagnosis increment" VALUE 0xa102907a _REC_VAL_20_u1 255. _CNV_A_R_LINEAR_____447_CM 0. 255. DISPLAY_IDENTIFIER C_ABC_INC_CWP_INT_OFF FORMAT "%3.0" /end CHARACTERISTIC
/begin CHARACTERISTIC c_abc_inc_mec_ivvt_in "Debounce counter increment - MEC_IVVT_IN diagnosis" VALUE 0xa102909c _REC_VAL_20_u1 255. _CNV_A_R_LINEAR_____0_CM 0. 255. DISPLAY_IDENTIFIER C_ABC_INC_MEC_IVVT_IN FORMAT "%3.0" /end CHARACTERISTIC
/begin CHARACTERISTIC c_abc_max_mec_ivvt_in "Debounce counter maximum value - MEC_IVVT_IN diagnosis" VALUE 0xa1029127 _REC_VAL_20_u1 254. _CNV_A_R_LINEAR_____0_CM 1. 255. DISPLAY_IDENTIFIER C_ABC_MAX_MEC_IVVT_IN FORMAT "%3.0" /end CHARACTERISTIC
/begin CHARACTERISTIC c_abc_max_gen "Maximum value debounce counter - Generator error" VALUE 0xa1029114 _REC_VAL_20_u1 254. _CNV_A_R_LINEAR_____0_CM 1. 255. DISPLAY_IDENTIFIER C_ABC_MAX_GEN FORMAT "%3.0" /end CHARACTERISTIC
/begin CHARACTERISTIC c_abc_inc_gen "Increment debounce counter - Generator error" VALUE 0xa1029089 _REC_VAL_20_u1 255. _CNV_A_R_LINEAR_____0_CM 0. 255. DISPLAY_IDENTIFIER C_ABC_INC_GEN FORMAT "%3.0" /end CHARACTERISTIC
/begin CHARACTERISTIC c_abc_inc_qoil_sens "Debounce counter increment - oil quality diagnosis" VALUE 0xa10290ab _REC_VAL_20_u1 255. _CNV_A_R_LINEAR_____0_CM 0. 255. DISPLAY_IDENTIFIER C_ABC_INC_QOIL_SENS FORMAT "%3.0" /end CHARACTERISTIC
/begin CHARACTERISTIC c_abc_max_qoil_sens "Debounce counter maximum value - oil quality diagnosis" VALUE 0xa1029137 _REC_VAL_20_u1 254. _CNV_A_R_LINEAR_____0_CM 1. 255. DISPLAY_IDENTIFIER C_ABC_MAX_QOIL_SENS FORMAT "%3.0" /end CHARACTERISTIC
/begin MEASUREMENT lv_err_gen "Boolean for error currently present on Generator" UBYTE _CNV_S_2_RANGE__0___1_CM 1 100. 0. 1. DISPLAY_IDENTIFIER LV_ERR_GEN ECU_ADDRESS 0xd00033fd BIT_MASK 0x1 /end MEASUREMENT
/begin CHARACTERISTIC c_abc_inc_bat_sens_it "Anti bounce increment" VALUE 0xa1029055 _REC_VAL_20_u1 255. _CNV_A_R_LINEAR_____0_CM 0. 255. DISPLAY_IDENTIFIER C_ABC_INC_BAT_SENS_IT FORMAT "%3.0" /end CHARACTERISTIC
/begin CHARACTERISTIC c_abc_inc_bat_sens_it_el "Anti bounce increment" VALUE 0xa1029056 _REC_VAL_20_u1 255. _CNV_A_R_LINEAR_____0_CM 0. 255. DISPLAY_IDENTIFIER C_ABC_INC_BAT_SENS_IT_EL FORMAT "%3.0" /end CHARACTERISTIC
/begin CHARACTERISTIC c_abc_max_bat_sens_it "Anti boune maximum" VALUE 0xa10290e0 _REC_VAL_20_u1 254. _CNV_A_R_LINEAR_____0_CM 1. 255. DISPLAY_IDENTIFIER C_ABC_MAX_BAT_SENS_IT FORMAT "%3.0" /end CHARACTERISTIC
/begin CHARACTERISTIC c_abc_max_bat_sens_it_el "Anti boune maximum" VALUE 0xa10290e1 _REC_VAL_20_u1 254. _CNV_A_R_LINEAR_____0_CM 1. 255. DISPLAY_IDENTIFIER C_ABC_MAX_BAT_SENS_IT_EL FORMAT "%3.0" /end CHARACTERISTIC
/begin MEASUREMENT lv_err_bat_sens_it "internal error (component) BAT_SENS" UBYTE _CNV_S_2_RANGE__0___1_CM 1 100. 0. 1. DISPLAY_IDENTIFIER LV_ERR_BAT_SENS_IT ECU_ADDRESS 0xd0003470 BIT_MASK 0x1 /end MEASUREMENT
/begin MEASUREMENT lv_err_bat_sens_it_el "internal error (electrical) BAT_SENS" UBYTE _CNV_S_2_RANGE__0___1_CM 1 100. 0. 1. DISPLAY_IDENTIFIER LV_ERR_BAT_SENS_IT_EL ECU_ADDRESS 0xd0003471 BIT_MASK 0x1 /end MEASUREMENT
/begin CHARACTERISTIC c_abc_inc_bat_sens "Anti bounce increment" VALUE 0xa1029054 _REC_VAL_20_u1 255. _CNV_A_R_LINEAR_____0_CM 0. 255. DISPLAY_IDENTIFIER C_ABC_INC_BAT_SENS FORMAT "%3.0" /end CHARACTERISTIC
/begin CHARACTERISTIC c_abc_inc_alter_bn "Anti bounce increment" VALUE 0xa102904e _REC_VAL_20_u1 255. _CNV_A_R_LINEAR_____0_CM 0. 255. DISPLAY_IDENTIFIER C_ABC_INC_ALTER_BN FORMAT "%3.0" /end CHARACTERISTIC
/begin CHARACTERISTIC c_abc_inc_alter_bn_bat "Anti bounce increment" VALUE 0xa102904f _REC_VAL_20_u1 255. _CNV_A_R_LINEAR_____0_CM 0. 255. DISPLAY_IDENTIFIER C_ABC_INC_ALTER_BN_BAT FORMAT "%3.0" /end CHARACTERISTIC
/begin CHARACTERISTIC c_abc_max_bat_sens "Anti boune maximum" VALUE 0xa10290df _REC_VAL_20_u1 254. _CNV_A_R_LINEAR_____0_CM 1. 255. DISPLAY_IDENTIFIER C_ABC_MAX_BAT_SENS FORMAT "%3.0" /end CHARACTERISTIC
/begin CHARACTERISTIC c_abc_max_alter_bn "Anti boune maximum" VALUE 0xa10290d9 _REC_VAL_20_u1 254. _CNV_A_R_LINEAR_____0_CM 1. 255. DISPLAY_IDENTIFIER C_ABC_MAX_ALTER_BN FORMAT "%3.0" /end CHARACTERISTIC
/begin CHARACTERISTIC c_abc_max_alter_bn_bat "Anti boune maximum" VALUE 0xa10290da _REC_VAL_20_u1 254. _CNV_A_R_LINEAR_____0_CM 1. 255. DISPLAY_IDENTIFIER C_ABC_MAX_ALTER_BN_BAT FORMAT "%3.0" /end CHARACTERISTIC
/begin MEASUREMENT lv_err_bat_sens "communication error BAT_SENS" UBYTE _CNV_S_2_RANGE__0___1_CM 1 100. 0. 1. DISPLAY_IDENTIFIER LV_ERR_BAT_SENS ECU_ADDRESS 0xd000346f BIT_MASK 0x1 /end MEASUREMENT
/begin MEASUREMENT lv_err_alter_bn "Boolean for error currently present on PM board network" UBYTE _CNV_S_2_RANGE__0___1_CM 1 100. 0. 1. DISPLAY_IDENTIFIER LV_ERR_ALTER_BN ECU_ADDRESS 0xd00033ff BIT_MASK 0x1 /end MEASUREMENT
/begin MEASUREMENT lv_err_alter_bn_bat "Boolean for error currently present on PM battery" UBYTE _CNV_S_2_RANGE__0___1_CM 1 100. 0. 1. DISPLAY_IDENTIFIER LV_ERR_ALTER_BN_BAT ECU_ADDRESS 0xd0003400 BIT_MASK 0x1 /end MEASUREMENT
/begin CHARACTERISTIC c_abc_inc_load_tps_plaus "Anti - bounce counter increment" VALUE 0xa1029095 _REC_VAL_20_u1 255. _CNV_A_R_LINEAR_____0_CM 0. 255. DISPLAY_IDENTIFIER C_ABC_INC_LOAD_TPS_PLAUS FORMAT "%3.0" /end CHARACTERISTIC
/begin CHARACTERISTIC c_abc_max_load_tps_plaus "Maximum value of the anti - bounce counter" VALUE 0xa1029120 _REC_VAL_20_u1 254. _CNV_A_R_LINEAR_____0_CM 1. 255. DISPLAY_IDENTIFIER C_ABC_MAX_LOAD_TPS_PLAUS FORMAT "%3.0" /end CHARACTERISTIC
/begin CHARACTERISTIC c_abc_inc_vim_plaus "Anti - bounce counter increment" VALUE 0xa10290d5 _REC_VAL_20_u1 255. _CNV_A_R_LINEAR_____0_CM 0. 255. DISPLAY_IDENTIFIER C_ABC_INC_VIM_PLAUS FORMAT "%3.0" /end CHARACTERISTIC
/begin CHARACTERISTIC c_abc_max_vim_plaus "Maximum value of the anti - bounce counter" VALUE 0xa1029161 _REC_VAL_20_u1 254. _CNV_A_R_LINEAR_____0_CM 1. 255. DISPLAY_IDENTIFIER C_ABC_MAX_VIM_PLAUS FORMAT "%3.0" /end CHARACTERISTIC
/begin CHARACTERISTIC c_abc_inc_map_dip_plaus "Anti - bounce counter increment" VALUE 0xa1029098 _REC_VAL_20_u1 255. _CNV_A_R_LINEAR_____0_CM 0. 255. DISPLAY_IDENTIFIER C_ABC_INC_MAP_DIP_PLAUS FORMAT "%3.0" /end CHARACTERISTIC
/begin CHARACTERISTIC c_abc_max_map_dip_plaus "Maximum value of the anti - bounce counter" VALUE 0xa1029123 _REC_VAL_20_u1 254. _CNV_A_R_LINEAR_____0_CM 1. 255. DISPLAY_IDENTIFIER C_ABC_MAX_MAP_DIP_PLAUS FORMAT "%3.0" /end CHARACTERISTIC
/begin CHARACTERISTIC c_abc_inc_alter_bn_rgn "Anti - bounce counter increment" VALUE 0xa1029050 _REC_VAL_20_u1 255. _CNV_A_R_LINEAR_____0_CM 0. 255. DISPLAY_IDENTIFIER C_ABC_INC_ALTER_BN_RGN FORMAT "%3.0" /end CHARACTERISTIC
/begin CHARACTERISTIC c_abc_max_alter_bn_rgn "Maximum value of the anti - bounce counter" VALUE 0xa10290db _REC_VAL_20_u1 254. _CNV_A_R_LINEAR_____0_CM 1. 255. DISPLAY_IDENTIFIER C_ABC_MAX_ALTER_BN_RGN FORMAT "%3.0" /end CHARACTERISTIC
/begin CHARACTERISTIC c_abc_dec_load_tps_plaus "Debounce counter decrement value LOAD_TPS_PLAUS Diagnosis" VALUE 0xa102904c _REC_VAL_20_u1 255. _CNV_A_R_LINEAR_____0_CM 0. 255. DISPLAY_IDENTIFIER C_ABC_DEC_LOAD_TPS_PLAUS FORMAT "%3.0" /end CHARACTERISTIC
/begin CHARACTERISTIC c_abc_inc_mec_ivvt_ex "Debounce counter increment - MEC_IVVT_EX diagnosis" VALUE 0xa102909b _REC_VAL_20_u1 255. _CNV_A_R_LINEAR_____0_CM 0. 255. DISPLAY_IDENTIFIER C_ABC_INC_MEC_IVVT_EX FORMAT "%3.0" /end CHARACTERISTIC
/begin CHARACTERISTIC c_abc_max_mec_ivvt_ex "Debounce counter maximum value - MEC_IVVT_EX diagnosis" VALUE 0xa1029126 _REC_VAL_20_u1 254. _CNV_A_R_LINEAR_____0_CM 1. 255. DISPLAY_IDENTIFIER C_ABC_MAX_MEC_IVVT_EX FORMAT "%3.0" /end CHARACTERISTIC
/begin CHARACTERISTIC c_abc_inc_toil_level "Debounce counter increment - TOIL_LEVEL diagnosis" VALUE 0xa10290bd _REC_VAL_20_u1 255. _CNV_A_R_LINEAR_____0_CM 0. 255. DISPLAY_IDENTIFIER C_ABC_INC_TOIL_LEVEL FORMAT "%3.0" /end CHARACTERISTIC
/begin CHARACTERISTIC c_abc_max_toil_level "Debounce counter maximum value - TOIL_LEVEL diagnosis" VALUE 0xa1029149 _REC_VAL_20_u1 254. _CNV_A_R_LINEAR_____0_CM 1. 255. DISPLAY_IDENTIFIER C_ABC_MAX_TOIL_LEVEL FORMAT "%3.0" /end CHARACTERISTIC
/begin CHARACTERISTIC c_abc_inc_poil_ctl_stat "Debounce counter increment POIL_CTL_STAT diagnosis" VALUE 0xa10290a4 _REC_VAL_20_u1 255. _CNV_A_R_LINEAR_____0_CM 0. 255. DISPLAY_IDENTIFIER C_ABC_INC_POIL_CTL_STAT FORMAT "%3.0" /end CHARACTERISTIC
/begin CHARACTERISTIC c_abc_inc_poil_ctl_dyn "Debounce counter increment POIL_CTL_DYN diagnosis" VALUE 0xa10290a3 _REC_VAL_20_u1 255. _CNV_A_R_LINEAR_____0_CM 0. 255. DISPLAY_IDENTIFIER C_ABC_INC_POIL_CTL_DYN FORMAT "%3.0" /end CHARACTERISTIC
/begin CHARACTERISTIC c_abc_max_poil_ctl_stat "Debounce counter maximum value POIL_CTL_STAT diagnosis" VALUE 0xa102912f _REC_VAL_20_u1 254. _CNV_A_R_LINEAR_____0_CM 1. 255. DISPLAY_IDENTIFIER C_ABC_MAX_POIL_CTL_STAT FORMAT "%3.0" /end CHARACTERISTIC
/begin CHARACTERISTIC c_abc_max_poil_ctl_dyn "Debounce counter maximum value POIL_CTL_DYN diagnosis" VALUE 0xa102912e _REC_VAL_20_u1 254. _CNV_A_R_LINEAR_____0_CM 1. 255. DISPLAY_IDENTIFIER C_ABC_MAX_POIL_CTL_DYN FORMAT "%3.0" /end CHARACTERISTIC
/begin CHARACTERISTIC c_abc_inc_plaus_igk_bn "Anti - bounce counter increment BN2000 Diagnosis" VALUE 0xa10290a2 _REC_VAL_20_u1 255. _CNV_A_R_LINEAR_____0_CM 0. 255. DISPLAY_IDENTIFIER C_ABC_INC_PLAUS_IGK_BN FORMAT "%3.0" /end CHARACTERISTIC
/begin CHARACTERISTIC c_abc_max_plaus_igk_bn "Maximum value of the anti - bounce counter BN2000 diagnosis" VALUE 0xa102912d _REC_VAL_20_u1 254. _CNV_A_R_LINEAR_____0_CM 1. 255. DISPLAY_IDENTIFIER C_ABC_MAX_PLAUS_IGK_BN FORMAT "%3.0" /end CHARACTERISTIC
/begin CHARACTERISTIC c_abc_max_spi_mps "Anti bounce maxi,um SPI_MPS diagnosis" VALUE 0xa1029142 _REC_VAL_20_u1 254. _CNV_A_R_LINEAR_____0_CM 1. 255. DISPLAY_IDENTIFIER C_ABC_MAX_SPI_MPS FORMAT "%3.0" /end CHARACTERISTIC
/begin CHARACTERISTIC c_abc_max_spi_knk "Anti bounce maxi,um SPI_KNK diagnosis" VALUE 0xa1029141 _REC_VAL_20_u1 254. _CNV_A_R_LINEAR_____0_CM 1. 255. DISPLAY_IDENTIFIER C_ABC_MAX_SPI_KNK FORMAT "%3.0" /end CHARACTERISTIC
/begin CHARACTERISTIC c_abc_inc_spi_mps "Antibounce increment SPI_MPS diagnosis" VALUE 0xa10290b6 _REC_VAL_20_u1 255. _CNV_A_R_LINEAR_____0_CM 0. 255. DISPLAY_IDENTIFIER C_ABC_INC_SPI_MPS FORMAT "%3.0" /end CHARACTERISTIC
/begin CHARACTERISTIC c_abc_inc_spi_knk "Antibounce increment SPI_KNK diagnosis" VALUE 0xa10290b5 _REC_VAL_20_u1 255. _CNV_A_R_LINEAR_____0_CM 0. 255. DISPLAY_IDENTIFIER C_ABC_INC_SPI_KNK FORMAT "%3.0" /end CHARACTERISTIC
/begin CHARACTERISTIC c_abc_inc_gen_diag "Increment debounce counter - Generator switch off " VALUE 0xa102908a _REC_VAL_20_u1 255. _CNV_A_R_LINEAR_____0_CM 0. 255. DISPLAY_IDENTIFIER C_ABC_INC_GEN_DIAG FORMAT "%3.0" /end CHARACTERISTIC
/begin CHARACTERISTIC c_abc_max_gen_diag "Maximum value debounce counter - Generator switch off diagnosis" VALUE 0xa1029115 _REC_VAL_20_u1 254. _CNV_A_R_LINEAR_____0_CM 1. 255. DISPLAY_IDENTIFIER C_ABC_MAX_GEN_DIAG FORMAT "%3.0" /end CHARACTERISTIC
/begin CHARACTERISTIC c_t_ast_gen_diag_off "End of genertaor diagnosis T_AST" VALUE 0xa102980a _REC_VAL_20_u2 51.2 _CNV_A_R_LINEAR_____4_CM 0. 51.2 DISPLAY_IDENTIFIER C_T_AST_GEN_DIAG_OFF FORMAT "%4.1" /end CHARACTERISTIC
/begin CHARACTERISTIC c_t_ast_gen_diag_on "Begin of genertaor diagnosis T_AST" VALUE 0xa102980c _REC_VAL_20_u2 51.2 _CNV_A_R_LINEAR_____4_CM 0. 51.2 DISPLAY_IDENTIFIER C_T_AST_GEN_DIAG_ON FORMAT "%4.1" /end CHARACTERISTIC
/begin CHARACTERISTIC c_vb_mes_gen_diag_thd "battery voltage threshold for diagnosis" VALUE 0xa1029bd4 _REC_VAL_20_u2 28.7055 _CNV_A_R_LINEAR_____445_CM 0. 28.7055 DISPLAY_IDENTIFIER C_VB_MES_GEN_DIAG_THD FORMAT "%5.2" /end CHARACTERISTIC
/begin CHARACTERISTIC c_vb_mes_gen_diag_thd_max "Max.battery voltage threshold for diagnosis" VALUE 0xa1029bd6 _REC_VAL_20_u2 28.7055 _CNV_A_R_LINEAR_____445_CM 0. 28.7055 DISPLAY_IDENTIFIER C_VB_MES_GEN_DIAG_THD_MAX FORMAT "%5.2" /end CHARACTERISTIC
/begin CHARACTERISTIC c_dffgen_thd_max "Max.DF diagnosis threshold for Generator diagnosis" VALUE 0xa1029300 _REC_VAL_20_u1 99.609375 _CNV_A_R_LINEAR_____5_CM 0. 99.609375 DISPLAY_IDENTIFIER C_DFFGEN_THD_MAX /end CHARACTERISTIC
/begin CHARACTERISTIC c_dffgen_thd_min "Min.DF diagnosis threshold for Generator diagnosis" VALUE 0xa1029301 _REC_VAL_20_u1 99.609375 _CNV_A_R_LINEAR_____5_CM 0. 99.609375 DISPLAY_IDENTIFIER C_DFFGEN_THD_MIN /end CHARACTERISTIC
/begin CHARACTERISTIC c_perc_gen_diag_vb_max "Percentage of battery voltage values within diagnosis range" VALUE 0xa102971a _REC_VAL_20_u2 99.99847412109381 _CNV_A_R_LINEAR_____7_CM 0. 99.99847412109381 DISPLAY_IDENTIFIER C_PERC_GEN_DIAG_VB_MAX /end CHARACTERISTIC
/begin MEASUREMENT ctr_diag_gen_diag "Diagnosis counter for fulfilled diagnosis values" UWORD _CNV_A_R_LINEAR_____50_CM 1 100. 0. 512. DISPLAY_IDENTIFIER CTR_DIAG_GEN_DIAG ECU_ADDRESS 0xc00029a2 FORMAT "%4.0" /end MEASUREMENT
/begin MEASUREMENT ctr_ref_gen_diag "Reference counter for diagnosis result" UWORD _CNV_A_R_LINEAR_____50_CM 1 100. 0. 512. DISPLAY_IDENTIFIER CTR_REF_GEN_DIAG ECU_ADDRESS 0xc00029a0 FORMAT "%4.0" /end MEASUREMENT
/begin MEASUREMENT lv_err_gen_diag "Error Generator diagnosis" UBYTE _CNV_S_2_RANGE__0___1_CM 1 100. 0. 1. DISPLAY_IDENTIFIER LV_ERR_GEN_DIAG ECU_ADDRESS 0xd00033fe BIT_MASK 0x1 /end MEASUREMENT
/begin CHARACTERISTIC c_abc_inc_nox_sens "Anti - bounce counter increment of NOx-Sensor OBD I diagnosis" VALUE 0xa10290a1 _REC_VAL_20_u1 255. _CNV_A_R_LINEAR_____0_CM 0. 255. DISPLAY_IDENTIFIER C_ABC_INC_NOX_SENS FORMAT "%3.0" /end CHARACTERISTIC
/begin CHARACTERISTIC c_abc_max_nox_sens "Maximum value of the anti - bounce counter for NOx-Sensor OBD I diagnosis" VALUE 0xa102912c _REC_VAL_20_u1 254. _CNV_A_R_LINEAR_____0_CM 1. 255. DISPLAY_IDENTIFIER C_ABC_MAX_NOX_SENS FORMAT "%3.0" /end CHARACTERISTIC
/begin CHARACTERISTIC c_abc_inc_tout_nox_sens "Debounce counter increment - diagnosis of timeout CAN message NOX_SENS" VALUE 0xa10290c8 _REC_VAL_20_u1 255. _CNV_A_R_LINEAR_____0_CM 0. 255. DISPLAY_IDENTIFIER C_ABC_INC_TOUT_NOX_SENS FORMAT "%3.0" /end CHARACTERISTIC
/begin CHARACTERISTIC c_abc_max_tout_nox_sens "debounce counter maximum value - diagnosis of timeout CAN message NOX_SENS" VALUE 0xa1029154 _REC_VAL_20_u1 254. _CNV_A_R_LINEAR_____0_CM 1. 255. DISPLAY_IDENTIFIER C_ABC_MAX_TOUT_NOX_SENS FORMAT "%3.0" /end CHARACTERISTIC
/begin CHARACTERISTIC c_abc_inc_t_es "Anti - bounce counter increment" VALUE 0xa10290b7 _REC_VAL_20_u1 255. _CNV_A_R_LINEAR_____0_CM 0. 255. DISPLAY_IDENTIFIER C_ABC_INC_T_ES FORMAT "%3.0" /end CHARACTERISTIC
/begin CHARACTERISTIC c_abc_max_t_es "Anti - bounce counter increment" VALUE 0xa1029143 _REC_VAL_20_u1 254. _CNV_A_R_LINEAR_____0_CM 1. 255. DISPLAY_IDENTIFIER C_ABC_MAX_T_ES FORMAT "%3.0" /end CHARACTERISTIC
/begin CHARACTERISTIC c_abc_inc_ftl_can "increment for debouncing diagnosis" VALUE 0xa1029084 _REC_VAL_20_u1 255. _CNV_A_R_LINEAR_____0_CM 0. 255. DISPLAY_IDENTIFIER C_ABC_INC_FTL_CAN FORMAT "%3.0" /end CHARACTERISTIC
/begin CHARACTERISTIC c_abc_max_ftl_can "max threshold for diagnosis" VALUE 0xa102910f _REC_VAL_20_u1 254. _CNV_A_R_LINEAR_____0_CM 1. 255. DISPLAY_IDENTIFIER C_ABC_MAX_FTL_CAN FORMAT "%3.0" /end CHARACTERISTIC
/begin MEASUREMENT lv_sens_bat_smt_act "Communication to IBS has been detected as alive" UBYTE _CNV_S_2_RANGE__0___1_CM 1 100. 0. 1. DISPLAY_IDENTIFIER LV_SENS_BAT_SMT_ACT ECU_ADDRESS 0xd000390c BIT_MASK 0x1 /end MEASUREMENT
/begin MEASUREMENT bsd_sens_bat_smt_info "Content of register [BSD_SENS_BAT_SMT_ADR]" UBYTE _CNV_A_R_LINEAR_____0_CM 1 100. 0. 255. DISPLAY_IDENTIFIER BSD_SENS_BAT_SMT_INFO ECU_ADDRESS 0xd0003908 FORMAT "%3.0" /end MEASUREMENT
/begin MEASUREMENT bsd_sens_bat_smt_adr "Actual register number" UBYTE _CNV_A_R_LINEAR_____0_CM 1 100. 0. 255. DISPLAY_IDENTIFIER BSD_SENS_BAT_SMT_ADR ECU_ADDRESS 0xd0003909 FORMAT "%3.0" /end MEASUREMENT
/begin MEASUREMENT lf_bsd_sens_bat_smt_ctl "Communication coordination byte (logical field)" UBYTE _CNV_A_R_LINEAR_____0_CM 1 100. 0. 255. DISPLAY_IDENTIFIER LF_BSD_SENS_BAT_SMT_CTL ECU_ADDRESS 0xd000390a FORMAT "%3.0" /end MEASUREMENT
/begin AXIS_PTS ldp_idx_bsd_sdl_tbl "" 0xa1020b68 online_dummy _REC_AXS_20_u1 255. _CNV_A_R_LINEAR_____0_CM 32 0. 255. FORMAT "%3.0" /end AXIS_PTS
/begin CHARACTERISTIC id_state_bsd_sdl_tbl "BSD component device scheduling timimg table" CURVE 0xa1022ec4 _REC_CUR_20_u1_u1 255. _CNV_A_R_LINEAR_____0_CM 0. 255. DISPLAY_IDENTIFIER ID_STATE_BSD_SDL_TBL FORMAT "%3.0"
 /begin AXIS_DESCR COM_AXIS online_dummy _CNV_A_R_LINEAR_____0_CM 32 0. 255. FORMAT "%3.0" AXIS_PTS_REF ldp_idx_bsd_sdl_tbl /end AXIS_DESCR
/end CHARACTERISTIC
/begin CHARACTERISTIC c_state_bsd_cpt_det "BSD Devices, which are set by default (bit coded! 1 = not to be learnt)" VALUE 0xa1029795 _REC_VAL_20_u1 255. _CNV_A_R_LINEAR_____0_CM 0. 255. DISPLAY_IDENTIFIER C_STATE_BSD_CPT_DET FORMAT "%3.0" /end CHARACTERISTIC
/begin CHARACTERISTIC c_state_bsd_cpt_avl "Actual  used BSD Devices (bit coded! 1 = used)" VALUE 0xa1029794 _REC_VAL_20_u1 255. _CNV_A_R_LINEAR_____0_CM 0. 255. DISPLAY_IDENTIFIER C_STATE_BSD_CPT_AVL FORMAT "%3.0" /end CHARACTERISTIC
/begin CHARACTERISTIC c_ctr_bsd_cpt_det "Number of required consecutive positive acknowledges to get a component learnt" VALUE 0xa102924c _REC_VAL_20_u1 255. _CNV_A_R_LINEAR_____0_CM 0. 255. DISPLAY_IDENTIFIER C_CTR_BSD_CPT_DET FORMAT "%3.0" /end CHARACTERISTIC
/begin MEASUREMENT lv_sens_bat_smt_det "IBS has been detected " UBYTE _CNV_S_2_RANGE__0___1_CM 1 100. 0. 1. DISPLAY_IDENTIFIER LV_SENS_BAT_SMT_DET ECU_ADDRESS 0xd000377e BIT_MASK 0x1 /end MEASUREMENT
/begin MEASUREMENT lf_bsd_cpt_avl "logical data field displaying the learnt and configured BSD devices" UBYTE _CNV_A_R_LINEAR_____0_CM 1 100. 0. 255. DISPLAY_IDENTIFIER LF_BSD_CPT_AVL ECU_ADDRESS 0xd000377b FORMAT "%3.0" /end MEASUREMENT
/begin MEASUREMENT state_bsd_com "Actual status of the communication between ECU and BSD devices" UBYTE _CNV_A_R_LINEAR_____0_CM 1 100. 0. 255. DISPLAY_IDENTIFIER STATE_BSD_COM ECU_ADDRESS 0xd000377a FORMAT "%3.0" /end MEASUREMENT
/begin MEASUREMENT lv_alter_com_act "Flag indication communication on BSD to alternator disturbed" UBYTE _CNV_S_2_RANGE__0___1_CM 1 100. 0. 1. DISPLAY_IDENTIFIER LV_ALTER_COM_ACT ECU_ADDRESS 0xd000379c BIT_MASK 0x1 /end MEASUREMENT
/begin MEASUREMENT lv_cwp_com_act "Flag indication communication on BSD to coolant water pump disturbed" UBYTE _CNV_S_2_RANGE__0___1_CM 1 100. 0. 1. DISPLAY_IDENTIFIER LV_CWP_COM_ACT ECU_ADDRESS 0xd000387c BIT_MASK 0x1 /end MEASUREMENT
/begin MEASUREMENT lv_qoil_com_act "Flag indication communication on BSD to oil quality sensor disturbed" UBYTE _CNV_S_2_RANGE__0___1_CM 1 100. 0. 1. DISPLAY_IDENTIFIER LV_QOIL_COM_ACT ECU_ADDRESS 0xd0003906 BIT_MASK 0x1 /end MEASUREMENT
/begin MEASUREMENT lv_sens_bat_smt_com_act "Flag indication communication on BSD to intelligent battery sensor disturbed" UBYTE _CNV_S_2_RANGE__0___1_CM 1 100. 0. 1. DISPLAY_IDENTIFIER LV_SENS_BAT_SMT_COM_ACT ECU_ADDRESS 0xd000390d BIT_MASK 0x1 /end MEASUREMENT
/begin MEASUREMENT state_bsd_cpt "" UBYTE _CNV_S_8_STATE_BSD__569_CM 1 100. 0. 7. DISPLAY_IDENTIFIER STATE_BSD_CPT ECU_ADDRESS 0xd0003779 /end MEASUREMENT
/begin MEASUREMENT idx_bsd_sdl_tbl "Index of the timing scheduler for the BSD devices" UBYTE _CNV_A_R_LINEAR_____0_CM 1 100. 0. 255. DISPLAY_IDENTIFIER IDX_BSD_SDL_TBL ECU_ADDRESS 0xc0002550 FORMAT "%3.0" /end MEASUREMENT
/begin MEASUREMENT ctr_bsd_cpt_com_ok "Number of 'ok' communications between ECU and BSD devices per scheduling timing table list" UBYTE _CNV_A_R_LINEAR_____0_CM 1 100. 0. 255. DISPLAY_IDENTIFIER CTR_BSD_CPT_COM_OK ECU_ADDRESS 0xd0003778 FORMAT "%3.0" /end MEASUREMENT
/begin MEASUREMENT t_rly_main_diag "Time window to perform the main relay diagnosis" UBYTE _CNV_A_R_LINEAR_____18_CM 1 100. 0. 2550. DISPLAY_IDENTIFIER T_RLY_MAIN_DIAG ECU_ADDRESS 0xc0000b94 FORMAT "%4.0" /end MEASUREMENT
/begin MEASUREMENT t_dly_rly_main_diag "Delay timer for the diagnosis to allow switching of the relay" UBYTE _CNV_A_R_LINEAR_____18_CM 1 100. 0. 2550. DISPLAY_IDENTIFIER T_DLY_RLY_MAIN_DIAG ECU_ADDRESS 0xd0003e49 FORMAT "%4.0" /end MEASUREMENT
/begin CHARACTERISTIC c_t_rly_main_diag "Time window to perform the main relay diagnosis" VALUE 0xa102995c _REC_VAL_20_u1 2550. _CNV_A_R_LINEAR_____18_CM 0. 2550. DISPLAY_IDENTIFIER C_T_RLY_MAIN_DIAG FORMAT "%4.0" /end CHARACTERISTIC
/begin CHARACTERISTIC c_vb_rly_main_diag "Voltage threshold for detection of battery voltage present" VALUE 0xa1029be4 _REC_VAL_20_u1 25.8984 _CNV_A_R_LINEAR_____21_CM 0. 25.8984 DISPLAY_IDENTIFIER C_VB_RLY_MAIN_DIAG FORMAT "%3.1" /end CHARACTERISTIC
/begin CHARACTERISTIC c_v_igk_rly_main_diag "Voltage threshold for detection of main relay on" VALUE 0xa1029b64 _REC_VAL_20_u1 25.8984 _CNV_A_R_LINEAR_____21_CM 0. 25.8984 DISPLAY_IDENTIFIER C_V_IGK_RLY_MAIN_DIAG FORMAT "%3.1" /end CHARACTERISTIC
/begin CHARACTERISTIC c_t_dly_rly_main_diag "Delay time for the diagnosis to allow switching of the relay" VALUE 0xa1029875 _REC_VAL_20_u1 2550. _CNV_A_R_LINEAR_____18_CM 0. 2550. DISPLAY_IDENTIFIER C_T_DLY_RLY_MAIN_DIAG FORMAT "%4.0" /end CHARACTERISTIC
/begin CHARACTERISTIC c_t_predrive_dly_max "Maximum predrive check delay" VALUE 0xa1029938 _REC_VAL_20_u1 2550. _CNV_A_R_LINEAR_____18_CM 0. 2550. DISPLAY_IDENTIFIER C_T_PREDRIVE_DLY_MAX FORMAT "%4.0" /end CHARACTERISTIC
/begin CHARACTERISTIC c_abc_inc_rly_main "Debounce counter increment - RLY_MAIN diagnosis" VALUE 0xa10290af _REC_VAL_20_u1 255. _CNV_A_R_LINEAR_____0_CM 0. 255. DISPLAY_IDENTIFIER C_ABC_INC_RLY_MAIN FORMAT "%3.0" /end CHARACTERISTIC
/begin CHARACTERISTIC c_abc_max_rly_main "Debounce counter maximum value - RLY_MAIN diagnosis" VALUE 0xa102913b _REC_VAL_20_u1 254. _CNV_A_R_LINEAR_____0_CM 1. 255. DISPLAY_IDENTIFIER C_ABC_MAX_RLY_MAIN FORMAT "%3.0" /end CHARACTERISTIC
/begin MEASUREMENT lv_err_bn_veh_mod "Present error BN2000" UBYTE _CNV_S_2_RANGE__0___1_CM 1 100. 0. 1. DISPLAY_IDENTIFIER LV_ERR_BN_VEH_MOD ECU_ADDRESS 0xd0003456 BIT_MASK 0x1 /end MEASUREMENT
/begin MEASUREMENT lv_err_rly_main_dly "Present error BN2000" UBYTE _CNV_S_2_RANGE__0___1_CM 1 100. 0. 1. DISPLAY_IDENTIFIER LV_ERR_RLY_MAIN_DLY ECU_ADDRESS 0xd000341b BIT_MASK 0x1 /end MEASUREMENT
/begin MEASUREMENT lv_err_rly_main "Boolean for error detected at the main relay" UBYTE _CNV_S_2_RANGE__0___1_CM 1 100. 0. 1. DISPLAY_IDENTIFIER LV_ERR_RLY_MAIN ECU_ADDRESS 0xd000341a BIT_MASK 0x1 /end MEASUREMENT
/begin MEASUREMENT state_rbm_vs_plaus "Interface of VS_PLAUS monitor with the Rate-Based Monitoring statistics" UBYTE _CNV_A_R_LINEAR_____0_CM 1 100. 0. 7. DISPLAY_IDENTIFIER STATE_RBM_VS_PLAUS ECU_ADDRESS 0xd0003ca0 FORMAT "%1.0" /end MEASUREMENT
/begin MEASUREMENT lv_inh_diag_knks "Inhibitflag for KNKS-diagnosis" UBYTE _CNV_S_2_RANGE__0___1_CM 1 100. 0. 1. DISPLAY_IDENTIFIER LV_INH_DIAG_KNKS ECU_ADDRESS 0xd0003d68 BIT_MASK 0x1 /end MEASUREMENT
/begin CHARACTERISTIC c_abc_max_map_dip_sens "Maximum value of the anti - bounce counter" VALUE 0xa1029124 _REC_VAL_20_u1 254. _CNV_A_R_LINEAR_____0_CM 1. 255. DISPLAY_IDENTIFIER C_ABC_MAX_MAP_DIP_SENS FORMAT "%3.0" /end CHARACTERISTIC
/begin CHARACTERISTIC c_abc_inc_map_dip_shift "Anti - bounce counter increment" VALUE 0xa102909a _REC_VAL_20_u1 255. _CNV_A_R_LINEAR_____0_CM 0. 255. DISPLAY_IDENTIFIER C_ABC_INC_MAP_DIP_SHIFT FORMAT "%3.0" /end CHARACTERISTIC
/begin CHARACTERISTIC c_abc_max_map_dip_shift "Maximum value of the anti - bounce counter" VALUE 0xa1029125 _REC_VAL_20_u1 254. _CNV_A_R_LINEAR_____0_CM 1. 255. DISPLAY_IDENTIFIER C_ABC_MAX_MAP_DIP_SHIFT FORMAT "%3.0" /end CHARACTERISTIC
/begin CHARACTERISTIC c_abc_inc_map_dip_sens "Anti - bounce counter increment" VALUE 0xa1029099 _REC_VAL_20_u1 255. _CNV_A_R_LINEAR_____0_CM 0. 255. DISPLAY_IDENTIFIER C_ABC_INC_MAP_DIP_SENS FORMAT "%3.0" /end CHARACTERISTIC
/begin CHARACTERISTIC c_abc_inc_ldm "Increment counter" VALUE 0xa1029094 _REC_VAL_20_u1 255. _CNV_A_R_LINEAR_____0_CM 0. 255. DISPLAY_IDENTIFIER C_ABC_INC_LDM FORMAT "%3.0" /end CHARACTERISTIC
/begin CHARACTERISTIC c_abc_max_ldm "Maximum counter" VALUE 0xa102911f _REC_VAL_20_u1 254. _CNV_A_R_LINEAR_____0_CM 1. 255. DISPLAY_IDENTIFIER C_ABC_MAX_LDM FORMAT "%3.0" /end CHARACTERISTIC
/begin CHARACTERISTIC c_abc_inc_amp_plaus "Anti - bounce counter increment" VALUE 0xa1029053 _REC_VAL_20_u1 255. _CNV_A_R_LINEAR_____0_CM 0. 255. DISPLAY_IDENTIFIER C_ABC_INC_AMP_PLAUS FORMAT "%3.0" /end CHARACTERISTIC
/begin CHARACTERISTIC c_abc_max_amp_plaus "Maximum value of the anti - bounce counter" VALUE 0xa10290de _REC_VAL_20_u1 254. _CNV_A_R_LINEAR_____0_CM 1. 255. DISPLAY_IDENTIFIER C_ABC_MAX_AMP_PLAUS FORMAT "%3.0" /end CHARACTERISTIC
/begin CHARACTERISTIC c_abc_inc_rly_crcv_heat "Debounce counter increment RLY_CRCV_HEAT" VALUE 0xa10290ad _REC_VAL_20_u1 255. _CNV_A_R_LINEAR_____0_CM 0. 255. DISPLAY_IDENTIFIER C_ABC_INC_RLY_CRCV_HEAT FORMAT "%3.0" /end CHARACTERISTIC
/begin CHARACTERISTIC c_abc_max_rly_crcv_heat "Debounce counter maximum value RLY_CRCV_HEAT" VALUE 0xa1029139 _REC_VAL_20_u1 254. _CNV_A_R_LINEAR_____0_CM 1. 255. DISPLAY_IDENTIFIER C_ABC_MAX_RLY_CRCV_HEAT FORMAT "%3.0" /end CHARACTERISTIC
/begin MEASUREMENT lv_err_sof "Boolean for error currently present on SOF" UBYTE _CNV_S_2_RANGE__0___1_CM 1 100. 0. 1. DISPLAY_IDENTIFIER LV_ERR_SOF ECU_ADDRESS 0xd000343a BIT_MASK 0x1 /end MEASUREMENT
/begin CHARACTERISTIC c_abc_inc_sof "Debounce counter increment SOF" VALUE 0xa10290b3 _REC_VAL_20_u1 255. _CNV_A_R_LINEAR_____0_CM 0. 255. DISPLAY_IDENTIFIER C_ABC_INC_SOF FORMAT "%3.0" /end CHARACTERISTIC
/begin CHARACTERISTIC c_abc_max_sof "Debounce counter maximum value SOF" VALUE 0xa102913f _REC_VAL_20_u1 254. _CNV_A_R_LINEAR_____0_CM 1. 255. DISPLAY_IDENTIFIER C_ABC_MAX_SOF FORMAT "%3.0" /end CHARACTERISTIC
/begin MEASUREMENT cdn_diag_sof "Activation conditions for sof" UBYTE _CNV_A_R_LINEAR_____0_CM 1 100. 0. 255. DISPLAY_IDENTIFIER CDN_DIAG_SOF ECU_ADDRESS 0xc0000b98 FORMAT "%3.0" /end MEASUREMENT
/begin MEASUREMENT lv_inh_diag_sof "Inhibit diagnosis sof" UBYTE _CNV_S_2_RANGE__0___1_CM 1 100. 0. 1. DISPLAY_IDENTIFIER LV_INH_DIAG_SOF ECU_ADDRESS 0xd0003dec BIT_MASK 0x1 /end MEASUREMENT
/begin MEASUREMENT lv_tps_sub_diag_err "TPS_SUB_DIAG is not valid due to present component error" UBYTE _CNV_S_2_RANGE__0___1_CM 1 100. 0. 1. DISPLAY_IDENTIFIER LV_TPS_SUB_DIAG_ERR ECU_ADDRESS 0xd0003ea8 /end MEASUREMENT
/begin CHARACTERISTIC c_abc_inc_sof_inh_mon "Anti - bounce counter increment" VALUE 0xa1000fdc _REC_VAL_20_u1 255. _CNV_A_R_LINEAR_____0_CM 0. 255. DISPLAY_IDENTIFIER C_ABC_INC_SOF_INH_MON FORMAT "%3.0" /end CHARACTERISTIC
/begin CHARACTERISTIC c_abc_max_sof_inh_mon "Debounce counter maximum value" VALUE 0xa1000ff8 _REC_VAL_20_u1 254. _CNV_A_R_LINEAR_____0_CM 1. 255. DISPLAY_IDENTIFIER C_ABC_MAX_SOF_INH_MON FORMAT "%3.0" /end CHARACTERISTIC
/begin COMPU_METHOD _CNV_A_R_LINEAR_____0_CM "" RAT_FUNC "%6.3" "-" COEFFS 0 1. 0. 0 0 1 /end COMPU_METHOD
/begin COMPU_METHOD _CNV_S_2_RANGE__0___1_CM "" TAB_VERB "%6.3" "-" COMPU_TAB_REF _CNV_S_2_RANGE__0___1 /end COMPU_METHOD
/begin COMPU_VTAB _CNV_S_2_RANGE__0___1 "" TAB_VERB 2 0 "0" 1 "1" /end COMPU_VTAB
/begin COMPU_METHOD _CNV_A_R_LINEAR_____2_CM "" RAT_FUNC "%6.3" "V" COEFFS 0 204.8 0. 0 0 1 /end COMPU_METHOD
/begin COMPU_METHOD _CNV_A_R_LINEAR_____3_CM "" RAT_FUNC "%6.3" "s" COEFFS 0 100. 0. 0 0 1 /end COMPU_METHOD
/begin COMPU_METHOD _CNV_A_R_LINEAR_____4_CM "" RAT_FUNC "%6.3" "s" COEFFS 0 10. 0. 0 0 1 /end COMPU_METHOD
/begin COMPU_METHOD _CNV_A_R_LINEAR_____5_CM "" RAT_FUNC "%6.3" "%" COEFFS 0 2.56 0. 0 0 1 /end COMPU_METHOD
/begin COMPU_METHOD _CNV_A_R_LINEAR_____6_CM "" RAT_FUNC "%6.3" "km/h" COEFFS 0 1. 0. 0 0 1 /end COMPU_METHOD
/begin COMPU_METHOD _CNV_A_R_LINEAR_____7_CM "" RAT_FUNC "%6.3" "%" COEFFS 0 655.3599999999997 0. 0 0 1 /end COMPU_METHOD
/begin COMPU_METHOD _CNV_A_R_LINEAR_____9_CM "" RAT_FUNC "%6.3" "rpm" COEFFS 0 3.125e-002 0. 0 0 1 /end COMPU_METHOD
/begin COMPU_METHOD _CNV_A_R_LINEAR_____11_CM "" RAT_FUNC "%6.3" "-" COEFFS 0 4095.999999839998 -1.280019205296412e-006 0 0 1 /end COMPU_METHOD
/begin COMPU_METHOD _CNV_A_R_LINEAR_____12_CM "" RAT_FUNC "%6.3" "µs" COEFFS 0 -1. 0. 0 0 1 /end COMPU_METHOD
/begin COMPU_METHOD _CNV_A_R_LINEAR_____13_CM "" RAT_FUNC "%6.3" "rpm" COEFFS 0 1. 0. 0 0 1 /end COMPU_METHOD
/begin COMPU_METHOD _CNV_A_R_LINEAR_____14_CM "" RAT_FUNC "%6.3" "mg/stk" COEFFS 0 0.183585313174946 0. 0 0 1 /end COMPU_METHOD
/begin COMPU_METHOD _CNV_A_R_LINEAR_____15_CM "" RAT_FUNC "%6.3" "-" COEFFS 0 127.9983874218908 1.612578109245533e-003 0 0 1 /end COMPU_METHOD
/begin COMPU_METHOD _CNV_A_R_LINEAR_____16_CM "" RAT_FUNC "%6.3" "°C" COEFFS 0 1.333333333333333 64. 0 0 1 /end COMPU_METHOD
/begin COMPU_METHOD _CNV_A_R_LINEAR_____17_CM "" RAT_FUNC "%6.3" "-" COEFFS 0 255.9983911655618 0. 0 0 1 /end COMPU_METHOD
/begin COMPU_METHOD _CNV_A_R_LINEAR_____18_CM "" RAT_FUNC "%6.3" "ms" COEFFS 0 0.1 0. 0 0 1 /end COMPU_METHOD
/begin COMPU_METHOD _CNV_A_R_LINEAR_____21_CM "" RAT_FUNC "%6.3" "V" COEFFS 0 9.846168103048838 0. 0 0 1 /end COMPU_METHOD
/begin COMPU_METHOD _CNV_A_R_LINEAR_____25_CM "" RAT_FUNC "%6.3" "°C" COEFFS 0 1. 40. 0 0 1 /end COMPU_METHOD
/begin COMPU_METHOD _CNV_A_R_LINEAR_____26_CM "" RAT_FUNC "%6.3" "hPa" COEFFS 0 12.06017666543982 0. 0 0 1 /end COMPU_METHOD
/begin COMPU_METHOD _CNV_A_R_LINEAR_____50_CM "" RAT_FUNC "%6.3" "" COEFFS 0 1. 0. 0 0 1 /end COMPU_METHOD
/begin COMPU_METHOD _CNV_A_R_LINEAR_____67_CM "" RAT_FUNC "%6.3" "bar" COEFFS 0 1. 0. 0 0 1 /end COMPU_METHOD
/begin COMPU_METHOD _CNV_A_R_LINEAR_____68_CM "" RAT_FUNC "%6.3" "-" COEFFS 0 65535.99999999996 0. 0 0 1 /end COMPU_METHOD
/begin COMPU_METHOD _CNV_A_R_LINEAR_____100_CM "" RAT_FUNC "%6.3" "-" COEFFS 0 128. 0. 0 0 1 /end COMPU_METHOD
/begin COMPU_METHOD _CNV_A_R_LINEAR_____108_CM "" RAT_FUNC "%6.3" "mg/stk" COEFFS 0 47.18142548596112 0. 0 0 1 /end COMPU_METHOD
/begin COMPU_METHOD _CNV_A_R_LINEAR_____133_CM "" RAT_FUNC "%6.3" "mA" COEFFS 0 163.8375 0. 0 0 1 /end COMPU_METHOD
/begin COMPU_METHOD _CNV_A_R_LINEAR_____145_CM "" RAT_FUNC "%6.3" "Seg" COEFFS 0 1. 0. 0 0 1 /end COMPU_METHOD
/begin COMPU_METHOD _CNV_A_R_LINEAR_____181_CM "" RAT_FUNC "%6.3" "-" COEFFS 0 65536.00270084133 0. 0 0 1 /end COMPU_METHOD
/begin COMPU_METHOD _CNV_A_R_EGCP_LINEA_194_CM "" RAT_FUNC "%6.3" "V" COEFFS 0 204.8000001200018 0. 0 0 1 /end COMPU_METHOD
/begin COMPU_METHOD _CNV_A_R_LINEAR_____195_CM "" RAT_FUNC "%6.3" "V" COEFFS 0 51.2 0. 0 0 1 /end COMPU_METHOD
/begin COMPU_METHOD _CNV_A_R_LINEAR_____221_CM "" RAT_FUNC "%6.3" "°TPS" COEFFS 0 137.0962343096234 0. 0 0 1 /end COMPU_METHOD
/begin COMPU_METHOD _CNV_A_R_LINEAR_____230_CM "" RAT_FUNC "%6.3" "s" COEFFS 0 200. 0. 0 0 1 /end COMPU_METHOD
/begin COMPU_METHOD _CNV_S_9_RANGE_STAT_251_CM "" TAB_VERB "%6.3" "-" COMPU_TAB_REF _CNV_S_9_RANGE_STAT_251 /end COMPU_METHOD
/begin COMPU_VTAB _CNV_S_9_RANGE_STAT_251 "" TAB_VERB 9 0 "PVS_NO_ERROR" 1 "PVS_LIH_PRED" 2 "PVS_LIH_1" 4 "PVS_LIH_2" 8 "PVS_LIH_MIN" 16 "PVS_DBL_ERROR" 32 "PVS_LIH_BLS" 64 "PVS_LIH_1_PRED" 128 "PVS_LIH_2_PRED" /end COMPU_VTAB
/begin COMPU_METHOD _CNV_A_R_LINEAR_____252_CM "" RAT_FUNC "%6.3" "V" COEFFS 0 102.4003523452984 0. 0 0 1 /end COMPU_METHOD
/begin COMPU_METHOD _CNV_A_R_LINEAR_____253_CM "" RAT_FUNC "%6.3" "s" COEFFS 0 2. 0. 0 0 1 /end COMPU_METHOD
/begin COMPU_METHOD _CNV_S_5_RANGE_STAT_267_CM "" TAB_VERB "%6.3" "-" COMPU_TAB_REF _CNV_S_5_RANGE_STAT_267 /end COMPU_METHOD
/begin COMPU_VTAB _CNV_S_5_RANGE_STAT_267 "" TAB_VERB 5 0 "TPS_NO_ERROR" 1 "TPS_LIH_1" 2 "TPS_LIH_2" 4 "TPS_MIN_MAX" 8 "TPS_DBL_ERROR" /end COMPU_VTAB
/begin COMPU_METHOD _CNV_S_6_RANGE_STAT_268_CM "" TAB_VERB "%6.3" "-" COMPU_TAB_REF _CNV_S_6_RANGE_STAT_268 /end COMPU_METHOD
/begin COMPU_VTAB _CNV_S_6_RANGE_STAT_268 "" TAB_VERB 6 0 "ETC_NO_LIH" 1 "ETC_LIH_1" 2 "ETC_LIH_2_REV" 4 "ETC_LIH_2" 8 "ETC_LIH_3" 16 "ETC_LIH_4" /end COMPU_VTAB
/begin COMPU_METHOD _CNV_A_R_LINEAR_____270_CM "" RAT_FUNC "%6.3" "°TPS" COEFFS 0 2. 0. 0 0 1 /end COMPU_METHOD
/begin COMPU_METHOD _CNV_A_R_LINEAR_____445_CM "" RAT_FUNC "%6.3" "V" COEFFS 0 35.63776976537597 0. 0 0 1 /end COMPU_METHOD
/begin COMPU_METHOD _CNV_A_R_LINEAR_____447_CM "" RAT_FUNC "%6.3" "-/100ms" COEFFS 0 1. 0. 0 0 1 /end COMPU_METHOD
/begin COMPU_METHOD _CNV_S_8_STATE_BSD__569_CM "" TAB_VERB "%6.3" "" COMPU_TAB_REF _CNV_S_8_STATE_BSD__569 /end COMPU_METHOD
/begin COMPU_VTAB _CNV_S_8_STATE_BSD__569 "" TAB_VERB 8 0 "SENS_BAT_SMT" 1 "O3" 2 "NO DEVICE" 3 "CWP" 4 "QOIL" 5 "NO DEVICE" 6 "ALTER" 7 "NO DEVICE" /end COMPU_VTAB
/begin RECORD_LAYOUT _REC_VAL_20_u1 FNC_VALUES 1 UBYTE COLUMN_DIR DIRECT /end RECORD_LAYOUT
/begin RECORD_LAYOUT _REC_VAL_20_u2 FNC_VALUES 1 UWORD COLUMN_DIR DIRECT /end RECORD_LAYOUT
/begin RECORD_LAYOUT _REC_AXS_20_u1 NO_AXIS_PTS_X 1 UBYTE AXIS_PTS_X 2 UBYTE INDEX_INCR DIRECT /end RECORD_LAYOUT
/begin RECORD_LAYOUT _REC_CUR_20_u1_u1 FNC_VALUES 1 UBYTE COLUMN_DIR DIRECT /end RECORD_LAYOUT
/begin RECORD_LAYOUT _REC_MAP_20_u2_u2_u1 FNC_VALUES 1 UWORD COLUMN_DIR DIRECT /end RECORD_LAYOUT
/begin RECORD_LAYOUT _REC_AXS_20_u2 NO_AXIS_PTS_X 1 UWORD AXIS_PTS_X 2 UWORD INDEX_INCR DIRECT /end RECORD_LAYOUT
/begin RECORD_LAYOUT _REC_CUR_20_u2_u2 FNC_VALUES 1 UWORD COLUMN_DIR DIRECT /end RECORD_LAYOUT
/begin RECORD_LAYOUT _REC_CUR_20_u1_u2 FNC_VALUES 1 UBYTE COLUMN_DIR DIRECT /end RECORD_LAYOUT
/begin RECORD_LAYOUT _REC_MAP_20_u1_u2_u2 FNC_VALUES 1 UBYTE COLUMN_DIR DIRECT /end RECORD_LAYOUT
/begin FUNCTION DIA_Fuel_pump_relay_RLY_EFP "_Fuel pump relay RLY_EFP" /begin OUT_MEASUREMENT lv_err_rly_efp cdn_diag_rly_efp lv_inh_diag_rly_efp /end OUT_MEASUREMENT /end FUNCTION
/begin FUNCTION DIA_Ambient_pressure_sensor "_Ambient pressure sensor" /begin DEF_CHARACTERISTIC c_amp_ref c_v_amp_max_diag c_v_amp_min_diag /end DEF_CHARACTERISTIC /end FUNCTION
/begin FUNCTION DIA_Oil_temperature_sensor_TOIL "_Oil temperature sensor TOIL" /begin DEF_CHARACTERISTIC c_toil_chk_ctl_1 c_toil_chk_ctl_2 /end DEF_CHARACTERISTIC /end FUNCTION
/begin FUNCTION DIA_Knock_sensor_diagnosis "_Knock sensor diagnosis"
 /begin DEF_CHARACTERISTIC c_nl_min_diag c_dyw_min_knks_diag c_v_int_knks_diag c_cycnr_knks_diag c_nl_max_diag c_maf_min_knks_diag c_n_min_knks_diag c_abc_max_knks c_abc_inc_knks /end DEF_CHARACTERISTIC
 /begin OUT_MEASUREMENT dyw_knks_diag[0] dyw_knks_diag[1] cycnr_dyw_knks_diag[0] cycnr_dyw_knks_diag[1] v_int_knks_diag[0] v_int_knks_diag[1] cycnr_int_knks_diag[0] cycnr_int_knks_diag[1] lv_err_knks_1 lv_err_knks_2 lv_inh_diag_knks /end OUT_MEASUREMENT
/end FUNCTION
/begin FUNCTION DIA_Vehicle_speed_signal_diagnosis "_Vehicle speed signal diagnosis"
 /begin DEF_CHARACTERISTIC c_maf_vs_min_diag_mt c_maf_vs_min_diag_at c_n_vs_min_diag_mt c_n_vs_min_diag_at c_t_vs_min_diag /end DEF_CHARACTERISTIC
 /begin OUT_MEASUREMENT t_vs_diag t_vs_end_diag lv_err_vs_plaus lv_err_vs state_rbm_vs_plaus /end OUT_MEASUREMENT
/end FUNCTION
/begin FUNCTION DIA_Ignition_system_diagnosis "_Ignition system diagnosis" /end FUNCTION
/begin FUNCTION DIA_Throttle_position_sensor_diagnosis "_Throttle position sensor diagnosis"
 /begin DEF_CHARACTERISTIC c_v_tps_min_diag_1 c_v_tps_min_diag_2 c_v_tps_max_diag_2 c_v_tps_max_diag_1 c_v_tps_ratio_hys c_t_tps_dif_int lc_use_tps_maf_diag c_t_dly_etc_lih c_tps_sub_crlc_dif c_tps_dif_diag_cor_mmv_max c_tps_sum_dif_diag_cor_max ip_fac_tps_dif_1 ip_fac_tps_dif_2 /end DEF_CHARACTERISTIC
 /begin OUT_MEASUREMENT lv_err_tps_ratio lv_err_tps_2 lv_err_tps_maf_1 lv_err_tps_maf_2 lv_err_tps_1 lv_det_err_tps_ratio tps_dif_diag_2 tps_dif_diag_cor_1 tps_dif_diag_cor_2 tps_sum_dif_diag_cor_1 tps_sum_dif_diag_cor_2 tps_dif_diag_1 tps_dif_diag_cor_mmv_1 tps_dif_diag_cor_mmv_2 lv_tps_sub_diag_err /end OUT_MEASUREMENT
/end FUNCTION
/begin FUNCTION DIA_ETC_driver_diagnosis "_ETC driver diagnosis" /begin OUT_MEASUREMENT lv_err_mtc_dr /end OUT_MEASUREMENT /end FUNCTION
/begin FUNCTION DIA_Generator_diagnosis "_Generator diagnosis"
 /begin DEF_CHARACTERISTIC c_t_ast_gen_diag_off c_t_ast_gen_diag_on c_vb_mes_gen_diag_thd c_vb_mes_gen_diag_thd_max c_dffgen_thd_max c_dffgen_thd_min c_perc_gen_diag_vb_max /end DEF_CHARACTERISTIC
 /begin OUT_MEASUREMENT lv_err_gen ctr_diag_gen_diag ctr_ref_gen_diag lv_err_gen_diag /end OUT_MEASUREMENT
/end FUNCTION
/begin FUNCTION DIA_Air_Condition_Compressor_Control_Relay_Diagnosis__RLY_ACCOUT_ "_Air Condition Compressor Control Relay Diagnosis (RLY_ACCOUT)"
 /begin OUT_MEASUREMENT cdn_diag_rly_accout lv_err_rly_accout lv_inh_diag_rly_accout /end OUT_MEASUREMENT
/end FUNCTION
/begin FUNCTION DIA_Main_Relay_Diagnosis__RLY_MAIN_ "_Main Relay Diagnosis (RLY_MAIN)"
 /begin DEF_CHARACTERISTIC c_t_rly_main_diag c_vb_rly_main_diag c_v_igk_rly_main_diag c_t_dly_rly_main_diag c_t_predrive_dly_max /end DEF_CHARACTERISTIC
 /begin OUT_MEASUREMENT t_rly_main_diag t_dly_rly_main_diag lv_err_bn_veh_mod lv_err_rly_main_dly lv_err_rly_main /end OUT_MEASUREMENT
/end FUNCTION
/begin FUNCTION DIA_Idle_Speed_Control_Diagnosis "_Idle Speed Control Diagnosis" /begin DEF_CHARACTERISTIC c_crlc_maf_sp_tqi_diagisc c_maf_sp_tqi_dyw_diagisc /end DEF_CHARACTERISTIC
 /begin OUT_MEASUREMENT lv_inh_diag_isc lv_inh_diag_rbm_isc state_rbm_isc maf_sp_tqi_mmv_diag_isc lv_maf_sp_tqi_dyw_diag_isc /end OUT_MEASUREMENT
/end FUNCTION
/begin FUNCTION DIA_CAN_diagnosis "_CAN diagnosis"
 /begin DEF_CHARACTERISTIC c_asr_3_cycnr_max c_asr_1_cycnr_max c_asr_4_cycnr_max c_efp_can_cycnr_max c_etcu_1_cycnr_max c_etcu_2_cycnr_max c_icl_2_cycnr_max c_icl_3_cycnr_max c_pste_1_cycnr_max c_ctr_diag_tcc_can_max_amt_1 c_ctr_diag_cpl_can_max_amt_1 c_amt_1_cycnr_max c_etcu_2_tcc_cycnr_max c_etcu_2_cks_cycnr_max /end DEF_CHARACTERISTIC
 /begin OUT_MEASUREMENT cyc_ctr_asr_3_diag cyc_ctr_efp_can_diag cyc_ctr_asr_1_diag lv_err_tout_asr_1 lv_err_tout_asr_3 cyc_ctr_asr_4_diag lv_err_tout_asr_4 cyc_ctr_etcu_1_diag cyc_ctr_etcu_2_diag cyc_ctr_etcu_2_tcc_diag cyc_ctr_etcu_2_cks_diag cyc_ctr_icl_2_diag cyc_ctr_icl_3_diag cyc_ctr_pste_1_diag cyc_ctr_amt_1_diag lv_err_tout_icl_2 lv_err_tout_icl_3 lv_err_tout_efp_can lv_err_can_boff lv_err_can_boff_B lv_err_can_boff_C lv_err_tout_etcu_2 lv_err_tout_amt_1 lv_err_tout_etcu_1 lv_err_tout_pste_1 /end OUT_MEASUREMENT
/end FUNCTION
/begin FUNCTION DIA_Multifunctional_steering_wheel__MSW_ "_Multifunctional steering wheel (MSW)"
 /begin DEF_CHARACTERISTIC c_vb_min_msw_diag c_t_min_msw_bit_diag c_t_max_msw_bit_diag /end DEF_CHARACTERISTIC
 /begin OUT_MEASUREMENT lv_err_msw_3 lv_err_msw_tog lv_err_msw_2 /end OUT_MEASUREMENT
/end FUNCTION
/begin FUNCTION DIA_Pedal_value_sensor_diagnosis "_Pedal value sensor diagnosis"
 /begin DEF_CHARACTERISTIC c_v_pvs_min_diag_2 c_t_is_pvs_err ip_pvs_ratio_hys c_pvs_bls_bts_plaus_conf c_vcc_dif_pvs c_v_pvs_min_diag_1 c_v_pvs_min_diag_min_1 c_v_pvs_min_diag_min_2 c_v_pvs_max_diag_1 c_v_pvs_max_diag_2 ldp_vs_ip_pv_av_max_brake ldp_brake_prs_ip_pv_av_max ip_pv_av_max_brake_vs ip_pv_av_max_brake_prs lc_brake_prs c_t_thd_vs_brake_max c_pv_av_brake_max c_pv_av_brake_min c_vs_brake_max c_vs_brake_min c_vs_max_brake c_n_max_brake /end DEF_CHARACTERISTIC
 /begin OUT_MEASUREMENT lv_err_pvs_1 lv_err_pvs_2 lv_dyn_lim_1_act lv_dyn_lim_2_act state_pvs_diag lv_n_sp_is_lih_act lv_err_pvs lv_det_not_plaus_act lv_pvs_bls_not_plaus_act ctr_pvs_bls_not_plaus_act lv_err_v_ref_2 lv_err_pvs_double lv_err_v_ref_1 lv_err_pvs_bls_not_plaus lv_det_err_pvs ctr_c_t_vs_brake_max pv_av_max_brake_det lv_pv_av_lim_act lv_cdn_vs_vld_1 lv_cdn_vs_vld_2 /end OUT_MEASUREMENT
/end FUNCTION
/begin FUNCTION DIA_Brake_light_switch_diagnosis__BLS_BTS_ "_Brake light switch diagnosis (BLS/BTS)" /begin DEF_CHARACTERISTIC c_t_bts_plaus_max /end DEF_CHARACTERISTIC
 /begin OUT_MEASUREMENT lv_brake_det lv_err_bls_plaus lv_err_im_bls_plaus lv_err_im_bts_plaus lv_bts_edge lv_bls_edge t_bts_plaus /end OUT_MEASUREMENT
/end FUNCTION
/begin FUNCTION DIA_Idle_Speed_Actuator_Diagnosis "_Idle Speed Actuator Diagnosis" /end FUNCTION
/begin FUNCTION DIA_Engine_roughness_idle_diagnosis "_Engine roughness idle diagnosis"
 /begin DEF_CHARACTERISTIC ip_thd_is_er_diag__n__maf ip_fac_thd_is_er_diag__tco c_crlc_is_er_diag /end DEF_CHARACTERISTIC
 /begin OUT_MEASUREMENT er_mmv_is_diag[0] er_mmv_is_diag[1] er_mmv_is_diag[2] er_mmv_is_diag[3] er_mmv_is_diag[4] er_mmv_is_diag[5] /end OUT_MEASUREMENT
/end FUNCTION
/begin FUNCTION DIA_Immobilizer_signal_diagnosis "_Immobilizer signal diagnosis" /begin DEF_CHARACTERISTIC c_tout_imob /end DEF_CHARACTERISTIC
 /begin OUT_MEASUREMENT lv_err_imob_2 lv_err_imob_1 lv_err_imob_3 lv_lock_imob inh_iv_imob ctr_err_imob_2 ctr_err_imob_1 /end OUT_MEASUREMENT
/end FUNCTION
/begin FUNCTION DIA_Exhaust_flap_diagnosis "_Exhaust flap diagnosis" /begin OUT_MEASUREMENT cdn_diag_ef lv_err_ef lv_inh_diag_ef /end OUT_MEASUREMENT /end FUNCTION
/begin FUNCTION DIA_Anti_bounce_algorithm "_Anti-bounce-algorithm"
 /begin DEF_CHARACTERISTIC c_abc_max_dmtlh c_abc_inc_dmtlh c_abc_inc_dmtl_pump c_abc_max_dmtl_pump c_abc_inc_dmtls c_abc_max_dmtls c_abc_inc_rly_accout c_abc_max_rly_accout c_abc_max_ebox_cfa c_abc_inc_ebox_cfa c_abc_max_ef c_abc_inc_ef c_abc_inc_ecras_el c_abc_max_ecras_el c_abc_inc_rly_st c_abc_max_rly_st c_abc_max_slv_ivvt c_abc_inc_slv_ivvt c_abc_inc_rly_efp c_abc_max_rly_efp c_abc_inc_imob_2 c_abc_inc_imob_1 c_abc_max_imob_2 c_abc_max_imob_1 c_abc_inc_amp c_abc_max_amp c_abc_inc_im_bts_plaus c_abc_inc_im_bls_plaus c_abc_max_im_bts_plaus c_abc_max_im_bls_plaus c_abc_inc_bn_tq_dcc c_abc_inc_bn_tq_tcs c_abc_inc_bn_vs_tcs c_abc_inc_bn_tcs c_abc_inc_bn_tq_etcu c_abc_inc_bn_cas c_abc_inc_bn_etcu c_abc_inc_bn_etcu_2 c_abc_inc_bn_etcu_disp c_abc_inc_bn_tq_amt c_abc_inc_bn_acc c_abc_inc_bn_icl c_abc_inc_bn_km_icl c_abc_inc_bn_veh_mod c_abc_inc_bn_t_icl c_abc_inc_bn_pow_vb c_abc_inc_bn_pow_gen c_abc_inc_bn_msw c_abc_inc_bn_ang_pste c_abc_max_bn_cas c_abc_max_bn_tq_tcs c_abc_max_bn_vs_tcs c_abc_max_bn_tcs c_abc_max_bn_tq_etcu c_abc_max_bn_etcu c_abc_max_bn_etcu_2 c_abc_max_bn_etcu_disp c_abc_max_bn_tq_amt c_abc_max_bn_acc c_abc_max_bn_t_icl c_abc_max_bn_km_icl c_abc_max_bn_veh_mod c_abc_max_bn_icl c_abc_max_bn_pow_vb c_abc_max_bn_pow_gen c_abc_max_bn_msw c_abc_max_bn_tq_dcc c_abc_max_bn_ang_pste c_ctr_diag_tcc_can_max_ars c_ctr_diag_tcc_can_max_cas c_ctr_diag_tcc_can_max_tq_tcs c_ctr_diag_tcc_can_max_tq_etcu c_ctr_diag_tcc_can_max_tq_amt c_ctr_diag_tcc_can_max_veh_mod c_ctr_diag_tcc_can_max_icl c_ctr_diag_tcc_can_max_msw c_ctr_diag_tcc_can_max_tq_dcc c_ctr_diag_cks_max_cas c_ctr_diag_cks_max_tq_tcs c_ctr_diag_cks_max_tq_etcu c_ctr_diag_cks_max_tq_amt c_ctr_diag_cks_max_veh_mod c_ctr_diag_cks_max_msw c_ctr_diag_cks_max_tq_dcc c_ctr_diag_tout_max_ars c_ctr_diag_tout_max_cas c_ctr_diag_tout_max_tq_tcs c_ctr_diag_tout_max_vs_tcs c_ctr_diag_tout_max_tcs c_ctr_diag_tout_max_tq_etcu c_ctr_diag_tout_max_tq_dcc c_ctr_diag_tout_max_tq_amt c_ctr_diag_tout_max_acc c_ctr_diag_tout_max_t_icl c_ctr_diag_tout_max_veh_mod c_ctr_diag_tout_max_km_icl c_ctr_diag_tout_max_icl c_ctr_diag_tout_max_pow_vb c_ctr_diag_tout_max_pow_gen c_ctr_diag_tout_max_msw c_ctr_diag_tout_max_etcu c_ctr_diag_tout_max_etcu_2 c_ctr_diag_tout_max_etcu_disp c_ctr_diag_tout_max_ang_pste c_abc_max_bn_ars c_abc_inc_bn_ars c_abc_dec_bn_tq_dcc c_abc_dec_bn_ars c_abc_dec_bn_cas c_abc_dec_bn_tq_tcs c_abc_dec_bn_vs_tcs c_abc_dec_bn_tcs c_abc_dec_bn_tq_etcu c_abc_dec_bn_etcu c_abc_dec_bn_etcu_2 c_abc_dec_bn_tq_amt c_abc_dec_bn_acc c_abc_dec_bn_icl c_abc_dec_bn_km_icl c_abc_dec_bn_t_icl c_abc_dec_bn_pow_vb c_abc_dec_bn_pow_gen c_abc_dec_bn_msw c_abc_dec_bn_ang_pste c_abc_dec_bn_veh_mod c_abc_inc_bn_tq_pste_2 c_abc_max_bn_tq_pste_2 c_abc_dec_bn_tq_pste_2 c_ctr_diag_tcc_can_max_tq_pste_2 c_ctr_diag_cks_max_tq_pste_2 c_ctr_diag_tout_max_tq_pste_2 c_abc_inc_bn_efp c_abc_inc_bn_efp_crash c_abc_max_bn_efp c_abc_max_bn_efp_crash c_abc_dec_bn_efp c_abc_dec_bn_efp_crash c_ctr_diag_tout_max_efp c_ctr_diag_tout_max_efp_crash c_abc_inc_bn_gear_rev c_abc_max_bn_gear_rev c_abc_dec_bn_gear_rev c_ctr_diag_tout_max_gear_rev c_abc_inc_bn_ltg_hdlp_l c_abc_max_bn_ltg_hdlp_l c_abc_dec_bn_ltg_hdlp_l c_ctr_diag_tout_max_ltg_hdlp_l c_abc_inc_bn_ldm c_abc_max_bn_ldm c_ctr_diag_tcc_can_max_ldm c_ctr_diag_cks_max_ldm c_ctr_diag_tout_max_ldm c_abc_dec_bn_ldm c_abc_inc_bn_hiv c_abc_max_bn_hiv c_ctr_diag_tout_max_hiv c_abc_dec_bn_hiv c_abc_inc_bn_trl c_abc_max_bn_trl c_ctr_diag_tout_max_trl c_abc_dec_bn_trl c_abc_inc_bn_t_clk c_abc_max_bn_t_clk c_ctr_diag_tout_max_t_clk c_abc_dec_bn_t_clk c_abc_dec_bn_etcu_disp c_abc_inc_bsd c_abc_inc_qoil_com c_abc_inc_cwp_com c_abc_inc_sens_bat_smt_com c_abc_inc_alter_com c_abc_max_bsd c_abc_max_alter_com c_abc_max_cwp_com c_abc_max_qoil_com c_abc_max_sens_bat_smt_com c_abc_inc_tout_efp c_abc_max_tout_efp c_abc_inc_tout_asr_3 c_abc_max_tout_asr_3 c_abc_inc_tout_asr_1 c_abc_max_tout_asr_1 c_abc_inc_tout_asr_4 c_abc_max_tout_asr_4 c_abc_inc_tout_etcu_1 c_abc_inc_tout_efp_can c_abc_inc_tout_etcu_2 c_abc_max_tout_efp_can c_abc_max_tout_etcu_1 c_abc_max_tout_etcu_2 c_abc_inc_tout_icl_2 c_abc_max_tout_icl_2 c_abc_inc_tout_icl_3 c_abc_max_tout_icl_3 c_abc_inc_tout_pste_1 c_abc_max_tout_pste_1 c_abc_inc_tout_amt_1 c_abc_max_tout_amt_1 c_abc_inc_can_boff_B c_abc_max_can_boff_B c_abc_inc_can_boff_C c_abc_max_can_boff_C c_abc_inc_locan_boff c_abc_max_locan_boff c_abc_inc_dcc c_abc_max_dcc c_abc_inc_cs c_abc_max_cs c_abc_inc_maf c_abc_max_maf c_abc_max_msw_2 c_abc_inc_msw_2 c_abc_inc_msw_tog c_abc_max_msw_tog c_abc_inc_msw_3 c_abc_max_msw_3 c_abc_inc_poil_swi c_abc_max_poil_swi c_abc_inc_pvs_ratio c_abc_max_pvs_ratio c_abc_max_pvs_bls_not_plaus c_abc_inc_pvs_bls_not_plaus c_abc_inc_v_ref_1 c_abc_inc_v_ref_2 c_abc_max_v_ref_1 c_abc_max_v_ref_2 c_abc_inc_pvs_1 c_abc_inc_pvs_2 c_abc_max_pvs_1 c_abc_max_pvs_2 c_abc_inc_sof_req c_abc_max_sof_req c_abc_max_tecu c_abc_inc_tecu c_abc_inc_teg_pcat_down c_abc_max_teg_pcat_down c_abc_inc_tia_el c_abc_inc_tia_plaus c_abc_max_tia_el c_abc_max_tia_plaus c_abc_inc_tps_2 c_abc_max_tps_2 c_abc_inc_tps_1 c_abc_inc_tps_ratio c_abc_max_tps_1 c_abc_max_tps_ratio c_abc_inc_tq_req_can c_abc_max_tq_req_can c_abc_inc_tqi_lim c_abc_max_tqi_lim c_abc_max_vs c_abc_inc_vs c_abc_inc_mtc_dr c_abc_max_mtc_dr c_abc_max_cwp_int_off c_abc_inc_cwp_pwr c_abc_max_cwp_pwr c_abc_inc_cwp_int_off c_abc_inc_mec_ivvt_in c_abc_max_mec_ivvt_in c_abc_max_gen c_abc_inc_gen c_abc_inc_qoil_sens c_abc_max_qoil_sens c_abc_inc_bat_sens_it c_abc_inc_bat_sens_it_el c_abc_max_bat_sens_it c_abc_max_bat_sens_it_el c_abc_inc_bat_sens c_abc_inc_alter_bn c_abc_inc_alter_bn_bat c_abc_max_bat_sens c_abc_max_alter_bn c_abc_max_alter_bn_bat c_abc_inc_load_tps_plaus c_abc_max_load_tps_plaus c_abc_inc_vim_plaus c_abc_max_vim_plaus c_abc_inc_map_dip_plaus c_abc_max_map_dip_plaus c_abc_inc_alter_bn_rgn c_abc_max_alter_bn_rgn c_abc_dec_load_tps_plaus c_abc_inc_mec_ivvt_ex c_abc_max_mec_ivvt_ex c_abc_inc_toil_level c_abc_max_toil_level c_abc_inc_poil_ctl_stat c_abc_inc_poil_ctl_dyn c_abc_max_poil_ctl_stat c_abc_max_poil_ctl_dyn c_abc_inc_plaus_igk_bn c_abc_max_plaus_igk_bn c_abc_max_spi_mps c_abc_max_spi_knk c_abc_inc_spi_mps c_abc_inc_spi_knk c_abc_inc_gen_diag c_abc_max_gen_diag c_abc_inc_nox_sens c_abc_max_nox_sens c_abc_inc_tout_nox_sens c_abc_max_tout_nox_sens c_abc_inc_t_es c_abc_max_t_es c_abc_inc_ftl_can c_abc_max_ftl_can c_abc_inc_rly_main c_abc_max_rly_main c_abc_max_map_dip_sens c_abc_inc_map_dip_shift c_abc_max_map_dip_shift c_abc_inc_map_dip_sens c_abc_inc_ldm c_abc_max_ldm c_abc_inc_amp_plaus c_abc_max_amp_plaus c_abc_inc_rly_crcv_heat c_abc_max_rly_crcv_heat c_abc_inc_sof c_abc_max_sof c_abc_inc_sof_inh_mon c_abc_max_sof_inh_mon /end DEF_CHARACTERISTIC
 /begin OUT_MEASUREMENT lv_err_amp /end OUT_MEASUREMENT
/end FUNCTION
/begin FUNCTION DIA_Torque_Request_for_Safety_Diagnosis "_Torque Request for Safety Diagnosis" /begin OUT_MEASUREMENT lv_err_tqi_lim /end OUT_MEASUREMENT /end FUNCTION
/begin FUNCTION DIA_E_box_cooling_fan_diagnosis "_E-box cooling fan diagnosis" /begin OUT_MEASUREMENT lv_err_ebox_cfa /end OUT_MEASUREMENT /end FUNCTION
/begin FUNCTION DIA_ECU_temperature_sensor_diagnosis "_ECU temperature sensor diagnosis"
 /begin DEF_CHARACTERISTIC c_tia_max_tecu_diag c_v_tecu_min_diag c_v_tecu_max_diag c_t_dly_tecu_diag /end DEF_CHARACTERISTIC
 /begin OUT_MEASUREMENT lv_err_tecu /end OUT_MEASUREMENT
/end FUNCTION
/begin FUNCTION DIA_Tank_leakage_pump_diagnosis "_Tank leakage pump diagnosis" /begin DEF_CHARACTERISTIC c_v_dmtl_max_diag c_t_v_dmtl_max_diag /end DEF_CHARACTERISTIC
 /begin OUT_MEASUREMENT cdn_diag_dmtlh lv_err_dmtlh lv_inh_diag_dmtlh cdn_diag_dmtl_pump lv_err_dmtl_pump lv_inh_diag_dmtl_pump t_v_dmtl_max_diag cdn_diag_dmtls lv_inh_diag_dmtls lv_err_dmtls iso_m6_diag_ram_com.m6_cur_dmtl_cor_fil_cid18 iso_m6_diag_ram_com.m6_cur_dmtl_cor_fil_cid19 iso_m6_diag_ram_com.m6_cur_dmtl_dmtls_test iso_m6_diag_ram_com.m6_cur_dmtl_thd_dmtls_test iso_m6_diag_ram_com.m6_cur_dmtl_rough_leak_end iso_m6_diag_ram_com.m6_cur_dmtl_thd_rough_leak iso_m6_diag_ram_com.m6_cur_dmtl_small_leak_end iso_m6_diag_ram_com.m6_cur_dmtl_ref_leak iso_m6_diag_ram_com.m6_cur_dmtl_rough_leak_len_end iso_m6_diag_ram_com.m6_cur_dmtl_thd_rough_leak_len iso_m6_diag_ram_com.m6_ctr_cnl_small_leak_mes /end OUT_MEASUREMENT
/end FUNCTION
/begin FUNCTION DIA_SOF_diagnosis "_SOF diagnosis" /begin DEF_CHARACTERISTIC c_v_sof_swi_min c_v_sof_swi_max /end DEF_CHARACTERISTIC /begin OUT_MEASUREMENT lv_err_sof_req lv_err_sof cdn_diag_sof lv_inh_diag_sof /end OUT_MEASUREMENT /end FUNCTION
/begin FUNCTION DIA_TPS___ETC_Limp_Home_Manager "DIA_TPS / ETC Limp-Home Manager"
 /begin OUT_MEASUREMENT lv_tps_mtc_n_lim lv_mtc_lih_cur_off lv_err_tps lv_n_lim_etc_lih lv_n_lim_etc_lih_rev state_tps_diag state_etc_lih lv_mtc_cur_off_req lv_tps_sng_err /end OUT_MEASUREMENT
/end FUNCTION
/begin FUNCTION DIA_Diagnosis_Oil_temperature_and_level_sensor___DTOENS_ "_Diagnosis Oil temperature and level sensor  (DTOENS)"
 /begin OUT_MEASUREMENT lv_err_bat_sens_it lv_err_bat_sens_it_el lv_err_bat_sens lv_err_alter_bn lv_err_alter_bn_bat /end OUT_MEASUREMENT
/end FUNCTION
/begin FUNCTION DIA_BSD_Diagnosis "_BSD Diagnosis"
 /begin DEF_CHARACTERISTIC c_ctr_max_msg_cwp_com c_ctr_max_msg_qoil_com c_ctr_max_msg_sens_bat_smt_com c_ctr_thd_msg_cwp_com_diag c_ctr_max_msg_alter_com c_ctr_max_alter_com_stop c_ctr_max_cwp_com_stop c_ctr_max_qoil_com_stop c_ctr_max_sens_bat_smt_com_stop id_state_bsd_sdl_tbl c_state_bsd_cpt_det c_state_bsd_cpt_avl c_ctr_bsd_cpt_det /end DEF_CHARACTERISTIC
 /begin OUT_MEASUREMENT lv_err_alter_com lv_err_cwp_com lv_err_qoil_com lv_err_sens_bat_smt_com ctr_msg_alter_com_diag ctr_msg_cwp_com_diag ctr_msg_qoil_com_diag ctr_msg_sens_bat_smt_com_diag ctr_msg_sens_bat_smt_com_stop ctr_msg_qoil_com_stop ctr_msg_cwp_com_stop ctr_msg_alter_com_stop state_bsd_msg_com_stop lv_err_bsd lv_inh_cwp_diag lv_msg_alter_com_stop lv_msg_cwp_com_stop lv_msg_qoil_com_stop lv_msg_sens_bat_smt_com_stop ctr_abc_alter_com ctr_abc_cwp_com ctr_abc_qoil_com ctr_abc_sens_bat_smt_com ctr_end_diag_alter_com ctr_end_diag_cwp_com ctr_end_diag_qoil_com ctr_end_diag_sens_bat_smt_com lv_sens_bat_smt_act bsd_sens_bat_smt_info bsd_sens_bat_smt_adr lf_bsd_sens_bat_smt_ctl lv_sens_bat_smt_det lf_bsd_cpt_avl state_bsd_com lv_alter_com_act lv_cwp_com_act lv_qoil_com_act lv_sens_bat_smt_com_act state_bsd_cpt idx_bsd_sdl_tbl ctr_bsd_cpt_com_ok /end OUT_MEASUREMENT
/end FUNCTION
/begin FUNCTION DIA_Starter_Output_Diagnosis "_Starter Output Diagnosis"
 /begin OUT_MEASUREMENT cdn_diag_ebox_cfa lv_err_rly_st cdn_diag_rly_st lv_inh_diag_rly_st /end OUT_MEASUREMENT
/end FUNCTION
/begin FUNCTION DIA_Oil_pressure_switch_diagnosis "_Oil pressure switch diagnosis"
 /begin DEF_CHARACTERISTIC c_t_poil_swi_pwl c_toil_poil_swi_max_diag c_toil_poil_swi_min_diag /end DEF_CHARACTERISTIC
 /begin OUT_MEASUREMENT t_poil_swi_pwl lv_err_poil_swi lv_deac_diag_poil_swi /end OUT_MEASUREMENT
/end FUNCTION
/begin FUNCTION DIA_CAN_diagnosis_for_EFP_control "_CAN diagnosis for EFP control" /begin DEF_CHARACTERISTIC c_efp_cycnr_max /end DEF_CHARACTERISTIC /begin OUT_MEASUREMENT cyc_ctr_efp_diag lv_err_efp lv_err_efp_crash /end OUT_MEASUREMENT /end FUNCTION
/end MODULE
/end PROJECT
