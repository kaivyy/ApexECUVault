ASAP2_VERSION 1 41
/begin PROJECT MSD85 "Spray Guided DI-System with Piezo Injectors for 8-Cylinder"
/begin HEADER "_default_HeaderComment" PROJECT_NO _91 /end HEADER
/begin MODULE _default_ModuleName "_default_ModuleLongIdentifier"
/begin MOD_COMMON "_default_ModCommonComment" DEPOSIT ABSOLUTE BYTE_ORDER MSB_LAST ALIGNMENT_BYTE 1 ALIGNMENT_WORD 2 ALIGNMENT_LONG 2 ALIGNMENT_FLOAT32_IEEE 2 ALIGNMENT_FLOAT64_IEEE 4 /end MOD_COMMON
/begin CHARACTERISTIC c_abc_max_dmtlh "Maximum value of the anti - bounce counter" VALUE 0xa080b9f8 _REC_VAL_20_u1 254. _CNV_A_R_LINEAR_____0_CM 1. 255. DISPLAY_IDENTIFIER C_ABC_MAX_DMTLH FORMAT "%3.0" /end CHARACTERISTIC
/begin CHARACTERISTIC c_abc_inc_dmtlh "Anti - bounce counter increment" VALUE 0xa080b930 _REC_VAL_20_u1 255. _CNV_A_R_LINEAR_____0_CM 0. 255. DISPLAY_IDENTIFIER C_ABC_INC_DMTLH FORMAT "%3.0" /end CHARACTERISTIC
/begin MEASUREMENT cdn_diag_dmtlh "Diagnosis conditions forDMTL Heater" UBYTE _CNV_A_R_LINEAR_____0_CM 1 100. 0. 255. DISPLAY_IDENTIFIER CDN_DIAG_DMTLH ECU_ADDRESS 0xd00009b4 FORMAT "%3.0" /end MEASUREMENT
/begin MEASUREMENT lv_err_dmtlh "Logical value for DMTL heater stage error" UBYTE _CNV_S_2_RANGE__0___1_CM 1 100. 0. 1. DISPLAY_IDENTIFIER LV_ERR_DMTLH ECU_ADDRESS 0xd0007f8f BIT_MASK 0x1 /end MEASUREMENT
/begin MEASUREMENT lv_inh_diag_dmtlh "DMTL heater diagnosis: application incidence to inhibit the diagnosis" UBYTE _CNV_S_2_RANGE__0___1_CM 1 100. 0. 1. DISPLAY_IDENTIFIER LV_INH_DIAG_DMTLH ECU_ADDRESS 0xd0008df4 BIT_MASK 0x1 /end MEASUREMENT
/begin CHARACTERISTIC c_abc_inc_dmtl_pump "Anti - bounce counter increment" VALUE 0xa080b92f _REC_VAL_20_u1 255. _CNV_A_R_LINEAR_____0_CM 0. 255. DISPLAY_IDENTIFIER C_ABC_INC_DMTL_PUMP FORMAT "%3.0" /end CHARACTERISTIC
/begin CHARACTERISTIC c_v_dmtl_max_diag "threshold voltage to recognise short to battery" VALUE 0xa080c3c2 _REC_VAL_20_u2 0.49951171875 _CNV_A_R_LINEAR_____2_CM 0. 4.9951171875 DISPLAY_IDENTIFIER C_V_DMTL_MAX_DIAG FORMAT "%5.3" /end CHARACTERISTIC
/begin CHARACTERISTIC c_abc_max_dmtl_pump "Debounce counter maximum value" VALUE 0xa080b9f7 _REC_VAL_20_u1 254. _CNV_A_R_LINEAR_____0_CM 1. 255. DISPLAY_IDENTIFIER C_ABC_MAX_DMTL_PUMP FORMAT "%3.0" /end CHARACTERISTIC
/begin CHARACTERISTIC c_t_v_dmtl_max_diag "bounce time for recognise short to battery" VALUE 0xa080c291 _REC_VAL_20_u1 0.254 _CNV_A_R_LINEAR_____3_CM 1.e-002 2.55 DISPLAY_IDENTIFIER C_T_V_DMTL_MAX_DIAG FORMAT "%4.2" /end CHARACTERISTIC
/begin MEASUREMENT cdn_diag_dmtl_pump "Diagnosis conditions for DMTL Pump" UBYTE _CNV_A_R_LINEAR_____0_CM 1 100. 0. 255. DISPLAY_IDENTIFIER CDN_DIAG_DMTL_PUMP ECU_ADDRESS 0xd00009b8 FORMAT "%3.0" /end MEASUREMENT
/begin MEASUREMENT lv_err_dmtl_pump "Error flag, DMTL pump" UBYTE _CNV_S_2_RANGE__0___1_CM 1 100. 0. 1. DISPLAY_IDENTIFIER LV_ERR_DMTL_PUMP ECU_ADDRESS 0xd0007f80 BIT_MASK 0x1 /end MEASUREMENT
/begin MEASUREMENT lv_inh_diag_dmtl_pump "DMTL pump diagnosis: application incidence to inhibit the diagnosis" UBYTE _CNV_S_2_RANGE__0___1_CM 1 100. 0. 1. DISPLAY_IDENTIFIER LV_INH_DIAG_DMTL_PUMP ECU_ADDRESS 0xd0008df0 BIT_MASK 0x1 /end MEASUREMENT
/begin MEASUREMENT t_v_dmtl_max_diag "debouince time" UBYTE _CNV_A_R_LINEAR_____3_CM 1 100. 0. 2.55 DISPLAY_IDENTIFIER T_V_DMTL_MAX_DIAG ECU_ADDRESS 0xd00009ba FORMAT "%4.2" /end MEASUREMENT
/begin CHARACTERISTIC c_abc_inc_dmtls "Anti - bounce counter increment" VALUE 0xa080b931 _REC_VAL_20_u1 255. _CNV_A_R_LINEAR_____0_CM 0. 255. DISPLAY_IDENTIFIER C_ABC_INC_DMTLS FORMAT "%3.0" /end CHARACTERISTIC
/begin CHARACTERISTIC c_abc_max_dmtls "Debounce counter maximum value" VALUE 0xa080b9f9 _REC_VAL_20_u1 254. _CNV_A_R_LINEAR_____0_CM 1. 255. DISPLAY_IDENTIFIER C_ABC_MAX_DMTLS FORMAT "%3.0" /end CHARACTERISTIC
/begin MEASUREMENT cdn_diag_dmtls "Diagnosis conditions for DMTL change over  Valve" UBYTE _CNV_A_R_LINEAR_____0_CM 1 100. 0. 255. DISPLAY_IDENTIFIER CDN_DIAG_DMTLS ECU_ADDRESS 0xd00009bc FORMAT "%3.0" /end MEASUREMENT
/begin MEASUREMENT lv_inh_diag_dmtls "DMTL change-over valve diagnosis: application incidence to inhibit the diagnosis" UBYTE _CNV_S_2_RANGE__0___1_CM 1 100. 0. 1. DISPLAY_IDENTIFIER LV_INH_DIAG_DMTLS ECU_ADDRESS 0xd0008dec BIT_MASK 0x1 /end MEASUREMENT
/begin MEASUREMENT lv_err_dmtls "Error flag, DMTL change-over valve" UBYTE _CNV_S_2_RANGE__0___1_CM 1 100. 0. 1. DISPLAY_IDENTIFIER LV_ERR_DMTLS ECU_ADDRESS 0xd0007f7f BIT_MASK 0x1 /end MEASUREMENT
/begin CHARACTERISTIC c_abc_inc_rly_accout "Debounce counter increment- RLY_ACCOUT diagnosis" VALUE 0xa080b977 _REC_VAL_20_u1 255. _CNV_A_R_LINEAR_____0_CM 0. 255. DISPLAY_IDENTIFIER C_ABC_INC_RLY_ACCOUT FORMAT "%3.0" /end CHARACTERISTIC
/begin CHARACTERISTIC c_abc_max_rly_accout "Debounce counter maximum value - RLY_ACCOUT diagnosis" VALUE 0xa080ba40 _REC_VAL_20_u1 254. _CNV_A_R_LINEAR_____0_CM 1. 255. DISPLAY_IDENTIFIER C_ABC_MAX_RLY_ACCOUT FORMAT "%3.0" /end CHARACTERISTIC
/begin CHARACTERISTIC c_abc_max_ebox_cfa "Debounce counter maximum value" VALUE 0xa080b9fb _REC_VAL_20_u1 254. _CNV_A_R_LINEAR_____0_CM 1. 255. DISPLAY_IDENTIFIER C_ABC_MAX_EBOX_CFA FORMAT "%3.0" /end CHARACTERISTIC
/begin CHARACTERISTIC c_abc_inc_ebox_cfa "Debounce counter increment" VALUE 0xa080b933 _REC_VAL_20_u1 255. _CNV_A_R_LINEAR_____0_CM 0. 255. DISPLAY_IDENTIFIER C_ABC_INC_EBOX_CFA FORMAT "%3.0" /end CHARACTERISTIC
/begin MEASUREMENT cdn_diag_ebox_cfa "Diagnosis conditions for E-Box Cooling FAN" UBYTE _CNV_A_R_LINEAR_____0_CM 1 100. 0. 255. DISPLAY_IDENTIFIER CDN_DIAG_EBOX_CFA ECU_ADDRESS 0xd0000ae0 FORMAT "%3.0" /end MEASUREMENT
/begin MEASUREMENT lv_err_ebox_cfa "Logical value for EBOX CFA error" UBYTE _CNV_S_2_RANGE__0___1_CM 1 100. 0. 1. DISPLAY_IDENTIFIER LV_ERR_EBOX_CFA ECU_ADDRESS 0xd0007f7c BIT_MASK 0x1 /end MEASUREMENT
/begin CHARACTERISTIC c_abc_max_ef "Debounce counter maximum value" VALUE 0xa080b9ff _REC_VAL_20_u1 254. _CNV_A_R_LINEAR_____0_CM 1. 255. DISPLAY_IDENTIFIER C_ABC_MAX_EF FORMAT "%3.0" /end CHARACTERISTIC
/begin CHARACTERISTIC c_abc_inc_ef "Debounce counter increment" VALUE 0xa080b937 _REC_VAL_20_u1 255. _CNV_A_R_LINEAR_____0_CM 0. 255. DISPLAY_IDENTIFIER C_ABC_INC_EF FORMAT "%3.0" /end CHARACTERISTIC
/begin MEASUREMENT lv_err_rly_st "Status of starter output diagnosis" UBYTE _CNV_S_2_RANGE__0___1_CM 1 100. 0. 1. DISPLAY_IDENTIFIER LV_ERR_RLY_ST ECU_ADDRESS 0xd0007f88 BIT_MASK 0x1 /end MEASUREMENT
/begin CHARACTERISTIC c_abc_inc_rly_st "anti-bounce increment value" VALUE 0xa080b97a _REC_VAL_20_u1 255. _CNV_A_R_LINEAR_____0_CM 0. 255. DISPLAY_IDENTIFIER C_ABC_INC_RLY_ST FORMAT "%3.0" /end CHARACTERISTIC
/begin CHARACTERISTIC c_abc_max_rly_st "anti-bounce maximum value" VALUE 0xa080ba43 _REC_VAL_20_u1 254. _CNV_A_R_LINEAR_____0_CM 1. 255. DISPLAY_IDENTIFIER C_ABC_MAX_RLY_ST FORMAT "%3.0" /end CHARACTERISTIC
/begin MEASUREMENT cdn_diag_rly_st "Activation conditions for starter relay" UBYTE _CNV_A_R_LINEAR_____0_CM 1 100. 0. 255. DISPLAY_IDENTIFIER CDN_DIAG_RLY_ST ECU_ADDRESS 0xd0001624 FORMAT "%3.0" /end MEASUREMENT
/begin MEASUREMENT lv_inh_diag_rly_st "Inhibit diagnosis starter relay" UBYTE _CNV_S_2_RANGE__0___1_CM 1 100. 0. 1. DISPLAY_IDENTIFIER LV_INH_DIAG_RLY_ST ECU_ADDRESS 0xd0008df8 BIT_MASK 0x1 /end MEASUREMENT
/begin CHARACTERISTIC c_slv_ivvt_pwm_diag_min_oc "Minimum threshold for OC diagnosis window" VALUE 0xa080c0b8 _REC_VAL_20_u2 99.99847412109381 _CNV_A_R_LINEAR_____8_CM 0. 99.99847412109381 DISPLAY_IDENTIFIER C_SLV_IVVT_PWM_DIAG_MIN_OC FORMAT "%5.2" /end CHARACTERISTIC
/begin CHARACTERISTIC c_slv_ivvt_pwm_diag_min_scb "Minimum threshold for SCB diagnosis window" VALUE 0xa080c0ba _REC_VAL_20_u2 99.99847412109381 _CNV_A_R_LINEAR_____8_CM 0. 99.99847412109381 DISPLAY_IDENTIFIER C_SLV_IVVT_PWM_DIAG_MIN_SCB FORMAT "%5.2" /end CHARACTERISTIC
/begin CHARACTERISTIC c_slv_ivvt_pwm_diag_max_scg "Maximum threshold for SCG diagnosis window" VALUE 0xa080c0b6 _REC_VAL_20_u2 99.99847412109381 _CNV_A_R_LINEAR_____8_CM 0. 99.99847412109381 DISPLAY_IDENTIFIER C_SLV_IVVT_PWM_DIAG_MAX_SCG FORMAT "%5.2" /end CHARACTERISTIC
/begin CHARACTERISTIC c_abc_inc_slv_ivvt_1 "Debounce counter increment - VANOS diagnosis magnetic valve CAM_IN" VALUE 0xa080b97c _REC_VAL_20_u1 255. _CNV_A_R_LINEAR_____0_CM 0. 255. DISPLAY_IDENTIFIER C_ABC_INC_SLV_IVVT_1 FORMAT "%3.0" /end CHARACTERISTIC
/begin CHARACTERISTIC c_abc_inc_slv_ivvt_2 "Debounce counter increment - VANOS diagnosis magnetic valve CAM_IN" VALUE 0xa080b97d _REC_VAL_20_u1 255. _CNV_A_R_LINEAR_____0_CM 0. 255. DISPLAY_IDENTIFIER C_ABC_INC_SLV_IVVT_2 FORMAT "%3.0" /end CHARACTERISTIC
/begin CHARACTERISTIC c_abc_max_slv_ivvt_2 "Debounce counter maximum value - VANOS diagnosis magnetic valves" VALUE 0xa080ba46 _REC_VAL_20_u1 254. _CNV_A_R_LINEAR_____0_CM 1. 255. DISPLAY_IDENTIFIER C_ABC_MAX_SLV_IVVT_2 FORMAT "%3.0" /end CHARACTERISTIC
/begin CHARACTERISTIC c_abc_max_slv_ivvt_1 "Debounce counter maximum value - VANOS diagnosis magnetic valves" VALUE 0xa080ba45 _REC_VAL_20_u1 254. _CNV_A_R_LINEAR_____0_CM 1. 255. DISPLAY_IDENTIFIER C_ABC_MAX_SLV_IVVT_1 FORMAT "%3.0" /end CHARACTERISTIC
/begin MEASUREMENT cdn_diag_slv_ivvt_ex_1 "Diagnosis condition for each symptom for IVVT_EX" UBYTE _CNV_A_R_LINEAR_____0_CM 1 100. 0. 255. DISPLAY_IDENTIFIER CDN_DIAG_SLV_IVVT_EX_1 ECU_ADDRESS 0xd0001096 FORMAT "%3.0" /end MEASUREMENT
/begin MEASUREMENT cdn_diag_slv_ivvt_ex_2 "Diagnosis condition for each symptom for IVVT_EX" UBYTE _CNV_A_R_LINEAR_____0_CM 1 100. 0. 255. DISPLAY_IDENTIFIER CDN_DIAG_SLV_IVVT_EX_2 ECU_ADDRESS 0xd0001097 FORMAT "%3.0" /end MEASUREMENT
/begin MEASUREMENT cdn_diag_slv_ivvt_in_1 "Diagnosis condition for each symptom for IVVT_IN" UBYTE _CNV_A_R_LINEAR_____0_CM 1 100. 0. 255. DISPLAY_IDENTIFIER CDN_DIAG_SLV_IVVT_IN_1 ECU_ADDRESS 0xd0001090 FORMAT "%3.0" /end MEASUREMENT
/begin MEASUREMENT cdn_diag_slv_ivvt_in_2 "Diagnosis condition for each symptom for IVVT_IN" UBYTE _CNV_A_R_LINEAR_____0_CM 1 100. 0. 255. DISPLAY_IDENTIFIER CDN_DIAG_SLV_IVVT_IN_2 ECU_ADDRESS 0xd0001091 FORMAT "%3.0" /end MEASUREMENT
/begin MEASUREMENT lv_err_slv_ivvt_ex_1 "Error flag solenoid valve of exhaust camshaft 1" UBYTE _CNV_S_2_RANGE__0___1_CM 1 100. 0. 1. DISPLAY_IDENTIFIER LV_ERR_SLV_IVVT_EX_1 ECU_ADDRESS 0xd0007f12 BIT_MASK 0x1 /end MEASUREMENT
/begin MEASUREMENT lv_err_slv_ivvt_ex_2 "Error flag solenoid valve of exhaust camshaft 2" UBYTE _CNV_S_2_RANGE__0___1_CM 1 100. 0. 1. DISPLAY_IDENTIFIER LV_ERR_SLV_IVVT_EX_2 ECU_ADDRESS 0xd0007f13 BIT_MASK 0x1 /end MEASUREMENT
/begin MEASUREMENT lv_err_slv_ivvt_in_1 "Error flag solenoid valve of inlet camshaft 1" UBYTE _CNV_S_2_RANGE__0___1_CM 1 100. 0. 1. DISPLAY_IDENTIFIER LV_ERR_SLV_IVVT_IN_1 ECU_ADDRESS 0xd0007f10 BIT_MASK 0x1 /end MEASUREMENT
/begin MEASUREMENT lv_err_slv_ivvt_in_2 "Error flag solenoid valve of inlet camshaft 2" UBYTE _CNV_S_2_RANGE__0___1_CM 1 100. 0. 1. DISPLAY_IDENTIFIER LV_ERR_SLV_IVVT_IN_2 ECU_ADDRESS 0xd0007f11 BIT_MASK 0x1 /end MEASUREMENT
/begin MEASUREMENT lv_inh_diag_slv_ivvt_ex_1 "Diagnosis inhibition IVVT_EX" UBYTE _CNV_S_2_RANGE__0___1_CM 1 100. 0. 1. DISPLAY_IDENTIFIER LV_INH_DIAG_SLV_IVVT_EX_1 ECU_ADDRESS 0xd0008e02 BIT_MASK 0x1 /end MEASUREMENT
/begin MEASUREMENT lv_inh_diag_slv_ivvt_ex_2 "Diagnosis inhibition IVVT_EX" UBYTE _CNV_S_2_RANGE__0___1_CM 1 100. 0. 1. DISPLAY_IDENTIFIER LV_INH_DIAG_SLV_IVVT_EX_2 ECU_ADDRESS 0xd0008e03 BIT_MASK 0x1 /end MEASUREMENT
/begin MEASUREMENT lv_inh_diag_slv_ivvt_in_1 "Diagnosis inhibition IVVT_IN" UBYTE _CNV_S_2_RANGE__0___1_CM 1 100. 0. 1. DISPLAY_IDENTIFIER LV_INH_DIAG_SLV_IVVT_IN_1 ECU_ADDRESS 0xd0008e00 BIT_MASK 0x1 /end MEASUREMENT
/begin MEASUREMENT lv_inh_diag_slv_ivvt_in_2 "Diagnosis inhibition IVVT_IN" UBYTE _CNV_S_2_RANGE__0___1_CM 1 100. 0. 1. DISPLAY_IDENTIFIER LV_INH_DIAG_SLV_IVVT_IN_2 ECU_ADDRESS 0xd0008e01 BIT_MASK 0x1 /end MEASUREMENT
/begin CHARACTERISTIC c_abc_inc_imob_1 "" VALUE 0xa080b950 _REC_VAL_20_u1 255. _CNV_A_R_LINEAR_____0_CM 0. 255. DISPLAY_IDENTIFIER C_ABC_INC_IMOB_1 FORMAT "%3.0" /end CHARACTERISTIC
/begin CHARACTERISTIC c_abc_inc_imob_2 "" VALUE 0xa080b951 _REC_VAL_20_u1 255. _CNV_A_R_LINEAR_____0_CM 0. 255. DISPLAY_IDENTIFIER C_ABC_INC_IMOB_2 FORMAT "%3.0" /end CHARACTERISTIC
/begin CHARACTERISTIC c_abc_inc_imob_3 "" VALUE 0xa080b952 _REC_VAL_20_u1 255. _CNV_A_R_LINEAR_____0_CM 0. 255. DISPLAY_IDENTIFIER C_ABC_INC_IMOB_3 FORMAT "%3.0" /end CHARACTERISTIC
/begin CHARACTERISTIC c_abc_max_imob_0 "" VALUE 0xa080ba17 _REC_VAL_20_u1 254. _CNV_A_R_LINEAR_____0_CM 1. 255. DISPLAY_IDENTIFIER C_ABC_MAX_IMOB_0 FORMAT "%3.0" /end CHARACTERISTIC
/begin CHARACTERISTIC c_abc_max_imob_1 "" VALUE 0xa080ba18 _REC_VAL_20_u1 254. _CNV_A_R_LINEAR_____0_CM 1. 255. DISPLAY_IDENTIFIER C_ABC_MAX_IMOB_1 FORMAT "%3.0" /end CHARACTERISTIC
/begin CHARACTERISTIC c_abc_max_imob_3 "" VALUE 0xa080ba1a _REC_VAL_20_u1 254. _CNV_A_R_LINEAR_____0_CM 1. 255. DISPLAY_IDENTIFIER C_ABC_MAX_IMOB_3 FORMAT "%3.0" /end CHARACTERISTIC
/begin CHARACTERISTIC c_abc_max_imob_2 "" VALUE 0xa080ba19 _REC_VAL_20_u1 254. _CNV_A_R_LINEAR_____0_CM 1. 255. DISPLAY_IDENTIFIER C_ABC_MAX_IMOB_2 FORMAT "%3.0" /end CHARACTERISTIC
/begin CHARACTERISTIC c_abc_inc_imob_0 "" VALUE 0xa080b94f _REC_VAL_20_u1 255. _CNV_A_R_LINEAR_____0_CM 0. 255. DISPLAY_IDENTIFIER C_ABC_INC_IMOB_0 FORMAT "%3.0" /end CHARACTERISTIC
/begin CHARACTERISTIC c_abc_dec_imob_0 "" VALUE 0xa080b8cd _REC_VAL_20_u1 255. _CNV_A_R_LINEAR_____0_CM 0. 255. DISPLAY_IDENTIFIER C_ABC_DEC_IMOB_0 FORMAT "%3.0" /end CHARACTERISTIC
/begin CHARACTERISTIC c_abc_dec_imob_1 "" VALUE 0xa080b8ce _REC_VAL_20_u1 255. _CNV_A_R_LINEAR_____0_CM 0. 255. DISPLAY_IDENTIFIER C_ABC_DEC_IMOB_1 FORMAT "%3.0" /end CHARACTERISTIC
/begin CHARACTERISTIC c_abc_dec_imob_3 "" VALUE 0xa080b8cf _REC_VAL_20_u1 255. _CNV_A_R_LINEAR_____0_CM 0. 255. DISPLAY_IDENTIFIER C_ABC_DEC_IMOB_3 FORMAT "%3.0" /end CHARACTERISTIC
/begin CHARACTERISTIC c_abc_inc_amp "Anti - bounce counter increment" VALUE 0xa080b8d6 _REC_VAL_20_u1 255. _CNV_A_R_LINEAR_____0_CM 0. 255. DISPLAY_IDENTIFIER C_ABC_INC_AMP FORMAT "%3.0" /end CHARACTERISTIC
/begin CHARACTERISTIC c_abc_max_amp "Maximum value of the anti - bounce counter" VALUE 0xa080b99e _REC_VAL_20_u1 254. _CNV_A_R_LINEAR_____0_CM 1. 255. DISPLAY_IDENTIFIER C_ABC_MAX_AMP FORMAT "%3.0" /end CHARACTERISTIC
/begin MEASUREMENT lv_err_amp "AMP error present" UBYTE _CNV_S_2_RANGE__0___1_CM 1 100. 0. 1. DISPLAY_IDENTIFIER LV_ERR_AMP ECU_ADDRESS 0xd0007f0c BIT_MASK 0x1 /end MEASUREMENT
/begin CHARACTERISTIC c_abc_inc_im_bts_plaus "BTS debounce counter increment  " VALUE 0xa080b94e _REC_VAL_20_u1 255. _CNV_A_R_LINEAR_____0_CM 0. 255. DISPLAY_IDENTIFIER C_ABC_INC_IM_BTS_PLAUS FORMAT "%3.0" /end CHARACTERISTIC
/begin CHARACTERISTIC c_abc_inc_im_bls_plaus "BLS debounce counter increment  " VALUE 0xa080b94d _REC_VAL_20_u1 255. _CNV_A_R_LINEAR_____0_CM 0. 255. DISPLAY_IDENTIFIER C_ABC_INC_IM_BLS_PLAUS FORMAT "%3.0" /end CHARACTERISTIC
/begin CHARACTERISTIC c_abc_max_im_bts_plaus "BTS debounce counter maximum value, error debounce" VALUE 0xa080ba16 _REC_VAL_20_u1 254. _CNV_A_R_LINEAR_____0_CM 1. 255. DISPLAY_IDENTIFIER C_ABC_MAX_IM_BTS_PLAUS FORMAT "%3.0" /end CHARACTERISTIC
/begin CHARACTERISTIC c_abc_max_im_bls_plaus "BLS debounce counter maximum value" VALUE 0xa080ba15 _REC_VAL_20_u1 254. _CNV_A_R_LINEAR_____0_CM 1. 255. DISPLAY_IDENTIFIER C_ABC_MAX_IM_BLS_PLAUS FORMAT "%3.0" /end CHARACTERISTIC
/begin CHARACTERISTIC c_abc_inc_bn_tq_dcc "Anti - bounce counter increment BN2000 Diagnosis" VALUE 0xa080b8f6 _REC_VAL_20_u1 255. _CNV_A_R_LINEAR_____0_CM 0. 255. DISPLAY_IDENTIFIER C_ABC_INC_BN_TQ_DCC FORMAT "%3.0" /end CHARACTERISTIC
/begin CHARACTERISTIC c_abc_inc_bn_tq_tcs "Anti - bounce counter increment BN2000 Diagnosis" VALUE 0xa080b8fa _REC_VAL_20_u1 255. _CNV_A_R_LINEAR_____0_CM 0. 255. DISPLAY_IDENTIFIER C_ABC_INC_BN_TQ_TCS FORMAT "%3.0" /end CHARACTERISTIC
/begin CHARACTERISTIC c_abc_inc_bn_vs_tcs "Anti - bounce counter increment BN2000 Diagnosis" VALUE 0xa080b8fd _REC_VAL_20_u1 255. _CNV_A_R_LINEAR_____0_CM 0. 255. DISPLAY_IDENTIFIER C_ABC_INC_BN_VS_TCS FORMAT "%3.0" /end CHARACTERISTIC
/begin CHARACTERISTIC c_abc_inc_bn_tcs "Anti - bounce counter increment BN2000 Diagnosis" VALUE 0xa080b8f4 _REC_VAL_20_u1 255. _CNV_A_R_LINEAR_____0_CM 0. 255. DISPLAY_IDENTIFIER C_ABC_INC_BN_TCS FORMAT "%3.0" /end CHARACTERISTIC
/begin CHARACTERISTIC c_abc_inc_bn_tq_etcu "Anti - bounce counter increment BN2000 Diagnosis" VALUE 0xa080b8f7 _REC_VAL_20_u1 255. _CNV_A_R_LINEAR_____0_CM 0. 255. DISPLAY_IDENTIFIER C_ABC_INC_BN_TQ_ETCU FORMAT "%3.0" /end CHARACTERISTIC
/begin CHARACTERISTIC c_abc_inc_bn_etcu "Anti - bounce counter increment BN2000 Diagnosis" VALUE 0xa080b8e3 _REC_VAL_20_u1 255. _CNV_A_R_LINEAR_____0_CM 0. 255. DISPLAY_IDENTIFIER C_ABC_INC_BN_ETCU FORMAT "%3.0" /end CHARACTERISTIC
/begin CHARACTERISTIC c_abc_inc_bn_etcu_2 "Anti - bounce counter increment BN2000 Diagnosis" VALUE 0xa080b8e4 _REC_VAL_20_u1 255. _CNV_A_R_LINEAR_____0_CM 0. 255. DISPLAY_IDENTIFIER C_ABC_INC_BN_ETCU_2 FORMAT "%3.0" /end CHARACTERISTIC
/begin CHARACTERISTIC c_abc_inc_bn_etcu_3 "Anti - bounce counter increment BN2000 Diagnosis" VALUE 0xa080b8e5 _REC_VAL_20_u1 255. _CNV_A_R_LINEAR_____0_CM 0. 255. DISPLAY_IDENTIFIER C_ABC_INC_BN_ETCU_3 FORMAT "%3.0" /end CHARACTERISTIC
/begin CHARACTERISTIC c_abc_inc_bn_etcu_disp "Anti - bounce counter increment BN2000 Diagnosis" VALUE 0xa080b8e6 _REC_VAL_20_u1 255. _CNV_A_R_LINEAR_____0_CM 0. 255. DISPLAY_IDENTIFIER C_ABC_INC_BN_ETCU_DISP FORMAT "%3.0" /end CHARACTERISTIC
/begin CHARACTERISTIC c_abc_inc_bn_tq_amt "Anti - bounce counter increment BN2000 Diagnosis" VALUE 0xa080b8f5 _REC_VAL_20_u1 255. _CNV_A_R_LINEAR_____0_CM 0. 255. DISPLAY_IDENTIFIER C_ABC_INC_BN_TQ_AMT FORMAT "%3.0" /end CHARACTERISTIC
/begin CHARACTERISTIC c_abc_inc_bn_acc "Anti - bounce counter increment BN2000 Diagnosis" VALUE 0xa080b8dc _REC_VAL_20_u1 255. _CNV_A_R_LINEAR_____0_CM 0. 255. DISPLAY_IDENTIFIER C_ABC_INC_BN_ACC FORMAT "%3.0" /end CHARACTERISTIC
/begin CHARACTERISTIC c_abc_inc_bn_icl "Anti - bounce counter increment BN2000 Diagnosis" VALUE 0xa080b8e9 _REC_VAL_20_u1 255. _CNV_A_R_LINEAR_____0_CM 0. 255. DISPLAY_IDENTIFIER C_ABC_INC_BN_ICL FORMAT "%3.0" /end CHARACTERISTIC
/begin CHARACTERISTIC c_abc_inc_bn_km_icl "Anti - bounce counter increment BN2000 Diagnosis" VALUE 0xa080b8ea _REC_VAL_20_u1 255. _CNV_A_R_LINEAR_____0_CM 0. 255. DISPLAY_IDENTIFIER C_ABC_INC_BN_KM_ICL FORMAT "%3.0" /end CHARACTERISTIC
/begin CHARACTERISTIC c_abc_inc_bn_veh_mod "Anti - bounce counter increment BN2000 Diagnosis" VALUE 0xa080b8fc _REC_VAL_20_u1 255. _CNV_A_R_LINEAR_____0_CM 0. 255. DISPLAY_IDENTIFIER C_ABC_INC_BN_VEH_MOD FORMAT "%3.0" /end CHARACTERISTIC
/begin CHARACTERISTIC c_abc_inc_bn_t_icl "Anti - bounce counter increment BN2000 Diagnosis" VALUE 0xa080b8f3 _REC_VAL_20_u1 255. _CNV_A_R_LINEAR_____0_CM 0. 255. DISPLAY_IDENTIFIER C_ABC_INC_BN_T_ICL FORMAT "%3.0" /end CHARACTERISTIC
/begin CHARACTERISTIC c_abc_inc_bn_pow_vb "Anti - bounce counter increment BN2000 Diagnosis" VALUE 0xa080b8f0 _REC_VAL_20_u1 255. _CNV_A_R_LINEAR_____0_CM 0. 255. DISPLAY_IDENTIFIER C_ABC_INC_BN_POW_VB FORMAT "%3.0" /end CHARACTERISTIC
/begin CHARACTERISTIC c_abc_inc_bn_pow_gen "Anti - bounce counter increment BN2000 Diagnosis" VALUE 0xa080b8ef _REC_VAL_20_u1 255. _CNV_A_R_LINEAR_____0_CM 0. 255. DISPLAY_IDENTIFIER C_ABC_INC_BN_POW_GEN FORMAT "%3.0" /end CHARACTERISTIC
/begin CHARACTERISTIC c_abc_inc_bn_msw "Anti - bounce counter increment BN2000 Diagnosis" VALUE 0xa080b8ed _REC_VAL_20_u1 255. _CNV_A_R_LINEAR_____0_CM 0. 255. DISPLAY_IDENTIFIER C_ABC_INC_BN_MSW FORMAT "%3.0" /end CHARACTERISTIC
/begin CHARACTERISTIC c_abc_inc_bn_ang_pste "Anti - bounce counter increment BN2000 Diagnosis" VALUE 0xa080b8dd _REC_VAL_20_u1 255. _CNV_A_R_LINEAR_____0_CM 0. 255. DISPLAY_IDENTIFIER C_ABC_INC_BN_ANG_PSTE FORMAT "%3.0" /end CHARACTERISTIC
/begin CHARACTERISTIC c_abc_max_bn_tq_tcs "Maximum value of the anti - bounce counter BN2000 diagnosis" VALUE 0xa080b9c2 _REC_VAL_20_u1 254. _CNV_A_R_LINEAR_____0_CM 1. 255. DISPLAY_IDENTIFIER C_ABC_MAX_BN_TQ_TCS FORMAT "%3.0" /end CHARACTERISTIC
/begin CHARACTERISTIC c_abc_max_bn_vs_tcs "Maximum value of the anti - bounce counter BN2000 diagnosis" VALUE 0xa080b9c5 _REC_VAL_20_u1 254. _CNV_A_R_LINEAR_____0_CM 1. 255. DISPLAY_IDENTIFIER C_ABC_MAX_BN_VS_TCS FORMAT "%3.0" /end CHARACTERISTIC
/begin CHARACTERISTIC c_abc_max_bn_tcs "Maximum value of the anti - bounce counter BN2000 diagnosis" VALUE 0xa080b9bc _REC_VAL_20_u1 254. _CNV_A_R_LINEAR_____0_CM 1. 255. DISPLAY_IDENTIFIER C_ABC_MAX_BN_TCS FORMAT "%3.0" /end CHARACTERISTIC
/begin CHARACTERISTIC c_abc_max_bn_tq_etcu "Maximum value of the anti - bounce counter BN2000 diagnosis" VALUE 0xa080b9bf _REC_VAL_20_u1 254. _CNV_A_R_LINEAR_____0_CM 1. 255. DISPLAY_IDENTIFIER C_ABC_MAX_BN_TQ_ETCU FORMAT "%3.0" /end CHARACTERISTIC
/begin CHARACTERISTIC c_abc_max_bn_etcu "Maximum value of the anti - bounce counter BN2000 diagnosis" VALUE 0xa080b9ab _REC_VAL_20_u1 254. _CNV_A_R_LINEAR_____0_CM 1. 255. DISPLAY_IDENTIFIER C_ABC_MAX_BN_ETCU FORMAT "%3.0" /end CHARACTERISTIC
/begin CHARACTERISTIC c_abc_max_bn_etcu_2 "Maximum value of the anti - bounce counter BN2000 diagnosis" VALUE 0xa080b9ac _REC_VAL_20_u1 254. _CNV_A_R_LINEAR_____0_CM 1. 255. DISPLAY_IDENTIFIER C_ABC_MAX_BN_ETCU_2 FORMAT "%3.0" /end CHARACTERISTIC
/begin CHARACTERISTIC c_abc_max_bn_etcu_3 "Maximum value of the anti - bounce counter BN2000 diagnosis" VALUE 0xa080b9ad _REC_VAL_20_u1 254. _CNV_A_R_LINEAR_____0_CM 1. 255. DISPLAY_IDENTIFIER C_ABC_MAX_BN_ETCU_3 FORMAT "%3.0" /end CHARACTERISTIC
/begin CHARACTERISTIC c_abc_max_bn_etcu_disp "Maximum value of the anti - bounce counter BN2000 diagnosis" VALUE 0xa080b9ae _REC_VAL_20_u1 254. _CNV_A_R_LINEAR_____0_CM 1. 255. DISPLAY_IDENTIFIER C_ABC_MAX_BN_ETCU_DISP FORMAT "%3.0" /end CHARACTERISTIC
/begin CHARACTERISTIC c_abc_max_bn_tq_amt "Maximum value of the anti - bounce counter BN2000 diagnosis" VALUE 0xa080b9bd _REC_VAL_20_u1 254. _CNV_A_R_LINEAR_____0_CM 1. 255. DISPLAY_IDENTIFIER C_ABC_MAX_BN_TQ_AMT FORMAT "%3.0" /end CHARACTERISTIC
/begin CHARACTERISTIC c_abc_max_bn_acc "Maximum value of the anti - bounce counter BN2000 diagnosis" VALUE 0xa080b9a4 _REC_VAL_20_u1 254. _CNV_A_R_LINEAR_____0_CM 1. 255. DISPLAY_IDENTIFIER C_ABC_MAX_BN_ACC FORMAT "%3.0" /end CHARACTERISTIC
/begin CHARACTERISTIC c_abc_max_bn_t_icl "Maximum value of the anti - bounce counter BN2000 diagnosis" VALUE 0xa080b9bb _REC_VAL_20_u1 254. _CNV_A_R_LINEAR_____0_CM 1. 255. DISPLAY_IDENTIFIER C_ABC_MAX_BN_T_ICL FORMAT "%3.0" /end CHARACTERISTIC
/begin CHARACTERISTIC c_abc_max_bn_km_icl "Maximum value of the anti - bounce counter BN2000 diagnosis" VALUE 0xa080b9b2 _REC_VAL_20_u1 254. _CNV_A_R_LINEAR_____0_CM 1. 255. DISPLAY_IDENTIFIER C_ABC_MAX_BN_KM_ICL FORMAT "%3.0" /end CHARACTERISTIC
/begin CHARACTERISTIC c_abc_max_bn_veh_mod "Maximum value of the anti - bounce counter BN2000 diagnosis" VALUE 0xa080b9c4 _REC_VAL_20_u1 254. _CNV_A_R_LINEAR_____0_CM 1. 255. DISPLAY_IDENTIFIER C_ABC_MAX_BN_VEH_MOD FORMAT "%3.0" /end CHARACTERISTIC
/begin CHARACTERISTIC c_abc_max_bn_icl "Maximum value of the anti - bounce counter BN2000 diagnosis" VALUE 0xa080b9b1 _REC_VAL_20_u1 254. _CNV_A_R_LINEAR_____0_CM 1. 255. DISPLAY_IDENTIFIER C_ABC_MAX_BN_ICL FORMAT "%3.0" /end CHARACTERISTIC
/begin CHARACTERISTIC c_abc_max_bn_pow_vb "Maximum value of the anti - bounce counter BN2000 diagnosis" VALUE 0xa080b9b8 _REC_VAL_20_u1 254. _CNV_A_R_LINEAR_____0_CM 1. 255. DISPLAY_IDENTIFIER C_ABC_MAX_BN_POW_VB FORMAT "%3.0" /end CHARACTERISTIC
/begin CHARACTERISTIC c_abc_max_bn_pow_gen "Maximum value of the anti - bounce counter BN2000 diagnosis" VALUE 0xa080b9b7 _REC_VAL_20_u1 254. _CNV_A_R_LINEAR_____0_CM 1. 255. DISPLAY_IDENTIFIER C_ABC_MAX_BN_POW_GEN FORMAT "%3.0" /end CHARACTERISTIC
/begin CHARACTERISTIC c_abc_max_bn_msw "Maximum value of the anti - bounce counter BN2000 diagnosis" VALUE 0xa080b9b5 _REC_VAL_20_u1 254. _CNV_A_R_LINEAR_____0_CM 1. 255. DISPLAY_IDENTIFIER C_ABC_MAX_BN_MSW FORMAT "%3.0" /end CHARACTERISTIC
/begin CHARACTERISTIC c_abc_max_bn_tq_dcc "Maximum value of the anti - bounce counter BN2000 diagnosis" VALUE 0xa080b9be _REC_VAL_20_u1 254. _CNV_A_R_LINEAR_____0_CM 1. 255. DISPLAY_IDENTIFIER C_ABC_MAX_BN_TQ_DCC FORMAT "%3.0" /end CHARACTERISTIC
/begin CHARACTERISTIC c_abc_max_bn_ang_pste "Maximum value of the anti - bounce counter BN2000 diagnosis" VALUE 0xa080b9a5 _REC_VAL_20_u1 254. _CNV_A_R_LINEAR_____0_CM 1. 255. DISPLAY_IDENTIFIER C_ABC_MAX_BN_ANG_PSTE FORMAT "%3.0" /end CHARACTERISTIC
/begin CHARACTERISTIC c_ctr_diag_tcc_can_max_ars "Maximum number of wrong ATCC_CAN count events before error detection of BN2000 message" VALUE 0xa080bb52 _REC_VAL_20_u1 255. _CNV_A_R_LINEAR_____0_CM 0. 255. DISPLAY_IDENTIFIER C_CTR_DIAG_TCC_CAN_MAX_ARS FORMAT "%3.0" /end CHARACTERISTIC
/begin CHARACTERISTIC c_ctr_diag_tcc_can_max_tq_tcs "Maximum number of wrong ATCC_CAN count events before error detection of BN2000 message" VALUE 0xa080bb5f _REC_VAL_20_u1 255. _CNV_A_R_LINEAR_____0_CM 0. 255. DISPLAY_IDENTIFIER C_CTR_DIAG_TCC_CAN_MAX_TQ_TCS FORMAT "%3.0" /end CHARACTERISTIC
/begin CHARACTERISTIC c_ctr_diag_tcc_can_max_tq_etcu "Maximum number of wrong ATCC_CAN count events before error detection of BN2000 message" VALUE 0xa080bb5c _REC_VAL_20_u1 255. _CNV_A_R_LINEAR_____0_CM 0. 255. DISPLAY_IDENTIFIER C_CTR_DIAG_TCC_CAN_MAX_TQ_ETCU FORMAT "%3.0" /end CHARACTERISTIC
/begin CHARACTERISTIC c_ctr_diag_tcc_can_max_etcu_3 "Maximum number of wrong ATCC_CAN count events before error detection of BN2000 message" VALUE 0xa080bb54 _REC_VAL_20_u1 255. _CNV_A_R_LINEAR_____0_CM 0. 255. DISPLAY_IDENTIFIER C_CTR_DIAG_TCC_CAN_MAX_ETCU_3 FORMAT "%3.0" /end CHARACTERISTIC
/begin CHARACTERISTIC c_ctr_diag_tcc_can_max_tq_amt "Maximum number of wrong ATCC_CAN count events before error detection of BN2000 message" VALUE 0xa080bb5a _REC_VAL_20_u1 255. _CNV_A_R_LINEAR_____0_CM 0. 255. DISPLAY_IDENTIFIER C_CTR_DIAG_TCC_CAN_MAX_TQ_AMT FORMAT "%3.0" /end CHARACTERISTIC
/begin CHARACTERISTIC c_ctr_diag_tcc_can_max_veh_mod "Maximum number of wrong ATCC_CAN count events before error detection of BN2000 message" VALUE 0xa080bb60 _REC_VAL_20_u1 255. _CNV_A_R_LINEAR_____0_CM 0. 255. DISPLAY_IDENTIFIER C_CTR_DIAG_TCC_CAN_MAX_VEH_MOD FORMAT "%3.0" /end CHARACTERISTIC
/begin CHARACTERISTIC c_ctr_diag_tcc_can_max_icl "Maximum number of wrong ATCC_CAN count events before error detection of BN2000 message" VALUE 0xa080bb55 _REC_VAL_20_u1 255. _CNV_A_R_LINEAR_____0_CM 0. 255. DISPLAY_IDENTIFIER C_CTR_DIAG_TCC_CAN_MAX_ICL FORMAT "%3.0" /end CHARACTERISTIC
/begin CHARACTERISTIC c_ctr_diag_tcc_can_max_msw "Maximum number of wrong ATCC_CAN count events before error detection of BN2000 message" VALUE 0xa080bb57 _REC_VAL_20_u1 255. _CNV_A_R_LINEAR_____0_CM 0. 255. DISPLAY_IDENTIFIER C_CTR_DIAG_TCC_CAN_MAX_MSW FORMAT "%3.0" /end CHARACTERISTIC
/begin CHARACTERISTIC c_ctr_diag_tcc_can_max_tq_dcc "Maximum number of wrong ATCC_CAN count events before error detection of BN2000 message" VALUE 0xa080bb5b _REC_VAL_20_u1 255. _CNV_A_R_LINEAR_____0_CM 0. 255. DISPLAY_IDENTIFIER C_CTR_DIAG_TCC_CAN_MAX_TQ_DCC FORMAT "%3.0" /end CHARACTERISTIC
/begin CHARACTERISTIC c_ctr_diag_cks_max_tq_tcs "Maximum number of wrong checksum calculation events before error detection of BN2000 message" VALUE 0xa080bb50 _REC_VAL_20_u1 255. _CNV_A_R_LINEAR_____0_CM 0. 255. DISPLAY_IDENTIFIER C_CTR_DIAG_CKS_MAX_TQ_TCS FORMAT "%3.0" /end CHARACTERISTIC
/begin CHARACTERISTIC c_ctr_diag_cks_max_tq_etcu "Maximum number of wrong checksum calculation events before error detection of BN2000 message" VALUE 0xa080bb4d _REC_VAL_20_u1 255. _CNV_A_R_LINEAR_____0_CM 0. 255. DISPLAY_IDENTIFIER C_CTR_DIAG_CKS_MAX_TQ_ETCU FORMAT "%3.0" /end CHARACTERISTIC
/begin CHARACTERISTIC c_ctr_diag_cks_max_etcu_3 "Maximum number of wrong checksum calculation events before error detection of BN2000 message" VALUE 0xa080bb46 _REC_VAL_20_u1 255. _CNV_A_R_LINEAR_____0_CM 0. 255. DISPLAY_IDENTIFIER C_CTR_DIAG_CKS_MAX_ETCU_3 FORMAT "%3.0" /end CHARACTERISTIC
/begin CHARACTERISTIC c_ctr_diag_cks_max_tq_amt "Maximum number of wrong checksum calculation events before error detection of BN2000 message" VALUE 0xa080bb4b _REC_VAL_20_u1 255. _CNV_A_R_LINEAR_____0_CM 0. 255. DISPLAY_IDENTIFIER C_CTR_DIAG_CKS_MAX_TQ_AMT FORMAT "%3.0" /end CHARACTERISTIC
/begin CHARACTERISTIC c_ctr_diag_cks_max_veh_mod "Maximum number of wrong checksum calculation events before error detection of BN2000 message" VALUE 0xa080bb51 _REC_VAL_20_u1 255. _CNV_A_R_LINEAR_____0_CM 0. 255. DISPLAY_IDENTIFIER C_CTR_DIAG_CKS_MAX_VEH_MOD FORMAT "%3.0" /end CHARACTERISTIC
/begin CHARACTERISTIC c_ctr_diag_cks_max_msw "Maximum number of wrong checksum calculation events before error detection of BN2000 message" VALUE 0xa080bb48 _REC_VAL_20_u1 255. _CNV_A_R_LINEAR_____0_CM 0. 255. DISPLAY_IDENTIFIER C_CTR_DIAG_CKS_MAX_MSW FORMAT "%3.0" /end CHARACTERISTIC
/begin CHARACTERISTIC c_ctr_diag_cks_max_tq_dcc "Maximum number of wrong checksum calculation events before error detection of BN2000 message" VALUE 0xa080bb4c _REC_VAL_20_u1 255. _CNV_A_R_LINEAR_____0_CM 0. 255. DISPLAY_IDENTIFIER C_CTR_DIAG_CKS_MAX_TQ_DCC FORMAT "%3.0" /end CHARACTERISTIC
/begin CHARACTERISTIC c_ctr_diag_tout_max_ars "Maximum number of missing message events before error detection of BN2000 message" VALUE 0xa080bb63 _REC_VAL_20_u1 255. _CNV_A_R_LINEAR_____0_CM 0. 255. DISPLAY_IDENTIFIER C_CTR_DIAG_TOUT_MAX_ARS FORMAT "%3.0" /end CHARACTERISTIC
/begin CHARACTERISTIC c_ctr_diag_tout_max_tq_tcs "Maximum number of missing message events before error detection of BN2000 message" VALUE 0xa080bb7f _REC_VAL_20_u1 255. _CNV_A_R_LINEAR_____0_CM 0. 255. DISPLAY_IDENTIFIER C_CTR_DIAG_TOUT_MAX_TQ_TCS FORMAT "%3.0" /end CHARACTERISTIC
/begin CHARACTERISTIC c_ctr_diag_tout_max_vs_tcs "Maximum number of missing message events before error detection of BN2000 message" VALUE 0xa080bb82 _REC_VAL_20_u1 255. _CNV_A_R_LINEAR_____0_CM 0. 255. DISPLAY_IDENTIFIER C_CTR_DIAG_TOUT_MAX_VS_TCS FORMAT "%3.0" /end CHARACTERISTIC
/begin CHARACTERISTIC c_ctr_diag_tout_max_tcs "Maximum number of missing message events before error detection of BN2000 message" VALUE 0xa080bb79 _REC_VAL_20_u1 255. _CNV_A_R_LINEAR_____0_CM 0. 255. DISPLAY_IDENTIFIER C_CTR_DIAG_TOUT_MAX_TCS FORMAT "%3.0" /end CHARACTERISTIC
/begin CHARACTERISTIC c_ctr_diag_tout_max_tq_etcu "Maximum number of missing message events before error detection of BN2000 message" VALUE 0xa080bb7c _REC_VAL_20_u1 255. _CNV_A_R_LINEAR_____0_CM 0. 255. DISPLAY_IDENTIFIER C_CTR_DIAG_TOUT_MAX_TQ_ETCU FORMAT "%3.0" /end CHARACTERISTIC
/begin CHARACTERISTIC c_ctr_diag_tout_max_tq_dcc "Maximum number of missing message events before error detection of BN2000 message" VALUE 0xa080bb7b _REC_VAL_20_u1 255. _CNV_A_R_LINEAR_____0_CM 0. 255. DISPLAY_IDENTIFIER C_CTR_DIAG_TOUT_MAX_TQ_DCC FORMAT "%3.0" /end CHARACTERISTIC
/begin CHARACTERISTIC c_ctr_diag_tout_max_tq_amt "Maximum number of missing message events before error detection of BN2000 message" VALUE 0xa080bb7a _REC_VAL_20_u1 255. _CNV_A_R_LINEAR_____0_CM 0. 255. DISPLAY_IDENTIFIER C_CTR_DIAG_TOUT_MAX_TQ_AMT FORMAT "%3.0" /end CHARACTERISTIC
/begin CHARACTERISTIC c_ctr_diag_tout_max_acc "Maximum number of missing message events before error detection of BN2000 message" VALUE 0xa080bb61 _REC_VAL_20_u1 255. _CNV_A_R_LINEAR_____0_CM 0. 255. DISPLAY_IDENTIFIER C_CTR_DIAG_TOUT_MAX_ACC FORMAT "%3.0" /end CHARACTERISTIC
/begin CHARACTERISTIC c_ctr_diag_tout_max_t_icl "Maximum number of missing message events before error detection of BN2000 message" VALUE 0xa080bb78 _REC_VAL_20_u1 255. _CNV_A_R_LINEAR_____0_CM 0. 255. DISPLAY_IDENTIFIER C_CTR_DIAG_TOUT_MAX_T_ICL FORMAT "%3.0" /end CHARACTERISTIC
/begin CHARACTERISTIC c_ctr_diag_tout_max_cdn_door "Maximum number of missing message events before error detection of BN2000 message" VALUE 0xa080bb65 _REC_VAL_20_u1 255. _CNV_A_R_LINEAR_____0_CM 0. 255. DISPLAY_IDENTIFIER C_CTR_DIAG_TOUT_MAX_CDN_DOOR FORMAT "%3.0" /end CHARACTERISTIC
/begin CHARACTERISTIC c_ctr_diag_tout_max_veh_mod "Maximum number of missing message events before error detection of BN2000 message" VALUE 0xa080bb81 _REC_VAL_20_u1 255. _CNV_A_R_LINEAR_____0_CM 0. 255. DISPLAY_IDENTIFIER C_CTR_DIAG_TOUT_MAX_VEH_MOD FORMAT "%3.0" /end CHARACTERISTIC
/begin CHARACTERISTIC c_ctr_diag_tout_max_km_icl "Maximum number of missing message events before error detection of BN2000 message" VALUE 0xa080bb6f _REC_VAL_20_u1 255. _CNV_A_R_LINEAR_____0_CM 0. 255. DISPLAY_IDENTIFIER C_CTR_DIAG_TOUT_MAX_KM_ICL FORMAT "%3.0" /end CHARACTERISTIC
/begin CHARACTERISTIC c_ctr_diag_tout_max_icl "Maximum number of missing message events before error detection of BN2000 message" VALUE 0xa080bb6e _REC_VAL_20_u1 255. _CNV_A_R_LINEAR_____0_CM 0. 255. DISPLAY_IDENTIFIER C_CTR_DIAG_TOUT_MAX_ICL FORMAT "%3.0" /end CHARACTERISTIC
/begin CHARACTERISTIC c_ctr_diag_tout_max_pow_vb "Maximum number of missing message events before error detection of BN2000 message" VALUE 0xa080bb75 _REC_VAL_20_u1 255. _CNV_A_R_LINEAR_____0_CM 0. 255. DISPLAY_IDENTIFIER C_CTR_DIAG_TOUT_MAX_POW_VB FORMAT "%3.0" /end CHARACTERISTIC
/begin CHARACTERISTIC c_ctr_diag_tout_max_pow_gen "Maximum number of missing message events before error detection of BN2000 message" VALUE 0xa080bb74 _REC_VAL_20_u1 255. _CNV_A_R_LINEAR_____0_CM 0. 255. DISPLAY_IDENTIFIER C_CTR_DIAG_TOUT_MAX_POW_GEN FORMAT "%3.0" /end CHARACTERISTIC
/begin CHARACTERISTIC c_ctr_diag_tout_max_msw "Maximum number of missing message events before error detection of BN2000 message" VALUE 0xa080bb72 _REC_VAL_20_u1 255. _CNV_A_R_LINEAR_____0_CM 0. 255. DISPLAY_IDENTIFIER C_CTR_DIAG_TOUT_MAX_MSW FORMAT "%3.0" /end CHARACTERISTIC
/begin CHARACTERISTIC c_ctr_diag_tout_max_etcu "Maximum number of missing message events before error detection of BN2000 message" VALUE 0xa080bb68 _REC_VAL_20_u1 255. _CNV_A_R_LINEAR_____0_CM 0. 255. DISPLAY_IDENTIFIER C_CTR_DIAG_TOUT_MAX_ETCU FORMAT "%3.0" /end CHARACTERISTIC
/begin CHARACTERISTIC c_ctr_diag_tout_max_etcu_2 "Maximum number of missing message events before error detection of BN2000 message" VALUE 0xa080bb69 _REC_VAL_20_u1 255. _CNV_A_R_LINEAR_____0_CM 0. 255. DISPLAY_IDENTIFIER C_CTR_DIAG_TOUT_MAX_ETCU_2 FORMAT "%3.0" /end CHARACTERISTIC
/begin CHARACTERISTIC c_ctr_diag_tout_max_etcu_3 "Maximum number of missing message events before error detection of BN2000 message" VALUE 0xa080bb6a _REC_VAL_20_u1 255. _CNV_A_R_LINEAR_____0_CM 0. 255. DISPLAY_IDENTIFIER C_CTR_DIAG_TOUT_MAX_ETCU_3 FORMAT "%3.0" /end CHARACTERISTIC
/begin CHARACTERISTIC c_ctr_diag_tout_max_etcu_disp "Maximum number of missing message events before error detection of BN2000 message" VALUE 0xa080bb6b _REC_VAL_20_u1 255. _CNV_A_R_LINEAR_____0_CM 0. 255. DISPLAY_IDENTIFIER C_CTR_DIAG_TOUT_MAX_ETCU_DISP FORMAT "%3.0" /end CHARACTERISTIC
/begin CHARACTERISTIC c_ctr_diag_tout_max_ang_pste "Maximum number of missing message events before error detection of BN2000 message" VALUE 0xa080bb62 _REC_VAL_20_u1 255. _CNV_A_R_LINEAR_____0_CM 0. 255. DISPLAY_IDENTIFIER C_CTR_DIAG_TOUT_MAX_ANG_PSTE FORMAT "%3.0" /end CHARACTERISTIC
/begin CHARACTERISTIC c_abc_max_bn_ars "Maximum value of the anti - bounce counter BN2000 diagnosis" VALUE 0xa080b9a6 _REC_VAL_20_u1 254. _CNV_A_R_LINEAR_____0_CM 1. 255. DISPLAY_IDENTIFIER C_ABC_MAX_BN_ARS FORMAT "%3.0" /end CHARACTERISTIC
/begin CHARACTERISTIC c_abc_inc_bn_ars "Anti - bounce counter increment BN2000 Diagnosis" VALUE 0xa080b8de _REC_VAL_20_u1 255. _CNV_A_R_LINEAR_____0_CM 0. 255. DISPLAY_IDENTIFIER C_ABC_INC_BN_ARS FORMAT "%3.0" /end CHARACTERISTIC
/begin CHARACTERISTIC c_abc_dec_bn_tq_dcc "Anti - bounce counter increment BN2000 Diagnosis" VALUE 0xa080b89a _REC_VAL_20_u1 255. _CNV_A_R_LINEAR_____0_CM 0. 255. DISPLAY_IDENTIFIER C_ABC_DEC_BN_TQ_DCC FORMAT "%3.0" /end CHARACTERISTIC
/begin CHARACTERISTIC c_abc_dec_bn_ars "Anti - bounce counter increment BN2000 Diagnosis" VALUE 0xa080b882 _REC_VAL_20_u1 255. _CNV_A_R_LINEAR_____0_CM 0. 255. DISPLAY_IDENTIFIER C_ABC_DEC_BN_ARS FORMAT "%3.0" /end CHARACTERISTIC
/begin CHARACTERISTIC c_abc_dec_bn_tq_tcs "Anti - bounce counter increment BN2000 Diagnosis" VALUE 0xa080b89e _REC_VAL_20_u1 255. _CNV_A_R_LINEAR_____0_CM 0. 255. DISPLAY_IDENTIFIER C_ABC_DEC_BN_TQ_TCS FORMAT "%3.0" /end CHARACTERISTIC
/begin CHARACTERISTIC c_abc_dec_bn_vs_tcs "Anti - bounce counter increment BN2000 Diagnosis" VALUE 0xa080b8a1 _REC_VAL_20_u1 255. _CNV_A_R_LINEAR_____0_CM 0. 255. DISPLAY_IDENTIFIER C_ABC_DEC_BN_VS_TCS FORMAT "%3.0" /end CHARACTERISTIC
/begin CHARACTERISTIC c_abc_dec_bn_tcs "Anti - bounce counter increment BN2000 Diagnosis" VALUE 0xa080b898 _REC_VAL_20_u1 255. _CNV_A_R_LINEAR_____0_CM 0. 255. DISPLAY_IDENTIFIER C_ABC_DEC_BN_TCS FORMAT "%3.0" /end CHARACTERISTIC
/begin CHARACTERISTIC c_abc_dec_bn_tq_etcu "Anti - bounce counter increment BN2000 Diagnosis" VALUE 0xa080b89b _REC_VAL_20_u1 255. _CNV_A_R_LINEAR_____0_CM 0. 255. DISPLAY_IDENTIFIER C_ABC_DEC_BN_TQ_ETCU FORMAT "%3.0" /end CHARACTERISTIC
/begin CHARACTERISTIC c_abc_dec_bn_etcu "Anti - bounce counter increment BN2000 Diagnosis" VALUE 0xa080b887 _REC_VAL_20_u1 255. _CNV_A_R_LINEAR_____0_CM 0. 255. DISPLAY_IDENTIFIER C_ABC_DEC_BN_ETCU FORMAT "%3.0" /end CHARACTERISTIC
/begin CHARACTERISTIC c_abc_dec_bn_etcu_2 "Anti - bounce counter increment BN2000 Diagnosis" VALUE 0xa080b888 _REC_VAL_20_u1 255. _CNV_A_R_LINEAR_____0_CM 0. 255. DISPLAY_IDENTIFIER C_ABC_DEC_BN_ETCU_2 FORMAT "%3.0" /end CHARACTERISTIC
/begin CHARACTERISTIC c_abc_dec_bn_etcu_3 "Anti - bounce counter increment BN2000 Diagnosis" VALUE 0xa080b889 _REC_VAL_20_u1 255. _CNV_A_R_LINEAR_____0_CM 0. 255. DISPLAY_IDENTIFIER C_ABC_DEC_BN_ETCU_3 FORMAT "%3.0" /end CHARACTERISTIC
/begin CHARACTERISTIC c_abc_dec_bn_etcu_disp "Anti - bounce counter increment BN2000 Diagnosis" VALUE 0xa080b88a _REC_VAL_20_u1 255. _CNV_A_R_LINEAR_____0_CM 0. 255. DISPLAY_IDENTIFIER C_ABC_DEC_BN_ETCU_DISP FORMAT "%3.0" /end CHARACTERISTIC
/begin CHARACTERISTIC c_abc_dec_bn_tq_amt "Anti - bounce counter increment BN2000 Diagnosis" VALUE 0xa080b899 _REC_VAL_20_u1 255. _CNV_A_R_LINEAR_____0_CM 0. 255. DISPLAY_IDENTIFIER C_ABC_DEC_BN_TQ_AMT FORMAT "%3.0" /end CHARACTERISTIC
/begin CHARACTERISTIC c_abc_dec_bn_acc "Anti - bounce counter increment BN2000 Diagnosis" VALUE 0xa080b880 _REC_VAL_20_u1 255. _CNV_A_R_LINEAR_____0_CM 0. 255. DISPLAY_IDENTIFIER C_ABC_DEC_BN_ACC FORMAT "%3.0" /end CHARACTERISTIC
/begin CHARACTERISTIC c_abc_dec_bn_icl "Anti - bounce counter increment BN2000 Diagnosis" VALUE 0xa080b88d _REC_VAL_20_u1 255. _CNV_A_R_LINEAR_____0_CM 0. 255. DISPLAY_IDENTIFIER C_ABC_DEC_BN_ICL FORMAT "%3.0" /end CHARACTERISTIC
/begin CHARACTERISTIC c_abc_dec_bn_km_icl "Anti - bounce counter increment BN2000 Diagnosis" VALUE 0xa080b88e _REC_VAL_20_u1 255. _CNV_A_R_LINEAR_____0_CM 0. 255. DISPLAY_IDENTIFIER C_ABC_DEC_BN_KM_ICL FORMAT "%3.0" /end CHARACTERISTIC
/begin CHARACTERISTIC c_abc_dec_bn_t_icl "Anti - bounce counter increment BN2000 Diagnosis" VALUE 0xa080b897 _REC_VAL_20_u1 255. _CNV_A_R_LINEAR_____0_CM 0. 255. DISPLAY_IDENTIFIER C_ABC_DEC_BN_T_ICL FORMAT "%3.0" /end CHARACTERISTIC
/begin CHARACTERISTIC c_abc_dec_bn_pow_vb "Anti - bounce counter increment BN2000 Diagnosis" VALUE 0xa080b894 _REC_VAL_20_u1 255. _CNV_A_R_LINEAR_____0_CM 0. 255. DISPLAY_IDENTIFIER C_ABC_DEC_BN_POW_VB FORMAT "%3.0" /end CHARACTERISTIC
/begin CHARACTERISTIC c_abc_dec_bn_pow_gen "Anti - bounce counter increment BN2000 Diagnosis" VALUE 0xa080b893 _REC_VAL_20_u1 255. _CNV_A_R_LINEAR_____0_CM 0. 255. DISPLAY_IDENTIFIER C_ABC_DEC_BN_POW_GEN FORMAT "%3.0" /end CHARACTERISTIC
/begin CHARACTERISTIC c_abc_dec_bn_msw "Anti - bounce counter increment BN2000 Diagnosis" VALUE 0xa080b891 _REC_VAL_20_u1 255. _CNV_A_R_LINEAR_____0_CM 0. 255. DISPLAY_IDENTIFIER C_ABC_DEC_BN_MSW FORMAT "%3.0" /end CHARACTERISTIC
/begin CHARACTERISTIC c_abc_dec_bn_ang_pste "Anti - bounce counter increment BN2000 Diagnosis" VALUE 0xa080b881 _REC_VAL_20_u1 255. _CNV_A_R_LINEAR_____0_CM 0. 255. DISPLAY_IDENTIFIER C_ABC_DEC_BN_ANG_PSTE FORMAT "%3.0" /end CHARACTERISTIC
/begin CHARACTERISTIC c_abc_dec_bn_veh_mod "Anti - bounce counter increment BN2000 Diagnosis" VALUE 0xa080b8a0 _REC_VAL_20_u1 255. _CNV_A_R_LINEAR_____0_CM 0. 255. DISPLAY_IDENTIFIER C_ABC_DEC_BN_VEH_MOD FORMAT "%3.0" /end CHARACTERISTIC
/begin CHARACTERISTIC c_abc_inc_bn_cdn_door "Anti - bounce counter increment BN2000 Diagnosis" VALUE 0xa080b8e0 _REC_VAL_20_u1 255. _CNV_A_R_LINEAR_____0_CM 0. 255. DISPLAY_IDENTIFIER C_ABC_INC_BN_CDN_DOOR FORMAT "%3.0" /end CHARACTERISTIC
/begin CHARACTERISTIC c_abc_inc_bn_tq_pste_2 "Anti - bounce counter increment BN2000 Diagnosis" VALUE 0xa080b8f8 _REC_VAL_20_u1 255. _CNV_A_R_LINEAR_____0_CM 0. 255. DISPLAY_IDENTIFIER C_ABC_INC_BN_TQ_PSTE_2 FORMAT "%3.0" /end CHARACTERISTIC
/begin CHARACTERISTIC c_abc_max_bn_tq_pste_2 "Maximum value of the anti - bounce counter BN2000 diagnosis" VALUE 0xa080b9c0 _REC_VAL_20_u1 254. _CNV_A_R_LINEAR_____0_CM 1. 255. DISPLAY_IDENTIFIER C_ABC_MAX_BN_TQ_PSTE_2 FORMAT "%3.0" /end CHARACTERISTIC
/begin CHARACTERISTIC c_abc_max_bn_cdn_door "Maximum value of the anti - bounce counter BN2000 diagnosis" VALUE 0xa080b9a8 _REC_VAL_20_u1 254. _CNV_A_R_LINEAR_____0_CM 1. 255. DISPLAY_IDENTIFIER C_ABC_MAX_BN_CDN_DOOR FORMAT "%3.0" /end CHARACTERISTIC
/begin CHARACTERISTIC c_abc_dec_bn_tq_pste_2 "Anti - bounce counter increment BN2000 Diagnosis" VALUE 0xa080b89c _REC_VAL_20_u1 255. _CNV_A_R_LINEAR_____0_CM 0. 255. DISPLAY_IDENTIFIER C_ABC_DEC_BN_TQ_PSTE_2 FORMAT "%3.0" /end CHARACTERISTIC
/begin CHARACTERISTIC c_abc_dec_bn_cdn_door "Anti - bounce counter increment BN2000 Diagnosis" VALUE 0xa080b884 _REC_VAL_20_u1 255. _CNV_A_R_LINEAR_____0_CM 0. 255. DISPLAY_IDENTIFIER C_ABC_DEC_BN_CDN_DOOR FORMAT "%3.0" /end CHARACTERISTIC
/begin CHARACTERISTIC c_abc_inc_bn_tq_pste_3 "Anti - bounce counter increment BN2000 Diagnosis" VALUE 0xa080b8f9 _REC_VAL_20_u1 255. _CNV_A_R_LINEAR_____0_CM 0. 255. DISPLAY_IDENTIFIER C_ABC_INC_BN_TQ_PSTE_3 FORMAT "%3.0" /end CHARACTERISTIC
/begin CHARACTERISTIC c_abc_max_bn_tq_pste_3 "Maximum value of the anti - bounce counter BN2000 diagnosis" VALUE 0xa080b9c1 _REC_VAL_20_u1 254. _CNV_A_R_LINEAR_____0_CM 1. 255. DISPLAY_IDENTIFIER C_ABC_MAX_BN_TQ_PSTE_3 FORMAT "%3.0" /end CHARACTERISTIC
/begin CHARACTERISTIC c_abc_dec_bn_tq_pste_3 "Anti - bounce counter increment BN2000 Diagnosis" VALUE 0xa080b89d _REC_VAL_20_u1 255. _CNV_A_R_LINEAR_____0_CM 0. 255. DISPLAY_IDENTIFIER C_ABC_DEC_BN_TQ_PSTE_3 FORMAT "%3.0" /end CHARACTERISTIC
/begin CHARACTERISTIC c_ctr_diag_tcc_can_max_tq_pste_2 "Maximum number of wrong ATCC_CAN count events before error detection of BN2000 message" VALUE 0xa080bb5d _REC_VAL_20_u1 255. _CNV_A_R_LINEAR_____0_CM 0. 255. DISPLAY_IDENTIFIER C_CTR_DIAG_TCC_CAN_MAX_TQ_PSTE_2 FORMAT "%3.0" /end CHARACTERISTIC
/begin CHARACTERISTIC c_ctr_diag_tcc_can_max_tq_pste_3 "Maximum number of wrong ATCC_CAN count events before error detection of BN2000 message" VALUE 0xa080bb5e _REC_VAL_20_u1 255. _CNV_A_R_LINEAR_____0_CM 0. 255. DISPLAY_IDENTIFIER C_CTR_DIAG_TCC_CAN_MAX_TQ_PSTE_3 FORMAT "%3.0" /end CHARACTERISTIC
/begin CHARACTERISTIC c_ctr_diag_cks_max_tq_pste_2 "Maximum number of wrong checksum calculation events before error detection of BN2000 message" VALUE 0xa080bb4e _REC_VAL_20_u1 255. _CNV_A_R_LINEAR_____0_CM 0. 255. DISPLAY_IDENTIFIER C_CTR_DIAG_CKS_MAX_TQ_PSTE_2 FORMAT "%3.0" /end CHARACTERISTIC
/begin CHARACTERISTIC c_ctr_diag_cks_max_tq_pste_3 "Maximum number of wrong checksum calculation events before error detection of BN2000 message" VALUE 0xa080bb4f _REC_VAL_20_u1 255. _CNV_A_R_LINEAR_____0_CM 0. 255. DISPLAY_IDENTIFIER C_CTR_DIAG_CKS_MAX_TQ_PSTE_3 FORMAT "%3.0" /end CHARACTERISTIC
/begin CHARACTERISTIC c_ctr_diag_tout_max_tq_pste_2 "Maximum number of missing message events before error detection of BN2000 message" VALUE 0xa080bb7d _REC_VAL_20_u1 255. _CNV_A_R_LINEAR_____0_CM 0. 255. DISPLAY_IDENTIFIER C_CTR_DIAG_TOUT_MAX_TQ_PSTE_2 FORMAT "%3.0" /end CHARACTERISTIC
/begin CHARACTERISTIC c_ctr_diag_tout_max_tq_pste_3 "Maximum number of missing message events before error detection of BN2000 message" VALUE 0xa080bb7e _REC_VAL_20_u1 255. _CNV_A_R_LINEAR_____0_CM 0. 255. DISPLAY_IDENTIFIER C_CTR_DIAG_TOUT_MAX_TQ_PSTE_3 FORMAT "%3.0" /end CHARACTERISTIC
/begin CHARACTERISTIC c_abc_inc_bn_efp "Anti - bounce counter increment BN2000 Diagnosis" VALUE 0xa080b8e1 _REC_VAL_20_u1 255. _CNV_A_R_LINEAR_____0_CM 0. 255. DISPLAY_IDENTIFIER C_ABC_INC_BN_EFP FORMAT "%3.0" /end CHARACTERISTIC
/begin CHARACTERISTIC c_abc_inc_bn_efp_crash "Anti - bounce counter increment BN2000 Diagnosis" VALUE 0xa080b8e2 _REC_VAL_20_u1 255. _CNV_A_R_LINEAR_____0_CM 0. 255. DISPLAY_IDENTIFIER C_ABC_INC_BN_EFP_CRASH FORMAT "%3.0" /end CHARACTERISTIC
/begin CHARACTERISTIC c_abc_max_bn_efp "Maximum value of the anti - bounce counter BN2000 diagnosis" VALUE 0xa080b9a9 _REC_VAL_20_u1 254. _CNV_A_R_LINEAR_____0_CM 1. 255. DISPLAY_IDENTIFIER C_ABC_MAX_BN_EFP FORMAT "%3.0" /end CHARACTERISTIC
/begin CHARACTERISTIC c_abc_max_bn_efp_crash "Maximum value of the anti - bounce counter BN2000 diagnosis" VALUE 0xa080b9aa _REC_VAL_20_u1 254. _CNV_A_R_LINEAR_____0_CM 1. 255. DISPLAY_IDENTIFIER C_ABC_MAX_BN_EFP_CRASH FORMAT "%3.0" /end CHARACTERISTIC
/begin CHARACTERISTIC c_abc_dec_bn_efp "Anti - bounce counter increment BN2000 Diagnosis" VALUE 0xa080b885 _REC_VAL_20_u1 255. _CNV_A_R_LINEAR_____0_CM 0. 255. DISPLAY_IDENTIFIER C_ABC_DEC_BN_EFP FORMAT "%3.0" /end CHARACTERISTIC
/begin CHARACTERISTIC c_abc_dec_bn_efp_crash "Anti - bounce counter increment BN2000 Diagnosis" VALUE 0xa080b886 _REC_VAL_20_u1 255. _CNV_A_R_LINEAR_____0_CM 0. 255. DISPLAY_IDENTIFIER C_ABC_DEC_BN_EFP_CRASH FORMAT "%3.0" /end CHARACTERISTIC
/begin CHARACTERISTIC c_ctr_diag_tout_max_efp "Maximum number of missing message events before error detection of BN2000 message" VALUE 0xa080bb66 _REC_VAL_20_u1 255. _CNV_A_R_LINEAR_____0_CM 0. 255. DISPLAY_IDENTIFIER C_CTR_DIAG_TOUT_MAX_EFP FORMAT "%3.0" /end CHARACTERISTIC
/begin CHARACTERISTIC c_ctr_diag_tout_max_efp_crash "Maximum number of missing message events before error detection of BN2000 message" VALUE 0xa080bb67 _REC_VAL_20_u1 255. _CNV_A_R_LINEAR_____0_CM 0. 255. DISPLAY_IDENTIFIER C_CTR_DIAG_TOUT_MAX_EFP_CRASH FORMAT "%3.0" /end CHARACTERISTIC
/begin CHARACTERISTIC c_abc_inc_bn_gear_rev "Anti - bounce counter increment BN2000 Diagnosis" VALUE 0xa080b8e7 _REC_VAL_20_u1 255. _CNV_A_R_LINEAR_____0_CM 0. 255. DISPLAY_IDENTIFIER C_ABC_INC_BN_GEAR_REV FORMAT "%3.0" /end CHARACTERISTIC
/begin CHARACTERISTIC c_abc_max_bn_gear_rev "Maximum value of the anti - bounce counter BN2000 diagnosis" VALUE 0xa080b9af _REC_VAL_20_u1 254. _CNV_A_R_LINEAR_____0_CM 1. 255. DISPLAY_IDENTIFIER C_ABC_MAX_BN_GEAR_REV FORMAT "%3.0" /end CHARACTERISTIC
/begin CHARACTERISTIC c_abc_dec_bn_gear_rev "Anti - bounce counter increment BN2000 Diagnosis" VALUE 0xa080b88b _REC_VAL_20_u1 255. _CNV_A_R_LINEAR_____0_CM 0. 255. DISPLAY_IDENTIFIER C_ABC_DEC_BN_GEAR_REV FORMAT "%3.0" /end CHARACTERISTIC
/begin CHARACTERISTIC c_ctr_diag_tout_max_gear_rev "Maximum number of missing message events before error detection of BN2000 message" VALUE 0xa080bb6c _REC_VAL_20_u1 255. _CNV_A_R_LINEAR_____0_CM 0. 255. DISPLAY_IDENTIFIER C_CTR_DIAG_TOUT_MAX_GEAR_REV FORMAT "%3.0" /end CHARACTERISTIC
/begin CHARACTERISTIC c_abc_inc_bn_ltg_hdlp_l "Anti - bounce counter increment BN2000 Diagnosis" VALUE 0xa080b8ec _REC_VAL_20_u1 255. _CNV_A_R_LINEAR_____0_CM 0. 255. DISPLAY_IDENTIFIER C_ABC_INC_BN_LTG_HDLP_L FORMAT "%3.0" /end CHARACTERISTIC
/begin CHARACTERISTIC c_abc_max_bn_ltg_hdlp_l "Maximum value of the anti - bounce counter BN2000 diagnosis" VALUE 0xa080b9b4 _REC_VAL_20_u1 254. _CNV_A_R_LINEAR_____0_CM 1. 255. DISPLAY_IDENTIFIER C_ABC_MAX_BN_LTG_HDLP_L FORMAT "%3.0" /end CHARACTERISTIC
/begin CHARACTERISTIC c_abc_dec_bn_ltg_hdlp_l "Anti - bounce counter increment BN2000 Diagnosis" VALUE 0xa080b890 _REC_VAL_20_u1 255. _CNV_A_R_LINEAR_____0_CM 0. 255. DISPLAY_IDENTIFIER C_ABC_DEC_BN_LTG_HDLP_L FORMAT "%3.0" /end CHARACTERISTIC
/begin CHARACTERISTIC c_ctr_diag_tout_max_ltg_hdlp_l "Maximum number of missing message events before error detection of BN2000 message" VALUE 0xa080bb71 _REC_VAL_20_u1 255. _CNV_A_R_LINEAR_____0_CM 0. 255. DISPLAY_IDENTIFIER C_CTR_DIAG_TOUT_MAX_LTG_HDLP_L FORMAT "%3.0" /end CHARACTERISTIC
/begin CHARACTERISTIC c_abc_inc_bn_ldm "Anti - bounce counter increment BN2000 Diagnosis" VALUE 0xa080b8eb _REC_VAL_20_u1 255. _CNV_A_R_LINEAR_____0_CM 0. 255. DISPLAY_IDENTIFIER C_ABC_INC_BN_LDM FORMAT "%3.0" /end CHARACTERISTIC
/begin CHARACTERISTIC c_abc_max_bn_ldm "Maximum value of the anti - bounce counter BN2000 diagnosis" VALUE 0xa080b9b3 _REC_VAL_20_u1 254. _CNV_A_R_LINEAR_____0_CM 1. 255. DISPLAY_IDENTIFIER C_ABC_MAX_BN_LDM FORMAT "%3.0" /end CHARACTERISTIC
/begin CHARACTERISTIC c_ctr_diag_tcc_can_max_ldm "Maximum number of wrong ATCC_CAN count events before error detection of BN2000 message" VALUE 0xa080bb56 _REC_VAL_20_u1 255. _CNV_A_R_LINEAR_____0_CM 0. 255. DISPLAY_IDENTIFIER C_CTR_DIAG_TCC_CAN_MAX_LDM FORMAT "%3.0" /end CHARACTERISTIC
/begin CHARACTERISTIC c_ctr_diag_cks_max_ldm "Maximum number of wrong checksum calculation events before error detection of BN2000 message" VALUE 0xa080bb47 _REC_VAL_20_u1 255. _CNV_A_R_LINEAR_____0_CM 0. 255. DISPLAY_IDENTIFIER C_CTR_DIAG_CKS_MAX_LDM FORMAT "%3.0" /end CHARACTERISTIC
/begin CHARACTERISTIC c_ctr_diag_tout_max_ldm "Maximum number of missing message events before error detection of BN2000 message" VALUE 0xa080bb70 _REC_VAL_20_u1 255. _CNV_A_R_LINEAR_____0_CM 0. 255. DISPLAY_IDENTIFIER C_CTR_DIAG_TOUT_MAX_LDM FORMAT "%3.0" /end CHARACTERISTIC
/begin CHARACTERISTIC c_abc_dec_bn_ldm "Anti - bounce counter increment BN2000 Diagnosis" VALUE 0xa080b88f _REC_VAL_20_u1 255. _CNV_A_R_LINEAR_____0_CM 0. 255. DISPLAY_IDENTIFIER C_ABC_DEC_BN_LDM FORMAT "%3.0" /end CHARACTERISTIC
/begin CHARACTERISTIC c_abc_inc_bn_hiv "Anti - bounce counter increment BN2000 Diagnosis" VALUE 0xa080b8e8 _REC_VAL_20_u1 255. _CNV_A_R_LINEAR_____0_CM 0. 255. DISPLAY_IDENTIFIER C_ABC_INC_BN_HIV FORMAT "%3.0" /end CHARACTERISTIC
/begin CHARACTERISTIC c_abc_max_bn_hiv "Maximum value of the anti - bounce counter BN2000 diagnosis" VALUE 0xa080b9b0 _REC_VAL_20_u1 254. _CNV_A_R_LINEAR_____0_CM 1. 255. DISPLAY_IDENTIFIER C_ABC_MAX_BN_HIV FORMAT "%3.0" /end CHARACTERISTIC
/begin CHARACTERISTIC c_ctr_diag_tout_max_hiv "Maximum number of missing message events before error detection of BN2000 message" VALUE 0xa080bb6d _REC_VAL_20_u1 255. _CNV_A_R_LINEAR_____0_CM 0. 255. DISPLAY_IDENTIFIER C_CTR_DIAG_TOUT_MAX_HIV FORMAT "%3.0" /end CHARACTERISTIC
/begin CHARACTERISTIC c_abc_dec_bn_hiv "Anti - bounce counter increment BN2000 Diagnosis" VALUE 0xa080b88c _REC_VAL_20_u1 255. _CNV_A_R_LINEAR_____0_CM 0. 255. DISPLAY_IDENTIFIER C_ABC_DEC_BN_HIV FORMAT "%3.0" /end CHARACTERISTIC
/begin CHARACTERISTIC c_abc_inc_bn_trl "Anti - bounce counter increment BN2000 Diagnosis" VALUE 0xa080b8fb _REC_VAL_20_u1 255. _CNV_A_R_LINEAR_____0_CM 0. 255. DISPLAY_IDENTIFIER C_ABC_INC_BN_TRL FORMAT "%3.0" /end CHARACTERISTIC
/begin CHARACTERISTIC c_abc_max_bn_trl "Maximum value of the anti - bounce counter BN2000 diagnosis" VALUE 0xa080b9c3 _REC_VAL_20_u1 254. _CNV_A_R_LINEAR_____0_CM 1. 255. DISPLAY_IDENTIFIER C_ABC_MAX_BN_TRL FORMAT "%3.0" /end CHARACTERISTIC
/begin CHARACTERISTIC c_ctr_diag_tout_max_trl "Maximum number of missing message events before error detection of BN2000 message" VALUE 0xa080bb80 _REC_VAL_20_u1 255. _CNV_A_R_LINEAR_____0_CM 0. 255. DISPLAY_IDENTIFIER C_CTR_DIAG_TOUT_MAX_TRL FORMAT "%3.0" /end CHARACTERISTIC
/begin CHARACTERISTIC c_abc_dec_bn_trl "Anti - bounce counter increment BN2000 Diagnosis" VALUE 0xa080b89f _REC_VAL_20_u1 255. _CNV_A_R_LINEAR_____0_CM 0. 255. DISPLAY_IDENTIFIER C_ABC_DEC_BN_TRL FORMAT "%3.0" /end CHARACTERISTIC
/begin CHARACTERISTIC c_abc_inc_bn_t_clk "Anti - bounce counter increment BN2000 Diagnosis" VALUE 0xa080b8f2 _REC_VAL_20_u1 255. _CNV_A_R_LINEAR_____0_CM 0. 255. DISPLAY_IDENTIFIER C_ABC_INC_BN_T_CLK FORMAT "%3.0" /end CHARACTERISTIC
/begin CHARACTERISTIC c_abc_max_bn_t_clk "Maximum value of the anti - bounce counter BN2000 diagnosis" VALUE 0xa080b9ba _REC_VAL_20_u1 254. _CNV_A_R_LINEAR_____0_CM 1. 255. DISPLAY_IDENTIFIER C_ABC_MAX_BN_T_CLK FORMAT "%3.0" /end CHARACTERISTIC
/begin CHARACTERISTIC c_ctr_diag_tout_max_t_clk "Maximum number of missing message events before error detection of BN2000 message" VALUE 0xa080bb77 _REC_VAL_20_u1 255. _CNV_A_R_LINEAR_____0_CM 0. 255. DISPLAY_IDENTIFIER C_CTR_DIAG_TOUT_MAX_T_CLK FORMAT "%3.0" /end CHARACTERISTIC
/begin CHARACTERISTIC c_abc_dec_bn_t_clk "Anti - bounce counter increment BN2000 Diagnosis" VALUE 0xa080b896 _REC_VAL_20_u1 255. _CNV_A_R_LINEAR_____0_CM 0. 255. DISPLAY_IDENTIFIER C_ABC_DEC_BN_T_CLK FORMAT "%3.0" /end CHARACTERISTIC
/begin CHARACTERISTIC c_abc_inc_bn_cas "Anti - bounce counter increment BN2000 Diagnosis" VALUE 0xa080b8df _REC_VAL_20_u1 255. _CNV_A_R_LINEAR_____0_CM 0. 255. DISPLAY_IDENTIFIER C_ABC_INC_BN_CAS FORMAT "%3.0" /end CHARACTERISTIC
/begin CHARACTERISTIC c_abc_inc_bn_req_pbr "Anti - bounce counter increment BN2000 Diagnosis" VALUE 0xa080b8f1 _REC_VAL_20_u1 255. _CNV_A_R_LINEAR_____0_CM 0. 255. DISPLAY_IDENTIFIER C_ABC_INC_BN_REQ_PBR FORMAT "%3.0" /end CHARACTERISTIC
/begin CHARACTERISTIC c_abc_inc_bn_pbr "Anti - bounce counter increment BN2000 Diagnosis" VALUE 0xa080b8ee _REC_VAL_20_u1 255. _CNV_A_R_LINEAR_____0_CM 0. 255. DISPLAY_IDENTIFIER C_ABC_INC_BN_PBR FORMAT "%3.0" /end CHARACTERISTIC
/begin CHARACTERISTIC c_abc_max_bn_cas "Maximum value of the anti - bounce counter BN2000 diagnosis" VALUE 0xa080b9a7 _REC_VAL_20_u1 254. _CNV_A_R_LINEAR_____0_CM 1. 255. DISPLAY_IDENTIFIER C_ABC_MAX_BN_CAS FORMAT "%3.0" /end CHARACTERISTIC
/begin CHARACTERISTIC c_abc_max_bn_req_pbr "Maximum value of the anti - bounce counter BN2000 diagnosis" VALUE 0xa080b9b9 _REC_VAL_20_u1 254. _CNV_A_R_LINEAR_____0_CM 1. 255. DISPLAY_IDENTIFIER C_ABC_MAX_BN_REQ_PBR FORMAT "%3.0" /end CHARACTERISTIC
/begin CHARACTERISTIC c_abc_max_bn_pbr "Maximum value of the anti - bounce counter BN2000 diagnosis" VALUE 0xa080b9b6 _REC_VAL_20_u1 254. _CNV_A_R_LINEAR_____0_CM 1. 255. DISPLAY_IDENTIFIER C_ABC_MAX_BN_PBR FORMAT "%3.0" /end CHARACTERISTIC
/begin CHARACTERISTIC c_abc_dec_bn_cas "Anti - bounce counter increment BN2000 Diagnosis" VALUE 0xa080b883 _REC_VAL_20_u1 255. _CNV_A_R_LINEAR_____0_CM 0. 255. DISPLAY_IDENTIFIER C_ABC_DEC_BN_CAS FORMAT "%3.0" /end CHARACTERISTIC
/begin CHARACTERISTIC c_abc_dec_bn_req_pbr "Anti - bounce counter increment BN2000 Diagnosis" VALUE 0xa080b895 _REC_VAL_20_u1 255. _CNV_A_R_LINEAR_____0_CM 0. 255. DISPLAY_IDENTIFIER C_ABC_DEC_BN_REQ_PBR FORMAT "%3.0" /end CHARACTERISTIC
/begin CHARACTERISTIC c_abc_dec_bn_pbr "Anti - bounce counter increment BN2000 Diagnosis" VALUE 0xa080b892 _REC_VAL_20_u1 255. _CNV_A_R_LINEAR_____0_CM 0. 255. DISPLAY_IDENTIFIER C_ABC_DEC_BN_PBR FORMAT "%3.0" /end CHARACTERISTIC
/begin CHARACTERISTIC c_ctr_diag_tcc_can_max_cas "Maximum number of wrong ATCC_CAN count events before error detection of BN2000 message" VALUE 0xa080bb53 _REC_VAL_20_u1 255. _CNV_A_R_LINEAR_____0_CM 0. 255. DISPLAY_IDENTIFIER C_CTR_DIAG_TCC_CAN_MAX_CAS FORMAT "%3.0" /end CHARACTERISTIC
/begin CHARACTERISTIC c_ctr_diag_tcc_can_max_req_pbr "Maximum number of wrong ATCC_CAN count events before error detection of BN2000 message" VALUE 0xa080bb59 _REC_VAL_20_u1 255. _CNV_A_R_LINEAR_____0_CM 0. 255. DISPLAY_IDENTIFIER C_CTR_DIAG_TCC_CAN_MAX_REQ_PBR FORMAT "%3.0" /end CHARACTERISTIC
/begin CHARACTERISTIC c_ctr_diag_tcc_can_max_pbr "Maximum number of wrong ATCC_CAN count events before error detection of BN2000 message" VALUE 0xa080bb58 _REC_VAL_20_u1 255. _CNV_A_R_LINEAR_____0_CM 0. 255. DISPLAY_IDENTIFIER C_CTR_DIAG_TCC_CAN_MAX_PBR FORMAT "%3.0" /end CHARACTERISTIC
/begin CHARACTERISTIC c_ctr_diag_cks_max_cas "Maximum number of wrong checksum calculation events before error detection of BN2000 message" VALUE 0xa080bb45 _REC_VAL_20_u1 255. _CNV_A_R_LINEAR_____0_CM 0. 255. DISPLAY_IDENTIFIER C_CTR_DIAG_CKS_MAX_CAS FORMAT "%3.0" /end CHARACTERISTIC
/begin CHARACTERISTIC c_ctr_diag_cks_max_req_pbr "Maximum number of wrong checksum calculation events before error detection of BN2000 message" VALUE 0xa080bb4a _REC_VAL_20_u1 255. _CNV_A_R_LINEAR_____0_CM 0. 255. DISPLAY_IDENTIFIER C_CTR_DIAG_CKS_MAX_REQ_PBR FORMAT "%3.0" /end CHARACTERISTIC
/begin CHARACTERISTIC c_ctr_diag_cks_max_pbr "Maximum number of wrong checksum calculation events before error detection of BN2000 message" VALUE 0xa080bb49 _REC_VAL_20_u1 255. _CNV_A_R_LINEAR_____0_CM 0. 255. DISPLAY_IDENTIFIER C_CTR_DIAG_CKS_MAX_PBR FORMAT "%3.0" /end CHARACTERISTIC
/begin CHARACTERISTIC c_ctr_diag_tout_max_cas "Maximum number of missing message events before error detection of BN2000 message" VALUE 0xa080bb64 _REC_VAL_20_u1 255. _CNV_A_R_LINEAR_____0_CM 0. 255. DISPLAY_IDENTIFIER C_CTR_DIAG_TOUT_MAX_CAS FORMAT "%3.0" /end CHARACTERISTIC
/begin CHARACTERISTIC c_ctr_diag_tout_max_req_pbr "Maximum number of missing message events before error detection of BN2000 message" VALUE 0xa080bb76 _REC_VAL_20_u1 255. _CNV_A_R_LINEAR_____0_CM 0. 255. DISPLAY_IDENTIFIER C_CTR_DIAG_TOUT_MAX_REQ_PBR FORMAT "%3.0" /end CHARACTERISTIC
/begin CHARACTERISTIC c_ctr_diag_tout_max_pbr "Maximum number of missing message events before error detection of BN2000 message" VALUE 0xa080bb73 _REC_VAL_20_u1 255. _CNV_A_R_LINEAR_____0_CM 0. 255. DISPLAY_IDENTIFIER C_CTR_DIAG_TOUT_MAX_PBR FORMAT "%3.0" /end CHARACTERISTIC
/begin MEASUREMENT lv_err_alter_com "Logical variable for alternator BSD communication error" UBYTE _CNV_S_2_RANGE__0___1_CM 1 100. 0. 1. DISPLAY_IDENTIFIER LV_ERR_ALTER_COM ECU_ADDRESS 0xd000801e BIT_MASK 0x1 /end MEASUREMENT
/begin MEASUREMENT lv_err_cwp_com "Logical variable for electrical coolant water pump BSD communication error" UBYTE _CNV_S_2_RANGE__0___1_CM 1 100. 0. 1. DISPLAY_IDENTIFIER LV_ERR_CWP_COM ECU_ADDRESS 0xd000801f BIT_MASK 0x1 /end MEASUREMENT
/begin MEASUREMENT lv_err_qoil_com "Logical variable for oil quality sensor (QLT) BSD communication error" UBYTE _CNV_S_2_RANGE__0___1_CM 1 100. 0. 1. DISPLAY_IDENTIFIER LV_ERR_QOIL_COM ECU_ADDRESS 0xd0008020 BIT_MASK 0x1 /end MEASUREMENT
/begin MEASUREMENT lv_err_sens_bat_smt_com "Logical variable for intelligent battery sensor (IBS) BSD communication error" UBYTE _CNV_S_2_RANGE__0___1_CM 1 100. 0. 1. DISPLAY_IDENTIFIER LV_ERR_SENS_BAT_SMT_COM ECU_ADDRESS 0xd0008021 BIT_MASK 0x1 /end MEASUREMENT
/begin MEASUREMENT ctr_msg_alter_com_diag "Counter of faulty alternator transmitting slots " UBYTE _CNV_A_R_LINEAR_____0_CM 1 100. 0. 255. DISPLAY_IDENTIFIER CTR_MSG_ALTER_COM_DIAG ECU_ADDRESS 0xd0000490 FORMAT "%3.0" /end MEASUREMENT
/begin MEASUREMENT ctr_msg_cwp_com_diag "Counter of faulty electrical coolant water pump transmitting slots " UBYTE _CNV_A_R_LINEAR_____0_CM 1 100. 0. 255. DISPLAY_IDENTIFIER CTR_MSG_CWP_COM_DIAG ECU_ADDRESS 0xd0000491 FORMAT "%3.0" /end MEASUREMENT
/begin MEASUREMENT ctr_msg_qoil_com_diag "Counter of faulty oil quality sensor (QLT) transmitting slots " UBYTE _CNV_A_R_LINEAR_____0_CM 1 100. 0. 255. DISPLAY_IDENTIFIER CTR_MSG_QOIL_COM_DIAG ECU_ADDRESS 0xd0000492 FORMAT "%3.0" /end MEASUREMENT
/begin MEASUREMENT ctr_msg_sens_bat_smt_com_diag "Counter of faulty intelligent battery sensor (IBS) transmitting slots " UBYTE _CNV_A_R_LINEAR_____0_CM 1 100. 0. 255. DISPLAY_IDENTIFIER CTR_MSG_SENS_BAT_SMT_COM_DIAG ECU_ADDRESS 0xd0008e05 FORMAT "%3.0" /end MEASUREMENT
/begin MEASUREMENT ctr_msg_sens_bat_smt_com_stop "Interrupt counter to stop the communictation to the intelligent battery sensor (IBS)" UWORD _CNV_A_R_LINEAR_____0_CM 1 100. 0. 65535. DISPLAY_IDENTIFIER CTR_MSG_SENS_BAT_SMT_COM_STOP ECU_ADDRESS 0xd000aa72 FORMAT "%5.0" /end MEASUREMENT
/begin MEASUREMENT ctr_msg_qoil_com_stop "Interrupt counter to stop the communictation to the oil quality sensor (QLT)  " UWORD _CNV_A_R_LINEAR_____0_CM 1 100. 0. 65535. DISPLAY_IDENTIFIER CTR_MSG_QOIL_COM_STOP ECU_ADDRESS 0xd000aa70 FORMAT "%5.0" /end MEASUREMENT
/begin MEASUREMENT ctr_msg_cwp_com_stop "Interrupt counter to stop the communictation to the electrical coolant water pump" UWORD _CNV_A_R_LINEAR_____0_CM 1 100. 0. 65535. DISPLAY_IDENTIFIER CTR_MSG_CWP_COM_STOP ECU_ADDRESS 0xd000aa6e FORMAT "%5.0" /end MEASUREMENT
/begin MEASUREMENT ctr_msg_alter_com_stop "Interrupt counter to stop the communictation to the alternator " UWORD _CNV_A_R_LINEAR_____0_CM 1 100. 0. 65535. DISPLAY_IDENTIFIER CTR_MSG_ALTER_COM_STOP ECU_ADDRESS 0xd000aa6c FORMAT "%5.0" /end MEASUREMENT
/begin MEASUREMENT state_bsd_msg_com_stop "Status of the communication STOP counter to the BSD devices" UBYTE _CNV_A_R_LINEAR_____0_CM 1 100. 0. 255. DISPLAY_IDENTIFIER STATE_BSD_MSG_COM_STOP ECU_ADDRESS 0xd0008e04 FORMAT "%3.0" /end MEASUREMENT
/begin MEASUREMENT lv_err_bsd "logical variable for BSD error" UBYTE _CNV_S_2_RANGE__0___1_CM 1 100. 0. 1. DISPLAY_IDENTIFIER LV_ERR_BSD ECU_ADDRESS 0xd0007f89 BIT_MASK 0x1 /end MEASUREMENT
/begin MEASUREMENT lv_inh_cwp_diag "Flag to freeze the CWP diagnosis in case a non-acknowledge of the BSD component CWP occurred" UBYTE _CNV_S_2_RANGE__0___1_CM 1 100. 0. 1. DISPLAY_IDENTIFIER LV_INH_CWP_DIAG ECU_ADDRESS 0xd0008e07 BIT_MASK 0x1 /end MEASUREMENT
/begin MEASUREMENT lv_msg_alter_com_stop "Flag indication that the communication stop counter of the device alternator <>0" UBYTE _CNV_S_2_RANGE__0___1_CM 1 100. 0. 1. DISPLAY_IDENTIFIER LV_MSG_ALTER_COM_STOP ECU_ADDRESS 0xd0000496 BIT_MASK 0x1 /end MEASUREMENT
/begin MEASUREMENT lv_msg_cwp_com_stop "Flag indication that the communication stop counter of the device el. Coolant water pump <>0" UBYTE _CNV_S_2_RANGE__0___1_CM 1 100. 0. 1. DISPLAY_IDENTIFIER LV_MSG_CWP_COM_STOP ECU_ADDRESS 0xd0000497 BIT_MASK 0x1 /end MEASUREMENT
/begin MEASUREMENT lv_msg_qoil_com_stop "Flag indication that the communication stop counter of the device oil quality sensor <>0" UBYTE _CNV_S_2_RANGE__0___1_CM 1 100. 0. 1. DISPLAY_IDENTIFIER LV_MSG_QOIL_COM_STOP ECU_ADDRESS 0xd0000498 BIT_MASK 0x1 /end MEASUREMENT
/begin MEASUREMENT lv_msg_sens_bat_smt_com_stop "Flag indication that the communication stop counter of the device intelligent battery sensor <>0" UBYTE _CNV_S_2_RANGE__0___1_CM 1 100. 0. 1. DISPLAY_IDENTIFIER LV_MSG_SENS_BAT_SMT_COM_STOP ECU_ADDRESS 0xd0000499 BIT_MASK 0x1 /end MEASUREMENT
/begin CHARACTERISTIC c_abc_inc_bsd "Anti - bounce counter increment" VALUE 0xa080b8fe _REC_VAL_20_u1 255. _CNV_A_R_LINEAR_____0_CM 0. 255. DISPLAY_IDENTIFIER C_ABC_INC_BSD FORMAT "%3.0" /end CHARACTERISTIC
/begin CHARACTERISTIC c_abc_inc_qoil_com "Anti-bounce counter increment  - diagnosis BSD communication to oil quality sensor" VALUE 0xa080b973 _REC_VAL_20_u1 255. _CNV_A_R_LINEAR_____0_CM 0. 255. DISPLAY_IDENTIFIER C_ABC_INC_QOIL_COM FORMAT "%3.0" /end CHARACTERISTIC
/begin CHARACTERISTIC c_abc_inc_cwp_com "Anti-bounce counter increment  - diagnosis BSD communication to electrical coolant water pump" VALUE 0xa080b92b _REC_VAL_20_u1 255. _CNV_A_R_LINEAR_____0_CM 0. 255. DISPLAY_IDENTIFIER C_ABC_INC_CWP_COM FORMAT "%3.0" /end CHARACTERISTIC
/begin CHARACTERISTIC c_abc_inc_sens_bat_smt_com "Anti-bounce counter increment  - diagnosis BSD communication to intelligent battery sensor" VALUE 0xa080b97b _REC_VAL_20_u1 255. _CNV_A_R_LINEAR_____0_CM 0. 255. DISPLAY_IDENTIFIER C_ABC_INC_SENS_BAT_SMT_COM FORMAT "%3.0" /end CHARACTERISTIC
/begin CHARACTERISTIC c_abc_inc_alter_com "Anti-bounce counter increment  - diagnosis BSD communication to alternater" VALUE 0xa080b8d5 _REC_VAL_20_u1 255. _CNV_A_R_LINEAR_____0_CM 0. 255. DISPLAY_IDENTIFIER C_ABC_INC_ALTER_COM FORMAT "%3.0" /end CHARACTERISTIC
/begin CHARACTERISTIC c_ctr_max_msg_cwp_com "Threshold for counter of faulty electrical coolant water pump transmitting slots" VALUE 0xa080bbad _REC_VAL_20_u1 255. _CNV_A_R_LINEAR_____0_CM 0. 255. DISPLAY_IDENTIFIER C_CTR_MAX_MSG_CWP_COM FORMAT "%3.0" /end CHARACTERISTIC
/begin CHARACTERISTIC c_ctr_max_msg_qoil_com "Threshold for counter of faulty oil quality sensor transmitting slots" VALUE 0xa080bbae _REC_VAL_20_u1 255. _CNV_A_R_LINEAR_____0_CM 0. 255. DISPLAY_IDENTIFIER C_CTR_MAX_MSG_QOIL_COM FORMAT "%3.0" /end CHARACTERISTIC
/begin CHARACTERISTIC c_ctr_max_msg_sens_bat_smt_com "Threshold for counter of faulty intelligent battery sensor transmitting slots" VALUE 0xa080bbaf _REC_VAL_20_u1 255. _CNV_A_R_LINEAR_____0_CM 0. 255. DISPLAY_IDENTIFIER C_CTR_MAX_MSG_SENS_BAT_SMT_COM FORMAT "%3.0" /end CHARACTERISTIC
/begin CHARACTERISTIC c_ctr_thd_msg_cwp_com_diag "Threshold to disable the functional CWP diagnosis in case a problem with the interface BSD is present" VALUE 0xa080bbdf _REC_VAL_20_u1 255. _CNV_A_R_LINEAR_____0_CM 0. 255. DISPLAY_IDENTIFIER C_CTR_THD_MSG_CWP_COM_DIAG FORMAT "%3.0" /end CHARACTERISTIC
/begin CHARACTERISTIC c_abc_max_bsd "Debounce counter maximum value" VALUE 0xa080b9c6 _REC_VAL_20_u1 254. _CNV_A_R_LINEAR_____0_CM 1. 255. DISPLAY_IDENTIFIER C_ABC_MAX_BSD FORMAT "%3.0" /end CHARACTERISTIC
/begin CHARACTERISTIC c_abc_max_alter_com "Anti-bounce counter maximum value  - diagnosis BSD communication to alternater" VALUE 0xa080b99d _REC_VAL_20_u1 254. _CNV_A_R_LINEAR_____0_CM 1. 255. DISPLAY_IDENTIFIER C_ABC_MAX_ALTER_COM FORMAT "%3.0" /end CHARACTERISTIC
/begin CHARACTERISTIC c_abc_max_cwp_com "Anti-bounce counter maximum value  - diagnosis BSD communication to electrical coolant water pump" VALUE 0xa080b9f3 _REC_VAL_20_u1 254. _CNV_A_R_LINEAR_____0_CM 1. 255. DISPLAY_IDENTIFIER C_ABC_MAX_CWP_COM FORMAT "%3.0" /end CHARACTERISTIC
/begin CHARACTERISTIC c_abc_max_qoil_com "Anti-bounce counter maximum value  - diagnosis BSD communication to oil quality sensor" VALUE 0xa080ba3c _REC_VAL_20_u1 254. _CNV_A_R_LINEAR_____0_CM 1. 255. DISPLAY_IDENTIFIER C_ABC_MAX_QOIL_COM FORMAT "%3.0" /end CHARACTERISTIC
/begin CHARACTERISTIC c_abc_max_sens_bat_smt_com "Anti-bounce counter maximum value  - diagnosis BSD communication to intelligent battery sensor" VALUE 0xa080ba44 _REC_VAL_20_u1 254. _CNV_A_R_LINEAR_____0_CM 1. 255. DISPLAY_IDENTIFIER C_ABC_MAX_SENS_BAT_SMT_COM FORMAT "%3.0" /end CHARACTERISTIC
/begin CHARACTERISTIC c_ctr_max_msg_alter_com "Threshold for counter of faulty alternator transmitting slots " VALUE 0xa080bbac _REC_VAL_20_u1 255. _CNV_A_R_LINEAR_____0_CM 0. 255. DISPLAY_IDENTIFIER C_CTR_MAX_MSG_ALTER_COM FORMAT "%3.0" /end CHARACTERISTIC
/begin CHARACTERISTIC c_ctr_max_alter_com_stop "Time out threshold for counter of alternator transmitting slots " VALUE 0xa080bba4 _REC_VAL_20_u2 65535. _CNV_A_R_LINEAR_____0_CM 0. 65535. DISPLAY_IDENTIFIER C_CTR_MAX_ALTER_COM_STOP FORMAT "%5.0" /end CHARACTERISTIC
/begin CHARACTERISTIC c_ctr_max_cwp_com_stop "Number of time out transmitting slots for electrical coolant water pump " VALUE 0xa080bba6 _REC_VAL_20_u2 65535. _CNV_A_R_LINEAR_____0_CM 0. 65535. DISPLAY_IDENTIFIER C_CTR_MAX_CWP_COM_STOP FORMAT "%5.0" /end CHARACTERISTIC
/begin CHARACTERISTIC c_ctr_max_qoil_com_stop "Number of time out transmitting slots for oil quality sensor" VALUE 0xa080bbb0 _REC_VAL_20_u2 65535. _CNV_A_R_LINEAR_____0_CM 0. 65535. DISPLAY_IDENTIFIER C_CTR_MAX_QOIL_COM_STOP FORMAT "%5.0" /end CHARACTERISTIC
/begin CHARACTERISTIC c_ctr_max_sens_bat_smt_com_stop "Number of time out transmitting slots for intelligent battery sensor " VALUE 0xa080bbb2 _REC_VAL_20_u2 65535. _CNV_A_R_LINEAR_____0_CM 0. 65535. DISPLAY_IDENTIFIER C_CTR_MAX_SENS_BAT_SMT_COM_STOP FORMAT "%5.0" /end CHARACTERISTIC
/begin MEASUREMENT ctr_abc_alter_com "Anti-bounce counter for alternator BSD communication error" UBYTE _CNV_A_R_LINEAR_____0_CM 1 100. 0. 255. DISPLAY_IDENTIFIER CTR_ABC_ALTER_COM ECU_ADDRESS 0xd0000493 FORMAT "%3.0" /end MEASUREMENT
/begin MEASUREMENT ctr_abc_cwp_com "Anti-bounce counter for electrical coolant water pump BSD communication error" UBYTE _CNV_A_R_LINEAR_____0_CM 1 100. 0. 255. DISPLAY_IDENTIFIER CTR_ABC_CWP_COM ECU_ADDRESS 0xd0000494 FORMAT "%3.0" /end MEASUREMENT
/begin MEASUREMENT ctr_abc_qoil_com "Anti-bounce counter for oil quality sensor (QLT) BSD communication error" UBYTE _CNV_A_R_LINEAR_____0_CM 1 100. 0. 255. DISPLAY_IDENTIFIER CTR_ABC_QOIL_COM ECU_ADDRESS 0xd0000495 FORMAT "%3.0" /end MEASUREMENT
/begin MEASUREMENT ctr_abc_sens_bat_smt_com "Anti-bounce counter for intelligent battery sensor (IBS) BSD communication error" UBYTE _CNV_A_R_LINEAR_____0_CM 1 100. 0. 255. DISPLAY_IDENTIFIER CTR_ABC_SENS_BAT_SMT_COM ECU_ADDRESS 0xd0008e06 FORMAT "%3.0" /end MEASUREMENT
/begin MEASUREMENT ctr_end_diag_alter_com "Counter for End of diagnosis condition detection for alternator BSD communication error" UBYTE _CNV_A_R_LINEAR_____0_CM 1 100. 0. 255. DISPLAY_IDENTIFIER CTR_END_DIAG_ALTER_COM ECU_ADDRESS 0xd000048c FORMAT "%3.0" /end MEASUREMENT
/begin MEASUREMENT ctr_end_diag_cwp_com "Counter for End of diagnosis condition detection for electrical coolant water pump BSD communication error" UBYTE _CNV_A_R_LINEAR_____0_CM 1 100. 0. 255. DISPLAY_IDENTIFIER CTR_END_DIAG_CWP_COM ECU_ADDRESS 0xd000048d FORMAT "%3.0" /end MEASUREMENT
/begin MEASUREMENT ctr_end_diag_qoil_com "Counter for End of diagnosis condition detection for oil quality sensor (QLT) BSD communication error" UBYTE _CNV_A_R_LINEAR_____0_CM 1 100. 0. 255. DISPLAY_IDENTIFIER CTR_END_DIAG_QOIL_COM ECU_ADDRESS 0xd000048e FORMAT "%3.0" /end MEASUREMENT
/begin MEASUREMENT ctr_end_diag_sens_bat_smt_com "Counter for End of diagnosis condition detection for intelligent battery sensor (IBS) BSD communication error" UBYTE _CNV_A_R_LINEAR_____0_CM 1 100. 0. 255. DISPLAY_IDENTIFIER CTR_END_DIAG_SENS_BAT_SMT_COM ECU_ADDRESS 0xd000048f FORMAT "%3.0" /end MEASUREMENT
/begin MEASUREMENT lv_err_efp "logical variable error in case of EFP self diagnosis" UBYTE _CNV_S_2_RANGE__0___1_CM 1 100. 0. 1. DISPLAY_IDENTIFIER LV_ERR_EFP ECU_ADDRESS 0xd0008b8a BIT_MASK 0x1 /end MEASUREMENT
/begin MEASUREMENT lv_err_efp_crash "logical variable error in case of crash switch off EFP" UBYTE _CNV_S_2_RANGE__0___1_CM 1 100. 0. 1. DISPLAY_IDENTIFIER LV_ERR_EFP_CRASH ECU_ADDRESS 0xd0008b8b BIT_MASK 0x1 /end MEASUREMENT
/begin CHARACTERISTIC c_abc_inc_efp "Debounce counter increment EFP error" VALUE 0xa080b938 _REC_VAL_20_u1 255. _CNV_A_R_LINEAR_____0_CM 0. 255. DISPLAY_IDENTIFIER C_ABC_INC_EFP FORMAT "%3.0" /end CHARACTERISTIC
/begin CHARACTERISTIC c_abc_max_efp "Debounce counter maximum value EFP error" VALUE 0xa080ba00 _REC_VAL_20_u1 254. _CNV_A_R_LINEAR_____0_CM 1. 255. DISPLAY_IDENTIFIER C_ABC_MAX_EFP FORMAT "%3.0" /end CHARACTERISTIC
/begin CHARACTERISTIC c_abc_inc_efp_crash "Debounce counter increment EFP error" VALUE 0xa080b939 _REC_VAL_20_u1 255. _CNV_A_R_LINEAR_____0_CM 0. 255. DISPLAY_IDENTIFIER C_ABC_INC_EFP_CRASH FORMAT "%3.0" /end CHARACTERISTIC
/begin CHARACTERISTIC c_abc_max_efp_crash "Debounce counter maximum value EFP error" VALUE 0xa080ba01 _REC_VAL_20_u1 254. _CNV_A_R_LINEAR_____0_CM 1. 255. DISPLAY_IDENTIFIER C_ABC_MAX_EFP_CRASH FORMAT "%3.0" /end CHARACTERISTIC
/begin CHARACTERISTIC c_abc_inc_can_boff "anti bounce counter increment  - diagnosis of CAN bus on / off" VALUE 0xa080b8ff _REC_VAL_20_u1 255. _CNV_A_R_LINEAR_____0_CM 0. 255. DISPLAY_IDENTIFIER C_ABC_INC_CAN_BOFF FORMAT "%3.0" /end CHARACTERISTIC
/begin CHARACTERISTIC c_abc_max_can_boff "anti bounce counter maximum value  - diagnosis of CAN bus on / off" VALUE 0xa080b9c7 _REC_VAL_20_u1 254. _CNV_A_R_LINEAR_____0_CM 1. 255. DISPLAY_IDENTIFIER C_ABC_MAX_CAN_BOFF FORMAT "%3.0" /end CHARACTERISTIC
/begin CHARACTERISTIC c_abc_inc_locan_boff "anti bounce counter increment  - diagnosis of CAN bus on / off" VALUE 0xa080b957 _REC_VAL_20_u1 255. _CNV_A_R_LINEAR_____0_CM 0. 255. DISPLAY_IDENTIFIER C_ABC_INC_LOCAN_BOFF FORMAT "%3.0" /end CHARACTERISTIC
/begin CHARACTERISTIC c_abc_max_locan_boff "anti bounce counter maximum value  - diagnosis of CAN bus on / off" VALUE 0xa080ba1f _REC_VAL_20_u1 254. _CNV_A_R_LINEAR_____0_CM 1. 255. DISPLAY_IDENTIFIER C_ABC_MAX_LOCAN_BOFF FORMAT "%3.0" /end CHARACTERISTIC
/begin CHARACTERISTIC c_abc_inc_dcc "Increment counter" VALUE 0xa080b92e _REC_VAL_20_u1 255. _CNV_A_R_LINEAR_____0_CM 0. 255. DISPLAY_IDENTIFIER C_ABC_INC_DCC FORMAT "%3.0" /end CHARACTERISTIC
/begin CHARACTERISTIC c_abc_max_dcc "Maximum counter" VALUE 0xa080b9f6 _REC_VAL_20_u1 254. _CNV_A_R_LINEAR_____0_CM 1. 255. DISPLAY_IDENTIFIER C_ABC_MAX_DCC FORMAT "%3.0" /end CHARACTERISTIC
/begin MEASUREMENT lv_dcc_off_ecu "Irreversible DCC error" UBYTE _CNV_S_2_RANGE__0___1_CM 1 100. 0. 1. DISPLAY_IDENTIFIER LV_DCC_OFF_ECU ECU_ADDRESS 0xd0008e3d BIT_MASK 0x1 /end MEASUREMENT
/begin MEASUREMENT t_dcc_brake_det "Brake delay timer" UBYTE _CNV_A_R_LINEAR_____3_CM 1 100. 0. 2.55 DISPLAY_IDENTIFIER T_DCC_BRAKE_DET ECU_ADDRESS 0xd0008e3c FORMAT "%4.2" /end MEASUREMENT
/begin CHARACTERISTIC c_t_max_brake_det_dcc "Maximum Brake delay timer" VALUE 0xa080c1dc _REC_VAL_20_u1 2.55 _CNV_A_R_LINEAR_____3_CM 0. 2.55 DISPLAY_IDENTIFIER C_T_MAX_BRAKE_DET_DCC FORMAT "%4.2" /end CHARACTERISTIC
/begin MEASUREMENT lv_err_dcc "DCC error" UBYTE _CNV_S_2_RANGE__0___1_CM 1 100. 0. 1. DISPLAY_IDENTIFIER LV_ERR_DCC ECU_ADDRESS 0xd0007f8d BIT_MASK 0x1 /end MEASUREMENT
/begin CHARACTERISTIC c_abc_inc_cs "Anti bounce increment CS diagnosis" VALUE 0xa080b929 _REC_VAL_20_u1 255. _CNV_A_R_LINEAR_____0_CM 0. 255. DISPLAY_IDENTIFIER C_ABC_INC_CS FORMAT "%3.0" /end CHARACTERISTIC
/begin CHARACTERISTIC c_abc_max_cs "Anti bounce maximum CS diagnosis" VALUE 0xa080b9f1 _REC_VAL_20_u1 254. _CNV_A_R_LINEAR_____0_CM 1. 255. DISPLAY_IDENTIFIER C_ABC_MAX_CS FORMAT "%3.0" /end CHARACTERISTIC
/begin MEASUREMENT iso_m6_diag_ram_com.m6_cur_dmtl_cor_fil_cid18 "" UWORD _CNV_A_R_LINEAR_____148_CM 1 100. 0. 400. DISPLAY_IDENTIFIER M6_CUR_DMTL_COR_FIL_CID18 ECU_ADDRESS 0xd000aa74 FORMAT "%7.3" /end MEASUREMENT
/begin MEASUREMENT iso_m6_diag_ram_com.m6_cur_dmtl_cor_fil_cid19 "" UWORD _CNV_A_R_LINEAR_____148_CM 1 100. 0. 400. DISPLAY_IDENTIFIER M6_CUR_DMTL_COR_FIL_CID19 ECU_ADDRESS 0xd000aa78 FORMAT "%7.3" /end MEASUREMENT
/begin MEASUREMENT iso_m6_diag_ram_com.m6_cur_dmtl_dmtls_test "" UWORD _CNV_A_R_LINEAR_____148_CM 1 100. 0. 400. DISPLAY_IDENTIFIER M6_CUR_DMTL_DMTLS_TEST ECU_ADDRESS 0xd000aa7c FORMAT "%7.3" /end MEASUREMENT
/begin MEASUREMENT iso_m6_diag_ram_com.m6_cur_dmtl_thd_dmtls_test "" UWORD _CNV_A_R_LINEAR_____148_CM 1 100. 0. 400. DISPLAY_IDENTIFIER M6_CUR_DMTL_THD_DMTLS_TEST ECU_ADDRESS 0xd000aa7e FORMAT "%7.3" /end MEASUREMENT
/begin MEASUREMENT iso_m6_diag_ram_com.m6_cur_dmtl_rough_leak_end "" UWORD _CNV_A_R_LINEAR_____148_CM 1 100. 0. 400. DISPLAY_IDENTIFIER M6_CUR_DMTL_ROUGH_LEAK_END ECU_ADDRESS 0xd000aa80 FORMAT "%7.3" /end MEASUREMENT
/begin MEASUREMENT iso_m6_diag_ram_com.m6_cur_dmtl_thd_rough_leak "" UWORD _CNV_A_R_LINEAR_____148_CM 1 100. 0. 400. DISPLAY_IDENTIFIER M6_CUR_DMTL_THD_ROUGH_LEAK ECU_ADDRESS 0xd000aa82 FORMAT "%7.3" /end MEASUREMENT
/begin MEASUREMENT iso_m6_diag_ram_com.m6_cur_dmtl_small_leak_end "" UWORD _CNV_A_R_LINEAR_____148_CM 1 100. 0. 400. DISPLAY_IDENTIFIER M6_CUR_DMTL_SMALL_LEAK_END ECU_ADDRESS 0xd000aa84 FORMAT "%7.3" /end MEASUREMENT
/begin MEASUREMENT iso_m6_diag_ram_com.m6_cur_dmtl_ref_leak "" UWORD _CNV_A_R_LINEAR_____148_CM 1 100. 0. 400. DISPLAY_IDENTIFIER M6_CUR_DMTL_REF_LEAK ECU_ADDRESS 0xd000aa86 FORMAT "%7.3" /end MEASUREMENT
/begin MEASUREMENT iso_m6_diag_ram_com.m6_cur_dmtl_rough_leak_len_end "" UWORD _CNV_A_R_LINEAR_____148_CM 1 100. 0. 400. DISPLAY_IDENTIFIER M6_CUR_DMTL_ROUGH_LEAK_LEN_END ECU_ADDRESS 0xd000aa8a FORMAT "%7.3" /end MEASUREMENT
/begin MEASUREMENT iso_m6_diag_ram_com.m6_cur_dmtl_thd_rough_leak_len "" UWORD _CNV_A_R_LINEAR_____148_CM 1 100. 0. 400. DISPLAY_IDENTIFIER M6_CUR_DMTL_THD_ROUGH_LEAK_LEN ECU_ADDRESS 0xd000aa8c FORMAT "%7.3" /end MEASUREMENT
/begin MEASUREMENT iso_m6_diag_ram_com.m6_ctr_cnl_small_leak_mes "" UBYTE _CNV_A_R_LINEAR_____0_CM 1 100. 0. 255. DISPLAY_IDENTIFIER M6_CTR_CNL_SMALL_LEAK_MES ECU_ADDRESS 0xd000aa88 FORMAT "%3.0" /end MEASUREMENT
/begin CHARACTERISTIC c_ctr_req_msg_oil "" VALUE 0xa080bbbc _REC_VAL_20_u1 255. _CNV_A_R_LINEAR_____0_CM 0. 255. DISPLAY_IDENTIFIER C_CTR_REQ_MSG_OIL FORMAT "%3.0" /end CHARACTERISTIC
/begin CHARACTERISTIC c_abc_inc_maf_frq_el[0] "Debounce counter increment for diagnosis instance MAF_FRQ_EL[NC_MAF_NR]" VALUE 0xa080b95a _REC_VAL_20_u1 255. _CNV_A_R_LINEAR_____0_CM 0. 255. DISPLAY_IDENTIFIER C_ABC_INC_MAF_FRQ_EL[0] FORMAT "%3.0" /end CHARACTERISTIC
/begin CHARACTERISTIC c_abc_inc_maf_frq_el[1] "Debounce counter increment for diagnosis instance MAF_FRQ_EL[NC_MAF_NR]" VALUE 0xa080b95b _REC_VAL_20_u1 255. _CNV_A_R_LINEAR_____0_CM 0. 255. DISPLAY_IDENTIFIER C_ABC_INC_MAF_FRQ_EL[1] FORMAT "%3.0" /end CHARACTERISTIC
/begin CHARACTERISTIC c_abc_inc_maf_frq_grd[0] "Debounce counter increment for diagnosis instance MAF_FRQ_GRD[NC_MAF_NR]" VALUE 0xa080b95c _REC_VAL_20_u1 255. _CNV_A_R_LINEAR_____0_CM 0. 255. DISPLAY_IDENTIFIER C_ABC_INC_MAF_FRQ_GRD[0] FORMAT "%3.0" /end CHARACTERISTIC
/begin CHARACTERISTIC c_abc_inc_maf_frq_grd[1] "Debounce counter increment for diagnosis instance MAF_FRQ_GRD[NC_MAF_NR]" VALUE 0xa080b95d _REC_VAL_20_u1 255. _CNV_A_R_LINEAR_____0_CM 0. 255. DISPLAY_IDENTIFIER C_ABC_INC_MAF_FRQ_GRD[1] FORMAT "%3.0" /end CHARACTERISTIC
/begin CHARACTERISTIC c_abc_inc_maf_frq_rng[0] "Debounce counter increment for diagnosis instance MAF_FRQ_RNG[NC_MAF_NR]" VALUE 0xa080b95e _REC_VAL_20_u1 255. _CNV_A_R_LINEAR_____0_CM 0. 255. DISPLAY_IDENTIFIER C_ABC_INC_MAF_FRQ_RNG[0] FORMAT "%3.0" /end CHARACTERISTIC
/begin CHARACTERISTIC c_abc_inc_maf_frq_rng[1] "Debounce counter increment for diagnosis instance MAF_FRQ_RNG[NC_MAF_NR]" VALUE 0xa080b95f _REC_VAL_20_u1 255. _CNV_A_R_LINEAR_____0_CM 0. 255. DISPLAY_IDENTIFIER C_ABC_INC_MAF_FRQ_RNG[1] FORMAT "%3.0" /end CHARACTERISTIC
/begin CHARACTERISTIC c_abc_max_maf_frq_el[0] "Debounce counter maximum value for diagnosis instance MAF_FRQ_EL[NC_MAF_NR]" VALUE 0xa080ba22 _REC_VAL_20_u1 254. _CNV_A_R_LINEAR_____0_CM 1. 255. DISPLAY_IDENTIFIER C_ABC_MAX_MAF_FRQ_EL[0] FORMAT "%3.0" /end CHARACTERISTIC
/begin CHARACTERISTIC c_abc_max_maf_frq_el[1] "Debounce counter maximum value for diagnosis instance MAF_FRQ_EL[NC_MAF_NR]" VALUE 0xa080ba23 _REC_VAL_20_u1 254. _CNV_A_R_LINEAR_____0_CM 1. 255. DISPLAY_IDENTIFIER C_ABC_MAX_MAF_FRQ_EL[1] FORMAT "%3.0" /end CHARACTERISTIC
/begin CHARACTERISTIC c_abc_max_maf_frq_grd[0] "Debounce counter maximum value for diagnosis instance MAF_FRQ_GRD[NC_MAF_NR]" VALUE 0xa080ba24 _REC_VAL_20_u1 254. _CNV_A_R_LINEAR_____0_CM 1. 255. DISPLAY_IDENTIFIER C_ABC_MAX_MAF_FRQ_GRD[0] FORMAT "%3.0" /end CHARACTERISTIC
/begin CHARACTERISTIC c_abc_max_maf_frq_grd[1] "Debounce counter maximum value for diagnosis instance MAF_FRQ_GRD[NC_MAF_NR]" VALUE 0xa080ba25 _REC_VAL_20_u1 254. _CNV_A_R_LINEAR_____0_CM 1. 255. DISPLAY_IDENTIFIER C_ABC_MAX_MAF_FRQ_GRD[1] FORMAT "%3.0" /end CHARACTERISTIC
/begin CHARACTERISTIC c_abc_max_maf_frq_rng[0] "Debounce counter maximum value for diagnosis instance MAF_FRQ_RNG[NC_MAF_NR]" VALUE 0xa080ba26 _REC_VAL_20_u1 254. _CNV_A_R_LINEAR_____0_CM 1. 255. DISPLAY_IDENTIFIER C_ABC_MAX_MAF_FRQ_RNG[0] FORMAT "%3.0" /end CHARACTERISTIC
/begin CHARACTERISTIC c_abc_max_maf_frq_rng[1] "Debounce counter maximum value for diagnosis instance MAF_FRQ_RNG[NC_MAF_NR]" VALUE 0xa080ba27 _REC_VAL_20_u1 254. _CNV_A_R_LINEAR_____0_CM 1. 255. DISPLAY_IDENTIFIER C_ABC_MAX_MAF_FRQ_RNG[1] FORMAT "%3.0" /end CHARACTERISTIC
/begin CHARACTERISTIC c_abc_inc_maf "Anti-bounce counter increment value" VALUE 0xa080b958 _REC_VAL_20_u1 255. _CNV_A_R_LINEAR_____0_CM 0. 255. DISPLAY_IDENTIFIER C_ABC_INC_MAF FORMAT "%3.0" /end CHARACTERISTIC
/begin CHARACTERISTIC c_abc_max_maf "Anti-bounce counter maximum value" VALUE 0xa080ba20 _REC_VAL_20_u1 254. _CNV_A_R_LINEAR_____0_CM 1. 255. DISPLAY_IDENTIFIER C_ABC_MAX_MAF FORMAT "%3.0" /end CHARACTERISTIC
/begin MEASUREMENT t_poil_swi_pwl "Timer for oil pressure inclination after engine stop" UBYTE _CNV_A_R_LINEAR_____4_CM 1 100. 0. 6.2 DISPLAY_IDENTIFIER T_POIL_SWI_PWL ECU_ADDRESS 0xd0008bf8 FORMAT "%3.1" /end MEASUREMENT
/begin CHARACTERISTIC c_abc_inc_poil_swi "Anti bounce increment value, POIL_SWI" VALUE 0xa080b96c _REC_VAL_20_u1 255. _CNV_A_R_LINEAR_____0_CM 0. 255. DISPLAY_IDENTIFIER C_ABC_INC_POIL_SWI FORMAT "%3.0" /end CHARACTERISTIC
/begin CHARACTERISTIC c_abc_max_poil_swi "Anti-bounce max. value, POIL_SWI" VALUE 0xa080ba34 _REC_VAL_20_u1 254. _CNV_A_R_LINEAR_____0_CM 1. 255. DISPLAY_IDENTIFIER C_ABC_MAX_POIL_SWI FORMAT "%3.0" /end CHARACTERISTIC
/begin CHARACTERISTIC c_t_poil_swi_pwl "Time for oil pressure inclination" VALUE 0xa080c256 _REC_VAL_20_u1 6.2 _CNV_A_R_LINEAR_____4_CM 0. 6.2 DISPLAY_IDENTIFIER C_T_POIL_SWI_PWL FORMAT "%3.1" /end CHARACTERISTIC
/begin CHARACTERISTIC c_toil_poil_swi_max_diag "Maximum diagnosis threshold TOIL" VALUE 0xa080c34d _REC_VAL_20_u1 200. _CNV_A_R_LINEAR_____26_CM -40. 160. DISPLAY_IDENTIFIER C_TOIL_POIL_SWI_MAX_DIAG FORMAT "%3.0" /end CHARACTERISTIC
/begin CHARACTERISTIC c_toil_poil_swi_min_diag "Minimum diagnosis threshold TOIL" VALUE 0xa080c34e _REC_VAL_20_u1 200. _CNV_A_R_LINEAR_____26_CM -40. 160. DISPLAY_IDENTIFIER C_TOIL_POIL_SWI_MIN_DIAG FORMAT "%3.0" /end CHARACTERISTIC
/begin MEASUREMENT lv_err_poil_swi "Error oil pressure switch" UBYTE _CNV_S_2_RANGE__0___1_CM 1 100. 0. 1. DISPLAY_IDENTIFIER LV_ERR_POIL_SWI ECU_ADDRESS 0xd0007f8a BIT_MASK 0x1 /end MEASUREMENT
/begin CHARACTERISTIC c_abc_inc_poil_dr "Antibounce counter increment" VALUE 0xa080b96b _REC_VAL_20_u1 255. _CNV_A_R_LINEAR_____0_CM 0. 255. DISPLAY_IDENTIFIER C_ABC_INC_POIL_DR FORMAT "%3.0" /end CHARACTERISTIC
/begin CHARACTERISTIC c_abc_max_poil_dr "Maximum value for antibounce counter" VALUE 0xa080ba33 _REC_VAL_20_u1 254. _CNV_A_R_LINEAR_____0_CM 1. 255. DISPLAY_IDENTIFIER C_ABC_MAX_POIL_DR FORMAT "%3.0" /end CHARACTERISTIC
/begin CHARACTERISTIC c_abc_inc_poil "Anti - bounce counter increment" VALUE 0xa080b968 _REC_VAL_20_u1 255. _CNV_A_R_LINEAR_____0_CM 0. 255. DISPLAY_IDENTIFIER C_ABC_INC_POIL FORMAT "%3.0" /end CHARACTERISTIC
/begin CHARACTERISTIC c_abc_max_poil "Maximum value of the anti - bounce counter" VALUE 0xa080ba30 _REC_VAL_20_u1 254. _CNV_A_R_LINEAR_____0_CM 1. 255. DISPLAY_IDENTIFIER C_ABC_MAX_POIL FORMAT "%3.0" /end CHARACTERISTIC
/begin CHARACTERISTIC c_abc_inc_pvs_ratio "Increment debounce counter" VALUE 0xa080b972 _REC_VAL_20_u1 255. _CNV_A_R_LINEAR_____0_CM 0. 255. DISPLAY_IDENTIFIER C_ABC_INC_PVS_RATIO FORMAT "%3.0" /end CHARACTERISTIC
/begin CHARACTERISTIC c_abc_max_pvs_ratio "Maximum value debounce counter " VALUE 0xa080ba3b _REC_VAL_20_u1 254. _CNV_A_R_LINEAR_____0_CM 1. 255. DISPLAY_IDENTIFIER C_ABC_MAX_PVS_RATIO FORMAT "%3.0" /end CHARACTERISTIC
/begin CHARACTERISTIC c_abc_max_pvs_bls_not_plaus "PVS_BLS_BTS_PLAUS counter maximum value" VALUE 0xa080ba3a _REC_VAL_20_u1 254. _CNV_A_R_LINEAR_____0_CM 1. 255. DISPLAY_IDENTIFIER C_ABC_MAX_PVS_BLS_NOT_PLAUS FORMAT "%3.0" /end CHARACTERISTIC
/begin CHARACTERISTIC c_abc_inc_pvs_bls_not_plaus "PVS_BLS_BTS_PLAUS counter increment value" VALUE 0xa080b971 _REC_VAL_20_u1 255. _CNV_A_R_LINEAR_____0_CM 0. 255. DISPLAY_IDENTIFIER C_ABC_INC_PVS_BLS_NOT_PLAUS FORMAT "%3.0" /end CHARACTERISTIC
/begin CHARACTERISTIC c_abc_inc_v_ref_1 "Anti bounce increment value for V_REF_1" VALUE 0xa080b993 _REC_VAL_20_u1 255. _CNV_A_R_LINEAR_____0_CM 0. 255. DISPLAY_IDENTIFIER C_ABC_INC_V_REF_1 FORMAT "%3.0" /end CHARACTERISTIC
/begin CHARACTERISTIC c_abc_inc_v_ref_2 "Anti bounce increment value for V_REF_2" VALUE 0xa080b994 _REC_VAL_20_u1 255. _CNV_A_R_LINEAR_____0_CM 0. 255. DISPLAY_IDENTIFIER C_ABC_INC_V_REF_2 FORMAT "%3.0" /end CHARACTERISTIC
/begin CHARACTERISTIC c_abc_max_v_ref_1 "Anti-bounce maximum value (x=1,2)" VALUE 0xa080ba5c _REC_VAL_20_u1 254. _CNV_A_R_LINEAR_____0_CM 1. 255. DISPLAY_IDENTIFIER C_ABC_MAX_V_REF_1 FORMAT "%3.0" /end CHARACTERISTIC
/begin CHARACTERISTIC c_abc_max_v_ref_2 "Anti-bounce maximum value (x=1,2)" VALUE 0xa080ba5d _REC_VAL_20_u1 254. _CNV_A_R_LINEAR_____0_CM 1. 255. DISPLAY_IDENTIFIER C_ABC_MAX_V_REF_2 FORMAT "%3.0" /end CHARACTERISTIC
/begin CHARACTERISTIC c_abc_inc_pvs_1 "Anti-bounce increment value, PVS 1" VALUE 0xa080b96f _REC_VAL_20_u1 255. _CNV_A_R_LINEAR_____0_CM 0. 255. DISPLAY_IDENTIFIER C_ABC_INC_PVS_1 FORMAT "%3.0" /end CHARACTERISTIC
/begin CHARACTERISTIC c_abc_inc_pvs_2 "Anti-bounce increment value, PVS 2" VALUE 0xa080b970 _REC_VAL_20_u1 255. _CNV_A_R_LINEAR_____0_CM 0. 255. DISPLAY_IDENTIFIER C_ABC_INC_PVS_2 FORMAT "%3.0" /end CHARACTERISTIC
/begin CHARACTERISTIC c_abc_max_pvs_1 "Anti-bounce maximum value, PVS 1" VALUE 0xa080ba38 _REC_VAL_20_u1 254. _CNV_A_R_LINEAR_____0_CM 1. 255. DISPLAY_IDENTIFIER C_ABC_MAX_PVS_1 FORMAT "%3.0" /end CHARACTERISTIC
/begin CHARACTERISTIC c_abc_max_pvs_2 "Anti-bounce maximum value, PVS 2" VALUE 0xa080ba39 _REC_VAL_20_u1 254. _CNV_A_R_LINEAR_____0_CM 1. 255. DISPLAY_IDENTIFIER C_ABC_MAX_PVS_2 FORMAT "%3.0" /end CHARACTERISTIC
/begin CHARACTERISTIC c_v_sof_swi_min "Input voltage threshold min" VALUE 0xa080c406 _REC_VAL_20_u2 4.9951171875 _CNV_A_R_LINEAR_____2_CM 0. 4.9951171875 DISPLAY_IDENTIFIER C_V_SOF_SWI_MIN FORMAT "%5.3" /end CHARACTERISTIC
/begin CHARACTERISTIC c_abc_inc_sof_req "Anti - bounce counter increment" VALUE 0xa080b97f _REC_VAL_20_u1 255. _CNV_A_R_LINEAR_____0_CM 0. 255. DISPLAY_IDENTIFIER C_ABC_INC_SOF_REQ FORMAT "%3.0" /end CHARACTERISTIC
/begin CHARACTERISTIC c_abc_max_sof_req "Debounce counter maximum value" VALUE 0xa080ba48 _REC_VAL_20_u1 254. _CNV_A_R_LINEAR_____0_CM 1. 255. DISPLAY_IDENTIFIER C_ABC_MAX_SOF_REQ FORMAT "%3.0" /end CHARACTERISTIC
/begin CHARACTERISTIC c_v_sof_swi_max "Input voltage threshold max" VALUE 0xa080c404 _REC_VAL_20_u2 4.9951171875 _CNV_A_R_LINEAR_____2_CM 0. 4.9951171875 DISPLAY_IDENTIFIER C_V_SOF_SWI_MAX FORMAT "%5.3" /end CHARACTERISTIC
/begin MEASUREMENT lv_err_sof_req "Erroflag sport-mode switch request" UBYTE _CNV_S_2_RANGE__0___1_CM 1 100. 0. 1. DISPLAY_IDENTIFIER LV_ERR_SOF_REQ ECU_ADDRESS 0xd0007f86 BIT_MASK 0x1 /end MEASUREMENT
/begin MEASUREMENT state_err_amt_can "State of AMT Error intervention CAN 11H" UBYTE _CNV_A_R_LINEAR_____0_CM 1 100. 0. 5. DISPLAY_IDENTIFIER STATE_ERR_AMT_CAN ECU_ADDRESS 0xd0008e39 FORMAT "%2.0" /end MEASUREMENT
/begin MEASUREMENT lv_amt_es_req "AMT request of engine stop" UBYTE _CNV_S_2_RANGE__0___1_CM 1 100. 0. 1. DISPLAY_IDENTIFIER LV_AMT_ES_REQ ECU_ADDRESS 0xd0008e3b BIT_MASK 0x1 /end MEASUREMENT
/begin MEASUREMENT t_state_amt_1_diag "Intervention  in shift phase 1" UWORD _CNV_A_R_LINEAR_____3_CM 1 100. 0. 655.35 DISPLAY_IDENTIFIER T_STATE_AMT_1_DIAG ECU_ADDRESS 0xd000164a FORMAT "%6.2" /end MEASUREMENT
/begin MEASUREMENT t_state_amt_2_diag "Intervention  in shift phase 2" UWORD _CNV_A_R_LINEAR_____3_CM 1 100. 0. 655.35 DISPLAY_IDENTIFIER T_STATE_AMT_2_DIAG ECU_ADDRESS 0xd000164c FORMAT "%6.2" /end MEASUREMENT
/begin MEASUREMENT t_state_amt_3_diag "Intervention  in shift phase 3" UWORD _CNV_A_R_LINEAR_____3_CM 1 100. 0. 655.35 DISPLAY_IDENTIFIER T_STATE_AMT_3_DIAG ECU_ADDRESS 0xd000164e FORMAT "%6.2" /end MEASUREMENT
/begin MEASUREMENT state_err_amt "State of AMT Error intervention" UBYTE _CNV_A_R_LINEAR_____0_CM 1 100. 0. 255. DISPLAY_IDENTIFIER STATE_ERR_AMT ECU_ADDRESS 0xd0008e38 FORMAT "%3.0" /end MEASUREMENT
/begin MEASUREMENT state_amt_old "Previos shift phase3" UBYTE _CNV_A_R_LINEAR_____0_CM 1 100. 0. 3. DISPLAY_IDENTIFIER STATE_AMT_OLD ECU_ADDRESS 0xd0001658 FORMAT "%2.0" /end MEASUREMENT
/begin MEASUREMENT t_state_clu_amt_diag "Timer clutch state " UWORD _CNV_A_R_LINEAR_____3_CM 1 100. 0. 655.35 DISPLAY_IDENTIFIER T_STATE_CLU_AMT_DIAG ECU_ADDRESS 0xd0001654 FORMAT "%6.2" /end MEASUREMENT
/begin CHARACTERISTIC c_vs_fil_amt "Vehicle speed threshold  engine stop" VALUE 0xa080c4be _REC_VAL_20_u2 511.99218 _CNV_A_R_LINEAR_____86_CM 0. 511.99218 DISPLAY_IDENTIFIER C_VS_FIL_AMT FORMAT "%7.3" /end CHARACTERISTIC
/begin CHARACTERISTIC c_t_max_state_amt_1_diag "Max Intervention  in shift phase 1" VALUE 0xa080c1fe _REC_VAL_20_u2 655.35 _CNV_A_R_LINEAR_____3_CM 0. 655.35 DISPLAY_IDENTIFIER C_T_MAX_STATE_AMT_1_DIAG FORMAT "%6.2" /end CHARACTERISTIC
/begin CHARACTERISTIC c_t_max_state_amt_2_diag "Max Intervention  in shift phase 2" VALUE 0xa080c200 _REC_VAL_20_u2 655.35 _CNV_A_R_LINEAR_____3_CM 0. 655.35 DISPLAY_IDENTIFIER C_T_MAX_STATE_AMT_2_DIAG FORMAT "%6.2" /end CHARACTERISTIC
/begin CHARACTERISTIC c_t_max_tqi_amt_diag "Max. timer shift intervention phase 1or 3" VALUE 0xa080c206 _REC_VAL_20_u2 655.35 _CNV_A_R_LINEAR_____3_CM 0. 655.35 DISPLAY_IDENTIFIER C_T_MAX_TQI_AMT_DIAG FORMAT "%6.2" /end CHARACTERISTIC
/begin CHARACTERISTIC c_tqi_amt_diag "Plausibility torque intervention hysteresis" VALUE 0xa080c3a0 _REC_VAL_20_u2 1023.96875 _CNV_A_R_LINEAR_____31_CM 0. 1023.96875 DISPLAY_IDENTIFIER C_TQI_AMT_DIAG FORMAT "%7.2" /end CHARACTERISTIC
/begin CHARACTERISTIC c_tqi_amt_cond_diag "Torque at shift phase 0" VALUE 0xa080c39e _REC_VAL_20_u2 1023.96875 _CNV_A_R_LINEAR_____31_CM 0. 1023.96875 DISPLAY_IDENTIFIER C_TQI_AMT_COND_DIAG FORMAT "%7.2" /end CHARACTERISTIC
/begin CHARACTERISTIC c_tqi_amt_can_es "Torque at engine stop" VALUE 0xa080c39c _REC_VAL_20_u2 1023.96875 _CNV_A_R_LINEAR_____31_CM 0. 1023.96875 DISPLAY_IDENTIFIER C_TQI_AMT_CAN_ES FORMAT "%7.2" /end CHARACTERISTIC
/begin CHARACTERISTIC c_t_max_state_amt_3_diag "Max Intervention  in shift phase 3" VALUE 0xa080c202 _REC_VAL_20_u2 655.35 _CNV_A_R_LINEAR_____3_CM 0. 655.35 DISPLAY_IDENTIFIER C_T_MAX_STATE_AMT_3_DIAG FORMAT "%6.2" /end CHARACTERISTIC
/begin CHARACTERISTIC c_t_max_state_clu_amt_diag "Max. time at clutch" VALUE 0xa080c204 _REC_VAL_20_u2 655.35 _CNV_A_R_LINEAR_____3_CM 0. 655.35 DISPLAY_IDENTIFIER C_T_MAX_STATE_CLU_AMT_DIAG FORMAT "%6.2" /end CHARACTERISTIC
/begin MEASUREMENT tqi_amt_plaus "Plausibility torque" UWORD _CNV_A_R_LINEAR_____31_CM 1 100. 0. 1023.96875 DISPLAY_IDENTIFIER TQI_AMT_PLAUS ECU_ADDRESS 0xd0001648 FORMAT "%7.2" /end MEASUREMENT
/begin CHARACTERISTIC c_tia_max_tecu_diag "TIA threshold - TECU diagnosis" VALUE 0xa080c32b _REC_VAL_20_u1 190.5 _CNV_A_R_LINEAR_____17_CM -48. 142.5 DISPLAY_IDENTIFIER C_TIA_MAX_TECU_DIAG FORMAT "%5.1" /end CHARACTERISTIC
/begin CHARACTERISTIC c_abc_max_tecu "Maximum value of the anti - bounce counter" VALUE 0xa080ba51 _REC_VAL_20_u1 254. _CNV_A_R_LINEAR_____0_CM 1. 255. DISPLAY_IDENTIFIER C_ABC_MAX_TECU FORMAT "%3.0" /end CHARACTERISTIC
/begin CHARACTERISTIC c_abc_inc_tecu "Anti - bounce counter increment" VALUE 0xa080b988 _REC_VAL_20_u1 255. _CNV_A_R_LINEAR_____0_CM 0. 255. DISPLAY_IDENTIFIER C_ABC_INC_TECU FORMAT "%3.0" /end CHARACTERISTIC
/begin CHARACTERISTIC c_vp_tecu_min_diag "VP_TECU threshold for short to ground - TECU diagnosis" VALUE 0xa080c476 _REC_VAL_20_u2 4.999847 _CNV_A_R_LINEAR_____172_CM 0. 4.999847 DISPLAY_IDENTIFIER C_VP_TECU_MIN_DIAG FORMAT "%6.4" /end CHARACTERISTIC
/begin CHARACTERISTIC c_vp_tecu_max_diag "VP_TECU threshold for short to VB or line break - TECU diagnosis" VALUE 0xa080c474 _REC_VAL_20_u2 4.999847 _CNV_A_R_LINEAR_____172_CM 0. 4.999847 DISPLAY_IDENTIFIER C_VP_TECU_MAX_DIAG FORMAT "%6.4" /end CHARACTERISTIC
/begin CHARACTERISTIC c_t_dly_tecu_diag "Delay time for diagnosis activation" VALUE 0xa080c18a _REC_VAL_20_u2 32767.5 _CNV_A_R_LINEAR_____19_CM 0. 32767.5 DISPLAY_IDENTIFIER C_T_DLY_TECU_DIAG FORMAT "%6.1" /end CHARACTERISTIC
/begin CHARACTERISTIC c_abc_inc_teg_pcat_down "debounce counter increment-TEG diagnosis" VALUE 0xa080b989 _REC_VAL_20_u1 255. _CNV_A_R_LINEAR_____0_CM 0. 255. DISPLAY_IDENTIFIER C_ABC_INC_TEG_PCAT_DOWN FORMAT "%3.0" /end CHARACTERISTIC
/begin CHARACTERISTIC c_abc_max_teg_pcat_down "debounce counter maximumt-TEG diagnosis" VALUE 0xa080ba52 _REC_VAL_20_u1 254. _CNV_A_R_LINEAR_____0_CM 1. 255. DISPLAY_IDENTIFIER C_ABC_MAX_TEG_PCAT_DOWN FORMAT "%3.0" /end CHARACTERISTIC
/begin CHARACTERISTIC c_abc_inc_tia_plaus "Anti - bounce increment TIA_PLAUS diagnosis" VALUE 0xa080b98c _REC_VAL_20_u1 255. _CNV_A_R_LINEAR_____0_CM 0. 255. DISPLAY_IDENTIFIER C_ABC_INC_TIA_PLAUS FORMAT "%3.0" /end CHARACTERISTIC
/begin CHARACTERISTIC c_abc_max_tia_plaus "Anti - bounce maximum TIA_PLAUS diagnosis" VALUE 0xa080ba55 _REC_VAL_20_u1 254. _CNV_A_R_LINEAR_____0_CM 1. 255. DISPLAY_IDENTIFIER C_ABC_MAX_TIA_PLAUS FORMAT "%3.0" /end CHARACTERISTIC
/begin MEASUREMENT lv_err_mtc_ctl_1 "Logical variable (set. if a MTCPWM error is present)" UBYTE _CNV_S_2_RANGE__0___1_CM 1 100. 0. 1. DISPLAY_IDENTIFIER LV_ERR_MTC_CTL_1 ECU_ADDRESS 0xd0007f40 BIT_MASK 0x1 /end MEASUREMENT
/begin CHARACTERISTIC c_abc_inc_tq_req_can "Anti bounce increment value, TQ-plausibility via CAN" VALUE 0xa080b991 _REC_VAL_20_u1 255. _CNV_A_R_LINEAR_____0_CM 0. 255. DISPLAY_IDENTIFIER C_ABC_INC_TQ_REQ_CAN FORMAT "%3.0" /end CHARACTERISTIC
/begin CHARACTERISTIC c_abc_max_tq_req_can "Anti-bounce max. value, TQ-plausibility via CAN" VALUE 0xa080ba5a _REC_VAL_20_u1 254. _CNV_A_R_LINEAR_____0_CM 1. 255. DISPLAY_IDENTIFIER C_ABC_MAX_TQ_REQ_CAN FORMAT "%3.0" /end CHARACTERISTIC
/begin CHARACTERISTIC c_abc_inc_tqi_lim "Increment counter for torque request for safety" VALUE 0xa080b992 _REC_VAL_20_u1 255. _CNV_A_R_LINEAR_____0_CM 0. 255. DISPLAY_IDENTIFIER C_ABC_INC_TQI_LIM FORMAT "%3.0" /end CHARACTERISTIC
/begin CHARACTERISTIC c_abc_max_tqi_lim "Maximum counter for torque request for safety" VALUE 0xa080ba5b _REC_VAL_20_u1 254. _CNV_A_R_LINEAR_____0_CM 1. 255. DISPLAY_IDENTIFIER C_ABC_MAX_TQI_LIM FORMAT "%3.0" /end CHARACTERISTIC
/begin MEASUREMENT lv_err_tqi_lim "Error flag torque request for safety is active" UBYTE _CNV_S_2_RANGE__0___1_CM 1 100. 0. 1. DISPLAY_IDENTIFIER LV_ERR_TQI_LIM ECU_ADDRESS 0xd0007f7e BIT_MASK 0x1 /end MEASUREMENT
/begin CHARACTERISTIC c_abc_max_vs "ABC maximum value for VS diagnosis" VALUE 0xa080ba60 _REC_VAL_20_u1 254. _CNV_A_R_LINEAR_____0_CM 1. 255. DISPLAY_IDENTIFIER C_ABC_MAX_VS FORMAT "%3.0" /end CHARACTERISTIC
/begin CHARACTERISTIC c_abc_inc_vs "ABC increment value for VS diagnosis" VALUE 0xa080b997 _REC_VAL_20_u1 255. _CNV_A_R_LINEAR_____0_CM 0. 255. DISPLAY_IDENTIFIER C_ABC_INC_VS FORMAT "%3.0" /end CHARACTERISTIC
/begin CHARACTERISTIC c_abc_max_cwp_int_off "Debounce threshold for internal shut off errors CWP" VALUE 0xa080b9f4 _REC_VAL_20_u1 254. _CNV_A_R_LINEAR_____0_CM 1. 255. DISPLAY_IDENTIFIER C_ABC_MAX_CWP_INT_OFF FORMAT "%3.0" /end CHARACTERISTIC
/begin CHARACTERISTIC c_abc_inc_cwp_pwr "CWP internal Diagnosis increment" VALUE 0xa080b92d _REC_VAL_20_u1 255. _CNV_A_R_LINEAR_____435_CM 0. 255. DISPLAY_IDENTIFIER C_ABC_INC_CWP_PWR FORMAT "%3.0" /end CHARACTERISTIC
/begin CHARACTERISTIC c_abc_max_cwp_pwr "Diagnosis increment" VALUE 0xa080b9f5 _REC_VAL_20_u1 254. _CNV_A_R_LINEAR_____0_CM 1. 255. DISPLAY_IDENTIFIER C_ABC_MAX_CWP_PWR FORMAT "%3.0" /end CHARACTERISTIC
/begin CHARACTERISTIC c_abc_inc_cwp_int_off "CWP internal Diagnosis increment" VALUE 0xa080b92c _REC_VAL_20_u1 255. _CNV_A_R_LINEAR_____435_CM 0. 255. DISPLAY_IDENTIFIER C_ABC_INC_CWP_INT_OFF FORMAT "%3.0" /end CHARACTERISTIC
/begin CHARACTERISTIC c_abc_inc_mec_ivvt_in_1 "Debounce counter increment - MEC_IVVT_IN diagnosis" VALUE 0xa080b965 _REC_VAL_20_u1 255. _CNV_A_R_LINEAR_____0_CM 0. 255. DISPLAY_IDENTIFIER C_ABC_INC_MEC_IVVT_IN_1 FORMAT "%3.0" /end CHARACTERISTIC
/begin CHARACTERISTIC c_abc_inc_mec_ivvt_in_2 "Debounce counter increment - MEC_IVVT_IN diagnosis" VALUE 0xa080b966 _REC_VAL_20_u1 255. _CNV_A_R_LINEAR_____0_CM 0. 255. DISPLAY_IDENTIFIER C_ABC_INC_MEC_IVVT_IN_2 FORMAT "%3.0" /end CHARACTERISTIC
/begin CHARACTERISTIC c_abc_max_mec_ivvt_in_1 "Debounce counter maximum value - MEC_IVVT_IN diagnosis" VALUE 0xa080ba2d _REC_VAL_20_u1 254. _CNV_A_R_LINEAR_____0_CM 1. 255. DISPLAY_IDENTIFIER C_ABC_MAX_MEC_IVVT_IN_1 FORMAT "%3.0" /end CHARACTERISTIC
/begin CHARACTERISTIC c_abc_max_mec_ivvt_in_2 "Debounce counter maximum value - MEC_IVVT_IN diagnosis" VALUE 0xa080ba2e _REC_VAL_20_u1 254. _CNV_A_R_LINEAR_____0_CM 1. 255. DISPLAY_IDENTIFIER C_ABC_MAX_MEC_IVVT_IN_2 FORMAT "%3.0" /end CHARACTERISTIC
/begin CHARACTERISTIC c_abc_max_gen "Maximum value debounce counter - Generator error" VALUE 0xa080ba09 _REC_VAL_20_u1 254. _CNV_A_R_LINEAR_____0_CM 1. 255. DISPLAY_IDENTIFIER C_ABC_MAX_GEN FORMAT "%3.0" /end CHARACTERISTIC
/begin CHARACTERISTIC c_abc_inc_gen "Increment debounce counter - Generator error" VALUE 0xa080b941 _REC_VAL_20_u1 255. _CNV_A_R_LINEAR_____0_CM 0. 255. DISPLAY_IDENTIFIER C_ABC_INC_GEN FORMAT "%3.0" /end CHARACTERISTIC
/begin CHARACTERISTIC c_abc_inc_qoil_sens "Debounce counter increment - oil quality diagnosis" VALUE 0xa080b974 _REC_VAL_20_u1 255. _CNV_A_R_LINEAR_____0_CM 0. 255. DISPLAY_IDENTIFIER C_ABC_INC_QOIL_SENS FORMAT "%3.0" /end CHARACTERISTIC
/begin CHARACTERISTIC c_abc_max_qoil_sens "Debounce counter maximum value - oil quality diagnosis" VALUE 0xa080ba3d _REC_VAL_20_u1 254. _CNV_A_R_LINEAR_____0_CM 1. 255. DISPLAY_IDENTIFIER C_ABC_MAX_QOIL_SENS FORMAT "%3.0" /end CHARACTERISTIC
/begin CHARACTERISTIC c_abc_inc_bat_sens_it "Anti bounce increment" VALUE 0xa080b8da _REC_VAL_20_u1 255. _CNV_A_R_LINEAR_____0_CM 0. 255. DISPLAY_IDENTIFIER C_ABC_INC_BAT_SENS_IT FORMAT "%3.0" /end CHARACTERISTIC
/begin CHARACTERISTIC c_abc_inc_bat_sens_it_el "Anti bounce increment" VALUE 0xa080b8db _REC_VAL_20_u1 255. _CNV_A_R_LINEAR_____0_CM 0. 255. DISPLAY_IDENTIFIER C_ABC_INC_BAT_SENS_IT_EL FORMAT "%3.0" /end CHARACTERISTIC
/begin CHARACTERISTIC c_abc_max_bat_sens_it "Anti boune maximum" VALUE 0xa080b9a2 _REC_VAL_20_u1 254. _CNV_A_R_LINEAR_____0_CM 1. 255. DISPLAY_IDENTIFIER C_ABC_MAX_BAT_SENS_IT FORMAT "%3.0" /end CHARACTERISTIC
/begin CHARACTERISTIC c_abc_max_bat_sens_it_el "Anti boune maximum" VALUE 0xa080b9a3 _REC_VAL_20_u1 254. _CNV_A_R_LINEAR_____0_CM 1. 255. DISPLAY_IDENTIFIER C_ABC_MAX_BAT_SENS_IT_EL FORMAT "%3.0" /end CHARACTERISTIC
/begin MEASUREMENT lv_err_bat_sens_it "internal error (component) BAT_SENS" UBYTE _CNV_S_2_RANGE__0___1_CM 1 100. 0. 1. DISPLAY_IDENTIFIER LV_ERR_BAT_SENS_IT ECU_ADDRESS 0xd0007fc0 BIT_MASK 0x1 /end MEASUREMENT
/begin MEASUREMENT lv_err_bat_sens_it_el "internal error (electrical) BAT_SENS" UBYTE _CNV_S_2_RANGE__0___1_CM 1 100. 0. 1. DISPLAY_IDENTIFIER LV_ERR_BAT_SENS_IT_EL ECU_ADDRESS 0xd0007fc1 BIT_MASK 0x1 /end MEASUREMENT
/begin CHARACTERISTIC c_abc_inc_bat_sens "Anti bounce increment" VALUE 0xa080b8d9 _REC_VAL_20_u1 255. _CNV_A_R_LINEAR_____0_CM 0. 255. DISPLAY_IDENTIFIER C_ABC_INC_BAT_SENS FORMAT "%3.0" /end CHARACTERISTIC
/begin CHARACTERISTIC c_abc_inc_alter_bn "Anti bounce increment" VALUE 0xa080b8d2 _REC_VAL_20_u1 255. _CNV_A_R_LINEAR_____0_CM 0. 255. DISPLAY_IDENTIFIER C_ABC_INC_ALTER_BN FORMAT "%3.0" /end CHARACTERISTIC
/begin CHARACTERISTIC c_abc_inc_alter_bn_bat "Anti bounce increment" VALUE 0xa080b8d3 _REC_VAL_20_u1 255. _CNV_A_R_LINEAR_____0_CM 0. 255. DISPLAY_IDENTIFIER C_ABC_INC_ALTER_BN_BAT FORMAT "%3.0" /end CHARACTERISTIC
/begin CHARACTERISTIC c_abc_max_bat_sens "Anti boune maximum" VALUE 0xa080b9a1 _REC_VAL_20_u1 254. _CNV_A_R_LINEAR_____0_CM 1. 255. DISPLAY_IDENTIFIER C_ABC_MAX_BAT_SENS FORMAT "%3.0" /end CHARACTERISTIC
/begin CHARACTERISTIC c_abc_max_alter_bn "Anti boune maximum" VALUE 0xa080b99a _REC_VAL_20_u1 254. _CNV_A_R_LINEAR_____0_CM 1. 255. DISPLAY_IDENTIFIER C_ABC_MAX_ALTER_BN FORMAT "%3.0" /end CHARACTERISTIC
/begin CHARACTERISTIC c_abc_max_alter_bn_bat "Anti boune maximum" VALUE 0xa080b99b _REC_VAL_20_u1 254. _CNV_A_R_LINEAR_____0_CM 1. 255. DISPLAY_IDENTIFIER C_ABC_MAX_ALTER_BN_BAT FORMAT "%3.0" /end CHARACTERISTIC
/begin MEASUREMENT lv_err_bat_sens "communication error BAT_SENS" UBYTE _CNV_S_2_RANGE__0___1_CM 1 100. 0. 1. DISPLAY_IDENTIFIER LV_ERR_BAT_SENS ECU_ADDRESS 0xd0007fbf BIT_MASK 0x1 /end MEASUREMENT
/begin MEASUREMENT lv_err_alter_bn "Boolean for error currently present on PM board network" UBYTE _CNV_S_2_RANGE__0___1_CM 1 100. 0. 1. DISPLAY_IDENTIFIER LV_ERR_ALTER_BN ECU_ADDRESS 0xd0007f43 BIT_MASK 0x1 /end MEASUREMENT
/begin MEASUREMENT lv_err_alter_bn_bat "Boolean for error currently present on PM battery" UBYTE _CNV_S_2_RANGE__0___1_CM 1 100. 0. 1. DISPLAY_IDENTIFIER LV_ERR_ALTER_BN_BAT ECU_ADDRESS 0xd0007f44 BIT_MASK 0x1 /end MEASUREMENT
/begin CHARACTERISTIC c_abc_inc_load_tps_plaus "Anti - bounce counter increment" VALUE 0xa080b956 _REC_VAL_20_u1 255. _CNV_A_R_LINEAR_____0_CM 0. 255. DISPLAY_IDENTIFIER C_ABC_INC_LOAD_TPS_PLAUS FORMAT "%3.0" /end CHARACTERISTIC
/begin CHARACTERISTIC c_abc_max_load_tps_plaus "Maximum value of the anti - bounce counter" VALUE 0xa080ba1e _REC_VAL_20_u1 254. _CNV_A_R_LINEAR_____0_CM 1. 255. DISPLAY_IDENTIFIER C_ABC_MAX_LOAD_TPS_PLAUS FORMAT "%3.0" /end CHARACTERISTIC
/begin CHARACTERISTIC c_abc_inc_map_dip_plaus "Anti - bounce counter increment" VALUE 0xa080b960 _REC_VAL_20_u1 255. _CNV_A_R_LINEAR_____0_CM 0. 255. DISPLAY_IDENTIFIER C_ABC_INC_MAP_DIP_PLAUS FORMAT "%3.0" /end CHARACTERISTIC
/begin CHARACTERISTIC c_abc_max_map_dip_plaus "Maximum value of the anti - bounce counter" VALUE 0xa080ba28 _REC_VAL_20_u1 254. _CNV_A_R_LINEAR_____0_CM 1. 255. DISPLAY_IDENTIFIER C_ABC_MAX_MAP_DIP_PLAUS FORMAT "%3.0" /end CHARACTERISTIC
/begin CHARACTERISTIC c_abc_inc_alter_bn_rgn "Anti - bounce counter increment" VALUE 0xa080b8d4 _REC_VAL_20_u1 255. _CNV_A_R_LINEAR_____0_CM 0. 255. DISPLAY_IDENTIFIER C_ABC_INC_ALTER_BN_RGN FORMAT "%3.0" /end CHARACTERISTIC
/begin CHARACTERISTIC c_abc_max_alter_bn_rgn "Maximum value of the anti - bounce counter" VALUE 0xa080b99c _REC_VAL_20_u1 254. _CNV_A_R_LINEAR_____0_CM 1. 255. DISPLAY_IDENTIFIER C_ABC_MAX_ALTER_BN_RGN FORMAT "%3.0" /end CHARACTERISTIC
/begin CHARACTERISTIC c_abc_dec_load_tps_plaus "Debounce counter decrement value LOAD_TPS_PLAUS Diagnosis" VALUE 0xa080b8d0 _REC_VAL_20_u1 255. _CNV_A_R_LINEAR_____0_CM 0. 255. DISPLAY_IDENTIFIER C_ABC_DEC_LOAD_TPS_PLAUS FORMAT "%3.0" /end CHARACTERISTIC
/begin CHARACTERISTIC c_abc_inc_mec_ivvt_ex "Debounce counter increment - MEC_IVVT_EX diagnosis" VALUE 0xa080b964 _REC_VAL_20_u1 255. _CNV_A_R_LINEAR_____0_CM 0. 255. DISPLAY_IDENTIFIER C_ABC_INC_MEC_IVVT_EX FORMAT "%3.0" /end CHARACTERISTIC
/begin CHARACTERISTIC c_abc_max_mec_ivvt_ex "Debounce counter maximum value - MEC_IVVT_EX diagnosis" VALUE 0xa080ba2c _REC_VAL_20_u1 254. _CNV_A_R_LINEAR_____0_CM 1. 255. DISPLAY_IDENTIFIER C_ABC_MAX_MEC_IVVT_EX FORMAT "%3.0" /end CHARACTERISTIC
/begin CHARACTERISTIC c_abc_inc_toil_level "Debounce counter increment - TOIL_LEVEL diagnosis" VALUE 0xa080b98e _REC_VAL_20_u1 255. _CNV_A_R_LINEAR_____0_CM 0. 255. DISPLAY_IDENTIFIER C_ABC_INC_TOIL_LEVEL FORMAT "%3.0" /end CHARACTERISTIC
/begin CHARACTERISTIC c_abc_max_toil_level "Debounce counter maximum value - TOIL_LEVEL diagnosis" VALUE 0xa080ba57 _REC_VAL_20_u1 254. _CNV_A_R_LINEAR_____0_CM 1. 255. DISPLAY_IDENTIFIER C_ABC_MAX_TOIL_LEVEL FORMAT "%3.0" /end CHARACTERISTIC
/begin CHARACTERISTIC c_abc_inc_poil_ctl_stat "Debounce counter increment POIL_CTL_STAT diagnosis" VALUE 0xa080b96a _REC_VAL_20_u1 255. _CNV_A_R_LINEAR_____0_CM 0. 255. DISPLAY_IDENTIFIER C_ABC_INC_POIL_CTL_STAT FORMAT "%3.0" /end CHARACTERISTIC
/begin CHARACTERISTIC c_abc_inc_poil_ctl_dyn "Debounce counter increment POIL_CTL_DYN diagnosis" VALUE 0xa080b969 _REC_VAL_20_u1 255. _CNV_A_R_LINEAR_____0_CM 0. 255. DISPLAY_IDENTIFIER C_ABC_INC_POIL_CTL_DYN FORMAT "%3.0" /end CHARACTERISTIC
/begin CHARACTERISTIC c_abc_max_poil_ctl_stat "Debounce counter maximum value POIL_CTL_STAT diagnosis" VALUE 0xa080ba32 _REC_VAL_20_u1 254. _CNV_A_R_LINEAR_____0_CM 1. 255. DISPLAY_IDENTIFIER C_ABC_MAX_POIL_CTL_STAT FORMAT "%3.0" /end CHARACTERISTIC
/begin CHARACTERISTIC c_abc_max_poil_ctl_dyn "Debounce counter maximum value POIL_CTL_DYN diagnosis" VALUE 0xa080ba31 _REC_VAL_20_u1 254. _CNV_A_R_LINEAR_____0_CM 1. 255. DISPLAY_IDENTIFIER C_ABC_MAX_POIL_CTL_DYN FORMAT "%3.0" /end CHARACTERISTIC
/begin CHARACTERISTIC c_abc_inc_amp_plaus_cus "Anti - bounce counter increment" VALUE 0xa080b8d8 _REC_VAL_20_u1 255. _CNV_A_R_LINEAR_____0_CM 0. 255. DISPLAY_IDENTIFIER C_ABC_INC_AMP_PLAUS_CUS FORMAT "%3.0" /end CHARACTERISTIC
/begin CHARACTERISTIC c_abc_max_amp_plaus_cus "Maximum value of the anti - bounce counter" VALUE 0xa080b9a0 _REC_VAL_20_u1 254. _CNV_A_R_LINEAR_____0_CM 1. 255. DISPLAY_IDENTIFIER C_ABC_MAX_AMP_PLAUS_CUS FORMAT "%3.0" /end CHARACTERISTIC
/begin CHARACTERISTIC c_abc_inc_tcha_prs_low "Debounce counter increment charger pressure to low diagnosis" VALUE 0xa080b987 _REC_VAL_20_u1 255. _CNV_A_R_LINEAR_____0_CM 0. 255. DISPLAY_IDENTIFIER C_ABC_INC_TCHA_PRS_LOW FORMAT "%3.0" /end CHARACTERISTIC
/begin CHARACTERISTIC c_abc_inc_tcha_leak "Debounce counter increment charger leakage diagnosis" VALUE 0xa080b984 _REC_VAL_20_u1 255. _CNV_A_R_LINEAR_____0_CM 0. 255. DISPLAY_IDENTIFIER C_ABC_INC_TCHA_LEAK FORMAT "%3.0" /end CHARACTERISTIC
/begin CHARACTERISTIC c_abc_inc_tcha_prs_dif "Debounce counter increment charger pressure difference diagnosis" VALUE 0xa080b985 _REC_VAL_20_u1 255. _CNV_A_R_LINEAR_____0_CM 0. 255. DISPLAY_IDENTIFIER C_ABC_INC_TCHA_PRS_DIF FORMAT "%3.0" /end CHARACTERISTIC
/begin CHARACTERISTIC c_abc_inc_tcha_prs_high "Debounce counter increment charger pressure to high diagnosis" VALUE 0xa080b986 _REC_VAL_20_u1 255. _CNV_A_R_LINEAR_____0_CM 0. 255. DISPLAY_IDENTIFIER C_ABC_INC_TCHA_PRS_HIGH FORMAT "%3.0" /end CHARACTERISTIC
/begin CHARACTERISTIC c_abc_max_tcha_prs_low "Debounce counter maximum charger pressure to low diagnosis" VALUE 0xa080ba50 _REC_VAL_20_u1 254. _CNV_A_R_LINEAR_____0_CM 1. 255. DISPLAY_IDENTIFIER C_ABC_MAX_TCHA_PRS_LOW FORMAT "%3.0" /end CHARACTERISTIC
/begin CHARACTERISTIC c_abc_max_tcha_leak "Debounce counter maximum charger leakage diagnosis" VALUE 0xa080ba4d _REC_VAL_20_u1 254. _CNV_A_R_LINEAR_____0_CM 1. 255. DISPLAY_IDENTIFIER C_ABC_MAX_TCHA_LEAK FORMAT "%3.0" /end CHARACTERISTIC
/begin CHARACTERISTIC c_abc_max_tcha_prs_dif "Debounce counter maximum charger pressure difference diagnosis" VALUE 0xa080ba4e _REC_VAL_20_u1 254. _CNV_A_R_LINEAR_____0_CM 1. 255. DISPLAY_IDENTIFIER C_ABC_MAX_TCHA_PRS_DIF FORMAT "%3.0" /end CHARACTERISTIC
/begin CHARACTERISTIC c_abc_max_tcha_prs_high "Debounce counter maximum charger pressure to high diagnosis" VALUE 0xa080ba4f _REC_VAL_20_u1 254. _CNV_A_R_LINEAR_____0_CM 1. 255. DISPLAY_IDENTIFIER C_ABC_MAX_TCHA_PRS_HIGH FORMAT "%3.0" /end CHARACTERISTIC
/begin CHARACTERISTIC c_abc_inc_put_plaus "Anti - bounce counter increment" VALUE 0xa080b96e _REC_VAL_20_u1 255. _CNV_A_R_LINEAR_____0_CM 0. 255. DISPLAY_IDENTIFIER C_ABC_INC_PUT_PLAUS FORMAT "%3.0" /end CHARACTERISTIC
/begin CHARACTERISTIC c_abc_max_put_plaus "Maximum value of the anti - bounce counter" VALUE 0xa080ba37 _REC_VAL_20_u1 254. _CNV_A_R_LINEAR_____0_CM 1. 255. DISPLAY_IDENTIFIER C_ABC_MAX_PUT_PLAUS FORMAT "%3.0" /end CHARACTERISTIC
/begin CHARACTERISTIC c_abc_inc_map_plaus "Anti - bounce counter increment" VALUE 0xa080b961 _REC_VAL_20_u1 255. _CNV_A_R_LINEAR_____0_CM 0. 255. DISPLAY_IDENTIFIER C_ABC_INC_MAP_PLAUS FORMAT "%3.0" /end CHARACTERISTIC
/begin CHARACTERISTIC c_abc_max_map_plaus "Maximum value of the anti - bounce counter" VALUE 0xa080ba29 _REC_VAL_20_u1 254. _CNV_A_R_LINEAR_____0_CM 1. 255. DISPLAY_IDENTIFIER C_ABC_MAX_MAP_PLAUS FORMAT "%3.0" /end CHARACTERISTIC
/begin CHARACTERISTIC c_abc_inc_tq_cst "Anti - bounce counter increment" VALUE 0xa080b990 _REC_VAL_20_u1 255. _CNV_A_R_LINEAR_____0_CM 0. 255. DISPLAY_IDENTIFIER C_ABC_INC_TQ_CST FORMAT "%3.0" /end CHARACTERISTIC
/begin CHARACTERISTIC c_abc_max_tq_cst "Maximum value of the anti - bounce counter" VALUE 0xa080ba59 _REC_VAL_20_u1 254. _CNV_A_R_LINEAR_____0_CM 1. 255. DISPLAY_IDENTIFIER C_ABC_MAX_TQ_CST FORMAT "%3.0" /end CHARACTERISTIC
/begin CHARACTERISTIC c_abc_inc_gen_el "Anti - bounce counter increment" VALUE 0xa080b945 _REC_VAL_20_u1 255. _CNV_A_R_LINEAR_____0_CM 0. 255. DISPLAY_IDENTIFIER C_ABC_INC_GEN_EL FORMAT "%3.0" /end CHARACTERISTIC
/begin CHARACTERISTIC c_abc_inc_gen_mec "Anti - bounce counter increment" VALUE 0xa080b948 _REC_VAL_20_u1 255. _CNV_A_R_LINEAR_____0_CM 0. 255. DISPLAY_IDENTIFIER C_ABC_INC_GEN_MEC FORMAT "%3.0" /end CHARACTERISTIC
/begin CHARACTERISTIC c_abc_inc_gen_h_temp "Anti - bounce counter increment" VALUE 0xa080b946 _REC_VAL_20_u1 255. _CNV_A_R_LINEAR_____0_CM 0. 255. DISPLAY_IDENTIFIER C_ABC_INC_GEN_H_TEMP FORMAT "%3.0" /end CHARACTERISTIC
/begin CHARACTERISTIC c_abc_inc_gen_typ_not_plaus "Anti - bounce counter increment" VALUE 0xa080b94a _REC_VAL_20_u1 255. _CNV_A_R_LINEAR_____0_CM 0. 255. DISPLAY_IDENTIFIER C_ABC_INC_GEN_TYP_NOT_PLAUS FORMAT "%3.0" /end CHARACTERISTIC
/begin CHARACTERISTIC c_abc_inc_gen_msg_lost "Anti - bounce counter increment" VALUE 0xa080b949 _REC_VAL_20_u1 255. _CNV_A_R_LINEAR_____0_CM 0. 255. DISPLAY_IDENTIFIER C_ABC_INC_GEN_MSG_LOST FORMAT "%3.0" /end CHARACTERISTIC
/begin CHARACTERISTIC c_abc_inc_gen_clc_v_not_plaus "Anti - bounce counter increment" VALUE 0xa080b942 _REC_VAL_20_u1 255. _CNV_A_R_LINEAR_____0_CM 0. 255. DISPLAY_IDENTIFIER C_ABC_INC_GEN_CLC_V_NOT_PLAUS FORMAT "%3.0" /end CHARACTERISTIC
/begin CHARACTERISTIC c_abc_inc_gen_h_temp_clc "Anti - bounce counter increment" VALUE 0xa080b947 _REC_VAL_20_u1 255. _CNV_A_R_LINEAR_____0_CM 0. 255. DISPLAY_IDENTIFIER C_ABC_INC_GEN_H_TEMP_CLC FORMAT "%3.0" /end CHARACTERISTIC
/begin CHARACTERISTIC c_abc_inc_gen_ctl_not_plaus "Anti - bounce counter increment" VALUE 0xa080b943 _REC_VAL_20_u1 255. _CNV_A_R_LINEAR_____0_CM 0. 255. DISPLAY_IDENTIFIER C_ABC_INC_GEN_CTL_NOT_PLAUS FORMAT "%3.0" /end CHARACTERISTIC
/begin CHARACTERISTIC c_abc_max_gen_el "Maximum value of the anti - bounce counter" VALUE 0xa080ba0d _REC_VAL_20_u1 254. _CNV_A_R_LINEAR_____0_CM 1. 255. DISPLAY_IDENTIFIER C_ABC_MAX_GEN_EL FORMAT "%3.0" /end CHARACTERISTIC
/begin CHARACTERISTIC c_abc_max_gen_mec "Maximum value of the anti - bounce counter" VALUE 0xa080ba10 _REC_VAL_20_u1 254. _CNV_A_R_LINEAR_____0_CM 1. 255. DISPLAY_IDENTIFIER C_ABC_MAX_GEN_MEC FORMAT "%3.0" /end CHARACTERISTIC
/begin CHARACTERISTIC c_abc_max_gen_h_temp "Maximum value of the anti - bounce counter" VALUE 0xa080ba0e _REC_VAL_20_u1 254. _CNV_A_R_LINEAR_____0_CM 1. 255. DISPLAY_IDENTIFIER C_ABC_MAX_GEN_H_TEMP FORMAT "%3.0" /end CHARACTERISTIC
/begin CHARACTERISTIC c_abc_max_gen_typ_not_plaus "Maximum value of the anti - bounce counter" VALUE 0xa080ba12 _REC_VAL_20_u1 254. _CNV_A_R_LINEAR_____0_CM 1. 255. DISPLAY_IDENTIFIER C_ABC_MAX_GEN_TYP_NOT_PLAUS FORMAT "%3.0" /end CHARACTERISTIC
/begin CHARACTERISTIC c_abc_max_gen_msg_lost "Maximum value of the anti - bounce counter" VALUE 0xa080ba11 _REC_VAL_20_u1 254. _CNV_A_R_LINEAR_____0_CM 1. 255. DISPLAY_IDENTIFIER C_ABC_MAX_GEN_MSG_LOST FORMAT "%3.0" /end CHARACTERISTIC
/begin CHARACTERISTIC c_abc_max_gen_clc_v_not_plaus "Maximum value of the anti - bounce counter" VALUE 0xa080ba0a _REC_VAL_20_u1 254. _CNV_A_R_LINEAR_____0_CM 1. 255. DISPLAY_IDENTIFIER C_ABC_MAX_GEN_CLC_V_NOT_PLAUS FORMAT "%3.0" /end CHARACTERISTIC
/begin CHARACTERISTIC c_abc_max_gen_h_temp_clc "Maximum value of the anti - bounce counter" VALUE 0xa080ba0f _REC_VAL_20_u1 254. _CNV_A_R_LINEAR_____0_CM 1. 255. DISPLAY_IDENTIFIER C_ABC_MAX_GEN_H_TEMP_CLC FORMAT "%3.0" /end CHARACTERISTIC
/begin CHARACTERISTIC c_abc_max_gen_ctl_not_plaus "Maximum value of the anti - bounce counter" VALUE 0xa080ba0b _REC_VAL_20_u1 254. _CNV_A_R_LINEAR_____0_CM 1. 255. DISPLAY_IDENTIFIER C_ABC_MAX_GEN_CTL_NOT_PLAUS FORMAT "%3.0" /end CHARACTERISTIC
/begin CHARACTERISTIC c_abc_inc_gs "Anti - bounce increment for GS diagnosis" VALUE 0xa080b94b _REC_VAL_20_u1 255. _CNV_A_R_LINEAR_____0_CM 0. 255. DISPLAY_IDENTIFIER C_ABC_INC_GS FORMAT "%3.0" /end CHARACTERISTIC
/begin CHARACTERISTIC c_abc_dec_gs "Anti - bounce decrement for GS diagnosis" VALUE 0xa080b8cc _REC_VAL_20_u1 255. _CNV_A_R_LINEAR_____0_CM 0. 255. DISPLAY_IDENTIFIER C_ABC_DEC_GS FORMAT "%3.0" /end CHARACTERISTIC
/begin CHARACTERISTIC c_abc_max_gs "anti - bounce maximum for GS diagnosis" VALUE 0xa080ba13 _REC_VAL_20_u1 254. _CNV_A_R_LINEAR_____0_CM 1. 255. DISPLAY_IDENTIFIER C_ABC_MAX_GS FORMAT "%3.0" /end CHARACTERISTIC
/begin CHARACTERISTIC c_abc_inc_plaus_igk_bn "Anti - bounce counter increment BN2000 Diagnosis" VALUE 0xa080b967 _REC_VAL_20_u1 255. _CNV_A_R_LINEAR_____0_CM 0. 255. DISPLAY_IDENTIFIER C_ABC_INC_PLAUS_IGK_BN FORMAT "%3.0" /end CHARACTERISTIC
/begin CHARACTERISTIC c_abc_max_plaus_igk_bn "Maximum value of the anti - bounce counter BN2000 diagnosis" VALUE 0xa080ba2f _REC_VAL_20_u1 254. _CNV_A_R_LINEAR_____0_CM 1. 255. DISPLAY_IDENTIFIER C_ABC_MAX_PLAUS_IGK_BN FORMAT "%3.0" /end CHARACTERISTIC
/begin CHARACTERISTIC c_vb_min_igk_diag "VB threshold for de-/activation of IGK-diagnosis" VALUE 0xa080c42b _REC_VAL_20_u1 25.8984 _CNV_A_R_LINEAR_____22_CM 0. 25.8984 DISPLAY_IDENTIFIER C_VB_MIN_IGK_DIAG FORMAT "%3.1" /end CHARACTERISTIC
/begin CHARACTERISTIC c_abc_max_spi_mps "Anti bounce maxi,um SPI_MPS diagnosis" VALUE 0xa080ba4a _REC_VAL_20_u1 254. _CNV_A_R_LINEAR_____0_CM 1. 255. DISPLAY_IDENTIFIER C_ABC_MAX_SPI_MPS FORMAT "%3.0" /end CHARACTERISTIC
/begin CHARACTERISTIC c_abc_max_spi_knk "Anti bounce maxi,um SPI_KNK diagnosis" VALUE 0xa080ba49 _REC_VAL_20_u1 254. _CNV_A_R_LINEAR_____0_CM 1. 255. DISPLAY_IDENTIFIER C_ABC_MAX_SPI_KNK FORMAT "%3.0" /end CHARACTERISTIC
/begin CHARACTERISTIC c_abc_inc_spi_mps "Antibounce increment SPI_MPS diagnosis" VALUE 0xa080b981 _REC_VAL_20_u1 255. _CNV_A_R_LINEAR_____0_CM 0. 255. DISPLAY_IDENTIFIER C_ABC_INC_SPI_MPS FORMAT "%3.0" /end CHARACTERISTIC
/begin CHARACTERISTIC c_abc_inc_spi_knk "Antibounce increment SPI_KNK diagnosis" VALUE 0xa080b980 _REC_VAL_20_u1 255. _CNV_A_R_LINEAR_____0_CM 0. 255. DISPLAY_IDENTIFIER C_ABC_INC_SPI_KNK FORMAT "%3.0" /end CHARACTERISTIC
/begin CHARACTERISTIC c_abc_inc_gen_diag "Increment debounce counter - Generator switch off " VALUE 0xa080b944 _REC_VAL_20_u1 255. _CNV_A_R_LINEAR_____0_CM 0. 255. DISPLAY_IDENTIFIER C_ABC_INC_GEN_DIAG FORMAT "%3.0" /end CHARACTERISTIC
/begin CHARACTERISTIC c_abc_max_gen_diag "Maximum value debounce counter - Generator switch off diagnosis" VALUE 0xa080ba0c _REC_VAL_20_u1 254. _CNV_A_R_LINEAR_____0_CM 1. 255. DISPLAY_IDENTIFIER C_ABC_MAX_GEN_DIAG FORMAT "%3.0" /end CHARACTERISTIC
/begin CHARACTERISTIC c_abc_inc_tout_nox_sens "Debounce counter increment - diagnosis of timeout CAN message NOX_SENS" VALUE 0xa080b98f _REC_VAL_20_u1 255. _CNV_A_R_LINEAR_____0_CM 0. 255. DISPLAY_IDENTIFIER C_ABC_INC_TOUT_NOX_SENS FORMAT "%3.0" /end CHARACTERISTIC
/begin CHARACTERISTIC c_abc_max_tout_nox_sens "debounce counter maximum value - diagnosis of timeout CAN message NOX_SENS" VALUE 0xa080ba58 _REC_VAL_20_u1 254. _CNV_A_R_LINEAR_____0_CM 1. 255. DISPLAY_IDENTIFIER C_ABC_MAX_TOUT_NOX_SENS FORMAT "%3.0" /end CHARACTERISTIC
/begin CHARACTERISTIC c_abc_inc_t_es "Anti - bounce counter increment" VALUE 0xa080b982 _REC_VAL_20_u1 255. _CNV_A_R_LINEAR_____0_CM 0. 255. DISPLAY_IDENTIFIER C_ABC_INC_T_ES FORMAT "%3.0" /end CHARACTERISTIC
/begin CHARACTERISTIC c_abc_max_t_es "Anti - bounce counter increment" VALUE 0xa080ba4b _REC_VAL_20_u1 254. _CNV_A_R_LINEAR_____0_CM 1. 255. DISPLAY_IDENTIFIER C_ABC_MAX_T_ES FORMAT "%3.0" /end CHARACTERISTIC
/begin CHARACTERISTIC c_abc_inc_ftl_le_can "increment for debouncing diagnosis" VALUE 0xa080b93b _REC_VAL_20_u1 255. _CNV_A_R_LINEAR_____0_CM 0. 255. DISPLAY_IDENTIFIER C_ABC_INC_FTL_LE_CAN FORMAT "%3.0" /end CHARACTERISTIC
/begin CHARACTERISTIC c_abc_inc_ftl_ri_can "increment for debouncing diagnosis" VALUE 0xa080b93d _REC_VAL_20_u1 255. _CNV_A_R_LINEAR_____0_CM 0. 255. DISPLAY_IDENTIFIER C_ABC_INC_FTL_RI_CAN FORMAT "%3.0" /end CHARACTERISTIC
/begin CHARACTERISTIC c_abc_max_ftl_le_can "max threshold for diagnosis" VALUE 0xa080ba03 _REC_VAL_20_u1 254. _CNV_A_R_LINEAR_____0_CM 1. 255. DISPLAY_IDENTIFIER C_ABC_MAX_FTL_LE_CAN FORMAT "%3.0" /end CHARACTERISTIC
/begin CHARACTERISTIC c_abc_max_ftl_ri_can "max threshold for diagnosis" VALUE 0xa080ba05 _REC_VAL_20_u1 254. _CNV_A_R_LINEAR_____0_CM 1. 255. DISPLAY_IDENTIFIER C_ABC_MAX_FTL_RI_CAN FORMAT "%3.0" /end CHARACTERISTIC
/begin MEASUREMENT lv_sens_bat_smt_act "Communication to IBS has been detected as alive" UBYTE _CNV_S_2_RANGE__0___1_CM 1 100. 0. 1. DISPLAY_IDENTIFIER LV_SENS_BAT_SMT_ACT ECU_ADDRESS 0xd00087cf BIT_MASK 0x1 /end MEASUREMENT
/begin MEASUREMENT bsd_sens_bat_smt_info "Content of register [BSD_SENS_BAT_SMT_ADR]" UBYTE _CNV_A_R_LINEAR_____0_CM 1 100. 0. 255. DISPLAY_IDENTIFIER BSD_SENS_BAT_SMT_INFO ECU_ADDRESS 0xd00087cc FORMAT "%3.0" /end MEASUREMENT
/begin MEASUREMENT bsd_sens_bat_smt_adr "Actual register number" UBYTE _CNV_A_R_LINEAR_____0_CM 1 100. 0. 255. DISPLAY_IDENTIFIER BSD_SENS_BAT_SMT_ADR ECU_ADDRESS 0xd00087cd FORMAT "%3.0" /end MEASUREMENT
/begin MEASUREMENT lf_bsd_sens_bat_smt_ctl "Communication coordination byte (logical field)" UBYTE _CNV_A_R_LINEAR_____0_CM 1 100. 0. 255. DISPLAY_IDENTIFIER LF_BSD_SENS_BAT_SMT_CTL ECU_ADDRESS 0xd00087ce FORMAT "%3.0" /end MEASUREMENT
/begin AXIS_PTS ldp_idx_bsd_sdl_tbl "" 0xa0808794 online_dummy _REC_AXS_20_u1 255. _CNV_A_R_LINEAR_____0_CM 32 0. 255. FORMAT "%3.0" /end AXIS_PTS
/begin CHARACTERISTIC id_state_bsd_sdl_tbl "BSD component device scheduling timimg table" CURVE 0xa0809df0 _REC_CUR_20_u1_u1 255. _CNV_A_R_LINEAR_____0_CM 0. 255. DISPLAY_IDENTIFIER ID_STATE_BSD_SDL_TBL FORMAT "%3.0"
 /begin AXIS_DESCR COM_AXIS online_dummy _CNV_A_R_LINEAR_____0_CM 32 0. 255. FORMAT "%3.0" AXIS_PTS_REF ldp_idx_bsd_sdl_tbl /end AXIS_DESCR
/end CHARACTERISTIC
/begin CHARACTERISTIC c_state_bsd_cpt_det "BSD Devices, which are set by default (bit coded! 1 = not to be learnt)" VALUE 0xa080c0bd _REC_VAL_20_u1 255. _CNV_A_R_LINEAR_____0_CM 0. 255. DISPLAY_IDENTIFIER C_STATE_BSD_CPT_DET FORMAT "%3.0" /end CHARACTERISTIC
/begin CHARACTERISTIC c_state_bsd_cpt_avl "Actual  used BSD Devices (bit coded! 1 = used)" VALUE 0xa080c0bc _REC_VAL_20_u1 255. _CNV_A_R_LINEAR_____0_CM 0. 255. DISPLAY_IDENTIFIER C_STATE_BSD_CPT_AVL FORMAT "%3.0" /end CHARACTERISTIC
/begin CHARACTERISTIC c_ctr_bsd_cpt_det "Number of required consecutive positive acknowledges to get a component learnt" VALUE 0xa080bb22 _REC_VAL_20_u1 255. _CNV_A_R_LINEAR_____0_CM 0. 255. DISPLAY_IDENTIFIER C_CTR_BSD_CPT_DET FORMAT "%3.0" /end CHARACTERISTIC
/begin MEASUREMENT lv_sens_bat_smt_det "IBS has been detected " UBYTE _CNV_S_2_RANGE__0___1_CM 1 100. 0. 1. DISPLAY_IDENTIFIER LV_SENS_BAT_SMT_DET ECU_ADDRESS 0xd000861a BIT_MASK 0x1 /end MEASUREMENT
/begin MEASUREMENT lf_bsd_cpt_avl "logical data field displaying the learnt and configured BSD devices" UBYTE _CNV_A_R_LINEAR_____0_CM 1 100. 0. 255. DISPLAY_IDENTIFIER LF_BSD_CPT_AVL ECU_ADDRESS 0xd0008617 FORMAT "%3.0" /end MEASUREMENT
/begin MEASUREMENT state_bsd_com "Actual status of the communication between ECU and BSD devices" UBYTE _CNV_A_R_LINEAR_____0_CM 1 100. 0. 255. DISPLAY_IDENTIFIER STATE_BSD_COM ECU_ADDRESS 0xd0008616 FORMAT "%3.0" /end MEASUREMENT
/begin MEASUREMENT lv_alter_com_act "Flag indication communication on BSD to alternator disturbed" UBYTE _CNV_S_2_RANGE__0___1_CM 1 100. 0. 1. DISPLAY_IDENTIFIER LV_ALTER_COM_ACT ECU_ADDRESS 0xd0008637 BIT_MASK 0x1 /end MEASUREMENT
/begin MEASUREMENT lv_cwp_com_act "Flag indication communication on BSD to coolant water pump disturbed" UBYTE _CNV_S_2_RANGE__0___1_CM 1 100. 0. 1. DISPLAY_IDENTIFIER LV_CWP_COM_ACT ECU_ADDRESS 0xd000872a BIT_MASK 0x1 /end MEASUREMENT
/begin MEASUREMENT lv_qoil_com_act "Flag indication communication on BSD to oil quality sensor disturbed" UBYTE _CNV_S_2_RANGE__0___1_CM 1 100. 0. 1. DISPLAY_IDENTIFIER LV_QOIL_COM_ACT ECU_ADDRESS 0xd00087c8 BIT_MASK 0x1 /end MEASUREMENT
/begin MEASUREMENT lv_sens_bat_smt_com_act "Flag indication communication on BSD to intelligent battery sensor disturbed" UBYTE _CNV_S_2_RANGE__0___1_CM 1 100. 0. 1. DISPLAY_IDENTIFIER LV_SENS_BAT_SMT_COM_ACT ECU_ADDRESS 0xd00087d0 BIT_MASK 0x1 /end MEASUREMENT
/begin MEASUREMENT state_bsd_cpt "" UBYTE _CNV_S_8_STATE_BSD__547_CM 1 100. 0. 7. DISPLAY_IDENTIFIER STATE_BSD_CPT ECU_ADDRESS 0xd0008615 /end MEASUREMENT
/begin MEASUREMENT idx_bsd_sdl_tbl "Index of the timing scheduler for the BSD devices" UBYTE _CNV_A_R_LINEAR_____0_CM 1 100. 0. 255. DISPLAY_IDENTIFIER IDX_BSD_SDL_TBL ECU_ADDRESS 0xd00034c0 FORMAT "%3.0" /end MEASUREMENT
/begin MEASUREMENT ctr_bsd_cpt_com_ok "Number of 'ok' communications between ECU and BSD devices per scheduling timing table list" UBYTE _CNV_A_R_LINEAR_____0_CM 1 100. 0. 255. DISPLAY_IDENTIFIER CTR_BSD_CPT_COM_OK ECU_ADDRESS 0xd0008614 FORMAT "%3.0" /end MEASUREMENT
/begin CHARACTERISTIC c_abc_inc_rly_main "Debounce counter increment - RLY_MAIN diagnosis" VALUE 0xa080b979 _REC_VAL_20_u1 255. _CNV_A_R_LINEAR_____0_CM 0. 255. DISPLAY_IDENTIFIER C_ABC_INC_RLY_MAIN FORMAT "%3.0" /end CHARACTERISTIC
/begin CHARACTERISTIC c_ctr_inc_diag_rly_main_dly "Debounce counter increment - RLY_MAIN diagnosis" VALUE 0xa080bb9a _REC_VAL_20_u1 255. _CNV_A_R_LINEAR_____0_CM 0. 255. DISPLAY_IDENTIFIER C_CTR_INC_DIAG_RLY_MAIN_DLY FORMAT "%3.0" /end CHARACTERISTIC
/begin CHARACTERISTIC c_ctr_inc_end_diag_rly_main_dly "Debounce counter increment - RLY_MAIN diagnosis" VALUE 0xa080bb9b _REC_VAL_20_u1 255. _CNV_A_R_LINEAR_____0_CM 0. 255. DISPLAY_IDENTIFIER C_CTR_INC_END_DIAG_RLY_MAIN_DLY FORMAT "%3.0" /end CHARACTERISTIC
/begin CHARACTERISTIC c_abc_max_rly_main "Debounce counter maximum value - RLY_MAIN diagnosis" VALUE 0xa080ba42 _REC_VAL_20_u1 254. _CNV_A_R_LINEAR_____0_CM 1. 255. DISPLAY_IDENTIFIER C_ABC_MAX_RLY_MAIN FORMAT "%3.0" /end CHARACTERISTIC
/begin CHARACTERISTIC c_ctr_max_diag_rly_main_dly "Debounce counter maximum value - RLY_MAIN diagnosis" VALUE 0xa080bbaa _REC_VAL_20_u1 254. _CNV_A_R_LINEAR_____0_CM 1. 255. DISPLAY_IDENTIFIER C_CTR_MAX_DIAG_RLY_MAIN_DLY FORMAT "%3.0" /end CHARACTERISTIC
/begin CHARACTERISTIC c_ctr_max_end_diag_rly_main_dly "Debounce counter maximum value - RLY_MAIN diagnosis" VALUE 0xa080bbab _REC_VAL_20_u1 254. _CNV_A_R_LINEAR_____0_CM 1. 255. DISPLAY_IDENTIFIER C_CTR_MAX_END_DIAG_RLY_MAIN_DLY FORMAT "%3.0" /end CHARACTERISTIC
/begin CHARACTERISTIC c_abc_inc_map_sens "Anti - bounce counter increment" VALUE 0xa080b962 _REC_VAL_20_u1 255. _CNV_A_R_LINEAR_____0_CM 0. 255. DISPLAY_IDENTIFIER C_ABC_INC_MAP_SENS FORMAT "%3.0" /end CHARACTERISTIC
/begin CHARACTERISTIC c_abc_inc_map_shift "Anti - bounce counter increment" VALUE 0xa080b963 _REC_VAL_20_u1 255. _CNV_A_R_LINEAR_____0_CM 0. 255. DISPLAY_IDENTIFIER C_ABC_INC_MAP_SHIFT FORMAT "%3.0" /end CHARACTERISTIC
/begin CHARACTERISTIC c_abc_max_map_sens "Maximum value of the anti - bounce counter" VALUE 0xa080ba2a _REC_VAL_20_u1 254. _CNV_A_R_LINEAR_____0_CM 1. 255. DISPLAY_IDENTIFIER C_ABC_MAX_MAP_SENS FORMAT "%3.0" /end CHARACTERISTIC
/begin CHARACTERISTIC c_abc_max_map_shift "Maximum value of the anti - bounce counter" VALUE 0xa080ba2b _REC_VAL_20_u1 254. _CNV_A_R_LINEAR_____0_CM 1. 255. DISPLAY_IDENTIFIER C_ABC_MAX_MAP_SHIFT FORMAT "%3.0" /end CHARACTERISTIC
/begin CHARACTERISTIC c_abc_inc_ldm "Increment counter" VALUE 0xa080b955 _REC_VAL_20_u1 255. _CNV_A_R_LINEAR_____0_CM 0. 255. DISPLAY_IDENTIFIER C_ABC_INC_LDM FORMAT "%3.0" /end CHARACTERISTIC
/begin CHARACTERISTIC c_abc_max_ldm "Maximum counter" VALUE 0xa080ba1d _REC_VAL_20_u1 254. _CNV_A_R_LINEAR_____0_CM 1. 255. DISPLAY_IDENTIFIER C_ABC_MAX_LDM FORMAT "%3.0" /end CHARACTERISTIC
/begin CHARACTERISTIC c_abc_inc_amp_plaus "Anti - bounce counter increment" VALUE 0xa080b8d7 _REC_VAL_20_u1 255. _CNV_A_R_LINEAR_____0_CM 0. 255. DISPLAY_IDENTIFIER C_ABC_INC_AMP_PLAUS FORMAT "%3.0" /end CHARACTERISTIC
/begin CHARACTERISTIC c_abc_max_amp_plaus "Maximum value of the anti - bounce counter" VALUE 0xa080b99f _REC_VAL_20_u1 254. _CNV_A_R_LINEAR_____0_CM 1. 255. DISPLAY_IDENTIFIER C_ABC_MAX_AMP_PLAUS FORMAT "%3.0" /end CHARACTERISTIC
/begin CHARACTERISTIC c_abc_inc_rly_crcv_heat "Debounce counter increment RLY_CRCV_HEAT" VALUE 0xa080b978 _REC_VAL_20_u1 255. _CNV_A_R_LINEAR_____0_CM 0. 255. DISPLAY_IDENTIFIER C_ABC_INC_RLY_CRCV_HEAT FORMAT "%3.0" /end CHARACTERISTIC
/begin CHARACTERISTIC c_abc_max_rly_crcv_heat "Debounce counter maximum value RLY_CRCV_HEAT" VALUE 0xa080ba41 _REC_VAL_20_u1 254. _CNV_A_R_LINEAR_____0_CM 1. 255. DISPLAY_IDENTIFIER C_ABC_MAX_RLY_CRCV_HEAT FORMAT "%3.0" /end CHARACTERISTIC
/begin MEASUREMENT lv_err_sof "Boolean for error currently present on SOF" UBYTE _CNV_S_2_RANGE__0___1_CM 1 100. 0. 1. DISPLAY_IDENTIFIER LV_ERR_SOF ECU_ADDRESS 0xd0007f85 BIT_MASK 0x1 /end MEASUREMENT
/begin CHARACTERISTIC c_abc_inc_sof "Debounce counter increment SOF" VALUE 0xa080b97e _REC_VAL_20_u1 255. _CNV_A_R_LINEAR_____0_CM 0. 255. DISPLAY_IDENTIFIER C_ABC_INC_SOF FORMAT "%3.0" /end CHARACTERISTIC
/begin CHARACTERISTIC c_abc_max_sof "Debounce counter maximum value SOF" VALUE 0xa080ba47 _REC_VAL_20_u1 254. _CNV_A_R_LINEAR_____0_CM 1. 255. DISPLAY_IDENTIFIER C_ABC_MAX_SOF FORMAT "%3.0" /end CHARACTERISTIC
/begin MEASUREMENT cdn_diag_sof "Activation conditions for sof" UBYTE _CNV_A_R_LINEAR_____0_CM 1 100. 0. 255. DISPLAY_IDENTIFIER CDN_DIAG_SOF ECU_ADDRESS 0xd0001620 FORMAT "%3.0" /end MEASUREMENT
/begin MEASUREMENT lv_inh_diag_sof "Inhibit diagnosis sof" UBYTE _CNV_S_2_RANGE__0___1_CM 1 100. 0. 1. DISPLAY_IDENTIFIER LV_INH_DIAG_SOF ECU_ADDRESS 0xd0008de0 BIT_MASK 0x1 /end MEASUREMENT
/begin CHARACTERISTIC c_abc_inc_sof_inh_mon "Anti - bounce counter increment" VALUE 0xa080cc4b _REC_VAL_20_u1 255. _CNV_A_R_LINEAR_____0_CM 0. 255. DISPLAY_IDENTIFIER C_ABC_INC_SOF_INH_MON FORMAT "%3.0" /end CHARACTERISTIC
/begin CHARACTERISTIC c_abc_max_sof_inh_mon "Debounce counter maximum value" VALUE 0xa080cc66 _REC_VAL_20_u1 254. _CNV_A_R_LINEAR_____0_CM 1. 255. DISPLAY_IDENTIFIER C_ABC_MAX_SOF_INH_MON FORMAT "%3.0" /end CHARACTERISTIC
/begin CHARACTERISTIC c_abc_inc_swi_afs_mon "Anti - bounce counter increment" VALUE 0xa0800da0 _REC_VAL_20_u1 255. _CNV_A_R_LINEAR_____0_CM 0. 255. DISPLAY_IDENTIFIER C_ABC_INC_SWI_AFS_MON FORMAT "%3.0" /end CHARACTERISTIC
/begin CHARACTERISTIC c_abc_max_swi_afs_mon "Maximum value of the anti - bounce counter" VALUE 0xa0800da5 _REC_VAL_20_u1 254. _CNV_A_R_LINEAR_____0_CM 1. 255. DISPLAY_IDENTIFIER C_ABC_MAX_SWI_AFS_MON FORMAT "%3.0" /end CHARACTERISTIC
/begin CHARACTERISTIC c_abc_inc_rfp_dr_1 "Debounce counter increment - recirculation flap driver" VALUE 0xa080b975 _REC_VAL_20_u1 255. _CNV_A_R_LINEAR_____0_CM 0. 255. DISPLAY_IDENTIFIER C_ABC_INC_RFP_DR_1 FORMAT "%3.0" /end CHARACTERISTIC
/begin CHARACTERISTIC c_abc_inc_rfp_dr_2 "Debounce counter increment - recirculation flap driver" VALUE 0xa080b976 _REC_VAL_20_u1 255. _CNV_A_R_LINEAR_____0_CM 0. 255. DISPLAY_IDENTIFIER C_ABC_INC_RFP_DR_2 FORMAT "%3.0" /end CHARACTERISTIC
/begin CHARACTERISTIC c_abc_max_rfp_dr_1 "Debounce counter maximum value - recirculation flap driver" VALUE 0xa080ba3e _REC_VAL_20_u1 254. _CNV_A_R_LINEAR_____0_CM 1. 255. DISPLAY_IDENTIFIER C_ABC_MAX_RFP_DR_1 FORMAT "%3.0" /end CHARACTERISTIC
/begin CHARACTERISTIC c_abc_max_rfp_dr_2 "Debounce counter maximum value - recirculation flap driver" VALUE 0xa080ba3f _REC_VAL_20_u1 254. _CNV_A_R_LINEAR_____0_CM 1. 255. DISPLAY_IDENTIFIER C_ABC_MAX_RFP_DR_2 FORMAT "%3.0" /end CHARACTERISTIC
/begin CHARACTERISTIC c_abc_inc_wg_1_dr "Debounce counter increment - Waste gate 1" VALUE 0xa080b998 _REC_VAL_20_u1 255. _CNV_A_R_LINEAR_____0_CM 0. 255. DISPLAY_IDENTIFIER C_ABC_INC_WG_1_DR FORMAT "%3.0" /end CHARACTERISTIC
/begin CHARACTERISTIC c_abc_inc_wg_2_dr "Debounce counter increment - Waste gate 2" VALUE 0xa080b999 _REC_VAL_20_u1 255. _CNV_A_R_LINEAR_____0_CM 0. 255. DISPLAY_IDENTIFIER C_ABC_INC_WG_2_DR FORMAT "%3.0" /end CHARACTERISTIC
/begin CHARACTERISTIC c_abc_max_wg_1_dr "Debounce counter maximum value - Waste gate" VALUE 0xa080ba61 _REC_VAL_20_u1 254. _CNV_A_R_LINEAR_____0_CM 1. 255. DISPLAY_IDENTIFIER C_ABC_MAX_WG_1_DR FORMAT "%3.0" /end CHARACTERISTIC
/begin CHARACTERISTIC c_abc_max_wg_2_dr "Debounce counter maximum value - Waste gate" VALUE 0xa080ba62 _REC_VAL_20_u1 254. _CNV_A_R_LINEAR_____0_CM 1. 255. DISPLAY_IDENTIFIER C_ABC_MAX_WG_2_DR FORMAT "%3.0" /end CHARACTERISTIC
/begin CHARACTERISTIC c_abc_inc_put_el "Increment debounce counter" VALUE 0xa080b96d _REC_VAL_20_u1 255. _CNV_A_R_LINEAR_____0_CM 0. 255. DISPLAY_IDENTIFIER C_ABC_INC_PUT_EL FORMAT "%3.0" /end CHARACTERISTIC
/begin CHARACTERISTIC c_abc_max_put_el "maximum value debounce counter" VALUE 0xa080ba36 _REC_VAL_20_u1 254. _CNV_A_R_LINEAR_____0_CM 1. 255. DISPLAY_IDENTIFIER C_ABC_MAX_PUT_EL FORMAT "%3.0" /end CHARACTERISTIC
/begin CHARACTERISTIC c_abc_inc_tia_el "Anti - bounce increment" VALUE 0xa080b98b _REC_VAL_20_u1 255. _CNV_A_R_LINEAR_____0_CM 0. 255. DISPLAY_IDENTIFIER C_ABC_INC_TIA_EL FORMAT "%3.0" /end CHARACTERISTIC
/begin CHARACTERISTIC c_abc_max_tia_el "Anti - bounce maximum" VALUE 0xa080ba54 _REC_VAL_20_u1 254. _CNV_A_R_LINEAR_____0_CM 1. 255. DISPLAY_IDENTIFIER C_ABC_MAX_TIA_EL FORMAT "%3.0" /end CHARACTERISTIC
/begin CHARACTERISTIC c_abc_inc_tia_thr_el "Anti-bounce increment" VALUE 0xa080b98d _REC_VAL_20_u1 255. _CNV_A_R_LINEAR_____0_CM 0. 255. DISPLAY_IDENTIFIER C_ABC_INC_TIA_THR_EL FORMAT "%3.0" /end CHARACTERISTIC
/begin CHARACTERISTIC c_abc_max_tia_thr_el "Anti-bounce maximum" VALUE 0xa080ba56 _REC_VAL_20_u1 254. _CNV_A_R_LINEAR_____0_CM 1. 255. DISPLAY_IDENTIFIER C_ABC_MAX_TIA_THR_EL FORMAT "%3.0" /end CHARACTERISTIC
/begin CHARACTERISTIC c_abc_inc_com_2_t_icl "Anti-bounce counter increment Communication on FA-CAN diagnosis" VALUE 0xa080b91f _REC_VAL_20_u1 255. _CNV_A_R_LINEAR_____0_CM 0. 255. DISPLAY_IDENTIFIER C_ABC_INC_COM_2_T_ICL FORMAT "%3.0" /end CHARACTERISTIC
/begin CHARACTERISTIC c_abc_dec_com_2_t_icl "Anti-bounce counter decrement Communication on FA-CAN diagnosis" VALUE 0xa080b8c1 _REC_VAL_20_u1 255. _CNV_A_R_LINEAR_____0_CM 0. 255. DISPLAY_IDENTIFIER C_ABC_DEC_COM_2_T_ICL FORMAT "%3.0" /end CHARACTERISTIC
/begin CHARACTERISTIC c_abc_max_com_2_t_icl "Anti-bounce counter maximum Communication on FA-CAN diagnosis" VALUE 0xa080b9e7 _REC_VAL_20_u1 254. _CNV_A_R_LINEAR_____0_CM 1. 255. DISPLAY_IDENTIFIER C_ABC_MAX_COM_2_T_ICL FORMAT "%3.0" /end CHARACTERISTIC
/begin CHARACTERISTIC c_ctr_tout_com_2_t_icl "Maximum number of missing messages events before error detection of message T_ICL" VALUE 0xa080bbff _REC_VAL_20_u1 255. _CNV_A_R_LINEAR_____0_CM 0. 255. DISPLAY_IDENTIFIER C_CTR_TOUT_COM_2_T_ICL FORMAT "%3.0" /end CHARACTERISTIC
/begin CHARACTERISTIC c_abc_inc_com_2_km_icl "Anti-bounce counter increment Communication on FA-CAN diagnosis" VALUE 0xa080b91a _REC_VAL_20_u1 255. _CNV_A_R_LINEAR_____0_CM 0. 255. DISPLAY_IDENTIFIER C_ABC_INC_COM_2_KM_ICL FORMAT "%3.0" /end CHARACTERISTIC
/begin CHARACTERISTIC c_abc_dec_com_2_km_icl "Anti-bounce counter decrement Communication on FA-CAN diagnosis" VALUE 0xa080b8bc _REC_VAL_20_u1 255. _CNV_A_R_LINEAR_____0_CM 0. 255. DISPLAY_IDENTIFIER C_ABC_DEC_COM_2_KM_ICL FORMAT "%3.0" /end CHARACTERISTIC
/begin CHARACTERISTIC c_abc_max_com_2_km_icl "Anti-bounce counter maximum Communication on FA-CAN diagnosis" VALUE 0xa080b9e2 _REC_VAL_20_u1 254. _CNV_A_R_LINEAR_____0_CM 1. 255. DISPLAY_IDENTIFIER C_ABC_MAX_COM_2_KM_ICL FORMAT "%3.0" /end CHARACTERISTIC
/begin CHARACTERISTIC c_ctr_tout_com_2_km_icl "Maximum number of missing messages events before error detection of message KM_ICL" VALUE 0xa080bbfa _REC_VAL_20_u1 255. _CNV_A_R_LINEAR_____0_CM 0. 255. DISPLAY_IDENTIFIER C_CTR_TOUT_COM_2_KM_ICL FORMAT "%3.0" /end CHARACTERISTIC
/begin CHARACTERISTIC c_abc_inc_com_2_t_absl_icl "Anti-bounce counter increment Communication on FA-CAN diagnosis" VALUE 0xa080b91d _REC_VAL_20_u1 255. _CNV_A_R_LINEAR_____0_CM 0. 255. DISPLAY_IDENTIFIER C_ABC_INC_COM_2_T_ABSL_ICL FORMAT "%3.0" /end CHARACTERISTIC
/begin CHARACTERISTIC c_abc_dec_com_2_t_absl_icl "Anti-bounce counter decrement Communication on FA-CAN diagnosis" VALUE 0xa080b8bf _REC_VAL_20_u1 255. _CNV_A_R_LINEAR_____0_CM 0. 255. DISPLAY_IDENTIFIER C_ABC_DEC_COM_2_T_ABSL_ICL FORMAT "%3.0" /end CHARACTERISTIC
/begin CHARACTERISTIC c_abc_max_com_2_t_absl_icl "Anti-bounce counter maximum Communication on FA-CAN diagnosis" VALUE 0xa080b9e5 _REC_VAL_20_u1 254. _CNV_A_R_LINEAR_____0_CM 1. 255. DISPLAY_IDENTIFIER C_ABC_MAX_COM_2_T_ABSL_ICL FORMAT "%3.0" /end CHARACTERISTIC
/begin CHARACTERISTIC c_ctr_tout_com_2_t_absl_icl "Maximum number of missing messages events before error detection of message T_ABSL_ICL" VALUE 0xa080bbfd _REC_VAL_20_u1 255. _CNV_A_R_LINEAR_____0_CM 0. 255. DISPLAY_IDENTIFIER C_CTR_TOUT_COM_2_T_ABSL_ICL FORMAT "%3.0" /end CHARACTERISTIC
/begin CHARACTERISTIC c_abc_inc_com_2_icl "Anti-bounce counter increment Communication on FA-CAN diagnosis" VALUE 0xa080b919 _REC_VAL_20_u1 255. _CNV_A_R_LINEAR_____0_CM 0. 255. DISPLAY_IDENTIFIER C_ABC_INC_COM_2_ICL FORMAT "%3.0" /end CHARACTERISTIC
/begin CHARACTERISTIC c_abc_dec_com_2_icl "Anti-bounce counter decrement Communication on FA-CAN diagnosis" VALUE 0xa080b8bb _REC_VAL_20_u1 255. _CNV_A_R_LINEAR_____0_CM 0. 255. DISPLAY_IDENTIFIER C_ABC_DEC_COM_2_ICL FORMAT "%3.0" /end CHARACTERISTIC
/begin CHARACTERISTIC c_abc_max_com_2_icl "Anti-bounce counter maximum Communication on FA-CAN diagnosis" VALUE 0xa080b9e1 _REC_VAL_20_u1 254. _CNV_A_R_LINEAR_____0_CM 1. 255. DISPLAY_IDENTIFIER C_ABC_MAX_COM_2_ICL FORMAT "%3.0" /end CHARACTERISTIC
/begin CHARACTERISTIC c_ctr_tout_com_2_icl "Maximum number of missing messages events before errordetection of message ICL" VALUE 0xa080bbf9 _REC_VAL_20_u1 255. _CNV_A_R_LINEAR_____0_CM 0. 255. DISPLAY_IDENTIFIER C_CTR_TOUT_COM_2_ICL FORMAT "%3.0" /end CHARACTERISTIC
/begin CHARACTERISTIC c_ctr_tcc_com_2_icl "Maximum number of wrong TCC_COM_2 count events before error detection of message ICL" VALUE 0xa080bbd8 _REC_VAL_20_u1 255. _CNV_A_R_LINEAR_____0_CM 0. 255. DISPLAY_IDENTIFIER C_CTR_TCC_COM_2_ICL FORMAT "%3.0" /end CHARACTERISTIC
/begin CHARACTERISTIC c_abc_inc_com_2_t_clk "Anti-bounce counter increment Communication on FA-CAN diagnosis" VALUE 0xa080b91e _REC_VAL_20_u1 255. _CNV_A_R_LINEAR_____0_CM 0. 255. DISPLAY_IDENTIFIER C_ABC_INC_COM_2_T_CLK FORMAT "%3.0" /end CHARACTERISTIC
/begin CHARACTERISTIC c_abc_dec_com_2_t_clk "Anti-bounce counter decrement Communication on FA-CAN diagnosis" VALUE 0xa080b8c0 _REC_VAL_20_u1 255. _CNV_A_R_LINEAR_____0_CM 0. 255. DISPLAY_IDENTIFIER C_ABC_DEC_COM_2_T_CLK FORMAT "%3.0" /end CHARACTERISTIC
/begin CHARACTERISTIC c_abc_max_com_2_t_clk "Anti-bounce counter maximum Communication on FA-CAN diagnosis" VALUE 0xa080b9e6 _REC_VAL_20_u1 254. _CNV_A_R_LINEAR_____0_CM 1. 255. DISPLAY_IDENTIFIER C_ABC_MAX_COM_2_T_CLK FORMAT "%3.0" /end CHARACTERISTIC
/begin CHARACTERISTIC c_ctr_tout_com_2_t_clk "Maximum number of missing messages events before error detection of message T_CLK" VALUE 0xa080bbfe _REC_VAL_20_u1 255. _CNV_A_R_LINEAR_____0_CM 0. 255. DISPLAY_IDENTIFIER C_CTR_TOUT_COM_2_T_CLK FORMAT "%3.0" /end CHARACTERISTIC
/begin CHARACTERISTIC c_ctr_tout_com_2_abs_icl "" VALUE 0xa080bbef _REC_VAL_20_u1 255. _CNV_A_R_LINEAR_____0_CM 0. 255. DISPLAY_IDENTIFIER C_CTR_TOUT_COM_2_ABS_ICL FORMAT "%3.0" /end CHARACTERISTIC
/begin CHARACTERISTIC c_abc_inc_com_2_abs_icl "" VALUE 0xa080b90f _REC_VAL_20_u1 255. _CNV_A_R_LINEAR_____0_CM 0. 255. DISPLAY_IDENTIFIER C_ABC_INC_COM_2_ABS_ICL FORMAT "%3.0" /end CHARACTERISTIC
/begin CHARACTERISTIC c_abc_dec_com_2_abs_icl "" VALUE 0xa080b8b1 _REC_VAL_20_u1 255. _CNV_A_R_LINEAR_____0_CM 0. 255. DISPLAY_IDENTIFIER C_ABC_DEC_COM_2_ABS_ICL FORMAT "%3.0" /end CHARACTERISTIC
/begin CHARACTERISTIC c_abc_max_com_2_abs_icl "" VALUE 0xa080b9d7 _REC_VAL_20_u1 254. _CNV_A_R_LINEAR_____0_CM 1. 255. DISPLAY_IDENTIFIER C_ABC_MAX_COM_2_ABS_ICL FORMAT "%3.0" /end CHARACTERISTIC
/begin CHARACTERISTIC c_t_tout_t_absv "" VALUE 0xa080c28a _REC_VAL_20_u1 255. _CNV_A_R_LINEAR_____0_CM 0. 255. DISPLAY_IDENTIFIER C_T_TOUT_T_ABSV FORMAT "%3.0" /end CHARACTERISTIC
/begin CHARACTERISTIC c_ctr_tout_com_2_tam_icl "" VALUE 0xa080bc00 _REC_VAL_20_u1 255. _CNV_A_R_LINEAR_____0_CM 0. 255. DISPLAY_IDENTIFIER C_CTR_TOUT_COM_2_TAM_ICL FORMAT "%3.0" /end CHARACTERISTIC
/begin CHARACTERISTIC c_abc_inc_com_2_tam_icl "" VALUE 0xa080b920 _REC_VAL_20_u1 255. _CNV_A_R_LINEAR_____0_CM 0. 255. DISPLAY_IDENTIFIER C_ABC_INC_COM_2_TAM_ICL FORMAT "%3.0" /end CHARACTERISTIC
/begin CHARACTERISTIC c_abc_dec_com_2_tam_icl "" VALUE 0xa080b8c2 _REC_VAL_20_u1 255. _CNV_A_R_LINEAR_____0_CM 0. 255. DISPLAY_IDENTIFIER C_ABC_DEC_COM_2_TAM_ICL FORMAT "%3.0" /end CHARACTERISTIC
/begin CHARACTERISTIC c_abc_max_com_2_tam_icl "" VALUE 0xa080b9e8 _REC_VAL_20_u1 254. _CNV_A_R_LINEAR_____0_CM 1. 255. DISPLAY_IDENTIFIER C_ABC_MAX_COM_2_TAM_ICL FORMAT "%3.0" /end CHARACTERISTIC
/begin CHARACTERISTIC c_abc_inc_com_2_cas_2 "Anti-bounce counter increment Communication on FA-CAN diagnosis" VALUE 0xa080b912 _REC_VAL_20_u1 255. _CNV_A_R_LINEAR_____0_CM 0. 255. DISPLAY_IDENTIFIER C_ABC_INC_COM_2_CAS_2 FORMAT "%3.0" /end CHARACTERISTIC
/begin CHARACTERISTIC c_abc_dec_com_2_cas_2 "Anti-bounce counter decrement Communication on FA-CAN diagnosis" VALUE 0xa080b8b4 _REC_VAL_20_u1 255. _CNV_A_R_LINEAR_____0_CM 0. 255. DISPLAY_IDENTIFIER C_ABC_DEC_COM_2_CAS_2 FORMAT "%3.0" /end CHARACTERISTIC
/begin CHARACTERISTIC c_abc_max_com_2_cas_2 "Anti-bounce counter maximum Communication on FA-CAN diagnosis" VALUE 0xa080b9da _REC_VAL_20_u1 254. _CNV_A_R_LINEAR_____0_CM 1. 255. DISPLAY_IDENTIFIER C_ABC_MAX_COM_2_CAS_2 FORMAT "%3.0" /end CHARACTERISTIC
/begin CHARACTERISTIC c_ctr_tout_com_2_cas_2 "Maximum number of missing messages events before error detection of message CAS_2" VALUE 0xa080bbf2 _REC_VAL_20_u1 255. _CNV_A_R_LINEAR_____0_CM 0. 255. DISPLAY_IDENTIFIER C_CTR_TOUT_COM_2_CAS_2 FORMAT "%3.0" /end CHARACTERISTIC
/begin CHARACTERISTIC c_ctr_tcc_com_2_cas_2 "Maximum number of wrong TCC_COM_2 count events before error detection of message CAS_2" VALUE 0xa080bbd6 _REC_VAL_20_u1 255. _CNV_A_R_LINEAR_____0_CM 0. 255. DISPLAY_IDENTIFIER C_CTR_TCC_COM_2_CAS_2 FORMAT "%3.0" /end CHARACTERISTIC
/begin CHARACTERISTIC c_ctr_crc_com_2_cas_2 "Maximum number of wrong checksum calculation events before error detection of message CAS_2" VALUE 0xa080bb36 _REC_VAL_20_u1 255. _CNV_A_R_LINEAR_____0_CM 0. 255. DISPLAY_IDENTIFIER C_CTR_CRC_COM_2_CAS_2 FORMAT "%3.0" /end CHARACTERISTIC
/begin CHARACTERISTIC c_abc_inc_com_2_cas "Anti-bounce counter increment Communication on FA-CAN diagnosis" VALUE 0xa080b911 _REC_VAL_20_u1 255. _CNV_A_R_LINEAR_____0_CM 0. 255. DISPLAY_IDENTIFIER C_ABC_INC_COM_2_CAS FORMAT "%3.0" /end CHARACTERISTIC
/begin CHARACTERISTIC c_abc_dec_com_2_cas "Anti-bounce counter decrement Communication on FA-CAN diagnosis" VALUE 0xa080b8b3 _REC_VAL_20_u1 255. _CNV_A_R_LINEAR_____0_CM 0. 255. DISPLAY_IDENTIFIER C_ABC_DEC_COM_2_CAS FORMAT "%3.0" /end CHARACTERISTIC
/begin CHARACTERISTIC c_abc_max_com_2_cas "Anti-bounce counter maximum Communication on FA-CAn diagnosis" VALUE 0xa080b9d9 _REC_VAL_20_u1 254. _CNV_A_R_LINEAR_____0_CM 1. 255. DISPLAY_IDENTIFIER C_ABC_MAX_COM_2_CAS FORMAT "%3.0" /end CHARACTERISTIC
/begin CHARACTERISTIC c_ctr_tout_com_2_cas "Maximum number of missing messages events before error detection of message CAS" VALUE 0xa080bbf1 _REC_VAL_20_u1 255. _CNV_A_R_LINEAR_____0_CM 0. 255. DISPLAY_IDENTIFIER C_CTR_TOUT_COM_2_CAS FORMAT "%3.0" /end CHARACTERISTIC
/begin CHARACTERISTIC c_ctr_tcc_com_2_cas "Maximum number of wrong TCC_COM_2 count events before error detection of message CAS" VALUE 0xa080bbd5 _REC_VAL_20_u1 255. _CNV_A_R_LINEAR_____0_CM 0. 255. DISPLAY_IDENTIFIER C_CTR_TCC_COM_2_CAS FORMAT "%3.0" /end CHARACTERISTIC
/begin CHARACTERISTIC c_ctr_crc_com_2_cas "Maximum number of wrong checksum calculation events before error detection of message CAS" VALUE 0xa080bb35 _REC_VAL_20_u1 255. _CNV_A_R_LINEAR_____0_CM 0. 255. DISPLAY_IDENTIFIER C_CTR_CRC_COM_2_CAS FORMAT "%3.0" /end CHARACTERISTIC
/begin CHARACTERISTIC c_abc_inc_com_2_pow_off "Anti-bounce counter increment Communication on FA-CAN diagnosis" VALUE 0xa080b91b _REC_VAL_20_u1 255. _CNV_A_R_LINEAR_____0_CM 0. 255. DISPLAY_IDENTIFIER C_ABC_INC_COM_2_POW_OFF FORMAT "%3.0" /end CHARACTERISTIC
/begin CHARACTERISTIC c_abc_dec_com_2_pow_off "Anti-bounce counter decrement Communication on FA-CAN diagnosis" VALUE 0xa080b8bd _REC_VAL_20_u1 255. _CNV_A_R_LINEAR_____0_CM 0. 255. DISPLAY_IDENTIFIER C_ABC_DEC_COM_2_POW_OFF FORMAT "%3.0" /end CHARACTERISTIC
/begin CHARACTERISTIC c_abc_max_com_2_pow_off "Anti-bounce counter maximum Communication on FA-CAN diagnosis" VALUE 0xa080b9e3 _REC_VAL_20_u1 254. _CNV_A_R_LINEAR_____0_CM 1. 255. DISPLAY_IDENTIFIER C_ABC_MAX_COM_2_POW_OFF FORMAT "%3.0" /end CHARACTERISTIC
/begin CHARACTERISTIC c_ctr_tout_com_2_pow_off "Maximum number of missing messages events before error detection of message POW_OFF" VALUE 0xa080bbfb _REC_VAL_20_u1 255. _CNV_A_R_LINEAR_____0_CM 0. 255. DISPLAY_IDENTIFIER C_CTR_TOUT_COM_2_POW_OFF FORMAT "%3.0" /end CHARACTERISTIC
/begin CHARACTERISTIC c_abc_inc_com_2_cdn_door "Anti-bounce counter increment Communication on FA-CAN diagnosis" VALUE 0xa080b913 _REC_VAL_20_u1 255. _CNV_A_R_LINEAR_____0_CM 0. 255. DISPLAY_IDENTIFIER C_ABC_INC_COM_2_CDN_DOOR FORMAT "%3.0" /end CHARACTERISTIC
/begin CHARACTERISTIC c_abc_dec_com_2_cdn_door "Anti-bounce counter decrement Communication on FA-CAN diagnosis" VALUE 0xa080b8b5 _REC_VAL_20_u1 255. _CNV_A_R_LINEAR_____0_CM 0. 255. DISPLAY_IDENTIFIER C_ABC_DEC_COM_2_CDN_DOOR FORMAT "%3.0" /end CHARACTERISTIC
/begin CHARACTERISTIC c_abc_max_com_2_cdn_door "Anti-bounce counter maximum Communication on FA-CAN diagnosis" VALUE 0xa080b9db _REC_VAL_20_u1 254. _CNV_A_R_LINEAR_____0_CM 1. 255. DISPLAY_IDENTIFIER C_ABC_MAX_COM_2_CDN_DOOR FORMAT "%3.0" /end CHARACTERISTIC
/begin CHARACTERISTIC c_ctr_tout_com_2_cdn_door "Maximum number of missing messages events before error detection of message CDN_DOOR" VALUE 0xa080bbf3 _REC_VAL_20_u1 255. _CNV_A_R_LINEAR_____0_CM 0. 255. DISPLAY_IDENTIFIER C_CTR_TOUT_COM_2_CDN_DOOR FORMAT "%3.0" /end CHARACTERISTIC
/begin CHARACTERISTIC c_abc_inc_com_2_state_veh "Anti-bounce counter increment Communication on FA-CAN diagnosis" VALUE 0xa080b91c _REC_VAL_20_u1 255. _CNV_A_R_LINEAR_____0_CM 0. 255. DISPLAY_IDENTIFIER C_ABC_INC_COM_2_STATE_VEH FORMAT "%3.0" /end CHARACTERISTIC
/begin CHARACTERISTIC c_abc_dec_com_2_state_veh "Anti-bounce counter decrement Communication on FA-CAN diagnosis" VALUE 0xa080b8be _REC_VAL_20_u1 255. _CNV_A_R_LINEAR_____0_CM 0. 255. DISPLAY_IDENTIFIER C_ABC_DEC_COM_2_STATE_VEH FORMAT "%3.0" /end CHARACTERISTIC
/begin CHARACTERISTIC c_abc_max_com_2_state_veh "Anti-bounce counter maximum Communication on FA-CAN diagnosis" VALUE 0xa080b9e4 _REC_VAL_20_u1 254. _CNV_A_R_LINEAR_____0_CM 1. 255. DISPLAY_IDENTIFIER C_ABC_MAX_COM_2_STATE_VEH FORMAT "%3.0" /end CHARACTERISTIC
/begin CHARACTERISTIC c_abc_inc_com_2_trl "Anti-bounce counter increment Communication on FA-CAN diagnosis" VALUE 0xa080b922 _REC_VAL_20_u1 255. _CNV_A_R_LINEAR_____0_CM 0. 255. DISPLAY_IDENTIFIER C_ABC_INC_COM_2_TRL FORMAT "%3.0" /end CHARACTERISTIC
/begin CHARACTERISTIC c_abc_dec_com_2_trl "Anti-bounce counter decrement Communication on FA-CAN diagnosis" VALUE 0xa080b8c4 _REC_VAL_20_u1 255. _CNV_A_R_LINEAR_____0_CM 0. 255. DISPLAY_IDENTIFIER C_ABC_DEC_COM_2_TRL FORMAT "%3.0" /end CHARACTERISTIC
/begin CHARACTERISTIC c_abc_max_com_2_trl "Anti-bounce counter maximum Communication on FA-CAN diagnosis" VALUE 0xa080b9ea _REC_VAL_20_u1 254. _CNV_A_R_LINEAR_____0_CM 1. 255. DISPLAY_IDENTIFIER C_ABC_MAX_COM_2_TRL FORMAT "%3.0" /end CHARACTERISTIC
/begin CHARACTERISTIC c_abc_inc_com_2_gear_rev "Anti-bounce counter increment Communication on FA-CAN diagnosis" VALUE 0xa080b918 _REC_VAL_20_u1 255. _CNV_A_R_LINEAR_____0_CM 0. 255. DISPLAY_IDENTIFIER C_ABC_INC_COM_2_GEAR_REV FORMAT "%3.0" /end CHARACTERISTIC
/begin CHARACTERISTIC c_abc_dec_com_2_gear_rev "Anti-bounce counter decrement Communication on FA-CAN diagnosis" VALUE 0xa080b8ba _REC_VAL_20_u1 255. _CNV_A_R_LINEAR_____0_CM 0. 255. DISPLAY_IDENTIFIER C_ABC_DEC_COM_2_GEAR_REV FORMAT "%3.0" /end CHARACTERISTIC
/begin CHARACTERISTIC c_abc_max_com_2_gear_rev "Anti-bounce counter maximum Communication on FA-CAN diagnosis" VALUE 0xa080b9e0 _REC_VAL_20_u1 254. _CNV_A_R_LINEAR_____0_CM 1. 255. DISPLAY_IDENTIFIER C_ABC_MAX_COM_2_GEAR_REV FORMAT "%3.0" /end CHARACTERISTIC
/begin CHARACTERISTIC c_abc_inc_com_2_efp_crash "Anti-bounce counter increment Communication on FA-CAN diagnosis" VALUE 0xa080b914 _REC_VAL_20_u1 255. _CNV_A_R_LINEAR_____0_CM 0. 255. DISPLAY_IDENTIFIER C_ABC_INC_COM_2_EFP_CRASH FORMAT "%3.0" /end CHARACTERISTIC
/begin CHARACTERISTIC c_abc_dec_com_2_efp_crash "Anti-bounce counter decrement Communication on FA-CAN diagnosis" VALUE 0xa080b8b6 _REC_VAL_20_u1 255. _CNV_A_R_LINEAR_____0_CM 0. 255. DISPLAY_IDENTIFIER C_ABC_DEC_COM_2_EFP_CRASH FORMAT "%3.0" /end CHARACTERISTIC
/begin CHARACTERISTIC c_abc_max_com_2_efp_crash "Anti-bounce counter maximum Communication on FA-CAN diagnosis" VALUE 0xa080b9dc _REC_VAL_20_u1 254. _CNV_A_R_LINEAR_____0_CM 1. 255. DISPLAY_IDENTIFIER C_ABC_MAX_COM_2_EFP_CRASH FORMAT "%3.0" /end CHARACTERISTIC
/begin CHARACTERISTIC c_abc_inc_com_1_ac_lgt "Anti-bounce counter increment Communication on FlexRay diagnosis" VALUE 0xa080b900 _REC_VAL_20_u1 255. _CNV_A_R_LINEAR_____0_CM 0. 255. DISPLAY_IDENTIFIER C_ABC_INC_COM_1_AC_LGT FORMAT "%3.0" /end CHARACTERISTIC
/begin CHARACTERISTIC c_abc_dec_com_1_ac_lgt "Anti-bounce counter decrement Communication on FlexRay diagnosis" VALUE 0xa080b8a2 _REC_VAL_20_u1 255. _CNV_A_R_LINEAR_____0_CM 0. 255. DISPLAY_IDENTIFIER C_ABC_DEC_COM_1_AC_LGT FORMAT "%3.0" /end CHARACTERISTIC
/begin CHARACTERISTIC c_abc_max_com_1_ac_lgt "Anti-bounce counter maximum Communication on FlexRay diagnosis" VALUE 0xa080b9c8 _REC_VAL_20_u1 254. _CNV_A_R_LINEAR_____0_CM 1. 255. DISPLAY_IDENTIFIER C_ABC_MAX_COM_1_AC_LGT FORMAT "%3.0" /end CHARACTERISTIC
/begin CHARACTERISTIC c_abc_inc_com_1_ac_trv "Anti-bounce counter increment Communication on FlexRay diagnosis" VALUE 0xa080b901 _REC_VAL_20_u1 255. _CNV_A_R_LINEAR_____0_CM 0. 255. DISPLAY_IDENTIFIER C_ABC_INC_COM_1_AC_TRV FORMAT "%3.0" /end CHARACTERISTIC
/begin CHARACTERISTIC c_abc_dec_com_1_ac_trv "Anti-bounce counter decrement Communication on FlexRay diagnosis" VALUE 0xa080b8a3 _REC_VAL_20_u1 255. _CNV_A_R_LINEAR_____0_CM 0. 255. DISPLAY_IDENTIFIER C_ABC_DEC_COM_1_AC_TRV FORMAT "%3.0" /end CHARACTERISTIC
/begin CHARACTERISTIC c_abc_max_com_1_ac_trv "Anti-bounce counter maximum Communication on FlexRay diagnosis" VALUE 0xa080b9c9 _REC_VAL_20_u1 254. _CNV_A_R_LINEAR_____0_CM 1. 255. DISPLAY_IDENTIFIER C_ABC_MAX_COM_1_AC_TRV FORMAT "%3.0" /end CHARACTERISTIC
/begin CHARACTERISTIC c_abc_inc_com_1_tq_pste "Anti-bounce counter increment Communication on FlexRay diagnosis" VALUE 0xa080b909 _REC_VAL_20_u1 255. _CNV_A_R_LINEAR_____0_CM 0. 255. DISPLAY_IDENTIFIER C_ABC_INC_COM_1_TQ_PSTE FORMAT "%3.0" /end CHARACTERISTIC
/begin CHARACTERISTIC c_abc_dec_com_1_tq_pste "Anti-bounce counter decrement Communication on FlexRay diagnosis" VALUE 0xa080b8ab _REC_VAL_20_u1 255. _CNV_A_R_LINEAR_____0_CM 0. 255. DISPLAY_IDENTIFIER C_ABC_DEC_COM_1_TQ_PSTE FORMAT "%3.0" /end CHARACTERISTIC
/begin CHARACTERISTIC c_abc_max_com_1_tq_pste "Anti-bounce counter maximum Communication on FlexRay diagnosis" VALUE 0xa080b9d1 _REC_VAL_20_u1 254. _CNV_A_R_LINEAR_____0_CM 1. 255. DISPLAY_IDENTIFIER C_ABC_MAX_COM_1_TQ_PSTE FORMAT "%3.0" /end CHARACTERISTIC
/begin CHARACTERISTIC c_abc_inc_com_1_vs "Anti-bound counter increment Communication on FlexRay diagnosis" VALUE 0xa080b90d _REC_VAL_20_u1 255. _CNV_A_R_LINEAR_____0_CM 0. 255. DISPLAY_IDENTIFIER C_ABC_INC_COM_1_VS FORMAT "%3.0" /end CHARACTERISTIC
/begin CHARACTERISTIC c_abc_dec_com_1_vs "Anti-bounce counter decrement Communication on FlexRay diagnosis" VALUE 0xa080b8af _REC_VAL_20_u1 255. _CNV_A_R_LINEAR_____0_CM 0. 255. DISPLAY_IDENTIFIER C_ABC_DEC_COM_1_VS FORMAT "%3.0" /end CHARACTERISTIC
/begin CHARACTERISTIC c_abc_max_com_1_vs "Anti-bounce counter maximum Communication on FlexRay diagnosis" VALUE 0xa080b9d5 _REC_VAL_20_u1 254. _CNV_A_R_LINEAR_____0_CM 1. 255. DISPLAY_IDENTIFIER C_ABC_MAX_COM_1_VS FORMAT "%3.0" /end CHARACTERISTIC
/begin CHARACTERISTIC c_abc_inc_com_1_req_tqdw "Anti-bounce counter increment Communication on FlexRay diagnosis" VALUE 0xa080b904 _REC_VAL_20_u1 255. _CNV_A_R_LINEAR_____0_CM 0. 255. DISPLAY_IDENTIFIER C_ABC_INC_COM_1_REQ_TQDW FORMAT "%3.0" /end CHARACTERISTIC
/begin CHARACTERISTIC c_abc_dec_com_1_req_tqdw "Anti-bounce counter decrement Communication on FlexRay diagnosis" VALUE 0xa080b8a6 _REC_VAL_20_u1 255. _CNV_A_R_LINEAR_____0_CM 0. 255. DISPLAY_IDENTIFIER C_ABC_DEC_COM_1_REQ_TQDW FORMAT "%3.0" /end CHARACTERISTIC
/begin CHARACTERISTIC c_abc_max_com_1_req_tqdw "Anti-bounce counter maximum Communication on FlexRay diagnosis" VALUE 0xa080b9cc _REC_VAL_20_u1 254. _CNV_A_R_LINEAR_____0_CM 1. 255. DISPLAY_IDENTIFIER C_ABC_MAX_COM_1_REQ_TQDW FORMAT "%3.0" /end CHARACTERISTIC
/begin CHARACTERISTIC c_ctr_tout_com_1_ac_trv "Maximum number of missing messages events before error detection of message AC_TRV" VALUE 0xa080bbe1 _REC_VAL_20_u1 255. _CNV_A_R_LINEAR_____0_CM 0. 255. DISPLAY_IDENTIFIER C_CTR_TOUT_COM_1_AC_TRV FORMAT "%3.0" /end CHARACTERISTIC
/begin CHARACTERISTIC c_ctr_tcc_com_1_ac_trv "Maximum number of wrong TCC_COM_1 count events before error detection of message AC_TRV" VALUE 0xa080bbcb _REC_VAL_20_u1 255. _CNV_A_R_LINEAR_____0_CM 0. 255. DISPLAY_IDENTIFIER C_CTR_TCC_COM_1_AC_TRV FORMAT "%3.0" /end CHARACTERISTIC
/begin CHARACTERISTIC c_ctr_crc_com_1_ac_trv "Maximum number of wrong Checksum calculation events before error detection of message AC_TRV" VALUE 0xa080bb2b _REC_VAL_20_u1 255. _CNV_A_R_LINEAR_____0_CM 0. 255. DISPLAY_IDENTIFIER C_CTR_CRC_COM_1_AC_TRV FORMAT "%3.0" /end CHARACTERISTIC
/begin CHARACTERISTIC c_abc_inc_com_1_tq_loss_cord "" VALUE 0xa080b908 _REC_VAL_20_u1 255. _CNV_A_R_LINEAR_____0_CM 0. 255. DISPLAY_IDENTIFIER C_ABC_INC_COM_1_TQ_LOSS_CORD FORMAT "%3.0" /end CHARACTERISTIC
/begin CHARACTERISTIC c_abc_dec_com_1_tq_loss_cord "" VALUE 0xa080b8aa _REC_VAL_20_u1 255. _CNV_A_R_LINEAR_____0_CM 0. 255. DISPLAY_IDENTIFIER C_ABC_DEC_COM_1_TQ_LOSS_CORD FORMAT "%3.0" /end CHARACTERISTIC
/begin CHARACTERISTIC c_abc_max_com_1_tq_loss_cord "" VALUE 0xa080b9d0 _REC_VAL_20_u1 254. _CNV_A_R_LINEAR_____0_CM 1. 255. DISPLAY_IDENTIFIER C_ABC_MAX_COM_1_TQ_LOSS_CORD FORMAT "%3.0" /end CHARACTERISTIC
/begin CHARACTERISTIC c_ctr_tout_com_1_tq_loss_cord "" VALUE 0xa080bbe8 _REC_VAL_20_u1 255. _CNV_A_R_LINEAR_____0_CM 0. 255. DISPLAY_IDENTIFIER C_CTR_TOUT_COM_1_TQ_LOSS_CORD FORMAT "%3.0" /end CHARACTERISTIC
/begin CHARACTERISTIC c_ctr_tcc_com_1_tq_loss_cord "" VALUE 0xa080bbcf _REC_VAL_20_u1 255. _CNV_A_R_LINEAR_____0_CM 0. 255. DISPLAY_IDENTIFIER C_CTR_TCC_COM_1_TQ_LOSS_CORD FORMAT "%3.0" /end CHARACTERISTIC
/begin CHARACTERISTIC c_ctr_crc_com_1_tq_loss_cord "" VALUE 0xa080bb2f _REC_VAL_20_u1 255. _CNV_A_R_LINEAR_____0_CM 0. 255. DISPLAY_IDENTIFIER C_CTR_CRC_COM_1_TQ_LOSS_CORD FORMAT "%3.0" /end CHARACTERISTIC
/begin CHARACTERISTIC c_abc_inc_com_1_tq_driv_asi "" VALUE 0xa080b907 _REC_VAL_20_u1 255. _CNV_A_R_LINEAR_____0_CM 0. 255. DISPLAY_IDENTIFIER C_ABC_INC_COM_1_TQ_DRIV_ASI FORMAT "%3.0" /end CHARACTERISTIC
/begin CHARACTERISTIC c_abc_dec_com_1_tq_driv_asi "" VALUE 0xa080b8a9 _REC_VAL_20_u1 255. _CNV_A_R_LINEAR_____0_CM 0. 255. DISPLAY_IDENTIFIER C_ABC_DEC_COM_1_TQ_DRIV_ASI FORMAT "%3.0" /end CHARACTERISTIC
/begin CHARACTERISTIC c_abc_max_com_1_tq_driv_asi "" VALUE 0xa080b9cf _REC_VAL_20_u1 254. _CNV_A_R_LINEAR_____0_CM 1. 255. DISPLAY_IDENTIFIER C_ABC_MAX_COM_1_TQ_DRIV_ASI FORMAT "%3.0" /end CHARACTERISTIC
/begin CHARACTERISTIC c_ctr_tout_com_1_tq_driv_asi "" VALUE 0xa080bbe7 _REC_VAL_20_u1 255. _CNV_A_R_LINEAR_____0_CM 0. 255. DISPLAY_IDENTIFIER C_CTR_TOUT_COM_1_TQ_DRIV_ASI FORMAT "%3.0" /end CHARACTERISTIC
/begin CHARACTERISTIC c_ctr_tcc_com_1_tq_driv_asi "" VALUE 0xa080bbce _REC_VAL_20_u1 255. _CNV_A_R_LINEAR_____0_CM 0. 255. DISPLAY_IDENTIFIER C_CTR_TCC_COM_1_TQ_DRIV_ASI FORMAT "%3.0" /end CHARACTERISTIC
/begin CHARACTERISTIC c_ctr_crc_com_1_tq_driv_asi "" VALUE 0xa080bb2e _REC_VAL_20_u1 255. _CNV_A_R_LINEAR_____0_CM 0. 255. DISPLAY_IDENTIFIER C_CTR_CRC_COM_1_TQ_DRIV_ASI FORMAT "%3.0" /end CHARACTERISTIC
/begin CHARACTERISTIC c_abc_inc_com_1_veh_mod "" VALUE 0xa080b90c _REC_VAL_20_u1 255. _CNV_A_R_LINEAR_____0_CM 0. 255. DISPLAY_IDENTIFIER C_ABC_INC_COM_1_VEH_MOD FORMAT "%3.0" /end CHARACTERISTIC
/begin CHARACTERISTIC c_abc_dec_com_1_veh_mod "" VALUE 0xa080b8ae _REC_VAL_20_u1 255. _CNV_A_R_LINEAR_____0_CM 0. 255. DISPLAY_IDENTIFIER C_ABC_DEC_COM_1_VEH_MOD FORMAT "%3.0" /end CHARACTERISTIC
/begin CHARACTERISTIC c_abc_max_com_1_veh_mod "" VALUE 0xa080b9d4 _REC_VAL_20_u1 254. _CNV_A_R_LINEAR_____0_CM 1. 255. DISPLAY_IDENTIFIER C_ABC_MAX_COM_1_VEH_MOD FORMAT "%3.0" /end CHARACTERISTIC
/begin CHARACTERISTIC c_ctr_tout_com_1_veh_mod "" VALUE 0xa080bbec _REC_VAL_20_u1 255. _CNV_A_R_LINEAR_____0_CM 0. 255. DISPLAY_IDENTIFIER C_CTR_TOUT_COM_1_VEH_MOD FORMAT "%3.0" /end CHARACTERISTIC
/begin CHARACTERISTIC c_ctr_tcc_com_1_veh_mod "" VALUE 0xa080bbd2 _REC_VAL_20_u1 255. _CNV_A_R_LINEAR_____0_CM 0. 255. DISPLAY_IDENTIFIER C_CTR_TCC_COM_1_VEH_MOD FORMAT "%3.0" /end CHARACTERISTIC
/begin CHARACTERISTIC c_ctr_crc_com_1_veh_mod "" VALUE 0xa080bb32 _REC_VAL_20_u1 255. _CNV_A_R_LINEAR_____0_CM 0. 255. DISPLAY_IDENTIFIER C_CTR_CRC_COM_1_VEH_MOD FORMAT "%3.0" /end CHARACTERISTIC
/begin CHARACTERISTIC c_abc_inc_com_2_tq_etcu "Anti-bounce counter increment Communication on FA-CAN diagnosis" VALUE 0xa080b921 _REC_VAL_20_u1 255. _CNV_A_R_LINEAR_____0_CM 0. 255. DISPLAY_IDENTIFIER C_ABC_INC_COM_2_TQ_ETCU FORMAT "%3.0" /end CHARACTERISTIC
/begin CHARACTERISTIC c_abc_dec_com_2_tq_etcu "Anti-bounce counter decrement Communication on FA-CAN diagnosis" VALUE 0xa080b8c3 _REC_VAL_20_u1 255. _CNV_A_R_LINEAR_____0_CM 0. 255. DISPLAY_IDENTIFIER C_ABC_DEC_COM_2_TQ_ETCU FORMAT "%3.0" /end CHARACTERISTIC
/begin CHARACTERISTIC c_abc_max_com_2_tq_etcu "Anti-bounce counter maximum Communication on FA-CAN diagnosis" VALUE 0xa080b9e9 _REC_VAL_20_u1 254. _CNV_A_R_LINEAR_____0_CM 1. 255. DISPLAY_IDENTIFIER C_ABC_MAX_COM_2_TQ_ETCU FORMAT "%3.0" /end CHARACTERISTIC
/begin CHARACTERISTIC c_ctr_tout_com_2_tq_etcu "Maximum number of missing messages events before error detectin of message TQ_ETCU" VALUE 0xa080bc01 _REC_VAL_20_u1 255. _CNV_A_R_LINEAR_____0_CM 0. 255. DISPLAY_IDENTIFIER C_CTR_TOUT_COM_2_TQ_ETCU FORMAT "%3.0" /end CHARACTERISTIC
/begin CHARACTERISTIC c_ctr_tcc_com_2_tq_etcu "Maximum number of wrong TCC_COM_2 count events before error detection of message TQ_ETCU" VALUE 0xa080bbd9 _REC_VAL_20_u1 255. _CNV_A_R_LINEAR_____0_CM 0. 255. DISPLAY_IDENTIFIER C_CTR_TCC_COM_2_TQ_ETCU FORMAT "%3.0" /end CHARACTERISTIC
/begin CHARACTERISTIC c_ctr_crc_com_2_tq_etcu "Maximum number of wrong checksum calculation events before error detection of message TQ_ETCU" VALUE 0xa080bb38 _REC_VAL_20_u1 255. _CNV_A_R_LINEAR_____0_CM 0. 255. DISPLAY_IDENTIFIER C_CTR_CRC_COM_2_TQ_ETCU FORMAT "%3.0" /end CHARACTERISTIC
/begin CHARACTERISTIC c_abc_inc_com_3_tq_etcu "Anti-bounce counter increment Communication on A-CAN diagnosis" VALUE 0xa080b928 _REC_VAL_20_u1 255. _CNV_A_R_LINEAR_____0_CM 0. 255. DISPLAY_IDENTIFIER C_ABC_INC_COM_3_TQ_ETCU FORMAT "%3.0" /end CHARACTERISTIC
/begin CHARACTERISTIC c_abc_dec_com_3_tq_etcu "Anti-bounce counter decrement Communication on A-CAN diagnosis" VALUE 0xa080b8ca _REC_VAL_20_u1 255. _CNV_A_R_LINEAR_____0_CM 0. 255. DISPLAY_IDENTIFIER C_ABC_DEC_COM_3_TQ_ETCU FORMAT "%3.0" /end CHARACTERISTIC
/begin CHARACTERISTIC c_abc_max_com_3_tq_etcu "Anti-bounce counter maximum Communication on A-CAN diagnosis" VALUE 0xa080b9f0 _REC_VAL_20_u1 254. _CNV_A_R_LINEAR_____0_CM 1. 255. DISPLAY_IDENTIFIER C_ABC_MAX_COM_3_TQ_ETCU FORMAT "%3.0" /end CHARACTERISTIC
/begin CHARACTERISTIC c_ctr_tout_com_3_tq_etcu "Maximum number of missing messages events before error detection of message TQ_ETCU" VALUE 0xa080bc08 _REC_VAL_20_u1 255. _CNV_A_R_LINEAR_____0_CM 0. 255. DISPLAY_IDENTIFIER C_CTR_TOUT_COM_3_TQ_ETCU FORMAT "%3.0" /end CHARACTERISTIC
/begin CHARACTERISTIC c_ctr_tcc_com_3_tq_etcu "Maximum number of wrong TCC_COM_3 count events before error detection of message TQ_ETCU" VALUE 0xa080bbdc _REC_VAL_20_u1 255. _CNV_A_R_LINEAR_____0_CM 0. 255. DISPLAY_IDENTIFIER C_CTR_TCC_COM_3_TQ_ETCU FORMAT "%3.0" /end CHARACTERISTIC
/begin CHARACTERISTIC c_ctr_crc_com_3_tq_etcu "Maximum number of wrong checksum calculation events before error detection of message TQ_ETCU" VALUE 0xa080bb3b _REC_VAL_20_u1 255. _CNV_A_R_LINEAR_____0_CM 0. 255. DISPLAY_IDENTIFIER C_CTR_CRC_COM_3_TQ_ETCU FORMAT "%3.0" /end CHARACTERISTIC
/begin CHARACTERISTIC c_abc_inc_com_2_etcu "Anti-bounce counter increment Communication on FA-CAN diagnosis" VALUE 0xa080b915 _REC_VAL_20_u1 255. _CNV_A_R_LINEAR_____0_CM 0. 255. DISPLAY_IDENTIFIER C_ABC_INC_COM_2_ETCU FORMAT "%3.0" /end CHARACTERISTIC
/begin CHARACTERISTIC c_abc_dec_com_2_etcu "Anti-bounce counter decrement Communication on FA-CAN diagnosis" VALUE 0xa080b8b7 _REC_VAL_20_u1 255. _CNV_A_R_LINEAR_____0_CM 0. 255. DISPLAY_IDENTIFIER C_ABC_DEC_COM_2_ETCU FORMAT "%3.0" /end CHARACTERISTIC
/begin CHARACTERISTIC c_abc_max_com_2_etcu "Anti-bounce counter maximum Communication on FA-CAN diagnosis" VALUE 0xa080b9dd _REC_VAL_20_u1 254. _CNV_A_R_LINEAR_____0_CM 1. 255. DISPLAY_IDENTIFIER C_ABC_MAX_COM_2_ETCU FORMAT "%3.0" /end CHARACTERISTIC
/begin CHARACTERISTIC c_ctr_tout_com_2_etcu "Maximum number of missing messages events before error detection of message ETCU" VALUE 0xa080bbf5 _REC_VAL_20_u1 255. _CNV_A_R_LINEAR_____0_CM 0. 255. DISPLAY_IDENTIFIER C_CTR_TOUT_COM_2_ETCU FORMAT "%3.0" /end CHARACTERISTIC
/begin CHARACTERISTIC c_ctr_tcc_com_2_etcu "Maximum number of wrong TCC_COM_2 count events before error detection of message ETCU " VALUE 0xa080bbd7 _REC_VAL_20_u1 255. _CNV_A_R_LINEAR_____0_CM 0. 255. DISPLAY_IDENTIFIER C_CTR_TCC_COM_2_ETCU FORMAT "%3.0" /end CHARACTERISTIC
/begin CHARACTERISTIC c_ctr_crc_com_2_etcu "Maximum number of wrong checksum calculation events before error detection of message ETCU" VALUE 0xa080bb37 _REC_VAL_20_u1 255. _CNV_A_R_LINEAR_____0_CM 0. 255. DISPLAY_IDENTIFIER C_CTR_CRC_COM_2_ETCU FORMAT "%3.0" /end CHARACTERISTIC
/begin CHARACTERISTIC c_abc_inc_com_3_etcu "Anti-bounce counter increment Communication on A-CAN diagnosis" VALUE 0xa080b924 _REC_VAL_20_u1 255. _CNV_A_R_LINEAR_____0_CM 0. 255. DISPLAY_IDENTIFIER C_ABC_INC_COM_3_ETCU FORMAT "%3.0" /end CHARACTERISTIC
/begin CHARACTERISTIC c_abc_dec_com_3_etcu "Anti-bounce counter decrement Communication on A-CAN diagnosis" VALUE 0xa080b8c6 _REC_VAL_20_u1 255. _CNV_A_R_LINEAR_____0_CM 0. 255. DISPLAY_IDENTIFIER C_ABC_DEC_COM_3_ETCU FORMAT "%3.0" /end CHARACTERISTIC
/begin CHARACTERISTIC c_abc_max_com_3_etcu "Anti-bounce counter maximum Communication on A-CAN diagnosis" VALUE 0xa080b9ec _REC_VAL_20_u1 254. _CNV_A_R_LINEAR_____0_CM 1. 255. DISPLAY_IDENTIFIER C_ABC_MAX_COM_3_ETCU FORMAT "%3.0" /end CHARACTERISTIC
/begin CHARACTERISTIC c_ctr_tout_com_3_etcu "Maximum number of missing messages events before error detection of message ETCU" VALUE 0xa080bc04 _REC_VAL_20_u1 255. _CNV_A_R_LINEAR_____0_CM 0. 255. DISPLAY_IDENTIFIER C_CTR_TOUT_COM_3_ETCU FORMAT "%3.0" /end CHARACTERISTIC
/begin CHARACTERISTIC c_ctr_tcc_com_3_etcu "Maximum number of wrong TCC_COM_3 count events before error detection of message ETCU" VALUE 0xa080bbda _REC_VAL_20_u1 255. _CNV_A_R_LINEAR_____0_CM 0. 255. DISPLAY_IDENTIFIER C_CTR_TCC_COM_3_ETCU FORMAT "%3.0" /end CHARACTERISTIC
/begin CHARACTERISTIC c_ctr_crc_com_3_etcu "Maximum number of wrong checksum calculation events before error detection of message ETCU" VALUE 0xa080bb39 _REC_VAL_20_u1 255. _CNV_A_R_LINEAR_____0_CM 0. 255. DISPLAY_IDENTIFIER C_CTR_CRC_COM_3_ETCU FORMAT "%3.0" /end CHARACTERISTIC
/begin CHARACTERISTIC c_abc_inc_com_2_etcu_disp "Anti-bounce increment Communication on FA-CAN diagnosis" VALUE 0xa080b916 _REC_VAL_20_u1 255. _CNV_A_R_LINEAR_____0_CM 0. 255. DISPLAY_IDENTIFIER C_ABC_INC_COM_2_ETCU_DISP FORMAT "%3.0" /end CHARACTERISTIC
/begin CHARACTERISTIC c_abc_dec_com_2_etcu_disp "Anti-bounce counter decrement Communication on FA-CAN diagnosis" VALUE 0xa080b8b8 _REC_VAL_20_u1 255. _CNV_A_R_LINEAR_____0_CM 0. 255. DISPLAY_IDENTIFIER C_ABC_DEC_COM_2_ETCU_DISP FORMAT "%3.0" /end CHARACTERISTIC
/begin CHARACTERISTIC c_abc_max_com_2_etcu_disp "Anti-bounce counter maximum Communication on FA-CAN diagnosis" VALUE 0xa080b9de _REC_VAL_20_u1 254. _CNV_A_R_LINEAR_____0_CM 1. 255. DISPLAY_IDENTIFIER C_ABC_MAX_COM_2_ETCU_DISP FORMAT "%3.0" /end CHARACTERISTIC
/begin CHARACTERISTIC c_ctr_tout_com_2_etcu_disp "Maximum number of missing messages events before error detection of message ETCU_DISP" VALUE 0xa080bbf6 _REC_VAL_20_u1 255. _CNV_A_R_LINEAR_____0_CM 0. 255. DISPLAY_IDENTIFIER C_CTR_TOUT_COM_2_ETCU_DISP FORMAT "%3.0" /end CHARACTERISTIC
/begin CHARACTERISTIC c_abc_inc_com_3_etcu_disp "Anti-bounce counter increment Communication on A-CAN diagnosis" VALUE 0xa080b925 _REC_VAL_20_u1 255. _CNV_A_R_LINEAR_____0_CM 0. 255. DISPLAY_IDENTIFIER C_ABC_INC_COM_3_ETCU_DISP FORMAT "%3.0" /end CHARACTERISTIC
/begin CHARACTERISTIC c_abc_dec_com_3_etcu_disp "Anti-bounce counter decrement Communication on A-CAN diagnosis" VALUE 0xa080b8c7 _REC_VAL_20_u1 255. _CNV_A_R_LINEAR_____0_CM 0. 255. DISPLAY_IDENTIFIER C_ABC_DEC_COM_3_ETCU_DISP FORMAT "%3.0" /end CHARACTERISTIC
/begin CHARACTERISTIC c_abc_max_com_3_etcu_disp "Anti-bounce counter maximum Communication on A-CAN diagnosis" VALUE 0xa080b9ed _REC_VAL_20_u1 254. _CNV_A_R_LINEAR_____0_CM 1. 255. DISPLAY_IDENTIFIER C_ABC_MAX_COM_3_ETCU_DISP FORMAT "%3.0" /end CHARACTERISTIC
/begin CHARACTERISTIC c_ctr_tout_com_3_etcu_disp "Maximum number of missing messages events before error detection of message ETCU_DISP" VALUE 0xa080bc05 _REC_VAL_20_u1 255. _CNV_A_R_LINEAR_____0_CM 0. 255. DISPLAY_IDENTIFIER C_CTR_TOUT_COM_3_ETCU_DISP FORMAT "%3.0" /end CHARACTERISTIC
/begin CHARACTERISTIC c_abc_inc_com_3_etcu_obd "Anti-bounce counter increment Communication on A-CAN diagnosis" VALUE 0xa080b926 _REC_VAL_20_u1 255. _CNV_A_R_LINEAR_____0_CM 0. 255. DISPLAY_IDENTIFIER C_ABC_INC_COM_3_ETCU_OBD FORMAT "%3.0" /end CHARACTERISTIC
/begin CHARACTERISTIC c_abc_dec_com_3_etcu_obd "Anti-bounce counter decrement Communication on A-CAN diagnosis" VALUE 0xa080b8c8 _REC_VAL_20_u1 255. _CNV_A_R_LINEAR_____0_CM 0. 255. DISPLAY_IDENTIFIER C_ABC_DEC_COM_3_ETCU_OBD FORMAT "%3.0" /end CHARACTERISTIC
/begin CHARACTERISTIC c_abc_max_com_3_etcu_obd "Anti-bounce counter maximum Communication on A-CAN diagnosis" VALUE 0xa080b9ee _REC_VAL_20_u1 254. _CNV_A_R_LINEAR_____0_CM 1. 255. DISPLAY_IDENTIFIER C_ABC_MAX_COM_3_ETCU_OBD FORMAT "%3.0" /end CHARACTERISTIC
/begin CHARACTERISTIC c_ctr_tout_com_3_etcu_obd "Maximum number of missing messages events before error detection of message ETCU_OBD" VALUE 0xa080bc06 _REC_VAL_20_u1 255. _CNV_A_R_LINEAR_____0_CM 0. 255. DISPLAY_IDENTIFIER C_CTR_TOUT_COM_3_ETCU_OBD FORMAT "%3.0" /end CHARACTERISTIC
/begin CHARACTERISTIC c_abc_inc_com_2_gb "Anti-bounce counter increment Communication on FA-CAN diagnosis" VALUE 0xa080b917 _REC_VAL_20_u1 255. _CNV_A_R_LINEAR_____0_CM 0. 255. DISPLAY_IDENTIFIER C_ABC_INC_COM_2_GB FORMAT "%3.0" /end CHARACTERISTIC
/begin CHARACTERISTIC c_abc_dec_com_2_gb "Anti-bounce counter decrement Communication on FA-CAN diagnosis" VALUE 0xa080b8b9 _REC_VAL_20_u1 255. _CNV_A_R_LINEAR_____0_CM 0. 255. DISPLAY_IDENTIFIER C_ABC_DEC_COM_2_GB FORMAT "%3.0" /end CHARACTERISTIC
/begin CHARACTERISTIC c_abc_max_com_2_gb "Anti-bounce counter maximum Communication on FA-CAN diagnosis" VALUE 0xa080b9df _REC_VAL_20_u1 254. _CNV_A_R_LINEAR_____0_CM 1. 255. DISPLAY_IDENTIFIER C_ABC_MAX_COM_2_GB FORMAT "%3.0" /end CHARACTERISTIC
/begin CHARACTERISTIC c_ctr_tout_com_2_gb "Maximum number of missing messages events before error detection of message GB" VALUE 0xa080bbf7 _REC_VAL_20_u1 255. _CNV_A_R_LINEAR_____0_CM 0. 255. DISPLAY_IDENTIFIER C_CTR_TOUT_COM_2_GB FORMAT "%3.0" /end CHARACTERISTIC
/begin CHARACTERISTIC c_abc_inc_com_3_gb "Anti-bounce counter increment Communication on A-CAN diagnosis" VALUE 0xa080b927 _REC_VAL_20_u1 255. _CNV_A_R_LINEAR_____0_CM 0. 255. DISPLAY_IDENTIFIER C_ABC_INC_COM_3_GB FORMAT "%3.0" /end CHARACTERISTIC
/begin CHARACTERISTIC c_abc_dec_com_3_gb "Anti-bounce counter decrement Communication on A-CAN diagnosis" VALUE 0xa080b8c9 _REC_VAL_20_u1 255. _CNV_A_R_LINEAR_____0_CM 0. 255. DISPLAY_IDENTIFIER C_ABC_DEC_COM_3_GB FORMAT "%3.0" /end CHARACTERISTIC
/begin CHARACTERISTIC c_abc_max_com_3_gb "Anti-bounce counter decrement Communication on A-CAN diagnosis" VALUE 0xa080b9ef _REC_VAL_20_u1 254. _CNV_A_R_LINEAR_____0_CM 1. 255. DISPLAY_IDENTIFIER C_ABC_MAX_COM_3_GB FORMAT "%3.0" /end CHARACTERISTIC
/begin CHARACTERISTIC c_ctr_tout_com_3_gb "Maximum number of missing messages events before error detection of message GB" VALUE 0xa080bc07 _REC_VAL_20_u1 255. _CNV_A_R_LINEAR_____0_CM 0. 255. DISPLAY_IDENTIFIER C_CTR_TOUT_COM_3_GB FORMAT "%3.0" /end CHARACTERISTIC
/begin CHARACTERISTIC c_ctr_tcc_com_3_etcu_disp "Maximum number of wrong TCC_COM_3 count events before error detection of message ETCU" VALUE 0xa080bbdb _REC_VAL_20_u1 255. _CNV_A_R_LINEAR_____0_CM 0. 255. FORMAT "%3.0" /end CHARACTERISTIC
/begin CHARACTERISTIC c_ctr_crc_com_3_etcu_disp "Maximum number of wrong checksum calculation events before error detection of message ETCU" VALUE 0xa080bb3a _REC_VAL_20_u1 255. _CNV_A_R_LINEAR_____0_CM 0. 255. FORMAT "%3.0" /end CHARACTERISTIC
/begin CHARACTERISTIC c_abc_inc_com_1_ang_pste "Anti-bounce counter increment Communication on FlexRay diagnosis" VALUE 0xa080b902 _REC_VAL_20_u1 255. _CNV_A_R_LINEAR_____0_CM 0. 255. DISPLAY_IDENTIFIER C_ABC_INC_COM_1_ANG_PSTE FORMAT "%3.0" /end CHARACTERISTIC
/begin CHARACTERISTIC c_abc_dec_com_1_ang_pste "Anti-bounce counter decrement Communication on FlexRay diagnosis" VALUE 0xa080b8a4 _REC_VAL_20_u1 255. _CNV_A_R_LINEAR_____0_CM 0. 255. DISPLAY_IDENTIFIER C_ABC_DEC_COM_1_ANG_PSTE FORMAT "%3.0" /end CHARACTERISTIC
/begin CHARACTERISTIC c_abc_max_com_1_ang_pste "Anti-bounce counter maximum Communication on FlexRay diagnosis" VALUE 0xa080b9ca _REC_VAL_20_u1 254. _CNV_A_R_LINEAR_____0_CM 1. 255. DISPLAY_IDENTIFIER C_ABC_MAX_COM_1_ANG_PSTE FORMAT "%3.0" /end CHARACTERISTIC
/begin CHARACTERISTIC c_abc_inc_com_1_swi_gear "Anti-bounce counter increment Communication on FlexRay diagnosis" VALUE 0xa080b905 _REC_VAL_20_u1 255. _CNV_A_R_LINEAR_____0_CM 0. 255. DISPLAY_IDENTIFIER C_ABC_INC_COM_1_SWI_GEAR FORMAT "%3.0" /end CHARACTERISTIC
/begin CHARACTERISTIC c_abc_dec_com_1_swi_gear "Anti-bounce counter decrement Communication on FlexRay diagnosis" VALUE 0xa080b8a7 _REC_VAL_20_u1 255. _CNV_A_R_LINEAR_____0_CM 0. 255. DISPLAY_IDENTIFIER C_ABC_DEC_COM_1_SWI_GEAR FORMAT "%3.0" /end CHARACTERISTIC
/begin CHARACTERISTIC c_abc_max_com_1_swi_gear "Anti-bounce counter maximum Communication on FlexRay diagnosis" VALUE 0xa080b9cd _REC_VAL_20_u1 254. _CNV_A_R_LINEAR_____0_CM 1. 255. DISPLAY_IDENTIFIER C_ABC_MAX_COM_1_SWI_GEAR FORMAT "%3.0" /end CHARACTERISTIC
/begin CHARACTERISTIC c_abc_inc_com_1_tcs "Anti-bounce counter increment Communication on FlexRay diagnosis" VALUE 0xa080b906 _REC_VAL_20_u1 255. _CNV_A_R_LINEAR_____0_CM 0. 255. DISPLAY_IDENTIFIER C_ABC_INC_COM_1_TCS FORMAT "%3.0" /end CHARACTERISTIC
/begin CHARACTERISTIC c_abc_dec_com_1_tcs "Anti-bounce counter decrement Communication on FlexRay diagnosis" VALUE 0xa080b8a8 _REC_VAL_20_u1 255. _CNV_A_R_LINEAR_____0_CM 0. 255. DISPLAY_IDENTIFIER C_ABC_DEC_COM_1_TCS FORMAT "%3.0" /end CHARACTERISTIC
/begin CHARACTERISTIC c_abc_max_com_1_tcs "Anti-bounce counter maximum Communication on FlexRay diagnosis" VALUE 0xa080b9ce _REC_VAL_20_u1 254. _CNV_A_R_LINEAR_____0_CM 1. 255. DISPLAY_IDENTIFIER C_ABC_MAX_COM_1_TCS FORMAT "%3.0" /end CHARACTERISTIC
/begin CHARACTERISTIC c_ctr_tout_com_1_tcs "Maximum number of missing messages events before error detection of message TCS" VALUE 0xa080bbe6 _REC_VAL_20_u1 255. _CNV_A_R_LINEAR_____0_CM 0. 255. DISPLAY_IDENTIFIER C_CTR_TOUT_COM_1_TCS FORMAT "%3.0" /end CHARACTERISTIC
/begin CHARACTERISTIC c_ctr_tcc_com_1_tcs "Maximum number of wrong TCC_COM_1 count events before error detection of message TCS" VALUE 0xa080bbcd _REC_VAL_20_u1 255. _CNV_A_R_LINEAR_____0_CM 0. 255. DISPLAY_IDENTIFIER C_CTR_TCC_COM_1_TCS FORMAT "%3.0" /end CHARACTERISTIC
/begin CHARACTERISTIC c_ctr_crc_com_1_tcs "Maximum number of wrong Checksum calculation events before error detection of message TCS" VALUE 0xa080bb2d _REC_VAL_20_u1 255. _CNV_A_R_LINEAR_____0_CM 0. 255. DISPLAY_IDENTIFIER C_CTR_CRC_COM_1_TCS FORMAT "%3.0" /end CHARACTERISTIC
/begin CHARACTERISTIC c_abc_inc_com_1_tq_tcs "Anti-bounce counter increment Communication on FlexRay diagnosis" VALUE 0xa080b90a _REC_VAL_20_u1 255. _CNV_A_R_LINEAR_____0_CM 0. 255. DISPLAY_IDENTIFIER C_ABC_INC_COM_1_TQ_TCS FORMAT "%3.0" /end CHARACTERISTIC
/begin CHARACTERISTIC c_abc_dec_com_1_tq_tcs "Anti-bounce counter decrement Communication on FlexRay diagnosis" VALUE 0xa080b8ac _REC_VAL_20_u1 255. _CNV_A_R_LINEAR_____0_CM 0. 255. DISPLAY_IDENTIFIER C_ABC_DEC_COM_1_TQ_TCS FORMAT "%3.0" /end CHARACTERISTIC
/begin CHARACTERISTIC c_abc_max_com_1_tq_tcs "Anti-bounce counter maximum Communication on FlexRay diagnosis" VALUE 0xa080b9d2 _REC_VAL_20_u1 254. _CNV_A_R_LINEAR_____0_CM 1. 255. DISPLAY_IDENTIFIER C_ABC_MAX_COM_1_TQ_TCS FORMAT "%3.0" /end CHARACTERISTIC
/begin CHARACTERISTIC c_ctr_tout_com_1_tq_tcs "Maximum number of missing messages events before error detection of message TCS" VALUE 0xa080bbea _REC_VAL_20_u1 255. _CNV_A_R_LINEAR_____0_CM 0. 255. DISPLAY_IDENTIFIER C_CTR_TOUT_COM_1_TQ_TCS FORMAT "%3.0" /end CHARACTERISTIC
/begin CHARACTERISTIC c_ctr_tcc_com_1_tq_tcs "Maximum number of wrong TCC_COM_1 count events before error detection of message TCS" VALUE 0xa080bbd1 _REC_VAL_20_u1 255. _CNV_A_R_LINEAR_____0_CM 0. 255. DISPLAY_IDENTIFIER C_CTR_TCC_COM_1_TQ_TCS FORMAT "%3.0" /end CHARACTERISTIC
/begin CHARACTERISTIC c_ctr_crc_com_1_tq_tcs "Maximum number of wrong Checksum calculation events before error detection of message TCS" VALUE 0xa080bb31 _REC_VAL_20_u1 255. _CNV_A_R_LINEAR_____0_CM 0. 255. DISPLAY_IDENTIFIER C_CTR_CRC_COM_1_TQ_TCS FORMAT "%3.0" /end CHARACTERISTIC
/begin CHARACTERISTIC c_abc_inc_com_1_wheel_tcs "Anti-bounce counter increment Communication on FlexRay diagnosis" VALUE 0xa080b90e _REC_VAL_20_u1 255. _CNV_A_R_LINEAR_____0_CM 0. 255. DISPLAY_IDENTIFIER C_ABC_INC_COM_1_WHEEL_TCS FORMAT "%3.0" /end CHARACTERISTIC
/begin CHARACTERISTIC c_abc_dec_com_1_wheel_tcs "Anti-bounce counter decrement Communication on FlexRay diagnosis" VALUE 0xa080b8b0 _REC_VAL_20_u1 255. _CNV_A_R_LINEAR_____0_CM 0. 255. DISPLAY_IDENTIFIER C_ABC_DEC_COM_1_WHEEL_TCS FORMAT "%3.0" /end CHARACTERISTIC
/begin CHARACTERISTIC c_abc_max_com_1_wheel_tcs "Anti-bounce counter maximum Communication on FlexRay diagnosis" VALUE 0xa080b9d6 _REC_VAL_20_u1 254. _CNV_A_R_LINEAR_____0_CM 1. 255. DISPLAY_IDENTIFIER C_ABC_MAX_COM_1_WHEEL_TCS FORMAT "%3.0" /end CHARACTERISTIC
/begin CHARACTERISTIC c_ctr_tout_com_1_wheel_tcs "Maximum number of missing messages events before error detection of message TCS" VALUE 0xa080bbee _REC_VAL_20_u1 255. _CNV_A_R_LINEAR_____0_CM 0. 255. DISPLAY_IDENTIFIER C_CTR_TOUT_COM_1_WHEEL_TCS FORMAT "%3.0" /end CHARACTERISTIC
/begin CHARACTERISTIC c_ctr_tcc_com_1_wheel_tcs "Maximum number of wrong TCC_COM_1 count events before error detection of message TCS" VALUE 0xa080bbd4 _REC_VAL_20_u1 255. _CNV_A_R_LINEAR_____0_CM 0. 255. DISPLAY_IDENTIFIER C_CTR_TCC_COM_1_WHEEL_TCS FORMAT "%3.0" /end CHARACTERISTIC
/begin CHARACTERISTIC c_ctr_crc_com_1_wheel_tcs "Maximum number of wrong Checksum calculation events before error detection of message TCS" VALUE 0xa080bb34 _REC_VAL_20_u1 255. _CNV_A_R_LINEAR_____0_CM 0. 255. DISPLAY_IDENTIFIER C_CTR_CRC_COM_1_WHEEL_TCS FORMAT "%3.0" /end CHARACTERISTIC
/begin CHARACTERISTIC c_abc_inc_com_1_tqb_tcs "Anti-bounce counter increment Communication on FlexRay diagnosis" VALUE 0xa080b90b _REC_VAL_20_u1 255. _CNV_A_R_LINEAR_____0_CM 0. 255. DISPLAY_IDENTIFIER C_ABC_INC_COM_1_TQB_TCS FORMAT "%3.0" /end CHARACTERISTIC
/begin CHARACTERISTIC c_abc_dec_com_1_tqb_tcs "Anti-bounce counter decrement Communication on FlexRay diagnosis" VALUE 0xa080b8ad _REC_VAL_20_u1 255. _CNV_A_R_LINEAR_____0_CM 0. 255. DISPLAY_IDENTIFIER C_ABC_DEC_COM_1_TQB_TCS FORMAT "%3.0" /end CHARACTERISTIC
/begin CHARACTERISTIC c_abc_max_com_1_tqb_tcs "Anti-bounce counter maximum Communication on FlexRay diagnosis" VALUE 0xa080b9d3 _REC_VAL_20_u1 254. _CNV_A_R_LINEAR_____0_CM 1. 255. DISPLAY_IDENTIFIER C_ABC_MAX_COM_1_TQB_TCS FORMAT "%3.0" /end CHARACTERISTIC
/begin CHARACTERISTIC c_ctr_tout_com_1_tqb_tcs "Maximum number of missing messages events before error detection of message TCS" VALUE 0xa080bbeb _REC_VAL_20_u1 255. _CNV_A_R_LINEAR_____0_CM 0. 255. DISPLAY_IDENTIFIER C_CTR_TOUT_COM_1_TQB_TCS FORMAT "%3.0" /end CHARACTERISTIC
/begin CHARACTERISTIC c_abc_inc_com_1_brake_tcs "Anti-bounce counter increment Communication on FlexRay diagnosis" VALUE 0xa080b903 _REC_VAL_20_u1 255. _CNV_A_R_LINEAR_____0_CM 0. 255. DISPLAY_IDENTIFIER C_ABC_INC_COM_1_BRAKE_TCS FORMAT "%3.0" /end CHARACTERISTIC
/begin CHARACTERISTIC c_abc_dec_com_1_brake_tcs "Anti-bounce counter decrement Communication on FlexRay diagnosis" VALUE 0xa080b8a5 _REC_VAL_20_u1 255. _CNV_A_R_LINEAR_____0_CM 0. 255. DISPLAY_IDENTIFIER C_ABC_DEC_COM_1_BRAKE_TCS FORMAT "%3.0" /end CHARACTERISTIC
/begin CHARACTERISTIC c_abc_max_com_1_brake_tcs "Anti-bounce counter maximum Communication on FlexRay diagnosis" VALUE 0xa080b9cb _REC_VAL_20_u1 254. _CNV_A_R_LINEAR_____0_CM 1. 255. DISPLAY_IDENTIFIER C_ABC_MAX_COM_1_BRAKE_TCS FORMAT "%3.0" /end CHARACTERISTIC
/begin CHARACTERISTIC c_ctr_tout_com_1_brake_tcs "Maximum number of missing messages events before error detection of message TCS" VALUE 0xa080bbe3 _REC_VAL_20_u1 255. _CNV_A_R_LINEAR_____0_CM 0. 255. DISPLAY_IDENTIFIER C_CTR_TOUT_COM_1_BRAKE_TCS FORMAT "%3.0" /end CHARACTERISTIC
/begin CHARACTERISTIC c_abc_inc_com_3_efp "Anti-bounce counter increment Communication on A-CAN diagnosis" VALUE 0xa080b923 _REC_VAL_20_u1 255. _CNV_A_R_LINEAR_____0_CM 0. 255. DISPLAY_IDENTIFIER C_ABC_INC_COM_3_EFP FORMAT "%3.0" /end CHARACTERISTIC
/begin CHARACTERISTIC c_abc_dec_com_3_efp "Anti-bounce counter decrement Communication on A-CAN diagnosis" VALUE 0xa080b8c5 _REC_VAL_20_u1 255. _CNV_A_R_LINEAR_____0_CM 0. 255. DISPLAY_IDENTIFIER C_ABC_DEC_COM_3_EFP FORMAT "%3.0" /end CHARACTERISTIC
/begin CHARACTERISTIC c_abc_max_com_3_efp "Anti-bounce counter maximum Communication on A-CAN diagnosis" VALUE 0xa080b9eb _REC_VAL_20_u1 254. _CNV_A_R_LINEAR_____0_CM 1. 255. DISPLAY_IDENTIFIER C_ABC_MAX_COM_3_EFP FORMAT "%3.0" /end CHARACTERISTIC
/begin CHARACTERISTIC c_ctr_tout_com_3_efp "Maximum number of missing events before error detection of message EFP" VALUE 0xa080bc03 _REC_VAL_20_u1 255. _CNV_A_R_LINEAR_____0_CM 0. 255. DISPLAY_IDENTIFIER C_CTR_TOUT_COM_3_EFP FORMAT "%3.0" /end CHARACTERISTIC
/begin CHARACTERISTIC c_abc_inc_dtc_trm "anti bounce counter increment for DTC_TRM diagnosis" VALUE 0xa080b932 _REC_VAL_20_u1 255. _CNV_A_R_LINEAR_____0_CM 0. 255. DISPLAY_IDENTIFIER C_ABC_INC_DTC_TRM FORMAT "%3.0" /end CHARACTERISTIC
/begin CHARACTERISTIC c_abc_max_dtc_trm "maximal value of anti bounce counter for DTC_TRM diagnosis" VALUE 0xa080b9fa _REC_VAL_20_u1 254. _CNV_A_R_LINEAR_____0_CM 1. 255. DISPLAY_IDENTIFIER C_ABC_MAX_DTC_TRM FORMAT "%3.0" /end CHARACTERISTIC
/begin CHARACTERISTIC c_abc_inc_com_2_acc "" VALUE 0xa080b910 _REC_VAL_20_u1 255. _CNV_A_R_LINEAR_____0_CM 0. 255. DISPLAY_IDENTIFIER C_ABC_INC_COM_2_ACC FORMAT "%3.0" /end CHARACTERISTIC
/begin CHARACTERISTIC c_abc_dec_com_2_acc "" VALUE 0xa080b8b2 _REC_VAL_20_u1 255. _CNV_A_R_LINEAR_____0_CM 0. 255. DISPLAY_IDENTIFIER C_ABC_DEC_COM_2_ACC FORMAT "%3.0" /end CHARACTERISTIC
/begin CHARACTERISTIC c_abc_max_com_2_acc "" VALUE 0xa080b9d8 _REC_VAL_20_u1 254. _CNV_A_R_LINEAR_____0_CM 1. 255. DISPLAY_IDENTIFIER C_ABC_MAX_COM_2_ACC FORMAT "%3.0" /end CHARACTERISTIC
/begin CHARACTERISTIC c_ctr_tout_com_2_acc "" VALUE 0xa080bbf0 _REC_VAL_20_u1 255. _CNV_A_R_LINEAR_____0_CM 0. 255. DISPLAY_IDENTIFIER C_CTR_TOUT_COM_2_ACC FORMAT "%3.0" /end CHARACTERISTIC
/begin COMPU_METHOD _CNV_A_R_LINEAR_____0_CM "" RAT_FUNC "%6.3" "-" COEFFS 0 1. 0. 0 0 1 /end COMPU_METHOD
/begin COMPU_METHOD _CNV_S_2_RANGE__0___1_CM "" TAB_VERB "%6.3" "-" COMPU_TAB_REF _CNV_S_2_RANGE__0___1 /end COMPU_METHOD
/begin COMPU_VTAB _CNV_S_2_RANGE__0___1 "" TAB_VERB 2 0 "0" 1 "1" /end COMPU_VTAB
/begin COMPU_METHOD _CNV_A_R_LINEAR_____2_CM "" RAT_FUNC "%6.3" "V" COEFFS 0 204.8 0. 0 0 1 /end COMPU_METHOD
/begin COMPU_METHOD _CNV_A_R_LINEAR_____3_CM "" RAT_FUNC "%6.3" "s" COEFFS 0 100. 0. 0 0 1 /end COMPU_METHOD
/begin COMPU_METHOD _CNV_A_R_LINEAR_____4_CM "" RAT_FUNC "%6.3" "s" COEFFS 0 10. 0. 0 0 1 /end COMPU_METHOD
/begin COMPU_METHOD _CNV_A_R_LINEAR_____8_CM "" RAT_FUNC "%6.3" "%" COEFFS 0 655.3599999999997 0. 0 0 1 /end COMPU_METHOD
/begin COMPU_METHOD _CNV_A_R_LINEAR_____17_CM "" RAT_FUNC "%6.3" "°C" COEFFS 0 1.333333333333333 64. 0 0 1 /end COMPU_METHOD
/begin COMPU_METHOD _CNV_A_R_LINEAR_____19_CM "" RAT_FUNC "%6.3" "s" COEFFS 0 2. 0. 0 0 1 /end COMPU_METHOD
/begin COMPU_METHOD _CNV_A_R_LINEAR_____22_CM "" RAT_FUNC "%6.3" "V" COEFFS 0 9.846168103048838 0. 0 0 1 /end COMPU_METHOD
/begin COMPU_METHOD _CNV_A_R_LINEAR_____26_CM "" RAT_FUNC "%6.3" "°C" COEFFS 0 1. 40. 0 0 1 /end COMPU_METHOD
/begin COMPU_METHOD _CNV_A_R_LINEAR_____31_CM "" RAT_FUNC "%6.3" "Nm" COEFFS 0 32. 0. 0 0 1 /end COMPU_METHOD
/begin COMPU_METHOD _CNV_A_R_LINEAR_____86_CM "" RAT_FUNC "%6.3" "km/h" COEFFS 0 128.0000018750286 0. 0 0 1 /end COMPU_METHOD
/begin COMPU_METHOD _CNV_A_R_LINEAR_____148_CM "" RAT_FUNC "%6.3" "mA" COEFFS 0 163.8375 0. 0 0 1 /end COMPU_METHOD
/begin COMPU_METHOD _CNV_A_R_LINEAR_____172_CM "" RAT_FUNC "%6.3" "V" COEFFS 0 6553.60054017653 0. 0 0 1 /end COMPU_METHOD
/begin COMPU_METHOD _CNV_A_R_LINEAR_____435_CM "" RAT_FUNC "%6.3" "-/100ms" COEFFS 0 1. 0. 0 0 1 /end COMPU_METHOD
/begin COMPU_METHOD _CNV_S_8_STATE_BSD__547_CM "" TAB_VERB "%6.3" "" COMPU_TAB_REF _CNV_S_8_STATE_BSD__547 /end COMPU_METHOD
/begin COMPU_VTAB _CNV_S_8_STATE_BSD__547 "" TAB_VERB 8 0 "SENS_BAT_SMT" 1 "O3" 2 "NO DEVICE" 3 "CWP" 4 "QOIL" 5 "NO DEVICE" 6 "ALTER" 7 "NO DEVICE" /end COMPU_VTAB
/begin RECORD_LAYOUT _REC_VAL_20_u1 FNC_VALUES 1 UBYTE COLUMN_DIR DIRECT /end RECORD_LAYOUT
/begin RECORD_LAYOUT _REC_VAL_20_u2 FNC_VALUES 1 UWORD COLUMN_DIR DIRECT /end RECORD_LAYOUT
/begin RECORD_LAYOUT _REC_AXS_20_u1 NO_AXIS_PTS_X 1 UBYTE AXIS_PTS_X 2 UBYTE INDEX_INCR DIRECT /end RECORD_LAYOUT
/begin RECORD_LAYOUT _REC_CUR_20_u1_u1 FNC_VALUES 1 UBYTE COLUMN_DIR DIRECT /end RECORD_LAYOUT
/begin FUNCTION DIA_Anti_bounce_algorithm "_Anti-bounce-algorithm"
 /begin DEF_CHARACTERISTIC c_abc_max_dmtlh c_abc_inc_dmtlh c_abc_inc_dmtl_pump c_abc_max_dmtl_pump c_abc_inc_dmtls c_abc_max_dmtls c_abc_inc_rly_accout c_abc_max_rly_accout c_abc_max_ebox_cfa c_abc_inc_ebox_cfa c_abc_max_ef c_abc_inc_ef c_abc_inc_rly_st c_abc_max_rly_st c_abc_inc_slv_ivvt_1 c_abc_inc_slv_ivvt_2 c_abc_max_slv_ivvt_2 c_abc_max_slv_ivvt_1 c_abc_inc_imob_1 c_abc_inc_imob_2 c_abc_inc_imob_3 c_abc_max_imob_0 c_abc_max_imob_1 c_abc_max_imob_3 c_abc_max_imob_2 c_abc_inc_imob_0 c_abc_dec_imob_0 c_abc_dec_imob_1 c_abc_dec_imob_3 c_abc_inc_amp c_abc_max_amp c_abc_inc_im_bts_plaus c_abc_inc_im_bls_plaus c_abc_max_im_bts_plaus c_abc_max_im_bls_plaus c_abc_inc_bn_tq_dcc c_abc_inc_bn_tq_tcs c_abc_inc_bn_vs_tcs c_abc_inc_bn_tcs c_abc_inc_bn_tq_etcu c_abc_inc_bn_etcu c_abc_inc_bn_etcu_2 c_abc_inc_bn_etcu_3 c_abc_inc_bn_etcu_disp c_abc_inc_bn_tq_amt c_abc_inc_bn_acc c_abc_inc_bn_icl c_abc_inc_bn_km_icl c_abc_inc_bn_veh_mod c_abc_inc_bn_t_icl c_abc_inc_bn_pow_vb c_abc_inc_bn_pow_gen c_abc_inc_bn_msw c_abc_inc_bn_ang_pste c_abc_max_bn_tq_tcs c_abc_max_bn_vs_tcs c_abc_max_bn_tcs c_abc_max_bn_tq_etcu c_abc_max_bn_etcu c_abc_max_bn_etcu_2 c_abc_max_bn_etcu_3 c_abc_max_bn_etcu_disp c_abc_max_bn_tq_amt c_abc_max_bn_acc c_abc_max_bn_t_icl c_abc_max_bn_km_icl c_abc_max_bn_veh_mod c_abc_max_bn_icl c_abc_max_bn_pow_vb c_abc_max_bn_pow_gen c_abc_max_bn_msw c_abc_max_bn_tq_dcc c_abc_max_bn_ang_pste c_ctr_diag_tcc_can_max_ars c_ctr_diag_tcc_can_max_tq_tcs c_ctr_diag_tcc_can_max_tq_etcu c_ctr_diag_tcc_can_max_etcu_3 c_ctr_diag_tcc_can_max_tq_amt c_ctr_diag_tcc_can_max_veh_mod c_ctr_diag_tcc_can_max_icl c_ctr_diag_tcc_can_max_msw c_ctr_diag_tcc_can_max_tq_dcc c_ctr_diag_cks_max_tq_tcs c_ctr_diag_cks_max_tq_etcu c_ctr_diag_cks_max_etcu_3 c_ctr_diag_cks_max_tq_amt c_ctr_diag_cks_max_veh_mod c_ctr_diag_cks_max_msw c_ctr_diag_cks_max_tq_dcc c_ctr_diag_tout_max_ars c_ctr_diag_tout_max_tq_tcs c_ctr_diag_tout_max_vs_tcs c_ctr_diag_tout_max_tcs c_ctr_diag_tout_max_tq_etcu c_ctr_diag_tout_max_tq_dcc c_ctr_diag_tout_max_tq_amt c_ctr_diag_tout_max_acc c_ctr_diag_tout_max_t_icl c_ctr_diag_tout_max_cdn_door c_ctr_diag_tout_max_veh_mod c_ctr_diag_tout_max_km_icl c_ctr_diag_tout_max_icl c_ctr_diag_tout_max_pow_vb c_ctr_diag_tout_max_pow_gen c_ctr_diag_tout_max_msw c_ctr_diag_tout_max_etcu c_ctr_diag_tout_max_etcu_2 c_ctr_diag_tout_max_etcu_3 c_ctr_diag_tout_max_etcu_disp c_ctr_diag_tout_max_ang_pste c_abc_max_bn_ars c_abc_inc_bn_ars c_abc_dec_bn_tq_dcc c_abc_dec_bn_ars c_abc_dec_bn_tq_tcs c_abc_dec_bn_vs_tcs c_abc_dec_bn_tcs c_abc_dec_bn_tq_etcu c_abc_dec_bn_etcu c_abc_dec_bn_etcu_2 c_abc_dec_bn_etcu_3 c_abc_dec_bn_etcu_disp c_abc_dec_bn_tq_amt c_abc_dec_bn_acc c_abc_dec_bn_icl c_abc_dec_bn_km_icl c_abc_dec_bn_t_icl c_abc_dec_bn_pow_vb c_abc_dec_bn_pow_gen c_abc_dec_bn_msw c_abc_dec_bn_ang_pste c_abc_dec_bn_veh_mod c_abc_inc_bn_cdn_door c_abc_inc_bn_tq_pste_2 c_abc_max_bn_tq_pste_2 c_abc_max_bn_cdn_door c_abc_dec_bn_tq_pste_2 c_abc_dec_bn_cdn_door c_abc_inc_bn_tq_pste_3 c_abc_max_bn_tq_pste_3 c_abc_dec_bn_tq_pste_3 c_ctr_diag_tcc_can_max_tq_pste_2 c_ctr_diag_tcc_can_max_tq_pste_3 c_ctr_diag_cks_max_tq_pste_2 c_ctr_diag_cks_max_tq_pste_3 c_ctr_diag_tout_max_tq_pste_2 c_ctr_diag_tout_max_tq_pste_3 c_abc_inc_bn_efp c_abc_inc_bn_efp_crash c_abc_max_bn_efp c_abc_max_bn_efp_crash c_abc_dec_bn_efp c_abc_dec_bn_efp_crash c_ctr_diag_tout_max_efp c_ctr_diag_tout_max_efp_crash c_abc_inc_bn_gear_rev c_abc_max_bn_gear_rev c_abc_dec_bn_gear_rev c_ctr_diag_tout_max_gear_rev c_abc_inc_bn_ltg_hdlp_l c_abc_max_bn_ltg_hdlp_l c_abc_dec_bn_ltg_hdlp_l c_ctr_diag_tout_max_ltg_hdlp_l c_abc_inc_bn_ldm c_abc_max_bn_ldm c_ctr_diag_tcc_can_max_ldm c_ctr_diag_cks_max_ldm c_ctr_diag_tout_max_ldm c_abc_dec_bn_ldm c_abc_inc_bn_hiv c_abc_max_bn_hiv c_ctr_diag_tout_max_hiv c_abc_dec_bn_hiv c_abc_inc_bn_trl c_abc_max_bn_trl c_ctr_diag_tout_max_trl c_abc_dec_bn_trl c_abc_inc_bn_t_clk c_abc_max_bn_t_clk c_ctr_diag_tout_max_t_clk c_abc_dec_bn_t_clk c_abc_inc_bn_cas c_abc_inc_bn_req_pbr c_abc_inc_bn_pbr c_abc_max_bn_cas c_abc_max_bn_req_pbr c_abc_max_bn_pbr c_abc_dec_bn_cas c_abc_dec_bn_req_pbr c_abc_dec_bn_pbr c_ctr_diag_tcc_can_max_cas c_ctr_diag_tcc_can_max_req_pbr c_ctr_diag_tcc_can_max_pbr c_ctr_diag_cks_max_cas c_ctr_diag_cks_max_req_pbr c_ctr_diag_cks_max_pbr c_ctr_diag_tout_max_cas c_ctr_diag_tout_max_req_pbr c_ctr_diag_tout_max_pbr c_abc_inc_bsd c_abc_inc_qoil_com c_abc_inc_cwp_com c_abc_inc_sens_bat_smt_com c_abc_inc_alter_com c_abc_max_bsd c_abc_max_alter_com c_abc_max_cwp_com c_abc_max_qoil_com c_abc_max_sens_bat_smt_com c_abc_inc_efp c_abc_max_efp c_abc_inc_efp_crash c_abc_max_efp_crash c_abc_inc_can_boff c_abc_max_can_boff c_abc_inc_locan_boff c_abc_max_locan_boff c_abc_inc_dcc c_abc_max_dcc c_abc_inc_cs c_abc_max_cs c_ctr_req_msg_oil c_abc_inc_maf_frq_el[0] c_abc_inc_maf_frq_el[1] c_abc_inc_maf_frq_grd[0] c_abc_inc_maf_frq_grd[1] c_abc_inc_maf_frq_rng[0] c_abc_inc_maf_frq_rng[1] c_abc_max_maf_frq_el[0] c_abc_max_maf_frq_el[1] c_abc_max_maf_frq_grd[0] c_abc_max_maf_frq_grd[1] c_abc_max_maf_frq_rng[0] c_abc_max_maf_frq_rng[1] c_abc_inc_maf c_abc_max_maf c_abc_inc_poil_swi c_abc_max_poil_swi c_abc_inc_poil_dr c_abc_max_poil_dr c_abc_inc_poil c_abc_max_poil c_abc_inc_pvs_ratio c_abc_max_pvs_ratio c_abc_max_pvs_bls_not_plaus c_abc_inc_pvs_bls_not_plaus c_abc_inc_v_ref_1 c_abc_inc_v_ref_2 c_abc_max_v_ref_1 c_abc_max_v_ref_2 c_abc_inc_pvs_1 c_abc_inc_pvs_2 c_abc_max_pvs_1 c_abc_max_pvs_2 c_abc_inc_sof_req c_abc_max_sof_req c_abc_max_tecu c_abc_inc_tecu c_abc_inc_teg_pcat_down c_abc_max_teg_pcat_down c_abc_inc_tia_plaus c_abc_max_tia_plaus c_abc_inc_tq_req_can c_abc_max_tq_req_can c_abc_inc_tqi_lim c_abc_max_tqi_lim c_abc_max_vs c_abc_inc_vs c_abc_max_cwp_int_off c_abc_inc_cwp_pwr c_abc_max_cwp_pwr c_abc_inc_cwp_int_off c_abc_inc_mec_ivvt_in_1 c_abc_inc_mec_ivvt_in_2 c_abc_max_mec_ivvt_in_1 c_abc_max_mec_ivvt_in_2 c_abc_max_gen c_abc_inc_gen c_abc_inc_qoil_sens c_abc_max_qoil_sens c_abc_inc_bat_sens_it c_abc_inc_bat_sens_it_el c_abc_max_bat_sens_it c_abc_max_bat_sens_it_el c_abc_inc_bat_sens c_abc_inc_alter_bn c_abc_inc_alter_bn_bat c_abc_max_bat_sens c_abc_max_alter_bn c_abc_max_alter_bn_bat c_abc_inc_load_tps_plaus c_abc_max_load_tps_plaus c_abc_inc_map_dip_plaus c_abc_max_map_dip_plaus c_abc_inc_alter_bn_rgn c_abc_max_alter_bn_rgn c_abc_dec_load_tps_plaus c_abc_inc_mec_ivvt_ex c_abc_max_mec_ivvt_ex c_abc_inc_toil_level c_abc_max_toil_level c_abc_inc_poil_ctl_stat c_abc_inc_poil_ctl_dyn c_abc_max_poil_ctl_stat c_abc_max_poil_ctl_dyn c_abc_inc_amp_plaus_cus c_abc_max_amp_plaus_cus c_abc_inc_tcha_prs_low c_abc_inc_tcha_leak c_abc_inc_tcha_prs_dif c_abc_inc_tcha_prs_high c_abc_max_tcha_prs_low c_abc_max_tcha_leak c_abc_max_tcha_prs_dif c_abc_max_tcha_prs_high c_abc_inc_put_plaus c_abc_max_put_plaus c_abc_inc_map_plaus c_abc_max_map_plaus c_abc_inc_tq_cst c_abc_max_tq_cst c_abc_inc_gen_el c_abc_inc_gen_mec c_abc_inc_gen_h_temp c_abc_inc_gen_typ_not_plaus c_abc_inc_gen_msg_lost c_abc_inc_gen_clc_v_not_plaus c_abc_inc_gen_h_temp_clc c_abc_inc_gen_ctl_not_plaus c_abc_max_gen_el c_abc_max_gen_mec c_abc_max_gen_h_temp c_abc_max_gen_typ_not_plaus c_abc_max_gen_msg_lost c_abc_max_gen_clc_v_not_plaus c_abc_max_gen_h_temp_clc c_abc_max_gen_ctl_not_plaus c_abc_inc_gs c_abc_dec_gs c_abc_max_gs c_abc_inc_plaus_igk_bn c_abc_max_plaus_igk_bn c_vb_min_igk_diag c_abc_max_spi_mps c_abc_max_spi_knk c_abc_inc_spi_mps c_abc_inc_spi_knk c_abc_inc_gen_diag c_abc_max_gen_diag c_abc_inc_tout_nox_sens c_abc_max_tout_nox_sens c_abc_inc_t_es c_abc_max_t_es c_abc_inc_ftl_le_can c_abc_inc_ftl_ri_can c_abc_max_ftl_le_can c_abc_max_ftl_ri_can c_abc_inc_rly_main c_ctr_inc_diag_rly_main_dly c_ctr_inc_end_diag_rly_main_dly c_abc_max_rly_main c_ctr_max_diag_rly_main_dly c_ctr_max_end_diag_rly_main_dly c_abc_inc_map_sens c_abc_inc_map_shift c_abc_max_map_sens c_abc_max_map_shift c_abc_inc_ldm c_abc_max_ldm c_abc_inc_amp_plaus c_abc_max_amp_plaus c_abc_inc_rly_crcv_heat c_abc_max_rly_crcv_heat c_abc_inc_sof c_abc_max_sof c_abc_inc_sof_inh_mon c_abc_max_sof_inh_mon c_abc_inc_swi_afs_mon c_abc_max_swi_afs_mon c_abc_inc_rfp_dr_1 c_abc_inc_rfp_dr_2 c_abc_max_rfp_dr_1 c_abc_max_rfp_dr_2 c_abc_inc_wg_1_dr c_abc_inc_wg_2_dr c_abc_max_wg_1_dr c_abc_max_wg_2_dr c_abc_inc_put_el c_abc_max_put_el c_abc_inc_tia_el c_abc_max_tia_el c_abc_inc_tia_thr_el c_abc_max_tia_thr_el c_abc_inc_com_2_t_icl c_abc_dec_com_2_t_icl c_abc_max_com_2_t_icl c_ctr_tout_com_2_t_icl c_abc_inc_com_2_km_icl c_abc_dec_com_2_km_icl c_abc_max_com_2_km_icl c_ctr_tout_com_2_km_icl c_abc_inc_com_2_t_absl_icl c_abc_dec_com_2_t_absl_icl c_abc_max_com_2_t_absl_icl c_ctr_tout_com_2_t_absl_icl c_abc_inc_com_2_icl c_abc_dec_com_2_icl c_abc_max_com_2_icl c_ctr_tout_com_2_icl c_ctr_tcc_com_2_icl c_abc_inc_com_2_t_clk c_abc_dec_com_2_t_clk c_abc_max_com_2_t_clk c_ctr_tout_com_2_t_clk c_ctr_tout_com_2_abs_icl c_abc_inc_com_2_abs_icl c_abc_dec_com_2_abs_icl c_abc_max_com_2_abs_icl c_t_tout_t_absv c_ctr_tout_com_2_tam_icl c_abc_inc_com_2_tam_icl c_abc_dec_com_2_tam_icl c_abc_max_com_2_tam_icl c_abc_inc_com_2_cas_2 c_abc_dec_com_2_cas_2 c_abc_max_com_2_cas_2 c_ctr_tout_com_2_cas_2 c_ctr_tcc_com_2_cas_2 c_ctr_crc_com_2_cas_2 c_abc_inc_com_2_cas c_abc_dec_com_2_cas c_abc_max_com_2_cas c_ctr_tout_com_2_cas c_ctr_tcc_com_2_cas c_ctr_crc_com_2_cas c_abc_inc_com_2_pow_off c_abc_dec_com_2_pow_off c_abc_max_com_2_pow_off c_ctr_tout_com_2_pow_off c_abc_inc_com_2_cdn_door c_abc_dec_com_2_cdn_door c_abc_max_com_2_cdn_door c_ctr_tout_com_2_cdn_door c_abc_inc_com_2_state_veh c_abc_dec_com_2_state_veh c_abc_max_com_2_state_veh c_abc_inc_com_2_trl c_abc_dec_com_2_trl c_abc_max_com_2_trl c_abc_inc_com_2_gear_rev c_abc_dec_com_2_gear_rev c_abc_max_com_2_gear_rev c_abc_inc_com_2_efp_crash c_abc_dec_com_2_efp_crash c_abc_max_com_2_efp_crash c_abc_inc_com_1_ac_lgt c_abc_dec_com_1_ac_lgt c_abc_max_com_1_ac_lgt c_abc_inc_com_1_ac_trv c_abc_dec_com_1_ac_trv c_abc_max_com_1_ac_trv c_abc_inc_com_1_tq_pste c_abc_dec_com_1_tq_pste c_abc_max_com_1_tq_pste c_abc_inc_com_1_vs c_abc_dec_com_1_vs c_abc_max_com_1_vs c_abc_inc_com_1_req_tqdw c_abc_dec_com_1_req_tqdw c_abc_max_com_1_req_tqdw c_ctr_tout_com_1_ac_trv c_ctr_tcc_com_1_ac_trv c_ctr_crc_com_1_ac_trv c_abc_inc_com_1_tq_loss_cord c_abc_dec_com_1_tq_loss_cord c_abc_max_com_1_tq_loss_cord c_ctr_tout_com_1_tq_loss_cord c_ctr_tcc_com_1_tq_loss_cord c_ctr_crc_com_1_tq_loss_cord c_abc_inc_com_1_tq_driv_asi c_abc_dec_com_1_tq_driv_asi c_abc_max_com_1_tq_driv_asi c_ctr_tout_com_1_tq_driv_asi c_ctr_tcc_com_1_tq_driv_asi c_ctr_crc_com_1_tq_driv_asi c_abc_inc_com_1_veh_mod c_abc_dec_com_1_veh_mod c_abc_max_com_1_veh_mod c_ctr_tout_com_1_veh_mod c_ctr_tcc_com_1_veh_mod c_ctr_crc_com_1_veh_mod c_abc_inc_com_2_tq_etcu c_abc_dec_com_2_tq_etcu c_abc_max_com_2_tq_etcu c_ctr_tout_com_2_tq_etcu c_ctr_tcc_com_2_tq_etcu c_ctr_crc_com_2_tq_etcu c_abc_inc_com_3_tq_etcu c_abc_dec_com_3_tq_etcu c_abc_max_com_3_tq_etcu c_ctr_tout_com_3_tq_etcu c_ctr_tcc_com_3_tq_etcu c_ctr_crc_com_3_tq_etcu c_abc_inc_com_2_etcu c_abc_dec_com_2_etcu c_abc_max_com_2_etcu c_ctr_tout_com_2_etcu c_ctr_tcc_com_2_etcu c_ctr_crc_com_2_etcu c_abc_inc_com_3_etcu c_abc_dec_com_3_etcu c_abc_max_com_3_etcu c_ctr_tout_com_3_etcu c_ctr_tcc_com_3_etcu c_ctr_crc_com_3_etcu c_abc_inc_com_2_etcu_disp c_abc_dec_com_2_etcu_disp c_abc_max_com_2_etcu_disp c_ctr_tout_com_2_etcu_disp c_abc_inc_com_3_etcu_disp c_abc_dec_com_3_etcu_disp c_abc_max_com_3_etcu_disp c_ctr_tout_com_3_etcu_disp c_abc_inc_com_3_etcu_obd c_abc_dec_com_3_etcu_obd c_abc_max_com_3_etcu_obd c_ctr_tout_com_3_etcu_obd c_abc_inc_com_2_gb c_abc_dec_com_2_gb c_abc_max_com_2_gb c_ctr_tout_com_2_gb c_abc_inc_com_3_gb c_abc_dec_com_3_gb c_abc_max_com_3_gb c_ctr_tout_com_3_gb c_ctr_tcc_com_3_etcu_disp c_ctr_crc_com_3_etcu_disp c_abc_inc_com_1_ang_pste c_abc_dec_com_1_ang_pste c_abc_max_com_1_ang_pste c_abc_inc_com_1_swi_gear c_abc_dec_com_1_swi_gear c_abc_max_com_1_swi_gear c_abc_inc_com_1_tcs c_abc_dec_com_1_tcs c_abc_max_com_1_tcs c_ctr_tout_com_1_tcs c_ctr_tcc_com_1_tcs c_ctr_crc_com_1_tcs c_abc_inc_com_1_tq_tcs c_abc_dec_com_1_tq_tcs c_abc_max_com_1_tq_tcs c_ctr_tout_com_1_tq_tcs c_ctr_tcc_com_1_tq_tcs c_ctr_crc_com_1_tq_tcs c_abc_inc_com_1_wheel_tcs c_abc_dec_com_1_wheel_tcs c_abc_max_com_1_wheel_tcs c_ctr_tout_com_1_wheel_tcs c_ctr_tcc_com_1_wheel_tcs c_ctr_crc_com_1_wheel_tcs c_abc_inc_com_1_tqb_tcs c_abc_dec_com_1_tqb_tcs c_abc_max_com_1_tqb_tcs c_ctr_tout_com_1_tqb_tcs c_abc_inc_com_1_brake_tcs c_abc_dec_com_1_brake_tcs c_abc_max_com_1_brake_tcs c_ctr_tout_com_1_brake_tcs c_abc_inc_com_3_efp c_abc_dec_com_3_efp c_abc_max_com_3_efp c_ctr_tout_com_3_efp c_abc_inc_dtc_trm c_abc_max_dtc_trm c_abc_inc_com_2_acc c_abc_dec_com_2_acc c_abc_max_com_2_acc c_ctr_tout_com_2_acc /end DEF_CHARACTERISTIC
 /begin OUT_MEASUREMENT lv_err_amp /end OUT_MEASUREMENT
/end FUNCTION
/begin FUNCTION DIA_Torque_Request_for_Safety_Diagnosis "_Torque Request for Safety Diagnosis" /begin OUT_MEASUREMENT lv_err_tqi_lim /end OUT_MEASUREMENT /end FUNCTION
/begin FUNCTION DIA_E_box_cooling_fan_diagnosis "_E-box cooling fan diagnosis" /begin OUT_MEASUREMENT lv_err_ebox_cfa /end OUT_MEASUREMENT /end FUNCTION
/begin FUNCTION DIA_ECU_temperature_sensor_diagnosis "_ECU temperature sensor diagnosis"
 /begin DEF_CHARACTERISTIC c_tia_max_tecu_diag c_vp_tecu_min_diag c_vp_tecu_max_diag c_t_dly_tecu_diag /end DEF_CHARACTERISTIC
/end FUNCTION
/begin FUNCTION DIA_Tank_leakage_pump_diagnosis "_Tank leakage pump diagnosis" /begin DEF_CHARACTERISTIC c_v_dmtl_max_diag c_t_v_dmtl_max_diag /end DEF_CHARACTERISTIC
 /begin OUT_MEASUREMENT cdn_diag_dmtlh lv_err_dmtlh lv_inh_diag_dmtlh cdn_diag_dmtl_pump lv_err_dmtl_pump lv_inh_diag_dmtl_pump t_v_dmtl_max_diag cdn_diag_dmtls lv_inh_diag_dmtls lv_err_dmtls iso_m6_diag_ram_com.m6_cur_dmtl_cor_fil_cid18 iso_m6_diag_ram_com.m6_cur_dmtl_cor_fil_cid19 iso_m6_diag_ram_com.m6_cur_dmtl_dmtls_test iso_m6_diag_ram_com.m6_cur_dmtl_thd_dmtls_test iso_m6_diag_ram_com.m6_cur_dmtl_rough_leak_end iso_m6_diag_ram_com.m6_cur_dmtl_thd_rough_leak iso_m6_diag_ram_com.m6_cur_dmtl_small_leak_end iso_m6_diag_ram_com.m6_cur_dmtl_ref_leak iso_m6_diag_ram_com.m6_cur_dmtl_rough_leak_len_end iso_m6_diag_ram_com.m6_cur_dmtl_thd_rough_leak_len iso_m6_diag_ram_com.m6_ctr_cnl_small_leak_mes /end OUT_MEASUREMENT
/end FUNCTION
/begin FUNCTION DIA_SOF_diagnosis "_SOF diagnosis" /begin DEF_CHARACTERISTIC c_v_sof_swi_min c_v_sof_swi_max /end DEF_CHARACTERISTIC /begin OUT_MEASUREMENT lv_err_sof_req lv_err_sof cdn_diag_sof lv_inh_diag_sof /end OUT_MEASUREMENT /end FUNCTION
/begin FUNCTION DIA_TPS___ETC_Limp_Home_Manager "DIA_TPS / ETC Limp-Home Manager" /end FUNCTION
/begin FUNCTION DIA_Diagnosis_Oil_temperature_and_level_sensor___DTOENS_ "_Diagnosis Oil temperature and level sensor  (DTOENS)"
 /begin OUT_MEASUREMENT lv_err_bat_sens_it lv_err_bat_sens_it_el lv_err_bat_sens lv_err_alter_bn lv_err_alter_bn_bat /end OUT_MEASUREMENT
/end FUNCTION
/begin FUNCTION DIA_BSD_Diagnosis "_BSD Diagnosis"
 /begin DEF_CHARACTERISTIC c_ctr_max_msg_cwp_com c_ctr_max_msg_qoil_com c_ctr_max_msg_sens_bat_smt_com c_ctr_thd_msg_cwp_com_diag c_ctr_max_msg_alter_com c_ctr_max_alter_com_stop c_ctr_max_cwp_com_stop c_ctr_max_qoil_com_stop c_ctr_max_sens_bat_smt_com_stop id_state_bsd_sdl_tbl c_state_bsd_cpt_det c_state_bsd_cpt_avl c_ctr_bsd_cpt_det /end DEF_CHARACTERISTIC
 /begin OUT_MEASUREMENT lv_err_alter_com lv_err_cwp_com lv_err_qoil_com lv_err_sens_bat_smt_com ctr_msg_alter_com_diag ctr_msg_cwp_com_diag ctr_msg_qoil_com_diag ctr_msg_sens_bat_smt_com_diag ctr_msg_sens_bat_smt_com_stop ctr_msg_qoil_com_stop ctr_msg_cwp_com_stop ctr_msg_alter_com_stop state_bsd_msg_com_stop lv_err_bsd lv_inh_cwp_diag lv_msg_alter_com_stop lv_msg_cwp_com_stop lv_msg_qoil_com_stop lv_msg_sens_bat_smt_com_stop ctr_abc_alter_com ctr_abc_cwp_com ctr_abc_qoil_com ctr_abc_sens_bat_smt_com ctr_end_diag_alter_com ctr_end_diag_cwp_com ctr_end_diag_qoil_com ctr_end_diag_sens_bat_smt_com lv_sens_bat_smt_act bsd_sens_bat_smt_info bsd_sens_bat_smt_adr lf_bsd_sens_bat_smt_ctl lv_sens_bat_smt_det lf_bsd_cpt_avl state_bsd_com lv_alter_com_act lv_cwp_com_act lv_qoil_com_act lv_sens_bat_smt_com_act state_bsd_cpt idx_bsd_sdl_tbl ctr_bsd_cpt_com_ok /end OUT_MEASUREMENT
/end FUNCTION
/begin FUNCTION DIA_Starter_Output_Diagnosis "_Starter Output Diagnosis"
 /begin OUT_MEASUREMENT cdn_diag_ebox_cfa lv_err_rly_st cdn_diag_rly_st lv_inh_diag_rly_st /end OUT_MEASUREMENT
/end FUNCTION
/begin FUNCTION DIA_Oil_pressure_switch_diagnosis "_Oil pressure switch diagnosis"
 /begin DEF_CHARACTERISTIC c_t_poil_swi_pwl c_toil_poil_swi_max_diag c_toil_poil_swi_min_diag /end DEF_CHARACTERISTIC
 /begin OUT_MEASUREMENT t_poil_swi_pwl lv_err_poil_swi /end OUT_MEASUREMENT
/end FUNCTION
/begin FUNCTION DIA_CAN_diagnosis_for_EFP_control "_CAN diagnosis for EFP control" /begin OUT_MEASUREMENT lv_err_efp lv_err_efp_crash /end OUT_MEASUREMENT /end FUNCTION
/begin FUNCTION DIA_ETC_Actuator_diagnosis_and_Adaptation "_ETC Actuator diagnosis and Adaptation" /begin OUT_MEASUREMENT lv_err_mtc_ctl_1 /end OUT_MEASUREMENT /end FUNCTION
/begin FUNCTION DIA_Electric_solenoid_valve_diagnosis "_Electric solenoid valve diagnosis"
 /begin DEF_CHARACTERISTIC c_slv_ivvt_pwm_diag_min_oc c_slv_ivvt_pwm_diag_min_scb c_slv_ivvt_pwm_diag_max_scg /end DEF_CHARACTERISTIC
 /begin OUT_MEASUREMENT cdn_diag_slv_ivvt_ex_1 cdn_diag_slv_ivvt_ex_2 cdn_diag_slv_ivvt_in_1 cdn_diag_slv_ivvt_in_2 lv_err_slv_ivvt_ex_1 lv_err_slv_ivvt_ex_2 lv_err_slv_ivvt_in_1 lv_err_slv_ivvt_in_2 lv_inh_diag_slv_ivvt_ex_1 lv_inh_diag_slv_ivvt_ex_2 lv_inh_diag_slv_ivvt_in_1 lv_inh_diag_slv_ivvt_in_2 /end OUT_MEASUREMENT
/end FUNCTION
/begin FUNCTION DIA_AMT_intervention_plausibility "_AMT intervention plausibility"
 /begin DEF_CHARACTERISTIC c_vs_fil_amt c_t_max_state_amt_1_diag c_t_max_state_amt_2_diag c_t_max_tqi_amt_diag c_tqi_amt_diag c_tqi_amt_cond_diag c_tqi_amt_can_es c_t_max_state_amt_3_diag c_t_max_state_clu_amt_diag /end DEF_CHARACTERISTIC
 /begin OUT_MEASUREMENT state_err_amt_can lv_amt_es_req t_state_amt_1_diag t_state_amt_2_diag t_state_amt_3_diag state_err_amt state_amt_old t_state_clu_amt_diag tqi_amt_plaus /end OUT_MEASUREMENT
/end FUNCTION
/begin FUNCTION DIA_GS_intervention_plausibility_Diagnosis "_GS intervention plausibility Diagnosis" /end FUNCTION
/begin FUNCTION DIA_Distance_cruise_control_diagnosis "_Distance cruise control diagnosis" /begin DEF_CHARACTERISTIC c_t_max_brake_det_dcc /end DEF_CHARACTERISTIC /begin OUT_MEASUREMENT lv_dcc_off_ecu t_dcc_brake_det lv_err_dcc /end OUT_MEASUREMENT /end FUNCTION
/end MODULE
/end PROJECT
